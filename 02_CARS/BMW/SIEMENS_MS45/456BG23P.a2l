ASAP2_VERSION 1 31
/begin PROJECT MS45 "BMW Motorsteuerung R6"
/begin HEADER "_default_HeaderComment" PROJECT_NO _56 /end HEADER
/begin MODULE _default_ModuleName "_default_ModuleLongIdentifier"
/begin MOD_COMMON "_default_ModCommonComment" DEPOSIT ABSOLUTE BYTE_ORDER MSB_FIRST ALIGNMENT_BYTE 1 ALIGNMENT_WORD 2 ALIGNMENT_LONG 4 ALIGNMENT_FLOAT32_IEEE 4 ALIGNMENT_FLOAT64_IEEE 8 /end MOD_COMMON
/begin MEASUREMENT lv_im_bls "brake light switch" UBYTE _CNV_S_2_RANGE______0_CM 1 100. 0. 1. DISPLAY_IDENTIFIER LV_IM_BLS ECU_ADDRESS 0x3fe142 BIT_MASK 0x1 /end MEASUREMENT
/begin MEASUREMENT lv_im_st "starter" UBYTE _CNV_S_2_RANGE______0_CM 1 100. 0. 1. DISPLAY_IDENTIFIER LV_IM_ST ECU_ADDRESS 0x3fe13b BIT_MASK 0x1 /end MEASUREMENT
/begin MEASUREMENT lv_im_lock "????" UBYTE _CNV_S_2_RANGE______0_CM 1 100. 0. 1. DISPLAY_IDENTIFIER LV_IM_LOCK ECU_ADDRESS 0x3fe13c BIT_MASK 0x1 /end MEASUREMENT
/begin MEASUREMENT lv_im_cru_set_ac "cruise control set / accelerate" UBYTE _CNV_S_2_RANGE______0_CM 1 100. 0. 1. DISPLAY_IDENTIFIER LV_IM_CRU_SET_AC ECU_ADDRESS 0x3fe13d BIT_MASK 0x1 /end MEASUREMENT
/begin MEASUREMENT lv_im_cru_resu_dece "cruise control resume / decelerate" UBYTE _CNV_S_2_RANGE______0_CM 1 100. 0. 1. DISPLAY_IDENTIFIER LV_IM_CRU_RESU_DECE ECU_ADDRESS 0x3fe13e BIT_MASK 0x1 /end MEASUREMENT
/begin MEASUREMENT lv_im_cru_main_off "cruise control main switch / off" UBYTE _CNV_S_2_RANGE______0_CM 1 100. 0. 1. DISPLAY_IDENTIFIER LV_IM_CRU_MAIN_OFF ECU_ADDRESS 0x3fe13f BIT_MASK 0x1 /end MEASUREMENT
/begin MEASUREMENT lv_im_bts "brake test switch" UBYTE _CNV_S_2_RANGE______0_CM 1 100. 0. 1. DISPLAY_IDENTIFIER LV_IM_BTS ECU_ADDRESS 0x3fe141 BIT_MASK 0x1 /end MEASUREMENT
/begin MEASUREMENT lv_im_cs_pn "clutch switch" UBYTE _CNV_S_2_RANGE______0_CM 1 100. 0. 1. DISPLAY_IDENTIFIER LV_IM_CS_PN ECU_ADDRESS 0x3fe140 BIT_MASK 0x1 /end MEASUREMENT
/begin MEASUREMENT lv_err_rly_efp "Boolean for error currently present on RLY_EFP" UBYTE _CNV_S_2_RANGE______2_R_CM 1 100. 0. 255. DISPLAY_IDENTIFIER LV_ERR_RLY_EFP ECU_ADDRESS 0x3fb868 /end MEASUREMENT
/begin MEASUREMENT lv_ef "Logical value exhaust flap, 1 = closed flap" UBYTE _CNV_S_2_RANGE______5_CM 1 100. 0. 1. DISPLAY_IDENTIFIER LV_EF ECU_ADDRESS 0x3fe3ec BIT_MASK 0x1 /end MEASUREMENT
/begin CHARACTERISTIC id_nr_ip_gear_ef_at "Index of switching threshold map, AT vehicle" CURVE 0x03e62 _REC_CUR_20_u1_u1 4. _CNV_A_R_LINEAR_____1_CM 1. 5. DISPLAY_IDENTIFIER ID_NR_IP_GEAR_EF_AT FORMAT "%2.0"
 /begin AXIS_DESCR COM_AXIS gear_ef _CNV_A_R_LINEAR_____22_CM 13 0. 12. FORMAT "%3.0" AXIS_PTS_REF ldpm_gear_ef_1 /end AXIS_DESCR
/end CHARACTERISTIC
/begin CHARACTERISTIC id_nr_ip_gear_ef_mt "Index of switching threshold map, MT vehicle" CURVE 0x03e6f _REC_CUR_20_u1_u1 4. _CNV_A_R_LINEAR_____1_CM 1. 5. DISPLAY_IDENTIFIER ID_NR_IP_GEAR_EF_MT FORMAT "%2.0"
 /begin AXIS_DESCR COM_AXIS gear_ef _CNV_A_R_LINEAR_____22_CM 13 0. 12. FORMAT "%3.0" AXIS_PTS_REF ldpm_gear_ef_1 /end AXIS_DESCR
/end CHARACTERISTIC
/begin CHARACTERISTIC ip_pv_min_at_2_ef "Switching threshold of exhaust flap, AT vehicle, gear group 2" CURVE 0x00d75 _REC_CUR_20_u1_u1 99.609375 _CNV_A_R_LINEAR_____10_CM 0. 99.609375 DISPLAY_IDENTIFIER IP_PV_MIN_AT_2_EF FORMAT "%4.1"
 /begin AXIS_DESCR COM_AXIS n_32 _CNV_A_R_LINEAR_____16_CM 5 0. 8160. FORMAT "%4.0" AXIS_PTS_REF ldpm_n_32__ef /end AXIS_DESCR
/end CHARACTERISTIC
/begin CHARACTERISTIC ip_pv_min_at_3_ef "Switching threshold of exhaust flap, AT vehicle, gear group 3" CURVE 0x00d7a _REC_CUR_20_u1_u1 99.609375 _CNV_A_R_LINEAR_____10_CM 0. 99.609375 DISPLAY_IDENTIFIER IP_PV_MIN_AT_3_EF FORMAT "%4.1"
 /begin AXIS_DESCR COM_AXIS n_32 _CNV_A_R_LINEAR_____16_CM 5 0. 8160. FORMAT "%4.0" AXIS_PTS_REF ldpm_n_32__ef /end AXIS_DESCR
/end CHARACTERISTIC
/begin CHARACTERISTIC ip_pv_min_at_4_ef "Switching threshold of exhaust flap, AT vehicle, gear group 4" CURVE 0x00d7f _REC_CUR_20_u1_u1 99.609375 _CNV_A_R_LINEAR_____10_CM 0. 99.609375 DISPLAY_IDENTIFIER IP_PV_MIN_AT_4_EF FORMAT "%4.1"
 /begin AXIS_DESCR COM_AXIS n_32 _CNV_A_R_LINEAR_____16_CM 5 0. 8160. FORMAT "%4.0" AXIS_PTS_REF ldpm_n_32__ef /end AXIS_DESCR
/end CHARACTERISTIC
/begin CHARACTERISTIC ip_pv_min_at_5_ef "Switching threshold of exhaust flap, AT vehicle, gear group 5" CURVE 0x00d84 _REC_CUR_20_u1_u1 99.609375 _CNV_A_R_LINEAR_____10_CM 0. 99.609375 DISPLAY_IDENTIFIER IP_PV_MIN_AT_5_EF FORMAT "%4.1"
 /begin AXIS_DESCR COM_AXIS n_32 _CNV_A_R_LINEAR_____16_CM 5 0. 8160. FORMAT "%4.0" AXIS_PTS_REF ldpm_n_32__ef /end AXIS_DESCR
/end CHARACTERISTIC
/begin CHARACTERISTIC ip_pv_min_mt_1_ef "Switching threshold of exhaust flap, MT vehicle, gear group 1" CURVE 0x00d89 _REC_CUR_20_u1_u1 99.609375 _CNV_A_R_LINEAR_____10_CM 0. 99.609375 DISPLAY_IDENTIFIER IP_PV_MIN_MT_1_EF FORMAT "%4.1"
 /begin AXIS_DESCR COM_AXIS n_32 _CNV_A_R_LINEAR_____16_CM 5 0. 8160. FORMAT "%4.0" AXIS_PTS_REF ldpm_n_32__ef /end AXIS_DESCR
/end CHARACTERISTIC
/begin CHARACTERISTIC ip_pv_min_mt_2_ef "Switching threshold of exhaust flap, MT vehicle, gear group 2" CURVE 0x00d8e _REC_CUR_20_u1_u1 99.609375 _CNV_A_R_LINEAR_____10_CM 0. 99.609375 DISPLAY_IDENTIFIER IP_PV_MIN_MT_2_EF FORMAT "%4.1"
 /begin AXIS_DESCR COM_AXIS n_32 _CNV_A_R_LINEAR_____16_CM 5 0. 8160. FORMAT "%4.0" AXIS_PTS_REF ldpm_n_32__ef /end AXIS_DESCR
/end CHARACTERISTIC
/begin CHARACTERISTIC ip_pv_min_mt_3_ef "Switching threshold of exhaust flap, MT vehicle, gear group 3" CURVE 0x00d93 _REC_CUR_20_u1_u1 99.609375 _CNV_A_R_LINEAR_____10_CM 0. 99.609375 DISPLAY_IDENTIFIER IP_PV_MIN_MT_3_EF FORMAT "%4.1"
 /begin AXIS_DESCR COM_AXIS n_32 _CNV_A_R_LINEAR_____16_CM 5 0. 8160. FORMAT "%4.0" AXIS_PTS_REF ldpm_n_32__ef /end AXIS_DESCR
/end CHARACTERISTIC
/begin CHARACTERISTIC ip_pv_min_mt_4_ef "Switching threshold of exhaust flap, MT vehicle, gear group 4" CURVE 0x00d98 _REC_CUR_20_u1_u1 99.609375 _CNV_A_R_LINEAR_____10_CM 0. 99.609375 DISPLAY_IDENTIFIER IP_PV_MIN_MT_4_EF FORMAT "%4.1"
 /begin AXIS_DESCR COM_AXIS n_32 _CNV_A_R_LINEAR_____16_CM 5 0. 8160. FORMAT "%4.0" AXIS_PTS_REF ldpm_n_32__ef /end AXIS_DESCR
/end CHARACTERISTIC
/begin CHARACTERISTIC c_pv_hys_ef "Hysteresis for switching threshold" VALUE 0x007ae _REC_VAL_20_u1 99.609375 _CNV_A_R_LINEAR_____10_CM 0. 99.609375 DISPLAY_IDENTIFIER C_PV_HYS_EF FORMAT "%4.1" /end CHARACTERISTIC
/begin CHARACTERISTIC c_vs_min_ef_at "Speed threshold for continuously opened exhaust flap, automatically shifted transmission" VALUE 0x00957 _REC_VAL_20_u1 255. _CNV_A_R_LINEAR_____23_CM 0. 255. DISPLAY_IDENTIFIER C_VS_MIN_EF_AT FORMAT "%3.0" /end CHARACTERISTIC
/begin CHARACTERISTIC c_vs_min_ef_mt "Speed threshold for continuously opened exhaust flap, manually shifted transmission" VALUE 0x00958 _REC_VAL_20_u1 255. _CNV_A_R_LINEAR_____23_CM 0. 255. DISPLAY_IDENTIFIER C_VS_MIN_EF_MT FORMAT "%3.0" /end CHARACTERISTIC
/begin CHARACTERISTIC c_t_ef_ast "Cranking time for EF actuation active" VALUE 0x0080d _REC_VAL_20_u1 25.5 _CNV_A_R_LINEAR_____24_CM 0. 25.5 DISPLAY_IDENTIFIER C_T_EF_AST FORMAT "%4.1" /end CHARACTERISTIC
/begin CHARACTERISTIC c_state_vs_min_ef_at "Exhaust flap actuation in case of vs < C_VS_MIN_EF_AT for AT version" VALUE 0x007c0 _REC_VAL_20_u1 1. _CNV_A_R_LINEAR_____1_CM 0. 1. DISPLAY_IDENTIFIER C_STATE_VS_MIN_EF_AT FORMAT "%2.0" /end CHARACTERISTIC
/begin CHARACTERISTIC c_state_vs_min_ef_mt "Exhaust flap actuation in case of vs < C_VS_MIN_EF_MT for MT version" VALUE 0x007c1 _REC_VAL_20_u1 1. _CNV_A_R_LINEAR_____1_CM 0. 1. DISPLAY_IDENTIFIER C_STATE_VS_MIN_EF_MT FORMAT "%2.0" /end CHARACTERISTIC
/begin CHARACTERISTIC ip_pv_min_mt_5_ef "Switching threshold of exhaust flap, MT vehicle, gear group 5" CURVE 0x00d9d _REC_CUR_20_u1_u1 99.609375 _CNV_A_R_LINEAR_____10_CM 0. 99.609375 DISPLAY_IDENTIFIER IP_PV_MIN_MT_5_EF FORMAT "%4.1"
 /begin AXIS_DESCR COM_AXIS n_32 _CNV_A_R_LINEAR_____16_CM 5 0. 8160. FORMAT "%4.0" AXIS_PTS_REF ldpm_n_32__ef /end AXIS_DESCR
/end CHARACTERISTIC
/begin CHARACTERISTIC c_state_ch_ef "Exhaust flap actuation in case catalyst heating with increased idle speed" VALUE 0x007be _REC_VAL_20_u1 1. _CNV_A_R_LINEAR_____1_CM 0. 1. DISPLAY_IDENTIFIER C_STATE_CH_EF FORMAT "%2.0" /end CHARACTERISTIC
/begin CHARACTERISTIC ip_pv_min_at_1_ef "Switching threshold of exhaust flap, AT vehicle, gear group 1" CURVE 0x00d70 _REC_CUR_20_u1_u1 99.609375 _CNV_A_R_LINEAR_____10_CM 0. 99.609375 DISPLAY_IDENTIFIER IP_PV_MIN_AT_1_EF FORMAT "%4.1"
 /begin AXIS_DESCR COM_AXIS n_32 _CNV_A_R_LINEAR_____16_CM 5 0. 8160. FORMAT "%4.0" AXIS_PTS_REF ldpm_n_32__ef /end AXIS_DESCR
/end CHARACTERISTIC
/begin AXIS_PTS ldpm_gear_ef_1 "" 0x07f3e gear_ef _REC_AXS_20_u1 12. _CNV_A_R_LINEAR_____22_CM 13 0. 12. DISPLAY_IDENTIFIER LDPM_GEAR_EF_1 FORMAT "%3.0" /end AXIS_PTS
/begin AXIS_PTS ldpm_n_32__ef "" 0x01346 n_32 _REC_AXS_20_u1 8160. _CNV_A_R_LINEAR_____16_CM 5 0. 8160. DISPLAY_IDENTIFIER LDPM_N_32__EF FORMAT "%4.0" /end AXIS_PTS
/begin MEASUREMENT sofpwm "Sound flap" UBYTE _CNV_A_R_LINEAR_____10_CM 1 100. 0. 99.609375 DISPLAY_IDENTIFIER SOFPWM ECU_ADDRESS 0x3fe3ed FORMAT "%4.1" /end MEASUREMENT
/begin MEASUREMENT lv_sof_inh "Sound flap inhibitation" UBYTE _CNV_S_2_RANGE______5_CM 1 100. 0. 1. DISPLAY_IDENTIFIER LV_SOF_INH ECU_ADDRESS 0x3fe3f5 /end MEASUREMENT
/begin MEASUREMENT pv_av_sof_req "" UBYTE _CNV_A_R_LINEAR_____10_CM 1 100. 0. 99.609375 DISPLAY_IDENTIFIER PV_AV_SOF_REQ ECU_ADDRESS 0x3fe3ee FORMAT "%4.1" /end MEASUREMENT
/begin MEASUREMENT n_sof_req "" UWORD _CNV_A_R_LINEAR_____11_CM 1 100. 0. 8160. DISPLAY_IDENTIFIER N_SOF_REQ ECU_ADDRESS 0x3fd606 BYTE_ORDER MSB_LAST FORMAT "%4.0" /end MEASUREMENT
/begin MEASUREMENT lv_sof_act "Logical value sound flap (1 = activated)" UBYTE _CNV_S_2_RANGE______5_CM 1 100. 0. 1. DISPLAY_IDENTIFIER LV_SOF_ACT ECU_ADDRESS 0x3fe3f6 /end MEASUREMENT
/begin MEASUREMENT lv_sof_req "Request activ/inactiv (0 = inactiv, 1 = activ)" UBYTE _CNV_S_2_RANGE______5_CM 1 100. 0. 1. DISPLAY_IDENTIFIER LV_SOF_REQ ECU_ADDRESS 0x3fe3f7 /end MEASUREMENT
/begin MEASUREMENT t_sof_act "Timer for Sound-flap activ" UWORD _CNV_A_R_LINEAR_____4_CM 1 100. 0. 655.35 DISPLAY_IDENTIFIER T_SOF_ACT ECU_ADDRESS 0x3fd608 BYTE_ORDER MSB_LAST FORMAT "%6.2" /end MEASUREMENT
/begin MEASUREMENT sofpwm_sof "PWM for Sound-flap" UBYTE _CNV_A_R_LINEAR_____10_CM 1 100. 0. 99.609375 DISPLAY_IDENTIFIER SOFPWM_SOF ECU_ADDRESS 0x3fe3ef FORMAT "%4.1" /end MEASUREMENT
/begin MEASUREMENT sofpwm_cor "PWM for Sound-flap, correction" UBYTE _CNV_A_R_LINEAR_____10_CM 1 100. 0. 99.609375 DISPLAY_IDENTIFIER SOFPWM_COR ECU_ADDRESS 0x3fe3f0 FORMAT "%4.1" /end MEASUREMENT
/begin CHARACTERISTIC c_v_sof_swi_on_bol "Voltage-Treshold bottom limit for sport mode ON" VALUE 0x019b2 _REC_VAL_20_u2 4.99511719 _CNV_A_R_LINEAR_____3_CM 0. 4.99511719 DISPLAY_IDENTIFIER C_V_SOF_SWI_ON_BOL FORMAT "%5.3" /end CHARACTERISTIC
/begin CHARACTERISTIC c_pv_av_sof_hys "pedal value hysteresis SOF" VALUE 0x007ab _REC_VAL_20_u1 99.609375 _CNV_A_R_LINEAR_____10_CM 0. 99.609375 DISPLAY_IDENTIFIER C_PV_AV_SOF_HYS FORMAT "%4.1" /end CHARACTERISTIC
/begin CHARACTERISTIC c_n_sof_hys "n hysteresis SOF" VALUE 0x01712 _REC_VAL_20_u2 8160. _CNV_A_R_LINEAR_____11_CM 0. 8160. DISPLAY_IDENTIFIER C_N_SOF_HYS FORMAT "%4.0" /end CHARACTERISTIC
/begin CHARACTERISTIC c_vs_sof_max "vs treshold for SOF activation" VALUE 0x0095f _REC_VAL_20_u1 255. _CNV_A_R_LINEAR_____23_CM 0. 255. DISPLAY_IDENTIFIER C_VS_SOF_MAX FORMAT "%3.0" /end CHARACTERISTIC
/begin CHARACTERISTIC c_t_ast_sof "time after start for SOF" VALUE 0x017bc _REC_VAL_20_u2 6553.5 _CNV_A_R_LINEAR_____24_CM 0. 6553.5 DISPLAY_IDENTIFIER C_T_AST_SOF FORMAT "%6.1" /end CHARACTERISTIC
/begin CHARACTERISTIC c_tia_sof_min "TIA treshold for SOF activation" VALUE 0x008d7 _REC_VAL_20_u1 190.5 _CNV_A_R_LINEAR_____12_CM -48. 142.5 DISPLAY_IDENTIFIER C_TIA_SOF_MIN FORMAT "%5.1" /end CHARACTERISTIC
/begin CHARACTERISTIC c_sofpwm_min "min pwm for SOF control" VALUE 0x007bb _REC_VAL_20_u1 99.609375 _CNV_A_R_LINEAR_____10_CM 0. 99.609375 DISPLAY_IDENTIFIER C_SOFPWM_MIN FORMAT "%4.1" /end CHARACTERISTIC
/begin CHARACTERISTIC c_t_sof_act_max "Timer for sound flap activation, max value" VALUE 0x018a2 _REC_VAL_20_u2 655.35 _CNV_A_R_LINEAR_____4_CM 0. 655.35 DISPLAY_IDENTIFIER C_T_SOF_ACT_MAX FORMAT "%6.2" /end CHARACTERISTIC
/begin CHARACTERISTIC id_sof_req_gear_0 "Request SOF in dependency of N and PV_AV_SOF_REQ (x = 0..6)" MAP 0x03f15 _REC_MAP_20_u1_u1_u2 1. _CNV_A_R_LINEAR_____1_CM 0. 1. DISPLAY_IDENTIFIER ID_SOF_REQ_GEAR_0 FORMAT "%2.0"
 /begin AXIS_DESCR COM_AXIS pv_av_sof_req _CNV_A_R_LINEAR_____10_CM 4 0. 99.609375 FORMAT "%4.1" AXIS_PTS_REF ldp_pv_av_sof_req_0 /end AXIS_DESCR
 /begin AXIS_DESCR COM_AXIS n_sof_req _CNV_A_R_LINEAR_____11_CM 6 0. 8160. FORMAT "%4.0" AXIS_PTS_REF ldp_n_sof_req_0 /end AXIS_DESCR
/end CHARACTERISTIC
/begin CHARACTERISTIC id_sof_req_gear_1 "Request SOF in dependency of N and PV_AV_SOF_REQ (x = 0..6)" MAP 0x03f2d _REC_MAP_20_u1_u1_u2 1. _CNV_A_R_LINEAR_____1_CM 0. 1. DISPLAY_IDENTIFIER ID_SOF_REQ_GEAR_1 FORMAT "%2.0"
 /begin AXIS_DESCR COM_AXIS pv_av_sof_req _CNV_A_R_LINEAR_____10_CM 4 0. 99.609375 FORMAT "%4.1" AXIS_PTS_REF ldp_pv_av_sof_req_1 /end AXIS_DESCR
 /begin AXIS_DESCR COM_AXIS n_sof_req _CNV_A_R_LINEAR_____11_CM 6 0. 8160. FORMAT "%4.0" AXIS_PTS_REF ldp_n_sof_req_1 /end AXIS_DESCR
/end CHARACTERISTIC
/begin CHARACTERISTIC id_sof_req_gear_2 "Request SOF in dependency of N and PV_AV_SOF_REQ (x = 0..6)" MAP 0x03f45 _REC_MAP_20_u1_u1_u2 1. _CNV_A_R_LINEAR_____1_CM 0. 1. DISPLAY_IDENTIFIER ID_SOF_REQ_GEAR_2 FORMAT "%2.0"
 /begin AXIS_DESCR COM_AXIS pv_av_sof_req _CNV_A_R_LINEAR_____10_CM 4 0. 99.609375 FORMAT "%4.1" AXIS_PTS_REF ldp_pv_av_sof_req_2 /end AXIS_DESCR
 /begin AXIS_DESCR COM_AXIS n_sof_req _CNV_A_R_LINEAR_____11_CM 6 0. 8160. FORMAT "%4.0" AXIS_PTS_REF ldp_n_sof_req_2 /end AXIS_DESCR
/end CHARACTERISTIC
/begin CHARACTERISTIC id_sof_req_gear_3 "Request SOF in dependency of N and PV_AV_SOF_REQ (x = 0..6)" MAP 0x03f5d _REC_MAP_20_u1_u1_u2 1. _CNV_A_R_LINEAR_____1_CM 0. 1. DISPLAY_IDENTIFIER ID_SOF_REQ_GEAR_3 FORMAT "%2.0"
 /begin AXIS_DESCR COM_AXIS pv_av_sof_req _CNV_A_R_LINEAR_____10_CM 4 0. 99.609375 FORMAT "%4.1" AXIS_PTS_REF ldp_pv_av_sof_req_3 /end AXIS_DESCR
 /begin AXIS_DESCR COM_AXIS n_sof_req _CNV_A_R_LINEAR_____11_CM 6 0. 8160. FORMAT "%4.0" AXIS_PTS_REF ldp_n_sof_req_3 /end AXIS_DESCR
/end CHARACTERISTIC
/begin CHARACTERISTIC id_sof_req_gear_4 "Request SOF in dependency of N and PV_AV_SOF_REQ (x = 0..6)" MAP 0x03f75 _REC_MAP_20_u1_u1_u2 1. _CNV_A_R_LINEAR_____1_CM 0. 1. DISPLAY_IDENTIFIER ID_SOF_REQ_GEAR_4 FORMAT "%2.0"
 /begin AXIS_DESCR COM_AXIS pv_av_sof_req _CNV_A_R_LINEAR_____10_CM 4 0. 99.609375 FORMAT "%4.1" AXIS_PTS_REF ldp_pv_av_sof_req_4 /end AXIS_DESCR
 /begin AXIS_DESCR COM_AXIS n_sof_req _CNV_A_R_LINEAR_____11_CM 6 0. 8160. FORMAT "%4.0" AXIS_PTS_REF ldp_n_sof_req_4 /end AXIS_DESCR
/end CHARACTERISTIC
/begin CHARACTERISTIC id_sof_req_gear_5 "Request SOF in dependency of N and PV_AV_SOF_REQ (x = 0..6)" MAP 0x03f8d _REC_MAP_20_u1_u1_u2 1. _CNV_A_R_LINEAR_____1_CM 0. 1. DISPLAY_IDENTIFIER ID_SOF_REQ_GEAR_5 FORMAT "%2.0"
 /begin AXIS_DESCR COM_AXIS pv_av_sof_req _CNV_A_R_LINEAR_____10_CM 4 0. 99.609375 FORMAT "%4.1" AXIS_PTS_REF ldp_pv_av_sof_req_5 /end AXIS_DESCR
 /begin AXIS_DESCR COM_AXIS n_sof_req _CNV_A_R_LINEAR_____11_CM 6 0. 8160. FORMAT "%4.0" AXIS_PTS_REF ldp_n_sof_req_5 /end AXIS_DESCR
/end CHARACTERISTIC
/begin CHARACTERISTIC id_sof_req_gear_6 "Request SOF in dependency of N and PV_AV_SOF_REQ (x = 0..6)" MAP 0x03fa5 _REC_MAP_20_u1_u1_u2 1. _CNV_A_R_LINEAR_____1_CM 0. 1. DISPLAY_IDENTIFIER ID_SOF_REQ_GEAR_6 FORMAT "%2.0"
 /begin AXIS_DESCR COM_AXIS pv_av_sof_req _CNV_A_R_LINEAR_____10_CM 4 0. 99.609375 FORMAT "%4.1" AXIS_PTS_REF ldp_pv_av_sof_req_6 /end AXIS_DESCR
 /begin AXIS_DESCR COM_AXIS n_sof_req _CNV_A_R_LINEAR_____11_CM 6 0. 8160. FORMAT "%4.0" AXIS_PTS_REF ldp_n_sof_req_6 /end AXIS_DESCR
/end CHARACTERISTIC
/begin CHARACTERISTIC ip_fac_sofpwm_on "FAC-PWM Soundflap ON" CURVE 0x05319 _REC_CUR_20_u1_u2 0.99610001 _CNV_A_R_LINEAR_____29_CM 0. 0.99610001 DISPLAY_IDENTIFIER IP_FAC_SOFPWM_ON FORMAT "%5.3"
 /begin AXIS_DESCR COM_AXIS t_sof_act _CNV_A_R_LINEAR_____4_CM 15 0. 655.35 FORMAT "%6.2" AXIS_PTS_REF ldpm_t_sof_act /end AXIS_DESCR
/end CHARACTERISTIC
/begin CHARACTERISTIC ip_fac_sofpwm_off "FAC-PWM Soundflap OFF" CURVE 0x0530a _REC_CUR_20_u1_u2 0.99610001 _CNV_A_R_LINEAR_____29_CM 0. 0.99610001 DISPLAY_IDENTIFIER IP_FAC_SOFPWM_OFF FORMAT "%5.3"
 /begin AXIS_DESCR COM_AXIS t_sof_act _CNV_A_R_LINEAR_____4_CM 15 0. 655.35 FORMAT "%6.2" AXIS_PTS_REF ldpm_t_sof_act /end AXIS_DESCR
/end CHARACTERISTIC
/begin CHARACTERISTIC ip_fac_sofpwm_vb "correction of SOFPWM concerning Ubatt" CURVE 0x00b6c _REC_CUR_20_u1_u1 1.99220002 _CNV_A_R_LINEAR_____39_CM 0. 1.99220002 DISPLAY_IDENTIFIER IP_FAC_SOFPWM_VB FORMAT "%5.3"
 /begin AXIS_DESCR COM_AXIS vb _CNV_A_R_LINEAR_____34_CM 8 0. 25.8984 FORMAT "%3.1" AXIS_PTS_REF ldp_vb_sof /end AXIS_DESCR
/end CHARACTERISTIC
/begin CHARACTERISTIC ip_fac_sofpwm_tia "correction of SOFPWM concerning TIA" CURVE 0x00b64 _REC_CUR_20_u1_u1 1.99220002 _CNV_A_R_LINEAR_____39_CM 0. 1.99220002 DISPLAY_IDENTIFIER IP_FAC_SOFPWM_TIA FORMAT "%5.3"
 /begin AXIS_DESCR COM_AXIS tia _CNV_A_R_LINEAR_____12_CM 8 -48. 142.5 FORMAT "%5.1" AXIS_PTS_REF ldp_tia_sof /end AXIS_DESCR
/end CHARACTERISTIC
/begin CHARACTERISTIC c_vs_sof_max_hys "VS treshold, hysteresis" VALUE 0x00960 _REC_VAL_20_u1 255. _CNV_A_R_LINEAR_____23_CM 0. 255. DISPLAY_IDENTIFIER C_VS_SOF_MAX_HYS FORMAT "%3.0" /end CHARACTERISTIC
/begin CHARACTERISTIC lc_sof_act_kwp "Flag for TIA and VB correction of sound-flap PWM" VALUE 0x00f6e _REC_VAL_20_u1 1. _CNV_A_R_LINEAR_____1_CM 0. 1. DISPLAY_IDENTIFIER LC_SOF_ACT_KWP FORMAT "%2.0" /end CHARACTERISTIC
/begin CHARACTERISTIC c_sofpwm_max "max. pwm for SOF control" VALUE 0x007ba _REC_VAL_20_u1 99.609375 _CNV_A_R_LINEAR_____10_CM 0. 99.609375 DISPLAY_IDENTIFIER C_SOFPWM_MAX FORMAT "%4.1" /end CHARACTERISTIC
/begin MEASUREMENT lv_sof_swi_req "Sport Mode required by switch" UBYTE _CNV_S_2_RANGE______5_CM 1 100. 0. 1. DISPLAY_IDENTIFIER LV_SOF_SWI_REQ ECU_ADDRESS 0x3fe3f1 /end MEASUREMENT
/begin AXIS_PTS ldp_vb_sof "" 0x07edb vb _REC_AXS_20_u1 25.8984 _CNV_A_R_LINEAR_____34_CM 8 0. 25.8984 DISPLAY_IDENTIFIER LDP_VB_SOF FORMAT "%3.1" /end AXIS_PTS
/begin AXIS_PTS ldp_tia_sof "" 0x07e54 tia _REC_AXS_20_u1 190.5 _CNV_A_R_LINEAR_____12_CM 8 -48. 142.5 DISPLAY_IDENTIFIER LDP_TIA_SOF FORMAT "%5.1" /end AXIS_PTS
/begin AXIS_PTS ldpm_t_sof_act "" 0x11b36 t_sof_act _REC_AXS_20_u2 655.35 _CNV_A_R_LINEAR_____4_CM 15 0. 655.35 DISPLAY_IDENTIFIER LDPM_T_SOF_ACT FORMAT "%6.2" /end AXIS_PTS
/begin AXIS_PTS ldp_pv_av_sof_req_1 "" 0x01103 pv_av_sof_req _REC_AXS_20_u1 99.609375 _CNV_A_R_LINEAR_____10_CM 4 0. 99.609375 DISPLAY_IDENTIFIER LDP_PV_AV_SOF_REQ_1 FORMAT "%4.1" /end AXIS_PTS
/begin AXIS_PTS ldp_pv_av_sof_req_2 "" 0x01108 pv_av_sof_req _REC_AXS_20_u1 99.609375 _CNV_A_R_LINEAR_____10_CM 4 0. 99.609375 DISPLAY_IDENTIFIER LDP_PV_AV_SOF_REQ_2 FORMAT "%4.1" /end AXIS_PTS
/begin AXIS_PTS ldp_pv_av_sof_req_3 "" 0x0110d pv_av_sof_req _REC_AXS_20_u1 99.609375 _CNV_A_R_LINEAR_____10_CM 4 0. 99.609375 DISPLAY_IDENTIFIER LDP_PV_AV_SOF_REQ_3 FORMAT "%4.1" /end AXIS_PTS
/begin AXIS_PTS ldp_pv_av_sof_req_4 "" 0x01112 pv_av_sof_req _REC_AXS_20_u1 99.609375 _CNV_A_R_LINEAR_____10_CM 4 0. 99.609375 DISPLAY_IDENTIFIER LDP_PV_AV_SOF_REQ_4 FORMAT "%4.1" /end AXIS_PTS
/begin AXIS_PTS ldp_pv_av_sof_req_5 "" 0x01117 pv_av_sof_req _REC_AXS_20_u1 99.609375 _CNV_A_R_LINEAR_____10_CM 4 0. 99.609375 DISPLAY_IDENTIFIER LDP_PV_AV_SOF_REQ_5 FORMAT "%4.1" /end AXIS_PTS
/begin AXIS_PTS ldp_pv_av_sof_req_0 "" 0x010fe pv_av_sof_req _REC_AXS_20_u1 99.609375 _CNV_A_R_LINEAR_____10_CM 4 0. 99.609375 DISPLAY_IDENTIFIER LDP_PV_AV_SOF_REQ_0 FORMAT "%4.1" /end AXIS_PTS
/begin AXIS_PTS ldp_pv_av_sof_req_6 "" 0x0111c pv_av_sof_req _REC_AXS_20_u1 99.609375 _CNV_A_R_LINEAR_____10_CM 4 0. 99.609375 DISPLAY_IDENTIFIER LDP_PV_AV_SOF_REQ_6 FORMAT "%4.1" /end AXIS_PTS
/begin AXIS_PTS ldp_n_sof_req_1 "" 0x10fb2 n_sof_req _REC_AXS_20_u2 8160. _CNV_A_R_LINEAR_____11_CM 6 0. 8160. DISPLAY_IDENTIFIER LDP_N_SOF_REQ_1 FORMAT "%4.0" /end AXIS_PTS
/begin AXIS_PTS ldp_n_sof_req_2 "" 0x10fc0 n_sof_req _REC_AXS_20_u2 8160. _CNV_A_R_LINEAR_____11_CM 6 0. 8160. DISPLAY_IDENTIFIER LDP_N_SOF_REQ_2 FORMAT "%4.0" /end AXIS_PTS
/begin AXIS_PTS ldp_n_sof_req_3 "" 0x10fce n_sof_req _REC_AXS_20_u2 8160. _CNV_A_R_LINEAR_____11_CM 6 0. 8160. DISPLAY_IDENTIFIER LDP_N_SOF_REQ_3 FORMAT "%4.0" /end AXIS_PTS
/begin AXIS_PTS ldp_n_sof_req_4 "" 0x10fdc n_sof_req _REC_AXS_20_u2 8160. _CNV_A_R_LINEAR_____11_CM 6 0. 8160. DISPLAY_IDENTIFIER LDP_N_SOF_REQ_4 FORMAT "%4.0" /end AXIS_PTS
/begin AXIS_PTS ldp_n_sof_req_5 "" 0x10fea n_sof_req _REC_AXS_20_u2 8160. _CNV_A_R_LINEAR_____11_CM 6 0. 8160. DISPLAY_IDENTIFIER LDP_N_SOF_REQ_5 FORMAT "%4.0" /end AXIS_PTS
/begin AXIS_PTS ldp_n_sof_req_0 "" 0x10fa4 n_sof_req _REC_AXS_20_u2 8160. _CNV_A_R_LINEAR_____11_CM 6 0. 8160. DISPLAY_IDENTIFIER LDP_N_SOF_REQ_0 FORMAT "%4.0" /end AXIS_PTS
/begin AXIS_PTS ldp_n_sof_req_6 "" 0x10ff8 n_sof_req _REC_AXS_20_u2 8160. _CNV_A_R_LINEAR_____11_CM 6 0. 8160. DISPLAY_IDENTIFIER LDP_N_SOF_REQ_6 FORMAT "%4.0" /end AXIS_PTS
/begin MEASUREMENT lv_sof_swi "Sport Mode switch acting" UBYTE _CNV_S_2_RANGE______5_CM 1 100. 0. 1. DISPLAY_IDENTIFIER LV_SOF_SWI ECU_ADDRESS 0x3fe3f2 /end MEASUREMENT
/begin MEASUREMENT lv_sof_swi_amt "Sport-mode switch AMT acting" UBYTE _CNV_S_2_RANGE______5_CM 1 100. 0. 1. DISPLAY_IDENTIFIER LV_SOF_SWI_AMT ECU_ADDRESS 0x3fe3f3 /end MEASUREMENT
/begin MEASUREMENT lv_sof_swi_amt_req "Sport-mode AMT required by switch" UBYTE _CNV_S_2_RANGE______5_CM 1 100. 0. 1. DISPLAY_IDENTIFIER LV_SOF_SWI_AMT_REQ ECU_ADDRESS 0x3fe3f4 /end MEASUREMENT
/begin CHARACTERISTIC c_v_sof_swi_on_tol "Voltage-Treshold top limit for sport mode ON (AMT)" VALUE 0x019b4 _REC_VAL_20_u2 4.99511719 _CNV_A_R_LINEAR_____3_CM 0. 4.99511719 DISPLAY_IDENTIFIER C_V_SOF_SWI_ON_TOL FORMAT "%5.3" /end CHARACTERISTIC
/begin CHARACTERISTIC c_v_sof_swi_amt_on_tol "Voltage-Treshold top limit for sport mode ON" VALUE 0x019ac _REC_VAL_20_u2 4.99511719 _CNV_A_R_LINEAR_____3_CM 0. 4.99511719 DISPLAY_IDENTIFIER C_V_SOF_SWI_AMT_ON_TOL FORMAT "%5.3" /end CHARACTERISTIC
/begin CHARACTERISTIC lc_var_sof_swi "Calibration switch (1 on / 0 off)" VALUE 0x00f9e _REC_VAL_20_u1 1. _CNV_A_R_LINEAR_____1_CM 0. 1. DISPLAY_IDENTIFIER LC_VAR_SOF_SWI FORMAT "%2.0" /end CHARACTERISTIC
/begin CHARACTERISTIC lc_var_sof_swi_amt "Calibration switch (1 on / 0 off)" VALUE 0x00f9f _REC_VAL_20_u1 1. _CNV_A_R_LINEAR_____1_CM 0. 1. DISPLAY_IDENTIFIER LC_VAR_SOF_SWI_AMT FORMAT "%2.0" /end CHARACTERISTIC
/begin CHARACTERISTIC lc_conf_city_ena "Enable condition regarding lv_city (1 on / 0 off)" VALUE 0x00f0b _REC_VAL_20_u1 1. _CNV_A_R_LINEAR_____1_CM 0. 1. DISPLAY_IDENTIFIER LC_CONF_CITY_ENA FORMAT "%2.0" /end CHARACTERISTIC
/begin MEASUREMENT v_amp "Ambient pressure sensor raw acquisition" UWORD _CNV_A_R_LINEAR_____3_CM 1 100. 0. 4.99511719 DISPLAY_IDENTIFIER V_AMP ECU_ADDRESS 0x3fd304 BYTE_ORDER MSB_LAST FORMAT "%5.3" /end MEASUREMENT
/begin MEASUREMENT v_tia "Intake air temperature sensor raw acquisition." UBYTE _CNV_A_R_LINEAR_____42_CM 1 100. 0. 4.998 DISPLAY_IDENTIFIER V_TIA ECU_ADDRESS 0x3fe136 FORMAT "%5.3" /end MEASUREMENT
/begin MEASUREMENT v_pvs_1 "Pedal value sensor 1 raw acquisition" UWORD _CNV_A_R_LINEAR_____3_CM 1 100. 0. 4.99511719 DISPLAY_IDENTIFIER V_PVS_1 ECU_ADDRESS 0x3fd30a BYTE_ORDER MSB_LAST FORMAT "%5.3" /end MEASUREMENT
/begin MEASUREMENT v_pvs_2 "Pedal value sensor 2 raw acquisition" UWORD _CNV_A_R_LINEAR_____3_CM 1 100. 0. 4.99511719 DISPLAY_IDENTIFIER V_PVS_2 ECU_ADDRESS 0x3fd30c BYTE_ORDER MSB_LAST FORMAT "%5.3" /end MEASUREMENT
/begin MEASUREMENT v_tco "Coolant temperature sensor raw acquisition." UWORD _CNV_A_R_LINEAR_____3_CM 1 100. 0. 4.99511719 DISPLAY_IDENTIFIER V_TCO ECU_ADDRESS 0x3fd31c BYTE_ORDER MSB_LAST FORMAT "%5.3" /end MEASUREMENT
/begin MEASUREMENT v_tco_ex "coolant temperature at cooler outlet" UWORD _CNV_A_R_LINEAR_____3_CM 1 100. 0. 4.99511719 DISPLAY_IDENTIFIER V_TCO_EX ECU_ADDRESS 0x3fd31a BYTE_ORDER MSB_LAST FORMAT "%5.3" /end MEASUREMENT
/begin MEASUREMENT v_tps_1 "Throttle position sensor 1 raw acquisition." UWORD _CNV_A_R_LINEAR_____3_CM 1 100. 0. 4.99511719 DISPLAY_IDENTIFIER V_TPS_1 ECU_ADDRESS 0x3fd314 BYTE_ORDER MSB_LAST FORMAT "%5.3" /end MEASUREMENT
/begin MEASUREMENT v_tps_2 "Throttle position sensor 2 raw acquisition." UWORD _CNV_A_R_LINEAR_____3_CM 1 100. 0. 4.99511719 DISPLAY_IDENTIFIER V_TPS_2 ECU_ADDRESS 0x3fd316 BYTE_ORDER MSB_LAST FORMAT "%5.3" /end MEASUREMENT
/begin MEASUREMENT v_ls_up_1 "Upstream oxygen sensor voltage raw acquisition - Bank n° 1" UWORD _CNV_A_R_LINEAR_____3_CM 1 100. 0. 4.99511719 DISPLAY_IDENTIFIER V_LS_UP_1 ECU_ADDRESS 0x3fd300 BYTE_ORDER MSB_LAST FORMAT "%5.3" /end MEASUREMENT
/begin MEASUREMENT v_ls_up_2 "Upstream oxygen sensor voltage raw acquisition - Bank n° 2" UWORD _CNV_A_R_LINEAR_____3_CM 1 100. 0. 4.99511719 DISPLAY_IDENTIFIER V_LS_UP_2 ECU_ADDRESS 0x3fd302 BYTE_ORDER MSB_LAST FORMAT "%5.3" /end MEASUREMENT
/begin MEASUREMENT v_ls_down_2 "Downstream oxygen sensor voltage raw acquisition - Bank n° 2" UWORD _CNV_A_R_LINEAR_____3_CM 1 100. 0. 4.99511719 DISPLAY_IDENTIFIER V_LS_DOWN_2 ECU_ADDRESS 0x3fd308 BYTE_ORDER MSB_LAST FORMAT "%5.3" /end MEASUREMENT
/begin MEASUREMENT v_ls_down_1 "Downstream oxygen sensor voltage raw acquisition - Bank n° 1" UWORD _CNV_A_R_LINEAR_____3_CM 1 100. 0. 4.99511719 DISPLAY_IDENTIFIER V_LS_DOWN_1 ECU_ADDRESS 0x3fd306 BYTE_ORDER MSB_LAST FORMAT "%5.3" /end MEASUREMENT
/begin MEASUREMENT vcc_pvs_1 "Voltage supply for pedal value sensor 1 (and TPS) raw acquisition" UWORD _CNV_A_R_LINEAR_____43_CM 1 100. 0. 9.9902 DISPLAY_IDENTIFIER VCC_PVS_1 ECU_ADDRESS 0x3fd30e BYTE_ORDER MSB_LAST FORMAT "%5.3" /end MEASUREMENT
/begin MEASUREMENT vcc_pvs_2 "Voltage supply for pedal value sensor 2 raw acquisition" UWORD _CNV_A_R_LINEAR_____43_CM 1 100. 0. 9.9902 DISPLAY_IDENTIFIER VCC_PVS_2 ECU_ADDRESS 0x3fd310 BYTE_ORDER MSB_LAST FORMAT "%5.3" /end MEASUREMENT
/begin MEASUREMENT v_vim_fb "Variable intake manifold feedback sensor raw acquisition." UWORD _CNV_A_R_LINEAR_____3_CM 1 100. 0. 4.99511719 DISPLAY_IDENTIFIER V_VIM_FB ECU_ADDRESS 0x3fd322 BYTE_ORDER MSB_LAST FORMAT "%5.3" /end MEASUREMENT
/begin MEASUREMENT v_teg_pcat_down_1 "Catalyst temperature sensor raw acquisition - cylinder bank 1" UWORD _CNV_A_R_LINEAR_____3_CM 1 100. 0. 4.99511719 DISPLAY_IDENTIFIER V_TEG_PCAT_DOWN_1 ECU_ADDRESS 0x3fd31e BYTE_ORDER MSB_LAST FORMAT "%5.3" /end MEASUREMENT
/begin MEASUREMENT v_teg_pcat_down_2 "Catalyst temperature sensor raw acquisition - cylinder bank 2" UWORD _CNV_A_R_LINEAR_____3_CM 1 100. 0. 4.99511719 DISPLAY_IDENTIFIER V_TEG_PCAT_DOWN_2 ECU_ADDRESS 0x3fd320 BYTE_ORDER MSB_LAST FORMAT "%5.3" /end MEASUREMENT
/begin MEASUREMENT v_tecu "ECU temperature sensor raw acquisition" UWORD _CNV_A_R_LINEAR_____3_CM 1 100. 0. 4.99511719 DISPLAY_IDENTIFIER V_TECU ECU_ADDRESS 0x3fd328 BYTE_ORDER MSB_LAST FORMAT "%5.3" /end MEASUREMENT
/begin MEASUREMENT v_fps "Fuel pressure sensor raw acquisition" UWORD _CNV_A_R_LINEAR_____3_CM 1 100. 0. 4.99511719 DISPLAY_IDENTIFIER V_FPS ECU_ADDRESS 0x3fd324 BYTE_ORDER MSB_LAST FORMAT "%5.3" /end MEASUREMENT
/begin MEASUREMENT v_saf "" UBYTE _CNV_A_R_LINEAR_____44_CM 1 100. 0. 4.998 DISPLAY_IDENTIFIER V_SAF ECU_ADDRESS 0x3fb325 FORMAT "%6.4" /end MEASUREMENT
/begin MEASUREMENT maf_ctr_1 "accumulated mass air flow measurements for segment number (2n-1), n = 1,2,3,..." UWORD _CNV_A_R_LINEAR_____1_CM 1 100. 0. 65535. DISPLAY_IDENTIFIER MAF_CTR_1 ECU_ADDRESS 0x3fb31a BYTE_ORDER MSB_LAST FORMAT "%5.0" /end MEASUREMENT
/begin MEASUREMENT maf_sum_1 "accumulated mass air flow measurements for segment number (2n-1), n = 1,2,3,..." ULONG _CNV_A_R_LINEAR_____45_CM 1 100. 0. 67108863.98 DISPLAY_IDENTIFIER MAF_SUM_1 ECU_ADDRESS 0x3fb30c BYTE_ORDER MSB_LAST FORMAT "%11.2" /end MEASUREMENT
/begin MEASUREMENT maf_sum "accumulated mass air flow measurements for segment number (2n), n = 1,2,3,..." ULONG _CNV_A_R_LINEAR_____45_CM 1 100. 0. 67108863.98 DISPLAY_IDENTIFIER MAF_SUM ECU_ADDRESS 0x3fb308 BYTE_ORDER MSB_LAST FORMAT "%11.2" /end MEASUREMENT
/begin MEASUREMENT v_maf "Mass air flow sensor raw acquisition" UBYTE _CNV_A_R_LINEAR_____44_CM 1 100. 0. 4.998 DISPLAY_IDENTIFIER V_MAF ECU_ADDRESS 0x3fb324 FORMAT "%6.4" /end MEASUREMENT
/begin MEASUREMENT vb_bas "Battery voltage after relay raw acquisition" UWORD _CNV_A_R_LINEAR_____3_CM 1 100. 0. 4.99511719 DISPLAY_IDENTIFIER VB_BAS ECU_ADDRESS 0x3fb31e BYTE_ORDER MSB_LAST FORMAT "%5.3" /end MEASUREMENT
/begin MEASUREMENT maf_ctr "accumulated mass air flow measurements for segment number (2n), n = 1,2,3,..." UWORD _CNV_A_R_LINEAR_____1_CM 1 100. 0. 65535. DISPLAY_IDENTIFIER MAF_CTR ECU_ADDRESS 0x3fb318 BYTE_ORDER MSB_LAST FORMAT "%5.0" /end MEASUREMENT
/begin MEASUREMENT lv_maf_seg "indicates if segment number is even or odd in order to choose MAF_SUM / MAF_CTR or MAF_SUM_1 / MAF_CTR_1" UBYTE _CNV_S_2_RANGE______0_CM 1 100. 0. 1. DISPLAY_IDENTIFIER LV_MAF_SEG ECU_ADDRESS 0x3fb328 BIT_MASK 0x1 /end MEASUREMENT
/begin CHARACTERISTIC c_cam_sync_dly "" VALUE 0x00603 _REC_VAL_20_u1 2. _CNV_A_R_LINEAR_____1_CM 0. 2. DISPLAY_IDENTIFIER C_CAM_SYNC_DLY FORMAT "%2.0" /end CHARACTERISTIC
/begin CHARACTERISTIC c_n_min_crk_tooth_vld "" VALUE 0x0170a _REC_VAL_20_u2 8160. _CNV_A_R_LINEAR_____11_CM 0. 8160. DISPLAY_IDENTIFIER C_N_MIN_CRK_TOOTH_VLD FORMAT "%4.0" /end CHARACTERISTIC
/begin CHARACTERISTIC id_crk_gap_ratio__n "" CURVE 0x00964 _REC_CUR_20_u1_u2 0.9375 _CNV_A_R_LINEAR_____46_CM 0. 0.9375 DISPLAY_IDENTIFIER ID_CRK_GAP_RATIO FORMAT "%6.4"
 /begin AXIS_DESCR COM_AXIS n _CNV_A_R_LINEAR_____11_CM 6 0. 8160. FORMAT "%4.0" AXIS_PTS_REF ldpm_n_id_crk_acq /end AXIS_DESCR
/end CHARACTERISTIC
/begin CHARACTERISTIC id_cam_tooth_per_sp_fac__n "" CURVE 0x03c74 _REC_CUR_20_u1_u2 1.99220002 _CNV_A_R_LINEAR_____39_CM 0. 1.99220002 DISPLAY_IDENTIFIER ID_CAM_TOOTH_PER_SP_FAC__N FORMAT "%5.3"
 /begin AXIS_DESCR COM_AXIS n _CNV_A_R_LINEAR_____11_CM 12 0. 8160. FORMAT "%4.0" AXIS_PTS_REF ldpm_n_id_cam_acq /end AXIS_DESCR
/end CHARACTERISTIC
/begin CHARACTERISTIC id_crk_tooth_per_sp_fac__n "" CURVE 0x0096a _REC_CUR_20_u1_u2 0.9375 _CNV_A_R_LINEAR_____46_CM 0. 0.9375 DISPLAY_IDENTIFIER ID_CRK_TOOTH_PER_SP_FAC FORMAT "%6.4"
 /begin AXIS_DESCR COM_AXIS n _CNV_A_R_LINEAR_____11_CM 6 0. 8160. FORMAT "%4.0" AXIS_PTS_REF ldpm_n_id_crk_acq /end AXIS_DESCR
/end CHARACTERISTIC
/begin CHARACTERISTIC id_saf_tab "conversion table for SAF value" MAP 0x08754 _REC_MAP_20_u2_u1_u1 1023.984375 _CNV_A_R_LINEAR_____47_CM 0. 1023.984375 DISPLAY_IDENTIFIER ID_SAF_TAB FORMAT "%7.2"
 /begin AXIS_DESCR COM_AXIS online_dummy _CNV_A_R_LINEAR_____1_CM 16 0. 255. FORMAT "%3.0" AXIS_PTS_REF ldp_id_saf_tab_1 /end AXIS_DESCR
 /begin AXIS_DESCR COM_AXIS online_dummy _CNV_A_R_LINEAR_____1_CM 16 0. 255. FORMAT "%3.0" AXIS_PTS_REF ldp_id_saf_tab_2 /end AXIS_DESCR
/end CHARACTERISTIC
/begin CHARACTERISTIC id_cam_tooth_ratio__n "" CURVE 0x03c80 _REC_CUR_20_u1_u2 7.96875 _CNV_A_R_LINEAR_____48_CM 0. 7.96875 DISPLAY_IDENTIFIER ID_CAM_TOOTH_RATIO__N FORMAT "%5.3"
 /begin AXIS_DESCR COM_AXIS n _CNV_A_R_LINEAR_____11_CM 12 0. 8160. FORMAT "%4.0" AXIS_PTS_REF ldpm_n_id_cam_acq /end AXIS_DESCR
/end CHARACTERISTIC
/begin CHARACTERISTIC id_crk_tooth_ratio__n "" CURVE 0x00970 _REC_CUR_20_u1_u2 0.9375 _CNV_A_R_LINEAR_____46_CM 0. 0.9375 DISPLAY_IDENTIFIER ID_CRK_TOOTH_RATIO FORMAT "%6.4"
 /begin AXIS_DESCR COM_AXIS n _CNV_A_R_LINEAR_____11_CM 6 0. 8160. FORMAT "%4.0" AXIS_PTS_REF ldpm_n_id_crk_acq /end AXIS_DESCR
/end CHARACTERISTIC
/begin MEASUREMENT v_igk_bas "Battery voltage after key raw acquisition" UWORD _CNV_A_R_LINEAR_____3_CM 1 100. 0. 4.99511719 DISPLAY_IDENTIFIER V_IGK_BAS ECU_ADDRESS 0x3fb31c BYTE_ORDER MSB_LAST FORMAT "%5.3" /end MEASUREMENT
/begin MEASUREMENT vcc_maf "Voltage supply for pedal value sensor 1 (and TPS) raw acquisitin" UWORD _CNV_A_R_LINEAR_____43_CM 1 100. 0. 9.9902 DISPLAY_IDENTIFIER VCC_MAF ECU_ADDRESS 0x3fd312 BYTE_ORDER MSB_LAST FORMAT "%5.3" /end MEASUREMENT
/begin MEASUREMENT v_toil "Oil temperature sensor raw acquisition" UBYTE _CNV_A_R_LINEAR_____44_CM 1 100. 0. 4.998 DISPLAY_IDENTIFIER V_TOIL ECU_ADDRESS 0x3fe137 FORMAT "%6.4" /end MEASUREMENT
/begin MEASUREMENT v_pvs_2_mc "Pedal value sensor 2 raw acquisition for Monitoring Level 2 MC" UBYTE _CNV_A_R_LINEAR_____44_CM 1 100. 0. 4.998 DISPLAY_IDENTIFIER V_PVS_2_MC ECU_ADDRESS 0x3fe138 FORMAT "%6.4" /end MEASUREMENT
/begin MEASUREMENT v_pvs_2_mu "Pedal value sensor 2 raw acquisition for Monitoring Level 2 MU" UBYTE _CNV_A_R_LINEAR_____44_CM 1 100. 0. 4.998 DISPLAY_IDENTIFIER V_PVS_2_MU ECU_ADDRESS 0x3fe139 FORMAT "%6.4" /end MEASUREMENT
/begin CHARACTERISTIC c_amp_ref "reference value of the ambient pressure" VALUE 0x01494 _REC_VAL_20_u2 5434. _CNV_A_R_LINEAR_____49_CM 0. 5434. DISPLAY_IDENTIFIER C_AMP_REF FORMAT "%7.2" /end CHARACTERISTIC
/begin CHARACTERISTIC c_v_amp_max_diag "maximum diagnostic value for the ambient pressure value" VALUE 0x01998 _REC_VAL_20_u2 4.99511719 _CNV_A_R_LINEAR_____3_CM 0. 4.99511719 DISPLAY_IDENTIFIER C_V_AMP_MAX_DIAG FORMAT "%5.3" /end CHARACTERISTIC
/begin CHARACTERISTIC c_v_amp_min_diag "minimum diagnostic value for the ambient pressure value" VALUE 0x0199a _REC_VAL_20_u2 4.99511719 _CNV_A_R_LINEAR_____3_CM 0. 4.99511719 DISPLAY_IDENTIFIER C_V_AMP_MIN_DIAG FORMAT "%5.3" /end CHARACTERISTIC
/begin MEASUREMENT cam_edge_nr_1 "identifier of  actual edge CAM_1" UBYTE _CNV_A_R_LINEAR_____1_CM 1 100. 0. 255. DISPLAY_IDENTIFIER CAM_EDGE_NR_1 ECU_ADDRESS 0x3fe464 FORMAT "%3.0" /end MEASUREMENT
/begin MEASUREMENT cam_edge_nr_0 "identifier of  actual edge CAM_0" UBYTE _CNV_A_R_LINEAR_____1_CM 1 100. 0. 255. DISPLAY_IDENTIFIER CAM_EDGE_NR_0 ECU_ADDRESS 0x3fe463 FORMAT "%3.0" /end MEASUREMENT
/begin MEASUREMENT ctr_cam_edge_ebr_det_0 "Counter of detected engine back rotations on CAM 0" UBYTE _CNV_A_R_LINEAR_____1_CM 1 100. 0. 255. DISPLAY_IDENTIFIER CTR_CAM_EDGE_EBR_DET_0 ECU_ADDRESS 0x3fe465 FORMAT "%3.0" /end MEASUREMENT
/begin MEASUREMENT lv_efp_on_ext_adj_can "switch ON of EFP via CAN (tester diagnosis9" UBYTE _CNV_S_2_RANGE______0_CM 1 100. 0. 1. DISPLAY_IDENTIFIER LV_EFP_ON_EXT_ADJ_CAN ECU_ADDRESS 0x3fde2e /end MEASUREMENT
/begin MEASUREMENT lv_efp_off_ext_adj_can "switch OFF of EFP via CAN (tester diagnosis9" UBYTE _CNV_S_2_RANGE______0_CM 1 100. 0. 1. DISPLAY_IDENTIFIER LV_EFP_OFF_EXT_ADJ_CAN ECU_ADDRESS 0x3fde2f /end MEASUREMENT
/begin MEASUREMENT state_diag_efp "diagnosis status of the electical fuel pump" UBYTE _CNV_A_R_LINEAR_____1_CM 1 100. 0. 255. DISPLAY_IDENTIFIER STATE_DIAG_EFP ECU_ADDRESS 0x3fde28 FORMAT "%3.0" /end MEASUREMENT
/begin MEASUREMENT state_efp_can "EFP - state for EOL and ASA diagnosis" UBYTE _CNV_A_R_LINEAR_____1_CM 1 100. 0. 3. DISPLAY_IDENTIFIER STATE_EFP_CAN ECU_ADDRESS 0x3fde29 FORMAT "%1.0" /end MEASUREMENT
/begin MEASUREMENT v_eng_efp "Engine voltage of the EFP" UBYTE _CNV_A_R_LINEAR_____89_CM 1 100. 5. 30.5 DISPLAY_IDENTIFIER V_ENG_EFP ECU_ADDRESS 0x3fde2a FORMAT "%4.1" /end MEASUREMENT
/begin MEASUREMENT cur_eng_efp "Engine current of the EFP" UBYTE _CNV_A_R_LINEAR_____90_CM 1 100. 0. 25.5 DISPLAY_IDENTIFIER CUR_ENG_EFP ECU_ADDRESS 0x3fde2b FORMAT "%4.1" /end MEASUREMENT
/begin MEASUREMENT vb_efp "VB measured by EFP" UBYTE _CNV_A_R_LINEAR_____89_CM 1 100. 5. 30.5 DISPLAY_IDENTIFIER VB_EFP ECU_ADDRESS 0x3fde2d FORMAT "%4.1" /end MEASUREMENT
/begin MEASUREMENT n_efp_av "Engine speed of the EFP" UBYTE _CNV_A_R_LINEAR_____91_CM 1 100. 0. 12750. DISPLAY_IDENTIFIER N_EFP_AV ECU_ADDRESS 0x3fde2c FORMAT "%6.0" /end MEASUREMENT
/begin CHARACTERISTIC c_eng_typ_efp "Engine type" VALUE 0x006b9 _REC_VAL_20_u1 1. _CNV_A_R_LINEAR_____22_CM 0. 1. DISPLAY_IDENTIFIER C_ENG_TYP_EFP FORMAT "%1.0" /end CHARACTERISTIC
/begin MEASUREMENT rel_flow_cps_av "Actual value of the relative flow (FLOW_CPS/MAF_CYL) through the CPS" UWORD _CNV_A_R_LINEAR_____37_CM 1 100. 0. 0.99998474 DISPLAY_IDENTIFIER REL_FLOW_CPS_AV ECU_ADDRESS 0x3fce54 BYTE_ORDER MSB_LAST FORMAT "%7.5" /end MEASUREMENT
/begin MEASUREMENT mff_add_cp "Additive adaptie correction of the mass fuel flow injection with active canister purge" UWORD _CNV_A_R_LINEAR_____106_CM 1 100. 0. 1389. DISPLAY_IDENTIFIER MFF_ADD_CP ECU_ADDRESS 0x3fce4c BYTE_ORDER MSB_LAST FORMAT "%7.2" /end MEASUREMENT
/begin MEASUREMENT flow_sp_cps "Flow setpoint through the CPS" UWORD _CNV_A_R_LINEAR_____111_CM 1 100. 0. 7.99987793 DISPLAY_IDENTIFIER FLOW_SP_CPS ECU_ADDRESS 0x3fce5c BYTE_ORDER MSB_LAST FORMAT "%7.4" /end MEASUREMENT
/begin MEASUREMENT flow_cor_cps "Corrected flow setpoint through the CPS" UWORD _CNV_A_R_LINEAR_____111_CM 1 100. 0. 7.99987793 DISPLAY_IDENTIFIER FLOW_COR_CPS ECU_ADDRESS 0x3fce88 BYTE_ORDER MSB_LAST FORMAT "%7.4" /end MEASUREMENT
/begin MEASUREMENT flow_req_cps "Reuest flow setpoint through the CPS" UWORD _CNV_A_R_LINEAR_____111_CM 1 100. 0. 7.99987793 DISPLAY_IDENTIFIER FLOW_REQ_CPS ECU_ADDRESS 0x3fce5e BYTE_ORDER MSB_LAST FORMAT "%7.4" /end MEASUREMENT
/begin MEASUREMENT flow_cps "Flow through the CPS" UWORD _CNV_A_R_LINEAR_____111_CM 1 100. 0. 7.99987793 DISPLAY_IDENTIFIER FLOW_CPS ECU_ADDRESS 0x3fce50 BYTE_ORDER MSB_LAST FORMAT "%7.4" /end MEASUREMENT
/begin MEASUREMENT cppwm_sp "Setpoint PWM signal for CPS opening" UBYTE _CNV_A_R_LINEAR_____10_CM 1 100. 0. 99.609375 DISPLAY_IDENTIFIER CPPWM_SP ECU_ADDRESS 0x3fde99 FORMAT "%3.1" /end MEASUREMENT
/begin MEASUREMENT fuel_cps "Fuel flow from the CPS to the Cylinder" UWORD _CNV_A_R_LINEAR_____111_CM 1 100. 0. 7.99987793 DISPLAY_IDENTIFIER FUEL_CPS ECU_ADDRESS 0x3fce4e BYTE_ORDER MSB_LAST FORMAT "%7.4" /end MEASUREMENT
/begin MEASUREMENT fuel_flow_add_buf[0] "Array of FUEL_FLOW_ADD_AD_CP values(20 values) " UWORD _CNV_A_R_LINEAR_____111_CM 1 100. 0. 7.99987793 DISPLAY_IDENTIFIER FUEL_FLOW_ADD_BUF_0_ ECU_ADDRESS 0x3fce60 BYTE_ORDER MSB_LAST FORMAT "%7.4" /end MEASUREMENT
/begin MEASUREMENT fuel_flow_add_buf[1] "Array of FUEL_FLOW_ADD_AD_CP values(20 values) " UWORD _CNV_A_R_LINEAR_____111_CM 1 100. 0. 7.99987793 DISPLAY_IDENTIFIER FUEL_FLOW_ADD_BUF_1_ ECU_ADDRESS 0x3fce62 BYTE_ORDER MSB_LAST FORMAT "%7.4" /end MEASUREMENT
/begin MEASUREMENT fuel_flow_add_buf[2] "Array of FUEL_FLOW_ADD_AD_CP values(20 values) " UWORD _CNV_A_R_LINEAR_____111_CM 1 100. 0. 7.99987793 DISPLAY_IDENTIFIER FUEL_FLOW_ADD_BUF_2_ ECU_ADDRESS 0x3fce64 BYTE_ORDER MSB_LAST FORMAT "%7.4" /end MEASUREMENT
/begin MEASUREMENT fuel_flow_add_buf[3] "Array of FUEL_FLOW_ADD_AD_CP values(20 values) " UWORD _CNV_A_R_LINEAR_____111_CM 1 100. 0. 7.99987793 DISPLAY_IDENTIFIER FUEL_FLOW_ADD_BUF_3_ ECU_ADDRESS 0x3fce66 BYTE_ORDER MSB_LAST FORMAT "%7.4" /end MEASUREMENT
/begin MEASUREMENT fuel_flow_add_buf[4] "Array of FUEL_FLOW_ADD_AD_CP values(20 values) " UWORD _CNV_A_R_LINEAR_____111_CM 1 100. 0. 7.99987793 DISPLAY_IDENTIFIER FUEL_FLOW_ADD_BUF_4_ ECU_ADDRESS 0x3fce68 BYTE_ORDER MSB_LAST FORMAT "%7.4" /end MEASUREMENT
/begin MEASUREMENT fuel_flow_add_buf[5] "Array of FUEL_FLOW_ADD_AD_CP values(20 values) " UWORD _CNV_A_R_LINEAR_____111_CM 1 100. 0. 7.99987793 DISPLAY_IDENTIFIER FUEL_FLOW_ADD_BUF_5_ ECU_ADDRESS 0x3fce6a BYTE_ORDER MSB_LAST FORMAT "%7.4" /end MEASUREMENT
/begin MEASUREMENT fuel_flow_add_buf[6] "Array of FUEL_FLOW_ADD_AD_CP values(20 values) " UWORD _CNV_A_R_LINEAR_____111_CM 1 100. 0. 7.99987793 DISPLAY_IDENTIFIER FUEL_FLOW_ADD_BUF_6_ ECU_ADDRESS 0x3fce6c BYTE_ORDER MSB_LAST FORMAT "%7.4" /end MEASUREMENT
/begin MEASUREMENT fuel_flow_add_buf[7] "Array of FUEL_FLOW_ADD_AD_CP values(20 values) " UWORD _CNV_A_R_LINEAR_____111_CM 1 100. 0. 7.99987793 DISPLAY_IDENTIFIER FUEL_FLOW_ADD_BUF_7_ ECU_ADDRESS 0x3fce6e BYTE_ORDER MSB_LAST FORMAT "%7.4" /end MEASUREMENT
/begin MEASUREMENT fuel_flow_add_buf[8] "Array of FUEL_FLOW_ADD_AD_CP values(20 values) " UWORD _CNV_A_R_LINEAR_____111_CM 1 100. 0. 7.99987793 DISPLAY_IDENTIFIER FUEL_FLOW_ADD_BUF_8_ ECU_ADDRESS 0x3fce70 BYTE_ORDER MSB_LAST FORMAT "%7.4" /end MEASUREMENT
/begin MEASUREMENT fuel_flow_add_buf[9] "Array of FUEL_FLOW_ADD_AD_CP values(20 values) " UWORD _CNV_A_R_LINEAR_____111_CM 1 100. 0. 7.99987793 DISPLAY_IDENTIFIER FUEL_FLOW_ADD_BUF_9_ ECU_ADDRESS 0x3fce72 BYTE_ORDER MSB_LAST FORMAT "%7.4" /end MEASUREMENT
/begin MEASUREMENT fuel_flow_add_buf[10] "Array of FUEL_FLOW_ADD_AD_CP values(20 values) " UWORD _CNV_A_R_LINEAR_____111_CM 1 100. 0. 7.99987793 DISPLAY_IDENTIFIER FUEL_FLOW_ADD_BUF_10_ ECU_ADDRESS 0x3fce74 BYTE_ORDER MSB_LAST FORMAT "%7.4" /end MEASUREMENT
/begin MEASUREMENT fuel_flow_add_buf[11] "Array of FUEL_FLOW_ADD_AD_CP values(20 values) " UWORD _CNV_A_R_LINEAR_____111_CM 1 100. 0. 7.99987793 DISPLAY_IDENTIFIER FUEL_FLOW_ADD_BUF_11_ ECU_ADDRESS 0x3fce76 BYTE_ORDER MSB_LAST FORMAT "%7.4" /end MEASUREMENT
/begin MEASUREMENT fuel_flow_add_buf[12] "Array of FUEL_FLOW_ADD_AD_CP values(20 values) " UWORD _CNV_A_R_LINEAR_____111_CM 1 100. 0. 7.99987793 DISPLAY_IDENTIFIER FUEL_FLOW_ADD_BUF_12_ ECU_ADDRESS 0x3fce78 BYTE_ORDER MSB_LAST FORMAT "%7.4" /end MEASUREMENT
/begin MEASUREMENT fuel_flow_add_buf[13] "Array of FUEL_FLOW_ADD_AD_CP values(20 values) " UWORD _CNV_A_R_LINEAR_____111_CM 1 100. 0. 7.99987793 DISPLAY_IDENTIFIER FUEL_FLOW_ADD_BUF_13_ ECU_ADDRESS 0x3fce7a BYTE_ORDER MSB_LAST FORMAT "%7.4" /end MEASUREMENT
/begin MEASUREMENT fuel_flow_add_buf[14] "Array of FUEL_FLOW_ADD_AD_CP values(20 values) " UWORD _CNV_A_R_LINEAR_____111_CM 1 100. 0. 7.99987793 DISPLAY_IDENTIFIER FUEL_FLOW_ADD_BUF_14_ ECU_ADDRESS 0x3fce7c BYTE_ORDER MSB_LAST FORMAT "%7.4" /end MEASUREMENT
/begin MEASUREMENT fuel_flow_add_buf[15] "Array of FUEL_FLOW_ADD_AD_CP values(20 values) " UWORD _CNV_A_R_LINEAR_____111_CM 1 100. 0. 7.99987793 DISPLAY_IDENTIFIER FUEL_FLOW_ADD_BUF_15_ ECU_ADDRESS 0x3fce7e BYTE_ORDER MSB_LAST FORMAT "%7.4" /end MEASUREMENT
/begin MEASUREMENT fuel_flow_add_buf[16] "Array of FUEL_FLOW_ADD_AD_CP values(20 values) " UWORD _CNV_A_R_LINEAR_____111_CM 1 100. 0. 7.99987793 DISPLAY_IDENTIFIER FUEL_FLOW_ADD_BUF_16_ ECU_ADDRESS 0x3fce80 BYTE_ORDER MSB_LAST FORMAT "%7.4" /end MEASUREMENT
/begin MEASUREMENT fuel_flow_add_buf[17] "Array of FUEL_FLOW_ADD_AD_CP values(20 values) " UWORD _CNV_A_R_LINEAR_____111_CM 1 100. 0. 7.99987793 DISPLAY_IDENTIFIER FUEL_FLOW_ADD_BUF_17_ ECU_ADDRESS 0x3fce82 BYTE_ORDER MSB_LAST FORMAT "%7.4" /end MEASUREMENT
/begin MEASUREMENT fuel_flow_add_buf[18] "Array of FUEL_FLOW_ADD_AD_CP values(20 values) " UWORD _CNV_A_R_LINEAR_____111_CM 1 100. 0. 7.99987793 DISPLAY_IDENTIFIER FUEL_FLOW_ADD_BUF_18_ ECU_ADDRESS 0x3fce84 BYTE_ORDER MSB_LAST FORMAT "%7.4" /end MEASUREMENT
/begin MEASUREMENT fuel_flow_add_buf[19] "Array of FUEL_FLOW_ADD_AD_CP values(20 values) " UWORD _CNV_A_R_LINEAR_____111_CM 1 100. 0. 7.99987793 DISPLAY_IDENTIFIER FUEL_FLOW_ADD_BUF_19_ ECU_ADDRESS 0x3fce86 BYTE_ORDER MSB_LAST FORMAT "%7.4" /end MEASUREMENT
/begin MEASUREMENT flow_tot_cps "Total of FLOW_CPS during emission cycle" ULONG _CNV_A_R_LINEAR_____112_CM 1 100. 0. 1456. DISPLAY_IDENTIFIER FLOW_TOT_CPS ECU_ADDRESS 0x3fbf24 BYTE_ORDER MSB_LAST FORMAT "%12.7" /end MEASUREMENT
/begin MEASUREMENT fuel_tot_cps "Total of FUEL_CPS during emission cycle" ULONG _CNV_A_R_LINEAR_____112_CM 1 100. 0. 1456. DISPLAY_IDENTIFIER FUEL_TOT_CPS ECU_ADDRESS 0x3fbf20 BYTE_ORDER MSB_LAST FORMAT "%12.7" /end MEASUREMENT
/begin MEASUREMENT maf_cps "Air flow from the CPS to the Cylinder" UWORD _CNV_A_R_LINEAR_____111_CM 1 100. 0. 7.99987793 DISPLAY_IDENTIFIER MAF_CPS ECU_ADDRESS 0x3fce52 BYTE_ORDER MSB_LAST FORMAT "%7.4" /end MEASUREMENT
/begin MEASUREMENT fac_tia_amp_cp "Flow correction versus air temperature and ambient pressure" UBYTE _CNV_A_R_LINEAR_____39_CM 1 100. 0. 1.99220002 DISPLAY_IDENTIFIER FAC_TIA_AMP_CP ECU_ADDRESS 0x3fde98 FORMAT "%5.3" /end MEASUREMENT
/begin MEASUREMENT maf_tot_cp_dly_old "Old vale of MAF_TOT_CP_DLY for  Padé filter calculation for MAF_TOT_CP_DLY" UWORD _CNV_A_R_LINEAR_____113_CM 1 100. 0. 2047.96875 DISPLAY_IDENTIFIER MAF_TOT_CP_DLY_OLD ECU_ADDRESS 0x3fce90 BYTE_ORDER MSB_LAST FORMAT "%7.2" /end MEASUREMENT
/begin MEASUREMENT maf_tot_cp_old2 "Old vale of MAF_TOT_CP for  Padé filter calculation for MAF_TOT_CP_DLY" UWORD _CNV_A_R_LINEAR_____113_CM 1 100. 0. 2047.96875 DISPLAY_IDENTIFIER MAF_TOT_CP_OLD2 ECU_ADDRESS 0x3fce94 BYTE_ORDER MSB_LAST FORMAT "%7.2" /end MEASUREMENT
/begin MEASUREMENT flow_cps_dly "Filtered value of FLOW_CPS (Padé Filter)" UWORD _CNV_A_R_LINEAR_____111_CM 1 100. 0. 7.99987793 DISPLAY_IDENTIFIER FLOW_CPS_DLY ECU_ADDRESS 0x3fce5a BYTE_ORDER MSB_LAST FORMAT "%7.4" /end MEASUREMENT
/begin MEASUREMENT flow_cps_dly_old "Old value of FLOW_CPS_DLY for Padé Filter calculation for FLOW_CPS_DLY" UWORD _CNV_A_R_LINEAR_____111_CM 1 100. 0. 7.99987793 DISPLAY_IDENTIFIER FLOW_CPS_DLY_OLD ECU_ADDRESS 0x3fce96 BYTE_ORDER MSB_LAST FORMAT "%7.4" /end MEASUREMENT
/begin MEASUREMENT flow_cps_old "Old value of FLOW_CPS for Padé Filter calculation for FLOW_CPS_DLY" UWORD _CNV_A_R_LINEAR_____111_CM 1 100. 0. 7.99987793 DISPLAY_IDENTIFIER FLOW_CPS_OLD ECU_ADDRESS 0x3fce98 BYTE_ORDER MSB_LAST FORMAT "%7.4" /end MEASUREMENT
/begin MEASUREMENT flow_cps_old2 "Old value of FLOW_CPS for Padé Filter calculation for FLOW_CPS_DLY" UWORD _CNV_A_R_LINEAR_____111_CM 1 100. 0. 7.99987793 DISPLAY_IDENTIFIER FLOW_CPS_OLD2 ECU_ADDRESS 0x3fce9a BYTE_ORDER MSB_LAST FORMAT "%7.4" /end MEASUREMENT
/begin MEASUREMENT flow_cps_dly_mmv "Moving mean value of FLOW_CPS_DLY" UWORD _CNV_A_R_LINEAR_____111_CM 1 100. 0. 7.99987793 DISPLAY_IDENTIFIER FLOW_CPS_DLY_MMV ECU_ADDRESS 0x3fce58 BYTE_ORDER MSB_LAST FORMAT "%7.4" /end MEASUREMENT
/begin MEASUREMENT maf_tot_cp "(MAF throttle)MAF_THR + (MAF through the canister prge valve) MAF_CPS" UWORD _CNV_A_R_LINEAR_____113_CM 1 100. 0. 2047.96875 DISPLAY_IDENTIFIER MAF_TOT_CP ECU_ADDRESS 0x3fce8c BYTE_ORDER MSB_LAST FORMAT "%7.2" /end MEASUREMENT
/begin MEASUREMENT maf_tot_cp_dly "Filtered value of MAF_TOT_CP(Padé Filter)" UWORD _CNV_A_R_LINEAR_____111_CM 1 100. 0. 7.99987793 DISPLAY_IDENTIFIER MAF_TOT_CP_DLY ECU_ADDRESS 0x3fce8e BYTE_ORDER MSB_LAST FORMAT "%7.4" /end MEASUREMENT
/begin MEASUREMENT maf_tot_cp_dly_mmv "Moving mean value of  MAF_TOT_CP_DLY" UWORD _CNV_A_R_LINEAR_____113_CM 1 100. 0. 2047.96875 DISPLAY_IDENTIFIER MAF_TOT_CP_DLY_MMV ECU_ADDRESS 0x3fce56 BYTE_ORDER MSB_LAST FORMAT "%7.2" /end MEASUREMENT
/begin MEASUREMENT maf_tot_cp_old "Old vale of MAF_TOT_CP for  Padé filter calculation for MAF_TOT_CP_DLY" UWORD _CNV_A_R_LINEAR_____113_CM 1 100. 0. 2047.96875 DISPLAY_IDENTIFIER MAF_TOT_CP_OLD ECU_ADDRESS 0x3fce92 BYTE_ORDER MSB_LAST FORMAT "%7.2" /end MEASUREMENT
/begin CHARACTERISTIC c_flow_cps_as "" VALUE 0x015ba _REC_VAL_20_u2 7.99987793 _CNV_A_R_LINEAR_____111_CM 0. 7.99987793 DISPLAY_IDENTIFIER C_FLOW_CPS_AS FORMAT "%7.4" /end CHARACTERISTIC
/begin CHARACTERISTIC c_maf_tot_cp_dly_crlc "" VALUE 0x016ba _REC_VAL_20_u2 0.99998474 _CNV_A_R_LINEAR_____37_CM 0. 0.99998474 DISPLAY_IDENTIFIER C_MAF_TOT_CP_DLY_CRLC FORMAT "%7.5" /end CHARACTERISTIC
/begin CHARACTERISTIC c_flow_cps_dly_crlc "" VALUE 0x015bc _REC_VAL_20_u2 0.99998474 _CNV_A_R_LINEAR_____37_CM 0. 0.99998474 DISPLAY_IDENTIFIER C_FLOW_CPS_DLY_CRLC FORMAT "%7.5" /end CHARACTERISTIC
/begin CHARACTERISTIC ip_cppwm__flow_cor_cps__prs_cps "CPS duty cycle" MAP 0x0499a _REC_MAP_20_u1_u2_u2 99.609375 _CNV_A_R_LINEAR_____10_CM 0. 99.609375 DISPLAY_IDENTIFIER IP_CPPWM__FLOW_COR_CPS__PRS_CPS FORMAT "%5.2"
 /begin AXIS_DESCR COM_AXIS flow_cor_cps _CNV_A_R_LINEAR_____111_CM 12 0. 7.99987793 FORMAT "%7.4" AXIS_PTS_REF ldp_flow_cor_cps_ip_cppwm /end AXIS_DESCR
 /begin AXIS_DESCR COM_AXIS prs_cps _CNV_A_R_LINEAR_____114_CM 12 -2717. 2717. FORMAT "%7.2" AXIS_PTS_REF ldpm_prs_cps_ip_cppwm /end AXIS_DESCR
/end CHARACTERISTIC
/begin CHARACTERISTIC ip_fac_amp_cp__amp "Correction factor for ambient pressure" CURVE 0x00a9a _REC_CUR_20_u1_u2 1.9921875 _CNV_A_R_LINEAR_____115_CM 0. 1.9921875 DISPLAY_IDENTIFIER IP_FAC_AMP_CP__AMP FORMAT "%5.3"
 /begin AXIS_DESCR COM_AXIS amp _CNV_A_R_LINEAR_____49_CM 6 0. 5434. FORMAT "%7.2" AXIS_PTS_REF ldp_amp_ip_fac_amp_cp /end AXIS_DESCR
/end CHARACTERISTIC
/begin CHARACTERISTIC ip_fac_tia_cp__tia_thr "Correction factor for intake air temperature" CURVE 0x00bda _REC_CUR_20_u1_u1 1.9921875 _CNV_A_R_LINEAR_____115_CM 0. 1.9921875 DISPLAY_IDENTIFIER IP_FAC_TIA_CP__TIA_THR FORMAT "%5.3"
 /begin AXIS_DESCR COM_AXIS tia _CNV_A_R_LINEAR_____12_CM 6 -48. 142.5 FORMAT "%5.1" AXIS_PTS_REF ldp_tia_thr_ip_fac_tia_cp /end AXIS_DESCR
/end CHARACTERISTIC
/begin CHARACTERISTIC ip_flow_cps__prs_cps "FLOW_CPS for fully opened CPS" CURVE 0x0b7a6 _REC_CUR_20_u2_u2 7.99987793 _CNV_A_R_LINEAR_____111_CM 0. 7.99987793 DISPLAY_IDENTIFIER IP_FLOW_CPS__PRS_CPS FORMAT "%7.4"
 /begin AXIS_DESCR COM_AXIS prs_cps _CNV_A_R_LINEAR_____114_CM 12 -2717. 2717. FORMAT "%7.2" AXIS_PTS_REF ldpm_prs_cps_ip_cppwm /end AXIS_DESCR
/end CHARACTERISTIC
/begin CHARACTERISTIC ip_fuel_dly_cps__n_32 "" CURVE 0x00c14 _REC_CUR_20_u1_u1 19. _CNV_A_R_LINEAR_____1_CM 0. 19. DISPLAY_IDENTIFIER IP_FUEL_DLY_CPS__N_32 FORMAT "%2.0"
 /begin AXIS_DESCR COM_AXIS n_32 _CNV_A_R_LINEAR_____16_CM 6 0. 8160. FORMAT "%4.0" AXIS_PTS_REF ldpm_n_32_ip_fuel_dly_cps /end AXIS_DESCR
/end CHARACTERISTIC
/begin CHARACTERISTIC ip_fuel_fac_cps__n_32 "Ratio of FUEL_CPS calculation" CURVE 0x00c1a _REC_CUR_20_u1_u1 0.9960940000000002 _CNV_A_R_LINEAR_____50_CM 0. 0.996094 DISPLAY_IDENTIFIER IP_FUEL_FAC_CPS__N_32 FORMAT "%5.3"
 /begin AXIS_DESCR COM_AXIS n_32 _CNV_A_R_LINEAR_____16_CM 6 0. 8160. FORMAT "%4.0" AXIS_PTS_REF ldpm_n_32_ip_fuel_dly_cps /end AXIS_DESCR
/end CHARACTERISTIC
/begin CHARACTERISTIC ip_flow_cps_dec__maf_cyl "Decrement value on FLOW_SP_CPS" CURVE 0x0b7be _REC_CUR_20_u2_u2 7.99987793 _CNV_A_R_LINEAR_____111_CM 0. 7.99987793 DISPLAY_IDENTIFIER IP_FLOW_CPS_DEC__MAF_CYL FORMAT "%7.4"
 /begin AXIS_DESCR COM_AXIS maf_cyl _CNV_A_R_LINEAR_____113_CM 6 0. 2047.96875 FORMAT "%6.2" AXIS_PTS_REF ldpm_maf_cyl_ip_rel_flow_inc_cp /end AXIS_DESCR
/end CHARACTERISTIC
/begin CHARACTERISTIC ip_flow_cps_inc__maf_cyl "Increment value on FLOW_SP_CPS" CURVE 0x0b7ca _REC_CUR_20_u2_u2 7.99987793 _CNV_A_R_LINEAR_____111_CM 0. 7.99987793 DISPLAY_IDENTIFIER IP_FLOW_CPS_INC__MAF_CYL FORMAT "%7.4"
 /begin AXIS_DESCR COM_AXIS maf_cyl _CNV_A_R_LINEAR_____113_CM 6 0. 2047.96875 FORMAT "%6.2" AXIS_PTS_REF ldpm_maf_cyl_ip_rel_flow_inc_cp /end AXIS_DESCR
/end CHARACTERISTIC
/begin CHARACTERISTIC ip_t_dly_cp__maf_cyl "Stabilization delay on CL_MMV vale during RAMP_OPEN" CURVE 0x0df92 _REC_CUR_20_u2_u2 63.99902344 _CNV_A_R_LINEAR_____116_CM 0. 63.99902344 DISPLAY_IDENTIFIER IP_T_DLY_CP__MAF_CYL FORMAT "%7.4"
 /begin AXIS_DESCR COM_AXIS maf_cyl _CNV_A_R_LINEAR_____113_CM 6 0. 2047.96875 FORMAT "%6.2" AXIS_PTS_REF ldpm_maf_cyl_ip_rel_flow_inc_cp /end AXIS_DESCR
/end CHARACTERISTIC
/begin AXIS_PTS ldp_flow_cor_cps_ip_cppwm "" 0x10ac4 flow_cor_cps _REC_AXS_20_u2 7.99987793 _CNV_A_R_LINEAR_____111_CM 12 0. 7.99987793 DISPLAY_IDENTIFIER LDP_FLOW_COR_CPS_IP_CPPWM FORMAT "%7.4" /end AXIS_PTS
/begin AXIS_PTS ldpm_prs_cps_ip_cppwm "" 0x11a9a prs_cps _REC_AXS_20_u2 5434. _CNV_A_R_LINEAR_____114_CM 12 -2717. 2717. DISPLAY_IDENTIFIER LDPM_PRS_CPS_IP_CPPWM FORMAT "%7.2" /end AXIS_PTS
/begin AXIS_PTS ldp_amp_ip_fac_amp_cp "" 0x108a6 amp _REC_AXS_20_u2 5434. _CNV_A_R_LINEAR_____49_CM 6 0. 5434. DISPLAY_IDENTIFIER LDP_AMP_IP_FAC_AMP_CP FORMAT "%7.2" /end AXIS_PTS
/begin AXIS_PTS ldp_tia_thr_ip_fac_tia_cp "" 0x01223 tia _REC_AXS_20_u1 190.5 _CNV_A_R_LINEAR_____12_CM 6 -48. 142.5 DISPLAY_IDENTIFIER LDP_TIA_THR_IP_FAC_TIA_CP FORMAT "%5.1" /end AXIS_PTS
/begin CHARACTERISTIC lc_flow_cps_as "" VALUE 0x00f25 _REC_VAL_20_u1 1. _CNV_A_R_LINEAR_____1_CM 0. 1. DISPLAY_IDENTIFIER LC_FLOW_CPS_AS FORMAT "%2.0" /end CHARACTERISTIC
/begin CHARACTERISTIC lc_flow_cps_cal "" VALUE 0x00f26 _REC_VAL_20_u1 1. _CNV_A_R_LINEAR_____1_CM 0. 1. DISPLAY_IDENTIFIER LC_FLOW_CPS_CAL FORMAT "%2.0" /end CHARACTERISTIC
/begin MEASUREMENT lv_obd_cdn_close_mod "Logical value for NO_PURGE authorization by projectspecific conditions " UBYTE _CNV_S_2_RANGE______0_CM 1 100. 0. 1. DISPLAY_IDENTIFIER LV_OBD_CDN_CLOSE_MOD ECU_ADDRESS 0x3fdeb5 BIT_MASK 0x1 /end MEASUREMENT
/begin MEASUREMENT lv_obd_cdn_min_mod "Logical value for MIN_PURGE authorization by projectspecific conditions " UBYTE _CNV_S_2_RANGE______0_CM 1 100. 0. 1. DISPLAY_IDENTIFIER LV_OBD_CDN_MIN_MOD ECU_ADDRESS 0x3fdeb6 BIT_MASK 0x1 /end MEASUREMENT
/begin MEASUREMENT lv_act_evap "Logical value for calculation of the functional check CPS in the canister function" UBYTE _CNV_S_2_RANGE______0_CM 1 100. 0. 1. DISPLAY_IDENTIFIER LV_ACT_EVAP ECU_ADDRESS 0x3fdeb7 BIT_MASK 0x1 /end MEASUREMENT
/begin MEASUREMENT flow_sp_cps_evap "Flow Set point through the CPS duting functional check CPS" UWORD _CNV_A_R_LINEAR_____111_CM 1 100. 0. 7.99987793 DISPLAY_IDENTIFIER FLOW_SP_CPS_EVAP ECU_ADDRESS 0x3fcede BYTE_ORDER MSB_LAST FORMAT "%7.4" /end MEASUREMENT
/begin MEASUREMENT cppwm_cps "Corrected PWM signal for CPS opening" UBYTE _CNV_A_R_LINEAR_____10_CM 1 100. 0. 99.609375 DISPLAY_IDENTIFIER CPPWM_CPS ECU_ADDRESS 0x3fdeba FORMAT "%4.1" /end MEASUREMENT
/begin MEASUREMENT cppwm_ref "Reference PWM signal for CPS opening" UBYTE _CNV_A_R_LINEAR_____10_CM 1 100. 0. 99.609375 DISPLAY_IDENTIFIER CPPWM_REF ECU_ADDRESS 0x3fdebd FORMAT "%4.1" /end MEASUREMENT
/begin MEASUREMENT lv_frq_1_cps "Logical value for CPS PWM frequency" UBYTE _CNV_S_2_RANGE______5_CM 1 100. 0. 1. DISPLAY_IDENTIFIER LV_FRQ_1_CPS ECU_ADDRESS 0x3fdec0 BIT_MASK 0x1 /end MEASUREMENT
/begin MEASUREMENT frq_req_cp "CPS Output frequency" UBYTE _CNV_A_R_LINEAR_____128_CM 1 100. 0. 255. DISPLAY_IDENTIFIER FRQ_REQ_CP ECU_ADDRESS 0x3fdebc FORMAT "%3.0" /end MEASUREMENT
/begin MEASUREMENT lv_close_act_cp "Logical value for CPS valve closed" UBYTE _CNV_S_2_RANGE______0_CM 1 100. 0. 1. DISPLAY_IDENTIFIER LV_CLOSE_ACT_CP ECU_ADDRESS 0x3fdebb BIT_MASK 0x1 /end MEASUREMENT
/begin MEASUREMENT cppwm "PWM signal for CPS opening" UBYTE _CNV_A_R_LINEAR_____10_CM 1 100. 0. 99.609375 DISPLAY_IDENTIFIER CPPWM ECU_ADDRESS 0x3fde97 FORMAT "%4.1" /end MEASUREMENT
/begin CHARACTERISTIC c_n_frq_1_cps "Threshold on engine speed to shift CPS frequency output" VALUE 0x00769 _REC_VAL_20_u1 8160. _CNV_A_R_LINEAR_____16_CM 0. 8160. DISPLAY_IDENTIFIER C_N_FRQ_1_CPS FORMAT "%4.0" /end CHARACTERISTIC
/begin CHARACTERISTIC c_n_frq_2_cps "Second threshold on engine speed to shift CPS frequency output" VALUE 0x0076a _REC_VAL_20_u1 8160. _CNV_A_R_LINEAR_____16_CM 0. 8160. DISPLAY_IDENTIFIER C_N_FRQ_2_CPS FORMAT "%4.0" /end CHARACTERISTIC
/begin CHARACTERISTIC c_n_frq_hys_cps "Hysteresis threshold on engine speed to shift CPS frequency output" VALUE 0x0076b _REC_VAL_20_u1 8160. _CNV_A_R_LINEAR_____16_CM 0. 8160. DISPLAY_IDENTIFIER C_N_FRQ_HYS_CPS FORMAT "%4.0" /end CHARACTERISTIC
/begin CHARACTERISTIC c_cppwm_frq_1_cps "Threshold on CPPWM to shift CPS output frequency" VALUE 0x00612 _REC_VAL_20_u1 99.609375 _CNV_A_R_LINEAR_____10_CM 0. 99.609375 DISPLAY_IDENTIFIER C_CPPWM_FRQ_1_CPS FORMAT "%5.1" /end CHARACTERISTIC
/begin CHARACTERISTIC c_cppwm_frq_2_cps "Threshold on CPPWM to shift CPS output frequency" VALUE 0x00614 _REC_VAL_20_u1 99.609375 _CNV_A_R_LINEAR_____10_CM 0. 99.609375 DISPLAY_IDENTIFIER C_CPPWM_FRQ_2_CPS FORMAT "%5.1" /end CHARACTERISTIC
/begin CHARACTERISTIC c_cppwm_frq_hys_cps "Hysteresis threshold on engine speed to shift CPS frequency output" VALUE 0x00615 _REC_VAL_20_u1 99.609375 _CNV_A_R_LINEAR_____10_CM 0. 99.609375 DISPLAY_IDENTIFIER C_CPPWM_FRQ_HYS_CPS FORMAT "%5.1" /end CHARACTERISTIC
/begin CHARACTERISTIC c_cppwm_frq_1 "First CPS output frequency" VALUE 0x00611 _REC_VAL_20_u1 255. _CNV_A_R_LINEAR_____128_CM 0. 255. DISPLAY_IDENTIFIER C_CPPWM_FRQ_1 FORMAT "%3.0" /end CHARACTERISTIC
/begin CHARACTERISTIC c_cppwm_frq_2 "Second CPS output frequency" VALUE 0x00613 _REC_VAL_20_u1 255. _CNV_A_R_LINEAR_____128_CM 0. 255. DISPLAY_IDENTIFIER C_CPPWM_FRQ_2 FORMAT "%3.0" /end CHARACTERISTIC
/begin CHARACTERISTIC c_cppwm_max_cps_diag_frq_1 "CPPWM_CPS maximum limit to assure the diagnosis with frequency 1" VALUE 0x00616 _REC_VAL_20_u1 99.609375 _CNV_A_R_LINEAR_____10_CM 0. 99.609375 DISPLAY_IDENTIFIER C_CPPWM_MAX_CPS_DIAG_FRQ_1 FORMAT "%5.1" /end CHARACTERISTIC
/begin CHARACTERISTIC c_cppwm_max_cps_diag_frq_2 "CPPWM_CPS maximum limit to assure the diagnosis with frequency 2" VALUE 0x00617 _REC_VAL_20_u1 99.609375 _CNV_A_R_LINEAR_____10_CM 0. 99.609375 DISPLAY_IDENTIFIER C_CPPWM_MAX_CPS_DIAG_FRQ_2 FORMAT "%5.1" /end CHARACTERISTIC
/begin CHARACTERISTIC c_cppwm_min_cps_diag_frq_1 "CPPWM_CPS minimum limit to assure the diagnosis with frequency 1" VALUE 0x00618 _REC_VAL_20_u1 99.609375 _CNV_A_R_LINEAR_____10_CM 0. 99.609375 DISPLAY_IDENTIFIER C_CPPWM_MIN_CPS_DIAG_FRQ_1 FORMAT "%5.1" /end CHARACTERISTIC
/begin CHARACTERISTIC c_cppwm_min_cps_diag_frq_2 "CPPWM_CPS minimum limit to assure the diagnosis with frequency 2" VALUE 0x00619 _REC_VAL_20_u1 99.609375 _CNV_A_R_LINEAR_____10_CM 0. 99.609375 DISPLAY_IDENTIFIER C_CPPWM_MIN_CPS_DIAG_FRQ_2 FORMAT "%5.1" /end CHARACTERISTIC
/begin CHARACTERISTIC c_cppwm_as "CPPWM_REF correction of application system" VALUE 0x0037e _REC_VAL_20_s1 199.21875 _CNV_A_R_LINEAR_____129_CM -100. 99.21875 DISPLAY_IDENTIFIER C_CPPWM_AS FORMAT "%6.1" /end CHARACTERISTIC
/begin CHARACTERISTIC lc_cppwm_lim_diag "Selection of diagnosis limit values on  CPPWM_CPS" VALUE 0x00f0d _REC_VAL_20_u1 1. _CNV_S_2_RANGE______5_CM 0. 1. DISPLAY_IDENTIFIER LC_CPPWM_LIM_DIAG /end CHARACTERISTIC
/begin CHARACTERISTIC lc_cppwm_as "C_CPPWM_AS activation" VALUE 0x00f0c _REC_VAL_20_u1 1. _CNV_S_2_RANGE______5_CM 0. 1. DISPLAY_IDENTIFIER LC_CPPWM_AS /end CHARACTERISTIC
/begin CHARACTERISTIC ip_cppwm_vb_add_1__vb "Additive VB correction for CPPWM" CURVE 0x00a2c _REC_CUR_20_u1_u1 99.609375 _CNV_A_R_LINEAR_____130_CM -50. 49.609375 DISPLAY_IDENTIFIER IP_CPPWM_VB_ADD_1__VB FORMAT "%6.2"
 /begin AXIS_DESCR COM_AXIS vb _CNV_A_R_LINEAR_____34_CM 8 0. 25.8984 FORMAT "%3.1" AXIS_PTS_REF ldpm_vb_ip_cppwm_vb /end AXIS_DESCR
/end CHARACTERISTIC
/begin CHARACTERISTIC ip_cppwm_vb_add_2__vb "Additive VB correction for CPPWM" CURVE 0x00a34 _REC_CUR_20_u1_u1 99.609375 _CNV_A_R_LINEAR_____130_CM -50. 49.609375 DISPLAY_IDENTIFIER IP_CPPWM_VB_ADD_2__VB FORMAT "%6.2"
 /begin AXIS_DESCR COM_AXIS vb _CNV_A_R_LINEAR_____34_CM 8 0. 25.8984 FORMAT "%3.1" AXIS_PTS_REF ldpm_vb_ip_cppwm_vb /end AXIS_DESCR
/end CHARACTERISTIC
/begin CHARACTERISTIC ip_cppwm_vb_fac__vb "Multiplicate VB correction for CPPWM" CURVE 0x00a3c _REC_CUR_20_u1_u1 1.9921875 _CNV_A_R_LINEAR_____115_CM 0. 1.9921875 DISPLAY_IDENTIFIER IP_CPPWM_VB_FAC__VB FORMAT "%5.3"
 /begin AXIS_DESCR COM_AXIS vb _CNV_A_R_LINEAR_____34_CM 8 0. 25.8984 FORMAT "%3.1" AXIS_PTS_REF ldpm_vb_ip_cppwm_vb /end AXIS_DESCR
/end CHARACTERISTIC
/begin CHARACTERISTIC ip_cppwm_cor_frq__cppwm_ref "PWM correction following frequency output" CURVE 0x00a24 _REC_CUR_20_u1_u1 1.9921875 _CNV_A_R_LINEAR_____115_CM 0. 1.9921875 DISPLAY_IDENTIFIER IP_CPPWM_COR_FRQ__CPPWM_REF FORMAT "%5.3"
 /begin AXIS_DESCR COM_AXIS cppwm_ref _CNV_A_R_LINEAR_____10_CM 8 0. 99.609375 FORMAT "%5.1" AXIS_PTS_REF ldp_cppwm_ref_ip_cppwm_cor_frq /end AXIS_DESCR
/end CHARACTERISTIC
/begin AXIS_PTS ldpm_vb_ip_cppwm_vb "" 0x082a7 vb _REC_AXS_20_u1 25.8984 _CNV_A_R_LINEAR_____34_CM 8 0. 25.8984 DISPLAY_IDENTIFIER LDPM_VB_IP_CPPWM_VB FORMAT "%3.1" /end AXIS_PTS
/begin AXIS_PTS ldp_cppwm_ref_ip_cppwm_cor_frq "" 0x07ad7 cppwm_ref _REC_AXS_20_u1 99.609375 _CNV_A_R_LINEAR_____10_CM 8 0. 99.609375 DISPLAY_IDENTIFIER LDP_CPPWM_REF_IP_CPPWM_COR_FRQ FORMAT "%5.1" /end AXIS_PTS
/begin MEASUREMENT state_t_sdl_cp "State of Time control function" UBYTE _CNV_S_7_RANGE_STAT_131_CM 1 100. 0. 6. DISPLAY_IDENTIFIER STATE_T_SDL_CP ECU_ADDRESS 0x3fdeb0 /end MEASUREMENT
/begin MEASUREMENT t_cp "Time of actual CP time range " UWORD _CNV_A_R_LINEAR_____24_CM 1 100. 0. 6553.5 DISPLAY_IDENTIFIER T_CP ECU_ADDRESS 0x3fced6 BYTE_ORDER MSB_LAST FORMAT "%6.1" /end MEASUREMENT
/begin MEASUREMENT t_max_cp "Maximum purge time " UWORD _CNV_A_R_LINEAR_____24_CM 1 100. 0. 6553.5 DISPLAY_IDENTIFIER T_MAX_CP ECU_ADDRESS 0x3fced8 BYTE_ORDER MSB_LAST FORMAT "%6.1" /end MEASUREMENT
/begin MEASUREMENT lv_mff_ad_ena "Lambda adaptation enabled " UBYTE _CNV_S_2_RANGE______0_CM 1 100. 0. 1. DISPLAY_IDENTIFIER LV_MFF_AD_ENA ECU_ADDRESS 0x3fdeb2 BIT_MASK 0x1 /end MEASUREMENT
/begin MEASUREMENT lv_cp_ena "Canister purge enabled " UBYTE _CNV_S_2_RANGE______0_CM 1 100. 0. 1. DISPLAY_IDENTIFIER LV_CP_ENA ECU_ADDRESS 0x3fdeb3 BIT_MASK 0x1 /end MEASUREMENT
/begin CHARACTERISTIC c_t_1_cp "Duration of first purge phase after engine start" VALUE 0x017a0 _REC_VAL_20_u2 6553.400000000001 _CNV_A_R_LINEAR_____24_CM 0.1 6553.5 DISPLAY_IDENTIFIER C_T_1_CP FORMAT "%6.1" /end CHARACTERISTIC
/begin CHARACTERISTIC c_t_2_cp "Duration of purge phase" VALUE 0x017a4 _REC_VAL_20_u2 6553.400000000001 _CNV_A_R_LINEAR_____24_CM 0.1 6553.5 DISPLAY_IDENTIFIER C_T_2_CP FORMAT "%6.1" /end CHARACTERISTIC
/begin CHARACTERISTIC c_t_di_cp "Disable time of purge phase when canister detected empty" VALUE 0x017d4 _REC_VAL_20_u2 6553.400000000001 _CNV_A_R_LINEAR_____24_CM 0.1 6553.5 DISPLAY_IDENTIFIER C_T_DI_CP FORMAT "%6.1" /end CHARACTERISTIC
/begin CHARACTERISTIC c_t_mff_ad_max "Time out for adaptation phase" VALUE 0x01870 _REC_VAL_20_u2 6553.400000000001 _CNV_A_R_LINEAR_____24_CM 0.1 6553.5 DISPLAY_IDENTIFIER C_T_MFF_AD_MAX FORMAT "%6.1" /end CHARACTERISTIC
/begin CHARACTERISTIC c_t_1_mff_ad "Duration of first lambda adaptation phase after engine start" VALUE 0x017a2 _REC_VAL_20_u2 6553.400000000001 _CNV_A_R_LINEAR_____24_CM 0.1 6553.5 DISPLAY_IDENTIFIER C_T_1_MFF_AD FORMAT "%6.1" /end CHARACTERISTIC
/begin CHARACTERISTIC c_cl_mmv_t_bol "Time Management canister load bottom limit" VALUE 0x014ba _REC_VAL_20_u2 1.99996948 _CNV_A_R_LINEAR_____21_CM 0. 1.99996948 DISPLAY_IDENTIFIER C_CL_MMV_T_BOL FORMAT "%7.5" /end CHARACTERISTIC
/begin CHARACTERISTIC c_cl_mmv_t_tol "Time management canister load top limit" VALUE 0x014bc _REC_VAL_20_u2 1.99996948 _CNV_A_R_LINEAR_____21_CM 0. 1.99996948 DISPLAY_IDENTIFIER C_CL_MMV_T_TOL FORMAT "%7.5" /end CHARACTERISTIC
/begin CHARACTERISTIC ip_t_max_cp__cl_mmv "Duration of maximum purge versus Canister Load" CURVE 0x0ea46 _REC_CUR_20_u2_u2 6553.400000000001 _CNV_A_R_LINEAR_____24_CM 0.1 6553.5 DISPLAY_IDENTIFIER IP_T_MAX_CP__CL_MMV FORMAT "%6.1"
 /begin AXIS_DESCR COM_AXIS cl_mmv _CNV_A_R_LINEAR_____21_CM 6 0. 1.99996948 FORMAT "%6.4" AXIS_PTS_REF ldp_cl_mmv_ip_t_max_cp /end AXIS_DESCR
/end CHARACTERISTIC
/begin AXIS_PTS ldp_cl_mmv_ip_t_max_cp "" 0x109a8 cl_mmv _REC_AXS_20_u2 1.99996948 _CNV_A_R_LINEAR_____21_CM 6 0. 1.99996948 DISPLAY_IDENTIFIER LDP_CL_MMV_IP_T_MAX_CP FORMAT "%6.4" /end AXIS_PTS
/begin MEASUREMENT t_ad "Time of actual lambda adaption time range" UWORD _CNV_A_R_LINEAR_____24_CM 1 100. 0. 6553.5 DISPLAY_IDENTIFIER T_AD ECU_ADDRESS 0x3fceda BYTE_ORDER MSB_LAST FORMAT "%6.1" /end MEASUREMENT
/begin MEASUREMENT t_max_ad "maximum adaption time " UWORD _CNV_A_R_LINEAR_____24_CM 1 100. 0. 6553.5 DISPLAY_IDENTIFIER T_MAX_AD ECU_ADDRESS 0x3fcedc BYTE_ORDER MSB_LAST FORMAT "%6.1" /end MEASUREMENT
/begin CHARACTERISTIC c_t_2_mff_ad "Duration of second lambda adaptation phase after engine start" VALUE 0x017a6 _REC_VAL_20_u2 6553.400000000001 _CNV_A_R_LINEAR_____24_CM 0.1 6553.5 DISPLAY_IDENTIFIER C_T_2_MFF_AD FORMAT "%6.1" /end CHARACTERISTIC
/begin CHARACTERISTIC c_t_4_mff_ad "Duration of fourth lambda adaptation phase after engine start" VALUE 0x017aa _REC_VAL_20_u2 6553.400000000001 _CNV_A_R_LINEAR_____24_CM 0.1 6553.5 DISPLAY_IDENTIFIER C_T_4_MFF_AD FORMAT "%6.1" /end CHARACTERISTIC
/begin CHARACTERISTIC c_t_3_mff_ad "Duration of third lambda adaptation phase after engine start" VALUE 0x017a8 _REC_VAL_20_u2 6553.400000000001 _CNV_A_R_LINEAR_____24_CM 0.1 6553.5 DISPLAY_IDENTIFIER C_T_3_MFF_AD FORMAT "%6.1" /end CHARACTERISTIC
/begin CHARACTERISTIC c_thd_t_ast_2_mff_ad "Begin of second lambda adaptation phase after leaving start" VALUE 0x0190e _REC_VAL_20_u2 6553.400000000001 _CNV_A_R_LINEAR_____24_CM 0.1 6553.5 DISPLAY_IDENTIFIER C_THD_T_AST_2_MFF_AD FORMAT "%6.1" /end CHARACTERISTIC
/begin CHARACTERISTIC c_thd_t_ast_3_mff_ad "Begin of third lambda adaptation phase after leaving start" VALUE 0x01910 _REC_VAL_20_u2 6553.400000000001 _CNV_A_R_LINEAR_____24_CM 0.1 6553.5 DISPLAY_IDENTIFIER C_THD_T_AST_3_MFF_AD FORMAT "%6.1" /end CHARACTERISTIC
/begin CHARACTERISTIC c_thd_t_ast_4_mff_ad "Begin of fourth  lambda adaptation phase after leaving start" VALUE 0x01912 _REC_VAL_20_u2 6553.400000000001 _CNV_A_R_LINEAR_____24_CM 0.1 6553.5 DISPLAY_IDENTIFIER C_THD_T_AST_4_MFF_AD FORMAT "%6.1" /end CHARACTERISTIC
/begin MEASUREMENT lv_ebox_cfa "control bit EBOX cooling fan" UBYTE _CNV_S_2_RANGE______5_CM 1 100. 0. 1. DISPLAY_IDENTIFIER LV_EBOX_CFA ECU_ADDRESS 0x3fe3b6 BIT_MASK 0x1 /end MEASUREMENT
/begin CHARACTERISTIC c_tecu_thd_ebox_cfa "TECU threshold for EBOX cooling fan ON" VALUE 0x008b3 _REC_VAL_20_u1 190.5 _CNV_A_R_LINEAR_____12_CM -48. 142.5 DISPLAY_IDENTIFIER C_TECU_THD_EBOX_CFA FORMAT "%5.1" /end CHARACTERISTIC
/begin CHARACTERISTIC c_tecu_hys_ebox_cfa "TECU hysteresis for EBOX cooling fan" VALUE 0x008b1 _REC_VAL_20_u1 190.5 _CNV_A_R_LINEAR_____13_CM 0. 190.5 DISPLAY_IDENTIFIER C_TECU_HYS_EBOX_CFA FORMAT "%5.1" /end CHARACTERISTIC
/begin CHARACTERISTIC c_tia_thd_ebox_cfa "TIA threshold for EBOX cooling fan ON" VALUE 0x008db _REC_VAL_20_u1 190.5 _CNV_A_R_LINEAR_____12_CM -48. 142.5 DISPLAY_IDENTIFIER C_TIA_THD_EBOX_CFA FORMAT "%5.1" /end CHARACTERISTIC
/begin CHARACTERISTIC c_tia_hys_ebox_cfa "TIA hysteresis for EBOX cooling fan" VALUE 0x008cc _REC_VAL_20_u1 190.5 _CNV_A_R_LINEAR_____13_CM 0. 190.5 DISPLAY_IDENTIFIER C_TIA_HYS_EBOX_CFA FORMAT "%5.1" /end CHARACTERISTIC
/begin CHARACTERISTIC c_t_max_ebox_cfa_act "maximum time for activation of EBOX_CFA after Kl.15 on (for diagnosis)" VALUE 0x0081c _REC_VAL_20_u1 255. _CNV_A_R_LINEAR_____30_CM 0. 255. DISPLAY_IDENTIFIER C_T_MAX_EBOX_CFA_ACT FORMAT "%3.0" /end CHARACTERISTIC
/begin CHARACTERISTIC c_n_thd_ebox_cfa_act "N threshold for activation of EBOX_CFA after Kl.15 on (for diagnosis)" VALUE 0x01722 _REC_VAL_20_u2 8160. _CNV_A_R_LINEAR_____11_CM 0. 8160. DISPLAY_IDENTIFIER C_N_THD_EBOX_CFA_ACT FORMAT "%4.0" /end CHARACTERISTIC
/begin MEASUREMENT lv_cdn_ecras_on "Condition bit for radiator air flaps to be closed" UBYTE _CNV_S_2_RANGE______0_CM 1 100. 0. 1. DISPLAY_IDENTIFIER LV_CDN_ECRAS_ON ECU_ADDRESS 0x3fe3d0 BIT_MASK 0x1 /end MEASUREMENT
/begin MEASUREMENT lv_cdn_ecras_off "Condition bit for radiator air flaps to be opened" UBYTE _CNV_S_2_RANGE______0_CM 1 100. 0. 1. DISPLAY_IDENTIFIER LV_CDN_ECRAS_OFF ECU_ADDRESS 0x3fe3d1 BIT_MASK 0x1 /end MEASUREMENT
/begin MEASUREMENT lv_ecras_off "Auxillary bit : openeing of air flap enabled/disabled" UBYTE _CNV_S_2_RANGE______0_CM 1 100. 0. 1. DISPLAY_IDENTIFIER LV_ECRAS_OFF ECU_ADDRESS 0x3fe3d3 BIT_MASK 0x1 /end MEASUREMENT
/begin MEASUREMENT lv_ecras_on "Auxillary bit : openeing of air flap enabled/disabled" UBYTE _CNV_S_2_RANGE______0_CM 1 100. 0. 1. DISPLAY_IDENTIFIER LV_ECRAS_ON ECU_ADDRESS 0x3fe3d2 BIT_MASK 0x1 /end MEASUREMENT
/begin MEASUREMENT lv_ecras "Indication of ait flaps to be closed" UBYTE _CNV_S_2_RANGE______0_CM 1 100. 0. 1. DISPLAY_IDENTIFIER LV_ECRAS ECU_ADDRESS 0x3fe3d4 BIT_MASK 0x1 /end MEASUREMENT
/begin MEASUREMENT ctr_t_dly_ecras_on "Delay time for closing the air flaps" UBYTE _CNV_A_R_LINEAR_____30_CM 1 100. 0. 255. DISPLAY_IDENTIFIER CTR_T_DLY_ECRAS_ON ECU_ADDRESS 0x3fe3ce FORMAT "%3.0" /end MEASUREMENT
/begin MEASUREMENT ctr_t_dly_ecras_off "Delay time for opening the air flaps" UBYTE _CNV_A_R_LINEAR_____30_CM 1 100. 0. 255. DISPLAY_IDENTIFIER CTR_T_DLY_ECRAS_OFF ECU_ADDRESS 0x3fe3cf FORMAT "%3.0" /end MEASUREMENT
/begin CHARACTERISTIC c_t_dly_max_ecras_on "" VALUE 0x00801 _REC_VAL_20_u1 255. _CNV_A_R_LINEAR_____30_CM 0. 255. DISPLAY_IDENTIFIER C_T_DLY_MAX_ECRAS_ON FORMAT "%3.0" /end CHARACTERISTIC
/begin CHARACTERISTIC c_t_dly_max_ecras_off "" VALUE 0x00800 _REC_VAL_20_u1 255. _CNV_A_R_LINEAR_____30_CM 0. 255. DISPLAY_IDENTIFIER C_T_DLY_MAX_ECRAS_OFF FORMAT "%3.0" /end CHARACTERISTIC
/begin CHARACTERISTIC c_n_32_ecras_on "" VALUE 0x00750 _REC_VAL_20_u1 8160. _CNV_A_R_LINEAR_____16_CM 0. 8160. DISPLAY_IDENTIFIER C_N_32_ECRAS_ON FORMAT "%4.0" /end CHARACTERISTIC
/begin CHARACTERISTIC c_vs_fil_ecras_on "" VALUE 0x01a4c _REC_VAL_20_u2 511.99218 _CNV_A_R_LINEAR_____85_CM 0. 511.99218 DISPLAY_IDENTIFIER C_VS_FIL_ECRAS_ON FORMAT "%7.3" /end CHARACTERISTIC
/begin CHARACTERISTIC c_tco_ex_ecras_on "" VALUE 0x0086b _REC_VAL_20_u1 190.5 _CNV_A_R_LINEAR_____12_CM -48. 142.5 DISPLAY_IDENTIFIER C_TCO_EX_ECRAS_ON FORMAT "%5.1" /end CHARACTERISTIC
/begin CHARACTERISTIC c_tco_ex_ecras_off "" VALUE 0x0086a _REC_VAL_20_u1 190.5 _CNV_A_R_LINEAR_____12_CM -48. 142.5 DISPLAY_IDENTIFIER C_TCO_EX_ECRAS_OFF FORMAT "%5.1" /end CHARACTERISTIC
/begin CHARACTERISTIC c_n_ecf_ecras_on "" VALUE 0x00766 _REC_VAL_20_u1 15. _CNV_A_R_LINEAR_____1_CM 0. 15. DISPLAY_IDENTIFIER C_N_ECF_ECRAS_ON FORMAT "%2.0" /end CHARACTERISTIC
/begin CHARACTERISTIC c_n_ecf_ecras_off "" VALUE 0x00765 _REC_VAL_20_u1 15. _CNV_A_R_LINEAR_____1_CM 0. 15. DISPLAY_IDENTIFIER C_N_ECF_ECRAS_OFF FORMAT "%2.0" /end CHARACTERISTIC
/begin CHARACTERISTIC c_tia_ecras_on "" VALUE 0x008ca _REC_VAL_20_u1 190.5 _CNV_A_R_LINEAR_____12_CM -48. 142.5 DISPLAY_IDENTIFIER C_TIA_ECRAS_ON FORMAT "%5.1" /end CHARACTERISTIC
/begin CHARACTERISTIC c_tia_ecras_off "" VALUE 0x008c9 _REC_VAL_20_u1 190.5 _CNV_A_R_LINEAR_____12_CM -48. 142.5 DISPLAY_IDENTIFIER C_TIA_ECRAS_OFF FORMAT "%5.1" /end CHARACTERISTIC
/begin CHARACTERISTIC c_temp_gb_ecras_on "" VALUE 0x008b6 _REC_VAL_20_u1 254. _CNV_A_R_LINEAR_____180_CM -40. 214. DISPLAY_IDENTIFIER C_TEMP_GB_ECRAS_ON FORMAT "%3.0" /end CHARACTERISTIC
/begin CHARACTERISTIC c_temp_gb_ecras_off "" VALUE 0x008b5 _REC_VAL_20_u1 254. _CNV_A_R_LINEAR_____180_CM -40. 214. DISPLAY_IDENTIFIER C_TEMP_GB_ECRAS_OFF FORMAT "%3.0" /end CHARACTERISTIC
/begin CHARACTERISTIC c_ectpwm_ecras_on "" VALUE 0x006b4 _REC_VAL_20_u1 99.609375 _CNV_A_R_LINEAR_____10_CM 0. 99.609375 DISPLAY_IDENTIFIER C_ECTPWM_ECRAS_ON FORMAT "%4.1" /end CHARACTERISTIC
/begin CHARACTERISTIC c_ectpwm_ecras_off "" VALUE 0x006b3 _REC_VAL_20_u1 99.609375 _CNV_A_R_LINEAR_____10_CM 0. 99.609375 DISPLAY_IDENTIFIER C_ECTPWM_ECRAS_OFF FORMAT "%4.1" /end CHARACTERISTIC
/begin CHARACTERISTIC lc_ecras_err_tco "Switch for LV_ERR_TCO as additional input variable" VALUE 0x00f13 _REC_VAL_20_u1 1. _CNV_S_2_RANGE______5_CM 0. 1. DISPLAY_IDENTIFIER LC_ECRAS_ERR_TCO /end CHARACTERISTIC
/begin CHARACTERISTIC lc_inh_ecras "Switch for LV_ERR_TCO as additional input variable" VALUE 0x00f2e _REC_VAL_20_u1 1. _CNV_S_2_RANGE______5_CM 0. 1. DISPLAY_IDENTIFIER LC_INH_ECRAS /end CHARACTERISTIC
/begin CHARACTERISTIC c_vs_fil_ecras_off "" VALUE 0x01a4a _REC_VAL_20_u2 511.99218 _CNV_A_R_LINEAR_____85_CM 0. 511.99218 DISPLAY_IDENTIFIER C_VS_FIL_ECRAS_OFF FORMAT "%7.3" /end CHARACTERISTIC
/begin MEASUREMENT lv_err_ivvt "Global error flag IVVT" UBYTE _CNV_S_2_RANGE______2_R_CM 1 100. 0. 255. DISPLAY_IDENTIFIER LV_ERR_IVVT ECU_ADDRESS 0x3fdfe0 /end MEASUREMENT
/begin MEASUREMENT lv_err_mec_ivvt_in_1 "IVVT 1 Error flag" UBYTE _CNV_S_2_RANGE______2_R_CM 1 100. 0. 255. DISPLAY_IDENTIFIER LV_ERR_MEC_IVVT_IN_1 ECU_ADDRESS 0x3fb870 /end MEASUREMENT
/begin MEASUREMENT lv_err_ref_ivvt_in_1 "IVVT 1 Error flag" UBYTE _CNV_S_2_RANGE______2_R_CM 1 100. 0. 255. DISPLAY_IDENTIFIER LV_ERR_REF_IVVT_IN_1 ECU_ADDRESS 0x3fb878 /end MEASUREMENT
/begin MEASUREMENT lv_err_mec_ivvt_ex_1 "IVVT 1 Error flag" UBYTE _CNV_S_2_RANGE______2_R_CM 1 100. 0. 255. DISPLAY_IDENTIFIER LV_ERR_MEC_IVVT_EX_1 ECU_ADDRESS 0x3fb874 /end MEASUREMENT
/begin MEASUREMENT lv_err_ref_ivvt_ex_1 "IVVT 1 Error flag" UBYTE _CNV_S_2_RANGE______2_R_CM 1 100. 0. 255. DISPLAY_IDENTIFIER LV_ERR_REF_IVVT_EX_1 ECU_ADDRESS 0x3fb87c /end MEASUREMENT
/begin CHARACTERISTIC c_t_dly_diag_ref_ivvt "Delaytime before IVVT" VALUE 0x007f2 _REC_VAL_20_u1 25.5 _CNV_A_R_LINEAR_____24_CM 0. 25.5 DISPLAY_IDENTIFIER C_T_DLY_DIAG_REF_IVVT FORMAT "%4.1" /end CHARACTERISTIC
/begin CHARACTERISTIC c_cam_hys_diag_ivvt "Threshold for diagnosis IVVT mechanical reference position" VALUE 0x005f6 _REC_VAL_20_u1 47.625 _CNV_A_R_LINEAR_____82_CM 0. 47.625 DISPLAY_IDENTIFIER C_CAM_HYS_DIAG_IVVT /end CHARACTERISTIC
/begin CHARACTERISTIC c_ctr_thd_ivvt_park "Maximum treshold for activation of IVVT parking function despite too high setpoint deviation or drift " VALUE 0x01500 _REC_VAL_20_u2 65535. _CNV_A_R_LINEAR_____1_CM 0. 65535. DISPLAY_IDENTIFIER C_CTR_THD_IVVT_PARK FORMAT "%5.0" /end CHARACTERISTIC
/begin MEASUREMENT lv_err_park_ivvt_in_1 "Error flag for park position error CAM IN 1" UBYTE _CNV_S_2_RANGE______2_R_CM 1 100. 0. 255. DISPLAY_IDENTIFIER LV_ERR_PARK_IVVT_IN_1 ECU_ADDRESS 0x3fb888 /end MEASUREMENT
/begin MEASUREMENT lv_err_park_ivvt_ex_1 "Error flag for park position error CAM EX 1" UBYTE _CNV_S_2_RANGE______2_R_CM 1 100. 0. 255. DISPLAY_IDENTIFIER LV_ERR_PARK_IVVT_EX_1 ECU_ADDRESS 0x3fb88c /end MEASUREMENT
/begin AXIS_PTS ldpm_n_13 "" 0x11864 n _REC_AXS_20_u2 8160. _CNV_A_R_LINEAR_____11_CM 6 0. 8160. DISPLAY_IDENTIFIER LDPM_N_13 FORMAT "%4.0" /end AXIS_PTS
/begin AXIS_PTS ldpm_n_5 "" 0x118f0 n _REC_AXS_20_u2 8160. _CNV_A_R_LINEAR_____11_CM 16 0. 8160. DISPLAY_IDENTIFIER LDPM_N_5 FORMAT "%4.0" /end AXIS_PTS
/begin AXIS_PTS ldpm_maf_ivvt_2 "" 0x117ae maf _REC_AXS_20_u2 1389. _CNV_A_R_LINEAR_____106_CM 12 0. 1389. DISPLAY_IDENTIFIER LDPM_MAF_IVVT_2 FORMAT "%7.2" /end AXIS_PTS
/begin MEASUREMENT ivvt_in.struct_sp_afl_ivvt.cam_sp_av_afl "Camshaft setpoint for homogeneous lean combustion -intake cam" SWORD _CNV_A_R_LINEAR_____227_CM 1 100. -768. 767.9765625 DISPLAY_IDENTIFIER CAM_SP_AV_IN_AFL ECU_ADDRESS 0x3fc0b0 BYTE_ORDER MSB_LAST FORMAT "%7.2" /end MEASUREMENT
/begin MEASUREMENT ivvt_in.struct_sp_s_ivvt.cam_sp_av_s "Exhaust camshaft target spread for stratified combustion" SWORD _CNV_A_R_LINEAR_____227_CM 1 100. -768. 767.9765625 DISPLAY_IDENTIFIER CAM_SP_AV_IN_S ECU_ADDRESS 0x3fc0ae BYTE_ORDER MSB_LAST FORMAT "%7.2" /end MEASUREMENT
/begin MEASUREMENT ivvt_in_1.struct_raw_ivvt.cam_raw "Raw value of current inlet CAM position (distance maximum valve lift GTDC)" UBYTE _CNV_A_R_LINEAR_____229_CM 1 100. 60. 155.625 DISPLAY_IDENTIFIER CAM_RAW_IN_1 ECU_ADDRESS 0x3fbf9c FORMAT "%5.1" /end MEASUREMENT
/begin MEASUREMENT ivvt_in_1.struct_raw_ivvt.cam_edge_nr "Number of CAM edge detected at current inlet CAM position" UBYTE _CNV_A_R_LINEAR_____1_CM 1 100. 0. 255. DISPLAY_IDENTIFIER CAM_EDGE_NR_IN_1 ECU_ADDRESS 0x3fbf9d FORMAT "%3.0" /end MEASUREMENT
/begin MEASUREMENT ivvt_in_1.struct_raw_ivvt.cam_psn_cap_save_ivvt "captured system time at inlet CAM edge" ULONG _CNV_A_R_LINEAR_____243_CM 1 100. 0. 17179869180. DISPLAY_IDENTIFIER CAM_PSN_CAP_SAVE_IVVT_IN_1 ECU_ADDRESS 0x3fbfa0 BYTE_ORDER MSB_LAST FORMAT "%11.0" /end MEASUREMENT
/begin MEASUREMENT ivvt_ex_1.struct_raw_ivvt.cam_raw "Raw value of current exhaust CAM position (distance maximum valve lift GTDC)" UBYTE _CNV_A_R_LINEAR_____226_CM 1 100. -40. -135.625 DISPLAY_IDENTIFIER CAM_RAW_EX_1 ECU_ADDRESS 0x3fc0b8 FORMAT "%5.1" /end MEASUREMENT
/begin MEASUREMENT ivvt_ex_1.struct_raw_ivvt.cam_edge_nr "Number of CAM edge detected at current exhaust CAM position" UBYTE _CNV_A_R_LINEAR_____1_CM 1 100. 0. 255. DISPLAY_IDENTIFIER CAM_EDGE_NR_EX_1 ECU_ADDRESS 0x3fc0b9 FORMAT "%3.0" /end MEASUREMENT
/begin MEASUREMENT ivvt_ex_1.struct_raw_ivvt.cam_psn_cap_save_ivvt "captured system time at exhaust CAM edge" ULONG _CNV_A_R_LINEAR_____243_CM 1 100. 0. 17179869180. DISPLAY_IDENTIFIER CAM_PSN_CAP_SAVE_IVVT_EX_1 ECU_ADDRESS 0x3fc0bc BYTE_ORDER MSB_LAST FORMAT "%11.0" /end MEASUREMENT
/begin MEASUREMENT ivvt_ex.struct_sp_afl_ivvt.cam_sp_av_afl "Camshaft setpoint for homogeneous lean combustion -intake cam" SWORD _CNV_A_R_LINEAR_____227_CM 1 100. -768. 767.9765625 DISPLAY_IDENTIFIER CAM_SP_AV_EX_AFL ECU_ADDRESS 0x3fc1cc BYTE_ORDER MSB_LAST FORMAT "%7.2" /end MEASUREMENT
/begin MEASUREMENT ivvt_ex.struct_sp_s_ivvt.cam_sp_av_s "Exhaust camshaft target spread for stratified combustion" SWORD _CNV_A_R_LINEAR_____227_CM 1 100. -768. 767.9765625 DISPLAY_IDENTIFIER CAM_SP_AV_EX_S ECU_ADDRESS 0x3fc1ca BYTE_ORDER MSB_LAST FORMAT "%7.2" /end MEASUREMENT
/begin CHARACTERISTIC id_cam_0_seg_ofs__cam_edge_nr "" CURVE 0x01a5a _REC_CUR_20_u2_u1 24575.625 _CNV_A_R_LINEAR_____245_CM -12288. 12287.625 DISPLAY_IDENTIFIER ID_CAM_0_SEG_OFS__CAM_EDGE_NR FORMAT "%7.1"
 /begin AXIS_DESCR COM_AXIS online_dummy _CNV_A_R_LINEAR_____1_CM 4 0. 3. FORMAT "%2.0" AXIS_PTS_REF ldpm_cam_edge_nr /end AXIS_DESCR
/end CHARACTERISTIC
/begin CHARACTERISTIC id_cam_1_seg_ofs__cam_edge_nr "" CURVE 0x01a62 _REC_CUR_20_u2_u1 24575.625 _CNV_A_R_LINEAR_____245_CM -12288. 12287.625 DISPLAY_IDENTIFIER ID_CAM_1_SEG_OFS__CAM_EDGE_NR FORMAT "%7.1"
 /begin AXIS_DESCR COM_AXIS online_dummy _CNV_A_R_LINEAR_____1_CM 4 0. 3. FORMAT "%2.0" AXIS_PTS_REF ldpm_cam_edge_nr /end AXIS_DESCR
/end CHARACTERISTIC
/begin CHARACTERISTIC c_n_max_ivvt_1 "" VALUE 0x016fe _REC_VAL_20_u2 8160. _CNV_A_R_LINEAR_____11_CM 0. 8160. DISPLAY_IDENTIFIER C_N_MAX_IVVT_1 FORMAT "%4.0" /end CHARACTERISTIC
/begin CHARACTERISTIC c_n_max_ivvt_2 "" VALUE 0x01700 _REC_VAL_20_u2 8160. _CNV_A_R_LINEAR_____11_CM 0. 8160. DISPLAY_IDENTIFIER C_N_MAX_IVVT_2 FORMAT "%4.0" /end CHARACTERISTIC
/begin AXIS_PTS ldpm_cam_edge_nr "" 0x012b9 online_dummy _REC_AXS_20_u1 3. _CNV_A_R_LINEAR_____1_CM 4 0. 3. DISPLAY_IDENTIFIER LDPM_CAM_EDGE_NR FORMAT "%2.0" /end AXIS_PTS
/begin CHARACTERISTIC ip_cam_sp_1_ex_afl__n__maf_ivvt "Target spread for thermal condition 1,hom, lean, exhaust camschaft" MAP 0x040aa _REC_MAP_20_u1_u2_u2 -95.625 _CNV_A_R_LINEAR_____226_CM -40. -135.625 DISPLAY_IDENTIFIER IP_CAM_SP_1_EX_AFL__N__MAF_IVVT FORMAT "%5.1"
 /begin AXIS_DESCR COM_AXIS n _CNV_A_R_LINEAR_____11_CM 16 0. 8160. FORMAT "%4.0" AXIS_PTS_REF ldpm_n_5 /end AXIS_DESCR
 /begin AXIS_DESCR COM_AXIS maf _CNV_A_R_LINEAR_____106_CM 12 0. 1389. FORMAT "%7.2" AXIS_PTS_REF ldpm_maf_ivvt_2 /end AXIS_DESCR
/end CHARACTERISTIC
/begin CHARACTERISTIC ip_cam_sp_2_ex_afl__n__maf_ivvt "Target spread for thermal condition 2,hom, lean, exhaust camschaft" MAP 0x044a2 _REC_MAP_20_u1_u2_u2 -95.625 _CNV_A_R_LINEAR_____226_CM -40. -135.625 DISPLAY_IDENTIFIER IP_CAM_SP_2_EX_AFL__N__MAF_IVVT FORMAT "%5.1"
 /begin AXIS_DESCR COM_AXIS n _CNV_A_R_LINEAR_____11_CM 16 0. 8160. FORMAT "%4.0" AXIS_PTS_REF ldpm_n_5 /end AXIS_DESCR
 /begin AXIS_DESCR COM_AXIS maf _CNV_A_R_LINEAR_____106_CM 12 0. 1389. FORMAT "%7.2" AXIS_PTS_REF ldpm_maf_ivvt_2 /end AXIS_DESCR
/end CHARACTERISTIC
/begin CHARACTERISTIC ip_cam_sp_2_in_afl__n__maf_ivvt "Target spread for thermal condition 2,hom, lean, intaket camschaft" MAP 0x0469e _REC_MAP_20_u1_u2_u2 95.625 _CNV_A_R_LINEAR_____229_CM 60. 155.625 DISPLAY_IDENTIFIER IP_CAM_SP_2_IN_AFL__N__MAF_IVVT FORMAT "%5.1"
 /begin AXIS_DESCR COM_AXIS n _CNV_A_R_LINEAR_____11_CM 16 0. 8160. FORMAT "%4.0" AXIS_PTS_REF ldpm_n_5 /end AXIS_DESCR
 /begin AXIS_DESCR COM_AXIS maf _CNV_A_R_LINEAR_____106_CM 12 0. 1389. FORMAT "%7.2" AXIS_PTS_REF ldpm_maf_ivvt_2 /end AXIS_DESCR
/end CHARACTERISTIC
/begin CHARACTERISTIC ip_cam_sp_1_in_afl__n__maf_ivvt "Target spread for thermal condition 1,hom, lean, intaket camschaft" MAP 0x042a6 _REC_MAP_20_u1_u2_u2 95.625 _CNV_A_R_LINEAR_____229_CM 60. 155.625 DISPLAY_IDENTIFIER IP_CAM_SP_1_IN_AFL__N__MAF_IVVT FORMAT "%5.1"
 /begin AXIS_DESCR COM_AXIS n _CNV_A_R_LINEAR_____11_CM 16 0. 8160. FORMAT "%4.0" AXIS_PTS_REF ldpm_n_5 /end AXIS_DESCR
 /begin AXIS_DESCR COM_AXIS maf _CNV_A_R_LINEAR_____106_CM 12 0. 1389. FORMAT "%7.2" AXIS_PTS_REF ldpm_maf_ivvt_2 /end AXIS_DESCR
/end CHARACTERISTIC
/begin MEASUREMENT mff_mmv "low pass filtered value for fuel mass flow" UWORD _CNV_A_R_LINEAR_____106_CM 1 100. 0. 1389. DISPLAY_IDENTIFIER MFF_MMV ECU_ADDRESS 0x3fd040 BYTE_ORDER MSB_LAST FORMAT "%7.2" /end MEASUREMENT
/begin CHARACTERISTIC ip_cam_sp_1_in_is_s__n__mff_mmv "Stratified target overlap for TCO_1, idle, intake camschaft" MAP 0x0439a _REC_MAP_20_u1_u2_u2 95.625 _CNV_A_R_LINEAR_____229_CM 60. 155.625 DISPLAY_IDENTIFIER IP_CAM_SP_1_IN_IS_S__N__MFF_MMV FORMAT "%5.1"
 /begin AXIS_DESCR COM_AXIS n _CNV_A_R_LINEAR_____11_CM 6 0. 8160. FORMAT "%4.0" AXIS_PTS_REF ldpm_n_13 /end AXIS_DESCR
 /begin AXIS_DESCR COM_AXIS mff_mmv _CNV_A_R_LINEAR_____106_CM 6 0. 1389. FORMAT "%7.2" AXIS_PTS_REF ldpm_mff_mmv /end AXIS_DESCR
/end CHARACTERISTIC
/begin CHARACTERISTIC ip_cam_sp_2_in_is_s__n__mff_mmv "Stratified target overlap for TCO_2, idle, intake camschaft" MAP 0x04792 _REC_MAP_20_u1_u2_u2 95.625 _CNV_A_R_LINEAR_____229_CM 60. 155.625 DISPLAY_IDENTIFIER IP_CAM_SP_2_IN_IS_S__N__MFF_MMV FORMAT "%5.1"
 /begin AXIS_DESCR COM_AXIS n _CNV_A_R_LINEAR_____11_CM 6 0. 8160. FORMAT "%4.0" AXIS_PTS_REF ldpm_n_13 /end AXIS_DESCR
 /begin AXIS_DESCR COM_AXIS mff_mmv _CNV_A_R_LINEAR_____106_CM 6 0. 1389. FORMAT "%7.2" AXIS_PTS_REF ldpm_mff_mmv /end AXIS_DESCR
/end CHARACTERISTIC
/begin CHARACTERISTIC ip_cam_sp_2_in_pl_s__n__mff_mmv "Stratified target overlap for TCO_2, PL, intake camschaft" MAP 0x04876 _REC_MAP_20_u1_u2_u2 95.625 _CNV_A_R_LINEAR_____229_CM 60. 155.625 DISPLAY_IDENTIFIER IP_CAM_SP_2_IN_PL_S__N__MFF_MMV FORMAT "%5.1"
 /begin AXIS_DESCR COM_AXIS n _CNV_A_R_LINEAR_____11_CM 6 0. 8160. FORMAT "%4.0" AXIS_PTS_REF ldpm_n_13 /end AXIS_DESCR
 /begin AXIS_DESCR COM_AXIS mff_mmv _CNV_A_R_LINEAR_____106_CM 6 0. 1389. FORMAT "%7.2" AXIS_PTS_REF ldpm_mff_mmv /end AXIS_DESCR
/end CHARACTERISTIC
/begin CHARACTERISTIC ip_cam_sp_1_in_pl_s__n__mff_mmv "Stratified target overlap for TCO_1, PL, intake camschaft" MAP 0x0447e _REC_MAP_20_u1_u2_u2 95.625 _CNV_A_R_LINEAR_____229_CM 60. 155.625 DISPLAY_IDENTIFIER IP_CAM_SP_1_IN_PL_S__N__MFF_MMV FORMAT "%5.1"
 /begin AXIS_DESCR COM_AXIS n _CNV_A_R_LINEAR_____11_CM 6 0. 8160. FORMAT "%4.0" AXIS_PTS_REF ldpm_n_13 /end AXIS_DESCR
 /begin AXIS_DESCR COM_AXIS mff_mmv _CNV_A_R_LINEAR_____106_CM 6 0. 1389. FORMAT "%7.2" AXIS_PTS_REF ldpm_mff_mmv /end AXIS_DESCR
/end CHARACTERISTIC
/begin CHARACTERISTIC ip_cam_sp_1_ex_is_s__n__mff_mmv "Stratified target overlap for TCO_1,IS , exhaust camschaft" MAP 0x0419e _REC_MAP_20_u1_u2_u2 -95.625 _CNV_A_R_LINEAR_____226_CM -40. -135.625 DISPLAY_IDENTIFIER IP_CAM_SP_1_EX_IS_S__N__MFF_MMV FORMAT "%5.1"
 /begin AXIS_DESCR COM_AXIS n _CNV_A_R_LINEAR_____11_CM 6 0. 8160. FORMAT "%4.0" AXIS_PTS_REF ldpm_n_13 /end AXIS_DESCR
 /begin AXIS_DESCR COM_AXIS mff_mmv _CNV_A_R_LINEAR_____106_CM 6 0. 1389. FORMAT "%7.2" AXIS_PTS_REF ldpm_mff_mmv /end AXIS_DESCR
/end CHARACTERISTIC
/begin CHARACTERISTIC ip_cam_sp_2_ex_is_s__n__mff_mmv "Stratified target overlap for TCO_2,IS , exhaust camschaft" MAP 0x04596 _REC_MAP_20_u1_u2_u2 -95.625 _CNV_A_R_LINEAR_____226_CM -40. -135.625 DISPLAY_IDENTIFIER IP_CAM_SP_2_EX_IS_S__N__MFF_MMV FORMAT "%5.1"
 /begin AXIS_DESCR COM_AXIS n _CNV_A_R_LINEAR_____11_CM 6 0. 8160. FORMAT "%4.0" AXIS_PTS_REF ldpm_n_13 /end AXIS_DESCR
 /begin AXIS_DESCR COM_AXIS mff_mmv _CNV_A_R_LINEAR_____106_CM 6 0. 1389. FORMAT "%7.2" AXIS_PTS_REF ldpm_mff_mmv /end AXIS_DESCR
/end CHARACTERISTIC
/begin CHARACTERISTIC ip_cam_sp_2_ex_pl_s__n__mff_mmv "Stratified target overlap for TCO_2, PL , exhaust camschaft" MAP 0x0467a _REC_MAP_20_u1_u2_u2 -95.625 _CNV_A_R_LINEAR_____226_CM -40. -135.625 DISPLAY_IDENTIFIER IP_CAM_SP_2_EX_PL_S__N__MFF_MMV FORMAT "%5.1"
 /begin AXIS_DESCR COM_AXIS n _CNV_A_R_LINEAR_____11_CM 6 0. 8160. FORMAT "%4.0" AXIS_PTS_REF ldpm_n_13 /end AXIS_DESCR
 /begin AXIS_DESCR COM_AXIS mff_mmv _CNV_A_R_LINEAR_____106_CM 6 0. 1389. FORMAT "%7.2" AXIS_PTS_REF ldpm_mff_mmv /end AXIS_DESCR
/end CHARACTERISTIC
/begin CHARACTERISTIC ip_cam_sp_1_ex_pl_s__n__mff_mmv "Stratified target overlap for TCO_1, PL , exhaust camschaft" MAP 0x04282 _REC_MAP_20_u1_u2_u2 -95.625 _CNV_A_R_LINEAR_____226_CM -40. -135.625 DISPLAY_IDENTIFIER IP_CAM_SP_1_EX_PL_S__N__MFF_MMV FORMAT "%5.1"
 /begin AXIS_DESCR COM_AXIS n _CNV_A_R_LINEAR_____11_CM 6 0. 8160. FORMAT "%4.0" AXIS_PTS_REF ldpm_n_13 /end AXIS_DESCR
 /begin AXIS_DESCR COM_AXIS mff_mmv _CNV_A_R_LINEAR_____106_CM 6 0. 1389. FORMAT "%7.2" AXIS_PTS_REF ldpm_mff_mmv /end AXIS_DESCR
/end CHARACTERISTIC
/begin CHARACTERISTIC c_crlc_mff_sp_s "correlation constant for low pass filterd mass fuel flow stratified" VALUE 0x014d8 _REC_VAL_20_u2 0.99998474 _CNV_A_R_LINEAR_____37_CM 0. 0.99998474 DISPLAY_IDENTIFIER C_CRLC_MFF_SP_S FORMAT "%7.5" /end CHARACTERISTIC
/begin AXIS_PTS ldpm_mff_mmv "" 0x11812 mff_mmv _REC_AXS_20_u2 1389. _CNV_A_R_LINEAR_____106_CM 6 0. 1389. DISPLAY_IDENTIFIER LDPM_MFF_MMV FORMAT "%7.2" /end AXIS_PTS
/begin CHARACTERISTIC id_maf_tab "conversion table for MAF value" MAP 0x083f4 _REC_MAP_20_u2_u1_u1 1023.984375 _CNV_A_R_LINEAR_____47_CM 0. 1023.984375 DISPLAY_IDENTIFIER ID_MAF_TAB FORMAT "%7.2"
 /begin AXIS_DESCR COM_AXIS online_dummy _CNV_A_R_LINEAR_____1_CM 16 0. 255. FORMAT "%3.0" AXIS_PTS_REF ldp_id_maf_tab_1 /end AXIS_DESCR
 /begin AXIS_DESCR COM_AXIS online_dummy _CNV_A_R_LINEAR_____1_CM 16 0. 255. FORMAT "%3.0" AXIS_PTS_REF ldp_id_maf_tab_2 /end AXIS_DESCR
/end CHARACTERISTIC
/begin AXIS_PTS ldp_id_maf_tab_1 "" 0x07b00 online_dummy _REC_AXS_20_u1 255. _CNV_A_R_LINEAR_____1_CM 16 0. 255. DISPLAY_IDENTIFIER LDP_ID_MAF_TAB_1 FORMAT "%3.0" /end AXIS_PTS
/begin AXIS_PTS ldp_id_maf_tab_2 "" 0x07b11 online_dummy _REC_AXS_20_u1 255. _CNV_A_R_LINEAR_____1_CM 16 0. 255. DISPLAY_IDENTIFIER LDP_ID_MAF_TAB_2 FORMAT "%3.0" /end AXIS_PTS
/begin CHARACTERISTIC c_n_min_maf_diag "Engine speed condition" VALUE 0x00784 _REC_VAL_20_u1 2448. _CNV_A_R_LINEAR_____16_CM 0. 8160. DISPLAY_IDENTIFIER C_N_MIN_MAF_DIAG FORMAT "%4.0" /end CHARACTERISTIC
/begin CHARACTERISTIC c_maf_min_diag "max. mass air flow diagnostic threshold" VALUE 0x016b2 _REC_VAL_20_u2 614.390625 _CNV_A_R_LINEAR_____113_CM 0. 2047.96875 DISPLAY_IDENTIFIER C_MAF_MIN_DIAG FORMAT "%7.2" /end CHARACTERISTIC
/begin CHARACTERISTIC c_isapwm_maf_min_isa_diag "ISAPWM_ISA-condition" VALUE 0x015e8 _REC_VAL_20_u2 99.99847412 _CNV_A_R_LINEAR_____9_CM 0. 99.99847412 DISPLAY_IDENTIFIER C_ISAPWM_MAF_MIN_ISA_DIAG /end CHARACTERISTIC
/begin CHARACTERISTIC c_maf_kgh_diag_ini "Set point for MAF_KGH_DIAG at transition out of start" VALUE 0x0168c _REC_VAL_20_u2 2047.96875 _CNV_A_R_LINEAR_____113_CM 0. 2047.96875 DISPLAY_IDENTIFIER C_MAF_KGH_DIAG_INI FORMAT "%7.2" /end CHARACTERISTIC
/begin MEASUREMENT pq_turb_sys "Substitute Mass air flow on ISA " UBYTE _CNV_A_R_LINEAR_____29_CM 1 100. 0. 0.99610001 DISPLAY_IDENTIFIER PQ_TURB_SYS ECU_ADDRESS 0x3fdf95 FORMAT "%5.3" /end MEASUREMENT
/begin MEASUREMENT maf_sub_isa "Substitute Mass air flow on ISA " UWORD _CNV_A_R_LINEAR_____106_CM 1 100. 0. 1389. DISPLAY_IDENTIFIER MAF_SUB_ISA ECU_ADDRESS 0x3fcf30 BYTE_ORDER MSB_LAST FORMAT "%7.2" /end MEASUREMENT
/begin MEASUREMENT maf_kgh_diag "Substitute Mass air flow on ISA " UWORD _CNV_A_R_LINEAR_____113_CM 1 100. 0. 2047.96875 DISPLAY_IDENTIFIER MAF_KGH_DIAG ECU_ADDRESS 0x3fcf32 BYTE_ORDER MSB_LAST FORMAT "%7.2" /end MEASUREMENT
/begin CHARACTERISTIC id_crlc_maf_diag__n_32 "Mittelungskonstante zur Mittelung des Luftmassen-Diagnosewertes" CURVE 0x00976 _REC_CUR_20_u1_u1 0.99610001 _CNV_A_R_LINEAR_____29_CM 0. 0.99610001 DISPLAY_IDENTIFIER ID_CRLC_MAF_DIAG__N_32 FORMAT "%5.3"
 /begin AXIS_DESCR COM_AXIS n_32 _CNV_A_R_LINEAR_____16_CM 4 0. 8160. FORMAT "%4.0" AXIS_PTS_REF ldp_n_32__crlc_maf_diag /end AXIS_DESCR
/end CHARACTERISTIC
/begin CHARACTERISTIC ip_maf_max_isa__pq_turb_sys "max. mass Air flow thru ISA" CURVE 0x0c6aa _REC_CUR_20_u2_u1 2047.96875 _CNV_A_R_LINEAR_____113_CM 0. 2047.96875 DISPLAY_IDENTIFIER IP_MAF_MAX_ISA__PQ_TURB_SYS FORMAT "%7.2"
 /begin AXIS_DESCR COM_AXIS n_32 _CNV_A_R_LINEAR_____29_CM 6 0. 0.99610001 FORMAT "%5.3" AXIS_PTS_REF ldpm_pq_turb_sys /end AXIS_DESCR
/end CHARACTERISTIC
/begin CHARACTERISTIC c_maf_max_diag "min. mass air flow diagnostic threshold" VALUE 0x016a2 _REC_VAL_20_u2 614.390625 _CNV_A_R_LINEAR_____113_CM 0. 2047.96875 DISPLAY_IDENTIFIER C_MAF_MAX_DIAG FORMAT "%7.2" /end CHARACTERISTIC
/begin CHARACTERISTIC c_fac_tq_req_min_maf_diag "" VALUE 0x015b0 _REC_VAL_20_u2 0.599990844 _CNV_A_R_LINEAR_____21_CM 0. 1.99996948 DISPLAY_IDENTIFIER C_FAC_TQ_REQ_MIN_MAF_DIAG FORMAT "%7.5" /end CHARACTERISTIC
/begin MEASUREMENT lv_maf_bls_diag "MAF error anf break active" UBYTE _CNV_S_2_RANGE______0_CM 1 100. 0. 1. DISPLAY_IDENTIFIER LV_MAF_BLS_DIAG ECU_ADDRESS 0x3fdf94 /end MEASUREMENT
/begin AXIS_PTS ldp_n_32__crlc_maf_diag "" 0x01011 n_32 _REC_AXS_20_u1 8160. _CNV_A_R_LINEAR_____16_CM 4 0. 8160. DISPLAY_IDENTIFIER LDP_N_32__CRLC_MAF_DIAG FORMAT "%4.0" /end AXIS_PTS
/begin AXIS_PTS ldpm_pq_turb_sys "" 0x01394 n_32 _REC_AXS_20_u1 0.99610001 _CNV_A_R_LINEAR_____29_CM 6 0. 0.99610001 DISPLAY_IDENTIFIER LDPM_PQ_TURB_SYS FORMAT "%5.3" /end AXIS_PTS
/begin AXIS_PTS ldp_isapwm__fac_pq_isa "" 0x10afa isapwm _REC_AXS_20_u2 99.99847412 _CNV_A_R_LINEAR_____9_CM 4 0. 99.99847412 DISPLAY_IDENTIFIER LDP_ISAPWM__FAC_PQ_ISA /end AXIS_PTS
/begin CHARACTERISTIC ip_fac_pq_isa__isapwm "Correction manifold/ turbulence pressure" CURVE 0x00b5c _REC_CUR_20_u1_u2 1.99220002 _CNV_A_R_LINEAR_____39_CM 0. 1.99220002 DISPLAY_IDENTIFIER IP_FAC_PQ_ISA__ISAPWM FORMAT "%5.3"
 /begin AXIS_DESCR COM_AXIS isapwm _CNV_A_R_LINEAR_____9_CM 4 0. 99.99847412 AXIS_PTS_REF ldp_isapwm__fac_pq_isa /end AXIS_DESCR
/end CHARACTERISTIC
/begin MEASUREMENT lv_err_maf "MAF error detected" UBYTE _CNV_S_2_RANGE______2_R_CM 1 100. 0. 255. DISPLAY_IDENTIFIER LV_ERR_MAF ECU_ADDRESS 0x3fb81c /end MEASUREMENT
/begin MEASUREMENT lv_poil_swi "logical variable oil pressure switch (1 = warning lamp on)" UBYTE _CNV_S_2_RANGE______0_CM 1 100. 0. 1. DISPLAY_IDENTIFIER LV_POIL_SWI ECU_ADDRESS 0x3fe241 BIT_MASK 0x1 /end MEASUREMENT
/begin MEASUREMENT lv_rly_st "Starter relay" UBYTE _CNV_S_2_RANGE______5_CM 1 100. 0. 1. DISPLAY_IDENTIFIER LV_RLY_ST ECU_ADDRESS 0x3fe3eb /end MEASUREMENT
/begin MEASUREMENT lv_err_amp "Error of the ambient pressure sensor" UBYTE _CNV_S_2_RANGE______2_R_CM 1 100. 0. 255. DISPLAY_IDENTIFIER LV_ERR_AMP ECU_ADDRESS 0x3fb818 /end MEASUREMENT
/begin MEASUREMENT saf_kgh "corrected value of SA mass flow" UWORD _CNV_A_R_LINEAR_____47_CM 1 100. 0. 1023.984375 DISPLAY_IDENTIFIER SAF_KGH ECU_ADDRESS 0x3fd21e BYTE_ORDER MSB_LAST FORMAT "%7.2" /end MEASUREMENT
/begin MEASUREMENT saf_mdl "Model value of secondary air mass flow (only if a SAFM is used)" UWORD _CNV_A_R_LINEAR_____47_CM 1 100. 0. 1023.984375 DISPLAY_IDENTIFIER SAF_MDL ECU_ADDRESS 0x3fd220 BYTE_ORDER MSB_LAST FORMAT "%7.2" /end MEASUREMENT
/begin CHARACTERISTIC lc_sa_swi_acq "logical constant for decision SAF_KGH through model value (=1) SAFM is used" VALUE 0x00f6c _REC_VAL_20_u1 1. _CNV_A_R_LINEAR_____1_CM 0. 1. DISPLAY_IDENTIFIER LC_SA_SWI_ACQ FORMAT "%2.0" /end CHARACTERISTIC
/begin MEASUREMENT saf_kgh_mes_bas "Raw secondary air-mass flow measured (without correction, to be used for diagnosis only)" UWORD _CNV_A_R_LINEAR_____113_CM 1 100. 0. 2047.96875 DISPLAY_IDENTIFIER SAF_KGH_MES_BAS ECU_ADDRESS 0x3fd222 BYTE_ORDER MSB_LAST FORMAT "%7.2" /end MEASUREMENT
/begin CHARACTERISTIC c_sofpwm_sof_max_diag "max. pwm for SOF control" VALUE 0x007bc _REC_VAL_20_u1 99.609375 _CNV_A_R_LINEAR_____10_CM 0. 99.609375 DISPLAY_IDENTIFIER C_SOFPWM_SOF_MAX_DIAG FORMAT "%4.1" /end CHARACTERISTIC
/begin CHARACTERISTIC c_sofpwm_sof_min_diag "max. pwm for SOF control" VALUE 0x007bd _REC_VAL_20_u1 99.609375 _CNV_A_R_LINEAR_____10_CM 0. 99.609375 DISPLAY_IDENTIFIER C_SOFPWM_SOF_MIN_DIAG FORMAT "%4.1" /end CHARACTERISTIC
/begin CHARACTERISTIC c_t_tia_tco_ex_diag "Time condition - TCO_EX diagnosis" VALUE 0x018be _REC_VAL_20_u2 65534. _CNV_A_R_LINEAR_____30_CM 1. 65535. DISPLAY_IDENTIFIER C_T_TIA_TCO_EX_DIAG FORMAT "%5.0" /end CHARACTERISTIC
/begin MEASUREMENT lv_err_tco_ex "TCO_EX error detected" UBYTE _CNV_S_2_RANGE______2_R_CM 1 100. 0. 255. DISPLAY_IDENTIFIER LV_ERR_TCO_EX ECU_ADDRESS 0x3fb810 /end MEASUREMENT
/begin MEASUREMENT lv_err_tia "TIA error detected" UBYTE _CNV_S_2_RANGE______2_R_CM 1 100. 0. 255. DISPLAY_IDENTIFIER LV_ERR_TIA ECU_ADDRESS 0x3fb814 /end MEASUREMENT
/begin CHARACTERISTIC c_tia_max_diag "TIA threshold for short to ground - TIA diagnosis" VALUE 0x008cf _REC_VAL_20_u1 28.575 _CNV_A_R_LINEAR_____12_CM -48. 142.5 DISPLAY_IDENTIFIER C_TIA_MAX_DIAG FORMAT "%5.1" /end CHARACTERISTIC
/begin CHARACTERISTIC c_tia_min_diag "TIA threshold for short to VB or line break - TIA diagnosis" VALUE 0x008d4 _REC_VAL_20_u1 28.575 _CNV_A_R_LINEAR_____12_CM -48. 142.5 DISPLAY_IDENTIFIER C_TIA_MIN_DIAG FORMAT "%5.1" /end CHARACTERISTIC
/begin CHARACTERISTIC c_vimpwm_2 "VIMPWM position 2" VALUE 0x004c8 _REC_VAL_20_s2 199.99694824 _CNV_A_R_LINEAR_____298_CM -100. 99.99694824 DISPLAY_IDENTIFIER C_VIMPWM_2 FORMAT "%8.3" /end CHARACTERISTIC
/begin CHARACTERISTIC c_vimpwm_3 "VIMPWM position 3" VALUE 0x004ca _REC_VAL_20_s2 199.99694824 _CNV_A_R_LINEAR_____298_CM -100. 99.99694824 DISPLAY_IDENTIFIER C_VIMPWM_3 FORMAT "%8.3" /end CHARACTERISTIC
/begin CHARACTERISTIC c_vim_av_2 "VIM_AV position 2" VALUE 0x019da _REC_VAL_20_u2 199.9969 _CNV_A_R_LINEAR_____485_CM 0. 199.9969 DISPLAY_IDENTIFIER C_VIM_AV_2 FORMAT "%7.3" /end CHARACTERISTIC
/begin CHARACTERISTIC c_vim_av_3 "VIM_AV position 3" VALUE 0x019dc _REC_VAL_20_u2 199.9969 _CNV_A_R_LINEAR_____485_CM 0. 199.9969 DISPLAY_IDENTIFIER C_VIM_AV_3 FORMAT "%7.3" /end CHARACTERISTIC
/begin CHARACTERISTIC c_n_vim_l "Lower engine speed threshold" VALUE 0x0172c _REC_VAL_20_u2 8160. _CNV_A_R_LINEAR_____11_CM 0. 8160. DISPLAY_IDENTIFIER C_N_VIM_L FORMAT "%4.0" /end CHARACTERISTIC
/begin CHARACTERISTIC c_n_vim_hys "engine speed threshold hysteresis" VALUE 0x0172a _REC_VAL_20_u2 8160. _CNV_A_R_LINEAR_____11_CM 0. 8160. DISPLAY_IDENTIFIER C_N_VIM_HYS FORMAT "%4.0" /end CHARACTERISTIC
/begin CHARACTERISTIC c_n_vim_h "Higher engine speed threshold" VALUE 0x01728 _REC_VAL_20_u2 8160. _CNV_A_R_LINEAR_____11_CM 0. 8160. DISPLAY_IDENTIFIER C_N_VIM_H FORMAT "%4.0" /end CHARACTERISTIC
/begin CHARACTERISTIC c_fac_maf_max_vim "load threshold" VALUE 0x0157a _REC_VAL_20_u2 1.99996948 _CNV_A_R_LINEAR_____21_CM 0. 1.99996948 DISPLAY_IDENTIFIER C_FAC_MAF_MAX_VIM FORMAT "%7.5" /end CHARACTERISTIC
/begin CHARACTERISTIC c_fac_maf_max_vim_hys "load threshold hysteresis" VALUE 0x0157c _REC_VAL_20_u2 1.99996948 _CNV_A_R_LINEAR_____21_CM 0. 1.99996948 DISPLAY_IDENTIFIER C_FAC_MAF_MAX_VIM_HYS FORMAT "%7.5" /end CHARACTERISTIC
/begin CHARACTERISTIC ip_fac_n_vim "TIA correction for VIM switch thresholds" CURVE 0x00b54 _REC_CUR_20_u1_u1 1.9921875 _CNV_A_R_LINEAR_____115_CM 0. 1.9921875 DISPLAY_IDENTIFIER IP_FAC_N_VIM FORMAT "%5.3"
 /begin AXIS_DESCR COM_AXIS tia _CNV_A_R_LINEAR_____12_CM 8 -48. 142.5 FORMAT "%5.1" AXIS_PTS_REF ldp_tia_fac_n_vim /end AXIS_DESCR
/end CHARACTERISTIC
/begin AXIS_PTS ldp_tia_fac_n_vim "" 0x07e4b tia _REC_AXS_20_u1 190.5 _CNV_A_R_LINEAR_____12_CM 8 -48. 142.5 DISPLAY_IDENTIFIER LDP_TIA_FAC_N_VIM FORMAT "%5.1" /end AXIS_PTS
/begin MEASUREMENT vimpwm "pulse width modulated signal for VIM-actuator" SWORD _CNV_A_R_LINEAR_____298_CM 1 100. -100. 99.99694824 DISPLAY_IDENTIFIER VIMPWM ECU_ADDRESS 0x3fd60e BYTE_ORDER MSB_LAST FORMAT "%8.3" /end MEASUREMENT
/begin MEASUREMENT n_vim "???" UWORD _CNV_A_R_LINEAR_____11_CM 1 100. 0. 8160. DISPLAY_IDENTIFIER N_VIM ECU_ADDRESS 0x3fd60c BYTE_ORDER MSB_LAST FORMAT "%4.0" /end MEASUREMENT
/begin MEASUREMENT vim_av "Actual position variable intake manifold" UWORD _CNV_A_R_LINEAR_____485_CM 1 100. 0. 199.9969 DISPLAY_IDENTIFIER VIM_AV ECU_ADDRESS 0x3fd60a BYTE_ORDER MSB_LAST FORMAT "%7.3" /end MEASUREMENT
/begin MEASUREMENT lv_vim "VIM power stage (2-stage-DISA); 0 passive, 1 active" UBYTE _CNV_S_2_RANGE______0_CM 1 100. 0. 1. DISPLAY_IDENTIFIER LV_VIM ECU_ADDRESS 0x3fe3fd /end MEASUREMENT
/begin CHARACTERISTIC c_vimpwm_4 "VIMPWM position 4" VALUE 0x004cc _REC_VAL_20_s2 199.99694824 _CNV_A_R_LINEAR_____298_CM -100. 99.99694824 DISPLAY_IDENTIFIER C_VIMPWM_4 FORMAT "%8.3" /end CHARACTERISTIC
/begin CHARACTERISTIC c_vimpwm_5 "VIMPWM position 5" VALUE 0x004ce _REC_VAL_20_s2 199.99694824 _CNV_A_R_LINEAR_____298_CM -100. 99.99694824 DISPLAY_IDENTIFIER C_VIMPWM_5 FORMAT "%8.3" /end CHARACTERISTIC
/begin CHARACTERISTIC c_vimpwm_1 "VIMPWM position 1" VALUE 0x004c6 _REC_VAL_20_s2 199.99694824 _CNV_A_R_LINEAR_____298_CM -100. 99.99694824 DISPLAY_IDENTIFIER C_VIMPWM_1 FORMAT "%8.3" /end CHARACTERISTIC
/begin CHARACTERISTIC c_vimpwm_6 "VIMPWM position 16" VALUE 0x004d0 _REC_VAL_20_s2 199.99694824 _CNV_A_R_LINEAR_____298_CM -100. 99.99694824 DISPLAY_IDENTIFIER C_VIMPWM_6 FORMAT "%8.3" /end CHARACTERISTIC
/begin CHARACTERISTIC c_vim_av_1 "VIM_AV position 1" VALUE 0x019d8 _REC_VAL_20_u2 199.9969 _CNV_A_R_LINEAR_____485_CM 0. 199.9969 DISPLAY_IDENTIFIER C_VIM_AV_1 FORMAT "%7.3" /end CHARACTERISTIC
/begin CHARACTERISTIC c_vim_av_5 "VIM_AV position 5" VALUE 0x019e0 _REC_VAL_20_u2 199.9969 _CNV_A_R_LINEAR_____485_CM 0. 199.9969 DISPLAY_IDENTIFIER C_VIM_AV_5 FORMAT "%7.3" /end CHARACTERISTIC
/begin CHARACTERISTIC c_vim_av_4 "VIM_AV position 4" VALUE 0x019de _REC_VAL_20_u2 199.9969 _CNV_A_R_LINEAR_____485_CM 0. 199.9969 DISPLAY_IDENTIFIER C_VIM_AV_4 FORMAT "%7.3" /end CHARACTERISTIC
/begin CHARACTERISTIC c_vim_av_6 "VIM_AV position 6" VALUE 0x019e2 _REC_VAL_20_u2 199.9969 _CNV_A_R_LINEAR_____485_CM 0. 199.9969 DISPLAY_IDENTIFIER C_VIM_AV_6 FORMAT "%7.3" /end CHARACTERISTIC
/begin MEASUREMENT B_ozfbsd "Bedingung Kommunikationsfehler BSD-Schnittstelle" UBYTE _CNV_R_R_identity_509_CM 1 100. 0. 1. DISPLAY_IDENTIFIER B_OZFBSD ECU_ADDRESS 0x3faa9a FORMAT "%8.4" BIT_MASK 0x1 /end MEASUREMENT
/begin MEASUREMENT ozlerrc "Fehlerzähler Niveau" UBYTE _CNV_R_R_dez_498_CM 1 100. 0. 255. DISPLAY_IDENTIFIER OZLERRC ECU_ADDRESS 0x3fad8b FORMAT "%8.4" /end MEASUREMENT
/begin MEASUREMENT oznivr "Ölniveau-Rohwert vom Sensor" UBYTE _CNV_R_R_dez_498_CM 1 100. 0. 255. DISPLAY_IDENTIFIER OZNIVR ECU_ADDRESS 0x3faa94 FORMAT "%8.4" /end MEASUREMENT
/begin MEASUREMENT ozqerrc "Fehlerzähler Permittivität" UBYTE _CNV_R_R_dez_498_CM 1 100. 0. 255. DISPLAY_IDENTIFIER OZQERRC ECU_ADDRESS 0x3fad8c FORMAT "%8.4" /end MEASUREMENT
/begin MEASUREMENT ozsierrc "Fehlerzähler Kommunikation" UBYTE _CNV_R_R_dez_498_CM 1 100. 0. 255. DISPLAY_IDENTIFIER OZSIERRC ECU_ADDRESS 0x3fad8d FORMAT "%8.4" /end MEASUREMENT
/begin MEASUREMENT ozstatus "Statusinformation vom Sensor" UBYTE _CNV_R_R_dez_498_CM 1 100. 0. 255. DISPLAY_IDENTIFIER OZSTATUS ECU_ADDRESS 0x3faa9c FORMAT "%8.4" /end MEASUREMENT
/begin MEASUREMENT ozterrc "Fehlerzähler Temperatur" UBYTE _CNV_R_R_dez_498_CM 1 100. 0. 255. DISPLAY_IDENTIFIER OZTERRC ECU_ADDRESS 0x3fad8e FORMAT "%8.4" /end MEASUREMENT
/begin MEASUREMENT ub "Batteriespannung" UBYTE _CNV_R_R_spg_ubatt_496_CM 1 100. 0. 24.021 DISPLAY_IDENTIFIER UB ECU_ADDRESS 0x3fdee0 FORMAT "%8.4" /end MEASUREMENT
/begin CHARACTERISTIC OZDIAGNMOT "Drehzahlschwelle für Diagnose QLT" VALUE 0x1a080 _REC_VAL_20_u1 0. _CNV_R_R_nmot_ub_q4_510_CM 0. 10200. FORMAT "%8.4" /end CHARACTERISTIC
/begin CHARACTERISTIC OZDIAGSPG "Spannung, unterhalb der die Diagnose ausgeblendet wird" VALUE 0x1a081 _REC_VAL_20_u1 0. _CNV_R_R_spg_ubatt_496_CM 0. 24.021 FORMAT "%8.4" /end CHARACTERISTIC
/begin CHARACTERISTIC OZERRD "Entprellzeit Sensor- und Kommunikationsfehler" VALUE 0x1a07c _REC_VAL_20_u2 0. _CNV_R_R_dez_498_CM 0. 65535. FORMAT "%8.4" /end CHARACTERISTIC
/begin CHARACTERISTIC OZHEAL "Entprellzeit Fehler-Healing" VALUE 0x1a07e _REC_VAL_20_u2 0. _CNV_R_R_dez_498_CM 0. 65535. FORMAT "%8.4" /end CHARACTERISTIC
/begin MEASUREMENT dqltBits2_1s "" UWORD _CNV_A_R_LINEAR_____1_CM 1 100. 0. 65535. DISPLAY_IDENTIFIER DQLTBITS2_1S ECU_ADDRESS 0x3fab26 BYTE_ORDER MSB_LAST FORMAT "%5.0" /end MEASUREMENT
/begin MEASUREMENT dqltBits2_1s.B_ozdiagok "Bedingung für über Tester geänderten Servicezähler" UWORD _CNV_A_R_LINEAR_____1_CM 1 100. 0. 65535. DISPLAY_IDENTIFIER B_OZDIAGOK ECU_ADDRESS 0x3fab26 BYTE_ORDER MSB_LAST FORMAT "%5.0" BIT_MASK 0x1 /end MEASUREMENT
/begin MEASUREMENT dqltBits2_1s.B_ozfsheal "Bedingung Ölwechsel erfolgt" UWORD _CNV_A_R_LINEAR_____1_CM 1 100. 0. 65535. DISPLAY_IDENTIFIER B_OZFSHEAL ECU_ADDRESS 0x3fab26 BYTE_ORDER MSB_LAST FORMAT "%5.0" BIT_MASK 0x2 /end MEASUREMENT
/begin MEASUREMENT dqltBits2_1s.B_ozlerr "Bedingung Niveausignal in Ordnung" UWORD _CNV_A_R_LINEAR_____1_CM 1 100. 0. 65535. DISPLAY_IDENTIFIER B_OZLERR ECU_ADDRESS 0x3fab26 BYTE_ORDER MSB_LAST FORMAT "%5.0" BIT_MASK 0x4 /end MEASUREMENT
/begin MEASUREMENT dqltBits2_1s.B_ozlerrb "Bedingung Permittivitätssignal in Ordnung" UWORD _CNV_A_R_LINEAR_____1_CM 1 100. 0. 65535. DISPLAY_IDENTIFIER B_OZLERRB ECU_ADDRESS 0x3fab26 BYTE_ORDER MSB_LAST FORMAT "%5.0" BIT_MASK 0x8 /end MEASUREMENT
/begin MEASUREMENT dqltBits2_1s.B_ozqerr "Bedingung Ölzustandssensor von Temic ist verbaut" UWORD _CNV_A_R_LINEAR_____1_CM 1 100. 0. 65535. DISPLAY_IDENTIFIER B_OZQERR ECU_ADDRESS 0x3fab26 BYTE_ORDER MSB_LAST FORMAT "%5.0" BIT_MASK 0x10 /end MEASUREMENT
/begin MEASUREMENT dqltBits2_1s.B_ozqerrb "Bedingung Ölzustandssensor von Temic ist verbaut" UWORD _CNV_A_R_LINEAR_____1_CM 1 100. 0. 65535. DISPLAY_IDENTIFIER B_OZQERRB ECU_ADDRESS 0x3fab26 BYTE_ORDER MSB_LAST FORMAT "%5.0" BIT_MASK 0x20 /end MEASUREMENT
/begin MEASUREMENT dqltBits2_1s.B_ozsierrb "Bedingung Ölzustandssensor von Temic ist verbaut" UWORD _CNV_A_R_LINEAR_____1_CM 1 100. 0. 65535. DISPLAY_IDENTIFIER B_OZSIERRB ECU_ADDRESS 0x3fab26 BYTE_ORDER MSB_LAST FORMAT "%5.0" BIT_MASK 0x40 /end MEASUREMENT
/begin MEASUREMENT dqltBits2_1s.B_oztemic "Bedingung Ölzustandssensor von Temic ist verbaut" UWORD _CNV_A_R_LINEAR_____1_CM 1 100. 0. 65535. DISPLAY_IDENTIFIER B_OZTEMIC ECU_ADDRESS 0x3fab26 BYTE_ORDER MSB_LAST FORMAT "%5.0" BIT_MASK 0x80 /end MEASUREMENT
/begin MEASUREMENT dqltBits2_1s.B_ozterr "Bedingung Ölzustandssensor von Temic ist verbaut" UWORD _CNV_A_R_LINEAR_____1_CM 1 100. 0. 65535. DISPLAY_IDENTIFIER B_OZTERR ECU_ADDRESS 0x3fab26 BYTE_ORDER MSB_LAST FORMAT "%5.0" BIT_MASK 0x100 /end MEASUREMENT
/begin MEASUREMENT dqltBits2_1s.B_ozterrb "Bedingung Ölzustandssensor von Temic ist verbaut" UWORD _CNV_A_R_LINEAR_____1_CM 1 100. 0. 65535. DISPLAY_IDENTIFIER B_OZTERRB ECU_ADDRESS 0x3fab26 BYTE_ORDER MSB_LAST FORMAT "%5.0" BIT_MASK 0x200 /end MEASUREMENT
/begin MEASUREMENT dqltBits1_1s "" UBYTE _CNV_A_R_LINEAR_____1_CM 1 100. 0. 255. DISPLAY_IDENTIFIER DQLTBITS1_1S ECU_ADDRESS 0x3fab28 FORMAT "%3.0" /end MEASUREMENT
/begin MEASUREMENT dqltBits1_1s.B_ozwertok "Bedingung Ölzustandssensor von Temic ist verbaut" UBYTE _CNV_A_R_LINEAR_____1_CM 1 100. 0. 255. DISPLAY_IDENTIFIER B_OZWERTOK ECU_ADDRESS 0x3fab28 FORMAT "%3.0" BIT_MASK 0x1 /end MEASUREMENT
/begin CHARACTERISTIC TOG_TK_MAX "" VALUE 0x1b820 _REC_VAL_20_u2 6553.5 _CNV_R_R_t_q0p1ms_526_CM 0. 6553.5 FORMAT "%8.3" /end CHARACTERISTIC
/begin CHARACTERISTIC TOG_TK_MIN "" VALUE 0x1b822 _REC_VAL_20_u2 6553.5 _CNV_R_R_t_q0p1ms_526_CM 0. 6553.5 FORMAT "%8.3" /end CHARACTERISTIC
/begin CHARACTERISTIC TOG_TR_MAX "" VALUE 0x1b824 _REC_VAL_20_u2 6553.5 _CNV_R_R_t_q0p1ms_526_CM 0. 6553.5 FORMAT "%8.3" /end CHARACTERISTIC
/begin CHARACTERISTIC TOG_TR_MIN "" VALUE 0x1b826 _REC_VAL_20_u2 6553.5 _CNV_R_R_t_q0p1ms_526_CM 0. 6553.5 FORMAT "%8.3" /end CHARACTERISTIC
/begin CHARACTERISTIC TOG_TV_MAX "" VALUE 0x1b828 _REC_VAL_20_u2 6553.5 _CNV_R_R_t_q0p1ms_526_CM 0. 6553.5 FORMAT "%8.3" /end CHARACTERISTIC
/begin CHARACTERISTIC TOG_TV_MIN "" VALUE 0x1b82a _REC_VAL_20_u2 6553.5 _CNV_R_R_t_q0p1ms_526_CM 0. 6553.5 FORMAT "%8.3" /end CHARACTERISTIC
/begin CHARACTERISTIC TOG_VERS "" VALUE 0x1b82d _REC_VAL_20_u1 2. _CNV_R_R_dez_498_CM 0. 2. FORMAT "%5.3" /end CHARACTERISTIC
/begin CHARACTERISTIC TOGVERZOEG "" VALUE 0x1b82c _REC_VAL_20_u1 255. _CNV_R_R_dez_498_CM 0. 255. FORMAT "%5.1" /end CHARACTERISTIC
/begin MEASUREMENT B_toel "" UBYTE _CNV_S_2_B_TRUE_530_CM 1 100. 0. 1. DISPLAY_IDENTIFIER B_TOEL ECU_ADDRESS 0x3faa75 /end MEASUREMENT
/begin MEASUREMENT B_tog "" UBYTE _CNV_S_2_B_TRUE_530_CM 1 100. 0. 1. DISPLAY_IDENTIFIER B_TOG ECU_ADDRESS 0x3faa76 /end MEASUREMENT
/begin MEASUREMENT Tog_cnt "" UBYTE _CNV_R_R_dez_498_CM 1 100. 0. 255. DISPLAY_IDENTIFIER TOG_CNT ECU_ADDRESS 0x3fa452 FORMAT "%5.1" /end MEASUREMENT
/begin MEASUREMENT Tog_icnt "" UWORD _CNV_R_R_t10msxs_ub_507_CM 1 100. 0. 655.35 DISPLAY_IDENTIFIER TOG_ICNT ECU_ADDRESS 0x3fa44a BYTE_ORDER MSB_LAST FORMAT "%8.4" /end MEASUREMENT
/begin MEASUREMENT Tog_pwmst "" UBYTE _CNV_R_R_dez_498_CM 1 100. 0. 255. DISPLAY_IDENTIFIER TOG_PWMST ECU_ADDRESS 0x3fa453 FORMAT "%5.1" /end MEASUREMENT
/begin MEASUREMENT Tog_state "" UBYTE _CNV_R_R_dez_498_CM 1 100. 0. 255. DISPLAY_IDENTIFIER TOG_STATE ECU_ADDRESS 0x3fa455 FORMAT "%5.1" /end MEASUREMENT
/begin MEASUREMENT Tog_tk "" UWORD _CNV_R_R_t_q0p1ms_526_CM 1 100. 0. 6553.5 DISPLAY_IDENTIFIER TOG_TK ECU_ADDRESS 0x3fa44c BYTE_ORDER MSB_LAST FORMAT "%8.3" /end MEASUREMENT
/begin MEASUREMENT Tog_tr "" UWORD _CNV_R_R_t_q0p1ms_526_CM 1 100. 0. 6553.5 DISPLAY_IDENTIFIER TOG_TR ECU_ADDRESS 0x3fa44e BYTE_ORDER MSB_LAST FORMAT "%8.3" /end MEASUREMENT
/begin MEASUREMENT Tog_tv "" UWORD _CNV_R_R_t_q0p1ms_526_CM 1 100. 0. 6553.5 DISPLAY_IDENTIFIER TOG_TV ECU_ADDRESS 0x3fa450 BYTE_ORDER MSB_LAST FORMAT "%8.3" /end MEASUREMENT
/begin MEASUREMENT Tog_uplcnt "" UBYTE _CNV_R_R_dez_498_CM 1 100. 0. 255. DISPLAY_IDENTIFIER TOG_UPLCNT ECU_ADDRESS 0x3fa456 FORMAT "%5.1" /end MEASUREMENT
/begin MEASUREMENT B_masterhw "" SBYTE _CNV_R_R_identity_509_CM 1 100. 0. 1. DISPLAY_IDENTIFIER B_MASTERHW ECU_ADDRESS 0x3fdf09 FORMAT "%8.4" BIT_MASK 0x1 /end MEASUREMENT
/begin MEASUREMENT bos01_w "Ausgabewert Restlaufstrecke Motoröl" SWORD _CNV_R_R_km_sw_q10_549_CM 1 100. -327680. 327670. DISPLAY_IDENTIFIER BOS01_W ECU_ADDRESS 0x3facec BYTE_ORDER MSB_LAST FORMAT "%8.4" /end MEASUREMENT
/begin MEASUREMENT bosbtvfbk "Rest-Verfügbarkeit Motoröl in Prozent" UBYTE _CNV_R_R_dez_498_CM 1 100. 0. 255. DISPLAY_IDENTIFIER BOSBTVFBK ECU_ADDRESS 0x3facee FORMAT "%8.4" /end MEASUREMENT
/begin MEASUREMENT bosstate "Einheit der BOS-Info (km)" UBYTE _CNV_R_R_dez_498_CM 1 100. 0. 255. DISPLAY_IDENTIFIER BOSSTATE ECU_ADDRESS 0x3faa7e FORMAT "%8.4" /end MEASUREMENT
/begin MEASUREMENT idbosmsg "Kennung für BOS-Meldung vom Kombi" UBYTE _CNV_R_R_dez_498_CM 1 100. 0. 255. DISPLAY_IDENTIFIER IDBOSMSG ECU_ADDRESS 0x3faa7f FORMAT "%8.4" /end MEASUREMENT
/begin MEASUREMENT idfbosmg_w "Kennung für BOS-Meldung = Ölservice-Info" UWORD _CNV_R_R_dez_498_CM 1 100. 0. 65535. DISPLAY_IDENTIFIER IDFBOSMG_W ECU_ADDRESS 0x3faa78 BYTE_ORDER MSB_LAST FORMAT "%8.4" /end MEASUREMENT
/begin MEASUREMENT idfbosmgt "Kennung für BOS-Meldung vom Tester" UBYTE _CNV_R_R_dez_498_CM 1 100. 0. 255. DISPLAY_IDENTIFIER IDFBOSMGT ECU_ADDRESS 0x3faa80 FORMAT "%8.4" /end MEASUREMENT
/begin MEASUREMENT ozkrzor "kurzzeitiger Mittelwert Orientierungsmessung Niveau" UBYTE _CNV_R_R_niv_ub_b75_550_CM 1 100. 0. 74.707031 DISPLAY_IDENTIFIER OZKRZOR ECU_ADDRESS 0x3faaa7 FORMAT "%8.4" /end MEASUREMENT
/begin MEASUREMENT ozlangmw "Langzeitmittelwert berechnet" UBYTE _CNV_R_R_niv_ub_b75_550_CM 1 100. 0. 74.707031 DISPLAY_IDENTIFIER OZLANGMW ECU_ADDRESS 0x3fad25 FORMAT "%8.4" /end MEASUREMENT
/begin MEASUREMENT ozrwanz "anzuzeigender Restweg" SWORD _CNV_R_R_km_sw_q10_549_CM 1 100. -327680. 327670. DISPLAY_IDENTIFIER OZRWANZ ECU_ADDRESS 0x3fad80 BYTE_ORDER MSB_LAST FORMAT "%8.4" /end MEASUREMENT
/begin MEASUREMENT ozrwanzt "letzter Wert der Restweganzeige" SWORD _CNV_R_R_km_sw_q10_549_CM 1 100. -327680. 327670. DISPLAY_IDENTIFIER OZRWANZT ECU_ADDRESS 0x3faa7a BYTE_ORDER MSB_LAST FORMAT "%8.4" /end MEASUREMENT
/begin MEASUREMENT ozsvcntchg "" UBYTE _CNV_R_R_dez_498_CM 1 100. 0. 255. DISPLAY_IDENTIFIER OZSVCNTCHG ECU_ADDRESS 0x3faa8f FORMAT "%8.4" /end MEASUREMENT
/begin MEASUREMENT oztempf "Öltemperatur gefiltert" UBYTE _CNV_R_R_temp_ub_q1_551_CM 1 100. -48. 207. DISPLAY_IDENTIFIER OZTEMPF ECU_ADDRESS 0x3fab24 FORMAT "%8.4" /end MEASUREMENT
/begin MEASUREMENT ozvfanz "anzuzeigende Verfügbarkeit" UBYTE _CNV_R_R_lf_ub_552_CM 1 100. 0. 2.55 DISPLAY_IDENTIFIER OZVFANZ ECU_ADDRESS 0x3fab21 FORMAT "%8.4" /end MEASUREMENT
/begin MEASUREMENT ozvftmp "begrenzte Verfügbarkeit" UBYTE _CNV_R_R_lf_ub_552_CM 1 100. 0. 2.55 DISPLAY_IDENTIFIER OZVFTMP ECU_ADDRESS 0x3faa82 FORMAT "%8.4" /end MEASUREMENT
/begin MEASUREMENT ozvormw "vorgezogener Mittelwert Niveau" UBYTE _CNV_R_R_niv_ub_b75_550_CM 1 100. 0. 74.707031 DISPLAY_IDENTIFIER OZVORMW ECU_ADDRESS 0x3faab0 FORMAT "%8.4" /end MEASUREMENT
/begin MEASUREMENT toel_w "Ausgabewert Motoröltemperatur für LoCAN" UWORD _CNV_R_R_temp_uw_q0_495_CM 1 100. -48. 200.25 DISPLAY_IDENTIFIER TOEL_W ECU_ADDRESS 0x3faa7c BYTE_ORDER MSB_LAST FORMAT "%8.4" /end MEASUREMENT
/begin MEASUREMENT toeloz "Ausgabe Öltemperatur" UBYTE _CNV_R_R_temp_ub_q1_551_CM 1 100. -48. 207. DISPLAY_IDENTIFIER TOELOZ ECU_ADDRESS 0x3faa83 FORMAT "%8.4" /end MEASUREMENT
/begin MEASUREMENT tol "Ausgabewert Öltemperatur in Standardquantisierung" UBYTE _CNV_R_R_temp_uw_q0_495_CM 1 100. -48. 143.25 DISPLAY_IDENTIFIER TOL ECU_ADDRESS 0x3faa84 FORMAT "%8.4" /end MEASUREMENT
/begin MEASUREMENT zrbosmld "anzuzeigender Zähler für durchgeführten Ölservice" UBYTE _CNV_R_R_dez_498_CM 1 100. 0. 255. DISPLAY_IDENTIFIER ZRBOSMLD ECU_ADDRESS 0x3facf0 FORMAT "%8.4" /end MEASUREMENT
/begin CHARACTERISTIC CW_OZ "" VALUE 0x1a01c _REC_VAL_20_u2 0. _CNV_R_R_dez_498_CM 0. 65535. FORMAT "%8.4" /end CHARACTERISTIC
/begin CHARACTERISTIC OZLANGLIM1 "Schwelle für langen Mittelwert Ölniveau (Vebrauchswarnung)" VALUE 0x1a000 _REC_VAL_20_u1 0. _CNV_R_R_niv_ub_b75_550_CM 0. 74.707031 FORMAT "%8.4" /end CHARACTERISTIC
/begin CHARACTERISTIC OZLANGLIM2 "Schwelle für langen Mittelwert Ölniveau (Verlustwarnung)" VALUE 0x1a001 _REC_VAL_20_u1 0. _CNV_R_R_niv_ub_b75_550_CM 0. 74.707031 FORMAT "%8.4" /end CHARACTERISTIC
/begin CHARACTERISTIC OZLIM1HEAL "Schwelle für Rücknahme der Ölniveauwarnung Verbrauch" VALUE 0x1a002 _REC_VAL_20_u1 0. _CNV_R_R_niv_ub_b75_550_CM 0. 74.707031 FORMAT "%8.4" /end CHARACTERISTIC
/begin CHARACTERISTIC OZLIM2HEAL "Schwelle für Rücknahme der Ölniveauwarnung Verlust" VALUE 0x1a003 _REC_VAL_20_u1 0. _CNV_R_R_niv_ub_b75_550_CM 0. 74.707031 FORMAT "%8.4" /end CHARACTERISTIC
/begin CHARACTERISTIC OZORLIM2 "Schwelle für Orientierungswert Ölniveau (Verlustwarnung)" VALUE 0x1a004 _REC_VAL_20_u1 0. _CNV_R_R_niv_ub_b75_550_CM 0. 74.707031 FORMAT "%8.4" /end CHARACTERISTIC
/begin CHARACTERISTIC OZVORLIM1 "Schwelle für vorgezogenen Mittelwert Ölniveau (Vebrauchswarnung)" VALUE 0x1a005 _REC_VAL_20_u1 0. _CNV_R_R_niv_ub_b75_550_CM 0. 74.707031 FORMAT "%8.4" /end CHARACTERISTIC
/begin CHARACTERISTIC OZVORLIM2 "Schwelle für vorgezogenen Mittelwert Ölniveau (Verlustwarnung)" VALUE 0x1a006 _REC_VAL_20_u1 0. _CNV_R_R_niv_ub_b75_550_CM 0. 74.707031 FORMAT "%8.4" /end CHARACTERISTIC
/begin MEASUREMENT ozbgBits1_1s "???" UBYTE _CNV_A_R_LINEAR_____1_CM 1 100. 0. 255. DISPLAY_IDENTIFIER OZBGBITS1_1S ECU_ADDRESS 0x3faa81 FORMAT "%3.0" /end MEASUREMENT
/begin MEASUREMENT ozbgBits1_1s.B_mol_vb "Bedingung Ölverbrauchswarnung" UBYTE _CNV_A_R_LINEAR_____1_CM 1 100. 0. 255. DISPLAY_IDENTIFIER B_MOL_VB ECU_ADDRESS 0x3faa81 FORMAT "%3.0" BIT_MASK 0x2 /end MEASUREMENT
/begin MEASUREMENT ozbgBits1_1s.B_bosmsgc "Bedingung für Absetzen einer BOS-Meldung" UBYTE _CNV_A_R_LINEAR_____1_CM 1 100. 0. 255. DISPLAY_IDENTIFIER B_BOSMSGC ECU_ADDRESS 0x3faa81 FORMAT "%3.0" BIT_MASK 0x8 /end MEASUREMENT
/begin MEASUREMENT ozbgBits1_1s.B_mol_vl "Bedingung Ölverlustwarnung" UBYTE _CNV_A_R_LINEAR_____1_CM 1 100. 0. 255. DISPLAY_IDENTIFIER B_MOL_VL ECU_ADDRESS 0x3faa81 FORMAT "%3.0" BIT_MASK 0x4 /end MEASUREMENT
/begin MEASUREMENT ozbgBits1_1s.B_oeltemp "Bedingung für CAN-Ausgabe der Öltemperatur" UBYTE _CNV_A_R_LINEAR_____1_CM 1 100. 0. 255. DISPLAY_IDENTIFIER B_OELTEMP ECU_ADDRESS 0x3faa81 FORMAT "%3.0" BIT_MASK 0x1 /end MEASUREMENT
/begin MEASUREMENT bosbtvfbkt "Verfügbarkeit vom Tester" UBYTE _CNV_R_R_dez_498_CM 1 100. 0. 255. DISPLAY_IDENTIFIER BOSBTVFBKT ECU_ADDRESS 0x3faa8a FORMAT "%8.4" /end MEASUREMENT
/begin MEASUREMENT idbosrst "" UBYTE _CNV_R_R_dez_498_CM 1 100. 0. 255. DISPLAY_IDENTIFIER IDBOSRST ECU_ADDRESS 0x3fdbb6 FORMAT "%8.4" /end MEASUREMENT
/begin MEASUREMENT idfbosrt_w "" UWORD _CNV_R_R_dez_498_CM 1 100. 0. 65535. DISPLAY_IDENTIFIER IDFBOSRT_W ECU_ADDRESS 0x3fcdce BYTE_ORDER MSB_LAST FORMAT "%8.4" /end MEASUREMENT
/begin MEASUREMENT idfbosrtt "Kennung vom Tester für Ölservice" UBYTE _CNV_R_R_dez_498_CM 1 100. 0. 255. DISPLAY_IDENTIFIER IDFBOSRTT ECU_ADDRESS 0x3faa8b FORMAT "%8.4" /end MEASUREMENT
/begin MEASUREMENT ozlowcnt "Zähler zur Sicherung der Ölwechselinformationen" UBYTE _CNV_R_R_dez_498_CM 1 100. 0. 255. DISPLAY_IDENTIFIER OZLOWCNT ECU_ADDRESS 0x3fad23 FORMAT "%8.4" /end MEASUREMENT
/begin MEASUREMENT ozlowkm[0] "Register für KM-Stand beim Ölwechsel" UWORD _CNV_R_R_km_sw_q10_549_CM 1 100. 0. 655350. DISPLAY_IDENTIFIER OZLOWKM_0_ ECU_ADDRESS 0x3facf2 BYTE_ORDER MSB_LAST FORMAT "%8.4" /end MEASUREMENT
/begin MEASUREMENT ozlowkm[1] "Register für KM-Stand beim Ölwechsel" UWORD _CNV_R_R_km_sw_q10_549_CM 1 100. 0. 655350. DISPLAY_IDENTIFIER OZLOWKM_1_ ECU_ADDRESS 0x3facf4 BYTE_ORDER MSB_LAST FORMAT "%8.4" /end MEASUREMENT
/begin MEASUREMENT ozlowkm[2] "Register für KM-Stand beim Ölwechsel" UWORD _CNV_R_R_km_sw_q10_549_CM 1 100. 0. 655350. DISPLAY_IDENTIFIER OZLOWKM_2_ ECU_ADDRESS 0x3facf6 BYTE_ORDER MSB_LAST FORMAT "%8.4" /end MEASUREMENT
/begin MEASUREMENT ozlowkm[3] "Register für KM-Stand beim Ölwechsel" UWORD _CNV_R_R_km_sw_q10_549_CM 1 100. 0. 655350. DISPLAY_IDENTIFIER OZLOWKM_3_ ECU_ADDRESS 0x3facf8 BYTE_ORDER MSB_LAST FORMAT "%8.4" /end MEASUREMENT
/begin MEASUREMENT ozlowkm[4] "Register für KM-Stand beim Ölwechsel" UWORD _CNV_R_R_km_sw_q10_549_CM 1 100. 0. 655350. DISPLAY_IDENTIFIER OZLOWKM_4_ ECU_ADDRESS 0x3facfa BYTE_ORDER MSB_LAST FORMAT "%8.4" /end MEASUREMENT
/begin MEASUREMENT ozlowkm[5] "Register für KM-Stand beim Ölwechsel" UWORD _CNV_R_R_km_sw_q10_549_CM 1 100. 0. 655350. DISPLAY_IDENTIFIER OZLOWKM_5_ ECU_ADDRESS 0x3facfc BYTE_ORDER MSB_LAST FORMAT "%8.4" /end MEASUREMENT
/begin MEASUREMENT ozlowperex[0] "Register für extrapoliertes Er beim Ölwechsel" UWORD _CNV_R_R_perm_uw_b6_553_CM 1 100. 0. 5.9999084 DISPLAY_IDENTIFIER OZLOWPEREX_0_ ECU_ADDRESS 0x3facfe BYTE_ORDER MSB_LAST FORMAT "%8.4" /end MEASUREMENT
/begin MEASUREMENT ozlowperex[1] "Register für extrapoliertes Er beim Ölwechsel" UWORD _CNV_R_R_perm_uw_b6_553_CM 1 100. 0. 5.9999084 DISPLAY_IDENTIFIER OZLOWPEREX_1_ ECU_ADDRESS 0x3fad00 BYTE_ORDER MSB_LAST FORMAT "%8.4" /end MEASUREMENT
/begin MEASUREMENT ozlowperex[2] "Register für extrapoliertes Er beim Ölwechsel" UWORD _CNV_R_R_perm_uw_b6_553_CM 1 100. 0. 5.9999084 DISPLAY_IDENTIFIER OZLOWPEREX_2_ ECU_ADDRESS 0x3fad02 BYTE_ORDER MSB_LAST FORMAT "%8.4" /end MEASUREMENT
/begin MEASUREMENT ozlowperex[3] "Register für extrapoliertes Er beim Ölwechsel" UWORD _CNV_R_R_perm_uw_b6_553_CM 1 100. 0. 5.9999084 DISPLAY_IDENTIFIER OZLOWPEREX_3_ ECU_ADDRESS 0x3fad04 BYTE_ORDER MSB_LAST FORMAT "%8.4" /end MEASUREMENT
/begin MEASUREMENT ozlowperex[4] "Register für extrapoliertes Er beim Ölwechsel" UWORD _CNV_R_R_perm_uw_b6_553_CM 1 100. 0. 5.9999084 DISPLAY_IDENTIFIER OZLOWPEREX_4_ ECU_ADDRESS 0x3fad06 BYTE_ORDER MSB_LAST FORMAT "%8.4" /end MEASUREMENT
/begin MEASUREMENT ozlowperex[5] "Register für extrapoliertes Er beim Ölwechsel" UWORD _CNV_R_R_perm_uw_b6_553_CM 1 100. 0. 5.9999084 DISPLAY_IDENTIFIER OZLOWPEREX_5_ ECU_ADDRESS 0x3fad08 BYTE_ORDER MSB_LAST FORMAT "%8.4" /end MEASUREMENT
/begin MEASUREMENT ozlowperm0[0] "Register für Er nach Ölwechsel" UWORD _CNV_R_R_perm_uw_b6_553_CM 1 100. 0. 5.9999084 DISPLAY_IDENTIFIER OZLOWPERM0_0_ ECU_ADDRESS 0x3fad0a BYTE_ORDER MSB_LAST FORMAT "%8.4" /end MEASUREMENT
/begin MEASUREMENT ozlowperm0[1] "Register für Er nach Ölwechsel" UWORD _CNV_R_R_perm_uw_b6_553_CM 1 100. 0. 5.9999084 DISPLAY_IDENTIFIER OZLOWPERM0_1_ ECU_ADDRESS 0x3fad0c BYTE_ORDER MSB_LAST FORMAT "%8.4" /end MEASUREMENT
/begin MEASUREMENT ozlowperm0[2] "Register für Er nach Ölwechsel" UWORD _CNV_R_R_perm_uw_b6_553_CM 1 100. 0. 5.9999084 DISPLAY_IDENTIFIER OZLOWPERM0_2_ ECU_ADDRESS 0x3fad0e BYTE_ORDER MSB_LAST FORMAT "%8.4" /end MEASUREMENT
/begin MEASUREMENT ozlowperm0[3] "Register für Er nach Ölwechsel" UWORD _CNV_R_R_perm_uw_b6_553_CM 1 100. 0. 5.9999084 DISPLAY_IDENTIFIER OZLOWPERM0_3_ ECU_ADDRESS 0x3fad10 BYTE_ORDER MSB_LAST FORMAT "%8.4" /end MEASUREMENT
/begin MEASUREMENT ozlowperm0[4] "Register für Er nach Ölwechsel" UWORD _CNV_R_R_perm_uw_b6_553_CM 1 100. 0. 5.9999084 DISPLAY_IDENTIFIER OZLOWPERM0_4_ ECU_ADDRESS 0x3fad12 BYTE_ORDER MSB_LAST FORMAT "%8.4" /end MEASUREMENT
/begin MEASUREMENT ozlowperm0[5] "Register für Er nach Ölwechsel" UWORD _CNV_R_R_perm_uw_b6_553_CM 1 100. 0. 5.9999084 DISPLAY_IDENTIFIER OZLOWPERM0_5_ ECU_ADDRESS 0x3fad14 BYTE_ORDER MSB_LAST FORMAT "%8.4" /end MEASUREMENT
/begin MEASUREMENT ozlowrwanz[0] "Register für Restweganzeige beim Ölwechsel" SWORD _CNV_R_R_km_sw_q10_549_CM 1 100. -327680. 327670. DISPLAY_IDENTIFIER OZLOWRWANZ_0_ ECU_ADDRESS 0x3fad16 BYTE_ORDER MSB_LAST FORMAT "%8.4" /end MEASUREMENT
/begin MEASUREMENT ozlowrwanz[1] "Register für Restweganzeige beim Ölwechsel" SWORD _CNV_R_R_km_sw_q10_549_CM 1 100. -327680. 327670. DISPLAY_IDENTIFIER OZLOWRWANZ_1_ ECU_ADDRESS 0x3fad18 BYTE_ORDER MSB_LAST FORMAT "%8.4" /end MEASUREMENT
/begin MEASUREMENT ozlowrwanz[2] "Register für Restweganzeige beim Ölwechsel" SWORD _CNV_R_R_km_sw_q10_549_CM 1 100. -327680. 327670. DISPLAY_IDENTIFIER OZLOWRWANZ_2_ ECU_ADDRESS 0x3fad1a BYTE_ORDER MSB_LAST FORMAT "%8.4" /end MEASUREMENT
/begin MEASUREMENT ozlowrwanz[3] "Register für Restweganzeige beim Ölwechsel" SWORD _CNV_R_R_km_sw_q10_549_CM 1 100. -327680. 327670. DISPLAY_IDENTIFIER OZLOWRWANZ_3_ ECU_ADDRESS 0x3fad1c BYTE_ORDER MSB_LAST FORMAT "%8.4" /end MEASUREMENT
/begin MEASUREMENT ozlowrwanz[4] "Register für Restweganzeige beim Ölwechsel" SWORD _CNV_R_R_km_sw_q10_549_CM 1 100. -327680. 327670. DISPLAY_IDENTIFIER OZLOWRWANZ_4_ ECU_ADDRESS 0x3fad1e BYTE_ORDER MSB_LAST FORMAT "%8.4" /end MEASUREMENT
/begin MEASUREMENT ozlowrwanz[5] "Register für Restweganzeige beim Ölwechsel" SWORD _CNV_R_R_km_sw_q10_549_CM 1 100. -327680. 327670. DISPLAY_IDENTIFIER OZLOWRWANZ_5_ ECU_ADDRESS 0x3fad20 BYTE_ORDER MSB_LAST FORMAT "%8.4" /end MEASUREMENT
/begin MEASUREMENT ozniv "" UBYTE _CNV_R_R_niv_ub_b75_550_CM 1 100. 0. 74.707031 DISPLAY_IDENTIFIER OZNIV ECU_ADDRESS 0x3faa8d FORMAT "%8.4" /end MEASUREMENT
/begin MEASUREMENT oznivt "begrenzter Niveau-Rohwert" UBYTE _CNV_R_R_dez_498_CM 1 100. 0. 255. DISPLAY_IDENTIFIER OZNIVT ECU_ADDRESS 0x3faa8e FORMAT "%8.4" /end MEASUREMENT
/begin MEASUREMENT ozperm_w "" UWORD _CNV_R_R_perm_uw_b6_553_CM 1 100. 0. 5.9999084 DISPLAY_IDENTIFIER OZPERM_W ECU_ADDRESS 0x3faa88 BYTE_ORDER MSB_LAST FORMAT "%8.4" /end MEASUREMENT
/begin MEASUREMENT ozpermex "" UWORD _CNV_R_R_perm_uw_b6_553_CM 1 100. 0. 5.9999084 DISPLAY_IDENTIFIER OZPERMEX ECU_ADDRESS 0x3fad4c BYTE_ORDER MSB_LAST FORMAT "%8.4" /end MEASUREMENT
/begin MEASUREMENT ozpermlow "" UWORD _CNV_R_R_perm_uw_b6_553_CM 1 100. 0. 5.9999084 DISPLAY_IDENTIFIER OZPERMLOW ECU_ADDRESS 0x3fad4e BYTE_ORDER MSB_LAST FORMAT "%8.4" /end MEASUREMENT
/begin MEASUREMENT ozpermr_w "" UWORD _CNV_R_R_dez_498_CM 1 100. 0. 1024. DISPLAY_IDENTIFIER OZPERMR_W ECU_ADDRESS 0x3faa96 BYTE_ORDER MSB_LAST FORMAT "%8.4" /end MEASUREMENT
/begin MEASUREMENT ozpermt "begrenzter Permittivitäts-Rohwert" UWORD _CNV_R_R_dez_498_CM 1 100. 0. 1024. DISPLAY_IDENTIFIER OZPERMT ECU_ADDRESS 0x3faa86 BYTE_ORDER MSB_LAST FORMAT "%8.4" /end MEASUREMENT
/begin MEASUREMENT oztemp "" UBYTE _CNV_R_R_temp_ub_q1_551_CM 1 100. -48. 207. DISPLAY_IDENTIFIER OZTEMP ECU_ADDRESS 0x3faa90 FORMAT "%8.4" /end MEASUREMENT
/begin MEASUREMENT oztempr "" UBYTE _CNV_R_R_dez_498_CM 1 100. 0. 255. DISPLAY_IDENTIFIER OZTEMPR ECU_ADDRESS 0x3faa98 FORMAT "%8.4" /end MEASUREMENT
/begin MEASUREMENT oztempt "begrenzter Temperatur-Rohwert" UBYTE _CNV_R_R_dez_498_CM 1 100. 0. 255. DISPLAY_IDENTIFIER OZTEMPT ECU_ADDRESS 0x3faa91 FORMAT "%8.4" /end MEASUREMENT
/begin MEASUREMENT ozvfbdmew "" UBYTE _CNV_R_R_dez_498_CM 1 100. 0. 255. DISPLAY_IDENTIFIER OZVFBDMEW ECU_ADDRESS 0x3fad24 FORMAT "%8.4" /end MEASUREMENT
/begin MEASUREMENT vbost "" UBYTE _CNV_R_R_dez_498_CM 1 100. 0. 255. DISPLAY_IDENTIFIER VBOST ECU_ADDRESS 0x3fdbb7 FORMAT "%8.4" /end MEASUREMENT
/begin MEASUREMENT zrbosr "" UBYTE _CNV_R_R_dez_498_CM 1 100. 0. 255. DISPLAY_IDENTIFIER ZRBOSR ECU_ADDRESS 0x3fdbb8 FORMAT "%8.4" /end MEASUREMENT
/begin MEASUREMENT zrbosrt "Servicezählerwert vom Tester" UBYTE _CNV_R_R_dez_498_CM 1 100. 0. 255. DISPLAY_IDENTIFIER ZRBOSRT ECU_ADDRESS 0x3faa92 FORMAT "%8.4" /end MEASUREMENT
/begin CHARACTERISTIC OZKMUPL "" VALUE 0x1a04e _REC_VAL_20_u2 0. _CNV_R_R_nmot_ub_q1_536_CM 0. 655350. FORMAT "%8.4" /end CHARACTERISTIC
/begin CHARACTERISTIC OZNIVKL "Skalierungskennlinie Niveau" CURVE 0x1a012 _REC_CUR_52_UBYTE_u1_u1 0. _CNV_R_R_niv_ub_b75_550_CM 0. 74.707031 FORMAT "%8.4"
 /begin AXIS_DESCR STD_AXIS oznivt _CNV_R_R_dez_498_CM 2 0. 255. FORMAT "%8.4" /end AXIS_DESCR
/end CHARACTERISTIC
/begin CHARACTERISTIC OZPERMKL "Skalierungskennlinie Permittivität" CURVE 0x1a008 _REC_CUR_52_UWORD_u2_u2 0. _CNV_R_R_perm_uw_b6_553_CM 0. 5.9999084 FORMAT "%8.4"
 /begin AXIS_DESCR STD_AXIS ozpermt _CNV_R_R_dez_498_CM 2 0. 1024. FORMAT "%8.4" /end AXIS_DESCR
/end CHARACTERISTIC
/begin CHARACTERISTIC OZTEMPKL "Skalierungskennlinie Temperatur" CURVE 0x1a017 _REC_CUR_52_UBYTE_u1_u1 0. _CNV_R_R_temp_ub_q1_551_CM -48. 207. FORMAT "%8.4"
 /begin AXIS_DESCR STD_AXIS oztempt _CNV_R_R_dez_498_CM 2 0. 255. FORMAT "%8.4" /end AXIS_DESCR
/end CHARACTERISTIC
/begin MEASUREMENT ozggBits2_1s "???" UBYTE _CNV_A_R_LINEAR_____1_CM 1 100. 0. 255. DISPLAY_IDENTIFIER OZGGBITS2_1S ECU_ADDRESS 0x3fad22 FORMAT "%3.0" /end MEASUREMENT
/begin MEASUREMENT ozggBits2_1s.B_dmewech "Bedingung für getauschte DME zur Aktualisierung der BOS-Werte" UBYTE _CNV_A_R_LINEAR_____1_CM 1 100. 0. 255. DISPLAY_IDENTIFIER B_DMEWECH ECU_ADDRESS 0x3fad22 FORMAT "%3.0" BIT_MASK 0x1 /end MEASUREMENT
/begin MEASUREMENT ozggBits2_1s.B_dmeini "Bedingung für neue noch nicht initialisierte DME" UBYTE _CNV_A_R_LINEAR_____1_CM 1 100. 0. 255. DISPLAY_IDENTIFIER B_DMEINI ECU_ADDRESS 0x3fad22 FORMAT "%3.0" BIT_MASK 0x2 /end MEASUREMENT
/begin MEASUREMENT ozggBits1_1s "???" UBYTE _CNV_A_R_LINEAR_____1_CM 1 100. 0. 255. DISPLAY_IDENTIFIER OZGGBITS1_1S ECU_ADDRESS 0x3faa8c FORMAT "%3.0" /end MEASUREMENT
/begin MEASUREMENT ozggBits1_1s.B_svcntchg "Bedingung für über Tester geänderten Servicezähler" UBYTE _CNV_A_R_LINEAR_____1_CM 1 100. 0. 255. DISPLAY_IDENTIFIER B_SVCNTCHG ECU_ADDRESS 0x3faa8c FORMAT "%3.0" BIT_MASK 0x1 /end MEASUREMENT
/begin MEASUREMENT ozggBits1_1s.B_oelwech "Bedingung Ölwechsel erfolgt" UBYTE _CNV_A_R_LINEAR_____1_CM 1 100. 0. 255. DISPLAY_IDENTIFIER B_OELWECH ECU_ADDRESS 0x3faa8c FORMAT "%3.0" BIT_MASK 0x2 /end MEASUREMENT
/begin MEASUREMENT ozggBits1_1s.B_ozniv "Bedingung Niveausignal in Ordnung" UBYTE _CNV_A_R_LINEAR_____1_CM 1 100. 0. 255. DISPLAY_IDENTIFIER B_OZNIV ECU_ADDRESS 0x3faa8c FORMAT "%3.0" BIT_MASK 0x10 /end MEASUREMENT
/begin MEASUREMENT ozggBits1_1s.B_ozperm "Bedingung Permittivitätssignal in Ordnung" UBYTE _CNV_A_R_LINEAR_____1_CM 1 100. 0. 255. DISPLAY_IDENTIFIER B_OZPERM ECU_ADDRESS 0x3faa8c FORMAT "%3.0" BIT_MASK 0x4 /end MEASUREMENT
/begin MEASUREMENT ozggBits1_1s.B_ozvfchg "Bedingung Ölzustandssensor von Temic ist verbaut" UBYTE _CNV_A_R_LINEAR_____1_CM 1 100. 0. 255. DISPLAY_IDENTIFIER B_OZVFCHG ECU_ADDRESS 0x3faa8c FORMAT "%3.0" BIT_MASK 0x20 /end MEASUREMENT
/begin MEASUREMENT ozggBits1_1s.B_oztemp "Bedingung Temperatursignal in Ordnung" UBYTE _CNV_A_R_LINEAR_____1_CM 1 100. 0. 255. DISPLAY_IDENTIFIER B_OZTEMP ECU_ADDRESS 0x3faa8c FORMAT "%3.0" BIT_MASK 0x8 /end MEASUREMENT
/begin MEASUREMENT B_sa "" UBYTE _CNV_R_R_identity_509_CM 1 100. 0. 1. DISPLAY_IDENTIFIER B_SA ECU_ADDRESS 0x3fdf1f FORMAT "%8.4" BIT_MASK 0x1 /end MEASUREMENT
/begin MEASUREMENT ozkrzcnt "Counter für kurzzeitigen Mittelwert Niveau" UBYTE _CNV_R_R_dez_498_CM 1 100. 0. 255. DISPLAY_IDENTIFIER OZKRZCNT ECU_ADDRESS 0x3faaa4 FORMAT "%8.4" /end MEASUREMENT
/begin MEASUREMENT ozkrzmw "kurzzeitiger Mittelwert Niveau" UBYTE _CNV_R_R_niv_ub_b75_550_CM 1 100. 0. 74.707031 DISPLAY_IDENTIFIER OZKRZMW ECU_ADDRESS 0x3faaa5 FORMAT "%8.4" /end MEASUREMENT
/begin MEASUREMENT ozkrzmwkor "kurzzeitiger drehzahlkorrigierter Mittelwert Niveau" UBYTE _CNV_R_R_niv_ub_b75_550_CM 1 100. 0. 74.707031 DISPLAY_IDENTIFIER OZKRZMWKOR ECU_ADDRESS 0x3faaa6 FORMAT "%8.4" /end MEASUREMENT
/begin MEASUREMENT ozlgmwcnt "" UBYTE _CNV_R_R_dez_498_CM 1 100. 0. 255. DISPLAY_IDENTIFIER OZLGMWCNT ECU_ADDRESS 0x3faaa8 FORMAT "%8.4" /end MEASUREMENT
/begin MEASUREMENT oznivlgalt "Langzeitmittelwert Niveau beim Starten des Motors (B_kl15 steigende Flanke)" UBYTE _CNV_R_R_niv_ub_b75_550_CM 1 100. 0. 74.707031 DISPLAY_IDENTIFIER OZNIVLGALT ECU_ADDRESS 0x3faaab FORMAT "%8.4" /end MEASUREMENT
/begin MEASUREMENT oznivlgneu "aktuell gültiger Langzeitmittelwert Niveau" UBYTE _CNV_R_R_niv_ub_b75_550_CM 1 100. 0. 74.707031 DISPLAY_IDENTIFIER OZNIVLGNEU ECU_ADDRESS 0x3faaac FORMAT "%8.4" /end MEASUREMENT
/begin MEASUREMENT oznivnflit "Nachfüllmenge in Liter" SBYTE _CNV_R_R_nivmmxl_ub_554_CM 1 100. -13.546667 13.546667 DISPLAY_IDENTIFIER OZNIVNFLIT ECU_ADDRESS 0x3faaad FORMAT "%8.4" /end MEASUREMENT
/begin MEASUREMENT oznivnfm "" UBYTE _CNV_R_R_nivmmxl_ub_555_CM 1 100. 0. 7.96875 DISPLAY_IDENTIFIER OZNIVNFM ECU_ADDRESS 0x3faaae FORMAT "%8.4" /end MEASUREMENT
/begin MEASUREMENT oznmotmw "kurzzeitiger Mittelwert Drehzahl" UBYTE _CNV_R_R_nmot_ub_q4_510_CM 1 100. 0. 10200. DISPLAY_IDENTIFIER OZNMOTMW ECU_ADDRESS 0x3faaaf FORMAT "%8.4" /end MEASUREMENT
/begin MEASUREMENT ozvormwcnt "Counter für vorgezogenen Mittelwert Niveau" UBYTE _CNV_R_R_dez_498_CM 1 100. 0. 255. DISPLAY_IDENTIFIER OZVORMWCNT ECU_ADDRESS 0x3faab1 FORMAT "%8.4" /end MEASUREMENT
/begin CHARACTERISTIC OZMWK "Anzahl der Messwerte für Kurzzeit-Mittelwert Niveau" VALUE 0x1a03f _REC_VAL_20_u1 0. _CNV_R_R_dez_498_CM 1. 255. FORMAT "%8.4" /end CHARACTERISTIC
/begin CHARACTERISTIC OZMWL "Anzahl der Messwerte für Langzeit-Mittelwert Niveau" VALUE 0x1a040 _REC_VAL_20_u1 0. _CNV_R_R_dez_498_CM 1. 255. FORMAT "%8.4" /end CHARACTERISTIC
/begin CHARACTERISTIC OZMWOR "Anzahl der Messwerte für Orientierungsmessung" VALUE 0x1a041 _REC_VAL_20_u1 0. _CNV_R_R_dez_498_CM 1. 255. FORMAT "%8.4" /end CHARACTERISTIC
/begin CHARACTERISTIC OZMWV "Anzahl der Messwerte für vorgezogenen Mittelwert Niveau" VALUE 0x1a042 _REC_VAL_20_u1 0. _CNV_R_R_dez_498_CM 1. 255. FORMAT "%8.4" /end CHARACTERISTIC
/begin CHARACTERISTIC OZNFCNT "Anzahl Werte für Nachfüllerkennung" VALUE 0x1a043 _REC_VAL_20_u1 0. _CNV_R_R_dez_498_CM 1. 255. FORMAT "%8.4" /end CHARACTERISTIC
/begin CHARACTERISTIC OZNFTMPMAX "obere Temperaturgrenze für Nachfüllerkennung" VALUE 0x1a044 _REC_VAL_20_u1 0. _CNV_R_R_temp_ub_q1_551_CM -48. 207. FORMAT "%8.4" /end CHARACTERISTIC
/begin CHARACTERISTIC OZNFTMPMIN "untere Temperaturgrenze für Nachfüllerkennung" VALUE 0x1a045 _REC_VAL_20_u1 0. _CNV_R_R_temp_ub_q1_551_CM -48. 207. FORMAT "%8.4" /end CHARACTERISTIC
/begin CHARACTERISTIC OZNIVMMLIT "Umrechnungsfaktor für Ölniveau von mm in Liter" VALUE 0x1a046 _REC_VAL_20_u1 0. _CNV_R_R_fak_ub_b1_534_CM 0. 0.99609375 FORMAT "%8.4" /end CHARACTERISTIC
/begin CHARACTERISTIC OZNIVNFM05 "Niveauschwelle für Erkennung 0,5 Liter nachgefüllt" VALUE 0x1a047 _REC_VAL_20_u1 0. _CNV_R_R_nivmmxl_ub_555_CM 0. 7.96875 FORMAT "%8.4" /end CHARACTERISTIC
/begin CHARACTERISTIC OZNIVNFM10 "Niveauschwelle für Erkennung 1,0 Liter nachgefüllt" VALUE 0x1a048 _REC_VAL_20_u1 0. _CNV_R_R_nivmmxl_ub_555_CM 0. 7.96875 FORMAT "%8.4" /end CHARACTERISTIC
/begin CHARACTERISTIC OZNMNIVKL "Kennlinie für Drehzahlkorrektur des Niveaus" CURVE 0x1a01e _REC_CUR_52_UBYTE_u1_u1 0. _CNV_R_R_niv_sb_b37_556_CM -37.5 37.207031 FORMAT "%8.4"
 /begin AXIS_DESCR STD_AXIS oznmotmw _CNV_R_R_nmot_ub_q4_510_CM 16 0. 10200. FORMAT "%8.4" /end AXIS_DESCR
/end CHARACTERISTIC
/begin CHARACTERISTIC OZNMOTMAX "obere Drehzahlgrenze für drehzahlkorrigierten Niveaumittelwert" VALUE 0x1a049 _REC_VAL_20_u1 0. _CNV_R_R_nmot_ub_q4_510_CM 0. 10200. FORMAT "%8.4" /end CHARACTERISTIC
/begin CHARACTERISTIC OZNMOTMIN "untere Drehzahlgrenze für drehzahlkorrigierten Niveaumittelwert" VALUE 0x1a04a _REC_VAL_20_u1 0. _CNV_R_R_nmot_ub_q4_510_CM 0. 10200. FORMAT "%8.4" /end CHARACTERISTIC
/begin CHARACTERISTIC OZTEMPBW "Temperaturschwelle Öltemperatur Motor betriebswarm" VALUE 0x1a04b _REC_VAL_20_u1 0. _CNV_R_R_temp_ub_q1_551_CM -48. 207. FORMAT "%8.4" /end CHARACTERISTIC
/begin CHARACTERISTIC OZTEMPORR "Temperaturschwelle für Orientierungsmessung" VALUE 0x1a04c _REC_VAL_20_u1 0. _CNV_R_R_temp_ub_q1_551_CM -48. 207. FORMAT "%8.4" /end CHARACTERISTIC
/begin MEASUREMENT oznivBits3_1s "???" UBYTE _CNV_A_R_LINEAR_____1_CM 1 100. 0. 255. DISPLAY_IDENTIFIER OZNIVBITS3_1S ECU_ADDRESS 0x3faaaa FORMAT "%3.0" /end MEASUREMENT
/begin MEASUREMENT oznivBits3_1s.B_ozor "Bedingung Orientierungsmessung erfolgt" UBYTE _CNV_A_R_LINEAR_____1_CM 1 100. 0. 255. DISPLAY_IDENTIFIER B_OZOR ECU_ADDRESS 0x3faaaa FORMAT "%3.0" BIT_MASK 0x1 /end MEASUREMENT
/begin MEASUREMENT oznivBits3_1s.B_ozvormw "Bedingung vorgezogener Mittelwert berechnet" UBYTE _CNV_A_R_LINEAR_____1_CM 1 100. 0. 255. DISPLAY_IDENTIFIER B_OZVORMW ECU_ADDRESS 0x3faaaa FORMAT "%3.0" BIT_MASK 0x2 /end MEASUREMENT
/begin MEASUREMENT oznivBits4_1s "???" UBYTE _CNV_A_R_LINEAR_____1_CM 1 100. 0. 255. DISPLAY_IDENTIFIER OZNIVBITS4_1S ECU_ADDRESS 0x3fad27 FORMAT "%3.0" /end MEASUREMENT
/begin MEASUREMENT oznivBits4_1s.B_ozlangmw "Bedingung Langzeit-Mittelwert berechnet" UBYTE _CNV_A_R_LINEAR_____1_CM 1 100. 0. 255. DISPLAY_IDENTIFIER B_OZLANGMW ECU_ADDRESS 0x3fad27 FORMAT "%3.0" BIT_MASK 0x1 /end MEASUREMENT
/begin MEASUREMENT oznivBits2_1s "???" UBYTE _CNV_A_R_LINEAR_____1_CM 1 100. 0. 255. DISPLAY_IDENTIFIER OZNIVBITS2_1S ECU_ADDRESS 0x3fad26 FORMAT "%3.0" /end MEASUREMENT
/begin MEASUREMENT oznivBits2_1s.B_ozlw1 "Bedingung mindestens ein gültiger Langzeitmittelwert war vorhanden" UBYTE _CNV_A_R_LINEAR_____1_CM 1 100. 0. 255. DISPLAY_IDENTIFIER B_OZLW1 ECU_ADDRESS 0x3fad26 FORMAT "%3.0" BIT_MASK 0x1 /end MEASUREMENT
/begin MEASUREMENT oznivBits1_1s "???" UBYTE _CNV_A_R_LINEAR_____1_CM 1 100. 0. 255. DISPLAY_IDENTIFIER OZNIVBITS1_1S ECU_ADDRESS 0x3faaa9 FORMAT "%3.0" /end MEASUREMENT
/begin MEASUREMENT oznivBits1_1s.B_ozkrzkor "Bedingung mindestens ein gültiger Langzeitmittelwert war vorhanden" UBYTE _CNV_A_R_LINEAR_____1_CM 1 100. 0. 255. DISPLAY_IDENTIFIER B_OZKRZKOR ECU_ADDRESS 0x3faaa9 FORMAT "%3.0" BIT_MASK 0x1 /end MEASUREMENT
/begin MEASUREMENT oznivBits1_1s.B_ozlw2 "Bedingung mindestens ein gültiger Langzeitmittelwert war vorhanden" UBYTE _CNV_A_R_LINEAR_____1_CM 1 100. 0. 255. DISPLAY_IDENTIFIER B_OZLW2 ECU_ADDRESS 0x3faaa9 FORMAT "%3.0" BIT_MASK 0x2 /end MEASUREMENT
/begin MEASUREMENT oznivBits1_1s.B_oznferk "Bedingung mindestens ein gültiger Langzeitmittelwert war vorhanden" UBYTE _CNV_A_R_LINEAR_____1_CM 1 100. 0. 255. DISPLAY_IDENTIFIER B_OZNFERK ECU_ADDRESS 0x3faaa9 FORMAT "%3.0" BIT_MASK 0x4 /end MEASUREMENT
/begin MEASUREMENT B_eepinioz "" SBYTE _CNV_R_R_identity_509_CM 1 100. 0. 1. DISPLAY_IDENTIFIER B_EEPINIOZ ECU_ADDRESS 0x3fdf15 FORMAT "%8.4" BIT_MASK 0x1 /end MEASUREMENT
/begin MEASUREMENT ozdindex "Zähler für Permittivitätaufbereitung (>= 6 -> Auswertung)" UBYTE _CNV_R_R_dez_498_CM 1 100. 0. 255. DISPLAY_IDENTIFIER OZDINDEX ECU_ADDRESS 0x3faacc FORMAT "%8.4" /end MEASUREMENT
/begin MEASUREMENT ozdperm "Delta-Er" SWORD _CNV_R_R_perm_sw_b6_557_CM 1 100. -6. 5.9998169 DISPLAY_IDENTIFIER OZDPERM ECU_ADDRESS 0x3faab2 BYTE_ORDER MSB_LAST FORMAT "%8.4" /end MEASUREMENT
/begin MEASUREMENT ozdpermsi "Index des letzten Kilometerstandes bei dem noch sicher keine Nachfüllung vorlag" SBYTE _CNV_R_R_dez_498_CM 1 100. -128. 127. DISPLAY_IDENTIFIER OZDPERMSI ECU_ADDRESS 0x3faacd FORMAT "%8.4" /end MEASUREMENT
/begin MEASUREMENT ozeranzp1 "Anzahl Punkte P1" UBYTE _CNV_R_R_dez_498_CM 1 100. 0. 255. DISPLAY_IDENTIFIER OZERANZP1 ECU_ADDRESS 0x3faace FORMAT "%8.4" /end MEASUREMENT
/begin MEASUREMENT ozeranzp2 "Anzahl Punkte P2" UBYTE _CNV_R_R_dez_498_CM 1 100. 0. 255. DISPLAY_IDENTIFIER OZERANZP2 ECU_ADDRESS 0x3faacf FORMAT "%8.4" /end MEASUREMENT
/begin MEASUREMENT ozeranzprf "Anzahl Punkte Pruefpunkt" UBYTE _CNV_R_R_dez_498_CM 1 100. 0. 255. DISPLAY_IDENTIFIER OZERANZPRF ECU_ADDRESS 0x3faad0 FORMAT "%8.4" /end MEASUREMENT
/begin MEASUREMENT ozkmlow "Kilometerstand letzter Ölwechsel" SWORD _CNV_R_R_km_sw_q10_549_CM 1 100. -327670. 327670. DISPLAY_IDENTIFIER OZKMLOW ECU_ADDRESS 0x3fad28 BYTE_ORDER MSB_LAST FORMAT "%8.4" /end MEASUREMENT
/begin MEASUREMENT ozkmpermgl "Kilometerstand bei gültigem Permittivitätsmittelwert" UWORD _CNV_R_R_nmot_ub_q1_536_CM 1 100. 0. 655350. DISPLAY_IDENTIFIER OZKMPERMGL ECU_ADDRESS 0x3faab4 BYTE_ORDER MSB_LAST FORMAT "%8.4" /end MEASUREMENT
/begin MEASUREMENT ozkmreg[0] "Schieberegister Kilometerstand" UWORD _CNV_R_R_nmot_ub_q1_536_CM 1 100. 0. 655350. DISPLAY_IDENTIFIER OZKMREG_0_ ECU_ADDRESS 0x3fad2a BYTE_ORDER MSB_LAST FORMAT "%8.4" /end MEASUREMENT
/begin MEASUREMENT ozkmreg[1] "Schieberegister Kilometerstand" UWORD _CNV_R_R_nmot_ub_q1_536_CM 1 100. 0. 655350. DISPLAY_IDENTIFIER OZKMREG_1_ ECU_ADDRESS 0x3fad2c BYTE_ORDER MSB_LAST FORMAT "%8.4" /end MEASUREMENT
/begin MEASUREMENT ozkmreg[2] "Schieberegister Kilometerstand" UWORD _CNV_R_R_nmot_ub_q1_536_CM 1 100. 0. 655350. DISPLAY_IDENTIFIER OZKMREG_2_ ECU_ADDRESS 0x3fad2e BYTE_ORDER MSB_LAST FORMAT "%8.4" /end MEASUREMENT
/begin MEASUREMENT ozkmreg[3] "Schieberegister Kilometerstand" UWORD _CNV_R_R_nmot_ub_q1_536_CM 1 100. 0. 655350. DISPLAY_IDENTIFIER OZKMREG_3_ ECU_ADDRESS 0x3fad30 BYTE_ORDER MSB_LAST FORMAT "%8.4" /end MEASUREMENT
/begin MEASUREMENT ozkmreg[4] "Schieberegister Kilometerstand" UWORD _CNV_R_R_nmot_ub_q1_536_CM 1 100. 0. 655350. DISPLAY_IDENTIFIER OZKMREG_4_ ECU_ADDRESS 0x3fad32 BYTE_ORDER MSB_LAST FORMAT "%8.4" /end MEASUREMENT
/begin MEASUREMENT ozkmreg[5] "Schieberegister Kilometerstand" UWORD _CNV_R_R_nmot_ub_q1_536_CM 1 100. 0. 655350. DISPLAY_IDENTIFIER OZKMREG_5_ ECU_ADDRESS 0x3fad34 BYTE_ORDER MSB_LAST FORMAT "%8.4" /end MEASUREMENT
/begin MEASUREMENT ozkmreg[6] "Schieberegister Kilometerstand" UWORD _CNV_R_R_nmot_ub_q1_536_CM 1 100. 0. 655350. DISPLAY_IDENTIFIER OZKMREG_6_ ECU_ADDRESS 0x3fad36 BYTE_ORDER MSB_LAST FORMAT "%8.4" /end MEASUREMENT
/begin MEASUREMENT ozkmreg[7] "Schieberegister Kilometerstand" UWORD _CNV_R_R_nmot_ub_q1_536_CM 1 100. 0. 655350. DISPLAY_IDENTIFIER OZKMREG_7_ ECU_ADDRESS 0x3fad38 BYTE_ORDER MSB_LAST FORMAT "%8.4" /end MEASUREMENT
/begin MEASUREMENT ozkmreg[8] "Schieberegister Kilometerstand" UWORD _CNV_R_R_nmot_ub_q1_536_CM 1 100. 0. 655350. DISPLAY_IDENTIFIER OZKMREG_8_ ECU_ADDRESS 0x3fad3a BYTE_ORDER MSB_LAST FORMAT "%8.4" /end MEASUREMENT
/begin MEASUREMENT ozkmreg[9] "Schieberegister Kilometerstand" UWORD _CNV_R_R_nmot_ub_q1_536_CM 1 100. 0. 655350. DISPLAY_IDENTIFIER OZKMREG_9_ ECU_ADDRESS 0x3fad3c BYTE_ORDER MSB_LAST FORMAT "%8.4" /end MEASUREMENT
/begin MEASUREMENT ozkmreg[10] "Schieberegister Kilometerstand" UWORD _CNV_R_R_nmot_ub_q1_536_CM 1 100. 0. 655350. DISPLAY_IDENTIFIER OZKMREG_10_ ECU_ADDRESS 0x3fad3e BYTE_ORDER MSB_LAST FORMAT "%8.4" /end MEASUREMENT
/begin MEASUREMENT ozkmreg[11] "Schieberegister Kilometerstand" UWORD _CNV_R_R_nmot_ub_q1_536_CM 1 100. 0. 655350. DISPLAY_IDENTIFIER OZKMREG_11_ ECU_ADDRESS 0x3fad40 BYTE_ORDER MSB_LAST FORMAT "%8.4" /end MEASUREMENT
/begin MEASUREMENT ozkmreg[12] "Schieberegister Kilometerstand" UWORD _CNV_R_R_nmot_ub_q1_536_CM 1 100. 0. 655350. DISPLAY_IDENTIFIER OZKMREG_12_ ECU_ADDRESS 0x3fad42 BYTE_ORDER MSB_LAST FORMAT "%8.4" /end MEASUREMENT
/begin MEASUREMENT ozkmreg[13] "Schieberegister Kilometerstand" UWORD _CNV_R_R_nmot_ub_q1_536_CM 1 100. 0. 655350. DISPLAY_IDENTIFIER OZKMREG_13_ ECU_ADDRESS 0x3fad44 BYTE_ORDER MSB_LAST FORMAT "%8.4" /end MEASUREMENT
/begin MEASUREMENT ozkmreg[14] "Schieberegister Kilometerstand" UWORD _CNV_R_R_nmot_ub_q1_536_CM 1 100. 0. 655350. DISPLAY_IDENTIFIER OZKMREG_14_ ECU_ADDRESS 0x3fad46 BYTE_ORDER MSB_LAST FORMAT "%8.4" /end MEASUREMENT
/begin MEASUREMENT ozlaufvar "Schleifenzähler Punkteberechnung" UBYTE _CNV_R_R_dez_498_CM 1 100. 0. 255. DISPLAY_IDENTIFIER OZLAUFVAR ECU_ADDRESS 0x3faad1 FORMAT "%8.4" /end MEASUREMENT
/begin MEASUREMENT ozlf1t "Länderfaktor 1" UBYTE _CNV_R_R_lf_ub_552_CM 1 100. 0. 2.55 DISPLAY_IDENTIFIER OZLF1T ECU_ADDRESS 0x3fad88 FORMAT "%8.4" /end MEASUREMENT
/begin MEASUREMENT oznivkm "letzter Kilometerstand bei dem ein neuer Langzeitmittelwert Niveau vorlag und kein Öl nachgefüllt wurde" UWORD _CNV_R_R_nmot_ub_q1_536_CM 1 100. 0. 655350. DISPLAY_IDENTIFIER OZNIVKM ECU_ADDRESS 0x3fad48 BYTE_ORDER MSB_LAST FORMAT "%8.4" /end MEASUREMENT
/begin MEASUREMENT ozoelkm "" UWORD _CNV_R_R_nmot_ub_q1_536_CM 1 100. 0. 655350. DISPLAY_IDENTIFIER OZOELKM ECU_ADDRESS 0x3fad4a BYTE_ORDER MSB_LAST FORMAT "%8.4" /end MEASUREMENT
/begin MEASUREMENT ozpermanz "Anzahl der Messwerte im Schieberegister" SBYTE _CNV_R_R_dez_498_CM 1 100. -128. 127. DISPLAY_IDENTIFIER OZPERMANZ ECU_ADDRESS 0x3fad72 FORMAT "%8.4" /end MEASUREMENT
/begin MEASUREMENT ozpermerp1 "Permittivität Punkt P1" UWORD _CNV_R_R_perm_uw_b6_553_CM 1 100. 0. 5.9999084 DISPLAY_IDENTIFIER OZPERMERP1 ECU_ADDRESS 0x3faab6 BYTE_ORDER MSB_LAST FORMAT "%8.4" /end MEASUREMENT
/begin MEASUREMENT ozpermerp2 "Permittivität Punkt P2" UWORD _CNV_R_R_perm_uw_b6_553_CM 1 100. 0. 5.9999084 DISPLAY_IDENTIFIER OZPERMERP2 ECU_ADDRESS 0x3faab8 BYTE_ORDER MSB_LAST FORMAT "%8.4" /end MEASUREMENT
/begin MEASUREMENT ozpermerpr "Permittivität Pruefpunkt" UWORD _CNV_R_R_perm_uw_b6_553_CM 1 100. 0. 5.9999084 DISPLAY_IDENTIFIER OZPERMERPR ECU_ADDRESS 0x3faaba BYTE_ORDER MSB_LAST FORMAT "%8.4" /end MEASUREMENT
/begin MEASUREMENT ozpermkmp1 "Kilometerstand Punkt P1" UWORD _CNV_R_R_nmot_ub_q1_536_CM 1 100. 0. 655350. DISPLAY_IDENTIFIER OZPERMKMP1 ECU_ADDRESS 0x3faabc BYTE_ORDER MSB_LAST FORMAT "%8.4" /end MEASUREMENT
/begin MEASUREMENT ozpermkmp2 "Kilometerstand Punkt P2" UWORD _CNV_R_R_nmot_ub_q1_536_CM 1 100. 0. 655350. DISPLAY_IDENTIFIER OZPERMKMP2 ECU_ADDRESS 0x3faabe BYTE_ORDER MSB_LAST FORMAT "%8.4" /end MEASUREMENT
/begin MEASUREMENT ozpermkmpr "Kilometerstand Pruefpunkt" UWORD _CNV_R_R_nmot_ub_q1_536_CM 1 100. 0. 655350. DISPLAY_IDENTIFIER OZPERMKMPR ECU_ADDRESS 0x3faac0 BYTE_ORDER MSB_LAST FORMAT "%8.4" /end MEASUREMENT
/begin MEASUREMENT ozpermko_w "korrigierter gültiger Permittivitätswert" UWORD _CNV_R_R_perm_uw_b6_553_CM 1 100. 0. 5.9999084 DISPLAY_IDENTIFIER OZPERMKO_W ECU_ADDRESS 0x3faac2 BYTE_ORDER MSB_LAST FORMAT "%8.4" /end MEASUREMENT
/begin MEASUREMENT ozpermoff "Offset für Permittivitätskorrektur" SWORD _CNV_R_R_perm_sw_b6_557_CM 1 100. -6. 5.9998169 DISPLAY_IDENTIFIER OZPERMOFF ECU_ADDRESS 0x3fad50 BYTE_ORDER MSB_LAST FORMAT "%8.4" /end MEASUREMENT
/begin MEASUREMENT ozpermpl_w "gültiger Permittivitätsmittelwert" UWORD _CNV_R_R_perm_uw_b6_553_CM 1 100. 0. 5.9999084 DISPLAY_IDENTIFIER OZPERMPL_W ECU_ADDRESS 0x3faac4 BYTE_ORDER MSB_LAST FORMAT "%8.4" /end MEASUREMENT
/begin MEASUREMENT ozpermreg[0] "Schieberegister Permittivität" UWORD _CNV_R_R_perm_uw_b6_553_CM 1 100. 0. 5.9999084 DISPLAY_IDENTIFIER OZPERMREG_0_ ECU_ADDRESS 0x3fad52 BYTE_ORDER MSB_LAST FORMAT "%8.4" /end MEASUREMENT
/begin MEASUREMENT ozpermreg[1] "Schieberegister Permittivität" UWORD _CNV_R_R_perm_uw_b6_553_CM 1 100. 0. 5.9999084 DISPLAY_IDENTIFIER OZPERMREG_1_ ECU_ADDRESS 0x3fad54 BYTE_ORDER MSB_LAST FORMAT "%8.4" /end MEASUREMENT
/begin MEASUREMENT ozpermreg[2] "Schieberegister Permittivität" UWORD _CNV_R_R_perm_uw_b6_553_CM 1 100. 0. 5.9999084 DISPLAY_IDENTIFIER OZPERMREG_2_ ECU_ADDRESS 0x3fad56 BYTE_ORDER MSB_LAST FORMAT "%8.4" /end MEASUREMENT
/begin MEASUREMENT ozpermreg[3] "Schieberegister Permittivität" UWORD _CNV_R_R_perm_uw_b6_553_CM 1 100. 0. 5.9999084 DISPLAY_IDENTIFIER OZPERMREG_3_ ECU_ADDRESS 0x3fad58 BYTE_ORDER MSB_LAST FORMAT "%8.4" /end MEASUREMENT
/begin MEASUREMENT ozpermreg[4] "Schieberegister Permittivität" UWORD _CNV_R_R_perm_uw_b6_553_CM 1 100. 0. 5.9999084 DISPLAY_IDENTIFIER OZPERMREG_4_ ECU_ADDRESS 0x3fad5a BYTE_ORDER MSB_LAST FORMAT "%8.4" /end MEASUREMENT
/begin MEASUREMENT ozpermreg[5] "Schieberegister Permittivität" UWORD _CNV_R_R_perm_uw_b6_553_CM 1 100. 0. 5.9999084 DISPLAY_IDENTIFIER OZPERMREG_5_ ECU_ADDRESS 0x3fad5c BYTE_ORDER MSB_LAST FORMAT "%8.4" /end MEASUREMENT
/begin MEASUREMENT ozpermreg[6] "Schieberegister Permittivität" UWORD _CNV_R_R_perm_uw_b6_553_CM 1 100. 0. 5.9999084 DISPLAY_IDENTIFIER OZPERMREG_6_ ECU_ADDRESS 0x3fad5e BYTE_ORDER MSB_LAST FORMAT "%8.4" /end MEASUREMENT
/begin MEASUREMENT ozpermreg[7] "Schieberegister Permittivität" UWORD _CNV_R_R_perm_uw_b6_553_CM 1 100. 0. 5.9999084 DISPLAY_IDENTIFIER OZPERMREG_7_ ECU_ADDRESS 0x3fad60 BYTE_ORDER MSB_LAST FORMAT "%8.4" /end MEASUREMENT
/begin MEASUREMENT ozpermreg[8] "Schieberegister Permittivität" UWORD _CNV_R_R_perm_uw_b6_553_CM 1 100. 0. 5.9999084 DISPLAY_IDENTIFIER OZPERMREG_8_ ECU_ADDRESS 0x3fad62 BYTE_ORDER MSB_LAST FORMAT "%8.4" /end MEASUREMENT
/begin MEASUREMENT ozpermreg[9] "Schieberegister Permittivität" UWORD _CNV_R_R_perm_uw_b6_553_CM 1 100. 0. 5.9999084 DISPLAY_IDENTIFIER OZPERMREG_9_ ECU_ADDRESS 0x3fad64 BYTE_ORDER MSB_LAST FORMAT "%8.4" /end MEASUREMENT
/begin MEASUREMENT ozpermreg[10] "Schieberegister Permittivität" UWORD _CNV_R_R_perm_uw_b6_553_CM 1 100. 0. 5.9999084 DISPLAY_IDENTIFIER OZPERMREG_10_ ECU_ADDRESS 0x3fad66 BYTE_ORDER MSB_LAST FORMAT "%8.4" /end MEASUREMENT
/begin MEASUREMENT ozpermreg[11] "Schieberegister Permittivität" UWORD _CNV_R_R_perm_uw_b6_553_CM 1 100. 0. 5.9999084 DISPLAY_IDENTIFIER OZPERMREG_11_ ECU_ADDRESS 0x3fad68 BYTE_ORDER MSB_LAST FORMAT "%8.4" /end MEASUREMENT
/begin MEASUREMENT ozpermreg[12] "Schieberegister Permittivität" UWORD _CNV_R_R_perm_uw_b6_553_CM 1 100. 0. 5.9999084 DISPLAY_IDENTIFIER OZPERMREG_12_ ECU_ADDRESS 0x3fad6a BYTE_ORDER MSB_LAST FORMAT "%8.4" /end MEASUREMENT
/begin MEASUREMENT ozpermreg[13] "Schieberegister Permittivität" UWORD _CNV_R_R_perm_uw_b6_553_CM 1 100. 0. 5.9999084 DISPLAY_IDENTIFIER OZPERMREG_13_ ECU_ADDRESS 0x3fad6c BYTE_ORDER MSB_LAST FORMAT "%8.4" /end MEASUREMENT
/begin MEASUREMENT ozpermreg[14] "Schieberegister Permittivität" UWORD _CNV_R_R_perm_uw_b6_553_CM 1 100. 0. 5.9999084 DISPLAY_IDENTIFIER OZPERMREG_14_ ECU_ADDRESS 0x3fad6e BYTE_ORDER MSB_LAST FORMAT "%8.4" /end MEASUREMENT
/begin MEASUREMENT ozprfstrg "Zähler für Delta Er-Ermittlung" UBYTE _CNV_R_R_dez_498_CM 1 100. 0. 255. DISPLAY_IDENTIFIER OZPRFSTRG ECU_ADDRESS 0x3fad75 FORMAT "%8.4" /end MEASUREMENT
/begin MEASUREMENT ozshift "Schleifenzähler für Schieberegister" UBYTE _CNV_R_R_dez_498_CM 1 100. 0. 255. DISPLAY_IDENTIFIER OZSHIFT ECU_ADDRESS 0x3faad3 FORMAT "%8.4" /end MEASUREMENT
/begin MEASUREMENT oztv1 "Zwischenvariable1 Permittivitätsaufbereitung" SWORD _CNV_R_R_nmot_ub_q1_536_CM 1 100. -327680. 327670. DISPLAY_IDENTIFIER OZTV1 ECU_ADDRESS 0x3faac6 BYTE_ORDER MSB_LAST FORMAT "%8.4" /end MEASUREMENT
/begin MEASUREMENT oztv2 "Zwischenvariable2 Permittivitätsaufbereitung" SWORD _CNV_R_R_nmot_ub_q1_536_CM 1 100. -327680. 327670. DISPLAY_IDENTIFIER OZTV2 ECU_ADDRESS 0x3faac8 BYTE_ORDER MSB_LAST FORMAT "%8.4" /end MEASUREMENT
/begin MEASUREMENT oztv3 "Zwischenvariable3 Permittivitätsaufbereitung" UWORD _CNV_R_R_perm_uw_b6_553_CM 1 100. 0. 5.9999084 DISPLAY_IDENTIFIER OZTV3 ECU_ADDRESS 0x3faaca BYTE_ORDER MSB_LAST FORMAT "%8.4" /end MEASUREMENT
/begin MEASUREMENT ozvfbfak "" UBYTE _CNV_R_R_lf_ub_552_CM 1 100. 0. 2.55 DISPLAY_IDENTIFIER OZVFBFAK ECU_ADDRESS 0x3faad4 FORMAT "%8.4" /end MEASUREMENT
/begin MEASUREMENT todeltime "Zähler Ausheizzeit (nichtflüchtig)" SWORD _CNV_R_R_dez_498_CM 1 100. -32768. 32767. DISPLAY_IDENTIFIER TODELTIME ECU_ADDRESS 0x3fad70 BYTE_ORDER MSB_LAST FORMAT "%8.4" /end MEASUREMENT
/begin CHARACTERISTIC OZBZKMSTK1 "" VALUE 0x1a064 _REC_VAL_20_u2 0. _CNV_R_R_nmot_ub_q1_536_CM 0. 655350. FORMAT "%8.4" /end CHARACTERISTIC
/begin CHARACTERISTIC OZOELKMPL "gefahrene Strecke nach Ölwechsel, ab wo Er-Auswertung erfolgt" VALUE 0x1a05c _REC_VAL_20_u1 0. _CNV_R_R_nmot_ub_q1_536_CM 0. 2550. FORMAT "%8.4" /end CHARACTERISTIC
/begin CHARACTERISTIC OZPERMCOK5 "minimale Anzahl der Messwerte für einen gültigen Permittivitätswert" VALUE 0x1a050 _REC_VAL_20_u2 0. _CNV_R_R_dez_498_CM 0. 65535. FORMAT "%8.4" /end CHARACTERISTIC
/begin CHARACTERISTIC OZPERMMIN "minimaler Permittivitätswert für gültige Auswertung" VALUE 0x1a052 _REC_VAL_20_u2 0. _CNV_R_R_perm_uw_b6_553_CM 0. 5.9999084 FORMAT "%8.4" /end CHARACTERISTIC
/begin CHARACTERISTIC OZPERMMNIV "Niveauschwelle für gültige Permittivitätsauswertung" VALUE 0x1a05d _REC_VAL_20_u1 0. _CNV_R_R_niv_ub_b75_550_CM 0. 74.707031 FORMAT "%8.4" /end CHARACTERISTIC
/begin CHARACTERISTIC OZPERMNK3 "Drehzahlschwelle für Er-Ausblendung" VALUE 0x1a05e _REC_VAL_20_u1 0. _CNV_R_R_nmot_ub_q4_510_CM 0. 10200. FORMAT "%8.4" /end CHARACTERISTIC
/begin CHARACTERISTIC OZPERMTIK6 "Mittelungszeitraum Permittivität" VALUE 0x1a054 _REC_VAL_20_u2 0. _CNV_R_R_dez_498_CM 0. 65535. FORMAT "%8.4" /end CHARACTERISTIC
/begin CHARACTERISTIC OZPERMTIK8 "Ausheizzeit" VALUE 0x1a056 _REC_VAL_20_u2 0. _CNV_R_R_dez_498_CM 0. 65535. FORMAT "%8.4" /end CHARACTERISTIC
/begin CHARACTERISTIC OZPERMTIK9 "maximale Zeit nach B_ozpermpl = true, Neustart und oztempf < OZPERMTI in der eine gültige Messung erfolgen kann (Kaltzeitschwelle)" VALUE 0x1a058 _REC_VAL_20_u2 0. _CNV_R_R_dez_498_CM 0. 65535. FORMAT "%8.4" /end CHARACTERISTIC
/begin CHARACTERISTIC OZPERMTK12 "Untere Temperaturgrenze Messfenster Permittivität" VALUE 0x1a05f _REC_VAL_20_u1 0. _CNV_R_R_temp_ub_q1_551_CM -48. 207. FORMAT "%8.4" /end CHARACTERISTIC
/begin CHARACTERISTIC OZPERMTK13 "Obere Temperaturgrenze Messfenster Permittivität" VALUE 0x1a060 _REC_VAL_20_u1 0. _CNV_R_R_temp_ub_q1_551_CM -48. 207. FORMAT "%8.4" /end CHARACTERISTIC
/begin CHARACTERISTIC OZPERMTK4 "Abklingzeit Drehzahlschwelle" VALUE 0x1a05a _REC_VAL_20_u2 0. _CNV_R_R_dez_498_CM 0. 65535. FORMAT "%8.4" /end CHARACTERISTIC
/begin CHARACTERISTIC OZPERMTK7 "Ausheiztemperatur" VALUE 0x1a061 _REC_VAL_20_u1 0. _CNV_R_R_temp_ub_q1_551_CM -48. 207. FORMAT "%8.4" /end CHARACTERISTIC
/begin MEASUREMENT kvaverbr "" UWORD _CNV_R_R_fuel_uw_b6_558_CM 1 100. 0. 65535. DISPLAY_IDENTIFIER KVAVERBR ECU_ADDRESS 0x3fcf00 BYTE_ORDER MSB_LAST FORMAT "%8.4" /end MEASUREMENT
/begin MEASUREMENT kvaverl "Kraftstoffverbrauch um einen Abtastwert verzögert" UWORD _CNV_R_R_fuel_uw_b6_558_CM 1 100. 0. 65535. DISPLAY_IDENTIFIER KVAVERL ECU_ADDRESS 0x3faad8 BYTE_ORDER MSB_LAST FORMAT "%8.4" /end MEASUREMENT
/begin MEASUREMENT ozcttagini "Initialwert für Ölzeitzähler" UWORD _CNV_R_R_dez_498_CM 1 100. -32767. 32767. DISPLAY_IDENTIFIER OZCTTAGINI ECU_ADDRESS 0x3fad78 BYTE_ORDER MSB_LAST FORMAT "%8.4" /end MEASUREMENT
/begin MEASUREMENT ozdkvb "Kraftstoffverbrauch innerhalb der letzten Sekunde" UWORD _CNV_R_R_fuel_uw_b6_558_CM 1 100. 0. 65535. DISPLAY_IDENTIFIER OZDKVB ECU_ADDRESS 0x3faada BYTE_ORDER MSB_LAST FORMAT "%8.4" /end MEASUREMENT
/begin MEASUREMENT ozgwfnbo "Gewichtungsfaktor Nachfüllbonus" UBYTE _CNV_R_R_fak_ub_b1_534_CM 1 100. 0. 0.99609375 DISPLAY_IDENTIFIER OZGWFNBO ECU_ADDRESS 0x3fab20 FORMAT "%8.4" /end MEASUREMENT
/begin MEASUREMENT ozkmstrw0 "Kilometerstand bei Restweg = Null" UWORD _CNV_R_R_km_sw_q10_549_CM 1 100. 0. 655350. DISPLAY_IDENTIFIER OZKMSTRW0 ECU_ADDRESS 0x3fad7a BYTE_ORDER MSB_LAST FORMAT "%8.4" /end MEASUREMENT
/begin MEASUREMENT ozkvbbgw "gewichteter Bonus Kraftstoffverbrauch" UWORD _CNV_R_R_fuel_uw_q1_559_CM 1 100. 0. 2000. DISPLAY_IDENTIFIER OZKVBBGW ECU_ADDRESS 0x3faadc BYTE_ORDER MSB_LAST FORMAT "%8.4" /end MEASUREMENT
/begin MEASUREMENT ozkvbdmew "Kraftstoffverbrauch aus eingeprägter Verfügbarkeit" UWORD _CNV_R_R_fuel_uw_q1_559_CM 1 100. 0. 9200. DISPLAY_IDENTIFIER OZKVBDMEW ECU_ADDRESS 0x3faade BYTE_ORDER MSB_LAST FORMAT "%8.4" /end MEASUREMENT
/begin MEASUREMENT ozkvbmx "Zwischengröße Restwegberechnung Kraftstoffverbrauch" UWORD _CNV_R_R_fuel_uw_q1_559_CM 1 100. 500. 9200. DISPLAY_IDENTIFIER OZKVBMX ECU_ADDRESS 0x3faae0 BYTE_ORDER MSB_LAST FORMAT "%8.4" /end MEASUREMENT
/begin MEASUREMENT ozkvbog "zugeteilte Bonuskraftstoffmenge" UWORD _CNV_R_R_fuel_uw_q1_559_CM 1 100. 0. 1200. DISPLAY_IDENTIFIER OZKVBOG ECU_ADDRESS 0x3fad7c BYTE_ORDER MSB_LAST FORMAT "%8.4" /end MEASUREMENT
/begin MEASUREMENT ozkvbogw "additiver Term Nachfüllbonus Kraftstoffverbrauch gewichtet" UWORD _CNV_R_R_fuel_uw_q1_559_CM 1 100. 0. 1200. DISPLAY_IDENTIFIER OZKVBOGW ECU_ADDRESS 0x3faae2 BYTE_ORDER MSB_LAST FORMAT "%8.4" /end MEASUREMENT
/begin MEASUREMENT ozkvbsm_ul "Kraftstoffverbrauch seit letztem Ölwechsel" ULONG _CNV_R_R_fuel_ul_q0_560_CM 1 100. 0. 10000. DISPLAY_IDENTIFIER OZKVBSM_UL ECU_ADDRESS 0x3fad84 BYTE_ORDER MSB_LAST FORMAT "%8.4" /end MEASUREMENT
/begin MEASUREMENT ozkvbtmp1 "" UWORD _CNV_R_R_lf_ub_552_CM 1 100. 0. 655.35 DISPLAY_IDENTIFIER OZKVBTMP1 ECU_ADDRESS 0x3faae4 BYTE_ORDER MSB_LAST FORMAT "%8.4" /end MEASUREMENT
/begin MEASUREMENT ozkvbtmp2 "" ULONG _CNV_R_R_nmot_ub_q1_536_CM 1 100. -1.e+037 1.e+037 DISPLAY_IDENTIFIER OZKVBTMP2 ECU_ADDRESS 0x3fab0c BYTE_ORDER MSB_LAST FORMAT "%8.4" /end MEASUREMENT
/begin MEASUREMENT ozkvbtmp3 "" UWORD _CNV_R_R_dez_498_CM 1 100. 0. 50000. DISPLAY_IDENTIFIER OZKVBTMP3 ECU_ADDRESS 0x3faae6 BYTE_ORDER MSB_LAST FORMAT "%8.4" /end MEASUREMENT
/begin MEASUREMENT ozkvbtmp4 "" SLONG _CNV_R_R_dez_498_CM 1 100. -32768. 51200000. DISPLAY_IDENTIFIER OZKVBTMP4 ECU_ADDRESS 0x3fab10 BYTE_ORDER MSB_LAST FORMAT "%8.4" /end MEASUREMENT
/begin MEASUREMENT ozlf1c "Länderfaktor 1 codiert" UBYTE _CNV_R_R_lf_ub_552_CM 1 100. 0. 2.55 DISPLAY_IDENTIFIER OZLF1C ECU_ADDRESS 0x3fad8f FORMAT "%8.4" /end MEASUREMENT
/begin MEASUREMENT ozlf2c "Länderfaktor 2 codiert" UBYTE _CNV_R_R_lf_ub_552_CM 1 100. 0. 2.55 DISPLAY_IDENTIFIER OZLF2C ECU_ADDRESS 0x3fad90 FORMAT "%8.4" /end MEASUREMENT
/begin MEASUREMENT ozlf2t "Länderfaktor 2" UBYTE _CNV_R_R_lf_ub_552_CM 1 100. 0. 2.55 DISPLAY_IDENTIFIER OZLF2T ECU_ADDRESS 0x3fad89 FORMAT "%8.4" /end MEASUREMENT
/begin MEASUREMENT ozoelzeit "Öllaufzeit" UWORD _CNV_R_R_dez_498_CM 1 100. 0. 65535. DISPLAY_IDENTIFIER OZOELZEIT ECU_ADDRESS 0x3faae8 BYTE_ORDER MSB_LAST FORMAT "%8.4" /end MEASUREMENT
/begin MEASUREMENT ozpermbgw "gewichteter Bonus Permittivität" UWORD _CNV_R_R_perm_uw_b6_553_CM 1 100. 0. 0.4 DISPLAY_IDENTIFIER OZPERMBGW ECU_ADDRESS 0x3faaea BYTE_ORDER MSB_LAST FORMAT "%8.4" /end MEASUREMENT
/begin MEASUREMENT ozpermbog "zugeteilter Permittivitätsbonus" UWORD _CNV_R_R_perm_uw_b6_553_CM 1 100. 0. 1.9999695 DISPLAY_IDENTIFIER OZPERMBOG ECU_ADDRESS 0x3fad7e BYTE_ORDER MSB_LAST FORMAT "%8.4" /end MEASUREMENT
/begin MEASUREMENT ozpermbogw "additiver Term Nachfüllbonus Permittivität gewichtet" UWORD _CNV_R_R_perm_uw_b6_553_CM 1 100. 0. 5.9999084 DISPLAY_IDENTIFIER OZPERMBOGW ECU_ADDRESS 0x3faaec BYTE_ORDER MSB_LAST FORMAT "%8.4" /end MEASUREMENT
/begin MEASUREMENT ozpermma "maximal zulässiges Delta-Er im Ölwechselintervall mit Bonus berücksichtigt" UWORD _CNV_R_R_perm_uw_b6_553_CM 1 100. 0. 5.9999084 DISPLAY_IDENTIFIER OZPERMMA ECU_ADDRESS 0x3faaee BYTE_ORDER MSB_LAST FORMAT "%8.4" /end MEASUREMENT
/begin MEASUREMENT ozpermtmp1 "" SWORD _CNV_R_R_dez_498_CM 1 100. -32768. 32767. DISPLAY_IDENTIFIER OZPERMTMP1 ECU_ADDRESS 0x3faaf0 BYTE_ORDER MSB_LAST FORMAT "%8.4" /end MEASUREMENT
/begin MEASUREMENT ozpermtmp2 "" ULONG _CNV_R_R_fuel_ul_q0_560_CM 1 100. 0. 524288. DISPLAY_IDENTIFIER OZPERMTMP2 ECU_ADDRESS 0x3fab14 BYTE_ORDER MSB_LAST FORMAT "%8.4" /end MEASUREMENT
/begin MEASUREMENT ozpermtmp3 "" SLONG _CNV_R_R_km_sw_q10_549_CM 1 100. -1.e+037 1.e+037 DISPLAY_IDENTIFIER OZPERMTMP3 ECU_ADDRESS 0x3fab18 BYTE_ORDER MSB_LAST FORMAT "%8.4" /end MEASUREMENT
/begin MEASUREMENT ozrwkvb "Restweg aus Kraftstoffverbrauch abgeleitet" SWORD _CNV_R_R_km_sw_q10_549_CM 1 100. -327680. 327670. DISPLAY_IDENTIFIER OZRWKVB ECU_ADDRESS 0x3faaf2 BYTE_ORDER MSB_LAST FORMAT "%8.4" /end MEASUREMENT
/begin MEASUREMENT ozrwkvba "absoluter Restweg aus Kraftstoffverbrauch" SWORD _CNV_R_R_km_sw_q10_549_CM 1 100. -327680. 327670. DISPLAY_IDENTIFIER OZRWKVBA ECU_ADDRESS 0x3faaf4 BYTE_ORDER MSB_LAST FORMAT "%8.4" /end MEASUREMENT
/begin MEASUREMENT ozrwkvbr "relativer Restweg aus Kraftstoffverbrauch" SLONG _CNV_R_R_dez_498_CM 1 100. -32768. 50000. DISPLAY_IDENTIFIER OZRWKVBR ECU_ADDRESS 0x3fab1c BYTE_ORDER MSB_LAST FORMAT "%8.4" /end MEASUREMENT
/begin MEASUREMENT ozrwp "Zwischengröße Restwegberechnung" SWORD _CNV_R_R_km_sw_q10_549_CM 1 100. -327680. 327670. DISPLAY_IDENTIFIER OZRWP ECU_ADDRESS 0x3faaf6 BYTE_ORDER MSB_LAST FORMAT "%8.4" /end MEASUREMENT
/begin MEASUREMENT ozrwperm "Restweg aus Permittivität abgeleitet" SWORD _CNV_R_R_km_sw_q10_549_CM 1 100. -327680. 327670. DISPLAY_IDENTIFIER OZRWPERM ECU_ADDRESS 0x3faaf8 BYTE_ORDER MSB_LAST FORMAT "%8.4" /end MEASUREMENT
/begin MEASUREMENT ozrwperma "absoluter Restweg aus Er" SWORD _CNV_R_R_km_sw_q10_549_CM 1 100. -327680. 327670. DISPLAY_IDENTIFIER OZRWPERMA ECU_ADDRESS 0x3faafa BYTE_ORDER MSB_LAST FORMAT "%8.4" /end MEASUREMENT
/begin MEASUREMENT ozrwpermr "relativer Restweg aus Er" SWORD _CNV_R_R_km_sw_q10_549_CM 1 100. -327680. 327670. DISPLAY_IDENTIFIER OZRWPERMR ECU_ADDRESS 0x3faafc BYTE_ORDER MSB_LAST FORMAT "%8.4" /end MEASUREMENT
/begin MEASUREMENT ozrwzeit "Restweg aus Zeit" SWORD _CNV_R_R_km_sw_q10_549_CM 1 100. -327680. 327670. DISPLAY_IDENTIFIER OZRWZEIT ECU_ADDRESS 0x3faafe BYTE_ORDER MSB_LAST FORMAT "%8.4" /end MEASUREMENT
/begin MEASUREMENT ozrwzeita "absoluter Restweg aus Zeit" SWORD _CNV_R_R_km_sw_q10_549_CM 1 100. -327680. 327670. DISPLAY_IDENTIFIER OZRWZEITA ECU_ADDRESS 0x3fab00 BYTE_ORDER MSB_LAST FORMAT "%8.4" /end MEASUREMENT
/begin MEASUREMENT ozrwzeitr "relativer Restweg aus Zeit" SWORD _CNV_R_R_km_sw_q10_549_CM 1 100. -327680. 327670. DISPLAY_IDENTIFIER OZRWZEITR ECU_ADDRESS 0x3fab02 BYTE_ORDER MSB_LAST FORMAT "%8.4" /end MEASUREMENT
/begin MEASUREMENT ozvfkvb "Verfügbarkeit aus Kraftstoffverbrauch" UWORD _CNV_R_R_fuel_ul_q0_560_CM 1 100. 0. 1.2207031 DISPLAY_IDENTIFIER OZVFKVB ECU_ADDRESS 0x3fab04 BYTE_ORDER MSB_LAST FORMAT "%8.4" /end MEASUREMENT
/begin MEASUREMENT ozvfzeit "Verfügbarkeit aus Zeit" UBYTE _CNV_R_R_lf_ub_552_CM 1 100. 0. 2.55 DISPLAY_IDENTIFIER OZVFZEIT ECU_ADDRESS 0x3fab22 FORMAT "%8.4" /end MEASUREMENT
/begin MEASUREMENT ozzeittmp1 "" UWORD _CNV_R_R_dez_498_CM 1 100. 0. 65535. DISPLAY_IDENTIFIER OZZEITTMP1 ECU_ADDRESS 0x3fab06 BYTE_ORDER MSB_LAST FORMAT "%8.4" /end MEASUREMENT
/begin MEASUREMENT ozzeittmp2 "Zwischenvariable Zeitberechnung" UBYTE _CNV_R_R_lf_ub_552_CM 1 100. 0. 2.55 DISPLAY_IDENTIFIER OZZEITTMP2 ECU_ADDRESS 0x3fab23 FORMAT "%8.4" /end MEASUREMENT
/begin MEASUREMENT ozzeittmp3 "" UWORD _CNV_R_R_lf_ub_552_CM 1 100. 0. 655.35 DISPLAY_IDENTIFIER OZZEITTMP3 ECU_ADDRESS 0x3fab08 BYTE_ORDER MSB_LAST FORMAT "%8.4" /end MEASUREMENT
/begin MEASUREMENT ztageabs_w "" UWORD _CNV_R_R_dez_498_CM 1 100. 0. 65535. DISPLAY_IDENTIFIER ZTAGEABS_W ECU_ADDRESS 0x3fcf02 BYTE_ORDER MSB_LAST FORMAT "%8.4" /end MEASUREMENT
/begin CHARACTERISTIC OZANFANZ "BOS-Startanzeigewert Restlaufstrecke" VALUE 0x1a062 _REC_VAL_20_u2 0. _CNV_R_R_nmot_ub_q1_536_CM 0. 655350. FORMAT "%8.4" /end CHARACTERISTIC
/begin CHARACTERISTIC OZKMMAXK11 "Maximalintervall" VALUE 0x1a066 _REC_VAL_20_u2 0. _CNV_R_R_km_sw_q10_549_CM 0. 655350. FORMAT "%8.4" /end CHARACTERISTIC
/begin CHARACTERISTIC OZKVB96 "Typprüfkraftstoffverbrauch" VALUE 0x1a076 _REC_VAL_20_u1 0. _CNV_R_R_fuel96_ub_561_CM 0. 25.5 FORMAT "%8.4" /end CHARACTERISTIC
/begin CHARACTERISTIC OZKVBMXK18 "maximal zulässige Gesamtkraftstoffbonusmenge" VALUE 0x1a068 _REC_VAL_20_u2 0. _CNV_R_R_fuel_uw_q1_559_CM 0. 1200. FORMAT "%8.4" /end CHARACTERISTIC
/begin CHARACTERISTIC OZKVBOK16 "Kraftstoffbonusmenge in [l] je 0,5l Ölnachfüllung" VALUE 0x1a06a _REC_VAL_20_u2 0. _CNV_R_R_fuel_uw_q1_559_CM 0. 1000. FORMAT "%8.4" /end CHARACTERISTIC
/begin CHARACTERISTIC OZLF1 "Länderfaktor 1 Festwert" VALUE 0x1a077 _REC_VAL_20_u1 0. _CNV_R_R_lf_ub_552_CM 0. 2.55 FORMAT "%8.4" /end CHARACTERISTIC
/begin CHARACTERISTIC OZLF2 "Länderfaktor 2 Festwert" VALUE 0x1a078 _REC_VAL_20_u1 0. _CNV_R_R_lf_ub_552_CM 0. 2.55 FORMAT "%8.4" /end CHARACTERISTIC
/begin CHARACTERISTIC OZMNKMBO "Wegstrecke ab der eine Bonuszuteilung erfolgt" VALUE 0x1a06c _REC_VAL_20_u2 0. _CNV_R_R_nmot_ub_q1_536_CM 0. 655350. FORMAT "%8.4" /end CHARACTERISTIC
/begin CHARACTERISTIC OZMXOHK15 "maximale Öllaufzeit" VALUE 0x1a06e _REC_VAL_20_u2 0. _CNV_R_R_dez_498_CM 0. 65535. FORMAT "%8.4" /end CHARACTERISTIC
/begin CHARACTERISTIC OZPERBOK17 "Er-Bonusbetrag je 0,5l Ölnachfüllung" VALUE 0x1a070 _REC_VAL_20_u2 0. _CNV_R_R_perm_uw_b6_553_CM 0. 0.20004272 FORMAT "%8.4" /end CHARACTERISTIC
/begin CHARACTERISTIC OZPERBRK14 "Begrenzungsfaktor für Restweg aus der Permittivität" VALUE 0x1a079 _REC_VAL_20_u1 0. _CNV_R_R_fak_ub_b4_538_CM 0. 3.984375 FORMAT "%8.4" /end CHARACTERISTIC
/begin CHARACTERISTIC OZPERXK10 "zulässige Permittivitätsänderung im Ölwechselintervall" VALUE 0x1a072 _REC_VAL_20_u2 0. _CNV_R_R_perm_uw_b6_553_CM 0. 1. FORMAT "%8.4" /end CHARACTERISTIC
/begin CHARACTERISTIC OZTAGCTERR "Fehlerkennung für Tagezähler" VALUE 0x1a074 _REC_VAL_20_u2 0. _CNV_R_R_dez_498_CM 0. 65535. FORMAT "%8.4" /end CHARACTERISTIC
/begin CHARACTERISTIC OZZEITFAKT "Faktor zum Ausblenden der Zeit zu Beginn der Auswertung" VALUE 0x1a07a _REC_VAL_20_u1 0. _CNV_R_R_lf_ub_552_CM 0. 2.55 FORMAT "%8.4" /end CHARACTERISTIC
/begin MEASUREMENT m_tol "" UBYTE _CNV_R_R_temp_uw_q0_495_CM 1 100. -48. 143.25 DISPLAY_IDENTIFIER M_TOL ECU_ADDRESS 0x3fdf20 FORMAT "%8.4" /end MEASUREMENT
/begin CHARACTERISTIC OZTEMPZK "Zeitkonstante Filter Öltemperatur" VALUE 0x1a07b _REC_VAL_20_u1 0. _CNV_R_R_zk1sxs_ub__562_CM 1. 255. FORMAT "%8.4" /end CHARACTERISTIC
/begin CHARACTERISTIC c_swi_vepu_as "control byte venturi pump" VALUE 0x007d4 _REC_VAL_20_u1 1. _CNV_S_2_RANGE______563_CM 0. 1. DISPLAY_IDENTIFIER C_SWI_VEPU_AS /end CHARACTERISTIC
/begin MEASUREMENT fspvdqltBits_1s "" UBYTE _CNV_A_R_LINEAR_____1_CM 1 100. 0. 255. DISPLAY_IDENTIFIER FSPVDQLTBITS_1S ECU_ADDRESS 0x3fdf17 FORMAT "%3.0" /end MEASUREMENT
/begin MEASUREMENT fspvdqltBits_1s.B_ozclfsp "Bedingung Ölzustandssensor von Temic ist verbaut" UBYTE _CNV_A_R_LINEAR_____1_CM 1 100. 0. 255. DISPLAY_IDENTIFIER B_OZCLFSP ECU_ADDRESS 0x3fdf17 FORMAT "%3.0" BIT_MASK 0x0 /end MEASUREMENT
/begin MEASUREMENT lv_err_qoil_sens "" UBYTE _CNV_S_2_RANGE______2_R_CM 1 100. 0. 255. DISPLAY_IDENTIFIER LV_ERR_QOIL_SENS ECU_ADDRESS 0x3fbb28 /end MEASUREMENT
/begin AXIS_PTS ldpm_maf_cyl_ip_rel_flow_inc_cp "" 0x11758 maf_cyl _REC_AXS_20_u2 2047.96875 _CNV_A_R_LINEAR_____113_CM 6 0. 2047.96875 DISPLAY_IDENTIFIER LDPM_MAF_CYL_IP_REL_FLOW_INC_CP FORMAT "%6.2" /end AXIS_PTS
/begin AXIS_PTS ldpm_n_32_ip_fuel_dly_cps "" 0x01365 n_32 _REC_AXS_20_u1 8160. _CNV_A_R_LINEAR_____16_CM 6 0. 8160. DISPLAY_IDENTIFIER LDPM_N_32_IP_FUEL_DLY_CPS FORMAT "%4.0" /end AXIS_PTS
/begin MEASUREMENT lv_key_off "Boolean for ignition key status (ON / OFF)" UBYTE _CNV_S_2_RANGE______0_CM 1 100. 0. 1. DISPLAY_IDENTIFIER LV_KEY_OFF ECU_ADDRESS 0x3fb329 BIT_MASK 0x1 /end MEASUREMENT
/begin MEASUREMENT v_dur_igc[0] "Burntime for  respective cylinder" UWORD _CNV_A_R_LINEAR_____198_CM 1 100. 0. 20. DISPLAY_IDENTIFIER V_DUR_IGC_0 ECU_ADDRESS 0x3fb380 BYTE_ORDER MSB_LAST FORMAT "%8.3" /end MEASUREMENT
/begin MEASUREMENT v_dur_igc[1] "Burntime for  respective cylinder" UWORD _CNV_A_R_LINEAR_____198_CM 1 100. 0. 20. DISPLAY_IDENTIFIER V_DUR_IGC_1 ECU_ADDRESS 0x3fb382 BYTE_ORDER MSB_LAST FORMAT "%8.3" /end MEASUREMENT
/begin MEASUREMENT v_dur_igc[2] "Burntime for  respective cylinder" UWORD _CNV_A_R_LINEAR_____198_CM 1 100. 0. 20. DISPLAY_IDENTIFIER V_DUR_IGC_2 ECU_ADDRESS 0x3fb384 BYTE_ORDER MSB_LAST FORMAT "%8.3" /end MEASUREMENT
/begin MEASUREMENT v_dur_igc[3] "Burntime for  respective cylinder" UWORD _CNV_A_R_LINEAR_____198_CM 1 100. 0. 20. DISPLAY_IDENTIFIER V_DUR_IGC_3 ECU_ADDRESS 0x3fb386 BYTE_ORDER MSB_LAST FORMAT "%8.3" /end MEASUREMENT
/begin MEASUREMENT v_dur_igc[4] "Burntime for  respective cylinder" UWORD _CNV_A_R_LINEAR_____198_CM 1 100. 0. 20. DISPLAY_IDENTIFIER V_DUR_IGC_4 ECU_ADDRESS 0x3fb388 BYTE_ORDER MSB_LAST FORMAT "%8.3" /end MEASUREMENT
/begin MEASUREMENT v_dur_igc[5] "Burntime for  respective cylinder" UWORD _CNV_A_R_LINEAR_____198_CM 1 100. 0. 20. DISPLAY_IDENTIFIER V_DUR_IGC_5 ECU_ADDRESS 0x3fb38a BYTE_ORDER MSB_LAST FORMAT "%8.3" /end MEASUREMENT
/begin MEASUREMENT lv_td_igc_cut[0] "Diagnostic-bit of primary short circuit to battery" UBYTE _CNV_S_2_RANGE______0_CM 1 100. 0. 1. DISPLAY_IDENTIFIER LV_TD_IGC_CUT_0 ECU_ADDRESS 0x3fb38c BIT_MASK 0x1 /end MEASUREMENT
/begin MEASUREMENT lv_td_igc_cut[1] "Diagnostic-bit of primary short circuit to battery" UBYTE _CNV_S_2_RANGE______0_CM 1 100. 0. 1. DISPLAY_IDENTIFIER LV_TD_IGC_CUT_1 ECU_ADDRESS 0x3fb38d BIT_MASK 0x1 /end MEASUREMENT
/begin MEASUREMENT lv_td_igc_cut[2] "Diagnostic-bit of primary short circuit to battery" UBYTE _CNV_S_2_RANGE______0_CM 1 100. 0. 1. DISPLAY_IDENTIFIER LV_TD_IGC_CUT_2 ECU_ADDRESS 0x3fb38e BIT_MASK 0x1 /end MEASUREMENT
/begin MEASUREMENT lv_td_igc_cut[3] "Diagnostic-bit of primary short circuit to battery" UBYTE _CNV_S_2_RANGE______0_CM 1 100. 0. 1. DISPLAY_IDENTIFIER LV_TD_IGC_CUT_3 ECU_ADDRESS 0x3fb38f BIT_MASK 0x1 /end MEASUREMENT
/begin MEASUREMENT lv_td_igc_cut[4] "Diagnostic-bit of primary short circuit to battery" UBYTE _CNV_S_2_RANGE______0_CM 1 100. 0. 1. DISPLAY_IDENTIFIER LV_TD_IGC_CUT_4 ECU_ADDRESS 0x3fb390 BIT_MASK 0x1 /end MEASUREMENT
/begin MEASUREMENT lv_td_igc_cut[5] "Diagnostic-bit of primary short circuit to battery" UBYTE _CNV_S_2_RANGE______0_CM 1 100. 0. 1. DISPLAY_IDENTIFIER LV_TD_IGC_CUT_5 ECU_ADDRESS 0x3fb391 BIT_MASK 0x1 /end MEASUREMENT
/begin MEASUREMENT t_seg_mis "" UWORD _CNV_A_R_LINEAR_____380_CM 1 100. 0. 65535. DISPLAY_IDENTIFIER BIOS_T_SEG_MIS ECU_ADDRESS 0x3fb364 BYTE_ORDER MSB_LAST FORMAT "%5.0" /end MEASUREMENT
/begin MEASUREMENT bios_cru_data "status off MSW module" UBYTE _CNV_S_5_RANGE_BIOS_618_R_CM 1 100. 110. 255. DISPLAY_IDENTIFIER BIOS_CRU_DATA ECU_ADDRESS 0x3fe7d1 /end MEASUREMENT
/begin MEASUREMENT vb_mes "Battery voltage value measured (10 bits)" UWORD _CNV_A_R_LINEAR_____207_CM 1 100. 0. 28.7055 DISPLAY_IDENTIFIER VB_MES ECU_ADDRESS 0x3fb320 BYTE_ORDER MSB_LAST FORMAT "%5.2" /end MEASUREMENT
/begin MEASUREMENT v_igk_mes "Computed ignition key voltage" UWORD _CNV_A_R_LINEAR_____207_CM 1 100. 0. 28.7055 DISPLAY_IDENTIFIER V_IGK_MES ECU_ADDRESS 0x3fb322 BYTE_ORDER MSB_LAST FORMAT "%5.2" /end MEASUREMENT
/begin MEASUREMENT saf_sum "Accumulated secondary air mass flow measurements for segment number (2n-1), n = 1,2,3,..." ULONG _CNV_A_R_LINEAR_____45_CM 1 100. 0. 67108863.98 DISPLAY_IDENTIFIER SAF_SUM ECU_ADDRESS 0x3fb2f8 BYTE_ORDER MSB_LAST FORMAT "%11.2" /end MEASUREMENT
/begin MEASUREMENT saf_sum_1 "Accumulated secondary air mass flow measurements for segment number (2n), n = 1,2,3,..." ULONG _CNV_A_R_LINEAR_____45_CM 1 100. 0. 67108863.98 DISPLAY_IDENTIFIER SAF_SUM_1 ECU_ADDRESS 0x3fb2fc BYTE_ORDER MSB_LAST FORMAT "%11.2" /end MEASUREMENT
/begin MEASUREMENT saf_ctr "Number of samples in buffer saf_sum" UWORD _CNV_A_R_LINEAR_____1_CM 1 100. 0. 65535. DISPLAY_IDENTIFIER SAF_CTR ECU_ADDRESS 0x3fb310 BYTE_ORDER MSB_LAST FORMAT "%5.0" /end MEASUREMENT
/begin MEASUREMENT saf_ctr_1 "Number of samples in buffer saf_sum_1" UWORD _CNV_A_R_LINEAR_____1_CM 1 100. 0. 65535. DISPLAY_IDENTIFIER SAF_CTR_1 ECU_ADDRESS 0x3fb312 BYTE_ORDER MSB_LAST FORMAT "%5.0" /end MEASUREMENT
/begin MEASUREMENT lv_saf_seg "indicates if segment number is even or odd" UBYTE _CNV_S_2_RANGE______0_CM 1 100. 0. 1. DISPLAY_IDENTIFIER LV_SAF_SEG ECU_ADDRESS 0x3fb326 /end MEASUREMENT
/begin MEASUREMENT ivvtpwm_1 "Pulsewidth modulated signal for cam-actuator 1" UWORD _CNV_A_R_LINEAR_____9_CM 1 100. 0. 99.99847412 DISPLAY_IDENTIFIER IVVTPWM_1 ECU_ADDRESS 0x3fb3ca BYTE_ORDER MSB_LAST /end MEASUREMENT
/begin MEASUREMENT ivvtpwm_0 "Pulsewidth modulated signal for cam-actuator 0" UWORD _CNV_A_R_LINEAR_____9_CM 1 100. 0. 99.99847412 DISPLAY_IDENTIFIER IVVTPWM_0 ECU_ADDRESS 0x3fb3c8 BYTE_ORDER MSB_LAST /end MEASUREMENT
/begin MEASUREMENT lv_hld_ivvtpwm_0 "Hold bit on PWM output CAM 0 (1 = hold dutycycle, 0 = energization time)" UBYTE _CNV_S_2_RANGE______0_CM 1 100. 0. 1. DISPLAY_IDENTIFIER LV_HLD_IVVTPWM_0 ECU_ADDRESS 0x3fb3cc BIT_MASK 0x1 /end MEASUREMENT
/begin MEASUREMENT lv_hld_ivvtpwm_1 "Hold bit on PWM output CAM 0 (1 = hold dutycycle, 0 = energization time)" UBYTE _CNV_S_2_RANGE______0_CM 1 100. 0. 1. DISPLAY_IDENTIFIER LV_HLD_IVVTPWM_1 ECU_ADDRESS 0x3fb3cd BIT_MASK 0x1 /end MEASUREMENT
/begin MEASUREMENT t_stop_cur_ivvtpwm_0 "Captured system time at end of energization time" ULONG _CNV_A_R_LINEAR_____243_CM 1 100. 0. 17179869180. DISPLAY_IDENTIFIER T_STOP_CUR_IVVTPWM_0 ECU_ADDRESS 0x3fb3d0 BYTE_ORDER MSB_LAST FORMAT "%11.0" /end MEASUREMENT
/begin MEASUREMENT t_stop_cur_ivvtpwm_1 "Captured system time at end of energization time" ULONG _CNV_A_R_LINEAR_____243_CM 1 100. 0. 17179869180. DISPLAY_IDENTIFIER T_STOP_CUR_IVVTPWM_1 ECU_ADDRESS 0x3fb3d4 BYTE_ORDER MSB_LAST FORMAT "%11.0" /end MEASUREMENT
/begin MEASUREMENT Tog_st "" UBYTE _CNV_R_R_dez_498_CM 1 100. 0. 255. DISPLAY_IDENTIFIER TOG_ST ECU_ADDRESS 0x3fa454 FORMAT "%5.1" /end MEASUREMENT
/begin MEASUREMENT Tog_st.B_togerr "" UBYTE _CNV_R_R_dez_498_CM 1 100. 0. 255. DISPLAY_IDENTIFIER B_TOGERR ECU_ADDRESS 0x3fa454 FORMAT "%5.1" BIT_MASK 0x40 /end MEASUREMENT
/begin MEASUREMENT Tog_st.B_togupl "" UBYTE _CNV_R_R_dez_498_CM 1 100. 0. 255. DISPLAY_IDENTIFIER B_TOGUPL ECU_ADDRESS 0x3fa454 FORMAT "%5.1" BIT_MASK 0x80 /end MEASUREMENT
/begin AXIS_PTS ldp_id_saf_tab_1 "" 0x07b22 online_dummy _REC_AXS_20_u1 255. _CNV_A_R_LINEAR_____1_CM 16 0. 255. DISPLAY_IDENTIFIER LDP_ID_SAF_TAB_1 FORMAT "%3.0" /end AXIS_PTS
/begin AXIS_PTS ldp_id_saf_tab_2 "" 0x07b33 online_dummy _REC_AXS_20_u1 255. _CNV_A_R_LINEAR_____1_CM 16 0. 255. DISPLAY_IDENTIFIER LDP_ID_SAF_TAB_2 FORMAT "%3.0" /end AXIS_PTS
/begin AXIS_PTS ldpm_n_id_crk_acq "" 0x119fc n _REC_AXS_20_u2 8160. _CNV_A_R_LINEAR_____11_CM 6 0. 8160. DISPLAY_IDENTIFIER LDPM_N_ID_CRK_ACQ FORMAT "%4.0" /end AXIS_PTS
/begin AXIS_PTS ldpm_n_id_cam_acq "" 0x119e2 n _REC_AXS_20_u2 8160. _CNV_A_R_LINEAR_____11_CM 12 0. 8160. DISPLAY_IDENTIFIER LDPM_N_ID_CAM_ACQ FORMAT "%4.0" /end AXIS_PTS
/begin COMPU_METHOD _CNV_S_2_RANGE______0_CM "" TAB_VERB "%6.3" "[-]" COMPU_TAB_REF _CNV_S_2_RANGE______0 /end COMPU_METHOD
/begin COMPU_VTAB _CNV_S_2_RANGE______0 "" TAB_VERB 2 0 "0" 1 "1" /end COMPU_VTAB
/begin COMPU_METHOD _CNV_A_R_LINEAR_____1_CM "" RAT_FUNC "%6.3" "-" COEFFS 0 1. 0. 0 0 1 /end COMPU_METHOD
/begin COMPU_METHOD _CNV_S_2_RANGE______2_R_CM "" TAB_VERB "%6.3" "[-]" COMPU_TAB_REF _CNV_S_2_RANGE______2_R /end COMPU_METHOD
/begin COMPU_VTAB_RANGE _CNV_S_2_RANGE______2_R "" 2 0 0 "0" 1 255 "1" /end COMPU_VTAB_RANGE
/begin COMPU_METHOD _CNV_A_R_LINEAR_____3_CM "" RAT_FUNC "%6.3" "V" COEFFS 0 204.7999998974999 0. 0 0 1 /end COMPU_METHOD
/begin COMPU_METHOD _CNV_A_R_LINEAR_____4_CM "" RAT_FUNC "%6.3" "s" COEFFS 0 100. 0. 0 0 1 /end COMPU_METHOD
/begin COMPU_METHOD _CNV_S_2_RANGE______5_CM "" TAB_VERB "%6.3" "-" COMPU_TAB_REF _CNV_S_2_RANGE______5 /end COMPU_METHOD
/begin COMPU_VTAB _CNV_S_2_RANGE______5 "" TAB_VERB 2 0 "0" 1 "1" /end COMPU_VTAB
/begin COMPU_METHOD _CNV_A_R_LINEAR_____9_CM "" RAT_FUNC "%6.3" "%" COEFFS 0 655.3600000071681 0. 0 0 1 /end COMPU_METHOD
/begin COMPU_METHOD _CNV_A_R_LINEAR_____10_CM "" RAT_FUNC "%6.3" "%" COEFFS 0 2.56 0. 0 0 1 /end COMPU_METHOD
/begin COMPU_METHOD _CNV_A_R_LINEAR_____11_CM "" RAT_FUNC "%6.3" "rpm" COEFFS 0 1. 0. 0 0 1 /end COMPU_METHOD
/begin COMPU_METHOD _CNV_A_R_LINEAR_____12_CM "" RAT_FUNC "%6.3" "°C" COEFFS 0 1.333333333333333 64. 0 0 1 /end COMPU_METHOD
/begin COMPU_METHOD _CNV_A_R_LINEAR_____13_CM "" RAT_FUNC "%6.3" "°C" COEFFS 0 1.333333333333333 0. 0 0 1 /end COMPU_METHOD
/begin COMPU_METHOD _CNV_A_R_LINEAR_____16_CM "" RAT_FUNC "%6.3" "rpm" COEFFS 0 3.125e-002 0. 0 0 1 /end COMPU_METHOD
/begin COMPU_METHOD _CNV_A_R_LINEAR_____21_CM "" RAT_FUNC "%6.3" "-" COEFFS 0 32768.00003968061 0. 0 0 1 /end COMPU_METHOD
/begin COMPU_METHOD _CNV_A_R_LINEAR_____22_CM "" RAT_FUNC "%6.3" "[-]" COEFFS 0 1. 0. 0 0 1 /end COMPU_METHOD
/begin COMPU_METHOD _CNV_A_R_LINEAR_____23_CM "" RAT_FUNC "%6.3" "km/h" COEFFS 0 1. 0. 0 0 1 /end COMPU_METHOD
/begin COMPU_METHOD _CNV_A_R_LINEAR_____24_CM "" RAT_FUNC "%6.3" "s" COEFFS 0 10. 0. 0 0 1 /end COMPU_METHOD
/begin COMPU_METHOD _CNV_A_R_LINEAR_____29_CM "" RAT_FUNC "%6.3" "-" COEFFS 0 255.9983911655618 0. 0 0 1 /end COMPU_METHOD
/begin COMPU_METHOD _CNV_A_R_LINEAR_____30_CM "" RAT_FUNC "%6.3" "s" COEFFS 0 1. 0. 0 0 1 /end COMPU_METHOD
/begin COMPU_METHOD _CNV_A_R_LINEAR_____34_CM "" RAT_FUNC "%6.3" "V" COEFFS 0 9.846168103048838 0. 0 0 1 /end COMPU_METHOD
/begin COMPU_METHOD _CNV_A_R_LINEAR_____37_CM "" RAT_FUNC "%6.3" "-" COEFFS 0 65536.00007936121 0. 0 0 1 /end COMPU_METHOD
/begin COMPU_METHOD _CNV_A_R_LINEAR_____39_CM "" RAT_FUNC "%6.3" "-" COEFFS 0 127.9991955827809 0. 0 0 1 /end COMPU_METHOD
/begin COMPU_METHOD _CNV_A_R_LINEAR_____42_CM "" RAT_FUNC "%6.3" "-" COEFFS 0 51.0204081632653 0. 0 0 1 /end COMPU_METHOD
/begin COMPU_METHOD _CNV_A_R_LINEAR_____43_CM "" RAT_FUNC "%6.3" "V" COEFFS 0 102.4003523452984 0. 0 0 1 /end COMPU_METHOD
/begin COMPU_METHOD _CNV_A_R_LINEAR_____44_CM "" RAT_FUNC "%6.3" "V" COEFFS 0 51.0204081632653 0. 0 0 1 /end COMPU_METHOD
/begin COMPU_METHOD _CNV_A_R_LINEAR_____45_CM "" RAT_FUNC "%6.3" "kg/h" COEFFS 0 64.00000000417234 0. 0 0 1 /end COMPU_METHOD
/begin COMPU_METHOD _CNV_A_R_LINEAR_____46_CM "" RAT_FUNC "%6.3" "-" COEFFS 0 16. 0. 0 0 1 /end COMPU_METHOD
/begin COMPU_METHOD _CNV_A_R_LINEAR_____47_CM "" RAT_FUNC "%6.3" "kg/h" COEFFS 0 64. 0. 0 0 1 /end COMPU_METHOD
/begin COMPU_METHOD _CNV_A_R_LINEAR_____48_CM "" RAT_FUNC "%6.3" "[-]" COEFFS 0 32. 0. 0 0 1 /end COMPU_METHOD
/begin COMPU_METHOD _CNV_A_R_LINEAR_____49_CM "" RAT_FUNC "%6.3" "hPa" COEFFS 0 12.06017666543982 0. 0 0 1 /end COMPU_METHOD
/begin COMPU_METHOD _CNV_A_R_LINEAR_____50_CM "" RAT_FUNC "%6.3" "[-]" COEFFS 0 255.9999357490357 0. 0 0 1 /end COMPU_METHOD
/begin COMPU_METHOD _CNV_A_R_LINEAR_____82_CM "" RAT_FUNC "%6.3" "°CRK" COEFFS 0 2.666666666666667 0. 0 0 1 /end COMPU_METHOD
/begin COMPU_METHOD _CNV_A_R_LINEAR_____85_CM "" RAT_FUNC "%6.3" "km/h" COEFFS 0 128.0000018750286 0. 0 0 1 /end COMPU_METHOD
/begin COMPU_METHOD _CNV_A_R_LINEAR_____89_CM "" RAT_FUNC "%6.3" "V" COEFFS 0 10. -50. 0 0 1 /end COMPU_METHOD
/begin COMPU_METHOD _CNV_A_R_LINEAR_____90_CM "" RAT_FUNC "%6.3" "A" COEFFS 0 10. 0. 0 0 1 /end COMPU_METHOD
/begin COMPU_METHOD _CNV_A_R_LINEAR_____91_CM "" RAT_FUNC "%6.3" "rpm" COEFFS 0 2.e-002 0. 0 0 1 /end COMPU_METHOD
/begin COMPU_METHOD _CNV_A_R_LINEAR_____106_CM "" RAT_FUNC "%6.3" "mg/stk" COEFFS 0 47.18142548596112 0. 0 0 1 /end COMPU_METHOD
/begin COMPU_METHOD _CNV_A_R_LINEAR_____111_CM "" RAT_FUNC "%6.3" "kg/h" COEFFS 0 8191.999999679995 0. 0 0 1 /end COMPU_METHOD
/begin COMPU_METHOD _CNV_A_R_LINEAR_____112_CM "" RAT_FUNC "%6.3" "g" COEFFS 0 2949840.175137362 0. 0 0 1 /end COMPU_METHOD
/begin COMPU_METHOD _CNV_A_R_LINEAR_____113_CM "" RAT_FUNC "%6.3" "kg/h" COEFFS 0 32. 0. 0 0 1 /end COMPU_METHOD
/begin COMPU_METHOD _CNV_A_R_LINEAR_____114_CM "" RAT_FUNC "%6.3" "hPa" COEFFS 0 12.06017666543982 32767.5 0 0 1 /end COMPU_METHOD
/begin COMPU_METHOD _CNV_A_R_LINEAR_____115_CM "" RAT_FUNC "%6.3" "-" COEFFS 0 128. 0. 0 0 1 /end COMPU_METHOD
/begin COMPU_METHOD _CNV_A_R_LINEAR_____116_CM "" RAT_FUNC "%6.3" "-" COEFFS 0 1023.999999959999 0. 0 0 1 /end COMPU_METHOD
/begin COMPU_METHOD _CNV_A_R_LINEAR_____128_CM "" RAT_FUNC "%6.3" "Hz" COEFFS 0 1. 0. 0 0 1 /end COMPU_METHOD
/begin COMPU_METHOD _CNV_A_R_LINEAR_____129_CM "" RAT_FUNC "%6.3" "%" COEFFS 0 1.28 0. 0 0 1 /end COMPU_METHOD
/begin COMPU_METHOD _CNV_A_R_LINEAR_____130_CM "" RAT_FUNC "%6.3" "%" COEFFS 0 2.56 128. 0 0 1 /end COMPU_METHOD
/begin COMPU_METHOD _CNV_S_7_RANGE_STAT_131_CM "" TAB_VERB "%6.3" "-" COMPU_TAB_REF _CNV_S_7_RANGE_STAT_131 /end COMPU_METHOD
/begin COMPU_VTAB _CNV_S_7_RANGE_STAT_131 "" TAB_VERB 7 0 "T_CP_NOT_ACT" 1 "T_CP_1_ACT" 2 "T_MFF_AD_1_ACT" 3 "T_MFF_AD_DEAC" 4 "T_MFF_AD_2_ACT" 5 "T_CP_2_ACT" 6 "T_CP_DEAC" /end COMPU_VTAB
/begin COMPU_METHOD _CNV_A_R_LINEAR_____180_CM "" RAT_FUNC "%6.3" "Grad C" COEFFS 0 1. 40. 0 0 1 /end COMPU_METHOD
/begin COMPU_METHOD _CNV_A_R_LINEAR_____198_CM "" RAT_FUNC "%6.3" "ms" COEFFS 0 250. 0. 0 0 1 /end COMPU_METHOD
/begin COMPU_METHOD _CNV_A_R_LINEAR_____207_CM "" RAT_FUNC "%6.3" "V" COEFFS 0 35.63776976537597 0. 0 0 1 /end COMPU_METHOD
/begin COMPU_METHOD _CNV_A_R_LINEAR_____226_CM "" RAT_FUNC "%6.3" "°CRK" COEFFS 0 -2.666666666666667 -106.6666666666667 0 0 1 /end COMPU_METHOD
/begin COMPU_METHOD _CNV_A_R_LINEAR_____227_CM "" RAT_FUNC "%6.3" "°CRK" COEFFS 0 42.66666666666666 0. 0 0 1 /end COMPU_METHOD
/begin COMPU_METHOD _CNV_A_R_LINEAR_____229_CM "" RAT_FUNC "%6.3" "°CRK" COEFFS 0 2.666666666666667 -160. 0 0 1 /end COMPU_METHOD
/begin COMPU_METHOD _CNV_A_R_LINEAR_____243_CM "" RAT_FUNC "%6.3" "µs" COEFFS 0 0.25 0. 0 0 1 /end COMPU_METHOD
/begin COMPU_METHOD _CNV_A_R_LINEAR_____245_CM "" RAT_FUNC "%6.3" "°CRK" COEFFS 0 2.666666666666667 32768. 0 0 1 /end COMPU_METHOD
/begin COMPU_METHOD _CNV_A_R_LINEAR_____298_CM "" RAT_FUNC "%6.3" "%" COEFFS 0 327.680000003584 3.584063961170614e-007 0 0 1 /end COMPU_METHOD
/begin COMPU_METHOD _CNV_A_R_LINEAR_____380_CM "" RAT_FUNC "%6.3" "µs" COEFFS 0 1. 0. 0 0 1 /end COMPU_METHOD
/begin COMPU_METHOD _CNV_A_R_LINEAR_____485_CM "" RAT_FUNC "%6.3" "%" COEFFS 0 327.6800790412251 0. 0 0 1 /end COMPU_METHOD
/begin COMPU_METHOD _CNV_R_R_temp_uw_q0_495_CM "" RAT_FUNC "%6.3" "[-]" COEFFS 0. 1. 48. 0. 0. 0.75 /end COMPU_METHOD
/begin COMPU_METHOD _CNV_R_R_spg_ubatt_496_CM "" RAT_FUNC "%6.3" "[-]" COEFFS 0. 1. 0. 0. 0. 9.420000000000001e-002 /end COMPU_METHOD
/begin COMPU_METHOD _CNV_R_R_dez_498_CM "" RAT_FUNC "%6.3" "[-]" COEFFS 0. 1. 0. 0. 0. 1. /end COMPU_METHOD
/begin COMPU_METHOD _CNV_R_R_t10msxs_ub_507_CM "" RAT_FUNC "%6.3" "s" COEFFS 0. 1. 0. 0. 0. 1.e-002 /end COMPU_METHOD
/begin COMPU_METHOD _CNV_R_R_identity_509_CM "" RAT_FUNC "%6.3" "-" COEFFS 0. 1. 0. 0. 0. 1. /end COMPU_METHOD
/begin COMPU_METHOD _CNV_R_R_nmot_ub_q4_510_CM "" RAT_FUNC "%6.3" "[-]" COEFFS 0. 1. 0. 0. 0. 40. /end COMPU_METHOD
/begin COMPU_METHOD _CNV_R_R_t_q0p1ms_526_CM "" RAT_FUNC "%6.3" "ms" COEFFS 0. 10. 0. 0. 0. 1. /end COMPU_METHOD
/begin COMPU_METHOD _CNV_S_2_B_TRUE_530_CM "" TAB_VERB "%6.3" "[-]" COMPU_TAB_REF _CNV_S_2_B_TRUE_530 /end COMPU_METHOD
/begin COMPU_VTAB _CNV_S_2_B_TRUE_530 "" TAB_VERB 2 0 "----" 1 "TRUE" /end COMPU_VTAB
/begin COMPU_METHOD _CNV_R_R_fak_ub_b1_534_CM "" RAT_FUNC "%6.3" "[-]" COEFFS 0. 256. 0. 0. 0. 1. /end COMPU_METHOD
/begin COMPU_METHOD _CNV_R_R_nmot_ub_q1_536_CM "" RAT_FUNC "%6.3" "[-]" COEFFS 0. 1. 0. 0. 0. 10. /end COMPU_METHOD
/begin COMPU_METHOD _CNV_R_R_fak_ub_b4_538_CM "" RAT_FUNC "%6.3" "[-]" COEFFS 0. 256. 0. 0. 0. 4. /end COMPU_METHOD
/begin COMPU_METHOD _CNV_R_R_km_sw_q10_549_CM "" RAT_FUNC "%6.3" "[-]" COEFFS 0. 0.1 0. 0. 0. 1. /end COMPU_METHOD
/begin COMPU_METHOD _CNV_R_R_niv_ub_b75_550_CM "" RAT_FUNC "%6.3" "mm" COEFFS 0. 256. 0. 0. 0. 75. /end COMPU_METHOD
/begin COMPU_METHOD _CNV_R_R_temp_ub_q1_551_CM "" RAT_FUNC "%6.3" "[-]" COEFFS 0. 1. 48. 0. 0. 1. /end COMPU_METHOD
/begin COMPU_METHOD _CNV_R_R_lf_ub_552_CM "" RAT_FUNC "%6.3" "[-]" COEFFS 0. 100. 0. 0. 0. 1. /end COMPU_METHOD
/begin COMPU_METHOD _CNV_R_R_perm_uw_b6_553_CM "" RAT_FUNC "%6.3" "[-]" COEFFS 0. 65536. 0. 0. 0. 6. /end COMPU_METHOD
/begin COMPU_METHOD _CNV_R_R_nivmmxl_ub_554_CM "" RAT_FUNC "%6.3" "[-]" COEFFS 0. 75. 0. 0. 0. 1. /end COMPU_METHOD
/begin COMPU_METHOD _CNV_R_R_nivmmxl_ub_555_CM "" RAT_FUNC "%6.3" "[-]" COEFFS 0. 32. 0. 0. 0. 1. /end COMPU_METHOD
/begin COMPU_METHOD _CNV_R_R_niv_sb_b37_556_CM "" RAT_FUNC "%6.3" "[-]" COEFFS 0. 256. 0. 0. 0. 75. /end COMPU_METHOD
/begin COMPU_METHOD _CNV_R_R_perm_sw_b6_557_CM "" RAT_FUNC "%6.3" "[-]" COEFFS 0. 32768. 0. 0. 0. 6. /end COMPU_METHOD
/begin COMPU_METHOD _CNV_R_R_fuel_uw_b6_558_CM "" RAT_FUNC "%6.3" "µL" COEFFS 0. 1. 0. 0. 0. 1. /end COMPU_METHOD
/begin COMPU_METHOD _CNV_R_R_fuel_uw_q1_559_CM "" RAT_FUNC "%6.3" "L" COEFFS 0. 1. 0. 0. 0. 1. /end COMPU_METHOD
/begin COMPU_METHOD _CNV_R_R_fuel_ul_q0_560_CM "" RAT_FUNC "%6.3" "L" COEFFS 0. 8192. 0. 0. 0. 1. /end COMPU_METHOD
/begin COMPU_METHOD _CNV_R_R_fuel96_ub_561_CM "" RAT_FUNC "%6.3" "[-]" COEFFS 0. 10. 0. 0. 0. 1. /end COMPU_METHOD
/begin COMPU_METHOD _CNV_R_R_zk1sxs_ub__562_CM "" RAT_FUNC "%6.3" "sec." COEFFS 0. 1. 0. 0. 0. 1. /end COMPU_METHOD
/begin COMPU_METHOD _CNV_S_2_RANGE______563_CM "" TAB_VERB "%6.3" "[-]" COMPU_TAB_REF _CNV_S_2_RANGE______563 /end COMPU_METHOD
/begin COMPU_VTAB _CNV_S_2_RANGE______563 "" TAB_VERB 2 0 "OFF" 1 "ON" /end COMPU_VTAB
/begin COMPU_METHOD _CNV_S_5_RANGE_BIOS_618_R_CM "" TAB_VERB "%6.3" "[-]" COMPU_TAB_REF _CNV_S_5_RANGE_BIOS_618_R /end COMPU_METHOD
/begin COMPU_VTAB_RANGE _CNV_S_5_RANGE_BIOS_618_R "" 5 110 111 "Resume" 182 183 "Set / Accelerate" 218 219 "OFF" 252 253 "Decelerate" 254 255 "None" /end COMPU_VTAB_RANGE
/begin RECORD_LAYOUT _REC_VAL_20_u1 FNC_VALUES 1 UBYTE COLUMN_DIR DIRECT /end RECORD_LAYOUT
/begin RECORD_LAYOUT _REC_VAL_20_u2 FNC_VALUES 1 UWORD COLUMN_DIR DIRECT /end RECORD_LAYOUT
/begin RECORD_LAYOUT _REC_CUR_20_u2_u1 FNC_VALUES 1 UWORD COLUMN_DIR DIRECT /end RECORD_LAYOUT
/begin RECORD_LAYOUT _REC_AXS_20_u1 NO_AXIS_PTS_X 1 UBYTE AXIS_PTS_X 2 UBYTE INDEX_INCR DIRECT /end RECORD_LAYOUT
/begin RECORD_LAYOUT _REC_CUR_20_u1_u1 FNC_VALUES 1 UBYTE COLUMN_DIR DIRECT /end RECORD_LAYOUT
/begin RECORD_LAYOUT _REC_AXS_20_u2 NO_AXIS_PTS_X 1 UWORD AXIS_PTS_X 2 UWORD INDEX_INCR DIRECT /end RECORD_LAYOUT
/begin RECORD_LAYOUT _REC_MAP_20_u1_u1_u2 FNC_VALUES 1 UBYTE COLUMN_DIR DIRECT /end RECORD_LAYOUT
/begin RECORD_LAYOUT _REC_CUR_20_u1_u2 FNC_VALUES 1 UBYTE COLUMN_DIR DIRECT /end RECORD_LAYOUT
/begin RECORD_LAYOUT _REC_MAP_20_u2_u1_u1 FNC_VALUES 1 UWORD COLUMN_DIR DIRECT /end RECORD_LAYOUT
/begin RECORD_LAYOUT _REC_CUR_20_u2_u2 FNC_VALUES 1 UWORD COLUMN_DIR DIRECT /end RECORD_LAYOUT
/begin RECORD_LAYOUT _REC_VAL_20_s1 FNC_VALUES 1 SBYTE COLUMN_DIR DIRECT /end RECORD_LAYOUT
/begin RECORD_LAYOUT _REC_VAL_20_s2 FNC_VALUES 1 SWORD COLUMN_DIR DIRECT /end RECORD_LAYOUT
/begin RECORD_LAYOUT _REC_MAP_20_u1_u2_u2 FNC_VALUES 1 UBYTE COLUMN_DIR DIRECT /end RECORD_LAYOUT
/begin RECORD_LAYOUT _REC_CUR_52_UWORD_u2_u2 NO_AXIS_PTS_X 1 UWORD AXIS_PTS_X 2 UWORD INDEX_INCR DIRECT FNC_VALUES 3 UWORD COLUMN_DIR DIRECT /end RECORD_LAYOUT
/begin RECORD_LAYOUT _REC_CUR_52_UBYTE_u1_u1 NO_AXIS_PTS_X 1 UBYTE AXIS_PTS_X 2 UBYTE INDEX_INCR DIRECT FNC_VALUES 3 UBYTE COLUMN_DIR DIRECT /end RECORD_LAYOUT
/begin FUNCTION AUX_Exhaust_flap_actuation "_Exhaust flap actuation"
 /begin DEF_CHARACTERISTIC id_nr_ip_gear_ef_at id_nr_ip_gear_ef_mt ip_pv_min_at_2_ef ip_pv_min_at_3_ef ip_pv_min_at_4_ef ip_pv_min_at_5_ef ip_pv_min_mt_1_ef ip_pv_min_mt_2_ef ip_pv_min_mt_3_ef ip_pv_min_mt_4_ef c_pv_hys_ef c_vs_min_ef_at c_vs_min_ef_mt c_t_ef_ast c_state_vs_min_ef_at c_state_vs_min_ef_mt ip_pv_min_mt_5_ef c_state_ch_ef ip_pv_min_at_1_ef /end DEF_CHARACTERISTIC
 /begin OUT_MEASUREMENT lv_ef /end OUT_MEASUREMENT
/end FUNCTION
/begin FUNCTION AUX_IVVT_application_Incidences "_IVVT application Incidences"
 /begin DEF_CHARACTERISTIC id_cam_0_seg_ofs__cam_edge_nr id_cam_1_seg_ofs__cam_edge_nr c_n_max_ivvt_1 c_n_max_ivvt_2 /end DEF_CHARACTERISTIC
 /begin OUT_MEASUREMENT cam_edge_nr_1 cam_edge_nr_0 ctr_cam_edge_ebr_det_0 ivvt_in_1.struct_raw_ivvt.cam_raw ivvt_in_1.struct_raw_ivvt.cam_edge_nr ivvt_in_1.struct_raw_ivvt.cam_psn_cap_save_ivvt ivvt_ex_1.struct_raw_ivvt.cam_raw ivvt_ex_1.struct_raw_ivvt.cam_edge_nr ivvt_ex_1.struct_raw_ivvt.cam_psn_cap_save_ivvt ivvtpwm_1 ivvtpwm_0 lv_hld_ivvtpwm_0 lv_hld_ivvtpwm_1 t_stop_cur_ivvtpwm_0 t_stop_cur_ivvtpwm_1 /end OUT_MEASUREMENT
/end FUNCTION
/begin FUNCTION AUX_Starter_Relay_Control "_Starter Relay Control" /begin OUT_MEASUREMENT lv_rly_st /end OUT_MEASUREMENT /end FUNCTION
/begin FUNCTION AUX_E_box_cooling_fan "_E-box cooling fan"
 /begin DEF_CHARACTERISTIC c_tecu_thd_ebox_cfa c_tecu_hys_ebox_cfa c_tia_thd_ebox_cfa c_tia_hys_ebox_cfa c_t_max_ebox_cfa_act c_n_thd_ebox_cfa_act /end DEF_CHARACTERISTIC
 /begin OUT_MEASUREMENT lv_ebox_cfa /end OUT_MEASUREMENT
/end FUNCTION
/begin FUNCTION AUX_Electrical_fuel_pump_Interfa "_Electrical fuel pump Interface" /end FUNCTION
/begin FUNCTION AUX_IVVT_setpoint_for_homogeneou "_IVVT setpoint for homogeneous-lean"
 /begin DEF_CHARACTERISTIC ip_cam_sp_1_ex_afl__n__maf_ivvt ip_cam_sp_2_ex_afl__n__maf_ivvt ip_cam_sp_2_in_afl__n__maf_ivvt ip_cam_sp_1_in_afl__n__maf_ivvt /end DEF_CHARACTERISTIC
 /begin OUT_MEASUREMENT ivvt_in.struct_sp_afl_ivvt.cam_sp_av_afl ivvt_ex.struct_sp_afl_ivvt.cam_sp_av_afl /end OUT_MEASUREMENT
/end FUNCTION
/begin FUNCTION AUX_IVVT_setpoint_for_stratified "_IVVT setpoint for stratified mode"
 /begin DEF_CHARACTERISTIC ip_cam_sp_1_in_is_s__n__mff_mmv ip_cam_sp_2_in_is_s__n__mff_mmv ip_cam_sp_2_in_pl_s__n__mff_mmv ip_cam_sp_1_in_pl_s__n__mff_mmv ip_cam_sp_1_ex_is_s__n__mff_mmv ip_cam_sp_2_ex_is_s__n__mff_mmv ip_cam_sp_2_ex_pl_s__n__mff_mmv ip_cam_sp_1_ex_pl_s__n__mff_mmv c_crlc_mff_sp_s /end DEF_CHARACTERISTIC
 /begin OUT_MEASUREMENT ivvt_in.struct_sp_s_ivvt.cam_sp_av_s ivvt_ex.struct_sp_s_ivvt.cam_sp_av_s mff_mmv /end OUT_MEASUREMENT
/end FUNCTION
/begin FUNCTION AUX_Application_incidences_for_t "__Application incidences for the Evaporative emission control"
 /begin OUT_MEASUREMENT lv_obd_cdn_close_mod lv_obd_cdn_min_mod lv_act_evap flow_sp_cps_evap /end OUT_MEASUREMENT
/end FUNCTION
/begin FUNCTION AUX_Sound_Flap_Control "_Sound Flap Control"
 /begin DEF_CHARACTERISTIC c_v_sof_swi_on_bol c_pv_av_sof_hys c_n_sof_hys c_vs_sof_max c_t_ast_sof c_tia_sof_min c_sofpwm_min c_t_sof_act_max id_sof_req_gear_0 id_sof_req_gear_1 id_sof_req_gear_2 id_sof_req_gear_3 id_sof_req_gear_4 id_sof_req_gear_5 id_sof_req_gear_6 ip_fac_sofpwm_on ip_fac_sofpwm_off ip_fac_sofpwm_vb ip_fac_sofpwm_tia c_vs_sof_max_hys lc_sof_act_kwp c_sofpwm_max c_v_sof_swi_on_tol c_v_sof_swi_amt_on_tol lc_var_sof_swi lc_var_sof_swi_amt lc_conf_city_ena c_sofpwm_sof_max_diag c_sofpwm_sof_min_diag /end DEF_CHARACTERISTIC
 /begin OUT_MEASUREMENT sofpwm lv_sof_inh pv_av_sof_req n_sof_req lv_sof_act lv_sof_req t_sof_act sofpwm_sof sofpwm_cor lv_sof_swi_req lv_sof_swi lv_sof_swi_amt lv_sof_swi_amt_req /end OUT_MEASUREMENT
/end FUNCTION
/begin FUNCTION AUX_Coordination_of_secondary_ai "_Coordination of secondary air mass flow determination" /begin DEF_CHARACTERISTIC lc_sa_swi_acq /end DEF_CHARACTERISTIC /begin OUT_MEASUREMENT saf_kgh saf_mdl /end OUT_MEASUREMENT /end FUNCTION
/begin FUNCTION AUX_Electronically_controlled_ra "_Electronically controlled radiator shutter"
 /begin DEF_CHARACTERISTIC c_t_dly_max_ecras_on c_t_dly_max_ecras_off c_n_32_ecras_on c_vs_fil_ecras_on c_tco_ex_ecras_on c_tco_ex_ecras_off c_n_ecf_ecras_on c_n_ecf_ecras_off c_tia_ecras_on c_tia_ecras_off c_temp_gb_ecras_on c_temp_gb_ecras_off c_ectpwm_ecras_on c_ectpwm_ecras_off lc_ecras_err_tco lc_inh_ecras c_vs_fil_ecras_off /end DEF_CHARACTERISTIC
 /begin OUT_MEASUREMENT lv_cdn_ecras_on lv_cdn_ecras_off lv_ecras_off lv_ecras_on lv_ecras ctr_t_dly_ecras_on ctr_t_dly_ecras_off /end OUT_MEASUREMENT
/end FUNCTION
/begin FUNCTION AUX_Flow_Calculations___Evaporat "_Flow Calculations - Evaporative Emission Control"
 /begin DEF_CHARACTERISTIC c_flow_cps_as c_maf_tot_cp_dly_crlc c_flow_cps_dly_crlc ip_cppwm__flow_cor_cps__prs_cps ip_fac_amp_cp__amp ip_fac_tia_cp__tia_thr ip_flow_cps__prs_cps ip_fuel_dly_cps__n_32 ip_fuel_fac_cps__n_32 ip_flow_cps_dec__maf_cyl ip_flow_cps_inc__maf_cyl ip_t_dly_cp__maf_cyl lc_flow_cps_as lc_flow_cps_cal /end DEF_CHARACTERISTIC
 /begin OUT_MEASUREMENT rel_flow_cps_av mff_add_cp flow_sp_cps flow_cor_cps flow_req_cps flow_cps cppwm_sp fuel_cps fuel_flow_add_buf[0] fuel_flow_add_buf[1] fuel_flow_add_buf[2] fuel_flow_add_buf[3] fuel_flow_add_buf[4] fuel_flow_add_buf[5] fuel_flow_add_buf[6] fuel_flow_add_buf[7] fuel_flow_add_buf[8] fuel_flow_add_buf[9] fuel_flow_add_buf[10] fuel_flow_add_buf[11] fuel_flow_add_buf[12] fuel_flow_add_buf[13] fuel_flow_add_buf[14] fuel_flow_add_buf[15] fuel_flow_add_buf[16] fuel_flow_add_buf[17] fuel_flow_add_buf[18] fuel_flow_add_buf[19] flow_tot_cps fuel_tot_cps maf_cps fac_tia_amp_cp maf_tot_cp_dly_old maf_tot_cp_old2 flow_cps_dly flow_cps_dly_old flow_cps_old flow_cps_old2 flow_cps_dly_mmv maf_tot_cp maf_tot_cp_dly maf_tot_cp_dly_mmv maf_tot_cp_old cppwm /end OUT_MEASUREMENT
/end FUNCTION
/begin FUNCTION AUX_Time_Control_between_lambda_ "_Time Control between lambda adaption and canister purge"
 /begin DEF_CHARACTERISTIC c_t_1_cp c_t_2_cp c_t_di_cp c_t_mff_ad_max c_t_1_mff_ad c_cl_mmv_t_bol c_cl_mmv_t_tol ip_t_max_cp__cl_mmv c_t_2_mff_ad c_t_4_mff_ad c_t_3_mff_ad c_thd_t_ast_2_mff_ad c_thd_t_ast_3_mff_ad c_thd_t_ast_4_mff_ad /end DEF_CHARACTERISTIC
 /begin OUT_MEASUREMENT state_t_sdl_cp t_cp t_max_cp lv_mff_ad_ena lv_cp_ena t_ad t_max_ad /end OUT_MEASUREMENT
/end FUNCTION
/begin FUNCTION AUX_Canister_Purge_ON_OFF_Valve_ "_Canister Purge ON/OFF Valve Control"
 /begin DEF_CHARACTERISTIC c_n_frq_1_cps c_n_frq_2_cps c_n_frq_hys_cps c_cppwm_frq_1_cps c_cppwm_frq_2_cps c_cppwm_frq_hys_cps c_cppwm_frq_1 c_cppwm_frq_2 c_cppwm_max_cps_diag_frq_1 c_cppwm_max_cps_diag_frq_2 c_cppwm_min_cps_diag_frq_1 c_cppwm_min_cps_diag_frq_2 c_cppwm_as lc_cppwm_lim_diag lc_cppwm_as ip_cppwm_vb_add_1__vb ip_cppwm_vb_add_2__vb ip_cppwm_vb_fac__vb ip_cppwm_cor_frq__cppwm_ref /end DEF_CHARACTERISTIC
 /begin OUT_MEASUREMENT cppwm_cps cppwm_ref lv_frq_1_cps frq_req_cp lv_close_act_cp /end OUT_MEASUREMENT
/end FUNCTION
/begin FUNCTION AUX_Variable_Intake_Manifold "_Variable Intake Manifold"
 /begin DEF_CHARACTERISTIC c_vimpwm_2 c_vimpwm_3 c_vim_av_2 c_vim_av_3 c_n_vim_l c_n_vim_hys c_n_vim_h c_fac_maf_max_vim c_fac_maf_max_vim_hys ip_fac_n_vim c_vimpwm_4 c_vimpwm_5 c_vimpwm_1 c_vimpwm_6 c_vim_av_1 c_vim_av_5 c_vim_av_4 c_vim_av_6 /end DEF_CHARACTERISTIC
 /begin OUT_MEASUREMENT vimpwm n_vim vim_av lv_vim /end OUT_MEASUREMENT
/end FUNCTION
/begin FUNCTION AUX_QLT_SENSOR "_QLT_SENSOR"
 /begin DEF_CHARACTERISTIC OZDIAGNMOT OZDIAGSPG OZERRD OZHEAL CW_OZ OZLANGLIM1 OZLANGLIM2 OZLIM1HEAL OZLIM2HEAL OZORLIM2 OZVORLIM1 OZVORLIM2 OZKMUPL OZNIVKL OZPERMKL OZTEMPKL OZMWK OZMWL OZMWOR OZMWV OZNFCNT OZNFTMPMAX OZNFTMPMIN OZNIVMMLIT OZNIVNFM05 OZNIVNFM10 OZNMNIVKL OZNMOTMAX OZNMOTMIN OZTEMPBW OZTEMPORR OZBZKMSTK1 OZOELKMPL OZPERMCOK5 OZPERMMIN OZPERMMNIV OZPERMNK3 OZPERMTIK6 OZPERMTIK8 OZPERMTIK9 OZPERMTK12 OZPERMTK13 OZPERMTK4 OZPERMTK7 OZANFANZ OZKMMAXK11 OZKVB96 OZKVBMXK18 OZKVBOK16 OZLF1 OZLF2 OZMNKMBO OZMXOHK15 OZPERBOK17 OZPERBRK14 OZPERXK10 OZTAGCTERR OZZEITFAKT OZTEMPZK /end DEF_CHARACTERISTIC
 /begin OUT_MEASUREMENT B_ozfbsd ozlerrc oznivr ozqerrc ozsierrc ozstatus ozterrc ub dqltBits2_1s dqltBits2_1s.B_ozdiagok dqltBits2_1s.B_ozfsheal dqltBits2_1s.B_ozlerr dqltBits2_1s.B_ozlerrb dqltBits2_1s.B_ozqerr dqltBits2_1s.B_ozqerrb dqltBits2_1s.B_ozsierrb dqltBits2_1s.B_oztemic dqltBits2_1s.B_ozterr dqltBits2_1s.B_ozterrb dqltBits1_1s dqltBits1_1s.B_ozwertok B_masterhw bos01_w bosbtvfbk bosstate idbosmsg idfbosmg_w idfbosmgt ozkrzor ozlangmw ozrwanz ozrwanzt ozsvcntchg oztempf ozvfanz ozvftmp ozvormw toel_w toeloz tol zrbosmld ozbgBits1_1s ozbgBits1_1s.B_mol_vb ozbgBits1_1s.B_bosmsgc ozbgBits1_1s.B_mol_vl ozbgBits1_1s.B_oeltemp bosbtvfbkt idbosrst idfbosrt_w idfbosrtt ozlowcnt ozlowkm[0] ozlowkm[1] ozlowkm[2] ozlowkm[3] ozlowkm[4] ozlowkm[5] ozlowperex[0] ozlowperex[1] ozlowperex[2] ozlowperex[3] ozlowperex[4] ozlowperex[5] ozlowperm0[0] ozlowperm0[1] ozlowperm0[2] ozlowperm0[3] ozlowperm0[4] ozlowperm0[5] ozlowrwanz[0] ozlowrwanz[1] ozlowrwanz[2] ozlowrwanz[3] ozlowrwanz[4] ozlowrwanz[5] ozniv oznivt ozperm_w ozpermex ozpermlow ozpermr_w ozpermt oztemp oztempr oztempt ozvfbdmew vbost zrbosr zrbosrt ozggBits2_1s ozggBits2_1s.B_dmewech ozggBits2_1s.B_dmeini ozggBits1_1s ozggBits1_1s.B_svcntchg ozggBits1_1s.B_oelwech ozggBits1_1s.B_ozniv ozggBits1_1s.B_ozperm ozggBits1_1s.B_ozvfchg ozggBits1_1s.B_oztemp B_sa ozkrzcnt ozkrzmw ozkrzmwkor ozlgmwcnt oznivlgalt oznivlgneu oznivnflit oznivnfm oznmotmw ozvormwcnt oznivBits3_1s oznivBits3_1s.B_ozor oznivBits3_1s.B_ozvormw oznivBits4_1s oznivBits4_1s.B_ozlangmw oznivBits2_1s oznivBits2_1s.B_ozlw1 oznivBits1_1s oznivBits1_1s.B_ozkrzkor oznivBits1_1s.B_ozlw2 oznivBits1_1s.B_oznferk B_eepinioz ozdindex ozdperm ozdpermsi ozeranzp1 ozeranzp2 ozeranzprf ozkmlow ozkmpermgl ozkmreg[0] ozkmreg[1] ozkmreg[2] ozkmreg[3] ozkmreg[4] ozkmreg[5] ozkmreg[6] ozkmreg[7] ozkmreg[8] ozkmreg[9] ozkmreg[10] ozkmreg[11] ozkmreg[12] ozkmreg[13] ozkmreg[14] ozlaufvar ozlf1t oznivkm ozoelkm ozpermanz ozpermerp1 ozpermerp2 ozpermerpr ozpermkmp1 ozpermkmp2 ozpermkmpr ozpermko_w ozpermoff ozpermpl_w ozpermreg[0] ozpermreg[1] ozpermreg[2] ozpermreg[3] ozpermreg[4] ozpermreg[5] ozpermreg[6] ozpermreg[7] ozpermreg[8] ozpermreg[9] ozpermreg[10] ozpermreg[11] ozpermreg[12] ozpermreg[13] ozpermreg[14] ozprfstrg ozshift oztv1 oztv2 oztv3 ozvfbfak todeltime kvaverbr kvaverl ozcttagini ozdkvb ozgwfnbo ozkmstrw0 ozkvbbgw ozkvbdmew ozkvbmx ozkvbog ozkvbogw ozkvbsm_ul ozkvbtmp1 ozkvbtmp2 ozkvbtmp3 ozkvbtmp4 ozlf1c ozlf2c ozlf2t ozoelzeit ozpermbgw ozpermbog ozpermbogw ozpermma ozpermtmp1 ozpermtmp2 ozpermtmp3 ozrwkvb ozrwkvba ozrwkvbr ozrwp ozrwperm ozrwperma ozrwpermr ozrwzeit ozrwzeita ozrwzeitr ozvfkvb ozvfzeit ozzeittmp1 ozzeittmp2 ozzeittmp3 ztageabs_w m_tol fspvdqltBits_1s fspvdqltBits_1s.B_ozclfsp lv_err_qoil_sens /end OUT_MEASUREMENT
/end FUNCTION
/begin FUNCTION AUX_Application_incidences_for_E "_Application incidences for Electrical fuel pump Interface" /begin DEF_CHARACTERISTIC c_eng_typ_efp /end DEF_CHARACTERISTIC
 /begin OUT_MEASUREMENT lv_efp_on_ext_adj_can lv_efp_off_ext_adj_can state_diag_efp state_efp_can v_eng_efp cur_eng_efp vb_efp n_efp_av /end OUT_MEASUREMENT
/end FUNCTION
/begin FUNCTION AUX_Mastershift "_Mastershift" /end FUNCTION
/begin FUNCTION BIO_Basic_SW_Inputs_and_Outputs "BIO"
 /begin SUB_FUNCTION BIO_Standard_analog_inputs BIO_Keyword_Protocol_2000 BIO_PWM_outputs BIO_Logic_inputs BIO_Acquisition_of_after_ignitio BIO_MSW_interface BIO_Acquisition_of_oil_pressure_ BIO_Acquisition_of_secondary_air BIO_Aquisition_Oil_temperature_a /end SUB_FUNCTION
/end FUNCTION
/begin FUNCTION BIO_Standard_analog_inputs "_Standard analog inputs"
 /begin DEF_CHARACTERISTIC c_cam_sync_dly c_n_min_crk_tooth_vld id_crk_gap_ratio__n id_cam_tooth_per_sp_fac__n id_crk_tooth_per_sp_fac__n id_saf_tab id_cam_tooth_ratio__n id_crk_tooth_ratio__n id_maf_tab /end DEF_CHARACTERISTIC
 /begin OUT_MEASUREMENT v_amp v_tia v_pvs_1 v_pvs_2 v_tco v_tco_ex v_tps_1 v_tps_2 v_ls_up_1 v_ls_up_2 v_ls_down_2 v_ls_down_1 vcc_pvs_1 vcc_pvs_2 v_vim_fb v_teg_pcat_down_1 v_teg_pcat_down_2 v_tecu v_fps v_saf maf_ctr_1 maf_sum_1 maf_sum v_maf vb_bas maf_ctr lv_maf_seg v_igk_bas vcc_maf v_toil v_pvs_2_mc v_pvs_2_mu /end OUT_MEASUREMENT
/end FUNCTION
/begin FUNCTION BIO_Keyword_Protocol_2000 "_Keyword Protocol 2000"
 /begin OUT_MEASUREMENT v_dur_igc[0] v_dur_igc[1] v_dur_igc[2] v_dur_igc[3] v_dur_igc[4] v_dur_igc[5] lv_td_igc_cut[0] lv_td_igc_cut[1] lv_td_igc_cut[2] lv_td_igc_cut[3] lv_td_igc_cut[4] lv_td_igc_cut[5] /end OUT_MEASUREMENT
/end FUNCTION
/begin FUNCTION BIO_PWM_outputs "_PWM outputs" /begin DEF_CHARACTERISTIC c_swi_vepu_as /end DEF_CHARACTERISTIC /end FUNCTION
/begin FUNCTION BIO_Logic_inputs "_Logic inputs"
 /begin OUT_MEASUREMENT lv_im_bls lv_im_st lv_im_lock lv_im_cru_set_ac lv_im_cru_resu_dece lv_im_cru_main_off lv_im_bts lv_im_cs_pn /end OUT_MEASUREMENT
/end FUNCTION
/begin FUNCTION BIO_Acquisition_of_after_ignitio "_Acquisition of after ignition key battery voltage" /begin OUT_MEASUREMENT lv_key_off t_seg_mis vb_mes v_igk_mes /end OUT_MEASUREMENT /end FUNCTION
/begin FUNCTION BIO_MSW_interface "_MSW interface" /begin OUT_MEASUREMENT bios_cru_data /end OUT_MEASUREMENT /end FUNCTION
/begin FUNCTION BIO_Acquisition_of_oil_pressure_ "_Acquisition of oil pressure switch" /begin OUT_MEASUREMENT lv_poil_swi /end OUT_MEASUREMENT /end FUNCTION
/begin FUNCTION BIO_Acquisition_of_secondary_air "_Acquisition of secondary air mass flow"
 /begin OUT_MEASUREMENT saf_kgh_mes_bas saf_sum saf_sum_1 saf_ctr saf_ctr_1 lv_saf_seg /end OUT_MEASUREMENT
/end FUNCTION
/begin FUNCTION BIO_Aquisition_Oil_temperature_a "_Aquisition Oil temperature and level sensor"
 /begin DEF_CHARACTERISTIC TOG_TK_MAX TOG_TK_MIN TOG_TR_MAX TOG_TR_MIN TOG_TV_MAX TOG_TV_MIN TOG_VERS TOGVERZOEG /end DEF_CHARACTERISTIC
 /begin OUT_MEASUREMENT B_toel B_tog Tog_cnt Tog_icnt Tog_pwmst Tog_state Tog_tk Tog_tr Tog_tv Tog_uplcnt Tog_st Tog_st.B_togerr Tog_st.B_togupl /end OUT_MEASUREMENT
/end FUNCTION
/begin FUNCTION DIA_Diagnosis_and_limp_home "DIA"
 /begin SUB_FUNCTION DIA_Mass_air_flow_meter DIA_Intake_air_temperature_senso DIA_Temperature_sensor___TCO_EX_ DIA_IVVT_diagnosis DIA_Fuel_pump_relay_RLY_EFP DIA_Ambient_pressure_sensor DIA_Upstream_oxygen_sensor_heate DIA_Downstream_oxygen_sensor_hea DIA_Oil_temperature_sensor_TOIL DIA_Electronically_controlled_th DIA_Knock_sensor_diagnosis DIA_Vehicle_speed_signal_diagnos DIA_Ignition_system_diagnosis DIA_Throttle_position_sensor_dia DIA_Injection_valves_IV_1_to_6 DIA_Canister_purge_valve_diagnos DIA_ETC_driver_diagnosis DIA_Lambda_sensor_upstream_heate DIA_Lambda_sensor_downstream_hea DIA_Generator_diagnosis DIA_Crankshaft_Signal_Diagnosis_ DIA_Camshaft_Sensor_Diagnosis_an DIA_Secondary_Air_Valve_Diagnosi DIA_Electronical_Cooling_Fan_Dia DIA_Secondary_Air_Pump_Diagnosis DIA_Air_Condition_Compressor_Con DIA_Main_Relay_Diagnosis__RLY_MA DIA_Coolant_Temperature_Sensor_D DIA_TCO_Sensor_Plausibility_Diag DIA_Idle_Speed_Control_Diagnosis DIA_CAN_diagnosis DIA_Multifunctional_steering_whe DIA_Pedal_value_sensor_diagnosis DIA_Brake_light_switch_diagnosis DIA_Idle_Speed_Actuator_Diagnosi DIA_Engine_roughness_idle_diagno DIA_Variable_Intake_Manifold__VI DIA_Immobilizer_signal_diagnosis DIA_Exhaust_flap_diagnosis DIA_Anti_bounce_algorithm DIA_Torque_Request_for_Safety_Di DIA_E_box_cooling_fan_diagnosis DIA_ECU_temperature_sensor_diagn DIA_Upstream_oxygen_sensor_signa DIA_Application_incidences_for_u DIA_Application_incidences_for_d DIA_Downstream_oxygen_sensor_sig DIA_Tank_leakage_pump_diagnosis DIA_SOF_diagnosis DIA_Oil_pressure_switch_diagnosi DIA_Starter_Output_Diagnosis DIA_BSD_Diagnosis DIA_Diagnosis_Oil_temperature_an DIA_CAN_diagnosis_for_EFP_contro DIA_TPS___ETC_Limp_Home_Manager DIA_ETC_Actuator_diagnosis_and_A DIA_Electric_solenoid_valve_diag DIA_Distance_cruise_control_diag DIA_GS_intervention_plausibility DIA_AMT_intervention_plausibilit DIA_Electronically_controlled_ra DIA_DMTL_heater_diagnosis DIA_Application_incidences_NOx_S DIA_NOx_Sensor_Diagnosis___OBD_I DIA_CAN_diagnosis_for_NOX_contro DIA_ECU_selftest DIA_Clutch_switch_diagnosis DIA_SPI_Bus_diagnosis DIA_PVS_diagnosis_application_in DIA_Automatic_gear_shift_signal_ /end SUB_FUNCTION
/end FUNCTION
/begin FUNCTION DIA_Mass_air_flow_meter "_Mass air flow meter"
 /begin DEF_CHARACTERISTIC c_n_min_maf_diag c_maf_min_diag c_isapwm_maf_min_isa_diag c_maf_kgh_diag_ini id_crlc_maf_diag__n_32 ip_maf_max_isa__pq_turb_sys c_maf_max_diag c_fac_tq_req_min_maf_diag ip_fac_pq_isa__isapwm /end DEF_CHARACTERISTIC
 /begin OUT_MEASUREMENT pq_turb_sys maf_sub_isa maf_kgh_diag lv_maf_bls_diag lv_err_maf /end OUT_MEASUREMENT
/end FUNCTION
/begin FUNCTION DIA_Intake_air_temperature_senso "_Intake air temperature sensor" /begin DEF_CHARACTERISTIC c_tia_max_diag c_tia_min_diag /end DEF_CHARACTERISTIC /begin OUT_MEASUREMENT lv_err_tia /end OUT_MEASUREMENT /end FUNCTION
/begin FUNCTION DIA_Temperature_sensor___TCO_EX_ "_Temperature sensor - TCO_EX Coolant" /begin DEF_CHARACTERISTIC c_t_tia_tco_ex_diag /end DEF_CHARACTERISTIC /begin OUT_MEASUREMENT lv_err_tco_ex /end OUT_MEASUREMENT /end FUNCTION
/begin FUNCTION DIA_IVVT_diagnosis "_IVVT diagnosis"
 /begin DEF_CHARACTERISTIC c_t_dly_diag_ref_ivvt c_cam_hys_diag_ivvt c_ctr_thd_ivvt_park /end DEF_CHARACTERISTIC
 /begin OUT_MEASUREMENT lv_err_ivvt lv_err_mec_ivvt_in_1 lv_err_ref_ivvt_in_1 lv_err_mec_ivvt_ex_1 lv_err_ref_ivvt_ex_1 lv_err_park_ivvt_in_1 lv_err_park_ivvt_ex_1 /end OUT_MEASUREMENT
/end FUNCTION
/begin FUNCTION DIA_Fuel_pump_relay_RLY_EFP "_Fuel pump relay RLY_EFP" /begin OUT_MEASUREMENT lv_err_rly_efp /end OUT_MEASUREMENT /end FUNCTION
/begin FUNCTION DIA_Ambient_pressure_sensor "_Ambient pressure sensor" /begin DEF_CHARACTERISTIC c_amp_ref c_v_amp_max_diag c_v_amp_min_diag /end DEF_CHARACTERISTIC /begin OUT_MEASUREMENT lv_err_amp /end OUT_MEASUREMENT /end FUNCTION
/end MODULE
/end PROJECT
