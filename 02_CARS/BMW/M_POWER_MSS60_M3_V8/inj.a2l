ASAP2_VERSION 1 30
/begin PROJECT MSS65-inj "Generiert am 14.10.05 um 11:34:36"
/begin HEADER "" VERSION "R341" /end HEADER
/begin MODULE _MSS65-inj "Generiert am 14.10.05 um 11:34:36"
/begin MOD_PAR "" VERSION "ccp 2.1" ADDR_EPK 0x63A10 EPK "V530" SUPPLIER "ZS-M-57" CUSTOMER "ZS-M-52" CUSTOMER_NO "xxx" USER "Q......." ECU "MSS65-INJ"
 /begin MEMORY_SEGMENT CODESEG1 "Program" CODE FLASH INTERN 0x10000 0x60000 -1 -1 -1 -1 -1 /end MEMORY_SEGMENT
 /begin MEMORY_SEGMENT CODESEG2 "Program" CODE FLASH EXTERN 0x450000 0x1B0000 -1 -1 -1 -1 -1 /end MEMORY_SEGMENT
 /begin MEMORY_SEGMENT DATASEG1 "Appl.-DATA" DATA FLASH INTERN 0x70000 0x10000 -1 -1 -1 -1 -1 /end MEMORY_SEGMENT
 /begin MEMORY_SEGMENT VARSEG "Variablen" VARIABLES RAM INTERN 0x3F8000 0x8000 -1 -1 -1 -1 -1 /end MEMORY_SEGMENT
 /begin CALIBRATION_METHOD DSERAP 1 /begin CALIBRATION_HANDLE 458752 65532 /end CALIBRATION_HANDLE /end CALIBRATION_METHOD
/end MOD_PAR
/begin MOD_COMMON "" BYTE_ORDER MSB_FIRST ALIGNMENT_BYTE 1 ALIGNMENT_WORD 2 ALIGNMENT_LONG 4 ALIGNMENT_FLOAT32_IEEE 4 ALIGNMENT_FLOAT64_IEEE 8 /end MOD_COMMON
/begin IF_DATA EDIC_ISO_DS2 "V1.0" 0x12 25 1 SUPP_SERVICE READMEM SUPP_SERVICE WRITEMEM SUPP_SERVICE ACK TELDATA 0x9E /end IF_DATA
/begin IF_DATA ASAP1B_CCP
 /begin SOURCE "5 ms" 3 5 QP_BLOB 0 LENGTH 20 CAN_ID_FIXED 0x510 RASTER 0 FIRST_PID 0 /end SOURCE
 /begin SOURCE "100 ms" 5 1 QP_BLOB 1 LENGTH 10 CAN_ID_FIXED 0x511 RASTER 1 FIRST_PID 20 /end SOURCE
 /begin SOURCE "segment-synchron" 103 1 QP_BLOB 2 LENGTH 10 CAN_ID_FIXED 0x512 RASTER 2 FIRST_PID 30 /end SOURCE
 /begin TP_BLOB 0x201 0x202 0x500 0x501 0x1234 MSB_FIRST /begin CAN_PARAM 0x1F4 0x41 0x25 /end CAN_PARAM
  /begin DEFINED_PAGES 1 Workingpage 0x0 0xC70000 0x10000 RAM RAM_INIT_BY_ECU FLASH_BACK DEFAULT /end DEFINED_PAGES
  /begin DEFINED_PAGES 2 Referenzpage 0x0 0x70000 0x10000 FLASH RAM_INIT_BY_ECU /end DEFINED_PAGES
  OPTIONAL_CMD 0xC OPTIONAL_CMD 0xD OPTIONAL_CMD 0xE OPTIONAL_CMD 0x9 OPTIONAL_CMD 0x10 OPTIONAL_CMD 0x11 OPTIONAL_CMD 0x12 OPTIONAL_CMD 0x13 OPTIONAL_CMD 0x18 OPTIONAL_CMD 0x19 OPTIONAL_CMD 0x22 OPTIONAL_CMD 0x23 BAUDRATE 500000 SAMPLE_POINT 66 SAMPLE_RATE 1 /begin CHECKSUM_PARAM 0x8009 65532 CHECKSUM_CALCULATION ACTIVE_PAGE /end CHECKSUM_PARAM RESUME_SUPPORTED STORE_SUPPORTED /end TP_BLOB
 /begin RASTER "5ms-Task" 5ms 0 3 5 /end RASTER
 /begin RASTER "100ms-Task" 100ms 1 5 1 /end RASTER
 /begin RASTER "sync-Task" sync 2 103 1 /end RASTER
/end IF_DATA
/begin IF_DATA ASAP1B_KWP2000
 /begin SOURCE "timeslot" 0 0 QP_BLOB 0 BLOCKMODE 0xf0 0 20 /end SOURCE
 /begin TP_BLOB 0x100 0x11 0xF1 WuP MSB_FIRST 1 0x0 TIME_DEF 20 2 25 28 250 0 SERAM 393472 393472 457471 457471 0 0 1 0 0 1 /begin CHECKSUM 0x10201 0x1 0x1 REQUESTROUTINERESULTS RNC_RESULT 35 /end CHECKSUM
  /begin FLASH_COPY TOOLFLASHBACK 0x3 REQUESTROUTINERESULTS RAM_INITBYECU 0x86 COPY_FRAME 1 RNC_RESULT 35 251 252 /end FLASH_COPY
  K_LINE WuP 0x11 0xF1 /end TP_BLOB
/end IF_DATA
/begin CHARACTERISTIC K_AG_TI_ANZ "Anzahl der unmittelbar aufeinanderfolgenden Ausblendungen." VALUE 0x70298 TKW_VV_VV_UW 100.0 FORMULA_0010 0.0 65535.0 /end CHARACTERISTIC
/begin CHARACTERISTIC K_AG_TI_CFG "Welcher Aussetzergenerator" VALUE 0x70294 TKW_VV_VV_UB 100.0 FORMULA_0576 0.0 3.0 /end CHARACTERISTIC
/begin CHARACTERISTIC K_AG_TI_PAUSE "Anzahl der Arbeitsspiele zwischen Ausblendungen." VALUE 0x7029A TKW_VV_VV_UW 100.0 FORMULA_0010 0.0 65535.0 /end CHARACTERISTIC
/begin CHARACTERISTIC K_AG_TI_V_MIN "Minimale Geschwindigkeitsschwelle." VALUE 0x7029C TKW_VV_VV_SW 100.0 FORMULA_0076 -80.0 360.0 FORMAT "%4.1" /end CHARACTERISTIC
/begin CHARACTERISTIC K_AG_TI_ZYL "Statisches Ausblendmuster." VALUE 0x70296 TKW_VV_VV_UW 100.0 FORMULA_0010 0.0 65535.0 /end CHARACTERISTIC
/begin CHARACTERISTIC K_BSD_BUS_ENABLE "BSD Bus aktivieren." VALUE 0x70753 TKW_VV_VV_UB 100.0 FORMULA_0003 0.0 1.0 /end CHARACTERISTIC
/begin CHARACTERISTIC K_BSD_KTENABLE "Codewort aktivierte BSD Komponententreiber" VALUE 0x70774 TKW_VV_VV_UB 100.0 FORMULA_0003 0.0 255.0 /end CHARACTERISTIC
/begin CHARACTERISTIC K_BSD_SCHEDTAB "BSD Schedulertabelle" VAL_BLK 0x70754 TKW_VV_VV_UB 100.0 FORMULA_0487 0.0 8.0 NUMBER 32 /end CHARACTERISTIC
/begin CHARACTERISTIC K_DEBUG_READ_ADR "Read Address" VALUE 0x70784 TKW_VV_VV_UL 100.0 FORMULA_0044 0.0 4294967295.0 FORMAT "%5.2" /end CHARACTERISTIC
/begin CHARACTERISTIC K_DEBUG_RW_LENGTH "Read/-Write Length" VALUE 0x70790 TKW_VV_VV_UB 100.0 FORMULA_0037 0.0 255.0 /end CHARACTERISTIC
/begin CHARACTERISTIC K_DEBUG_WRITE_ADR "Write Address" VALUE 0x70788 TKW_VV_VV_UL 100.0 FORMULA_0044 0.0 4294967295.0 FORMAT "%5.2" /end CHARACTERISTIC
/begin CHARACTERISTIC K_DEBUG_WRITE_VALUE "Write VALUE" VALUE 0x7078C TKW_VV_VV_UL 100.0 FORMULA_0044 0.0 4294967295.0 FORMAT "%5.2" /end CHARACTERISTIC
/begin CHARACTERISTIC K_DI1000DT "" VALUE 0x72F0A TKW_VV_VV_UB 100.0 FORMULA_0741 0.0 12.75 /end CHARACTERISTIC
/begin CHARACTERISTIC K_DI1000STG "" VALUE 0x72F08 TKW_VV_VV_UB 100.0 FORMULA_0740 0.0 20.39999961853027 /end CHARACTERISTIC
/begin CHARACTERISTIC K_DI1000TGRZ "" VALUE 0x72EFF TKW_VV_VV_UB 100.0 FORMULA_0476 0.0 255.0 /end CHARACTERISTIC
/begin CHARACTERISTIC K_DI200DT "" VALUE 0x72F09 TKW_VV_VV_UB 100.0 FORMULA_0741 0.0 12.75 /end CHARACTERISTIC
/begin CHARACTERISTIC K_DI200STG "" VALUE 0x72F07 TKW_VV_VV_UB 100.0 FORMULA_0733 0.0 5.099999904632568 /end CHARACTERISTIC
/begin CHARACTERISTIC K_DIHIGHGRZ "" VALUE 0x72F03 TKW_VV_VV_UB 100.0 FORMULA_0740 0.0 20.39999961853027 /end CHARACTERISTIC
/begin CHARACTERISTIC K_DILOWGRZ "" VALUE 0x72F02 TKW_VV_VV_UB 100.0 FORMULA_0733 0.0 5.099999904632568 /end CHARACTERISTIC
/begin CHARACTERISTIC K_DIPL5 "" VALUE 0x72F0D TKW_VV_VV_UB 100.0 FORMULA_0003 0.0 255.0 /end CHARACTERISTIC
/begin CHARACTERISTIC K_DIPL6 "" VALUE 0x72F0E TKW_VV_VV_UB 100.0 FORMULA_0003 0.0 255.0 /end CHARACTERISTIC
/begin CHARACTERISTIC K_DIPL7 "" VALUE 0x72F0F TKW_VV_VV_UB 100.0 FORMULA_0003 0.0 255.0 /end CHARACTERISTIC
/begin CHARACTERISTIC K_DIPL8 "" VALUE 0x72F10 TKW_VV_VV_UB 100.0 FORMULA_0003 0.0 255.0 /end CHARACTERISTIC
/begin CHARACTERISTIC K_DKL15FIL "" VALUE 0x72F05 TKW_VV_VV_UB 100.0 FORMULA_0742 0.0 1.593700051307678 /end CHARACTERISTIC
/begin CHARACTERISTIC K_DTMAXGRZI "" VALUE 0x72F01 TKW_VV_VV_UB 100.0 FORMULA_0476 0.0 255.0 /end CHARACTERISTIC
/begin CHARACTERISTIC K_DUIGRZ "" VALUE 0x72F00 TKW_VV_VV_UB 100.0 FORMULA_0733 0.0 5.099999904632568 /end CHARACTERISTIC
/begin CHARACTERISTIC K_DUMINTGRZ "" VALUE 0x72F04 TKW_VV_VV_UB 100.0 FORMULA_0741 0.0 12.75 /end CHARACTERISTIC
/begin CHARACTERISTIC K_DUREFMAX "" VALUE 0x72F06 TKW_VV_VV_UB 100.0 FORMULA_0743 0.0 4.998000144958496 /end CHARACTERISTIC
/begin CHARACTERISTIC K_DUREFMINI "" VALUE 0x72F11 TKW_VV_VV_UB 100.0 FORMULA_0743 0.0 4.998000144958496 /end CHARACTERISTIC
/begin CHARACTERISTIC K_ENABSDIBS "kt_ibs enable Kommunikation" VALUE 0x72F24 TKW_VV_VV_UB 100.0 FORMULA_0003 0.0 255.0 /end CHARACTERISTIC
/begin CHARACTERISTIC K_ENISOC0 "" VALUE 0x72EF0 TKW_VV_VV_UB 100.0 FORMULA_0733 0.0 5.099999904632568 /end CHARACTERISTIC
/begin CHARACTERISTIC K_ENUSOC0 "" VALUE 0x72EF1 TKW_VV_VV_UB 100.0 FORMULA_0734 6.0 22.31999969482422 /end CHARACTERISTIC
/begin CHARACTERISTIC K_ERREPEAT "EBSD Fehler repeat" VALUE 0x72F25 TKW_VV_VV_UB 100.0 FORMULA_0003 0.0 255.0 /end CHARACTERISTIC
/begin CHARACTERISTIC K_GEN_BSD_ERROR_CC_CNT "Generatorfehler-Zeitzaehlerschwelle" VALUE 0x702A4 TKW_VV_VV_UW 100.0 FORMULA_0597 0.0 1092.25 FORMAT "%5.2" /end CHARACTERISTIC
/begin CHARACTERISTIC K_GEN_BSD_VARIANTE "Gen.-regler-Variante" VALUE 0x702A2 TKW_VV_VV_UB 100.0 FORMULA_0596 0.0 255.0 /end CHARACTERISTIC
/begin CHARACTERISTIC K_GEN_SLP_UG "Generatorspannungsvorgabe bei SLP-Betrieb" VALUE 0x702A0 TKW_VV_VV_UW 100.0 FORMULA_0466 0.0 6553.5 FORMAT "%6.3" /end CHARACTERISTIC
/begin CHARACTERISTIC K_IBSTSTERR "EBSD Fehler repeat" VALUE 0x72F27 TKW_VV_VV_UB 100.0 FORMULA_0003 0.0 255.0 /end CHARACTERISTIC
/begin CHARACTERISTIC K_IBSVERSION "Liste der kompatiblen IBS SW- Versionen" VAL_BLK 0x72F14 TKW_VV_VV_UB 100.0 FORMULA_0003 0.0 255.0 NUMBER 16 /end CHARACTERISTIC
/begin CHARACTERISTIC K_IBTEMPMAXI "" VALUE 0x72F12 TKW_VV_VV_UB 100.0 FORMULA_0003 0.0 255.0 /end CHARACTERISTIC
/begin CHARACTERISTIC K_IBTEMPMINI "" VALUE 0x72F13 TKW_VV_VV_UB 100.0 FORMULA_0003 0.0 255.0 /end CHARACTERISTIC
/begin CHARACTERISTIC K_IBUNPLADEL "EBSD Fehler repeat" VALUE 0x72F26 TKW_VV_VV_UB 100.0 FORMULA_0003 0.0 255.0 /end CHARACTERISTIC
/begin CHARACTERISTIC K_ISLEEPGRZ "" VALUE 0x72EFE TKW_VV_VV_UB 100.0 FORMULA_0733 0.0 5.099999904632568 /end CHARACTERISTIC
/begin CHARACTERISTIC K_ISTARTTRIG "" VALUE 0x72EF5 TKW_VV_VV_UB 100.0 FORMULA_0502 0.0 1305.599975585938 /end CHARACTERISTIC
/begin CHARACTERISTIC K_OELSTAND_CAN_PST_LINEAR "Oelstand per CAN Ident-381h" VALUE 0x702A6 TKW_VV_VV_UB 100.0 FORMULA_0003 0.0 1.0 /end CHARACTERISTIC
/begin CHARACTERISTIC K_OZ_1_5_L_BEGR "1,5L-Anzeigeschwelle" VALUE 0x702BC TKW_VV_VV_UB 100.0 FORMULA_0595 -10.0 15.39990043640137 /end CHARACTERISTIC
/begin CHARACTERISTIC K_OZ_1L_BEGR_O "obere 1L-Schwelle abzgl. Kraftst." VALUE 0x702BB TKW_VV_VV_UB 100.0 FORMULA_0595 -10.0 15.39990043640137 /end CHARACTERISTIC
/begin CHARACTERISTIC K_OZ_1L_BEGR_U "untere 1L-Schwelle abzgl. Kraftst." VALUE 0x702B8 TKW_VV_VV_UB 100.0 FORMULA_0595 -10.0 15.39990043640137 /end CHARACTERISTIC
/begin CHARACTERISTIC K_OZ_AG_MESSSTAB_MIN_OK "Schwelle Motoroel Min-OK" VALUE 0x702BD TKW_VV_VV_UB 100.0 FORMULA_0595 -10.0 15.39990043640137 /end CHARACTERISTIC
/begin CHARACTERISTIC K_OZ_AG_MESSSTAB_OK "Schwelle Motoroel OK" VALUE 0x702BE TKW_VV_VV_UB 100.0 FORMULA_0595 -10.0 15.39990043640137 /end CHARACTERISTIC
/begin CHARACTERISTIC K_OZ_AG_MESSSTAB_OK_MAX "Schwelle Motoroel OK-Max" VALUE 0x702BF TKW_VV_VV_UB 100.0 FORMULA_0595 -10.0 15.39990043640137 /end CHARACTERISTIC
/begin CHARACTERISTIC K_OZ_ALT_HYST_F "Mindestschwankung Langzeitmsg." VALUE 0x702B5 TKW_VV_VV_UB 100.0 FORMULA_0438 0.0 25.5 /end CHARACTERISTIC
/begin CHARACTERISTIC K_OZ_ALT_HYST_U "Mind.schwankung (nach unten) Erstuebernahme Lzw." VALUE 0x702B4 TKW_VV_VV_UB 100.0 FORMULA_0438 0.0 25.5 /end CHARACTERISTIC
/begin CHARACTERISTIC K_OZ_ALT_NACHF "Nachfuellerkennung Motoroel" VALUE 0x702B2 TKW_VV_VV_UB 100.0 FORMULA_0438 0.0 25.5 /end CHARACTERISTIC
/begin CHARACTERISTIC K_OZ_CC_OELVERBRAUCH "Schwelle Motoroel bei Minimum" VALUE 0x702B9 TKW_VV_VV_UB 100.0 FORMULA_0595 -10.0 15.39990043640137 /end CHARACTERISTIC
/begin CHARACTERISTIC K_OZ_CC_OELVERLUST "Schwelle Motoroel unter Minimum bzw. Oelverlust" VALUE 0x702BA TKW_VV_VV_UB 100.0 FORMULA_0595 -10.0 15.39990043640137 /end CHARACTERISTIC
/begin CHARACTERISTIC K_OZ_KRZ_HYST "Mindestschwankung Kurzzeitmsg." VALUE 0x702B6 TKW_VV_VV_UB 100.0 FORMULA_0438 0.0 25.5 /end CHARACTERISTIC
/begin CHARACTERISTIC K_OZ_KRZ_HYST_CBS "Mindestschwankung (CBS frisch)" VALUE 0x702B3 TKW_VV_VV_UB 100.0 FORMULA_0438 0.0 25.5 /end CHARACTERISTIC
/begin CHARACTERISTIC K_OZ_KRZ_MESSUNG_LL "Oelstanderfassung nach x sec. im Leerlauf" VALUE 0x702B0 TKW_VV_VV_UW 100.0 FORMULA_0021 0.0 655.0 FORMAT "%5.2" /end CHARACTERISTIC
/begin CHARACTERISTIC K_OZ_LZW_AEND_BEGR "neg. Inkrement Langzeitmsg." VALUE 0x702B7 TKW_VV_VV_UB 100.0 FORMULA_0438 0.0 25.5 /end CHARACTERISTIC
/begin CHARACTERISTIC K_OZ_MIN_LEVEL_VOL "Gesamtoelmenge Min-Stand" VALUE 0x702C0 TKW_VV_VV_UW 100.0 FORMULA_0598 0.0 20.0 FORMAT "%5.2" /end CHARACTERISTIC
/begin CHARACTERISTIC K_OZ_N_OELMAXKORR_O "ob. Drehz.grenze Wichtung Langzeitmw." VALUE 0x702AE TKW_VV_VV_SW 100.0 FORMULA_0006 -32768.0 32767.0 /end CHARACTERISTIC
/begin CHARACTERISTIC K_OZ_N_OELMAXKORR_U "unt. Drehz.grenze Wichtung Langzeitmw." VALUE 0x702AC TKW_VV_VV_SW 100.0 FORMULA_0006 -32768.0 32767.0 /end CHARACTERISTIC
/begin CHARACTERISTIC K_OZ_NIV_KM_MAX "max. Km nach letzter Oelnivmessg." VALUE 0x702C4 TKW_VV_VV_UL 100.0 FORMULA_0027 0.0 16777214.0 /end CHARACTERISTIC
/begin CHARACTERISTIC K_OZ_PM_CC_CBS_MSG_TEST "CC-und CBS-Meldungen-Testkonstante" VALUE 0x702C8 TKW_VV_VV_UW 100.0 FORMULA_0599 0.0 65535.0 FORMAT "%5.2" /end CHARACTERISTIC
/begin CHARACTERISTIC K_OZ_TEMP_75 "Mindesttemp. Oelwanne" VALUE 0x702D0 TKW_VV_VV_SW 100.0 FORMULA_0431 -3276.800048828125 3276.699951171875 /end CHARACTERISTIC
/begin CHARACTERISTIC K_OZ_TEMP_KOR "Korrekturfaktor Volumenausdehnung" VALUE 0x702CE TKW_VV_VV_UB 100.0 FORMULA_0600 0.5 1.5 /end CHARACTERISTIC
/begin CHARACTERISTIC K_OZ_TEMPBW_KOPF "Mindesttemp. am Oelfilterkopf" VALUE 0x702CA TKW_VV_VV_SW 100.0 FORMULA_0023 -50.0 170.0 FORMAT "%4.1" /end CHARACTERISTIC
/begin CHARACTERISTIC K_OZ_TEMPBW_SUMPF "Mindesttemp. Oelwanne" VALUE 0x702CC TKW_VV_VV_SW 100.0 FORMULA_0431 -3276.800048828125 3276.699951171875 /end CHARACTERISTIC
/begin CHARACTERISTIC K_OZLBESCH_STAND_CC "Laengsbeschl.-Ausblendung Standmsg." VALUE 0x702AA TKW_VV_VV_SB 100.0 FORMULA_0448 -32.0 31.75 /end CHARACTERISTIC
/begin CHARACTERISTIC K_OZLBESCHS "Laengsbeschleunigung Ausblendung-Schwelle im Stand" VALUE 0x702A7 TKW_VV_VV_SB 100.0 FORMULA_0448 -32.0 31.75 /end CHARACTERISTIC
/begin CHARACTERISTIC K_OZORLIM2 "Schwelle für Orientierungswert Ölniveau (Verlustwarnung)" VALUE 0x702A9 TKW_VV_VV_UB 100.0 FORMULA_0436 0.0 74.70700073242188 /end CHARACTERISTIC
/begin CHARACTERISTIC K_OZQBESCH_STAND_CC "Querbeschl.-Ausblendung Standmsg." VALUE 0x702AB TKW_VV_VV_SB 100.0 FORMULA_0448 -32.0 31.75 /end CHARACTERISTIC
/begin CHARACTERISTIC K_OZQBESCHS "Querbeschleunigung Ausblendung-Schwelle im Stand" VALUE 0x702A8 TKW_VV_VV_SB 100.0 FORMULA_0448 -32.0 31.75 /end CHARACTERISTIC
/begin CHARACTERISTIC K_S_CLERRIBS "IBS Fehlerlöschen schaltbar" VALUE 0x72F28 TKW_VV_VV_UB 100.0 FORMULA_0003 0.0 255.0 /end CHARACTERISTIC
/begin CHARACTERISTIC K_SCHNELLMSG_ANZAHL_WERTE "Anzahl Oelsensor-Rohwerte" VALUE 0x702D2 TKW_VV_VV_UB 100.0 FORMULA_0487 7.0 20.0 /end CHARACTERISTIC
/begin CHARACTERISTIC K_SCHNELLMSG_KL15_AUSBLEND "Ausblendungszeit Bedingung Schnellmsg." VALUE 0x702D6 TKW_VV_VV_UW 100.0 FORMULA_0021 0.0 655.0 FORMAT "%5.2" /end CHARACTERISTIC
/begin CHARACTERISTIC K_SCHNELLMSG_KL15_MAX "CC-Mld-Schnellmessung-Aktivzeit" VALUE 0x702D4 TKW_VV_VV_UW 100.0 FORMULA_0021 0.0 655.0 FORMAT "%5.2" /end CHARACTERISTIC
/begin CHARACTERISTIC K_SCHNELLMSG_N_MAX "Maximaldrehzahl fuer Schnellmessung" VALUE 0x702DE TKW_VV_VV_SW 100.0 FORMULA_0006 0.0 10000.0 /end CHARACTERISTIC
/begin CHARACTERISTIC K_SCHNELLMSG_OZLBESCHS "Laengsbeschl. Ausblendung-Schwelle Schnellmessung" VALUE 0x702D8 TKW_VV_VV_SB 100.0 FORMULA_0448 -32.0 31.75 /end CHARACTERISTIC
/begin CHARACTERISTIC K_SCHNELLMSG_OZQBESCHS "Querbeschl. Ausblendung-Schwelle Schnellmessung" VALUE 0x702D9 TKW_VV_VV_SB 100.0 FORMULA_0448 -32.0 31.75 /end CHARACTERISTIC
/begin CHARACTERISTIC K_SCHNELLMSG_T_MS "Motor steht-Schwelle" VALUE 0x702DA TKW_VV_VV_UW 100.0 FORMULA_0440 1.0 65535.0 FORMAT "%5.2" /end CHARACTERISTIC
/begin CHARACTERISTIC K_SCHNELLMSG_TOEL_MIN "Mindestoeltemp. fuer Schnellmessung" VALUE 0x702DC TKW_VV_VV_SW 100.0 FORMULA_0023 -50.0 170.0 FORMAT "%4.1" /end CHARACTERISTIC
/begin CHARACTERISTIC K_SCHNELLMSG_V_MAX "Max.geschwindigkeit Schnellmessung" VALUE 0x702E0 TKW_VV_VV_SW 100.0 FORMULA_0076 -80.0 360.0 FORMAT "%4.1" /end CHARACTERISTIC
/begin CHARACTERISTIC K_SLEEPWAIT "" VALUE 0x72F2A TKW_VV_VV_UB 100.0 FORMULA_0487 0.0 255.0 /end CHARACTERISTIC
/begin CHARACTERISTIC K_T_CLERRIBS "" VALUE 0x72F29 TKW_VV_VV_UB 100.0 FORMULA_0003 0.0 255.0 /end CHARACTERISTIC
/begin CHARACTERISTIC K_T_UTIEFSET "" VALUE 0x72EF9 TKW_VV_VV_UB 100.0 FORMULA_0476 0.0 255.0 /end CHARACTERISTIC
/begin CHARACTERISTIC K_T1SCHWELLE "" VALUE 0x72EFB TKW_VV_VV_UB 100.0 FORMULA_0739 0.0 10.19999980926514 /end CHARACTERISTIC
/begin CHARACTERISTIC K_T1SOC0 "" VALUE 0x72EF2 TKW_VV_VV_UB 100.0 FORMULA_0735 0.0 65280.0 /end CHARACTERISTIC
/begin CHARACTERISTIC K_T2SCHWELLE "" VALUE 0x72EFC TKW_VV_VV_UB 100.0 FORMULA_0739 0.0 10.19999980926514 /end CHARACTERISTIC
/begin CHARACTERISTIC K_T2SOC0 "" VALUE 0x72EF3 TKW_VV_VV_UB 100.0 FORMULA_0735 0.0 65280.0 /end CHARACTERISTIC
/begin CHARACTERISTIC K_T3SCHWELLE "" VALUE 0x72EFD TKW_VV_VV_UB 100.0 FORMULA_0739 0.0 10.19999980926514 /end CHARACTERISTIC
/begin CHARACTERISTIC K_T3SOC0 "" VALUE 0x72EF4 TKW_VV_VV_UB 100.0 FORMULA_0735 0.0 65280.0 /end CHARACTERISTIC
/begin CHARACTERISTIC K_TIME_SET_1 "-" VALUE 0x702E2 TKW_VV_VV_SW 100.0 FORMULA_0010 -32768.0 32767.0 /end CHARACTERISTIC
/begin CHARACTERISTIC K_TIME_SET_2 "-" VALUE 0x702E4 TKW_VV_VV_SW 100.0 FORMULA_0010 -32768.0 32767.0 /end CHARACTERISTIC
/begin CHARACTERISTIC K_TIME_SET_3 "-" VALUE 0x702E6 TKW_VV_VV_SW 100.0 FORMULA_0010 -32768.0 32767.0 /end CHARACTERISTIC
/begin CHARACTERISTIC K_TMPCOM_DIV "" VALUE 0x72F0C TKW_VV_VV_UB 100.0 FORMULA_0003 0.0 255.0 /end CHARACTERISTIC
/begin CHARACTERISTIC K_TMPCOM_MUL "" VALUE 0x72F0B TKW_VV_VV_UB 100.0 FORMULA_0003 0.0 255.0 /end CHARACTERISTIC
/begin CHARACTERISTIC K_TNUSTART "" VALUE 0x72EF6 TKW_VV_VV_UB 100.0 FORMULA_0736 0.0 3.1875 /end CHARACTERISTIC
/begin CHARACTERISTIC K_TNUSTARTFL "" VALUE 0x72EF7 TKW_VV_VV_UB 100.0 FORMULA_0737 9.999999776482582e-003 0.5199999809265137 /end CHARACTERISTIC
/begin CHARACTERISTIC K_TPT1TICO "" VALUE 0x72F2C TKW_VV_VV_UW 100.0 FORMULA_0744 0.0 3276.75 FORMAT "%5.2" /end CHARACTERISTIC
/begin CHARACTERISTIC K_TSLEEPRUH "" VALUE 0x72EFA TKW_VV_VV_UB 100.0 FORMULA_0738 0.0 4080.0 /end CHARACTERISTIC
/begin CHARACTERISTIC K_UTIEFAPP "" VALUE 0x72EF8 TKW_VV_VV_UB 100.0 FORMULA_0734 6.0 22.31999969482422 /end CHARACTERISTIC
/begin CHARACTERISTIC KF_OZ_TEMP_KOR "Temperaturkorrektur Kurzzeitmessung" MAP 0x7035A TKF_SW_SW_UW 100.0 FORMULA_0456 0.0 63.99900054931641 FORMAT "%7.4"
 /begin AXIS_DESCR STD_AXIS Oz_krzmwkor FORMULA_0451 6 0.0 74.70700073242188 MAX_GRAD 0.0 FORMAT "%5.2" /end AXIS_DESCR
 /begin AXIS_DESCR STD_AXIS toel_delta FORMULA_0602 6 0.0 32767.0 MAX_GRAD 0.0 FORMAT "%5.2" /end AXIS_DESCR
/end CHARACTERISTIC
/begin CHARACTERISTIC KF_SCHNELLMSG_OZNIVR_MIN "Mindestniveau kurz nach KL15ein" MAP 0x703BC TKF_SW_SW_SW 100.0 FORMULA_0603 0.0 75.37090301513672 FORMAT "%5.2" /begin AXIS_DESCR STD_AXIS n FORMULA_0006 6 0.0 10000.0 MAX_GRAD 0.0 /end AXIS_DESCR
 /begin AXIS_DESCR STD_AXIS tmot FORMULA_0023 6 -50.0 170.0 MAX_GRAD 0.0 FORMAT "%4.1" /end AXIS_DESCR
/end CHARACTERISTIC
/begin CHARACTERISTIC KL_GEN_AUSL_BEGR "Generator Auslastungsbegrenzung" CURVE 0x702E8 TKL_SW_VV_UB 100.0 FORMULA_0601 0.0 87.5
 /begin AXIS_DESCR STD_AXIS N_gen FORMULA_0006 5 -32768.0 32767.0 MAX_GRAD 0.0 /end AXIS_DESCR
/end CHARACTERISTIC
/begin CHARACTERISTIC KL_OELLEVEL_KOMBI "Linearisierungskennlinie Kombianzeige" CURVE 0x702FA TKL_UB_VV_UB 100.0 FORMULA_0595 -10.0 15.39990043640137
 /begin AXIS_DESCR STD_AXIS Oz_langmw FORMULA_0436 20 0.0 74.70700073242188 MAX_GRAD 0.0 /end AXIS_DESCR
/end CHARACTERISTIC
/begin CHARACTERISTIC KL_OZ_LGMW_OFFSET "Linearisierungskennlinie Kombianzeige" CURVE 0x70324 TKL_UB_VV_UB 100.0 FORMULA_0436 0.0 74.41400146484375
 /begin AXIS_DESCR STD_AXIS Oz_langmw FORMULA_0436 8 0.0 74.70700073242188 MAX_GRAD 0.0 /end AXIS_DESCR
/end CHARACTERISTIC
/begin CHARACTERISTIC KL_OZ_LL_L_OFFSET "Laengs-Beschl. Korr. Niveau" CURVE 0x70336 TKL_SW_VV_SB 100.0 FORMULA_0436 -21.97260093688965 21.97260093688965
 /begin AXIS_DESCR STD_AXIS smg_ax_10s_mw FORMULA_0123 5 -20.0 20.0 MAX_GRAD 0.0 FORMAT "%5.2" /end AXIS_DESCR
/end CHARACTERISTIC
/begin CHARACTERISTIC KL_OZ_LL_Q_OFFSET "Quer-Beschl. Korr. Niveau" CURVE 0x70348 TKL_SW_VV_SB 100.0 FORMULA_0436 -21.97260093688965 21.97260093688965
 /begin AXIS_DESCR STD_AXIS can_ay_10s_mw FORMULA_0123 5 -20.0 20.0 MAX_GRAD 0.0 FORMAT "%5.2" /end AXIS_DESCR
/end CHARACTERISTIC
/begin MEASUREMENT Acfzgl "Fahrzeuglaengsbeschleunigung " SBYTE FORMULA_0589 0 0.0 -32.0 31.75 READ_WRITE ECU_ADDRESS 0x3FBC46 /end MEASUREMENT
/begin MEASUREMENT Acfzgq "Fahrzeugquerbeschleunigung" SBYTE FORMULA_0589 0 0.0 -32.0 31.75 READ_WRITE ECU_ADDRESS 0x3FBC47 /end MEASUREMENT
/begin MEASUREMENT ag_ti_anz "Zaehler der unmittelbar aufeinanderfolgenden Ausblendungen." UWORD FORMULA_0010 0 0.0 0.0 65535.0 READ_WRITE ECU_ADDRESS 0x3FBC12 /end MEASUREMENT
/begin MEASUREMENT ag_ti_anz_ctrl "Anzahl der unmittelbar aufeinanderfolgenden Ausblendungen." UWORD FORMULA_0010 0 0.0 0.0 65535.0 READ_WRITE ECU_ADDRESS 0x3FBC0E /end MEASUREMENT
/begin MEASUREMENT ag_ti_cfg_ctrl "Welcher Aussetzergenerator" UBYTE FORMULA_0576 0 0.0 0.0 3.0 READ_WRITE ECU_ADDRESS 0x3FBC0A /end MEASUREMENT
/begin MEASUREMENT ag_ti_exd_state "Exd-State." UBYTE FORMULA_0575 0 0.0 0.0 255.0 READ_WRITE ECU_ADDRESS 0x3FBC09 /end MEASUREMENT
/begin MEASUREMENT ag_ti_mask "Status Aussetzergenerator." UWORD FORMULA_0577 0 0.0 0.0 4095.0 READ_WRITE ECU_ADDRESS 0x3FBC16 /end MEASUREMENT
/begin MEASUREMENT ag_ti_mask_zyl1 "Ausblendung Zylinder 1." UWORD FORMULA_0578 0 0 0.0 255.0 READ_WRITE BIT_MASK 0x1 ECU_ADDRESS 0x3FBC16 /end MEASUREMENT
/begin MEASUREMENT ag_ti_mask_zyl10 "Ausblendung Zylinder 10." UWORD FORMULA_0587 0 0 0.0 255.0 READ_WRITE BIT_MASK 0x200 ECU_ADDRESS 0x3FBC16 /end MEASUREMENT
/begin MEASUREMENT ag_ti_mask_zyl2 "Ausblendung Zylinder 2." UWORD FORMULA_0579 0 0 0.0 255.0 READ_WRITE BIT_MASK 0x2 ECU_ADDRESS 0x3FBC16 /end MEASUREMENT
/begin MEASUREMENT ag_ti_mask_zyl3 "Ausblendung Zylinder 3." UWORD FORMULA_0580 0 0 0.0 255.0 READ_WRITE BIT_MASK 0x4 ECU_ADDRESS 0x3FBC16 /end MEASUREMENT
/begin MEASUREMENT ag_ti_mask_zyl4 "Ausblendung Zylinder 4." UWORD FORMULA_0581 0 0 0.0 255.0 READ_WRITE BIT_MASK 0x8 ECU_ADDRESS 0x3FBC16 /end MEASUREMENT
/begin MEASUREMENT ag_ti_mask_zyl5 "Ausblendung Zylinder 5." UWORD FORMULA_0582 0 0 0.0 255.0 READ_WRITE BIT_MASK 0x10 ECU_ADDRESS 0x3FBC16 /end MEASUREMENT
/begin MEASUREMENT ag_ti_mask_zyl6 "Ausblendung Zylinder 6." UWORD FORMULA_0583 0 0 0.0 255.0 READ_WRITE BIT_MASK 0x20 ECU_ADDRESS 0x3FBC16 /end MEASUREMENT
/begin MEASUREMENT ag_ti_mask_zyl7 "Ausblendung Zylinder 7." UWORD FORMULA_0584 0 0 0.0 255.0 READ_WRITE BIT_MASK 0x40 ECU_ADDRESS 0x3FBC16 /end MEASUREMENT
/begin MEASUREMENT ag_ti_mask_zyl8 "Ausblendung Zylinder 8." UWORD FORMULA_0585 0 0 0.0 255.0 READ_WRITE BIT_MASK 0x80 ECU_ADDRESS 0x3FBC16 /end MEASUREMENT
/begin MEASUREMENT ag_ti_mask_zyl9 "Ausblendung Zylinder 9." UWORD FORMULA_0586 0 0 0.0 255.0 READ_WRITE BIT_MASK 0x100 ECU_ADDRESS 0x3FBC16 /end MEASUREMENT
/begin MEASUREMENT ag_ti_pause "Zaehler der Arbeitsspiele zwischen Ausblendungen." UWORD FORMULA_0010 0 0.0 0.0 65535.0 READ_WRITE ECU_ADDRESS 0x3FBC14 /end MEASUREMENT
/begin MEASUREMENT ag_ti_pause_ctrl "Anzahl der Arbeitsspiele zwischen Ausblendungen." UWORD FORMULA_0010 0 0.0 0.0 65535.0 READ_WRITE ECU_ADDRESS 0x3FBC10 /end MEASUREMENT
/begin MEASUREMENT ag_ti_zyl "Naechster Zylinder der ausgeblendet wird." UBYTE FORMULA_0408 0 0.0 1.0 12.0 READ_WRITE ECU_ADDRESS 0x3FBC08 /end MEASUREMENT
/begin MEASUREMENT ag_ti_zyl_ctrl "Statisches Ausblendmuster." UWORD FORMULA_0010 0 0.0 0.0 65535.0 READ_WRITE ECU_ADDRESS 0x3FBC0C /end MEASUREMENT
/begin MEASUREMENT B_ckl30 "Bedingung Klemme R (vom CAN)" UBYTE FORMULA_0590 0 0.0 0.0 255.0 READ_WRITE ECU_ADDRESS 0x3FBCAC /end MEASUREMENT
/begin MEASUREMENT B_ckl50 "Bedingung Klemme 50 (vom CAN)" UBYTE FORMULA_0590 0 0.0 0.0 255.0 READ_WRITE ECU_ADDRESS 0x3FBCAB /end MEASUREMENT
/begin MEASUREMENT B_DMTL_ABBRUCH_BETANK "Abbruch wegen starken Stromanstieg" UBYTE FORMULA_0547 0 0 0.0 255.0 READ_WRITE BIT_MASK 0x2 ECU_ADDRESS 0x3FA7E1 /end MEASUREMENT
/begin MEASUREMENT B_DMTL_ABBRUCH_FEUCHT "Abbruch wg. Stromschwankung" UBYTE FORMULA_0552 0 0 0.0 255.0 READ_WRITE BIT_MASK 0x40 ECU_ADDRESS 0x3FA7E1 /end MEASUREMENT
/begin MEASUREMENT B_DMTL_DECKEL_DICHT "Deckel dicht bestaetigt durch Grobleckdia" UBYTE FORMULA_0200 0 0 0.0 255.0 READ_WRITE BIT_MASK 0x1 ECU_ADDRESS 0x3FA7E2 /end MEASUREMENT
/begin MEASUREMENT B_DMTL_DECKEL_GEPRUEFT "Deckel nach Betankung geprueft" UBYTE FORMULA_0200 0 0 0.0 255.0 READ_WRITE BIT_MASK 0x1 ECU_ADDRESS 0x3FA7E1 /end MEASUREMENT
/begin MEASUREMENT B_DMTL_FST_GESTIEGEN "Nachtanken wurde erkannt" UBYTE FORMULA_0548 0 0 0.0 255.0 READ_WRITE BIT_MASK 0x4 ECU_ADDRESS 0x3FA7E1 /end MEASUREMENT
/begin MEASUREMENT B_DMTL_GROB_VERMUT "Grobleck wegen Betankung?" UBYTE FORMULA_0549 0 0 0.0 255.0 READ_WRITE BIT_MASK 0x8 ECU_ADDRESS 0x3FA7E1 /end MEASUREMENT
/begin MEASUREMENT B_DMTL_GROBLECK_1 "1x Grobleck Vermutung bestaetigt" UBYTE FORMULA_0550 0 0 0.0 255.0 READ_WRITE BIT_MASK 0x10 ECU_ADDRESS 0x3FA7E1 /end MEASUREMENT
/begin MEASUREMENT B_DMTL_GROBLECK_2 "2x Grobleck Vermutung bestaetigt" UBYTE FORMULA_0551 0 0 0.0 255.0 READ_WRITE BIT_MASK 0x20 ECU_ADDRESS 0x3FA7E1 /end MEASUREMENT
/begin MEASUREMENT B_DMTL_STANDZEIT "Standzeit fuer Diagnose erfuellt" UBYTE FORMULA_0207 0 0 0.0 255.0 READ_WRITE BIT_MASK 0x80 ECU_ADDRESS 0x3FA7E1 /end MEASUREMENT
/begin MEASUREMENT B_etumg "Umgebungstemperaturfehler?" UBYTE FORMULA_0003 0 0.0 0.0 255.0 READ_WRITE ECU_ADDRESS 0x3FBC51 /end MEASUREMENT
/begin MEASUREMENT B_fabttreg "Bed. Batterietausch registrieren" UBYTE FORMULA_0003 0 0.0 0.0 255.0 READ_WRITE ECU_ADDRESS 0x3F9909 /end MEASUREMENT
/begin MEASUREMENT B_fahisrst "Bed. Histogramm Reset" UBYTE FORMULA_0003 0 0.0 0.0 255.0 READ_WRITE ECU_ADDRESS 0x3F9908 /end MEASUREMENT
/begin MEASUREMENT B_fapmmess "Bed. Messmethode PM" UBYTE FORMULA_0003 0 0.0 0.0 255.0 READ_WRITE ECU_ADDRESS 0x3F990A /end MEASUREMENT
/begin MEASUREMENT B_fs "Bed. Fahrstufe" UBYTE FORMULA_0003 0 0.0 0.0 255.0 READ_WRITE ECU_ADDRESS 0x3FBC52 /end MEASUREMENT
/begin MEASUREMENT B_gen_bsd_error_CC "Generatorkommunikationsfehler aktiv" UBYTE FORMULA_0590 0 0.0 0.0 255.0 READ_WRITE ECU_ADDRESS 0x3FBC54 /end MEASUREMENT
/begin MEASUREMENT B_genslp "Spannungsanf. Sekundaerluftpumpe" UBYTE FORMULA_0003 0 0.0 0.0 255.0 READ_WRITE ECU_ADDRESS 0x3FBC53 /end MEASUREMENT
/begin MEASUREMENT B_kl15 "Bed. Kl15" UBYTE FORMULA_0590 0 0.0 0.0 255.0 READ_WRITE ECU_ADDRESS 0x3FBC55 /end MEASUREMENT
/begin MEASUREMENT B_kl15_ep "Bed. Kl15 gesetzt" UBYTE FORMULA_0590 0 0.0 0.0 255.0 READ_WRITE ECU_ADDRESS 0x3FBC56 /end MEASUREMENT
/begin MEASUREMENT B_kwdreht "Bed. Kurbelw. syncr." UBYTE FORMULA_0003 0 0.0 0.0 255.0 READ_WRITE ECU_ADDRESS 0x3FBC57 /end MEASUREMENT
/begin MEASUREMENT B_ll "Bed. Leerlauf" UBYTE FORMULA_0003 0 0.0 0.0 255.0 READ_WRITE ECU_ADDRESS 0x3FBC58 /end MEASUREMENT
/begin MEASUREMENT B_ll_niv_krz "" UBYTE FORMULA_0003 0 0.0 0.0 1.0 READ_WRITE ECU_ADDRESS 0x3FBCAF /end MEASUREMENT
/begin MEASUREMENT B_ll_niv_krz_alt "" UBYTE FORMULA_0003 0 0.0 0.0 1.0 READ_WRITE ECU_ADDRESS 0x3FBCB0 /end MEASUREMENT
/begin MEASUREMENT B_llrein "Leerlauf mind. einmal gesetzt" UBYTE FORMULA_0003 0 0.0 0.0 255.0 READ_WRITE ECU_ADDRESS 0x3FBC59 /end MEASUREMENT
/begin MEASUREMENT B_oz_oelcheck_CC "CC-Mldg. Oelstand zu niedrig" UBYTE FORMULA_0003 0 0.0 0.0 1.0 READ_WRITE ECU_ADDRESS 0x3FBCB2 /end MEASUREMENT
/begin MEASUREMENT B_oz_oelverbr_CC "CC: Oelverbrauchswarnung - Motoroelstand bei Minimum" UBYTE FORMULA_0003 0 0.0 0.0 1.0 READ_WRITE ECU_ADDRESS 0x3FBCB3 /end MEASUREMENT
/begin MEASUREMENT B_oz_oelverlust_CC "CC: Oelverlust - Motoroelstand unter Minimum" UBYTE FORMULA_0003 0 0.0 0.0 1.0 READ_WRITE ECU_ADDRESS 0x3FBCB4 /end MEASUREMENT
/begin MEASUREMENT B_ozlangmw_kl15_st "" UBYTE FORMULA_0003 0 0.0 0.0 1.0 READ_WRITE ECU_ADDRESS 0x3FBCB1 /end MEASUREMENT
/begin MEASUREMENT B_pmsv_st "EEPROM sichern nach WakeUp" UBYTE FORMULA_0003 0 0.0 0.0 1.0 READ_WRITE ECU_ADDRESS 0x3FBCAE /end MEASUREMENT
/begin MEASUREMENT B_pwf "Bed. Powerfail" UBYTE FORMULA_0003 0 0.0 0.0 255.0 READ_WRITE ECU_ADDRESS 0x3FBC5A /end MEASUREMENT
/begin MEASUREMENT B_schnellmsg_bed "Schnellmessung-Diagnosebedingungen OK" UBYTE FORMULA_0003 0 0.0 0.0 1.0 READ_WRITE ECU_ADDRESS 0x3FBCB5 /end MEASUREMENT
/begin MEASUREMENT B_schnellmsg_fertig "Niveauwerte-Schnellmessung gesammelt" UBYTE FORMULA_0003 0 0.0 0.0 1.0 READ_WRITE ECU_ADDRESS 0x3FBCB6 /end MEASUREMENT
/begin MEASUREMENT B_schnellmsg_oel_ok "Schnellmessung: mind. ein Messwert ueber OK-Schwelle" UBYTE FORMULA_0003 0 0.0 0.0 1.0 READ_WRITE ECU_ADDRESS 0x3FBCB7 /end MEASUREMENT
/begin MEASUREMENT B_sta "Bed. Automatikstart" UBYTE FORMULA_0003 0 0.0 0.0 255.0 READ_WRITE ECU_ADDRESS 0x3FBC5C /end MEASUREMENT
/begin MEASUREMENT B_start "Vor bzw. im Start" UBYTE FORMULA_0003 0 0.0 0.0 255.0 READ_WRITE ECU_ADDRESS 0x3FBC5D /end MEASUREMENT
/begin MEASUREMENT B_startende "Ende Startvorg." UBYTE FORMULA_0003 0 0.0 0.0 255.0 READ_WRITE ECU_ADDRESS 0x3FBC5E /end MEASUREMENT
/begin MEASUREMENT B_taerr "Tans-Fehler da ?" UBYTE FORMULA_0003 0 0.0 0.0 255.0 READ_WRITE ECU_ADDRESS 0x3FBC5F /end MEASUREMENT
/begin MEASUREMENT B_taners "Tans-Ersatzwert ?" UBYTE FORMULA_0003 0 0.0 0.0 255.0 READ_WRITE ECU_ADDRESS 0x3FBC60 /end MEASUREMENT
/begin MEASUREMENT B_tumers "Ersatzwert TUMG ?" UBYTE FORMULA_0003 0 0.0 0.0 255.0 READ_WRITE ECU_ADDRESS 0x3FBC61 /end MEASUREMENT
/begin MEASUREMENT B_VAN_ANSCHL_OK_A1 "Anschlag bei max Spreizung gueltig" UBYTE FORMULA_0201 0 0 0.0 255.0 READ_WRITE BIT_MASK 0x2 ECU_ADDRESS 0x3FA7D2 /end MEASUREMENT
/begin MEASUREMENT B_VAN_ANSCHL_OK_A2 "Anschlag bei max Spreizung gueltig" UBYTE FORMULA_0203 0 0 0.0 255.0 READ_WRITE BIT_MASK 0x8 ECU_ADDRESS 0x3FA7D2 /end MEASUREMENT
/begin MEASUREMENT B_VAN_ANSCHL_OK_E1 "Anschlag bei max Spreizung gueltig" UBYTE FORMULA_0200 0 0 0.0 255.0 READ_WRITE BIT_MASK 0x1 ECU_ADDRESS 0x3FA7D2 /end MEASUREMENT
/begin MEASUREMENT B_VAN_ANSCHL_OK_E2 "Anschlag bei max Spreizung gueltig" UBYTE FORMULA_0202 0 0 0.0 255.0 READ_WRITE BIT_MASK 0x4 ECU_ADDRESS 0x3FA7D2 /end MEASUREMENT
/begin MEASUREMENT B_vl "Bed. Vollast" UBYTE FORMULA_0003 0 0.0 0.0 255.0 READ_WRITE ECU_ADDRESS 0x3FBC62 /end MEASUREMENT
/begin MEASUREMENT Batt_class "Klassifizierung der in diesem Fzg. eingebauten Batterie" UBYTE FORMULA_0003 0 0.0 0.0 255.0 READ_WRITE ECU_ADDRESS 0x3F990B /end MEASUREMENT
/begin MEASUREMENT batt_tausch_exd_timeout "Batterietausch-Erkennungszeit" UBYTE FORMULA_0461 0 0.0 0.0 25.5 READ_WRITE ECU_ADDRESS 0x3FBD07 /end MEASUREMENT
/begin MEASUREMENT bgTaskCtr "Counter" UWORD FORMULA_0010 0 0.0 0.0 65535.0 READ_WRITE ECU_ADDRESS 0x3FBDF4 /end MEASUREMENT
/begin MEASUREMENT Bordnetz "0x01 => CAN11H / 0x02 => CAN12H" UBYTE FORMULA_0003 0 0.0 0.0 255.0 READ_WRITE ECU_ADDRESS 0x3FBC63 /end MEASUREMENT
/begin MEASUREMENT Bosbtvfbkt "Verfuegbarkeit ueber Tester" UBYTE FORMULA_0003 0 0.0 0.0 255.0 READ_WRITE ECU_ADDRESS 0x3FBC3B /end MEASUREMENT
/begin MEASUREMENT Bosfxid2r "ID_Funktion_BOS_Rueckstellung_2" UWORD FORMULA_0010 0 0.0 0.0 65535.0 READ_WRITE ECU_ADDRESS 0x3FBC38 /end MEASUREMENT
/begin MEASUREMENT Bosid2r "ID_2_BOS_Rueckstellung_2" UBYTE FORMULA_0003 0 0.0 0.0 255.0 READ_WRITE ECU_ADDRESS 0x3FBC3A /end MEASUREMENT
/begin MEASUREMENT Bosjzielr "Zieltermin_Monat_BOS_Rueckstellung_2" UBYTE FORMULA_0003 0 0.0 0.0 255.0 READ_WRITE ECU_ADDRESS 0x3FBC40 /end MEASUREMENT
/begin MEASUREMENT Bosjzielt "Zieltermin_Jahr vom Tester " UBYTE FORMULA_0003 0 0.0 0.0 255.0 READ_WRITE ECU_ADDRESS 0x3FBC41 /end MEASUREMENT
/begin MEASUREMENT Bosmzielr "Zieltermin_Jahr_BOS_Rueckstellung_2" UBYTE FORMULA_0003 0 0.0 0.0 255.0 READ_WRITE ECU_ADDRESS 0x3FBC42 /end MEASUREMENT
/begin MEASUREMENT Bosmzielt "Zieltermin_Monat vom Tester" UBYTE FORMULA_0003 0 0.0 0.0 255.0 READ_WRITE ECU_ADDRESS 0x3FBC43 /end MEASUREMENT
/begin MEASUREMENT Bosrlsmr "Restlaufstrecke Motoroel vom Kombi" SWORD FORMULA_0010 0 0.0 -32768.0 32767.0 READ_WRITE ECU_ADDRESS 0x3FBC3C /end MEASUREMENT
/begin MEASUREMENT Bosrw2r "Prognose_Intervall_Weg_BOS_Rueckstellung_2" UBYTE FORMULA_0003 0 0.0 0.0 255.0 READ_WRITE ECU_ADDRESS 0x3FBC3E /end MEASUREMENT
/begin MEASUREMENT Bosrw2t "Prognose_Intervall_Weg vomTester" UBYTE FORMULA_0003 0 0.0 0.0 255.0 READ_WRITE ECU_ADDRESS 0x3FBC45 /end MEASUREMENT
/begin MEASUREMENT Bosv "Verfuegbarkeit vom Kombi" UBYTE FORMULA_0003 0 0.0 0.0 255.0 READ_WRITE ECU_ADDRESS 0x3FBC35 /end MEASUREMENT
/begin MEASUREMENT Bsd_cur_dev "aktuelles Device BSD zugeordnet" UBYTE FORMULA_0003 0 0.0 0.0 255.0 READ_WRITE ECU_ADDRESS 0x3FBCE2 /end MEASUREMENT
/begin MEASUREMENT bsd_error "BSD Bus Fehler." UBYTE FORMULA_0604 0 0.0 0.0 255.0 READ_WRITE ECU_ADDRESS 0x3FBCD8 /end MEASUREMENT
/begin MEASUREMENT Bsd_error_cnt_nv "BSD Error Counter." UWORD FORMULA_0010 0 0.0 0.0 65535.0 READ_WRITE ARRAY_SIZE 9 ECU_ADDRESS 0x3FA724 MATRIX_DIM 9 1 1 /end MEASUREMENT
/begin MEASUREMENT Bsd_slot_idx "aktueller Slot der BSD fuer Device:" UBYTE FORMULA_0003 0 0.0 0.0 255.0 READ_WRITE ECU_ADDRESS 0x3FBCE1 /end MEASUREMENT
/begin MEASUREMENT Bsd_status "Bearbeitungsstatus BSD pro Device:" UBYTE FORMULA_0605 0 0.0 0.0 255.0 READ_WRITE ARRAY_SIZE 8 ECU_ADDRESS 0x3FBCD9 MATRIX_DIM 8 1 1 /end MEASUREMENT
/begin MEASUREMENT c_cbs_oel_nv "Codierdaten OELWARTUNGSINTERVALL" UBYTE FORMULA_0034 0 0.0 0.0 255.0 READ_WRITE ECU_ADDRESS 0x3F89B2 /end MEASUREMENT
/begin MEASUREMENT c_ksa_nv "Codierdaten KRAFTSTOFFAUSLEGUNG" UBYTE FORMULA_0035 0 0.0 0.0 255.0 READ_WRITE ECU_ADDRESS 0x3F89B3 /end MEASUREMENT
/begin MEASUREMENT c_mil_nv "Codierdaten MILANSTEUERUNG" UBYTE FORMULA_0033 0 0.0 0.0 255.0 READ_WRITE ECU_ADDRESS 0x3F89B1 /end MEASUREMENT
/begin MEASUREMENT c_mj_nv "Codierdaten MODELLJAHR" UBYTE FORMULA_0036 0 0.0 0.0 255.0 READ_WRITE ECU_ADDRESS 0x3F89B4 /end MEASUREMENT
/begin MEASUREMENT can_ay_10s_mw "Querbeschleunigung 10s-Mittelw." SWORD FORMULA_0123 0 0.0 -20.0 20.0 READ_WRITE ECU_ADDRESS 0x3FBC66 /end MEASUREMENT
/begin MEASUREMENT can_ay_10s_mw_sum "Querbeschleunigung Summe" SWORD FORMULA_0123 0 0.0 -20.0 20.0 READ_WRITE ECU_ADDRESS 0x3FBC68 /end MEASUREMENT
/begin MEASUREMENT can_fllv_eoi "akt. Oel-Fuellstand" UBYTE FORMULA_0037 0 0.0 0.0 2.0 READ_WRITE ECU_ADDRESS 0x3FBCB8 /end MEASUREMENT
/begin MEASUREMENT can_fzgtyp_clas_pwr_nv "Variante v_max-Anhebung" UBYTE FORMULA_0030 0 0.0 0.0 255.0 READ_WRITE ECU_ADDRESS 0x3F89AE /end MEASUREMENT
/begin MEASUREMENT can_fzgtyp_grb_nv "Getriebevariante" UBYTE FORMULA_0031 0 0.0 0.0 255.0 READ_WRITE ECU_ADDRESS 0x3F89AF /end MEASUREMENT
/begin MEASUREMENT can_fzgtyp_land_nv "Laendervariante" UBYTE FORMULA_0028 0 0.0 0.0 255.0 READ_WRITE ECU_ADDRESS 0x3F89AC /end MEASUREMENT
/begin MEASUREMENT can_fzgtyp_veh_nv "Fahrzeugvariante" UBYTE FORMULA_0029 0 0.0 0.0 255.0 READ_WRITE ECU_ADDRESS 0x3F89AD /end MEASUREMENT
/begin MEASUREMENT can_km_stand_nv "Kilometerstand" ULONG FORMULA_0027 0 0.0 0.0 16777214.0 READ_WRITE ECU_ADDRESS 0x3F89A8 /end MEASUREMENT
/begin MEASUREMENT can_recm_rflv_eoi "Auskunft Nachfuellen" UBYTE FORMULA_0037 0 0.0 0.0 2.0 READ_WRITE ECU_ADDRESS 0x3FBCB9 /end MEASUREMENT
/begin MEASUREMENT can_st_empf_nv "Empfangsstatus NV" UBYTE FORMULA_0003 0 0.0 0.0 255.0 READ_WRITE ECU_ADDRESS 0x3F95AA /end MEASUREMENT
/begin MEASUREMENT can_st_fllv_eoi "M-spezif. Erweit. Oel-Fuellstand" UBYTE FORMULA_0037 0 0.0 0.0 2.0 READ_WRITE ECU_ADDRESS 0x3FBCBA /end MEASUREMENT
/begin MEASUREMENT can_standverb "Standverbraucher" ULONG FORMULA_0000 0 0.0 0.0 4294967295.0 READ_WRITE ECU_ADDRESS 0x3FA738 /end MEASUREMENT
/begin MEASUREMENT can_standverb_anh "StdVerb Anhaenger" ULONG FORMULA_0518 0 0 0.0 255.0 READ_WRITE BIT_MASK 0x1 ECU_ADDRESS 0x3FA738 /end MEASUREMENT
/begin MEASUREMENT can_standverb_apu "StdVerb APU" ULONG FORMULA_0529 0 0 0.0 255.0 READ_WRITE BIT_MASK 0x800 ECU_ADDRESS 0x3FA738 /end MEASUREMENT
/begin MEASUREMENT can_standverb_dwa "StdVerb DWA" ULONG FORMULA_0520 0 0 0.0 255.0 READ_WRITE BIT_MASK 0x4 ECU_ADDRESS 0x3FA738 /end MEASUREMENT
/begin MEASUREMENT can_standverb_fsh "StdVerb Frontscheibenheizung" ULONG FORMULA_0530 0 0 0.0 255.0 READ_WRITE BIT_MASK 0x1000 ECU_ADDRESS 0x3FA738 /end MEASUREMENT
/begin MEASUREMENT can_standverb_getr "StdVerb Getriebe" ULONG FORMULA_0524 0 0 0.0 255.0 READ_WRITE BIT_MASK 0x40 ECU_ADDRESS 0x3FA738 /end MEASUREMENT
/begin MEASUREMENT can_standverb_licht "StdVerb Licht" ULONG FORMULA_0521 0 0 0.0 255.0 READ_WRITE BIT_MASK 0x8 ECU_ADDRESS 0x3FA738 /end MEASUREMENT
/begin MEASUREMENT can_standverb_nmi "StdVerb NMI" ULONG FORMULA_0519 0 0 0.0 255.0 READ_WRITE BIT_MASK 0x2 ECU_ADDRESS 0x3FA738 /end MEASUREMENT
/begin MEASUREMENT can_standverb_rw "StdVerb Restwärme" ULONG FORMULA_0525 0 0 0.0 255.0 READ_WRITE BIT_MASK 0x80 ECU_ADDRESS 0x3FA738 /end MEASUREMENT
/begin MEASUREMENT can_standverb_sh "StdVerb Standheizung" ULONG FORMULA_0522 0 0 0.0 255.0 READ_WRITE BIT_MASK 0x10 ECU_ADDRESS 0x3FA738 /end MEASUREMENT
/begin MEASUREMENT can_standverb_skl "StdVerb Standklima" ULONG FORMULA_0528 0 0 0.0 255.0 READ_WRITE BIT_MASK 0x400 ECU_ADDRESS 0x3FA738 /end MEASUREMENT
/begin MEASUREMENT can_standverb_sl "StdVerb Standlüfter" ULONG FORMULA_0523 0 0 0.0 255.0 READ_WRITE BIT_MASK 0x20 ECU_ADDRESS 0x3FA738 /end MEASUREMENT
/begin MEASUREMENT can_standverb_tece "StdVerb Telefon ECE" ULONG FORMULA_0526 0 0 0.0 255.0 READ_WRITE BIT_MASK 0x100 ECU_ADDRESS 0x3FA738 /end MEASUREMENT
/begin MEASUREMENT can_standverb_tus "StdVerb Telefon US" ULONG FORMULA_0527 0 0 0.0 255.0 READ_WRITE BIT_MASK 0x200 ECU_ADDRESS 0x3FA738 /end MEASUREMENT
/begin MEASUREMENT cana_ctBoffDbounce "BusOff-Counter" UBYTE FORMULA_0003 0 0.0 0.0 255.0 READ_WRITE ECU_ADDRESS 0x3FBDF6 /end MEASUREMENT
/begin MEASUREMENT canb_ctBoffDbounce "BusOff-Counter" UBYTE FORMULA_0003 0 0.0 0.0 255.0 READ_WRITE ECU_ADDRESS 0x3FBDF7 /end MEASUREMENT
/begin MEASUREMENT carbtlgr_aif_nummer "Stelle des letzten AIF" SBYTE FORMULA_0627 0 0.0 -128.0 127.0 READ_WRITE ECU_ADDRESS 0x3FBDA1 /end MEASUREMENT
/begin MEASUREMENT ccp_retry_cnt_nv "Download Retryzaehler" UWORD FORMULA_0010 0 0.0 0.0 65535.0 READ_WRITE ECU_ADDRESS 0x3F9882 /end MEASUREMENT
/begin MEASUREMENT Chk16_ibs "Checksumme Parameter aus IBS" UWORD FORMULA_0010 0 0.0 0.0 65535.0 READ_WRITE ECU_ADDRESS 0x3FAED2 /end MEASUREMENT
/begin MEASUREMENT Chkpara "Checksumme Parameter intern" UWORD FORMULA_0010 0 0.0 0.0 65535.0 READ_WRITE ECU_ADDRESS 0x3FAED4 /end MEASUREMENT
/begin MEASUREMENT cnt_mw_ax_ay "Counter fuer Mw.-Berechng." UBYTE FORMULA_0003 0 0.0 0.0 255.0 READ_WRITE ECU_ADDRESS 0x3FBC6E /end MEASUREMENT
/begin MEASUREMENT coding_array_attribute "Attribute des aktuellen Codierbereiches" UBYTE FORMULA_0628 0 0.0 0.0 255.0 READ_WRITE ECU_ADDRESS 0x3FBDA8 /end MEASUREMENT
/begin MEASUREMENT coding_init_laufzeit "Laufzeitmessung coding_init" ULONG FORMULA_0072 0 0.0 0.0 4294967295.0 READ_WRITE ECU_ADDRESS 0x3FBDAC /end MEASUREMENT
/begin MEASUREMENT coding_logistics "Startadresse des gültigen Codierbereiches" ULONG FORMULA_0000 0 0.0 0.0 4294967295.0 READ_WRITE ECU_ADDRESS 0x3FBDA4 /end MEASUREMENT
/begin MEASUREMENT coding_umw0 "Umweltbedingung 0 Codierung" UWORD FORMULA_0010 0 0.0 0.0 65535.0 READ_WRITE ECU_ADDRESS 0x3FBDB0 /end MEASUREMENT
/begin MEASUREMENT coding_umw1 "Umweltbedingung 1 Codierung" UWORD FORMULA_0010 0 0.0 0.0 65535.0 READ_WRITE ECU_ADDRESS 0x3FBDB2 /end MEASUREMENT
/begin MEASUREMENT coding_umw2 "Umweltbedingung 2 Codierung" UWORD FORMULA_0010 0 0.0 0.0 65535.0 READ_WRITE ECU_ADDRESS 0x3FBDB4 /end MEASUREMENT
/begin MEASUREMENT coding_umw3 "Umweltbedingung 3 Codierung" UWORD FORMULA_0010 0 0.0 0.0 65535.0 READ_WRITE ECU_ADDRESS 0x3FBDB6 /end MEASUREMENT
/begin MEASUREMENT Comcontrol "Kontrolle Diagnose Modul DIBS" UBYTE FORMULA_0003 0 0.0 0.0 255.0 READ_WRITE ECU_ADDRESS 0x3FC0B5 /end MEASUREMENT
/begin MEASUREMENT crc32_boot "Booter-CRC" ULONG FORMULA_0000 0 0.0 0.0 4294967295.0 READ_WRITE ECU_ADDRESS 0x3FBDD8 /end MEASUREMENT
/begin MEASUREMENT crc32_boot_st "Status CRC-Berechnung" UBYTE FORMULA_0043 0 0.0 0.0 255.0 READ_WRITE ECU_ADDRESS 0x3FBDD7 /end MEASUREMENT
/begin MEASUREMENT crc32_data "Daten-CRC" ULONG FORMULA_0000 0 0.0 0.0 4294967295.0 READ_WRITE ECU_ADDRESS 0x3FBDE0 /end MEASUREMENT
/begin MEASUREMENT crc32_data_carb_nv "Daten-CRC fuer Mode 9" ULONG FORMULA_0000 0 0.0 0.0 4294967295.0 READ_WRITE ECU_ADDRESS 0x3F9834 /end MEASUREMENT
/begin MEASUREMENT crc32_data_st "Status CRC-Berechnung" UBYTE FORMULA_0043 0 0.0 0.0 255.0 READ_WRITE ECU_ADDRESS 0x3FBDD5 /end MEASUREMENT
/begin MEASUREMENT crc32_prog "Programm-CRC" ULONG FORMULA_0000 0 0.0 0.0 4294967295.0 READ_WRITE ECU_ADDRESS 0x3FBDDC /end MEASUREMENT
/begin MEASUREMENT crc32_prog_carb_nv "Programm-CRC fuer Mode 9" ULONG FORMULA_0000 0 0.0 0.0 4294967295.0 READ_WRITE ECU_ADDRESS 0x3F9830 /end MEASUREMENT
/begin MEASUREMENT crc32_prog_st "Status CRC-Berechnung" UBYTE FORMULA_0043 0 0.0 0.0 255.0 READ_WRITE ECU_ADDRESS 0x3FBDD6 /end MEASUREMENT
/begin MEASUREMENT crc32_result "Ergebnis der CRC-Berechnungen" UBYTE FORMULA_0042 0 0.0 0.0 255.0 READ_WRITE ECU_ADDRESS 0x3FBDD4 /end MEASUREMENT
/begin MEASUREMENT debug_rw_result "Result Read/-Write Operation" ULONG FORMULA_0000 0 0.0 0.0 4294967295.0 READ_WRITE ECU_ADDRESS 0x3FBDF8 /end MEASUREMENT
/begin MEASUREMENT Dfbegr "Begrenzung Gen.-Auslastung" UBYTE FORMULA_0601 0 0.0 0.0 87.5 READ_WRITE ECU_ADDRESS 0x3FAEB9 /end MEASUREMENT
/begin MEASUREMENT Dfgrob "Gen.-Auslastung (grob aus Dffgen)" UBYTE FORMULA_0592 0 0.0 0.0 87.5 READ_WRITE ECU_ADDRESS 0x3FBCAA /end MEASUREMENT
/begin MEASUREMENT Dfsiggen "Auslastungsgrad Generator" UBYTE FORMULA_0475 0 0.0 0.0 99.60929870605469 READ_WRITE ECU_ADDRESS 0x3FAEB1 /end MEASUREMENT
/begin MEASUREMENT dmtl_abbr_fein "Anzahl abgebrochene Feindiags" UBYTE FORMULA_0545 0 0.0 0.0 255.0 READ_WRITE ECU_ADDRESS 0x3FA7D5 /end MEASUREMENT
/begin MEASUREMENT dmtl_abbr_feucht_mil "Anzahl Feuchteabbrueche fuer MIL" UBYTE FORMULA_0545 0 0.0 0.0 255.0 READ_WRITE ECU_ADDRESS 0x3FA7D8 /end MEASUREMENT
/begin MEASUREMENT dmtl_abbr_ub "Anzahl Abbrueche wegen Spannung" UWORD FORMULA_0546 0 0.0 0.0 65535.0 READ_WRITE ECU_ADDRESS 0x3FA7D6 /end MEASUREMENT
/begin MEASUREMENT dmtl_anz_deckel_leck "Anzahl erkannter Deckellecks" UBYTE FORMULA_0545 0 0.0 0.0 255.0 READ_WRITE ECU_ADDRESS 0x3FA7D9 /end MEASUREMENT
/begin MEASUREMENT dmtl_anz_dia_deckel "Anzahl durchgelaufene Deckeldiagnosen" UWORD FORMULA_0546 0 0.0 0.0 65535.0 READ_WRITE ECU_ADDRESS 0x3FA7DA /end MEASUREMENT
/begin MEASUREMENT dmtl_anz_dia_fein "Anzahl durchgelaufene Feinleckdiagnosen" UWORD FORMULA_0546 0 0.0 0.0 65535.0 READ_WRITE ECU_ADDRESS 0x3FA7DE /end MEASUREMENT
/begin MEASUREMENT dmtl_anz_dia_grob "Anzahl durchgelaufene Grobleckdiagnosen" UWORD FORMULA_0546 0 0.0 0.0 65535.0 READ_WRITE ECU_ADDRESS 0x3FA7DC /end MEASUREMENT
/begin MEASUREMENT dmtl_anz_fahrten "Anzahl der langen Fahrten" UBYTE FORMULA_0003 0 0.0 0.0 255.0 READ_WRITE ECU_ADDRESS 0x3FA7E0 /end MEASUREMENT
/begin MEASUREMENT dmtl_crb_cid "" UBYTE FORMULA_0003 0 0.0 0.0 255.0 READ_WRITE ECU_ADDRESS 0x3FA7F2 /end MEASUREMENT
/begin MEASUREMENT dmtl_crb_grenze "Strom Diagnosemodul Tankleck" UWORD FORMULA_0553 0 0.0 0.0 147.4537048339844 READ_WRITE ECU_ADDRESS 0x3FA7F6 /end MEASUREMENT
/begin MEASUREMENT dmtl_crb_mess "Strom Diagnosemodul Tankleck" UWORD FORMULA_0553 0 0.0 0.0 147.4537048339844 READ_WRITE ECU_ADDRESS 0x3FA7F4 /end MEASUREMENT
/begin MEASUREMENT dmtl_flags_nv "Flags der DMTL" UBYTE FORMULA_0003 0 0.0 0.0 255.0 READ_WRITE ECU_ADDRESS 0x3FA7E1 /end MEASUREMENT
/begin MEASUREMENT dmtl_flags_nv2 "Flags der DMTL" UBYTE FORMULA_0003 0 0.0 0.0 255.0 READ_WRITE ECU_ADDRESS 0x3FA7E2 /end MEASUREMENT
/begin MEASUREMENT dmtl_grob_ohne_fein "Anzahl Grobleckdiags. ohne Feindiag" UBYTE FORMULA_0545 0 0.0 0.0 255.0 READ_WRITE ECU_ADDRESS 0x3FA7E3 /end MEASUREMENT
/begin MEASUREMENT dmtl_i_filt "DMTL Strom korrigiert und gefiltert" UWORD FORMULA_0553 0 0.0 0.0 147.4537048339844 READ_WRITE ECU_ADDRESS 0x3FA7E4 /end MEASUREMENT
/begin MEASUREMENT dmtl_i_filt.rest "DMTL Strom korr. Filter-Rest" UWORD FORMULA_0554 0 0.0 0.0 8.999799728393555 READ_WRITE ECU_ADDRESS 0x3FA7E6 /end MEASUREMENT
/begin MEASUREMENT dmtl_i_min "DMTL Strom minimal" UWORD FORMULA_0553 0 0.0 0.0 147.4537048339844 READ_WRITE ECU_ADDRESS 0x3FA7E8 /end MEASUREMENT
/begin MEASUREMENT dmtl_i_ref "DMTL Strom Referenzleck" UWORD FORMULA_0553 0 0.0 0.0 147.4537048339844 READ_WRITE ECU_ADDRESS 0x3FA7EA /end MEASUREMENT
/begin MEASUREMENT dmtl_st_nv "Betriebszustand nichtfluechtig gespeichert" UBYTE FORMULA_0555 0 0.0 0.0 255.0 READ_WRITE ECU_ADDRESS 0x3FA7EC /end MEASUREMENT
/begin MEASUREMENT dmtl_t_abstell "DMTL Abstellzeit" UWORD FORMULA_0556 0 0.0 0.0 65535.0 READ_WRITE ECU_ADDRESS 0x3FA7EE /end MEASUREMENT
/begin MEASUREMENT dmtl_t_mess "DMTL aktuelle Meßdauer" UWORD FORMULA_0071 0 0.0 0.0 6553.5 READ_WRITE ECU_ADDRESS 0x3FA7F0 /end MEASUREMENT
/begin MEASUREMENT Ebsd_adr "EBSD Adresse im IBS" UBYTE FORMULA_0003 0 0.0 0.0 255.0 READ_WRITE ECU_ADDRESS 0x3FAEC7 /end MEASUREMENT
/begin MEASUREMENT Ebsd_errdir "EBSD Übertragungsrichtung bei Fehler" UBYTE FORMULA_0003 0 0.0 0.0 255.0 READ_WRITE ECU_ADDRESS 0x3FAEC8 /end MEASUREMENT
/begin MEASUREMENT Ebsd_errep "EBSD Fehler repeat timer" UBYTE FORMULA_0003 0 0.0 0.0 255.0 READ_WRITE ECU_ADDRESS 0x3FAECA /end MEASUREMENT
/begin MEASUREMENT Ebsd_errin "EBSD Index bei Fehler" UBYTE FORMULA_0003 0 0.0 0.0 255.0 READ_WRITE ECU_ADDRESS 0x3FAEC9 /end MEASUREMENT
/begin MEASUREMENT Ebsd_nbyt "Länge EBSD Variable" UBYTE FORMULA_0003 0 0.0 0.0 255.0 READ_WRITE ECU_ADDRESS 0x3FAEC5 /end MEASUREMENT
/begin MEASUREMENT Ebsd_timo "EBSD Fehler timeout counter" UBYTE FORMULA_0003 0 0.0 0.0 255.0 READ_WRITE ECU_ADDRESS 0x3FAECB /end MEASUREMENT
/begin MEASUREMENT Ebsd_varin "Index EBSD Variable" UBYTE FORMULA_0003 0 0.0 0.0 255.0 READ_WRITE ECU_ADDRESS 0x3FAEC4 /end MEASUREMENT
/begin MEASUREMENT ed_css_st_ign_nv "CSS-Status der Funktionen" UBYTE FORMULA_0037 0 0.0 0.0 255.0 READ_WRITE ECU_ADDRESS 0x3F868A /end MEASUREMENT
/begin MEASUREMENT ed_css_st_ign_nv_auss "Aussetzer" UBYTE FORMULA_0038 0 0 0.0 255.0 READ_WRITE BIT_MASK 0x1 ECU_ADDRESS 0x3F868A /end MEASUREMENT
/begin MEASUREMENT ed_css_st_ign_nv_lls "Leerlaufsteller" UBYTE FORMULA_0041 0 0 0.0 255.0 READ_WRITE BIT_MASK 0x8 ECU_ADDRESS 0x3F868A /end MEASUREMENT
/begin MEASUREMENT ed_css_st_ign_nv_pwg "Pedalwertgeber" UBYTE FORMULA_0039 0 0 0.0 255.0 READ_WRITE BIT_MASK 0x2 ECU_ADDRESS 0x3F868A /end MEASUREMENT
/begin MEASUREMENT ed_css_st_ign_nv_tmot "Motortemperatur" UBYTE FORMULA_0040 0 0 0.0 255.0 READ_WRITE BIT_MASK 0x4 ECU_ADDRESS 0x3F868A /end MEASUREMENT
/begin MEASUREMENT ed_css_st_inj_nv "CSS-Status der Funktionen" UBYTE FORMULA_0037 0 0.0 0.0 255.0 READ_WRITE ECU_ADDRESS 0x3FA84A /end MEASUREMENT
/begin MEASUREMENT ed_css_st_inj_nv_fplau "Fuellungsplausi" UBYTE FORMULA_0565 0 0 0.0 255.0 READ_WRITE BIT_MASK 0x10 ECU_ADDRESS 0x3FA84A /end MEASUREMENT
/begin MEASUREMENT ed_css_st_inj_nv_hfm "Luftmassenmesser" UBYTE FORMULA_0041 0 0 0.0 255.0 READ_WRITE BIT_MASK 0x8 ECU_ADDRESS 0x3FA84A /end MEASUREMENT
/begin MEASUREMENT ed_css_st_inj_nv_kds "Kraftstoffsystem" UBYTE FORMULA_0040 0 0 0.0 255.0 READ_WRITE BIT_MASK 0x4 ECU_ADDRESS 0x3FA84A /end MEASUREMENT
/begin MEASUREMENT ed_css_st_inj_nv_kw "Kurbelwelle" UBYTE FORMULA_0566 0 0 0.0 255.0 READ_WRITE BIT_MASK 0x20 ECU_ADDRESS 0x3FA84A /end MEASUREMENT
/begin MEASUREMENT ed_css_st_inj_nv_pt_can "Powertrain CAN" UBYTE FORMULA_0568 0 0 0.0 255.0 READ_WRITE BIT_MASK 0x80 ECU_ADDRESS 0x3FA84A /end MEASUREMENT
/begin MEASUREMENT ed_css_st_inj_nv_sls "Sekundaerluft" UBYTE FORMULA_0038 0 0 0.0 255.0 READ_WRITE BIT_MASK 0x1 ECU_ADDRESS 0x3FA84A /end MEASUREMENT
/begin MEASUREMENT ed_css_st_inj_nv_ti "Einspritzung" UBYTE FORMULA_0039 0 0 0.0 255.0 READ_WRITE BIT_MASK 0x2 ECU_ADDRESS 0x3FA84A /end MEASUREMENT
/begin MEASUREMENT ed_css_st_inj_nv_van "Vanos" UBYTE FORMULA_0567 0 0 0.0 255.0 READ_WRITE BIT_MASK 0x40 ECU_ADDRESS 0x3FA84A /end MEASUREMENT
/begin MEASUREMENT ed_fsp_del_km_stand_nv "Kilometerstand FSP-Loeschen" ULONG FORMULA_0027 0 0.0 0.0 16777214.0 READ_WRITE ECU_ADDRESS 0x3FA84C /end MEASUREMENT
/begin MEASUREMENT ed_fsp_inj_fehlerzaehler_nv "Zaehler zum Fehlersortieren" UWORD FORMULA_0010 0 0.0 0.0 65535.0 READ_WRITE ECU_ADDRESS 0x3F89A6 /end MEASUREMENT
/begin MEASUREMENT ed_rbm_css_denominator_nv "CSS Denominator" UWORD FORMULA_0010 0 0.0 0.0 65535.0 READ_WRITE ECU_ADDRESS 0x3FA846 /end MEASUREMENT
/begin MEASUREMENT ed_rbm_css_numerator_nv "CSS Numerator" UWORD FORMULA_0010 0 0.0 0.0 65535.0 READ_WRITE ECU_ADDRESS 0x3FA848 /end MEASUREMENT
/begin MEASUREMENT ed_rbm_general_dcy_nv "General Denominator" UWORD FORMULA_0010 0 0.0 0.0 65535.0 READ_WRITE ECU_ADDRESS 0x3FA844 /end MEASUREMENT
/begin MEASUREMENT ed_rbm_ignition_count_nv "Motorstartzaehler" UWORD FORMULA_0010 0 0.0 0.0 65535.0 READ_WRITE ECU_ADDRESS 0x3FA842 /end MEASUREMENT
/begin MEASUREMENT ed_wuc_counter_nv "Anzahl Warmupcycle seit FSP-Loeschen" UBYTE FORMULA_0003 0 0.0 0.0 255.0 READ_WRITE ECU_ADDRESS 0x3FA84B /end MEASUREMENT
/begin MEASUREMENT eeprom_anzahl_schreiben_nv "Anzahl der Schreibvorgaenge ins Flash" ULONG FORMULA_0571 0 0.0 0.0 4294967295.0 READ_WRITE ECU_ADDRESS 0x3F9538 /end MEASUREMENT
/begin MEASUREMENT eeprom_crc_nv "Standstabile Adaptionsdaten" ULONG FORMULA_0000 0 0.0 0.0 4294967295.0 READ_WRITE ECU_ADDRESS 0x3F9540 /end MEASUREMENT
/begin MEASUREMENT eeprom_crc_wichtig_nv "Lebensdauer Adaptionsdaten" ULONG FORMULA_0000 0 0.0 0.0 4294967295.0 READ_WRITE ECU_ADDRESS 0x3F9534 /end MEASUREMENT
/begin MEASUREMENT eeprom_date "Erstelldatum beim Abspeichern" UBYTE FORMULA_0419 0 0.0 0.0 255.0 READ_WRITE ARRAY_SIZE 9 ECU_ADDRESS 0x3F9546 MATRIX_DIM 9 1 1 /end MEASUREMENT
/begin MEASUREMENT eeprom_datenlaenge_nv "Anzahl der Datenbytes" UWORD FORMULA_0572 0 0.0 0.0 262140.0 READ_WRITE ECU_ADDRESS 0x3F9544 /end MEASUREMENT
/begin MEASUREMENT eeprom_datenlaenge_wichtig_nv "Anzahl der Datenbytes" UWORD FORMULA_0572 0 0.0 0.0 262140.0 READ_WRITE ECU_ADDRESS 0x3F953C /end MEASUREMENT
/begin MEASUREMENT eeprom_time "Erstellzeit beim Abspeichern" UBYTE FORMULA_0419 0 0.0 0.0 255.0 READ_WRITE ARRAY_SIZE 6 ECU_ADDRESS 0x3F954F MATRIX_DIM 6 1 1 /end MEASUREMENT
/begin MEASUREMENT eeprom_version_prog_nv "Programmversion beim Abspeichern" UWORD FORMULA_0573 0 0.0 0.0 65535.0 READ_WRITE ECU_ADDRESS 0x3F953E /end MEASUREMENT
/begin MEASUREMENT elu_nl_nv "PWM-Signal der letzten ELU-Nachlaufanforderung" UBYTE FORMULA_0032 0 0.0 0.0 255.0 READ_WRITE ECU_ADDRESS 0x3F89B0 /end MEASUREMENT
/begin MEASUREMENT elu_typ_nv "verbauter E-Luefter-Typ" UBYTE FORMULA_0562 0 0.0 0.0 255.0 READ_WRITE ECU_ADDRESS 0x3FA830 /end MEASUREMENT
/begin MEASUREMENT Fahrzeug " = 60 ? " UBYTE FORMULA_0003 0 0.0 0.0 255.0 READ_WRITE ECU_ADDRESS 0x3FBC4E /end MEASUREMENT
/begin MEASUREMENT Fsclctr "Hilfszaehler IBS Fehler loeschen" UBYTE FORMULA_0003 0 0.0 0.0 255.0 READ_WRITE ECU_ADDRESS 0x3FAECD /end MEASUREMENT
/begin MEASUREMENT fst_max_nv "Fuellstand zu Beginn der Diagnose" UBYTE FORMULA_0559 0 0.0 0.0 127.5 READ_WRITE ECU_ADDRESS 0x3FA806 /end MEASUREMENT
/begin MEASUREMENT fst_min_nv "Min. Fuellstand, fuer Nachtankerkennung" UBYTE FORMULA_0559 0 0.0 0.0 127.5 READ_WRITE ECU_ADDRESS 0x3FA807 /end MEASUREMENT
/begin MEASUREMENT fst_rechts "gefilterter Geberwert rechts" UBYTE FORMULA_0559 0 0.0 0.0 127.5 READ_WRITE ECU_ADDRESS 0x3FA808 /end MEASUREMENT
/begin MEASUREMENT fst_rechts.rest "Filter Rest Geberwert rechts" UBYTE FORMULA_0560 0 0.0 0.0 0.4979999959468842 READ_WRITE ECU_ADDRESS 0x3FA809 /end MEASUREMENT
/begin MEASUREMENT fst_verbr_nv "Verbrauchter Kraftstoff" UWORD FORMULA_0561 0 0.0 0.0 67.10780334472656 READ_WRITE ECU_ADDRESS 0x3FA80A /end MEASUREMENT
/begin MEASUREMENT gen_bsd_error_cnt "Generatorfehler-Zeitzaehler" UWORD FORMULA_0593 0 0.0 0.0 65535.0 READ_WRITE ECU_ADDRESS 0x3FBCBC /end MEASUREMENT
/begin MEASUREMENT gen_exd_timeout "KWP-Ansteuerzeit" UBYTE FORMULA_0461 0 0.0 0.0 25.5 READ_WRITE ECU_ADDRESS 0x3FBD06 /end MEASUREMENT
/begin MEASUREMENT Gen_manufak "Herstellerkennung Generator" UBYTE FORMULA_0003 0 0.0 0.0 255.0 READ_WRITE ECU_ADDRESS 0x3FAEB2 /end MEASUREMENT
/begin MEASUREMENT gen_n_elu "Drehzahlanforderung E-Luefter Generator" UBYTE FORMULA_0003 0 0.0 0.0 100.0 READ_WRITE ECU_ADDRESS 0x3FBCBB /end MEASUREMENT
/begin MEASUREMENT Gen_temp_chip "Generatortemp. (Chip)" UBYTE FORMULA_0003 0 0.0 0.0 255.0 READ_WRITE ECU_ADDRESS 0x3FAEB8 /end MEASUREMENT
/begin MEASUREMENT Gen_typkenn "Typkennung Generator" UBYTE FORMULA_0003 0 0.0 0.0 255.0 READ_WRITE ECU_ADDRESS 0x3FAEB3 /end MEASUREMENT
/begin MEASUREMENT hdw_1_nv "HDW" ULONG FORMULA_0000 0 0.0 0.0 4294967295.0 READ_WRITE ECU_ADDRESS 0x3F9558 /end MEASUREMENT
/begin MEASUREMENT hdw_2_nv "HDW" ULONG FORMULA_0000 0 0.0 0.0 4294967295.0 READ_WRITE ECU_ADDRESS 0x3F955C /end MEASUREMENT
/begin MEASUREMENT hdw_3_nv "HDW" ULONG FORMULA_0000 0 0.0 0.0 4294967295.0 READ_WRITE ECU_ADDRESS 0x3F9560 /end MEASUREMENT
/begin MEASUREMENT hdw_z1_nv "HDW" UBYTE FORMULA_0003 0 0.0 0.0 255.0 READ_WRITE ECU_ADDRESS 0x3FA73C /end MEASUREMENT
/begin MEASUREMENT history_reset_exd_timeout "Ruhestrommessung-Erkennungszeit" UBYTE FORMULA_0461 0 0.0 0.0 25.5 READ_WRITE ECU_ADDRESS 0x3FBD08 /end MEASUREMENT
/begin MEASUREMENT hwTaskCtr "Counter" UWORD FORMULA_0010 0 0.0 0.0 65535.0 READ_WRITE ECU_ADDRESS 0x3FBDE4 /end MEASUREMENT
/begin MEASUREMENT I_batt "Batteriestrom von IBS gemessen" UWORD FORMULA_0508 0 0.0 -200.0 5042.7998046875 READ_WRITE ECU_ADDRESS 0x3FC0C8 /end MEASUREMENT
/begin MEASUREMENT I_soc0 "Strom bei Ruhespannungsmessung" SWORD FORMULA_0511 0 0.0 -655.3599853515625 655.3400268554688 READ_WRITE ECU_ADDRESS 0x3FC0D8 /end MEASUREMENT
/begin MEASUREMENT I_tnstart "Batteriestrom im Start" UWORD FORMULA_0515 0 0.0 0.0 1310.699951171875 READ_WRITE ECU_ADDRESS 0x3FC0EC /end MEASUREMENT
/begin MEASUREMENT I_vorstart "Batteriestrom vor Start" UWORD FORMULA_0732 0 0.0 -200.0 1110.699951171875 READ_WRITE ECU_ADDRESS 0x3FC0EA /end MEASUREMENT
/begin MEASUREMENT Ib_chk16 "Checksumme EBSD Übertragung aus IBS" UWORD FORMULA_0010 0 0.0 0.0 65535.0 READ_WRITE ECU_ADDRESS 0x3FAED0 /end MEASUREMENT
/begin MEASUREMENT Ib_parlen "Länge IBS Parameterliste" UBYTE FORMULA_0003 0 0.0 0.0 255.0 READ_WRITE ECU_ADDRESS 0x3FC0BC /end MEASUREMENT
/begin MEASUREMENT Ibhwversi "IBS Hardware Version" UBYTE FORMULA_0003 0 0.0 0.0 255.0 READ_WRITE ECU_ADDRESS 0x3FC0BB /end MEASUREMENT
/begin MEASUREMENT Ibs_errors "Fehler Reg. aus IBS gelesen" UBYTE FORMULA_0003 0 0.0 0.0 255.0 READ_WRITE ECU_ADDRESS 0x3FC0B0 /end MEASUREMENT
/begin MEASUREMENT Ibs_msgind "Index auf EBSD Botschaft" UBYTE FORMULA_0003 0 0.0 0.0 255.0 READ_WRITE ECU_ADDRESS 0x3FC0B1 /end MEASUREMENT
/begin MEASUREMENT Ibs_msgsta "EBSD Fehler Status" UBYTE FORMULA_0003 0 0.0 0.0 255.0 READ_WRITE ECU_ADDRESS 0x3FC0B2 /end MEASUREMENT
/begin MEASUREMENT Ibs_reg5 "IBS Register 5 Var.not used: now St_ibsreg5" UBYTE FORMULA_0003 0 0.0 0.0 255.0 READ_WRITE ECU_ADDRESS 0x3FC0AF /end MEASUREMENT
/begin MEASUREMENT Ibs_start "Status Statemachine Startup Kommunikation" UBYTE FORMULA_0003 0 0.0 0.0 255.0 READ_WRITE ECU_ADDRESS 0x3FC0B4 /end MEASUREMENT
/begin MEASUREMENT Ibsbclctri "IBS Fehlerzähler" UBYTE FORMULA_0003 0 0.0 0.0 255.0 READ_WRITE ECU_ADDRESS 0x3FC0BE /end MEASUREMENT
/begin MEASUREMENT Ibsborctr "IBS Fehlerzähler" UWORD FORMULA_0010 0 0.0 0.0 65535.0 READ_WRITE ECU_ADDRESS 0x3FC0CC /end MEASUREMENT
/begin MEASUREMENT Ibsdncsctr "IBS Fehlerzähler download checksum" UBYTE FORMULA_0003 0 0.0 0.0 255.0 READ_WRITE ECU_ADDRESS 0x3FC0C2 /end MEASUREMENT
/begin MEASUREMENT Ibseromctr "IBS Fehlerzähler" UBYTE FORMULA_0003 0 0.0 0.0 255.0 READ_WRITE ECU_ADDRESS 0x3FC0BF /end MEASUREMENT
/begin MEASUREMENT Ibsiicctri "IBS Fehlerzähler" UBYTE FORMULA_0003 0 0.0 0.0 255.0 READ_WRITE ECU_ADDRESS 0x3FC0BD /end MEASUREMENT
/begin MEASUREMENT Ibslvdctr "IBS Fehlerzähler" UWORD FORMULA_0010 0 0.0 0.0 65535.0 READ_WRITE ECU_ADDRESS 0x3FC0C6 /end MEASUREMENT
/begin MEASUREMENT Ibsporctr "IBS Fehlerzähler power on" UWORD FORMULA_0010 0 0.0 0.0 65535.0 READ_WRITE ECU_ADDRESS 0x3FC0D0 /end MEASUREMENT
/begin MEASUREMENT Ibspromctr "IBS Fehlerzähler" UBYTE FORMULA_0003 0 0.0 0.0 255.0 READ_WRITE ECU_ADDRESS 0x3FC0C1 /end MEASUREMENT
/begin MEASUREMENT Ibsptyctr "IBS Fehlerzähler BSD parity" UWORD FORMULA_0010 0 0.0 0.0 65535.0 READ_WRITE ECU_ADDRESS 0x3FC0D2 /end MEASUREMENT
/begin MEASUREMENT Ibsramctr "IBS Fehlerzähler" UBYTE FORMULA_0003 0 0.0 0.0 255.0 READ_WRITE ECU_ADDRESS 0x3FC0C0 /end MEASUREMENT
/begin MEASUREMENT Ibswbase "IBS Software Baseline" UBYTE FORMULA_0003 0 0.0 0.0 255.0 READ_WRITE ECU_ADDRESS 0x3FC0B9 /end MEASUREMENT
/begin MEASUREMENT Ibswchang "IBS Software Änderungs Status" UBYTE FORMULA_0003 0 0.0 0.0 255.0 READ_WRITE ECU_ADDRESS 0x3FC0BA /end MEASUREMENT
/begin MEASUREMENT Ibswdtctr "IBS Fehlerzähler watchdog" UWORD FORMULA_0010 0 0.0 0.0 65535.0 READ_WRITE ECU_ADDRESS 0x3FC0CE /end MEASUREMENT
/begin MEASUREMENT Id_bosrst "ID fuer BOSReset vom Kombi" UBYTE FORMULA_0003 0 0.0 0.0 255.0 READ_WRITE ECU_ADDRESS 0x3FBC34 /end MEASUREMENT
/begin MEASUREMENT Id_bosrtt "ID BOS-Reset vom Tester" UBYTE FORMULA_0003 0 0.0 0.0 255.0 READ_WRITE ECU_ADDRESS 0x3FBC37 /end MEASUREMENT
/begin MEASUREMENT Id_bosrtw "ID fuer Motoroel vom Kombi" UWORD FORMULA_0010 0 0.0 0.0 65535.0 READ_WRITE ECU_ADDRESS 0x3FBC32 /end MEASUREMENT
/begin MEASUREMENT Ierr "Erregerstrom momentan" UBYTE FORMULA_0464 0 0.0 0.0 7.875 READ_WRITE ECU_ADDRESS 0x3FAEBA /end MEASUREMENT
/begin MEASUREMENT Ierrfgrenz "Erregerstrom Begrenzung (Kopie von Ierrfgrenz)" UBYTE FORMULA_0464 0 0.0 0.0 3.875 READ_WRITE ECU_ADDRESS 0x3FAEBB /end MEASUREMENT
/begin MEASUREMENT Ikurz_ogr "Obere Grenze Kurzschluss strom vom CAS" UBYTE FORMULA_0003 0 0.0 0.0 255.0 READ_WRITE ECU_ADDRESS 0x3F990C /end MEASUREMENT
/begin MEASUREMENT Ikurz_ugr " Untere Grenze Kurzschlussstrom vom CAS" UBYTE FORMULA_0003 0 0.0 0.0 255.0 READ_WRITE ECU_ADDRESS 0x3F990D /end MEASUREMENT
/begin MEASUREMENT ipk_sync_error_st_nv "IPK Sync Error im Hochlauf" UBYTE FORMULA_0005 0 0.0 0.0 255.0 READ_WRITE ECU_ADDRESS 0x3F9842 /end MEASUREMENT
/begin MEASUREMENT ipk_sync_errorcount_nv "Fehlerzaehler fuer Sync-Timeout" UBYTE FORMULA_0003 0 0.0 0.0 255.0 READ_WRITE ECU_ADDRESS 0x3F9841 /end MEASUREMENT
/begin MEASUREMENT Iwakeupgr "Fahrzeugspezifischer Ruhestrom" UBYTE FORMULA_0003 0 0.0 0.0 255.0 READ_WRITE ECU_ADDRESS 0x3F990E /end MEASUREMENT
/begin MEASUREMENT kat_obd_wert_gesamt_nv "Gesamtsystemdiagnosewert" UWORD FORMULA_0025 0 0.0 0.0 3.999000072479248 READ_WRITE ECU_ADDRESS 0x3F89A2 /end MEASUREMENT
/begin MEASUREMENT kat_obd_wert_max_nv_b1 "max. KAT-Diag. Wert ueber alle Diagnosen" UWORD FORMULA_0025 0 0.0 0.0 3.999000072479248 READ_WRITE ECU_ADDRESS 0x3FA850 /end MEASUREMENT
/begin MEASUREMENT kat_obd_wert_max_nv_b2 "max. KAT-Diag. Wert ueber alle Diagnosen" UWORD FORMULA_0025 0 0.0 0.0 3.999000072479248 READ_WRITE ECU_ADDRESS 0x3FA852 /end MEASUREMENT
/begin MEASUREMENT kat_obd_wert_nv_b1 "gem., gewichtete Abweichung z. MW" UWORD FORMULA_0025 0 0.0 0.0 3.999000072479248 READ_WRITE ECU_ADDRESS 0x3F899E /end MEASUREMENT
/begin MEASUREMENT kat_obd_wert_nv_b2 "gem., gewichtete Abweichung z. MW" UWORD FORMULA_0025 0 0.0 0.0 3.999000072479248 READ_WRITE ECU_ADDRESS 0x3F89A0 /end MEASUREMENT
/begin MEASUREMENT kats_mdl_t_nv "Zeit im Katschutz wegen Modelltempereratur(Sensor)" UWORD FORMULA_0071 0 0.0 0.0 6553.5 READ_WRITE ARRAY_SIZE 2 ECU_ADDRESS 0x3FA866 MATRIX_DIM 2 1 1 /end MEASUREMENT
/begin MEASUREMENT kats_nkat_t_nv "Zeit im Katschutz wegen Nkat-Tempereratur(Sensor)" UWORD FORMULA_0071 0 0.0 0.0 6553.5 READ_WRITE ARRAY_SIZE 2 ECU_ADDRESS 0x3FA862 MATRIX_DIM 2 1 1 /end MEASUREMENT
/begin MEASUREMENT kats_vkat_t_nv "Zeit im Katschutz wegen Vkat-Tempereratur(Sensor)" UWORD FORMULA_0071 0 0.0 0.0 6553.5 READ_WRITE ARRAY_SIZE 2 ECU_ADDRESS 0x3FA86A MATRIX_DIM 2 1 1 /end MEASUREMENT
/begin MEASUREMENT kge_ml_intg_min_nv "Minwert Luftmassenstrom-Integral" UWORD FORMULA_0564 0 0.0 0.0 6553.5 READ_WRITE ARRAY_SIZE 2 ECU_ADDRESS 0x3FA83A MATRIX_DIM 2 1 1 /end MEASUREMENT
/begin MEASUREMENT kge_ml_mw_intg_min_nv "Minwert MW Luftmassenstrom-Integral" UWORD FORMULA_0564 0 0.0 0.0 6553.5 READ_WRITE ARRAY_SIZE 2 ECU_ADDRESS 0x3FA83E MATRIX_DIM 2 1 1 /end MEASUREMENT
/begin MEASUREMENT Km_st "Kilometerstand" UWORD FORMULA_0591 0 0.0 0.0 655350.0 READ_WRITE ECU_ADDRESS 0x3FBC70 /end MEASUREMENT
/begin MEASUREMENT ksd_obd_ll_max_nv_b1 "Triggerzaehler - max. Ueberschreitung im LL" UBYTE FORMULA_0003 0 0.0 0.0 255.0 READ_WRITE ECU_ADDRESS 0x3FA799 /end MEASUREMENT
/begin MEASUREMENT ksd_obd_ll_max_nv_b2 "Triggerzaehler - max. Ueberschreitung im LL" UBYTE FORMULA_0003 0 0.0 0.0 255.0 READ_WRITE ECU_ADDRESS 0x3FA79A /end MEASUREMENT
/begin MEASUREMENT ksd_obd_ll_min_nv_b1 "Triggerzaehler - min. Ueberschreitung im LL" UBYTE FORMULA_0003 0 0.0 0.0 255.0 READ_WRITE ECU_ADDRESS 0x3FA79B /end MEASUREMENT
/begin MEASUREMENT ksd_obd_ll_min_nv_b2 "Triggerzaehler - min. Ueberschreitung im LL" UBYTE FORMULA_0003 0 0.0 0.0 255.0 READ_WRITE ECU_ADDRESS 0x3FA79C /end MEASUREMENT
/begin MEASUREMENT ksd_obd_oel_sperr_nv "Zaehler - Erkennung auf Oelverduennung" UBYTE FORMULA_0003 0 0.0 0.0 255.0 READ_WRITE ECU_ADDRESS 0x3FA798 /end MEASUREMENT
/begin MEASUREMENT ksd_obd_tl_max_nv_b1 "Triggerzaehler - max. Ueberschreitung im TL" UBYTE FORMULA_0003 0 0.0 0.0 255.0 READ_WRITE ECU_ADDRESS 0x3FA79D /end MEASUREMENT
/begin MEASUREMENT ksd_obd_tl_max_nv_b2 "Triggerzaehler - max. Ueberschreitung im TL" UBYTE FORMULA_0003 0 0.0 0.0 255.0 READ_WRITE ECU_ADDRESS 0x3FA79E /end MEASUREMENT
/begin MEASUREMENT ksd_obd_tl_min_nv_b1 "Triggerzaehler - min. Ueberschreitung im TL" UBYTE FORMULA_0003 0 0.0 0.0 255.0 READ_WRITE ECU_ADDRESS 0x3FA79F /end MEASUREMENT
/begin MEASUREMENT ksd_obd_tl_min_nv_b2 "Triggerzaehler - min. Ueberschreitung im TL" UBYTE FORMULA_0003 0 0.0 0.0 255.0 READ_WRITE ECU_ADDRESS 0x3FA7A0 /end MEASUREMENT
/begin MEASUREMENT Kt_ibsstatus "Status BSD Statemachine" UBYTE FORMULA_0003 0 0.0 0.0 255.0 READ_WRITE ECU_ADDRESS 0x3FC0B3 /end MEASUREMENT
/begin MEASUREMENT Ktib_chk16 "Checksumme EBSD Übertragung intern" UWORD FORMULA_0010 0 0.0 0.0 65535.0 READ_WRITE ECU_ADDRESS 0x3FAECE /end MEASUREMENT
/begin MEASUREMENT Ktupcsctr "kt_ibs Fehlerzähler EBSD Checksumme" UWORD FORMULA_0010 0 0.0 0.0 65535.0 READ_WRITE ECU_ADDRESS 0x3FC0FC /end MEASUREMENT
/begin MEASUREMENT Kvaverbr "Kraftstoffverbrauch (Einspritzmenge in Microliter)" UWORD FORMULA_0588 0 0.0 0.0 65535.0 READ_WRITE ECU_ADDRESS 0x3FBC2E /end MEASUREMENT
/begin MEASUREMENT kwp_fetrawe_st "" UBYTE FORMULA_0026 0 0.0 0.0 255.0 READ_WRITE ECU_ADDRESS 0x3F89A4 /end MEASUREMENT
/begin MEASUREMENT kwp_ps_teststamp "" UBYTE FORMULA_0003 0 0.0 0.0 255.0 READ_WRITE ARRAY_SIZE 3 ECU_ADDRESS 0x3FA80C MATRIX_DIM 3 1 1 /end MEASUREMENT
/begin MEASUREMENT L_pwmout "Tastverhaeltnis E-Luefter" UWORD FORMULA_0010 0 0.0 0.0 65535.0 READ_WRITE ECU_ADDRESS 0x3FBC72 /end MEASUREMENT
/begin MEASUREMENT la_trim_i_ad_nv_b1 "wirkender I-Anteil - adaptiert" SWORD FORMULA_0025 0 0.0 -2.0 1.998999953269959 READ_WRITE ECU_ADDRESS 0x3FA78C /end MEASUREMENT
/begin MEASUREMENT la_trim_i_ad_nv_b2 "wirkender I-Anteil - adaptiert" SWORD FORMULA_0025 0 0.0 -2.0 1.998999953269959 READ_WRITE ECU_ADDRESS 0x3FA78E /end MEASUREMENT
/begin MEASUREMENT laa_f_ber_nv_b1 "Faktor-Lambdaadaption ohne TE" UWORD FORMULA_0024 0 0.0 0.0 1.998999953269959 READ_WRITE ECU_ADDRESS 0x3F899A /end MEASUREMENT
/begin MEASUREMENT laa_f_ber_nv_b2 "Faktor-Lambdaadaption ohne TE" UWORD FORMULA_0024 0 0.0 0.0 1.998999953269959 READ_WRITE ECU_ADDRESS 0x3F899C /end MEASUREMENT
/begin MEASUREMENT laa_offs_nv_b1 "Offset-Lambdaadaption" SWORD FORMULA_0535 0 0.0 -512.0 511.0 READ_WRITE ECU_ADDRESS 0x3FA75E /end MEASUREMENT
/begin MEASUREMENT laa_offs_nv_b2 "Offset-Lambdaadaption" SWORD FORMULA_0535 0 0.0 -512.0 511.0 READ_WRITE ECU_ADDRESS 0x3FA760 /end MEASUREMENT
/begin MEASUREMENT lank_obd_s_us_max_nv_b1 "max. NKAT-Sondensignal bei NKAT-VL-Diag." UWORD FORMULA_0536 0 0.0 0.0 1200.0 READ_WRITE ECU_ADDRESS 0x3FA790 /end MEASUREMENT
/begin MEASUREMENT lank_obd_s_us_max_nv_b2 "max. NKAT-Sondensignal bei NKAT-VL-Diag." UWORD FORMULA_0536 0 0.0 0.0 1200.0 READ_WRITE ECU_ADDRESS 0x3FA792 /end MEASUREMENT
/begin MEASUREMENT lank_obd_s_us_min_nv_b1 "min. NKAT-Sondensignal bei NKAT-SA-Diag." UWORD FORMULA_0536 0 0.0 0.0 1200.0 READ_WRITE ECU_ADDRESS 0x3FA794 /end MEASUREMENT
/begin MEASUREMENT lank_obd_s_us_min_nv_b2 "min. NKAT-Sondensignal bei NKAT-SA-Diag." UWORD FORMULA_0536 0 0.0 0.0 1200.0 READ_WRITE ECU_ADDRESS 0x3FA796 /end MEASUREMENT
/begin MEASUREMENT lavk_ad_gain_b1 "Faktor-Sondenadaption" UWORD FORMULA_0073 0 0.0 0.0 4.0 READ_WRITE ECU_ADDRESS 0x3FA762 /end MEASUREMENT
/begin MEASUREMENT lavk_ad_gain_b2 "Faktor-Sondenadaption" UWORD FORMULA_0073 0 0.0 0.0 4.0 READ_WRITE ECU_ADDRESS 0x3FA764 /end MEASUREMENT
/begin MEASUREMENT lavk_ad_offs_b1 "Offset-Sondenadaption" SWORD FORMULA_0536 0 0.0 -5000.0 5000.0 READ_WRITE ECU_ADDRESS 0x3FA766 /end MEASUREMENT
/begin MEASUREMENT lavk_ad_offs_b2 "Offset-Sondenadaption" SWORD FORMULA_0536 0 0.0 -5000.0 5000.0 READ_WRITE ECU_ADDRESS 0x3FA768 /end MEASUREMENT
/begin MEASUREMENT lavk_obd_dyn_wert_gesamt_nv "Gesamt-Diagnosewert" UWORD FORMULA_0025 0 0.0 0.0 3.999000072479248 READ_WRITE ECU_ADDRESS 0x3FA76E /end MEASUREMENT
/begin MEASUREMENT lavk_obd_dyn_wert_min_nv_b1 "min. Diagnosewert ueber alle Diag.Durchlaeufe" UWORD FORMULA_0025 0 0.0 0.0 3.999000072479248 READ_WRITE ECU_ADDRESS 0x3FA770 /end MEASUREMENT
/begin MEASUREMENT lavk_obd_dyn_wert_min_nv_b2 "min. Diagnosewert ueber alle Diag.Durchlaeufe" UWORD FORMULA_0025 0 0.0 0.0 3.999000072479248 READ_WRITE ECU_ADDRESS 0x3FA772 /end MEASUREMENT
/begin MEASUREMENT lavk_obd_dyn_wert_nv_b1 "Diagnosewert" UWORD FORMULA_0025 0 0.0 0.0 3.999000072479248 READ_WRITE ECU_ADDRESS 0x3FA76A /end MEASUREMENT
/begin MEASUREMENT lavk_obd_dyn_wert_nv_b2 "Diagnosewert" UWORD FORMULA_0025 0 0.0 0.0 3.999000072479248 READ_WRITE ECU_ADDRESS 0x3FA76C /end MEASUREMENT
/begin MEASUREMENT lshnk_diag_r_gmw_nv_b1 "gem. Heizerwiderstand NKAT" UWORD FORMULA_0541 0 0.0 0.0 100.0 READ_WRITE ECU_ADDRESS 0x3FA788 /end MEASUREMENT
/begin MEASUREMENT lshnk_diag_r_gmw_nv_b2 "gem. Heizerwiderstand NKAT" UWORD FORMULA_0541 0 0.0 0.0 100.0 READ_WRITE ECU_ADDRESS 0x3FA78A /end MEASUREMENT
/begin MEASUREMENT lshvk_diag_aktiv_b1 "VKAT-LSH-Diag-AKTIV" UWORD FORMULA_0537 0 0 0.0 255.0 READ_WRITE BIT_MASK 0x1 ECU_ADDRESS 0x3FA778 /end MEASUREMENT
/begin MEASUREMENT lshvk_diag_aktiv_b2 "VKAT-LSH-Diag-AKTIV" UWORD FORMULA_0537 0 0 0.0 255.0 READ_WRITE BIT_MASK 0x1 ECU_ADDRESS 0x3FA77A /end MEASUREMENT
/begin MEASUREMENT lshvk_diag_info_b1 "VKAT-LSH-Diag-INFO" UWORD FORMULA_0538 0 0 0.0 255.0 READ_WRITE BIT_MASK 0x2 ECU_ADDRESS 0x3FA778 /end MEASUREMENT
/begin MEASUREMENT lshvk_diag_info_b2 "VKAT-LSH-Diag-INFO" UWORD FORMULA_0538 0 0 0.0 255.0 READ_WRITE BIT_MASK 0x2 ECU_ADDRESS 0x3FA77A /end MEASUREMENT
/begin MEASUREMENT lshvk_diag_r_adapt_b1 "adaptierter Heizerwiderstand VKAT" UWORD FORMULA_0541 0 0.0 0.0 100.0 READ_WRITE ECU_ADDRESS 0x3FA780 /end MEASUREMENT
/begin MEASUREMENT lshvk_diag_r_adapt_b2 "adaptierter Heizerwiderstand VKAT" UWORD FORMULA_0541 0 0.0 0.0 100.0 READ_WRITE ECU_ADDRESS 0x3FA782 /end MEASUREMENT
/begin MEASUREMENT lshvk_diag_r_adaption_b1 "gueltige LSHVK-R-Adaption" UWORD FORMULA_0539 0 0 0.0 255.0 READ_WRITE BIT_MASK 0x4 ECU_ADDRESS 0x3FA778 /end MEASUREMENT
/begin MEASUREMENT lshvk_diag_r_adaption_b2 "gueltige LSHVK-R-Adaption" UWORD FORMULA_0539 0 0 0.0 255.0 READ_WRITE BIT_MASK 0x4 ECU_ADDRESS 0x3FA77A /end MEASUREMENT
/begin MEASUREMENT lshvk_diag_r_gmw_nv_b1 "gem. Heizerwiderstand VKAT" UWORD FORMULA_0541 0 0.0 0.0 100.0 READ_WRITE ECU_ADDRESS 0x3FA784 /end MEASUREMENT
/begin MEASUREMENT lshvk_diag_r_gmw_nv_b2 "gem. Heizerwiderstand VKAT" UWORD FORMULA_0541 0 0.0 0.0 100.0 READ_WRITE ECU_ADDRESS 0x3FA786 /end MEASUREMENT
/begin MEASUREMENT lshvk_diag_sh_to_x_sperren_b1 "VKAT-LSH-Einschalten aufgrund elektr. Diag. sperren" UWORD FORMULA_0540 0 0 0.0 255.0 READ_WRITE BIT_MASK 0x8 ECU_ADDRESS 0x3FA778 /end MEASUREMENT
/begin MEASUREMENT lshvk_diag_sh_to_x_sperren_b2 "VKAT-LSH-Einschalten aufgrund elektr. Diag. sperren" UWORD FORMULA_0540 0 0 0.0 255.0 READ_WRITE BIT_MASK 0x8 ECU_ADDRESS 0x3FA77A /end MEASUREMENT
/begin MEASUREMENT lshvk_diag_st_nv_b1 "VKAT-LSH-Diag.-Status" UWORD FORMULA_0080 0 0.0 0.0 65535.0 READ_WRITE ECU_ADDRESS 0x3FA778 /end MEASUREMENT
/begin MEASUREMENT lshvk_diag_st_nv_b2 "VKAT-LSH-Diag.-Status" UWORD FORMULA_0080 0 0.0 0.0 65535.0 READ_WRITE ECU_ADDRESS 0x3FA77A /end MEASUREMENT
/begin MEASUREMENT lshvk_r_ad_gain_b1 "Faktor-Sonden-Ri-Adaption" UWORD FORMULA_0073 0 0.0 0.0 4.0 READ_WRITE ECU_ADDRESS 0x3FA774 /end MEASUREMENT
/begin MEASUREMENT lshvk_r_ad_gain_b2 "Faktor-Sonden-Ri-Adaption" UWORD FORMULA_0073 0 0.0 0.0 4.0 READ_WRITE ECU_ADDRESS 0x3FA776 /end MEASUREMENT
/begin MEASUREMENT lshvk_r_ad_offs_b1 "Offset-Sonden-Ri-Adaption" SWORD FORMULA_0536 0 0.0 -5000.0 5000.0 READ_WRITE ECU_ADDRESS 0x3FA77C /end MEASUREMENT
/begin MEASUREMENT lshvk_r_ad_offs_b2 "Offset-Sonden-Ri-Adaption" SWORD FORMULA_0536 0 0.0 -5000.0 5000.0 READ_WRITE ECU_ADDRESS 0x3FA77E /end MEASUREMENT
/begin MEASUREMENT mdrv_p400_only_nv "P400-Only" UWORD FORMULA_0010 0 0.0 0.0 65535.0 READ_WRITE ECU_ADDRESS 0x3F9734 /end MEASUREMENT
/begin MEASUREMENT mdrv_p500_start_nv "P500-Hochlauf" UWORD FORMULA_0010 0 0.0 0.0 65535.0 READ_WRITE ECU_ADDRESS 0x3F9736 /end MEASUREMENT
/begin MEASUREMENT mdrv_st_dsc_key0 "MDRV-Status DSC (CAN)" UBYTE FORMULA_0215 0 0.0 0.0 255.0 READ_WRITE ECU_ADDRESS 0x3F960C /end MEASUREMENT
/begin MEASUREMENT mdrv_st_dsc_key1 "MDRV-Status DSC (CAN)" UBYTE FORMULA_0215 0 0.0 0.0 255.0 READ_WRITE ECU_ADDRESS 0x3F960D /end MEASUREMENT
/begin MEASUREMENT mdrv_st_dsc_key2 "MDRV-Status DSC (CAN)" UBYTE FORMULA_0215 0 0.0 0.0 255.0 READ_WRITE ECU_ADDRESS 0x3F960E /end MEASUREMENT
/begin MEASUREMENT mdrv_st_dsc_key3 "MDRV-Status DSC (CAN)" UBYTE FORMULA_0215 0 0.0 0.0 255.0 READ_WRITE ECU_ADDRESS 0x3F960F /end MEASUREMENT
/begin MEASUREMENT mdrv_st_dsc_key4 "MDRV-Status DSC (CAN)" UBYTE FORMULA_0215 0 0.0 0.0 255.0 READ_WRITE ECU_ADDRESS 0x3F9610 /end MEASUREMENT
/begin MEASUREMENT mdrv_st_dsc_key5 "MDRV-Status DSC (CAN)" UBYTE FORMULA_0215 0 0.0 0.0 255.0 READ_WRITE ECU_ADDRESS 0x3F9611 /end MEASUREMENT
/begin MEASUREMENT mdrv_st_dsc_key6 "MDRV-Status DSC (CAN)" UBYTE FORMULA_0215 0 0.0 0.0 255.0 READ_WRITE ECU_ADDRESS 0x3F9612 /end MEASUREMENT
/begin MEASUREMENT mdrv_st_dsc_key7 "MDRV-Status DSC (CAN)" UBYTE FORMULA_0215 0 0.0 0.0 255.0 READ_WRITE ECU_ADDRESS 0x3F9613 /end MEASUREMENT
/begin MEASUREMENT mdrv_st_dsc_key8 "MDRV-Status DSC (CAN)" UBYTE FORMULA_0215 0 0.0 0.0 255.0 READ_WRITE ECU_ADDRESS 0x3F9614 /end MEASUREMENT
/begin MEASUREMENT mdrv_st_dsc_key9 "MDRV-Status DSC (CAN)" UBYTE FORMULA_0215 0 0.0 0.0 255.0 READ_WRITE ECU_ADDRESS 0x3F9615 /end MEASUREMENT
/begin MEASUREMENT mdrv_st_mod_albv_key0 "MDRV-Status aLBV (CAN)" UBYTE FORMULA_0219 0 0.0 0.0 255.0 READ_WRITE ECU_ADDRESS 0x3F963E /end MEASUREMENT
/begin MEASUREMENT mdrv_st_mod_albv_key1 "MDRV-Status aLBV (CAN)" UBYTE FORMULA_0219 0 0.0 0.0 255.0 READ_WRITE ECU_ADDRESS 0x3F963F /end MEASUREMENT
/begin MEASUREMENT mdrv_st_mod_albv_key2 "MDRV-Status aLBV (CAN)" UBYTE FORMULA_0219 0 0.0 0.0 255.0 READ_WRITE ECU_ADDRESS 0x3F9640 /end MEASUREMENT
/begin MEASUREMENT mdrv_st_mod_albv_key3 "MDRV-Status aLBV (CAN)" UBYTE FORMULA_0219 0 0.0 0.0 255.0 READ_WRITE ECU_ADDRESS 0x3F9641 /end MEASUREMENT
/begin MEASUREMENT mdrv_st_mod_albv_key4 "MDRV-Status aLBV (CAN)" UBYTE FORMULA_0219 0 0.0 0.0 255.0 READ_WRITE ECU_ADDRESS 0x3F9642 /end MEASUREMENT
/begin MEASUREMENT mdrv_st_mod_albv_key5 "MDRV-Status aLBV (CAN)" UBYTE FORMULA_0219 0 0.0 0.0 255.0 READ_WRITE ECU_ADDRESS 0x3F9643 /end MEASUREMENT
/begin MEASUREMENT mdrv_st_mod_albv_key6 "MDRV-Status aLBV (CAN)" UBYTE FORMULA_0219 0 0.0 0.0 255.0 READ_WRITE ECU_ADDRESS 0x3F9644 /end MEASUREMENT
/begin MEASUREMENT mdrv_st_mod_albv_key7 "MDRV-Status aLBV (CAN)" UBYTE FORMULA_0219 0 0.0 0.0 255.0 READ_WRITE ECU_ADDRESS 0x3F9645 /end MEASUREMENT
/begin MEASUREMENT mdrv_st_mod_albv_key8 "MDRV-Status aLBV (CAN)" UBYTE FORMULA_0219 0 0.0 0.0 255.0 READ_WRITE ECU_ADDRESS 0x3F9646 /end MEASUREMENT
/begin MEASUREMENT mdrv_st_mod_albv_key9 "MDRV-Status aLBV (CAN)" UBYTE FORMULA_0219 0 0.0 0.0 255.0 READ_WRITE ECU_ADDRESS 0x3F9647 /end MEASUREMENT
/begin MEASUREMENT mdrv_st_mod_edck_key0 "MDRV-Status EDCK (CAN)" UBYTE FORMULA_0219 0 0.0 0.0 255.0 READ_WRITE ECU_ADDRESS 0x3F9634 /end MEASUREMENT
/begin MEASUREMENT mdrv_st_mod_edck_key1 "MDRV-Status EDCK (CAN)" UBYTE FORMULA_0219 0 0.0 0.0 255.0 READ_WRITE ECU_ADDRESS 0x3F9635 /end MEASUREMENT
/begin MEASUREMENT mdrv_st_mod_edck_key2 "MDRV-Status EDCK (CAN)" UBYTE FORMULA_0219 0 0.0 0.0 255.0 READ_WRITE ECU_ADDRESS 0x3F9636 /end MEASUREMENT
/begin MEASUREMENT mdrv_st_mod_edck_key3 "MDRV-Status EDCK (CAN)" UBYTE FORMULA_0219 0 0.0 0.0 255.0 READ_WRITE ECU_ADDRESS 0x3F9637 /end MEASUREMENT
/begin MEASUREMENT mdrv_st_mod_edck_key4 "MDRV-Status EDCK (CAN)" UBYTE FORMULA_0219 0 0.0 0.0 255.0 READ_WRITE ECU_ADDRESS 0x3F9638 /end MEASUREMENT
/begin MEASUREMENT mdrv_st_mod_edck_key5 "MDRV-Status EDCK (CAN)" UBYTE FORMULA_0219 0 0.0 0.0 255.0 READ_WRITE ECU_ADDRESS 0x3F9639 /end MEASUREMENT
/begin MEASUREMENT mdrv_st_mod_edck_key6 "MDRV-Status EDCK (CAN)" UBYTE FORMULA_0219 0 0.0 0.0 255.0 READ_WRITE ECU_ADDRESS 0x3F963A /end MEASUREMENT
/begin MEASUREMENT mdrv_st_mod_edck_key7 "MDRV-Status EDCK (CAN)" UBYTE FORMULA_0219 0 0.0 0.0 255.0 READ_WRITE ECU_ADDRESS 0x3F963B /end MEASUREMENT
/begin MEASUREMENT mdrv_st_mod_edck_key8 "MDRV-Status EDCK (CAN)" UBYTE FORMULA_0219 0 0.0 0.0 255.0 READ_WRITE ECU_ADDRESS 0x3F963C /end MEASUREMENT
/begin MEASUREMENT mdrv_st_mod_edck_key9 "MDRV-Status EDCK (CAN)" UBYTE FORMULA_0219 0 0.0 0.0 255.0 READ_WRITE ECU_ADDRESS 0x3F963D /end MEASUREMENT
/begin MEASUREMENT mdrv_st_mod_eng_key0 "MDRV-Status Motor (CAN)" UBYTE FORMULA_0218 0 0.0 0.0 255.0 READ_WRITE ECU_ADDRESS 0x3F962A /end MEASUREMENT
/begin MEASUREMENT mdrv_st_mod_eng_key1 "MDRV-Status Motor (CAN)" UBYTE FORMULA_0218 0 0.0 0.0 255.0 READ_WRITE ECU_ADDRESS 0x3F962B /end MEASUREMENT
/begin MEASUREMENT mdrv_st_mod_eng_key2 "MDRV-Status Motor (CAN)" UBYTE FORMULA_0218 0 0.0 0.0 255.0 READ_WRITE ECU_ADDRESS 0x3F962C /end MEASUREMENT
/begin MEASUREMENT mdrv_st_mod_eng_key3 "MDRV-Status Motor (CAN)" UBYTE FORMULA_0218 0 0.0 0.0 255.0 READ_WRITE ECU_ADDRESS 0x3F962D /end MEASUREMENT
/begin MEASUREMENT mdrv_st_mod_eng_key4 "MDRV-Status Motor (CAN)" UBYTE FORMULA_0218 0 0.0 0.0 255.0 READ_WRITE ECU_ADDRESS 0x3F962E /end MEASUREMENT
/begin MEASUREMENT mdrv_st_mod_eng_key5 "MDRV-Status Motor (CAN)" UBYTE FORMULA_0218 0 0.0 0.0 255.0 READ_WRITE ECU_ADDRESS 0x3F962F /end MEASUREMENT
/begin MEASUREMENT mdrv_st_mod_eng_key6 "MDRV-Status Motor (CAN)" UBYTE FORMULA_0218 0 0.0 0.0 255.0 READ_WRITE ECU_ADDRESS 0x3F9630 /end MEASUREMENT
/begin MEASUREMENT mdrv_st_mod_eng_key7 "MDRV-Status Motor (CAN)" UBYTE FORMULA_0218 0 0.0 0.0 255.0 READ_WRITE ECU_ADDRESS 0x3F9631 /end MEASUREMENT
/begin MEASUREMENT mdrv_st_mod_eng_key8 "MDRV-Status Motor (CAN)" UBYTE FORMULA_0218 0 0.0 0.0 255.0 READ_WRITE ECU_ADDRESS 0x3F9632 /end MEASUREMENT
/begin MEASUREMENT mdrv_st_mod_eng_key9 "MDRV-Status Motor (CAN)" UBYTE FORMULA_0218 0 0.0 0.0 255.0 READ_WRITE ECU_ADDRESS 0x3F9633 /end MEASUREMENT
/begin MEASUREMENT mdrv_st_mod_hud_key0 "MDRV-Status HUD (CAN)" UBYTE FORMULA_0220 0 0.0 0.0 255.0 READ_WRITE ECU_ADDRESS 0x3F9648 /end MEASUREMENT
/begin MEASUREMENT mdrv_st_mod_hud_key1 "MDRV-Status HUD (CAN)" UBYTE FORMULA_0220 0 0.0 0.0 255.0 READ_WRITE ECU_ADDRESS 0x3F9649 /end MEASUREMENT
/begin MEASUREMENT mdrv_st_mod_hud_key2 "MDRV-Status HUD (CAN)" UBYTE FORMULA_0220 0 0.0 0.0 255.0 READ_WRITE ECU_ADDRESS 0x3F964A /end MEASUREMENT
/begin MEASUREMENT mdrv_st_mod_hud_key3 "MDRV-Status HUD (CAN)" UBYTE FORMULA_0220 0 0.0 0.0 255.0 READ_WRITE ECU_ADDRESS 0x3F964B /end MEASUREMENT
/begin MEASUREMENT mdrv_st_mod_hud_key4 "MDRV-Status HUD (CAN)" UBYTE FORMULA_0220 0 0.0 0.0 255.0 READ_WRITE ECU_ADDRESS 0x3F964C /end MEASUREMENT
/begin MEASUREMENT mdrv_st_mod_hud_key5 "MDRV-Status HUD (CAN)" UBYTE FORMULA_0220 0 0.0 0.0 255.0 READ_WRITE ECU_ADDRESS 0x3F964D /end MEASUREMENT
/begin MEASUREMENT mdrv_st_mod_hud_key6 "MDRV-Status HUD (CAN)" UBYTE FORMULA_0220 0 0.0 0.0 255.0 READ_WRITE ECU_ADDRESS 0x3F964E /end MEASUREMENT
/begin MEASUREMENT mdrv_st_mod_hud_key7 "MDRV-Status HUD (CAN)" UBYTE FORMULA_0220 0 0.0 0.0 255.0 READ_WRITE ECU_ADDRESS 0x3F964F /end MEASUREMENT
/begin MEASUREMENT mdrv_st_mod_hud_key8 "MDRV-Status HUD (CAN)" UBYTE FORMULA_0220 0 0.0 0.0 255.0 READ_WRITE ECU_ADDRESS 0x3F9650 /end MEASUREMENT
/begin MEASUREMENT mdrv_st_mod_hud_key9 "MDRV-Status HUD (CAN)" UBYTE FORMULA_0220 0 0.0 0.0 255.0 READ_WRITE ECU_ADDRESS 0x3F9651 /end MEASUREMENT
/begin MEASUREMENT mdrv_st_mod_smg_key0 "MDRV-Status SMG (CAN)" UBYTE FORMULA_0216 0 0.0 0.0 255.0 READ_WRITE ECU_ADDRESS 0x3F9616 /end MEASUREMENT
/begin MEASUREMENT mdrv_st_mod_smg_key1 "MDRV-Status SMG (CAN)" UBYTE FORMULA_0216 0 0.0 0.0 255.0 READ_WRITE ECU_ADDRESS 0x3F9617 /end MEASUREMENT
/begin MEASUREMENT mdrv_st_mod_smg_key2 "MDRV-Status SMG (CAN)" UBYTE FORMULA_0216 0 0.0 0.0 255.0 READ_WRITE ECU_ADDRESS 0x3F9618 /end MEASUREMENT
/begin MEASUREMENT mdrv_st_mod_smg_key3 "MDRV-Status SMG (CAN)" UBYTE FORMULA_0216 0 0.0 0.0 255.0 READ_WRITE ECU_ADDRESS 0x3F9619 /end MEASUREMENT
/begin MEASUREMENT mdrv_st_mod_smg_key4 "MDRV-Status SMG (CAN)" UBYTE FORMULA_0216 0 0.0 0.0 255.0 READ_WRITE ECU_ADDRESS 0x3F961A /end MEASUREMENT
/begin MEASUREMENT mdrv_st_mod_smg_key5 "MDRV-Status SMG (CAN)" UBYTE FORMULA_0216 0 0.0 0.0 255.0 READ_WRITE ECU_ADDRESS 0x3F961B /end MEASUREMENT
/begin MEASUREMENT mdrv_st_mod_smg_key6 "MDRV-Status SMG (CAN)" UBYTE FORMULA_0216 0 0.0 0.0 255.0 READ_WRITE ECU_ADDRESS 0x3F961C /end MEASUREMENT
/begin MEASUREMENT mdrv_st_mod_smg_key7 "MDRV-Status SMG (CAN)" UBYTE FORMULA_0216 0 0.0 0.0 255.0 READ_WRITE ECU_ADDRESS 0x3F961D /end MEASUREMENT
/begin MEASUREMENT mdrv_st_mod_smg_key8 "MDRV-Status SMG (CAN)" UBYTE FORMULA_0216 0 0.0 0.0 255.0 READ_WRITE ECU_ADDRESS 0x3F961E /end MEASUREMENT
/begin MEASUREMENT mdrv_st_mod_smg_key9 "MDRV-Status SMG (CAN)" UBYTE FORMULA_0216 0 0.0 0.0 255.0 READ_WRITE ECU_ADDRESS 0x3F961F /end MEASUREMENT
/begin MEASUREMENT mdrv_st_stg_smg_key0 "MDRV-Status Drivelogic (CAN)" UBYTE FORMULA_0217 0 0.0 0.0 255.0 READ_WRITE ECU_ADDRESS 0x3F9620 /end MEASUREMENT
/begin MEASUREMENT mdrv_st_stg_smg_key1 "MDRV-Status Drivelogic (CAN)" UBYTE FORMULA_0217 0 0.0 0.0 255.0 READ_WRITE ECU_ADDRESS 0x3F9621 /end MEASUREMENT
/begin MEASUREMENT mdrv_st_stg_smg_key2 "MDRV-Status Drivelogic (CAN)" UBYTE FORMULA_0217 0 0.0 0.0 255.0 READ_WRITE ECU_ADDRESS 0x3F9622 /end MEASUREMENT
/begin MEASUREMENT mdrv_st_stg_smg_key3 "MDRV-Status Drivelogic (CAN)" UBYTE FORMULA_0217 0 0.0 0.0 255.0 READ_WRITE ECU_ADDRESS 0x3F9623 /end MEASUREMENT
/begin MEASUREMENT mdrv_st_stg_smg_key4 "MDRV-Status Drivelogic (CAN)" UBYTE FORMULA_0217 0 0.0 0.0 255.0 READ_WRITE ECU_ADDRESS 0x3F9624 /end MEASUREMENT
/begin MEASUREMENT mdrv_st_stg_smg_key5 "MDRV-Status Drivelogic (CAN)" UBYTE FORMULA_0217 0 0.0 0.0 255.0 READ_WRITE ECU_ADDRESS 0x3F9625 /end MEASUREMENT
/begin MEASUREMENT mdrv_st_stg_smg_key6 "MDRV-Status Drivelogic (CAN)" UBYTE FORMULA_0217 0 0.0 0.0 255.0 READ_WRITE ECU_ADDRESS 0x3F9626 /end MEASUREMENT
/begin MEASUREMENT mdrv_st_stg_smg_key7 "MDRV-Status Drivelogic (CAN)" UBYTE FORMULA_0217 0 0.0 0.0 255.0 READ_WRITE ECU_ADDRESS 0x3F9627 /end MEASUREMENT
/begin MEASUREMENT mdrv_st_stg_smg_key8 "MDRV-Status Drivelogic (CAN)" UBYTE FORMULA_0217 0 0.0 0.0 255.0 READ_WRITE ECU_ADDRESS 0x3F9628 /end MEASUREMENT
/begin MEASUREMENT mdrv_st_stg_smg_key9 "MDRV-Status Drivelogic (CAN)" UBYTE FORMULA_0217 0 0.0 0.0 255.0 READ_WRITE ECU_ADDRESS 0x3F9629 /end MEASUREMENT
/begin MEASUREMENT Mslui "Integr. Luftmasse" UWORD FORMULA_0010 0 0.0 0.0 65535.0 READ_WRITE ECU_ADDRESS 0x3FBC74 /end MEASUREMENT
/begin MEASUREMENT n_max_ff_anzahl "Anzahl der Begrenzungsphasen" UWORD FORMULA_0010 0 0.0 0.0 65535.0 READ_WRITE ECU_ADDRESS 0x3F957C /end MEASUREMENT
/begin MEASUREMENT n_max_ff_gang "Gang" SBYTE FORMULA_0135 0 0.0 -1.0 10.0 READ_WRITE ECU_ADDRESS 0x3F95A8 /end MEASUREMENT
/begin MEASUREMENT n_max_ff_km_stand "Kilometerstand" ULONG FORMULA_0027 0 0.0 0.0 16777214.0 READ_WRITE ECU_ADDRESS 0x3F9594 /end MEASUREMENT
/begin MEASUREMENT n_max_ff_md_fahrer "Fahrerwunschmoment" SWORD FORMULA_0009 0 0.0 -100.0 1000.0 READ_WRITE ECU_ADDRESS 0x3F959A /end MEASUREMENT
/begin MEASUREMENT n_max_ff_md_ist "Kupplungs-Istmoment" SWORD FORMULA_0009 0 0.0 -100.0 1000.0 READ_WRITE ECU_ADDRESS 0x3F959E /end MEASUREMENT
/begin MEASUREMENT n_max_ff_md_wunsch "resultierendes Kupplungs-Wunschmoment" SWORD FORMULA_0009 0 0.0 -100.0 1000.0 READ_WRITE ECU_ADDRESS 0x3F959C /end MEASUREMENT
/begin MEASUREMENT n_max_ff_ml "Luftmasse" SWORD FORMULA_0103 0 0.0 -100.0 1400.0 READ_WRITE ECU_ADDRESS 0x3F9598 /end MEASUREMENT
/begin MEASUREMENT n_max_ff_n_getriebe "Getriebeeingangsdrehzahl" SWORD FORMULA_0006 0 0.0 0.0 10000.0 READ_WRITE ECU_ADDRESS 0x3F9584 /end MEASUREMENT
/begin MEASUREMENT n_max_ff_n_grad "Gradient" SWORD FORMULA_0105 0 0.0 -10000.0 10000.0 READ_WRITE ECU_ADDRESS 0x3F9580 /end MEASUREMENT
/begin MEASUREMENT n_max_ff_n_vanos "Referenzdrehzahl aus Vanos" SWORD FORMULA_0006 0 0.0 0.0 10000.0 READ_WRITE ECU_ADDRESS 0x3F9582 /end MEASUREMENT
/begin MEASUREMENT n_max_ff_nbegr_egas "Begrenzerdrehzahl fuer Md-Eingrif" SWORD FORMULA_0006 0 0.0 0.0 10000.0 READ_WRITE ECU_ADDRESS 0x3F9586 /end MEASUREMENT
/begin MEASUREMENT n_max_ff_nbegr_ti "Begrenzerdrehzahl fuer Ti-Eingrif" SWORD FORMULA_0006 0 0.0 0.0 10000.0 READ_WRITE ECU_ADDRESS 0x3F9588 /end MEASUREMENT
/begin MEASUREMENT n_max_ff_nmax "Erreichte Maximaldrehzahl" SWORD FORMULA_0006 0 0.0 0.0 10000.0 READ_WRITE ECU_ADDRESS 0x3F957E /end MEASUREMENT
/begin MEASUREMENT n_max_ff_pwg "Fahrpedalstellung" SWORD FORMULA_0001 0 0.0 -10.0 120.0 READ_WRITE ECU_ADDRESS 0x3F9592 /end MEASUREMENT
/begin MEASUREMENT n_max_ff_schalter_inj "Schalterstatus Inj" UWORD FORMULA_0010 0 0.0 0.0 65535.0 READ_WRITE ECU_ADDRESS 0x3F95A4 /end MEASUREMENT
/begin MEASUREMENT n_max_ff_smg_st "DME-Status" UBYTE FORMULA_0298 0 0.0 0.0 255.0 READ_WRITE ECU_ADDRESS 0x3F95A9 /end MEASUREMENT
/begin MEASUREMENT n_max_ff_t_nbegr_egas "Einzelzeit oberhalb nbegr_egas" UWORD FORMULA_0021 0 0.0 0.0 655.0 READ_WRITE ECU_ADDRESS 0x3F958E /end MEASUREMENT
/begin MEASUREMENT n_max_ff_tmot "Kuehlwassertemperatur" SWORD FORMULA_0023 0 0.0 -50.0 170.0 READ_WRITE ECU_ADDRESS 0x3F95A0 /end MEASUREMENT
/begin MEASUREMENT n_max_ff_toel "Oeltemperatur" SWORD FORMULA_0023 0 0.0 -50.0 170.0 READ_WRITE ECU_ADDRESS 0x3F95A2 /end MEASUREMENT
/begin MEASUREMENT n_max_ff_tsum_egas "Summenzeit oberhalb nbegr_egas" UWORD FORMULA_0021 0 0.0 0.0 655.0 READ_WRITE ECU_ADDRESS 0x3F958A /end MEASUREMENT
/begin MEASUREMENT n_max_ff_tsum_ti "Summenzeit oberhalb nbegr_ti" UWORD FORMULA_0021 0 0.0 0.0 655.0 READ_WRITE ECU_ADDRESS 0x3F958C /end MEASUREMENT
/begin MEASUREMENT n_max_ff_v_hinten "mittlere Geschwindigkeit hinten" SWORD FORMULA_0076 0 0.0 -80.0 360.0 READ_WRITE ECU_ADDRESS 0x3F9590 /end MEASUREMENT
/begin MEASUREMENT n_max_ff_zustand_motor "Betriebszustand" UWORD FORMULA_0019 0 0.0 0.0 65535.0 READ_WRITE ECU_ADDRESS 0x3F95A6 /end MEASUREMENT
/begin MEASUREMENT Nsllm "Solldrehzahl im Leerlauf" SWORD FORMULA_0010 0 0.0 -32768.0 32767.0 READ_WRITE ECU_ADDRESS 0x3FBC7E /end MEASUREMENT
/begin MEASUREMENT nw_fehlerzaehler_nv "Anzahl Rueckschaltungen in 360° Mode" UBYTE FORMULA_0003 0 0.0 0.0 255.0 READ_WRITE ECU_ADDRESS 0x3FA7D3 /end MEASUREMENT
/begin MEASUREMENT os_err.addr "OS-Err: Adresse" ULONG FORMULA_0000 0 0.0 0.0 4294967295.0 READ_WRITE ECU_ADDRESS 0x3FC9E8 /end MEASUREMENT
/begin MEASUREMENT os_err.deadline.cnt "OS-Err: Deadline" UBYTE FORMULA_0003 0 0.0 0.0 255.0 READ_WRITE ECU_ADDRESS 0x3FC9E4 /end MEASUREMENT
/begin MEASUREMENT os_err.deadline.task "OS-Err: Deadline" UBYTE FORMULA_0355 0 0.0 0.0 255.0 READ_WRITE ECU_ADDRESS 0x3FC9E5 /end MEASUREMENT
/begin MEASUREMENT os_err.dflt.cnt "OS-Err: Default" UBYTE FORMULA_0003 0 0.0 0.0 255.0 READ_WRITE ECU_ADDRESS 0x3FC9E6 /end MEASUREMENT
/begin MEASUREMENT os_err.dflt.task "OS-Err: Default" UBYTE FORMULA_0355 0 0.0 0.0 255.0 READ_WRITE ECU_ADDRESS 0x3FC9E7 /end MEASUREMENT
/begin MEASUREMENT os_err.fifo.cnt "OS-Err: FIFO full" UBYTE FORMULA_0003 0 0.0 0.0 255.0 READ_WRITE ECU_ADDRESS 0x3FC9E0 /end MEASUREMENT
/begin MEASUREMENT os_err.fifo.task "OS-Err: FIFO full" UBYTE FORMULA_0355 0 0.0 0.0 255.0 READ_WRITE ECU_ADDRESS 0x3FC9E1 /end MEASUREMENT
/begin MEASUREMENT os_err.id.cnt "OS-Err: ID" UBYTE FORMULA_0003 0 0.0 0.0 255.0 READ_WRITE ECU_ADDRESS 0x3FC9D4 /end MEASUREMENT
/begin MEASUREMENT os_err.id.task "OS-Err: ID" UBYTE FORMULA_0355 0 0.0 0.0 255.0 READ_WRITE ECU_ADDRESS 0x3FC9D5 /end MEASUREMENT
/begin MEASUREMENT os_err.limit.cnt "OS-Err: Limit" UBYTE FORMULA_0003 0 0.0 0.0 255.0 READ_WRITE ECU_ADDRESS 0x3FC9D6 /end MEASUREMENT
/begin MEASUREMENT os_err.limit.task "OS-Err: Limit" UBYTE FORMULA_0355 0 0.0 0.0 255.0 READ_WRITE ECU_ADDRESS 0x3FC9D7 /end MEASUREMENT
/begin MEASUREMENT os_err.no_fnc.cnt "OS-Err: No Fkt" UBYTE FORMULA_0003 0 0.0 0.0 255.0 READ_WRITE ECU_ADDRESS 0x3FC9DA /end MEASUREMENT
/begin MEASUREMENT os_err.no_fnc.task "OS-Err: No Fkt" UBYTE FORMULA_0355 0 0.0 0.0 255.0 READ_WRITE ECU_ADDRESS 0x3FC9DB /end MEASUREMENT
/begin MEASUREMENT os_err.stack.cnt "OS-Err: Stack" UBYTE FORMULA_0003 0 0.0 0.0 255.0 READ_WRITE ECU_ADDRESS 0x3FC9DE /end MEASUREMENT
/begin MEASUREMENT os_err.stack.task "OS-Err: Stack" UBYTE FORMULA_0355 0 0.0 0.0 255.0 READ_WRITE ECU_ADDRESS 0x3FC9DF /end MEASUREMENT
/begin MEASUREMENT os_err.sum_cnt "OS-Err: Summe" UBYTE FORMULA_0003 0 0.0 0.0 255.0 READ_WRITE ECU_ADDRESS 0x3FC9EC /end MEASUREMENT
/begin MEASUREMENT os_err.tt_act.cnt "OS-Err: TT aktiv" UBYTE FORMULA_0003 0 0.0 0.0 255.0 READ_WRITE ECU_ADDRESS 0x3FC9D8 /end MEASUREMENT
/begin MEASUREMENT os_err.tt_act.task "OS-Err: TT aktiv" UBYTE FORMULA_0355 0 0.0 0.0 255.0 READ_WRITE ECU_ADDRESS 0x3FC9D9 /end MEASUREMENT
/begin MEASUREMENT os_err.tt_miss.cnt "OS-Err: TT missing" UBYTE FORMULA_0003 0 0.0 0.0 255.0 READ_WRITE ECU_ADDRESS 0x3FC9DC /end MEASUREMENT
/begin MEASUREMENT os_err.tt_miss.task "OS-Err: TT missing" UBYTE FORMULA_0355 0 0.0 0.0 255.0 READ_WRITE ECU_ADDRESS 0x3FC9DD /end MEASUREMENT
/begin MEASUREMENT os_err.type "Fehlertyp" UBYTE FORMULA_0356 0 0.0 0.0 255.0 READ_WRITE ECU_ADDRESS 0x3FC9ED /end MEASUREMENT
/begin MEASUREMENT os_err.value.cnt "OS-Err: Value" UBYTE FORMULA_0003 0 0.0 0.0 255.0 READ_WRITE ECU_ADDRESS 0x3FC9E2 /end MEASUREMENT
/begin MEASUREMENT os_err.value.task "OS-Err: Value" UBYTE FORMULA_0355 0 0.0 0.0 255.0 READ_WRITE ECU_ADDRESS 0x3FC9E3 /end MEASUREMENT
/begin MEASUREMENT os_err_ff.addr_0 "Adresse wo letzte Exception her kam" ULONG FORMULA_0000 0 0.0 0.0 4294967295.0 READ_WRITE ECU_ADDRESS 0x3F98B8 /end MEASUREMENT
/begin MEASUREMENT os_err_ff.addr_1 "Adresse wo letzte Exception her kam" ULONG FORMULA_0000 0 0.0 0.0 4294967295.0 READ_WRITE ECU_ADDRESS 0x3F98BC /end MEASUREMENT
/begin MEASUREMENT os_err_ff.addr_2 "Adresse wo letzte Exception her kam" ULONG FORMULA_0000 0 0.0 0.0 4294967295.0 READ_WRITE ECU_ADDRESS 0x3F98C0 /end MEASUREMENT
/begin MEASUREMENT os_err_ff.addr_3 "Adresse wo letzte Exception her kam" ULONG FORMULA_0000 0 0.0 0.0 4294967295.0 READ_WRITE ECU_ADDRESS 0x3F98C4 /end MEASUREMENT
/begin MEASUREMENT os_err_ff.addr_4 "Adresse wo letzte Exception her kam" ULONG FORMULA_0000 0 0.0 0.0 4294967295.0 READ_WRITE ECU_ADDRESS 0x3F98C8 /end MEASUREMENT
/begin MEASUREMENT os_err_ff.addr_5 "Adresse wo letzte Exception her kam" ULONG FORMULA_0000 0 0.0 0.0 4294967295.0 READ_WRITE ECU_ADDRESS 0x3F98CC /end MEASUREMENT
/begin MEASUREMENT os_err_ff.addr_6 "Adresse wo letzte Exception her kam" ULONG FORMULA_0000 0 0.0 0.0 4294967295.0 READ_WRITE ECU_ADDRESS 0x3F98D0 /end MEASUREMENT
/begin MEASUREMENT os_err_ff.addr_7 "Adresse wo letzte Exception her kam" ULONG FORMULA_0000 0 0.0 0.0 4294967295.0 READ_WRITE ECU_ADDRESS 0x3F98D4 /end MEASUREMENT
/begin MEASUREMENT os_err_ff.ptr "Zeiger auf Ringspeicher" ULONG FORMULA_0000 0 0.0 0.0 4294967295.0 READ_WRITE ECU_ADDRESS 0x3F98B4 /end MEASUREMENT
/begin MEASUREMENT os_proz_ff.aq_soll_grad "Gradient AQ-Soll von Bank1" SWORD FORMULA_0020 0 0.0 -30000.0 30000.0 READ_WRITE ECU_ADDRESS 0x3F98E2 /end MEASUREMENT
/begin MEASUREMENT os_proz_ff.mtime "Maximale Prozess Zeit" UWORD FORMULA_0018 0 0.0 0.0 65535.0 READ_WRITE ECU_ADDRESS 0x3F98D8 /end MEASUREMENT
/begin MEASUREMENT os_proz_ff.mtime_pid "PID des Prozesses mit max Zeit" UWORD FORMULA_0010 0 0.0 0.0 65535.0 READ_WRITE ECU_ADDRESS 0x3F98DA /end MEASUREMENT
/begin MEASUREMENT os_proz_ff.n "Motordrehzahl" SWORD FORMULA_0006 0 0.0 0.0 10000.0 READ_WRITE ECU_ADDRESS 0x3F98DC /end MEASUREMENT
/begin MEASUREMENT os_proz_ff.rf "relative Fuellung Mittel zwischen Bank 1 und 2" SWORD FORMULA_0007 0 0.0 0.0 2.0 READ_WRITE ECU_ADDRESS 0x3F98DE /end MEASUREMENT
/begin MEASUREMENT os_proz_ff.time_ml "Motor laeuft Zeit" UWORD FORMULA_0021 0 0.0 0.0 655.0 READ_WRITE ECU_ADDRESS 0x3F98E4 /end MEASUREMENT
/begin MEASUREMENT os_proz_ff.zustand_motor "Betriebszustand der Motorsteuerung" UWORD FORMULA_0019 0 0.0 0.0 65535.0 READ_WRITE ECU_ADDRESS 0x3F98E0 /end MEASUREMENT
/begin MEASUREMENT os_proz_irq_ff.aq_soll_grad "Gradient AQ-Soll von Bank1" SWORD FORMULA_0020 0 0.0 -30000.0 30000.0 READ_WRITE ECU_ADDRESS 0x3F98F0 /end MEASUREMENT
/begin MEASUREMENT os_proz_irq_ff.mtime "Maximale Prozess Zeit" UWORD FORMULA_0018 0 0.0 0.0 65535.0 READ_WRITE ECU_ADDRESS 0x3F98E6 /end MEASUREMENT
/begin MEASUREMENT os_proz_irq_ff.mtime_pid "PID des Prozesses mit max Zeit" UWORD FORMULA_0010 0 0.0 0.0 65535.0 READ_WRITE ECU_ADDRESS 0x3F98E8 /end MEASUREMENT
/begin MEASUREMENT os_proz_irq_ff.n "Motordrehzahl" SWORD FORMULA_0006 0 0.0 0.0 10000.0 READ_WRITE ECU_ADDRESS 0x3F98EA /end MEASUREMENT
/begin MEASUREMENT os_proz_irq_ff.rf "relative Fuellung Mittel zwischen Bank 1 und 2" SWORD FORMULA_0007 0 0.0 0.0 2.0 READ_WRITE ECU_ADDRESS 0x3F98EC /end MEASUREMENT
/begin MEASUREMENT os_proz_irq_ff.time_ml "Motor laeuft Zeit" UWORD FORMULA_0021 0 0.0 0.0 655.0 READ_WRITE ECU_ADDRESS 0x3F98F2 /end MEASUREMENT
/begin MEASUREMENT os_proz_irq_ff.zustand_motor "Betriebszustand der Motorsteuerung" UWORD FORMULA_0019 0 0.0 0.0 65535.0 READ_WRITE ECU_ADDRESS 0x3F98EE /end MEASUREMENT
/begin MEASUREMENT os_proz_irq_last_nv "CPU Last fuer diesen IRQ" UWORD FORMULA_0022 0 0.0 0.0 655.3499755859375 READ_WRITE ARRAY_SIZE 10 ECU_ADDRESS 0x3F98F4 MATRIX_DIM 10 1 1 /end MEASUREMENT
/begin MEASUREMENT Oz_anz_kombi_AG_code "Peilstab-Nachr. AG-codiert (fllv_eoi) 0x381" UBYTE FORMULA_0594 0 0.0 0.0 255.0 READ_WRITE ECU_ADDRESS 0x3F990F /end MEASUREMENT
/begin MEASUREMENT Oz_anzeige_kombi "Peilstab-CAN-Nachr. an Kombi (st_fllv_eoi)" UBYTE FORMULA_0595 0 0.0 -10.0 15.39990043640137 READ_WRITE ECU_ADDRESS 0x3F9910 /end MEASUREMENT
/begin MEASUREMENT Oz_anzeige_kombi_alt "gemerktes Oz_anzeige_kombi" UBYTE FORMULA_0595 0 0.0 -10.0 15.39990043640137 READ_WRITE ECU_ADDRESS 0x3F9911 /end MEASUREMENT
/begin MEASUREMENT Oz_datstat "Status Datum/Uhrzeit" UBYTE FORMULA_0003 0 0.0 0.0 255.0 READ_WRITE ECU_ADDRESS 0x3FBC4A /end MEASUREMENT
/begin MEASUREMENT Oz_einfahr_int_akt "Oel-Einfahrintervall aktiv (i.d.R. 2000 km)" UBYTE FORMULA_0574 0 0.0 0.0 255.0 READ_WRITE ECU_ADDRESS 0x3F973A /end MEASUREMENT
/begin MEASUREMENT Oz_krzmsg_can_kombi_BC "Oel-Kurzzeitmessung" UBYTE FORMULA_0517 0 0.0 0.0 255.0 READ_WRITE ECU_ADDRESS 0x3FA736 /end MEASUREMENT
/begin MEASUREMENT Oz_krzmsg_ctr "Zeitmesser fuer Kurzzeitmessung" UWORD FORMULA_0071 0 0.0 0.0 6553.5 READ_WRITE ECU_ADDRESS 0x3FA73E /end MEASUREMENT
/begin MEASUREMENT Oz_krzmsg_st "Kurzzeitmessung aktiv/inaktiv" UBYTE FORMULA_0532 0 0.0 0.0 2.0 READ_WRITE ECU_ADDRESS 0x3FA740 /end MEASUREMENT
/begin MEASUREMENT Oz_krzmwkor_n_kor "Drehzahlkorr. Oelniveauwert" UBYTE FORMULA_0436 0 0.0 0.0 74.70700073242188 READ_WRITE ECU_ADDRESS 0x3FBCBE /end MEASUREMENT
/begin MEASUREMENT Oz_krzmwkor_temp_kor "Temperaturkorr. Oelniveauwert" UBYTE FORMULA_0436 0 0.0 0.0 74.70700073242188 READ_WRITE ECU_ADDRESS 0x3FBCBF /end MEASUREMENT
/begin MEASUREMENT Oz_langmw_offset "Korrekturoffset Langzeitwert" UBYTE FORMULA_0436 0 0.0 0.0 74.70700073242188 READ_WRITE ECU_ADDRESS 0x3FBCC0 /end MEASUREMENT
/begin MEASUREMENT Oz_lf1c "Laenderfaktor1 codiert" UBYTE FORMULA_0003 0 0.0 0.0 255.0 READ_WRITE ECU_ADDRESS 0x3FBC4C /end MEASUREMENT
/begin MEASUREMENT Oz_lf2c "Laenderfaktor1 codiert" UBYTE FORMULA_0003 0 0.0 0.0 255.0 READ_WRITE ECU_ADDRESS 0x3FBC4D /end MEASUREMENT
/begin MEASUREMENT Oz_lgztwert_cbs_reset_st "Erkennung 1. Langztwert nach CBS-Reset" UBYTE FORMULA_0531 0 0 0.0 255.0 READ_WRITE BIT_MASK 0x1 ECU_ADDRESS 0x3FA73D /end MEASUREMENT
/begin MEASUREMENT Oz_n_gesamtzeit "Zeitdauer Langzeitwertermittlung" UWORD FORMULA_0593 0 0.0 0.0 65535.0 READ_WRITE ECU_ADDRESS 0x3FBCC4 /end MEASUREMENT
/begin MEASUREMENT Oz_n_messzeit "Zeitdauer im Drehzahlband" UWORD FORMULA_0593 0 0.0 0.0 65535.0 READ_WRITE ECU_ADDRESS 0x3FBCC6 /end MEASUREMENT
/begin MEASUREMENT Oz_niv_km_update "Km-Stand bei letzter Oelnivmessg." ULONG FORMULA_0027 0 0.0 0.0 16777214.0 READ_WRITE ECU_ADDRESS 0x3F9914 /end MEASUREMENT
/begin MEASUREMENT Oz_nivr "Rohwert Ölniveaumessung vom Sensor" UBYTE FORMULA_0731 0 0.0 0.1000000014901161 75.0 READ_WRITE ECU_ADDRESS 0x3FAF01 /end MEASUREMENT
/begin MEASUREMENT Oz_nivr_index "Rohwert-Index-Zaehler" UBYTE FORMULA_0037 0 0.0 0.0 255.0 READ_WRITE ECU_ADDRESS 0x3FAF06 /end MEASUREMENT
/begin MEASUREMENT Oz_offset_ll_l "l-beschl. korr. Oelniveauwert" SBYTE FORMULA_0436 0 0.0 -21.97260093688965 21.97260093688965 READ_WRITE ECU_ADDRESS 0x3FBCC2 /end MEASUREMENT
/begin MEASUREMENT Oz_offset_ll_q "q-beschl. korr. Oelniveauwert" SBYTE FORMULA_0436 0 0.0 -21.97260093688965 21.97260093688965 READ_WRITE ECU_ADDRESS 0x3FBCC1 /end MEASUREMENT
/begin MEASUREMENT Oz_permr "Rohwert Permittivität vom Sensor" UWORD FORMULA_0745 0 0.0 1.0 6.0 READ_WRITE ECU_ADDRESS 0x3FAF04 /end MEASUREMENT
/begin MEASUREMENT Oz_status "Statusinformation vom Ölzustandssensor" UBYTE FORMULA_0003 0 0.0 0.0 255.0 READ_WRITE ECU_ADDRESS 0x3FAF02 /end MEASUREMENT
/begin MEASUREMENT Oz_verbleib_verh "Verh. Zeit im Drehzahlband/Lgztmw" UBYTE FORMULA_0032 0 0.0 0.0 255.0 READ_WRITE ECU_ADDRESS 0x3FBCC8 /end MEASUREMENT
/begin MEASUREMENT pctrl_proz_err_nv "Fehler Prozessueberwachung" UWORD FORMULA_0010 0 0.0 0.0 65535.0 READ_WRITE ECU_ADDRESS 0x3F9868 /end MEASUREMENT
/begin MEASUREMENT pctrl_task_err_nv "Fehler Taskueberwachung" UBYTE FORMULA_0003 0 0.0 0.0 255.0 READ_WRITE ECU_ADDRESS 0x3F9866 /end MEASUREMENT
/begin MEASUREMENT pks_obd_abw "Kraftstoffdruck Ist-Soll Verhaeltniss" SWORD FORMULA_0543 0 0.0 -1000.0 1000.0 READ_WRITE ECU_ADDRESS 0x3FA7C0 /end MEASUREMENT
/begin MEASUREMENT pksr_adap_fak_nv "Adaptionsfaktor PKSR " UWORD FORMULA_0558 0 0.0 0.0 6.0 READ_WRITE ECU_ADDRESS 0x3FA804 /end MEASUREMENT
/begin MEASUREMENT pksr_adap_off_roh_nv "Adaptionsoffset roh PKSR " SWORD FORMULA_0557 0 0.0 -100.0 99.98999786376953 READ_WRITE ECU_ADDRESS 0x3FA802 /end MEASUREMENT
/begin MEASUREMENT pksr_st_nv "pksr Status Adaption" UBYTE FORMULA_0544 0 0.0 0.0 255.0 READ_WRITE ECU_ADDRESS 0x3FA7D4 /end MEASUREMENT
/begin MEASUREMENT Pmsv "Angemeldete Powermanagment Standverbraucher" UBYTE FORMULA_0003 0 0.0 0.0 255.0 READ_WRITE ARRAY_SIZE 15 ECU_ADDRESS 0x3F9918 MATRIX_DIM 15 1 1 /end MEASUREMENT
/begin MEASUREMENT psau_adapt_nv_b1 "Adaptionswert zur PSAU1 im GLOBbereich" SWORD FORMULA_0075 0 0.0 -100.0 200.0 READ_WRITE ECU_ADDRESS 0x3FA742 /end MEASUREMENT
/begin MEASUREMENT psau_adapt_nv_b2 "Adaptionswert zur PSAU1 im GLOBbereich" SWORD FORMULA_0075 0 0.0 -100.0 200.0 READ_WRITE ECU_ADDRESS 0x3FA744 /end MEASUREMENT
/begin MEASUREMENT pumg_obd_abstell_nv "Umgebungsdruck beim Abstellen" SWORD FORMULA_0075 0 0.0 400.0 1200.0 READ_WRITE ECU_ADDRESS 0x3FA838 /end MEASUREMENT
/begin MEASUREMENT pumg_obd_st_nv "OBD-Status pumg" UBYTE FORMULA_0569 0 0.0 0.0 255.0 READ_WRITE ECU_ADDRESS 0x3FA854 /end MEASUREMENT
/begin MEASUREMENT pumg_obd_start_nv "pumg waehrend des Motorstart" SWORD FORMULA_0075 0 0.0 400.0 1200.0 READ_WRITE ECU_ADDRESS 0x3FA856 /end MEASUREMENT
/begin MEASUREMENT Qelad "Delta Batterieentladung" UWORD FORMULA_0498 0 0.0 0.0 1192.750244140625 READ_WRITE ECU_ADDRESS 0x3FC0D6 /end MEASUREMENT
/begin MEASUREMENT Qeladsoc0 "Entladung bei Ruhespannungsmessung" UWORD FORMULA_0498 0 0.0 0.0 1192.750244140625 READ_WRITE ECU_ADDRESS 0x3FC0E4 /end MEASUREMENT
/begin MEASUREMENT Qlad "Delta Batterieladung" UWORD FORMULA_0498 0 0.0 0.0 1192.750244140625 READ_WRITE ECU_ADDRESS 0x3FC0D4 /end MEASUREMENT
/begin MEASUREMENT Qladsoc0 "Ladung bei Ruhespannungsmessung" UWORD FORMULA_0498 0 0.0 0.0 1192.750244140625 READ_WRITE ECU_ADDRESS 0x3FC0E2 /end MEASUREMENT
/begin MEASUREMENT r100msTaskCtr "Counter" UWORD FORMULA_0010 0 0.0 0.0 65535.0 READ_WRITE ECU_ADDRESS 0x3FBDF0 /end MEASUREMENT
/begin MEASUREMENT r10msTaskCtr "Counter" ULONG FORMULA_0000 0 0.0 0.0 4294967295.0 READ_WRITE ECU_ADDRESS 0x3FBDEC /end MEASUREMENT
/begin MEASUREMENT r1msTaskCtr "Counter" UWORD FORMULA_0010 0 0.0 0.0 65535.0 READ_WRITE ECU_ADDRESS 0x3FBDE8 /end MEASUREMENT
/begin MEASUREMENT r1sTaskCtr "Counter" UWORD FORMULA_0010 0 0.0 0.0 65535.0 READ_WRITE ECU_ADDRESS 0x3FBDF2 /end MEASUREMENT
/begin MEASUREMENT R5cyctim "Timer f. zyklisches Senden IBS Reg. 5" UBYTE FORMULA_0003 0 0.0 0.0 255.0 READ_WRITE ECU_ADDRESS 0x3FAECC /end MEASUREMENT
/begin MEASUREMENT r5msTaskCtr "Counter" UWORD FORMULA_0010 0 0.0 0.0 65535.0 READ_WRITE ECU_ADDRESS 0x3FBDEA /end MEASUREMENT
/begin MEASUREMENT ram_chk_err_adr_nv "Fehleradresse vom RamCheck" ULONG FORMULA_0000 0 0.0 0.0 4294967295.0 READ_WRITE ECU_ADDRESS 0x3F9838 /end MEASUREMENT
/begin MEASUREMENT sk_ff.crc32_result "CRC-Fehler" UBYTE FORMULA_0013 0 0.0 0.0 255.0 READ_WRITE ECU_ADDRESS 0x3F9857 /end MEASUREMENT
/begin MEASUREMENT sk_ff.egas_sk_mode "SK-Mode Egas" UBYTE FORMULA_0012 0 0.0 0.0 255.0 READ_WRITE ECU_ADDRESS 0x3F9854 /end MEASUREMENT
/begin MEASUREMENT sk_ff.fail_st_zyl "Ausblender" UWORD FORMULA_0010 0 0.0 0.0 65535.0 READ_WRITE ECU_ADDRESS 0x3F9850 /end MEASUREMENT
/begin MEASUREMENT sk_ff.kupp_ist "Istmoment" SWORD FORMULA_0009 0 0.0 -100.0 1000.0 READ_WRITE ECU_ADDRESS 0x3F984C /end MEASUREMENT
/begin MEASUREMENT sk_ff.kupp_wunsch_ges "Wunschmoment" SWORD FORMULA_0009 0 0.0 -100.0 1000.0 READ_WRITE ECU_ADDRESS 0x3F984A /end MEASUREMENT
/begin MEASUREMENT sk_ff.md_sk_mode "SK-Mode Momentenmanager" UBYTE FORMULA_0012 0 0.0 0.0 255.0 READ_WRITE ECU_ADDRESS 0x3F9855 /end MEASUREMENT
/begin MEASUREMENT sk_ff.n "Drehzahl" SWORD FORMULA_0006 0 0.0 0.0 10000.0 READ_WRITE ECU_ADDRESS 0x3F9844 /end MEASUREMENT
/begin MEASUREMENT sk_ff.os_err_addr "OS-Err: Adresse" ULONG FORMULA_0000 0 0.0 0.0 4294967295.0 READ_WRITE ECU_ADDRESS 0x3F985C /end MEASUREMENT
/begin MEASUREMENT sk_ff.os_err_cnt "OS-Err: Summe" UBYTE FORMULA_0003 0 0.0 0.0 255.0 READ_WRITE ECU_ADDRESS 0x3F9858 /end MEASUREMENT
/begin MEASUREMENT sk_ff.os_err_type "Fehlertyp" UBYTE FORMULA_0014 0 0.0 0.0 255.0 READ_WRITE ECU_ADDRESS 0x3F9859 /end MEASUREMENT
/begin MEASUREMENT sk_ff.proz_err "Prozess-Fehler" UWORD FORMULA_0010 0 0.0 0.0 65535.0 READ_WRITE ECU_ADDRESS 0x3F9860 /end MEASUREMENT
/begin MEASUREMENT sk_ff.pwg_soll "Pedalwert" SWORD FORMULA_0001 0 0.0 -10.0 120.0 READ_WRITE ECU_ADDRESS 0x3F984E /end MEASUREMENT
/begin MEASUREMENT sk_ff.reset_cnt "Resetzaehler" UBYTE FORMULA_0003 0 0.0 0.0 255.0 READ_WRITE ECU_ADDRESS 0x3F985A /end MEASUREMENT
/begin MEASUREMENT sk_ff.rf_m "Fuellung" SWORD FORMULA_0007 0 0.0 0.0 2.0 READ_WRITE ECU_ADDRESS 0x3F9846 /end MEASUREMENT
/begin MEASUREMENT sk_ff.smg_sk_mode "SK-Mode SMG" UBYTE FORMULA_0012 0 0.0 0.0 255.0 READ_WRITE ECU_ADDRESS 0x3F9856 /end MEASUREMENT
/begin MEASUREMENT sk_ff.stufe "SK-Stufe" UBYTE FORMULA_0003 0 0.0 0.0 255.0 READ_WRITE ECU_ADDRESS 0x3F985B /end MEASUREMENT
/begin MEASUREMENT sk_ff.task_err "Task-Fehler" UWORD FORMULA_0010 0 0.0 0.0 65535.0 READ_WRITE ECU_ADDRESS 0x3F9862 /end MEASUREMENT
/begin MEASUREMENT sk_ff.ub "Spannung" SWORD FORMULA_0008 0 0.0 0.0 28.0 READ_WRITE ECU_ADDRESS 0x3F9848 /end MEASUREMENT
/begin MEASUREMENT sk_ff.ursache "Ursache fuer SK-Eingriff" UWORD FORMULA_0011 0 0.0 0.0 65535.0 READ_WRITE ECU_ADDRESS 0x3F9852 /end MEASUREMENT
/begin MEASUREMENT slp_t_aus_nv "Auschalt-SLP rel. Zeit" ULONG FORMULA_0145 0 0.0 0.0 71582788.25 READ_WRITE ECU_ADDRESS 0x3FA7BC /end MEASUREMENT
/begin MEASUREMENT slp_time_on_nv "Laufzeit der SLP" UWORD FORMULA_0071 0 0.0 0.0 6553.5 READ_WRITE ECU_ADDRESS 0x3FA832 /end MEASUREMENT
/begin MEASUREMENT sls_obdh_lam_intg_norm_maxph_nv "Max. Peakhold norm. Lam-Integral der Soll/-Istabweichung" SWORD FORMULA_0570 0 0.0 -1.899999976158142 1.899999976158142 READ_WRITE ECU_ADDRESS 0x3FA85E /end MEASUREMENT
/begin MEASUREMENT sls_obdh_lam_intg_norm_minph_nv "Min. Peakhold Norm. Lam-Integral der Soll/-Istabweichung" SWORD FORMULA_0570 0 0.0 -1.899999976158142 1.899999976158142 READ_WRITE ECU_ADDRESS 0x3FA860 /end MEASUREMENT
/begin MEASUREMENT sls_obdh_lam_intg_norm_nv "Normiertes Lam-Integral der Soll/-Istabweichung" SWORD FORMULA_0570 0 0.0 -1.899999976158142 1.899999976158142 READ_WRITE ECU_ADDRESS 0x3FA858 /end MEASUREMENT
/begin MEASUREMENT sls_obdh_mdf_max_intg_norm_nv "Norm. MDF Max-Integral der Soll/-Istabweichung" SWORD FORMULA_0563 0 0.0 -32.76699829101563 32.76699829101563 READ_WRITE ECU_ADDRESS 0x3FA834 /end MEASUREMENT
/begin MEASUREMENT sls_obdh_mdf_max_intg_norm_ph_nv "Peakhold des norm. MDF Max-Integral der Soll/-Istabweichung" SWORD FORMULA_0563 0 0.0 -32.76699829101563 32.76699829101563 READ_WRITE ECU_ADDRESS 0x3FA85A /end MEASUREMENT
/begin MEASUREMENT sls_obdh_mdf_min_intg_norm_nv "Norm. MDF Min-Integral der Soll/-Istabweichung" SWORD FORMULA_0563 0 0.0 -32.76699829101563 32.76699829101563 READ_WRITE ECU_ADDRESS 0x3FA836 /end MEASUREMENT
/begin MEASUREMENT sls_obdh_mdf_min_intg_norm_ph_nv "Peakhold des norm. MDF Min-Integral der Soll/-Istabweichung" SWORD FORMULA_0563 0 0.0 -32.76699829101563 32.76699829101563 READ_WRITE ECU_ADDRESS 0x3FA85C /end MEASUREMENT
/begin MEASUREMENT smg_ax_10s_mw "Laengsbeschleunigung 10s-Mittelw." SWORD FORMULA_0123 0 0.0 -20.0 20.0 READ_WRITE ECU_ADDRESS 0x3FBC6A /end MEASUREMENT
/begin MEASUREMENT smg_ax_10s_mw_sum "Laengsbeschleunigung 10s-Mittelw." SWORD FORMULA_0123 0 0.0 -20.0 20.0 READ_WRITE ECU_ADDRESS 0x3FBC6C /end MEASUREMENT
/begin MEASUREMENT Snibs "Seriennummer" ULONG FORMULA_0000 0 0.0 0.0 4294967295.0 READ_WRITE ECU_ADDRESS 0x3FC104 /end MEASUREMENT
/begin MEASUREMENT spim_chain_error_nv "SPI Chains Fehler" UBYTE FORMULA_0004 0 0.0 0.0 255.0 READ_WRITE ECU_ADDRESS 0x3F9840 /end MEASUREMENT
/begin MEASUREMENT spim_error_reinit_ctr_nv "SPI-reinits durch Fehlverhalten" UBYTE FORMULA_0003 0 0.0 0.0 255.0 READ_WRITE ECU_ADDRESS 0x3F983F /end MEASUREMENT
/begin MEASUREMENT spim_errorcode_reinit_nv "Errorcode weswegen ein SPI-Reinit ausgefuehrt wurde" UBYTE FORMULA_0002 0 0.0 0.0 255.0 READ_WRITE ECU_ADDRESS 0x3F983E /end MEASUREMENT
/begin MEASUREMENT St_bsd_ktenable "Zustand aktivierte BSD Komponententreiber" UBYTE FORMULA_0003 0 0.0 0.0 255.0 READ_WRITE ECU_ADDRESS 0x3FBD04 /end MEASUREMENT
/begin MEASUREMENT St_bsd_ktenable.B_dev_gen1 "Generator 1 enabled" UBYTE FORMULA_0428 0 0 0.0 255.0 READ_WRITE BIT_MASK 0x20 ECU_ADDRESS 0x3FBD04 /end MEASUREMENT
/begin MEASUREMENT St_bsd_ktenable.B_dev_gen2 "Generator 2 enabled" UBYTE FORMULA_0429 0 0 0.0 255.0 READ_WRITE BIT_MASK 0x40 ECU_ADDRESS 0x3FBD04 /end MEASUREMENT
/begin MEASUREMENT St_bsd_ktenable.B_dev_glrd "Diesel Gluehsteuergeraet enabled" UBYTE FORMULA_0430 0 0 0.0 255.0 READ_WRITE BIT_MASK 0x80 ECU_ADDRESS 0x3FBD04 /end MEASUREMENT
/begin MEASUREMENT St_bsd_ktenable.B_dev_ibs "IBS enabled" UBYTE FORMULA_0423 0 0 0.0 255.0 READ_WRITE BIT_MASK 0x1 ECU_ADDRESS 0x3FBD04 /end MEASUREMENT
/begin MEASUREMENT St_bsd_ktenable.B_dev_oz "Oelzustandssensor/QLT enabled" UBYTE FORMULA_0427 0 0 0.0 255.0 READ_WRITE BIT_MASK 0x10 ECU_ADDRESS 0x3FBD04 /end MEASUREMENT
/begin MEASUREMENT St_bsd_ktenable.B_dev_ozon "Ozonsensor enabled" UBYTE FORMULA_0424 0 0 0.0 255.0 READ_WRITE BIT_MASK 0x2 ECU_ADDRESS 0x3FBD04 /end MEASUREMENT
/begin MEASUREMENT St_bsd_ktenable.B_dev_wapue "Wasserpumpe Elektrik enabled" UBYTE FORMULA_0425 0 0 0.0 255.0 READ_WRITE BIT_MASK 0x4 ECU_ADDRESS 0x3FBD04 /end MEASUREMENT
/begin MEASUREMENT St_bsd_ktenable.B_dev_wapum "Wasserpumpe Motor enabled" UBYTE FORMULA_0426 0 0 0.0 255.0 READ_WRITE BIT_MASK 0x8 ECU_ADDRESS 0x3FBD04 /end MEASUREMENT
/begin MEASUREMENT St_generator "Bitbasis Zustand Generator" UBYTE FORMULA_0003 0 0.0 0.0 255.0 READ_WRITE ECU_ADDRESS 0x3FAEB0 /end MEASUREMENT
/begin MEASUREMENT St_generator.B_crashgen "Crash für Generatorabschaltung" UBYTE FORMULA_0429 0 0 0.0 255.0 READ_WRITE BIT_MASK 0x40 ECU_ADDRESS 0x3FAEB0 /end MEASUREMENT
/begin MEASUREMENT St_generator.B_genactiv "Interface aktiv Generator" UBYTE FORMULA_0423 0 0 0.0 255.0 READ_WRITE BIT_MASK 0x1 ECU_ADDRESS 0x3FAEB0 /end MEASUREMENT
/begin MEASUREMENT St_generator.B_genfbsd "BSD-Fehler Generator" UBYTE FORMULA_0425 0 0 0.0 255.0 READ_WRITE BIT_MASK 0x4 ECU_ADDRESS 0x3FAEB0 /end MEASUREMENT
/begin MEASUREMENT St_generator.B_genfel "Elektrischer Fehler Generator" UBYTE FORMULA_0426 0 0 0.0 255.0 READ_WRITE BIT_MASK 0x8 ECU_ADDRESS 0x3FAEB0 /end MEASUREMENT
/begin MEASUREMENT St_generator.B_genfht "Hohe Temperatur Generator" UBYTE FORMULA_0427 0 0 0.0 255.0 READ_WRITE BIT_MASK 0x10 ECU_ADDRESS 0x3FAEB0 /end MEASUREMENT
/begin MEASUREMENT St_generator.B_genfme "Mechanischer Fehler Generator" UBYTE FORMULA_0428 0 0 0.0 255.0 READ_WRITE BIT_MASK 0x20 ECU_ADDRESS 0x3FAEB0 /end MEASUREMENT
/begin MEASUREMENT St_ibebsd1 "" UBYTE FORMULA_0003 0 0.0 0.0 255.0 READ_WRITE ECU_ADDRESS 0x3FC0B6 /end MEASUREMENT
/begin MEASUREMENT St_ibebsd1.B_eb_busy "Bedingung EBSD Übertragungsrichtung schreiben" UBYTE FORMULA_0426 0 0 0.0 255.0 READ_WRITE BIT_MASK 0x8 ECU_ADDRESS 0x3FC0B6 /end MEASUREMENT
/begin MEASUREMENT St_ibebsd1.B_eb_txok "Bedingung EBSD Übertragungsrichtung schreiben" UBYTE FORMULA_0425 0 0 0.0 255.0 READ_WRITE BIT_MASK 0x4 ECU_ADDRESS 0x3FC0B6 /end MEASUREMENT
/begin MEASUREMENT St_ibebsd1.B_ibs_msgrdy "Bedingung EBSD Botschaft von IBS empfangen" UBYTE FORMULA_0423 0 0 0.0 255.0 READ_WRITE BIT_MASK 0x1 ECU_ADDRESS 0x3FC0B6 /end MEASUREMENT
/begin MEASUREMENT St_ibebsd1.B_ibs_msgwri "Bedingung EBSD Übertragungsrichtung schreiben" UBYTE FORMULA_0424 0 0 0.0 255.0 READ_WRITE BIT_MASK 0x2 ECU_ADDRESS 0x3FC0B6 /end MEASUREMENT
/begin MEASUREMENT St_ibmix "Statuswort ibmix" UBYTE FORMULA_0003 0 0.0 0.0 255.0 READ_WRITE ECU_ADDRESS 0x3FC0B8 /end MEASUREMENT
/begin MEASUREMENT St_ibmix.B_ibrhilo "toggle Bit Register0/ 1 hi- od. lo byte" UBYTE FORMULA_0423 0 0 0.0 255.0 READ_WRITE BIT_MASK 0x1 ECU_ADDRESS 0x3FC0B8 /end MEASUREMENT
/begin MEASUREMENT St_ibmix.B_ibttog "global toggle bit" UBYTE FORMULA_0424 0 0 0.0 255.0 READ_WRITE BIT_MASK 0x2 ECU_ADDRESS 0x3FC0B8 /end MEASUREMENT
/begin MEASUREMENT St_ibserr "Statuswort ibserr" UBYTE FORMULA_0003 0 0.0 0.0 255.0 READ_WRITE ECU_ADDRESS 0x3FC0B7 /end MEASUREMENT
/begin MEASUREMENT St_ibserr.B_ibfbsd "Bedingung BSD Fehler" UBYTE FORMULA_0423 0 0 0.0 255.0 READ_WRITE BIT_MASK 0x1 ECU_ADDRESS 0x3FC0B7 /end MEASUREMENT
/begin MEASUREMENT St_ibserr.B_ibfebsd "Bedingung EBSD Fehler" UBYTE FORMULA_0424 0 0 0.0 255.0 READ_WRITE BIT_MASK 0x2 ECU_ADDRESS 0x3FC0B7 /end MEASUREMENT
/begin MEASUREMENT St_ibserr.B_ibunplau "Bedingung IBS Version unplausibel" UBYTE FORMULA_0425 0 0 0.0 255.0 READ_WRITE BIT_MASK 0x4 ECU_ADDRESS 0x3FC0B7 /end MEASUREMENT
/begin MEASUREMENT St_ibsreg4 "" UBYTE FORMULA_0003 0 0.0 0.0 255.0 READ_WRITE ECU_ADDRESS 0x3FC0AD /end MEASUREMENT
/begin MEASUREMENT St_ibsreg4.B_ibspwf "Bedingung IBS powerfail erkannt" UBYTE FORMULA_0427 0 0 0.0 255.0 READ_WRITE BIT_MASK 0x10 ECU_ADDRESS 0x3FC0AD /end MEASUREMENT
/begin MEASUREMENT St_ibsreg4.B_ibsweck "Bedingung IBS hat geweckt" UBYTE FORMULA_0429 0 0 0.0 255.0 READ_WRITE BIT_MASK 0x40 ECU_ADDRESS 0x3FC0AD /end MEASUREMENT
/begin MEASUREMENT St_ibsreg4.B_startfgk "Bedingung Startfähigkeit gefährdet" UBYTE FORMULA_0423 0 0 0.0 255.0 READ_WRITE BIT_MASK 0x1 ECU_ADDRESS 0x3FC0AD /end MEASUREMENT
/begin MEASUREMENT St_ibsreg4.B_strtaw "Bedingung Startauswertung gerechnet" UBYTE FORMULA_0424 0 0 0.0 255.0 READ_WRITE BIT_MASK 0x2 ECU_ADDRESS 0x3FC0AD /end MEASUREMENT
/begin MEASUREMENT St_ibsreg4.B_tiefset "Bedingung Tiefentladung" UBYTE FORMULA_0428 0 0 0.0 255.0 READ_WRITE BIT_MASK 0x20 ECU_ADDRESS 0x3FC0AD /end MEASUREMENT
/begin MEASUREMENT St_ibsreg5 "Statuswort ibsreg5" UBYTE FORMULA_0003 0 0.0 0.0 255.0 READ_WRITE ECU_ADDRESS 0x3FC0AE /end MEASUREMENT
/begin MEASUREMENT St_ibsreg5.B_fsclr "Bedingung IBS interne Fehler loeschen" UBYTE FORMULA_0426 0 0 0.0 255.0 READ_WRITE BIT_MASK 0x8 ECU_ADDRESS 0x3FC0AE /end MEASUREMENT
/begin MEASUREMENT St_oz "Statuswort mit Biteingangsgroessen OZ" UBYTE FORMULA_0003 0 0.0 0.0 255.0 READ_WRITE ECU_ADDRESS 0x3FAF00 /end MEASUREMENT
/begin MEASUREMENT St_oz.B_anhang "Bedingung Anhänger erkannt" UBYTE FORMULA_0423 0 0 0.0 255.0 READ_WRITE BIT_MASK 0x1 ECU_ADDRESS 0x3FAF00 /end MEASUREMENT
/begin MEASUREMENT St_oz.B_ozfbsd "Bedingung Fehler BSD-Kommunikation" UBYTE FORMULA_0424 0 0 0.0 255.0 READ_WRITE BIT_MASK 0x2 ECU_ADDRESS 0x3FAF00 /end MEASUREMENT
/begin MEASUREMENT St_schnellmsg_check "State Schnellmessung" UBYTE FORMULA_0003 0 0.0 0.0 255.0 READ_WRITE ECU_ADDRESS 0x3FBCC9 /end MEASUREMENT
/begin MEASUREMENT St_sleep "Statuswort Einschlafverhalten" UBYTE FORMULA_0037 0 0.0 0.0 255.0 READ_WRITE ECU_ADDRESS 0x3FC0AC /end MEASUREMENT
/begin MEASUREMENT St_sleep.B_sleepwait "Signal Verzoegerung Sleep Indication" UBYTE FORMULA_0423 0 0 0.0 255.0 READ_WRITE BIT_MASK 0x1 ECU_ADDRESS 0x3FC0AC /end MEASUREMENT
/begin MEASUREMENT stat_data_nrf_nv "Statistik n/rf-Array" ULONG FORMULA_0542 0 0.0 0.0 4294967295.0 READ_WRITE ARRAY_SIZE 56 ECU_ADDRESS 0x3F9654 MATRIX_DIM 56 1 1 /end MEASUREMENT
/begin MEASUREMENT stat_data_tdme_nv "tdme-Statistik ueber ECU-life-time" ULONG FORMULA_0542 0 0.0 0.0 4294967295.0 READ_WRITE ARRAY_SIZE 8 ECU_ADDRESS 0x3F95AC MATRIX_DIM 8 1 1 /end MEASUREMENT
/begin MEASUREMENT stat_data_tmot_nv "tmot-Statistik ueber Motorlaufzeit" ULONG FORMULA_0542 0 0.0 0.0 4294967295.0 READ_WRITE ARRAY_SIZE 8 ECU_ADDRESS 0x3F95CC MATRIX_DIM 8 1 1 /end MEASUREMENT
/begin MEASUREMENT stat_data_toel_nv "toel-Statistik ueber Motorlaufzeit" ULONG FORMULA_0542 0 0.0 0.0 4294967295.0 READ_WRITE ARRAY_SIZE 8 ECU_ADDRESS 0x3F95EC MATRIX_DIM 8 1 1 /end MEASUREMENT
/begin MEASUREMENT syncTaskCtr "Counter" UWORD FORMULA_0010 0 0.0 0.0 65535.0 READ_WRITE ECU_ADDRESS 0x3FBDE6 /end MEASUREMENT
/begin MEASUREMENT sys_exc_addr_nv "Exception-Adresse" ULONG FORMULA_0000 0 0.0 0.0 4294967295.0 READ_WRITE ECU_ADDRESS 0x3F9870 /end MEASUREMENT
/begin MEASUREMENT sys_exc_lr_nv "Exception-Linkregister" ULONG FORMULA_0000 0 0.0 0.0 4294967295.0 READ_WRITE ECU_ADDRESS 0x3F986C /end MEASUREMENT
/begin MEASUREMENT sys_exc_vec_nv "Exception-Vector" UWORD FORMULA_0015 0 0.0 0.0 65535.0 READ_WRITE ECU_ADDRESS 0x3F986A /end MEASUREMENT
/begin MEASUREMENT sys_rsr_cnt_nv.csrs "ChkstopReset" UBYTE FORMULA_0003 0 0.0 0.0 255.0 READ_WRITE ECU_ADDRESS 0x3F9878 /end MEASUREMENT
/begin MEASUREMENT sys_rsr_cnt_nv.dbhrs "DebugHardReset" UBYTE FORMULA_0003 0 0.0 0.0 255.0 READ_WRITE ECU_ADDRESS 0x3F9879 /end MEASUREMENT
/begin MEASUREMENT sys_rsr_cnt_nv.dbsrs "DebugSoftReset" UBYTE FORMULA_0003 0 0.0 0.0 255.0 READ_WRITE ECU_ADDRESS 0x3F987A /end MEASUREMENT
/begin MEASUREMENT sys_rsr_cnt_nv.ehrs "ExtHardReset" UBYTE FORMULA_0003 0 0.0 0.0 255.0 READ_WRITE ECU_ADDRESS 0x3F9874 /end MEASUREMENT
/begin MEASUREMENT sys_rsr_cnt_nv.esrs "ExtSoftReset" UBYTE FORMULA_0003 0 0.0 0.0 255.0 READ_WRITE ECU_ADDRESS 0x3F9875 /end MEASUREMENT
/begin MEASUREMENT sys_rsr_cnt_nv.ghrst "GlitchHPinReset" UBYTE FORMULA_0003 0 0.0 0.0 255.0 READ_WRITE ECU_ADDRESS 0x3F987F /end MEASUREMENT
/begin MEASUREMENT sys_rsr_cnt_nv.gpor "GlitchPowerOnReset" UBYTE FORMULA_0003 0 0.0 0.0 255.0 READ_WRITE ECU_ADDRESS 0x3F987E /end MEASUREMENT
/begin MEASUREMENT sys_rsr_cnt_nv.gsrst "GlitchSPinReset" UBYTE FORMULA_0003 0 0.0 0.0 255.0 READ_WRITE ECU_ADDRESS 0x3F9880 /end MEASUREMENT
/begin MEASUREMENT sys_rsr_cnt_nv.ilbc "IllegalBitChangeReset" UBYTE FORMULA_0003 0 0.0 0.0 255.0 READ_WRITE ECU_ADDRESS 0x3F987D /end MEASUREMENT
/begin MEASUREMENT sys_rsr_cnt_nv.jtrs "JTAGReset" UBYTE FORMULA_0003 0 0.0 0.0 255.0 READ_WRITE ECU_ADDRESS 0x3F987B /end MEASUREMENT
/begin MEASUREMENT sys_rsr_cnt_nv.llrs "LossOfClockReset" UBYTE FORMULA_0003 0 0.0 0.0 255.0 READ_WRITE ECU_ADDRESS 0x3F9876 /end MEASUREMENT
/begin MEASUREMENT sys_rsr_cnt_nv.ocrs "OnChipReset" UBYTE FORMULA_0003 0 0.0 0.0 255.0 READ_WRITE ECU_ADDRESS 0x3F987C /end MEASUREMENT
/begin MEASUREMENT sys_rsr_cnt_nv.swrs "WatchdogReset" UBYTE FORMULA_0003 0 0.0 0.0 255.0 READ_WRITE ECU_ADDRESS 0x3F9877 /end MEASUREMENT
/begin MEASUREMENT sys_zust_cpu_last_max_nv "Maximale CPU Last" UWORD FORMULA_0001 0 0.0 0.0 100.0 READ_WRITE ECU_ADDRESS 0x3F983C /end MEASUREMENT
/begin MEASUREMENT T_batt_ibs "Batterietemperatur" SWORD FORMULA_0431 0 0.0 -3276.800048828125 3276.699951171875 READ_WRITE ECU_ADDRESS 0x3FC0F6 /end MEASUREMENT
/begin MEASUREMENT T_batt_max "Maximale Batt. Temperatur bei Stillstand" SWORD FORMULA_0431 0 0.0 -3276.800048828125 3276.699951171875 READ_WRITE ECU_ADDRESS 0x3FC0F8 /end MEASUREMENT
/begin MEASUREMENT T_batt_min "Minimale Batt. Temperatur bei Stillstand" SWORD FORMULA_0431 0 0.0 -3276.800048828125 3276.699951171875 READ_WRITE ECU_ADDRESS 0x3FC0FA /end MEASUREMENT
/begin MEASUREMENT T_battsoc0 "Batterietemperatur bei Ruhespannungsmessung" SWORD FORMULA_0431 0 0.0 -3276.800048828125 3276.699951171875 READ_WRITE ECU_ADDRESS 0x3FC0DA /end MEASUREMENT
/begin MEASUREMENT T_battsoci "T_battsoc0, Rohwert aus IBS" UBYTE FORMULA_0003 0 0.0 0.0 255.0 READ_WRITE ECU_ADDRESS 0x3FC0C3 /end MEASUREMENT
/begin MEASUREMENT T_jahr "Borddatum" UWORD FORMULA_0010 0 0.0 0.0 65535.0 READ_WRITE ECU_ADDRESS 0x3FBC48 /end MEASUREMENT
/begin MEASUREMENT T_monate "Borddatum" UBYTE FORMULA_0003 0 0.0 0.0 255.0 READ_WRITE ECU_ADDRESS 0x3FBC4B /end MEASUREMENT
/begin MEASUREMENT t_mot_steht_1s_nv "Zeitpunkt sei dem Motor steht" ULONG FORMULA_0542 0 0.0 0.0 4294967295.0 READ_WRITE ECU_ADDRESS 0x3FA7B8 /end MEASUREMENT
/begin MEASUREMENT T1histiruh "Ruhestromhistogramm Klasse 1" UWORD FORMULA_0010 0 0.0 0.0 65535.0 READ_WRITE ECU_ADDRESS 0x3FC0EE /end MEASUREMENT
/begin MEASUREMENT T2histiruh "Ruhestromhistogramm Klasse 2" UWORD FORMULA_0010 0 0.0 0.0 65535.0 READ_WRITE ECU_ADDRESS 0x3FC0F0 /end MEASUREMENT
/begin MEASUREMENT T3histiruh "Ruhestromhistogramm Klasse 3" UWORD FORMULA_0010 0 0.0 0.0 65535.0 READ_WRITE ECU_ADDRESS 0x3FC0F2 /end MEASUREMENT
/begin MEASUREMENT T4histiruh "Ruhestromhistogramm Klasse 4" UWORD FORMULA_0010 0 0.0 0.0 65535.0 READ_WRITE ECU_ADDRESS 0x3FC0F4 /end MEASUREMENT
/begin MEASUREMENT tanzyl_mr_off_nv "Temperaturdifferenz Motorraum zu TMOT." SWORD FORMULA_0074 0 0.0 -1000.0 1000.0 READ_WRITE ECU_ADDRESS 0x3FA816 /end MEASUREMENT
/begin MEASUREMENT tanzyl_off_nv "Temperaturdifferenz TANZYL Modell zu ungefiltert." SWORD FORMULA_0074 0 0.0 -1000.0 1000.0 READ_WRITE ECU_ADDRESS 0x3FA814 /end MEASUREMENT
/begin MEASUREMENT Tbatt_maxi "T_batt_max, Rohwert aus IBS" UBYTE FORMULA_0003 0 0.0 0.0 255.0 READ_WRITE ECU_ADDRESS 0x3FC0C4 /end MEASUREMENT
/begin MEASUREMENT Tbatt_mini "T_batt_min, Rohwert aus IBS" UBYTE FORMULA_0003 0 0.0 0.0 255.0 READ_WRITE ECU_ADDRESS 0x3FC0C5 /end MEASUREMENT
/begin MEASUREMENT Tchip "Chiptemperatur Generator1" SWORD FORMULA_0431 0 0.0 -3276.800048828125 3276.699951171875 READ_WRITE ECU_ADDRESS 0x3FBCA8 /end MEASUREMENT
/begin MEASUREMENT te_obd_crb_cid_b1 "" UBYTE FORMULA_0003 0 0.0 0.0 255.0 READ_WRITE ECU_ADDRESS 0x3FA7F8 /end MEASUREMENT
/begin MEASUREMENT te_obd_crb_cid_b2 "" UBYTE FORMULA_0003 0 0.0 0.0 255.0 READ_WRITE ECU_ADDRESS 0x3FA7F9 /end MEASUREMENT
/begin MEASUREMENT te_obd_crb_grenze_b1 "Prozent" SWORD FORMULA_0022 0 0.0 -200.0 200.0 READ_WRITE ECU_ADDRESS 0x3FA7FE /end MEASUREMENT
/begin MEASUREMENT te_obd_crb_grenze_b2 "Prozent" SWORD FORMULA_0022 0 0.0 -200.0 200.0 READ_WRITE ECU_ADDRESS 0x3FA800 /end MEASUREMENT
/begin MEASUREMENT te_obd_crb_mess_b1 "Prozent" SWORD FORMULA_0022 0 0.0 -200.0 200.0 READ_WRITE ECU_ADDRESS 0x3FA7FA /end MEASUREMENT
/begin MEASUREMENT te_obd_crb_mess_b2 "Prozent" SWORD FORMULA_0022 0 0.0 -200.0 200.0 READ_WRITE ECU_ADDRESS 0x3FA7FC /end MEASUREMENT
/begin MEASUREMENT ti_mks_ns_ist_abstell_b1 "bereits eingetragener Nachstartmasse" UWORD FORMULA_0533 0 0.0 0.0 16383.75 READ_WRITE ECU_ADDRESS 0x3FA746 /end MEASUREMENT
/begin MEASUREMENT ti_mks_ns_ist_abstell_b2 "bereits eingetragener Nachstartmasse" UWORD FORMULA_0533 0 0.0 0.0 16383.75 READ_WRITE ECU_ADDRESS 0x3FA748 /end MEASUREMENT
/begin MEASUREMENT time_abs_old "Absolutzeit seit 1.1.2000 letzter DME-Lauf" UWORD FORMULA_0190 0 0.0 0.0 65535.0 READ_WRITE ECU_ADDRESS 0x3F9738 /end MEASUREMENT
/begin MEASUREMENT time_bz_nv "Betriebszeit der DME" ULONG FORMULA_0542 0 0.0 0.0 4294967295.0 READ_WRITE ECU_ADDRESS 0x3F9564 /end MEASUREMENT
/begin MEASUREMENT time_set_1 "Wiederholzaehler" SWORD FORMULA_0010 0 0.0 -32768.0 32767.0 READ_WRITE ECU_ADDRESS 0x3FBCCA /end MEASUREMENT
/begin MEASUREMENT time_set_2 "Wiederholzaehler" SWORD FORMULA_0010 0 0.0 -32768.0 32767.0 READ_WRITE ECU_ADDRESS 0x3FBCCC /end MEASUREMENT
/begin MEASUREMENT time_set_3 "Wiederholzaehler" SWORD FORMULA_0010 0 0.0 -32768.0 32767.0 READ_WRITE ECU_ADDRESS 0x3FBCCE /end MEASUREMENT
/begin MEASUREMENT time_stamp_kl15_on "Zeitpunkt Schnellmsg. time_kl15_on" ULONG FORMULA_0147 0 0.0 0.0 655.0 READ_WRITE ECU_ADDRESS 0x3FBCD0 /end MEASUREMENT
/begin MEASUREMENT tksm_mr_off_nv "Temperaturdifferenz Motorraum zu TMOT." SWORD FORMULA_0074 0 0.0 -1000.0 1000.0 READ_WRITE ECU_ADDRESS 0x3FA812 /end MEASUREMENT
/begin MEASUREMENT tksm_off_nv "Temperaturdifferenz TKS Modell zu ungefiltert." SWORD FORMULA_0074 0 0.0 -1000.0 1000.0 READ_WRITE ECU_ADDRESS 0x3FA810 /end MEASUREMENT
/begin MEASUREMENT Tlrfgen "Sollwert Load-Response-Zeit, empfangen vom Generator" UBYTE FORMULA_0461 0 0.0 0.0 25.5 READ_WRITE ECU_ADDRESS 0x3FAEB4 /end MEASUREMENT
/begin MEASUREMENT Tlrgen_exd "Sollwert Load-Response Generator (ext. Diagnose)" UBYTE FORMULA_0461 0 0.0 0.0 25.5 READ_WRITE ECU_ADDRESS 0x3FBD0C /end MEASUREMENT
/begin MEASUREMENT tmot_abstell_nv "Abstelltemperatur des Motors" SWORD FORMULA_0023 0 0.0 -50.0 170.0 READ_WRITE ECU_ADDRESS 0x3F8688 /end MEASUREMENT
/begin MEASUREMENT toel_wanne "Oeltemperatur am QLT (Oelwanne)" SWORD FORMULA_0023 0 0.0 -50.0 170.0 READ_WRITE ECU_ADDRESS 0x3F8998 /end MEASUREMENT
/begin MEASUREMENT tpu_kw_err_ff_a.cnt "Abrisszaehler" UBYTE FORMULA_0003 0 0.0 0.0 255.0 READ_WRITE ECU_ADDRESS 0x3F9887 /end MEASUREMENT
/begin MEASUREMENT tpu_kw_err_ff_a.event_time "letzte Ereigniszeit" ULONG FORMULA_0017 0 0.0 0.0 2396.745 READ_WRITE ECU_ADDRESS 0x3F9894 /end MEASUREMENT
/begin MEASUREMENT tpu_kw_err_ff_a.irq "Interruptarten" UBYTE FORMULA_0003 0 0.0 0.0 255.0 READ_WRITE ECU_ADDRESS 0x3F9886 /end MEASUREMENT
/begin MEASUREMENT tpu_kw_err_ff_a.last_period "letzte Zahnperiode" ULONG FORMULA_0017 0 0.0 0.0 2396.745 READ_WRITE ECU_ADDRESS 0x3F9890 /end MEASUREMENT
/begin MEASUREMENT tpu_kw_err_ff_a.n "Abrissdrehzahl" SWORD FORMULA_0006 0 0.0 0.0 10000.0 READ_WRITE ECU_ADDRESS 0x3F9888 /end MEASUREMENT
/begin MEASUREMENT tpu_kw_err_ff_a.n_zahn "Abrisszahndrehzahl" SWORD FORMULA_0006 0 0.0 0.0 10000.0 READ_WRITE ECU_ADDRESS 0x3F988A /end MEASUREMENT
/begin MEASUREMENT tpu_kw_err_ff_a.prev_period "vorletzte Zahnperiode" ULONG FORMULA_0017 0 0.0 0.0 2396.745 READ_WRITE ECU_ADDRESS 0x3F988C /end MEASUREMENT
/begin MEASUREMENT tpu_kw_err_ff_a.state "Zustand der TPU" UBYTE FORMULA_0016 0 0.0 0.0 255.0 READ_WRITE ECU_ADDRESS 0x3F9884 /end MEASUREMENT
/begin MEASUREMENT tpu_kw_err_ff_a.tooth "Abrisszahn" UBYTE FORMULA_0003 0 0.0 0.0 255.0 READ_WRITE ECU_ADDRESS 0x3F9885 /end MEASUREMENT
/begin MEASUREMENT tpu_kw_err_ff_a.tooth_time "letzte Zahnzeit" ULONG FORMULA_0017 0 0.0 0.0 2396.745 READ_WRITE ECU_ADDRESS 0x3F9898 /end MEASUREMENT
/begin MEASUREMENT tpu_kw_err_ff_b.cnt "Abrisszaehler" UBYTE FORMULA_0003 0 0.0 0.0 255.0 READ_WRITE ECU_ADDRESS 0x3F989F /end MEASUREMENT
/begin MEASUREMENT tpu_kw_err_ff_b.event_time "letzte Ereigniszeit" ULONG FORMULA_0017 0 0.0 0.0 2396.745 READ_WRITE ECU_ADDRESS 0x3F98AC /end MEASUREMENT
/begin MEASUREMENT tpu_kw_err_ff_b.irq "Interruptarten" UBYTE FORMULA_0003 0 0.0 0.0 255.0 READ_WRITE ECU_ADDRESS 0x3F989E /end MEASUREMENT
/begin MEASUREMENT tpu_kw_err_ff_b.last_period "letzte Zahnperiode" ULONG FORMULA_0017 0 0.0 0.0 2396.745 READ_WRITE ECU_ADDRESS 0x3F98A8 /end MEASUREMENT
/begin MEASUREMENT tpu_kw_err_ff_b.n "Abrissdrehzahl" SWORD FORMULA_0006 0 0.0 0.0 10000.0 READ_WRITE ECU_ADDRESS 0x3F98A0 /end MEASUREMENT
/begin MEASUREMENT tpu_kw_err_ff_b.n_zahn "Abrisszahndrehzahl" SWORD FORMULA_0006 0 0.0 0.0 10000.0 READ_WRITE ECU_ADDRESS 0x3F98A2 /end MEASUREMENT
/begin MEASUREMENT tpu_kw_err_ff_b.prev_period "vorletzte Zahnperiode" ULONG FORMULA_0017 0 0.0 0.0 2396.745 READ_WRITE ECU_ADDRESS 0x3F98A4 /end MEASUREMENT
/begin MEASUREMENT tpu_kw_err_ff_b.state "Zustand der TPU" UBYTE FORMULA_0016 0 0.0 0.0 255.0 READ_WRITE ECU_ADDRESS 0x3F989C /end MEASUREMENT
/begin MEASUREMENT tpu_kw_err_ff_b.tooth "Abrisszahn" UBYTE FORMULA_0003 0 0.0 0.0 255.0 READ_WRITE ECU_ADDRESS 0x3F989D /end MEASUREMENT
/begin MEASUREMENT tpu_kw_err_ff_b.tooth_time "letzte Zahnzeit" ULONG FORMULA_0017 0 0.0 0.0 2396.745 READ_WRITE ECU_ADDRESS 0x3F98B0 /end MEASUREMENT
/begin MEASUREMENT tpu_kw_irq_info_cnt_nv_a "Anzahl Infointerrupts (+/- ein Zahn)." UBYTE FORMULA_0003 0 0.0 0.0 255.0 READ_WRITE ECU_ADDRESS 0x3F9864 /end MEASUREMENT
/begin MEASUREMENT tpu_kw_irq_info_cnt_nv_b "Anzahl Infointerrupts (+/- ein Zahn)." UBYTE FORMULA_0003 0 0.0 0.0 255.0 READ_WRITE ECU_ADDRESS 0x3F9865 /end MEASUREMENT
/begin MEASUREMENT tpu_kw_n_drop_ff.cnt "Abrisszaehler" UBYTE FORMULA_0003 0 0.0 0.0 255.0 READ_WRITE ECU_ADDRESS 0x3FA81B /end MEASUREMENT
/begin MEASUREMENT tpu_kw_n_drop_ff.event_time "letzte Ereigniszeit" ULONG FORMULA_0017 0 0.0 0.0 2396.745 READ_WRITE ECU_ADDRESS 0x3FA828 /end MEASUREMENT
/begin MEASUREMENT tpu_kw_n_drop_ff.irq "Interruptarten" UBYTE FORMULA_0003 0 0.0 0.0 255.0 READ_WRITE ECU_ADDRESS 0x3FA81A /end MEASUREMENT
/begin MEASUREMENT tpu_kw_n_drop_ff.last_period "letzte Zahnperiode" ULONG FORMULA_0017 0 0.0 0.0 2396.745 READ_WRITE ECU_ADDRESS 0x3FA824 /end MEASUREMENT
/begin MEASUREMENT tpu_kw_n_drop_ff.n "Abrissdrehzahl" SWORD FORMULA_0006 0 0.0 0.0 10000.0 READ_WRITE ECU_ADDRESS 0x3FA81C /end MEASUREMENT
/begin MEASUREMENT tpu_kw_n_drop_ff.n_zahn "Abrisszahndrehzahl" SWORD FORMULA_0006 0 0.0 0.0 10000.0 READ_WRITE ECU_ADDRESS 0x3FA81E /end MEASUREMENT
/begin MEASUREMENT tpu_kw_n_drop_ff.prev_period "vorletzte Zahnperiode" ULONG FORMULA_0017 0 0.0 0.0 2396.745 READ_WRITE ECU_ADDRESS 0x3FA820 /end MEASUREMENT
/begin MEASUREMENT tpu_kw_n_drop_ff.state "Zustand der TPU" UBYTE FORMULA_0016 0 0.0 0.0 255.0 READ_WRITE ECU_ADDRESS 0x3FA818 /end MEASUREMENT
/begin MEASUREMENT tpu_kw_n_drop_ff.tooth "Abrisszahn" UBYTE FORMULA_0003 0 0.0 0.0 255.0 READ_WRITE ECU_ADDRESS 0x3FA819 /end MEASUREMENT
/begin MEASUREMENT tpu_kw_n_drop_ff.tooth_time "letzte Zahnzeit" ULONG FORMULA_0017 0 0.0 0.0 2396.745 READ_WRITE ECU_ADDRESS 0x3FA82C /end MEASUREMENT
/begin MEASUREMENT U_batt "Batteriespannung von IBS gemessen" UWORD FORMULA_0501 0 0.0 6.0 22.38369941711426 READ_WRITE ECU_ADDRESS 0x3FC0CA /end MEASUREMENT
/begin MEASUREMENT U_fgen "Spannung Generator, empfangen vom Generator" UWORD FORMULA_0466 0 0.0 0.0 6553.5 READ_WRITE ECU_ADDRESS 0x3FAEB6 /end MEASUREMENT
/begin MEASUREMENT U_gen_exd "Sollwert Generatorspannung (ext. Diagnose)" UWORD FORMULA_0466 0 0.0 0.0 6553.5 READ_WRITE ECU_ADDRESS 0x3FBD0A /end MEASUREMENT
/begin MEASUREMENT U_gen_slp "Generatorspannungsvorgabe bei SLP-Betrieb" UWORD FORMULA_0466 0 0.0 0.0 6553.5 READ_WRITE ECU_ADDRESS 0x3FBC9A /end MEASUREMENT
/begin MEASUREMENT U_tnstart "Spannung im Start" UWORD FORMULA_0501 0 0.0 6.0 22.38369941711426 READ_WRITE ECU_ADDRESS 0x3FC0E8 /end MEASUREMENT
/begin MEASUREMENT U_vorstart "Spannung vor Start" UWORD FORMULA_0501 0 0.0 6.0 22.38369941711426 READ_WRITE ECU_ADDRESS 0x3FC0E6 /end MEASUREMENT
/begin MEASUREMENT U1soc0 "Ruhespannung 1" UWORD FORMULA_0501 0 0.0 6.0 22.38369941711426 READ_WRITE ECU_ADDRESS 0x3FC0DC /end MEASUREMENT
/begin MEASUREMENT U2soc0 "Ruhespannung 1" UWORD FORMULA_0501 0 0.0 6.0 22.38369941711426 READ_WRITE ECU_ADDRESS 0x3FC0DE /end MEASUREMENT
/begin MEASUREMENT U3soc0 "Ruhespannung 1" UWORD FORMULA_0501 0 0.0 6.0 22.38369941711426 READ_WRITE ECU_ADDRESS 0x3FC0E0 /end MEASUREMENT
/begin MEASUREMENT Unind "EBSD Puffer Index" UBYTE FORMULA_0003 0 0.0 0.0 255.0 READ_WRITE ECU_ADDRESS 0x3FAEC6 /end MEASUREMENT
/begin MEASUREMENT v_max_anh_cnt_nv "Zaehler v_max-Anhebeversuche durch Tester" UBYTE FORMULA_0003 0 0.0 0.0 255.0 READ_WRITE ECU_ADDRESS 0x3F973B /end MEASUREMENT
/begin MEASUREMENT v_max_ff_anh_st "Status v_max-Anhebung durch CAS bzw. BMW-Nachruestung" UBYTE FORMULA_0221 0 0.0 0.0 255.0 READ_WRITE ECU_ADDRESS 0x3F973C /end MEASUREMENT
/begin MEASUREMENT v_max_ff_gang "Istgang" SBYTE FORMULA_0135 0 0.0 -1.0 10.0 READ_WRITE ECU_ADDRESS 0x3F957A /end MEASUREMENT
/begin MEASUREMENT v_max_ff_km_stand "Kilometerstand" ULONG FORMULA_0027 0 0.0 0.0 16777214.0 READ_WRITE ECU_ADDRESS 0x3F9570 /end MEASUREMENT
/begin MEASUREMENT v_max_ff_md_fahrer "Fahrerwunschmoment" SWORD FORMULA_0009 0 0.0 -100.0 1000.0 READ_WRITE ECU_ADDRESS 0x3F9576 /end MEASUREMENT
/begin MEASUREMENT v_max_ff_md_ist "Kupplungs-Istmoment" SWORD FORMULA_0009 0 0.0 -100.0 1000.0 READ_WRITE ECU_ADDRESS 0x3F9578 /end MEASUREMENT
/begin MEASUREMENT v_max_ff_n "Motordrehzahl" SWORD FORMULA_0006 0 0.0 0.0 10000.0 READ_WRITE ECU_ADDRESS 0x3F9574 /end MEASUREMENT
/begin MEASUREMENT v_max_ff_v_direkt "direkt ermittelte Fzgeschw." SWORD FORMULA_0076 0 0.0 -80.0 360.0 READ_WRITE ECU_ADDRESS 0x3F956E /end MEASUREMENT
/begin MEASUREMENT v_max_ff_v_hinten "mittl. Hinterachsgeschw." SWORD FORMULA_0076 0 0.0 -80.0 360.0 READ_WRITE ECU_ADDRESS 0x3F956C /end MEASUREMENT
/begin MEASUREMENT v_max_ff_v_max "Maximalgeschwindigkeit" SWORD FORMULA_0076 0 0.0 -80.0 360.0 READ_WRITE ECU_ADDRESS 0x3F9568 /end MEASUREMENT
/begin MEASUREMENT v_max_ff_v_max_schw "Abregelgeschwindigkeit" SWORD FORMULA_0076 0 0.0 -80.0 360.0 READ_WRITE ECU_ADDRESS 0x3F956A /end MEASUREMENT
/begin MEASUREMENT v_max_ff_v_max_st "Status Maximalgeschwindigkeit" UBYTE FORMULA_0003 0 0.0 0.0 255.0 READ_WRITE ECU_ADDRESS 0x3F957B /end MEASUREMENT
/begin MEASUREMENT van_guete_A1 "Ventil-Guete gefilt., n.v." UWORD FORMULA_0024 0 0.0 0.0 1.999899983406067 READ_WRITE ECU_ADDRESS 0x3FA7CC /end MEASUREMENT
/begin MEASUREMENT van_guete_A2 "Ventil-Guete gefilt., n.v." UWORD FORMULA_0024 0 0.0 0.0 1.999899983406067 READ_WRITE ECU_ADDRESS 0x3FA7D0 /end MEASUREMENT
/begin MEASUREMENT van_guete_E1 "Ventil-Guete gefilt., n.v." UWORD FORMULA_0024 0 0.0 0.0 1.999899983406067 READ_WRITE ECU_ADDRESS 0x3FA7CA /end MEASUREMENT
/begin MEASUREMENT van_guete_E2 "Ventil-Guete gefilt., n.v." UWORD FORMULA_0024 0 0.0 0.0 1.999899983406067 READ_WRITE ECU_ADDRESS 0x3FA7CE /end MEASUREMENT
/begin MEASUREMENT van_ist_anschl_A1 "gemessene Spreizung am Anschlag" SWORD FORMULA_0102 0 0.0 50.0 160.0 READ_WRITE ECU_ADDRESS 0x3FA7C4 /end MEASUREMENT
/begin MEASUREMENT van_ist_anschl_A2 "gemessene Spreizung am Anschlag" SWORD FORMULA_0102 0 0.0 50.0 160.0 READ_WRITE ECU_ADDRESS 0x3FA7C8 /end MEASUREMENT
/begin MEASUREMENT van_ist_anschl_E1 "gemessene Spreizung am Anschlag" SWORD FORMULA_0102 0 0.0 50.0 160.0 READ_WRITE ECU_ADDRESS 0x3FA7C2 /end MEASUREMENT
/begin MEASUREMENT van_ist_anschl_E2 "gemessene Spreizung am Anschlag" SWORD FORMULA_0102 0 0.0 50.0 160.0 READ_WRITE ECU_ADDRESS 0x3FA7C6 /end MEASUREMENT
/begin MEASUREMENT van_st_anschl "Status VanosAnschlag gueltig" UBYTE FORMULA_0003 0 0.0 0.0 255.0 READ_WRITE ECU_ADDRESS 0x3FA7D2 /end MEASUREMENT
/begin MEASUREMENT wf_ist_zyl1 "Wandfilmistmenge" UWORD FORMULA_0534 0 0.0 0.0 2000.0 READ_WRITE ECU_ADDRESS 0x3FA74A /end MEASUREMENT
/begin MEASUREMENT wf_ist_zyl10 "Wandfilmistmenge" UWORD FORMULA_0534 0 0.0 0.0 2000.0 READ_WRITE ECU_ADDRESS 0x3FA75C /end MEASUREMENT
/begin MEASUREMENT wf_ist_zyl2 "Wandfilmistmenge" UWORD FORMULA_0534 0 0.0 0.0 2000.0 READ_WRITE ECU_ADDRESS 0x3FA74C /end MEASUREMENT
/begin MEASUREMENT wf_ist_zyl3 "Wandfilmistmenge" UWORD FORMULA_0534 0 0.0 0.0 2000.0 READ_WRITE ECU_ADDRESS 0x3FA74E /end MEASUREMENT
/begin MEASUREMENT wf_ist_zyl4 "Wandfilmistmenge" UWORD FORMULA_0534 0 0.0 0.0 2000.0 READ_WRITE ECU_ADDRESS 0x3FA750 /end MEASUREMENT
/begin MEASUREMENT wf_ist_zyl5 "Wandfilmistmenge" UWORD FORMULA_0534 0 0.0 0.0 2000.0 READ_WRITE ECU_ADDRESS 0x3FA752 /end MEASUREMENT
/begin MEASUREMENT wf_ist_zyl6 "Wandfilmistmenge" UWORD FORMULA_0534 0 0.0 0.0 2000.0 READ_WRITE ECU_ADDRESS 0x3FA754 /end MEASUREMENT
/begin MEASUREMENT wf_ist_zyl7 "Wandfilmistmenge" UWORD FORMULA_0534 0 0.0 0.0 2000.0 READ_WRITE ECU_ADDRESS 0x3FA756 /end MEASUREMENT
/begin MEASUREMENT wf_ist_zyl8 "Wandfilmistmenge" UWORD FORMULA_0534 0 0.0 0.0 2000.0 READ_WRITE ECU_ADDRESS 0x3FA758 /end MEASUREMENT
/begin MEASUREMENT wf_ist_zyl9 "Wandfilmistmenge" UWORD FORMULA_0534 0 0.0 0.0 2000.0 READ_WRITE ECU_ADDRESS 0x3FA75A /end MEASUREMENT
/begin MEASUREMENT Zbibs "Zusbaunummer" ULONG FORMULA_0000 0 0.0 0.0 4294967295.0 READ_WRITE ECU_ADDRESS 0x3FC100 /end MEASUREMENT
/begin MEASUREMENT zgla_f "Adaptionsfaktor - Zylindergleichstellung" UWORD FORMULA_0024 0 0.0 0.0 1.998999953269959 READ_WRITE ARRAY_SIZE 10 ECU_ADDRESS 0x3FA7A2 MATRIX_DIM 10 1 1 /end MEASUREMENT
/begin MEASUREMENT Zrbosr "Servicezaehler vom Kombi" UBYTE FORMULA_0003 0 0.0 0.0 255.0 READ_WRITE ECU_ADDRESS 0x3FBC36 /end MEASUREMENT
/begin MEASUREMENT Zrbosrt "Servicezaehlerstand vom Tester" UBYTE FORMULA_0003 0 0.0 0.0 255.0 READ_WRITE ECU_ADDRESS 0x3FBC44 /end MEASUREMENT
/begin MEASUREMENT Ztageabs "Tagezaehler vom Kombi " UWORD FORMULA_0010 0 0.0 0.0 65535.0 READ_WRITE ECU_ADDRESS 0x3FBC30 /end MEASUREMENT
/begin COMPU_METHOD FORMULA_0000 "FORMULA_0000" RAT_FUNC "%7.0" "-" COEFFS 0 1 0 0 0 1 /end COMPU_METHOD
/begin COMPU_METHOD FORMULA_0001 "FORMULA_0001" RAT_FUNC "%6.1" "%" COEFFS 0 10.0 0.0 0 0.0 1.0 /end COMPU_METHOD
/begin COMPU_METHOD FORMULA_0002 "FORMULA_0002" TAB_VERB "%3.0" "-" COMPU_TAB_REF FORMULA_0002_VTAB /end COMPU_METHOD
/begin COMPU_METHOD FORMULA_0003 "FORMULA_0003" RAT_FUNC "%3.0" "-" COEFFS 0 1 0 0 0 1 /end COMPU_METHOD
/begin COMPU_METHOD FORMULA_0004 "FORMULA_0004" TAB_VERB "%5.2" "-" COMPU_TAB_REF FORMULA_0004_VTAB /end COMPU_METHOD
/begin COMPU_METHOD FORMULA_0005 "FORMULA_0005" TAB_VERB "%5.2" "-" COMPU_TAB_REF FORMULA_0005_VTAB /end COMPU_METHOD
/begin COMPU_METHOD FORMULA_0006 "FORMULA_0006" RAT_FUNC "%5.0" "Upm" COEFFS 0 1 0 0 0 1 /end COMPU_METHOD
/begin COMPU_METHOD FORMULA_0007 "FORMULA_0007" RAT_FUNC "%8.3" "-" COEFFS 0 10000.0 0.0 0 0.0 1.0 /end COMPU_METHOD
/begin COMPU_METHOD FORMULA_0008 "FORMULA_0008" RAT_FUNC "%6.1" "V" COEFFS 0 10.0 0.0 0 0.0 1.0 /end COMPU_METHOD
/begin COMPU_METHOD FORMULA_0009 "FORMULA_0009" RAT_FUNC "%6.1" "Nm" COEFFS 0 10.0 0.0 0 0.0 1.0 /end COMPU_METHOD
/begin COMPU_METHOD FORMULA_0010 "FORMULA_0010" RAT_FUNC "%5.0" "-" COEFFS 0 1 0 0 0 1 /end COMPU_METHOD
/begin COMPU_METHOD FORMULA_0011 "FORMULA_0011" TAB_VERB "%5.0" "-" COMPU_TAB_REF FORMULA_0011_VTAB /end COMPU_METHOD
/begin COMPU_METHOD FORMULA_0012 "FORMULA_0012" TAB_VERB "%3.0" "-" COMPU_TAB_REF FORMULA_0012_VTAB /end COMPU_METHOD
/begin COMPU_METHOD FORMULA_0013 "FORMULA_0013" TAB_VERB "%3.0" "-" COMPU_TAB_REF FORMULA_0013_VTAB /end COMPU_METHOD
/begin COMPU_METHOD FORMULA_0014 "FORMULA_0014" TAB_VERB "%3.0" "-" COMPU_TAB_REF FORMULA_0014_VTAB /end COMPU_METHOD
/begin COMPU_METHOD FORMULA_0015 "FORMULA_0015" TAB_VERB "%5.0" "-" COMPU_TAB_REF FORMULA_0015_VTAB /end COMPU_METHOD
/begin COMPU_METHOD FORMULA_0016 "FORMULA_0016" TAB_VERB "%3.0" "-" COMPU_TAB_REF FORMULA_0016_VTAB /end COMPU_METHOD
/begin COMPU_METHOD FORMULA_0017 "FORMULA_0017" RAT_FUNC "%9.2" "ms" COEFFS 0 7000.0 0.0 0 0.0 1.0 /end COMPU_METHOD
/begin COMPU_METHOD FORMULA_0018 "FORMULA_0018" RAT_FUNC "%5.0" "us" COEFFS 0 1 0 0 0 1 /end COMPU_METHOD
/begin COMPU_METHOD FORMULA_0019 "FORMULA_0019" TAB_VERB "%7.2" "-" COMPU_TAB_REF FORMULA_0019_VTAB /end COMPU_METHOD
/begin COMPU_METHOD FORMULA_0020 "FORMULA_0020" RAT_FUNC "%5.0" "qmm/s" COEFFS 0 5.e-002 0.0 0 0.0 1.0 /end COMPU_METHOD
/begin COMPU_METHOD FORMULA_0021 "FORMULA_0021" RAT_FUNC "%7.2" "s" COEFFS 0 100.0 0.0 0 0.0 1.0 /end COMPU_METHOD
/begin COMPU_METHOD FORMULA_0022 "FORMULA_0022" RAT_FUNC "%7.2" "%" COEFFS 0 100.0 0.0 0 0.0 1.0 /end COMPU_METHOD
/begin COMPU_METHOD FORMULA_0023 "FORMULA_0023" RAT_FUNC "%6.1" "°C" COEFFS 0 10.0 2732.0 0 0.0 1.0 /end COMPU_METHOD
/begin COMPU_METHOD FORMULA_0024 "FORMULA_0024" RAT_FUNC "%9.4" "-" COEFFS 0 32768.0 0.0 0 0.0 1.0 /end COMPU_METHOD
/begin COMPU_METHOD FORMULA_0025 "FORMULA_0025" RAT_FUNC "%8.3" "-" COEFFS 0 16384.0 0.0 0 0.0 1.0 /end COMPU_METHOD
/begin COMPU_METHOD FORMULA_0026 "FORMULA_0026" TAB_VERB "%3.0" "-" COMPU_TAB_REF FORMULA_0026_VTAB /end COMPU_METHOD
/begin COMPU_METHOD FORMULA_0027 "FORMULA_0027" RAT_FUNC "%7.0" "km" COEFFS 0 1 0 0 0 1 /end COMPU_METHOD
/begin COMPU_METHOD FORMULA_0028 "FORMULA_0028" TAB_VERB "%3.0" "-" COMPU_TAB_REF FORMULA_0028_VTAB /end COMPU_METHOD
/begin COMPU_METHOD FORMULA_0029 "FORMULA_0029" TAB_VERB "%3.0" "-" COMPU_TAB_REF FORMULA_0029_VTAB /end COMPU_METHOD
/begin COMPU_METHOD FORMULA_0030 "FORMULA_0030" TAB_VERB "%3.0" "-" COMPU_TAB_REF FORMULA_0030_VTAB /end COMPU_METHOD
/begin COMPU_METHOD FORMULA_0031 "FORMULA_0031" TAB_VERB "%3.0" "-" COMPU_TAB_REF FORMULA_0031_VTAB /end COMPU_METHOD
/begin COMPU_METHOD FORMULA_0032 "FORMULA_0032" RAT_FUNC "%3.0" "%" COEFFS 0 1 0 0 0 1 /end COMPU_METHOD
/begin COMPU_METHOD FORMULA_0033 "FORMULA_0033" TAB_VERB "%3.0" "-" COMPU_TAB_REF FORMULA_0033_VTAB /end COMPU_METHOD
/begin COMPU_METHOD FORMULA_0034 "FORMULA_0034" TAB_VERB "%3.0" "-" COMPU_TAB_REF FORMULA_0034_VTAB /end COMPU_METHOD
/begin COMPU_METHOD FORMULA_0035 "FORMULA_0035" TAB_VERB "%3.0" "-" COMPU_TAB_REF FORMULA_0035_VTAB /end COMPU_METHOD
/begin COMPU_METHOD FORMULA_0036 "FORMULA_0036" TAB_VERB "%3.0" "-" COMPU_TAB_REF FORMULA_0036_VTAB /end COMPU_METHOD
/begin COMPU_METHOD FORMULA_0037 "FORMULA_0037" RAT_FUNC "%5.2" "-" COEFFS 0 1 0 0 0 1 /end COMPU_METHOD
/begin COMPU_METHOD FORMULA_0038 "FORMULA_0038" TAB_VERB "%5.2" "-" COMPU_TAB_REF FORMULA_0038_VTAB /end COMPU_METHOD
/begin COMPU_METHOD FORMULA_0039 "FORMULA_0039" TAB_VERB "%5.2" "-" COMPU_TAB_REF FORMULA_0039_VTAB /end COMPU_METHOD
/begin COMPU_METHOD FORMULA_0040 "FORMULA_0040" TAB_VERB "%5.2" "-" COMPU_TAB_REF FORMULA_0040_VTAB /end COMPU_METHOD
/begin COMPU_METHOD FORMULA_0041 "FORMULA_0041" TAB_VERB "%5.2" "-" COMPU_TAB_REF FORMULA_0041_VTAB /end COMPU_METHOD
/begin COMPU_METHOD FORMULA_0042 "FORMULA_0042" TAB_VERB "%3.0" "-" COMPU_TAB_REF FORMULA_0042_VTAB /end COMPU_METHOD
/begin COMPU_METHOD FORMULA_0043 "FORMULA_0043" TAB_VERB "%3.0" "-" COMPU_TAB_REF FORMULA_0043_VTAB /end COMPU_METHOD
/begin COMPU_METHOD FORMULA_0044 "FORMULA_0044" RAT_FUNC "%9.2" "-" COEFFS 0 1 0 0 0 1 /end COMPU_METHOD
/begin COMPU_METHOD FORMULA_0071 "FORMULA_0071" RAT_FUNC "%6.1" "s" COEFFS 0 10.0 0.0 0 0.0 1.0 /end COMPU_METHOD
/begin COMPU_METHOD FORMULA_0072 "FORMULA_0072" RAT_FUNC "%7.0" "us" COEFFS 0 1 0 0 0 1 /end COMPU_METHOD
/begin COMPU_METHOD FORMULA_0073 "FORMULA_0073" RAT_FUNC "%8.3" "-" COEFFS 0 1024.0 0.0 0 0.0 1.0 /end COMPU_METHOD
/begin COMPU_METHOD FORMULA_0074 "FORMULA_0074" RAT_FUNC "%6.1" "Kelvin" COEFFS 0 10.0 0.0 0 0.0 1.0 /end COMPU_METHOD
/begin COMPU_METHOD FORMULA_0075 "FORMULA_0075" RAT_FUNC "%6.1" "mbar" COEFFS 0 16.0 0.0 0 0.0 1.0 /end COMPU_METHOD
/begin COMPU_METHOD FORMULA_0076 "FORMULA_0076" RAT_FUNC "%6.1" "km/h" COEFFS 0 16.0 0.0 0 0.0 1.0 /end COMPU_METHOD
/begin COMPU_METHOD FORMULA_0080 "FORMULA_0080" RAT_FUNC "%7.2" "-" COEFFS 0 1 0 0 0 1 /end COMPU_METHOD
/begin COMPU_METHOD FORMULA_0102 "FORMULA_0102" RAT_FUNC "%6.1" "°KW" COEFFS 0 10.0 0.0 0 0.0 1.0 /end COMPU_METHOD
/begin COMPU_METHOD FORMULA_0103 "FORMULA_0103" RAT_FUNC "%6.1" "kg/h" COEFFS 0 10.0 0.0 0 0.0 1.0 /end COMPU_METHOD
/begin COMPU_METHOD FORMULA_0105 "FORMULA_0105" RAT_FUNC "%5.0" "Upm/s" COEFFS 0 1 0 0 0 1 /end COMPU_METHOD
/begin COMPU_METHOD FORMULA_0123 "FORMULA_0123" RAT_FUNC "%7.2" "m/(s*s)" COEFFS 0 40.0 0.0 0 0.0 1.0 /end COMPU_METHOD
/begin COMPU_METHOD FORMULA_0135 "FORMULA_0135" RAT_FUNC "%3.0" ".Gang" COEFFS 0 1 0 0 0 1 /end COMPU_METHOD
/begin COMPU_METHOD FORMULA_0145 "FORMULA_0145" RAT_FUNC "%9.2" "min" COEFFS 0 60.0 0.0 0 0.0 1.0 /end COMPU_METHOD
/begin COMPU_METHOD FORMULA_0147 "FORMULA_0147" RAT_FUNC "%9.2" "s" COEFFS 0 100.0 0.0 0 0.0 1.0 /end COMPU_METHOD
/begin COMPU_METHOD FORMULA_0190 "FORMULA_0190" RAT_FUNC "%5.0" "Tage" COEFFS 0 1 0 0 0 1 /end COMPU_METHOD
/begin COMPU_METHOD FORMULA_0200 "FORMULA_0200" TAB_VERB "%5.2" "-" COMPU_TAB_REF FORMULA_0200_VTAB /end COMPU_METHOD
/begin COMPU_METHOD FORMULA_0201 "FORMULA_0201" TAB_VERB "%5.2" "-" COMPU_TAB_REF FORMULA_0201_VTAB /end COMPU_METHOD
/begin COMPU_METHOD FORMULA_0202 "FORMULA_0202" TAB_VERB "%5.2" "-" COMPU_TAB_REF FORMULA_0202_VTAB /end COMPU_METHOD
/begin COMPU_METHOD FORMULA_0203 "FORMULA_0203" TAB_VERB "%5.2" "-" COMPU_TAB_REF FORMULA_0203_VTAB /end COMPU_METHOD
/begin COMPU_METHOD FORMULA_0207 "FORMULA_0207" TAB_VERB "%5.2" "-" COMPU_TAB_REF FORMULA_0207_VTAB /end COMPU_METHOD
/begin COMPU_METHOD FORMULA_0215 "FORMULA_0215" TAB_VERB "%3.0" "-" COMPU_TAB_REF FORMULA_0215_VTAB /end COMPU_METHOD
/begin COMPU_METHOD FORMULA_0216 "FORMULA_0216" TAB_VERB "%3.0" "-" COMPU_TAB_REF FORMULA_0216_VTAB /end COMPU_METHOD
/begin COMPU_METHOD FORMULA_0217 "FORMULA_0217" TAB_VERB "%3.0" "-" COMPU_TAB_REF FORMULA_0217_VTAB /end COMPU_METHOD
/begin COMPU_METHOD FORMULA_0218 "FORMULA_0218" TAB_VERB "%3.0" "-" COMPU_TAB_REF FORMULA_0218_VTAB /end COMPU_METHOD
/begin COMPU_METHOD FORMULA_0219 "FORMULA_0219" TAB_VERB "%3.0" "-" COMPU_TAB_REF FORMULA_0219_VTAB /end COMPU_METHOD
/begin COMPU_METHOD FORMULA_0220 "FORMULA_0220" TAB_VERB "%3.0" "-" COMPU_TAB_REF FORMULA_0220_VTAB /end COMPU_METHOD
/begin COMPU_METHOD FORMULA_0221 "FORMULA_0221" TAB_VERB "%3.0" "-" COMPU_TAB_REF FORMULA_0221_VTAB /end COMPU_METHOD
/begin COMPU_METHOD FORMULA_0298 "FORMULA_0298" TAB_VERB "%5.2" "-" COMPU_TAB_REF FORMULA_0298_VTAB /end COMPU_METHOD
/begin COMPU_METHOD FORMULA_0355 "FORMULA_0355" TAB_VERB "%3.0" "-" COMPU_TAB_REF FORMULA_0355_VTAB /end COMPU_METHOD
/begin COMPU_METHOD FORMULA_0356 "FORMULA_0356" TAB_VERB "%3.0" "-" COMPU_TAB_REF FORMULA_0356_VTAB /end COMPU_METHOD
/begin COMPU_METHOD FORMULA_0408 "FORMULA_0408" RAT_FUNC "%3.0" "-" COEFFS 0 1.0 -1.0 0 0.0 1.0 /end COMPU_METHOD
/begin COMPU_METHOD FORMULA_0419 "FORMULA_0419" TAB_VERB "%3.0" "-" COMPU_TAB_REF FORMULA_0419_VTAB /end COMPU_METHOD
/begin COMPU_METHOD FORMULA_0423 "FORMULA_0423" TAB_VERB "%5.2" "-" COMPU_TAB_REF FORMULA_0423_VTAB /end COMPU_METHOD
/begin COMPU_METHOD FORMULA_0424 "FORMULA_0424" TAB_VERB "%5.2" "-" COMPU_TAB_REF FORMULA_0424_VTAB /end COMPU_METHOD
/begin COMPU_METHOD FORMULA_0425 "FORMULA_0425" TAB_VERB "%5.2" "-" COMPU_TAB_REF FORMULA_0425_VTAB /end COMPU_METHOD
/begin COMPU_METHOD FORMULA_0426 "FORMULA_0426" TAB_VERB "%5.2" "-" COMPU_TAB_REF FORMULA_0426_VTAB /end COMPU_METHOD
/begin COMPU_METHOD FORMULA_0427 "FORMULA_0427" TAB_VERB "%5.2" "-" COMPU_TAB_REF FORMULA_0427_VTAB /end COMPU_METHOD
/begin COMPU_METHOD FORMULA_0428 "FORMULA_0428" TAB_VERB "%5.2" "-" COMPU_TAB_REF FORMULA_0428_VTAB /end COMPU_METHOD
/begin COMPU_METHOD FORMULA_0429 "FORMULA_0429" TAB_VERB "%5.2" "-" COMPU_TAB_REF FORMULA_0429_VTAB /end COMPU_METHOD
/begin COMPU_METHOD FORMULA_0430 "FORMULA_0430" TAB_VERB "%5.2" "-" COMPU_TAB_REF FORMULA_0430_VTAB /end COMPU_METHOD
/begin COMPU_METHOD FORMULA_0431 "FORMULA_0431" RAT_FUNC "%5.0" "°C" COEFFS 0 10.0 0.0 0 0.0 1.0 /end COMPU_METHOD
/begin COMPU_METHOD FORMULA_0436 "FORMULA_0436" RAT_FUNC "%5.2" "mm" COEFFS 0 3.413333333333334 0.0 0 0.0 1.0 /end COMPU_METHOD
/begin COMPU_METHOD FORMULA_0438 "FORMULA_0438" RAT_FUNC "%5.2" "Liter" COEFFS 0 10.0 0.0 0 0.0 1.0 /end COMPU_METHOD
/begin COMPU_METHOD FORMULA_0440 "FORMULA_0440" RAT_FUNC "%7.2" "min" COEFFS 0 1 0 0 0 1 /end COMPU_METHOD
/begin COMPU_METHOD FORMULA_0448 "FORMULA_0448" RAT_FUNC "%4.1" "-" COEFFS 0 4.0 0.0 0 0.0 1.0 /end COMPU_METHOD
/begin COMPU_METHOD FORMULA_0451 "FORMULA_0451" RAT_FUNC "%7.2" "mm" COEFFS 0 3.413333333333334 0.0 0 0.0 1.0 /end COMPU_METHOD
/begin COMPU_METHOD FORMULA_0456 "FORMULA_0456" RAT_FUNC "%9.4" "-" COEFFS 0 1024.0 0.0 0 0.0 1.0 /end COMPU_METHOD
/begin COMPU_METHOD FORMULA_0461 "FORMULA_0461" RAT_FUNC "%4.1" "s" COEFFS 0 10.0 0.0 0 0.0 1.0 /end COMPU_METHOD
/begin COMPU_METHOD FORMULA_0464 "FORMULA_0464" RAT_FUNC "%6.3" "A" COEFFS 0 8.0 0.0 0 0.0 1.0 /end COMPU_METHOD
/begin COMPU_METHOD FORMULA_0466 "FORMULA_0466" RAT_FUNC "%8.3" "V" COEFFS 0 10.0 0.0 0 0.0 1.0 /end COMPU_METHOD
/begin COMPU_METHOD FORMULA_0475 "FORMULA_0475" RAT_FUNC "%5.2" "%" COEFFS 0 2.56 0.0 0 0.0 1.0 /end COMPU_METHOD
/begin COMPU_METHOD FORMULA_0476 "FORMULA_0476" RAT_FUNC "%5.2" "min" COEFFS 0 1 0 0 0 1 /end COMPU_METHOD
/begin COMPU_METHOD FORMULA_0487 "FORMULA_0487" RAT_FUNC "%4.1" "-" COEFFS 0 1 0 0 0 1 /end COMPU_METHOD
/begin COMPU_METHOD FORMULA_0498 "FORMULA_0498" RAT_FUNC "%8.3" "Ah" COEFFS 0 54.94444444444444 0.0 0 0.0 1.0 /end COMPU_METHOD
/begin COMPU_METHOD FORMULA_0501 "FORMULA_0501" RAT_FUNC "%8.3" "" COEFFS 0 4000.0 -24000.0 0 0.0 1.0 /end COMPU_METHOD
/begin COMPU_METHOD FORMULA_0502 "FORMULA_0502" RAT_FUNC "%5.2" "" COEFFS 0 0.1953125 0.0 0 0.0 1.0 /end COMPU_METHOD
/begin COMPU_METHOD FORMULA_0508 "FORMULA_0508" RAT_FUNC "%8.3" "" COEFFS 0 12.5 2500.0 0 0.0 1.0 /end COMPU_METHOD
/begin COMPU_METHOD FORMULA_0511 "FORMULA_0511" RAT_FUNC "%8.3" "A" COEFFS 0 50.0 0.0 0 0.0 1.0 /end COMPU_METHOD
/begin COMPU_METHOD FORMULA_0515 "FORMULA_0515" RAT_FUNC "%8.3" "A" COEFFS 0 50.0 0.0 0 0.0 1.0 /end COMPU_METHOD
/begin COMPU_METHOD FORMULA_0517 "FORMULA_0517" TAB_VERB "%3.0" "-" COMPU_TAB_REF FORMULA_0517_VTAB /end COMPU_METHOD
/begin COMPU_METHOD FORMULA_0518 "FORMULA_0518" TAB_VERB "%7.0" "-" COMPU_TAB_REF FORMULA_0518_VTAB /end COMPU_METHOD
/begin COMPU_METHOD FORMULA_0519 "FORMULA_0519" TAB_VERB "%7.0" "-" COMPU_TAB_REF FORMULA_0519_VTAB /end COMPU_METHOD
/begin COMPU_METHOD FORMULA_0520 "FORMULA_0520" TAB_VERB "%7.0" "-" COMPU_TAB_REF FORMULA_0520_VTAB /end COMPU_METHOD
/begin COMPU_METHOD FORMULA_0521 "FORMULA_0521" TAB_VERB "%7.0" "-" COMPU_TAB_REF FORMULA_0521_VTAB /end COMPU_METHOD
/begin COMPU_METHOD FORMULA_0522 "FORMULA_0522" TAB_VERB "%7.0" "-" COMPU_TAB_REF FORMULA_0522_VTAB /end COMPU_METHOD
/begin COMPU_METHOD FORMULA_0523 "FORMULA_0523" TAB_VERB "%7.0" "-" COMPU_TAB_REF FORMULA_0523_VTAB /end COMPU_METHOD
/begin COMPU_METHOD FORMULA_0524 "FORMULA_0524" TAB_VERB "%7.0" "-" COMPU_TAB_REF FORMULA_0524_VTAB /end COMPU_METHOD
/begin COMPU_METHOD FORMULA_0525 "FORMULA_0525" TAB_VERB "%7.0" "-" COMPU_TAB_REF FORMULA_0525_VTAB /end COMPU_METHOD
/begin COMPU_METHOD FORMULA_0526 "FORMULA_0526" TAB_VERB "%7.0" "-" COMPU_TAB_REF FORMULA_0526_VTAB /end COMPU_METHOD
/begin COMPU_METHOD FORMULA_0527 "FORMULA_0527" TAB_VERB "%7.0" "-" COMPU_TAB_REF FORMULA_0527_VTAB /end COMPU_METHOD
/begin COMPU_METHOD FORMULA_0528 "FORMULA_0528" TAB_VERB "%7.0" "-" COMPU_TAB_REF FORMULA_0528_VTAB /end COMPU_METHOD
/begin COMPU_METHOD FORMULA_0529 "FORMULA_0529" TAB_VERB "%7.0" "-" COMPU_TAB_REF FORMULA_0529_VTAB /end COMPU_METHOD
/begin COMPU_METHOD FORMULA_0530 "FORMULA_0530" TAB_VERB "%7.0" "-" COMPU_TAB_REF FORMULA_0530_VTAB /end COMPU_METHOD
/begin COMPU_METHOD FORMULA_0531 "FORMULA_0531" TAB_VERB "%3.0" "-" COMPU_TAB_REF FORMULA_0531_VTAB /end COMPU_METHOD
/begin COMPU_METHOD FORMULA_0532 "FORMULA_0532" TAB_VERB "%5.2" "-" COMPU_TAB_REF FORMULA_0532_VTAB /end COMPU_METHOD
/begin COMPU_METHOD FORMULA_0533 "FORMULA_0533" RAT_FUNC "%7.2" "mg" COEFFS 0 4.0 0.0 0 0.0 1.0 /end COMPU_METHOD
/begin COMPU_METHOD FORMULA_0534 "FORMULA_0534" RAT_FUNC "%7.2" "mg" COEFFS 0 32.0 0.0 0 0.0 1.0 /end COMPU_METHOD
/begin COMPU_METHOD FORMULA_0535 "FORMULA_0535" RAT_FUNC "%8.3" "mg/ASP" COEFFS 0 64.0 0.0 0 0.0 1.0 /end COMPU_METHOD
/begin COMPU_METHOD FORMULA_0536 "FORMULA_0536" RAT_FUNC "%5.0" "mV" COEFFS 0 0.2048 0.0 0 0.0 1.0 /end COMPU_METHOD
/begin COMPU_METHOD FORMULA_0537 "FORMULA_0537" TAB_VERB "%7.2" "-" COMPU_TAB_REF FORMULA_0537_VTAB /end COMPU_METHOD
/begin COMPU_METHOD FORMULA_0538 "FORMULA_0538" TAB_VERB "%7.2" "-" COMPU_TAB_REF FORMULA_0538_VTAB /end COMPU_METHOD
/begin COMPU_METHOD FORMULA_0539 "FORMULA_0539" TAB_VERB "%7.2" "-" COMPU_TAB_REF FORMULA_0539_VTAB /end COMPU_METHOD
/begin COMPU_METHOD FORMULA_0540 "FORMULA_0540" TAB_VERB "%7.2" "-" COMPU_TAB_REF FORMULA_0540_VTAB /end COMPU_METHOD
/begin COMPU_METHOD FORMULA_0541 "FORMULA_0541" RAT_FUNC "%6.1" "Ohm" COEFFS 0 10.0 0.0 0 0.0 1.0 /end COMPU_METHOD
/begin COMPU_METHOD FORMULA_0542 "FORMULA_0542" RAT_FUNC "%7.0" "s" COEFFS 0 1 0 0 0 1 /end COMPU_METHOD
/begin COMPU_METHOD FORMULA_0543 "FORMULA_0543" RAT_FUNC "%5.0" "%" COEFFS 0 1 0 0 0 1 /end COMPU_METHOD
/begin COMPU_METHOD FORMULA_0544 "FORMULA_0544" TAB_VERB "%5.2" "-" COMPU_TAB_REF FORMULA_0544_VTAB /end COMPU_METHOD
/begin COMPU_METHOD FORMULA_0545 "FORMULA_0545" RAT_FUNC "%3.0" "Diags" COEFFS 0 1 0 0 0 1 /end COMPU_METHOD
/begin COMPU_METHOD FORMULA_0546 "FORMULA_0546" RAT_FUNC "%5.0" "Diags" COEFFS 0 1 0 0 0 1 /end COMPU_METHOD
/begin COMPU_METHOD FORMULA_0547 "FORMULA_0547" TAB_VERB "%5.2" "-" COMPU_TAB_REF FORMULA_0547_VTAB /end COMPU_METHOD
/begin COMPU_METHOD FORMULA_0548 "FORMULA_0548" TAB_VERB "%5.2" "-" COMPU_TAB_REF FORMULA_0548_VTAB /end COMPU_METHOD
/begin COMPU_METHOD FORMULA_0549 "FORMULA_0549" TAB_VERB "%5.2" "-" COMPU_TAB_REF FORMULA_0549_VTAB /end COMPU_METHOD
/begin COMPU_METHOD FORMULA_0550 "FORMULA_0550" TAB_VERB "%5.2" "-" COMPU_TAB_REF FORMULA_0550_VTAB /end COMPU_METHOD
/begin COMPU_METHOD FORMULA_0551 "FORMULA_0551" TAB_VERB "%5.2" "-" COMPU_TAB_REF FORMULA_0551_VTAB /end COMPU_METHOD
/begin COMPU_METHOD FORMULA_0552 "FORMULA_0552" TAB_VERB "%5.2" "-" COMPU_TAB_REF FORMULA_0552_VTAB /end COMPU_METHOD
/begin COMPU_METHOD FORMULA_0553 "FORMULA_0553" RAT_FUNC "%7.2" "mA" COEFFS 0 444.4444444444445 0.0 0 0.0 1.0 /end COMPU_METHOD
/begin COMPU_METHOD FORMULA_0554 "FORMULA_0554" RAT_FUNC "%7.2" "uA" COEFFS 0 7281.777777777777 0.0 0 0.0 1.0 /end COMPU_METHOD
/begin COMPU_METHOD FORMULA_0555 "FORMULA_0555" TAB_VERB "%5.2" "-" COMPU_TAB_REF FORMULA_0555_VTAB /end COMPU_METHOD
/begin COMPU_METHOD FORMULA_0556 "FORMULA_0556" RAT_FUNC "%5.0" "min" COEFFS 0 1 0 0 0 1 /end COMPU_METHOD
/begin COMPU_METHOD FORMULA_0557 "FORMULA_0557" RAT_FUNC "%8.3" "%" COEFFS 0 327.68 0.0 0 0.0 1.0 /end COMPU_METHOD
/begin COMPU_METHOD FORMULA_0558 "FORMULA_0558" RAT_FUNC "%9.4" "-" COEFFS 0 10000.0 0.0 0 0.0 1.0 /end COMPU_METHOD
/begin COMPU_METHOD FORMULA_0559 "FORMULA_0559" RAT_FUNC "%4.1" "l" COEFFS 0 2.0 0.0 0 0.0 1.0 /end COMPU_METHOD
/begin COMPU_METHOD FORMULA_0560 "FORMULA_0560" RAT_FUNC "%6.3" "l" COEFFS 0 512.0 0.0 0 0.0 1.0 /end COMPU_METHOD
/begin COMPU_METHOD FORMULA_0561 "FORMULA_0561" RAT_FUNC "%8.3" "L" COEFFS 0 976.5625 0.0 0 0.0 1.0 /end COMPU_METHOD
/begin COMPU_METHOD FORMULA_0562 "FORMULA_0562" TAB_VERB "%5.2" "-" COMPU_TAB_REF FORMULA_0562_VTAB /end COMPU_METHOD
/begin COMPU_METHOD FORMULA_0563 "FORMULA_0563" RAT_FUNC "%8.3" "kg/h" COEFFS 0 1000.0 0.0 0 0.0 1.0 /end COMPU_METHOD
/begin COMPU_METHOD FORMULA_0564 "FORMULA_0564" RAT_FUNC "%6.1" "kg*5ms/h" COEFFS 0 10.0 0.0 0 0.0 1.0 /end COMPU_METHOD
/begin COMPU_METHOD FORMULA_0565 "FORMULA_0565" TAB_VERB "%5.2" "-" COMPU_TAB_REF FORMULA_0565_VTAB /end COMPU_METHOD
/begin COMPU_METHOD FORMULA_0566 "FORMULA_0566" TAB_VERB "%5.2" "-" COMPU_TAB_REF FORMULA_0566_VTAB /end COMPU_METHOD
/begin COMPU_METHOD FORMULA_0567 "FORMULA_0567" TAB_VERB "%5.2" "-" COMPU_TAB_REF FORMULA_0567_VTAB /end COMPU_METHOD
/begin COMPU_METHOD FORMULA_0568 "FORMULA_0568" TAB_VERB "%5.2" "-" COMPU_TAB_REF FORMULA_0568_VTAB /end COMPU_METHOD
/begin COMPU_METHOD FORMULA_0569 "FORMULA_0569" TAB_VERB "%5.2" "-" COMPU_TAB_REF FORMULA_0569_VTAB /end COMPU_METHOD
/begin COMPU_METHOD FORMULA_0570 "FORMULA_0570" RAT_FUNC "%7.2" "-*s" COEFFS 0 16384.0 0.0 0 0.0 1.0 /end COMPU_METHOD
/begin COMPU_METHOD FORMULA_0571 "FORMULA_0571" RAT_FUNC "%7.0" "mal" COEFFS 0 1 0 0 0 1 /end COMPU_METHOD
/begin COMPU_METHOD FORMULA_0572 "FORMULA_0572" RAT_FUNC "%5.0" "bytes" COEFFS 0 0.25 0.0 0 0.0 1.0 /end COMPU_METHOD
/begin COMPU_METHOD FORMULA_0573 "FORMULA_0573" RAT_FUNC "%5.0" "VERS" COEFFS 0 1 0 0 0 1 /end COMPU_METHOD
/begin COMPU_METHOD FORMULA_0574 "FORMULA_0574" TAB_VERB "%3.0" "-" COMPU_TAB_REF FORMULA_0574_VTAB /end COMPU_METHOD
/begin COMPU_METHOD FORMULA_0575 "FORMULA_0575" TAB_VERB "%3.0" "-" COMPU_TAB_REF FORMULA_0575_VTAB /end COMPU_METHOD
/begin COMPU_METHOD FORMULA_0576 "FORMULA_0576" TAB_VERB "%3.0" "-" COMPU_TAB_REF FORMULA_0576_VTAB /end COMPU_METHOD
/begin COMPU_METHOD FORMULA_0577 "FORMULA_0577" TAB_VERB "%5.0" "-" COMPU_TAB_REF FORMULA_0577_VTAB /end COMPU_METHOD
/begin COMPU_METHOD FORMULA_0578 "FORMULA_0578" TAB_VERB "%5.0" "-" COMPU_TAB_REF FORMULA_0578_VTAB /end COMPU_METHOD
/begin COMPU_METHOD FORMULA_0579 "FORMULA_0579" TAB_VERB "%5.0" "-" COMPU_TAB_REF FORMULA_0579_VTAB /end COMPU_METHOD
/begin COMPU_METHOD FORMULA_0580 "FORMULA_0580" TAB_VERB "%5.0" "-" COMPU_TAB_REF FORMULA_0580_VTAB /end COMPU_METHOD
/begin COMPU_METHOD FORMULA_0581 "FORMULA_0581" TAB_VERB "%5.0" "-" COMPU_TAB_REF FORMULA_0581_VTAB /end COMPU_METHOD
/begin COMPU_METHOD FORMULA_0582 "FORMULA_0582" TAB_VERB "%5.0" "-" COMPU_TAB_REF FORMULA_0582_VTAB /end COMPU_METHOD
/begin COMPU_METHOD FORMULA_0583 "FORMULA_0583" TAB_VERB "%5.0" "-" COMPU_TAB_REF FORMULA_0583_VTAB /end COMPU_METHOD
/begin COMPU_METHOD FORMULA_0584 "FORMULA_0584" TAB_VERB "%5.0" "-" COMPU_TAB_REF FORMULA_0584_VTAB /end COMPU_METHOD
/begin COMPU_METHOD FORMULA_0585 "FORMULA_0585" TAB_VERB "%5.0" "-" COMPU_TAB_REF FORMULA_0585_VTAB /end COMPU_METHOD
/begin COMPU_METHOD FORMULA_0586 "FORMULA_0586" TAB_VERB "%5.0" "-" COMPU_TAB_REF FORMULA_0586_VTAB /end COMPU_METHOD
/begin COMPU_METHOD FORMULA_0587 "FORMULA_0587" TAB_VERB "%5.0" "-" COMPU_TAB_REF FORMULA_0587_VTAB /end COMPU_METHOD
/begin COMPU_METHOD FORMULA_0588 "FORMULA_0588" RAT_FUNC "%5.0" "ul" COEFFS 0 1 0 0 0 1 /end COMPU_METHOD
/begin COMPU_METHOD FORMULA_0589 "FORMULA_0589" RAT_FUNC "%3.0" "m/s*s" COEFFS 0 4.0 0.0 0 0.0 1.0 /end COMPU_METHOD
/begin COMPU_METHOD FORMULA_0590 "FORMULA_0590" TAB_VERB "%5.2" "-" COMPU_TAB_REF FORMULA_0590_VTAB /end COMPU_METHOD
/begin COMPU_METHOD FORMULA_0591 "FORMULA_0591" RAT_FUNC "%5.0" "-" COEFFS 0 0.1 0.0 0 0.0 1.0 /end COMPU_METHOD
/begin COMPU_METHOD FORMULA_0592 "FORMULA_0592" TAB_VERB "%5.2" "%" COMPU_TAB_REF FORMULA_0592_VTAB /end COMPU_METHOD
/begin COMPU_METHOD FORMULA_0593 "FORMULA_0593" RAT_FUNC "%5.0" "s" COEFFS 0 1 0 0 0 1 /end COMPU_METHOD
/begin COMPU_METHOD FORMULA_0594 "FORMULA_0594" TAB_VERB "%5.2" "-" COMPU_TAB_REF FORMULA_0594_VTAB /end COMPU_METHOD
/begin COMPU_METHOD FORMULA_0595 "FORMULA_0595" RAT_FUNC "%5.2" "Liter" COEFFS 0 10.0 100.0 0 0.0 1.0 /end COMPU_METHOD
/begin COMPU_METHOD FORMULA_0596 "FORMULA_0596" TAB_VERB "%5.2" "-" COMPU_TAB_REF FORMULA_0596_VTAB /end COMPU_METHOD
/begin COMPU_METHOD FORMULA_0597 "FORMULA_0597" RAT_FUNC "%7.2" "min" COEFFS 0 60.0 0.0 0 0.0 1.0 /end COMPU_METHOD
/begin COMPU_METHOD FORMULA_0598 "FORMULA_0598" RAT_FUNC "%7.2" "Liter" COEFFS 0 1000.0 0.0 0 0.0 1.0 /end COMPU_METHOD
/begin COMPU_METHOD FORMULA_0599 "FORMULA_0599" TAB_VERB "%7.2" "-" COMPU_TAB_REF FORMULA_0599_VTAB /end COMPU_METHOD
/begin COMPU_METHOD FORMULA_0600 "FORMULA_0600" RAT_FUNC "%5.2" "-" COEFFS 0 10.0 0.0 0 0.0 1.0 /end COMPU_METHOD
/begin COMPU_METHOD FORMULA_0601 "FORMULA_0601" RAT_FUNC "%5.2" "%" COEFFS 0 8.e-002 0.0 0 0.0 1.0 /end COMPU_METHOD
/begin COMPU_METHOD FORMULA_0602 "FORMULA_0602" RAT_FUNC "%7.2" "Kelvin" COEFFS 0 1 0 0 0 1 /end COMPU_METHOD
/begin COMPU_METHOD FORMULA_0603 "FORMULA_0603" RAT_FUNC "%7.2" "mm" COEFFS 0 3.37 0.0 0 0.0 1.0 /end COMPU_METHOD
/begin COMPU_METHOD FORMULA_0604 "FORMULA_0604" TAB_VERB "%3.0" "-" COMPU_TAB_REF FORMULA_0604_VTAB /end COMPU_METHOD
/begin COMPU_METHOD FORMULA_0605 "FORMULA_0605" TAB_VERB "%3.0" "-" COMPU_TAB_REF FORMULA_0605_VTAB /end COMPU_METHOD
/begin COMPU_METHOD FORMULA_0627 "FORMULA_0627" TAB_VERB "%3.0" "-" COMPU_TAB_REF FORMULA_0627_VTAB /end COMPU_METHOD
/begin COMPU_METHOD FORMULA_0628 "FORMULA_0628" TAB_VERB "%3.0" "-" COMPU_TAB_REF FORMULA_0628_VTAB /end COMPU_METHOD
/begin COMPU_METHOD FORMULA_0731 "FORMULA_0731" RAT_FUNC "%5.2" "mm" COEFFS 0 3.37 0.0 0 0.0 1.0 /end COMPU_METHOD
/begin COMPU_METHOD FORMULA_0732 "FORMULA_0732" RAT_FUNC "%7.2" "A" COEFFS 0 50.0 10000.0 0 0.0 1.0 /end COMPU_METHOD
/begin COMPU_METHOD FORMULA_0733 "FORMULA_0733" RAT_FUNC "%5.2" "A" COEFFS 0 50.0 0.0 0 0.0 1.0 /end COMPU_METHOD
/begin COMPU_METHOD FORMULA_0734 "FORMULA_0734" RAT_FUNC "%5.2" "V" COEFFS 0 15.625 -93.75 0 0.0 1.0 /end COMPU_METHOD
/begin COMPU_METHOD FORMULA_0735 "FORMULA_0735" RAT_FUNC "%5.2" "s" COEFFS 0 3.90625e-003 0.0 0 0.0 1.0 /end COMPU_METHOD
/begin COMPU_METHOD FORMULA_0736 "FORMULA_0736" RAT_FUNC "%5.2" "s" COEFFS 0 80.0 0.0 0 0.0 1.0 /end COMPU_METHOD
/begin COMPU_METHOD FORMULA_0737 "FORMULA_0737" RAT_FUNC "%5.2" "s" COEFFS 0 500.0 -5.0 0 0.0 1.0 /end COMPU_METHOD
/begin COMPU_METHOD FORMULA_0738 "FORMULA_0738" RAT_FUNC "%5.2" "s" COEFFS 0 6.25e-002 0.0 0 0.0 1.0 /end COMPU_METHOD
/begin COMPU_METHOD FORMULA_0739 "FORMULA_0739" RAT_FUNC "%5.2" "A" COEFFS 0 25.0 0.0 0 0.0 1.0 /end COMPU_METHOD
/begin COMPU_METHOD FORMULA_0740 "FORMULA_0740" RAT_FUNC "%5.2" "A" COEFFS 0 12.5 0.0 0 0.0 1.0 /end COMPU_METHOD
/begin COMPU_METHOD FORMULA_0741 "FORMULA_0741" RAT_FUNC "%5.2" "s" COEFFS 0 20.0 0.0 0 0.0 1.0 /end COMPU_METHOD
/begin COMPU_METHOD FORMULA_0742 "FORMULA_0742" RAT_FUNC "%5.2" "s" COEFFS 0 160.0 0.0 0 0.0 1.0 /end COMPU_METHOD
/begin COMPU_METHOD FORMULA_0743 "FORMULA_0743" RAT_FUNC "%5.2" "V" COEFFS 0 51.02040816326531 0.0 0 0.0 1.0 /end COMPU_METHOD
/begin COMPU_METHOD FORMULA_0744 "FORMULA_0744" RAT_FUNC "%7.2" "s" COEFFS 0 20.0 0.0 0 0.0 1.0 /end COMPU_METHOD
/begin COMPU_METHOD FORMULA_0745 "FORMULA_0745" RAT_FUNC "%5.0" "-" COEFFS 0 170.0 0.0 0 0.0 1.0 /end COMPU_METHOD
/begin COMPU_VTAB FORMULA_0002_VTAB "FORMULA_0002_VTAB" TAB_VERB 4 0 "in Ordnung" 128 "queue full" 64 "queue fehler" 32 "IRQ illegal" DEFAULT_VALUE "undefiniert" /end COMPU_VTAB
/begin COMPU_VTAB FORMULA_0004_VTAB "FORMULA_0004_VTAB" TAB_VERB 9 0 "OK" 1 "NR CS0" 2 "NR CS1" 4 "NR CS2" 8 "NR CS3" 16 "CNT CS0" 17 "CNT CS1" 18 "CNT CS2" 20 "CNT CS3" /end COMPU_VTAB
/begin COMPU_VTAB FORMULA_0005_VTAB "FORMULA_0005_VTAB" TAB_VERB 7 0 "OK" 1 "Seg-Kanal" 2 "5ms-Kanal" 4 "10ms-Kanal" 8 "100ms-Kanal" 16 "bgnd-Kanal" 32 "kwp-Kanal" DEFAULT_VALUE "ungueltig" /end COMPU_VTAB
/begin COMPU_VTAB FORMULA_0011_VTAB "FORMULA_0011_VTAB" TAB_VERB 14 0 "kein Fehler" 1 "Egasueberwachung" 2 "Momentenueberwachung" 4 "Einspritzueberwachung" 8 "SMG-Ueberwachung" 16 "Systemfehler" 32 "Stackueberwachung" 64 "Resetanzahl" 128 "Gemischfehler" 512 "CRC-Check" 1024 "Taskueberwachung" 2048 "Prozessueberwachung" 4096 "Pedalwertgeber" 8192 "Mastervac" DEFAULT_VALUE "undef" /end COMPU_VTAB
/begin COMPU_VTAB FORMULA_0012_VTAB "FORMULA_0012_VTAB" TAB_VERB 1 0 "iO" DEFAULT_VALUE "Fehler" /end COMPU_VTAB
/begin COMPU_VTAB FORMULA_0013_VTAB "FORMULA_0013_VTAB" TAB_VERB 5 0 "CRC iO" 1 "D-Fehler" 2 "P-Fehler" 3 "PD-Fehler" 4 "B-Fehler" DEFAULT_VALUE "Mehrfachfehler" /end COMPU_VTAB
/begin COMPU_VTAB FORMULA_0014_VTAB "FORMULA_0014_VTAB" TAB_VERB 5 0 "OK" 3 "ID" 4 "Limit" 11 "Overrun" 14 "Stack" /end COMPU_VTAB
/begin COMPU_VTAB FORMULA_0015_VTAB "FORMULA_0015_VTAB" TAB_VERB 6 512 "MCI" 768 "DataAcc" 1024 "IntrAcc" 1536 "Align" 1792 "PrgExc" 8192 "NMI" /end COMPU_VTAB
/begin COMPU_VTAB FORMULA_0016_VTAB "FORMULA_0016_VTAB" TAB_VERB 13 0 "ini" 1 "1st edge" 2 "second edge" 3 "wait teeth" 4 "search gap" 5 "1st missing required" 6 "last tooth until gap" 7 "1st missing tooth" 8 "2nd missing tooth" 9 "1st tooth after gap" 10 "2nd tooth after gap" 11 "tooth 2..56, 62..116" 12 "gap required" DEFAULT_VALUE "undefined" /end COMPU_VTAB
/begin COMPU_VTAB FORMULA_0019_VTAB "FORMULA_0019_VTAB" TAB_VERB 13 1 "Motor steht" 2 "Motor presync" 4 "Start" 8 "LLOKS" 16 "LLMKS" 32 "TL" 64 "VL" 128 "SA" 256 "NL" 512 "Abgew." 1024 "Kl15 aus" 2048 "Wakeup" 4096 "Schub" DEFAULT_VALUE "undefiniert" /end COMPU_VTAB
/begin COMPU_VTAB FORMULA_0026_VTAB "FORMULA_0026_VTAB" TAB_VERB 4 0 "off" 1 "Fertigungsmode" 2 "Transportmode" 4 "Werkstattmode" DEFAULT_VALUE "off" /end COMPU_VTAB
/begin COMPU_VTAB FORMULA_0028_VTAB "FORMULA_0028_VTAB" TAB_VERB 7 0 "kein Land" 1 "ECE" 2 "US" 3 "D" 4 "GB" 5 "J" 255 "ungueltig" /end COMPU_VTAB
/begin COMPU_VTAB FORMULA_0029_VTAB "FORMULA_0029_VTAB" TAB_VERB 9 0 "keine Angabe" 4 "E60" 5 "E61" 6 "E63" 7 "E64" 8 "E90" 13 "E91" 14 "E92" 15 "E93" DEFAULT_VALUE "ungueltig" /end COMPU_VTAB
/begin COMPU_VTAB FORMULA_0030_VTAB "FORMULA_0030_VTAB" TAB_VERB 3 0 "v_max 250" 1 "reserviert" 2 "v_max angehoben" DEFAULT_VALUE "undef" /end COMPU_VTAB
/begin COMPU_VTAB FORMULA_0031_VTAB "FORMULA_0031_VTAB" TAB_VERB 6 0 "HS" 1 "Automat" 2 "Steptronic" 3 "SMG" 4 "DKG" 15 "ungueltig" /end COMPU_VTAB
/begin COMPU_VTAB FORMULA_0033_VTAB "FORMULA_0033_VTAB" TAB_VERB 2 255 "Lampe aktiviert" 254 "Lampe deaktiviert" DEFAULT_VALUE "undef" /end COMPU_VTAB
/begin COMPU_VTAB FORMULA_0034_VTAB "FORMULA_0034_VTAB" TAB_VERB 4 255 "25tkm" 254 "20tkm" 252 "12tkm" 248 "6tkm" DEFAULT_VALUE "undef" /end COMPU_VTAB
/begin COMPU_VTAB FORMULA_0035_VTAB "FORMULA_0035_VTAB" TAB_VERB 3 255 "Standard" 254 "minderwertig" 252 "bleihaltig" DEFAULT_VALUE "undef" /end COMPU_VTAB
/begin COMPU_VTAB FORMULA_0036_VTAB "FORMULA_0036_VTAB" TAB_VERB 10 255 "unknown" 254 "MJ2007" 253 "MJ2008" 252 "MJ2009" 251 "MJ2010" 250 "MJ2011" 249 "MJ2012" 248 "MJ2013" 247 "MJ2014" 246 "MJ2015" DEFAULT_VALUE "undef" /end COMPU_VTAB
/begin COMPU_VTAB FORMULA_0038_VTAB "FORMULA_0038_VTAB" TAB_VERB 1 0 "erfuellt" DEFAULT_VALUE "offen" /end COMPU_VTAB
/begin COMPU_VTAB FORMULA_0039_VTAB "FORMULA_0039_VTAB" TAB_VERB 1 0 "erfuellt" DEFAULT_VALUE "offen" /end COMPU_VTAB
/begin COMPU_VTAB FORMULA_0040_VTAB "FORMULA_0040_VTAB" TAB_VERB 1 0 "erfuellt" DEFAULT_VALUE "offen" /end COMPU_VTAB
/begin COMPU_VTAB FORMULA_0041_VTAB "FORMULA_0041_VTAB" TAB_VERB 1 0 "erfuellt" DEFAULT_VALUE "offen" /end COMPU_VTAB
/begin COMPU_VTAB FORMULA_0042_VTAB "FORMULA_0042_VTAB" TAB_VERB 4 0 "CRC iO" 1 "Daten falsch" 2 "Prog falsch" 4 "Booter falsch" DEFAULT_VALUE "Mehrfachfehler" /end COMPU_VTAB
/begin COMPU_VTAB FORMULA_0043_VTAB "FORMULA_0043_VTAB" TAB_VERB 4 0 "Inaktiv" 1 "Start" 2 "Aktiv" 3 "Ende" DEFAULT_VALUE "undef" /end COMPU_VTAB
/begin COMPU_VTAB FORMULA_0200_VTAB "FORMULA_0200_VTAB" TAB_VERB 2 0 "nein" 1 "ja" /end COMPU_VTAB
/begin COMPU_VTAB FORMULA_0201_VTAB "FORMULA_0201_VTAB" TAB_VERB 2 0 "nein" 1 "ja" /end COMPU_VTAB
/begin COMPU_VTAB FORMULA_0202_VTAB "FORMULA_0202_VTAB" TAB_VERB 2 0 "nein" 1 "ja" /end COMPU_VTAB
/begin COMPU_VTAB FORMULA_0203_VTAB "FORMULA_0203_VTAB" TAB_VERB 2 0 "nein" 1 "ja" /end COMPU_VTAB
/begin COMPU_VTAB FORMULA_0207_VTAB "FORMULA_0207_VTAB" TAB_VERB 2 0 "nein" 1 "ja" /end COMPU_VTAB
/begin COMPU_VTAB FORMULA_0215_VTAB "FORMULA_0215_VTAB" TAB_VERB 4 0 "k. Aenderung" 1 "Aus" 2 "Ein" 4 "Sport" DEFAULT_VALUE "undef" /end COMPU_VTAB
/begin COMPU_VTAB FORMULA_0216_VTAB "FORMULA_0216_VTAB" TAB_VERB 3 0 "k. Aenderung" 1 "Automat" 2 "Sequentiell" DEFAULT_VALUE "undef" /end COMPU_VTAB
/begin COMPU_VTAB FORMULA_0217_VTAB "FORMULA_0217_VTAB" TAB_VERB 1 0 "k. Aenderung" /end COMPU_VTAB
/begin COMPU_VTAB FORMULA_0218_VTAB "FORMULA_0218_VTAB" TAB_VERB 4 0 "k. Aenderung" 1 "Komfort" 2 "Normal" 3 "Sport" DEFAULT_VALUE "undef" /end COMPU_VTAB
/begin COMPU_VTAB FORMULA_0219_VTAB "FORMULA_0219_VTAB" TAB_VERB 4 0 "k. Aenderung" 1 "KL1" 2 "KL2" 3 "KL3" DEFAULT_VALUE "undef" /end COMPU_VTAB
/begin COMPU_VTAB FORMULA_0220_VTAB "FORMULA_0220_VTAB" TAB_VERB 2 0 "k. Aenderung" 1 "M-Cfg" DEFAULT_VALUE "undef" /end COMPU_VTAB
/begin COMPU_VTAB FORMULA_0221_VTAB "FORMULA_0221_VTAB" TAB_VERB 2 0 "nicht angehoben" 1 "angehoben" DEFAULT_VALUE "undef" /end COMPU_VTAB
/begin COMPU_VTAB FORMULA_0298_VTAB "FORMULA_0298_VTAB" TAB_VERB 6 0 "Inaktiv" 1 "Abregeln" 2 "Schalten" 3 "Aufregeln" 4 "Ende" 15 "Error" /end COMPU_VTAB
/begin COMPU_VTAB FORMULA_0355_VTAB "FORMULA_0355_VTAB" TAB_VERB 11 0 "Ok" 1 "Sync1" 2 "Sync2" 3 "SyncMS" 4 "1ms-Task" 5 "5ms-Task" 6 "10ms-Task" 7 "100ms-Task" 8 "1s-Task" 9 "Bgnd-Task" 10 "undef" /end COMPU_VTAB
/begin COMPU_VTAB FORMULA_0356_VTAB "FORMULA_0356_VTAB" TAB_VERB 13 0 "Ok" 1 "Access" 2 "Level" 3 "ID" 4 "Limit" 5 "NoFnc" 6 "Resource" 7 "State" 8 "Value" 9 "TT missing" 10 "TT active" 11 "Overrun" 14 "Stack" /end COMPU_VTAB
/begin COMPU_VTAB FORMULA_0419_VTAB "FORMULA_0419_VTAB" TAB_VERB 63 45 "-" 48 "0" 49 "1" 50 "2" 51 "3" 52 "4" 53 "5" 54 "6" 55 "7" 56 "8" 57 "9" 65 "A" 66 "B" 67 "C" 68 "D" 69 "E" 70 "F" 71 "G" 72 "H" 73 "I" 74 "J" 75 "K" 76 "L" 77 "M" 78 "N" 79 "O" 80 "P" 81 "Q" 82 "R" 83 "S" 84 "T" 85 "U" 86 "V" 87 "W" 88 "X" 89 "Y" 90 "Z" 97 "a" 98 "b" 99 "c" 100 "d" 101 "e" 102 "f" 103 "g" 104 "h" 105 "i" 106 "j" 107 "k" 108 "l" 109 "m" 110 "n" 111 "o" 112 "p" 113 "q" 114 "r" 115 "s" 116 "t" 117 "u" 118 "v" 119 "w" 120 "x" 121 "y" 122 "z" DEFAULT_VALUE "DEZ" /end COMPU_VTAB
/begin COMPU_VTAB FORMULA_0423_VTAB "FORMULA_0423_VTAB" TAB_VERB 2 0 "FALSE" 1 "TRUE" DEFAULT_VALUE "TRUE" /end COMPU_VTAB
/begin COMPU_VTAB FORMULA_0424_VTAB "FORMULA_0424_VTAB" TAB_VERB 2 0 "FALSE" 1 "TRUE" DEFAULT_VALUE "TRUE" /end COMPU_VTAB
/begin COMPU_VTAB FORMULA_0425_VTAB "FORMULA_0425_VTAB" TAB_VERB 2 0 "FALSE" 1 "TRUE" DEFAULT_VALUE "TRUE" /end COMPU_VTAB
/begin COMPU_VTAB FORMULA_0426_VTAB "FORMULA_0426_VTAB" TAB_VERB 2 0 "FALSE" 1 "TRUE" DEFAULT_VALUE "TRUE" /end COMPU_VTAB
/begin COMPU_VTAB FORMULA_0427_VTAB "FORMULA_0427_VTAB" TAB_VERB 2 0 "FALSE" 1 "TRUE" DEFAULT_VALUE "TRUE" /end COMPU_VTAB
/begin COMPU_VTAB FORMULA_0428_VTAB "FORMULA_0428_VTAB" TAB_VERB 2 0 "FALSE" 1 "TRUE" DEFAULT_VALUE "TRUE" /end COMPU_VTAB
/begin COMPU_VTAB FORMULA_0429_VTAB "FORMULA_0429_VTAB" TAB_VERB 2 0 "FALSE" 1 "TRUE" DEFAULT_VALUE "TRUE" /end COMPU_VTAB
/begin COMPU_VTAB FORMULA_0430_VTAB "FORMULA_0430_VTAB" TAB_VERB 2 0 "FALSE" 1 "TRUE" DEFAULT_VALUE "TRUE" /end COMPU_VTAB
/begin COMPU_VTAB FORMULA_0517_VTAB "FORMULA_0517_VTAB" TAB_VERB 2 0 "ausgeschaltet" 1 "Einschalten" DEFAULT_VALUE "undef" /end COMPU_VTAB
/begin COMPU_VTAB FORMULA_0518_VTAB "FORMULA_0518_VTAB" TAB_VERB 2 0 "aus" 1 "ein" /end COMPU_VTAB
/begin COMPU_VTAB FORMULA_0519_VTAB "FORMULA_0519_VTAB" TAB_VERB 2 0 "aus" 1 "ein" /end COMPU_VTAB
/begin COMPU_VTAB FORMULA_0520_VTAB "FORMULA_0520_VTAB" TAB_VERB 2 0 "aus" 1 "ein" /end COMPU_VTAB
/begin COMPU_VTAB FORMULA_0521_VTAB "FORMULA_0521_VTAB" TAB_VERB 2 0 "aus" 1 "ein" /end COMPU_VTAB
/begin COMPU_VTAB FORMULA_0522_VTAB "FORMULA_0522_VTAB" TAB_VERB 2 0 "aus" 1 "ein" /end COMPU_VTAB
/begin COMPU_VTAB FORMULA_0523_VTAB "FORMULA_0523_VTAB" TAB_VERB 2 0 "aus" 1 "ein" /end COMPU_VTAB
/begin COMPU_VTAB FORMULA_0524_VTAB "FORMULA_0524_VTAB" TAB_VERB 2 0 "aus" 1 "ein" /end COMPU_VTAB
/begin COMPU_VTAB FORMULA_0525_VTAB "FORMULA_0525_VTAB" TAB_VERB 2 0 "aus" 1 "ein" /end COMPU_VTAB
/begin COMPU_VTAB FORMULA_0526_VTAB "FORMULA_0526_VTAB" TAB_VERB 2 0 "aus" 1 "ein" /end COMPU_VTAB
/begin COMPU_VTAB FORMULA_0527_VTAB "FORMULA_0527_VTAB" TAB_VERB 2 0 "aus" 1 "ein" /end COMPU_VTAB
/begin COMPU_VTAB FORMULA_0528_VTAB "FORMULA_0528_VTAB" TAB_VERB 2 0 "aus" 1 "ein" /end COMPU_VTAB
/begin COMPU_VTAB FORMULA_0529_VTAB "FORMULA_0529_VTAB" TAB_VERB 2 0 "aus" 1 "ein" /end COMPU_VTAB
/begin COMPU_VTAB FORMULA_0530_VTAB "FORMULA_0530_VTAB" TAB_VERB 2 0 "aus" 1 "ein" /end COMPU_VTAB
/begin COMPU_VTAB FORMULA_0531_VTAB "FORMULA_0531_VTAB" TAB_VERB 2 0 "Langztwert nach CBS-RESET" 1 "noch kein Langztwert nach CBS-RESET" /end COMPU_VTAB
/begin COMPU_VTAB FORMULA_0532_VTAB "FORMULA_0532_VTAB" TAB_VERB 4 0 "keine Messg. erwuenscht" 1 "Kurzzeitmessg. laeuft" 2 "Kurzzeitmessg. erfolgr." 3 "Kurzzeitmessg. abgebr." /end COMPU_VTAB
/begin COMPU_VTAB FORMULA_0537_VTAB "FORMULA_0537_VTAB" TAB_VERB 1 0 "Messung gesperrt" DEFAULT_VALUE "Messung freigegeben" /end COMPU_VTAB
/begin COMPU_VTAB FORMULA_0538_VTAB "FORMULA_0538_VTAB" TAB_VERB 1 0 "Diag. inaktiv" DEFAULT_VALUE "Diag. aktiv" /end COMPU_VTAB
/begin COMPU_VTAB FORMULA_0539_VTAB "FORMULA_0539_VTAB" TAB_VERB 1 0 "INIT-Wert" DEFAULT_VALUE "gelernter Wert" /end COMPU_VTAB
/begin COMPU_VTAB FORMULA_0540_VTAB "FORMULA_0540_VTAB" TAB_VERB 1 0 "i.O." DEFAULT_VALUE "SH_TO_X_SPERREN" /end COMPU_VTAB
/begin COMPU_VTAB FORMULA_0544_VTAB "FORMULA_0544_VTAB" TAB_VERB 3 0 "Vorlauf gesperrt" 1 "mit Vorlauf" 2 "Vorl init" /end COMPU_VTAB
/begin COMPU_VTAB FORMULA_0547_VTAB "FORMULA_0547_VTAB" TAB_VERB 2 0 "nein" 1 "ja" /end COMPU_VTAB
/begin COMPU_VTAB FORMULA_0548_VTAB "FORMULA_0548_VTAB" TAB_VERB 2 0 "nein" 1 "ja" /end COMPU_VTAB
/begin COMPU_VTAB FORMULA_0549_VTAB "FORMULA_0549_VTAB" TAB_VERB 2 0 "nein" 1 "ja" /end COMPU_VTAB
/begin COMPU_VTAB FORMULA_0550_VTAB "FORMULA_0550_VTAB" TAB_VERB 2 0 "nein" 1 "ja" /end COMPU_VTAB
/begin COMPU_VTAB FORMULA_0551_VTAB "FORMULA_0551_VTAB" TAB_VERB 2 0 "nein" 1 "ja" /end COMPU_VTAB
/begin COMPU_VTAB FORMULA_0552_VTAB "FORMULA_0552_VTAB" TAB_VERB 2 0 "nein" 1 "ja" /end COMPU_VTAB
/begin COMPU_VTAB FORMULA_0555_VTAB "FORMULA_0555_VTAB" TAB_VERB 51 0 "AUS" 1 "BEREIT" 2 "WAIT_KLA" 3 "WAIT_V" 4 "WAIT_N" 5 "WAIT_UB" 6 "WAIT_PMIN" 7 "WAIT_TEMP" 8 "WAIT_FST" 9 "WAIT_TEV" 10 "WAIT_EXD" 11 "WAIT_FEHLER_LOESCH" 12 "WAIT_VENTIL" 13 "WAIT_AY" 14 "WAIT_FEUCHT" 20 "START" 21 "REFDIA1" 22 "VENTIL_CHK" 23 "DECKELDIA" 24 "GROBLECKDIA" 25 "FEINLECKDIA" 26 "DECKEL_REFDIA2" 27 "GROB_REFDIA2" 28 "FEIN_REFDIA2" 29 "VENTIL_CHK2" 32 "DECKEL_DICHT" 33 "GROB_DICHT" 34 "FEIN_DICHT" 35 "DECKELLECK" 36 "GROBLECK" 37 "FEINLECK" 40 "ABBRUCH_UB_DIFF" 41 "ABBRUCH_I_REF_DIFF" 42 "ABBRUCH_TEV" 43 "ABBRUCH_KL15" 44 "ABBRUCH_N" 45 "ABBRUCH_V" 46 "ABBRUCH_KS" 47 "ABBRUCH_EXD" 48 "ABBRUCH_REF_ZU_GROSS" 49 "ABBRUCH_REF_ZU_KLEIN" 50 "ABBRUCH_VERSTOPFT" 51 "ABBRUCH_NACHTANK" 52 "ABBRUCH_TANKDECKEL" 53 "ABBRUCH_AIRBAG" 54 "ABBRUCH_I_REF_1/2" 55 "ABBRUCH_DI2" 56 "ABBRUCH_AY" 57 "ABBRUCH_I_REF2_DIFF" 58 "ABBRUCH_UB_MIN" 59 "ABBRUCH_POWER_DOWN" DEFAULT_VALUE "undef" /end COMPU_VTAB
/begin COMPU_VTAB FORMULA_0562_VTAB "FORMULA_0562_VTAB" TAB_VERB 4 0 "kein ELU erkannt" 1 "BMW 600W" 2 "BMW 850W" 128 "TEMIC 850W invers" DEFAULT_VALUE "undefiniert" /end COMPU_VTAB
/begin COMPU_VTAB FORMULA_0565_VTAB "FORMULA_0565_VTAB" TAB_VERB 1 0 "erfuellt" DEFAULT_VALUE "offen" /end COMPU_VTAB
/begin COMPU_VTAB FORMULA_0566_VTAB "FORMULA_0566_VTAB" TAB_VERB 1 0 "erfuellt" DEFAULT_VALUE "offen" /end COMPU_VTAB
/begin COMPU_VTAB FORMULA_0567_VTAB "FORMULA_0567_VTAB" TAB_VERB 1 0 "erfuellt" DEFAULT_VALUE "offen" /end COMPU_VTAB
/begin COMPU_VTAB FORMULA_0568_VTAB "FORMULA_0568_VTAB" TAB_VERB 1 0 "erfuellt" DEFAULT_VALUE "offen" /end COMPU_VTAB
/begin COMPU_VTAB FORMULA_0569_VTAB "FORMULA_0569_VTAB" TAB_VERB 9 0 "Initialisierung" 1 "Rangecheck geheilt" 2 "n.i.O. Zyklusvergleich" 4 "i.O. Zyklusvergleich" 8 "i.O. Modellcheck" 16 "n.i.O. Rangecheck" 32 "n.i.O. Gradientenueberwachung" 64 "n.i.O. Modellcheck" 128 "Diagnose gesperrt" DEFAULT_VALUE "undef" /end COMPU_VTAB
/begin COMPU_VTAB FORMULA_0574_VTAB "FORMULA_0574_VTAB" TAB_VERB 2 0 "Einfahrint. abgeschl." 1 "Einfahrint. aktiv" DEFAULT_VALUE "undef" /end COMPU_VTAB
/begin COMPU_VTAB FORMULA_0575_VTAB "FORMULA_0575_VTAB" TAB_VERB 5 0 "Inaktiv" 1 "Key" 5 "Aktiv" 8 "Fehler" 9 "Beendet" DEFAULT_VALUE "undefined" /end COMPU_VTAB
/begin COMPU_VTAB FORMULA_0576_VTAB "FORMULA_0576_VTAB" TAB_VERB 4 0 "Aus" 1 "Statisch" 2 "Sequentiell" 3 "Sporadisch" DEFAULT_VALUE "undefined" /end COMPU_VTAB
/begin COMPU_VTAB FORMULA_0577_VTAB "FORMULA_0577_VTAB" TAB_VERB 1 0 "keine Ausblendung." DEFAULT_VALUE "Ausblendungen aktiv." /end COMPU_VTAB
/begin COMPU_VTAB FORMULA_0578_VTAB "FORMULA_0578_VTAB" TAB_VERB 1 0 "Zyl. 1 an." DEFAULT_VALUE "Zyl. 1 aus." /end COMPU_VTAB
/begin COMPU_VTAB FORMULA_0579_VTAB "FORMULA_0579_VTAB" TAB_VERB 1 0 "Zyl. 2 an." DEFAULT_VALUE "Zyl. 2 aus." /end COMPU_VTAB
/begin COMPU_VTAB FORMULA_0580_VTAB "FORMULA_0580_VTAB" TAB_VERB 1 0 "Zyl. 3 an." DEFAULT_VALUE "Zyl. 3 aus." /end COMPU_VTAB
/begin COMPU_VTAB FORMULA_0581_VTAB "FORMULA_0581_VTAB" TAB_VERB 1 0 "Zyl. 4 an." DEFAULT_VALUE "Zyl. 4 aus." /end COMPU_VTAB
/begin COMPU_VTAB FORMULA_0582_VTAB "FORMULA_0582_VTAB" TAB_VERB 1 0 "Zyl. 5 an." DEFAULT_VALUE "Zyl. 5 aus." /end COMPU_VTAB
/begin COMPU_VTAB FORMULA_0583_VTAB "FORMULA_0583_VTAB" TAB_VERB 1 0 "Zyl. 6 an." DEFAULT_VALUE "Zyl. 6 aus." /end COMPU_VTAB
/begin COMPU_VTAB FORMULA_0584_VTAB "FORMULA_0584_VTAB" TAB_VERB 1 0 "Zyl. 7 an." DEFAULT_VALUE "Zyl. 7 aus." /end COMPU_VTAB
/begin COMPU_VTAB FORMULA_0585_VTAB "FORMULA_0585_VTAB" TAB_VERB 1 0 "Zyl. 8 an." DEFAULT_VALUE "Zyl. 8 aus." /end COMPU_VTAB
/begin COMPU_VTAB FORMULA_0586_VTAB "FORMULA_0586_VTAB" TAB_VERB 1 0 "Zyl. 9 an." DEFAULT_VALUE "Zyl. 9 aus." /end COMPU_VTAB
/begin COMPU_VTAB FORMULA_0587_VTAB "FORMULA_0587_VTAB" TAB_VERB 1 0 "Zyl. 10 an." DEFAULT_VALUE "Zyl. 10 aus." /end COMPU_VTAB
/begin COMPU_VTAB FORMULA_0590_VTAB "FORMULA_0590_VTAB" TAB_VERB 2 0 "FALSE" 1 "TRUE" /end COMPU_VTAB
/begin COMPU_VTAB FORMULA_0592_VTAB "FORMULA_0592_VTAB" TAB_VERB 4 0 "<50" 1 "50..<75" 2 "75..<100" 3 "100" /end COMPU_VTAB
/begin COMPU_VTAB FORMULA_0594_VTAB "FORMULA_0594_VTAB" TAB_VERB 9 12 "zu wenig" 25 "Minimum" 38 "Min-OK" 53 "OK" 69 "OK-Max" 85 "Max" 95 "Ueberfuellt" 120 "-.-" 121 "Uhr" DEFAULT_VALUE "undef." /end COMPU_VTAB
/begin COMPU_VTAB FORMULA_0596_VTAB "FORMULA_0596_VTAB" TAB_VERB 3 0 "BSD1_alt" 1 "BSD1_plus" 2 "BSD2" DEFAULT_VALUE "undef." /end COMPU_VTAB
/begin COMPU_VTAB FORMULA_0599_VTAB "FORMULA_0599_VTAB" TAB_VERB 15 0 "keine Test-CC/CBS-Meldung raus" 1 "CC Motoroel nachfuellen" 2 "CC Motoroel unter min" 3 "CC Motoroelsensor gestoert" 4 "CC Motoroel ueberhitzt" 5 "CC Motoroeldruck zu niedrig" 6 "CC Batterie wird nicht geladen" 7 "CC Batterieentladung zu hoch" 8 "CC Batterie stark entladen" 9 "CC Batterieueberwachung ausgef." 10 "CC Batterie pruefen" 11 "CC Batteriekontakte pruefen" 12 "CC Batterie entl. Verbr.abschaltung" 13 "CBS Oel Verfbkt. und Restlauflstg." 14 "CBS Oel Prognoseinterv. u. Zieltermin" /end COMPU_VTAB
/begin COMPU_VTAB FORMULA_0604_VTAB "FORMULA_0604_VTAB" TAB_VERB 32 0 "none" 16 "ack" 32 "par" 48 "par+ack" 64 "read" 80 "read+ack" 96 "read+par" 112 "read+par+ack" 128 "send" 144 "send+ack" 160 "send+par" 176 "send+par+ack" 192 "send+read" 208 "send+read+ack" 224 "send+read+par" 240 "send+read+par+ack" 1 "glitch" 17 "ack+glitch" 33 "par+glitch" 49 "par+ack+glitch" 65 "read+glitch" 81 "read+ack+glitch" 97 "read+par+glitch" 113 "read+par+ack+glitch" 129 "send+glitch" 145 "send+ack+glitch" 161 "send+par+glitch" 177 "send+par+ack+glitch" 193 "send+read+glitch" 209 "send+read+ack+glitch" 225 "send+read+par+glitch" 241 "send+read+par+ack+glitch" DEFAULT_VALUE "undefined" /end COMPU_VTAB
/begin COMPU_VTAB FORMULA_0605_VTAB "FORMULA_0605_VTAB" TAB_VERB 9 0 "BSD_IDLE" 1 "BSDHTOK" 2 "BSDWRITE" 4 "BSDDO" 8 "BSDBSY" 16 "BSDRXRDY" 32 "BSDTXOK" 64 "BSDDTRQ" 48 "BSDTXIND" /end COMPU_VTAB
/begin COMPU_VTAB FORMULA_0627_VTAB "FORMULA_0627_VTAB" TAB_VERB 1 -1 "Kein AIF)" /end COMPU_VTAB
/begin COMPU_VTAB FORMULA_0628_VTAB "FORMULA_0628_VTAB" TAB_VERB 3 0 "unbeschrieben" 1 "beschrieben" 2 "geloescht" DEFAULT_VALUE "undef" /end COMPU_VTAB
/begin FUNCTION AdaptCommon ""
 /begin OUT_MEASUREMENT ccp_retry_cnt_nv crc32_data_carb_nv crc32_prog_carb_nv ipk_sync_error_st_nv ipk_sync_errorcount_nv os_err_ff.addr_0 os_err_ff.addr_1 os_err_ff.addr_2 os_err_ff.addr_3 os_err_ff.addr_4 os_err_ff.addr_5 os_err_ff.addr_6 os_err_ff.addr_7 os_err_ff.ptr os_proz_ff.aq_soll_grad os_proz_ff.mtime os_proz_ff.mtime_pid os_proz_ff.n os_proz_ff.rf os_proz_ff.time_ml os_proz_ff.zustand_motor os_proz_irq_ff.aq_soll_grad os_proz_irq_ff.mtime os_proz_irq_ff.mtime_pid os_proz_irq_ff.n os_proz_irq_ff.rf os_proz_irq_ff.time_ml os_proz_irq_ff.zustand_motor os_proz_irq_last_nv pctrl_proz_err_nv pctrl_task_err_nv ram_chk_err_adr_nv sk_ff.crc32_result sk_ff.egas_sk_mode sk_ff.fail_st_zyl sk_ff.kupp_ist sk_ff.kupp_wunsch_ges sk_ff.md_sk_mode sk_ff.n sk_ff.os_err_addr sk_ff.os_err_cnt sk_ff.os_err_type sk_ff.proz_err sk_ff.pwg_soll sk_ff.reset_cnt sk_ff.rf_m sk_ff.smg_sk_mode sk_ff.stufe sk_ff.task_err sk_ff.ub sk_ff.ursache spim_chain_error_nv spim_error_reinit_ctr_nv spim_errorcode_reinit_nv sys_exc_addr_nv sys_exc_lr_nv sys_exc_vec_nv sys_rsr_cnt_nv.csrs sys_rsr_cnt_nv.dbhrs sys_rsr_cnt_nv.dbsrs sys_rsr_cnt_nv.ehrs sys_rsr_cnt_nv.esrs sys_rsr_cnt_nv.ghrst sys_rsr_cnt_nv.gpor sys_rsr_cnt_nv.gsrst sys_rsr_cnt_nv.ilbc sys_rsr_cnt_nv.jtrs sys_rsr_cnt_nv.llrs sys_rsr_cnt_nv.ocrs sys_rsr_cnt_nv.swrs sys_zust_cpu_last_max_nv tpu_kw_err_ff_a.cnt tpu_kw_err_ff_a.event_time tpu_kw_err_ff_a.irq tpu_kw_err_ff_a.last_period tpu_kw_err_ff_a.n tpu_kw_err_ff_a.n_zahn tpu_kw_err_ff_a.prev_period tpu_kw_err_ff_a.state tpu_kw_err_ff_a.tooth tpu_kw_err_ff_a.tooth_time tpu_kw_err_ff_b.cnt tpu_kw_err_ff_b.event_time tpu_kw_err_ff_b.irq tpu_kw_err_ff_b.last_period tpu_kw_err_ff_b.n tpu_kw_err_ff_b.n_zahn tpu_kw_err_ff_b.prev_period tpu_kw_err_ff_b.state tpu_kw_err_ff_b.tooth tpu_kw_err_ff_b.tooth_time tpu_kw_irq_info_cnt_nv_a tpu_kw_irq_info_cnt_nv_b /end OUT_MEASUREMENT
/end FUNCTION
/begin FUNCTION Adaptiondaten_glob ""
 /begin OUT_MEASUREMENT c_cbs_oel_nv c_ksa_nv c_mil_nv c_mj_nv can_fzgtyp_clas_pwr_nv can_fzgtyp_grb_nv can_fzgtyp_land_nv can_fzgtyp_veh_nv can_km_stand_nv ed_css_st_ign_nv ed_css_st_ign_nv_auss ed_css_st_ign_nv_lls ed_css_st_ign_nv_pwg ed_css_st_ign_nv_tmot ed_fsp_inj_fehlerzaehler_nv elu_nl_nv kat_obd_wert_gesamt_nv kat_obd_wert_nv_b1 kat_obd_wert_nv_b2 kwp_fetrawe_st laa_f_ber_nv_b1 laa_f_ber_nv_b2 tmot_abstell_nv toel_wanne /end OUT_MEASUREMENT
/end FUNCTION
/begin FUNCTION Adaptionswerte ""
 /begin OUT_MEASUREMENT B_DMTL_ABBRUCH_BETANK B_DMTL_ABBRUCH_FEUCHT B_DMTL_DECKEL_DICHT B_DMTL_DECKEL_GEPRUEFT B_DMTL_FST_GESTIEGEN B_DMTL_GROB_VERMUT B_DMTL_GROBLECK_1 B_DMTL_GROBLECK_2 B_DMTL_STANDZEIT B_VAN_ANSCHL_OK_A1 B_VAN_ANSCHL_OK_A2 B_VAN_ANSCHL_OK_E1 B_VAN_ANSCHL_OK_E2 Bsd_error_cnt_nv can_st_empf_nv can_standverb can_standverb_anh can_standverb_apu can_standverb_dwa can_standverb_fsh can_standverb_getr can_standverb_licht can_standverb_nmi can_standverb_rw can_standverb_sh can_standverb_skl can_standverb_sl can_standverb_tece can_standverb_tus dmtl_abbr_fein dmtl_abbr_feucht_mil dmtl_abbr_ub dmtl_anz_deckel_leck dmtl_anz_dia_deckel dmtl_anz_dia_fein dmtl_anz_dia_grob dmtl_anz_fahrten dmtl_crb_cid dmtl_crb_grenze dmtl_crb_mess dmtl_flags_nv dmtl_flags_nv2 dmtl_grob_ohne_fein dmtl_i_filt dmtl_i_filt.rest dmtl_i_min dmtl_i_ref dmtl_st_nv dmtl_t_abstell dmtl_t_mess ed_css_st_inj_nv ed_css_st_inj_nv_fplau ed_css_st_inj_nv_hfm ed_css_st_inj_nv_kds ed_css_st_inj_nv_kw ed_css_st_inj_nv_pt_can ed_css_st_inj_nv_sls ed_css_st_inj_nv_ti ed_css_st_inj_nv_van ed_fsp_del_km_stand_nv ed_rbm_css_denominator_nv ed_rbm_css_numerator_nv ed_rbm_general_dcy_nv ed_rbm_ignition_count_nv ed_wuc_counter_nv eeprom_anzahl_schreiben_nv eeprom_crc_nv eeprom_crc_wichtig_nv eeprom_date eeprom_datenlaenge_nv eeprom_datenlaenge_wichtig_nv eeprom_time eeprom_version_prog_nv elu_typ_nv fst_max_nv fst_min_nv fst_rechts fst_rechts.rest fst_verbr_nv hdw_1_nv hdw_2_nv hdw_3_nv hdw_z1_nv kat_obd_wert_max_nv_b1 kat_obd_wert_max_nv_b2 kats_mdl_t_nv kats_nkat_t_nv kats_vkat_t_nv kge_ml_intg_min_nv kge_ml_mw_intg_min_nv ksd_obd_ll_max_nv_b1 ksd_obd_ll_max_nv_b2 ksd_obd_ll_min_nv_b1 ksd_obd_ll_min_nv_b2 ksd_obd_oel_sperr_nv ksd_obd_tl_max_nv_b1 ksd_obd_tl_max_nv_b2 ksd_obd_tl_min_nv_b1 ksd_obd_tl_min_nv_b2 kwp_ps_teststamp la_trim_i_ad_nv_b1 la_trim_i_ad_nv_b2 laa_offs_nv_b1 laa_offs_nv_b2 lank_obd_s_us_max_nv_b1 lank_obd_s_us_max_nv_b2 lank_obd_s_us_min_nv_b1 lank_obd_s_us_min_nv_b2 lavk_ad_gain_b1 lavk_ad_gain_b2 lavk_ad_offs_b1 lavk_ad_offs_b2 lavk_obd_dyn_wert_gesamt_nv lavk_obd_dyn_wert_min_nv_b1 lavk_obd_dyn_wert_min_nv_b2 lavk_obd_dyn_wert_nv_b1 lavk_obd_dyn_wert_nv_b2 lshnk_diag_r_gmw_nv_b1 lshnk_diag_r_gmw_nv_b2 lshvk_diag_aktiv_b1 lshvk_diag_aktiv_b2 lshvk_diag_info_b1 lshvk_diag_info_b2 lshvk_diag_r_adapt_b1 lshvk_diag_r_adapt_b2 lshvk_diag_r_adaption_b1 lshvk_diag_r_adaption_b2 lshvk_diag_r_gmw_nv_b1 lshvk_diag_r_gmw_nv_b2 lshvk_diag_sh_to_x_sperren_b1 lshvk_diag_sh_to_x_sperren_b2 lshvk_diag_st_nv_b1 lshvk_diag_st_nv_b2 lshvk_r_ad_gain_b1 lshvk_r_ad_gain_b2 lshvk_r_ad_offs_b1 lshvk_r_ad_offs_b2 mdrv_p400_only_nv mdrv_p500_start_nv mdrv_st_dsc_key0 mdrv_st_dsc_key1 mdrv_st_dsc_key2 mdrv_st_dsc_key3 mdrv_st_dsc_key4 mdrv_st_dsc_key5 mdrv_st_dsc_key6 mdrv_st_dsc_key7 mdrv_st_dsc_key8 mdrv_st_dsc_key9 mdrv_st_mod_albv_key0 mdrv_st_mod_albv_key1 mdrv_st_mod_albv_key2 mdrv_st_mod_albv_key3 mdrv_st_mod_albv_key4 mdrv_st_mod_albv_key5 mdrv_st_mod_albv_key6 mdrv_st_mod_albv_key7 mdrv_st_mod_albv_key8 mdrv_st_mod_albv_key9 mdrv_st_mod_edck_key0 mdrv_st_mod_edck_key1 mdrv_st_mod_edck_key2 mdrv_st_mod_edck_key3 mdrv_st_mod_edck_key4 mdrv_st_mod_edck_key5 mdrv_st_mod_edck_key6 mdrv_st_mod_edck_key7 mdrv_st_mod_edck_key8 mdrv_st_mod_edck_key9 mdrv_st_mod_eng_key0 mdrv_st_mod_eng_key1 mdrv_st_mod_eng_key2 mdrv_st_mod_eng_key3 mdrv_st_mod_eng_key4 mdrv_st_mod_eng_key5 mdrv_st_mod_eng_key6 mdrv_st_mod_eng_key7 mdrv_st_mod_eng_key8 mdrv_st_mod_eng_key9 mdrv_st_mod_hud_key0 mdrv_st_mod_hud_key1 mdrv_st_mod_hud_key2 mdrv_st_mod_hud_key3 mdrv_st_mod_hud_key4 mdrv_st_mod_hud_key5 mdrv_st_mod_hud_key6 mdrv_st_mod_hud_key7 mdrv_st_mod_hud_key8 mdrv_st_mod_hud_key9 mdrv_st_mod_smg_key0 mdrv_st_mod_smg_key1 mdrv_st_mod_smg_key2 mdrv_st_mod_smg_key3 mdrv_st_mod_smg_key4 mdrv_st_mod_smg_key5 mdrv_st_mod_smg_key6 mdrv_st_mod_smg_key7 mdrv_st_mod_smg_key8 mdrv_st_mod_smg_key9 mdrv_st_stg_smg_key0 mdrv_st_stg_smg_key1 mdrv_st_stg_smg_key2 mdrv_st_stg_smg_key3 mdrv_st_stg_smg_key4 mdrv_st_stg_smg_key5 mdrv_st_stg_smg_key6 mdrv_st_stg_smg_key7 mdrv_st_stg_smg_key8 mdrv_st_stg_smg_key9 n_max_ff_anzahl n_max_ff_gang n_max_ff_km_stand n_max_ff_md_fahrer n_max_ff_md_ist n_max_ff_md_wunsch n_max_ff_ml n_max_ff_n_getriebe n_max_ff_n_grad n_max_ff_n_vanos n_max_ff_nbegr_egas n_max_ff_nbegr_ti n_max_ff_nmax n_max_ff_pwg n_max_ff_schalter_inj n_max_ff_smg_st n_max_ff_t_nbegr_egas n_max_ff_tmot n_max_ff_toel n_max_ff_tsum_egas n_max_ff_tsum_ti n_max_ff_v_hinten n_max_ff_zustand_motor nw_fehlerzaehler_nv Oz_einfahr_int_akt Oz_krzmsg_can_kombi_BC Oz_krzmsg_ctr Oz_krzmsg_st Oz_lgztwert_cbs_reset_st pks_obd_abw pksr_adap_fak_nv pksr_adap_off_roh_nv pksr_st_nv psau_adapt_nv_b1 psau_adapt_nv_b2 pumg_obd_abstell_nv pumg_obd_st_nv pumg_obd_start_nv slp_t_aus_nv slp_time_on_nv sls_obdh_lam_intg_norm_maxph_nv sls_obdh_lam_intg_norm_minph_nv sls_obdh_lam_intg_norm_nv sls_obdh_mdf_max_intg_norm_nv sls_obdh_mdf_max_intg_norm_ph_nv sls_obdh_mdf_min_intg_norm_nv sls_obdh_mdf_min_intg_norm_ph_nv stat_data_nrf_nv stat_data_tdme_nv stat_data_tmot_nv stat_data_toel_nv t_mot_steht_1s_nv tanzyl_mr_off_nv tanzyl_off_nv te_obd_crb_cid_b1 te_obd_crb_cid_b2 te_obd_crb_grenze_b1 te_obd_crb_grenze_b2 te_obd_crb_mess_b1 te_obd_crb_mess_b2 ti_mks_ns_ist_abstell_b1 ti_mks_ns_ist_abstell_b2 time_abs_old time_bz_nv tksm_mr_off_nv tksm_off_nv tpu_kw_n_drop_ff.cnt tpu_kw_n_drop_ff.event_time tpu_kw_n_drop_ff.irq tpu_kw_n_drop_ff.last_period tpu_kw_n_drop_ff.n tpu_kw_n_drop_ff.n_zahn tpu_kw_n_drop_ff.prev_period tpu_kw_n_drop_ff.state tpu_kw_n_drop_ff.tooth tpu_kw_n_drop_ff.tooth_time v_max_anh_cnt_nv v_max_ff_anh_st v_max_ff_gang v_max_ff_km_stand v_max_ff_md_fahrer v_max_ff_md_ist v_max_ff_n v_max_ff_v_direkt v_max_ff_v_hinten v_max_ff_v_max v_max_ff_v_max_schw v_max_ff_v_max_st van_guete_A1 van_guete_A2 van_guete_E1 van_guete_E2 van_ist_anschl_A1 van_ist_anschl_A2 van_ist_anschl_E1 van_ist_anschl_E2 van_st_anschl wf_ist_zyl1 wf_ist_zyl10 wf_ist_zyl2 wf_ist_zyl3 wf_ist_zyl4 wf_ist_zyl5 wf_ist_zyl6 wf_ist_zyl7 wf_ist_zyl8 wf_ist_zyl9 zgla_f /end OUT_MEASUREMENT
/end FUNCTION
/begin FUNCTION Ascet_interf ""
 /begin DEF_CHARACTERISTIC K_GEN_BSD_ERROR_CC_CNT K_GEN_BSD_VARIANTE K_GEN_SLP_UG K_OELSTAND_CAN_PST_LINEAR K_OZ_1_5_L_BEGR K_OZ_1L_BEGR_O K_OZ_1L_BEGR_U K_OZ_AG_MESSSTAB_MIN_OK K_OZ_AG_MESSSTAB_OK K_OZ_AG_MESSSTAB_OK_MAX K_OZ_ALT_HYST_F K_OZ_ALT_HYST_U K_OZ_ALT_NACHF K_OZ_CC_OELVERBRAUCH K_OZ_CC_OELVERLUST K_OZ_KRZ_HYST K_OZ_KRZ_HYST_CBS K_OZ_KRZ_MESSUNG_LL K_OZ_LZW_AEND_BEGR K_OZ_MIN_LEVEL_VOL K_OZ_N_OELMAXKORR_O K_OZ_N_OELMAXKORR_U K_OZ_NIV_KM_MAX K_OZ_PM_CC_CBS_MSG_TEST K_OZ_TEMP_75 K_OZ_TEMP_KOR K_OZ_TEMPBW_KOPF K_OZ_TEMPBW_SUMPF K_OZLBESCH_STAND_CC K_OZLBESCHS K_OZORLIM2 K_OZQBESCH_STAND_CC K_OZQBESCHS K_SCHNELLMSG_ANZAHL_WERTE K_SCHNELLMSG_KL15_AUSBLEND K_SCHNELLMSG_KL15_MAX K_SCHNELLMSG_N_MAX K_SCHNELLMSG_OZLBESCHS K_SCHNELLMSG_OZQBESCHS K_SCHNELLMSG_T_MS K_SCHNELLMSG_TOEL_MIN K_SCHNELLMSG_V_MAX K_TIME_SET_1 K_TIME_SET_2 K_TIME_SET_3 KF_OZ_TEMP_KOR KF_SCHNELLMSG_OZNIVR_MIN KL_GEN_AUSL_BEGR KL_OELLEVEL_KOMBI KL_OZ_LGMW_OFFSET KL_OZ_LL_L_OFFSET KL_OZ_LL_Q_OFFSET /end DEF_CHARACTERISTIC
 /begin OUT_MEASUREMENT Acfzgl Acfzgq B_ckl30 B_ckl50 B_etumg B_fabttreg B_fahisrst B_fapmmess B_fs B_gen_bsd_error_CC B_genslp B_kl15 B_kl15_ep B_kwdreht B_ll B_ll_niv_krz B_ll_niv_krz_alt B_llrein B_oz_oelcheck_CC B_oz_oelverbr_CC B_oz_oelverlust_CC B_ozlangmw_kl15_st B_pmsv_st B_pwf B_schnellmsg_bed B_schnellmsg_fertig B_schnellmsg_oel_ok B_sta B_start B_startende B_taerr B_taners B_tumers B_vl Batt_class Bordnetz Bosbtvfbkt Bosfxid2r Bosid2r Bosjzielr Bosjzielt Bosmzielr Bosmzielt Bosrlsmr Bosrw2r Bosrw2t Bosv can_ay_10s_mw can_ay_10s_mw_sum can_fllv_eoi can_recm_rflv_eoi can_st_fllv_eoi cnt_mw_ax_ay Dfgrob Fahrzeug gen_bsd_error_cnt gen_n_elu Id_bosrst Id_bosrtt Id_bosrtw Ikurz_ogr Ikurz_ugr Iwakeupgr Km_st Kvaverbr L_pwmout Mslui Nsllm Oz_anz_kombi_AG_code Oz_anzeige_kombi Oz_anzeige_kombi_alt Oz_datstat Oz_krzmwkor_n_kor Oz_krzmwkor_temp_kor Oz_langmw_offset Oz_lf1c Oz_lf2c Oz_n_gesamtzeit Oz_n_messzeit Oz_niv_km_update Oz_offset_ll_l Oz_offset_ll_q Oz_verbleib_verh Pmsv smg_ax_10s_mw smg_ax_10s_mw_sum St_schnellmsg_check T_jahr T_monate Tchip time_set_1 time_set_2 time_set_3 time_stamp_kl15_on U_gen_slp Zrbosr Zrbosrt Ztageabs /end OUT_MEASUREMENT
/end FUNCTION
/begin FUNCTION Aussetzererkennung ""
 /begin DEF_CHARACTERISTIC K_AG_TI_ANZ K_AG_TI_CFG K_AG_TI_PAUSE K_AG_TI_V_MIN K_AG_TI_ZYL /end DEF_CHARACTERISTIC
 /begin OUT_MEASUREMENT ag_ti_anz ag_ti_anz_ctrl ag_ti_cfg_ctrl ag_ti_exd_state ag_ti_mask ag_ti_mask_zyl1 ag_ti_mask_zyl10 ag_ti_mask_zyl2 ag_ti_mask_zyl3 ag_ti_mask_zyl4 ag_ti_mask_zyl5 ag_ti_mask_zyl6 ag_ti_mask_zyl7 ag_ti_mask_zyl8 ag_ti_mask_zyl9 ag_ti_pause ag_ti_pause_ctrl ag_ti_zyl ag_ti_zyl_ctrl /end OUT_MEASUREMENT
/end FUNCTION
/begin FUNCTION Betriebssystem ""
 /begin OUT_MEASUREMENT os_err.addr os_err.deadline.cnt os_err.deadline.task os_err.dflt.cnt os_err.dflt.task os_err.fifo.cnt os_err.fifo.task os_err.id.cnt os_err.id.task os_err.limit.cnt os_err.limit.task os_err.no_fnc.cnt os_err.no_fnc.task os_err.stack.cnt os_err.stack.task os_err.sum_cnt os_err.tt_act.cnt os_err.tt_act.task os_err.tt_miss.cnt os_err.tt_miss.task os_err.type os_err.value.cnt os_err.value.task /end OUT_MEASUREMENT
/end FUNCTION
/begin FUNCTION BSD_KOMPONENTENTREIBER ""
 /begin DEF_CHARACTERISTIC K_BSD_BUS_ENABLE K_BSD_KTENABLE K_BSD_SCHEDTAB K_DI1000DT K_DI1000STG K_DI1000TGRZ K_DI200DT K_DI200STG K_DIHIGHGRZ K_DILOWGRZ K_DIPL5 K_DIPL6 K_DIPL7 K_DIPL8 K_DKL15FIL K_DTMAXGRZI K_DUIGRZ K_DUMINTGRZ K_DUREFMAX K_DUREFMINI K_ENABSDIBS K_ENISOC0 K_ENUSOC0 K_ERREPEAT K_IBSTSTERR K_IBSVERSION K_IBTEMPMAXI K_IBTEMPMINI K_IBUNPLADEL K_ISLEEPGRZ K_ISTARTTRIG K_S_CLERRIBS K_SLEEPWAIT K_T_CLERRIBS K_T_UTIEFSET K_T1SCHWELLE K_T1SOC0 K_T2SCHWELLE K_T2SOC0 K_T3SCHWELLE K_T3SOC0 K_TMPCOM_DIV K_TMPCOM_MUL K_TNUSTART K_TNUSTARTFL K_TPT1TICO K_TSLEEPRUH K_UTIEFAPP /end DEF_CHARACTERISTIC
 /begin OUT_MEASUREMENT batt_tausch_exd_timeout Bsd_cur_dev bsd_error Bsd_slot_idx Bsd_status Chk16_ibs Chkpara Comcontrol Dfbegr Dfsiggen Ebsd_adr Ebsd_errdir Ebsd_errep Ebsd_errin Ebsd_nbyt Ebsd_timo Ebsd_varin Fsclctr gen_exd_timeout Gen_manufak Gen_temp_chip Gen_typkenn history_reset_exd_timeout I_batt I_soc0 I_tnstart I_vorstart Ib_chk16 Ib_parlen Ibhwversi Ibs_errors Ibs_msgind Ibs_msgsta Ibs_reg5 Ibs_start Ibsbclctri Ibsborctr Ibsdncsctr Ibseromctr Ibsiicctri Ibslvdctr Ibsporctr Ibspromctr Ibsptyctr Ibsramctr Ibswbase Ibswchang Ibswdtctr Ierr Ierrfgrenz Kt_ibsstatus Ktib_chk16 Ktupcsctr Oz_nivr Oz_nivr_index Oz_permr Oz_status Qelad Qeladsoc0 Qlad Qladsoc0 R5cyctim Snibs St_bsd_ktenable St_bsd_ktenable.B_dev_gen1 St_bsd_ktenable.B_dev_gen2 St_bsd_ktenable.B_dev_glrd St_bsd_ktenable.B_dev_ibs St_bsd_ktenable.B_dev_oz St_bsd_ktenable.B_dev_ozon St_bsd_ktenable.B_dev_wapue St_bsd_ktenable.B_dev_wapum St_generator St_generator.B_crashgen St_generator.B_genactiv St_generator.B_genfbsd St_generator.B_genfel St_generator.B_genfht St_generator.B_genfme St_ibebsd1 St_ibebsd1.B_eb_busy St_ibebsd1.B_eb_txok St_ibebsd1.B_ibs_msgrdy St_ibebsd1.B_ibs_msgwri St_ibmix St_ibmix.B_ibrhilo St_ibmix.B_ibttog St_ibserr St_ibserr.B_ibfbsd St_ibserr.B_ibfebsd St_ibserr.B_ibunplau St_ibsreg4 St_ibsreg4.B_ibspwf St_ibsreg4.B_ibsweck St_ibsreg4.B_startfgk St_ibsreg4.B_strtaw St_ibsreg4.B_tiefset St_ibsreg5 St_ibsreg5.B_fsclr St_oz St_oz.B_anhang St_oz.B_ozfbsd St_sleep St_sleep.B_sleepwait T_batt_ibs T_batt_max T_batt_min T_battsoc0 T_battsoci T1histiruh T2histiruh T3histiruh T4histiruh Tbatt_maxi Tbatt_mini Tlrfgen Tlrgen_exd U_batt U_fgen U_gen_exd U_tnstart U_vorstart U1soc0 U2soc0 U3soc0 Unind Zbibs /end OUT_MEASUREMENT
/end FUNCTION
/begin FUNCTION Carbtelegramm "" /begin OUT_MEASUREMENT carbtlgr_aif_nummer /end OUT_MEASUREMENT /end FUNCTION
/begin FUNCTION Checksumme ""
 /begin OUT_MEASUREMENT crc32_boot crc32_boot_st crc32_data crc32_data_st crc32_prog crc32_prog_st crc32_result /end OUT_MEASUREMENT
/end FUNCTION
/begin FUNCTION coding ""
 /begin OUT_MEASUREMENT coding_array_attribute coding_init_laufzeit coding_logistics coding_umw0 coding_umw1 coding_umw2 coding_umw3 /end OUT_MEASUREMENT
/end FUNCTION
/begin FUNCTION Debugging ""
 /begin DEF_CHARACTERISTIC K_DEBUG_READ_ADR K_DEBUG_RW_LENGTH K_DEBUG_WRITE_ADR K_DEBUG_WRITE_VALUE /end DEF_CHARACTERISTIC
 /begin IN_MEASUREMENT cana_estat canb_estat qadca_qasr0 qadca_qasr1 qadcb_qasr0 qadcb_qasr1 /end IN_MEASUREMENT
 /begin OUT_MEASUREMENT bgTaskCtr cana_ctBoffDbounce canb_ctBoffDbounce debug_rw_result hwTaskCtr r100msTaskCtr r10msTaskCtr r1msTaskCtr r1sTaskCtr r5msTaskCtr syncTaskCtr /end OUT_MEASUREMENT
/end FUNCTION
/begin RECORD_LAYOUT TKF_SW_SW_SW FNC_VALUES 5 SWORD COLUMN_DIR DIRECT AXIS_PTS_X 3 SWORD INDEX_INCR DIRECT AXIS_PTS_Y 4 SWORD INDEX_INCR DIRECT NO_AXIS_PTS_X 1 UBYTE NO_AXIS_PTS_Y 2 UBYTE /end RECORD_LAYOUT
/begin RECORD_LAYOUT TKF_SW_SW_UW FNC_VALUES 5 UWORD COLUMN_DIR DIRECT AXIS_PTS_X 3 SWORD INDEX_INCR DIRECT AXIS_PTS_Y 4 SWORD INDEX_INCR DIRECT NO_AXIS_PTS_X 1 UBYTE NO_AXIS_PTS_Y 2 UBYTE /end RECORD_LAYOUT
/begin RECORD_LAYOUT TKL_SW_VV_SB FNC_VALUES 4 SBYTE COLUMN_DIR DIRECT AXIS_PTS_X 3 SWORD INDEX_INCR DIRECT NO_AXIS_PTS_X 1 UBYTE RESERVED 2 BYTE /end RECORD_LAYOUT
/begin RECORD_LAYOUT TKL_SW_VV_UB FNC_VALUES 4 UBYTE COLUMN_DIR DIRECT AXIS_PTS_X 3 SWORD INDEX_INCR DIRECT NO_AXIS_PTS_X 1 UBYTE RESERVED 2 BYTE /end RECORD_LAYOUT
/begin RECORD_LAYOUT TKL_UB_VV_UB FNC_VALUES 4 UBYTE COLUMN_DIR DIRECT AXIS_PTS_X 3 UBYTE INDEX_INCR DIRECT NO_AXIS_PTS_X 1 UBYTE RESERVED 2 BYTE /end RECORD_LAYOUT
/begin RECORD_LAYOUT TKW_VV_VV_SB FNC_VALUES 1 SBYTE COLUMN_DIR DIRECT /end RECORD_LAYOUT
/begin RECORD_LAYOUT TKW_VV_VV_SW FNC_VALUES 1 SWORD COLUMN_DIR DIRECT /end RECORD_LAYOUT
/begin RECORD_LAYOUT TKW_VV_VV_UB FNC_VALUES 1 UBYTE COLUMN_DIR DIRECT /end RECORD_LAYOUT
/begin RECORD_LAYOUT TKW_VV_VV_UL FNC_VALUES 1 ULONG COLUMN_DIR DIRECT /end RECORD_LAYOUT
/begin RECORD_LAYOUT TKW_VV_VV_UW FNC_VALUES 1 UWORD COLUMN_DIR DIRECT /end RECORD_LAYOUT
/end MODULE
/end PROJECT
