ASAP2_VERSION 1 31
/begin PROJECT MS45 "BMW Motorsteuerung R6"
/begin HEADER "_default_HeaderComment" PROJECT_NO _56 /end HEADER
/begin MODULE _default_ModuleName "_default_ModuleLongIdentifier"
/begin MOD_COMMON "_default_ModCommonComment" DEPOSIT ABSOLUTE BYTE_ORDER MSB_FIRST ALIGNMENT_BYTE 1 ALIGNMENT_WORD 2 ALIGNMENT_LONG 4 ALIGNMENT_FLOAT32_IEEE 4 ALIGNMENT_FLOAT64_IEEE 8 /end MOD_COMMON
/begin MEASUREMENT lam_bank_1.ls_down_cur.bf.lv_r_down_ls_det "Boolean flag indicating that resistance has already been determined in current lean phase(lock out)" ULONG _CNV_S_2_RANGE______0_CM 1 100. 0. 1. DISPLAY_IDENTIFIER LV_R_DOWN_LS_DET_1 ECU_ADDRESS 0x3fc388 BYTE_ORDER MSB_LAST BIT_MASK 0x10000000 /end MEASUREMENT
/begin MEASUREMENT lam_bank_1.ls_down_cur.bf.lv_r_down_ls_drv1_vls_cdn "Boolean flag indicating that low gradient condition met" ULONG _CNV_S_2_RANGE______0_CM 1 100. 0. 1. DISPLAY_IDENTIFIER LV_R_DOWN_LS_DRV1_VLS_CDN_1 ECU_ADDRESS 0x3fc388 BYTE_ORDER MSB_LAST BIT_MASK 0x80000000 /end MEASUREMENT
/begin MEASUREMENT lam_bank_1.ls_down_cur.bf.lv_r_down_ls_ena "Boolean flag indicating that conditions have been met and resistance determination requested" ULONG _CNV_S_2_RANGE______0_CM 1 100. 0. 1. DISPLAY_IDENTIFIER LV_R_DOWN_LS_ENA_1 ECU_ADDRESS 0x3fc388 BYTE_ORDER MSB_LAST BIT_MASK 0x20000000 /end MEASUREMENT
/begin MEASUREMENT lam_bank_1.ls_down_cur.bf.lv_r_down_ls_vls_rng_cdn "Boolean flag indicating that VLS_DOWN at low gradient condition met" ULONG _CNV_S_2_RANGE______0_CM 1 100. 0. 1. DISPLAY_IDENTIFIER LV_R_DOWN_LS_VLS_RNG_CDN_1 ECU_ADDRESS 0x3fc388 BYTE_ORDER MSB_LAST BIT_MASK 0x40000000 /end MEASUREMENT
/begin MEASUREMENT lam_bank_1.ls_down_cur.bf.lv_vls_not_vld_down "Boolean flag indicating that VLS_DOWN_i signal not valid, i.e. masked due to Ri determination" ULONG _CNV_S_2_RANGE______0_CM 1 100. 0. 1. DISPLAY_IDENTIFIER LV_VLS_NOT_VLD_DOWN_1 ECU_ADDRESS 0x3fc388 BYTE_ORDER MSB_LAST BIT_MASK 0x8000000 /end MEASUREMENT
/begin MEASUREMENT lam_bank_1.ls_down_cur.ctr_cycnr_r_down_ls "Handshake counter indicating the number of valid resistance values determined since initial activation" UWORD _CNV_A_R_LINEAR_____1_CM 1 100. 0. 65535. DISPLAY_IDENTIFIER CTR_CYCNR_R_DOWN_LS_1 ECU_ADDRESS 0x3fc394 BYTE_ORDER MSB_LAST FORMAT "%5.0" /end MEASUREMENT
/begin MEASUREMENT lam_bank_1.ls_down_cur.drv1_vls_down_mmv_thd_max "Upper variable VLS_DOWN gradient threshold" SWORD _CNV_A_R_LINEAR_____276_CM 1 100. -2.5 2.4999 DISPLAY_IDENTIFIER DRV1_VLS_DOWN_MMV_THD_MAX_1 ECU_ADDRESS 0x3fc3a2 BYTE_ORDER MSB_LAST FORMAT "%7.4" /end MEASUREMENT
/begin MEASUREMENT lam_bank_1.ls_down_cur.drv1_vls_down_mmv_thd_min "Lower variable VLS_DOWN gradient threshold" SWORD _CNV_A_R_LINEAR_____276_CM 1 100. -2.5 2.4999 DISPLAY_IDENTIFIER DRV1_VLS_DOWN_MMV_THD_MIN_1 ECU_ADDRESS 0x3fc3a4 BYTE_ORDER MSB_LAST FORMAT "%7.4" /end MEASUREMENT
/begin MEASUREMENT lam_bank_1.ls_down_cur.fac_t_drv1_vls_down_abs "Multiplicative factor modifies C_DRV1_VLS_DOWN_ABS_MAX dependent on T_VLS_CYC_AFL_HLD" UBYTE _CNV_A_R_LINEAR_____46_CM 1 100. 0. 15.9375 DISPLAY_IDENTIFIER FAC_T_DRV1_VLS_DOWN_ABS_1 ECU_ADDRESS 0x3fc390 FORMAT "%5.2" /end MEASUREMENT
/begin MEASUREMENT lam_bank_1.ls_down_cur.fac_t_drv1_vls_down_mmv "Multiplicative factor modifies DRV1_VLS_DOWN_MMV_MIN_THD dependent on T_VLS_CYC_AFL_HLD" UBYTE _CNV_A_R_LINEAR_____278_CM 1 100. 0. 63.75 DISPLAY_IDENTIFIER FAC_T_DRV1_VLS_DOWN_MMV_1 ECU_ADDRESS 0x3fc391 FORMAT "%4.1" /end MEASUREMENT
/begin MEASUREMENT lam_bank_1.ls_down_cur.r_down_ls_mes "Internal resistance of downstream oxygen sensor (Measured)" UWORD _CNV_A_R_LINEAR_____279_CM 1 100. 0. 65535. DISPLAY_IDENTIFIER R_DOWN_LS_MES_1 ECU_ADDRESS 0x3fc398 BYTE_ORDER MSB_LAST FORMAT "%5.0" /end MEASUREMENT
/begin MEASUREMENT lam_bank_1.ls_down_cur.t_sample_r_down_ls "Time measured between internal resistance samples" UWORD _CNV_A_R_LINEAR_____4_CM 1 100. 0. 655.35 DISPLAY_IDENTIFIER T_SAMPLE_R_DOWN_LS_1 ECU_ADDRESS 0x3fc3a0 BYTE_ORDER MSB_LAST FORMAT "%6.2" /end MEASUREMENT
/begin MEASUREMENT lam_bank_1.ls_down_cur.t_vls_cyc_afl_hld_r_down_ls "Lean mixture cycle time (measured upstream), held until next threshold crossing downstream" UBYTE _CNV_A_R_LINEAR_____4_CM 1 100. 0. 2.55 DISPLAY_IDENTIFIER T_VLS_CYC_AFL_HLD_R_DOWN_LS_1 ECU_ADDRESS 0x3fc392 FORMAT "%4.2" /end MEASUREMENT
/begin MEASUREMENT lam_bank_1.ls_down_cur.ttip_ls_down_mes "Downstream oxygen sensor ceramic temperature" SWORD _CNV_A_R_LINEAR_____280_CM 1 100. -2048. 2047.938 DISPLAY_IDENTIFIER TTIP_LS_DOWN_MES_1 ECU_ADDRESS 0x3fc3a6 BYTE_ORDER MSB_LAST FORMAT "%8.2" /end MEASUREMENT
/begin MEASUREMENT lam_bank_1.ls_down_cur.ttip_ls_down_mes_bol "Downstream oxygen sensor ceramic temperature, Lower limit, Unfiltered" SWORD _CNV_A_R_LINEAR_____280_CM 1 100. -2048. 2047.938 DISPLAY_IDENTIFIER TTIP_LS_DOWN_MES_BOL_1 ECU_ADDRESS 0x3fc3aa BYTE_ORDER MSB_LAST FORMAT "%8.2" /end MEASUREMENT
/begin MEASUREMENT lam_bank_1.ls_down_cur.ttip_ls_down_mes_bol_mmv "Downstream oxygen sensor ceramic temperature, Lower limit, Filtered" SWORD _CNV_A_R_LINEAR_____280_CM 1 100. -2048. 2047.938 DISPLAY_IDENTIFIER TTIP_LS_DOWN_MES_BOL_MMV_1 ECU_ADDRESS 0x3fc3b0 BYTE_ORDER MSB_LAST FORMAT "%8.2" /end MEASUREMENT
/begin MEASUREMENT lam_bank_1.ls_down_cur.ttip_ls_down_mes_tol "Downstream oxygen sensor ceramic temperature, Upper limit, Unfiltered" SWORD _CNV_A_R_LINEAR_____280_CM 1 100. -2048. 2047.938 DISPLAY_IDENTIFIER TTIP_LS_DOWN_MES_TOL_1 ECU_ADDRESS 0x3fc3a8 BYTE_ORDER MSB_LAST FORMAT "%8.2" /end MEASUREMENT
/begin MEASUREMENT lam_bank_1.ls_down_cur.ttip_ls_down_mes_tol_mmv "Downstream oxygen sensor ceramic temperature, Upper limit, Filtered" SWORD _CNV_A_R_LINEAR_____280_CM 1 100. -2048. 2047.938 DISPLAY_IDENTIFIER TTIP_LS_DOWN_MES_TOL_MMV_1 ECU_ADDRESS 0x3fc3ac BYTE_ORDER MSB_LAST FORMAT "%8.2" /end MEASUREMENT
/begin MEASUREMENT lam_bank_1.ls_down_cur.r_down_ls_mdl_sens_new "Internal resistance of downstream oxygen sensor (Modelled for new sensor)" UWORD _CNV_A_R_LINEAR_____279_CM 1 100. 0. 65535. DISPLAY_IDENTIFIER R_DOWN_LS_MDL_SENS_NEW_1 ECU_ADDRESS 0x3fc39c BYTE_ORDER MSB_LAST FORMAT "%5.0" /end MEASUREMENT
/begin MEASUREMENT lam_bank_1.ls_down_cur.pow_lsh_down_mmv "Moving mean value of downstream oxygen sensor heater power" UWORD _CNV_A_R_LINEAR_____281_CM 1 100. 0. 65.535 DISPLAY_IDENTIFIER POW_LSH_DOWN_MMV_1 ECU_ADDRESS 0x3fc39e BYTE_ORDER MSB_LAST /end MEASUREMENT
/begin MEASUREMENT lam_bank_1.ls_down_cur.ttip_ref_ls_down_mdl_mmv "Reference of downstream oxygen sensor ceramic temperature (Modelled for new sensor)" UWORD _CNV_A_R_LINEAR_____282_CM 1 100. 0. 2047.938 DISPLAY_IDENTIFIER TTIP_REF_LS_DOWN_MDL_MMV_1 ECU_ADDRESS 0x3fc3b4 BYTE_ORDER MSB_LAST FORMAT "%7.3" /end MEASUREMENT
/begin MEASUREMENT lam_bank_1.ls_up_cur.bf.lv_r_up_ls_det "Boolean flag indicating that resistance has already been determined in current lean phase(lock out)" ULONG _CNV_S_2_RANGE______0_CM 1 100. 0. 1. DISPLAY_IDENTIFIER LV_R_UP_LS_DET_1 ECU_ADDRESS 0x3fc4c0 BYTE_ORDER MSB_LAST BIT_MASK 0x10000000 /end MEASUREMENT
/begin MEASUREMENT lam_bank_1.ls_up_cur.bf.lv_r_up_ls_drv1_vls_cdn "Boolean flag indicating that VLS_UP at low gradient condition met" ULONG _CNV_S_2_RANGE______0_CM 1 100. 0. 1. DISPLAY_IDENTIFIER LV_R_UP_LS_DRV1_VLS_CDN_1 ECU_ADDRESS 0x3fc4c0 BYTE_ORDER MSB_LAST BIT_MASK 0x80000000 /end MEASUREMENT
/begin MEASUREMENT lam_bank_1.ls_up_cur.bf.lv_r_up_ls_ena "Boolean flag indicating that application conditions have been met" ULONG _CNV_S_2_RANGE______0_CM 1 100. 0. 1. DISPLAY_IDENTIFIER LV_R_UP_LS_ENA_1 ECU_ADDRESS 0x3fc4c0 BYTE_ORDER MSB_LAST BIT_MASK 0x20000000 /end MEASUREMENT
/begin MEASUREMENT lam_bank_1.ls_up_cur.bf.lv_r_up_ls_vls_rng_cdn "Boolean flag indicating that VLS_UP at low gradient condition met" ULONG _CNV_S_2_RANGE______0_CM 1 100. 0. 1. DISPLAY_IDENTIFIER LV_R_UP_LS_VLS_RNG_CDN_1 ECU_ADDRESS 0x3fc4c0 BYTE_ORDER MSB_LAST BIT_MASK 0x40000000 /end MEASUREMENT
/begin MEASUREMENT lam_bank_1.ls_up_cur.bf.lv_vls_not_vld_up "Boolean flag indicating that VLS_UP_i signal not valid, i.e. masked due to Ri determination" ULONG _CNV_S_2_RANGE______0_CM 1 100. 0. 1. DISPLAY_IDENTIFIER LV_VLS_NOT_VLD_UP_1 ECU_ADDRESS 0x3fc4c0 BYTE_ORDER MSB_LAST BIT_MASK 0x8000000 /end MEASUREMENT
/begin MEASUREMENT lam_bank_1.ls_up_cur.ctr_cycnr_r_up_ls "Handshake counter indicating the number of valid resistance values determined since initial activation" UWORD _CNV_A_R_LINEAR_____1_CM 1 100. 0. 65535. DISPLAY_IDENTIFIER CTR_CYCNR_R_UP_LS_1 ECU_ADDRESS 0x3fc4ca BYTE_ORDER MSB_LAST FORMAT "%5.0" /end MEASUREMENT
/begin MEASUREMENT lam_bank_1.ls_up_cur.drv1_vls_up_mmv_thd_max "Upper variable VLS_UP gradient threshold" SWORD _CNV_A_R_LINEAR_____276_CM 1 100. -2.5 2.4999 DISPLAY_IDENTIFIER DRV1_VLS_UP_MMV_THD_MAX_1 ECU_ADDRESS 0x3fc4d4 BYTE_ORDER MSB_LAST FORMAT "%7.4" /end MEASUREMENT
/begin MEASUREMENT lam_bank_1.ls_up_cur.drv1_vls_up_mmv_thd_min "Lower variable VLS_UP gradient threshold" SWORD _CNV_A_R_LINEAR_____276_CM 1 100. -2.5 2.4999 DISPLAY_IDENTIFIER DRV1_VLS_UP_MMV_THD_MIN_1 ECU_ADDRESS 0x3fc4d6 BYTE_ORDER MSB_LAST FORMAT "%7.4" /end MEASUREMENT
/begin MEASUREMENT lam_bank_1.ls_up_cur.fac_t_drv1_vls_up_abs "Multiplicative factor modifies C_DRV1_VLS_UP_ABS_MAX dependent on T_VLS_CYC_AFL_HLD" UBYTE _CNV_A_R_LINEAR_____46_CM 1 100. 0. 15.9375 DISPLAY_IDENTIFIER FAC_T_DRV1_VLS_UP_ABS_1 ECU_ADDRESS 0x3fc4c8 FORMAT "%5.2" /end MEASUREMENT
/begin MEASUREMENT lam_bank_1.ls_up_cur.fac_t_drv1_vls_up_mmv "Multiplicative factor modifies DRV1_VLS_UP_MMV_MIN_THD dependent on T_VLS_CYC_AFL_HLD" UBYTE _CNV_A_R_LINEAR_____278_CM 1 100. 0. 63.75 DISPLAY_IDENTIFIER FAC_T_DRV1_VLS_UP_MMV_1 ECU_ADDRESS 0x3fc4c9 FORMAT "%4.1" /end MEASUREMENT
/begin MEASUREMENT lam_bank_1.ls_up_cur.r_up_ls "Internal resistance of upstream oxygen sensor, cylinder bank i" UWORD _CNV_A_R_LINEAR_____279_CM 1 100. 0. 65535. DISPLAY_IDENTIFIER R_UP_LS_1 ECU_ADDRESS 0x3fc4cc BYTE_ORDER MSB_LAST FORMAT "%5.0" /end MEASUREMENT
/begin MEASUREMENT lam_bank_1.ls_up_cur.r_up_ls_mes "Internal resistance of upstream oxygen sensor (Measured)" UWORD _CNV_A_R_LINEAR_____279_CM 1 100. 0. 65535. DISPLAY_IDENTIFIER R_UP_LS_MES_1 ECU_ADDRESS 0x3fc4ce BYTE_ORDER MSB_LAST FORMAT "%5.0" /end MEASUREMENT
/begin MEASUREMENT lam_bank_1.ls_up_cur.t_sample_r_up_ls "Time measured between internal resistance samples" UWORD _CNV_A_R_LINEAR_____4_CM 1 100. 0. 655.35 DISPLAY_IDENTIFIER T_SAMPLE_R_UP_LS_1 ECU_ADDRESS 0x3fc4d2 BYTE_ORDER MSB_LAST FORMAT "%6.2" /end MEASUREMENT
/begin MEASUREMENT lam_bank_1.ls_up_cur.ttip_ls_up_mes "Upstream oxygen sensor ceramic temperature" SWORD _CNV_A_R_LINEAR_____280_CM 1 100. -2048. 2047.938 DISPLAY_IDENTIFIER TTIP_LS_UP_MES_1 ECU_ADDRESS 0x3fc4d8 BYTE_ORDER MSB_LAST FORMAT "%8.2" /end MEASUREMENT
/begin MEASUREMENT lam_bank_1.ls_up_cur.ttip_ls_up_mes_bol "Upstream oxygen sensor ceramic temperature, Lower limit, Unfiltered" SWORD _CNV_A_R_LINEAR_____280_CM 1 100. -2048. 2047.938 DISPLAY_IDENTIFIER TTIP_LS_UP_MES_BOL_1 ECU_ADDRESS 0x3fc4dc BYTE_ORDER MSB_LAST FORMAT "%8.2" /end MEASUREMENT
/begin MEASUREMENT lam_bank_1.ls_up_cur.ttip_ls_up_mes_bol_mmv "Upstream oxygen sensor ceramic temperature, Lower limit, Unfiltered" SWORD _CNV_A_R_LINEAR_____280_CM 1 100. -2048. 2047.938 DISPLAY_IDENTIFIER TTIP_LS_UP_MES_BOL_MMV_1 ECU_ADDRESS 0x3fc4e2 BYTE_ORDER MSB_LAST FORMAT "%8.2" /end MEASUREMENT
/begin MEASUREMENT lam_bank_1.ls_up_cur.ttip_ls_up_mes_tol "Downstream oxygen sensor ceramic temperature, Upper limit, Unfiltered" SWORD _CNV_A_R_LINEAR_____280_CM 1 100. -2048. 2047.938 DISPLAY_IDENTIFIER TTIP_LS_UP_MES_TOL_1 ECU_ADDRESS 0x3fc4da BYTE_ORDER MSB_LAST FORMAT "%8.2" /end MEASUREMENT
/begin MEASUREMENT lam_bank_1.ls_up_cur.ttip_ls_up_mes_tol_mmv "Upstream oxygen sensor ceramic temperature, Lower limit, Unfiltered" SWORD _CNV_A_R_LINEAR_____280_CM 1 100. -2048. 2047.938 DISPLAY_IDENTIFIER TTIP_LS_UP_MES_TOL_MMV_1 ECU_ADDRESS 0x3fc4de BYTE_ORDER MSB_LAST FORMAT "%8.2" /end MEASUREMENT
/begin MEASUREMENT lam_bank_1.ls_up_cur.r_up_ls_mdl_sens_new "Internal resistance of upstream oxygen sensor (Modelled for new sensor)" UWORD _CNV_A_R_LINEAR_____279_CM 1 100. 0. 65535. DISPLAY_IDENTIFIER R_UP_LS_MDL_SENS_NEW_1 ECU_ADDRESS 0x3fc4e8 BYTE_ORDER MSB_LAST FORMAT "%5.0" /end MEASUREMENT
/begin MEASUREMENT lam_bank_1.ls_up_cur.pow_lsh_up_mmv "Moving_mean value of upstream oxygen sensor heater power" UWORD _CNV_A_R_LINEAR_____281_CM 1 100. 0. 65.535 DISPLAY_IDENTIFIER POW_LSH_UP_MMV_1 ECU_ADDRESS 0x3fc4ea BYTE_ORDER MSB_LAST /end MEASUREMENT
/begin MEASUREMENT lam_bank_1.ls_up_cur.ttip_ref_ls_up_mdl_mmv "Reference of upstream oxygen sensor ceramic temperature (Modelled for new sensor)" UWORD _CNV_A_R_LINEAR_____283_CM 1 100. 0. 2047.96875 DISPLAY_IDENTIFIER TTIP_REF_LS_UP_MDL_MMV_1 ECU_ADDRESS 0x3fc4ec BYTE_ORDER MSB_LAST FORMAT "%7.2" /end MEASUREMENT
/begin MEASUREMENT lam_bank_2.ls_down_cur.bf.lv_r_down_ls_det "Boolean flag indicating that resistance has already been determined in current lean phase(lock out)" ULONG _CNV_S_2_RANGE______0_CM 1 100. 0. 1. DISPLAY_IDENTIFIER LV_R_DOWN_LS_DET_2 ECU_ADDRESS 0x3fc6ec BYTE_ORDER MSB_LAST BIT_MASK 0x10000000 /end MEASUREMENT
/begin MEASUREMENT lam_bank_2.ls_down_cur.bf.lv_r_down_ls_drv1_vls_cdn "Boolean flag indicating that low gradient condition met" ULONG _CNV_S_2_RANGE______0_CM 1 100. 0. 1. DISPLAY_IDENTIFIER LV_R_DOWN_LS_DRV1_VLS_CDN_2 ECU_ADDRESS 0x3fc6ec BYTE_ORDER MSB_LAST BIT_MASK 0x80000000 /end MEASUREMENT
/begin MEASUREMENT lam_bank_2.ls_down_cur.bf.lv_r_down_ls_ena "Boolean flag indicating that conditions have been met and resistance determination requested" ULONG _CNV_S_2_RANGE______0_CM 1 100. 0. 1. DISPLAY_IDENTIFIER LV_R_DOWN_LS_ENA_2 ECU_ADDRESS 0x3fc6ec BYTE_ORDER MSB_LAST BIT_MASK 0x20000000 /end MEASUREMENT
/begin MEASUREMENT lam_bank_2.ls_down_cur.bf.lv_r_down_ls_vls_rng_cdn "Boolean flag indicating that VLS_DOWN at low gradient condition met" ULONG _CNV_S_2_RANGE______0_CM 1 100. 0. 1. DISPLAY_IDENTIFIER LV_R_DOWN_LS_VLS_RNG_CDN_2 ECU_ADDRESS 0x3fc6ec BYTE_ORDER MSB_LAST BIT_MASK 0x40000000 /end MEASUREMENT
/begin MEASUREMENT lam_bank_2.ls_down_cur.bf.lv_vls_not_vld_down "Boolean flag indicating that VLS_DOWN_i signal not valid, i.e. masked due to Ri determination" ULONG _CNV_S_2_RANGE______0_CM 1 100. 0. 1. DISPLAY_IDENTIFIER LV_VLS_NOT_VLD_DOWN_2 ECU_ADDRESS 0x3fc6ec BYTE_ORDER MSB_LAST BIT_MASK 0x8000000 /end MEASUREMENT
/begin MEASUREMENT lam_bank_2.ls_down_cur.ctr_cycnr_r_down_ls "Handshake counter indicating the number of valid resistance values determined since initial activation" UWORD _CNV_A_R_LINEAR_____1_CM 1 100. 0. 65535. DISPLAY_IDENTIFIER CTR_CYCNR_R_DOWN_LS_2 ECU_ADDRESS 0x3fc6f8 BYTE_ORDER MSB_LAST FORMAT "%5.0" /end MEASUREMENT
/begin MEASUREMENT lam_bank_2.ls_down_cur.drv1_vls_down_mmv_thd_max "Upper variable VLS_DOWN gradient threshold" SWORD _CNV_A_R_LINEAR_____276_CM 1 100. -2.5 2.4999 DISPLAY_IDENTIFIER DRV1_VLS_DOWN_MMV_THD_MAX_2 ECU_ADDRESS 0x3fc706 BYTE_ORDER MSB_LAST FORMAT "%7.4" /end MEASUREMENT
/begin MEASUREMENT lam_bank_2.ls_down_cur.drv1_vls_down_mmv_thd_min "Lower variable VLS_DOWN gradient threshold" SWORD _CNV_A_R_LINEAR_____276_CM 1 100. -2.5 2.4999 DISPLAY_IDENTIFIER DRV1_VLS_DOWN_MMV_THD_MIN_2 ECU_ADDRESS 0x3fc708 BYTE_ORDER MSB_LAST FORMAT "%7.4" /end MEASUREMENT
/begin MEASUREMENT lam_bank_2.ls_down_cur.fac_t_drv1_vls_down_abs "Multiplicative factor modifies C_DRV1_VLS_DOWN_ABS_MAX dependent on T_VLS_CYC_AFL_HLD" UBYTE _CNV_A_R_LINEAR_____46_CM 1 100. 0. 15.9375 DISPLAY_IDENTIFIER FAC_T_DRV1_VLS_DOWN_ABS_2 ECU_ADDRESS 0x3fc6f4 FORMAT "%5.2" /end MEASUREMENT
/begin MEASUREMENT lam_bank_2.ls_down_cur.fac_t_drv1_vls_down_mmv "Multiplicative factor modifies DRV1_VLS_DOWN_MMV_MIN_THD dependent on T_VLS_CYC_AFL_HLD" UBYTE _CNV_A_R_LINEAR_____278_CM 1 100. 0. 63.75 DISPLAY_IDENTIFIER FAC_T_DRV1_VLS_DOWN_MMV_2 ECU_ADDRESS 0x3fc6f5 FORMAT "%4.1" /end MEASUREMENT
/begin MEASUREMENT lam_bank_2.ls_down_cur.r_down_ls_mes "Internal resistance of downstream oxygen sensor (Measured)" UWORD _CNV_A_R_LINEAR_____279_CM 1 100. 0. 65535. DISPLAY_IDENTIFIER R_DOWN_LS_MES_2 ECU_ADDRESS 0x3fc6fc BYTE_ORDER MSB_LAST FORMAT "%5.0" /end MEASUREMENT
/begin MEASUREMENT lam_bank_2.ls_down_cur.t_sample_r_down_ls "Time measured between internal resistance samples" UWORD _CNV_A_R_LINEAR_____4_CM 1 100. 0. 655.35 DISPLAY_IDENTIFIER T_SAMPLE_R_DOWN_LS_2 ECU_ADDRESS 0x3fc704 BYTE_ORDER MSB_LAST FORMAT "%6.2" /end MEASUREMENT
/begin MEASUREMENT lam_bank_2.ls_down_cur.t_vls_cyc_afl_hld_r_down_ls "Lean mixture cycle time (measured upstream), held until next threshold crossing downstream" UBYTE _CNV_A_R_LINEAR_____4_CM 1 100. 0. 2.55 DISPLAY_IDENTIFIER T_VLS_CYC_AFL_HLD_R_DOWN_LS_2 ECU_ADDRESS 0x3fc6f6 FORMAT "%4.2" /end MEASUREMENT
/begin MEASUREMENT lam_bank_2.ls_down_cur.ttip_ls_down_mes "Downstream oxygen sensor ceramic temperature" SWORD _CNV_A_R_LINEAR_____280_CM 1 100. -2048. 2047.938 DISPLAY_IDENTIFIER TTIP_LS_DOWN_MES_2 ECU_ADDRESS 0x3fc70a BYTE_ORDER MSB_LAST FORMAT "%8.2" /end MEASUREMENT
/begin MEASUREMENT lam_bank_2.ls_down_cur.ttip_ls_down_mes_bol "Downstream oxygen sensor ceramic temperature, Lower limit, Unfiltered" SWORD _CNV_A_R_LINEAR_____280_CM 1 100. -2048. 2047.938 DISPLAY_IDENTIFIER TTIP_LS_DOWN_MES_BOL_2 ECU_ADDRESS 0x3fc70e BYTE_ORDER MSB_LAST FORMAT "%8.2" /end MEASUREMENT
/begin MEASUREMENT lam_bank_2.ls_down_cur.ttip_ls_down_mes_bol_mmv "Downstream oxygen sensor ceramic temperature, Lower limit, Filtered" SWORD _CNV_A_R_LINEAR_____280_CM 1 100. -2048. 2047.938 DISPLAY_IDENTIFIER TTIP_LS_DOWN_MES_BOL_MMV_2 ECU_ADDRESS 0x3fc714 BYTE_ORDER MSB_LAST FORMAT "%8.2" /end MEASUREMENT
/begin MEASUREMENT lam_bank_2.ls_down_cur.ttip_ls_down_mes_tol "Downstream oxygen sensor ceramic temperature, Upper limit, Unfiltered" SWORD _CNV_A_R_LINEAR_____280_CM 1 100. -2048. 2047.938 DISPLAY_IDENTIFIER TTIP_LS_DOWN_MES_TOL_2 ECU_ADDRESS 0x3fc70c BYTE_ORDER MSB_LAST FORMAT "%8.2" /end MEASUREMENT
/begin MEASUREMENT lam_bank_2.ls_down_cur.ttip_ls_down_mes_tol_mmv "Downstream oxygen sensor ceramic temperature, Upper limit, Filtered" SWORD _CNV_A_R_LINEAR_____280_CM 1 100. -2048. 2047.938 DISPLAY_IDENTIFIER TTIP_LS_DOWN_MES_TOL_MMV_2 ECU_ADDRESS 0x3fc710 BYTE_ORDER MSB_LAST FORMAT "%8.2" /end MEASUREMENT
/begin MEASUREMENT lam_bank_2.ls_down_cur.r_down_ls_mdl_sens_new "Internal resistance of downstream oxygen sensor (Modelled for new sensor)" UWORD _CNV_A_R_LINEAR_____279_CM 1 100. 0. 65535. DISPLAY_IDENTIFIER R_DOWN_LS_MDL_SENS_NEW_2 ECU_ADDRESS 0x3fc700 BYTE_ORDER MSB_LAST FORMAT "%5.0" /end MEASUREMENT
/begin MEASUREMENT lam_bank_2.ls_down_cur.pow_lsh_down_mmv "Moving mean value of downstream oxygen sensor heater power" UWORD _CNV_A_R_LINEAR_____281_CM 1 100. 0. 65.535 DISPLAY_IDENTIFIER POW_LSH_DOWN_MMV_2 ECU_ADDRESS 0x3fc702 BYTE_ORDER MSB_LAST /end MEASUREMENT
/begin MEASUREMENT lam_bank_2.ls_down_cur.ttip_ref_ls_down_mdl_mmv "Reference of downstream oxygen sensor ceramic temperature (Modelled for new sensor)" UWORD _CNV_A_R_LINEAR_____282_CM 1 100. 0. 2047.938 DISPLAY_IDENTIFIER TTIP_REF_LS_DOWN_MDL_MMV_2 ECU_ADDRESS 0x3fc718 BYTE_ORDER MSB_LAST FORMAT "%7.3" /end MEASUREMENT
/begin MEASUREMENT lam_bank_2.ls_up_cur.bf.lv_r_up_ls_det "Boolean flag indicating that resistance has already been determined in current lean phase(lock out)" ULONG _CNV_S_2_RANGE______0_CM 1 100. 0. 1. DISPLAY_IDENTIFIER LV_R_UP_LS_DET_2 ECU_ADDRESS 0x3fc824 BYTE_ORDER MSB_LAST BIT_MASK 0x10000000 /end MEASUREMENT
/begin MEASUREMENT lam_bank_2.ls_up_cur.bf.lv_r_up_ls_drv1_vls_cdn "Boolean flag indicating that VLS_UP at low gradient condition met" ULONG _CNV_S_2_RANGE______0_CM 1 100. 0. 1. DISPLAY_IDENTIFIER LV_R_UP_LS_DRV1_VLS_CDN_2 ECU_ADDRESS 0x3fc824 BYTE_ORDER MSB_LAST BIT_MASK 0x80000000 /end MEASUREMENT
/begin MEASUREMENT lam_bank_2.ls_up_cur.bf.lv_r_up_ls_ena "Boolean flag indicating that application conditions have been met" ULONG _CNV_S_2_RANGE______0_CM 1 100. 0. 1. DISPLAY_IDENTIFIER LV_R_UP_LS_ENA_2 ECU_ADDRESS 0x3fc824 BYTE_ORDER MSB_LAST BIT_MASK 0x20000000 /end MEASUREMENT
/begin MEASUREMENT lam_bank_2.ls_up_cur.bf.lv_r_up_ls_vls_rng_cdn "Boolean flag indicating that VLS_UP at low gradient condition met" ULONG _CNV_S_2_RANGE______0_CM 1 100. 0. 1. DISPLAY_IDENTIFIER LV_R_UP_LS_VLS_RNG_CDN_2 ECU_ADDRESS 0x3fc824 BYTE_ORDER MSB_LAST BIT_MASK 0x40000000 /end MEASUREMENT
/begin MEASUREMENT lam_bank_2.ls_up_cur.bf.lv_vls_not_vld_up "Boolean flag indicating that VLS_UP_i signal not valid, i.e. masked due to Ri determination" ULONG _CNV_S_2_RANGE______0_CM 1 100. 0. 1. DISPLAY_IDENTIFIER LV_VLS_NOT_VLD_UP_2 ECU_ADDRESS 0x3fc824 BYTE_ORDER MSB_LAST BIT_MASK 0x8000000 /end MEASUREMENT
/begin MEASUREMENT lam_bank_2.ls_up_cur.ctr_cycnr_r_up_ls "Handshake counter indicating the number of valid resistance values determined since initial activation" UWORD _CNV_A_R_LINEAR_____1_CM 1 100. 0. 65535. DISPLAY_IDENTIFIER CTR_CYCNR_R_UP_LS_2 ECU_ADDRESS 0x3fc82e BYTE_ORDER MSB_LAST FORMAT "%5.0" /end MEASUREMENT
/begin MEASUREMENT lam_bank_2.ls_up_cur.drv1_vls_up_mmv_thd_max "Upper variable VLS_UP gradient threshold" SWORD _CNV_A_R_LINEAR_____276_CM 1 100. -2.5 2.4999 DISPLAY_IDENTIFIER DRV1_VLS_UP_MMV_THD_MAX_2 ECU_ADDRESS 0x3fc838 BYTE_ORDER MSB_LAST FORMAT "%7.4" /end MEASUREMENT
/begin MEASUREMENT lam_bank_2.ls_up_cur.drv1_vls_up_mmv_thd_min "Lower variable VLS_UP gradient threshold" SWORD _CNV_A_R_LINEAR_____276_CM 1 100. -2.5 2.4999 DISPLAY_IDENTIFIER DRV1_VLS_UP_MMV_THD_MIN_2 ECU_ADDRESS 0x3fc83a BYTE_ORDER MSB_LAST FORMAT "%7.4" /end MEASUREMENT
/begin MEASUREMENT lam_bank_2.ls_up_cur.fac_t_drv1_vls_up_abs "Multiplicative factor modifies C_DRV1_VLS_UP_ABS_MAX dependent on T_VLS_CYC_AFL_HLD" UBYTE _CNV_A_R_LINEAR_____46_CM 1 100. 0. 15.9375 DISPLAY_IDENTIFIER FAC_T_DRV1_VLS_UP_ABS_2 ECU_ADDRESS 0x3fc82c FORMAT "%5.2" /end MEASUREMENT
/begin MEASUREMENT lam_bank_2.ls_up_cur.fac_t_drv1_vls_up_mmv "Multiplicative factor modifies DRV1_VLS_UP_MMV_MIN_THD dependent on T_VLS_CYC_AFL_HLD" UBYTE _CNV_A_R_LINEAR_____278_CM 1 100. 0. 63.75 DISPLAY_IDENTIFIER FAC_T_DRV1_VLS_UP_MMV_2 ECU_ADDRESS 0x3fc82d FORMAT "%4.1" /end MEASUREMENT
/begin MEASUREMENT lam_bank_2.ls_up_cur.r_up_ls "Internal resistance of upstream oxygen sensor, cylinder bank i" UWORD _CNV_A_R_LINEAR_____279_CM 1 100. 0. 65535. DISPLAY_IDENTIFIER R_UP_LS_2 ECU_ADDRESS 0x3fc830 BYTE_ORDER MSB_LAST FORMAT "%5.0" /end MEASUREMENT
/begin MEASUREMENT lam_bank_2.ls_up_cur.r_up_ls_mes "Internal resistance of upstream oxygen sensor (Measured)" UWORD _CNV_A_R_LINEAR_____279_CM 1 100. 0. 65535. DISPLAY_IDENTIFIER R_UP_LS_MES_2 ECU_ADDRESS 0x3fc832 BYTE_ORDER MSB_LAST FORMAT "%5.0" /end MEASUREMENT
/begin MEASUREMENT lam_bank_2.ls_up_cur.t_sample_r_up_ls "Time measured between internal resistance samples" UWORD _CNV_A_R_LINEAR_____4_CM 1 100. 0. 655.35 DISPLAY_IDENTIFIER T_SAMPLE_R_UP_LS_2 ECU_ADDRESS 0x3fc836 BYTE_ORDER MSB_LAST FORMAT "%6.2" /end MEASUREMENT
/begin MEASUREMENT lam_bank_2.ls_up_cur.ttip_ls_up_mes "Upstream oxygen sensor ceramic temperature" SWORD _CNV_A_R_LINEAR_____280_CM 1 100. -2048. 2047.938 DISPLAY_IDENTIFIER TTIP_LS_UP_MES_2 ECU_ADDRESS 0x3fc83c BYTE_ORDER MSB_LAST FORMAT "%8.2" /end MEASUREMENT
/begin MEASUREMENT lam_bank_2.ls_up_cur.ttip_ls_up_mes_bol "Upstream oxygen sensor ceramic temperature, Lower limit, Unfiltered" SWORD _CNV_A_R_LINEAR_____280_CM 1 100. -2048. 2047.938 DISPLAY_IDENTIFIER TTIP_LS_UP_MES_BOL_2 ECU_ADDRESS 0x3fc840 BYTE_ORDER MSB_LAST FORMAT "%8.2" /end MEASUREMENT
/begin MEASUREMENT lam_bank_2.ls_up_cur.ttip_ls_up_mes_bol_mmv "Upstream oxygen sensor ceramic temperature, Lower limit, Unfiltered" SWORD _CNV_A_R_LINEAR_____280_CM 1 100. -2048. 2047.938 DISPLAY_IDENTIFIER TTIP_LS_UP_MES_BOL_MMV_2 ECU_ADDRESS 0x3fc846 BYTE_ORDER MSB_LAST FORMAT "%8.2" /end MEASUREMENT
/begin MEASUREMENT lam_bank_2.ls_up_cur.ttip_ls_up_mes_tol "Downstream oxygen sensor ceramic temperature, Upper limit, Unfiltered" SWORD _CNV_A_R_LINEAR_____280_CM 1 100. -2048. 2047.938 DISPLAY_IDENTIFIER TTIP_LS_UP_MES_TOL_2 ECU_ADDRESS 0x3fc83e BYTE_ORDER MSB_LAST FORMAT "%8.2" /end MEASUREMENT
/begin MEASUREMENT lam_bank_2.ls_up_cur.ttip_ls_up_mes_tol_mmv "Upstream oxygen sensor ceramic temperature, Lower limit, Unfiltered" SWORD _CNV_A_R_LINEAR_____280_CM 1 100. -2048. 2047.938 DISPLAY_IDENTIFIER TTIP_LS_UP_MES_TOL_MMV_2 ECU_ADDRESS 0x3fc842 BYTE_ORDER MSB_LAST FORMAT "%8.2" /end MEASUREMENT
/begin MEASUREMENT lam_bank_2.ls_up_cur.r_up_ls_mdl_sens_new "Internal resistance of upstream oxygen sensor (Modelled for new sensor)" UWORD _CNV_A_R_LINEAR_____279_CM 1 100. 0. 65535. DISPLAY_IDENTIFIER R_UP_LS_MDL_SENS_NEW_2 ECU_ADDRESS 0x3fc84c BYTE_ORDER MSB_LAST FORMAT "%5.0" /end MEASUREMENT
/begin MEASUREMENT lam_bank_2.ls_up_cur.pow_lsh_up_mmv "Moving_mean value of upstream oxygen sensor heater power" UWORD _CNV_A_R_LINEAR_____281_CM 1 100. 0. 65.535 DISPLAY_IDENTIFIER POW_LSH_UP_MMV_2 ECU_ADDRESS 0x3fc84e BYTE_ORDER MSB_LAST /end MEASUREMENT
/begin MEASUREMENT lam_bank_2.ls_up_cur.ttip_ref_ls_up_mdl_mmv "Reference of upstream oxygen sensor ceramic temperature (Modelled for new sensor)" UWORD _CNV_A_R_LINEAR_____283_CM 1 100. 0. 2047.96875 DISPLAY_IDENTIFIER TTIP_REF_LS_UP_MDL_MMV_2 ECU_ADDRESS 0x3fc850 BYTE_ORDER MSB_LAST FORMAT "%7.2" /end MEASUREMENT
/begin MEASUREMENT lamb_sawup "Basis lambda (pre-control)" UWORD _CNV_A_R_LINEAR_____164_CM 1 100. 0. 31.99902344 DISPLAY_IDENTIFIER LAMB_SAWUP ECU_ADDRESS 0x3fd0be BYTE_ORDER MSB_LAST FORMAT "%7.4" /end MEASUREMENT
/begin MEASUREMENT fac_lamb_de_sa "Lambda deviation through secondary air" UWORD _CNV_A_R_LINEAR_____309_CM 1 100. 0. 3.999939 DISPLAY_IDENTIFIER FAC_LAMB_DE_SA ECU_ADDRESS 0x3fd0c0 BYTE_ORDER MSB_LAST FORMAT "%7.5" /end MEASUREMENT
/begin MEASUREMENT lamb_sa_ch "Lambda for secondary air catalyst heating" UWORD _CNV_A_R_LINEAR_____164_CM 1 100. 0. 31.99902344 DISPLAY_IDENTIFIER LAMB_SA_CH ECU_ADDRESS 0x3fd0c2 BYTE_ORDER MSB_LAST FORMAT "%7.4" /end MEASUREMENT
/begin CHARACTERISTIC ip_lamb_sawup "basic lambda correction for rich catalyst heating" MAP 0x0c312 _REC_MAP_20_u2_u2_u1 31.99902344 _CNV_A_R_LINEAR_____164_CM 0. 31.99902344 DISPLAY_IDENTIFIER IP_LAMB_SAWUP FORMAT "%7.4"
 /begin AXIS_DESCR COM_AXIS tqi_req_slow _CNV_A_R_LINEAR_____186_CM 8 -1024. 1023.96875 FORMAT "%6.2" AXIS_PTS_REF ldp_tqi_req_slow__lamb_sawup /end AXIS_DESCR
 /begin AXIS_DESCR COM_AXIS n_32 _CNV_A_R_LINEAR_____16_CM 8 0. 8160. FORMAT "%4.0" AXIS_PTS_REF ldp_n_32__lamb_sawup /end AXIS_DESCR
/end CHARACTERISTIC
/begin CHARACTERISTIC ip_lamb_sawup_is "basic lambda correction for rich catalyst heating during idle speed" MAP 0x0c392 _REC_MAP_20_u2_u2_u1 31.99902344 _CNV_A_R_LINEAR_____164_CM 0. 31.99902344 DISPLAY_IDENTIFIER IP_LAMB_SAWUP_IS FORMAT "%7.4"
 /begin AXIS_DESCR COM_AXIS tqi_req_slow _CNV_A_R_LINEAR_____186_CM 8 -1024. 1023.96875 FORMAT "%6.2" AXIS_PTS_REF ldp_tqi_req_slow__lamb_sawup_is /end AXIS_DESCR
 /begin AXIS_DESCR COM_AXIS n_32 _CNV_A_R_LINEAR_____16_CM 8 0. 8160. FORMAT "%4.0" AXIS_PTS_REF ldp_n_32__lamb_sawup_is /end AXIS_DESCR
/end CHARACTERISTIC
/begin CHARACTERISTIC ip_lamb_add_sawup "additive correction of the basic lambda heating correction" MAP 0x0bc46 _REC_MAP_20_u2_u2_u1 63.99902344 _CNV_A_R_LINEAR_____266_CM -32. 31.99902344 DISPLAY_IDENTIFIER IP_LAMB_ADD_SAWUP FORMAT "%8.4"
 /begin AXIS_DESCR COM_AXIS t_ast _CNV_A_R_LINEAR_____24_CM 8 0. 6553.5 FORMAT "%6.1" AXIS_PTS_REF ldp_t_ast__lamb_add_sawup /end AXIS_DESCR
 /begin AXIS_DESCR COM_AXIS tco _CNV_A_R_LINEAR_____12_CM 8 -48. 142.5 FORMAT "%5.1" AXIS_PTS_REF ldp_tco__lamb_add_sawup /end AXIS_DESCR
/end CHARACTERISTIC
/begin CHARACTERISTIC lc_sa_swi_cmb "Logical constant to switch between Lambda-combustion / Lambda pre-cat" VALUE 0x00f6d _REC_VAL_20_u1 1. _CNV_A_R_LINEAR_____1_CM 0. 1. DISPLAY_IDENTIFIER LC_SA_SWI_CMB FORMAT "%2.0" /end CHARACTERISTIC
/begin AXIS_PTS ldp_tqi_req_slow__lamb_sawup "" 0x11390 tqi_req_slow _REC_AXS_20_u2 2047.96875 _CNV_A_R_LINEAR_____186_CM 8 -1024. 1023.96875 DISPLAY_IDENTIFIER LDP_TQI_REQ_SLOW__LAMB_SAWUP FORMAT "%6.2" /end AXIS_PTS
/begin AXIS_PTS ldp_tqi_req_slow__lamb_sawup_is "" 0x113a2 tqi_req_slow _REC_AXS_20_u2 2047.96875 _CNV_A_R_LINEAR_____186_CM 8 -1024. 1023.96875 DISPLAY_IDENTIFIER LDP_TQI_REQ_SLOW__LAMB_SAWUP_IS FORMAT "%6.2" /end AXIS_PTS
/begin AXIS_PTS ldp_n_32__lamb_sawup "" 0x07c1d n_32 _REC_AXS_20_u1 8160. _CNV_A_R_LINEAR_____16_CM 8 0. 8160. DISPLAY_IDENTIFIER LDP_N_32__LAMB_SAWUP FORMAT "%4.0" /end AXIS_PTS
/begin AXIS_PTS ldp_n_32__lamb_sawup_is "" 0x07c26 n_32 _REC_AXS_20_u1 8160. _CNV_A_R_LINEAR_____16_CM 8 0. 8160. DISPLAY_IDENTIFIER LDP_N_32__LAMB_SAWUP_IS FORMAT "%4.0" /end AXIS_PTS
/begin AXIS_PTS ldp_t_ast__lamb_add_sawup "" 0x11168 t_ast _REC_AXS_20_u2 6553.5 _CNV_A_R_LINEAR_____24_CM 8 0. 6553.5 DISPLAY_IDENTIFIER LDP_T_AST__LAMB_ADD_SAWUP FORMAT "%6.1" /end AXIS_PTS
/begin AXIS_PTS ldp_tco__lamb_add_sawup "" 0x07d95 tco _REC_AXS_20_u1 190.5 _CNV_A_R_LINEAR_____12_CM 8 -48. 142.5 DISPLAY_IDENTIFIER LDP_TCO__LAMB_ADD_SAWUP FORMAT "%5.1" /end AXIS_PTS
/begin MEASUREMENT lamb_sp_sa_eol "Lambda for secondary air EOL test" UWORD _CNV_A_R_LINEAR_____164_CM 1 100. 0. 31.99902344 DISPLAY_IDENTIFIER LAMB_SP_SA_EOL ECU_ADDRESS 0x3fd0c4 BYTE_ORDER MSB_LAST FORMAT "%7.4" /end MEASUREMENT
/begin CHARACTERISTIC c_lamb_sp_sa_eol "Lambda setpoint for EOL test" VALUE 0x01614 _REC_VAL_20_u2 31.99902344 _CNV_A_R_LINEAR_____164_CM 0. 31.99902344 DISPLAY_IDENTIFIER C_LAMB_SP_SA_EOL FORMAT "%7.4" /end CHARACTERISTIC
/begin MEASUREMENT lamb_ratio "Current Lambda ratio for interpolation factor" UWORD _CNV_A_R_LINEAR_____264_CM 1 100. -2. 2. DISPLAY_IDENTIFIER LAMB_RATIO ECU_ADDRESS 0x3fd04e BYTE_ORDER MSB_LAST FORMAT "%8.5" /end MEASUREMENT
/begin CHARACTERISTIC ip_lamb_iga_afl__n_32__maf_hb "Lambda map for interpolation on ignition angle corrected with maps IGA_xxx_AFL" MAP 0x0c09e _REC_MAP_20_u2_u1_u1 31.99902344 _CNV_A_R_LINEAR_____164_CM 0. 31.99902344 DISPLAY_IDENTIFIER IP_LAMB_IGA_AFL__N_32__MAF_HB FORMAT "%7.4"
 /begin AXIS_DESCR COM_AXIS n_32 _CNV_A_R_LINEAR_____16_CM 16 0. 8160. FORMAT "%4.0" AXIS_PTS_REF ldp_n_32__lamb_iga_afl /end AXIS_DESCR
 /begin AXIS_DESCR COM_AXIS maf _CNV_A_R_LINEAR_____27_CM 12 0. 1389. FORMAT "%4.0" AXIS_PTS_REF ldp_maf_hb__lamb_iga_afl /end AXIS_DESCR
/end CHARACTERISTIC
/begin CHARACTERISTIC c_lamb_iga_afr "Lambdavalue for ignition angle interpolation correlated with maps IP_IGA_xxx_AFR" VALUE 0x01604 _REC_VAL_20_u2 31.99902344 _CNV_A_R_LINEAR_____164_CM 0. 31.99902344 DISPLAY_IDENTIFIER C_LAMB_IGA_AFR FORMAT "%7.4" /end CHARACTERISTIC
/begin AXIS_PTS ldp_n_32__lamb_iga_afl "" 0x07c0c n_32 _REC_AXS_20_u1 8160. _CNV_A_R_LINEAR_____16_CM 16 0. 8160. DISPLAY_IDENTIFIER LDP_N_32__LAMB_IGA_AFL FORMAT "%4.0" /end AXIS_PTS
/begin AXIS_PTS ldp_maf_hb__lamb_iga_afl "" 0x07b7d maf _REC_AXS_20_u1 1389. _CNV_A_R_LINEAR_____27_CM 12 0. 1389. DISPLAY_IDENTIFIER LDP_MAF_HB__LAMB_IGA_AFL FORMAT "%4.0" /end AXIS_PTS
/begin CHARACTERISTIC c_temp_cur_on_ls_down "Temperature threshold for the activation of sensor pumping" VALUE 0x018fc _REC_VAL_20_u2 2047. _CNV_A_R_LINEAR_____7_CM 0. 2047. DISPLAY_IDENTIFIER C_TEMP_CUR_ON_LS_DOWN FORMAT "%7.2" /end CHARACTERISTIC
/begin CHARACTERISTIC c_t_cur_on_ls_down "Duration for pump current active" VALUE 0x007e6 _REC_VAL_20_u1 8.e-003 _CNV_A_R_LINEAR_____317_CM 0. 8.e-003 DISPLAY_IDENTIFIER C_T_CUR_ON_LS_DOWN FORMAT "%4.3" /end CHARACTERISTIC
/begin CHARACTERISTIC c_t_cur_off_ls_down "Minimum delay between consecutive pump current activation" VALUE 0x017cc _REC_VAL_20_u2 655.35 _CNV_A_R_LINEAR_____4_CM 0. 655.35 DISPLAY_IDENTIFIER C_T_CUR_OFF_LS_DOWN FORMAT "%6.2" /end CHARACTERISTIC
/begin CHARACTERISTIC c_t_cur_dly_ls_down "Duration in which VLS_DOWN_i signal masked directly after Ri determination" VALUE 0x007e4 _REC_VAL_20_u1 0.255 _CNV_A_R_LINEAR_____317_CM 0. 0.255 DISPLAY_IDENTIFIER C_T_CUR_DLY_LS_DOWN FORMAT "%5.3" /end CHARACTERISTIC
/begin CHARACTERISTIC c_vls_mmv_min_rng_tol_ls_down "Permitted range of VLS_DOWN_i above VLS_DOWN_MMV_MIN_i at low gradient for Ri determination" VALUE 0x01a2c _REC_VAL_20_u2 4.99992371 _CNV_A_R_LINEAR_____250_CM 0. 4.99992371 DISPLAY_IDENTIFIER C_VLS_MMV_MIN_RNG_TOL_LS_DOWN FORMAT "%7.5" /end CHARACTERISTIC
/begin CHARACTERISTIC c_vls_mmv_min_rng_bol_ls_down "Permitted range of VLS_DOWN_i below VLS_DOWN_MMV_MIN_i at low gradient for Ri determination" VALUE 0x01a28 _REC_VAL_20_u2 4.99992371 _CNV_A_R_LINEAR_____250_CM 0. 4.99992371 DISPLAY_IDENTIFIER C_VLS_MMV_MIN_RNG_BOL_LS_DOWN FORMAT "%7.5" /end CHARACTERISTIC
/begin CHARACTERISTIC c_drv1_vls_down_mmv_thd_min "Minimum threshold for mean 1st derivative of VLS_DOWN_i signal for Ri determination" VALUE 0x003e8 _REC_VAL_20_s2 4.9999 _CNV_A_R_LINEAR_____276_CM -2.5 2.4999 DISPLAY_IDENTIFIER C_DRV1_VLS_DOWN_MMV_THD_MIN FORMAT "%7.4" /end CHARACTERISTIC
/begin CHARACTERISTIC c_drv1_vls_down_mmv_thd_max "Maximum threshold for mean 1st derivative of VLS_DOWN_i signal for Ri determination" VALUE 0x003e6 _REC_VAL_20_s2 4.9999 _CNV_A_R_LINEAR_____276_CM -2.5 2.4999 DISPLAY_IDENTIFIER C_DRV1_VLS_DOWN_MMV_THD_MAX FORMAT "%7.4" /end CHARACTERISTIC
/begin CHARACTERISTIC c_fac_stk_drv1_vls_down_mmv "Multiplicative factor used to weight gradient thresholds dependent on VLS_DOWN_MMV_xxx_i amplitude" VALUE 0x006da _REC_VAL_20_u1 1.99220002 _CNV_A_R_LINEAR_____39_CM 0. 1.99220002 DISPLAY_IDENTIFIER C_FAC_STK_DRV1_VLS_DOWN_MMV FORMAT "%5.3" /end CHARACTERISTIC
/begin CHARACTERISTIC c_fac_drv1_vls_down_mmv_min "Hysteresis factor of DRV1_VLS_DOWN_MMV_MIN governing limiting of DRV1_VLS_DOWN_MMV_MIN_THD" VALUE 0x006c5 _REC_VAL_20_u1 0.99610001 _CNV_A_R_LINEAR_____29_CM 0. 0.99610001 DISPLAY_IDENTIFIER C_FAC_DRV1_VLS_DOWN_MMV_MIN FORMAT "%5.3" /end CHARACTERISTIC
/begin CHARACTERISTIC c_drv1_vls_down_abs_max "Threshold for absolute maximum 1st derivative of VLS_DOWN_i signal for Ri determination" VALUE 0x01530 _REC_VAL_20_u2 4.9999237 _CNV_A_R_LINEAR_____277_CM 0. 4.9999237 DISPLAY_IDENTIFIER C_DRV1_VLS_DOWN_ABS_MAX FORMAT "%6.4" /end CHARACTERISTIC
/begin CHARACTERISTIC c_ctr_vls_afl_cyc_r_down_ls "Min. no. AF cycles post lambda controller activation to permit use of T_VLS_CYC_AFL_HLD dependency" VALUE 0x01502 _REC_VAL_20_u2 65535. _CNV_A_R_LINEAR_____1_CM 0. 65535. DISPLAY_IDENTIFIER C_CTR_VLS_AFL_CYC_R_DOWN_LS FORMAT "%5.0" /end CHARACTERISTIC
/begin CHARACTERISTIC c_maf_kgh_r_down_ls "Maximum MAF_KGH threshold for activation of internal resistance determination" VALUE 0x0169a _REC_VAL_20_u2 2047.96875 _CNV_A_R_LINEAR_____113_CM 0. 2047.96875 DISPLAY_IDENTIFIER C_MAF_KGH_R_DOWN_LS FORMAT "%7.2" /end CHARACTERISTIC
/begin CHARACTERISTIC c_fac_err_pos_r_down_ls "Internal resistance measurement positive error (i.e. 0% to 100%)" VALUE 0x006ca _REC_VAL_20_u1 0.9960940000000002 _CNV_A_R_LINEAR_____50_CM 0. 0.996094 DISPLAY_IDENTIFIER C_FAC_ERR_POS_R_DOWN_LS FORMAT "%5.3" /end CHARACTERISTIC
/begin CHARACTERISTIC c_fac_err_neg_r_down_ls "Internal resistance measurement negative error (i.e. 100% to 0%)" VALUE 0x006c8 _REC_VAL_20_u1 0.9960940000000002 _CNV_A_R_LINEAR_____50_CM 0. 0.996094 DISPLAY_IDENTIFIER C_FAC_ERR_NEG_R_DOWN_LS FORMAT "%5.3" /end CHARACTERISTIC
/begin CHARACTERISTIC c_crlc_ttip_fall_r_down_ls "Correlation (filter) constant for falling ceramic temperature, limit calculation" VALUE 0x0063f _REC_VAL_20_u1 0.99610001 _CNV_A_R_LINEAR_____318_CM 0. 0.99610001 DISPLAY_IDENTIFIER C_CRLC_TTIP_FALL_R_DOWN_LS FORMAT "%5.3" /end CHARACTERISTIC
/begin CHARACTERISTIC c_crlc_ttip_rise_r_down_ls "Correlation (filter) constant for rising ceramic temperature, limit calculation" VALUE 0x00641 _REC_VAL_20_u1 0.99610001 _CNV_A_R_LINEAR_____318_CM 0. 0.99610001 DISPLAY_IDENTIFIER C_CRLC_TTIP_RISE_R_DOWN_LS FORMAT "%5.3" /end CHARACTERISTIC
/begin CHARACTERISTIC lc_inh_r_down_ls_vld "Boolean flag inhibiting internal resistance determination validity function" VALUE 0x00f3f _REC_VAL_20_u1 1. _CNV_A_R_LINEAR_____1_CM 0. 1. DISPLAY_IDENTIFIER LC_INH_R_DOWN_LS_VLD FORMAT "%2.0" /end CHARACTERISTIC
/begin CHARACTERISTIC ip_fac_t_drv1_vls_down_abs "Multiplicative factor modifies C_DRV1_VLS_DOWN_ABS_MAX dependent on T_VLS_CYC_AFL_HLD" CURVE 0x00b7c _REC_CUR_20_u1_u1 15.9375 _CNV_A_R_LINEAR_____46_CM 0. 15.9375 DISPLAY_IDENTIFIER IP_FAC_T_DRV1_VLS_DOWN_ABS FORMAT "%5.2"
 /begin AXIS_DESCR COM_AXIS lam_bank_1.ls_up.t_vls_cyc_afl_hld _CNV_A_R_LINEAR_____4_CM 8 0. 2.55 FORMAT "%4.2" AXIS_PTS_REF ldpm_t_vls_cyc_afl_hld /end AXIS_DESCR
/end CHARACTERISTIC
/begin CHARACTERISTIC ip_ttip_ls_down "Oxygen sensor temperature vs. internal resistance characteristic" CURVE 0x10636 _REC_CUR_20_u2_u2 2047.96875 _CNV_A_R_LINEAR_____283_CM 0. 2047.96875 DISPLAY_IDENTIFIER IP_TTIP_LS_DOWN FORMAT "%7.2"
 /begin AXIS_DESCR COM_AXIS lam_bank_1.ls_down_cur.r_down_ls _CNV_A_R_LINEAR_____279_CM 8 0. 65535. FORMAT "%5.0" AXIS_PTS_REF ldp_r_down_ls_ip_ttip_ls_down /end AXIS_DESCR
/end CHARACTERISTIC
/begin CHARACTERISTIC ip_fac_t_drv1_vls_down_mmv "Multiplicative factor modifies DRV1_VLS_DOWN_MMV_MIN_THD dependent on T_VLS_CYC_AFL_HLD" CURVE 0x00b84 _REC_CUR_20_u1_u1 63.75 _CNV_A_R_LINEAR_____278_CM 0. 63.75 DISPLAY_IDENTIFIER IP_FAC_T_DRV1_VLS_DOWN_MMV FORMAT "%4.1"
 /begin AXIS_DESCR COM_AXIS lam_bank_1.ls_up.t_vls_cyc_afl_hld _CNV_A_R_LINEAR_____4_CM 8 0. 2.55 FORMAT "%4.2" AXIS_PTS_REF ldpm_t_vls_cyc_afl_hld /end AXIS_DESCR
/end CHARACTERISTIC
/begin AXIS_PTS ldp_r_down_ls_ip_ttip_ls_down "" 0x11106 lam_bank_1.ls_down_cur.r_down_ls _REC_AXS_20_u2 65535. _CNV_A_R_LINEAR_____279_CM 8 0. 65535. DISPLAY_IDENTIFIER LDP_R_DOWN_LS_IP_TTIP_LS_DOWN FORMAT "%5.0" /end AXIS_PTS
/begin AXIS_PTS ldp_maf_kgh_crlc_ttip_ref_ls "" 0x10d0a maf_kgh _REC_AXS_20_u2 2047.96875 _CNV_A_R_LINEAR_____113_CM 8 0. 2047.96875 DISPLAY_IDENTIFIER LDP_MAF_KGH_CRLC_TTIP_REF_LS FORMAT "%7.2" /end AXIS_PTS
/begin CHARACTERISTIC ip_crlc_ttip_ref_ls_down_mdl "Correlation map for calculation of reference downstream tip temperature(modelled for new sensor)" CURVE 0x00a68 _REC_CUR_20_u1_u2 0.99610001 _CNV_A_R_LINEAR_____29_CM 0. 0.99610001 DISPLAY_IDENTIFIER IP_CRLC_TTIP_REF_LS_DOWN_MDL FORMAT "%5.3"
 /begin AXIS_DESCR COM_AXIS maf_kgh _CNV_A_R_LINEAR_____113_CM 8 0. 2047.96875 FORMAT "%7.2" AXIS_PTS_REF ldp_maf_kgh_crlc_ttip_ref_ls /end AXIS_DESCR
/end CHARACTERISTIC
/begin AXIS_PTS ldp_pow_lsh_down_mmv_r_down_ls "" 0x11080 lam_bank_1.ls_down_cur.pow_lsh_down_mmv _REC_AXS_20_u2 65.535 _CNV_A_R_LINEAR_____281_CM 8 0. 65.535 DISPLAY_IDENTIFIER LDP_POW_LSH_DOWN_MMV_R_DOWN_LS /end AXIS_PTS
/begin CHARACTERISTIC c_crlc_pow_lsh_down "Correlation (filter) constant for moving mean value of downstream heater power" VALUE 0x00633 _REC_VAL_20_u1 0.9960940000000002 _CNV_A_R_LINEAR_____50_CM 0. 0.996094 DISPLAY_IDENTIFIER C_CRLC_POW_LSH_DOWN FORMAT "%5.3" /end CHARACTERISTIC
/begin CHARACTERISTIC ip_r_down_ls_mdl_sens_new "Internal resistance of a new downstream oxygen sensor(modelled)" MAP 0x0d77a _REC_MAP_20_u2_u2_u2 65535. _CNV_A_R_LINEAR_____279_CM 0. 65535. DISPLAY_IDENTIFIER IP_R_DOWN_LS_MDL_SENS_NEW FORMAT "%5.0"
 /begin AXIS_DESCR COM_AXIS lam_bank_1.ls_down_cur.pow_lsh_down_mmv _CNV_A_R_LINEAR_____281_CM 8 0. 65.535 AXIS_PTS_REF ldp_pow_lsh_down_mmv_r_down_ls /end AXIS_DESCR
 /begin AXIS_DESCR COM_AXIS lam_bank_1.ls_down_cur.ttip_ref_ls_down_mdl_mmv _CNV_A_R_LINEAR_____282_CM 8 0. 2047.938 FORMAT "%7.3" AXIS_PTS_REF ldp_ttip_ref_ls_down_mdl_r_down /end AXIS_DESCR
/end CHARACTERISTIC
/begin AXIS_PTS ldp_ttip_ref_ls_down_mdl_r_down "" 0x11404 lam_bank_1.ls_down_cur.ttip_ref_ls_down_mdl_mmv _REC_AXS_20_u2 2047.938 _CNV_A_R_LINEAR_____282_CM 8 0. 2047.938 DISPLAY_IDENTIFIER LDP_TTIP_REF_LS_DOWN_MDL_R_DOWN FORMAT "%7.3" /end AXIS_PTS
/begin CHARACTERISTIC c_t_cur_dly_ls_up "Duration in which VLS_UP_i signal masked directly after Ri determination" VALUE 0x007e5 _REC_VAL_20_u1 0.255 _CNV_A_R_LINEAR_____317_CM 0. 0.255 DISPLAY_IDENTIFIER C_T_CUR_DLY_LS_UP FORMAT "%5.3" /end CHARACTERISTIC
/begin CHARACTERISTIC c_t_cur_on_ls_up "Pulse duration for pump current" VALUE 0x007e7 _REC_VAL_20_u1 8.e-003 _CNV_A_R_LINEAR_____317_CM 0. 8.e-003 DISPLAY_IDENTIFIER C_T_CUR_ON_LS_UP FORMAT "%4.3" /end CHARACTERISTIC
/begin CHARACTERISTIC c_t_cur_off_ls_up "Pulse off time for pump current" VALUE 0x017ce _REC_VAL_20_u2 655.35 _CNV_A_R_LINEAR_____4_CM 0. 655.35 DISPLAY_IDENTIFIER C_T_CUR_OFF_LS_UP FORMAT "%6.2" /end CHARACTERISTIC
/begin CHARACTERISTIC c_vls_mmv_min_rng_tol_ls_up "Permitted range of VLS_UP_i above VLS_MMV_MIN_i at low gradient for Ri determination" VALUE 0x01a2e _REC_VAL_20_u2 4.99992371 _CNV_A_R_LINEAR_____250_CM 0. 4.99992371 DISPLAY_IDENTIFIER C_VLS_MMV_MIN_RNG_TOL_LS_UP FORMAT "%7.5" /end CHARACTERISTIC
/begin CHARACTERISTIC c_vls_mmv_min_rng_bol_ls_up "Permitted range of VLS_UP_i below VLS_MMV_MIN_i at low gradient for Ri determination" VALUE 0x01a2a _REC_VAL_20_u2 4.99992371 _CNV_A_R_LINEAR_____250_CM 0. 4.99992371 DISPLAY_IDENTIFIER C_VLS_MMV_MIN_RNG_BOL_LS_UP FORMAT "%7.5" /end CHARACTERISTIC
/begin CHARACTERISTIC c_drv1_vls_up_mmv_thd_min "Minimum threshold for mean 1st derivative of VLS_UP_i signal for Ri determination" VALUE 0x003ec _REC_VAL_20_s2 4.9999 _CNV_A_R_LINEAR_____276_CM -2.5 2.4999 DISPLAY_IDENTIFIER C_DRV1_VLS_UP_MMV_THD_MIN FORMAT "%7.4" /end CHARACTERISTIC
/begin CHARACTERISTIC c_drv1_vls_up_mmv_thd_max "Maximum threshold for mean 1st derivative of VLS_UP_i signal for Ri determination" VALUE 0x003ea _REC_VAL_20_s2 4.9999 _CNV_A_R_LINEAR_____276_CM -2.5 2.4999 DISPLAY_IDENTIFIER C_DRV1_VLS_UP_MMV_THD_MAX FORMAT "%7.4" /end CHARACTERISTIC
/begin CHARACTERISTIC c_fac_stk_drv1_vls_up_mmv "Multiplicative factor used to weight gradient thresholds dependent on VLS_MMV_xxx_i amplitude" VALUE 0x006db _REC_VAL_20_u1 1.99220002 _CNV_A_R_LINEAR_____39_CM 0. 1.99220002 DISPLAY_IDENTIFIER C_FAC_STK_DRV1_VLS_UP_MMV FORMAT "%5.3" /end CHARACTERISTIC
/begin CHARACTERISTIC c_fac_drv1_vls_up_mmv_min "Hysteresis factor of DRV1_VLS_UP_MMV_MIN governing limiting of DRV1_VLS_UP_MMV_MIN_THD" VALUE 0x006c6 _REC_VAL_20_u1 0.99610001 _CNV_A_R_LINEAR_____29_CM 0. 0.99610001 DISPLAY_IDENTIFIER C_FAC_DRV1_VLS_UP_MMV_MIN FORMAT "%5.3" /end CHARACTERISTIC
/begin CHARACTERISTIC c_ctr_vls_afl_cyc_r_up_ls "Min. no. AF cycles post lambda controller activation to permit use of T_VLS_CYC_AFL_HLD dependency" VALUE 0x01504 _REC_VAL_20_u2 65535. _CNV_A_R_LINEAR_____1_CM 0. 65535. DISPLAY_IDENTIFIER C_CTR_VLS_AFL_CYC_R_UP_LS FORMAT "%5.0" /end CHARACTERISTIC
/begin CHARACTERISTIC c_maf_kgh_r_up_ls "Maximum MAF_KGH threshold for activation of internal resistance determination" VALUE 0x0169c _REC_VAL_20_u2 2047.96875 _CNV_A_R_LINEAR_____113_CM 0. 2047.96875 DISPLAY_IDENTIFIER C_MAF_KGH_R_UP_LS FORMAT "%7.2" /end CHARACTERISTIC
/begin CHARACTERISTIC c_fac_err_pos_r_up_ls "Internal resistance measurement positive error (i.e. 0% to 100%)" VALUE 0x006cb _REC_VAL_20_u1 0.9960940000000002 _CNV_A_R_LINEAR_____50_CM 0. 0.996094 DISPLAY_IDENTIFIER C_FAC_ERR_POS_R_UP_LS FORMAT "%5.3" /end CHARACTERISTIC
/begin CHARACTERISTIC c_fac_err_neg_r_up_ls "Internal resistance measurement negative error (i.e. 100% to 0%)" VALUE 0x006c9 _REC_VAL_20_u1 0.9960940000000002 _CNV_A_R_LINEAR_____50_CM 0. 0.996094 DISPLAY_IDENTIFIER C_FAC_ERR_NEG_R_UP_LS FORMAT "%5.3" /end CHARACTERISTIC
/begin CHARACTERISTIC c_crlc_ttip_rise_r_up_ls "Correlation (filter) constant for rising ceramic temperature, limit calculation" VALUE 0x00642 _REC_VAL_20_u1 0.99610001 _CNV_A_R_LINEAR_____318_CM 0. 0.99610001 DISPLAY_IDENTIFIER C_CRLC_TTIP_RISE_R_UP_LS FORMAT "%5.3" /end CHARACTERISTIC
/begin CHARACTERISTIC lc_inh_r_up_ls_vld "Boolean flag inhibiting internal resistance determination validity function" VALUE 0x00f40 _REC_VAL_20_u1 1. _CNV_A_R_LINEAR_____22_CM 0. 1. DISPLAY_IDENTIFIER LC_INH_R_UP_LS_VLD FORMAT "%1.0" /end CHARACTERISTIC
/begin CHARACTERISTIC c_temp_cur_on_ls_up "Temperature threshold for the activation of sensor pumping" VALUE 0x018fe _REC_VAL_20_u2 2047. _CNV_A_R_LINEAR_____7_CM 0. 2047. DISPLAY_IDENTIFIER C_TEMP_CUR_ON_LS_UP FORMAT "%7.2" /end CHARACTERISTIC
/begin CHARACTERISTIC ip_fac_t_drv1_vls_up_mmv "Multiplicative factor modifies DRV1_VLS_UP_MMV_MIN_THD dependent on T_VLS_CYC_AFL_HLD" CURVE 0x00b94 _REC_CUR_20_u1_u1 63.75 _CNV_A_R_LINEAR_____278_CM 0. 63.75 DISPLAY_IDENTIFIER IP_FAC_T_DRV1_VLS_UP_MMV FORMAT "%4.1"
 /begin AXIS_DESCR COM_AXIS lam_bank_1.ls_up.t_vls_cyc_afl_hld _CNV_A_R_LINEAR_____4_CM 8 0. 2.55 FORMAT "%4.2" AXIS_PTS_REF ldpm_t_vls_cyc_afl_hld /end AXIS_DESCR
/end CHARACTERISTIC
/begin CHARACTERISTIC c_drv1_vls_up_abs_max "Threshold for absolute maximum 1st derivative of VLS_UP_i signal for Ri determination" VALUE 0x01532 _REC_VAL_20_u2 4.9999237 _CNV_A_R_LINEAR_____277_CM 0. 4.9999237 DISPLAY_IDENTIFIER C_DRV1_VLS_UP_ABS_MAX FORMAT "%6.4" /end CHARACTERISTIC
/begin CHARACTERISTIC ip_ttip_ls_up "Oxygen sensor temperature vs. internal resistance characteristic" CURVE 0x10646 _REC_CUR_20_u2_u2 2047.96875 _CNV_A_R_LINEAR_____283_CM 0. 2047.96875 DISPLAY_IDENTIFIER IP_TTIP_LS_UP FORMAT "%7.2"
 /begin AXIS_DESCR COM_AXIS lam_bank_1.ls_up_cur.r_up_ls _CNV_A_R_LINEAR_____279_CM 8 0. 65535. FORMAT "%5.0" AXIS_PTS_REF ldp_r_up_ls_ip_ttip_ls_up /end AXIS_DESCR
/end CHARACTERISTIC
/begin CHARACTERISTIC ip_crlc_ttip_ref_ls_up_mdl_mmv "Corelation map for calculation of reverence upstream tip temperature (modelled for new sensor)" CURVE 0x00a70 _REC_CUR_20_u1_u2 0.9960940000000002 _CNV_A_R_LINEAR_____50_CM 0. 0.996094 DISPLAY_IDENTIFIER IP_CRLC_TTIP_REF_LS_UP_MDL_MMV FORMAT "%5.3"
 /begin AXIS_DESCR COM_AXIS maf_kgh _CNV_A_R_LINEAR_____113_CM 8 0. 2047.96875 FORMAT "%7.2" AXIS_PTS_REF ldp_maf_kgh_crlc_ttip_ref_ls_up /end AXIS_DESCR
/end CHARACTERISTIC
/begin AXIS_PTS ldpm_t_vls_cyc_afl_hld "" 0x08181 lam_bank_1.ls_up.t_vls_cyc_afl_hld _REC_AXS_20_u1 2.55 _CNV_A_R_LINEAR_____4_CM 8 0. 2.55 DISPLAY_IDENTIFIER LDPM_T_VLS_CYC_AFL_HLD FORMAT "%4.2" /end AXIS_PTS
/begin AXIS_PTS ldp_maf_kgh_crlc_ttip_ref_ls_up "" 0x10d1c maf_kgh _REC_AXS_20_u2 2047.96875 _CNV_A_R_LINEAR_____113_CM 8 0. 2047.96875 DISPLAY_IDENTIFIER LDP_MAF_KGH_CRLC_TTIP_REF_LS_UP FORMAT "%7.2" /end AXIS_PTS
/begin AXIS_PTS ldp_r_up_ls_ip_ttip_ls_up "" 0x11122 lam_bank_1.ls_up_cur.r_up_ls _REC_AXS_20_u2 65535. _CNV_A_R_LINEAR_____279_CM 8 0. 65535. DISPLAY_IDENTIFIER LDP_R_UP_LS_IP_TTIP_LS_UP FORMAT "%5.0" /end AXIS_PTS
/begin AXIS_PTS ldp_pow_lsh_up_mmv_r_up_ls_mdl "" 0x11092 online_dummy _REC_AXS_20_u2 65.535 _CNV_A_R_LINEAR_____281_CM 8 0. 65.535 DISPLAY_IDENTIFIER LDP_POW_LSH_UP_MMV_R_UP_LS_MDL /end AXIS_PTS
/begin AXIS_PTS ldp_ttip_ref_ls_up_mdl_r_up_ls "" 0x11428 online_dummy _REC_AXS_20_u2 2047.96875 _CNV_A_R_LINEAR_____283_CM 8 0. 2047.96875 DISPLAY_IDENTIFIER LDP_TTIP_REF_LS_UP_MDL_R_UP_LS FORMAT "%7.2" /end AXIS_PTS
/begin CHARACTERISTIC ip_fac_t_drv1_vls_up_abs "Multiplicative factor modifies C_DRV1_VLS_UP_ABS_MAX dependent on T_VLS_CYC_AFL_HLD" CURVE 0x00b8c _REC_CUR_20_u1_u1 15.9375 _CNV_A_R_LINEAR_____46_CM 0. 15.9375 DISPLAY_IDENTIFIER IP_FAC_T_DRV1_VLS_UP_ABS FORMAT "%5.2"
 /begin AXIS_DESCR COM_AXIS lam_bank_1.ls_up.t_vls_cyc_afl_hld _CNV_A_R_LINEAR_____4_CM 8 0. 2.55 FORMAT "%4.2" AXIS_PTS_REF ldpm_t_vls_cyc_afl_hld /end AXIS_DESCR
/end CHARACTERISTIC
/begin CHARACTERISTIC ip_r_up_ls_mdl_sens_new "Internal resistence of a new upstream oxygen sensor (modelled)" MAP 0x0d7fa _REC_MAP_20_u2_u2_u2 65535. _CNV_A_R_LINEAR_____279_CM 0. 65535. DISPLAY_IDENTIFIER IP_R_UP_LS_MDL_SENS_NEW FORMAT "%5.0"
 /begin AXIS_DESCR COM_AXIS online_dummy _CNV_A_R_LINEAR_____281_CM 8 0. 65.535 AXIS_PTS_REF ldp_pow_lsh_up_mmv_r_up_ls_mdl /end AXIS_DESCR
 /begin AXIS_DESCR COM_AXIS online_dummy _CNV_A_R_LINEAR_____283_CM 8 0. 2047.96875 FORMAT "%7.2" AXIS_PTS_REF ldp_ttip_ref_ls_up_mdl_r_up_ls /end AXIS_DESCR
/end CHARACTERISTIC
/begin CHARACTERISTIC c_crlc_ttip_fall_r_up_ls "Correlation (filter) constant for falling ceramic temperature, limit calculation" VALUE 0x00640 _REC_VAL_20_u1 0.99610001 _CNV_A_R_LINEAR_____318_CM 0. 0.99610001 DISPLAY_IDENTIFIER C_CRLC_TTIP_FALL_R_UP_LS FORMAT "%5.3" /end CHARACTERISTIC
/begin CHARACTERISTIC c_crlc_pow_lsh_up "Correlation (filter) constant for moving mean value of upstream heater power" VALUE 0x00634 _REC_VAL_20_u1 0.99610001 _CNV_A_R_LINEAR_____29_CM 0. 0.99610001 DISPLAY_IDENTIFIER C_CRLC_POW_LSH_UP FORMAT "%5.3" /end CHARACTERISTIC
/begin MEASUREMENT tqi_sp_mff "Engine torque in stratified combustion for injection setpoint." SWORD _CNV_A_R_LINEAR_____55_CM 1 100. -1024. 1023.96875 DISPLAY_IDENTIFIER TQI_SP_MFF ECU_ADDRESS 0x3fd4dc BYTE_ORDER MSB_LAST FORMAT "%8.2" /end MEASUREMENT
/begin MEASUREMENT tqi_sp_mff_1 "Engine torque in stratified combustion for injection setpoint before manual switch." UWORD _CNV_A_R_LINEAR_____55_CM 1 100. 0. 1023.96875 DISPLAY_IDENTIFIER TQI_SP_MFF_1 ECU_ADDRESS 0x3fd4de BYTE_ORDER MSB_LAST FORMAT "%7.2" /end MEASUREMENT
/begin MEASUREMENT mff_sp_s_1 "fuel mass flow setpoint intermitted value for stratified mode" UWORD _CNV_A_R_LINEAR_____106_CM 1 100. 0. 1389. DISPLAY_IDENTIFIER MFF_SP_S_1 ECU_ADDRESS 0x3fd4da BYTE_ORDER MSB_LAST FORMAT "%7.2" /end MEASUREMENT
/begin MEASUREMENT mff_sp_s "Fuel mass in stratified combustion." UWORD _CNV_A_R_LINEAR_____106_CM 1 100. 0. 1389. DISPLAY_IDENTIFIER MFF_SP_S ECU_ADDRESS 0x3fd4d6 BYTE_ORDER MSB_LAST FORMAT "%7.2" /end MEASUREMENT
/begin MEASUREMENT mff_sp_s_eng "calculated mass fuel flow output for canister purge" UWORD _CNV_A_R_LINEAR_____106_CM 1 100. 0. 1389. DISPLAY_IDENTIFIER MFF_SP_S_ENG ECU_ADDRESS 0x3fd4d8 BYTE_ORDER MSB_LAST FORMAT "%7.2" /end MEASUREMENT
/begin MEASUREMENT eff_tot_bas_s "Total basic efficiency for stratified mode" UWORD _CNV_A_R_LINEAR_____21_CM 1 100. 0. 1.99996948 DISPLAY_IDENTIFIER EFF_TOT_BAS_S ECU_ADDRESS 0x3fd4e0 BYTE_ORDER MSB_LAST FORMAT "%7.5" /end MEASUREMENT
/begin CHARACTERISTIC ip_mff_sp_s "Fuel mass stratified mode" MAP 0x0ccd6 _REC_MAP_20_u2_u1_u2 1389. _CNV_A_R_LINEAR_____106_CM 0. 1389. DISPLAY_IDENTIFIER IP_MFF_SP_S FORMAT "%7.2"
 /begin AXIS_DESCR COM_AXIS n_32 _CNV_A_R_LINEAR_____16_CM 16 0. 8160. FORMAT "%4.0" AXIS_PTS_REF ldpm_n_32_s /end AXIS_DESCR
 /begin AXIS_DESCR COM_AXIS tqi_sp_mff _CNV_A_R_LINEAR_____55_CM 12 0. 1023.96875 FORMAT "%7.2" AXIS_PTS_REF ldpm_tqi_sp_mff_s /end AXIS_DESCR
/end CHARACTERISTIC
/begin CHARACTERISTIC lc_tqi_sp_mff_man_act "Logiacl constant for manual torque-switch" VALUE 0x00f98 _REC_VAL_20_u1 1. _CNV_A_R_LINEAR_____1_CM 0. 1. DISPLAY_IDENTIFIER LC_TQI_SP_MFF_MAN_ACT FORMAT "%2.0" /end CHARACTERISTIC
/begin CHARACTERISTIC c_tqi_sp_mff_man "manual torque switch value" VALUE 0x01994 _REC_VAL_20_u2 1023.96875 _CNV_A_R_LINEAR_____55_CM 0. 1023.96875 DISPLAY_IDENTIFIER C_TQI_SP_MFF_MAN FORMAT "%7.2" /end CHARACTERISTIC
/begin CHARACTERISTIC lc_mff_sp_s_man_act "Logical constant for manual MFF-switch" VALUE 0x00f5c _REC_VAL_20_u1 1. _CNV_A_R_LINEAR_____1_CM 0. 1. DISPLAY_IDENTIFIER LC_MFF_SP_S_MAN_ACT FORMAT "%2.0" /end CHARACTERISTIC
/begin CHARACTERISTIC c_mff_sp_s_man "Manual fuel mass flow setpoint for stratified mode" VALUE 0x016c8 _REC_VAL_20_u2 1389. _CNV_A_R_LINEAR_____106_CM 0. 1389. DISPLAY_IDENTIFIER C_MFF_SP_S_MAN FORMAT "%7.2" /end CHARACTERISTIC
/begin CHARACTERISTIC c_mff_sp_s_ofs_as "Manual fuel mass flow setpoint for application" VALUE 0x016ca _REC_VAL_20_u2 1389. _CNV_A_R_LINEAR_____106_CM 0. 1389. DISPLAY_IDENTIFIER C_MFF_SP_S_OFS_AS FORMAT "%7.2" /end CHARACTERISTIC
/begin AXIS_PTS ldpm_tqi_sp_mff_s "" 0x11c72 tqi_sp_mff _REC_AXS_20_u2 1023.96875 _CNV_A_R_LINEAR_____55_CM 12 0. 1023.96875 DISPLAY_IDENTIFIER LDPM_TQI_SP_MFF_S FORMAT "%7.2" /end AXIS_PTS
/begin CHARACTERISTIC c_ti_min_post_pulse "minimum duration of ti post pulses" VALUE 0x0192c _REC_VAL_20_u2 0.5 _CNV_A_R_LINEAR_____198_CM 0. 5. DISPLAY_IDENTIFIER C_TI_MIN_POST_PULSE FORMAT "%5.3" /end CHARACTERISTIC
/begin MEASUREMENT bios_ti[0] "injection time cylinder logical " UWORD _CNV_A_R_LINEAR_____198_CM 1 100. 0. 262.14 DISPLAY_IDENTIFIER BIOS_TI_0 ECU_ADDRESS 0x3fd50e BYTE_ORDER MSB_LAST FORMAT "%7.3" /end MEASUREMENT
/begin MEASUREMENT bios_ti[1] "injection time cylinder logical " UWORD _CNV_A_R_LINEAR_____198_CM 1 100. 0. 262.14 DISPLAY_IDENTIFIER BIOS_TI_1 ECU_ADDRESS 0x3fd510 BYTE_ORDER MSB_LAST FORMAT "%7.3" /end MEASUREMENT
/begin MEASUREMENT bios_ti[2] "injection time cylinder logical " UWORD _CNV_A_R_LINEAR_____198_CM 1 100. 0. 262.14 DISPLAY_IDENTIFIER BIOS_TI_2 ECU_ADDRESS 0x3fd512 BYTE_ORDER MSB_LAST FORMAT "%7.3" /end MEASUREMENT
/begin MEASUREMENT bios_ti[3] "injection time cylinder logical " UWORD _CNV_A_R_LINEAR_____198_CM 1 100. 0. 262.14 DISPLAY_IDENTIFIER BIOS_TI_3 ECU_ADDRESS 0x3fd514 BYTE_ORDER MSB_LAST FORMAT "%7.3" /end MEASUREMENT
/begin MEASUREMENT bios_ti[4] "injection time cylinder logical " UWORD _CNV_A_R_LINEAR_____198_CM 1 100. 0. 262.14 DISPLAY_IDENTIFIER BIOS_TI_4 ECU_ADDRESS 0x3fd516 BYTE_ORDER MSB_LAST FORMAT "%7.3" /end MEASUREMENT
/begin MEASUREMENT bios_ti[5] "injection time cylinder logical " UWORD _CNV_A_R_LINEAR_____198_CM 1 100. 0. 262.14 DISPLAY_IDENTIFIER BIOS_TI_5 ECU_ADDRESS 0x3fd518 BYTE_ORDER MSB_LAST FORMAT "%7.3" /end MEASUREMENT
/begin MEASUREMENT bios_ti_ofs "offset injection time for dead time correction" SWORD _CNV_A_R_LINEAR_____198_CM 1 100. 0. 131.068 DISPLAY_IDENTIFIER BIOS_TI_OFS ECU_ADDRESS 0x3fd52a BYTE_ORDER MSB_LAST FORMAT "%7.3" /end MEASUREMENT
/begin MEASUREMENT bios_ti_min_post_pulse_inj "minimum duration of ti post pulses" UWORD _CNV_A_R_LINEAR_____198_CM 1 100. 0. 5. DISPLAY_IDENTIFIER BIOS_TI_MIN_POST_PULSE_INJ ECU_ADDRESS 0x3fd526 BYTE_ORDER MSB_LAST FORMAT "%5.3" /end MEASUREMENT
/begin MEASUREMENT bios_eoi_lim "latest possible end of injection before TDC" UWORD _CNV_A_R_LINEAR_____227_CM 1 100. 0. 720. DISPLAY_IDENTIFIER BIOS_EOI_LIM ECU_ADDRESS 0x3fd528 BYTE_ORDER MSB_LAST FORMAT "%6.2" /end MEASUREMENT
/begin MEASUREMENT bios_lv_post_puls_inj "logical variable to enable post pulses" UBYTE _CNV_S_2_RANGE______5_CM 1 100. 0. 1. DISPLAY_IDENTIFIER BIOS_LV_POST_PULS_INJ ECU_ADDRESS 0x3fe36f BIT_MASK 0x1 /end MEASUREMENT
/begin MEASUREMENT bios_eoi[0] "end of injection in °crk before BIOS_EOI_LIM" UWORD _CNV_A_R_LINEAR_____227_CM 1 100. 0. 720. DISPLAY_IDENTIFIER BIOS_EOI_0 ECU_ADDRESS 0x3fd51a BYTE_ORDER MSB_LAST FORMAT "%6.2" /end MEASUREMENT
/begin MEASUREMENT bios_eoi[1] "end of injection in °crk before BIOS_EOI_LIM" UWORD _CNV_A_R_LINEAR_____227_CM 1 100. 0. 720. DISPLAY_IDENTIFIER BIOS_EOI_1 ECU_ADDRESS 0x3fd51c BYTE_ORDER MSB_LAST FORMAT "%6.2" /end MEASUREMENT
/begin MEASUREMENT bios_eoi[2] "end of injection in °crk before BIOS_EOI_LIM" UWORD _CNV_A_R_LINEAR_____227_CM 1 100. 0. 720. DISPLAY_IDENTIFIER BIOS_EOI_2 ECU_ADDRESS 0x3fd51e BYTE_ORDER MSB_LAST FORMAT "%6.2" /end MEASUREMENT
/begin MEASUREMENT bios_eoi[3] "end of injection in °crk before BIOS_EOI_LIM" UWORD _CNV_A_R_LINEAR_____227_CM 1 100. 0. 720. DISPLAY_IDENTIFIER BIOS_EOI_3 ECU_ADDRESS 0x3fd520 BYTE_ORDER MSB_LAST FORMAT "%6.2" /end MEASUREMENT
/begin MEASUREMENT bios_eoi[4] "end of injection in °crk before BIOS_EOI_LIM" UWORD _CNV_A_R_LINEAR_____227_CM 1 100. 0. 720. DISPLAY_IDENTIFIER BIOS_EOI_4 ECU_ADDRESS 0x3fd522 BYTE_ORDER MSB_LAST FORMAT "%6.2" /end MEASUREMENT
/begin MEASUREMENT bios_eoi[5] "end of injection in °crk before BIOS_EOI_LIM" UWORD _CNV_A_R_LINEAR_____227_CM 1 100. 0. 720. DISPLAY_IDENTIFIER BIOS_EOI_5 ECU_ADDRESS 0x3fd524 BYTE_ORDER MSB_LAST FORMAT "%6.2" /end MEASUREMENT
/begin CHARACTERISTIC lc_post_puls_inj_ena "Logical constant for enabling post pulse" VALUE 0x00f64 _REC_VAL_20_u1 1. _CNV_A_R_LINEAR_____22_CM 0. 1. DISPLAY_IDENTIFIER LC_POST_PULS_INJ_ENA FORMAT "%1.0" /end CHARACTERISTIC
/begin CHARACTERISTIC c_ti_as_cyl[0] "injection time factor to correct cylinder injection value cyl. 0" VALUE 0x008be _REC_VAL_20_u1 1.99220002 _CNV_A_R_LINEAR_____39_CM 0. 1.99220002 DISPLAY_IDENTIFIER C_TI_AS_CYL_0 FORMAT "%5.3" /end CHARACTERISTIC
/begin CHARACTERISTIC c_ti_as_cyl[1] "injection time factor to correct cylinder injection value cyl. 1" VALUE 0x008bf _REC_VAL_20_u1 1.99220002 _CNV_A_R_LINEAR_____39_CM 0. 1.99220002 DISPLAY_IDENTIFIER C_TI_AS_CYL_1 FORMAT "%5.3" /end CHARACTERISTIC
/begin CHARACTERISTIC c_ti_as_cyl[2] "injection time factor to correct cylinder injection value cyl. 2" VALUE 0x008c0 _REC_VAL_20_u1 1.99220002 _CNV_A_R_LINEAR_____39_CM 0. 1.99220002 DISPLAY_IDENTIFIER C_TI_AS_CYL_2 FORMAT "%5.3" /end CHARACTERISTIC
/begin CHARACTERISTIC c_ti_as_cyl[3] "injection time factor to correct cylinder injection value cyl. 3" VALUE 0x008c1 _REC_VAL_20_u1 1.99220002 _CNV_A_R_LINEAR_____39_CM 0. 1.99220002 DISPLAY_IDENTIFIER C_TI_AS_CYL_3 FORMAT "%5.3" /end CHARACTERISTIC
/begin CHARACTERISTIC c_ti_as_cyl[4] "injection time factor to correct cylinder injection value cyl. 4" VALUE 0x008c2 _REC_VAL_20_u1 1.99220002 _CNV_A_R_LINEAR_____39_CM 0. 1.99220002 DISPLAY_IDENTIFIER C_TI_AS_CYL_4 FORMAT "%5.3" /end CHARACTERISTIC
/begin CHARACTERISTIC c_ti_as_cyl[5] "injection time factor to correct cylinder injection value cyl. 5" VALUE 0x008c3 _REC_VAL_20_u1 1.99220002 _CNV_A_R_LINEAR_____39_CM 0. 1.99220002 DISPLAY_IDENTIFIER C_TI_AS_CYL_5 FORMAT "%5.3" /end CHARACTERISTIC
/begin CHARACTERISTIC c_ti_as "global injection time correction" VALUE 0x008bd _REC_VAL_20_u1 1.99220002 _CNV_A_R_LINEAR_____39_CM 0. 1.99220002 DISPLAY_IDENTIFIER C_TI_AS FORMAT "%5.3" /end CHARACTERISTIC
/begin MEASUREMENT inj_hom_req "homogeneous injection requested, binary coded" UBYTE _CNV_A_R_LINEAR_____1_CM 1 100. 0. 255. DISPLAY_IDENTIFIER INJ_HOM_REQ ECU_ADDRESS 0x3fe36e FORMAT "%3.0" /end MEASUREMENT
/begin CHARACTERISTIC ip_eoi_min_tipr "Latest permitted predicted end of injection for pre-injection" CURVE 0x0aa16 _REC_CUR_20_u2_u1 720. _CNV_A_R_LINEAR_____82_CM 0. 720. DISPLAY_IDENTIFIER IP_EOI_MIN_TIPR FORMAT "%6.2"
 /begin AXIS_DESCR COM_AXIS tco _CNV_A_R_LINEAR_____12_CM 8 -48. 142.5 FORMAT "%5.1" AXIS_PTS_REF ldp_tco__eoi_min_tipr /end AXIS_DESCR
/end CHARACTERISTIC
/begin CHARACTERISTIC c_nr_max_tooth_tipr "Maximum tooth number till preliminary synchronisation for preinjection" VALUE 0x00798 _REC_VAL_20_u1 63. _CNV_A_R_LINEAR_____1_CM 1. 64. DISPLAY_IDENTIFIER C_NR_MAX_TOOTH_TIPR FORMAT "%3.0" /end CHARACTERISTIC
/begin AXIS_PTS ldp_tco__eoi_min_tipr "" 0x07d71 tco _REC_AXS_20_u1 190.5 _CNV_A_R_LINEAR_____12_CM 8 -48. 142.5 DISPLAY_IDENTIFIER LDP_TCO__EOI_MIN_TIPR FORMAT "%5.1" /end AXIS_PTS
/begin AXIS_PTS ldpm_n_32_s "" 0x08113 n_32 _REC_AXS_20_u1 8160. _CNV_A_R_LINEAR_____16_CM 16 0. 8160. DISPLAY_IDENTIFIER LDPM_N_32_S FORMAT "%4.0" /end AXIS_PTS
/begin MEASUREMENT vls_cur_on_vls_up_1 "Upstream oxygen sensor voltage C_T_CUR_ON_LS_UP after switching on pump current switch" UWORD _CNV_A_R_LINEAR_____3_CM 1 100. 0. 4.99511719 DISPLAY_IDENTIFIER VLS_CUR_ON_VLS_UP_1 ECU_ADDRESS 0x3fb400 BYTE_ORDER MSB_LAST FORMAT "%5.3" /end MEASUREMENT
/begin MEASUREMENT vls_cur_off_vls_up_1 "Upstream oxygen sensor voltage prior to switching on pump current switch" UWORD _CNV_A_R_LINEAR_____3_CM 1 100. 0. 4.99511719 DISPLAY_IDENTIFIER VLS_CUR_OFF_VLS_UP_1 ECU_ADDRESS 0x3fb402 BYTE_ORDER MSB_LAST FORMAT "%5.3" /end MEASUREMENT
/begin MEASUREMENT vls_cur_on_vls_up_2 "Upstream oxygen sensor voltage C_T_CUR_ON_LS_UP after switching on pump current switch" UWORD _CNV_A_R_LINEAR_____3_CM 1 100. 0. 4.99511719 DISPLAY_IDENTIFIER VLS_CUR_ON_VLS_UP_2 ECU_ADDRESS 0x3fb414 BYTE_ORDER MSB_LAST FORMAT "%5.3" /end MEASUREMENT
/begin MEASUREMENT vls_cur_off_vls_up_2 "Upstream oxygen sensor voltage prior to switching on pump current switch" UWORD _CNV_A_R_LINEAR_____3_CM 1 100. 0. 4.99511719 DISPLAY_IDENTIFIER VLS_CUR_OFF_VLS_UP_2 ECU_ADDRESS 0x3fb416 BYTE_ORDER MSB_LAST FORMAT "%5.3" /end MEASUREMENT
/begin MEASUREMENT vls_cur_on_vls_down_1 "Downstream oxygen sensor voltage C_T_CUR_ON_LS_DOWN after switching on pump current switch" UWORD _CNV_A_R_LINEAR_____3_CM 1 100. 0. 4.99511719 DISPLAY_IDENTIFIER VLS_CUR_ON_VLS_DOWN_1 ECU_ADDRESS 0x3fb40a BYTE_ORDER MSB_LAST FORMAT "%5.3" /end MEASUREMENT
/begin MEASUREMENT vls_cur_on_vls_down_2 "Downstream oxygen sensor voltage C_T_CUR_ON_LS_DOWN after switching on pump current switch" UWORD _CNV_A_R_LINEAR_____3_CM 1 100. 0. 4.99511719 DISPLAY_IDENTIFIER VLS_CUR_ON_VLS_DOWN_2 ECU_ADDRESS 0x3fb41e BYTE_ORDER MSB_LAST FORMAT "%5.3" /end MEASUREMENT
/begin MEASUREMENT vls_cur_off_vls_down_1 "Downstream oxygen sensor voltage prior to switching on pump current switch" UWORD _CNV_A_R_LINEAR_____3_CM 1 100. 0. 4.99511719 DISPLAY_IDENTIFIER VLS_CUR_OFF_VLS_DOWN_1 ECU_ADDRESS 0x3fb40c BYTE_ORDER MSB_LAST FORMAT "%5.3" /end MEASUREMENT
/begin MEASUREMENT vls_cur_off_vls_down_2 "Downstream oxygen sensor voltage prior to switching on pump current switch" UWORD _CNV_A_R_LINEAR_____3_CM 1 100. 0. 4.99511719 DISPLAY_IDENTIFIER VLS_CUR_OFF_VLS_DOWN_2 ECU_ADDRESS 0x3fb420 BYTE_ORDER MSB_LAST FORMAT "%5.3" /end MEASUREMENT
/begin COMPU_METHOD _CNV_S_2_RANGE______0_CM "" TAB_VERB "%6.3" "[-]" COMPU_TAB_REF _CNV_S_2_RANGE______0 /end COMPU_METHOD
/begin COMPU_VTAB _CNV_S_2_RANGE______0 "" TAB_VERB 2 0 "0" 1 "1" /end COMPU_VTAB
/begin COMPU_METHOD _CNV_A_R_LINEAR_____1_CM "" RAT_FUNC "%6.3" "-" COEFFS 0 1. 0. 0 0 1 /end COMPU_METHOD
/begin COMPU_METHOD _CNV_A_R_LINEAR_____3_CM "" RAT_FUNC "%6.3" "V" COEFFS 0 204.7999998974999 0. 0 0 1 /end COMPU_METHOD
/begin COMPU_METHOD _CNV_A_R_LINEAR_____4_CM "" RAT_FUNC "%6.3" "s" COEFFS 0 100. 0. 0 0 1 /end COMPU_METHOD
/begin COMPU_METHOD _CNV_S_2_RANGE______5_CM "" TAB_VERB "%6.3" "-" COMPU_TAB_REF _CNV_S_2_RANGE______5 /end COMPU_METHOD
/begin COMPU_VTAB _CNV_S_2_RANGE______5 "" TAB_VERB 2 0 "0" 1 "1" /end COMPU_VTAB
/begin COMPU_METHOD _CNV_A_R_LINEAR_____7_CM "" RAT_FUNC "%6.3" "°C" COEFFS 0 16. 0. 0 0 1 /end COMPU_METHOD
/begin COMPU_METHOD _CNV_A_R_LINEAR_____12_CM "" RAT_FUNC "%6.3" "°C" COEFFS 0 1.333333333333333 64. 0 0 1 /end COMPU_METHOD
/begin COMPU_METHOD _CNV_A_R_LINEAR_____16_CM "" RAT_FUNC "%6.3" "rpm" COEFFS 0 3.125e-002 0. 0 0 1 /end COMPU_METHOD
/begin COMPU_METHOD _CNV_A_R_LINEAR_____21_CM "" RAT_FUNC "%6.3" "-" COEFFS 0 32768.00003968061 0. 0 0 1 /end COMPU_METHOD
/begin COMPU_METHOD _CNV_A_R_LINEAR_____22_CM "" RAT_FUNC "%6.3" "[-]" COEFFS 0 1. 0. 0 0 1 /end COMPU_METHOD
/begin COMPU_METHOD _CNV_A_R_LINEAR_____24_CM "" RAT_FUNC "%6.3" "s" COEFFS 0 10. 0. 0 0 1 /end COMPU_METHOD
/begin COMPU_METHOD _CNV_A_R_LINEAR_____27_CM "" RAT_FUNC "%6.3" "mg/stk" COEFFS 0 0.183585313174946 0. 0 0 1 /end COMPU_METHOD
/begin COMPU_METHOD _CNV_A_R_LINEAR_____29_CM "" RAT_FUNC "%6.3" "-" COEFFS 0 255.9983911655618 0. 0 0 1 /end COMPU_METHOD
/begin COMPU_METHOD _CNV_A_R_LINEAR_____39_CM "" RAT_FUNC "%6.3" "-" COEFFS 0 127.9991955827809 0. 0 0 1 /end COMPU_METHOD
/begin COMPU_METHOD _CNV_A_R_LINEAR_____46_CM "" RAT_FUNC "%6.3" "-" COEFFS 0 16. 0. 0 0 1 /end COMPU_METHOD
/begin COMPU_METHOD _CNV_A_R_LINEAR_____50_CM "" RAT_FUNC "%6.3" "[-]" COEFFS 0 255.9999357490357 0. 0 0 1 /end COMPU_METHOD
/begin COMPU_METHOD _CNV_A_R_LINEAR_____55_CM "" RAT_FUNC "%6.3" "Nm" COEFFS 0 32. 0. 0 0 1 /end COMPU_METHOD
/begin COMPU_METHOD _CNV_A_R_LINEAR_____82_CM "" RAT_FUNC "%6.3" "°CRK" COEFFS 0 2.666666666666667 0. 0 0 1 /end COMPU_METHOD
/begin COMPU_METHOD _CNV_A_R_LINEAR_____106_CM "" RAT_FUNC "%6.3" "mg/stk" COEFFS 0 47.18142548596112 0. 0 0 1 /end COMPU_METHOD
/begin COMPU_METHOD _CNV_A_R_LINEAR_____113_CM "" RAT_FUNC "%6.3" "kg/h" COEFFS 0 32. 0. 0 0 1 /end COMPU_METHOD
/begin COMPU_METHOD _CNV_A_R_LINEAR_____164_CM "" RAT_FUNC "%6.3" "-" COEFFS 0 1023.999999919998 0. 0 0 1 /end COMPU_METHOD
/begin COMPU_METHOD _CNV_A_R_LINEAR_____186_CM "" RAT_FUNC "%6.3" "Nm" COEFFS 0 32. 32768. 0 0 1 /end COMPU_METHOD
/begin COMPU_METHOD _CNV_A_R_LINEAR_____198_CM "" RAT_FUNC "%6.3" "ms" COEFFS 0 250. 0. 0 0 1 /end COMPU_METHOD
/begin COMPU_METHOD _CNV_A_R_LINEAR_____227_CM "" RAT_FUNC "%6.3" "°CRK" COEFFS 0 42.66666666666666 0. 0 0 1 /end COMPU_METHOD
/begin COMPU_METHOD _CNV_A_R_LINEAR_____250_CM "" RAT_FUNC "%6.3" "V" COEFFS 0 13107.19998965744 0. 0 0 1 /end COMPU_METHOD
/begin COMPU_METHOD _CNV_A_R_LINEAR_____264_CM "" RAT_FUNC "%6.3" "-" COEFFS 0 16383.75 32767.5 0 0 1 /end COMPU_METHOD
/begin COMPU_METHOD _CNV_A_R_LINEAR_____266_CM "" RAT_FUNC "%6.3" "[-]" COEFFS 0 1023.999999959999 32767.99999871998 0 0 1 /end COMPU_METHOD
/begin COMPU_METHOD _CNV_A_R_LINEAR_____276_CM "" RAT_FUNC "%6.3" "V/10ms" COEFFS 0 13107.26214524291 0.1553631072602002 0 0 1 /end COMPU_METHOD
/begin COMPU_METHOD _CNV_A_R_LINEAR_____277_CM "" RAT_FUNC "%6.3" "V/10ms" COEFFS 0 13107.20001587224 0. 0 0 1 /end COMPU_METHOD
/begin COMPU_METHOD _CNV_A_R_LINEAR_____278_CM "" RAT_FUNC "%6.3" "[-]" COEFFS 0 4. 0. 0 0 1 /end COMPU_METHOD
/begin COMPU_METHOD _CNV_A_R_LINEAR_____279_CM "" RAT_FUNC "%6.3" "ohm" COEFFS 0 1. 0. 0 0 1 /end COMPU_METHOD
/begin COMPU_METHOD _CNV_A_R_LINEAR_____280_CM "" RAT_FUNC "%6.3" "°C" COEFFS 0 15.99999804684544 -4.000060547696194e-003 0 0 1 /end COMPU_METHOD
/begin COMPU_METHOD _CNV_A_R_LINEAR_____281_CM "" RAT_FUNC "%6.3" "W" COEFFS 0 1000. 0. 0 0 1 /end COMPU_METHOD
/begin COMPU_METHOD _CNV_A_R_LINEAR_____282_CM "" RAT_FUNC "%6.3" "°C" COEFFS 0 15.99999609363174 0. 0 0 1 /end COMPU_METHOD
/begin COMPU_METHOD _CNV_A_R_LINEAR_____283_CM "" RAT_FUNC "%6.3" "°C" COEFFS 0 15.99975585564965 0. 0 0 1 /end COMPU_METHOD
/begin COMPU_METHOD _CNV_A_R_LINEAR_____309_CM "" RAT_FUNC "%6.3" "-" COEFFS 0 16383.99985599781 0. 0 0 1 /end COMPU_METHOD
/begin COMPU_METHOD _CNV_A_R_LINEAR_____317_CM "" RAT_FUNC "%6.3" "s" COEFFS 0 1000. 0. 0 0 1 /end COMPU_METHOD
/begin COMPU_METHOD _CNV_A_R_LINEAR_____318_CM "" RAT_FUNC "%6.3" "1/s" COEFFS 0 255.9983911655618 0. 0 0 1 /end COMPU_METHOD
/begin RECORD_LAYOUT _REC_VAL_20_u1 FNC_VALUES 1 UBYTE COLUMN_DIR DIRECT /end RECORD_LAYOUT
/begin RECORD_LAYOUT _REC_VAL_20_u2 FNC_VALUES 1 UWORD COLUMN_DIR DIRECT /end RECORD_LAYOUT
/begin RECORD_LAYOUT _REC_CUR_20_u2_u1 FNC_VALUES 1 UWORD COLUMN_DIR DIRECT /end RECORD_LAYOUT
/begin RECORD_LAYOUT _REC_AXS_20_u1 NO_AXIS_PTS_X 1 UBYTE AXIS_PTS_X 2 UBYTE INDEX_INCR DIRECT /end RECORD_LAYOUT
/begin RECORD_LAYOUT _REC_CUR_20_u1_u1 FNC_VALUES 1 UBYTE COLUMN_DIR DIRECT /end RECORD_LAYOUT
/begin RECORD_LAYOUT _REC_AXS_20_u2 NO_AXIS_PTS_X 1 UWORD AXIS_PTS_X 2 UWORD INDEX_INCR DIRECT /end RECORD_LAYOUT
/begin RECORD_LAYOUT _REC_MAP_20_u2_u2_u1 FNC_VALUES 1 UWORD COLUMN_DIR DIRECT /end RECORD_LAYOUT
/begin RECORD_LAYOUT _REC_CUR_20_u1_u2 FNC_VALUES 1 UBYTE COLUMN_DIR DIRECT /end RECORD_LAYOUT
/begin RECORD_LAYOUT _REC_MAP_20_u2_u1_u1 FNC_VALUES 1 UWORD COLUMN_DIR DIRECT /end RECORD_LAYOUT
/begin RECORD_LAYOUT _REC_CUR_20_u2_u2 FNC_VALUES 1 UWORD COLUMN_DIR DIRECT /end RECORD_LAYOUT
/begin RECORD_LAYOUT _REC_VAL_20_s2 FNC_VALUES 1 SWORD COLUMN_DIR DIRECT /end RECORD_LAYOUT
/begin RECORD_LAYOUT _REC_MAP_20_u2_u1_u2 FNC_VALUES 1 UWORD COLUMN_DIR DIRECT /end RECORD_LAYOUT
/begin RECORD_LAYOUT _REC_MAP_20_u2_u2_u2 FNC_VALUES 1 UWORD COLUMN_DIR DIRECT /end RECORD_LAYOUT
/begin FUNCTION INJ_Mass_Fuel_Flow_Setpoint_for_ "_Mass Fuel Flow Setpoint for Stratified Mode"
 /begin DEF_CHARACTERISTIC ip_mff_sp_s lc_tqi_sp_mff_man_act c_tqi_sp_mff_man lc_mff_sp_s_man_act c_mff_sp_s_man c_mff_sp_s_ofs_as /end DEF_CHARACTERISTIC
 /begin OUT_MEASUREMENT tqi_sp_mff tqi_sp_mff_1 mff_sp_s_1 mff_sp_s mff_sp_s_eng eff_tot_bas_s /end OUT_MEASUREMENT
/end FUNCTION
/begin FUNCTION INJ_LAMB_RATIO_calculation "_LAMB_RATIO calculation" /begin DEF_CHARACTERISTIC ip_lamb_iga_afl__n_32__maf_hb c_lamb_iga_afr /end DEF_CHARACTERISTIC /begin OUT_MEASUREMENT lamb_ratio /end OUT_MEASUREMENT /end FUNCTION
/begin FUNCTION INJ_Catalyst_heating_with_second "_Catalyst heating with secondary air"
 /begin DEF_CHARACTERISTIC ip_lamb_sawup ip_lamb_sawup_is ip_lamb_add_sawup lc_sa_swi_cmb c_lamb_sp_sa_eol /end DEF_CHARACTERISTIC
 /begin OUT_MEASUREMENT lamb_sawup fac_lamb_de_sa lamb_sa_ch lamb_sp_sa_eol /end OUT_MEASUREMENT
/end FUNCTION
/begin FUNCTION INJ_Injection_Time_Correction_by "_Injection Time Correction by the Application System"
 /begin DEF_CHARACTERISTIC c_ti_as_cyl[0] c_ti_as_cyl[1] c_ti_as_cyl[2] c_ti_as_cyl[3] c_ti_as_cyl[4] c_ti_as_cyl[5] c_ti_as ip_eoi_min_tipr c_nr_max_tooth_tipr /end DEF_CHARACTERISTIC
 /begin OUT_MEASUREMENT bios_ti[0] bios_ti[1] bios_ti[2] bios_ti[3] bios_ti[4] bios_ti[5] inj_hom_req /end OUT_MEASUREMENT
/end FUNCTION
/begin FUNCTION INJ_Transformation_layer_for_bas "_Transformation layer for basic software" /begin DEF_CHARACTERISTIC c_ti_min_post_pulse lc_post_puls_inj_ena /end DEF_CHARACTERISTIC
 /begin OUT_MEASUREMENT bios_ti_ofs bios_ti_min_post_pulse_inj bios_eoi_lim bios_lv_post_puls_inj bios_eoi[0] bios_eoi[1] bios_eoi[2] bios_eoi[3] bios_eoi[4] bios_eoi[5] /end OUT_MEASUREMENT
/end FUNCTION
/begin FUNCTION INJ_Upstream_oxygen_sensor_inter "_Upstream oxygen sensor internal resistance determination"
 /begin DEF_CHARACTERISTIC c_t_cur_dly_ls_up c_t_cur_on_ls_up c_t_cur_off_ls_up c_vls_mmv_min_rng_tol_ls_up c_vls_mmv_min_rng_bol_ls_up c_drv1_vls_up_mmv_thd_min c_drv1_vls_up_mmv_thd_max c_fac_stk_drv1_vls_up_mmv c_fac_drv1_vls_up_mmv_min c_ctr_vls_afl_cyc_r_up_ls c_maf_kgh_r_up_ls c_fac_err_pos_r_up_ls c_fac_err_neg_r_up_ls c_crlc_ttip_rise_r_up_ls lc_inh_r_up_ls_vld c_temp_cur_on_ls_up ip_fac_t_drv1_vls_up_mmv c_drv1_vls_up_abs_max ip_ttip_ls_up ip_crlc_ttip_ref_ls_up_mdl_mmv ip_fac_t_drv1_vls_up_abs ip_r_up_ls_mdl_sens_new c_crlc_ttip_fall_r_up_ls c_crlc_pow_lsh_up /end DEF_CHARACTERISTIC
 /begin OUT_MEASUREMENT lam_bank_1.ls_up_cur.bf.lv_r_up_ls_det lam_bank_1.ls_up_cur.bf.lv_r_up_ls_drv1_vls_cdn lam_bank_1.ls_up_cur.bf.lv_r_up_ls_ena lam_bank_1.ls_up_cur.bf.lv_r_up_ls_vls_rng_cdn lam_bank_1.ls_up_cur.bf.lv_vls_not_vld_up lam_bank_1.ls_up_cur.ctr_cycnr_r_up_ls lam_bank_1.ls_up_cur.drv1_vls_up_mmv_thd_max lam_bank_1.ls_up_cur.drv1_vls_up_mmv_thd_min lam_bank_1.ls_up_cur.fac_t_drv1_vls_up_abs lam_bank_1.ls_up_cur.fac_t_drv1_vls_up_mmv lam_bank_1.ls_up_cur.r_up_ls lam_bank_1.ls_up_cur.r_up_ls_mes lam_bank_1.ls_up_cur.t_sample_r_up_ls lam_bank_1.ls_up_cur.ttip_ls_up_mes lam_bank_1.ls_up_cur.ttip_ls_up_mes_bol lam_bank_1.ls_up_cur.ttip_ls_up_mes_bol_mmv lam_bank_1.ls_up_cur.ttip_ls_up_mes_tol lam_bank_1.ls_up_cur.ttip_ls_up_mes_tol_mmv lam_bank_1.ls_up_cur.r_up_ls_mdl_sens_new lam_bank_1.ls_up_cur.pow_lsh_up_mmv lam_bank_1.ls_up_cur.ttip_ref_ls_up_mdl_mmv lam_bank_2.ls_up_cur.bf.lv_r_up_ls_det lam_bank_2.ls_up_cur.bf.lv_r_up_ls_drv1_vls_cdn lam_bank_2.ls_up_cur.bf.lv_r_up_ls_ena lam_bank_2.ls_up_cur.bf.lv_r_up_ls_vls_rng_cdn lam_bank_2.ls_up_cur.bf.lv_vls_not_vld_up lam_bank_2.ls_up_cur.ctr_cycnr_r_up_ls lam_bank_2.ls_up_cur.drv1_vls_up_mmv_thd_max lam_bank_2.ls_up_cur.drv1_vls_up_mmv_thd_min lam_bank_2.ls_up_cur.fac_t_drv1_vls_up_abs lam_bank_2.ls_up_cur.fac_t_drv1_vls_up_mmv lam_bank_2.ls_up_cur.r_up_ls lam_bank_2.ls_up_cur.r_up_ls_mes lam_bank_2.ls_up_cur.t_sample_r_up_ls lam_bank_2.ls_up_cur.ttip_ls_up_mes lam_bank_2.ls_up_cur.ttip_ls_up_mes_bol lam_bank_2.ls_up_cur.ttip_ls_up_mes_bol_mmv lam_bank_2.ls_up_cur.ttip_ls_up_mes_tol lam_bank_2.ls_up_cur.ttip_ls_up_mes_tol_mmv lam_bank_2.ls_up_cur.r_up_ls_mdl_sens_new lam_bank_2.ls_up_cur.pow_lsh_up_mmv lam_bank_2.ls_up_cur.ttip_ref_ls_up_mdl_mmv vls_cur_on_vls_up_1 vls_cur_off_vls_up_1 vls_cur_on_vls_up_2 vls_cur_off_vls_up_2 /end OUT_MEASUREMENT
/end FUNCTION
/begin FUNCTION INJ_Downstream_oxygen_sensor_int "_Downstream oxygen sensor internal resistance determination"
 /begin DEF_CHARACTERISTIC c_temp_cur_on_ls_down c_t_cur_on_ls_down c_t_cur_off_ls_down c_t_cur_dly_ls_down c_vls_mmv_min_rng_tol_ls_down c_vls_mmv_min_rng_bol_ls_down c_drv1_vls_down_mmv_thd_min c_drv1_vls_down_mmv_thd_max c_fac_stk_drv1_vls_down_mmv c_fac_drv1_vls_down_mmv_min c_drv1_vls_down_abs_max c_ctr_vls_afl_cyc_r_down_ls c_maf_kgh_r_down_ls c_fac_err_pos_r_down_ls c_fac_err_neg_r_down_ls c_crlc_ttip_fall_r_down_ls c_crlc_ttip_rise_r_down_ls lc_inh_r_down_ls_vld ip_fac_t_drv1_vls_down_abs ip_ttip_ls_down ip_fac_t_drv1_vls_down_mmv ip_crlc_ttip_ref_ls_down_mdl c_crlc_pow_lsh_down ip_r_down_ls_mdl_sens_new /end DEF_CHARACTERISTIC
 /begin OUT_MEASUREMENT lam_bank_1.ls_down_cur.bf.lv_r_down_ls_det lam_bank_1.ls_down_cur.bf.lv_r_down_ls_drv1_vls_cdn lam_bank_1.ls_down_cur.bf.lv_r_down_ls_ena lam_bank_1.ls_down_cur.bf.lv_r_down_ls_vls_rng_cdn lam_bank_1.ls_down_cur.bf.lv_vls_not_vld_down lam_bank_1.ls_down_cur.ctr_cycnr_r_down_ls lam_bank_1.ls_down_cur.drv1_vls_down_mmv_thd_max lam_bank_1.ls_down_cur.drv1_vls_down_mmv_thd_min lam_bank_1.ls_down_cur.fac_t_drv1_vls_down_abs lam_bank_1.ls_down_cur.fac_t_drv1_vls_down_mmv lam_bank_1.ls_down_cur.r_down_ls_mes lam_bank_1.ls_down_cur.t_sample_r_down_ls lam_bank_1.ls_down_cur.t_vls_cyc_afl_hld_r_down_ls lam_bank_1.ls_down_cur.ttip_ls_down_mes lam_bank_1.ls_down_cur.ttip_ls_down_mes_bol lam_bank_1.ls_down_cur.ttip_ls_down_mes_bol_mmv lam_bank_1.ls_down_cur.ttip_ls_down_mes_tol lam_bank_1.ls_down_cur.ttip_ls_down_mes_tol_mmv lam_bank_1.ls_down_cur.r_down_ls_mdl_sens_new lam_bank_1.ls_down_cur.pow_lsh_down_mmv lam_bank_1.ls_down_cur.ttip_ref_ls_down_mdl_mmv lam_bank_2.ls_down_cur.bf.lv_r_down_ls_det lam_bank_2.ls_down_cur.bf.lv_r_down_ls_drv1_vls_cdn lam_bank_2.ls_down_cur.bf.lv_r_down_ls_ena lam_bank_2.ls_down_cur.bf.lv_r_down_ls_vls_rng_cdn lam_bank_2.ls_down_cur.bf.lv_vls_not_vld_down lam_bank_2.ls_down_cur.ctr_cycnr_r_down_ls lam_bank_2.ls_down_cur.drv1_vls_down_mmv_thd_max lam_bank_2.ls_down_cur.drv1_vls_down_mmv_thd_min lam_bank_2.ls_down_cur.fac_t_drv1_vls_down_abs lam_bank_2.ls_down_cur.fac_t_drv1_vls_down_mmv lam_bank_2.ls_down_cur.r_down_ls_mes lam_bank_2.ls_down_cur.t_sample_r_down_ls lam_bank_2.ls_down_cur.t_vls_cyc_afl_hld_r_down_ls lam_bank_2.ls_down_cur.ttip_ls_down_mes lam_bank_2.ls_down_cur.ttip_ls_down_mes_bol lam_bank_2.ls_down_cur.ttip_ls_down_mes_bol_mmv lam_bank_2.ls_down_cur.ttip_ls_down_mes_tol lam_bank_2.ls_down_cur.ttip_ls_down_mes_tol_mmv lam_bank_2.ls_down_cur.r_down_ls_mdl_sens_new lam_bank_2.ls_down_cur.pow_lsh_down_mmv lam_bank_2.ls_down_cur.ttip_ref_ls_down_mdl_mmv vls_cur_on_vls_down_1 vls_cur_on_vls_down_2 vls_cur_off_vls_down_1 vls_cur_off_vls_down_2 /end OUT_MEASUREMENT
/end FUNCTION
/end MODULE
/end PROJECT
