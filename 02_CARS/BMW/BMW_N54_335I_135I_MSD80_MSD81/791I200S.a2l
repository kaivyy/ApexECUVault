ASAP2_VERSION 1 41
/begin PROJECT MSD85 "Spray Guided DI-System with Piezo Injectors for 8-Cylinder"
/begin HEADER "_default_HeaderComment" PROJECT_NO _91 /end HEADER
/begin MODULE _default_ModuleName "_default_ModuleLongIdentifier"
/begin MOD_COMMON "_default_ModCommonComment" DEPOSIT ABSOLUTE BYTE_ORDER MSB_LAST ALIGNMENT_BYTE 1 ALIGNMENT_WORD 2 ALIGNMENT_LONG 2 ALIGNMENT_FLOAT32_IEEE 2 ALIGNMENT_FLOAT64_IEEE 4 /end MOD_COMMON
/begin MEASUREMENT fmy_stat_msw_tog.err_info_stat.lv_ready "readiness status of the diagnosis instance MSW_TOG" UWORD _CNV_S_2_RANGE__0___1_CM 1 100. 0. 1. DISPLAY_IDENTIFIER LV_READY_MSW_TOG ECU_ADDRESS 0xd0009866 BIT_MASK 0x10 /end MEASUREMENT
/begin MEASUREMENT fmy_stat_msw_tog.err_info_stat.lv_end_diag "end of diagnosis of the diagnosis instance MSW_TOG" UWORD _CNV_S_2_RANGE__0___1_CM 1 100. 0. 1. DISPLAY_IDENTIFIER LV_END_DIAG_MSW_TOG ECU_ADDRESS 0xd0009866 BIT_MASK 0x20 /end MEASUREMENT
/begin MEASUREMENT fmy_stat_msw_tog.err_info_stat.lv_cdn_diag "diagnosis condition of the diagnosis instance MSW_TOG" UWORD _CNV_S_2_RANGE__0___1_CM 1 100. 0. 1. DISPLAY_IDENTIFIER LV_CDN_DIAG_MSW_TOG ECU_ADDRESS 0xd0009866 BIT_MASK 0x40 /end MEASUREMENT
/begin MEASUREMENT fmy_stat_msw_tog.err_info_stat.err_sym "symptoms of the diagnosis instance MSW_TOG" UWORD _CNV_S_16_RANGE_ERR__349_CM 1 100. 0. 15. DISPLAY_IDENTIFIER ERR_SYM_MSW_TOG ECU_ADDRESS 0xd0009866 BIT_MASK 0x780 /end MEASUREMENT
/begin MEASUREMENT fmy_stat_msw_2.ctr_abc "anti bounce counter for diagnosis instance MSW_2" UBYTE _CNV_A_R_LINEAR_____0_CM 1 100. 0. 255. DISPLAY_IDENTIFIER CTR_ABC_MSW_2 ECU_ADDRESS 0xd000985c FORMAT "%3.0" /end MEASUREMENT
/begin MEASUREMENT fmy_stat_msw_2.ctr_end_diag "counter for end of diagnosis for diagnosis instance MSW_2" UBYTE _CNV_A_R_LINEAR_____0_CM 1 100. 0. 255. DISPLAY_IDENTIFIER CTR_ABC_END_DIAG_MSW_2 ECU_ADDRESS 0xd000985d FORMAT "%3.0" /end MEASUREMENT
/begin MEASUREMENT fmy_stat_msw_2.err_info_stat.lv_err_mem "storage in dynamic failure memory of the diagnosis instance MSW_2" UWORD _CNV_S_2_RANGE__0___1_CM 1 100. 0. 1. DISPLAY_IDENTIFIER LV_ERR_MEM_MSW_2 ECU_ADDRESS 0xd000985e BIT_MASK 0x8 /end MEASUREMENT
/begin MEASUREMENT fmy_stat_msw_2.err_info_stat.lv_ready "readiness status of the diagnosis instance MSW_2" UWORD _CNV_S_2_RANGE__0___1_CM 1 100. 0. 1. DISPLAY_IDENTIFIER LV_READY_MSW_2 ECU_ADDRESS 0xd000985e BIT_MASK 0x10 /end MEASUREMENT
/begin MEASUREMENT fmy_stat_msw_2.err_info_stat.lv_end_diag "end of diagnosis of the diagnosis instance MSW_2" UWORD _CNV_S_2_RANGE__0___1_CM 1 100. 0. 1. DISPLAY_IDENTIFIER LV_END_DIAG_MSW_2 ECU_ADDRESS 0xd000985e BIT_MASK 0x20 /end MEASUREMENT
/begin MEASUREMENT fmy_stat_msw_2.err_info_stat.lv_cdn_diag "diagnosis condition of the diagnosis instance MSW_2" UWORD _CNV_S_2_RANGE__0___1_CM 1 100. 0. 1. DISPLAY_IDENTIFIER LV_CDN_DIAG_MSW_2 ECU_ADDRESS 0xd000985e BIT_MASK 0x40 /end MEASUREMENT
/begin MEASUREMENT fmy_stat_msw_2.err_info_stat.err_sym "symptoms of the diagnosis instance MSW_2" UWORD _CNV_S_16_RANGE_ERR__349_CM 1 100. 0. 15. DISPLAY_IDENTIFIER ERR_SYM_MSW_2 ECU_ADDRESS 0xd000985e BIT_MASK 0x780 /end MEASUREMENT
/begin MEASUREMENT fmy_stat_msw_3.ctr_abc "anti bounce counter for diagnosis instance MSW_3" UBYTE _CNV_A_R_LINEAR_____0_CM 1 100. 0. 255. DISPLAY_IDENTIFIER CTR_ABC_MSW_3 ECU_ADDRESS 0xd0009860 FORMAT "%3.0" /end MEASUREMENT
/begin MEASUREMENT fmy_stat_msw_3.ctr_end_diag "counter for end of diagnosis for diagnosis instance MSW_3" UBYTE _CNV_A_R_LINEAR_____0_CM 1 100. 0. 255. DISPLAY_IDENTIFIER CTR_ABC_END_DIAG_MSW_3 ECU_ADDRESS 0xd0009861 FORMAT "%3.0" /end MEASUREMENT
/begin MEASUREMENT fmy_stat_msw_3.err_info_stat.lv_err_mem "storage in dynamic failure memory of the diagnosis instance MSW_3" UWORD _CNV_S_2_RANGE__0___1_CM 1 100. 0. 1. DISPLAY_IDENTIFIER LV_ERR_MEM_MSW_3 ECU_ADDRESS 0xd0009862 BIT_MASK 0x8 /end MEASUREMENT
/begin MEASUREMENT fmy_stat_msw_3.err_info_stat.lv_ready "readiness status of the diagnosis instance MSW_3" UWORD _CNV_S_2_RANGE__0___1_CM 1 100. 0. 1. DISPLAY_IDENTIFIER LV_READY_MSW_3 ECU_ADDRESS 0xd0009862 BIT_MASK 0x10 /end MEASUREMENT
/begin MEASUREMENT fmy_stat_msw_3.err_info_stat.lv_end_diag "end of diagnosis of the diagnosis instance MSW_3" UWORD _CNV_S_2_RANGE__0___1_CM 1 100. 0. 1. DISPLAY_IDENTIFIER LV_END_DIAG_MSW_3 ECU_ADDRESS 0xd0009862 BIT_MASK 0x20 /end MEASUREMENT
/begin MEASUREMENT fmy_stat_msw_3.err_info_stat.lv_cdn_diag "diagnosis condition of the diagnosis instance MSW_3" UWORD _CNV_S_2_RANGE__0___1_CM 1 100. 0. 1. DISPLAY_IDENTIFIER LV_CDN_DIAG_MSW_3 ECU_ADDRESS 0xd0009862 BIT_MASK 0x40 /end MEASUREMENT
/begin MEASUREMENT fmy_stat_msw_3.err_info_stat.err_sym "symptoms of the diagnosis instance MSW_3" UWORD _CNV_S_16_RANGE_ERR__349_CM 1 100. 0. 15. DISPLAY_IDENTIFIER ERR_SYM_MSW_3 ECU_ADDRESS 0xd0009862 BIT_MASK 0x780 /end MEASUREMENT
/begin MEASUREMENT fmy_stat_mis_0.ctr_abc "anti bounce counter for diagnosis instance MIS_0" UBYTE _CNV_A_R_LINEAR_____0_CM 1 100. 0. 255. DISPLAY_IDENTIFIER CTR_ABC_MIS_0 ECU_ADDRESS 0xd0009830 FORMAT "%3.0" /end MEASUREMENT
/begin MEASUREMENT fmy_stat_mis_0.ctr_end_diag "counter for end of diagnosis for diagnosis instance MIS_0" UBYTE _CNV_A_R_LINEAR_____0_CM 1 100. 0. 255. DISPLAY_IDENTIFIER CTR_ABC_END_DIAG_MIS_0 ECU_ADDRESS 0xd0009831 FORMAT "%3.0" /end MEASUREMENT
/begin MEASUREMENT fmy_stat_mis_0.err_info_stat.lv_err_mem "storage in dynamic failure memory of the diagnosis instance MIS_0" UWORD _CNV_S_2_RANGE__0___1_CM 1 100. 0. 1. DISPLAY_IDENTIFIER LV_ERR_MEM_MIS_0 ECU_ADDRESS 0xd0009832 BIT_MASK 0x8 /end MEASUREMENT
/begin MEASUREMENT fmy_stat_mis_0.err_info_stat.lv_ready "readiness status of the diagnosis instance MIS_0" UWORD _CNV_S_2_RANGE__0___1_CM 1 100. 0. 1. DISPLAY_IDENTIFIER LV_READY_MIS_0 ECU_ADDRESS 0xd0009832 BIT_MASK 0x10 /end MEASUREMENT
/begin MEASUREMENT fmy_stat_mis_0.err_info_stat.lv_end_diag "end of diagnosis of the diagnosis instance MIS_0" UWORD _CNV_S_2_RANGE__0___1_CM 1 100. 0. 1. DISPLAY_IDENTIFIER LV_END_DIAG_MIS_0 ECU_ADDRESS 0xd0009832 BIT_MASK 0x20 /end MEASUREMENT
/begin MEASUREMENT fmy_stat_mis_0.err_info_stat.lv_cdn_diag "diagnosis condition of the diagnosis instance MIS_0" UWORD _CNV_S_2_RANGE__0___1_CM 1 100. 0. 1. DISPLAY_IDENTIFIER LV_CDN_DIAG_MIS_0 ECU_ADDRESS 0xd0009832 BIT_MASK 0x40 /end MEASUREMENT
/begin MEASUREMENT fmy_stat_mis_0.err_info_stat.err_sym "symptoms of the diagnosis instance MIS_0" UWORD _CNV_S_16_RANGE_ERR__349_CM 1 100. 0. 15. DISPLAY_IDENTIFIER ERR_SYM_MIS_0 ECU_ADDRESS 0xd0009832 BIT_MASK 0x780 /end MEASUREMENT
/begin MEASUREMENT fmy_stat_mis_1.ctr_abc "anti bounce counter for diagnosis instance MIS_1" UBYTE _CNV_A_R_LINEAR_____0_CM 1 100. 0. 255. DISPLAY_IDENTIFIER CTR_ABC_MIS_1 ECU_ADDRESS 0xd0009834 FORMAT "%3.0" /end MEASUREMENT
/begin MEASUREMENT fmy_stat_mis_1.ctr_end_diag "counter for end of diagnosis for diagnosis instance MIS_1" UBYTE _CNV_A_R_LINEAR_____0_CM 1 100. 0. 255. DISPLAY_IDENTIFIER CTR_ABC_END_DIAG_MIS_1 ECU_ADDRESS 0xd0009835 FORMAT "%3.0" /end MEASUREMENT
/begin MEASUREMENT fmy_stat_mis_1.err_info_stat.lv_err_mem "storage in dynamic failure memory of the diagnosis instance MIS_1" UWORD _CNV_S_2_RANGE__0___1_CM 1 100. 0. 1. DISPLAY_IDENTIFIER LV_ERR_MEM_MIS_1 ECU_ADDRESS 0xd0009836 BIT_MASK 0x8 /end MEASUREMENT
/begin MEASUREMENT fmy_stat_mis_1.err_info_stat.lv_ready "readiness status of the diagnosis instance MIS_1" UWORD _CNV_S_2_RANGE__0___1_CM 1 100. 0. 1. DISPLAY_IDENTIFIER LV_READY_MIS_1 ECU_ADDRESS 0xd0009836 BIT_MASK 0x10 /end MEASUREMENT
/begin MEASUREMENT fmy_stat_mis_1.err_info_stat.lv_end_diag "end of diagnosis of the diagnosis instance MIS_1" UWORD _CNV_S_2_RANGE__0___1_CM 1 100. 0. 1. DISPLAY_IDENTIFIER LV_END_DIAG_MIS_1 ECU_ADDRESS 0xd0009836 BIT_MASK 0x20 /end MEASUREMENT
/begin MEASUREMENT fmy_stat_mis_1.err_info_stat.lv_cdn_diag "diagnosis condition of the diagnosis instance MIS_1" UWORD _CNV_S_2_RANGE__0___1_CM 1 100. 0. 1. DISPLAY_IDENTIFIER LV_CDN_DIAG_MIS_1 ECU_ADDRESS 0xd0009836 BIT_MASK 0x40 /end MEASUREMENT
/begin MEASUREMENT fmy_stat_mis_1.err_info_stat.err_sym "symptoms of the diagnosis instance MIS_1" UWORD _CNV_S_16_RANGE_ERR__349_CM 1 100. 0. 15. DISPLAY_IDENTIFIER ERR_SYM_MIS_1 ECU_ADDRESS 0xd0009836 BIT_MASK 0x780 /end MEASUREMENT
/begin MEASUREMENT fmy_stat_mis_2.ctr_abc "anti bounce counter for diagnosis instance MIS_2" UBYTE _CNV_A_R_LINEAR_____0_CM 1 100. 0. 255. DISPLAY_IDENTIFIER CTR_ABC_MIS_2 ECU_ADDRESS 0xd0009838 FORMAT "%3.0" /end MEASUREMENT
/begin MEASUREMENT fmy_stat_mis_2.ctr_end_diag "counter for end of diagnosis for diagnosis instance MIS_2" UBYTE _CNV_A_R_LINEAR_____0_CM 1 100. 0. 255. DISPLAY_IDENTIFIER CTR_ABC_END_DIAG_MIS_2 ECU_ADDRESS 0xd0009839 FORMAT "%3.0" /end MEASUREMENT
/begin MEASUREMENT fmy_stat_mis_2.err_info_stat.lv_err_mem "storage in dynamic failure memory of the diagnosis instance MIS_2" UWORD _CNV_S_2_RANGE__0___1_CM 1 100. 0. 1. DISPLAY_IDENTIFIER LV_ERR_MEM_MIS_2 ECU_ADDRESS 0xd000983a BIT_MASK 0x8 /end MEASUREMENT
/begin MEASUREMENT fmy_stat_mis_2.err_info_stat.lv_ready "readiness status of the diagnosis instance MIS_2" UWORD _CNV_S_2_RANGE__0___1_CM 1 100. 0. 1. DISPLAY_IDENTIFIER LV_READY_MIS_2 ECU_ADDRESS 0xd000983a BIT_MASK 0x10 /end MEASUREMENT
/begin MEASUREMENT fmy_stat_mis_2.err_info_stat.lv_end_diag "end of diagnosis of the diagnosis instance MIS_2" UWORD _CNV_S_2_RANGE__0___1_CM 1 100. 0. 1. DISPLAY_IDENTIFIER LV_END_DIAG_MIS_2 ECU_ADDRESS 0xd000983a BIT_MASK 0x20 /end MEASUREMENT
/begin MEASUREMENT fmy_stat_mis_2.err_info_stat.lv_cdn_diag "diagnosis condition of the diagnosis instance MIS_2" UWORD _CNV_S_2_RANGE__0___1_CM 1 100. 0. 1. DISPLAY_IDENTIFIER LV_CDN_DIAG_MIS_2 ECU_ADDRESS 0xd000983a BIT_MASK 0x40 /end MEASUREMENT
/begin MEASUREMENT fmy_stat_mis_2.err_info_stat.err_sym "symptoms of the diagnosis instance MIS_2" UWORD _CNV_S_16_RANGE_ERR__349_CM 1 100. 0. 15. DISPLAY_IDENTIFIER ERR_SYM_MIS_2 ECU_ADDRESS 0xd000983a BIT_MASK 0x780 /end MEASUREMENT
/begin MEASUREMENT fmy_stat_mis_3.ctr_abc "anti bounce counter for diagnosis instance MIS_3" UBYTE _CNV_A_R_LINEAR_____0_CM 1 100. 0. 255. DISPLAY_IDENTIFIER CTR_ABC_MIS_3 ECU_ADDRESS 0xd000983c FORMAT "%3.0" /end MEASUREMENT
/begin MEASUREMENT fmy_stat_mis_3.ctr_end_diag "counter for end of diagnosis for diagnosis instance MIS_3" UBYTE _CNV_A_R_LINEAR_____0_CM 1 100. 0. 255. DISPLAY_IDENTIFIER CTR_ABC_END_DIAG_MIS_3 ECU_ADDRESS 0xd000983d FORMAT "%3.0" /end MEASUREMENT
/begin MEASUREMENT fmy_stat_mis_3.err_info_stat.lv_err_mem "storage in dynamic failure memory of the diagnosis instance MIS_3" UWORD _CNV_S_2_RANGE__0___1_CM 1 100. 0. 1. DISPLAY_IDENTIFIER LV_ERR_MEM_MIS_3 ECU_ADDRESS 0xd000983e BIT_MASK 0x8 /end MEASUREMENT
/begin MEASUREMENT fmy_stat_mis_3.err_info_stat.lv_ready "readiness status of the diagnosis instance MIS_3" UWORD _CNV_S_2_RANGE__0___1_CM 1 100. 0. 1. DISPLAY_IDENTIFIER LV_READY_MIS_3 ECU_ADDRESS 0xd000983e BIT_MASK 0x10 /end MEASUREMENT
/begin MEASUREMENT fmy_stat_mis_3.err_info_stat.lv_end_diag "end of diagnosis of the diagnosis instance MIS_3" UWORD _CNV_S_2_RANGE__0___1_CM 1 100. 0. 1. DISPLAY_IDENTIFIER LV_END_DIAG_MIS_3 ECU_ADDRESS 0xd000983e BIT_MASK 0x20 /end MEASUREMENT
/begin MEASUREMENT fmy_stat_mis_3.err_info_stat.lv_cdn_diag "diagnosis condition of the diagnosis instance MIS_3" UWORD _CNV_S_2_RANGE__0___1_CM 1 100. 0. 1. DISPLAY_IDENTIFIER LV_CDN_DIAG_MIS_3 ECU_ADDRESS 0xd000983e BIT_MASK 0x40 /end MEASUREMENT
/begin MEASUREMENT fmy_stat_mis_3.err_info_stat.err_sym "symptoms of the diagnosis instance MIS_3" UWORD _CNV_S_16_RANGE_ERR__349_CM 1 100. 0. 15. DISPLAY_IDENTIFIER ERR_SYM_MIS_3 ECU_ADDRESS 0xd000983e BIT_MASK 0x780 /end MEASUREMENT
/begin MEASUREMENT fmy_stat_mis_4.ctr_abc "anti bounce counter for diagnosis instance MIS_4" UBYTE _CNV_A_R_LINEAR_____0_CM 1 100. 0. 255. DISPLAY_IDENTIFIER CTR_ABC_MIS_4 ECU_ADDRESS 0xd0009840 FORMAT "%3.0" /end MEASUREMENT
/begin MEASUREMENT fmy_stat_mis_4.ctr_end_diag "counter for end of diagnosis for diagnosis instance MIS_4" UBYTE _CNV_A_R_LINEAR_____0_CM 1 100. 0. 255. DISPLAY_IDENTIFIER CTR_ABC_END_DIAG_MIS_4 ECU_ADDRESS 0xd0009841 FORMAT "%3.0" /end MEASUREMENT
/begin MEASUREMENT fmy_stat_mis_4.err_info_stat.lv_err_mem "storage in dynamic failure memory of the diagnosis instance MIS_4" UWORD _CNV_S_2_RANGE__0___1_CM 1 100. 0. 1. DISPLAY_IDENTIFIER LV_ERR_MEM_MIS_4 ECU_ADDRESS 0xd0009842 BIT_MASK 0x8 /end MEASUREMENT
/begin MEASUREMENT fmy_stat_mis_4.err_info_stat.lv_ready "readiness status of the diagnosis instance MIS_4" UWORD _CNV_S_2_RANGE__0___1_CM 1 100. 0. 1. DISPLAY_IDENTIFIER LV_READY_MIS_4 ECU_ADDRESS 0xd0009842 BIT_MASK 0x10 /end MEASUREMENT
/begin MEASUREMENT fmy_stat_mis_4.err_info_stat.lv_end_diag "end of diagnosis of the diagnosis instance MIS_4" UWORD _CNV_S_2_RANGE__0___1_CM 1 100. 0. 1. DISPLAY_IDENTIFIER LV_END_DIAG_MIS_4 ECU_ADDRESS 0xd0009842 BIT_MASK 0x20 /end MEASUREMENT
/begin MEASUREMENT fmy_stat_mis_4.err_info_stat.lv_cdn_diag "diagnosis condition of the diagnosis instance MIS_4" UWORD _CNV_S_2_RANGE__0___1_CM 1 100. 0. 1. DISPLAY_IDENTIFIER LV_CDN_DIAG_MIS_4 ECU_ADDRESS 0xd0009842 BIT_MASK 0x40 /end MEASUREMENT
/begin MEASUREMENT fmy_stat_mis_4.err_info_stat.err_sym "symptoms of the diagnosis instance MIS_4" UWORD _CNV_S_16_RANGE_ERR__349_CM 1 100. 0. 15. DISPLAY_IDENTIFIER ERR_SYM_MIS_4 ECU_ADDRESS 0xd0009842 BIT_MASK 0x780 /end MEASUREMENT
/begin MEASUREMENT fmy_stat_mis_5.ctr_abc "anti bounce counter for diagnosis instance MIS_5" UBYTE _CNV_A_R_LINEAR_____0_CM 1 100. 0. 255. DISPLAY_IDENTIFIER CTR_ABC_MIS_5 ECU_ADDRESS 0xd0009844 FORMAT "%3.0" /end MEASUREMENT
/begin MEASUREMENT fmy_stat_mis_5.ctr_end_diag "counter for end of diagnosis for diagnosis instance MIS_5" UBYTE _CNV_A_R_LINEAR_____0_CM 1 100. 0. 255. DISPLAY_IDENTIFIER CTR_ABC_END_DIAG_MIS_5 ECU_ADDRESS 0xd0009845 FORMAT "%3.0" /end MEASUREMENT
/begin MEASUREMENT fmy_stat_mis_5.err_info_stat.lv_err_mem "storage in dynamic failure memory of the diagnosis instance MIS_5" UWORD _CNV_S_2_RANGE__0___1_CM 1 100. 0. 1. DISPLAY_IDENTIFIER LV_ERR_MEM_MIS_5 ECU_ADDRESS 0xd0009846 BIT_MASK 0x8 /end MEASUREMENT
/begin MEASUREMENT fmy_stat_mis_5.err_info_stat.lv_ready "readiness status of the diagnosis instance MIS_5" UWORD _CNV_S_2_RANGE__0___1_CM 1 100. 0. 1. DISPLAY_IDENTIFIER LV_READY_MIS_5 ECU_ADDRESS 0xd0009846 BIT_MASK 0x10 /end MEASUREMENT
/begin MEASUREMENT fmy_stat_mis_5.err_info_stat.lv_end_diag "end of diagnosis of the diagnosis instance MIS_5" UWORD _CNV_S_2_RANGE__0___1_CM 1 100. 0. 1. DISPLAY_IDENTIFIER LV_END_DIAG_MIS_5 ECU_ADDRESS 0xd0009846 BIT_MASK 0x20 /end MEASUREMENT
/begin MEASUREMENT fmy_stat_mis_5.err_info_stat.lv_cdn_diag "diagnosis condition of the diagnosis instance MIS_5" UWORD _CNV_S_2_RANGE__0___1_CM 1 100. 0. 1. DISPLAY_IDENTIFIER LV_CDN_DIAG_MIS_5 ECU_ADDRESS 0xd0009846 BIT_MASK 0x40 /end MEASUREMENT
/begin MEASUREMENT fmy_stat_mis_5.err_info_stat.err_sym "symptoms of the diagnosis instance MIS_5" UWORD _CNV_S_16_RANGE_ERR__349_CM 1 100. 0. 15. DISPLAY_IDENTIFIER ERR_SYM_MIS_5 ECU_ADDRESS 0xd0009846 BIT_MASK 0x780 /end MEASUREMENT
/begin MEASUREMENT fmy_stat_mis_6.ctr_abc "anti bounce counter for diagnosis instance MIS_6" UBYTE _CNV_A_R_LINEAR_____0_CM 1 100. 0. 255. DISPLAY_IDENTIFIER CTR_ABC_MIS_6 ECU_ADDRESS 0xd0009848 FORMAT "%3.0" /end MEASUREMENT
/begin MEASUREMENT fmy_stat_mis_6.ctr_end_diag "counter for end of diagnosis for diagnosis instance MIS_6" UBYTE _CNV_A_R_LINEAR_____0_CM 1 100. 0. 255. DISPLAY_IDENTIFIER CTR_ABC_END_DIAG_MIS_6 ECU_ADDRESS 0xd0009849 FORMAT "%3.0" /end MEASUREMENT
/begin MEASUREMENT fmy_stat_mis_6.err_info_stat.lv_err_mem "storage in dynamic failure memory of the diagnosis instance MIS_6" UWORD _CNV_S_2_RANGE__0___1_CM 1 100. 0. 1. DISPLAY_IDENTIFIER LV_ERR_MEM_MIS_6 ECU_ADDRESS 0xd000984a BIT_MASK 0x8 /end MEASUREMENT
/begin MEASUREMENT fmy_stat_mis_6.err_info_stat.lv_ready "readiness status of the diagnosis instance MIS_6" UWORD _CNV_S_2_RANGE__0___1_CM 1 100. 0. 1. DISPLAY_IDENTIFIER LV_READY_MIS_6 ECU_ADDRESS 0xd000984a BIT_MASK 0x10 /end MEASUREMENT
/begin MEASUREMENT fmy_stat_mis_6.err_info_stat.lv_end_diag "end of diagnosis of the diagnosis instance MIS_6" UWORD _CNV_S_2_RANGE__0___1_CM 1 100. 0. 1. DISPLAY_IDENTIFIER LV_END_DIAG_MIS_6 ECU_ADDRESS 0xd000984a BIT_MASK 0x20 /end MEASUREMENT
/begin MEASUREMENT fmy_stat_mis_6.err_info_stat.lv_cdn_diag "diagnosis condition of the diagnosis instance MIS_6" UWORD _CNV_S_2_RANGE__0___1_CM 1 100. 0. 1. DISPLAY_IDENTIFIER LV_CDN_DIAG_MIS_6 ECU_ADDRESS 0xd000984a BIT_MASK 0x40 /end MEASUREMENT
/begin MEASUREMENT fmy_stat_mis_6.err_info_stat.err_sym "symptoms of the diagnosis instance MIS_6" UWORD _CNV_S_16_RANGE_ERR__349_CM 1 100. 0. 15. DISPLAY_IDENTIFIER ERR_SYM_MIS_6 ECU_ADDRESS 0xd000984a BIT_MASK 0x780 /end MEASUREMENT
/begin MEASUREMENT fmy_stat_mis_7.ctr_abc "anti bounce counter for diagnosis instance MIS_7" UBYTE _CNV_A_R_LINEAR_____0_CM 1 100. 0. 255. DISPLAY_IDENTIFIER CTR_ABC_MIS_7 ECU_ADDRESS 0xd000984c FORMAT "%3.0" /end MEASUREMENT
/begin MEASUREMENT fmy_stat_mis_7.ctr_end_diag "counter for end of diagnosis for diagnosis instance MIS_7" UBYTE _CNV_A_R_LINEAR_____0_CM 1 100. 0. 255. DISPLAY_IDENTIFIER CTR_ABC_END_DIAG_MIS_7 ECU_ADDRESS 0xd000984d FORMAT "%3.0" /end MEASUREMENT
/begin MEASUREMENT fmy_stat_mis_7.err_info_stat.lv_err_mem "storage in dynamic failure memory of the diagnosis instance MIS_7" UWORD _CNV_S_2_RANGE__0___1_CM 1 100. 0. 1. DISPLAY_IDENTIFIER LV_ERR_MEM_MIS_7 ECU_ADDRESS 0xd000984e BIT_MASK 0x8 /end MEASUREMENT
/begin MEASUREMENT fmy_stat_mis_7.err_info_stat.lv_ready "readiness status of the diagnosis instance MIS_7" UWORD _CNV_S_2_RANGE__0___1_CM 1 100. 0. 1. DISPLAY_IDENTIFIER LV_READY_MIS_7 ECU_ADDRESS 0xd000984e BIT_MASK 0x10 /end MEASUREMENT
/begin MEASUREMENT fmy_stat_mis_7.err_info_stat.lv_end_diag "end of diagnosis of the diagnosis instance MIS_7" UWORD _CNV_S_2_RANGE__0___1_CM 1 100. 0. 1. DISPLAY_IDENTIFIER LV_END_DIAG_MIS_7 ECU_ADDRESS 0xd000984e BIT_MASK 0x20 /end MEASUREMENT
/begin MEASUREMENT fmy_stat_mis_7.err_info_stat.lv_cdn_diag "diagnosis condition of the diagnosis instance MIS_7" UWORD _CNV_S_2_RANGE__0___1_CM 1 100. 0. 1. DISPLAY_IDENTIFIER LV_CDN_DIAG_MIS_7 ECU_ADDRESS 0xd000984e BIT_MASK 0x40 /end MEASUREMENT
/begin MEASUREMENT fmy_stat_mis_7.err_info_stat.err_sym "symptoms of the diagnosis instance MIS_7" UWORD _CNV_S_16_RANGE_ERR__349_CM 1 100. 0. 15. DISPLAY_IDENTIFIER ERR_SYM_MIS_7 ECU_ADDRESS 0xd000984e BIT_MASK 0x780 /end MEASUREMENT
/begin MEASUREMENT fmy_stat_mis_mpl.ctr_abc "anti bounce counter for diagnosis instance MIS_MPL" UBYTE _CNV_A_R_LINEAR_____0_CM 1 100. 0. 255. DISPLAY_IDENTIFIER CTR_ABC_MIS_MPL ECU_ADDRESS 0xd0009854 FORMAT "%3.0" /end MEASUREMENT
/begin MEASUREMENT fmy_stat_mis_mpl.ctr_end_diag "counter for end of diagnosis for diagnosis instance MIS_MPL" UBYTE _CNV_A_R_LINEAR_____0_CM 1 100. 0. 255. DISPLAY_IDENTIFIER CTR_ABC_END_DIAG_MIS_MPL ECU_ADDRESS 0xd0009855 FORMAT "%3.0" /end MEASUREMENT
/begin MEASUREMENT fmy_stat_mis_mpl.err_info_stat.lv_err_mem "storage in dynamic failure memory of the diagnosis instance MIS_MPL" UWORD _CNV_S_2_RANGE__0___1_CM 1 100. 0. 1. DISPLAY_IDENTIFIER LV_ERR_MEM_MIS_MPL ECU_ADDRESS 0xd0009856 BIT_MASK 0x8 /end MEASUREMENT
/begin MEASUREMENT fmy_stat_mis_mpl.err_info_stat.lv_ready "readiness status of the diagnosis instance MIS_MPL" UWORD _CNV_S_2_RANGE__0___1_CM 1 100. 0. 1. DISPLAY_IDENTIFIER LV_READY_MIS_MPL ECU_ADDRESS 0xd0009856 BIT_MASK 0x10 /end MEASUREMENT
/begin MEASUREMENT fmy_stat_mis_mpl.err_info_stat.lv_end_diag "end of diagnosis of the diagnosis instance MIS_MPL" UWORD _CNV_S_2_RANGE__0___1_CM 1 100. 0. 1. DISPLAY_IDENTIFIER LV_END_DIAG_MIS_MPL ECU_ADDRESS 0xd0009856 BIT_MASK 0x20 /end MEASUREMENT
/begin MEASUREMENT fmy_stat_mis_mpl.err_info_stat.lv_cdn_diag "diagnosis condition of the diagnosis instance MIS_MPL" UWORD _CNV_S_2_RANGE__0___1_CM 1 100. 0. 1. DISPLAY_IDENTIFIER LV_CDN_DIAG_MIS_MPL ECU_ADDRESS 0xd0009856 BIT_MASK 0x40 /end MEASUREMENT
/begin MEASUREMENT fmy_stat_mis_mpl.err_info_stat.err_sym "symptoms of the diagnosis instance MIS_MPL" UWORD _CNV_S_16_RANGE_ERR__349_CM 1 100. 0. 15. DISPLAY_IDENTIFIER ERR_SYM_MIS_MPL ECU_ADDRESS 0xd0009856 BIT_MASK 0x780 /end MEASUREMENT
/begin MEASUREMENT fmy_stat_mis_ftl_l.ctr_abc "anti bounce counter for diagnosis instance MIS_FTL_L" UBYTE _CNV_A_R_LINEAR_____0_CM 1 100. 0. 255. DISPLAY_IDENTIFIER CTR_ABC_MIS_FTL_L ECU_ADDRESS 0xd0009850 FORMAT "%3.0" /end MEASUREMENT
/begin MEASUREMENT fmy_stat_mis_ftl_l.ctr_end_diag "counter for end of diagnosis for diagnosis instance MIS_FTL_L" UBYTE _CNV_A_R_LINEAR_____0_CM 1 100. 0. 255. DISPLAY_IDENTIFIER CTR_ABC_END_DIAG_MIS_FTL_L ECU_ADDRESS 0xd0009851 FORMAT "%3.0" /end MEASUREMENT
/begin MEASUREMENT fmy_stat_mis_ftl_l.err_info_stat.lv_err_mem "storage in dynamic failure memory of the diagnosis instance MIS_FTL_L" UWORD _CNV_S_2_RANGE__0___1_CM 1 100. 0. 1. DISPLAY_IDENTIFIER LV_ERR_MEM_MIS_FTL_L ECU_ADDRESS 0xd0009852 BIT_MASK 0x8 /end MEASUREMENT
/begin MEASUREMENT fmy_stat_mis_ftl_l.err_info_stat.lv_ready "readiness status of the diagnosis instance MIS_FTL_L" UWORD _CNV_S_2_RANGE__0___1_CM 1 100. 0. 1. DISPLAY_IDENTIFIER LV_READY_MIS_FTL_L ECU_ADDRESS 0xd0009852 BIT_MASK 0x10 /end MEASUREMENT
/begin MEASUREMENT fmy_stat_mis_ftl_l.err_info_stat.lv_end_diag "end of diagnosis of the diagnosis instance MIS_FTL_L" UWORD _CNV_S_2_RANGE__0___1_CM 1 100. 0. 1. DISPLAY_IDENTIFIER LV_END_DIAG_MIS_FTL_L ECU_ADDRESS 0xd0009852 BIT_MASK 0x20 /end MEASUREMENT
/begin MEASUREMENT fmy_stat_mis_ftl_l.err_info_stat.lv_cdn_diag "diagnosis condition of the diagnosis instance MIS_FTL_L" UWORD _CNV_S_2_RANGE__0___1_CM 1 100. 0. 1. DISPLAY_IDENTIFIER LV_CDN_DIAG_MIS_FTL_L ECU_ADDRESS 0xd0009852 BIT_MASK 0x40 /end MEASUREMENT
/begin MEASUREMENT fmy_stat_mis_ftl_l.err_info_stat.err_sym "symptoms of the diagnosis instance MIS_FTL_L" UWORD _CNV_S_16_RANGE_ERR__349_CM 1 100. 0. 15. DISPLAY_IDENTIFIER ERR_SYM_MIS_FTL_L ECU_ADDRESS 0xd0009852 BIT_MASK 0x780 /end MEASUREMENT
/begin MEASUREMENT fmy_stat_ef.ctr_abc "anti bounce counter for diagnosis instance EF" UBYTE _CNV_A_R_LINEAR_____0_CM 1 100. 0. 255. DISPLAY_IDENTIFIER CTR_ABC_EF ECU_ADDRESS 0xd000964c FORMAT "%3.0" /end MEASUREMENT
/begin MEASUREMENT fmy_stat_ef.ctr_end_diag "counter for end of diagnosis for diagnosis instance EF" UBYTE _CNV_A_R_LINEAR_____0_CM 1 100. 0. 255. DISPLAY_IDENTIFIER CTR_ABC_END_DIAG_EF ECU_ADDRESS 0xd000964d FORMAT "%3.0" /end MEASUREMENT
/begin MEASUREMENT fmy_stat_ef.err_info_stat.lv_err_mem "storage in dynamic failure memory of the diagnosis instance EF" UWORD _CNV_S_2_RANGE__0___1_CM 1 100. 0. 1. DISPLAY_IDENTIFIER LV_ERR_MEM_EF ECU_ADDRESS 0xd000964e BIT_MASK 0x8 /end MEASUREMENT
/begin MEASUREMENT fmy_stat_ef.err_info_stat.lv_ready "readiness status of the diagnosis instance EF" UWORD _CNV_S_2_RANGE__0___1_CM 1 100. 0. 1. DISPLAY_IDENTIFIER LV_READY_EF ECU_ADDRESS 0xd000964e BIT_MASK 0x10 /end MEASUREMENT
/begin MEASUREMENT fmy_stat_ef.err_info_stat.lv_end_diag "end of diagnosis of the diagnosis instance EF" UWORD _CNV_S_2_RANGE__0___1_CM 1 100. 0. 1. DISPLAY_IDENTIFIER LV_END_DIAG_EF ECU_ADDRESS 0xd000964e BIT_MASK 0x20 /end MEASUREMENT
/begin MEASUREMENT fmy_stat_ef.err_info_stat.lv_cdn_diag "diagnosis condition of the diagnosis instance EF" UWORD _CNV_S_2_RANGE__0___1_CM 1 100. 0. 1. DISPLAY_IDENTIFIER LV_CDN_DIAG_EF ECU_ADDRESS 0xd000964e BIT_MASK 0x40 /end MEASUREMENT
/begin MEASUREMENT fmy_stat_ef.err_info_stat.err_sym "symptoms of the diagnosis instance EF" UWORD _CNV_S_16_RANGE_ERR__349_CM 1 100. 0. 15. DISPLAY_IDENTIFIER ERR_SYM_EF ECU_ADDRESS 0xd000964e BIT_MASK 0x780 /end MEASUREMENT
/begin MEASUREMENT fmy_stat_tecu.ctr_abc "anti bounce counter for diagnosis instance TECU" UBYTE _CNV_A_R_LINEAR_____0_CM 1 100. 0. 255. DISPLAY_IDENTIFIER CTR_ABC_TECU ECU_ADDRESS 0xd0009a2c FORMAT "%3.0" /end MEASUREMENT
/begin MEASUREMENT fmy_stat_tecu.ctr_end_diag "counter for end of diagnosis for diagnosis instance TECU" UBYTE _CNV_A_R_LINEAR_____0_CM 1 100. 0. 255. DISPLAY_IDENTIFIER CTR_ABC_END_DIAG_TECU ECU_ADDRESS 0xd0009a2d FORMAT "%3.0" /end MEASUREMENT
/begin MEASUREMENT fmy_stat_tecu.err_info_stat.lv_err_mem "storage in dynamic failure memory of the diagnosis instance TECU" UWORD _CNV_S_2_RANGE__0___1_CM 1 100. 0. 1. DISPLAY_IDENTIFIER LV_ERR_MEM_TECU ECU_ADDRESS 0xd0009a2e BIT_MASK 0x8 /end MEASUREMENT
/begin MEASUREMENT fmy_stat_tecu.err_info_stat.lv_ready "readiness status of the diagnosis instance TECU" UWORD _CNV_S_2_RANGE__0___1_CM 1 100. 0. 1. DISPLAY_IDENTIFIER LV_READY_TECU ECU_ADDRESS 0xd0009a2e BIT_MASK 0x10 /end MEASUREMENT
/begin MEASUREMENT fmy_stat_tecu.err_info_stat.lv_end_diag "end of diagnosis of the diagnosis instance TECU" UWORD _CNV_S_2_RANGE__0___1_CM 1 100. 0. 1. DISPLAY_IDENTIFIER LV_END_DIAG_TECU ECU_ADDRESS 0xd0009a2e BIT_MASK 0x20 /end MEASUREMENT
/begin MEASUREMENT fmy_stat_tecu.err_info_stat.lv_cdn_diag "diagnosis condition of the diagnosis instance TECU" UWORD _CNV_S_2_RANGE__0___1_CM 1 100. 0. 1. DISPLAY_IDENTIFIER LV_CDN_DIAG_TECU ECU_ADDRESS 0xd0009a2e BIT_MASK 0x40 /end MEASUREMENT
/begin MEASUREMENT fmy_stat_tecu.err_info_stat.err_sym "symptoms of the diagnosis instance TECU" UWORD _CNV_S_16_RANGE_ERR__349_CM 1 100. 0. 15. DISPLAY_IDENTIFIER ERR_SYM_TECU ECU_ADDRESS 0xd0009a2e BIT_MASK 0x780 /end MEASUREMENT
/begin MEASUREMENT fmy_stat_ebox_cfa.ctr_abc "anti bounce counter for diagnosis instance EBOX_CFA" UBYTE _CNV_A_R_LINEAR_____0_CM 1 100. 0. 255. DISPLAY_IDENTIFIER CTR_ABC_EBOX_CFA ECU_ADDRESS 0xd0009618 FORMAT "%3.0" /end MEASUREMENT
/begin MEASUREMENT fmy_stat_ebox_cfa.ctr_end_diag "counter for end of diagnosis for diagnosis instance EBOX_CFA" UBYTE _CNV_A_R_LINEAR_____0_CM 1 100. 0. 255. DISPLAY_IDENTIFIER CTR_ABC_END_DIAG_EBOX_CFA ECU_ADDRESS 0xd0009619 FORMAT "%3.0" /end MEASUREMENT
/begin MEASUREMENT fmy_stat_ebox_cfa.err_info_stat.lv_err_mem "storage in dynamic failure memory of the diagnosis instance EBOX_CFA" UWORD _CNV_S_2_RANGE__0___1_CM 1 100. 0. 1. DISPLAY_IDENTIFIER LV_ERR_MEM_EBOX_CFA ECU_ADDRESS 0xd000961a BIT_MASK 0x8 /end MEASUREMENT
/begin MEASUREMENT fmy_stat_ebox_cfa.err_info_stat.lv_ready "readiness status of the diagnosis instance EBOX_CFA" UWORD _CNV_S_2_RANGE__0___1_CM 1 100. 0. 1. DISPLAY_IDENTIFIER LV_READY_EBOX_CFA ECU_ADDRESS 0xd000961a BIT_MASK 0x10 /end MEASUREMENT
/begin MEASUREMENT fmy_stat_ebox_cfa.err_info_stat.lv_end_diag "end of diagnosis of the diagnosis instance EBOX_CFA" UWORD _CNV_S_2_RANGE__0___1_CM 1 100. 0. 1. DISPLAY_IDENTIFIER LV_END_DIAG_EBOX_CFA ECU_ADDRESS 0xd000961a BIT_MASK 0x20 /end MEASUREMENT
/begin MEASUREMENT fmy_stat_ebox_cfa.err_info_stat.lv_cdn_diag "diagnosis condition of the diagnosis instance EBOX_CFA" UWORD _CNV_S_2_RANGE__0___1_CM 1 100. 0. 1. DISPLAY_IDENTIFIER LV_CDN_DIAG_EBOX_CFA ECU_ADDRESS 0xd000961a BIT_MASK 0x40 /end MEASUREMENT
/begin MEASUREMENT fmy_stat_ebox_cfa.err_info_stat.err_sym "symptoms of the diagnosis instance EBOX_CFA" UWORD _CNV_S_16_RANGE_ERR__349_CM 1 100. 0. 15. DISPLAY_IDENTIFIER ERR_SYM_EBOX_CFA ECU_ADDRESS 0xd000961a BIT_MASK 0x780 /end MEASUREMENT
/begin MEASUREMENT fmy_stat_ecu_ram.ctr_abc "anti bounce counter for diagnosis instance ECU_RAM" UBYTE _CNV_A_R_LINEAR_____0_CM 1 100. 0. 255. DISPLAY_IDENTIFIER CTR_ABC_ECU_RAM ECU_ADDRESS 0xd0009648 FORMAT "%3.0" /end MEASUREMENT
/begin MEASUREMENT fmy_stat_ecu_ram.ctr_end_diag "counter for end of diagnosis for diagnosis instance ECU_RAM" UBYTE _CNV_A_R_LINEAR_____0_CM 1 100. 0. 255. DISPLAY_IDENTIFIER CTR_ABC_END_DIAG_ECU_RAM ECU_ADDRESS 0xd0009649 FORMAT "%3.0" /end MEASUREMENT
/begin MEASUREMENT fmy_stat_ecu_ram.err_info_stat.lv_err_mem "storage in dynamic failure memory of the diagnosis instance ECU_RAM" UWORD _CNV_S_2_RANGE__0___1_CM 1 100. 0. 1. DISPLAY_IDENTIFIER LV_ERR_MEM_ECU_RAM ECU_ADDRESS 0xd000964a BIT_MASK 0x8 /end MEASUREMENT
/begin MEASUREMENT fmy_stat_ecu_ram.err_info_stat.lv_ready "readiness status of the diagnosis instance ECU_RAM" UWORD _CNV_S_2_RANGE__0___1_CM 1 100. 0. 1. DISPLAY_IDENTIFIER LV_READY_ECU_RAM ECU_ADDRESS 0xd000964a BIT_MASK 0x10 /end MEASUREMENT
/begin MEASUREMENT fmy_stat_ecu_ram.err_info_stat.lv_end_diag "end of diagnosis of the diagnosis instance ECU_RAM" UWORD _CNV_S_2_RANGE__0___1_CM 1 100. 0. 1. DISPLAY_IDENTIFIER LV_END_DIAG_ECU_RAM ECU_ADDRESS 0xd000964a BIT_MASK 0x20 /end MEASUREMENT
/begin MEASUREMENT fmy_stat_ecu_ram.err_info_stat.lv_cdn_diag "diagnosis condition of the diagnosis instance ECU_RAM" UWORD _CNV_S_2_RANGE__0___1_CM 1 100. 0. 1. DISPLAY_IDENTIFIER LV_CDN_DIAG_ECU_RAM ECU_ADDRESS 0xd000964a BIT_MASK 0x40 /end MEASUREMENT
/begin MEASUREMENT fmy_stat_ecu_ram.err_info_stat.err_sym "symptoms of the diagnosis instance ECU_RAM" UWORD _CNV_S_16_RANGE_ERR__349_CM 1 100. 0. 15. DISPLAY_IDENTIFIER ERR_SYM_ECU_RAM ECU_ADDRESS 0xd000964a BIT_MASK 0x780 /end MEASUREMENT
/begin MEASUREMENT fmy_stat_tqi_lim.ctr_abc "anti bounce counter for diagnosis instance TQI_LIM" UBYTE _CNV_A_R_LINEAR_____0_CM 1 100. 0. 255. DISPLAY_IDENTIFIER CTR_ABC_TQI_LIM ECU_ADDRESS 0xd0009acc FORMAT "%3.0" /end MEASUREMENT
/begin MEASUREMENT fmy_stat_tqi_lim.ctr_end_diag "counter for end of diagnosis for diagnosis instance TQI_LIM" UBYTE _CNV_A_R_LINEAR_____0_CM 1 100. 0. 255. DISPLAY_IDENTIFIER CTR_ABC_END_DIAG_TQI_LIM ECU_ADDRESS 0xd0009acd FORMAT "%3.0" /end MEASUREMENT
/begin MEASUREMENT fmy_stat_tqi_lim.err_info_stat.lv_err_mem "storage in dynamic failure memory of the diagnosis instance TQI_LIM" UWORD _CNV_S_2_RANGE__0___1_CM 1 100. 0. 1. DISPLAY_IDENTIFIER LV_ERR_MEM_TQI_LIM ECU_ADDRESS 0xd0009ace BIT_MASK 0x8 /end MEASUREMENT
/begin MEASUREMENT fmy_stat_tqi_lim.err_info_stat.lv_ready "readiness status of the diagnosis instance TQI_LIM" UWORD _CNV_S_2_RANGE__0___1_CM 1 100. 0. 1. DISPLAY_IDENTIFIER LV_READY_TQI_LIM ECU_ADDRESS 0xd0009ace BIT_MASK 0x10 /end MEASUREMENT
/begin MEASUREMENT fmy_stat_tqi_lim.err_info_stat.lv_end_diag "end of diagnosis of the diagnosis instance TQI_LIM" UWORD _CNV_S_2_RANGE__0___1_CM 1 100. 0. 1. DISPLAY_IDENTIFIER LV_END_DIAG_TQI_LIM ECU_ADDRESS 0xd0009ace BIT_MASK 0x20 /end MEASUREMENT
/begin MEASUREMENT fmy_stat_tqi_lim.err_info_stat.lv_cdn_diag "diagnosis condition of the diagnosis instance TQI_LIM" UWORD _CNV_S_2_RANGE__0___1_CM 1 100. 0. 1. DISPLAY_IDENTIFIER LV_CDN_DIAG_TQI_LIM ECU_ADDRESS 0xd0009ace BIT_MASK 0x40 /end MEASUREMENT
/begin MEASUREMENT fmy_stat_tqi_lim.err_info_stat.err_sym "symptoms of the diagnosis instance TQI_LIM" UWORD _CNV_S_16_RANGE_ERR__349_CM 1 100. 0. 15. DISPLAY_IDENTIFIER ERR_SYM_TQI_LIM ECU_ADDRESS 0xd0009ace BIT_MASK 0x780 /end MEASUREMENT
/begin MEASUREMENT fmy_stat_dmtls.ctr_abc "anti bounce counter for diagnosis instance DMTLS" UBYTE _CNV_A_R_LINEAR_____0_CM 1 100. 0. 255. DISPLAY_IDENTIFIER CTR_ABC_DMTLS ECU_ADDRESS 0xd0009600 FORMAT "%3.0" /end MEASUREMENT
/begin MEASUREMENT fmy_stat_dmtls.ctr_end_diag "counter for end of diagnosis for diagnosis instance DMTLS" UBYTE _CNV_A_R_LINEAR_____0_CM 1 100. 0. 255. DISPLAY_IDENTIFIER CTR_ABC_END_DIAG_DMTLS ECU_ADDRESS 0xd0009601 FORMAT "%3.0" /end MEASUREMENT
/begin MEASUREMENT fmy_stat_dmtls.err_info_stat.lv_err_mem "storage in dynamic failure memory of the diagnosis instance DMTLS" UWORD _CNV_S_2_RANGE__0___1_CM 1 100. 0. 1. DISPLAY_IDENTIFIER LV_ERR_MEM_DMTLS ECU_ADDRESS 0xd0009602 BIT_MASK 0x8 /end MEASUREMENT
/begin MEASUREMENT fmy_stat_dmtls.err_info_stat.lv_ready "readiness status of the diagnosis instance DMTLS" UWORD _CNV_S_2_RANGE__0___1_CM 1 100. 0. 1. DISPLAY_IDENTIFIER LV_READY_DMTLS ECU_ADDRESS 0xd0009602 BIT_MASK 0x10 /end MEASUREMENT
/begin MEASUREMENT fmy_stat_dmtls.err_info_stat.lv_end_diag "end of diagnosis of the diagnosis instance DMTLS" UWORD _CNV_S_2_RANGE__0___1_CM 1 100. 0. 1. DISPLAY_IDENTIFIER LV_END_DIAG_DMTLS ECU_ADDRESS 0xd0009602 BIT_MASK 0x20 /end MEASUREMENT
/begin MEASUREMENT fmy_stat_dmtls.err_info_stat.lv_cdn_diag "diagnosis condition of the diagnosis instance DMTLS" UWORD _CNV_S_2_RANGE__0___1_CM 1 100. 0. 1. DISPLAY_IDENTIFIER LV_CDN_DIAG_DMTLS ECU_ADDRESS 0xd0009602 BIT_MASK 0x40 /end MEASUREMENT
/begin MEASUREMENT fmy_stat_dmtls.err_info_stat.err_sym "symptoms of the diagnosis instance DMTLS" UWORD _CNV_S_16_RANGE_ERR__349_CM 1 100. 0. 15. DISPLAY_IDENTIFIER ERR_SYM_DMTLS ECU_ADDRESS 0xd0009602 BIT_MASK 0x780 /end MEASUREMENT
/begin MEASUREMENT fmy_stat_dmtl_pump.ctr_abc "anti bounce counter for diagnosis instance DMTL_PUMP" UBYTE _CNV_A_R_LINEAR_____0_CM 1 100. 0. 255. DISPLAY_IDENTIFIER CTR_ABC_DMTL_PUMP ECU_ADDRESS 0xd00095f4 FORMAT "%3.0" /end MEASUREMENT
/begin MEASUREMENT fmy_stat_dmtl_pump.ctr_end_diag "counter for end of diagnosis for diagnosis instance DMTL_PUMP" UBYTE _CNV_A_R_LINEAR_____0_CM 1 100. 0. 255. DISPLAY_IDENTIFIER CTR_ABC_END_DIAG_DMTL_PUMP ECU_ADDRESS 0xd00095f5 FORMAT "%3.0" /end MEASUREMENT
/begin MEASUREMENT fmy_stat_dmtl_pump.err_info_stat.lv_err_mem "storage in dynamic failure memory of the diagnosis instance DMTL_PUMP" UWORD _CNV_S_2_RANGE__0___1_CM 1 100. 0. 1. DISPLAY_IDENTIFIER LV_ERR_MEM_DMTL_PUMP ECU_ADDRESS 0xd00095f6 BIT_MASK 0x8 /end MEASUREMENT
/begin MEASUREMENT fmy_stat_dmtl_pump.err_info_stat.lv_ready "readiness status of the diagnosis instance DMTL_PUMP" UWORD _CNV_S_2_RANGE__0___1_CM 1 100. 0. 1. DISPLAY_IDENTIFIER LV_READY_DMTL_PUMP ECU_ADDRESS 0xd00095f6 BIT_MASK 0x10 /end MEASUREMENT
/begin MEASUREMENT fmy_stat_dmtl_pump.err_info_stat.lv_end_diag "end of diagnosis of the diagnosis instance DMTL_PUMP" UWORD _CNV_S_2_RANGE__0___1_CM 1 100. 0. 1. DISPLAY_IDENTIFIER LV_END_DIAG_DMTL_PUMP ECU_ADDRESS 0xd00095f6 BIT_MASK 0x20 /end MEASUREMENT
/begin MEASUREMENT fmy_stat_dmtl_pump.err_info_stat.lv_cdn_diag "diagnosis condition of the diagnosis instance DMTL_PUMP" UWORD _CNV_S_2_RANGE__0___1_CM 1 100. 0. 1. DISPLAY_IDENTIFIER LV_CDN_DIAG_DMTL_PUMP ECU_ADDRESS 0xd00095f6 BIT_MASK 0x40 /end MEASUREMENT
/begin MEASUREMENT fmy_stat_dmtl_pump.err_info_stat.err_sym "symptoms of the diagnosis instance DMTL_PUMP" UWORD _CNV_S_16_RANGE_ERR__349_CM 1 100. 0. 15. DISPLAY_IDENTIFIER ERR_SYM_DMTL_PUMP ECU_ADDRESS 0xd00095f6 BIT_MASK 0x780 /end MEASUREMENT
/begin MEASUREMENT fmy_stat_dmtlm.ctr_abc "anti bounce counter for diagnosis instance DMTLM" UBYTE _CNV_A_R_LINEAR_____0_CM 1 100. 0. 255. DISPLAY_IDENTIFIER CTR_ABC_DMTLM ECU_ADDRESS 0xd00095fc FORMAT "%3.0" /end MEASUREMENT
/begin MEASUREMENT fmy_stat_dmtlm.ctr_end_diag "counter for end of diagnosis for diagnosis instance DMTLM" UBYTE _CNV_A_R_LINEAR_____0_CM 1 100. 0. 255. DISPLAY_IDENTIFIER CTR_ABC_END_DIAG_DMTLM ECU_ADDRESS 0xd00095fd FORMAT "%3.0" /end MEASUREMENT
/begin MEASUREMENT fmy_stat_dmtlm.err_info_stat.lv_err_mem "storage in dynamic failure memory of the diagnosis instance DMTLM" UWORD _CNV_S_2_RANGE__0___1_CM 1 100. 0. 1. DISPLAY_IDENTIFIER LV_ERR_MEM_DMTLM ECU_ADDRESS 0xd00095fe BIT_MASK 0x8 /end MEASUREMENT
/begin MEASUREMENT fmy_stat_dmtlm.err_info_stat.lv_ready "readiness status of the diagnosis instance DMTLM" UWORD _CNV_S_2_RANGE__0___1_CM 1 100. 0. 1. DISPLAY_IDENTIFIER LV_READY_DMTLM ECU_ADDRESS 0xd00095fe BIT_MASK 0x10 /end MEASUREMENT
/begin MEASUREMENT fmy_stat_dmtlm.err_info_stat.lv_end_diag "end of diagnosis of the diagnosis instance DMTLM" UWORD _CNV_S_2_RANGE__0___1_CM 1 100. 0. 1. DISPLAY_IDENTIFIER LV_END_DIAG_DMTLM ECU_ADDRESS 0xd00095fe BIT_MASK 0x20 /end MEASUREMENT
/begin MEASUREMENT fmy_stat_dmtlm.err_info_stat.lv_cdn_diag "diagnosis condition of the diagnosis instance DMTLM" UWORD _CNV_S_2_RANGE__0___1_CM 1 100. 0. 1. DISPLAY_IDENTIFIER LV_CDN_DIAG_DMTLM ECU_ADDRESS 0xd00095fe BIT_MASK 0x40 /end MEASUREMENT
/begin MEASUREMENT fmy_stat_dmtlm.err_info_stat.err_sym "symptoms of the diagnosis instance DMTLM" UWORD _CNV_S_16_RANGE_ERR__349_CM 1 100. 0. 15. DISPLAY_IDENTIFIER ERR_SYM_DMTLM ECU_ADDRESS 0xd00095fe BIT_MASK 0x780 /end MEASUREMENT
/begin MEASUREMENT fmy_stat_rough_leak.ctr_abc "anti bounce counter for diagnosis instance ROUGH_LEAK" UBYTE _CNV_A_R_LINEAR_____0_CM 1 100. 0. 255. DISPLAY_IDENTIFIER CTR_ABC_ROUGH_LEAK ECU_ADDRESS 0xd0009960 FORMAT "%3.0" /end MEASUREMENT
/begin MEASUREMENT fmy_stat_rough_leak.ctr_end_diag "counter for end of diagnosis for diagnosis instance ROUGH_LEAK" UBYTE _CNV_A_R_LINEAR_____0_CM 1 100. 0. 255. DISPLAY_IDENTIFIER CTR_ABC_END_DIAG_ROUGH_LEAK ECU_ADDRESS 0xd0009961 FORMAT "%3.0" /end MEASUREMENT
/begin MEASUREMENT fmy_stat_rough_leak.err_info_stat.lv_err_mem "storage in dynamic failure memory of the diagnosis instance ROUGH_LEAK" UWORD _CNV_S_2_RANGE__0___1_CM 1 100. 0. 1. DISPLAY_IDENTIFIER LV_ERR_MEM_ROUGH_LEAK ECU_ADDRESS 0xd0009962 BIT_MASK 0x8 /end MEASUREMENT
/begin MEASUREMENT fmy_stat_rough_leak.err_info_stat.lv_ready "readiness status of the diagnosis instance ROUGH_LEAK" UWORD _CNV_S_2_RANGE__0___1_CM 1 100. 0. 1. DISPLAY_IDENTIFIER LV_READY_ROUGH_LEAK ECU_ADDRESS 0xd0009962 BIT_MASK 0x10 /end MEASUREMENT
/begin MEASUREMENT fmy_stat_rough_leak.err_info_stat.lv_end_diag "end of diagnosis of the diagnosis instance ROUGH_LEAK" UWORD _CNV_S_2_RANGE__0___1_CM 1 100. 0. 1. DISPLAY_IDENTIFIER LV_END_DIAG_ROUGH_LEAK ECU_ADDRESS 0xd0009962 BIT_MASK 0x20 /end MEASUREMENT
/begin MEASUREMENT fmy_stat_rough_leak.err_info_stat.lv_cdn_diag "diagnosis condition of the diagnosis instance ROUGH_LEAK" UWORD _CNV_S_2_RANGE__0___1_CM 1 100. 0. 1. DISPLAY_IDENTIFIER LV_CDN_DIAG_ROUGH_LEAK ECU_ADDRESS 0xd0009962 BIT_MASK 0x40 /end MEASUREMENT
/begin MEASUREMENT fmy_stat_rough_leak.err_info_stat.err_sym "symptoms of the diagnosis instance ROUGH_LEAK" UWORD _CNV_S_16_RANGE_ERR__349_CM 1 100. 0. 15. DISPLAY_IDENTIFIER ERR_SYM_ROUGH_LEAK ECU_ADDRESS 0xd0009962 BIT_MASK 0x780 /end MEASUREMENT
/begin MEASUREMENT fmy_stat_small_leak.ctr_abc "anti bounce counter for diagnosis instance SMALL_LEAK" UBYTE _CNV_A_R_LINEAR_____0_CM 1 100. 0. 255. DISPLAY_IDENTIFIER CTR_ABC_SMALL_LEAK ECU_ADDRESS 0xd00099ac FORMAT "%3.0" /end MEASUREMENT
/begin MEASUREMENT fmy_stat_small_leak.ctr_end_diag "counter for end of diagnosis for diagnosis instance SMALL_LEAK" UBYTE _CNV_A_R_LINEAR_____0_CM 1 100. 0. 255. DISPLAY_IDENTIFIER CTR_ABC_END_DIAG_SMALL_LEAK ECU_ADDRESS 0xd00099ad FORMAT "%3.0" /end MEASUREMENT
/begin MEASUREMENT fmy_stat_small_leak.err_info_stat.lv_err_mem "storage in dynamic failure memory of the diagnosis instance SMALL_LEAK" UWORD _CNV_S_2_RANGE__0___1_CM 1 100. 0. 1. DISPLAY_IDENTIFIER LV_ERR_MEM_SMALL_LEAK ECU_ADDRESS 0xd00099ae BIT_MASK 0x8 /end MEASUREMENT
/begin MEASUREMENT fmy_stat_small_leak.err_info_stat.lv_ready "readiness status of the diagnosis instance SMALL_LEAK" UWORD _CNV_S_2_RANGE__0___1_CM 1 100. 0. 1. DISPLAY_IDENTIFIER LV_READY_SMALL_LEAK ECU_ADDRESS 0xd00099ae BIT_MASK 0x10 /end MEASUREMENT
/begin MEASUREMENT fmy_stat_small_leak.err_info_stat.lv_end_diag "end of diagnosis of the diagnosis instance SMALL_LEAK" UWORD _CNV_S_2_RANGE__0___1_CM 1 100. 0. 1. DISPLAY_IDENTIFIER LV_END_DIAG_SMALL_LEAK ECU_ADDRESS 0xd00099ae BIT_MASK 0x20 /end MEASUREMENT
/begin MEASUREMENT fmy_stat_small_leak.err_info_stat.lv_cdn_diag "diagnosis condition of the diagnosis instance SMALL_LEAK" UWORD _CNV_S_2_RANGE__0___1_CM 1 100. 0. 1. DISPLAY_IDENTIFIER LV_CDN_DIAG_SMALL_LEAK ECU_ADDRESS 0xd00099ae BIT_MASK 0x40 /end MEASUREMENT
/begin MEASUREMENT fmy_stat_small_leak.err_info_stat.err_sym "symptoms of the diagnosis instance SMALL_LEAK" UWORD _CNV_S_16_RANGE_ERR__349_CM 1 100. 0. 15. DISPLAY_IDENTIFIER ERR_SYM_SMALL_LEAK ECU_ADDRESS 0xd00099ae BIT_MASK 0x780 /end MEASUREMENT
/begin MEASUREMENT fmy_stat_chk_fuc.ctr_abc "anti bounce counter for diagnosis instance CHK_FUC" UBYTE _CNV_A_R_LINEAR_____0_CM 1 100. 0. 255. DISPLAY_IDENTIFIER CTR_ABC_CHK_FUC ECU_ADDRESS 0xd000949c FORMAT "%3.0" /end MEASUREMENT
/begin MEASUREMENT fmy_stat_chk_fuc.ctr_end_diag "counter for end of diagnosis for diagnosis instance CHK_FUC" UBYTE _CNV_A_R_LINEAR_____0_CM 1 100. 0. 255. DISPLAY_IDENTIFIER CTR_ABC_END_DIAG_CHK_FUC ECU_ADDRESS 0xd000949d FORMAT "%3.0" /end MEASUREMENT
/begin MEASUREMENT fmy_stat_chk_fuc.err_info_stat.lv_err_mem "storage in dynamic failure memory of the diagnosis instance CHK_FUC" UWORD _CNV_S_2_RANGE__0___1_CM 1 100. 0. 1. DISPLAY_IDENTIFIER LV_ERR_MEM_CHK_FUC ECU_ADDRESS 0xd000949e BIT_MASK 0x8 /end MEASUREMENT
/begin MEASUREMENT fmy_stat_chk_fuc.err_info_stat.lv_ready "readiness status of the diagnosis instance CHK_FUC" UWORD _CNV_S_2_RANGE__0___1_CM 1 100. 0. 1. DISPLAY_IDENTIFIER LV_READY_CHK_FUC ECU_ADDRESS 0xd000949e BIT_MASK 0x10 /end MEASUREMENT
/begin MEASUREMENT fmy_stat_chk_fuc.err_info_stat.lv_end_diag "end of diagnosis of the diagnosis instance CHK_FUC" UWORD _CNV_S_2_RANGE__0___1_CM 1 100. 0. 1. DISPLAY_IDENTIFIER LV_END_DIAG_CHK_FUC ECU_ADDRESS 0xd000949e BIT_MASK 0x20 /end MEASUREMENT
/begin MEASUREMENT fmy_stat_chk_fuc.err_info_stat.lv_cdn_diag "diagnosis condition of the diagnosis instance CHK_FUC" UWORD _CNV_S_2_RANGE__0___1_CM 1 100. 0. 1. DISPLAY_IDENTIFIER LV_CDN_DIAG_CHK_FUC ECU_ADDRESS 0xd000949e BIT_MASK 0x40 /end MEASUREMENT
/begin MEASUREMENT fmy_stat_chk_fuc.err_info_stat.err_sym "symptoms of the diagnosis instance CHK_FUC" UWORD _CNV_S_16_RANGE_ERR__349_CM 1 100. 0. 15. DISPLAY_IDENTIFIER ERR_SYM_CHK_FUC ECU_ADDRESS 0xd000949e BIT_MASK 0x780 /end MEASUREMENT
/begin MEASUREMENT fmy_stat_sof.ctr_abc "anti bounce counter for diagnosis instance SOF" UBYTE _CNV_A_R_LINEAR_____0_CM 1 100. 0. 255. DISPLAY_IDENTIFIER CTR_ABC_SOF ECU_ADDRESS 0xd00099b0 FORMAT "%3.0" /end MEASUREMENT
/begin MEASUREMENT fmy_stat_sof.ctr_end_diag "counter for end of diagnosis for diagnosis instance SOF" UBYTE _CNV_A_R_LINEAR_____0_CM 1 100. 0. 255. DISPLAY_IDENTIFIER CTR_ABC_END_DIAG_SOF ECU_ADDRESS 0xd00099b1 FORMAT "%3.0" /end MEASUREMENT
/begin MEASUREMENT fmy_stat_sof.err_info_stat.lv_err_mem "storage in dynamic failure memory of the diagnosis instance SOF" UWORD _CNV_S_2_RANGE__0___1_CM 1 100. 0. 1. DISPLAY_IDENTIFIER LV_ERR_MEM_SOF ECU_ADDRESS 0xd00099b2 BIT_MASK 0x8 /end MEASUREMENT
/begin MEASUREMENT fmy_stat_sof.err_info_stat.lv_ready "readiness status of the diagnosis instance SOF" UWORD _CNV_S_2_RANGE__0___1_CM 1 100. 0. 1. DISPLAY_IDENTIFIER LV_READY_SOF ECU_ADDRESS 0xd00099b2 BIT_MASK 0x10 /end MEASUREMENT
/begin MEASUREMENT fmy_stat_sof.err_info_stat.lv_end_diag "end of diagnosis of the diagnosis instance SOF" UWORD _CNV_S_2_RANGE__0___1_CM 1 100. 0. 1. DISPLAY_IDENTIFIER LV_END_DIAG_SOF ECU_ADDRESS 0xd00099b2 BIT_MASK 0x20 /end MEASUREMENT
/begin MEASUREMENT fmy_stat_sof.err_info_stat.lv_cdn_diag "diagnosis condition of the diagnosis instance SOF" UWORD _CNV_S_2_RANGE__0___1_CM 1 100. 0. 1. DISPLAY_IDENTIFIER LV_CDN_DIAG_SOF ECU_ADDRESS 0xd00099b2 BIT_MASK 0x40 /end MEASUREMENT
/begin MEASUREMENT fmy_stat_sof.err_info_stat.err_sym "symptoms of the diagnosis instance SOF" UWORD _CNV_S_16_RANGE_ERR__349_CM 1 100. 0. 15. DISPLAY_IDENTIFIER ERR_SYM_SOF ECU_ADDRESS 0xd00099b2 BIT_MASK 0x780 /end MEASUREMENT
/begin MEASUREMENT fmy_stat_sof_req.ctr_abc "anti bounce counter for diagnosis instance SOF_REQ" UBYTE _CNV_A_R_LINEAR_____0_CM 1 100. 0. 255. DISPLAY_IDENTIFIER CTR_ABC_SOF_REQ ECU_ADDRESS 0xd00099b4 FORMAT "%3.0" /end MEASUREMENT
/begin MEASUREMENT fmy_stat_sof_req.ctr_end_diag "counter for end of diagnosis for diagnosis instance SOF_REQ" UBYTE _CNV_A_R_LINEAR_____0_CM 1 100. 0. 255. DISPLAY_IDENTIFIER CTR_ABC_END_DIAG_SOF_REQ ECU_ADDRESS 0xd00099b5 FORMAT "%3.0" /end MEASUREMENT
/begin MEASUREMENT fmy_stat_sof_req.err_info_stat.lv_err_mem "storage in dynamic failure memory of the diagnosis instance SOF_REQ" UWORD _CNV_S_2_RANGE__0___1_CM 1 100. 0. 1. DISPLAY_IDENTIFIER LV_ERR_MEM_SOF_REQ ECU_ADDRESS 0xd00099b6 BIT_MASK 0x8 /end MEASUREMENT
/begin MEASUREMENT fmy_stat_sof_req.err_info_stat.lv_ready "readiness status of the diagnosis instance SOF_REQ" UWORD _CNV_S_2_RANGE__0___1_CM 1 100. 0. 1. DISPLAY_IDENTIFIER LV_READY_SOF_REQ ECU_ADDRESS 0xd00099b6 BIT_MASK 0x10 /end MEASUREMENT
/begin MEASUREMENT fmy_stat_sof_req.err_info_stat.lv_end_diag "end of diagnosis of the diagnosis instance SOF_REQ" UWORD _CNV_S_2_RANGE__0___1_CM 1 100. 0. 1. DISPLAY_IDENTIFIER LV_END_DIAG_SOF_REQ ECU_ADDRESS 0xd00099b6 BIT_MASK 0x20 /end MEASUREMENT
/begin MEASUREMENT fmy_stat_sof_req.err_info_stat.lv_cdn_diag "diagnosis condition of the diagnosis instance SOF_REQ" UWORD _CNV_S_2_RANGE__0___1_CM 1 100. 0. 1. DISPLAY_IDENTIFIER LV_CDN_DIAG_SOF_REQ ECU_ADDRESS 0xd00099b6 BIT_MASK 0x40 /end MEASUREMENT
/begin MEASUREMENT fmy_stat_sof_req.err_info_stat.err_sym "symptoms of the diagnosis instance SOF_REQ" UWORD _CNV_S_16_RANGE_ERR__349_CM 1 100. 0. 15. DISPLAY_IDENTIFIER ERR_SYM_SOF_REQ ECU_ADDRESS 0xd00099b6 BIT_MASK 0x780 /end MEASUREMENT
/begin MEASUREMENT fmy_stat_rly_crcv_heat.ctr_abc "anti bounce counter for diagnosis instance RLY_CRCV_HEAT" UBYTE _CNV_A_R_LINEAR_____0_CM 1 100. 0. 255. DISPLAY_IDENTIFIER CTR_ABC_RLY_CRCV_HEAT ECU_ADDRESS 0xd000994c FORMAT "%3.0" /end MEASUREMENT
/begin MEASUREMENT fmy_stat_rly_crcv_heat.ctr_end_diag "counter for end of diagnosis for diagnosis instance RLY_CRCV_HEAT" UBYTE _CNV_A_R_LINEAR_____0_CM 1 100. 0. 255. DISPLAY_IDENTIFIER CTR_ABC_END_DIAG_RLY_CRCV_HEAT ECU_ADDRESS 0xd000994d FORMAT "%3.0" /end MEASUREMENT
/begin MEASUREMENT fmy_stat_rly_crcv_heat.err_info_stat.lv_err_mem "storage in dynamic failure memory of the diagnosis instance RLY_CRCV_HEAT" UWORD _CNV_S_2_RANGE__0___1_CM 1 100. 0. 1. DISPLAY_IDENTIFIER LV_ERR_MEM_RLY_CRCV_HEAT ECU_ADDRESS 0xd000994e BIT_MASK 0x8 /end MEASUREMENT
/begin MEASUREMENT fmy_stat_rly_crcv_heat.err_info_stat.lv_ready "readiness status of the diagnosis instance RLY_CRCV_HEAT" UWORD _CNV_S_2_RANGE__0___1_CM 1 100. 0. 1. DISPLAY_IDENTIFIER LV_READY_RLY_CRCV_HEAT ECU_ADDRESS 0xd000994e BIT_MASK 0x10 /end MEASUREMENT
/begin MEASUREMENT fmy_stat_rly_crcv_heat.err_info_stat.lv_end_diag "end of diagnosis of the diagnosis instance RLY_CRCV_HEAT" UWORD _CNV_S_2_RANGE__0___1_CM 1 100. 0. 1. DISPLAY_IDENTIFIER LV_END_DIAG_RLY_CRCV_HEAT ECU_ADDRESS 0xd000994e BIT_MASK 0x20 /end MEASUREMENT
/begin MEASUREMENT fmy_stat_rly_crcv_heat.err_info_stat.lv_cdn_diag "diagnosis condition of the diagnosis instance RLY_CRCV_HEAT" UWORD _CNV_S_2_RANGE__0___1_CM 1 100. 0. 1. DISPLAY_IDENTIFIER LV_CDN_DIAG_RLY_CRCV_HEAT ECU_ADDRESS 0xd000994e BIT_MASK 0x40 /end MEASUREMENT
/begin MEASUREMENT fmy_stat_rly_crcv_heat.err_info_stat.err_sym "symptoms of the diagnosis instance RLY_CRCV_HEAT" UWORD _CNV_S_16_RANGE_ERR__349_CM 1 100. 0. 15. DISPLAY_IDENTIFIER ERR_SYM_RLY_CRCV_HEAT ECU_ADDRESS 0xd000994e BIT_MASK 0x780 /end MEASUREMENT
/begin MEASUREMENT fmy_stat_rly_st.ctr_abc "anti bounce counter for diagnosis instance RLY_ST" UBYTE _CNV_A_R_LINEAR_____0_CM 1 100. 0. 255. DISPLAY_IDENTIFIER CTR_ABC_RLY_ST ECU_ADDRESS 0xd0009958 FORMAT "%3.0" /end MEASUREMENT
/begin MEASUREMENT fmy_stat_rly_st.ctr_end_diag "counter for end of diagnosis for diagnosis instance RLY_ST" UBYTE _CNV_A_R_LINEAR_____0_CM 1 100. 0. 255. DISPLAY_IDENTIFIER CTR_ABC_END_DIAG_RLY_ST ECU_ADDRESS 0xd0009959 FORMAT "%3.0" /end MEASUREMENT
/begin MEASUREMENT fmy_stat_rly_st.err_info_stat.lv_err_mem "storage in dynamic failure memory of the diagnosis instance RLY_ST" UWORD _CNV_S_2_RANGE__0___1_CM 1 100. 0. 1. DISPLAY_IDENTIFIER LV_ERR_MEM_RLY_ST ECU_ADDRESS 0xd000995a BIT_MASK 0x8 /end MEASUREMENT
/begin MEASUREMENT fmy_stat_rly_st.err_info_stat.lv_ready "readiness status of the diagnosis instance RLY_ST" UWORD _CNV_S_2_RANGE__0___1_CM 1 100. 0. 1. DISPLAY_IDENTIFIER LV_READY_RLY_ST ECU_ADDRESS 0xd000995a BIT_MASK 0x10 /end MEASUREMENT
/begin MEASUREMENT fmy_stat_rly_st.err_info_stat.lv_end_diag "end of diagnosis of the diagnosis instance RLY_ST" UWORD _CNV_S_2_RANGE__0___1_CM 1 100. 0. 1. DISPLAY_IDENTIFIER LV_END_DIAG_RLY_ST ECU_ADDRESS 0xd000995a BIT_MASK 0x20 /end MEASUREMENT
/begin MEASUREMENT fmy_stat_rly_st.err_info_stat.lv_cdn_diag "diagnosis condition of the diagnosis instance RLY_ST" UWORD _CNV_S_2_RANGE__0___1_CM 1 100. 0. 1. DISPLAY_IDENTIFIER LV_CDN_DIAG_RLY_ST ECU_ADDRESS 0xd000995a BIT_MASK 0x40 /end MEASUREMENT
/begin MEASUREMENT fmy_stat_rly_st.err_info_stat.err_sym "symptoms of the diagnosis instance RLY_ST" UWORD _CNV_S_16_RANGE_ERR__349_CM 1 100. 0. 15. DISPLAY_IDENTIFIER ERR_SYM_RLY_ST ECU_ADDRESS 0xd000995a BIT_MASK 0x780 /end MEASUREMENT
/begin MEASUREMENT fmy_stat_bsd.ctr_abc "anti bounce counter for diagnosis instance BSD" UBYTE _CNV_A_R_LINEAR_____0_CM 1 100. 0. 255. DISPLAY_IDENTIFIER CTR_ABC_BSD ECU_ADDRESS 0xd000947c FORMAT "%3.0" /end MEASUREMENT
/begin MEASUREMENT fmy_stat_bsd.ctr_end_diag "counter for end of diagnosis for diagnosis instance BSD" UBYTE _CNV_A_R_LINEAR_____0_CM 1 100. 0. 255. DISPLAY_IDENTIFIER CTR_ABC_END_DIAG_BSD ECU_ADDRESS 0xd000947d FORMAT "%3.0" /end MEASUREMENT
/begin MEASUREMENT fmy_stat_bsd.err_info_stat.lv_err_mem "storage in dynamic failure memory of the diagnosis instance BSD" UWORD _CNV_S_2_RANGE__0___1_CM 1 100. 0. 1. DISPLAY_IDENTIFIER LV_ERR_MEM_BSD ECU_ADDRESS 0xd000947e BIT_MASK 0x8 /end MEASUREMENT
/begin MEASUREMENT fmy_stat_bsd.err_info_stat.lv_ready "readiness status of the diagnosis instance BSD" UWORD _CNV_S_2_RANGE__0___1_CM 1 100. 0. 1. DISPLAY_IDENTIFIER LV_READY_BSD ECU_ADDRESS 0xd000947e BIT_MASK 0x10 /end MEASUREMENT
/begin MEASUREMENT fmy_stat_bsd.err_info_stat.lv_end_diag "end of diagnosis of the diagnosis instance BSD" UWORD _CNV_S_2_RANGE__0___1_CM 1 100. 0. 1. DISPLAY_IDENTIFIER LV_END_DIAG_BSD ECU_ADDRESS 0xd000947e BIT_MASK 0x20 /end MEASUREMENT
/begin MEASUREMENT fmy_stat_bsd.err_info_stat.lv_cdn_diag "diagnosis condition of the diagnosis instance BSD" UWORD _CNV_S_2_RANGE__0___1_CM 1 100. 0. 1. DISPLAY_IDENTIFIER LV_CDN_DIAG_BSD ECU_ADDRESS 0xd000947e BIT_MASK 0x40 /end MEASUREMENT
/begin MEASUREMENT fmy_stat_bsd.err_info_stat.err_sym "symptoms of the diagnosis instance BSD" UWORD _CNV_S_16_RANGE_ERR__349_CM 1 100. 0. 15. DISPLAY_IDENTIFIER ERR_SYM_BSD ECU_ADDRESS 0xd000947e BIT_MASK 0x780 /end MEASUREMENT
/begin MEASUREMENT fmy_stat_poil_swi.ctr_abc "anti bounce counter for diagnosis instance POIL_SWI" UBYTE _CNV_A_R_LINEAR_____0_CM 1 100. 0. 255. DISPLAY_IDENTIFIER CTR_ABC_POIL_SWI ECU_ADDRESS 0xd00098e8 FORMAT "%3.0" /end MEASUREMENT
/begin MEASUREMENT fmy_stat_poil_swi.ctr_end_diag "counter for end of diagnosis for diagnosis instance POIL_SWI" UBYTE _CNV_A_R_LINEAR_____0_CM 1 100. 0. 255. DISPLAY_IDENTIFIER CTR_ABC_END_DIAG_POIL_SWI ECU_ADDRESS 0xd00098e9 FORMAT "%3.0" /end MEASUREMENT
/begin MEASUREMENT fmy_stat_poil_swi.err_info_stat.lv_err_mem "storage in dynamic failure memory of the diagnosis instance POIL_SWI" UWORD _CNV_S_2_RANGE__0___1_CM 1 100. 0. 1. DISPLAY_IDENTIFIER LV_ERR_MEM_POIL_SWI ECU_ADDRESS 0xd00098ea BIT_MASK 0x8 /end MEASUREMENT
/begin MEASUREMENT fmy_stat_poil_swi.err_info_stat.lv_ready "readiness status of the diagnosis instance POIL_SWI" UWORD _CNV_S_2_RANGE__0___1_CM 1 100. 0. 1. DISPLAY_IDENTIFIER LV_READY_POIL_SWI ECU_ADDRESS 0xd00098ea BIT_MASK 0x10 /end MEASUREMENT
/begin MEASUREMENT fmy_stat_poil_swi.err_info_stat.lv_end_diag "end of diagnosis of the diagnosis instance POIL_SWI" UWORD _CNV_S_2_RANGE__0___1_CM 1 100. 0. 1. DISPLAY_IDENTIFIER LV_END_DIAG_POIL_SWI ECU_ADDRESS 0xd00098ea BIT_MASK 0x20 /end MEASUREMENT
/begin MEASUREMENT fmy_stat_poil_swi.err_info_stat.lv_cdn_diag "diagnosis condition of the diagnosis instance POIL_SWI" UWORD _CNV_S_2_RANGE__0___1_CM 1 100. 0. 1. DISPLAY_IDENTIFIER LV_CDN_DIAG_POIL_SWI ECU_ADDRESS 0xd00098ea BIT_MASK 0x40 /end MEASUREMENT
/begin MEASUREMENT fmy_stat_poil_swi.err_info_stat.err_sym "symptoms of the diagnosis instance POIL_SWI" UWORD _CNV_S_16_RANGE_ERR__349_CM 1 100. 0. 15. DISPLAY_IDENTIFIER ERR_SYM_POIL_SWI ECU_ADDRESS 0xd00098ea BIT_MASK 0x780 /end MEASUREMENT
/begin MEASUREMENT fmy_stat_tout_efp_can.ctr_abc "anti bounce counter for diagnosis instance TOUT_EFP_CAN" UBYTE _CNV_A_R_LINEAR_____0_CM 1 100. 0. 255. DISPLAY_IDENTIFIER CTR_ABC_TOUT_EFP_CAN ECU_ADDRESS 0xd0009a68 FORMAT "%3.0" /end MEASUREMENT
/begin MEASUREMENT fmy_stat_tout_efp_can.ctr_end_diag "counter for end of diagnosis for diagnosis instance TOUT_EFP_CAN" UBYTE _CNV_A_R_LINEAR_____0_CM 1 100. 0. 255. DISPLAY_IDENTIFIER CTR_ABC_END_DIAG_TOUT_EFP_CAN ECU_ADDRESS 0xd0009a69 FORMAT "%3.0" /end MEASUREMENT
/begin MEASUREMENT fmy_stat_tout_efp_can.err_info_stat.lv_err_mem "storage in dynamic failure memory of the diagnosis instance TOUT_EFP_CAN" UWORD _CNV_S_2_RANGE__0___1_CM 1 100. 0. 1. DISPLAY_IDENTIFIER LV_ERR_MEM_TOUT_EFP_CAN ECU_ADDRESS 0xd0009a6a BIT_MASK 0x8 /end MEASUREMENT
/begin MEASUREMENT fmy_stat_tout_efp_can.err_info_stat.lv_ready "readiness status of the diagnosis instance TOUT_EFP_CAN" UWORD _CNV_S_2_RANGE__0___1_CM 1 100. 0. 1. DISPLAY_IDENTIFIER LV_READY_TOUT_EFP_CAN ECU_ADDRESS 0xd0009a6a BIT_MASK 0x10 /end MEASUREMENT
/begin MEASUREMENT fmy_stat_tout_efp_can.err_info_stat.lv_end_diag "end of diagnosis of the diagnosis instance TOUT_EFP_CAN" UWORD _CNV_S_2_RANGE__0___1_CM 1 100. 0. 1. DISPLAY_IDENTIFIER LV_END_DIAG_TOUT_EFP_CAN ECU_ADDRESS 0xd0009a6a BIT_MASK 0x20 /end MEASUREMENT
/begin MEASUREMENT fmy_stat_tout_efp_can.err_info_stat.lv_cdn_diag "diagnosis condition of the diagnosis instance TOUT_EFP_CAN" UWORD _CNV_S_2_RANGE__0___1_CM 1 100. 0. 1. DISPLAY_IDENTIFIER LV_CDN_DIAG_TOUT_EFP_CAN ECU_ADDRESS 0xd0009a6a BIT_MASK 0x40 /end MEASUREMENT
/begin MEASUREMENT fmy_stat_tout_efp_can.err_info_stat.err_sym "symptoms of the diagnosis instance TOUT_EFP_CAN" UWORD _CNV_S_16_RANGE_ERR__349_CM 1 100. 0. 15. DISPLAY_IDENTIFIER ERR_SYM_TOUT_EFP_CAN ECU_ADDRESS 0xd0009a6a BIT_MASK 0x780 /end MEASUREMENT
/begin MEASUREMENT fmy_stat_diagcps.ctr_abc "anti bounce counter for diagnosis instance DIAGCPS" UBYTE _CNV_A_R_LINEAR_____0_CM 1 100. 0. 255. DISPLAY_IDENTIFIER CTR_ABC_DIAGCPS ECU_ADDRESS 0xd00095f0 FORMAT "%3.0" /end MEASUREMENT
/begin MEASUREMENT fmy_stat_diagcps.ctr_end_diag "counter for end of diagnosis for diagnosis instance DIAGCPS" UBYTE _CNV_A_R_LINEAR_____0_CM 1 100. 0. 255. DISPLAY_IDENTIFIER CTR_ABC_END_DIAG_DIAGCPS ECU_ADDRESS 0xd00095f1 FORMAT "%3.0" /end MEASUREMENT
/begin MEASUREMENT fmy_stat_diagcps.err_info_stat.lv_err_mem "storage in dynamic failure memory of the diagnosis instance DIAGCPS" UWORD _CNV_S_2_RANGE__0___1_CM 1 100. 0. 1. DISPLAY_IDENTIFIER LV_ERR_MEM_DIAGCPS ECU_ADDRESS 0xd00095f2 BIT_MASK 0x8 /end MEASUREMENT
/begin MEASUREMENT fmy_stat_diagcps.err_info_stat.lv_ready "readiness status of the diagnosis instance DIAGCPS" UWORD _CNV_S_2_RANGE__0___1_CM 1 100. 0. 1. DISPLAY_IDENTIFIER LV_READY_DIAGCPS ECU_ADDRESS 0xd00095f2 BIT_MASK 0x10 /end MEASUREMENT
/begin MEASUREMENT fmy_stat_diagcps.err_info_stat.lv_end_diag "end of diagnosis of the diagnosis instance DIAGCPS" UWORD _CNV_S_2_RANGE__0___1_CM 1 100. 0. 1. DISPLAY_IDENTIFIER LV_END_DIAG_DIAGCPS ECU_ADDRESS 0xd00095f2 BIT_MASK 0x20 /end MEASUREMENT
/begin MEASUREMENT fmy_stat_diagcps.err_info_stat.lv_cdn_diag "diagnosis condition of the diagnosis instance DIAGCPS" UWORD _CNV_S_2_RANGE__0___1_CM 1 100. 0. 1. DISPLAY_IDENTIFIER LV_CDN_DIAG_DIAGCPS ECU_ADDRESS 0xd00095f2 BIT_MASK 0x40 /end MEASUREMENT
/begin MEASUREMENT fmy_stat_diagcps.err_info_stat.err_sym "symptoms of the diagnosis instance DIAGCPS" UWORD _CNV_S_16_RANGE_ERR__349_CM 1 100. 0. 15. DISPLAY_IDENTIFIER ERR_SYM_DIAGCPS ECU_ADDRESS 0xd00095f2 BIT_MASK 0x780 /end MEASUREMENT
/begin MEASUREMENT fmy_stat_dcc.ctr_abc "anti bounce counter for diagnosis instance DCC" UBYTE _CNV_A_R_LINEAR_____0_CM 1 100. 0. 255. DISPLAY_IDENTIFIER CTR_ABC_DCC ECU_ADDRESS 0xd00095e4 FORMAT "%3.0" /end MEASUREMENT
/begin MEASUREMENT fmy_stat_dcc.ctr_end_diag "counter for end of diagnosis for diagnosis instance DCC" UBYTE _CNV_A_R_LINEAR_____0_CM 1 100. 0. 255. DISPLAY_IDENTIFIER CTR_ABC_END_DIAG_DCC ECU_ADDRESS 0xd00095e5 FORMAT "%3.0" /end MEASUREMENT
/begin MEASUREMENT fmy_stat_dcc.err_info_stat.lv_err_mem "storage in dynamic failure memory of the diagnosis instance DCC" UWORD _CNV_S_2_RANGE__0___1_CM 1 100. 0. 1. DISPLAY_IDENTIFIER LV_ERR_MEM_DCC ECU_ADDRESS 0xd00095e6 BIT_MASK 0x8 /end MEASUREMENT
/begin MEASUREMENT fmy_stat_dcc.err_info_stat.lv_ready "readiness status of the diagnosis instance DCC" UWORD _CNV_S_2_RANGE__0___1_CM 1 100. 0. 1. DISPLAY_IDENTIFIER LV_READY_DCC ECU_ADDRESS 0xd00095e6 BIT_MASK 0x10 /end MEASUREMENT
/begin MEASUREMENT fmy_stat_dcc.err_info_stat.lv_end_diag "end of diagnosis of the diagnosis instance DCC" UWORD _CNV_S_2_RANGE__0___1_CM 1 100. 0. 1. DISPLAY_IDENTIFIER LV_END_DIAG_DCC ECU_ADDRESS 0xd00095e6 BIT_MASK 0x20 /end MEASUREMENT
/begin MEASUREMENT fmy_stat_dcc.err_info_stat.lv_cdn_diag "diagnosis condition of the diagnosis instance DCC" UWORD _CNV_S_2_RANGE__0___1_CM 1 100. 0. 1. DISPLAY_IDENTIFIER LV_CDN_DIAG_DCC ECU_ADDRESS 0xd00095e6 BIT_MASK 0x40 /end MEASUREMENT
/begin MEASUREMENT fmy_stat_dcc.err_info_stat.err_sym "symptoms of the diagnosis instance DCC" UWORD _CNV_S_16_RANGE_ERR__349_CM 1 100. 0. 15. DISPLAY_IDENTIFIER ERR_SYM_DCC ECU_ADDRESS 0xd00095e6 BIT_MASK 0x780 /end MEASUREMENT
/begin MEASUREMENT fmy_stat_ldm.ctr_abc "anti bounce counter for diagnosis instance LDM" UBYTE _CNV_A_R_LINEAR_____0_CM 1 100. 0. 255. DISPLAY_IDENTIFIER CTR_ABC_LDM ECU_ADDRESS 0xd00097c0 FORMAT "%3.0" /end MEASUREMENT
/begin MEASUREMENT fmy_stat_ldm.ctr_end_diag "counter for end of diagnosis for diagnosis instance LDM" UBYTE _CNV_A_R_LINEAR_____0_CM 1 100. 0. 255. DISPLAY_IDENTIFIER CTR_ABC_END_DIAG_LDM ECU_ADDRESS 0xd00097c1 FORMAT "%3.0" /end MEASUREMENT
/begin MEASUREMENT fmy_stat_ldm.err_info_stat.lv_err_mem "storage in dynamic failure memory of the diagnosis instance LDM" UWORD _CNV_S_2_RANGE__0___1_CM 1 100. 0. 1. DISPLAY_IDENTIFIER LV_ERR_MEM_LDM ECU_ADDRESS 0xd00097c2 BIT_MASK 0x8 /end MEASUREMENT
/begin MEASUREMENT fmy_stat_ldm.err_info_stat.lv_ready "readiness status of the diagnosis instance LDM" UWORD _CNV_S_2_RANGE__0___1_CM 1 100. 0. 1. DISPLAY_IDENTIFIER LV_READY_LDM ECU_ADDRESS 0xd00097c2 BIT_MASK 0x10 /end MEASUREMENT
/begin MEASUREMENT fmy_stat_ldm.err_info_stat.lv_end_diag "end of diagnosis of the diagnosis instance LDM" UWORD _CNV_S_2_RANGE__0___1_CM 1 100. 0. 1. DISPLAY_IDENTIFIER LV_END_DIAG_LDM ECU_ADDRESS 0xd00097c2 BIT_MASK 0x20 /end MEASUREMENT
/begin MEASUREMENT fmy_stat_ldm.err_info_stat.lv_cdn_diag "diagnosis condition of the diagnosis instance LDM" UWORD _CNV_S_2_RANGE__0___1_CM 1 100. 0. 1. DISPLAY_IDENTIFIER LV_CDN_DIAG_LDM ECU_ADDRESS 0xd00097c2 BIT_MASK 0x40 /end MEASUREMENT
/begin MEASUREMENT fmy_stat_ldm.err_info_stat.err_sym "symptoms of the diagnosis instance LDM" UWORD _CNV_S_16_RANGE_ERR__349_CM 1 100. 0. 15. DISPLAY_IDENTIFIER ERR_SYM_LDM ECU_ADDRESS 0xd00097c2 BIT_MASK 0x780 /end MEASUREMENT
/begin MEASUREMENT fmy_stat_dmtlh.ctr_abc "anti bounce counter for diagnosis instance DMTLH" UBYTE _CNV_A_R_LINEAR_____0_CM 1 100. 0. 255. DISPLAY_IDENTIFIER CTR_ABC_DMTLH ECU_ADDRESS 0xd00095f8 FORMAT "%3.0" /end MEASUREMENT
/begin MEASUREMENT fmy_stat_dmtlh.ctr_end_diag "counter for end of diagnosis for diagnosis instance DMTLH" UBYTE _CNV_A_R_LINEAR_____0_CM 1 100. 0. 255. DISPLAY_IDENTIFIER CTR_ABC_END_DIAG_DMTLH ECU_ADDRESS 0xd00095f9 FORMAT "%3.0" /end MEASUREMENT
/begin MEASUREMENT fmy_stat_dmtlh.err_info_stat.lv_err_mem "storage in dynamic failure memory of the diagnosis instance DMTLH" UWORD _CNV_S_2_RANGE__0___1_CM 1 100. 0. 1. DISPLAY_IDENTIFIER LV_ERR_MEM_DMTLH ECU_ADDRESS 0xd00095fa BIT_MASK 0x8 /end MEASUREMENT
/begin MEASUREMENT fmy_stat_dmtlh.err_info_stat.lv_ready "readiness status of the diagnosis instance DMTLH" UWORD _CNV_S_2_RANGE__0___1_CM 1 100. 0. 1. DISPLAY_IDENTIFIER LV_READY_DMTLH ECU_ADDRESS 0xd00095fa BIT_MASK 0x10 /end MEASUREMENT
/begin MEASUREMENT fmy_stat_dmtlh.err_info_stat.lv_end_diag "end of diagnosis of the diagnosis instance DMTLH" UWORD _CNV_S_2_RANGE__0___1_CM 1 100. 0. 1. DISPLAY_IDENTIFIER LV_END_DIAG_DMTLH ECU_ADDRESS 0xd00095fa BIT_MASK 0x20 /end MEASUREMENT
/begin MEASUREMENT fmy_stat_dmtlh.err_info_stat.lv_cdn_diag "diagnosis condition of the diagnosis instance DMTLH" UWORD _CNV_S_2_RANGE__0___1_CM 1 100. 0. 1. DISPLAY_IDENTIFIER LV_CDN_DIAG_DMTLH ECU_ADDRESS 0xd00095fa BIT_MASK 0x40 /end MEASUREMENT
/begin MEASUREMENT fmy_stat_dmtlh.err_info_stat.err_sym "symptoms of the diagnosis instance DMTLH" UWORD _CNV_S_16_RANGE_ERR__349_CM 1 100. 0. 15. DISPLAY_IDENTIFIER ERR_SYM_DMTLH ECU_ADDRESS 0xd00095fa BIT_MASK 0x780 /end MEASUREMENT
/begin MEASUREMENT fmy_stat_cs.ctr_abc "anti bounce counter for diagnosis instance CS" UBYTE _CNV_A_R_LINEAR_____0_CM 1 100. 0. 255. DISPLAY_IDENTIFIER CTR_ABC_CS ECU_ADDRESS 0xd0009580 FORMAT "%3.0" /end MEASUREMENT
/begin MEASUREMENT fmy_stat_cs.ctr_end_diag "counter for end of diagnosis for diagnosis instance CS" UBYTE _CNV_A_R_LINEAR_____0_CM 1 100. 0. 255. DISPLAY_IDENTIFIER CTR_ABC_END_DIAG_CS ECU_ADDRESS 0xd0009581 FORMAT "%3.0" /end MEASUREMENT
/begin MEASUREMENT fmy_stat_cs.err_info_stat.lv_err_mem "storage in dynamic failure memory of the diagnosis instance CS" UWORD _CNV_S_2_RANGE__0___1_CM 1 100. 0. 1. DISPLAY_IDENTIFIER LV_ERR_MEM_CS ECU_ADDRESS 0xd0009582 BIT_MASK 0x8 /end MEASUREMENT
/begin MEASUREMENT fmy_stat_cs.err_info_stat.lv_ready "readiness status of the diagnosis instance CS" UWORD _CNV_S_2_RANGE__0___1_CM 1 100. 0. 1. DISPLAY_IDENTIFIER LV_READY_CS ECU_ADDRESS 0xd0009582 BIT_MASK 0x10 /end MEASUREMENT
/begin MEASUREMENT fmy_stat_cs.err_info_stat.lv_end_diag "end of diagnosis of the diagnosis instance CS" UWORD _CNV_S_2_RANGE__0___1_CM 1 100. 0. 1. DISPLAY_IDENTIFIER LV_END_DIAG_CS ECU_ADDRESS 0xd0009582 BIT_MASK 0x20 /end MEASUREMENT
/begin MEASUREMENT fmy_stat_cs.err_info_stat.lv_cdn_diag "diagnosis condition of the diagnosis instance CS" UWORD _CNV_S_2_RANGE__0___1_CM 1 100. 0. 1. DISPLAY_IDENTIFIER LV_CDN_DIAG_CS ECU_ADDRESS 0xd0009582 BIT_MASK 0x40 /end MEASUREMENT
/begin MEASUREMENT fmy_stat_cs.err_info_stat.err_sym "symptoms of the diagnosis instance CS" UWORD _CNV_S_16_RANGE_ERR__349_CM 1 100. 0. 15. DISPLAY_IDENTIFIER ERR_SYM_CS ECU_ADDRESS 0xd0009582 BIT_MASK 0x780 /end MEASUREMENT
/begin MEASUREMENT fmy_stat_spi_mps.ctr_abc "anti bounce counter for diagnosis instance SPI_MPS" UBYTE _CNV_A_R_LINEAR_____0_CM 1 100. 0. 255. DISPLAY_IDENTIFIER CTR_ABC_SPI_MPS ECU_ADDRESS 0xd00099bc FORMAT "%3.0" /end MEASUREMENT
/begin MEASUREMENT fmy_stat_spi_mps.ctr_end_diag "counter for end of diagnosis for diagnosis instance SPI_MPS" UBYTE _CNV_A_R_LINEAR_____0_CM 1 100. 0. 255. DISPLAY_IDENTIFIER CTR_ABC_END_DIAG_SPI_MPS ECU_ADDRESS 0xd00099bd FORMAT "%3.0" /end MEASUREMENT
/begin MEASUREMENT fmy_stat_spi_mps.err_info_stat.lv_err_mem "storage in dynamic failure memory of the diagnosis instance SPI_MPS" UWORD _CNV_S_2_RANGE__0___1_CM 1 100. 0. 1. DISPLAY_IDENTIFIER LV_ERR_MEM_SPI_MPS ECU_ADDRESS 0xd00099be BIT_MASK 0x8 /end MEASUREMENT
/begin MEASUREMENT fmy_stat_spi_mps.err_info_stat.lv_ready "readiness status of the diagnosis instance SPI_MPS" UWORD _CNV_S_2_RANGE__0___1_CM 1 100. 0. 1. DISPLAY_IDENTIFIER LV_READY_SPI_MPS ECU_ADDRESS 0xd00099be BIT_MASK 0x10 /end MEASUREMENT
/begin MEASUREMENT fmy_stat_spi_mps.err_info_stat.lv_end_diag "end of diagnosis of the diagnosis instance SPI_MPS" UWORD _CNV_S_2_RANGE__0___1_CM 1 100. 0. 1. DISPLAY_IDENTIFIER LV_END_DIAG_SPI_MPS ECU_ADDRESS 0xd00099be BIT_MASK 0x20 /end MEASUREMENT
/begin MEASUREMENT fmy_stat_spi_mps.err_info_stat.lv_cdn_diag "diagnosis condition of the diagnosis instance SPI_MPS" UWORD _CNV_S_2_RANGE__0___1_CM 1 100. 0. 1. DISPLAY_IDENTIFIER LV_CDN_DIAG_SPI_MPS ECU_ADDRESS 0xd00099be BIT_MASK 0x40 /end MEASUREMENT
/begin MEASUREMENT fmy_stat_spi_mps.err_info_stat.err_sym "symptoms of the diagnosis instance SPI_MPS" UWORD _CNV_S_16_RANGE_ERR__349_CM 1 100. 0. 15. DISPLAY_IDENTIFIER ERR_SYM_SPI_MPS ECU_ADDRESS 0xd00099be BIT_MASK 0x780 /end MEASUREMENT
/begin MEASUREMENT fmy_stat_spi_knk.ctr_abc "anti bounce counter for diagnosis instance SPI_KNK" UBYTE _CNV_A_R_LINEAR_____0_CM 1 100. 0. 255. DISPLAY_IDENTIFIER CTR_ABC_SPI_KNK ECU_ADDRESS 0xd00099b8 FORMAT "%3.0" /end MEASUREMENT
/begin MEASUREMENT fmy_stat_spi_knk.ctr_end_diag "counter for end of diagnosis for diagnosis instance SPI_KNK" UBYTE _CNV_A_R_LINEAR_____0_CM 1 100. 0. 255. DISPLAY_IDENTIFIER CTR_ABC_END_DIAG_SPI_KNK ECU_ADDRESS 0xd00099b9 FORMAT "%3.0" /end MEASUREMENT
/begin MEASUREMENT fmy_stat_spi_knk.err_info_stat.lv_err_mem "storage in dynamic failure memory of the diagnosis instance SPI_KNK" UWORD _CNV_S_2_RANGE__0___1_CM 1 100. 0. 1. DISPLAY_IDENTIFIER LV_ERR_MEM_SPI_KNK ECU_ADDRESS 0xd00099ba BIT_MASK 0x8 /end MEASUREMENT
/begin MEASUREMENT fmy_stat_spi_knk.err_info_stat.lv_ready "readiness status of the diagnosis instance SPI_KNK" UWORD _CNV_S_2_RANGE__0___1_CM 1 100. 0. 1. DISPLAY_IDENTIFIER LV_READY_SPI_KNK ECU_ADDRESS 0xd00099ba BIT_MASK 0x10 /end MEASUREMENT
/begin MEASUREMENT fmy_stat_spi_knk.err_info_stat.lv_end_diag "end of diagnosis of the diagnosis instance SPI_KNK" UWORD _CNV_S_2_RANGE__0___1_CM 1 100. 0. 1. DISPLAY_IDENTIFIER LV_END_DIAG_SPI_KNK ECU_ADDRESS 0xd00099ba BIT_MASK 0x20 /end MEASUREMENT
/begin MEASUREMENT fmy_stat_spi_knk.err_info_stat.lv_cdn_diag "diagnosis condition of the diagnosis instance SPI_KNK" UWORD _CNV_S_2_RANGE__0___1_CM 1 100. 0. 1. DISPLAY_IDENTIFIER LV_CDN_DIAG_SPI_KNK ECU_ADDRESS 0xd00099ba BIT_MASK 0x40 /end MEASUREMENT
/begin MEASUREMENT fmy_stat_spi_knk.err_info_stat.err_sym "symptoms of the diagnosis instance SPI_KNK" UWORD _CNV_S_16_RANGE_ERR__349_CM 1 100. 0. 15. DISPLAY_IDENTIFIER ERR_SYM_SPI_KNK ECU_ADDRESS 0xd00099ba BIT_MASK 0x780 /end MEASUREMENT
/begin MEASUREMENT fmy_stat_sens_poil.ctr_abc "anti bounce counter for diagnosis instance SENS_POIL" UBYTE _CNV_A_R_LINEAR_____0_CM 1 100. 0. 255. DISPLAY_IDENTIFIER CTR_ABC_SENS_POIL ECU_ADDRESS 0xd0009980 FORMAT "%3.0" /end MEASUREMENT
/begin MEASUREMENT fmy_stat_sens_poil.ctr_end_diag "counter for end of diagnosis for diagnosis instance SENS_POIL" UBYTE _CNV_A_R_LINEAR_____0_CM 1 100. 0. 255. DISPLAY_IDENTIFIER CTR_ABC_END_DIAG_SENS_POIL ECU_ADDRESS 0xd0009981 FORMAT "%3.0" /end MEASUREMENT
/begin MEASUREMENT fmy_stat_sens_poil.err_info_stat.lv_err_mem "storage in dynamic failure memory of the diagnosis instance SENS_POIL" UWORD _CNV_S_2_RANGE__0___1_CM 1 100. 0. 1. DISPLAY_IDENTIFIER LV_ERR_MEM_SENS_POIL ECU_ADDRESS 0xd0009982 BIT_MASK 0x8 /end MEASUREMENT
/begin MEASUREMENT fmy_stat_sens_poil.err_info_stat.lv_ready "readiness status of the diagnosis instance SENS_POIL" UWORD _CNV_S_2_RANGE__0___1_CM 1 100. 0. 1. DISPLAY_IDENTIFIER LV_READY_SENS_POIL ECU_ADDRESS 0xd0009982 BIT_MASK 0x10 /end MEASUREMENT
/begin MEASUREMENT fmy_stat_sens_poil.err_info_stat.lv_end_diag "end of diagnosis of the diagnosis instance SENS_POIL" UWORD _CNV_S_2_RANGE__0___1_CM 1 100. 0. 1. DISPLAY_IDENTIFIER LV_END_DIAG_SENS_POIL ECU_ADDRESS 0xd0009982 BIT_MASK 0x20 /end MEASUREMENT
/begin MEASUREMENT fmy_stat_sens_poil.err_info_stat.lv_cdn_diag "diagnosis condition of the diagnosis instance SENS_POIL" UWORD _CNV_S_2_RANGE__0___1_CM 1 100. 0. 1. DISPLAY_IDENTIFIER LV_CDN_DIAG_SENS_POIL ECU_ADDRESS 0xd0009982 BIT_MASK 0x40 /end MEASUREMENT
/begin MEASUREMENT fmy_stat_sens_poil.err_info_stat.err_sym "symptoms of the diagnosis instance SENS_POIL" UWORD _CNV_S_16_RANGE_ERR__349_CM 1 100. 0. 15. DISPLAY_IDENTIFIER ERR_SYM_SENS_POIL ECU_ADDRESS 0xd0009982 BIT_MASK 0x780 /end MEASUREMENT
/begin MEASUREMENT fmy_stat_poil_dr.ctr_abc "anti bounce counter for diagnosis instance POIL_DR" UBYTE _CNV_A_R_LINEAR_____0_CM 1 100. 0. 255. DISPLAY_IDENTIFIER CTR_ABC_POIL_DR ECU_ADDRESS 0xd00098e4 FORMAT "%3.0" /end MEASUREMENT
/begin MEASUREMENT fmy_stat_poil_dr.ctr_end_diag "counter for end of diagnosis for diagnosis instance POIL_DR" UBYTE _CNV_A_R_LINEAR_____0_CM 1 100. 0. 255. DISPLAY_IDENTIFIER CTR_ABC_END_DIAG_POIL_DR ECU_ADDRESS 0xd00098e5 FORMAT "%3.0" /end MEASUREMENT
/begin MEASUREMENT fmy_stat_poil_dr.err_info_stat.lv_err_mem "storage in dynamic failure memory of the diagnosis instance POIL_DR" UWORD _CNV_S_2_RANGE__0___1_CM 1 100. 0. 1. DISPLAY_IDENTIFIER LV_ERR_MEM_POIL_DR ECU_ADDRESS 0xd00098e6 BIT_MASK 0x8 /end MEASUREMENT
/begin MEASUREMENT fmy_stat_poil_dr.err_info_stat.lv_ready "readiness status of the diagnosis instance POIL_DR" UWORD _CNV_S_2_RANGE__0___1_CM 1 100. 0. 1. DISPLAY_IDENTIFIER LV_READY_POIL_DR ECU_ADDRESS 0xd00098e6 BIT_MASK 0x10 /end MEASUREMENT
/begin MEASUREMENT fmy_stat_poil_dr.err_info_stat.lv_end_diag "end of diagnosis of the diagnosis instance POIL_DR" UWORD _CNV_S_2_RANGE__0___1_CM 1 100. 0. 1. DISPLAY_IDENTIFIER LV_END_DIAG_POIL_DR ECU_ADDRESS 0xd00098e6 BIT_MASK 0x20 /end MEASUREMENT
/begin MEASUREMENT fmy_stat_poil_dr.err_info_stat.lv_cdn_diag "diagnosis condition of the diagnosis instance POIL_DR" UWORD _CNV_S_2_RANGE__0___1_CM 1 100. 0. 1. DISPLAY_IDENTIFIER LV_CDN_DIAG_POIL_DR ECU_ADDRESS 0xd00098e6 BIT_MASK 0x40 /end MEASUREMENT
/begin MEASUREMENT fmy_stat_poil_dr.err_info_stat.err_sym "symptoms of the diagnosis instance POIL_DR" UWORD _CNV_S_16_RANGE_ERR__349_CM 1 100. 0. 15. DISPLAY_IDENTIFIER ERR_SYM_POIL_DR ECU_ADDRESS 0xd00098e6 BIT_MASK 0x780 /end MEASUREMENT
/begin MEASUREMENT fmy_stat_bn_tq_dcc.ctr_abc "anti bounce counter for diagnosis instance BN_TQ_DCC" UBYTE _CNV_A_R_LINEAR_____0_CM 1 100. 0. 255. DISPLAY_IDENTIFIER CTR_ABC_BN_TQ_DCC ECU_ADDRESS 0xd000945c FORMAT "%3.0" /end MEASUREMENT
/begin MEASUREMENT fmy_stat_bn_tq_dcc.ctr_end_diag "counter for end of diagnosis for diagnosis instance BN_TQ_DCC" UBYTE _CNV_A_R_LINEAR_____0_CM 1 100. 0. 255. DISPLAY_IDENTIFIER CTR_ABC_END_DIAG_BN_TQ_DCC ECU_ADDRESS 0xd000945d FORMAT "%3.0" /end MEASUREMENT
/begin MEASUREMENT fmy_stat_bn_tq_dcc.err_info_stat.lv_err_mem "storage in dynamic failure memory of the diagnosis instance BN_TQ_DCC" UWORD _CNV_S_2_RANGE__0___1_CM 1 100. 0. 1. DISPLAY_IDENTIFIER LV_ERR_MEM_BN_TQ_DCC ECU_ADDRESS 0xd000945e BIT_MASK 0x8 /end MEASUREMENT
/begin MEASUREMENT fmy_stat_bn_tq_dcc.err_info_stat.lv_ready "readiness status of the diagnosis instance BN_TQ_DCC" UWORD _CNV_S_2_RANGE__0___1_CM 1 100. 0. 1. DISPLAY_IDENTIFIER LV_READY_BN_TQ_DCC ECU_ADDRESS 0xd000945e BIT_MASK 0x10 /end MEASUREMENT
/begin MEASUREMENT fmy_stat_bn_tq_dcc.err_info_stat.lv_end_diag "end of diagnosis of the diagnosis instance BN_TQ_DCC" UWORD _CNV_S_2_RANGE__0___1_CM 1 100. 0. 1. DISPLAY_IDENTIFIER LV_END_DIAG_BN_TQ_DCC ECU_ADDRESS 0xd000945e BIT_MASK 0x20 /end MEASUREMENT
/begin MEASUREMENT fmy_stat_bn_tq_dcc.err_info_stat.lv_cdn_diag "diagnosis condition of the diagnosis instance BN_TQ_DCC" UWORD _CNV_S_2_RANGE__0___1_CM 1 100. 0. 1. DISPLAY_IDENTIFIER LV_CDN_DIAG_BN_TQ_DCC ECU_ADDRESS 0xd000945e BIT_MASK 0x40 /end MEASUREMENT
/begin MEASUREMENT fmy_stat_bn_tq_dcc.err_info_stat.err_sym "symptoms of the diagnosis instance BN_TQ_DCC" UWORD _CNV_S_16_RANGE_ERR__349_CM 1 100. 0. 15. DISPLAY_IDENTIFIER ERR_SYM_BN_TQ_DCC ECU_ADDRESS 0xd000945e BIT_MASK 0x780 /end MEASUREMENT
/begin MEASUREMENT fmy_stat_bn_tq_pste_2.ctr_abc "anti bounce counter for diagnosis instance BN_TQ_PSTE_2" UBYTE _CNV_A_R_LINEAR_____0_CM 1 100. 0. 255. DISPLAY_IDENTIFIER CTR_ABC_BN_TQ_PSTE_2 ECU_ADDRESS 0xd0009464 FORMAT "%3.0" /end MEASUREMENT
/begin MEASUREMENT fmy_stat_bn_tq_pste_2.ctr_end_diag "counter for end of diagnosis for diagnosis instance BN_TQ_PSTE_2" UBYTE _CNV_A_R_LINEAR_____0_CM 1 100. 0. 255. DISPLAY_IDENTIFIER CTR_ABC_END_DIAG_BN_TQ_PSTE_2 ECU_ADDRESS 0xd0009465 FORMAT "%3.0" /end MEASUREMENT
/begin MEASUREMENT fmy_stat_bn_tq_pste_2.err_info_stat.lv_err_mem "storage in dynamic failure memory of the diagnosis instance BN_TQ_PSTE_2" UWORD _CNV_S_2_RANGE__0___1_CM 1 100. 0. 1. DISPLAY_IDENTIFIER LV_ERR_MEM_BN_TQ_PSTE_2 ECU_ADDRESS 0xd0009466 BIT_MASK 0x8 /end MEASUREMENT
/begin MEASUREMENT fmy_stat_bn_tq_pste_2.err_info_stat.lv_ready "readiness status of the diagnosis instance BN_TQ_PSTE_2" UWORD _CNV_S_2_RANGE__0___1_CM 1 100. 0. 1. DISPLAY_IDENTIFIER LV_READY_BN_TQ_PSTE_2 ECU_ADDRESS 0xd0009466 BIT_MASK 0x10 /end MEASUREMENT
/begin MEASUREMENT fmy_stat_bn_tq_pste_2.err_info_stat.lv_end_diag "end of diagnosis of the diagnosis instance BN_TQ_PSTE_2" UWORD _CNV_S_2_RANGE__0___1_CM 1 100. 0. 1. DISPLAY_IDENTIFIER LV_END_DIAG_BN_TQ_PSTE_2 ECU_ADDRESS 0xd0009466 BIT_MASK 0x20 /end MEASUREMENT
/begin MEASUREMENT fmy_stat_bn_tq_pste_2.err_info_stat.lv_cdn_diag "diagnosis condition of the diagnosis instance BN_TQ_PSTE_2" UWORD _CNV_S_2_RANGE__0___1_CM 1 100. 0. 1. DISPLAY_IDENTIFIER LV_CDN_DIAG_BN_TQ_PSTE_2 ECU_ADDRESS 0xd0009466 BIT_MASK 0x40 /end MEASUREMENT
/begin MEASUREMENT fmy_stat_bn_tq_pste_2.err_info_stat.err_sym "symptoms of the diagnosis instance BN_TQ_PSTE_2" UWORD _CNV_S_16_RANGE_ERR__349_CM 1 100. 0. 15. DISPLAY_IDENTIFIER ERR_SYM_BN_TQ_PSTE_2 ECU_ADDRESS 0xd0009466 BIT_MASK 0x780 /end MEASUREMENT
/begin MEASUREMENT fmy_stat_bn_tq_pste_3.ctr_abc "anti bounce counter for diagnosis instance BN_TQ_PSTE_3" UBYTE _CNV_A_R_LINEAR_____0_CM 1 100. 0. 255. DISPLAY_IDENTIFIER CTR_ABC_BN_TQ_PSTE_3 ECU_ADDRESS 0xd0009468 FORMAT "%3.0" /end MEASUREMENT
/begin MEASUREMENT fmy_stat_bn_tq_pste_3.ctr_end_diag "counter for end of diagnosis for diagnosis instance BN_TQ_PSTE_3" UBYTE _CNV_A_R_LINEAR_____0_CM 1 100. 0. 255. DISPLAY_IDENTIFIER CTR_ABC_END_DIAG_BN_TQ_PSTE_3 ECU_ADDRESS 0xd0009469 FORMAT "%3.0" /end MEASUREMENT
/begin MEASUREMENT fmy_stat_bn_tq_pste_3.err_info_stat.lv_err_mem "storage in dynamic failure memory of the diagnosis instance BN_TQ_PSTE_3" UWORD _CNV_S_2_RANGE__0___1_CM 1 100. 0. 1. DISPLAY_IDENTIFIER LV_ERR_MEM_BN_TQ_PSTE_3 ECU_ADDRESS 0xd000946a BIT_MASK 0x8 /end MEASUREMENT
/begin MEASUREMENT fmy_stat_bn_tq_pste_3.err_info_stat.lv_ready "readiness status of the diagnosis instance BN_TQ_PSTE_3" UWORD _CNV_S_2_RANGE__0___1_CM 1 100. 0. 1. DISPLAY_IDENTIFIER LV_READY_BN_TQ_PSTE_3 ECU_ADDRESS 0xd000946a BIT_MASK 0x10 /end MEASUREMENT
/begin MEASUREMENT fmy_stat_bn_tq_pste_3.err_info_stat.lv_end_diag "end of diagnosis of the diagnosis instance BN_TQ_PSTE_3" UWORD _CNV_S_2_RANGE__0___1_CM 1 100. 0. 1. DISPLAY_IDENTIFIER LV_END_DIAG_BN_TQ_PSTE_3 ECU_ADDRESS 0xd000946a BIT_MASK 0x20 /end MEASUREMENT
/begin MEASUREMENT fmy_stat_bn_tq_pste_3.err_info_stat.lv_cdn_diag "diagnosis condition of the diagnosis instance BN_TQ_PSTE_3" UWORD _CNV_S_2_RANGE__0___1_CM 1 100. 0. 1. DISPLAY_IDENTIFIER LV_CDN_DIAG_BN_TQ_PSTE_3 ECU_ADDRESS 0xd000946a BIT_MASK 0x40 /end MEASUREMENT
/begin MEASUREMENT fmy_stat_bn_tq_pste_3.err_info_stat.err_sym "symptoms of the diagnosis instance BN_TQ_PSTE_3" UWORD _CNV_S_16_RANGE_ERR__349_CM 1 100. 0. 15. DISPLAY_IDENTIFIER ERR_SYM_BN_TQ_PSTE_3 ECU_ADDRESS 0xd000946a BIT_MASK 0x780 /end MEASUREMENT
/begin MEASUREMENT fmy_stat_bn_ars.ctr_abc "anti bounce counter for diagnosis instance BN_ARS" UBYTE _CNV_A_R_LINEAR_____0_CM 1 100. 0. 255. DISPLAY_IDENTIFIER CTR_ABC_BN_ARS ECU_ADDRESS 0xd00093fc FORMAT "%3.0" /end MEASUREMENT
/begin MEASUREMENT fmy_stat_bn_ars.ctr_end_diag "counter for end of diagnosis for diagnosis instance BN_ARS" UBYTE _CNV_A_R_LINEAR_____0_CM 1 100. 0. 255. DISPLAY_IDENTIFIER CTR_ABC_END_DIAG_BN_ARS ECU_ADDRESS 0xd00093fd FORMAT "%3.0" /end MEASUREMENT
/begin MEASUREMENT fmy_stat_bn_ars.err_info_stat.lv_err_mem "storage in dynamic failure memory of the diagnosis instance BN_ARS" UWORD _CNV_S_2_RANGE__0___1_CM 1 100. 0. 1. DISPLAY_IDENTIFIER LV_ERR_MEM_BN_ARS ECU_ADDRESS 0xd00093fe BIT_MASK 0x8 /end MEASUREMENT
/begin MEASUREMENT fmy_stat_bn_ars.err_info_stat.lv_ready "readiness status of the diagnosis instance BN_ARS" UWORD _CNV_S_2_RANGE__0___1_CM 1 100. 0. 1. DISPLAY_IDENTIFIER LV_READY_BN_ARS ECU_ADDRESS 0xd00093fe BIT_MASK 0x10 /end MEASUREMENT
/begin MEASUREMENT fmy_stat_bn_ars.err_info_stat.lv_end_diag "end of diagnosis of the diagnosis instance BN_ARS" UWORD _CNV_S_2_RANGE__0___1_CM 1 100. 0. 1. DISPLAY_IDENTIFIER LV_END_DIAG_BN_ARS ECU_ADDRESS 0xd00093fe BIT_MASK 0x20 /end MEASUREMENT
/begin MEASUREMENT fmy_stat_bn_ars.err_info_stat.lv_cdn_diag "diagnosis condition of the diagnosis instance BN_ARS" UWORD _CNV_S_2_RANGE__0___1_CM 1 100. 0. 1. DISPLAY_IDENTIFIER LV_CDN_DIAG_BN_ARS ECU_ADDRESS 0xd00093fe BIT_MASK 0x40 /end MEASUREMENT
/begin MEASUREMENT fmy_stat_bn_ars.err_info_stat.err_sym "symptoms of the diagnosis instance BN_ARS" UWORD _CNV_S_16_RANGE_ERR__349_CM 1 100. 0. 15. DISPLAY_IDENTIFIER ERR_SYM_BN_ARS ECU_ADDRESS 0xd00093fe BIT_MASK 0x780 /end MEASUREMENT
/begin MEASUREMENT fmy_stat_bn_cas.ctr_abc "anti bounce counter for diagnosis instance BN_CAS" UBYTE _CNV_A_R_LINEAR_____0_CM 1 100. 0. 255. DISPLAY_IDENTIFIER CTR_ABC_BN_CAS ECU_ADDRESS 0xd0009400 FORMAT "%3.0" /end MEASUREMENT
/begin MEASUREMENT fmy_stat_bn_cas.ctr_end_diag "counter for end of diagnosis for diagnosis instance BN_CAS" UBYTE _CNV_A_R_LINEAR_____0_CM 1 100. 0. 255. DISPLAY_IDENTIFIER CTR_ABC_END_DIAG_BN_CAS ECU_ADDRESS 0xd0009401 FORMAT "%3.0" /end MEASUREMENT
/begin MEASUREMENT fmy_stat_bn_cas.err_info_stat.lv_err_mem "storage in dynamic failure memory of the diagnosis instance BN_CAS" UWORD _CNV_S_2_RANGE__0___1_CM 1 100. 0. 1. DISPLAY_IDENTIFIER LV_ERR_MEM_BN_CAS ECU_ADDRESS 0xd0009402 BIT_MASK 0x8 /end MEASUREMENT
/begin MEASUREMENT fmy_stat_bn_cas.err_info_stat.lv_ready "readiness status of the diagnosis instance BN_CAS" UWORD _CNV_S_2_RANGE__0___1_CM 1 100. 0. 1. DISPLAY_IDENTIFIER LV_READY_BN_CAS ECU_ADDRESS 0xd0009402 BIT_MASK 0x10 /end MEASUREMENT
/begin MEASUREMENT fmy_stat_bn_cas.err_info_stat.lv_end_diag "end of diagnosis of the diagnosis instance BN_CAS" UWORD _CNV_S_2_RANGE__0___1_CM 1 100. 0. 1. DISPLAY_IDENTIFIER LV_END_DIAG_BN_CAS ECU_ADDRESS 0xd0009402 BIT_MASK 0x20 /end MEASUREMENT
/begin MEASUREMENT fmy_stat_bn_cas.err_info_stat.lv_cdn_diag "diagnosis condition of the diagnosis instance BN_CAS" UWORD _CNV_S_2_RANGE__0___1_CM 1 100. 0. 1. DISPLAY_IDENTIFIER LV_CDN_DIAG_BN_CAS ECU_ADDRESS 0xd0009402 BIT_MASK 0x40 /end MEASUREMENT
/begin MEASUREMENT fmy_stat_bn_cas.err_info_stat.err_sym "symptoms of the diagnosis instance BN_CAS" UWORD _CNV_S_16_RANGE_ERR__349_CM 1 100. 0. 15. DISPLAY_IDENTIFIER ERR_SYM_BN_CAS ECU_ADDRESS 0xd0009402 BIT_MASK 0x780 /end MEASUREMENT
/begin MEASUREMENT fmy_stat_bn_tq_tcs.ctr_abc "anti bounce counter for diagnosis instance BN_TQ_TCS" UBYTE _CNV_A_R_LINEAR_____0_CM 1 100. 0. 255. DISPLAY_IDENTIFIER CTR_ABC_BN_TQ_TCS ECU_ADDRESS 0xd000946c FORMAT "%3.0" /end MEASUREMENT
/begin MEASUREMENT fmy_stat_bn_tq_tcs.ctr_end_diag "counter for end of diagnosis for diagnosis instance BN_TQ_TCS" UBYTE _CNV_A_R_LINEAR_____0_CM 1 100. 0. 255. DISPLAY_IDENTIFIER CTR_ABC_END_DIAG_BN_TQ_TCS ECU_ADDRESS 0xd000946d FORMAT "%3.0" /end MEASUREMENT
/begin MEASUREMENT fmy_stat_bn_tq_tcs.err_info_stat.lv_err_mem "storage in dynamic failure memory of the diagnosis instance BN_TQ_TCS" UWORD _CNV_S_2_RANGE__0___1_CM 1 100. 0. 1. DISPLAY_IDENTIFIER LV_ERR_MEM_BN_TQ_TCS ECU_ADDRESS 0xd000946e BIT_MASK 0x8 /end MEASUREMENT
/begin MEASUREMENT fmy_stat_bn_tq_tcs.err_info_stat.lv_ready "readiness status of the diagnosis instance BN_TQ_TCS" UWORD _CNV_S_2_RANGE__0___1_CM 1 100. 0. 1. DISPLAY_IDENTIFIER LV_READY_BN_TQ_TCS ECU_ADDRESS 0xd000946e BIT_MASK 0x10 /end MEASUREMENT
/begin MEASUREMENT fmy_stat_bn_tq_tcs.err_info_stat.lv_end_diag "end of diagnosis of the diagnosis instance BN_TQ_TCS" UWORD _CNV_S_2_RANGE__0___1_CM 1 100. 0. 1. DISPLAY_IDENTIFIER LV_END_DIAG_BN_TQ_TCS ECU_ADDRESS 0xd000946e BIT_MASK 0x20 /end MEASUREMENT
/begin MEASUREMENT fmy_stat_bn_tq_tcs.err_info_stat.lv_cdn_diag "diagnosis condition of the diagnosis instance BN_TQ_TCS" UWORD _CNV_S_2_RANGE__0___1_CM 1 100. 0. 1. DISPLAY_IDENTIFIER LV_CDN_DIAG_BN_TQ_TCS ECU_ADDRESS 0xd000946e BIT_MASK 0x40 /end MEASUREMENT
/begin MEASUREMENT fmy_stat_bn_tq_tcs.err_info_stat.err_sym "symptoms of the diagnosis instance BN_TQ_TCS" UWORD _CNV_S_16_RANGE_ERR__349_CM 1 100. 0. 15. DISPLAY_IDENTIFIER ERR_SYM_BN_TQ_TCS ECU_ADDRESS 0xd000946e BIT_MASK 0x780 /end MEASUREMENT
/begin MEASUREMENT fmy_stat_bn_vs_tcs.ctr_abc "anti bounce counter for diagnosis instance BN_VS_TCS" UBYTE _CNV_A_R_LINEAR_____0_CM 1 100. 0. 255. DISPLAY_IDENTIFIER CTR_ABC_BN_VS_TCS ECU_ADDRESS 0xd0009478 FORMAT "%3.0" /end MEASUREMENT
/begin MEASUREMENT fmy_stat_bn_vs_tcs.ctr_end_diag "counter for end of diagnosis for diagnosis instance BN_VS_TCS" UBYTE _CNV_A_R_LINEAR_____0_CM 1 100. 0. 255. DISPLAY_IDENTIFIER CTR_ABC_END_DIAG_BN_VS_TCS ECU_ADDRESS 0xd0009479 FORMAT "%3.0" /end MEASUREMENT
/begin MEASUREMENT fmy_stat_bn_vs_tcs.err_info_stat.lv_err_mem "storage in dynamic failure memory of the diagnosis instance BN_VS_TCS" UWORD _CNV_S_2_RANGE__0___1_CM 1 100. 0. 1. DISPLAY_IDENTIFIER LV_ERR_MEM_BN_VS_TCS ECU_ADDRESS 0xd000947a BIT_MASK 0x8 /end MEASUREMENT
/begin MEASUREMENT fmy_stat_bn_vs_tcs.err_info_stat.lv_ready "readiness status of the diagnosis instance BN_VS_TCS" UWORD _CNV_S_2_RANGE__0___1_CM 1 100. 0. 1. DISPLAY_IDENTIFIER LV_READY_BN_VS_TCS ECU_ADDRESS 0xd000947a BIT_MASK 0x10 /end MEASUREMENT
/begin MEASUREMENT fmy_stat_bn_vs_tcs.err_info_stat.lv_end_diag "end of diagnosis of the diagnosis instance BN_VS_TCS" UWORD _CNV_S_2_RANGE__0___1_CM 1 100. 0. 1. DISPLAY_IDENTIFIER LV_END_DIAG_BN_VS_TCS ECU_ADDRESS 0xd000947a BIT_MASK 0x20 /end MEASUREMENT
/begin MEASUREMENT fmy_stat_bn_vs_tcs.err_info_stat.lv_cdn_diag "diagnosis condition of the diagnosis instance BN_VS_TCS" UWORD _CNV_S_2_RANGE__0___1_CM 1 100. 0. 1. DISPLAY_IDENTIFIER LV_CDN_DIAG_BN_VS_TCS ECU_ADDRESS 0xd000947a BIT_MASK 0x40 /end MEASUREMENT
/begin MEASUREMENT fmy_stat_bn_vs_tcs.err_info_stat.err_sym "symptoms of the diagnosis instance BN_VS_TCS" UWORD _CNV_S_16_RANGE_ERR__349_CM 1 100. 0. 15. DISPLAY_IDENTIFIER ERR_SYM_BN_VS_TCS ECU_ADDRESS 0xd000947a BIT_MASK 0x780 /end MEASUREMENT
/begin MEASUREMENT fmy_stat_bn_tcs.ctr_abc "anti bounce counter for diagnosis instance BN_TCS" UBYTE _CNV_A_R_LINEAR_____0_CM 1 100. 0. 255. DISPLAY_IDENTIFIER CTR_ABC_BN_TCS ECU_ADDRESS 0xd0009454 FORMAT "%3.0" /end MEASUREMENT
/begin MEASUREMENT fmy_stat_bn_tcs.ctr_end_diag "counter for end of diagnosis for diagnosis instance BN_TCS" UBYTE _CNV_A_R_LINEAR_____0_CM 1 100. 0. 255. DISPLAY_IDENTIFIER CTR_ABC_END_DIAG_BN_TCS ECU_ADDRESS 0xd0009455 FORMAT "%3.0" /end MEASUREMENT
/begin MEASUREMENT fmy_stat_bn_tcs.err_info_stat.lv_err_mem "storage in dynamic failure memory of the diagnosis instance BN_TCS" UWORD _CNV_S_2_RANGE__0___1_CM 1 100. 0. 1. DISPLAY_IDENTIFIER LV_ERR_MEM_BN_TCS ECU_ADDRESS 0xd0009456 BIT_MASK 0x8 /end MEASUREMENT
/begin MEASUREMENT fmy_stat_bn_tcs.err_info_stat.lv_ready "readiness status of the diagnosis instance BN_TCS" UWORD _CNV_S_2_RANGE__0___1_CM 1 100. 0. 1. DISPLAY_IDENTIFIER LV_READY_BN_TCS ECU_ADDRESS 0xd0009456 BIT_MASK 0x10 /end MEASUREMENT
/begin MEASUREMENT fmy_stat_bn_tcs.err_info_stat.lv_end_diag "end of diagnosis of the diagnosis instance BN_TCS" UWORD _CNV_S_2_RANGE__0___1_CM 1 100. 0. 1. DISPLAY_IDENTIFIER LV_END_DIAG_BN_TCS ECU_ADDRESS 0xd0009456 BIT_MASK 0x20 /end MEASUREMENT
/begin MEASUREMENT fmy_stat_bn_tcs.err_info_stat.lv_cdn_diag "diagnosis condition of the diagnosis instance BN_TCS" UWORD _CNV_S_2_RANGE__0___1_CM 1 100. 0. 1. DISPLAY_IDENTIFIER LV_CDN_DIAG_BN_TCS ECU_ADDRESS 0xd0009456 BIT_MASK 0x40 /end MEASUREMENT
/begin MEASUREMENT fmy_stat_bn_tcs.err_info_stat.err_sym "symptoms of the diagnosis instance BN_TCS" UWORD _CNV_S_16_RANGE_ERR__349_CM 1 100. 0. 15. DISPLAY_IDENTIFIER ERR_SYM_BN_TCS ECU_ADDRESS 0xd0009456 BIT_MASK 0x780 /end MEASUREMENT
/begin MEASUREMENT fmy_stat_bn_tq_etcu.ctr_abc "anti bounce counter for diagnosis instance BN_TQ_ETCU" UBYTE _CNV_A_R_LINEAR_____0_CM 1 100. 0. 255. DISPLAY_IDENTIFIER CTR_ABC_BN_TQ_ETCU ECU_ADDRESS 0xd0009460 FORMAT "%3.0" /end MEASUREMENT
/begin MEASUREMENT fmy_stat_bn_tq_etcu.ctr_end_diag "counter for end of diagnosis for diagnosis instance BN_TQ_ETCU" UBYTE _CNV_A_R_LINEAR_____0_CM 1 100. 0. 255. DISPLAY_IDENTIFIER CTR_ABC_END_DIAG_BN_TQ_ETCU ECU_ADDRESS 0xd0009461 FORMAT "%3.0" /end MEASUREMENT
/begin MEASUREMENT fmy_stat_bn_tq_etcu.err_info_stat.lv_err_mem "storage in dynamic failure memory of the diagnosis instance BN_TQ_ETCU" UWORD _CNV_S_2_RANGE__0___1_CM 1 100. 0. 1. DISPLAY_IDENTIFIER LV_ERR_MEM_BN_TQ_ETCU ECU_ADDRESS 0xd0009462 BIT_MASK 0x8 /end MEASUREMENT
/begin MEASUREMENT fmy_stat_bn_tq_etcu.err_info_stat.lv_ready "readiness status of the diagnosis instance BN_TQ_ETCU" UWORD _CNV_S_2_RANGE__0___1_CM 1 100. 0. 1. DISPLAY_IDENTIFIER LV_READY_BN_TQ_ETCU ECU_ADDRESS 0xd0009462 BIT_MASK 0x10 /end MEASUREMENT
/begin MEASUREMENT fmy_stat_bn_tq_etcu.err_info_stat.lv_end_diag "end of diagnosis of the diagnosis instance BN_TQ_ETCU" UWORD _CNV_S_2_RANGE__0___1_CM 1 100. 0. 1. DISPLAY_IDENTIFIER LV_END_DIAG_BN_TQ_ETCU ECU_ADDRESS 0xd0009462 BIT_MASK 0x20 /end MEASUREMENT
/begin MEASUREMENT fmy_stat_bn_tq_etcu.err_info_stat.lv_cdn_diag "diagnosis condition of the diagnosis instance BN_TQ_ETCU" UWORD _CNV_S_2_RANGE__0___1_CM 1 100. 0. 1. DISPLAY_IDENTIFIER LV_CDN_DIAG_BN_TQ_ETCU ECU_ADDRESS 0xd0009462 BIT_MASK 0x40 /end MEASUREMENT
/begin MEASUREMENT fmy_stat_bn_tq_etcu.err_info_stat.err_sym "symptoms of the diagnosis instance BN_TQ_ETCU" UWORD _CNV_S_16_RANGE_ERR__349_CM 1 100. 0. 15. DISPLAY_IDENTIFIER ERR_SYM_BN_TQ_ETCU ECU_ADDRESS 0xd0009462 BIT_MASK 0x780 /end MEASUREMENT
/begin MEASUREMENT fmy_stat_bn_etcu.ctr_abc "anti bounce counter for diagnosis instance BN_ETCU" UBYTE _CNV_A_R_LINEAR_____0_CM 1 100. 0. 255. DISPLAY_IDENTIFIER CTR_ABC_BN_ETCU ECU_ADDRESS 0xd0009410 FORMAT "%3.0" /end MEASUREMENT
/begin MEASUREMENT fmy_stat_bn_etcu.ctr_end_diag "counter for end of diagnosis for diagnosis instance BN_ETCU" UBYTE _CNV_A_R_LINEAR_____0_CM 1 100. 0. 255. DISPLAY_IDENTIFIER CTR_ABC_END_DIAG_BN_ETCU ECU_ADDRESS 0xd0009411 FORMAT "%3.0" /end MEASUREMENT
/begin MEASUREMENT fmy_stat_bn_etcu.err_info_stat.lv_err_mem "storage in dynamic failure memory of the diagnosis instance BN_ETCU" UWORD _CNV_S_2_RANGE__0___1_CM 1 100. 0. 1. DISPLAY_IDENTIFIER LV_ERR_MEM_BN_ETCU ECU_ADDRESS 0xd0009412 BIT_MASK 0x8 /end MEASUREMENT
/begin MEASUREMENT fmy_stat_bn_etcu.err_info_stat.lv_ready "readiness status of the diagnosis instance BN_ETCU" UWORD _CNV_S_2_RANGE__0___1_CM 1 100. 0. 1. DISPLAY_IDENTIFIER LV_READY_BN_ETCU ECU_ADDRESS 0xd0009412 BIT_MASK 0x10 /end MEASUREMENT
/begin MEASUREMENT fmy_stat_bn_etcu.err_info_stat.lv_end_diag "end of diagnosis of the diagnosis instance BN_ETCU" UWORD _CNV_S_2_RANGE__0___1_CM 1 100. 0. 1. DISPLAY_IDENTIFIER LV_END_DIAG_BN_ETCU ECU_ADDRESS 0xd0009412 BIT_MASK 0x20 /end MEASUREMENT
/begin MEASUREMENT fmy_stat_bn_etcu.err_info_stat.lv_cdn_diag "diagnosis condition of the diagnosis instance BN_ETCU" UWORD _CNV_S_2_RANGE__0___1_CM 1 100. 0. 1. DISPLAY_IDENTIFIER LV_CDN_DIAG_BN_ETCU ECU_ADDRESS 0xd0009412 BIT_MASK 0x40 /end MEASUREMENT
/begin MEASUREMENT fmy_stat_bn_etcu.err_info_stat.err_sym "symptoms of the diagnosis instance BN_ETCU" UWORD _CNV_S_16_RANGE_ERR__349_CM 1 100. 0. 15. DISPLAY_IDENTIFIER ERR_SYM_BN_ETCU ECU_ADDRESS 0xd0009412 BIT_MASK 0x780 /end MEASUREMENT
/begin MEASUREMENT fmy_stat_bn_etcu_2.ctr_abc "anti bounce counter for diagnosis instance BN_ETCU_2" UBYTE _CNV_A_R_LINEAR_____0_CM 1 100. 0. 255. DISPLAY_IDENTIFIER CTR_ABC_BN_ETCU_2 ECU_ADDRESS 0xd0009414 FORMAT "%3.0" /end MEASUREMENT
/begin MEASUREMENT fmy_stat_bn_etcu_2.ctr_end_diag "counter for end of diagnosis for diagnosis instance BN_ETCU_2" UBYTE _CNV_A_R_LINEAR_____0_CM 1 100. 0. 255. DISPLAY_IDENTIFIER CTR_ABC_END_DIAG_BN_ETCU_2 ECU_ADDRESS 0xd0009415 FORMAT "%3.0" /end MEASUREMENT
/begin MEASUREMENT fmy_stat_bn_etcu_2.err_info_stat.lv_err_mem "storage in dynamic failure memory of the diagnosis instance BN_ETCU_2" UWORD _CNV_S_2_RANGE__0___1_CM 1 100. 0. 1. DISPLAY_IDENTIFIER LV_ERR_MEM_BN_ETCU_2 ECU_ADDRESS 0xd0009416 BIT_MASK 0x8 /end MEASUREMENT
/begin MEASUREMENT fmy_stat_bn_etcu_2.err_info_stat.lv_ready "readiness status of the diagnosis instance BN_ETCU_2" UWORD _CNV_S_2_RANGE__0___1_CM 1 100. 0. 1. DISPLAY_IDENTIFIER LV_READY_BN_ETCU_2 ECU_ADDRESS 0xd0009416 BIT_MASK 0x10 /end MEASUREMENT
/begin MEASUREMENT fmy_stat_bn_etcu_2.err_info_stat.lv_end_diag "end of diagnosis of the diagnosis instance BN_ETCU_2" UWORD _CNV_S_2_RANGE__0___1_CM 1 100. 0. 1. DISPLAY_IDENTIFIER LV_END_DIAG_BN_ETCU_2 ECU_ADDRESS 0xd0009416 BIT_MASK 0x20 /end MEASUREMENT
/begin MEASUREMENT fmy_stat_bn_etcu_2.err_info_stat.lv_cdn_diag "diagnosis condition of the diagnosis instance BN_ETCU_2" UWORD _CNV_S_2_RANGE__0___1_CM 1 100. 0. 1. DISPLAY_IDENTIFIER LV_CDN_DIAG_BN_ETCU_2 ECU_ADDRESS 0xd0009416 BIT_MASK 0x40 /end MEASUREMENT
/begin MEASUREMENT fmy_stat_bn_etcu_2.err_info_stat.err_sym "symptoms of the diagnosis instance BN_ETCU_2" UWORD _CNV_S_16_RANGE_ERR__349_CM 1 100. 0. 15. DISPLAY_IDENTIFIER ERR_SYM_BN_ETCU_2 ECU_ADDRESS 0xd0009416 BIT_MASK 0x780 /end MEASUREMENT
/begin MEASUREMENT fmy_stat_bn_etcu_3.ctr_abc "anti bounce counter for diagnosis instance BN_ETCU_3" UBYTE _CNV_A_R_LINEAR_____0_CM 1 100. 0. 255. DISPLAY_IDENTIFIER CTR_ABC_BN_ETCU_3 ECU_ADDRESS 0xd0009418 FORMAT "%3.0" /end MEASUREMENT
/begin MEASUREMENT fmy_stat_bn_etcu_3.ctr_end_diag "counter for end of diagnosis for diagnosis instance BN_ETCU_3" UBYTE _CNV_A_R_LINEAR_____0_CM 1 100. 0. 255. DISPLAY_IDENTIFIER CTR_ABC_END_DIAG_BN_ETCU_3 ECU_ADDRESS 0xd0009419 FORMAT "%3.0" /end MEASUREMENT
/begin MEASUREMENT fmy_stat_bn_etcu_3.err_info_stat.lv_err_mem "storage in dynamic failure memory of the diagnosis instance BN_ETCU_3" UWORD _CNV_S_2_RANGE__0___1_CM 1 100. 0. 1. DISPLAY_IDENTIFIER LV_ERR_MEM_BN_ETCU_3 ECU_ADDRESS 0xd000941a BIT_MASK 0x8 /end MEASUREMENT
/begin MEASUREMENT fmy_stat_bn_etcu_3.err_info_stat.lv_ready "readiness status of the diagnosis instance BN_ETCU_3" UWORD _CNV_S_2_RANGE__0___1_CM 1 100. 0. 1. DISPLAY_IDENTIFIER LV_READY_BN_ETCU_3 ECU_ADDRESS 0xd000941a BIT_MASK 0x10 /end MEASUREMENT
/begin MEASUREMENT fmy_stat_bn_etcu_3.err_info_stat.lv_end_diag "end of diagnosis of the diagnosis instance BN_ETCU_3" UWORD _CNV_S_2_RANGE__0___1_CM 1 100. 0. 1. DISPLAY_IDENTIFIER LV_END_DIAG_BN_ETCU_3 ECU_ADDRESS 0xd000941a BIT_MASK 0x20 /end MEASUREMENT
/begin MEASUREMENT fmy_stat_bn_etcu_3.err_info_stat.lv_cdn_diag "diagnosis condition of the diagnosis instance BN_ETCU_3" UWORD _CNV_S_2_RANGE__0___1_CM 1 100. 0. 1. DISPLAY_IDENTIFIER LV_CDN_DIAG_BN_ETCU_3 ECU_ADDRESS 0xd000941a BIT_MASK 0x40 /end MEASUREMENT
/begin MEASUREMENT fmy_stat_bn_etcu_3.err_info_stat.err_sym "symptoms of the diagnosis instance BN_ETCU_3" UWORD _CNV_S_16_RANGE_ERR__349_CM 1 100. 0. 15. DISPLAY_IDENTIFIER ERR_SYM_BN_ETCU_3 ECU_ADDRESS 0xd000941a BIT_MASK 0x780 /end MEASUREMENT
/begin MEASUREMENT fmy_stat_bn_etcu_disp.ctr_abc "anti bounce counter for diagnosis instance BN_ETCU_DISP" UBYTE _CNV_A_R_LINEAR_____0_CM 1 100. 0. 255. DISPLAY_IDENTIFIER CTR_ABC_BN_ETCU_DISP ECU_ADDRESS 0xd000941c FORMAT "%3.0" /end MEASUREMENT
/begin MEASUREMENT fmy_stat_bn_etcu_disp.ctr_end_diag "counter for end of diagnosis for diagnosis instance BN_ETCU_DISP" UBYTE _CNV_A_R_LINEAR_____0_CM 1 100. 0. 255. DISPLAY_IDENTIFIER CTR_ABC_END_DIAG_BN_ETCU_DISP ECU_ADDRESS 0xd000941d FORMAT "%3.0" /end MEASUREMENT
/begin MEASUREMENT fmy_stat_bn_etcu_disp.err_info_stat.lv_err_mem "storage in dynamic failure memory of the diagnosis instance BN_ETCU_DISP" UWORD _CNV_S_2_RANGE__0___1_CM 1 100. 0. 1. DISPLAY_IDENTIFIER LV_ERR_MEM_BN_ETCU_DISP ECU_ADDRESS 0xd000941e BIT_MASK 0x8 /end MEASUREMENT
/begin MEASUREMENT fmy_stat_bn_etcu_disp.err_info_stat.lv_ready "readiness status of the diagnosis instance BN_ETCU_DISP" UWORD _CNV_S_2_RANGE__0___1_CM 1 100. 0. 1. DISPLAY_IDENTIFIER LV_READY_BN_ETCU_DISP ECU_ADDRESS 0xd000941e BIT_MASK 0x10 /end MEASUREMENT
/begin MEASUREMENT fmy_stat_bn_etcu_disp.err_info_stat.lv_end_diag "end of diagnosis of the diagnosis instance BN_ETCU_DISP" UWORD _CNV_S_2_RANGE__0___1_CM 1 100. 0. 1. DISPLAY_IDENTIFIER LV_END_DIAG_BN_ETCU_DISP ECU_ADDRESS 0xd000941e BIT_MASK 0x20 /end MEASUREMENT
/begin MEASUREMENT fmy_stat_bn_etcu_disp.err_info_stat.lv_cdn_diag "diagnosis condition of the diagnosis instance BN_ETCU_DISP" UWORD _CNV_S_2_RANGE__0___1_CM 1 100. 0. 1. DISPLAY_IDENTIFIER LV_CDN_DIAG_BN_ETCU_DISP ECU_ADDRESS 0xd000941e BIT_MASK 0x40 /end MEASUREMENT
/begin MEASUREMENT fmy_stat_bn_etcu_disp.err_info_stat.err_sym "symptoms of the diagnosis instance BN_ETCU_DISP" UWORD _CNV_S_16_RANGE_ERR__349_CM 1 100. 0. 15. DISPLAY_IDENTIFIER ERR_SYM_BN_ETCU_DISP ECU_ADDRESS 0xd000941e BIT_MASK 0x780 /end MEASUREMENT
/begin MEASUREMENT fmy_stat_bn_tq_amt.ctr_abc "anti bounce counter for diagnosis instance BN_TQ_AMT" UBYTE _CNV_A_R_LINEAR_____0_CM 1 100. 0. 255. DISPLAY_IDENTIFIER CTR_ABC_BN_TQ_AMT ECU_ADDRESS 0xd0009458 FORMAT "%3.0" /end MEASUREMENT
/begin MEASUREMENT fmy_stat_bn_tq_amt.ctr_end_diag "counter for end of diagnosis for diagnosis instance BN_TQ_AMT" UBYTE _CNV_A_R_LINEAR_____0_CM 1 100. 0. 255. DISPLAY_IDENTIFIER CTR_ABC_END_DIAG_BN_TQ_AMT ECU_ADDRESS 0xd0009459 FORMAT "%3.0" /end MEASUREMENT
/begin MEASUREMENT fmy_stat_bn_tq_amt.err_info_stat.lv_err_mem "storage in dynamic failure memory of the diagnosis instance BN_TQ_AMT" UWORD _CNV_S_2_RANGE__0___1_CM 1 100. 0. 1. DISPLAY_IDENTIFIER LV_ERR_MEM_BN_TQ_AMT ECU_ADDRESS 0xd000945a BIT_MASK 0x8 /end MEASUREMENT
/begin MEASUREMENT fmy_stat_bn_tq_amt.err_info_stat.lv_ready "readiness status of the diagnosis instance BN_TQ_AMT" UWORD _CNV_S_2_RANGE__0___1_CM 1 100. 0. 1. DISPLAY_IDENTIFIER LV_READY_BN_TQ_AMT ECU_ADDRESS 0xd000945a BIT_MASK 0x10 /end MEASUREMENT
/begin MEASUREMENT fmy_stat_bn_tq_amt.err_info_stat.lv_end_diag "end of diagnosis of the diagnosis instance BN_TQ_AMT" UWORD _CNV_S_2_RANGE__0___1_CM 1 100. 0. 1. DISPLAY_IDENTIFIER LV_END_DIAG_BN_TQ_AMT ECU_ADDRESS 0xd000945a BIT_MASK 0x20 /end MEASUREMENT
/begin MEASUREMENT fmy_stat_bn_tq_amt.err_info_stat.lv_cdn_diag "diagnosis condition of the diagnosis instance BN_TQ_AMT" UWORD _CNV_S_2_RANGE__0___1_CM 1 100. 0. 1. DISPLAY_IDENTIFIER LV_CDN_DIAG_BN_TQ_AMT ECU_ADDRESS 0xd000945a BIT_MASK 0x40 /end MEASUREMENT
/begin MEASUREMENT fmy_stat_bn_tq_amt.err_info_stat.err_sym "symptoms of the diagnosis instance BN_TQ_AMT" UWORD _CNV_S_16_RANGE_ERR__349_CM 1 100. 0. 15. DISPLAY_IDENTIFIER ERR_SYM_BN_TQ_AMT ECU_ADDRESS 0xd000945a BIT_MASK 0x780 /end MEASUREMENT
/begin MEASUREMENT fmy_stat_bn_acc.ctr_abc "anti bounce counter for diagnosis instance BN_ACC" UBYTE _CNV_A_R_LINEAR_____0_CM 1 100. 0. 255. DISPLAY_IDENTIFIER CTR_ABC_BN_ACC ECU_ADDRESS 0xd00093f4 FORMAT "%3.0" /end MEASUREMENT
/begin MEASUREMENT fmy_stat_bn_acc.ctr_end_diag "counter for end of diagnosis for diagnosis instance BN_ACC" UBYTE _CNV_A_R_LINEAR_____0_CM 1 100. 0. 255. DISPLAY_IDENTIFIER CTR_ABC_END_DIAG_BN_ACC ECU_ADDRESS 0xd00093f5 FORMAT "%3.0" /end MEASUREMENT
/begin MEASUREMENT fmy_stat_bn_acc.err_info_stat.lv_err_mem "storage in dynamic failure memory of the diagnosis instance BN_ACC" UWORD _CNV_S_2_RANGE__0___1_CM 1 100. 0. 1. DISPLAY_IDENTIFIER LV_ERR_MEM_BN_ACC ECU_ADDRESS 0xd00093f6 BIT_MASK 0x8 /end MEASUREMENT
/begin MEASUREMENT fmy_stat_bn_acc.err_info_stat.lv_ready "readiness status of the diagnosis instance BN_ACC" UWORD _CNV_S_2_RANGE__0___1_CM 1 100. 0. 1. DISPLAY_IDENTIFIER LV_READY_BN_ACC ECU_ADDRESS 0xd00093f6 BIT_MASK 0x10 /end MEASUREMENT
/begin MEASUREMENT fmy_stat_bn_acc.err_info_stat.lv_end_diag "end of diagnosis of the diagnosis instance BN_ACC" UWORD _CNV_S_2_RANGE__0___1_CM 1 100. 0. 1. DISPLAY_IDENTIFIER LV_END_DIAG_BN_ACC ECU_ADDRESS 0xd00093f6 BIT_MASK 0x20 /end MEASUREMENT
/begin MEASUREMENT fmy_stat_bn_acc.err_info_stat.lv_cdn_diag "diagnosis condition of the diagnosis instance BN_ACC" UWORD _CNV_S_2_RANGE__0___1_CM 1 100. 0. 1. DISPLAY_IDENTIFIER LV_CDN_DIAG_BN_ACC ECU_ADDRESS 0xd00093f6 BIT_MASK 0x40 /end MEASUREMENT
/begin MEASUREMENT fmy_stat_bn_acc.err_info_stat.err_sym "symptoms of the diagnosis instance BN_ACC" UWORD _CNV_S_16_RANGE_ERR__349_CM 1 100. 0. 15. DISPLAY_IDENTIFIER ERR_SYM_BN_ACC ECU_ADDRESS 0xd00093f6 BIT_MASK 0x780 /end MEASUREMENT
/begin MEASUREMENT fmy_stat_bn_t_icl.ctr_abc "anti bounce counter for diagnosis instance BN_T_ICL" UBYTE _CNV_A_R_LINEAR_____0_CM 1 100. 0. 255. DISPLAY_IDENTIFIER CTR_ABC_BN_T_ICL ECU_ADDRESS 0xd0009450 FORMAT "%3.0" /end MEASUREMENT
/begin MEASUREMENT fmy_stat_bn_t_icl.ctr_end_diag "counter for end of diagnosis for diagnosis instance BN_T_ICL" UBYTE _CNV_A_R_LINEAR_____0_CM 1 100. 0. 255. DISPLAY_IDENTIFIER CTR_ABC_END_DIAG_BN_T_ICL ECU_ADDRESS 0xd0009451 FORMAT "%3.0" /end MEASUREMENT
/begin MEASUREMENT fmy_stat_bn_t_icl.err_info_stat.lv_err_mem "storage in dynamic failure memory of the diagnosis instance BN_T_ICL" UWORD _CNV_S_2_RANGE__0___1_CM 1 100. 0. 1. DISPLAY_IDENTIFIER LV_ERR_MEM_BN_T_ICL ECU_ADDRESS 0xd0009452 BIT_MASK 0x8 /end MEASUREMENT
/begin MEASUREMENT fmy_stat_bn_t_icl.err_info_stat.lv_ready "readiness status of the diagnosis instance BN_T_ICL" UWORD _CNV_S_2_RANGE__0___1_CM 1 100. 0. 1. DISPLAY_IDENTIFIER LV_READY_BN_T_ICL ECU_ADDRESS 0xd0009452 BIT_MASK 0x10 /end MEASUREMENT
/begin MEASUREMENT fmy_stat_bn_t_icl.err_info_stat.lv_end_diag "end of diagnosis of the diagnosis instance BN_T_ICL" UWORD _CNV_S_2_RANGE__0___1_CM 1 100. 0. 1. DISPLAY_IDENTIFIER LV_END_DIAG_BN_T_ICL ECU_ADDRESS 0xd0009452 BIT_MASK 0x20 /end MEASUREMENT
/begin MEASUREMENT fmy_stat_bn_t_icl.err_info_stat.lv_cdn_diag "diagnosis condition of the diagnosis instance BN_T_ICL" UWORD _CNV_S_2_RANGE__0___1_CM 1 100. 0. 1. DISPLAY_IDENTIFIER LV_CDN_DIAG_BN_T_ICL ECU_ADDRESS 0xd0009452 BIT_MASK 0x40 /end MEASUREMENT
/begin MEASUREMENT fmy_stat_bn_t_icl.err_info_stat.err_sym "symptoms of the diagnosis instance BN_T_ICL" UWORD _CNV_S_16_RANGE_ERR__349_CM 1 100. 0. 15. DISPLAY_IDENTIFIER ERR_SYM_BN_T_ICL ECU_ADDRESS 0xd0009452 BIT_MASK 0x780 /end MEASUREMENT
/begin MEASUREMENT fmy_stat_bn_veh_mod.ctr_abc "anti bounce counter for diagnosis instance BN_VEH_MOD" UBYTE _CNV_A_R_LINEAR_____0_CM 1 100. 0. 255. DISPLAY_IDENTIFIER CTR_ABC_BN_VEH_MOD ECU_ADDRESS 0xd0009474 FORMAT "%3.0" /end MEASUREMENT
/begin MEASUREMENT fmy_stat_bn_veh_mod.ctr_end_diag "counter for end of diagnosis for diagnosis instance BN_VEH_MOD" UBYTE _CNV_A_R_LINEAR_____0_CM 1 100. 0. 255. DISPLAY_IDENTIFIER CTR_ABC_END_DIAG_BN_VEH_MOD ECU_ADDRESS 0xd0009475 FORMAT "%3.0" /end MEASUREMENT
/begin MEASUREMENT fmy_stat_bn_veh_mod.err_info_stat.lv_err_mem "storage in dynamic failure memory of the diagnosis instance BN_VEH_MOD" UWORD _CNV_S_2_RANGE__0___1_CM 1 100. 0. 1. DISPLAY_IDENTIFIER LV_ERR_MEM_BN_VEH_MOD ECU_ADDRESS 0xd0009476 BIT_MASK 0x8 /end MEASUREMENT
/begin MEASUREMENT fmy_stat_bn_veh_mod.err_info_stat.lv_ready "readiness status of the diagnosis instance BN_VEH_MOD" UWORD _CNV_S_2_RANGE__0___1_CM 1 100. 0. 1. DISPLAY_IDENTIFIER LV_READY_BN_VEH_MOD ECU_ADDRESS 0xd0009476 BIT_MASK 0x10 /end MEASUREMENT
/begin MEASUREMENT fmy_stat_bn_veh_mod.err_info_stat.lv_end_diag "end of diagnosis of the diagnosis instance BN_VEH_MOD" UWORD _CNV_S_2_RANGE__0___1_CM 1 100. 0. 1. DISPLAY_IDENTIFIER LV_END_DIAG_BN_VEH_MOD ECU_ADDRESS 0xd0009476 BIT_MASK 0x20 /end MEASUREMENT
/begin MEASUREMENT fmy_stat_bn_veh_mod.err_info_stat.lv_cdn_diag "diagnosis condition of the diagnosis instance BN_VEH_MOD" UWORD _CNV_S_2_RANGE__0___1_CM 1 100. 0. 1. DISPLAY_IDENTIFIER LV_CDN_DIAG_BN_VEH_MOD ECU_ADDRESS 0xd0009476 BIT_MASK 0x40 /end MEASUREMENT
/begin MEASUREMENT fmy_stat_bn_veh_mod.err_info_stat.err_sym "symptoms of the diagnosis instance BN_VEH_MOD" UWORD _CNV_S_16_RANGE_ERR__349_CM 1 100. 0. 15. DISPLAY_IDENTIFIER ERR_SYM_BN_VEH_MOD ECU_ADDRESS 0xd0009476 BIT_MASK 0x780 /end MEASUREMENT
/begin MEASUREMENT fmy_stat_bn_km_icl.ctr_abc "anti bounce counter for diagnosis instance BN_KM_ICL" UBYTE _CNV_A_R_LINEAR_____0_CM 1 100. 0. 255. DISPLAY_IDENTIFIER CTR_ABC_BN_KM_ICL ECU_ADDRESS 0xd000942c FORMAT "%3.0" /end MEASUREMENT
/begin MEASUREMENT fmy_stat_bn_km_icl.ctr_end_diag "counter for end of diagnosis for diagnosis instance BN_KM_ICL" UBYTE _CNV_A_R_LINEAR_____0_CM 1 100. 0. 255. DISPLAY_IDENTIFIER CTR_ABC_END_DIAG_BN_KM_ICL ECU_ADDRESS 0xd000942d FORMAT "%3.0" /end MEASUREMENT
/begin MEASUREMENT fmy_stat_bn_km_icl.err_info_stat.lv_err_mem "storage in dynamic failure memory of the diagnosis instance BN_KM_ICL" UWORD _CNV_S_2_RANGE__0___1_CM 1 100. 0. 1. DISPLAY_IDENTIFIER LV_ERR_MEM_BN_KM_ICL ECU_ADDRESS 0xd000942e BIT_MASK 0x8 /end MEASUREMENT
/begin MEASUREMENT fmy_stat_bn_km_icl.err_info_stat.lv_ready "readiness status of the diagnosis instance BN_KM_ICL" UWORD _CNV_S_2_RANGE__0___1_CM 1 100. 0. 1. DISPLAY_IDENTIFIER LV_READY_BN_KM_ICL ECU_ADDRESS 0xd000942e BIT_MASK 0x10 /end MEASUREMENT
/begin MEASUREMENT fmy_stat_bn_km_icl.err_info_stat.lv_end_diag "end of diagnosis of the diagnosis instance BN_KM_ICL" UWORD _CNV_S_2_RANGE__0___1_CM 1 100. 0. 1. DISPLAY_IDENTIFIER LV_END_DIAG_BN_KM_ICL ECU_ADDRESS 0xd000942e BIT_MASK 0x20 /end MEASUREMENT
/begin MEASUREMENT fmy_stat_bn_km_icl.err_info_stat.lv_cdn_diag "diagnosis condition of the diagnosis instance BN_KM_ICL" UWORD _CNV_S_2_RANGE__0___1_CM 1 100. 0. 1. DISPLAY_IDENTIFIER LV_CDN_DIAG_BN_KM_ICL ECU_ADDRESS 0xd000942e BIT_MASK 0x40 /end MEASUREMENT
/begin MEASUREMENT fmy_stat_bn_km_icl.err_info_stat.err_sym "symptoms of the diagnosis instance BN_KM_ICL" UWORD _CNV_S_16_RANGE_ERR__349_CM 1 100. 0. 15. DISPLAY_IDENTIFIER ERR_SYM_BN_KM_ICL ECU_ADDRESS 0xd000942e BIT_MASK 0x780 /end MEASUREMENT
/begin MEASUREMENT fmy_stat_bn_icl.ctr_abc "anti bounce counter for diagnosis instance BN_ICL" UBYTE _CNV_A_R_LINEAR_____0_CM 1 100. 0. 255. DISPLAY_IDENTIFIER CTR_ABC_BN_ICL ECU_ADDRESS 0xd0009428 FORMAT "%3.0" /end MEASUREMENT
/begin MEASUREMENT fmy_stat_bn_icl.ctr_end_diag "counter for end of diagnosis for diagnosis instance BN_ICL" UBYTE _CNV_A_R_LINEAR_____0_CM 1 100. 0. 255. DISPLAY_IDENTIFIER CTR_ABC_END_DIAG_BN_ICL ECU_ADDRESS 0xd0009429 FORMAT "%3.0" /end MEASUREMENT
/begin MEASUREMENT fmy_stat_bn_icl.err_info_stat.lv_err_mem "storage in dynamic failure memory of the diagnosis instance BN_ICL" UWORD _CNV_S_2_RANGE__0___1_CM 1 100. 0. 1. DISPLAY_IDENTIFIER LV_ERR_MEM_BN_ICL ECU_ADDRESS 0xd000942a BIT_MASK 0x8 /end MEASUREMENT
/begin MEASUREMENT fmy_stat_bn_icl.err_info_stat.lv_ready "readiness status of the diagnosis instance BN_ICL" UWORD _CNV_S_2_RANGE__0___1_CM 1 100. 0. 1. DISPLAY_IDENTIFIER LV_READY_BN_ICL ECU_ADDRESS 0xd000942a BIT_MASK 0x10 /end MEASUREMENT
/begin MEASUREMENT fmy_stat_bn_icl.err_info_stat.lv_end_diag "end of diagnosis of the diagnosis instance BN_ICL" UWORD _CNV_S_2_RANGE__0___1_CM 1 100. 0. 1. DISPLAY_IDENTIFIER LV_END_DIAG_BN_ICL ECU_ADDRESS 0xd000942a BIT_MASK 0x20 /end MEASUREMENT
/begin MEASUREMENT fmy_stat_bn_icl.err_info_stat.lv_cdn_diag "diagnosis condition of the diagnosis instance BN_ICL" UWORD _CNV_S_2_RANGE__0___1_CM 1 100. 0. 1. DISPLAY_IDENTIFIER LV_CDN_DIAG_BN_ICL ECU_ADDRESS 0xd000942a BIT_MASK 0x40 /end MEASUREMENT
/begin MEASUREMENT fmy_stat_bn_icl.err_info_stat.err_sym "symptoms of the diagnosis instance BN_ICL" UWORD _CNV_S_16_RANGE_ERR__349_CM 1 100. 0. 15. DISPLAY_IDENTIFIER ERR_SYM_BN_ICL ECU_ADDRESS 0xd000942a BIT_MASK 0x780 /end MEASUREMENT
/begin MEASUREMENT fmy_stat_bn_pow_vb.ctr_abc "anti bounce counter for diagnosis instance BN_POW_VB" UBYTE _CNV_A_R_LINEAR_____0_CM 1 100. 0. 255. DISPLAY_IDENTIFIER CTR_ABC_BN_POW_VB ECU_ADDRESS 0xd0009444 FORMAT "%3.0" /end MEASUREMENT
/begin MEASUREMENT fmy_stat_bn_pow_vb.ctr_end_diag "counter for end of diagnosis for diagnosis instance BN_POW_VB" UBYTE _CNV_A_R_LINEAR_____0_CM 1 100. 0. 255. DISPLAY_IDENTIFIER CTR_ABC_END_DIAG_BN_POW_VB ECU_ADDRESS 0xd0009445 FORMAT "%3.0" /end MEASUREMENT
/begin MEASUREMENT fmy_stat_bn_pow_vb.err_info_stat.lv_err_mem "storage in dynamic failure memory of the diagnosis instance BN_POW_VB" UWORD _CNV_S_2_RANGE__0___1_CM 1 100. 0. 1. DISPLAY_IDENTIFIER LV_ERR_MEM_BN_POW_VB ECU_ADDRESS 0xd0009446 BIT_MASK 0x8 /end MEASUREMENT
/begin MEASUREMENT fmy_stat_bn_pow_vb.err_info_stat.lv_ready "readiness status of the diagnosis instance BN_POW_VB" UWORD _CNV_S_2_RANGE__0___1_CM 1 100. 0. 1. DISPLAY_IDENTIFIER LV_READY_BN_POW_VB ECU_ADDRESS 0xd0009446 BIT_MASK 0x10 /end MEASUREMENT
/begin MEASUREMENT fmy_stat_bn_pow_vb.err_info_stat.lv_end_diag "end of diagnosis of the diagnosis instance BN_POW_VB" UWORD _CNV_S_2_RANGE__0___1_CM 1 100. 0. 1. DISPLAY_IDENTIFIER LV_END_DIAG_BN_POW_VB ECU_ADDRESS 0xd0009446 BIT_MASK 0x20 /end MEASUREMENT
/begin MEASUREMENT fmy_stat_bn_pow_vb.err_info_stat.lv_cdn_diag "diagnosis condition of the diagnosis instance BN_POW_VB" UWORD _CNV_S_2_RANGE__0___1_CM 1 100. 0. 1. DISPLAY_IDENTIFIER LV_CDN_DIAG_BN_POW_VB ECU_ADDRESS 0xd0009446 BIT_MASK 0x40 /end MEASUREMENT
/begin MEASUREMENT fmy_stat_bn_pow_vb.err_info_stat.err_sym "symptoms of the diagnosis instance BN_POW_VB" UWORD _CNV_S_16_RANGE_ERR__349_CM 1 100. 0. 15. DISPLAY_IDENTIFIER ERR_SYM_BN_POW_VB ECU_ADDRESS 0xd0009446 BIT_MASK 0x780 /end MEASUREMENT
/begin MEASUREMENT fmy_stat_bn_pow_gen.ctr_abc "anti bounce counter for diagnosis instance BN_POW_GEN" UBYTE _CNV_A_R_LINEAR_____0_CM 1 100. 0. 255. DISPLAY_IDENTIFIER CTR_ABC_BN_POW_GEN ECU_ADDRESS 0xd0009440 FORMAT "%3.0" /end MEASUREMENT
/begin MEASUREMENT fmy_stat_bn_pow_gen.ctr_end_diag "counter for end of diagnosis for diagnosis instance BN_POW_GEN" UBYTE _CNV_A_R_LINEAR_____0_CM 1 100. 0. 255. DISPLAY_IDENTIFIER CTR_ABC_END_DIAG_BN_POW_GEN ECU_ADDRESS 0xd0009441 FORMAT "%3.0" /end MEASUREMENT
/begin MEASUREMENT fmy_stat_bn_pow_gen.err_info_stat.lv_err_mem "storage in dynamic failure memory of the diagnosis instance BN_POW_GEN" UWORD _CNV_S_2_RANGE__0___1_CM 1 100. 0. 1. DISPLAY_IDENTIFIER LV_ERR_MEM_BN_POW_GEN ECU_ADDRESS 0xd0009442 BIT_MASK 0x8 /end MEASUREMENT
/begin MEASUREMENT fmy_stat_bn_pow_gen.err_info_stat.lv_ready "readiness status of the diagnosis instance BN_POW_GEN" UWORD _CNV_S_2_RANGE__0___1_CM 1 100. 0. 1. DISPLAY_IDENTIFIER LV_READY_BN_POW_GEN ECU_ADDRESS 0xd0009442 BIT_MASK 0x10 /end MEASUREMENT
/begin MEASUREMENT fmy_stat_bn_pow_gen.err_info_stat.lv_end_diag "end of diagnosis of the diagnosis instance BN_POW_GEN" UWORD _CNV_S_2_RANGE__0___1_CM 1 100. 0. 1. DISPLAY_IDENTIFIER LV_END_DIAG_BN_POW_GEN ECU_ADDRESS 0xd0009442 BIT_MASK 0x20 /end MEASUREMENT
/begin MEASUREMENT fmy_stat_bn_pow_gen.err_info_stat.lv_cdn_diag "diagnosis condition of the diagnosis instance BN_POW_GEN" UWORD _CNV_S_2_RANGE__0___1_CM 1 100. 0. 1. DISPLAY_IDENTIFIER LV_CDN_DIAG_BN_POW_GEN ECU_ADDRESS 0xd0009442 BIT_MASK 0x40 /end MEASUREMENT
/begin MEASUREMENT fmy_stat_bn_pow_gen.err_info_stat.err_sym "symptoms of the diagnosis instance BN_POW_GEN" UWORD _CNV_S_16_RANGE_ERR__349_CM 1 100. 0. 15. DISPLAY_IDENTIFIER ERR_SYM_BN_POW_GEN ECU_ADDRESS 0xd0009442 BIT_MASK 0x780 /end MEASUREMENT
/begin MEASUREMENT fmy_stat_bn_msw.ctr_abc "anti bounce counter for diagnosis instance BN_MSW" UBYTE _CNV_A_R_LINEAR_____0_CM 1 100. 0. 255. DISPLAY_IDENTIFIER CTR_ABC_BN_MSW ECU_ADDRESS 0xd0009438 FORMAT "%3.0" /end MEASUREMENT
/begin MEASUREMENT fmy_stat_bn_msw.ctr_end_diag "counter for end of diagnosis for diagnosis instance BN_MSW" UBYTE _CNV_A_R_LINEAR_____0_CM 1 100. 0. 255. DISPLAY_IDENTIFIER CTR_ABC_END_DIAG_BN_MSW ECU_ADDRESS 0xd0009439 FORMAT "%3.0" /end MEASUREMENT
/begin MEASUREMENT fmy_stat_bn_msw.err_info_stat.lv_err_mem "storage in dynamic failure memory of the diagnosis instance BN_MSW" UWORD _CNV_S_2_RANGE__0___1_CM 1 100. 0. 1. DISPLAY_IDENTIFIER LV_ERR_MEM_BN_MSW ECU_ADDRESS 0xd000943a BIT_MASK 0x8 /end MEASUREMENT
/begin MEASUREMENT fmy_stat_bn_msw.err_info_stat.lv_ready "readiness status of the diagnosis instance BN_MSW" UWORD _CNV_S_2_RANGE__0___1_CM 1 100. 0. 1. DISPLAY_IDENTIFIER LV_READY_BN_MSW ECU_ADDRESS 0xd000943a BIT_MASK 0x10 /end MEASUREMENT
/begin MEASUREMENT fmy_stat_bn_msw.err_info_stat.lv_end_diag "end of diagnosis of the diagnosis instance BN_MSW" UWORD _CNV_S_2_RANGE__0___1_CM 1 100. 0. 1. DISPLAY_IDENTIFIER LV_END_DIAG_BN_MSW ECU_ADDRESS 0xd000943a BIT_MASK 0x20 /end MEASUREMENT
/begin MEASUREMENT fmy_stat_bn_msw.err_info_stat.lv_cdn_diag "diagnosis condition of the diagnosis instance BN_MSW" UWORD _CNV_S_2_RANGE__0___1_CM 1 100. 0. 1. DISPLAY_IDENTIFIER LV_CDN_DIAG_BN_MSW ECU_ADDRESS 0xd000943a BIT_MASK 0x40 /end MEASUREMENT
/begin MEASUREMENT fmy_stat_bn_msw.err_info_stat.err_sym "symptoms of the diagnosis instance BN_MSW" UWORD _CNV_S_16_RANGE_ERR__349_CM 1 100. 0. 15. DISPLAY_IDENTIFIER ERR_SYM_BN_MSW ECU_ADDRESS 0xd000943a BIT_MASK 0x780 /end MEASUREMENT
/begin MEASUREMENT fmy_stat_bn_ang_pste.ctr_abc "anti bounce counter for diagnosis instance BN_ANG_PSTE" UBYTE _CNV_A_R_LINEAR_____0_CM 1 100. 0. 255. DISPLAY_IDENTIFIER CTR_ABC_BN_ANG_PSTE ECU_ADDRESS 0xd00093f8 FORMAT "%3.0" /end MEASUREMENT
/begin MEASUREMENT fmy_stat_bn_ang_pste.ctr_end_diag "counter for end of diagnosis for diagnosis instance BN_ANG_PSTE" UBYTE _CNV_A_R_LINEAR_____0_CM 1 100. 0. 255. DISPLAY_IDENTIFIER CTR_ABC_END_DIAG_BN_ANG_PSTE ECU_ADDRESS 0xd00093f9 FORMAT "%3.0" /end MEASUREMENT
/begin MEASUREMENT fmy_stat_bn_ang_pste.err_info_stat.lv_err_mem "storage in dynamic failure memory of the diagnosis instance BN_ANG_PSTE" UWORD _CNV_S_2_RANGE__0___1_CM 1 100. 0. 1. DISPLAY_IDENTIFIER LV_ERR_MEM_BN_ANG_PSTE ECU_ADDRESS 0xd00093fa BIT_MASK 0x8 /end MEASUREMENT
/begin MEASUREMENT fmy_stat_bn_ang_pste.err_info_stat.lv_ready "readiness status of the diagnosis instance BN_ANG_PSTE" UWORD _CNV_S_2_RANGE__0___1_CM 1 100. 0. 1. DISPLAY_IDENTIFIER LV_READY_BN_ANG_PSTE ECU_ADDRESS 0xd00093fa BIT_MASK 0x10 /end MEASUREMENT
/begin MEASUREMENT fmy_stat_bn_ang_pste.err_info_stat.lv_end_diag "end of diagnosis of the diagnosis instance BN_ANG_PSTE" UWORD _CNV_S_2_RANGE__0___1_CM 1 100. 0. 1. DISPLAY_IDENTIFIER LV_END_DIAG_BN_ANG_PSTE ECU_ADDRESS 0xd00093fa BIT_MASK 0x20 /end MEASUREMENT
/begin MEASUREMENT fmy_stat_bn_ang_pste.err_info_stat.lv_cdn_diag "diagnosis condition of the diagnosis instance BN_ANG_PSTE" UWORD _CNV_S_2_RANGE__0___1_CM 1 100. 0. 1. DISPLAY_IDENTIFIER LV_CDN_DIAG_BN_ANG_PSTE ECU_ADDRESS 0xd00093fa BIT_MASK 0x40 /end MEASUREMENT
/begin MEASUREMENT fmy_stat_bn_ang_pste.err_info_stat.err_sym "symptoms of the diagnosis instance BN_ANG_PSTE" UWORD _CNV_S_16_RANGE_ERR__349_CM 1 100. 0. 15. DISPLAY_IDENTIFIER ERR_SYM_BN_ANG_PSTE ECU_ADDRESS 0xd00093fa BIT_MASK 0x780 /end MEASUREMENT
/begin MEASUREMENT fmy_stat_bn_gear_rev.ctr_abc "anti bounce counter for diagnosis instance BN_GEAR_REV" UBYTE _CNV_A_R_LINEAR_____0_CM 1 100. 0. 255. DISPLAY_IDENTIFIER CTR_ABC_BN_GEAR_REV ECU_ADDRESS 0xd0009420 FORMAT "%3.0" /end MEASUREMENT
/begin MEASUREMENT fmy_stat_bn_gear_rev.ctr_end_diag "counter for end of diagnosis for diagnosis instance BN_GEAR_REV" UBYTE _CNV_A_R_LINEAR_____0_CM 1 100. 0. 255. DISPLAY_IDENTIFIER CTR_ABC_END_DIAG_BN_GEAR_REV ECU_ADDRESS 0xd0009421 FORMAT "%3.0" /end MEASUREMENT
/begin MEASUREMENT fmy_stat_bn_gear_rev.err_info_stat.lv_err_mem "storage in dynamic failure memory of the diagnosis instance BN_GEAR_REV" UWORD _CNV_S_2_RANGE__0___1_CM 1 100. 0. 1. DISPLAY_IDENTIFIER LV_ERR_MEM_BN_GEAR_REV ECU_ADDRESS 0xd0009422 BIT_MASK 0x8 /end MEASUREMENT
/begin MEASUREMENT fmy_stat_bn_gear_rev.err_info_stat.lv_ready "readiness status of the diagnosis instance BN_GEAR_REV" UWORD _CNV_S_2_RANGE__0___1_CM 1 100. 0. 1. DISPLAY_IDENTIFIER LV_READY_BN_GEAR_REV ECU_ADDRESS 0xd0009422 BIT_MASK 0x10 /end MEASUREMENT
/begin MEASUREMENT fmy_stat_bn_gear_rev.err_info_stat.lv_end_diag "end of diagnosis of the diagnosis instance BN_GEAR_REV" UWORD _CNV_S_2_RANGE__0___1_CM 1 100. 0. 1. DISPLAY_IDENTIFIER LV_END_DIAG_BN_GEAR_REV ECU_ADDRESS 0xd0009422 BIT_MASK 0x20 /end MEASUREMENT
/begin MEASUREMENT fmy_stat_bn_gear_rev.err_info_stat.lv_cdn_diag "diagnosis condition of the diagnosis instance BN_GEAR_REV" UWORD _CNV_S_2_RANGE__0___1_CM 1 100. 0. 1. DISPLAY_IDENTIFIER LV_CDN_DIAG_BN_GEAR_REV ECU_ADDRESS 0xd0009422 BIT_MASK 0x40 /end MEASUREMENT
/begin MEASUREMENT fmy_stat_bn_gear_rev.err_info_stat.err_sym "symptoms of the diagnosis instance BN_GEAR_REV" UWORD _CNV_S_16_RANGE_ERR__349_CM 1 100. 0. 15. DISPLAY_IDENTIFIER ERR_SYM_BN_GEAR_REV ECU_ADDRESS 0xd0009422 BIT_MASK 0x780 /end MEASUREMENT
/begin MEASUREMENT fmy_stat_bn_ltg_hdlp_l.ctr_abc "anti bounce counter for diagnosis instance BN_LTG_HDLP_L" UBYTE _CNV_A_R_LINEAR_____0_CM 1 100. 0. 255. DISPLAY_IDENTIFIER CTR_ABC_BN_LTG_HDLP_L ECU_ADDRESS 0xd0009434 FORMAT "%3.0" /end MEASUREMENT
/begin MEASUREMENT fmy_stat_bn_ltg_hdlp_l.ctr_end_diag "counter for end of diagnosis for diagnosis instance BN_LTG_HDLP_L" UBYTE _CNV_A_R_LINEAR_____0_CM 1 100. 0. 255. DISPLAY_IDENTIFIER CTR_ABC_END_DIAG_BN_LTG_HDLP_L ECU_ADDRESS 0xd0009435 FORMAT "%3.0" /end MEASUREMENT
/begin MEASUREMENT fmy_stat_bn_ltg_hdlp_l.err_info_stat.lv_err_mem "storage in dynamic failure memory of the diagnosis instance BN_LTG_HDLP_L" UWORD _CNV_S_2_RANGE__0___1_CM 1 100. 0. 1. DISPLAY_IDENTIFIER LV_ERR_MEM_BN_LTG_HDLP_L ECU_ADDRESS 0xd0009436 BIT_MASK 0x8 /end MEASUREMENT
/begin MEASUREMENT fmy_stat_bn_ltg_hdlp_l.err_info_stat.lv_ready "readiness status of the diagnosis instance BN_LTG_HDLP_L" UWORD _CNV_S_2_RANGE__0___1_CM 1 100. 0. 1. DISPLAY_IDENTIFIER LV_READY_BN_LTG_HDLP_L ECU_ADDRESS 0xd0009436 BIT_MASK 0x10 /end MEASUREMENT
/begin MEASUREMENT fmy_stat_bn_ltg_hdlp_l.err_info_stat.lv_end_diag "end of diagnosis of the diagnosis instance BN_LTG_HDLP_L" UWORD _CNV_S_2_RANGE__0___1_CM 1 100. 0. 1. DISPLAY_IDENTIFIER LV_END_DIAG_BN_LTG_HDLP_L ECU_ADDRESS 0xd0009436 BIT_MASK 0x20 /end MEASUREMENT
/begin MEASUREMENT fmy_stat_bn_ltg_hdlp_l.err_info_stat.lv_cdn_diag "diagnosis condition of the diagnosis instance BN_LTG_HDLP_L" UWORD _CNV_S_2_RANGE__0___1_CM 1 100. 0. 1. DISPLAY_IDENTIFIER LV_CDN_DIAG_BN_LTG_HDLP_L ECU_ADDRESS 0xd0009436 BIT_MASK 0x40 /end MEASUREMENT
/begin MEASUREMENT fmy_stat_bn_ltg_hdlp_l.err_info_stat.err_sym "symptoms of the diagnosis instance BN_LTG_HDLP_L" UWORD _CNV_S_16_RANGE_ERR__349_CM 1 100. 0. 15. DISPLAY_IDENTIFIER ERR_SYM_BN_LTG_HDLP_L ECU_ADDRESS 0xd0009436 BIT_MASK 0x780 /end MEASUREMENT
/begin MEASUREMENT fmy_stat_bn_ldm.ctr_abc "anti bounce counter for diagnosis instance BN_LDM" UBYTE _CNV_A_R_LINEAR_____0_CM 1 100. 0. 255. DISPLAY_IDENTIFIER CTR_ABC_BN_LDM ECU_ADDRESS 0xd0009430 FORMAT "%3.0" /end MEASUREMENT
/begin MEASUREMENT fmy_stat_bn_ldm.ctr_end_diag "counter for end of diagnosis for diagnosis instance BN_LDM" UBYTE _CNV_A_R_LINEAR_____0_CM 1 100. 0. 255. DISPLAY_IDENTIFIER CTR_ABC_END_DIAG_BN_LDM ECU_ADDRESS 0xd0009431 FORMAT "%3.0" /end MEASUREMENT
/begin MEASUREMENT fmy_stat_bn_ldm.err_info_stat.lv_err_mem "storage in dynamic failure memory of the diagnosis instance BN_LDM" UWORD _CNV_S_2_RANGE__0___1_CM 1 100. 0. 1. DISPLAY_IDENTIFIER LV_ERR_MEM_BN_LDM ECU_ADDRESS 0xd0009432 BIT_MASK 0x8 /end MEASUREMENT
/begin MEASUREMENT fmy_stat_bn_ldm.err_info_stat.lv_ready "readiness status of the diagnosis instance BN_LDM" UWORD _CNV_S_2_RANGE__0___1_CM 1 100. 0. 1. DISPLAY_IDENTIFIER LV_READY_BN_LDM ECU_ADDRESS 0xd0009432 BIT_MASK 0x10 /end MEASUREMENT
/begin MEASUREMENT fmy_stat_bn_ldm.err_info_stat.lv_end_diag "end of diagnosis of the diagnosis instance BN_LDM" UWORD _CNV_S_2_RANGE__0___1_CM 1 100. 0. 1. DISPLAY_IDENTIFIER LV_END_DIAG_BN_LDM ECU_ADDRESS 0xd0009432 BIT_MASK 0x20 /end MEASUREMENT
/begin MEASUREMENT fmy_stat_bn_ldm.err_info_stat.lv_cdn_diag "diagnosis condition of the diagnosis instance BN_LDM" UWORD _CNV_S_2_RANGE__0___1_CM 1 100. 0. 1. DISPLAY_IDENTIFIER LV_CDN_DIAG_BN_LDM ECU_ADDRESS 0xd0009432 BIT_MASK 0x40 /end MEASUREMENT
/begin MEASUREMENT fmy_stat_bn_ldm.err_info_stat.err_sym "symptoms of the diagnosis instance BN_LDM" UWORD _CNV_S_16_RANGE_ERR__349_CM 1 100. 0. 15. DISPLAY_IDENTIFIER ERR_SYM_BN_LDM ECU_ADDRESS 0xd0009432 BIT_MASK 0x780 /end MEASUREMENT
/begin MEASUREMENT fmy_stat_bn_trl.ctr_abc "anti bounce counter for diagnosis instance BN_TRL" UBYTE _CNV_A_R_LINEAR_____0_CM 1 100. 0. 255. DISPLAY_IDENTIFIER CTR_ABC_BN_TRL ECU_ADDRESS 0xd0009470 FORMAT "%3.0" /end MEASUREMENT
/begin MEASUREMENT fmy_stat_bn_trl.ctr_end_diag "counter for end of diagnosis for diagnosis instance BN_TRL" UBYTE _CNV_A_R_LINEAR_____0_CM 1 100. 0. 255. DISPLAY_IDENTIFIER CTR_ABC_END_DIAG_BN_TRL ECU_ADDRESS 0xd0009471 FORMAT "%3.0" /end MEASUREMENT
/begin MEASUREMENT fmy_stat_bn_trl.err_info_stat.lv_err_mem "storage in dynamic failure memory of the diagnosis instance BN_TRL" UWORD _CNV_S_2_RANGE__0___1_CM 1 100. 0. 1. DISPLAY_IDENTIFIER LV_ERR_MEM_BN_TRL ECU_ADDRESS 0xd0009472 BIT_MASK 0x8 /end MEASUREMENT
/begin MEASUREMENT fmy_stat_bn_trl.err_info_stat.lv_ready "readiness status of the diagnosis instance BN_TRL" UWORD _CNV_S_2_RANGE__0___1_CM 1 100. 0. 1. DISPLAY_IDENTIFIER LV_READY_BN_TRL ECU_ADDRESS 0xd0009472 BIT_MASK 0x10 /end MEASUREMENT
/begin MEASUREMENT fmy_stat_bn_trl.err_info_stat.lv_end_diag "end of diagnosis of the diagnosis instance BN_TRL" UWORD _CNV_S_2_RANGE__0___1_CM 1 100. 0. 1. DISPLAY_IDENTIFIER LV_END_DIAG_BN_TRL ECU_ADDRESS 0xd0009472 BIT_MASK 0x20 /end MEASUREMENT
/begin MEASUREMENT fmy_stat_bn_trl.err_info_stat.lv_cdn_diag "diagnosis condition of the diagnosis instance BN_TRL" UWORD _CNV_S_2_RANGE__0___1_CM 1 100. 0. 1. DISPLAY_IDENTIFIER LV_CDN_DIAG_BN_TRL ECU_ADDRESS 0xd0009472 BIT_MASK 0x40 /end MEASUREMENT
/begin MEASUREMENT fmy_stat_bn_trl.err_info_stat.err_sym "symptoms of the diagnosis instance BN_TRL" UWORD _CNV_S_16_RANGE_ERR__349_CM 1 100. 0. 15. DISPLAY_IDENTIFIER ERR_SYM_BN_TRL ECU_ADDRESS 0xd0009472 BIT_MASK 0x780 /end MEASUREMENT
/begin MEASUREMENT fmy_stat_bn_hiv.ctr_abc "anti bounce counter for diagnosis instance BN_HIV" UBYTE _CNV_A_R_LINEAR_____0_CM 1 100. 0. 255. DISPLAY_IDENTIFIER CTR_ABC_BN_HIV ECU_ADDRESS 0xd0009424 FORMAT "%3.0" /end MEASUREMENT
/begin MEASUREMENT fmy_stat_bn_hiv.ctr_end_diag "counter for end of diagnosis for diagnosis instance BN_HIV" UBYTE _CNV_A_R_LINEAR_____0_CM 1 100. 0. 255. DISPLAY_IDENTIFIER CTR_ABC_END_DIAG_BN_HIV ECU_ADDRESS 0xd0009425 FORMAT "%3.0" /end MEASUREMENT
/begin MEASUREMENT fmy_stat_bn_hiv.err_info_stat.lv_err_mem "storage in dynamic failure memory of the diagnosis instance BN_HIV" UWORD _CNV_S_2_RANGE__0___1_CM 1 100. 0. 1. DISPLAY_IDENTIFIER LV_ERR_MEM_BN_HIV ECU_ADDRESS 0xd0009426 BIT_MASK 0x8 /end MEASUREMENT
/begin MEASUREMENT fmy_stat_bn_hiv.err_info_stat.lv_ready "readiness status of the diagnosis instance BN_HIV" UWORD _CNV_S_2_RANGE__0___1_CM 1 100. 0. 1. DISPLAY_IDENTIFIER LV_READY_BN_HIV ECU_ADDRESS 0xd0009426 BIT_MASK 0x10 /end MEASUREMENT
/begin MEASUREMENT fmy_stat_bn_hiv.err_info_stat.lv_end_diag "end of diagnosis of the diagnosis instance BN_HIV" UWORD _CNV_S_2_RANGE__0___1_CM 1 100. 0. 1. DISPLAY_IDENTIFIER LV_END_DIAG_BN_HIV ECU_ADDRESS 0xd0009426 BIT_MASK 0x20 /end MEASUREMENT
/begin MEASUREMENT fmy_stat_bn_hiv.err_info_stat.lv_cdn_diag "diagnosis condition of the diagnosis instance BN_HIV" UWORD _CNV_S_2_RANGE__0___1_CM 1 100. 0. 1. DISPLAY_IDENTIFIER LV_CDN_DIAG_BN_HIV ECU_ADDRESS 0xd0009426 BIT_MASK 0x40 /end MEASUREMENT
/begin MEASUREMENT fmy_stat_bn_hiv.err_info_stat.err_sym "symptoms of the diagnosis instance BN_HIV" UWORD _CNV_S_16_RANGE_ERR__349_CM 1 100. 0. 15. DISPLAY_IDENTIFIER ERR_SYM_BN_HIV ECU_ADDRESS 0xd0009426 BIT_MASK 0x780 /end MEASUREMENT
/begin MEASUREMENT fmy_stat_bn_t_clk.ctr_abc "anti bounce counter for diagnosis instance BN_T_CLK" UBYTE _CNV_A_R_LINEAR_____0_CM 1 100. 0. 255. DISPLAY_IDENTIFIER CTR_ABC_BN_T_CLK ECU_ADDRESS 0xd000944c FORMAT "%3.0" /end MEASUREMENT
/begin MEASUREMENT fmy_stat_bn_t_clk.ctr_end_diag "counter for end of diagnosis for diagnosis instance BN_T_CLK" UBYTE _CNV_A_R_LINEAR_____0_CM 1 100. 0. 255. DISPLAY_IDENTIFIER CTR_ABC_END_DIAG_BN_T_CLK ECU_ADDRESS 0xd000944d FORMAT "%3.0" /end MEASUREMENT
/begin MEASUREMENT fmy_stat_bn_t_clk.err_info_stat.lv_err_mem "storage in dynamic failure memory of the diagnosis instance BN_T_CLK" UWORD _CNV_S_2_RANGE__0___1_CM 1 100. 0. 1. DISPLAY_IDENTIFIER LV_ERR_MEM_BN_T_CLK ECU_ADDRESS 0xd000944e BIT_MASK 0x8 /end MEASUREMENT
/begin MEASUREMENT fmy_stat_bn_t_clk.err_info_stat.lv_ready "readiness status of the diagnosis instance BN_T_CLK" UWORD _CNV_S_2_RANGE__0___1_CM 1 100. 0. 1. DISPLAY_IDENTIFIER LV_READY_BN_T_CLK ECU_ADDRESS 0xd000944e BIT_MASK 0x10 /end MEASUREMENT
/begin MEASUREMENT fmy_stat_bn_t_clk.err_info_stat.lv_end_diag "end of diagnosis of the diagnosis instance BN_T_CLK" UWORD _CNV_S_2_RANGE__0___1_CM 1 100. 0. 1. DISPLAY_IDENTIFIER LV_END_DIAG_BN_T_CLK ECU_ADDRESS 0xd000944e BIT_MASK 0x20 /end MEASUREMENT
/begin MEASUREMENT fmy_stat_bn_t_clk.err_info_stat.lv_cdn_diag "diagnosis condition of the diagnosis instance BN_T_CLK" UWORD _CNV_S_2_RANGE__0___1_CM 1 100. 0. 1. DISPLAY_IDENTIFIER LV_CDN_DIAG_BN_T_CLK ECU_ADDRESS 0xd000944e BIT_MASK 0x40 /end MEASUREMENT
/begin MEASUREMENT fmy_stat_bn_t_clk.err_info_stat.err_sym "symptoms of the diagnosis instance BN_T_CLK" UWORD _CNV_S_16_RANGE_ERR__349_CM 1 100. 0. 15. DISPLAY_IDENTIFIER ERR_SYM_BN_T_CLK ECU_ADDRESS 0xd000944e BIT_MASK 0x780 /end MEASUREMENT
/begin MEASUREMENT fmy_stat_bn_efp_crash.ctr_abc "anti bounce counter for diagnosis instance BN_EFP_CRASH" UBYTE _CNV_A_R_LINEAR_____0_CM 1 100. 0. 255. DISPLAY_IDENTIFIER CTR_ABC_BN_EFP_CRASH ECU_ADDRESS 0xd000940c FORMAT "%3.0" /end MEASUREMENT
/begin MEASUREMENT fmy_stat_bn_efp_crash.ctr_end_diag "counter for end of diagnosis for diagnosis instance BN_EFP_CRASH" UBYTE _CNV_A_R_LINEAR_____0_CM 1 100. 0. 255. DISPLAY_IDENTIFIER CTR_ABC_END_DIAG_BN_EFP_CRASH ECU_ADDRESS 0xd000940d FORMAT "%3.0" /end MEASUREMENT
/begin MEASUREMENT fmy_stat_bn_efp_crash.err_info_stat.lv_err_mem "storage in dynamic failure memory of the diagnosis instance BN_EFP_CRASH" UWORD _CNV_S_2_RANGE__0___1_CM 1 100. 0. 1. DISPLAY_IDENTIFIER LV_ERR_MEM_BN_EFP_CRASH ECU_ADDRESS 0xd000940e BIT_MASK 0x8 /end MEASUREMENT
/begin MEASUREMENT fmy_stat_bn_efp_crash.err_info_stat.lv_ready "readiness status of the diagnosis instance BN_EFP_CRASH" UWORD _CNV_S_2_RANGE__0___1_CM 1 100. 0. 1. DISPLAY_IDENTIFIER LV_READY_BN_EFP_CRASH ECU_ADDRESS 0xd000940e BIT_MASK 0x10 /end MEASUREMENT
/begin MEASUREMENT fmy_stat_bn_efp_crash.err_info_stat.lv_end_diag "end of diagnosis of the diagnosis instance BN_EFP_CRASH" UWORD _CNV_S_2_RANGE__0___1_CM 1 100. 0. 1. DISPLAY_IDENTIFIER LV_END_DIAG_BN_EFP_CRASH ECU_ADDRESS 0xd000940e BIT_MASK 0x20 /end MEASUREMENT
/begin MEASUREMENT fmy_stat_bn_efp_crash.err_info_stat.lv_cdn_diag "diagnosis condition of the diagnosis instance BN_EFP_CRASH" UWORD _CNV_S_2_RANGE__0___1_CM 1 100. 0. 1. DISPLAY_IDENTIFIER LV_CDN_DIAG_BN_EFP_CRASH ECU_ADDRESS 0xd000940e BIT_MASK 0x40 /end MEASUREMENT
/begin MEASUREMENT fmy_stat_bn_efp_crash.err_info_stat.err_sym "symptoms of the diagnosis instance BN_EFP_CRASH" UWORD _CNV_S_16_RANGE_ERR__349_CM 1 100. 0. 15. DISPLAY_IDENTIFIER ERR_SYM_BN_EFP_CRASH ECU_ADDRESS 0xd000940e BIT_MASK 0x780 /end MEASUREMENT
/begin MEASUREMENT fmy_stat_bn_cdn_door.ctr_abc "anti bounce counter for diagnosis instance BN_CDN_DOOR" UBYTE _CNV_A_R_LINEAR_____0_CM 1 100. 0. 255. DISPLAY_IDENTIFIER CTR_ABC_BN_CDN_DOOR ECU_ADDRESS 0xd0009404 FORMAT "%3.0" /end MEASUREMENT
/begin MEASUREMENT fmy_stat_bn_cdn_door.ctr_end_diag "counter for end of diagnosis for diagnosis instance BN_CDN_DOOR" UBYTE _CNV_A_R_LINEAR_____0_CM 1 100. 0. 255. DISPLAY_IDENTIFIER CTR_ABC_END_DIAG_BN_CDN_DOOR ECU_ADDRESS 0xd0009405 FORMAT "%3.0" /end MEASUREMENT
/begin MEASUREMENT fmy_stat_bn_cdn_door.err_info_stat.lv_err_mem "storage in dynamic failure memory of the diagnosis instance BN_CDN_DOOR" UWORD _CNV_S_2_RANGE__0___1_CM 1 100. 0. 1. DISPLAY_IDENTIFIER LV_ERR_MEM_BN_CDN_DOOR ECU_ADDRESS 0xd0009406 BIT_MASK 0x8 /end MEASUREMENT
/begin MEASUREMENT fmy_stat_bn_cdn_door.err_info_stat.lv_ready "readiness status of the diagnosis instance BN_CDN_DOOR" UWORD _CNV_S_2_RANGE__0___1_CM 1 100. 0. 1. DISPLAY_IDENTIFIER LV_READY_BN_CDN_DOOR ECU_ADDRESS 0xd0009406 BIT_MASK 0x10 /end MEASUREMENT
/begin MEASUREMENT fmy_stat_bn_cdn_door.err_info_stat.lv_end_diag "end of diagnosis of the diagnosis instance BN_CDN_DOOR" UWORD _CNV_S_2_RANGE__0___1_CM 1 100. 0. 1. DISPLAY_IDENTIFIER LV_END_DIAG_BN_CDN_DOOR ECU_ADDRESS 0xd0009406 BIT_MASK 0x20 /end MEASUREMENT
/begin MEASUREMENT fmy_stat_bn_cdn_door.err_info_stat.lv_cdn_diag "diagnosis condition of the diagnosis instance BN_CDN_DOOR" UWORD _CNV_S_2_RANGE__0___1_CM 1 100. 0. 1. DISPLAY_IDENTIFIER LV_CDN_DIAG_BN_CDN_DOOR ECU_ADDRESS 0xd0009406 BIT_MASK 0x40 /end MEASUREMENT
/begin MEASUREMENT fmy_stat_bn_cdn_door.err_info_stat.err_sym "symptoms of the diagnosis instance BN_CDN_DOOR" UWORD _CNV_S_16_RANGE_ERR__349_CM 1 100. 0. 15. DISPLAY_IDENTIFIER ERR_SYM_BN_CDN_DOOR ECU_ADDRESS 0xd0009406 BIT_MASK 0x780 /end MEASUREMENT
/begin MEASUREMENT fmy_stat_bn_req_pbr.ctr_abc "anti bounce counter for diagnosis instance BN_REQ_PBR" UBYTE _CNV_A_R_LINEAR_____0_CM 1 100. 0. 255. DISPLAY_IDENTIFIER CTR_ABC_BN_REQ_PBR ECU_ADDRESS 0xd0009448 FORMAT "%3.0" /end MEASUREMENT
/begin MEASUREMENT fmy_stat_bn_req_pbr.ctr_end_diag "counter for end of diagnosis for diagnosis instance BN_REQ_PBR" UBYTE _CNV_A_R_LINEAR_____0_CM 1 100. 0. 255. DISPLAY_IDENTIFIER CTR_ABC_END_DIAG_BN_REQ_PBR ECU_ADDRESS 0xd0009449 FORMAT "%3.0" /end MEASUREMENT
/begin MEASUREMENT fmy_stat_bn_req_pbr.err_info_stat.lv_err_mem "storage in dynamic failure memory of the diagnosis instance BN_REQ_PBR" UWORD _CNV_S_2_RANGE__0___1_CM 1 100. 0. 1. DISPLAY_IDENTIFIER LV_ERR_MEM_BN_REQ_PBR ECU_ADDRESS 0xd000944a BIT_MASK 0x8 /end MEASUREMENT
/begin MEASUREMENT fmy_stat_bn_req_pbr.err_info_stat.lv_ready "readiness status of the diagnosis instance BN_REQ_PBR" UWORD _CNV_S_2_RANGE__0___1_CM 1 100. 0. 1. DISPLAY_IDENTIFIER LV_READY_BN_REQ_PBR ECU_ADDRESS 0xd000944a BIT_MASK 0x10 /end MEASUREMENT
/begin MEASUREMENT fmy_stat_bn_req_pbr.err_info_stat.lv_end_diag "end of diagnosis of the diagnosis instance BN_REQ_PBR" UWORD _CNV_S_2_RANGE__0___1_CM 1 100. 0. 1. DISPLAY_IDENTIFIER LV_END_DIAG_BN_REQ_PBR ECU_ADDRESS 0xd000944a BIT_MASK 0x20 /end MEASUREMENT
/begin MEASUREMENT fmy_stat_bn_req_pbr.err_info_stat.lv_cdn_diag "diagnosis condition of the diagnosis instance BN_REQ_PBR" UWORD _CNV_S_2_RANGE__0___1_CM 1 100. 0. 1. DISPLAY_IDENTIFIER LV_CDN_DIAG_BN_REQ_PBR ECU_ADDRESS 0xd000944a BIT_MASK 0x40 /end MEASUREMENT
/begin MEASUREMENT fmy_stat_bn_req_pbr.err_info_stat.err_sym "symptoms of the diagnosis instance BN_REQ_PBR" UWORD _CNV_S_16_RANGE_ERR__349_CM 1 100. 0. 15. DISPLAY_IDENTIFIER ERR_SYM_BN_REQ_PBR ECU_ADDRESS 0xd000944a BIT_MASK 0x780 /end MEASUREMENT
/begin MEASUREMENT fmy_stat_bn_pbr.ctr_abc "anti bounce counter for diagnosis instance BN_PBR" UBYTE _CNV_A_R_LINEAR_____0_CM 1 100. 0. 255. DISPLAY_IDENTIFIER CTR_ABC_BN_PBR ECU_ADDRESS 0xd000943c FORMAT "%3.0" /end MEASUREMENT
/begin MEASUREMENT fmy_stat_bn_pbr.ctr_end_diag "counter for end of diagnosis for diagnosis instance BN_PBR" UBYTE _CNV_A_R_LINEAR_____0_CM 1 100. 0. 255. DISPLAY_IDENTIFIER CTR_ABC_END_DIAG_BN_PBR ECU_ADDRESS 0xd000943d FORMAT "%3.0" /end MEASUREMENT
/begin MEASUREMENT fmy_stat_bn_pbr.err_info_stat.lv_err_mem "storage in dynamic failure memory of the diagnosis instance BN_PBR" UWORD _CNV_S_2_RANGE__0___1_CM 1 100. 0. 1. DISPLAY_IDENTIFIER LV_ERR_MEM_BN_PBR ECU_ADDRESS 0xd000943e BIT_MASK 0x8 /end MEASUREMENT
/begin MEASUREMENT fmy_stat_bn_pbr.err_info_stat.lv_ready "readiness status of the diagnosis instance BN_PBR" UWORD _CNV_S_2_RANGE__0___1_CM 1 100. 0. 1. DISPLAY_IDENTIFIER LV_READY_BN_PBR ECU_ADDRESS 0xd000943e BIT_MASK 0x10 /end MEASUREMENT
/begin MEASUREMENT fmy_stat_bn_pbr.err_info_stat.lv_end_diag "end of diagnosis of the diagnosis instance BN_PBR" UWORD _CNV_S_2_RANGE__0___1_CM 1 100. 0. 1. DISPLAY_IDENTIFIER LV_END_DIAG_BN_PBR ECU_ADDRESS 0xd000943e BIT_MASK 0x20 /end MEASUREMENT
/begin MEASUREMENT fmy_stat_bn_pbr.err_info_stat.lv_cdn_diag "diagnosis condition of the diagnosis instance BN_PBR" UWORD _CNV_S_2_RANGE__0___1_CM 1 100. 0. 1. DISPLAY_IDENTIFIER LV_CDN_DIAG_BN_PBR ECU_ADDRESS 0xd000943e BIT_MASK 0x40 /end MEASUREMENT
/begin MEASUREMENT fmy_stat_bn_pbr.err_info_stat.err_sym "symptoms of the diagnosis instance BN_PBR" UWORD _CNV_S_16_RANGE_ERR__349_CM 1 100. 0. 15. DISPLAY_IDENTIFIER ERR_SYM_BN_PBR ECU_ADDRESS 0xd000943e BIT_MASK 0x780 /end MEASUREMENT
/begin MEASUREMENT fmy_stat_bn_efp.ctr_abc "anti bounce counter for diagnosis instance BN_EFP" UBYTE _CNV_A_R_LINEAR_____0_CM 1 100. 0. 255. DISPLAY_IDENTIFIER CTR_ABC_BN_EFP ECU_ADDRESS 0xd0009408 FORMAT "%3.0" /end MEASUREMENT
/begin MEASUREMENT fmy_stat_bn_efp.ctr_end_diag "counter for end of diagnosis for diagnosis instance BN_EFP" UBYTE _CNV_A_R_LINEAR_____0_CM 1 100. 0. 255. DISPLAY_IDENTIFIER CTR_ABC_END_DIAG_BN_EFP ECU_ADDRESS 0xd0009409 FORMAT "%3.0" /end MEASUREMENT
/begin MEASUREMENT fmy_stat_bn_efp.err_info_stat.lv_err_mem "storage in dynamic failure memory of the diagnosis instance BN_EFP" UWORD _CNV_S_2_RANGE__0___1_CM 1 100. 0. 1. DISPLAY_IDENTIFIER LV_ERR_MEM_BN_EFP ECU_ADDRESS 0xd000940a BIT_MASK 0x8 /end MEASUREMENT
/begin MEASUREMENT fmy_stat_bn_efp.err_info_stat.lv_ready "readiness status of the diagnosis instance BN_EFP" UWORD _CNV_S_2_RANGE__0___1_CM 1 100. 0. 1. DISPLAY_IDENTIFIER LV_READY_BN_EFP ECU_ADDRESS 0xd000940a BIT_MASK 0x10 /end MEASUREMENT
/begin MEASUREMENT fmy_stat_bn_efp.err_info_stat.lv_end_diag "end of diagnosis of the diagnosis instance BN_EFP" UWORD _CNV_S_2_RANGE__0___1_CM 1 100. 0. 1. DISPLAY_IDENTIFIER LV_END_DIAG_BN_EFP ECU_ADDRESS 0xd000940a BIT_MASK 0x20 /end MEASUREMENT
/begin MEASUREMENT fmy_stat_bn_efp.err_info_stat.lv_cdn_diag "diagnosis condition of the diagnosis instance BN_EFP" UWORD _CNV_S_2_RANGE__0___1_CM 1 100. 0. 1. DISPLAY_IDENTIFIER LV_CDN_DIAG_BN_EFP ECU_ADDRESS 0xd000940a BIT_MASK 0x40 /end MEASUREMENT
/begin MEASUREMENT fmy_stat_bn_efp.err_info_stat.err_sym "symptoms of the diagnosis instance BN_EFP" UWORD _CNV_S_16_RANGE_ERR__349_CM 1 100. 0. 15. DISPLAY_IDENTIFIER ERR_SYM_BN_EFP ECU_ADDRESS 0xd000940a BIT_MASK 0x780 /end MEASUREMENT
/begin MEASUREMENT fmy_stat_load_tps_plaus.ctr_abc "anti bounce counter for diagnosis instance LOAD_TPS_PLAUS" UBYTE _CNV_A_R_LINEAR_____0_CM 1 100. 0. 255. DISPLAY_IDENTIFIER CTR_ABC_LOAD_TPS_PLAUS ECU_ADDRESS 0xd00097c4 FORMAT "%3.0" /end MEASUREMENT
/begin MEASUREMENT fmy_stat_load_tps_plaus.ctr_end_diag "counter for end of diagnosis for diagnosis instance LOAD_TPS_PLAUS" UBYTE _CNV_A_R_LINEAR_____0_CM 1 100. 0. 255. DISPLAY_IDENTIFIER CTR_ABC_END_DIAG_LOAD_TPS_PLAUS ECU_ADDRESS 0xd00097c5 FORMAT "%3.0" /end MEASUREMENT
/begin MEASUREMENT fmy_stat_load_tps_plaus.err_info_stat.lv_err_mem "storage in dynamic failure memory of the diagnosis instance LOAD_TPS_PLAUS" UWORD _CNV_S_2_RANGE__0___1_CM 1 100. 0. 1. DISPLAY_IDENTIFIER LV_ERR_MEM_LOAD_TPS_PLAUS ECU_ADDRESS 0xd00097c6 BIT_MASK 0x8 /end MEASUREMENT
/begin MEASUREMENT fmy_stat_load_tps_plaus.err_info_stat.lv_ready "readiness status of the diagnosis instance LOAD_TPS_PLAUS" UWORD _CNV_S_2_RANGE__0___1_CM 1 100. 0. 1. DISPLAY_IDENTIFIER LV_READY_LOAD_TPS_PLAUS ECU_ADDRESS 0xd00097c6 BIT_MASK 0x10 /end MEASUREMENT
/begin MEASUREMENT fmy_stat_load_tps_plaus.err_info_stat.lv_end_diag "end of diagnosis of the diagnosis instance LOAD_TPS_PLAUS" UWORD _CNV_S_2_RANGE__0___1_CM 1 100. 0. 1. DISPLAY_IDENTIFIER LV_END_DIAG_LOAD_TPS_PLAUS ECU_ADDRESS 0xd00097c6 BIT_MASK 0x20 /end MEASUREMENT
/begin MEASUREMENT fmy_stat_load_tps_plaus.err_info_stat.lv_cdn_diag "diagnosis condition of the diagnosis instance LOAD_TPS_PLAUS" UWORD _CNV_S_2_RANGE__0___1_CM 1 100. 0. 1. DISPLAY_IDENTIFIER LV_CDN_DIAG_LOAD_TPS_PLAUS ECU_ADDRESS 0xd00097c6 BIT_MASK 0x40 /end MEASUREMENT
/begin MEASUREMENT fmy_stat_load_tps_plaus.err_info_stat.err_sym "symptoms of the diagnosis instance LOAD_TPS_PLAUS" UWORD _CNV_S_16_RANGE_ERR__349_CM 1 100. 0. 15. DISPLAY_IDENTIFIER ERR_SYM_LOAD_TPS_PLAUS ECU_ADDRESS 0xd00097c6 BIT_MASK 0x780 /end MEASUREMENT
/begin MEASUREMENT fmy_stat_egy_min.ctr_abc "anti bounce counter for diagnosis instance EGY_MIN" UBYTE _CNV_A_R_LINEAR_____0_CM 1 100. 0. 255. DISPLAY_IDENTIFIER CTR_ABC_EGY_MIN ECU_ADDRESS 0xd0009654 FORMAT "%3.0" /end MEASUREMENT
/begin MEASUREMENT fmy_stat_egy_min.ctr_end_diag "counter for end of diagnosis for diagnosis instance EGY_MIN" UBYTE _CNV_A_R_LINEAR_____0_CM 1 100. 0. 255. DISPLAY_IDENTIFIER CTR_ABC_END_DIAG_EGY_MIN ECU_ADDRESS 0xd0009655 FORMAT "%3.0" /end MEASUREMENT
/begin MEASUREMENT fmy_stat_egy_min.err_info_stat.lv_err_mem "storage in dynamic failure memory of the diagnosis instance EGY_MIN" UWORD _CNV_S_2_RANGE__0___1_CM 1 100. 0. 1. DISPLAY_IDENTIFIER LV_ERR_MEM_EGY_MIN ECU_ADDRESS 0xd0009656 BIT_MASK 0x8 /end MEASUREMENT
/begin MEASUREMENT fmy_stat_egy_min.err_info_stat.lv_ready "readiness status of the diagnosis instance EGY_MIN" UWORD _CNV_S_2_RANGE__0___1_CM 1 100. 0. 1. DISPLAY_IDENTIFIER LV_READY_EGY_MIN ECU_ADDRESS 0xd0009656 BIT_MASK 0x10 /end MEASUREMENT
/begin MEASUREMENT fmy_stat_egy_min.err_info_stat.lv_end_diag "end of diagnosis of the diagnosis instance EGY_MIN" UWORD _CNV_S_2_RANGE__0___1_CM 1 100. 0. 1. DISPLAY_IDENTIFIER LV_END_DIAG_EGY_MIN ECU_ADDRESS 0xd0009656 BIT_MASK 0x20 /end MEASUREMENT
/begin MEASUREMENT fmy_stat_egy_min.err_info_stat.lv_cdn_diag "diagnosis condition of the diagnosis instance EGY_MIN" UWORD _CNV_S_2_RANGE__0___1_CM 1 100. 0. 1. DISPLAY_IDENTIFIER LV_CDN_DIAG_EGY_MIN ECU_ADDRESS 0xd0009656 BIT_MASK 0x40 /end MEASUREMENT
/begin MEASUREMENT fmy_stat_egy_min.err_info_stat.err_sym "symptoms of the diagnosis instance EGY_MIN" UWORD _CNV_S_16_RANGE_ERR__349_CM 1 100. 0. 15. DISPLAY_IDENTIFIER ERR_SYM_EGY_MIN ECU_ADDRESS 0xd0009656 BIT_MASK 0x780 /end MEASUREMENT
/begin MEASUREMENT fmy_stat_locan_boff.ctr_abc "anti bounce counter for diagnosis instance LOCAN_BOFF" UBYTE _CNV_A_R_LINEAR_____0_CM 1 100. 0. 255. DISPLAY_IDENTIFIER CTR_ABC_LOCAN_BOFF ECU_ADDRESS 0xd00097c8 FORMAT "%3.0" /end MEASUREMENT
/begin MEASUREMENT fmy_stat_locan_boff.ctr_end_diag "counter for end of diagnosis for diagnosis instance LOCAN_BOFF" UBYTE _CNV_A_R_LINEAR_____0_CM 1 100. 0. 255. DISPLAY_IDENTIFIER CTR_ABC_END_DIAG_LOCAN_BOFF ECU_ADDRESS 0xd00097c9 FORMAT "%3.0" /end MEASUREMENT
/begin MEASUREMENT fmy_stat_locan_boff.err_info_stat.lv_err_mem "storage in dynamic failure memory of the diagnosis instance LOCAN_BOFF" UWORD _CNV_S_2_RANGE__0___1_CM 1 100. 0. 1. DISPLAY_IDENTIFIER LV_ERR_MEM_LOCAN_BOFF ECU_ADDRESS 0xd00097ca BIT_MASK 0x8 /end MEASUREMENT
/begin MEASUREMENT fmy_stat_locan_boff.err_info_stat.lv_ready "readiness status of the diagnosis instance LOCAN_BOFF" UWORD _CNV_S_2_RANGE__0___1_CM 1 100. 0. 1. DISPLAY_IDENTIFIER LV_READY_LOCAN_BOFF ECU_ADDRESS 0xd00097ca BIT_MASK 0x10 /end MEASUREMENT
/begin MEASUREMENT fmy_stat_locan_boff.err_info_stat.lv_end_diag "end of diagnosis of the diagnosis instance LOCAN_BOFF" UWORD _CNV_S_2_RANGE__0___1_CM 1 100. 0. 1. DISPLAY_IDENTIFIER LV_END_DIAG_LOCAN_BOFF ECU_ADDRESS 0xd00097ca BIT_MASK 0x20 /end MEASUREMENT
/begin MEASUREMENT fmy_stat_locan_boff.err_info_stat.lv_cdn_diag "diagnosis condition of the diagnosis instance LOCAN_BOFF" UWORD _CNV_S_2_RANGE__0___1_CM 1 100. 0. 1. DISPLAY_IDENTIFIER LV_CDN_DIAG_LOCAN_BOFF ECU_ADDRESS 0xd00097ca BIT_MASK 0x40 /end MEASUREMENT
/begin MEASUREMENT fmy_stat_locan_boff.err_info_stat.err_sym "symptoms of the diagnosis instance LOCAN_BOFF" UWORD _CNV_S_16_RANGE_ERR__349_CM 1 100. 0. 15. DISPLAY_IDENTIFIER ERR_SYM_LOCAN_BOFF ECU_ADDRESS 0xd00097ca BIT_MASK 0x780 /end MEASUREMENT
/begin MEASUREMENT fmy_stat_cwp_plaus.ctr_abc "anti bounce counter for diagnosis instance CWP_PLAUS" UBYTE _CNV_A_R_LINEAR_____0_CM 1 100. 0. 255. DISPLAY_IDENTIFIER CTR_ABC_CWP_PLAUS ECU_ADDRESS 0xd000959c FORMAT "%3.0" /end MEASUREMENT
/begin MEASUREMENT fmy_stat_cwp_plaus.ctr_end_diag "counter for end of diagnosis for diagnosis instance CWP_PLAUS" UBYTE _CNV_A_R_LINEAR_____0_CM 1 100. 0. 255. DISPLAY_IDENTIFIER CTR_ABC_END_DIAG_CWP_PLAUS ECU_ADDRESS 0xd000959d FORMAT "%3.0" /end MEASUREMENT
/begin MEASUREMENT fmy_stat_cwp_plaus.err_info_stat.lv_err_mem "storage in dynamic failure memory of the diagnosis instance CWP_PLAUS" UWORD _CNV_S_2_RANGE__0___1_CM 1 100. 0. 1. DISPLAY_IDENTIFIER LV_ERR_MEM_CWP_PLAUS ECU_ADDRESS 0xd000959e BIT_MASK 0x8 /end MEASUREMENT
/begin MEASUREMENT fmy_stat_cwp_plaus.err_info_stat.lv_ready "readiness status of the diagnosis instance CWP_PLAUS" UWORD _CNV_S_2_RANGE__0___1_CM 1 100. 0. 1. DISPLAY_IDENTIFIER LV_READY_CWP_PLAUS ECU_ADDRESS 0xd000959e BIT_MASK 0x10 /end MEASUREMENT
/begin MEASUREMENT fmy_stat_cwp_plaus.err_info_stat.lv_end_diag "end of diagnosis of the diagnosis instance CWP_PLAUS" UWORD _CNV_S_2_RANGE__0___1_CM 1 100. 0. 1. DISPLAY_IDENTIFIER LV_END_DIAG_CWP_PLAUS ECU_ADDRESS 0xd000959e BIT_MASK 0x20 /end MEASUREMENT
/begin MEASUREMENT fmy_stat_cwp_plaus.err_info_stat.lv_cdn_diag "diagnosis condition of the diagnosis instance CWP_PLAUS" UWORD _CNV_S_2_RANGE__0___1_CM 1 100. 0. 1. DISPLAY_IDENTIFIER LV_CDN_DIAG_CWP_PLAUS ECU_ADDRESS 0xd000959e BIT_MASK 0x40 /end MEASUREMENT
/begin MEASUREMENT fmy_stat_cwp_plaus.err_info_stat.err_sym "symptoms of the diagnosis instance CWP_PLAUS" UWORD _CNV_S_16_RANGE_ERR__349_CM 1 100. 0. 15. DISPLAY_IDENTIFIER ERR_SYM_CWP_PLAUS ECU_ADDRESS 0xd000959e BIT_MASK 0x780 /end MEASUREMENT
/begin MEASUREMENT fmy_stat_cwp_int_off.ctr_abc "anti bounce counter for diagnosis instance CWP_INT_OFF" UBYTE _CNV_A_R_LINEAR_____0_CM 1 100. 0. 255. DISPLAY_IDENTIFIER CTR_ABC_CWP_INT_OFF ECU_ADDRESS 0xd0009598 FORMAT "%3.0" /end MEASUREMENT
/begin MEASUREMENT fmy_stat_cwp_int_off.ctr_end_diag "counter for end of diagnosis for diagnosis instance CWP_INT_OFF" UBYTE _CNV_A_R_LINEAR_____0_CM 1 100. 0. 255. DISPLAY_IDENTIFIER CTR_ABC_END_DIAG_CWP_INT_OFF ECU_ADDRESS 0xd0009599 FORMAT "%3.0" /end MEASUREMENT
/begin MEASUREMENT fmy_stat_cwp_int_off.err_info_stat.lv_err_mem "storage in dynamic failure memory of the diagnosis instance CWP_INT_OFF" UWORD _CNV_S_2_RANGE__0___1_CM 1 100. 0. 1. DISPLAY_IDENTIFIER LV_ERR_MEM_CWP_INT_OFF ECU_ADDRESS 0xd000959a BIT_MASK 0x8 /end MEASUREMENT
/begin MEASUREMENT fmy_stat_cwp_int_off.err_info_stat.lv_ready "readiness status of the diagnosis instance CWP_INT_OFF" UWORD _CNV_S_2_RANGE__0___1_CM 1 100. 0. 1. DISPLAY_IDENTIFIER LV_READY_CWP_INT_OFF ECU_ADDRESS 0xd000959a BIT_MASK 0x10 /end MEASUREMENT
/begin MEASUREMENT fmy_stat_cwp_int_off.err_info_stat.lv_end_diag "end of diagnosis of the diagnosis instance CWP_INT_OFF" UWORD _CNV_S_2_RANGE__0___1_CM 1 100. 0. 1. DISPLAY_IDENTIFIER LV_END_DIAG_CWP_INT_OFF ECU_ADDRESS 0xd000959a BIT_MASK 0x20 /end MEASUREMENT
/begin MEASUREMENT fmy_stat_cwp_int_off.err_info_stat.lv_cdn_diag "diagnosis condition of the diagnosis instance CWP_INT_OFF" UWORD _CNV_S_2_RANGE__0___1_CM 1 100. 0. 1. DISPLAY_IDENTIFIER LV_CDN_DIAG_CWP_INT_OFF ECU_ADDRESS 0xd000959a BIT_MASK 0x40 /end MEASUREMENT
/begin MEASUREMENT fmy_stat_cwp_int_off.err_info_stat.err_sym "symptoms of the diagnosis instance CWP_INT_OFF" UWORD _CNV_S_16_RANGE_ERR__349_CM 1 100. 0. 15. DISPLAY_IDENTIFIER ERR_SYM_CWP_INT_OFF ECU_ADDRESS 0xd000959a BIT_MASK 0x780 /end MEASUREMENT
/begin MEASUREMENT fmy_stat_cwp_pwr.ctr_abc "anti bounce counter for diagnosis instance CWP_PWR" UBYTE _CNV_A_R_LINEAR_____0_CM 1 100. 0. 255. DISPLAY_IDENTIFIER CTR_ABC_CWP_PWR ECU_ADDRESS 0xd00095a0 FORMAT "%3.0" /end MEASUREMENT
/begin MEASUREMENT fmy_stat_cwp_pwr.ctr_end_diag "counter for end of diagnosis for diagnosis instance CWP_PWR" UBYTE _CNV_A_R_LINEAR_____0_CM 1 100. 0. 255. DISPLAY_IDENTIFIER CTR_ABC_END_DIAG_CWP_PWR ECU_ADDRESS 0xd00095a1 FORMAT "%3.0" /end MEASUREMENT
/begin MEASUREMENT fmy_stat_cwp_pwr.err_info_stat.lv_err_mem "storage in dynamic failure memory of the diagnosis instance CWP_PWR" UWORD _CNV_S_2_RANGE__0___1_CM 1 100. 0. 1. DISPLAY_IDENTIFIER LV_ERR_MEM_CWP_PWR ECU_ADDRESS 0xd00095a2 BIT_MASK 0x8 /end MEASUREMENT
/begin MEASUREMENT fmy_stat_cwp_pwr.err_info_stat.lv_ready "readiness status of the diagnosis instance CWP_PWR" UWORD _CNV_S_2_RANGE__0___1_CM 1 100. 0. 1. DISPLAY_IDENTIFIER LV_READY_CWP_PWR ECU_ADDRESS 0xd00095a2 BIT_MASK 0x10 /end MEASUREMENT
/begin MEASUREMENT fmy_stat_cwp_pwr.err_info_stat.lv_end_diag "end of diagnosis of the diagnosis instance CWP_PWR" UWORD _CNV_S_2_RANGE__0___1_CM 1 100. 0. 1. DISPLAY_IDENTIFIER LV_END_DIAG_CWP_PWR ECU_ADDRESS 0xd00095a2 BIT_MASK 0x20 /end MEASUREMENT
/begin MEASUREMENT fmy_stat_cwp_pwr.err_info_stat.lv_cdn_diag "diagnosis condition of the diagnosis instance CWP_PWR" UWORD _CNV_S_2_RANGE__0___1_CM 1 100. 0. 1. DISPLAY_IDENTIFIER LV_CDN_DIAG_CWP_PWR ECU_ADDRESS 0xd00095a2 BIT_MASK 0x40 /end MEASUREMENT
/begin MEASUREMENT fmy_stat_cwp_pwr.err_info_stat.err_sym "symptoms of the diagnosis instance CWP_PWR" UWORD _CNV_S_16_RANGE_ERR__349_CM 1 100. 0. 15. DISPLAY_IDENTIFIER ERR_SYM_CWP_PWR ECU_ADDRESS 0xd00095a2 BIT_MASK 0x780 /end MEASUREMENT
/begin MEASUREMENT fmy_stat_cwp_com_plaus.ctr_abc "anti bounce counter for diagnosis instance CWP_COM_PLAUS" UBYTE _CNV_A_R_LINEAR_____0_CM 1 100. 0. 255. DISPLAY_IDENTIFIER CTR_ABC_CWP_COM_PLAUS ECU_ADDRESS 0xd0009594 FORMAT "%3.0" /end MEASUREMENT
/begin MEASUREMENT fmy_stat_cwp_com_plaus.ctr_end_diag "counter for end of diagnosis for diagnosis instance CWP_COM_PLAUS" UBYTE _CNV_A_R_LINEAR_____0_CM 1 100. 0. 255. DISPLAY_IDENTIFIER CTR_ABC_END_DIAG_CWP_COM_PLAUS ECU_ADDRESS 0xd0009595 FORMAT "%3.0" /end MEASUREMENT
/begin MEASUREMENT fmy_stat_cwp_com_plaus.err_info_stat.lv_err_mem "storage in dynamic failure memory of the diagnosis instance CWP_COM_PLAUS" UWORD _CNV_S_2_RANGE__0___1_CM 1 100. 0. 1. DISPLAY_IDENTIFIER LV_ERR_MEM_CWP_COM_PLAUS ECU_ADDRESS 0xd0009596 BIT_MASK 0x8 /end MEASUREMENT
/begin MEASUREMENT fmy_stat_cwp_com_plaus.err_info_stat.lv_ready "readiness status of the diagnosis instance CWP_COM_PLAUS" UWORD _CNV_S_2_RANGE__0___1_CM 1 100. 0. 1. DISPLAY_IDENTIFIER LV_READY_CWP_COM_PLAUS ECU_ADDRESS 0xd0009596 BIT_MASK 0x10 /end MEASUREMENT
/begin MEASUREMENT fmy_stat_cwp_com_plaus.err_info_stat.lv_end_diag "end of diagnosis of the diagnosis instance CWP_COM_PLAUS" UWORD _CNV_S_2_RANGE__0___1_CM 1 100. 0. 1. DISPLAY_IDENTIFIER LV_END_DIAG_CWP_COM_PLAUS ECU_ADDRESS 0xd0009596 BIT_MASK 0x20 /end MEASUREMENT
/begin MEASUREMENT fmy_stat_cwp_com_plaus.err_info_stat.lv_cdn_diag "diagnosis condition of the diagnosis instance CWP_COM_PLAUS" UWORD _CNV_S_2_RANGE__0___1_CM 1 100. 0. 1. DISPLAY_IDENTIFIER LV_CDN_DIAG_CWP_COM_PLAUS ECU_ADDRESS 0xd0009596 BIT_MASK 0x40 /end MEASUREMENT
/begin MEASUREMENT fmy_stat_cwp_com_plaus.err_info_stat.err_sym "symptoms of the diagnosis instance CWP_COM_PLAUS" UWORD _CNV_S_16_RANGE_ERR__349_CM 1 100. 0. 15. DISPLAY_IDENTIFIER ERR_SYM_CWP_COM_PLAUS ECU_ADDRESS 0xd0009596 BIT_MASK 0x780 /end MEASUREMENT
/begin MEASUREMENT fmy_stat_qoil_sens.ctr_abc "anti bounce counter for diagnosis instance QOIL_SENS" UBYTE _CNV_A_R_LINEAR_____0_CM 1 100. 0. 255. DISPLAY_IDENTIFIER CTR_ABC_QOIL_SENS ECU_ADDRESS 0xd000992c FORMAT "%3.0" /end MEASUREMENT
/begin MEASUREMENT fmy_stat_qoil_sens.ctr_end_diag "counter for end of diagnosis for diagnosis instance QOIL_SENS" UBYTE _CNV_A_R_LINEAR_____0_CM 1 100. 0. 255. DISPLAY_IDENTIFIER CTR_ABC_END_DIAG_QOIL_SENS ECU_ADDRESS 0xd000992d FORMAT "%3.0" /end MEASUREMENT
/begin MEASUREMENT fmy_stat_qoil_sens.err_info_stat.lv_err_mem "storage in dynamic failure memory of the diagnosis instance QOIL_SENS" UWORD _CNV_S_2_RANGE__0___1_CM 1 100. 0. 1. DISPLAY_IDENTIFIER LV_ERR_MEM_QOIL_SENS ECU_ADDRESS 0xd000992e BIT_MASK 0x8 /end MEASUREMENT
/begin MEASUREMENT fmy_stat_qoil_sens.err_info_stat.lv_ready "readiness status of the diagnosis instance QOIL_SENS" UWORD _CNV_S_2_RANGE__0___1_CM 1 100. 0. 1. DISPLAY_IDENTIFIER LV_READY_QOIL_SENS ECU_ADDRESS 0xd000992e BIT_MASK 0x10 /end MEASUREMENT
/begin MEASUREMENT fmy_stat_qoil_sens.err_info_stat.lv_end_diag "end of diagnosis of the diagnosis instance QOIL_SENS" UWORD _CNV_S_2_RANGE__0___1_CM 1 100. 0. 1. DISPLAY_IDENTIFIER LV_END_DIAG_QOIL_SENS ECU_ADDRESS 0xd000992e BIT_MASK 0x20 /end MEASUREMENT
/begin MEASUREMENT fmy_stat_qoil_sens.err_info_stat.lv_cdn_diag "diagnosis condition of the diagnosis instance QOIL_SENS" UWORD _CNV_S_2_RANGE__0___1_CM 1 100. 0. 1. DISPLAY_IDENTIFIER LV_CDN_DIAG_QOIL_SENS ECU_ADDRESS 0xd000992e BIT_MASK 0x40 /end MEASUREMENT
/begin MEASUREMENT fmy_stat_qoil_sens.err_info_stat.err_sym "symptoms of the diagnosis instance QOIL_SENS" UWORD _CNV_S_16_RANGE_ERR__349_CM 1 100. 0. 15. DISPLAY_IDENTIFIER ERR_SYM_QOIL_SENS ECU_ADDRESS 0xd000992e BIT_MASK 0x780 /end MEASUREMENT
/begin MEASUREMENT fmy_stat_bat_sens.ctr_abc "anti bounce counter for diagnosis instance BAT_SENS" UBYTE _CNV_A_R_LINEAR_____0_CM 1 100. 0. 255. DISPLAY_IDENTIFIER CTR_ABC_BAT_SENS ECU_ADDRESS 0xd00093e8 FORMAT "%3.0" /end MEASUREMENT
/begin MEASUREMENT fmy_stat_bat_sens.ctr_end_diag "counter for end of diagnosis for diagnosis instance BAT_SENS" UBYTE _CNV_A_R_LINEAR_____0_CM 1 100. 0. 255. DISPLAY_IDENTIFIER CTR_ABC_END_DIAG_BAT_SENS ECU_ADDRESS 0xd00093e9 FORMAT "%3.0" /end MEASUREMENT
/begin MEASUREMENT fmy_stat_bat_sens.err_info_stat.lv_err_mem "storage in dynamic failure memory of the diagnosis instance BAT_SENS" UWORD _CNV_S_2_RANGE__0___1_CM 1 100. 0. 1. DISPLAY_IDENTIFIER LV_ERR_MEM_BAT_SENS ECU_ADDRESS 0xd00093ea BIT_MASK 0x8 /end MEASUREMENT
/begin MEASUREMENT fmy_stat_bat_sens.err_info_stat.lv_ready "readiness status of the diagnosis instance BAT_SENS" UWORD _CNV_S_2_RANGE__0___1_CM 1 100. 0. 1. DISPLAY_IDENTIFIER LV_READY_BAT_SENS ECU_ADDRESS 0xd00093ea BIT_MASK 0x10 /end MEASUREMENT
/begin MEASUREMENT fmy_stat_bat_sens.err_info_stat.lv_end_diag "end of diagnosis of the diagnosis instance BAT_SENS" UWORD _CNV_S_2_RANGE__0___1_CM 1 100. 0. 1. DISPLAY_IDENTIFIER LV_END_DIAG_BAT_SENS ECU_ADDRESS 0xd00093ea BIT_MASK 0x20 /end MEASUREMENT
/begin MEASUREMENT fmy_stat_bat_sens.err_info_stat.lv_cdn_diag "diagnosis condition of the diagnosis instance BAT_SENS" UWORD _CNV_S_2_RANGE__0___1_CM 1 100. 0. 1. DISPLAY_IDENTIFIER LV_CDN_DIAG_BAT_SENS ECU_ADDRESS 0xd00093ea BIT_MASK 0x40 /end MEASUREMENT
/begin MEASUREMENT fmy_stat_bat_sens.err_info_stat.err_sym "symptoms of the diagnosis instance BAT_SENS" UWORD _CNV_S_16_RANGE_ERR__349_CM 1 100. 0. 15. DISPLAY_IDENTIFIER ERR_SYM_BAT_SENS ECU_ADDRESS 0xd00093ea BIT_MASK 0x780 /end MEASUREMENT
/begin MEASUREMENT fmy_stat_bat_sens_it.ctr_abc "anti bounce counter for diagnosis instance BAT_SENS_IT" UBYTE _CNV_A_R_LINEAR_____0_CM 1 100. 0. 255. DISPLAY_IDENTIFIER CTR_ABC_BAT_SENS_IT ECU_ADDRESS 0xd00093ec FORMAT "%3.0" /end MEASUREMENT
/begin MEASUREMENT fmy_stat_bat_sens_it.ctr_end_diag "counter for end of diagnosis for diagnosis instance BAT_SENS_IT" UBYTE _CNV_A_R_LINEAR_____0_CM 1 100. 0. 255. DISPLAY_IDENTIFIER CTR_ABC_END_DIAG_BAT_SENS_IT ECU_ADDRESS 0xd00093ed FORMAT "%3.0" /end MEASUREMENT
/begin MEASUREMENT fmy_stat_bat_sens_it.err_info_stat.lv_err_mem "storage in dynamic failure memory of the diagnosis instance BAT_SENS_IT" UWORD _CNV_S_2_RANGE__0___1_CM 1 100. 0. 1. DISPLAY_IDENTIFIER LV_ERR_MEM_BAT_SENS_IT ECU_ADDRESS 0xd00093ee BIT_MASK 0x8 /end MEASUREMENT
/begin MEASUREMENT fmy_stat_bat_sens_it.err_info_stat.lv_ready "readiness status of the diagnosis instance BAT_SENS_IT" UWORD _CNV_S_2_RANGE__0___1_CM 1 100. 0. 1. DISPLAY_IDENTIFIER LV_READY_BAT_SENS_IT ECU_ADDRESS 0xd00093ee BIT_MASK 0x10 /end MEASUREMENT
/begin MEASUREMENT fmy_stat_bat_sens_it.err_info_stat.lv_end_diag "end of diagnosis of the diagnosis instance BAT_SENS_IT" UWORD _CNV_S_2_RANGE__0___1_CM 1 100. 0. 1. DISPLAY_IDENTIFIER LV_END_DIAG_BAT_SENS_IT ECU_ADDRESS 0xd00093ee BIT_MASK 0x20 /end MEASUREMENT
/begin MEASUREMENT fmy_stat_bat_sens_it.err_info_stat.lv_cdn_diag "diagnosis condition of the diagnosis instance BAT_SENS_IT" UWORD _CNV_S_2_RANGE__0___1_CM 1 100. 0. 1. DISPLAY_IDENTIFIER LV_CDN_DIAG_BAT_SENS_IT ECU_ADDRESS 0xd00093ee BIT_MASK 0x40 /end MEASUREMENT
/begin MEASUREMENT fmy_stat_bat_sens_it.err_info_stat.err_sym "symptoms of the diagnosis instance BAT_SENS_IT" UWORD _CNV_S_16_RANGE_ERR__349_CM 1 100. 0. 15. DISPLAY_IDENTIFIER ERR_SYM_BAT_SENS_IT ECU_ADDRESS 0xd00093ee BIT_MASK 0x780 /end MEASUREMENT
/begin MEASUREMENT fmy_stat_bat_sens_it_el.ctr_abc "anti bounce counter for diagnosis instance BAT_SENS_IT_EL" UBYTE _CNV_A_R_LINEAR_____0_CM 1 100. 0. 255. DISPLAY_IDENTIFIER CTR_ABC_BAT_SENS_IT_EL ECU_ADDRESS 0xd00093f0 FORMAT "%3.0" /end MEASUREMENT
/begin MEASUREMENT fmy_stat_bat_sens_it_el.ctr_end_diag "counter for end of diagnosis for diagnosis instance BAT_SENS_IT_EL" UBYTE _CNV_A_R_LINEAR_____0_CM 1 100. 0. 255. DISPLAY_IDENTIFIER CTR_ABC_END_DIAG_BAT_SENS_IT_EL ECU_ADDRESS 0xd00093f1 FORMAT "%3.0" /end MEASUREMENT
/begin MEASUREMENT fmy_stat_bat_sens_it_el.err_info_stat.lv_err_mem "storage in dynamic failure memory of the diagnosis instance BAT_SENS_IT_EL" UWORD _CNV_S_2_RANGE__0___1_CM 1 100. 0. 1. DISPLAY_IDENTIFIER LV_ERR_MEM_BAT_SENS_IT_EL ECU_ADDRESS 0xd00093f2 BIT_MASK 0x8 /end MEASUREMENT
/begin MEASUREMENT fmy_stat_bat_sens_it_el.err_info_stat.lv_ready "readiness status of the diagnosis instance BAT_SENS_IT_EL" UWORD _CNV_S_2_RANGE__0___1_CM 1 100. 0. 1. DISPLAY_IDENTIFIER LV_READY_BAT_SENS_IT_EL ECU_ADDRESS 0xd00093f2 BIT_MASK 0x10 /end MEASUREMENT
/begin MEASUREMENT fmy_stat_bat_sens_it_el.err_info_stat.lv_end_diag "end of diagnosis of the diagnosis instance BAT_SENS_IT_EL" UWORD _CNV_S_2_RANGE__0___1_CM 1 100. 0. 1. DISPLAY_IDENTIFIER LV_END_DIAG_BAT_SENS_IT_EL ECU_ADDRESS 0xd00093f2 BIT_MASK 0x20 /end MEASUREMENT
/begin MEASUREMENT fmy_stat_bat_sens_it_el.err_info_stat.lv_cdn_diag "diagnosis condition of the diagnosis instance BAT_SENS_IT_EL" UWORD _CNV_S_2_RANGE__0___1_CM 1 100. 0. 1. DISPLAY_IDENTIFIER LV_CDN_DIAG_BAT_SENS_IT_EL ECU_ADDRESS 0xd00093f2 BIT_MASK 0x40 /end MEASUREMENT
/begin MEASUREMENT fmy_stat_bat_sens_it_el.err_info_stat.err_sym "symptoms of the diagnosis instance BAT_SENS_IT_EL" UWORD _CNV_S_16_RANGE_ERR__349_CM 1 100. 0. 15. DISPLAY_IDENTIFIER ERR_SYM_BAT_SENS_IT_EL ECU_ADDRESS 0xd00093f2 BIT_MASK 0x780 /end MEASUREMENT
/begin MEASUREMENT fmy_stat_ecu_nvmy.ctr_abc "anti bounce counter for diagnosis instance ECU_NVMY" UBYTE _CNV_A_R_LINEAR_____0_CM 1 100. 0. 255. DISPLAY_IDENTIFIER CTR_ABC_ECU_NVMY ECU_ADDRESS 0xd0009644 FORMAT "%3.0" /end MEASUREMENT
/begin MEASUREMENT fmy_stat_ecu_nvmy.ctr_end_diag "counter for end of diagnosis for diagnosis instance ECU_NVMY" UBYTE _CNV_A_R_LINEAR_____0_CM 1 100. 0. 255. DISPLAY_IDENTIFIER CTR_ABC_END_DIAG_ECU_NVMY ECU_ADDRESS 0xd0009645 FORMAT "%3.0" /end MEASUREMENT
/begin MEASUREMENT fmy_stat_ecu_nvmy.err_info_stat.lv_err_mem "storage in dynamic failure memory of the diagnosis instance ECU_NVMY" UWORD _CNV_S_2_RANGE__0___1_CM 1 100. 0. 1. DISPLAY_IDENTIFIER LV_ERR_MEM_ECU_NVMY ECU_ADDRESS 0xd0009646 BIT_MASK 0x8 /end MEASUREMENT
/begin MEASUREMENT fmy_stat_ecu_nvmy.err_info_stat.lv_ready "readiness status of the diagnosis instance ECU_NVMY" UWORD _CNV_S_2_RANGE__0___1_CM 1 100. 0. 1. DISPLAY_IDENTIFIER LV_READY_ECU_NVMY ECU_ADDRESS 0xd0009646 BIT_MASK 0x10 /end MEASUREMENT
/begin MEASUREMENT fmy_stat_ecu_nvmy.err_info_stat.lv_end_diag "end of diagnosis of the diagnosis instance ECU_NVMY" UWORD _CNV_S_2_RANGE__0___1_CM 1 100. 0. 1. DISPLAY_IDENTIFIER LV_END_DIAG_ECU_NVMY ECU_ADDRESS 0xd0009646 BIT_MASK 0x20 /end MEASUREMENT
/begin MEASUREMENT fmy_stat_ecu_nvmy.err_info_stat.lv_cdn_diag "diagnosis condition of the diagnosis instance ECU_NVMY" UWORD _CNV_S_2_RANGE__0___1_CM 1 100. 0. 1. DISPLAY_IDENTIFIER LV_CDN_DIAG_ECU_NVMY ECU_ADDRESS 0xd0009646 BIT_MASK 0x40 /end MEASUREMENT
/begin MEASUREMENT fmy_stat_ecu_nvmy.err_info_stat.err_sym "symptoms of the diagnosis instance ECU_NVMY" UWORD _CNV_S_16_RANGE_ERR__349_CM 1 100. 0. 15. DISPLAY_IDENTIFIER ERR_SYM_ECU_NVMY ECU_ADDRESS 0xd0009646 BIT_MASK 0x780 /end MEASUREMENT
/begin MEASUREMENT fmy_stat_gs.ctr_abc "anti bounce counter for diagnosis instance GS" UBYTE _CNV_A_R_LINEAR_____0_CM 1 100. 0. 255. DISPLAY_IDENTIFIER CTR_ABC_GS ECU_ADDRESS 0xd00096e4 FORMAT "%3.0" /end MEASUREMENT
/begin MEASUREMENT fmy_stat_gs.ctr_end_diag "counter for end of diagnosis for diagnosis instance GS" UBYTE _CNV_A_R_LINEAR_____0_CM 1 100. 0. 255. DISPLAY_IDENTIFIER CTR_ABC_END_DIAG_GS ECU_ADDRESS 0xd00096e5 FORMAT "%3.0" /end MEASUREMENT
/begin MEASUREMENT fmy_stat_gs.err_info_stat.lv_err_mem "storage in dynamic failure memory of the diagnosis instance GS" UWORD _CNV_S_2_RANGE__0___1_CM 1 100. 0. 1. DISPLAY_IDENTIFIER LV_ERR_MEM_GS ECU_ADDRESS 0xd00096e6 BIT_MASK 0x8 /end MEASUREMENT
/begin MEASUREMENT fmy_stat_gs.err_info_stat.lv_ready "readiness status of the diagnosis instance GS" UWORD _CNV_S_2_RANGE__0___1_CM 1 100. 0. 1. DISPLAY_IDENTIFIER LV_READY_GS ECU_ADDRESS 0xd00096e6 BIT_MASK 0x10 /end MEASUREMENT
/begin MEASUREMENT fmy_stat_gs.err_info_stat.lv_end_diag "end of diagnosis of the diagnosis instance GS" UWORD _CNV_S_2_RANGE__0___1_CM 1 100. 0. 1. DISPLAY_IDENTIFIER LV_END_DIAG_GS ECU_ADDRESS 0xd00096e6 BIT_MASK 0x20 /end MEASUREMENT
/begin MEASUREMENT fmy_stat_gs.err_info_stat.lv_cdn_diag "diagnosis condition of the diagnosis instance GS" UWORD _CNV_S_2_RANGE__0___1_CM 1 100. 0. 1. DISPLAY_IDENTIFIER LV_CDN_DIAG_GS ECU_ADDRESS 0xd00096e6 BIT_MASK 0x40 /end MEASUREMENT
/begin MEASUREMENT fmy_stat_gs.err_info_stat.err_sym "symptoms of the diagnosis instance GS" UWORD _CNV_S_16_RANGE_ERR__349_CM 1 100. 0. 15. DISPLAY_IDENTIFIER ERR_SYM_GS ECU_ADDRESS 0xd00096e6 BIT_MASK 0x780 /end MEASUREMENT
/begin MEASUREMENT fmy_stat_plaus_igk_bn.ctr_abc "anti bounce counter for diagnosis instance PLAUS_IGK_BN" UBYTE _CNV_A_R_LINEAR_____0_CM 1 100. 0. 255. DISPLAY_IDENTIFIER CTR_ABC_PLAUS_IGK_BN ECU_ADDRESS 0xd00098e0 FORMAT "%3.0" /end MEASUREMENT
/begin MEASUREMENT fmy_stat_plaus_igk_bn.ctr_end_diag "counter for end of diagnosis for diagnosis instance PLAUS_IGK_BN" UBYTE _CNV_A_R_LINEAR_____0_CM 1 100. 0. 255. DISPLAY_IDENTIFIER CTR_ABC_END_DIAG_PLAUS_IGK_BN ECU_ADDRESS 0xd00098e1 FORMAT "%3.0" /end MEASUREMENT
/begin MEASUREMENT fmy_stat_plaus_igk_bn.err_info_stat.lv_err_mem "storage in dynamic failure memory of the diagnosis instance PLAUS_IGK_BN" UWORD _CNV_S_2_RANGE__0___1_CM 1 100. 0. 1. DISPLAY_IDENTIFIER LV_ERR_MEM_PLAUS_IGK_BN ECU_ADDRESS 0xd00098e2 BIT_MASK 0x8 /end MEASUREMENT
/begin MEASUREMENT fmy_stat_plaus_igk_bn.err_info_stat.lv_ready "readiness status of the diagnosis instance PLAUS_IGK_BN" UWORD _CNV_S_2_RANGE__0___1_CM 1 100. 0. 1. DISPLAY_IDENTIFIER LV_READY_PLAUS_IGK_BN ECU_ADDRESS 0xd00098e2 BIT_MASK 0x10 /end MEASUREMENT
/begin MEASUREMENT fmy_stat_plaus_igk_bn.err_info_stat.lv_end_diag "end of diagnosis of the diagnosis instance PLAUS_IGK_BN" UWORD _CNV_S_2_RANGE__0___1_CM 1 100. 0. 1. DISPLAY_IDENTIFIER LV_END_DIAG_PLAUS_IGK_BN ECU_ADDRESS 0xd00098e2 BIT_MASK 0x20 /end MEASUREMENT
/begin MEASUREMENT fmy_stat_plaus_igk_bn.err_info_stat.lv_cdn_diag "diagnosis condition of the diagnosis instance PLAUS_IGK_BN" UWORD _CNV_S_2_RANGE__0___1_CM 1 100. 0. 1. DISPLAY_IDENTIFIER LV_CDN_DIAG_PLAUS_IGK_BN ECU_ADDRESS 0xd00098e2 BIT_MASK 0x40 /end MEASUREMENT
/begin MEASUREMENT fmy_stat_plaus_igk_bn.err_info_stat.err_sym "symptoms of the diagnosis instance PLAUS_IGK_BN" UWORD _CNV_S_16_RANGE_ERR__349_CM 1 100. 0. 15. DISPLAY_IDENTIFIER ERR_SYM_PLAUS_IGK_BN ECU_ADDRESS 0xd00098e2 BIT_MASK 0x780 /end MEASUREMENT
/begin MEASUREMENT fmy_stat_tq_req_can.ctr_abc "anti bounce counter for diagnosis instance TQ_REQ_CAN" UBYTE _CNV_A_R_LINEAR_____0_CM 1 100. 0. 255. DISPLAY_IDENTIFIER CTR_ABC_TQ_REQ_CAN ECU_ADDRESS 0xd0009ac0 FORMAT "%3.0" /end MEASUREMENT
/begin MEASUREMENT fmy_stat_tq_req_can.ctr_end_diag "counter for end of diagnosis for diagnosis instance TQ_REQ_CAN" UBYTE _CNV_A_R_LINEAR_____0_CM 1 100. 0. 255. DISPLAY_IDENTIFIER CTR_ABC_END_DIAG_TQ_REQ_CAN ECU_ADDRESS 0xd0009ac1 FORMAT "%3.0" /end MEASUREMENT
/begin MEASUREMENT fmy_stat_tq_req_can.err_info_stat.lv_err_mem "storage in dynamic failure memory of the diagnosis instance TQ_REQ_CAN" UWORD _CNV_S_2_RANGE__0___1_CM 1 100. 0. 1. DISPLAY_IDENTIFIER LV_ERR_MEM_TQ_REQ_CAN ECU_ADDRESS 0xd0009ac2 BIT_MASK 0x8 /end MEASUREMENT
/begin MEASUREMENT fmy_stat_tq_req_can.err_info_stat.lv_ready "readiness status of the diagnosis instance TQ_REQ_CAN" UWORD _CNV_S_2_RANGE__0___1_CM 1 100. 0. 1. DISPLAY_IDENTIFIER LV_READY_TQ_REQ_CAN ECU_ADDRESS 0xd0009ac2 BIT_MASK 0x10 /end MEASUREMENT
/begin MEASUREMENT fmy_stat_tq_req_can.err_info_stat.lv_end_diag "end of diagnosis of the diagnosis instance TQ_REQ_CAN" UWORD _CNV_S_2_RANGE__0___1_CM 1 100. 0. 1. DISPLAY_IDENTIFIER LV_END_DIAG_TQ_REQ_CAN ECU_ADDRESS 0xd0009ac2 BIT_MASK 0x20 /end MEASUREMENT
/begin MEASUREMENT fmy_stat_tq_req_can.err_info_stat.lv_cdn_diag "diagnosis condition of the diagnosis instance TQ_REQ_CAN" UWORD _CNV_S_2_RANGE__0___1_CM 1 100. 0. 1. DISPLAY_IDENTIFIER LV_CDN_DIAG_TQ_REQ_CAN ECU_ADDRESS 0xd0009ac2 BIT_MASK 0x40 /end MEASUREMENT
/begin MEASUREMENT fmy_stat_tq_req_can.err_info_stat.err_sym "symptoms of the diagnosis instance TQ_REQ_CAN" UWORD _CNV_S_16_RANGE_ERR__349_CM 1 100. 0. 15. DISPLAY_IDENTIFIER ERR_SYM_TQ_REQ_CAN ECU_ADDRESS 0xd0009ac2 BIT_MASK 0x780 /end MEASUREMENT
/begin MEASUREMENT fmy_stat_map_sens_1.ctr_abc "anti bounce counter for diagnosis instance MAP_SENS_1" UBYTE _CNV_A_R_LINEAR_____0_CM 1 100. 0. 255. DISPLAY_IDENTIFIER CTR_ABC_MAP_SENS_1 ECU_ADDRESS 0xd0009810 FORMAT "%3.0" /end MEASUREMENT
/begin MEASUREMENT fmy_stat_map_sens_1.ctr_end_diag "counter for end of diagnosis for diagnosis instance MAP_SENS_1" UBYTE _CNV_A_R_LINEAR_____0_CM 1 100. 0. 255. DISPLAY_IDENTIFIER CTR_ABC_END_DIAG_MAP_SENS_1 ECU_ADDRESS 0xd0009811 FORMAT "%3.0" /end MEASUREMENT
/begin MEASUREMENT fmy_stat_map_sens_1.err_info_stat.lv_err_mem "storage in dynamic failure memory of the diagnosis instance MAP_SENS_1" UWORD _CNV_S_2_RANGE__0___1_CM 1 100. 0. 1. DISPLAY_IDENTIFIER LV_ERR_MEM_MAP_SENS_1 ECU_ADDRESS 0xd0009812 BIT_MASK 0x8 /end MEASUREMENT
/begin MEASUREMENT fmy_stat_map_sens_1.err_info_stat.lv_ready "readiness status of the diagnosis instance MAP_SENS_1" UWORD _CNV_S_2_RANGE__0___1_CM 1 100. 0. 1. DISPLAY_IDENTIFIER LV_READY_MAP_SENS_1 ECU_ADDRESS 0xd0009812 BIT_MASK 0x10 /end MEASUREMENT
/begin MEASUREMENT fmy_stat_map_sens_1.err_info_stat.lv_end_diag "end of diagnosis of the diagnosis instance MAP_SENS_1" UWORD _CNV_S_2_RANGE__0___1_CM 1 100. 0. 1. DISPLAY_IDENTIFIER LV_END_DIAG_MAP_SENS_1 ECU_ADDRESS 0xd0009812 BIT_MASK 0x20 /end MEASUREMENT
/begin MEASUREMENT fmy_stat_map_sens_1.err_info_stat.lv_cdn_diag "diagnosis condition of the diagnosis instance MAP_SENS_1" UWORD _CNV_S_2_RANGE__0___1_CM 1 100. 0. 1. DISPLAY_IDENTIFIER LV_CDN_DIAG_MAP_SENS_1 ECU_ADDRESS 0xd0009812 BIT_MASK 0x40 /end MEASUREMENT
/begin MEASUREMENT fmy_stat_map_sens_1.err_info_stat.err_sym "symptoms of the diagnosis instance MAP_SENS_1" UWORD _CNV_S_16_RANGE_ERR__349_CM 1 100. 0. 15. DISPLAY_IDENTIFIER ERR_SYM_MAP_SENS_1 ECU_ADDRESS 0xd0009812 BIT_MASK 0x780 /end MEASUREMENT
/begin MEASUREMENT fmy_stat_map_sens_2.ctr_abc "anti bounce counter for diagnosis instance MAP_SENS_2" UBYTE _CNV_A_R_LINEAR_____0_CM 1 100. 0. 255. DISPLAY_IDENTIFIER CTR_ABC_MAP_SENS_2 ECU_ADDRESS 0xd0009814 FORMAT "%3.0" /end MEASUREMENT
/begin MEASUREMENT fmy_stat_map_sens_2.ctr_end_diag "counter for end of diagnosis for diagnosis instance MAP_SENS_2" UBYTE _CNV_A_R_LINEAR_____0_CM 1 100. 0. 255. DISPLAY_IDENTIFIER CTR_ABC_END_DIAG_MAP_SENS_2 ECU_ADDRESS 0xd0009815 FORMAT "%3.0" /end MEASUREMENT
/begin MEASUREMENT fmy_stat_map_sens_2.err_info_stat.lv_err_mem "storage in dynamic failure memory of the diagnosis instance MAP_SENS_2" UWORD _CNV_S_2_RANGE__0___1_CM 1 100. 0. 1. DISPLAY_IDENTIFIER LV_ERR_MEM_MAP_SENS_2 ECU_ADDRESS 0xd0009816 BIT_MASK 0x8 /end MEASUREMENT
/begin MEASUREMENT fmy_stat_map_sens_2.err_info_stat.lv_ready "readiness status of the diagnosis instance MAP_SENS_2" UWORD _CNV_S_2_RANGE__0___1_CM 1 100. 0. 1. DISPLAY_IDENTIFIER LV_READY_MAP_SENS_2 ECU_ADDRESS 0xd0009816 BIT_MASK 0x10 /end MEASUREMENT
/begin MEASUREMENT fmy_stat_map_sens_2.err_info_stat.lv_end_diag "end of diagnosis of the diagnosis instance MAP_SENS_2" UWORD _CNV_S_2_RANGE__0___1_CM 1 100. 0. 1. DISPLAY_IDENTIFIER LV_END_DIAG_MAP_SENS_2 ECU_ADDRESS 0xd0009816 BIT_MASK 0x20 /end MEASUREMENT
/begin MEASUREMENT fmy_stat_map_sens_2.err_info_stat.lv_cdn_diag "diagnosis condition of the diagnosis instance MAP_SENS_2" UWORD _CNV_S_2_RANGE__0___1_CM 1 100. 0. 1. DISPLAY_IDENTIFIER LV_CDN_DIAG_MAP_SENS_2 ECU_ADDRESS 0xd0009816 BIT_MASK 0x40 /end MEASUREMENT
/begin MEASUREMENT fmy_stat_map_sens_2.err_info_stat.err_sym "symptoms of the diagnosis instance MAP_SENS_2" UWORD _CNV_S_16_RANGE_ERR__349_CM 1 100. 0. 15. DISPLAY_IDENTIFIER ERR_SYM_MAP_SENS_2 ECU_ADDRESS 0xd0009816 BIT_MASK 0x780 /end MEASUREMENT
/begin MEASUREMENT fmy_stat_dtc_trm.ctr_abc "anti bounce counter for diagnosis instance DTC_TRM" UBYTE _CNV_A_R_LINEAR_____0_CM 1 100. 0. 255. DISPLAY_IDENTIFIER CTR_ABC_DTC_TRM ECU_ADDRESS 0xd0009608 FORMAT "%3.0" /end MEASUREMENT
/begin MEASUREMENT fmy_stat_dtc_trm.ctr_end_diag "counter for end of diagnosis for diagnosis instance DTC_TRM" UBYTE _CNV_A_R_LINEAR_____0_CM 1 100. 0. 255. DISPLAY_IDENTIFIER CTR_ABC_END_DIAG_DTC_TRM ECU_ADDRESS 0xd0009609 FORMAT "%3.0" /end MEASUREMENT
/begin MEASUREMENT fmy_stat_dtc_trm.err_info_stat.lv_err_mem "storage in dynamic failure memory of the diagnosis instance DTC_TRM" UWORD _CNV_S_2_RANGE__0___1_CM 1 100. 0. 1. DISPLAY_IDENTIFIER LV_ERR_MEM_DTC_TRM ECU_ADDRESS 0xd000960a BIT_MASK 0x8 /end MEASUREMENT
/begin MEASUREMENT fmy_stat_dtc_trm.err_info_stat.lv_ready "readiness status of the diagnosis instance DTC_TRM" UWORD _CNV_S_2_RANGE__0___1_CM 1 100. 0. 1. DISPLAY_IDENTIFIER LV_READY_DTC_TRM ECU_ADDRESS 0xd000960a BIT_MASK 0x10 /end MEASUREMENT
/begin MEASUREMENT fmy_stat_dtc_trm.err_info_stat.lv_end_diag "end of diagnosis of the diagnosis instance DTC_TRM" UWORD _CNV_S_2_RANGE__0___1_CM 1 100. 0. 1. DISPLAY_IDENTIFIER LV_END_DIAG_DTC_TRM ECU_ADDRESS 0xd000960a BIT_MASK 0x20 /end MEASUREMENT
/begin MEASUREMENT fmy_stat_dtc_trm.err_info_stat.lv_cdn_diag "diagnosis condition of the diagnosis instance DTC_TRM" UWORD _CNV_S_2_RANGE__0___1_CM 1 100. 0. 1. DISPLAY_IDENTIFIER LV_CDN_DIAG_DTC_TRM ECU_ADDRESS 0xd000960a BIT_MASK 0x40 /end MEASUREMENT
/begin MEASUREMENT fmy_stat_dtc_trm.err_info_stat.err_sym "symptoms of the diagnosis instance DTC_TRM" UWORD _CNV_S_16_RANGE_ERR__349_CM 1 100. 0. 15. DISPLAY_IDENTIFIER ERR_SYM_DTC_TRM ECU_ADDRESS 0xd000960a BIT_MASK 0x780 /end MEASUREMENT
/begin MEASUREMENT fmy_stat_mec_ivvt_in_1.ctr_abc "anti bounce counter for diagnosis instance MEC_IVVT_IN_1" UBYTE _CNV_A_R_LINEAR_____0_CM 1 100. 0. 255. DISPLAY_IDENTIFIER CTR_ABC_MEC_IVVT_IN_1 ECU_ADDRESS 0xd0009824 FORMAT "%3.0" /end MEASUREMENT
/begin MEASUREMENT fmy_stat_mec_ivvt_in_1.ctr_end_diag "counter for end of diagnosis for diagnosis instance MEC_IVVT_IN_1" UBYTE _CNV_A_R_LINEAR_____0_CM 1 100. 0. 255. DISPLAY_IDENTIFIER CTR_ABC_END_DIAG_MEC_IVVT_IN_1 ECU_ADDRESS 0xd0009825 FORMAT "%3.0" /end MEASUREMENT
/begin MEASUREMENT fmy_stat_mec_ivvt_in_1.err_info_stat.lv_err_mem "storage in dynamic failure memory of the diagnosis instance MEC_IVVT_IN_1" UWORD _CNV_S_2_RANGE__0___1_CM 1 100. 0. 1. DISPLAY_IDENTIFIER LV_ERR_MEM_MEC_IVVT_IN_1 ECU_ADDRESS 0xd0009826 BIT_MASK 0x8 /end MEASUREMENT
/begin MEASUREMENT fmy_stat_mec_ivvt_in_1.err_info_stat.lv_ready "readiness status of the diagnosis instance MEC_IVVT_IN_1" UWORD _CNV_S_2_RANGE__0___1_CM 1 100. 0. 1. DISPLAY_IDENTIFIER LV_READY_MEC_IVVT_IN_1 ECU_ADDRESS 0xd0009826 BIT_MASK 0x10 /end MEASUREMENT
/begin MEASUREMENT fmy_stat_mec_ivvt_in_1.err_info_stat.lv_end_diag "end of diagnosis of the diagnosis instance MEC_IVVT_IN_1" UWORD _CNV_S_2_RANGE__0___1_CM 1 100. 0. 1. DISPLAY_IDENTIFIER LV_END_DIAG_MEC_IVVT_IN_1 ECU_ADDRESS 0xd0009826 BIT_MASK 0x20 /end MEASUREMENT
/begin MEASUREMENT fmy_stat_mec_ivvt_in_1.err_info_stat.lv_cdn_diag "diagnosis condition of the diagnosis instance MEC_IVVT_IN_1" UWORD _CNV_S_2_RANGE__0___1_CM 1 100. 0. 1. DISPLAY_IDENTIFIER LV_CDN_DIAG_MEC_IVVT_IN_1 ECU_ADDRESS 0xd0009826 BIT_MASK 0x40 /end MEASUREMENT
/begin MEASUREMENT fmy_stat_mec_ivvt_in_1.err_info_stat.err_sym "symptoms of the diagnosis instance MEC_IVVT_IN_1" UWORD _CNV_S_16_RANGE_ERR__349_CM 1 100. 0. 15. DISPLAY_IDENTIFIER ERR_SYM_MEC_IVVT_IN_1 ECU_ADDRESS 0xd0009826 BIT_MASK 0x780 /end MEASUREMENT
/begin MEASUREMENT fmy_stat_mec_ivvt_in_2.ctr_abc "anti bounce counter for diagnosis instance MEC_IVVT_IN_2" UBYTE _CNV_A_R_LINEAR_____0_CM 1 100. 0. 255. DISPLAY_IDENTIFIER CTR_ABC_MEC_IVVT_IN_2 ECU_ADDRESS 0xd0009828 FORMAT "%3.0" /end MEASUREMENT
/begin MEASUREMENT fmy_stat_mec_ivvt_in_2.ctr_end_diag "counter for end of diagnosis for diagnosis instance MEC_IVVT_IN_2" UBYTE _CNV_A_R_LINEAR_____0_CM 1 100. 0. 255. DISPLAY_IDENTIFIER CTR_ABC_END_DIAG_MEC_IVVT_IN_2 ECU_ADDRESS 0xd0009829 FORMAT "%3.0" /end MEASUREMENT
/begin MEASUREMENT fmy_stat_mec_ivvt_in_2.err_info_stat.lv_err_mem "storage in dynamic failure memory of the diagnosis instance MEC_IVVT_IN_2" UWORD _CNV_S_2_RANGE__0___1_CM 1 100. 0. 1. DISPLAY_IDENTIFIER LV_ERR_MEM_MEC_IVVT_IN_2 ECU_ADDRESS 0xd000982a BIT_MASK 0x8 /end MEASUREMENT
/begin MEASUREMENT fmy_stat_mec_ivvt_in_2.err_info_stat.lv_ready "readiness status of the diagnosis instance MEC_IVVT_IN_2" UWORD _CNV_S_2_RANGE__0___1_CM 1 100. 0. 1. DISPLAY_IDENTIFIER LV_READY_MEC_IVVT_IN_2 ECU_ADDRESS 0xd000982a BIT_MASK 0x10 /end MEASUREMENT
/begin MEASUREMENT fmy_stat_mec_ivvt_in_2.err_info_stat.lv_end_diag "end of diagnosis of the diagnosis instance MEC_IVVT_IN_2" UWORD _CNV_S_2_RANGE__0___1_CM 1 100. 0. 1. DISPLAY_IDENTIFIER LV_END_DIAG_MEC_IVVT_IN_2 ECU_ADDRESS 0xd000982a BIT_MASK 0x20 /end MEASUREMENT
/begin MEASUREMENT fmy_stat_mec_ivvt_in_2.err_info_stat.lv_cdn_diag "diagnosis condition of the diagnosis instance MEC_IVVT_IN_2" UWORD _CNV_S_2_RANGE__0___1_CM 1 100. 0. 1. DISPLAY_IDENTIFIER LV_CDN_DIAG_MEC_IVVT_IN_2 ECU_ADDRESS 0xd000982a BIT_MASK 0x40 /end MEASUREMENT
/begin MEASUREMENT fmy_stat_mec_ivvt_in_2.err_info_stat.err_sym "symptoms of the diagnosis instance MEC_IVVT_IN_2" UWORD _CNV_S_16_RANGE_ERR__349_CM 1 100. 0. 15. DISPLAY_IDENTIFIER ERR_SYM_MEC_IVVT_IN_2 ECU_ADDRESS 0xd000982a BIT_MASK 0x780 /end MEASUREMENT
/begin MEASUREMENT fmy_stat_mec_ivvt_ex.ctr_abc "anti bounce counter for diagnosis instance MEC_IVVT_EX" UBYTE _CNV_A_R_LINEAR_____0_CM 1 100. 0. 255. DISPLAY_IDENTIFIER CTR_ABC_MEC_IVVT_EX ECU_ADDRESS 0xd0009820 FORMAT "%3.0" /end MEASUREMENT
/begin MEASUREMENT fmy_stat_mec_ivvt_ex.ctr_end_diag "counter for end of diagnosis for diagnosis instance MEC_IVVT_EX" UBYTE _CNV_A_R_LINEAR_____0_CM 1 100. 0. 255. DISPLAY_IDENTIFIER CTR_ABC_END_DIAG_MEC_IVVT_EX ECU_ADDRESS 0xd0009821 FORMAT "%3.0" /end MEASUREMENT
/begin MEASUREMENT fmy_stat_mec_ivvt_ex.err_info_stat.lv_err_mem "storage in dynamic failure memory of the diagnosis instance MEC_IVVT_EX" UWORD _CNV_S_2_RANGE__0___1_CM 1 100. 0. 1. DISPLAY_IDENTIFIER LV_ERR_MEM_MEC_IVVT_EX ECU_ADDRESS 0xd0009822 BIT_MASK 0x8 /end MEASUREMENT
/begin MEASUREMENT fmy_stat_mec_ivvt_ex.err_info_stat.lv_ready "readiness status of the diagnosis instance MEC_IVVT_EX" UWORD _CNV_S_2_RANGE__0___1_CM 1 100. 0. 1. DISPLAY_IDENTIFIER LV_READY_MEC_IVVT_EX ECU_ADDRESS 0xd0009822 BIT_MASK 0x10 /end MEASUREMENT
/begin MEASUREMENT fmy_stat_mec_ivvt_ex.err_info_stat.lv_end_diag "end of diagnosis of the diagnosis instance MEC_IVVT_EX" UWORD _CNV_S_2_RANGE__0___1_CM 1 100. 0. 1. DISPLAY_IDENTIFIER LV_END_DIAG_MEC_IVVT_EX ECU_ADDRESS 0xd0009822 BIT_MASK 0x20 /end MEASUREMENT
/begin MEASUREMENT fmy_stat_mec_ivvt_ex.err_info_stat.lv_cdn_diag "diagnosis condition of the diagnosis instance MEC_IVVT_EX" UWORD _CNV_S_2_RANGE__0___1_CM 1 100. 0. 1. DISPLAY_IDENTIFIER LV_CDN_DIAG_MEC_IVVT_EX ECU_ADDRESS 0xd0009822 BIT_MASK 0x40 /end MEASUREMENT
/begin MEASUREMENT fmy_stat_mec_ivvt_ex.err_info_stat.err_sym "symptoms of the diagnosis instance MEC_IVVT_EX" UWORD _CNV_S_16_RANGE_ERR__349_CM 1 100. 0. 15. DISPLAY_IDENTIFIER ERR_SYM_MEC_IVVT_EX ECU_ADDRESS 0xd0009822 BIT_MASK 0x780 /end MEASUREMENT
/begin MEASUREMENT fmy_stat_tout_nox_sens_1.ctr_abc "anti bounce counter for diagnosis instance TOUT_NOX_SENS_1" UBYTE _CNV_A_R_LINEAR_____0_CM 1 100. 0. 255. DISPLAY_IDENTIFIER CTR_ABC_TOUT_NOX_SENS_1 ECU_ADDRESS 0xd0009a6c FORMAT "%3.0" /end MEASUREMENT
/begin MEASUREMENT fmy_stat_tout_nox_sens_1.ctr_end_diag "counter for end of diagnosis for diagnosis instance TOUT_NOX_SENS_1" UBYTE _CNV_A_R_LINEAR_____0_CM 1 100. 0. 255. DISPLAY_IDENTIFIER CTR_ABC_END_DIAG_TOUT_NOX_SENS_1 ECU_ADDRESS 0xd0009a6d FORMAT "%3.0" /end MEASUREMENT
/begin MEASUREMENT fmy_stat_tout_nox_sens_1.err_info_stat.lv_err_mem "storage in dynamic failure memory of the diagnosis instance TOUT_NOX_SENS_1" UWORD _CNV_S_2_RANGE__0___1_CM 1 100. 0. 1. DISPLAY_IDENTIFIER LV_ERR_MEM_TOUT_NOX_SENS_1 ECU_ADDRESS 0xd0009a6e BIT_MASK 0x8 /end MEASUREMENT
/begin MEASUREMENT fmy_stat_tout_nox_sens_1.err_info_stat.lv_ready "readiness status of the diagnosis instance TOUT_NOX_SENS_1" UWORD _CNV_S_2_RANGE__0___1_CM 1 100. 0. 1. DISPLAY_IDENTIFIER LV_READY_TOUT_NOX_SENS_1 ECU_ADDRESS 0xd0009a6e BIT_MASK 0x10 /end MEASUREMENT
/begin MEASUREMENT fmy_stat_tout_nox_sens_1.err_info_stat.lv_end_diag "end of diagnosis of the diagnosis instance TOUT_NOX_SENS_1" UWORD _CNV_S_2_RANGE__0___1_CM 1 100. 0. 1. DISPLAY_IDENTIFIER LV_END_DIAG_TOUT_NOX_SENS_1 ECU_ADDRESS 0xd0009a6e BIT_MASK 0x20 /end MEASUREMENT
/begin MEASUREMENT fmy_stat_tout_nox_sens_1.err_info_stat.lv_cdn_diag "diagnosis condition of the diagnosis instance TOUT_NOX_SENS_1" UWORD _CNV_S_2_RANGE__0___1_CM 1 100. 0. 1. DISPLAY_IDENTIFIER LV_CDN_DIAG_TOUT_NOX_SENS_1 ECU_ADDRESS 0xd0009a6e BIT_MASK 0x40 /end MEASUREMENT
/begin MEASUREMENT fmy_stat_tout_nox_sens_1.err_info_stat.err_sym "symptoms of the diagnosis instance TOUT_NOX_SENS_1" UWORD _CNV_S_16_RANGE_ERR__349_CM 1 100. 0. 15. DISPLAY_IDENTIFIER ERR_SYM_TOUT_NOX_SENS_1 ECU_ADDRESS 0xd0009a6e BIT_MASK 0x780 /end MEASUREMENT
/begin MEASUREMENT fmy_stat_tout_nox_sens_2.ctr_abc "anti bounce counter for diagnosis instance TOUT_NOX_SENS_2" UBYTE _CNV_A_R_LINEAR_____0_CM 1 100. 0. 255. DISPLAY_IDENTIFIER CTR_ABC_TOUT_NOX_SENS_2 ECU_ADDRESS 0xd0009a70 FORMAT "%3.0" /end MEASUREMENT
/begin MEASUREMENT fmy_stat_tout_nox_sens_2.ctr_end_diag "counter for end of diagnosis for diagnosis instance TOUT_NOX_SENS_2" UBYTE _CNV_A_R_LINEAR_____0_CM 1 100. 0. 255. DISPLAY_IDENTIFIER CTR_ABC_END_DIAG_TOUT_NOX_SENS_2 ECU_ADDRESS 0xd0009a71 FORMAT "%3.0" /end MEASUREMENT
/begin MEASUREMENT fmy_stat_tout_nox_sens_2.err_info_stat.lv_err_mem "storage in dynamic failure memory of the diagnosis instance TOUT_NOX_SENS_2" UWORD _CNV_S_2_RANGE__0___1_CM 1 100. 0. 1. DISPLAY_IDENTIFIER LV_ERR_MEM_TOUT_NOX_SENS_2 ECU_ADDRESS 0xd0009a72 BIT_MASK 0x8 /end MEASUREMENT
/begin COMPU_METHOD _CNV_A_R_LINEAR_____0_CM "" RAT_FUNC "%6.3" "-" COEFFS 0 1. 0. 0 0 1 /end COMPU_METHOD
/begin COMPU_METHOD _CNV_S_2_RANGE__0___1_CM "" TAB_VERB "%6.3" "-" COMPU_TAB_REF _CNV_S_2_RANGE__0___1 /end COMPU_METHOD
/begin COMPU_VTAB _CNV_S_2_RANGE__0___1 "" TAB_VERB 2 0 "0" 1 "1" /end COMPU_VTAB
/begin COMPU_METHOD _CNV_S_16_RANGE_ERR__349_CM "" TAB_VERB "%6.3" "-" COMPU_TAB_REF _CNV_S_16_RANGE_ERR__349 /end COMPU_METHOD
/begin COMPU_VTAB _CNV_S_16_RANGE_ERR__349 "" TAB_VERB 16 0 "NO_SYM" 1 "SYM_0" 2 "SYM_1" 3 "SYM_0, SYM_1" 4 "SYM_2" 5 "SYM_0, SYM_2" 6 "SYM_1, SYM_2" 7 "SYM_0, SYM_1, SYM_2" 8 "SYM_3" 9 "SYM_0, SYM_3" 10 "SYM_1, SYM_3" 11 "SYM_0, SYM_1,SYM_3" 12 "SYM_2, SYM_3" 13 "SYM_0, SYM_2, SYM_3" 14 "SYM_1, SYM_2, SYM_3" 15 "SYM_0, SYM_1, SYM_2, SYM_3" /end COMPU_VTAB
/begin FUNCTION ERRM_Table_of_Failures "Table_of_Failures"
 /begin OUT_MEASUREMENT fmy_stat_msw_tog.err_info_stat.lv_ready fmy_stat_msw_tog.err_info_stat.lv_end_diag fmy_stat_msw_tog.err_info_stat.lv_cdn_diag fmy_stat_msw_tog.err_info_stat.err_sym fmy_stat_msw_2.ctr_abc fmy_stat_msw_2.ctr_end_diag fmy_stat_msw_2.err_info_stat.lv_err_mem fmy_stat_msw_2.err_info_stat.lv_ready fmy_stat_msw_2.err_info_stat.lv_end_diag fmy_stat_msw_2.err_info_stat.lv_cdn_diag fmy_stat_msw_2.err_info_stat.err_sym fmy_stat_msw_3.ctr_abc fmy_stat_msw_3.ctr_end_diag fmy_stat_msw_3.err_info_stat.lv_err_mem fmy_stat_msw_3.err_info_stat.lv_ready fmy_stat_msw_3.err_info_stat.lv_end_diag fmy_stat_msw_3.err_info_stat.lv_cdn_diag fmy_stat_msw_3.err_info_stat.err_sym fmy_stat_mis_0.ctr_abc fmy_stat_mis_0.ctr_end_diag fmy_stat_mis_0.err_info_stat.lv_err_mem fmy_stat_mis_0.err_info_stat.lv_ready fmy_stat_mis_0.err_info_stat.lv_end_diag fmy_stat_mis_0.err_info_stat.lv_cdn_diag fmy_stat_mis_0.err_info_stat.err_sym fmy_stat_mis_1.ctr_abc fmy_stat_mis_1.ctr_end_diag fmy_stat_mis_1.err_info_stat.lv_err_mem fmy_stat_mis_1.err_info_stat.lv_ready fmy_stat_mis_1.err_info_stat.lv_end_diag fmy_stat_mis_1.err_info_stat.lv_cdn_diag fmy_stat_mis_1.err_info_stat.err_sym fmy_stat_mis_2.ctr_abc fmy_stat_mis_2.ctr_end_diag fmy_stat_mis_2.err_info_stat.lv_err_mem fmy_stat_mis_2.err_info_stat.lv_ready fmy_stat_mis_2.err_info_stat.lv_end_diag fmy_stat_mis_2.err_info_stat.lv_cdn_diag fmy_stat_mis_2.err_info_stat.err_sym fmy_stat_mis_3.ctr_abc fmy_stat_mis_3.ctr_end_diag fmy_stat_mis_3.err_info_stat.lv_err_mem fmy_stat_mis_3.err_info_stat.lv_ready fmy_stat_mis_3.err_info_stat.lv_end_diag fmy_stat_mis_3.err_info_stat.lv_cdn_diag fmy_stat_mis_3.err_info_stat.err_sym fmy_stat_mis_4.ctr_abc fmy_stat_mis_4.ctr_end_diag fmy_stat_mis_4.err_info_stat.lv_err_mem fmy_stat_mis_4.err_info_stat.lv_ready fmy_stat_mis_4.err_info_stat.lv_end_diag fmy_stat_mis_4.err_info_stat.lv_cdn_diag fmy_stat_mis_4.err_info_stat.err_sym fmy_stat_mis_5.ctr_abc fmy_stat_mis_5.ctr_end_diag fmy_stat_mis_5.err_info_stat.lv_err_mem fmy_stat_mis_5.err_info_stat.lv_ready fmy_stat_mis_5.err_info_stat.lv_end_diag fmy_stat_mis_5.err_info_stat.lv_cdn_diag fmy_stat_mis_5.err_info_stat.err_sym fmy_stat_mis_6.ctr_abc fmy_stat_mis_6.ctr_end_diag fmy_stat_mis_6.err_info_stat.lv_err_mem fmy_stat_mis_6.err_info_stat.lv_ready fmy_stat_mis_6.err_info_stat.lv_end_diag fmy_stat_mis_6.err_info_stat.lv_cdn_diag fmy_stat_mis_6.err_info_stat.err_sym fmy_stat_mis_7.ctr_abc fmy_stat_mis_7.ctr_end_diag fmy_stat_mis_7.err_info_stat.lv_err_mem fmy_stat_mis_7.err_info_stat.lv_ready fmy_stat_mis_7.err_info_stat.lv_end_diag fmy_stat_mis_7.err_info_stat.lv_cdn_diag fmy_stat_mis_7.err_info_stat.err_sym fmy_stat_mis_mpl.ctr_abc fmy_stat_mis_mpl.ctr_end_diag fmy_stat_mis_mpl.err_info_stat.lv_err_mem fmy_stat_mis_mpl.err_info_stat.lv_ready fmy_stat_mis_mpl.err_info_stat.lv_end_diag fmy_stat_mis_mpl.err_info_stat.lv_cdn_diag fmy_stat_mis_mpl.err_info_stat.err_sym fmy_stat_mis_ftl_l.ctr_abc fmy_stat_mis_ftl_l.ctr_end_diag fmy_stat_mis_ftl_l.err_info_stat.lv_err_mem fmy_stat_mis_ftl_l.err_info_stat.lv_ready fmy_stat_mis_ftl_l.err_info_stat.lv_end_diag fmy_stat_mis_ftl_l.err_info_stat.lv_cdn_diag fmy_stat_mis_ftl_l.err_info_stat.err_sym fmy_stat_ef.ctr_abc fmy_stat_ef.ctr_end_diag fmy_stat_ef.err_info_stat.lv_err_mem fmy_stat_ef.err_info_stat.lv_ready fmy_stat_ef.err_info_stat.lv_end_diag fmy_stat_ef.err_info_stat.lv_cdn_diag fmy_stat_ef.err_info_stat.err_sym fmy_stat_tecu.ctr_abc fmy_stat_tecu.ctr_end_diag fmy_stat_tecu.err_info_stat.lv_err_mem fmy_stat_tecu.err_info_stat.lv_ready fmy_stat_tecu.err_info_stat.lv_end_diag fmy_stat_tecu.err_info_stat.lv_cdn_diag fmy_stat_tecu.err_info_stat.err_sym fmy_stat_ebox_cfa.ctr_abc fmy_stat_ebox_cfa.ctr_end_diag fmy_stat_ebox_cfa.err_info_stat.lv_err_mem fmy_stat_ebox_cfa.err_info_stat.lv_ready fmy_stat_ebox_cfa.err_info_stat.lv_end_diag fmy_stat_ebox_cfa.err_info_stat.lv_cdn_diag fmy_stat_ebox_cfa.err_info_stat.err_sym fmy_stat_ecu_ram.ctr_abc fmy_stat_ecu_ram.ctr_end_diag fmy_stat_ecu_ram.err_info_stat.lv_err_mem fmy_stat_ecu_ram.err_info_stat.lv_ready fmy_stat_ecu_ram.err_info_stat.lv_end_diag fmy_stat_ecu_ram.err_info_stat.lv_cdn_diag fmy_stat_ecu_ram.err_info_stat.err_sym fmy_stat_tqi_lim.ctr_abc fmy_stat_tqi_lim.ctr_end_diag fmy_stat_tqi_lim.err_info_stat.lv_err_mem fmy_stat_tqi_lim.err_info_stat.lv_ready fmy_stat_tqi_lim.err_info_stat.lv_end_diag fmy_stat_tqi_lim.err_info_stat.lv_cdn_diag fmy_stat_tqi_lim.err_info_stat.err_sym fmy_stat_dmtls.ctr_abc fmy_stat_dmtls.ctr_end_diag fmy_stat_dmtls.err_info_stat.lv_err_mem fmy_stat_dmtls.err_info_stat.lv_ready fmy_stat_dmtls.err_info_stat.lv_end_diag fmy_stat_dmtls.err_info_stat.lv_cdn_diag fmy_stat_dmtls.err_info_stat.err_sym fmy_stat_dmtl_pump.ctr_abc fmy_stat_dmtl_pump.ctr_end_diag fmy_stat_dmtl_pump.err_info_stat.lv_err_mem fmy_stat_dmtl_pump.err_info_stat.lv_ready fmy_stat_dmtl_pump.err_info_stat.lv_end_diag fmy_stat_dmtl_pump.err_info_stat.lv_cdn_diag fmy_stat_dmtl_pump.err_info_stat.err_sym fmy_stat_dmtlm.ctr_abc fmy_stat_dmtlm.ctr_end_diag fmy_stat_dmtlm.err_info_stat.lv_err_mem fmy_stat_dmtlm.err_info_stat.lv_ready fmy_stat_dmtlm.err_info_stat.lv_end_diag fmy_stat_dmtlm.err_info_stat.lv_cdn_diag fmy_stat_dmtlm.err_info_stat.err_sym fmy_stat_rough_leak.ctr_abc fmy_stat_rough_leak.ctr_end_diag fmy_stat_rough_leak.err_info_stat.lv_err_mem fmy_stat_rough_leak.err_info_stat.lv_ready fmy_stat_rough_leak.err_info_stat.lv_end_diag fmy_stat_rough_leak.err_info_stat.lv_cdn_diag fmy_stat_rough_leak.err_info_stat.err_sym fmy_stat_small_leak.ctr_abc fmy_stat_small_leak.ctr_end_diag fmy_stat_small_leak.err_info_stat.lv_err_mem fmy_stat_small_leak.err_info_stat.lv_ready fmy_stat_small_leak.err_info_stat.lv_end_diag fmy_stat_small_leak.err_info_stat.lv_cdn_diag fmy_stat_small_leak.err_info_stat.err_sym fmy_stat_chk_fuc.ctr_abc fmy_stat_chk_fuc.ctr_end_diag fmy_stat_chk_fuc.err_info_stat.lv_err_mem fmy_stat_chk_fuc.err_info_stat.lv_ready fmy_stat_chk_fuc.err_info_stat.lv_end_diag fmy_stat_chk_fuc.err_info_stat.lv_cdn_diag fmy_stat_chk_fuc.err_info_stat.err_sym fmy_stat_sof.ctr_abc fmy_stat_sof.ctr_end_diag fmy_stat_sof.err_info_stat.lv_err_mem fmy_stat_sof.err_info_stat.lv_ready fmy_stat_sof.err_info_stat.lv_end_diag fmy_stat_sof.err_info_stat.lv_cdn_diag fmy_stat_sof.err_info_stat.err_sym fmy_stat_sof_req.ctr_abc fmy_stat_sof_req.ctr_end_diag fmy_stat_sof_req.err_info_stat.lv_err_mem fmy_stat_sof_req.err_info_stat.lv_ready fmy_stat_sof_req.err_info_stat.lv_end_diag fmy_stat_sof_req.err_info_stat.lv_cdn_diag fmy_stat_sof_req.err_info_stat.err_sym fmy_stat_rly_crcv_heat.ctr_abc fmy_stat_rly_crcv_heat.ctr_end_diag fmy_stat_rly_crcv_heat.err_info_stat.lv_err_mem fmy_stat_rly_crcv_heat.err_info_stat.lv_ready fmy_stat_rly_crcv_heat.err_info_stat.lv_end_diag fmy_stat_rly_crcv_heat.err_info_stat.lv_cdn_diag fmy_stat_rly_crcv_heat.err_info_stat.err_sym fmy_stat_rly_st.ctr_abc fmy_stat_rly_st.ctr_end_diag fmy_stat_rly_st.err_info_stat.lv_err_mem fmy_stat_rly_st.err_info_stat.lv_ready fmy_stat_rly_st.err_info_stat.lv_end_diag fmy_stat_rly_st.err_info_stat.lv_cdn_diag fmy_stat_rly_st.err_info_stat.err_sym fmy_stat_bsd.ctr_abc fmy_stat_bsd.ctr_end_diag fmy_stat_bsd.err_info_stat.lv_err_mem fmy_stat_bsd.err_info_stat.lv_ready fmy_stat_bsd.err_info_stat.lv_end_diag fmy_stat_bsd.err_info_stat.lv_cdn_diag fmy_stat_bsd.err_info_stat.err_sym fmy_stat_poil_swi.ctr_abc fmy_stat_poil_swi.ctr_end_diag fmy_stat_poil_swi.err_info_stat.lv_err_mem fmy_stat_poil_swi.err_info_stat.lv_ready fmy_stat_poil_swi.err_info_stat.lv_end_diag fmy_stat_poil_swi.err_info_stat.lv_cdn_diag fmy_stat_poil_swi.err_info_stat.err_sym fmy_stat_tout_efp_can.ctr_abc fmy_stat_tout_efp_can.ctr_end_diag fmy_stat_tout_efp_can.err_info_stat.lv_err_mem fmy_stat_tout_efp_can.err_info_stat.lv_ready fmy_stat_tout_efp_can.err_info_stat.lv_end_diag fmy_stat_tout_efp_can.err_info_stat.lv_cdn_diag fmy_stat_tout_efp_can.err_info_stat.err_sym fmy_stat_diagcps.ctr_abc fmy_stat_diagcps.ctr_end_diag fmy_stat_diagcps.err_info_stat.lv_err_mem fmy_stat_diagcps.err_info_stat.lv_ready fmy_stat_diagcps.err_info_stat.lv_end_diag fmy_stat_diagcps.err_info_stat.lv_cdn_diag fmy_stat_diagcps.err_info_stat.err_sym fmy_stat_dcc.ctr_abc fmy_stat_dcc.ctr_end_diag fmy_stat_dcc.err_info_stat.lv_err_mem fmy_stat_dcc.err_info_stat.lv_ready fmy_stat_dcc.err_info_stat.lv_end_diag fmy_stat_dcc.err_info_stat.lv_cdn_diag fmy_stat_dcc.err_info_stat.err_sym fmy_stat_ldm.ctr_abc fmy_stat_ldm.ctr_end_diag fmy_stat_ldm.err_info_stat.lv_err_mem fmy_stat_ldm.err_info_stat.lv_ready fmy_stat_ldm.err_info_stat.lv_end_diag fmy_stat_ldm.err_info_stat.lv_cdn_diag fmy_stat_ldm.err_info_stat.err_sym fmy_stat_dmtlh.ctr_abc fmy_stat_dmtlh.ctr_end_diag fmy_stat_dmtlh.err_info_stat.lv_err_mem fmy_stat_dmtlh.err_info_stat.lv_ready fmy_stat_dmtlh.err_info_stat.lv_end_diag fmy_stat_dmtlh.err_info_stat.lv_cdn_diag fmy_stat_dmtlh.err_info_stat.err_sym fmy_stat_cs.ctr_abc fmy_stat_cs.ctr_end_diag fmy_stat_cs.err_info_stat.lv_err_mem fmy_stat_cs.err_info_stat.lv_ready fmy_stat_cs.err_info_stat.lv_end_diag fmy_stat_cs.err_info_stat.lv_cdn_diag fmy_stat_cs.err_info_stat.err_sym fmy_stat_spi_mps.ctr_abc fmy_stat_spi_mps.ctr_end_diag fmy_stat_spi_mps.err_info_stat.lv_err_mem fmy_stat_spi_mps.err_info_stat.lv_ready fmy_stat_spi_mps.err_info_stat.lv_end_diag fmy_stat_spi_mps.err_info_stat.lv_cdn_diag fmy_stat_spi_mps.err_info_stat.err_sym fmy_stat_spi_knk.ctr_abc fmy_stat_spi_knk.ctr_end_diag fmy_stat_spi_knk.err_info_stat.lv_err_mem fmy_stat_spi_knk.err_info_stat.lv_ready fmy_stat_spi_knk.err_info_stat.lv_end_diag fmy_stat_spi_knk.err_info_stat.lv_cdn_diag fmy_stat_spi_knk.err_info_stat.err_sym fmy_stat_sens_poil.ctr_abc fmy_stat_sens_poil.ctr_end_diag fmy_stat_sens_poil.err_info_stat.lv_err_mem fmy_stat_sens_poil.err_info_stat.lv_ready fmy_stat_sens_poil.err_info_stat.lv_end_diag fmy_stat_sens_poil.err_info_stat.lv_cdn_diag fmy_stat_sens_poil.err_info_stat.err_sym fmy_stat_poil_dr.ctr_abc fmy_stat_poil_dr.ctr_end_diag fmy_stat_poil_dr.err_info_stat.lv_err_mem fmy_stat_poil_dr.err_info_stat.lv_ready fmy_stat_poil_dr.err_info_stat.lv_end_diag fmy_stat_poil_dr.err_info_stat.lv_cdn_diag fmy_stat_poil_dr.err_info_stat.err_sym fmy_stat_bn_tq_dcc.ctr_abc fmy_stat_bn_tq_dcc.ctr_end_diag fmy_stat_bn_tq_dcc.err_info_stat.lv_err_mem fmy_stat_bn_tq_dcc.err_info_stat.lv_ready fmy_stat_bn_tq_dcc.err_info_stat.lv_end_diag fmy_stat_bn_tq_dcc.err_info_stat.lv_cdn_diag fmy_stat_bn_tq_dcc.err_info_stat.err_sym fmy_stat_bn_tq_pste_2.ctr_abc fmy_stat_bn_tq_pste_2.ctr_end_diag fmy_stat_bn_tq_pste_2.err_info_stat.lv_err_mem fmy_stat_bn_tq_pste_2.err_info_stat.lv_ready fmy_stat_bn_tq_pste_2.err_info_stat.lv_end_diag fmy_stat_bn_tq_pste_2.err_info_stat.lv_cdn_diag fmy_stat_bn_tq_pste_2.err_info_stat.err_sym fmy_stat_bn_tq_pste_3.ctr_abc fmy_stat_bn_tq_pste_3.ctr_end_diag fmy_stat_bn_tq_pste_3.err_info_stat.lv_err_mem fmy_stat_bn_tq_pste_3.err_info_stat.lv_ready fmy_stat_bn_tq_pste_3.err_info_stat.lv_end_diag fmy_stat_bn_tq_pste_3.err_info_stat.lv_cdn_diag fmy_stat_bn_tq_pste_3.err_info_stat.err_sym fmy_stat_bn_ars.ctr_abc fmy_stat_bn_ars.ctr_end_diag fmy_stat_bn_ars.err_info_stat.lv_err_mem fmy_stat_bn_ars.err_info_stat.lv_ready fmy_stat_bn_ars.err_info_stat.lv_end_diag fmy_stat_bn_ars.err_info_stat.lv_cdn_diag fmy_stat_bn_ars.err_info_stat.err_sym fmy_stat_bn_cas.ctr_abc fmy_stat_bn_cas.ctr_end_diag fmy_stat_bn_cas.err_info_stat.lv_err_mem fmy_stat_bn_cas.err_info_stat.lv_ready fmy_stat_bn_cas.err_info_stat.lv_end_diag fmy_stat_bn_cas.err_info_stat.lv_cdn_diag fmy_stat_bn_cas.err_info_stat.err_sym fmy_stat_bn_tq_tcs.ctr_abc fmy_stat_bn_tq_tcs.ctr_end_diag fmy_stat_bn_tq_tcs.err_info_stat.lv_err_mem fmy_stat_bn_tq_tcs.err_info_stat.lv_ready fmy_stat_bn_tq_tcs.err_info_stat.lv_end_diag fmy_stat_bn_tq_tcs.err_info_stat.lv_cdn_diag fmy_stat_bn_tq_tcs.err_info_stat.err_sym fmy_stat_bn_vs_tcs.ctr_abc fmy_stat_bn_vs_tcs.ctr_end_diag fmy_stat_bn_vs_tcs.err_info_stat.lv_err_mem fmy_stat_bn_vs_tcs.err_info_stat.lv_ready fmy_stat_bn_vs_tcs.err_info_stat.lv_end_diag fmy_stat_bn_vs_tcs.err_info_stat.lv_cdn_diag fmy_stat_bn_vs_tcs.err_info_stat.err_sym fmy_stat_bn_tcs.ctr_abc fmy_stat_bn_tcs.ctr_end_diag fmy_stat_bn_tcs.err_info_stat.lv_err_mem fmy_stat_bn_tcs.err_info_stat.lv_ready fmy_stat_bn_tcs.err_info_stat.lv_end_diag fmy_stat_bn_tcs.err_info_stat.lv_cdn_diag fmy_stat_bn_tcs.err_info_stat.err_sym fmy_stat_bn_tq_etcu.ctr_abc fmy_stat_bn_tq_etcu.ctr_end_diag fmy_stat_bn_tq_etcu.err_info_stat.lv_err_mem fmy_stat_bn_tq_etcu.err_info_stat.lv_ready fmy_stat_bn_tq_etcu.err_info_stat.lv_end_diag fmy_stat_bn_tq_etcu.err_info_stat.lv_cdn_diag fmy_stat_bn_tq_etcu.err_info_stat.err_sym fmy_stat_bn_etcu.ctr_abc fmy_stat_bn_etcu.ctr_end_diag fmy_stat_bn_etcu.err_info_stat.lv_err_mem fmy_stat_bn_etcu.err_info_stat.lv_ready fmy_stat_bn_etcu.err_info_stat.lv_end_diag fmy_stat_bn_etcu.err_info_stat.lv_cdn_diag fmy_stat_bn_etcu.err_info_stat.err_sym fmy_stat_bn_etcu_2.ctr_abc fmy_stat_bn_etcu_2.ctr_end_diag fmy_stat_bn_etcu_2.err_info_stat.lv_err_mem fmy_stat_bn_etcu_2.err_info_stat.lv_ready fmy_stat_bn_etcu_2.err_info_stat.lv_end_diag fmy_stat_bn_etcu_2.err_info_stat.lv_cdn_diag fmy_stat_bn_etcu_2.err_info_stat.err_sym fmy_stat_bn_etcu_3.ctr_abc fmy_stat_bn_etcu_3.ctr_end_diag fmy_stat_bn_etcu_3.err_info_stat.lv_err_mem fmy_stat_bn_etcu_3.err_info_stat.lv_ready fmy_stat_bn_etcu_3.err_info_stat.lv_end_diag fmy_stat_bn_etcu_3.err_info_stat.lv_cdn_diag fmy_stat_bn_etcu_3.err_info_stat.err_sym fmy_stat_bn_etcu_disp.ctr_abc fmy_stat_bn_etcu_disp.ctr_end_diag fmy_stat_bn_etcu_disp.err_info_stat.lv_err_mem fmy_stat_bn_etcu_disp.err_info_stat.lv_ready fmy_stat_bn_etcu_disp.err_info_stat.lv_end_diag fmy_stat_bn_etcu_disp.err_info_stat.lv_cdn_diag fmy_stat_bn_etcu_disp.err_info_stat.err_sym fmy_stat_bn_tq_amt.ctr_abc fmy_stat_bn_tq_amt.ctr_end_diag fmy_stat_bn_tq_amt.err_info_stat.lv_err_mem fmy_stat_bn_tq_amt.err_info_stat.lv_ready fmy_stat_bn_tq_amt.err_info_stat.lv_end_diag fmy_stat_bn_tq_amt.err_info_stat.lv_cdn_diag fmy_stat_bn_tq_amt.err_info_stat.err_sym fmy_stat_bn_acc.ctr_abc fmy_stat_bn_acc.ctr_end_diag fmy_stat_bn_acc.err_info_stat.lv_err_mem fmy_stat_bn_acc.err_info_stat.lv_ready fmy_stat_bn_acc.err_info_stat.lv_end_diag fmy_stat_bn_acc.err_info_stat.lv_cdn_diag fmy_stat_bn_acc.err_info_stat.err_sym fmy_stat_bn_t_icl.ctr_abc fmy_stat_bn_t_icl.ctr_end_diag fmy_stat_bn_t_icl.err_info_stat.lv_err_mem fmy_stat_bn_t_icl.err_info_stat.lv_ready fmy_stat_bn_t_icl.err_info_stat.lv_end_diag fmy_stat_bn_t_icl.err_info_stat.lv_cdn_diag fmy_stat_bn_t_icl.err_info_stat.err_sym fmy_stat_bn_veh_mod.ctr_abc fmy_stat_bn_veh_mod.ctr_end_diag fmy_stat_bn_veh_mod.err_info_stat.lv_err_mem fmy_stat_bn_veh_mod.err_info_stat.lv_ready fmy_stat_bn_veh_mod.err_info_stat.lv_end_diag fmy_stat_bn_veh_mod.err_info_stat.lv_cdn_diag fmy_stat_bn_veh_mod.err_info_stat.err_sym fmy_stat_bn_km_icl.ctr_abc fmy_stat_bn_km_icl.ctr_end_diag fmy_stat_bn_km_icl.err_info_stat.lv_err_mem fmy_stat_bn_km_icl.err_info_stat.lv_ready fmy_stat_bn_km_icl.err_info_stat.lv_end_diag fmy_stat_bn_km_icl.err_info_stat.lv_cdn_diag fmy_stat_bn_km_icl.err_info_stat.err_sym fmy_stat_bn_icl.ctr_abc fmy_stat_bn_icl.ctr_end_diag fmy_stat_bn_icl.err_info_stat.lv_err_mem fmy_stat_bn_icl.err_info_stat.lv_ready fmy_stat_bn_icl.err_info_stat.lv_end_diag fmy_stat_bn_icl.err_info_stat.lv_cdn_diag fmy_stat_bn_icl.err_info_stat.err_sym fmy_stat_bn_pow_vb.ctr_abc fmy_stat_bn_pow_vb.ctr_end_diag fmy_stat_bn_pow_vb.err_info_stat.lv_err_mem fmy_stat_bn_pow_vb.err_info_stat.lv_ready fmy_stat_bn_pow_vb.err_info_stat.lv_end_diag fmy_stat_bn_pow_vb.err_info_stat.lv_cdn_diag fmy_stat_bn_pow_vb.err_info_stat.err_sym fmy_stat_bn_pow_gen.ctr_abc fmy_stat_bn_pow_gen.ctr_end_diag fmy_stat_bn_pow_gen.err_info_stat.lv_err_mem fmy_stat_bn_pow_gen.err_info_stat.lv_ready fmy_stat_bn_pow_gen.err_info_stat.lv_end_diag fmy_stat_bn_pow_gen.err_info_stat.lv_cdn_diag fmy_stat_bn_pow_gen.err_info_stat.err_sym fmy_stat_bn_msw.ctr_abc fmy_stat_bn_msw.ctr_end_diag fmy_stat_bn_msw.err_info_stat.lv_err_mem fmy_stat_bn_msw.err_info_stat.lv_ready fmy_stat_bn_msw.err_info_stat.lv_end_diag fmy_stat_bn_msw.err_info_stat.lv_cdn_diag fmy_stat_bn_msw.err_info_stat.err_sym fmy_stat_bn_ang_pste.ctr_abc fmy_stat_bn_ang_pste.ctr_end_diag fmy_stat_bn_ang_pste.err_info_stat.lv_err_mem fmy_stat_bn_ang_pste.err_info_stat.lv_ready fmy_stat_bn_ang_pste.err_info_stat.lv_end_diag fmy_stat_bn_ang_pste.err_info_stat.lv_cdn_diag fmy_stat_bn_ang_pste.err_info_stat.err_sym fmy_stat_bn_gear_rev.ctr_abc fmy_stat_bn_gear_rev.ctr_end_diag fmy_stat_bn_gear_rev.err_info_stat.lv_err_mem fmy_stat_bn_gear_rev.err_info_stat.lv_ready fmy_stat_bn_gear_rev.err_info_stat.lv_end_diag fmy_stat_bn_gear_rev.err_info_stat.lv_cdn_diag fmy_stat_bn_gear_rev.err_info_stat.err_sym fmy_stat_bn_ltg_hdlp_l.ctr_abc fmy_stat_bn_ltg_hdlp_l.ctr_end_diag fmy_stat_bn_ltg_hdlp_l.err_info_stat.lv_err_mem fmy_stat_bn_ltg_hdlp_l.err_info_stat.lv_ready fmy_stat_bn_ltg_hdlp_l.err_info_stat.lv_end_diag fmy_stat_bn_ltg_hdlp_l.err_info_stat.lv_cdn_diag fmy_stat_bn_ltg_hdlp_l.err_info_stat.err_sym fmy_stat_bn_ldm.ctr_abc fmy_stat_bn_ldm.ctr_end_diag fmy_stat_bn_ldm.err_info_stat.lv_err_mem fmy_stat_bn_ldm.err_info_stat.lv_ready fmy_stat_bn_ldm.err_info_stat.lv_end_diag fmy_stat_bn_ldm.err_info_stat.lv_cdn_diag fmy_stat_bn_ldm.err_info_stat.err_sym fmy_stat_bn_trl.ctr_abc fmy_stat_bn_trl.ctr_end_diag fmy_stat_bn_trl.err_info_stat.lv_err_mem fmy_stat_bn_trl.err_info_stat.lv_ready fmy_stat_bn_trl.err_info_stat.lv_end_diag fmy_stat_bn_trl.err_info_stat.lv_cdn_diag fmy_stat_bn_trl.err_info_stat.err_sym fmy_stat_bn_hiv.ctr_abc fmy_stat_bn_hiv.ctr_end_diag fmy_stat_bn_hiv.err_info_stat.lv_err_mem fmy_stat_bn_hiv.err_info_stat.lv_ready fmy_stat_bn_hiv.err_info_stat.lv_end_diag fmy_stat_bn_hiv.err_info_stat.lv_cdn_diag fmy_stat_bn_hiv.err_info_stat.err_sym fmy_stat_bn_t_clk.ctr_abc fmy_stat_bn_t_clk.ctr_end_diag fmy_stat_bn_t_clk.err_info_stat.lv_err_mem fmy_stat_bn_t_clk.err_info_stat.lv_ready fmy_stat_bn_t_clk.err_info_stat.lv_end_diag fmy_stat_bn_t_clk.err_info_stat.lv_cdn_diag fmy_stat_bn_t_clk.err_info_stat.err_sym fmy_stat_bn_efp_crash.ctr_abc fmy_stat_bn_efp_crash.ctr_end_diag fmy_stat_bn_efp_crash.err_info_stat.lv_err_mem fmy_stat_bn_efp_crash.err_info_stat.lv_ready fmy_stat_bn_efp_crash.err_info_stat.lv_end_diag fmy_stat_bn_efp_crash.err_info_stat.lv_cdn_diag fmy_stat_bn_efp_crash.err_info_stat.err_sym fmy_stat_bn_cdn_door.ctr_abc fmy_stat_bn_cdn_door.ctr_end_diag fmy_stat_bn_cdn_door.err_info_stat.lv_err_mem fmy_stat_bn_cdn_door.err_info_stat.lv_ready fmy_stat_bn_cdn_door.err_info_stat.lv_end_diag fmy_stat_bn_cdn_door.err_info_stat.lv_cdn_diag fmy_stat_bn_cdn_door.err_info_stat.err_sym fmy_stat_bn_req_pbr.ctr_abc fmy_stat_bn_req_pbr.ctr_end_diag fmy_stat_bn_req_pbr.err_info_stat.lv_err_mem fmy_stat_bn_req_pbr.err_info_stat.lv_ready fmy_stat_bn_req_pbr.err_info_stat.lv_end_diag fmy_stat_bn_req_pbr.err_info_stat.lv_cdn_diag fmy_stat_bn_req_pbr.err_info_stat.err_sym fmy_stat_bn_pbr.ctr_abc fmy_stat_bn_pbr.ctr_end_diag fmy_stat_bn_pbr.err_info_stat.lv_err_mem fmy_stat_bn_pbr.err_info_stat.lv_ready fmy_stat_bn_pbr.err_info_stat.lv_end_diag fmy_stat_bn_pbr.err_info_stat.lv_cdn_diag fmy_stat_bn_pbr.err_info_stat.err_sym fmy_stat_bn_efp.ctr_abc fmy_stat_bn_efp.ctr_end_diag fmy_stat_bn_efp.err_info_stat.lv_err_mem fmy_stat_bn_efp.err_info_stat.lv_ready fmy_stat_bn_efp.err_info_stat.lv_end_diag fmy_stat_bn_efp.err_info_stat.lv_cdn_diag fmy_stat_bn_efp.err_info_stat.err_sym fmy_stat_load_tps_plaus.ctr_abc fmy_stat_load_tps_plaus.ctr_end_diag fmy_stat_load_tps_plaus.err_info_stat.lv_err_mem fmy_stat_load_tps_plaus.err_info_stat.lv_ready fmy_stat_load_tps_plaus.err_info_stat.lv_end_diag fmy_stat_load_tps_plaus.err_info_stat.lv_cdn_diag fmy_stat_load_tps_plaus.err_info_stat.err_sym fmy_stat_egy_min.ctr_abc fmy_stat_egy_min.ctr_end_diag fmy_stat_egy_min.err_info_stat.lv_err_mem fmy_stat_egy_min.err_info_stat.lv_ready fmy_stat_egy_min.err_info_stat.lv_end_diag fmy_stat_egy_min.err_info_stat.lv_cdn_diag fmy_stat_egy_min.err_info_stat.err_sym fmy_stat_locan_boff.ctr_abc fmy_stat_locan_boff.ctr_end_diag fmy_stat_locan_boff.err_info_stat.lv_err_mem fmy_stat_locan_boff.err_info_stat.lv_ready fmy_stat_locan_boff.err_info_stat.lv_end_diag fmy_stat_locan_boff.err_info_stat.lv_cdn_diag fmy_stat_locan_boff.err_info_stat.err_sym fmy_stat_cwp_plaus.ctr_abc fmy_stat_cwp_plaus.ctr_end_diag fmy_stat_cwp_plaus.err_info_stat.lv_err_mem fmy_stat_cwp_plaus.err_info_stat.lv_ready fmy_stat_cwp_plaus.err_info_stat.lv_end_diag fmy_stat_cwp_plaus.err_info_stat.lv_cdn_diag fmy_stat_cwp_plaus.err_info_stat.err_sym fmy_stat_cwp_int_off.ctr_abc fmy_stat_cwp_int_off.ctr_end_diag fmy_stat_cwp_int_off.err_info_stat.lv_err_mem fmy_stat_cwp_int_off.err_info_stat.lv_ready fmy_stat_cwp_int_off.err_info_stat.lv_end_diag fmy_stat_cwp_int_off.err_info_stat.lv_cdn_diag fmy_stat_cwp_int_off.err_info_stat.err_sym fmy_stat_cwp_pwr.ctr_abc fmy_stat_cwp_pwr.ctr_end_diag fmy_stat_cwp_pwr.err_info_stat.lv_err_mem fmy_stat_cwp_pwr.err_info_stat.lv_ready fmy_stat_cwp_pwr.err_info_stat.lv_end_diag fmy_stat_cwp_pwr.err_info_stat.lv_cdn_diag fmy_stat_cwp_pwr.err_info_stat.err_sym fmy_stat_cwp_com_plaus.ctr_abc fmy_stat_cwp_com_plaus.ctr_end_diag fmy_stat_cwp_com_plaus.err_info_stat.lv_err_mem fmy_stat_cwp_com_plaus.err_info_stat.lv_ready fmy_stat_cwp_com_plaus.err_info_stat.lv_end_diag fmy_stat_cwp_com_plaus.err_info_stat.lv_cdn_diag fmy_stat_cwp_com_plaus.err_info_stat.err_sym fmy_stat_qoil_sens.ctr_abc fmy_stat_qoil_sens.ctr_end_diag fmy_stat_qoil_sens.err_info_stat.lv_err_mem fmy_stat_qoil_sens.err_info_stat.lv_ready fmy_stat_qoil_sens.err_info_stat.lv_end_diag fmy_stat_qoil_sens.err_info_stat.lv_cdn_diag fmy_stat_qoil_sens.err_info_stat.err_sym fmy_stat_bat_sens.ctr_abc fmy_stat_bat_sens.ctr_end_diag fmy_stat_bat_sens.err_info_stat.lv_err_mem fmy_stat_bat_sens.err_info_stat.lv_ready fmy_stat_bat_sens.err_info_stat.lv_end_diag fmy_stat_bat_sens.err_info_stat.lv_cdn_diag fmy_stat_bat_sens.err_info_stat.err_sym fmy_stat_bat_sens_it.ctr_abc fmy_stat_bat_sens_it.ctr_end_diag fmy_stat_bat_sens_it.err_info_stat.lv_err_mem fmy_stat_bat_sens_it.err_info_stat.lv_ready fmy_stat_bat_sens_it.err_info_stat.lv_end_diag fmy_stat_bat_sens_it.err_info_stat.lv_cdn_diag fmy_stat_bat_sens_it.err_info_stat.err_sym fmy_stat_bat_sens_it_el.ctr_abc fmy_stat_bat_sens_it_el.ctr_end_diag fmy_stat_bat_sens_it_el.err_info_stat.lv_err_mem fmy_stat_bat_sens_it_el.err_info_stat.lv_ready fmy_stat_bat_sens_it_el.err_info_stat.lv_end_diag fmy_stat_bat_sens_it_el.err_info_stat.lv_cdn_diag fmy_stat_bat_sens_it_el.err_info_stat.err_sym fmy_stat_ecu_nvmy.ctr_abc fmy_stat_ecu_nvmy.ctr_end_diag fmy_stat_ecu_nvmy.err_info_stat.lv_err_mem fmy_stat_ecu_nvmy.err_info_stat.lv_ready fmy_stat_ecu_nvmy.err_info_stat.lv_end_diag fmy_stat_ecu_nvmy.err_info_stat.lv_cdn_diag fmy_stat_ecu_nvmy.err_info_stat.err_sym fmy_stat_gs.ctr_abc fmy_stat_gs.ctr_end_diag fmy_stat_gs.err_info_stat.lv_err_mem fmy_stat_gs.err_info_stat.lv_ready fmy_stat_gs.err_info_stat.lv_end_diag fmy_stat_gs.err_info_stat.lv_cdn_diag fmy_stat_gs.err_info_stat.err_sym fmy_stat_plaus_igk_bn.ctr_abc fmy_stat_plaus_igk_bn.ctr_end_diag fmy_stat_plaus_igk_bn.err_info_stat.lv_err_mem fmy_stat_plaus_igk_bn.err_info_stat.lv_ready fmy_stat_plaus_igk_bn.err_info_stat.lv_end_diag fmy_stat_plaus_igk_bn.err_info_stat.lv_cdn_diag fmy_stat_plaus_igk_bn.err_info_stat.err_sym fmy_stat_tq_req_can.ctr_abc fmy_stat_tq_req_can.ctr_end_diag fmy_stat_tq_req_can.err_info_stat.lv_err_mem fmy_stat_tq_req_can.err_info_stat.lv_ready fmy_stat_tq_req_can.err_info_stat.lv_end_diag fmy_stat_tq_req_can.err_info_stat.lv_cdn_diag fmy_stat_tq_req_can.err_info_stat.err_sym fmy_stat_map_sens_1.ctr_abc fmy_stat_map_sens_1.ctr_end_diag fmy_stat_map_sens_1.err_info_stat.lv_err_mem fmy_stat_map_sens_1.err_info_stat.lv_ready fmy_stat_map_sens_1.err_info_stat.lv_end_diag fmy_stat_map_sens_1.err_info_stat.lv_cdn_diag fmy_stat_map_sens_1.err_info_stat.err_sym fmy_stat_map_sens_2.ctr_abc fmy_stat_map_sens_2.ctr_end_diag fmy_stat_map_sens_2.err_info_stat.lv_err_mem fmy_stat_map_sens_2.err_info_stat.lv_ready fmy_stat_map_sens_2.err_info_stat.lv_end_diag fmy_stat_map_sens_2.err_info_stat.lv_cdn_diag fmy_stat_map_sens_2.err_info_stat.err_sym fmy_stat_dtc_trm.ctr_abc fmy_stat_dtc_trm.ctr_end_diag fmy_stat_dtc_trm.err_info_stat.lv_err_mem fmy_stat_dtc_trm.err_info_stat.lv_ready fmy_stat_dtc_trm.err_info_stat.lv_end_diag fmy_stat_dtc_trm.err_info_stat.lv_cdn_diag fmy_stat_dtc_trm.err_info_stat.err_sym fmy_stat_mec_ivvt_in_1.ctr_abc fmy_stat_mec_ivvt_in_1.ctr_end_diag fmy_stat_mec_ivvt_in_1.err_info_stat.lv_err_mem fmy_stat_mec_ivvt_in_1.err_info_stat.lv_ready fmy_stat_mec_ivvt_in_1.err_info_stat.lv_end_diag fmy_stat_mec_ivvt_in_1.err_info_stat.lv_cdn_diag fmy_stat_mec_ivvt_in_1.err_info_stat.err_sym fmy_stat_mec_ivvt_in_2.ctr_abc fmy_stat_mec_ivvt_in_2.ctr_end_diag fmy_stat_mec_ivvt_in_2.err_info_stat.lv_err_mem fmy_stat_mec_ivvt_in_2.err_info_stat.lv_ready fmy_stat_mec_ivvt_in_2.err_info_stat.lv_end_diag fmy_stat_mec_ivvt_in_2.err_info_stat.lv_cdn_diag fmy_stat_mec_ivvt_in_2.err_info_stat.err_sym fmy_stat_mec_ivvt_ex.ctr_abc fmy_stat_mec_ivvt_ex.ctr_end_diag fmy_stat_mec_ivvt_ex.err_info_stat.lv_err_mem fmy_stat_mec_ivvt_ex.err_info_stat.lv_ready fmy_stat_mec_ivvt_ex.err_info_stat.lv_end_diag fmy_stat_mec_ivvt_ex.err_info_stat.lv_cdn_diag fmy_stat_mec_ivvt_ex.err_info_stat.err_sym fmy_stat_tout_nox_sens_1.ctr_abc fmy_stat_tout_nox_sens_1.ctr_end_diag fmy_stat_tout_nox_sens_1.err_info_stat.lv_err_mem fmy_stat_tout_nox_sens_1.err_info_stat.lv_ready fmy_stat_tout_nox_sens_1.err_info_stat.lv_end_diag fmy_stat_tout_nox_sens_1.err_info_stat.lv_cdn_diag fmy_stat_tout_nox_sens_1.err_info_stat.err_sym fmy_stat_tout_nox_sens_2.ctr_abc fmy_stat_tout_nox_sens_2.ctr_end_diag fmy_stat_tout_nox_sens_2.err_info_stat.lv_err_mem /end OUT_MEASUREMENT
/end FUNCTION
/end MODULE
/end PROJECT
