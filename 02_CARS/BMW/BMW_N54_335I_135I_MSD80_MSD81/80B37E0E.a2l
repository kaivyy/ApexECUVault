ASAP2_VERSION 1 41
/begin PROJECT MSD70 "Spray Guided DI-System with Piezo Injectors for 6-Cylinder"
/begin HEADER "_default_HeaderComment" PROJECT_NO _0B /end HEADER
/begin MODULE _default_ModuleName "_default_ModuleLongIdentifier"
/begin MOD_COMMON "_default_ModCommonComment" DEPOSIT ABSOLUTE BYTE_ORDER MSB_LAST ALIGNMENT_BYTE 1 ALIGNMENT_WORD 2 ALIGNMENT_LONG 2 ALIGNMENT_FLOAT32_IEEE 2 ALIGNMENT_FLOAT64_IEEE 4 /end MOD_COMMON
/begin MEASUREMENT Absch_korr "Korrekturwert Abschaltung" SWORD _CNV_R_R_Def_f_sw_q_571_CM 1 100. -40. 40. DISPLAY_IDENTIFIER ABSCH_KORR ECU_ADDRESS 0xc00046e0 FORMAT "%8.3" /end MEASUREMENT
/begin MEASUREMENT All2ptc "Gesamtgewichtung für PTC-Ansteuerung" SWORD _CNV_R_R_Def_f_sw_p_581_CM 1 100. -500. 550. DISPLAY_IDENTIFIER ALL2PTC ECU_ADDRESS 0xc00028f4 FORMAT "%7.2" /end MEASUREMENT
/begin MEASUREMENT Allk "Leerlauf Auslassspreizung gedrosselt kalt zum Katheizen" UBYTE _CNV_R_R_Def_spr_ub_582_CM 1 100. 0. 204. DISPLAY_IDENTIFIER ALLK ECU_ADDRESS 0xd000792a FORMAT "%5.2" /end MEASUREMENT
/begin MEASUREMENT Allptcfilt "pi-geregelte Gewichtung für PTC-Ansteuerung" UWORD _CNV_R_R_Def_f_sw_p_581_CM 1 100. 0. 550. DISPLAY_IDENTIFIER ALLPTCFILT ECU_ADDRESS 0xc000291a FORMAT "%8.3" /end MEASUREMENT
/begin MEASUREMENT Allw "Leerlauf Auslassspreizung gedrosselt warm zum Katheizen" UBYTE _CNV_R_R_Def_spr_ub_582_CM 1 100. 0. 204. DISPLAY_IDENTIFIER ALLW ECU_ADDRESS 0xd000792b FORMAT "%5.2" /end MEASUREMENT
/begin MEASUREMENT Ask "optimale Auslassspreizung kalt ungedrosselt" UBYTE _CNV_R_R_Def_spr_ub_582_CM 1 100. 0. 204. DISPLAY_IDENTIFIER ASK ECU_ADDRESS 0xd000792c FORMAT "%5.2" /end MEASUREMENT
/begin MEASUREMENT Aspr "Sollwert Auslassspreizung" UBYTE _CNV_R_R_Def_spr_ub_582_CM 1 100. 0. 204. DISPLAY_IDENTIFIER ASPR ECU_ADDRESS 0xd000790c FORMAT "%5.2" /end MEASUREMENT
/begin MEASUREMENT Aspr_last "" UBYTE _CNV_R_R_Def_spr_ub_582_CM 1 100. 0. 204. DISPLAY_IDENTIFIER ASPR_LAST ECU_ADDRESS 0xd0007926 FORMAT "%5.2" /end MEASUREMENT
/begin MEASUREMENT Aspr_norm "" UBYTE _CNV_R_R_Def_spr_ub_582_CM 1 100. 0. 204. DISPLAY_IDENTIFIER ASPR_NORM ECU_ADDRESS 0xd000791f FORMAT "%5.2" /end MEASUREMENT
/begin MEASUREMENT Aspr_ramp "" SWORD _CNV_R_R_Def_spr_sw_583_CM 1 100. 0. 180. DISPLAY_IDENTIFIER ASPR_RAMP ECU_ADDRESS 0xd000795a FORMAT "%7.2" /end MEASUREMENT
/begin MEASUREMENT Aspr_vl1 "" UBYTE _CNV_R_R_Def_spr_ub_582_CM 1 100. 0. 204. DISPLAY_IDENTIFIER ASPR_VL1 ECU_ADDRESS 0xd0007922 FORMAT "%5.2" /end MEASUREMENT
/begin MEASUREMENT Aspr_vl2 "" UBYTE _CNV_R_R_Def_spr_ub_582_CM 1 100. 0. 204. DISPLAY_IDENTIFIER ASPR_VL2 ECU_ADDRESS 0xd0007923 FORMAT "%5.2" /end MEASUREMENT
/begin MEASUREMENT Aspr_vs "Normspreizung Auslass" UWORD _CNV_R_R_Def_spr_sw_583_CM 1 100. 0. 6553.5 DISPLAY_IDENTIFIER ASPR_VS ECU_ADDRESS 0xd0007956 FORMAT "%7.2" /end MEASUREMENT
/begin MEASUREMENT Asprhs "Auslassspreizung Teillast, Homogen_Schicht" UBYTE _CNV_R_R_Def_spr_ub_582_CM 1 100. 0. 204. DISPLAY_IDENTIFIER ASPRHS ECU_ADDRESS 0xd0007952 FORMAT "%5.2" /end MEASUREMENT
/begin MEASUREMENT Asprimx "Max. der Istauslassspreizung" UWORD _CNV_R_R_Def_spr_sw_583_CM 1 100. 0. 6553.5 DISPLAY_IDENTIFIER ASPRIMX ECU_ADDRESS 0xd000792e FORMAT "%7.2" /end MEASUREMENT
/begin MEASUREMENT Asprl "Auslassspreizung im Leerlauf gedrosselt" UBYTE _CNV_R_R_Def_spr_ub_582_CM 1 100. 0. 204. DISPLAY_IDENTIFIER ASPRL ECU_ADDRESS 0xd0007908 FORMAT "%5.2" /end MEASUREMENT
/begin MEASUREMENT Asprlast "" UBYTE _CNV_R_R_Def_spr_ub_582_CM 1 100. 0. 204. DISPLAY_IDENTIFIER ASPRLAST ECU_ADDRESS 0xd0007927 FORMAT "%5.2" /end MEASUREMENT
/begin MEASUREMENT Asprlhs "Auslassspreizung Leerlauf, Homogen_Schicht" UBYTE _CNV_R_R_Def_spr_ub_582_CM 1 100. 0. 204. DISPLAY_IDENTIFIER ASPRLHS ECU_ADDRESS 0xd0007951 FORMAT "%5.2" /end MEASUREMENT
/begin MEASUREMENT Asprll "" UBYTE _CNV_R_R_Def_spr_ub_582_CM 1 100. 0. 204. DISPLAY_IDENTIFIER ASPRLL ECU_ADDRESS 0xd0007929 FORMAT "%5.2" /end MEASUREMENT
/begin MEASUREMENT Asprll_kh "KH-Spreizung AUSLASS-LL" UBYTE _CNV_R_R_Def_spr_ub_582_CM 1 100. 0. 204. DISPLAY_IDENTIFIER ASPRLL_KH ECU_ADDRESS 0xd000791c FORMAT "%5.2" /end MEASUREMENT
/begin MEASUREMENT Asprlu "Auslassspreizung im Leerlauf ungedrosselt" UBYTE _CNV_R_R_Def_spr_ub_582_CM 1 100. 0. 204. DISPLAY_IDENTIFIER ASPRLU ECU_ADDRESS 0xd0007909 FORMAT "%5.2" /end MEASUREMENT
/begin MEASUREMENT Asprt "Auslassspreizung teilgedrosselt" UBYTE _CNV_R_R_Def_spr_ub_582_CM 1 100. 0. 204. DISPLAY_IDENTIFIER ASPRT ECU_ADDRESS 0xd0007930 FORMAT "%5.2" /end MEASUREMENT
/begin MEASUREMENT Asprtl_kh "KH-Spreizung AUSLASS-TL" UBYTE _CNV_R_R_Def_spr_ub_582_CM 1 100. 0. 204. DISPLAY_IDENTIFIER ASPRTL_KH ECU_ADDRESS 0xd000791d FORMAT "%5.2" /end MEASUREMENT
/begin MEASUREMENT Aspru "Auslassspreizung ungedrosselt" UBYTE _CNV_R_R_Def_spr_ub_582_CM 1 100. 0. 204. DISPLAY_IDENTIFIER ASPRU ECU_ADDRESS 0xd0007931 FORMAT "%5.2" /end MEASUREMENT
/begin MEASUREMENT Astk "optimale Auslassspreizung teilgedrosselt kalt" UBYTE _CNV_R_R_Def_spr_ub_582_CM 1 100. 0. 204. DISPLAY_IDENTIFIER ASTK ECU_ADDRESS 0xd0007932 FORMAT "%5.2" /end MEASUREMENT
/begin MEASUREMENT Astw "optimale Auslassspreizung teilgedrosselt warm" UBYTE _CNV_R_R_Def_spr_ub_582_CM 1 100. 0. 204. DISPLAY_IDENTIFIER ASTW ECU_ADDRESS 0xd0007933 FORMAT "%5.2" /end MEASUREMENT
/begin MEASUREMENT Asw "optimale Auslassspreizung ungedrosselt warm" UBYTE _CNV_R_R_Def_spr_ub_582_CM 1 100. 0. 204. DISPLAY_IDENTIFIER ASW ECU_ADDRESS 0xd0007934 FORMAT "%5.2" /end MEASUREMENT
/begin MEASUREMENT Aswll "optimale Auslassspreizung ungedrosselt warm im Leerlauf" UBYTE _CNV_R_R_Def_spr_ub_582_CM 1 100. 0. 204. DISPLAY_IDENTIFIER ASWLL ECU_ADDRESS 0xd0007935 FORMAT "%5.2" /end MEASUREMENT
/begin MEASUREMENT Batt_index "Batterie Index" UBYTE _CNV_R_R_Def_dez_sl_575_CM 1 100. 0. 255. DISPLAY_IDENTIFIER BATT_INDEX ECU_ADDRESS 0xc00028c6 FORMAT "%3.0" /end MEASUREMENT
/begin MEASUREMENT Bnctrmx1s "" UBYTE _CNV_R_R_Def_dez_sl_575_CM 1 100. 0. 255. DISPLAY_IDENTIFIER BNCTRMX1S ECU_ADDRESS 0xd00072d9 FORMAT "%3.0" /end MEASUREMENT
/begin MEASUREMENT Bnsctr "Counter Bordnetzspannungsplausibilisierung" UBYTE _CNV_R_R_Def_dez_sl_575_CM 1 100. 0. 255. DISPLAY_IDENTIFIER BNSCTR ECU_ADDRESS 0xc0004708 FORMAT "%3.0" /end MEASUREMENT
/begin MEASUREMENT Bnsctrant0 "Counter 1 sec-Anteile ohne Grenzwertüberschreitung" ULONG _CNV_R_R_Def_dez_sl_575_CM 1 100. 0. 4294967295. DISPLAY_IDENTIFIER BNSCTRANT0 ECU_ADDRESS 0xc00046fe FORMAT "%7.0" /end MEASUREMENT
/begin MEASUREMENT Bnsctrant1 "Counter 1 sec-Anteile 1. Bereich" UWORD _CNV_R_R_Def_dez_sl_575_CM 1 100. 0. 65535. DISPLAY_IDENTIFIER BNSCTRANT1 ECU_ADDRESS 0xc0004702 FORMAT "%5.0" /end MEASUREMENT
/begin MEASUREMENT Bnsctrant2 "Counter 1 sec-Anteile 2. Bereich" UWORD _CNV_R_R_Def_dez_sl_575_CM 1 100. 0. 65535. DISPLAY_IDENTIFIER BNSCTRANT2 ECU_ADDRESS 0xc0004704 FORMAT "%5.0" /end MEASUREMENT
/begin MEASUREMENT Bnsctrant3 "Counter 1 sec-Anteile 3. Bereich" UWORD _CNV_R_R_Def_dez_sl_575_CM 1 100. 0. 65535. DISPLAY_IDENTIFIER BNSCTRANT3 ECU_ADDRESS 0xc0004706 FORMAT "%5.0" /end MEASUREMENT
/begin MEASUREMENT C_battnenn "Batteriekapazitaet" UBYTE _CNV_R_R_DEZ_436_CM 1 100. 0. 255. DISPLAY_IDENTIFIER C_BATTNENN ECU_ADDRESS 0xc00028c7 FORMAT "%4.1" /end MEASUREMENT
/begin MEASUREMENT Cbatt_lo "Nennkapazität Batterie, lokal" UBYTE _CNV_R_R_DEZ_436_CM 1 100. 1. 255. DISPLAY_IDENTIFIER CBATT_LO ECU_ADDRESS 0xc0005216 FORMAT "%4.1" /end MEASUREMENT
/begin MEASUREMENT Codiercnt "Internet Zaehler fuer Anfrage Codierung" UBYTE _CNV_R_R_Def_td_ub__593_CM 1 100. 0. 25.5 DISPLAY_IDENTIFIER CODIERCNT ECU_ADDRESS 0xc00028c8 FORMAT "%4.1" /end MEASUREMENT
/begin MEASUREMENT Ctrcbr "Steuerung_Stromzweige" UBYTE _CNV_R_R_Def_dez_sl_575_CM 1 100. 0. 255. DISPLAY_IDENTIFIER CTRCBR ECU_ADDRESS 0xc000294b FORMAT "%3.0" /end MEASUREMENT
/begin MEASUREMENT Ctrcbr7 "lokales ctrcbr" UBYTE _CNV_R_R_Def_dez_sl_575_CM 1 100. 0. 255. DISPLAY_IDENTIFIER CTRCBR7 ECU_ADDRESS 0xc000294c FORMAT "%3.0" /end MEASUREMENT
/begin MEASUREMENT Ctrcbrmem "altes ctrbr" UBYTE _CNV_R_R_Def_dez_sl_575_CM 1 100. 0. 255. DISPLAY_IDENTIFIER CTRCBRMEM ECU_ADDRESS 0xc000294d FORMAT "%3.0" /end MEASUREMENT
/begin MEASUREMENT Ctrpcos "Steuerung_Standverbraucher" UBYTE _CNV_R_R_Def_dez_sl_575_CM 1 100. 0. 3. DISPLAY_IDENTIFIER CTRPCOS ECU_ADDRESS 0xc000294e FORMAT "%3.0" /end MEASUREMENT
/begin MEASUREMENT Ctrpcos7 "lokales ctrpcos" UBYTE _CNV_R_R_Def_dez_sl_575_CM 1 100. 0. 3. DISPLAY_IDENTIFIER CTRPCOS7 ECU_ADDRESS 0xc00046c9 FORMAT "%3.0" /end MEASUREMENT
/begin MEASUREMENT Ctrpcosmem "altes ctrpcos" UBYTE _CNV_R_R_Def_dez_sl_575_CM 1 100. 0. 3. DISPLAY_IDENTIFIER CTRPCOSMEM ECU_ADDRESS 0xc000294f FORMAT "%3.0" /end MEASUREMENT
/begin MEASUREMENT Ctrprio "Steuerung_Spitzenreduzierung_Priorität" UBYTE _CNV_R_R_Def_dez_sl_575_CM 1 100. 0. 7. DISPLAY_IDENTIFIER CTRPRIO ECU_ADDRESS 0xc0002950 FORMAT "%3.0" /end MEASUREMENT
/begin MEASUREMENT Ctrprio7 "lokales ctrprio" UBYTE _CNV_R_R_Def_dez_sl_575_CM 1 100. 0. 7. DISPLAY_IDENTIFIER CTRPRIO7 ECU_ADDRESS 0xc0002951 FORMAT "%3.0" /end MEASUREMENT
/begin MEASUREMENT Ctrpriocf "Steuerung_Spitzenreduzierung_Priorität_Komfort" UBYTE _CNV_R_R_Def_dez_sl_575_CM 1 100. 0. 7. DISPLAY_IDENTIFIER CTRPRIOCF ECU_ADDRESS 0xc0002952 FORMAT "%3.0" /end MEASUREMENT
/begin MEASUREMENT Ctrpriocf7 "lokales ctrpriocf" UBYTE _CNV_R_R_Def_dez_sl_575_CM 1 100. 0. 7. DISPLAY_IDENTIFIER CTRPRIOCF7 ECU_ADDRESS 0xc0002953 FORMAT "%3.0" /end MEASUREMENT
/begin MEASUREMENT Ctrpriocfm "altes ctrpriocf" UBYTE _CNV_R_R_Def_dez_sl_575_CM 1 100. 0. 7. DISPLAY_IDENTIFIER CTRPRIOCFM ECU_ADDRESS 0xc0002954 FORMAT "%3.0" /end MEASUREMENT
/begin MEASUREMENT Ctrpriomem "altes ctrprio" UBYTE _CNV_R_R_Def_dez_sl_575_CM 1 100. 0. 7. DISPLAY_IDENTIFIER CTRPRIOMEM ECU_ADDRESS 0xc0002955 FORMAT "%3.0" /end MEASUREMENT
/begin MEASUREMENT Ctrpwrcf "Komfort-Teil von ctrpwrcos" UWORD _CNV_R_R_Def_dez_sl_575_CM 1 100. 0. 65535. DISPLAY_IDENTIFIER CTRPWRCF ECU_ADDRESS 0xc000291c FORMAT "%5.0" /end MEASUREMENT
/begin MEASUREMENT Ctrpwrcos "Steuerung_Leistung_Verbraucher" UWORD _CNV_R_R_Def_dez_sl_575_CM 1 100. 0. 65535. DISPLAY_IDENTIFIER CTRPWRCOS ECU_ADDRESS 0xc000291e FORMAT "%5.0" /end MEASUREMENT
/begin MEASUREMENT Ctrpwrcos7 "lokales ctrpwrcos" UWORD _CNV_R_R_Def_dez_sl_575_CM 1 100. 0. 65535. DISPLAY_IDENTIFIER CTRPWRCOS7 ECU_ADDRESS 0xc0002920 FORMAT "%5.0" /end MEASUREMENT
/begin MEASUREMENT Ctrpwrdf "df-Teil von ctrpwrcos" UWORD _CNV_R_R_Def_dez_sl_575_CM 1 100. 0. 65535. DISPLAY_IDENTIFIER CTRPWRDF ECU_ADDRESS 0xc0002922 FORMAT "%5.0" /end MEASUREMENT
/begin MEASUREMENT Ctrpwrmem "altes ctrpwrcos" UWORD _CNV_R_R_Def_dez_sl_575_CM 1 100. 0. 65535. DISPLAY_IDENTIFIER CTRPWRMEM ECU_ADDRESS 0xc0002924 FORMAT "%5.0" /end MEASUREMENT
/begin MEASUREMENT Ctrpwspcos "Steuerung_Leistung_Sonderverbraucher" UBYTE _CNV_R_R_Def_f_ub_b_595_CM 1 100. 0. 127.5 DISPLAY_IDENTIFIER CTRPWSPCOS ECU_ADDRESS 0xc0002956 FORMAT "%5.2" /end MEASUREMENT
/begin MEASUREMENT D_qelad "Delta Kapazität entladen" UWORD _CNV_R_R_Def_ql_uw__596_CM 1 100. 0. 1193.0282 DISPLAY_IDENTIFIER D_QELAD ECU_ADDRESS 0xc000520c FORMAT "%8.3" /end MEASUREMENT
/begin MEASUREMENT D_qlad "Delta Kapazität geladen" UWORD _CNV_R_R_Def_ql_uw__596_CM 1 100. 0. 1193.0282 DISPLAY_IDENTIFIER D_QLAD ECU_ADDRESS 0xc000520e FORMAT "%8.3" /end MEASUREMENT
/begin MEASUREMENT D_soc "Abstand zur Startfähigkeitsgrenze" SWORD _CNV_R_R_Def_f_sw_b_597_CM 1 100. -100. 99.9969 DISPLAY_IDENTIFIER D_SOC ECU_ADDRESS 0xc00046e2 FORMAT "%8.3" /end MEASUREMENT
/begin MEASUREMENT D_socw "Delta SoC" SWORD _CNV_R_R_Def_f_sw_b_597_CM 1 100. -100. 99.9969 DISPLAY_IDENTIFIER D_SOCW ECU_ADDRESS 0xc0005224 FORMAT "%8.3" /end MEASUREMENT
/begin MEASUREMENT D_udtptc "Spannungsdifferenz in 10ms" SBYTE _CNV_R_R_Def_u_sb_q_598_CM 1 100. -12.0576 11.9634 DISPLAY_IDENTIFIER D_UDTPTC ECU_ADDRESS 0xc000294a FORMAT "%7.4" /end MEASUREMENT
/begin MEASUREMENT Deltadff "Gradient des vom Generator empfangenen Lastsignals" SBYTE _CNV_R_R_Def_f_sb_b_600_CM 1 100. -64. 63.5 DISPLAY_IDENTIFIER DELTADFF ECU_ADDRESS 0xc000524e FORMAT "%5.2" /end MEASUREMENT
/begin MEASUREMENT Df2pi "DF-Gewichtung auf Prios" SWORD _CNV_R_R_Def_f_sw_p_581_CM 1 100. -100. 100. DISPLAY_IDENTIFIER DF2PI ECU_ADDRESS 0xc00028f6 FORMAT "%7.2" /end MEASUREMENT
/begin MEASUREMENT Dfall2pi "Gesamtgewichtung auf Prios" SWORD _CNV_R_R_Def_f_sw_p_581_CM 1 100. -500. 500. DISPLAY_IDENTIFIER DFALL2PI ECU_ADDRESS 0xc00028f8 FORMAT "%7.2" /end MEASUREMENT
/begin MEASUREMENT Dfallpi "PI-Geregelte Gesamtgewichtung auf Prios" UWORD _CNV_R_R_Def_f_sw_p_581_CM 1 100. 0. 450. DISPLAY_IDENTIFIER DFALLPI ECU_ADDRESS 0xc0002926 FORMAT "%8.3" /end MEASUREMENT
/begin MEASUREMENT Dff_filt7 "lokales dffgenflit" UBYTE _CNV_R_R_Def_f_ub_b_602_CM 1 100. 0. 99.60930000000001 DISPLAY_IDENTIFIER DFF_FILT7 ECU_ADDRESS 0xc0002957 FORMAT "%5.2" /end MEASUREMENT
/begin MEASUREMENT Dffgenschz "Zähler für Generatorlastschwnkungen zur Leerlauf-Solldrehzahlanhebung" UBYTE _CNV_R_R_Def_dez_sl_575_CM 1 100. 0. 255. DISPLAY_IDENTIFIER DFFGENSCHZ ECU_ADDRESS 0xc000524f FORMAT "%3.0" /end MEASUREMENT
/begin MEASUREMENT Dfgenfilt "Über PT-1 gefiltertes dffgen-Signal" UBYTE _CNV_R_R_Def_f_ub_b_602_CM 1 100. 0. 99.60930000000001 DISPLAY_IDENTIFIER DFGENFILT ECU_ADDRESS 0xc0002958 FORMAT "%5.2" /end MEASUREMENT
/begin MEASUREMENT Dfpi2ptc "Gewichtung der Prios -> Gewichtung für PTC Ansteuerung" SWORD _CNV_R_R_Def_f_sw_p_581_CM 1 100. -100. 100. DISPLAY_IDENTIFIER DFPI2PTC ECU_ADDRESS 0xc00028fa FORMAT "%7.2" /end MEASUREMENT
/begin MEASUREMENT Dfprio "" UWORD _CNV_R_R_Def_f_sw_p_581_CM 1 100. 0. 450. DISPLAY_IDENTIFIER DFPRIO ECU_ADDRESS 0xc0002928 FORMAT "%8.3" /end MEASUREMENT
/begin MEASUREMENT Dfpt1_2ptc "gefiltertes dffgen Gewichtung auf PTC-Ansteuerung" SWORD _CNV_R_R_Def_f_sw_p_581_CM 1 100. -100. 100. DISPLAY_IDENTIFIER DFPT1_2PTC ECU_ADDRESS 0xc00028fc FORMAT "%7.2" /end MEASUREMENT
/begin MEASUREMENT Dfpt1filt "Wert nach DF-Tiefpass Prio" UBYTE _CNV_R_R_Def_f_ub_b_602_CM 1 100. 0. 99.60930000000001 DISPLAY_IDENTIFIER DFPT1FILT ECU_ADDRESS 0xc0002959 FORMAT "%5.2" /end MEASUREMENT
/begin MEASUREMENT Dfpt1ptc "Wert nach DFFGEN-Filter PTC" UBYTE _CNV_R_R_Def_f_ub_b_602_CM 1 100. 0. 99.60930000000001 DISPLAY_IDENTIFIER DFPT1PTC ECU_ADDRESS 0xc000295a FORMAT "%5.2" /end MEASUREMENT
/begin MEASUREMENT Dnkw "Drehzahlabweichung bei Leerlaufregelung" SWORD _CNV_R_R_Def_n_sw_q_612_CM 1 100. -32768. 32767. DISPLAY_IDENTIFIER DNKW ECU_ADDRESS 0xc000524a FORMAT "%5.0" /end MEASUREMENT
/begin MEASUREMENT Dqelad7 "diff = qelad-qeladold7" UWORD _CNV_R_R_Def_ql_uw__615_CM 1 100. 0. 19088.4522 DISPLAY_IDENTIFIER DQELAD7 ECU_ADDRESS 0xc00028b0 FORMAT "%7.2" /end MEASUREMENT
/begin MEASUREMENT Dqlad7 "diff = qlad-qladold7" UWORD _CNV_R_R_Def_ql_uw__615_CM 1 100. 0. 19088.4522 DISPLAY_IDENTIFIER DQLAD7 ECU_ADDRESS 0xc00028b2 FORMAT "%7.2" /end MEASUREMENT
/begin MEASUREMENT Dsoc2pi "Batterieladezustand-Gewichtung auf Prios" SWORD _CNV_R_R_Def_f_sw_p_581_CM 1 100. -150. 150. DISPLAY_IDENTIFIER DSOC2PI ECU_ADDRESS 0xc00028fe FORMAT "%7.2" /end MEASUREMENT
/begin MEASUREMENT Dsoc2ptc "dsoc Gewichtung auf PTC-Ansteuerung" SWORD _CNV_R_R_Def_f_sw_p_581_CM 1 100. -150. 150. DISPLAY_IDENTIFIER DSOC2PTC ECU_ADDRESS 0xc0002900 FORMAT "%7.2" /end MEASUREMENT
/begin MEASUREMENT Dudtmul "PTC dudt : gewichtetes Dudt" SWORD _CNV_R_R_Def_f_sw_q_621_CM 1 100. -48.2304 48.2289 DISPLAY_IDENTIFIER DUDTMUL ECU_ADDRESS 0xc0002902 FORMAT "%9.4" /end MEASUREMENT
/begin MEASUREMENT Dvsa_ramp "" SWORD _CNV_R_R_Def_spr_sw_583_CM 1 100. -3276.8 3276.7 DISPLAY_IDENTIFIER DVSA_RAMP ECU_ADDRESS 0xd0007912 FORMAT "%7.2" /end MEASUREMENT
/begin MEASUREMENT Dvse_ramp "" SWORD _CNV_R_R_Def_spr_sw_583_CM 1 100. -3276.8 3276.7 DISPLAY_IDENTIFIER DVSE_RAMP ECU_ADDRESS 0xd0007910 FORMAT "%7.2" /end MEASUREMENT
/begin MEASUREMENT Ellk "Leerlaufeinlassspreizung gedrosselt kalt zum Katheizen" UBYTE _CNV_R_R_Def_spr_ub_582_CM 1 100. 0. 204. DISPLAY_IDENTIFIER ELLK ECU_ADDRESS 0xd0007936 FORMAT "%5.2" /end MEASUREMENT
/begin MEASUREMENT Ellw "Leerlaufeinlassspreizung gedrosselt warm zum Katheizen" UBYTE _CNV_R_R_Def_spr_ub_582_CM 1 100. 0. 204. DISPLAY_IDENTIFIER ELLW ECU_ADDRESS 0xd0007937 FORMAT "%5.2" /end MEASUREMENT
/begin MEASUREMENT Esk "optimale Einlassspreizung ungedrosselt kalt" UBYTE _CNV_R_R_Def_spr_ub_582_CM 1 100. 0. 204. DISPLAY_IDENTIFIER ESK ECU_ADDRESS 0xd0007938 FORMAT "%5.2" /end MEASUREMENT
/begin MEASUREMENT Espr "Sollwert Einlassspreizung" UBYTE _CNV_R_R_Def_spr_ub_582_CM 1 100. 0. 204. DISPLAY_IDENTIFIER ESPR ECU_ADDRESS 0xd000790d FORMAT "%5.2" /end MEASUREMENT
/begin MEASUREMENT Espr_last "" UBYTE _CNV_R_R_Def_spr_ub_582_CM 1 100. 0. 204. DISPLAY_IDENTIFIER ESPR_LAST ECU_ADDRESS 0xd0007924 FORMAT "%5.2" /end MEASUREMENT
/begin MEASUREMENT Espr_norm "" UBYTE _CNV_R_R_Def_spr_ub_582_CM 1 100. 0. 204. DISPLAY_IDENTIFIER ESPR_NORM ECU_ADDRESS 0xd000791e FORMAT "%5.2" /end MEASUREMENT
/begin MEASUREMENT Espr_ramp "" SWORD _CNV_R_R_Def_spr_sw_583_CM 1 100. 0. 180. DISPLAY_IDENTIFIER ESPR_RAMP ECU_ADDRESS 0xd0007958 FORMAT "%7.2" /end MEASUREMENT
/begin MEASUREMENT Espr_vl1 "" UBYTE _CNV_R_R_Def_spr_ub_582_CM 1 100. 0. 204. DISPLAY_IDENTIFIER ESPR_VL1 ECU_ADDRESS 0xd0007920 FORMAT "%5.2" /end MEASUREMENT
/begin MEASUREMENT Espr_vl2 "" UBYTE _CNV_R_R_Def_spr_ub_582_CM 1 100. 0. 204. DISPLAY_IDENTIFIER ESPR_VL2 ECU_ADDRESS 0xd0007921 FORMAT "%5.2" /end MEASUREMENT
/begin MEASUREMENT Espr_vs "" UWORD _CNV_R_R_Def_spr_sw_583_CM 1 100. 0. 6553.5 DISPLAY_IDENTIFIER ESPR_VS ECU_ADDRESS 0xd0007954 FORMAT "%7.2" /end MEASUREMENT
/begin MEASUREMENT Esprhs "Einlassspreizung Teillast, Homogen_Schicht" UBYTE _CNV_R_R_Def_spr_ub_582_CM 1 100. 0. 204. DISPLAY_IDENTIFIER ESPRHS ECU_ADDRESS 0xd0007950 FORMAT "%5.2" /end MEASUREMENT
/begin MEASUREMENT Esprimx "Max. der Isteinlassspreizung" UWORD _CNV_R_R_Def_spr_sw_583_CM 1 100. 0. 6553.5 DISPLAY_IDENTIFIER ESPRIMX ECU_ADDRESS 0xd000793a FORMAT "%7.2" /end MEASUREMENT
/begin MEASUREMENT Esprl "Einlassspreizung im Leerlauf gedrosselt" UBYTE _CNV_R_R_Def_spr_ub_582_CM 1 100. 0. 204. DISPLAY_IDENTIFIER ESPRL ECU_ADDRESS 0xd000790a FORMAT "%5.2" /end MEASUREMENT
/begin MEASUREMENT Esprlast "" UBYTE _CNV_R_R_Def_spr_ub_582_CM 1 100. 0. 204. DISPLAY_IDENTIFIER ESPRLAST ECU_ADDRESS 0xd0007925 FORMAT "%5.2" /end MEASUREMENT
/begin MEASUREMENT Esprlhs "Einlassspreizung Leerlauf, Homogen_Schicht" UBYTE _CNV_R_R_Def_spr_ub_582_CM 1 100. 0. 204. DISPLAY_IDENTIFIER ESPRLHS ECU_ADDRESS 0xd000794f FORMAT "%5.2" /end MEASUREMENT
/begin MEASUREMENT Esprll "" UBYTE _CNV_R_R_Def_spr_ub_582_CM 1 100. 0. 204. DISPLAY_IDENTIFIER ESPRLL ECU_ADDRESS 0xd0007928 FORMAT "%5.2" /end MEASUREMENT
/begin MEASUREMENT Esprll_kh "KH-Spreizung EINLASS-LL" UBYTE _CNV_R_R_Def_spr_ub_582_CM 1 100. 0. 204. DISPLAY_IDENTIFIER ESPRLL_KH ECU_ADDRESS 0xd000791a FORMAT "%5.2" /end MEASUREMENT
/begin MEASUREMENT Esprlu "Einlassspreizung im Leerlauf ungedrosselt" UBYTE _CNV_R_R_Def_spr_ub_582_CM 1 100. 0. 204. DISPLAY_IDENTIFIER ESPRLU ECU_ADDRESS 0xd000790b FORMAT "%5.2" /end MEASUREMENT
/begin MEASUREMENT Esprt "Einlassspreizung teilgedrosselt" UBYTE _CNV_R_R_Def_spr_ub_582_CM 1 100. 0. 204. DISPLAY_IDENTIFIER ESPRT ECU_ADDRESS 0xd000793c FORMAT "%5.2" /end MEASUREMENT
/begin MEASUREMENT Esprtl_kh "KH-Spreizung EINLASS-TL" UBYTE _CNV_R_R_Def_spr_ub_582_CM 1 100. 0. 204. DISPLAY_IDENTIFIER ESPRTL_KH ECU_ADDRESS 0xd000791b FORMAT "%5.2" /end MEASUREMENT
/begin MEASUREMENT Espru "Einlassspreizung ungedrosselt" UBYTE _CNV_R_R_Def_spr_ub_582_CM 1 100. 0. 204. DISPLAY_IDENTIFIER ESPRU ECU_ADDRESS 0xd000793d FORMAT "%5.2" /end MEASUREMENT
/begin MEASUREMENT Estk "optimale Einlassspreizung teilgedrosselt kalt" UBYTE _CNV_R_R_Def_spr_ub_582_CM 1 100. 0. 204. DISPLAY_IDENTIFIER ESTK ECU_ADDRESS 0xd000793e FORMAT "%5.2" /end MEASUREMENT
/begin MEASUREMENT Estw "optimale Einlassspreizung teilgedrosselt warm" UBYTE _CNV_R_R_Def_spr_ub_582_CM 1 100. 0. 204. DISPLAY_IDENTIFIER ESTW ECU_ADDRESS 0xd000793f FORMAT "%5.2" /end MEASUREMENT
/begin MEASUREMENT Esw "optimale Einlassspreizung ungedrosselt warm" UBYTE _CNV_R_R_Def_spr_ub_582_CM 1 100. 0. 204. DISPLAY_IDENTIFIER ESW ECU_ADDRESS 0xd0007940 FORMAT "%5.2" /end MEASUREMENT
/begin MEASUREMENT Eswll "optimale Einlassspreizung ungedrosselt warm im Leerlauf" UBYTE _CNV_R_R_Def_spr_ub_582_CM 1 100. 0. 204. DISPLAY_IDENTIFIER ESWLL ECU_ADDRESS 0xd0007941 FORMAT "%5.2" /end MEASUREMENT
/begin MEASUREMENT Eta_mdkh "Wirkungsgrad bei Katheizen" SWORD _CNV_R_R_Def_eta_sw_628_CM 1 100. 0. 100. DISPLAY_IDENTIFIER ETA_MDKH ECU_ADDRESS 0xc0005254 FORMAT "%8.3" /end MEASUREMENT
/begin MEASUREMENT F_dudtptc "Inkrement auf Ptc_pwr aufgrund du/dt" UWORD _CNV_R_R_Def_f_sw_p_581_CM 1 100. 0. 550. DISPLAY_IDENTIFIER F_DUDTPTC ECU_ADDRESS 0xc000292a FORMAT "%8.3" /end MEASUREMENT
/begin MEASUREMENT F_easwll "" UBYTE _CNV_R_R_Def_f_ub_b_573_CM 1 100. 0. 0.996 DISPLAY_IDENTIFIER F_EASWLL ECU_ADDRESS 0xc0005250 /end MEASUREMENT
/begin MEASUREMENT F_easwll_hs "" UBYTE _CNV_R_R_Def_f_ub_b_573_CM 1 100. 0. 0.996 DISPLAY_IDENTIFIER F_EASWLL_HS ECU_ADDRESS 0xd000794c /end MEASUREMENT
/begin MEASUREMENT F_wnwkh "" UBYTE _CNV_R_R_Def_f_ub_b_573_CM 1 100. 0. 0.996 DISPLAY_IDENTIFIER F_WNWKH ECU_ADDRESS 0xc0005253 /end MEASUREMENT
/begin MEASUREMENT F_wnwkh_aus "" UBYTE _CNV_R_R_Def_f_ub_b_573_CM 1 100. 0. 0.996 DISPLAY_IDENTIFIER F_WNWKH_AUS ECU_ADDRESS 0xc0005256 /end MEASUREMENT
/begin MEASUREMENT F_wnwkhk "" UBYTE _CNV_R_R_Def_f_ub_b_573_CM 1 100. 0. 0.996 DISPLAY_IDENTIFIER F_WNWKHK ECU_ADDRESS 0xc0005251 /end MEASUREMENT
/begin MEASUREMENT F_wnwkhk_2 "" UBYTE _CNV_R_R_Def_f_ub_b_573_CM 1 100. 0. 0.996 DISPLAY_IDENTIFIER F_WNWKHK_2 ECU_ADDRESS 0xc0005252 /end MEASUREMENT
/begin MEASUREMENT Fashsw_aus "" UBYTE _CNV_R_R_Def_f_ub_b_573_CM 1 100. 0. 0.996 DISPLAY_IDENTIFIER FASHSW_AUS ECU_ADDRESS 0xd000794e /end MEASUREMENT
/begin MEASUREMENT Fastw_aus "Faktor Auslass teilgedrosselt" UBYTE _CNV_R_R_Def_f_ub_b_573_CM 1 100. 0. 0.996 DISPLAY_IDENTIFIER FASTW_AUS ECU_ADDRESS 0xc0005257 /end MEASUREMENT
/begin MEASUREMENT Fasw_aus "Faktor Auslass ungedrosselt" UBYTE _CNV_R_R_Def_f_ub_b_573_CM 1 100. 0. 0.996 DISPLAY_IDENTIFIER FASW_AUS ECU_ADDRESS 0xc0005259 /end MEASUREMENT
/begin MEASUREMENT Feshsw_aus "" UBYTE _CNV_R_R_Def_f_ub_b_573_CM 1 100. 0. 0.996 DISPLAY_IDENTIFIER FESHSW_AUS ECU_ADDRESS 0xd000794d /end MEASUREMENT
/begin MEASUREMENT Festw_aus "Faktor Einlass teilgedrosselt" UBYTE _CNV_R_R_Def_f_ub_b_573_CM 1 100. 0. 0.996 DISPLAY_IDENTIFIER FESTW_AUS ECU_ADDRESS 0xc0005258 /end MEASUREMENT
/begin MEASUREMENT Fesw_aus "Faktor Einlass ungedrosselt" UBYTE _CNV_R_R_Def_f_ub_b_573_CM 1 100. 0. 0.996 DISPLAY_IDENTIFIER FESW_AUS ECU_ADDRESS 0xc000525a /end MEASUREMENT
/begin MEASUREMENT Fs_pm "Fehlerspeicher Powermanagement, Bitcodiert" UBYTE _CNV_R_R_Def_dez_sl_575_CM 1 100. 0. 255. DISPLAY_IDENTIFIER FS_PM ECU_ADDRESS 0xc00046a4 FORMAT "%3.0" /end MEASUREMENT
/begin MEASUREMENT Ib_commcnt "Zähler Taskaufrufe zwischen periodischer Abfrage qlad und qelad" UBYTE _CNV_R_R_Def_dez_sl_575_CM 1 100. 0. 255. DISPLAY_IDENTIFIER IB_COMMCNT ECU_ADDRESS 0xc0005217 FORMAT "%3.0" /end MEASUREMENT
/begin MEASUREMENT Ib_commsta "Statemaschine zeiger zur Abfrage qlad und qelad" UBYTE _CNV_R_R_Def_dez_sl_575_CM 1 100. 0. 255. DISPLAY_IDENTIFIER IB_COMMSTA ECU_ADDRESS 0xc0005218 FORMAT "%3.0" /end MEASUREMENT
/begin MEASUREMENT Ibsbor_hb "highbyte ibsborctr" UBYTE _CNV_R_R_Def_dez_sl_575_CM 1 100. 0. 255. DISPLAY_IDENTIFIER IBSBOR_HB ECU_ADDRESS 0xc00028c9 FORMAT "%3.0" /end MEASUREMENT
/begin MEASUREMENT Ibtdiff "Delta Ibtsoll-Ibatt" UWORD _CNV_R_R_Def_i_uw_q_642_CM 1 100. -200. 5042.8 DISPLAY_IDENTIFIER IBTDIFF ECU_ADDRESS 0xc000292c FORMAT "%8.3" /end MEASUREMENT
/begin MEASUREMENT Ibtdiff2pi "Batterie-soll-strom Gewichtung auf Prios" SWORD _CNV_R_R_Def_f_sw_p_581_CM 1 100. -100. 100. DISPLAY_IDENTIFIER IBTDIFF2PI ECU_ADDRESS 0xc0002904 FORMAT "%7.2" /end MEASUREMENT
/begin MEASUREMENT Ibtsoll "Sollstrom aufgrund von tbatt und dsoc" UWORD _CNV_R_R_Def_i_uw_q_642_CM 1 100. -200. 5042.8 DISPLAY_IDENTIFIER IBTSOLL ECU_ADDRESS 0xc000292e FORMAT "%8.3" /end MEASUREMENT
/begin MEASUREMENT Ideltaabs "Differenz der Startströme" UWORD _CNV_R_R_Def_i_uw_q_648_CM 1 100. 2.e-002 1310.7 DISPLAY_IDENTIFIER IDELTAABS ECU_ADDRESS 0xc0002996 FORMAT "%8.3" /end MEASUREMENT
/begin MEASUREMENT Idiff2ptc "idiff Gewichtung auf die PTC-Ansteuerung" SWORD _CNV_R_R_Def_f_sw_p_581_CM 1 100. -100. 100. DISPLAY_IDENTIFIER IDIFF2PTC ECU_ADDRESS 0xc0002906 FORMAT "%7.2" /end MEASUREMENT
/begin MEASUREMENT Ierrgrenz_ll "Grenzerregerstrombegrenzung Generator" UBYTE _CNV_R_R_Def_i_ub_q_645_CM 1 100. 0. 31.875 DISPLAY_IDENTIFIER IERRGRENZ_LL ECU_ADDRESS 0xd00072e1 /end MEASUREMENT
/begin MEASUREMENT Igenrest "Generatorreststrom modelliert" UBYTE _CNV_R_R_DEZ_436_CM 1 100. 0. 255. DISPLAY_IDENTIFIER IGENREST ECU_ADDRESS 0xc000295b /end MEASUREMENT
/begin MEASUREMENT Ikurz_ogrz "Obere Grenze Kurzschlußstrom" UBYTE _CNV_R_R_Def_i_ub_q_651_CM 1 100. 0. 2550. DISPLAY_IDENTIFIER IKURZ_OGRZ ECU_ADDRESS 0xc00028ca FORMAT "%5.2" /end MEASUREMENT
/begin MEASUREMENT Ikurz_ugrz "Untere Grenze Kurzschlußstrom" UBYTE _CNV_R_R_Def_i_ub_q_651_CM 1 100. 0. 2550. DISPLAY_IDENTIFIER IKURZ_UGRZ ECU_ADDRESS 0xc00028cb FORMAT "%5.2" /end MEASUREMENT
/begin MEASUREMENT Ipmdfprio "lokale Prioberechnungsvariable bei IPM aktiv" UWORD _CNV_R_R_Def_f_sw_p_581_CM 1 100. 0. 450. DISPLAY_IDENTIFIER IPMDFPRIO ECU_ADDRESS 0xc0002930 FORMAT "%8.3" /end MEASUREMENT
/begin MEASUREMENT Isoc0loc "Batteriestrom zum Zeitpunkt der Ruhespannungsmessung (lokal)" SWORD _CNV_R_R_Def_i_sw_q_647_CM 1 100. -655.36 655.34 DISPLAY_IDENTIFIER ISOC0LOC ECU_ADDRESS 0xc0005208 FORMAT "%8.3" /end MEASUREMENT
/begin MEASUREMENT Isolldiff "Differenz isoll - ibatt_w für PTC Ansteuerung" UWORD _CNV_R_R_Def_i_uw_q_642_CM 1 100. -200. 5042.8 DISPLAY_IDENTIFIER ISOLLDIFF ECU_ADDRESS 0xc0002932 FORMAT "%8.3" /end MEASUREMENT
/begin MEASUREMENT Iwakeupgrz "Ruhestromverletzungsgrenze, ab hier weckt u.U. das IBS." UBYTE _CNV_R_R_Def_i_ub_q_652_CM 1 100. 0. 0.255 DISPLAY_IDENTIFIER IWAKEUPGRZ ECU_ADDRESS 0xc00028cc /end MEASUREMENT
/begin MEASUREMENT Kalevcnt "Anzahl der Ruhespannungsmessungen" UBYTE _CNV_R_R_Def_dez_sl_575_CM 1 100. 0. 255. DISPLAY_IDENTIFIER KALEVCNT ECU_ADDRESS 0xc0005219 FORMAT "%3.0" /end MEASUREMENT
/begin MEASUREMENT Memprio1 "memory 1 PI-Regler dfall2pi E60Prio" UWORD _CNV_R_R_Def_f_uw_b_636_CM 1 100. 0. 511.9921 DISPLAY_IDENTIFIER MEMPRIO1 ECU_ADDRESS 0xc0002934 FORMAT "%8.3" /end MEASUREMENT
/begin MEASUREMENT Memprio2 "memory 2 PI-Regler dfall2pi E60Prio" UWORD _CNV_R_R_Def_f_uw_b_636_CM 1 100. 0. 511.9921 DISPLAY_IDENTIFIER MEMPRIO2 ECU_ADDRESS 0xc0002936 FORMAT "%8.3" /end MEASUREMENT
/begin MEASUREMENT Memptc1 "memory 1 PI-Regler all2ptc PTC" UWORD _CNV_R_R_Def_f_uw_b_636_CM 1 100. 0. 511.9921 DISPLAY_IDENTIFIER MEMPTC1 ECU_ADDRESS 0xc0002938 FORMAT "%8.3" /end MEASUREMENT
/begin MEASUREMENT Memptc2 "memory 2 PI-Regler all2ptc PTC" UWORD _CNV_R_R_Def_f_uw_b_636_CM 1 100. 0. 511.9921 DISPLAY_IDENTIFIER MEMPTC2 ECU_ADDRESS 0xc000293a FORMAT "%8.3" /end MEASUREMENT
/begin MEASUREMENT Nnmstart "Motordrehzahl nach Motorstart" SWORD _CNV_R_R_Def_n_sw_q_612_CM 1 100. -32768. 32767. DISPLAY_IDENTIFIER NNMSTART ECU_ADDRESS 0xd000729e FORMAT "%5.0" /end MEASUREMENT
/begin MEASUREMENT Ospgcnt "fs_Oberspannungscounter" UBYTE _CNV_R_R_Def_td_ub__593_CM 1 100. 0. 25.5 DISPLAY_IDENTIFIER OSPGCNT ECU_ADDRESS 0xc00028cd FORMAT "%4.1" /end MEASUREMENT
/begin MEASUREMENT Ospgprell "Anzahl der entprellten FS_Oberspannungserkennung" UBYTE _CNV_R_R_Def_dez_sl_575_CM 1 100. 0. 255. DISPLAY_IDENTIFIER OSPGPRELL ECU_ADDRESS 0xc00028ce FORMAT "%3.0" /end MEASUREMENT
/begin MEASUREMENT Ospgstat "Status Oberspannungserkennung" UBYTE _CNV_R_R_Def_dez_sl_575_CM 1 100. 0. 255. DISPLAY_IDENTIFIER OSPGSTAT ECU_ADDRESS 0xc00028cf FORMAT "%3.0" /end MEASUREMENT
/begin MEASUREMENT P_oel_diff "Öldruck Regeldifferenz" SWORD _CNV_R_R_Def_p_sw_q_683_CM 1 100. -32768. 32767. DISPLAY_IDENTIFIER P_OEL_DIFF ECU_ADDRESS 0xd0006b3a FORMAT "%6.1" /end MEASUREMENT
/begin MEASUREMENT P_oel_modell "Öldruck Istwert (aus Modell)" UWORD _CNV_R_R_Def_p_sw_q_683_CM 1 100. 0. 65535. DISPLAY_IDENTIFIER P_OEL_MODELL ECU_ADDRESS 0xd0006b38 FORMAT "%6.1" /end MEASUREMENT
/begin MEASUREMENT P_oel_soll "Öldruck Sollwert" UWORD _CNV_R_R_Def_p_sw_q_683_CM 1 100. 0. 65535. DISPLAY_IDENTIFIER P_OEL_SOLL ECU_ADDRESS 0xd0006b2e FORMAT "%6.1" /end MEASUREMENT
/begin MEASUREMENT P_oelist_f "Öldruck Istwert gefiltert" UWORD _CNV_R_R_Def_p_sw_q_683_CM 1 100. 0. 65535. DISPLAY_IDENTIFIER P_OELIST_F ECU_ADDRESS 0xd0006b3c FORMAT "%6.1" /end MEASUREMENT
/begin MEASUREMENT P_oelsol_kf "Öldruck Sollwert direkt aus Kennfeld" UWORD _CNV_R_R_Def_p_sw_q_683_CM 1 100. 0. 65535. DISPLAY_IDENTIFIER P_OELSOL_KF ECU_ADDRESS 0xd0006b36 FORMAT "%6.1" /end MEASUREMENT
/begin MEASUREMENT P_oelsoldiag "Öldruck Sollwert gefiltert für Diagnose (Dynamikerkennung)" UWORD _CNV_R_R_Def_p_sw_q_683_CM 1 100. 0. 65535. DISPLAY_IDENTIFIER P_OELSOLDIAG ECU_ADDRESS 0xd0006b3e FORMAT "%6.1" /end MEASUREMENT
/begin MEASUREMENT Pgen2ptc "Gewichtung der Generatorrestleistung für PTC-Ansteuerung" SWORD _CNV_R_R_Def_f_sw_p_581_CM 1 100. -100. 100. DISPLAY_IDENTIFIER PGEN2PTC ECU_ADDRESS 0xc0002908 FORMAT "%7.2" /end MEASUREMENT
/begin MEASUREMENT Pgenrest "Generatorrestleistung (igenrest*ubatt_w)" UWORD _CNV_R_R_Def_f_sw_p_581_CM 1 100. 0. 6400. DISPLAY_IDENTIFIER PGENREST ECU_ADDRESS 0xc000293c FORMAT "%8.3" /end MEASUREMENT
/begin MEASUREMENT Picntr "Counter fuer PI-Reset" UBYTE _CNV_R_R_Def_td_ub__593_CM 1 100. 0. 25.5 DISPLAY_IDENTIFIER PICNTR ECU_ADDRESS 0xc000295c FORMAT "%4.1" /end MEASUREMENT
/begin MEASUREMENT Pm_klemmstat "Umweltbed. Klemmenstatus" UBYTE _CNV_R_R_Def_dez_sl_575_CM 1 100. 0. 255. DISPLAY_IDENTIFIER PM_KLEMMSTAT ECU_ADDRESS 0xc00028d0 FORMAT "%3.0" /end MEASUREMENT
/begin MEASUREMENT Pm_tsrdy "Status Berechnung Tsaison" UBYTE _CNV_R_R_Def_dez_sl_575_CM 1 100. 0. 1. DISPLAY_IDENTIFIER PM_TSRDY ECU_ADDRESS 0xc00046f0 FORMAT "%4.1" /end MEASUREMENT
/begin MEASUREMENT Pmbscount "zyklisches Senden entspricht 5 sek" UBYTE _CNV_R_R_Def_dez_sl_575_CM 1 100. 0. 255. DISPLAY_IDENTIFIER PMBSCOUNT ECU_ADDRESS 0xc000295d FORMAT "%3.0" /end MEASUREMENT
/begin MEASUREMENT Pminfo1 "Infospeicher 1 vom Powermanagement" UWORD _CNV_R_R_Def_dez_sl_575_CM 1 100. 0. 65535. DISPLAY_IDENTIFIER PMINFO1 ECU_ADDRESS 0xc0004654 FORMAT "%5.0" ARRAY_SIZE 37 MATRIX_DIM 37 1 1 /end MEASUREMENT
/begin MEASUREMENT Pminfo2 "Fehlerinfo2 vom Powermanagement" UBYTE _CNV_R_R_Def_dez_sl_575_CM 1 100. 0. 255. DISPLAY_IDENTIFIER PMINFO2 ECU_ADDRESS 0xc00046a8 FORMAT "%3.0" ARRAY_SIZE 29 MATRIX_DIM 29 1 1 /end MEASUREMENT
/begin MEASUREMENT Pmstartsta "Schalter für Ablaufsteuerung" UBYTE _CNV_R_R_Def_dez_sl_575_CM 1 100. 0. 255. DISPLAY_IDENTIFIER PMSTARTSTA ECU_ADDRESS 0xc000299a FORMAT "%3.0" /end MEASUREMENT
/begin MEASUREMENT Pmvscount "Zähler bis zum nächsten zyklischen Senden von 3b3" UBYTE _CNV_R_R_Def_dez_sl_575_CM 1 100. 0. 255. DISPLAY_IDENTIFIER PMVSCOUNT ECU_ADDRESS 0xc000295e FORMAT "%3.0" /end MEASUREMENT
/begin MEASUREMENT Poelad_array "Adaptionswerte Array" SWORD _CNV_R_R_Def_f_uw_b_579_CM 1 100. -1. 0.9999 DISPLAY_IDENTIFIER POELAD_ARRAY ECU_ADDRESS 0xc000411c FORMAT "%14.5" ARRAY_SIZE 9 MATRIX_DIM 3 3 1 /end MEASUREMENT
/begin MEASUREMENT Poelad_idx_n "Idx Bereichsadaption Öldruckregler Achse Nkw" UBYTE _CNV_R_R_Def_dez_sl_575_CM 1 100. 0. 255. DISPLAY_IDENTIFIER POELAD_IDX_N ECU_ADDRESS 0xd0006b33 FORMAT "%3.0" /end MEASUREMENT
/begin MEASUREMENT Poelad_idx_t "Idx Bereichsadaption Öldruckregler Achse Toel" UBYTE _CNV_R_R_Def_dez_sl_575_CM 1 100. 0. 255. DISPLAY_IDENTIFIER POELAD_IDX_T ECU_ADDRESS 0xd0006b32 FORMAT "%3.0" /end MEASUREMENT
/begin MEASUREMENT Poeldiag "Integratorwert Regler-Eingang" SWORD _CNV_R_R_Def_p_sw_q_683_CM 1 100. -32768. 32767. DISPLAY_IDENTIFIER POELDIAG ECU_ADDRESS 0xd0006b50 FORMAT "%6.1" /end MEASUREMENT
/begin MEASUREMENT Poeldiag_abs "Integratorwert Regler-Eingang (Absolutwert aufintegriert)" UWORD _CNV_R_R_Def_p_sw_q_683_CM 1 100. 0. 65535. DISPLAY_IDENTIFIER POELDIAG_ABS ECU_ADDRESS 0xd0006b52 FORMAT "%6.1" /end MEASUREMENT
/begin MEASUREMENT Poeldiag_quot "Quotient aus Poeldiag und Poeldiag_abs" UWORD _CNV_R_R_Def_f_uw_b_579_CM 1 100. 0. 1.9999 DISPLAY_IDENTIFIER POELDIAG_QUOT ECU_ADDRESS 0xd0006b54 FORMAT "%14.5" /end MEASUREMENT
/begin MEASUREMENT Poelreg_ad "Öldruck-Regler Adaptionswert" SWORD _CNV_R_R_Def_f_uw_b_579_CM 1 100. -1. 0.9999 DISPLAY_IDENTIFIER POELREG_AD ECU_ADDRESS 0xd0006b44 FORMAT "%14.5" /end MEASUREMENT
/begin MEASUREMENT Poelreg_d "Öldruck-Regler D-Anteil" SWORD _CNV_R_R_Def_f_uw_b_579_CM 1 100. -1. 0.9999 DISPLAY_IDENTIFIER POELREG_D ECU_ADDRESS 0xd0006b4a FORMAT "%14.5" /end MEASUREMENT
/begin MEASUREMENT Poelreg_i "Öldruck-Regler I-Anteil" SWORD _CNV_R_R_Def_f_uw_b_579_CM 1 100. -1. 0.9999 DISPLAY_IDENTIFIER POELREG_I ECU_ADDRESS 0xd0006b48 FORMAT "%14.5" /end MEASUREMENT
/begin MEASUREMENT Poelreg_off "Öldruck-Regler Reibungs Offset (Anti Hysterese)" SWORD _CNV_R_R_Def_f_uw_b_579_CM 1 100. -1. 0.9999 DISPLAY_IDENTIFIER POELREG_OFF ECU_ADDRESS 0xd0006b4e FORMAT "%14.5" /end MEASUREMENT
/begin MEASUREMENT Poelreg_out "Öldruck Reglerausgang inkl. Adaption und Gewichtung" UWORD _CNV_R_R_Def_f_uw_b_591_CM 1 100. 0. 0.9999 DISPLAY_IDENTIFIER POELREG_OUT ECU_ADDRESS 0xd0006b42 FORMAT "%14.5" /end MEASUREMENT
/begin MEASUREMENT Poelreg_p "Öldruck-Regler P-Anteil" SWORD _CNV_R_R_Def_f_uw_b_579_CM 1 100. -1. 0.9999 DISPLAY_IDENTIFIER POELREG_P ECU_ADDRESS 0xd0006b46 FORMAT "%14.5" /end MEASUREMENT
/begin MEASUREMENT Poelreg_pid "Öldruck-Regler Ausgang" SWORD _CNV_R_R_Def_f_uw_b_579_CM 1 100. -1. 0.9999 DISPLAY_IDENTIFIER POELREG_PID ECU_ADDRESS 0xd0006b4c FORMAT "%14.5" /end MEASUREMENT
/begin MEASUREMENT Poelreg_st "Status Öldruckregler" UBYTE _CNV_R_R_Def_dez_sl_575_CM 1 100. 0. 255. DISPLAY_IDENTIFIER POELREG_ST ECU_ADDRESS 0xd0006b34 FORMAT "%3.0" /end MEASUREMENT
/begin MEASUREMENT Prail_h "Sollwert Raildruck aus KF_PRAIL_H" UWORD _CNV_R_R_Def_p_uw_q_685_CM 1 100. 0. 39.9993 DISPLAY_IDENTIFIER PRAIL_H ECU_ADDRESS 0xd0007bee FORMAT "%9.4" /end MEASUREMENT
/begin MEASUREMENT Prail_h_doe "Sollwert Raildruck aus KF_PRAIL_HDOE" UWORD _CNV_R_R_Def_p_uw_q_685_CM 1 100. 0. 39.9993 DISPLAY_IDENTIFIER PRAIL_H_DOE ECU_ADDRESS 0xd0007bf0 FORMAT "%9.4" /end MEASUREMENT
/begin MEASUREMENT Prail_hs "Sollwert Raildruck aus KF_PRAIL_HS" UWORD _CNV_R_R_Def_p_uw_q_685_CM 1 100. 0. 39.9993 DISPLAY_IDENTIFIER PRAIL_HS ECU_ADDRESS 0xd0007bf2 FORMAT "%9.4" /end MEASUREMENT
/begin MEASUREMENT Prail_hs_min "Untere Raildruckgrenze zu Umschaltung in HS" UWORD _CNV_R_R_Def_p_uw_q_685_CM 1 100. 0. 39.9993 DISPLAY_IDENTIFIER PRAIL_HS_MIN ECU_ADDRESS 0xd0007bf6 FORMAT "%9.4" /end MEASUREMENT
/begin MEASUREMENT Prail_out_s "Raildruck setpoint for stratified mode,high range" UWORD _CNV_R_R_Def_p_uw_q_685_CM 1 100. 0. 39.9993 DISPLAY_IDENTIFIER PRAIL_OUT_S ECU_ADDRESS 0xd0007bea FORMAT "%9.4" /end MEASUREMENT
/begin MEASUREMENT Prail_s "Sollwert Raildruck aus KF_PRAIL_S" UWORD _CNV_R_R_Def_p_uw_q_685_CM 1 100. 0. 39.9993 DISPLAY_IDENTIFIER PRAIL_S ECU_ADDRESS 0xd0007bf4 FORMAT "%9.4" /end MEASUREMENT
/begin MEASUREMENT Prail_s_min "Untere Raildruckgrenze zu Umschaltung in Schicht" UWORD _CNV_R_R_Def_p_uw_q_685_CM 1 100. 0. 39.9993 DISPLAY_IDENTIFIER PRAIL_S_MIN ECU_ADDRESS 0xd0007bf8 FORMAT "%9.4" /end MEASUREMENT
/begin MEASUREMENT Prail_schalt "Ausgang Umschalter Raildruck" UWORD _CNV_R_R_Def_p_uw_q_685_CM 1 100. 0. 39.9993 DISPLAY_IDENTIFIER PRAIL_SCHALT ECU_ADDRESS 0xd0007bfa FORMAT "%9.4" /end MEASUREMENT
/begin MEASUREMENT Prail_soll "Sollwert für Raildruckregler" UWORD _CNV_R_R_Def_p_uw_q_685_CM 1 100. 0. 39.9993 DISPLAY_IDENTIFIER PRAIL_SOLL ECU_ADDRESS 0xd0007be8 FORMAT "%9.4" /end MEASUREMENT
/begin MEASUREMENT Prail_sw "Sollwert für Raildruckregler" UWORD _CNV_R_R_Def_p_uw_q_685_CM 1 100. 0. 39.9993 DISPLAY_IDENTIFIER PRAIL_SW ECU_ADDRESS 0xd0007be6 FORMAT "%9.4" /end MEASUREMENT
/begin MEASUREMENT Priopizw1 "Pi-Regler zw1" SLONG _CNV_R_R_Def_f_sl_q_688_CM 1 100. -512. 512. DISPLAY_IDENTIFIER PRIOPIZW1 ECU_ADDRESS 0xc00028e4 FORMAT "%10.3" /end MEASUREMENT
/begin MEASUREMENT Priopizw2 "Pi-Regler zw2" SLONG _CNV_R_R_Def_f_sl_q_688_CM 1 100. -512. 512. DISPLAY_IDENTIFIER PRIOPIZW2 ECU_ADDRESS 0xc00028e8 FORMAT "%10.3" /end MEASUREMENT
/begin MEASUREMENT Ptc_pwr "Maximale Leistung, die der PTC einstellen darf." UBYTE _CNV_R_R_Def_f_ub_b_595_CM 1 100. 0. 127.5 DISPLAY_IDENTIFIER PTC_PWR ECU_ADDRESS 0xc000295f FORMAT "%5.2" /end MEASUREMENT
/begin MEASUREMENT Ptc_pwr7 "lokales ptc_pwr" UBYTE _CNV_R_R_Def_f_ub_b_595_CM 1 100. 0. 127.5 DISPLAY_IDENTIFIER PTC_PWR7 ECU_ADDRESS 0xc0002960 FORMAT "%5.2" /end MEASUREMENT
/begin MEASUREMENT Ptcadd "Wg. Spgeinbruch zu addierender PTC Faktor" UWORD _CNV_R_R_Def_f_sw_p_581_CM 1 100. 0. 550. DISPLAY_IDENTIFIER PTCADD ECU_ADDRESS 0xc000293e FORMAT "%8.3" /end MEASUREMENT
/begin MEASUREMENT Ptcpizw1 "PTC PI Regler zw1" SLONG _CNV_R_R_Def_f_sl_q_688_CM 1 100. -512. 512. DISPLAY_IDENTIFIER PTCPIZW1 ECU_ADDRESS 0xc00028ec FORMAT "%10.3" /end MEASUREMENT
/begin MEASUREMENT Ptcpizw2 "PTC PI zw2" SLONG _CNV_R_R_Def_f_sl_q_688_CM 1 100. -512. 512. DISPLAY_IDENTIFIER PTCPIZW2 ECU_ADDRESS 0xc00028f0 FORMAT "%10.3" /end MEASUREMENT
/begin MEASUREMENT Pwrspmem "altes ctrpwspcos" UBYTE _CNV_R_R_Def_f_ub_b_595_CM 1 100. 0. 127.5 DISPLAY_IDENTIFIER PWRSPMEM ECU_ADDRESS 0xc0002961 FORMAT "%5.2" /end MEASUREMENT
/begin MEASUREMENT Q_bila "Kapazität Batterie (long)" ULONG _CNV_R_R_Def_ql_ul__692_CM 1 100. 0. 1193.0464 DISPLAY_IDENTIFIER Q_BILA ECU_ADDRESS 0xc00046ce FORMAT "%11.4" /end MEASUREMENT
/begin MEASUREMENT Q_startfgk "Abstand zur Startfähigkeitsgrenze" UWORD _CNV_R_R_Def_ql_uw__596_CM 1 100. 0. 1193.0282 DISPLAY_IDENTIFIER Q_STARTFGK ECU_ADDRESS 0xc00046e8 FORMAT "%8.3" /end MEASUREMENT
/begin MEASUREMENT Qeladold "Kapazität Entladen vor Abstellen" UWORD _CNV_R_R_Def_ql_uw__596_CM 1 100. 0. 1193.0282 DISPLAY_IDENTIFIER QELADOLD ECU_ADDRESS 0xc00046d2 FORMAT "%8.3" /end MEASUREMENT
/begin MEASUREMENT Qeladold7 "zuletzt gesp. qelad" UWORD _CNV_R_R_Def_ql_uw__596_CM 1 100. 0. 1193.0282 DISPLAY_IDENTIFIER QELADOLD7 ECU_ADDRESS 0xc000469e FORMAT "%8.3" /end MEASUREMENT
/begin MEASUREMENT Qladold "Kapazität Getladen vor Abstellen" UWORD _CNV_R_R_Def_ql_uw__596_CM 1 100. 0. 1193.0282 DISPLAY_IDENTIFIER QLADOLD ECU_ADDRESS 0xc00046d4 FORMAT "%8.3" /end MEASUREMENT
/begin MEASUREMENT Qladold7 "zuletzt gesp. qlad" UWORD _CNV_R_R_Def_ql_uw__596_CM 1 100. 0. 1193.0282 DISPLAY_IDENTIFIER QLADOLD7 ECU_ADDRESS 0xc00046a0 FORMAT "%8.3" /end MEASUREMENT
/begin MEASUREMENT Qladzwsp7 "qlad uebertragspeicher" UWORD _CNV_R_R_Def_dez_sl_575_CM 1 100. 0. 65535. DISPLAY_IDENTIFIER QLADZWSP7 ECU_ADDRESS 0xc00028b4 FORMAT "%5.0" /end MEASUREMENT
/begin MEASUREMENT Rin_grenzh "Batt.Innenwiderstand Grenze" UBYTE _CNV_R_R_Def_f_ub_b_695_CM 1 100. 0. 31.875 DISPLAY_IDENTIFIER RIN_GRENZH ECU_ADDRESS 0xc000299b FORMAT "%5.2" /end MEASUREMENT
/begin MEASUREMENT Rin_start "Innenwiderstand Batterie beim Start" UBYTE _CNV_R_R_Def_f_ub_b_695_CM 1 100. 0. 31.875 DISPLAY_IDENTIFIER RIN_START ECU_ADDRESS 0xc000299c FORMAT "%5.2" /end MEASUREMENT
/begin MEASUREMENT Rqpcos "Anforderung_Standverbraucher" UBYTE _CNV_R_R_Def_dez_sl_575_CM 1 100. 0. 3. DISPLAY_IDENTIFIER RQPCOS ECU_ADDRESS 0xc0002962 FORMAT "%3.0" /end MEASUREMENT
/begin MEASUREMENT Rqpcos7 "lokales rqpcos" UBYTE _CNV_R_R_Def_dez_sl_575_CM 1 100. 0. 3. DISPLAY_IDENTIFIER RQPCOS7 ECU_ADDRESS 0xc0002963 FORMAT "%3.0" /end MEASUREMENT
/begin MEASUREMENT Rqpcosmem "altes rqpcos" UBYTE _CNV_R_R_Def_dez_sl_575_CM 1 100. 0. 3. DISPLAY_IDENTIFIER RQPCOSMEM ECU_ADDRESS 0xc0002964 FORMAT "%3.0" /end MEASUREMENT
/begin MEASUREMENT Schalt_prail "Umschalter Raildruck" UBYTE _CNV_R_R_Def_dez_sl_575_CM 1 100. 0. 255. DISPLAY_IDENTIFIER SCHALT_PRAIL ECU_ADDRESS 0xd0007bec FORMAT "%3.0" /end MEASUREMENT
/begin MEASUREMENT Selspcos "Auswahl_Sonderverbraucher" UBYTE _CNV_R_R_Def_dez_sl_575_CM 1 100. 0. 15. DISPLAY_IDENTIFIER SELSPCOS ECU_ADDRESS 0xc0002965 FORMAT "%3.0" /end MEASUREMENT
/begin MEASUREMENT Selspcosme "altes selspcos" UBYTE _CNV_R_R_Def_dez_sl_575_CM 1 100. 0. 15. DISPLAY_IDENTIFIER SELSPCOSME ECU_ADDRESS 0xc0002966 FORMAT "%3.0" /end MEASUREMENT
/begin MEASUREMENT Soc_b_loc "lokal soc_bila f. KFSOCLF" UWORD _CNV_R_R_Def_f_uw_b_576_CM 1 100. 0. 99.9984 DISPLAY_IDENTIFIER SOC_B_LOC ECU_ADDRESS 0xc00046d6 FORMAT "%8.3" /end MEASUREMENT
/begin MEASUREMENT Soc_bila "Ladezustand durch Bilanzierung und Ruhespannungsmessung ermittelt" UWORD _CNV_R_R_Def_f_uw_b_576_CM 1 100. 0. 99.9984 DISPLAY_IDENTIFIER SOC_BILA ECU_ADDRESS 0xc0005210 FORMAT "%8.3" /end MEASUREMENT
/begin MEASUREMENT Soc_fit "SoC aus der Fitformel" UWORD _CNV_R_R_Def_f_uw_b_576_CM 1 100. 0. 99.9984 DISPLAY_IDENTIFIER SOC_FIT ECU_ADDRESS 0xc00046dc FORMAT "%8.3" /end MEASUREMENT
/begin MEASUREMENT Soc_fit_temp "" UWORD _CNV_R_R_Def_f_uw_b_576_CM 1 100. 0. 99.9984 DISPLAY_IDENTIFIER SOC_FIT_TEMP ECU_ADDRESS 0xc000521c FORMAT "%8.3" /end MEASUREMENT
/begin MEASUREMENT Soc_korr "Korrekturwert soc_bila" SWORD _CNV_R_R_Def_f_sw_b_597_CM 1 100. -100. 99.9969 DISPLAY_IDENTIFIER SOC_KORR ECU_ADDRESS 0xc00046e4 FORMAT "%8.3" /end MEASUREMENT
/begin MEASUREMENT Soc_q_kor "Korrekturwert Genauigkeit Ladezustandsbestimmung" UWORD _CNV_R_R_Def_ql_uw__596_CM 1 100. 0. 1193.0282 DISPLAY_IDENTIFIER SOC_Q_KOR ECU_ADDRESS 0xc00046ea FORMAT "%8.3" /end MEASUREMENT
/begin MEASUREMENT Soc_q_loc "lokaler Zähler Genauigkeit Ladeztustandsbestimmung" UWORD _CNV_R_R_Def_ql_uw__596_CM 1 100. 0. 1193.0282 DISPLAY_IDENTIFIER SOC_Q_LOC ECU_ADDRESS 0xc00046d8 FORMAT "%8.3" /end MEASUREMENT
/begin MEASUREMENT Soc_quali "Zähler Genauigkeit Ladeztustandsbestimmung" UWORD _CNV_R_R_Def_ql_uw__596_CM 1 100. 0. 1193.0282 DISPLAY_IDENTIFIER SOC_QUALI ECU_ADDRESS 0xc0005212 FORMAT "%8.3" /end MEASUREMENT
/begin MEASUREMENT Soc_rel "Relativzähler für Ladezustand SoC" UWORD _CNV_R_R_Def_f_uw_b_576_CM 1 100. 0. 99.9984 DISPLAY_IDENTIFIER SOC_REL ECU_ADDRESS 0xc00046ec FORMAT "%8.3" /end MEASUREMENT
/begin MEASUREMENT Soc_stfgk "Startfähigkeitsgrenze" UWORD _CNV_R_R_Def_f_uw_b_576_CM 1 100. 0. 99.9984 DISPLAY_IDENTIFIER SOC_STFGK ECU_ADDRESS 0xc00046ee FORMAT "%8.3" /end MEASUREMENT
/begin MEASUREMENT Soc_stfgkw "SoC Startfähigkeit" UWORD _CNV_R_R_Def_f_uw_b_576_CM 1 100. 0. 99.9984 DISPLAY_IDENTIFIER SOC_STFGKW ECU_ADDRESS 0xc0005228 FORMAT "%8.3" /end MEASUREMENT
/begin MEASUREMENT St_bns "Statuswort" UBYTE _CNV_R_R_Def_dez_sl_575_CM 1 100. 0. 255. DISPLAY_IDENTIFIER ST_BNS ECU_ADDRESS 0xc00046fc FORMAT "%3.0" /end MEASUREMENT
/begin MEASUREMENT St_bns.B_bns "Bordnetzstabilitätsmaßnahmen aktiv" UBYTE _CNV_S_2_Def_bit_ub_700_CM 1 100. 0. 1. DISPLAY_IDENTIFIER B_BNS ECU_ADDRESS 0xc00046fc BIT_MASK 0x1 /end MEASUREMENT
/begin MEASUREMENT St_bns2 "Statuswort" UBYTE _CNV_R_R_Def_dez_sl_575_CM 1 100. 0. 255. DISPLAY_IDENTIFIER ST_BNS2 ECU_ADDRESS 0xd00072d8 FORMAT "%3.0" /end MEASUREMENT
/begin MEASUREMENT St_bns2.B_nachlnd7 "lokales B_nachlaufende" UBYTE _CNV_S_2_Def_bit_ub_700_CM 1 100. 0. 1. DISPLAY_IDENTIFIER B_NACHLND7 ECU_ADDRESS 0xd00072d8 BIT_MASK 0x1 /end MEASUREMENT
/begin MEASUREMENT St_pgenllred "Statuswort" UBYTE _CNV_R_R_Def_dez_sl_575_CM 1 100. 0. 255. DISPLAY_IDENTIFIER ST_PGENLLRED ECU_ADDRESS 0xd00072e0 FORMAT "%3.0" /end MEASUREMENT
/begin MEASUREMENT St_pgenllred.B_geli "Bedingung Generatorlastbegrenzung für Leerlaufstabilisierung" UBYTE _CNV_S_2_Def_bit_ub_701_CM 1 100. 0. 2. DISPLAY_IDENTIFIER B_GELI ECU_ADDRESS 0xd00072e0 BIT_MASK 0x2 /end MEASUREMENT
/begin MEASUREMENT St_pgenllred.B_nsubgen "Bedingung Leerlaufsolldrehzahlanhebung bei erkannten Generatorlastschwankung" UBYTE _CNV_S_2_Def_bit_ub_700_CM 1 100. 0. 1. DISPLAY_IDENTIFIER B_NSUBGEN ECU_ADDRESS 0xd00072e0 BIT_MASK 0x1 /end MEASUREMENT
/begin MEASUREMENT St_pgenllred.B_pgenllerk "Bedingung Generatorlimitierung wegen LL-Sägen erkannt" UBYTE _CNV_S_2_Def_bit_ub_702_CM 1 100. 0. 4. DISPLAY_IDENTIFIER B_PGENLLERK ECU_ADDRESS 0xd00072e0 BIT_MASK 0x4 /end MEASUREMENT
/begin MEASUREMENT St_pgenllred_200ms "Statuswort" UBYTE _CNV_R_R_Def_dez_sl_575_CM 1 100. 0. 255. DISPLAY_IDENTIFIER ST_PGENLLRED_200MS ECU_ADDRESS 0xc0005248 FORMAT "%3.0" /end MEASUREMENT
/begin MEASUREMENT St_pgenllred_200ms.B_dffaktiv "Bedingung Auswertung des Generatorlastsignals für Leerlaufregelung aktiv" UBYTE _CNV_S_2_Def_bit_ub_701_CM 1 100. 0. 2. DISPLAY_IDENTIFIER B_DFFAKTIV ECU_ADDRESS 0xc0005248 BIT_MASK 0x2 /end MEASUREMENT
/begin MEASUREMENT St_pgenllred_200ms.B_nsubg_r "Resetbedingung für LL Anhebung GEN" UBYTE _CNV_S_2_Def_bit_ub_702_CM 1 100. 0. 4. DISPLAY_IDENTIFIER B_NSUBG_R ECU_ADDRESS 0xc0005248 BIT_MASK 0x4 /end MEASUREMENT
/begin MEASUREMENT St_pgenllred_200ms.B_nsubgen1 "Temporäre Zwischengröße für LL Anhebung Generator" UBYTE _CNV_S_2_Def_bit_ub_703_CM 1 100. 0. 8. DISPLAY_IDENTIFIER B_NSUBGEN1 ECU_ADDRESS 0xc0005248 BIT_MASK 0x8 /end MEASUREMENT
/begin MEASUREMENT St_pgenllred_200ms.B_pgenllfa "Bedingung für Rücksetzen erkanntes LL-Sägen durch Generator" UBYTE _CNV_S_2_Def_bit_ub_704_CM 1 100. 0. 16. DISPLAY_IDENTIFIER B_PGENLLFA ECU_ADDRESS 0xc0005248 BIT_MASK 0x10 /end MEASUREMENT
/begin MEASUREMENT St_pgenllred_200ms.B_pgenredllve "Bedingung Fehler Fahrzeuggeschwindigkeit erkannt" UBYTE _CNV_S_2_Def_bit_ub_700_CM 1 100. 0. 1. DISPLAY_IDENTIFIER B_PGENREDLLVE ECU_ADDRESS 0xc0005248 BIT_MASK 0x1 /end MEASUREMENT
/begin MEASUREMENT St_pmdiag0 "Statuswort" UBYTE _CNV_R_R_Def_dez_sl_575_CM 1 100. 0. 255. DISPLAY_IDENTIFIER ST_PMDIAG0 ECU_ADDRESS 0xd000728c FORMAT "%3.0" /end MEASUREMENT
/begin MEASUREMENT St_pmdiag0.B_ccbtnach "CC Meldung : Batterie Nachladen" UBYTE _CNV_S_2_Def_bit_ub_706_CM 1 100. 0. 64. DISPLAY_IDENTIFIER B_CCBTNACH ECU_ADDRESS 0xd000728c BIT_MASK 0x40 /end MEASUREMENT
/begin MEASUREMENT St_pmdiag0.B_ccbttdfk "CC Meldung : Batterie verschlissen" UBYTE _CNV_S_2_Def_bit_ub_702_CM 1 100. 0. 4. DISPLAY_IDENTIFIER B_CCBTTDFK ECU_ADDRESS 0xd000728c BIT_MASK 0x4 /end MEASUREMENT
/begin MEASUREMENT St_pmdiag0.B_ccbttknt "CC Meldung : Batteriekontakt pruefen" UBYTE _CNV_S_2_Def_bit_ub_704_CM 1 100. 0. 16. DISPLAY_IDENTIFIER B_CCBTTKNT ECU_ADDRESS 0xd000728c BIT_MASK 0x10 /end MEASUREMENT
/begin MEASUREMENT St_pmdiag0.B_ccpmerr "CC Meldung : Powermgm ausser Betrieb" UBYTE _CNV_S_2_Def_bit_ub_703_CM 1 100. 0. 8. DISPLAY_IDENTIFIER B_CCPMERR ECU_ADDRESS 0xd000728c BIT_MASK 0x8 /end MEASUREMENT
/begin MEASUREMENT St_pmdiag0.B_ccprio "CC Meldung : Komfortverbraucher eingeschraenkt" UBYTE _CNV_S_2_Def_bit_ub_701_CM 1 100. 0. 2. DISPLAY_IDENTIFIER B_CCPRIO ECU_ADDRESS 0xd000728c BIT_MASK 0x2 /end MEASUREMENT
/begin MEASUREMENT St_pmdiag0.B_codierpm "Anfrage an CAS die Codierdaten erneut fuer PM zu senden." UBYTE _CNV_S_2_Def_bit_ub_700_CM 1 100. 0. 1. DISPLAY_IDENTIFIER B_CODIERPM ECU_ADDRESS 0xd000728c BIT_MASK 0x1 /end MEASUREMENT
/begin MEASUREMENT St_pmdiag0.B_pcoschg "Bed. SVstatus darf geändert werden." UBYTE _CNV_S_2_Def_bit_ub_705_CM 1 100. 0. 32. DISPLAY_IDENTIFIER B_PCOSCHG ECU_ADDRESS 0xd000728c BIT_MASK 0x20 /end MEASUREMENT
/begin MEASUREMENT St_pmdiag0.B_tiefrset "Tiefentladungsbit, B_tiefset, im IBS löschen." UBYTE _CNV_S_2_Def_bit_ub_707_CM 1 100. 0. 128. DISPLAY_IDENTIFIER B_TIEFRSET ECU_ADDRESS 0xd000728c BIT_MASK 0x80 /end MEASUREMENT
/begin MEASUREMENT St_pmdiag1 "Statuswort" UBYTE _CNV_R_R_Def_dez_sl_575_CM 1 100. 0. 255. DISPLAY_IDENTIFIER ST_PMDIAG1 ECU_ADDRESS 0xd000728d FORMAT "%3.0" /end MEASUREMENT
/begin MEASUREMENT St_pmdiag1.B_ccruhver "CC Meldung : erhoehter Ruhestrom" UBYTE _CNV_S_2_Def_bit_ub_700_CM 1 100. 0. 1. DISPLAY_IDENTIFIER B_CCRUHVER ECU_ADDRESS 0xd000728d BIT_MASK 0x1 /end MEASUREMENT
/begin MEASUREMENT St_pmdiag1.B_histrset "IBS Histrogramm darf gelöscht werden." UBYTE _CNV_S_2_Def_bit_ub_701_CM 1 100. 0. 2. DISPLAY_IDENTIFIER B_HISTRSET ECU_ADDRESS 0xd000728d BIT_MASK 0x2 /end MEASUREMENT
/begin MEASUREMENT St_pmdiag1.B_qelad1step "Q_elad 1. Takt vorbei " UBYTE _CNV_S_2_Def_bit_ub_705_CM 1 100. 0. 32. DISPLAY_IDENTIFIER B_QELAD1STEP ECU_ADDRESS 0xd000728d BIT_MASK 0x20 /end MEASUREMENT
/begin MEASUREMENT St_pmdiag1.B_ruhverl7 "Ruhestromverletzung derzeit vorhanden." UBYTE _CNV_S_2_Def_bit_ub_704_CM 1 100. 0. 16. DISPLAY_IDENTIFIER B_RUHVERL7 ECU_ADDRESS 0xd000728d BIT_MASK 0x10 /end MEASUREMENT
/begin MEASUREMENT St_pmdiag1.B_sv_ihka "IHKA Standverbraucher aktiv" UBYTE _CNV_S_2_Def_bit_ub_703_CM 1 100. 0. 8. DISPLAY_IDENTIFIER B_SV_IHKA ECU_ADDRESS 0xd000728d BIT_MASK 0x8 /end MEASUREMENT
/begin MEASUREMENT St_pmdiag1.B_timer_rst "Dient zum Aufziehen des internen Delay Timers" UBYTE _CNV_S_2_Def_bit_ub_702_CM 1 100. 0. 4. DISPLAY_IDENTIFIER B_TIMER_RST ECU_ADDRESS 0xd000728d BIT_MASK 0x4 /end MEASUREMENT
/begin MEASUREMENT St_pmdiagnv "Statuswort" UBYTE _CNV_R_R_Def_dez_sl_575_CM 1 100. 0. 255. DISPLAY_IDENTIFIER ST_PMDIAGNV ECU_ADDRESS 0xc0004650 FORMAT "%3.0" /end MEASUREMENT
/begin MEASUREMENT St_pmdiagnv.B_ruhverl "ruhestromverletzung vorhanden" UBYTE _CNV_S_2_Def_bit_ub_700_CM 1 100. 0. 1. DISPLAY_IDENTIFIER B_RUHVERL ECU_ADDRESS 0xc0004650 BIT_MASK 0x1 /end MEASUREMENT
/begin MEASUREMENT St_pmprsv_nv "Statuswort" UBYTE _CNV_R_R_Def_dez_sl_575_CM 1 100. 0. 255. DISPLAY_IDENTIFIER ST_PMPRSV_NV ECU_ADDRESS 0xc00046c8 FORMAT "%3.0" /end MEASUREMENT
/begin MEASUREMENT St_pmprsv_nv.B_enwake7 "lokales B_enwake" UBYTE _CNV_S_2_Def_bit_ub_700_CM 1 100. 0. 1. DISPLAY_IDENTIFIER B_ENWAKE7 ECU_ADDRESS 0xc00046c8 BIT_MASK 0x1 /end MEASUREMENT
/begin MEASUREMENT St_pmprsvcalc "Statuswort" UBYTE _CNV_R_R_Def_dez_sl_575_CM 1 100. 0. 255. DISPLAY_IDENTIFIER ST_PMPRSVCALC ECU_ADDRESS 0xd0007290 FORMAT "%3.0" /end MEASUREMENT
/begin MEASUREMENT St_pmprsvcalc.B_gendef "Bedingung Generator defekt während Motorbetrieb" UBYTE _CNV_S_2_Def_bit_ub_705_CM 1 100. 0. 32. DISPLAY_IDENTIFIER B_GENDEF ECU_ADDRESS 0xd0007290 BIT_MASK 0x20 /end MEASUREMENT
/begin MEASUREMENT St_pmprsvcalc.B_ipmaktiv "IPM Massnahmen bzgl. Prios aktiviert" UBYTE _CNV_S_2_Def_bit_ub_703_CM 1 100. 0. 8. DISPLAY_IDENTIFIER B_IPMAKTIV ECU_ADDRESS 0xd0007290 BIT_MASK 0x8 /end MEASUREMENT
/begin MEASUREMENT St_pmprsvcalc.B_ipmtimer "IPM Timer für Prios aktiv" UBYTE _CNV_S_2_Def_bit_ub_702_CM 1 100. 0. 4. DISPLAY_IDENTIFIER B_IPMTIMER ECU_ADDRESS 0xd0007290 BIT_MASK 0x4 /end MEASUREMENT
/begin MEASUREMENT St_pmprsvcalc.B_kwdr_old "Dient zur Erkennung einer steigender Flanke B_kl15" UBYTE _CNV_S_2_Def_bit_ub_704_CM 1 100. 0. 16. DISPLAY_IDENTIFIER B_KWDR_OLD ECU_ADDRESS 0xd0007290 BIT_MASK 0x10 /end MEASUREMENT
/begin MEASUREMENT St_pmprsvcalc.B_nkwptcio "NKW status für PTC i.o." UBYTE _CNV_S_2_Def_bit_ub_706_CM 1 100. 0. 64. DISPLAY_IDENTIFIER B_NKWPTCIO ECU_ADDRESS 0xd0007290 BIT_MASK 0x40 /end MEASUREMENT
/begin MEASUREMENT St_pmprsvcalc.B_ptckoor "PTC Koordinator Maßnahmen Aktiv" UBYTE _CNV_S_2_Def_bit_ub_707_CM 1 100. 0. 128. DISPLAY_IDENTIFIER B_PTCKOOR ECU_ADDRESS 0xd0007290 BIT_MASK 0x80 /end MEASUREMENT
/begin MEASUREMENT St_pmprsvcalc.B_ubtlow "Bedingung Batterie in Unterspannungszustand" UBYTE _CNV_S_2_Def_bit_ub_700_CM 1 100. 0. 1. DISPLAY_IDENTIFIER B_UBTLOW ECU_ADDRESS 0xd0007290 BIT_MASK 0x1 /end MEASUREMENT
/begin MEASUREMENT St_pmprsvcalc.B_uloreset "Bedingung Batterie nicht mehr in Unterspannungszustand" UBYTE _CNV_S_2_Def_bit_ub_701_CM 1 100. 0. 2. DISPLAY_IDENTIFIER B_ULORESET ECU_ADDRESS 0xd0007290 BIT_MASK 0x2 /end MEASUREMENT
/begin MEASUREMENT St_pmprsvcalc1 "Statuswort" UBYTE _CNV_R_R_Def_dez_sl_575_CM 1 100. 0. 255. DISPLAY_IDENTIFIER ST_PMPRSVCALC1 ECU_ADDRESS 0xd0007291 FORMAT "%3.0" /end MEASUREMENT
/begin MEASUREMENT St_pmprsvcalc1.B_dubt "Bedg., ob dubt > 100mV" UBYTE _CNV_S_2_Def_bit_ub_701_CM 1 100. 0. 2. DISPLAY_IDENTIFIER B_DUBT ECU_ADDRESS 0xd0007291 BIT_MASK 0x2 /end MEASUREMENT
/begin MEASUREMENT St_pmprsvcalc1.B_enwakeup "Bit, ob IBS Bus wecken darf oder nicht." UBYTE _CNV_S_2_Def_bit_ub_700_CM 1 100. 0. 1. DISPLAY_IDENTIFIER B_ENWAKEUP ECU_ADDRESS 0xd0007291 BIT_MASK 0x1 /end MEASUREMENT
/begin MEASUREMENT St_pmprsvcalc1.B_limcalc "Bedg. begrenzte Berechnung" UBYTE _CNV_S_2_Def_bit_ub_705_CM 1 100. 0. 32. DISPLAY_IDENTIFIER B_LIMCALC ECU_ADDRESS 0xd0007291 BIT_MASK 0x20 /end MEASUREMENT
/begin MEASUREMENT St_pmprsvcalc1.B_notprsv "Bed.Notlauf aufg.Batt-Unterspg, Generatorstat und B_kl15 in PMPRSVCALC" UBYTE _CNV_S_2_Def_bit_ub_706_CM 1 100. 0. 64. DISPLAY_IDENTIFIER B_NOTPRSV ECU_ADDRESS 0xd0007291 BIT_MASK 0x40 /end MEASUREMENT
/begin MEASUREMENT St_pmprsvcalc1.B_pireset "Bedingung für PI-Reset" UBYTE _CNV_S_2_Def_bit_ub_707_CM 1 100. 0. 128. DISPLAY_IDENTIFIER B_PIRESET ECU_ADDRESS 0xd0007291 BIT_MASK 0x80 /end MEASUREMENT
/begin MEASUREMENT St_pmprsvcalc1.B_pmbsdanf "Bedg. ob 3b4 versendet wird" UBYTE _CNV_S_2_Def_bit_ub_704_CM 1 100. 0. 16. DISPLAY_IDENTIFIER B_PMBSDANF ECU_ADDRESS 0xd0007291 BIT_MASK 0x10 /end MEASUREMENT
/begin MEASUREMENT St_pmprsvcalc1.B_pmvsdanf "Bedg., ob 3b3 versendet wird" UBYTE _CNV_S_2_Def_bit_ub_702_CM 1 100. 0. 4. DISPLAY_IDENTIFIER B_PMVSDANF ECU_ADDRESS 0xd0007291 BIT_MASK 0x4 /end MEASUREMENT
/begin MEASUREMENT St_pmprsvcalc2 "Statuswort" UBYTE _CNV_R_R_Def_dez_sl_575_CM 1 100. 0. 255. DISPLAY_IDENTIFIER ST_PMPRSVCALC2 ECU_ADDRESS 0xd0007292 FORMAT "%3.0" /end MEASUREMENT
/begin MEASUREMENT St_pmprsvcalc2.B_kwdrise "Motorstart Rising" UBYTE _CNV_S_2_Def_bit_ub_700_CM 1 100. 0. 1. DISPLAY_IDENTIFIER B_KWDRISE ECU_ADDRESS 0xd0007292 BIT_MASK 0x1 /end MEASUREMENT
/begin MEASUREMENT St_pmprsvcalc2.B_pmsulevon "PM Sulev Maßnahmen aktiv" UBYTE _CNV_S_2_Def_bit_ub_701_CM 1 100. 0. 2. DISPLAY_IDENTIFIER B_PMSULEVON ECU_ADDRESS 0xd0007292 BIT_MASK 0x2 /end MEASUREMENT
/begin MEASUREMENT St_pmsocalc1 "Statuswort" UBYTE _CNV_R_R_Def_dez_sl_575_CM 1 100. 0. 255. DISPLAY_IDENTIFIER ST_PMSOCALC1 ECU_ADDRESS 0xc00046cc FORMAT "%3.0" /end MEASUREMENT
/begin MEASUREMENT St_pmsocalc1.B_ibspwf_e "Bedingung Powerfail IBS erkannt" UBYTE _CNV_S_2_Def_bit_ub_700_CM 1 100. 0. 1. DISPLAY_IDENTIFIER B_IBSPWF_E ECU_ADDRESS 0xc00046cc BIT_MASK 0x1 /end MEASUREMENT
/begin MEASUREMENT St_pmsoccalc "Statuswort" UBYTE _CNV_R_R_Def_dez_sl_575_CM 1 100. 0. 255. DISPLAY_IDENTIFIER ST_PMSOCCALC ECU_ADDRESS 0xd0007294 FORMAT "%3.0" /end MEASUREMENT
/begin MEASUREMENT St_pmsoccalc.B_soc_pwf "Uo Kalibrierung durchgeführt" UBYTE _CNV_S_2_Def_bit_ub_701_CM 1 100. 0. 2. DISPLAY_IDENTIFIER B_SOC_PWF ECU_ADDRESS 0xd0007294 BIT_MASK 0x2 /end MEASUREMENT
/begin MEASUREMENT St_pmsoccalc.B_soccalc "Uo Kalibrierung durchgeführt" UBYTE _CNV_S_2_Def_bit_ub_702_CM 1 100. 0. 4. DISPLAY_IDENTIFIER B_SOCCALC ECU_ADDRESS 0xd0007294 BIT_MASK 0x4 /end MEASUREMENT
/begin MEASUREMENT St_pmsockor0 "Statuswort" UBYTE _CNV_R_R_Def_dez_sl_575_CM 1 100. 0. 255. DISPLAY_IDENTIFIER ST_PMSOCKOR0 ECU_ADDRESS 0xd0007298 FORMAT "%3.0" /end MEASUREMENT
/begin MEASUREMENT St_pmsockor0.B_abschfit "Bedingung Korrektur Startfähigkeitsgrenze durchgeführt" UBYTE _CNV_S_2_Def_bit_ub_705_CM 1 100. 0. 32. DISPLAY_IDENTIFIER B_ABSCHFIT ECU_ADDRESS 0xd0007298 BIT_MASK 0x20 /end MEASUREMENT
/begin MEASUREMENT St_pmsockor0.B_pm_fit2 "Bedingung Hilfsvariable Fit 2" UBYTE _CNV_S_2_Def_bit_ub_701_CM 1 100. 0. 2. DISPLAY_IDENTIFIER B_PM_FIT2 ECU_ADDRESS 0xd0007298 BIT_MASK 0x2 /end MEASUREMENT
/begin MEASUREMENT St_pmsockor0.B_pm_fit3 "Bedingung Hilfsvariable Fit 3" UBYTE _CNV_S_2_Def_bit_ub_702_CM 1 100. 0. 4. DISPLAY_IDENTIFIER B_PM_FIT3 ECU_ADDRESS 0xd0007298 BIT_MASK 0x4 /end MEASUREMENT
/begin MEASUREMENT St_pmsockor0.B_pmsocini "wird beim INIT wahr um den Timer zurückzusetzen" UBYTE _CNV_S_2_Def_bit_ub_703_CM 1 100. 0. 8. DISPLAY_IDENTIFIER B_PMSOCINI ECU_ADDRESS 0xd0007298 BIT_MASK 0x8 /end MEASUREMENT
/begin MEASUREMENT St_pmsockor0.B_q_start "Bedingung Startqualität vollständig berechnet" UBYTE _CNV_S_2_Def_bit_ub_704_CM 1 100. 0. 16. DISPLAY_IDENTIFIER B_Q_START ECU_ADDRESS 0xd0007298 BIT_MASK 0x10 /end MEASUREMENT
/begin MEASUREMENT St_pmsockor0.B_soc_npl "Bedingung SoC-Wert nicht plausibel" UBYTE _CNV_S_2_Def_bit_ub_700_CM 1 100. 0. 1. DISPLAY_IDENTIFIER B_SOC_NPL ECU_ADDRESS 0xd0007298 BIT_MASK 0x1 /end MEASUREMENT
/begin MEASUREMENT St_pmsocstart0 "Statuswort" UBYTE _CNV_R_R_Def_dez_sl_575_CM 1 100. 0. 255. DISPLAY_IDENTIFIER ST_PMSOCSTART0 ECU_ADDRESS 0xd000729c FORMAT "%3.0" /end MEASUREMENT
/begin MEASUREMENT St_pmsocstart0.B_pmstart7 "Bed. Motorstart für Startauswertung PM" UBYTE _CNV_S_2_Def_bit_ub_700_CM 1 100. 0. 1. DISPLAY_IDENTIFIER B_PMSTART7 ECU_ADDRESS 0xd000729c BIT_MASK 0x1 /end MEASUREMENT
/begin MEASUREMENT St_pmsocstart0.B_resetsta "Bedingung Reset Startauswertung" UBYTE _CNV_S_2_Def_bit_ub_701_CM 1 100. 0. 2. DISPLAY_IDENTIFIER B_RESETSTA ECU_ADDRESS 0xd000729c BIT_MASK 0x2 /end MEASUREMENT
/begin MEASUREMENT St_pmsocstart0.B_rstdatardy "Motor aus erkannt, Startwerte im IBS bereit zum löschen." UBYTE _CNV_S_2_Def_bit_ub_702_CM 1 100. 0. 4. DISPLAY_IDENTIFIER B_RSTDATARDY ECU_ADDRESS 0xd000729c BIT_MASK 0x4 /end MEASUREMENT
/begin MEASUREMENT St_pmsocstart_nv0 "Statuswort" UBYTE _CNV_R_R_Def_dez_sl_575_CM 1 100. 0. 255. DISPLAY_IDENTIFIER ST_PMSOCSTART_NV0 ECU_ADDRESS 0xc00046f4 FORMAT "%3.0" /end MEASUREMENT
/begin MEASUREMENT St_pmsocstart_nv0.B_pmsqrdy "kt_ibs.dat" UBYTE _CNV_S_2_Def_bit_ub_701_CM 1 100. 0. 2. DISPLAY_IDENTIFIER B_PMSQRDY ECU_ADDRESS 0xc00046f4 BIT_MASK 0x2 /end MEASUREMENT
/begin MEASUREMENT St_pmsocstart_nv0.B_pmstartq "Bedingung Startqualität" UBYTE _CNV_S_2_Def_bit_ub_700_CM 1 100. 0. 1. DISPLAY_IDENTIFIER B_PMSTARTQ ECU_ADDRESS 0xc00046f4 BIT_MASK 0x1 /end MEASUREMENT
/begin MEASUREMENT St_pmugencalc "Statuswort" UBYTE _CNV_R_R_Def_dez_sl_575_CM 1 100. 0. 255. DISPLAY_IDENTIFIER ST_PMUGENCALC ECU_ADDRESS 0xd00072b0 FORMAT "%3.0" /end MEASUREMENT
/begin MEASUREMENT St_pmugencalc.B_genclcon "Wird auf true gesetzt wenn Motor und Generator bereits T_B_NMOT-Sekunden laufen." UBYTE _CNV_S_2_Def_bit_ub_700_CM 1 100. 0. 1. DISPLAY_IDENTIFIER B_GENCLCON ECU_ADDRESS 0xd00072b0 BIT_MASK 0x1 /end MEASUREMENT
/begin MEASUREMENT St_poelreg2 "Statusbyte POEL_REG2 (Layer Ausgänge)" UBYTE _CNV_R_R_Def_dez_sl_575_CM 1 100. 0. 255. DISPLAY_IDENTIFIER ST_POELREG2 ECU_ADDRESS 0xd0006b2d FORMAT "%3.0" /end MEASUREMENT
/begin MEASUREMENT St_poelreg2.B_poel_anz "Bedingung Öldruck Kombi-Anzeige" UBYTE _CNV_S_2_Def_bit_ub_700_CM 1 100. 0. 1. DISPLAY_IDENTIFIER B_POEL_ANZ ECU_ADDRESS 0xd0006b2d BIT_MASK 0x1 /end MEASUREMENT
/begin MEASUREMENT St_poelreg3 "Statusbyte POEL_REG3 (Layer Eingänge)" UBYTE _CNV_R_R_Def_dez_sl_575_CM 1 100. 0. 255. DISPLAY_IDENTIFIER ST_POELREG3 ECU_ADDRESS 0xd0006b2c FORMAT "%3.0" /end MEASUREMENT
/begin MEASUREMENT St_poelreg3.B_poel_ad "Bedingung Öldruck-Regler Adaption ein" UBYTE _CNV_S_2_Def_bit_ub_700_CM 1 100. 0. 1. DISPLAY_IDENTIFIER B_POEL_AD ECU_ADDRESS 0xd0006b2c BIT_MASK 0x1 /end MEASUREMENT
/begin MEASUREMENT St_poelreg3.B_poel_diag "Öldruck-Regler Freigabe für Fehlererkennung" UBYTE _CNV_S_2_Def_bit_ub_705_CM 1 100. 0. 32. DISPLAY_IDENTIFIER B_POEL_DIAG ECU_ADDRESS 0xd0006b2c BIT_MASK 0x20 /end MEASUREMENT
/begin MEASUREMENT St_poelreg3.B_poelad_lern "Bedingung Öldruck-Regler Adaption lernen" UBYTE _CNV_S_2_Def_bit_ub_701_CM 1 100. 0. 2. DISPLAY_IDENTIFIER B_POELAD_LERN ECU_ADDRESS 0xd0006b2c BIT_MASK 0x2 /end MEASUREMENT
/begin MEASUREMENT St_poelreg3.B_poelnkw_on "Drehzahl über Schwelle zeitverzögert" UBYTE _CNV_S_2_Def_bit_ub_702_CM 1 100. 0. 4. DISPLAY_IDENTIFIER B_POELNKW_ON ECU_ADDRESS 0xd0006b2c BIT_MASK 0x4 /end MEASUREMENT
/begin MEASUREMENT St_poelreg3.B_poelreg_on "Öldruck-Regler Freigabe" UBYTE _CNV_S_2_Def_bit_ub_703_CM 1 100. 0. 8. DISPLAY_IDENTIFIER B_POELREG_ON ECU_ADDRESS 0xd0006b2c BIT_MASK 0x8 /end MEASUREMENT
/begin MEASUREMENT St_poelreg3.B_poelsol_dyn "Öldruck-Sollwert Dynamik erkannt" UBYTE _CNV_S_2_Def_bit_ub_704_CM 1 100. 0. 16. DISPLAY_IDENTIFIER B_POELSOL_DYN ECU_ADDRESS 0xd0006b2c BIT_MASK 0x10 /end MEASUREMENT
/begin MEASUREMENT St_rail "Statuswort Raildruckregler" UBYTE _CNV_R_R_Def_dez_sl_575_CM 1 100. 0. 255. DISPLAY_IDENTIFIER ST_RAIL ECU_ADDRESS 0xd0007be4 FORMAT "%3.0" /end MEASUREMENT
/begin MEASUREMENT St_rail.B_prailsw "Bedingung Raildruck von BMW verwenden" UBYTE _CNV_S_2_Def_bit_ub_700_CM 1 100. 0. 1. DISPLAY_IDENTIFIER B_PRAILSW ECU_ADDRESS 0xd0007be4 BIT_MASK 0x1 /end MEASUREMENT
/begin MEASUREMENT St_railko "Statuswort" UBYTE _CNV_R_R_Def_dez_sl_575_CM 1 100. 0. 255. DISPLAY_IDENTIFIER ST_RAILKO ECU_ADDRESS 0xd0007be5 FORMAT "%3.0" /end MEASUREMENT
/begin MEASUREMENT St_railko.B_prail_hs "Statuswort" UBYTE _CNV_S_2_Def_bit_ub_701_CM 1 100. 0. 2. DISPLAY_IDENTIFIER B_PRAIL_HS ECU_ADDRESS 0xd0007be5 BIT_MASK 0x2 /end MEASUREMENT
/begin MEASUREMENT St_railko.B_prail_s "Statuswort" UBYTE _CNV_S_2_Def_bit_ub_700_CM 1 100. 0. 1. DISPLAY_IDENTIFIER B_PRAIL_S ECU_ADDRESS 0xd0007be5 BIT_MASK 0x1 /end MEASUREMENT
/begin MEASUREMENT St_ramp "" UBYTE _CNV_R_R_Def_dez_sl_575_CM 1 100. 0. 255. DISPLAY_IDENTIFIER ST_RAMP ECU_ADDRESS 0xd0007919 FORMAT "%3.0" /end MEASUREMENT
/begin MEASUREMENT St_ramp.B_arampend "" UBYTE _CNV_S_2_Def_bit_ub_702_CM 1 100. 0. 4. DISPLAY_IDENTIFIER B_ARAMPEND ECU_ADDRESS 0xd0007919 BIT_MASK 0x4 /end MEASUREMENT
/begin MEASUREMENT St_ramp.B_arampend_1 "" UBYTE _CNV_S_2_Def_bit_ub_703_CM 1 100. 0. 8. DISPLAY_IDENTIFIER B_ARAMPEND_1 ECU_ADDRESS 0xd0007919 BIT_MASK 0x8 /end MEASUREMENT
/begin MEASUREMENT St_ramp.B_erampend "" UBYTE _CNV_S_2_Def_bit_ub_700_CM 1 100. 0. 1. DISPLAY_IDENTIFIER B_ERAMPEND ECU_ADDRESS 0xd0007919 BIT_MASK 0x1 /end MEASUREMENT
/begin MEASUREMENT St_ramp.B_erampend_1 "" UBYTE _CNV_S_2_Def_bit_ub_701_CM 1 100. 0. 2. DISPLAY_IDENTIFIER B_ERAMPEND_1 ECU_ADDRESS 0xd0007919 BIT_MASK 0x2 /end MEASUREMENT
/begin MEASUREMENT St_restg "Statuswort RESTGAS" UBYTE _CNV_R_R_Def_dez_sl_575_CM 1 100. 0. 255. DISPLAY_IDENTIFIER ST_RESTG ECU_ADDRESS 0xd000790e FORMAT "%3.0" /end MEASUREMENT
/begin MEASUREMENT St_restg.B_ff_nvsaad "Statuswort RESTGAS" UBYTE _CNV_S_2_Def_bit_ub_703_CM 1 100. 0. 8. DISPLAY_IDENTIFIER B_FF_NVSAAD ECU_ADDRESS 0xd000790e BIT_MASK 0x8 /end MEASUREMENT
/begin MEASUREMENT St_restg.B_ff_nvsead "Statuswort RESTGAS" UBYTE _CNV_S_2_Def_bit_ub_702_CM 1 100. 0. 4. DISPLAY_IDENTIFIER B_FF_NVSEAD ECU_ADDRESS 0xd000790e BIT_MASK 0x4 /end MEASUREMENT
/begin MEASUREMENT St_restg.B_nvsaad "Adaptionssperre Auslassvanos" UBYTE _CNV_S_2_Def_bit_ub_700_CM 1 100. 0. 1. DISPLAY_IDENTIFIER B_NVSAAD ECU_ADDRESS 0xd000790e BIT_MASK 0x1 /end MEASUREMENT
/begin MEASUREMENT St_restg.B_nvsead "Adaptionssperre Einlassvanos" UBYTE _CNV_S_2_Def_bit_ub_701_CM 1 100. 0. 2. DISPLAY_IDENTIFIER B_NVSEAD ECU_ADDRESS 0xd000790e BIT_MASK 0x2 /end MEASUREMENT
/begin MEASUREMENT St_rstg "Statuswort RESTGAS" UBYTE _CNV_R_R_Def_dez_sl_575_CM 1 100. 0. 255. DISPLAY_IDENTIFIER ST_RSTG ECU_ADDRESS 0xd0007918 FORMAT "%3.0" /end MEASUREMENT
/begin MEASUREMENT St_rstg.B_aspan "Bedingung zus. Auslassspreizung bei Schubabschalten" UBYTE _CNV_S_2_Def_bit_ub_702_CM 1 100. 0. 4. DISPLAY_IDENTIFIER B_ASPAN ECU_ADDRESS 0xd0007918 BIT_MASK 0x4 /end MEASUREMENT
/begin MEASUREMENT St_rstg.B_espan "Bedingung zus. Einlassspreizung bei Schubabschalten" UBYTE _CNV_S_2_Def_bit_ub_703_CM 1 100. 0. 8. DISPLAY_IDENTIFIER B_ESPAN ECU_ADDRESS 0xd0007918 BIT_MASK 0x8 /end MEASUREMENT
/begin MEASUREMENT St_rstg.B_vsast "Bedingung Auslassvanos Start" UBYTE _CNV_S_2_Def_bit_ub_704_CM 1 100. 0. 16. DISPLAY_IDENTIFIER B_VSAST ECU_ADDRESS 0xd0007918 BIT_MASK 0x10 /end MEASUREMENT
/begin MEASUREMENT St_rstg.B_vsest "Bedingung Einlassvanos Start" UBYTE _CNV_S_2_Def_bit_ub_705_CM 1 100. 0. 32. DISPLAY_IDENTIFIER B_VSEST ECU_ADDRESS 0xd0007918 BIT_MASK 0x20 /end MEASUREMENT
/begin MEASUREMENT St_rstg.B_vzare "Bedingung Auslassvanos verzögern" UBYTE _CNV_S_2_Def_bit_ub_706_CM 1 100. 0. 64. DISPLAY_IDENTIFIER B_VZARE ECU_ADDRESS 0xd0007918 BIT_MASK 0x40 /end MEASUREMENT
/begin MEASUREMENT St_rstg.B_vzere "Bedingung Einlassvanos verzögern" UBYTE _CNV_S_2_Def_bit_ub_707_CM 1 100. 0. 128. DISPLAY_IDENTIFIER B_VZERE ECU_ADDRESS 0xd0007918 BIT_MASK 0x80 /end MEASUREMENT
/begin MEASUREMENT St_rstg.B_wnwmnba "minimaler Adaptionsgrenzwert erreicht (Auslass), Sollwertbegrenzung aktiv" UBYTE _CNV_S_2_Def_bit_ub_701_CM 1 100. 0. 2. DISPLAY_IDENTIFIER B_WNWMNBA ECU_ADDRESS 0xd0007918 BIT_MASK 0x2 /end MEASUREMENT
/begin MEASUREMENT St_rstg.B_wnwmnbe "minimaler Adaptionsgrenzwert erreicht (Einlass), Sollwertbegrenzung aktiv" UBYTE _CNV_S_2_Def_bit_ub_700_CM 1 100. 0. 1. DISPLAY_IDENTIFIER B_WNWMNBE ECU_ADDRESS 0xd0007918 BIT_MASK 0x1 /end MEASUREMENT
/begin MEASUREMENT St_rstg1 "Statuswort RESTGAS" UBYTE _CNV_R_R_Def_dez_sl_575_CM 1 100. 0. 255. DISPLAY_IDENTIFIER ST_RSTG1 ECU_ADDRESS 0xd0007942 FORMAT "%3.0" /end MEASUREMENT
/begin MEASUREMENT St_rstg1.B_nrf_kl15vorab "Statuswort RESTGAS" UBYTE _CNV_S_2_Def_bit_ub_702_CM 1 100. 0. 4. DISPLAY_IDENTIFIER B_NRF_KL15VORAB ECU_ADDRESS 0xd0007942 BIT_MASK 0x4 /end MEASUREMENT
/begin MEASUREMENT St_rstg1.Rsthyst1 "Hysterest Einlassseite" UBYTE _CNV_S_2_Def_bit_ub_700_CM 1 100. 0. 1. DISPLAY_IDENTIFIER RSTHYST1 ECU_ADDRESS 0xd0007942 BIT_MASK 0x1 /end MEASUREMENT
/begin MEASUREMENT St_rstg1.Rsthyst2 "Hysterest Einlassseite" UBYTE _CNV_S_2_Def_bit_ub_701_CM 1 100. 0. 2. DISPLAY_IDENTIFIER RSTHYST2 ECU_ADDRESS 0xd0007942 BIT_MASK 0x2 /end MEASUREMENT
/begin MEASUREMENT Stat_sv_reg "Status Standverbraucher registriert" UWORD _CNV_R_R_Def_dez_sl_575_CM 1 100. 0. 65535. DISPLAY_IDENTIFIER STAT_SV_REG ECU_ADDRESS 0xc00028b6 FORMAT "%5.0" /end MEASUREMENT
/begin MEASUREMENT Stat_sv_reg1 "LoByte Stat_sv_reg für Umweltbedingungen" UBYTE _CNV_R_R_Def_dez_sl_575_CM 1 100. 0. 255. DISPLAY_IDENTIFIER STAT_SV_REG1 ECU_ADDRESS 0xc00028d1 FORMAT "%3.0" /end MEASUREMENT
/begin MEASUREMENT Stat_sv_reg2 "HiByte Stat_sv_reg für Umweltbedinung" UBYTE _CNV_R_R_Def_dez_sl_575_CM 1 100. 0. 255. DISPLAY_IDENTIFIER STAT_SV_REG2 ECU_ADDRESS 0xc00028d2 FORMAT "%3.0" /end MEASUREMENT
/begin MEASUREMENT Stpcos "Status_Standverbraucher" UBYTE _CNV_R_R_Def_dez_sl_575_CM 1 100. 0. 3. DISPLAY_IDENTIFIER STPCOS ECU_ADDRESS 0xc0002967 FORMAT "%3.0" /end MEASUREMENT
/begin MEASUREMENT Stpcos7 "lokales stpcos" UBYTE _CNV_R_R_Def_dez_sl_575_CM 1 100. 0. 3. DISPLAY_IDENTIFIER STPCOS7 ECU_ADDRESS 0xc00046ca FORMAT "%3.0" /end MEASUREMENT
/begin MEASUREMENT Stpcosmem "altes stpcos" UBYTE _CNV_R_R_Def_dez_sl_575_CM 1 100. 0. 3. DISPLAY_IDENTIFIER STPCOSMEM ECU_ADDRESS 0xc0002968 FORMAT "%3.0" /end MEASUREMENT
/begin MEASUREMENT Svaus "Status Standverbraucher sind aus " UBYTE _CNV_R_R_Def_dez_sl_575_CM 1 100. 0. 1. DISPLAY_IDENTIFIER SVAUS ECU_ADDRESS 0xc00028d3 FORMAT "%4.1" /end MEASUREMENT
/begin MEASUREMENT T1histshort "T1 Histogramm in 14.9333 MIn. Quantisiert" UBYTE _CNV_R_R_Def_td_ub__716_CM 1 100. 0. 3808. DISPLAY_IDENTIFIER T1HISTSHORT ECU_ADDRESS 0xc00028d4 FORMAT "%5.2" /end MEASUREMENT
/begin MEASUREMENT T1pmcntr "T1PMINFO countdowncounter" UBYTE _CNV_R_R_Def_td_ub__593_CM 1 100. 0. 25.5 DISPLAY_IDENTIFIER T1PMCNTR ECU_ADDRESS 0xc00028d5 FORMAT "%4.1" /end MEASUREMENT
/begin MEASUREMENT T2hist "T2histitruh in sek." UWORD _CNV_R_R_Def_td_uw__717_CM 1 100. 0. 917490. DISPLAY_IDENTIFIER T2HIST ECU_ADDRESS 0xc00028b8 FORMAT "%7.2" /end MEASUREMENT
/begin MEASUREMENT T2histshort "T2 Histogramm als Umweltbed. bei Ruhestromverletzung" UBYTE _CNV_R_R_Def_td_ub__716_CM 1 100. 0. 3808. DISPLAY_IDENTIFIER T2HISTSHORT ECU_ADDRESS 0xc00028d6 FORMAT "%5.2" /end MEASUREMENT
/begin MEASUREMENT T2pmcntr "T2PMINFO countdowncounter" UWORD _CNV_R_R_Def_td_ub__593_CM 1 100. 0. 6553.5 DISPLAY_IDENTIFIER T2PMCNTR ECU_ADDRESS 0xc00028ba FORMAT "%6.1" /end MEASUREMENT
/begin MEASUREMENT T3hist "T3histiruh in Sek" UWORD _CNV_R_R_Def_td_uw__717_CM 1 100. 0. 917490. DISPLAY_IDENTIFIER T3HIST ECU_ADDRESS 0xc00028bc FORMAT "%7.2" /end MEASUREMENT
/begin MEASUREMENT T3histshort "T3 Histogramm als Umweltbed. bei Ruhestromverletzung" UBYTE _CNV_R_R_Def_td_ub__716_CM 1 100. 0. 3808. DISPLAY_IDENTIFIER T3HISTSHORT ECU_ADDRESS 0xc00028d7 FORMAT "%5.2" /end MEASUREMENT
/begin MEASUREMENT T3pmcntr "T3PMINFO countdowncounter" UWORD _CNV_R_R_Def_td_ub__593_CM 1 100. 0. 6553.5 DISPLAY_IDENTIFIER T3PMCNTR ECU_ADDRESS 0xc00028be FORMAT "%6.1" /end MEASUREMENT
/begin MEASUREMENT T4hist "T4histiruh in Sek" UWORD _CNV_R_R_Def_td_uw__717_CM 1 100. 0. 917490. DISPLAY_IDENTIFIER T4HIST ECU_ADDRESS 0xc00028c0 FORMAT "%7.2" /end MEASUREMENT
/begin MEASUREMENT T4histshort "T4 Histogramm als Umweltbed. bei Ruhestromverletzung" UBYTE _CNV_R_R_Def_td_ub__716_CM 1 100. 0. 3808. DISPLAY_IDENTIFIER T4HISTSHORT ECU_ADDRESS 0xc00028d8 FORMAT "%5.2" /end MEASUREMENT
/begin MEASUREMENT T_bnmotakt "Zeit nachdem der Motor laeuft, hoert nach T_B_NMOT Sekunden auf." UBYTE _CNV_R_R_Def_td_uw__682_CM 1 100. 0. 255. DISPLAY_IDENTIFIER T_BNMOTAKT ECU_ADDRESS 0xc0005246 FORMAT "%5.2" /end MEASUREMENT
/begin MEASUREMENT T_delta "Zeit, die seit letzem Prozessaufruf verstrichen ist. Dient zur Taskkompatibilitaet." UBYTE _CNV_R_R_Def_td_uw__682_CM 1 100. 0. 255. DISPLAY_IDENTIFIER T_DELTA ECU_ADDRESS 0xc0005247 FORMAT "%5.2" /end MEASUREMENT
/begin MEASUREMENT T_histsum "Txhistiruh Summe" UWORD _CNV_R_R_Def_td_uw__718_CM 1 100. 0. 3669960. DISPLAY_IDENTIFIER T_HISTSUM ECU_ADDRESS 0xc00028c2 FORMAT "%7.2" /end MEASUREMENT
/begin MEASUREMENT T_histsummin "Summe der Txhistiruh in Minuten" UWORD _CNV_R_R_Def_td_uw__719_CM 1 100. 0. 61166. DISPLAY_IDENTIFIER T_HISTSUMMIN ECU_ADDRESS 0xc00028c4 FORMAT "%7.2" /end MEASUREMENT
/begin MEASUREMENT T_oel_fak "Faktor für Einfluss Öldruck Reglerausgang in abh. Toel" UWORD _CNV_R_R_Def_f_uw_b_591_CM 1 100. 0. 0.9999 DISPLAY_IDENTIFIER T_OEL_FAK ECU_ADDRESS 0xd0006b40 FORMAT "%14.5" /end MEASUREMENT
/begin MEASUREMENT T_saismem "T Saison zw. speicher" UBYTE _CNV_R_R_Def_dez_sl_575_CM 1 100. 0. 255. DISPLAY_IDENTIFIER T_SAISMEM ECU_ADDRESS 0xc00028d9 FORMAT "%3.0" /end MEASUREMENT
/begin MEASUREMENT T_saison "Saison -Temperatur" SWORD _CNV_R_R_Def_t_sw_q_618_CM 1 100. -3276.8 3276.7 DISPLAY_IDENTIFIER T_SAISON ECU_ADDRESS 0xc00046e6 FORMAT "%6.1" /end MEASUREMENT
/begin MEASUREMENT T_saisonalt "letzter Wert Saisontemperatur" SWORD _CNV_R_R_Def_t_sw_q_618_CM 1 100. -3276.8 3276.7 DISPLAY_IDENTIFIER T_SAISONALT ECU_ADDRESS 0xc0005226 FORMAT "%6.1" /end MEASUREMENT
/begin MEASUREMENT Tdffgen "Zeitzähler für Erkennung Generatorlastschwankung für Leerlaufanhebung" UWORD _CNV_R_R_Def_td_uw__726_CM 1 100. 0. 13107. DISPLAY_IDENTIFIER TDFFGEN ECU_ADDRESS 0xc000524c FORMAT "%6.1" /end MEASUREMENT
/begin MEASUREMENT Tsocloc "Batterietemperatur zum Zeitpunkt der Ruhespannungsmessung (lokal)" SWORD _CNV_R_R_Def_t_sw_q_618_CM 1 100. -3276.8 3276.7 DISPLAY_IDENTIFIER TSOCLOC ECU_ADDRESS 0xc000520a FORMAT "%6.1" /end MEASUREMENT
/begin MEASUREMENT Tv_poel "Tastverhältnis Öldruck Regelventil" UWORD _CNV_R_R_Def_f_uw_b_576_CM 1 100. 0. 99.9984 DISPLAY_IDENTIFIER TV_POEL ECU_ADDRESS 0xd0006b30 FORMAT "%8.3" /end MEASUREMENT
/begin MEASUREMENT U_grenz "Grenzwert Spannung" UWORD _CNV_R_R_Def_u_uw_q_730_CM 1 100. 6. 22.3837 DISPLAY_IDENTIFIER U_GRENZ ECU_ADDRESS 0xc0002998 FORMAT "%9.4" /end MEASUREMENT
/begin MEASUREMENT U_ibs "Generatorspannungsvorgabe von IBS" SWORD _CNV_R_R_Def_u_sw_b_732_CM 1 100. -128. 127.996 DISPLAY_IDENTIFIER U_IBS ECU_ADDRESS 0xc0005238 FORMAT "%8.3" /end MEASUREMENT
/begin MEASUREMENT U_igrdetec "U_gsoll - U_ibs für IGRLOW Detektierung" SWORD _CNV_R_R_Def_u_sw_b_732_CM 1 100. -128. 127.996 DISPLAY_IDENTIFIER U_IGRDETEC ECU_ADDRESS 0xc000523a FORMAT "%8.3" /end MEASUREMENT
/begin MEASUREMENT U_startausw "U_tnstart - ugrenz" SWORD _CNV_R_R_Def_u_sw_q_733_CM 1 100. -8.192 8.191700000000001 DISPLAY_IDENTIFIER U_STARTAUSW ECU_ADDRESS 0xc0002994 FORMAT "%9.4" /end MEASUREMENT
/begin MEASUREMENT Ub_old "letzter Wert Batteriespannung" UWORD _CNV_R_R_Def_u_sb_q_598_CM 1 100. 0. 6173.397 DISPLAY_IDENTIFIER UB_OLD ECU_ADDRESS 0xd00072a0 FORMAT "%6.1" /end MEASUREMENT
/begin MEASUREMENT Ubatt0 "Aus Wertetripel ausgewählter Ruhespannungswert" UWORD _CNV_R_R_Def_u_uw_q_730_CM 1 100. 6. 22.3837 DISPLAY_IDENTIFIER UBATT0 ECU_ADDRESS 0xc0005214 FORMAT "%9.4" /end MEASUREMENT
/begin MEASUREMENT Ubatts2 "Hilfswert2 Spannung aus Fitberechnung" UWORD _CNV_R_R_Def_u_uw_q_730_CM 1 100. 6. 16. DISPLAY_IDENTIFIER UBATTS2 ECU_ADDRESS 0xc000521e FORMAT "%9.4" /end MEASUREMENT
/begin MEASUREMENT Ubattsoll "Batteriesollspannung aufgrund Batterietemperatur und Batt.-ladezustand. Weitere Nutzung in PMPRSVCALC." UWORD _CNV_R_R_Def_u_uw_q_730_CM 1 100. 6. 22.3837 DISPLAY_IDENTIFIER UBATTSOLL ECU_ADDRESS 0xc0005242 FORMAT "%9.4" /end MEASUREMENT
/begin MEASUREMENT Ubattsoll7 "lokales ubattsoll" UWORD _CNV_R_R_Def_u_uw_q_730_CM 1 100. 6. 22.3837 DISPLAY_IDENTIFIER UBATTSOLL7 ECU_ADDRESS 0xc0005244 FORMAT "%9.4" /end MEASUREMENT
/begin MEASUREMENT Ubdiff "ubattsoll - ubatt_w" SWORD _CNV_R_R_Def_f_sw_b_577_CM 1 100. -32. 31.999 DISPLAY_IDENTIFIER UBDIFF ECU_ADDRESS 0xc000290a FORMAT "%9.4" /end MEASUREMENT
/begin MEASUREMENT Ubdiff2pi "Ubatt-Differenz-Gewichtung auf Prios" SWORD _CNV_R_R_Def_f_sw_p_581_CM 1 100. -100. 100. DISPLAY_IDENTIFIER UBDIFF2PI ECU_ADDRESS 0xc000290c FORMAT "%7.2" /end MEASUREMENT
/begin MEASUREMENT Ubdiffilt "Wert nach Ubdiff-Tiefpass Prio" SWORD _CNV_R_R_Def_f_sw_b_577_CM 1 100. -32. 31.999 DISPLAY_IDENTIFIER UBDIFFILT ECU_ADDRESS 0xc000290e FORMAT "%9.4" /end MEASUREMENT
/begin MEASUREMENT Ubdiffptc "Delta Usoll-Ubatt PTC" SWORD _CNV_R_R_Def_f_sw_b_577_CM 1 100. -32. 31.999 DISPLAY_IDENTIFIER UBDIFFPTC ECU_ADDRESS 0xc0002910 FORMAT "%9.4" /end MEASUREMENT
/begin MEASUREMENT Ubold7 "PTC dudt : alter Ub Wert zur Differenzbildung" UWORD _CNV_R_R_Def_u_sb_q_598_CM 1 100. 0. 6173.397 DISPLAY_IDENTIFIER UBOLD7 ECU_ADDRESS 0xc0002940 FORMAT "%6.1" /end MEASUREMENT
/begin MEASUREMENT Ubt "Batteriespannung" UWORD _CNV_R_R_Def_u_uw_q_735_CM 1 100. 0. 983.025 DISPLAY_IDENTIFIER UBT ECU_ADDRESS 0xc0002942 FORMAT "%8.3" /end MEASUREMENT
/begin MEASUREMENT Ubt7 "Lokale Batteriespannung" UWORD _CNV_R_R_Def_u_uw_q_735_CM 1 100. 0. 61.425 DISPLAY_IDENTIFIER UBT7 ECU_ADDRESS 0xc0002944 FORMAT "%8.3" /end MEASUREMENT
/begin MEASUREMENT Ubt7mem "resultierendes ubt" SWORD _CNV_R_R_Def_u_sw_b_732_CM 1 100. -128. 127.996 DISPLAY_IDENTIFIER UBT7MEM ECU_ADDRESS 0xc0002912 FORMAT "%8.3" /end MEASUREMENT
/begin MEASUREMENT Ubt7old "altes ubt" UWORD _CNV_R_R_Def_u_uw_q_735_CM 1 100. 0. 61.425 DISPLAY_IDENTIFIER UBT7OLD ECU_ADDRESS 0xc0002946 FORMAT "%8.3" /end MEASUREMENT
/begin MEASUREMENT Ubtpt12ptc "Ubatt Gewichtung für PTC Ansteuerung" SWORD _CNV_R_R_Def_f_sw_p_581_CM 1 100. -100. 100. DISPLAY_IDENTIFIER UBTPT12PTC ECU_ADDRESS 0xc0002914 FORMAT "%7.2" /end MEASUREMENT
/begin MEASUREMENT Ubtpt1ptc "Ubdiffptc gefiltert" SWORD _CNV_R_R_Def_f_sw_b_577_CM 1 100. -32. 31.999 DISPLAY_IDENTIFIER UBTPT1PTC ECU_ADDRESS 0xc0002916 FORMAT "%9.4" /end MEASUREMENT
/begin MEASUREMENT Udelta "Delta zw. Battsollspg und Battspg" SWORD _CNV_R_R_Def_u_sw_q_733_CM 1 100. -8.192 8.191700000000001 DISPLAY_IDENTIFIER UDELTA ECU_ADDRESS 0xc000523c FORMAT "%9.4" /end MEASUREMENT
/begin MEASUREMENT Udeltaabs "Absolutwert von udelta" SWORD _CNV_R_R_Def_u_sw_q_733_CM 1 100. 0. 8.191700000000001 DISPLAY_IDENTIFIER UDELTAABS ECU_ADDRESS 0xc000523e FORMAT "%9.4" /end MEASUREMENT
/begin MEASUREMENT Udeltaabsc "absoluter Wert von udelta" UWORD _CNV_R_R_Def_u_uw_q_735_CM 1 100. 0. 61.425 DISPLAY_IDENTIFIER UDELTAABSC ECU_ADDRESS 0xc0002948 FORMAT "%8.3" /end MEASUREMENT
/begin MEASUREMENT Udeltac "inkrementierte Differenz zwischen altem und neuem ubt" SWORD _CNV_R_R_Def_u_sw_b_732_CM 1 100. -128. 127.996 DISPLAY_IDENTIFIER UDELTAC ECU_ADDRESS 0xc0002918 FORMAT "%8.3" /end MEASUREMENT
/begin MEASUREMENT Uibs7 "lokales uibs" SWORD _CNV_R_R_Def_u_sw_b_732_CM 1 100. -128. 127.996 DISPLAY_IDENTIFIER UIBS7 ECU_ADDRESS 0xc0005240 FORMAT "%8.3" /end MEASUREMENT
/begin MEASUREMENT Ulev "Spannungsebene" UBYTE _CNV_R_R_Def_dez_sl_575_CM 1 100. 0. 15. DISPLAY_IDENTIFIER ULEV ECU_ADDRESS 0xc0002969 FORMAT "%3.0" /end MEASUREMENT
/begin MEASUREMENT Ulevmem "altes ulev" UBYTE _CNV_R_R_Def_dez_sl_575_CM 1 100. 0. 15. DISPLAY_IDENTIFIER ULEVMEM ECU_ADDRESS 0xc000296a FORMAT "%3.0" /end MEASUREMENT
/begin MEASUREMENT Ulow "Unterspannungsstatus : 0=i.O, 1=in between, 2=unterspannung" UBYTE _CNV_R_R_Def_dez_sl_575_CM 1 100. 0. 255. DISPLAY_IDENTIFIER ULOW ECU_ADDRESS 0xc000296b FORMAT "%3.0" /end MEASUREMENT
/begin MEASUREMENT Ulowtimer "Zeit zur Unterspannungserkennung * Taskzeit (50*100ms = 5sec)" UBYTE _CNV_R_R_Def_td_ub__593_CM 1 100. 0. 25.5 DISPLAY_IDENTIFIER ULOWTIMER ECU_ADDRESS 0xc000296c FORMAT "%4.1" /end MEASUREMENT
/begin MEASUREMENT Uspgcnt "FS_Unterspannungscounter" UBYTE _CNV_R_R_Def_td_ub__593_CM 1 100. 0. 25.5 DISPLAY_IDENTIFIER USPGCNT ECU_ADDRESS 0xc00028da FORMAT "%4.1" /end MEASUREMENT
/begin MEASUREMENT Uspgprell "Anzahl der entprellten FS_Unterspannungserkennung." UBYTE _CNV_R_R_Def_dez_sl_575_CM 1 100. 0. 255. DISPLAY_IDENTIFIER USPGPRELL ECU_ADDRESS 0xc00028db FORMAT "%3.0" /end MEASUREMENT
/begin MEASUREMENT Uspgstat "FS_Unterspannungsstatus" UBYTE _CNV_R_R_Def_dez_sl_575_CM 1 100. 0. 255. DISPLAY_IDENTIFIER USPGSTAT ECU_ADDRESS 0xc00028dc FORMAT "%3.0" /end MEASUREMENT
/begin MEASUREMENT V_pgenllkor "Fahrzeuggeschwindigkeit korrigiert" UWORD _CNV_R_R_Def_v_uw_q_738_CM 1 100. 0. 6553.5 DISPLAY_IDENTIFIER V_PGENLLKOR ECU_ADDRESS 0xd00072e2 FORMAT "%7.2" /end MEASUREMENT
/begin MEASUREMENT Vsa_admn "min. Adaptionswert Auslassvanos" UWORD _CNV_R_R_Def_spr_sw_583_CM 1 100. 0. 180. DISPLAY_IDENTIFIER VSA_ADMN ECU_ADDRESS 0xd0007948 FORMAT "%7.2" /end MEASUREMENT
/begin MEASUREMENT Vsa_sprn "Normspreizung Auslass" UWORD _CNV_R_R_Def_spr_sw_583_CM 1 100. 0. 6553.5 DISPLAY_IDENTIFIER VSA_SPRN ECU_ADDRESS 0xd0007914 FORMAT "%7.2" /end MEASUREMENT
/begin MEASUREMENT Vsa_vzt "Verzögerungszeit Auslassvanos" UBYTE _CNV_R_R_Def_td_uw__679_CM 1 100. 0. 2.55 DISPLAY_IDENTIFIER VSA_VZT ECU_ADDRESS 0xd0007943 FORMAT "%5.2" /end MEASUREMENT
/begin MEASUREMENT Vsa_vzz "Erfolgte Anzahl an Nachtriggerungen (Einlassseite)" UBYTE _CNV_R_R_Def_dez_sl_575_CM 1 100. 0. 255. DISPLAY_IDENTIFIER VSA_VZZ ECU_ADDRESS 0xd0007944 FORMAT "%3.0" /end MEASUREMENT
/begin MEASUREMENT Vse_admn "min. Adaptionswert Einlassvanos" UWORD _CNV_R_R_Def_spr_sw_583_CM 1 100. 0. 180. DISPLAY_IDENTIFIER VSE_ADMN ECU_ADDRESS 0xd0007946 FORMAT "%7.2" /end MEASUREMENT
/begin MEASUREMENT Vse_sprn "Normspreizung Einlass" UWORD _CNV_R_R_Def_spr_sw_583_CM 1 100. 0. 6553.5 DISPLAY_IDENTIFIER VSE_SPRN ECU_ADDRESS 0xd0007916 FORMAT "%7.2" /end MEASUREMENT
/begin MEASUREMENT Vse_vzt "Verzögerungszeit Einlassvanos" UBYTE _CNV_R_R_Def_td_uw__679_CM 1 100. 0. 2.55 DISPLAY_IDENTIFIER VSE_VZT ECU_ADDRESS 0xd000794a FORMAT "%5.2" /end MEASUREMENT
/begin MEASUREMENT Vse_vzz "Erfolgte Anzahl an Nachtriggerungen (Einlassseite)" UBYTE _CNV_R_R_Def_dez_sl_575_CM 1 100. 0. 255. DISPLAY_IDENTIFIER VSE_VZZ ECU_ADDRESS 0xd000794b FORMAT "%3.0" /end MEASUREMENT
/begin MEASUREMENT Wnwsamn "minimale Auslass Sollspreizung" UWORD _CNV_R_R_Def_spr_sw_583_CM 1 100. 0. 180. DISPLAY_IDENTIFIER WNWSAMN ECU_ADDRESS 0xd000795e FORMAT "%7.2" /end MEASUREMENT
/begin MEASUREMENT Wnwsemn "minimale Einlass Sollspreizung" UWORD _CNV_R_R_Def_spr_sw_583_CM 1 100. 0. 180. DISPLAY_IDENTIFIER WNWSEMN ECU_ADDRESS 0xd000795c FORMAT "%7.2" /end MEASUREMENT
/begin MEASUREMENT Ztagedelta "verstrichene Tage" UBYTE _CNV_R_R_Def_dez_sl_575_CM 1 100. 0. 10. DISPLAY_IDENTIFIER ZTAGEDELTA ECU_ADDRESS 0xc00028dd FORMAT "%3.0" /end MEASUREMENT
/begin MEASUREMENT Ztageold "letzter Wert von ztageabs_w" UWORD _CNV_R_R_Def_dez_sl_575_CM 1 100. 0. 65535. DISPLAY_IDENTIFIER ZTAGEOLD ECU_ADDRESS 0xc00046a2 FORMAT "%5.0" /end MEASUREMENT
/begin MEASUREMENT Ztagestate "Tageswechsel Statemachine Ctr" UBYTE _CNV_R_R_Def_dez_sl_575_CM 1 100. 0. 255. DISPLAY_IDENTIFIER ZTAGESTATE ECU_ADDRESS 0xc00028de FORMAT "%3.0" /end MEASUREMENT
/begin MEASUREMENT kbmcount "Counter, gesetzt von KBMCNT_APP" UBYTE _CNV_R_R_Def_td_ub__593_CM 1 100. 0. 25.5 DISPLAY_IDENTIFIER KBMCOUNT ECU_ADDRESS 0xc000296d FORMAT "%4.1" /end MEASUREMENT
/begin CHARACTERISTIC CBATT_DEF "Ersatzwert Batteriekapazität" VALUE 0xa1017918 _REC_VAL_20_u1 99.06 _CNV_R_R_DEZ_436_CM 1. 255. FORMAT "%4.1" /end CHARACTERISTIC
/begin CHARACTERISTIC CW_CCMASK "CC-Meldung Maske" VALUE 0xa1017562 _REC_VAL_20_u1 99.45 _CNV_R_R_Def_dez_sl_575_CM 0. 255. FORMAT "%3.0" /end CHARACTERISTIC
/begin CHARACTERISTIC CW_PMDEFMASK "Bitcodierte Maske zum Setzen von PM Defekt" VALUE 0xa1017563 _REC_VAL_20_u1 99.45 _CNV_R_R_Def_dez_sl_575_CM 0. 255. FORMAT "%3.0" /end CHARACTERISTIC
/begin CHARACTERISTIC CW_PMMASKDFP "Powermanagement Fehlerpseicher Maske" VALUE 0xa1017564 _REC_VAL_20_u1 99.45 _CNV_R_R_Def_dez_sl_575_CM 0. 255. FORMAT "%3.0" /end CHARACTERISTIC
/begin CHARACTERISTIC CW_POEL "Codewort P_oel" VALUE 0xa100e1a4 _REC_VAL_20_u1 99.45 _CNV_R_R_Def_dez_sl_575_CM 0. 255. FORMAT "%3.0" /end CHARACTERISTIC
/begin CHARACTERISTIC KF_ALLW "Kennfeld Leerlauf Auslassspreizung gedrosselt warm" MAP 0xa101dd08 _REC_MAP_52_u1_s2_s2 99.96000000000001 _CNV_R_R_Def_spr_ub_582_CM 0. 204. FORMAT "%5.2"
 /begin AXIS_DESCR STD_AXIS Nkw _CNV_R_R_Def_n_sw_q_612_CM 12 -32768. 32767. FORMAT "%5.0" /end AXIS_DESCR
 /begin AXIS_DESCR STD_AXIS Rk_soll_s _CNV_R_R_Def_rk_sw__697_CM 12 -1600. 1599.9511 /end AXIS_DESCR
/end CHARACTERISTIC
/begin CHARACTERISTIC KF_DASTDLL "" MAP 0xa101e27c _REC_MAP_52_u1_u2_s2 99.96000000000001 _CNV_R_R_Def_spr_ub_582_CM 0. 204. FORMAT "%5.2" /begin AXIS_DESCR STD_AXIS Minhub _CNV_R_R_Def_hub_uw_605_CM 6 0. 65.535 /end AXIS_DESCR
 /begin AXIS_DESCR STD_AXIS Dpssolfilt _CNV_R_R_Def_p_sw_q_578_CM 6 -1280. 1279.9609 FORMAT "%5.2" /end AXIS_DESCR
/end CHARACTERISTIC
/begin CHARACTERISTIC KF_DASTDT "" MAP 0xa101e23c _REC_MAP_52_u1_u2_s2 99.96000000000001 _CNV_R_R_Def_spr_ub_582_CM 0. 204. FORMAT "%5.2" /begin AXIS_DESCR STD_AXIS Minhub _CNV_R_R_Def_hub_uw_605_CM 6 0. 65.535 /end AXIS_DESCR
 /begin AXIS_DESCR STD_AXIS Dpssolfilt _CNV_R_R_Def_p_sw_q_578_CM 6 -1280. 1279.9609 FORMAT "%5.2" /end AXIS_DESCR
/end CHARACTERISTIC
/begin CHARACTERISTIC KF_DESTDLL "" MAP 0xa101e1fc _REC_MAP_52_u1_u2_s2 99.96000000000001 _CNV_R_R_Def_spr_ub_582_CM 0. 204. FORMAT "%5.2" /begin AXIS_DESCR STD_AXIS Minhub _CNV_R_R_Def_hub_uw_605_CM 6 0. 65.535 /end AXIS_DESCR
 /begin AXIS_DESCR STD_AXIS Dpssolfilt _CNV_R_R_Def_p_sw_q_578_CM 6 -1280. 1279.9609 FORMAT "%5.2" /end AXIS_DESCR
/end CHARACTERISTIC
/begin CHARACTERISTIC KF_DESTDT "" MAP 0xa101e1bc _REC_MAP_52_u1_u2_s2 99.96000000000001 _CNV_R_R_Def_spr_ub_582_CM 0. 204. FORMAT "%5.2" /begin AXIS_DESCR STD_AXIS Minhub _CNV_R_R_Def_hub_uw_605_CM 6 0. 65.535 /end AXIS_DESCR
 /begin AXIS_DESCR STD_AXIS Dpssolfilt _CNV_R_R_Def_p_sw_q_578_CM 6 -1280. 1279.9609 FORMAT "%5.2" /end AXIS_DESCR
/end CHARACTERISTIC
/begin CHARACTERISTIC KF_ELLW "Kennfeld Leerlauf Einlassspreizung gedrosselt warm" MAP 0xa101da4c _REC_MAP_52_u1_s2_s2 99.96000000000001 _CNV_R_R_Def_spr_ub_582_CM 0. 204. FORMAT "%5.2"
 /begin AXIS_DESCR STD_AXIS Nkw _CNV_R_R_Def_n_sw_q_612_CM 12 -32768. 32767. FORMAT "%5.0" /end AXIS_DESCR
 /begin AXIS_DESCR STD_AXIS Rk_soll_s _CNV_R_R_Def_rk_sw__697_CM 12 -1600. 1599.9511 /end AXIS_DESCR
/end CHARACTERISTIC
/begin CHARACTERISTIC KF_IBTSOLL "KFSollstrom aufgrund von Batterietemperatur und Ladezustand." MAP 0xa10178bc _REC_MAP_52_UBYTE_u2_s2_s2 104.856 _CNV_R_R_Def_i_uw_q_642_CM -200. 5042.8
 /begin AXIS_DESCR STD_AXIS T_batt _CNV_R_R_Def_t_sw_q_618_CM 5 -3276.8 3276.7 FORMAT "%4.1" /end AXIS_DESCR
 /begin AXIS_DESCR STD_AXIS D_soc _CNV_R_R_Def_f_sw_b_597_CM 6 -100. 99.9969 /end AXIS_DESCR
/end CHARACTERISTIC
/begin CHARACTERISTIC KF_KASLL "" MAP 0xa101d6e4 _REC_MAP_52_u1_s2_s2 99.96000000000001 _CNV_R_R_Def_spr_ub_582_CM 0. 204. FORMAT "%5.2"
 /begin AXIS_DESCR STD_AXIS Nkw _CNV_R_R_Def_n_sw_q_612_CM 12 -32768. 32767. FORMAT "%5.0" /end AXIS_DESCR
 /begin AXIS_DESCR STD_AXIS Rfv_vns _CNV_R_R_Def_rf_sw__616_CM 5 -327.68 327.67 FORMAT "%7.4" /end AXIS_DESCR
/end CHARACTERISTIC
/begin CHARACTERISTIC KF_KASLL_HS "" MAP 0xa101e70c _REC_MAP_52_u1_s2_s2 99.96000000000001 _CNV_R_R_Def_spr_ub_582_CM 0. 204. FORMAT "%5.2"
 /begin AXIS_DESCR STD_AXIS Nkw _CNV_R_R_Def_n_sw_q_612_CM 12 -32768. 32767. FORMAT "%5.0" /end AXIS_DESCR
 /begin AXIS_DESCR STD_AXIS Rk_soll_hs _CNV_R_R_Def_rk_sw__697_CM 5 -1600. 1599.9511 /end AXIS_DESCR
/end CHARACTERISTIC
/begin CHARACTERISTIC KF_KASOPT "Kennfeld optimale Auslassspreizung kalt teilgedrosselt" MAP 0xa101db10 _REC_MAP_52_u1_s2_s2 99.96000000000001 _CNV_R_R_Def_spr_ub_582_CM 0. 204. FORMAT "%5.2"
 /begin AXIS_DESCR STD_AXIS Nkw _CNV_R_R_Def_n_sw_q_612_CM 16 -32768. 32767. FORMAT "%5.0" /end AXIS_DESCR
 /begin AXIS_DESCR STD_AXIS Rk_soll_s _CNV_R_R_Def_rk_sw__697_CM 12 -1600. 1599.9511 /end AXIS_DESCR
/end CHARACTERISTIC
/begin CHARACTERISTIC KF_KASOPT_HS "Kennfeld optimale Auslassspreizung kalt Homogen_Schicht" MAP 0xa101e4b4 _REC_MAP_52_u1_s2_s2 99.96000000000001 _CNV_R_R_Def_spr_ub_582_CM 0. 204. FORMAT "%5.2"
 /begin AXIS_DESCR STD_AXIS Nkw _CNV_R_R_Def_n_sw_q_612_CM 16 -32768. 32767. FORMAT "%5.0" /end AXIS_DESCR
 /begin AXIS_DESCR STD_AXIS Rk_soll_hs _CNV_R_R_Def_rk_sw__697_CM 12 -1600. 1599.9511 /end AXIS_DESCR
/end CHARACTERISTIC
/begin CHARACTERISTIC KF_KASOPU "Kennfeld optimale Auslassspreizung kalt ungedrosselt" MAP 0xa101e0c0 _REC_MAP_52_u1_s2_s2 99.96000000000001 _CNV_R_R_Def_spr_ub_582_CM 0. 204. FORMAT "%5.2"
 /begin AXIS_DESCR STD_AXIS Nkw _CNV_R_R_Def_n_sw_q_612_CM 16 -32768. 32767. FORMAT "%5.0" /end AXIS_DESCR
 /begin AXIS_DESCR STD_AXIS Rfv_vns _CNV_R_R_Def_rf_sw__616_CM 12 -327.68 327.67 FORMAT "%7.4" /end AXIS_DESCR
/end CHARACTERISTIC
/begin CHARACTERISTIC KF_KESLL "" MAP 0xa101d684 _REC_MAP_52_u1_s2_s2 99.96000000000001 _CNV_R_R_Def_spr_ub_582_CM 0. 204. FORMAT "%5.2"
 /begin AXIS_DESCR STD_AXIS Nkw _CNV_R_R_Def_n_sw_q_612_CM 12 -32768. 32767. FORMAT "%5.0" /end AXIS_DESCR
 /begin AXIS_DESCR STD_AXIS Rfv_vns _CNV_R_R_Def_rf_sw__616_CM 5 -327.68 327.67 FORMAT "%7.4" /end AXIS_DESCR
/end CHARACTERISTIC
/begin CHARACTERISTIC KF_KESLL_HS "" MAP 0xa101e6ac _REC_MAP_52_u1_s2_s2 99.96000000000001 _CNV_R_R_Def_spr_ub_582_CM 0. 204. FORMAT "%5.2"
 /begin AXIS_DESCR STD_AXIS Nkw _CNV_R_R_Def_n_sw_q_612_CM 12 -32768. 32767. FORMAT "%5.0" /end AXIS_DESCR
 /begin AXIS_DESCR STD_AXIS Rk_soll_hs _CNV_R_R_Def_rk_sw__697_CM 5 -1600. 1599.9511 /end AXIS_DESCR
/end CHARACTERISTIC
/begin CHARACTERISTIC KF_KESOPT "Kennfeld optimale Einlassspreizung kalt teilgedrosselt" MAP 0xa101d854 _REC_MAP_52_u1_s2_s2 99.96000000000001 _CNV_R_R_Def_spr_ub_582_CM 0. 204. FORMAT "%5.2"
 /begin AXIS_DESCR STD_AXIS Nkw _CNV_R_R_Def_n_sw_q_612_CM 16 -32768. 32767. FORMAT "%5.0" /end AXIS_DESCR
 /begin AXIS_DESCR STD_AXIS Rk_soll_s _CNV_R_R_Def_rk_sw__697_CM 12 -1600. 1599.9511 /end AXIS_DESCR
/end CHARACTERISTIC
/begin CHARACTERISTIC KF_KESOPT_HS "Kennfeld optimale Einlassspreizung kalt Homogen_Schicht" MAP 0xa101e2bc _REC_MAP_52_u1_s2_s2 99.96000000000001 _CNV_R_R_Def_spr_ub_582_CM 0. 204. FORMAT "%5.2"
 /begin AXIS_DESCR STD_AXIS Nkw _CNV_R_R_Def_n_sw_q_612_CM 16 -32768. 32767. FORMAT "%5.0" /end AXIS_DESCR
 /begin AXIS_DESCR STD_AXIS Rk_soll_hs _CNV_R_R_Def_rk_sw__697_CM 12 -1600. 1599.9511 /end AXIS_DESCR
/end CHARACTERISTIC
/begin CHARACTERISTIC KF_KESOPU "Kennfeld optimale Einlassspreizung kalt ungedrosselt" MAP 0xa101dfc4 _REC_MAP_52_u1_s2_s2 99.96000000000001 _CNV_R_R_Def_spr_ub_582_CM 0. 204. FORMAT "%5.2"
 /begin AXIS_DESCR STD_AXIS Nkw _CNV_R_R_Def_n_sw_q_612_CM 16 -32768. 32767. FORMAT "%5.0" /end AXIS_DESCR
 /begin AXIS_DESCR STD_AXIS Rfv_vns _CNV_R_R_Def_rf_sw__616_CM 12 -327.68 327.67 FORMAT "%7.4" /end AXIS_DESCR
/end CHARACTERISTIC
/begin CHARACTERISTIC KF_PMRIBAT1 "Kennfeld Innenwiderstand Batterie" MAP 0xa1017ab4 _REC_MAP_52_u1_s2_u2 0.255 _CNV_R_R_Def_f_ub_q_755_CM 0. 0.255
 /begin AXIS_DESCR STD_AXIS T_batt _CNV_R_R_Def_t_sw_q_618_CM 4 -3276.8 3276.7 FORMAT "%4.1" /end AXIS_DESCR
 /begin AXIS_DESCR STD_AXIS I_batt _CNV_R_R_Def_i_uw_q_642_CM 6 -200. 5042.8 /end AXIS_DESCR
/end CHARACTERISTIC
/begin CHARACTERISTIC KF_PMRIBAT2 "Kennfeld Innenwiderstand Batterie2" MAP 0xa1017a84 _REC_MAP_52_u1_s2_u2 0.255 _CNV_R_R_Def_f_ub_q_755_CM 0. 0.255
 /begin AXIS_DESCR STD_AXIS T_batt _CNV_R_R_Def_t_sw_q_618_CM 4 -3276.8 3276.7 FORMAT "%4.1" /end AXIS_DESCR
 /begin AXIS_DESCR STD_AXIS I_batt _CNV_R_R_Def_i_uw_q_642_CM 6 -200. 5042.8 /end AXIS_DESCR
/end CHARACTERISTIC
/begin CHARACTERISTIC KF_PMRIBAT3 "Kennfeld Innenwiderstand Batterie3" MAP 0xa1017a24 _REC_MAP_52_u1_s2_u2 0.255 _CNV_R_R_Def_f_ub_q_755_CM 0. 0.255
 /begin AXIS_DESCR STD_AXIS T_batt _CNV_R_R_Def_t_sw_q_618_CM 4 -3276.8 3276.7 FORMAT "%4.1" /end AXIS_DESCR
 /begin AXIS_DESCR STD_AXIS I_batt _CNV_R_R_Def_i_uw_q_642_CM 6 -200. 5042.8 /end AXIS_DESCR
/end CHARACTERISTIC
/begin CHARACTERISTIC KF_PMRIBAT4 "Kennfeld Innenwiderstand Batterie4" MAP 0xa1017a54 _REC_MAP_52_u1_s2_u2 0.255 _CNV_R_R_Def_f_ub_q_755_CM 0. 0.255
 /begin AXIS_DESCR STD_AXIS T_batt _CNV_R_R_Def_t_sw_q_618_CM 4 -3276.8 3276.7 FORMAT "%4.1" /end AXIS_DESCR
 /begin AXIS_DESCR STD_AXIS I_batt _CNV_R_R_Def_i_uw_q_642_CM 6 -200. 5042.8 /end AXIS_DESCR
/end CHARACTERISTIC
/begin CHARACTERISTIC KF_PMRIBAT5 "Kennfeld Innenwiderstand Batterie5" MAP 0xa10179f4 _REC_MAP_52_u1_s2_u2 0.255 _CNV_R_R_Def_f_ub_q_755_CM 0. 0.255
 /begin AXIS_DESCR STD_AXIS T_batt _CNV_R_R_Def_t_sw_q_618_CM 4 -3276.8 3276.7 FORMAT "%4.1" /end AXIS_DESCR
 /begin AXIS_DESCR STD_AXIS I_batt _CNV_R_R_Def_i_uw_q_642_CM 6 -200. 5042.8 /end AXIS_DESCR
/end CHARACTERISTIC
/begin CHARACTERISTIC KF_PMRIBAT6 "Kennfeld Innenwiderstand Batterie6" MAP 0xa10179c4 _REC_MAP_52_u1_s2_u2 0.255 _CNV_R_R_Def_f_ub_q_755_CM 0. 0.255
 /begin AXIS_DESCR STD_AXIS T_batt _CNV_R_R_Def_t_sw_q_618_CM 4 -3276.8 3276.7 FORMAT "%4.1" /end AXIS_DESCR
 /begin AXIS_DESCR STD_AXIS I_batt _CNV_R_R_Def_i_uw_q_642_CM 6 -200. 5042.8 /end AXIS_DESCR
/end CHARACTERISTIC
/begin CHARACTERISTIC KF_PMRIBAT7 "Kennfeld Innenwiderstand Batterie7" MAP 0xa1017ae4 _REC_MAP_52_u1_s2_u2 0.255 _CNV_R_R_Def_f_ub_q_755_CM 0. 0.255
 /begin AXIS_DESCR STD_AXIS T_batt _CNV_R_R_Def_t_sw_q_618_CM 4 -3276.8 3276.7 FORMAT "%4.1" /end AXIS_DESCR
 /begin AXIS_DESCR STD_AXIS I_batt _CNV_R_R_Def_i_uw_q_642_CM 6 -200. 5042.8 /end AXIS_DESCR
/end CHARACTERISTIC
/begin CHARACTERISTIC KF_PMRIBAT8 "Kennfeld Innenwiderstand Batterie8" MAP 0xa1017994 _REC_MAP_52_u1_s2_u2 0.255 _CNV_R_R_Def_f_ub_q_755_CM 0. 0.255
 /begin AXIS_DESCR STD_AXIS T_batt _CNV_R_R_Def_t_sw_q_618_CM 4 -3276.8 3276.7 FORMAT "%4.1" /end AXIS_DESCR
 /begin AXIS_DESCR STD_AXIS I_batt _CNV_R_R_Def_i_uw_q_642_CM 6 -200. 5042.8 /end AXIS_DESCR
/end CHARACTERISTIC
/begin CHARACTERISTIC KF_POELREG_ERR "Integratorwertschwellen (Reglereingang absolut) zur Fehlererkennung" MAP 0xa100e320 _REC_MAP_52_UBYTE_u2_s2_s2 0. _CNV_R_R_Def_p_sw_q_683_CM 0. 65535. FORMAT "%4.1"
 /begin AXIS_DESCR STD_AXIS Nkw _CNV_R_R_Def_n_sw_q_612_CM 4 -32768. 32767. FORMAT "%5.0" /end AXIS_DESCR
 /begin AXIS_DESCR STD_AXIS Toel _CNV_R_R_Def_t_sw_q_620_CM 4 -327.68 327.67 FORMAT "%5.2" /end AXIS_DESCR
/end CHARACTERISTIC
/begin CHARACTERISTIC KF_POELSOLL "Öldruck Sollwertvorgabe für geregelte Ölpumpe" MAP 0xa100e2bc _REC_MAP_52_UBYTE_u2_s2_s2 0. _CNV_R_R_Def_p_sw_q_683_CM 0. 65535. FORMAT "%4.1"
 /begin AXIS_DESCR STD_AXIS Nkw _CNV_R_R_Def_n_sw_q_612_CM 6 -32768. 32767. FORMAT "%5.0" /end AXIS_DESCR
 /begin AXIS_DESCR STD_AXIS Rk_soll _CNV_R_R_Def_rk_sw__697_CM 6 -1600. 1599.9511 /end AXIS_DESCR
/end CHARACTERISTIC
/begin CHARACTERISTIC KF_PRAIL_H "Kennfeld RAILDRUCK HOMOGEN" MAP 0xa1020440 _REC_MAP_52_UBYTE_u2_s2_s2 39.9993 _CNV_R_R_Def_p_uw_q_685_CM 0. 39.9993 FORMAT "%7.4"
 /begin AXIS_DESCR STD_AXIS Nkw _CNV_R_R_Def_n_sw_q_612_CM 8 -32768. 32767. FORMAT "%5.0" /end AXIS_DESCR
 /begin AXIS_DESCR STD_AXIS Rk_soll_h _CNV_R_R_Def_rk_sw__697_CM 8 -1600. 1599.9511 /end AXIS_DESCR
/end CHARACTERISTIC
/begin CHARACTERISTIC KF_PRAIL_HDOE "Kennfeld RAILDRUCK HOMOGEN-DOPPELEINSPRITZUNG" MAP 0xa10204e4 _REC_MAP_52_UBYTE_u2_s2_s2 39.9993 _CNV_R_R_Def_p_uw_q_685_CM 0. 39.9993 FORMAT "%7.4"
 /begin AXIS_DESCR STD_AXIS Nkw _CNV_R_R_Def_n_sw_q_612_CM 8 -32768. 32767. FORMAT "%5.0" /end AXIS_DESCR
 /begin AXIS_DESCR STD_AXIS Rk_soll_h _CNV_R_R_Def_rk_sw__697_CM 8 -1600. 1599.9511 /end AXIS_DESCR
/end CHARACTERISTIC
/begin CHARACTERISTIC KF_PRAIL_HS "Kennfeld RAILDRUCK HOMOGEN-SCHICHT" MAP 0xa1020588 _REC_MAP_52_UBYTE_u2_s2_s2 39.9993 _CNV_R_R_Def_p_uw_q_685_CM 0. 39.9993 FORMAT "%7.4"
 /begin AXIS_DESCR STD_AXIS Nkw _CNV_R_R_Def_n_sw_q_612_CM 8 -32768. 32767. FORMAT "%5.0" /end AXIS_DESCR
 /begin AXIS_DESCR STD_AXIS Rk_soll_hs _CNV_R_R_Def_rk_sw__697_CM 8 -1600. 1599.9511 /end AXIS_DESCR
/end CHARACTERISTIC
/begin CHARACTERISTIC KF_PRAIL_HSMIN "Kennfeld RAILDRUCK HOMOGEN-SCHICHT MIN." MAP 0xa102062c _REC_MAP_52_UBYTE_u2_s2_s2 39.9993 _CNV_R_R_Def_p_uw_q_685_CM 0. 39.9993 FORMAT "%7.4"
 /begin AXIS_DESCR STD_AXIS Nkw _CNV_R_R_Def_n_sw_q_612_CM 8 -32768. 32767. FORMAT "%5.0" /end AXIS_DESCR
 /begin AXIS_DESCR STD_AXIS Rk_soll_hs _CNV_R_R_Def_rk_sw__697_CM 8 -1600. 1599.9511 /end AXIS_DESCR
/end CHARACTERISTIC
/begin CHARACTERISTIC KF_PRAIL_S "Kennfeld RAILDRUCK SCHICHT" MAP 0xa10206d0 _REC_MAP_52_UBYTE_u2_s2_s2 39.9993 _CNV_R_R_Def_p_uw_q_685_CM 0. 39.9993 FORMAT "%7.4"
 /begin AXIS_DESCR STD_AXIS Nkw _CNV_R_R_Def_n_sw_q_612_CM 8 -32768. 32767. FORMAT "%5.0" /end AXIS_DESCR
 /begin AXIS_DESCR STD_AXIS Rk_soll_s _CNV_R_R_Def_rk_sw__697_CM 8 -1600. 1599.9511 /end AXIS_DESCR
/end CHARACTERISTIC
/begin CHARACTERISTIC KF_PRAIL_SMIN "Kennfeld RAILDRUCK SCHICHT MIN." MAP 0xa1020774 _REC_MAP_52_UBYTE_u2_s2_s2 39.9993 _CNV_R_R_Def_p_uw_q_685_CM 0. 39.9993 FORMAT "%7.4"
 /begin AXIS_DESCR STD_AXIS Nkw _CNV_R_R_Def_n_sw_q_612_CM 8 -32768. 32767. FORMAT "%5.0" /end AXIS_DESCR
 /begin AXIS_DESCR STD_AXIS Rk_soll_s _CNV_R_R_Def_rk_sw__697_CM 8 -1600. 1599.9511 /end AXIS_DESCR
/end CHARACTERISTIC
/begin CHARACTERISTIC KF_SOC0UBIB "" MAP 0xa101794c _REC_MAP_52_UBYTE_u2_u2_s2 95.442256 _CNV_R_R_Def_ql_uw__596_CM 0. 1193.0282
 /begin AXIS_DESCR STD_AXIS Ubatt0 _CNV_R_R_Def_u_uw_q_730_CM 3 6. 22.3837 FORMAT "%7.4" /end AXIS_DESCR
 /begin AXIS_DESCR STD_AXIS Isoc0loc _CNV_R_R_Def_i_sw_q_647_CM 5 -655.36 655.34 /end AXIS_DESCR
/end CHARACTERISTIC
/begin CHARACTERISTIC KF_SOCLF "Ladefaktor in Abhängigkeit von Temperatur und Ladezustand" MAP 0xa1017934 _REC_MAP_52_u1_s2_u2 3.9686 _CNV_R_R_Def_f_ub_b_670_CM 1.57e-002 3.9843 FORMAT "%5.2"
 /begin AXIS_DESCR STD_AXIS T_batt _CNV_R_R_Def_t_sw_q_618_CM 3 -3276.8 3276.7 FORMAT "%4.1" /end AXIS_DESCR
 /begin AXIS_DESCR STD_AXIS Soc_b_loc _CNV_R_R_Def_ql_uw__596_CM 3 0. 1192.7502 /end AXIS_DESCR
/end CHARACTERISTIC
/begin CHARACTERISTIC KF_USOLL "Batteriesollspannung aufgrund der Temperatur und soc." MAP 0xa1017bd0 _REC_MAP_52_UBYTE_u2_s2_u2 16.3837 _CNV_R_R_Def_u_uw_q_730_CM 6. 22.3837 FORMAT "%7.4"
 /begin AXIS_DESCR STD_AXIS T_batt _CNV_R_R_Def_t_sw_q_618_CM 3 -3276.8 3276.7 FORMAT "%4.1" /end AXIS_DESCR
 /begin AXIS_DESCR STD_AXIS Soc_rel _CNV_R_R_Def_f_uw_b_576_CM 3 0. 99.9984 /end AXIS_DESCR
/end CHARACTERISTIC
/begin CHARACTERISTIC KF_WASLL "Kennfeld Auslassspreizung Leerlauf" MAP 0xa101d5c4 _REC_MAP_52_u1_s2_s2 99.96000000000001 _CNV_R_R_Def_spr_ub_582_CM 0. 204. FORMAT "%5.2"
 /begin AXIS_DESCR STD_AXIS Nkw _CNV_R_R_Def_n_sw_q_612_CM 12 -32768. 32767. FORMAT "%5.0" /end AXIS_DESCR
 /begin AXIS_DESCR STD_AXIS Rfv_vns _CNV_R_R_Def_rf_sw__616_CM 5 -327.68 327.67 FORMAT "%7.4" /end AXIS_DESCR
/end CHARACTERISTIC
/begin CHARACTERISTIC KF_WASLL_HS "Kennfeld Auslassspreizung Leerlauf" MAP 0xa101e7cc _REC_MAP_52_u1_s2_s2 99.96000000000001 _CNV_R_R_Def_spr_ub_582_CM 0. 204. FORMAT "%5.2"
 /begin AXIS_DESCR STD_AXIS Nkw _CNV_R_R_Def_n_sw_q_612_CM 12 -32768. 32767. FORMAT "%5.0" /end AXIS_DESCR
 /begin AXIS_DESCR STD_AXIS Rk_soll_hs _CNV_R_R_Def_rk_sw__697_CM 5 -1600. 1599.9511 /end AXIS_DESCR
/end CHARACTERISTIC
/begin CHARACTERISTIC KF_WASOPT "Kennfeld optimale Auslassspreizung warm teilgedrosselt" MAP 0xa101dc0c _REC_MAP_52_u1_s2_s2 99.96000000000001 _CNV_R_R_Def_spr_ub_582_CM 0. 204. FORMAT "%5.2"
 /begin AXIS_DESCR STD_AXIS Nkw _CNV_R_R_Def_n_sw_q_612_CM 16 -32768. 32767. FORMAT "%5.0" /end AXIS_DESCR
 /begin AXIS_DESCR STD_AXIS Rk_soll_s _CNV_R_R_Def_rk_sw__697_CM 12 -1600. 1599.9511 /end AXIS_DESCR
/end CHARACTERISTIC
/begin CHARACTERISTIC KF_WASOPT_HS "Kennfeld optimale Auslassspreizung warm Homogen_Schicht" MAP 0xa101e5b0 _REC_MAP_52_u1_s2_s2 99.96000000000001 _CNV_R_R_Def_spr_ub_582_CM 0. 204. FORMAT "%5.2"
 /begin AXIS_DESCR STD_AXIS Nkw _CNV_R_R_Def_n_sw_q_612_CM 16 -32768. 32767. FORMAT "%5.0" /end AXIS_DESCR
 /begin AXIS_DESCR STD_AXIS Rk_soll_hs _CNV_R_R_Def_rk_sw__697_CM 12 -1600. 1599.9511 /end AXIS_DESCR
/end CHARACTERISTIC
/begin CHARACTERISTIC KF_WASOPU "Kennfeld optimale Auslassspreizung warm ungedrosselt" MAP 0xa101dec8 _REC_MAP_52_u1_s2_s2 99.96000000000001 _CNV_R_R_Def_spr_ub_582_CM 0. 204. FORMAT "%5.2"
 /begin AXIS_DESCR STD_AXIS Nkw _CNV_R_R_Def_n_sw_q_612_CM 16 -32768. 32767. FORMAT "%5.0" /end AXIS_DESCR
 /begin AXIS_DESCR STD_AXIS Rfv_vns _CNV_R_R_Def_rf_sw__616_CM 12 -327.68 327.67 FORMAT "%7.4" /end AXIS_DESCR
/end CHARACTERISTIC
/begin CHARACTERISTIC KF_WASVL "Kennfeld Auslassspreizung Volllast abh. von Drehzahl und Klopfstärke" MAP 0xa101d534 _REC_MAP_52_u1_s2_u2 99.96000000000001 _CNV_R_R_Def_spr_ub_582_CM 0. 204. FORMAT "%5.2"
 /begin AXIS_DESCR STD_AXIS Nkw _CNV_R_R_Def_n_sw_q_612_CM 16 -32768. 32767. FORMAT "%5.0" /end AXIS_DESCR
 /begin AXIS_DESCR STD_AXIS Wkrm _CNV_R_R_Def_zw_ub__748_CM 2 -49151.25 0. FORMAT "%5.2" /end AXIS_DESCR
/end CHARACTERISTIC
/begin CHARACTERISTIC KF_WASVLT "Kennfeld Auslassspreizung Volllast gedrosselt abh. von Drehzahl und Klopfstärke" MAP 0xa101d57c _REC_MAP_52_u1_s2_u2 99.96000000000001 _CNV_R_R_Def_spr_ub_582_CM 0. 204. FORMAT "%5.2"
 /begin AXIS_DESCR STD_AXIS Nkw _CNV_R_R_Def_n_sw_q_612_CM 16 -32768. 32767. FORMAT "%5.0" /end AXIS_DESCR
 /begin AXIS_DESCR STD_AXIS Wkrm _CNV_R_R_Def_zw_ub__748_CM 2 -49151.25 0. FORMAT "%5.2" /end AXIS_DESCR
/end CHARACTERISTIC
/begin CHARACTERISTIC KF_WESLL "Kennfeld Einlasssprezung Leerlauf" MAP 0xa101d624 _REC_MAP_52_u1_s2_s2 99.96000000000001 _CNV_R_R_Def_spr_ub_582_CM 0. 204. FORMAT "%5.2"
 /begin AXIS_DESCR STD_AXIS Nkw _CNV_R_R_Def_n_sw_q_612_CM 12 -32768. 32767. FORMAT "%5.0" /end AXIS_DESCR
 /begin AXIS_DESCR STD_AXIS Rfv_vns _CNV_R_R_Def_rf_sw__616_CM 5 -327.68 327.67 FORMAT "%7.4" /end AXIS_DESCR
/end CHARACTERISTIC
/begin CHARACTERISTIC KF_WESLL_HS "Kennfeld Einlasssprezung Leerlauf" MAP 0xa101e76c _REC_MAP_52_u1_s2_s2 99.96000000000001 _CNV_R_R_Def_spr_ub_582_CM 0. 204. FORMAT "%5.2"
 /begin AXIS_DESCR STD_AXIS Nkw _CNV_R_R_Def_n_sw_q_612_CM 12 -32768. 32767. FORMAT "%5.0" /end AXIS_DESCR
 /begin AXIS_DESCR STD_AXIS Rk_soll_hs _CNV_R_R_Def_rk_sw__697_CM 5 -1600. 1599.9511 /end AXIS_DESCR
/end CHARACTERISTIC
/begin CHARACTERISTIC KF_WESOPT "Kennfeld optimale Einlassspreizung warm teilgedrosselt" MAP 0xa101d950 _REC_MAP_52_u1_s2_s2 99.96000000000001 _CNV_R_R_Def_spr_ub_582_CM 0. 204. FORMAT "%5.2"
 /begin AXIS_DESCR STD_AXIS Nkw _CNV_R_R_Def_n_sw_q_612_CM 16 -32768. 32767. FORMAT "%5.0" /end AXIS_DESCR
 /begin AXIS_DESCR STD_AXIS Rk_soll_s _CNV_R_R_Def_rk_sw__697_CM 12 -1600. 1599.9511 /end AXIS_DESCR
/end CHARACTERISTIC
/begin CHARACTERISTIC KF_WESOPT_HS "Kennfeld optimale Einlassspreizung warm Homogen_Schicht" MAP 0xa101e3b8 _REC_MAP_52_u1_s2_s2 99.96000000000001 _CNV_R_R_Def_spr_ub_582_CM 0. 204. FORMAT "%5.2"
 /begin AXIS_DESCR STD_AXIS Nkw _CNV_R_R_Def_n_sw_q_612_CM 16 -32768. 32767. FORMAT "%5.0" /end AXIS_DESCR
 /begin AXIS_DESCR STD_AXIS Rk_soll_hs _CNV_R_R_Def_rk_sw__697_CM 12 -1600. 1599.9511 /end AXIS_DESCR
/end CHARACTERISTIC
/begin CHARACTERISTIC KF_WESOPU "Kennfeld optimale Einlassspreizung warm ungedrosselt" MAP 0xa101ddcc _REC_MAP_52_u1_s2_s2 99.96000000000001 _CNV_R_R_Def_spr_ub_582_CM 0. 204. FORMAT "%5.2"
 /begin AXIS_DESCR STD_AXIS Nkw _CNV_R_R_Def_n_sw_q_612_CM 16 -32768. 32767. FORMAT "%5.0" /end AXIS_DESCR
 /begin AXIS_DESCR STD_AXIS Rfv_vns _CNV_R_R_Def_rf_sw__616_CM 12 -327.68 327.67 FORMAT "%7.4" /end AXIS_DESCR
/end CHARACTERISTIC
/begin CHARACTERISTIC KF_WESVL "Kennfeld Einlassspreizung Volllast abh. von Drehzahl und Klopfstärke" MAP 0xa101d744 _REC_MAP_52_u1_s2_u2 99.96000000000001 _CNV_R_R_Def_spr_ub_582_CM 0. 204. FORMAT "%5.2"
 /begin AXIS_DESCR STD_AXIS Nkw _CNV_R_R_Def_n_sw_q_612_CM 16 -32768. 32767. FORMAT "%5.0" /end AXIS_DESCR
 /begin AXIS_DESCR STD_AXIS Wkrm _CNV_R_R_Def_zw_ub__748_CM 2 -49151.25 0. FORMAT "%5.2" /end AXIS_DESCR
/end CHARACTERISTIC
/begin CHARACTERISTIC KF_WESVLT "Kennfeld Einlassspreizung Volllast gedrosselt abh. von Drehzahl und Klopfstärke" MAP 0xa101d78c _REC_MAP_52_u1_s2_u2 99.96000000000001 _CNV_R_R_Def_spr_ub_582_CM 0. 204. FORMAT "%5.2"
 /begin AXIS_DESCR STD_AXIS Nkw _CNV_R_R_Def_n_sw_q_612_CM 16 -32768. 32767. FORMAT "%5.0" /end AXIS_DESCR
 /begin AXIS_DESCR STD_AXIS Wkrm _CNV_R_R_Def_zw_ub__748_CM 2 -49151.25 0. FORMAT "%5.2" /end AXIS_DESCR
/end CHARACTERISTIC
/begin CHARACTERISTIC KF_WNWKHK "" MAP 0xa101d7d4 _REC_MAP_52_u1_s2_u2 0.996 _CNV_R_R_Def_f_ub_b_573_CM 0. 0.996
 /begin AXIS_DESCR STD_AXIS Tmot _CNV_R_R_Def_t_sw_q_620_CM 6 -327.68 327.67 FORMAT "%5.2" /end AXIS_DESCR
 /begin AXIS_DESCR STD_AXIS Tn_start_10 _CNV_R_R_Def_td_uw__679_CM 6 0. 655.35 FORMAT "%5.2" /end AXIS_DESCR
/end CHARACTERISTIC
/begin CHARACTERISTIC KF_WNWKHK_2 "" MAP 0xa101d814 _REC_MAP_52_u1_s2_u2 0.996 _CNV_R_R_Def_f_ub_b_573_CM 0. 0.996
 /begin AXIS_DESCR STD_AXIS Tmot _CNV_R_R_Def_t_sw_q_620_CM 6 -327.68 327.67 FORMAT "%5.2" /end AXIS_DESCR
 /begin AXIS_DESCR STD_AXIS Tn_start_10 _CNV_R_R_Def_td_uw__679_CM 6 0. 655.35 FORMAT "%5.2" /end AXIS_DESCR
/end CHARACTERISTIC
/begin CHARACTERISTIC KL_ASPAN "Kennlinie Auslassspreizung Schubabschalten" CURVE 0xa101d444 _REC_CUR_TKL_UW_VV__u1_s2 0. _CNV_R_R_Def_spr_ub_582_CM -26214.4 26213.6 FORMAT "%5.2"
 /begin AXIS_DESCR STD_AXIS Nkw _CNV_R_R_Def_n_sw_q_612_CM 5 -32768. 32767. FORMAT "%5.0" /end AXIS_DESCR
/end CHARACTERISTIC
/begin CHARACTERISTIC KL_ASPVZ "Kennlinie Einschaltverzögerung Auslass abh. von Tmot" CURVE 0xa101d4d0 _REC_CUR_TKL_UW_VV__u1_s2 99.45 _CNV_R_R_Def_td_uw__679_CM 0. 255. FORMAT "%5.2"
 /begin AXIS_DESCR STD_AXIS Tmot _CNV_R_R_Def_t_sw_q_620_CM 5 -327.68 327.67 FORMAT "%5.2" /end AXIS_DESCR
/end CHARACTERISTIC
/begin CHARACTERISTIC KL_CLASS2IND "Batterieklasse -> Batterieindex" CURVE 0xa1017608 _REC_CUR_TKL_UW_VV__u1_u1 99.45 _CNV_R_R_Def_dez_sl_575_CM 0. 255. FORMAT "%3.0"
 /begin AXIS_DESCR STD_AXIS Batt_class _CNV_R_R_Def_dez_sl_575_CM 8 0. 255. FORMAT "%3.0" /end AXIS_DESCR
/end CHARACTERISTIC
/begin CHARACTERISTIC KL_CLASS2NENN "Batterieklasse -> Batteriegroesse" CURVE 0xa10175a0 _REC_CUR_TKL_UW_VV__u1_u1 99.45 _CNV_R_R_DEZ_436_CM 0. 255. FORMAT "%4.1"
 /begin AXIS_DESCR STD_AXIS Batt_class _CNV_R_R_Def_dez_sl_575_CM 8 0. 255. FORMAT "%3.0" /end AXIS_DESCR
/end CHARACTERISTIC
/begin CHARACTERISTIC KL_DFPRIO "Dffgen Prio Übersetzer" CURVE 0xa10177e8 _REC_CUR_TKL_UW_VV__s2_u1 100. _CNV_R_R_Def_f_sw_p_581_CM -100. 100. FORMAT "%5.2"
 /begin AXIS_DESCR STD_AXIS Dfpt1filt _CNV_R_R_Def_f_ub_b_602_CM 6 0. 99.60930000000001 FORMAT "%5.2" /end AXIS_DESCR
/end CHARACTERISTIC
/begin CHARACTERISTIC KL_DFPTC "Gefiltertes dffgen -> Prio_Gewichtung -Übersetzer" CURVE 0xa101777c _REC_CUR_TKL_UW_VV__s2_u1 100. _CNV_R_R_Def_f_sw_p_581_CM -100. 100. FORMAT "%5.2"
 /begin AXIS_DESCR STD_AXIS Dfpt1ptc _CNV_R_R_Def_f_ub_b_602_CM 6 0. 99.60930000000001 FORMAT "%5.2" /end AXIS_DESCR
/end CHARACTERISTIC
/begin CHARACTERISTIC KL_DSOCPRIO "" CURVE 0xa101788c _REC_CUR_TKL_UW_VV__u2_s2 102.39842 _CNV_R_R_Def_f_uw_b_636_CM 0. 511.9921 /begin AXIS_DESCR STD_AXIS D_soc _CNV_R_R_Def_f_sw_b_597_CM 5 -100. 99.9969 /end AXIS_DESCR /end CHARACTERISTIC
/begin CHARACTERISTIC KL_DSOCPTC "Kennlinie dsoc auf PTC-Ansteuerung Übersetzer" CURVE 0xa101785c _REC_CUR_TKL_UW_VV__s2_s2 99. _CNV_R_R_Def_f_sw_p_581_CM -150. 150. FORMAT "%5.2" /begin AXIS_DESCR STD_AXIS D_soc _CNV_R_R_Def_f_sw_b_597_CM 4 -100. 99.9969 /end AXIS_DESCR /end CHARACTERISTIC
/begin CHARACTERISTIC KL_DUDTPTC "Übersetzer dudtmul -> PTC Add. Gewichtung" CURVE 0xa1017844 _REC_CUR_TKL_UW_VV__u2_s2 99. _CNV_R_R_Def_f_sw_p_581_CM 0. 550.
 /begin AXIS_DESCR STD_AXIS Dudtmul _CNV_R_R_Def_f_sw_q_621_CM 5 -48.2304 48.2289 FORMAT "%7.4" /end AXIS_DESCR
/end CHARACTERISTIC
/begin CHARACTERISTIC KL_ESPAN "Kennlinie Einlassspreizung Schubabschalten" CURVE 0xa101d458 _REC_CUR_TKL_UW_VV__u1_s2 99.96000000000001 _CNV_R_R_Def_spr_ub_582_CM 0. 204. FORMAT "%5.2"
 /begin AXIS_DESCR STD_AXIS Nkw _CNV_R_R_Def_n_sw_q_612_CM 5 -32768. 32767. FORMAT "%5.0" /end AXIS_DESCR
/end CHARACTERISTIC
/begin CHARACTERISTIC KL_ESPVZ "Kennlinie Einschaltverzögerung Einlass abh. von Tmot" CURVE 0xa101d4e4 _REC_CUR_TKL_UW_VV__u1_s2 99.45 _CNV_R_R_Def_td_uw__679_CM 0. 255. FORMAT "%5.2"
 /begin AXIS_DESCR STD_AXIS Tmot _CNV_R_R_Def_t_sw_q_620_CM 5 -327.68 327.67 FORMAT "%5.2" /end AXIS_DESCR
/end CHARACTERISTIC
/begin CHARACTERISTIC KL_FASHSW "Kennlinie Faktor Auslass Homogen_Schicht warm" CURVE 0xa101d50c _REC_CUR_TKL_UW_VV__u1_s2 0.996 _CNV_R_R_Def_f_ub_b_573_CM 0. 0.996
 /begin AXIS_DESCR STD_AXIS Tmot _CNV_R_R_Def_t_sw_q_620_CM 6 -327.68 327.67 FORMAT "%5.2" /end AXIS_DESCR
/end CHARACTERISTIC
/begin CHARACTERISTIC KL_FASTW "Kennlinie Faktor Auslass teilgedrosselt warm" CURVE 0xa101d480 _REC_CUR_TKL_UW_VV__u1_s2 0.996 _CNV_R_R_Def_f_ub_b_573_CM 0. 0.996
 /begin AXIS_DESCR STD_AXIS Tmot _CNV_R_R_Def_t_sw_q_620_CM 6 -327.68 327.67 FORMAT "%5.2" /end AXIS_DESCR
/end CHARACTERISTIC
/begin CHARACTERISTIC KL_FASW "Kennlinie Faktor Auslass ungedrosselt warm" CURVE 0xa101d494 _REC_CUR_TKL_UW_VV__u1_s2 0.996 _CNV_R_R_Def_f_ub_b_573_CM 0. 0.996
 /begin AXIS_DESCR STD_AXIS Tmot _CNV_R_R_Def_t_sw_q_620_CM 6 -327.68 327.67 FORMAT "%5.2" /end AXIS_DESCR
/end CHARACTERISTIC
/begin CHARACTERISTIC KL_FEASWLL "" CURVE 0xa101d46c _REC_CUR_TKL_UW_VV__u1_s2 0.996 _CNV_R_R_Def_f_ub_b_573_CM 0. 0.996
 /begin AXIS_DESCR STD_AXIS Tmot _CNV_R_R_Def_t_sw_q_620_CM 6 -327.68 327.67 FORMAT "%5.2" /end AXIS_DESCR
/end CHARACTERISTIC
/begin CHARACTERISTIC KL_FEASWLL_HS "" CURVE 0xa101d520 _REC_CUR_TKL_UW_VV__u1_s2 0.996 _CNV_R_R_Def_f_ub_b_573_CM 0. 0.996
 /begin AXIS_DESCR STD_AXIS Tmot _CNV_R_R_Def_t_sw_q_620_CM 6 -327.68 327.67 FORMAT "%5.2" /end AXIS_DESCR
/end CHARACTERISTIC
/begin CHARACTERISTIC KL_FESHSW "Kennlinie Faktor Einlass Homogen_Schicht warm" CURVE 0xa101d4f8 _REC_CUR_TKL_UW_VV__u1_s2 0.996 _CNV_R_R_Def_f_ub_b_573_CM 0. 0.996
 /begin AXIS_DESCR STD_AXIS Tmot _CNV_R_R_Def_t_sw_q_620_CM 6 -327.68 327.67 FORMAT "%5.2" /end AXIS_DESCR
/end CHARACTERISTIC
/begin CHARACTERISTIC KL_FESTW "Kennlinie Faktor Einlass teilgedrosselt warm" CURVE 0xa101d4a8 _REC_CUR_TKL_UW_VV__u1_s2 0.996 _CNV_R_R_Def_f_ub_b_573_CM 0. 0.996
 /begin AXIS_DESCR STD_AXIS Tmot _CNV_R_R_Def_t_sw_q_620_CM 6 -327.68 327.67 FORMAT "%5.2" /end AXIS_DESCR
/end CHARACTERISTIC
/begin CHARACTERISTIC KL_FESW "Kennlinie Faktor Einlass ungedrosselt warm" CURVE 0xa101d4bc _REC_CUR_TKL_UW_VV__u1_s2 0.996 _CNV_R_R_Def_f_ub_b_573_CM 0. 0.996
 /begin AXIS_DESCR STD_AXIS Tmot _CNV_R_R_Def_t_sw_q_620_CM 6 -327.68 327.67 FORMAT "%5.2" /end AXIS_DESCR
/end CHARACTERISTIC
/begin CHARACTERISTIC KL_FITGRZ "Grenzwert für soc_fit" CURVE 0xa1017b44 _REC_CUR_TKL_UW_VV__u2_s2 99.9984 _CNV_R_R_Def_f_uw_b_576_CM 0. 99.9984
 /begin AXIS_DESCR STD_AXIS T_saison _CNV_R_R_Def_t_sw_q_618_CM 4 -3276.8 3276.7 FORMAT "%4.1" /end AXIS_DESCR
/end CHARACTERISTIC
/begin CHARACTERISTIC KL_GELIKMIE "Faktor für Generatorlastbegrenzung für Leerlaufstabilisierung" CURVE 0xa1017ce0 _REC_CUR_TKL_UW_VV__u1_u1 1.9921 _CNV_R_R_Def_f_ub_b_625_CM 0. 1.9921 /begin AXIS_DESCR STD_AXIS Ierr _CNV_R_R_Def_i_ub_q_645_CM 6 0. 31.875 /end AXIS_DESCR /end CHARACTERISTIC
/begin CHARACTERISTIC KL_I2PTC "I-Delta Übersetzer zu PTC Ansteuerung" CURVE 0xa101771c _REC_CUR_TKL_UW_VV__s2_u2 100. _CNV_R_R_Def_f_sw_p_581_CM -100. 100. FORMAT "%5.2"
 /begin AXIS_DESCR STD_AXIS Isolldiff _CNV_R_R_Def_i_uw_q_642_CM 6 -200. 5042.8 /end AXIS_DESCR
/end CHARACTERISTIC
/begin CHARACTERISTIC KL_IREST "Noch verfuegbare Restleistung vom Generator." CURVE 0xa1017818 _REC_CUR_TKL_UW_VV__s2_u2 100. _CNV_R_R_Def_f_sw_p_581_CM -100. 100. FORMAT "%5.2"
 /begin AXIS_DESCR STD_AXIS Pgenrest _CNV_R_R_Def_f_sw_p_581_CM 10 0. 16383.75 /end AXIS_DESCR
/end CHARACTERISTIC
/begin CHARACTERISTIC KL_ISOLLPR "Delta-I -> Prio Übersetzer" CURVE 0xa1017870 _REC_CUR_TKL_UW_VV__s2_u2 100. _CNV_R_R_Def_f_sw_p_581_CM -100. 100. FORMAT "%5.2" /begin AXIS_DESCR STD_AXIS Ibtdiff _CNV_R_R_Def_i_uw_q_642_CM 6 -200. 5042.8 /end AXIS_DESCR /end CHARACTERISTIC
/begin CHARACTERISTIC KL_ITNSTART "Startspannung abh. vom Itnstart" CURVE 0xa1017b8c _REC_CUR_TKL_UW_VV__u2_u1 16.3837 _CNV_R_R_Def_u_uw_q_730_CM 6. 22.3837 FORMAT "%7.4"
 /begin AXIS_DESCR STD_AXIS NO_INPUT_QUANTITY _CNV_R_R_Def_i_ub_b_758_CM 4 0. 996.0937 /end AXIS_DESCR
/end CHARACTERISTIC
/begin CHARACTERISTIC KL_PMSOCVU "SoC-Wert aus der Fitberechnung" CURVE 0xa1017984 _REC_CUR_TKL_UW_VV__u2_u2 99.9984 _CNV_R_R_Def_f_uw_b_576_CM 0. 99.9984
 /begin AXIS_DESCR STD_AXIS Ubatts2 _CNV_R_R_Def_u_uw_q_730_CM 3 6. 22.3837 FORMAT "%7.4" /end AXIS_DESCR
/end CHARACTERISTIC
/begin CHARACTERISTIC KL_POELISTMN "Minimal Öldruck in abh. von der Drehzahl" CURVE 0xa100e260 _REC_CUR_TKL_UW_VV__u2_s2 0. _CNV_R_R_Def_p_sw_q_683_CM 0. 65535. FORMAT "%4.1"
 /begin AXIS_DESCR STD_AXIS Nkw _CNV_R_R_Def_n_sw_q_612_CM 6 -32768. 32767. FORMAT "%5.0" /end AXIS_DESCR
/end CHARACTERISTIC
/begin CHARACTERISTIC KL_POELREG_D "D-Parameter für Öldruckregler (abh. von Toel)" CURVE 0xa100e24c _REC_CUR_TKL_UW_VV__u2_s2 0.9999 _CNV_R_R_Def_f_uw_b_591_CM 0. 0.9999 FORMAT "%14.5"
 /begin AXIS_DESCR STD_AXIS Toel _CNV_R_R_Def_t_sw_q_620_CM 4 -327.68 327.67 FORMAT "%5.2" /end AXIS_DESCR
/end CHARACTERISTIC
/begin CHARACTERISTIC KL_POELREG_I "I-Parameter für Öldruckregler (abh. von Toel)" CURVE 0xa100e238 _REC_CUR_TKL_UW_VV__u2_s2 0.9999 _CNV_R_R_Def_f_uw_b_591_CM 0. 0.9999 FORMAT "%14.5"
 /begin AXIS_DESCR STD_AXIS Toel _CNV_R_R_Def_t_sw_q_620_CM 4 -327.68 327.67 FORMAT "%5.2" /end AXIS_DESCR
/end CHARACTERISTIC
/begin CHARACTERISTIC KL_POELREG_P "P-Parameter für Öldruckregler (abh. von Toel)" CURVE 0xa100e224 _REC_CUR_TKL_UW_VV__u2_s2 0.9999 _CNV_R_R_Def_f_uw_b_591_CM 0. 0.9999 FORMAT "%14.5"
 /begin AXIS_DESCR STD_AXIS Toel _CNV_R_R_Def_t_sw_q_620_CM 4 -327.68 327.67 FORMAT "%5.2" /end AXIS_DESCR
/end CHARACTERISTIC
/begin CHARACTERISTIC KL_POELTVUB "Kennlinie Ub-Abhaengigkeit Tastverhaeltnis Oeldruck Regelventil" CURVE 0xa100e1d4 _REC_CUR_TKL_UW_VV__u2_u2 1.9999 _CNV_R_R_Def_f_uw_b_579_CM 0. 1.9999 FORMAT "%14.5"
 /begin AXIS_DESCR STD_AXIS Ub _CNV_R_R_Def_u_sb_q_598_CM 4 0. 6173.397 FORMAT "%4.1" /end AXIS_DESCR
/end CHARACTERISTIC
/begin CHARACTERISTIC KL_PRIO2PTC "Gewichtung der Prios auf Gewichtung fuer PTC Ansteuerung" CURVE 0xa10177bc _REC_CUR_TKL_UW_VV__s2_u2 100. _CNV_R_R_Def_f_sw_p_581_CM -100. 100. FORMAT "%5.2" /begin AXIS_DESCR STD_AXIS Dfprio _CNV_R_R_Def_f_sw_p_581_CM 5 0. 16383.75 /end AXIS_DESCR /end CHARACTERISTIC
/begin CHARACTERISTIC KL_PRIOCF "" CURVE 0xa1017738 _REC_CUR_TKL_UW_VV__u1_s2 6. _CNV_R_R_Def_dez_sl_575_CM 0. 6. FORMAT "%3.0"
 /begin AXIS_DESCR STD_AXIS Dsoc2pi _CNV_R_R_Def_f_sw_p_581_CM 7 -8192. 8191.75 FORMAT "%5.2" /end AXIS_DESCR
/end CHARACTERISTIC
/begin CHARACTERISTIC KL_PRIODF "" CURVE 0xa10178a4 _REC_CUR_TKL_UW_VV__u1_u2 6. _CNV_R_R_Def_dez_sl_575_CM 0. 6. FORMAT "%3.0" /begin AXIS_DESCR STD_AXIS Dfprio _CNV_R_R_Def_f_sw_p_581_CM 7 0. 16383.75 /end AXIS_DESCR /end CHARACTERISTIC
/begin CHARACTERISTIC KL_PTC "PWM-Übersetzer für PTC-Ansteuerung" CURVE 0xa1017708 _REC_CUR_TKL_UW_VV__u1_u2 99.45 _CNV_R_R_Def_f_ub_b_595_CM 0. 127.5 FORMAT "%5.2"
 /begin AXIS_DESCR STD_AXIS Allptcfilt _CNV_R_R_Def_f_sw_p_581_CM 5 0. 16383.75 /end AXIS_DESCR
/end CHARACTERISTIC
/begin CHARACTERISTIC KL_PWRCF "" CURVE 0xa1017750 _REC_CUR_TKL_UW_VV__u1_s2 6. _CNV_R_R_Def_dez_sl_575_CM 0. 6. FORMAT "%3.0"
 /begin AXIS_DESCR STD_AXIS Dsoc2pi _CNV_R_R_Def_f_sw_p_581_CM 7 -8192. 8191.75 FORMAT "%5.2" /end AXIS_DESCR
/end CHARACTERISTIC
/begin CHARACTERISTIC KL_PWRDF "" CURVE 0xa1017790 _REC_CUR_TKL_UW_VV__u1_u2 13. _CNV_R_R_Def_dez_sl_575_CM 0. 13. FORMAT "%3.0" /begin AXIS_DESCR STD_AXIS Dfprio _CNV_R_R_Def_f_sw_p_581_CM 14 0. 16383.75 /end AXIS_DESCR /end CHARACTERISTIC
/begin CHARACTERISTIC KL_SOC0TEMP "Temperaturabhängige Stromkorrektur für Ruhespannungsmessung" CURVE 0xa1017920 _REC_CUR_TKL_UW_VV__u1_s2 1.9921 _CNV_R_R_Def_f_ub_b_625_CM 0. 1.9921
 /begin AXIS_DESCR STD_AXIS Tsocloc _CNV_R_R_Def_t_sw_q_618_CM 5 -3276.8 3276.7 FORMAT "%4.1" /end AXIS_DESCR
/end CHARACTERISTIC
/begin CHARACTERISTIC KL_SOCPRIO "dsoc -> Prio Übersetzer" CURVE 0xa10177d4 _REC_CUR_TKL_UW_VV__s2_s2 99. _CNV_R_R_Def_f_sw_p_581_CM -150. 150. FORMAT "%5.2" /begin AXIS_DESCR STD_AXIS D_soc _CNV_R_R_Def_f_sw_b_597_CM 4 -100. 99.9969 /end AXIS_DESCR /end CHARACTERISTIC
/begin CHARACTERISTIC KL_SSOC "soc_s in Abh. von tsaison" CURVE 0xa1017b58 _REC_CUR_TKL_UW_VV__u2_s2 99.9984 _CNV_R_R_Def_f_uw_b_576_CM 0. 99.9984
 /begin AXIS_DESCR STD_AXIS T_saison _CNV_R_R_Def_t_sw_q_618_CM 4 -3276.8 3276.7 FORMAT "%4.1" /end AXIS_DESCR
/end CHARACTERISTIC
/begin CHARACTERISTIC KL_T2RELMAX "Max Toleranzzeit von T2" CURVE 0xa10175d0 _REC_CUR_TKL_UW_VV__u2_u2 0. _CNV_R_R_Def_td_uw__717_CM 0. 917490. FORMAT "%5.2"
 /begin AXIS_DESCR STD_AXIS T_histsum _CNV_R_R_Def_td_uw__718_CM 6 0. 3669960. FORMAT "%5.2" /end AXIS_DESCR
/end CHARACTERISTIC
/begin CHARACTERISTIC KL_T2RELMXRG "Max Toleranzzeit von T2 Ringshift" CURVE 0xa10175b4 _REC_CUR_TKL_UW_VV__u2_u2 0. _CNV_R_R_Def_td_uw__717_CM 0. 917490. FORMAT "%5.2"
 /begin AXIS_DESCR STD_AXIS T_histsum _CNV_R_R_Def_td_uw__718_CM 6 0. 3669960. FORMAT "%5.2" /end AXIS_DESCR
/end CHARACTERISTIC
/begin CHARACTERISTIC KL_T3RELMAX "Max Toleranzzeit von T3" CURVE 0xa10175ec _REC_CUR_TKL_UW_VV__u2_u2 0. _CNV_R_R_Def_td_uw__717_CM 0. 917490. FORMAT "%5.2"
 /begin AXIS_DESCR STD_AXIS T_histsum _CNV_R_R_Def_td_uw__718_CM 6 0. 3669960. FORMAT "%5.2" /end AXIS_DESCR
/end CHARACTERISTIC
/begin CHARACTERISTIC KL_T3RELMXRG "Max Toleranzzeit von T3 Ringshift" CURVE 0xa101761c _REC_CUR_TKL_UW_VV__u2_u2 0. _CNV_R_R_Def_td_uw__717_CM 0. 917490. FORMAT "%5.2"
 /begin AXIS_DESCR STD_AXIS T_histsum _CNV_R_R_Def_td_uw__718_CM 6 0. 3669960. FORMAT "%5.2" /end AXIS_DESCR
/end CHARACTERISTIC
/begin CHARACTERISTIC KL_T4RELMAX "Max Toleranzzeit von T4" CURVE 0xa1017638 _REC_CUR_TKL_UW_VV__u2_u2 0. _CNV_R_R_Def_td_uw__717_CM 0. 917490. FORMAT "%5.2"
 /begin AXIS_DESCR STD_AXIS T_histsum _CNV_R_R_Def_td_uw__718_CM 6 0. 3669960. FORMAT "%5.2" /end AXIS_DESCR
/end CHARACTERISTIC
/begin CHARACTERISTIC KL_T4RELMXRG "Max Toleranzzeit von T4 Ringshift" CURVE 0xa1017584 _REC_CUR_TKL_UW_VV__u2_u2 0. _CNV_R_R_Def_td_uw__717_CM 0. 917490. FORMAT "%5.2"
 /begin AXIS_DESCR STD_AXIS T_histsum _CNV_R_R_Def_td_uw__718_CM 6 0. 3669960. FORMAT "%5.2" /end AXIS_DESCR
/end CHARACTERISTIC
/begin CHARACTERISTIC KL_TOEL_ADD "Toel Abhängigkeit des Druck-Sollwerts (Additiv)" CURVE 0xa100e1fc _REC_CUR_TKL_UW_VV__u2_s2 0. _CNV_R_R_Def_p_sw_q_683_CM 0. 65535. FORMAT "%4.1"
 /begin AXIS_DESCR STD_AXIS Toel _CNV_R_R_Def_t_sw_q_620_CM 4 -327.68 327.67 FORMAT "%5.2" /end AXIS_DESCR
/end CHARACTERISTIC
/begin CHARACTERISTIC KL_TOEL_FAK "Einfluss Ausgang Öldruckregler in abh. Toel" CURVE 0xa100e210 _REC_CUR_TKL_UW_VV__u2_s2 0.9999 _CNV_R_R_Def_f_uw_b_591_CM 0. 0.9999 FORMAT "%14.5"
 /begin AXIS_DESCR STD_AXIS Toel _CNV_R_R_Def_t_sw_q_620_CM 4 -327.68 327.67 FORMAT "%5.2" /end AXIS_DESCR
/end CHARACTERISTIC
/begin CHARACTERISTIC KL_TOEL_MUL "Toel Abhängigkeit des Druck-Sollwerts (Multiplikativ)" CURVE 0xa100e1e8 _REC_CUR_TKL_UW_VV__u2_s2 1.9999 _CNV_R_R_Def_f_uw_b_579_CM 0. 1.9999 FORMAT "%14.5"
 /begin AXIS_DESCR STD_AXIS Toel _CNV_R_R_Def_t_sw_q_620_CM 4 -327.68 327.67 FORMAT "%5.2" /end AXIS_DESCR
/end CHARACTERISTIC
/begin CHARACTERISTIC KL_TOEL_PUMP "Streckenmodell Pumpe" CURVE 0xa100e27c _REC_CUR_TKL_UW_VV__u2_s2 99.83844000000001 _CNV_R_R_Def_f_uw_b_764_CM 0. 127.998
 /begin AXIS_DESCR STD_AXIS Toel _CNV_R_R_Def_t_sw_q_620_CM 7 -327.68 327.67 FORMAT "%5.2" /end AXIS_DESCR
/end CHARACTERISTIC
/begin CHARACTERISTIC KL_TOEL_SINK "Schluckgröße Motor (Streckenmodell)" CURVE 0xa100e29c _REC_CUR_TKL_UW_VV__u2_s2 31.99950000000001 _CNV_R_R_Def_f_uw_b_604_CM 0. 31.9995 FORMAT "%7.4"
 /begin AXIS_DESCR STD_AXIS Toel _CNV_R_R_Def_t_sw_q_620_CM 7 -327.68 327.67 FORMAT "%5.2" /end AXIS_DESCR
/end CHARACTERISTIC
/begin CHARACTERISTIC KL_UBTPRIO "Delta-Spannung -> Prio Übersetzer" CURVE 0xa10177fc _REC_CUR_TKL_UW_VV__s2_s2 100. _CNV_R_R_Def_f_sw_p_581_CM -100. 100. FORMAT "%5.2"
 /begin AXIS_DESCR STD_AXIS Ubdiffilt _CNV_R_R_Def_f_sw_b_577_CM 6 -32. 31.999 FORMAT "%7.4" /end AXIS_DESCR
/end CHARACTERISTIC
/begin CHARACTERISTIC KL_UB_PTC "UBatt-Kennlinie für Ansteuerung PTC" CURVE 0xa10176ec _REC_CUR_TKL_UW_VV__s2_s2 100. _CNV_R_R_Def_f_sw_p_581_CM -100. 100. FORMAT "%5.2"
 /begin AXIS_DESCR STD_AXIS Ubtpt1ptc _CNV_R_R_Def_f_sw_b_577_CM 6 -32. 31.999 FORMAT "%7.4" /end AXIS_DESCR
/end CHARACTERISTIC
/begin CHARACTERISTIC KL_UNSTART "Startspannung abhängig v.Motordrehzahl" CURVE 0xa1017b80 _REC_CUR_TKL_UW_VV__u2_s2 16.3837 _CNV_R_R_Def_u_uw_q_730_CM 6. 22.3837 FORMAT "%7.4"
 /begin AXIS_DESCR STD_AXIS Nnmstart _CNV_R_R_Def_n_sw_q_612_CM 2 -32768. 32767. FORMAT "%5.0" /end AXIS_DESCR
/end CHARACTERISTIC
/begin CHARACTERISTIC KL_USOLL "Batteriesollspannung aufgrund von tbatt" CURVE 0xa1017bc0 _REC_CUR_TKL_UW_VV__u2_s2 16.3837 _CNV_R_R_Def_u_uw_q_730_CM 6. 22.3837 FORMAT "%7.4"
 /begin AXIS_DESCR STD_AXIS T_batt _CNV_R_R_Def_t_sw_q_618_CM 3 -3276.8 3276.7 FORMAT "%4.1" /end AXIS_DESCR
/end CHARACTERISTIC
/begin CHARACTERISTIC KL_UTSTART "Startspannung in Abhängigkeit von Temperatur Batterie" CURVE 0xa1017b9c _REC_CUR_TKL_UW_VV__s2_s2 16.3837 _CNV_R_R_Def_u_sw_q_733_CM -8.192 8.191700000000001 FORMAT "%7.4"
 /begin AXIS_DESCR STD_AXIS T_batt _CNV_R_R_Def_t_sw_q_618_CM 3 -3276.8 3276.7 FORMAT "%4.1" /end AXIS_DESCR
/end CHARACTERISTIC
/begin CHARACTERISTIC KL_WUBPTC "KL Multiplikationsfaktor W_ub bei SpgEinbruch" CURVE 0xa1017768 _REC_CUR_TKL_UW_VV__u1_u2 3.9843 _CNV_R_R_Def_f_ub_b_670_CM 0. 3.9843 FORMAT "%5.2"
 /begin AXIS_DESCR STD_AXIS Ub _CNV_R_R_Def_u_sb_q_598_CM 5 0. 6173.397 FORMAT "%4.1" /end AXIS_DESCR
/end CHARACTERISTIC
/begin CHARACTERISTIC K_ABKORROVER "schlechter absch_korr Schwelle ueberschritten" VALUE 0xa1017548 _REC_VAL_20_s2 99.9984 _CNV_R_R_Def_f_sw_q_571_CM -50. 49.9984 /end CHARACTERISTIC
/begin CHARACTERISTIC K_ABSCHKORA "Applikationswert für Korrektur Abschaltung" VALUE 0xa1017b14 _REC_VAL_20_s2 99.9984 _CNV_R_R_Def_f_sw_q_571_CM -50. 49.9984 /end CHARACTERISTIC
/begin CHARACTERISTIC K_ASPRNOTL "Notlaufspreizung Auslassvanos" VALUE 0xa101d40c _REC_VAL_20_u1 99.96000000000001 _CNV_R_R_Def_spr_ub_582_CM 0. 204. FORMAT "%5.2" /end CHARACTERISTIC
/begin CHARACTERISTIC K_BATTINDAPP "batt_index appl." VALUE 0xa1017565 _REC_VAL_20_u1 99.45 _CNV_R_R_Def_dez_sl_575_CM 0. 255. FORMAT "%3.0" /end CHARACTERISTIC
/begin CHARACTERISTIC K_BATTREGAPP "Batterietauschregristrieren App" VALUE 0xa1017566 _REC_VAL_20_u1 99.45 _CNV_R_R_Def_dez_sl_575_CM 0. 255. FORMAT "%3.0" /end CHARACTERISTIC
/begin CHARACTERISTIC K_BILA_OGRZ "Grenzwert oberhalb dessen eine Apassung durch soc_kor nicht zulässig ist" VALUE 0xa1017b22 _REC_VAL_20_u2 99.9984 _CNV_R_R_Def_f_uw_b_576_CM 0. 99.9984 /end CHARACTERISTIC
/begin CHARACTERISTIC K_BILA_UGRZ "" VALUE 0xa1017b24 _REC_VAL_20_u2 99.9984 _CNV_R_R_Def_f_uw_b_576_CM 0. 99.9984 /end CHARACTERISTIC
/begin CHARACTERISTIC K_BNSMAX "Bordnetz Instabil Schwelle" VALUE 0xa1017cae _REC_VAL_20_u1 99.45 _CNV_R_R_Def_dez_sl_575_CM 0. 255. FORMAT "%3.0" /end CHARACTERISTIC
/begin CHARACTERISTIC K_BNS_CTRINC "bnsctr inkrement" VALUE 0xa1017caf _REC_VAL_20_u1 99.45 _CNV_R_R_Def_dez_sl_575_CM 0. 255. FORMAT "%3.0" /end CHARACTERISTIC
/begin CHARACTERISTIC K_BNS_SCHW1 "BN Instabilitätsschwelle 1" VALUE 0xa1017cb0 _REC_VAL_20_u1 99.45 _CNV_R_R_Def_dez_sl_575_CM 0. 255. FORMAT "%3.0" /end CHARACTERISTIC
/begin CHARACTERISTIC K_BNS_UBMAX "BN Spg. max. Schwelle" VALUE 0xa1017cb1 _REC_VAL_20_u1 24.021 _CNV_R_R_Def_u_sb_q_598_CM 0. 24.021 FORMAT "%7.4" /end CHARACTERISTIC
/begin CHARACTERISTIC K_BNS_UBMIN "BN Spg. untere Schwelle" VALUE 0xa1017cb2 _REC_VAL_20_u1 24.021 _CNV_R_R_Def_u_sb_q_598_CM 0. 24.021 FORMAT "%7.4" /end CHARACTERISTIC
/begin CHARACTERISTIC K_BNS_VFZG "Schwelle Geschwindigkeit fuer BNS" VALUE 0xa1017cac _REC_VAL_20_u2 0. _CNV_R_R_Def_v_uw_q_737_CM 0. 65535. FORMAT "%5.0" /end CHARACTERISTIC
/begin CHARACTERISTIC K_CBATTAPP "Cbattnenn appl." VALUE 0xa1017567 _REC_VAL_20_u1 99.45 _CNV_R_R_DEZ_436_CM 0. 255. FORMAT "%4.1" /end CHARACTERISTIC
/begin CHARACTERISTIC K_CCPRIOSET "Schwelle von E65Prios ab dem ccmeldung aktiv ist." VALUE 0xa1017568 _REC_VAL_20_u1 7. _CNV_R_R_Def_dez_sl_575_CM 0. 7. FORMAT "%3.0" /end CHARACTERISTIC
/begin CHARACTERISTIC K_CCPRIOTIME "Zeitverschiebung bis ccmeldung gesetzt wird." VALUE 0xa1017569 _REC_VAL_20_u1 25.5 _CNV_R_R_Def_td_ub__593_CM 0. 25.5 FORMAT "%4.1" /end CHARACTERISTIC
/begin CHARACTERISTIC K_CCPWRSET "ctrpwrcos Schwelle ab dem CC Meldung aktiviert wird. " VALUE 0xa1017552 _REC_VAL_20_u2 0. _CNV_R_R_Def_dez_sl_575_CM 0. 65535. FORMAT "%5.0" /end CHARACTERISTIC
/begin CHARACTERISTIC K_CTRCBRA "" VALUE 0xa1017684 _REC_VAL_20_u1 99.45 _CNV_R_R_Def_dez_sl_575_CM 0. 255. FORMAT "%3.0" /end CHARACTERISTIC
/begin CHARACTERISTIC K_CTRCBRAPP "Steuerung Stromzweige Applikationsgroesse" VALUE 0xa1017685 _REC_VAL_20_u1 99.45 _CNV_R_R_Def_dez_sl_575_CM 0. 255. FORMAT "%3.0" /end CHARACTERISTIC
/begin CHARACTERISTIC K_CTRCBRKBM "CTRCBR APP bei B_startfgk" VALUE 0xa1017686 _REC_VAL_20_u1 99.45 _CNV_R_R_Def_dez_sl_575_CM 0. 255. FORMAT "%3.0" /end CHARACTERISTIC
/begin CHARACTERISTIC K_CTRPCOSAPP "Steuerung Standverbraucher Applikationsgroesse" VALUE 0xa1017687 _REC_VAL_20_u1 3. _CNV_R_R_Def_dez_sl_575_CM 0. 3. FORMAT "%3.0" /end CHARACTERISTIC
/begin CHARACTERISTIC K_CTRPRIOAPP "Steuerung Spitzenreduzierung Prioritaet Applikationsgroesse" VALUE 0xa1017688 _REC_VAL_20_u1 7. _CNV_R_R_Def_dez_sl_575_CM 0. 7. FORMAT "%3.0" /end CHARACTERISTIC
/begin CHARACTERISTIC K_CTRPRIOCF "" VAL_BLK 0xa10176dc _REC_VAL_2_u1 99.45 _CNV_R_R_Def_dez_sl_575_CM 0. 255. FORMAT "%3.0" NUMBER 7 /end CHARACTERISTIC
/begin CHARACTERISTIC K_CTRPWRCF "" VAL_BLK 0xa10176b0 _REC_VAL_2_u2 0. _CNV_R_R_Def_dez_sl_575_CM 0. 65535. FORMAT "%5.0" NUMBER 7 /end CHARACTERISTIC
/begin CHARACTERISTIC K_CTRPWRDF "" VAL_BLK 0xa10176c0 _REC_VAL_2_u2 0. _CNV_R_R_Def_dez_sl_575_CM 0. 65535. FORMAT "%5.0" NUMBER 14 /end CHARACTERISTIC
/begin CHARACTERISTIC K_DAB_KORR1 "Korrekturkonstante 1 für Abschaltung" VALUE 0xa1017b16 _REC_VAL_20_s2 99.9984 _CNV_R_R_Def_f_sw_q_571_CM -50. 49.9984 /end CHARACTERISTIC
/begin CHARACTERISTIC K_DAB_KORR2 "Korrekturkonstante 2 für Abschaltung" VALUE 0xa1017b18 _REC_VAL_20_s2 99.9984 _CNV_R_R_Def_f_sw_q_571_CM -50. 49.9984 /end CHARACTERISTIC
/begin CHARACTERISTIC K_DAB_KORR3 "Korrekturkonstante 3 für Abschaltung" VALUE 0xa1017b1a _REC_VAL_20_s2 99.9984 _CNV_R_R_Def_f_sw_q_571_CM -50. 49.9984 /end CHARACTERISTIC
/begin CHARACTERISTIC K_DELTADFFMX "Gradientenschwelle des Generator-Lastsignals für Leerlauf-Solldrehzahlanhebung" VALUE 0xa1017cd4 _REC_VAL_20_s1 99.45 _CNV_R_R_Def_f_sb_b_600_CM -64. 63.5 FORMAT "%5.2" /end CHARACTERISTIC
/begin CHARACTERISTIC K_DFFILTAPP "Schalter, um dffgenfilt auf DFFILT_APP umzustellen" VALUE 0xa1017689 _REC_VAL_20_u1 99.60930000000001 _CNV_R_R_Def_f_ub_b_602_CM 0. 99.60930000000001 FORMAT "%5.2" /end CHARACTERISTIC
/begin CHARACTERISTIC K_DFFLIM "Schwelle für Generatorlast zum Rücksetzen der Leerlauf-Solldrehzahlanhebung" VALUE 0xa1017cd5 _REC_VAL_20_u1 99.60930000000001 _CNV_R_R_Def_f_ub_b_602_CM 0. 99.60930000000001 FORMAT "%5.2" /end CHARACTERISTIC
/begin CHARACTERISTIC K_DFFLLANH "Schwelle für Generatorlast zum Aktivieren der Leerlauf-Solldrehzahlanhebung" VALUE 0xa1017cd6 _REC_VAL_20_u1 99.60930000000001 _CNV_R_R_Def_f_ub_b_602_CM 0. 99.60930000000001 FORMAT "%5.2" /end CHARACTERISTIC
/begin CHARACTERISTIC K_DFFSCHZMX "Zählerschwelle für Aktivieren der Leerlauf-Solldrehzahlanhebung bei Generatorlastschw." VALUE 0xa1017cd7 _REC_VAL_20_u1 99.45 _CNV_R_R_Def_dez_sl_575_CM 0. 255. FORMAT "%3.0" /end CHARACTERISTIC
/begin CHARACTERISTIC K_DFKOMMERR "Ersatzwert Dffgen bei Gen. Komm. Fehler" VALUE 0xa101768a _REC_VAL_20_u1 99.60930000000001 _CNV_R_R_Def_f_ub_b_602_CM 0. 99.60930000000001 FORMAT "%5.2" /end CHARACTERISTIC
/begin CHARACTERISTIC K_DFOVERRIDE "Schwellwert wann Generator als ueberlastet erkannt wird" VALUE 0xa1017bbc _REC_VAL_20_u1 99.60930000000001 _CNV_R_R_Def_f_ub_b_602_CM 0. 99.60930000000001 FORMAT "%5.2" /end CHARACTERISTIC
/begin CHARACTERISTIC K_DFPTC_LP "K-Faktor des df-Tiefpass Filters zur Berechnung von PTC" VALUE 0xa101768b _REC_VAL_20_u1 0.996 _CNV_R_R_Def_f_ub_b_573_CM 0. 0.996 /end CHARACTERISTIC
/begin CHARACTERISTIC K_DF_LP "K-Faktor des df-Tiefpass Filters zur Berechnung von ctrpwrdf" VALUE 0xa101768c _REC_VAL_20_u1 0.996 _CNV_R_R_Def_f_ub_b_573_CM 0. 0.996 /end CHARACTERISTIC
/begin CHARACTERISTIC K_DSOCA "Applikationsgrösse für d_soc" VALUE 0xa1017b1c _REC_VAL_20_s2 99.99844999999999 _CNV_R_R_Def_f_sw_b_597_CM -100. 99.9969 /end CHARACTERISTIC
/begin CHARACTERISTIC K_DSOCABSCH "Applikationsgrösse für d_soc" VALUE 0xa1017b1e _REC_VAL_20_s2 99.99844999999999 _CNV_R_R_Def_f_sw_b_597_CM -100. 99.9969 /end CHARACTERISTIC
/begin CHARACTERISTIC K_DSOCHYSTCC "DSOC Hyst. fuer B_ccbtnach reset " VALUE 0xa101754a _REC_VAL_20_s2 99.99844999999999 _CNV_R_R_Def_f_sw_b_597_CM -100. 99.9969 /end CHARACTERISTIC
/begin CHARACTERISTIC K_DSOCLOW "DSOC Grenze f. CCmeld Batt Nachladen" VALUE 0xa101754c _REC_VAL_20_s2 99.99844999999999 _CNV_R_R_Def_f_sw_b_597_CM -100. 99.9969 /end CHARACTERISTIC
/begin CHARACTERISTIC K_DSOCPCOS "dsoc, unterhalb derer die Standverbraucher deaktiviert werden." VALUE 0xa1017654 _REC_VAL_20_s2 99.99844999999999 _CNV_R_R_Def_f_sw_b_597_CM -100. 99.9969 /end CHARACTERISTIC
/begin CHARACTERISTIC K_DTMSPR "Motortemperaturhysterese für Spreizungsfreigabe" VALUE 0xa101d42e _REC_VAL_20_s2 98.30250000000001 _CNV_R_R_Def_t_sw_q_620_CM -327.68 327.67 FORMAT "%5.2" /end CHARACTERISTIC
/begin CHARACTERISTIC K_DUDTPTCAUS "K-Faktor für dudt-PTC Abschaltung" VALUE 0xa101765a _REC_VAL_20_u2 0.9999847412109381 _CNV_R_R_Def_f_uw_b_591_CM 0. 0.9999847412109381 FORMAT "%14.5" /end CHARACTERISTIC
/begin CHARACTERISTIC K_ESPRNOTL "Notlaufspreizung Einlassvanos" VALUE 0xa101d40d _REC_VAL_20_u1 99.96000000000001 _CNV_R_R_Def_spr_ub_582_CM 0. 204. FORMAT "%5.2" /end CHARACTERISTIC
/begin CHARACTERISTIC K_ETA_MDKH "Minimales Wirkungsgrad bei Katheizen" VALUE 0xa101d42c _REC_VAL_20_s2 100. _CNV_R_R_Def_eta_sw_628_CM 0. 100. /end CHARACTERISTIC
/begin CHARACTERISTIC K_FWNWKH_MAX "" VALUE 0xa101d41e _REC_VAL_20_u2 0.9999 _CNV_R_R_Def_f_uw_b_591_CM 0. 0.9999 FORMAT "%14.5" /end CHARACTERISTIC
/begin CHARACTERISTIC K_FWNWKH_MIN "" VALUE 0xa101d41c _REC_VAL_20_u2 0.9999 _CNV_R_R_Def_f_uw_b_591_CM 0. 0.9999 FORMAT "%14.5" /end CHARACTERISTIC
/begin CHARACTERISTIC K_GELIIEAPP "Applikationswert Generatorlastbegrenzung für Leerlaufsolldrehzahlberechnung" VALUE 0xa1017cd8 _REC_VAL_20_u1 31.875 _CNV_R_R_Def_i_ub_q_645_CM 0. 31.875 /end CHARACTERISTIC
/begin CHARACTERISTIC K_GELIIEZK "Zeitkonstante für Filterung Generatorlastsignal (Leerlaufsolldrehzahlberechnung)" VALUE 0xa1017cd9 _REC_VAL_20_u1 0.996 _CNV_R_R_Def_f_ub_b_573_CM 0. 0.996 /end CHARACTERISTIC
/begin CHARACTERISTIC K_GELISETAPP "Aoolikationswert Generatorlastbegrenzung für Leerlaufstabilisierung" VALUE 0xa1017cda _REC_VAL_20_u1 1. _CNV_R_R_Def_dez_sl_575_CM 0. 1. FORMAT "%4.1" /end CHARACTERISTIC
/begin CHARACTERISTIC K_GELIVMAX "Maximale Fahrzeuggeschwindigkeit für Generatorlastbegrenzung" VALUE 0xa1017cc4 _REC_VAL_20_u2 131.07 _CNV_R_R_Def_v_uw_q_738_CM 0. 6553.5 FORMAT "%5.2" /end CHARACTERISTIC
/begin CHARACTERISTIC K_HISTDMERST "Manueller Reset d. Histogramm in der DME" VALUE 0xa101756a _REC_VAL_20_u1 99.45 _CNV_R_R_Def_dez_sl_575_CM 0. 255. FORMAT "%3.0" /end CHARACTERISTIC
/begin CHARACTERISTIC K_HISTIBSRST "Manueller Histogramm Reset in IBS" VALUE 0xa101756b _REC_VAL_20_u1 99.45 _CNV_R_R_Def_dez_sl_575_CM 0. 255. FORMAT "%3.0" /end CHARACTERISTIC
/begin CHARACTERISTIC K_IBSWAKEAPP "Bit, ob IBS Bus wecken darf oder nicht. Applikationsgroesse." VALUE 0xa101768d _REC_VAL_20_u1 99.45 _CNV_R_R_Def_dez_sl_575_CM 0. 255. FORMAT "%3.0" /end CHARACTERISTIC
/begin CHARACTERISTIC K_IB_COMMVAL "Anzahl Taskaufrufe zwischen periodischer Abfrage qlad und qelad" VALUE 0xa1017919 _REC_VAL_20_u1 99.45 _CNV_R_R_Def_dez_sl_575_CM 0. 255. FORMAT "%3.0" /end CHARACTERISTIC
/begin CHARACTERISTIC K_IGRDETEC "U_gsoll - U_ibs Max für Freeze" VALUE 0xa1017bac _REC_VAL_20_s2 99.83843999999999 _CNV_R_R_Def_u_sw_b_732_CM -128. 127.996 /end CHARACTERISTIC
/begin CHARACTERISTIC K_IPMPMDEC "Prio-dekrementfaktor aufgrund IPM" VALUE 0xa101765c _REC_VAL_20_u2 99. _CNV_R_R_Def_f_sw_p_581_CM 0. 450. /end CHARACTERISTIC
/begin CHARACTERISTIC K_IPMPMINC "Prio-Inkrementfaktor aufgrund IPM" VALUE 0xa101765e _REC_VAL_20_u2 99. _CNV_R_R_Def_f_sw_p_581_CM 0. 450. /end CHARACTERISTIC
/begin CHARACTERISTIC K_IWAKEAPP "Wakeupgrenze Appl." VALUE 0xa101756c _REC_VAL_20_u1 0.255 _CNV_R_R_Def_i_ub_q_652_CM 0. 0.255 /end CHARACTERISTIC
/begin CHARACTERISTIC K_I_FITAUSW "Grenzwert Fitstrom" VALUE 0xa101797c _REC_VAL_20_u2 104.856 _CNV_R_R_Def_i_uw_q_642_CM -200. 5042.8 /end CHARACTERISTIC
/begin CHARACTERISTIC K_KBMCNT_APP "Zeit, indem KBM alle Straenge einschalten soll." VALUE 0xa101768e _REC_VAL_20_u1 25.5 _CNV_R_R_Def_td_ub__593_CM 0. 25.5 FORMAT "%4.1" /end CHARACTERISTIC
/begin CHARACTERISTIC K_KHRAMP_AUS "" VALUE 0xa101d3bc _REC_VAL_20_u1 0.996 _CNV_R_R_Def_f_ub_b_573_CM 0. 0.996 /end CHARACTERISTIC
/begin CHARACTERISTIC K_KHRAMP_EIN "" VALUE 0xa101d3bd _REC_VAL_20_u1 0.996 _CNV_R_R_Def_f_ub_b_573_CM 0. 0.996 /end CHARACTERISTIC
/begin CHARACTERISTIC K_KH_EIN "" VALUE 0xa101d3be _REC_VAL_20_u1 0.996 _CNV_R_R_Def_f_ub_b_573_CM 0. 0.996 /end CHARACTERISTIC
/begin CHARACTERISTIC K_KSOGRZAPP "Ikurz_ogrz appl." VALUE 0xa101756d _REC_VAL_20_u1 99.84 _CNV_R_R_Def_i_ub_q_774_CM 0. 998.4 FORMAT "%5.2" /end CHARACTERISTIC
/begin CHARACTERISTIC K_KSUGRZAPP "Ikurz_ugrz Appl." VALUE 0xa101756e _REC_VAL_20_u1 100. _CNV_R_R_Def_i_ub_q_774_CM 0. 1000. FORMAT "%5.2" /end CHARACTERISTIC
/begin CHARACTERISTIC K_LLPMFILTK "Filterkonstante : Tiefpassfilter DF-Signal" VALUE 0xa101768f _REC_VAL_20_u1 0.996 _CNV_R_R_Def_f_ub_b_573_CM 0. 0.996 /end CHARACTERISTIC
/begin CHARACTERISTIC K_LLWDNMAX "Obere Schwelle Drehzahlabweichung im Leerlauf für Erkennung Generatorlastschwankung" VALUE 0xa1017cb8 _REC_VAL_20_s2 0. _CNV_R_R_Def_n_sw_q_612_CM -32768. 32767. FORMAT "%5.0" /end CHARACTERISTIC
/begin CHARACTERISTIC K_LLWDNMIN "Untere Schwelle Drehzahlabweichung im Leerlauf für Erkennung Generatorlastschwankung" VALUE 0xa1017cba _REC_VAL_20_s2 0. _CNV_R_R_Def_n_sw_q_612_CM -32768. 32767. FORMAT "%5.0" /end CHARACTERISTIC
/begin CHARACTERISTIC K_MATEN_KATHZ "Betriebsart Enablematrix Kathheizen" VAL_BLK 0xa101d3f4 _REC_VAL_2_u1 99.45 _CNV_R_R_Def_dez_sl_575_CM 0. 255. FORMAT "%3.0" NUMBER 8 /end CHARACTERISTIC
/begin CHARACTERISTIC K_MATEN_KATHZSUB "Sub-Betriebsart Enablematrix Kathheizen" VAL_BLK 0xa101d3fc _REC_VAL_2_u1 99.45 _CNV_R_R_Def_dez_sl_575_CM 0. 255. FORMAT "%3.0" NUMBER 16 /end CHARACTERISTIC
/begin CHARACTERISTIC K_MAT_ASPR "Zuordnung Eingang Ba-Umschaltung zu Betriebsart" VAL_BLK 0xa101d3e4 _REC_VAL_2_u1 99.45 _CNV_R_R_Def_dez_sl_575_CM 0. 255. FORMAT "%3.0" NUMBER 8 /end CHARACTERISTIC
/begin CHARACTERISTIC K_MAT_ASPRL "Zuordnung Eingang Ba-Umschaltung zu Betriebsart" VAL_BLK 0xa101d3dc _REC_VAL_2_u1 99.45 _CNV_R_R_Def_dez_sl_575_CM 0. 255. FORMAT "%3.0" NUMBER 8 /end CHARACTERISTIC
/begin CHARACTERISTIC K_MAT_ASPRVL "Zuordnung Eingang Ba-Umschaltung zu Betriebsart" VAL_BLK 0xa101d3ec _REC_VAL_2_u1 99.45 _CNV_R_R_Def_dez_sl_575_CM 0. 255. FORMAT "%3.0" NUMBER 8 /end CHARACTERISTIC
/begin CHARACTERISTIC K_MAT_ESPR "Zuordnung Eingang Ba-Umschaltung zu Betriebsart" VAL_BLK 0xa101d3cc _REC_VAL_2_u1 99.45 _CNV_R_R_Def_dez_sl_575_CM 0. 255. FORMAT "%3.0" NUMBER 8 /end CHARACTERISTIC
/begin CHARACTERISTIC K_MAT_ESPRL "Zuordnung Eingang Ba-Umschaltung zu Betriebsart" VAL_BLK 0xa101d3c4 _REC_VAL_2_u1 99.45 _CNV_R_R_Def_dez_sl_575_CM 0. 255. FORMAT "%3.0" NUMBER 8 /end CHARACTERISTIC
/begin CHARACTERISTIC K_MAT_ESPRVL "Zuordnung Eingang Ba-Umschaltung zu Betriebsart" VAL_BLK 0xa101d3d4 _REC_VAL_2_u1 99.45 _CNV_R_R_Def_dez_sl_575_CM 0. 255. FORMAT "%3.0" NUMBER 8 /end CHARACTERISTIC
/begin CHARACTERISTIC K_MN_PTCPI "Minimalwert des PI-Reglers PTC Ansteuerung" VALUE 0xa1017660 _REC_VAL_20_u2 102.39842 _CNV_R_R_Def_f_uw_b_636_CM 0. 511.9921 /end CHARACTERISTIC
/begin CHARACTERISTIC K_MN_PWRDFPI "Minimaler Wert PI-Regler df Prio" VALUE 0xa1017662 _REC_VAL_20_u2 102.39842 _CNV_R_R_Def_f_uw_b_636_CM 0. 511.9921 /end CHARACTERISTIC
/begin CHARACTERISTIC K_MX_PTCPI "Maximalwert des PI-Reglers PTC Ansteuerung" VALUE 0xa1017664 _REC_VAL_20_u2 102.39842 _CNV_R_R_Def_f_uw_b_636_CM 0. 511.9921 /end CHARACTERISTIC
/begin CHARACTERISTIC K_NKW2HIPTC "Nkw i.O. PTC darf zugeschaltet werden." VALUE 0xa1017656 _REC_VAL_20_s2 0. _CNV_R_R_Def_n_sw_q_612_CM -32768. 32767. FORMAT "%5.0" /end CHARACTERISTIC
/begin CHARACTERISTIC K_NKW2LOWPTC "Nkw zu niedrig, PTC wird abgeschaltet" VALUE 0xa1017658 _REC_VAL_20_s2 0. _CNV_R_R_Def_n_sw_q_612_CM -32768. 32767. FORMAT "%5.0" /end CHARACTERISTIC
/begin CHARACTERISTIC K_NMAXVNS_ANS "" VALUE 0xa101d420 _REC_VAL_20_s2 0. _CNV_R_R_Def_n_sw_q_612_CM -32768. 32767. FORMAT "%5.0" /end CHARACTERISTIC
/begin CHARACTERISTIC K_NMOTLLANH "Motordrehzahlschwelle für Rücksetzen der Leerlaufanhebung Generatorlast" VALUE 0xa1017cbc _REC_VAL_20_s2 0. _CNV_R_R_Def_n_sw_q_612_CM -32768. 32767. FORMAT "%5.0" /end CHARACTERISTIC
/begin CHARACTERISTIC K_NSTATLLANH "Schwelle Leerlaufsolldrehzahl zum Aktivieren der Leerlaufanhebung Generatorlast" VALUE 0xa1017cbe _REC_VAL_20_s2 0. _CNV_R_R_Def_n_sw_q_612_CM -32768. 32767. FORMAT "%5.0" /end CHARACTERISTIC
/begin CHARACTERISTIC K_OFASPRAP "Offset Applikation Auslass" VALUE 0xa101d430 _REC_VAL_20_s2 100.8 _CNV_R_R_Def_spr_ub_582_CM -180. 180. FORMAT "%5.2" /end CHARACTERISTIC
/begin CHARACTERISTIC K_OFESPRAP "Offset Applikation Einlass" VALUE 0xa101d432 _REC_VAL_20_s2 100.8 _CNV_R_R_Def_spr_ub_582_CM -180. 180. FORMAT "%5.2" /end CHARACTERISTIC
/begin CHARACTERISTIC K_OSPGAPP "Oberspannungsschwelle" VALUE 0xa1017554 _REC_VAL_20_u2 16.3837 _CNV_R_R_Def_u_uw_q_730_CM 6. 22.3837 FORMAT "%7.4" /end CHARACTERISTIC
/begin CHARACTERISTIC K_OSPGHYST "Unterspannungshysterese" VALUE 0xa101754e _REC_VAL_20_s2 16.3837 _CNV_R_R_Def_u_sw_q_733_CM -8.192 8.191700000000001 FORMAT "%7.4" /end CHARACTERISTIC
/begin CHARACTERISTIC K_OSPGPRELLZ "Anzahl der Entprellungen für Oberspannungsfehlereintrag" VALUE 0xa101756f _REC_VAL_20_u1 99.45 _CNV_R_R_Def_dez_sl_575_CM 0. 255. FORMAT "%3.0" /end CHARACTERISTIC
/begin CHARACTERISTIC K_OSPRELLDEC "Dekrement auf Entprellcounter Oberspannung" VALUE 0xa1017570 _REC_VAL_20_u1 99.45 _CNV_R_R_Def_dez_sl_575_CM 0. 255. FORMAT "%3.0" /end CHARACTERISTIC
/begin CHARACTERISTIC K_OSPRELLINC "Inkrement auf Entprellcounter Oberspannung" VALUE 0xa1017571 _REC_VAL_20_u1 99.45 _CNV_R_R_Def_dez_sl_575_CM 0. 255. FORMAT "%3.0" /end CHARACTERISTIC
/begin CHARACTERISTIC K_PMQ_UX "Ruhespannung Extrapolationsteiler" VALUE 0xa101791a _REC_VAL_20_u1 7.9374 _CNV_R_R_Def_f_ub_b_753_CM 3.13e-002 7.9687 FORMAT "%5.2" /end CHARACTERISTIC
/begin CHARACTERISTIC K_PMTIMERSQ1 "Startwert Timer für soc_quali" VALUE 0xa1017b26 _REC_VAL_20_u2 0. _CNV_R_R_Def_dez_sl_575_CM 0. 65535. FORMAT "%5.0" /end CHARACTERISTIC
/begin CHARACTERISTIC K_PMUBAT_MAX "Max. zugelassene Batteriespg " VALUE 0xa1017bb8 _REC_VAL_20_u2 16.3837 _CNV_R_R_Def_u_uw_q_730_CM 6. 22.3837 FORMAT "%7.4" /end CHARACTERISTIC
/begin CHARACTERISTIC K_PMUBAT_MIN "Min. zugelassene Batteriespg" VALUE 0xa1017bba _REC_VAL_20_u2 16.3837 _CNV_R_R_Def_u_uw_q_730_CM 6. 22.3837 FORMAT "%7.4" /end CHARACTERISTIC
/begin CHARACTERISTIC K_PMUGEN_MAX "Max zugelassene Generatorspg" VALUE 0xa1017bae _REC_VAL_20_s2 99.83843999999999 _CNV_R_R_Def_u_sw_b_732_CM -128. 127.996 /end CHARACTERISTIC
/begin CHARACTERISTIC K_PMUGEN_MIN "Min zugelassene Generatorspg" VALUE 0xa1017bb0 _REC_VAL_20_s2 99.83843999999999 _CNV_R_R_Def_u_sw_b_732_CM -128. 127.996 /end CHARACTERISTIC
/begin CHARACTERISTIC K_PM_IPMON "IPM Massnahmen bzgl. PM aktiviert" VALUE 0xa1017690 _REC_VAL_20_u1 3. _CNV_R_R_Def_dez_sl_575_CM 0. 3. FORMAT "%3.0" /end CHARACTERISTIC
/begin CHARACTERISTIC K_PM_TABSMN "Applikationsgrösse für Abstellzeit tabsmn_w" VALUE 0xa1017b28 _REC_VAL_20_u2 0. _CNV_R_R_Def_td_uw__682_CM 0. 65535. FORMAT "%5.0" /end CHARACTERISTIC
/begin CHARACTERISTIC K_POELADI "K-Wert Integrator Öldruck Adaption lernen" VALUE 0xa100e1b6 _REC_VAL_20_u2 0.9999 _CNV_R_R_Def_f_uw_b_591_CM 0. 0.9999 FORMAT "%14.5" /end CHARACTERISTIC
/begin CHARACTERISTIC K_POELADMN "Min-Begrenzung Integrator Öldruck Adaption lernen" VALUE 0xa100e1b8 _REC_VAL_20_s2 1.9999 _CNV_R_R_Def_f_uw_b_579_CM -1. 0.9999 FORMAT "%14.5" /end CHARACTERISTIC
/begin CHARACTERISTIC K_POELADMX "Max-Begrenzung Integrator Öldruck Adaption lernen" VALUE 0xa100e1ba _REC_VAL_20_s2 1.9999 _CNV_R_R_Def_f_uw_b_579_CM -1. 0.9999 FORMAT "%14.5" /end CHARACTERISTIC
/begin CHARACTERISTIC K_POELNKW_ON "Drehzahlschwelle für Aktivierung Öldruck-Regler" VALUE 0xa100e1ac _REC_VAL_20_s2 0. _CNV_R_R_Def_n_sw_q_612_CM -32768. 32767. FORMAT "%5.0" /end CHARACTERISTIC
/begin CHARACTERISTIC K_POELREGIMN "I-Anteil min für Öldruck-Regler" VALUE 0xa100e1be _REC_VAL_20_s2 1.9999 _CNV_R_R_Def_f_uw_b_579_CM -1. 0.9999 FORMAT "%14.5" /end CHARACTERISTIC
/begin CHARACTERISTIC K_POELREGIMX "I-Anteil max für Öldruck-Regler" VALUE 0xa100e1c0 _REC_VAL_20_s2 1.9999 _CNV_R_R_Def_f_uw_b_579_CM -1. 0.9999 FORMAT "%14.5" /end CHARACTERISTIC
/begin CHARACTERISTIC K_POELREGMN "Min-Grenze für Öldruck-Regler" VALUE 0xa100e1c2 _REC_VAL_20_s2 1.9999 _CNV_R_R_Def_f_uw_b_579_CM -1. 0.9999 FORMAT "%14.5" /end CHARACTERISTIC
/begin CHARACTERISTIC K_POELREGMX "Max-Grenze für Öldruck-Regler" VALUE 0xa100e1c4 _REC_VAL_20_s2 1.9999 _CNV_R_R_Def_f_uw_b_579_CM -1. 0.9999 FORMAT "%14.5" /end CHARACTERISTIC
/begin CHARACTERISTIC K_POELREG_OFF "Reibungs Offset für Öldruck Anti-Hysterese Funktion" VALUE 0xa100e1bc _REC_VAL_20_s2 1.9999 _CNV_R_R_Def_f_uw_b_579_CM -1. 0.9999 FORMAT "%14.5" /end CHARACTERISTIC
/begin CHARACTERISTIC K_POELROUTMN "Min-Grenze für Ausgang Öldruck-Regler" VALUE 0xa100e1c8 _REC_VAL_20_u2 0.9999 _CNV_R_R_Def_f_uw_b_591_CM 0. 0.9999 FORMAT "%14.5" /end CHARACTERISTIC
/begin CHARACTERISTIC K_POELROUTMX "Max-Grenze für Ausgang Öldruck-Regler" VALUE 0xa100e1c6 _REC_VAL_20_u2 0.9999 _CNV_R_R_Def_f_uw_b_591_CM 0. 0.9999 FORMAT "%14.5" /end CHARACTERISTIC
/begin CHARACTERISTIC K_POELSOLDYN "Max Abstand zw. Sollwert und Sollwert_f (Dynamikerkennung)" VALUE 0xa100e1ca _REC_VAL_20_u2 0. _CNV_R_R_Def_p_sw_q_683_CM 0. 65535. FORMAT "%4.1" /end CHARACTERISTIC
/begin CHARACTERISTIC K_POEL_NKW1 "Untere Drehzahlschwelle für Öldruck-Bereichs-Adaption" VALUE 0xa100e1ae _REC_VAL_20_s2 0. _CNV_R_R_Def_n_sw_q_612_CM -32768. 32767. FORMAT "%5.0" /end CHARACTERISTIC
/begin CHARACTERISTIC K_POEL_NKW2 "Obere Drehzahlschwelle für Öldruck-Bereichs-Adaption" VALUE 0xa100e1b0 _REC_VAL_20_s2 0. _CNV_R_R_Def_n_sw_q_612_CM -32768. 32767. FORMAT "%5.0" /end CHARACTERISTIC
/begin CHARACTERISTIC K_POEL_T1 "Untere Öltemperaturschwelle für Öldruck-Bereichs-Adaption" VALUE 0xa100e1b2 _REC_VAL_20_s2 98.30250000000001 _CNV_R_R_Def_t_sw_q_620_CM -327.68 327.67 FORMAT "%5.2" /end CHARACTERISTIC
/begin CHARACTERISTIC K_POEL_T2 "Obere Öltemperaturschwelle für Öldruck-Bereichs-Adaption" VALUE 0xa100e1b4 _REC_VAL_20_s2 98.30250000000001 _CNV_R_R_Def_t_sw_q_620_CM -327.68 327.67 FORMAT "%5.2" /end CHARACTERISTIC
/begin CHARACTERISTIC K_PRAIL_MAN "Manuelle Sollwertvorgabe für RAILDRUCK" VALUE 0xa102043c _REC_VAL_20_u2 39.9993 _CNV_R_R_Def_p_uw_q_685_CM 0. 39.9993 FORMAT "%7.4" /end CHARACTERISTIC
/begin CHARACTERISTIC K_PRIO15 "Prios bei Kl.15, Motor aus" VALUE 0xa1017691 _REC_VAL_20_u1 7. _CNV_R_R_Def_dez_sl_575_CM 0. 7. FORMAT "%3.0" /end CHARACTERISTIC
/begin CHARACTERISTIC K_PRIOCF15 "PrioCF bei kl.15, Motor aus" VALUE 0xa1017692 _REC_VAL_20_u1 7. _CNV_R_R_Def_dez_sl_575_CM 0. 7. FORMAT "%3.0" /end CHARACTERISTIC
/begin CHARACTERISTIC K_PRIOCFAPP "Steuerung Spitzenreduzierung Prioritaet Komfort App" VALUE 0xa1017693 _REC_VAL_20_u1 7. _CNV_R_R_Def_dez_sl_575_CM 0. 7. FORMAT "%3.0" /end CHARACTERISTIC
/begin CHARACTERISTIC K_PRIOCF_R "Prio Comfort Bei Kl.R" VALUE 0xa1017694 _REC_VAL_20_u1 7. _CNV_R_R_Def_dez_sl_575_CM 0. 7. FORMAT "%3.0" /end CHARACTERISTIC
/begin CHARACTERISTIC K_PRIODF "" VAL_BLK 0xa10176e4 _REC_VAL_2_u1 99.45 _CNV_R_R_Def_dez_sl_575_CM 0. 255. FORMAT "%3.0" NUMBER 7 /end CHARACTERISTIC
/begin CHARACTERISTIC K_PRIO_R "Prio Bei Kl.R" VALUE 0xa1017695 _REC_VAL_20_u1 7. _CNV_R_R_Def_dez_sl_575_CM 0. 7. FORMAT "%3.0" /end CHARACTERISTIC
/begin CHARACTERISTIC K_PT1SPR "Filterkonstante Spreizung" VALUE 0xa101d410 _REC_VAL_20_u1 0.996 _CNV_R_R_Def_f_ub_b_573_CM 0. 0.996 /end CHARACTERISTIC
/begin CHARACTERISTIC K_PTCPWRAPP "Ansteuerung PWM-Ausgang für PTC-Zuheizer. Applikationsgroesse." VALUE 0xa1017696 _REC_VAL_20_u1 99.45 _CNV_R_R_Def_f_ub_b_595_CM 0. 127.5 FORMAT "%5.2" /end CHARACTERISTIC
/begin CHARACTERISTIC K_PTC_PI "K-Faktor des PI-Reglers PTC-Ansteuerung" VALUE 0xa1017697 _REC_VAL_20_u1 0.996 _CNV_R_R_Def_f_ub_b_573_CM 0. 0.996 /end CHARACTERISTIC
/begin CHARACTERISTIC K_PWGLLANH "Fahrpedalwinkel-Schwelle für Rücksetzen der Leerlaufanhebung Generatorlast" VALUE 0xa1017cc0 _REC_VAL_20_s2 95.99852999999999 _CNV_R_R_Def_wdk_sw_691_CM -800. 799.9755 FORMAT "%5.2" /end CHARACTERISTIC
/begin CHARACTERISTIC K_PWRCOS15 "PWRCOS bei Kl.15, Motor aus" VALUE 0xa1017666 _REC_VAL_20_u2 0. _CNV_R_R_Def_dez_sl_575_CM 0. 65535. FORMAT "%5.0" /end CHARACTERISTIC
/begin CHARACTERISTIC K_PWRCOSAPP "Steuerung Leistung Verbraucher bitcodiert Applikationsgroesse" VALUE 0xa1017668 _REC_VAL_20_u2 0. _CNV_R_R_Def_dez_sl_575_CM 0. 65535. FORMAT "%5.0" /end CHARACTERISTIC
/begin CHARACTERISTIC K_PWRCOSHT "ctrpwrcos-Wert bei Generator Hochtemperatur" VALUE 0xa101766a _REC_VAL_20_u2 0. _CNV_R_R_Def_dez_sl_575_CM 0. 65535. FORMAT "%5.0" /end CHARACTERISTIC
/begin CHARACTERISTIC K_PWRCOSULEV "Bitcodierte ctrpwrcos Zuschaltung bei Sulev" VALUE 0xa101766c _REC_VAL_20_u2 0. _CNV_R_R_Def_dez_sl_575_CM 0. 65535. FORMAT "%5.0" /end CHARACTERISTIC
/begin CHARACTERISTIC K_PWRCOS_R "PowerCos Bitcodiert bei Kl.R" VALUE 0xa101766e _REC_VAL_20_u2 0. _CNV_R_R_Def_dez_sl_575_CM 0. 65535. FORMAT "%5.0" /end CHARACTERISTIC
/begin CHARACTERISTIC K_PWRCSGNDEF "ctrpwrcos-Wert bei Gen. mechn. el. Fehler" VALUE 0xa1017670 _REC_VAL_20_u2 0. _CNV_R_R_Def_dez_sl_575_CM 0. 65535. FORMAT "%5.0" /end CHARACTERISTIC
/begin CHARACTERISTIC K_PWRCSKOMM "ctrpwrcos Wert bei Gen. Komm. Fehler" VALUE 0xa1017672 _REC_VAL_20_u2 0. _CNV_R_R_Def_dez_sl_575_CM 0. 65535. FORMAT "%5.0" /end CHARACTERISTIC
/begin CHARACTERISTIC K_PWRDF_PI "K-Faktor des PI Reglers zur Berechnung von ctrpwrdf" VALUE 0xa1017698 _REC_VAL_20_u1 0.996 _CNV_R_R_Def_f_ub_b_573_CM 0. 0.996 /end CHARACTERISTIC
/begin CHARACTERISTIC K_QSOCCL1 "Grenze zur Ladezustandsqualitätsklasse1" VALUE 0xa1017b2a _REC_VAL_20_u2 95.442256 _CNV_R_R_Def_ql_uw__596_CM 0. 1193.0282 /end CHARACTERISTIC
/begin CHARACTERISTIC K_QSOCCL2 "Grenze zur Ladezustandsqualitätsklasse2" VALUE 0xa1017b2c _REC_VAL_20_u2 95.442256 _CNV_R_R_Def_ql_uw__596_CM 0. 1193.0282 /end CHARACTERISTIC
/begin CHARACTERISTIC K_QSOCCL3 "Grenze zur Ladezustandsqualitätsklasse3" VALUE 0xa1017b2e _REC_VAL_20_u2 95.442256 _CNV_R_R_Def_ql_uw__596_CM 0. 1193.0282 /end CHARACTERISTIC
/begin CHARACTERISTIC K_QSTARTFGA "Applikationswert für q_startfgk" VALUE 0xa1017b30 _REC_VAL_20_u2 95.442256 _CNV_R_R_Def_ql_uw__596_CM 0. 1193.0282 /end CHARACTERISTIC
/begin CHARACTERISTIC K_Q_BILAPWF "Defaultwert für q_bila nach Powerfail" VALUE 0xa1017910 _REC_VAL_20_u2 95.442256 _CNV_R_R_Def_ql_uw__596_CM 0. 1193.0282 /end CHARACTERISTIC
/begin CHARACTERISTIC K_RAMPENA "" VALUE 0xa101d424 _REC_VAL_20_u2 131.07 _CNV_R_R_Def_spr_sw_583_CM 0. 6553.5 FORMAT "%5.2" /end CHARACTERISTIC
/begin CHARACTERISTIC K_RESET_PI "PI-Reset-Zeit bei steigender Kl.15" VALUE 0xa1017699 _REC_VAL_20_u1 25.5 _CNV_R_R_Def_td_ub__593_CM 0. 25.5 FORMAT "%4.1" /end CHARACTERISTIC
/begin CHARACTERISTIC K_RFMAXVNS_ANS "" VALUE 0xa101d422 _REC_VAL_20_s2 98.30250000000001 _CNV_R_R_Def_rf_sw__616_CM -327.68 327.67 FORMAT "%7.4" /end CHARACTERISTIC
/begin CHARACTERISTIC K_RIN_GRENZ1 "Grenzwert Innenwiderstand Batterie1" VALUE 0xa1017b72 _REC_VAL_20_u1 31.875 _CNV_R_R_Def_f_ub_b_695_CM 0. 31.875 FORMAT "%5.2" /end CHARACTERISTIC
/begin CHARACTERISTIC K_RIN_GRENZ2 "Grenzwert Innenwiderstand Batterie2" VALUE 0xa1017b73 _REC_VAL_20_u1 31.875 _CNV_R_R_Def_f_ub_b_695_CM 0. 31.875 FORMAT "%5.2" /end CHARACTERISTIC
/begin CHARACTERISTIC K_RIN_GRENZ3 "Grenzwert Innenwiderstand Batterie3" VALUE 0xa1017b74 _REC_VAL_20_u1 31.875 _CNV_R_R_Def_f_ub_b_695_CM 0. 31.875 FORMAT "%5.2" /end CHARACTERISTIC
/begin CHARACTERISTIC K_RIN_GRENZ4 "Grenzwert Innenwiderstand Batterie4" VALUE 0xa1017b75 _REC_VAL_20_u1 31.875 _CNV_R_R_Def_f_ub_b_695_CM 0. 31.875 FORMAT "%5.2" /end CHARACTERISTIC
/begin CHARACTERISTIC K_RIN_GRENZ5 "Grenzwert Innenwiderstand Batterie5" VALUE 0xa1017b76 _REC_VAL_20_u1 31.875 _CNV_R_R_Def_f_ub_b_695_CM 0. 31.875 FORMAT "%5.2" /end CHARACTERISTIC
/begin CHARACTERISTIC K_RIN_GRENZ6 "Grenzwert Innenwiderstand Batterie6" VALUE 0xa1017b77 _REC_VAL_20_u1 31.875 _CNV_R_R_Def_f_ub_b_695_CM 0. 31.875 FORMAT "%5.2" /end CHARACTERISTIC
/begin CHARACTERISTIC K_RIN_GRENZ7 "Grenzwert Innenwiderstand Batterie7" VALUE 0xa1017b78 _REC_VAL_20_u1 31.875 _CNV_R_R_Def_f_ub_b_695_CM 0. 31.875 FORMAT "%5.2" /end CHARACTERISTIC
/begin CHARACTERISTIC K_RIN_GRENZ8 "Grenzwert Innenwiderstand Batterie8" VALUE 0xa1017b79 _REC_VAL_20_u1 31.875 _CNV_R_R_Def_f_ub_b_695_CM 0. 31.875 FORMAT "%5.2" /end CHARACTERISTIC
/begin CHARACTERISTIC K_RQPCOSA "Parameter für SV-Anmeldung" VALUE 0xa101769a _REC_VAL_20_u1 3. _CNV_R_R_Def_dez_sl_575_CM 0. 3. FORMAT "%3.0" /end CHARACTERISTIC
/begin CHARACTERISTIC K_RQPCOSAPP "Anforderung Standverbraucher Applikationsgroesse" VALUE 0xa101769b _REC_VAL_20_u1 99.45 _CNV_R_R_Def_dez_sl_575_CM 0. 255. FORMAT "%3.0" /end CHARACTERISTIC
/begin CHARACTERISTIC K_RQULCP "RQPCOS Master umschalter" VALUE 0xa101769c _REC_VAL_20_u1 4. _CNV_R_R_Def_dez_sl_575_CM 0. 4. FORMAT "%3.0" /end CHARACTERISTIC
/begin CHARACTERISTIC K_RUHVERMODE "Ruhestromverletzungserkennungsmode" VALUE 0xa1017572 _REC_VAL_20_u1 99.45 _CNV_R_R_Def_dez_sl_575_CM 0. 255. FORMAT "%3.0" /end CHARACTERISTIC
/begin CHARACTERISTIC K_SELSPCOSA "Spezialverbraucher" VALUE 0xa101769d _REC_VAL_20_u1 15. _CNV_R_R_Def_dez_sl_575_CM 0. 15. FORMAT "%3.0" /end CHARACTERISTIC
/begin CHARACTERISTIC K_SELSPCSAPP "Auswahl Sonderverbraucher Applikationsgroesse" VALUE 0xa101769e _REC_VAL_20_u1 15. _CNV_R_R_Def_dez_sl_575_CM 0. 15. FORMAT "%3.0" /end CHARACTERISTIC
/begin CHARACTERISTIC K_SOCFITAPP "Applikationwert Soc aus der Fitberechnung" VALUE 0xa101797e _REC_VAL_20_u2 99.9984 _CNV_R_R_Def_f_uw_b_576_CM 0. 99.9984 /end CHARACTERISTIC
/begin CHARACTERISTIC K_SOCFITGRZ "Grenzwert für soc_fit" VALUE 0xa1017b32 _REC_VAL_20_u2 99.9984 _CNV_R_R_Def_f_uw_b_576_CM 0. 99.9984 /end CHARACTERISTIC
/begin CHARACTERISTIC K_SOCFITLIMH "Applikationskonstante zur Verbesserung SoC aus der Fitberechnung" VALUE 0xa1017b34 _REC_VAL_20_u2 99.9984 _CNV_R_R_Def_f_uw_b_576_CM 0. 99.9984 /end CHARACTERISTIC
/begin CHARACTERISTIC K_SOCFITLIML "Applikationskonstante zur Abwertung SoC aus der Fitberechnung" VALUE 0xa1017b36 _REC_VAL_20_u2 99.9984 _CNV_R_R_Def_f_uw_b_576_CM 0. 99.9984 /end CHARACTERISTIC
/begin CHARACTERISTIC K_SOC_BILAWA "Applikationswert soc_bila" VALUE 0xa1017912 _REC_VAL_20_u2 99.9984 _CNV_R_R_Def_f_uw_b_576_CM 0. 99.9984 /end CHARACTERISTIC
/begin CHARACTERISTIC K_SOC_QPWF "Ladezustandsqualität nach Powerfail" VALUE 0xa1017914 _REC_VAL_20_u2 95.442256 _CNV_R_R_Def_ql_uw__596_CM 0. 1193.0282 /end CHARACTERISTIC
/begin CHARACTERISTIC K_SOC_QUALIA "Applikationswert soc_quali" VALUE 0xa1017916 _REC_VAL_20_u2 95.442256 _CNV_R_R_Def_ql_uw__596_CM 0. 1193.0282 /end CHARACTERISTIC
/begin CHARACTERISTIC K_SOC_STAFGA "Applikationswert für SoC aus der Startfähigkeit" VALUE 0xa1017b38 _REC_VAL_20_u2 99.9984 _CNV_R_R_Def_f_uw_b_576_CM 0. 99.9984 /end CHARACTERISTIC
/begin CHARACTERISTIC K_SPRLLFL_AUS "" VALUE 0xa101d417 _REC_VAL_20_u1 99.45 _CNV_R_R_Def_dez_sl_575_CM 0. 255. FORMAT "%3.0" /end CHARACTERISTIC
/begin CHARACTERISTIC K_SPRLLFL_EIN "" VALUE 0xa101d418 _REC_VAL_20_u1 99.45 _CNV_R_R_Def_dez_sl_575_CM 0. 255. FORMAT "%3.0" /end CHARACTERISTIC
/begin CHARACTERISTIC K_SPRRAMP_EIN "Minimale Rampensteigung nach Startende" VALUE 0xa101d442 _REC_VAL_20_s2 131.07 _CNV_R_R_Def_spr_sw_583_CM -3276.8 3276.7 FORMAT "%5.2" /end CHARACTERISTIC
/begin CHARACTERISTIC K_SPRRAMP_NEG "" VALUE 0xa101d428 _REC_VAL_20_s2 131.07 _CNV_R_R_Def_spr_sw_583_CM -3276.8 3276.7 FORMAT "%5.2" /end CHARACTERISTIC
/begin CHARACTERISTIC K_SPRRAMP_POS "" VALUE 0xa101d426 _REC_VAL_20_s2 131.07 _CNV_R_R_Def_spr_sw_583_CM -3276.8 3276.7 FORMAT "%5.2" /end CHARACTERISTIC
/begin CHARACTERISTIC K_SPRZGAN_OFF "Anschlagspreizung Offset" VAL_BLK 0xa101d41a _REC_VAL_2_u1 99.96000000000001 _CNV_R_R_Def_spr_ub_582_CM 0. 204. FORMAT "%5.2" NUMBER 2 /end CHARACTERISTIC
/begin CHARACTERISTIC K_STPCOSAPP "Status Standverbraucher Applikationsgroesse" VALUE 0xa101769f _REC_VAL_20_u1 3. _CNV_R_R_Def_dez_sl_575_CM 0. 3. FORMAT "%3.0" /end CHARACTERISTIC
/begin CHARACTERISTIC K_T1PMINFO "T1 Zykluszeit fuer PM Fehlerinfo" VALUE 0xa1017573 _REC_VAL_20_u1 25.5 _CNV_R_R_Def_td_ub__593_CM 0. 25.5 FORMAT "%4.1" /end CHARACTERISTIC
/begin CHARACTERISTIC K_T2PMINFO "T2 Zykluszeit fuer PM Fehlerinfo" VALUE 0xa1017556 _REC_VAL_20_u2 131.07 _CNV_R_R_Def_td_ub__593_CM 0. 6553.5 FORMAT "%4.1" /end CHARACTERISTIC
/begin CHARACTERISTIC K_T3PMINFO "T3 Zykluszeit fuer PM Fehlerinfo" VALUE 0xa1017558 _REC_VAL_20_u2 131.07 _CNV_R_R_Def_td_ub__593_CM 0. 6553.5 FORMAT "%4.1" /end CHARACTERISTIC
/begin CHARACTERISTIC K_TBATNACHL "B_ccbtnach wird nach dieser Zeit aktiviert" VALUE 0xa101755a _REC_VAL_20_u2 131.07 _CNV_R_R_Def_td_ub__593_CM 0. 6553.5 FORMAT "%4.1" /end CHARACTERISTIC
/begin CHARACTERISTIC K_TCODIERPM "T1 Zyklus fuer Fehlerinfo" VALUE 0xa1017574 _REC_VAL_20_u1 25.5 _CNV_R_R_Def_td_ub__593_CM 0. 25.5 FORMAT "%4.1" /end CHARACTERISTIC
/begin CHARACTERISTIC K_TDFDTMAX "Zeitschwelle zum Erkennen Drehzahlabweichung durch Generatorlastschwankung" VALUE 0xa1017cc6 _REC_VAL_20_u2 131.07 _CNV_R_R_Def_td_uw__726_CM 0. 13107. FORMAT "%4.1" /end CHARACTERISTIC
/begin CHARACTERISTIC K_TDFFABLF "Zeitschwelle (Tdffgen) zum Rücksetzen der Leerlaufanhebung" VALUE 0xa1017cc8 _REC_VAL_20_u2 131.07 _CNV_R_R_Def_td_uw__726_CM 0. 13107. FORMAT "%4.1" /end CHARACTERISTIC
/begin CHARACTERISTIC K_TDFFMAX "Maximale Periodendauer Generatorlastschwankungen  für Leerlaufstabilisierung" VALUE 0xa1017cca _REC_VAL_20_u2 131.07 _CNV_R_R_Def_td_uw__726_CM 0. 13107. FORMAT "%4.1" /end CHARACTERISTIC
/begin CHARACTERISTIC K_TDFFMIN "Minimale Periodendauer Generatorlastschwankungen für Leerlaufstabilisierung" VALUE 0xa1017ccc _REC_VAL_20_u2 131.07 _CNV_R_R_Def_td_uw__726_CM 0. 13107. FORMAT "%4.1" /end CHARACTERISTIC
/begin CHARACTERISTIC K_TDNHOLD "Haltezeit für Bedingung Drehzahlabweichung durch Generatorlastschwankung" VALUE 0xa1017cdb _REC_VAL_20_u1 51. _CNV_R_R_Def_td_uw__726_CM 0. 51. FORMAT "%4.1" /end CHARACTERISTIC
/begin CHARACTERISTIC K_TD_BNMOT "Zeit nach Motorlauf, wo die stufenweise (USTEPMIN) Berechnung von uibs aktiviert wird." VALUE 0xa1017bbd _REC_VAL_20_u1 99.45 _CNV_R_R_Def_td_uw__682_CM 0. 255. FORMAT "%5.2" /end CHARACTERISTIC
/begin CHARACTERISTIC K_TD_PMUGEN "Taskzeit von PMUGENCALC, = Zeit wo die stufenweise Setzung von uibs berechnet wird." VALUE 0xa1017bbe _REC_VAL_20_u1 99.45 _CNV_R_R_Def_td_uw__682_CM 0. 255. FORMAT "%5.2" /end CHARACTERISTIC
/begin CHARACTERISTIC K_TD_POELAD "Raster für Öldruck Adaption lernen" VALUE 0xa100e1a8 _REC_VAL_20_u1 2.54 _CNV_R_R_Def_td_uw__679_CM 1.e-002 2.55 FORMAT "%5.2" /end CHARACTERISTIC
/begin CHARACTERISTIC K_TD_POELDIAG "Integrationszeit für Öldruckregler Diagnose" VALUE 0xa100e1aa _REC_VAL_20_u1 2.55 _CNV_R_R_Def_td_uw__679_CM 0. 2.55 FORMAT "%5.2" /end CHARACTERISTIC
/begin CHARACTERISTIC K_TD_POELDYN "Verzögerung mit der B_poeldyn zurückgesetzt wird" VALUE 0xa100e1a9 _REC_VAL_20_u1 2.55 _CNV_R_R_Def_td_uw__679_CM 0. 2.55 FORMAT "%5.2" /end CHARACTERISTIC
/begin CHARACTERISTIC K_TD_POELIST "Filterkonstante Ist-Öldruck" VALUE 0xa100e1ce _REC_VAL_20_u2 99.9984 _CNV_R_R_Def_f_uw_b_576_CM 0. 99.9984 /end CHARACTERISTIC
/begin CHARACTERISTIC K_TD_POELMDL "Filterkonstante Modell-Öldruck" VALUE 0xa100e1cc _REC_VAL_20_u2 99.9984 _CNV_R_R_Def_f_uw_b_576_CM 0. 99.9984 /end CHARACTERISTIC
/begin CHARACTERISTIC K_TD_POELNKW "Zeitverzögerung nach Überschreiten Drehzahlschwelle" VALUE 0xa100e1ab _REC_VAL_20_u1 2.55 _CNV_R_R_Def_td_uw__679_CM 0. 2.55 FORMAT "%5.2" /end CHARACTERISTIC
/begin CHARACTERISTIC K_TD_POELSD "Filterkonstante Soll-Öldruck für Diagnose (Dynamikerkennung)" VALUE 0xa100e1d2 _REC_VAL_20_u2 99.9984 _CNV_R_R_Def_f_uw_b_576_CM 0. 99.9984 /end CHARACTERISTIC
/begin CHARACTERISTIC K_TD_POELSOL "Filterkonstante Soll-Öldruck" VALUE 0xa100e1d0 _REC_VAL_20_u2 99.9984 _CNV_R_R_Def_f_uw_b_576_CM 0. 99.9984 /end CHARACTERISTIC
/begin CHARACTERISTIC K_TD_PWRDFPI "K-Faktor des PI Reglers zur Berechnung von ctrpwrdf" VALUE 0xa1017674 _REC_VAL_20_u2 131.068 _CNV_R_R_Def_td_ub__593_CM 0.1 6553.5 FORMAT "%4.1" /end CHARACTERISTIC
/begin CHARACTERISTIC K_TIME_START "Zeittriggerschwelle nach Motorstart" VALUE 0xa1017b6c _REC_VAL_20_u2 98.30250000000001 _CNV_R_R_Def_td_uw__679_CM 0. 655.35 FORMAT "%5.2" /end CHARACTERISTIC
/begin CHARACTERISTIC K_TMASPR "Motortemperaturschwelle für Auslassspreizungsfreigabe" VALUE 0xa101d434 _REC_VAL_20_s2 98.30250000000001 _CNV_R_R_Def_t_sw_q_620_CM -327.68 327.67 FORMAT "%5.2" /end CHARACTERISTIC
/begin CHARACTERISTIC K_TMESPR "Motortemperaturschwelle für Einlassspreizungsfreigabe" VALUE 0xa101d436 _REC_VAL_20_s2 98.30250000000001 _CNV_R_R_Def_t_sw_q_620_CM -327.68 327.67 FORMAT "%5.2" /end CHARACTERISTIC
/begin CHARACTERISTIC K_TMOTLLANH "Motortemperatur-Schwelle zum Aktivieren der Leerlaufanhebung Generatorlast" VALUE 0xa1017cc2 _REC_VAL_20_s2 98.30250000000001 _CNV_R_R_Def_t_sw_q_620_CM -327.68 327.67 FORMAT "%5.2" /end CHARACTERISTIC
/begin CHARACTERISTIC K_TMVS_ANLERN "Tmot Schwelle für zus. Anschlagadaption bei SA" VALUE 0xa101d43c _REC_VAL_20_s2 98.30250000000001 _CNV_R_R_Def_t_sw_q_620_CM -327.68 327.67 FORMAT "%5.2" /end CHARACTERISTIC
/begin CHARACTERISTIC K_TNSTLLANH "Zeitschwelle nach Startende zum Aktivieren der Leerlaufanhebung Generatorlast" VALUE 0xa1017cce _REC_VAL_20_u2 98.30250000000001 _CNV_R_R_Def_td_uw__679_CM 0. 655.35 FORMAT "%5.2" /end CHARACTERISTIC
/begin CHARACTERISTIC K_TRINGSHIFT "Ruhezeit nachdem der Ruhestrom-Ringspeicher eingetragen wird." VALUE 0xa1017575 _REC_VAL_20_u1 99.96000000000001 _CNV_R_R_Def_td_uw__719_CM 0. 238. FORMAT "%7.4" /end CHARACTERISTIC
/begin CHARACTERISTIC K_TSAISONFIL "Filterkonstante für t_saison" VALUE 0xa1017b3a _REC_VAL_20_u2 0. _CNV_R_R_Def_dez_sl_575_CM 1. 65535. FORMAT "%5.0" /end CHARACTERISTIC
/begin CHARACTERISTIC K_TSAISPWF "Defaultwert Saison Temp bei DME Powerfail" VALUE 0xa1017b20 _REC_VAL_20_s2 131.07 _CNV_R_R_Def_t_sw_q_618_CM -3276.8 3276.7 FORMAT "%4.1" /end CHARACTERISTIC
/begin CHARACTERISTIC K_TVRAMP "Startwert für TurnOnDelay Timer für Dvsx_ramp" VALUE 0xa101d438 _REC_VAL_20_u2 98.30250000000001 _CNV_R_R_Def_td_uw__679_CM 0. 655.35 FORMAT "%5.2" /end CHARACTERISTIC
/begin CHARACTERISTIC K_TVSPSA "Startwert für TurnOnDelay Timer für zus. Anschlagadaption bei SA" VALUE 0xa101d43a _REC_VAL_20_u2 98.30250000000001 _CNV_R_R_Def_td_uw__679_CM 0. 655.35 FORMAT "%5.2" /end CHARACTERISTIC
/begin CHARACTERISTIC K_T_BNSDELAY "Delayzeit nach Motorstartende für BNS Überwachung" VALUE 0xa1017cb3 _REC_VAL_20_u1 99.45 _CNV_R_R_Def_td_uw__682_CM 0. 255. FORMAT "%5.2" /end CHARACTERISTIC
/begin CHARACTERISTIC K_T_CCRUHVER "Dauer fuer CC-Meld. erhoehter Ruhestrom" VALUE 0xa101755c _REC_VAL_20_u2 131.07 _CNV_R_R_Def_td_ub__593_CM 0. 6553.5 FORMAT "%4.1" /end CHARACTERISTIC
/begin CHARACTERISTIC K_T_IPMPRIO "max. Zeit, indem Prio aufgrund IPM gesteuert wird" VALUE 0xa10176a0 _REC_VAL_20_u1 25.5 _CNV_R_R_Def_td_ub__593_CM 0. 25.5 FORMAT "%4.1" /end CHARACTERISTIC
/begin CHARACTERISTIC K_T_KMSHIFT "Delayzeit für Km_st Info-shift" VALUE 0xa101755e _REC_VAL_20_u2 131.07 _CNV_R_R_Def_td_ub__593_CM 0. 6553.5 FORMAT "%4.1" /end CHARACTERISTIC
/begin CHARACTERISTIC K_T_NKPTCAUS "Zeit PTC aus aufgrund NKW zu niedrig." VALUE 0xa10176a1 _REC_VAL_20_u1 25.5 _CNV_R_R_Def_td_ub__593_CM 0. 25.5 FORMAT "%4.1" /end CHARACTERISTIC
/begin CHARACTERISTIC K_T_OSPGRSET "Zeit für 1x Oberspannungsentprellungrücknahme" VALUE 0xa1017576 _REC_VAL_20_u1 25.5 _CNV_R_R_Def_td_ub__593_CM 0. 25.5 FORMAT "%4.1" /end CHARACTERISTIC
/begin CHARACTERISTIC K_T_OSPGSET "Entrpellzeit FS_oberspannungserkennung" VALUE 0xa1017577 _REC_VAL_20_u1 25.5 _CNV_R_R_Def_td_ub__593_CM 0. 25.5 FORMAT "%4.1" /end CHARACTERISTIC
/begin CHARACTERISTIC K_T_PMBS "Zeit bis zum nächsten zyklischen senden" VALUE 0xa10176a2 _REC_VAL_20_u1 99.45 _CNV_R_R_Def_td_uw__682_CM 0. 255. FORMAT "%5.2" /end CHARACTERISTIC
/begin CHARACTERISTIC K_T_PMVS "Zeit zwischen zwei zyklischen Sendungen von 3b3 " VALUE 0xa10176a3 _REC_VAL_20_u1 99.45 _CNV_R_R_Def_td_uw__682_CM 0. 255. FORMAT "%5.2" /end CHARACTERISTIC
/begin CHARACTERISTIC K_T_PTCKWAN "PTC-Ein Wartezeit nach Motor an." VALUE 0xa10176a4 _REC_VAL_20_u1 25.5 _CNV_R_R_Def_td_ub__593_CM 0. 25.5 FORMAT "%4.1" /end CHARACTERISTIC
/begin CHARACTERISTIC K_T_PTCPI "T-Faktor des PI-Reglers für PTC-Ansteuerung" VALUE 0xa1017676 _REC_VAL_20_u2 131.068 _CNV_R_R_Def_td_ub__593_CM 0.1 6553.5 FORMAT "%4.1" /end CHARACTERISTIC
/begin CHARACTERISTIC K_T_RUHAUSW "Minimal verstrichene Zeit für Ruheverl. Auswertung" VALUE 0xa1017578 _REC_VAL_20_u1 99.96000000000001 _CNV_R_R_Def_td_uw__719_CM 0. 238. FORMAT "%7.4" /end CHARACTERISTIC
/begin CHARACTERISTIC K_T_SQSHIFT "Delayzeit für Soc_quali Info-shift" VALUE 0xa1017579 _REC_VAL_20_u1 25.5 _CNV_R_R_Def_td_ub__593_CM 0. 25.5 FORMAT "%4.1" /end CHARACTERISTIC
/begin CHARACTERISTIC K_T_SULEVON "Zeit für SULEV-ctrpwrcos-prios nach Motorstart" VALUE 0xa1017678 _REC_VAL_20_u2 131.07 _CNV_R_R_Def_td_ub__593_CM 0. 6553.5 FORMAT "%4.1" /end CHARACTERISTIC
/begin CHARACTERISTIC K_T_USPGRSET "Uterspannung Resetzeit" VALUE 0xa101757a _REC_VAL_20_u1 25.5 _CNV_R_R_Def_td_ub__593_CM 0. 25.5 FORMAT "%4.1" /end CHARACTERISTIC
/begin CHARACTERISTIC K_T_USPGSET "Zeit für 1x Unterspannungsentprellung" VALUE 0xa101757b _REC_VAL_20_u1 25.5 _CNV_R_R_Def_td_ub__593_CM 0. 25.5 FORMAT "%4.1" /end CHARACTERISTIC
/begin CHARACTERISTIC K_UBAT_LP "K-Faktor des ubatt-tiefpass Filters zur Berechnung von ctrpwrdf" VALUE 0xa101767a _REC_VAL_20_u2 0.9999847412109381 _CNV_R_R_Def_f_uw_b_591_CM 0. 0.9999847412109381 FORMAT "%14.5" /end CHARACTERISTIC
/begin CHARACTERISTIC K_UBPTC_LP "K-Faktor des ubatt-Tiefpass Filters zur Berechnung von PTC" VALUE 0xa101767c _REC_VAL_20_u2 0.9999847412109381 _CNV_R_R_Def_f_uw_b_591_CM 0. 0.9999847412109381 FORMAT "%14.5" /end CHARACTERISTIC
/begin CHARACTERISTIC K_UBTAPP "Batteriespannung Applikationsgroesse" VALUE 0xa101767e _REC_VAL_20_u2 61.425 _CNV_R_R_Def_u_uw_q_735_CM 0. 61.425 /end CHARACTERISTIC
/begin CHARACTERISTIC K_UBTLOWMAX "Obere Unterspannungsgrenze" VALUE 0xa1017680 _REC_VAL_20_u2 10. _CNV_R_R_Def_u_uw_q_730_CM 6. 16. FORMAT "%7.4" /end CHARACTERISTIC
/begin CHARACTERISTIC K_UBTLOWMIN "Untere Unterspannungsgrenze" VALUE 0xa1017682 _REC_VAL_20_u2 10. _CNV_R_R_Def_u_uw_q_730_CM 6. 16. FORMAT "%7.4" /end CHARACTERISTIC
/begin CHARACTERISTIC K_UB_GRENZ "Grenzwert Gradient d. Bordnetzspannung" VALUE 0xa1017b6e _REC_VAL_20_u2 123.46794 _CNV_R_R_Def_u_sb_q_598_CM 0. 6173.397 FORMAT "%4.1" /end CHARACTERISTIC
/begin CHARACTERISTIC K_UGENNORM "Generator Normspannung" VALUE 0xa1017bb2 _REC_VAL_20_s2 99.83843999999999 _CNV_R_R_Def_u_sw_b_732_CM -128. 127.996 /end CHARACTERISTIC
/begin CHARACTERISTIC K_UIBSAPP "Manueller Applikationswert von Uibs an UGENKOR" VALUE 0xa1017bb4 _REC_VAL_20_s2 99.83843999999999 _CNV_R_R_Def_u_sw_b_732_CM -128. 127.996 /end CHARACTERISTIC
/begin CHARACTERISTIC K_ULEVA "Spannungslevel" VALUE 0xa10176a5 _REC_VAL_20_u1 99.45 _CNV_R_R_Def_dez_sl_575_CM 0. 255. FORMAT "%3.0" /end CHARACTERISTIC
/begin CHARACTERISTIC K_ULEVAPP "Spannungsebene Applikationsgroesse" VALUE 0xa10176a6 _REC_VAL_20_u1 15. _CNV_R_R_Def_dez_sl_575_CM 0. 15. FORMAT "%3.0" /end CHARACTERISTIC
/begin CHARACTERISTIC K_ULOWSETAPP "Entrpellzeit zentrale Unterspannung" VALUE 0xa10176a7 _REC_VAL_20_u1 25.5 _CNV_R_R_Def_td_ub__593_CM 0. 25.5 FORMAT "%4.1" /end CHARACTERISTIC
/begin CHARACTERISTIC K_USPGAPP "Unterspannungschwelle" VALUE 0xa1017560 _REC_VAL_20_u2 16.3837 _CNV_R_R_Def_u_uw_q_730_CM 6. 22.3837 FORMAT "%7.4" /end CHARACTERISTIC
/begin CHARACTERISTIC K_USPGHYST "Unterspannungshysterese" VALUE 0xa1017550 _REC_VAL_20_s2 16.3837 _CNV_R_R_Def_u_sw_q_733_CM -8.192 8.191700000000001 FORMAT "%7.4" /end CHARACTERISTIC
/begin CHARACTERISTIC K_USPGPRELLZ "Anzahl der FS_uspg Entprellungen für Fehlereintrag" VALUE 0xa101757c _REC_VAL_20_u1 99.45 _CNV_R_R_Def_dez_sl_575_CM 0. 255. FORMAT "%3.0" /end CHARACTERISTIC
/begin CHARACTERISTIC K_USPRELLDEC "Dekrement auf Entprellcounter Unterspannung" VALUE 0xa101757d _REC_VAL_20_u1 99.45 _CNV_R_R_Def_dez_sl_575_CM 0. 255. FORMAT "%3.0" /end CHARACTERISTIC
/begin CHARACTERISTIC K_USPRELLINC "Inkrement auf Entprellcounter Unterspannung" VALUE 0xa101757e _REC_VAL_20_u1 99.45 _CNV_R_R_Def_dez_sl_575_CM 0. 255. FORMAT "%3.0" /end CHARACTERISTIC
/begin CHARACTERISTIC K_USTARTGRZ "Spannungsgrenzwert für Startauswertung " VALUE 0xa1017b70 _REC_VAL_20_u2 16.3837 _CNV_R_R_Def_u_uw_q_730_CM 6. 22.3837 FORMAT "%7.4" /end CHARACTERISTIC
/begin CHARACTERISTIC K_USTEPMIN "Min. Delta zw. Battsollspg und Battspg damit uibs veraendert wird." VALUE 0xa1017bb6 _REC_VAL_20_s2 99.83843999999999 _CNV_R_R_Def_u_sw_b_732_CM -128. 127.996 /end CHARACTERISTIC
/begin CHARACTERISTIC K_VFZGGENFIL "Filterkonstante Filterung V" VALUE 0xa1017cd0 _REC_VAL_20_u2 0.9999694824218756 _CNV_R_R_Def_f_uw_b_591_CM 1.52587890625e-005 0.9999847412109381 FORMAT "%14.5" /end CHARACTERISTIC
/begin CHARACTERISTIC K_VFZGGENKOR "Korrekturfaktor für V" VALUE 0xa1017cdc _REC_VAL_20_u1 7.9687 _CNV_R_R_Def_f_ub_b_753_CM 0. 7.9687 FORMAT "%5.2" /end CHARACTERISTIC
/begin CHARACTERISTIC K_VFZGLLANH "Fahrgeschwindigkeits-Schwelle ¨ fur R¨ ucksetzen der Leerlaufanhebung Generatorlast" VALUE 0xa1017cd2 _REC_VAL_20_u2 0. _CNV_R_R_Def_v_uw_q_737_CM 0. 65535. FORMAT "%5.0" /end CHARACTERISTIC
/begin CHARACTERISTIC K_VNS_VZD "Verstellschwelle VANOS" VALUE 0xa101d413 _REC_VAL_20_u1 25.5 _CNV_R_R_Def_spr_sw_583_CM 0. 25.5 FORMAT "%5.2" /end CHARACTERISTIC
/begin CHARACTERISTIC K_VNS_VZZMX "Max. Anzahl an Nachtriggerungen" VALUE 0xa101d414 _REC_VAL_20_u1 99.45 _CNV_R_R_Def_dez_sl_575_CM 0. 255. FORMAT "%3.0" /end CHARACTERISTIC
/begin CHARACTERISTIC K_VNS_WTZ "Wartezeit" VALUE 0xa101d415 _REC_VAL_20_u1 2.55 _CNV_R_R_Def_td_uw__679_CM 0. 2.55 FORMAT "%5.2" /end CHARACTERISTIC
/begin CHARACTERISTIC K_VSEMN_NOTL "Einlassspreizung bei VVT-Notlauf" VALUE 0xa101d42a _REC_VAL_20_u2 100.8 _CNV_R_R_Def_spr_sw_583_CM 0. 180. FORMAT "%5.2" /end CHARACTERISTIC
/begin CHARACTERISTIC K_WNWAIMN "Minimalwert der individuellen NW-Spätanschlagsadaption" VALUE 0xa101d43e _REC_VAL_20_u2 100.8 _CNV_R_R_Def_spr_sw_583_CM 0. 180. FORMAT "%5.2" /end CHARACTERISTIC
/begin CHARACTERISTIC K_WNWKHRA_MIN "" VALUE 0xa101d416 _REC_VAL_20_u1 0.996 _CNV_R_R_Def_f_ub_b_573_CM 0. 0.996 /end CHARACTERISTIC
/begin CHARACTERISTIC K_WNWMN "Minimaler Nockenwellensollwinkel" VALUE 0xa101d440 _REC_VAL_20_u2 100.8 _CNV_R_R_Def_spr_sw_583_CM 0. 180. FORMAT "%5.2" /end CHARACTERISTIC
/begin CHARACTERISTIC S_ABSCHK "Schalter für Applikationswert absch_korr" VALUE 0xa1017b3c _REC_VAL_20_u1 99.45 _CNV_R_R_Def_dez_sl_575_CM 0. 255. FORMAT "%3.0" /end CHARACTERISTIC
/begin CHARACTERISTIC S_ASPSATRU "Applikationsschalter für dauerhafte zus. Auslassspreizung" VALUE 0xa101d412 _REC_VAL_20_u1 1. _CNV_R_R_Def_dez_sl_575_CM 0. 1. FORMAT "%3.0" /end CHARACTERISTIC
/begin CHARACTERISTIC S_BNSCLRAPP "BNS Daten löschen" VALUE 0xa1017cb4 _REC_VAL_20_u1 99.45 _CNV_R_R_Def_dez_sl_575_CM 0. 255. FORMAT "%3.0" /end CHARACTERISTIC
/begin CHARACTERISTIC S_BSOCCALC "Enable Rücksetzten Ruhespannungen IBS" VALUE 0xa101791b _REC_VAL_20_u1 99.45 _CNV_R_R_Def_dez_sl_575_CM 0. 255. FORMAT "%3.0" /end CHARACTERISTIC
/begin CHARACTERISTIC S_DFKOMMERR "Maßnahmen bei Gen. Komm. Fehler aktiv" VALUE 0xa10176a8 _REC_VAL_20_u1 1. _CNV_R_R_Def_dez_sl_575_CM 0. 1. FORMAT "%4.1" /end CHARACTERISTIC
/begin CHARACTERISTIC S_DSOCS "Schalter für Applikationswert Delta SoC" VALUE 0xa1017b3d _REC_VAL_20_u1 99.45 _CNV_R_R_Def_dez_sl_575_CM 0. 255. FORMAT "%3.0" /end CHARACTERISTIC
/begin CHARACTERISTIC S_ESPSATRU "Applikationsschalter für dauerhafte zus. Einlassspreizung" VALUE 0xa101d411 _REC_VAL_20_u1 1. _CNV_R_R_Def_dez_sl_575_CM 0. 1. FORMAT "%3.0" /end CHARACTERISTIC
/begin CHARACTERISTIC S_GELIBIEAPP "Applikation Generatorlastbegrenzung für Leerlaufstabilisierung" VALUE 0xa1017cdd _REC_VAL_20_u1 1. _CNV_R_R_Def_dez_sl_575_CM 0. 1. FORMAT "%4.1" /end CHARACTERISTIC
/begin CHARACTERISTIC S_IPMPTC "PTC Einschränkung aufgrund IPM" VALUE 0xa10176a9 _REC_VAL_20_u1 1. _CNV_R_R_Def_dez_sl_575_CM 0. 1. FORMAT "%4.1" /end CHARACTERISTIC
/begin CHARACTERISTIC S_KATHEIN_EXT "" VALUE 0xa101d3bf _REC_VAL_20_u1 1. _CNV_R_R_Def_dez_sl_575_CM 0. 1. FORMAT "%3.0" /end CHARACTERISTIC
/begin CHARACTERISTIC S_MDAPPAS "Schalter Applikation Auslass" VALUE 0xa101d40e _REC_VAL_20_u1 1. _CNV_R_R_Def_dez_sl_575_CM 0. 1. FORMAT "%3.0" /end CHARACTERISTIC
/begin CHARACTERISTIC S_MDAPPES "Schalter Applikation Einlass" VALUE 0xa101d40f _REC_VAL_20_u1 1. _CNV_R_R_Def_dez_sl_575_CM 0. 1. FORMAT "%3.0" /end CHARACTERISTIC
/begin CHARACTERISTIC S_NKWITNSTRT "0 = Nkw-Auswertung, 1=Itnstart Auswertung" VALUE 0xa1017b7a _REC_VAL_20_u1 1. _CNV_R_R_Def_dez_sl_575_CM 0. 1. FORMAT "%4.1" /end CHARACTERISTIC
/begin CHARACTERISTIC S_PGENLL_AKT "Aktivierung Leistungsreduzierung Generator durch Generatorlastschwankung" VALUE 0xa1017cde _REC_VAL_20_u1 1. _CNV_R_R_Def_dez_sl_575_CM 0. 1. FORMAT "%4.1" /end CHARACTERISTIC
/begin CHARACTERISTIC S_PMMESS "Schalter Messemode aktiv" VALUE 0xa10176aa _REC_VAL_20_u1 1. _CNV_R_R_Def_dez_sl_575_CM 0. 1. FORMAT "%4.1" /end CHARACTERISTIC
/begin CHARACTERISTIC S_PMSOCFIT "Schalter zur Applikation SoC aus der Fitberechnung" VALUE 0xa1017982 _REC_VAL_20_u1 99.45 _CNV_R_R_Def_dez_sl_575_CM 0. 255. FORMAT "%3.0" /end CHARACTERISTIC
/begin CHARACTERISTIC S_PMSTARTQ "Applikationsschalter f. B_pmstartq" VALUE 0xa1017b7b _REC_VAL_20_u1 99.45 _CNV_R_R_Def_dez_sl_575_CM 0. 255. FORMAT "%3.0" /end CHARACTERISTIC
/begin CHARACTERISTIC S_PMSV_HEIZ "Standheizen wird für Nibble-historie ausgewertet" VALUE 0xa101757f _REC_VAL_20_u1 1. _CNV_R_R_Def_dez_sl_575_CM 0. 1. FORMAT "%4.1" /end CHARACTERISTIC
/begin CHARACTERISTIC S_PMSV_KLIMA "Standklimatisierung wird für Nibble-historie ausgewertet" VALUE 0xa1017580 _REC_VAL_20_u1 1. _CNV_R_R_Def_dez_sl_575_CM 0. 1. FORMAT "%4.1" /end CHARACTERISTIC
/begin CHARACTERISTIC S_PMSV_LUFT "Standlueften wird für Nibble-historie ausgewertet" VALUE 0xa1017581 _REC_VAL_20_u1 1. _CNV_R_R_Def_dez_sl_575_CM 0. 1. FORMAT "%4.1" /end CHARACTERISTIC
/begin CHARACTERISTIC S_PMTABSMN "Schalter für Applikation der Abstellzeit tabsmn_w" VALUE 0xa1017b3e _REC_VAL_20_u1 99.45 _CNV_R_R_Def_dez_sl_575_CM 0. 255. FORMAT "%3.0" /end CHARACTERISTIC
/begin CHARACTERISTIC S_PM_TEST1 "Applikationsschalter um die Startberechnung zu erzwingen" VALUE 0xa1017b7c _REC_VAL_20_u1 99.45 _CNV_R_R_Def_dez_sl_575_CM 0. 255. FORMAT "%3.0" /end CHARACTERISTIC
/begin CHARACTERISTIC S_POELREG_AD "Freigabe Öldruck-Regleradaption" VALUE 0xa100e1a7 _REC_VAL_20_u1 99.45 _CNV_R_R_Def_dez_sl_575_CM 0. 255. FORMAT "%3.0" /end CHARACTERISTIC
/begin CHARACTERISTIC S_POELR_PWM "Freigabe PWM-Ausgabe an Regelventil" VALUE 0xa100e1a6 _REC_VAL_20_u1 99.45 _CNV_R_R_Def_dez_sl_575_CM 0. 255. FORMAT "%3.0" /end CHARACTERISTIC
/begin CHARACTERISTIC S_POEL_TEST "P_oel_modell als Istdruck verwenden" VALUE 0xa100e1a5 _REC_VAL_20_u1 99.45 _CNV_R_R_Def_dez_sl_575_CM 0. 255. FORMAT "%3.0" /end CHARACTERISTIC
/begin CHARACTERISTIC S_PRAIL_MAN "Schalter für manuelle Vorgabe Prail_sw" VALUE 0xa102043e _REC_VAL_20_u1 99.45 _CNV_R_R_Def_dez_sl_575_CM 0. 255. FORMAT "%3.0" /end CHARACTERISTIC
/begin CHARACTERISTIC S_PRAIL_SW "Schalter für Bedingung B_prailsw" VALUE 0xa102043f _REC_VAL_20_u1 99.45 _CNV_R_R_Def_dez_sl_575_CM 0. 255. FORMAT "%3.0" /end CHARACTERISTIC
/begin CHARACTERISTIC S_PRIOCFENA "" VALUE 0xa10176ab _REC_VAL_20_u1 1. _CNV_R_R_Def_dez_sl_575_CM 0. 1. FORMAT "%4.1" /end CHARACTERISTIC
/begin CHARACTERISTIC S_PRIOMANUAL "Manueller Schalter fuer E60/E65-Can Botschaften" VALUE 0xa10176ac _REC_VAL_20_u1 99.45 _CNV_R_R_Def_dez_sl_575_CM 0. 255. FORMAT "%3.0" /end CHARACTERISTIC
/begin CHARACTERISTIC S_PTCKOOR "Schalter Aktivierung PTC Koordinator im PMPRSVCALC" VALUE 0xa10176ad _REC_VAL_20_u1 1. _CNV_R_R_Def_dez_sl_575_CM 0. 1. FORMAT "%4.1" /end CHARACTERISTIC
/begin CHARACTERISTIC S_PTCMANUAL "Schalter manueller PTC Wert aktivieren." VALUE 0xa10176ae _REC_VAL_20_u1 1. _CNV_R_R_Def_dez_sl_575_CM 0. 1. FORMAT "%4.1" /end CHARACTERISTIC
/begin CHARACTERISTIC S_PWRCFENA "" VALUE 0xa10176af _REC_VAL_20_u1 1. _CNV_R_R_Def_dez_sl_575_CM 0. 1. FORMAT "%4.1" /end CHARACTERISTIC
/begin CHARACTERISTIC S_QSTARTFK "Schalter für Applikation q_startfgk" VALUE 0xa1017b3f _REC_VAL_20_u1 99.45 _CNV_R_R_Def_dez_sl_575_CM 0. 255. FORMAT "%3.0" /end CHARACTERISTIC
/begin CHARACTERISTIC S_RIN "Schalter Applikation Innenwiderstandsprüfung" VALUE 0xa1017b7d _REC_VAL_20_u1 99.45 _CNV_R_R_Def_dez_sl_575_CM 0. 255. FORMAT "%3.0" /end CHARACTERISTIC
/begin CHARACTERISTIC S_SICHER_ON "Spreizungen VVT sicher aktiv" VALUE 0xa101d3c0 _REC_VAL_20_u1 1. _CNV_R_R_Def_dez_sl_575_CM 0. 1. FORMAT "%3.0" /end CHARACTERISTIC
/begin CHARACTERISTIC S_SOCSTAFK "Schalter für Applikation SoC aus der Startfähigkeit" VALUE 0xa1017b40 _REC_VAL_20_u1 99.45 _CNV_R_R_Def_dez_sl_575_CM 0. 255. FORMAT "%3.0" /end CHARACTERISTIC
/begin CHARACTERISTIC S_SOC_BILA "Schalter für Applik. soc_bila" VALUE 0xa101791c _REC_VAL_20_u1 99.45 _CNV_R_R_Def_dez_sl_575_CM 0. 255. FORMAT "%3.0" /end CHARACTERISTIC
/begin CHARACTERISTIC S_SOC_QUAL "Schalter für Applik. soc_quali" VALUE 0xa101791d _REC_VAL_20_u1 99.45 _CNV_R_R_Def_dez_sl_575_CM 0. 255. FORMAT "%3.0" /end CHARACTERISTIC
/begin CHARACTERISTIC S_STARTAW "Startauswertung fertig" VALUE 0xa1017b7e _REC_VAL_20_u1 99.45 _CNV_R_R_Def_dez_sl_575_CM 0. 255. FORMAT "%3.0" /end CHARACTERISTIC
/begin CHARACTERISTIC S_UIBS "Schalter für UIBS, wenn True dann uibs=UIBSAPP" VALUE 0xa1017bbf _REC_VAL_20_u1 1. _CNV_R_R_Def_dez_sl_575_CM 0. 1. FORMAT "%4.1" /end CHARACTERISTIC
/begin CHARACTERISTIC ZK_PMSOC "Zeitfaktor" VALUE 0xa1017980 _REC_VAL_20_u2 0.9999847412109381 _CNV_R_R_Def_f_uw_b_591_CM 0. 0.9999847412109381 FORMAT "%14.5" /end CHARACTERISTIC
/begin COMPU_METHOD _CNV_R_R_DEZ_436_CM "" RAT_FUNC "%6.3" "" COEFFS 0. 1. 0. 0. 0. 1. /end COMPU_METHOD
/begin COMPU_METHOD _CNV_R_R_Def_f_sw_q_571_CM "Def_f_sw_q0p00153" RAT_FUNC "%6.3" "-" COEFFS 0. 32768. 0. 0. 0. 50. /end COMPU_METHOD
/begin COMPU_METHOD _CNV_R_R_Def_f_ub_b_573_CM "Def_f_ub_b1" RAT_FUNC "%6.3" "-" COEFFS 0. 256. 0. 0. 0. 1. /end COMPU_METHOD
/begin COMPU_METHOD _CNV_R_R_Def_dez_sl_575_CM "Def_dez_sl_q1" RAT_FUNC "%6.3" "-" COEFFS 0. 1. 0. 0. 0. 1. /end COMPU_METHOD
/begin COMPU_METHOD _CNV_R_R_Def_f_uw_b_576_CM "Def_f_uw_b100" RAT_FUNC "%6.3" "%" COEFFS 0. 65536. 0. 0. 0. 100. /end COMPU_METHOD
/begin COMPU_METHOD _CNV_R_R_Def_f_sw_b_577_CM "Def_f_sw_b32" RAT_FUNC "%6.3" "-" COEFFS 0. 32768. 0. 0. 0. 32. /end COMPU_METHOD
/begin COMPU_METHOD _CNV_R_R_Def_p_sw_q_578_CM "Def_p_sw_q0p039" RAT_FUNC "%6.3" "hPa" COEFFS 0. 256. 0. 0. 0. 10. /end COMPU_METHOD
/begin COMPU_METHOD _CNV_R_R_Def_f_uw_b_579_CM "Def_f_uw_b2" RAT_FUNC "%6.3" "-" COEFFS 0. 65536. 0. 0. 0. 2. /end COMPU_METHOD
/begin COMPU_METHOD _CNV_R_R_Def_f_sw_p_581_CM "Def_f_sw_p0q25" RAT_FUNC "%6.3" "" COEFFS 0. 4. 0. 0. 0. 1. /end COMPU_METHOD
/begin COMPU_METHOD _CNV_R_R_Def_spr_ub_582_CM "Def_spr_ub_q0p8" RAT_FUNC "%6.3" "° KW" COEFFS 0. 1. 0. 0. 0. 0.8 /end COMPU_METHOD
/begin COMPU_METHOD _CNV_R_R_Def_spr_sw_583_CM "Def_spr_sw_q0p1" RAT_FUNC "%6.3" "° KW" COEFFS 0. 10. 0. 0. 0. 1. /end COMPU_METHOD
/begin COMPU_METHOD _CNV_R_R_Def_f_uw_b_591_CM "Def_f_uw_b1" RAT_FUNC "%6.3" "-" COEFFS 0. 65536. 0. 0. 0. 1. /end COMPU_METHOD
/begin COMPU_METHOD _CNV_R_R_Def_td_ub__593_CM "Def_td_ub_q0p1" RAT_FUNC "%6.3" "s" COEFFS 0. 10. 0. 0. 0. 1. /end COMPU_METHOD
/begin COMPU_METHOD _CNV_R_R_Def_f_ub_b_595_CM "Def_f_ub_b127p5" RAT_FUNC "%6.3" "%" COEFFS 0. 2. 0. 0. 0. 1. /end COMPU_METHOD
/begin COMPU_METHOD _CNV_R_R_Def_ql_uw__596_CM "Def_ql_uw_q0p0182" RAT_FUNC "%6.3" "Ah" COEFFS 0. 989. 0. 0. 0. 18. /end COMPU_METHOD
/begin COMPU_METHOD _CNV_R_R_Def_f_sw_b_597_CM "Def_f_sw_b100" RAT_FUNC "%6.3" "-" COEFFS 0. 32768. 0. 0. 0. 100. /end COMPU_METHOD
/begin COMPU_METHOD _CNV_R_R_Def_u_sb_q_598_CM "Def_u_sb_q0p0942" RAT_FUNC "%6.3" "V" COEFFS 0. 1. 0. 0. 0. 9.420000000000001e-002 /end COMPU_METHOD
/begin COMPU_METHOD _CNV_R_R_Def_f_sb_b_600_CM "Def_f_sb_b64" RAT_FUNC "%6.3" "-" COEFFS 0. 128. 0. 0. 0. 64. /end COMPU_METHOD
/begin COMPU_METHOD _CNV_R_R_Def_f_ub_b_602_CM "Def_f_ub_b100" RAT_FUNC "%6.3" "%" COEFFS 0. 256. 0. 0. 0. 100. /end COMPU_METHOD
/begin COMPU_METHOD _CNV_R_R_Def_f_uw_b_604_CM "Def_f_uw_b32" RAT_FUNC "%6.3" "-" COEFFS 0. 65536. 0. 0. 0. 32. /end COMPU_METHOD
/begin COMPU_METHOD _CNV_R_R_Def_hub_uw_605_CM "Def_hub_uw_q0p001" RAT_FUNC "%6.3" "mm" COEFFS 0. 1000. 0. 0. 0. 1. /end COMPU_METHOD
/begin COMPU_METHOD _CNV_R_R_Def_n_sw_q_612_CM "Def_n_sw_q1p0" RAT_FUNC "%6.3" "Upm" COEFFS 0. 1. 0. 0. 0. 1. /end COMPU_METHOD
/begin COMPU_METHOD _CNV_R_R_Def_ql_uw__615_CM "Def_ql_uw_q0p29127" RAT_FUNC "%6.3" "" COEFFS 0. 103. 0. 0. 0. 30. /end COMPU_METHOD
/begin COMPU_METHOD _CNV_R_R_Def_rf_sw__616_CM "Def_rf_sw_q0p01" RAT_FUNC "%6.3" "%" COEFFS 0. 100. 0. 0. 0. 1. /end COMPU_METHOD
/begin COMPU_METHOD _CNV_R_R_Def_t_sw_q_618_CM "Def_t_sw_q0p1" RAT_FUNC "%6.3" "°C" COEFFS 0. 10. 0. 0. 0. 1. /end COMPU_METHOD
/begin COMPU_METHOD _CNV_R_R_Def_t_sw_q_620_CM "Def_t_sw_q0p01" RAT_FUNC "%6.3" "°C" COEFFS 0. 100. 0. 0. 0. 1. /end COMPU_METHOD
/begin COMPU_METHOD _CNV_R_R_Def_f_sw_q_621_CM "Def_f_sw_q0p000147" RAT_FUNC "%6.3" "-" COEFFS 0. 64. 0. 0. 0. 9.420000000000001e-002 /end COMPU_METHOD
/begin COMPU_METHOD _CNV_R_R_Def_f_ub_b_625_CM "Def_f_ub_b2" RAT_FUNC "%6.3" "-" COEFFS 0. 256. 0. 0. 0. 2. /end COMPU_METHOD
/begin COMPU_METHOD _CNV_R_R_Def_eta_sw_628_CM "Def_eta_sw_q0p00305" RAT_FUNC "%6.3" "%" COEFFS 0. 32767. 0. 0. 0. 100. /end COMPU_METHOD
/begin COMPU_METHOD _CNV_R_R_Def_f_uw_b_636_CM "Def_f_uw_b512" RAT_FUNC "%6.3" "-" COEFFS 0. 65536. 0. 0. 0. 512. /end COMPU_METHOD
/begin COMPU_METHOD _CNV_R_R_Def_i_uw_q_642_CM "Def_i_uw_q0p08_o200" RAT_FUNC "%6.3" "" COEFFS 0. 25. 5000. 0. 0. 2. /end COMPU_METHOD
/begin COMPU_METHOD _CNV_R_R_Def_i_ub_q_645_CM "Def_i_ub_q0p125" RAT_FUNC "%6.3" "A" COEFFS 0. 8. 0. 0. 0. 1. /end COMPU_METHOD
/begin COMPU_METHOD _CNV_R_R_Def_i_sw_q_647_CM "Def_i_sw_q0p02" RAT_FUNC "%6.3" "A" COEFFS 0. 50. 0. 0. 0. 1. /end COMPU_METHOD
/begin COMPU_METHOD _CNV_R_R_Def_i_uw_q_648_CM "Def_i_uw_q0p02" RAT_FUNC "%6.3" "A" COEFFS 0. 1. 0. 0. 0. 2.e-002 /end COMPU_METHOD
/begin COMPU_METHOD _CNV_R_R_Def_i_ub_q_651_CM "Def_i_ub_q10" RAT_FUNC "%6.3" "A" COEFFS 0. 1. 0. 0. 0. 10. /end COMPU_METHOD
/begin COMPU_METHOD _CNV_R_R_Def_i_ub_q_652_CM "Def_i_ub_q0p00125" RAT_FUNC "%6.3" "" COEFFS 0. 800. 0. 0. 0. 1. /end COMPU_METHOD
/begin COMPU_METHOD _CNV_R_R_Def_f_ub_b_670_CM "Def_f_ub_b4" RAT_FUNC "%6.3" "-" COEFFS 0. 256. 0. 0. 0. 4. /end COMPU_METHOD
/begin COMPU_METHOD _CNV_R_R_Def_td_uw__679_CM "Def_td_uw_q0p01" RAT_FUNC "%6.3" "s" COEFFS 0. 100. 0. 0. 0. 1. /end COMPU_METHOD
/begin COMPU_METHOD _CNV_R_R_Def_td_uw__682_CM "Def_td_uw_q1" RAT_FUNC "%6.3" "s" COEFFS 0. 1. 0. 0. 0. 1. /end COMPU_METHOD
/begin COMPU_METHOD _CNV_R_R_Def_p_sw_q_683_CM "Def_p_sw_q1" RAT_FUNC "%6.3" "hPa" COEFFS 0. 1. 0. 0. 0. 1. /end COMPU_METHOD
/begin COMPU_METHOD _CNV_R_R_Def_p_uw_q_685_CM "Def_p_uw_q0p0061" RAT_FUNC "%6.3" "MPa" COEFFS 0. 65536. 0. 0. 0. 40. /end COMPU_METHOD
/begin COMPU_METHOD _CNV_R_R_Def_f_sl_q_688_CM "Def_f_sl_q0p007" RAT_FUNC "%6.3" "" COEFFS 0. 65536. 0. 0. 0. 512. /end COMPU_METHOD
/begin COMPU_METHOD _CNV_R_R_Def_wdk_sw_691_CM "Def_wdk_sw_q0p0244" RAT_FUNC "%6.3" "%" COEFFS 0. 4096. 0. 0. 0. 100. /end COMPU_METHOD
/begin COMPU_METHOD _CNV_R_R_Def_ql_ul__692_CM "Def_ql_ul_q2p7Em7" RAT_FUNC "%6.3" "Ah" COEFFS 0. 3600000. 0. 0. 0. 1. /end COMPU_METHOD
/begin COMPU_METHOD _CNV_R_R_Def_f_ub_b_695_CM "Def_f_ub_b32" RAT_FUNC "%6.3" "-" COEFFS 0. 256. 0. 0. 0. 32. /end COMPU_METHOD
/begin COMPU_METHOD _CNV_R_R_Def_rk_sw__697_CM "Def_rk_sw_b1600" RAT_FUNC "%6.3" "%" COEFFS 0. 2048. 0. 0. 0. 100. /end COMPU_METHOD
/begin COMPU_METHOD _CNV_S_2_Def_bit_ub_700_CM "Def_bit_ub_0" TAB_VERB "%6.3" "-" COMPU_TAB_REF _CNV_S_2_Def_bit_ub_700 /end COMPU_METHOD
/begin COMPU_VTAB _CNV_S_2_Def_bit_ub_700 "Def_bit_ub_0" TAB_VERB 2 0 "FALSE" 1 "TRUE" /end COMPU_VTAB
/begin COMPU_METHOD _CNV_S_2_Def_bit_ub_701_CM "Def_bit_ub_1" TAB_VERB "%6.3" "-" COMPU_TAB_REF _CNV_S_2_Def_bit_ub_701 /end COMPU_METHOD
/begin COMPU_VTAB _CNV_S_2_Def_bit_ub_701 "Def_bit_ub_1" TAB_VERB 2 0 "FALSE" 2 "TRUE" /end COMPU_VTAB
/begin COMPU_METHOD _CNV_S_2_Def_bit_ub_702_CM "Def_bit_ub_2" TAB_VERB "%6.3" "-" COMPU_TAB_REF _CNV_S_2_Def_bit_ub_702 /end COMPU_METHOD
/begin COMPU_VTAB _CNV_S_2_Def_bit_ub_702 "Def_bit_ub_2" TAB_VERB 2 0 "FALSE" 4 "TRUE" /end COMPU_VTAB
/begin COMPU_METHOD _CNV_S_2_Def_bit_ub_703_CM "Def_bit_ub_3" TAB_VERB "%6.3" "-" COMPU_TAB_REF _CNV_S_2_Def_bit_ub_703 /end COMPU_METHOD
/begin COMPU_VTAB _CNV_S_2_Def_bit_ub_703 "Def_bit_ub_3" TAB_VERB 2 0 "FALSE" 8 "TRUE" /end COMPU_VTAB
/begin COMPU_METHOD _CNV_S_2_Def_bit_ub_704_CM "Def_bit_ub_4" TAB_VERB "%6.3" "-" COMPU_TAB_REF _CNV_S_2_Def_bit_ub_704 /end COMPU_METHOD
/begin COMPU_VTAB _CNV_S_2_Def_bit_ub_704 "Def_bit_ub_4" TAB_VERB 2 0 "FALSE" 16 "TRUE" /end COMPU_VTAB
/begin COMPU_METHOD _CNV_S_2_Def_bit_ub_705_CM "Def_bit_ub_5" TAB_VERB "%6.3" "-" COMPU_TAB_REF _CNV_S_2_Def_bit_ub_705 /end COMPU_METHOD
/begin COMPU_VTAB _CNV_S_2_Def_bit_ub_705 "Def_bit_ub_5" TAB_VERB 2 0 "FALSE" 32 "TRUE" /end COMPU_VTAB
/begin COMPU_METHOD _CNV_S_2_Def_bit_ub_706_CM "Def_bit_ub_6" TAB_VERB "%6.3" "-" COMPU_TAB_REF _CNV_S_2_Def_bit_ub_706 /end COMPU_METHOD
/begin COMPU_VTAB _CNV_S_2_Def_bit_ub_706 "Def_bit_ub_6" TAB_VERB 2 0 "FALSE" 64 "TRUE" /end COMPU_VTAB
/begin COMPU_METHOD _CNV_S_2_Def_bit_ub_707_CM "Def_bit_ub_7" TAB_VERB "%6.3" "-" COMPU_TAB_REF _CNV_S_2_Def_bit_ub_707 /end COMPU_METHOD
/begin COMPU_VTAB _CNV_S_2_Def_bit_ub_707 "Def_bit_ub_7" TAB_VERB 2 0 "FALSE" 128 "TRUE" /end COMPU_VTAB
/begin COMPU_METHOD _CNV_R_R_Def_td_ub__716_CM "Def_td_ub_q14p9333" RAT_FUNC "%6.3" "min" COEFFS 0. 15. 0. 0. 0. 224. /end COMPU_METHOD
/begin COMPU_METHOD _CNV_R_R_Def_td_uw__717_CM "Def_td_uw_q14" RAT_FUNC "%6.3" "s" COEFFS 0. 1. 0. 0. 0. 14. /end COMPU_METHOD
/begin COMPU_METHOD _CNV_R_R_Def_td_uw__718_CM "Def_td_uw_q56" RAT_FUNC "%6.3" "s" COEFFS 0. 1. 0. 0. 0. 56. /end COMPU_METHOD
/begin COMPU_METHOD _CNV_R_R_Def_td_uw__719_CM "Def_td_uw_q0p933" RAT_FUNC "%6.3" "min" COEFFS 0. 15. 0. 0. 0. 14. /end COMPU_METHOD
/begin COMPU_METHOD _CNV_R_R_Def_td_uw__726_CM "Def_td_uw_q0p2" RAT_FUNC "%6.3" "s" COEFFS 0. 5. 0. 0. 0. 1. /end COMPU_METHOD
/begin COMPU_METHOD _CNV_R_R_Def_u_uw_q_730_CM "Def_u_uw_q0p25em3_o6" RAT_FUNC "%6.3" "" COEFFS 0. -4000. 24000. 0. 0. -1. /end COMPU_METHOD
/begin COMPU_METHOD _CNV_R_R_Def_u_sw_b_732_CM "Def_u_sw_b128" RAT_FUNC "%6.3" "V" COEFFS 0. 256. 0. 0. 0. 1. /end COMPU_METHOD
/begin COMPU_METHOD _CNV_R_R_Def_u_sw_q_733_CM "Def_u_sw_q0p00025" RAT_FUNC "%6.3" "" COEFFS 0. 4000. 0. 0. 0. 1. /end COMPU_METHOD
/begin COMPU_METHOD _CNV_R_R_Def_u_uw_q_735_CM "Def_u_uw_q0p015" RAT_FUNC "%6.3" "V" COEFFS 0. 200. 0. 0. 0. 3. /end COMPU_METHOD
/begin COMPU_METHOD _CNV_R_R_Def_v_uw_q_737_CM "Def_v_uw_q1p0" RAT_FUNC "%6.3" "km/h" COEFFS 0. 1. 0. 0. 0. 1. /end COMPU_METHOD
/begin COMPU_METHOD _CNV_R_R_Def_v_uw_q_738_CM "Def_v_uw_q0p1" RAT_FUNC "%6.3" "km/h" COEFFS 0. 10. 0. 0. 0. 1. /end COMPU_METHOD
/begin COMPU_METHOD _CNV_R_R_Def_zw_ub__748_CM "Def_zw_ub_q0p75" RAT_FUNC "%6.3" "°" COEFFS 0. -1. 0. 0. 0. 0.75 /end COMPU_METHOD
/begin COMPU_METHOD _CNV_R_R_Def_f_ub_b_753_CM "Def_f_ub_b8" RAT_FUNC "%6.3" "-" COEFFS 0. 256. 0. 0. 0. 8. /end COMPU_METHOD
/begin COMPU_METHOD _CNV_R_R_Def_f_ub_q_755_CM "Def_f_ub_q0p001" RAT_FUNC "%6.3" "" COEFFS 0. 1000. 0. 0. 0. 1. /end COMPU_METHOD
/begin COMPU_METHOD _CNV_R_R_Def_i_ub_b_758_CM "Def_i_ub_b1000" RAT_FUNC "%6.3" "A" COEFFS 0. 256. 0. 0. 0. 1000. /end COMPU_METHOD
/begin COMPU_METHOD _CNV_R_R_Def_f_uw_b_764_CM "Def_f_uw_b128" RAT_FUNC "%6.3" "" COEFFS 0. 512. 0. 0. 0. 1. /end COMPU_METHOD
/begin COMPU_METHOD _CNV_R_R_Def_i_ub_q_774_CM "Def_i_ub_q5p12" RAT_FUNC "%6.3" "" COEFFS 0. 25. 0. 0. 0. 128. /end COMPU_METHOD
/begin RECORD_LAYOUT _REC_VAL_20_u1 FNC_VALUES 1 UBYTE COLUMN_DIR DIRECT /end RECORD_LAYOUT
/begin RECORD_LAYOUT _REC_VAL_20_u2 FNC_VALUES 1 UWORD COLUMN_DIR DIRECT /end RECORD_LAYOUT
/begin RECORD_LAYOUT _REC_VAL_20_s2 FNC_VALUES 1 SWORD COLUMN_DIR DIRECT /end RECORD_LAYOUT
/begin RECORD_LAYOUT _REC_VAL_20_s1 FNC_VALUES 1 SBYTE COLUMN_DIR DIRECT /end RECORD_LAYOUT
/begin RECORD_LAYOUT _REC_MAP_52_UBYTE_u2_s2_s2 NO_AXIS_PTS_X 1 UBYTE NO_AXIS_PTS_Y 2 UBYTE AXIS_PTS_X 3 SWORD INDEX_INCR DIRECT AXIS_PTS_Y 4 SWORD INDEX_INCR DIRECT FNC_VALUES 5 UWORD COLUMN_DIR DIRECT /end RECORD_LAYOUT
/begin RECORD_LAYOUT _REC_MAP_52_UBYTE_u2_s2_u2 NO_AXIS_PTS_X 1 UBYTE NO_AXIS_PTS_Y 2 UBYTE AXIS_PTS_X 3 SWORD INDEX_INCR DIRECT AXIS_PTS_Y 4 UWORD INDEX_INCR DIRECT FNC_VALUES 5 UWORD COLUMN_DIR DIRECT /end RECORD_LAYOUT
/begin RECORD_LAYOUT _REC_MAP_52_u1_s2_s2 NO_AXIS_PTS_X 1 UBYTE NO_AXIS_PTS_Y 2 UBYTE AXIS_PTS_X 3 SWORD INDEX_INCR DIRECT AXIS_PTS_Y 4 SWORD INDEX_INCR DIRECT FNC_VALUES 5 UBYTE COLUMN_DIR DIRECT /end RECORD_LAYOUT
/begin RECORD_LAYOUT _REC_MAP_52_UBYTE_u2_u2_s2 NO_AXIS_PTS_X 1 UBYTE NO_AXIS_PTS_Y 2 UBYTE AXIS_PTS_X 3 UWORD INDEX_INCR DIRECT AXIS_PTS_Y 4 SWORD INDEX_INCR DIRECT FNC_VALUES 5 UWORD COLUMN_DIR DIRECT /end RECORD_LAYOUT
/begin RECORD_LAYOUT _REC_MAP_52_u1_u2_s2 NO_AXIS_PTS_X 1 UBYTE NO_AXIS_PTS_Y 2 UBYTE AXIS_PTS_X 3 UWORD INDEX_INCR DIRECT AXIS_PTS_Y 4 SWORD INDEX_INCR DIRECT FNC_VALUES 5 UBYTE COLUMN_DIR DIRECT /end RECORD_LAYOUT
/begin RECORD_LAYOUT _REC_MAP_52_u1_s2_u2 NO_AXIS_PTS_X 1 UBYTE NO_AXIS_PTS_Y 2 UBYTE AXIS_PTS_X 3 SWORD INDEX_INCR DIRECT AXIS_PTS_Y 4 UWORD INDEX_INCR DIRECT FNC_VALUES 5 UBYTE COLUMN_DIR DIRECT /end RECORD_LAYOUT
/begin RECORD_LAYOUT _REC_CUR_TKL_UW_VV__u2_u2 NO_AXIS_PTS_X 1 UBYTE RESERVED 2 BYTE AXIS_PTS_X 3 UWORD INDEX_INCR DIRECT FNC_VALUES 4 UWORD COLUMN_DIR DIRECT /end RECORD_LAYOUT
/begin RECORD_LAYOUT _REC_CUR_TKL_UW_VV__u2_s2 NO_AXIS_PTS_X 1 UBYTE RESERVED 2 BYTE AXIS_PTS_X 3 SWORD INDEX_INCR DIRECT FNC_VALUES 4 UWORD COLUMN_DIR DIRECT /end RECORD_LAYOUT
/begin RECORD_LAYOUT _REC_CUR_TKL_UW_VV__u1_s2 NO_AXIS_PTS_X 1 UBYTE RESERVED 2 BYTE AXIS_PTS_X 3 SWORD INDEX_INCR DIRECT FNC_VALUES 4 UBYTE COLUMN_DIR DIRECT /end RECORD_LAYOUT
/begin RECORD_LAYOUT _REC_CUR_TKL_UW_VV__u1_u2 NO_AXIS_PTS_X 1 UBYTE RESERVED 2 BYTE AXIS_PTS_X 3 UWORD INDEX_INCR DIRECT FNC_VALUES 4 UBYTE COLUMN_DIR DIRECT /end RECORD_LAYOUT
/begin RECORD_LAYOUT _REC_CUR_TKL_UW_VV__s2_u2 NO_AXIS_PTS_X 1 UBYTE RESERVED 2 BYTE AXIS_PTS_X 3 UWORD INDEX_INCR DIRECT FNC_VALUES 4 SWORD COLUMN_DIR DIRECT /end RECORD_LAYOUT
/begin RECORD_LAYOUT _REC_CUR_TKL_UW_VV__s2_s2 NO_AXIS_PTS_X 1 UBYTE RESERVED 2 BYTE AXIS_PTS_X 3 SWORD INDEX_INCR DIRECT FNC_VALUES 4 SWORD COLUMN_DIR DIRECT /end RECORD_LAYOUT
/begin RECORD_LAYOUT _REC_CUR_TKL_UW_VV__u1_u1 NO_AXIS_PTS_X 1 UBYTE RESERVED 2 BYTE AXIS_PTS_X 3 UBYTE INDEX_INCR DIRECT FNC_VALUES 4 UBYTE COLUMN_DIR DIRECT /end RECORD_LAYOUT
/begin RECORD_LAYOUT _REC_CUR_TKL_UW_VV__s2_u1 NO_AXIS_PTS_X 1 UBYTE RESERVED 2 BYTE AXIS_PTS_X 3 UBYTE INDEX_INCR DIRECT FNC_VALUES 4 SWORD COLUMN_DIR DIRECT /end RECORD_LAYOUT
/begin RECORD_LAYOUT _REC_CUR_TKL_UW_VV__u2_u1 NO_AXIS_PTS_X 1 UBYTE RESERVED 2 BYTE AXIS_PTS_X 3 UBYTE INDEX_INCR DIRECT FNC_VALUES 4 UWORD COLUMN_DIR DIRECT /end RECORD_LAYOUT
/begin RECORD_LAYOUT _REC_VAL_2_u1 FNC_VALUES 1 UBYTE COLUMN_DIR DIRECT /end RECORD_LAYOUT
/begin RECORD_LAYOUT _REC_VAL_2_u2 FNC_VALUES 1 UWORD COLUMN_DIR DIRECT /end RECORD_LAYOUT
/begin FUNCTION PGENLLRED ""
 /begin DEF_CHARACTERISTIC KL_GELIKMIE K_DELTADFFMX K_DFFLIM K_DFFLLANH K_DFFSCHZMX K_GELIIEAPP K_GELIIEZK K_GELISETAPP K_GELIVMAX K_LLWDNMAX K_LLWDNMIN K_NMOTLLANH K_NSTATLLANH K_PWGLLANH K_TDFDTMAX K_TDFFABLF K_TDFFMAX K_TDFFMIN K_TDNHOLD K_TMOTLLANH K_TNSTLLANH K_VFZGGENFIL K_VFZGGENKOR K_VFZGLLANH S_GELIBIEAPP S_PGENLL_AKT /end DEF_CHARACTERISTIC
 /begin OUT_MEASUREMENT Deltadff Dffgenschz Dnkw Ierrgrenz_ll St_pgenllred St_pgenllred.B_geli St_pgenllred.B_nsubgen St_pgenllred.B_pgenllerk St_pgenllred_200ms St_pgenllred_200ms.B_dffaktiv St_pgenllred_200ms.B_nsubg_r St_pgenllred_200ms.B_nsubgen1 St_pgenllred_200ms.B_pgenllfa St_pgenllred_200ms.B_pgenredllve Tdffgen V_pgenllkor /end OUT_MEASUREMENT
/end FUNCTION
/begin FUNCTION PMBNSTAB ""
 /begin DEF_CHARACTERISTIC K_BNSMAX K_BNS_CTRINC K_BNS_SCHW1 K_BNS_UBMAX K_BNS_UBMIN K_BNS_VFZG K_T_BNSDELAY S_BNSCLRAPP /end DEF_CHARACTERISTIC
 /begin OUT_MEASUREMENT Bnctrmx1s Bnsctr Bnsctrant0 Bnsctrant1 Bnsctrant2 Bnsctrant3 St_bns St_bns.B_bns St_bns2 St_bns2.B_nachlnd7 /end OUT_MEASUREMENT
/end FUNCTION
/begin FUNCTION PMDIAG ""
 /begin DEF_CHARACTERISTIC CW_CCMASK CW_PMDEFMASK CW_PMMASKDFP KL_CLASS2IND KL_CLASS2NENN KL_T2RELMAX KL_T2RELMXRG KL_T3RELMAX KL_T3RELMXRG KL_T4RELMAX KL_T4RELMXRG K_ABKORROVER K_BATTINDAPP K_BATTREGAPP K_CBATTAPP K_CCPRIOSET K_CCPRIOTIME K_CCPWRSET K_DSOCHYSTCC K_DSOCLOW K_HISTDMERST K_HISTIBSRST K_IWAKEAPP K_KSOGRZAPP K_KSUGRZAPP K_OSPGAPP K_OSPGHYST K_OSPGPRELLZ K_OSPRELLDEC K_OSPRELLINC K_RUHVERMODE K_T1PMINFO K_T2PMINFO K_T3PMINFO K_TBATNACHL K_TCODIERPM K_TRINGSHIFT K_T_CCRUHVER K_T_KMSHIFT K_T_OSPGRSET K_T_OSPGSET K_T_RUHAUSW K_T_SQSHIFT K_T_USPGRSET K_T_USPGSET K_USPGAPP K_USPGHYST K_USPGPRELLZ K_USPRELLDEC K_USPRELLINC S_PMSV_HEIZ S_PMSV_KLIMA S_PMSV_LUFT /end DEF_CHARACTERISTIC
 /begin OUT_MEASUREMENT Batt_index C_battnenn Codiercnt Dqelad7 Dqlad7 Fs_pm Ibsbor_hb Ikurz_ogrz Ikurz_ugrz Iwakeupgrz Ospgcnt Ospgprell Ospgstat Pm_klemmstat Pminfo1 Pminfo2 Qeladold7 Qladold7 Qladzwsp7 St_pmdiag0 St_pmdiag0.B_ccbtnach St_pmdiag0.B_ccbttdfk St_pmdiag0.B_ccbttknt St_pmdiag0.B_ccpmerr St_pmdiag0.B_ccprio St_pmdiag0.B_codierpm St_pmdiag0.B_pcoschg St_pmdiag0.B_tiefrset St_pmdiag1 St_pmdiag1.B_ccruhver St_pmdiag1.B_histrset St_pmdiag1.B_qelad1step St_pmdiag1.B_ruhverl7 St_pmdiag1.B_sv_ihka St_pmdiag1.B_timer_rst St_pmdiagnv St_pmdiagnv.B_ruhverl Stat_sv_reg Stat_sv_reg1 Stat_sv_reg2 Svaus T1histshort T1pmcntr T2hist T2histshort T2pmcntr T3hist T3histshort T3pmcntr T4hist T4histshort T_histsum T_histsummin T_saismem Uspgcnt Uspgprell Uspgstat Ztagedelta Ztageold Ztagestate /end OUT_MEASUREMENT
/end FUNCTION
/begin FUNCTION PMPRSVCALC ""
 /begin DEF_CHARACTERISTIC KF_IBTSOLL KL_DFPRIO KL_DFPTC KL_DSOCPRIO KL_DSOCPTC KL_DUDTPTC KL_I2PTC KL_IREST KL_ISOLLPR KL_PRIO2PTC KL_PRIOCF KL_PRIODF KL_PTC KL_PWRCF KL_PWRDF KL_SOCPRIO KL_UBTPRIO KL_UB_PTC KL_WUBPTC K_CTRCBRA K_CTRCBRAPP K_CTRCBRKBM K_CTRPCOSAPP K_CTRPRIOAPP K_CTRPRIOCF K_CTRPWRCF K_CTRPWRDF K_DFFILTAPP K_DFKOMMERR K_DFPTC_LP K_DF_LP K_DSOCPCOS K_DUDTPTCAUS K_IBSWAKEAPP K_IPMPMDEC K_IPMPMINC K_KBMCNT_APP K_LLPMFILTK K_MN_PTCPI K_MN_PWRDFPI K_MX_PTCPI K_NKW2HIPTC K_NKW2LOWPTC K_PM_IPMON K_PRIO15 K_PRIOCF15 K_PRIOCFAPP K_PRIOCF_R K_PRIODF K_PRIO_R K_PTCPWRAPP K_PTC_PI K_PWRCOS15 K_PWRCOSAPP K_PWRCOSHT K_PWRCOSULEV K_PWRCOS_R K_PWRCSGNDEF K_PWRCSKOMM K_PWRDF_PI K_RESET_PI K_RQPCOSA K_RQPCOSAPP K_RQULCP K_SELSPCOSA K_SELSPCSAPP K_STPCOSAPP K_TD_PWRDFPI K_T_IPMPRIO K_T_NKPTCAUS K_T_PMBS K_T_PMVS K_T_PTCKWAN K_T_PTCPI K_T_SULEVON K_UBAT_LP K_UBPTC_LP K_UBTAPP K_UBTLOWMAX K_UBTLOWMIN K_ULEVA K_ULEVAPP K_ULOWSETAPP S_DFKOMMERR S_IPMPTC S_PMMESS S_PRIOCFENA S_PRIOMANUAL S_PTCKOOR S_PTCMANUAL S_PWRCFENA /end DEF_CHARACTERISTIC
 /begin OUT_MEASUREMENT All2ptc Allptcfilt Ctrcbr Ctrcbr7 Ctrcbrmem Ctrpcos Ctrpcos7 Ctrpcosmem Ctrprio Ctrprio7 Ctrpriocf Ctrpriocf7 Ctrpriocfm Ctrpriomem Ctrpwrcf Ctrpwrcos Ctrpwrcos7 Ctrpwrdf Ctrpwrmem Ctrpwspcos D_udtptc Df2pi Dfall2pi Dfallpi Dff_filt7 Dfgenfilt Dfpi2ptc Dfprio Dfpt1_2ptc Dfpt1filt Dfpt1ptc Dsoc2pi Dsoc2ptc Dudtmul F_dudtptc Ibtdiff Ibtdiff2pi Ibtsoll Idiff2ptc Igenrest Ipmdfprio Isolldiff Memprio1 Memprio2 Memptc1 Memptc2 Pgen2ptc Pgenrest Picntr Pmbscount Pmvscount Priopizw1 Priopizw2 Ptc_pwr Ptc_pwr7 Ptcadd Ptcpizw1 Ptcpizw2 Pwrspmem Rqpcos Rqpcos7 Rqpcosmem Selspcos Selspcosme St_pmprsv_nv St_pmprsv_nv.B_enwake7 St_pmprsvcalc St_pmprsvcalc.B_gendef St_pmprsvcalc.B_ipmaktiv St_pmprsvcalc.B_ipmtimer St_pmprsvcalc.B_kwdr_old St_pmprsvcalc.B_nkwptcio St_pmprsvcalc.B_ptckoor St_pmprsvcalc.B_ubtlow St_pmprsvcalc.B_uloreset St_pmprsvcalc1 St_pmprsvcalc1.B_dubt St_pmprsvcalc1.B_enwakeup St_pmprsvcalc1.B_limcalc St_pmprsvcalc1.B_notprsv St_pmprsvcalc1.B_pireset St_pmprsvcalc1.B_pmbsdanf St_pmprsvcalc1.B_pmvsdanf St_pmprsvcalc2 St_pmprsvcalc2.B_kwdrise St_pmprsvcalc2.B_pmsulevon Stpcos Stpcos7 Stpcosmem Ubdiff Ubdiff2pi Ubdiffilt Ubdiffptc Ubold7 Ubt Ubt7 Ubt7mem Ubt7old Ubtpt12ptc Ubtpt1ptc Udeltaabsc Udeltac Ulev Ulevmem Ulow Ulowtimer kbmcount /end OUT_MEASUREMENT
/end FUNCTION
/begin FUNCTION PMSOCCALC ""
 /begin DEF_CHARACTERISTIC CBATT_DEF KF_SOC0UBIB KF_SOCLF KL_SOC0TEMP K_IB_COMMVAL K_PMQ_UX K_Q_BILAPWF K_SOC_BILAWA K_SOC_QPWF K_SOC_QUALIA S_BSOCCALC S_SOC_BILA S_SOC_QUAL /end DEF_CHARACTERISTIC
 /begin OUT_MEASUREMENT Cbatt_lo D_qelad D_qlad Ib_commcnt Ib_commsta Isoc0loc Kalevcnt Q_bila Qeladold Qladold Soc_b_loc Soc_bila Soc_q_loc Soc_quali St_pmsocalc1 St_pmsocalc1.B_ibspwf_e St_pmsoccalc St_pmsoccalc.B_soc_pwf St_pmsoccalc.B_soccalc Tsocloc Ubatt0 /end OUT_MEASUREMENT
/end FUNCTION
/begin FUNCTION PMSOCFIT ""
 /begin DEF_CHARACTERISTIC KF_PMRIBAT1 KF_PMRIBAT2 KF_PMRIBAT3 KF_PMRIBAT4 KF_PMRIBAT5 KF_PMRIBAT6 KF_PMRIBAT7 KF_PMRIBAT8 KL_PMSOCVU K_I_FITAUSW K_SOCFITAPP S_PMSOCFIT ZK_PMSOC /end DEF_CHARACTERISTIC
 /begin OUT_MEASUREMENT Soc_fit Soc_fit_temp Ubatts2 /end OUT_MEASUREMENT
/end FUNCTION
/begin FUNCTION PMSOCKOR ""
 /begin DEF_CHARACTERISTIC KL_FITGRZ KL_SSOC K_ABSCHKORA K_BILA_OGRZ K_BILA_UGRZ K_DAB_KORR1 K_DAB_KORR2 K_DAB_KORR3 K_DSOCA K_DSOCABSCH K_PMTIMERSQ1 K_PM_TABSMN K_QSOCCL1 K_QSOCCL2 K_QSOCCL3 K_QSTARTFGA K_SOCFITGRZ K_SOCFITLIMH K_SOCFITLIML K_SOC_STAFGA K_TSAISONFIL K_TSAISPWF S_ABSCHK S_DSOCS S_PMTABSMN S_QSTARTFK S_SOCSTAFK /end DEF_CHARACTERISTIC
 /begin OUT_MEASUREMENT Absch_korr D_soc D_socw Pm_tsrdy Q_startfgk Soc_korr Soc_q_kor Soc_rel Soc_stfgk Soc_stfgkw St_pmsockor0 St_pmsockor0.B_abschfit St_pmsockor0.B_pm_fit2 St_pmsockor0.B_pm_fit3 St_pmsockor0.B_pmsocini St_pmsockor0.B_q_start St_pmsockor0.B_soc_npl T_saison T_saisonalt /end OUT_MEASUREMENT
/end FUNCTION
/begin FUNCTION PMSOCSTART ""
 /begin DEF_CHARACTERISTIC KL_ITNSTART KL_UNSTART KL_UTSTART K_RIN_GRENZ1 K_RIN_GRENZ2 K_RIN_GRENZ3 K_RIN_GRENZ4 K_RIN_GRENZ5 K_RIN_GRENZ6 K_RIN_GRENZ7 K_RIN_GRENZ8 K_TIME_START K_UB_GRENZ K_USTARTGRZ S_NKWITNSTRT S_PMSTARTQ S_PM_TEST1 S_RIN S_STARTAW /end DEF_CHARACTERISTIC
 /begin OUT_MEASUREMENT Ideltaabs Nnmstart Pmstartsta Rin_grenzh Rin_start St_pmsocstart0 St_pmsocstart0.B_pmstart7 St_pmsocstart0.B_resetsta St_pmsocstart0.B_rstdatardy St_pmsocstart_nv0 St_pmsocstart_nv0.B_pmsqrdy St_pmsocstart_nv0.B_pmstartq U_grenz U_startausw Ub_old /end OUT_MEASUREMENT
/end FUNCTION
/begin FUNCTION PMUGENCALC ""
 /begin DEF_CHARACTERISTIC KF_USOLL KL_USOLL K_DFOVERRIDE K_IGRDETEC K_PMUBAT_MAX K_PMUBAT_MIN K_PMUGEN_MAX K_PMUGEN_MIN K_TD_BNMOT K_TD_PMUGEN K_UGENNORM K_UIBSAPP K_USTEPMIN S_UIBS /end DEF_CHARACTERISTIC
 /begin OUT_MEASUREMENT St_pmugencalc St_pmugencalc.B_genclcon T_bnmotakt T_delta U_ibs U_igrdetec Ubattsoll Ubattsoll7 Udelta Udeltaabs Uibs7 /end OUT_MEASUREMENT
/end FUNCTION
/begin FUNCTION POEL_REG ""
 /begin DEF_CHARACTERISTIC CW_POEL KF_POELREG_ERR KF_POELSOLL KL_POELISTMN KL_POELREG_D KL_POELREG_I KL_POELREG_P KL_POELTVUB KL_TOEL_ADD KL_TOEL_FAK KL_TOEL_MUL KL_TOEL_PUMP KL_TOEL_SINK K_POELADI K_POELADMN K_POELADMX K_POELNKW_ON K_POELREGIMN K_POELREGIMX K_POELREGMN K_POELREGMX K_POELREG_OFF K_POELROUTMN K_POELROUTMX K_POELSOLDYN K_POEL_NKW1 K_POEL_NKW2 K_POEL_T1 K_POEL_T2 K_TD_POELAD K_TD_POELDIAG K_TD_POELDYN K_TD_POELIST K_TD_POELMDL K_TD_POELNKW K_TD_POELSD K_TD_POELSOL S_POELREG_AD S_POELR_PWM S_POEL_TEST /end DEF_CHARACTERISTIC
 /begin OUT_MEASUREMENT P_oel_diff P_oel_modell P_oel_soll P_oelist_f P_oelsol_kf P_oelsoldiag Poelad_array Poelad_idx_n Poelad_idx_t Poeldiag Poeldiag_abs Poeldiag_quot Poelreg_ad Poelreg_d Poelreg_i Poelreg_off Poelreg_out Poelreg_p Poelreg_pid Poelreg_st St_poelreg2 St_poelreg2.B_poel_anz St_poelreg3 St_poelreg3.B_poel_ad St_poelreg3.B_poel_diag St_poelreg3.B_poelad_lern St_poelreg3.B_poelnkw_on St_poelreg3.B_poelreg_on St_poelreg3.B_poelsol_dyn T_oel_fak Tv_poel /end OUT_MEASUREMENT
/end FUNCTION
/begin FUNCTION RAILKO ""
 /begin DEF_CHARACTERISTIC KF_PRAIL_H KF_PRAIL_HDOE KF_PRAIL_HS KF_PRAIL_HSMIN KF_PRAIL_S KF_PRAIL_SMIN K_PRAIL_MAN S_PRAIL_MAN S_PRAIL_SW /end DEF_CHARACTERISTIC
 /begin OUT_MEASUREMENT Prail_h Prail_h_doe Prail_hs Prail_hs_min Prail_out_s Prail_s Prail_s_min Prail_schalt Prail_soll Prail_sw Schalt_prail St_rail St_rail.B_prailsw St_railko St_railko.B_prail_hs St_railko.B_prail_s /end OUT_MEASUREMENT
/end FUNCTION
/begin FUNCTION RESTGAS ""
 /begin DEF_CHARACTERISTIC KF_ALLW KF_DASTDLL KF_DASTDT KF_DESTDLL KF_DESTDT KF_ELLW KF_KASLL KF_KASLL_HS KF_KASOPT KF_KASOPT_HS KF_KASOPU KF_KESLL KF_KESLL_HS KF_KESOPT KF_KESOPT_HS KF_KESOPU KF_WASLL KF_WASLL_HS KF_WASOPT KF_WASOPT_HS KF_WASOPU KF_WASVL KF_WASVLT KF_WESLL KF_WESLL_HS KF_WESOPT KF_WESOPT_HS KF_WESOPU KF_WESVL KF_WESVLT KF_WNWKHK KF_WNWKHK_2 KL_ASPAN KL_ASPVZ KL_ESPAN KL_ESPVZ KL_FASHSW KL_FASTW KL_FASW KL_FEASWLL KL_FEASWLL_HS KL_FESHSW KL_FESTW KL_FESW K_ASPRNOTL K_DTMSPR K_ESPRNOTL K_ETA_MDKH K_FWNWKH_MAX K_FWNWKH_MIN K_KHRAMP_AUS K_KHRAMP_EIN K_KH_EIN K_MATEN_KATHZ K_MATEN_KATHZSUB K_MAT_ASPR K_MAT_ASPRL K_MAT_ASPRVL K_MAT_ESPR K_MAT_ESPRL K_MAT_ESPRVL K_NMAXVNS_ANS K_OFASPRAP K_OFESPRAP K_PT1SPR K_RAMPENA K_RFMAXVNS_ANS K_SPRLLFL_AUS K_SPRLLFL_EIN K_SPRRAMP_EIN K_SPRRAMP_NEG K_SPRRAMP_POS K_SPRZGAN_OFF K_TMASPR K_TMESPR K_TMVS_ANLERN K_TVRAMP K_TVSPSA K_VNS_VZD K_VNS_VZZMX K_VNS_WTZ K_VSEMN_NOTL K_WNWAIMN K_WNWKHRA_MIN K_WNWMN S_ASPSATRU S_ESPSATRU S_KATHEIN_EXT S_MDAPPAS S_MDAPPES S_SICHER_ON /end DEF_CHARACTERISTIC
 /begin OUT_MEASUREMENT Allk Allw Ask Aspr Aspr_last Aspr_norm Aspr_ramp Aspr_vl1 Aspr_vl2 Aspr_vs Asprhs Asprimx Asprl Asprlast Asprlhs Asprll Asprll_kh Asprlu Asprt Asprtl_kh Aspru Astk Astw Asw Aswll Dvsa_ramp Dvse_ramp Ellk Ellw Esk Espr Espr_last Espr_norm Espr_ramp Espr_vl1 Espr_vl2 Espr_vs Esprhs Esprimx Esprl Esprlast Esprlhs Esprll Esprll_kh Esprlu Esprt Esprtl_kh Espru Estk Estw Esw Eswll Eta_mdkh F_easwll F_easwll_hs F_wnwkh F_wnwkh_aus F_wnwkhk F_wnwkhk_2 Fashsw_aus Fastw_aus Fasw_aus Feshsw_aus Festw_aus Fesw_aus St_ramp St_ramp.B_arampend St_ramp.B_arampend_1 St_ramp.B_erampend St_ramp.B_erampend_1 St_restg St_restg.B_ff_nvsaad St_restg.B_ff_nvsead St_restg.B_nvsaad St_restg.B_nvsead St_rstg St_rstg.B_aspan St_rstg.B_espan St_rstg.B_vsast St_rstg.B_vsest St_rstg.B_vzare St_rstg.B_vzere St_rstg.B_wnwmnba St_rstg.B_wnwmnbe St_rstg1 St_rstg1.B_nrf_kl15vorab St_rstg1.Rsthyst1 St_rstg1.Rsthyst2 Vsa_admn Vsa_sprn Vsa_vzt Vsa_vzz Vse_admn Vse_sprn Vse_vzt Vse_vzz Wnwsamn Wnwsemn /end OUT_MEASUREMENT
/end FUNCTION
/end MODULE
/end PROJECT
