/* -------------------------------------------------------------------------
Visu-IT!
Data Declaration System (DDS)
- ASAP2 export -
DDS-Version 4.0.1
Component-Version Build<000030.02> 2004/05/17 09:45:46
CreationDate 03 Nov 2004, 16:12:45
Project MSD70
Number 80B
Structure 7I0
Serial Nr. 00
Option Project (DataBase) E:\bmsnf\msd80-52507h0e\msd80\mc1_u\tmp\db
Option Verbose false
Option ASAP2File E:\bmsnf\msd80-52507h0e\msd80\mc1_u\out\cal\4v071030.a2l
Option IgnoreAddressCheck false
Option ASAP2Version 1.41
Option ExportSoftwareGrouping false
Option ExportComponentGrouping false
Option SuppressFunctionGrouping false
Option SuppressAxisFunctionGrouping false
Option ExportDisplayIdentifier <2>
Option ExportLongIdentifier <0>
Option ExportAnnotation false
Option PartialExportViaFunction
Option MemoryRegionAutoAssignment <0>
Option ExportReference2MemorySegment false
Option AddressOffset <0>
Option IfDataTemplateList 'CCP ASAP1B v2.4 (using ccp-definition)'
'ETK_V1_1_0_P2'
Option A2MLMode <0>
Option CalibrationMethodList
Option SuppressEcuAddress false
Option SuppressFloat false
Option SuppressVariantCoding false
Option VariantCodingMode <0>
Option OnlineOnly false
Option ExportHiddenData false
Option Map2PointLinearConv2RatFunc true
Option NonLinearConvMode <0>
Option MapVTabRange2VTab false
Option MaxCompuTabValuePairs <333>
Option DefaultFormat4VerbalConvers...
Option WriteEscapeCharacters false
Option AllowASAP1_3IdentsAlso4NonI... true
Option IgnorePartialIdentLengthCheck true
------------------------------------------------------------------------- */
ASAP2_VERSION 1 41
/begin PROJECT MSD70 "Spray Guided DI-System with Piezo Injectors for 6-Cylinder"
/begin HEADER "_default_HeaderComment" PROJECT_NO _0B /end HEADER
/begin MODULE _default_ModuleName "_default_ModuleLongIdentifier"
/begin MOD_PAR "_default_ModParComment" ADDR_EPK 0xa100005c EPK "80B7I000"
 /begin MEMORY_SEGMENT _INT_RAM "DRAM" VARIABLES RAM INTERN 0xd0000000 0x10000 -1 -1 -1 -1 -1 /begin IF_DATA ETK DP_BLOB 0xd0000000 0x10000 /end IF_DATA /end MEMORY_SEGMENT
 /begin MEMORY_SEGMENT _ROM "CAL" DATA FLASH EXTERN 0xa1000000 0x40000 -1 -1 -1 -1 -1 /begin IF_DATA ETK DP_BLOB 0xa1000000 0x40000 /end IF_DATA /end MEMORY_SEGMENT
 /begin MEMORY_SEGMENT _RAM "SRAM" VARIABLES RAM EXTERN 0xc0000000 0x10000 -1 -1 -1 -1 -1 /begin IF_DATA ETK DP_BLOB 0xc0000000 0x10000 /end IF_DATA /end MEMORY_SEGMENT
/end MOD_PAR
/begin MOD_COMMON "_default_ModCommonComment" DEPOSIT ABSOLUTE BYTE_ORDER MSB_LAST ALIGNMENT_BYTE 1 ALIGNMENT_WORD 2 ALIGNMENT_LONG 2 ALIGNMENT_FLOAT32_IEEE 2 ALIGNMENT_FLOAT64_IEEE 4 /end MOD_COMMON
/begin IF_DATA ASAP1B_CCP
 /begin SOURCE "CrankSyncCyl0" 0 0 DISPLAY_IDENTIFIER "DAQ0" /begin QP_BLOB 1 LENGTH 10 CAN_ID_FIXED 0x7a2 RASTER 1 FIRST_PID 0 /end QP_BLOB /end SOURCE
 /begin SOURCE "CrankSyncCyl1" 0 0 DISPLAY_IDENTIFIER "DAQ1" /begin QP_BLOB 2 LENGTH 10 CAN_ID_FIXED 0x7a2 RASTER 2 FIRST_PID 16 /end QP_BLOB /end SOURCE
 /begin SOURCE "CrankSyncCyl2" 0 0 DISPLAY_IDENTIFIER "DAQ2" /begin QP_BLOB 3 LENGTH 10 CAN_ID_FIXED 0x7a2 RASTER 3 FIRST_PID 32 /end QP_BLOB /end SOURCE
 /begin SOURCE "CrankSyncCyl3" 0 0 DISPLAY_IDENTIFIER "DAQ3" /begin QP_BLOB 4 LENGTH 10 CAN_ID_FIXED 0x7a2 RASTER 4 FIRST_PID 48 /end QP_BLOB /end SOURCE
 /begin SOURCE "CrankSyncCyl4" 0 0 DISPLAY_IDENTIFIER "DAQ4" /begin QP_BLOB 5 LENGTH 10 CAN_ID_FIXED 0x7a2 RASTER 5 FIRST_PID 64 /end QP_BLOB /end SOURCE
 /begin SOURCE "CrankSyncCyl5" 0 0 DISPLAY_IDENTIFIER "DAQ5" /begin QP_BLOB 6 LENGTH 10 CAN_ID_FIXED 0x7a2 RASTER 6 FIRST_PID 80 /end QP_BLOB /end SOURCE
 /begin SOURCE "TimeSync10ms" 0 0 DISPLAY_IDENTIFIER "10ms" /begin QP_BLOB 30 LENGTH 10 CAN_ID_FIXED 0x7a3 RASTER 30 FIRST_PID 128 /end QP_BLOB /end SOURCE
 /begin SOURCE "Display" 0 0 DISPLAY_IDENTIFIER "DSPL" /begin QP_BLOB 31 LENGTH 60 CAN_ID_FIXED 0x7a4 RASTER 31 FIRST_PID 144 /end QP_BLOB /end SOURCE
 /begin RASTER "CrankSyncCyl0" "CYL0" 1 103 1 /end RASTER
 /begin RASTER "CrankSyncCyl1" "CYL1" 2 103 1 /end RASTER
 /begin RASTER "CrankSyncCyl2" "CYL2" 3 103 1 /end RASTER
 /begin RASTER "CrankSyncCyl3" "CYL3" 4 103 1 /end RASTER
 /begin RASTER "CrankSyncCyl4" "CYL4" 5 103 1 /end RASTER
 /begin RASTER "CrankSyncCyl5" "CYL5" 6 103 1 /end RASTER
 /begin RASTER "TimeSync10ms" "10ms" 30 3 10 /end RASTER
 /begin RASTER "Display" "DISP" 31 3 100 /end RASTER
 /begin EVENT_GROUP "CrankSyncCyl0-5" "CRANK" RASTER 1 RASTER 2 RASTER 3 RASTER 4 RASTER 5 RASTER 6 /end EVENT_GROUP
 /begin SEED_KEY "internal.dll" "internal.dll" "internal.dll" /end SEED_KEY
 /begin CHECKSUM "CRC16.DLL" /end CHECKSUM
 /begin TP_BLOB 0x0201 0x0204 0x7a0 0x7a1 0x1 2 BAUDRATE 1000000 SAMPLE_POINT 60 SAMPLE_RATE 1 BTL_CYCLES 16 SJW 2 SYNC_EDGE DUAL RESUME_SUPPORTED STORE_SUPPORTED /begin CHECKSUM_PARAM 0x9001 0x200 CHECKSUM_CALCULATION ACTIVE_PAGE /end CHECKSUM_PARAM
  /begin DEFINED_PAGES 1 "Working Page" 0 0xa1080000 0x40000 RAM RAM_INIT_BY_ECU FLASH_BACK /end DEFINED_PAGES
  /begin DEFINED_PAGES 2 "Reference Page" 0 0xa1000000 0x40000 FLASH DEFAULT /end DEFINED_PAGES
  OPTIONAL_CMD 0x5 OPTIONAL_CMD 0x8 OPTIONAL_CMD 0x9 OPTIONAL_CMD 0xc OPTIONAL_CMD 0xd OPTIONAL_CMD 0xe OPTIONAL_CMD 0x11 OPTIONAL_CMD 0x12 OPTIONAL_CMD 0x13 OPTIONAL_CMD 0x19 OPTIONAL_CMD 0x23 /end TP_BLOB
/end IF_DATA
/begin IF_DATA ETK
 /begin SOURCE "Segment Synchronous" 103 1 QP_BLOB 1 0x3c 0x0 0x0 0x0 0 0 0 /end SOURCE
 /begin SOURCE "Time Synchronous 10ms" 4 1 QP_BLOB 2 0x5c 0x0 0x0 0x0 10 0 0 /end SOURCE
 /begin SOURCE "Time Synchronous 100ms" 5 1 QP_BLOB 3 0x5c 0x0 0x0 0x0 100 0 0 /end SOURCE
 /begin SOURCE "Bypass Segment Synchronous" 103 1 QP_BLOB 4 0x30 0x0 0x0 0x0 0 0x10 0x0 /end SOURCE
 /begin SOURCE "Bypass Time Synchronous" 4 1 QP_BLOB 5 0x30 0x0 0x0 0x0 10 0x20 0x0 /end SOURCE
 /begin TP_BLOB 16777217 0 2048 /begin DISTAB_CFG 13 273 1 25682176 16843008 TRG_MOD 0 183 0 0 0 /end DISTAB_CFG CODE_CHK 0 0 0 0 ETK_CFG 2 226 78 223 239 78 223 239 78 207 251 254 255 255 251 255 255 255 255 255 3 255 1 255 RESERVED 8774864 1536 EXTERN -1 -1 -1 -1 -1 /end TP_BLOB
/end IF_DATA
/begin CHARACTERISTIC c_vs_min_ef_at "Speed threshold for continuously opened exhaust flap, automatically shifted transmission" VALUE 0xa1029cb7 _REC_VAL_20_u1 255. _CNV_A_R_LINEAR_____6_CM 0. 255. DISPLAY_IDENTIFIER C_VS_MIN_EF_AT FORMAT "%3.0" /end CHARACTERISTIC
/begin CHARACTERISTIC c_vs_min_ef_mt "Speed threshold for continuously opened exhaust flap, manually shifted transmission" VALUE 0xa1029cb8 _REC_VAL_20_u1 255. _CNV_A_R_LINEAR_____6_CM 0. 255. DISPLAY_IDENTIFIER C_VS_MIN_EF_MT FORMAT "%3.0" /end CHARACTERISTIC
/begin CHARACTERISTIC c_t_ef_ast "Cranking time for EF actuation active" VALUE 0xa1029887 _REC_VAL_20_u1 25.5 _CNV_A_R_LINEAR_____4_CM 0. 25.5 DISPLAY_IDENTIFIER C_T_EF_AST FORMAT "%4.1" /end CHARACTERISTIC
/begin AXIS_PTS ldpm_gear_ef_1 "" 0xa1021af8 gear_ef _REC_AXS_20_u1 6. _CNV_A_R_LINEAR_____0_CM 7 0. 6. FORMAT "%1.0" /end AXIS_PTS
/begin CHARACTERISTIC id_fac_tq_ef_thd_ctop_open_mt "Switching threshold FAC_TQ_EF for convertible top open MT" MAP 0xa10225b8 _REC_MAP_20_u2_u1_u1 1.99996948242188 _CNV_A_R_LINEAR_____8_CM 0. 1.99996948242188 DISPLAY_IDENTIFIER ID_FAC_TQ_EF_THD_CTOP_OPEN_MT FORMAT "%9.8"
 /begin AXIS_DESCR COM_AXIS n_ef _CNV_A_R_LINEAR_____9_CM 6 0. 8160. FORMAT "%4.0" AXIS_PTS_REF ldpm_n_ef /end AXIS_DESCR
 /begin AXIS_DESCR COM_AXIS gear_ef _CNV_A_R_LINEAR_____0_CM 7 0. 6. FORMAT "%1.0" AXIS_PTS_REF ldpm_gear_ef_1 /end AXIS_DESCR
/end CHARACTERISTIC
/begin CHARACTERISTIC id_fac_tq_ef_thd_ctop_open_at "Switching threshold FAC_TQ_EF for convertible top open  AT" MAP 0xa1022564 _REC_MAP_20_u2_u1_u1 1.99996948242188 _CNV_A_R_LINEAR_____8_CM 0. 1.99996948242188 DISPLAY_IDENTIFIER ID_FAC_TQ_EF_THD_CTOP_OPEN_AT FORMAT "%9.8"
 /begin AXIS_DESCR COM_AXIS n_ef _CNV_A_R_LINEAR_____9_CM 6 0. 8160. FORMAT "%4.0" AXIS_PTS_REF ldpm_n_ef /end AXIS_DESCR
 /begin AXIS_DESCR COM_AXIS gear_ef _CNV_A_R_LINEAR_____0_CM 7 0. 6. FORMAT "%1.0" AXIS_PTS_REF ldpm_gear_ef_1 /end AXIS_DESCR
/end CHARACTERISTIC
/begin AXIS_PTS ldpm_n_ef "" 0xa1021ffa n_ef _REC_AXS_20_u1 8160. _CNV_A_R_LINEAR_____9_CM 6 0. 8160. FORMAT "%4.0" /end AXIS_PTS
/begin CHARACTERISTIC id_fac_tq_ef_thd_ctop_close_at "Switching threshold FAC_TQ_EF for convertible top close  AT" MAP 0xa10224bc _REC_MAP_20_u2_u1_u1 1.99996948242188 _CNV_A_R_LINEAR_____8_CM 0. 1.99996948242188 DISPLAY_IDENTIFIER ID_FAC_TQ_EF_THD_CTOP_CLOSE_AT FORMAT "%9.8"
 /begin AXIS_DESCR COM_AXIS n_ef _CNV_A_R_LINEAR_____9_CM 6 0. 8160. FORMAT "%4.0" AXIS_PTS_REF ldpm_n_ef /end AXIS_DESCR
 /begin AXIS_DESCR COM_AXIS gear_ef _CNV_A_R_LINEAR_____0_CM 7 0. 6. FORMAT "%1.0" AXIS_PTS_REF ldpm_gear_ef_1 /end AXIS_DESCR
/end CHARACTERISTIC
/begin CHARACTERISTIC id_fac_tq_ef_thd_ctop_close_mt "Switching threshold FAC_TQ_EF for convertible top close  MT" MAP 0xa1022510 _REC_MAP_20_u2_u1_u1 1.99996948242188 _CNV_A_R_LINEAR_____8_CM 0. 1.99996948242188 DISPLAY_IDENTIFIER ID_FAC_TQ_EF_THD_CTOP_CLOSE_MT FORMAT "%9.8"
 /begin AXIS_DESCR COM_AXIS n_ef _CNV_A_R_LINEAR_____9_CM 6 0. 8160. FORMAT "%4.0" AXIS_PTS_REF ldpm_n_ef /end AXIS_DESCR
 /begin AXIS_DESCR COM_AXIS gear_ef _CNV_A_R_LINEAR_____0_CM 7 0. 6. FORMAT "%1.0" AXIS_PTS_REF ldpm_gear_ef_1 /end AXIS_DESCR
/end CHARACTERISTIC
/begin CHARACTERISTIC ip_t_dly_ef "Time delay for closing exhaust flap" CURVE 0xa1027c2c _REC_CUR_20_u1_u1 25.5 _CNV_A_R_LINEAR_____4_CM 0. 25.5 DISPLAY_IDENTIFIER IP_T_DLY_EF FORMAT "%4.1"
 /begin AXIS_DESCR COM_AXIS n_32 _CNV_A_R_LINEAR_____9_CM 8 0. 8160. FORMAT "%4.0" AXIS_PTS_REF ldp_n_32_ip_t_dly_ef /end AXIS_DESCR
/end CHARACTERISTIC
/begin CHARACTERISTIC lc_ef_conf "Switch for inverted exhaust flap = 0 normal flap; =1 inverted flap" VALUE 0xa1029d1b _REC_VAL_20_u1 1. _CNV_A_R_LINEAR_____0_CM 0. 1. DISPLAY_IDENTIFIER LC_EF_CONF FORMAT "%2.0" /end CHARACTERISTIC
/begin CHARACTERISTIC c_n_ef_hys "Switch for inverted exhaust flap = 0 normal flap; =1 inverted flap" VALUE 0xa10295f7 _REC_VAL_20_u1 8160. _CNV_A_R_LINEAR_____9_CM 0. 8160. DISPLAY_IDENTIFIER C_N_EF_HYS FORMAT "%4.0" /end CHARACTERISTIC
/begin CHARACTERISTIC c_fac_tq_ef_thd_hys "Hysteresis for switching threshold" VALUE 0xa10293b2 _REC_VAL_20_s2 3.999938965 _CNV_A_R_LINEAR_____10_CM -2. 1.999938965 DISPLAY_IDENTIFIER C_FAC_TQ_EF_THD_HYS FORMAT "%8.4" /end CHARACTERISTIC
/begin MEASUREMENT lv_ef "Logical value exhaust flap, 1 = closed flap" UBYTE _CNV_S_2_RANGE__0___1_CM 1 100. 0. 1. DISPLAY_IDENTIFIER LV_EF ECU_ADDRESS 0xd0003dd4 BIT_MASK 0x1 /end MEASUREMENT
/begin MEASUREMENT fac_tq_ef_thd "Switching threshold for exhaust flap" UWORD _CNV_A_R_LINEAR_____8_CM 1 100. 0. 1.99996948242188 DISPLAY_IDENTIFIER FAC_TQ_EF_THD ECU_ADDRESS 0xc0000010 FORMAT "%7.5" /end MEASUREMENT
/begin MEASUREMENT fac_tq_ef_thd_ctop "Switching threshold for exhaust flap without hysteresis" UWORD _CNV_A_R_LINEAR_____8_CM 1 100. 0. 1.99996948242188 DISPLAY_IDENTIFIER FAC_TQ_EF_THD_CTOP ECU_ADDRESS 0xc0000012 FORMAT "%7.5" /end MEASUREMENT
/begin MEASUREMENT n_ef "N for exhaust flap" UBYTE _CNV_A_R_LINEAR_____9_CM 1 100. 0. 8160. DISPLAY_IDENTIFIER N_EF ECU_ADDRESS 0xc0000018 FORMAT "%4.0" /end MEASUREMENT
/begin MEASUREMENT t_dly_ef "Time delay for closing exhaust flap" UBYTE _CNV_A_R_LINEAR_____4_CM 1 100. 0. 25.5 DISPLAY_IDENTIFIER T_DLY_EF ECU_ADDRESS 0xc0000019 FORMAT "%4.1" /end MEASUREMENT
/begin AXIS_PTS ldp_n_32_ip_t_dly_ef "" 0xa1020e40 n_32 _REC_AXS_20_u1 8160. _CNV_A_R_LINEAR_____9_CM 8 0. 8160. FORMAT "%4.0" /end AXIS_PTS
/begin CHARACTERISTIC lc_state_ch_ef "Exhaust flap actuation in case catalyst heating with increased idle speed" VALUE 0xa1029dd7 _REC_VAL_20_u1 1. _CNV_A_R_LINEAR_____0_CM 0. 1. DISPLAY_IDENTIFIER LC_STATE_CH_EF FORMAT "%2.0" /end CHARACTERISTIC
/begin CHARACTERISTIC lc_state_vs_min_ef_at "Exhaust flap actuation in case of vs < C_VS_MIN_EF_AT for AT version" VALUE 0xa1029ddc _REC_VAL_20_u1 1. _CNV_A_R_LINEAR_____0_CM 0. 1. DISPLAY_IDENTIFIER LC_STATE_VS_MIN_EF_AT FORMAT "%2.0" /end CHARACTERISTIC
/begin CHARACTERISTIC lc_state_vs_min_ef_mt "Exhaust flap actuation in case of vs < C_VS_MIN_EF_MT for MT version" VALUE 0xa1029ddd _REC_VAL_20_u1 1. _CNV_A_R_LINEAR_____0_CM 0. 1. DISPLAY_IDENTIFIER LC_STATE_VS_MIN_EF_MT FORMAT "%2.0" /end CHARACTERISTIC
/begin CHARACTERISTIC lc_state_ef_ast "State exhaust flap after start" VALUE 0xa1029dd8 _REC_VAL_20_u1 1. _CNV_A_R_LINEAR_____0_CM 0. 1. DISPLAY_IDENTIFIER LC_STATE_EF_AST FORMAT "%2.0" /end CHARACTERISTIC
/begin CHARACTERISTIC c_v_sof_swi_on_bol "Voltage-Treshold bottom limit for sport mode ON" VALUE 0xa1029b90 _REC_VAL_20_u2 4.9951171875 _CNV_A_R_LINEAR_____2_CM 0. 4.9951171875 DISPLAY_IDENTIFIER C_V_SOF_SWI_ON_BOL FORMAT "%5.3" /end CHARACTERISTIC
/begin MEASUREMENT lv_sof_swi_req "Sport Mode required by switch" UBYTE _CNV_S_2_RANGE__0___1_CM 1 100. 0. 1. DISPLAY_IDENTIFIER LV_SOF_SWI_REQ ECU_ADDRESS 0xd0003dd8 BIT_MASK 0x1 /end MEASUREMENT
/begin MEASUREMENT lv_sof_swi "Sport Mode switch acting" UBYTE _CNV_S_2_RANGE__0___1_CM 1 100. 0. 1. DISPLAY_IDENTIFIER LV_SOF_SWI ECU_ADDRESS 0xd0003dd9 BIT_MASK 0x1 /end MEASUREMENT
/begin MEASUREMENT lv_sof_swi_amt "Sport-mode switch AMT acting" UBYTE _CNV_S_2_RANGE__0___1_CM 1 100. 0. 1. DISPLAY_IDENTIFIER LV_SOF_SWI_AMT ECU_ADDRESS 0xd0003dda BIT_MASK 0x1 /end MEASUREMENT
/begin MEASUREMENT lv_sof_swi_amt_req "Sport-mode AMT required by switch" UBYTE _CNV_S_2_RANGE__0___1_CM 1 100. 0. 1. DISPLAY_IDENTIFIER LV_SOF_SWI_AMT_REQ ECU_ADDRESS 0xd0003ddb BIT_MASK 0x1 /end MEASUREMENT
/begin CHARACTERISTIC c_v_sof_swi_on_tol "Voltage-Treshold top limit for sport mode ON (AMT)" VALUE 0xa1029b92 _REC_VAL_20_u2 4.9951171875 _CNV_A_R_LINEAR_____2_CM 0. 4.9951171875 DISPLAY_IDENTIFIER C_V_SOF_SWI_ON_TOL FORMAT "%5.3" /end CHARACTERISTIC
/begin CHARACTERISTIC c_v_sof_swi_amt_on_tol "Voltage-Treshold top limit for sport mode ON" VALUE 0xa1029b8a _REC_VAL_20_u2 4.9951171875 _CNV_A_R_LINEAR_____2_CM 0. 4.9951171875 DISPLAY_IDENTIFIER C_V_SOF_SWI_AMT_ON_TOL FORMAT "%5.3" /end CHARACTERISTIC
/begin CHARACTERISTIC lc_var_sof_swi "Calibration switch (1 on / 0 off)" VALUE 0xa1029e13 _REC_VAL_20_u1 1. _CNV_A_R_LINEAR_____0_CM 0. 1. DISPLAY_IDENTIFIER LC_VAR_SOF_SWI FORMAT "%2.0" /end CHARACTERISTIC
/begin CHARACTERISTIC lc_var_sof_swi_amt "Calibration switch (1 on / 0 off)" VALUE 0xa1029e14 _REC_VAL_20_u1 1. _CNV_A_R_LINEAR_____0_CM 0. 1. DISPLAY_IDENTIFIER LC_VAR_SOF_SWI_AMT FORMAT "%2.0" /end CHARACTERISTIC
/begin CHARACTERISTIC lc_conf_city_ena "Enable condition regarding lv_city (1 on / 0 off)" VALUE 0xa1029d10 _REC_VAL_20_u1 1. _CNV_A_R_LINEAR_____0_CM 0. 1. DISPLAY_IDENTIFIER LC_CONF_CITY_ENA FORMAT "%2.0" /end CHARACTERISTIC
/begin CHARACTERISTIC c_vs_min_sof_mt "Speed threshold for continously opened sound flap (manuel transmission)" VALUE 0xa1029cc8 _REC_VAL_20_u1 255. _CNV_A_R_LINEAR_____6_CM 0. 255. DISPLAY_IDENTIFIER C_VS_MIN_SOF_MT FORMAT "%3.0" /end CHARACTERISTIC
/begin CHARACTERISTIC c_vs_min_sof_at "Speed threshold for continously opened sound flap (automatic transmission)" VALUE 0xa1029cc7 _REC_VAL_20_u1 255. _CNV_A_R_LINEAR_____6_CM 0. 255. DISPLAY_IDENTIFIER C_VS_MIN_SOF_AT FORMAT "%3.0" /end CHARACTERISTIC
/begin MEASUREMENT lv_sof "Logical value sound flap (1 = activated)" UBYTE _CNV_S_2_RANGE__0___1_CM 1 100. 0. 1. DISPLAY_IDENTIFIER LV_SOF ECU_ADDRESS 0xd0003ddc BIT_MASK 0x1 /end MEASUREMENT
/begin MEASUREMENT fac_tq_sof_thd "Switching threshold for sound flap" UWORD _CNV_A_R_LINEAR_____8_CM 1 100. 0. 1.99996948242188 DISPLAY_IDENTIFIER FAC_TQ_SOF_THD ECU_ADDRESS 0xc0000048 FORMAT "%7.5" BIT_MASK 0x1 /end MEASUREMENT
/begin MEASUREMENT fac_tq_sof_thd_ctop "Switching threshold for sound flap without hysteresis" UWORD _CNV_A_R_LINEAR_____8_CM 1 100. 0. 1.99996948242188 DISPLAY_IDENTIFIER FAC_TQ_SOF_THD_CTOP ECU_ADDRESS 0xc000004a FORMAT "%7.5" BIT_MASK 0x1 /end MEASUREMENT
/begin MEASUREMENT n_sof "N for sound flap" UBYTE _CNV_A_R_LINEAR_____9_CM 1 100. 0. 8160. DISPLAY_IDENTIFIER N_SOF ECU_ADDRESS 0xc0000050 FORMAT "%4.0" BIT_MASK 0x1 /end MEASUREMENT
/begin MEASUREMENT t_dly_sof "Time delay for closing sound flap" UBYTE _CNV_A_R_LINEAR_____4_CM 1 100. 0. 25.5 DISPLAY_IDENTIFIER T_DLY_SOF ECU_ADDRESS 0xc0000051 FORMAT "%4.1" /end MEASUREMENT
/begin CHARACTERISTIC c_t_sof_ast "cranking time for SOF actuation active" VALUE 0xa1029960 _REC_VAL_20_u1 25.5 _CNV_A_R_LINEAR_____4_CM 0. 25.5 DISPLAY_IDENTIFIER C_T_SOF_AST FORMAT "%4.1" /end CHARACTERISTIC
/begin CHARACTERISTIC c_n_sof_hys "N hysteresis SOF" VALUE 0xa102964a _REC_VAL_20_u1 8160. _CNV_A_R_LINEAR_____9_CM 0. 8160. DISPLAY_IDENTIFIER C_N_SOF_HYS FORMAT "%4.0" /end CHARACTERISTIC
/begin CHARACTERISTIC c_fac_tq_sof_thd_hys "Hysteresis for switching threshold sound flap" VALUE 0xa10293c6 _REC_VAL_20_s2 3.99993896484375 _CNV_A_R_LINEAR_____23_CM -2. 1.99993896484375 DISPLAY_IDENTIFIER C_FAC_TQ_SOF_THD_HYS FORMAT "%8.5" /end CHARACTERISTIC
/begin AXIS_PTS ldpm_n_sof "" 0xa10220dc n_sof _REC_AXS_20_u1 8160. _CNV_A_R_LINEAR_____9_CM 6 0. 8160. FORMAT "%4.0" /end AXIS_PTS
/begin AXIS_PTS ldp_n_32_ip_t_dly_sof "" 0xa1020e4c n_32 _REC_AXS_20_u1 8160. _CNV_A_R_LINEAR_____9_CM 8 0. 8160. FORMAT "%4.0" /end AXIS_PTS
/begin CHARACTERISTIC ip_t_dly_sof "Time delay for closing sound flap" CURVE 0xa1027c48 _REC_CUR_20_u1_u1 25.5 _CNV_A_R_LINEAR_____4_CM 0. 25.5 DISPLAY_IDENTIFIER IP_T_DLY_SOF FORMAT "%4.1"
 /begin AXIS_DESCR COM_AXIS n_32 _CNV_A_R_LINEAR_____9_CM 8 0. 8160. FORMAT "%4.0" AXIS_PTS_REF ldp_n_32_ip_t_dly_sof /end AXIS_DESCR
/end CHARACTERISTIC
/begin CHARACTERISTIC id_fac_tq_sof_thd_ctop_open_mt "Switching threshold FAC_TQ_SOF for convertible top open (manuel transmission)" MAP 0xa1022708 _REC_MAP_20_u2_u1_u1 1.99996948242188 _CNV_A_R_LINEAR_____8_CM 0. 1.99996948242188 DISPLAY_IDENTIFIER ID_FAC_TQ_SOF_THD_CTOP_OPEN_MT FORMAT "%7.5"
 /begin AXIS_DESCR COM_AXIS n_sof _CNV_A_R_LINEAR_____9_CM 6 0. 8160. FORMAT "%4.0" AXIS_PTS_REF ldpm_n_sof /end AXIS_DESCR
 /begin AXIS_DESCR COM_AXIS gear_ef _CNV_A_R_LINEAR_____0_CM 7 0. 6. FORMAT "%1.0" AXIS_PTS_REF ldpm_gear_ef_1 /end AXIS_DESCR
/end CHARACTERISTIC
/begin CHARACTERISTIC id_fac_tq_sof_thd_ctop_open_at "Switching threshold FAC_TQ_SOF for convertible top open (automatic transmission)" MAP 0xa10226b4 _REC_MAP_20_u2_u1_u1 1.99996948242188 _CNV_A_R_LINEAR_____8_CM 0. 1.99996948242188 DISPLAY_IDENTIFIER ID_FAC_TQ_SOF_THD_CTOP_OPEN_AT FORMAT "%7.5"
 /begin AXIS_DESCR COM_AXIS n_sof _CNV_A_R_LINEAR_____9_CM 6 0. 8160. FORMAT "%4.0" AXIS_PTS_REF ldpm_n_sof /end AXIS_DESCR
 /begin AXIS_DESCR COM_AXIS gear_ef _CNV_A_R_LINEAR_____0_CM 7 0. 6. FORMAT "%1.0" AXIS_PTS_REF ldpm_gear_ef_1 /end AXIS_DESCR
/end CHARACTERISTIC
/begin CHARACTERISTIC id_fac_tq_sof_thd_ctop_close_mt "Switching threshold FAC_TQ_SOF for convertible top closed (manuel transmission)" MAP 0xa1022660 _REC_MAP_20_u2_u1_u1 1.99996948242188 _CNV_A_R_LINEAR_____8_CM 0. 1.99996948242188 DISPLAY_IDENTIFIER ID_FAC_TQ_SOF_THD_CTOP_CLOSE_MT FORMAT "%7.5"
 /begin AXIS_DESCR COM_AXIS n_sof _CNV_A_R_LINEAR_____9_CM 6 0. 8160. FORMAT "%4.0" AXIS_PTS_REF ldpm_n_sof /end AXIS_DESCR
 /begin AXIS_DESCR COM_AXIS gear_ef _CNV_A_R_LINEAR_____0_CM 7 0. 6. FORMAT "%1.0" AXIS_PTS_REF ldpm_gear_ef_1 /end AXIS_DESCR
/end CHARACTERISTIC
/begin CHARACTERISTIC id_fac_tq_sof_thd_ctop_close_at "Switching threshold FAC_TQ_SOF for convertible top closed (automatic transmission)" MAP 0xa102260c _REC_MAP_20_u2_u1_u1 1.99996948242188 _CNV_A_R_LINEAR_____8_CM 0. 1.99996948242188 DISPLAY_IDENTIFIER ID_FAC_TQ_SOF_THD_CTOP_CLOSE_AT FORMAT "%7.5"
 /begin AXIS_DESCR COM_AXIS n_sof _CNV_A_R_LINEAR_____9_CM 6 0. 8160. FORMAT "%4.0" AXIS_PTS_REF ldpm_n_sof /end AXIS_DESCR
 /begin AXIS_DESCR COM_AXIS gear_ef _CNV_A_R_LINEAR_____0_CM 7 0. 6. FORMAT "%1.0" AXIS_PTS_REF ldpm_gear_ef_1 /end AXIS_DESCR
/end CHARACTERISTIC
/begin CHARACTERISTIC lc_state_vs_min_sof_mt "State sound flap in case of VS < C_VS_MIN_SOF_MT (manuel transmission)" VALUE 0xa1029ddf _REC_VAL_20_u1 1. _CNV_A_R_LINEAR_____0_CM 0. 1. DISPLAY_IDENTIFIER LC_STATE_VS_MIN_SOF_MT FORMAT "%2.0" /end CHARACTERISTIC
/begin CHARACTERISTIC lc_state_vs_min_sof_at "State sound flap in case of VS < C_VS_MIN_SOF_MT (automatic transmission)" VALUE 0xa1029dde _REC_VAL_20_u1 1. _CNV_A_R_LINEAR_____0_CM 0. 1. DISPLAY_IDENTIFIER LC_STATE_VS_MIN_SOF_AT FORMAT "%2.0" /end CHARACTERISTIC
/begin CHARACTERISTIC lc_state_sof_ast "State sound flap during C_T_SOF_AST" VALUE 0xa1029dda _REC_VAL_20_u1 1. _CNV_A_R_LINEAR_____0_CM 0. 1. DISPLAY_IDENTIFIER LC_STATE_SOF_AST FORMAT "%2.0" /end CHARACTERISTIC
/begin MEASUREMENT lv_accout_rly_ena "LV indicating that the conditions for activating the ACC-relay are fullfilled" UBYTE _CNV_S_2_RANGE__0___1_CM 1 100. 0. 1. DISPLAY_IDENTIFIER LV_ACCOUT_RLY_ENA ECU_ADDRESS 0xd0003dba BIT_MASK 0x1 /end MEASUREMENT
/begin CHARACTERISTIC c_vs_max_accin "Speed condition for ACC suppression at high load" VALUE 0xa1029ca2 _REC_VAL_20_u1 255. _CNV_A_R_LINEAR_____6_CM 0. 255. DISPLAY_IDENTIFIER C_VS_MAX_ACCIN FORMAT "%3.0" /end CHARACTERISTIC
/begin CHARACTERISTIC c_accin_dly_1 "Delay for ACC suppression in transition after full load" VALUE 0xa1029178 _REC_VAL_20_u2 655.34 _CNV_A_R_LINEAR_____3_CM 1.e-002 655.35 DISPLAY_IDENTIFIER C_ACCIN_DLY_1 FORMAT "%6.2" /end CHARACTERISTIC
/begin CHARACTERISTIC c_accin_dly_1_lock_fl "Blocking time for renewed triggering of the ACC suppression at high load" VALUE 0xa102917a _REC_VAL_20_u2 655.35 _CNV_A_R_LINEAR_____3_CM 0. 655.35 DISPLAY_IDENTIFIER C_ACCIN_DLY_1_LOCK_FL FORMAT "%6.2" /end CHARACTERISTIC
/begin CHARACTERISTIC c_accin_dly_4 "Delay in transition from start" VALUE 0xa102917c _REC_VAL_20_u2 6553.5 _CNV_A_R_LINEAR_____4_CM 0. 6553.5 DISPLAY_IDENTIFIER C_ACCIN_DLY_4 FORMAT "%6.1" /end CHARACTERISTIC
/begin CHARACTERISTIC c_pvs_fl_accin "PV-threshold for ACC suppression" VALUE 0xa1029738 _REC_VAL_20_u1 99.609375 _CNV_A_R_LINEAR_____5_CM 0. 99.609375 DISPLAY_IDENTIFIER C_PVS_FL_ACCIN FORMAT "%4.1" /end CHARACTERISTIC
/begin CHARACTERISTIC c_accin_dly_5 "Delay before renewed reactivation of the ACC" VALUE 0xa102917e _REC_VAL_20_u2 655.35 _CNV_A_R_LINEAR_____3_CM 0. 655.35 DISPLAY_IDENTIFIER C_ACCIN_DLY_5 FORMAT "%6.2" /end CHARACTERISTIC
/begin MEASUREMENT lv_accout_rly "LV to activate the ACC-relay" UBYTE _CNV_S_2_RANGE__0___1_CM 1 100. 0. 1. DISPLAY_IDENTIFIER LV_ACCOUT_RLY ECU_ADDRESS 0xd0003dbb BIT_MASK 0x1 /end MEASUREMENT
/begin CHARACTERISTIC c_tco_max_accin_hys "Hysteresis for leaving ACC suppression" VALUE 0xa10299d2 _REC_VAL_20_u1 60. _CNV_A_R_LINEAR_____24_CM 0. 60. DISPLAY_IDENTIFIER C_TCO_MAX_ACCIN_HYS FORMAT "%4.1" /end CHARACTERISTIC
/begin AXIS_PTS ldpm_n_32__t_acc "" 0xa1021e2c n_32 _REC_AXS_20_u1 8160. _CNV_A_R_LINEAR_____9_CM 3 0. 8160. FORMAT "%4.0" /end AXIS_PTS
/begin MEASUREMENT t_acc "Timer for duration of transient TQ_LOSS_ACC correction " UBYTE _CNV_A_R_LINEAR_____3_CM 1 100. 0. 2.55 DISPLAY_IDENTIFIER T_ACC ECU_ADDRESS 0xd0003db8 FORMAT "%4.2" /end MEASUREMENT
/begin MEASUREMENT t_acc_dly "delay time for start of TQ_LOSS_ACC-calculation & ACC-relay" UBYTE _CNV_A_R_LINEAR_____3_CM 1 100. 0. 2.55 DISPLAY_IDENTIFIER T_ACC_DLY ECU_ADDRESS 0xd0003db9 FORMAT "%4.2" /end MEASUREMENT
/begin CHARACTERISTIC ip_t_acc_dly_on__n_32 "Turn-On-Delay for start of T_ACC depending on N_32" CURVE 0xa10278e4 _REC_CUR_20_u1_u1 2.55 _CNV_A_R_LINEAR_____3_CM 0. 2.55 DISPLAY_IDENTIFIER IP_T_ACC_DLY_ON__N_32 FORMAT "%4.2"
 /begin AXIS_DESCR COM_AXIS n_32 _CNV_A_R_LINEAR_____9_CM 3 0. 8160. FORMAT "%4.0" AXIS_PTS_REF ldpm_n_32__t_acc /end AXIS_DESCR
/end CHARACTERISTIC
/begin CHARACTERISTIC ip_t_acc_dly_off__n_32 "Turn-Off-Delay for start of T_ACC depending on N_32" CURVE 0xa10278e0 _REC_CUR_20_u1_u1 2.55 _CNV_A_R_LINEAR_____3_CM 0. 2.55 DISPLAY_IDENTIFIER IP_T_ACC_DLY_OFF__N_32 FORMAT "%4.2"
 /begin AXIS_DESCR COM_AXIS n_32 _CNV_A_R_LINEAR_____9_CM 3 0. 8160. FORMAT "%4.0" AXIS_PTS_REF ldpm_n_32__t_acc /end AXIS_DESCR
/end CHARACTERISTIC
/begin CHARACTERISTIC c_tco_max_accin "TCC threshold for ACC suppression" VALUE 0xa10299d1 _REC_VAL_20_u1 190.5 _CNV_A_R_LINEAR_____16_CM -48. 142.5 DISPLAY_IDENTIFIER C_TCO_MAX_ACCIN FORMAT "%5.1" /end CHARACTERISTIC
/begin CHARACTERISTIC c_toil_max_accin "TOIL threshold for ACC suppression" VALUE 0xa1029a83 _REC_VAL_20_u1 200. _CNV_A_R_LINEAR_____25_CM -40. 160. DISPLAY_IDENTIFIER C_TOIL_MAX_ACCIN FORMAT "%3.0" /end CHARACTERISTIC
/begin CHARACTERISTIC c_toil_max_accin_hys "TOIL hysteresis for ACC suppression" VALUE 0xa1029a84 _REC_VAL_20_u1 60. _CNV_A_R_LINEAR_____24_CM 0. 60. DISPLAY_IDENTIFIER C_TOIL_MAX_ACCIN_HYS FORMAT "%4.1" /end CHARACTERISTIC
/begin CHARACTERISTIC c_temp_gb_max_accin "TEMP_GB threshold for ACC suppression" VALUE 0xa1029a1f _REC_VAL_20_u1 255. _CNV_A_R_LINEAR_____25_CM -40. 215. DISPLAY_IDENTIFIER C_TEMP_GB_MAX_ACCIN FORMAT "%3.0" /end CHARACTERISTIC
/begin CHARACTERISTIC c_temp_gb_max_accin_hys "TEMP_GB hysteresis for ACC suppression" VALUE 0xa1029a20 _REC_VAL_20_u1 60. _CNV_A_R_LINEAR_____24_CM 0. 60. DISPLAY_IDENTIFIER C_TEMP_GB_MAX_ACCIN_HYS FORMAT "%4.1" /end CHARACTERISTIC
/begin MEASUREMENT lv_efp_on_ext_adj_can "switch ON of EFP via CAN (tester diagnosis9" UBYTE _CNV_S_2_RANGE__0___1_CM 1 100. 0. 1. DISPLAY_IDENTIFIER LV_EFP_ON_EXT_ADJ_CAN ECU_ADDRESS 0xd0003755 BIT_MASK 0x1 /end MEASUREMENT
/begin MEASUREMENT lv_efp_off_ext_adj_can "switch OFF of EFP via CAN (tester diagnosis9" UBYTE _CNV_S_2_RANGE__0___1_CM 1 100. 0. 1. DISPLAY_IDENTIFIER LV_EFP_OFF_EXT_ADJ_CAN ECU_ADDRESS 0xd0003756 BIT_MASK 0x1 /end MEASUREMENT
/begin MEASUREMENT state_diag_efp "diagnosis status of the electical fuel pump" UBYTE _CNV_A_R_LINEAR_____0_CM 1 100. 0. 255. DISPLAY_IDENTIFIER STATE_DIAG_EFP ECU_ADDRESS 0xd000374b FORMAT "%3.0" /end MEASUREMENT
/begin MEASUREMENT state_efp_can "EFP - state for EOL and ASA diagnosis" UBYTE _CNV_A_R_LINEAR_____0_CM 1 100. 0. 3. DISPLAY_IDENTIFIER STATE_EFP_CAN ECU_ADDRESS 0xd000374c FORMAT "%1.0" /end MEASUREMENT
/begin MEASUREMENT v_eng_efp "Engine voltage of the EFP" UBYTE _CNV_A_R_LINEAR_____83_CM 1 100. 5. 30.5 DISPLAY_IDENTIFIER V_ENG_EFP ECU_ADDRESS 0xd000374d FORMAT "%4.1" /end MEASUREMENT
/begin MEASUREMENT cur_eng_efp "Engine current of the EFP" UBYTE _CNV_A_R_LINEAR_____84_CM 1 100. 0. 25.5 DISPLAY_IDENTIFIER CUR_ENG_EFP ECU_ADDRESS 0xd000374e FORMAT "%4.1" /end MEASUREMENT
/begin MEASUREMENT vb_efp "VB measured by EFP" UBYTE _CNV_A_R_LINEAR_____83_CM 1 100. 5. 30.5 DISPLAY_IDENTIFIER VB_EFP ECU_ADDRESS 0xd0003750 FORMAT "%4.1" /end MEASUREMENT
/begin MEASUREMENT n_efp_av "Engine speed of the EFP" UBYTE _CNV_A_R_LINEAR_____85_CM 1 100. 0. 12750. DISPLAY_IDENTIFIER N_EFP_AV ECU_ADDRESS 0xd000374f FORMAT "%6.0" /end MEASUREMENT
/begin CHARACTERISTIC c_eng_typ_efp "Engine type" VALUE 0xa102935a _REC_VAL_20_u1 1. _CNV_A_R_LINEAR_____0_CM 0. 1. DISPLAY_IDENTIFIER C_ENG_TYP_EFP FORMAT "%1.0" /end CHARACTERISTIC
/begin MEASUREMENT lv_ebox_cfa "control bit EBOX cooling fan" UBYTE _CNV_S_2_RANGE__0___1_CM 1 100. 0. 1. DISPLAY_IDENTIFIER LV_EBOX_CFA ECU_ADDRESS 0xd0003dc4 BIT_MASK 0x1 /end MEASUREMENT
/begin CHARACTERISTIC c_tecu_thd_ebox_cfa "TECU threshold for EBOX cooling fan ON" VALUE 0xa1029a00 _REC_VAL_20_u1 190.5 _CNV_A_R_LINEAR_____16_CM -48. 142.5 DISPLAY_IDENTIFIER C_TECU_THD_EBOX_CFA FORMAT "%5.1" /end CHARACTERISTIC
/begin CHARACTERISTIC c_tecu_hys_ebox_cfa "TECU hysteresis for EBOX cooling fan" VALUE 0xa10299f7 _REC_VAL_20_u1 190.5 _CNV_A_R_LINEAR_____24_CM 0. 190.5 DISPLAY_IDENTIFIER C_TECU_HYS_EBOX_CFA FORMAT "%5.1" /end CHARACTERISTIC
/begin CHARACTERISTIC c_tia_thd_ebox_cfa "TIA threshold for EBOX cooling fan ON" VALUE 0xa1029a57 _REC_VAL_20_u1 190.5 _CNV_A_R_LINEAR_____16_CM -48. 142.5 DISPLAY_IDENTIFIER C_TIA_THD_EBOX_CFA FORMAT "%5.1" /end CHARACTERISTIC
/begin CHARACTERISTIC c_tia_hys_ebox_cfa "TIA hysteresis for EBOX cooling fan" VALUE 0xa1029a4d _REC_VAL_20_u1 190.5 _CNV_A_R_LINEAR_____24_CM 0. 190.5 DISPLAY_IDENTIFIER C_TIA_HYS_EBOX_CFA FORMAT "%5.1" /end CHARACTERISTIC
/begin CHARACTERISTIC c_t_max_ebox_cfa_act "maximum time for activation of EBOX_CFA after Kl.15 on (for diagnosis)" VALUE 0xa10298c0 _REC_VAL_20_u1 255. _CNV_A_R_LINEAR_____35_CM 0. 255. DISPLAY_IDENTIFIER C_T_MAX_EBOX_CFA_ACT FORMAT "%3.0" /end CHARACTERISTIC
/begin CHARACTERISTIC c_n_thd_ebox_cfa_act "N threshold for activation of EBOX_CFA after Kl.15 on (for diagnosis)" VALUE 0xa1029668 _REC_VAL_20_u2 8160. _CNV_A_R_LINEAR_____13_CM 0. 8160. DISPLAY_IDENTIFIER C_N_THD_EBOX_CFA_ACT FORMAT "%4.0" /end CHARACTERISTIC
/begin MEASUREMENT state_vls_eol "Status of lambda sensor EOL diagnosis confused wired" UBYTE _CNV_S_12_STATE_VLS__215_CM 1 100. 0. 24. DISPLAY_IDENTIFIER STATE_VLS_EOL ECU_ADDRESS 0xd0003f68 /end MEASUREMENT
/begin CHARACTERISTIC c_tco_min_vls_eol "TCO threshold for VLS EOL diagnosis" VALUE 0xa10299eb _REC_VAL_20_u1 190.5 _CNV_A_R_LINEAR_____16_CM -48. 142.5 DISPLAY_IDENTIFIER C_TCO_MIN_VLS_EOL FORMAT "%5.1" /end CHARACTERISTIC
/begin CHARACTERISTIC c_teg_cat_down_eol "TEG_CAT_DOWN threshold for VLS EOL diagnosis" VALUE 0xa1029a02 _REC_VAL_20_u2 1507.3 _CNV_A_R_LINEAR_____216_CM -48. 1459.3 DISPLAY_IDENTIFIER C_TEG_CAT_DOWN_EOL FORMAT "%7.2" /end CHARACTERISTIC
/begin CHARACTERISTIC c_maf_int_min_vls_eol "MAF integral threshold for lambda sensor EOL diagnos confused wired" VALUE 0xa1029542 _REC_VAL_20_u2 1820.4167 _CNV_A_R_LINEAR_____217_CM 0. 1820.4167 DISPLAY_IDENTIFIER C_MAF_INT_MIN_VLS_EOL FORMAT "%9.4" /end CHARACTERISTIC
/begin CHARACTERISTIC c_lamb_sp_vls_eol_afr "Lambda setpoint AFR for lambda sensor EOL diagnos confused wired" VALUE 0xa102950c _REC_VAL_20_u2 31.9990234375 _CNV_A_R_LINEAR_____122_CM 0. 31.9990234375 DISPLAY_IDENTIFIER C_LAMB_SP_VLS_EOL_AFR FORMAT "%7.4" /end CHARACTERISTIC
/begin CHARACTERISTIC c_lamb_sp_vls_eol_afl "Lambda setpoint AFL for lambda sensor EOL diagnos confused wired" VALUE 0xa102950a _REC_VAL_20_u2 31.9990234375 _CNV_A_R_LINEAR_____122_CM 0. 31.9990234375 DISPLAY_IDENTIFIER C_LAMB_SP_VLS_EOL_AFL FORMAT "%7.4" /end CHARACTERISTIC
/begin CHARACTERISTIC c_vls_afr_eol "Rich VLS threshold for lambda sensor EOL diagnosis" VALUE 0xa1029c28 _REC_VAL_20_u2 4.995 _CNV_A_R_LINEAR_____218_CM 0. 4.995 DISPLAY_IDENTIFIER C_VLS_AFR_EOL FORMAT "%5.3" /end CHARACTERISTIC
/begin CHARACTERISTIC c_vls_afl_eol "Lean VLS threshold for lambda sensor EOL diagnosis" VALUE 0xa1029c26 _REC_VAL_20_u2 4.995 _CNV_A_R_LINEAR_____218_CM 0. 4.995 DISPLAY_IDENTIFIER C_VLS_AFL_EOL FORMAT "%5.3" /end CHARACTERISTIC
/begin MEASUREMENT maf_int_min_vls_eol "MAF integral for Lambda sensor EOL diagnosis confused wrong wired" UWORD _CNV_A_R_LINEAR_____217_CM 1 100. 0. 1820.4167 DISPLAY_IDENTIFIER MAF_INT_MIN_VLS_EOL ECU_ADDRESS 0xd00053f8 FORMAT "%9.4" /end MEASUREMENT
/begin MEASUREMENT lv_act_vls_eol "Activation bit for lambda sensor EOL diagnos confused wired" UBYTE _CNV_S_2_RANGE__0___1_CM 1 100. 0. 1. DISPLAY_IDENTIFIER LV_ACT_VLS_EOL ECU_ADDRESS 0xd0003f69 BIT_MASK 0x1 /end MEASUREMENT
/begin CHARACTERISTIC c_lamb_ls_up_afr_eol "Rich lambda threshold for lambda sensor EOL diagnosis" VALUE 0xa10294d6 _REC_VAL_20_u2 31.9990234375 _CNV_A_R_LINEAR_____122_CM 0. 31.9990234375 DISPLAY_IDENTIFIER C_LAMB_LS_UP_AFR_EOL FORMAT "%7.4" /end CHARACTERISTIC
/begin CHARACTERISTIC c_lamb_ls_up_afl_eol "Lean lambda threshold for lambda sensor EOL diagnosis" VALUE 0xa10294d4 _REC_VAL_20_u2 31.9990234375 _CNV_A_R_LINEAR_____122_CM 0. 31.9990234375 DISPLAY_IDENTIFIER C_LAMB_LS_UP_AFL_EOL FORMAT "%7.4" /end CHARACTERISTIC
/begin MEASUREMENT lamb_sp_vls_eol[0] "Lambda setpoint for lambda sensor EOL diagnosis confused wired" UWORD _CNV_A_R_LINEAR_____122_CM 1 100. 0. 31.9990234375 DISPLAY_IDENTIFIER LAMB_SP_VLS_EOL[1] ECU_ADDRESS 0xd00053f4 FORMAT "%7.4" /end MEASUREMENT
/begin MEASUREMENT lamb_sp_vls_eol[1] "Lambda setpoint for lambda sensor EOL diagnosis confused wired" UWORD _CNV_A_R_LINEAR_____122_CM 1 100. 0. 31.9990234375 DISPLAY_IDENTIFIER LAMB_SP_VLS_EOL[2] ECU_ADDRESS 0xd00053f6 FORMAT "%7.4" /end MEASUREMENT
/begin MEASUREMENT vls_down_afl_eol[0] "Frozen VLS value for Lambda sensor EOL diagnosis confused wrong wired" UWORD _CNV_A_R_LINEAR_____218_CM 1 100. 0. 4.995 DISPLAY_IDENTIFIER VLS_DOWN_AFL_EOL[1] ECU_ADDRESS 0xd00053fe FORMAT "%5.3" /end MEASUREMENT
/begin MEASUREMENT vls_down_afl_eol[1] "Frozen VLS value for Lambda sensor EOL diagnosis confused wrong wired" UWORD _CNV_A_R_LINEAR_____218_CM 1 100. 0. 4.995 DISPLAY_IDENTIFIER VLS_DOWN_AFL_EOL[2] ECU_ADDRESS 0xd0005400 FORMAT "%5.3" /end MEASUREMENT
/begin MEASUREMENT vls_down_afr_eol[0] "Frozen VLS value for Lambda sensor EOL diagnosis confused wrong wired" UWORD _CNV_A_R_LINEAR_____218_CM 1 100. 0. 4.995 DISPLAY_IDENTIFIER VLS_DOWN_AFR_EOL[1] ECU_ADDRESS 0xd00053fa FORMAT "%5.3" /end MEASUREMENT
/begin MEASUREMENT vls_down_afr_eol[1] "Frozen VLS value for Lambda sensor EOL diagnosis confused wrong wired" UWORD _CNV_A_R_LINEAR_____218_CM 1 100. 0. 4.995 DISPLAY_IDENTIFIER VLS_DOWN_AFR_EOL[2] ECU_ADDRESS 0xd00053fc FORMAT "%5.3" /end MEASUREMENT
/begin MEASUREMENT lamb_ls_up_afl_eol[0] "Frozen VLS value for Lambda sensor EOL diagnosis confused wrong wired" UWORD _CNV_A_R_LINEAR_____122_CM 1 100. 0. 31.9990234375 DISPLAY_IDENTIFIER LAMB_LS_UP_AFL_EOL[1] ECU_ADDRESS 0xd0005406 FORMAT "%7.4" /end MEASUREMENT
/begin MEASUREMENT lamb_ls_up_afl_eol[1] "Frozen VLS value for Lambda sensor EOL diagnosis confused wrong wired" UWORD _CNV_A_R_LINEAR_____122_CM 1 100. 0. 31.9990234375 DISPLAY_IDENTIFIER LAMB_LS_UP_AFL_EOL[2] ECU_ADDRESS 0xd0005408 FORMAT "%7.4" /end MEASUREMENT
/begin MEASUREMENT lamb_ls_up_afr_eol[0] "Frozen VLS value for Lambda sensor EOL diagnosis confused wrong wired" UWORD _CNV_A_R_LINEAR_____122_CM 1 100. 0. 31.9990234375 DISPLAY_IDENTIFIER LAMB_LS_UP_AFR_EOL[1] ECU_ADDRESS 0xd0005402 FORMAT "%7.4" /end MEASUREMENT
/begin MEASUREMENT lamb_ls_up_afr_eol[1] "Frozen VLS value for Lambda sensor EOL diagnosis confused wrong wired" UWORD _CNV_A_R_LINEAR_____122_CM 1 100. 0. 31.9990234375 DISPLAY_IDENTIFIER LAMB_LS_UP_AFR_EOL[2] ECU_ADDRESS 0xd0005404 FORMAT "%7.4" /end MEASUREMENT
/begin MEASUREMENT lamb_sp_ext_adj_1 "bank selective external lambda setpoint (EOL test)" UWORD _CNV_A_R_LINEAR_____122_CM 1 100. 0. 31.9990234375 DISPLAY_IDENTIFIER LAMB_SP_EXT_ADJ_1 ECU_ADDRESS 0xd000540c FORMAT "%7.4" /end MEASUREMENT
/begin MEASUREMENT lamb_sp_ext_adj_2 "bank selective external lambda setpoint (EOL test)" UWORD _CNV_A_R_LINEAR_____122_CM 1 100. 0. 31.9990234375 DISPLAY_IDENTIFIER LAMB_SP_EXT_ADJ_2 ECU_ADDRESS 0xd000540e FORMAT "%7.4" /end MEASUREMENT
/begin MEASUREMENT lv_lamb_sp_ext_adj_1 "FL<g to activate bank selective external lambda setpoint (EOL test)" UBYTE _CNV_S_2_RANGE__0___1_CM 1 100. 0. 1. DISPLAY_IDENTIFIER LV_LAMB_SP_EXT_ADJ_1 ECU_ADDRESS 0xd0003f6c BIT_MASK 0x1 /end MEASUREMENT
/begin MEASUREMENT lv_lamb_sp_ext_adj_2 "FL<g to activate bank selective external lambda setpoint (EOL test)" UBYTE _CNV_S_2_RANGE__0___1_CM 1 100. 0. 1. DISPLAY_IDENTIFIER LV_LAMB_SP_EXT_ADJ_2 ECU_ADDRESS 0xd0003f6d BIT_MASK 0x1 /end MEASUREMENT
/begin CHARACTERISTIC c_add_n_max_fcut "Additive threshold to maximum engine speed for activation fuel cut-off all cylinders" VALUE 0xa1029186 _REC_VAL_20_u2 8160. _CNV_A_R_LINEAR_____13_CM 0. 8160. DISPLAY_IDENTIFIER C_ADD_N_MAX_FCUT FORMAT "%4.0" /end CHARACTERISTIC
/begin CHARACTERISTIC c_n_grd_hys "Hysteresis for N_GRD Filtering" VALUE 0xa10295fc _REC_VAL_20_s1 8160. _CNV_A_R_LINEAR_____29_CM -4096. 4064. DISPLAY_IDENTIFIER C_N_GRD_HYS FORMAT "%5.0" /end CHARACTERISTIC
/begin CHARACTERISTIC c_tqi_max_pas "Passive value indicated engine torque when engine speed limitation is inactive" VALUE 0xa1029b3e _REC_VAL_20_u2 1023.96875 _CNV_A_R_LINEAR_____30_CM 0. 1023.96875 DISPLAY_IDENTIFIER C_TQI_MAX_PAS FORMAT "%7.2" /end CHARACTERISTIC
/begin MEASUREMENT lv_n_max_req_fcut "Logical variable fuel cut-off of all cylinder requested for engine speed limitation" UBYTE _CNV_S_2_RANGE__0___1_CM 1 100. 0. 1. DISPLAY_IDENTIFIER LV_N_MAX_REQ_FCUT ECU_ADDRESS 0xd0003b39 BIT_MASK 0x1 /end MEASUREMENT
/begin MEASUREMENT n_dif_max_lim "Engine speed difference as an input for PI-controller" SWORD _CNV_A_R_LINEAR_____13_CM 1 100. -8160. 8160. DISPLAY_IDENTIFIER N_DIF_MAX_LIM ECU_ADDRESS 0xc0000996 FORMAT "%4.0" /end MEASUREMENT
/begin MEASUREMENT n_pred_max_lim "Predicted engine speed " UWORD _CNV_A_R_LINEAR_____13_CM 1 100. 0. 8160. DISPLAY_IDENTIFIER N_PRED_MAX_LIM ECU_ADDRESS 0xc0000994 FORMAT "%4.0" /end MEASUREMENT
/begin MEASUREMENT tq_n_max_dif "Torque output of N_MAX-PI-Controller" SWORD _CNV_A_R_LINEAR_____30_CM 1 100. -1024. 1023.96875 DISPLAY_IDENTIFIER TQ_N_MAX_DIF ECU_ADDRESS 0xc000099c FORMAT "%6.2" /end MEASUREMENT
/begin MEASUREMENT tq_n_max_dif_i "Torque output of N_MAX-I-Controller" SLONG _CNV_A_R_LINEAR_____239_CM 1 100. -1024. 1023.99999952 DISPLAY_IDENTIFIER TQ_N_MAX_DIF_I ECU_ADDRESS 0xc00009a4 FORMAT "%11.7" /end MEASUREMENT
/begin MEASUREMENT tq_n_max_dif_p "Torque output of N_MAX-P-Controller" SWORD _CNV_A_R_LINEAR_____30_CM 1 100. -1024. 1023.96875 DISPLAY_IDENTIFIER TQ_N_MAX_DIF_P ECU_ADDRESS 0xc000099e FORMAT "%6.2" /end MEASUREMENT
/begin MEASUREMENT tq_n_max_inp_i "Torque input for N_MAX I-controller" SWORD _CNV_A_R_LINEAR_____175_CM 1 100. -4. 3.99987793 DISPLAY_IDENTIFIER TQ_N_MAX_INP_I ECU_ADDRESS 0xc0000998 FORMAT "%5.4" /end MEASUREMENT
/begin MEASUREMENT tqi_n_max "Indicated engine torque setpoint  for N_MAX-limitation" SWORD _CNV_A_R_LINEAR_____30_CM 1 100. -1024. 1023.96875 DISPLAY_IDENTIFIER TQI_N_MAX ECU_ADDRESS 0xd0004f64 FORMAT "%8.2" /end MEASUREMENT
/begin MEASUREMENT tqi_n_max_ref "Reference indicated engine  torque on which controller output is applied" SWORD _CNV_A_R_LINEAR_____30_CM 1 100. -1024. 1023.96875 DISPLAY_IDENTIFIER TQI_N_MAX_REF ECU_ADDRESS 0xc000099a FORMAT "%8.2" /end MEASUREMENT
/begin MEASUREMENT n_grd_fil "Filtered engine speed gradient for predicted engine speed" SBYTE _CNV_A_R_LINEAR_____240_CM 1 100. -4096. 4064. DISPLAY_IDENTIFIER N_GRD_FIL ECU_ADDRESS 0xc00009a8 FORMAT "%4.0" /end MEASUREMENT
/begin CHARACTERISTIC c_crlc_n_grd_fil_1 "N_GRD_FIL low pass filter constant if LV_N_MAX = 0" VALUE 0xa102920e _REC_VAL_20_u2 0.9999847412109381 _CNV_A_R_LINEAR_____68_CM 0. 0.9999847412109381 DISPLAY_IDENTIFIER C_CRLC_N_GRD_FIL_1 FORMAT "%7.5" /end CHARACTERISTIC
/begin CHARACTERISTIC c_crlc_n_grd_fil_2 "N_GRD_FIL low pass filter constant if LV_N_MAX = 1" VALUE 0xa1029210 _REC_VAL_20_u2 0.9999847412109381 _CNV_A_R_LINEAR_____68_CM 0. 0.9999847412109381 DISPLAY_IDENTIFIER C_CRLC_N_GRD_FIL_2 FORMAT "%7.5" /end CHARACTERISTIC
/begin CHARACTERISTIC c_tqi_n_max_inc "Maximum increment for the output when limiting increasing rate" VALUE 0xa1029b44 _REC_VAL_20_u2 1023.96875 _CNV_A_R_LINEAR_____30_CM 0. 1023.96875 DISPLAY_IDENTIFIER C_TQI_N_MAX_INC FORMAT "%7.2" /end CHARACTERISTIC
/begin CHARACTERISTIC id_fac_n_max_i_at__gear "I-control parameter for N_MAX-controller automatic transmission" CURVE 0xa102245c _REC_CUR_20_u2_u1 7.9998779296875 _CNV_A_R_LINEAR_____241_CM 0. 7.9998779296875 DISPLAY_IDENTIFIER ID_FAC_N_MAX_I_AT__GEAR FORMAT "%6.4"
 /begin AXIS_DESCR COM_AXIS gear _CNV_A_R_LINEAR_____0_CM 9 0. 255. FORMAT "%3.0" AXIS_PTS_REF ldpm_gear /end AXIS_DESCR
/end CHARACTERISTIC
/begin CHARACTERISTIC id_fac_n_max_p_mt__gear "P-control parameter for N_MAX-controller manual transmission" CURVE 0xa1022490 _REC_CUR_20_u1_u1 7.96875 _CNV_A_R_LINEAR_____242_CM 0. 7.96875 DISPLAY_IDENTIFIER ID_FAC_N_MAX_P_MT__GEAR FORMAT "%4.2"
 /begin AXIS_DESCR COM_AXIS gear _CNV_A_R_LINEAR_____0_CM 9 0. 255. FORMAT "%3.0" AXIS_PTS_REF ldpm_gear /end AXIS_DESCR
/end CHARACTERISTIC
/begin CHARACTERISTIC id_fac_n_max_i_mt__gear "I-control parameter for N_MAX-controller manual transmission" CURVE 0xa1022470 _REC_CUR_20_u2_u1 7.9998779296875 _CNV_A_R_LINEAR_____241_CM 0. 7.9998779296875 DISPLAY_IDENTIFIER ID_FAC_N_MAX_I_MT__GEAR FORMAT "%6.4"
 /begin AXIS_DESCR COM_AXIS gear _CNV_A_R_LINEAR_____0_CM 9 0. 255. FORMAT "%3.0" AXIS_PTS_REF ldpm_gear /end AXIS_DESCR
/end CHARACTERISTIC
/begin CHARACTERISTIC id_fac_n_max_p_at__gear "P-control parameter for N_MAX-controller automatic transmission" CURVE 0xa1022484 _REC_CUR_20_u1_u1 7.96875 _CNV_A_R_LINEAR_____242_CM 0. 7.96875 DISPLAY_IDENTIFIER ID_FAC_N_MAX_P_AT__GEAR FORMAT "%4.2"
 /begin AXIS_DESCR COM_AXIS gear _CNV_A_R_LINEAR_____0_CM 9 0. 255. FORMAT "%3.0" AXIS_PTS_REF ldpm_gear /end AXIS_DESCR
/end CHARACTERISTIC
/begin CHARACTERISTIC id_t_n_max_pred_at__gear "Prediction time for predicted engine speed for automatic transmission" CURVE 0xa1022f7c _REC_CUR_20_u1_u1 7.96875 _CNV_A_R_LINEAR_____183_CM 0. 7.96875 DISPLAY_IDENTIFIER ID_T_N_MAX_PRED_AT__GEAR FORMAT "%4.2"
 /begin AXIS_DESCR COM_AXIS gear _CNV_A_R_LINEAR_____0_CM 9 0. 255. FORMAT "%3.0" AXIS_PTS_REF ldpm_gear /end AXIS_DESCR
/end CHARACTERISTIC
/begin CHARACTERISTIC id_t_n_max_pred_mt__gear "Prediction time for predicted engine speed for manual transmission" CURVE 0xa1022f88 _REC_CUR_20_u1_u1 7.96875 _CNV_A_R_LINEAR_____183_CM 0. 7.96875 DISPLAY_IDENTIFIER ID_T_N_MAX_PRED_MT__GEAR FORMAT "%4.2"
 /begin AXIS_DESCR COM_AXIS gear _CNV_A_R_LINEAR_____0_CM 9 0. 255. FORMAT "%3.0" AXIS_PTS_REF ldpm_gear /end AXIS_DESCR
/end CHARACTERISTIC
/begin CHARACTERISTIC ip_n_grd_thd__n_32 "Engine speed gradient threshold for filtering of basic engine speed gradient" CURVE 0xa1026338 _REC_CUR_20_u1_u1 8160. _CNV_A_R_LINEAR_____180_CM -4096. 4064. DISPLAY_IDENTIFIER IP_N_GRD_THD__N_32 FORMAT "%5.0"
 /begin AXIS_DESCR COM_AXIS n_32 _CNV_A_R_LINEAR_____9_CM 8 0. 8160. FORMAT "%4.0" AXIS_PTS_REF ldp_n_32_n_grd_thd /end AXIS_DESCR
/end CHARACTERISTIC
/begin MEASUREMENT n_grd_fil_fil "Low pass filtered engine speed gradient for predicted engine speed" SBYTE _CNV_A_R_LINEAR_____240_CM 1 100. -4096. 4064. DISPLAY_IDENTIFIER N_GRD_FIL_FIL ECU_ADDRESS 0xc00009a9 FORMAT "%4.0" /end MEASUREMENT
/begin MEASUREMENT tqi_n_max_1 "Intermitted indicated engine torque after considering PI-controller output" SWORD _CNV_A_R_LINEAR_____30_CM 1 100. -1024. 1023.96875 DISPLAY_IDENTIFIER TQI_N_MAX_1 ECU_ADDRESS 0xc00009a0 FORMAT "%8.2" /end MEASUREMENT
/begin MEASUREMENT tqi_n_max_2 "Intermitted indicated engine torque after considering PI-controller output" SWORD _CNV_A_R_LINEAR_____30_CM 1 100. -1024. 1023.96875 DISPLAY_IDENTIFIER TQI_N_MAX_2 ECU_ADDRESS 0xc00009a2 FORMAT "%8.2" /end MEASUREMENT
/begin MEASUREMENT lv_n_max "Logical variable engine speed limitation active" UBYTE _CNV_S_2_RANGE__0___1_CM 1 100. 0. 1. DISPLAY_IDENTIFIER LV_N_MAX ECU_ADDRESS 0xd0003b38 BIT_MASK 0x1 /end MEASUREMENT
/begin AXIS_PTS ldp_n_32_n_grd_thd "" 0xa1020e68 n_32 _REC_AXS_20_u1 8160. _CNV_A_R_LINEAR_____9_CM 8 0. 8160. FORMAT "%4.0" /end AXIS_PTS
/begin AXIS_PTS ldpm_gear "" 0xa1021acc gear _REC_AXS_20_u1 255. _CNV_A_R_LINEAR_____0_CM 9 0. 255. FORMAT "%3.0" /end AXIS_PTS
/begin CHARACTERISTIC c_fac_tqi_n_max_ref "Factor on TQI_N_MAX_REF value to init. I-controller" VALUE 0xa10293c9 _REC_VAL_20_u1 0.99609375 _CNV_A_R_LINEAR_____71_CM 0. 0.99609375 DISPLAY_IDENTIFIER C_FAC_TQI_N_MAX_REF FORMAT "%5.3" /end CHARACTERISTIC
/begin MEASUREMENT n_max "highest engine speed reached" UWORD _CNV_A_R_LINEAR_____13_CM 1 100. 1. 8160. DISPLAY_IDENTIFIER N_MAX ECU_ADDRESS 0xd0004f70 FORMAT "%4.0" /end MEASUREMENT
/begin MEASUREMENT trt_n_max "total running time in case of maximum engine speed reached" ULONG _CNV_A_R_LINEAR_____137_CM 1 100. 0. 119304.6471 DISPLAY_IDENTIFIER TRT_N_MAX ECU_ADDRESS 0xd00056fc FORMAT "%12.5" /end MEASUREMENT
/begin CHARACTERISTIC c_n_lim_min "Engine speed threshold for overrevving event" VALUE 0xa102960a _REC_VAL_20_u2 8160. _CNV_A_R_LINEAR_____13_CM 0. 8160. DISPLAY_IDENTIFIER C_N_LIM_MIN FORMAT "%4.0" /end CHARACTERISTIC
/begin MEASUREMENT ctr_n_max "event frequency counter" UBYTE _CNV_A_R_LINEAR_____0_CM 1 100. 0. 255. DISPLAY_IDENTIFIER CTR_N_MAX ECU_ADDRESS 0xd0003b40 FORMAT "%3.0" /end MEASUREMENT
/begin MEASUREMENT ctr_km_n_max "km counter at highest event" UWORD _CNV_A_R_LINEAR_____70_CM 1 100. 0. 655350. DISPLAY_IDENTIFIER CTR_KM_N_MAX ECU_ADDRESS 0xd0004f72 FORMAT "%7.0" /end MEASUREMENT
/begin MEASUREMENT n_grd_n_max "engine speed gradient at highest event" SBYTE _CNV_A_R_LINEAR_____9_CM 1 100. -4096. 4064. DISPLAY_IDENTIFIER N_GRD_N_MAX ECU_ADDRESS 0xd0003b45 FORMAT "%5.0" /end MEASUREMENT
/begin MEASUREMENT vs_n_max "vehicle speed at highest event" UBYTE _CNV_A_R_LINEAR_____6_CM 1 100. 0. 255. DISPLAY_IDENTIFIER VS_N_MAX ECU_ADDRESS 0xd0003b41 FORMAT "%3.0" /end MEASUREMENT
/begin MEASUREMENT pv_av_n_max "pedal value at highest event" UBYTE _CNV_A_R_LINEAR_____5_CM 1 100. 0. 99.609375 DISPLAY_IDENTIFIER PV_AV_N_MAX ECU_ADDRESS 0xd0003b42 FORMAT "%4.1" /end MEASUREMENT
/begin MEASUREMENT gear_ef_n_max "gear ratio at highest event" UBYTE _CNV_A_R_LINEAR_____0_CM 1 100. 0. 255. DISPLAY_IDENTIFIER GEAR_EF_N_MAX ECU_ADDRESS 0xd0003b43 FORMAT "%3.0" /end MEASUREMENT
/begin MEASUREMENT lv_cs_n_max "clutch switch detection at highest event" UBYTE _CNV_S_2_RANGE__0___1_CM 1 100. 0. 1. DISPLAY_IDENTIFIER LV_CS_N_MAX ECU_ADDRESS 0xd0003b46 BIT_MASK 0x1 /end MEASUREMENT
/begin MEASUREMENT t_sum_n_max "time sum of all events maximum engine speed reached" UWORD _CNV_A_R_LINEAR_____4_CM 1 100. 0. 6553.5 DISPLAY_IDENTIFIER T_SUM_N_MAX ECU_ADDRESS 0xd0004f74 FORMAT "%6.1" /end MEASUREMENT
/begin MEASUREMENT t_n_max "time sum at highest event" UWORD _CNV_A_R_LINEAR_____4_CM 1 100. 0. 6553.5 DISPLAY_IDENTIFIER T_N_MAX ECU_ADDRESS 0xd0004f76 FORMAT "%6.1" /end MEASUREMENT
/begin MEASUREMENT nr_pat_scc_n_max "selected index off fuel cut off pattern at highest event" UBYTE _CNV_A_R_LINEAR_____0_CM 1 100. 0. 255. DISPLAY_IDENTIFIER NR_PAT_SCC_N_MAX ECU_ADDRESS 0xd0003b44 FORMAT "%3.0" /end MEASUREMENT
/begin CHARACTERISTIC lc_ad_clr_lam "Logical constant for initializing LAMBDA nvmy data" VALUE 0xa1029cf3 _REC_VAL_20_u1 1. _CNV_A_R_LINEAR_____0_CM 0. 1. DISPLAY_IDENTIFIER LC_AD_CLR_LAM FORMAT "%2.0" /end CHARACTERISTIC
/begin CHARACTERISTIC lc_ad_clr_tps "Logical constant for initializing TPS nvmy data" VALUE 0xa1029d01 _REC_VAL_20_u1 1. _CNV_A_R_LINEAR_____0_CM 0. 1. DISPLAY_IDENTIFIER LC_AD_CLR_TPS FORMAT "%2.0" /end CHARACTERISTIC
/begin CHARACTERISTIC lc_ad_clr_mis "Logical constant for initializing MISFIRE nvmy data" VALUE 0xa1029cf5 _REC_VAL_20_u1 1. _CNV_A_R_LINEAR_____0_CM 0. 1. DISPLAY_IDENTIFIER LC_AD_CLR_MIS FORMAT "%2.0" /end CHARACTERISTIC
/begin CHARACTERISTIC lc_ad_clr_ivvt "Logical constant for initializing IVVT nvmy data" VALUE 0xa1029cf1 _REC_VAL_20_u1 1. _CNV_A_R_LINEAR_____0_CM 0. 1. DISPLAY_IDENTIFIER LC_AD_CLR_IVVT FORMAT "%2.0" /end CHARACTERISTIC
/begin CHARACTERISTIC lc_ad_clr_ati "Logical constant for initializing ATI nvmy data" VALUE 0xa1029ce3 _REC_VAL_20_u1 1. _CNV_A_R_LINEAR_____0_CM 0. 1. DISPLAY_IDENTIFIER LC_AD_CLR_ATI FORMAT "%2.0" /end CHARACTERISTIC
/begin CHARACTERISTIC lc_ad_clr_toil "Logical constant for initializing TOIL nvmy data" VALUE 0xa1029cff _REC_VAL_20_u1 1. _CNV_A_R_LINEAR_____0_CM 0. 1. DISPLAY_IDENTIFIER LC_AD_CLR_TOIL FORMAT "%2.0" /end CHARACTERISTIC
/begin CHARACTERISTIC lc_ad_clr_n_sp_is "Logical constant for initializing N_SP_IS nvmy data" VALUE 0xa1029cf7 _REC_VAL_20_u1 1. _CNV_A_R_LINEAR_____0_CM 0. 1. DISPLAY_IDENTIFIER LC_AD_CLR_N_SP_IS FORMAT "%2.0" /end CHARACTERISTIC
/begin CHARACTERISTIC lc_ad_clr_ron "Logical constant for initializing RON nvmy data" VALUE 0xa1029cfc _REC_VAL_20_u1 1. _CNV_A_R_LINEAR_____0_CM 0. 1. DISPLAY_IDENTIFIER LC_AD_CLR_RON FORMAT "%2.0" /end CHARACTERISTIC
/begin CHARACTERISTIC lc_ad_clr_tecu "Logical constant for initializing TECU nvmy data" VALUE 0xa1029cfe _REC_VAL_20_u1 1. _CNV_A_R_LINEAR_____0_CM 0. 1. DISPLAY_IDENTIFIER LC_AD_CLR_TECU FORMAT "%2.0" /end CHARACTERISTIC
/begin CHARACTERISTIC lc_ad_clr_var "Logical constant for initializing VAR nvmy data" VALUE 0xa1029d04 _REC_VAL_20_u1 1. _CNV_A_R_LINEAR_____0_CM 0. 1. DISPLAY_IDENTIFIER LC_AD_CLR_VAR FORMAT "%2.0" /end CHARACTERISTIC
/begin CHARACTERISTIC lc_ad_clr_dmtl "Logical constant for initializing DMTL nvmy data" VALUE 0xa1029ce8 _REC_VAL_20_u1 1. _CNV_A_R_LINEAR_____0_CM 0. 1. DISPLAY_IDENTIFIER LC_AD_CLR_DMTL FORMAT "%2.0" /end CHARACTERISTIC
/begin CHARACTERISTIC lc_ad_clr_sof "Logical constant for initializing the sound flap / sport switch" VALUE 0xa1029cfd _REC_VAL_20_u1 1. _CNV_A_R_LINEAR_____0_CM 0. 1. DISPLAY_IDENTIFIER LC_AD_CLR_SOF FORMAT "%2.0" /end CHARACTERISTIC
/begin CHARACTERISTIC lc_ad_clr_n_max "Logical constant for initializing the N_MAX nvmy data" VALUE 0xa1029cf6 _REC_VAL_20_u1 1. _CNV_A_R_LINEAR_____0_CM 0. 1. DISPLAY_IDENTIFIER LC_AD_CLR_N_MAX FORMAT "%2.0" /end CHARACTERISTIC
/begin CHARACTERISTIC lc_ad_clr_lif "Logical constant for initializing LIF" VALUE 0xa1029cf4 _REC_VAL_20_u1 1. _CNV_A_R_LINEAR_____0_CM 0. 1. DISPLAY_IDENTIFIER LC_AD_CLR_LIF FORMAT "%2.0" /end CHARACTERISTIC
/begin CHARACTERISTIC lc_ad_clr_tqi_lim "Logical constant for initializing TQI_LIM" VALUE 0xa1029d02 _REC_VAL_20_u1 1. _CNV_A_R_LINEAR_____0_CM 0. 1. DISPLAY_IDENTIFIER LC_AD_CLR_TQI_LIM FORMAT "%2.0" /end CHARACTERISTIC
/begin CHARACTERISTIC lc_ad_clr "Logical constant for initializing AD" VALUE 0xa1029ce2 _REC_VAL_20_u1 1. _CNV_A_R_LINEAR_____0_CM 0. 1. DISPLAY_IDENTIFIER LC_AD_CLR FORMAT "%2.0" /end CHARACTERISTIC
/begin CHARACTERISTIC lc_ad_clr_obd2 "Logical constant for initializing OBDII" VALUE 0xa1029cf9 _REC_VAL_20_u1 1. _CNV_A_R_LINEAR_____0_CM 0. 1. DISPLAY_IDENTIFIER LC_AD_CLR_OBD2 FORMAT "%2.0" /end CHARACTERISTIC
/begin CHARACTERISTIC lc_ad_clr_cru "Logical constant for initializing CRU" VALUE 0xa1029ce7 _REC_VAL_20_u1 1. _CNV_A_R_LINEAR_____0_CM 0. 1. DISPLAY_IDENTIFIER LC_AD_CLR_CRU FORMAT "%2.0" /end CHARACTERISTIC
/begin MEASUREMENT lv_nvmy_rd_failed "Reading from NVMY failed due to TRL or CHK error" UBYTE _CNV_S_2_RANGE__0___1_CM 1 100. 0. 1. DISPLAY_IDENTIFIER LV_NVMY_RD_FAILED ECU_ADDRESS 0xd0003ba0 BIT_MASK 0x1 /end MEASUREMENT
/begin CHARACTERISTIC lc_ad_clr_can "Logical constant for initializing CAN nvmy data" VALUE 0xa1029ce5 _REC_VAL_20_u1 1. _CNV_A_R_LINEAR_____0_CM 0. 1. DISPLAY_IDENTIFIER LC_AD_CLR_CAN FORMAT "%2.0" /end CHARACTERISTIC
/begin CHARACTERISTIC lc_ad_clr_pste "Logical constant for initializing PSTE nvmy data" VALUE 0xa1029cfb _REC_VAL_20_u1 1. _CNV_A_R_LINEAR_____0_CM 0. 1. DISPLAY_IDENTIFIER LC_AD_CLR_PSTE FORMAT "%2.0" /end CHARACTERISTIC
/begin CHARACTERISTIC lc_ad_clr_toil_max "Logical constant for initializing TOIL_MAX nvmy data" VALUE 0xa1029d00 _REC_VAL_20_u1 1. _CNV_A_R_LINEAR_____0_CM 0. 1. DISPLAY_IDENTIFIER LC_AD_CLR_TOIL_MAX FORMAT "%2.0" /end CHARACTERISTIC
/begin CHARACTERISTIC lc_ad_clr_nox "Logical constant for initializing NOx nvmy data" VALUE 0xa1029cf8 _REC_VAL_20_u1 1. _CNV_A_R_LINEAR_____0_CM 0. 1. DISPLAY_IDENTIFIER LC_AD_CLR_NOX FORMAT "%2.0" /end CHARACTERISTIC
/begin CHARACTERISTIC lc_ad_clr_ente "Logical constant for initializing ENTE nvmy data" VALUE 0xa1029ced _REC_VAL_20_u1 1. _CNV_A_R_LINEAR_____0_CM 0. 1. DISPLAY_IDENTIFIER LC_AD_CLR_ENTE FORMAT "%2.0" /end CHARACTERISTIC
/begin CHARACTERISTIC lc_ad_clr_enrd "Logical constant for initializing NOx nvmy data" VALUE 0xa1029ceb _REC_VAL_20_u1 1. _CNV_A_R_LINEAR_____0_CM 0. 1. DISPLAY_IDENTIFIER LC_AD_CLR_ENRD FORMAT "%2.0" /end CHARACTERISTIC
/begin MEASUREMENT lv_nvmy_cus_wrg "0: reading of customer adaptation block in the E2PROM was successful // 1: not sucessful" UBYTE _CNV_S_2_RANGE__0___1_CM 1 100. 0. 1. DISPLAY_IDENTIFIER LV_NVMY_CUS_WRG ECU_ADDRESS 0xd00038d0 BIT_MASK 0x1 /end MEASUREMENT
/begin CHARACTERISTIC lc_ad_clr_ensd "Logical constant for initializing ENSD nvmy data" VALUE 0xa1029cec _REC_VAL_20_u1 1. _CNV_A_R_LINEAR_____0_CM 0. 1. DISPLAY_IDENTIFIER LC_AD_CLR_ENSD FORMAT "%2.0" /end CHARACTERISTIC
/begin CHARACTERISTIC lc_ad_clr_extd "Logical constant for initializing the EXTD nvmy data" VALUE 0xa1029cee _REC_VAL_20_u1 1. _CNV_A_R_LINEAR_____0_CM 0. 1. DISPLAY_IDENTIFIER LC_AD_CLR_EXTD FORMAT "%2.0" /end CHARACTERISTIC
/begin CHARACTERISTIC lc_ad_clr_bal "Logical constant for initializing BAL nvmy data" VALUE 0xa1029ce4 _REC_VAL_20_u1 1. _CNV_A_R_LINEAR_____0_CM 0. 1. DISPLAY_IDENTIFIER LC_AD_CLR_BAL FORMAT "%2.0" /end CHARACTERISTIC
/begin CHARACTERISTIC lc_ad_clr_ccp "Logical constant for initializing CCP nvmy data" VALUE 0xa1029ce6 _REC_VAL_20_u1 1. _CNV_A_R_LINEAR_____0_CM 0. 1. DISPLAY_IDENTIFIER LC_AD_CLR_CCP FORMAT "%2.0" /end CHARACTERISTIC
/begin CHARACTERISTIC lc_ad_clr_tqlo "Logical constant for initializing TQLO nvmy data" VALUE 0xa1029d03 _REC_VAL_20_u1 1. _CNV_A_R_LINEAR_____0_CM 0. 1. DISPLAY_IDENTIFIER LC_AD_CLR_TQLO FORMAT "%2.0" /end CHARACTERISTIC
/begin CHARACTERISTIC lc_ad_clr_pow "Logical constant for initializing POW nvmy data" VALUE 0xa1029cfa _REC_VAL_20_u1 1. _CNV_A_R_LINEAR_____0_CM 0. 1. DISPLAY_IDENTIFIER LC_AD_CLR_POW FORMAT "%2.0" /end CHARACTERISTIC
/begin CHARACTERISTIC lc_ad_clr_laco "Logical constant for initializing LACO nvmy data" VALUE 0xa1029cf2 _REC_VAL_20_u1 1. _CNV_A_R_LINEAR_____0_CM 0. 1. DISPLAY_IDENTIFIER LC_AD_CLR_LACO FORMAT "%2.0" /end CHARACTERISTIC
/begin CHARACTERISTIC lc_ad_clr_egr "Logical constant for initializing EGR nvmy data" VALUE 0xa1029cea _REC_VAL_20_u1 1. _CNV_A_R_LINEAR_____0_CM 0. 1. DISPLAY_IDENTIFIER LC_AD_CLR_EGR FORMAT "%2.0" /end CHARACTERISTIC
/begin CHARACTERISTIC lc_ad_clr_egcp "Logical constant for initializing EGCP nvmy data" VALUE 0xa1029ce9 _REC_VAL_20_u1 1. _CNV_A_R_LINEAR_____0_CM 0. 1. DISPLAY_IDENTIFIER LC_AD_CLR_EGCP FORMAT "%2.0" /end CHARACTERISTIC
/begin MEASUREMENT pwl_lock_cdn "power latch extension by project specific configuration:" UWORD _CNV_A_R_LINEAR_____0_CM 1 100. 0. 65535. DISPLAY_IDENTIFIER PWL_LOCK_CDN ECU_ADDRESS 0xd0005036 /end MEASUREMENT
/begin MEASUREMENT t_pwl "incrementing timer during PWL phase active" UWORD _CNV_A_R_LINEAR_____4_CM 1 100. 0. 6553.5 DISPLAY_IDENTIFIER T_PWL ECU_ADDRESS 0xd0005034 FORMAT "%6.1" /end MEASUREMENT
/begin MEASUREMENT lv_pwl_act "power latch phase active" UBYTE _CNV_S_2_RANGE__0___1_CM 1 100. 0. 1. DISPLAY_IDENTIFIER LV_PWL_ACT ECU_ADDRESS 0xc0000b88 BIT_MASK 0x1 /end MEASUREMENT
/begin MEASUREMENT lv_inh_pwl_tran_es_el "flag active in shut down phase: IGK on is not accepted without reset" UBYTE _CNV_S_2_RANGE__0___1_CM 1 100. 0. 1. DISPLAY_IDENTIFIER LV_INH_PWL_TRAN_ES_EL ECU_ADDRESS 0xd0003bd0 BIT_MASK 0x1 /end MEASUREMENT
/begin CHARACTERISTIC c_t_min_pwl "minimum power latch time for ECU switch off" VALUE 0xa1029908 _REC_VAL_20_u2 6553.5 _CNV_A_R_LINEAR_____4_CM 0. 6553.5 DISPLAY_IDENTIFIER C_T_MIN_PWL FORMAT "%6.1" /end CHARACTERISTIC
/begin CHARACTERISTIC c_t_max_pwl "maximum power latch time for ECU switch off" VALUE 0xa10298cc _REC_VAL_20_u2 6553.5 _CNV_A_R_LINEAR_____4_CM 0. 6553.5 DISPLAY_IDENTIFIER C_T_MAX_PWL FORMAT "%6.1" /end CHARACTERISTIC
/begin MEASUREMENT lv_rly_st "Starter relay" UBYTE _CNV_S_2_RANGE__0___1_CM 1 100. 0. 1. DISPLAY_IDENTIFIER LV_RLY_ST ECU_ADDRESS 0xd0003dc8 BIT_MASK 0x1 /end MEASUREMENT
/begin CHARACTERISTIC c_vim_av_3 "VIM_AV for flap 1 opened, flap 2 closed" VALUE 0xa1029c12 _REC_VAL_20_u2 199.9969 _CNV_A_R_LINEAR_____290_CM 0. 199.9969 DISPLAY_IDENTIFIER C_VIM_AV_3 FORMAT "%7.3" /end CHARACTERISTIC
/begin CHARACTERISTIC c_n_vim_l "Lower engine speed threshold" VALUE 0xa1029672 _REC_VAL_20_u2 8160. _CNV_A_R_LINEAR_____13_CM 0. 8160. DISPLAY_IDENTIFIER C_N_VIM_L FORMAT "%4.0" /end CHARACTERISTIC
/begin CHARACTERISTIC c_n_vim_hys "engine speed threshold hysteresis" VALUE 0xa1029670 _REC_VAL_20_u2 8160. _CNV_A_R_LINEAR_____13_CM 0. 8160. DISPLAY_IDENTIFIER C_N_VIM_HYS FORMAT "%4.0" /end CHARACTERISTIC
/begin CHARACTERISTIC c_fac_maf_max_vim "load threshold" VALUE 0xa1029388 _REC_VAL_20_u2 1.99996948242188 _CNV_A_R_LINEAR_____8_CM 0. 1.99996948242188 DISPLAY_IDENTIFIER C_FAC_MAF_MAX_VIM FORMAT "%7.5" /end CHARACTERISTIC
/begin CHARACTERISTIC c_fac_maf_max_vim_hys "load threshold hysteresis" VALUE 0xa102938a _REC_VAL_20_u2 1.99996948242188 _CNV_A_R_LINEAR_____8_CM 0. 1.99996948242188 DISPLAY_IDENTIFIER C_FAC_MAF_MAX_VIM_HYS FORMAT "%7.5" /end CHARACTERISTIC
/begin CHARACTERISTIC ip_fac_n_vim "TIA - and load-correction for VIM switch thresholds" MAP 0xa1023b78 _REC_MAP_20_u1_u1_u2 1.9921875 _CNV_A_R_LINEAR_____100_CM 0. 1.9921875 DISPLAY_IDENTIFIER IP_FAC_N_VIM FORMAT "%5.3"
 /begin AXIS_DESCR COM_AXIS n_32 _CNV_A_R_LINEAR_____9_CM 8 0. 8160. FORMAT "%4.0" AXIS_PTS_REF ldp_n_32_fac_n_vim /end AXIS_DESCR
 /begin AXIS_DESCR COM_AXIS fac_maf_max _CNV_A_R_LINEAR_____8_CM 6 0. 1.99996948242188 FORMAT "%7.5" AXIS_PTS_REF ldp_fac_maf_max_ip_fac_n_vim /end AXIS_DESCR
/end CHARACTERISTIC
/begin MEASUREMENT n_vim "???" UWORD _CNV_A_R_LINEAR_____13_CM 1 100. 0. 8160. DISPLAY_IDENTIFIER N_VIM ECU_ADDRESS 0xd0005214 FORMAT "%4.0" /end MEASUREMENT
/begin MEASUREMENT vim_av "Actual position variable intake manifold" UWORD _CNV_A_R_LINEAR_____290_CM 1 100. 0. 199.9969 DISPLAY_IDENTIFIER VIM_AV ECU_ADDRESS 0xd0005216 FORMAT "%7.3" /end MEASUREMENT
/begin CHARACTERISTIC c_vim_av_4 "VIM_AV for flap 1 closed, flap 2 opened" VALUE 0xa1029c14 _REC_VAL_20_u2 199.9969 _CNV_A_R_LINEAR_____290_CM 0. 199.9969 DISPLAY_IDENTIFIER C_VIM_AV_4 FORMAT "%7.3" /end CHARACTERISTIC
/begin CHARACTERISTIC c_vim_av_2 "VIM_AV for both flaps closed" VALUE 0xa1029c10 _REC_VAL_20_u2 199.9969 _CNV_A_R_LINEAR_____290_CM 0. 199.9969 DISPLAY_IDENTIFIER C_VIM_AV_2 FORMAT "%7.3" /end CHARACTERISTIC
/begin CHARACTERISTIC c_vim_av_1 "VIM_AV for both flaps opened" VALUE 0xa1029c0e _REC_VAL_20_u2 199.9969 _CNV_A_R_LINEAR_____290_CM 0. 199.9969 DISPLAY_IDENTIFIER C_VIM_AV_1 FORMAT "%7.3" /end CHARACTERISTIC
/begin MEASUREMENT vimpwm_1 "pulse width modulated signal for actuator DISA_1" SWORD _CNV_A_R_LINEAR_____201_CM 1 100. -100. 99.9969482421875 DISPLAY_IDENTIFIER VIMPWM_1 ECU_ADDRESS 0xd0005218 FORMAT "%8.3" /end MEASUREMENT
/begin MEASUREMENT vimpwm_2 "pulse width modulated signal for actuator DISA_2" SWORD _CNV_A_R_LINEAR_____201_CM 1 100. -100. 99.9969482421875 DISPLAY_IDENTIFIER VIMPWM_2 ECU_ADDRESS 0xd000521a FORMAT "%8.3" /end MEASUREMENT
/begin MEASUREMENT lv_vim "VIM power stage (2-stage-DISA); 0 passive, 1 active" UBYTE _CNV_S_2_RANGE__0___1_CM 1 100. 0. 1. DISPLAY_IDENTIFIER LV_VIM ECU_ADDRESS 0xd0003de0 BIT_MASK 0x1 /end MEASUREMENT
/begin MEASUREMENT lv_vim_rls "Conditions for releas of VIM function are met" UBYTE _CNV_S_2_RANGE__0___1_CM 1 100. 0. 1. DISPLAY_IDENTIFIER LV_VIM_RLS ECU_ADDRESS 0xd0003de1 BIT_MASK 0x1 /end MEASUREMENT
/begin MEASUREMENT lv_vim_1 "setpoint VIM flap 1, 0:closed, 1: opened" UBYTE _CNV_S_2_RANGE__0___1_CM 1 100. 0. 1. DISPLAY_IDENTIFIER LV_VIM_1 ECU_ADDRESS 0xc0000e04 BIT_MASK 0x1 /end MEASUREMENT
/begin MEASUREMENT lv_vim_2 "setpoint VIM flap 2, 0:closed, 1: opened" UBYTE _CNV_S_2_RANGE__0___1_CM 1 100. 0. 1. DISPLAY_IDENTIFIER LV_VIM_2 ECU_ADDRESS 0xc0000e05 BIT_MASK 0x1 /end MEASUREMENT
/begin MEASUREMENT t_open_vim_deac "Timer to open the VIM flaps before deactivating the VIM function" UBYTE _CNV_A_R_LINEAR_____3_CM 1 100. 0. 2.55 DISPLAY_IDENTIFIER T_OPEN_VIM_DEAC ECU_ADDRESS 0xc0000e02 FORMAT "%4.2" /end MEASUREMENT
/begin CHARACTERISTIC c_vb_min_vim "minimum battery voltage to release VIM function" VALUE 0xa1029be3 _REC_VAL_20_u1 7.76953125 _CNV_A_R_LINEAR_____289_CM 0. 25.8984375 DISPLAY_IDENTIFIER C_VB_MIN_VIM FORMAT "%9.6" /end CHARACTERISTIC
/begin CHARACTERISTIC c_vb_max_vim "maximum battery voltage to release VIM function" VALUE 0xa1029bd2 _REC_VAL_20_u1 7.76953125 _CNV_A_R_LINEAR_____289_CM 0. 25.8984375 DISPLAY_IDENTIFIER C_VB_MAX_VIM FORMAT "%9.6" /end CHARACTERISTIC
/begin CHARACTERISTIC c_n_vim_h "Higher engine speed threshold" VALUE 0xa102966e _REC_VAL_20_u2 8160. _CNV_A_R_LINEAR_____13_CM 0. 8160. DISPLAY_IDENTIFIER C_N_VIM_H FORMAT "%4.0" /end CHARACTERISTIC
/begin CHARACTERISTIC c_n_vim_mid "Medium engine speed threshold" VALUE 0xa1029674 _REC_VAL_20_u2 8160. _CNV_A_R_LINEAR_____13_CM 0. 8160. DISPLAY_IDENTIFIER C_N_VIM_MID FORMAT "%4.0" /end CHARACTERISTIC
/begin CHARACTERISTIC lc_pwm_vim_man "Logical constant to enable manual setting of VIMPWM_1/2 by calibration system" VALUE 0xa1029dbd _REC_VAL_20_u1 1. _CNV_S_2_RANGE__0___1_CM 0. 1. DISPLAY_IDENTIFIER LC_PWM_VIM_MAN /end CHARACTERISTIC
/begin CHARACTERISTIC c_state_vim_1_sp_man "manual setting of the setpoint VIM flap 1 by calibration system, 0:closed, 1: opened" VALUE 0xa10297ca _REC_VAL_20_u1 1. _CNV_A_R_LINEAR_____0_CM 0. 1. DISPLAY_IDENTIFIER C_STATE_VIM_1_SP_MAN FORMAT "%1.0" /end CHARACTERISTIC
/begin CHARACTERISTIC c_state_vim_2_sp_man "manual setting of the setpoint VIM flap 2 by calibration system, 0:closed, 1: opened" VALUE 0xa10297cb _REC_VAL_20_u1 1. _CNV_A_R_LINEAR_____0_CM 0. 1. DISPLAY_IDENTIFIER C_STATE_VIM_2_SP_MAN FORMAT "%1.0" /end CHARACTERISTIC
/begin CHARACTERISTIC c_vimpwm_pas "VIMPWM \"passive\"" VALUE 0xa1029c24 _REC_VAL_20_s2 199.9969482421875 _CNV_A_R_LINEAR_____201_CM -100. 99.9969482421875 DISPLAY_IDENTIFIER C_VIMPWM_PAS FORMAT "%8.3" /end CHARACTERISTIC
/begin CHARACTERISTIC c_pwm_vim_close "PWM to close VIM flap" VALUE 0xa1029778 _REC_VAL_20_s2 199.9969482421875 _CNV_A_R_LINEAR_____201_CM -100. 99.9969482421875 DISPLAY_IDENTIFIER C_PWM_VIM_CLOSE FORMAT "%8.3" /end CHARACTERISTIC
/begin CHARACTERISTIC c_pwm_vim_open "PWM to open VIM flap" VALUE 0xa102977c _REC_VAL_20_s2 199.9969482421875 _CNV_A_R_LINEAR_____201_CM -100. 99.9969482421875 DISPLAY_IDENTIFIER C_PWM_VIM_OPEN FORMAT "%8.3" /end CHARACTERISTIC
/begin CHARACTERISTIC c_t_open_vim_deac "Time to open the VIM flaps before deactivating the VIM function" VALUE 0xa1029936 _REC_VAL_20_u1 2.55 _CNV_A_R_LINEAR_____3_CM 0. 2.55 DISPLAY_IDENTIFIER C_T_OPEN_VIM_DEAC FORMAT "%4.2" /end CHARACTERISTIC
/begin CHARACTERISTIC c_vim_av_pas "VIM_AV during passive function" VALUE 0xa1029c18 _REC_VAL_20_u2 199.9969 _CNV_A_R_LINEAR_____290_CM 0. 199.9969 DISPLAY_IDENTIFIER C_VIM_AV_PAS FORMAT "%7.3" /end CHARACTERISTIC
/begin AXIS_PTS ldp_tia_id_state_rls_vim "" 0xa102136e tia _REC_AXS_20_u1 190.5 _CNV_A_R_LINEAR_____16_CM 6 -48. 142.5 FORMAT "%5.1" /end AXIS_PTS
/begin AXIS_PTS ldp_tco_id_state_rls_vim "" 0xa10212a8 tco _REC_AXS_20_u1 190.5 _CNV_A_R_LINEAR_____16_CM 6 -48. 142.5 FORMAT "%5.1" /end AXIS_PTS
/begin MEASUREMENT idx_2_sp_vim_1 "LDPM_IDX_2_SP_VIM_1_VIMA" UBYTE _CNV_A_R_LINEAR_____0_CM 1 100. 0. 1. DISPLAY_IDENTIFIER IDX_2_SP_VIM_1 ECU_ADDRESS 0xc0000e01 FORMAT "%1.0" /end MEASUREMENT
/begin MEASUREMENT idx_1_sp_vim_1 "LDPM_IDX_1_SP_VIM_1_VIMA" UBYTE _CNV_A_R_LINEAR_____0_CM 1 100. 0. 3. DISPLAY_IDENTIFIER IDX_1_SP_VIM_1 ECU_ADDRESS 0xc0000e00 FORMAT "%1.0" /end MEASUREMENT
/begin AXIS_PTS ldpm_idx_1_sp_vim_1_vima "" 0xa1021b2a idx_1_sp_vim_1 _REC_AXS_20_u1 3. _CNV_A_R_LINEAR_____0_CM 4 0. 3. FORMAT "%1.0" /end AXIS_PTS
/begin AXIS_PTS ldpm_idx_2_sp_vim_1_vima "" 0xa1021b30 idx_2_sp_vim_1 _REC_AXS_20_u1 1. _CNV_A_R_LINEAR_____0_CM 2 0. 1. FORMAT "%1.0" /end AXIS_PTS
/begin AXIS_PTS ldp_fac_maf_max_ip_fac_n_vim "" 0xa102099c fac_maf_max _REC_AXS_20_u2 1.99996948242188 _CNV_A_R_LINEAR_____8_CM 6 0. 1.99996948242188 FORMAT "%7.5" /end AXIS_PTS
/begin CHARACTERISTIC id_state_vim_1_sp "Table defining the setpoint VIM flap 1, 0: closed, 1: opened" MAP 0xa1022f10 _REC_MAP_20_u1_u1_u1 1. _CNV_A_R_LINEAR_____0_CM 0. 1. DISPLAY_IDENTIFIER ID_STATE_VIM_1_SP FORMAT "%1.0"
 /begin AXIS_DESCR COM_AXIS idx_1_sp_vim_1 _CNV_A_R_LINEAR_____0_CM 4 0. 3. FORMAT "%1.0" AXIS_PTS_REF ldpm_idx_1_sp_vim_1_vima /end AXIS_DESCR
 /begin AXIS_DESCR COM_AXIS idx_2_sp_vim_1 _CNV_A_R_LINEAR_____0_CM 2 0. 1. FORMAT "%1.0" AXIS_PTS_REF ldpm_idx_2_sp_vim_1_vima /end AXIS_DESCR
/end CHARACTERISTIC
/begin CHARACTERISTIC id_state_vim_2_sp "Table defining the setpoint VIM flap 2, 0: closed, 1: opened" MAP 0xa1022f18 _REC_MAP_20_u1_u1_u1 1. _CNV_A_R_LINEAR_____0_CM 0. 1. DISPLAY_IDENTIFIER ID_STATE_VIM_2_SP FORMAT "%1.0"
 /begin AXIS_DESCR COM_AXIS idx_1_sp_vim_1 _CNV_A_R_LINEAR_____0_CM 4 0. 3. FORMAT "%1.0" AXIS_PTS_REF ldpm_idx_1_sp_vim_1_vima /end AXIS_DESCR
 /begin AXIS_DESCR COM_AXIS idx_2_sp_vim_1 _CNV_A_R_LINEAR_____0_CM 2 0. 1. FORMAT "%1.0" AXIS_PTS_REF ldpm_idx_2_sp_vim_1_vima /end AXIS_DESCR
/end CHARACTERISTIC
/begin CHARACTERISTIC id_state_rls_vim "Temperature condition for VIM function is met (1) or not met (0)" MAP 0xa1022eec _REC_MAP_20_u1_u1_u1 1. _CNV_A_R_LINEAR_____0_CM 0. 1. DISPLAY_IDENTIFIER ID_STATE_RLS_VIM FORMAT "%1.0"
 /begin AXIS_DESCR COM_AXIS tia _CNV_A_R_LINEAR_____16_CM 6 -48. 142.5 FORMAT "%5.1" AXIS_PTS_REF ldp_tia_id_state_rls_vim /end AXIS_DESCR
 /begin AXIS_DESCR COM_AXIS tco _CNV_A_R_LINEAR_____16_CM 6 -48. 142.5 FORMAT "%5.1" AXIS_PTS_REF ldp_tco_id_state_rls_vim /end AXIS_DESCR
/end CHARACTERISTIC
/begin CHARACTERISTIC ip_fac_tia_n_vim "TIA correction for VIM switch thresholds" CURVE 0xa10242ec _REC_CUR_20_u1_u1 1.9921875 _CNV_A_R_LINEAR_____100_CM 0. 1.9921875 DISPLAY_IDENTIFIER IP_FAC_TIA_N_VIM FORMAT "%5.3"
 /begin AXIS_DESCR COM_AXIS tia _CNV_A_R_LINEAR_____16_CM 8 -48. 142.5 FORMAT "%5.1" AXIS_PTS_REF ldp_tia_fac_tia_n_vim /end AXIS_DESCR
/end CHARACTERISTIC
/begin AXIS_PTS ldp_tia_fac_tia_n_vim "" 0xa1021364 tia _REC_AXS_20_u1 190.5 _CNV_A_R_LINEAR_____16_CM 8 -48. 142.5 FORMAT "%5.1" /end AXIS_PTS
/begin AXIS_PTS ldp_n_32_fac_n_vim "" 0xa1020de0 n_32 _REC_AXS_20_u1 8160. _CNV_A_R_LINEAR_____9_CM 8 0. 8160. FORMAT "%4.0" /end AXIS_PTS
/begin CHARACTERISTIC c_pwm_vim_deac "PWM-signal to deactivate VIM flap" VALUE 0xa102977a _REC_VAL_20_s2 199.9969482421875 _CNV_A_R_LINEAR_____201_CM -100. 99.9969482421875 DISPLAY_IDENTIFIER C_PWM_VIM_DEAC FORMAT "%8.3" /end CHARACTERISTIC
/begin CHARACTERISTIC c_vim_av_deac "VIM_AV during deactivation" VALUE 0xa1029c16 _REC_VAL_20_u2 199.9969 _CNV_A_R_LINEAR_____290_CM 0. 199.9969 DISPLAY_IDENTIFIER C_VIM_AV_DEAC FORMAT "%7.3" /end CHARACTERISTIC
/begin CHARACTERISTIC lc_pwm_vim_cus "Logical constant to enable customer setting of VIMPWM_1/2 by calibration system" VALUE 0xa1029dbc _REC_VAL_20_u1 1. _CNV_S_2_RANGE__0___1_CM 0. 1. DISPLAY_IDENTIFIER LC_PWM_VIM_CUS /end CHARACTERISTIC
/begin CHARACTERISTIC c_vb_min_bsd_diag "Battery voltage threshold of power management diagnosis" VALUE 0xa1029bd9 _REC_VAL_20_u1 26. _CNV_A_R_LINEAR_____36_CM 0. 26. DISPLAY_IDENTIFIER C_VB_MIN_BSD_DIAG FORMAT "%4.1" /end CHARACTERISTIC
/begin CHARACTERISTIC lc_alter_rd_tbl_6 "logical constant: software switch for condition read register 6" VALUE 0xa1029d09 _REC_VAL_20_u1 1. _CNV_A_R_LINEAR_____0_CM 0. 1. DISPLAY_IDENTIFIER LC_ALTER_RD_TBL_6 FORMAT "%1.0" /end CHARACTERISTIC
/begin CHARACTERISTIC lc_alter_bsd_prot_2 "logical constant: software swich to choose BSD protocol" VALUE 0xa1029d08 _REC_VAL_20_u1 1. _CNV_A_R_LINEAR_____0_CM 0. 1. DISPLAY_IDENTIFIER LC_ALTER_BSD_PROT_2 FORMAT "%1.0" /end CHARACTERISTIC
/begin CHARACTERISTIC lc_alter_wr_cord_1 "logical constant: software swich to choose the writing order during step 1" VALUE 0xa1029d0a _REC_VAL_20_u1 1. _CNV_A_R_LINEAR_____0_CM 0. 1. DISPLAY_IDENTIFIER LC_ALTER_WR_CORD_1 FORMAT "%1.0" /end CHARACTERISTIC
/begin CHARACTERISTIC lc_alter_wr_cord_2 "logical constant: software swich to choose the writing order during step 2" VALUE 0xa1029d0b _REC_VAL_20_u1 1. _CNV_A_R_LINEAR_____0_CM 0. 1. DISPLAY_IDENTIFIER LC_ALTER_WR_CORD_2 FORMAT "%1.0" /end CHARACTERISTIC
/begin CHARACTERISTIC lc_alter_wr_cord_3 "logical constant: software swich to choose the writing order during step 3" VALUE 0xa1029d0c _REC_VAL_20_u1 1. _CNV_A_R_LINEAR_____0_CM 0. 1. DISPLAY_IDENTIFIER LC_ALTER_WR_CORD_3 FORMAT "%1.0" /end CHARACTERISTIC
/begin CHARACTERISTIC c_t_wr_per_alter_tbl_0 "calibratible time period for write register 0 (alternator powermanagement)" VALUE 0xa10299b3 _REC_VAL_20_u1 10.2 _CNV_A_R_LINEAR_____279_CM 0. 10.2 DISPLAY_IDENTIFIER C_T_WR_PER_ALTER_TBL_0 FORMAT "%5.2" /end CHARACTERISTIC
/begin CHARACTERISTIC c_t_wr_per_alter_tbl_1 "calibratible time period for write register 1 (alternator powermanagement)" VALUE 0xa10299b4 _REC_VAL_20_u1 10.2 _CNV_A_R_LINEAR_____279_CM 0. 10.2 DISPLAY_IDENTIFIER C_T_WR_PER_ALTER_TBL_1 FORMAT "%5.2" /end CHARACTERISTIC
/begin CHARACTERISTIC c_t_rd_per_alter_tbl_2 "calibratible time period for reading register 2 (alternator powermanagement)" VALUE 0xa102994e _REC_VAL_20_u1 10.2 _CNV_A_R_LINEAR_____279_CM 0. 10.2 DISPLAY_IDENTIFIER C_T_RD_PER_ALTER_TBL_2 FORMAT "%5.2" /end CHARACTERISTIC
/begin CHARACTERISTIC c_t_rd_per_alter_tbl_5 "calibratible time period for reading register 5 (alternator powermanagement)" VALUE 0xa102994f _REC_VAL_20_u1 10.2 _CNV_A_R_LINEAR_____279_CM 0. 10.2 DISPLAY_IDENTIFIER C_T_RD_PER_ALTER_TBL_5 FORMAT "%5.2" /end CHARACTERISTIC
/begin CHARACTERISTIC c_t_fil_cur_exct_alter "calibratible filter time for exciting current  (alternator powermanagement)" VALUE 0xa10298a0 _REC_VAL_20_u1 2.55 _CNV_A_R_LINEAR_____3_CM 0. 2.55 DISPLAY_IDENTIFIER C_T_FIL_CUR_EXCT_ALTER FORMAT "%4.2" /end CHARACTERISTIC
/begin MEASUREMENT lv_alter_bsd_prot_2 "condition for BSD protocol controller type 2" UBYTE _CNV_S_2_RANGE__0___1_CM 1 100. 0. 1. DISPLAY_IDENTIFIER LV_ALTER_BSD_PROT_2 ECU_ADDRESS 0xd000379d BIT_MASK 0x1 /end MEASUREMENT
/begin MEASUREMENT lv_alter_if_act "condition alternator interface activ" UBYTE _CNV_S_2_RANGE__0___1_CM 1 100. 0. 1. DISPLAY_IDENTIFIER LV_ALTER_IF_ACT ECU_ADDRESS 0xd000379a BIT_MASK 0x1 /end MEASUREMENT
/begin MEASUREMENT lv_alter_eve_rd "condition: eo-read" UBYTE _CNV_S_2_RANGE__0___1_CM 1 100. 0. 1. DISPLAY_IDENTIFIER LV_ALTER_EVE_RD ECU_ADDRESS 0xd000379e BIT_MASK 0x1 /end MEASUREMENT
/begin MEASUREMENT lv_alter_eve_wr "condition: eo-write" UBYTE _CNV_S_2_RANGE__0___1_CM 1 100. 0. 1. DISPLAY_IDENTIFIER LV_ALTER_EVE_WR ECU_ADDRESS 0xd000379f BIT_MASK 0x1 /end MEASUREMENT
/begin MEASUREMENT bsd_alter_rd.t_load_resp_alter_0 "actual value from alternator load response time" ULONG _CNV_A_R_LINEAR_____35_CM 1 100. 0. 15. DISPLAY_IDENTIFIER T_LOAD_RESP_ALTER_0 ECU_ADDRESS 0xd0003790 FORMAT "%2.0" BIT_MASK 0xC0 /end MEASUREMENT
/begin MEASUREMENT bsd_alter_rd.v_alter "received voltage alternator" ULONG _CNV_A_R_LINEAR_____417_CM 1 100. 10.6 16.9 DISPLAY_IDENTIFIER V_ALTER ECU_ADDRESS 0xd0003790 FORMAT "%4.1" BIT_MASK 0x3F /end MEASUREMENT
/begin MEASUREMENT bsd_alter_rd.t_load_resp_alter_1 "actual value from alternator load response time" ULONG _CNV_A_R_LINEAR_____35_CM 1 100. 0. 15. DISPLAY_IDENTIFIER T_LOAD_RESP_ALTER_1 ECU_ADDRESS 0xd0003790 FORMAT "%2.0" BIT_MASK 0xE000 /end MEASUREMENT
/begin MEASUREMENT bsd_alter_rd.lv_load_resp_alter_cnd_1 "alternator load response condition for register 1 activ" ULONG _CNV_S_2_RANGE______75_CM 1 100. 0. 1. DISPLAY_IDENTIFIER LV_LOAD_RESP_ALTER_CND_1 ECU_ADDRESS 0xd0003790 BIT_MASK 0x1000 /end MEASUREMENT
/begin MEASUREMENT bsd_alter_rd.lv_load_resp_alter_thd_act "shut of the load response threshold for alternator (copy of SP)" ULONG _CNV_S_2_RANGE______75_CM 1 100. 0. 1. DISPLAY_IDENTIFIER LV_LOAD_RESP_ALTER_THD_ACT ECU_ADDRESS 0xd0003790 BIT_MASK 0x100 /end MEASUREMENT
/begin MEASUREMENT bsd_alter_rd.lv_alter_err_temp "(excess) temperature fault alternator" ULONG _CNV_S_2_RANGE______75_CM 1 100. 0. 1. DISPLAY_IDENTIFIER LV_ALTER_ERR_TEMP ECU_ADDRESS 0xd0003790 BIT_MASK 0x800000 /end MEASUREMENT
/begin MEASUREMENT bsd_alter_rd.lv_alter_err_mec "mechanical fault alternator" ULONG _CNV_S_2_RANGE______75_CM 1 100. 0. 1. DISPLAY_IDENTIFIER LV_ALTER_ERR_MEC ECU_ADDRESS 0xd0003790 BIT_MASK 0x400000 /end MEASUREMENT
/begin MEASUREMENT bsd_alter_rd.lv_alter_err_el "electrical fault alternator" ULONG _CNV_S_2_RANGE______75_CM 1 100. 0. 1. DISPLAY_IDENTIFIER LV_ALTER_ERR_EL ECU_ADDRESS 0xd0003790 BIT_MASK 0x200000 /end MEASUREMENT
/begin MEASUREMENT bsd_alter_rd.pow_rel_alter "occupancy of alternator" ULONG _CNV_A_R_LINEAR_____418_CM 1 100. 0. 96.875 DISPLAY_IDENTIFIER POW_REL_ALTER ECU_ADDRESS 0xd0003790 FORMAT "%4.1" BIT_MASK 0x1F0000 /end MEASUREMENT
/begin MEASUREMENT bsd_alter_rd.pow_rel_alter_l_res "DF rough value (occupancy factor) from alternator" UBYTE _CNV_S_4_STATE_POW__419_CM 1 100. 0. 3. DISPLAY_IDENTIFIER POW_REL_ALTER_L_RES ECU_ADDRESS 0xd0003793 BIT_MASK 0xC0 /end MEASUREMENT
/begin MEASUREMENT bsd_alter_rd.cur_alter_exct "actual value exciting current  alternator" ULONG _CNV_A_R_LINEAR_____420_CM 1 100. 0. 7.75 DISPLAY_IDENTIFIER CUR_ALTER_EXCT ECU_ADDRESS 0xd0003790 FORMAT "%3.1" BIT_MASK 0x3F000000 /end MEASUREMENT
/begin MEASUREMENT bsd_alter_rd.temp_alter_mc "chip temperature alternator" ULONG _CNV_A_R_LINEAR_____421_CM 1 100. -32. 216. DISPLAY_IDENTIFIER TEMP_ALTER_MC ECU_ADDRESS 0xd0003794 FORMAT "%4.0" BIT_MASK 0x3E00 /end MEASUREMENT
/begin MEASUREMENT bsd_alter_rd.alter_cod_0 "manufacturer identifier" ULONG _CNV_A_R_LINEAR_____0_CM 1 100. 0. 7. DISPLAY_IDENTIFIER ALTER_COD_0 ECU_ADDRESS 0xd0003794 FORMAT "%3.0" BIT_MASK 0xE00000 /end MEASUREMENT
/begin MEASUREMENT bsd_alter_rd.alter_cod_1 "type identifier alternator" ULONG _CNV_A_R_LINEAR_____0_CM 1 100. 0. 31. DISPLAY_IDENTIFIER ALTER_COD_1 ECU_ADDRESS 0xd0003794 FORMAT "%3.0" BIT_MASK 0x1F0000 /end MEASUREMENT
/begin MEASUREMENT bsd_alter_rd.alter_cod_2 "controller version alternator" ULONG _CNV_A_R_LINEAR_____0_CM 1 100. 0. 3. DISPLAY_IDENTIFIER ALTER_COD_2 ECU_ADDRESS 0xd0003794 FORMAT "%3.0" BIT_MASK 0xC0000000 /end MEASUREMENT
/begin MEASUREMENT bsd_alter_rd.v_alter_nom "nominal voltage alternator" ULONG _CNV_A_R_LINEAR_____422_CM 1 100. 0. 3. DISPLAY_IDENTIFIER V_ALTER_NOM ECU_ADDRESS 0xd0003794 FORMAT "%2.0" BIT_MASK 0x30000000 /end MEASUREMENT
/begin MEASUREMENT bsd_alter_rd.alter_cod_3 "chip version  alternator" ULONG _CNV_A_R_LINEAR_____0_CM 1 100. 0. 15. DISPLAY_IDENTIFIER ALTER_COD_3 ECU_ADDRESS 0xd0003794 FORMAT "%3.0" BIT_MASK 0xF000000 /end MEASUREMENT
/begin MEASUREMENT bsd_alter_wr.t_load_resp_alter_sp_0 "actual value from alternator load response time" ULONG _CNV_A_R_LINEAR_____35_CM 1 100. 0. 15. DISPLAY_IDENTIFIER T_LOAD_RESP_ALTER_SP_0 ECU_ADDRESS 0xd0003780 FORMAT "%2.0" BIT_MASK 0xC0 /end MEASUREMENT
/begin MEASUREMENT bsd_alter_wr.v_alter_sp "received voltage alternator" ULONG _CNV_A_R_LINEAR_____417_CM 1 100. 10.6 16.9 DISPLAY_IDENTIFIER V_ALTER_SP ECU_ADDRESS 0xd0003780 FORMAT "%4.1" BIT_MASK 0x3F /end MEASUREMENT
/begin MEASUREMENT bsd_alter_wr.t_load_resp_alter_sp_1 "actual value from alternator load response time" ULONG _CNV_A_R_LINEAR_____35_CM 1 100. 0. 15. DISPLAY_IDENTIFIER T_LOAD_RESP_ALTER_SP_1 ECU_ADDRESS 0xd0003780 FORMAT "%2.0" BIT_MASK 0xE000 /end MEASUREMENT
/begin MEASUREMENT bsd_alter_wr.lv_load_resp_alter_cnd_1 "actual value exciting current  alternator" ULONG _CNV_S_2_RANGE______75_CM 1 100. 0. 1. DISPLAY_IDENTIFIER LV_LOAD_RESP_ALTER_CND_1 ECU_ADDRESS 0xd0003780 BIT_MASK 0x1000 /end MEASUREMENT
/begin MEASUREMENT bsd_alter_wr.lv_load_resp_alter_thd_act_sp "shut of the load response threshold for alternator" ULONG _CNV_S_2_RANGE______75_CM 1 100. 0. 1. DISPLAY_IDENTIFIER LV_LOAD_RESP_ALTER_THD_ACT_SP ECU_ADDRESS 0xd0003780 BIT_MASK 0x100 /end MEASUREMENT
/begin MEASUREMENT bsd_alter_wr.cur_alter_exct_lim_sp "actual value exciting current  alternator" ULONG _CNV_A_R_LINEAR_____423_CM 1 100. 0. 7.75 DISPLAY_IDENTIFIER CUR_ALTER_EXCT_LIM_SP ECU_ADDRESS 0xd0003780 FORMAT "%3.1" BIT_MASK 0x3E000000 /end MEASUREMENT
/begin MEASUREMENT genawnumm "Generatorkennfeldnummer" UBYTE _CNV_R_R_DEZ_436_CM 1 100. 0. 255. DISPLAY_IDENTIFIER GENAWNUMM ECU_ADDRESS 0xd0003c4f FORMAT "%8.4" /end MEASUREMENT
/begin CHARACTERISTIC lc_pow_cord_inh "Configuration of alternator powermanagement" VALUE 0xa1029db4 _REC_VAL_20_u1 1. _CNV_A_R_LINEAR_____0_CM 0. 1. DISPLAY_IDENTIFIER LC_POW_CORD_INH FORMAT "%1.0" /end CHARACTERISTIC
/begin MEASUREMENT lv_err_qoil_sens "" UBYTE _CNV_S_2_RANGE__0___1_CM 1 100. 0. 1. DISPLAY_IDENTIFIER LV_ERR_QOIL_SENS ECU_ADDRESS 0xd000346e BIT_MASK 0x1 /end MEASUREMENT
/begin MEASUREMENT lv_err_toil_level "Boolean for error currently present on TOENS sensor" UBYTE _CNV_S_2_RANGE__0___1_CM 1 100. 0. 1. DISPLAY_IDENTIFIER LV_ERR_TOIL_LEVEL ECU_ADDRESS 0xd0003407 BIT_MASK 0x1 /end MEASUREMENT
/begin MEASUREMENT lv_err_toil "TOIL error flag" UBYTE _CNV_S_2_RANGE__0___1_CM 1 100. 0. 1. DISPLAY_IDENTIFIER LV_ERR_TOIL ECU_ADDRESS 0xd00037f6 BIT_MASK 0x1 /end MEASUREMENT
/begin MEASUREMENT lv_ecras "Indication of air flaps being closed (1)/open (0)" UBYTE _CNV_S_2_RANGE__0___1_CM 1 100. 0. 1. DISPLAY_IDENTIFIER LV_ECRAS ECU_ADDRESS 0xd0003891 BIT_MASK 0x1 /end MEASUREMENT
/begin MEASUREMENT ozpermr_w "Signal Oelzustand" UWORD _CNV_A_R_LINEAR_____0_CM 1 100. 0. 65535. DISPLAY_IDENTIFIER OZPERMR_W ECU_ADDRESS 0xd0004cfa FORMAT "%5.0" /end MEASUREMENT
/begin MEASUREMENT ozstatus "Status of oil sensor" UWORD _CNV_A_R_LINEAR_____0_CM 1 100. 0. 65535. DISPLAY_IDENTIFIER OZSTATUS ECU_ADDRESS 0xd0004cfc FORMAT "%5.0" /end MEASUREMENT
/begin MEASUREMENT oztempr "Signal Oeltemperatur" UWORD _CNV_A_R_LINEAR_____0_CM 1 100. 0. 65535. DISPLAY_IDENTIFIER OZTEMPR ECU_ADDRESS 0xd0004cfe FORMAT "%5.0" /end MEASUREMENT
/begin MEASUREMENT oznivr "Signal Oelstand" UWORD _CNV_A_R_LINEAR_____0_CM 1 100. 0. 65535. DISPLAY_IDENTIFIER OZNIVR ECU_ADDRESS 0xd0004cf8 FORMAT "%5.0" /end MEASUREMENT
/begin CHARACTERISTIC c_tco_min_egr "Minimum temperature for EGR-control active" VALUE 0xa10299dd _REC_VAL_20_u1 190.5 _CNV_A_R_LINEAR_____16_CM -48. 142.5 DISPLAY_IDENTIFIER C_TCO_MIN_EGR FORMAT "%5.1" /end CHARACTERISTIC
/begin CHARACTERISTIC c_t_ast_egr "time delay for EGR active after start" VALUE 0xa1029806 _REC_VAL_20_u2 6553.5 _CNV_A_R_LINEAR_____4_CM 0. 6553.5 DISPLAY_IDENTIFIER C_T_AST_EGR FORMAT "%6.1" /end CHARACTERISTIC
/begin MEASUREMENT lv_acr_ctl_ena "logical value for EGR-control active" UBYTE _CNV_S_2_RANGE__0___1_CM 1 100. 0. 1. DISPLAY_IDENTIFIER LV_ACR_CTL_ENA ECU_ADDRESS 0xd00039b4 BIT_MASK 0x1 /end MEASUREMENT
/begin CHARACTERISTIC lc_acr_ctl_ena "Logical constant for the activation of actuator position control " VALUE 0xa1029ce1 _REC_VAL_20_u1 1. _CNV_A_R_LINEAR_____0_CM 0. 1. DISPLAY_IDENTIFIER LC_ACR_CTL_ENA FORMAT "%1.0" /end CHARACTERISTIC
/begin MEASUREMENT pwm_vcv " PWM signal for the VCV" UWORD _CNV_A_R_LINEAR_____7_CM 1 100. 0. 99.99847412109381 DISPLAY_IDENTIFIER PWM_VCV ECU_ADDRESS 0xd0004d30 /end MEASUREMENT
/begin MEASUREMENT lv_fuel_mass_ctl_stop_req "Logical variable requesting 'freezing' the I-part of the controller" UBYTE _CNV_S_2_RANGE__0___1_CM 1 100. 0. 1. DISPLAY_IDENTIFIER LV_FUEL_MASS_CTL_STOP_REQ ECU_ADDRESS 0xd00039d2 BIT_MASK 0x1 /end MEASUREMENT
/begin MEASUREMENT frq_req_vcv " Required frequency for the volume control valve" UWORD _CNV_A_R_LINEAR_____305_CM 1 100. 10. 1023. DISPLAY_IDENTIFIER FRQ_REQ_VCV ECU_ADDRESS 0xd0004d34 FORMAT "%4.0" /end MEASUREMENT
/begin MEASUREMENT pwm_vcv_ctl "PWM signal for the VCV of the control" UWORD _CNV_A_R_LINEAR_____7_CM 1 100. 0. 99.99847412109381 DISPLAY_IDENTIFIER PWM_VCV_CTL ECU_ADDRESS 0xc00008e2 /end MEASUREMENT
/begin MEASUREMENT pwm_vcv_max "Maximum PWM signal for the VCV" UWORD _CNV_A_R_LINEAR_____7_CM 1 100. 0. 99.99847412109381 DISPLAY_IDENTIFIER PWM_VCV_MAX ECU_ADDRESS 0xc00008e4 /end MEASUREMENT
/begin MEASUREMENT pwm_vcv_req " Requested PWM signal for the VCV" UWORD _CNV_A_R_LINEAR_____7_CM 1 100. 0. 99.99847412109381 DISPLAY_IDENTIFIER PWM_VCV_REQ ECU_ADDRESS 0xc00008e0 /end MEASUREMENT
/begin CHARACTERISTIC c_rho_fuel "Densitiy of the fuel" VALUE 0xa1029784 _REC_VAL_20_u2 825.3605 _CNV_A_R_LINEAR_____541_CM 74.6395 900. DISPLAY_IDENTIFIER C_RHO_FUEL FORMAT "%7.2" /end CHARACTERISTIC
/begin CHARACTERISTIC c_frq_pwm_vcv_opl "Required frequency for the VCV for open position" VALUE 0xa10293ea _REC_VAL_20_u2 1013. _CNV_A_R_LINEAR_____305_CM 10. 1023. DISPLAY_IDENTIFIER C_FRQ_PWM_VCV_OPL FORMAT "%4.0" /end CHARACTERISTIC
/begin CHARACTERISTIC c_frq_pwm_vcv_stnd "Required frequency for the VCV for standard operation" VALUE 0xa10293ec _REC_VAL_20_u2 1013. _CNV_A_R_LINEAR_____305_CM 10. 1023. DISPLAY_IDENTIFIER C_FRQ_PWM_VCV_STND FORMAT "%4.0" /end CHARACTERISTIC
/begin CHARACTERISTIC c_pwm_vcv_lim_inc "Gradient limitation for increment of PWM_VCV" VALUE 0xa1029754 _REC_VAL_20_u2 99.99847412109381 _CNV_A_R_LINEAR_____7_CM 0. 99.99847412109381 DISPLAY_IDENTIFIER C_PWM_VCV_LIM_INC /end CHARACTERISTIC
/begin AXIS_PTS ldp_vff_vcv_ip_pwm_vcv_bas "" 0xa1021768 vff_vcv _REC_AXS_20_u2 255. _CNV_A_R_LINEAR_____156_CM 16 0. 255. FORMAT "%7.3" /end AXIS_PTS
/begin CHARACTERISTIC ip_pwm_vcv_bas "Base map for the PWM_VCV depending on VFF" CURVE 0xa1027798 _REC_CUR_20_u2_u2 99.99847412109381 _CNV_A_R_LINEAR_____7_CM 0. 99.99847412109381 DISPLAY_IDENTIFIER IP_PWM_VCV_BAS
 /begin AXIS_DESCR COM_AXIS vff_vcv _CNV_A_R_LINEAR_____156_CM 16 0. 255. FORMAT "%7.3" AXIS_PTS_REF ldp_vff_vcv_ip_pwm_vcv_bas /end AXIS_DESCR
/end CHARACTERISTIC
/begin CHARACTERISTIC ip_pwm_vcv_max "Maximum FPAPWM depending on battery voltage" CURVE 0xa10277b8 _REC_CUR_20_u2_u1 99.99847412109381 _CNV_A_R_LINEAR_____7_CM 0. 99.99847412109381 DISPLAY_IDENTIFIER IP_PWM_VCV_MAX
 /begin AXIS_DESCR COM_AXIS vb _CNV_A_R_LINEAR_____289_CM 8 0. 25.8984375 FORMAT "%9.6" AXIS_PTS_REF ldpm_vb_fusl /end AXIS_DESCR
/end CHARACTERISTIC
/begin CHARACTERISTIC ip_fac_pwm_vcv_vb "Correction factor for the PWM_VCV by the battery voltage" CURVE 0xa1023ef4 _REC_CUR_20_u1_u1 1.9921875 _CNV_A_R_LINEAR_____100_CM 0. 1.9921875 DISPLAY_IDENTIFIER IP_FAC_PWM_VCV_VB FORMAT "%8.6"
 /begin AXIS_DESCR COM_AXIS vb _CNV_A_R_LINEAR_____289_CM 8 0. 25.8984375 FORMAT "%9.6" AXIS_PTS_REF ldpm_vb_fusl /end AXIS_DESCR
/end CHARACTERISTIC
/begin AXIS_PTS ldpm_vb_fusl "Battery Voltage" 0xa10223a0 vb _REC_AXS_20_u1 25.8984375 _CNV_A_R_LINEAR_____289_CM 8 0. 25.8984375 FORMAT "%9.6" /end AXIS_PTS
/begin CHARACTERISTIC c_pwm_vcv_min_opl "Minimum PWM signal for the VCV in open loop (at engine stop)" VALUE 0xa1029770 _REC_VAL_20_u2 99.99847412109381 _CNV_A_R_LINEAR_____7_CM 0. 99.99847412109381 DISPLAY_IDENTIFIER C_PWM_VCV_MIN_OPL /end CHARACTERISTIC
/begin MEASUREMENT vff_vcv " Requested volume fuel flow through the VCV " UWORD _CNV_A_R_LINEAR_____156_CM 1 100. 0. 255. DISPLAY_IDENTIFIER VFF_VCV ECU_ADDRESS 0xd0004d32 FORMAT "%7.3" /end MEASUREMENT
/begin MEASUREMENT state_pwm_vcv_tran "State diagram for the PWM VCV control" UBYTE _CNV_S_7_RANGE_STAT_542_CM 1 100. 0. 6. DISPLAY_IDENTIFIER STATE_PWM_VCV_TRAN ECU_ADDRESS 0xc0000914 /end MEASUREMENT
/begin MEASUREMENT lv_fuel_mass_ctl_rst_req "Logical variable for reseting P and I-part of the controller" UBYTE _CNV_S_2_RANGE__0___1_CM 1 100. 0. 1. DISPLAY_IDENTIFIER LV_FUEL_MASS_CTL_RST_REQ ECU_ADDRESS 0xd00039d1 BIT_MASK 0x1 /end MEASUREMENT
/begin MEASUREMENT lv_vff_vcv_min_ad_ena "Adaptation conditions for the minimum flow through the VCV are fulfilled" UBYTE _CNV_S_2_RANGE__0___1_CM 1 100. 0. 1. DISPLAY_IDENTIFIER LV_VFF_VCV_MIN_AD_ENA ECU_ADDRESS 0xc000091c BIT_MASK 0x1 /end MEASUREMENT
/begin MEASUREMENT state_pwm_vcv "State diagram for the PWM  VCV control" UBYTE _CNV_S_6_RANGE_STAT_543_CM 1 100. 0. 5. DISPLAY_IDENTIFIER STATE_PWM_VCV ECU_ADDRESS 0xd00039d0 /end MEASUREMENT
/begin MEASUREMENT state_vff_vcv_min "Minimum VCV adaptation state" UBYTE _CNV_S_5_RANGE_STAT_544_CM 1 100. 0. 4. DISPLAY_IDENTIFIER STATE_VFF_VCV_MIN ECU_ADDRESS 0xc0000915 /end MEASUREMENT
/begin MEASUREMENT t_vff_vcv_min_ad_st "Timer to start the pressure increase during adaptation" UWORD _CNV_A_R_LINEAR_____3_CM 1 100. 0. 655.35 DISPLAY_IDENTIFIER T_VFF_VCV_MIN_AD_ST ECU_ADDRESS 0xc00008f0 FORMAT "%6.2" /end MEASUREMENT
/begin AXIS_PTS ldp_tfu_ip_fac_pwm_vcv "" 0xa102133c tfu _REC_AXS_20_u1 190.5 _CNV_A_R_LINEAR_____16_CM 8 -48. 142.5 FORMAT "%6.2" /end AXIS_PTS
/begin CHARACTERISTIC ip_fac_pwm_vcv_tfu "Correction factor for the PWM_VCV by the fuel temperature" CURVE 0xa1023eec _REC_CUR_20_u1_u1 0.99609375 _CNV_A_R_LINEAR_____27_CM 0. 0.99609375 DISPLAY_IDENTIFIER IP_FAC_PWM_VCV_TFU FORMAT "%5.3"
 /begin AXIS_DESCR COM_AXIS tfu _CNV_A_R_LINEAR_____16_CM 8 -48. 142.5 FORMAT "%6.2" AXIS_PTS_REF ldp_tfu_ip_fac_pwm_vcv /end AXIS_DESCR
/end CHARACTERISTIC
/begin CHARACTERISTIC ip_pwm_vcv_min "Minimum PWM signal for the VCV" CURVE 0xa10277c8 _REC_CUR_20_u2_u2 99.99847412109381 _CNV_A_R_LINEAR_____7_CM 0. 99.99847412109381 DISPLAY_IDENTIFIER IP_PWM_VCV_MIN
 /begin AXIS_DESCR COM_AXIS fup_req_fpa _CNV_A_R_LINEAR_____152_CM 8 0. 347776. FORMAT "%6.0" AXIS_PTS_REF ldp_fup_req_fpa_ip_pwm_vcv_min /end AXIS_DESCR
/end CHARACTERISTIC
/begin CHARACTERISTIC c_fup_dif_max_vff_vcv_min_ad "Maximum pressure deviation allowed for adaptation of VFF_VCV_MIN" VALUE 0xa1029418 _REC_VAL_20_u2 347776. _CNV_A_R_LINEAR_____152_CM 0. 347776. DISPLAY_IDENTIFIER C_FUP_DIF_MAX_VFF_VCV_MIN_AD FORMAT "%6.0" /end CHARACTERISTIC
/begin CHARACTERISTIC c_fup_vff_vcv_min_ad_hys "Fuel pressure difference for VFF_VCV_MIN adaptation" VALUE 0xa102948a _REC_VAL_20_u2 347776. _CNV_A_R_LINEAR_____152_CM 0. 347776. DISPLAY_IDENTIFIER C_FUP_VFF_VCV_MIN_AD_HYS FORMAT "%6.0" /end CHARACTERISTIC
/begin CHARACTERISTIC c_fup_vff_vcv_min_ad_st "Fuel pressure value for VFF_VCV_MIN adaptation start" VALUE 0xa102948e _REC_VAL_20_u2 347776. _CNV_A_R_LINEAR_____152_CM 0. 347776. DISPLAY_IDENTIFIER C_FUP_VFF_VCV_MIN_AD_ST FORMAT "%6.0" /end CHARACTERISTIC
/begin CHARACTERISTIC c_vff_vcv_min_tol "VFF_VCV_MIN adaptation top value" VALUE 0xa1029c0a _REC_VAL_20_u2 255. _CNV_A_R_LINEAR_____156_CM 0. 255. DISPLAY_IDENTIFIER C_VFF_VCV_MIN_TOL FORMAT "%7.3" /end CHARACTERISTIC
/begin CHARACTERISTIC c_vff_vcv_min_ini "VFF_VCV_MIN initial value" VALUE 0xa1029c08 _REC_VAL_20_u2 255. _CNV_A_R_LINEAR_____156_CM 0. 255. DISPLAY_IDENTIFIER C_VFF_VCV_MIN_INI FORMAT "%7.3" /end CHARACTERISTIC
/begin AXIS_PTS ldp_fup_req_fpa_ip_pwm_vcv_min "" 0xa1020ab4 fup_req_fpa _REC_AXS_20_u2 347776. _CNV_A_R_LINEAR_____152_CM 8 0. 347776. FORMAT "%6.0" /end AXIS_PTS
/begin MEASUREMENT fac_vff_fpa "Factor for the flow through the regulator part of 3W-valve(depending on VFF_VCV_MIN)" UBYTE _CNV_A_R_LINEAR_____27_CM 1 100. 0. 0.99609375 DISPLAY_IDENTIFIER FAC_VFF_FPA ECU_ADDRESS 0xc0000916 FORMAT "%5.3" /end MEASUREMENT
/begin AXIS_PTS ldp_fac_vff_fpa_ip_fac_pwm_vcv "" 0xa10209ea fac_vff_fpa _REC_AXS_20_u1 0.99609375 _CNV_A_R_LINEAR_____27_CM 4 0. 0.99609375 FORMAT "%5.3" /end AXIS_PTS
/begin CHARACTERISTIC ip_fac_pwm_vcv_min "Correction factor for the PWM_VCV_MIN by the flow through the regulator part" CURVE 0xa1023ee8 _REC_CUR_20_u1_u1 9.960000000000001 _CNV_A_R_LINEAR_____545_CM 0. 9.960000000000001 DISPLAY_IDENTIFIER IP_FAC_PWM_VCV_MIN FORMAT "%4.3"
 /begin AXIS_DESCR COM_AXIS fac_vff_fpa _CNV_A_R_LINEAR_____27_CM 4 0. 0.99609375 FORMAT "%5.3" AXIS_PTS_REF ldp_fac_vff_fpa_ip_fac_pwm_vcv /end AXIS_DESCR
/end CHARACTERISTIC
/begin CHARACTERISTIC c_pwm_vcv_min_tol "Maximum value for PWM_VCV_MIN " VALUE 0xa1029772 _REC_VAL_20_u2 99.99847412109381 _CNV_A_R_LINEAR_____7_CM 0. 99.99847412109381 DISPLAY_IDENTIFIER C_PWM_VCV_MIN_TOL /end CHARACTERISTIC
/begin MEASUREMENT vff_vcv_min "Adapted minimum volume fuel flow through the VCV" UWORD _CNV_A_R_LINEAR_____156_CM 1 100. 0. 255. DISPLAY_IDENTIFIER VFF_VCV_MIN ECU_ADDRESS 0xd0004d36 FORMAT "%7.3" /end MEASUREMENT
/begin MEASUREMENT vff_pwm_vcv_bas_ad_2 "Volume fuel flow second adaptation point flow control part" UWORD _CNV_A_R_LINEAR_____156_CM 1 100. 0. 255. DISPLAY_IDENTIFIER VFF_PWM_VCV_BAS_AD_2 ECU_ADDRESS 0xd0004d38 FORMAT "%7.3" /end MEASUREMENT
/begin MEASUREMENT vff_pwm_vcv_bas_ad_1 "Volume fuel flow first adaptation point flow control part" UWORD _CNV_A_R_LINEAR_____156_CM 1 100. 0. 255. DISPLAY_IDENTIFIER VFF_PWM_VCV_BAS_AD_1 ECU_ADDRESS 0xd0004d3a FORMAT "%7.3" /end MEASUREMENT
/begin MEASUREMENT pwm_vcv_min "Minimum PWM signal for the VCV" UWORD _CNV_A_R_LINEAR_____7_CM 1 100. 0. 99.99847412109381 DISPLAY_IDENTIFIER PWM_VCV_MIN ECU_ADDRESS 0xc00008e6 /end MEASUREMENT
/begin MEASUREMENT pwm_vcv_bas_ad_1 "Adapted PWM of the first point flow control part" SWORD _CNV_A_R_LINEAR_____110_CM 1 100. -50. 49.9984741210938 DISPLAY_IDENTIFIER PWM_VCV_BAS_AD_1 ECU_ADDRESS 0xd0004d3e FORMAT "%7.3" /end MEASUREMENT
/begin MEASUREMENT pwm_vcv_bas_ad_2 "Adapted PWM of the second point flow control part" SWORD _CNV_A_R_LINEAR_____110_CM 1 100. -50. 49.9984741210938 DISPLAY_IDENTIFIER PWM_VCV_BAS_AD_2 ECU_ADDRESS 0xd0004d40 FORMAT "%7.3" /end MEASUREMENT
/begin MEASUREMENT pwm_vcv_min_ad_1 "Adapted PWM of the first point pressure control part" SWORD _CNV_A_R_LINEAR_____110_CM 1 100. -50. 49.9984741210938 DISPLAY_IDENTIFIER PWM_VCV_MIN_AD_1 ECU_ADDRESS 0xd0004d44 FORMAT "%7.3" /end MEASUREMENT
/begin MEASUREMENT pwm_vcv_min_ad_2 "Adapted PWM of the second point pressure control part" SWORD _CNV_A_R_LINEAR_____110_CM 1 100. -50. 49.9984741210938 DISPLAY_IDENTIFIER PWM_VCV_MIN_AD_2 ECU_ADDRESS 0xd0004d46 FORMAT "%7.3" /end MEASUREMENT
/begin MEASUREMENT fup_pwm_vcv_min_ad_2 "Fuel pressure second adaptation point pressure control" UWORD _CNV_A_R_LINEAR_____152_CM 1 100. 0. 347776. DISPLAY_IDENTIFIER FUP_PWM_VCV_MIN_AD_2 ECU_ADDRESS 0xd0004d48 FORMAT "%6.0" /end MEASUREMENT
/begin MEASUREMENT fup_pwm_vcv_min_ad_1 "Fuel pressure first adaptation point pressure control" UWORD _CNV_A_R_LINEAR_____152_CM 1 100. 0. 347776. DISPLAY_IDENTIFIER FUP_PWM_VCV_MIN_AD_1 ECU_ADDRESS 0xd0004d4a FORMAT "%6.0" /end MEASUREMENT
/begin MEASUREMENT pwm_vcv_bas "Base PWM signal for the VCV" UWORD _CNV_A_R_LINEAR_____7_CM 1 100. 0. 99.99847412109381 DISPLAY_IDENTIFIER PWM_VCV_BAS ECU_ADDRESS 0xc00008e8 /end MEASUREMENT
/begin MEASUREMENT pwm_vcv_bas_ad "Adapted value for the flow control part" SWORD _CNV_A_R_LINEAR_____110_CM 1 100. -50. 49.9984741210938 DISPLAY_IDENTIFIER PWM_VCV_BAS_AD ECU_ADDRESS 0xd0004d3c FORMAT "%7.3" /end MEASUREMENT
/begin MEASUREMENT pwm_vcv_min_ad "Adapted value for the pressure control part" SWORD _CNV_A_R_LINEAR_____110_CM 1 100. -50. 49.9984741210938 DISPLAY_IDENTIFIER PWM_VCV_MIN_AD ECU_ADDRESS 0xd0004d42 FORMAT "%7.3" /end MEASUREMENT
/begin CHARACTERISTIC c_vff_pwm_vcv_bas_ad_1_ini "Initialisation value for the volume fuel flow first adaptation point flow control part" VALUE 0xa1029bfa _REC_VAL_20_u2 255. _CNV_A_R_LINEAR_____156_CM 0. 255. DISPLAY_IDENTIFIER C_VFF_PWM_VCV_BAS_AD_1_INI FORMAT "%7.3" /end CHARACTERISTIC
/begin CHARACTERISTIC c_vff_pwm_vcv_bas_ad_2_ini "Initialisation value for the volume fuel flow second adaptation point point flow control part" VALUE 0xa1029bfe _REC_VAL_20_u2 255. _CNV_A_R_LINEAR_____156_CM 0. 255. DISPLAY_IDENTIFIER C_VFF_PWM_VCV_BAS_AD_2_INI FORMAT "%7.3" /end CHARACTERISTIC
/begin CHARACTERISTIC c_fup_vff_vcv_min_ad_red "Fuel pressure reduction value due to temperature for VFF_VCV_MIN adaptation" VALUE 0xa102948c _REC_VAL_20_u2 347776. _CNV_A_R_LINEAR_____152_CM 0. 347776. DISPLAY_IDENTIFIER C_FUP_VFF_VCV_MIN_AD_RED FORMAT "%6.0" /end CHARACTERISTIC
/begin CHARACTERISTIC c_pwm_vcv_bas_ad_2_ini "Initialisation value PWM_VCV second point of flow control part" VALUE 0xa1029744 _REC_VAL_20_s2 99.99847412109381 _CNV_A_R_LINEAR_____110_CM -50. 49.9984741210938 DISPLAY_IDENTIFIER C_PWM_VCV_BAS_AD_2_INI FORMAT "%7.3" /end CHARACTERISTIC
/begin CHARACTERISTIC c_pwm_vcv_min_ad_1_ini "Initialisation value PWM_VCV first point of pressure control part" VALUE 0xa102975a _REC_VAL_20_s2 99.99847412109381 _CNV_A_R_LINEAR_____110_CM -50. 49.9984741210938 DISPLAY_IDENTIFIER C_PWM_VCV_MIN_AD_1_INI FORMAT "%7.3" /end CHARACTERISTIC
/begin CHARACTERISTIC c_pwm_vcv_min_ad_2_ini "Initialisation value PWM_VCV second point of pressure control part" VALUE 0xa1029760 _REC_VAL_20_s2 99.99847412109381 _CNV_A_R_LINEAR_____110_CM -50. 49.9984741210938 DISPLAY_IDENTIFIER C_PWM_VCV_MIN_AD_2_INI FORMAT "%7.3" /end CHARACTERISTIC
/begin CHARACTERISTIC lc_hpp_ctl_ad_clr "Clearing of adaptation values of 'high pressure pump control'" VALUE 0xa1029d43 _REC_VAL_20_u1 1. _CNV_A_R_LINEAR_____0_CM 0. 1. DISPLAY_IDENTIFIER LC_HPP_CTL_AD_CLR FORMAT "%1.0" /end CHARACTERISTIC
/begin CHARACTERISTIC c_pwm_vcv_lim_dec "Gradient limitation for decrement of PWM_VCV " VALUE 0xa1029752 _REC_VAL_20_u2 99.99847412109381 _CNV_A_R_LINEAR_____7_CM 0. 99.99847412109381 DISPLAY_IDENTIFIER C_PWM_VCV_LIM_DEC /end CHARACTERISTIC
/begin CHARACTERISTIC c_ctr_pwm_vcv_bas_ad_max "Counter for the flow control part adaptation" VALUE 0xa10292b6 _REC_VAL_20_u1 255. _CNV_A_R_LINEAR_____0_CM 0. 255. DISPLAY_IDENTIFIER C_CTR_PWM_VCV_BAS_AD_MAX FORMAT "%3.0" /end CHARACTERISTIC
/begin CHARACTERISTIC c_pwm_vcv_ad_cord_1 "Correlation constant for transfering the I-part into the PWM_VCV_BAS curve" VALUE 0xa102973b _REC_VAL_20_u1 9.96078431372549e-002 _CNV_A_R_LINEAR_____546_CM 3.92156862745098e-004 0.1 DISPLAY_IDENTIFIER C_PWM_VCV_AD_CORD_1 FORMAT "%5.4" /end CHARACTERISTIC
/begin CHARACTERISTIC c_pwm_vcv_ad_cord_2 "Correlation constant for transfering the I-part into the PWM_VCV_BAS curve" VALUE 0xa102973c _REC_VAL_20_u1 1.27e-003 _CNV_A_R_LINEAR_____547_CM 5.e-006 1.275e-003 DISPLAY_IDENTIFIER C_PWM_VCV_AD_CORD_2 FORMAT "%8.6" /end CHARACTERISTIC
/begin CHARACTERISTIC c_fup_sp_vff_vcv_min_ad_end "Fuel pressure setpoint level for ending the VFF_VCV_MIN adaptation" VALUE 0xa1029484 _REC_VAL_20_u2 347776. _CNV_A_R_LINEAR_____152_CM 0. 347776. DISPLAY_IDENTIFIER C_FUP_SP_VFF_VCV_MIN_AD_END FORMAT "%6.0" /end CHARACTERISTIC
/begin CHARACTERISTIC c_fup_dif_pwm_vcv_ad "Max. fuel pressure deviation to allow adaptation" VALUE 0xa102941a _REC_VAL_20_u2 347776. _CNV_A_R_LINEAR_____152_CM 0. 347776. DISPLAY_IDENTIFIER C_FUP_DIF_PWM_VCV_AD FORMAT "%6.0" /end CHARACTERISTIC
/begin CHARACTERISTIC c_vff_vcv_min_bol "VFF_VCV_MIN adaptation bottom value" VALUE 0xa1029c04 _REC_VAL_20_u2 255. _CNV_A_R_LINEAR_____156_CM 0. 255. DISPLAY_IDENTIFIER C_VFF_VCV_MIN_BOL FORMAT "%7.3" /end CHARACTERISTIC
/begin CHARACTERISTIC c_vff_pwm_vcv_bas_hys_1 "Hysteresis of  volume flow to allow adaptation of point 1" VALUE 0xa1029c00 _REC_VAL_20_u2 255. _CNV_A_R_LINEAR_____156_CM 0. 255. DISPLAY_IDENTIFIER C_VFF_PWM_VCV_BAS_HYS_1 FORMAT "%7.3" /end CHARACTERISTIC
/begin CHARACTERISTIC c_vff_pwm_vcv_bas_hys_2 "Hysteresis of  volume flow to allow adaptation of point 2" VALUE 0xa1029c02 _REC_VAL_20_u2 255. _CNV_A_R_LINEAR_____156_CM 0. 255. DISPLAY_IDENTIFIER C_VFF_PWM_VCV_BAS_HYS_2 FORMAT "%7.3" /end CHARACTERISTIC
/begin CHARACTERISTIC c_vff_pwm_vcv_bas_ad_1 "Mean volume flow to allow adaptation of point 1" VALUE 0xa1029bf8 _REC_VAL_20_u2 255. _CNV_A_R_LINEAR_____156_CM 0. 255. DISPLAY_IDENTIFIER C_VFF_PWM_VCV_BAS_AD_1 FORMAT "%7.3" /end CHARACTERISTIC
/begin CHARACTERISTIC c_vff_pwm_vcv_bas_ad_2 "Mean volume flow to allow adaptation of point 2" VALUE 0xa1029bfc _REC_VAL_20_u2 255. _CNV_A_R_LINEAR_____156_CM 0. 255. DISPLAY_IDENTIFIER C_VFF_PWM_VCV_BAS_AD_2 FORMAT "%7.3" /end CHARACTERISTIC
/begin CHARACTERISTIC c_ctr_pwm_vcv_min_ad_max "Counter for the pressure control part adaptation" VALUE 0xa10292b7 _REC_VAL_20_u1 255. _CNV_A_R_LINEAR_____0_CM 0. 255. DISPLAY_IDENTIFIER C_CTR_PWM_VCV_MIN_AD_MAX FORMAT "%3.0" /end CHARACTERISTIC
/begin CHARACTERISTIC c_pwm_vcv_bas_ad_2_max "Maximum value for the adaptation of point 2 of the flow control part" VALUE 0xa1029746 _REC_VAL_20_s2 99.99847412109381 _CNV_A_R_LINEAR_____110_CM -50. 49.9984741210938 DISPLAY_IDENTIFIER C_PWM_VCV_BAS_AD_2_MAX FORMAT "%7.3" /end CHARACTERISTIC
/begin CHARACTERISTIC c_pwm_vcv_bas_ad_1_min "Minimum value for the adaptation of point 1 of the flow control part" VALUE 0xa1029742 _REC_VAL_20_s2 99.99847412109381 _CNV_A_R_LINEAR_____110_CM -50. 49.9984741210938 DISPLAY_IDENTIFIER C_PWM_VCV_BAS_AD_1_MIN FORMAT "%7.3" /end CHARACTERISTIC
/begin CHARACTERISTIC c_pwm_vcv_bas_ad_2_min "Minimum value for the adaptation of point 2 of the flow control part" VALUE 0xa1029748 _REC_VAL_20_s2 99.99847412109381 _CNV_A_R_LINEAR_____110_CM -50. 49.9984741210938 DISPLAY_IDENTIFIER C_PWM_VCV_BAS_AD_2_MIN FORMAT "%7.3" /end CHARACTERISTIC
/begin CHARACTERISTIC c_fup_pwm_vcv_min_hys_1 "Hysteresis of fuel pressure for adaptation of point 1 of pressure control part" VALUE 0xa1029456 _REC_VAL_20_u2 347776. _CNV_A_R_LINEAR_____152_CM 0. 347776. DISPLAY_IDENTIFIER C_FUP_PWM_VCV_MIN_HYS_1 FORMAT "%6.0" /end CHARACTERISTIC
/begin CHARACTERISTIC c_fup_pwm_vcv_min_hys_2 "Hysteresis of fuel pressure for adaptation of point 2 of pressure control part" VALUE 0xa1029458 _REC_VAL_20_u2 347776. _CNV_A_R_LINEAR_____152_CM 0. 347776. DISPLAY_IDENTIFIER C_FUP_PWM_VCV_MIN_HYS_2 FORMAT "%6.0" /end CHARACTERISTIC
/begin CHARACTERISTIC c_fup_pwm_vcv_min_ad_1 "Mean fuel pressure for adaptation of point 1 of pressure control part" VALUE 0xa102944e _REC_VAL_20_u2 347776. _CNV_A_R_LINEAR_____152_CM 0. 347776. DISPLAY_IDENTIFIER C_FUP_PWM_VCV_MIN_AD_1 FORMAT "%6.0" /end CHARACTERISTIC
/begin CHARACTERISTIC c_fup_pwm_vcv_min_ad_2 "Mean fuel pressure for adaptation of point 2 of pressure control part" VALUE 0xa1029452 _REC_VAL_20_u2 347776. _CNV_A_R_LINEAR_____152_CM 0. 347776. DISPLAY_IDENTIFIER C_FUP_PWM_VCV_MIN_AD_2 FORMAT "%6.0" /end CHARACTERISTIC
/begin CHARACTERISTIC c_crlc_vff_mff_sp "Correlation constant for the MMV calculation of VFF_MFF_SP_FUP_CTL" VALUE 0xa1029245 _REC_VAL_20_u1 0.99609375 _CNV_A_R_LINEAR_____27_CM 0. 0.99609375 DISPLAY_IDENTIFIER C_CRLC_VFF_MFF_SP FORMAT "%5.3" /end CHARACTERISTIC
/begin CHARACTERISTIC c_crlc_fup_pwm_vcv_min_ad "Correlation constant for the MMV calculation of FUP for the adaptation" VALUE 0xa10291fe _REC_VAL_20_u1 0.99609375 _CNV_A_R_LINEAR_____27_CM 0. 0.99609375 DISPLAY_IDENTIFIER C_CRLC_FUP_PWM_VCV_MIN_AD FORMAT "%5.3" /end CHARACTERISTIC
/begin CHARACTERISTIC c_pwm_vcv_bas_ad_1_max "Maximum value for the adaptation of point 1 of the flow control part" VALUE 0xa1029740 _REC_VAL_20_s2 99.99847412109381 _CNV_A_R_LINEAR_____110_CM -50. 49.9984741210938 DISPLAY_IDENTIFIER C_PWM_VCV_BAS_AD_1_MAX FORMAT "%7.3" /end CHARACTERISTIC
/begin CHARACTERISTIC c_pwm_vcv_min_ad_1_max "Maximum value for the adaptation of point 1 of the pressure control part" VALUE 0xa102975c _REC_VAL_20_s2 99.99847412109381 _CNV_A_R_LINEAR_____110_CM -50. 49.9984741210938 DISPLAY_IDENTIFIER C_PWM_VCV_MIN_AD_1_MAX FORMAT "%7.3" /end CHARACTERISTIC
/begin CHARACTERISTIC c_pwm_vcv_min_ad_2_max "Maximum value for the adaptation of point 2 of the pressure control part" VALUE 0xa1029762 _REC_VAL_20_s2 99.99847412109381 _CNV_A_R_LINEAR_____110_CM -50. 49.9984741210938 DISPLAY_IDENTIFIER C_PWM_VCV_MIN_AD_2_MAX FORMAT "%7.3" /end CHARACTERISTIC
/begin CHARACTERISTIC c_pwm_vcv_min_ad_1_min "Minimum value for the adaptation of point 1 of the pressure control part" VALUE 0xa102975e _REC_VAL_20_s2 99.99847412109381 _CNV_A_R_LINEAR_____110_CM -50. 49.9984741210938 DISPLAY_IDENTIFIER C_PWM_VCV_MIN_AD_1_MIN FORMAT "%7.3" /end CHARACTERISTIC
/begin CHARACTERISTIC c_pwm_vcv_min_ad_2_min "Minimum value for the adaptation of point 2 of the pressure control part" VALUE 0xa1029764 _REC_VAL_20_s2 99.99847412109381 _CNV_A_R_LINEAR_____110_CM -50. 49.9984741210938 DISPLAY_IDENTIFIER C_PWM_VCV_MIN_AD_2_MIN FORMAT "%7.3" /end CHARACTERISTIC
/begin CHARACTERISTIC c_pwm_vcv_vff_vcv_min_ad "PWM value for the leakage adaptation" VALUE 0xa1029776 _REC_VAL_20_u2 99.99847412109381 _CNV_A_R_LINEAR_____7_CM 0. 99.99847412109381 DISPLAY_IDENTIFIER C_PWM_VCV_VFF_VCV_MIN_AD /end CHARACTERISTIC
/begin CHARACTERISTIC c_fup_pwm_vcv_min_ad_1_ini "Initialisation value for the fuel pressure first adaptation point pressure control part" VALUE 0xa1029450 _REC_VAL_20_u2 347776. _CNV_A_R_LINEAR_____152_CM 0. 347776. DISPLAY_IDENTIFIER C_FUP_PWM_VCV_MIN_AD_1_INI FORMAT "%6.0" /end CHARACTERISTIC
/begin CHARACTERISTIC c_fup_pwm_vcv_min_ad_2_ini "Initialisation value for the fuel pressure second adaptation point pressure control part" VALUE 0xa1029454 _REC_VAL_20_u2 347776. _CNV_A_R_LINEAR_____152_CM 0. 347776. DISPLAY_IDENTIFIER C_FUP_PWM_VCV_MIN_AD_2_INI FORMAT "%6.0" /end CHARACTERISTIC
/begin MEASUREMENT t_vff_vcv_min "Time measured for the pressure increase during adaptation" UWORD _CNV_A_R_LINEAR_____3_CM 1 100. 0. 655.35 DISPLAY_IDENTIFIER T_VFF_VCV_MIN ECU_ADDRESS 0xc00008ee FORMAT "%6.2" /end MEASUREMENT
/begin MEASUREMENT t_vff_vcv_lim "maximum time for leakage adaption" UWORD _CNV_A_R_LINEAR_____3_CM 1 100. 0. 655.35 DISPLAY_IDENTIFIER T_VFF_VCV_LIM ECU_ADDRESS 0xc00008ec FORMAT "%6.2" /end MEASUREMENT
/begin CHARACTERISTIC c_tfu_pwm_vcv_ad_max "maximum temperature for the adaptation" VALUE 0xa1029a25 _REC_VAL_20_u1 190.5 _CNV_A_R_LINEAR_____16_CM -48. 142.5 DISPLAY_IDENTIFIER C_TFU_PWM_VCV_AD_MAX FORMAT "%6.2" /end CHARACTERISTIC
/begin CHARACTERISTIC c_tfu_pwm_vcv_ad_min "minimum temperature for the adaptation" VALUE 0xa1029a26 _REC_VAL_20_u1 190.5 _CNV_A_R_LINEAR_____16_CM -48. 142.5 DISPLAY_IDENTIFIER C_TFU_PWM_VCV_AD_MIN FORMAT "%6.2" /end CHARACTERISTIC
/begin CHARACTERISTIC c_tfu_vff_vcv_min_clc_max "maximum temperature for the leakage adaptation" VALUE 0xa1029a2a _REC_VAL_20_u1 190.5 _CNV_A_R_LINEAR_____16_CM -48. 142.5 DISPLAY_IDENTIFIER C_TFU_VFF_VCV_MIN_CLC_MAX FORMAT "%6.2" /end CHARACTERISTIC
/begin CHARACTERISTIC c_tfu_vff_vcv_min_clc_min "minimum temperature for the leakage adaptation" VALUE 0xa1029a2b _REC_VAL_20_u1 190.5 _CNV_A_R_LINEAR_____16_CM -48. 142.5 DISPLAY_IDENTIFIER C_TFU_VFF_VCV_MIN_CLC_MIN FORMAT "%6.2" /end CHARACTERISTIC
/begin CHARACTERISTIC c_t_vff_vcv_min_ad_st_max "Time for VFF_VCV_MIN adaptation start" VALUE 0xa1029996 _REC_VAL_20_u2 655.35 _CNV_A_R_LINEAR_____3_CM 0. 655.35 DISPLAY_IDENTIFIER C_T_VFF_VCV_MIN_AD_ST_MAX FORMAT "%6.2" /end CHARACTERISTIC
/begin CHARACTERISTIC c_t_vff_vcv_lim_max "maximum time for the leakage adaptation" VALUE 0xa1029994 _REC_VAL_20_u2 655.35 _CNV_A_R_LINEAR_____3_CM 0. 655.35 DISPLAY_IDENTIFIER C_T_VFF_VCV_LIM_MAX FORMAT "%6.2" /end CHARACTERISTIC
/begin CHARACTERISTIC c_fup_ofs_mfp_max "FUP offset for high pressure start" VALUE 0xa1029448 _REC_VAL_20_s2 347776. _CNV_A_R_LINEAR_____548_CM -173890.6533608 173885.3466392 DISPLAY_IDENTIFIER C_FUP_OFS_MFP_MAX FORMAT "%11.2" /end CHARACTERISTIC
/begin CHARACTERISTIC lc_pwm_vcv_man_act "Switch for manual PWM_VCV" VALUE 0xa1029dbb _REC_VAL_20_u1 1. _CNV_A_R_LINEAR_____0_CM 0. 1. DISPLAY_IDENTIFIER LC_PWM_VCV_MAN_ACT FORMAT "%1.0" /end CHARACTERISTIC
/begin CHARACTERISTIC lc_prs_h_st "logical constant for selecting the high pressure start" VALUE 0xa1029db5 _REC_VAL_20_u1 1. _CNV_A_R_LINEAR_____0_CM 0. 1. DISPLAY_IDENTIFIER LC_PRS_H_ST FORMAT "%1.0" /end CHARACTERISTIC
/begin CHARACTERISTIC c_pwm_vcv_man " Manual PWM signal for the VCV" VALUE 0xa1029756 _REC_VAL_20_u2 99.99847412109381 _CNV_A_R_LINEAR_____7_CM 0. 99.99847412109381 DISPLAY_IDENTIFIER C_PWM_VCV_MAN /end CHARACTERISTIC
/begin CHARACTERISTIC c_pwm_vcv_st "PWM_VCV for the start after the event 1TOOTH" VALUE 0xa1029774 _REC_VAL_20_u2 99.99847412109381 _CNV_A_R_LINEAR_____7_CM 0. 99.99847412109381 DISPLAY_IDENTIFIER C_PWM_VCV_ST /end CHARACTERISTIC
/begin CHARACTERISTIC c_pwm_vcv_bas_ad_1_ini "Initialisation value PWM_VCV first point of flow control part" VALUE 0xa102973e _REC_VAL_20_s2 99.99847412109381 _CNV_A_R_LINEAR_____110_CM -50. 49.9984741210938 DISPLAY_IDENTIFIER C_PWM_VCV_BAS_AD_1_INI FORMAT "%7.3" /end CHARACTERISTIC
/begin CHARACTERISTIC c_pwm_vcv_bas_ad_min "Minimum value for the adaptation of the flow control part" VALUE 0xa102974c _REC_VAL_20_s2 99.99847412109381 _CNV_A_R_LINEAR_____110_CM -50. 49.9984741210938 DISPLAY_IDENTIFIER C_PWM_VCV_BAS_AD_MIN FORMAT "%7.3" /end CHARACTERISTIC
/begin CHARACTERISTIC c_pwm_vcv_bas_ad_max "Maximum value for the adaptation of the flow control part" VALUE 0xa102974a _REC_VAL_20_s2 99.99847412109381 _CNV_A_R_LINEAR_____110_CM -50. 49.9984741210938 DISPLAY_IDENTIFIER C_PWM_VCV_BAS_AD_MAX FORMAT "%7.3" /end CHARACTERISTIC
/begin CHARACTERISTIC c_pwm_vcv_min_ad_max "Maximum value for the adaptation of the pressure control part" VALUE 0xa1029766 _REC_VAL_20_s2 99.99847412109381 _CNV_A_R_LINEAR_____110_CM -50. 49.9984741210938 DISPLAY_IDENTIFIER C_PWM_VCV_MIN_AD_MAX FORMAT "%7.3" /end CHARACTERISTIC
/begin CHARACTERISTIC c_pwm_vcv_min_ad_min "Minimum value for the adaptation of the pressure control part" VALUE 0xa1029768 _REC_VAL_20_s2 99.99847412109381 _CNV_A_R_LINEAR_____110_CM -50. 49.9984741210938 DISPLAY_IDENTIFIER C_PWM_VCV_MIN_AD_MIN FORMAT "%7.3" /end CHARACTERISTIC
/begin CHARACTERISTIC c_t_pwm_vcv_first_vld_tooth "Time for the counter which checks the first valid totth signal" VALUE 0xa1029944 _REC_VAL_20_u1 25.5 _CNV_A_R_LINEAR_____4_CM 0. 25.5 DISPLAY_IDENTIFIER C_T_PWM_VCV_FIRST_VLD_TOOTH FORMAT "%4.1" /end CHARACTERISTIC
/begin MEASUREMENT fup_vff_vcv_min_ad_st "Initial fuel pressure where the VFF_VCV_MIN calculation starts at" UWORD _CNV_A_R_LINEAR_____152_CM 1 100. 0. 347776. DISPLAY_IDENTIFIER FUP_VFF_VCV_MIN_AD_ST ECU_ADDRESS 0xc00008ea FORMAT "%6.0" /end MEASUREMENT
/begin MEASUREMENT fup_sp_vff_vcv_min_ad_end "fuel pressure setpoint level for ending the VFF_VCV_MIN adaptation" UWORD _CNV_A_R_LINEAR_____152_CM 1 100. 0. 347776. DISPLAY_IDENTIFIER FUP_SP_VFF_VCV_MIN_AD_END ECU_ADDRESS 0xc00008fa FORMAT "%6.0" /end MEASUREMENT
/begin MEASUREMENT fup_sp_vff_vcv_min_ad_st "fuel pressure setpoint level for starting the VFF_VCV_MIN adaptation" UWORD _CNV_A_R_LINEAR_____152_CM 1 100. 0. 347776. DISPLAY_IDENTIFIER FUP_SP_VFF_VCV_MIN_AD_ST ECU_ADDRESS 0xc00008fc FORMAT "%6.0" /end MEASUREMENT
/begin MEASUREMENT lv_fup_prs_ctl_req " Logical variable requesting pressure control mode " UBYTE _CNV_S_2_RANGE__0___1_CM 1 100. 0. 1. DISPLAY_IDENTIFIER LV_FUP_PRS_CTL_REQ ECU_ADDRESS 0xd00039c1 BIT_MASK 0x1 /end MEASUREMENT
/begin MEASUREMENT lv_fup_req_fpa_stop " Logical variable requesting I-part freeze of controller for pressure control " UBYTE _CNV_S_2_RANGE__0___1_CM 1 100. 0. 1. DISPLAY_IDENTIFIER LV_FUP_REQ_FPA_STOP ECU_ADDRESS 0xd00039c2 BIT_MASK 0x1 /end MEASUREMENT
/begin MEASUREMENT lv_fuel_mass_ad_stop "Logical variable requesting adaptation stop of controller for demand control " UBYTE _CNV_S_2_RANGE__0___1_CM 1 100. 0. 1. DISPLAY_IDENTIFIER LV_FUEL_MASS_AD_STOP ECU_ADDRESS 0xd00039c5 BIT_MASK 0x1 /end MEASUREMENT
/begin MEASUREMENT lv_vff_vcv_min "Logical variable indicating volume flow through VCV reaches limit " UBYTE _CNV_S_2_RANGE__0___1_CM 1 100. 0. 1. DISPLAY_IDENTIFIER LV_VFF_VCV_MIN ECU_ADDRESS 0xc00006b7 BIT_MASK 0x1 /end MEASUREMENT
/begin MEASUREMENT vff_mff_sp_fup_ctl "Volume fuel flow through the injectors " UWORD _CNV_A_R_LINEAR_____156_CM 1 100. 0. 255. DISPLAY_IDENTIFIER VFF_MFF_SP_FUP_CTL ECU_ADDRESS 0xd0004d1e FORMAT "%7.3" /end MEASUREMENT
/begin MEASUREMENT state_fup_ctl_tran "Transistion conditions for the STATE_FUP_CTL " UBYTE _CNV_S_4_RANGE_STAT_549_CM 1 100. 0. 3. DISPLAY_IDENTIFIER STATE_FUP_CTL_TRAN ECU_ADDRESS 0xc00006b4 /end MEASUREMENT
/begin MEASUREMENT state_fup_ctl " Operating state for the global fuel pressure regulation strategy" UBYTE _CNV_S_4_RANGE_STAT_550_CM 1 100. 0. 3. DISPLAY_IDENTIFIER STATE_FUP_CTL ECU_ADDRESS 0xd00039c0 /end MEASUREMENT
/begin CHARACTERISTIC c_fup_ctl_mod "Request for operating state of the global fuel pressure regulation strategy" VALUE 0xa1029414 _REC_VAL_20_u1 2. _CNV_S_3_RANGE_FUP__551_CM 0. 2. DISPLAY_IDENTIFIER C_FUP_CTL_MOD /end CHARACTERISTIC
/begin MEASUREMENT fpa_mff "Fuel flow through the regulator " UWORD _CNV_A_R_LINEAR_____156_CM 1 100. 0. 255. DISPLAY_IDENTIFIER FPA_MFF ECU_ADDRESS 0xd0004d1c FORMAT "%7.3" /end MEASUREMENT
/begin MEASUREMENT lv_fuel_mass_ctl_stop "Logical variable requesting I-part freeze of controller for flow control " UBYTE _CNV_S_2_RANGE__0___1_CM 1 100. 0. 1. DISPLAY_IDENTIFIER LV_FUEL_MASS_CTL_STOP ECU_ADDRESS 0xd00039c4 BIT_MASK 0x1 /end MEASUREMENT
/begin MEASUREMENT lv_fuel_mass_ctl_rst "Logical variable requesting I-part reset of controller for flow control" UBYTE _CNV_S_2_RANGE__0___1_CM 1 100. 0. 1. DISPLAY_IDENTIFIER LV_FUEL_MASS_CTL_RST ECU_ADDRESS 0xd00039c6 BIT_MASK 0x1 /end MEASUREMENT
/begin CHARACTERISTIC lc_fuel_mass_ctl_rst "Logical switch requesting I-part reset of controller for flow control at leaving pressure control" VALUE 0xa1029d3d _REC_VAL_20_u1 1. _CNV_A_R_LINEAR_____0_CM 0. 1. DISPLAY_IDENTIFIER LC_FUEL_MASS_CTL_RST FORMAT "%1.0" /end CHARACTERISTIC
/begin CHARACTERISTIC lc_vff_swi "Logical switch selecting VFF_VCV or VFF_MFF_SP_FUP_CTL as input for structure Change" VALUE 0xa1029e18 _REC_VAL_20_u1 1. _CNV_A_R_LINEAR_____0_CM 0. 1. DISPLAY_IDENTIFIER LC_VFF_SWI FORMAT "%1.0" /end CHARACTERISTIC
/begin CHARACTERISTIC lc_fpa_conf "Logical switch for PCV/VCV or 3-Way-VCV (1: PCV/VCV)" VALUE 0xa1029d3b _REC_VAL_20_u1 1. _CNV_A_R_LINEAR_____0_CM 0. 1. DISPLAY_IDENTIFIER LC_FPA_CONF FORMAT "%1.0" /end CHARACTERISTIC
/begin MEASUREMENT lv_fup_req_fpa_rst " Logical variable requesting I-part reset of controller for pressure control " UBYTE _CNV_S_2_RANGE__0___1_CM 1 100. 0. 1. DISPLAY_IDENTIFIER LV_FUP_REQ_FPA_RST ECU_ADDRESS 0xd00039c3 BIT_MASK 0x1 /end MEASUREMENT
/begin MEASUREMENT ctr_seg_fup_ofs_bol " Counter for 'forced' leaving of pressure control " UBYTE _CNV_A_R_LINEAR_____0_CM 1 100. 0. 255. DISPLAY_IDENTIFIER CTR_SEG_FUP_OFS_BOL ECU_ADDRESS 0xc00006b5 FORMAT "%3.0" /end MEASUREMENT
/begin MEASUREMENT ctr_seg_fup_ofs_tol "Counter for 'forced' leaving of flow control " UBYTE _CNV_A_R_LINEAR_____0_CM 1 100. 0. 255. DISPLAY_IDENTIFIER CTR_SEG_FUP_OFS_TOL ECU_ADDRESS 0xc00006b6 FORMAT "%3.0" /end MEASUREMENT
/begin CHARACTERISTIC c_ctr_seg_fup_ofs_tol_max "Max. value for the counter for 'forced' leaving of flow control " VALUE 0xa10292c3 _REC_VAL_20_u1 255. _CNV_A_R_LINEAR_____0_CM 0. 255. DISPLAY_IDENTIFIER C_CTR_SEG_FUP_OFS_TOL_MAX FORMAT "%3.0" /end CHARACTERISTIC
/begin CHARACTERISTIC lc_fup_req_fpa_rst "Logical switch requesting I-part reset of controller for pressure control at leaving flow control" VALUE 0xa1029d41 _REC_VAL_20_u1 1. _CNV_A_R_LINEAR_____0_CM 0. 1. DISPLAY_IDENTIFIER LC_FUP_REQ_FPA_RST FORMAT "%1.0" /end CHARACTERISTIC
/begin CHARACTERISTIC c_fup_ofs_bol "Offset to the FUP for the 'forced' leaving of pressure control" VALUE 0xa1029442 _REC_VAL_20_s2 347776. _CNV_A_R_LINEAR_____548_CM -173890.6533608 173885.3466392 DISPLAY_IDENTIFIER C_FUP_OFS_BOL FORMAT "%9.2" /end CHARACTERISTIC
/begin CHARACTERISTIC c_fup_ofs_tol "Offset to the FUP for the 'forced' leaving of flow control" VALUE 0xa102944c _REC_VAL_20_s2 347776. _CNV_A_R_LINEAR_____548_CM -173890.6533608 173885.3466392 DISPLAY_IDENTIFIER C_FUP_OFS_TOL FORMAT "%9.2" /end CHARACTERISTIC
/begin CHARACTERISTIC c_fup_sp_dec_tol "Offset to the FUP for the 'forced' leaving of flow control" VALUE 0xa102946e _REC_VAL_20_u2 347776. _CNV_A_R_LINEAR_____152_CM 0. 347776. DISPLAY_IDENTIFIER C_FUP_SP_DEC_TOL FORMAT "%6.0" /end CHARACTERISTIC
/begin CHARACTERISTIC c_ctr_seg_fup_ofs_bol_max "Max. value for the counter for 'forced' leaving of pressure control " VALUE 0xa10292c2 _REC_VAL_20_u1 255. _CNV_A_R_LINEAR_____0_CM 0. 255. DISPLAY_IDENTIFIER C_CTR_SEG_FUP_OFS_BOL_MAX FORMAT "%3.0" /end CHARACTERISTIC
/begin CHARACTERISTIC c_vff_vcv_min_bol_hys "Hysteresis to the lower switch limit" VALUE 0xa1029c06 _REC_VAL_20_u2 255. _CNV_A_R_LINEAR_____156_CM 0. 255. DISPLAY_IDENTIFIER C_VFF_VCV_MIN_BOL_HYS FORMAT "%7.3" /end CHARACTERISTIC
/begin CHARACTERISTIC c_vff_vcv_min_tol_hys "Hysteresis to the upper switch limit" VALUE 0xa1029c0c _REC_VAL_20_u2 255. _CNV_A_R_LINEAR_____156_CM 0. 255. DISPLAY_IDENTIFIER C_VFF_VCV_MIN_TOL_HYS FORMAT "%7.3" /end CHARACTERISTIC
/begin CHARACTERISTIC c_fup_sp_man "Manual fuel pressure setpoint" VALUE 0xa1029478 _REC_VAL_20_u2 347776. _CNV_A_R_LINEAR_____152_CM 0. 347776. DISPLAY_IDENTIFIER C_FUP_SP_MAN FORMAT "%6.0" /end CHARACTERISTIC
/begin CHARACTERISTIC c_fup_sp_pu_lim_inc "Gradient limitation for fuel pressure setpoint increment during PU/PUC" VALUE 0xa102947e _REC_VAL_20_u2 347776. _CNV_A_R_LINEAR_____152_CM 0. 347776. DISPLAY_IDENTIFIER C_FUP_SP_PU_LIM_INC FORMAT "%6.0" /end CHARACTERISTIC
/begin CHARACTERISTIC c_fup_sp_pu_lim_dec "Gradient limitation for fuel pressure setpoint decrement during PU/PUC" VALUE 0xa102947c _REC_VAL_20_u2 347776. _CNV_A_R_LINEAR_____152_CM 0. 347776. DISPLAY_IDENTIFIER C_FUP_SP_PU_LIM_DEC FORMAT "%6.0" /end CHARACTERISTIC
/begin CHARACTERISTIC c_fup_sp_lim_dec "Gradient limitation for fuel pressure setpoint decrement during normal operation" VALUE 0xa1029474 _REC_VAL_20_u2 347776. _CNV_A_R_LINEAR_____152_CM 0. 347776. DISPLAY_IDENTIFIER C_FUP_SP_LIM_DEC FORMAT "%6.0" /end CHARACTERISTIC
/begin CHARACTERISTIC lc_fup_sp_man_act "Switch for manual fuel pressure setpoint" VALUE 0xa1029d42 _REC_VAL_20_u1 1. _CNV_A_R_LINEAR_____0_CM 0. 1. DISPLAY_IDENTIFIER LC_FUP_SP_MAN_ACT FORMAT "%1.0" /end CHARACTERISTIC
/begin CHARACTERISTIC ip_fup_sp_hom "Fuel pressure setpoint for homogenous engine operation" MAP 0xa1024b14 _REC_MAP_20_u2_u1_u2 347776. _CNV_A_R_LINEAR_____152_CM 0. 347776. DISPLAY_IDENTIFIER IP_FUP_SP_HOM FORMAT "%6.0"
 /begin AXIS_DESCR COM_AXIS n_32 _CNV_A_R_LINEAR_____9_CM 8 0. 8160. FORMAT "%4.0" AXIS_PTS_REF ldpm_n_1_fusl /end AXIS_DESCR
 /begin AXIS_DESCR COM_AXIS mff_sp_fup_ctl _CNV_A_R_LINEAR_____108_CM 10 0. 1389. FORMAT "%7.2" AXIS_PTS_REF ldpm_mff_sp_fup_ctl_1_fusl /end AXIS_DESCR
/end CHARACTERISTIC
/begin AXIS_PTS ldpm_n_1_fusl "" 0xa1021d1c n_32 _REC_AXS_20_u1 8160. _CNV_A_R_LINEAR_____9_CM 8 0. 8160. FORMAT "%4.0" /end AXIS_PTS
/begin AXIS_PTS ldpm_mff_sp_fup_ctl_1_fusl "" 0xa1021c9c mff_sp_fup_ctl _REC_AXS_20_u2 1389. _CNV_A_R_LINEAR_____108_CM 10 0. 1389. FORMAT "%7.2" /end AXIS_PTS
/begin CHARACTERISTIC ip_fup_sp_s "Fuel pressure setpoint for stratified engine operation" MAP 0xa1024c54 _REC_MAP_20_u2_u1_u2 347776. _CNV_A_R_LINEAR_____152_CM 0. 347776. DISPLAY_IDENTIFIER IP_FUP_SP_S FORMAT "%6.0"
 /begin AXIS_DESCR COM_AXIS n_32 _CNV_A_R_LINEAR_____9_CM 8 0. 8160. FORMAT "%4.0" AXIS_PTS_REF ldpm_n_1_fusl /end AXIS_DESCR
 /begin AXIS_DESCR COM_AXIS mff_sp_fup_ctl _CNV_A_R_LINEAR_____108_CM 10 0. 1389. FORMAT "%7.2" AXIS_PTS_REF ldpm_mff_sp_fup_ctl_1_fusl /end AXIS_DESCR
/end CHARACTERISTIC
/begin CHARACTERISTIC ip_fup_sp_pu "Fuel pressure setpoint for PU and PUC engine operation" MAP 0xa1024bb4 _REC_MAP_20_u2_u1_u2 347776. _CNV_A_R_LINEAR_____152_CM 0. 347776. DISPLAY_IDENTIFIER IP_FUP_SP_PU FORMAT "%6.0"
 /begin AXIS_DESCR COM_AXIS n_32 _CNV_A_R_LINEAR_____9_CM 8 0. 8160. FORMAT "%4.0" AXIS_PTS_REF ldpm_n_1_fusl /end AXIS_DESCR
 /begin AXIS_DESCR COM_AXIS mff_sp_fup_ctl _CNV_A_R_LINEAR_____108_CM 10 0. 1389. FORMAT "%7.2" AXIS_PTS_REF ldpm_mff_sp_fup_ctl_1_fusl /end AXIS_DESCR
/end CHARACTERISTIC
/begin MEASUREMENT fup_sp "Fuel pressure setpoint" UWORD _CNV_A_R_LINEAR_____152_CM 1 100. 0. 347776. DISPLAY_IDENTIFIER FUP_SP ECU_ADDRESS 0xd0004d20 FORMAT "%6.0" /end MEASUREMENT
/begin MEASUREMENT fup_sp_grd_act "Indicator for gradient limitation out of start active" UBYTE _CNV_A_R_LINEAR_____0_CM 1 100. 0. 15. DISPLAY_IDENTIFIER FUP_SP_GRD_ACT ECU_ADDRESS 0xc00006bc FORMAT "%3.0" /end MEASUREMENT
/begin MEASUREMENT fup_h_sp_s "Fuel pressure setpoint for stratified mode, high range" UWORD _CNV_A_R_LINEAR_____152_CM 1 100. 0. 347776. DISPLAY_IDENTIFIER FUP_H_SP_S ECU_ADDRESS 0xd0004d22 FORMAT "%6.0" /end MEASUREMENT
/begin MEASUREMENT fup_sp_tmp "Fuel pressure setpoint (before limitation)" UWORD _CNV_A_R_LINEAR_____152_CM 1 100. 0. 347776. DISPLAY_IDENTIFIER FUP_SP_TMP ECU_ADDRESS 0xd0004d24 FORMAT "%6.0" /end MEASUREMENT
/begin MEASUREMENT lv_fup_sp_add "Logical variable indicating that the additional fuel pressure setpoint in the puc phase is enable" UBYTE _CNV_S_2_RANGE__0___1_CM 1 100. 0. 1. DISPLAY_IDENTIFIER LV_FUP_SP_ADD ECU_ADDRESS 0xd00039c8 BIT_MASK 0x1 /end MEASUREMENT
/begin CHARACTERISTIC c_fup_sp_st_lgrd_dec "Gradient limitation for fuel pressure setpoint decrement out of start" VALUE 0xa1029482 _REC_VAL_20_u2 347776. _CNV_A_R_LINEAR_____152_CM 0. 347776. DISPLAY_IDENTIFIER C_FUP_SP_ST_LGRD_DEC FORMAT "%6.0" /end CHARACTERISTIC
/begin CHARACTERISTIC c_t_fup_sp_add_1 "time of counter number 1 for additional fuel pressure setpoint in the PUC phase" VALUE 0xa10298a4 _REC_VAL_20_u2 655.35 _CNV_A_R_LINEAR_____3_CM 0. 655.35 DISPLAY_IDENTIFIER C_T_FUP_SP_ADD_1 FORMAT "%6.2" /end CHARACTERISTIC
/begin CHARACTERISTIC c_t_fup_sp_add_2 "time of counter number 2 for additional fuel pressure setpoint in the PUC phase" VALUE 0xa10298a6 _REC_VAL_20_u2 655.35 _CNV_A_R_LINEAR_____3_CM 0. 655.35 DISPLAY_IDENTIFIER C_T_FUP_SP_ADD_2 FORMAT "%6.2" /end CHARACTERISTIC
/begin CHARACTERISTIC c_fup_sp_st "Fuel pressure setpoint during start" VALUE 0xa1029480 _REC_VAL_20_u2 347776. _CNV_A_R_LINEAR_____152_CM 0. 347776. DISPLAY_IDENTIFIER C_FUP_SP_ST FORMAT "%6.0" /end CHARACTERISTIC
/begin CHARACTERISTIC c_fup_sp_add "additional fuel pressure setpoint in the PUC phase" VALUE 0xa102946a _REC_VAL_20_s2 347776. _CNV_A_R_LINEAR_____548_CM -173890.6533608 173885.3466392 DISPLAY_IDENTIFIER C_FUP_SP_ADD FORMAT "%11.2" /end CHARACTERISTIC
/begin CHARACTERISTIC c_fup_sp_lim_inc "Gradient limitation for fuel pressure setpoint increment during normal operation" VALUE 0xa1029476 _REC_VAL_20_u2 347776. _CNV_A_R_LINEAR_____152_CM 0. 347776. DISPLAY_IDENTIFIER C_FUP_SP_LIM_INC FORMAT "%6.0" /end CHARACTERISTIC
/begin CHARACTERISTIC c_fup_sp_lih_vcv_open "FUP setpoint for VCV open limphome" VALUE 0xa1029472 _REC_VAL_20_u2 347776. _CNV_A_R_LINEAR_____152_CM 0. 347776. DISPLAY_IDENTIFIER C_FUP_SP_LIH_VCV_OPEN FORMAT "%6.0" /end CHARACTERISTIC
/begin MEASUREMENT fuel_mass_req "Requested fuel mass from the pump" UWORD _CNV_A_R_LINEAR_____160_CM 1 100. 0. 1389. DISPLAY_IDENTIFIER FUEL_MASS_REQ ECU_ADDRESS 0xd0004d1a FORMAT "%7.2" /end MEASUREMENT
/begin MEASUREMENT fuel_mass_ad "Adaptive fuel mass" SWORD _CNV_A_R_LINEAR_____552_CM 1 100. -694.5 694.478806 DISPLAY_IDENTIFIER FUEL_MASS_AD ECU_ADDRESS 0xd0004d14 FORMAT "%7.2" /end MEASUREMENT
/begin MEASUREMENT fuel_mass_ad_dif "Deviation of the fuel mass for the adaptation" SWORD _CNV_A_R_LINEAR_____552_CM 1 100. -694.5 694.478806 DISPLAY_IDENTIFIER FUEL_MASS_AD_DIF ECU_ADDRESS 0xd0004d16 FORMAT "%7.2" /end MEASUREMENT
/begin MEASUREMENT fuel_mass_req_pctl "Requested fuel mass from the precontroller" SWORD _CNV_A_R_LINEAR_____552_CM 1 100. -694.5 694.478806 DISPLAY_IDENTIFIER FUEL_MASS_REQ_PCTL ECU_ADDRESS 0xc0000682 FORMAT "%7.2" /end MEASUREMENT
/begin MEASUREMENT fac_clc_fuel_mass_fup "Factor for compressibility and density of gasoline and rail" UBYTE _CNV_A_R_LINEAR_____553_CM 1 100. 0. 510. DISPLAY_IDENTIFIER FAC_CLC_FUEL_MASS_FUP ECU_ADDRESS 0xd00039bc FORMAT "%3.0" /end MEASUREMENT
/begin MEASUREMENT fuel_mass_req_ctl "Controller output" SWORD _CNV_A_R_LINEAR_____552_CM 1 100. -694.5 694.478806 DISPLAY_IDENTIFIER FUEL_MASS_REQ_CTL ECU_ADDRESS 0xc0000684 FORMAT "%7.2" /end MEASUREMENT
/begin MEASUREMENT fup_dif_ctl "Deviation of measured fuel pressure and FUP_MDL or FUP_SP (depending on LC_USE_FUP_MDL_CTL)" SWORD _CNV_A_R_LINEAR_____548_CM 1 100. -173890.6533608 173885.3466392 DISPLAY_IDENTIFIER FUP_DIF_CTL ECU_ADDRESS 0xc000068c FORMAT "%9.2" /end MEASUREMENT
/begin MEASUREMENT fuel_mass_req_p_ctl "P-part of the controller" SWORD _CNV_A_R_LINEAR_____552_CM 1 100. -694.5 694.478806 DISPLAY_IDENTIFIER FUEL_MASS_REQ_P_CTL ECU_ADDRESS 0xc0000686 FORMAT "%7.2" /end MEASUREMENT
/begin MEASUREMENT fuel_mass_req_i_ctl_mmv "Mean value of the I-part of the controller" SWORD _CNV_A_R_LINEAR_____552_CM 1 100. -694.5 694.478806 DISPLAY_IDENTIFIER FUEL_MASS_REQ_I_CTL_MMV ECU_ADDRESS 0xc0000688 FORMAT "%7.2" /end MEASUREMENT
/begin MEASUREMENT fup_dif_pctl "Deviation of fuel pressure setpoint and FUP_MDL or FUP (depending on LC_USE_FUP_MDL_PCTL)" SWORD _CNV_A_R_LINEAR_____548_CM 1 100. -173890.6533608 173885.3466392 DISPLAY_IDENTIFIER FUP_DIF_PCTL ECU_ADDRESS 0xc000068a FORMAT "%9.2" /end MEASUREMENT
/begin MEASUREMENT fuel_mass_req_pctl_tmp "Requested fuel mass from the precontroller (without the influence of the weighting factor)" SWORD _CNV_A_R_LINEAR_____552_CM 1 100. -694.5 694.478806 DISPLAY_IDENTIFIER FUEL_MASS_REQ_PCTL_TMP ECU_ADDRESS 0xc0000680 FORMAT "%7.2" /end MEASUREMENT
/begin MEASUREMENT seg_ctr_fuel_mass_ad "Segment counter before adaptation is allowed" UWORD _CNV_A_R_LINEAR_____0_CM 1 100. 0. 65535. DISPLAY_IDENTIFIER SEG_CTR_FUEL_MASS_AD ECU_ADDRESS 0xc0000690 FORMAT "%5.0" /end MEASUREMENT
/begin MEASUREMENT fup_dif "Deviation of fuel pressure setpoint and measured fuel pressure" SWORD _CNV_A_R_LINEAR_____548_CM 1 100. -173890.6533608 173885.3466392 DISPLAY_IDENTIFIER FUP_DIF ECU_ADDRESS 0xd0004d18 FORMAT "%9.2" /end MEASUREMENT
/begin CHARACTERISTIC ip_fuel_mass_req_p_ctl "P-part of the controller" CURVE 0xa1024a1c _REC_CUR_20_u2_u2 1388.978806 _CNV_A_R_LINEAR_____554_CM -694.5 694.478806 DISPLAY_IDENTIFIER IP_FUEL_MASS_REQ_P_CTL FORMAT "%7.2"
 /begin AXIS_DESCR COM_AXIS fup_dif_ctl _CNV_A_R_LINEAR_____555_CM 8 -173890.6533608 173885.3466392 FORMAT "%9.2" AXIS_PTS_REF ldpm_fup_dif_ctl_1_fusl /end AXIS_DESCR
/end CHARACTERISTIC
/begin CHARACTERISTIC ip_fuel_mass_req_i_ctl "I-part of the controller" CURVE 0xa1024a0c _REC_CUR_20_u2_u2 138.8978805541992 _CNV_A_R_LINEAR_____556_CM -69.45 69.4478805541992 DISPLAY_IDENTIFIER IP_FUEL_MASS_REQ_I_CTL FORMAT "%7.3"
 /begin AXIS_DESCR COM_AXIS fup_dif_ctl _CNV_A_R_LINEAR_____555_CM 8 -173890.6533608 173885.3466392 FORMAT "%9.2" AXIS_PTS_REF ldpm_fup_dif_ctl_1_fusl /end AXIS_DESCR
/end CHARACTERISTIC
/begin CHARACTERISTIC ip_fac_clc_fuel_mass_fup "Factor for compressibility and density of gasoline and rail" CURVE 0xa1023458 _REC_CUR_20_u1_u1 510. _CNV_A_R_LINEAR_____553_CM 0. 510. DISPLAY_IDENTIFIER IP_FAC_CLC_FUEL_MASS_FUP FORMAT "%3.0"
 /begin AXIS_DESCR COM_AXIS tfu _CNV_A_R_LINEAR_____16_CM 3 -48. 142.5 FORMAT "%6.2" AXIS_PTS_REF ldp_tfu_ip_fac_clc_fuel_mass /end AXIS_DESCR
/end CHARACTERISTIC
/begin AXIS_PTS ldp_fup_dif_pctl_ip_fac_fuel "" 0xa1020a50 fup_dif_pctl _REC_AXS_20_u2 347776. _CNV_A_R_LINEAR_____555_CM 8 -173890.6533608 173885.3466392 FORMAT "%9.2" /end AXIS_PTS
/begin AXIS_PTS ldpm_fup_dif_ctl_1_fusl "" 0xa1021aa4 fup_dif_ctl _REC_AXS_20_u2 347776. _CNV_A_R_LINEAR_____555_CM 8 -173890.6533608 173885.3466392 FORMAT "%9.2" /end AXIS_PTS
/begin AXIS_PTS ldp_tfu_ip_fac_clc_fuel_mass "" 0xa1021336 tfu _REC_AXS_20_u1 190.5 _CNV_A_R_LINEAR_____16_CM 3 -48. 142.5 FORMAT "%6.2" /end AXIS_PTS
/begin CHARACTERISTIC c_fuel_mass_req_i_ctl_mmv_crlc "Filter constant for moving mean value calculation of the I-part" VALUE 0xa1029410 _REC_VAL_20_u1 0.99609375 _CNV_A_R_LINEAR_____27_CM 0. 0.99609375 DISPLAY_IDENTIFIER C_FUEL_MASS_REQ_I_CTL_MMV_CRLC FORMAT "%5.3" /end CHARACTERISTIC
/begin CHARACTERISTIC lc_fuel_mass_req_ctl_clr "Switch for enabling CTL/AD part reset at fast pressure decrease" VALUE 0xa1029d3e _REC_VAL_20_u1 1. _CNV_A_R_LINEAR_____0_CM 0. 1. DISPLAY_IDENTIFIER LC_FUEL_MASS_REQ_CTL_CLR FORMAT "%1.0" /end CHARACTERISTIC
/begin CHARACTERISTIC lc_use_fuel_mass_req_ctl "Switch for using the controller output for the fuel mass requested calculation" VALUE 0xa1029e09 _REC_VAL_20_u1 1. _CNV_A_R_LINEAR_____0_CM 0. 1. DISPLAY_IDENTIFIER LC_USE_FUEL_MASS_REQ_CTL FORMAT "%1.0" /end CHARACTERISTIC
/begin CHARACTERISTIC c_n_fuel_mass_ad_min "Minimum engine speed threshold for allowing adaptive fuel mass" VALUE 0xa10295f9 _REC_VAL_20_u1 8160. _CNV_A_R_LINEAR_____9_CM 0. 8160. DISPLAY_IDENTIFIER C_N_FUEL_MASS_AD_MIN FORMAT "%4.0" /end CHARACTERISTIC
/begin CHARACTERISTIC c_n_fuel_mass_ad_max "Maximum engine speed threshold for allowing adaptive fuel mass" VALUE 0xa10295f8 _REC_VAL_20_u1 8160. _CNV_A_R_LINEAR_____9_CM 0. 8160. DISPLAY_IDENTIFIER C_N_FUEL_MASS_AD_MAX FORMAT "%4.0" /end CHARACTERISTIC
/begin CHARACTERISTIC c_fuel_mass_ad_cor_crlc "Filter constant for the fuel mass adaptation" VALUE 0xa10293fa _REC_VAL_20_u1 0.99609375 _CNV_A_R_LINEAR_____27_CM 0. 0.99609375 DISPLAY_IDENTIFIER C_FUEL_MASS_AD_COR_CRLC FORMAT "%5.3" /end CHARACTERISTIC
/begin CHARACTERISTIC c_fuel_mass_ad_max "Maximum adaptive fuel mass" VALUE 0xa1029400 _REC_VAL_20_s2 1388.978806 _CNV_A_R_LINEAR_____552_CM -694.5 694.478806 DISPLAY_IDENTIFIER C_FUEL_MASS_AD_MAX FORMAT "%7.2" /end CHARACTERISTIC
/begin CHARACTERISTIC c_fuel_mass_ad_min "Minimum adaptive fuel mass" VALUE 0xa1029402 _REC_VAL_20_s2 1388.978806 _CNV_A_R_LINEAR_____552_CM -694.5 694.478806 DISPLAY_IDENTIFIER C_FUEL_MASS_AD_MIN FORMAT "%7.2" /end CHARACTERISTIC
/begin CHARACTERISTIC lc_ad_clr_fuel_mass_ad "Switch for resetting the fuel adaptation" VALUE 0xa1029cef _REC_VAL_20_u1 1. _CNV_A_R_LINEAR_____0_CM 0. 1. DISPLAY_IDENTIFIER LC_AD_CLR_FUEL_MASS_AD FORMAT "%1.0" /end CHARACTERISTIC
/begin CHARACTERISTIC c_fuel_mass_req_i_ctl_max "Maximum I-part of the controller" VALUE 0xa102940c _REC_VAL_20_s2 1388.978806 _CNV_A_R_LINEAR_____552_CM -694.5 694.478806 DISPLAY_IDENTIFIER C_FUEL_MASS_REQ_I_CTL_MAX FORMAT "%7.2" /end CHARACTERISTIC
/begin CHARACTERISTIC c_fuel_mass_req_i_ctl_min "Minimum I-part of the controller" VALUE 0xa102940e _REC_VAL_20_s2 1388.978806 _CNV_A_R_LINEAR_____552_CM -694.5 694.478806 DISPLAY_IDENTIFIER C_FUEL_MASS_REQ_I_CTL_MIN FORMAT "%7.2" /end CHARACTERISTIC
/begin MEASUREMENT fac_fuel_mass_req_pctl "weighting factor for the precontroller" UWORD _CNV_A_R_LINEAR_____68_CM 1 100. 0. 0.9999847412109381 DISPLAY_IDENTIFIER FAC_FUEL_MASS_REQ_PCTL ECU_ADDRESS 0xc000068e FORMAT "%7.5" /end MEASUREMENT
/begin CHARACTERISTIC c_seg_ctr_fuel_mass_ad_max "Number of segments with stable conditions before an adaptation occurs" VALUE 0xa102978a _REC_VAL_20_u2 65535. _CNV_A_R_LINEAR_____0_CM 0. 65535. DISPLAY_IDENTIFIER C_SEG_CTR_FUEL_MASS_AD_MAX FORMAT "%5.0" /end CHARACTERISTIC
/begin AXIS_PTS ldpm_n_32_fusl_1 "" 0xa1021e58 n_32 _REC_AXS_20_u1 8160. _CNV_A_R_LINEAR_____9_CM 8 0. 8160. FORMAT "%4.0" /end AXIS_PTS
/begin CHARACTERISTIC ip_fac_fuel_mass_req_ctl "Weighting factor for the controller" CURVE 0xa1023950 _REC_CUR_20_u1_u1 3.984375 _CNV_A_R_LINEAR_____283_CM 0. 3.984375 DISPLAY_IDENTIFIER IP_FAC_FUEL_MASS_REQ_CTL FORMAT "%8.6"
 /begin AXIS_DESCR COM_AXIS n_32 _CNV_A_R_LINEAR_____9_CM 8 0. 8160. FORMAT "%4.0" AXIS_PTS_REF ldpm_n_32_fusl_1 /end AXIS_DESCR
/end CHARACTERISTIC
/begin CHARACTERISTIC c_dly_fup_sp "Delay of the FUP_SP in calculation cycles" VALUE 0xa102930e _REC_VAL_20_u1 5. _CNV_A_R_LINEAR_____0_CM 1. 6. DISPLAY_IDENTIFIER C_DLY_FUP_SP FORMAT "%1.0" /end CHARACTERISTIC
/begin MEASUREMENT lv_fuel_add_act "Logical variable indicating that additional fuel mass is added to precontrol" UBYTE _CNV_S_2_RANGE__0___1_CM 1 100. 0. 1. DISPLAY_IDENTIFIER LV_FUEL_ADD_ACT ECU_ADDRESS 0xc00006a4 BIT_MASK 0x1 /end MEASUREMENT
/begin CHARACTERISTIC c_pv_grd_thd_fuel_add "Pedal value gradient threshold for adding fuel mass" VALUE 0xa1029734 _REC_VAL_20_u1 2490.234 _CNV_A_R_LINEAR_____247_CM -1250. 1240.234 DISPLAY_IDENTIFIER C_PV_GRD_THD_FUEL_ADD FORMAT "%6.1" /end CHARACTERISTIC
/begin CHARACTERISTIC ip_fuel_mass_req_add "Additve fuel mass for the precontroller" CURVE 0xa10249fc _REC_CUR_20_u2_u1 1389. _CNV_A_R_LINEAR_____160_CM 0. 1389. DISPLAY_IDENTIFIER IP_FUEL_MASS_REQ_ADD FORMAT "%7.2"
 /begin AXIS_DESCR COM_AXIS n_32 _CNV_A_R_LINEAR_____9_CM 8 0. 8160. FORMAT "%4.0" AXIS_PTS_REF ldp_n_32_ip_fuel_mass_req_add /end AXIS_DESCR
/end CHARACTERISTIC
/begin CHARACTERISTIC c_pv_thd_fuel_add "Pedal value threshold for adding fuel mass" VALUE 0xa1029736 _REC_VAL_20_u1 99.609375 _CNV_A_R_LINEAR_____5_CM 0. 99.609375 DISPLAY_IDENTIFIER C_PV_THD_FUEL_ADD FORMAT "%9.6" /end CHARACTERISTIC
/begin CHARACTERISTIC c_ctr_cyc_fuel_add "Number of segments where adding additional fuel mass to precontrol is active" VALUE 0xa1029258 _REC_VAL_20_u2 65535. _CNV_A_R_LINEAR_____0_CM 0. 65535. DISPLAY_IDENTIFIER C_CTR_CYC_FUEL_ADD FORMAT "%5.0" /end CHARACTERISTIC
/begin MEASUREMENT fuel_mass_req_i_ctl_h_res "I-part of the controller" SLONG _CNV_A_R_LINEAR_____557_CM 1 100. -694.5 694.499999676598 DISPLAY_IDENTIFIER FUEL_MASS_REQ_I_CTL_H_RES ECU_ADDRESS 0xd000553c FORMAT "%12.7" /end MEASUREMENT
/begin AXIS_PTS ldp_n_32_ip_fuel_mass_req_add "" 0xa1020e18 n_32 _REC_AXS_20_u1 8160. _CNV_A_R_LINEAR_____9_CM 8 0. 8160. FORMAT "%4.0" /end AXIS_PTS
/begin AXIS_PTS ldp_n_32_ip_fac_n_fuel_req_pctl "" 0xa1020e00 n_32 _REC_AXS_20_u1 8160. _CNV_A_R_LINEAR_____9_CM 8 0. 8160. FORMAT "%4.0" /end AXIS_PTS
/begin CHARACTERISTIC ip_fac_fuel_mass_req_pctl "Weighting factor for the precontroller" CURVE 0xa1023958 _REC_CUR_20_u2_u2 0.9999847412109381 _CNV_A_R_LINEAR_____68_CM 0. 0.9999847412109381 DISPLAY_IDENTIFIER IP_FAC_FUEL_MASS_REQ_PCTL FORMAT "%7.5"
 /begin AXIS_DESCR COM_AXIS fup_dif_pctl _CNV_A_R_LINEAR_____555_CM 8 -173890.6533608 173885.3466392 FORMAT "%9.2" AXIS_PTS_REF ldp_fup_dif_pctl_ip_fac_fuel /end AXIS_DESCR
/end CHARACTERISTIC
/begin CHARACTERISTIC ip_fac_n_mass_fuel_req_pctl "factor for the precontroller depending on engine speed" CURVE 0xa1023b68 _REC_CUR_20_u1_u1 9.960000000000001 _CNV_A_R_LINEAR_____545_CM 0. 9.960000000000001 DISPLAY_IDENTIFIER IP_FAC_N_MASS_FUEL_REQ_PCTL FORMAT "%4.3"
 /begin AXIS_DESCR COM_AXIS n_32 _CNV_A_R_LINEAR_____9_CM 8 0. 8160. FORMAT "%4.0" AXIS_PTS_REF ldp_n_32_ip_fac_n_fuel_req_pctl /end AXIS_DESCR
/end CHARACTERISTIC
/begin CHARACTERISTIC c_clc_fuel_pump_ctl "Amount of segments of calculation recurrency of high pressure pump control" VALUE 0xa10291be _REC_VAL_20_u2 1.99996948242188 _CNV_A_R_LINEAR_____8_CM 0. 1.99996948242188 DISPLAY_IDENTIFIER C_CLC_FUEL_PUMP_CTL FORMAT "%7.5" /end CHARACTERISTIC
/begin CHARACTERISTIC c_fup_ofs_st "Offset to the fuel pressure setpoint for controller strategy switch out of start" VALUE 0xa102944a _REC_VAL_20_u2 347776. _CNV_A_R_LINEAR_____152_CM 0. 347776. DISPLAY_IDENTIFIER C_FUP_OFS_ST FORMAT "%6.0" /end CHARACTERISTIC
/begin CHARACTERISTIC c_fup_ofs_ctl "Offset to the fuel pressure setpoint for controller strategy switch" VALUE 0xa1029444 _REC_VAL_20_u2 347776. _CNV_A_R_LINEAR_____152_CM 0. 347776. DISPLAY_IDENTIFIER C_FUP_OFS_CTL FORMAT "%6.0" /end CHARACTERISTIC
/begin CHARACTERISTIC c_t_dly_fpa_cll_req "Delay time for closed loop control to avoid overheating" VALUE 0xa102984e _REC_VAL_20_u2 655.35 _CNV_A_R_LINEAR_____3_CM 0. 655.35 DISPLAY_IDENTIFIER C_T_DLY_FPA_CLL_REQ FORMAT "%6.2" /end CHARACTERISTIC
/begin CHARACTERISTIC c_t_dly_fpa_prot "Delay time for protection of the component" VALUE 0xa1029850 _REC_VAL_20_u2 655.35 _CNV_A_R_LINEAR_____3_CM 0. 655.35 DISPLAY_IDENTIFIER C_T_DLY_FPA_PROT FORMAT "%6.2" /end CHARACTERISTIC
/begin CHARACTERISTIC c_n_32_fpa "Minimum engine speed for leaving low pressure state" VALUE 0xa10295bb _REC_VAL_20_u1 8160. _CNV_A_R_LINEAR_____9_CM 0. 8160. DISPLAY_IDENTIFIER C_N_32_FPA FORMAT "%4.0" /end CHARACTERISTIC
/begin CHARACTERISTIC c_t_dly_fup_max "Delay time for the maximum fuel pressure to start controller invention" VALUE 0xa102985e _REC_VAL_20_u2 655.35 _CNV_A_R_LINEAR_____3_CM 0. 655.35 DISPLAY_IDENTIFIER C_T_DLY_FUP_MAX FORMAT "%6.2" /end CHARACTERISTIC
/begin MEASUREMENT state_fup_tran "Transistion conditions for the state of the fuel pressure controller" UBYTE _CNV_S_9_RANGE_STAT_558_CM 1 100. 0. 8. DISPLAY_IDENTIFIER STATE_FUP_TRAN ECU_ADDRESS 0xc00006dc /end MEASUREMENT
/begin MEASUREMENT crlc_vcv_fpapwm_ad "Calculation for the adaptation of VCV and FPAPWM" UWORD _CNV_A_R_LINEAR_____23_CM 1 100. 0. 3.99993896484375 DISPLAY_IDENTIFIER CRLC_VCV_FPAPWM_AD ECU_ADDRESS 0xd0004d2e FORMAT "%7.5" /end MEASUREMENT
/begin MEASUREMENT lv_dly_fpa_cll_req "Logical variable for closed-loop control request to avoid overheating" UBYTE _CNV_S_2_RANGE__0___1_CM 1 100. 0. 1. DISPLAY_IDENTIFIER LV_DLY_FPA_CLL_REQ ECU_ADDRESS 0xc00006e0 BIT_MASK 0x1 /end MEASUREMENT
/begin MEASUREMENT state_fup "State of the fuel pressure controller" UBYTE _CNV_S_6_RANGE_STAT_559_CM 1 100. 0. 5. DISPLAY_IDENTIFIER STATE_FUP ECU_ADDRESS 0xd00039cc /end MEASUREMENT
/begin MEASUREMENT lv_fup_req_fpa_ad_auth "Flag for adaptation authorisation of FUP_REQ_FPA" UBYTE _CNV_S_2_RANGE__0___1_CM 1 100. 0. 1. DISPLAY_IDENTIFIER LV_FUP_REQ_FPA_AD_AUTH ECU_ADDRESS 0xd00039cd BIT_MASK 0x1 /end MEASUREMENT
/begin MEASUREMENT lv_fup_req_fpa_ad_inh "Logical variable requesting inhibition of the adaptation of the controller" UBYTE _CNV_S_2_RANGE__0___1_CM 1 100. 0. 1. DISPLAY_IDENTIFIER LV_FUP_REQ_FPA_AD_INH ECU_ADDRESS 0xc00006de BIT_MASK 0x1 /end MEASUREMENT
/begin MEASUREMENT fup_req_fpa "Required fuel pressure from the FPA " UWORD _CNV_A_R_LINEAR_____152_CM 1 100. 0. 347776. DISPLAY_IDENTIFIER FUP_REQ_FPA ECU_ADDRESS 0xd0004d2c FORMAT "%6.0" /end MEASUREMENT
/begin MEASUREMENT fup_req_fpa_pctl "Requested fuel pressure by the precontrol" UWORD _CNV_A_R_LINEAR_____152_CM 1 100. 0. 347776. DISPLAY_IDENTIFIER FUP_REQ_FPA_PCTL ECU_ADDRESS 0xc00006c8 FORMAT "%6.0" /end MEASUREMENT
/begin MEASUREMENT fup_req_fpa_i_ad "Adaptive I-part of FUP_REQ_FPA" SWORD _CNV_A_R_LINEAR_____548_CM 1 100. -173890.6533608 173885.3466392 DISPLAY_IDENTIFIER FUP_REQ_FPA_I_AD ECU_ADDRESS 0xd0004d28 FORMAT "%9.2" /end MEASUREMENT
/begin MEASUREMENT fup_req_fpa_p "P-part of FUP_REQ_FPA" SWORD _CNV_A_R_LINEAR_____548_CM 1 100. -173890.6533608 173885.3466392 DISPLAY_IDENTIFIER FUP_REQ_FPA_P ECU_ADDRESS 0xc00006c0 FORMAT "%9.2" /end MEASUREMENT
/begin MEASUREMENT lv_fpapwm_ad "Logical variable indicating adaptation of FPAPWM" UBYTE _CNV_S_2_RANGE__0___1_CM 1 100. 0. 1. DISPLAY_IDENTIFIER LV_FPAPWM_AD ECU_ADDRESS 0xc00006df BIT_MASK 0x1 /end MEASUREMENT
/begin MEASUREMENT fpa_mff_mem "Memorized fuel flow through the regulator" UWORD _CNV_A_R_LINEAR_____156_CM 1 100. 0. 255. DISPLAY_IDENTIFIER FPA_MFF_MEM ECU_ADDRESS 0xc00006cc FORMAT "%7.3" /end MEASUREMENT
/begin MEASUREMENT fpapwm_mem "Memorized global fuel pressure regulation" UWORD _CNV_A_R_LINEAR_____7_CM 1 100. 0. 99.99847412109381 DISPLAY_IDENTIFIER FPAPWM_MEM ECU_ADDRESS 0xc00006ce /end MEASUREMENT
/begin MEASUREMENT fup_sp_fil "Filtered fuel pressure setpoint" UWORD _CNV_A_R_LINEAR_____152_CM 1 100. 0. 347776. DISPLAY_IDENTIFIER FUP_SP_FIL ECU_ADDRESS 0xc00006d0 FORMAT "%6.0" /end MEASUREMENT
/begin MEASUREMENT t_dly_fpapwm_ad "Delay for the FPAPWM adaptation" UWORD _CNV_A_R_LINEAR_____3_CM 1 100. 0. 655.35 DISPLAY_IDENTIFIER T_DLY_FPAPWM_AD ECU_ADDRESS 0xc00006ca FORMAT "%6.2" /end MEASUREMENT
/begin MEASUREMENT t_dly_fpa_prot "Delay time for protection of the component" UWORD _CNV_A_R_LINEAR_____3_CM 1 100. 0. 655.35 DISPLAY_IDENTIFIER T_DLY_FPA_PROT ECU_ADDRESS 0xc00006d2 FORMAT "%6.2" /end MEASUREMENT
/begin MEASUREMENT t_dly_fup_max "Delay time for the maximum fuel pressure to start controller invention" UWORD _CNV_A_R_LINEAR_____3_CM 1 100. 0. 655.35 DISPLAY_IDENTIFIER T_DLY_FUP_MAX ECU_ADDRESS 0xc00006d4 FORMAT "%6.2" /end MEASUREMENT
/begin MEASUREMENT t_dly_err_fup "Delay time for a fuel pressure error to start controller invention" UWORD _CNV_A_R_LINEAR_____3_CM 1 100. 0. 655.35 DISPLAY_IDENTIFIER T_DLY_ERR_FUP ECU_ADDRESS 0xc00006d6 FORMAT "%6.2" /end MEASUREMENT
/begin MEASUREMENT t_dly_fpa_cll_req "Delay time for closed loop control to avoid overheating" UWORD _CNV_A_R_LINEAR_____3_CM 1 100. 0. 655.35 DISPLAY_IDENTIFIER T_DLY_FPA_CLL_REQ ECU_ADDRESS 0xc00006d8 FORMAT "%6.2" /end MEASUREMENT
/begin MEASUREMENT fup_dif_dly "Deviation of FUP_SP and FUP with the delay of FUP_SP" SWORD _CNV_A_R_LINEAR_____548_CM 1 100. -173890.6533608 173885.3466392 DISPLAY_IDENTIFIER FUP_DIF_DLY ECU_ADDRESS 0xc00006c2 FORMAT "%9.2" /end MEASUREMENT
/begin MEASUREMENT fup_req_fpa_i "I-part of FUP_REQ_FPA" SWORD _CNV_A_R_LINEAR_____548_CM 1 100. -173890.6533608 173885.3466392 DISPLAY_IDENTIFIER FUP_REQ_FPA_I ECU_ADDRESS 0xd0004d2a FORMAT "%9.2" /end MEASUREMENT
/begin MEASUREMENT fup_req_fpa_i_tmp "Temporary I-part of FUP_REQ_FPA" SWORD _CNV_A_R_LINEAR_____548_CM 1 100. -173890.6533608 173885.3466392 DISPLAY_IDENTIFIER FUP_REQ_FPA_I_TMP ECU_ADDRESS 0xc00006c4 FORMAT "%9.2" /end MEASUREMENT
/begin CHARACTERISTIC c_t_dly_err_fup "Delay time for a fuel pressure error to start controller invention" VALUE 0xa102984a _REC_VAL_20_u2 655.35 _CNV_A_R_LINEAR_____3_CM 0. 655.35 DISPLAY_IDENTIFIER C_T_DLY_ERR_FUP FORMAT "%6.2" /end CHARACTERISTIC
/begin CHARACTERISTIC c_fup_max "Maximum fuel pressure without controller intervention" VALUE 0xa102943e _REC_VAL_20_u2 347776. _CNV_A_R_LINEAR_____152_CM 0. 347776. DISPLAY_IDENTIFIER C_FUP_MAX FORMAT "%6.0" /end CHARACTERISTIC
/begin CHARACTERISTIC c_fup_req_fpa_max "Maximum value for FUP_REQ_FPA" VALUE 0xa1029464 _REC_VAL_20_u2 347776. _CNV_A_R_LINEAR_____152_CM 0. 347776. DISPLAY_IDENTIFIER C_FUP_REQ_FPA_MAX FORMAT "%6.0" /end CHARACTERISTIC
/begin CHARACTERISTIC c_fpa_mff_min_ad "Minimum adaptive value for the flow through the regulator for adaptation" VALUE 0xa10293d8 _REC_VAL_20_u2 255. _CNV_A_R_LINEAR_____156_CM 0. 255. DISPLAY_IDENTIFIER C_FPA_MFF_MIN_AD FORMAT "%7.3" /end CHARACTERISTIC
/begin CHARACTERISTIC c_fup_dif_ad "Fuel pressure deviation limit for adaptation" VALUE 0xa1029416 _REC_VAL_20_u2 347776. _CNV_A_R_LINEAR_____152_CM 0. 347776. DISPLAY_IDENTIFIER C_FUP_DIF_AD FORMAT "%6.0" /end CHARACTERISTIC
/begin CHARACTERISTIC c_t_dly_fpapwm_ad "Delay time for the FPAPWM adaptation" VALUE 0xa1029852 _REC_VAL_20_u2 655.35 _CNV_A_R_LINEAR_____3_CM 0. 655.35 DISPLAY_IDENTIFIER C_T_DLY_FPAPWM_AD FORMAT "%6.2" /end CHARACTERISTIC
/begin CHARACTERISTIC c_fpa_mff_dif_ad "Deviation limit for the flow through the regulator for adaptation" VALUE 0xa10293d6 _REC_VAL_20_u2 255. _CNV_A_R_LINEAR_____156_CM 0. 255. DISPLAY_IDENTIFIER C_FPA_MFF_DIF_AD FORMAT "%7.3" /end CHARACTERISTIC
/begin CHARACTERISTIC c_fpapwm_dif_ad "Deviation limit for the FPAPWM" VALUE 0xa10293da _REC_VAL_20_u2 99.99847412109381 _CNV_A_R_LINEAR_____7_CM 0. 99.99847412109381 DISPLAY_IDENTIFIER C_FPAPWM_DIF_AD /end CHARACTERISTIC
/begin CHARACTERISTIC c_n_fup_ad_min "Minimum engine speed threshold for allowing adaption of FUP_REQ_FPA" VALUE 0xa10295fb _REC_VAL_20_u1 8160. _CNV_A_R_LINEAR_____9_CM 0. 8160. DISPLAY_IDENTIFIER C_N_FUP_AD_MIN FORMAT "%4.0" /end CHARACTERISTIC
/begin CHARACTERISTIC c_tq_fup_ad_min "Minimium torque for allowing FUP_REQ_FPA adaptation" VALUE 0xa1029afc _REC_VAL_20_u2 1023.96875 _CNV_A_R_LINEAR_____30_CM 0. 1023.96875 DISPLAY_IDENTIFIER C_TQ_FUP_AD_MIN FORMAT "%7.2" /end CHARACTERISTIC
/begin CHARACTERISTIC c_tq_fup_ad_max "Maximum torque for allowing FUP_REQ_FPA adaptation" VALUE 0xa1029afa _REC_VAL_20_u2 1023.96875 _CNV_A_R_LINEAR_____30_CM 0. 1023.96875 DISPLAY_IDENTIFIER C_TQ_FUP_AD_MAX FORMAT "%7.2" /end CHARACTERISTIC
/begin CHARACTERISTIC c_n_fup_ad_max "Maximum engine speed threshold for allowing adaption of FUP_REQ_FPA" VALUE 0xa10295fa _REC_VAL_20_u1 8160. _CNV_A_R_LINEAR_____9_CM 0. 8160. DISPLAY_IDENTIFIER C_N_FUP_AD_MAX FORMAT "%4.0" /end CHARACTERISTIC
/begin CHARACTERISTIC c_fup_req_fpa_ini "Intial value for FUP_REQ_FPA" VALUE 0xa1029462 _REC_VAL_20_u2 347776. _CNV_A_R_LINEAR_____152_CM 0. 347776. DISPLAY_IDENTIFIER C_FUP_REQ_FPA_INI FORMAT "%6.0" /end CHARACTERISTIC
/begin CHARACTERISTIC c_fup_req_fpa_i_ad_min "Minimum value for adaptive part of FUP_REQ_FPA" VALUE 0xa102945c _REC_VAL_20_s2 347776. _CNV_A_R_LINEAR_____548_CM -173890.6533608 173885.3466392 DISPLAY_IDENTIFIER C_FUP_REQ_FPA_I_AD_MIN FORMAT "%9.2" /end CHARACTERISTIC
/begin CHARACTERISTIC lc_ad_clr_fup_fpa_i_ad "Switch for reseting the FUP_REQ_FPA adaptation" VALUE 0xa1029cf0 _REC_VAL_20_u1 1. _CNV_A_R_LINEAR_____0_CM 0. 1. DISPLAY_IDENTIFIER LC_AD_CLR_FUP_FPA_I_AD FORMAT "%1.0" /end CHARACTERISTIC
/begin CHARACTERISTIC c_crlc_vcv_fpapwm_ad "Correlation for the adaptation of VCV and FPAPWM" VALUE 0xa1029242 _REC_VAL_20_u2 3.99993896484375 _CNV_A_R_LINEAR_____23_CM 0. 3.99993896484375 DISPLAY_IDENTIFIER C_CRLC_VCV_FPAPWM_AD FORMAT "%7.5" /end CHARACTERISTIC
/begin CHARACTERISTIC c_fup_req_fpa_i_ad_max "Maximum value for adaptive part of FUP_REQ_FPA" VALUE 0xa102945a _REC_VAL_20_s2 347776. _CNV_A_R_LINEAR_____548_CM -173890.6533608 173885.3466392 DISPLAY_IDENTIFIER C_FUP_REQ_FPA_I_AD_MAX FORMAT "%9.2" /end CHARACTERISTIC
/begin CHARACTERISTIC c_fup_req_fpa_i_max "Maximum value for integral part of FUP_REQ_FPA" VALUE 0xa102945e _REC_VAL_20_s2 347776. _CNV_A_R_LINEAR_____548_CM -173890.6533608 173885.3466392 DISPLAY_IDENTIFIER C_FUP_REQ_FPA_I_MAX FORMAT "%9.2" /end CHARACTERISTIC
/begin CHARACTERISTIC c_fup_req_fpa_i_min "Minimum value for integral part of FUP_REQ_FPA" VALUE 0xa1029460 _REC_VAL_20_s2 347776. _CNV_A_R_LINEAR_____548_CM -173890.6533608 173885.3466392 DISPLAY_IDENTIFIER C_FUP_REQ_FPA_I_MIN FORMAT "%9.2" /end CHARACTERISTIC
/begin CHARACTERISTIC c_fup_req_fpa_min "Minimum value for FUP_REQ_FPA" VALUE 0xa1029466 _REC_VAL_20_u2 347776. _CNV_A_R_LINEAR_____152_CM 0. 347776. DISPLAY_IDENTIFIER C_FUP_REQ_FPA_MIN FORMAT "%6.0" /end CHARACTERISTIC
/begin CHARACTERISTIC c_fup_sp_pctl_crlc "FUP_SP correlation constant for the precontrol of FPA_REQ_FPA" VALUE 0xa102947a _REC_VAL_20_u1 0.99609375 _CNV_A_R_LINEAR_____27_CM 0. 0.99609375 DISPLAY_IDENTIFIER C_FUP_SP_PCTL_CRLC FORMAT "%5.3" /end CHARACTERISTIC
/begin CHARACTERISTIC c_fup_sp_crlc "Correlation constant for the FUP_SP for the PI-control" VALUE 0xa102946c _REC_VAL_20_u1 0.99609375 _CNV_A_R_LINEAR_____27_CM 0. 0.99609375 DISPLAY_IDENTIFIER C_FUP_SP_CRLC FORMAT "%5.3" /end CHARACTERISTIC
/begin AXIS_PTS ldp_fup_sp_dif_ip_fac_fup_sp "" 0xa1020ac8 online_dummy _REC_AXS_20_u2 347776. _CNV_A_R_LINEAR_____555_CM 8 -173890.6533608 173885.3466392 FORMAT "%9.2" /end AXIS_PTS
/begin AXIS_PTS ldpm_fup_dif_dly_fusl_1 "" 0xa1021ab8 fup_dif_dly _REC_AXS_20_u2 347776. _CNV_A_R_LINEAR_____555_CM 8 -173890.6533608 173885.3466392 FORMAT "%9.2" /end AXIS_PTS
/begin CHARACTERISTIC ip_fac_fup_sp_pctl "Factor for fuel pressure setpoint change influence to the feed forward controller" CURVE 0xa1023968 _REC_CUR_20_u2_u2 0.9999847412109381 _CNV_A_R_LINEAR_____68_CM 0. 0.9999847412109381 DISPLAY_IDENTIFIER IP_FAC_FUP_SP_PCTL FORMAT "%7.5"
 /begin AXIS_DESCR COM_AXIS online_dummy _CNV_A_R_LINEAR_____555_CM 8 -173890.6533608 173885.3466392 FORMAT "%9.2" AXIS_PTS_REF ldp_fup_sp_dif_ip_fac_fup_sp /end AXIS_DESCR
/end CHARACTERISTIC
/begin CHARACTERISTIC ip_fup_req_fpa_p "Proportional parameter of FUP_REQ_FPA" CURVE 0xa1024b04 _REC_CUR_20_u2_u2 347776. _CNV_A_R_LINEAR_____555_CM -173890.6533608 173885.3466392 DISPLAY_IDENTIFIER IP_FUP_REQ_FPA_P FORMAT "%9.2"
 /begin AXIS_DESCR COM_AXIS fup_dif_dly _CNV_A_R_LINEAR_____555_CM 8 -173890.6533608 173885.3466392 FORMAT "%9.2" AXIS_PTS_REF ldpm_fup_dif_dly_fusl_1 /end AXIS_DESCR
/end CHARACTERISTIC
/begin CHARACTERISTIC ip_fup_req_fpa_i "Integral parameter of FUP_REQ_FPA" CURVE 0xa1024af4 _REC_CUR_20_u2_u2 347776. _CNV_A_R_LINEAR_____555_CM -173890.6533608 173885.3466392 DISPLAY_IDENTIFIER IP_FUP_REQ_FPA_I FORMAT "%9.2"
 /begin AXIS_DESCR COM_AXIS fup_dif_dly _CNV_A_R_LINEAR_____555_CM 8 -173890.6533608 173885.3466392 FORMAT "%9.2" AXIS_PTS_REF ldpm_fup_dif_dly_fusl_1 /end AXIS_DESCR
/end CHARACTERISTIC
/begin MEASUREMENT fpapwm "Global fuel pressure regulation" UWORD _CNV_A_R_LINEAR_____7_CM 1 100. 0. 99.99847412109381 DISPLAY_IDENTIFIER FPAPWM ECU_ADDRESS 0xd0004d4c /end MEASUREMENT
/begin MEASUREMENT frq_req_fpa " Required frequency for the regulator " UWORD _CNV_A_R_LINEAR_____305_CM 1 100. 10. 1023. DISPLAY_IDENTIFIER FRQ_REQ_FPA ECU_ADDRESS 0xd0004d4e FORMAT "%4.0" /end MEASUREMENT
/begin MEASUREMENT fpapwm_ctl "FPAPWM out of the base map" UWORD _CNV_A_R_LINEAR_____7_CM 1 100. 0. 99.99847412109381 DISPLAY_IDENTIFIER FPAPWM_CTL ECU_ADDRESS 0xc0000924 /end MEASUREMENT
/begin MEASUREMENT fpapwm_req "Requested FPAPWM (before gradient limitation)" UWORD _CNV_A_R_LINEAR_____7_CM 1 100. 0. 99.99847412109381 DISPLAY_IDENTIFIER FPAPWM_REQ ECU_ADDRESS 0xc0000928 /end MEASUREMENT
/begin CHARACTERISTIC c_fpapwm_min "Minimum FPAPWM" VALUE 0xa10293e2 _REC_VAL_20_u2 99.99847412109381 _CNV_A_R_LINEAR_____7_CM 0. 99.99847412109381 DISPLAY_IDENTIFIER C_FPAPWM_MIN /end CHARACTERISTIC
/begin CHARACTERISTIC c_frq_fpapwm_stnd "Required frequency for the regulator for standard operation" VALUE 0xa10293e8 _REC_VAL_20_u2 1013. _CNV_A_R_LINEAR_____305_CM 10. 1023. DISPLAY_IDENTIFIER C_FRQ_FPAPWM_STND FORMAT "%4.0" /end CHARACTERISTIC
/begin CHARACTERISTIC c_fpapwm_man "Manual FPAPWM" VALUE 0xa10293e0 _REC_VAL_20_u2 99.99847412109381 _CNV_A_R_LINEAR_____7_CM 0. 99.99847412109381 DISPLAY_IDENTIFIER C_FPAPWM_MAN /end CHARACTERISTIC
/begin AXIS_PTS ldp_fup_req_fpa_ip_fpapwm_bas "" 0xa1020aa0 fup_req_fpa _REC_AXS_20_u2 347776. _CNV_A_R_LINEAR_____152_CM 8 0. 347776. FORMAT "%6.0" /end AXIS_PTS
/begin CHARACTERISTIC ip_fpapwm_bas "Base map for the FPAPWM depending on the required fuel pressure in the rail" CURVE 0xa10249dc _REC_CUR_20_u2_u2 99.99847412109381 _CNV_A_R_LINEAR_____7_CM 0. 99.99847412109381 DISPLAY_IDENTIFIER IP_FPAPWM_BAS
 /begin AXIS_DESCR COM_AXIS fup_req_fpa _CNV_A_R_LINEAR_____152_CM 8 0. 347776. FORMAT "%6.0" AXIS_PTS_REF ldp_fup_req_fpa_ip_fpapwm_bas /end AXIS_DESCR
/end CHARACTERISTIC
/begin AXIS_PTS ldp_tfpa_ip_fac_fpapwm "" 0xa1021324 tfpa _REC_AXS_20_u1 190.5 _CNV_A_R_LINEAR_____16_CM 8 -48. 142.5 FORMAT "%5.1" /end AXIS_PTS
/begin MEASUREMENT lv_fup_req_fpa_stop_req "Logical variable for request of 'freezing' the  I-part of the pressure controller" UBYTE _CNV_S_2_RANGE__0___1_CM 1 100. 0. 1. DISPLAY_IDENTIFIER LV_FUP_REQ_FPA_STOP_REQ ECU_ADDRESS 0xd00039d5 BIT_MASK 0x1 /end MEASUREMENT
/begin CHARACTERISTIC ip_fac_fpapwm_tfpa "Correction factor for the FPAPWM by the actuator temperature" CURVE 0xa1023940 _REC_CUR_20_u1_u1 0.99609375 _CNV_A_R_LINEAR_____71_CM 0. 0.99609375 DISPLAY_IDENTIFIER IP_FAC_FPAPWM_TFPA FORMAT "%5.3"
 /begin AXIS_DESCR COM_AXIS tfpa _CNV_A_R_LINEAR_____16_CM 8 -48. 142.5 FORMAT "%5.1" AXIS_PTS_REF ldp_tfpa_ip_fac_fpapwm /end AXIS_DESCR
/end CHARACTERISTIC
/begin CHARACTERISTIC ip_fpapwm_max "Maximum FPAPWM depending on battery voltage" CURVE 0xa10249ec _REC_CUR_20_u2_u2 99.99847412109381 _CNV_A_R_LINEAR_____7_CM 0. 99.99847412109381 DISPLAY_IDENTIFIER IP_FPAPWM_MAX
 /begin AXIS_DESCR COM_AXIS fup_sp _CNV_A_R_LINEAR_____152_CM 8 0. 347776. FORMAT "%6.0" AXIS_PTS_REF ldp_fup_sp_ip_fpapwm_max /end AXIS_DESCR
/end CHARACTERISTIC
/begin MEASUREMENT state_fpa "State diagram for the regulator control" UBYTE _CNV_S_6_RANGE_STAT_560_CM 1 100. 0. 5. DISPLAY_IDENTIFIER STATE_FPA ECU_ADDRESS 0xd00039d4 /end MEASUREMENT
/begin MEASUREMENT state_fpa_tran "Transistion conditions for STATE_FPA" UBYTE _CNV_S_9_RANGE_STAT_561_CM 1 100. 0. 8. DISPLAY_IDENTIFIER STATE_FPA_TRAN ECU_ADDRESS 0xc000092c /end MEASUREMENT
/begin CHARACTERISTIC c_fpapwm_lim_inc "Gradient limitation for increment of FPAPWM" VALUE 0xa10293de _REC_VAL_20_u2 99.99847412109381 _CNV_A_R_LINEAR_____7_CM 0. 99.99847412109381 DISPLAY_IDENTIFIER C_FPAPWM_LIM_INC /end CHARACTERISTIC
/begin CHARACTERISTIC c_frq_fpapwm_opl "Required frequency for the regulator for open loop" VALUE 0xa10293e6 _REC_VAL_20_u2 1013. _CNV_A_R_LINEAR_____305_CM 10. 1023. DISPLAY_IDENTIFIER C_FRQ_FPAPWM_OPL FORMAT "%4.0" /end CHARACTERISTIC
/begin MEASUREMENT fpapwm_bas "Basic fuel pressure regulation term" UWORD _CNV_A_R_LINEAR_____7_CM 1 100. 0. 99.99847412109381 DISPLAY_IDENTIFIER FPAPWM_BAS ECU_ADDRESS 0xc0000920 /end MEASUREMENT
/begin MEASUREMENT fpapwm_min " Minimum FPAPWM" UWORD _CNV_A_R_LINEAR_____7_CM 1 100. 0. 99.99847412109381 DISPLAY_IDENTIFIER FPAPWM_MIN ECU_ADDRESS 0xc0000926 /end MEASUREMENT
/begin MEASUREMENT fpapwm_max " Maximum FPAPWM" UWORD _CNV_A_R_LINEAR_____7_CM 1 100. 0. 99.99847412109381 DISPLAY_IDENTIFIER FPAPWM_MAX ECU_ADDRESS 0xc0000922 /end MEASUREMENT
/begin CHARACTERISTIC c_frq_fpapwm_close "Required frequency for the regulator for closing" VALUE 0xa10293e4 _REC_VAL_20_u2 1013. _CNV_A_R_LINEAR_____305_CM 10. 1023. DISPLAY_IDENTIFIER C_FRQ_FPAPWM_CLOSE FORMAT "%4.0" /end CHARACTERISTIC
/begin CHARACTERISTIC ip_fac_fpapwm_vb "Correction factor for the FPAPWM by the battery voltage" CURVE 0xa1023948 _REC_CUR_20_u1_u1 1.9921875 _CNV_A_R_LINEAR_____100_CM 0. 1.9921875 DISPLAY_IDENTIFIER IP_FAC_FPAPWM_VB FORMAT "%5.3"
 /begin AXIS_DESCR COM_AXIS vb _CNV_A_R_LINEAR_____289_CM 8 0. 25.8984375 FORMAT "%9.6" AXIS_PTS_REF ldpm_vb_fusl /end AXIS_DESCR
/end CHARACTERISTIC
/begin AXIS_PTS ldp_fup_sp_ip_fpapwm_max "" 0xa1020adc fup_sp _REC_AXS_20_u2 347776. _CNV_A_R_LINEAR_____152_CM 8 0. 347776. FORMAT "%6.0" /end AXIS_PTS
/begin MEASUREMENT lv_fup_req_fpa_rst_req "Logical variable for reseting P and I-part of the pressure controller" UBYTE _CNV_S_2_RANGE__0___1_CM 1 100. 0. 1. DISPLAY_IDENTIFIER LV_FUP_REQ_FPA_RST_REQ ECU_ADDRESS 0xd00039d6 BIT_MASK 0x1 /end MEASUREMENT
/begin MEASUREMENT lv_fup_lih_l_prs_ctl_req "Logical variable requesting fuel low pressure control limphome" UBYTE _CNV_S_2_RANGE__0___1_CM 1 100. 0. 1. DISPLAY_IDENTIFIER LV_FUP_LIH_L_PRS_CTL_REQ ECU_ADDRESS 0xd00039d7 BIT_MASK 0x1 /end MEASUREMENT
/begin MEASUREMENT lv_fup_lih_hom_vcv_open_req "Logical variable requesting limphome for VCV open" UBYTE _CNV_S_2_RANGE__0___1_CM 1 100. 0. 1. DISPLAY_IDENTIFIER LV_FUP_LIH_HOM_VCV_OPEN_REQ ECU_ADDRESS 0xd00039d8 BIT_MASK 0x1 /end MEASUREMENT
/begin MEASUREMENT lv_fup_lih_hom_req "Logical variable indicating LIH mode for HPP requested" UBYTE _CNV_S_2_RANGE__0___1_CM 1 100. 0. 1. DISPLAY_IDENTIFIER LV_FUP_LIH_HOM_REQ ECU_ADDRESS 0xd00039d9 BIT_MASK 0x1 /end MEASUREMENT
/begin CHARACTERISTIC c_fpapwm_lim_dec "Gradient limitation for decrement of FPAPWM" VALUE 0xa10293dc _REC_VAL_20_u2 99.99847412109381 _CNV_A_R_LINEAR_____7_CM 0. 99.99847412109381 DISPLAY_IDENTIFIER C_FPAPWM_LIM_DEC /end CHARACTERISTIC
/begin CHARACTERISTIC c_fup_lih_vcv_open "fuel pressure threshold for switching to VCV open limphome mode" VALUE 0xa102943c _REC_VAL_20_u2 347776. _CNV_A_R_LINEAR_____152_CM 0. 347776. DISPLAY_IDENTIFIER C_FUP_LIH_VCV_OPEN FORMAT "%6.0" /end CHARACTERISTIC
/begin CHARACTERISTIC c_t_fup_lih_l_prs_ctl_req "timer for freeze the controller in FUP_LIH_L_PRS_CTL" VALUE 0xa10298a2 _REC_VAL_20_u2 655.35 _CNV_A_R_LINEAR_____3_CM 0. 655.35 DISPLAY_IDENTIFIER C_T_FUP_LIH_L_PRS_CTL_REQ FORMAT "%6.2" /end CHARACTERISTIC
/begin CHARACTERISTIC lc_fpapwm_man_act "Switch for manual FPAPWM" VALUE 0xa1029d3c _REC_VAL_20_u1 1. _CNV_A_R_LINEAR_____0_CM 0. 1. DISPLAY_IDENTIFIER LC_FPAPWM_MAN_ACT FORMAT "%1.0" /end CHARACTERISTIC
/begin CHARACTERISTIC lc_t_fup_lih_l_prs_ctl_req "Switch for enabling of the timer for freeze the controller in FUP_LIH_L_PRS_CTL" VALUE 0xa1029de6 _REC_VAL_20_u1 1. _CNV_A_R_LINEAR_____0_CM 0. 1. DISPLAY_IDENTIFIER LC_T_FUP_LIH_L_PRS_CTL_REQ FORMAT "%1.0" /end CHARACTERISTIC
/begin MEASUREMENT tfpa "Fuel pressure actuator temperature" UBYTE _CNV_A_R_LINEAR_____16_CM 1 100. -48. 142.5 DISPLAY_IDENTIFIER TFPA ECU_ADDRESS 0xd00039dc FORMAT "%5.1" /end MEASUREMENT
/begin MEASUREMENT cur_cns_cwp "current consumption cooling water pump" UBYTE _CNV_A_R_LINEAR_____564_CM 1 100. 0. 127.5 DISPLAY_IDENTIFIER CUR_CNS_CWP ECU_ADDRESS 0xd0003872 FORMAT "%4.1" /end MEASUREMENT
/begin MEASUREMENT lv_cwp_block_deac "cooling water pump blocking not activ" UBYTE _CNV_S_2_RANGE__0___1_CM 1 100. 0. 1. DISPLAY_IDENTIFIER LV_CWP_BLOCK_DEAC ECU_ADDRESS 0xd000387b BIT_MASK 0x1 /end MEASUREMENT
/begin MEASUREMENT lv_cwp_temp_high "" UBYTE _CNV_S_2_RANGE__0___1_CM 1 100. 0. 1. DISPLAY_IDENTIFIER LV_CWP_TEMP_HIGH ECU_ADDRESS 0xd0003877 BIT_MASK 0x1 /end MEASUREMENT
/begin MEASUREMENT lv_cwp_vcc_plaus "" UBYTE _CNV_S_2_RANGE__0___1_CM 1 100. 0. 1. DISPLAY_IDENTIFIER LV_CWP_VCC_PLAUS ECU_ADDRESS 0xd000387a BIT_MASK 0x1 /end MEASUREMENT
/begin MEASUREMENT lv_n_mon_cwp_deac "rpm monitoring cooling water pump deactivated" UBYTE _CNV_S_2_RANGE__0___1_CM 1 100. 0. 1. DISPLAY_IDENTIFIER LV_N_MON_CWP_DEAC ECU_ADDRESS 0xd0003876 BIT_MASK 0x1 /end MEASUREMENT
/begin MEASUREMENT v_cwp "voltage EWP" UBYTE _CNV_A_R_LINEAR_____440_CM 1 100. 0. 25.5 DISPLAY_IDENTIFIER V_CWP ECU_ADDRESS 0xd0003870 FORMAT "%4.1" /end MEASUREMENT
/begin MEASUREMENT temp_el_cwp "electronic temperature coolant water pump" UBYTE _CNV_A_R_ENSD_LINEA_415_CM 1 100. -50. 205. DISPLAY_IDENTIFIER TEMP_EL_CWP ECU_ADDRESS 0xd0003871 FORMAT "%5.0" /end MEASUREMENT
/begin MEASUREMENT n_rel_cwp "actual water pump speed" UBYTE _CNV_A_R_LINEAR_____0_CM 1 100. 0. 255. DISPLAY_IDENTIFIER N_REL_CWP ECU_ADDRESS 0xd000386f FORMAT "%3.0" /end MEASUREMENT
/begin MEASUREMENT lv_cwp_pre_lock "" UBYTE _CNV_S_2_RANGE__0___1_CM 1 100. 0. 1. DISPLAY_IDENTIFIER LV_CWP_PRE_LOCK ECU_ADDRESS 0xd0003879 BIT_MASK 0x1 /end MEASUREMENT
/begin MEASUREMENT lv_cwp_lock "CWP blocked / Current consumption too high" UBYTE _CNV_S_2_RANGE__0___1_CM 1 100. 0. 1. DISPLAY_IDENTIFIER LV_CWP_LOCK ECU_ADDRESS 0xd0003878 BIT_MASK 0x1 /end MEASUREMENT
/begin MEASUREMENT lf_pow_cwp_cod "Register 5 Bit 0...4 / CWP power  HW version (200W or 350/400W)" UBYTE _CNV_A_R_LINEAR_____0_CM 1 100. 0. 255. DISPLAY_IDENTIFIER LF_POW_CWP_COD ECU_ADDRESS 0xd0003873 FORMAT "%3.0" /end MEASUREMENT
/begin MEASUREMENT lf_cwp_info_cod "Register 5 Bit 5...7 <<5 / Supplier information (Pierburg / SiemensVDO)" UBYTE _CNV_A_R_LINEAR_____0_CM 1 100. 0. 255. DISPLAY_IDENTIFIER LF_CWP_INFO_COD ECU_ADDRESS 0xd0003874 FORMAT "%3.0" /end MEASUREMENT
/begin MEASUREMENT lv_cwp_hw_lih_in_chk "Register 6 Bit 2 / Supply voltage to CWP (HW PIN) connected correctly - LIH stategy in case of BSD com. error" UBYTE _CNV_S_2_RANGE__0___1_CM 1 100. 0. 1. DISPLAY_IDENTIFIER LV_CWP_HW_LIH_IN_CHK ECU_ADDRESS 0xd000387d BIT_MASK 0x1 /end MEASUREMENT
/begin CHARACTERISTIC lc_rly_main_man_req "Activation of manual switching of main relay" VALUE 0xa1029dc4 _REC_VAL_20_u1 1. _CNV_A_R_LINEAR_____0_CM 0. 1. DISPLAY_IDENTIFIER LC_RLY_MAIN_MAN_REQ FORMAT "%1.0" /end CHARACTERISTIC
/begin CHARACTERISTIC lc_rly_main_man_adj "Switching main relay" VALUE 0xa1029dc3 _REC_VAL_20_u1 1. _CNV_A_R_LINEAR_____0_CM 0. 1. DISPLAY_IDENTIFIER LC_RLY_MAIN_MAN_ADJ FORMAT "%1.0" /end CHARACTERISTIC
/begin MEASUREMENT lv_rly_main "Main relay control command state" UBYTE _CNV_S_2_RANGE__0___1_CM 1 100. 0. 1. DISPLAY_IDENTIFIER LV_RLY_MAIN ECU_ADDRESS 0xd0003dcc BIT_MASK 0x1 /end MEASUREMENT
/begin MEASUREMENT lv_rly_main_sys "System depending main relay control command state" UBYTE _CNV_S_2_RANGE__0___1_CM 1 100. 0. 1. DISPLAY_IDENTIFIER LV_RLY_MAIN_SYS ECU_ADDRESS 0xc0000b90 BIT_MASK 0x1 /end MEASUREMENT
/begin CHARACTERISTIC lc_rly_hpdi_man_req "Activation of manual switching of HPDI relay" VALUE 0xa1029dc2 _REC_VAL_20_u1 1. _CNV_A_R_LINEAR_____0_CM 0. 1. DISPLAY_IDENTIFIER LC_RLY_HPDI_MAN_REQ FORMAT "%1.0" /end CHARACTERISTIC
/begin CHARACTERISTIC lc_rly_hpdi_man_adj "Switching HPDI relay" VALUE 0xa1029dc1 _REC_VAL_20_u1 1. _CNV_A_R_LINEAR_____0_CM 0. 1. DISPLAY_IDENTIFIER LC_RLY_HPDI_MAN_ADJ FORMAT "%1.0" /end CHARACTERISTIC
/begin MEASUREMENT lv_rly_hpdi "HPDI relay control command state" UBYTE _CNV_S_2_RANGE__0___1_CM 1 100. 0. 1. DISPLAY_IDENTIFIER LV_RLY_HPDI ECU_ADDRESS 0xd0003dd0 BIT_MASK 0x1 /end MEASUREMENT
/begin MEASUREMENT lv_rly_hpdi_sys "System depending HPDI relay control command state" UBYTE _CNV_S_2_RANGE__0___1_CM 1 100. 0. 1. DISPLAY_IDENTIFIER LV_RLY_HPDI_SYS ECU_ADDRESS 0xc0000b8c BIT_MASK 0x1 /end MEASUREMENT
/begin CHARACTERISTIC c_t_ast_min_rly_crcv_heat "Minimal time after start for CRCV_HEAT activation (default: 60s)" VALUE 0xa1029814 _REC_VAL_20_u2 6553.5 _CNV_A_R_LINEAR_____4_CM 0. 6553.5 DISPLAY_IDENTIFIER C_T_AST_MIN_RLY_CRCV_HEAT FORMAT "%6.1" /end CHARACTERISTIC
/begin CHARACTERISTIC c_tia_max_rly_crcv_heat "Maximal intake air temperature for CRCV_HEAT activation (default: 0°C)" VALUE 0xa1029a50 _REC_VAL_20_u1 190.5 _CNV_A_R_LINEAR_____16_CM -48. 142.5 DISPLAY_IDENTIFIER C_TIA_MAX_RLY_CRCV_HEAT FORMAT "%6.2" /end CHARACTERISTIC
/begin CHARACTERISTIC c_tia_hys_rly_crcv_heat "Intake air temperature hysteresis between activation and deactivation of CRCV_HEAT (default: 3°C)" VALUE 0xa1029a4e _REC_VAL_20_u1 190.5 _CNV_A_R_LINEAR_____16_CM -48. 142.5 DISPLAY_IDENTIFIER C_TIA_HYS_RLY_CRCV_HEAT FORMAT "%6.2" /end CHARACTERISTIC
/begin MEASUREMENT lv_rly_crcv_heat "Crankcase ventilation heater relay (1: activated, 0: deactivated)" UBYTE _CNV_S_2_RANGE__0___1_CM 1 100. 0. 1. DISPLAY_IDENTIFIER LV_RLY_CRCV_HEAT ECU_ADDRESS 0xd0003de4 BIT_MASK 0x1 /end MEASUREMENT
/begin COMPU_METHOD _CNV_A_R_LINEAR_____0_CM "" RAT_FUNC "%6.3" "-" COEFFS 0 1. 0. 0 0 1 /end COMPU_METHOD
/begin COMPU_METHOD _CNV_S_2_RANGE__0___1_CM "" TAB_VERB "%6.3" "-" COMPU_TAB_REF _CNV_S_2_RANGE__0___1 /end COMPU_METHOD
/begin COMPU_VTAB _CNV_S_2_RANGE__0___1 "" TAB_VERB 2 0 "0" 1 "1" /end COMPU_VTAB
/begin COMPU_METHOD _CNV_A_R_LINEAR_____2_CM "" RAT_FUNC "%6.3" "V" COEFFS 0 204.8 0. 0 0 1 /end COMPU_METHOD
/begin COMPU_METHOD _CNV_A_R_LINEAR_____3_CM "" RAT_FUNC "%6.3" "s" COEFFS 0 100. 0. 0 0 1 /end COMPU_METHOD
/begin COMPU_METHOD _CNV_A_R_LINEAR_____4_CM "" RAT_FUNC "%6.3" "s" COEFFS 0 10. 0. 0 0 1 /end COMPU_METHOD
/begin COMPU_METHOD _CNV_A_R_LINEAR_____5_CM "" RAT_FUNC "%6.3" "%" COEFFS 0 2.56 0. 0 0 1 /end COMPU_METHOD
/begin COMPU_METHOD _CNV_A_R_LINEAR_____6_CM "" RAT_FUNC "%6.3" "km/h" COEFFS 0 1. 0. 0 0 1 /end COMPU_METHOD
/begin COMPU_METHOD _CNV_A_R_LINEAR_____7_CM "" RAT_FUNC "%6.3" "%" COEFFS 0 655.3599999999997 0. 0 0 1 /end COMPU_METHOD
/begin COMPU_METHOD _CNV_A_R_LINEAR_____8_CM "" RAT_FUNC "%6.3" "-" COEFFS 0 32767.99999999992 0. 0 0 1 /end COMPU_METHOD
/begin COMPU_METHOD _CNV_A_R_LINEAR_____9_CM "" RAT_FUNC "%6.3" "rpm" COEFFS 0 3.125e-002 0. 0 0 1 /end COMPU_METHOD
/begin COMPU_METHOD _CNV_A_R_LINEAR_____10_CM "" RAT_FUNC "%6.3" "-" COEFFS 0 16383.99999935999 -1.280019205296412e-006 0 0 1 /end COMPU_METHOD
/begin COMPU_METHOD _CNV_A_R_LINEAR_____13_CM "" RAT_FUNC "%6.3" "rpm" COEFFS 0 1. 0. 0 0 1 /end COMPU_METHOD
/begin COMPU_METHOD _CNV_A_R_LINEAR_____16_CM "" RAT_FUNC "%6.3" "°C" COEFFS 0 1.333333333333333 64. 0 0 1 /end COMPU_METHOD
/begin COMPU_METHOD _CNV_A_R_LINEAR_____23_CM "" RAT_FUNC "%6.3" "-" COEFFS 0 16384. 0. 0 0 1 /end COMPU_METHOD
/begin COMPU_METHOD _CNV_A_R_LINEAR_____24_CM "" RAT_FUNC "%6.3" "°C" COEFFS 0 1.333333333333333 0. 0 0 1 /end COMPU_METHOD
/begin COMPU_METHOD _CNV_A_R_LINEAR_____25_CM "" RAT_FUNC "%6.3" "°C" COEFFS 0 1. 40. 0 0 1 /end COMPU_METHOD
/begin COMPU_METHOD _CNV_A_R_LINEAR_____27_CM "" RAT_FUNC "%6.3" "-" COEFFS 0 256. 0. 0 0 1 /end COMPU_METHOD
/begin COMPU_METHOD _CNV_A_R_LINEAR_____29_CM "" RAT_FUNC "%6.3" "rpm/s" COEFFS 0 3.125e-002 0. 0 0 1 /end COMPU_METHOD
/begin COMPU_METHOD _CNV_A_R_LINEAR_____30_CM "" RAT_FUNC "%6.3" "Nm" COEFFS 0 32. 0. 0 0 1 /end COMPU_METHOD
/begin COMPU_METHOD _CNV_A_R_LINEAR_____35_CM "" RAT_FUNC "%6.3" "s" COEFFS 0 1. 0. 0 0 1 /end COMPU_METHOD
/begin COMPU_METHOD _CNV_A_R_LINEAR_____36_CM "" RAT_FUNC "%6.3" "V" COEFFS 0 9.807692307692308 0. 0 0 1 /end COMPU_METHOD
/begin COMPU_METHOD _CNV_A_R_LINEAR_____68_CM "" RAT_FUNC "%6.3" "-" COEFFS 0 65535.99999999996 0. 0 0 1 /end COMPU_METHOD
/begin COMPU_METHOD _CNV_A_R_LINEAR_____70_CM "" RAT_FUNC "%6.3" "km" COEFFS 0 0.1 0. 0 0 1 /end COMPU_METHOD
/begin COMPU_METHOD _CNV_A_R_LINEAR_____71_CM "" RAT_FUNC "%6.3" "" COEFFS 0 256. 0. 0 0 1 /end COMPU_METHOD
/begin COMPU_METHOD _CNV_S_2_RANGE______75_CM "" TAB_VERB "%6.3" "" COMPU_TAB_REF _CNV_S_2_RANGE______75 /end COMPU_METHOD
/begin COMPU_VTAB _CNV_S_2_RANGE______75 "" TAB_VERB 2 0 "0" 1 "1" /end COMPU_VTAB
/begin COMPU_METHOD _CNV_A_R_LINEAR_____83_CM "" RAT_FUNC "%6.3" "V" COEFFS 0 10. -50. 0 0 1 /end COMPU_METHOD
/begin COMPU_METHOD _CNV_A_R_LINEAR_____84_CM "" RAT_FUNC "%6.3" "A" COEFFS 0 10. 0. 0 0 1 /end COMPU_METHOD
/begin COMPU_METHOD _CNV_A_R_LINEAR_____85_CM "" RAT_FUNC "%6.3" "rpm" COEFFS 0 2.e-002 0. 0 0 1 /end COMPU_METHOD
/begin COMPU_METHOD _CNV_A_R_LINEAR_____100_CM "" RAT_FUNC "%6.3" "-" COEFFS 0 128. 0. 0 0 1 /end COMPU_METHOD
/begin COMPU_METHOD _CNV_A_R_LINEAR_____108_CM "" RAT_FUNC "%6.3" "mg/stk" COEFFS 0 47.18142548596112 0. 0 0 1 /end COMPU_METHOD
/begin COMPU_METHOD _CNV_A_R_LINEAR_____110_CM "" RAT_FUNC "%6.3" "%" COEFFS 0 655.3599999999997 -1.455191522836685e-011 0 0 1 /end COMPU_METHOD
/begin COMPU_METHOD _CNV_A_R_LINEAR_____122_CM "" RAT_FUNC "%6.3" "-" COEFFS 0 1024. 0. 0 0 1 /end COMPU_METHOD
/begin COMPU_METHOD _CNV_A_R_LINEAR_____137_CM "" RAT_FUNC "%6.3" "h" COEFFS 0 35999.99999497086 0. 0 0 1 /end COMPU_METHOD
/begin COMPU_METHOD _CNV_A_R_LINEAR_____152_CM "" RAT_FUNC "%6.3" "hPa" COEFFS 0 0.1884402603974972 0. 0 0 1 /end COMPU_METHOD
/begin COMPU_METHOD _CNV_A_R_LINEAR_____156_CM "" RAT_FUNC "%6.3" "l/h" COEFFS 0 257. 0. 0 0 1 /end COMPU_METHOD
/begin COMPU_METHOD _CNV_A_R_LINEAR_____160_CM "" RAT_FUNC "%6.3" "mg" COEFFS 0 47.18142548596112 0. 0 0 1 /end COMPU_METHOD
/begin COMPU_METHOD _CNV_A_R_LINEAR_____175_CM "" RAT_FUNC "%6.3" "Nm" COEFFS 0 8191.999999679995 -1.280019205296412e-006 0 0 1 /end COMPU_METHOD
/begin COMPU_METHOD _CNV_A_R_LINEAR_____180_CM "" RAT_FUNC "%6.3" "rpm" COEFFS 0 3.125e-002 128. 0 0 1 /end COMPU_METHOD
/begin COMPU_METHOD _CNV_A_R_LINEAR_____183_CM "" RAT_FUNC "%6.3" "s" COEFFS 0 32. 0. 0 0 1 /end COMPU_METHOD
/begin COMPU_METHOD _CNV_A_R_LINEAR_____201_CM "" RAT_FUNC "%6.3" "%" COEFFS 0 327.68 0. 0 0 1 /end COMPU_METHOD
/begin COMPU_METHOD _CNV_S_12_STATE_VLS__215_CM "" TAB_VERB "%6.3" "" COMPU_TAB_REF _CNV_S_12_STATE_VLS__215 /end COMPU_METHOD
/begin COMPU_VTAB _CNV_S_12_STATE_VLS__215 "" TAB_VERB 12 0 "OFF" 1 "STEP_1" 2 "STEP_2" 16 "FINISHED" 17 "ERR_UP" 18 "ERR_DOWN" 19 "ERR_UP_DOWN" 20 "ERR_UP_1" 21 "ERR_UP_2" 22 "ERR_DOWN_1" 23 "ERR_DOWN_2" 24 "NO_RESULT" /end COMPU_VTAB
/begin COMPU_METHOD _CNV_A_R_LINEAR_____216_CM "" RAT_FUNC "%6.3" "°C" COEFFS 0 43.47840509520334 2086.96344456976 0 0 1 /end COMPU_METHOD
/begin COMPU_METHOD _CNV_A_R_LINEAR_____217_CM "" RAT_FUNC "%6.3" "g" COEFFS 0 35.99999934081027 0. 0 0 1 /end COMPU_METHOD
/begin COMPU_METHOD _CNV_A_R_LINEAR_____218_CM "" RAT_FUNC "%6.3" "V" COEFFS 0 204.8048048048048 0. 0 0 1 /end COMPU_METHOD
/begin COMPU_METHOD _CNV_A_R_LINEAR_____239_CM "" RAT_FUNC "%6.3" "Nm" COEFFS 0 2097152.000003239 3.316402435302734e-003 0 0 1 /end COMPU_METHOD
/begin COMPU_METHOD _CNV_A_R_LINEAR_____240_CM "" RAT_FUNC "%6.3" "1/min/s" COEFFS 0 3.125e-002 0. 0 0 1 /end COMPU_METHOD
/begin COMPU_METHOD _CNV_A_R_LINEAR_____241_CM "" RAT_FUNC "%6.3" "Nm/rpm" COEFFS 0 8192. 0. 0 0 1 /end COMPU_METHOD
/begin COMPU_METHOD _CNV_A_R_LINEAR_____242_CM "" RAT_FUNC "%6.3" "Nm/rpm" COEFFS 0 32. 0. 0 0 1 /end COMPU_METHOD
/begin COMPU_METHOD _CNV_A_R_LINEAR_____247_CM "" RAT_FUNC "%6.3" "%/s" COEFFS 0 0.1024000154202376 128.000019275297 0 0 1 /end COMPU_METHOD
/begin COMPU_METHOD _CNV_A_R_LINEAR_____279_CM "" RAT_FUNC "%6.3" "s" COEFFS 0 25. 0. 0 0 1 /end COMPU_METHOD
/begin COMPU_METHOD _CNV_A_R_LINEAR_____283_CM "" RAT_FUNC "%6.3" "-" COEFFS 0 64. 0. 0 0 1 /end COMPU_METHOD
/begin COMPU_METHOD _CNV_A_R_LINEAR_____289_CM "Battery voltage" RAT_FUNC "%6.3" "V" COEFFS 0 9.846153846153847 0. 0 0 1 /end COMPU_METHOD
/begin COMPU_METHOD _CNV_A_R_LINEAR_____290_CM "" RAT_FUNC "%6.3" "%" COEFFS 0 327.6800790412251 0. 0 0 1 /end COMPU_METHOD
/begin COMPU_METHOD _CNV_A_R_LINEAR_____305_CM "" RAT_FUNC "%6.3" "Hz" COEFFS 0 1. 0. 0 0 1 /end COMPU_METHOD
/begin COMPU_METHOD _CNV_A_R_ENSD_LINEA_415_CM "" RAT_FUNC "%6.3" "°C" COEFFS 0 1. 50. 0 0 1 /end COMPU_METHOD
/begin COMPU_METHOD _CNV_A_R_LINEAR_____417_CM "" RAT_FUNC "%6.3" "V" COEFFS 0 10. -106. 0 0 1 /end COMPU_METHOD
/begin COMPU_METHOD _CNV_A_R_LINEAR_____418_CM "" RAT_FUNC "%6.3" "%" COEFFS 0 0.32 0. 0 0 1 /end COMPU_METHOD
/begin COMPU_METHOD _CNV_S_4_STATE_POW__419_CM "" TAB_VERB "%6.3" "-" COMPU_TAB_REF _CNV_S_4_STATE_POW__419 /end COMPU_METHOD
/begin COMPU_VTAB _CNV_S_4_STATE_POW__419 "" TAB_VERB 4 0 "DF<50%" 1 "50%<DF<75%" 2 "75%<DF<100%" 3 "100%" /end COMPU_VTAB
/begin COMPU_METHOD _CNV_A_R_LINEAR_____420_CM "" RAT_FUNC "%6.3" "A" COEFFS 0 8. 0. 0 0 1 /end COMPU_METHOD
/begin COMPU_METHOD _CNV_A_R_LINEAR_____421_CM "" RAT_FUNC "%6.3" "°C" COEFFS 0 0.125 4. 0 0 1 /end COMPU_METHOD
/begin COMPU_METHOD _CNV_A_R_LINEAR_____422_CM "" RAT_FUNC "%6.3" "V" COEFFS 0 1. 0. 0 0 1 /end COMPU_METHOD
/begin COMPU_METHOD _CNV_A_R_LINEAR_____423_CM "" RAT_FUNC "%6.3" "A" COEFFS 0 4. 0. 0 0 1 /end COMPU_METHOD
/begin COMPU_METHOD _CNV_R_R_DEZ_436_CM "" RAT_FUNC "%6.3" "" COEFFS 0. 1. 0. 0. 0. 1. /end COMPU_METHOD
/begin COMPU_METHOD _CNV_A_R_LINEAR_____440_CM "" RAT_FUNC "%6.3" "V" COEFFS 0 10. 0. 0 0 1 /end COMPU_METHOD
/begin COMPU_METHOD _CNV_A_R_LINEAR_____541_CM "" RAT_FUNC "%6.3" "mg/cm³" COEFFS 0 72.81666617193335 4.452599805517821e-004 0 0 1 /end COMPU_METHOD
/begin COMPU_METHOD _CNV_S_7_RANGE_STAT_542_CM "" TAB_VERB "%6.3" "-" COMPU_TAB_REF _CNV_S_7_RANGE_STAT_542 /end COMPU_METHOD
/begin COMPU_VTAB _CNV_S_7_RANGE_STAT_542 "" TAB_VERB 7 0 "CRASH" 1 "OPEN" 2 "CLOSE" 3 "CONTROL" 4 "MANUAL" 5 "MANUAL_OPEN" 6 "MAXIMUM" /end COMPU_VTAB
/begin COMPU_METHOD _CNV_S_6_RANGE_STAT_543_CM "" TAB_VERB "%6.3" "-" COMPU_TAB_REF _CNV_S_6_RANGE_STAT_543 /end COMPU_METHOD
/begin COMPU_VTAB _CNV_S_6_RANGE_STAT_543 "" TAB_VERB 6 0 "VCV_TEST" 1 "START" 2 "MFP_CTL" 3 "VCV_CLOSE" 4 "VCV_CRASH" 5 "MFP_MAX" /end COMPU_VTAB
/begin COMPU_METHOD _CNV_S_5_RANGE_STAT_544_CM "" TAB_VERB "%6.3" "-" COMPU_TAB_REF _CNV_S_5_RANGE_STAT_544 /end COMPU_METHOD
/begin COMPU_VTAB _CNV_S_5_RANGE_STAT_544 "" TAB_VERB 5 0 "PASSIVE" 1 "READY" 2 "START" 3 "ACTIVE" 4 "END" /end COMPU_VTAB
/begin COMPU_METHOD _CNV_A_R_LINEAR_____545_CM "" RAT_FUNC "%6.3" "-" COEFFS 0 25.60240963855421 0. 0 0 1 /end COMPU_METHOD
/begin COMPU_METHOD _CNV_A_R_LINEAR_____546_CM "" RAT_FUNC "%6.3" "%/mg" COEFFS 0 2550. 0. 0 0 1 /end COMPU_METHOD
/begin COMPU_METHOD _CNV_A_R_LINEAR_____547_CM "" RAT_FUNC "%6.3" "%/hPa" COEFFS 0 200000. 0. 0 0 1 /end COMPU_METHOD
/begin COMPU_METHOD _CNV_A_R_LINEAR_____548_CM "" RAT_FUNC "%6.3" "hPa" COEFFS 0 0.1884402603974972 8.003553375601769e-011 0 0 1 /end COMPU_METHOD
/begin COMPU_METHOD _CNV_S_4_RANGE_STAT_549_CM "" TAB_VERB "%6.3" "-" COMPU_TAB_REF _CNV_S_4_RANGE_STAT_549 /end COMPU_METHOD
/begin COMPU_VTAB _CNV_S_4_RANGE_STAT_549 "" TAB_VERB 4 0 "FLOW_REQ" 1 "FLOW2PRS_REQ" 2 "PRS_REQ" 3 "PRS2FLOW_REQ" /end COMPU_VTAB
/begin COMPU_METHOD _CNV_S_4_RANGE_STAT_550_CM "" TAB_VERB "%6.3" "-" COMPU_TAB_REF _CNV_S_4_RANGE_STAT_550 /end COMPU_METHOD
/begin COMPU_VTAB _CNV_S_4_RANGE_STAT_550 "" TAB_VERB 4 0 "FLOW_CONTROL" 1 "FLOW2PRS" 2 "PRESSURE_CONTROL" 3 "PRS2FLOW" /end COMPU_VTAB
/begin COMPU_METHOD _CNV_S_3_RANGE_FUP__551_CM "" TAB_VERB "%6.3" "-" COMPU_TAB_REF _CNV_S_3_RANGE_FUP__551 /end COMPU_METHOD
/begin COMPU_VTAB _CNV_S_3_RANGE_FUP__551 "" TAB_VERB 3 0 "AUTOMATIC" 1 "FLOW_CONTROL" 2 "PRESSURE_CONTROL" /end COMPU_VTAB
/begin COMPU_METHOD _CNV_A_R_LINEAR_____552_CM "" RAT_FUNC "%6.3" "mg" COEFFS 0 47.18214541280769 -1.080506262951531e-005 0 0 1 /end COMPU_METHOD
/begin COMPU_METHOD _CNV_A_R_LINEAR_____553_CM "" RAT_FUNC "%6.3" "hPa/mg" COEFFS 0 0.5 0. 0 0 1 /end COMPU_METHOD
/begin COMPU_METHOD _CNV_A_R_LINEAR_____554_CM "" RAT_FUNC "%6.3" "mg" COEFFS 0 47.18214541280769 32767.99998919494 0 0 1 /end COMPU_METHOD
/begin COMPU_METHOD _CNV_A_R_LINEAR_____555_CM "" RAT_FUNC "%6.3" "hPa" COEFFS 0 0.1884402603974972 32768.00000000008 0 0 1 /end COMPU_METHOD
/begin COMPU_METHOD _CNV_A_R_LINEAR_____556_CM "" RAT_FUNC "%6.3" "mg" COEFFS 0 471.8214542836573 32768. 0 0 1 /end COMPU_METHOD
/begin COMPU_METHOD _CNV_A_R_LINEAR_____557_CM "" RAT_FUNC "%6.3" "mg" COEFFS 0 3092129.082793377 4.76837158203125e-007 0 0 1 /end COMPU_METHOD
/begin COMPU_METHOD _CNV_S_9_RANGE_STAT_558_CM "" TAB_VERB "%6.3" "-" COMPU_TAB_REF _CNV_S_9_RANGE_STAT_558 /end COMPU_METHOD
/begin COMPU_VTAB _CNV_S_9_RANGE_STAT_558 "" TAB_VERB 9 0 "Emergency" 1 "LP" 2 "LP-FPln" 3 "FPln-PCtl" 4 "Opl" 5 "PCtl-OvP" 6 "OvP-PCtl" 7 "Opl_PCtl" 8 "PCtl-FPln" /end COMPU_VTAB
/begin COMPU_METHOD _CNV_S_6_RANGE_STAT_559_CM "" TAB_VERB "%6.3" "-" COMPU_TAB_REF _CNV_S_6_RANGE_STAT_559 /end COMPU_METHOD
/begin COMPU_VTAB _CNV_S_6_RANGE_STAT_559 "" TAB_VERB 6 0 "Low pressure state" 1 "Fast pressure increase" 2 "Pressure_control" 3 "Over_pressure" 4 "Open loop" 5 "Emergency" /end COMPU_VTAB
/begin COMPU_METHOD _CNV_S_6_RANGE_STAT_560_CM "" TAB_VERB "%6.3" "-" COMPU_TAB_REF _CNV_S_6_RANGE_STAT_560 /end COMPU_METHOD
/begin COMPU_VTAB _CNV_S_6_RANGE_STAT_560 "" TAB_VERB 6 0 "FPA_OPEN" 1 "FPA_CLOSE" 2 "FPA_LGRD" 3 "FPA_CTL" 4 "FPA_MAN" 5 "FPA_CRASH" /end COMPU_VTAB
/begin COMPU_METHOD _CNV_S_9_RANGE_STAT_561_CM "" TAB_VERB "%6.3" "-" COMPU_TAB_REF _CNV_S_9_RANGE_STAT_561 /end COMPU_METHOD
/begin COMPU_VTAB _CNV_S_9_RANGE_STAT_561 "" TAB_VERB 9 0 "CRASH" 1 "FPA_OPEN" 2 "FPA_CLOSE" 3 "CLOSE2LGRD" 4 "OPEN2CTL" 5 "LGRD2CTL" 6 "CTL2LGRD" 7 "FPA_MAN" 8 "MAN2LP" /end COMPU_VTAB
/begin COMPU_METHOD _CNV_A_R_LINEAR_____564_CM "" RAT_FUNC "%6.3" "A" COEFFS 0 2. 0. 0 0 1 /end COMPU_METHOD
/begin RECORD_LAYOUT _REC_VAL_20_u1 FNC_VALUES 1 UBYTE COLUMN_DIR DIRECT /end RECORD_LAYOUT
/begin RECORD_LAYOUT _REC_VAL_20_u2 FNC_VALUES 1 UWORD COLUMN_DIR DIRECT /end RECORD_LAYOUT
/begin RECORD_LAYOUT _REC_AXS_20_u1 NO_AXIS_PTS_X 1 UBYTE AXIS_PTS_X 2 UBYTE INDEX_INCR DIRECT /end RECORD_LAYOUT
/begin RECORD_LAYOUT _REC_MAP_20_u2_u1_u1 FNC_VALUES 1 UWORD COLUMN_DIR DIRECT /end RECORD_LAYOUT
/begin RECORD_LAYOUT _REC_CUR_20_u1_u1 FNC_VALUES 1 UBYTE COLUMN_DIR DIRECT /end RECORD_LAYOUT
/begin RECORD_LAYOUT _REC_VAL_20_s2 FNC_VALUES 1 SWORD COLUMN_DIR DIRECT /end RECORD_LAYOUT
/begin RECORD_LAYOUT _REC_AXS_20_u2 NO_AXIS_PTS_X 1 UWORD AXIS_PTS_X 2 UWORD INDEX_INCR DIRECT /end RECORD_LAYOUT
/begin RECORD_LAYOUT _REC_CUR_20_u2_u1 FNC_VALUES 1 UWORD COLUMN_DIR DIRECT /end RECORD_LAYOUT
/begin RECORD_LAYOUT _REC_CUR_20_u2_u2 FNC_VALUES 1 UWORD COLUMN_DIR DIRECT /end RECORD_LAYOUT
/begin RECORD_LAYOUT _REC_VAL_20_s1 FNC_VALUES 1 SBYTE COLUMN_DIR DIRECT /end RECORD_LAYOUT
/begin RECORD_LAYOUT _REC_MAP_20_u2_u1_u2 FNC_VALUES 1 UWORD COLUMN_DIR DIRECT /end RECORD_LAYOUT
/begin RECORD_LAYOUT _REC_MAP_20_u1_u1_u1 FNC_VALUES 1 UBYTE COLUMN_DIR DIRECT /end RECORD_LAYOUT
/begin RECORD_LAYOUT _REC_MAP_20_u1_u1_u2 FNC_VALUES 1 UBYTE COLUMN_DIR DIRECT /end RECORD_LAYOUT
/begin FUNCTION EOL_End_of_line_test "_End of line test"
 /begin SUB_FUNCTION EOL_End_of_line_test_Lambda_sensors_confused_wrong_wired EOL_Lambda_setpoint_for_external_adjustment /end SUB_FUNCTION
/end FUNCTION
/begin FUNCTION EOL_End_of_line_test_Lambda_sensors_confused_wrong_wired "_End of line test Lambda sensors confused wrong wired"
 /begin DEF_CHARACTERISTIC c_tco_min_vls_eol c_teg_cat_down_eol c_maf_int_min_vls_eol c_lamb_sp_vls_eol_afr c_lamb_sp_vls_eol_afl c_vls_afr_eol c_vls_afl_eol c_lamb_ls_up_afr_eol c_lamb_ls_up_afl_eol /end DEF_CHARACTERISTIC
 /begin OUT_MEASUREMENT state_vls_eol maf_int_min_vls_eol lv_act_vls_eol lamb_sp_vls_eol[0] lamb_sp_vls_eol[1] vls_down_afl_eol[0] vls_down_afl_eol[1] vls_down_afr_eol[0] vls_down_afr_eol[1] lamb_ls_up_afl_eol[0] lamb_ls_up_afl_eol[1] lamb_ls_up_afr_eol[0] lamb_ls_up_afr_eol[1] /end OUT_MEASUREMENT
/end FUNCTION
/begin FUNCTION EOL_Lambda_setpoint_for_external_adjustment "_Lambda setpoint for external adjustment"
 /begin OUT_MEASUREMENT lamb_sp_ext_adj_1 lamb_sp_ext_adj_2 lv_lamb_sp_ext_adj_1 lv_lamb_sp_ext_adj_2 /end OUT_MEASUREMENT
/end FUNCTION
/begin FUNCTION C_Y_Byp_Sim "" /begin SUB_FUNCTION Bypass_Simulation /end SUB_FUNCTION /end FUNCTION
/begin FUNCTION Bypass_Simulation "Bypass_Simulation" /end FUNCTION
/begin FUNCTION C_0_BGO "C_0_BGO" /begin SUB_FUNCTION BGO_Non_volatile_datas /end SUB_FUNCTION /end FUNCTION
/begin FUNCTION BGO_Non_volatile_datas "_Non volatile datas"
 /begin DEF_CHARACTERISTIC lc_ad_clr_lam lc_ad_clr_tps lc_ad_clr_mis lc_ad_clr_ivvt lc_ad_clr_ati lc_ad_clr_toil lc_ad_clr_n_sp_is lc_ad_clr_ron lc_ad_clr_tecu lc_ad_clr_var lc_ad_clr_dmtl lc_ad_clr_sof lc_ad_clr_n_max lc_ad_clr_lif lc_ad_clr_tqi_lim lc_ad_clr lc_ad_clr_obd2 lc_ad_clr_cru lc_ad_clr_can lc_ad_clr_pste lc_ad_clr_toil_max lc_ad_clr_nox lc_ad_clr_ente lc_ad_clr_enrd lc_ad_clr_ensd lc_ad_clr_extd lc_ad_clr_bal lc_ad_clr_ccp lc_ad_clr_tqlo lc_ad_clr_pow lc_ad_clr_laco lc_ad_clr_egr lc_ad_clr_egcp /end DEF_CHARACTERISTIC
 /begin OUT_MEASUREMENT lv_nvmy_rd_failed lv_nvmy_cus_wrg /end OUT_MEASUREMENT
/end FUNCTION
/begin FUNCTION C_9_AUX "C_9_AUX"
 /begin SUB_FUNCTION AUX_Blocking_of_the_air_conditioner_compressor AUX_Engine_speed_limitation_controller AUX_Electrical_fuel_pump_control AUX_Fuel_pressure_control AUX_Disa AUX_Exhaust_gas_recirculation AUX_Determination_of_secondary_air_mass_flow AUX_Power_Management AUX_Coil_substitute_temperature AUX_Exhaust_flap_actuation AUX_IVVT_application_Incidences AUX_Starter_Relay_Control AUX_E_box_cooling_fan AUX_Application_incidences_for_Electrical_fuel_pump_Interface AUX_Sound_Flap_Control AUX_Electronically_controlled_radiator_shutter AUX_Variable_Intake_Manifold AUX_QLT_SENSOR AUX_Electrical_controlled_Water_Pump AUX_PWL_Manager AUX_Main_Relay_Control AUX_HPDI_Relay_Control AUX_Fuel_pressure_setpoint_calculation AUX_Fuel_supply_general AUX_Application_incidences_fuel_pressure_control AUX_Fuel_pressure_actuator_temperature AUX_High_pressure_pump_control_VCV AUX_Application_incidences_high_pressure_pump_control AUX_Crankcase_ventilation_heater_control AUX_Electr_fuel_pump_control AUX_Ele_fuel_pump_control_AI AUX_Fuel_pres_sp_low_pres_pump AUX_Cylinder_balancing_cor_DC AUX_Cylinder_balancing_cor_EOL /end SUB_FUNCTION
/end FUNCTION
/begin FUNCTION AUX_Blocking_of_the_air_conditioner_compressor "_Blocking of the air conditioner compressor"
 /begin DEF_CHARACTERISTIC c_vs_max_accin c_accin_dly_1 c_accin_dly_1_lock_fl c_accin_dly_4 c_pvs_fl_accin c_accin_dly_5 c_tco_max_accin_hys ip_t_acc_dly_on__n_32 ip_t_acc_dly_off__n_32 c_tco_max_accin c_toil_max_accin c_toil_max_accin_hys c_temp_gb_max_accin c_temp_gb_max_accin_hys /end DEF_CHARACTERISTIC
 /begin OUT_MEASUREMENT lv_accout_rly_ena lv_accout_rly t_acc t_acc_dly /end OUT_MEASUREMENT
/end FUNCTION
/begin FUNCTION AUX_Engine_speed_limitation_controller "_Engine speed limitation controller"
 /begin DEF_CHARACTERISTIC c_add_n_max_fcut c_n_grd_hys c_tqi_max_pas c_crlc_n_grd_fil_1 c_crlc_n_grd_fil_2 c_tqi_n_max_inc id_fac_n_max_i_at__gear id_fac_n_max_p_mt__gear id_fac_n_max_i_mt__gear id_fac_n_max_p_at__gear id_t_n_max_pred_at__gear id_t_n_max_pred_mt__gear ip_n_grd_thd__n_32 c_fac_tqi_n_max_ref c_n_lim_min /end DEF_CHARACTERISTIC
 /begin OUT_MEASUREMENT lv_n_max_req_fcut n_dif_max_lim n_pred_max_lim tq_n_max_dif tq_n_max_dif_i tq_n_max_dif_p tq_n_max_inp_i tqi_n_max tqi_n_max_ref n_grd_fil n_grd_fil_fil tqi_n_max_1 tqi_n_max_2 lv_n_max n_max trt_n_max ctr_n_max ctr_km_n_max n_grd_n_max vs_n_max pv_av_n_max gear_ef_n_max lv_cs_n_max t_sum_n_max t_n_max nr_pat_scc_n_max /end OUT_MEASUREMENT
/end FUNCTION
/begin FUNCTION AUX_Electrical_fuel_pump_control "_Electrical fuel pump control" /end FUNCTION
/begin FUNCTION AUX_Fuel_pressure_control "_Fuel pressure control"
 /begin DEF_CHARACTERISTIC ip_fuel_mass_req_p_ctl ip_fuel_mass_req_i_ctl ip_fac_clc_fuel_mass_fup ldp_fup_dif_pctl_ip_fac_fuel ldpm_fup_dif_ctl_1_fusl ldp_tfu_ip_fac_clc_fuel_mass c_fuel_mass_req_i_ctl_mmv_crlc lc_fuel_mass_req_ctl_clr lc_use_fuel_mass_req_ctl c_n_fuel_mass_ad_min c_n_fuel_mass_ad_max c_fuel_mass_ad_cor_crlc c_fuel_mass_ad_max c_fuel_mass_ad_min lc_ad_clr_fuel_mass_ad c_fuel_mass_req_i_ctl_max c_fuel_mass_req_i_ctl_min c_seg_ctr_fuel_mass_ad_max ldpm_n_32_fusl_1 ip_fac_fuel_mass_req_ctl c_dly_fup_sp c_pv_grd_thd_fuel_add ip_fuel_mass_req_add c_pv_thd_fuel_add c_ctr_cyc_fuel_add ldp_n_32_ip_fuel_mass_req_add ldp_n_32_ip_fac_n_fuel_req_pctl ip_fac_fuel_mass_req_pctl ip_fac_n_mass_fuel_req_pctl c_clc_fuel_pump_ctl /end DEF_CHARACTERISTIC
 /begin OUT_MEASUREMENT fuel_mass_req fuel_mass_ad fuel_mass_ad_dif fuel_mass_req_pctl fac_clc_fuel_mass_fup fuel_mass_req_ctl fup_dif_ctl fuel_mass_req_p_ctl fuel_mass_req_i_ctl_mmv fup_dif_pctl fuel_mass_req_pctl_tmp seg_ctr_fuel_mass_ad fup_dif fac_fuel_mass_req_pctl lv_fuel_add_act fuel_mass_req_i_ctl_h_res /end OUT_MEASUREMENT
/end FUNCTION
/begin FUNCTION AUX_Disa "_Disa" /end FUNCTION
/begin FUNCTION AUX_Exhaust_gas_recirculation "_Exhaust gas recirculation" /begin DEF_CHARACTERISTIC c_tco_min_egr c_t_ast_egr lc_acr_ctl_ena /end DEF_CHARACTERISTIC /begin OUT_MEASUREMENT lv_acr_ctl_ena /end OUT_MEASUREMENT /end FUNCTION
/begin FUNCTION AUX_Determination_of_secondary_air_mass_flow "_Determination of secondary air mass flow" /end FUNCTION
/begin FUNCTION AUX_Power_Management "_Power Management"
 /begin DEF_CHARACTERISTIC c_vb_min_bsd_diag lc_alter_rd_tbl_6 lc_alter_bsd_prot_2 lc_alter_wr_cord_1 lc_alter_wr_cord_2 lc_alter_wr_cord_3 c_t_wr_per_alter_tbl_0 c_t_wr_per_alter_tbl_1 c_t_rd_per_alter_tbl_2 c_t_rd_per_alter_tbl_5 c_t_fil_cur_exct_alter lc_pow_cord_inh /end DEF_CHARACTERISTIC
 /begin OUT_MEASUREMENT lv_alter_bsd_prot_2 lv_alter_if_act lv_alter_eve_rd lv_alter_eve_wr bsd_alter_rd.t_load_resp_alter_0 bsd_alter_rd.v_alter bsd_alter_rd.t_load_resp_alter_1 bsd_alter_rd.lv_load_resp_alter_cnd_1 bsd_alter_rd.lv_load_resp_alter_thd_act bsd_alter_rd.lv_alter_err_temp bsd_alter_rd.lv_alter_err_mec bsd_alter_rd.lv_alter_err_el bsd_alter_rd.pow_rel_alter bsd_alter_rd.pow_rel_alter_l_res bsd_alter_rd.cur_alter_exct bsd_alter_rd.temp_alter_mc bsd_alter_rd.alter_cod_0 bsd_alter_rd.alter_cod_1 bsd_alter_rd.alter_cod_2 bsd_alter_rd.v_alter_nom bsd_alter_rd.alter_cod_3 bsd_alter_wr.t_load_resp_alter_sp_0 bsd_alter_wr.v_alter_sp bsd_alter_wr.t_load_resp_alter_sp_1 bsd_alter_wr.lv_load_resp_alter_cnd_1 bsd_alter_wr.lv_load_resp_alter_thd_act_sp bsd_alter_wr.cur_alter_exct_lim_sp genawnumm /end OUT_MEASUREMENT
/end FUNCTION
/begin FUNCTION AUX_Coil_substitute_temperature "_Coil substitute temperature" /end FUNCTION
/begin FUNCTION AUX_Exhaust_flap_actuation "_Exhaust flap actuation"
 /begin DEF_CHARACTERISTIC c_vs_min_ef_at c_vs_min_ef_mt c_t_ef_ast id_fac_tq_ef_thd_ctop_open_mt id_fac_tq_ef_thd_ctop_open_at id_fac_tq_ef_thd_ctop_close_at id_fac_tq_ef_thd_ctop_close_mt ip_t_dly_ef lc_ef_conf c_n_ef_hys c_fac_tq_ef_thd_hys lc_state_ch_ef lc_state_vs_min_ef_at lc_state_vs_min_ef_mt lc_state_ef_ast /end DEF_CHARACTERISTIC
 /begin OUT_MEASUREMENT lv_ef fac_tq_ef_thd fac_tq_ef_thd_ctop n_ef t_dly_ef /end OUT_MEASUREMENT
/end FUNCTION
/begin FUNCTION AUX_IVVT_application_Incidences "_IVVT application Incidences" /end FUNCTION
/begin FUNCTION AUX_Starter_Relay_Control "_Starter Relay Control" /begin OUT_MEASUREMENT lv_rly_st /end OUT_MEASUREMENT /end FUNCTION
/begin FUNCTION AUX_E_box_cooling_fan "_E-box cooling fan"
 /begin DEF_CHARACTERISTIC c_tecu_thd_ebox_cfa c_tecu_hys_ebox_cfa c_tia_thd_ebox_cfa c_tia_hys_ebox_cfa c_t_max_ebox_cfa_act c_n_thd_ebox_cfa_act /end DEF_CHARACTERISTIC
 /begin OUT_MEASUREMENT lv_ebox_cfa /end OUT_MEASUREMENT
/end FUNCTION
/begin FUNCTION AUX_Application_incidences_for_Electrical_fuel_pump_Interface "_Application incidences for Electrical fuel pump Interface" /begin DEF_CHARACTERISTIC c_eng_typ_efp /end DEF_CHARACTERISTIC
 /begin OUT_MEASUREMENT lv_efp_on_ext_adj_can lv_efp_off_ext_adj_can state_diag_efp state_efp_can v_eng_efp cur_eng_efp vb_efp n_efp_av /end OUT_MEASUREMENT
/end FUNCTION
/begin FUNCTION AUX_Sound_Flap_Control "_Sound Flap Control"
 /begin DEF_CHARACTERISTIC c_v_sof_swi_on_bol c_v_sof_swi_on_tol c_v_sof_swi_amt_on_tol lc_var_sof_swi lc_var_sof_swi_amt lc_conf_city_ena c_vs_min_sof_mt c_vs_min_sof_at c_t_sof_ast c_n_sof_hys c_fac_tq_sof_thd_hys ip_t_dly_sof id_fac_tq_sof_thd_ctop_open_mt id_fac_tq_sof_thd_ctop_open_at id_fac_tq_sof_thd_ctop_close_mt id_fac_tq_sof_thd_ctop_close_at lc_state_vs_min_sof_mt lc_state_vs_min_sof_at lc_state_sof_ast /end DEF_CHARACTERISTIC
 /begin OUT_MEASUREMENT lv_sof_swi_req lv_sof_swi lv_sof_swi_amt lv_sof_swi_amt_req lv_sof fac_tq_sof_thd fac_tq_sof_thd_ctop n_sof t_dly_sof /end OUT_MEASUREMENT
/end FUNCTION
/begin FUNCTION AUX_Electronically_controlled_radiator_shutter "_Electronically controlled radiator shutter" /begin OUT_MEASUREMENT lv_ecras /end OUT_MEASUREMENT /end FUNCTION
/begin FUNCTION AUX_Variable_Intake_Manifold "_Variable Intake Manifold"
 /begin DEF_CHARACTERISTIC c_vim_av_3 c_n_vim_l c_n_vim_hys c_fac_maf_max_vim c_fac_maf_max_vim_hys ip_fac_n_vim c_vim_av_4 c_vim_av_2 c_vim_av_1 c_vb_min_vim c_vb_max_vim c_n_vim_h c_n_vim_mid lc_pwm_vim_man c_state_vim_1_sp_man c_state_vim_2_sp_man c_vimpwm_pas c_pwm_vim_close c_pwm_vim_open c_t_open_vim_deac c_vim_av_pas ldp_tia_id_state_rls_vim ldp_tco_id_state_rls_vim id_state_vim_1_sp id_state_vim_2_sp id_state_rls_vim ip_fac_tia_n_vim c_pwm_vim_deac c_vim_av_deac lc_pwm_vim_cus /end DEF_CHARACTERISTIC
 /begin OUT_MEASUREMENT n_vim vim_av vimpwm_1 vimpwm_2 lv_vim lv_vim_rls lv_vim_1 lv_vim_2 t_open_vim_deac idx_2_sp_vim_1 idx_1_sp_vim_1 /end OUT_MEASUREMENT
/end FUNCTION
/begin FUNCTION AUX_QLT_SENSOR "_QLT_SENSOR"
 /begin OUT_MEASUREMENT lv_err_qoil_sens lv_err_toil_level lv_err_toil ozpermr_w ozstatus oztempr oznivr /end OUT_MEASUREMENT
/end FUNCTION
/begin FUNCTION AUX_Electrical_controlled_Water_Pump "_Electrical controlled Water Pump"
 /begin OUT_MEASUREMENT cur_cns_cwp lv_cwp_block_deac lv_cwp_temp_high lv_cwp_vcc_plaus lv_n_mon_cwp_deac v_cwp temp_el_cwp n_rel_cwp lv_cwp_pre_lock lv_cwp_lock lf_pow_cwp_cod lf_cwp_info_cod lv_cwp_hw_lih_in_chk /end OUT_MEASUREMENT
/end FUNCTION
/begin FUNCTION AUX_PWL_Manager "_PWL Manager" /begin DEF_CHARACTERISTIC c_t_min_pwl c_t_max_pwl /end DEF_CHARACTERISTIC /begin OUT_MEASUREMENT pwl_lock_cdn t_pwl lv_pwl_act lv_inh_pwl_tran_es_el /end OUT_MEASUREMENT /end FUNCTION
/begin FUNCTION AUX_Main_Relay_Control "_Main Relay Control" /begin DEF_CHARACTERISTIC lc_rly_main_man_req lc_rly_main_man_adj /end DEF_CHARACTERISTIC /begin OUT_MEASUREMENT lv_rly_main lv_rly_main_sys /end OUT_MEASUREMENT /end FUNCTION
/begin FUNCTION AUX_HPDI_Relay_Control "_HPDI Relay Control" /begin DEF_CHARACTERISTIC lc_rly_hpdi_man_req lc_rly_hpdi_man_adj /end DEF_CHARACTERISTIC /begin OUT_MEASUREMENT lv_rly_hpdi lv_rly_hpdi_sys /end OUT_MEASUREMENT /end FUNCTION
/begin FUNCTION AUX_Fuel_pressure_setpoint_calculation "_Fuel pressure setpoint calculation"
 /begin DEF_CHARACTERISTIC c_fup_sp_man c_fup_sp_pu_lim_inc c_fup_sp_pu_lim_dec c_fup_sp_lim_dec lc_fup_sp_man_act ip_fup_sp_hom ldpm_n_1_fusl ldpm_mff_sp_fup_ctl_1_fusl ip_fup_sp_s ip_fup_sp_pu c_fup_sp_st_lgrd_dec c_t_fup_sp_add_1 c_t_fup_sp_add_2 c_fup_sp_st c_fup_sp_add c_fup_sp_lim_inc c_fup_sp_lih_vcv_open /end DEF_CHARACTERISTIC
 /begin OUT_MEASUREMENT fup_sp fup_sp_grd_act fup_h_sp_s fup_sp_tmp lv_fup_sp_add /end OUT_MEASUREMENT
/end FUNCTION
/begin FUNCTION AUX_Fuel_supply_general "_Fuel supply general"
 /begin DEF_CHARACTERISTIC c_fup_ctl_mod lc_fuel_mass_ctl_rst lc_vff_swi lc_fpa_conf c_ctr_seg_fup_ofs_tol_max lc_fup_req_fpa_rst c_fup_ofs_bol c_fup_ofs_tol c_fup_sp_dec_tol c_ctr_seg_fup_ofs_bol_max c_vff_vcv_min_bol_hys c_vff_vcv_min_tol_hys /end DEF_CHARACTERISTIC
 /begin OUT_MEASUREMENT lv_fup_prs_ctl_req lv_fup_req_fpa_stop lv_fuel_mass_ad_stop lv_vff_vcv_min vff_mff_sp_fup_ctl state_fup_ctl_tran state_fup_ctl fpa_mff lv_fuel_mass_ctl_stop lv_fuel_mass_ctl_rst lv_fup_req_fpa_rst ctr_seg_fup_ofs_bol ctr_seg_fup_ofs_tol /end OUT_MEASUREMENT
/end FUNCTION
/begin FUNCTION AUX_Application_incidences_fuel_pressure_control "_Application incidences fuel pressure control"
 /begin DEF_CHARACTERISTIC c_fup_ofs_st c_fup_ofs_ctl c_t_dly_fpa_cll_req c_t_dly_fpa_prot c_n_32_fpa c_t_dly_fup_max c_t_dly_err_fup c_fup_max c_fup_req_fpa_max c_fpa_mff_min_ad c_fup_dif_ad c_t_dly_fpapwm_ad c_fpa_mff_dif_ad c_fpapwm_dif_ad c_n_fup_ad_min c_tq_fup_ad_min c_tq_fup_ad_max c_n_fup_ad_max c_fup_req_fpa_ini c_fup_req_fpa_i_ad_min lc_ad_clr_fup_fpa_i_ad c_crlc_vcv_fpapwm_ad c_fup_req_fpa_i_ad_max c_fup_req_fpa_i_max c_fup_req_fpa_i_min c_fup_req_fpa_min c_fup_sp_pctl_crlc c_fup_sp_crlc ldp_fup_sp_dif_ip_fac_fup_sp ldpm_fup_dif_dly_fusl_1 ip_fac_fup_sp_pctl ip_fup_req_fpa_p ip_fup_req_fpa_i /end DEF_CHARACTERISTIC
 /begin OUT_MEASUREMENT state_fup_tran crlc_vcv_fpapwm_ad lv_dly_fpa_cll_req state_fup lv_fup_req_fpa_ad_auth lv_fup_req_fpa_ad_inh fup_req_fpa fup_req_fpa_pctl fup_req_fpa_i_ad fup_req_fpa_p lv_fpapwm_ad fpa_mff_mem fpapwm_mem fup_sp_fil t_dly_fpapwm_ad t_dly_fpa_prot t_dly_fup_max t_dly_err_fup t_dly_fpa_cll_req fup_dif_dly fup_req_fpa_i fup_req_fpa_i_tmp /end OUT_MEASUREMENT
/end FUNCTION
/begin FUNCTION AUX_Fuel_pressure_actuator_temperature "_Fuel pressure actuator temperature" /begin OUT_MEASUREMENT tfpa /end OUT_MEASUREMENT /end FUNCTION
/begin FUNCTION AUX_High_pressure_pump_control_VCV "_High pressure pump control"
 /begin DEF_CHARACTERISTIC c_rho_fuel c_frq_pwm_vcv_opl c_frq_pwm_vcv_stnd c_pwm_vcv_lim_inc ldp_vff_vcv_ip_pwm_vcv_bas ip_pwm_vcv_bas ip_pwm_vcv_max ip_fac_pwm_vcv_vb ldpm_vb_fusl c_pwm_vcv_min_opl ldp_tfu_ip_fac_pwm_vcv ip_fac_pwm_vcv_tfu ip_pwm_vcv_min c_fup_dif_max_vff_vcv_min_ad c_fup_vff_vcv_min_ad_hys c_fup_vff_vcv_min_ad_st c_vff_vcv_min_tol c_vff_vcv_min_ini ldp_fup_req_fpa_ip_pwm_vcv_min ldp_fac_vff_fpa_ip_fac_pwm_vcv ip_fac_pwm_vcv_min c_pwm_vcv_min_tol c_vff_pwm_vcv_bas_ad_1_ini c_vff_pwm_vcv_bas_ad_2_ini c_fup_vff_vcv_min_ad_red c_pwm_vcv_bas_ad_2_ini c_pwm_vcv_min_ad_1_ini c_pwm_vcv_min_ad_2_ini lc_hpp_ctl_ad_clr c_pwm_vcv_lim_dec c_ctr_pwm_vcv_bas_ad_max c_pwm_vcv_ad_cord_1 c_pwm_vcv_ad_cord_2 c_fup_sp_vff_vcv_min_ad_end c_fup_dif_pwm_vcv_ad c_vff_vcv_min_bol c_vff_pwm_vcv_bas_hys_1 c_vff_pwm_vcv_bas_hys_2 c_vff_pwm_vcv_bas_ad_1 c_vff_pwm_vcv_bas_ad_2 c_ctr_pwm_vcv_min_ad_max c_pwm_vcv_bas_ad_2_max c_pwm_vcv_bas_ad_1_min c_pwm_vcv_bas_ad_2_min c_fup_pwm_vcv_min_hys_1 c_fup_pwm_vcv_min_hys_2 c_fup_pwm_vcv_min_ad_1 c_fup_pwm_vcv_min_ad_2 c_crlc_vff_mff_sp c_crlc_fup_pwm_vcv_min_ad c_pwm_vcv_bas_ad_1_max c_pwm_vcv_min_ad_1_max c_pwm_vcv_min_ad_2_max c_pwm_vcv_min_ad_1_min c_pwm_vcv_min_ad_2_min c_pwm_vcv_vff_vcv_min_ad c_fup_pwm_vcv_min_ad_1_ini c_fup_pwm_vcv_min_ad_2_ini c_tfu_pwm_vcv_ad_max c_tfu_pwm_vcv_ad_min c_tfu_vff_vcv_min_clc_max c_tfu_vff_vcv_min_clc_min c_t_vff_vcv_min_ad_st_max c_t_vff_vcv_lim_max c_fup_ofs_mfp_max lc_pwm_vcv_man_act lc_prs_h_st c_pwm_vcv_man c_pwm_vcv_st c_pwm_vcv_bas_ad_1_ini c_pwm_vcv_bas_ad_min c_pwm_vcv_bas_ad_max c_pwm_vcv_min_ad_max c_pwm_vcv_min_ad_min c_t_pwm_vcv_first_vld_tooth /end DEF_CHARACTERISTIC
 /begin OUT_MEASUREMENT pwm_vcv lv_fuel_mass_ctl_stop_req frq_req_vcv pwm_vcv_ctl pwm_vcv_max pwm_vcv_req vff_vcv state_pwm_vcv_tran lv_fuel_mass_ctl_rst_req lv_vff_vcv_min_ad_ena state_pwm_vcv state_vff_vcv_min t_vff_vcv_min_ad_st fac_vff_fpa vff_vcv_min vff_pwm_vcv_bas_ad_2 vff_pwm_vcv_bas_ad_1 pwm_vcv_min pwm_vcv_bas_ad_1 pwm_vcv_bas_ad_2 pwm_vcv_min_ad_1 pwm_vcv_min_ad_2 fup_pwm_vcv_min_ad_2 fup_pwm_vcv_min_ad_1 pwm_vcv_bas pwm_vcv_bas_ad pwm_vcv_min_ad t_vff_vcv_min t_vff_vcv_lim fup_vff_vcv_min_ad_st fup_sp_vff_vcv_min_ad_end fup_sp_vff_vcv_min_ad_st /end OUT_MEASUREMENT
/end FUNCTION
/begin FUNCTION AUX_Application_incidences_high_pressure_pump_control "_Application incidences high pressure pump control"
 /begin DEF_CHARACTERISTIC c_fpapwm_min c_frq_fpapwm_stnd c_fpapwm_man ldp_fup_req_fpa_ip_fpapwm_bas ip_fpapwm_bas ldp_tfpa_ip_fac_fpapwm ip_fac_fpapwm_tfpa ip_fpapwm_max c_fpapwm_lim_inc c_frq_fpapwm_opl c_frq_fpapwm_close ip_fac_fpapwm_vb ldp_fup_sp_ip_fpapwm_max c_fpapwm_lim_dec c_fup_lih_vcv_open c_t_fup_lih_l_prs_ctl_req lc_fpapwm_man_act lc_t_fup_lih_l_prs_ctl_req /end DEF_CHARACTERISTIC
 /begin OUT_MEASUREMENT fpapwm frq_req_fpa fpapwm_ctl fpapwm_req lv_fup_req_fpa_stop_req state_fpa state_fpa_tran fpapwm_bas fpapwm_min fpapwm_max lv_fup_req_fpa_rst_req lv_fup_lih_l_prs_ctl_req lv_fup_lih_hom_vcv_open_req lv_fup_lih_hom_req /end OUT_MEASUREMENT
/end FUNCTION
/begin FUNCTION AUX_Crankcase_ventilation_heater_control "_Crankcase ventilation heater control"
 /begin DEF_CHARACTERISTIC c_t_ast_min_rly_crcv_heat c_tia_max_rly_crcv_heat c_tia_hys_rly_crcv_heat /end DEF_CHARACTERISTIC
 /begin OUT_MEASUREMENT lv_rly_crcv_heat /end OUT_MEASUREMENT
/end FUNCTION
/end MODULE
/end PROJECT
/* -------------------------------------------------------------------------
Visu-IT! - Data Declaration System (DDS)
Quality FE<0> NCE<0> E<917> W<4922>
Quantity Maps <2643> Parameter<6735> Axes<2245> Online<15089>
------------------------------------------------------------------------- */
