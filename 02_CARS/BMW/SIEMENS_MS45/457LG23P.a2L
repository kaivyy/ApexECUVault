ASAP2_VERSION 1 31
/begin PROJECT MS45 "BMW Motorsteuerung R6"
/begin HEADER "_default_HeaderComment" PROJECT_NO _57 /end HEADER
/begin MODULE _default_ModuleName "_default_ModuleLongIdentifier"
/begin MOD_COMMON "_default_ModCommonComment" DEPOSIT ABSOLUTE BYTE_ORDER MSB_FIRST ALIGNMENT_BYTE 1 ALIGNMENT_WORD 2 ALIGNMENT_LONG 4 ALIGNMENT_FLOAT32_IEEE 4 ALIGNMENT_FLOAT64_IEEE 8 /end MOD_COMMON
/begin MEASUREMENT v_dmtl "???" UWORD _CNV_A_R_LINEAR_____3_CM 1 100. 0. 4.99511719 DISPLAY_IDENTIFIER V_DMTL ECU_ADDRESS 0x3fd766 BYTE_ORDER MSB_LAST FORMAT "%5.3" /end MEASUREMENT
/begin MEASUREMENT v_sof_swi "Voltage sound flap switch" UWORD _CNV_A_R_LINEAR_____3_CM 1 100. 0. 4.99511719 DISPLAY_IDENTIFIER V_SOF_SWI ECU_ADDRESS 0x3fd76a BYTE_ORDER MSB_LAST FORMAT "%5.3" /end MEASUREMENT
/begin MEASUREMENT v_sof_swi_mon "Voltage sound flap switch" UWORD _CNV_A_R_LINEAR_____3_CM 1 100. 0. 4.99511719 DISPLAY_IDENTIFIER V_SOF_SWI_MON ECU_ADDRESS 0x3fd76c BYTE_ORDER MSB_LAST FORMAT "%5.3" /end MEASUREMENT
/begin CHARACTERISTIC c_amp_dmtl_max "lower altitude threshold for DMTL function / upper ambient pressure for DMTL function" VALUE 0xffe414e6 _REC_VAL_20_u2 5434.25976563 _CNV_A_R_LINEAR_____166_CM 0. 5434.25976563 DISPLAY_IDENTIFIER C_AMP_DMTL_MAX FORMAT "%7.2" /end CHARACTERISTIC
/begin CHARACTERISTIC c_cod_2_dmtl "2nd  application code word of DMTL function" VALUE 0xffe40654 _REC_VAL_20_u1 255. _CNV_A_R_LINEAR_____0_CM 0. 255. DISPLAY_IDENTIFIER C_COD_2_DMTL FORMAT "%3.0" /end CHARACTERISTIC
/begin CHARACTERISTIC c_cod_dmtl "Calibrationconstant" VALUE 0xffe40655 _REC_VAL_20_u1 255. _CNV_A_R_LINEAR_____0_CM 0. 255. DISPLAY_IDENTIFIER C_COD_DMTL FORMAT "%3.0" /end CHARACTERISTIC
/begin CHARACTERISTIC c_crlc_cur_dmtl_fil "Time constant of pump current filtering" VALUE 0xffe41536 _REC_VAL_20_u2 0.99998474 _CNV_A_R_LINEAR_____37_CM 0. 0.99998474 DISPLAY_IDENTIFIER C_CRLC_CUR_DMTL_FIL FORMAT "%7.5" /end CHARACTERISTIC
/begin CHARACTERISTIC c_crlc_cur_dmtl_fil_lim "Time constant at the beginning of pump current filtering" VALUE 0xffe41538 _REC_VAL_20_u2 0.99998474 _CNV_A_R_LINEAR_____37_CM 0. 0.99998474 DISPLAY_IDENTIFIER C_CRLC_CUR_DMTL_FIL_LIM FORMAT "%7.5" /end CHARACTERISTIC
/begin CHARACTERISTIC c_crlc_cur_dmtl_fil_refu "Correlation constant at the beginning of pump current filtering" VALUE 0xffe4153a _REC_VAL_20_u2 0.99998474 _CNV_A_R_LINEAR_____37_CM 0. 0.99998474 DISPLAY_IDENTIFIER C_CRLC_CUR_DMTL_FIL_REFU FORMAT "%7.5" /end CHARACTERISTIC
/begin CHARACTERISTIC c_crlc_vb_dmtl_fil "Time constant of VB filtering" VALUE 0xffe4157c _REC_VAL_20_u2 0.99998474 _CNV_A_R_LINEAR_____37_CM 0. 0.99998474 DISPLAY_IDENTIFIER C_CRLC_VB_DMTL_FIL FORMAT "%7.5" /end CHARACTERISTIC
/begin CHARACTERISTIC c_crlc_vb_dmtl_fil_lim "Time constant at the beginning of VB filtering" VALUE 0xffe4157e _REC_VAL_20_u2 0.99998474 _CNV_A_R_LINEAR_____37_CM 0. 0.99998474 DISPLAY_IDENTIFIER C_CRLC_VB_DMTL_FIL_LIM FORMAT "%7.5" /end CHARACTERISTIC
/begin CHARACTERISTIC c_cur_dmtl_cor_fil_ofs_amp "Pump current offset in case of ambient pressure" VALUE 0xffe403de _REC_VAL_20_s2 399.9938 _CNV_A_R_LINEAR_____167_CM -200. 199.9938 DISPLAY_IDENTIFIER C_CUR_DMTL_COR_FIL_OFS_AMP FORMAT "%8.3" /end CHARACTERISTIC
/begin CHARACTERISTIC c_cur_dmtl_dif_cur_dmtl_stat "Delta pump current for pump current" VALUE 0xffe41592 _REC_VAL_20_u2 400. _CNV_A_R_LINEAR_____168_CM 0. 400. DISPLAY_IDENTIFIER C_CUR_DMTL_DIF_CUR_DMTL_STAT FORMAT "%7.3" /end CHARACTERISTIC
/begin CHARACTERISTIC c_cur_dmtl_ref_leak_max "upper threshold of pump current for reference measurement" VALUE 0xffe41598 _REC_VAL_20_u2 400. _CNV_A_R_LINEAR_____168_CM 0. 400. DISPLAY_IDENTIFIER C_CUR_DMTL_REF_LEAK_MAX FORMAT "%7.3" /end CHARACTERISTIC
/begin CHARACTERISTIC c_cur_dmtl_ref_leak_min "lower threshold of pump current for reference measurement" VALUE 0xffe4159a _REC_VAL_20_u2 400. _CNV_A_R_LINEAR_____168_CM 0. 400. DISPLAY_IDENTIFIER C_CUR_DMTL_REF_LEAK_MIN FORMAT "%7.3" /end CHARACTERISTIC
/begin CHARACTERISTIC c_cur_dmtl_ref_ofs "Reference pump current offset" VALUE 0xffe4159c _REC_VAL_20_u2 400. _CNV_A_R_LINEAR_____168_CM 0. 400. DISPLAY_IDENTIFIER C_CUR_DMTL_REF_OFS FORMAT "%7.3" /end CHARACTERISTIC
/begin CHARACTERISTIC c_ena_fco_diag "Threshold consumed fuel for diagnosis enable" VALUE 0xffe415e0 _REC_VAL_20_u2 4294.9 _CNV_A_R_LINEAR_____169_CM 0. 4294.9 DISPLAY_IDENTIFIER C_ENA_FCO_DIAG FORMAT "%7.2" /end CHARACTERISTIC
/begin CHARACTERISTIC c_fco_diag_max "Upper tolerance variable for level sensor diagnosis" VALUE 0xffe40381 _REC_VAL_20_s1 255. _CNV_A_R_LINEAR_____96_CM -128. 127. DISPLAY_IDENTIFIER C_FCO_DIAG_MAX FORMAT "%4.0" /end CHARACTERISTIC
/begin CHARACTERISTIC c_fco_diag_min "Lower tolerance variable for level sensor diagnosis" VALUE 0xffe40382 _REC_VAL_20_s1 255. _CNV_A_R_LINEAR_____96_CM -128. 127. DISPLAY_IDENTIFIER C_FCO_DIAG_MIN FORMAT "%4.0" /end CHARACTERISTIC
/begin CHARACTERISTIC c_ftl_dec_ftl_diag_min "minimum level decrease for refueling detection" VALUE 0xffe40383 _REC_VAL_20_s1 255. _CNV_A_R_LINEAR_____96_CM -128. 127. DISPLAY_IDENTIFIER C_FTL_DEC_FTL_DIAG_MIN FORMAT "%4.0" /end CHARACTERISTIC
/begin CHARACTERISTIC c_ftl_diag_max "maximum tank level" VALUE 0xffe41668 _REC_VAL_20_u2 126. _CNV_A_R_LINEAR_____170_CM 0. 126. DISPLAY_IDENTIFIER C_FTL_DIAG_MAX FORMAT "%6.2" /end CHARACTERISTIC
/begin CHARACTERISTIC c_ftl_diag_min "minimum fuel tank volume for refueling detection" VALUE 0xffe40384 _REC_VAL_20_s1 255. _CNV_A_R_LINEAR_____96_CM -128. 127. DISPLAY_IDENTIFIER C_FTL_DIAG_MIN FORMAT "%4.0" /end CHARACTERISTIC
/begin CHARACTERISTIC c_ftl_dmtl_max "max. tank level for DMTL function" VALUE 0xffe40756 _REC_VAL_20_u1 5.04 _CNV_A_R_LINEAR_____96_CM 0. 126. DISPLAY_IDENTIFIER C_FTL_DMTL_MAX FORMAT "%3.0" /end CHARACTERISTIC
/begin CHARACTERISTIC c_ftl_dmtl_min "min. tank level for DMTL function" VALUE 0xffe40757 _REC_VAL_20_u1 5.04 _CNV_A_R_LINEAR_____96_CM 0. 126. DISPLAY_IDENTIFIER C_FTL_DMTL_MIN FORMAT "%3.0" /end CHARACTERISTIC
/begin CHARACTERISTIC c_hys_ftl_dmtl "hysteresis for tank level bit for DMTL function" VALUE 0xffe4075a _REC_VAL_20_u1 5.04 _CNV_A_R_LINEAR_____96_CM 0. 126. DISPLAY_IDENTIFIER C_HYS_FTL_DMTL FORMAT "%3.0" /end CHARACTERISTIC
/begin CHARACTERISTIC c_r_dmtl "Resistance of pump current measurement" VALUE 0xffe40835 _REC_VAL_20_u1 50. _CNV_A_R_LINEAR_____171_CM 0. 50. DISPLAY_IDENTIFIER C_R_DMTL /end CHARACTERISTIC
/begin CHARACTERISTIC c_sum_ena_rough_leak_max "maximum number of ENABLES satisfied for rough leak check" VALUE 0xffe4084d _REC_VAL_20_u1 255. _CNV_A_R_LINEAR_____0_CM 0. 255. DISPLAY_IDENTIFIER C_SUM_ENA_ROUGH_LEAK_MAX FORMAT "%3.0" /end CHARACTERISTIC
/begin CHARACTERISTIC c_sum_ena_rough_leak_test_max "max. number of miniature leak checks after refueling" VALUE 0xffe4084e _REC_VAL_20_u1 255. _CNV_A_R_LINEAR_____0_CM 0. 255. DISPLAY_IDENTIFIER C_SUM_ENA_ROUGH_LEAK_TEST_MAX FORMAT "%3.0" /end CHARACTERISTIC
/begin CHARACTERISTIC c_sum_ena_small_leak_test_max "max. number of rough leak checks for miniature leak check" VALUE 0xffe4084f _REC_VAL_20_u1 255. _CNV_A_R_LINEAR_____0_CM 0. 255. DISPLAY_IDENTIFIER C_SUM_ENA_SMALL_LEAK_TEST_MAX FORMAT "%3.0" /end CHARACTERISTIC
/begin CHARACTERISTIC c_sum_rep_rough_leak_mes_fuc_max "maximum number of repeated check filler cap checks" VALUE 0xffe40853 _REC_VAL_20_u1 255. _CNV_A_R_LINEAR_____0_CM 0. 255. DISPLAY_IDENTIFIER C_SUM_REP_ROUGH_LEAK_MES_FUC_MAX FORMAT "%3.0" /end CHARACTERISTIC
/begin CHARACTERISTIC c_t_cur_dmtl_rough_leak_max "max. time pump current check in rough leak phase" VALUE 0xffe418ea _REC_VAL_20_u2 6553.5 _CNV_A_R_LINEAR_____24_CM 0. 6553.5 DISPLAY_IDENTIFIER C_T_CUR_DMTL_ROUGH_LEAK_MAX FORMAT "%6.1" /end CHARACTERISTIC
/begin CHARACTERISTIC c_t_cur_dmtl_rough_leak_min "min. time pump current check in rough leak phase" VALUE 0xffe418ec _REC_VAL_20_u2 6553.5 _CNV_A_R_LINEAR_____24_CM 0. 6553.5 DISPLAY_IDENTIFIER C_T_CUR_DMTL_ROUGH_LEAK_MIN FORMAT "%6.1" /end CHARACTERISTIC
/begin CHARACTERISTIC c_t_cur_dmtl_stat "Time for pump current stable" VALUE 0xffe418ee _REC_VAL_20_u2 6553.5 _CNV_A_R_LINEAR_____24_CM 0. 6553.5 DISPLAY_IDENTIFIER C_T_CUR_DMTL_STAT FORMAT "%6.1" /end CHARACTERISTIC
/begin CHARACTERISTIC c_t_dly_cur_dmtl_dif_mes "Current decrease detection delay during measurement" VALUE 0xffe41904 _REC_VAL_20_u2 6553.5 _CNV_A_R_LINEAR_____24_CM 0. 6553.5 DISPLAY_IDENTIFIER C_T_DLY_CUR_DMTL_DIF_MES FORMAT "%6.1" /end CHARACTERISTIC
/begin CHARACTERISTIC c_t_dly_det_refu "Wait period of refueling detection" VALUE 0xffe41906 _REC_VAL_20_u2 655.35 _CNV_A_R_LINEAR_____4_CM 0. 655.35 DISPLAY_IDENTIFIER C_T_DLY_DET_REFU FORMAT "%6.2" /end CHARACTERISTIC
/begin CHARACTERISTIC c_t_dly_dmtls "Waiting time after change-over of solenoid valve" VALUE 0xffe40879 _REC_VAL_20_u1 25.5 _CNV_A_R_LINEAR_____24_CM 0. 25.5 DISPLAY_IDENTIFIER C_T_DLY_DMTLS FORMAT "%4.1" /end CHARACTERISTIC
/begin CHARACTERISTIC c_t_dly_es_pwl "Post-operating wait period until start of DMTL function" VALUE 0xffe4087a _REC_VAL_20_u1 25.5 _CNV_A_R_LINEAR_____24_CM 0. 25.5 DISPLAY_IDENTIFIER C_T_DLY_ES_PWL FORMAT "%4.1" /end CHARACTERISTIC
/begin CHARACTERISTIC c_t_dly_fuc_can_off "Delay time with which Check filler Cap - light is switched off" VALUE 0xffe41914 _REC_VAL_20_u2 6553.5 _CNV_A_R_LINEAR_____24_CM 0. 6553.5 DISPLAY_IDENTIFIER C_T_DLY_FUC_CAN_OFF FORMAT "%6.1" /end CHARACTERISTIC
/begin CHARACTERISTIC c_t_dly_fuc_can_on "Delay time with which Check filler Cap - light is switched on" VALUE 0xffe41916 _REC_VAL_20_u2 6553.5 _CNV_A_R_LINEAR_____24_CM 0. 6553.5 DISPLAY_IDENTIFIER C_T_DLY_FUC_CAN_ON FORMAT "%6.1" /end CHARACTERISTIC
/begin CHARACTERISTIC c_t_dly_igk_ftl "Minimum time for which LV_IGK must be = 1 to issue a validated level" VALUE 0xffe4087b _REC_VAL_20_u1 1.02 _CNV_A_R_LINEAR_____24_CM 0. 25.5 DISPLAY_IDENTIFIER C_T_DLY_IGK_FTL FORMAT "%4.1" /end CHARACTERISTIC
/begin CHARACTERISTIC c_t_dly_req_pwl_dmtl "Post-operating time after no request for extending the post-operating phase is present any longer" VALUE 0xffe40890 _REC_VAL_20_u1 25.5 _CNV_A_R_LINEAR_____24_CM 0. 25.5 DISPLAY_IDENTIFIER C_T_DLY_REQ_PWL_DMTL FORMAT "%4.1" /end CHARACTERISTIC
/begin CHARACTERISTIC c_t_dmtl_eol_max "Max. time for end of line diagnosis after test unit initiation" VALUE 0xffe4193e _REC_VAL_20_u2 6553.5 _CNV_A_R_LINEAR_____24_CM 0. 6553.5 DISPLAY_IDENTIFIER C_T_DMTL_EOL_MAX FORMAT "%6.1" /end CHARACTERISTIC
/begin CHARACTERISTIC c_t_dmtl_max "Maximum time for DMTL diagnosis" VALUE 0xffe41940 _REC_VAL_20_u2 6553.5 _CNV_A_R_LINEAR_____24_CM 0. 6553.5 DISPLAY_IDENTIFIER C_T_DMTL_MAX FORMAT "%6.1" /end CHARACTERISTIC
/begin CHARACTERISTIC c_t_es_dmtl_min "minimum shut-off time for tank leakage diagnosis" VALUE 0xffe4196c _REC_VAL_20_u2 65535. _CNV_A_R_LINEAR_____97_CM 0. 65535. DISPLAY_IDENTIFIER C_T_ES_DMTL_MIN FORMAT "%5.0" /end CHARACTERISTIC
/begin CHARACTERISTIC c_t_es_sub_dmtl "Substitute shut-off time for tank leakage diagnosis" VALUE 0xffe41970 _REC_VAL_20_u2 65535. _CNV_A_R_LINEAR_____97_CM 0. 65535. DISPLAY_IDENTIFIER C_T_ES_SUB_DMTL FORMAT "%5.0" /end CHARACTERISTIC
/begin CHARACTERISTIC c_t_ref_leak_mes_max "Time for reference leakage measurement" VALUE 0xffe419e8 _REC_VAL_20_u2 6553.5 _CNV_A_R_LINEAR_____24_CM 0. 6553.5 DISPLAY_IDENTIFIER C_T_REF_LEAK_MES_MAX FORMAT "%6.1" /end CHARACTERISTIC
/begin CHARACTERISTIC c_t_ref_leak_mes_rep_max "Time for repeat reference leakage measurement" VALUE 0xffe419ea _REC_VAL_20_u2 6553.5 _CNV_A_R_LINEAR_____24_CM 0. 6553.5 DISPLAY_IDENTIFIER C_T_REF_LEAK_MES_REP_MAX FORMAT "%6.1" /end CHARACTERISTIC
/begin CHARACTERISTIC c_t_vb_dly_dmtl "Time delay for Vbat monitoring" VALUE 0xffe41a20 _REC_VAL_20_u2 6553.5 _CNV_A_R_LINEAR_____24_CM 0. 6553.5 DISPLAY_IDENTIFIER C_T_VB_DLY_DMTL FORMAT "%6.1" /end CHARACTERISTIC
/begin CHARACTERISTIC c_tam_dmtl_min "lower temperature threshold for the DMTL function" VALUE 0xffe408d6 _REC_VAL_20_u1 190.5 _CNV_A_R_LINEAR_____11_CM -48. 142.5 DISPLAY_IDENTIFIER C_TAM_DMTL_MIN FORMAT "%5.1" /end CHARACTERISTIC
/begin CHARACTERISTIC c_tco_st_dmtl_min "min. TCO_ST for DMTL enable" VALUE 0xffe40927 _REC_VAL_20_u1 190.5 _CNV_A_R_LINEAR_____11_CM -48. 142.5 DISPLAY_IDENTIFIER C_TCO_ST_DMTL_MIN FORMAT "%5.1" /end CHARACTERISTIC
/begin CHARACTERISTIC c_trt_dmtl_eol_max "" VALUE 0xffe414b0 _REC_VAL_20_u4 119304.6471 _CNV_A_R_LINEAR_____172_CM 0. 119304.6471 DISPLAY_IDENTIFIER C_TRT_DMTL_EOL_MAX FORMAT "%12.5" /end CHARACTERISTIC
/begin CHARACTERISTIC c_vb_dmtl_asa_max "Maximum battery threshold at end of line for DMTL" VALUE 0xffe409ad _REC_VAL_20_u1 26. _CNV_A_R_LINEAR_____60_CM 0. 26. DISPLAY_IDENTIFIER C_VB_DMTL_ASA_MAX FORMAT "%4.1" /end CHARACTERISTIC
/begin CHARACTERISTIC c_vb_dmtl_asa_min "Minimum battery threshold at end of line for DMTL" VALUE 0xffe409ae _REC_VAL_20_u1 26. _CNV_A_R_LINEAR_____60_CM 0. 26. DISPLAY_IDENTIFIER C_VB_DMTL_ASA_MIN FORMAT "%4.1" /end CHARACTERISTIC
/begin CHARACTERISTIC c_vb_dmtl_dif "Delta VB threshold for DMTL" VALUE 0xffe41b2a _REC_VAL_20_u2 26. _CNV_A_R_LINEAR_____173_CM 0. 26. DISPLAY_IDENTIFIER C_VB_DMTL_DIF FORMAT "%7.4" /end CHARACTERISTIC
/begin CHARACTERISTIC c_vb_dmtl_max "maximum battery threshold for the DMTL function" VALUE 0xffe409af _REC_VAL_20_u1 26. _CNV_A_R_LINEAR_____60_CM 0. 26. DISPLAY_IDENTIFIER C_VB_DMTL_MAX FORMAT "%4.1" /end CHARACTERISTIC
/begin CHARACTERISTIC c_vb_dmtl_min "minimum battery threshold for the DMTL function" VALUE 0xffe409b0 _REC_VAL_20_u1 26. _CNV_A_R_LINEAR_____60_CM 0. 26. DISPLAY_IDENTIFIER C_VB_DMTL_MIN FORMAT "%4.1" /end CHARACTERISTIC
/begin CHARACTERISTIC c_vs_ftl_diag_max "" VALUE 0xffe409cd _REC_VAL_20_u1 255. _CNV_A_R_LINEAR_____23_CM 0. 255. DISPLAY_IDENTIFIER C_VS_FTL_DIAG_MAX FORMAT "%3.0" /end CHARACTERISTIC
/begin MEASUREMENT ctr_cnl_rough_leak_mes_fuc "Number of aborted check filler cap checks" UBYTE _CNV_A_R_LINEAR_____0_CM 1 100. 0. 255. DISPLAY_IDENTIFIER CTR_CNL_ROUGH_LEAK_MES_FUC ECU_ADDRESS 0x3fe9d3 FORMAT "%3.0" /end MEASUREMENT
/begin MEASUREMENT ctr_cnl_small_leak_mes "Number of aborted miniature leak measurements due to current fluctuations" UBYTE _CNV_A_R_LINEAR_____0_CM 1 100. 0. 255. DISPLAY_IDENTIFIER CTR_CNL_SMALL_LEAK_MES ECU_ADDRESS 0x3fe9d4 FORMAT "%3.0" /end MEASUREMENT
/begin MEASUREMENT ctr_cur_dmtl_ref_dif_max "Number of aborted measurements due to current fluctuation" UWORD _CNV_A_R_LINEAR_____0_CM 1 100. 0. 65535. DISPLAY_IDENTIFIER CTR_CUR_DMTL_REF_DIF_MAX ECU_ADDRESS 0x3fdaf0 BYTE_ORDER MSB_LAST FORMAT "%5.0" /end MEASUREMENT
/begin MEASUREMENT ctr_dmtl_act "Number of commenced leakage measurements" UWORD _CNV_A_R_LINEAR_____0_CM 1 100. 0. 65535. DISPLAY_IDENTIFIER CTR_DMTL_ACT ECU_ADDRESS 0x3fdaf2 BYTE_ORDER MSB_LAST FORMAT "%5.0" /end MEASUREMENT
/begin MEASUREMENT ctr_rep_rough_leak_mes_fuc "Number of repeated check filler cap checks" UBYTE _CNV_A_R_LINEAR_____0_CM 1 100. 0. 255. DISPLAY_IDENTIFIER CTR_REP_ROUGH_LEAK_MES_FUC ECU_ADDRESS 0x3fe9d8 FORMAT "%3.0" /end MEASUREMENT
/begin MEASUREMENT ctr_rough_leak_mes "Number of realized rough leak diagnosis" UWORD _CNV_A_R_LINEAR_____0_CM 1 100. 0. 65535. DISPLAY_IDENTIFIER CTR_ROUGH_LEAK_MES ECU_ADDRESS 0x3fdaf4 BYTE_ORDER MSB_LAST FORMAT "%5.0" /end MEASUREMENT
/begin MEASUREMENT ctr_small_leak_mes "Number of realized miniature leak diagnosis" UWORD _CNV_A_R_LINEAR_____0_CM 1 100. 0. 65535. DISPLAY_IDENTIFIER CTR_SMALL_LEAK_MES ECU_ADDRESS 0x3fdaf6 BYTE_ORDER MSB_LAST FORMAT "%5.0" /end MEASUREMENT
/begin MEASUREMENT cur_dmtl "Pump current tank leakage diagnosis" UWORD _CNV_A_R_LINEAR_____168_CM 1 100. 0. 400. DISPLAY_IDENTIFIER CUR_DMTL ECU_ADDRESS 0x3fdaf8 BYTE_ORDER MSB_LAST FORMAT "%7.3" /end MEASUREMENT
/begin MEASUREMENT cur_dmtl_comp_rough_leak "Pump current comparision in case of rough leak measurement" UWORD _CNV_A_R_LINEAR_____168_CM 1 100. 0. 400. DISPLAY_IDENTIFIER CUR_DMTL_COMP_ROUGH_LEAK ECU_ADDRESS 0x3fdb38 BYTE_ORDER MSB_LAST FORMAT "%7.3" /end MEASUREMENT
/begin MEASUREMENT cur_dmtl_comp_small_leak_len "Pump current comparision in case of 2. miniature leak measurement" UWORD _CNV_A_R_LINEAR_____168_CM 1 100. 0. 400. DISPLAY_IDENTIFIER CUR_DMTL_COMP_SMALL_LEAK_LEN ECU_ADDRESS 0x3fdb3a BYTE_ORDER MSB_LAST FORMAT "%7.3" /end MEASUREMENT
/begin MEASUREMENT cur_dmtl_cor_fil_max "Maximum pump current during reference leka measurement" UWORD _CNV_A_R_LINEAR_____168_CM 1 100. 0. 400. DISPLAY_IDENTIFIER CUR_DMTL_COR_FIL_MAX ECU_ADDRESS 0x3fdb3e BYTE_ORDER MSB_LAST FORMAT "%7.3" /end MEASUREMENT
/begin MEASUREMENT cur_dmtl_cor_fil_min "Minimum pump current during reference leak  measurement" UWORD _CNV_A_R_LINEAR_____168_CM 1 100. 0. 400. DISPLAY_IDENTIFIER CUR_DMTL_COR_FIL_MIN ECU_ADDRESS 0x3fdb42 BYTE_ORDER MSB_LAST FORMAT "%7.3" /end MEASUREMENT
/begin MEASUREMENT cur_dmtl_cor_fil_refu_hpf "corrected, high-pass filtered pump current" SWORD _CNV_A_R_LINEAR_____167_CM 1 100. -200. 199.9938 DISPLAY_IDENTIFIER CUR_DMTL_COR_FIL_REFU_HPF ECU_ADDRESS 0x3fdb6e BYTE_ORDER MSB_LAST FORMAT "%8.3" /end MEASUREMENT
/begin MEASUREMENT cur_dmtl_dif "Differential pump current" UWORD _CNV_A_R_LINEAR_____168_CM 1 100. 0. 400. DISPLAY_IDENTIFIER CUR_DMTL_DIF ECU_ADDRESS 0x3fdb44 BYTE_ORDER MSB_LAST FORMAT "%7.3" /end MEASUREMENT
/begin MEASUREMENT cur_dmtl_dif_ref_rough_leak "Difference, pump current  between reference and min. in case of rough leak check" UWORD _CNV_A_R_LINEAR_____168_CM 1 100. 0. 400. DISPLAY_IDENTIFIER CUR_DMTL_DIF_REF_ROUGH_LEAK ECU_ADDRESS 0x3fdafa BYTE_ORDER MSB_LAST FORMAT "%7.3" /end MEASUREMENT
/begin MEASUREMENT cur_dmtl_ref_leak "Pump current reference leakage" UWORD _CNV_A_R_LINEAR_____168_CM 1 100. 0. 400. DISPLAY_IDENTIFIER CUR_DMTL_REF_LEAK ECU_ADDRESS 0x3fdafe BYTE_ORDER MSB_LAST FORMAT "%7.3" /end MEASUREMENT
/begin MEASUREMENT cur_dmtl_rough_leak_len_end "Pump current at the end of the rough leak measurement extension" UWORD _CNV_A_R_LINEAR_____168_CM 1 100. 0. 400. DISPLAY_IDENTIFIER CUR_DMTL_ROUGH_LEAK_LEN_END ECU_ADDRESS 0x3fdb4c BYTE_ORDER MSB_LAST FORMAT "%7.3" /end MEASUREMENT
/begin MEASUREMENT cur_dmtl_rough_leak_min "Min. pump current in case of rough leak measurement" UWORD _CNV_A_R_LINEAR_____168_CM 1 100. 0. 400. DISPLAY_IDENTIFIER CUR_DMTL_ROUGH_LEAK_MIN ECU_ADDRESS 0x3fdb02 BYTE_ORDER MSB_LAST FORMAT "%7.3" /end MEASUREMENT
/begin MEASUREMENT cur_dmtl_thd_rough_leak_len "Pump current threshold in case of rough leak measurement extension" UWORD _CNV_A_R_LINEAR_____168_CM 1 100. 0. 400. DISPLAY_IDENTIFIER CUR_DMTL_THD_ROUGH_LEAK_LEN ECU_ADDRESS 0x3fdb54 BYTE_ORDER MSB_LAST FORMAT "%7.3" /end MEASUREMENT
/begin MEASUREMENT fco_av_dmtl "currently consumed fuel" UWORD _CNV_A_R_LINEAR_____169_CM 1 100. 0. 4294.9 DISPLAY_IDENTIFIER FCO_AV_DMTL ECU_ADDRESS 0x3fdb06 BYTE_ORDER MSB_LAST FORMAT "%7.2" /end MEASUREMENT
/begin MEASUREMENT state_dmtl "DMTL state" UBYTE _CNV_S_13_STATE_DMTL_174_CM 1 100. 0. 12. DISPLAY_IDENTIFIER STATE_DMTL ECU_ADDRESS 0x3fe9df /end MEASUREMENT
/begin MEASUREMENT t_act_cur_dmtl_stat "Current time, pump current stable" UWORD _CNV_A_R_LINEAR_____24_CM 1 100. 0. 6553.5 DISPLAY_IDENTIFIER T_ACT_CUR_DMTL_STAT ECU_ADDRESS 0x3fdb58 BYTE_ORDER MSB_LAST FORMAT "%6.1" /end MEASUREMENT
/begin MEASUREMENT t_act_leak_mes "Current time, leakage measurement" UWORD _CNV_A_R_LINEAR_____24_CM 1 100. 0. 6553.5 DISPLAY_IDENTIFIER T_ACT_LEAK_MES ECU_ADDRESS 0x3fdb12 BYTE_ORDER MSB_LAST FORMAT "%6.1" /end MEASUREMENT
/begin MEASUREMENT t_act_ref_leak_mes "Current time, reference leakage measurement" UWORD _CNV_A_R_LINEAR_____24_CM 1 100. 0. 6553.5 DISPLAY_IDENTIFIER T_ACT_REF_LEAK_MES ECU_ADDRESS 0x3fdb5a BYTE_ORDER MSB_LAST FORMAT "%6.1" /end MEASUREMENT
/begin MEASUREMENT t_es_dmtl "Engine off duration time for the DMTL-function" UWORD _CNV_A_R_LINEAR_____97_CM 1 100. 0. 65535. DISPLAY_IDENTIFIER T_ES_DMTL ECU_ADDRESS 0x3fdb66 BYTE_ORDER MSB_LAST FORMAT "%5.0" /end MEASUREMENT
/begin MEASUREMENT cur_dmtl_dmtls_test "pump current during pump test" UWORD _CNV_A_R_LINEAR_____168_CM 1 100. 0. 400. DISPLAY_IDENTIFIER CUR_DMTL_DMTLS_TEST ECU_ADDRESS 0x3fdb46 BYTE_ORDER MSB_LAST FORMAT "%7.3" /end MEASUREMENT
/begin MEASUREMENT cur_dmtl_thd_rough_leak "Pump current threshold in case of rough leak measurement" UWORD _CNV_A_R_LINEAR_____168_CM 1 100. 0. 400. DISPLAY_IDENTIFIER CUR_DMTL_THD_ROUGH_LEAK ECU_ADDRESS 0x3fdb52 BYTE_ORDER MSB_LAST FORMAT "%7.3" /end MEASUREMENT
/begin MEASUREMENT cur_dmtl_thd_dmtls_test "Pump current threshold in case of DMTL valve check" UWORD _CNV_A_R_LINEAR_____168_CM 1 100. 0. 400. DISPLAY_IDENTIFIER CUR_DMTL_THD_DMTLS_TEST ECU_ADDRESS 0x3fdb50 BYTE_ORDER MSB_LAST FORMAT "%7.3" /end MEASUREMENT
/begin CHARACTERISTIC c_t_ast_dmtl_max "min. post-starting period for canister purge diagnosis" VALUE 0xffe418d6 _REC_VAL_20_u2 6553.2 _CNV_A_R_LINEAR_____24_CM 0.3 6553.5 DISPLAY_IDENTIFIER C_T_AST_DMTL_MAX FORMAT "%6.1" /end CHARACTERISTIC
/begin CHARACTERISTIC c_t_act_rough_leak "Time for rough leak measurement" VALUE 0xffe418ce _REC_VAL_20_u2 6553.2 _CNV_A_R_LINEAR_____24_CM 0.3 6553.5 DISPLAY_IDENTIFIER C_T_ACT_ROUGH_LEAK FORMAT "%6.1" /end CHARACTERISTIC
/begin CHARACTERISTIC c_t_act_small_leak "Time for miniature leak measurement" VALUE 0xffe418d0 _REC_VAL_20_u2 6553.2 _CNV_A_R_LINEAR_____24_CM 0.3 6553.5 DISPLAY_IDENTIFIER C_T_ACT_SMALL_LEAK FORMAT "%6.1" /end CHARACTERISTIC
/begin CHARACTERISTIC ip_t_act_small_leak__ftl "Time for miniature leak measurement" CURVE 0xffe4e638 _REC_CUR_20_u2_u1 655.35 _CNV_A_R_LINEAR_____24_CM 0. 6553.5 DISPLAY_IDENTIFIER IP_T_ACT_SMALL_LEAK__FTL FORMAT "%6.1"
 /begin AXIS_DESCR COM_AXIS ftl _CNV_A_R_LINEAR_____96_CM 5 0. 126. FORMAT "%3.0" AXIS_PTS_REF ldp_ftl__t_small_leak_test /end AXIS_DESCR
/end CHARACTERISTIC
/begin CHARACTERISTIC ip_fac_cur_dmtl_rough "Factor delta pump current for rough leak detection" CURVE 0xffe4afca _REC_CUR_20_u2_u2 0.99998474 _CNV_A_R_LINEAR_____37_CM 0. 0.99998474 DISPLAY_IDENTIFIER IP_FAC_CUR_DMTL_ROUGH FORMAT "%7.5"
 /begin AXIS_DESCR COM_AXIS cur_dmtl_dif_ref_rough_leak _CNV_A_R_LINEAR_____168_CM 8 0. 400. FORMAT "%7.3" AXIS_PTS_REF ldpm_cur_dmtldifrefroughleak_1 /end AXIS_DESCR
/end CHARACTERISTIC
/begin CHARACTERISTIC ip_fac_cur_dmtl_ref "Factor delta pump current for rouh leak detection concerning reference" CURVE 0xffe4afba _REC_CUR_20_u2_u2 0.99998474 _CNV_A_R_LINEAR_____37_CM 0. 0.99998474 DISPLAY_IDENTIFIER IP_FAC_CUR_DMTL_REF FORMAT "%7.5"
 /begin AXIS_DESCR COM_AXIS cur_dmtl_dif_ref_rough_leak _CNV_A_R_LINEAR_____168_CM 8 0. 400. FORMAT "%7.3" AXIS_PTS_REF ldpm_cur_dmtldifrefroughleak_1 /end AXIS_DESCR
/end CHARACTERISTIC
/begin CHARACTERISTIC ip_t_cur_dmtl_stat "Time for pump current stable" MAP 0xffe4e7d2 _REC_MAP_20_u2_u2_u1 655.35 _CNV_A_R_LINEAR_____24_CM 0. 6553.5 DISPLAY_IDENTIFIER IP_T_CUR_DMTL_STAT FORMAT "%6.1"
 /begin AXIS_DESCR COM_AXIS cur_dmtl_dif_ref_rough_leak _CNV_A_R_LINEAR_____168_CM 8 0. 400. FORMAT "%7.3" AXIS_PTS_REF ldpm_cur_dmtldifrefroughleak_1 /end AXIS_DESCR
 /begin AXIS_DESCR COM_AXIS ftl _CNV_A_R_LINEAR_____96_CM 8 0. 126. FORMAT "%3.0" AXIS_PTS_REF ldp_ftl__t_cur_dmtl_stat /end AXIS_DESCR
/end CHARACTERISTIC
/begin CHARACTERISTIC c_t_ref_test_rough_leak "Time for reference test in case of rough leak check" VALUE 0xffe419ec _REC_VAL_20_u2 6553.5 _CNV_A_R_LINEAR_____24_CM 0. 6553.5 DISPLAY_IDENTIFIER C_T_REF_TEST_ROUGH_LEAK FORMAT "%6.1" /end CHARACTERISTIC
/begin CHARACTERISTIC c_fac_t_cur_dmtl_stat_len "Factor for 2. stabilization" VALUE 0xffe4161e _REC_VAL_20_u2 0.99997 _CNV_A_R_LINEAR_____175_CM 0. 0.99997 DISPLAY_IDENTIFIER C_FAC_T_CUR_DMTL_STAT_LEN FORMAT "%8.6" /end CHARACTERISTIC
/begin MEASUREMENT cur_dmtl_cor "Corrected pump current" UWORD _CNV_A_R_LINEAR_____168_CM 1 100. 0. 400. DISPLAY_IDENTIFIER CUR_DMTL_COR ECU_ADDRESS 0x3fdb3c BYTE_ORDER MSB_LAST FORMAT "%7.3" /end MEASUREMENT
/begin MEASUREMENT cur_dmtl_cor_fil "corrected and filtered pump current" UWORD _CNV_A_R_LINEAR_____168_CM 1 100. 0. 400. DISPLAY_IDENTIFIER CUR_DMTL_COR_FIL ECU_ADDRESS 0x3fcfec BYTE_ORDER MSB_LAST FORMAT "%7.3" /end MEASUREMENT
/begin CHARACTERISTIC ip_fac_cur_dmtl "Battery-voltage dependent correction factor for the pump current" CURVE 0xffe40b6c _REC_CUR_20_u1_u2 1.9921875 _CNV_A_R_LINEAR_____117_CM 0. 1.9921875 DISPLAY_IDENTIFIER IP_FAC_CUR_DMTL FORMAT "%5.3"
 /begin AXIS_DESCR COM_AXIS vb_dmtl_fil _CNV_A_R_LINEAR_____173_CM 6 0. 26. FORMAT "%7.4" AXIS_PTS_REF ldp_vb_dmtl_fil__fac_cur_dmtl /end AXIS_DESCR
/end CHARACTERISTIC
/begin MEASUREMENT vb_dmtl_ref "Filtered battery voltage on transition to refeence leak measurement" UWORD _CNV_A_R_LINEAR_____173_CM 1 100. 0. 26. DISPLAY_IDENTIFIER VB_DMTL_REF ECU_ADDRESS 0x3fdb6c BYTE_ORDER MSB_LAST FORMAT "%7.4" /end MEASUREMENT
/begin MEASUREMENT vb_dmtl_fil "Filtered battery voltage" UWORD _CNV_A_R_LINEAR_____173_CM 1 100. 0. 26. DISPLAY_IDENTIFIER VB_DMTL_FIL ECU_ADDRESS 0x3fdb18 BYTE_ORDER MSB_LAST FORMAT "%7.4" /end MEASUREMENT
/begin CHARACTERISTIC c_tam_dmtl_max "upper temperature threshold for the DMTL function" VALUE 0xffe408d5 _REC_VAL_20_u1 190.5 _CNV_A_R_LINEAR_____11_CM -48. 142.5 DISPLAY_IDENTIFIER C_TAM_DMTL_MAX FORMAT "%5.1" /end CHARACTERISTIC
/begin CHARACTERISTIC c_cl_dmtl_max "maximum loading degree for the DMTL function" VALUE 0xffe4151c _REC_VAL_20_u2 1.99996948 _CNV_A_R_LINEAR_____20_CM 0. 1.99996948 DISPLAY_IDENTIFIER C_CL_DMTL_MAX FORMAT "%7.5" /end CHARACTERISTIC
/begin CHARACTERISTIC c_vs_fuc_can_min "Minimum speed for activation Check filler cap" VALUE 0xffe409ce _REC_VAL_20_u1 255. _CNV_A_R_LINEAR_____23_CM 0. 255. DISPLAY_IDENTIFIER C_VS_FUC_CAN_MIN FORMAT "%3.0" /end CHARACTERISTIC
/begin CHARACTERISTIC c_vs_dmtl_max "max. vehicle speed" VALUE 0xffe409cb _REC_VAL_20_u1 255. _CNV_A_R_LINEAR_____23_CM 0. 255. DISPLAY_IDENTIFIER C_VS_DMTL_MAX FORMAT "%3.0" /end CHARACTERISTIC
/begin MEASUREMENT ftl_ini "Ini value level for diagnostic cycle" UBYTE _CNV_A_R_LINEAR_____96_CM 1 100. 0. 126. DISPLAY_IDENTIFIER FTL_INI ECU_ADDRESS 0x3fe9dd FORMAT "%3.0" /end MEASUREMENT
/begin MEASUREMENT ftl_old "FTL for plausibility check" UBYTE _CNV_A_R_LINEAR_____96_CM 1 100. 0. 126. DISPLAY_IDENTIFIER FTL_OLD ECU_ADDRESS 0x3fe9de FORMAT "%3.0" /end MEASUREMENT
/begin MEASUREMENT ctr_ena_rough_leak "Counter of  enable conditions fulfilled, without rough leak test" UBYTE _CNV_A_R_LINEAR_____0_CM 1 100. 0. 255. DISPLAY_IDENTIFIER CTR_ENA_ROUGH_LEAK ECU_ADDRESS 0x3fe9d5 FORMAT "%3.0" /end MEASUREMENT
/begin CHARACTERISTIC c_sum_cnl_rough_leak_mes_fuc_max "maximum number of aborted check filler cap checks" VALUE 0xffe40848 _REC_VAL_20_u1 255. _CNV_A_R_LINEAR_____0_CM 0. 255. DISPLAY_IDENTIFIER C_SUM_CNL_ROUGH_LEAK_MES_FUC_MAX FORMAT "%3.0" /end CHARACTERISTIC
/begin CHARACTERISTIC c_sum_cnl_small_leak_mes_max "Max. number of aborted miniature leak  checks due to current fluctuations" VALUE 0xffe40849 _REC_VAL_20_u1 255. _CNV_A_R_LINEAR_____0_CM 0. 255. DISPLAY_IDENTIFIER C_SUM_CNL_SMALL_LEAK_MES_MAX FORMAT "%3.0" /end CHARACTERISTIC
/begin MEASUREMENT ctr_ena_rough_leak_test "Counter for the number of rough leak checks for miniature leak check" UBYTE _CNV_A_R_LINEAR_____0_CM 1 100. 0. 255. DISPLAY_IDENTIFIER CTR_ENA_ROUGH_LEAK_TEST ECU_ADDRESS 0x3fe9d6 FORMAT "%3.0" /end MEASUREMENT
/begin MEASUREMENT ctr_ena_small_leak_test "Counter recording the number of miniature leak checks after refueling" UBYTE _CNV_A_R_LINEAR_____0_CM 1 100. 0. 255. DISPLAY_IDENTIFIER CTR_ENA_SMALL_LEAK_TEST ECU_ADDRESS 0x3fe9d7 FORMAT "%3.0" /end MEASUREMENT
/begin CHARACTERISTIC c_cur_dmtl_ref_dif_max "Upper threshold of the Delta pump current" VALUE 0xffe41596 _REC_VAL_20_u2 400. _CNV_A_R_LINEAR_____168_CM 0. 400. DISPLAY_IDENTIFIER C_CUR_DMTL_REF_DIF_MAX FORMAT "%7.3" /end CHARACTERISTIC
/begin CHARACTERISTIC c_cur_dmtl_dif_thd_refu "Threshold pump current change for refueling detection" VALUE 0xffe403e2 _REC_VAL_20_s2 399.9938 _CNV_A_R_LINEAR_____167_CM -200. 199.9938 DISPLAY_IDENTIFIER C_CUR_DMTL_DIF_THD_REFU FORMAT "%8.3" /end CHARACTERISTIC
/begin CHARACTERISTIC c_cur_dmtl_dif_thd_fuc "Threshold pump current change for refueling detection" VALUE 0xffe403e0 _REC_VAL_20_s2 399.9938 _CNV_A_R_LINEAR_____167_CM -200. 199.9938 DISPLAY_IDENTIFIER C_CUR_DMTL_DIF_THD_FUC FORMAT "%8.3" /end CHARACTERISTIC
/begin CHARACTERISTIC c_cur_dmtl_dif_thd_mes "Current decrease threshold during measurement" VALUE 0xffe41594 _REC_VAL_20_u2 400. _CNV_A_R_LINEAR_____168_CM 0. 400. DISPLAY_IDENTIFIER C_CUR_DMTL_DIF_THD_MES FORMAT "%7.3" /end CHARACTERISTIC
/begin CHARACTERISTIC c_dist_refu_rough_leak_min "lower threshold of distance covered between refueling and rough leak suspicion" VALUE 0xffe415bc _REC_VAL_20_u2 65535. _CNV_A_R_LINEAR_____176_CM 0. 65535. DISPLAY_IDENTIFIER C_DIST_REFU_ROUGH_LEAK_MIN FORMAT "%5.0" /end CHARACTERISTIC
/begin CHARACTERISTIC lc_cod_hdmtl "Max. time for end of line diagnosis after test unit initiation" VALUE 0xffe40f41 _REC_VAL_20_u1 1. _CNV_A_R_LINEAR_____0_CM 0. 1. DISPLAY_IDENTIFIER LC_COD_HDMTL FORMAT "%2.0" /end CHARACTERISTIC
/begin CHARACTERISTIC ip_t_act_rough_leak "Time for rough leak measurement" CURVE 0xffe4e62e _REC_CUR_20_u2_u1 655.35 _CNV_A_R_LINEAR_____24_CM 0. 6553.5 DISPLAY_IDENTIFIER IP_T_ACT_ROUGH_LEAK FORMAT "%6.1"
 /begin AXIS_DESCR COM_AXIS ftl _CNV_A_R_LINEAR_____96_CM 5 0. 126. FORMAT "%3.0" AXIS_PTS_REF ldp_ftl__t_rough_leak_test /end AXIS_DESCR
/end CHARACTERISTIC
/begin AXIS_PTS ldp_ftl__t_cur_dmtl_stat "" 0xffe47f29 ftl _REC_AXS_20_u1 126. _CNV_A_R_LINEAR_____96_CM 8 0. 126. DISPLAY_IDENTIFIER LDP_FTL__T_CUR_DMTL_STAT FORMAT "%3.0" /end AXIS_PTS
/begin AXIS_PTS ldp_ftl__t_small_leak_test "" 0xffe41037 ftl _REC_AXS_20_u1 126. _CNV_A_R_LINEAR_____96_CM 5 0. 126. DISPLAY_IDENTIFIER LDP_FTL__T_SMALL_LEAK_TEST FORMAT "%3.0" /end AXIS_PTS
/begin AXIS_PTS ldp_vb_dmtl_fil__fac_cur_dmtl "" 0xffe51630 vb_dmtl_fil _REC_AXS_20_u2 26. _CNV_A_R_LINEAR_____173_CM 6 0. 26. DISPLAY_IDENTIFIER LDP_VB_DMTL_FIL__FAC_CUR_DMTL FORMAT "%7.4" /end AXIS_PTS
/begin AXIS_PTS ldpm_cur_dmtldifrefroughleak_1 "" 0xffe517c2 cur_dmtl_dif_ref_rough_leak _REC_AXS_20_u2 400. _CNV_A_R_LINEAR_____168_CM 8 0. 400. DISPLAY_IDENTIFIER LDPM_CUR_DMTLDIFREFROUGHLEAK_1 FORMAT "%7.3" /end AXIS_PTS
/begin AXIS_PTS ldp_ftl__t_rough_leak_test "" 0xffe41031 ftl _REC_AXS_20_u1 126. _CNV_A_R_LINEAR_____96_CM 5 0. 126. DISPLAY_IDENTIFIER LDP_FTL__T_ROUGH_LEAK_TEST FORMAT "%3.0" /end AXIS_PTS
/begin MEASUREMENT dmtl_priv_state_1.bitfield.lv_chk_dmtl_cur_dmtl_vld "Check of components on pump current thresholds valid" ULONG _CNV_S_2_RANGE______2_CM 1 100. 0. 1. DISPLAY_IDENTIFIER LV_CHK_DMTL_CUR_DMTL_VLD ECU_ADDRESS 0x3fcff8 BYTE_ORDER MSB_LAST BIT_MASK 0x80000000 /end MEASUREMENT
/begin MEASUREMENT dmtl_priv_state_1.bitfield.lv_chk_dmtl_vld "Check of components on current fluctuations valid" ULONG _CNV_S_2_RANGE______2_CM 1 100. 0. 1. DISPLAY_IDENTIFIER LV_CHK_DMTL_VLD ECU_ADDRESS 0x3fcff8 BYTE_ORDER MSB_LAST BIT_MASK 0x40000000 /end MEASUREMENT
/begin MEASUREMENT dmtl_priv_state_1.bitfield.lv_cur_dmtl_dmtls_test "Pump current threshold reached in case of  DMTL-valve check" ULONG _CNV_S_2_RANGE______2_CM 1 100. 0. 1. DISPLAY_IDENTIFIER LV_CUR_DMTL_DMTLS_TEST ECU_ADDRESS 0x3fcff8 BYTE_ORDER MSB_LAST BIT_MASK 0x1000000 /end MEASUREMENT
/begin MEASUREMENT dmtl_priv_state_1.bitfield.lv_cur_dmtl_ref_mes_max "Upper pump current threshold reached during reference measurement" ULONG _CNV_S_2_RANGE______2_CM 1 100. 0. 1. DISPLAY_IDENTIFIER LV_CUR_DMTL_REF_MES_MAX ECU_ADDRESS 0x3fcff8 BYTE_ORDER MSB_LAST BIT_MASK 0x800000 /end MEASUREMENT
/begin MEASUREMENT dmtl_priv_state_1.bitfield.lv_cur_dmtl_ref_mes_min "Lower pump current threshold reached during reference measurement" ULONG _CNV_S_2_RANGE______2_CM 1 100. 0. 1. DISPLAY_IDENTIFIER LV_CUR_DMTL_REF_MES_MIN ECU_ADDRESS 0x3fcff8 BYTE_ORDER MSB_LAST BIT_MASK 0x400000 /end MEASUREMENT
/begin MEASUREMENT dmtl_priv_state_1.bitfield.lv_cyc_rough_leak_susp "Cycle flag, rough leak suspected" ULONG _CNV_S_2_RANGE______2_CM 1 100. 0. 1. DISPLAY_IDENTIFIER LV_CYC_ROUGH_LEAK_SUSP ECU_ADDRESS 0x3fcff8 BYTE_ORDER MSB_LAST BIT_MASK 0x200000 /end MEASUREMENT
/begin MEASUREMENT dmtl_priv_state_1.bitfield.lv_dist_dmtl "Minimum distance after suspected rough leak or refueling" ULONG _CNV_S_2_RANGE______2_CM 1 100. 0. 1. DISPLAY_IDENTIFIER LV_DIST_DMTL ECU_ADDRESS 0x3fcff8 BYTE_ORDER MSB_LAST BIT_MASK 0x20000 /end MEASUREMENT
/begin MEASUREMENT dmtl_priv_state_1.bitfield.lv_dmtl_asa "Factory test active" ULONG _CNV_S_2_RANGE______2_CM 1 100. 0. 1. DISPLAY_IDENTIFIER LV_DMTL_ASA ECU_ADDRESS 0x3fcff8 BYTE_ORDER MSB_LAST BIT_MASK 0x10000 /end MEASUREMENT
/begin MEASUREMENT dmtl_priv_state_1.bitfield.lv_dmtl_eol "End of line test active" ULONG _CNV_S_2_RANGE______2_CM 1 100. 0. 1. DISPLAY_IDENTIFIER LV_DMTL_EOL ECU_ADDRESS 0x3fcff8 BYTE_ORDER MSB_LAST BIT_MASK 0x8000 /end MEASUREMENT
/begin MEASUREMENT dmtl_priv_state_1.bitfield.lv_dmtl_pump "controlbit of the DMTL pump powerstage" ULONG _CNV_S_2_RANGE______2_CM 1 100. 0. 1. DISPLAY_IDENTIFIER LV_DMTL_PUMP ECU_ADDRESS 0x3fcff8 BYTE_ORDER MSB_LAST BIT_MASK 0x1000 /end MEASUREMENT
/begin MEASUREMENT dmtl_priv_state_1.bitfield.lv_dmtl_pump_on "DMTL pump motor on" ULONG _CNV_S_2_RANGE______2_CM 1 100. 0. 1. DISPLAY_IDENTIFIER LV_DMTL_PUMP_ON ECU_ADDRESS 0x3fcff8 BYTE_ORDER MSB_LAST BIT_MASK 0x800 /end MEASUREMENT
/begin MEASUREMENT dmtl_priv_state_1.bitfield.lv_dmtl_rst_rough_leak "inhibit small leak diagnosis" ULONG _CNV_S_2_RANGE______2_CM 1 100. 0. 1. DISPLAY_IDENTIFIER LV_DMTL_RST_ROUGH_LEAK ECU_ADDRESS 0x3fcff8 BYTE_ORDER MSB_LAST BIT_MASK 0x400 /end MEASUREMENT
/begin MEASUREMENT dmtl_priv_state_1.bitfield.lv_dmtls "controlbit of the DMTL solenoid powerstage" ULONG _CNV_S_2_RANGE______2_CM 1 100. 0. 1. DISPLAY_IDENTIFIER LV_DMTLS ECU_ADDRESS 0x3fcff8 BYTE_ORDER MSB_LAST BIT_MASK 0x200 /end MEASUREMENT
/begin MEASUREMENT dmtl_priv_state_1.bitfield.lv_dmtls_on "DMTL valve on" ULONG _CNV_S_2_RANGE______2_CM 1 100. 0. 1. DISPLAY_IDENTIFIER LV_DMTLS_ON ECU_ADDRESS 0x3fcff8 BYTE_ORDER MSB_LAST BIT_MASK 0x100 /end MEASUREMENT
/begin MEASUREMENT dmtl_priv_state_1.bitfield.lv_dr_dmtl "Enabling the output stages of the DMTL module" ULONG _CNV_S_2_RANGE______2_CM 1 100. 0. 1. DISPLAY_IDENTIFIER LV_DR_DMTL ECU_ADDRESS 0x3fcff8 BYTE_ORDER MSB_LAST BIT_MASK 0x80 /end MEASUREMENT
/begin MEASUREMENT dmtl_priv_state_1.bitfield.lv_dr_dmtl_pump "DMTL pump activation" ULONG _CNV_S_2_RANGE______2_CM 1 100. 0. 1. DISPLAY_IDENTIFIER LV_DR_DMTL_PUMP ECU_ADDRESS 0x3fcff8 BYTE_ORDER MSB_LAST BIT_MASK 0x40 /end MEASUREMENT
/begin MEASUREMENT dmtl_priv_state_1.bitfield.lv_ena_fco_diag "Consumption diagnosis enable" ULONG _CNV_S_2_RANGE______2_CM 1 100. 0. 1. DISPLAY_IDENTIFIER LV_ENA_FCO_DIAG ECU_ADDRESS 0x3fcff8 BYTE_ORDER MSB_LAST BIT_MASK 0x20 /end MEASUREMENT
/begin MEASUREMENT dmtl_priv_state_1.bitfield.lv_ena_ftl_diag "Fuel level diagnosis enable" ULONG _CNV_S_2_RANGE______2_CM 1 100. 0. 1. DISPLAY_IDENTIFIER LV_ENA_FTL_DIAG ECU_ADDRESS 0x3fcff8 BYTE_ORDER MSB_LAST BIT_MASK 0x10 /end MEASUREMENT
/begin MEASUREMENT dmtl_priv_state_2.bitfield.lv_ena_fuc_rough_leak_mes "Enable rough leak measurement due to Check Filler Cap" ULONG _CNV_S_2_RANGE______2_CM 1 100. 0. 1. DISPLAY_IDENTIFIER LV_ENA_FUC_ROUGH_LEAK_MES ECU_ADDRESS 0x3fcffc BYTE_ORDER MSB_LAST BIT_MASK 0x80000000 /end MEASUREMENT
/begin MEASUREMENT dmtl_priv_state_2.bitfield.lv_ena_main_dmtl "DMTL main enabling" ULONG _CNV_S_2_RANGE______2_CM 1 100. 0. 1. DISPLAY_IDENTIFIER LV_ENA_MAIN_DMTL ECU_ADDRESS 0x3fcffc BYTE_ORDER MSB_LAST BIT_MASK 0x40000000 /end MEASUREMENT
/begin MEASUREMENT dmtl_priv_state_2.bitfield.lv_ena_main_dmtl_fuc "Main enabling DMTL Check Filler Cap" ULONG _CNV_S_2_RANGE______2_CM 1 100. 0. 1. DISPLAY_IDENTIFIER LV_ENA_MAIN_DMTL_FUC ECU_ADDRESS 0x3fcffc BYTE_ORDER MSB_LAST BIT_MASK 0x20000000 /end MEASUREMENT
/begin MEASUREMENT dmtl_priv_state_2.bitfield.lv_ena_rough_leak_1 "Auxiliary bit enable condition for rough leak check is present" ULONG _CNV_S_2_RANGE______2_CM 1 100. 0. 1. DISPLAY_IDENTIFIER LV_ENA_ROUGH_LEAK_1 ECU_ADDRESS 0x3fcffc BYTE_ORDER MSB_LAST BIT_MASK 0x10000000 /end MEASUREMENT
/begin MEASUREMENT dmtl_priv_state_2.bitfield.lv_ena_rough_leak_2 "Auxiliary bit enabling rough leak check through manual activation" ULONG _CNV_S_2_RANGE______2_CM 1 100. 0. 1. DISPLAY_IDENTIFIER LV_ENA_ROUGH_LEAK_2 ECU_ADDRESS 0x3fcffc BYTE_ORDER MSB_LAST BIT_MASK 0x8000000 /end MEASUREMENT
/begin MEASUREMENT dmtl_priv_state_2.bitfield.lv_ena_rough_leak_3 "Auxiliary bit interruption of rough leak check" ULONG _CNV_S_2_RANGE______2_CM 1 100. 0. 1. DISPLAY_IDENTIFIER LV_ENA_ROUGH_LEAK_3 ECU_ADDRESS 0x3fcffc BYTE_ORDER MSB_LAST BIT_MASK 0x4000000 /end MEASUREMENT
/begin MEASUREMENT dmtl_priv_state_2.bitfield.lv_ena_rough_leak_mes "Enabling rough leak measurement" ULONG _CNV_S_2_RANGE______2_CM 1 100. 0. 1. DISPLAY_IDENTIFIER LV_ENA_ROUGH_LEAK_MES ECU_ADDRESS 0x3fcffc BYTE_ORDER MSB_LAST BIT_MASK 0x800000 /end MEASUREMENT
/begin MEASUREMENT dmtl_priv_state_2.bitfield.lv_ena_rough_leak_mes_only "Enable only rough leak measurement" ULONG _CNV_S_2_RANGE______2_CM 1 100. 0. 1. DISPLAY_IDENTIFIER LV_ENA_ROUGH_LEAK_MES_ONLY ECU_ADDRESS 0x3fcffc BYTE_ORDER MSB_LAST BIT_MASK 0x400000 /end MEASUREMENT
/begin MEASUREMENT dmtl_priv_state_2.bitfield.lv_ena_small_leak_1 "Enable for miniature leak check via test unit intervention" ULONG _CNV_S_2_RANGE______2_CM 1 100. 0. 1. DISPLAY_IDENTIFIER LV_ENA_SMALL_LEAK_1 ECU_ADDRESS 0x3fcffc BYTE_ORDER MSB_LAST BIT_MASK 0x100000 /end MEASUREMENT
/begin MEASUREMENT dmtl_priv_state_2.bitfield.lv_ena_small_leak_mes_end "End of enable miniature leak measurement" ULONG _CNV_S_2_RANGE______2_CM 1 100. 0. 1. DISPLAY_IDENTIFIER LV_ENA_SMALL_LEAK_MES_END ECU_ADDRESS 0x3fcffc BYTE_ORDER MSB_LAST BIT_MASK 0x80000 /end MEASUREMENT
/begin MEASUREMENT dmtl_priv_state_2.bitfield.lv_err_det_small_leak_min "Error, minimum value detected, miniature leakage" ULONG _CNV_S_2_RANGE______2_CM 1 100. 0. 1. DISPLAY_IDENTIFIER LV_ERR_DET_SMALL_LEAK_MIN ECU_ADDRESS 0x3fcffc BYTE_ORDER MSB_LAST BIT_MASK 0x2000 /end MEASUREMENT
/begin MEASUREMENT dmtl_priv_state_2.bitfield.lv_fco_diag_max "Upper consumption diagnosis threshold" ULONG _CNV_S_2_RANGE______2_CM 1 100. 0. 1. DISPLAY_IDENTIFIER LV_FCO_DIAG_MAX ECU_ADDRESS 0x3fcffc BYTE_ORDER MSB_LAST BIT_MASK 0x1000 /end MEASUREMENT
/begin MEASUREMENT dmtl_priv_state_2.bitfield.lv_fco_diag_min "Lower consumption diagnosis threshold" ULONG _CNV_S_2_RANGE______2_CM 1 100. 0. 1. DISPLAY_IDENTIFIER LV_FCO_DIAG_MIN ECU_ADDRESS 0x3fcffc BYTE_ORDER MSB_LAST BIT_MASK 0x800 /end MEASUREMENT
/begin MEASUREMENT dmtl_priv_state_2.bitfield.lv_fco_h_ftl "Consumed fuel greater than tank level" ULONG _CNV_S_2_RANGE______2_CM 1 100. 0. 1. DISPLAY_IDENTIFIER LV_FCO_H_FTL ECU_ADDRESS 0x3fcffc BYTE_ORDER MSB_LAST BIT_MASK 0x400 /end MEASUREMENT
/begin MEASUREMENT dmtl_priv_state_2.bitfield.lv_ftl_dec "Tank volume has decreased" ULONG _CNV_S_2_RANGE______2_CM 1 100. 0. 1. DISPLAY_IDENTIFIER LV_FTL_DEC ECU_ADDRESS 0x3fcffc BYTE_ORDER MSB_LAST BIT_MASK 0x20 /end MEASUREMENT
/begin MEASUREMENT dmtl_priv_state_2.bitfield.lv_ftl_dec_igk_on "Tank filling volume has decreased in case of ignition key ON" ULONG _CNV_S_2_RANGE______2_CM 1 100. 0. 1. DISPLAY_IDENTIFIER LV_FTL_DEC_IGK_ON ECU_ADDRESS 0x3fcffc BYTE_ORDER MSB_LAST BIT_MASK 0x10 /end MEASUREMENT
/begin MEASUREMENT dmtl_priv_state_2.bitfield.lv_ftl_dmtl_max "max. tank level for DMTL function" ULONG _CNV_S_2_RANGE______2_CM 1 100. 0. 1. DISPLAY_IDENTIFIER LV_FTL_DMTL_MAX ECU_ADDRESS 0x3fcffc BYTE_ORDER MSB_LAST BIT_MASK 0x4 /end MEASUREMENT
/begin MEASUREMENT dmtl_priv_state_2.bitfield.lv_ftl_dmtl_min "min. tank level for DMTL function" ULONG _CNV_S_2_RANGE______2_CM 1 100. 0. 1. DISPLAY_IDENTIFIER LV_FTL_DMTL_MIN ECU_ADDRESS 0x3fcffc BYTE_ORDER MSB_LAST BIT_MASK 0x2 /end MEASUREMENT
/begin MEASUREMENT dmtl_priv_state_2.bitfield.lv_ftl_dmtl_val "validated tank level for DMTL function" ULONG _CNV_S_2_RANGE______2_CM 1 100. 0. 1. DISPLAY_IDENTIFIER LV_FTL_DMTL_VAL ECU_ADDRESS 0x3fcffc BYTE_ORDER MSB_LAST BIT_MASK 0x1 /end MEASUREMENT
/begin MEASUREMENT dmtl_priv_state_3.bitfield.lv_ftl_dyn "Level dynamics due to refueling" ULONG _CNV_S_2_RANGE______2_CM 1 100. 0. 1. DISPLAY_IDENTIFIER LV_FTL_DYN ECU_ADDRESS 0x3fd000 BYTE_ORDER MSB_LAST BIT_MASK 0x80000000 /end MEASUREMENT
/begin MEASUREMENT dmtl_priv_state_3.bitfield.lv_ftl_inc "Tank volume has increased" ULONG _CNV_S_2_RANGE______2_CM 1 100. 0. 1. DISPLAY_IDENTIFIER LV_FTL_INC ECU_ADDRESS 0x3fd000 BYTE_ORDER MSB_LAST BIT_MASK 0x40000000 /end MEASUREMENT
/begin MEASUREMENT dmtl_priv_state_3.bitfield.lv_ftl_inc_igk_on "Tank filling volume has increased in case of ignition key ON" ULONG _CNV_S_2_RANGE______2_CM 1 100. 0. 1. DISPLAY_IDENTIFIER LV_FTL_INC_IGK_ON ECU_ADDRESS 0x3fd000 BYTE_ORDER MSB_LAST BIT_MASK 0x20000000 /end MEASUREMENT
/begin MEASUREMENT dmtl_priv_state_3.bitfield.lv_no_purge_dr_dmtl "Pulse width modulation of canister-purge" ULONG _CNV_S_2_RANGE______2_CM 1 100. 0. 1. DISPLAY_IDENTIFIER LV_NO_PURGE_DR_DMTL ECU_ADDRESS 0x3fd000 BYTE_ORDER MSB_LAST BIT_MASK 0x1000000 /end MEASUREMENT
/begin MEASUREMENT dmtl_priv_state_3.bitfield.lv_no_purge_dmtl_rough_leak "request bit for no_purge" ULONG _CNV_S_2_RANGE______2_CM 1 100. 0. 1. DISPLAY_IDENTIFIER LV_NO_PURGE_DMTL_ROUGH_LEAK ECU_ADDRESS 0x3fd000 BYTE_ORDER MSB_LAST BIT_MASK 0x800000 /end MEASUREMENT
/begin MEASUREMENT dmtl_priv_state_3.bitfield.lv_no_purge_dmtl_small_leak "request bit for no_purge" ULONG _CNV_S_2_RANGE______2_CM 1 100. 0. 1. DISPLAY_IDENTIFIER LV_NO_PURGE_DMTL_SMALL_LEAK ECU_ADDRESS 0x3fd000 BYTE_ORDER MSB_LAST BIT_MASK 0x400000 /end MEASUREMENT
/begin MEASUREMENT dmtl_priv_state_4.bitfield.lv_ref_leak_rough_leak_susp "Condition, second reference measurement due to \"rough leak suspected\"" ULONG _CNV_S_2_RANGE______2_CM 1 100. 0. 1. DISPLAY_IDENTIFIER LV_REF_LEAK_ROUGH_LEAK_SUSP ECU_ADDRESS 0x3fd004 BYTE_ORDER MSB_LAST BIT_MASK 0x8000000 /end MEASUREMENT
/begin MEASUREMENT dmtl_priv_state_4.bitfield.lv_refu "Refueling" ULONG _CNV_S_2_RANGE______2_CM 1 100. 0. 1. DISPLAY_IDENTIFIER LV_REFU ECU_ADDRESS 0x3fd004 BYTE_ORDER MSB_LAST BIT_MASK 0x4000000 /end MEASUREMENT
/begin MEASUREMENT dmtl_priv_state_4.bitfield.lv_refu_1 "Refueling process, internal" ULONG _CNV_S_2_RANGE______2_CM 1 100. 0. 1. DISPLAY_IDENTIFIER LV_REFU_1 ECU_ADDRESS 0x3fd004 BYTE_ORDER MSB_LAST BIT_MASK 0x2000000 /end MEASUREMENT
/begin MEASUREMENT dmtl_priv_state_4.bitfield.lv_refu_end "Refueling finished" ULONG _CNV_S_2_RANGE______2_CM 1 100. 0. 1. DISPLAY_IDENTIFIER LV_REFU_END ECU_ADDRESS 0x3fd004 BYTE_ORDER MSB_LAST BIT_MASK 0x1000000 /end MEASUREMENT
/begin MEASUREMENT dmtl_priv_state_4.bitfield.lv_refu_rls_diag "Refueling diagnosis possible" ULONG _CNV_S_2_RANGE______2_CM 1 100. 0. 1. DISPLAY_IDENTIFIER LV_REFU_RLS_DIAG ECU_ADDRESS 0x3fd004 BYTE_ORDER MSB_LAST BIT_MASK 0x400000 /end MEASUREMENT
/begin MEASUREMENT dmtl_priv_state_4.bitfield.lv_refu_val "Refueling bit valid, internal" ULONG _CNV_S_2_RANGE______2_CM 1 100. 0. 1. DISPLAY_IDENTIFIER LV_REFU_VAL ECU_ADDRESS 0x3fd004 BYTE_ORDER MSB_LAST BIT_MASK 0x200000 /end MEASUREMENT
/begin MEASUREMENT dmtl_priv_state_4.bitfield.lv_refu_val_1 "Refueling bit valid, internal" ULONG _CNV_S_2_RANGE______2_CM 1 100. 0. 1. DISPLAY_IDENTIFIER LV_REFU_VAL_1 ECU_ADDRESS 0x3fd004 BYTE_ORDER MSB_LAST BIT_MASK 0x100000 /end MEASUREMENT
/begin MEASUREMENT dmtl_priv_state_4.bitfield.lv_req_ena_rough_leak "Request rough leak measurement" ULONG _CNV_S_2_RANGE______2_CM 1 100. 0. 1. DISPLAY_IDENTIFIER LV_REQ_ENA_ROUGH_LEAK ECU_ADDRESS 0x3fd004 BYTE_ORDER MSB_LAST BIT_MASK 0x80000 /end MEASUREMENT
/begin MEASUREMENT dmtl_priv_state_4.bitfield.lv_req_pwl_rough_leak "Request of STG off delay, rough leak diagnosis" ULONG _CNV_S_2_RANGE______2_CM 1 100. 0. 1. DISPLAY_IDENTIFIER LV_REQ_PWL_ROUGH_LEAK ECU_ADDRESS 0x3fd004 BYTE_ORDER MSB_LAST BIT_MASK 0x20000 /end MEASUREMENT
/begin MEASUREMENT dmtl_priv_state_4.bitfield.lv_req_pwl_small_leak "Request of STG off delay, miniature leak test" ULONG _CNV_S_2_RANGE______2_CM 1 100. 0. 1. DISPLAY_IDENTIFIER LV_REQ_PWL_SMALL_LEAK ECU_ADDRESS 0x3fd004 BYTE_ORDER MSB_LAST BIT_MASK 0x10000 /end MEASUREMENT
/begin MEASUREMENT dmtl_priv_state_4.bitfield.lv_req_rough_leak "Request rough leak measurement (low volatile fuel)" ULONG _CNV_S_2_RANGE______2_CM 1 100. 0. 1. DISPLAY_IDENTIFIER LV_REQ_ROUGH_LEAK ECU_ADDRESS 0x3fd004 BYTE_ORDER MSB_LAST BIT_MASK 0x8000 /end MEASUREMENT
/begin MEASUREMENT dmtl_priv_state_4.bitfield.lv_rough_leak_susp "Rough leak suspected" ULONG _CNV_S_2_RANGE______2_CM 1 100. 0. 1. DISPLAY_IDENTIFIER LV_ROUGH_LEAK_SUSP ECU_ADDRESS 0x3fd004 BYTE_ORDER MSB_LAST BIT_MASK 0x4000 /end MEASUREMENT
/begin MEASUREMENT dmtl_priv_state_4.bitfield.lv_small_leak_mes_len "Condition, extension miniature leak measurement" ULONG _CNV_S_2_RANGE______2_CM 1 100. 0. 1. DISPLAY_IDENTIFIER LV_SMALL_LEAK_MES_LEN ECU_ADDRESS 0x3fd004 BYTE_ORDER MSB_LAST BIT_MASK 0x10 /end MEASUREMENT
/begin MEASUREMENT dmtl_priv_state_4.bitfield.lv_t_dly_dmtl_pwl "Waiting time DMTL start finished" ULONG _CNV_S_2_RANGE______2_CM 1 100. 0. 1. DISPLAY_IDENTIFIER LV_T_DLY_DMTL_PWL ECU_ADDRESS 0x3fd004 BYTE_ORDER MSB_LAST BIT_MASK 0x8 /end MEASUREMENT
/begin MEASUREMENT dmtl_glob_state_1.bitfield.lv_ctr_cnl_small_leak_mes "Threshold of aborted miniature leak measurements due to current fluctuations exceeded" ULONG _CNV_S_2_RANGE______2_CM 1 100. 0. 1. DISPLAY_IDENTIFIER LV_CTR_CNL_SMALL_LEAK_MES ECU_ADDRESS 0x3fcfe4 BYTE_ORDER MSB_LAST BIT_MASK 0x80000000 /end MEASUREMENT
/begin MEASUREMENT dmtl_glob_state_1.bitfield.lv_cur_dmtl_ref_dif_max "Condition \"delta reference current\" exceeded" ULONG _CNV_S_2_RANGE______2_CM 1 100. 0. 1. DISPLAY_IDENTIFIER LV_CUR_DMTL_REF_DIF_MAX ECU_ADDRESS 0x3fcfe4 BYTE_ORDER MSB_LAST BIT_MASK 0x40000000 /end MEASUREMENT
/begin MEASUREMENT dmtl_glob_state_1.bitfield.lv_cur_dmtl_thd_dif_mes "Decreasing pump current during measurement" ULONG _CNV_S_2_RANGE______2_CM 1 100. 0. 1. DISPLAY_IDENTIFIER LV_CUR_DMTL_THD_DIF_MES ECU_ADDRESS 0x3fcfe4 BYTE_ORDER MSB_LAST BIT_MASK 0x20000000 /end MEASUREMENT
/begin MEASUREMENT dmtl_glob_state_1.bitfield.lv_det_fuc_open "Detection of fuel cap open" ULONG _CNV_S_2_RANGE______2_CM 1 100. 0. 1. DISPLAY_IDENTIFIER LV_DET_FUC_OPEN ECU_ADDRESS 0x3fcfe4 BYTE_ORDER MSB_LAST BIT_MASK 0x10000000 /end MEASUREMENT
/begin MEASUREMENT dmtl_glob_state_1.bitfield.lv_det_refu "Detection of refueling" ULONG _CNV_S_2_RANGE______2_CM 1 100. 0. 1. DISPLAY_IDENTIFIER LV_DET_REFU ECU_ADDRESS 0x3fcfe4 BYTE_ORDER MSB_LAST BIT_MASK 0x8000000 /end MEASUREMENT
/begin MEASUREMENT dmtl_glob_state_1.bitfield.lv_dist_det_rough_leak "Distance covered since rough leak detection" ULONG _CNV_S_2_RANGE______2_CM 1 100. 0. 1. DISPLAY_IDENTIFIER LV_DIST_DET_ROUGH_LEAK ECU_ADDRESS 0x3fcfe4 BYTE_ORDER MSB_LAST BIT_MASK 0x4000000 /end MEASUREMENT
/begin MEASUREMENT dmtl_glob_state_1.bitfield.lv_dmtl_act "DMTL state machine running" ULONG _CNV_S_2_RANGE______2_CM 1 100. 0. 1. DISPLAY_IDENTIFIER LV_DMTL_ACT ECU_ADDRESS 0x3fcfe4 BYTE_ORDER MSB_LAST BIT_MASK 0x2000000 /end MEASUREMENT
/begin MEASUREMENT dmtl_glob_state_1.bitfield.lv_dmtl_stop "Abnormal termination of DMTL function" ULONG _CNV_S_2_RANGE______2_CM 1 100. 0. 1. DISPLAY_IDENTIFIER LV_DMTL_STOP ECU_ADDRESS 0x3fcfe4 BYTE_ORDER MSB_LAST BIT_MASK 0x800000 /end MEASUREMENT
/begin MEASUREMENT dmtl_glob_state_1.bitfield.lv_ena_fuc "Request check filler cap" ULONG _CNV_S_2_RANGE______2_CM 1 100. 0. 1. DISPLAY_IDENTIFIER LV_ENA_FUC ECU_ADDRESS 0x3fcfe4 BYTE_ORDER MSB_LAST BIT_MASK 0x400000 /end MEASUREMENT
/begin MEASUREMENT dmtl_glob_state_1.bitfield.lv_ena_leak_dmtl "Enabling function request, coarse / miniature leakage measurement" ULONG _CNV_S_2_RANGE______2_CM 1 100. 0. 1. DISPLAY_IDENTIFIER LV_ENA_LEAK_DMTL ECU_ADDRESS 0x3fcfe4 BYTE_ORDER MSB_LAST BIT_MASK 0x200000 /end MEASUREMENT
/begin MEASUREMENT dmtl_glob_state_1.bitfield.lv_ena_osc_rough_leak_mes "Enable rough leak measurement after current fluctuations" ULONG _CNV_S_2_RANGE______2_CM 1 100. 0. 1. DISPLAY_IDENTIFIER LV_ENA_OSC_ROUGH_LEAK_MES ECU_ADDRESS 0x3fcfe4 BYTE_ORDER MSB_LAST BIT_MASK 0x100000 /end MEASUREMENT
/begin MEASUREMENT dmtl_glob_state_1.bitfield.lv_ena_small_leak_mes "Enable miniature leak measurement" ULONG _CNV_S_2_RANGE______2_CM 1 100. 0. 1. DISPLAY_IDENTIFIER LV_ENA_SMALL_LEAK_MES ECU_ADDRESS 0x3fcfe4 BYTE_ORDER MSB_LAST BIT_MASK 0x20000 /end MEASUREMENT
/begin MEASUREMENT dmtl_glob_state_1.bitfield.lv_ena_small_leak_refu "Enable miniature leak check after refueling" ULONG _CNV_S_2_RANGE______2_CM 1 100. 0. 1. DISPLAY_IDENTIFIER LV_ENA_SMALL_LEAK_REFU ECU_ADDRESS 0x3fcfe4 BYTE_ORDER MSB_LAST BIT_MASK 0x10000 /end MEASUREMENT
/begin MEASUREMENT dmtl_glob_state_1.bitfield.lv_err_det_dmtl_max "Error maximum value DMTL" ULONG _CNV_S_2_RANGE______2_CM 1 100. 0. 1. DISPLAY_IDENTIFIER LV_ERR_DET_DMTL_MAX ECU_ADDRESS 0x3fcfe4 BYTE_ORDER MSB_LAST BIT_MASK 0x8000 /end MEASUREMENT
/begin MEASUREMENT dmtl_glob_state_1.bitfield.lv_err_det_dmtl_min "Error, minimum value detected in DMTL module" ULONG _CNV_S_2_RANGE______2_CM 1 100. 0. 1. DISPLAY_IDENTIFIER LV_ERR_DET_DMTL_MIN ECU_ADDRESS 0x3fcfe4 BYTE_ORDER MSB_LAST BIT_MASK 0x4000 /end MEASUREMENT
/begin MEASUREMENT dmtl_glob_state_1.bitfield.lv_err_det_rough_leak_min "Rough leak error" ULONG _CNV_S_2_RANGE______2_CM 1 100. 0. 1. DISPLAY_IDENTIFIER LV_ERR_DET_ROUGH_LEAK_MIN ECU_ADDRESS 0x3fcfe4 BYTE_ORDER MSB_LAST BIT_MASK 0x2000 /end MEASUREMENT
/begin MEASUREMENT dmtl_glob_state_1.bitfield.lv_err_ftl "Tank level error" ULONG _CNV_S_2_RANGE______2_CM 1 100. 0. 1. DISPLAY_IDENTIFIER LV_ERR_FTL ECU_ADDRESS 0x3fcfe4 BYTE_ORDER MSB_LAST BIT_MASK 0x1000 /end MEASUREMENT
/begin MEASUREMENT dmtl_glob_state_1.bitfield.lv_err_ftl_plaus "Tank level plausibility error" ULONG _CNV_S_2_RANGE______2_CM 1 100. 0. 1. DISPLAY_IDENTIFIER LV_ERR_FTL_PLAUS ECU_ADDRESS 0x3fcfe4 BYTE_ORDER MSB_LAST BIT_MASK 0x800 /end MEASUREMENT
/begin MEASUREMENT dmtl_glob_state_1.bitfield.lv_err_sig_dmtl "Error signal DMTL" ULONG _CNV_S_2_RANGE______2_CM 1 100. 0. 1. DISPLAY_IDENTIFIER LV_ERR_SIG_DMTL ECU_ADDRESS 0x3fcfe4 BYTE_ORDER MSB_LAST BIT_MASK 0x200 /end MEASUREMENT
/begin MEASUREMENT dmtl_glob_state_1.bitfield.lv_err_small_leak "Error miniature leak" ULONG _CNV_S_2_RANGE______2_CM 1 100. 0. 1. DISPLAY_IDENTIFIER LV_ERR_SMALL_LEAK ECU_ADDRESS 0x3fcfe4 BYTE_ORDER MSB_LAST BIT_MASK 0x100 /end MEASUREMENT
/begin MEASUREMENT dmtl_glob_state_1.bitfield.lv_ftl_diag "Level sensor diagnosis" ULONG _CNV_S_2_RANGE______2_CM 1 100. 0. 1. DISPLAY_IDENTIFIER LV_FTL_DIAG ECU_ADDRESS 0x3fcfe4 BYTE_ORDER MSB_LAST BIT_MASK 0x80 /end MEASUREMENT
/begin MEASUREMENT dmtl_glob_state_1.bitfield.lv_fuc_can "Tank cap open - display" ULONG _CNV_S_2_RANGE______2_CM 1 100. 0. 1. DISPLAY_IDENTIFIER LV_FUC_CAN ECU_ADDRESS 0x3fcfe4 BYTE_ORDER MSB_LAST BIT_MASK 0x40 /end MEASUREMENT
/begin MEASUREMENT dmtl_glob_state_1.bitfield.lv_fuc_open "Filler cap open" ULONG _CNV_S_2_RANGE______2_CM 1 100. 0. 1. DISPLAY_IDENTIFIER LV_FUC_OPEN ECU_ADDRESS 0x3fcfe4 BYTE_ORDER MSB_LAST BIT_MASK 0x20 /end MEASUREMENT
/begin MEASUREMENT dmtl_glob_state_1.bitfield.lv_no_purge_dmtl "request for no_purge of the evap.-system" ULONG _CNV_S_2_RANGE______2_CM 1 100. 0. 1. DISPLAY_IDENTIFIER LV_NO_PURGE_DMTL ECU_ADDRESS 0x3fcfe4 BYTE_ORDER MSB_LAST BIT_MASK 0x10 /end MEASUREMENT
/begin MEASUREMENT dmtl_glob_state_1.bitfield.lv_refu_dmtl "Condition refueling" ULONG _CNV_S_2_RANGE______2_CM 1 100. 0. 1. DISPLAY_IDENTIFIER LV_REFU_DMTL ECU_ADDRESS 0x3fcfe4 BYTE_ORDER MSB_LAST BIT_MASK 0x4 /end MEASUREMENT
/begin MEASUREMENT dmtl_glob_state_2.bitfield.lv_req_pwl_dmtl "Request of STG off delay, tank leakage diagnosis" ULONG _CNV_S_2_RANGE______2_CM 1 100. 0. 1. DISPLAY_IDENTIFIER LV_REQ_PWL_DMTL ECU_ADDRESS 0x3fcfe8 BYTE_ORDER MSB_LAST BIT_MASK 0x80000000 /end MEASUREMENT
/begin MEASUREMENT dmtl_glob_state_2.bitfield.lv_rough_leak_susp_set "Rough leak suspicion with cycle bit rough leak suspicion present" ULONG _CNV_S_2_RANGE______2_CM 1 100. 0. 1. DISPLAY_IDENTIFIER LV_ROUGH_LEAK_SUSP_SET ECU_ADDRESS 0x3fcfe8 BYTE_ORDER MSB_LAST BIT_MASK 0x20000000 /end MEASUREMENT
/begin MEASUREMENT dmtl_glob_state_2.bitfield.lv_rst_small_leak_mes_refu "reset miniature leck after refueling" ULONG _CNV_S_2_RANGE______2_CM 1 100. 0. 1. DISPLAY_IDENTIFIER LV_RST_SMALL_LEAK_MES_REFU ECU_ADDRESS 0x3fcfe8 BYTE_ORDER MSB_LAST BIT_MASK 0x10000000 /end MEASUREMENT
/begin MEASUREMENT dmtl_glob_state_2.bitfield.lv_sdr_dmtl "Error plausibility DMTL" ULONG _CNV_S_2_RANGE______2_CM 1 100. 0. 1. DISPLAY_IDENTIFIER LV_SDR_DMTL ECU_ADDRESS 0x3fcfe8 BYTE_ORDER MSB_LAST BIT_MASK 0x8000000 /end MEASUREMENT
/begin MEASUREMENT dmtl_glob_state_2.bitfield.lv_t_dmtl_max "max. time for DMTL" ULONG _CNV_S_2_RANGE______2_CM 1 100. 0. 1. DISPLAY_IDENTIFIER LV_T_DMTL_MAX ECU_ADDRESS 0x3fcfe8 BYTE_ORDER MSB_LAST BIT_MASK 0x4000000 /end MEASUREMENT
/begin MEASUREMENT dmtl_glob_state_2.bitfield.lv_vb_dif_max "high battery voltage deviation" ULONG _CNV_S_2_RANGE______2_CM 1 100. 0. 1. DISPLAY_IDENTIFIER LV_VB_DIF_MAX ECU_ADDRESS 0x3fcfe8 BYTE_ORDER MSB_LAST BIT_MASK 0x1000000 /end MEASUREMENT
/begin MEASUREMENT dmtl_glob_state_2.bitfield.lv_hdmtl_on "heater DMTL" ULONG _CNV_S_2_RANGE______2_CM 1 100. 0. 1. DISPLAY_IDENTIFIER LV_HDMTL_ON ECU_ADDRESS 0x3fcfe8 BYTE_ORDER MSB_LAST BIT_MASK 0x800000 /end MEASUREMENT
/begin MEASUREMENT dmtl_glob_state_2.bitfield.lv_dr_dmtls "DMTL solenoid valve activation" ULONG _CNV_S_2_RANGE______2_CM 1 100. 0. 1. DISPLAY_IDENTIFIER LV_DR_DMTLS ECU_ADDRESS 0x3fcfe8 BYTE_ORDER MSB_LAST BIT_MASK 0x400000 /end MEASUREMENT
/begin MEASUREMENT dmtl_glob_state_2.bitfield.lv_vb_range_dmtl "DMTL does not start because battery is out of band width" ULONG _CNV_S_2_RANGE______2_CM 1 100. 0. 1. DISPLAY_IDENTIFIER LV_VB_RANGE_DMTL ECU_ADDRESS 0x3fcfe8 BYTE_ORDER MSB_LAST BIT_MASK 0x20000 /end MEASUREMENT
/begin MEASUREMENT dmtl_glob_state_2.bitfield.lv_cyc_rough_leak_mode6 "Cycle flag, rough leak error" ULONG _CNV_S_2_RANGE______2_CM 1 100. 0. 1. DISPLAY_IDENTIFIER LV_CYC_ROUGH_LEAK_MODE6 ECU_ADDRESS 0x3fcfe8 BYTE_ORDER MSB_LAST BIT_MASK 0x200000 /end MEASUREMENT
/begin MEASUREMENT dmtl_glob_state_2.bitfield.lv_rough_leak_mes_len "Condition, extension rough leak measurement" ULONG _CNV_S_2_RANGE______2_CM 1 100. 0. 1. DISPLAY_IDENTIFIER LV_ROUGH_LEAK_MES_LEN ECU_ADDRESS 0x3fcfe8 BYTE_ORDER MSB_LAST BIT_MASK 0x100000 /end MEASUREMENT
/begin MEASUREMENT dmtl_glob_state_2.bitfield.lv_cyc_small_leak_mode6 "Cycle flag, miniature leak" ULONG _CNV_S_2_RANGE______2_CM 1 100. 0. 1. DISPLAY_IDENTIFIER LV_CYC_SMALL_LEAK_MODE6 ECU_ADDRESS 0x3fcfe8 BYTE_ORDER MSB_LAST BIT_MASK 0x80000 /end MEASUREMENT
/begin MEASUREMENT cur_dmtl_small_leak_end "Pump current at the end of the miniature leak measurement" UWORD _CNV_A_R_LINEAR_____168_CM 1 100. 0. 400. DISPLAY_IDENTIFIER CUR_DMTL_SMALL_LEAK_END ECU_ADDRESS 0x3fdb4e BYTE_ORDER MSB_LAST FORMAT "%7.3" /end MEASUREMENT
/begin MEASUREMENT cur_dmtl_ref_dif_max "???" UWORD _CNV_A_R_LINEAR_____168_CM 1 100. 0. 400. DISPLAY_IDENTIFIER CUR_DMTL_REF_DIF_MAX ECU_ADDRESS 0x3fdb48 BYTE_ORDER MSB_LAST FORMAT "%7.3" /end MEASUREMENT
/begin CHARACTERISTIC c_t_dly_stop_refu "Delay time stop before refueling" VALUE 0xffe41934 _REC_VAL_20_u2 65535. _CNV_A_R_LINEAR_____30_CM 0. 65535. DISPLAY_IDENTIFIER C_T_DLY_STOP_REFU FORMAT "%5.0" /end CHARACTERISTIC
/begin CHARACTERISTIC c_t_ena_dr_dmtl_max "max. time for function request DMTL output stages" VALUE 0xffe4194a _REC_VAL_20_u2 6553.5 _CNV_A_R_LINEAR_____24_CM 0. 6553.5 DISPLAY_IDENTIFIER C_T_ENA_DR_DMTL_MAX FORMAT "%6.1" /end CHARACTERISTIC
/begin MEASUREMENT lv_err_dmtl_leak "logical variable for DMTL LEAK error" UBYTE _CNV_S_2_RANGE______1_R_CM 1 100. 0. 255. DISPLAY_IDENTIFIER LV_ERR_DMTL_LEAK ECU_ADDRESS 0x3fba70 /end MEASUREMENT
/begin CHARACTERISTIC fmy_id_toil.envd "" CURVE 0xffe41d52 _REC_CUR_20_u1_u1 255. _CNV_A_R_LINEAR_____0_CM 0. 255. DISPLAY_IDENTIFIER ID_ERR_ENVD_TOIL FORMAT "%3.0"
 /begin AXIS_DESCR COM_AXIS online_dummy _CNV_A_R_LINEAR_____22_CM 4 0. 3. FORMAT "%2.0" AXIS_PTS_REF ldp_fmy_envd /end AXIS_DESCR
/end CHARACTERISTIC
/begin CHARACTERISTIC fmy_id_tco_ex.envd "" CURVE 0xffe41d64 _REC_CUR_20_u1_u1 255. _CNV_A_R_LINEAR_____0_CM 0. 255. DISPLAY_IDENTIFIER ID_ERR_ENVD_TCO_EX FORMAT "%3.0"
 /begin AXIS_DESCR COM_AXIS online_dummy _CNV_A_R_LINEAR_____22_CM 4 0. 3. FORMAT "%2.0" AXIS_PTS_REF ldp_fmy_envd /end AXIS_DESCR
/end CHARACTERISTIC
/begin CHARACTERISTIC fmy_id_tia.envd "" CURVE 0xffe41d76 _REC_CUR_20_u1_u1 255. _CNV_A_R_LINEAR_____0_CM 0. 255. DISPLAY_IDENTIFIER ID_ERR_ENVD_TIA FORMAT "%3.0"
 /begin AXIS_DESCR COM_AXIS online_dummy _CNV_A_R_LINEAR_____22_CM 4 0. 3. FORMAT "%2.0" AXIS_PTS_REF ldp_fmy_envd /end AXIS_DESCR
/end CHARACTERISTIC
/begin CHARACTERISTIC fmy_id_amp.envd "" CURVE 0xffe41d88 _REC_CUR_20_u1_u1 255. _CNV_A_R_LINEAR_____0_CM 0. 255. DISPLAY_IDENTIFIER ID_ERR_ENVD_AMP FORMAT "%3.0"
 /begin AXIS_DESCR COM_AXIS online_dummy _CNV_A_R_LINEAR_____22_CM 4 0. 3. FORMAT "%2.0" AXIS_PTS_REF ldp_fmy_envd /end AXIS_DESCR
/end CHARACTERISTIC
/begin CHARACTERISTIC fmy_id_maf.envd "" CURVE 0xffe41d9a _REC_CUR_20_u1_u1 255. _CNV_A_R_LINEAR_____0_CM 0. 255. DISPLAY_IDENTIFIER ID_ERR_ENVD_MAF FORMAT "%3.0"
 /begin AXIS_DESCR COM_AXIS online_dummy _CNV_A_R_LINEAR_____22_CM 4 0. 3. FORMAT "%2.0" AXIS_PTS_REF ldp_fmy_envd /end AXIS_DESCR
/end CHARACTERISTIC
/begin CHARACTERISTIC fmy_id_vls_down_max_1.envd "" CURVE 0xffe41dac _REC_CUR_20_u1_u1 255. _CNV_A_R_LINEAR_____0_CM 0. 255. DISPLAY_IDENTIFIER ID_ERR_ENVD_VLS_DOWN_MAX_1 FORMAT "%3.0"
 /begin AXIS_DESCR COM_AXIS online_dummy _CNV_A_R_LINEAR_____22_CM 4 0. 3. FORMAT "%2.0" AXIS_PTS_REF ldp_fmy_envd /end AXIS_DESCR
/end CHARACTERISTIC
/begin CHARACTERISTIC fmy_id_vls_down_max_2.envd "" CURVE 0xffe41dbe _REC_CUR_20_u1_u1 255. _CNV_A_R_LINEAR_____0_CM 0. 255. DISPLAY_IDENTIFIER ID_ERR_ENVD_VLS_DOWN_MAX_2 FORMAT "%3.0"
 /begin AXIS_DESCR COM_AXIS online_dummy _CNV_A_R_LINEAR_____22_CM 4 0. 3. FORMAT "%2.0" AXIS_PTS_REF ldp_fmy_envd /end AXIS_DESCR
/end CHARACTERISTIC
/begin CHARACTERISTIC fmy_id_vls_down_min_cold_1.envd "" CURVE 0xffe41dd0 _REC_CUR_20_u1_u1 255. _CNV_A_R_LINEAR_____0_CM 0. 255. DISPLAY_IDENTIFIER ID_ERR_ENVD_VLS_DOWN_MIN_COLD_1 FORMAT "%3.0"
 /begin AXIS_DESCR COM_AXIS online_dummy _CNV_A_R_LINEAR_____22_CM 4 0. 3. FORMAT "%2.0" AXIS_PTS_REF ldp_fmy_envd /end AXIS_DESCR
/end CHARACTERISTIC
/begin CHARACTERISTIC fmy_id_vls_down_min_cold_2.envd "" CURVE 0xffe41de2 _REC_CUR_20_u1_u1 255. _CNV_A_R_LINEAR_____0_CM 0. 255. DISPLAY_IDENTIFIER ID_ERR_ENVD_VLS_DOWN_MIN_COLD_2 FORMAT "%3.0"
 /begin AXIS_DESCR COM_AXIS online_dummy _CNV_A_R_LINEAR_____22_CM 4 0. 3. FORMAT "%2.0" AXIS_PTS_REF ldp_fmy_envd /end AXIS_DESCR
/end CHARACTERISTIC
/begin CHARACTERISTIC fmy_id_vls_down_min_1.envd "" CURVE 0xffe41df4 _REC_CUR_20_u1_u1 255. _CNV_A_R_LINEAR_____0_CM 0. 255. DISPLAY_IDENTIFIER ID_ERR_ENVD_VLS_DOWN_MIN_1 FORMAT "%3.0"
 /begin AXIS_DESCR COM_AXIS online_dummy _CNV_A_R_LINEAR_____22_CM 4 0. 3. FORMAT "%2.0" AXIS_PTS_REF ldp_fmy_envd /end AXIS_DESCR
/end CHARACTERISTIC
/begin CHARACTERISTIC fmy_id_vls_down_min_2.envd "" CURVE 0xffe41e06 _REC_CUR_20_u1_u1 255. _CNV_A_R_LINEAR_____0_CM 0. 255. DISPLAY_IDENTIFIER ID_ERR_ENVD_VLS_DOWN_MIN_2 FORMAT "%3.0"
 /begin AXIS_DESCR COM_AXIS online_dummy _CNV_A_R_LINEAR_____22_CM 4 0. 3. FORMAT "%2.0" AXIS_PTS_REF ldp_fmy_envd /end AXIS_DESCR
/end CHARACTERISTIC
/begin CHARACTERISTIC fmy_id_vls_down_oc_1.envd "" CURVE 0xffe41e18 _REC_CUR_20_u1_u1 255. _CNV_A_R_LINEAR_____0_CM 0. 255. DISPLAY_IDENTIFIER ID_ERR_ENVD_VLS_DOWN_OC_1 FORMAT "%3.0"
 /begin AXIS_DESCR COM_AXIS online_dummy _CNV_A_R_LINEAR_____22_CM 4 0. 3. FORMAT "%2.0" AXIS_PTS_REF ldp_fmy_envd /end AXIS_DESCR
/end CHARACTERISTIC
/begin CHARACTERISTIC fmy_id_vls_down_oc_2.envd "" CURVE 0xffe41e2a _REC_CUR_20_u1_u1 255. _CNV_A_R_LINEAR_____0_CM 0. 255. DISPLAY_IDENTIFIER ID_ERR_ENVD_VLS_DOWN_OC_2 FORMAT "%3.0"
 /begin AXIS_DESCR COM_AXIS online_dummy _CNV_A_R_LINEAR_____22_CM 4 0. 3. FORMAT "%2.0" AXIS_PTS_REF ldp_fmy_envd /end AXIS_DESCR
/end CHARACTERISTIC
/begin CHARACTERISTIC fmy_id_iv_0.envd "" CURVE 0xffe41e3c _REC_CUR_20_u1_u1 255. _CNV_A_R_LINEAR_____0_CM 0. 255. DISPLAY_IDENTIFIER ID_ERR_ENVD_IV_0 FORMAT "%3.0"
 /begin AXIS_DESCR COM_AXIS online_dummy _CNV_A_R_LINEAR_____22_CM 4 0. 3. FORMAT "%2.0" AXIS_PTS_REF ldp_fmy_envd /end AXIS_DESCR
/end CHARACTERISTIC
/begin CHARACTERISTIC fmy_id_iv_1.envd "" CURVE 0xffe41e4e _REC_CUR_20_u1_u1 255. _CNV_A_R_LINEAR_____0_CM 0. 255. DISPLAY_IDENTIFIER ID_ERR_ENVD_IV_1 FORMAT "%3.0"
 /begin AXIS_DESCR COM_AXIS online_dummy _CNV_A_R_LINEAR_____22_CM 4 0. 3. FORMAT "%2.0" AXIS_PTS_REF ldp_fmy_envd /end AXIS_DESCR
/end CHARACTERISTIC
/begin CHARACTERISTIC fmy_id_iv_2.envd "" CURVE 0xffe41e60 _REC_CUR_20_u1_u1 255. _CNV_A_R_LINEAR_____0_CM 0. 255. DISPLAY_IDENTIFIER ID_ERR_ENVD_IV_2 FORMAT "%3.0"
 /begin AXIS_DESCR COM_AXIS online_dummy _CNV_A_R_LINEAR_____22_CM 4 0. 3. FORMAT "%2.0" AXIS_PTS_REF ldp_fmy_envd /end AXIS_DESCR
/end CHARACTERISTIC
/begin CHARACTERISTIC fmy_id_iv_3.envd "" CURVE 0xffe41e72 _REC_CUR_20_u1_u1 255. _CNV_A_R_LINEAR_____0_CM 0. 255. DISPLAY_IDENTIFIER ID_ERR_ENVD_IV_3 FORMAT "%3.0"
 /begin AXIS_DESCR COM_AXIS online_dummy _CNV_A_R_LINEAR_____22_CM 4 0. 3. FORMAT "%2.0" AXIS_PTS_REF ldp_fmy_envd /end AXIS_DESCR
/end CHARACTERISTIC
/begin CHARACTERISTIC fmy_id_iv_4.envd "" CURVE 0xffe41e84 _REC_CUR_20_u1_u1 255. _CNV_A_R_LINEAR_____0_CM 0. 255. DISPLAY_IDENTIFIER ID_ERR_ENVD_IV_4 FORMAT "%3.0"
 /begin AXIS_DESCR COM_AXIS online_dummy _CNV_A_R_LINEAR_____22_CM 4 0. 3. FORMAT "%2.0" AXIS_PTS_REF ldp_fmy_envd /end AXIS_DESCR
/end CHARACTERISTIC
/begin CHARACTERISTIC fmy_id_iv_5.envd "" CURVE 0xffe41e96 _REC_CUR_20_u1_u1 255. _CNV_A_R_LINEAR_____0_CM 0. 255. DISPLAY_IDENTIFIER ID_ERR_ENVD_IV_5 FORMAT "%3.0"
 /begin AXIS_DESCR COM_AXIS online_dummy _CNV_A_R_LINEAR_____22_CM 4 0. 3. FORMAT "%2.0" AXIS_PTS_REF ldp_fmy_envd /end AXIS_DESCR
/end CHARACTERISTIC
/begin CHARACTERISTIC fmy_id_lsh_up_1.envd "" CURVE 0xffe41ea8 _REC_CUR_20_u1_u1 255. _CNV_A_R_LINEAR_____0_CM 0. 255. DISPLAY_IDENTIFIER ID_ERR_ENVD_LSH_UP_1 FORMAT "%3.0"
 /begin AXIS_DESCR COM_AXIS online_dummy _CNV_A_R_LINEAR_____22_CM 4 0. 3. FORMAT "%2.0" AXIS_PTS_REF ldp_fmy_envd /end AXIS_DESCR
/end CHARACTERISTIC
/begin CHARACTERISTIC fmy_id_lsh_up_2.envd "" CURVE 0xffe41eba _REC_CUR_20_u1_u1 255. _CNV_A_R_LINEAR_____0_CM 0. 255. DISPLAY_IDENTIFIER ID_ERR_ENVD_LSH_UP_2 FORMAT "%3.0"
 /begin AXIS_DESCR COM_AXIS online_dummy _CNV_A_R_LINEAR_____22_CM 4 0. 3. FORMAT "%2.0" AXIS_PTS_REF ldp_fmy_envd /end AXIS_DESCR
/end CHARACTERISTIC
/begin CHARACTERISTIC fmy_id_lsh_down_1.envd "" CURVE 0xffe41ecc _REC_CUR_20_u1_u1 255. _CNV_A_R_LINEAR_____0_CM 0. 255. DISPLAY_IDENTIFIER ID_ERR_ENVD_LSH_DOWN_1 FORMAT "%3.0"
 /begin AXIS_DESCR COM_AXIS online_dummy _CNV_A_R_LINEAR_____22_CM 4 0. 3. FORMAT "%2.0" AXIS_PTS_REF ldp_fmy_envd /end AXIS_DESCR
/end CHARACTERISTIC
/begin CHARACTERISTIC fmy_id_lsh_down_2.envd "" CURVE 0xffe41ede _REC_CUR_20_u1_u1 255. _CNV_A_R_LINEAR_____0_CM 0. 255. DISPLAY_IDENTIFIER ID_ERR_ENVD_LSH_DOWN_2 FORMAT "%3.0"
 /begin AXIS_DESCR COM_AXIS online_dummy _CNV_A_R_LINEAR_____22_CM 4 0. 3. FORMAT "%2.0" AXIS_PTS_REF ldp_fmy_envd /end AXIS_DESCR
/end CHARACTERISTIC
/begin CHARACTERISTIC fmy_id_rly_efp.envd "" CURVE 0xffe41ef0 _REC_CUR_20_u1_u1 255. _CNV_A_R_LINEAR_____0_CM 0. 255. DISPLAY_IDENTIFIER ID_ERR_ENVD_RLY_EFP FORMAT "%3.0"
 /begin AXIS_DESCR COM_AXIS online_dummy _CNV_A_R_LINEAR_____22_CM 4 0. 3. FORMAT "%2.0" AXIS_PTS_REF ldp_fmy_envd /end AXIS_DESCR
/end CHARACTERISTIC
/begin CHARACTERISTIC fmy_id_cps.envd "" CURVE 0xffe41f02 _REC_CUR_20_u1_u1 255. _CNV_A_R_LINEAR_____0_CM 0. 255. DISPLAY_IDENTIFIER ID_ERR_ENVD_CPS FORMAT "%3.0"
 /begin AXIS_DESCR COM_AXIS online_dummy _CNV_A_R_LINEAR_____22_CM 4 0. 3. FORMAT "%2.0" AXIS_PTS_REF ldp_fmy_envd /end AXIS_DESCR
/end CHARACTERISTIC
/begin CHARACTERISTIC fmy_id_mec_ivvt_in_1.envd "" CURVE 0xffe41f14 _REC_CUR_20_u1_u1 255. _CNV_A_R_LINEAR_____0_CM 0. 255. DISPLAY_IDENTIFIER ID_ERR_ENVD_MEC_IVVT_IN_1 FORMAT "%3.0"
 /begin AXIS_DESCR COM_AXIS online_dummy _CNV_A_R_LINEAR_____22_CM 4 0. 3. FORMAT "%2.0" AXIS_PTS_REF ldp_fmy_envd /end AXIS_DESCR
/end CHARACTERISTIC
/begin CHARACTERISTIC fmy_id_mec_ivvt_ex_1.envd "" CURVE 0xffe41f26 _REC_CUR_20_u1_u1 255. _CNV_A_R_LINEAR_____0_CM 0. 255. DISPLAY_IDENTIFIER ID_ERR_ENVD_MEC_IVVT_EX_1 FORMAT "%3.0"
 /begin AXIS_DESCR COM_AXIS online_dummy _CNV_A_R_LINEAR_____22_CM 4 0. 3. FORMAT "%2.0" AXIS_PTS_REF ldp_fmy_envd /end AXIS_DESCR
/end CHARACTERISTIC
/begin CHARACTERISTIC fmy_id_ref_ivvt_in_1.envd "" CURVE 0xffe41f38 _REC_CUR_20_u1_u1 255. _CNV_A_R_LINEAR_____0_CM 0. 255. DISPLAY_IDENTIFIER ID_ERR_ENVD_REF_IVVT_IN_1 FORMAT "%3.0"
 /begin AXIS_DESCR COM_AXIS online_dummy _CNV_A_R_LINEAR_____22_CM 4 0. 3. FORMAT "%2.0" AXIS_PTS_REF ldp_fmy_envd /end AXIS_DESCR
/end CHARACTERISTIC
/begin CHARACTERISTIC fmy_id_ref_ivvt_ex_1.envd "" CURVE 0xffe41f4a _REC_CUR_20_u1_u1 255. _CNV_A_R_LINEAR_____0_CM 0. 255. DISPLAY_IDENTIFIER ID_ERR_ENVD_REF_IVVT_EX_1 FORMAT "%3.0"
 /begin AXIS_DESCR COM_AXIS online_dummy _CNV_A_R_LINEAR_____22_CM 4 0. 3. FORMAT "%2.0" AXIS_PTS_REF ldp_fmy_envd /end AXIS_DESCR
/end CHARACTERISTIC
/begin CHARACTERISTIC fmy_id_slv_ivvt_in_1.envd "" CURVE 0xffe41f5c _REC_CUR_20_u1_u1 255. _CNV_A_R_LINEAR_____0_CM 0. 255. DISPLAY_IDENTIFIER ID_ERR_ENVD_SLV_IVVT_IN_1 FORMAT "%3.0"
 /begin AXIS_DESCR COM_AXIS online_dummy _CNV_A_R_LINEAR_____22_CM 4 0. 3. FORMAT "%2.0" AXIS_PTS_REF ldp_fmy_envd /end AXIS_DESCR
/end CHARACTERISTIC
/begin CHARACTERISTIC fmy_id_slv_ivvt_ex_1.envd "" CURVE 0xffe41f6e _REC_CUR_20_u1_u1 255. _CNV_A_R_LINEAR_____0_CM 0. 255. DISPLAY_IDENTIFIER ID_ERR_ENVD_SLV_IVVT_EX_1 FORMAT "%3.0"
 /begin AXIS_DESCR COM_AXIS online_dummy _CNV_A_R_LINEAR_____22_CM 4 0. 3. FORMAT "%2.0" AXIS_PTS_REF ldp_fmy_envd /end AXIS_DESCR
/end CHARACTERISTIC
/begin CHARACTERISTIC fmy_id_park_ivvt_in_1.envd "" CURVE 0xffe41f80 _REC_CUR_20_u1_u1 255. _CNV_A_R_LINEAR_____0_CM 0. 255. DISPLAY_IDENTIFIER ID_ERR_ENVD_PARK_IVVT_IN_1 FORMAT "%3.0"
 /begin AXIS_DESCR COM_AXIS online_dummy _CNV_A_R_LINEAR_____22_CM 4 0. 3. FORMAT "%2.0" AXIS_PTS_REF ldp_fmy_envd /end AXIS_DESCR
/end CHARACTERISTIC
/begin CHARACTERISTIC fmy_id_park_ivvt_ex_1.envd "" CURVE 0xffe41f92 _REC_CUR_20_u1_u1 255. _CNV_A_R_LINEAR_____0_CM 0. 255. DISPLAY_IDENTIFIER ID_ERR_ENVD_PARK_IVVT_EX_1 FORMAT "%3.0"
 /begin AXIS_DESCR COM_AXIS online_dummy _CNV_A_R_LINEAR_____22_CM 4 0. 3. FORMAT "%2.0" AXIS_PTS_REF ldp_fmy_envd /end AXIS_DESCR
/end CHARACTERISTIC
/begin CHARACTERISTIC fmy_id_ecu_cks.envd "" CURVE 0xffe41fa4 _REC_CUR_20_u1_u1 255. _CNV_A_R_LINEAR_____0_CM 0. 255. DISPLAY_IDENTIFIER ID_ERR_ENVD_ECU_CKS FORMAT "%3.0"
 /begin AXIS_DESCR COM_AXIS online_dummy _CNV_A_R_LINEAR_____22_CM 4 0. 3. FORMAT "%2.0" AXIS_PTS_REF ldp_fmy_envd /end AXIS_DESCR
/end CHARACTERISTIC
/begin CHARACTERISTIC fmy_id_toil_level.envd "" CURVE 0xffe41fb6 _REC_CUR_20_u1_u1 255. _CNV_A_R_LINEAR_____0_CM 0. 255. DISPLAY_IDENTIFIER ID_ERR_ENVD_TOIL_LEVEL FORMAT "%3.0"
 /begin AXIS_DESCR COM_AXIS online_dummy _CNV_A_R_LINEAR_____22_CM 4 0. 3. FORMAT "%2.0" AXIS_PTS_REF ldp_fmy_envd /end AXIS_DESCR
/end CHARACTERISTIC
/begin CHARACTERISTIC fmy_id_tout_etcu_1.envd "" CURVE 0xffe41fc8 _REC_CUR_20_u1_u1 255. _CNV_A_R_LINEAR_____0_CM 0. 255. DISPLAY_IDENTIFIER ID_ERR_ENVD_TOUT_ETCU_1 FORMAT "%3.0"
 /begin AXIS_DESCR COM_AXIS online_dummy _CNV_A_R_LINEAR_____22_CM 4 0. 3. FORMAT "%2.0" AXIS_PTS_REF ldp_fmy_envd /end AXIS_DESCR
/end CHARACTERISTIC
/begin CHARACTERISTIC fmy_id_tout_etcu_2.envd "" CURVE 0xffe41fda _REC_CUR_20_u1_u1 255. _CNV_A_R_LINEAR_____0_CM 0. 255. DISPLAY_IDENTIFIER ID_ERR_ENVD_TOUT_ETCU_2 FORMAT "%3.0"
 /begin AXIS_DESCR COM_AXIS online_dummy _CNV_A_R_LINEAR_____22_CM 4 0. 3. FORMAT "%2.0" AXIS_PTS_REF ldp_fmy_envd /end AXIS_DESCR
/end CHARACTERISTIC
/begin CHARACTERISTIC fmy_id_tout_icl_2.envd "" CURVE 0xffe41fec _REC_CUR_20_u1_u1 255. _CNV_A_R_LINEAR_____0_CM 0. 255. DISPLAY_IDENTIFIER ID_ERR_ENVD_TOUT_ICL_2 FORMAT "%3.0"
 /begin AXIS_DESCR COM_AXIS online_dummy _CNV_A_R_LINEAR_____22_CM 4 0. 3. FORMAT "%2.0" AXIS_PTS_REF ldp_fmy_envd /end AXIS_DESCR
/end CHARACTERISTIC
/begin CHARACTERISTIC fmy_id_tout_icl_3.envd "" CURVE 0xffe41ffe _REC_CUR_20_u1_u1 255. _CNV_A_R_LINEAR_____0_CM 0. 255. DISPLAY_IDENTIFIER ID_ERR_ENVD_TOUT_ICL_3 FORMAT "%3.0"
 /begin AXIS_DESCR COM_AXIS online_dummy _CNV_A_R_LINEAR_____22_CM 4 0. 3. FORMAT "%2.0" AXIS_PTS_REF ldp_fmy_envd /end AXIS_DESCR
/end CHARACTERISTIC
/begin CHARACTERISTIC fmy_id_tout_asr_1.envd "" CURVE 0xffe42010 _REC_CUR_20_u1_u1 255. _CNV_A_R_LINEAR_____0_CM 0. 255. DISPLAY_IDENTIFIER ID_ERR_ENVD_TOUT_ASR_1 FORMAT "%3.0"
 /begin AXIS_DESCR COM_AXIS online_dummy _CNV_A_R_LINEAR_____22_CM 4 0. 3. FORMAT "%2.0" AXIS_PTS_REF ldp_fmy_envd /end AXIS_DESCR
/end CHARACTERISTIC
/begin CHARACTERISTIC fmy_id_tout_asr_3.envd "" CURVE 0xffe42022 _REC_CUR_20_u1_u1 255. _CNV_A_R_LINEAR_____0_CM 0. 255. DISPLAY_IDENTIFIER ID_ERR_ENVD_TOUT_ASR_3 FORMAT "%3.0"
 /begin AXIS_DESCR COM_AXIS online_dummy _CNV_A_R_LINEAR_____22_CM 4 0. 3. FORMAT "%2.0" AXIS_PTS_REF ldp_fmy_envd /end AXIS_DESCR
/end CHARACTERISTIC
/begin CHARACTERISTIC fmy_id_tout_asr_4.envd "" CURVE 0xffe42034 _REC_CUR_20_u1_u1 255. _CNV_A_R_LINEAR_____0_CM 0. 255. DISPLAY_IDENTIFIER ID_ERR_ENVD_TOUT_ASR_4 FORMAT "%3.0"
 /begin AXIS_DESCR COM_AXIS online_dummy _CNV_A_R_LINEAR_____22_CM 4 0. 3. FORMAT "%2.0" AXIS_PTS_REF ldp_fmy_envd /end AXIS_DESCR
/end CHARACTERISTIC
/begin CHARACTERISTIC fmy_id_tout_pste_1.envd "" CURVE 0xffe42046 _REC_CUR_20_u1_u1 255. _CNV_A_R_LINEAR_____0_CM 0. 255. DISPLAY_IDENTIFIER ID_ERR_ENVD_TOUT_PSTE_1 FORMAT "%3.0"
 /begin AXIS_DESCR COM_AXIS online_dummy _CNV_A_R_LINEAR_____22_CM 4 0. 3. FORMAT "%2.0" AXIS_PTS_REF ldp_fmy_envd /end AXIS_DESCR
/end CHARACTERISTIC
/begin CHARACTERISTIC fmy_id_tout_amt_1.envd "" CURVE 0xffe42058 _REC_CUR_20_u1_u1 255. _CNV_A_R_LINEAR_____0_CM 0. 255. DISPLAY_IDENTIFIER ID_ERR_ENVD_TOUT_AMT_1 FORMAT "%3.0"
 /begin AXIS_DESCR COM_AXIS online_dummy _CNV_A_R_LINEAR_____22_CM 4 0. 3. FORMAT "%2.0" AXIS_PTS_REF ldp_fmy_envd /end AXIS_DESCR
/end CHARACTERISTIC
/begin CHARACTERISTIC fmy_id_vs.envd "" CURVE 0xffe4206a _REC_CUR_20_u1_u1 255. _CNV_A_R_LINEAR_____0_CM 0. 255. DISPLAY_IDENTIFIER ID_ERR_ENVD_VS FORMAT "%3.0"
 /begin AXIS_DESCR COM_AXIS online_dummy _CNV_A_R_LINEAR_____22_CM 4 0. 3. FORMAT "%2.0" AXIS_PTS_REF ldp_fmy_envd /end AXIS_DESCR
/end CHARACTERISTIC
/begin CHARACTERISTIC fmy_id_knks_1.envd "" CURVE 0xffe4207c _REC_CUR_20_u1_u1 255. _CNV_A_R_LINEAR_____0_CM 0. 255. DISPLAY_IDENTIFIER ID_ERR_ENVD_KNKS_1 FORMAT "%3.0"
 /begin AXIS_DESCR COM_AXIS online_dummy _CNV_A_R_LINEAR_____22_CM 4 0. 3. FORMAT "%2.0" AXIS_PTS_REF ldp_fmy_envd /end AXIS_DESCR
/end CHARACTERISTIC
/begin CHARACTERISTIC fmy_id_knks_2.envd "" CURVE 0xffe4208e _REC_CUR_20_u1_u1 255. _CNV_A_R_LINEAR_____0_CM 0. 255. DISPLAY_IDENTIFIER ID_ERR_ENVD_KNKS_2 FORMAT "%3.0"
 /begin AXIS_DESCR COM_AXIS online_dummy _CNV_A_R_LINEAR_____22_CM 4 0. 3. FORMAT "%2.0" AXIS_PTS_REF ldp_fmy_envd /end AXIS_DESCR
/end CHARACTERISTIC
/begin CHARACTERISTIC fmy_id_td_igc_cut_0.envd "" CURVE 0xffe420a0 _REC_CUR_20_u1_u1 255. _CNV_A_R_LINEAR_____0_CM 0. 255. DISPLAY_IDENTIFIER ID_ERR_ENVD_TD_IGC_CUT_0 FORMAT "%3.0"
 /begin AXIS_DESCR COM_AXIS online_dummy _CNV_A_R_LINEAR_____22_CM 4 0. 3. FORMAT "%2.0" AXIS_PTS_REF ldp_fmy_envd /end AXIS_DESCR
/end CHARACTERISTIC
/begin CHARACTERISTIC fmy_id_td_igc_cut_1.envd "" CURVE 0xffe420b2 _REC_CUR_20_u1_u1 255. _CNV_A_R_LINEAR_____0_CM 0. 255. DISPLAY_IDENTIFIER ID_ERR_ENVD_TD_IGC_CUT_1 FORMAT "%3.0"
 /begin AXIS_DESCR COM_AXIS online_dummy _CNV_A_R_LINEAR_____22_CM 4 0. 3. FORMAT "%2.0" AXIS_PTS_REF ldp_fmy_envd /end AXIS_DESCR
/end CHARACTERISTIC
/begin CHARACTERISTIC fmy_id_td_igc_cut_2.envd "" CURVE 0xffe420c4 _REC_CUR_20_u1_u1 255. _CNV_A_R_LINEAR_____0_CM 0. 255. DISPLAY_IDENTIFIER ID_ERR_ENVD_TD_IGC_CUT_2 FORMAT "%3.0"
 /begin AXIS_DESCR COM_AXIS online_dummy _CNV_A_R_LINEAR_____22_CM 4 0. 3. FORMAT "%2.0" AXIS_PTS_REF ldp_fmy_envd /end AXIS_DESCR
/end CHARACTERISTIC
/begin CHARACTERISTIC fmy_id_td_igc_cut_3.envd "" CURVE 0xffe420d6 _REC_CUR_20_u1_u1 255. _CNV_A_R_LINEAR_____0_CM 0. 255. DISPLAY_IDENTIFIER ID_ERR_ENVD_TD_IGC_CUT_3 FORMAT "%3.0"
 /begin AXIS_DESCR COM_AXIS online_dummy _CNV_A_R_LINEAR_____22_CM 4 0. 3. FORMAT "%2.0" AXIS_PTS_REF ldp_fmy_envd /end AXIS_DESCR
/end CHARACTERISTIC
/begin CHARACTERISTIC fmy_id_td_igc_cut_4.envd "" CURVE 0xffe420e8 _REC_CUR_20_u1_u1 255. _CNV_A_R_LINEAR_____0_CM 0. 255. DISPLAY_IDENTIFIER ID_ERR_ENVD_TD_IGC_CUT_4 FORMAT "%3.0"
 /begin AXIS_DESCR COM_AXIS online_dummy _CNV_A_R_LINEAR_____22_CM 4 0. 3. FORMAT "%2.0" AXIS_PTS_REF ldp_fmy_envd /end AXIS_DESCR
/end CHARACTERISTIC
/begin CHARACTERISTIC fmy_id_td_igc_cut_5.envd "" CURVE 0xffe420fa _REC_CUR_20_u1_u1 255. _CNV_A_R_LINEAR_____0_CM 0. 255. DISPLAY_IDENTIFIER ID_ERR_ENVD_TD_IGC_CUT_5 FORMAT "%3.0"
 /begin AXIS_DESCR COM_AXIS online_dummy _CNV_A_R_LINEAR_____22_CM 4 0. 3. FORMAT "%2.0" AXIS_PTS_REF ldp_fmy_envd /end AXIS_DESCR
/end CHARACTERISTIC
/begin CHARACTERISTIC fmy_id_dur_igc_0.envd "" CURVE 0xffe4210c _REC_CUR_20_u1_u1 255. _CNV_A_R_LINEAR_____0_CM 0. 255. DISPLAY_IDENTIFIER ID_ERR_ENVD_DUR_IGC_0 FORMAT "%3.0"
 /begin AXIS_DESCR COM_AXIS online_dummy _CNV_A_R_LINEAR_____22_CM 4 0. 3. FORMAT "%2.0" AXIS_PTS_REF ldp_fmy_envd /end AXIS_DESCR
/end CHARACTERISTIC
/begin CHARACTERISTIC fmy_id_dur_igc_1.envd "" CURVE 0xffe4211e _REC_CUR_20_u1_u1 255. _CNV_A_R_LINEAR_____0_CM 0. 255. DISPLAY_IDENTIFIER ID_ERR_ENVD_DUR_IGC_1 FORMAT "%3.0"
 /begin AXIS_DESCR COM_AXIS online_dummy _CNV_A_R_LINEAR_____22_CM 4 0. 3. FORMAT "%2.0" AXIS_PTS_REF ldp_fmy_envd /end AXIS_DESCR
/end CHARACTERISTIC
/begin CHARACTERISTIC fmy_id_dur_igc_2.envd "" CURVE 0xffe42130 _REC_CUR_20_u1_u1 255. _CNV_A_R_LINEAR_____0_CM 0. 255. DISPLAY_IDENTIFIER ID_ERR_ENVD_DUR_IGC_2 FORMAT "%3.0"
 /begin AXIS_DESCR COM_AXIS online_dummy _CNV_A_R_LINEAR_____22_CM 4 0. 3. FORMAT "%2.0" AXIS_PTS_REF ldp_fmy_envd /end AXIS_DESCR
/end CHARACTERISTIC
/begin CHARACTERISTIC fmy_id_dur_igc_3.envd "" CURVE 0xffe42142 _REC_CUR_20_u1_u1 255. _CNV_A_R_LINEAR_____0_CM 0. 255. DISPLAY_IDENTIFIER ID_ERR_ENVD_DUR_IGC_3 FORMAT "%3.0"
 /begin AXIS_DESCR COM_AXIS online_dummy _CNV_A_R_LINEAR_____22_CM 4 0. 3. FORMAT "%2.0" AXIS_PTS_REF ldp_fmy_envd /end AXIS_DESCR
/end CHARACTERISTIC
/begin CHARACTERISTIC fmy_id_dur_igc_4.envd "" CURVE 0xffe42154 _REC_CUR_20_u1_u1 255. _CNV_A_R_LINEAR_____0_CM 0. 255. DISPLAY_IDENTIFIER ID_ERR_ENVD_DUR_IGC_4 FORMAT "%3.0"
 /begin AXIS_DESCR COM_AXIS online_dummy _CNV_A_R_LINEAR_____22_CM 4 0. 3. FORMAT "%2.0" AXIS_PTS_REF ldp_fmy_envd /end AXIS_DESCR
/end CHARACTERISTIC
/begin CHARACTERISTIC fmy_id_dur_igc_5.envd "" CURVE 0xffe42166 _REC_CUR_20_u1_u1 255. _CNV_A_R_LINEAR_____0_CM 0. 255. DISPLAY_IDENTIFIER ID_ERR_ENVD_DUR_IGC_5 FORMAT "%3.0"
 /begin AXIS_DESCR COM_AXIS online_dummy _CNV_A_R_LINEAR_____22_CM 4 0. 3. FORMAT "%2.0" AXIS_PTS_REF ldp_fmy_envd /end AXIS_DESCR
/end CHARACTERISTIC
/begin CHARACTERISTIC fmy_id_tps_1.envd "" CURVE 0xffe42178 _REC_CUR_20_u1_u1 255. _CNV_A_R_LINEAR_____0_CM 0. 255. DISPLAY_IDENTIFIER ID_ERR_ENVD_TPS_1 FORMAT "%3.0"
 /begin AXIS_DESCR COM_AXIS online_dummy _CNV_A_R_LINEAR_____22_CM 4 0. 3. FORMAT "%2.0" AXIS_PTS_REF ldp_fmy_envd /end AXIS_DESCR
/end CHARACTERISTIC
/begin CHARACTERISTIC fmy_id_tps_2.envd "" CURVE 0xffe4218a _REC_CUR_20_u1_u1 255. _CNV_A_R_LINEAR_____0_CM 0. 255. DISPLAY_IDENTIFIER ID_ERR_ENVD_TPS_2 FORMAT "%3.0"
 /begin AXIS_DESCR COM_AXIS online_dummy _CNV_A_R_LINEAR_____22_CM 4 0. 3. FORMAT "%2.0" AXIS_PTS_REF ldp_fmy_envd /end AXIS_DESCR
/end CHARACTERISTIC
/begin CHARACTERISTIC fmy_id_tps_maf_1.envd "" CURVE 0xffe4219c _REC_CUR_20_u1_u1 255. _CNV_A_R_LINEAR_____0_CM 0. 255. DISPLAY_IDENTIFIER ID_ERR_ENVD_TPS_MAF_1 FORMAT "%3.0"
 /begin AXIS_DESCR COM_AXIS online_dummy _CNV_A_R_LINEAR_____22_CM 4 0. 3. FORMAT "%2.0" AXIS_PTS_REF ldp_fmy_envd /end AXIS_DESCR
/end CHARACTERISTIC
/begin CHARACTERISTIC fmy_id_tps_maf_2.envd "" CURVE 0xffe421ae _REC_CUR_20_u1_u1 255. _CNV_A_R_LINEAR_____0_CM 0. 255. DISPLAY_IDENTIFIER ID_ERR_ENVD_TPS_MAF_2 FORMAT "%3.0"
 /begin AXIS_DESCR COM_AXIS online_dummy _CNV_A_R_LINEAR_____22_CM 4 0. 3. FORMAT "%2.0" AXIS_PTS_REF ldp_fmy_envd /end AXIS_DESCR
/end CHARACTERISTIC
/begin CHARACTERISTIC fmy_id_v_ref_1.envd "" CURVE 0xffe421c0 _REC_CUR_20_u1_u1 255. _CNV_A_R_LINEAR_____0_CM 0. 255. DISPLAY_IDENTIFIER ID_ERR_ENVD_V_REF_1 FORMAT "%3.0"
 /begin AXIS_DESCR COM_AXIS online_dummy _CNV_A_R_LINEAR_____22_CM 4 0. 3. FORMAT "%2.0" AXIS_PTS_REF ldp_fmy_envd /end AXIS_DESCR
/end CHARACTERISTIC
/begin CHARACTERISTIC fmy_id_v_ref_2.envd "" CURVE 0xffe421d2 _REC_CUR_20_u1_u1 255. _CNV_A_R_LINEAR_____0_CM 0. 255. DISPLAY_IDENTIFIER ID_ERR_ENVD_V_REF_2 FORMAT "%3.0"
 /begin AXIS_DESCR COM_AXIS online_dummy _CNV_A_R_LINEAR_____22_CM 4 0. 3. FORMAT "%2.0" AXIS_PTS_REF ldp_fmy_envd /end AXIS_DESCR
/end CHARACTERISTIC
/begin CHARACTERISTIC fmy_id_pvs_1.envd "" CURVE 0xffe421e4 _REC_CUR_20_u1_u1 255. _CNV_A_R_LINEAR_____0_CM 0. 255. DISPLAY_IDENTIFIER ID_ERR_ENVD_PVS_1 FORMAT "%3.0"
 /begin AXIS_DESCR COM_AXIS online_dummy _CNV_A_R_LINEAR_____22_CM 4 0. 3. FORMAT "%2.0" AXIS_PTS_REF ldp_fmy_envd /end AXIS_DESCR
/end CHARACTERISTIC
/begin CHARACTERISTIC fmy_id_pvs_2.envd "" CURVE 0xffe421f6 _REC_CUR_20_u1_u1 255. _CNV_A_R_LINEAR_____0_CM 0. 255. DISPLAY_IDENTIFIER ID_ERR_ENVD_PVS_2 FORMAT "%3.0"
 /begin AXIS_DESCR COM_AXIS online_dummy _CNV_A_R_LINEAR_____22_CM 4 0. 3. FORMAT "%2.0" AXIS_PTS_REF ldp_fmy_envd /end AXIS_DESCR
/end CHARACTERISTIC
/begin CHARACTERISTIC fmy_id_pvs_ratio.envd "" CURVE 0xffe42208 _REC_CUR_20_u1_u1 255. _CNV_A_R_LINEAR_____0_CM 0. 255. DISPLAY_IDENTIFIER ID_ERR_ENVD_PVS_RATIO FORMAT "%3.0"
 /begin AXIS_DESCR COM_AXIS online_dummy _CNV_A_R_LINEAR_____22_CM 4 0. 3. FORMAT "%2.0" AXIS_PTS_REF ldp_fmy_envd /end AXIS_DESCR
/end CHARACTERISTIC
/begin CHARACTERISTIC fmy_id_pvs_double.envd "" CURVE 0xffe4221a _REC_CUR_20_u1_u1 255. _CNV_A_R_LINEAR_____0_CM 0. 255. DISPLAY_IDENTIFIER ID_ERR_ENVD_PVS_DOUBLE FORMAT "%3.0"
 /begin AXIS_DESCR COM_AXIS online_dummy _CNV_A_R_LINEAR_____22_CM 4 0. 3. FORMAT "%2.0" AXIS_PTS_REF ldp_fmy_envd /end AXIS_DESCR
/end CHARACTERISTIC
/begin CHARACTERISTIC fmy_id_pvs_bls_not_plaus.envd "" CURVE 0xffe4222c _REC_CUR_20_u1_u1 255. _CNV_A_R_LINEAR_____0_CM 0. 255. DISPLAY_IDENTIFIER ID_ERR_ENVD_PVS_BLS_NOT_PLAUS FORMAT "%3.0"
 /begin AXIS_DESCR COM_AXIS online_dummy _CNV_A_R_LINEAR_____22_CM 4 0. 3. FORMAT "%2.0" AXIS_PTS_REF ldp_fmy_envd /end AXIS_DESCR
/end CHARACTERISTIC
/begin CHARACTERISTIC fmy_id_mtc_dr.envd "" CURVE 0xffe4223e _REC_CUR_20_u1_u1 255. _CNV_A_R_LINEAR_____0_CM 0. 255. DISPLAY_IDENTIFIER ID_ERR_ENVD_MTC_DR FORMAT "%3.0"
 /begin AXIS_DESCR COM_AXIS online_dummy _CNV_A_R_LINEAR_____22_CM 4 0. 3. FORMAT "%2.0" AXIS_PTS_REF ldp_fmy_envd /end AXIS_DESCR
/end CHARACTERISTIC
/begin CHARACTERISTIC fmy_id_mtc_ctl_1.envd "" CURVE 0xffe42250 _REC_CUR_20_u1_u1 255. _CNV_A_R_LINEAR_____0_CM 0. 255. DISPLAY_IDENTIFIER ID_ERR_ENVD_MTC_CTL_1 FORMAT "%3.0"
 /begin AXIS_DESCR COM_AXIS online_dummy _CNV_A_R_LINEAR_____22_CM 4 0. 3. FORMAT "%2.0" AXIS_PTS_REF ldp_fmy_envd /end AXIS_DESCR
/end CHARACTERISTIC
/begin CHARACTERISTIC fmy_id_mtc_ctl_2.envd "" CURVE 0xffe42262 _REC_CUR_20_u1_u1 255. _CNV_A_R_LINEAR_____0_CM 0. 255. DISPLAY_IDENTIFIER ID_ERR_ENVD_MTC_CTL_2 FORMAT "%3.0"
 /begin AXIS_DESCR COM_AXIS online_dummy _CNV_A_R_LINEAR_____22_CM 4 0. 3. FORMAT "%2.0" AXIS_PTS_REF ldp_fmy_envd /end AXIS_DESCR
/end CHARACTERISTIC
/begin CHARACTERISTIC fmy_id_mtc_ctl_3.envd "" CURVE 0xffe42274 _REC_CUR_20_u1_u1 255. _CNV_A_R_LINEAR_____0_CM 0. 255. DISPLAY_IDENTIFIER ID_ERR_ENVD_MTC_CTL_3 FORMAT "%3.0"
 /begin AXIS_DESCR COM_AXIS online_dummy _CNV_A_R_LINEAR_____22_CM 4 0. 3. FORMAT "%2.0" AXIS_PTS_REF ldp_fmy_envd /end AXIS_DESCR
/end CHARACTERISTIC
/begin CHARACTERISTIC fmy_id_tps_ad.envd "" CURVE 0xffe42286 _REC_CUR_20_u1_u1 255. _CNV_A_R_LINEAR_____0_CM 0. 255. DISPLAY_IDENTIFIER ID_ERR_ENVD_TPS_AD FORMAT "%3.0"
 /begin AXIS_DESCR COM_AXIS online_dummy _CNV_A_R_LINEAR_____22_CM 4 0. 3. FORMAT "%2.0" AXIS_PTS_REF ldp_fmy_envd /end AXIS_DESCR
/end CHARACTERISTIC
/begin CHARACTERISTIC fmy_id_tps_ad_bol.envd "" CURVE 0xffe42298 _REC_CUR_20_u1_u1 255. _CNV_A_R_LINEAR_____0_CM 0. 255. DISPLAY_IDENTIFIER ID_ERR_ENVD_TPS_AD_BOL FORMAT "%3.0"
 /begin AXIS_DESCR COM_AXIS online_dummy _CNV_A_R_LINEAR_____22_CM 4 0. 3. FORMAT "%2.0" AXIS_PTS_REF ldp_fmy_envd /end AXIS_DESCR
/end CHARACTERISTIC
/begin CHARACTERISTIC fmy_id_tps_st_chk_1.envd "" CURVE 0xffe422aa _REC_CUR_20_u1_u1 255. _CNV_A_R_LINEAR_____0_CM 0. 255. DISPLAY_IDENTIFIER ID_ERR_ENVD_TPS_ST_CHK_1 FORMAT "%3.0"
 /begin AXIS_DESCR COM_AXIS online_dummy _CNV_A_R_LINEAR_____22_CM 4 0. 3. FORMAT "%2.0" AXIS_PTS_REF ldp_fmy_envd /end AXIS_DESCR
/end CHARACTERISTIC
/begin CHARACTERISTIC fmy_id_tps_st_chk_2.envd "" CURVE 0xffe422bc _REC_CUR_20_u1_u1 255. _CNV_A_R_LINEAR_____0_CM 0. 255. DISPLAY_IDENTIFIER ID_ERR_ENVD_TPS_ST_CHK_2 FORMAT "%3.0"
 /begin AXIS_DESCR COM_AXIS online_dummy _CNV_A_R_LINEAR_____22_CM 4 0. 3. FORMAT "%2.0" AXIS_PTS_REF ldp_fmy_envd /end AXIS_DESCR
/end CHARACTERISTIC
/begin CHARACTERISTIC fmy_id_gen.envd "" CURVE 0xffe422ce _REC_CUR_20_u1_u1 255. _CNV_A_R_LINEAR_____0_CM 0. 255. DISPLAY_IDENTIFIER ID_ERR_ENVD_GEN FORMAT "%3.0"
 /begin AXIS_DESCR COM_AXIS online_dummy _CNV_A_R_LINEAR_____22_CM 4 0. 3. FORMAT "%2.0" AXIS_PTS_REF ldp_fmy_envd /end AXIS_DESCR
/end CHARACTERISTIC
/begin CHARACTERISTIC fmy_id_gen_if.envd "" CURVE 0xffe422e0 _REC_CUR_20_u1_u1 255. _CNV_A_R_LINEAR_____0_CM 0. 255. DISPLAY_IDENTIFIER ID_ERR_ENVD_GEN_IF FORMAT "%3.0"
 /begin AXIS_DESCR COM_AXIS online_dummy _CNV_A_R_LINEAR_____22_CM 4 0. 3. FORMAT "%2.0" AXIS_PTS_REF ldp_fmy_envd /end AXIS_DESCR
/end CHARACTERISTIC
/begin CHARACTERISTIC fmy_id_gen_diag.envd "" CURVE 0xffe422f2 _REC_CUR_20_u1_u1 255. _CNV_A_R_LINEAR_____0_CM 0. 255. DISPLAY_IDENTIFIER ID_ERR_ENVD_GEN_DIAG FORMAT "%3.0"
 /begin AXIS_DESCR COM_AXIS online_dummy _CNV_A_R_LINEAR_____22_CM 4 0. 3. FORMAT "%2.0" AXIS_PTS_REF ldp_fmy_envd /end AXIS_DESCR
/end CHARACTERISTIC
/begin CHARACTERISTIC fmy_id_vim.envd "" CURVE 0xffe42304 _REC_CUR_20_u1_u1 255. _CNV_A_R_LINEAR_____0_CM 0. 255. DISPLAY_IDENTIFIER ID_ERR_ENVD_VIM FORMAT "%3.0"
 /begin AXIS_DESCR COM_AXIS online_dummy _CNV_A_R_LINEAR_____22_CM 4 0. 3. FORMAT "%2.0" AXIS_PTS_REF ldp_fmy_envd /end AXIS_DESCR
/end CHARACTERISTIC
/begin CHARACTERISTIC fmy_id_cam_per_0.envd "" CURVE 0xffe42316 _REC_CUR_20_u1_u1 255. _CNV_A_R_LINEAR_____0_CM 0. 255. DISPLAY_IDENTIFIER ID_ERR_ENVD_CAM_PER_0 FORMAT "%3.0"
 /begin AXIS_DESCR COM_AXIS online_dummy _CNV_A_R_LINEAR_____22_CM 4 0. 3. FORMAT "%2.0" AXIS_PTS_REF ldp_fmy_envd /end AXIS_DESCR
/end CHARACTERISTIC
/begin CHARACTERISTIC fmy_id_cam_per_1.envd "" CURVE 0xffe42328 _REC_CUR_20_u1_u1 255. _CNV_A_R_LINEAR_____0_CM 0. 255. DISPLAY_IDENTIFIER ID_ERR_ENVD_CAM_PER_1 FORMAT "%3.0"
 /begin AXIS_DESCR COM_AXIS online_dummy _CNV_A_R_LINEAR_____22_CM 4 0. 3. FORMAT "%2.0" AXIS_PTS_REF ldp_fmy_envd /end AXIS_DESCR
/end CHARACTERISTIC
/begin CHARACTERISTIC fmy_id_cam_psn_0.envd "" CURVE 0xffe4233a _REC_CUR_20_u1_u1 255. _CNV_A_R_LINEAR_____0_CM 0. 255. DISPLAY_IDENTIFIER ID_ERR_ENVD_CAM_PSN_0 FORMAT "%3.0"
 /begin AXIS_DESCR COM_AXIS online_dummy _CNV_A_R_LINEAR_____22_CM 4 0. 3. FORMAT "%2.0" AXIS_PTS_REF ldp_fmy_envd /end AXIS_DESCR
/end CHARACTERISTIC
/begin CHARACTERISTIC fmy_id_cam_psn_1.envd "" CURVE 0xffe4234c _REC_CUR_20_u1_u1 255. _CNV_A_R_LINEAR_____0_CM 0. 255. DISPLAY_IDENTIFIER ID_ERR_ENVD_CAM_PSN_1 FORMAT "%3.0"
 /begin AXIS_DESCR COM_AXIS online_dummy _CNV_A_R_LINEAR_____22_CM 4 0. 3. FORMAT "%2.0" AXIS_PTS_REF ldp_fmy_envd /end AXIS_DESCR
/end CHARACTERISTIC
/begin CHARACTERISTIC fmy_id_cam_0_not_plaus.envd "" CURVE 0xffe4235e _REC_CUR_20_u1_u1 255. _CNV_A_R_LINEAR_____0_CM 0. 255. DISPLAY_IDENTIFIER ID_ERR_ENVD_CAM_0_NOT_PLAUS FORMAT "%3.0"
 /begin AXIS_DESCR COM_AXIS online_dummy _CNV_A_R_LINEAR_____22_CM 4 0. 3. FORMAT "%2.0" AXIS_PTS_REF ldp_fmy_envd /end AXIS_DESCR
/end CHARACTERISTIC
/begin CHARACTERISTIC fmy_id_cam_1_not_plaus.envd "" CURVE 0xffe42370 _REC_CUR_20_u1_u1 255. _CNV_A_R_LINEAR_____0_CM 0. 255. DISPLAY_IDENTIFIER ID_ERR_ENVD_CAM_1_NOT_PLAUS FORMAT "%3.0"
 /begin AXIS_DESCR COM_AXIS online_dummy _CNV_A_R_LINEAR_____22_CM 4 0. 3. FORMAT "%2.0" AXIS_PTS_REF ldp_fmy_envd /end AXIS_DESCR
/end CHARACTERISTIC
/begin CHARACTERISTIC fmy_id_eng_psn.envd "" CURVE 0xffe42382 _REC_CUR_20_u1_u1 255. _CNV_A_R_LINEAR_____0_CM 0. 255. DISPLAY_IDENTIFIER ID_ERR_ENVD_ENG_PSN FORMAT "%3.0"
 /begin AXIS_DESCR COM_AXIS online_dummy _CNV_A_R_LINEAR_____22_CM 4 0. 3. FORMAT "%2.0" AXIS_PTS_REF ldp_fmy_envd /end AXIS_DESCR
/end CHARACTERISTIC
/begin CHARACTERISTIC fmy_id_tooth_per.envd "" CURVE 0xffe42394 _REC_CUR_20_u1_u1 255. _CNV_A_R_LINEAR_____0_CM 0. 255. DISPLAY_IDENTIFIER ID_ERR_ENVD_TOOTH_PER FORMAT "%3.0"
 /begin AXIS_DESCR COM_AXIS online_dummy _CNV_A_R_LINEAR_____22_CM 4 0. 3. FORMAT "%2.0" AXIS_PTS_REF ldp_fmy_envd /end AXIS_DESCR
/end CHARACTERISTIC
/begin CHARACTERISTIC fmy_id_tpu_syn.envd "" CURVE 0xffe423a6 _REC_CUR_20_u1_u1 255. _CNV_A_R_LINEAR_____0_CM 0. 255. DISPLAY_IDENTIFIER ID_ERR_ENVD_TPU_SYN FORMAT "%3.0"
 /begin AXIS_DESCR COM_AXIS online_dummy _CNV_A_R_LINEAR_____22_CM 4 0. 3. FORMAT "%2.0" AXIS_PTS_REF ldp_fmy_envd /end AXIS_DESCR
/end CHARACTERISTIC
/begin CHARACTERISTIC fmy_id_crk_not_plaus.envd "" CURVE 0xffe423b8 _REC_CUR_20_u1_u1 255. _CNV_A_R_LINEAR_____0_CM 0. 255. DISPLAY_IDENTIFIER ID_ERR_ENVD_CRK_NOT_PLAUS FORMAT "%3.0"
 /begin AXIS_DESCR COM_AXIS online_dummy _CNV_A_R_LINEAR_____22_CM 4 0. 3. FORMAT "%2.0" AXIS_PTS_REF ldp_fmy_envd /end AXIS_DESCR
/end CHARACTERISTIC
/begin CHARACTERISTIC fmy_id_tout_txu_1.envd "" CURVE 0xffe423ca _REC_CUR_20_u1_u1 255. _CNV_A_R_LINEAR_____0_CM 0. 255. DISPLAY_IDENTIFIER ID_ERR_ENVD_TOUT_TXU_1 FORMAT "%3.0"
 /begin AXIS_DESCR COM_AXIS online_dummy _CNV_A_R_LINEAR_____22_CM 4 0. 3. FORMAT "%2.0" AXIS_PTS_REF ldp_fmy_envd /end AXIS_DESCR
/end CHARACTERISTIC
/begin CHARACTERISTIC fmy_id_can_boff.envd "" CURVE 0xffe423dc _REC_CUR_20_u1_u1 255. _CNV_A_R_LINEAR_____0_CM 0. 255. DISPLAY_IDENTIFIER ID_ERR_ENVD_CAN_BOFF FORMAT "%3.0"
 /begin AXIS_DESCR COM_AXIS online_dummy _CNV_A_R_LINEAR_____22_CM 4 0. 3. FORMAT "%2.0" AXIS_PTS_REF ldp_fmy_envd /end AXIS_DESCR
/end CHARACTERISTIC
/begin CHARACTERISTIC fmy_id_rly_main.envd "" CURVE 0xffe423ee _REC_CUR_20_u1_u1 255. _CNV_A_R_LINEAR_____0_CM 0. 255. DISPLAY_IDENTIFIER ID_ERR_ENVD_RLY_MAIN FORMAT "%3.0"
 /begin AXIS_DESCR COM_AXIS online_dummy _CNV_A_R_LINEAR_____22_CM 4 0. 3. FORMAT "%2.0" AXIS_PTS_REF ldp_fmy_envd /end AXIS_DESCR
/end CHARACTERISTIC
/begin CHARACTERISTIC fmy_id_rly_main_dly.envd "" CURVE 0xffe42400 _REC_CUR_20_u1_u1 255. _CNV_A_R_LINEAR_____0_CM 0. 255. DISPLAY_IDENTIFIER ID_ERR_ENVD_RLY_MAIN_DLY FORMAT "%3.0"
 /begin AXIS_DESCR COM_AXIS online_dummy _CNV_A_R_LINEAR_____22_CM 4 0. 3. FORMAT "%2.0" AXIS_PTS_REF ldp_fmy_envd /end AXIS_DESCR
/end CHARACTERISTIC
/begin CHARACTERISTIC fmy_id_rly_accout.envd "" CURVE 0xffe42412 _REC_CUR_20_u1_u1 255. _CNV_A_R_LINEAR_____0_CM 0. 255. DISPLAY_IDENTIFIER ID_ERR_ENVD_RLY_ACCOUT FORMAT "%3.0"
 /begin AXIS_DESCR COM_AXIS online_dummy _CNV_A_R_LINEAR_____22_CM 4 0. 3. FORMAT "%2.0" AXIS_PTS_REF ldp_fmy_envd /end AXIS_DESCR
/end CHARACTERISTIC
/begin CHARACTERISTIC fmy_id_sap.envd "" CURVE 0xffe42424 _REC_CUR_20_u1_u1 255. _CNV_A_R_LINEAR_____0_CM 0. 255. DISPLAY_IDENTIFIER ID_ERR_ENVD_SAP FORMAT "%3.0"
 /begin AXIS_DESCR COM_AXIS online_dummy _CNV_A_R_LINEAR_____22_CM 4 0. 3. FORMAT "%2.0" AXIS_PTS_REF ldp_fmy_envd /end AXIS_DESCR
/end CHARACTERISTIC
/begin CHARACTERISTIC fmy_id_sav.envd "" CURVE 0xffe42436 _REC_CUR_20_u1_u1 255. _CNV_A_R_LINEAR_____0_CM 0. 255. DISPLAY_IDENTIFIER ID_ERR_ENVD_SAV FORMAT "%3.0"
 /begin AXIS_DESCR COM_AXIS online_dummy _CNV_A_R_LINEAR_____22_CM 4 0. 3. FORMAT "%2.0" AXIS_PTS_REF ldp_fmy_envd /end AXIS_DESCR
/end CHARACTERISTIC
/begin CHARACTERISTIC fmy_id_ecf.envd "" CURVE 0xffe42448 _REC_CUR_20_u1_u1 255. _CNV_A_R_LINEAR_____0_CM 0. 255. DISPLAY_IDENTIFIER ID_ERR_ENVD_ECF FORMAT "%3.0"
 /begin AXIS_DESCR COM_AXIS online_dummy _CNV_A_R_LINEAR_____22_CM 4 0. 3. FORMAT "%2.0" AXIS_PTS_REF ldp_fmy_envd /end AXIS_DESCR
/end CHARACTERISTIC
/begin CHARACTERISTIC fmy_id_tco_plaus.envd "" CURVE 0xffe4245a _REC_CUR_20_u1_u1 255. _CNV_A_R_LINEAR_____0_CM 0. 255. DISPLAY_IDENTIFIER ID_ERR_ENVD_TCO_PLAUS FORMAT "%3.0"
 /begin AXIS_DESCR COM_AXIS online_dummy _CNV_A_R_LINEAR_____22_CM 4 0. 3. FORMAT "%2.0" AXIS_PTS_REF ldp_fmy_envd /end AXIS_DESCR
/end CHARACTERISTIC
/begin CHARACTERISTIC fmy_id_tco_el.envd "" CURVE 0xffe4246c _REC_CUR_20_u1_u1 255. _CNV_A_R_LINEAR_____0_CM 0. 255. DISPLAY_IDENTIFIER ID_ERR_ENVD_TCO_EL FORMAT "%3.0"
 /begin AXIS_DESCR COM_AXIS online_dummy _CNV_A_R_LINEAR_____22_CM 4 0. 3. FORMAT "%2.0" AXIS_PTS_REF ldp_fmy_envd /end AXIS_DESCR
/end CHARACTERISTIC
/begin CHARACTERISTIC fmy_id_tco_grd.envd "" CURVE 0xffe4247e _REC_CUR_20_u1_u1 255. _CNV_A_R_LINEAR_____0_CM 0. 255. DISPLAY_IDENTIFIER ID_ERR_ENVD_TCO_GRD FORMAT "%3.0"
 /begin AXIS_DESCR COM_AXIS online_dummy _CNV_A_R_LINEAR_____22_CM 4 0. 3. FORMAT "%2.0" AXIS_PTS_REF ldp_fmy_envd /end AXIS_DESCR
/end CHARACTERISTIC
/begin CHARACTERISTIC fmy_id_tco_stuck.envd "" CURVE 0xffe42490 _REC_CUR_20_u1_u1 255. _CNV_A_R_LINEAR_____0_CM 0. 255. DISPLAY_IDENTIFIER ID_ERR_ENVD_TCO_STUCK FORMAT "%3.0"
 /begin AXIS_DESCR COM_AXIS online_dummy _CNV_A_R_LINEAR_____22_CM 4 0. 3. FORMAT "%2.0" AXIS_PTS_REF ldp_fmy_envd /end AXIS_DESCR
/end CHARACTERISTIC
/begin CHARACTERISTIC fmy_id_ect_el.envd "" CURVE 0xffe424a2 _REC_CUR_20_u1_u1 255. _CNV_A_R_LINEAR_____0_CM 0. 255. DISPLAY_IDENTIFIER ID_ERR_ENVD_ECT_EL FORMAT "%3.0"
 /begin AXIS_DESCR COM_AXIS online_dummy _CNV_A_R_LINEAR_____22_CM 4 0. 3. FORMAT "%2.0" AXIS_PTS_REF ldp_fmy_envd /end AXIS_DESCR
/end CHARACTERISTIC
/begin CHARACTERISTIC fmy_id_ect_mec.envd "" CURVE 0xffe424b4 _REC_CUR_20_u1_u1 255. _CNV_A_R_LINEAR_____0_CM 0. 255. DISPLAY_IDENTIFIER ID_ERR_ENVD_ECT_MEC FORMAT "%3.0"
 /begin AXIS_DESCR COM_AXIS online_dummy _CNV_A_R_LINEAR_____22_CM 4 0. 3. FORMAT "%2.0" AXIS_PTS_REF ldp_fmy_envd /end AXIS_DESCR
/end CHARACTERISTIC
/begin CHARACTERISTIC fmy_id_isc.envd "" CURVE 0xffe424c6 _REC_CUR_20_u1_u1 255. _CNV_A_R_LINEAR_____0_CM 0. 255. DISPLAY_IDENTIFIER ID_ERR_ENVD_ISC FORMAT "%3.0"
 /begin AXIS_DESCR COM_AXIS online_dummy _CNV_A_R_LINEAR_____22_CM 4 0. 3. FORMAT "%2.0" AXIS_PTS_REF ldp_fmy_envd /end AXIS_DESCR
/end CHARACTERISTIC
/begin CHARACTERISTIC fmy_id_im_bls_plaus.envd "" CURVE 0xffe424d8 _REC_CUR_20_u1_u1 255. _CNV_A_R_LINEAR_____0_CM 0. 255. DISPLAY_IDENTIFIER ID_ERR_ENVD_IM_BLS_PLAUS FORMAT "%3.0"
 /begin AXIS_DESCR COM_AXIS online_dummy _CNV_A_R_LINEAR_____22_CM 4 0. 3. FORMAT "%2.0" AXIS_PTS_REF ldp_fmy_envd /end AXIS_DESCR
/end CHARACTERISTIC
/begin CHARACTERISTIC fmy_id_im_bts_plaus.envd "" CURVE 0xffe424ea _REC_CUR_20_u1_u1 255. _CNV_A_R_LINEAR_____0_CM 0. 255. DISPLAY_IDENTIFIER ID_ERR_ENVD_IM_BTS_PLAUS FORMAT "%3.0"
 /begin AXIS_DESCR COM_AXIS online_dummy _CNV_A_R_LINEAR_____22_CM 4 0. 3. FORMAT "%2.0" AXIS_PTS_REF ldp_fmy_envd /end AXIS_DESCR
/end CHARACTERISTIC
/begin CHARACTERISTIC fmy_id_msw_tog.envd "" CURVE 0xffe424fc _REC_CUR_20_u1_u1 255. _CNV_A_R_LINEAR_____0_CM 0. 255. DISPLAY_IDENTIFIER ID_ERR_ENVD_MSW_TOG FORMAT "%3.0"
 /begin AXIS_DESCR COM_AXIS online_dummy _CNV_A_R_LINEAR_____22_CM 4 0. 3. FORMAT "%2.0" AXIS_PTS_REF ldp_fmy_envd /end AXIS_DESCR
/end CHARACTERISTIC
/begin CHARACTERISTIC fmy_id_msw_2.envd "" CURVE 0xffe4250e _REC_CUR_20_u1_u1 255. _CNV_A_R_LINEAR_____0_CM 0. 255. DISPLAY_IDENTIFIER ID_ERR_ENVD_MSW_2 FORMAT "%3.0"
 /begin AXIS_DESCR COM_AXIS online_dummy _CNV_A_R_LINEAR_____22_CM 4 0. 3. FORMAT "%2.0" AXIS_PTS_REF ldp_fmy_envd /end AXIS_DESCR
/end CHARACTERISTIC
/begin CHARACTERISTIC fmy_id_msw_3.envd "" CURVE 0xffe42520 _REC_CUR_20_u1_u1 255. _CNV_A_R_LINEAR_____0_CM 0. 255. DISPLAY_IDENTIFIER ID_ERR_ENVD_MSW_3 FORMAT "%3.0"
 /begin AXIS_DESCR COM_AXIS online_dummy _CNV_A_R_LINEAR_____22_CM 4 0. 3. FORMAT "%2.0" AXIS_PTS_REF ldp_fmy_envd /end AXIS_DESCR
/end CHARACTERISTIC
/begin CHARACTERISTIC fmy_id_isa_1.envd "" CURVE 0xffe42532 _REC_CUR_20_u1_u1 255. _CNV_A_R_LINEAR_____0_CM 0. 255. DISPLAY_IDENTIFIER ID_ERR_ENVD_ISA_1 FORMAT "%3.0"
 /begin AXIS_DESCR COM_AXIS online_dummy _CNV_A_R_LINEAR_____22_CM 4 0. 3. FORMAT "%2.0" AXIS_PTS_REF ldp_fmy_envd /end AXIS_DESCR
/end CHARACTERISTIC
/begin CHARACTERISTIC fmy_id_isa_2.envd "" CURVE 0xffe42544 _REC_CUR_20_u1_u1 255. _CNV_A_R_LINEAR_____0_CM 0. 255. DISPLAY_IDENTIFIER ID_ERR_ENVD_ISA_2 FORMAT "%3.0"
 /begin AXIS_DESCR COM_AXIS online_dummy _CNV_A_R_LINEAR_____22_CM 4 0. 3. FORMAT "%2.0" AXIS_PTS_REF ldp_fmy_envd /end AXIS_DESCR
/end CHARACTERISTIC
/begin CHARACTERISTIC fmy_id_seg_t_ad.envd "" CURVE 0xffe42556 _REC_CUR_20_u1_u1 255. _CNV_A_R_LINEAR_____0_CM 0. 255. DISPLAY_IDENTIFIER ID_ERR_ENVD_SEG_T_AD FORMAT "%3.0"
 /begin AXIS_DESCR COM_AXIS online_dummy _CNV_A_R_LINEAR_____22_CM 4 0. 3. FORMAT "%2.0" AXIS_PTS_REF ldp_fmy_envd /end AXIS_DESCR
/end CHARACTERISTIC
/begin CHARACTERISTIC fmy_id_seg_t.envd "" CURVE 0xffe42568 _REC_CUR_20_u1_u1 255. _CNV_A_R_LINEAR_____0_CM 0. 255. DISPLAY_IDENTIFIER ID_ERR_ENVD_SEG_T FORMAT "%3.0"
 /begin AXIS_DESCR COM_AXIS online_dummy _CNV_A_R_LINEAR_____22_CM 4 0. 3. FORMAT "%2.0" AXIS_PTS_REF ldp_fmy_envd /end AXIS_DESCR
/end CHARACTERISTIC
/begin CHARACTERISTIC fmy_id_mis_0.envd "" CURVE 0xffe4257a _REC_CUR_20_u1_u1 255. _CNV_A_R_LINEAR_____0_CM 0. 255. DISPLAY_IDENTIFIER ID_ERR_ENVD_MIS_0 FORMAT "%3.0"
 /begin AXIS_DESCR COM_AXIS online_dummy _CNV_A_R_LINEAR_____22_CM 4 0. 3. FORMAT "%2.0" AXIS_PTS_REF ldp_fmy_envd /end AXIS_DESCR
/end CHARACTERISTIC
/begin CHARACTERISTIC fmy_id_mis_1.envd "" CURVE 0xffe4258c _REC_CUR_20_u1_u1 255. _CNV_A_R_LINEAR_____0_CM 0. 255. DISPLAY_IDENTIFIER ID_ERR_ENVD_MIS_1 FORMAT "%3.0"
 /begin AXIS_DESCR COM_AXIS online_dummy _CNV_A_R_LINEAR_____22_CM 4 0. 3. FORMAT "%2.0" AXIS_PTS_REF ldp_fmy_envd /end AXIS_DESCR
/end CHARACTERISTIC
/begin CHARACTERISTIC fmy_id_mis_2.envd "" CURVE 0xffe4259e _REC_CUR_20_u1_u1 255. _CNV_A_R_LINEAR_____0_CM 0. 255. DISPLAY_IDENTIFIER ID_ERR_ENVD_MIS_2 FORMAT "%3.0"
 /begin AXIS_DESCR COM_AXIS online_dummy _CNV_A_R_LINEAR_____22_CM 4 0. 3. FORMAT "%2.0" AXIS_PTS_REF ldp_fmy_envd /end AXIS_DESCR
/end CHARACTERISTIC
/begin CHARACTERISTIC fmy_id_mis_3.envd "" CURVE 0xffe425b0 _REC_CUR_20_u1_u1 255. _CNV_A_R_LINEAR_____0_CM 0. 255. DISPLAY_IDENTIFIER ID_ERR_ENVD_MIS_3 FORMAT "%3.0"
 /begin AXIS_DESCR COM_AXIS online_dummy _CNV_A_R_LINEAR_____22_CM 4 0. 3. FORMAT "%2.0" AXIS_PTS_REF ldp_fmy_envd /end AXIS_DESCR
/end CHARACTERISTIC
/begin CHARACTERISTIC fmy_id_mis_4.envd "" CURVE 0xffe425c2 _REC_CUR_20_u1_u1 255. _CNV_A_R_LINEAR_____0_CM 0. 255. DISPLAY_IDENTIFIER ID_ERR_ENVD_MIS_4 FORMAT "%3.0"
 /begin AXIS_DESCR COM_AXIS online_dummy _CNV_A_R_LINEAR_____22_CM 4 0. 3. FORMAT "%2.0" AXIS_PTS_REF ldp_fmy_envd /end AXIS_DESCR
/end CHARACTERISTIC
/begin CHARACTERISTIC fmy_id_mis_5.envd "" CURVE 0xffe425d4 _REC_CUR_20_u1_u1 255. _CNV_A_R_LINEAR_____0_CM 0. 255. DISPLAY_IDENTIFIER ID_ERR_ENVD_MIS_5 FORMAT "%3.0"
 /begin AXIS_DESCR COM_AXIS online_dummy _CNV_A_R_LINEAR_____22_CM 4 0. 3. FORMAT "%2.0" AXIS_PTS_REF ldp_fmy_envd /end AXIS_DESCR
/end CHARACTERISTIC
/begin CHARACTERISTIC fmy_id_mis_low_fuel.envd "" CURVE 0xffe425e6 _REC_CUR_20_u1_u1 255. _CNV_A_R_LINEAR_____0_CM 0. 255. DISPLAY_IDENTIFIER ID_ERR_ENVD_MIS_LOW_FUEL FORMAT "%3.0"
 /begin AXIS_DESCR COM_AXIS online_dummy _CNV_A_R_LINEAR_____22_CM 4 0. 3. FORMAT "%2.0" AXIS_PTS_REF ldp_fmy_envd /end AXIS_DESCR
/end CHARACTERISTIC
/begin CHARACTERISTIC fmy_id_mis_mpl.envd "" CURVE 0xffe425f8 _REC_CUR_20_u1_u1 255. _CNV_A_R_LINEAR_____0_CM 0. 255. DISPLAY_IDENTIFIER ID_ERR_ENVD_MIS_MPL FORMAT "%3.0"
 /begin AXIS_DESCR COM_AXIS online_dummy _CNV_A_R_LINEAR_____22_CM 4 0. 3. FORMAT "%2.0" AXIS_PTS_REF ldp_fmy_envd /end AXIS_DESCR
/end CHARACTERISTIC
/begin CHARACTERISTIC fmy_id_conv_mon_1.envd "" CURVE 0xffe4260a _REC_CUR_20_u1_u1 255. _CNV_A_R_LINEAR_____0_CM 0. 255. DISPLAY_IDENTIFIER ID_ERR_ENVD_CONV_MON_1 FORMAT "%3.0"
 /begin AXIS_DESCR COM_AXIS online_dummy _CNV_A_R_LINEAR_____22_CM 4 0. 3. FORMAT "%2.0" AXIS_PTS_REF ldp_fmy_envd /end AXIS_DESCR
/end CHARACTERISTIC
/begin CHARACTERISTIC fmy_id_n_32_mon_1.envd "" CURVE 0xffe4261c _REC_CUR_20_u1_u1 255. _CNV_A_R_LINEAR_____0_CM 0. 255. DISPLAY_IDENTIFIER ID_ERR_ENVD_N_32_MON_1 FORMAT "%3.0"
 /begin AXIS_DESCR COM_AXIS online_dummy _CNV_A_R_LINEAR_____22_CM 4 0. 3. FORMAT "%2.0" AXIS_PTS_REF ldp_fmy_envd /end AXIS_DESCR
/end CHARACTERISTIC
/begin CHARACTERISTIC fmy_id_pvs_mon_1.envd "" CURVE 0xffe4262e _REC_CUR_20_u1_u1 255. _CNV_A_R_LINEAR_____0_CM 0. 255. DISPLAY_IDENTIFIER ID_ERR_ENVD_PVS_MON_1 FORMAT "%3.0"
 /begin AXIS_DESCR COM_AXIS online_dummy _CNV_A_R_LINEAR_____22_CM 4 0. 3. FORMAT "%2.0" AXIS_PTS_REF ldp_fmy_envd /end AXIS_DESCR
/end CHARACTERISTIC
/begin CHARACTERISTIC fmy_id_maf_tps_mon_1.envd "" CURVE 0xffe42640 _REC_CUR_20_u1_u1 255. _CNV_A_R_LINEAR_____0_CM 0. 255. DISPLAY_IDENTIFIER ID_ERR_ENVD_MAF_TPS_MON_1 FORMAT "%3.0"
 /begin AXIS_DESCR COM_AXIS online_dummy _CNV_A_R_LINEAR_____22_CM 4 0. 3. FORMAT "%2.0" AXIS_PTS_REF ldp_fmy_envd /end AXIS_DESCR
/end CHARACTERISTIC
/begin CHARACTERISTIC fmy_id_tq_dif_isc_mon_1.envd "" CURVE 0xffe42652 _REC_CUR_20_u1_u1 255. _CNV_A_R_LINEAR_____0_CM 0. 255. DISPLAY_IDENTIFIER ID_ERR_ENVD_TQ_DIF_ISC_MON_1 FORMAT "%3.0"
 /begin AXIS_DESCR COM_AXIS online_dummy _CNV_A_R_LINEAR_____22_CM 4 0. 3. FORMAT "%2.0" AXIS_PTS_REF ldp_fmy_envd /end AXIS_DESCR
/end CHARACTERISTIC
/begin CHARACTERISTIC fmy_id_tq_req_mon_1.envd "" CURVE 0xffe42664 _REC_CUR_20_u1_u1 255. _CNV_A_R_LINEAR_____0_CM 0. 255. DISPLAY_IDENTIFIER ID_ERR_ENVD_TQ_REQ_MON_1 FORMAT "%3.0"
 /begin AXIS_DESCR COM_AXIS online_dummy _CNV_A_R_LINEAR_____22_CM 4 0. 3. FORMAT "%2.0" AXIS_PTS_REF ldp_fmy_envd /end AXIS_DESCR
/end CHARACTERISTIC
/begin CHARACTERISTIC fmy_id_tq_ext_mon_1.envd "" CURVE 0xffe42676 _REC_CUR_20_u1_u1 255. _CNV_A_R_LINEAR_____0_CM 0. 255. DISPLAY_IDENTIFIER ID_ERR_ENVD_TQ_EXT_MON_1 FORMAT "%3.0"
 /begin AXIS_DESCR COM_AXIS online_dummy _CNV_A_R_LINEAR_____22_CM 4 0. 3. FORMAT "%2.0" AXIS_PTS_REF ldp_fmy_envd /end AXIS_DESCR
/end CHARACTERISTIC
/begin CHARACTERISTIC fmy_id_tqi_av_mon_1.envd "" CURVE 0xffe42688 _REC_CUR_20_u1_u1 255. _CNV_A_R_LINEAR_____0_CM 0. 255. DISPLAY_IDENTIFIER ID_ERR_ENVD_TQI_AV_MON_1 FORMAT "%3.0"
 /begin AXIS_DESCR COM_AXIS online_dummy _CNV_A_R_LINEAR_____22_CM 4 0. 3. FORMAT "%2.0" AXIS_PTS_REF ldp_fmy_envd /end AXIS_DESCR
/end CHARACTERISTIC
/begin CHARACTERISTIC fmy_id_tqi_n_max_mon_1.envd "" CURVE 0xffe4269a _REC_CUR_20_u1_u1 255. _CNV_A_R_LINEAR_____0_CM 0. 255. DISPLAY_IDENTIFIER ID_ERR_ENVD_TQI_N_MAX_MON_1 FORMAT "%3.0"
 /begin AXIS_DESCR COM_AXIS online_dummy _CNV_A_R_LINEAR_____22_CM 4 0. 3. FORMAT "%2.0" AXIS_PTS_REF ldp_fmy_envd /end AXIS_DESCR
/end CHARACTERISTIC
/begin CHARACTERISTIC fmy_id_cru_inh_mon_1.envd "" CURVE 0xffe426ac _REC_CUR_20_u1_u1 255. _CNV_A_R_LINEAR_____0_CM 0. 255. DISPLAY_IDENTIFIER ID_ERR_ENVD_CRU_INH_MON_1 FORMAT "%3.0"
 /begin AXIS_DESCR COM_AXIS online_dummy _CNV_A_R_LINEAR_____22_CM 4 0. 3. FORMAT "%2.0" AXIS_PTS_REF ldp_fmy_envd /end AXIS_DESCR
/end CHARACTERISTIC
/begin CHARACTERISTIC fmy_id_tqi_n_max_nvmy_mon.envd "" CURVE 0xffe426be _REC_CUR_20_u1_u1 255. _CNV_A_R_LINEAR_____0_CM 0. 255. DISPLAY_IDENTIFIER ID_ERR_ENVD_TQI_N_MAX_NVMY_MON FORMAT "%3.0"
 /begin AXIS_DESCR COM_AXIS online_dummy _CNV_A_R_LINEAR_____22_CM 4 0. 3. FORMAT "%2.0" AXIS_PTS_REF ldp_fmy_envd /end AXIS_DESCR
/end CHARACTERISTIC
/begin CHARACTERISTIC fmy_id_sa_safm.envd "" CURVE 0xffe426d0 _REC_CUR_20_u1_u1 255. _CNV_A_R_LINEAR_____0_CM 0. 255. DISPLAY_IDENTIFIER ID_ERR_ENVD_SA_SAFM FORMAT "%3.0"
 /begin AXIS_DESCR COM_AXIS online_dummy _CNV_A_R_LINEAR_____22_CM 4 0. 3. FORMAT "%2.0" AXIS_PTS_REF ldp_fmy_envd /end AXIS_DESCR
/end CHARACTERISTIC
/begin CHARACTERISTIC fmy_id_sa_sap.envd "" CURVE 0xffe426e2 _REC_CUR_20_u1_u1 255. _CNV_A_R_LINEAR_____0_CM 0. 255. DISPLAY_IDENTIFIER ID_ERR_ENVD_SA_SAP FORMAT "%3.0"
 /begin AXIS_DESCR COM_AXIS online_dummy _CNV_A_R_LINEAR_____22_CM 4 0. 3. FORMAT "%2.0" AXIS_PTS_REF ldp_fmy_envd /end AXIS_DESCR
/end CHARACTERISTIC
/begin CHARACTERISTIC fmy_id_sa_sys.envd "" CURVE 0xffe426f4 _REC_CUR_20_u1_u1 255. _CNV_A_R_LINEAR_____0_CM 0. 255. DISPLAY_IDENTIFIER ID_ERR_ENVD_SA_SYS FORMAT "%3.0"
 /begin AXIS_DESCR COM_AXIS online_dummy _CNV_A_R_LINEAR_____22_CM 4 0. 3. FORMAT "%2.0" AXIS_PTS_REF ldp_fmy_envd /end AXIS_DESCR
/end CHARACTERISTIC
/begin CHARACTERISTIC fmy_id_sa_sav.envd "" CURVE 0xffe42706 _REC_CUR_20_u1_u1 255. _CNV_A_R_LINEAR_____0_CM 0. 255. DISPLAY_IDENTIFIER ID_ERR_ENVD_SA_SAV FORMAT "%3.0"
 /begin AXIS_DESCR COM_AXIS online_dummy _CNV_A_R_LINEAR_____22_CM 4 0. 3. FORMAT "%2.0" AXIS_PTS_REF ldp_fmy_envd /end AXIS_DESCR
/end CHARACTERISTIC
/begin CHARACTERISTIC fmy_id_imob_1.envd "" CURVE 0xffe42718 _REC_CUR_20_u1_u1 255. _CNV_A_R_LINEAR_____0_CM 0. 255. DISPLAY_IDENTIFIER ID_ERR_ENVD_IMOB_1 FORMAT "%3.0"
 /begin AXIS_DESCR COM_AXIS online_dummy _CNV_A_R_LINEAR_____22_CM 4 0. 3. FORMAT "%2.0" AXIS_PTS_REF ldp_fmy_envd /end AXIS_DESCR
/end CHARACTERISTIC
/begin CHARACTERISTIC fmy_id_imob_2.envd "" CURVE 0xffe4272a _REC_CUR_20_u1_u1 255. _CNV_A_R_LINEAR_____0_CM 0. 255. DISPLAY_IDENTIFIER ID_ERR_ENVD_IMOB_2 FORMAT "%3.0"
 /begin AXIS_DESCR COM_AXIS online_dummy _CNV_A_R_LINEAR_____22_CM 4 0. 3. FORMAT "%2.0" AXIS_PTS_REF ldp_fmy_envd /end AXIS_DESCR
/end CHARACTERISTIC
/begin CHARACTERISTIC fmy_id_imob_3.envd "" CURVE 0xffe4273c _REC_CUR_20_u1_u1 255. _CNV_A_R_LINEAR_____0_CM 0. 255. DISPLAY_IDENTIFIER ID_ERR_ENVD_IMOB_3 FORMAT "%3.0"
 /begin AXIS_DESCR COM_AXIS online_dummy _CNV_A_R_LINEAR_____22_CM 4 0. 3. FORMAT "%2.0" AXIS_PTS_REF ldp_fmy_envd /end AXIS_DESCR
/end CHARACTERISTIC
/begin CHARACTERISTIC fmy_id_fsd_1.envd "" CURVE 0xffe4274e _REC_CUR_20_u1_u1 255. _CNV_A_R_LINEAR_____0_CM 0. 255. DISPLAY_IDENTIFIER ID_ERR_ENVD_FSD_1 FORMAT "%3.0"
 /begin AXIS_DESCR COM_AXIS online_dummy _CNV_A_R_LINEAR_____22_CM 4 0. 3. FORMAT "%2.0" AXIS_PTS_REF ldp_fmy_envd /end AXIS_DESCR
/end CHARACTERISTIC
/begin CHARACTERISTIC fmy_id_fsd_2.envd "" CURVE 0xffe42760 _REC_CUR_20_u1_u1 255. _CNV_A_R_LINEAR_____0_CM 0. 255. DISPLAY_IDENTIFIER ID_ERR_ENVD_FSD_2 FORMAT "%3.0"
 /begin AXIS_DESCR COM_AXIS online_dummy _CNV_A_R_LINEAR_____22_CM 4 0. 3. FORMAT "%2.0" AXIS_PTS_REF ldp_fmy_envd /end AXIS_DESCR
/end CHARACTERISTIC
/begin CHARACTERISTIC fmy_id_ls_down_swt_1.envd "" CURVE 0xffe42772 _REC_CUR_20_u1_u1 255. _CNV_A_R_LINEAR_____0_CM 0. 255. DISPLAY_IDENTIFIER ID_ERR_ENVD_LS_DOWN_SWT_1 FORMAT "%3.0"
 /begin AXIS_DESCR COM_AXIS online_dummy _CNV_A_R_LINEAR_____22_CM 4 0. 3. FORMAT "%2.0" AXIS_PTS_REF ldp_fmy_envd /end AXIS_DESCR
/end CHARACTERISTIC
/begin CHARACTERISTIC fmy_id_ls_down_swt_2.envd "" CURVE 0xffe42784 _REC_CUR_20_u1_u1 255. _CNV_A_R_LINEAR_____0_CM 0. 255. DISPLAY_IDENTIFIER ID_ERR_ENVD_LS_DOWN_SWT_2 FORMAT "%3.0"
 /begin AXIS_DESCR COM_AXIS online_dummy _CNV_A_R_LINEAR_____22_CM 4 0. 3. FORMAT "%2.0" AXIS_PTS_REF ldp_fmy_envd /end AXIS_DESCR
/end CHARACTERISTIC
/begin CHARACTERISTIC fmy_id_ls_down_pue_1.envd "" CURVE 0xffe42796 _REC_CUR_20_u1_u1 255. _CNV_A_R_LINEAR_____0_CM 0. 255. DISPLAY_IDENTIFIER ID_ERR_ENVD_LS_DOWN_PUE_1 FORMAT "%3.0"
 /begin AXIS_DESCR COM_AXIS online_dummy _CNV_A_R_LINEAR_____22_CM 4 0. 3. FORMAT "%2.0" AXIS_PTS_REF ldp_fmy_envd /end AXIS_DESCR
/end CHARACTERISTIC
/begin CHARACTERISTIC fmy_id_ls_down_pue_2.envd "" CURVE 0xffe427a8 _REC_CUR_20_u1_u1 255. _CNV_A_R_LINEAR_____0_CM 0. 255. DISPLAY_IDENTIFIER ID_ERR_ENVD_LS_DOWN_PUE_2 FORMAT "%3.0"
 /begin AXIS_DESCR COM_AXIS online_dummy _CNV_A_R_LINEAR_____22_CM 4 0. 3. FORMAT "%2.0" AXIS_PTS_REF ldp_fmy_envd /end AXIS_DESCR
/end CHARACTERISTIC
/begin CHARACTERISTIC fmy_id_ef.envd "" CURVE 0xffe427ba _REC_CUR_20_u1_u1 255. _CNV_A_R_LINEAR_____0_CM 0. 255. DISPLAY_IDENTIFIER ID_ERR_ENVD_EF FORMAT "%3.0"
 /begin AXIS_DESCR COM_AXIS online_dummy _CNV_A_R_LINEAR_____22_CM 4 0. 3. FORMAT "%2.0" AXIS_PTS_REF ldp_fmy_envd /end AXIS_DESCR
/end CHARACTERISTIC
/begin CHARACTERISTIC fmy_id_tecu.envd "" CURVE 0xffe427cc _REC_CUR_20_u1_u1 255. _CNV_A_R_LINEAR_____0_CM 0. 255. DISPLAY_IDENTIFIER ID_ERR_ENVD_TECU FORMAT "%3.0"
 /begin AXIS_DESCR COM_AXIS online_dummy _CNV_A_R_LINEAR_____22_CM 4 0. 3. FORMAT "%2.0" AXIS_PTS_REF ldp_fmy_envd /end AXIS_DESCR
/end CHARACTERISTIC
/begin CHARACTERISTIC fmy_id_ebox_cfa.envd "" CURVE 0xffe427de _REC_CUR_20_u1_u1 255. _CNV_A_R_LINEAR_____0_CM 0. 255. DISPLAY_IDENTIFIER ID_ERR_ENVD_EBOX_CFA FORMAT "%3.0"
 /begin AXIS_DESCR COM_AXIS online_dummy _CNV_A_R_LINEAR_____22_CM 4 0. 3. FORMAT "%2.0" AXIS_PTS_REF ldp_fmy_envd /end AXIS_DESCR
/end CHARACTERISTIC
/begin CHARACTERISTIC fmy_id_ecu_ram.envd "" CURVE 0xffe427f0 _REC_CUR_20_u1_u1 255. _CNV_A_R_LINEAR_____0_CM 0. 255. DISPLAY_IDENTIFIER ID_ERR_ENVD_ECU_RAM FORMAT "%3.0"
 /begin AXIS_DESCR COM_AXIS online_dummy _CNV_A_R_LINEAR_____22_CM 4 0. 3. FORMAT "%2.0" AXIS_PTS_REF ldp_fmy_envd /end AXIS_DESCR
/end CHARACTERISTIC
/begin CHARACTERISTIC fmy_id_tqi_lim.envd "" CURVE 0xffe42802 _REC_CUR_20_u1_u1 255. _CNV_A_R_LINEAR_____0_CM 0. 255. DISPLAY_IDENTIFIER ID_ERR_ENVD_TQI_LIM FORMAT "%3.0"
 /begin AXIS_DESCR COM_AXIS online_dummy _CNV_A_R_LINEAR_____22_CM 4 0. 3. FORMAT "%2.0" AXIS_PTS_REF ldp_fmy_envd /end AXIS_DESCR
/end CHARACTERISTIC
/begin CHARACTERISTIC fmy_id_obd2_lsh_down_1.envd "" CURVE 0xffe42814 _REC_CUR_20_u1_u1 255. _CNV_A_R_LINEAR_____0_CM 0. 255. DISPLAY_IDENTIFIER ID_ERR_ENVD_OBD2_LSH_DOWN_1 FORMAT "%3.0"
 /begin AXIS_DESCR COM_AXIS online_dummy _CNV_A_R_LINEAR_____22_CM 4 0. 3. FORMAT "%2.0" AXIS_PTS_REF ldp_fmy_envd /end AXIS_DESCR
/end CHARACTERISTIC
/begin CHARACTERISTIC fmy_id_obd2_lsh_down_2.envd "" CURVE 0xffe42826 _REC_CUR_20_u1_u1 255. _CNV_A_R_LINEAR_____0_CM 0. 255. DISPLAY_IDENTIFIER ID_ERR_ENVD_OBD2_LSH_DOWN_2 FORMAT "%3.0"
 /begin AXIS_DESCR COM_AXIS online_dummy _CNV_A_R_LINEAR_____22_CM 4 0. 3. FORMAT "%2.0" AXIS_PTS_REF ldp_fmy_envd /end AXIS_DESCR
/end CHARACTERISTIC
/begin CHARACTERISTIC fmy_id_dmtls.envd "" CURVE 0xffe42838 _REC_CUR_20_u1_u1 255. _CNV_A_R_LINEAR_____0_CM 0. 255. DISPLAY_IDENTIFIER ID_ERR_ENVD_DMTLS FORMAT "%3.0"
 /begin AXIS_DESCR COM_AXIS online_dummy _CNV_A_R_LINEAR_____22_CM 4 0. 3. FORMAT "%2.0" AXIS_PTS_REF ldp_fmy_envd /end AXIS_DESCR
/end CHARACTERISTIC
/begin CHARACTERISTIC fmy_id_dmtl_pump.envd "" CURVE 0xffe4284a _REC_CUR_20_u1_u1 255. _CNV_A_R_LINEAR_____0_CM 0. 255. DISPLAY_IDENTIFIER ID_ERR_ENVD_DMTL_PUMP FORMAT "%3.0"
 /begin AXIS_DESCR COM_AXIS online_dummy _CNV_A_R_LINEAR_____22_CM 4 0. 3. FORMAT "%2.0" AXIS_PTS_REF ldp_fmy_envd /end AXIS_DESCR
/end CHARACTERISTIC
/begin CHARACTERISTIC fmy_id_dmtlm.envd "" CURVE 0xffe4285c _REC_CUR_20_u1_u1 255. _CNV_A_R_LINEAR_____0_CM 0. 255. DISPLAY_IDENTIFIER ID_ERR_ENVD_DMTLM FORMAT "%3.0"
 /begin AXIS_DESCR COM_AXIS online_dummy _CNV_A_R_LINEAR_____22_CM 4 0. 3. FORMAT "%2.0" AXIS_PTS_REF ldp_fmy_envd /end AXIS_DESCR
/end CHARACTERISTIC
/begin CHARACTERISTIC fmy_id_dmtl_leak.envd "" CURVE 0xffe4286e _REC_CUR_20_u1_u1 255. _CNV_A_R_LINEAR_____0_CM 0. 255. DISPLAY_IDENTIFIER ID_ERR_ENVD_DMTL_LEAK FORMAT "%3.0"
 /begin AXIS_DESCR COM_AXIS online_dummy _CNV_A_R_LINEAR_____22_CM 4 0. 3. FORMAT "%2.0" AXIS_PTS_REF ldp_fmy_envd /end AXIS_DESCR
/end CHARACTERISTIC
/begin CHARACTERISTIC fmy_id_sof.envd "" CURVE 0xffe42880 _REC_CUR_20_u1_u1 255. _CNV_A_R_LINEAR_____0_CM 0. 255. DISPLAY_IDENTIFIER ID_ERR_ENVD_SOF FORMAT "%3.0"
 /begin AXIS_DESCR COM_AXIS online_dummy _CNV_A_R_LINEAR_____22_CM 4 0. 3. FORMAT "%2.0" AXIS_PTS_REF ldp_fmy_envd /end AXIS_DESCR
/end CHARACTERISTIC
/begin CHARACTERISTIC fmy_id_sof_req.envd "" CURVE 0xffe42892 _REC_CUR_20_u1_u1 255. _CNV_A_R_LINEAR_____0_CM 0. 255. DISPLAY_IDENTIFIER ID_ERR_ENVD_SOF_REQ FORMAT "%3.0"
 /begin AXIS_DESCR COM_AXIS online_dummy _CNV_A_R_LINEAR_____22_CM 4 0. 3. FORMAT "%2.0" AXIS_PTS_REF ldp_fmy_envd /end AXIS_DESCR
/end CHARACTERISTIC
/begin CHARACTERISTIC fmy_id_rly_st.envd "" CURVE 0xffe428a4 _REC_CUR_20_u1_u1 255. _CNV_A_R_LINEAR_____0_CM 0. 255. DISPLAY_IDENTIFIER ID_ERR_ENVD_RLY_ST FORMAT "%3.0"
 /begin AXIS_DESCR COM_AXIS online_dummy _CNV_A_R_LINEAR_____22_CM 4 0. 3. FORMAT "%2.0" AXIS_PTS_REF ldp_fmy_envd /end AXIS_DESCR
/end CHARACTERISTIC
/begin CHARACTERISTIC fmy_id_bsd.envd "" CURVE 0xffe428b6 _REC_CUR_20_u1_u1 255. _CNV_A_R_LINEAR_____0_CM 0. 255. DISPLAY_IDENTIFIER ID_ERR_ENVD_BSD FORMAT "%3.0"
 /begin AXIS_DESCR COM_AXIS online_dummy _CNV_A_R_LINEAR_____22_CM 4 0. 3. FORMAT "%2.0" AXIS_PTS_REF ldp_fmy_envd /end AXIS_DESCR
/end CHARACTERISTIC
/begin CHARACTERISTIC fmy_id_poil_swi.envd "" CURVE 0xffe428c8 _REC_CUR_20_u1_u1 255. _CNV_A_R_LINEAR_____0_CM 0. 255. DISPLAY_IDENTIFIER ID_ERR_ENVD_POIL_SWI FORMAT "%3.0"
 /begin AXIS_DESCR COM_AXIS online_dummy _CNV_A_R_LINEAR_____22_CM 4 0. 3. FORMAT "%2.0" AXIS_PTS_REF ldp_fmy_envd /end AXIS_DESCR
/end CHARACTERISTIC
/begin CHARACTERISTIC fmy_id_tout_efp.envd "" CURVE 0xffe428da _REC_CUR_20_u1_u1 255. _CNV_A_R_LINEAR_____0_CM 0. 255. DISPLAY_IDENTIFIER ID_ERR_ENVD_TOUT_EFP FORMAT "%3.0"
 /begin AXIS_DESCR COM_AXIS online_dummy _CNV_A_R_LINEAR_____22_CM 4 0. 3. FORMAT "%2.0" AXIS_PTS_REF ldp_fmy_envd /end AXIS_DESCR
/end CHARACTERISTIC
/begin CHARACTERISTIC fmy_id_diagcps.envd "" CURVE 0xffe428ec _REC_CUR_20_u1_u1 255. _CNV_A_R_LINEAR_____0_CM 0. 255. DISPLAY_IDENTIFIER ID_ERR_ENVD_DIAGCPS FORMAT "%3.0"
 /begin AXIS_DESCR COM_AXIS online_dummy _CNV_A_R_LINEAR_____22_CM 4 0. 3. FORMAT "%2.0" AXIS_PTS_REF ldp_fmy_envd /end AXIS_DESCR
/end CHARACTERISTIC
/begin CHARACTERISTIC fmy_id_tq_gs_inc_plaus.envd "" CURVE 0xffe428fe _REC_CUR_20_u1_u1 255. _CNV_A_R_LINEAR_____0_CM 0. 255. DISPLAY_IDENTIFIER ID_ERR_ENVD_TQ_GS_INC_PLAUS FORMAT "%3.0"
 /begin AXIS_DESCR COM_AXIS online_dummy _CNV_A_R_LINEAR_____22_CM 4 0. 3. FORMAT "%2.0" AXIS_PTS_REF ldp_fmy_envd /end AXIS_DESCR
/end CHARACTERISTIC
/begin CHARACTERISTIC fmy_id_dcc.envd "" CURVE 0xffe42910 _REC_CUR_20_u1_u1 255. _CNV_A_R_LINEAR_____0_CM 0. 255. DISPLAY_IDENTIFIER ID_ERR_ENVD_DCC FORMAT "%3.0"
 /begin AXIS_DESCR COM_AXIS online_dummy _CNV_A_R_LINEAR_____22_CM 4 0. 3. FORMAT "%2.0" AXIS_PTS_REF ldp_fmy_envd /end AXIS_DESCR
/end CHARACTERISTIC
/begin CHARACTERISTIC fmy_id_ecras.envd "" CURVE 0xffe42922 _REC_CUR_20_u1_u1 255. _CNV_A_R_LINEAR_____0_CM 0. 255. DISPLAY_IDENTIFIER ID_ERR_ENVD_ECRAS FORMAT "%3.0"
 /begin AXIS_DESCR COM_AXIS online_dummy _CNV_A_R_LINEAR_____22_CM 4 0. 3. FORMAT "%2.0" AXIS_PTS_REF ldp_fmy_envd /end AXIS_DESCR
/end CHARACTERISTIC
/begin CHARACTERISTIC fmy_id_dmtlh.envd "" CURVE 0xffe42934 _REC_CUR_20_u1_u1 255. _CNV_A_R_LINEAR_____0_CM 0. 255. DISPLAY_IDENTIFIER ID_ERR_ENVD_DMTLH FORMAT "%3.0"
 /begin AXIS_DESCR COM_AXIS online_dummy _CNV_A_R_LINEAR_____22_CM 4 0. 3. FORMAT "%2.0" AXIS_PTS_REF ldp_fmy_envd /end AXIS_DESCR
/end CHARACTERISTIC
/begin CHARACTERISTIC fmy_id_cs.envd "" CURVE 0xffe42946 _REC_CUR_20_u1_u1 255. _CNV_A_R_LINEAR_____0_CM 0. 255. DISPLAY_IDENTIFIER ID_ERR_ENVD_CS FORMAT "%3.0"
 /begin AXIS_DESCR COM_AXIS online_dummy _CNV_A_R_LINEAR_____22_CM 4 0. 3. FORMAT "%2.0" AXIS_PTS_REF ldp_fmy_envd /end AXIS_DESCR
/end CHARACTERISTIC
/begin CHARACTERISTIC fmy_id_spi_mps.envd "" CURVE 0xffe42958 _REC_CUR_20_u1_u1 255. _CNV_A_R_LINEAR_____0_CM 0. 255. DISPLAY_IDENTIFIER ID_ERR_ENVD_SPI_MPS FORMAT "%3.0"
 /begin AXIS_DESCR COM_AXIS online_dummy _CNV_A_R_LINEAR_____22_CM 4 0. 3. FORMAT "%2.0" AXIS_PTS_REF ldp_fmy_envd /end AXIS_DESCR
/end CHARACTERISTIC
/begin CHARACTERISTIC fmy_id_spi_knk.envd "" CURVE 0xffe4296a _REC_CUR_20_u1_u1 255. _CNV_A_R_LINEAR_____0_CM 0. 255. DISPLAY_IDENTIFIER ID_ERR_ENVD_SPI_KNK FORMAT "%3.0"
 /begin AXIS_DESCR COM_AXIS online_dummy _CNV_A_R_LINEAR_____22_CM 4 0. 3. FORMAT "%2.0" AXIS_PTS_REF ldp_fmy_envd /end AXIS_DESCR
/end CHARACTERISTIC
/begin CHARACTERISTIC fmy_id_bn_tq_dcc.envd "" CURVE 0xffe4297c _REC_CUR_20_u1_u1 255. _CNV_A_R_LINEAR_____0_CM 0. 255. DISPLAY_IDENTIFIER ID_ERR_ENVD_BN_TQ_DCC FORMAT "%3.0"
 /begin AXIS_DESCR COM_AXIS online_dummy _CNV_A_R_LINEAR_____22_CM 4 0. 3. FORMAT "%2.0" AXIS_PTS_REF ldp_fmy_envd /end AXIS_DESCR
/end CHARACTERISTIC
/begin CHARACTERISTIC fmy_id_bn_tq_pste_2.envd "" CURVE 0xffe4298e _REC_CUR_20_u1_u1 255. _CNV_A_R_LINEAR_____0_CM 0. 255. DISPLAY_IDENTIFIER ID_ERR_ENVD_BN_TQ_PSTE_2 FORMAT "%3.0"
 /begin AXIS_DESCR COM_AXIS online_dummy _CNV_A_R_LINEAR_____22_CM 4 0. 3. FORMAT "%2.0" AXIS_PTS_REF ldp_fmy_envd /end AXIS_DESCR
/end CHARACTERISTIC
/begin CHARACTERISTIC fmy_id_bn_ars.envd "" CURVE 0xffe429a0 _REC_CUR_20_u1_u1 255. _CNV_A_R_LINEAR_____0_CM 0. 255. DISPLAY_IDENTIFIER ID_ERR_ENVD_BN_ARS FORMAT "%3.0"
 /begin AXIS_DESCR COM_AXIS online_dummy _CNV_A_R_LINEAR_____22_CM 4 0. 3. FORMAT "%2.0" AXIS_PTS_REF ldp_fmy_envd /end AXIS_DESCR
/end CHARACTERISTIC
/begin CHARACTERISTIC fmy_id_bn_cas.envd "" CURVE 0xffe429b2 _REC_CUR_20_u1_u1 255. _CNV_A_R_LINEAR_____0_CM 0. 255. DISPLAY_IDENTIFIER ID_ERR_ENVD_BN_CAS FORMAT "%3.0"
 /begin AXIS_DESCR COM_AXIS online_dummy _CNV_A_R_LINEAR_____22_CM 4 0. 3. FORMAT "%2.0" AXIS_PTS_REF ldp_fmy_envd /end AXIS_DESCR
/end CHARACTERISTIC
/begin CHARACTERISTIC fmy_id_bn_tq_tcs.envd "" CURVE 0xffe429c4 _REC_CUR_20_u1_u1 255. _CNV_A_R_LINEAR_____0_CM 0. 255. DISPLAY_IDENTIFIER ID_ERR_ENVD_BN_TQ_TCS FORMAT "%3.0"
 /begin AXIS_DESCR COM_AXIS online_dummy _CNV_A_R_LINEAR_____22_CM 4 0. 3. FORMAT "%2.0" AXIS_PTS_REF ldp_fmy_envd /end AXIS_DESCR
/end CHARACTERISTIC
/begin CHARACTERISTIC fmy_id_bn_vs_tcs.envd "" CURVE 0xffe429d6 _REC_CUR_20_u1_u1 255. _CNV_A_R_LINEAR_____0_CM 0. 255. DISPLAY_IDENTIFIER ID_ERR_ENVD_BN_VS_TCS FORMAT "%3.0"
 /begin AXIS_DESCR COM_AXIS online_dummy _CNV_A_R_LINEAR_____22_CM 4 0. 3. FORMAT "%2.0" AXIS_PTS_REF ldp_fmy_envd /end AXIS_DESCR
/end CHARACTERISTIC
/begin CHARACTERISTIC fmy_id_bn_tcs.envd "" CURVE 0xffe429e8 _REC_CUR_20_u1_u1 255. _CNV_A_R_LINEAR_____0_CM 0. 255. DISPLAY_IDENTIFIER ID_ERR_ENVD_BN_TCS FORMAT "%3.0"
 /begin AXIS_DESCR COM_AXIS online_dummy _CNV_A_R_LINEAR_____22_CM 4 0. 3. FORMAT "%2.0" AXIS_PTS_REF ldp_fmy_envd /end AXIS_DESCR
/end CHARACTERISTIC
/begin CHARACTERISTIC fmy_id_bn_tq_etcu.envd "" CURVE 0xffe429fa _REC_CUR_20_u1_u1 255. _CNV_A_R_LINEAR_____0_CM 0. 255. DISPLAY_IDENTIFIER ID_ERR_ENVD_BN_TQ_ETCU FORMAT "%3.0"
 /begin AXIS_DESCR COM_AXIS online_dummy _CNV_A_R_LINEAR_____22_CM 4 0. 3. FORMAT "%2.0" AXIS_PTS_REF ldp_fmy_envd /end AXIS_DESCR
/end CHARACTERISTIC
/begin CHARACTERISTIC fmy_id_bn_etcu.envd "" CURVE 0xffe42a0c _REC_CUR_20_u1_u1 255. _CNV_A_R_LINEAR_____0_CM 0. 255. DISPLAY_IDENTIFIER ID_ERR_ENVD_BN_ETCU FORMAT "%3.0"
 /begin AXIS_DESCR COM_AXIS online_dummy _CNV_A_R_LINEAR_____22_CM 4 0. 3. FORMAT "%2.0" AXIS_PTS_REF ldp_fmy_envd /end AXIS_DESCR
/end CHARACTERISTIC
/begin CHARACTERISTIC fmy_id_bn_tq_amt.envd "" CURVE 0xffe42a1e _REC_CUR_20_u1_u1 255. _CNV_A_R_LINEAR_____0_CM 0. 255. DISPLAY_IDENTIFIER ID_ERR_ENVD_BN_TQ_AMT FORMAT "%3.0"
 /begin AXIS_DESCR COM_AXIS online_dummy _CNV_A_R_LINEAR_____22_CM 4 0. 3. FORMAT "%2.0" AXIS_PTS_REF ldp_fmy_envd /end AXIS_DESCR
/end CHARACTERISTIC
/begin CHARACTERISTIC fmy_id_bn_acc.envd "" CURVE 0xffe42a30 _REC_CUR_20_u1_u1 255. _CNV_A_R_LINEAR_____0_CM 0. 255. DISPLAY_IDENTIFIER ID_ERR_ENVD_BN_ACC FORMAT "%3.0"
 /begin AXIS_DESCR COM_AXIS online_dummy _CNV_A_R_LINEAR_____22_CM 4 0. 3. FORMAT "%2.0" AXIS_PTS_REF ldp_fmy_envd /end AXIS_DESCR
/end CHARACTERISTIC
/begin CHARACTERISTIC fmy_id_bn_t_icl.envd "" CURVE 0xffe42a42 _REC_CUR_20_u1_u1 255. _CNV_A_R_LINEAR_____0_CM 0. 255. DISPLAY_IDENTIFIER ID_ERR_ENVD_BN_T_ICL FORMAT "%3.0"
 /begin AXIS_DESCR COM_AXIS online_dummy _CNV_A_R_LINEAR_____22_CM 4 0. 3. FORMAT "%2.0" AXIS_PTS_REF ldp_fmy_envd /end AXIS_DESCR
/end CHARACTERISTIC
/begin CHARACTERISTIC fmy_id_bn_veh_mod.envd "" CURVE 0xffe42a54 _REC_CUR_20_u1_u1 255. _CNV_A_R_LINEAR_____0_CM 0. 255. DISPLAY_IDENTIFIER ID_ERR_ENVD_BN_VEH_MOD FORMAT "%3.0"
 /begin AXIS_DESCR COM_AXIS online_dummy _CNV_A_R_LINEAR_____22_CM 4 0. 3. FORMAT "%2.0" AXIS_PTS_REF ldp_fmy_envd /end AXIS_DESCR
/end CHARACTERISTIC
/begin CHARACTERISTIC fmy_id_bn_km_icl.envd "" CURVE 0xffe42a66 _REC_CUR_20_u1_u1 255. _CNV_A_R_LINEAR_____0_CM 0. 255. DISPLAY_IDENTIFIER ID_ERR_ENVD_BN_KM_ICL FORMAT "%3.0"
 /begin AXIS_DESCR COM_AXIS online_dummy _CNV_A_R_LINEAR_____22_CM 4 0. 3. FORMAT "%2.0" AXIS_PTS_REF ldp_fmy_envd /end AXIS_DESCR
/end CHARACTERISTIC
/begin CHARACTERISTIC fmy_id_bn_icl.envd "" CURVE 0xffe42a78 _REC_CUR_20_u1_u1 255. _CNV_A_R_LINEAR_____0_CM 0. 255. DISPLAY_IDENTIFIER ID_ERR_ENVD_BN_ICL FORMAT "%3.0"
 /begin AXIS_DESCR COM_AXIS online_dummy _CNV_A_R_LINEAR_____22_CM 4 0. 3. FORMAT "%2.0" AXIS_PTS_REF ldp_fmy_envd /end AXIS_DESCR
/end CHARACTERISTIC
/begin CHARACTERISTIC fmy_id_bn_pow_vb.envd "" CURVE 0xffe42a8a _REC_CUR_20_u1_u1 255. _CNV_A_R_LINEAR_____0_CM 0. 255. DISPLAY_IDENTIFIER ID_ERR_ENVD_BN_POW_VB FORMAT "%3.0"
 /begin AXIS_DESCR COM_AXIS online_dummy _CNV_A_R_LINEAR_____22_CM 4 0. 3. FORMAT "%2.0" AXIS_PTS_REF ldp_fmy_envd /end AXIS_DESCR
/end CHARACTERISTIC
/begin CHARACTERISTIC fmy_id_bn_pow_gen.envd "" CURVE 0xffe42a9c _REC_CUR_20_u1_u1 255. _CNV_A_R_LINEAR_____0_CM 0. 255. DISPLAY_IDENTIFIER ID_ERR_ENVD_BN_POW_GEN FORMAT "%3.0"
 /begin AXIS_DESCR COM_AXIS online_dummy _CNV_A_R_LINEAR_____22_CM 4 0. 3. FORMAT "%2.0" AXIS_PTS_REF ldp_fmy_envd /end AXIS_DESCR
/end CHARACTERISTIC
/begin CHARACTERISTIC fmy_id_bn_msw.envd "" CURVE 0xffe42aae _REC_CUR_20_u1_u1 255. _CNV_A_R_LINEAR_____0_CM 0. 255. DISPLAY_IDENTIFIER ID_ERR_ENVD_BN_MSW FORMAT "%3.0"
 /begin AXIS_DESCR COM_AXIS online_dummy _CNV_A_R_LINEAR_____22_CM 4 0. 3. FORMAT "%2.0" AXIS_PTS_REF ldp_fmy_envd /end AXIS_DESCR
/end CHARACTERISTIC
/begin CHARACTERISTIC fmy_id_bn_ang_pste.envd "" CURVE 0xffe42ac0 _REC_CUR_20_u1_u1 255. _CNV_A_R_LINEAR_____0_CM 0. 255. DISPLAY_IDENTIFIER ID_ERR_ENVD_BN_ANG_PSTE FORMAT "%3.0"
 /begin AXIS_DESCR COM_AXIS online_dummy _CNV_A_R_LINEAR_____22_CM 4 0. 3. FORMAT "%2.0" AXIS_PTS_REF ldp_fmy_envd /end AXIS_DESCR
/end CHARACTERISTIC
/begin CHARACTERISTIC fmy_id_bn_efp.envd "" CURVE 0xffe42ad2 _REC_CUR_20_u1_u1 255. _CNV_A_R_LINEAR_____0_CM 0. 255. DISPLAY_IDENTIFIER ID_ERR_ENVD_BN_EFP FORMAT "%3.0"
 /begin AXIS_DESCR COM_AXIS online_dummy _CNV_A_R_LINEAR_____22_CM 4 0. 3. FORMAT "%2.0" AXIS_PTS_REF ldp_fmy_envd /end AXIS_DESCR
/end CHARACTERISTIC
/begin CHARACTERISTIC fmy_id_load_tps_plaus.envd "" CURVE 0xffe42ae4 _REC_CUR_20_u1_u1 255. _CNV_A_R_LINEAR_____0_CM 0. 255. DISPLAY_IDENTIFIER ID_ERR_ENVD_LOAD_TPS_PLAUS FORMAT "%3.0"
 /begin AXIS_DESCR COM_AXIS online_dummy _CNV_A_R_LINEAR_____22_CM 4 0. 3. FORMAT "%2.0" AXIS_PTS_REF ldp_fmy_envd /end AXIS_DESCR
/end CHARACTERISTIC
/begin CHARACTERISTIC fmy_id_efp_crash.envd "" CURVE 0xffe42af6 _REC_CUR_20_u1_u1 255. _CNV_A_R_LINEAR_____0_CM 0. 255. DISPLAY_IDENTIFIER ID_ERR_ENVD_EFP_CRASH FORMAT "%3.0"
 /begin AXIS_DESCR COM_AXIS online_dummy _CNV_A_R_LINEAR_____22_CM 4 0. 3. FORMAT "%2.0" AXIS_PTS_REF ldp_fmy_envd /end AXIS_DESCR
/end CHARACTERISTIC
/begin CHARACTERISTIC fmy_id_efp.envd "" CURVE 0xffe42b08 _REC_CUR_20_u1_u1 255. _CNV_A_R_LINEAR_____0_CM 0. 255. DISPLAY_IDENTIFIER ID_ERR_ENVD_EFP FORMAT "%3.0"
 /begin AXIS_DESCR COM_AXIS online_dummy _CNV_A_R_LINEAR_____22_CM 4 0. 3. FORMAT "%2.0" AXIS_PTS_REF ldp_fmy_envd /end AXIS_DESCR
/end CHARACTERISTIC
/begin CHARACTERISTIC fmy_id_locan_boff.envd "" CURVE 0xffe42b1a _REC_CUR_20_u1_u1 255. _CNV_A_R_LINEAR_____0_CM 0. 255. DISPLAY_IDENTIFIER ID_ERR_ENVD_LOCAN_BOFF FORMAT "%3.0"
 /begin AXIS_DESCR COM_AXIS online_dummy _CNV_A_R_LINEAR_____22_CM 4 0. 3. FORMAT "%2.0" AXIS_PTS_REF ldp_fmy_envd /end AXIS_DESCR
/end CHARACTERISTIC
/begin CHARACTERISTIC fmy_id_chg_ls_up.envd "" CURVE 0xffe42b2c _REC_CUR_20_u1_u1 255. _CNV_A_R_LINEAR_____0_CM 0. 255. DISPLAY_IDENTIFIER ID_ERR_ENVD_CHG_LS_UP FORMAT "%3.0"
 /begin AXIS_DESCR COM_AXIS online_dummy _CNV_A_R_LINEAR_____22_CM 4 0. 3. FORMAT "%2.0" AXIS_PTS_REF ldp_fmy_envd /end AXIS_DESCR
/end CHARACTERISTIC
/begin CHARACTERISTIC fmy_id_chg_ls_down.envd "" CURVE 0xffe42b3e _REC_CUR_20_u1_u1 255. _CNV_A_R_LINEAR_____0_CM 0. 255. DISPLAY_IDENTIFIER ID_ERR_ENVD_CHG_LS_DOWN FORMAT "%3.0"
 /begin AXIS_DESCR COM_AXIS online_dummy _CNV_A_R_LINEAR_____22_CM 4 0. 3. FORMAT "%2.0" AXIS_PTS_REF ldp_fmy_envd /end AXIS_DESCR
/end CHARACTERISTIC
/begin CHARACTERISTIC fmy_id_qoil_sens.envd "" CURVE 0xffe42b50 _REC_CUR_20_u1_u1 255. _CNV_A_R_LINEAR_____0_CM 0. 255. DISPLAY_IDENTIFIER ID_ERR_ENVD_QOIL_SENS FORMAT "%3.0"
 /begin AXIS_DESCR COM_AXIS online_dummy _CNV_A_R_LINEAR_____22_CM 4 0. 3. FORMAT "%2.0" AXIS_PTS_REF ldp_fmy_envd /end AXIS_DESCR
/end CHARACTERISTIC
/begin CHARACTERISTIC fmy_id_bat_sens.envd "" CURVE 0xffe42b62 _REC_CUR_20_u1_u1 255. _CNV_A_R_LINEAR_____0_CM 0. 255. DISPLAY_IDENTIFIER ID_ERR_ENVD_BAT_SENS FORMAT "%3.0"
 /begin AXIS_DESCR COM_AXIS online_dummy _CNV_A_R_LINEAR_____22_CM 4 0. 3. FORMAT "%2.0" AXIS_PTS_REF ldp_fmy_envd /end AXIS_DESCR
/end CHARACTERISTIC
/begin CHARACTERISTIC fmy_id_bat_sens_it.envd "" CURVE 0xffe42b74 _REC_CUR_20_u1_u1 255. _CNV_A_R_LINEAR_____0_CM 0. 255. DISPLAY_IDENTIFIER ID_ERR_ENVD_BAT_SENS_IT FORMAT "%3.0"
 /begin AXIS_DESCR COM_AXIS online_dummy _CNV_A_R_LINEAR_____22_CM 4 0. 3. FORMAT "%2.0" AXIS_PTS_REF ldp_fmy_envd /end AXIS_DESCR
/end CHARACTERISTIC
/begin CHARACTERISTIC fmy_id_bat_sens_it_el.envd "" CURVE 0xffe42b86 _REC_CUR_20_u1_u1 255. _CNV_A_R_LINEAR_____0_CM 0. 255. DISPLAY_IDENTIFIER ID_ERR_ENVD_BAT_SENS_IT_EL FORMAT "%3.0"
 /begin AXIS_DESCR COM_AXIS online_dummy _CNV_A_R_LINEAR_____22_CM 4 0. 3. FORMAT "%2.0" AXIS_PTS_REF ldp_fmy_envd /end AXIS_DESCR
/end CHARACTERISTIC
/begin CHARACTERISTIC fmy_id_ecu_nvmy.envd "" CURVE 0xffe42b98 _REC_CUR_20_u1_u1 255. _CNV_A_R_LINEAR_____0_CM 0. 255. DISPLAY_IDENTIFIER ID_ERR_ENVD_ECU_NVMY FORMAT "%3.0"
 /begin AXIS_DESCR COM_AXIS online_dummy _CNV_A_R_LINEAR_____22_CM 4 0. 3. FORMAT "%2.0" AXIS_PTS_REF ldp_fmy_envd /end AXIS_DESCR
/end CHARACTERISTIC
/begin CHARACTERISTIC fmy_id_gs.envd "" CURVE 0xffe42baa _REC_CUR_20_u1_u1 255. _CNV_A_R_LINEAR_____0_CM 0. 255. DISPLAY_IDENTIFIER ID_ERR_ENVD_GS FORMAT "%3.0"
 /begin AXIS_DESCR COM_AXIS online_dummy _CNV_A_R_LINEAR_____22_CM 4 0. 3. FORMAT "%2.0" AXIS_PTS_REF ldp_fmy_envd /end AXIS_DESCR
/end CHARACTERISTIC
/begin CHARACTERISTIC fmy_id_o3_conc.envd "" CURVE 0xffe42bbc _REC_CUR_20_u1_u1 255. _CNV_A_R_LINEAR_____0_CM 0. 255. DISPLAY_IDENTIFIER ID_ERR_ENVD_O3_CONC FORMAT "%3.0"
 /begin AXIS_DESCR COM_AXIS online_dummy _CNV_A_R_LINEAR_____22_CM 4 0. 3. FORMAT "%2.0" AXIS_PTS_REF ldp_fmy_envd /end AXIS_DESCR
/end CHARACTERISTIC
/begin CHARACTERISTIC fmy_id_ls_up_shift_afl_1.envd "" CURVE 0xffe42bce _REC_CUR_20_u1_u1 255. _CNV_A_R_LINEAR_____0_CM 0. 255. DISPLAY_IDENTIFIER ID_ERR_ENVD_LS_UP_SHIFT_AFL_1 FORMAT "%3.0"
 /begin AXIS_DESCR COM_AXIS online_dummy _CNV_A_R_LINEAR_____22_CM 4 0. 3. FORMAT "%2.0" AXIS_PTS_REF ldp_fmy_envd /end AXIS_DESCR
/end CHARACTERISTIC
/begin CHARACTERISTIC fmy_id_ls_up_shift_afl_2.envd "" CURVE 0xffe42be0 _REC_CUR_20_u1_u1 255. _CNV_A_R_LINEAR_____0_CM 0. 255. DISPLAY_IDENTIFIER ID_ERR_ENVD_LS_UP_SHIFT_AFL_2 FORMAT "%3.0"
 /begin AXIS_DESCR COM_AXIS online_dummy _CNV_A_R_LINEAR_____22_CM 4 0. 3. FORMAT "%2.0" AXIS_PTS_REF ldp_fmy_envd /end AXIS_DESCR
/end CHARACTERISTIC
/begin CHARACTERISTIC fmy_id_ls_up_shift_afr_1.envd "" CURVE 0xffe42bf2 _REC_CUR_20_u1_u1 255. _CNV_A_R_LINEAR_____0_CM 0. 255. DISPLAY_IDENTIFIER ID_ERR_ENVD_LS_UP_SHIFT_AFR_1 FORMAT "%3.0"
 /begin AXIS_DESCR COM_AXIS online_dummy _CNV_A_R_LINEAR_____22_CM 4 0. 3. FORMAT "%2.0" AXIS_PTS_REF ldp_fmy_envd /end AXIS_DESCR
/end CHARACTERISTIC
/begin CHARACTERISTIC fmy_id_ls_up_shift_afr_2.envd "" CURVE 0xffe42c04 _REC_CUR_20_u1_u1 255. _CNV_A_R_LINEAR_____0_CM 0. 255. DISPLAY_IDENTIFIER ID_ERR_ENVD_LS_UP_SHIFT_AFR_2 FORMAT "%3.0"
 /begin AXIS_DESCR COM_AXIS online_dummy _CNV_A_R_LINEAR_____22_CM 4 0. 3. FORMAT "%2.0" AXIS_PTS_REF ldp_fmy_envd /end AXIS_DESCR
/end CHARACTERISTIC
/begin CHARACTERISTIC fmy_id_oc_lsl_1.envd "" CURVE 0xffe42c16 _REC_CUR_20_u1_u1 255. _CNV_A_R_LINEAR_____0_CM 0. 255. DISPLAY_IDENTIFIER ID_ERR_ENVD_OC_LSL_1 FORMAT "%3.0"
 /begin AXIS_DESCR COM_AXIS online_dummy _CNV_A_R_LINEAR_____22_CM 4 0. 3. FORMAT "%2.0" AXIS_PTS_REF ldp_fmy_envd /end AXIS_DESCR
/end CHARACTERISTIC
/begin CHARACTERISTIC fmy_id_oc_lsl_2.envd "" CURVE 0xffe42c28 _REC_CUR_20_u1_u1 255. _CNV_A_R_LINEAR_____0_CM 0. 255. DISPLAY_IDENTIFIER ID_ERR_ENVD_OC_LSL_2 FORMAT "%3.0"
 /begin AXIS_DESCR COM_AXIS online_dummy _CNV_A_R_LINEAR_____22_CM 4 0. 3. FORMAT "%2.0" AXIS_PTS_REF ldp_fmy_envd /end AXIS_DESCR
/end CHARACTERISTIC
/begin CHARACTERISTIC fmy_id_cat_diag_1.envd "" CURVE 0xffe42c3a _REC_CUR_20_u1_u1 255. _CNV_A_R_LINEAR_____0_CM 0. 255. DISPLAY_IDENTIFIER ID_ERR_ENVD_CAT_DIAG_1 FORMAT "%3.0"
 /begin AXIS_DESCR COM_AXIS online_dummy _CNV_A_R_LINEAR_____22_CM 4 0. 3. FORMAT "%2.0" AXIS_PTS_REF ldp_fmy_envd /end AXIS_DESCR
/end CHARACTERISTIC
/begin CHARACTERISTIC fmy_id_cat_diag_2.envd "" CURVE 0xffe42c4c _REC_CUR_20_u1_u1 255. _CNV_A_R_LINEAR_____0_CM 0. 255. DISPLAY_IDENTIFIER ID_ERR_ENVD_CAT_DIAG_2 FORMAT "%3.0"
 /begin AXIS_DESCR COM_AXIS online_dummy _CNV_A_R_LINEAR_____22_CM 4 0. 3. FORMAT "%2.0" AXIS_PTS_REF ldp_fmy_envd /end AXIS_DESCR
/end CHARACTERISTIC
/begin CHARACTERISTIC fmy_id_el_lsl_1.envd "" CURVE 0xffe42c5e _REC_CUR_20_u1_u1 255. _CNV_A_R_LINEAR_____0_CM 0. 255. DISPLAY_IDENTIFIER ID_ERR_ENVD_EL_LSL_1 FORMAT "%3.0"
 /begin AXIS_DESCR COM_AXIS online_dummy _CNV_A_R_LINEAR_____22_CM 4 0. 3. FORMAT "%2.0" AXIS_PTS_REF ldp_fmy_envd /end AXIS_DESCR
/end CHARACTERISTIC
/begin CHARACTERISTIC fmy_id_el_lsl_2.envd "" CURVE 0xffe42c70 _REC_CUR_20_u1_u1 255. _CNV_A_R_LINEAR_____0_CM 0. 255. DISPLAY_IDENTIFIER ID_ERR_ENVD_EL_LSL_2 FORMAT "%3.0"
 /begin AXIS_DESCR COM_AXIS online_dummy _CNV_A_R_LINEAR_____22_CM 4 0. 3. FORMAT "%2.0" AXIS_PTS_REF ldp_fmy_envd /end AXIS_DESCR
/end CHARACTERISTIC
/begin CHARACTERISTIC fmy_id_cat_diag_nox_1.envd "" CURVE 0xffe42c82 _REC_CUR_20_u1_u1 255. _CNV_A_R_LINEAR_____0_CM 0. 255. DISPLAY_IDENTIFIER ID_ERR_ENVD_CAT_DIAG_NOX_1 FORMAT "%3.0"
 /begin AXIS_DESCR COM_AXIS online_dummy _CNV_A_R_LINEAR_____22_CM 4 0. 3. FORMAT "%2.0" AXIS_PTS_REF ldp_fmy_envd /end AXIS_DESCR
/end CHARACTERISTIC
/begin CHARACTERISTIC fmy_id_cat_diag_nox_2.envd "" CURVE 0xffe42c94 _REC_CUR_20_u1_u1 255. _CNV_A_R_LINEAR_____0_CM 0. 255. DISPLAY_IDENTIFIER ID_ERR_ENVD_CAT_DIAG_NOX_2 FORMAT "%3.0"
 /begin AXIS_DESCR COM_AXIS online_dummy _CNV_A_R_LINEAR_____22_CM 4 0. 3. FORMAT "%2.0" AXIS_PTS_REF ldp_fmy_envd /end AXIS_DESCR
/end CHARACTERISTIC
/begin CHARACTERISTIC fmy_id_vls_down_puc_1.envd "" CURVE 0xffe42ca6 _REC_CUR_20_u1_u1 255. _CNV_A_R_LINEAR_____0_CM 0. 255. DISPLAY_IDENTIFIER ID_ERR_ENVD_VLS_DOWN_PUC_1 FORMAT "%3.0"
 /begin AXIS_DESCR COM_AXIS online_dummy _CNV_A_R_LINEAR_____22_CM 4 0. 3. FORMAT "%2.0" AXIS_PTS_REF ldp_fmy_envd /end AXIS_DESCR
/end CHARACTERISTIC
/begin CHARACTERISTIC fmy_id_vls_down_puc_2.envd "" CURVE 0xffe42cb8 _REC_CUR_20_u1_u1 255. _CNV_A_R_LINEAR_____0_CM 0. 255. DISPLAY_IDENTIFIER ID_ERR_ENVD_VLS_DOWN_PUC_2 FORMAT "%3.0"
 /begin AXIS_DESCR COM_AXIS online_dummy _CNV_A_R_LINEAR_____22_CM 4 0. 3. FORMAT "%2.0" AXIS_PTS_REF ldp_fmy_envd /end AXIS_DESCR
/end CHARACTERISTIC
/begin CHARACTERISTIC fmy_id_vls_down_fl_1.envd "" CURVE 0xffe42cca _REC_CUR_20_u1_u1 255. _CNV_A_R_LINEAR_____0_CM 0. 255. DISPLAY_IDENTIFIER ID_ERR_ENVD_VLS_DOWN_FL_1 FORMAT "%3.0"
 /begin AXIS_DESCR COM_AXIS online_dummy _CNV_A_R_LINEAR_____22_CM 4 0. 3. FORMAT "%2.0" AXIS_PTS_REF ldp_fmy_envd /end AXIS_DESCR
/end CHARACTERISTIC
/begin CHARACTERISTIC fmy_id_vls_down_fl_2.envd "" CURVE 0xffe42cdc _REC_CUR_20_u1_u1 255. _CNV_A_R_LINEAR_____0_CM 0. 255. DISPLAY_IDENTIFIER ID_ERR_ENVD_VLS_DOWN_FL_2 FORMAT "%3.0"
 /begin AXIS_DESCR COM_AXIS online_dummy _CNV_A_R_LINEAR_____22_CM 4 0. 3. FORMAT "%2.0" AXIS_PTS_REF ldp_fmy_envd /end AXIS_DESCR
/end CHARACTERISTIC
/begin CHARACTERISTIC fmy_id_chk_ls_down_1.envd "" CURVE 0xffe42cee _REC_CUR_20_u1_u1 255. _CNV_A_R_LINEAR_____0_CM 0. 255. DISPLAY_IDENTIFIER ID_ERR_ENVD_CHK_LS_DOWN_1 FORMAT "%3.0"
 /begin AXIS_DESCR COM_AXIS online_dummy _CNV_A_R_LINEAR_____22_CM 4 0. 3. FORMAT "%2.0" AXIS_PTS_REF ldp_fmy_envd /end AXIS_DESCR
/end CHARACTERISTIC
/begin CHARACTERISTIC fmy_id_chk_ls_down_2.envd "" CURVE 0xffe42d00 _REC_CUR_20_u1_u1 255. _CNV_A_R_LINEAR_____0_CM 0. 255. DISPLAY_IDENTIFIER ID_ERR_ENVD_CHK_LS_DOWN_2 FORMAT "%3.0"
 /begin AXIS_DESCR COM_AXIS online_dummy _CNV_A_R_LINEAR_____22_CM 4 0. 3. FORMAT "%2.0" AXIS_PTS_REF ldp_fmy_envd /end AXIS_DESCR
/end CHARACTERISTIC
/begin CHARACTERISTIC fmy_id_delta_lamb_i_1.envd "" CURVE 0xffe42d12 _REC_CUR_20_u1_u1 255. _CNV_A_R_LINEAR_____0_CM 0. 255. DISPLAY_IDENTIFIER ID_ERR_ENVD_DELTA_LAMB_I_1 FORMAT "%3.0"
 /begin AXIS_DESCR COM_AXIS online_dummy _CNV_A_R_LINEAR_____22_CM 4 0. 3. FORMAT "%2.0" AXIS_PTS_REF ldp_fmy_envd /end AXIS_DESCR
/end CHARACTERISTIC
/begin CHARACTERISTIC fmy_id_delta_lamb_i_2.envd "" CURVE 0xffe42d24 _REC_CUR_20_u1_u1 255. _CNV_A_R_LINEAR_____0_CM 0. 255. DISPLAY_IDENTIFIER ID_ERR_ENVD_DELTA_LAMB_I_2 FORMAT "%3.0"
 /begin AXIS_DESCR COM_AXIS online_dummy _CNV_A_R_LINEAR_____22_CM 4 0. 3. FORMAT "%2.0" AXIS_PTS_REF ldp_fmy_envd /end AXIS_DESCR
/end CHARACTERISTIC
/begin CHARACTERISTIC fmy_id_o3_up.envd "" CURVE 0xffe42d36 _REC_CUR_20_u1_u1 255. _CNV_A_R_LINEAR_____0_CM 0. 255. DISPLAY_IDENTIFIER ID_ERR_ENVD_O3_UP FORMAT "%3.0"
 /begin AXIS_DESCR COM_AXIS online_dummy _CNV_A_R_LINEAR_____22_CM 4 0. 3. FORMAT "%2.0" AXIS_PTS_REF ldp_fmy_envd /end AXIS_DESCR
/end CHARACTERISTIC
/begin CHARACTERISTIC fmy_id_o3_down.envd "" CURVE 0xffe42d48 _REC_CUR_20_u1_u1 255. _CNV_A_R_LINEAR_____0_CM 0. 255. DISPLAY_IDENTIFIER ID_ERR_ENVD_O3_DOWN FORMAT "%3.0"
 /begin AXIS_DESCR COM_AXIS online_dummy _CNV_A_R_LINEAR_____22_CM 4 0. 3. FORMAT "%2.0" AXIS_PTS_REF ldp_fmy_envd /end AXIS_DESCR
/end CHARACTERISTIC
/begin CHARACTERISTIC fmy_id_obd2_ttip_ls_up_1.envd "" CURVE 0xffe42d5a _REC_CUR_20_u1_u1 255. _CNV_A_R_LINEAR_____0_CM 0. 255. DISPLAY_IDENTIFIER ID_ERR_ENVD_OBD2_TTIP_LS_UP_1 FORMAT "%3.0"
 /begin AXIS_DESCR COM_AXIS online_dummy _CNV_A_R_LINEAR_____22_CM 4 0. 3. FORMAT "%2.0" AXIS_PTS_REF ldp_fmy_envd /end AXIS_DESCR
/end CHARACTERISTIC
/begin CHARACTERISTIC fmy_id_obd2_ttip_ls_up_2.envd "" CURVE 0xffe42d6c _REC_CUR_20_u1_u1 255. _CNV_A_R_LINEAR_____0_CM 0. 255. DISPLAY_IDENTIFIER ID_ERR_ENVD_OBD2_TTIP_LS_UP_2 FORMAT "%3.0"
 /begin AXIS_DESCR COM_AXIS online_dummy _CNV_A_R_LINEAR_____22_CM 4 0. 3. FORMAT "%2.0" AXIS_PTS_REF ldp_fmy_envd /end AXIS_DESCR
/end CHARACTERISTIC
/begin CHARACTERISTIC fmy_id_lsh_ls_up_1.envd "" CURVE 0xffe42d7e _REC_CUR_20_u1_u1 255. _CNV_A_R_LINEAR_____0_CM 0. 255. DISPLAY_IDENTIFIER ID_ERR_ENVD_LSH_LS_UP_1 FORMAT "%3.0"
 /begin AXIS_DESCR COM_AXIS online_dummy _CNV_A_R_LINEAR_____22_CM 4 0. 3. FORMAT "%2.0" AXIS_PTS_REF ldp_fmy_envd /end AXIS_DESCR
/end CHARACTERISTIC
/begin CHARACTERISTIC fmy_id_lsh_ls_up_2.envd "" CURVE 0xffe42d90 _REC_CUR_20_u1_u1 255. _CNV_A_R_LINEAR_____0_CM 0. 255. DISPLAY_IDENTIFIER ID_ERR_ENVD_LSH_LS_UP_2 FORMAT "%3.0"
 /begin AXIS_DESCR COM_AXIS online_dummy _CNV_A_R_LINEAR_____22_CM 4 0. 3. FORMAT "%2.0" AXIS_PTS_REF ldp_fmy_envd /end AXIS_DESCR
/end CHARACTERISTIC
/begin CHARACTERISTIC fmy_id_vls_up_thd_over_1.envd "" CURVE 0xffe42da2 _REC_CUR_20_u1_u1 255. _CNV_A_R_LINEAR_____0_CM 0. 255. DISPLAY_IDENTIFIER ID_ERR_ENVD_VLS_UP_THD_OVER_1 FORMAT "%3.0"
 /begin AXIS_DESCR COM_AXIS online_dummy _CNV_A_R_LINEAR_____22_CM 4 0. 3. FORMAT "%2.0" AXIS_PTS_REF ldp_fmy_envd /end AXIS_DESCR
/end CHARACTERISTIC
/begin CHARACTERISTIC fmy_id_vls_up_thd_over_2.envd "" CURVE 0xffe42db4 _REC_CUR_20_u1_u1 255. _CNV_A_R_LINEAR_____0_CM 0. 255. DISPLAY_IDENTIFIER ID_ERR_ENVD_VLS_UP_THD_OVER_2 FORMAT "%3.0"
 /begin AXIS_DESCR COM_AXIS online_dummy _CNV_A_R_LINEAR_____22_CM 4 0. 3. FORMAT "%2.0" AXIS_PTS_REF ldp_fmy_envd /end AXIS_DESCR
/end CHARACTERISTIC
/begin CHARACTERISTIC fmy_id_tout_nox_sens_1.envd "" CURVE 0xffe42dc6 _REC_CUR_20_u1_u1 255. _CNV_A_R_LINEAR_____0_CM 0. 255. DISPLAY_IDENTIFIER ID_ERR_ENVD_TOUT_NOX_SENS_1 FORMAT "%3.0"
 /begin AXIS_DESCR COM_AXIS online_dummy _CNV_A_R_LINEAR_____22_CM 4 0. 3. FORMAT "%2.0" AXIS_PTS_REF ldp_fmy_envd /end AXIS_DESCR
/end CHARACTERISTIC
/begin CHARACTERISTIC fmy_id_nox_sens_1.envd "" CURVE 0xffe42dd8 _REC_CUR_20_u1_u1 255. _CNV_A_R_LINEAR_____0_CM 0. 255. DISPLAY_IDENTIFIER ID_ERR_ENVD_NOX_SENS_1 FORMAT "%3.0"
 /begin AXIS_DESCR COM_AXIS online_dummy _CNV_A_R_LINEAR_____22_CM 4 0. 3. FORMAT "%2.0" AXIS_PTS_REF ldp_fmy_envd /end AXIS_DESCR
/end CHARACTERISTIC
/begin CHARACTERISTIC fmy_id_tout_nox_sens_2.envd "" CURVE 0xffe42dea _REC_CUR_20_u1_u1 255. _CNV_A_R_LINEAR_____0_CM 0. 255. DISPLAY_IDENTIFIER ID_ERR_ENVD_TOUT_NOX_SENS_2 FORMAT "%3.0"
 /begin AXIS_DESCR COM_AXIS online_dummy _CNV_A_R_LINEAR_____22_CM 4 0. 3. FORMAT "%2.0" AXIS_PTS_REF ldp_fmy_envd /end AXIS_DESCR
/end CHARACTERISTIC
/begin CHARACTERISTIC fmy_id_nox_sens_2.envd "" CURVE 0xffe42dfc _REC_CUR_20_u1_u1 255. _CNV_A_R_LINEAR_____0_CM 0. 255. DISPLAY_IDENTIFIER ID_ERR_ENVD_NOX_SENS_2 FORMAT "%3.0"
 /begin AXIS_DESCR COM_AXIS online_dummy _CNV_A_R_LINEAR_____22_CM 4 0. 3. FORMAT "%2.0" AXIS_PTS_REF ldp_fmy_envd /end AXIS_DESCR
/end CHARACTERISTIC
/begin CHARACTERISTIC fmy_id_if_lsl_1.envd "" CURVE 0xffe42e0e _REC_CUR_20_u1_u1 255. _CNV_A_R_LINEAR_____0_CM 0. 255. DISPLAY_IDENTIFIER ID_ERR_ENVD_IF_LSL_1 FORMAT "%3.0"
 /begin AXIS_DESCR COM_AXIS online_dummy _CNV_A_R_LINEAR_____22_CM 4 0. 3. FORMAT "%2.0" AXIS_PTS_REF ldp_fmy_envd /end AXIS_DESCR
/end CHARACTERISTIC
/begin CHARACTERISTIC fmy_id_if_lsl_2.envd "" CURVE 0xffe42e20 _REC_CUR_20_u1_u1 255. _CNV_A_R_LINEAR_____0_CM 0. 255. DISPLAY_IDENTIFIER ID_ERR_ENVD_IF_LSL_2 FORMAT "%3.0"
 /begin AXIS_DESCR COM_AXIS online_dummy _CNV_A_R_LINEAR_____22_CM 4 0. 3. FORMAT "%2.0" AXIS_PTS_REF ldp_fmy_envd /end AXIS_DESCR
/end CHARACTERISTIC
/begin CHARACTERISTIC fmy_id_ls_up_dyn_vld_1.envd "" CURVE 0xffe42e32 _REC_CUR_20_u1_u1 255. _CNV_A_R_LINEAR_____0_CM 0. 255. DISPLAY_IDENTIFIER ID_ERR_ENVD_LS_UP_DYN_VLD_1 FORMAT "%3.0"
 /begin AXIS_DESCR COM_AXIS online_dummy _CNV_A_R_LINEAR_____22_CM 4 0. 3. FORMAT "%2.0" AXIS_PTS_REF ldp_fmy_envd /end AXIS_DESCR
/end CHARACTERISTIC
/begin CHARACTERISTIC fmy_id_ls_up_dyn_vld_2.envd "" CURVE 0xffe42e44 _REC_CUR_20_u1_u1 255. _CNV_A_R_LINEAR_____0_CM 0. 255. DISPLAY_IDENTIFIER ID_ERR_ENVD_LS_UP_DYN_VLD_2 FORMAT "%3.0"
 /begin AXIS_DESCR COM_AXIS online_dummy _CNV_A_R_LINEAR_____22_CM 4 0. 3. FORMAT "%2.0" AXIS_PTS_REF ldp_fmy_envd /end AXIS_DESCR
/end CHARACTERISTIC
/begin CHARACTERISTIC fmy_id_ls_up_puc_vld_1.envd "" CURVE 0xffe42e56 _REC_CUR_20_u1_u1 255. _CNV_A_R_LINEAR_____0_CM 0. 255. DISPLAY_IDENTIFIER ID_ERR_ENVD_LS_UP_PUC_VLD_1 FORMAT "%3.0"
 /begin AXIS_DESCR COM_AXIS online_dummy _CNV_A_R_LINEAR_____22_CM 4 0. 3. FORMAT "%2.0" AXIS_PTS_REF ldp_fmy_envd /end AXIS_DESCR
/end CHARACTERISTIC
/begin CHARACTERISTIC fmy_id_ls_up_puc_vld_2.envd "" CURVE 0xffe42e68 _REC_CUR_20_u1_u1 255. _CNV_A_R_LINEAR_____0_CM 0. 255. DISPLAY_IDENTIFIER ID_ERR_ENVD_LS_UP_PUC_VLD_2 FORMAT "%3.0"
 /begin AXIS_DESCR COM_AXIS online_dummy _CNV_A_R_LINEAR_____22_CM 4 0. 3. FORMAT "%2.0" AXIS_PTS_REF ldp_fmy_envd /end AXIS_DESCR
/end CHARACTERISTIC
/begin CHARACTERISTIC fmy_id_lsh_up_obd2_vld_1.envd "" CURVE 0xffe42e7a _REC_CUR_20_u1_u1 255. _CNV_A_R_LINEAR_____0_CM 0. 255. DISPLAY_IDENTIFIER ID_ERR_ENVD_LSH_UP_OBD2_VLD_1 FORMAT "%3.0"
 /begin AXIS_DESCR COM_AXIS online_dummy _CNV_A_R_LINEAR_____22_CM 4 0. 3. FORMAT "%2.0" AXIS_PTS_REF ldp_fmy_envd /end AXIS_DESCR
/end CHARACTERISTIC
/begin CHARACTERISTIC fmy_id_lsh_up_obd2_vld_2.envd "" CURVE 0xffe42e8c _REC_CUR_20_u1_u1 255. _CNV_A_R_LINEAR_____0_CM 0. 255. DISPLAY_IDENTIFIER ID_ERR_ENVD_LSH_UP_OBD2_VLD_2 FORMAT "%3.0"
 /begin AXIS_DESCR COM_AXIS online_dummy _CNV_A_R_LINEAR_____22_CM 4 0. 3. FORMAT "%2.0" AXIS_PTS_REF ldp_fmy_envd /end AXIS_DESCR
/end CHARACTERISTIC
/begin CHARACTERISTIC fmy_id_nox_sens_htp_1.envd "" CURVE 0xffe42e9e _REC_CUR_20_u1_u1 255. _CNV_A_R_LINEAR_____0_CM 0. 255. DISPLAY_IDENTIFIER ID_ERR_ENVD_NOX_SENS_HTP_1 FORMAT "%3.0"
 /begin AXIS_DESCR COM_AXIS online_dummy _CNV_A_R_LINEAR_____22_CM 4 0. 3. FORMAT "%2.0" AXIS_PTS_REF ldp_fmy_envd /end AXIS_DESCR
/end CHARACTERISTIC
/begin CHARACTERISTIC fmy_id_nox_sens_plaus_1.envd "" CURVE 0xffe42eb0 _REC_CUR_20_u1_u1 255. _CNV_A_R_LINEAR_____0_CM 0. 255. DISPLAY_IDENTIFIER ID_ERR_ENVD_NOX_SENS_PLAUS_1 FORMAT "%3.0"
 /begin AXIS_DESCR COM_AXIS online_dummy _CNV_A_R_LINEAR_____22_CM 4 0. 3. FORMAT "%2.0" AXIS_PTS_REF ldp_fmy_envd /end AXIS_DESCR
/end CHARACTERISTIC
/begin CHARACTERISTIC fmy_id_nox_sens_avl_1.envd "" CURVE 0xffe42ec2 _REC_CUR_20_u1_u1 255. _CNV_A_R_LINEAR_____0_CM 0. 255. DISPLAY_IDENTIFIER ID_ERR_ENVD_NOX_SENS_AVL_1 FORMAT "%3.0"
 /begin AXIS_DESCR COM_AXIS online_dummy _CNV_A_R_LINEAR_____22_CM 4 0. 3. FORMAT "%2.0" AXIS_PTS_REF ldp_fmy_envd /end AXIS_DESCR
/end CHARACTERISTIC
/begin CHARACTERISTIC fmy_id_nox_sens_dyn_1.envd "" CURVE 0xffe42ed4 _REC_CUR_20_u1_u1 255. _CNV_A_R_LINEAR_____0_CM 0. 255. DISPLAY_IDENTIFIER ID_ERR_ENVD_NOX_SENS_DYN_1 FORMAT "%3.0"
 /begin AXIS_DESCR COM_AXIS online_dummy _CNV_A_R_LINEAR_____22_CM 4 0. 3. FORMAT "%2.0" AXIS_PTS_REF ldp_fmy_envd /end AXIS_DESCR
/end CHARACTERISTIC
/begin CHARACTERISTIC fmy_id_nox_sens_ref_air_1.envd "" CURVE 0xffe42ee6 _REC_CUR_20_u1_u1 255. _CNV_A_R_LINEAR_____0_CM 0. 255. DISPLAY_IDENTIFIER ID_ERR_ENVD_NOX_SENS_REF_AIR_1 FORMAT "%3.0"
 /begin AXIS_DESCR COM_AXIS online_dummy _CNV_A_R_LINEAR_____22_CM 4 0. 3. FORMAT "%2.0" AXIS_PTS_REF ldp_fmy_envd /end AXIS_DESCR
/end CHARACTERISTIC
/begin CHARACTERISTIC fmy_id_nox_sens_htp_2.envd "" CURVE 0xffe42ef8 _REC_CUR_20_u1_u1 255. _CNV_A_R_LINEAR_____0_CM 0. 255. DISPLAY_IDENTIFIER ID_ERR_ENVD_NOX_SENS_HTP_2 FORMAT "%3.0"
 /begin AXIS_DESCR COM_AXIS online_dummy _CNV_A_R_LINEAR_____22_CM 4 0. 3. FORMAT "%2.0" AXIS_PTS_REF ldp_fmy_envd /end AXIS_DESCR
/end CHARACTERISTIC
/begin CHARACTERISTIC fmy_id_nox_sens_plaus_2.envd "" CURVE 0xffe42f0a _REC_CUR_20_u1_u1 255. _CNV_A_R_LINEAR_____0_CM 0. 255. DISPLAY_IDENTIFIER ID_ERR_ENVD_NOX_SENS_PLAUS_2 FORMAT "%3.0"
 /begin AXIS_DESCR COM_AXIS online_dummy _CNV_A_R_LINEAR_____22_CM 4 0. 3. FORMAT "%2.0" AXIS_PTS_REF ldp_fmy_envd /end AXIS_DESCR
/end CHARACTERISTIC
/begin CHARACTERISTIC fmy_id_nox_sens_avl_2.envd "" CURVE 0xffe42f1c _REC_CUR_20_u1_u1 255. _CNV_A_R_LINEAR_____0_CM 0. 255. DISPLAY_IDENTIFIER ID_ERR_ENVD_NOX_SENS_AVL_2 FORMAT "%3.0"
 /begin AXIS_DESCR COM_AXIS online_dummy _CNV_A_R_LINEAR_____22_CM 4 0. 3. FORMAT "%2.0" AXIS_PTS_REF ldp_fmy_envd /end AXIS_DESCR
/end CHARACTERISTIC
/begin CHARACTERISTIC fmy_id_nox_sens_dyn_2.envd "" CURVE 0xffe42f2e _REC_CUR_20_u1_u1 255. _CNV_A_R_LINEAR_____0_CM 0. 255. DISPLAY_IDENTIFIER ID_ERR_ENVD_NOX_SENS_DYN_2 FORMAT "%3.0"
 /begin AXIS_DESCR COM_AXIS online_dummy _CNV_A_R_LINEAR_____22_CM 4 0. 3. FORMAT "%2.0" AXIS_PTS_REF ldp_fmy_envd /end AXIS_DESCR
/end CHARACTERISTIC
/begin CHARACTERISTIC fmy_id_nox_sens_ref_air_2.envd "" CURVE 0xffe42f40 _REC_CUR_20_u1_u1 255. _CNV_A_R_LINEAR_____0_CM 0. 255. DISPLAY_IDENTIFIER ID_ERR_ENVD_NOX_SENS_REF_AIR_2 FORMAT "%3.0"
 /begin AXIS_DESCR COM_AXIS online_dummy _CNV_A_R_LINEAR_____22_CM 4 0. 3. FORMAT "%2.0" AXIS_PTS_REF ldp_fmy_envd /end AXIS_DESCR
/end CHARACTERISTIC
/begin MEASUREMENT lv_inh_diag_fsd_cp "Deactivation bit for fuel system diagnosis due to internal states of the CP-function" UBYTE _CNV_S_2_RANGE______2_CM 1 100. 0. 1. DISPLAY_IDENTIFIER LV_INH_DIAG_FSD_CP ECU_ADDRESS 0x3fea47 BIT_MASK 0x1 /end MEASUREMENT
/begin CHARACTERISTIC lc_inh_fsd_man_deac "Manual deactivation of FSD inhibitation" VALUE 0xffe40f7b _REC_VAL_20_u1 1. _CNV_A_R_LINEAR_____22_CM 0. 1. DISPLAY_IDENTIFIER LC_INH_FSD_MAN_DEAC FORMAT "%2.0" /end CHARACTERISTIC
/begin MEASUREMENT lv_err_det_fsd_1 "Error detection flag FSD diagnosis" UBYTE _CNV_S_2_RANGE______2_CM 1 100. 0. 1. DISPLAY_IDENTIFIER LV_ERR_DET_FSD_1 ECU_ADDRESS 0x3fea44 BIT_MASK 0x1 /end MEASUREMENT
/begin MEASUREMENT lv_err_det_fsd_2 "Error detection flag FSD diagnosis" UBYTE _CNV_S_2_RANGE______2_CM 1 100. 0. 1. DISPLAY_IDENTIFIER LV_ERR_DET_FSD_2 ECU_ADDRESS 0x3fea45 BIT_MASK 0x1 /end MEASUREMENT
/begin CHARACTERISTIC c_cl_mmv_max_fsd "Maximum value for CL_MMV to permit FSD" VALUE 0xffe4152a _REC_VAL_20_u2 1.99996948 _CNV_A_R_LINEAR_____20_CM 0. 1.99996948 DISPLAY_IDENTIFIER C_CL_MMV_MAX_FSD FORMAT "%7.5" /end CHARACTERISTIC
/begin CHARACTERISTIC c_tco_min_fsd_pu "Minimum coolent tempeature for FSD stop during PU" VALUE 0xffe40918 _REC_VAL_20_u1 190.5 _CNV_A_R_LINEAR_____11_CM -48. 142.5 DISPLAY_IDENTIFIER C_TCO_MIN_FSD_PU FORMAT "%5.1" /end CHARACTERISTIC
/begin CHARACTERISTIC c_t_dly_fsd_pu "Time after end of PU before restart of FSD" VALUE 0xffe41910 _REC_VAL_20_u2 1310.7 _CNV_A_R_LINEAR_____198_CM 0. 1310.7 DISPLAY_IDENTIFIER C_T_DLY_FSD_PU FORMAT "%7.2" /end CHARACTERISTIC
/begin CHARACTERISTIC c_t_dly_fsd_reac "Time after end of PUC before restart of FSD" VALUE 0xffe41912 _REC_VAL_20_u2 1310.7 _CNV_A_R_LINEAR_____198_CM 0. 1310.7 DISPLAY_IDENTIFIER C_T_DLY_FSD_REAC FORMAT "%7.2" /end CHARACTERISTIC
/begin CHARACTERISTIC c_t_ti_add_wf_dec_sum "Time after end of PUC before restart of FSD" VALUE 0xffe408cd _REC_VAL_20_u1 5.1 _CNV_A_R_LINEAR_____198_CM 0. 5.1 DISPLAY_IDENTIFIER C_T_TI_ADD_WF_DEC_SUM FORMAT "%4.2" /end CHARACTERISTIC
/begin CHARACTERISTIC c_ti_add_wf_dec "Time after end of PUC before restart of FSD" VALUE 0xffe41a76 _REC_VAL_20_u2 131.068 _CNV_A_R_LINEAR_____165_CM 0. 131.068 DISPLAY_IDENTIFIER C_TI_ADD_WF_DEC FORMAT "%7.3" /end CHARACTERISTIC
/begin CHARACTERISTIC c_ti_add_wf_min_ldc "Time after end of PUC before restart of FSD" VALUE 0xffe41a78 _REC_VAL_20_u2 131.068 _CNV_A_R_LINEAR_____165_CM 0. 131.068 DISPLAY_IDENTIFIER C_TI_ADD_WF_MIN_LDC FORMAT "%7.3" /end CHARACTERISTIC
/begin CHARACTERISTIC c_ti_add_wf_sum_max "Time after end of PUC before restart of FSD" VALUE 0xffe41a7a _REC_VAL_20_u2 262.14 _CNV_A_R_LINEAR_____165_CM 0. 262.14 DISPLAY_IDENTIFIER C_TI_ADD_WF_SUM_MAX FORMAT "%7.3" /end CHARACTERISTIC
/begin MEASUREMENT ti_add_wf_sum "Sum of TI_ADD_WF over threshold" UWORD _CNV_A_R_LINEAR_____165_CM 1 100. 0. 262.14 DISPLAY_IDENTIFIER TI_ADD_WF_SUM ECU_ADDRESS 0x3fdbe0 BYTE_ORDER MSB_LAST FORMAT "%7.3" /end MEASUREMENT
/begin MEASUREMENT t_ti_add_wf_dec_sum "time counter for decrementation of ti_add_wf_sum" UBYTE _CNV_A_R_LINEAR_____198_CM 1 100. 0. 5.1 DISPLAY_IDENTIFIER T_TI_ADD_WF_DEC_SUM ECU_ADDRESS 0x3fea48 FORMAT "%4.2" /end MEASUREMENT
/begin MEASUREMENT lv_ldc_fsd "Limited dynamic of FSD concerning wall film" UBYTE _CNV_S_2_RANGE______2_CM 1 100. 0. 1. DISPLAY_IDENTIFIER LV_LDC_FSD ECU_ADDRESS 0x3fea4c BIT_MASK 0x1 /end MEASUREMENT
/begin MEASUREMENT lv_inh_diag_fsd "fuel system diagnosis: application incidence to inhibit the diagnosis" UBYTE _CNV_S_2_RANGE______2_CM 1 100. 0. 1. DISPLAY_IDENTIFIER LV_INH_DIAG_FSD ECU_ADDRESS 0x3fea46 BIT_MASK 0x1 /end MEASUREMENT
/begin MEASUREMENT lam_bank_1.lsh_down_obd2.pow_int_obd2_lsh_down "Integral indicates measure of cooling energy of exhaust gas at sensor location" UWORD _CNV_A_R_LINEAR_____314_CM 1 100. 0. 65535. DISPLAY_IDENTIFIER POW_INT_OBD2_LSH_DOWN_1 ECU_ADDRESS 0x3fc3f6 BYTE_ORDER MSB_LAST FORMAT "%5.0" /end MEASUREMENT
/begin MEASUREMENT lam_bank_1.lsh_down_obd2.state_obd2_lsh_down "Indicates current phase of oxygen sensor heater OBDII diagnosis" UBYTE _CNV_S_9_STATE_OBD2_315_CM 1 100. 0. 8. DISPLAY_IDENTIFIER STATE_OBD2_LSH_DOWN_1 ECU_ADDRESS 0x3fc3f4 /end MEASUREMENT
/begin MEASUREMENT lam_bank_1.lsh_down_obd2.tcc_obd2_lsh_down "Number of completed valid diagnosis cycles" UWORD _CNV_A_R_LINEAR_____22_CM 1 100. 0. 1023. DISPLAY_IDENTIFIER TCC_OBD2_LSH_DOWN_1 ECU_ADDRESS 0x3fc3f8 BYTE_ORDER MSB_LAST FORMAT "%4.0" /end MEASUREMENT
/begin MEASUREMENT lam_bank_1.lsh_down_obd2.frc_obd2_lsh_down "Number of faults detected during valid diagnosis cycles" UWORD _CNV_A_R_LINEAR_____22_CM 1 100. 0. 1023. DISPLAY_IDENTIFIER FRC_OBD2_LSH_DOWN_1 ECU_ADDRESS 0x3fc3fa BYTE_ORDER MSB_LAST FORMAT "%4.0" /end MEASUREMENT
/begin MEASUREMENT lam_bank_1.lsh_down_obd2.ctr_cycnr_r_obd2_lsh_down "Value of handshake counter for last valid resistance value used for diagnosis" UWORD _CNV_A_R_LINEAR_____0_CM 1 100. 0. 65535. DISPLAY_IDENTIFIER CTR_CYCNR_R_OBD2_LSH_DOWN_1 ECU_ADDRESS 0x3fc3fc BYTE_ORDER MSB_LAST FORMAT "%5.0" /end MEASUREMENT
/begin MEASUREMENT lam_bank_1.lsh_down_obd2.r_down_ls_obd2_lsh_down "Most current upstream oxygen sensor internal resistance used for diagnosis cycle, Mode 6 information" UWORD _CNV_A_R_LINEAR_____0_CM 1 100. 0. 65535. DISPLAY_IDENTIFIER R_DOWN_LS_OBD2_LSH_DOWN_1 ECU_ADDRESS 0x3fc3fe BYTE_ORDER MSB_LAST FORMAT "%5.0" /end MEASUREMENT
/begin MEASUREMENT lam_bank_1.lsh_down_obd2.temp_dif_obd2_lsh_down "Indicates difference in temperature between set operating temperature & exhaust gas at sensor location" UWORD _CNV_A_R_LINEAR_____13_CM 1 100. 0. 2047. DISPLAY_IDENTIFIER TEMP_DIF_OBD2_LSH_DOWN_1 ECU_ADDRESS 0x3fc402 BYTE_ORDER MSB_LAST FORMAT "%4.0" /end MEASUREMENT
/begin MEASUREMENT lam_bank_2.lsh_down_obd2.pow_int_obd2_lsh_down "Integral indicates measure of cooling energy of exhaust gas at sensor location" UWORD _CNV_A_R_LINEAR_____314_CM 1 100. 0. 65535. DISPLAY_IDENTIFIER POW_INT_OBD2_LSH_DOWN_2 ECU_ADDRESS 0x3fc8ae BYTE_ORDER MSB_LAST FORMAT "%5.0" /end MEASUREMENT
/begin MEASUREMENT lam_bank_2.lsh_down_obd2.state_obd2_lsh_down "Indicates current phase of oxygen sensor heater OBDII diagnosis" UBYTE _CNV_S_9_STATE_OBD2_315_CM 1 100. 0. 8. DISPLAY_IDENTIFIER STATE_OBD2_LSH_DOWN_2 ECU_ADDRESS 0x3fc8ac /end MEASUREMENT
/begin MEASUREMENT lam_bank_2.lsh_down_obd2.tcc_obd2_lsh_down "Number of completed valid diagnosis cycles" UWORD _CNV_A_R_LINEAR_____22_CM 1 100. 0. 1023. DISPLAY_IDENTIFIER TCC_OBD2_LSH_DOWN_2 ECU_ADDRESS 0x3fc8b0 BYTE_ORDER MSB_LAST FORMAT "%4.0" /end MEASUREMENT
/begin MEASUREMENT lam_bank_2.lsh_down_obd2.frc_obd2_lsh_down "Number of faults detected during valid diagnosis cycles" UWORD _CNV_A_R_LINEAR_____22_CM 1 100. 0. 1023. DISPLAY_IDENTIFIER FRC_OBD2_LSH_DOWN_2 ECU_ADDRESS 0x3fc8b2 BYTE_ORDER MSB_LAST FORMAT "%4.0" /end MEASUREMENT
/begin MEASUREMENT lam_bank_2.lsh_down_obd2.ctr_cycnr_r_obd2_lsh_down "Value of handshake counter for last valid resistance value used for diagnosis" UWORD _CNV_A_R_LINEAR_____0_CM 1 100. 0. 65535. DISPLAY_IDENTIFIER CTR_CYCNR_R_OBD2_LSH_DOWN_2 ECU_ADDRESS 0x3fc8b4 BYTE_ORDER MSB_LAST FORMAT "%5.0" /end MEASUREMENT
/begin MEASUREMENT lam_bank_2.lsh_down_obd2.r_down_ls_obd2_lsh_down "Most current upstream oxygen sensor internal resistance used for diagnosis cycle, Mode 6 information" UWORD _CNV_A_R_LINEAR_____0_CM 1 100. 0. 65535. DISPLAY_IDENTIFIER R_DOWN_LS_OBD2_LSH_DOWN_2 ECU_ADDRESS 0x3fc8b6 BYTE_ORDER MSB_LAST FORMAT "%5.0" /end MEASUREMENT
/begin MEASUREMENT lam_bank_2.lsh_down_obd2.temp_dif_obd2_lsh_down "Indicates difference in temperature between set operating temperature & exhaust gas at sensor location" UWORD _CNV_A_R_LINEAR_____13_CM 1 100. 0. 2047. DISPLAY_IDENTIFIER TEMP_DIF_OBD2_LSH_DOWN_2 ECU_ADDRESS 0x3fc8ba BYTE_ORDER MSB_LAST FORMAT "%4.0" /end MEASUREMENT
/begin MEASUREMENT lv_err_dmtlm "error DMTL module" UBYTE _CNV_S_2_RANGE______2_CM 1 100. 0. 1. DISPLAY_IDENTIFIER LV_ERR_DMTLM ECU_ADDRESS 0x3fba6c /end MEASUREMENT
/begin CHARACTERISTIC lc_inh_cat_diag_man_deac "Manual deactivation of cat diagnosis inhibition condition" VALUE 0xffe40f6e _REC_VAL_20_u1 1. _CNV_S_2_RANGE______2_CM 0. 1. DISPLAY_IDENTIFIER LC_INH_CAT_DIAG_MAN_DEAC /end CHARACTERISTIC
/begin CHARACTERISTIC c_pwm_min_obd2_lsh_down "Minimum permitted heater effective voltage PWM for upstream LSH OBDII diagnosis " VALUE 0xffe40832 _REC_VAL_20_u1 99.609375 _CNV_A_R_LINEAR_____9_CM 0. 99.609375 DISPLAY_IDENTIFIER C_PWM_MIN_OBD2_LSH_DOWN FORMAT "%4.1" /end CHARACTERISTIC
/begin CHARACTERISTIC c_pwm_max_obd2_lsh_down "Maximum permitted heater effective voltage PWM for upstream LSH OBDII diagnosis " VALUE 0xffe40831 _REC_VAL_20_u1 99.609375 _CNV_A_R_LINEAR_____9_CM 0. 99.609375 DISPLAY_IDENTIFIER C_PWM_MAX_OBD2_LSH_DOWN FORMAT "%4.1" /end CHARACTERISTIC
/begin CHARACTERISTIC c_t_dly_obd2_lsh_down "Minimum delay prior to checking status of OBDI heater / signal faults" VALUE 0xffe4088d _REC_VAL_20_u1 255. _CNV_A_R_LINEAR_____30_CM 0. 255. DISPLAY_IDENTIFIER C_T_DLY_OBD2_LSH_DOWN FORMAT "%3.0" /end CHARACTERISTIC
/begin CHARACTERISTIC c_temp_min_obd2_lsh_down "Temperature threshold under which downstream LSH OBDII diagnosis activated" VALUE 0xffe41a6a _REC_VAL_20_u2 2047. _CNV_A_R_LINEAR_____6_CM 0. 2047. DISPLAY_IDENTIFIER C_TEMP_MIN_OBD2_LSH_DOWN FORMAT "%7.2" /end CHARACTERISTIC
/begin CHARACTERISTIC c_temp_set_obd2_lsh_down "Set temperature fordownstream LSH operation used to generate power integral" VALUE 0xffe41a6c _REC_VAL_20_u2 2047. _CNV_A_R_LINEAR_____6_CM 0. 2047. DISPLAY_IDENTIFIER C_TEMP_SET_OBD2_LSH_DOWN FORMAT "%7.2" /end CHARACTERISTIC
/begin CHARACTERISTIC c_egy_min_obd2_lsh_down "Measure of minimum required cooling energy required atdownstream sensor prior to checking Ri threshold" VALUE 0xffe415d2 _REC_VAL_20_u2 65535. _CNV_A_R_LINEAR_____314_CM 0. 65535. DISPLAY_IDENTIFIER C_EGY_MIN_OBD2_LSH_DOWN FORMAT "%5.0" /end CHARACTERISTIC
/begin CHARACTERISTIC c_tcc_obd2_lsh_down "Number of valid downstream LSH OBDII diagnosis cycles over which statistic evaluation to be carried out" VALUE 0xffe41a2c _REC_VAL_20_u2 1023. _CNV_A_R_LINEAR_____22_CM 0. 1023. DISPLAY_IDENTIFIER C_TCC_OBD2_LSH_DOWN FORMAT "%4.0" /end CHARACTERISTIC
/begin CHARACTERISTIC c_frc_obd2_lsh_down "Fault detection threshold, when exceeded, heater is determined to be defective during driving cycle" VALUE 0xffe41662 _REC_VAL_20_u2 1023. _CNV_A_R_LINEAR_____22_CM 0. 1023. DISPLAY_IDENTIFIER C_FRC_OBD2_LSH_DOWN FORMAT "%4.0" /end CHARACTERISTIC
/begin CHARACTERISTIC ip_r_thd_obd2_lsh_down "Internal resistance threshold, when exceeded, heater is determined to be defective for current diagnosis cycle:" CURVE 0xffe41c98 _REC_CUR_20_u2_u2 65535. _CNV_A_R_LINEAR_____309_CM 0. 65535. DISPLAY_IDENTIFIER IP_R_THD_OBD2_LSH_DOWN FORMAT "%5.0"
 /begin AXIS_DESCR COM_AXIS lam_bank_1.ls_down_cur.r_down_ls_mdl_sens_new _CNV_A_R_LINEAR_____309_CM 4 0. 65535. FORMAT "%5.0" AXIS_PTS_REF ldp_r_down_ls_mdl_sens_new_r_thd /end AXIS_DESCR
/end CHARACTERISTIC
/begin AXIS_PTS ldp_r_down_ls_mdl_sens_new_r_thd "" 0xffe5125a lam_bank_1.ls_down_cur.r_down_ls_mdl_sens_new _REC_AXS_20_u2 65535. _CNV_A_R_LINEAR_____309_CM 4 0. 65535. DISPLAY_IDENTIFIER LDP_R_DOWN_LS_MDL_SENS_NEW_R_THD FORMAT "%5.0" /end AXIS_PTS
/begin AXIS_PTS ldp_maf_kgh__fac_maf_lsh_down "" 0xffe50e2c maf_kgh _REC_AXS_20_u2 2047.96875 _CNV_A_R_LINEAR_____115_CM 6 0. 2047.96875 DISPLAY_IDENTIFIER LDP_MAF_KGH__FAC_MAF_LSH_DOWN FORMAT "%7.2" /end AXIS_PTS
/begin CHARACTERISTIC ip_fac_maf_lsh_down "Factor reflecting forced convection influence of cooling area, gas velocity and heat transfer coefficient" CURVE 0xffe40baf _REC_CUR_20_u1_u2 15.9375 _CNV_A_R_LINEAR_____46_CM 0. 15.9375 DISPLAY_IDENTIFIER IP_FAC_MAF_LSH_DOWN FORMAT "%5.2"
 /begin AXIS_DESCR COM_AXIS maf_kgh _CNV_A_R_LINEAR_____115_CM 6 0. 2047.96875 FORMAT "%7.2" AXIS_PTS_REF ldp_maf_kgh__fac_maf_lsh_down /end AXIS_DESCR
/end CHARACTERISTIC
/begin CHARACTERISTIC ip_fac_teg_mdl_ls_down "Factor for internal resistance threshold depending on exhaust gas temperature" CURVE 0xffe40c07 _REC_CUR_20_u1_u2 127.5 _CNV_A_R_LINEAR_____441_CM 0. 127.5 DISPLAY_IDENTIFIER IP_FAC_TEG_MDL_LS_DOWN FORMAT "%5.1"
 /begin AXIS_DESCR COM_AXIS online_dummy _CNV_A_R_LINEAR_____6_CM 8 0. 2047. FORMAT "%7.2" AXIS_PTS_REF ldp_ttip_ref_ls_down_ip_fac_teg /end AXIS_DESCR
/end CHARACTERISTIC
/begin AXIS_PTS ldp_ttip_ref_ls_down_ip_fac_teg "" 0xffe51560 online_dummy _REC_AXS_20_u2 2047. _CNV_A_R_LINEAR_____6_CM 8 0. 2047. DISPLAY_IDENTIFIER LDP_TTIP_REF_LS_DOWN_IP_FAC_TEG FORMAT "%7.2" /end AXIS_PTS
/begin MEASUREMENT lv_err_obd2_lsh_down_1 "Boolean flag indicating that fault is present and has been debounced" UBYTE _CNV_S_2_RANGE______1_R_CM 1 100. 0. 255. DISPLAY_IDENTIFIER LV_ERR_OBD2_LSH_DOWN_1 ECU_ADDRESS 0x3fba5c /end MEASUREMENT
/begin MEASUREMENT lv_err_obd2_lsh_down_2 "Boolean flag indicating that fault is present and has been debounced" UBYTE _CNV_S_2_RANGE______1_R_CM 1 100. 0. 255. DISPLAY_IDENTIFIER LV_ERR_OBD2_LSH_DOWN_2 ECU_ADDRESS 0x3fba60 /end MEASUREMENT
/begin MEASUREMENT dist_dmtl "Distance covered for DMTL function" UWORD _CNV_A_R_LINEAR_____176_CM 1 100. 0. 65535. DISPLAY_IDENTIFIER DIST_DMTL ECU_ADDRESS 0x3fcfe0 BYTE_ORDER MSB_LAST FORMAT "%5.0" /end MEASUREMENT
/begin AXIS_PTS ldp_fmy_envd "" 0xffe4102c online_dummy _REC_AXS_20_u1 3. _CNV_A_R_LINEAR_____22_CM 4 0. 3. DISPLAY_IDENTIFIER LDP_FMY_ENVD FORMAT "%2.0" /end AXIS_PTS
/begin COMPU_METHOD _CNV_A_R_LINEAR_____0_CM "" RAT_FUNC "%6.3" "-" COEFFS 0 1. 0. 0 0 1 /end COMPU_METHOD
/begin COMPU_METHOD _CNV_S_2_RANGE______1_R_CM "" TAB_VERB "%6.3" "[-]" COMPU_TAB_REF _CNV_S_2_RANGE______1_R /end COMPU_METHOD
/begin COMPU_VTAB_RANGE _CNV_S_2_RANGE______1_R "" 2 0 0 "0" 1 255 "1" /end COMPU_VTAB_RANGE
/begin COMPU_METHOD _CNV_S_2_RANGE______2_CM "" TAB_VERB "%6.3" "[-]" COMPU_TAB_REF _CNV_S_2_RANGE______2 /end COMPU_METHOD
/begin COMPU_VTAB _CNV_S_2_RANGE______2 "" TAB_VERB 2 0 "0" 1 "1" /end COMPU_VTAB
/begin COMPU_METHOD _CNV_A_R_LINEAR_____3_CM "" RAT_FUNC "%6.3" "V" COEFFS 0 204.7999998974999 0. 0 0 1 /end COMPU_METHOD
/begin COMPU_METHOD _CNV_A_R_LINEAR_____4_CM "" RAT_FUNC "%6.3" "s" COEFFS 0 100. 0. 0 0 1 /end COMPU_METHOD
/begin COMPU_METHOD _CNV_A_R_LINEAR_____6_CM "" RAT_FUNC "%6.3" "°C" COEFFS 0 16. 0. 0 0 1 /end COMPU_METHOD
/begin COMPU_METHOD _CNV_A_R_LINEAR_____9_CM "" RAT_FUNC "%6.3" "%" COEFFS 0 2.56 0. 0 0 1 /end COMPU_METHOD
/begin COMPU_METHOD _CNV_A_R_LINEAR_____11_CM "" RAT_FUNC "%6.3" "°C" COEFFS 0 1.333333333333333 64. 0 0 1 /end COMPU_METHOD
/begin COMPU_METHOD _CNV_A_R_LINEAR_____13_CM "" RAT_FUNC "%6.3" "°C" COEFFS 0 1. 0. 0 0 1 /end COMPU_METHOD
/begin COMPU_METHOD _CNV_A_R_LINEAR_____20_CM "" RAT_FUNC "%6.3" "-" COEFFS 0 32768.00003968061 0. 0 0 1 /end COMPU_METHOD
/begin COMPU_METHOD _CNV_A_R_LINEAR_____22_CM "" RAT_FUNC "%6.3" "[-]" COEFFS 0 1. 0. 0 0 1 /end COMPU_METHOD
/begin COMPU_METHOD _CNV_A_R_LINEAR_____23_CM "" RAT_FUNC "%6.3" "km/h" COEFFS 0 1. 0. 0 0 1 /end COMPU_METHOD
/begin COMPU_METHOD _CNV_A_R_LINEAR_____24_CM "" RAT_FUNC "%6.3" "s" COEFFS 0 10. 0. 0 0 1 /end COMPU_METHOD
/begin COMPU_METHOD _CNV_A_R_LINEAR_____30_CM "" RAT_FUNC "%6.3" "s" COEFFS 0 1. 0. 0 0 1 /end COMPU_METHOD
/begin COMPU_METHOD _CNV_A_R_LINEAR_____37_CM "" RAT_FUNC "%6.3" "-" COEFFS 0 65536.00007936121 0. 0 0 1 /end COMPU_METHOD
/begin COMPU_METHOD _CNV_A_R_LINEAR_____46_CM "" RAT_FUNC "%6.3" "-" COEFFS 0 16. 0. 0 0 1 /end COMPU_METHOD
/begin COMPU_METHOD _CNV_A_R_LINEAR_____60_CM "" RAT_FUNC "%6.3" "V" COEFFS 0 9.807692307692308 0. 0 0 1 /end COMPU_METHOD
/begin COMPU_METHOD _CNV_A_R_LINEAR_____96_CM "" RAT_FUNC "%6.3" "l" COEFFS 0 1. 0. 0 0 1 /end COMPU_METHOD
/begin COMPU_METHOD _CNV_A_R_LINEAR_____97_CM "" RAT_FUNC "%6.3" "min" COEFFS 0 1. 0. 0 0 1 /end COMPU_METHOD
/begin COMPU_METHOD _CNV_A_R_LINEAR_____115_CM "" RAT_FUNC "%6.3" "kg/h" COEFFS 0 32. 0. 0 0 1 /end COMPU_METHOD
/begin COMPU_METHOD _CNV_A_R_LINEAR_____117_CM "" RAT_FUNC "%6.3" "-" COEFFS 0 128. 0. 0 0 1 /end COMPU_METHOD
/begin COMPU_METHOD _CNV_A_R_LINEAR_____165_CM "" RAT_FUNC "%6.3" "ms" COEFFS 0 250. 0. 0 0 1 /end COMPU_METHOD
/begin COMPU_METHOD _CNV_A_R_LINEAR_____166_CM "" RAT_FUNC "%6.3" "hPa" COEFFS 0 12.05960017121163 0. 0 0 1 /end COMPU_METHOD
/begin COMPU_METHOD _CNV_A_R_LINEAR_____167_CM "" RAT_FUNC "%6.3" "mA" COEFFS 0 163.8400395206126 7.904122518084478e-003 0 0 1 /end COMPU_METHOD
/begin COMPU_METHOD _CNV_A_R_LINEAR_____168_CM "" RAT_FUNC "%6.3" "mA" COEFFS 0 163.8375 0. 0 0 1 /end COMPU_METHOD
/begin COMPU_METHOD _CNV_A_R_LINEAR_____169_CM "" RAT_FUNC "%6.3" "l" COEFFS 0 15.25879531537405 0. 0 0 1 /end COMPU_METHOD
/begin COMPU_METHOD _CNV_A_R_LINEAR_____170_CM "" RAT_FUNC "%6.3" "l" COEFFS 0 15.26190476190476 0. 0 0 1 /end COMPU_METHOD
/begin COMPU_METHOD _CNV_A_R_LINEAR_____171_CM "" RAT_FUNC "%6.3" "ohm" COEFFS 0 5.1 0. 0 0 1 /end COMPU_METHOD
/begin COMPU_METHOD _CNV_A_R_LINEAR_____172_CM "" RAT_FUNC "%6.3" "h" COEFFS 0 35999.99999497086 0. 0 0 1 /end COMPU_METHOD
/begin COMPU_METHOD _CNV_A_R_LINEAR_____173_CM "" RAT_FUNC "%6.3" "V" COEFFS 0 2510.769230769231 0. 0 0 1 /end COMPU_METHOD
/begin COMPU_METHOD _CNV_S_13_STATE_DMTL_174_CM "" TAB_VERB "%6.3" "-" COMPU_TAB_REF _CNV_S_13_STATE_DMTL_174 /end COMPU_METHOD
/begin COMPU_VTAB _CNV_S_13_STATE_DMTL_174 "" TAB_VERB 13 0 "START" 1 "REF_LEAK_MES" 2 "ROUGH_LEAK_MES" 3 "ROUGH_LEAK_MES_LEN" 4 "ROUGH_LEAK_MES_END" 5 "SMALL_LEAK_MES" 6 "SMALL_LEAK_MES_LEN" 7 "2.REF_LEAK_MES" 8 "TANK_PROOFED" 9 "SMALL_LEAK" 10 "ROUGH_LEAK" 11 "MODULE_ERROR" 12 "END" /end COMPU_VTAB
/begin COMPU_METHOD _CNV_A_R_LINEAR_____175_CM "" RAT_FUNC "%6.3" "-" COEFFS 0 32767.98303949118 0. 0 0 1 /end COMPU_METHOD
/begin COMPU_METHOD _CNV_A_R_LINEAR_____176_CM "" RAT_FUNC "%6.3" "m" COEFFS 0 1. 0. 0 0 1 /end COMPU_METHOD
/begin COMPU_METHOD _CNV_A_R_LINEAR_____198_CM "" RAT_FUNC "%6.3" "s" COEFFS 0 50. 0. 0 0 1 /end COMPU_METHOD
/begin COMPU_METHOD _CNV_A_R_LINEAR_____309_CM "" RAT_FUNC "%6.3" "ohm" COEFFS 0 1. 0. 0 0 1 /end COMPU_METHOD
/begin COMPU_METHOD _CNV_A_R_LINEAR_____314_CM "" RAT_FUNC "%6.3" "J" COEFFS 0 1. 0. 0 0 1 /end COMPU_METHOD
/begin COMPU_METHOD _CNV_S_9_STATE_OBD2_315_CM "" TAB_VERB "%6.3" "[-]" COMPU_TAB_REF _CNV_S_9_STATE_OBD2_315 /end COMPU_METHOD
/begin COMPU_VTAB _CNV_S_9_STATE_OBD2_315 "" TAB_VERB 9 0 "DIAG_OFF" 1 "DIAG_INIT" 2 "LS_READY" 3 "OBD1_DLY" 4 "OBD1_CHK" 5 "TEG_THD" 6 "POW_INT" 7 "DIAG_ACT" 8 "DIAG_END" /end COMPU_VTAB
/begin COMPU_METHOD _CNV_A_R_LINEAR_____441_CM "" RAT_FUNC "%6.3" "-" COEFFS 0 2. 0. 0 0 1 /end COMPU_METHOD
/begin RECORD_LAYOUT _REC_VAL_20_u1 FNC_VALUES 1 UBYTE COLUMN_DIR DIRECT /end RECORD_LAYOUT
/begin RECORD_LAYOUT _REC_VAL_20_u2 FNC_VALUES 1 UWORD COLUMN_DIR DIRECT /end RECORD_LAYOUT
/begin RECORD_LAYOUT _REC_CUR_20_u2_u1 FNC_VALUES 1 UWORD COLUMN_DIR DIRECT /end RECORD_LAYOUT
/begin RECORD_LAYOUT _REC_AXS_20_u1 NO_AXIS_PTS_X 1 UBYTE AXIS_PTS_X 2 UBYTE INDEX_INCR DIRECT /end RECORD_LAYOUT
/begin RECORD_LAYOUT _REC_CUR_20_u1_u1 FNC_VALUES 1 UBYTE COLUMN_DIR DIRECT /end RECORD_LAYOUT
/begin RECORD_LAYOUT _REC_AXS_20_u2 NO_AXIS_PTS_X 1 UWORD AXIS_PTS_X 2 UWORD INDEX_INCR DIRECT /end RECORD_LAYOUT
/begin RECORD_LAYOUT _REC_MAP_20_u2_u2_u1 FNC_VALUES 1 UWORD COLUMN_DIR DIRECT /end RECORD_LAYOUT
/begin RECORD_LAYOUT _REC_CUR_20_u1_u2 FNC_VALUES 1 UBYTE COLUMN_DIR DIRECT /end RECORD_LAYOUT
/begin RECORD_LAYOUT _REC_CUR_20_u2_u2 FNC_VALUES 1 UWORD COLUMN_DIR DIRECT /end RECORD_LAYOUT
/begin RECORD_LAYOUT _REC_VAL_20_s1 FNC_VALUES 1 SBYTE COLUMN_DIR DIRECT /end RECORD_LAYOUT
/begin RECORD_LAYOUT _REC_VAL_20_u4 FNC_VALUES 1 ULONG COLUMN_DIR DIRECT /end RECORD_LAYOUT
/begin RECORD_LAYOUT _REC_VAL_20_s2 FNC_VALUES 1 SWORD COLUMN_DIR DIRECT /end RECORD_LAYOUT
/begin FUNCTION OBD_Tank_leakage_diagnosis_based "_Tank leakage diagnosis based on DMTL"
 /begin DEF_CHARACTERISTIC c_amp_dmtl_max c_cod_2_dmtl c_cod_dmtl c_crlc_cur_dmtl_fil c_crlc_cur_dmtl_fil_lim c_crlc_cur_dmtl_fil_refu c_crlc_vb_dmtl_fil c_crlc_vb_dmtl_fil_lim c_cur_dmtl_cor_fil_ofs_amp c_cur_dmtl_dif_cur_dmtl_stat c_cur_dmtl_ref_leak_max c_cur_dmtl_ref_leak_min c_cur_dmtl_ref_ofs c_ena_fco_diag c_fco_diag_max c_fco_diag_min c_ftl_dec_ftl_diag_min c_ftl_diag_max c_ftl_diag_min c_ftl_dmtl_max c_ftl_dmtl_min c_hys_ftl_dmtl c_r_dmtl c_sum_ena_rough_leak_max c_sum_ena_rough_leak_test_max c_sum_ena_small_leak_test_max c_sum_rep_rough_leak_mes_fuc_max c_t_cur_dmtl_rough_leak_max c_t_cur_dmtl_rough_leak_min c_t_cur_dmtl_stat c_t_dly_cur_dmtl_dif_mes c_t_dly_det_refu c_t_dly_dmtls c_t_dly_es_pwl c_t_dly_fuc_can_off c_t_dly_fuc_can_on c_t_dly_igk_ftl c_t_dly_req_pwl_dmtl c_t_dmtl_eol_max c_t_dmtl_max c_t_es_dmtl_min c_t_es_sub_dmtl c_t_ref_leak_mes_max c_t_ref_leak_mes_rep_max c_t_vb_dly_dmtl c_tam_dmtl_min c_tco_st_dmtl_min c_trt_dmtl_eol_max c_vb_dmtl_asa_max c_vb_dmtl_asa_min c_vb_dmtl_dif c_vb_dmtl_max c_vb_dmtl_min c_vs_ftl_diag_max c_t_ast_dmtl_max c_t_act_rough_leak c_t_act_small_leak ip_t_act_small_leak__ftl ip_fac_cur_dmtl_rough ip_fac_cur_dmtl_ref ip_t_cur_dmtl_stat c_t_ref_test_rough_leak c_fac_t_cur_dmtl_stat_len ip_fac_cur_dmtl c_tam_dmtl_max c_cl_dmtl_max c_vs_fuc_can_min c_vs_dmtl_max c_sum_cnl_rough_leak_mes_fuc_max c_sum_cnl_small_leak_mes_max c_cur_dmtl_ref_dif_max c_cur_dmtl_dif_thd_refu c_cur_dmtl_dif_thd_fuc c_cur_dmtl_dif_thd_mes c_dist_refu_rough_leak_min lc_cod_hdmtl ip_t_act_rough_leak c_t_dly_stop_refu c_t_ena_dr_dmtl_max /end DEF_CHARACTERISTIC
 /begin OUT_MEASUREMENT v_dmtl v_sof_swi v_sof_swi_mon ctr_cnl_rough_leak_mes_fuc ctr_cnl_small_leak_mes ctr_cur_dmtl_ref_dif_max ctr_dmtl_act ctr_rep_rough_leak_mes_fuc ctr_rough_leak_mes ctr_small_leak_mes cur_dmtl cur_dmtl_comp_rough_leak cur_dmtl_comp_small_leak_len cur_dmtl_cor_fil_max cur_dmtl_cor_fil_min cur_dmtl_cor_fil_refu_hpf cur_dmtl_dif cur_dmtl_dif_ref_rough_leak cur_dmtl_ref_leak cur_dmtl_rough_leak_len_end cur_dmtl_rough_leak_min cur_dmtl_thd_rough_leak_len fco_av_dmtl state_dmtl t_act_cur_dmtl_stat t_act_leak_mes t_act_ref_leak_mes t_es_dmtl cur_dmtl_dmtls_test cur_dmtl_thd_rough_leak cur_dmtl_thd_dmtls_test cur_dmtl_cor cur_dmtl_cor_fil vb_dmtl_ref vb_dmtl_fil ftl_ini ftl_old ctr_ena_rough_leak ctr_ena_rough_leak_test ctr_ena_small_leak_test dmtl_priv_state_1.bitfield.lv_chk_dmtl_cur_dmtl_vld dmtl_priv_state_1.bitfield.lv_chk_dmtl_vld dmtl_priv_state_1.bitfield.lv_cur_dmtl_dmtls_test dmtl_priv_state_1.bitfield.lv_cur_dmtl_ref_mes_max dmtl_priv_state_1.bitfield.lv_cur_dmtl_ref_mes_min dmtl_priv_state_1.bitfield.lv_cyc_rough_leak_susp dmtl_priv_state_1.bitfield.lv_dist_dmtl dmtl_priv_state_1.bitfield.lv_dmtl_asa dmtl_priv_state_1.bitfield.lv_dmtl_eol dmtl_priv_state_1.bitfield.lv_dmtl_pump dmtl_priv_state_1.bitfield.lv_dmtl_pump_on dmtl_priv_state_1.bitfield.lv_dmtl_rst_rough_leak dmtl_priv_state_1.bitfield.lv_dmtls dmtl_priv_state_1.bitfield.lv_dmtls_on dmtl_priv_state_1.bitfield.lv_dr_dmtl dmtl_priv_state_1.bitfield.lv_dr_dmtl_pump dmtl_priv_state_1.bitfield.lv_ena_fco_diag dmtl_priv_state_1.bitfield.lv_ena_ftl_diag dmtl_priv_state_2.bitfield.lv_ena_fuc_rough_leak_mes dmtl_priv_state_2.bitfield.lv_ena_main_dmtl dmtl_priv_state_2.bitfield.lv_ena_main_dmtl_fuc dmtl_priv_state_2.bitfield.lv_ena_rough_leak_1 dmtl_priv_state_2.bitfield.lv_ena_rough_leak_2 dmtl_priv_state_2.bitfield.lv_ena_rough_leak_3 dmtl_priv_state_2.bitfield.lv_ena_rough_leak_mes dmtl_priv_state_2.bitfield.lv_ena_rough_leak_mes_only dmtl_priv_state_2.bitfield.lv_ena_small_leak_1 dmtl_priv_state_2.bitfield.lv_ena_small_leak_mes_end dmtl_priv_state_2.bitfield.lv_err_det_small_leak_min dmtl_priv_state_2.bitfield.lv_fco_diag_max dmtl_priv_state_2.bitfield.lv_fco_diag_min dmtl_priv_state_2.bitfield.lv_fco_h_ftl dmtl_priv_state_2.bitfield.lv_ftl_dec dmtl_priv_state_2.bitfield.lv_ftl_dec_igk_on dmtl_priv_state_2.bitfield.lv_ftl_dmtl_max dmtl_priv_state_2.bitfield.lv_ftl_dmtl_min dmtl_priv_state_2.bitfield.lv_ftl_dmtl_val dmtl_priv_state_3.bitfield.lv_ftl_dyn dmtl_priv_state_3.bitfield.lv_ftl_inc dmtl_priv_state_3.bitfield.lv_ftl_inc_igk_on dmtl_priv_state_3.bitfield.lv_no_purge_dr_dmtl dmtl_priv_state_3.bitfield.lv_no_purge_dmtl_rough_leak dmtl_priv_state_3.bitfield.lv_no_purge_dmtl_small_leak dmtl_priv_state_4.bitfield.lv_ref_leak_rough_leak_susp dmtl_priv_state_4.bitfield.lv_refu dmtl_priv_state_4.bitfield.lv_refu_1 dmtl_priv_state_4.bitfield.lv_refu_end dmtl_priv_state_4.bitfield.lv_refu_rls_diag dmtl_priv_state_4.bitfield.lv_refu_val dmtl_priv_state_4.bitfield.lv_refu_val_1 dmtl_priv_state_4.bitfield.lv_req_ena_rough_leak dmtl_priv_state_4.bitfield.lv_req_pwl_rough_leak dmtl_priv_state_4.bitfield.lv_req_pwl_small_leak dmtl_priv_state_4.bitfield.lv_req_rough_leak dmtl_priv_state_4.bitfield.lv_rough_leak_susp dmtl_priv_state_4.bitfield.lv_small_leak_mes_len dmtl_priv_state_4.bitfield.lv_t_dly_dmtl_pwl dmtl_glob_state_1.bitfield.lv_ctr_cnl_small_leak_mes dmtl_glob_state_1.bitfield.lv_cur_dmtl_ref_dif_max dmtl_glob_state_1.bitfield.lv_cur_dmtl_thd_dif_mes dmtl_glob_state_1.bitfield.lv_det_fuc_open dmtl_glob_state_1.bitfield.lv_det_refu dmtl_glob_state_1.bitfield.lv_dist_det_rough_leak dmtl_glob_state_1.bitfield.lv_dmtl_act dmtl_glob_state_1.bitfield.lv_dmtl_stop dmtl_glob_state_1.bitfield.lv_ena_fuc dmtl_glob_state_1.bitfield.lv_ena_leak_dmtl dmtl_glob_state_1.bitfield.lv_ena_osc_rough_leak_mes dmtl_glob_state_1.bitfield.lv_ena_small_leak_mes dmtl_glob_state_1.bitfield.lv_ena_small_leak_refu dmtl_glob_state_1.bitfield.lv_err_det_dmtl_max dmtl_glob_state_1.bitfield.lv_err_det_dmtl_min dmtl_glob_state_1.bitfield.lv_err_det_rough_leak_min dmtl_glob_state_1.bitfield.lv_err_ftl dmtl_glob_state_1.bitfield.lv_err_ftl_plaus dmtl_glob_state_1.bitfield.lv_err_sig_dmtl dmtl_glob_state_1.bitfield.lv_err_small_leak dmtl_glob_state_1.bitfield.lv_ftl_diag dmtl_glob_state_1.bitfield.lv_fuc_can dmtl_glob_state_1.bitfield.lv_fuc_open dmtl_glob_state_1.bitfield.lv_no_purge_dmtl dmtl_glob_state_1.bitfield.lv_refu_dmtl dmtl_glob_state_2.bitfield.lv_req_pwl_dmtl dmtl_glob_state_2.bitfield.lv_rough_leak_susp_set dmtl_glob_state_2.bitfield.lv_rst_small_leak_mes_refu dmtl_glob_state_2.bitfield.lv_sdr_dmtl dmtl_glob_state_2.bitfield.lv_t_dmtl_max dmtl_glob_state_2.bitfield.lv_vb_dif_max dmtl_glob_state_2.bitfield.lv_hdmtl_on dmtl_glob_state_2.bitfield.lv_dr_dmtls dmtl_glob_state_2.bitfield.lv_vb_range_dmtl dmtl_glob_state_2.bitfield.lv_cyc_rough_leak_mode6 dmtl_glob_state_2.bitfield.lv_rough_leak_mes_len dmtl_glob_state_2.bitfield.lv_cyc_small_leak_mode6 cur_dmtl_small_leak_end cur_dmtl_ref_dif_max lv_err_dmtl_leak lv_err_dmtlm dist_dmtl /end OUT_MEASUREMENT
/end FUNCTION
/begin FUNCTION OBD_Downstream_oxygen_sensor_hea "_Downstream oxygen sensor heater OBDII monitoring"
 /begin DEF_CHARACTERISTIC c_pwm_min_obd2_lsh_down c_pwm_max_obd2_lsh_down c_t_dly_obd2_lsh_down c_temp_min_obd2_lsh_down c_temp_set_obd2_lsh_down c_egy_min_obd2_lsh_down c_tcc_obd2_lsh_down c_frc_obd2_lsh_down ip_r_thd_obd2_lsh_down ldp_r_down_ls_mdl_sens_new_r_thd ip_fac_maf_lsh_down ip_fac_teg_mdl_ls_down /end DEF_CHARACTERISTIC
 /begin OUT_MEASUREMENT lam_bank_1.lsh_down_obd2.pow_int_obd2_lsh_down lam_bank_1.lsh_down_obd2.state_obd2_lsh_down lam_bank_1.lsh_down_obd2.tcc_obd2_lsh_down lam_bank_1.lsh_down_obd2.frc_obd2_lsh_down lam_bank_1.lsh_down_obd2.ctr_cycnr_r_obd2_lsh_down lam_bank_1.lsh_down_obd2.r_down_ls_obd2_lsh_down lam_bank_1.lsh_down_obd2.temp_dif_obd2_lsh_down lam_bank_2.lsh_down_obd2.pow_int_obd2_lsh_down lam_bank_2.lsh_down_obd2.state_obd2_lsh_down lam_bank_2.lsh_down_obd2.tcc_obd2_lsh_down lam_bank_2.lsh_down_obd2.frc_obd2_lsh_down lam_bank_2.lsh_down_obd2.ctr_cycnr_r_obd2_lsh_down lam_bank_2.lsh_down_obd2.r_down_ls_obd2_lsh_down lam_bank_2.lsh_down_obd2.temp_dif_obd2_lsh_down lv_err_obd2_lsh_down_1 lv_err_obd2_lsh_down_2 /end OUT_MEASUREMENT
/end FUNCTION
/begin FUNCTION OBD_Application_incidence_cataly "_Application incidence catalyst efficiency diagnosis (OSC Method)" /begin DEF_CHARACTERISTIC lc_inh_cat_diag_man_deac /end DEF_CHARACTERISTIC /end FUNCTION
/begin FUNCTION OBD_Application_incidences_for_f "_Application incidences for fuel system diagnosis"
 /begin DEF_CHARACTERISTIC lc_inh_fsd_man_deac c_cl_mmv_max_fsd c_tco_min_fsd_pu c_t_dly_fsd_pu c_t_dly_fsd_reac c_t_ti_add_wf_dec_sum c_ti_add_wf_dec c_ti_add_wf_min_ldc c_ti_add_wf_sum_max /end DEF_CHARACTERISTIC
 /begin OUT_MEASUREMENT lv_inh_diag_fsd_cp lv_err_det_fsd_1 lv_err_det_fsd_2 ti_add_wf_sum t_ti_add_wf_dec_sum lv_ldc_fsd lv_inh_diag_fsd /end OUT_MEASUREMENT
/end FUNCTION
/begin FUNCTION OBD_Environmental_Data "_Environmental Data"
 /begin DEF_CHARACTERISTIC fmy_id_toil.envd fmy_id_tco_ex.envd fmy_id_tia.envd fmy_id_amp.envd fmy_id_maf.envd fmy_id_vls_down_max_1.envd fmy_id_vls_down_max_2.envd fmy_id_vls_down_min_cold_1.envd fmy_id_vls_down_min_cold_2.envd fmy_id_vls_down_min_1.envd fmy_id_vls_down_min_2.envd fmy_id_vls_down_oc_1.envd fmy_id_vls_down_oc_2.envd fmy_id_iv_0.envd fmy_id_iv_1.envd fmy_id_iv_2.envd fmy_id_iv_3.envd fmy_id_iv_4.envd fmy_id_iv_5.envd fmy_id_lsh_up_1.envd fmy_id_lsh_up_2.envd fmy_id_lsh_down_1.envd fmy_id_lsh_down_2.envd fmy_id_rly_efp.envd fmy_id_cps.envd fmy_id_mec_ivvt_in_1.envd fmy_id_mec_ivvt_ex_1.envd fmy_id_ref_ivvt_in_1.envd fmy_id_ref_ivvt_ex_1.envd fmy_id_slv_ivvt_in_1.envd fmy_id_slv_ivvt_ex_1.envd fmy_id_park_ivvt_in_1.envd fmy_id_park_ivvt_ex_1.envd fmy_id_ecu_cks.envd fmy_id_toil_level.envd fmy_id_tout_etcu_1.envd fmy_id_tout_etcu_2.envd fmy_id_tout_icl_2.envd fmy_id_tout_icl_3.envd fmy_id_tout_asr_1.envd fmy_id_tout_asr_3.envd fmy_id_tout_asr_4.envd fmy_id_tout_pste_1.envd fmy_id_tout_amt_1.envd fmy_id_vs.envd fmy_id_knks_1.envd fmy_id_knks_2.envd fmy_id_td_igc_cut_0.envd fmy_id_td_igc_cut_1.envd fmy_id_td_igc_cut_2.envd fmy_id_td_igc_cut_3.envd fmy_id_td_igc_cut_4.envd fmy_id_td_igc_cut_5.envd fmy_id_dur_igc_0.envd fmy_id_dur_igc_1.envd fmy_id_dur_igc_2.envd fmy_id_dur_igc_3.envd fmy_id_dur_igc_4.envd fmy_id_dur_igc_5.envd fmy_id_tps_1.envd fmy_id_tps_2.envd fmy_id_tps_maf_1.envd fmy_id_tps_maf_2.envd fmy_id_v_ref_1.envd fmy_id_v_ref_2.envd fmy_id_pvs_1.envd fmy_id_pvs_2.envd fmy_id_pvs_ratio.envd fmy_id_pvs_double.envd fmy_id_pvs_bls_not_plaus.envd fmy_id_mtc_dr.envd fmy_id_mtc_ctl_1.envd fmy_id_mtc_ctl_2.envd fmy_id_mtc_ctl_3.envd fmy_id_tps_ad.envd fmy_id_tps_ad_bol.envd fmy_id_tps_st_chk_1.envd fmy_id_tps_st_chk_2.envd fmy_id_gen.envd fmy_id_gen_if.envd fmy_id_gen_diag.envd fmy_id_vim.envd fmy_id_cam_per_0.envd fmy_id_cam_per_1.envd fmy_id_cam_psn_0.envd fmy_id_cam_psn_1.envd fmy_id_cam_0_not_plaus.envd fmy_id_cam_1_not_plaus.envd fmy_id_eng_psn.envd fmy_id_tooth_per.envd fmy_id_tpu_syn.envd fmy_id_crk_not_plaus.envd fmy_id_tout_txu_1.envd fmy_id_can_boff.envd fmy_id_rly_main.envd fmy_id_rly_main_dly.envd fmy_id_rly_accout.envd fmy_id_sap.envd fmy_id_sav.envd fmy_id_ecf.envd fmy_id_tco_plaus.envd fmy_id_tco_el.envd fmy_id_tco_grd.envd fmy_id_tco_stuck.envd fmy_id_ect_el.envd fmy_id_ect_mec.envd fmy_id_isc.envd fmy_id_im_bls_plaus.envd fmy_id_im_bts_plaus.envd fmy_id_msw_tog.envd fmy_id_msw_2.envd fmy_id_msw_3.envd fmy_id_isa_1.envd fmy_id_isa_2.envd fmy_id_seg_t_ad.envd fmy_id_seg_t.envd fmy_id_mis_0.envd fmy_id_mis_1.envd fmy_id_mis_2.envd fmy_id_mis_3.envd fmy_id_mis_4.envd fmy_id_mis_5.envd fmy_id_mis_low_fuel.envd fmy_id_mis_mpl.envd fmy_id_conv_mon_1.envd fmy_id_n_32_mon_1.envd fmy_id_pvs_mon_1.envd fmy_id_maf_tps_mon_1.envd fmy_id_tq_dif_isc_mon_1.envd fmy_id_tq_req_mon_1.envd fmy_id_tq_ext_mon_1.envd fmy_id_tqi_av_mon_1.envd fmy_id_tqi_n_max_mon_1.envd fmy_id_cru_inh_mon_1.envd fmy_id_tqi_n_max_nvmy_mon.envd fmy_id_sa_safm.envd fmy_id_sa_sap.envd fmy_id_sa_sys.envd fmy_id_sa_sav.envd fmy_id_imob_1.envd fmy_id_imob_2.envd fmy_id_imob_3.envd fmy_id_fsd_1.envd fmy_id_fsd_2.envd fmy_id_ls_down_swt_1.envd fmy_id_ls_down_swt_2.envd fmy_id_ls_down_pue_1.envd fmy_id_ls_down_pue_2.envd fmy_id_ef.envd fmy_id_tecu.envd fmy_id_ebox_cfa.envd fmy_id_ecu_ram.envd fmy_id_tqi_lim.envd fmy_id_obd2_lsh_down_1.envd fmy_id_obd2_lsh_down_2.envd fmy_id_dmtls.envd fmy_id_dmtl_pump.envd fmy_id_dmtlm.envd fmy_id_dmtl_leak.envd fmy_id_sof.envd fmy_id_sof_req.envd fmy_id_rly_st.envd fmy_id_bsd.envd fmy_id_poil_swi.envd fmy_id_tout_efp.envd fmy_id_diagcps.envd fmy_id_tq_gs_inc_plaus.envd fmy_id_dcc.envd fmy_id_ecras.envd fmy_id_dmtlh.envd fmy_id_cs.envd fmy_id_spi_mps.envd fmy_id_spi_knk.envd fmy_id_bn_tq_dcc.envd fmy_id_bn_tq_pste_2.envd fmy_id_bn_ars.envd fmy_id_bn_cas.envd fmy_id_bn_tq_tcs.envd fmy_id_bn_vs_tcs.envd fmy_id_bn_tcs.envd fmy_id_bn_tq_etcu.envd fmy_id_bn_etcu.envd fmy_id_bn_tq_amt.envd fmy_id_bn_acc.envd fmy_id_bn_t_icl.envd fmy_id_bn_veh_mod.envd fmy_id_bn_km_icl.envd fmy_id_bn_icl.envd fmy_id_bn_pow_vb.envd fmy_id_bn_pow_gen.envd fmy_id_bn_msw.envd fmy_id_bn_ang_pste.envd fmy_id_bn_efp.envd fmy_id_load_tps_plaus.envd fmy_id_efp_crash.envd fmy_id_efp.envd fmy_id_locan_boff.envd fmy_id_chg_ls_up.envd fmy_id_chg_ls_down.envd fmy_id_qoil_sens.envd fmy_id_bat_sens.envd fmy_id_bat_sens_it.envd fmy_id_bat_sens_it_el.envd fmy_id_ecu_nvmy.envd fmy_id_gs.envd fmy_id_o3_conc.envd fmy_id_ls_up_shift_afl_1.envd fmy_id_ls_up_shift_afl_2.envd fmy_id_ls_up_shift_afr_1.envd fmy_id_ls_up_shift_afr_2.envd fmy_id_oc_lsl_1.envd fmy_id_oc_lsl_2.envd fmy_id_cat_diag_1.envd fmy_id_cat_diag_2.envd fmy_id_el_lsl_1.envd fmy_id_el_lsl_2.envd fmy_id_cat_diag_nox_1.envd fmy_id_cat_diag_nox_2.envd fmy_id_vls_down_puc_1.envd fmy_id_vls_down_puc_2.envd fmy_id_vls_down_fl_1.envd fmy_id_vls_down_fl_2.envd fmy_id_chk_ls_down_1.envd fmy_id_chk_ls_down_2.envd fmy_id_delta_lamb_i_1.envd fmy_id_delta_lamb_i_2.envd fmy_id_o3_up.envd fmy_id_o3_down.envd fmy_id_obd2_ttip_ls_up_1.envd fmy_id_obd2_ttip_ls_up_2.envd fmy_id_lsh_ls_up_1.envd fmy_id_lsh_ls_up_2.envd fmy_id_vls_up_thd_over_1.envd fmy_id_vls_up_thd_over_2.envd fmy_id_tout_nox_sens_1.envd fmy_id_nox_sens_1.envd fmy_id_tout_nox_sens_2.envd fmy_id_nox_sens_2.envd fmy_id_if_lsl_1.envd fmy_id_if_lsl_2.envd fmy_id_ls_up_dyn_vld_1.envd fmy_id_ls_up_dyn_vld_2.envd fmy_id_ls_up_puc_vld_1.envd fmy_id_ls_up_puc_vld_2.envd fmy_id_lsh_up_obd2_vld_1.envd fmy_id_lsh_up_obd2_vld_2.envd fmy_id_nox_sens_htp_1.envd fmy_id_nox_sens_plaus_1.envd fmy_id_nox_sens_avl_1.envd fmy_id_nox_sens_dyn_1.envd fmy_id_nox_sens_ref_air_1.envd fmy_id_nox_sens_htp_2.envd fmy_id_nox_sens_plaus_2.envd fmy_id_nox_sens_avl_2.envd fmy_id_nox_sens_dyn_2.envd fmy_id_nox_sens_ref_air_2.envd /end DEF_CHARACTERISTIC
/end FUNCTION
/end MODULE
/end PROJECT
