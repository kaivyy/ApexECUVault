ASAP2_VERSION 1 41
/begin PROJECT MSD70 "Spray Guided DI-System with Piezo Injectors for 6-Cylinder"
/begin HEADER "_default_HeaderComment" PROJECT_NO _0B /end HEADER
/begin MODULE _default_ModuleName "_default_ModuleLongIdentifier"
/begin MOD_COMMON "_default_ModCommonComment" DEPOSIT ABSOLUTE BYTE_ORDER MSB_LAST ALIGNMENT_BYTE 1 ALIGNMENT_WORD 2 ALIGNMENT_LONG 2 ALIGNMENT_FLOAT32_IEEE 2 ALIGNMENT_FLOAT64_IEEE 4 /end MOD_COMMON
/begin CHARACTERISTIC c_maf_lam_cyl_min "Minimum mass air flow for the activation" VALUE 0xa1029550 _REC_VAL_20_u2 1389. _CNV_A_R_LINEAR_____108_CM 0. 1389. DISPLAY_IDENTIFIER C_MAF_LAM_CYL_MIN FORMAT "%7.2" /end CHARACTERISTIC
/begin CHARACTERISTIC c_maf_lam_cyl_max "Maximum mass air flow for the activation" VALUE 0xa102954e _REC_VAL_20_u2 1389. _CNV_A_R_LINEAR_____108_CM 0. 1389. DISPLAY_IDENTIFIER C_MAF_LAM_CYL_MAX FORMAT "%7.2" /end CHARACTERISTIC
/begin CHARACTERISTIC c_n_lam_cyl_max "Maximum engine speed for the activation" VALUE 0xa1029602 _REC_VAL_20_u2 8160. _CNV_A_R_LINEAR_____13_CM 0. 8160. DISPLAY_IDENTIFIER C_N_LAM_CYL_MAX FORMAT "%4.0" /end CHARACTERISTIC
/begin MEASUREMENT lv_lam_cyl_ena_2 "Activation of the cylinder individual lambda control is open" UBYTE _CNV_S_2_RANGE__0___1_CM 1 100. 0. 1. DISPLAY_IDENTIFIER LV_LAM_CYL_ENA_2 ECU_ADDRESS 0xd0003b0c BIT_MASK 0x1 /end MEASUREMENT
/begin MEASUREMENT pha_shift_cam_ex_1 "variable phase shift (variable valve timing)" SBYTE _CNV_A_R_LINEAR_____109_CM 1 100. -720. 720. DISPLAY_IDENTIFIER PHA_SHIFT_CAM_EX_1 ECU_ADDRESS 0xd0003b08 FORMAT "%6.1" /end MEASUREMENT
/begin MEASUREMENT pha_shift_cam_ex_2 "variable phase shift (variable valve timing)" SBYTE _CNV_A_R_LINEAR_____109_CM 1 100. -720. 720. DISPLAY_IDENTIFIER PHA_SHIFT_CAM_EX_2 ECU_ADDRESS 0xd0003b09 FORMAT "%6.1" /end MEASUREMENT
/begin CHARACTERISTIC c_amp_lam_cyl_min "Minimum ambient pressure for the activation" VALUE 0xa1029192 _REC_VAL_20_u2 5434. _CNV_A_R_LINEAR_____26_CM 0. 5434. DISPLAY_IDENTIFIER C_AMP_LAM_CYL_MIN FORMAT "%7.2" /end CHARACTERISTIC
/begin CHARACTERISTIC c_fac_mv_ls_up_dyn_lam_cyl_thd "CILC-specific threshold of limit-sensor" VALUE 0xa1029394 _REC_VAL_20_u2 31.9990234375 _CNV_A_R_LINEAR_____122_CM 0. 31.9990234375 DISPLAY_IDENTIFIER C_FAC_MV_LS_UP_DYN_LAM_CYL_THD FORMAT "%7.4" /end CHARACTERISTIC
/begin CHARACTERISTIC c_cl_mmv_lam_cyl_max "max. canister load" VALUE 0xa10291b8 _REC_VAL_20_u2 7.9998779296875 _CNV_A_R_LINEAR_____113_CM 0. 7.9998779296875 DISPLAY_IDENTIFIER C_CL_MMV_LAM_CYL_MAX FORMAT "%6.4" /end CHARACTERISTIC
/begin CHARACTERISTIC lc_lam_cyl_ena_cdn_man "manual switch to enable the cylinder individual lambda control ignoring the conditions are fulfilled" VALUE 0xa1029d6f _REC_VAL_20_u1 1. _CNV_A_R_LINEAR_____0_CM 0. 1. DISPLAY_IDENTIFIER LC_LAM_CYL_ENA_CDN_MAN FORMAT "%1.0" /end CHARACTERISTIC
/begin CHARACTERISTIC c_teg_cat_up_mdl_lam_cyl_max "max. exhaust gas temperature; engine out-alternative value for sensor hexagon temperature" VALUE 0xa1029a0a _REC_VAL_20_u2 2047. _CNV_A_R_LINEAR_____123_CM 0. 2047. DISPLAY_IDENTIFIER C_TEG_CAT_UP_MDL_LAM_CYL_MAX FORMAT "%9.4" /end CHARACTERISTIC
/begin MEASUREMENT lv_lam_cyl_ena_1 "Activation of the cylinder individual lambda control is open" UBYTE _CNV_S_2_RANGE__0___1_CM 1 100. 0. 1. DISPLAY_IDENTIFIER LV_LAM_CYL_ENA_1 ECU_ADDRESS 0xd0003b0a BIT_MASK 0x1 /end MEASUREMENT
/begin MEASUREMENT lv_lam_cyl_ena_cyl_bal_dc_1 "Specific activation conditions for cylinder individual lambda control are fulfilled in DC (CYBL coordination)" UBYTE _CNV_S_2_RANGE__0___1_CM 1 100. 0. 1. DISPLAY_IDENTIFIER LV_LAM_CYL_ENA_CYL_BAL_DC_1 ECU_ADDRESS 0xd0003b0b BIT_MASK 0x1 /end MEASUREMENT
/begin MEASUREMENT lv_lam_cyl_ena_cyl_bal_dc_2 "Specific activation conditions for cylinder individual lambda control are fulfilled in DC (CYBL coordination)" UBYTE _CNV_S_2_RANGE__0___1_CM 1 100. 0. 1. DISPLAY_IDENTIFIER LV_LAM_CYL_ENA_CYL_BAL_DC_2 ECU_ADDRESS 0xd0003b0d BIT_MASK 0x1 /end MEASUREMENT
/begin MEASUREMENT lv_n_cdn_lam_cyl_ena "Engine speed condition for the activation of the cylinder individual lambda control fulfilled" UBYTE _CNV_S_2_RANGE__0___1_CM 1 100. 0. 1. DISPLAY_IDENTIFIER LV_N_CDN_LAM_CYL_ENA ECU_ADDRESS 0xc00004f8 BIT_MASK 0x1 /end MEASUREMENT
/begin CHARACTERISTIC c_n_lam_cyl_min "Minimum engine speed for the activation" VALUE 0xa1029606 _REC_VAL_20_u2 8160. _CNV_A_R_LINEAR_____13_CM 0. 8160. DISPLAY_IDENTIFIER C_N_LAM_CYL_MIN FORMAT "%4.0" /end CHARACTERISTIC
/begin CHARACTERISTIC c_n_lam_cyl_min_eol "Minimum engine speed for the activation at EOL" VALUE 0xa1029608 _REC_VAL_20_u2 8160. _CNV_A_R_LINEAR_____13_CM 0. 8160. DISPLAY_IDENTIFIER C_N_LAM_CYL_MIN_EOL FORMAT "%4.0" /end CHARACTERISTIC
/begin CHARACTERISTIC c_n_lam_cyl_max_eol "Maximum engine speed for the activation at EOL" VALUE 0xa1029604 _REC_VAL_20_u2 8160. _CNV_A_R_LINEAR_____13_CM 0. 8160. DISPLAY_IDENTIFIER C_N_LAM_CYL_MAX_EOL FORMAT "%4.0" /end CHARACTERISTIC
/begin CHARACTERISTIC c_wgpwm_max_lam_cyl_sel "Maximum threshold of waste gate signal for activation of cylinder individual lambda control" VALUE 0xa1029cde _REC_VAL_20_u2 99.99847412109381 _CNV_A_R_LINEAR_____7_CM 0. 99.99847412109381 DISPLAY_IDENTIFIER C_WGPWM_MAX_LAM_CYL_SEL /end CHARACTERISTIC
/begin AXIS_PTS ldpm_tco_1_igsp "" 0xa102220c tco _REC_AXS_20_u1 190.5 _CNV_A_R_LINEAR_____16_CM 8 -48. 142.5 FORMAT "%5.1" /end AXIS_PTS
/begin MEASUREMENT iga_st "Basic ignition angle at start" UBYTE _CNV_A_R_LINEAR_____167_CM 1 100. -35.625 60. DISPLAY_IDENTIFIER IGA_ST ECU_ADDRESS 0xd0003cf0 FORMAT "%5.1" /end MEASUREMENT
/begin CHARACTERISTIC ip_iga_st_bas_opm_1 "Basic ignition angle at start at operation mode 1" MAP 0xa10257bc _REC_MAP_20_u1_u2_u1 4.78125 _CNV_A_R_LINEAR_____167_CM -35.625 60. DISPLAY_IDENTIFIER IP_IGA_ST_BAS_OPM_1 FORMAT "%5.1"
 /begin AXIS_DESCR COM_AXIS n _CNV_A_R_LINEAR_____13_CM 6 0. 8160. FORMAT "%4.0" AXIS_PTS_REF ldpm_n_1_iga_st /end AXIS_DESCR
 /begin AXIS_DESCR COM_AXIS tco _CNV_A_R_LINEAR_____16_CM 8 -48. 142.5 FORMAT "%5.1" AXIS_PTS_REF ldpm_tco_1_igsp /end AXIS_DESCR
/end CHARACTERISTIC
/begin CHARACTERISTIC ip_iga_st_cyc_st_cor_opm_1 "Correction of the basic ignition angle at start dependen on the start cycle counter at operation mode 1" MAP 0xa102581c _REC_MAP_20_u1_u1_u1 4.78125 _CNV_A_R_LINEAR_____171_CM -48. 47.625 DISPLAY_IDENTIFIER IP_IGA_ST_CYC_ST_COR_OPM_1 FORMAT "%5.1"
 /begin AXIS_DESCR COM_AXIS NO_INPUT_QUANTITY _CNV_A_R_LINEAR_____0_CM 6 0. 255. FORMAT "%3.0" AXIS_PTS_REF ldpm_cyc_1_iga_st /end AXIS_DESCR
 /begin AXIS_DESCR COM_AXIS tco _CNV_A_R_LINEAR_____16_CM 8 -48. 142.5 FORMAT "%5.1" AXIS_PTS_REF ldpm_tco_1_igsp /end AXIS_DESCR
/end CHARACTERISTIC
/begin CHARACTERISTIC ip_iga_st_amp_cor_opm_1 "Ambient pressure correction of the basic ignition angle at start at operation mode 1" CURVE 0xa10257b0 _REC_CUR_20_u1_u2 4.78125 _CNV_A_R_LINEAR_____171_CM -48. 47.625 DISPLAY_IDENTIFIER IP_IGA_ST_AMP_COR_OPM_1 FORMAT "%5.1"
 /begin AXIS_DESCR COM_AXIS amp _CNV_A_R_LINEAR_____26_CM 6 0. 5434. FORMAT "%7.2" AXIS_PTS_REF ldpm_amp_1_iga_st /end AXIS_DESCR
/end CHARACTERISTIC
/begin AXIS_PTS ldpm_cyc_1_iga_st "" 0xa1021942 NO_INPUT_QUANTITY _REC_AXS_20_u1 255. _CNV_A_R_LINEAR_____0_CM 6 0. 255. FORMAT "%3.0" /end AXIS_PTS
/begin AXIS_PTS ldpm_n_1_iga_st "" 0xa1021d28 n _REC_AXS_20_u2 8160. _CNV_A_R_LINEAR_____13_CM 6 0. 8160. FORMAT "%4.0" /end AXIS_PTS
/begin AXIS_PTS ldpm_amp_1_iga_st "" 0xa10218ec amp _REC_AXS_20_u2 5434. _CNV_A_R_LINEAR_____26_CM 6 0. 5434. FORMAT "%7.2" /end AXIS_PTS
/begin CHARACTERISTIC ip_iga_st_bas_opm_2 "Basic ignition angle at start at operation mode 2" MAP 0xa10257ec _REC_MAP_20_u1_u2_u1 4.78125 _CNV_A_R_LINEAR_____167_CM -35.625 60. DISPLAY_IDENTIFIER IP_IGA_ST_BAS_OPM_2 FORMAT "%5.1"
 /begin AXIS_DESCR COM_AXIS n _CNV_A_R_LINEAR_____13_CM 6 0. 8160. FORMAT "%4.0" AXIS_PTS_REF ldpm_n_1_iga_st /end AXIS_DESCR
 /begin AXIS_DESCR COM_AXIS tco _CNV_A_R_LINEAR_____16_CM 8 -48. 142.5 FORMAT "%5.1" AXIS_PTS_REF ldpm_tco_1_igsp /end AXIS_DESCR
/end CHARACTERISTIC
/begin CHARACTERISTIC ip_iga_st_cyc_st_cor_opm_2 "Correction of the basic ignition angle at start dependen on the start cycle counter at operation mode 2" MAP 0xa102584c _REC_MAP_20_u1_u1_u1 4.78125 _CNV_A_R_LINEAR_____171_CM -48. 47.625 DISPLAY_IDENTIFIER IP_IGA_ST_CYC_ST_COR_OPM_2 FORMAT "%5.1"
 /begin AXIS_DESCR COM_AXIS NO_INPUT_QUANTITY _CNV_A_R_LINEAR_____0_CM 6 0. 255. FORMAT "%3.0" AXIS_PTS_REF ldpm_cyc_1_iga_st /end AXIS_DESCR
 /begin AXIS_DESCR COM_AXIS tco _CNV_A_R_LINEAR_____16_CM 8 -48. 142.5 FORMAT "%5.1" AXIS_PTS_REF ldpm_tco_1_igsp /end AXIS_DESCR
/end CHARACTERISTIC
/begin CHARACTERISTIC ip_iga_st_amp_cor_opm_2 "Ambient pressure correction of the basic ignition angle at start at operation mode 2" CURVE 0xa10257b6 _REC_CUR_20_u1_u2 4.78125 _CNV_A_R_LINEAR_____171_CM -48. 47.625 DISPLAY_IDENTIFIER IP_IGA_ST_AMP_COR_OPM_2 FORMAT "%5.1"
 /begin AXIS_DESCR COM_AXIS amp _CNV_A_R_LINEAR_____26_CM 6 0. 5434. FORMAT "%7.2" AXIS_PTS_REF ldpm_amp_1_iga_st /end AXIS_DESCR
/end CHARACTERISTIC
/begin CHARACTERISTIC ip_iga_st_tia_cor_opm_1 "Ambient pressure correction of the basic ignition angle at start at operation mode 1" CURVE 0xa102587c _REC_CUR_20_u1_u1 95.625 _CNV_A_R_LINEAR_____171_CM -48. 47.625 DISPLAY_IDENTIFIER IP_IGA_ST_TIA_COR_OPM_1 FORMAT "%5.1"
 /begin AXIS_DESCR COM_AXIS tia _CNV_A_R_LINEAR_____16_CM 6 -48. 142.5 FORMAT "%5.1" AXIS_PTS_REF ldpm_tia_1_iga_st /end AXIS_DESCR
/end CHARACTERISTIC
/begin CHARACTERISTIC ip_iga_st_tia_cor_opm_2 "Ambient pressure correction of the basic ignition angle at start at operation mode 2" CURVE 0xa1025882 _REC_CUR_20_u1_u1 95.625 _CNV_A_R_LINEAR_____171_CM -48. 47.625 DISPLAY_IDENTIFIER IP_IGA_ST_TIA_COR_OPM_2 FORMAT "%5.1"
 /begin AXIS_DESCR COM_AXIS tia _CNV_A_R_LINEAR_____16_CM 6 -48. 142.5 FORMAT "%5.1" AXIS_PTS_REF ldpm_tia_1_iga_st /end AXIS_DESCR
/end CHARACTERISTIC
/begin AXIS_PTS ldpm_tia_1_iga_st "" 0xa1022306 tia _REC_AXS_20_u1 190.5 _CNV_A_R_LINEAR_____16_CM 6 -48. 142.5 FORMAT "%5.1" /end AXIS_PTS
/begin MEASUREMENT iga_min_teg_h_rng "minimum ignition angle" SWORD _CNV_A_R_LINEAR_____166_CM 1 100. -90. 90. DISPLAY_IDENTIFIER IGA_MIN_TEG_H_RNG ECU_ADDRESS 0xd000512e FORMAT "%8.4" /end MEASUREMENT
/begin MEASUREMENT iga_dif_min_teg_h_rng "Difference of minimum ignition angle with reference one - TEG correction included" UWORD _CNV_A_R_LINEAR_____169_CM 1 100. 0. -180. DISPLAY_IDENTIFIER IGA_DIF_MIN_TEG_H_RNG ECU_ADDRESS 0xd0005130 FORMAT "%8.4" /end MEASUREMENT
/begin CHARACTERISTIC c_teg_max_iga_hys "Hysterisis on exhaust gas temperature for spark retard control" VALUE 0xa1029a18 _REC_VAL_20_u2 2047. _CNV_A_R_LINEAR_____123_CM 0. 2047. DISPLAY_IDENTIFIER C_TEG_MAX_IGA_HYS FORMAT "%7.2" /end CHARACTERISTIC
/begin CHARACTERISTIC c_teg_max_iga "Maximum allowable exhaust gas temperature for spark retard control" VALUE 0xa1029a16 _REC_VAL_20_u2 2047. _CNV_A_R_LINEAR_____123_CM 0. 2047. DISPLAY_IDENTIFIER C_TEG_MAX_IGA FORMAT "%7.2" /end CHARACTERISTIC
/begin CHARACTERISTIC ip_iga_dif_min_teg_h_rng__teg "Minimum ignition angle versus exhaust gas temperature" CURVE 0xa1025424 _REC_CUR_20_u2_u2 -180. _CNV_A_R_LINEAR_____169_CM 0. -180. DISPLAY_IDENTIFIER IP_IGA_DIF_MIN_TEG_H_RNG__TEG FORMAT "%8.4"
 /begin AXIS_DESCR COM_AXIS teg_dyn_hys _CNV_A_R_LINEAR_____123_CM 16 0. 2047. FORMAT "%7.2" AXIS_PTS_REF ldp_teg_dyn_hys /end AXIS_DESCR
/end CHARACTERISTIC
/begin MEASUREMENT teg_dyn_hys "Temperature of exhaust gas with hysterisis for IGA_MIN limitation" UWORD _CNV_A_R_LINEAR_____123_CM 1 100. 0. 2047. DISPLAY_IDENTIFIER TEG_DYN_HYS ECU_ADDRESS 0xc0000770 FORMAT "%7.2" /end MEASUREMENT
/begin MEASUREMENT teg_cat_up_mdl_max "Maximal temperature of exhaust gas between all cylinder bank" UWORD _CNV_A_R_LINEAR_____123_CM 1 100. 0. 2047. DISPLAY_IDENTIFIER TEG_CAT_UP_MDL_MAX ECU_ADDRESS 0xd000512c FORMAT "%7.2" /end MEASUREMENT
/begin AXIS_PTS ldp_teg_dyn_hys "" 0xa10212e8 teg_dyn_hys _REC_AXS_20_u2 2047. _CNV_A_R_LINEAR_____123_CM 16 0. 2047. FORMAT "%7.2" /end AXIS_PTS
/begin MEASUREMENT iga_min_teg "minimum ignition angle" UBYTE _CNV_A_R_LINEAR_____167_CM 1 100. -35.625 60. DISPLAY_IDENTIFIER IGA_MIN_TEG ECU_ADDRESS 0xd0003d18 FORMAT "%5.1" /end MEASUREMENT
/begin MEASUREMENT iga_dif_min_teg "Difference of minimum ignition angle with reference one - TEG correction included" UBYTE _CNV_A_R_LINEAR_____174_CM 1 100. 0. -95.625 DISPLAY_IDENTIFIER IGA_DIF_MIN_TEG ECU_ADDRESS 0xd0003d19 FORMAT "%5.1" /end MEASUREMENT
/begin CHARACTERISTIC ip_iga_dif_min_teg__teg "Minimum ignition angle versus exhaust gas temperature" CURVE 0xa1025414 _REC_CUR_20_u1_u2 -95.625 _CNV_A_R_LINEAR_____174_CM 0. -95.625 DISPLAY_IDENTIFIER IP_IGA_DIF_MIN_TEG__TEG FORMAT "%5.1"
 /begin AXIS_DESCR COM_AXIS teg_dyn_hys _CNV_A_R_LINEAR_____123_CM 16 0. 2047. FORMAT "%7.2" AXIS_PTS_REF ldp_teg_dyn_hys /end AXIS_DESCR
/end CHARACTERISTIC
/begin CHARACTERISTIC ip_maf_min_knk__n__tco "Air-mass Threshold Release KNK" MAP 0xa102614c _REC_MAP_20_u1_u1_u1 1389. _CNV_A_R_LINEAR_____14_CM 0. 1389. DISPLAY_IDENTIFIER IP_MAF_MIN_KNK__N__TCO FORMAT "%4.0"
 /begin AXIS_DESCR COM_AXIS n_32 _CNV_A_R_LINEAR_____9_CM 8 0. 8160. FORMAT "%4.0" AXIS_PTS_REF ldpm_n_3_9 /end AXIS_DESCR
 /begin AXIS_DESCR COM_AXIS tco _CNV_A_R_LINEAR_____16_CM 4 -48. 142.5 FORMAT "%3.0" AXIS_PTS_REF ldp_tco__maf_min_knk /end AXIS_DESCR
/end CHARACTERISTIC
/begin CHARACTERISTIC id_iga_dec_knk_1__n "Spark retard at recognised knocking, Intensity 1" CURVE 0xa10229bc _REC_CUR_20_u1_u1 47.25 _CNV_A_R_LINEAR_____187_CM 0.375 47.625 DISPLAY_IDENTIFIER ID_IGA_DEC_KNK_1__N FORMAT "%4.1"
 /begin AXIS_DESCR COM_AXIS n_knk _CNV_A_R_LINEAR_____9_CM 3 0. 8160. FORMAT "%4.0" AXIS_PTS_REF ldpm_n_4_9 /end AXIS_DESCR
/end CHARACTERISTIC
/begin CHARACTERISTIC id_iga_dec_knk_2__n "Spark retard at recognised knocking, Intensity 2" CURVE 0xa10229c0 _REC_CUR_20_u1_u1 47.25 _CNV_A_R_LINEAR_____187_CM 0.375 47.625 DISPLAY_IDENTIFIER ID_IGA_DEC_KNK_2__N FORMAT "%4.1"
 /begin AXIS_DESCR COM_AXIS n_knk _CNV_A_R_LINEAR_____9_CM 3 0. 8160. FORMAT "%4.0" AXIS_PTS_REF ldpm_n_4_9 /end AXIS_DESCR
/end CHARACTERISTIC
/begin CHARACTERISTIC id_n_grd_max_knk__n "Speed Gradient for dynamic identification" CURVE 0xa1022da8 _REC_CUR_20_u1_u1 4064. _CNV_A_R_LINEAR_____29_CM 0. 4064. DISPLAY_IDENTIFIER ID_N_GRD_MAX_KNK__N FORMAT "%4.0"
 /begin AXIS_DESCR COM_AXIS n_knk _CNV_A_R_LINEAR_____9_CM 8 0. 8160. FORMAT "%4.0" AXIS_PTS_REF ldpm_n_iga_ad /end AXIS_DESCR
/end CHARACTERISTIC
/begin CHARACTERISTIC ip_iga_inc_knk__n "Re-set Increment KNK" CURVE 0xa1025490 _REC_CUR_20_u2_u1 47.99707032000001 _CNV_A_R_LINEAR_____188_CM 1.46484e-003 47.99853516 DISPLAY_IDENTIFIER IP_IGA_INC_KNK__N FORMAT "%8.5"
 /begin AXIS_DESCR COM_AXIS n_knk _CNV_A_R_LINEAR_____9_CM 4 0. 8160. FORMAT "%4.0" AXIS_PTS_REF ldpm_n_fil_frq_knk /end AXIS_DESCR
/end CHARACTERISTIC
/begin MEASUREMENT iga_knk[0] "Spark retard through knock control without Adaptation(cylinder individual)" UBYTE _CNV_A_R_LINEAR_____171_CM 1 100. -48. 0. DISPLAY_IDENTIFIER IGA_KNK[0] ECU_ADDRESS 0xd0003d4c FORMAT "%7.3" /end MEASUREMENT
/begin MEASUREMENT iga_knk[1] "Spark retard through knock control without Adaptation(cylinder individual)" UBYTE _CNV_A_R_LINEAR_____171_CM 1 100. -48. 0. DISPLAY_IDENTIFIER IGA_KNK[1] ECU_ADDRESS 0xd0003d4d FORMAT "%7.3" /end MEASUREMENT
/begin MEASUREMENT iga_knk[2] "Spark retard through knock control without Adaptation(cylinder individual)" UBYTE _CNV_A_R_LINEAR_____171_CM 1 100. -48. 0. DISPLAY_IDENTIFIER IGA_KNK[2] ECU_ADDRESS 0xd0003d4e FORMAT "%7.3" /end MEASUREMENT
/begin MEASUREMENT iga_knk[3] "Spark retard through knock control without Adaptation(cylinder individual)" UBYTE _CNV_A_R_LINEAR_____171_CM 1 100. -48. 0. DISPLAY_IDENTIFIER IGA_KNK[3] ECU_ADDRESS 0xd0003d4f FORMAT "%7.3" /end MEASUREMENT
/begin MEASUREMENT iga_knk[4] "Spark retard through knock control without Adaptation(cylinder individual)" UBYTE _CNV_A_R_LINEAR_____171_CM 1 100. -48. 0. DISPLAY_IDENTIFIER IGA_KNK[4] ECU_ADDRESS 0xd0003d50 FORMAT "%7.3" /end MEASUREMENT
/begin MEASUREMENT iga_knk[5] "Spark retard through knock control without Adaptation(cylinder individual)" UBYTE _CNV_A_R_LINEAR_____171_CM 1 100. -48. 0. DISPLAY_IDENTIFIER IGA_KNK[5] ECU_ADDRESS 0xd0003d51 FORMAT "%7.3" /end MEASUREMENT
/begin MEASUREMENT knk_thd[0] "Knock Threshold cylinder x" UBYTE _CNV_A_R_LINEAR_____189_CM 1 100. 0. 4.998 DISPLAY_IDENTIFIER KNK_THD[0] ECU_ADDRESS 0xd0003d54 FORMAT "%6.4" /end MEASUREMENT
/begin MEASUREMENT knk_thd[1] "Knock Threshold cylinder x" UBYTE _CNV_A_R_LINEAR_____189_CM 1 100. 0. 4.998 DISPLAY_IDENTIFIER KNK_THD[1] ECU_ADDRESS 0xd0003d55 FORMAT "%6.4" /end MEASUREMENT
/begin MEASUREMENT knk_thd[2] "Knock Threshold cylinder x" UBYTE _CNV_A_R_LINEAR_____189_CM 1 100. 0. 4.998 DISPLAY_IDENTIFIER KNK_THD[2] ECU_ADDRESS 0xd0003d56 FORMAT "%6.4" /end MEASUREMENT
/begin MEASUREMENT knk_thd[3] "Knock Threshold cylinder x" UBYTE _CNV_A_R_LINEAR_____189_CM 1 100. 0. 4.998 DISPLAY_IDENTIFIER KNK_THD[3] ECU_ADDRESS 0xd0003d57 FORMAT "%6.4" /end MEASUREMENT
/begin MEASUREMENT knk_thd[4] "Knock Threshold cylinder x" UBYTE _CNV_A_R_LINEAR_____189_CM 1 100. 0. 4.998 DISPLAY_IDENTIFIER KNK_THD[4] ECU_ADDRESS 0xd0003d58 FORMAT "%6.4" /end MEASUREMENT
/begin MEASUREMENT knk_thd[5] "Knock Threshold cylinder x" UBYTE _CNV_A_R_LINEAR_____189_CM 1 100. 0. 4.998 DISPLAY_IDENTIFIER KNK_THD[5] ECU_ADDRESS 0xd0003d59 FORMAT "%6.4" /end MEASUREMENT
/begin MEASUREMENT knks_cmd_fil[0] "Knock Filter Frequency and Reference Filter Frequency Cyl.x" UBYTE _CNV_A_R_LINEAR_____0_CM 1 100. 0. 63. DISPLAY_IDENTIFIER KNKS_CMD_FIL[0] ECU_ADDRESS 0xd0003d34 FORMAT "%2.0" /end MEASUREMENT
/begin MEASUREMENT knks_cmd_fil[1] "Knock Filter Frequency and Reference Filter Frequency Cyl.x" UBYTE _CNV_A_R_LINEAR_____0_CM 1 100. 0. 63. DISPLAY_IDENTIFIER KNKS_CMD_FIL[1] ECU_ADDRESS 0xd0003d35 FORMAT "%2.0" /end MEASUREMENT
/begin MEASUREMENT knks_cmd_fil[2] "Knock Filter Frequency and Reference Filter Frequency Cyl.x" UBYTE _CNV_A_R_LINEAR_____0_CM 1 100. 0. 63. DISPLAY_IDENTIFIER KNKS_CMD_FIL[2] ECU_ADDRESS 0xd0003d36 FORMAT "%2.0" /end MEASUREMENT
/begin MEASUREMENT knks_cmd_fil[3] "Knock Filter Frequency and Reference Filter Frequency Cyl.x" UBYTE _CNV_A_R_LINEAR_____0_CM 1 100. 0. 63. DISPLAY_IDENTIFIER KNKS_CMD_FIL[3] ECU_ADDRESS 0xd0003d37 FORMAT "%2.0" /end MEASUREMENT
/begin MEASUREMENT knks_cmd_fil[4] "Knock Filter Frequency and Reference Filter Frequency Cyl.x" UBYTE _CNV_A_R_LINEAR_____0_CM 1 100. 0. 63. DISPLAY_IDENTIFIER KNKS_CMD_FIL[4] ECU_ADDRESS 0xd0003d38 FORMAT "%2.0" /end MEASUREMENT
/begin MEASUREMENT knks_cmd_fil[5] "Knock Filter Frequency and Reference Filter Frequency Cyl.x" UBYTE _CNV_A_R_LINEAR_____0_CM 1 100. 0. 63. DISPLAY_IDENTIFIER KNKS_CMD_FIL[5] ECU_ADDRESS 0xd0003d39 FORMAT "%2.0" /end MEASUREMENT
/begin MEASUREMENT knkwb[0] "Beginning of Measurement Window Cyl.x" UWORD _CNV_A_R_LINEAR_____168_CM 1 100. 0. 108. DISPLAY_IDENTIFIER KNKWB[0] ECU_ADDRESS 0xd0005140 FORMAT "%5.1" /end MEASUREMENT
/begin MEASUREMENT knkwb[1] "Beginning of Measurement Window Cyl.x" UWORD _CNV_A_R_LINEAR_____168_CM 1 100. 0. 108. DISPLAY_IDENTIFIER KNKWB[1] ECU_ADDRESS 0xd0005142 FORMAT "%5.1" /end MEASUREMENT
/begin MEASUREMENT knkwb[2] "Beginning of Measurement Window Cyl.x" UWORD _CNV_A_R_LINEAR_____168_CM 1 100. 0. 108. DISPLAY_IDENTIFIER KNKWB[2] ECU_ADDRESS 0xd0005144 FORMAT "%5.1" /end MEASUREMENT
/begin MEASUREMENT knkwb[3] "Beginning of Measurement Window Cyl.x" UWORD _CNV_A_R_LINEAR_____168_CM 1 100. 0. 108. DISPLAY_IDENTIFIER KNKWB[3] ECU_ADDRESS 0xd0005146 FORMAT "%5.1" /end MEASUREMENT
/begin MEASUREMENT knkwb[4] "Beginning of Measurement Window Cyl.x" UWORD _CNV_A_R_LINEAR_____168_CM 1 100. 0. 108. DISPLAY_IDENTIFIER KNKWB[4] ECU_ADDRESS 0xd0005148 FORMAT "%5.1" /end MEASUREMENT
/begin MEASUREMENT knkwb[5] "Beginning of Measurement Window Cyl.x" UWORD _CNV_A_R_LINEAR_____168_CM 1 100. 0. 108. DISPLAY_IDENTIFIER KNKWB[5] ECU_ADDRESS 0xd000514a FORMAT "%5.1" /end MEASUREMENT
/begin MEASUREMENT knkwe[0] "End of Measurement Window Cyl.x" UWORD _CNV_A_R_LINEAR_____168_CM 1 100. 0.375 114. DISPLAY_IDENTIFIER KNKWE[0] ECU_ADDRESS 0xd000514c FORMAT "%5.1" /end MEASUREMENT
/begin MEASUREMENT knkwe[1] "End of Measurement Window Cyl.x" UWORD _CNV_A_R_LINEAR_____168_CM 1 100. 0.375 114. DISPLAY_IDENTIFIER KNKWE[1] ECU_ADDRESS 0xd000514e FORMAT "%5.1" /end MEASUREMENT
/begin MEASUREMENT knkwe[2] "End of Measurement Window Cyl.x" UWORD _CNV_A_R_LINEAR_____168_CM 1 100. 0.375 114. DISPLAY_IDENTIFIER KNKWE[2] ECU_ADDRESS 0xd0005150 FORMAT "%5.1" /end MEASUREMENT
/begin MEASUREMENT knkwe[3] "End of Measurement Window Cyl.x" UWORD _CNV_A_R_LINEAR_____168_CM 1 100. 0.375 114. DISPLAY_IDENTIFIER KNKWE[3] ECU_ADDRESS 0xd0005152 FORMAT "%5.1" /end MEASUREMENT
/begin MEASUREMENT knkwe[4] "End of Measurement Window Cyl.x" UWORD _CNV_A_R_LINEAR_____168_CM 1 100. 0.375 114. DISPLAY_IDENTIFIER KNKWE[4] ECU_ADDRESS 0xd0005154 FORMAT "%5.1" /end MEASUREMENT
/begin MEASUREMENT knkwe[5] "End of Measurement Window Cyl.x" UWORD _CNV_A_R_LINEAR_____168_CM 1 100. 0.375 114. DISPLAY_IDENTIFIER KNKWE[5] ECU_ADDRESS 0xd0005156 FORMAT "%5.1" /end MEASUREMENT
/begin MEASUREMENT lv_knk_ctl_ena "Boolean for knock control enabled" UBYTE _CNV_S_2_RANGE__0___1_CM 1 100. 0. 1. DISPLAY_IDENTIFIER LV_KNK_CTL_ENA ECU_ADDRESS 0xd0003d5e BIT_MASK 0x1 /end MEASUREMENT
/begin MEASUREMENT lv_knk_tra_maf "Logical variable for Load Dynamic Function active or passive" UBYTE _CNV_S_2_RANGE__0___1_CM 1 100. 0. 1. DISPLAY_IDENTIFIER LV_KNK_TRA_MAF ECU_ADDRESS 0xc000085e BIT_MASK 0x1 /end MEASUREMENT
/begin MEASUREMENT n_knk "Engine speed with hysteresis" UBYTE _CNV_A_R_LINEAR_____9_CM 1 100. 0. 8160. DISPLAY_IDENTIFIER N_KNK ECU_ADDRESS 0xc0000858 FORMAT "%4.0" /end MEASUREMENT
/begin MEASUREMENT nl[0] "Floating mean value of the noise signal" UWORD _CNV_A_R_LINEAR_____190_CM 1 100. 0. 4.99992371 DISPLAY_IDENTIFIER NL[0] ECU_ADDRESS 0xd0005134 FORMAT "%7.5" /end MEASUREMENT
/begin MEASUREMENT nl[1] "Floating mean value of the noise signal" UWORD _CNV_A_R_LINEAR_____190_CM 1 100. 0. 4.99992371 DISPLAY_IDENTIFIER NL[1] ECU_ADDRESS 0xd0005136 FORMAT "%7.5" /end MEASUREMENT
/begin MEASUREMENT nl[2] "Floating mean value of the noise signal" UWORD _CNV_A_R_LINEAR_____190_CM 1 100. 0. 4.99992371 DISPLAY_IDENTIFIER NL[2] ECU_ADDRESS 0xd0005138 FORMAT "%7.5" /end MEASUREMENT
/begin MEASUREMENT nl[3] "Floating mean value of the noise signal" UWORD _CNV_A_R_LINEAR_____190_CM 1 100. 0. 4.99992371 DISPLAY_IDENTIFIER NL[3] ECU_ADDRESS 0xd000513a FORMAT "%7.5" /end MEASUREMENT
/begin MEASUREMENT nl[4] "Floating mean value of the noise signal" UWORD _CNV_A_R_LINEAR_____190_CM 1 100. 0. 4.99992371 DISPLAY_IDENTIFIER NL[4] ECU_ADDRESS 0xd000513c FORMAT "%7.5" /end MEASUREMENT
/begin MEASUREMENT nl[5] "Floating mean value of the noise signal" UWORD _CNV_A_R_LINEAR_____190_CM 1 100. 0. 4.99992371 DISPLAY_IDENTIFIER NL[5] ECU_ADDRESS 0xd000513e FORMAT "%7.5" /end MEASUREMENT
/begin CHARACTERISTIC c_fac_tra_knk "correction factor for load dynamic active" VALUE 0xa10293ca _REC_VAL_20_u1 6.96875 _CNV_A_R_LINEAR_____184_CM 1. 7.96875 DISPLAY_IDENTIFIER C_FAC_TRA_KNK FORMAT "%5.3" /end CHARACTERISTIC
/begin CHARACTERISTIC c_iga_dif_min_max_knk "Control excursion limit valid for spark advance and spark retard " VALUE 0xa10294ae _REC_VAL_20_u1 48. _CNV_A_R_LINEAR_____168_CM 0. 48. DISPLAY_IDENTIFIER C_IGA_DIF_MIN_MAX_KNK FORMAT "%4.1" /end CHARACTERISTIC
/begin CHARACTERISTIC c_iga_lgrd_3 "gradient limitation when  underspending knock load threshold" VALUE 0xa10294b2 _REC_VAL_20_u2 47.99853 _CNV_A_R_LINEAR_____191_CM 0. 47.99853 DISPLAY_IDENTIFIER C_IGA_LGRD_3 /end CHARACTERISTIC
/begin CHARACTERISTIC c_maf_iga_hys_knk "Air-Mass Hysteresis for Knock Control" VALUE 0xa102953c _REC_VAL_20_u1 1389. _CNV_A_R_LINEAR_____14_CM 0. 1389. DISPLAY_IDENTIFIER C_MAF_IGA_HYS_KNK FORMAT "%4.0" /end CHARACTERISTIC
/begin CHARACTERISTIC c_n_iga_hys_knk "Speed Hysteresis for Knock Control" VALUE 0xa1029601 _REC_VAL_20_u1 8160. _CNV_A_R_LINEAR_____9_CM 0. 8160. DISPLAY_IDENTIFIER C_N_IGA_HYS_KNK FORMAT "%4.0" /end CHARACTERISTIC
/begin CHARACTERISTIC c_nl_crlc "Averaging Constant for Noise Value Calculation" VALUE 0xa102967e _REC_VAL_20_u1 0.99609375 _CNV_A_R_LINEAR_____27_CM 0. 0.99609375 DISPLAY_IDENTIFIER C_NL_CRLC FORMAT "%5.3" /end CHARACTERISTIC
/begin CHARACTERISTIC c_nl_crlc_tra "Averaging Constant for Noise Value Calculation for Transient Case" VALUE 0xa102967f _REC_VAL_20_u1 0.99609375 _CNV_A_R_LINEAR_____27_CM 0. 0.99609375 DISPLAY_IDENTIFIER C_NL_CRLC_TRA FORMAT "%5.3" /end CHARACTERISTIC
/begin MEASUREMENT lv_knk_tra_n "Logical variable for Engine Speed Dynamic Function active or passive" UBYTE _CNV_S_2_RANGE__0___1_CM 1 100. 0. 1. DISPLAY_IDENTIFIER LV_KNK_TRA_N ECU_ADDRESS 0xd0003d5f BIT_MASK 0x1 /end MEASUREMENT
/begin MEASUREMENT iga_adj_knk[0] "Total spark retard through knock control with Adaptation (cylinder individual)" UBYTE _CNV_A_R_LINEAR_____171_CM 1 100. -48. 0. DISPLAY_IDENTIFIER IGA_ADJ_KNK[0] ECU_ADDRESS 0xd0003d46 FORMAT "%5.1" /end MEASUREMENT
/begin MEASUREMENT iga_adj_knk[1] "Total spark retard through knock control with Adaptation (cylinder individual)" UBYTE _CNV_A_R_LINEAR_____171_CM 1 100. -48. 0. DISPLAY_IDENTIFIER IGA_ADJ_KNK[1] ECU_ADDRESS 0xd0003d47 FORMAT "%5.1" /end MEASUREMENT
/begin MEASUREMENT iga_adj_knk[2] "Total spark retard through knock control with Adaptation (cylinder individual)" UBYTE _CNV_A_R_LINEAR_____171_CM 1 100. -48. 0. DISPLAY_IDENTIFIER IGA_ADJ_KNK[2] ECU_ADDRESS 0xd0003d48 FORMAT "%5.1" /end MEASUREMENT
/begin MEASUREMENT iga_adj_knk[3] "Total spark retard through knock control with Adaptation (cylinder individual)" UBYTE _CNV_A_R_LINEAR_____171_CM 1 100. -48. 0. DISPLAY_IDENTIFIER IGA_ADJ_KNK[3] ECU_ADDRESS 0xd0003d49 FORMAT "%5.1" /end MEASUREMENT
/begin MEASUREMENT iga_adj_knk[4] "Total spark retard through knock control with Adaptation (cylinder individual)" UBYTE _CNV_A_R_LINEAR_____171_CM 1 100. -48. 0. DISPLAY_IDENTIFIER IGA_ADJ_KNK[4] ECU_ADDRESS 0xd0003d4a FORMAT "%5.1" /end MEASUREMENT
/begin MEASUREMENT iga_adj_knk[5] "Total spark retard through knock control with Adaptation (cylinder individual)" UBYTE _CNV_A_R_LINEAR_____171_CM 1 100. -48. 0. DISPLAY_IDENTIFIER IGA_ADJ_KNK[5] ECU_ADDRESS 0xd0003d4b FORMAT "%5.1" /end MEASUREMENT
/begin MEASUREMENT iga_adj_max_knk "Total spark retard through knock control with Adaptation (cylinder individual)" UBYTE _CNV_A_R_LINEAR_____167_CM 1 100. -35.625 60. DISPLAY_IDENTIFIER IGA_ADJ_MAX_KNK ECU_ADDRESS 0xd0003d5d FORMAT "%5.1" /end MEASUREMENT
/begin MEASUREMENT iga_mv_adj_knk "meanvalue of actual retard adjustment with Adaptation values" UBYTE _CNV_A_R_LINEAR_____171_CM 1 100. -48. 0. DISPLAY_IDENTIFIER IGA_MV_ADJ_KNK ECU_ADDRESS 0xd0003d52 FORMAT "%4.1" /end MEASUREMENT
/begin MEASUREMENT cyl_id_knk "cylinder number for knock control" UBYTE _CNV_A_R_LINEAR_____0_CM 1 100. 0. 255. DISPLAY_IDENTIFIER CYL_ID_KNK ECU_ADDRESS 0xd0003d2d FORMAT "%3.0" /end MEASUREMENT
/begin MEASUREMENT lv_knk "Logical variable for recognition of knock" UBYTE _CNV_S_2_RANGE__0___1_CM 1 100. 0. 1. DISPLAY_IDENTIFIER LV_KNK ECU_ADDRESS 0xd0003d60 BIT_MASK 0x1 /end MEASUREMENT
/begin MEASUREMENT iga_mv_knk "meanvalue of actual retard adjustment without Adaptation values" UBYTE _CNV_A_R_LINEAR_____171_CM 1 100. -48. 0. DISPLAY_IDENTIFIER IGA_MV_KNK ECU_ADDRESS 0xd0003d5c FORMAT "%4.1" /end MEASUREMENT
/begin MEASUREMENT fac_iga_max_knk "Weighting factor for the max. spark retard against coolant" UBYTE _CNV_A_R_LINEAR_____71_CM 1 100. 0. 0.99609375 DISPLAY_IDENTIFIER FAC_IGA_MAX_KNK ECU_ADDRESS 0xc0000859 FORMAT "%5.3" /end MEASUREMENT
/begin MEASUREMENT knks_cmd_gain[0] "Amplification precontrol Cyl.x" UBYTE _CNV_A_R_LINEAR_____0_CM 1 100. 0. 63. DISPLAY_IDENTIFIER KNKS_CMD_GAIN[0] ECU_ADDRESS 0xd0003d40 FORMAT "%2.0" /end MEASUREMENT
/begin MEASUREMENT knks_cmd_gain[1] "Amplification precontrol Cyl.x" UBYTE _CNV_A_R_LINEAR_____0_CM 1 100. 0. 63. DISPLAY_IDENTIFIER KNKS_CMD_GAIN[1] ECU_ADDRESS 0xd0003d41 FORMAT "%2.0" /end MEASUREMENT
/begin MEASUREMENT knks_cmd_gain[2] "Amplification precontrol Cyl.x" UBYTE _CNV_A_R_LINEAR_____0_CM 1 100. 0. 63. DISPLAY_IDENTIFIER KNKS_CMD_GAIN[2] ECU_ADDRESS 0xd0003d42 FORMAT "%2.0" /end MEASUREMENT
/begin MEASUREMENT knks_cmd_gain[3] "Amplification precontrol Cyl.x" UBYTE _CNV_A_R_LINEAR_____0_CM 1 100. 0. 63. DISPLAY_IDENTIFIER KNKS_CMD_GAIN[3] ECU_ADDRESS 0xd0003d43 FORMAT "%2.0" /end MEASUREMENT
/begin MEASUREMENT knks_cmd_gain[4] "Amplification precontrol Cyl.x" UBYTE _CNV_A_R_LINEAR_____0_CM 1 100. 0. 63. DISPLAY_IDENTIFIER KNKS_CMD_GAIN[4] ECU_ADDRESS 0xd0003d44 FORMAT "%2.0" /end MEASUREMENT
/begin MEASUREMENT knks_cmd_gain[5] "Amplification precontrol Cyl.x" UBYTE _CNV_A_R_LINEAR_____0_CM 1 100. 0. 63. DISPLAY_IDENTIFIER KNKS_CMD_GAIN[5] ECU_ADDRESS 0xd0003d45 FORMAT "%2.0" /end MEASUREMENT
/begin MEASUREMENT knks_cmd_int[0] "Integration time constant Cyl.x" UBYTE _CNV_A_R_LINEAR_____0_CM 1 100. 0. 31. DISPLAY_IDENTIFIER KNKS_CMD_INT[0] ECU_ADDRESS 0xd0003d3a FORMAT "%2.0" /end MEASUREMENT
/begin MEASUREMENT knks_cmd_int[1] "Integration time constant Cyl.x" UBYTE _CNV_A_R_LINEAR_____0_CM 1 100. 0. 31. DISPLAY_IDENTIFIER KNKS_CMD_INT[1] ECU_ADDRESS 0xd0003d3b FORMAT "%2.0" /end MEASUREMENT
/begin MEASUREMENT knks_cmd_int[2] "Integration time constant Cyl.x" UBYTE _CNV_A_R_LINEAR_____0_CM 1 100. 0. 31. DISPLAY_IDENTIFIER KNKS_CMD_INT[2] ECU_ADDRESS 0xd0003d3c FORMAT "%2.0" /end MEASUREMENT
/begin MEASUREMENT knks_cmd_int[3] "Integration time constant Cyl.x" UBYTE _CNV_A_R_LINEAR_____0_CM 1 100. 0. 31. DISPLAY_IDENTIFIER KNKS_CMD_INT[3] ECU_ADDRESS 0xd0003d3d FORMAT "%2.0" /end MEASUREMENT
/begin MEASUREMENT knks_cmd_int[4] "Integration time constant Cyl.x" UBYTE _CNV_A_R_LINEAR_____0_CM 1 100. 0. 31. DISPLAY_IDENTIFIER KNKS_CMD_INT[4] ECU_ADDRESS 0xd0003d3e FORMAT "%2.0" /end MEASUREMENT
/begin MEASUREMENT knks_cmd_int[5] "Integration time constant Cyl.x" UBYTE _CNV_A_R_LINEAR_____0_CM 1 100. 0. 31. DISPLAY_IDENTIFIER KNKS_CMD_INT[5] ECU_ADDRESS 0xd0003d3f FORMAT "%2.0" /end MEASUREMENT
/begin CHARACTERISTIC id_cycnr_fac_tra_knk__n "Cycle counter during which the Load Dynamic Function stays active after triggering" CURVE 0xa1022446 _REC_CUR_20_u1_u1 255. _CNV_A_R_LINEAR_____0_CM 0. 255. DISPLAY_IDENTIFIER ID_CYCNR_FAC_TRA_KNK__N FORMAT "%3.0"
 /begin AXIS_DESCR COM_AXIS n_knk _CNV_A_R_LINEAR_____9_CM 4 0. 8160. FORMAT "%4.0" AXIS_PTS_REF ldpm_n_6_4 /end AXIS_DESCR
/end CHARACTERISTIC
/begin CHARACTERISTIC ip_knkwb_1__n__maf "Beginning of Measurement Window Cyl.2" MAP 0xa1025a80 _REC_MAP_20_u2_u1_u1 108. _CNV_A_R_LINEAR_____168_CM 0. 108. DISPLAY_IDENTIFIER IP_KNKWB[1] FORMAT "%5.1"
 /begin AXIS_DESCR COM_AXIS n_knk _CNV_A_R_LINEAR_____9_CM 10 0. 8160. FORMAT "%4.0" AXIS_PTS_REF ldpm_n_knkwb /end AXIS_DESCR
 /begin AXIS_DESCR COM_AXIS maf_knk _CNV_A_R_LINEAR_____14_CM 4 0. 1389. FORMAT "%4.0" AXIS_PTS_REF ldpm_maf_knkwb /end AXIS_DESCR
/end CHARACTERISTIC
/begin CHARACTERISTIC ip_gain_knk_1__n__maf "Amplification precontrol Cyl.2" MAP 0xa1024d34 _REC_MAP_20_u1_u1_u1 63. _CNV_A_R_LINEAR_____0_CM 0. 63. DISPLAY_IDENTIFIER IP_GAIN_KNK[1] FORMAT "%2.0"
 /begin AXIS_DESCR COM_AXIS n_knk _CNV_A_R_LINEAR_____9_CM 16 0. 8160. FORMAT "%4.0" AXIS_PTS_REF ldpm_n_2_9 /end AXIS_DESCR
 /begin AXIS_DESCR COM_AXIS maf_knk _CNV_A_R_LINEAR_____14_CM 4 0. 1389. FORMAT "%4.0" AXIS_PTS_REF ldpm_maf_1_9 /end AXIS_DESCR
/end CHARACTERISTIC
/begin CHARACTERISTIC ip_fac_thd_knk_0__n__maf "Knock Factor Table Cyl. 1" MAP 0xa10240fc _REC_MAP_20_u1_u1_u1 7.96875 _CNV_A_R_LINEAR_____184_CM 0. 7.96875 DISPLAY_IDENTIFIER IP_FAC_THD_KNK[0] FORMAT "%4.2"
 /begin AXIS_DESCR COM_AXIS n_knk _CNV_A_R_LINEAR_____9_CM 16 0. 8160. FORMAT "%4.0" AXIS_PTS_REF ldpm_n_2_9 /end AXIS_DESCR
 /begin AXIS_DESCR COM_AXIS maf_knk _CNV_A_R_LINEAR_____14_CM 4 0. 1389. FORMAT "%4.0" AXIS_PTS_REF ldpm_maf_1_9 /end AXIS_DESCR
/end CHARACTERISTIC
/begin CHARACTERISTIC ip_fac_thd_knk_1__n__maf "Knock Factor Table Cyl. 2" MAP 0xa102413c _REC_MAP_20_u1_u1_u1 7.96875 _CNV_A_R_LINEAR_____184_CM 0. 7.96875 DISPLAY_IDENTIFIER IP_FAC_THD_KNK[1] FORMAT "%4.2"
 /begin AXIS_DESCR COM_AXIS n_knk _CNV_A_R_LINEAR_____9_CM 16 0. 8160. FORMAT "%4.0" AXIS_PTS_REF ldpm_n_2_9 /end AXIS_DESCR
 /begin AXIS_DESCR COM_AXIS maf_knk _CNV_A_R_LINEAR_____14_CM 4 0. 1389. FORMAT "%4.0" AXIS_PTS_REF ldpm_maf_1_9 /end AXIS_DESCR
/end CHARACTERISTIC
/begin CHARACTERISTIC ip_fac_thd_knk_2__n__maf "Knock Factor Table Cyl. 3" MAP 0xa102417c _REC_MAP_20_u1_u1_u1 7.96875 _CNV_A_R_LINEAR_____184_CM 0. 7.96875 DISPLAY_IDENTIFIER IP_FAC_THD_KNK[2] FORMAT "%4.2"
 /begin AXIS_DESCR COM_AXIS n_knk _CNV_A_R_LINEAR_____9_CM 16 0. 8160. FORMAT "%4.0" AXIS_PTS_REF ldpm_n_2_9 /end AXIS_DESCR
 /begin AXIS_DESCR COM_AXIS maf_knk _CNV_A_R_LINEAR_____14_CM 4 0. 1389. FORMAT "%4.0" AXIS_PTS_REF ldpm_maf_1_9 /end AXIS_DESCR
/end CHARACTERISTIC
/begin CHARACTERISTIC ip_fac_thd_knk_3__n__maf "Knock Factor Table Cyl. 4" MAP 0xa10241bc _REC_MAP_20_u1_u1_u1 7.96875 _CNV_A_R_LINEAR_____184_CM 0. 7.96875 DISPLAY_IDENTIFIER IP_FAC_THD_KNK[3] FORMAT "%4.2"
 /begin AXIS_DESCR COM_AXIS n_knk _CNV_A_R_LINEAR_____9_CM 16 0. 8160. FORMAT "%4.0" AXIS_PTS_REF ldpm_n_2_9 /end AXIS_DESCR
 /begin AXIS_DESCR COM_AXIS maf_knk _CNV_A_R_LINEAR_____14_CM 4 0. 1389. FORMAT "%4.0" AXIS_PTS_REF ldpm_maf_1_9 /end AXIS_DESCR
/end CHARACTERISTIC
/begin CHARACTERISTIC ip_fac_thd_knk_4__n__maf "Knock Factor Table Cyl. 5" MAP 0xa10241fc _REC_MAP_20_u1_u1_u1 7.96875 _CNV_A_R_LINEAR_____184_CM 0. 7.96875 DISPLAY_IDENTIFIER IP_FAC_THD_KNK[4] FORMAT "%4.2"
 /begin AXIS_DESCR COM_AXIS n_knk _CNV_A_R_LINEAR_____9_CM 16 0. 8160. FORMAT "%4.0" AXIS_PTS_REF ldpm_n_2_9 /end AXIS_DESCR
 /begin AXIS_DESCR COM_AXIS maf_knk _CNV_A_R_LINEAR_____14_CM 4 0. 1389. FORMAT "%4.0" AXIS_PTS_REF ldpm_maf_1_9 /end AXIS_DESCR
/end CHARACTERISTIC
/begin CHARACTERISTIC ip_fac_thd_knk_5__n__maf "Knock Factor Table Cyl. 6" MAP 0xa102423c _REC_MAP_20_u1_u1_u1 7.96875 _CNV_A_R_LINEAR_____184_CM 0. 7.96875 DISPLAY_IDENTIFIER IP_FAC_THD_KNK[5] FORMAT "%4.2"
 /begin AXIS_DESCR COM_AXIS n_knk _CNV_A_R_LINEAR_____9_CM 16 0. 8160. FORMAT "%4.0" AXIS_PTS_REF ldpm_n_2_9 /end AXIS_DESCR
 /begin AXIS_DESCR COM_AXIS maf_knk _CNV_A_R_LINEAR_____14_CM 4 0. 1389. FORMAT "%4.0" AXIS_PTS_REF ldpm_maf_1_9 /end AXIS_DESCR
/end CHARACTERISTIC
/begin CHARACTERISTIC c_nl_min "Minimum noise value" VALUE 0xa1029681 _REC_VAL_20_u1 4.998 _CNV_A_R_LINEAR_____189_CM 0. 4.998 DISPLAY_IDENTIFIER C_NL_MIN FORMAT "%5.3" /end CHARACTERISTIC
/begin CHARACTERISTIC id_maf_dif_tra_knk__n "Throttle Position Gradient for Load Dynamik Recognition" CURVE 0xa1022b54 _REC_CUR_20_s2_u1 1388.978806 _CNV_A_R_LINEAR_____192_CM -694.5 694.478806 DISPLAY_IDENTIFIER ID_MAF_DIF_TRA_KNK__N FORMAT "%7.2"
 /begin AXIS_DESCR COM_AXIS n_knk _CNV_A_R_LINEAR_____9_CM 4 0. 8160. FORMAT "%4.0" AXIS_PTS_REF ldpm_n_6_4 /end AXIS_DESCR
/end CHARACTERISTIC
/begin CHARACTERISTIC ip_iga_bas_max_knk__n__maf "Maximum value for spark retard" MAP 0xa1024f0c _REC_MAP_20_u1_u1_u1 95.625 _CNV_A_R_LINEAR_____167_CM -35.625 60. DISPLAY_IDENTIFIER IP_IGA_BAS_MAX_KNK__N__MAF FORMAT "%5.1"
 /begin AXIS_DESCR COM_AXIS n_32 _CNV_A_R_LINEAR_____9_CM 8 0. 8160. FORMAT "%4.0" AXIS_PTS_REF ldpm_n_iga_max_knk /end AXIS_DESCR
 /begin AXIS_DESCR COM_AXIS maf _CNV_A_R_LINEAR_____14_CM 8 0. 1389. FORMAT "%4.0" AXIS_PTS_REF ldpm_maf_iga_max_knk /end AXIS_DESCR
/end CHARACTERISTIC
/begin CHARACTERISTIC ip_iga_ofs_max_knk__n__maf "Maximum value for spark retard" MAP 0xa1025770 _REC_MAP_20_u1_u1_u1 95.625 _CNV_A_R_LINEAR_____171_CM -48. 47.625 DISPLAY_IDENTIFIER IP_IGA_OFS_MAX_KNK__N__MAF FORMAT "%5.1"
 /begin AXIS_DESCR COM_AXIS n_32 _CNV_A_R_LINEAR_____9_CM 8 0. 8160. FORMAT "%4.0" AXIS_PTS_REF ldpm_n_iga_max_knk /end AXIS_DESCR
 /begin AXIS_DESCR COM_AXIS maf _CNV_A_R_LINEAR_____14_CM 8 0. 1389. FORMAT "%4.0" AXIS_PTS_REF ldpm_maf_iga_max_knk /end AXIS_DESCR
/end CHARACTERISTIC
/begin CHARACTERISTIC ip_fac_iga_max_knk__tco__tia "Weighting factor for the max. spark retard against coolant" MAP 0xa1023a18 _REC_MAP_20_u1_u1_u1 0.99609375 _CNV_A_R_LINEAR_____71_CM 0. 0.99609375 DISPLAY_IDENTIFIER IP_FAC_IGA_MAX_KNK__TCO__TIA FORMAT "%5.3"
 /begin AXIS_DESCR COM_AXIS tco _CNV_A_R_LINEAR_____16_CM 4 -48. 142.5 FORMAT "%5.1" AXIS_PTS_REF ldp_tco__fac_iga_max_knk /end AXIS_DESCR
 /begin AXIS_DESCR COM_AXIS tia _CNV_A_R_LINEAR_____16_CM 4 -48. 142.5 FORMAT "%5.1" AXIS_PTS_REF ldp_tia__fac_iga_max_knk /end AXIS_DESCR
/end CHARACTERISTIC
/begin AXIS_PTS ldp_tco__maf_min_knk "" 0xa1021282 tco _REC_AXS_20_u1 190.5 _CNV_A_R_LINEAR_____16_CM 4 -48. 142.5 FORMAT "%3.0" /end AXIS_PTS
/begin AXIS_PTS ldpm_n_3_9 "" 0xa1021e74 n_32 _REC_AXS_20_u1 8160. _CNV_A_R_LINEAR_____9_CM 8 0. 8160. FORMAT "%4.0" /end AXIS_PTS
/begin AXIS_PTS ldpm_n_4_9 "" 0xa1021e7e n_knk _REC_AXS_20_u1 8160. _CNV_A_R_LINEAR_____9_CM 3 0. 8160. FORMAT "%4.0" /end AXIS_PTS
/begin AXIS_PTS ldpm_n_6_4 "" 0xa1021e82 n_knk _REC_AXS_20_u1 8160. _CNV_A_R_LINEAR_____9_CM 4 0. 8160. FORMAT "%4.0" /end AXIS_PTS
/begin AXIS_PTS ldpm_n_iga_max_knk "" 0xa10220c4 n_32 _REC_AXS_20_u1 8160. _CNV_A_R_LINEAR_____9_CM 8 0. 8160. FORMAT "%4.0" /end AXIS_PTS
/begin AXIS_PTS ldpm_maf_iga_max_knk "" 0xa1021c54 maf _REC_AXS_20_u1 1389. _CNV_A_R_LINEAR_____14_CM 8 0. 1389. FORMAT "%4.0" /end AXIS_PTS
/begin AXIS_PTS ldp_tco__fac_iga_max_knk "" 0xa1021264 tco _REC_AXS_20_u1 190.5 _CNV_A_R_LINEAR_____16_CM 4 -48. 142.5 FORMAT "%5.1" /end AXIS_PTS
/begin AXIS_PTS ldp_tia__fac_iga_max_knk "" 0xa1021352 tia _REC_AXS_20_u1 190.5 _CNV_A_R_LINEAR_____16_CM 4 -48. 142.5 FORMAT "%5.1" /end AXIS_PTS
/begin CHARACTERISTIC c_knk_thd_max "Maximum knock threshold" VALUE 0xa10294bd _REC_VAL_20_u1 4.998 _CNV_A_R_LINEAR_____189_CM 0. 4.998 DISPLAY_IDENTIFIER C_KNK_THD_MAX FORMAT "%4.2" /end CHARACTERISTIC
/begin AXIS_PTS ldpm_n_iga_ad "" 0xa10220b8 n_knk _REC_AXS_20_u1 8160. _CNV_A_R_LINEAR_____9_CM 8 0. 8160. FORMAT "%4.0" /end AXIS_PTS
/begin AXIS_PTS ldpm_maf_iga_ad "" 0xa1021c4a maf_knk _REC_AXS_20_u1 1389. _CNV_A_R_LINEAR_____14_CM 6 0. 1389. FORMAT "%7.2" /end AXIS_PTS
/begin AXIS_PTS ldpm_n_knkwb "" 0xa10220d0 n_knk _REC_AXS_20_u1 8160. _CNV_A_R_LINEAR_____9_CM 10 0. 8160. FORMAT "%4.0" /end AXIS_PTS
/begin AXIS_PTS ldpm_maf_knkwb "" 0xa1021c80 maf_knk _REC_AXS_20_u1 1389. _CNV_A_R_LINEAR_____14_CM 4 0. 1389. FORMAT "%4.0" /end AXIS_PTS
/begin AXIS_PTS ldpm_n_fil_frq_knk "" 0xa102201e n_knk _REC_AXS_20_u1 8160. _CNV_A_R_LINEAR_____9_CM 4 0. 8160. FORMAT "%4.0" /end AXIS_PTS
/begin AXIS_PTS ldpm_maf_1_9 "" 0xa1021b80 maf_knk _REC_AXS_20_u1 69.45 _CNV_A_R_LINEAR_____14_CM 4 0. 1389. FORMAT "%4.0" /end AXIS_PTS
/begin AXIS_PTS ldpm_n_2_9 "" 0xa1021d60 n_knk _REC_AXS_20_u1 8160. _CNV_A_R_LINEAR_____9_CM 16 0. 8160. FORMAT "%4.0" /end AXIS_PTS
/begin CHARACTERISTIC id_fil_frq_knk_0__n "Knock Filter Frequency and Reference Filter Frequency Cyl.1" CURVE 0xa102275c _REC_CUR_20_u1_u1 63. _CNV_A_R_LINEAR_____0_CM 0. 63. DISPLAY_IDENTIFIER ID_FIL_FRQ_KNK[0] FORMAT "%2.0"
 /begin AXIS_DESCR COM_AXIS n_knk _CNV_A_R_LINEAR_____9_CM 4 0. 8160. FORMAT "%4.0" AXIS_PTS_REF ldpm_n_fil_frq_knk /end AXIS_DESCR
/end CHARACTERISTIC
/begin CHARACTERISTIC id_fil_frq_knk_1__n "Knock Filter Frequency and Reference Filter Frequency Cyl.2" CURVE 0xa1022760 _REC_CUR_20_u1_u1 63. _CNV_A_R_LINEAR_____0_CM 0. 63. DISPLAY_IDENTIFIER ID_FIL_FRQ_KNK[1] FORMAT "%2.0"
 /begin AXIS_DESCR COM_AXIS n_knk _CNV_A_R_LINEAR_____9_CM 4 0. 8160. FORMAT "%4.0" AXIS_PTS_REF ldpm_n_fil_frq_knk /end AXIS_DESCR
/end CHARACTERISTIC
/begin CHARACTERISTIC id_fil_frq_knk_2__n "Knock Filter Frequency and Reference Filter Frequency Cyl.3" CURVE 0xa1022764 _REC_CUR_20_u1_u1 63. _CNV_A_R_LINEAR_____0_CM 0. 63. DISPLAY_IDENTIFIER ID_FIL_FRQ_KNK[2] FORMAT "%2.0"
 /begin AXIS_DESCR COM_AXIS n_knk _CNV_A_R_LINEAR_____9_CM 4 0. 8160. FORMAT "%4.0" AXIS_PTS_REF ldpm_n_fil_frq_knk /end AXIS_DESCR
/end CHARACTERISTIC
/begin CHARACTERISTIC id_fil_frq_knk_3__n "Knock Filter Frequency and Reference Filter Frequency Cyl.4" CURVE 0xa1022768 _REC_CUR_20_u1_u1 63. _CNV_A_R_LINEAR_____0_CM 0. 63. DISPLAY_IDENTIFIER ID_FIL_FRQ_KNK[3] FORMAT "%2.0"
 /begin AXIS_DESCR COM_AXIS n_knk _CNV_A_R_LINEAR_____9_CM 4 0. 8160. FORMAT "%4.0" AXIS_PTS_REF ldpm_n_fil_frq_knk /end AXIS_DESCR
/end CHARACTERISTIC
/begin CHARACTERISTIC id_fil_frq_knk_4__n "Knock Filter Frequency and Reference Filter Frequency Cyl.5" CURVE 0xa102276c _REC_CUR_20_u1_u1 63. _CNV_A_R_LINEAR_____0_CM 0. 63. DISPLAY_IDENTIFIER ID_FIL_FRQ_KNK[4] FORMAT "%2.0"
 /begin AXIS_DESCR COM_AXIS n_knk _CNV_A_R_LINEAR_____9_CM 4 0. 8160. FORMAT "%4.0" AXIS_PTS_REF ldpm_n_fil_frq_knk /end AXIS_DESCR
/end CHARACTERISTIC
/begin CHARACTERISTIC id_fil_frq_knk_5__n "Knock Filter Frequency and Reference Filter Frequency Cyl.6" CURVE 0xa1022770 _REC_CUR_20_u1_u1 63. _CNV_A_R_LINEAR_____0_CM 0. 63. DISPLAY_IDENTIFIER ID_FIL_FRQ_KNK[5] FORMAT "%2.0"
 /begin AXIS_DESCR COM_AXIS n_knk _CNV_A_R_LINEAR_____9_CM 4 0. 8160. FORMAT "%4.0" AXIS_PTS_REF ldpm_n_fil_frq_knk /end AXIS_DESCR
/end CHARACTERISTIC
/begin MEASUREMENT knks[0] "" UWORD _CNV_A_R_LINEAR_____190_CM 1 100. 0. 4.99992371 DISPLAY_IDENTIFIER KNKS[0] ECU_ADDRESS 0xd00054a0 FORMAT "%7.5" /end MEASUREMENT
/begin MEASUREMENT knks[1] "" UWORD _CNV_A_R_LINEAR_____190_CM 1 100. 0. 4.99992371 DISPLAY_IDENTIFIER KNKS[1] ECU_ADDRESS 0xd00054a2 FORMAT "%7.5" /end MEASUREMENT
/begin MEASUREMENT knks[2] "" UWORD _CNV_A_R_LINEAR_____190_CM 1 100. 0. 4.99992371 DISPLAY_IDENTIFIER KNKS[2] ECU_ADDRESS 0xd00054a4 FORMAT "%7.5" /end MEASUREMENT
/begin MEASUREMENT knks[3] "" UWORD _CNV_A_R_LINEAR_____190_CM 1 100. 0. 4.99992371 DISPLAY_IDENTIFIER KNKS[3] ECU_ADDRESS 0xd00054a6 FORMAT "%7.5" /end MEASUREMENT
/begin MEASUREMENT knks[4] "" UWORD _CNV_A_R_LINEAR_____190_CM 1 100. 0. 4.99992371 DISPLAY_IDENTIFIER KNKS[4] ECU_ADDRESS 0xd00054a8 FORMAT "%7.5" /end MEASUREMENT
/begin MEASUREMENT knks[5] "" UWORD _CNV_A_R_LINEAR_____190_CM 1 100. 0. 4.99992371 DISPLAY_IDENTIFIER KNKS[5] ECU_ADDRESS 0xd00054aa FORMAT "%7.5" /end MEASUREMENT
/begin CHARACTERISTIC ip_knkwb_2__n__maf "Beginning of Measurement Window Cyl.3" MAP 0xa1025ad0 _REC_MAP_20_u2_u1_u1 108. _CNV_A_R_LINEAR_____168_CM 0. 108. DISPLAY_IDENTIFIER IP_KNKWB[2] FORMAT "%5.1"
 /begin AXIS_DESCR COM_AXIS n_knk _CNV_A_R_LINEAR_____9_CM 10 0. 8160. FORMAT "%4.0" AXIS_PTS_REF ldpm_n_knkwb /end AXIS_DESCR
 /begin AXIS_DESCR COM_AXIS maf_knk _CNV_A_R_LINEAR_____14_CM 4 0. 1389. FORMAT "%4.0" AXIS_PTS_REF ldpm_maf_knkwb /end AXIS_DESCR
/end CHARACTERISTIC
/begin CHARACTERISTIC ip_knkwb_3__n__maf "Beginning of Measurement Window Cyl.4" MAP 0xa1025b20 _REC_MAP_20_u2_u1_u1 108. _CNV_A_R_LINEAR_____168_CM 0. 108. DISPLAY_IDENTIFIER IP_KNKWB[3] FORMAT "%5.1"
 /begin AXIS_DESCR COM_AXIS n_knk _CNV_A_R_LINEAR_____9_CM 10 0. 8160. FORMAT "%4.0" AXIS_PTS_REF ldpm_n_knkwb /end AXIS_DESCR
 /begin AXIS_DESCR COM_AXIS maf_knk _CNV_A_R_LINEAR_____14_CM 4 0. 1389. FORMAT "%4.0" AXIS_PTS_REF ldpm_maf_knkwb /end AXIS_DESCR
/end CHARACTERISTIC
/begin CHARACTERISTIC ip_knkwb_4__n__maf "Beginning of Measurement Window Cyl.5" MAP 0xa1025b70 _REC_MAP_20_u2_u1_u1 108. _CNV_A_R_LINEAR_____168_CM 0. 108. DISPLAY_IDENTIFIER IP_KNKWB[4] FORMAT "%5.1"
 /begin AXIS_DESCR COM_AXIS n_knk _CNV_A_R_LINEAR_____9_CM 10 0. 8160. FORMAT "%4.0" AXIS_PTS_REF ldpm_n_knkwb /end AXIS_DESCR
 /begin AXIS_DESCR COM_AXIS maf_knk _CNV_A_R_LINEAR_____14_CM 4 0. 1389. FORMAT "%4.0" AXIS_PTS_REF ldpm_maf_knkwb /end AXIS_DESCR
/end CHARACTERISTIC
/begin CHARACTERISTIC ip_knkwb_5__n__maf "Beginning of Measurement Window Cyl.6" MAP 0xa1025bc0 _REC_MAP_20_u2_u1_u1 108. _CNV_A_R_LINEAR_____168_CM 0. 108. DISPLAY_IDENTIFIER IP_KNKWB[5] FORMAT "%5.1"
 /begin AXIS_DESCR COM_AXIS n_knk _CNV_A_R_LINEAR_____9_CM 10 0. 8160. FORMAT "%4.0" AXIS_PTS_REF ldpm_n_knkwb /end AXIS_DESCR
 /begin AXIS_DESCR COM_AXIS maf_knk _CNV_A_R_LINEAR_____14_CM 4 0. 1389. FORMAT "%4.0" AXIS_PTS_REF ldpm_maf_knkwb /end AXIS_DESCR
/end CHARACTERISTIC
/begin CHARACTERISTIC ip_knkwe_0__n__maf "End of Measurement Window Cyl.1" MAP 0xa1025c10 _REC_MAP_20_u2_u1_u1 113.625 _CNV_A_R_LINEAR_____168_CM 0.375 114. DISPLAY_IDENTIFIER IP_KNKWE[0] FORMAT "%5.1"
 /begin AXIS_DESCR COM_AXIS n_knk _CNV_A_R_LINEAR_____9_CM 10 0. 8160. FORMAT "%4.0" AXIS_PTS_REF ldpm_n_knkwb /end AXIS_DESCR
 /begin AXIS_DESCR COM_AXIS maf_knk _CNV_A_R_LINEAR_____14_CM 4 0. 1389. FORMAT "%4.0" AXIS_PTS_REF ldpm_maf_knkwb /end AXIS_DESCR
/end CHARACTERISTIC
/begin CHARACTERISTIC ip_knkwe_1__n__maf "End of Measurement Window Cyl.2" MAP 0xa1025c60 _REC_MAP_20_u2_u1_u1 113.625 _CNV_A_R_LINEAR_____168_CM 0.375 114. DISPLAY_IDENTIFIER IP_KNKWE[1] FORMAT "%5.1"
 /begin AXIS_DESCR COM_AXIS n_knk _CNV_A_R_LINEAR_____9_CM 10 0. 8160. FORMAT "%4.0" AXIS_PTS_REF ldpm_n_knkwb /end AXIS_DESCR
 /begin AXIS_DESCR COM_AXIS maf_knk _CNV_A_R_LINEAR_____14_CM 4 0. 1389. FORMAT "%4.0" AXIS_PTS_REF ldpm_maf_knkwb /end AXIS_DESCR
/end CHARACTERISTIC
/begin CHARACTERISTIC ip_knkwe_2__n__maf "End of Measurement Window Cyl.3" MAP 0xa1025cb0 _REC_MAP_20_u2_u1_u1 113.625 _CNV_A_R_LINEAR_____168_CM 0.375 114. DISPLAY_IDENTIFIER IP_KNKWE[2] FORMAT "%5.1"
 /begin AXIS_DESCR COM_AXIS n_knk _CNV_A_R_LINEAR_____9_CM 10 0. 8160. FORMAT "%4.0" AXIS_PTS_REF ldpm_n_knkwb /end AXIS_DESCR
 /begin AXIS_DESCR COM_AXIS maf_knk _CNV_A_R_LINEAR_____14_CM 4 0. 1389. FORMAT "%4.0" AXIS_PTS_REF ldpm_maf_knkwb /end AXIS_DESCR
/end CHARACTERISTIC
/begin CHARACTERISTIC ip_knkwe_3__n__maf "End of Measurement Window Cyl.4" MAP 0xa1025d00 _REC_MAP_20_u2_u1_u1 113.625 _CNV_A_R_LINEAR_____168_CM 0.375 114. DISPLAY_IDENTIFIER IP_KNKWE[3] FORMAT "%5.1"
 /begin AXIS_DESCR COM_AXIS n_knk _CNV_A_R_LINEAR_____9_CM 10 0. 8160. FORMAT "%4.0" AXIS_PTS_REF ldpm_n_knkwb /end AXIS_DESCR
 /begin AXIS_DESCR COM_AXIS maf_knk _CNV_A_R_LINEAR_____14_CM 4 0. 1389. FORMAT "%4.0" AXIS_PTS_REF ldpm_maf_knkwb /end AXIS_DESCR
/end CHARACTERISTIC
/begin CHARACTERISTIC ip_knkwe_4__n__maf "End of Measurement Window Cyl.5" MAP 0xa1025d50 _REC_MAP_20_u2_u1_u1 113.625 _CNV_A_R_LINEAR_____168_CM 0.375 114. DISPLAY_IDENTIFIER IP_KNKWE[4] FORMAT "%5.1"
 /begin AXIS_DESCR COM_AXIS n_knk _CNV_A_R_LINEAR_____9_CM 10 0. 8160. FORMAT "%4.0" AXIS_PTS_REF ldpm_n_knkwb /end AXIS_DESCR
 /begin AXIS_DESCR COM_AXIS maf_knk _CNV_A_R_LINEAR_____14_CM 4 0. 1389. FORMAT "%4.0" AXIS_PTS_REF ldpm_maf_knkwb /end AXIS_DESCR
/end CHARACTERISTIC
/begin CHARACTERISTIC ip_knkwe_5__n__maf "End of Measurement Window Cyl.6" MAP 0xa1025da0 _REC_MAP_20_u2_u1_u1 113.625 _CNV_A_R_LINEAR_____168_CM 0.375 114. DISPLAY_IDENTIFIER IP_KNKWE[5] FORMAT "%5.1"
 /begin AXIS_DESCR COM_AXIS n_knk _CNV_A_R_LINEAR_____9_CM 10 0. 8160. FORMAT "%4.0" AXIS_PTS_REF ldpm_n_knkwb /end AXIS_DESCR
 /begin AXIS_DESCR COM_AXIS maf_knk _CNV_A_R_LINEAR_____14_CM 4 0. 1389. FORMAT "%4.0" AXIS_PTS_REF ldpm_maf_knkwb /end AXIS_DESCR
/end CHARACTERISTIC
/begin CHARACTERISTIC ip_gain_knk_0__n__maf "Amplification precontrol Cyl.1" MAP 0xa1024cf4 _REC_MAP_20_u1_u1_u1 63. _CNV_A_R_LINEAR_____0_CM 0. 63. DISPLAY_IDENTIFIER IP_GAIN_KNK[0] FORMAT "%2.0"
 /begin AXIS_DESCR COM_AXIS n_knk _CNV_A_R_LINEAR_____9_CM 16 0. 8160. FORMAT "%4.0" AXIS_PTS_REF ldpm_n_2_9 /end AXIS_DESCR
 /begin AXIS_DESCR COM_AXIS maf_knk _CNV_A_R_LINEAR_____14_CM 4 0. 1389. FORMAT "%4.0" AXIS_PTS_REF ldpm_maf_1_9 /end AXIS_DESCR
/end CHARACTERISTIC
/begin CHARACTERISTIC ip_gain_knk_2__n__maf "Amplification precontrol Cyl.3" MAP 0xa1024d74 _REC_MAP_20_u1_u1_u1 63. _CNV_A_R_LINEAR_____0_CM 0. 63. DISPLAY_IDENTIFIER IP_GAIN_KNK[2] FORMAT "%2.0"
 /begin AXIS_DESCR COM_AXIS n_knk _CNV_A_R_LINEAR_____9_CM 16 0. 8160. FORMAT "%4.0" AXIS_PTS_REF ldpm_n_2_9 /end AXIS_DESCR
 /begin AXIS_DESCR COM_AXIS maf_knk _CNV_A_R_LINEAR_____14_CM 4 0. 1389. FORMAT "%4.0" AXIS_PTS_REF ldpm_maf_1_9 /end AXIS_DESCR
/end CHARACTERISTIC
/begin CHARACTERISTIC ip_gain_knk_3__n__maf "Amplification precontrol Cyl.4" MAP 0xa1024db4 _REC_MAP_20_u1_u1_u1 63. _CNV_A_R_LINEAR_____0_CM 0. 63. DISPLAY_IDENTIFIER IP_GAIN_KNK[3] FORMAT "%2.0"
 /begin AXIS_DESCR COM_AXIS n_knk _CNV_A_R_LINEAR_____9_CM 16 0. 8160. FORMAT "%4.0" AXIS_PTS_REF ldpm_n_2_9 /end AXIS_DESCR
 /begin AXIS_DESCR COM_AXIS maf_knk _CNV_A_R_LINEAR_____14_CM 4 0. 1389. FORMAT "%4.0" AXIS_PTS_REF ldpm_maf_1_9 /end AXIS_DESCR
/end CHARACTERISTIC
/begin CHARACTERISTIC ip_gain_knk_4__n__maf "Amplification precontrol Cyl.5" MAP 0xa1024df4 _REC_MAP_20_u1_u1_u1 63. _CNV_A_R_LINEAR_____0_CM 0. 63. DISPLAY_IDENTIFIER IP_GAIN_KNK[4] FORMAT "%2.0"
 /begin AXIS_DESCR COM_AXIS n_knk _CNV_A_R_LINEAR_____9_CM 16 0. 8160. FORMAT "%4.0" AXIS_PTS_REF ldpm_n_2_9 /end AXIS_DESCR
 /begin AXIS_DESCR COM_AXIS maf_knk _CNV_A_R_LINEAR_____14_CM 4 0. 1389. FORMAT "%4.0" AXIS_PTS_REF ldpm_maf_1_9 /end AXIS_DESCR
/end CHARACTERISTIC
/begin CHARACTERISTIC ip_gain_knk_5__n__maf "Amplification precontrol Cyl.6" MAP 0xa1024e34 _REC_MAP_20_u1_u1_u1 63. _CNV_A_R_LINEAR_____0_CM 0. 63. DISPLAY_IDENTIFIER IP_GAIN_KNK[5] FORMAT "%2.0"
 /begin AXIS_DESCR COM_AXIS n_knk _CNV_A_R_LINEAR_____9_CM 16 0. 8160. FORMAT "%4.0" AXIS_PTS_REF ldpm_n_2_9 /end AXIS_DESCR
 /begin AXIS_DESCR COM_AXIS maf_knk _CNV_A_R_LINEAR_____14_CM 4 0. 1389. FORMAT "%4.0" AXIS_PTS_REF ldpm_maf_1_9 /end AXIS_DESCR
/end CHARACTERISTIC
/begin CHARACTERISTIC ip_knkwb_0__n__maf "Beginning of Measurement Window Cyl.1" MAP 0xa1025a30 _REC_MAP_20_u2_u1_u1 108. _CNV_A_R_LINEAR_____168_CM 0. 108. DISPLAY_IDENTIFIER IP_KNKWB[0] FORMAT "%5.1"
 /begin AXIS_DESCR COM_AXIS n_knk _CNV_A_R_LINEAR_____9_CM 10 0. 8160. FORMAT "%4.0" AXIS_PTS_REF ldpm_n_knkwb /end AXIS_DESCR
 /begin AXIS_DESCR COM_AXIS maf_knk _CNV_A_R_LINEAR_____14_CM 4 0. 1389. FORMAT "%4.0" AXIS_PTS_REF ldpm_maf_knkwb /end AXIS_DESCR
/end CHARACTERISTIC
/begin CHARACTERISTIC id_itc_knk_0__n__maf "Integration time constant Cyl.1" MAP 0xa10229d4 _REC_MAP_20_u1_u1_u1 31. _CNV_A_R_LINEAR_____0_CM 0. 31. DISPLAY_IDENTIFIER ID_ITC_KNK[0] FORMAT "%2.0"
 /begin AXIS_DESCR COM_AXIS n_knk _CNV_A_R_LINEAR_____9_CM 16 0. 8160. FORMAT "%4.0" AXIS_PTS_REF ldpm_n_2_9 /end AXIS_DESCR
 /begin AXIS_DESCR COM_AXIS maf_knk _CNV_A_R_LINEAR_____14_CM 4 0. 1389. FORMAT "%4.0" AXIS_PTS_REF ldpm_maf_1_9 /end AXIS_DESCR
/end CHARACTERISTIC
/begin CHARACTERISTIC id_itc_knk_1__n__maf "Integration time constant Cyl.2" MAP 0xa1022a14 _REC_MAP_20_u1_u1_u1 31. _CNV_A_R_LINEAR_____0_CM 0. 31. DISPLAY_IDENTIFIER ID_ITC_KNK[1] FORMAT "%2.0"
 /begin AXIS_DESCR COM_AXIS n_knk _CNV_A_R_LINEAR_____9_CM 16 0. 8160. FORMAT "%4.0" AXIS_PTS_REF ldpm_n_2_9 /end AXIS_DESCR
 /begin AXIS_DESCR COM_AXIS maf_knk _CNV_A_R_LINEAR_____14_CM 4 0. 1389. FORMAT "%4.0" AXIS_PTS_REF ldpm_maf_1_9 /end AXIS_DESCR
/end CHARACTERISTIC
/begin CHARACTERISTIC id_itc_knk_2__n__maf "Integration time constant Cyl.3" MAP 0xa1022a54 _REC_MAP_20_u1_u1_u1 31. _CNV_A_R_LINEAR_____0_CM 0. 31. DISPLAY_IDENTIFIER ID_ITC_KNK[2] FORMAT "%2.0"
 /begin AXIS_DESCR COM_AXIS n_knk _CNV_A_R_LINEAR_____9_CM 16 0. 8160. FORMAT "%4.0" AXIS_PTS_REF ldpm_n_2_9 /end AXIS_DESCR
 /begin AXIS_DESCR COM_AXIS maf_knk _CNV_A_R_LINEAR_____14_CM 4 0. 1389. FORMAT "%4.0" AXIS_PTS_REF ldpm_maf_1_9 /end AXIS_DESCR
/end CHARACTERISTIC
/begin CHARACTERISTIC id_itc_knk_3__n__maf "Integration time constant Cyl.4" MAP 0xa1022a94 _REC_MAP_20_u1_u1_u1 31. _CNV_A_R_LINEAR_____0_CM 0. 31. DISPLAY_IDENTIFIER ID_ITC_KNK[3] FORMAT "%2.0"
 /begin AXIS_DESCR COM_AXIS n_knk _CNV_A_R_LINEAR_____9_CM 16 0. 8160. FORMAT "%4.0" AXIS_PTS_REF ldpm_n_2_9 /end AXIS_DESCR
 /begin AXIS_DESCR COM_AXIS maf_knk _CNV_A_R_LINEAR_____14_CM 4 0. 1389. FORMAT "%4.0" AXIS_PTS_REF ldpm_maf_1_9 /end AXIS_DESCR
/end CHARACTERISTIC
/begin CHARACTERISTIC id_itc_knk_4__n__maf "Integration time constant Cyl.5" MAP 0xa1022ad4 _REC_MAP_20_u1_u1_u1 31. _CNV_A_R_LINEAR_____0_CM 0. 31. DISPLAY_IDENTIFIER ID_ITC_KNK[4] FORMAT "%2.0"
 /begin AXIS_DESCR COM_AXIS n_knk _CNV_A_R_LINEAR_____9_CM 16 0. 8160. FORMAT "%4.0" AXIS_PTS_REF ldpm_n_2_9 /end AXIS_DESCR
 /begin AXIS_DESCR COM_AXIS maf_knk _CNV_A_R_LINEAR_____14_CM 4 0. 1389. FORMAT "%4.0" AXIS_PTS_REF ldpm_maf_1_9 /end AXIS_DESCR
/end CHARACTERISTIC
/begin CHARACTERISTIC id_itc_knk_5__n__maf "Integration time constant Cyl.6" MAP 0xa1022b14 _REC_MAP_20_u1_u1_u1 31. _CNV_A_R_LINEAR_____0_CM 0. 31. DISPLAY_IDENTIFIER ID_ITC_KNK[5] FORMAT "%2.0"
 /begin AXIS_DESCR COM_AXIS n_knk _CNV_A_R_LINEAR_____9_CM 16 0. 8160. FORMAT "%4.0" AXIS_PTS_REF ldpm_n_2_9 /end AXIS_DESCR
 /begin AXIS_DESCR COM_AXIS maf_knk _CNV_A_R_LINEAR_____14_CM 4 0. 1389. FORMAT "%4.0" AXIS_PTS_REF ldpm_maf_1_9 /end AXIS_DESCR
/end CHARACTERISTIC
/begin CHARACTERISTIC c_knks_1_diag "Assignment of cylinder number to knock sensor 1 (diagnosis only)" VALUE 0xa10294be _REC_VAL_20_u1 255. _CNV_A_R_LINEAR_____0_CM 0. 255. DISPLAY_IDENTIFIER C_KNKS_1_DIAG FORMAT "%3.0" /end CHARACTERISTIC
/begin CHARACTERISTIC c_knks_2_diag "Assignment of cylinder number to knock sensor 2 (diagnosis only)" VALUE 0xa10294bf _REC_VAL_20_u1 255. _CNV_A_R_LINEAR_____0_CM 0. 255. DISPLAY_IDENTIFIER C_KNKS_2_DIAG FORMAT "%3.0" /end CHARACTERISTIC
/begin MEASUREMENT maf_knk "Mass air flow with hysteresis" UBYTE _CNV_A_R_LINEAR_____14_CM 1 100. 0. 1389. DISPLAY_IDENTIFIER MAF_KNK ECU_ADDRESS 0xd0003d2c FORMAT "%7.2" /end MEASUREMENT
/begin MEASUREMENT knks_1_diag "Assignment of cylinder number to knock sensor 1 (diagnosis only)" UBYTE _CNV_A_R_LINEAR_____0_CM 1 100. 0. 255. DISPLAY_IDENTIFIER KNKS_1_DIAG ECU_ADDRESS 0xd0003d5a FORMAT "%3.0" /end MEASUREMENT
/begin MEASUREMENT knks_2_diag "Assignment of cylinder number to knock sensor 2 (diagnosis only)" UBYTE _CNV_A_R_LINEAR_____0_CM 1 100. 0. 255. DISPLAY_IDENTIFIER KNKS_2_DIAG ECU_ADDRESS 0xd0003d5b FORMAT "%3.0" /end MEASUREMENT
/begin CHARACTERISTIC ip_knk_thd_add_n "Knock summand" CURVE 0xa1025a20 _REC_CUR_20_u1_u1 5.1 _CNV_A_R_LINEAR_____193_CM -2.56 2.54 DISPLAY_IDENTIFIER IP_KNK_THD_ADD_N FORMAT "%4.2"
 /begin AXIS_DESCR COM_AXIS n_knk _CNV_A_R_LINEAR_____9_CM 16 0. 8160. FORMAT "%4.0" AXIS_PTS_REF ldpm_n_2_9 /end AXIS_DESCR
/end CHARACTERISTIC
/begin MEASUREMENT knk_ctl_dis "knock control disabled due to malfunctions" UBYTE _CNV_S_2_RANGE__0___1_CM 1 100. 0. 1. DISPLAY_IDENTIFIER KNK_CTL_DIS ECU_ADDRESS 0xd0003d64 /end MEASUREMENT
/begin CHARACTERISTIC c_lamb_cop_min "minimum value for catalyst overheating protection" VALUE 0xa10294cc _REC_VAL_20_u2 31.9990234375 _CNV_A_R_LINEAR_____122_CM 0. 31.9990234375 DISPLAY_IDENTIFIER C_LAMB_COP_MIN FORMAT "%7.4" /end CHARACTERISTIC
/begin CHARACTERISTIC c_lamb_cop_pas "passive value for the lambda catalyst overheating prevention" VALUE 0xa10294ce _REC_VAL_20_u2 31.9990234375 _CNV_A_R_LINEAR_____122_CM 0. 31.9990234375 DISPLAY_IDENTIFIER C_LAMB_COP_PAS FORMAT "%7.4" /end CHARACTERISTIC
/begin CHARACTERISTIC c_lamb_teg_cat_up_mdl_cop_i "I-part of controler" VALUE 0xa1029512 _REC_VAL_20_u2 3.9219e-003 _CNV_A_R_LINEAR_____196_CM 0. 3.9219e-003 DISPLAY_IDENTIFIER C_LAMB_TEG_CAT_UP_MDL_COP_I FORMAT "%9.8" /end CHARACTERISTIC
/begin CHARACTERISTIC c_lamb_teg_cat_down_cop_i "I-part of controler" VALUE 0xa1029510 _REC_VAL_20_u2 3.9219e-003 _CNV_A_R_LINEAR_____196_CM 0. 3.9219e-003 DISPLAY_IDENTIFIER C_LAMB_TEG_CAT_DOWN_COP_I FORMAT "%9.8" /end CHARACTERISTIC
/begin CHARACTERISTIC c_lamb_tnt_mdl_h_cop_i "I-part of controler" VALUE 0xa1029514 _REC_VAL_20_u2 3.9219e-003 _CNV_A_R_LINEAR_____196_CM 0. 3.9219e-003 DISPLAY_IDENTIFIER C_LAMB_TNT_MDL_H_COP_I FORMAT "%9.8" /end CHARACTERISTIC
/begin CHARACTERISTIC c_teg_cat_up_mdl_thd_min_cop "bottom threshold for exhaust gas temperature upstream of the precatalyst" VALUE 0xa1029a10 _REC_VAL_20_u2 2047. _CNV_A_R_LINEAR_____123_CM 0. 2047. DISPLAY_IDENTIFIER C_TEG_CAT_UP_MDL_THD_MIN_COP FORMAT "%7.2" /end CHARACTERISTIC
/begin CHARACTERISTIC c_tnt_mdl_h_thd_min_cop "bottom threshold for temperature in the NOx Trap catalyst" VALUE 0xa1029a60 _REC_VAL_20_u2 1023.984375 _CNV_A_R_LINEAR_____197_CM 0. 1023.984375 DISPLAY_IDENTIFIER C_TNT_MDL_H_THD_MIN_COP FORMAT "%6.1" /end CHARACTERISTIC
/begin CHARACTERISTIC c_tnt_mdl_h_thd_cop "threshold for temperature in the NOx Trap catalyst - I-controller activation" VALUE 0xa1029a5c _REC_VAL_20_u2 1023.984375 _CNV_A_R_LINEAR_____197_CM 0. 1023.984375 DISPLAY_IDENTIFIER C_TNT_MDL_H_THD_COP FORMAT "%6.1" /end CHARACTERISTIC
/begin CHARACTERISTIC c_tnt_mdl_h_thd_max_cop "maximum threshold for temperature in the NOx Trap catalyst" VALUE 0xa1029a5e _REC_VAL_20_u2 1023.984375 _CNV_A_R_LINEAR_____197_CM 0. 1023.984375 DISPLAY_IDENTIFIER C_TNT_MDL_H_THD_MAX_COP FORMAT "%6.1" /end CHARACTERISTIC
/begin CHARACTERISTIC c_teg_cat_down_thd_min_cop "bottom threshold for exhaust gas temperature downstream of the precatalyst" VALUE 0xa1029a08 _REC_VAL_20_u2 2047. _CNV_A_R_LINEAR_____123_CM 0. 2047. DISPLAY_IDENTIFIER C_TEG_CAT_DOWN_THD_MIN_COP FORMAT "%7.2" /end CHARACTERISTIC
/begin CHARACTERISTIC c_teg_cat_up_mdl_thd_cop "threshold for exhaust gas temperature upstream of the precatalyst - I-controller activation" VALUE 0xa1029a0c _REC_VAL_20_u2 2047. _CNV_A_R_LINEAR_____123_CM 0. 2047. DISPLAY_IDENTIFIER C_TEG_CAT_UP_MDL_THD_COP FORMAT "%7.2" /end CHARACTERISTIC
/begin CHARACTERISTIC c_teg_cat_down_thd_cop "threshold for exhaust gas temperature downstream of the precatalyst  - I-controller activation" VALUE 0xa1029a04 _REC_VAL_20_u2 2047. _CNV_A_R_LINEAR_____123_CM 0. 2047. DISPLAY_IDENTIFIER C_TEG_CAT_DOWN_THD_COP FORMAT "%7.2" /end CHARACTERISTIC
/begin CHARACTERISTIC c_teg_cat_up_mdl_thd_max_cop "Maximum threshold for exhaust gas temperature upstream of the precatalyst" VALUE 0xa1029a0e _REC_VAL_20_u2 2047. _CNV_A_R_LINEAR_____123_CM 0. 2047. DISPLAY_IDENTIFIER C_TEG_CAT_UP_MDL_THD_MAX_COP FORMAT "%7.2" /end CHARACTERISTIC
/begin CHARACTERISTIC c_teg_cat_down_thd_max_cop "Maximum threshold for exhaust gas temperature downstream of the precatalyst" VALUE 0xa1029a06 _REC_VAL_20_u2 2047. _CNV_A_R_LINEAR_____123_CM 0. 2047. DISPLAY_IDENTIFIER C_TEG_CAT_DOWN_THD_MAX_COP FORMAT "%7.2" /end CHARACTERISTIC
/begin MEASUREMENT lam_bank_1.cat_prev.lamb_cop_cus "lambda for catalyst overheating prevention" UWORD _CNV_A_R_LINEAR_____122_CM 1 100. 0. 31.9990234375 DISPLAY_IDENTIFIER LAMB_COP_CUS_1 ECU_ADDRESS 0xd00055c8 FORMAT "%7.4" /end MEASUREMENT
/begin MEASUREMENT lam_bank_1.cat_prev.lv_lamb_cop_cus "general flag for catalyst overheating prevention active and output" UBYTE _CNV_S_2_RANGE__0___1_CM 1 100. 0. 1. DISPLAY_IDENTIFIER LV_LAMB_COP_CUS_1 ECU_ADDRESS 0xd00055d2 BIT_MASK 0x1 /end MEASUREMENT
/begin MEASUREMENT lam_bank_1.cat_prev.lamb_teg_cat_up_mdl_cop "calculation value for catalyst overheating prevention upstream of the precatalyst" UWORD _CNV_A_R_LINEAR_____122_CM 1 100. 0. 31.9990234375 DISPLAY_IDENTIFIER LAMB_TEG_CAT_UP_MDL_COP_1 ECU_ADDRESS 0xd00055ca FORMAT "%7.4" /end MEASUREMENT
/begin MEASUREMENT lam_bank_1.cat_prev.lamb_teg_cat_down_cop "calculation value for catalyst overheating prevention downstream the precatalyst" UWORD _CNV_A_R_LINEAR_____122_CM 1 100. 0. 31.9990234375 DISPLAY_IDENTIFIER LAMB_TEG_CAT_DOWN_COP_1 ECU_ADDRESS 0xd00055cc FORMAT "%7.4" /end MEASUREMENT
/begin MEASUREMENT lam_bank_1.cat_prev.lamb_tnt_mdl_h_cop "calculation value for catalyst overheating prevention in the NOx-trap catalyst" UWORD _CNV_A_R_LINEAR_____122_CM 1 100. 0. 31.9990234375 DISPLAY_IDENTIFIER LAMB_TNT_MDL_H_COP_1 ECU_ADDRESS 0xd00055ce FORMAT "%7.4" /end MEASUREMENT
/begin MEASUREMENT lam_bank_1.cat_prev.lv_teg_cat_up_mdl_cop "flag for catalyst overheating prevention active" UBYTE _CNV_S_2_RANGE__0___1_CM 1 100. 0. 1. DISPLAY_IDENTIFIER LV_TEG_CAT_UP_MDL_COP_1 ECU_ADDRESS 0xd00055d3 BIT_MASK 0x1 /end MEASUREMENT
/begin MEASUREMENT lam_bank_1.cat_prev.lv_teg_cat_down_cop "flag for catalyst overheating prevention active" UBYTE _CNV_S_2_RANGE__0___1_CM 1 100. 0. 1. DISPLAY_IDENTIFIER LV_TEG_CAT_DOWN_COP_1 ECU_ADDRESS 0xd00055d4 BIT_MASK 0x1 /end MEASUREMENT
/begin MEASUREMENT lam_bank_1.cat_prev.lv_tnt_mdl_h_cop "flag for catalyst overheating prevention active" UBYTE _CNV_S_2_RANGE__0___1_CM 1 100. 0. 1. DISPLAY_IDENTIFIER LV_TNT_MDL_H_COP_1 ECU_ADDRESS 0xd00055d5 BIT_MASK 0x1 /end MEASUREMENT
/begin MEASUREMENT lam_bank_1.cat_prev.teg_cat_down "Exhaust gas temperature downstream the catalyst" UWORD _CNV_A_R_LINEAR_____123_CM 1 100. 0. 2047. DISPLAY_IDENTIFIER TEG_CAT_DOWN_1 ECU_ADDRESS 0xd00055d0 FORMAT "%7.2" /end MEASUREMENT
/begin MEASUREMENT lam_bank_1.lam_dlyl.bf.lv_ldc_dly "status limited dynamic" ULONG _CNV_S_2_RANGE______75_CM 1 100. 0. 1. DISPLAY_IDENTIFIER LV_LDC_DLY_1 ECU_ADDRESS 0xd000562c BIT_MASK 0x1 /end MEASUREMENT
/begin MEASUREMENT lam_bank_1.lam_dlyl.bf.lv_lam_mv_ldc_dly "status limited dynamic FAC_LAM_MV[NC_CBK_EX_NR]" ULONG _CNV_S_2_RANGE______75_CM 1 100. 0. 1. DISPLAY_IDENTIFIER LV_LAM_MV_LDC_DLY_1 ECU_ADDRESS 0xd000562c BIT_MASK 0x2 /end MEASUREMENT
/begin MEASUREMENT lam_bank_1.lam_dlyl.lam_mv_mmv_dly "floating mean value for limited lambda deviation" SWORD _CNV_A_R_LINEAR_____110_CM 1 100. -50. 49.9984741210938 DISPLAY_IDENTIFIER LAM_MV_MMV_DLY_1 ECU_ADDRESS 0xd000562e FORMAT "%7.3" /end MEASUREMENT
/begin MEASUREMENT lam_bank_1.lam_dlyl.maf_int_ldc_dly "integral of mass air flow since limited dynamic conditions are fulfilled" UWORD _CNV_A_R_LINEAR_____198_CM 1 100. 0. 1820.398 DISPLAY_IDENTIFIER MAF_INT_LDC_DLY_1 ECU_ADDRESS 0xd0005632 FORMAT "%7.2" /end MEASUREMENT
/begin MEASUREMENT lam_bank_1.lam_dlyl.pv_av_grd_sum_dly "sum. value for limited lambda deviation" UWORD _CNV_A_R_LINEAR_____199_CM 1 100. 0. 639990.2340000001 DISPLAY_IDENTIFIER PV_AV_GRD_SUM_DLY_1 ECU_ADDRESS 0xd0005630 FORMAT "%8.1" /end MEASUREMENT
/begin MEASUREMENT lam_bank_2.cat_prev.lamb_cop_cus "lambda for catalyst overheating prevention" UWORD _CNV_A_R_LINEAR_____122_CM 1 100. 0. 31.9990234375 DISPLAY_IDENTIFIER LAMB_COP_CUS_2 ECU_ADDRESS 0xd0005660 FORMAT "%7.4" /end MEASUREMENT
/begin MEASUREMENT lam_bank_2.cat_prev.lv_lamb_cop_cus "general flag for catalyst overheating prevention active and output" UBYTE _CNV_S_2_RANGE__0___1_CM 1 100. 0. 1. DISPLAY_IDENTIFIER LV_LAMB_COP_CUS_2 ECU_ADDRESS 0xd000566a BIT_MASK 0x1 /end MEASUREMENT
/begin MEASUREMENT lam_bank_2.cat_prev.lamb_teg_cat_up_mdl_cop "calculation value for catalyst overheating prevention upstream of the precatalyst" UWORD _CNV_A_R_LINEAR_____122_CM 1 100. 0. 31.9990234375 DISPLAY_IDENTIFIER LAMB_TEG_CAT_UP_MDL_COP_2 ECU_ADDRESS 0xd0005662 FORMAT "%7.4" /end MEASUREMENT
/begin MEASUREMENT lam_bank_2.cat_prev.lamb_teg_cat_down_cop "calculation value for catalyst overheating prevention downstream the precatalyst" UWORD _CNV_A_R_LINEAR_____122_CM 1 100. 0. 31.9990234375 DISPLAY_IDENTIFIER LAMB_TEG_CAT_DOWN_COP_2 ECU_ADDRESS 0xd0005664 FORMAT "%7.4" /end MEASUREMENT
/begin MEASUREMENT lam_bank_2.cat_prev.lamb_tnt_mdl_h_cop "calculation value for catalyst overheating prevention in the NOx-trap catalyst" UWORD _CNV_A_R_LINEAR_____122_CM 1 100. 0. 31.9990234375 DISPLAY_IDENTIFIER LAMB_TNT_MDL_H_COP_2 ECU_ADDRESS 0xd0005666 FORMAT "%7.4" /end MEASUREMENT
/begin MEASUREMENT lam_bank_2.cat_prev.lv_teg_cat_up_mdl_cop "flag for catalyst overheating prevention active" UBYTE _CNV_S_2_RANGE__0___1_CM 1 100. 0. 1. DISPLAY_IDENTIFIER LV_TEG_CAT_UP_MDL_COP_2 ECU_ADDRESS 0xd000566b BIT_MASK 0x1 /end MEASUREMENT
/begin MEASUREMENT lam_bank_2.cat_prev.lv_teg_cat_down_cop "flag for catalyst overheating prevention active" UBYTE _CNV_S_2_RANGE__0___1_CM 1 100. 0. 1. DISPLAY_IDENTIFIER LV_TEG_CAT_DOWN_COP_2 ECU_ADDRESS 0xd000566c BIT_MASK 0x1 /end MEASUREMENT
/begin MEASUREMENT lam_bank_2.cat_prev.lv_tnt_mdl_h_cop "flag for catalyst overheating prevention active" UBYTE _CNV_S_2_RANGE__0___1_CM 1 100. 0. 1. DISPLAY_IDENTIFIER LV_TNT_MDL_H_COP_2 ECU_ADDRESS 0xd000566d BIT_MASK 0x1 /end MEASUREMENT
/begin MEASUREMENT lam_bank_2.cat_prev.teg_cat_down "Exhaust gas temperature downstream the catalyst" UWORD _CNV_A_R_LINEAR_____123_CM 1 100. 0. 2047. DISPLAY_IDENTIFIER TEG_CAT_DOWN_2 ECU_ADDRESS 0xd0005668 FORMAT "%7.2" /end MEASUREMENT
/begin MEASUREMENT lam_bank_2.lam_dlyl.bf.lv_ldc_dly "status limited dynamic" ULONG _CNV_S_2_RANGE______75_CM 1 100. 0. 1. DISPLAY_IDENTIFIER LV_LDC_DLY_2 ECU_ADDRESS 0xd00056c4 BIT_MASK 0x1 /end MEASUREMENT
/begin MEASUREMENT lam_bank_2.lam_dlyl.bf.lv_lam_mv_ldc_dly "status limited dynamic FAC_LAM_MV[NC_CBK_EX_NR]" ULONG _CNV_S_2_RANGE______75_CM 1 100. 0. 1. DISPLAY_IDENTIFIER LV_LAM_MV_LDC_DLY_2 ECU_ADDRESS 0xd00056c4 BIT_MASK 0x2 /end MEASUREMENT
/begin MEASUREMENT lam_bank_2.lam_dlyl.lam_mv_mmv_dly "floating mean value for limited lambda deviation" SWORD _CNV_A_R_LINEAR_____110_CM 1 100. -50. 49.9984741210938 DISPLAY_IDENTIFIER LAM_MV_MMV_DLY_2 ECU_ADDRESS 0xd00056c6 FORMAT "%7.3" /end MEASUREMENT
/begin MEASUREMENT lam_bank_2.lam_dlyl.maf_int_ldc_dly "integral of mass air flow since limited dynamic conditions are fulfilled" UWORD _CNV_A_R_LINEAR_____198_CM 1 100. 0. 1820.398 DISPLAY_IDENTIFIER MAF_INT_LDC_DLY_2 ECU_ADDRESS 0xd00056ca FORMAT "%7.2" /end MEASUREMENT
/begin MEASUREMENT lam_bank_2.lam_dlyl.pv_av_grd_sum_dly "sum. value for limited lambda deviation" UWORD _CNV_A_R_LINEAR_____199_CM 1 100. 0. 639990.2340000001 DISPLAY_IDENTIFIER PV_AV_GRD_SUM_DLY_2 ECU_ADDRESS 0xd00056c8 FORMAT "%8.1" /end MEASUREMENT
/begin CHARACTERISTIC lc_rpu_lamb_rgn_1 "Switch to use RPU value of LAMB_RGN_i" VALUE 0xa1029dc8 _REC_VAL_20_u1 1. _CNV_A_R_LINEAR_____0_CM 0. 1. DISPLAY_IDENTIFIER LC_RPU_LAMB_RGN_1 FORMAT "%1.0" /end CHARACTERISTIC
/begin MEASUREMENT t_rgn "Time counter for active regeneration" UWORD _CNV_A_R_LINEAR_____3_CM 1 100. 0. 655.35 DISPLAY_IDENTIFIER T_RGN ECU_ADDRESS 0xd0004dd4 FORMAT "%6.2" /end MEASUREMENT
/begin MEASUREMENT t_rgn_2 "Time counter for second regeneration" UWORD _CNV_A_R_LINEAR_____3_CM 1 100. 0. 655.35 DISPLAY_IDENTIFIER T_RGN_2 ECU_ADDRESS 0xd0004dd6 FORMAT "%6.2" /end MEASUREMENT
/begin MEASUREMENT lv_lamb_park_afl_deac "Deactivation flag for regeneration depending on T_RGN_2" UBYTE _CNV_S_2_RANGE__0___1_CM 1 100. 0. 1. DISPLAY_IDENTIFIER LV_LAMB_PARK_AFL_DEAC ECU_ADDRESS 0xc000087f BIT_MASK 0x1 /end MEASUREMENT
/begin MEASUREMENT lv_lamb_sp_swi "Flag of alternate" UBYTE _CNV_S_2_RANGE__0___1_CM 1 100. 0. 1. DISPLAY_IDENTIFIER LV_LAMB_SP_SWI ECU_ADDRESS 0xd0003a37 BIT_MASK 0x1 /end MEASUREMENT
/begin MEASUREMENT maf_kgh_hom "Calculated MAF_KGH for homogeneous operation" UWORD _CNV_A_R_LINEAR_____207_CM 1 100. 0. 2047.96875 DISPLAY_IDENTIFIER MAF_KGH_HOM ECU_ADDRESS 0xd0004ddc FORMAT "%10.5" /end MEASUREMENT
/begin CHARACTERISTIC c_lamb_purge_l_ampl "Lambda purge for low amplitude regeneration" VALUE 0xa10294f4 _REC_VAL_20_u2 31.9990234375 _CNV_A_R_LINEAR_____122_CM 0. 31.9990234375 DISPLAY_IDENTIFIER C_LAMB_PURGE_L_AMPL FORMAT "%7.4" /end CHARACTERISTIC
/begin CHARACTERISTIC c_lamb_pas_bas "Basis lambda setpoint for passive state" VALUE 0xa10294f0 _REC_VAL_20_u2 31.9990234375 _CNV_A_R_LINEAR_____122_CM 0. 31.9990234375 DISPLAY_IDENTIFIER C_LAMB_PAS_BAS FORMAT "%7.4" /end CHARACTERISTIC
/begin CHARACTERISTIC c_maf_kgh_thr_max "Definition of max MAF_KGH for calculation of lambda setpoint depending on MAF_KGH" VALUE 0xa102954a _REC_VAL_20_u2 2047.96875 _CNV_A_R_LINEAR_____207_CM 0. 2047.96875 DISPLAY_IDENTIFIER C_MAF_KGH_THR_MAX FORMAT "%10.5" /end CHARACTERISTIC
/begin CHARACTERISTIC c_maf_kgh_thr_min "Definition of min MAF_KGH for calculation of lambda setpoint depending on MAF_KGH" VALUE 0xa102954c _REC_VAL_20_u2 2047.96875 _CNV_A_R_LINEAR_____207_CM 0. 2047.96875 DISPLAY_IDENTIFIER C_MAF_KGH_THR_MIN FORMAT "%10.5" /end CHARACTERISTIC
/begin CHARACTERISTIC c_state_lamb_rgn_2_h_ampl "Lambda setpoint correction strategy for second high amplitude regeneration" VALUE 0xa10297b1 _REC_VAL_20_u1 3. _CNV_S_4_RANGE_C_ST_208_CM 0. 3. DISPLAY_IDENTIFIER C_STATE_LAMB_RGN_2_H_AMPL /end CHARACTERISTIC
/begin CHARACTERISTIC c_state_lamb_rgn_l_ampl "Strategy for low amplitude regeneration" VALUE 0xa10297b2 _REC_VAL_20_u1 3. _CNV_S_4_RANGE_C_ST_209_CM 0. 3. DISPLAY_IDENTIFIER C_STATE_LAMB_RGN_L_AMPL /end CHARACTERISTIC
/begin CHARACTERISTIC c_state_lamb_rgn_l_ampl_bas "Basis low amplitude lambda regeneration state" VALUE 0xa10297b3 _REC_VAL_20_u1 2. _CNV_S_3_RANGE_C_ST_210_CM 0. 2. DISPLAY_IDENTIFIER C_STATE_LAMB_RGN_L_AMPL_BAS /end CHARACTERISTIC
/begin CHARACTERISTIC c_state_lamb_rgn_1_h_ampl "Lambda setpoint correction strategy for first high amplitude regeneration" VALUE 0xa10297b0 _REC_VAL_20_u1 3. _CNV_S_4_RANGE_C_ST_208_CM 0. 3. DISPLAY_IDENTIFIER C_STATE_LAMB_RGN_1_H_AMPL /end CHARACTERISTIC
/begin CHARACTERISTIC c_t_purge_h_ampl "Purge time for high amplitude regeneration" VALUE 0xa102993c _REC_VAL_20_u2 655.35 _CNV_A_R_LINEAR_____3_CM 0. 655.35 DISPLAY_IDENTIFIER C_T_PURGE_H_AMPL FORMAT "%6.2" /end CHARACTERISTIC
/begin CHARACTERISTIC c_t_purge_l_ampl "Purge time for low amplitude regeneration" VALUE 0xa102993e _REC_VAL_20_u2 655.35 _CNV_A_R_LINEAR_____3_CM 0. 655.35 DISPLAY_IDENTIFIER C_T_PURGE_L_AMPL FORMAT "%6.2" /end CHARACTERISTIC
/begin CHARACTERISTIC c_vls_park_t_rgn_2_deac "Threshold value for switch from lean to stoichiometric park at second regeneration" VALUE 0xa1029c5c _REC_VAL_20_u2 1400. _CNV_A_R_LINEAR_____211_CM -200. 1200. DISPLAY_IDENTIFIER C_VLS_PARK_T_RGN_2_DEAC FORMAT "%4.0" /end CHARACTERISTIC
/begin AXIS_PTS ldp_vls_h_ampl_2_ip_lamb_fac "" 0xa10217f8 vls_nox_sens_1 _REC_AXS_20_u2 1400. _CNV_A_R_LINEAR_____211_CM 8 -200. 1200. FORMAT "%4.0" /end AXIS_PTS
/begin AXIS_PTS ldp_t_rgn_2_l_ampl_ip_lamb_fac "" 0xa1021238 t_rgn_2 _REC_AXS_20_u2 655.35 _CNV_A_R_LINEAR_____3_CM 8 0. 655.35 FORMAT "%6.2" /end AXIS_PTS
/begin AXIS_PTS ldp_vls_h_ampl_1_ip_lamb_fac "" 0xa10217e4 vls_nox_sens_1 _REC_AXS_20_u2 1400. _CNV_A_R_LINEAR_____211_CM 8 -200. 1200. FORMAT "%4.0" /end AXIS_PTS
/begin AXIS_PTS ldp_vls_park_1_ip_lamb_fac "" 0xa1021848 vls_nox_sens_1 _REC_AXS_20_u2 1400. _CNV_A_R_LINEAR_____211_CM 8 -200. 1200. FORMAT "%4.0" /end AXIS_PTS
/begin AXIS_PTS ldp_t_rgn_1_park_ip_lamb_fac "" 0xa1021224 t_rgn _REC_AXS_20_u2 655.35 _CNV_A_R_LINEAR_____3_CM 8 0. 655.35 FORMAT "%6.2" /end AXIS_PTS
/begin AXIS_PTS ldp_t_rgn_2_park_ip_lamb_fac "" 0xa102124c t_rgn_2 _REC_AXS_20_u2 655.35 _CNV_A_R_LINEAR_____3_CM 8 0. 655.35 FORMAT "%6.2" /end AXIS_PTS
/begin CHARACTERISTIC ip_lamb_fac_park_2_t_rgn_2 "Lambda setpoint correction factor for park depending on T_RGN_2" CURVE 0xa1026008 _REC_CUR_20_u1_u2 1.9921875 _CNV_A_R_LINEAR_____100_CM 0. 1.9921875 DISPLAY_IDENTIFIER IP_LAMB_FAC_PARK_2_T_RGN_2 FORMAT "%8.6"
 /begin AXIS_DESCR COM_AXIS t_rgn_2 _CNV_A_R_LINEAR_____3_CM 8 0. 655.35 FORMAT "%6.2" AXIS_PTS_REF ldp_t_rgn_2_park_ip_lamb_fac /end AXIS_DESCR
/end CHARACTERISTIC
/begin AXIS_PTS ldp_vls_l_ampl_2_ip_lamb_fac "" 0xa1021820 vls_nox_sens_1 _REC_AXS_20_u2 1400. _CNV_A_R_LINEAR_____211_CM 8 -200. 1200. FORMAT "%4.0" /end AXIS_PTS
/begin AXIS_PTS ldp_vls_l_ampl_1_ip_lamb_fac "" 0xa102180c vls_nox_sens_1 _REC_AXS_20_u2 1400. _CNV_A_R_LINEAR_____211_CM 8 -200. 1200. FORMAT "%4.0" /end AXIS_PTS
/begin AXIS_PTS ldp_t_rgn_1_l_ampl_ip_lamb_fac "" 0xa1021210 t_rgn _REC_AXS_20_u2 655.35 _CNV_A_R_LINEAR_____3_CM 8 0. 655.35 FORMAT "%6.2" /end AXIS_PTS
/begin AXIS_PTS ldp_maf_kgh_l_ampl_ip_lamb_fac "" 0xa1020cb0 maf_kgh_hom _REC_AXS_20_u2 2047.96875 _CNV_A_R_LINEAR_____207_CM 4 0. 2047.96875 FORMAT "%10.5" /end AXIS_PTS
/begin AXIS_PTS ldp_maf_kgh_hom_ip_lamb_bas "" 0xa1020c8c maf_kgh_hom _REC_AXS_20_u2 2047.96875 _CNV_A_R_LINEAR_____207_CM 8 0. 2047.96875 FORMAT "%10.5" /end AXIS_PTS
/begin MEASUREMENT state_rgn[0] "NOx regeneration state" UBYTE _CNV_S_4_STATE_RGN__212_CM 1 100. 0. 3. DISPLAY_IDENTIFIER STATE_RGN_1 ECU_ADDRESS 0xd0003a34 /end MEASUREMENT
/begin MEASUREMENT state_rgn[1] "NOx regeneration state" UBYTE _CNV_S_4_STATE_RGN__212_CM 1 100. 0. 3. DISPLAY_IDENTIFIER STATE_RGN_2 ECU_ADDRESS 0xd0003a35 /end MEASUREMENT
/begin MEASUREMENT lamb_rgn[0] "Lambda setpoint for catalyst regeneration" UWORD _CNV_A_R_LINEAR_____122_CM 1 100. 0. 31.9990234375 DISPLAY_IDENTIFIER LAMB_RGN_1 ECU_ADDRESS 0xd0004dd8 FORMAT "%7.4" /end MEASUREMENT
/begin MEASUREMENT lamb_rgn[1] "Lambda setpoint for catalyst regeneration" UWORD _CNV_A_R_LINEAR_____122_CM 1 100. 0. 31.9990234375 DISPLAY_IDENTIFIER LAMB_RGN_2 ECU_ADDRESS 0xd0004dda FORMAT "%7.4" /end MEASUREMENT
/begin MEASUREMENT lamb_rgn_fac[0] "factor for the correction of the regeneration lambda" UBYTE _CNV_A_R_LINEAR_____100_CM 1 100. 0. 1.9921875 DISPLAY_IDENTIFIER LAMB_RGN_FAC_1 ECU_ADDRESS 0xc000087c FORMAT "%8.6" /end MEASUREMENT
/begin MEASUREMENT lamb_rgn_fac[1] "factor for the correction of the regeneration lambda" UBYTE _CNV_A_R_LINEAR_____100_CM 1 100. 0. 1.9921875 DISPLAY_IDENTIFIER LAMB_RGN_FAC_2 ECU_ADDRESS 0xc000087d FORMAT "%8.6" /end MEASUREMENT
/begin CHARACTERISTIC c_lamb_purge_h_ampl "Lambda purge for high amplitude regeneration" VALUE 0xa10294f2 _REC_VAL_20_u2 31.9990234375 _CNV_A_R_LINEAR_____122_CM 0. 31.9990234375 DISPLAY_IDENTIFIER C_LAMB_PURGE_H_AMPL FORMAT "%7.4" /end CHARACTERISTIC
/begin CHARACTERISTIC c_lamb_rgn_h_ampl_bas "Basis lambda setpoint for high amplitude regeneration" VALUE 0xa10294f8 _REC_VAL_20_u2 31.9990234375 _CNV_A_R_LINEAR_____122_CM 0. 31.9990234375 DISPLAY_IDENTIFIER C_LAMB_RGN_H_AMPL_BAS FORMAT "%7.4" /end CHARACTERISTIC
/begin CHARACTERISTIC c_lamb_rgn_l_ampl_bas "Basis lambda setpoint for low amplitude regeneration" VALUE 0xa10294fa _REC_VAL_20_u2 31.9990234375 _CNV_A_R_LINEAR_____122_CM 0. 31.9990234375 DISPLAY_IDENTIFIER C_LAMB_RGN_L_AMPL_BAS FORMAT "%7.4" /end CHARACTERISTIC
/begin CHARACTERISTIC c_lamb_rgn_l_ampl_bas_max "Basis max lambda setpoint for low amplitude regeneration" VALUE 0xa10294fc _REC_VAL_20_u2 31.9990234375 _CNV_A_R_LINEAR_____122_CM 0. 31.9990234375 DISPLAY_IDENTIFIER C_LAMB_RGN_L_AMPL_BAS_MAX FORMAT "%7.4" /end CHARACTERISTIC
/begin CHARACTERISTIC c_state_rgn_1_park "Park strategy for first regeneration" VALUE 0xa10297b8 _REC_VAL_20_u1 3. _CNV_S_4_RANGE_C_ST_208_CM 0. 3. DISPLAY_IDENTIFIER C_STATE_RGN_1_PARK /end CHARACTERISTIC
/begin CHARACTERISTIC c_state_rgn_2_park "Park strategy for second regeneration" VALUE 0xa10297b9 _REC_VAL_20_u1 3. _CNV_S_4_RANGE_C_ST_208_CM 0. 3. DISPLAY_IDENTIFIER C_STATE_RGN_2_PARK /end CHARACTERISTIC
/begin CHARACTERISTIC c_state_rgn_ini_1 "Initialisation state for first bank" VALUE 0xa10297bb _REC_VAL_20_u1 3. _CNV_S_4_STATE_RGN__212_CM 0. 3. DISPLAY_IDENTIFIER C_STATE_RGN_INI_1 /end CHARACTERISTIC
/begin CHARACTERISTIC c_state_rgn_ini_2 "Initialisation state for second bank" VALUE 0xa10297bc _REC_VAL_20_u1 3. _CNV_S_4_STATE_RGN__212_CM 0. 3. DISPLAY_IDENTIFIER C_STATE_RGN_INI_2 /end CHARACTERISTIC
/begin CHARACTERISTIC ip_lamb_fac_h_ampl_2_vls "Lambda setpoint correction factor for second high amplitude regeneration depending on VLS_NOX_SENS_1" CURVE 0xa1025fb8 _REC_CUR_20_u1_u2 1.9921875 _CNV_A_R_LINEAR_____100_CM 0. 1.9921875 DISPLAY_IDENTIFIER IP_LAMB_FAC_H_AMPL_2_VLS FORMAT "%8.6"
 /begin AXIS_DESCR COM_AXIS vls_nox_sens_1 _CNV_A_R_LINEAR_____211_CM 8 -200. 1200. FORMAT "%4.0" AXIS_PTS_REF ldp_vls_h_ampl_2_ip_lamb_fac /end AXIS_DESCR
/end CHARACTERISTIC
/begin CHARACTERISTIC ip_lamb_fac_l_ampl_2_vls "Lambda setpoint correction factor for second low amplitude regeneration depending on VLS_NOX_SENS_1" CURVE 0xa1025fc0 _REC_CUR_20_u1_u2 1.9921875 _CNV_A_R_LINEAR_____100_CM 0. 1.9921875 DISPLAY_IDENTIFIER IP_LAMB_FAC_L_AMPL_2_VLS FORMAT "%8.6"
 /begin AXIS_DESCR COM_AXIS vls_nox_sens_1 _CNV_A_R_LINEAR_____211_CM 8 -200. 1200. FORMAT "%4.0" AXIS_PTS_REF ldp_vls_l_ampl_2_ip_lamb_fac /end AXIS_DESCR
/end CHARACTERISTIC
/begin CHARACTERISTIC ip_lamb_fac_l_ampl_t_rgn_2 "Lambda setpoint correction factor for low amplitude regeneration depending on T_RGN_2" CURVE 0xa1025fd0 _REC_CUR_20_u1_u2 1.9921875 _CNV_A_R_LINEAR_____100_CM 0. 1.9921875 DISPLAY_IDENTIFIER IP_LAMB_FAC_L_AMPL_T_RGN_2 FORMAT "%8.6"
 /begin AXIS_DESCR COM_AXIS t_rgn_2 _CNV_A_R_LINEAR_____3_CM 8 0. 655.35 FORMAT "%6.2" AXIS_PTS_REF ldp_t_rgn_2_l_ampl_ip_lamb_fac /end AXIS_DESCR
/end CHARACTERISTIC
/begin CHARACTERISTIC ip_lamb_fac_l_ampl_t_rgn_1 "Lambda setpoint correction factor for low amplitude regeneration depending on T_RGN" CURVE 0xa1025fc8 _REC_CUR_20_u1_u2 1.9921875 _CNV_A_R_LINEAR_____100_CM 0. 1.9921875 DISPLAY_IDENTIFIER IP_LAMB_FAC_L_AMPL_T_RGN_1 FORMAT "%8.6"
 /begin AXIS_DESCR COM_AXIS t_rgn _CNV_A_R_LINEAR_____3_CM 8 0. 655.35 FORMAT "%6.2" AXIS_PTS_REF ldp_t_rgn_1_l_ampl_ip_lamb_fac /end AXIS_DESCR
/end CHARACTERISTIC
/begin CHARACTERISTIC ip_lamb_fac_h_ampl_1_vls "Lambda setpoint correction factor for first high amplitude regeneration depending on VLS_NOX_SENS_1" CURVE 0xa1025fb0 _REC_CUR_20_u1_u2 1.9921875 _CNV_A_R_LINEAR_____100_CM 0. 1.9921875 DISPLAY_IDENTIFIER IP_LAMB_FAC_H_AMPL_1_VLS FORMAT "%8.6"
 /begin AXIS_DESCR COM_AXIS vls_nox_sens_1 _CNV_A_R_LINEAR_____211_CM 8 -200. 1200. FORMAT "%4.0" AXIS_PTS_REF ldp_vls_h_ampl_1_ip_lamb_fac /end AXIS_DESCR
/end CHARACTERISTIC
/begin CHARACTERISTIC ip_lamb_fac_park_1_vls "Lambda setpoint correction factor for park depending on VLS_NOX_SENS_1" CURVE 0xa1026000 _REC_CUR_20_u1_u2 1.9921875 _CNV_A_R_LINEAR_____100_CM 0. 1.9921875 DISPLAY_IDENTIFIER IP_LAMB_FAC_PARK_1_VLS FORMAT "%8.6"
 /begin AXIS_DESCR COM_AXIS vls_nox_sens_1 _CNV_A_R_LINEAR_____211_CM 8 -200. 1200. FORMAT "%4.0" AXIS_PTS_REF ldp_vls_park_1_ip_lamb_fac /end AXIS_DESCR
/end CHARACTERISTIC
/begin CHARACTERISTIC ip_lamb_fac_park_1_t_rgn "Lambda setpoint correction factor for park for first regeneration depending on T_RGN" CURVE 0xa1025ff8 _REC_CUR_20_u1_u2 1.9921875 _CNV_A_R_LINEAR_____100_CM 0. 1.9921875 DISPLAY_IDENTIFIER IP_LAMB_FAC_PARK_1_T_RGN FORMAT "%8.6"
 /begin AXIS_DESCR COM_AXIS t_rgn _CNV_A_R_LINEAR_____3_CM 8 0. 655.35 FORMAT "%6.2" AXIS_PTS_REF ldp_t_rgn_1_park_ip_lamb_fac /end AXIS_DESCR
/end CHARACTERISTIC
/begin CHARACTERISTIC ip_lamb_fac_l_ampl_vls_maf_kgh "Lambda setpoint correction factor for first low amplitude regeneration depending on MAF and VLS_NOX_SENS_1" MAP 0xa1025fd8 _REC_MAP_20_u1_u2_u2 1.9921875 _CNV_A_R_LINEAR_____100_CM 0. 1.9921875 DISPLAY_IDENTIFIER IP_LAMB_FAC_L_AMPL_VLS_MAF_KGH FORMAT "%8.6"
 /begin AXIS_DESCR COM_AXIS maf_kgh_hom _CNV_A_R_LINEAR_____207_CM 4 0. 2047.96875 FORMAT "%10.5" AXIS_PTS_REF ldp_maf_kgh_l_ampl_ip_lamb_fac /end AXIS_DESCR
 /begin AXIS_DESCR COM_AXIS vls_nox_sens_1 _CNV_A_R_LINEAR_____211_CM 8 -200. 1200. FORMAT "%4.0" AXIS_PTS_REF ldp_vls_l_ampl_1_ip_lamb_fac /end AXIS_DESCR
/end CHARACTERISTIC
/begin CHARACTERISTIC ip_lamb_rgn_l_ampl_bas "Lambda low regeneration setpoint depending on MAF_KGH" CURVE 0xa10260a0 _REC_CUR_20_u2_u2 31.9990234375 _CNV_A_R_LINEAR_____122_CM 0. 31.9990234375 DISPLAY_IDENTIFIER IP_LAMB_RGN_L_AMPL_BAS FORMAT "%7.4"
 /begin AXIS_DESCR COM_AXIS maf_kgh_hom _CNV_A_R_LINEAR_____207_CM 8 0. 2047.96875 FORMAT "%10.5" AXIS_PTS_REF ldp_maf_kgh_hom_ip_lamb_bas /end AXIS_DESCR
/end CHARACTERISTIC
/begin MEASUREMENT lamb_rgn_l_ampl_bas "Calculated basis low regeneration lambda setpoint" UWORD _CNV_A_R_LINEAR_____122_CM 1 100. 0. 31.9990234375 DISPLAY_IDENTIFIER LAMB_RGN_L_AMPL_BAS ECU_ADDRESS 0xc0000878 FORMAT "%7.4" /end MEASUREMENT
/begin MEASUREMENT ctr_rgn_cyc_lamb_rgn "Regenerations counter for calculation of alternate flag" UBYTE _CNV_A_R_LINEAR_____0_CM 1 100. 0. 255. DISPLAY_IDENTIFIER CTR_RGN_CYC_LAMB_RGN ECU_ADDRESS 0xd0003a36 FORMAT "%3.0" /end MEASUREMENT
/begin CHARACTERISTIC c_lamb_park_bas "Basis lambda setpoint for park" VALUE 0xa10294ee _REC_VAL_20_u2 31.9990234375 _CNV_A_R_LINEAR_____122_CM 0. 31.9990234375 DISPLAY_IDENTIFIER C_LAMB_PARK_BAS FORMAT "%7.4" /end CHARACTERISTIC
/begin CHARACTERISTIC c_ctr_rgn_swi_act "Number of regenerations with initialization of STATE_RGN when the alternate flag is 1" VALUE 0xa10292bc _REC_VAL_20_u1 254. _CNV_A_R_LINEAR_____0_CM 1. 255. DISPLAY_IDENTIFIER C_CTR_RGN_SWI_ACT FORMAT "%3.0" /end CHARACTERISTIC
/begin CHARACTERISTIC c_ctr_rgn_swi_deac "Number of regenerations with initialization of STATE_RGN when the alternate flag is 0" VALUE 0xa10292bd _REC_VAL_20_u1 254. _CNV_A_R_LINEAR_____0_CM 1. 255. DISPLAY_IDENTIFIER C_CTR_RGN_SWI_DEAC FORMAT "%3.0" /end CHARACTERISTIC
/begin MEASUREMENT maf_mmv_dly "floating mean value for limited MAF" UWORD _CNV_A_R_LINEAR_____108_CM 1 100. 0. 1389. DISPLAY_IDENTIFIER MAF_MMV_DLY ECU_ADDRESS 0xd0004eca FORMAT "%7.2" /end MEASUREMENT
/begin CHARACTERISTIC c_maf_crlc_dly "floating mean value calculation MAF" VALUE 0xa1029530 _REC_VAL_20_u2 0.9999847412109381 _CNV_A_R_LINEAR_____68_CM 0. 0.9999847412109381 DISPLAY_IDENTIFIER C_MAF_CRLC_DLY FORMAT "%7.5" /end CHARACTERISTIC
/begin CHARACTERISTIC c_lam_mv_crlc_dly "floating mean value calculation lambda " VALUE 0xa10294c2 _REC_VAL_20_u2 0.9999847412109381 _CNV_A_R_LINEAR_____68_CM 0. 0.9999847412109381 DISPLAY_IDENTIFIER C_LAM_MV_CRLC_DLY FORMAT "%7.5" /end CHARACTERISTIC
/begin CHARACTERISTIC c_n_dyw_dly "threshold limited dynamic engine speed" VALUE 0xa10295f4 _REC_VAL_20_u2 8159. _CNV_A_R_LINEAR_____13_CM 1. 8160. DISPLAY_IDENTIFIER C_N_DYW_DLY FORMAT "%4.0" /end CHARACTERISTIC
/begin CHARACTERISTIC c_maf_dyw_dly "threshold limited dynamic engine MAF " VALUE 0xa1029538 _REC_VAL_20_u2 1389. _CNV_A_R_LINEAR_____108_CM 0. 1389. DISPLAY_IDENTIFIER C_MAF_DYW_DLY FORMAT "%7.2" /end CHARACTERISTIC
/begin CHARACTERISTIC c_lam_mv_dyw_dly "threshold limited dynamic lambda " VALUE 0xa10294c4 _REC_VAL_20_u2 99.99847412109381 _CNV_A_R_LINEAR_____7_CM 0. 99.99847412109381 DISPLAY_IDENTIFIER C_LAM_MV_DYW_DLY /end CHARACTERISTIC
/begin MEASUREMENT n_mmv_dly "floating mean value for limited engine speed" UWORD _CNV_A_R_LINEAR_____13_CM 1 100. 0. 8160. DISPLAY_IDENTIFIER N_MMV_DLY ECU_ADDRESS 0xd0004ec8 FORMAT "%4.0" /end MEASUREMENT
/begin MEASUREMENT lv_n_ldc_dly "status limited dynamic N" UBYTE _CNV_S_2_RANGE__0___1_CM 1 100. 0. 1. DISPLAY_IDENTIFIER LV_N_LDC_DLY ECU_ADDRESS 0xc0000884 BIT_MASK 0x1 /end MEASUREMENT
/begin MEASUREMENT lv_maf_ldc_dly "status limited dynamic MAF" UBYTE _CNV_S_2_RANGE__0___1_CM 1 100. 0. 1. DISPLAY_IDENTIFIER LV_MAF_LDC_DLY ECU_ADDRESS 0xc0000885 BIT_MASK 0x1 /end MEASUREMENT
/begin CHARACTERISTIC c_n_crlc_dly "floating mean value calculation engine speed" VALUE 0xa10295d6 _REC_VAL_20_u2 0.9999847412109381 _CNV_A_R_LINEAR_____68_CM 0. 0.9999847412109381 DISPLAY_IDENTIFIER C_N_CRLC_DLY FORMAT "%7.5" /end CHARACTERISTIC
/begin CHARACTERISTIC c_pv_av_grd_dec_dly "decrement for calculation PV_AV gradient" VALUE 0xa1029727 _REC_VAL_20_u1 2490.234 _CNV_A_R_LINEAR_____213_CM 0. 2490.234 DISPLAY_IDENTIFIER C_PV_AV_GRD_DEC_DLY FORMAT "%6.1" /end CHARACTERISTIC
/begin CHARACTERISTIC c_pv_av_grd_sum_max_dly "max. threshold limited dynamic PV_AV gradient" VALUE 0xa102972a _REC_VAL_20_u2 639990.2340000001 _CNV_A_R_LINEAR_____199_CM 0. 639990.2340000001 DISPLAY_IDENTIFIER C_PV_AV_GRD_SUM_MAX_DLY FORMAT "%8.1" /end CHARACTERISTIC
/begin CHARACTERISTIC c_pv_av_grd_sum_min_dly "min. threshold limited dynamic PV_AV gradient" VALUE 0xa102972c _REC_VAL_20_u2 639990.2340000001 _CNV_A_R_LINEAR_____199_CM 0. 639990.2340000001 DISPLAY_IDENTIFIER C_PV_AV_GRD_SUM_MIN_DLY FORMAT "%8.1" /end CHARACTERISTIC
/begin CHARACTERISTIC c_t_pv_av_grd_dec_sum_dly "time periods for calculation limited dynamic PV_AV gradient" VALUE 0xa1029940 _REC_VAL_20_u1 5.1 _CNV_A_R_LINEAR_____107_CM 0. 5.1 DISPLAY_IDENTIFIER C_T_PV_AV_GRD_DEC_SUM_DLY FORMAT "%4.2" /end CHARACTERISTIC
/begin CHARACTERISTIC c_pv_av_grd_min_sum_dly "minimum value of PV_AV gradient to increment PV_AV_GRD_SUM_DLY" VALUE 0xa1029728 _REC_VAL_20_u1 1240.234 _CNV_A_R_LINEAR_____214_CM 0. 1240.234 DISPLAY_IDENTIFIER C_PV_AV_GRD_MIN_SUM_DLY FORMAT "%8.3" /end CHARACTERISTIC
/begin CHARACTERISTIC c_maf_int_min_ldc_dly "threshold for MAF integral while restart of LAM after inactive " VALUE 0xa1029540 _REC_VAL_20_u2 1820.398 _CNV_A_R_LINEAR_____198_CM 0. 1820.398 DISPLAY_IDENTIFIER C_MAF_INT_MIN_LDC_DLY FORMAT "%7.2" /end CHARACTERISTIC
/begin MEASUREMENT mff_sp_hom[0] "Mass fuel flow setpoint for homogeneous charge (output)" UWORD _CNV_A_R_LINEAR_____108_CM 1 100. 0. 1389. DISPLAY_IDENTIFIER MFF_SP_HOM[1] ECU_ADDRESS 0xd0005158 FORMAT "%7.2" /end MEASUREMENT
/begin MEASUREMENT mff_sp_hom[1] "Mass fuel flow setpoint for homogeneous charge (output)" UWORD _CNV_A_R_LINEAR_____108_CM 1 100. 0. 1389. DISPLAY_IDENTIFIER MFF_SP_HOM[2] ECU_ADDRESS 0xd000515a FORMAT "%7.2" /end MEASUREMENT
/begin MEASUREMENT mff_sp_fup_ctl "Mass fuel flow setpoint for fuel pressure control" UWORD _CNV_A_R_LINEAR_____108_CM 1 100. 0. 1389. DISPLAY_IDENTIFIER MFF_SP_FUP_CTL ECU_ADDRESS 0xd0005166 FORMAT "%7.2" /end MEASUREMENT
/begin MEASUREMENT mff_sp_hom_eng[0] "Mass fuel flow setpoint after combustion seletion" UWORD _CNV_A_R_LINEAR_____108_CM 1 100. 0. 1389. DISPLAY_IDENTIFIER MFF_SP_HOM_ENG[1] ECU_ADDRESS 0xd000515c FORMAT "%7.2" /end MEASUREMENT
/begin MEASUREMENT mff_sp_hom_eng[1] "Mass fuel flow setpoint after combustion seletion" UWORD _CNV_A_R_LINEAR_____108_CM 1 100. 0. 1389. DISPLAY_IDENTIFIER MFF_SP_HOM_ENG[2] ECU_ADDRESS 0xd000515e FORMAT "%7.2" /end MEASUREMENT
/begin MEASUREMENT mff_sp_mv "Mass fuel flow setpoint after combustion selection - mean value" UWORD _CNV_A_R_LINEAR_____108_CM 1 100. 0. 1389. DISPLAY_IDENTIFIER MFF_SP_MV ECU_ADDRESS 0xd0005164 FORMAT "%7.2" /end MEASUREMENT
/begin MEASUREMENT mff_sp[0] "Mass fuel flow setpoint after combustion selection - bank selective" UWORD _CNV_A_R_LINEAR_____108_CM 1 100. 0. 1389. DISPLAY_IDENTIFIER MFF_SP[1] ECU_ADDRESS 0xd0005160 FORMAT "%7.2" /end MEASUREMENT
/begin MEASUREMENT mff_sp[1] "Mass fuel flow setpoint after combustion selection - bank selective" UWORD _CNV_A_R_LINEAR_____108_CM 1 100. 0. 1389. DISPLAY_IDENTIFIER MFF_SP[2] ECU_ADDRESS 0xd0005162 FORMAT "%7.2" /end MEASUREMENT
/begin CHARACTERISTIC c_lamb_bas_cor_min "Minimum value for lambda setpoint" VALUE 0xa10294ca _REC_VAL_20_u2 31.9990234375 _CNV_A_R_LINEAR_____122_CM 0. 31.9990234375 DISPLAY_IDENTIFIER C_LAMB_BAS_COR_MIN FORMAT "%7.4" /end CHARACTERISTIC
/begin MEASUREMENT inh_iv_amt "Shut off sequence of AMT transmission" UBYTE _CNV_A_R_LINEAR_____0_CM 1 100. 0. 255. DISPLAY_IDENTIFIER INH_IV_AMT ECU_ADDRESS 0xd0003e4e FORMAT "%3.0" /end MEASUREMENT
/begin MEASUREMENT lv_ast_end "logical bit for \"After-start end\"" UBYTE _CNV_S_2_RANGE__0___1_CM 1 100. 0. 1. DISPLAY_IDENTIFIER LV_AST_END ECU_ADDRESS 0xd0003d71 BIT_MASK 0x1 /end MEASUREMENT
/begin AXIS_PTS ldpm_tia_ip_ti_cast "" 0xa102231c tia _REC_AXS_20_u1 28.575 _CNV_A_R_LINEAR_____16_CM 2 -48. 142.5 FORMAT "%5.1" /end AXIS_PTS
/begin CHARACTERISTIC ip_ti_cast_opm_2 "Initialization value of post start enrichment factor at operation mode 2" MAP 0xa1027eb8 _REC_MAP_20_u1_u1_u1 0.3984375 _CNV_A_R_LINEAR_____255_CM 0. 3.984375 DISPLAY_IDENTIFIER IP_TI_CAST_OPM_2 FORMAT "%4.2"
 /begin AXIS_DESCR COM_AXIS tia _CNV_A_R_LINEAR_____16_CM 2 -48. 142.5 FORMAT "%5.1" AXIS_PTS_REF ldpm_tia_ip_ti_cast /end AXIS_DESCR
 /begin AXIS_DESCR COM_AXIS tco _CNV_A_R_LINEAR_____16_CM 10 -48. 142.5 FORMAT "%5.1" AXIS_PTS_REF ldpm_tco__mff_deac_cst /end AXIS_DESCR
/end CHARACTERISTIC
/begin CHARACTERISTIC ip_ti_deac_cast_opm_2 "Deactivation factor of post start enrichment at operation mode 2" MAP 0xa1027f6c _REC_MAP_20_u1_u2_u1 9.9609375e-002 _CNV_A_R_LINEAR_____71_CM 0. 0.99609375 DISPLAY_IDENTIFIER IP_TI_DEAC_CAST_OPM_2 FORMAT "%5.3"
 /begin AXIS_DESCR COM_AXIS cyc_cast _CNV_A_R_LINEAR_____0_CM 16 0. 65535. FORMAT "%5.0" AXIS_PTS_REF ldpm_cyc_cast_2 /end AXIS_DESCR
 /begin AXIS_DESCR COM_AXIS tco _CNV_A_R_LINEAR_____16_CM 10 -48. 142.5 FORMAT "%5.1" AXIS_PTS_REF ldpm_tco__mff_deac_cst /end AXIS_DESCR
/end CHARACTERISTIC
/begin CHARACTERISTIC ip_ti_cast_opm_1 "Initialization value of post start enrichment factor at operation mode 1" MAP 0xa1027ea4 _REC_MAP_20_u1_u1_u1 0.3984375 _CNV_A_R_LINEAR_____255_CM 0. 3.984375 DISPLAY_IDENTIFIER IP_TI_CAST_OPM_1 FORMAT "%4.2"
 /begin AXIS_DESCR COM_AXIS tia _CNV_A_R_LINEAR_____16_CM 2 -48. 142.5 FORMAT "%5.1" AXIS_PTS_REF ldpm_tia_ip_ti_cast /end AXIS_DESCR
 /begin AXIS_DESCR COM_AXIS tco _CNV_A_R_LINEAR_____16_CM 10 -48. 142.5 FORMAT "%5.1" AXIS_PTS_REF ldpm_tco__mff_deac_cst /end AXIS_DESCR
/end CHARACTERISTIC
/begin CHARACTERISTIC ip_ti_deac_cast_opm_1 "Deactivation factor of post start enrichment at operation mode 1" MAP 0xa1027ecc _REC_MAP_20_u1_u2_u1 9.9609375e-002 _CNV_A_R_LINEAR_____71_CM 0. 0.99609375 DISPLAY_IDENTIFIER IP_TI_DEAC_CAST_OPM_1 FORMAT "%5.3"
 /begin AXIS_DESCR COM_AXIS cyc_cast _CNV_A_R_LINEAR_____0_CM 16 0. 65535. FORMAT "%5.0" AXIS_PTS_REF ldpm_cyc_cast_2 /end AXIS_DESCR
 /begin AXIS_DESCR COM_AXIS tco _CNV_A_R_LINEAR_____16_CM 10 -48. 142.5 FORMAT "%5.1" AXIS_PTS_REF ldpm_tco__mff_deac_cst /end AXIS_DESCR
/end CHARACTERISTIC
/begin AXIS_PTS ldpm_tco__mff_deac_cst "" 0xa1022258 tco _REC_AXS_20_u1 19.05 _CNV_A_R_LINEAR_____16_CM 10 -48. 142.5 FORMAT "%5.1" /end AXIS_PTS
/begin CHARACTERISTIC id_ti_cast_opm_av "Operation mode matrix (actual)" CURVE 0xa1022f9c _REC_CUR_20_u1_u1 7. _CNV_A_R_LINEAR_____0_CM 1. 8. DISPLAY_IDENTIFIER ID_TI_CAST_OPM_AV FORMAT "%1.0"
 /begin AXIS_DESCR COM_AXIS opm_av _CNV_A_R_LINEAR_____0_CM 8 0. 8. FORMAT "%1.0" AXIS_PTS_REF ldpm_opm_av /end AXIS_DESCR
/end CHARACTERISTIC
/begin CHARACTERISTIC id_ti_cast_opm_req "Operation mode matrix (requested)" CURVE 0xa1022fa4 _REC_CUR_20_u1_u1 7. _CNV_A_R_LINEAR_____0_CM 1. 8. DISPLAY_IDENTIFIER ID_TI_CAST_OPM_REQ FORMAT "%1.0"
 /begin AXIS_DESCR COM_AXIS opm_req _CNV_A_R_LINEAR_____0_CM 8 0. 8. FORMAT "%1.0" AXIS_PTS_REF ldpm_opm_req /end AXIS_DESCR
/end CHARACTERISTIC
/begin MEASUREMENT ti_cast "Cold post start injection time correction" UWORD _CNV_A_R_LINEAR_____23_CM 1 100. 0. 3.99993896484375 DISPLAY_IDENTIFIER TI_CAST ECU_ADDRESS 0xd0005168 FORMAT "%7.5" /end MEASUREMENT
/begin MEASUREMENT ti_cast_opm_1 "Cold start fuel mass flow at operation mode 1" UWORD _CNV_A_R_LINEAR_____23_CM 1 100. 0. 3.99993896484375 DISPLAY_IDENTIFIER TI_CAST_OPM_1 ECU_ADDRESS 0xc0000c04 FORMAT "%7.5" /end MEASUREMENT
/begin MEASUREMENT ti_cast_opm_2 "Cold start fuel mass flow at operation mode 2" UWORD _CNV_A_R_LINEAR_____23_CM 1 100. 0. 3.99993896484375 DISPLAY_IDENTIFIER TI_CAST_OPM_2 ECU_ADDRESS 0xc0000c06 FORMAT "%7.5" /end MEASUREMENT
/begin MEASUREMENT ti_cast_sel "Cold start fuel mass flow after operation mode manager" UWORD _CNV_A_R_LINEAR_____23_CM 1 100. 0. 3.99993896484375 DISPLAY_IDENTIFIER TI_CAST_SEL ECU_ADDRESS 0xc0000c08 FORMAT "%7.5" /end MEASUREMENT
/begin MEASUREMENT lv_ti_cast_opm_rls "Operation mode within valid range" UBYTE _CNV_S_2_RANGE__0___1_CM 1 100. 0. 1. DISPLAY_IDENTIFIER LV_TI_CAST_OPM_RLS ECU_ADDRESS 0xc0000c10 BIT_MASK 0x1 /end MEASUREMENT
/begin MEASUREMENT lv_ti_cast_opm_sel_1 "operation mode 1 is active" UBYTE _CNV_S_2_RANGE__0___1_CM 1 100. 0. 1. DISPLAY_IDENTIFIER LV_TI_CAST_OPM_SEL_1 ECU_ADDRESS 0xc0000c0e BIT_MASK 0x1 /end MEASUREMENT
/begin MEASUREMENT lv_ti_cast_opm_sel_2 "operation mode 2 is active" UBYTE _CNV_S_2_RANGE__0___1_CM 1 100. 0. 1. DISPLAY_IDENTIFIER LV_TI_CAST_OPM_SEL_2 ECU_ADDRESS 0xc0000c0f BIT_MASK 0x1 /end MEASUREMENT
/begin CHARACTERISTIC ip_fac_rest_ti_cast_opm_1 "Correction of post start enrichment dependent from TCO, MAP, and lambda adaptation, operation mode 1" MAP 0xa1023f4c _REC_MAP_20_u1_u2_u1 9.9609375e-002 _CNV_A_R_LINEAR_____71_CM 0. 0.99609375 DISPLAY_IDENTIFIER IP_FAC_REST_TI_CAST_OPM_1 FORMAT "%5.3"
 /begin AXIS_DESCR COM_AXIS cyc_cast _CNV_A_R_LINEAR_____0_CM 8 0. 65535. FORMAT "%5.0" AXIS_PTS_REF ldpm_cyc_cast_1 /end AXIS_DESCR
 /begin AXIS_DESCR COM_AXIS fac_st_rest _CNV_A_R_LINEAR_____97_CM 6 0. 1.99220002 FORMAT "%5.3" AXIS_PTS_REF ldpm_fac_st_rest /end AXIS_DESCR
/end CHARACTERISTIC
/begin CHARACTERISTIC ip_fac_rest_ti_cast_opm_2 "Correction of post start enrichment dependent from TCO, MAP, and lambda adaptation, operation mode 2" MAP 0xa1023f7c _REC_MAP_20_u1_u2_u1 9.9609375e-002 _CNV_A_R_LINEAR_____71_CM 0. 0.99609375 DISPLAY_IDENTIFIER IP_FAC_REST_TI_CAST_OPM_2 FORMAT "%5.3"
 /begin AXIS_DESCR COM_AXIS cyc_cast _CNV_A_R_LINEAR_____0_CM 8 0. 65535. FORMAT "%5.0" AXIS_PTS_REF ldpm_cyc_cast_1 /end AXIS_DESCR
 /begin AXIS_DESCR COM_AXIS fac_st_rest _CNV_A_R_LINEAR_____97_CM 6 0. 1.99220002 FORMAT "%5.3" AXIS_PTS_REF ldpm_fac_st_rest /end AXIS_DESCR
/end CHARACTERISTIC
/begin AXIS_PTS ldpm_fac_st_rest "" 0xa1021a26 fac_st_rest _REC_AXS_20_u1 1.99220002 _CNV_A_R_LINEAR_____97_CM 6 0. 1.99220002 FORMAT "%5.3" /end AXIS_PTS
/begin AXIS_PTS ldpm_cyc_cast_1 "" 0xa102194c cyc_cast _REC_AXS_20_u2 65535. _CNV_A_R_LINEAR_____0_CM 8 0. 65535. FORMAT "%5.0" /end AXIS_PTS
/begin AXIS_PTS ldpm_cyc_cast_2 "" 0xa1021960 cyc_cast _REC_AXS_20_u2 65535. _CNV_A_R_LINEAR_____0_CM 16 0. 65535. FORMAT "%5.0" /end AXIS_PTS
/begin CHARACTERISTIC ip_rest "Considering the shut-off time for re-start calculation" CURVE 0xa10277d8 _REC_CUR_20_u1_u2 0.199220002 _CNV_A_R_LINEAR_____17_CM 0. 0.99610001 DISPLAY_IDENTIFIER IP_REST FORMAT "%5.3"
 /begin AXIS_DESCR COM_AXIS t_es _CNV_A_R_LINEAR_____77_CM 8 0. 65535. FORMAT "%5.0" AXIS_PTS_REF ldp_t_es__rest /end AXIS_DESCR
/end CHARACTERISTIC
/begin CHARACTERISTIC ip_fac_rest "Considering coolant stop temperature and after start time for re-start calculation" MAP 0xa1023f0c _REC_MAP_20_u1_u2_u1 0.199220002 _CNV_A_R_LINEAR_____17_CM 0. 0.99610001 DISPLAY_IDENTIFIER IP_FAC_REST FORMAT "%5.3"
 /begin AXIS_DESCR COM_AXIS t_ast_rest _CNV_A_R_LINEAR_____4_CM 8 0. 6553.5 FORMAT "%6.1" AXIS_PTS_REF ldp_t_ast_rest /end AXIS_DESCR
 /begin AXIS_DESCR COM_AXIS tco_stop _CNV_A_R_LINEAR_____16_CM 8 -48. 142.5 FORMAT "%5.1" AXIS_PTS_REF ldp_tco_stop__fac_rest /end AXIS_DESCR
/end CHARACTERISTIC
/begin CHARACTERISTIC ip_fac_stall "Special cold start reduction factor in case of re-start after engine stall out" CURVE 0xa1023fac _REC_CUR_20_u1_u1 0.199220002 _CNV_A_R_LINEAR_____17_CM 0. 0.99610001 DISPLAY_IDENTIFIER IP_FAC_STALL FORMAT "%5.3"
 /begin AXIS_DESCR COM_AXIS tco _CNV_A_R_LINEAR_____16_CM 8 -48. 142.5 FORMAT "%5.1" AXIS_PTS_REF ldpm_tco__fac_stall /end AXIS_DESCR
/end CHARACTERISTIC
/begin AXIS_PTS ldpm_tco__ti_st_rest "" 0xa1022270 tco _REC_AXS_20_u1 28.575 _CNV_A_R_LINEAR_____16_CM 8 -48. 142.5 FORMAT "%5.1" /end AXIS_PTS
/begin AXIS_PTS ldp_tco_stop__fac_rest "" 0xa10212d8 tco_stop _REC_AXS_20_u1 28.575 _CNV_A_R_LINEAR_____16_CM 8 -48. 142.5 FORMAT "%5.1" /end AXIS_PTS
/begin AXIS_PTS ldpm_tco__fac_stall "" 0xa1022240 tco _REC_AXS_20_u1 28.575 _CNV_A_R_LINEAR_____16_CM 8 -48. 142.5 FORMAT "%5.1" /end AXIS_PTS
/begin AXIS_PTS ldp_t_es__rest "" 0xa10211d8 t_es _REC_AXS_20_u2 9830.25 _CNV_A_R_LINEAR_____77_CM 8 0. 65535. FORMAT "%5.0" /end AXIS_PTS
/begin AXIS_PTS ldp_t_ast_rest "" 0xa10211c4 t_ast_rest _REC_AXS_20_u2 983.025 _CNV_A_R_LINEAR_____4_CM 8 0. 6553.5 FORMAT "%6.1" /end AXIS_PTS
/begin CHARACTERISTIC ip_fac_stnd_rest "Cold start reduction factor in case of re-start with no engine stop time T_ES available" CURVE 0xa1023fb4 _REC_CUR_20_u1_u1 0.199220002 _CNV_A_R_LINEAR_____17_CM 0. 0.99610001 DISPLAY_IDENTIFIER IP_FAC_STND_REST FORMAT "%5.3"
 /begin AXIS_DESCR COM_AXIS tco _CNV_A_R_LINEAR_____16_CM 8 -48. 142.5 FORMAT "%5.1" AXIS_PTS_REF ldpm_tco__ti_st_rest /end AXIS_DESCR
/end CHARACTERISTIC
/begin MEASUREMENT fac_st_rest "Cold start reduction factor in case of re-start detected" UBYTE _CNV_A_R_LINEAR_____97_CM 1 100. 0. 1.99220002 DISPLAY_IDENTIFIER FAC_ST_REST ECU_ADDRESS 0xd0003d74 FORMAT "%5.3" /end MEASUREMENT
/begin CHARACTERISTIC ip_ti_wup_opm_1 "TI warm up correction at operation mode 1" MAP 0xa10280a4 _REC_MAP_20_u1_u1_u1 0.1494140625 _CNV_A_R_LINEAR_____71_CM 0. 0.99609375 DISPLAY_IDENTIFIER IP_TI_WUP_OPM_1 FORMAT "%5.3"
 /begin AXIS_DESCR COM_AXIS maf _CNV_A_R_LINEAR_____14_CM 8 0. 1389. FORMAT "%4.0" AXIS_PTS_REF ldpm_maf_hb__ti_wup /end AXIS_DESCR
 /begin AXIS_DESCR COM_AXIS n_32 _CNV_A_R_LINEAR_____9_CM 8 0. 8160. FORMAT "%4.0" AXIS_PTS_REF ldpm_n_32__ti_wup /end AXIS_DESCR
/end CHARACTERISTIC
/begin MEASUREMENT ti_wup_1 "Warm-up enrichment part after operation mode manager, intermediate value" UWORD _CNV_A_R_LINEAR_____256_CM 1 100. 0. 4. DISPLAY_IDENTIFIER TI_WUP_1 ECU_ADDRESS 0xc0000c6a FORMAT "%6.4" /end MEASUREMENT
/begin MEASUREMENT ti_wup "Warm-up injection time correction" UWORD _CNV_A_R_LINEAR_____256_CM 1 100. 0. 4. DISPLAY_IDENTIFIER TI_WUP ECU_ADDRESS 0xd000516c FORMAT "%6.4" /end MEASUREMENT
/begin MEASUREMENT ti_temp "Warm-up enrichment part, intermediate, permanent part" UWORD _CNV_A_R_LINEAR_____256_CM 1 100. 0. 4. DISPLAY_IDENTIFIER TI_TEMP ECU_ADDRESS 0xc0000c60 FORMAT "%6.4" /end MEASUREMENT
/begin CHARACTERISTIC ip_ti_tco_wup_opm_1 "TCO/TCO_ST-dependent warm up correction at operation mode 1" MAP 0xa1028074 _REC_MAP_20_u1_u1_u1 0.199220002 _CNV_A_R_LINEAR_____97_CM 0. 1.99220002 DISPLAY_IDENTIFIER IP_TI_TCO_WUP_OPM_1 FORMAT "%5.3"
 /begin AXIS_DESCR COM_AXIS tco_st _CNV_A_R_LINEAR_____16_CM 3 -48. 142.5 FORMAT "%5.1" AXIS_PTS_REF ldp_tco_st_ti_tco_wup_opm_1 /end AXIS_DESCR
 /begin AXIS_DESCR COM_AXIS tco _CNV_A_R_LINEAR_____16_CM 8 -48. 142.5 FORMAT "%5.1" AXIS_PTS_REF ldpm_tco_ti_wup_opm_1 /end AXIS_DESCR
/end CHARACTERISTIC
/begin CHARACTERISTIC ip_ti_fac_n_map "Injection time weighting for temperature influence f(operating point)" MAP 0xa102800c _REC_MAP_20_u1_u2_u1 9.9610001e-002 _CNV_A_R_LINEAR_____17_CM 0. 0.99610001 DISPLAY_IDENTIFIER IP_TI_FAC_N_MAP FORMAT "%5.3"
 /begin AXIS_DESCR COM_AXIS map _CNV_A_R_LINEAR_____26_CM 8 0. 5434. FORMAT "%7.2" AXIS_PTS_REF ldp_map__ti_fac_n_map /end AXIS_DESCR
 /begin AXIS_DESCR COM_AXIS n_32 _CNV_A_R_LINEAR_____9_CM 8 0. 8160. FORMAT "%4.0" AXIS_PTS_REF ldp_n_32__ti_fac_n_map /end AXIS_DESCR
/end CHARACTERISTIC
/begin CHARACTERISTIC ip_ti_fac_tia_toil "Injection time weighting for temperature influence f(TIA, TOIL)" MAP 0xa1028050 _REC_MAP_20_u1_u1_u1 0.199220002 _CNV_A_R_LINEAR_____97_CM 0. 1.99220002 DISPLAY_IDENTIFIER IP_TI_FAC_TIA_TOIL FORMAT "%5.3"
 /begin AXIS_DESCR COM_AXIS tia _CNV_A_R_LINEAR_____16_CM 6 -48. 142.5 FORMAT "%5.1" AXIS_PTS_REF ldp_tia_ti_fac_tia_toil /end AXIS_DESCR
 /begin AXIS_DESCR COM_AXIS toil _CNV_A_R_LINEAR_____25_CM 6 -40. 160. FORMAT "%3.0" AXIS_PTS_REF ldp_toil_ti_fac_tia_toil /end AXIS_DESCR
/end CHARACTERISTIC
/begin CHARACTERISTIC ip_ti_fac_tco "Injection time weighting for temperature influence f(coolant temperature)" CURVE 0xa102804c _REC_CUR_20_u1_u1 9.9610001e-002 _CNV_A_R_LINEAR_____17_CM 0. 0.99610001 DISPLAY_IDENTIFIER IP_TI_FAC_TCO FORMAT "%5.3"
 /begin AXIS_DESCR COM_AXIS tco _CNV_A_R_LINEAR_____16_CM 3 -48. 142.5 FORMAT "%5.1" AXIS_PTS_REF ldp_tco__ti_fac_tco /end AXIS_DESCR
/end CHARACTERISTIC
/begin AXIS_PTS ldpm_maf_hb__ti_wup "" 0xa1021c40 maf _REC_AXS_20_u1 1389. _CNV_A_R_LINEAR_____14_CM 8 0. 1389. FORMAT "%4.0" /end AXIS_PTS
/begin AXIS_PTS ldpm_n_32__ti_wup "" 0xa1021e30 n_32 _REC_AXS_20_u1 8160. _CNV_A_R_LINEAR_____9_CM 8 0. 8160. FORMAT "%4.0" /end AXIS_PTS
/begin AXIS_PTS ldp_map_dif__fac_ti_vo_wup "" 0xa1020d04 online_dummy _REC_AXS_20_u2 5434. _CNV_A_R_LINEAR_____26_CM 8 0. 5434. FORMAT "%7.2" /end AXIS_PTS
/begin AXIS_PTS ldp_map__ti_fac_n_map "" 0xa1020cf0 map _REC_AXS_20_u2 5434. _CNV_A_R_LINEAR_____26_CM 8 0. 5434. FORMAT "%7.2" /end AXIS_PTS
/begin AXIS_PTS ldp_n_32__ti_fac_n_map "" 0xa1020da8 n_32 _REC_AXS_20_u1 8160. _CNV_A_R_LINEAR_____9_CM 8 0. 8160. FORMAT "%4.0" /end AXIS_PTS
/begin AXIS_PTS ldp_toil_ti_fac_tia_toil "" 0xa1021456 toil _REC_AXS_20_u1 200. _CNV_A_R_LINEAR_____25_CM 6 -40. 160. FORMAT "%3.0" /end AXIS_PTS
/begin AXIS_PTS ldp_tia_ti_fac_tia_toil "" 0xa1021386 tia _REC_AXS_20_u1 190.5 _CNV_A_R_LINEAR_____16_CM 6 -48. 142.5 FORMAT "%5.1" /end AXIS_PTS
/begin AXIS_PTS ldp_tco__ti_fac_tco "" 0xa102129c tco _REC_AXS_20_u1 190.5 _CNV_A_R_LINEAR_____16_CM 3 -48. 142.5 FORMAT "%5.1" /end AXIS_PTS
/begin CHARACTERISTIC ip_fac_ti_vo_wup "Factor map for TCO/VO dependent warm up correction" MAP 0xa10242ac _REC_MAP_20_u1_u2_u1 0.199220002 _CNV_A_R_LINEAR_____97_CM 0. 1.99220002 DISPLAY_IDENTIFIER IP_FAC_TI_VO_WUP FORMAT "%5.3"
 /begin AXIS_DESCR COM_AXIS online_dummy _CNV_A_R_LINEAR_____26_CM 8 0. 5434. FORMAT "%7.2" AXIS_PTS_REF ldp_map_dif__fac_ti_vo_wup /end AXIS_DESCR
 /begin AXIS_DESCR COM_AXIS n_32 _CNV_A_R_LINEAR_____9_CM 8 0. 8160. FORMAT "%4.0" AXIS_PTS_REF ldpm_n_32__ti_wup /end AXIS_DESCR
/end CHARACTERISTIC
/begin CHARACTERISTIC ip_fac_ti_tco_wup_opm_1 "warm up basic factor at operation mode 1" CURVE 0xa102429c _REC_CUR_20_u1_u1 0.199220002 _CNV_A_R_LINEAR_____97_CM 0. 1.99220002 DISPLAY_IDENTIFIER IP_FAC_TI_TCO_WUP_OPM_1 FORMAT "%5.3"
 /begin AXIS_DESCR COM_AXIS tco _CNV_A_R_LINEAR_____16_CM 8 -48. 142.5 FORMAT "%5.1" AXIS_PTS_REF ldpm_tco_ti_wup_opm_1 /end AXIS_DESCR
/end CHARACTERISTIC
/begin CHARACTERISTIC ip_fac_ti_tco_wup_opm_2 "warm up basic factor at operation mode 2" CURVE 0xa10242a4 _REC_CUR_20_u1_u1 0.199220002 _CNV_A_R_LINEAR_____97_CM 0. 1.99220002 DISPLAY_IDENTIFIER IP_FAC_TI_TCO_WUP_OPM_2 FORMAT "%5.3"
 /begin AXIS_DESCR COM_AXIS tco _CNV_A_R_LINEAR_____16_CM 8 -48. 142.5 FORMAT "%5.1" AXIS_PTS_REF ldpm_tco_ti_wup_opm_2 /end AXIS_DESCR
/end CHARACTERISTIC
/begin CHARACTERISTIC ip_ti_tco_wup_opm_2 "TCO/TCO_ST-dependent warm up correction at operation mode 2" MAP 0xa102808c _REC_MAP_20_u1_u1_u1 0.199220002 _CNV_A_R_LINEAR_____97_CM 0. 1.99220002 DISPLAY_IDENTIFIER IP_TI_TCO_WUP_OPM_2 FORMAT "%5.3"
 /begin AXIS_DESCR COM_AXIS tco_st _CNV_A_R_LINEAR_____16_CM 3 -48. 142.5 FORMAT "%5.1" AXIS_PTS_REF ldp_tco_st_ti_tco_wup_opm_2 /end AXIS_DESCR
 /begin AXIS_DESCR COM_AXIS tco _CNV_A_R_LINEAR_____16_CM 8 -48. 142.5 FORMAT "%5.1" AXIS_PTS_REF ldpm_tco_ti_wup_opm_2 /end AXIS_DESCR
/end CHARACTERISTIC
/begin CHARACTERISTIC ip_ti_wup_opm_2 "TI warm up correction at operation mode 2" MAP 0xa10280e4 _REC_MAP_20_u1_u1_u1 0.1494140625 _CNV_A_R_LINEAR_____71_CM 0. 0.99609375 DISPLAY_IDENTIFIER IP_TI_WUP_OPM_2 FORMAT "%5.3"
 /begin AXIS_DESCR COM_AXIS maf _CNV_A_R_LINEAR_____14_CM 8 0. 1389. FORMAT "%4.0" AXIS_PTS_REF ldpm_maf_hb__ti_wup /end AXIS_DESCR
 /begin AXIS_DESCR COM_AXIS n_32 _CNV_A_R_LINEAR_____9_CM 8 0. 8160. FORMAT "%4.0" AXIS_PTS_REF ldpm_n_32__ti_wup /end AXIS_DESCR
/end CHARACTERISTIC
/begin CHARACTERISTIC id_ti_wup_1_opm_av "Operation mode matix(actual)" CURVE 0xa1022fac _REC_CUR_20_u1_u1 7. _CNV_A_R_LINEAR_____0_CM 1. 8. DISPLAY_IDENTIFIER ID_TI_WUP_1_OPM_AV FORMAT "%1.0"
 /begin AXIS_DESCR COM_AXIS opm_av _CNV_A_R_LINEAR_____0_CM 8 0. 8. FORMAT "%1.0" AXIS_PTS_REF ldpm_opm_av /end AXIS_DESCR
/end CHARACTERISTIC
/begin CHARACTERISTIC id_ti_wup_1_opm_req "Operation mode matix(requested)" CURVE 0xa1022fb4 _REC_CUR_20_u1_u1 7. _CNV_A_R_LINEAR_____0_CM 1. 8. DISPLAY_IDENTIFIER ID_TI_WUP_1_OPM_REQ FORMAT "%1.0"
 /begin AXIS_DESCR COM_AXIS opm_req _CNV_A_R_LINEAR_____0_CM 8 0. 8. FORMAT "%1.0" AXIS_PTS_REF ldpm_opm_req /end AXIS_DESCR
/end CHARACTERISTIC
/begin MEASUREMENT ti_wup_1_opm_1 "Warm-up enrichment part at operation mode 1" UWORD _CNV_A_R_LINEAR_____256_CM 1 100. 0. 4. DISPLAY_IDENTIFIER TI_WUP_1_OPM_1 ECU_ADDRESS 0xc0000c62 FORMAT "%6.4" /end MEASUREMENT
/begin MEASUREMENT lv_ti_wup_1_opm_sel_2 "operation mode 2 is active" UBYTE _CNV_S_2_RANGE__0___1_CM 1 100. 0. 1. DISPLAY_IDENTIFIER LV_TI_WUP_1_OPM_SEL_2 ECU_ADDRESS 0xc0000c6f BIT_MASK 0x1 /end MEASUREMENT
/begin MEASUREMENT lv_ti_wup_1_opm_rls "operation mode within valid range" UBYTE _CNV_S_2_RANGE__0___1_CM 1 100. 0. 1. DISPLAY_IDENTIFIER LV_TI_WUP_1_OPM_RLS ECU_ADDRESS 0xc0000c70 BIT_MASK 0x1 /end MEASUREMENT
/begin MEASUREMENT ti_wup_1_opm_2 "Warm-up enrichment part at operation mode 2" UWORD _CNV_A_R_LINEAR_____256_CM 1 100. 0. 4. DISPLAY_IDENTIFIER TI_WUP_1_OPM_2 ECU_ADDRESS 0xc0000c64 FORMAT "%6.4" /end MEASUREMENT
/begin MEASUREMENT ti_wup_1_add "Warm-up enrichment, additive part of intermediate value" UWORD _CNV_A_R_LINEAR_____256_CM 1 100. 0. 4. DISPLAY_IDENTIFIER TI_WUP_1_ADD ECU_ADDRESS 0xd000516e FORMAT "%6.4" /end MEASUREMENT
/begin MEASUREMENT ti_wup_1_add_opm_1 "Warm-up enrichment, additive part of intermediate value at operation mode 1" UWORD _CNV_A_R_LINEAR_____256_CM 1 100. 0. 4. DISPLAY_IDENTIFIER TI_WUP_1_ADD_OPM_1 ECU_ADDRESS 0xc0000c66 FORMAT "%6.4" /end MEASUREMENT
/begin MEASUREMENT ti_wup_1_add_opm_2 "Warm-up enrichment, additive part of intermediate value at operation mode 2" UWORD _CNV_A_R_LINEAR_____256_CM 1 100. 0. 4. DISPLAY_IDENTIFIER TI_WUP_1_ADD_OPM_2 ECU_ADDRESS 0xc0000c68 FORMAT "%6.4" /end MEASUREMENT
/begin MEASUREMENT lv_ti_wup_1_opm_sel_1 "operation mode 1 is active" UBYTE _CNV_S_2_RANGE__0___1_CM 1 100. 0. 1. DISPLAY_IDENTIFIER LV_TI_WUP_1_OPM_SEL_1 ECU_ADDRESS 0xc0000c6e BIT_MASK 0x1 /end MEASUREMENT
/begin MEASUREMENT lv_ti_wup_1_add_opm_sel_1 "operation mode 1 is active" UBYTE _CNV_S_2_RANGE__0___1_CM 1 100. 0. 1. DISPLAY_IDENTIFIER LV_TI_WUP_1_ADD_OPM_SEL_1 ECU_ADDRESS 0xc0000c71 BIT_MASK 0x1 /end MEASUREMENT
/begin MEASUREMENT lv_ti_wup_1_add_opm_sel_2 "operation mode 2 is active" UBYTE _CNV_S_2_RANGE__0___1_CM 1 100. 0. 1. DISPLAY_IDENTIFIER LV_TI_WUP_1_ADD_OPM_SEL_2 ECU_ADDRESS 0xc0000c72 BIT_MASK 0x1 /end MEASUREMENT
/begin MEASUREMENT lv_ti_wup_1_add_opm_rls "operation mode within valid range" UBYTE _CNV_S_2_RANGE__0___1_CM 1 100. 0. 1. DISPLAY_IDENTIFIER LV_TI_WUP_1_ADD_OPM_RLS ECU_ADDRESS 0xc0000c73 BIT_MASK 0x1 /end MEASUREMENT
/begin AXIS_PTS ldpm_tco_ti_wup_opm_1 "" 0xa10222c8 tco _REC_AXS_20_u1 190.5 _CNV_A_R_LINEAR_____16_CM 8 -48. 142.5 FORMAT "%5.1" /end AXIS_PTS
/begin AXIS_PTS ldpm_tco_ti_wup_opm_2 "" 0xa10222d4 tco _REC_AXS_20_u1 190.5 _CNV_A_R_LINEAR_____16_CM 8 -48. 142.5 FORMAT "%5.1" /end AXIS_PTS
/begin AXIS_PTS ldp_tco_st_ti_tco_wup_opm_1 "" 0xa10212d0 tco_st _REC_AXS_20_u1 190.5 _CNV_A_R_LINEAR_____16_CM 3 -48. 142.5 FORMAT "%5.1" /end AXIS_PTS
/begin AXIS_PTS ldp_tco_st_ti_tco_wup_opm_2 "" 0xa10212d4 tco_st _REC_AXS_20_u1 190.5 _CNV_A_R_LINEAR_____16_CM 3 -48. 142.5 FORMAT "%5.1" /end AXIS_PTS
/begin CHARACTERISTIC c_tco_min_obd2_lsh_down "TCO-threshold for OBD2 heater diagnosis downstream" VALUE 0xa100221b _REC_VAL_20_u1 190.5 _CNV_A_R_LINEAR_____16_CM -48. 142.5 DISPLAY_IDENTIFIER C_TCO_MIN_OBD2_LSH_DOWN FORMAT "%5.1" /end CHARACTERISTIC
/begin MEASUREMENT lv_ad_clr_ron "toggle bit for reseting of RON adaption value" UBYTE _CNV_S_2_RANGE__0___1_CM 1 100. 0. 1. DISPLAY_IDENTIFIER LV_AD_CLR_RON ECU_ADDRESS 0xc0002468 BIT_MASK 0x1 /end MEASUREMENT
/begin CHARACTERISTIC c_knks_rel_ini "ini value of relative knock signal" VALUE 0xa10294c0 _REC_VAL_20_u2 0.999755 _CNV_A_R_LINEAR_____178_CM 0. 0.999755 DISPLAY_IDENTIFIER C_KNKS_REL_INI FORMAT "%7.5" /end CHARACTERISTIC
/begin MEASUREMENT knks_rel_nl[0] "Relative knock value" UWORD _CNV_A_R_LINEAR_____181_CM 1 100. 0. 0.9999847 DISPLAY_IDENTIFIER KNKS_REL_NL_0 ECU_ADDRESS 0xd0005494 FORMAT "%7.5" /end MEASUREMENT
/begin MEASUREMENT knks_rel_nl[1] "Relative knock value" UWORD _CNV_A_R_LINEAR_____181_CM 1 100. 0. 0.9999847 DISPLAY_IDENTIFIER KNKS_REL_NL_1 ECU_ADDRESS 0xd0005496 FORMAT "%7.5" /end MEASUREMENT
/begin MEASUREMENT knks_rel_nl[2] "Relative knock value" UWORD _CNV_A_R_LINEAR_____181_CM 1 100. 0. 0.9999847 DISPLAY_IDENTIFIER KNKS_REL_NL_2 ECU_ADDRESS 0xd0005498 FORMAT "%7.5" /end MEASUREMENT
/begin MEASUREMENT knks_rel_nl[3] "Relative knock value" UWORD _CNV_A_R_LINEAR_____181_CM 1 100. 0. 0.9999847 DISPLAY_IDENTIFIER KNKS_REL_NL_3 ECU_ADDRESS 0xd000549a FORMAT "%7.5" /end MEASUREMENT
/begin MEASUREMENT knks_rel_nl[4] "Relative knock value" UWORD _CNV_A_R_LINEAR_____181_CM 1 100. 0. 0.9999847 DISPLAY_IDENTIFIER KNKS_REL_NL_4 ECU_ADDRESS 0xd000549c FORMAT "%7.5" /end MEASUREMENT
/begin MEASUREMENT knks_rel_nl[5] "Relative knock value" UWORD _CNV_A_R_LINEAR_____181_CM 1 100. 0. 0.9999847 DISPLAY_IDENTIFIER KNKS_REL_NL_5 ECU_ADDRESS 0xd000549e FORMAT "%7.5" /end MEASUREMENT
/begin MEASUREMENT nr_cyl_scc_teg[0] "Number of shut off cyl for TEG calculation" UBYTE _CNV_A_R_LINEAR_____465_CM 1 100. 0. 13. DISPLAY_IDENTIFIER NR_CYL_SCC_TEG[0] ECU_ADDRESS 0xd0003b78 FORMAT "%4.1" /end MEASUREMENT
/begin MEASUREMENT nr_cyl_scc_teg[1] "Number of shut off cyl for TEG calculation" UBYTE _CNV_A_R_LINEAR_____465_CM 1 100. 0. 13. DISPLAY_IDENTIFIER NR_CYL_SCC_TEG[1] ECU_ADDRESS 0xd0003b79 FORMAT "%4.1" /end MEASUREMENT
/begin MEASUREMENT lv_teg_min_thd[0] "dew point has been reached bank selective" UBYTE _CNV_A_R_LINEAR_____0_CM 1 100. 0. 1. DISPLAY_IDENTIFIER LV_TEG_MIN_THD[0] ECU_ADDRESS 0xd0003b7a FORMAT "%1.0" BIT_MASK 0x1 /end MEASUREMENT
/begin MEASUREMENT lv_teg_min_thd[1] "dew point has been reached bank selective" UBYTE _CNV_A_R_LINEAR_____0_CM 1 100. 0. 1. DISPLAY_IDENTIFIER LV_TEG_MIN_THD[1] ECU_ADDRESS 0xd0003b7b FORMAT "%1.0" BIT_MASK 0x1 /end MEASUREMENT
/begin MEASUREMENT lv_teg_cat_down_min_thd[0] "dew point has been reached bank selective" UBYTE _CNV_A_R_LINEAR_____0_CM 1 100. 0. 1. DISPLAY_IDENTIFIER LV_TEG_CAT_DOWN_MIN_THD[0] ECU_ADDRESS 0xd0003b7c FORMAT "%1.0" BIT_MASK 0x1 /end MEASUREMENT
/begin MEASUREMENT lv_teg_cat_down_min_thd[1] "dew point has been reached bank selective" UBYTE _CNV_A_R_LINEAR_____0_CM 1 100. 0. 1. DISPLAY_IDENTIFIER LV_TEG_CAT_DOWN_MIN_THD[1] ECU_ADDRESS 0xd0003b7d FORMAT "%1.0" BIT_MASK 0x1 /end MEASUREMENT
/begin MEASUREMENT lv_puc_inh_temp_cat "Flag to inhibit PUC operation due to too high TEMP_CAT" UBYTE _CNV_A_R_LINEAR_____0_CM 1 100. 0. 1. DISPLAY_IDENTIFIER LV_PUC_INH_TEMP_CAT ECU_ADDRESS 0xd0002ec8 FORMAT "%1.0" BIT_MASK 0x1 /end MEASUREMENT
/begin MEASUREMENT lamb_sp "lambda setpoint" UWORD _CNV_A_R_LINEAR_____122_CM 1 100. 0. 31.9990234375 DISPLAY_IDENTIFIER LAMB_SP ECU_ADDRESS 0xd0004be0 FORMAT "%7.4" /end MEASUREMENT
/begin MEASUREMENT lamb_hom_afl "lambda setpoint for homogeneous lean combustion" UWORD _CNV_A_R_LINEAR_____122_CM 1 100. 0. 31.9990234375 DISPLAY_IDENTIFIER LAMB_HOM_AFL ECU_ADDRESS 0xd0004be4 FORMAT "%7.4" /end MEASUREMENT
/begin MEASUREMENT lamb_bas_1 "basic lambda setpoint" UWORD _CNV_A_R_LINEAR_____122_CM 1 100. 0. 31.9990234375 DISPLAY_IDENTIFIER LAMB_BAS_1 ECU_ADDRESS 0xd0004be2 FORMAT "%7.4" /end MEASUREMENT
/begin MEASUREMENT lamb_bas_2 "basic lambda setpoint" UWORD _CNV_A_R_LINEAR_____122_CM 1 100. 0. 31.9990234375 DISPLAY_IDENTIFIER LAMB_BAS_2 ECU_ADDRESS 0xd0004bee FORMAT "%7.4" /end MEASUREMENT
/begin MEASUREMENT lamb_bas_h_res_1 "bank selective basic lambda setpoint with high resolution" ULONG _CNV_A_R_LINEAR_____466_CM 1 100. 0. 32. DISPLAY_IDENTIFIER LAMB_BAS_H_RES_1 ECU_ADDRESS 0xd0005520 FORMAT "%8.5" /end MEASUREMENT
/begin MEASUREMENT lamb_bas_h_res_2 "bank selective basic lambda setpoint with high resolution" ULONG _CNV_A_R_LINEAR_____466_CM 1 100. 0. 32. DISPLAY_IDENTIFIER LAMB_BAS_H_RES_2 ECU_ADDRESS 0xd0005524 FORMAT "%8.5" /end MEASUREMENT
/begin AXIS_PTS ldpm_opm_req "" 0xa1022198 opm_req _REC_AXS_20_u1 8. _CNV_A_R_LINEAR_____0_CM 8 0. 8. FORMAT "%1.0" /end AXIS_PTS
/begin AXIS_PTS ldpm_opm_av "" 0xa102218c opm_av _REC_AXS_20_u1 8. _CNV_A_R_LINEAR_____0_CM 8 0. 8. FORMAT "%1.0" /end AXIS_PTS
/begin MEASUREMENT lv_sel_cyl "boolean for cylinder specific transition PU-PUC, PUC-IS or PUC-PL ongoing" UBYTE _CNV_S_2_RANGE__0___1_CM 1 100. 0. 1. DISPLAY_IDENTIFIER LV_SEL_CYL ECU_ADDRESS 0xd0003d6d BIT_MASK 0x1 /end MEASUREMENT
/begin MEASUREMENT nr_pat_sel_cyl "selected index of fuel cut-off pattern for transition PU-PUC, PUC-IS, PUC-PL" UBYTE _CNV_A_R_LINEAR_____0_CM 1 100. 0. 255. DISPLAY_IDENTIFIER NR_PAT_SEL_CYL ECU_ADDRESS 0xd0003d6c FORMAT "%3.0" /end MEASUREMENT
/begin MEASUREMENT t_fcut_aj "timer value during jerk minimal sequential fuel cut-off" UBYTE _CNV_A_R_LINEAR_____3_CM 1 100. 0. 2.55 DISPLAY_IDENTIFIER T_FCUT_AJ ECU_ADDRESS 0xc000077c FORMAT "%4.2" /end MEASUREMENT
/begin MEASUREMENT t_osc_dt "period of time of the oscillation of the drive train" UBYTE _CNV_A_R_LINEAR_____3_CM 1 100. 0. 2.55 DISPLAY_IDENTIFIER T_OSC_DT ECU_ADDRESS 0xc000077d FORMAT "%4.2" /end MEASUREMENT
/begin MEASUREMENT nr_sel_cyl "index number of the selected cylinder pattern" UBYTE _CNV_A_R_LINEAR_____0_CM 1 100. 0. 255. DISPLAY_IDENTIFIER NR_SEL_CYL ECU_ADDRESS 0xc000077e FORMAT "%3.0" /end MEASUREMENT
/begin MEASUREMENT case_sel_cyl "case selector" UBYTE _CNV_A_R_LINEAR_____0_CM 1 100. 0. 3. DISPLAY_IDENTIFIER CASE_SEL_CYL ECU_ADDRESS 0xc000077f FORMAT "%1.0" /end MEASUREMENT
/begin AXIS_PTS ldp_case_sel_cyl__pat_sel_cyl "" 0xa1020880 case_sel_cyl _REC_AXS_20_u1 2. _CNV_A_R_LINEAR_____0_CM 3 1. 3. FORMAT "%3.0" /end AXIS_PTS
/begin AXIS_PTS ldp_nr_sel_cyl__pat_sel_cyl "" 0xa102107c nr_sel_cyl _REC_AXS_20_u1 7. _CNV_A_R_LINEAR_____0_CM 8 1. 8. FORMAT "%3.0" /end AXIS_PTS
/begin AXIS_PTS ldp_gr_mt__t_osc_dt "" 0xa1020b0c gr_mt _REC_AXS_20_u1 255. _CNV_A_R_LINEAR_____0_CM 8 0. 255. FORMAT "%3.0" /end AXIS_PTS
/begin CHARACTERISTIC id_pat_sel_cyl "table for cylinder specific restart and trailing throttle fuel cut-off" MAP 0xa1022ea0 _REC_MAP_20_u1_u1_u1 255. _CNV_A_R_LINEAR_____0_CM 0. 255. DISPLAY_IDENTIFIER ID_PAT_SEL_CYL FORMAT "%3.0"
 /begin AXIS_DESCR COM_AXIS case_sel_cyl _CNV_A_R_LINEAR_____0_CM 3 1. 3. FORMAT "%3.0" AXIS_PTS_REF ldp_case_sel_cyl__pat_sel_cyl /end AXIS_DESCR
 /begin AXIS_DESCR COM_AXIS nr_sel_cyl _CNV_A_R_LINEAR_____0_CM 8 1. 8. FORMAT "%3.0" AXIS_PTS_REF ldp_nr_sel_cyl__pat_sel_cyl /end AXIS_DESCR
/end CHARACTERISTIC
/begin CHARACTERISTIC id_t_osc_dt "characteristic period of time of the eigenfrequency of the powertrain" CURVE 0xa1022f94 _REC_CUR_20_u1_u1 2.55 _CNV_A_R_LINEAR_____3_CM 0. 2.55 DISPLAY_IDENTIFIER ID_T_OSC_DT FORMAT "%4.2"
 /begin AXIS_DESCR COM_AXIS gr_mt _CNV_A_R_LINEAR_____0_CM 8 0. 255. FORMAT "%3.0" AXIS_PTS_REF ldp_gr_mt__t_osc_dt /end AXIS_DESCR
/end CHARACTERISTIC
/begin CHARACTERISTIC c_tps_grd_max_sel_rpl "TPS_GRD threshold for cancelling cylinder individual restart PL" VALUE 0xa1029a9a _REC_VAL_20_u1 2987.5 _CNV_A_R_LINEAR_____260_CM 0. 2987.5 DISPLAY_IDENTIFIER C_TPS_GRD_MAX_SEL_RPL FORMAT "%4.0" /end CHARACTERISTIC
/begin CHARACTERISTIC c_n_grd_min_sel_ris "N_GRD threshold for cancelling cylinder individual restart IS" VALUE 0xa10295fe _REC_VAL_20_s1 8160. _CNV_A_R_LINEAR_____29_CM -4096. 4064. DISPLAY_IDENTIFIER C_N_GRD_MIN_SEL_RIS FORMAT "%5.0" /end CHARACTERISTIC
/begin CHARACTERISTIC c_maf_max_sel_rpl "MAF threshold for cancelling cylinder individual restart PL" VALUE 0xa1029556 _REC_VAL_20_u2 1389. _CNV_A_R_LINEAR_____108_CM 0. 1389. DISPLAY_IDENTIFIER C_MAF_MAX_SEL_RPL FORMAT "%7.2" /end CHARACTERISTIC
/begin CHARACTERISTIC c_n_dif_max_sel_ris "N_DIF_COR threshold for cancelling cylinder individual restart idle" VALUE 0xa10295ea _REC_VAL_20_u2 65535. _CNV_A_R_LINEAR_____172_CM -32768. 32767. DISPLAY_IDENTIFIER C_N_DIF_MAX_SEL_RIS FORMAT "%6.0" /end CHARACTERISTIC
/begin CHARACTERISTIC c_nr_sel_cyl_1 "start pattern for transition from PU to PUC (case 1)" VALUE 0xa10296bc _REC_VAL_20_u1 7. _CNV_A_R_LINEAR_____0_CM 1. 8. DISPLAY_IDENTIFIER C_NR_SEL_CYL_1 FORMAT "%3.0" /end CHARACTERISTIC
/begin CHARACTERISTIC c_nr_sel_cyl_2 "start pattern for transition from PUC to IS, PU (case 2)" VALUE 0xa10296bd _REC_VAL_20_u1 7. _CNV_A_R_LINEAR_____0_CM 1. 8. DISPLAY_IDENTIFIER C_NR_SEL_CYL_2 FORMAT "%3.0" /end CHARACTERISTIC
/begin CHARACTERISTIC c_nr_sel_cyl_3 "start pattern for transition from PUC to IS, PL (case 3)" VALUE 0xa10296be _REC_VAL_20_u1 7. _CNV_A_R_LINEAR_____0_CM 1. 8. DISPLAY_IDENTIFIER C_NR_SEL_CYL_3 FORMAT "%3.0" /end CHARACTERISTIC
/begin CHARACTERISTIC lc_ena_fcut_aj "logical variable to enable jerk minimal sequential fuel cut-off" VALUE 0xa1029d29 _REC_VAL_20_u1 1. _CNV_A_R_LINEAR_____0_CM 0. 1. DISPLAY_IDENTIFIER LC_ENA_FCUT_AJ FORMAT "%1.0" /end CHARACTERISTIC
/begin CHARACTERISTIC c_tqi_sp_slow_dif_max "TQI_SP_SLOW_DIF threshold for cancelling cylinder individual cut-off for restart in PL" VALUE 0xa1029b48 _REC_VAL_20_s2 2047.96875 _CNV_A_R_LINEAR_____30_CM -1024. 1023.96875 DISPLAY_IDENTIFIER C_TQI_SP_SLOW_DIF_MAX FORMAT "%8.2" /end CHARACTERISTIC
/begin MEASUREMENT tqi_sp_slow_dif "Difference in requested torque for slow path from actual to last segment" SWORD _CNV_A_R_LINEAR_____30_CM 1 100. -1024. 1023.96875 DISPLAY_IDENTIFIER TQI_SP_SLOW_DIF ECU_ADDRESS 0xc0000778 FORMAT "%6.2" /end MEASUREMENT
/begin CHARACTERISTIC c_mff_fac "Constannt for stoichiometric air/fuel ratio (=1/14.7)" VALUE 0xa1029576 _REC_VAL_20_u2 0.125 _CNV_A_R_LINEAR_____471_CM 0. 0.125 DISPLAY_IDENTIFIER C_MFF_FAC FORMAT "%7.5" /end CHARACTERISTIC
/begin MEASUREMENT lv_inh_lscl_cus[0] "inhibit signal for the controller deactivation" UBYTE _CNV_S_2_RANGE__0___1_CM 1 100. 0. 1. DISPLAY_IDENTIFIER LV_INH_LSCL_CUS[0] ECU_ADDRESS 0xd0003814 BIT_MASK 0x1 /end MEASUREMENT
/begin MEASUREMENT lv_inh_lscl_cus[1] "inhibit signal for the controller deactivation" UBYTE _CNV_S_2_RANGE__0___1_CM 1 100. 0. 1. DISPLAY_IDENTIFIER LV_INH_LSCL_CUS[1] ECU_ADDRESS 0xd0003815 BIT_MASK 0x1 /end MEASUREMENT
/begin MEASUREMENT lamb_sp_ofs_ext[0] "lambda setpoint offset defined by customer" SWORD _CNV_A_R_LINEAR_____23_CM 1 100. -2. 1.99993896484375 DISPLAY_IDENTIFIER LAMB_SP_OFS_EXT[0] ECU_ADDRESS 0xd0004bf8 FORMAT "%8.5" /end MEASUREMENT
/begin MEASUREMENT lamb_sp_ofs_ext[1] "lambda setpoint offset defined by customer" SWORD _CNV_A_R_LINEAR_____23_CM 1 100. -2. 1.99993896484375 DISPLAY_IDENTIFIER LAMB_SP_OFS_EXT[1] ECU_ADDRESS 0xd0004bfa FORMAT "%8.5" /end MEASUREMENT
/begin MEASUREMENT iga_bas_egr_cor_hom "Additive basic ignition angle correction due to EGR influence to homogenous mode" SBYTE _CNV_A_R_LINEAR_____168_CM 1 100. -48. 47.625 DISPLAY_IDENTIFIER IGA_BAS_EGR_COR_HOM ECU_ADDRESS 0xc000072a FORMAT "%5.1" /end MEASUREMENT
/begin MEASUREMENT iga_bas_egr_cor_s "Additive basic ignition angle correction due to EGR influence to stratified mode" SBYTE _CNV_A_R_LINEAR_____168_CM 1 100. -48. 47.625 DISPLAY_IDENTIFIER IGA_BAS_EGR_COR_S ECU_ADDRESS 0xc000072b FORMAT "%5.1" /end MEASUREMENT
/begin CHARACTERISTIC ip_fac_rate_egr_afl "Temperature corrective factor (air/fuel lean)" CURVE 0xa1023efc _REC_CUR_20_u1_u1 1.99220002 _CNV_A_R_LINEAR_____97_CM 0. 1.99220002 DISPLAY_IDENTIFIER IP_FAC_RATE_EGR_AFL FORMAT "%5.3"
 /begin AXIS_DESCR COM_AXIS tco _CNV_A_R_LINEAR_____16_CM 8 -48. 142.5 FORMAT "%5.1" AXIS_PTS_REF ldpm_tco__iga_egr /end AXIS_DESCR
/end CHARACTERISTIC
/begin CHARACTERISTIC ip_fac_rate_egr_s "temperature corrective factor (stratified mode)" CURVE 0xa1023f04 _REC_CUR_20_u1_u1 1.99220002 _CNV_A_R_LINEAR_____97_CM 0. 1.99220002 DISPLAY_IDENTIFIER IP_FAC_RATE_EGR_S FORMAT "%5.3"
 /begin AXIS_DESCR COM_AXIS tco _CNV_A_R_LINEAR_____16_CM 8 -48. 142.5 FORMAT "%5.1" AXIS_PTS_REF ldpm_tco__iga_egr /end AXIS_DESCR
/end CHARACTERISTIC
/begin CHARACTERISTIC ip_iga_egr_s "Spark advance added to basic value with EGR function (stratified mode)" MAP 0xa1025474 _REC_MAP_20_u1_u1_u2 95.625 _CNV_A_R_LINEAR_____171_CM -48. 47.625 DISPLAY_IDENTIFIER IP_IGA_EGR_S FORMAT "%5.1"
 /begin AXIS_DESCR COM_AXIS n_32 _CNV_A_R_LINEAR_____9_CM 5 0. 8160. FORMAT "%4.0" AXIS_PTS_REF ldp_n_32__iga_egr_s /end AXIS_DESCR
 /begin AXIS_DESCR COM_AXIS mff_sp_s _CNV_A_R_LINEAR_____108_CM 5 0. 1389. FORMAT "%7.2" AXIS_PTS_REF ldp_mff_sp_s__egr_iga /end AXIS_DESCR
/end CHARACTERISTIC
/begin MEASUREMENT iga_bas_egr_cor "Additive basic ignition angle correction due to EGR influence" SBYTE _CNV_A_R_LINEAR_____168_CM 1 100. -48. 47.625 DISPLAY_IDENTIFIER IGA_BAS_EGR_COR ECU_ADDRESS 0xd0003ce8 FORMAT "%5.1" /end MEASUREMENT
/begin MEASUREMENT egr_ratio_cor_2 "Corrected EGR_RATIO for LDP of LPD_IGA_BAS_EGR" UWORD _CNV_A_R_LINEAR_____7_CM 1 100. 0. 99.99847412109381 DISPLAY_IDENTIFIER EGR_RATIO_COR_2 ECU_ADDRESS 0xc0000724 /end MEASUREMENT
/begin CHARACTERISTIC ip_fac_iga_bas_egr_lamb "Factor for EGR_RATIO list of datapoints" MAP 0xa1023978 _REC_MAP_20_u1_u1_u2 0.99609375 _CNV_A_R_LINEAR_____27_CM 0. 0.99609375 DISPLAY_IDENTIFIER IP_FAC_IGA_BAS_EGR_LAMB FORMAT "%5.3"
 /begin AXIS_DESCR COM_AXIS n_32 _CNV_A_R_LINEAR_____9_CM 12 0. 8160. FORMAT "%4.0" AXIS_PTS_REF ldpm_n_32_ip_egr_ratio /end AXIS_DESCR
 /begin AXIS_DESCR COM_AXIS maf _CNV_A_R_LINEAR_____108_CM 12 0. 1389. FORMAT "%7.2" AXIS_PTS_REF ldpm_maf_ip_egr_ratio /end AXIS_DESCR
/end CHARACTERISTIC
/begin CHARACTERISTIC ip_iga_bas_egr "Basis for EGR correction IGA_BAS" CURVE 0xa1024e74 _REC_CUR_20_u1_u2 95.625 _CNV_A_R_LINEAR_____171_CM -48. 47.625 DISPLAY_IDENTIFIER IP_IGA_BAS_EGR FORMAT "%5.1"
 /begin AXIS_DESCR COM_AXIS egr_ratio_cor_2 _CNV_A_R_LINEAR_____489_CM 6 0. 99.99847412109381 AXIS_PTS_REF ldp_egr_ratio_cor_2__iga_bas /end AXIS_DESCR
/end CHARACTERISTIC
/begin CHARACTERISTIC ip_iga_bas_egr_fac__n__maf "" MAP 0xa1024e7c _REC_MAP_20_u1_u1_u2 1.99220002 _CNV_A_R_LINEAR_____97_CM 0. 1.99220002 DISPLAY_IDENTIFIER IP_IGA_BAS_EGR_FAC__N__MAF FORMAT "%5.3"
 /begin AXIS_DESCR COM_AXIS n_32 _CNV_A_R_LINEAR_____9_CM 12 0. 8160. FORMAT "%4.0" AXIS_PTS_REF ldpm_n_32_ip_egr_ratio /end AXIS_DESCR
 /begin AXIS_DESCR COM_AXIS maf _CNV_A_R_LINEAR_____108_CM 12 0. 1389. FORMAT "%7.2" AXIS_PTS_REF ldpm_maf_ip_egr_ratio /end AXIS_DESCR
/end CHARACTERISTIC
/begin AXIS_PTS ldp_n_32__iga_egr_s "" 0xa1020d7c n_32 _REC_AXS_20_u1 8160. _CNV_A_R_LINEAR_____9_CM 5 0. 8160. FORMAT "%4.0" /end AXIS_PTS
/begin AXIS_PTS ldp_mff_sp_s__egr_iga "" 0xa1020d60 mff_sp_s _REC_AXS_20_u2 1389. _CNV_A_R_LINEAR_____108_CM 5 0. 1389. FORMAT "%7.2" /end AXIS_PTS
/begin AXIS_PTS ldp_egr_ratio_cor_2__iga_bas "" 0xa102091c egr_ratio_cor_2 _REC_AXS_20_u2 99.99847412109381 _CNV_A_R_LINEAR_____489_CM 6 0. 99.99847412109381 /end AXIS_PTS
/begin AXIS_PTS ldpm_tco__iga_egr "" 0xa102224c tco _REC_AXS_20_u1 190.5 _CNV_A_R_LINEAR_____16_CM 8 -48. 142.5 FORMAT "%5.1" /end AXIS_PTS
/begin AXIS_PTS ldpm_n_32_ip_egr_ratio "" 0xa1021e64 n_32 _REC_AXS_20_u1 8160. _CNV_A_R_LINEAR_____9_CM 12 0. 8160. FORMAT "%4.0" /end AXIS_PTS
/begin AXIS_PTS ldpm_maf_ip_egr_ratio "" 0xa1021c60 maf _REC_AXS_20_u2 1389. _CNV_A_R_LINEAR_____108_CM 12 0. 1389. FORMAT "%7.2" /end AXIS_PTS
/begin CHARACTERISTIC c_tnt_mdl_thd_rgn_not "NOx catalyst monolith temperature max. threshold for inhibit a regeneration" VALUE 0xa1029a7e _REC_VAL_20_u1 1020. _CNV_A_R_LINEAR_____490_CM 0. 1020. DISPLAY_IDENTIFIER C_TNT_MDL_THD_RGN_NOT FORMAT "%4.0" /end CHARACTERISTIC
/begin CHARACTERISTIC c_tnt_mdl_thd_rgn_not_hys "NOx catalyst monolith temperature hysteresis for inhibit a regeneration" VALUE 0xa1029a7f _REC_VAL_20_u1 1020. _CNV_A_R_LINEAR_____490_CM 0. 1020. DISPLAY_IDENTIFIER C_TNT_MDL_THD_RGN_NOT_HYS FORMAT "%4.0" /end CHARACTERISTIC
/begin CHARACTERISTIC lc_inh_nt_act_off "Codeword for the manual setting of the inhibiting bit" VALUE 0xa1029d58 _REC_VAL_20_u1 1. _CNV_A_R_LINEAR_____0_CM 0. 1. DISPLAY_IDENTIFIER LC_INH_NT_ACT_OFF FORMAT "%2.0" /end CHARACTERISTIC
/begin CHARACTERISTIC lc_inh_rgn_req_ntld "Codeword for general inhibition of regeneration request due to loading degree" VALUE 0xa1029d69 _REC_VAL_20_u1 1. _CNV_A_R_LINEAR_____0_CM 0. 1. DISPLAY_IDENTIFIER LC_INH_RGN_REQ_NTLD FORMAT "%2.0" /end CHARACTERISTIC
/begin CHARACTERISTIC lc_inh_nt_afl_off "Manual setting of inhibiting Lambda = 1 request" VALUE 0xa1029d5a _REC_VAL_20_u1 1. _CNV_A_R_LINEAR_____0_CM 0. 1. DISPLAY_IDENTIFIER LC_INH_NT_AFL_OFF FORMAT "%2.0" /end CHARACTERISTIC
/begin CHARACTERISTIC lc_inh_nt_prj_act "calibration constant inhibiting the NOx catalyst auxiliary functionalities (complete)" VALUE 0xa1029d5e _REC_VAL_20_u1 1. _CNV_A_R_LINEAR_____0_CM 0. 1. DISPLAY_IDENTIFIER LC_INH_NT_PRJ_ACT FORMAT "%2.0" /end CHARACTERISTIC
/begin CHARACTERISTIC c_tnt_mdl_nt_stc_max_min "Temperature threshold for enabling / disabling an full saturation" VALUE 0xa1029a75 _REC_VAL_20_u1 1020. _CNV_A_R_LINEAR_____490_CM 0. 1020. DISPLAY_IDENTIFIER C_TNT_MDL_NT_STC_MAX_MIN FORMAT "%4.0" /end CHARACTERISTIC
/begin CHARACTERISTIC c_tnt_mdl_nt_stc_max_max "Temperature threshold for enabling / disabling full saturation" VALUE 0xa1029a74 _REC_VAL_20_u1 1020. _CNV_A_R_LINEAR_____490_CM 0. 1020. DISPLAY_IDENTIFIER C_TNT_MDL_NT_STC_MAX_MAX FORMAT "%4.0" /end CHARACTERISTIC
/begin CHARACTERISTIC c_tnt_mdl_nt_stc_max_delta "max. deviation between higher and lower NT temp. for enabling a full saturation" VALUE 0xa1029a73 _REC_VAL_20_u1 1020. _CNV_A_R_LINEAR_____490_CM 0. 1020. DISPLAY_IDENTIFIER C_TNT_MDL_NT_STC_MAX_DELTA FORMAT "%4.0" /end CHARACTERISTIC
/begin CHARACTERISTIC c_tnt_mdl_o2_stc_min "minimum speed for OSC-adaptation" VALUE 0xa1029a78 _REC_VAL_20_u1 1020. _CNV_A_R_LINEAR_____490_CM 0. 1020. DISPLAY_IDENTIFIER C_TNT_MDL_O2_STC_MIN FORMAT "%4.0" /end CHARACTERISTIC
/begin CHARACTERISTIC c_tnt_mdl_o2_stc_max "Temperature threshold for enabling / disabling an O2-STC adaptation" VALUE 0xa1029a77 _REC_VAL_20_u1 1020. _CNV_A_R_LINEAR_____490_CM 0. 1020. DISPLAY_IDENTIFIER C_TNT_MDL_O2_STC_MAX FORMAT "%4.0" /end CHARACTERISTIC
/begin CHARACTERISTIC c_tnt_mdl_o2_stc_delta "max. deviation between higher and lower NT temp. for enabling an O2-STC adaptation" VALUE 0xa1029a76 _REC_VAL_20_u1 1020. _CNV_A_R_LINEAR_____490_CM 0. 1020. DISPLAY_IDENTIFIER C_TNT_MDL_O2_STC_DELTA FORMAT "%4.0" /end CHARACTERISTIC
/begin CHARACTERISTIC lc_inh_nt_stc_max "calibration constant  inhibiting the full saturation" VALUE 0xa1029d5f _REC_VAL_20_u1 1. _CNV_A_R_LINEAR_____0_CM 0. 1. DISPLAY_IDENTIFIER LC_INH_NT_STC_MAX FORMAT "%2.0" /end CHARACTERISTIC
/begin CHARACTERISTIC c_vs_o2_stc_min "minimum speed for OSC-adaptation" VALUE 0xa1029ccb _REC_VAL_20_u1 255. _CNV_A_R_LINEAR_____6_CM 0. 255. DISPLAY_IDENTIFIER C_VS_O2_STC_MIN FORMAT "%3.0" /end CHARACTERISTIC
/begin CHARACTERISTIC lc_inh_nt_o2_stc "calibration constant  inhibiting oxygen storage capacity adaptation" VALUE 0xa1029d5d _REC_VAL_20_u1 1. _CNV_A_R_LINEAR_____0_CM 0. 1. DISPLAY_IDENTIFIER LC_INH_NT_O2_STC FORMAT "%2.0" /end CHARACTERISTIC
/begin CHARACTERISTIC lc_inh_nt_afl "Codeword for forcing to Lambda=1 operation" VALUE 0xa1029d59 _REC_VAL_20_u1 1. _CNV_A_R_LINEAR_____0_CM 0. 1. DISPLAY_IDENTIFIER LC_INH_NT_AFL FORMAT "%2.0" /end CHARACTERISTIC
/begin CHARACTERISTIC lc_inh_req_nox_sens_off "Manual setting of inhibiting exlusively regeneration out of NOx-Sensor" VALUE 0xa1029d66 _REC_VAL_20_u1 1. _CNV_A_R_LINEAR_____0_CM 0. 1. DISPLAY_IDENTIFIER LC_INH_REQ_NOX_SENS_OFF FORMAT "%2.0" /end CHARACTERISTIC
/begin MEASUREMENT lv_inh_nox_sens_rgn "Inhibition flag for NOx catalyst regeneration-stop request by NOx sensor readiness" UBYTE _CNV_S_2_RANGE__0___1_CM 1 100. 0. 1. DISPLAY_IDENTIFIER LV_INH_NOX_SENS_RGN ECU_ADDRESS 0xd0003ae6 BIT_MASK 0x1 /end MEASUREMENT
/begin CHARACTERISTIC c_t_nox_sens_vld_state_rgn_req "Minimum time with NOx sensor not valid to switch to model" VALUE 0xa102992a _REC_VAL_20_u2 327.67 _CNV_A_R_LINEAR_____3_CM 0. 327.67 DISPLAY_IDENTIFIER C_T_NOX_SENS_VLD_STATE_RGN_REQ FORMAT "%6.2" /end CHARACTERISTIC
/begin CHARACTERISTIC c_ntld_state_rgn_req "Minimum NOx catalyst loading degree to switch model (< NTLD_MAX)" VALUE 0xa1029712 _REC_VAL_20_u2 1. _CNV_A_R_LINEAR_____232_CM 0. 1. DISPLAY_IDENTIFIER C_NTLD_STATE_RGN_REQ FORMAT "%6.4" /end CHARACTERISTIC
/begin CHARACTERISTIC lc_tnt_mdl_max_ofs "" VALUE 0xa1029df3 _REC_VAL_20_u1 1. _CNV_A_R_LINEAR_____0_CM 0. 1. DISPLAY_IDENTIFIER LC_TNT_MDL_MAX_OFS FORMAT "%2.0" /end CHARACTERISTIC
/begin CHARACTERISTIC c_vs_tnt_mdl_min "Vehicle speed threshold to enable CAT cooling at standing car" VALUE 0xa1029cdb _REC_VAL_20_u1 255. _CNV_A_R_LINEAR_____6_CM 0. 255. DISPLAY_IDENTIFIER C_VS_TNT_MDL_MIN FORMAT "%3.0" /end CHARACTERISTIC
/begin CHARACTERISTIC c_t_vs_is_nt "Duration cat cooling at standing car is allowed" VALUE 0xa10299ab _REC_VAL_20_u1 25.5 _CNV_A_R_LINEAR_____4_CM 0. 25.5 DISPLAY_IDENTIFIER C_T_VS_IS_NT FORMAT "%3.1" /end CHARACTERISTIC
/begin CHARACTERISTIC c_tnt_mdl_max_ofs "Nox catalyst temperature offset to enable cat cooling at standing car" VALUE 0xa1029a64 _REC_VAL_20_s1 1020. _CNV_A_R_LINEAR_____490_CM -512. 508. DISPLAY_IDENTIFIER C_TNT_MDL_MAX_OFS FORMAT "%4.2" /end CHARACTERISTIC
/begin CHARACTERISTIC c_tnt_mdl_h_max_ofs "Min Nox catalyst temperature to enable cat cooling at standing car" VALUE 0xa1029a5b _REC_VAL_20_u1 1020. _CNV_A_R_LINEAR_____490_CM 0. 1020. DISPLAY_IDENTIFIER C_TNT_MDL_H_MAX_OFS FORMAT "%4.0" /end CHARACTERISTIC
/begin CHARACTERISTIC c_nt_sul_min_ofs "MIn NOx catalyst sulphur load to enable cat cooling at standing car" VALUE 0xa10296f0 _REC_VAL_20_u2 10485.6 _CNV_A_R_LINEAR_____495_CM 0. 10485.6 DISPLAY_IDENTIFIER C_NT_SUL_MIN_OFS FORMAT "%8.2" /end CHARACTERISTIC
/begin CHARACTERISTIC lc_inh_ntld_req_nox_sens_auth "Inhibition of NOx regeneration requests due to NTLD after the NOx sensor has reached its readiness" VALUE 0xa1029d60 _REC_VAL_20_u1 1. _CNV_A_R_LINEAR_____0_CM 0. 1. DISPLAY_IDENTIFIER LC_INH_NTLD_REQ_NOX_SENS_AUTH FORMAT "%2.0" /end CHARACTERISTIC
/begin CHARACTERISTIC lc_inh_ntld_req_nox_sens_vld "Inhibition of NOx regeneration requests due to NTLD, if the NOx signal is valid" VALUE 0xa1029d61 _REC_VAL_20_u1 1. _CNV_A_R_LINEAR_____0_CM 0. 1. DISPLAY_IDENTIFIER LC_INH_NTLD_REQ_NOX_SENS_VLD FORMAT "%2.0" /end CHARACTERISTIC
/begin CHARACTERISTIC lc_inh_rgn_is "Inhibition of NOx regeneration requests at idle speed" VALUE 0xa1029d67 _REC_VAL_20_u1 1. _CNV_A_R_LINEAR_____0_CM 0. 1. DISPLAY_IDENTIFIER LC_INH_RGN_IS FORMAT "%2.0" /end CHARACTERISTIC
/begin CHARACTERISTIC lc_inh_ntld_rgn_req_afs_swi "Inhibition of prerequest for a NOx regeneration at switch to stoichiometric operation" VALUE 0xa1029d62 _REC_VAL_20_u1 1. _CNV_A_R_LINEAR_____0_CM 0. 1. DISPLAY_IDENTIFIER LC_INH_NTLD_RGN_REQ_AFS_SWI FORMAT "%2.0" /end CHARACTERISTIC
/begin CHARACTERISTIC c_vs_min_rgn "Minimum vehicle speed for requesting a NOx regeneration" VALUE 0xa1029cc3 _REC_VAL_20_u1 255. _CNV_A_R_LINEAR_____6_CM 0. 255. DISPLAY_IDENTIFIER C_VS_MIN_RGN FORMAT "%3.0" /end CHARACTERISTIC
/begin MEASUREMENT state_nox_prj "state of auxiliary functionalities manager" UBYTE _CNV_S_4_STATE_NOX__521_CM 1 100. 0. 4. DISPLAY_IDENTIFIER STATE_NOX_PRJ ECU_ADDRESS 0xd0003a58 /end MEASUREMENT
/begin MEASUREMENT lv_nt_ad_cmpl "flag for communication with NOx catalyst aging module indicating a succesful adaptaion cycle" UBYTE _CNV_S_2_RANGE__0___1_CM 1 100. 0. 1. DISPLAY_IDENTIFIER LV_NT_AD_CMPL ECU_ADDRESS 0xd0003a5e BIT_MASK 0x1 /end MEASUREMENT
/begin MEASUREMENT lv_nt_ad_vld "flag indicating that the evaluation of the adaptation values is allowed" UBYTE _CNV_S_2_RANGE__0___1_CM 1 100. 0. 1. DISPLAY_IDENTIFIER LV_NT_AD_VLD ECU_ADDRESS 0xd0003a5d BIT_MASK 0x1 /end MEASUREMENT
/begin MEASUREMENT lv_nt_stc_max_act "flag for active full saturation" UBYTE _CNV_S_2_RANGE__0___1_CM 1 100. 0. 1. DISPLAY_IDENTIFIER LV_NT_STC_MAX_ACT ECU_ADDRESS 0xd0003a5f BIT_MASK 0x1 /end MEASUREMENT
/begin MEASUREMENT lv_nt_stc_max_afl_act "flag for active lean phase of full saturation" UBYTE _CNV_S_2_RANGE__0___1_CM 1 100. 0. 1. DISPLAY_IDENTIFIER LV_NT_STC_MAX_AFL_ACT ECU_ADDRESS 0xd0003a60 BIT_MASK 0x1 /end MEASUREMENT
/begin MEASUREMENT lv_nt_o2_stc_act "flag for active O2_STC management" UBYTE _CNV_S_2_RANGE__0___1_CM 1 100. 0. 1. DISPLAY_IDENTIFIER LV_NT_O2_STC_ACT ECU_ADDRESS 0xd0003a5c BIT_MASK 0x1 /end MEASUREMENT
/begin MEASUREMENT lv_nt_prj_act "flag indicating an activated aux. func. module" UBYTE _CNV_S_2_RANGE__0___1_CM 1 100. 0. 1. DISPLAY_IDENTIFIER LV_NT_PRJ_ACT ECU_ADDRESS 0xd0003a59 BIT_MASK 0x1 /end MEASUREMENT
/begin MEASUREMENT lv_rgn_req_ad "request for a full regeneration for adaptation or elongated stratisfied mode" UBYTE _CNV_S_2_RANGE__0___1_CM 1 100. 0. 1. DISPLAY_IDENTIFIER LV_RGN_REQ_AD ECU_ADDRESS 0xd0003a5b BIT_MASK 0x1 /end MEASUREMENT
/begin MEASUREMENT lv_rgn_req_ad_vld "flag to set a valid request for a full regeneration" UBYTE _CNV_S_2_RANGE__0___1_CM 1 100. 0. 1. DISPLAY_IDENTIFIER LV_RGN_REQ_AD_VLD ECU_ADDRESS 0xc00009f9 BIT_MASK 0x1 /end MEASUREMENT
/begin MEASUREMENT lv_rgn_cdn_ad "flag for validity of sensor signal during regeneration" UBYTE _CNV_S_2_RANGE__0___1_CM 1 100. 0. 1. DISPLAY_IDENTIFIER LV_RGN_CDN_AD ECU_ADDRESS 0xc00009fa BIT_MASK 0x1 /end MEASUREMENT
/begin MEASUREMENT lv_inh_rgn_ad "flag inhibiting a regeneration request by NOx sensor or loading degree model" UBYTE _CNV_S_2_RANGE__0___1_CM 1 100. 0. 1. DISPLAY_IDENTIFIER LV_INH_RGN_AD ECU_ADDRESS 0xd0003a5a BIT_MASK 0x1 /end MEASUREMENT
/begin MEASUREMENT lv_sens_afr_ad_secu_1 "security threshold for sensor switch detection exceeded" UBYTE _CNV_S_2_RANGE__0___1_CM 1 100. 0. 1. DISPLAY_IDENTIFIER LV_SENS_AFR_AD_SECU_1 ECU_ADDRESS 0xc00009fb BIT_MASK 0x1 /end MEASUREMENT
/begin MEASUREMENT lv_sens_afr_ad_secu_2 "security threshold for sensor switch detection exceeded" UBYTE _CNV_S_2_RANGE__0___1_CM 1 100. 0. 1. DISPLAY_IDENTIFIER LV_SENS_AFR_AD_SECU_2 ECU_ADDRESS 0xc00009fc BIT_MASK 0x1 /end MEASUREMENT
/begin MEASUREMENT lv_sens_afr_o2_1 "thrshold for detecting rich mixture downstrem exceeded" UBYTE _CNV_S_2_RANGE__0___1_CM 1 100. 0. 1. DISPLAY_IDENTIFIER LV_SENS_AFR_O2_1 ECU_ADDRESS 0xd0003a61 BIT_MASK 0x1 /end MEASUREMENT
/begin MEASUREMENT lv_sens_afr_o2_2 "thrshold for detecting rich mixture downstrem exceeded" UBYTE _CNV_S_2_RANGE__0___1_CM 1 100. 0. 1. DISPLAY_IDENTIFIER LV_SENS_AFR_O2_2 ECU_ADDRESS 0xd0003a62 BIT_MASK 0x1 /end MEASUREMENT
/begin MEASUREMENT maf_int_puc_o2_stc "integral of mass air flow while PUC active, modified value for O2_STC measurement" UWORD _CNV_A_R_LINEAR_____198_CM 1 100. 0. 1820.398 DISPLAY_IDENTIFIER MAF_INT_PUC_O2_STC ECU_ADDRESS 0xc00009f0 FORMAT "%7.2" /end MEASUREMENT
/begin MEASUREMENT t_vls_down_afl_1 "switch time counter" UWORD _CNV_A_R_LINEAR_____3_CM 1 100. 0. 655.35 DISPLAY_IDENTIFIER T_VLS_DOWN_AFL_1 ECU_ADDRESS 0xd0004e08 FORMAT "%6.2" /end MEASUREMENT
/begin MEASUREMENT t_vls_down_afl_2 "switch time counter" UWORD _CNV_A_R_LINEAR_____3_CM 1 100. 0. 655.35 DISPLAY_IDENTIFIER T_VLS_DOWN_AFL_2 ECU_ADDRESS 0xd0004e0c FORMAT "%6.2" /end MEASUREMENT
/begin MEASUREMENT t_vls_down_secu_1 "time during witch sensor signal must pass from 1. vls-thd to 2. vls-thd (safety procedure)" UWORD _CNV_A_R_LINEAR_____3_CM 1 100. 0. 655.35 DISPLAY_IDENTIFIER T_VLS_DOWN_SECU_1 ECU_ADDRESS 0xc00009f2 FORMAT "%6.2" /end MEASUREMENT
/begin MEASUREMENT t_vls_down_secu_2 "time during witch sensor signal must pass from 1. vls-thd to 2. vls-thd (safety procedure)" UWORD _CNV_A_R_LINEAR_____3_CM 1 100. 0. 655.35 DISPLAY_IDENTIFIER T_VLS_DOWN_SECU_2 ECU_ADDRESS 0xc00009f6 FORMAT "%6.2" /end MEASUREMENT
/begin MEASUREMENT t_nt_ad_com "time counter for duration of communication state" UBYTE _CNV_A_R_LINEAR_____4_CM 1 100. 0. 25.5 DISPLAY_IDENTIFIER T_NT_AD_COM ECU_ADDRESS 0xc00009f8 FORMAT "%4.1" /end MEASUREMENT
/begin MEASUREMENT ntl_dec_int_ad_1 "integral of reducing agent until sensor switch" UWORD _CNV_A_R_LINEAR_____495_CM 1 100. 0. 10485.6 DISPLAY_IDENTIFIER NTL_DEC_INT_AD_1 ECU_ADDRESS 0xd0004e0a FORMAT "%7.1" /end MEASUREMENT
/begin MEASUREMENT ntl_dec_int_ad_2 "integral of reducing agent until sensor switch" UWORD _CNV_A_R_LINEAR_____495_CM 1 100. 0. 10485.6 DISPLAY_IDENTIFIER NTL_DEC_INT_AD_2 ECU_ADDRESS 0xd0004e0e FORMAT "%7.1" /end MEASUREMENT
/begin MEASUREMENT ntl_dec_int_thd "integral of reducing agent to be achieved to stop full regeneration" UWORD _CNV_A_R_LINEAR_____495_CM 1 100. 0. 10485.6 DISPLAY_IDENTIFIER NTL_DEC_INT_THD ECU_ADDRESS 0xc00009f4 FORMAT "%7.1" /end MEASUREMENT
/begin CHARACTERISTIC lc_nt_prj_act "logical constant for auxiliary functionalities module activation" VALUE 0xa1029daf _REC_VAL_20_u1 1. _CNV_A_R_LINEAR_____0_CM 0. 1. DISPLAY_IDENTIFIER LC_NT_PRJ_ACT FORMAT "%1.0" /end CHARACTERISTIC
/begin CHARACTERISTIC lc_rgn_req_ad_vld_act "logical constant for activation of extended regeneration phase after elongated stratified mode" VALUE 0xa1029dc0 _REC_VAL_20_u1 1. _CNV_A_R_LINEAR_____0_CM 0. 1. DISPLAY_IDENTIFIER LC_RGN_REQ_AD_VLD_ACT FORMAT "%1.0" /end CHARACTERISTIC
/begin CHARACTERISTIC c_maf_int_puc_o2_stc "required integral of air mass in PUC before starting an O2_STC measurement" VALUE 0xa1029546 _REC_VAL_20_u2 1820.398 _CNV_A_R_LINEAR_____198_CM 0. 1820.398 DISPLAY_IDENTIFIER C_MAF_INT_PUC_O2_STC FORMAT "%7.2" /end CHARACTERISTIC
/begin CHARACTERISTIC c_ntl_max_o2_stc "maximum permissible NOx load for O2_STC measurement" VALUE 0xa10296f8 _REC_VAL_20_u2 10485.6 _CNV_A_R_LINEAR_____495_CM 0. 10485.6 DISPLAY_IDENTIFIER C_NTL_MAX_O2_STC FORMAT "%7.1" /end CHARACTERISTIC
/begin CHARACTERISTIC c_t_vls_down_secu "time within sensor signal must pass from 1. thd to 2. thd" VALUE 0xa10299a0 _REC_VAL_20_u2 655.35 _CNV_A_R_LINEAR_____3_CM 0. 655.35 DISPLAY_IDENTIFIER C_T_VLS_DOWN_SECU FORMAT "%6.2" /end CHARACTERISTIC
/begin CHARACTERISTIC c_t_nt_ad_com "time threshold for duration of communication state" VALUE 0xa1029930 _REC_VAL_20_u1 25.5 _CNV_A_R_LINEAR_____4_CM 0. 25.5 DISPLAY_IDENTIFIER C_T_NT_AD_COM FORMAT "%4.1" /end CHARACTERISTIC
/begin CHARACTERISTIC c_vs_min_rgn_ad "maximum vehicle speed for use of adaptation value" VALUE 0xa1029cc4 _REC_VAL_20_u1 255. _CNV_A_R_LINEAR_____6_CM 0. 255. DISPLAY_IDENTIFIER C_VS_MIN_RGN_AD FORMAT "%3.0" /end CHARACTERISTIC
/begin CHARACTERISTIC c_n_32_min_rgn_ad "minimum engine speed for use of adaptation value" VALUE 0xa10295cb _REC_VAL_20_u1 8160. _CNV_A_R_LINEAR_____9_CM 0. 8160. DISPLAY_IDENTIFIER C_N_32_MIN_RGN_AD FORMAT "%4.0" /end CHARACTERISTIC
/begin CHARACTERISTIC c_maf_min_rgn_ad "minimum mass air flow for use of adaptation value" VALUE 0xa1029560 _REC_VAL_20_u2 16383.75 _CNV_A_R_LINEAR_____522_CM 0. 16383.75 DISPLAY_IDENTIFIER C_MAF_MIN_RGN_AD FORMAT "%7.1" /end CHARACTERISTIC
/begin CHARACTERISTIC c_state_sens_afr_ad_1 "mode to determine rich exhaust gas downstream NOx trap" VALUE 0xa10297c2 _REC_VAL_20_u1 3. _CNV_S_4_STATE_SENS_523_CM 0. 3. DISPLAY_IDENTIFIER C_STATE_SENS_AFR_AD_1 /end CHARACTERISTIC
/begin CHARACTERISTIC c_state_sens_afr_ad_2 "mode to determine rich exhaust gas downstream NOx trap" VALUE 0xa10297c3 _REC_VAL_20_u1 3. _CNV_S_4_STATE_SENS_523_CM 0. 3. DISPLAY_IDENTIFIER C_STATE_SENS_AFR_AD_2 /end CHARACTERISTIC
/begin CHARACTERISTIC c_vls_down_afr_o2 "downstream binary lambda sensor signal threshold for determining rich exhaust gas (osc adaptation)" VALUE 0xa1029c3a _REC_VAL_20_u2 4.9951171875 _CNV_A_R_LINEAR_____2_CM 0. 4.9951171875 DISPLAY_IDENTIFIER C_VLS_DOWN_AFR_O2 FORMAT "%5.3" /end CHARACTERISTIC
/begin CHARACTERISTIC c_vls_down_afr_ad_secu "1. sensor thd. after which 2. thd. must be reached within fixed time " VALUE 0xa1029c38 _REC_VAL_20_u2 4.9951171875 _CNV_A_R_LINEAR_____2_CM 0. 4.9951171875 DISPLAY_IDENTIFIER C_VLS_DOWN_AFR_AD_SECU FORMAT "%5.3" /end CHARACTERISTIC
/begin CHARACTERISTIC c_vls_nox_sens_afr_o2 "binary NOx sensor signal threshold for determining rich exhaust gas (osc adaptation)" VALUE 0xa1029c56 _REC_VAL_20_u2 1400. _CNV_A_R_LINEAR_____211_CM -200. 1200. DISPLAY_IDENTIFIER C_VLS_NOX_SENS_AFR_O2 FORMAT "%4.0" /end CHARACTERISTIC
/begin CHARACTERISTIC c_vls_nox_sens_afr_ad_secu "1. sensor thd. after which 2. thd. must be reached within fixed time " VALUE 0xa1029c54 _REC_VAL_20_u2 1400. _CNV_A_R_LINEAR_____211_CM -200. 1200. DISPLAY_IDENTIFIER C_VLS_NOX_SENS_AFR_AD_SECU FORMAT "%4.0" /end CHARACTERISTIC
/begin CHARACTERISTIC c_lamb_nox_sens_afr_o2 "linear NOx sensor signal threshold for determining rich exhaust gas (osc adaptation)" VALUE 0xa10294e4 _REC_VAL_20_u2 31.9990234375 _CNV_A_R_LINEAR_____122_CM 0. 31.9990234375 DISPLAY_IDENTIFIER C_LAMB_NOX_SENS_AFR_O2 FORMAT "%7.4" /end CHARACTERISTIC
/begin CHARACTERISTIC c_lamb_nox_sens_afr_ad_secu "1. sensor thd. after which 2. thd. must be reached within fixed time " VALUE 0xa10294e2 _REC_VAL_20_u2 31.9990234375 _CNV_A_R_LINEAR_____122_CM 0. 31.9990234375 DISPLAY_IDENTIFIER C_LAMB_NOX_SENS_AFR_AD_SECU FORMAT "%7.4" /end CHARACTERISTIC
/begin AXIS_PTS ldp_t_afl_ntl_dec_int_ofs "" 0xa1021190 t_afl _REC_AXS_20_u2 1310.7 _CNV_A_R_LINEAR_____107_CM 8 0. 1310.7 FORMAT "%7.2" /end AXIS_PTS
/begin CHARACTERISTIC ip_ntl_dec_int_ofs_t_afl "additional reducing agent mass required after elongated stratified mode" CURVE 0xa1026df8 _REC_CUR_20_u2_u2 10485.6 _CNV_A_R_LINEAR_____495_CM 0. 10485.6 DISPLAY_IDENTIFIER IP_NTL_DEC_INT_OFS_T_AFL FORMAT "%7.1"
 /begin AXIS_DESCR COM_AXIS t_afl _CNV_A_R_LINEAR_____107_CM 8 0. 1310.7 FORMAT "%7.2" AXIS_PTS_REF ldp_t_afl_ntl_dec_int_ofs /end AXIS_DESCR
/end CHARACTERISTIC
/begin MEASUREMENT nox_out_mes_int_1 "absolute tailpipe NOx emission during stratified operation mode" UWORD _CNV_A_R_LINEAR_____495_CM 1 100. 0. 10485.6 DISPLAY_IDENTIFIER NOX_OUT_MES_INT_1 ECU_ADDRESS 0xd0004e14 FORMAT "%7.1" /end MEASUREMENT
/begin MEASUREMENT nox_out_mes_int_2 "absolute tailpipe NOx emission during stratified operation mode" UWORD _CNV_A_R_LINEAR_____495_CM 1 100. 0. 10485.6 DISPLAY_IDENTIFIER NOX_OUT_MES_INT_2 ECU_ADDRESS 0xd0004e18 FORMAT "%7.1" /end MEASUREMENT
/begin MEASUREMENT nox_out_mes_1 "tailpipe NOx emission" UWORD _CNV_A_R_LINEAR_____492_CM 1 100. 0. 1023.984375 DISPLAY_IDENTIFIER NOX_OUT_MES_1 ECU_ADDRESS 0xd0004e16 FORMAT "%7.2" /end MEASUREMENT
/begin MEASUREMENT nox_out_mes_2 "tailpipe NOx emission" UWORD _CNV_A_R_LINEAR_____492_CM 1 100. 0. 1023.984375 DISPLAY_IDENTIFIER NOX_OUT_MES_2 ECU_ADDRESS 0xd0004e1a FORMAT "%7.2" /end MEASUREMENT
/begin CHARACTERISTIC lc_nox_out_mes_int_act "switch to enable calculation of NOx tailpipe emission" VALUE 0xa1029d89 _REC_VAL_20_u1 1. _CNV_A_R_LINEAR_____0_CM 0. 1. DISPLAY_IDENTIFIER LC_NOX_OUT_MES_INT_ACT FORMAT "%1.0" /end CHARACTERISTIC
/begin MEASUREMENT teg_pcat_down_add "temperature offset to correct the influence of the exhaust flap and temp. sensor position" SWORD _CNV_A_R_LINEAR_____197_CM 1 100. -512. 511.984375 DISPLAY_IDENTIFIER TEG_PCAT_DOWN_ADD ECU_ADDRESS 0xd0004eac FORMAT "%6.2" /end MEASUREMENT
/begin MEASUREMENT fac_tnt_min_cor_1 "factor to reduce dew-point time of NOx cat. monolith temp. model" UBYTE _CNV_A_R_LINEAR_____100_CM 1 100. 0. 1.9921875 DISPLAY_IDENTIFIER FAC_TNT_MIN_COR_1 ECU_ADDRESS 0xd0003ad4 FORMAT "%5.3" /end MEASUREMENT
/begin MEASUREMENT fac_tnt_min_cor_2 "factor to reduce dew-point time of NOx cat. monolith temp. model" UBYTE _CNV_A_R_LINEAR_____100_CM 1 100. 0. 1.9921875 DISPLAY_IDENTIFIER FAC_TNT_MIN_COR_2 ECU_ADDRESS 0xd0003ad5 FORMAT "%5.3" /end MEASUREMENT
/begin MEASUREMENT teg_pcat_down_cor_1 "Sensor input NOx catalyst monolith temperature" UWORD _CNV_A_R_LINEAR_____197_CM 1 100. 0. 1023.984375 DISPLAY_IDENTIFIER TEG_PCAT_DOWN_COR_1 ECU_ADDRESS 0xd0004ec0 FORMAT "%7.2" /end MEASUREMENT
/begin MEASUREMENT teg_pcat_down_cor_2 "Sensor input NOx catalyst monolith temperature" UWORD _CNV_A_R_LINEAR_____197_CM 1 100. 0. 1023.984375 DISPLAY_IDENTIFIER TEG_PCAT_DOWN_COR_2 ECU_ADDRESS 0xd0004ec2 FORMAT "%7.2" /end MEASUREMENT
/begin MEASUREMENT int_tnt_maf "sum of weighted air mass flow values used for dew point recognition" UWORD _CNV_A_R_LINEAR_____533_CM 1 100. 0. 14506.44 DISPLAY_IDENTIFIER INT_TNT_MAF ECU_ADDRESS 0xc0000be0 FORMAT "%7.1" /end MEASUREMENT
/begin MEASUREMENT lv_tnt_min_thd_1 "dew point recognition" UBYTE _CNV_S_2_RANGE__0___1_CM 1 100. 0. 1. DISPLAY_IDENTIFIER LV_TNT_MIN_THD_1 ECU_ADDRESS 0xd0003af5 BIT_MASK 0x1 /end MEASUREMENT
/begin MEASUREMENT lv_tnt_min_thd_2 "dew point recognition" UBYTE _CNV_S_2_RANGE__0___1_CM 1 100. 0. 1. DISPLAY_IDENTIFIER LV_TNT_MIN_THD_2 ECU_ADDRESS 0xd0003af6 BIT_MASK 0x1 /end MEASUREMENT
/begin MEASUREMENT fac_int_tnt_maf_sa "Correction factor for INT_TNT_MAF calculation for active secondary air" UBYTE _CNV_A_R_LINEAR_____255_CM 1 100. 0. 3.984375 DISPLAY_IDENTIFIER FAC_INT_TNT_MAF_SA ECU_ADDRESS 0xc0000be4 FORMAT "%4.2" /end MEASUREMENT
/begin MEASUREMENT ctr_cold_st_nt "number of cold starts for NOx catalyst" UBYTE _CNV_A_R_LINEAR_____0_CM 1 100. 0. 255. DISPLAY_IDENTIFIER CTR_COLD_ST_NT ECU_ADDRESS 0xd0003af4 FORMAT "%3.0" /end MEASUREMENT
/begin CHARACTERISTIC c_fac_int_tnt_maf_sa "Correction factor for INT_TNT_MAF calculation for active secondary air" VALUE 0xa1029382 _REC_VAL_20_u1 3.984375 _CNV_A_R_LINEAR_____255_CM 0. 3.984375 DISPLAY_IDENTIFIER C_FAC_INT_TNT_MAF_SA FORMAT "%4.2" /end CHARACTERISTIC
/begin AXIS_PTS ldpm_tco_st__int_tnt_thd "" 0xa10222be tco_st _REC_AXS_20_u1 28.575 _CNV_A_R_LINEAR_____16_CM 6 -48. 142.5 FORMAT "%5.1" /end AXIS_PTS
/begin AXIS_PTS ldpm_teg__int_tnt_thd "" 0xa10222e8 online_dummy _REC_AXS_20_u2 153.59765625 _CNV_A_R_LINEAR_____197_CM 6 0. 1023.984375 FORMAT "%7.2" /end AXIS_PTS
/begin CHARACTERISTIC ip_int_tnt_thd_1__tco_st__teg "threshold for air mass flow integral for the detection of dew-point" MAP 0xa1025990 _REC_MAP_20_u2_u1_u2 14506.44 _CNV_A_R_LINEAR_____533_CM 0. 14506.44 DISPLAY_IDENTIFIER IP_INT_TNT_THD_1__TCO_ST__TEG FORMAT "%7.1"
 /begin AXIS_DESCR COM_AXIS tco_st _CNV_A_R_LINEAR_____16_CM 6 -48. 142.5 FORMAT "%5.1" AXIS_PTS_REF ldpm_tco_st__int_tnt_thd /end AXIS_DESCR
 /begin AXIS_DESCR COM_AXIS online_dummy _CNV_A_R_LINEAR_____197_CM 6 0. 1023.984375 FORMAT "%7.2" AXIS_PTS_REF ldpm_teg__int_tnt_thd /end AXIS_DESCR
/end CHARACTERISTIC
/begin CHARACTERISTIC ip_int_tnt_thd_2__tco_st__teg "threshold for air mass flow integral for the detection of dew-point" MAP 0xa10259d8 _REC_MAP_20_u2_u1_u2 14506.44 _CNV_A_R_LINEAR_____533_CM 0. 14506.44 DISPLAY_IDENTIFIER IP_INT_TNT_THD_2__TCO_ST__TEG FORMAT "%7.1"
 /begin AXIS_DESCR COM_AXIS tco_st _CNV_A_R_LINEAR_____16_CM 6 -48. 142.5 FORMAT "%5.1" AXIS_PTS_REF ldpm_tco_st__int_tnt_thd /end AXIS_DESCR
 /begin AXIS_DESCR COM_AXIS online_dummy _CNV_A_R_LINEAR_____197_CM 6 0. 1023.984375 FORMAT "%7.2" AXIS_PTS_REF ldpm_teg__int_tnt_thd /end AXIS_DESCR
/end CHARACTERISTIC
/begin AXIS_PTS ldp_ctr_cold_st_nt__tnt_cold_st "" 0xa102088c ctr_cold_st_nt _REC_AXS_20_u1 255. _CNV_A_R_LINEAR_____0_CM 6 0. 255. FORMAT "%3.0" /end AXIS_PTS
/begin CHARACTERISTIC id_tnt_cold_st__ctr_cold_st_nt "weighting factor for the consideration of the number of cold start tests" CURVE 0xa1022fbc _REC_CUR_20_u1_u1 3.984375 _CNV_A_R_LINEAR_____255_CM 0. 3.984375 DISPLAY_IDENTIFIER ID_TNT_COLD_ST__CTR_COLD_ST_NT FORMAT "%4.2"
 /begin AXIS_DESCR COM_AXIS ctr_cold_st_nt _CNV_A_R_LINEAR_____0_CM 6 0. 255. FORMAT "%3.0" AXIS_PTS_REF ldp_ctr_cold_st_nt__tnt_cold_st /end AXIS_DESCR
/end CHARACTERISTIC
/begin AXIS_PTS ldp_eff_iga_av__int_tnt "" 0xa10208c0 eff_iga_av _REC_AXS_20_u2 1.99996948242188 _CNV_A_R_LINEAR_____8_CM 6 0. 1.99996948242188 FORMAT "%7.5" /end AXIS_PTS
/begin AXIS_PTS ldp_maf_kgh__int_tnt "" 0xa1020c7c maf_kgh _REC_AXS_20_u2 2047.96875 _CNV_A_R_LINEAR_____207_CM 6 0. 2047.96875 FORMAT "%7.2" /end AXIS_PTS
/begin CHARACTERISTIC ip_int_tnt__eff_iga_av__maf_kgh "weighting factor for ignition angle influence on dew point calculation" MAP 0xa102596c _REC_MAP_20_u1_u2_u2 15.9375 _CNV_A_R_EVAC_LINEA_314_CM 0. 15.9375 DISPLAY_IDENTIFIER IP_INT_TNT__EFF_IGA_AV__MAF_KGH FORMAT "%5.2"
 /begin AXIS_DESCR COM_AXIS eff_iga_av _CNV_A_R_LINEAR_____8_CM 6 0. 1.99996948242188 FORMAT "%7.5" AXIS_PTS_REF ldp_eff_iga_av__int_tnt /end AXIS_DESCR
 /begin AXIS_DESCR COM_AXIS maf_kgh _CNV_A_R_LINEAR_____207_CM 6 0. 2047.96875 FORMAT "%7.2" AXIS_PTS_REF ldp_maf_kgh__int_tnt /end AXIS_DESCR
/end CHARACTERISTIC
/begin MEASUREMENT ctr_cold_st "number of cold starts" UBYTE _CNV_A_R_LINEAR_____0_CM 1 100. 0. 255. DISPLAY_IDENTIFIER CTR_COLD_ST ECU_ADDRESS 0xd0003b74 FORMAT "%3.0" /end MEASUREMENT
/begin MEASUREMENT int_teg_maf "sum of the weighted air mass flow values used for the dew point recognition" UWORD _CNV_A_R_LINEAR_____534_CM 1 100. 0. 9102.08 DISPLAY_IDENTIFIER INT_TEG_MAF ECU_ADDRESS 0xc0000be8 FORMAT "%6.1" /end MEASUREMENT
/begin MEASUREMENT lv_teg_cat_down_min_thd_1 "dew-point recognition downstream of catalyst" UBYTE _CNV_A_R_LINEAR_____0_CM 1 100. 0. 1. DISPLAY_IDENTIFIER LV_TEG_CAT_DOWN_MIN_THD ECU_ADDRESS 0xd0003b76 FORMAT "%1.0" BIT_MASK 0x1 /end MEASUREMENT
/begin MEASUREMENT lv_teg_min_thd_1 "dew-point recognition" UBYTE _CNV_A_R_LINEAR_____0_CM 1 100. 0. 1. DISPLAY_IDENTIFIER LV_TEG_MIN_THD ECU_ADDRESS 0xd0003b75 FORMAT "%1.0" BIT_MASK 0x1 /end MEASUREMENT
/begin CHARACTERISTIC id_ctr_cold_st "weighting factor for the consideration of the number of cold-start tests" CURVE 0xa1022440 _REC_CUR_20_u1_u1 3.984375 _CNV_A_R_LINEAR_____255_CM 0. 3.984375 DISPLAY_IDENTIFIER ID_CTR_COLD_ST FORMAT "%4.2"
 /begin AXIS_DESCR COM_AXIS ctr_cold_st _CNV_A_R_LINEAR_____0_CM 6 0. 255. FORMAT "%3.0" AXIS_PTS_REF ldp_ctr_cold_st__ctr_cold_st /end AXIS_DESCR
/end CHARACTERISTIC
/begin AXIS_PTS ldp_ctr_cold_st__ctr_cold_st "" 0xa1020884 ctr_cold_st _REC_AXS_20_u1 255. _CNV_A_R_LINEAR_____0_CM 6 0. 255. FORMAT "%3.0" /end AXIS_PTS
/begin CHARACTERISTIC ip_int_teg_thd "threshold air mass flow integral for detection of dew point upstream of catalyst" MAP 0xa102590c _REC_MAP_20_u2_u1_u1 9102.08 _CNV_A_R_LINEAR_____534_CM 0. 9102.08 DISPLAY_IDENTIFIER IP_INT_TEG_THD FORMAT "%6.1"
 /begin AXIS_DESCR COM_AXIS tco_st _CNV_A_R_LINEAR_____16_CM 8 -48. 142.5 FORMAT "%6.2" AXIS_PTS_REF ldpm_tco_st_1_extd /end AXIS_DESCR
 /begin AXIS_DESCR COM_AXIS tia _CNV_A_R_LINEAR_____16_CM 6 -48. 142.5 FORMAT "%6.2" AXIS_PTS_REF ldpm_tia_1_extd /end AXIS_DESCR
/end CHARACTERISTIC
/begin CHARACTERISTIC ip_int_teg_cat_down_thd "threshold air mass flow integral for detection of dew point downstream of catalyst" MAP 0xa10258ac _REC_MAP_20_u2_u1_u1 9102.08 _CNV_A_R_LINEAR_____534_CM 0. 9102.08 DISPLAY_IDENTIFIER IP_INT_TEG_CAT_DOWN_THD FORMAT "%6.1"
 /begin AXIS_DESCR COM_AXIS tco_st _CNV_A_R_LINEAR_____16_CM 8 -48. 142.5 FORMAT "%6.2" AXIS_PTS_REF ldpm_tco_st_1_extd /end AXIS_DESCR
 /begin AXIS_DESCR COM_AXIS tia _CNV_A_R_LINEAR_____16_CM 6 -48. 142.5 FORMAT "%6.2" AXIS_PTS_REF ldpm_tia_1_extd /end AXIS_DESCR
/end CHARACTERISTIC
/begin AXIS_PTS ldpm_tco_st_1_extd "" 0xa10222b4 tco_st _REC_AXS_20_u1 190.5 _CNV_A_R_LINEAR_____16_CM 8 -48. 142.5 FORMAT "%6.2" /end AXIS_PTS
/begin AXIS_PTS ldpm_tia_1_extd "" 0xa10222fe tia _REC_AXS_20_u1 190.5 _CNV_A_R_LINEAR_____16_CM 6 -48. 142.5 FORMAT "%6.2" /end AXIS_PTS
/begin CHARACTERISTIC ip_int_teg "weighting factor for the consideration of the ignition angle and MAF_KGH influence for dew point determination" MAP 0xa1025888 _REC_MAP_20_u1_u2_u2 15.9375 _CNV_A_R_EVAC_LINEA_314_CM 0. 15.9375 DISPLAY_IDENTIFIER IP_INT_TEG FORMAT "%5.2"
 /begin AXIS_DESCR COM_AXIS eff_iga_av _CNV_A_R_LINEAR_____8_CM 6 0. 1.99996948242188 FORMAT "%7.5" AXIS_PTS_REF ldp_eff_iga_av__int_teg /end AXIS_DESCR
 /begin AXIS_DESCR COM_AXIS maf_kgh _CNV_A_R_LINEAR_____207_CM 6 0. 2047.96875 FORMAT "%7.2" AXIS_PTS_REF ldp_maf_kgh__int_teg /end AXIS_DESCR
/end CHARACTERISTIC
/begin AXIS_PTS ldp_eff_iga_av__int_teg "" 0xa10208b0 eff_iga_av _REC_AXS_20_u2 1.99996948242188 _CNV_A_R_LINEAR_____8_CM 6 0. 1.99996948242188 FORMAT "%7.5" /end AXIS_PTS
/begin AXIS_PTS ldp_maf_kgh__int_teg "" 0xa1020c6c maf_kgh _REC_AXS_20_u2 2047.96875 _CNV_A_R_LINEAR_____207_CM 6 0. 2047.96875 FORMAT "%7.2" /end AXIS_PTS
/begin MEASUREMENT lv_iga_tra_knk "Load dynamic correction active" UBYTE _CNV_S_2_RANGE__0___1_CM 1 100. 0. 1. DISPLAY_IDENTIFIER LV_IGA_TRA_KNK ECU_ADDRESS 0xd00038b2 BIT_MASK 0x1 /end MEASUREMENT
/begin MEASUREMENT iga_is_tq_knk "Torgue reserve for knockcontrol in idle speed" UBYTE _CNV_A_R_LINEAR_____171_CM 1 100. -48. 0. DISPLAY_IDENTIFIER IGA_IS_TQ_KNK ECU_ADDRESS 0xd00038b0 FORMAT "%7.3" /end MEASUREMENT
/begin MEASUREMENT iga_mv_adj_knk_cus "Mean spark retard of knock control incl. knock - and fuel quality adaptation by customer" UBYTE _CNV_A_R_LINEAR_____171_CM 1 100. -48. 0. DISPLAY_IDENTIFIER IGA_MV_ADJ_KNK_CUS ECU_ADDRESS 0xd00038b1 FORMAT "%7.3" /end MEASUREMENT
/begin MEASUREMENT temp_cat_dyn_mdl[0] "modeled catalyst monolith temperature (bank selective)" UWORD _CNV_A_R_LINEAR_____204_CM 1 100. -273.15 1774.7875 DISPLAY_IDENTIFIER TEMP_CAT_DYN_MDL[1] ECU_ADDRESS 0xd0004c58 FORMAT "%9.4" /end MEASUREMENT
/begin MEASUREMENT temp_cat_dyn_mdl[1] "modeled catalyst monolith temperature (bank selective)" UWORD _CNV_A_R_LINEAR_____204_CM 1 100. -273.15 1774.7875 DISPLAY_IDENTIFIER TEMP_CAT_DYN_MDL[2] ECU_ADDRESS 0xd0004c5a FORMAT "%9.4" /end MEASUREMENT
/begin MEASUREMENT tnt_mdl_1_1 "Modelled NOx catalyst monolith temperatures" UWORD _CNV_A_R_LINEAR_____197_CM 1 100. 0. 1023.984375 DISPLAY_IDENTIFIER TNT_MDL_1_1 ECU_ADDRESS 0xd0004c62 FORMAT "%7.2" /end MEASUREMENT
/begin MEASUREMENT tnt_mdl_1_2 "Modelled NOx catalyst monolith temperatures" UWORD _CNV_A_R_LINEAR_____197_CM 1 100. 0. 1023.984375 DISPLAY_IDENTIFIER TNT_MDL_1_2 ECU_ADDRESS 0xd0004c7e FORMAT "%7.2" /end MEASUREMENT
/begin MEASUREMENT tnt_mdl_2_1 "Modelled NOx catalyst monolith temperatures" UWORD _CNV_A_R_LINEAR_____197_CM 1 100. 0. 1023.984375 DISPLAY_IDENTIFIER TNT_MDL_2_1 ECU_ADDRESS 0xd0004c64 FORMAT "%7.2" /end MEASUREMENT
/begin MEASUREMENT tnt_mdl_2_2 "Modelled NOx catalyst monolith temperatures" UWORD _CNV_A_R_LINEAR_____197_CM 1 100. 0. 1023.984375 DISPLAY_IDENTIFIER TNT_MDL_2_2 ECU_ADDRESS 0xd0004c80 FORMAT "%7.2" /end MEASUREMENT
/begin MEASUREMENT tnt_mdl_mv "Mean value of the two modelled NOx catalyst monolith temperatures" UWORD _CNV_A_R_LINEAR_____197_CM 1 100. 0. 1023.984375 DISPLAY_IDENTIFIER TNT_MDL_MV ECU_ADDRESS 0xd0004c66 FORMAT "%7.2" /end MEASUREMENT
/begin MEASUREMENT tnt_mdl_h "Maximum of modelled NOx catalyst monolith temperatures" UWORD _CNV_A_R_LINEAR_____197_CM 1 100. 0. 1023.984375 DISPLAY_IDENTIFIER TNT_MDL_H ECU_ADDRESS 0xd0004c6a FORMAT "%7.2" /end MEASUREMENT
/begin MEASUREMENT tnt_mdl_h_1 "Maximum of modelled NOx catalyst monolith temperatures (bank selective)" UWORD _CNV_A_R_LINEAR_____197_CM 1 100. 0. 1023.984375 DISPLAY_IDENTIFIER TNT_MDL_H_1 ECU_ADDRESS 0xd0004c6c FORMAT "%7.2" /end MEASUREMENT
/begin MEASUREMENT tnt_mdl_h_2 "Maximum of modelled NOx catalyst monolith temperatures (bank selective)" UWORD _CNV_A_R_LINEAR_____197_CM 1 100. 0. 1023.984375 DISPLAY_IDENTIFIER TNT_MDL_H_2 ECU_ADDRESS 0xd0004c84 FORMAT "%7.2" /end MEASUREMENT
/begin MEASUREMENT tnt_mdl_l "Minimum of modelled NOx catalyst monolith temperatures" UWORD _CNV_A_R_LINEAR_____197_CM 1 100. 0. 1023.984375 DISPLAY_IDENTIFIER TNT_MDL_L ECU_ADDRESS 0xd0004c6e FORMAT "%7.2" /end MEASUREMENT
/begin MEASUREMENT tnt_mdl_max_avl "Maximum attainable monolith temp. for active Nox cat. desulfation" UWORD _CNV_A_R_LINEAR_____197_CM 1 100. 0. 1023.984375 DISPLAY_IDENTIFIER TNT_MDL_MAX_AVL ECU_ADDRESS 0xd0004c60 FORMAT "%7.2" /end MEASUREMENT
/begin MEASUREMENT tnt_mdl_mv_1 "MMean value of the two modelled NOx catalyst monolith temperatures for exhaust branch 1" UWORD _CNV_A_R_LINEAR_____197_CM 1 100. 0. 1023.984375 DISPLAY_IDENTIFIER TNT_MDL_MV_1 ECU_ADDRESS 0xd0004c68 FORMAT "%7.2" /end MEASUREMENT
/begin MEASUREMENT tnt_mdl_mv_2 "MMean value of the two modelled NOx catalyst monolith temperatures for exhaust branch 2" UWORD _CNV_A_R_LINEAR_____197_CM 1 100. 0. 1023.984375 DISPLAY_IDENTIFIER TNT_MDL_MV_2 ECU_ADDRESS 0xd0004c82 FORMAT "%7.2" /end MEASUREMENT
/begin MEASUREMENT temp_cat_stat_mdl[0] "Modelled catalyst temperature under static conditions" UWORD _CNV_A_R_LINEAR_____204_CM 1 100. -273.15 1774.7875 DISPLAY_IDENTIFIER TEMP_CAT_STAT_MDL[1] ECU_ADDRESS 0xd0004c5c FORMAT "%9.4" /end MEASUREMENT
/begin MEASUREMENT temp_cat_stat_mdl[1] "Modelled catalyst temperature under static conditions" UWORD _CNV_A_R_LINEAR_____204_CM 1 100. -273.15 1774.7875 DISPLAY_IDENTIFIER TEMP_CAT_STAT_MDL[2] ECU_ADDRESS 0xd0004c5e FORMAT "%9.4" /end MEASUREMENT
/begin MEASUREMENT t_mff_ad_min "Time indicating the minimum time for next requested lambda adaptation" UWORD _CNV_A_R_LINEAR_____4_CM 1 100. 0. 6553.5 DISPLAY_IDENTIFIER T_MFF_AD_MIN ECU_ADDRESS 0xd0004bfc FORMAT "%6.1" /end MEASUREMENT
/begin COMPU_METHOD _CNV_A_R_LINEAR_____0_CM "" RAT_FUNC "%6.3" "-" COEFFS 0 1. 0. 0 0 1 /end COMPU_METHOD
/begin COMPU_METHOD _CNV_S_2_RANGE__0___1_CM "" TAB_VERB "%6.3" "-" COMPU_TAB_REF _CNV_S_2_RANGE__0___1 /end COMPU_METHOD
/begin COMPU_VTAB _CNV_S_2_RANGE__0___1 "" TAB_VERB 2 0 "0" 1 "1" /end COMPU_VTAB
/begin COMPU_METHOD _CNV_A_R_LINEAR_____2_CM "" RAT_FUNC "%6.3" "V" COEFFS 0 204.8 0. 0 0 1 /end COMPU_METHOD
/begin COMPU_METHOD _CNV_A_R_LINEAR_____3_CM "" RAT_FUNC "%6.3" "s" COEFFS 0 100. 0. 0 0 1 /end COMPU_METHOD
/begin COMPU_METHOD _CNV_A_R_LINEAR_____4_CM "" RAT_FUNC "%6.3" "s" COEFFS 0 10. 0. 0 0 1 /end COMPU_METHOD
/begin COMPU_METHOD _CNV_A_R_LINEAR_____6_CM "" RAT_FUNC "%6.3" "km/h" COEFFS 0 1. 0. 0 0 1 /end COMPU_METHOD
/begin COMPU_METHOD _CNV_A_R_LINEAR_____7_CM "" RAT_FUNC "%6.3" "%" COEFFS 0 655.3599999999997 0. 0 0 1 /end COMPU_METHOD
/begin COMPU_METHOD _CNV_A_R_LINEAR_____8_CM "" RAT_FUNC "%6.3" "-" COEFFS 0 32767.99999999992 0. 0 0 1 /end COMPU_METHOD
/begin COMPU_METHOD _CNV_A_R_LINEAR_____9_CM "" RAT_FUNC "%6.3" "rpm" COEFFS 0 3.125e-002 0. 0 0 1 /end COMPU_METHOD
/begin COMPU_METHOD _CNV_A_R_LINEAR_____13_CM "" RAT_FUNC "%6.3" "rpm" COEFFS 0 1. 0. 0 0 1 /end COMPU_METHOD
/begin COMPU_METHOD _CNV_A_R_LINEAR_____14_CM "" RAT_FUNC "%6.3" "mg/stk" COEFFS 0 0.183585313174946 0. 0 0 1 /end COMPU_METHOD
/begin COMPU_METHOD _CNV_A_R_LINEAR_____16_CM "" RAT_FUNC "%6.3" "°C" COEFFS 0 1.333333333333333 64. 0 0 1 /end COMPU_METHOD
/begin COMPU_METHOD _CNV_A_R_LINEAR_____17_CM "" RAT_FUNC "%6.3" "-" COEFFS 0 255.9983911655618 0. 0 0 1 /end COMPU_METHOD
/begin COMPU_METHOD _CNV_A_R_LINEAR_____23_CM "" RAT_FUNC "%6.3" "-" COEFFS 0 16384. 0. 0 0 1 /end COMPU_METHOD
/begin COMPU_METHOD _CNV_A_R_LINEAR_____25_CM "" RAT_FUNC "%6.3" "°C" COEFFS 0 1. 40. 0 0 1 /end COMPU_METHOD
/begin COMPU_METHOD _CNV_A_R_LINEAR_____26_CM "" RAT_FUNC "%6.3" "hPa" COEFFS 0 12.06017666543982 0. 0 0 1 /end COMPU_METHOD
/begin COMPU_METHOD _CNV_A_R_LINEAR_____27_CM "" RAT_FUNC "%6.3" "-" COEFFS 0 256. 0. 0 0 1 /end COMPU_METHOD
/begin COMPU_METHOD _CNV_A_R_LINEAR_____29_CM "" RAT_FUNC "%6.3" "rpm/s" COEFFS 0 3.125e-002 0. 0 0 1 /end COMPU_METHOD
/begin COMPU_METHOD _CNV_A_R_LINEAR_____30_CM "" RAT_FUNC "%6.3" "Nm" COEFFS 0 32. 0. 0 0 1 /end COMPU_METHOD
/begin COMPU_METHOD _CNV_A_R_LINEAR_____68_CM "" RAT_FUNC "%6.3" "-" COEFFS 0 65535.99999999996 0. 0 0 1 /end COMPU_METHOD
/begin COMPU_METHOD _CNV_A_R_LINEAR_____71_CM "" RAT_FUNC "%6.3" "" COEFFS 0 256. 0. 0 0 1 /end COMPU_METHOD
/begin COMPU_METHOD _CNV_S_2_RANGE______75_CM "" TAB_VERB "%6.3" "" COMPU_TAB_REF _CNV_S_2_RANGE______75 /end COMPU_METHOD
/begin COMPU_VTAB _CNV_S_2_RANGE______75 "" TAB_VERB 2 0 "0" 1 "1" /end COMPU_VTAB
/begin COMPU_METHOD _CNV_A_R_LINEAR_____77_CM "" RAT_FUNC "%6.3" "min" COEFFS 0 1. 0. 0 0 1 /end COMPU_METHOD
/begin COMPU_METHOD _CNV_A_R_LINEAR_____97_CM "" RAT_FUNC "%6.3" "-" COEFFS 0 127.9991955827809 0. 0 0 1 /end COMPU_METHOD
/begin COMPU_METHOD _CNV_A_R_LINEAR_____100_CM "" RAT_FUNC "%6.3" "-" COEFFS 0 128. 0. 0 0 1 /end COMPU_METHOD
/begin COMPU_METHOD _CNV_A_R_LINEAR_____107_CM "" RAT_FUNC "%6.3" "s" COEFFS 0 50. 0. 0 0 1 /end COMPU_METHOD
/begin COMPU_METHOD _CNV_A_R_LINEAR_____108_CM "" RAT_FUNC "%6.3" "mg/stk" COEFFS 0 47.18142548596112 0. 0 0 1 /end COMPU_METHOD
/begin COMPU_METHOD _CNV_A_R_LINEAR_____109_CM "" RAT_FUNC "%6.3" "°CRK" COEFFS 0 0.1666666666666667 0. 0 0 1 /end COMPU_METHOD
/begin COMPU_METHOD _CNV_A_R_LINEAR_____110_CM "" RAT_FUNC "%6.3" "%" COEFFS 0 655.3599999999997 -1.455191522836685e-011 0 0 1 /end COMPU_METHOD
/begin COMPU_METHOD _CNV_A_R_LINEAR_____113_CM "" RAT_FUNC "%6.3" "-" COEFFS 0 8192. 0. 0 0 1 /end COMPU_METHOD
/begin COMPU_METHOD _CNV_A_R_LINEAR_____122_CM "" RAT_FUNC "%6.3" "-" COEFFS 0 1024. 0. 0 0 1 /end COMPU_METHOD
/begin COMPU_METHOD _CNV_A_R_LINEAR_____123_CM "" RAT_FUNC "%6.3" "°C" COEFFS 0 16. 0. 0 0 1 /end COMPU_METHOD
/begin COMPU_METHOD _CNV_A_R_LINEAR_____166_CM "" RAT_FUNC "%6.3" "°CRK" COEFFS 0 16. 0. 0 0 1 /end COMPU_METHOD
/begin COMPU_METHOD _CNV_A_R_LINEAR_____167_CM "" RAT_FUNC "%6.3" "°CRK" COEFFS 0 2.666666666666667 95. 0 0 1 /end COMPU_METHOD
/begin COMPU_METHOD _CNV_A_R_LINEAR_____168_CM "" RAT_FUNC "%6.3" "°CRK" COEFFS 0 2.666666666666667 0. 0 0 1 /end COMPU_METHOD
/begin COMPU_METHOD _CNV_A_R_LINEAR_____169_CM "" RAT_FUNC "%6.3" "°CRK" COEFFS 0 -16. 0. 0 0 1 /end COMPU_METHOD
/begin COMPU_METHOD _CNV_A_R_LINEAR_____171_CM "" RAT_FUNC "%6.3" "°CRK" COEFFS 0 2.666666666666667 128. 0 0 1 /end COMPU_METHOD
/begin COMPU_METHOD _CNV_A_R_LINEAR_____172_CM "" RAT_FUNC "%6.3" "rpm" COEFFS 0 1. 32768. 0 0 1 /end COMPU_METHOD
/begin COMPU_METHOD _CNV_A_R_LINEAR_____174_CM "" RAT_FUNC "%6.3" "°CRK" COEFFS 0 -2.666666666666667 0. 0 0 1 /end COMPU_METHOD
/begin COMPU_METHOD _CNV_A_R_LINEAR_____178_CM "" RAT_FUNC "%6.3" "-" COEFFS 0 65551.06000970239 0. 0 0 1 /end COMPU_METHOD
/begin COMPU_METHOD _CNV_A_R_LINEAR_____181_CM "" RAT_FUNC "%6.3" "-" COEFFS 0 65536.00270084133 0. 0 0 1 /end COMPU_METHOD
/begin COMPU_METHOD _CNV_A_R_LINEAR_____184_CM "" RAT_FUNC "%6.3" "-" COEFFS 0 32. 0. 0 0 1 /end COMPU_METHOD
/begin COMPU_METHOD _CNV_A_R_LINEAR_____187_CM "" RAT_FUNC "%6.3" "-" COEFFS 0 2.666666666666667 0. 0 0 1 /end COMPU_METHOD
/begin COMPU_METHOD _CNV_A_R_LINEAR_____188_CM "" RAT_FUNC "%6.3" "-" COEFFS 0 682.6666665599934 2.560156259323598e-006 0 0 1 /end COMPU_METHOD
/begin COMPU_METHOD _CNV_A_R_LINEAR_____189_CM "" RAT_FUNC "%6.3" "V" COEFFS 0 51.0204081632653 0. 0 0 1 /end COMPU_METHOD
/begin COMPU_METHOD _CNV_A_R_LINEAR_____190_CM "" RAT_FUNC "%6.3" "V" COEFFS 0 13107.19998965744 0. 0 0 1 /end COMPU_METHOD
/begin COMPU_METHOD _CNV_A_R_LINEAR_____191_CM "" RAT_FUNC "%6.3" "°CRK" COEFFS 0 682.6667400022459 0. 0 0 1 /end COMPU_METHOD
/begin COMPU_METHOD _CNV_A_R_LINEAR_____192_CM "" RAT_FUNC "%6.3" "mg/stk" COEFFS 0 47.18214541280769 -1.080506262951531e-005 0 0 1 /end COMPU_METHOD
/begin COMPU_METHOD _CNV_A_R_LINEAR_____193_CM "" RAT_FUNC "%6.3" "V" COEFFS 0 50. 128. 0 0 1 /end COMPU_METHOD
/begin COMPU_METHOD _CNV_A_R_LINEAR_____196_CM "" RAT_FUNC "%6.3" "1/°C" COEFFS 0 16710013.00390117 0. 0 0 1 /end COMPU_METHOD
/begin COMPU_METHOD _CNV_A_R_LINEAR_____197_CM "" RAT_FUNC "%6.3" "°C" COEFFS 0 64. 0. 0 0 1 /end COMPU_METHOD
/begin COMPU_METHOD _CNV_A_R_LINEAR_____198_CM "" RAT_FUNC "%6.3" "g" COEFFS 0 36.00036915004301 0. 0 0 1 /end COMPU_METHOD
/begin COMPU_METHOD _CNV_A_R_LINEAR_____199_CM "" RAT_FUNC "%6.3" "%/s" COEFFS 0 0.1024000000600009 0. 0 0 1 /end COMPU_METHOD
/begin COMPU_METHOD _CNV_A_R_LINEAR_____204_CM "" RAT_FUNC "%6.3" "°C" COEFFS 0 16. 4370.4 0 0 1 /end COMPU_METHOD
/begin COMPU_METHOD _CNV_A_R_LINEAR_____207_CM "" RAT_FUNC "%6.3" "kg/h" COEFFS 0 32. 0. 0 0 1 /end COMPU_METHOD
/begin COMPU_METHOD _CNV_S_4_RANGE_C_ST_208_CM "" TAB_VERB "%6.3" "-" COMPU_TAB_REF _CNV_S_4_RANGE_C_ST_208 /end COMPU_METHOD
/begin COMPU_VTAB _CNV_S_4_RANGE_C_ST_208 "" TAB_VERB 4 0 "NONE" 1 "VLS" 2 "T_RGN" 3 "T_RGN_2" /end COMPU_VTAB
/begin COMPU_METHOD _CNV_S_4_RANGE_C_ST_209_CM "" TAB_VERB "%6.3" "-" COMPU_TAB_REF _CNV_S_4_RANGE_C_ST_209 /end COMPU_METHOD
/begin COMPU_VTAB _CNV_S_4_RANGE_C_ST_209 "" TAB_VERB 4 0 "NONE" 1 "VLS_MAF" 2 "T_RGN" 3 "T_RGN_2" /end COMPU_VTAB
/begin COMPU_METHOD _CNV_S_3_RANGE_C_ST_210_CM "" TAB_VERB "%6.3" "-" COMPU_TAB_REF _CNV_S_3_RANGE_C_ST_210 /end COMPU_METHOD
/begin COMPU_VTAB _CNV_S_3_RANGE_C_ST_210 "" TAB_VERB 3 0 "NONE" 1 "IP" 2 "CLC" /end COMPU_VTAB
/begin COMPU_METHOD _CNV_A_R_LINEAR_____211_CM "" RAT_FUNC "%6.3" "mV" COEFFS 0 1. 200. 0 0 1 /end COMPU_METHOD
/begin COMPU_METHOD _CNV_S_4_STATE_RGN__212_CM "" TAB_VERB "%6.3" "-" COMPU_TAB_REF _CNV_S_4_STATE_RGN__212 /end COMPU_METHOD
/begin COMPU_VTAB _CNV_S_4_STATE_RGN__212 "" TAB_VERB 4 0 "H_AMPL" 1 "PARK" 2 "L_AMPL" 3 "PASSIVE" /end COMPU_VTAB
/begin COMPU_METHOD _CNV_A_R_LINEAR_____213_CM "" RAT_FUNC "%6.3" "%/s" COEFFS 0 0.1024000154202376 0. 0 0 1 /end COMPU_METHOD
/begin COMPU_METHOD _CNV_A_R_LINEAR_____214_CM "" RAT_FUNC "%6.3" "%/s" COEFFS 0 0.1024000309618991 128. 0 0 1 /end COMPU_METHOD
/begin COMPU_METHOD _CNV_A_R_LINEAR_____232_CM "" RAT_FUNC "%6.3" "" COEFFS 0 65535. 0. 0 0 1 /end COMPU_METHOD
/begin COMPU_METHOD _CNV_A_R_LINEAR_____255_CM "" RAT_FUNC "%6.3" "" COEFFS 0 64. 0. 0 0 1 /end COMPU_METHOD
/begin COMPU_METHOD _CNV_A_R_LINEAR_____256_CM "" RAT_FUNC "%6.3" "-" COEFFS 0 16383.75 0. 0 0 1 /end COMPU_METHOD
/begin COMPU_METHOD _CNV_A_R_LINEAR_____260_CM "" RAT_FUNC "%6.3" "°TPS/s" COEFFS 0 8.535564853556485e-002 0. 0 0 1 /end COMPU_METHOD
/begin COMPU_METHOD _CNV_A_R_EVAC_LINEA_314_CM "" RAT_FUNC "%6.3" "-" COEFFS 0 16. 0. 0 0 1 /end COMPU_METHOD
/begin COMPU_METHOD _CNV_A_R_LINEAR_____465_CM "" RAT_FUNC "%6.3" "-" COEFFS 0 2. 0. 0 0 1 /end COMPU_METHOD
/begin COMPU_METHOD _CNV_A_R_LINEAR_____466_CM "" RAT_FUNC "%6.3" "-" COEFFS 0 16383.96875 0. 0 0 1 /end COMPU_METHOD
/begin COMPU_METHOD _CNV_A_R_LINEAR_____471_CM "" RAT_FUNC "%6.3" "-" COEFFS 0 524280. 0. 0 0 1 /end COMPU_METHOD
/begin COMPU_METHOD _CNV_A_R_LINEAR_____489_CM "" RAT_FUNC "%6.3" "-" COEFFS 0 655.3599999999997 0. 0 0 1 /end COMPU_METHOD
/begin COMPU_METHOD _CNV_A_R_LINEAR_____490_CM "" RAT_FUNC "%6.3" "°C" COEFFS 0 0.25 0. 0 0 1 /end COMPU_METHOD
/begin COMPU_METHOD _CNV_A_R_LINEAR_____492_CM "" RAT_FUNC "%6.3" "mg/s" COEFFS 0 64. 0. 0 0 1 /end COMPU_METHOD
/begin COMPU_METHOD _CNV_A_R_LINEAR_____495_CM "" RAT_FUNC "%6.3" "mg" COEFFS 0 6.25 0. 0 0 1 /end COMPU_METHOD
/begin COMPU_METHOD _CNV_S_4_STATE_NOX__521_CM "" TAB_VERB "%6.3" "-" COMPU_TAB_REF _CNV_S_4_STATE_NOX__521 /end COMPU_METHOD
/begin COMPU_VTAB _CNV_S_4_STATE_NOX__521 "" TAB_VERB 4 0 "Passive" 2 "Full_Rgn" 3 "Communication" 4 "O2_STC" /end COMPU_VTAB
/begin COMPU_METHOD _CNV_A_R_LINEAR_____522_CM "" RAT_FUNC "%6.3" "kg/h" COEFFS 0 4. 0. 0 0 1 /end COMPU_METHOD
/begin COMPU_METHOD _CNV_S_4_STATE_SENS_523_CM "" TAB_VERB "%6.3" "-" COMPU_TAB_REF _CNV_S_4_STATE_SENS_523 /end COMPU_METHOD
/begin COMPU_VTAB _CNV_S_4_STATE_SENS_523 "" TAB_VERB 4 0 "VLS_DOWN" 1 "VLS_NOX_SENS" 2 "LAMB_NOX_SENS" 3 "VLS_NT_DOWN" /end COMPU_VTAB
/begin COMPU_METHOD _CNV_A_R_LINEAR_____533_CM "" RAT_FUNC "%6.3" "g" COEFFS 0 4.517648713261145 0. 0 0 1 /end COMPU_METHOD
/begin COMPU_METHOD _CNV_A_R_LINEAR_____534_CM "" RAT_FUNC "%6.3" "g" COEFFS 0 7.200002636759949 0. 0 0 1 /end COMPU_METHOD
/begin RECORD_LAYOUT _REC_VAL_20_u1 FNC_VALUES 1 UBYTE COLUMN_DIR DIRECT /end RECORD_LAYOUT
/begin RECORD_LAYOUT _REC_VAL_20_u2 FNC_VALUES 1 UWORD COLUMN_DIR DIRECT /end RECORD_LAYOUT
/begin RECORD_LAYOUT _REC_AXS_20_u1 NO_AXIS_PTS_X 1 UBYTE AXIS_PTS_X 2 UBYTE INDEX_INCR DIRECT /end RECORD_LAYOUT
/begin RECORD_LAYOUT _REC_MAP_20_u2_u1_u1 FNC_VALUES 1 UWORD COLUMN_DIR DIRECT /end RECORD_LAYOUT
/begin RECORD_LAYOUT _REC_CUR_20_u1_u1 FNC_VALUES 1 UBYTE COLUMN_DIR DIRECT /end RECORD_LAYOUT
/begin RECORD_LAYOUT _REC_VAL_20_s2 FNC_VALUES 1 SWORD COLUMN_DIR DIRECT /end RECORD_LAYOUT
/begin RECORD_LAYOUT _REC_AXS_20_u2 NO_AXIS_PTS_X 1 UWORD AXIS_PTS_X 2 UWORD INDEX_INCR DIRECT /end RECORD_LAYOUT
/begin RECORD_LAYOUT _REC_CUR_20_u2_u1 FNC_VALUES 1 UWORD COLUMN_DIR DIRECT /end RECORD_LAYOUT
/begin RECORD_LAYOUT _REC_CUR_20_u2_u2 FNC_VALUES 1 UWORD COLUMN_DIR DIRECT /end RECORD_LAYOUT
/begin RECORD_LAYOUT _REC_VAL_20_s1 FNC_VALUES 1 SBYTE COLUMN_DIR DIRECT /end RECORD_LAYOUT
/begin RECORD_LAYOUT _REC_MAP_20_u2_u1_u2 FNC_VALUES 1 UWORD COLUMN_DIR DIRECT /end RECORD_LAYOUT
/begin RECORD_LAYOUT _REC_CUR_20_u1_u2 FNC_VALUES 1 UBYTE COLUMN_DIR DIRECT /end RECORD_LAYOUT
/begin RECORD_LAYOUT _REC_MAP_20_u1_u2_u2 FNC_VALUES 1 UBYTE COLUMN_DIR DIRECT /end RECORD_LAYOUT
/begin RECORD_LAYOUT _REC_MAP_20_u1_u1_u1 FNC_VALUES 1 UBYTE COLUMN_DIR DIRECT /end RECORD_LAYOUT
/begin RECORD_LAYOUT _REC_MAP_20_u1_u2_u1 FNC_VALUES 1 UBYTE COLUMN_DIR DIRECT /end RECORD_LAYOUT
/begin RECORD_LAYOUT _REC_MAP_20_u1_u1_u2 FNC_VALUES 1 UBYTE COLUMN_DIR DIRECT /end RECORD_LAYOUT
/begin RECORD_LAYOUT _REC_CUR_20_s2_u1 FNC_VALUES 1 SWORD COLUMN_DIR DIRECT /end RECORD_LAYOUT
/begin FUNCTION IGA_Basic_ignition_angle_at_start "_Basic ignition angle at start"
 /begin DEF_CHARACTERISTIC ip_iga_st_bas_opm_1 ip_iga_st_cyc_st_cor_opm_1 ip_iga_st_amp_cor_opm_1 ip_iga_st_bas_opm_2 ip_iga_st_cyc_st_cor_opm_2 ip_iga_st_amp_cor_opm_2 ip_iga_st_tia_cor_opm_1 ip_iga_st_tia_cor_opm_2 /end DEF_CHARACTERISTIC
 /begin OUT_MEASUREMENT iga_st /end OUT_MEASUREMENT
/end FUNCTION
/begin FUNCTION IGA_KnockControl "_KnockControl"
 /begin DEF_CHARACTERISTIC ip_maf_min_knk__n__tco id_iga_dec_knk_1__n id_iga_dec_knk_2__n id_n_grd_max_knk__n ip_iga_inc_knk__n c_fac_tra_knk c_iga_dif_min_max_knk c_iga_lgrd_3 c_maf_iga_hys_knk c_n_iga_hys_knk c_nl_crlc c_nl_crlc_tra id_cycnr_fac_tra_knk__n ip_knkwb_1__n__maf ip_gain_knk_1__n__maf ip_fac_thd_knk_0__n__maf ip_fac_thd_knk_1__n__maf ip_fac_thd_knk_2__n__maf ip_fac_thd_knk_3__n__maf ip_fac_thd_knk_4__n__maf ip_fac_thd_knk_5__n__maf c_nl_min id_maf_dif_tra_knk__n ip_iga_bas_max_knk__n__maf ip_iga_ofs_max_knk__n__maf ip_fac_iga_max_knk__tco__tia ldp_tco__maf_min_knk ldpm_n_3_9 c_knk_thd_max ldpm_n_iga_ad ldpm_maf_iga_ad ldpm_n_knkwb ldpm_maf_knkwb ldpm_n_fil_frq_knk id_fil_frq_knk_0__n id_fil_frq_knk_1__n id_fil_frq_knk_2__n id_fil_frq_knk_3__n id_fil_frq_knk_4__n id_fil_frq_knk_5__n ip_knkwb_2__n__maf ip_knkwb_3__n__maf ip_knkwb_4__n__maf ip_knkwb_5__n__maf ip_knkwe_0__n__maf ip_knkwe_1__n__maf ip_knkwe_2__n__maf ip_knkwe_3__n__maf ip_knkwe_4__n__maf ip_knkwe_5__n__maf ip_gain_knk_0__n__maf ip_gain_knk_2__n__maf ip_gain_knk_3__n__maf ip_gain_knk_4__n__maf ip_gain_knk_5__n__maf ip_knkwb_0__n__maf id_itc_knk_0__n__maf id_itc_knk_1__n__maf id_itc_knk_2__n__maf id_itc_knk_3__n__maf id_itc_knk_4__n__maf id_itc_knk_5__n__maf c_knks_1_diag c_knks_2_diag ip_knk_thd_add_n c_knks_rel_ini /end DEF_CHARACTERISTIC
 /begin OUT_MEASUREMENT iga_knk[0] iga_knk[1] iga_knk[2] iga_knk[3] iga_knk[4] iga_knk[5] knk_thd[0] knk_thd[1] knk_thd[2] knk_thd[3] knk_thd[4] knk_thd[5] knks_cmd_fil[0] knks_cmd_fil[1] knks_cmd_fil[2] knks_cmd_fil[3] knks_cmd_fil[4] knks_cmd_fil[5] knkwb[0] knkwb[1] knkwb[2] knkwb[3] knkwb[4] knkwb[5] knkwe[0] knkwe[1] knkwe[2] knkwe[3] knkwe[4] knkwe[5] lv_knk_ctl_ena lv_knk_tra_maf n_knk nl[0] nl[1] nl[2] nl[3] nl[4] nl[5] lv_knk_tra_n iga_adj_knk[0] iga_adj_knk[1] iga_adj_knk[2] iga_adj_knk[3] iga_adj_knk[4] iga_adj_knk[5] iga_adj_max_knk iga_mv_adj_knk cyl_id_knk lv_knk iga_mv_knk fac_iga_max_knk knks_cmd_gain[0] knks_cmd_gain[1] knks_cmd_gain[2] knks_cmd_gain[3] knks_cmd_gain[4] knks_cmd_gain[5] knks_cmd_int[0] knks_cmd_int[1] knks_cmd_int[2] knks_cmd_int[3] knks_cmd_int[4] knks_cmd_int[5] knks[0] knks[1] knks[2] knks[3] knks[4] knks[5] maf_knk knks_1_diag knks_2_diag knk_ctl_dis knks_rel_nl[0] knks_rel_nl[1] knks_rel_nl[2] knks_rel_nl[3] knks_rel_nl[4] knks_rel_nl[5] /end OUT_MEASUREMENT
/end FUNCTION
/begin FUNCTION IGA_Ignition_angle_correction_due_to_EGR "_Ignition angle correction due to EGR"
 /begin DEF_CHARACTERISTIC ip_fac_rate_egr_afl ip_fac_rate_egr_s ip_iga_egr_s ip_fac_iga_bas_egr_lamb ip_iga_bas_egr ip_iga_bas_egr_fac__n__maf /end DEF_CHARACTERISTIC
 /begin OUT_MEASUREMENT iga_bas_egr_cor_hom iga_bas_egr_cor_s iga_bas_egr_cor egr_ratio_cor_2 /end OUT_MEASUREMENT
/end FUNCTION
/begin FUNCTION IGA_Minimum_IGA_limitation_for_exhaust_gas_temperature_protection "_Minimum IGA limitation for exhaust gas temperature protection"
 /begin DEF_CHARACTERISTIC c_teg_max_iga_hys c_teg_max_iga ip_iga_dif_min_teg_h_rng__teg ip_iga_dif_min_teg__teg /end DEF_CHARACTERISTIC
 /begin OUT_MEASUREMENT iga_min_teg_h_rng iga_dif_min_teg_h_rng teg_dyn_hys teg_cat_up_mdl_max iga_min_teg iga_dif_min_teg /end OUT_MEASUREMENT
/end FUNCTION
/begin FUNCTION IGA_Load_dynamics_correction "_Load dynamics correction"
 /begin OUT_MEASUREMENT lv_ad_clr_ron lv_iga_tra_knk iga_is_tq_knk iga_mv_adj_knk_cus /end OUT_MEASUREMENT
/end FUNCTION
/begin FUNCTION C_7_INJ "C_7_INJ"
 /begin SUB_FUNCTION INJ_General_Calculation_of_Fuel_Inj_Time INJ_Warm_up_correction INJ_Cylinder_shut_off INJ_Injection_fuel_setpoint_for_homogeneous_mode INJ_Lambda_coordination INJ_Lambda_Catalyst_overheating_prevention INJ_Basic_lambda_setpoint INJ_Lambda_setpoint_for_catalyst_regeneration INJ_Injection_Time_Correction_by_the_Application_System INJ_Exhaust_Gas_temperature_model INJ_Catalyst_enrichment_function INJ_Application_incidences_for_catalyst_enrichment_function INJ_Lambda_stimulation_for_a_lambda_controller_with_an_UEGO_sensor INJ_Forced_stimulation_for_a_lambda_controller_with_an_UEGO_sensor INJ_Application_Incidences_for_the_Cylinder_Individual_Lambda_Control INJ_Restart_function INJ_Detection_of_limited_dynamic_condition_for_dynamic_fuel_trim INJ_Application_incidence_exhaust_gas_temperature_model INJ_Conditioning_of_catalyst_O2_loading INJ_Application_Incidences_for_conditioning_of_catalyst_O2_loading INJ_Downstream_oxygen_sensor_internal_resistance_determination INJ_Inhibition_Conditions_for_OBDII_oxygen_downstream_heater_diagnosis INJ_Seq_FCUT_And_Restart_Fuel_Feed INJ_Application_incidence_NOx_catalyst_management INJ_NOx_catalyst_management___auxiliary_functionalities INJ_NOx_Catalyst_Monolith_Temperature_Model INJ_NOx_Cat_Monolith_Temp_Model__AI INJ_NOx_tailpipe_emission INJ_NOx_Cat_Sulphur_Model INJ_NOx_Cat_Model_Control INJ_NOx_Cat_Desulfation_Lambda_Stimulation INJ_NOx_Engine_out_Emission_Adaptation INJ_NOx_catalyst_management_catalyst_states INJ_NOx_catalyst_desulfation INJ_NOx_engine_out_emission_stratified_mode INJ_NOx___Sensor_function INJ_NOx_catalyst_Oxygen_storage_capacity_adaptation INJ_Application_Incidence_for_NOx_Cat_Desulfation_Lambda_Stimulation INJ_NOx_engine_out_emission_homogeneous_mode INJ_NOx_catalyst_desulfation___heating_activation INJ_Application_incidence_for_NOx_cat_aging INJ_NOx_Catalyst_aging INJ_Phase_Shift_Adapt INJ_Cyl_Bal_via_Lam_Sens INJ_Coord_Inj_Time_Cor_Fac_CYLB INJ_Cyl_Bal_via_Mul_TI_Intervent INJ_Cyl_Bal_via_Add_TI_Intervent /end SUB_FUNCTION
/end FUNCTION
/begin FUNCTION INJ_General_Calculation_of_Fuel_Inj_Time "_General Calculation of Fuel Inj Time"
 /begin DEF_CHARACTERISTIC ip_ti_cast_opm_2 ip_ti_deac_cast_opm_2 ip_ti_cast_opm_1 ip_ti_deac_cast_opm_1 id_ti_cast_opm_av id_ti_cast_opm_req ip_fac_rest_ti_cast_opm_1 ip_fac_rest_ti_cast_opm_2 c_mff_fac /end DEF_CHARACTERISTIC
 /begin OUT_MEASUREMENT lv_ast_end ti_cast ti_cast_opm_1 ti_cast_opm_2 ti_cast_sel lv_ti_cast_opm_rls lv_ti_cast_opm_sel_1 lv_ti_cast_opm_sel_2 /end OUT_MEASUREMENT
/end FUNCTION
/begin FUNCTION INJ_Warm_up_correction "_Warm up correction"
 /begin DEF_CHARACTERISTIC ip_ti_wup_opm_1 ip_ti_tco_wup_opm_1 ip_ti_fac_n_map ip_ti_fac_tia_toil ip_ti_fac_tco ip_fac_ti_vo_wup ip_fac_ti_tco_wup_opm_1 ip_fac_ti_tco_wup_opm_2 ip_ti_tco_wup_opm_2 ip_ti_wup_opm_2 id_ti_wup_1_opm_av id_ti_wup_1_opm_req /end DEF_CHARACTERISTIC
 /begin OUT_MEASUREMENT ti_wup_1 ti_wup ti_temp ti_wup_1_opm_1 lv_ti_wup_1_opm_sel_2 lv_ti_wup_1_opm_rls ti_wup_1_opm_2 ti_wup_1_add ti_wup_1_add_opm_1 ti_wup_1_add_opm_2 lv_ti_wup_1_opm_sel_1 lv_ti_wup_1_add_opm_sel_1 lv_ti_wup_1_add_opm_sel_2 lv_ti_wup_1_add_opm_rls /end OUT_MEASUREMENT
/end FUNCTION
/begin FUNCTION INJ_Cylinder_shut_off "_Cylinder shut off" /begin OUT_MEASUREMENT inh_iv_amt /end OUT_MEASUREMENT /end FUNCTION
/begin FUNCTION INJ_Injection_fuel_setpoint_for_homogeneous_mode "_Injection fuel setpoint for homogeneous mode"
 /begin OUT_MEASUREMENT mff_sp_hom[0] mff_sp_hom[1] mff_sp_fup_ctl mff_sp_hom_eng[0] mff_sp_hom_eng[1] mff_sp_mv mff_sp[0] mff_sp[1] /end OUT_MEASUREMENT
/end FUNCTION
/begin FUNCTION INJ_Lambda_coordination "_Lambda coordination" /begin DEF_CHARACTERISTIC c_lamb_bas_cor_min /end DEF_CHARACTERISTIC
 /begin OUT_MEASUREMENT lamb_sp lamb_bas_1 lamb_bas_2 lamb_bas_h_res_1 lamb_bas_h_res_2 /end OUT_MEASUREMENT
/end FUNCTION
/begin FUNCTION INJ_Lambda_Catalyst_overheating_prevention "_Lambda Catalyst overheating prevention"
 /begin DEF_CHARACTERISTIC c_lamb_cop_min c_lamb_cop_pas c_lamb_teg_cat_up_mdl_cop_i c_lamb_teg_cat_down_cop_i c_lamb_tnt_mdl_h_cop_i c_teg_cat_up_mdl_thd_min_cop c_tnt_mdl_h_thd_min_cop c_tnt_mdl_h_thd_cop c_tnt_mdl_h_thd_max_cop c_teg_cat_down_thd_min_cop c_teg_cat_up_mdl_thd_cop c_teg_cat_down_thd_cop c_teg_cat_up_mdl_thd_max_cop c_teg_cat_down_thd_max_cop /end DEF_CHARACTERISTIC
 /begin OUT_MEASUREMENT lam_bank_1.cat_prev.lamb_cop_cus lam_bank_1.cat_prev.lv_lamb_cop_cus lam_bank_1.cat_prev.lamb_teg_cat_up_mdl_cop lam_bank_1.cat_prev.lamb_teg_cat_down_cop lam_bank_1.cat_prev.lamb_tnt_mdl_h_cop lam_bank_1.cat_prev.lv_teg_cat_up_mdl_cop lam_bank_1.cat_prev.lv_teg_cat_down_cop lam_bank_1.cat_prev.lv_tnt_mdl_h_cop lam_bank_1.cat_prev.teg_cat_down lam_bank_2.cat_prev.lamb_cop_cus lam_bank_2.cat_prev.lv_lamb_cop_cus lam_bank_2.cat_prev.lamb_teg_cat_up_mdl_cop lam_bank_2.cat_prev.lamb_teg_cat_down_cop lam_bank_2.cat_prev.lamb_tnt_mdl_h_cop lam_bank_2.cat_prev.lv_teg_cat_up_mdl_cop lam_bank_2.cat_prev.lv_teg_cat_down_cop lam_bank_2.cat_prev.lv_tnt_mdl_h_cop lam_bank_2.cat_prev.teg_cat_down /end OUT_MEASUREMENT
/end FUNCTION
/begin FUNCTION INJ_Basic_lambda_setpoint "_Basic lambda setpoint" /begin OUT_MEASUREMENT lamb_hom_afl /end OUT_MEASUREMENT /end FUNCTION
/begin FUNCTION INJ_Lambda_setpoint_for_catalyst_regeneration "_Lambda setpoint for catalyst regeneration"
 /begin DEF_CHARACTERISTIC lc_rpu_lamb_rgn_1 c_lamb_purge_l_ampl c_lamb_pas_bas c_maf_kgh_thr_max c_maf_kgh_thr_min c_state_lamb_rgn_2_h_ampl c_state_lamb_rgn_l_ampl c_state_lamb_rgn_l_ampl_bas c_state_lamb_rgn_1_h_ampl c_t_purge_h_ampl c_t_purge_l_ampl c_vls_park_t_rgn_2_deac ldp_vls_h_ampl_2_ip_lamb_fac ldp_t_rgn_2_l_ampl_ip_lamb_fac ldp_vls_h_ampl_1_ip_lamb_fac ldp_vls_park_1_ip_lamb_fac ldp_t_rgn_1_park_ip_lamb_fac ldp_t_rgn_2_park_ip_lamb_fac ip_lamb_fac_park_2_t_rgn_2 ldp_vls_l_ampl_2_ip_lamb_fac ldp_vls_l_ampl_1_ip_lamb_fac ldp_t_rgn_1_l_ampl_ip_lamb_fac ldp_maf_kgh_l_ampl_ip_lamb_fac ldp_maf_kgh_hom_ip_lamb_bas c_lamb_purge_h_ampl c_lamb_rgn_h_ampl_bas c_lamb_rgn_l_ampl_bas c_lamb_rgn_l_ampl_bas_max c_state_rgn_1_park c_state_rgn_2_park c_state_rgn_ini_1 c_state_rgn_ini_2 ip_lamb_fac_h_ampl_2_vls ip_lamb_fac_l_ampl_2_vls ip_lamb_fac_l_ampl_t_rgn_2 ip_lamb_fac_l_ampl_t_rgn_1 ip_lamb_fac_h_ampl_1_vls ip_lamb_fac_park_1_vls ip_lamb_fac_park_1_t_rgn ip_lamb_fac_l_ampl_vls_maf_kgh ip_lamb_rgn_l_ampl_bas c_lamb_park_bas c_ctr_rgn_swi_act c_ctr_rgn_swi_deac /end DEF_CHARACTERISTIC
 /begin OUT_MEASUREMENT t_rgn t_rgn_2 lv_lamb_park_afl_deac lv_lamb_sp_swi maf_kgh_hom state_rgn[0] state_rgn[1] lamb_rgn[0] lamb_rgn[1] lamb_rgn_fac[0] lamb_rgn_fac[1] lamb_rgn_l_ampl_bas ctr_rgn_cyc_lamb_rgn /end OUT_MEASUREMENT
/end FUNCTION
/begin FUNCTION INJ_Injection_Time_Correction_by_the_Application_System "_Injection Time Correction by the Application System"
 /begin OUT_MEASUREMENT lv_inh_lscl_cus[0] lv_inh_lscl_cus[1] lamb_sp_ofs_ext[0] lamb_sp_ofs_ext[1] t_mff_ad_min /end OUT_MEASUREMENT
/end FUNCTION
/begin FUNCTION INJ_Exhaust_Gas_temperature_model "_Exhaust Gas temperature model"
 /begin DEF_CHARACTERISTIC id_ctr_cold_st ldp_ctr_cold_st__ctr_cold_st ip_int_teg_thd ip_int_teg_cat_down_thd ldpm_tco_st_1_extd ldpm_tia_1_extd ip_int_teg ldp_eff_iga_av__int_teg ldp_maf_kgh__int_teg /end DEF_CHARACTERISTIC
 /begin OUT_MEASUREMENT lv_puc_inh_temp_cat ctr_cold_st int_teg_maf lv_teg_cat_down_min_thd_1 lv_teg_min_thd_1 temp_cat_dyn_mdl[0] temp_cat_dyn_mdl[1] temp_cat_stat_mdl[0] temp_cat_stat_mdl[1] /end OUT_MEASUREMENT
/end FUNCTION
/begin FUNCTION INJ_Catalyst_enrichment_function "_Catalyst enrichment function" /end FUNCTION
/begin FUNCTION INJ_Application_incidences_for_catalyst_enrichment_function "_Application incidences for catalyst enrichment function" /end FUNCTION
/begin FUNCTION INJ_Lambda_stimulation_for_a_lambda_controller_with_an_UEGO_sensor "_Lambda stimulation for a lambda-controller with an UEGO-sensor" /end FUNCTION
/begin FUNCTION INJ_Forced_stimulation_for_a_lambda_controller_with_an_UEGO_sensor "_Forced stimulation for a lambda-controller with an UEGO-sensor" /end FUNCTION
/begin FUNCTION INJ_Application_Incidences_for_the_Cylinder_Individual_Lambda_Control "_Application Incidences for the Cylinder Individual Lambda Control"
 /begin DEF_CHARACTERISTIC c_maf_lam_cyl_min c_maf_lam_cyl_max c_n_lam_cyl_max c_amp_lam_cyl_min c_fac_mv_ls_up_dyn_lam_cyl_thd c_cl_mmv_lam_cyl_max lc_lam_cyl_ena_cdn_man c_teg_cat_up_mdl_lam_cyl_max c_n_lam_cyl_min c_n_lam_cyl_min_eol c_n_lam_cyl_max_eol c_wgpwm_max_lam_cyl_sel /end DEF_CHARACTERISTIC
 /begin OUT_MEASUREMENT lv_lam_cyl_ena_2 pha_shift_cam_ex_1 pha_shift_cam_ex_2 lv_lam_cyl_ena_1 lv_lam_cyl_ena_cyl_bal_dc_1 lv_lam_cyl_ena_cyl_bal_dc_2 lv_n_cdn_lam_cyl_ena /end OUT_MEASUREMENT
/end FUNCTION
/begin FUNCTION INJ_Restart_function "_Restart function" /begin DEF_CHARACTERISTIC ip_rest ip_fac_rest ip_fac_stall ip_fac_stnd_rest /end DEF_CHARACTERISTIC /begin OUT_MEASUREMENT fac_st_rest /end OUT_MEASUREMENT /end FUNCTION
/begin FUNCTION INJ_Detection_of_limited_dynamic_condition_for_dynamic_fuel_trim "_Detection of limited dynamic condition for dynamic fuel trim"
 /begin DEF_CHARACTERISTIC c_maf_crlc_dly c_lam_mv_crlc_dly c_n_dyw_dly c_maf_dyw_dly c_lam_mv_dyw_dly c_n_crlc_dly c_pv_av_grd_dec_dly c_pv_av_grd_sum_max_dly c_pv_av_grd_sum_min_dly c_t_pv_av_grd_dec_sum_dly c_pv_av_grd_min_sum_dly c_maf_int_min_ldc_dly /end DEF_CHARACTERISTIC
 /begin OUT_MEASUREMENT lam_bank_1.lam_dlyl.bf.lv_ldc_dly lam_bank_1.lam_dlyl.bf.lv_lam_mv_ldc_dly lam_bank_1.lam_dlyl.lam_mv_mmv_dly lam_bank_1.lam_dlyl.maf_int_ldc_dly lam_bank_1.lam_dlyl.pv_av_grd_sum_dly lam_bank_2.lam_dlyl.bf.lv_ldc_dly lam_bank_2.lam_dlyl.bf.lv_lam_mv_ldc_dly lam_bank_2.lam_dlyl.lam_mv_mmv_dly lam_bank_2.lam_dlyl.maf_int_ldc_dly lam_bank_2.lam_dlyl.pv_av_grd_sum_dly maf_mmv_dly n_mmv_dly lv_n_ldc_dly lv_maf_ldc_dly /end OUT_MEASUREMENT
/end FUNCTION
/begin FUNCTION INJ_Application_incidence_exhaust_gas_temperature_model "_Application incidence exhaust gas temperature model"
 /begin OUT_MEASUREMENT nr_cyl_scc_teg[0] nr_cyl_scc_teg[1] lv_teg_min_thd[0] lv_teg_min_thd[1] lv_teg_cat_down_min_thd[0] lv_teg_cat_down_min_thd[1] /end OUT_MEASUREMENT
/end FUNCTION
/begin FUNCTION INJ_Conditioning_of_catalyst_O2_loading "_Conditioning of catalyst O2 loading" /end FUNCTION
/begin FUNCTION INJ_Application_Incidences_for_conditioning_of_catalyst_O2_loading "_Application Incidences for conditioning of catalyst O2 loading" /end FUNCTION
/begin FUNCTION INJ_Downstream_oxygen_sensor_internal_resistance_determination "_Downstream oxygen sensor internal resistance determination" /end FUNCTION
/begin FUNCTION INJ_Inhibition_Conditions_for_OBDII_oxygen_downstream_heater_diagnosis "Inhibition Conditions for OBDII oxygen downstream heater diagnosis" /begin DEF_CHARACTERISTIC c_tco_min_obd2_lsh_down /end DEF_CHARACTERISTIC /end FUNCTION
/begin FUNCTION INJ_Seq_FCUT_And_Restart_Fuel_Feed ""
 /begin DEF_CHARACTERISTIC ldp_case_sel_cyl__pat_sel_cyl ldp_nr_sel_cyl__pat_sel_cyl ldp_gr_mt__t_osc_dt id_pat_sel_cyl id_t_osc_dt c_tps_grd_max_sel_rpl c_n_grd_min_sel_ris c_maf_max_sel_rpl c_n_dif_max_sel_ris c_nr_sel_cyl_1 c_nr_sel_cyl_2 c_nr_sel_cyl_3 lc_ena_fcut_aj c_tqi_sp_slow_dif_max /end DEF_CHARACTERISTIC
 /begin OUT_MEASUREMENT lv_sel_cyl nr_pat_sel_cyl t_fcut_aj t_osc_dt nr_sel_cyl case_sel_cyl tqi_sp_slow_dif /end OUT_MEASUREMENT
/end FUNCTION
/begin FUNCTION INJ_Application_incidence_NOx_catalyst_management "_Application incidence NOx catalyst management"
 /begin DEF_CHARACTERISTIC c_tnt_mdl_thd_rgn_not c_tnt_mdl_thd_rgn_not_hys lc_inh_nt_act_off lc_inh_rgn_req_ntld lc_inh_nt_afl_off c_tnt_mdl_nt_stc_max_min c_tnt_mdl_nt_stc_max_max c_tnt_mdl_nt_stc_max_delta c_tnt_mdl_o2_stc_min c_tnt_mdl_o2_stc_max c_tnt_mdl_o2_stc_delta c_vs_o2_stc_min lc_inh_nt_afl lc_inh_req_nox_sens_off c_t_nox_sens_vld_state_rgn_req c_ntld_state_rgn_req lc_tnt_mdl_max_ofs c_vs_tnt_mdl_min c_t_vs_is_nt c_tnt_mdl_max_ofs c_tnt_mdl_h_max_ofs c_nt_sul_min_ofs lc_inh_ntld_req_nox_sens_auth lc_inh_ntld_req_nox_sens_vld lc_inh_rgn_is lc_inh_ntld_rgn_req_afs_swi c_vs_min_rgn /end DEF_CHARACTERISTIC
 /begin OUT_MEASUREMENT lv_inh_nox_sens_rgn /end OUT_MEASUREMENT
/end FUNCTION
/begin FUNCTION INJ_NOx_catalyst_management___auxiliary_functionalities "_NOx catalyst management - auxiliary functionalities"
 /begin DEF_CHARACTERISTIC lc_inh_nt_prj_act lc_inh_nt_stc_max lc_inh_nt_o2_stc lc_nt_prj_act lc_rgn_req_ad_vld_act c_maf_int_puc_o2_stc c_ntl_max_o2_stc c_t_vls_down_secu c_t_nt_ad_com c_vs_min_rgn_ad c_n_32_min_rgn_ad c_maf_min_rgn_ad c_state_sens_afr_ad_1 c_state_sens_afr_ad_2 c_vls_down_afr_o2 c_vls_down_afr_ad_secu c_vls_nox_sens_afr_o2 c_vls_nox_sens_afr_ad_secu c_lamb_nox_sens_afr_o2 c_lamb_nox_sens_afr_ad_secu ldp_t_afl_ntl_dec_int_ofs ip_ntl_dec_int_ofs_t_afl /end DEF_CHARACTERISTIC
 /begin OUT_MEASUREMENT state_nox_prj lv_nt_ad_cmpl lv_nt_ad_vld lv_nt_stc_max_act lv_nt_stc_max_afl_act lv_nt_o2_stc_act lv_nt_prj_act lv_rgn_req_ad lv_rgn_req_ad_vld lv_rgn_cdn_ad lv_inh_rgn_ad lv_sens_afr_ad_secu_1 lv_sens_afr_ad_secu_2 lv_sens_afr_o2_1 lv_sens_afr_o2_2 maf_int_puc_o2_stc t_vls_down_afl_1 t_vls_down_afl_2 t_vls_down_secu_1 t_vls_down_secu_2 t_nt_ad_com ntl_dec_int_ad_1 ntl_dec_int_ad_2 ntl_dec_int_thd /end OUT_MEASUREMENT
/end FUNCTION
/begin FUNCTION INJ_NOx_Catalyst_Monolith_Temperature_Model "_NOx Catalyst Monolith Temperature Model"
 /begin DEF_CHARACTERISTIC c_fac_int_tnt_maf_sa ldpm_tco_st__int_tnt_thd ldpm_teg__int_tnt_thd ip_int_tnt_thd_1__tco_st__teg ip_int_tnt_thd_2__tco_st__teg ldp_ctr_cold_st_nt__tnt_cold_st id_tnt_cold_st__ctr_cold_st_nt ldp_eff_iga_av__int_tnt ldp_maf_kgh__int_tnt ip_int_tnt__eff_iga_av__maf_kgh /end DEF_CHARACTERISTIC
 /begin OUT_MEASUREMENT teg_pcat_down_cor_1 teg_pcat_down_cor_2 int_tnt_maf lv_tnt_min_thd_1 lv_tnt_min_thd_2 fac_int_tnt_maf_sa ctr_cold_st_nt tnt_mdl_1_1 tnt_mdl_1_2 tnt_mdl_2_1 tnt_mdl_2_2 tnt_mdl_mv tnt_mdl_h tnt_mdl_h_1 tnt_mdl_h_2 tnt_mdl_l tnt_mdl_max_avl tnt_mdl_mv_1 tnt_mdl_mv_2 /end OUT_MEASUREMENT
/end FUNCTION
/begin FUNCTION INJ_NOx_Cat_Monolith_Temp_Model__AI "_NOx Cat Monolith Temp Model  AI" /begin OUT_MEASUREMENT teg_pcat_down_add fac_tnt_min_cor_1 fac_tnt_min_cor_2 /end OUT_MEASUREMENT /end FUNCTION
/begin FUNCTION INJ_NOx_tailpipe_emission "_NOx tailpipe emission" /begin DEF_CHARACTERISTIC lc_nox_out_mes_int_act /end DEF_CHARACTERISTIC
 /begin OUT_MEASUREMENT nox_out_mes_int_1 nox_out_mes_int_2 nox_out_mes_1 nox_out_mes_2 /end OUT_MEASUREMENT
/end FUNCTION
/end MODULE
/end PROJECT
