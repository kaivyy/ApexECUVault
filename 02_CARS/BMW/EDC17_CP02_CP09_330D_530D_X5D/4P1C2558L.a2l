ASAP2_VERSION 1 4
/begin PROJECT P_558 "EDC17_CP02"
/begin HEADER "" VERSION "V1C1" PROJECT_NO P_558 /end HEADER
/begin MODULE DIM ""
/begin MOD_COMMON "" BYTE_ORDER MSB_LAST ALIGNMENT_BYTE 1 ALIGNMENT_WORD 2 ALIGNMENT_LONG 4 ALIGNMENT_FLOAT32_IEEE 4 /end MOD_COMMON
/begin CHARACTERISTIC InjCrv_ctATSMISel_C "Selektionsparameter für Arrayelement Ansauglufttemperatur (EngDa_tFld) für die Haupteinspritzung" VALUE 0x8005286C Val_Wu8 2.00000000000 IndSysTempFldSel 0.00 2.00000000000 FORMAT "%13.11" /end CHARACTERISTIC
/begin CHARACTERISTIC InjCrv_ctATSPiISel_C "Selektionsparameter für Arrayelement Ansauglufttemperatur (EngDa_tFld) für die Voreinspritzungen" VALUE 0x80058584 Val_Wu8 2.00000000000 IndSysTempFldSel 0.00 2.00000000000 FORMAT "%13.11" /end CHARACTERISTIC
/begin CHARACTERISTIC InjCrv_dphiMIDyn.Pos_C "/" VALUE 0x8005065C Kw_Ws32 720021.972992 RmpCrsAg_InjCrv 0.00 720021.972992 FORMAT "%13.6" EXTENDED_LIMITS -720021.973327 720021.972992 /end CHARACTERISTIC
/begin CHARACTERISTIC InjCrv_dphiMIDyn.Neg_C "/" VALUE 0x80050660 Kw_Ws32 720021.972992 RmpCrsAg_InjCrv 0.00 720021.972992 FORMAT "%13.6" EXTENDED_LIMITS -720021.973327 720021.972992 /end CHARACTERISTIC
/begin CHARACTERISTIC InjCrv_dpMIDynCorDT1.T1_C "/" VALUE 0x80050664 Kw_Ws32 4294.9672940 TimeDelay_s 0.000002000000001 4294.9672960 FORMAT "%12.7" /end CHARACTERISTIC
/begin CHARACTERISTIC InjCrv_dpMIDynCorDT1.Kd_C "/" VALUE 0x80050668 Kw_Ws32 32767.9999924 Kd_Pres2dpdt -16384.0000000 16383.9999924 FORMAT "%13.7" /end CHARACTERISTIC
/begin CHARACTERISTIC InjCrv_dqFltLowNeg_C "niedriger Schwellwert für Neg. dq für Filter Parameter Auswahl" VALUE 0x8005066C Kw_Ws16 32767.50 InjMassPerSec_20ms -16384.00 16383.50 FORMAT "%8.2" /end CHARACTERISTIC
/begin CHARACTERISTIC InjCrv_dqFltLowPos_C "niedriger Schwellwert für Pos. dq für Filter Parameter Auswahl" VALUE 0x8005066E Kw_Ws16 32767.50 InjMassPerSec_20ms -16384.00 16383.50 FORMAT "%8.2" /end CHARACTERISTIC
/begin CHARACTERISTIC InjCrv_dqFltMidNeg_C "Mittel Schwellwert für Neg. dq für Filter Parameter Auswahl" VALUE 0x80050670 Kw_Ws16 32767.50 InjMassPerSec_20ms -16384.00 16383.50 FORMAT "%8.2" /end CHARACTERISTIC
/begin CHARACTERISTIC InjCrv_dqFltMidPos_C "Mittel Schwellwert für Pos. dq für Filter Parameter Auswahl" VALUE 0x80050672 Kw_Ws16 32767.50 InjMassPerSec_20ms -16384.00 16383.50 FORMAT "%8.2" /end CHARACTERISTIC
/begin CHARACTERISTIC InjCrv_dqSetUnBalMax_C "Obere Begrenzung für PT1 und DT1 filterte Einspritzungquantität" VALUE 0x80050674 Kw_Ws16 32767.50 InjMassPerSec_20ms -16384.00 16383.50 FORMAT "%8.2" /end CHARACTERISTIC
/begin CHARACTERISTIC InjCrv_dqSetUnBalMin_C "Unterere Grenze für PT1 und DT1 filterte Einspritzungquantität" VALUE 0x80050676 Kw_Ws16 32767.50 InjMassPerSec_20ms -16384.00 16383.50 FORMAT "%8.2" /end CHARACTERISTIC
/begin CHARACTERISTIC InjCrv_DT1DQMISOECor2.T1_C "/" VALUE 0x80050678 Kw_Ws32 4294.9672940 TimeDelay_s 0.000002000000001 4294.9672960 FORMAT "%12.7" /end CHARACTERISTIC
/begin CHARACTERISTIC InjCrv_DT1DQMISOECor2.Kd_C "/" VALUE 0x8005067C Kw_Ws32 3276799.99924 Kd_PerSec_20ms -1638400.00000 1638399.99924 FORMAT "%13.5" /end CHARACTERISTIC
/begin CHARACTERISTIC InjCrv_facAPMIDynCor2_CUR "Gewichtungsfaktor von der atmosphärischen Druck für die MI SOE-Korrektur" CURVE 0x80050680 Kl_Xs16_Ws16 7.999878 Fact -4.000000 3.999878 FORMAT "%8.6"
 /begin AXIS_DESCR STD_AXIS EnvP_p Pres_hPa 6 -32768.00 3500.00 FORMAT "%8.2" EXTENDED_LIMITS -32768.00 32767.00 DEPOSIT ABSOLUTE /end AXIS_DESCR
/end CHARACTERISTIC
/begin CHARACTERISTIC InjCrv_facAPPiI1DynCor_CUR "Kennlinie für atmosphärendruckabhängigen Gewichtungsfaktor der Voreinspritzung Pil1" CURVE 0x8007A2E2 Kl_Xs16_Ws16 2.000000 Fact 0.00 2.000000 FORMAT "%8.6" EXTENDED_LIMITS -4.000000 3.999878
 /begin AXIS_DESCR STD_AXIS EnvP_p Pres_hPa 6 0.00 3500.000 FORMAT "%8.3" EXTENDED_LIMITS -32768.00 32767.00 DEPOSIT ABSOLUTE /end AXIS_DESCR
/end CHARACTERISTIC
/begin CHARACTERISTIC InjCrv_facAPPiI1DynQCor_CUR "atmosphärendruckabhängiger Gewichtungsfaktor" CURVE 0x8007A2FC Kl_Xs16_Ws16 2.000000 Fact 0.00 2.000000 FORMAT "%8.6" EXTENDED_LIMITS -4.000000 3.999878
 /begin AXIS_DESCR STD_AXIS EnvP_p Pres_hPa 6 0.00 3500.000 FORMAT "%8.3" EXTENDED_LIMITS -32768.00 32767.00 DEPOSIT ABSOLUTE /end AXIS_DESCR
/end CHARACTERISTIC
/begin CHARACTERISTIC InjCrv_facDQMI1DynCor2_CUR "Gewichtungsfaktor der abgeleiteten Einspritzmenge for S0E Korrektur" CURVE 0x8005069A Kl_Xs16_Ws16 4.000000 Fact -2.000000 2.000000 FORMAT "%8.6" EXTENDED_LIMITS -4.000000 3.999878
 /begin AXIS_DESCR STD_AXIS InjCrv_dqSetUnBalFltLim InjMassPerSec_20ms 6 -16384.00 16383.50 FORMAT "%8.2" DEPOSIT ABSOLUTE /end AXIS_DESCR
/end CHARACTERISTIC
/begin CHARACTERISTIC InjCrv_facDQPiI1DynCor_CUR "Gewichtungskennlinie, abhängig vom Einspritzmengengradianten" CURVE 0x80054278 Kl_Xs16_Ws16 4.000000 Fact -2.000000 2.000000 FORMAT "%8.6" EXTENDED_LIMITS -4.000000 3.999878
 /begin AXIS_DESCR STD_AXIS InjCrv_dqSetUnBalFltLim InjMassPerSec_20ms 6 -16384.00 16383.50 FORMAT "%8.2" DEPOSIT ABSOLUTE /end AXIS_DESCR
/end CHARACTERISTIC
/begin CHARACTERISTIC InjCrv_facDQPiI1DynQCor_CUR "Korrekturfaktor für dynamische Korrektur der Quantität der Einspritzung PII1" CURVE 0x80054292 Kl_Xs16_Ws16 4.000000 Fact -2.000000 2.000000 FORMAT "%8.6" EXTENDED_LIMITS -4.000000 3.999878
 /begin AXIS_DESCR STD_AXIS InjCrv_dqSetUnBalFltLim InjMassPerSec_20ms 6 -16384.00 16383.50 FORMAT "%8.2" DEPOSIT ABSOLUTE /end AXIS_DESCR
/end CHARACTERISTIC
/begin CHARACTERISTIC InjCrv_facETMIDynCor2_CUR "weighting factor by engine temperature for SOE correction" CURVE 0x800506B4 Kl_Xs16_Ws16 7.999878 Fact -4.000000 3.999878 FORMAT "%8.6"
 /begin AXIS_DESCR STD_AXIS InjSys_tEng Temp_Cels 6 -3549.940 3003.560 FORMAT "%8.3" DEPOSIT ABSOLUTE /end AXIS_DESCR
/end CHARACTERISTIC
/begin CHARACTERISTIC InjCrv_facETPiI1DynCor_CUR "Kennlinie für motortemperaturabhängigen Gewichtungsfaktor der Voreinspritzung Pil1" CURVE 0x8007A316 Kl_Xs16_Ws16 2.000000 Fact 0.00 2.000000 FORMAT "%8.6" EXTENDED_LIMITS -4.000000 3.999878
 /begin AXIS_DESCR STD_AXIS InjSys_tEng Temp_Cels 6 -50.14000 199.8600 FORMAT "%8.4" EXTENDED_LIMITS -3549.940 3003.560 DEPOSIT ABSOLUTE /end AXIS_DESCR
/end CHARACTERISTIC
/begin CHARACTERISTIC InjCrv_facETPiI1DynQCor_CUR "Kennlinie für motortemperaturabhängigen Gewichtungsfaktor" CURVE 0x8007A330 Kl_Xs16_Ws16 2.000000 Fact 0.00 2.000000 FORMAT "%8.6" EXTENDED_LIMITS -4.000000 3.999878
 /begin AXIS_DESCR STD_AXIS InjSys_tEng Temp_Cels 6 -50.14000 199.8600 FORMAT "%8.4" EXTENDED_LIMITS -3549.940 3003.560 DEPOSIT ABSOLUTE /end AXIS_DESCR
/end CHARACTERISTIC
/begin CHARACTERISTIC InjCrv_facIAMIDynCor2_CUR "weighting factor by intake air temperature for SOE correction" CURVE 0x800506CE Kl_Xs16_Ws16 7.999878 Fact -4.000000 3.999878 FORMAT "%8.6"
 /begin AXIS_DESCR STD_AXIS InjCrv_tAirMI Temp_Cels 6 -3549.940 3003.560 FORMAT "%8.3" DEPOSIT ABSOLUTE /end AXIS_DESCR
/end CHARACTERISTIC
/begin CHARACTERISTIC InjCrv_facIAPiI1DynCor_CUR "Kennlinie für ansauglufttemperaturabhängigen Gewichtungsfaktor der Voreinspritzung PiI1" CURVE 0x8007A34A Kl_Xs16_Ws16 2.000000 Fact 0.00 2.000000 FORMAT "%8.6" EXTENDED_LIMITS -4.000000 3.999878
 /begin AXIS_DESCR STD_AXIS InjCrv_tAirPiI Temp_Cels 6 -50.14000 199.8600 FORMAT "%8.4" EXTENDED_LIMITS -3549.940 3003.560 DEPOSIT ABSOLUTE /end AXIS_DESCR
/end CHARACTERISTIC
/begin CHARACTERISTIC InjCrv_facMI1ATSSOECor0Rgn_GCUR "ansauglufttemperaturabhängige Ansteuerbeginnkorrekturgruppenkennlinie 1 für MI1 im Regenerationsbetrieb" CURVE 0x80052958 CurG_Ws16 1.000000 Fact 0.00 1.000000 FORMAT "%8.6" EXTENDED_LIMITS -4.000000 3.999878
 /begin AXIS_DESCR COM_AXIS InjCrv_tAirMI Temp_Cels 12 -50.14000 199.8600 FORMAT "%8.4" EXTENDED_LIMITS -3549.940 3003.560 AXIS_PTS_REF InjCrv_facMI1ATSSOECorRgn_AXIS /end AXIS_DESCR
/end CHARACTERISTIC
/begin CHARACTERISTIC InjCrv_facMI1ATSSOECor1Rgn_GCUR "ansauglufttemperaturabhängige Ansteuerbeginnkorrekturgruppenkennlinie 2 für MI1 im Regenerationsbetrieb" CURVE 0x80052970 CurG_Ws16 1.000000 Fact 0.00 1.000000 FORMAT "%8.6" EXTENDED_LIMITS -4.000000 3.999878
 /begin AXIS_DESCR COM_AXIS InjCrv_tAirMI Temp_Cels 12 -50.14000 199.8600 FORMAT "%8.4" EXTENDED_LIMITS -3549.940 3003.560 AXIS_PTS_REF InjCrv_facMI1ATSSOECorRgn_AXIS /end AXIS_DESCR
/end CHARACTERISTIC
/begin AXIS_PTS InjCrv_facMI1ATSSOECorRgn_AXIS "Stützstellenverteilung für die Gruppenkennlinien InjCrv_facMI1ATSSOECor%Rgn_GCUR" 0x80052988 InjCrv_tAirMI Axis_Xs16 250.0000 Temp_Cels 12 -50.14000 199.8600 FORMAT "%8.4" EXTENDED_LIMITS -3549.940 3003.560 DEPOSIT ABSOLUTE /end AXIS_PTS
/begin CHARACTERISTIC InjCrv_facMI1ETSSOECor0Rgn_GCUR "motortemperaturabhängige Ansteuerbeginnkorrekturgruppenkennlinie 1 für MI1 im Regenerationsbetrieb" CURVE 0x800529A2 CurG_Ws16 1.000000 Fact 0.00 1.000000 FORMAT "%8.6" EXTENDED_LIMITS -4.000000 3.999878
 /begin AXIS_DESCR COM_AXIS InjSys_tEng Temp_Cels 12 -50.14000 199.8600 FORMAT "%8.4" EXTENDED_LIMITS -3549.940 3003.560 AXIS_PTS_REF InjCrv_facMI1ETSSOECorRgn_AXIS /end AXIS_DESCR
/end CHARACTERISTIC
/begin CHARACTERISTIC InjCrv_facMI1ETSSOECor1Rgn_GCUR "motortemperaturabhängige Ansteuerbeginnkorrekturgruppenkennlinie 2 für MI1 im Regenerationsbetrieb" CURVE 0x800529BA CurG_Ws16 1.000000 Fact 0.00 1.000000 FORMAT "%8.6" EXTENDED_LIMITS -4.000000 3.999878
 /begin AXIS_DESCR COM_AXIS InjSys_tEng Temp_Cels 12 -50.14000 199.8600 FORMAT "%8.4" EXTENDED_LIMITS -3549.940 3003.560 AXIS_PTS_REF InjCrv_facMI1ETSSOECorRgn_AXIS /end AXIS_DESCR
/end CHARACTERISTIC
/begin AXIS_PTS InjCrv_facMI1ETSSOECorRgn_AXIS "Stützstellenverteilung für die Gruppenkennlinien InjCrv_facMI1ETSSOECor%Rgn_GCUR" 0x800529D2 InjSys_tEng Axis_Xs16 250.0000 Temp_Cels 12 -50.14000 199.8600 FORMAT "%8.4" EXTENDED_LIMITS -3549.940 3003.560 DEPOSIT ABSOLUTE /end AXIS_PTS
/begin CHARACTERISTIC InjCrv_facMI1SOERmp0Val_GCUR "Faktorisierungskennlinie für den Einspritzbeginn der MI1" CURVE 0x800538FC CurG_Ws16 3.999939 CoEOMSwt_S16 -2.000000 1.999939 FORMAT "%8.6"
 /begin AXIS_DESCR COM_AXIS CoEOM_facRmpVal CoEOMSwt_S16 11 -2.000000 1.999939 FORMAT "%8.6" AXIS_PTS_REF InjCrv_facMI1SOERmpValX_AXIS /end AXIS_DESCR
/end CHARACTERISTIC
/begin CHARACTERISTIC InjCrv_facMI1SOERmp1Val_GCUR "Faktorisierungskennlinie für den Einspritzbeginn der MI1" CURVE 0x80053912 CurG_Ws16 3.999939 CoEOMSwt_S16 -2.000000 1.999939 FORMAT "%8.6"
 /begin AXIS_DESCR COM_AXIS CoEOM_facRmpVal CoEOMSwt_S16 11 -2.000000 1.999939 FORMAT "%8.6" AXIS_PTS_REF InjCrv_facMI1SOERmpValX_AXIS /end AXIS_DESCR
/end CHARACTERISTIC
/begin AXIS_PTS InjCrv_facMI1SOERmpValX_AXIS "Gruppenkennlinien-Achse für die Gewichtung des Einspritzbeginn-Faktors der MI1" 0x80053928 CoEOM_facRmpVal Axis_Xs16 3.999939 CoEOMSwt_S16 11 -2.000000 1.999939 FORMAT "%8.6" DEPOSIT ABSOLUTE /end AXIS_PTS
/begin CHARACTERISTIC InjCrv_facMIAPSPhiCor1_CUR "atmosphärendruckabhängige Korrekturkennlinie -1 für Ansteuerbeginn MI1" CURVE 0x8005286E CurG_Ws16 1.000000 Fact 0.00 1.000000 FORMAT "%8.6" EXTENDED_LIMITS -4.000000 3.999878
 /begin AXIS_DESCR COM_AXIS EnvP_p Pres_hPa 8 0.00 3500.000 FORMAT "%8.3" EXTENDED_LIMITS -32768.00 32767.00 AXIS_PTS_REF InjCrv_facMIAPSPhiCor_AXIS /end AXIS_DESCR
/end CHARACTERISTIC
/begin CHARACTERISTIC InjCrv_facMIAPSPhiCor2_CUR "atmosphärendruckabhängige Korrekturkennlinie -2 für Ansteuerbeginn MI1" CURVE 0x8005287E CurG_Ws16 1.000000 Fact 0.00 1.000000 FORMAT "%8.6" EXTENDED_LIMITS -4.000000 3.999878
 /begin AXIS_DESCR COM_AXIS EnvP_p Pres_hPa 8 0.00 3500.000 FORMAT "%8.3" EXTENDED_LIMITS -32768.00 32767.00 AXIS_PTS_REF InjCrv_facMIAPSPhiCor_AXIS /end AXIS_DESCR
/end CHARACTERISTIC
/begin CHARACTERISTIC InjCrv_facMIAPSPhiCorStrt_CUR "weighting factor by air pressure for SOE correction" CURVE 0x8007A240 Kl_Xs16_Ws16 7.999878 Fact -4.000000 3.999878 FORMAT "%8.6"
 /begin AXIS_DESCR STD_AXIS EnvP_p Pres_hPa 8 -32768.00 3500.00 FORMAT "%8.2" EXTENDED_LIMITS -32768.00 32767.00 DEPOSIT ABSOLUTE /end AXIS_DESCR
/end CHARACTERISTIC
/begin AXIS_PTS InjCrv_facMIAPSPhiCor_AXIS "gemeinsame Stützstellen für atmosphärendruckabhängige Ansteuerbeginnkorrekturkennlinien für MI1" 0x8005288E EnvP_p Axis_Xs16 4000.000 Pres_hPa 8 0.00 4000.000 FORMAT "%8.3" EXTENDED_LIMITS -32768.00 32767.00 DEPOSIT ABSOLUTE /end AXIS_PTS
/begin CHARACTERISTIC InjCrv_facMIATSDynCor_CUR "Korrekturkennline für Lufttemperaturkorrektur" CURVE 0x800506E8 Kl_Xs16_Ws16 7.999878 Fact -4.000000 3.999878 FORMAT "%8.6"
 /begin AXIS_DESCR STD_AXIS InjCrv_tAirMI Temp_Cels 6 -3549.940 3003.560 FORMAT "%8.3" DEPOSIT ABSOLUTE /end AXIS_DESCR
/end CHARACTERISTIC
/begin CHARACTERISTIC InjCrv_facMIATSPhiCor1_CUR "ansauglufttemperaturabhängige Korrekturkennlinie -1 für Ansteuerbeginn MI1" CURVE 0x800528A0 CurG_Ws16 1.000000 Fact 0.00 1.000000 FORMAT "%8.6" EXTENDED_LIMITS -4.000000 3.999878
 /begin AXIS_DESCR COM_AXIS InjCrv_tAirMI Temp_Cels 8 -50.14000 199.8600 FORMAT "%8.4" EXTENDED_LIMITS -3549.940 3003.560 AXIS_PTS_REF InjCrv_facMIATSPhiCor_AXIS /end AXIS_DESCR
/end CHARACTERISTIC
/begin CHARACTERISTIC InjCrv_facMIATSPhiCor2_CUR "ansauglufttemperaturabhängige Korrekturkennlinie -2 für Ansteuerbeginn MI1" CURVE 0x800528B0 CurG_Ws16 1.000000 Fact 0.00 1.000000 FORMAT "%8.6" EXTENDED_LIMITS -4.000000 3.999878
 /begin AXIS_DESCR COM_AXIS InjCrv_tAirMI Temp_Cels 8 -50.14000 199.8600 FORMAT "%8.4" EXTENDED_LIMITS -3549.940 3003.560 AXIS_PTS_REF InjCrv_facMIATSPhiCor_AXIS /end AXIS_DESCR
/end CHARACTERISTIC
/begin CHARACTERISTIC InjCrv_facMIATSPhiCorStrt_CUR "weighting factor by intake air temperature for SOE correction" CURVE 0x8007A262 Kl_Xs16_Ws16 7.999878 Fact -4.000000 3.999878 FORMAT "%8.6"
 /begin AXIS_DESCR STD_AXIS InjCrv_tAirMI Temp_Cels 8 -3549.940 3003.560 FORMAT "%8.3" DEPOSIT ABSOLUTE /end AXIS_DESCR
/end CHARACTERISTIC
/begin AXIS_PTS InjCrv_facMIATSPhiCor_AXIS "gemeinsame Stützstellen für ansauglufttemperaturabhängige Ansteuerbeginnkorrekturkennlinien für MI1" 0x800528C0 InjCrv_tAirMI Axis_Xs16 250.0000 Temp_Cels 8 -50.14000 199.8600 FORMAT "%8.4" EXTENDED_LIMITS -3549.940 3003.560 DEPOSIT ABSOLUTE /end AXIS_PTS
/begin CHARACTERISTIC InjCrv_facMICTSDynCor_CUR "Korrekturkennlinie für Wassertemperaturkorrektur" CURVE 0x80050702 Kl_Xs16_Ws16 7.999878 Fact -4.000000 3.999878 FORMAT "%8.6"
 /begin AXIS_DESCR STD_AXIS InjSys_tEng Temp_Cels 6 -3549.940 3003.560 FORMAT "%8.3" DEPOSIT ABSOLUTE /end AXIS_DESCR
/end CHARACTERISTIC
/begin CHARACTERISTIC InjCrv_facMIETSPhiCor11_GCUR "motortemperaturabhängige Korrekturkennlinie -1 für Ansteuerbeginn MI1" CURVE 0x8007A284 Gkl_Ws16 7.999878 Fact -4.000000 3.999878 FORMAT "%8.6"
 /begin AXIS_DESCR COM_AXIS InjSys_tEng Temp_Cels 8 -3549.940 3003.560 FORMAT "%8.3" AXIS_PTS_REF InjCrv_facMIETSPhiCor1_AXIS /end AXIS_DESCR
/end CHARACTERISTIC
/begin CHARACTERISTIC InjCrv_facMIETSPhiCor12_GCUR "motortemperaturabhängige Korrekturkennlinie -2 für Ansteuerbeginn MI1" CURVE 0x8007A294 Gkl_Ws16 7.999878 Fact -4.000000 3.999878 FORMAT "%8.6"
 /begin AXIS_DESCR COM_AXIS InjSys_tEng Temp_Cels 8 -3549.940 3003.560 FORMAT "%8.3" AXIS_PTS_REF InjCrv_facMIETSPhiCor1_AXIS /end AXIS_DESCR
/end CHARACTERISTIC
/begin AXIS_PTS InjCrv_facMIETSPhiCor1_AXIS "" 0x8007A2A4 InjSys_tEng GSst_Xs16 6553.500 Temp_Cels 8 -3549.940 3003.560 FORMAT "%8.3" DEPOSIT ABSOLUTE /end AXIS_PTS
/begin CHARACTERISTIC InjCrv_facMIETSPhiCor1_CUR "motortemperaturabhängige Korrekturkennlinie -1 für Ansteuerbeginn MI1" CURVE 0x800528D2 CurG_Ws16 1.000000 Fact 0.00 1.000000 FORMAT "%8.6" EXTENDED_LIMITS -4.000000 3.999878
 /begin AXIS_DESCR COM_AXIS InjSys_tEng Temp_Cels 8 -50.14000 199.8600 FORMAT "%8.4" EXTENDED_LIMITS -3549.940 3003.560 AXIS_PTS_REF InjCrv_facMIETSPhiCor_AXIS /end AXIS_DESCR
/end CHARACTERISTIC
/begin CHARACTERISTIC InjCrv_facMIETSPhiCor2_CUR "motortemperaturabhängige Korrekturkennlinie -2 für Ansteuerbeginn MI1" CURVE 0x800528E2 CurG_Ws16 1.000000 Fact 0.00 1.000000 FORMAT "%8.6" EXTENDED_LIMITS -4.000000 3.999878
 /begin AXIS_DESCR COM_AXIS InjSys_tEng Temp_Cels 8 -50.14000 199.8600 FORMAT "%8.4" EXTENDED_LIMITS -3549.940 3003.560 AXIS_PTS_REF InjCrv_facMIETSPhiCor_AXIS /end AXIS_DESCR
/end CHARACTERISTIC
/begin CHARACTERISTIC InjCrv_facMIETSPhiCorStrt_CUR "weighting factor by engine temperature for SOE correction" CURVE 0x8007A2B6 Kl_Xs16_Ws16 7.999878 Fact -4.000000 3.999878 FORMAT "%8.6"
 /begin AXIS_DESCR STD_AXIS InjSys_tEng Temp_Cels 8 -3549.940 3003.560 FORMAT "%8.3" DEPOSIT ABSOLUTE /end AXIS_DESCR
/end CHARACTERISTIC
/begin AXIS_PTS InjCrv_facMIETSPhiCor_AXIS "gemeinsame Stützstellen für motortemperaturabhängige Ansteuerbeginnkorrekturkennlinien für MI1" 0x800528F2 InjSys_tEng Axis_Xs16 250.0000 Temp_Cels 8 -50.14000 199.8600 FORMAT "%8.4" EXTENDED_LIMITS -3549.940 3003.560 DEPOSIT ABSOLUTE /end AXIS_PTS
/begin CHARACTERISTIC InjCrv_facMIFTSRailCorStrt_CUR "correction factor curve for the MI1, based on rail pressure" CURVE 0x8007A2D8 Kl_Xs16_Ws16 7.999878 Fact -4.000000 3.999878 FORMAT "%8.6"
 /begin AXIS_DESCR STD_AXIS Rail_pSetPointFlTempCor Pres_Rail 2 -3276.800 2000.000 FORMAT "%5.3" EXTENDED_LIMITS -3276.800 3276.700 DEPOSIT ABSOLUTE /end AXIS_DESCR
/end CHARACTERISTIC
/begin CHARACTERISTIC InjCrv_facMIFTSRailCor_CUR "Korrekturfaktorkennlinie für die MI1, abhängig von der kraftstofftemperaturabhängigen Raildruckkorrektur" CURVE 0x80052904 Cur_Xs16Ws16 1.000000 Fact 0.00 1.000000 FORMAT "%8.6" EXTENDED_LIMITS -4.000000 3.999878
 /begin AXIS_DESCR STD_AXIS Rail_pSetPointFlTempCor Pres_Rail 8 -1800.000 2000.000 FORMAT "%5.3" EXTENDED_LIMITS -3276.800 3276.700 DEPOSIT ABSOLUTE /end AXIS_DESCR
/end CHARACTERISTIC
/begin CHARACTERISTIC InjCrv_facMIPDynCor_CUR "Korrekturkennlinie für Faktor abhängig vom Raildruck" CURVE 0x8005071C Kl_Xs16_Ws16 2.000000 Fact 0.00 2.000000 FORMAT "%8.6" EXTENDED_LIMITS -4.000000 3.999878
 /begin AXIS_DESCR STD_AXIS InjCrv_pMIDynCor_mp Pres_Rail 8 -3276.800 2000.000 FORMAT "%5.3" EXTENDED_LIMITS -3276.800 3276.700 DEPOSIT ABSOLUTE /end AXIS_DESCR
/end CHARACTERISTIC
/begin CHARACTERISTIC InjCrv_facMIPFltPhiCor_CUR "rußmassenabhängiger Korrekturfaktor des Partikelfilters" CURVE 0x80052926 Cur_Xs16Ws16 1.000000 Fact 0.00 1.000000 FORMAT "%8.6" EXTENDED_LIMITS -4.000000 3.999878
 /begin AXIS_DESCR STD_AXIS Exh_pFltPPFltUs Pres_hPa 12 -32768.00 3500.00 FORMAT "%8.2" EXTENDED_LIMITS -32768.00 32767.00 DEPOSIT ABSOLUTE /end AXIS_DESCR
/end CHARACTERISTIC
/begin CHARACTERISTIC InjCrv_facPiI1APSQCor0Rgn1_GCUR "atmosphärendruckabhängige Mengenkorrekturkennlinie 1 für PiI1 für die Regenerationsstufe 1" CURVE 0x800586B0 CurG_Ws16 1.000000 Fact 0.00 1.000000 FORMAT "%8.6" EXTENDED_LIMITS -4.000000 3.999878
 /begin AXIS_DESCR COM_AXIS EnvP_p Pres_hPa 12 0.00 3500.000 FORMAT "%8.3" EXTENDED_LIMITS -32768.00 32767.00 AXIS_PTS_REF InjCrv_facPiI1APSQCorRgn_AXIS /end AXIS_DESCR
/end CHARACTERISTIC
/begin CHARACTERISTIC InjCrv_facPiI1APSQCor0Rgn2_GCUR "atmosphärendruckabhängige Mengenkorrekturkennlinie 2 für PiI1 für die Regenerationsstufe 1" CURVE 0x800586C8 CurG_Ws16 1.000000 Fact 0.00 1.000000 FORMAT "%8.6" EXTENDED_LIMITS -4.000000 3.999878
 /begin AXIS_DESCR COM_AXIS EnvP_p Pres_hPa 12 0.00 3500.000 FORMAT "%8.3" EXTENDED_LIMITS -32768.00 32767.00 AXIS_PTS_REF InjCrv_facPiI1APSQCorRgn_AXIS /end AXIS_DESCR
/end CHARACTERISTIC
/begin CHARACTERISTIC InjCrv_facPiI1APSQCor1Rgn1_GCUR "atmosphärendruckabhängige Mengenkorrekturkennlinie 1 für PiI1 für die Regenerationsstufe 2" CURVE 0x800586E0 CurG_Ws16 1.000000 Fact 0.00 1.000000 FORMAT "%8.6" EXTENDED_LIMITS -4.000000 3.999878
 /begin AXIS_DESCR COM_AXIS EnvP_p Pres_hPa 12 0.00 3500.000 FORMAT "%8.3" EXTENDED_LIMITS -32768.00 32767.00 AXIS_PTS_REF InjCrv_facPiI1APSQCorRgn_AXIS /end AXIS_DESCR
/end CHARACTERISTIC
/begin CHARACTERISTIC InjCrv_facPiI1APSQCor1Rgn2_GCUR "atmosphärendruckabhängige Mengenkorrekturkennlinie 2 für PiI1 für die Regenerationsstufe 2" CURVE 0x800586F8 CurG_Ws16 1.000000 Fact 0.00 1.000000 FORMAT "%8.6" EXTENDED_LIMITS -4.000000 3.999878
 /begin AXIS_DESCR COM_AXIS EnvP_p Pres_hPa 12 0.00 3500.000 FORMAT "%8.3" EXTENDED_LIMITS -32768.00 32767.00 AXIS_PTS_REF InjCrv_facPiI1APSQCorRgn_AXIS /end AXIS_DESCR
/end CHARACTERISTIC
/begin CHARACTERISTIC InjCrv_facPiI1APSQCor1_CUR "atmosphärendruckabhängige Mengenkorrekturkennlinie 1 für PiI 1" CURVE 0x80058586 CurG_Ws16 1.000000 Fact 0.00 1.000000 FORMAT "%8.6" EXTENDED_LIMITS -4.000000 3.999878
 /begin AXIS_DESCR COM_AXIS EnvP_p Pres_hPa 10 0.00 3500.000 FORMAT "%8.3" EXTENDED_LIMITS -32768.00 32767.00 AXIS_PTS_REF InjCrv_facPiI1APSQCor_AXIS /end AXIS_DESCR
/end CHARACTERISTIC
/begin CHARACTERISTIC InjCrv_facPiI1APSQCor2_CUR "atmosphärendruckabhängige Mengenkorrekturkennlinie für PiI 1 wenn PiI2 oder PiI3 aktiv ist" CURVE 0x8005859A CurG_Ws16 1.000000 Fact 0.00 1.000000 FORMAT "%8.6" EXTENDED_LIMITS -4.000000 3.999878
 /begin AXIS_DESCR COM_AXIS EnvP_p Pres_hPa 10 0.00 3500.000 FORMAT "%8.3" EXTENDED_LIMITS -32768.00 32767.00 AXIS_PTS_REF InjCrv_facPiI1APSQCor_AXIS /end AXIS_DESCR
/end CHARACTERISTIC
/begin AXIS_PTS InjCrv_facPiI1APSQCorRgn_AXIS "gemeinsame Stützstellen für atmosphärendruckabhängige Mengenkorrekturkennlinien für PiI1 für die Regeneration" 0x80058710 EnvP_p Axis_Xs16 3500.000 Pres_hPa 12 0.00 3500.000 FORMAT "%8.3" EXTENDED_LIMITS -32768.00 32767.00 DEPOSIT ABSOLUTE /end AXIS_PTS
/begin CHARACTERISTIC InjCrv_facPiI1APSQCorStrt_CUR "weighting factor of atmospheric pressure for pilot injections quantity correction" CURVE 0x8007A364 Kl_Xs16_Ws16 7.999878 Fact -4.000000 3.999878 FORMAT "%8.6"
 /begin AXIS_DESCR STD_AXIS EnvP_p Pres_hPa 8 -32768.00 3500.00 FORMAT "%8.2" EXTENDED_LIMITS -32768.00 32767.00 DEPOSIT ABSOLUTE /end AXIS_DESCR
/end CHARACTERISTIC
/begin AXIS_PTS InjCrv_facPiI1APSQCor_AXIS "" 0x800585AE EnvP_p Axis_Xs16 3500.000 Pres_hPa 10 0.00 3500.000 FORMAT "%8.3" EXTENDED_LIMITS -32768.00 32767.00 DEPOSIT ABSOLUTE /end AXIS_PTS
/begin CHARACTERISTIC InjCrv_facPiI1ATSQCor0Rgn1_GCUR "umgebungsluftabhängige Mengenkorrekturkennlinie 1 für PiI1 für die Regenerationsstufe 1" CURVE 0x8005872A CurG_Ws16 1.000000 Fact 0.00 1.000000 FORMAT "%8.6" EXTENDED_LIMITS -4.000000 3.999878
 /begin AXIS_DESCR COM_AXIS InjCrv_tAirPiI Temp_Cels 12 -50.14000 199.8600 FORMAT "%8.4" EXTENDED_LIMITS -3549.940 3003.560 AXIS_PTS_REF InjCrv_facPiI1ATSQCorRgn_AXIS /end AXIS_DESCR
/end CHARACTERISTIC
/begin CHARACTERISTIC InjCrv_facPiI1ATSQCor0Rgn2_GCUR "umgebungsluftabhängige Mengenkorrekturkennlinie 2 für PiI1 für die Regenerationsstufe 1" CURVE 0x80058742 CurG_Ws16 1.000000 Fact 0.00 1.000000 FORMAT "%8.6" EXTENDED_LIMITS -4.000000 3.999878
 /begin AXIS_DESCR COM_AXIS InjCrv_tAirPiI Temp_Cels 12 -50.14000 199.8600 FORMAT "%8.4" EXTENDED_LIMITS -3549.940 3003.560 AXIS_PTS_REF InjCrv_facPiI1ATSQCorRgn_AXIS /end AXIS_DESCR
/end CHARACTERISTIC
/begin CHARACTERISTIC InjCrv_facPiI1ATSQCor1Rgn1_GCUR "umgebungsluftabhängige Mengenkorrekturkennlinie 1 für PiI1 für die Regenerationsstufe 2" CURVE 0x8005875A CurG_Ws16 1.000000 Fact 0.00 1.000000 FORMAT "%8.6" EXTENDED_LIMITS -4.000000 3.999878
 /begin AXIS_DESCR COM_AXIS InjCrv_tAirPiI Temp_Cels 12 -50.14000 199.8600 FORMAT "%8.4" EXTENDED_LIMITS -3549.940 3003.560 AXIS_PTS_REF InjCrv_facPiI1ATSQCorRgn_AXIS /end AXIS_DESCR
/end CHARACTERISTIC
/begin CHARACTERISTIC InjCrv_facPiI1ATSQCor1Rgn2_GCUR "umgebungsluftabhängige Mengenkorrekturkennlinie 2 für PiI1 für die Regenerationsstufe 2" CURVE 0x80058772 CurG_Ws16 1.000000 Fact 0.00 1.000000 FORMAT "%8.6" EXTENDED_LIMITS -4.000000 3.999878
 /begin AXIS_DESCR COM_AXIS InjCrv_tAirPiI Temp_Cels 12 -50.14000 199.8600 FORMAT "%8.4" EXTENDED_LIMITS -3549.940 3003.560 AXIS_PTS_REF InjCrv_facPiI1ATSQCorRgn_AXIS /end AXIS_DESCR
/end CHARACTERISTIC
/begin CHARACTERISTIC InjCrv_facPiI1ATSQCor1_CUR "ansauglufttemperaturabhängige Mengenkorrekturkennlinie 1 für PiI1" CURVE 0x800585C4 CurG_Ws16 1.000000 Fact 0.00 1.000000 FORMAT "%8.6" EXTENDED_LIMITS -4.000000 3.999878
 /begin AXIS_DESCR COM_AXIS InjCrv_tAirPiI Temp_Cels 10 -50.14000 199.8600 FORMAT "%8.4" EXTENDED_LIMITS -3549.940 3003.560 AXIS_PTS_REF InjCrv_facPiI1ATSQCor_AXIS /end AXIS_DESCR
/end CHARACTERISTIC
/begin CHARACTERISTIC InjCrv_facPiI1ATSQCor2_CUR "ansauglufttemperaturabhängige Mengenkorrekturkennlinie für PiI1 wenn PiI2 oder PiI3 aktiv ist" CURVE 0x800585D8 CurG_Ws16 1.000000 Fact 0.00 1.000000 FORMAT "%8.6" EXTENDED_LIMITS -4.000000 3.999878
 /begin AXIS_DESCR COM_AXIS InjCrv_tAirPiI Temp_Cels 10 -50.14000 199.8600 FORMAT "%8.4" EXTENDED_LIMITS -3549.940 3003.560 AXIS_PTS_REF InjCrv_facPiI1ATSQCor_AXIS /end AXIS_DESCR
/end CHARACTERISTIC
/begin AXIS_PTS InjCrv_facPiI1ATSQCorRgn_AXIS "gemeinsame Stützstellen für umgebungstemperaturabhängige Mengenkorrekturkennlinien für PiI1 für die Regeneration" 0x8005878A InjCrv_tAirPiI Axis_Xs16 250.0000 Temp_Cels 12 -50.14000 199.8600 FORMAT "%8.4" EXTENDED_LIMITS -3549.940 3003.560 DEPOSIT ABSOLUTE /end AXIS_PTS
/begin CHARACTERISTIC InjCrv_facPiI1ATSQCorStrt_CUR "weighting factor of intake air temperature for pilot injections quantity correction" CURVE 0x8007A386 Kl_Xs16_Ws16 7.999878 Fact -4.000000 3.999878 FORMAT "%8.6"
 /begin AXIS_DESCR STD_AXIS InjCrv_tAirPiI Temp_Cels 8 -3549.940 3003.560 FORMAT "%8.3" DEPOSIT ABSOLUTE /end AXIS_DESCR
/end CHARACTERISTIC
/begin AXIS_PTS InjCrv_facPiI1ATSQCor_AXIS "" 0x800585EC InjCrv_tAirPiI Axis_Xs16 250.0000 Temp_Cels 10 -50.14000 199.8600 FORMAT "%8.4" EXTENDED_LIMITS -3549.940 3003.560 DEPOSIT ABSOLUTE /end AXIS_PTS
/begin CHARACTERISTIC InjCrv_facPiI1ATSSOECor0Rgn1_CUR "umgebungstemperaturabhängige Ansteuerbeginnkorrekturkennlinie 1 für PiI1 für die Regenerationsstufe 1" CURVE 0x800587A4 CurG_Ws16 1.000000 Fact 0.00 1.000000 FORMAT "%8.6" EXTENDED_LIMITS -4.000000 3.999878
 /begin AXIS_DESCR COM_AXIS InjCrv_tAirPiI Temp_Cels 12 -50.14000 199.8600 FORMAT "%8.4" EXTENDED_LIMITS -3549.940 3003.560 AXIS_PTS_REF InjCrv_facPiI1ATSSOECorRgn_AXIS /end AXIS_DESCR
/end CHARACTERISTIC
/begin CHARACTERISTIC InjCrv_facPiI1ATSSOECor0Rgn2_CUR "umgebungstemperaturabhängige Ansteuerbeginnkorrekturkennlinie 2 für PiI1 für die Regenerationsstufe 1" CURVE 0x800587BC CurG_Ws16 1.000000 Fact 0.00 1.000000 FORMAT "%8.6" EXTENDED_LIMITS -4.000000 3.999878
 /begin AXIS_DESCR COM_AXIS InjCrv_tAirPiI Temp_Cels 12 -50.14000 199.8600 FORMAT "%8.4" EXTENDED_LIMITS -3549.940 3003.560 AXIS_PTS_REF InjCrv_facPiI1ATSSOECorRgn_AXIS /end AXIS_DESCR
/end CHARACTERISTIC
/begin CHARACTERISTIC InjCrv_facPiI1ATSSOECor1Rgn1_CUR "umgebungstemperaturabhängige Ansteuerbeginnkorrekturkennlinie 1 für PiI1 für die Regenerationsstufe 2" CURVE 0x800587D4 CurG_Ws16 1.000000 Fact 0.00 1.000000 FORMAT "%8.6" EXTENDED_LIMITS -4.000000 3.999878
 /begin AXIS_DESCR COM_AXIS InjCrv_tAirPiI Temp_Cels 12 -50.14000 199.8600 FORMAT "%8.4" EXTENDED_LIMITS -3549.940 3003.560 AXIS_PTS_REF InjCrv_facPiI1ATSSOECorRgn_AXIS /end AXIS_DESCR
/end CHARACTERISTIC
/begin CHARACTERISTIC InjCrv_facPiI1ATSSOECor1Rgn2_CUR "umgebungstemperaturabhängige Ansteuerbeginnkorrekturkennlinie 2 für PiI1 für die Regenerationsstufe 2" CURVE 0x800587EC CurG_Ws16 1.000000 Fact 0.00 1.000000 FORMAT "%8.6" EXTENDED_LIMITS -4.000000 3.999878
 /begin AXIS_DESCR COM_AXIS InjCrv_tAirPiI Temp_Cels 12 -50.14000 199.8600 FORMAT "%8.4" EXTENDED_LIMITS -3549.940 3003.560 AXIS_PTS_REF InjCrv_facPiI1ATSSOECorRgn_AXIS /end AXIS_DESCR
/end CHARACTERISTIC
/begin CHARACTERISTIC InjCrv_facPiI1ATSSOECor1_CUR "Ansauglufttemperaturabhängige Ansteuerbeginnkorrekturkennlinie für PiI1 bei inaktiver PiI2" CURVE 0x80058602 CurG_Ws16 1.000000 Fact 0.00 1.000000 FORMAT "%8.6" EXTENDED_LIMITS -4.000000 3.999878
 /begin AXIS_DESCR COM_AXIS InjCrv_tAirPiI Temp_Cels 8 -50.14000 199.8600 FORMAT "%8.4" EXTENDED_LIMITS -3549.940 3003.560 AXIS_PTS_REF InjCrv_facPiI1ATSSOECor_AXIS /end AXIS_DESCR
/end CHARACTERISTIC
/begin CHARACTERISTIC InjCrv_facPiI1ATSSOECor2_CUR "Ansauglufttemperaturabhängige Ansteuerbeginnkorrekturkennlinie für PiI1 bei aktiver PiI2" CURVE 0x80058612 CurG_Ws16 1.000000 Fact 0.00 1.000000 FORMAT "%8.6" EXTENDED_LIMITS -4.000000 3.999878
 /begin AXIS_DESCR COM_AXIS InjCrv_tAirPiI Temp_Cels 8 -50.14000 199.8600 FORMAT "%8.4" EXTENDED_LIMITS -3549.940 3003.560 AXIS_PTS_REF InjCrv_facPiI1ATSSOECor_AXIS /end AXIS_DESCR
/end CHARACTERISTIC
/begin AXIS_PTS InjCrv_facPiI1ATSSOECorRgn_AXIS "gemeinsame Stützstellen für umgebungstemperaturabhängige Ansteuerbeginnkorrekturkennlinien für PiI1 für die Regeneration" 0x80058804 InjCrv_tAirPiI Axis_Xs16 250.0000 Temp_Cels 12 -50.14000 199.8600 FORMAT "%8.4" EXTENDED_LIMITS -3549.940 3003.560 DEPOSIT ABSOLUTE /end AXIS_PTS
/begin AXIS_PTS InjCrv_facPiI1ATSSOECor_AXIS "" 0x80058622 InjCrv_tAirPiI Axis_Xs16 250.0000 Temp_Cels 8 -50.14000 199.8600 FORMAT "%8.4" EXTENDED_LIMITS -3549.940 3003.560 DEPOSIT ABSOLUTE /end AXIS_PTS
/begin CHARACTERISTIC InjCrv_facPiI1ETSQCor0Rgn1_GCUR "motortemperaturabhängige Mengenkorrekturkennlinie 1 für PiI1 für die Regenerationsstufe 1" CURVE 0x8005881E CurG_Ws16 1.000000 Fact 0.00 1.000000 FORMAT "%8.6" EXTENDED_LIMITS -4.000000 3.999878
 /begin AXIS_DESCR COM_AXIS InjSys_tEng Temp_Cels 12 -50.14000 199.8600 FORMAT "%8.4" EXTENDED_LIMITS -3549.940 3003.560 AXIS_PTS_REF InjCrv_facPiI1ETSQCorRgn_AXIS /end AXIS_DESCR
/end CHARACTERISTIC
/begin CHARACTERISTIC InjCrv_facPiI1ETSQCor0Rgn2_GCUR "motortemperaturabhängige Mengenkorrekturkennlinie 2 für PiI1 für die Regenerationsstufe 1" CURVE 0x80058836 CurG_Ws16 1.000000 Fact 0.00 1.000000 FORMAT "%8.6" EXTENDED_LIMITS -4.000000 3.999878
 /begin AXIS_DESCR COM_AXIS InjSys_tEng Temp_Cels 12 -50.14000 199.8600 FORMAT "%8.4" EXTENDED_LIMITS -3549.940 3003.560 AXIS_PTS_REF InjCrv_facPiI1ETSQCorRgn_AXIS /end AXIS_DESCR
/end CHARACTERISTIC
/begin CHARACTERISTIC InjCrv_facPiI1ETSQCor11_CUR "motortemperaturabhängige Mengenkorrekturkennlinie -1 für Voreinspritzung 1" CURVE 0x8007A3A8 Kl_Xs16_Ws16 7.999878 Fact -4.000000 3.999878 FORMAT "%8.6"
 /begin AXIS_DESCR STD_AXIS InjSys_tEng Temp_Cels 10 -3549.940 3003.560 FORMAT "%8.3" DEPOSIT ABSOLUTE /end AXIS_DESCR
/end CHARACTERISTIC
/begin CHARACTERISTIC InjCrv_facPiI1ETSQCor12_CUR "motortemperaturabhängige Mengenkorrekturkennlinie für Voreinspritzung 1 bei inaktiver Voreinspritzung 2" CURVE 0x8007A3D2 Kl_Xs16_Ws16 7.999878 Fact -4.000000 3.999878 FORMAT "%8.6"
 /begin AXIS_DESCR STD_AXIS InjSys_tEng Temp_Cels 8 -3549.940 3003.560 FORMAT "%8.3" DEPOSIT ABSOLUTE /end AXIS_DESCR
/end CHARACTERISTIC
/begin CHARACTERISTIC InjCrv_facPiI1ETSQCor1Rgn1_GCUR "motortemperaturabhängige Mengenkorrekturkennlinie 1 für PiI1 für die Regenerationsstufe 2" CURVE 0x8005884E CurG_Ws16 1.000000 Fact 0.00 1.000000 FORMAT "%8.6" EXTENDED_LIMITS -4.000000 3.999878
 /begin AXIS_DESCR COM_AXIS InjSys_tEng Temp_Cels 12 -50.14000 199.8600 FORMAT "%8.4" EXTENDED_LIMITS -3549.940 3003.560 AXIS_PTS_REF InjCrv_facPiI1ETSQCorRgn_AXIS /end AXIS_DESCR
/end CHARACTERISTIC
/begin CHARACTERISTIC InjCrv_facPiI1ETSQCor1Rgn2_GCUR "motortemperaturabhängige Mengenkorrekturkennlinie 2 für PiI1 für die Regenerationsstufe 2" CURVE 0x80058866 CurG_Ws16 1.000000 Fact 0.00 1.000000 FORMAT "%8.6" EXTENDED_LIMITS -4.000000 3.999878
 /begin AXIS_DESCR COM_AXIS InjSys_tEng Temp_Cels 12 -50.14000 199.8600 FORMAT "%8.4" EXTENDED_LIMITS -3549.940 3003.560 AXIS_PTS_REF InjCrv_facPiI1ETSQCorRgn_AXIS /end AXIS_DESCR
/end CHARACTERISTIC
/begin CHARACTERISTIC InjCrv_facPiI1ETSQCor1_CUR "motortemperaturabhängige Mengenkorrekturkennlinie 1 für PiI1" CURVE 0x80058634 CurG_Ws16 1.000000 Fact 0.00 1.000000 FORMAT "%8.6" EXTENDED_LIMITS -4.000000 3.999878
 /begin AXIS_DESCR COM_AXIS InjSys_tEng Temp_Cels 10 -50.14000 199.8600 FORMAT "%8.4" EXTENDED_LIMITS -3549.940 3003.560 AXIS_PTS_REF InjCrv_facPiI1ETSQCor_AXIS /end AXIS_DESCR
/end CHARACTERISTIC
/begin CHARACTERISTIC InjCrv_facPiI1ETSQCor2_CUR "motortemperaturabhängige Mengenkorrekturkennlinie für PiI1 wenn PiI2 oder PiI3 aktiv ist" CURVE 0x80058648 CurG_Ws16 1.000000 Fact 0.00 1.000000 FORMAT "%8.6" EXTENDED_LIMITS -4.000000 3.999878
 /begin AXIS_DESCR COM_AXIS InjSys_tEng Temp_Cels 10 -50.14000 199.8600 FORMAT "%8.4" EXTENDED_LIMITS -3549.940 3003.560 AXIS_PTS_REF InjCrv_facPiI1ETSQCor_AXIS /end AXIS_DESCR
/end CHARACTERISTIC
/begin AXIS_PTS InjCrv_facPiI1ETSQCorRgn_AXIS "gemeinsame Stützstellen für motortemperaturabhängige Mengenkorrekturkennlinien für PiI1 für die Regeneration" 0x8005887E InjSys_tEng Axis_Xs16 250.0000 Temp_Cels 12 -50.14000 199.8600 FORMAT "%8.4" EXTENDED_LIMITS -3549.940 3003.560 DEPOSIT ABSOLUTE /end AXIS_PTS
/begin CHARACTERISTIC InjCrv_facPiI1ETSQCorStrt_CUR "weighting factor of engine temperature for pilot injection quantity correction" CURVE 0x8007A3F4 Kl_Xs16_Ws16 7.999878 Fact -4.000000 3.999878 FORMAT "%8.6"
 /begin AXIS_DESCR STD_AXIS InjSys_tEng Temp_Cels 8 -3549.940 3003.560 FORMAT "%8.3" DEPOSIT ABSOLUTE /end AXIS_DESCR
/end CHARACTERISTIC
/begin AXIS_PTS InjCrv_facPiI1ETSQCor_AXIS "" 0x8005865C InjSys_tEng Axis_Xs16 250.0000 Temp_Cels 10 -50.14000 199.8600 FORMAT "%8.4" EXTENDED_LIMITS -3549.940 3003.560 DEPOSIT ABSOLUTE /end AXIS_PTS
/begin CHARACTERISTIC InjCrv_facPiI1ETSSOECor0Rgn1_CUR "motortemperaturabhängige Ansteuerbeginnkorrekturkennlinie 1 für die PiI1 für die Regenerationsstufe 1" CURVE 0x80058898 CurG_Ws16 1.000000 Fact 0.00 1.000000 FORMAT "%8.6" EXTENDED_LIMITS -4.000000 3.999878
 /begin AXIS_DESCR COM_AXIS InjSys_tEng Temp_Cels 12 -50.14000 199.8600 FORMAT "%8.4" EXTENDED_LIMITS -3549.940 3003.560 AXIS_PTS_REF InjCrv_facPiI1ETSSOECorRgn_AXIS /end AXIS_DESCR
/end CHARACTERISTIC
/begin CHARACTERISTIC InjCrv_facPiI1ETSSOECor0Rgn2_CUR "motortemperaturabhängige Ansteuerbeginnkorrekturkennlinie 2 für die PiI1 für die Regenerationsstufe 1" CURVE 0x800588B0 CurG_Ws16 1.000000 Fact 0.00 1.000000 FORMAT "%8.6" EXTENDED_LIMITS -4.000000 3.999878
 /begin AXIS_DESCR COM_AXIS InjSys_tEng Temp_Cels 12 -50.14000 199.8600 FORMAT "%8.4" EXTENDED_LIMITS -3549.940 3003.560 AXIS_PTS_REF InjCrv_facPiI1ETSSOECorRgn_AXIS /end AXIS_DESCR
/end CHARACTERISTIC
/begin CHARACTERISTIC InjCrv_facPiI1ETSSOECor11_CUR "motortemperaturabhängige Ansteuerbeginnkorrekturkennlinie -1 für Voreinspritzung 1" CURVE 0x8007A416 Kl_Xs16_Ws16 7.999878 Fact -4.000000 3.999878 FORMAT "%8.6"
 /begin AXIS_DESCR STD_AXIS InjSys_tEng Temp_Cels 10 -3549.940 3003.560 FORMAT "%8.3" DEPOSIT ABSOLUTE /end AXIS_DESCR
/end CHARACTERISTIC
/begin CHARACTERISTIC InjCrv_facPiI1ETSSOECor12_CUR "motortemperaturabhängige Ansteuerbeginnkorrekturkennlinie für Voreinspritzung 1 bei aktiver Voreinspritzung 2" CURVE 0x8007A440 Kl_Xs16_Ws16 7.999878 Fact -4.000000 3.999878 FORMAT "%8.6"
 /begin AXIS_DESCR STD_AXIS InjSys_tEng Temp_Cels 8 -3549.940 3003.560 FORMAT "%8.3" DEPOSIT ABSOLUTE /end AXIS_DESCR
/end CHARACTERISTIC
/begin CHARACTERISTIC InjCrv_facPiI1ETSSOECor1Rgn1_CUR "motortemperaturabhängige Ansteuerbeginnkorrekturkennlinie 1 für die PiI1 für die Regenerationsstufe 2" CURVE 0x800588C8 CurG_Ws16 1.000000 Fact 0.00 1.000000 FORMAT "%8.6" EXTENDED_LIMITS -4.000000 3.999878
 /begin AXIS_DESCR COM_AXIS InjSys_tEng Temp_Cels 12 -50.14000 199.8600 FORMAT "%8.4" EXTENDED_LIMITS -3549.940 3003.560 AXIS_PTS_REF InjCrv_facPiI1ETSSOECorRgn_AXIS /end AXIS_DESCR
/end CHARACTERISTIC
/begin CHARACTERISTIC InjCrv_facPiI1ETSSOECor1Rgn2_CUR "motortemperaturabhängige Ansteuerbeginnkorrekturkennlinie 2 für die PiI1 für die Regenerationsstufe 2" CURVE 0x800588E0 CurG_Ws16 1.000000 Fact 0.00 1.000000 FORMAT "%8.6" EXTENDED_LIMITS -4.000000 3.999878
 /begin AXIS_DESCR COM_AXIS InjSys_tEng Temp_Cels 12 -50.14000 199.8600 FORMAT "%8.4" EXTENDED_LIMITS -3549.940 3003.560 AXIS_PTS_REF InjCrv_facPiI1ETSSOECorRgn_AXIS /end AXIS_DESCR
/end CHARACTERISTIC
/begin CHARACTERISTIC InjCrv_facPiI1ETSSOECor1_CUR "motortemperaturabhängige Ansteuerbeginnkorrekturkennlinie 1 für PiI1" CURVE 0x80058672 CurG_Ws16 1.000000 Fact 0.00 1.000000 FORMAT "%8.6" EXTENDED_LIMITS -4.000000 3.999878
 /begin AXIS_DESCR COM_AXIS InjSys_tEng Temp_Cels 10 -50.14000 199.8600 FORMAT "%8.4" EXTENDED_LIMITS -3549.940 3003.560 AXIS_PTS_REF InjCrv_facPiI1ETSSOECor_AXIS /end AXIS_DESCR
/end CHARACTERISTIC
/begin CHARACTERISTIC InjCrv_facPiI1ETSSOECor2_CUR "motortemperaturabhängige Ansteuerbeginnkorrekturkennlinie 2 für PiI1" CURVE 0x80058686 CurG_Ws16 1.000000 Fact 0.00 1.000000 FORMAT "%8.6" EXTENDED_LIMITS -4.000000 3.999878
 /begin AXIS_DESCR COM_AXIS InjSys_tEng Temp_Cels 10 -50.14000 199.8600 FORMAT "%8.4" EXTENDED_LIMITS -3549.940 3003.560 AXIS_PTS_REF InjCrv_facPiI1ETSSOECor_AXIS /end AXIS_DESCR
/end CHARACTERISTIC
/begin AXIS_PTS InjCrv_facPiI1ETSSOECorRgn_AXIS "gemeinsame Stützstellen für motortemperaturabhängige Ansteuerbeginnkorrekturkennlinien für PiI1 für die Regeneration" 0x800588F8 InjSys_tEng Axis_Xs16 250.0000 Temp_Cels 12 -50.14000 199.8600 FORMAT "%8.4" EXTENDED_LIMITS -3549.940 3003.560 DEPOSIT ABSOLUTE /end AXIS_PTS
/begin CHARACTERISTIC InjCrv_facPiI1ETSSOECorStrt_CUR "motortemperaturabhängige Ansteuerbeginnkorrekturkennlinie für Voreinspritzung 1 im Startfall" CURVE 0x8007A462 Kl_Xs16_Ws16 7.999878 Fact -4.000000 3.999878 FORMAT "%8.6"
 /begin AXIS_DESCR STD_AXIS InjSys_tEng Temp_Cels 8 -3549.940 3003.560 FORMAT "%8.3" DEPOSIT ABSOLUTE /end AXIS_DESCR
/end CHARACTERISTIC
/begin AXIS_PTS InjCrv_facPiI1ETSSOECor_AXIS "" 0x8005869A InjSys_tEng Axis_Xs16 250.0000 Temp_Cels 10 -50.14000 199.8600 FORMAT "%8.4" EXTENDED_LIMITS -3549.940 3003.560 DEPOSIT ABSOLUTE /end AXIS_PTS
/begin CHARACTERISTIC InjCrv_facPiI1QntMin_CUR "raildruckabhängige Kennlinie zur Ermittlung des Faktor fuer die Berechnung der Mindestmenge um die PiI1 abzuschalten" CURVE 0x800539E4 Cur_Xs16Ws16 1.000000 Fact1 0.00 1.000000 FORMAT "%8.6" EXTENDED_LIMITS -256.0000 255.9922
 /begin AXIS_DESCR STD_AXIS RailP_pFlt Pres_Rail 8 0.00 2000.000 FORMAT "%5.3" EXTENDED_LIMITS -3276.800 3276.700 DEPOSIT ABSOLUTE /end AXIS_DESCR
/end CHARACTERISTIC
/begin CHARACTERISTIC InjCrv_facPiI1QntRmp0Val_GCUR "Faktorisierungskennlinie für die Menge der PiI1" CURVE 0x8005A2CE CurG_Ws16 3.999939 CoEOMSwt_S16 -2.000000 1.999939 FORMAT "%8.6"
 /begin AXIS_DESCR COM_AXIS CoEOM_facRmpVal CoEOMSwt_S16 11 -2.000000 1.999939 FORMAT "%8.6" AXIS_PTS_REF InjCrv_facPiI1QntRmpValX_AXIS /end AXIS_DESCR
/end CHARACTERISTIC
/begin CHARACTERISTIC InjCrv_facPiI1QntRmp1Val_GCUR "Faktorisierungskennlinie für die Menge der PiI1" CURVE 0x8005A2E4 CurG_Ws16 3.999939 CoEOMSwt_S16 -2.000000 1.999939 FORMAT "%8.6"
 /begin AXIS_DESCR COM_AXIS CoEOM_facRmpVal CoEOMSwt_S16 11 -2.000000 1.999939 FORMAT "%8.6" AXIS_PTS_REF InjCrv_facPiI1QntRmpValX_AXIS /end AXIS_DESCR
/end CHARACTERISTIC
/begin AXIS_PTS InjCrv_facPiI1QntRmpValX_AXIS "Gruppenkennlinien-Achse für die Gewichtung des Mengen-Faktors der PiI1" 0x8005A2FA CoEOM_facRmpVal Axis_Xs16 3.999939 CoEOMSwt_S16 11 -2.000000 1.999939 FORMAT "%8.6" DEPOSIT ABSOLUTE /end AXIS_PTS
/begin CHARACTERISTIC InjCrv_facPiI1SOERmp0Val_GCUR "Faktorisierungskennlinie für den Einspritzbeginn der PiI1" CURVE 0x8005A312 CurG_Ws16 3.999939 CoEOMSwt_S16 -2.000000 1.999939 FORMAT "%8.6"
 /begin AXIS_DESCR COM_AXIS CoEOM_facRmpVal CoEOMSwt_S16 11 -2.000000 1.999939 FORMAT "%8.6" AXIS_PTS_REF InjCrv_facPiI1SOERmpValX_AXIS /end AXIS_DESCR
/end CHARACTERISTIC
/begin CHARACTERISTIC InjCrv_facPiI1SOERmp1Val_GCUR "Faktorisierungskennlinie für den Einspritzbeginn der PiI1" CURVE 0x8005A328 CurG_Ws16 3.999939 CoEOMSwt_S16 -2.000000 1.999939 FORMAT "%8.6"
 /begin AXIS_DESCR COM_AXIS CoEOM_facRmpVal CoEOMSwt_S16 11 -2.000000 1.999939 FORMAT "%8.6" AXIS_PTS_REF InjCrv_facPiI1SOERmpValX_AXIS /end AXIS_DESCR
/end CHARACTERISTIC
/begin AXIS_PTS InjCrv_facPiI1SOERmpValX_AXIS "Gruppenkennlinien-Achse für die Gewichtung des Einspritzbeginn-Faktors der PiI1" 0x8005A33E CoEOM_facRmpVal Axis_Xs16 3.999939 CoEOMSwt_S16 11 -2.000000 1.999939 FORMAT "%8.6" DEPOSIT ABSOLUTE /end AXIS_PTS
/begin CHARACTERISTIC InjCrv_nMIDynMax_C "Drehzahlschwelle unter der die Korrektur erfolgt" VALUE 0x8005073E Kw_Ws16 6000.000 EngN 0.00 6000.000 FORMAT "%8.3" EXTENDED_LIMITS -16384.00 16383.50 /end CHARACTERISTIC
/begin CHARACTERISTIC InjCrv_pAirPiIRlsHigh_C "obere Hystereseschwelle zur atmosphärendruckabhängigen PiI Freigabekorrektur" VALUE 0x8004F6B4 Val_Ws16 3500.000 Pres_hPa 0.00 3500.000 FORMAT "%8.3" EXTENDED_LIMITS -32768.00 32767.00 /end CHARACTERISTIC
/begin CHARACTERISTIC InjCrv_pAirPiIRlsLow_C "untere Hystereseschwelle zur atmosphärendruckabhängigen PiI Freigabekorrektur" VALUE 0x8004F6B6 Val_Ws16 3500.000 Pres_hPa 0.00 3500.000 FORMAT "%8.3" EXTENDED_LIMITS -32768.00 32767.00 /end CHARACTERISTIC
/begin CHARACTERISTIC InjCrv_phiMI1ATSCor0Rgn_GMAP "Basis-Ansteuerbeginnkorrekturkennfeld 1 der MI1 abhängig von der Ansauglufttemperatur im Regenerationsbetrieb" MAP 0x80051FE4 MapG_Ws16 49.98932 AngleCrS -9.997864 39.99145 FORMAT "%8.5" EXTENDED_LIMITS -720.0220 720.0000
 /begin AXIS_DESCR COM_AXIS Epm_nEng EngN 16 0.00 6000.000 FORMAT "%8.3" EXTENDED_LIMITS -16384.00 16383.50 AXIS_PTS_REF InjCrv_phiMI1ATSCorRgnX_AXIS /end AXIS_DESCR
 /begin AXIS_DESCR COM_AXIS InjCtl_qSetUnBal InjMass 16 0.00 327.6700 FORMAT "%8.4" EXTENDED_LIMITS -327.6800 327.6700 AXIS_PTS_REF InjCrv_phiMI1ATSCorRgnY_AXIS /end AXIS_DESCR
/end CHARACTERISTIC
/begin CHARACTERISTIC InjCrv_phiMI1ATSCor1Rgn_GMAP "Basis-Ansteuerbeginnkorrekturkennfeld 2 der MI1 abhängig von der Ansauglufttemperatur im Regenerationsbetrieb" MAP 0x800521E4 MapG_Ws16 49.98932 AngleCrS -9.997864 39.99145 FORMAT "%8.5" EXTENDED_LIMITS -720.0220 720.0000
 /begin AXIS_DESCR COM_AXIS Epm_nEng EngN 16 0.00 6000.000 FORMAT "%8.3" EXTENDED_LIMITS -16384.00 16383.50 AXIS_PTS_REF InjCrv_phiMI1ATSCorRgnX_AXIS /end AXIS_DESCR
 /begin AXIS_DESCR COM_AXIS InjCtl_qSetUnBal InjMass 16 0.00 327.6700 FORMAT "%8.4" EXTENDED_LIMITS -327.6800 327.6700 AXIS_PTS_REF InjCrv_phiMI1ATSCorRgnY_AXIS /end AXIS_DESCR
/end CHARACTERISTIC
/begin AXIS_PTS InjCrv_phiMI1ATSCorRgnX_AXIS "" 0x800523E4 Epm_nEng Axis_Xs16 6000.000 EngN 16 0.00 6000.000 FORMAT "%8.3" EXTENDED_LIMITS -16384.00 16383.50 DEPOSIT ABSOLUTE /end AXIS_PTS
/begin AXIS_PTS InjCrv_phiMI1ATSCorRgnY_AXIS "" 0x80052406 InjCtl_qSetUnBal Axis_Xs16 327.6700 InjMass 16 0.00 327.6700 FORMAT "%8.4" EXTENDED_LIMITS -327.6800 327.6700 DEPOSIT ABSOLUTE /end AXIS_PTS
/begin CHARACTERISTIC InjCrv_phiMI1Bas0Rgn1_GMAP "Basiskennfeld 1 für den Ansteuerwinkel der HE1 in Regenerationstufe 1" MAP 0x800529EC MapG_Ws16 49.98932 AngleCrS -9.997864 39.99145 FORMAT "%8.5" EXTENDED_LIMITS -720.0220 720.0000
 /begin AXIS_DESCR COM_AXIS Epm_nEng EngN 16 0.00 6000.000 FORMAT "%8.3" EXTENDED_LIMITS -16384.00 16383.50 AXIS_PTS_REF InjCrv_phiMI1BasRgn1X_AXIS /end AXIS_DESCR
 /begin AXIS_DESCR COM_AXIS InjCtl_qSetUnBal InjMass 16 0.00 327.6700 FORMAT "%8.4" EXTENDED_LIMITS -327.6800 327.6700 AXIS_PTS_REF InjCrv_phiMI1BasRgn1Y_AXIS /end AXIS_DESCR
/end CHARACTERISTIC
/begin CHARACTERISTIC InjCrv_phiMI1Bas0Rgn2_GMAP "Basiskennfeld 2 für den Ansteuerwinkel der HE1 in Regenerationstufe 1" MAP 0x80052BEC MapG_Ws16 49.98932 AngleCrS -9.997864 39.99145 FORMAT "%8.5" EXTENDED_LIMITS -720.0220 720.0000
 /begin AXIS_DESCR COM_AXIS Epm_nEng EngN 16 0.00 6000.000 FORMAT "%8.3" EXTENDED_LIMITS -16384.00 16383.50 AXIS_PTS_REF InjCrv_phiMI1BasRgn2X_AXIS /end AXIS_DESCR
 /begin AXIS_DESCR COM_AXIS InjCtl_qSetUnBal InjMass 16 0.00 327.6700 FORMAT "%8.4" EXTENDED_LIMITS -327.6800 327.6700 AXIS_PTS_REF InjCrv_phiMI1BasRgn2Y_AXIS /end AXIS_DESCR
/end CHARACTERISTIC
/begin CHARACTERISTIC InjCrv_phiMI1Bas0Rgn3_GMAP "Basiskennfeld 3 für den Ansteuerwinkel der HE1 in Regenerationstufe 1" MAP 0x80052DEC MapG_Ws16 49.98932 AngleCrS -9.997864 39.99145 FORMAT "%8.5" EXTENDED_LIMITS -720.0220 720.0000
 /begin AXIS_DESCR COM_AXIS Epm_nEng EngN 16 0.00 6000.000 FORMAT "%8.3" EXTENDED_LIMITS -16384.00 16383.50 AXIS_PTS_REF InjCrv_phiMI1BasRgn3X_AXIS /end AXIS_DESCR
 /begin AXIS_DESCR COM_AXIS InjCtl_qSetUnBal InjMass 16 0.00 327.6700 FORMAT "%8.4" EXTENDED_LIMITS -327.6800 327.6700 AXIS_PTS_REF InjCrv_phiMI1BasRgn3Y_AXIS /end AXIS_DESCR
/end CHARACTERISTIC
/begin CHARACTERISTIC InjCrv_phiMI1Bas1BstLP_MAP "" MAP 0x8004F9B0 Map_Xs16Ys16Ws16 1440.022 AngleCrS -720.0220 720.0000 FORMAT "%8.4"
 /begin AXIS_DESCR STD_AXIS Epm_nEng EngN 16 -16384.00 16383.50 FORMAT "%8.2" DEPOSIT ABSOLUTE /end AXIS_DESCR
 /begin AXIS_DESCR STD_AXIS InjCtl_qSetUnBal InjMass 16 -327.6800 327.6700 FORMAT "%8.4" DEPOSIT ABSOLUTE /end AXIS_DESCR
/end CHARACTERISTIC
/begin CHARACTERISTIC InjCrv_phiMI1Bas1Rgn1_GMAP "" MAP 0x80052FEC MapG_Ws16 49.98932 AngleCrS -9.997864 39.99145 FORMAT "%8.5" EXTENDED_LIMITS -720.0220 720.0000
 /begin AXIS_DESCR COM_AXIS Epm_nEng EngN 16 0.00 6000.000 FORMAT "%8.3" EXTENDED_LIMITS -16384.00 16383.50 AXIS_PTS_REF InjCrv_phiMI1BasRgn1X_AXIS /end AXIS_DESCR
 /begin AXIS_DESCR COM_AXIS InjCtl_qSetUnBal InjMass 16 0.00 327.6700 FORMAT "%8.4" EXTENDED_LIMITS -327.6800 327.6700 AXIS_PTS_REF InjCrv_phiMI1BasRgn1Y_AXIS /end AXIS_DESCR
/end CHARACTERISTIC
/begin CHARACTERISTIC InjCrv_phiMI1Bas1Rgn2_GMAP "" MAP 0x800531EC MapG_Ws16 49.98932 AngleCrS -9.997864 39.99145 FORMAT "%8.5" EXTENDED_LIMITS -720.0220 720.0000
 /begin AXIS_DESCR COM_AXIS Epm_nEng EngN 16 0.00 6000.000 FORMAT "%8.3" EXTENDED_LIMITS -16384.00 16383.50 AXIS_PTS_REF InjCrv_phiMI1BasRgn2X_AXIS /end AXIS_DESCR
 /begin AXIS_DESCR COM_AXIS InjCtl_qSetUnBal InjMass 16 0.00 327.6700 FORMAT "%8.4" EXTENDED_LIMITS -327.6800 327.6700 AXIS_PTS_REF InjCrv_phiMI1BasRgn2Y_AXIS /end AXIS_DESCR
/end CHARACTERISTIC
/begin CHARACTERISTIC InjCrv_phiMI1Bas1Rgn3_GMAP "" MAP 0x800533EC MapG_Ws16 49.98932 AngleCrS -9.997864 39.99145 FORMAT "%8.5" EXTENDED_LIMITS -720.0220 720.0000
 /begin AXIS_DESCR COM_AXIS Epm_nEng EngN 16 0.00 6000.000 FORMAT "%8.3" EXTENDED_LIMITS -16384.00 16383.50 AXIS_PTS_REF InjCrv_phiMI1BasRgn3X_AXIS /end AXIS_DESCR
 /begin AXIS_DESCR COM_AXIS InjCtl_qSetUnBal InjMass 16 0.00 327.6700 FORMAT "%8.4" EXTENDED_LIMITS -327.6800 327.6700 AXIS_PTS_REF InjCrv_phiMI1BasRgn3Y_AXIS /end AXIS_DESCR
/end CHARACTERISTIC
/begin CHARACTERISTIC InjCrv_phiMI1Bas1_MAP "1. Grundwertekennfeld, Ansteuerbeginn MI1" MAP 0x8004FBF4 Map_Xs16Ys16Ws16 1440.022 AngleCrS -720.0220 720.0000 FORMAT "%8.4"
 /begin AXIS_DESCR STD_AXIS Epm_nEng EngN 16 0.00 6000.000 FORMAT "%8.3" EXTENDED_LIMITS -16384.00 16383.50 DEPOSIT ABSOLUTE /end AXIS_DESCR
 /begin AXIS_DESCR STD_AXIS InjCtl_qSetUnBal InjMass 16 0.00 327.6700 FORMAT "%8.4" EXTENDED_LIMITS -327.6800 327.6700 DEPOSIT ABSOLUTE /end AXIS_DESCR
/end CHARACTERISTIC
/begin CHARACTERISTIC InjCrv_phiMI1Bas2BstLP_MAP "" MAP 0x8004FE38 Map_Xs16Ys16Ws16 1440.022 AngleCrS -720.0220 720.0000 FORMAT "%8.4"
 /begin AXIS_DESCR STD_AXIS Epm_nEng EngN 16 -16384.00 16383.50 FORMAT "%8.2" DEPOSIT ABSOLUTE /end AXIS_DESCR
 /begin AXIS_DESCR STD_AXIS InjCtl_qSetUnBal InjMass 16 -327.6800 327.6700 FORMAT "%8.4" DEPOSIT ABSOLUTE /end AXIS_DESCR
/end CHARACTERISTIC
/begin CHARACTERISTIC InjCrv_phiMI1Bas2_MAP "2. Grundwertekennfeld, Ansteuerbeginn MI1" MAP 0x8005007C Map_Xs16Ys16Ws16 49.98932 AngleCrS -9.997864 39.99145 FORMAT "%8.5" EXTENDED_LIMITS -720.0220 720.0000
 /begin AXIS_DESCR STD_AXIS Epm_nEng EngN 16 0.00 6000.000 FORMAT "%8.3" EXTENDED_LIMITS -16384.00 16383.50 DEPOSIT ABSOLUTE /end AXIS_DESCR
 /begin AXIS_DESCR STD_AXIS InjCtl_qSetUnBal InjMass 16 0.00 327.6700 FORMAT "%8.4" EXTENDED_LIMITS -327.6800 327.6700 DEPOSIT ABSOLUTE /end AXIS_DESCR
/end CHARACTERISTIC
/begin CHARACTERISTIC InjCrv_phiMI1Bas3_MAP "3. Grundwertekennfeld, Ansteuerbeginn MI1" MAP 0x800502C0 Map_Xs16Ys16Ws16 49.98932 AngleCrS -9.997864 39.99145 FORMAT "%8.5" EXTENDED_LIMITS -720.0220 720.0000
 /begin AXIS_DESCR STD_AXIS Epm_nEng EngN 16 0.00 6000.000 FORMAT "%8.3" EXTENDED_LIMITS -16384.00 16383.50 DEPOSIT ABSOLUTE /end AXIS_DESCR
 /begin AXIS_DESCR STD_AXIS InjCtl_qSetUnBal InjMass 16 0.00 327.6700 FORMAT "%8.4" EXTENDED_LIMITS -327.6800 327.6700 DEPOSIT ABSOLUTE /end AXIS_DESCR
/end CHARACTERISTIC
/begin CHARACTERISTIC InjCrv_phiMI1Bas4_MAP "4. Grundwertekennfeld, Ansteuerbeginn MI1" MAP 0x80050504 Map_Xs16Ys16Ws16 49.98932 AngleCrS -9.997864 39.99145 FORMAT "%8.5" EXTENDED_LIMITS -720.0220 720.0000
 /begin AXIS_DESCR STD_AXIS Epm_nEng EngN 2 0.00 6000.000 FORMAT "%8.3" EXTENDED_LIMITS -16384.00 16383.50 DEPOSIT ABSOLUTE /end AXIS_DESCR
 /begin AXIS_DESCR STD_AXIS InjCtl_qSetUnBal InjMass 2 0.00 327.6700 FORMAT "%8.4" EXTENDED_LIMITS -327.6800 327.6700 DEPOSIT ABSOLUTE /end AXIS_DESCR
/end CHARACTERISTIC
/begin CHARACTERISTIC InjCrv_phiMI1Bas5_MAP "5. Grundwertekennfeld, Ansteuerbeginn MI1" MAP 0x80050518 Map_Xs16Ys16Ws16 49.98932 AngleCrS -9.997864 39.99145 FORMAT "%8.5" EXTENDED_LIMITS -720.0220 720.0000
 /begin AXIS_DESCR STD_AXIS Epm_nEng EngN 2 0.00 6000.000 FORMAT "%8.3" EXTENDED_LIMITS -16384.00 16383.50 DEPOSIT ABSOLUTE /end AXIS_DESCR
 /begin AXIS_DESCR STD_AXIS InjCtl_qSetUnBal InjMass 2 0.00 327.6700 FORMAT "%8.4" EXTENDED_LIMITS -327.6800 327.6700 DEPOSIT ABSOLUTE /end AXIS_DESCR
/end CHARACTERISTIC
/begin AXIS_PTS InjCrv_phiMI1BasRgn1X_AXIS "" 0x800535EC Epm_nEng Axis_Xs16 6000.000 EngN 16 0.00 6000.000 FORMAT "%8.3" EXTENDED_LIMITS -16384.00 16383.50 DEPOSIT ABSOLUTE /end AXIS_PTS
/begin AXIS_PTS InjCrv_phiMI1BasRgn1Y_AXIS "" 0x8005360E InjCtl_qSetUnBal Axis_Xs16 327.6700 InjMass 16 0.00 327.6700 FORMAT "%8.4" EXTENDED_LIMITS -327.6800 327.6700 DEPOSIT ABSOLUTE /end AXIS_PTS
/begin AXIS_PTS InjCrv_phiMI1BasRgn2X_AXIS "" 0x80053630 Epm_nEng Axis_Xs16 6000.000 EngN 16 0.00 6000.000 FORMAT "%8.3" EXTENDED_LIMITS -16384.00 16383.50 DEPOSIT ABSOLUTE /end AXIS_PTS
/begin AXIS_PTS InjCrv_phiMI1BasRgn2Y_AXIS "" 0x80053652 InjCtl_qSetUnBal Axis_Xs16 327.6700 InjMass 16 0.00 327.6700 FORMAT "%8.4" EXTENDED_LIMITS -327.6800 327.6700 DEPOSIT ABSOLUTE /end AXIS_PTS
/begin AXIS_PTS InjCrv_phiMI1BasRgn3X_AXIS "" 0x80053674 Epm_nEng Axis_Xs16 6000.000 EngN 16 0.00 6000.000 FORMAT "%8.3" EXTENDED_LIMITS -16384.00 16383.50 DEPOSIT ABSOLUTE /end AXIS_PTS
/begin AXIS_PTS InjCrv_phiMI1BasRgn3Y_AXIS "" 0x80053696 InjCtl_qSetUnBal Axis_Xs16 327.6700 InjMass 16 0.00 327.6700 FORMAT "%8.4" EXTENDED_LIMITS -327.6800 327.6700 DEPOSIT ABSOLUTE /end AXIS_PTS
/begin CHARACTERISTIC InjCrv_phiMI1BasStrt_MAP "1st base map of MI1 SOE" MAP 0x80053940 Kf_Xs16_Ys16_Ws16 49.98932 AngleCrS -9.997864 39.99145 FORMAT "%8.5" EXTENDED_LIMITS -720.0220 720.0000
 /begin AXIS_DESCR STD_AXIS Epm_nEng EngN 8 0.00 6000.000 FORMAT "%8.3" EXTENDED_LIMITS -16384.00 16383.50 DEPOSIT ABSOLUTE /end AXIS_DESCR
 /begin AXIS_DESCR STD_AXIS InjCtl_qSetUnBal InjMass 8 0.00 327.6700 FORMAT "%8.4" EXTENDED_LIMITS -327.6800 327.6700 DEPOSIT ABSOLUTE /end AXIS_DESCR
/end CHARACTERISTIC
/begin CHARACTERISTIC InjCrv_phiMI1Des_C "Fernsteuerwert des Ansteuerbeginns der MI" VALUE 0x8005052C Val_Ws16 49.98932 AngleCrS -9.997864 39.99145 FORMAT "%8.5" EXTENDED_LIMITS -720.0220 720.0000 /end CHARACTERISTIC
/begin CHARACTERISTIC InjCrv_phiMI1DynCor2_MAP "Basiskorrekturkennfeld für MI bei SOE Korrektur 2" MAP 0x80050740 Kf_Xs16_Ys16_Ws16 50.01129 AngleCrS -25.00565 25.00565 FORMAT "%8.5" EXTENDED_LIMITS -720.0220 720.0000
 /begin AXIS_DESCR STD_AXIS Epm_nEng EngN 12 0.00 6000.000 FORMAT "%8.3" EXTENDED_LIMITS -16384.00 16383.50 DEPOSIT ABSOLUTE /end AXIS_DESCR
 /begin AXIS_DESCR STD_AXIS InjCtl_qSetUnBal InjMass 8 0.00 327.6700 FORMAT "%8.4" EXTENDED_LIMITS -327.6800 327.6700 DEPOSIT ABSOLUTE /end AXIS_DESCR
/end CHARACTERISTIC
/begin CHARACTERISTIC InjCrv_phiMI1ETSCor0Rgn_GMAP "Basis-Ansteuerbeginnkorrekturkennfeld 1 der MI1 abhängig von der Motortemperatur im Regenerationsbetrieb" MAP 0x80052428 MapG_Ws16 49.98932 AngleCrS -9.997864 39.99145 FORMAT "%8.5" EXTENDED_LIMITS -720.0220 720.0000
 /begin AXIS_DESCR COM_AXIS Epm_nEng EngN 16 0.00 6000.000 FORMAT "%8.3" EXTENDED_LIMITS -16384.00 16383.50 AXIS_PTS_REF InjCrv_phiMI1ETSCorRgnX_AXIS /end AXIS_DESCR
 /begin AXIS_DESCR COM_AXIS InjCtl_qSetUnBal InjMass 16 0.00 327.6700 FORMAT "%8.4" EXTENDED_LIMITS -327.6800 327.6700 AXIS_PTS_REF InjCrv_phiMI1ETSCorRgnY_AXIS /end AXIS_DESCR
/end CHARACTERISTIC
/begin CHARACTERISTIC InjCrv_phiMI1ETSCor1Rgn_GMAP "Basis-Ansteuerbeginnkorrekturkennfeld 2 der MI1 abhängig von der Motortemperatur im Regenerationsbetrieb" MAP 0x80052628 MapG_Ws16 49.98932 AngleCrS -9.997864 39.99145 FORMAT "%8.5" EXTENDED_LIMITS -720.0220 720.0000
 /begin AXIS_DESCR COM_AXIS Epm_nEng EngN 16 0.00 6000.000 FORMAT "%8.3" EXTENDED_LIMITS -16384.00 16383.50 AXIS_PTS_REF InjCrv_phiMI1ETSCorRgnX_AXIS /end AXIS_DESCR
 /begin AXIS_DESCR COM_AXIS InjCtl_qSetUnBal InjMass 16 0.00 327.6700 FORMAT "%8.4" EXTENDED_LIMITS -327.6800 327.6700 AXIS_PTS_REF InjCrv_phiMI1ETSCorRgnY_AXIS /end AXIS_DESCR
/end CHARACTERISTIC
/begin AXIS_PTS InjCrv_phiMI1ETSCorRgnX_AXIS "" 0x80052828 Epm_nEng Axis_Xs16 6000.000 EngN 16 0.00 6000.000 FORMAT "%8.3" EXTENDED_LIMITS -16384.00 16383.50 DEPOSIT ABSOLUTE /end AXIS_PTS
/begin AXIS_PTS InjCrv_phiMI1ETSCorRgnY_AXIS "" 0x8005284A InjCtl_qSetUnBal Axis_Xs16 327.6700 InjMass 16 0.00 327.6700 FORMAT "%8.4" EXTENDED_LIMITS -327.6800 327.6700 DEPOSIT ABSOLUTE /end AXIS_PTS
/begin CHARACTERISTIC InjCrv_phiMI1Max1_MAP "Kennfeld 1 für frühesten Ansteuerbeginn MI1" MAP 0x8005052E MapG_Ws16 49.98932 AngleCrS -9.997864 39.99145 FORMAT "%8.5" EXTENDED_LIMITS -720.0220 720.0000
 /begin AXIS_DESCR COM_AXIS Epm_nEng EngN 8 0.00 6000.000 FORMAT "%8.3" EXTENDED_LIMITS -16384.00 16383.50 AXIS_PTS_REF InjCrv_phiMI1Max_X_AXIS /end AXIS_DESCR
 /begin AXIS_DESCR COM_AXIS InjCtl_qSetUnBal InjMass 8 0.00 327.6700 FORMAT "%8.4" EXTENDED_LIMITS -327.6800 327.6700 AXIS_PTS_REF InjCrv_phiMI1Max_Y_AXIS /end AXIS_DESCR
/end CHARACTERISTIC
/begin CHARACTERISTIC InjCrv_phiMI1Max2_MAP "Kennfeld 2 für frühesten Ansteuerbeginn MI1" MAP 0x800505AE MapG_Ws16 49.98932 AngleCrS -9.997864 39.99145 FORMAT "%8.5" EXTENDED_LIMITS -720.0220 720.0000
 /begin AXIS_DESCR COM_AXIS Epm_nEng EngN 8 0.00 6000.000 FORMAT "%8.3" EXTENDED_LIMITS -16384.00 16383.50 AXIS_PTS_REF InjCrv_phiMI1Max_X_AXIS /end AXIS_DESCR
 /begin AXIS_DESCR COM_AXIS InjCtl_qSetUnBal InjMass 8 0.00 327.6700 FORMAT "%8.4" EXTENDED_LIMITS -327.6800 327.6700 AXIS_PTS_REF InjCrv_phiMI1Max_Y_AXIS /end AXIS_DESCR
/end CHARACTERISTIC
/begin AXIS_PTS InjCrv_phiMI1Max_X_AXIS "gemeinsame X-Achse der Kennfelder für frühesten Ansteuerbeginn für MI" 0x8005062E Epm_nEng Axis_Xs16 6000.000 EngN 8 0.00 6000.000 FORMAT "%8.3" EXTENDED_LIMITS -16384.00 16383.50 DEPOSIT ABSOLUTE /end AXIS_PTS
/begin AXIS_PTS InjCrv_phiMI1Max_Y_AXIS "gemeinsame Y-Achse der Kennfelder für frühesten Ansteuerbeginn für MI" 0x80050640 InjCtl_qSetUnBal Axis_Xs16 327.6700 InjMass 8 0.00 327.6700 FORMAT "%8.4" EXTENDED_LIMITS -327.6800 327.6700 DEPOSIT ABSOLUTE /end AXIS_PTS
/begin CHARACTERISTIC InjCrv_phiMI1Min_C "spätester Ansteuerbeginn der MI1" VALUE 0x80050652 Val_Ws16 49.98932 AngleCrS -9.997864 39.99145 FORMAT "%8.5" EXTENDED_LIMITS -720.0220 720.0000 /end CHARACTERISTIC
/begin CHARACTERISTIC InjCrv_phiMIAPSCor1_MAP "atmosphärendruckabhängiges Korrekturkennfeld 1 für Ansteuerbeginn MI1" MAP 0x80050FE4 MapG_Ws16 19.99573 AngleCrS -9.997864 9.997864 FORMAT "%8.5" EXTENDED_LIMITS -720.0220 720.0000
 /begin AXIS_DESCR COM_AXIS Epm_nEng EngN 16 0.00 6000.000 FORMAT "%8.3" EXTENDED_LIMITS -16384.00 16383.50 AXIS_PTS_REF InjCrv_phiMIAPSCor_X_AXIS /end AXIS_DESCR
 /begin AXIS_DESCR COM_AXIS InjCtl_qSetUnBal InjMass 16 0.00 327.6700 FORMAT "%8.4" EXTENDED_LIMITS -327.6800 327.6700 AXIS_PTS_REF InjCrv_phiMIAPSCor_Y_AXIS /end AXIS_DESCR
/end CHARACTERISTIC
/begin CHARACTERISTIC InjCrv_phiMIAPSCor2_MAP "atmosphärendruckabhängiges Korrekturkennfeld 2 für Ansteuerbeginn MI1" MAP 0x800511E4 MapG_Ws16 19.99573 AngleCrS -9.997864 9.997864 FORMAT "%8.5" EXTENDED_LIMITS -720.0220 720.0000
 /begin AXIS_DESCR COM_AXIS Epm_nEng EngN 16 0.00 6000.000 FORMAT "%8.3" EXTENDED_LIMITS -16384.00 16383.50 AXIS_PTS_REF InjCrv_phiMIAPSCor_X_AXIS /end AXIS_DESCR
 /begin AXIS_DESCR COM_AXIS InjCtl_qSetUnBal InjMass 16 0.00 327.6700 FORMAT "%8.4" EXTENDED_LIMITS -327.6800 327.6700 AXIS_PTS_REF InjCrv_phiMIAPSCor_Y_AXIS /end AXIS_DESCR
/end CHARACTERISTIC
/begin CHARACTERISTIC InjCrv_phiMIAPSCorStrt_MAP "base value for SOE correction to be weighted by air pressure" MAP 0x8005082C Kf_Xs16_Ys16_Ws16 1440.022 AngleCrS -720.0220 720.0000 FORMAT "%8.4"
 /begin AXIS_DESCR STD_AXIS Epm_nEng EngN 8 -16384.00 16383.50 FORMAT "%8.2" DEPOSIT ABSOLUTE /end AXIS_DESCR
 /begin AXIS_DESCR STD_AXIS InjCtl_qSetUnBal InjMass 8 -327.6800 327.6700 FORMAT "%8.4" DEPOSIT ABSOLUTE /end AXIS_DESCR
/end CHARACTERISTIC
/begin AXIS_PTS InjCrv_phiMIAPSCor_X_AXIS "" 0x800513E4 Epm_nEng Axis_Xs16 6000.000 EngN 16 0.00 6000.000 FORMAT "%8.3" EXTENDED_LIMITS -16384.00 16383.50 DEPOSIT ABSOLUTE /end AXIS_PTS
/begin AXIS_PTS InjCrv_phiMIAPSCor_Y_AXIS "" 0x80051406 InjCtl_qSetUnBal Axis_Xs16 327.6700 InjMass 16 0.00 327.6700 FORMAT "%8.4" EXTENDED_LIMITS -327.6800 327.6700 DEPOSIT ABSOLUTE /end AXIS_PTS
/begin CHARACTERISTIC InjCrv_phiMIAPSDynCor_MAP "Korrekturkennfeld für Ansteuerbeginn der Haupteinspritzung" MAP 0x800508D0 Kf_Xs16_Ys16_Ws16 50.01129 AngleCrS -25.00565 25.00565 FORMAT "%8.5" EXTENDED_LIMITS -720.0220 720.0000
 /begin AXIS_DESCR STD_AXIS Epm_nEng EngN 4 0.00 6000.000 FORMAT "%8.3" EXTENDED_LIMITS -16384.00 16383.50 DEPOSIT ABSOLUTE /end AXIS_DESCR
 /begin AXIS_DESCR STD_AXIS InjCrv_dpMIDynCor_mp dp_dZ20 4 -1000.000 1000.000 FORMAT "%8.3" EXTENDED_LIMITS -327680.0 327670.0 DEPOSIT ABSOLUTE /end AXIS_DESCR
/end CHARACTERISTIC
/begin CHARACTERISTIC InjCrv_phiMIATSCor1_MAP "ansauglufttemperaturabhängiges Korrekturkennfeld 1 für Ansteuerbeginn MI1" MAP 0x80051428 MapG_Ws16 19.99573 AngleCrS -9.997864 9.997864 FORMAT "%8.5" EXTENDED_LIMITS -720.0220 720.0000
 /begin AXIS_DESCR COM_AXIS Epm_nEng EngN 16 0.00 6000.000 FORMAT "%8.3" EXTENDED_LIMITS -16384.00 16383.50 AXIS_PTS_REF InjCrv_phiMIATSCor_X_AXIS /end AXIS_DESCR
 /begin AXIS_DESCR COM_AXIS InjCtl_qSetUnBal InjMass 16 0.00 327.6700 FORMAT "%8.4" EXTENDED_LIMITS -327.6800 327.6700 AXIS_PTS_REF InjCrv_phiMIATSCor_Y_AXIS /end AXIS_DESCR
/end CHARACTERISTIC
/begin CHARACTERISTIC InjCrv_phiMIATSCor2_MAP "ansauglufttemperaturabhängiges Korrekturkennfeld 2 für Ansteuerbeginn MI1" MAP 0x80051628 MapG_Ws16 19.99573 AngleCrS -9.997864 9.997864 FORMAT "%8.5" EXTENDED_LIMITS -720.0220 720.0000
 /begin AXIS_DESCR COM_AXIS Epm_nEng EngN 16 0.00 6000.000 FORMAT "%8.3" EXTENDED_LIMITS -16384.00 16383.50 AXIS_PTS_REF InjCrv_phiMIATSCor_X_AXIS /end AXIS_DESCR
 /begin AXIS_DESCR COM_AXIS InjCtl_qSetUnBal InjMass 16 0.00 327.6700 FORMAT "%8.4" EXTENDED_LIMITS -327.6800 327.6700 AXIS_PTS_REF InjCrv_phiMIATSCor_Y_AXIS /end AXIS_DESCR
/end CHARACTERISTIC
/begin CHARACTERISTIC InjCrv_phiMIATSCorStrt_MAP "base value for SOE correction to be weighted by intake air temperature" MAP 0x80050904 Kf_Xs16_Ys16_Ws16 1440.022 AngleCrS -720.0220 720.0000 FORMAT "%8.4"
 /begin AXIS_DESCR STD_AXIS Epm_nEng EngN 8 -16384.00 16383.50 FORMAT "%8.2" DEPOSIT ABSOLUTE /end AXIS_DESCR
 /begin AXIS_DESCR STD_AXIS InjCtl_qSetUnBal InjMass 8 -327.6800 327.6700 FORMAT "%8.4" DEPOSIT ABSOLUTE /end AXIS_DESCR
/end CHARACTERISTIC
/begin AXIS_PTS InjCrv_phiMIATSCor_X_AXIS "" 0x80051828 Epm_nEng Axis_Xs16 6000.000 EngN 16 0.00 6000.000 FORMAT "%8.3" EXTENDED_LIMITS -16384.00 16383.50 DEPOSIT ABSOLUTE /end AXIS_PTS
/begin AXIS_PTS InjCrv_phiMIATSCor_Y_AXIS "" 0x8005184A InjCtl_qSetUnBal Axis_Xs16 327.6700 InjMass 16 0.00 327.6700 FORMAT "%8.4" EXTENDED_LIMITS -327.6800 327.6700 DEPOSIT ABSOLUTE /end AXIS_PTS
/begin CHARACTERISTIC InjCrv_phiMIDynCor_MAP "Korrekturkennfeld für Ansteuerbeginn Haupteinspritzung" MAP 0x800509A8 Kf_Xs16_Ys16_Ws16 50.01129 AngleCrS -25.00565 25.00565 FORMAT "%8.5" EXTENDED_LIMITS -720.0220 720.0000
 /begin AXIS_DESCR STD_AXIS Epm_nEng EngN 16 0.00 6000.000 FORMAT "%8.3" EXTENDED_LIMITS -16384.00 16383.50 DEPOSIT ABSOLUTE /end AXIS_DESCR
 /begin AXIS_DESCR STD_AXIS InjCtl_qSetUnBal InjMass 8 0.00 327.6700 FORMAT "%8.4" EXTENDED_LIMITS -327.6800 327.6700 DEPOSIT ABSOLUTE /end AXIS_DESCR
/end CHARACTERISTIC
/begin CHARACTERISTIC InjCrv_phiMIDynMax_C "Max. Grenze für Korrekturwert des Ansteuerbeginns der MI1" VALUE 0x80050ADC Kw_Ws16 50.01129 AngleCrS -25.00565 25.00565 FORMAT "%8.5" EXTENDED_LIMITS -720.0220 720.0000 /end CHARACTERISTIC
/begin CHARACTERISTIC InjCrv_phiMIDynMin_C "Min. Grenze für Korrekturwert des Ansteuerbeginns der MI1" VALUE 0x80050ADE Kw_Ws16 50.01129 AngleCrS -25.00565 25.00565 FORMAT "%8.5" EXTENDED_LIMITS -720.0220 720.0000 /end CHARACTERISTIC
/begin CHARACTERISTIC InjCrv_phiMIETSCor11_GMAP "Motortemperaturabhängiges Ansteuerbeginnkorrekturkennfeld 1 für MI1" MAP 0x80050AE0 Gkf_Ws16 1440.022 AngleCrS -720.0220 720.0000 FORMAT "%8.4"
 /begin AXIS_DESCR COM_AXIS Epm_nEng EngN 16 0.00 6000.000 FORMAT "%8.3" EXTENDED_LIMITS -16384.00 16383.50 AXIS_PTS_REF InjCrv_phiMIETSCor1_X_AXIS /end AXIS_DESCR
 /begin AXIS_DESCR COM_AXIS InjCtl_qSetUnBal InjMass 16 0.00 327.6700 FORMAT "%8.4" EXTENDED_LIMITS -327.6800 327.6700 AXIS_PTS_REF InjCrv_phiMIETSCor1_Y_AXIS /end AXIS_DESCR
/end CHARACTERISTIC
/begin CHARACTERISTIC InjCrv_phiMIETSCor12_GMAP "Motortemperaturabhängiges Ansteuerbeginnkorrekturkennfeld 2 für MI1" MAP 0x80050CE0 Gkf_Ws16 1440.022 AngleCrS -720.0220 720.0000 FORMAT "%8.4"
 /begin AXIS_DESCR COM_AXIS Epm_nEng EngN 16 0.00 6000.000 FORMAT "%8.3" EXTENDED_LIMITS -16384.00 16383.50 AXIS_PTS_REF InjCrv_phiMIETSCor1_X_AXIS /end AXIS_DESCR
 /begin AXIS_DESCR COM_AXIS InjCtl_qSetUnBal InjMass 16 0.00 327.6700 FORMAT "%8.4" EXTENDED_LIMITS -327.6800 327.6700 AXIS_PTS_REF InjCrv_phiMIETSCor1_Y_AXIS /end AXIS_DESCR
/end CHARACTERISTIC
/begin CHARACTERISTIC InjCrv_phiMIETSCor1_MAP "motortemperaturabhängiges Korrekturkennfeld 1 für Ansteuerbeginn MI1" MAP 0x8005186C MapG_Ws16 19.99573 AngleCrS -9.997864 9.997864 FORMAT "%8.5" EXTENDED_LIMITS -720.0220 720.0000
 /begin AXIS_DESCR COM_AXIS Epm_nEng EngN 16 0.00 6000.000 FORMAT "%8.3" EXTENDED_LIMITS -16384.00 16383.50 AXIS_PTS_REF InjCrv_phiMIETSCor_X_AXIS /end AXIS_DESCR
 /begin AXIS_DESCR COM_AXIS InjCtl_qSetUnBal InjMass 16 0.00 327.6700 FORMAT "%8.4" EXTENDED_LIMITS -327.6800 327.6700 AXIS_PTS_REF InjCrv_phiMIETSCor_Y_AXIS /end AXIS_DESCR
/end CHARACTERISTIC
/begin AXIS_PTS InjCrv_phiMIETSCor1_X_AXIS "" 0x80050EE0 Epm_nEng Axis_Xs16 6000.000 EngN 16 0.00 6000.000 FORMAT "%8.3" EXTENDED_LIMITS -16384.00 16383.50 DEPOSIT ABSOLUTE /end AXIS_PTS
/begin AXIS_PTS InjCrv_phiMIETSCor1_Y_AXIS "" 0x80050F02 InjCtl_qSetUnBal Axis_Xs16 327.6700 InjMass 16 0.00 327.6700 FORMAT "%8.4" EXTENDED_LIMITS -327.6800 327.6700 DEPOSIT ABSOLUTE /end AXIS_PTS
/begin CHARACTERISTIC InjCrv_phiMIETSCor2_MAP "motortemperaturabhängiges Korrekturkennfeld 2 für Ansteuerbeginn MI1" MAP 0x80051A6C MapG_Ws16 19.99573 AngleCrS -9.997864 9.997864 FORMAT "%8.5" EXTENDED_LIMITS -720.0220 720.0000
 /begin AXIS_DESCR COM_AXIS Epm_nEng EngN 16 0.00 6000.000 FORMAT "%8.3" EXTENDED_LIMITS -16384.00 16383.50 AXIS_PTS_REF InjCrv_phiMIETSCor_X_AXIS /end AXIS_DESCR
 /begin AXIS_DESCR COM_AXIS InjCtl_qSetUnBal InjMass 16 0.00 327.6700 FORMAT "%8.4" EXTENDED_LIMITS -327.6800 327.6700 AXIS_PTS_REF InjCrv_phiMIETSCor_Y_AXIS /end AXIS_DESCR
/end CHARACTERISTIC
/begin CHARACTERISTIC InjCrv_phiMIETSCorStrt_MAP "base value for SOE correction to be weighted by engine temperature" MAP 0x80050F24 Kf_Xs16_Ys16_Ws16 1440.022 AngleCrS -720.0220 720.0000 FORMAT "%8.4"
 /begin AXIS_DESCR STD_AXIS Epm_nEng EngN 8 -16384.00 16383.50 FORMAT "%8.2" DEPOSIT ABSOLUTE /end AXIS_DESCR
 /begin AXIS_DESCR STD_AXIS InjCtl_qSetUnBal InjMass 8 -327.6800 327.6700 FORMAT "%8.4" DEPOSIT ABSOLUTE /end AXIS_DESCR
/end CHARACTERISTIC
/begin AXIS_PTS InjCrv_phiMIETSCor_X_AXIS "" 0x80051C6C Epm_nEng Axis_Xs16 6000.000 EngN 16 0.00 6000.000 FORMAT "%8.3" EXTENDED_LIMITS -16384.00 16383.50 DEPOSIT ABSOLUTE /end AXIS_PTS
/begin AXIS_PTS InjCrv_phiMIETSCor_Y_AXIS "" 0x80051C8E InjCtl_qSetUnBal Axis_Xs16 327.6700 InjMass 16 0.00 327.6700 FORMAT "%8.4" EXTENDED_LIMITS -327.6800 327.6700 DEPOSIT ABSOLUTE /end AXIS_PTS
/begin CHARACTERISTIC InjCrv_phiMIFTSRailCorMax_C "Maximaler Ansteuerbeginnkorrekturfaktor für MI1, abhängig von der kraftstofftemperaturabhängigen Raildruckkorrektur" VALUE 0x80051CB0 Val_Ws16 1440.022 AngleCrS -720.0220 720.0000 FORMAT "%8.4" /end CHARACTERISTIC
/begin CHARACTERISTIC InjCrv_phiMIFTSRailCorMin_C "Minimaler Ansteuerbeginnkorrekturfaktor für MI1, abhängig von der kraftstofftemperaturabhängigen Raildruckkorrektur" VALUE 0x80051CB2 Val_Ws16 1440.022 AngleCrS -720.0220 720.0000 FORMAT "%8.4" /end CHARACTERISTIC
/begin CHARACTERISTIC InjCrv_phiMIFTSRailCorStrtMax_C "Maximaler Ansteuerbeginnkorrekturfaktor für MI1, abhängig von der kraftstofftemperaturabhängigen Raildruckkorrektur" VALUE 0x80050FC8 Kw_Ws16 1440.022 AngleCrS -720.0220 720.0000 FORMAT "%8.4" /end CHARACTERISTIC
/begin CHARACTERISTIC InjCrv_phiMIFTSRailCorStrtMin_C "Minimaler Ansteuerbeginnkorrekturfaktor für MI1, abhängig von der kraftstofftemperaturabhängigen Raildruckkorrektur" VALUE 0x80050FCA Kw_Ws16 1440.022 AngleCrS -720.0220 720.0000 FORMAT "%8.4" /end CHARACTERISTIC
/begin CHARACTERISTIC InjCrv_phiMIFTSRailCorStrt_MAP "map for correction factor of SOE for the MI1, based on rail pressure" MAP 0x80050FCC Kf_Xs16_Ys16_Ws16 1440.022 AngleCrS -720.0220 720.0000 FORMAT "%8.4"
 /begin AXIS_DESCR STD_AXIS Epm_nEng EngN 2 -16384.00 16383.50 FORMAT "%8.2" DEPOSIT ABSOLUTE /end AXIS_DESCR
 /begin AXIS_DESCR STD_AXIS InjCtl_qSetUnBal InjMass 2 -327.6800 327.6700 FORMAT "%8.4" DEPOSIT ABSOLUTE /end AXIS_DESCR
/end CHARACTERISTIC
/begin CHARACTERISTIC InjCrv_phiMIFTSRailCor_MAP "Korrekturfaktorkennfeld für die MI1, abhängig von der kraftstofftemperaturabhängigen Raildruckkorrektur" MAP 0x80051CB4 Map_Xs16Ys16Ws16 19.99573 AngleCrS -9.997864 9.997864 FORMAT "%8.5" EXTENDED_LIMITS -720.0220 720.0000
 /begin AXIS_DESCR STD_AXIS Epm_nEng EngN 12 0.00 6000.000 FORMAT "%8.3" EXTENDED_LIMITS -16384.00 16383.50 DEPOSIT ABSOLUTE /end AXIS_DESCR
 /begin AXIS_DESCR STD_AXIS InjCtl_qSetUnBal InjMass 8 0.00 327.6700 FORMAT "%8.4" EXTENDED_LIMITS -327.6800 327.6700 DEPOSIT ABSOLUTE /end AXIS_DESCR
/end CHARACTERISTIC
/begin CHARACTERISTIC InjCrv_phiMIPFltCor_MAP "Kennfeld für die Ansteuerbeginnkorrektur der MI1 in Abhängigkeit der Partikelfilterbeladung" MAP 0x80051DA0 Map_Xs16Ys16Ws16 19.99573 AngleCrS -9.997864 9.997864 FORMAT "%8.5" EXTENDED_LIMITS -720.0220 720.0000
 /begin AXIS_DESCR STD_AXIS Epm_nEng EngN 16 0.00 6000.000 FORMAT "%8.3" EXTENDED_LIMITS -16384.00 16383.50 DEPOSIT ABSOLUTE /end AXIS_DESCR
 /begin AXIS_DESCR STD_AXIS InjCtl_qSetUnBal InjMass 16 0.00 327.6700 FORMAT "%8.4" EXTENDED_LIMITS -327.6800 327.6700 DEPOSIT ABSOLUTE /end AXIS_DESCR
/end CHARACTERISTIC
/begin CHARACTERISTIC InjCrv_phiPiI1Des_C "Fernsteuerwert des Ansteuerbeginns (Winkelkomponente) der PiI1" VALUE 0x80053A06 Val_Ws16 720.0000 AngleCrS 0.00 720.0000 FORMAT "%8.4" EXTENDED_LIMITS -720.0220 720.0000 /end CHARACTERISTIC
/begin CHARACTERISTIC InjCrv_phiPiIMax_C "frühester absoluter Ansteuerbeginn einer PiI" VALUE 0x80053A08 Val_Ws16 100.0006 AngleCrS 0.00 100.0006 FORMAT "%8.4" EXTENDED_LIMITS -720.0220 720.0000 /end CHARACTERISTIC
/begin CHARACTERISTIC InjCrv_pMIDynMax_C "Max. Grenze Raildruckdifferenz" VALUE 0x80050FE0 Kw_Ws16 2000.000 Pres_Rail 0.00 2000.000 FORMAT "%5.3" EXTENDED_LIMITS -3276.800 3276.700 /end CHARACTERISTIC
/begin CHARACTERISTIC InjCrv_pMIDynMin_C "Min. Grenze Raildruckdifferenz" VALUE 0x80050FE2 Kw_Ws16 2000.000 Pres_Rail 0.00 2000.000 FORMAT "%5.3" EXTENDED_LIMITS -3276.800 3276.700 /end CHARACTERISTIC
/begin CHARACTERISTIC InjCrv_qMI1Cor_MAP "Mengenkorrekturkennfeld der MI1" MAP 0x800536B8 Kf_Xs16_Ys16_Ws16 655.3500 InjMassInj -327.6800 327.6700 FORMAT "%8.4"
 /begin AXIS_DESCR STD_AXIS Epm_nEng EngN 16 -16384.00 16383.50 FORMAT "%8.2" DEPOSIT ABSOLUTE /end AXIS_DESCR
 /begin AXIS_DESCR STD_AXIS InjCtl_qSetUnBal InjMass 16 -327.6800 327.6700 FORMAT "%8.4" DEPOSIT ABSOLUTE /end AXIS_DESCR
/end CHARACTERISTIC
/begin CHARACTERISTIC InjCrv_qMI1Des_C "Fernsteuerwert der Einspritzmenge der MI" VALUE 0x80050654 Val_Ws16 100.0000 InjMass 0.00 100.0000 FORMAT "%8.4" EXTENDED_LIMITS -327.6800 327.6700 /end CHARACTERISTIC
/begin CHARACTERISTIC InjCrv_qMI1MinPiI1DiffHys_C "Differenzmenge zwischen unterer und oberer Hystereseschwelle bei PiI1 für Freigabe PiI1 wenn genügend Menge für MI und PiI1" VALUE 0x80053A0A Val_Ws16 10.00000 InjMass 0.00 10.00000 FORMAT "%8.5" EXTENDED_LIMITS -327.6800 327.6700 /end CHARACTERISTIC
/begin CHARACTERISTIC InjCrv_qPiI1APSCor0Rgn1_GMAP "Druckabhängiger Basiswert für die Mengenkorrektur 1 der PiI1 für die Regenerationsstufe 1" MAP 0x80055C30 MapG_Ws16 10.00000 InjMass 0.00 10.00000 FORMAT "%8.5" EXTENDED_LIMITS -327.6800 327.6700
 /begin AXIS_DESCR COM_AXIS Epm_nEng EngN 16 0.00 6000.000 FORMAT "%8.3" EXTENDED_LIMITS -16384.00 16383.50 AXIS_PTS_REF InjCrv_qPiI1APSCorRgnX_AXIS /end AXIS_DESCR
 /begin AXIS_DESCR COM_AXIS InjCtl_qSetUnBal InjMass 16 0.00 327.6700 FORMAT "%8.4" EXTENDED_LIMITS -327.6800 327.6700 AXIS_PTS_REF InjCrv_qPiI1APSCorRgnY_AXIS /end AXIS_DESCR
/end CHARACTERISTIC
/begin CHARACTERISTIC InjCrv_qPiI1APSCor0Rgn2_GMAP "Druckabhängiger Basiswert für die Mengenkorrektur 2 der PiI1 für die Regenerationsstufe 1" MAP 0x80055E30 MapG_Ws16 10.00000 InjMass 0.00 10.00000 FORMAT "%8.5" EXTENDED_LIMITS -327.6800 327.6700
 /begin AXIS_DESCR COM_AXIS Epm_nEng EngN 16 0.00 6000.000 FORMAT "%8.3" EXTENDED_LIMITS -16384.00 16383.50 AXIS_PTS_REF InjCrv_qPiI1APSCorRgnX_AXIS /end AXIS_DESCR
 /begin AXIS_DESCR COM_AXIS InjCtl_qSetUnBal InjMass 16 0.00 327.6700 FORMAT "%8.4" EXTENDED_LIMITS -327.6800 327.6700 AXIS_PTS_REF InjCrv_qPiI1APSCorRgnY_AXIS /end AXIS_DESCR
/end CHARACTERISTIC
/begin CHARACTERISTIC InjCrv_qPiI1APSCor1Rgn1_GMAP "Druckabhängiger Basiswert für die Mengenkorrektur 1 der PiI1 für die Regenerationsstufe 2" MAP 0x80056030 MapG_Ws16 10.00000 InjMass 0.00 10.00000 FORMAT "%8.5" EXTENDED_LIMITS -327.6800 327.6700
 /begin AXIS_DESCR COM_AXIS Epm_nEng EngN 16 0.00 6000.000 FORMAT "%8.3" EXTENDED_LIMITS -16384.00 16383.50 AXIS_PTS_REF InjCrv_qPiI1APSCorRgnX_AXIS /end AXIS_DESCR
 /begin AXIS_DESCR COM_AXIS InjCtl_qSetUnBal InjMass 16 0.00 327.6700 FORMAT "%8.4" EXTENDED_LIMITS -327.6800 327.6700 AXIS_PTS_REF InjCrv_qPiI1APSCorRgnY_AXIS /end AXIS_DESCR
/end CHARACTERISTIC
/begin CHARACTERISTIC InjCrv_qPiI1APSCor1Rgn2_GMAP "Druckabhängiger Basiswert für die Mengenkorrektur 2 der PiI1 für die Regenerationsstufe 2" MAP 0x80056230 MapG_Ws16 10.00000 InjMass 0.00 10.00000 FORMAT "%8.5" EXTENDED_LIMITS -327.6800 327.6700
 /begin AXIS_DESCR COM_AXIS Epm_nEng EngN 16 0.00 6000.000 FORMAT "%8.3" EXTENDED_LIMITS -16384.00 16383.50 AXIS_PTS_REF InjCrv_qPiI1APSCorRgnX_AXIS /end AXIS_DESCR
 /begin AXIS_DESCR COM_AXIS InjCtl_qSetUnBal InjMass 16 0.00 327.6700 FORMAT "%8.4" EXTENDED_LIMITS -327.6800 327.6700 AXIS_PTS_REF InjCrv_qPiI1APSCorRgnY_AXIS /end AXIS_DESCR
/end CHARACTERISTIC
/begin CHARACTERISTIC InjCrv_qPiI1APSCor2_MAP "atmosphärendruckabhängige Einspritzmengenkorrekturkennfeld 2 für PiI1 und PiI2" MAP 0x80054F64 MapG_Ws16 10.00000 InjMass 0.00 10.00000 FORMAT "%8.5" EXTENDED_LIMITS -327.6800 327.6700
 /begin AXIS_DESCR COM_AXIS Epm_nEng EngN 16 0.00 6000.000 FORMAT "%8.3" EXTENDED_LIMITS -16384.00 16383.50 AXIS_PTS_REF InjCrv_qPiI1APSCor_X_AXIS /end AXIS_DESCR
 /begin AXIS_DESCR COM_AXIS InjCtl_qSetUnBal InjMass 16 0.00 327.6700 FORMAT "%8.4" EXTENDED_LIMITS -327.6800 327.6700 AXIS_PTS_REF InjCrv_qPiI1APSCor_Y_AXIS /end AXIS_DESCR
/end CHARACTERISTIC
/begin AXIS_PTS InjCrv_qPiI1APSCorRgnX_AXIS "" 0x80056430 Epm_nEng Axis_Xs16 6000.000 EngN 16 0.00 6000.000 FORMAT "%8.3" EXTENDED_LIMITS -16384.00 16383.50 DEPOSIT ABSOLUTE /end AXIS_PTS
/begin AXIS_PTS InjCrv_qPiI1APSCorRgnY_AXIS "" 0x80056452 InjCtl_qSetUnBal Axis_Xs16 327.6700 InjMass 16 0.00 327.6700 FORMAT "%8.4" EXTENDED_LIMITS -327.6800 327.6700 DEPOSIT ABSOLUTE /end AXIS_PTS
/begin CHARACTERISTIC InjCrv_qPiI1APSCorStrt_MAP "correction value for atmospheric pressure dependent pilot injections quantity correction" MAP 0x800542AC Kf_Xs16_Ys16_Ws16 655.3500 InjMassInj -327.6800 327.6700 FORMAT "%8.4"
 /begin AXIS_DESCR STD_AXIS Epm_nEng EngN 8 -16384.00 16383.50 FORMAT "%8.2" DEPOSIT ABSOLUTE /end AXIS_DESCR
 /begin AXIS_DESCR STD_AXIS InjCtl_qSetUnBal InjMass 8 -327.6800 327.6700 FORMAT "%8.4" DEPOSIT ABSOLUTE /end AXIS_DESCR
/end CHARACTERISTIC
/begin CHARACTERISTIC InjCrv_qPiI1APSCor_MAP "atmosphärendruckabhängiges Einspritzmengenkorrekturkennfeld 1 für PiI 1" MAP 0x80055164 MapG_Ws16 10.00000 InjMass 0.00 10.00000 FORMAT "%8.5" EXTENDED_LIMITS -327.6800 327.6700
 /begin AXIS_DESCR COM_AXIS Epm_nEng EngN 16 0.00 6000.000 FORMAT "%8.3" EXTENDED_LIMITS -16384.00 16383.50 AXIS_PTS_REF InjCrv_qPiI1APSCor_X_AXIS /end AXIS_DESCR
 /begin AXIS_DESCR COM_AXIS InjCtl_qSetUnBal InjMass 16 0.00 327.6700 FORMAT "%8.4" EXTENDED_LIMITS -327.6800 327.6700 AXIS_PTS_REF InjCrv_qPiI1APSCor_Y_AXIS /end AXIS_DESCR
/end CHARACTERISTIC
/begin AXIS_PTS InjCrv_qPiI1APSCor_X_AXIS "" 0x80055364 Epm_nEng Axis_Xs16 6000.000 EngN 16 0.00 6000.000 FORMAT "%8.3" EXTENDED_LIMITS -16384.00 16383.50 DEPOSIT ABSOLUTE /end AXIS_PTS
/begin AXIS_PTS InjCrv_qPiI1APSCor_Y_AXIS "" 0x80055386 InjCtl_qSetUnBal Axis_Xs16 327.6700 InjMass 16 0.00 327.6700 FORMAT "%8.4" EXTENDED_LIMITS -327.6800 327.6700 DEPOSIT ABSOLUTE /end AXIS_PTS
/begin CHARACTERISTIC InjCrv_qPiI1ATSCor0Rgn1_GMAP "Lufttemperaturabhängiger Basiswert für die Mengenkorrektur 1 der PiI1 für die Regenerationsstufe 1" MAP 0x80056474 MapG_Ws16 10.00000 InjMass 0.00 10.00000 FORMAT "%8.5" EXTENDED_LIMITS -327.6800 327.6700
 /begin AXIS_DESCR COM_AXIS Epm_nEng EngN 16 0.00 6000.000 FORMAT "%8.3" EXTENDED_LIMITS -16384.00 16383.50 AXIS_PTS_REF InjCrv_qPiI1ATSCorRgnX_AXIS /end AXIS_DESCR
 /begin AXIS_DESCR COM_AXIS InjCtl_qSetUnBal InjMass 16 0.00 327.6700 FORMAT "%8.4" EXTENDED_LIMITS -327.6800 327.6700 AXIS_PTS_REF InjCrv_qPiI1ATSCorRgnY_AXIS /end AXIS_DESCR
/end CHARACTERISTIC
/begin CHARACTERISTIC InjCrv_qPiI1ATSCor0Rgn2_GMAP "Lufttemperaturabhängiger Basiswert für die Mengenkorrektur 2 der PiI1 für die Regenerationsstufe 1" MAP 0x80056674 MapG_Ws16 10.00000 InjMass 0.00 10.00000 FORMAT "%8.5" EXTENDED_LIMITS -327.6800 327.6700
 /begin AXIS_DESCR COM_AXIS Epm_nEng EngN 16 0.00 6000.000 FORMAT "%8.3" EXTENDED_LIMITS -16384.00 16383.50 AXIS_PTS_REF InjCrv_qPiI1ATSCorRgnX_AXIS /end AXIS_DESCR
 /begin AXIS_DESCR COM_AXIS InjCtl_qSetUnBal InjMass 16 0.00 327.6700 FORMAT "%8.4" EXTENDED_LIMITS -327.6800 327.6700 AXIS_PTS_REF InjCrv_qPiI1ATSCorRgnY_AXIS /end AXIS_DESCR
/end CHARACTERISTIC
/begin CHARACTERISTIC InjCrv_qPiI1ATSCor1Rgn1_GMAP "Lufttemperaturabhängiger Basiswert für die Mengenkorrektur 1 der PiI1 für die Regenerationsstufe 2" MAP 0x80056874 MapG_Ws16 10.00000 InjMass 0.00 10.00000 FORMAT "%8.5" EXTENDED_LIMITS -327.6800 327.6700
 /begin AXIS_DESCR COM_AXIS Epm_nEng EngN 16 0.00 6000.000 FORMAT "%8.3" EXTENDED_LIMITS -16384.00 16383.50 AXIS_PTS_REF InjCrv_qPiI1ATSCorRgnX_AXIS /end AXIS_DESCR
 /begin AXIS_DESCR COM_AXIS InjCtl_qSetUnBal InjMass 16 0.00 327.6700 FORMAT "%8.4" EXTENDED_LIMITS -327.6800 327.6700 AXIS_PTS_REF InjCrv_qPiI1ATSCorRgnY_AXIS /end AXIS_DESCR
/end CHARACTERISTIC
/begin CHARACTERISTIC InjCrv_qPiI1ATSCor1Rgn2_GMAP "Lufttemperaturabhängiger Basiswert für die Mengenkorrektur 2 der PiI1 für die Regenerationsstufe 2" MAP 0x80056A74 MapG_Ws16 10.00000 InjMass 0.00 10.00000 FORMAT "%8.5" EXTENDED_LIMITS -327.6800 327.6700
 /begin AXIS_DESCR COM_AXIS Epm_nEng EngN 16 0.00 6000.000 FORMAT "%8.3" EXTENDED_LIMITS -16384.00 16383.50 AXIS_PTS_REF InjCrv_qPiI1ATSCorRgnX_AXIS /end AXIS_DESCR
 /begin AXIS_DESCR COM_AXIS InjCtl_qSetUnBal InjMass 16 0.00 327.6700 FORMAT "%8.4" EXTENDED_LIMITS -327.6800 327.6700 AXIS_PTS_REF InjCrv_qPiI1ATSCorRgnY_AXIS /end AXIS_DESCR
/end CHARACTERISTIC
/begin CHARACTERISTIC InjCrv_qPiI1ATSCor2_MAP "ansauglufttemperaturabhängiges Einspritzmengenkorrekturkennfeld 2 für PiI1 und PiI2" MAP 0x800553A8 MapG_Ws16 10.00000 InjMass 0.00 10.00000 FORMAT "%8.5" EXTENDED_LIMITS -327.6800 327.6700
 /begin AXIS_DESCR COM_AXIS Epm_nEng EngN 16 0.00 6000.000 FORMAT "%8.3" EXTENDED_LIMITS -16384.00 16383.50 AXIS_PTS_REF InjCrv_qPiI1ATSCor_X_AXIS /end AXIS_DESCR
 /begin AXIS_DESCR COM_AXIS InjCtl_qSetUnBal InjMass 16 0.00 327.6700 FORMAT "%8.4" EXTENDED_LIMITS -327.6800 327.6700 AXIS_PTS_REF InjCrv_qPiI1ATSCor_Y_AXIS /end AXIS_DESCR
/end CHARACTERISTIC
/begin AXIS_PTS InjCrv_qPiI1ATSCorRgnX_AXIS "" 0x80056C74 Epm_nEng Axis_Xs16 6000.000 EngN 16 0.00 6000.000 FORMAT "%8.3" EXTENDED_LIMITS -16384.00 16383.50 DEPOSIT ABSOLUTE /end AXIS_PTS
/begin AXIS_PTS InjCrv_qPiI1ATSCorRgnY_AXIS "" 0x80056C96 InjCtl_qSetUnBal Axis_Xs16 327.6700 InjMass 16 0.00 327.6700 FORMAT "%8.4" EXTENDED_LIMITS -327.6800 327.6700 DEPOSIT ABSOLUTE /end AXIS_PTS
/begin CHARACTERISTIC InjCrv_qPiI1ATSCorStrt_MAP "correction value for intake air temperature dependent pilot injections quantity correction" MAP 0x80054350 Kf_Xs16_Ys16_Ws16 655.3500 InjMassInj -327.6800 327.6700 FORMAT "%8.4"
 /begin AXIS_DESCR STD_AXIS Epm_nEng EngN 8 -16384.00 16383.50 FORMAT "%8.2" DEPOSIT ABSOLUTE /end AXIS_DESCR
 /begin AXIS_DESCR STD_AXIS InjCtl_qSetUnBal InjMass 8 -327.6800 327.6700 FORMAT "%8.4" DEPOSIT ABSOLUTE /end AXIS_DESCR
/end CHARACTERISTIC
/begin CHARACTERISTIC InjCrv_qPiI1ATSCor_MAP "ansauglufttemperaturabhängiges Mengenkorrekturkennfeld für PiI 1" MAP 0x800555A8 MapG_Ws16 10.00000 InjMass 0.00 10.00000 FORMAT "%8.5" EXTENDED_LIMITS -327.6800 327.6700
 /begin AXIS_DESCR COM_AXIS Epm_nEng EngN 16 0.00 6000.000 FORMAT "%8.3" EXTENDED_LIMITS -16384.00 16383.50 AXIS_PTS_REF InjCrv_qPiI1ATSCor_X_AXIS /end AXIS_DESCR
 /begin AXIS_DESCR COM_AXIS InjCtl_qSetUnBal InjMass 16 0.00 327.6700 FORMAT "%8.4" EXTENDED_LIMITS -327.6800 327.6700 AXIS_PTS_REF InjCrv_qPiI1ATSCor_Y_AXIS /end AXIS_DESCR
/end CHARACTERISTIC
/begin AXIS_PTS InjCrv_qPiI1ATSCor_X_AXIS "" 0x800557A8 Epm_nEng Axis_Xs16 6000.000 EngN 16 0.00 6000.000 FORMAT "%8.3" EXTENDED_LIMITS -16384.00 16383.50 DEPOSIT ABSOLUTE /end AXIS_PTS
/begin AXIS_PTS InjCrv_qPiI1ATSCor_Y_AXIS "" 0x800557CA InjCtl_qSetUnBal Axis_Xs16 327.6700 InjMass 16 0.00 327.6700 FORMAT "%8.4" EXTENDED_LIMITS -327.6800 327.6700 DEPOSIT ABSOLUTE /end AXIS_PTS
/begin CHARACTERISTIC InjCrv_qPiI1Bas0Rgn1_GMAP "Kennfeld für Basiswert für die Basismenge der PiI1 für die Regenerationsstufe 1 bei inaktiver PiI2" MAP 0x80059002 MapG_Ws16 10.00000 InjMass 0.00 10.00000 FORMAT "%8.5" EXTENDED_LIMITS -327.6800 327.6700
 /begin AXIS_DESCR COM_AXIS Epm_nEng EngN 16 0.00 6000.000 FORMAT "%8.3" EXTENDED_LIMITS -16384.00 16383.50 AXIS_PTS_REF InjCrv_qPiI1BasRgnX_AXIS /end AXIS_DESCR
 /begin AXIS_DESCR COM_AXIS InjCtl_qSetUnBal InjMass 16 0.00 327.6700 FORMAT "%8.4" EXTENDED_LIMITS -327.6800 327.6700 AXIS_PTS_REF InjCrv_qPiI1BasRgnY_AXIS /end AXIS_DESCR
/end CHARACTERISTIC
/begin CHARACTERISTIC InjCrv_qPiI1Bas0Rgn2_GMAP "Kennfeld für Basiswert für die Basismenge der PiI1 für die Regenerationsstufe 1 bei aktiver PiI2" MAP 0x80059202 MapG_Ws16 10.00000 InjMass 0.00 10.00000 FORMAT "%8.5" EXTENDED_LIMITS -327.6800 327.6700
 /begin AXIS_DESCR COM_AXIS Epm_nEng EngN 16 0.00 6000.000 FORMAT "%8.3" EXTENDED_LIMITS -16384.00 16383.50 AXIS_PTS_REF InjCrv_qPiI1BasRgnX_AXIS /end AXIS_DESCR
 /begin AXIS_DESCR COM_AXIS InjCtl_qSetUnBal InjMass 16 0.00 327.6700 FORMAT "%8.4" EXTENDED_LIMITS -327.6800 327.6700 AXIS_PTS_REF InjCrv_qPiI1BasRgnY_AXIS /end AXIS_DESCR
/end CHARACTERISTIC
/begin CHARACTERISTIC InjCrv_qPiI1Bas1Rgn1_GMAP "Kennfeld für Basiswert für die Basismenge der PiI1 für die Regenerationsstufe 2 bei inaktiver PiI2" MAP 0x80059402 MapG_Ws16 10.00000 InjMass 0.00 10.00000 FORMAT "%8.5" EXTENDED_LIMITS -327.6800 327.6700
 /begin AXIS_DESCR COM_AXIS Epm_nEng EngN 16 0.00 6000.000 FORMAT "%8.3" EXTENDED_LIMITS -16384.00 16383.50 AXIS_PTS_REF InjCrv_qPiI1BasRgnX_AXIS /end AXIS_DESCR
 /begin AXIS_DESCR COM_AXIS InjCtl_qSetUnBal InjMass 16 0.00 327.6700 FORMAT "%8.4" EXTENDED_LIMITS -327.6800 327.6700 AXIS_PTS_REF InjCrv_qPiI1BasRgnY_AXIS /end AXIS_DESCR
/end CHARACTERISTIC
/begin CHARACTERISTIC InjCrv_qPiI1Bas1Rgn2_GMAP "Kennfeld für Basiswert für die Basismenge der PiI1 für die Regenerationsstufe 2 bei aktiver PiI2" MAP 0x80059602 MapG_Ws16 10.00000 InjMass 0.00 10.00000 FORMAT "%8.5" EXTENDED_LIMITS -327.6800 327.6700
 /begin AXIS_DESCR COM_AXIS Epm_nEng EngN 16 0.00 6000.000 FORMAT "%8.3" EXTENDED_LIMITS -16384.00 16383.50 AXIS_PTS_REF InjCrv_qPiI1BasRgnX_AXIS /end AXIS_DESCR
 /begin AXIS_DESCR COM_AXIS InjCtl_qSetUnBal InjMass 16 0.00 327.6700 FORMAT "%8.4" EXTENDED_LIMITS -327.6800 327.6700 AXIS_PTS_REF InjCrv_qPiI1BasRgnY_AXIS /end AXIS_DESCR
/end CHARACTERISTIC
/begin CHARACTERISTIC InjCrv_qPiI1Bas1_MAP "Einspritzmenge PiI1 Grundwertekennfeld 1" MAP 0x80053A0C MapG_Ws16 10.00000 InjMass 0.00 10.00000 FORMAT "%8.5" EXTENDED_LIMITS -327.6800 327.6700
 /begin AXIS_DESCR COM_AXIS Epm_nEng EngN 16 0.00 6000.000 FORMAT "%8.3" EXTENDED_LIMITS -16384.00 16383.50 AXIS_PTS_REF InjCrv_qPiI1Bas_X_AXIS /end AXIS_DESCR
 /begin AXIS_DESCR COM_AXIS InjCtl_qSetUnBal InjMass 16 0.00 327.6700 FORMAT "%8.4" EXTENDED_LIMITS -327.6800 327.6700 AXIS_PTS_REF InjCrv_qPiI1Bas_Y_AXIS /end AXIS_DESCR
/end CHARACTERISTIC
/begin CHARACTERISTIC InjCrv_qPiI1Bas2_MAP "Einspritzmenge PiI1 Grundwertekennfeld 2" MAP 0x80053C0C MapG_Ws16 10.00000 InjMass 0.00 10.00000 FORMAT "%8.5" EXTENDED_LIMITS -327.6800 327.6700
 /begin AXIS_DESCR COM_AXIS Epm_nEng EngN 16 0.00 6000.000 FORMAT "%8.3" EXTENDED_LIMITS -16384.00 16383.50 AXIS_PTS_REF InjCrv_qPiI1Bas_X_AXIS /end AXIS_DESCR
 /begin AXIS_DESCR COM_AXIS InjCtl_qSetUnBal InjMass 16 0.00 327.6700 FORMAT "%8.4" EXTENDED_LIMITS -327.6800 327.6700 AXIS_PTS_REF InjCrv_qPiI1Bas_Y_AXIS /end AXIS_DESCR
/end CHARACTERISTIC
/begin AXIS_PTS InjCrv_qPiI1BasRgnX_AXIS "" 0x80059802 Epm_nEng Axis_Xs16 6000.000 EngN 16 0.00 6000.000 FORMAT "%8.3" EXTENDED_LIMITS -16384.00 16383.50 DEPOSIT ABSOLUTE /end AXIS_PTS
/begin AXIS_PTS InjCrv_qPiI1BasRgnY_AXIS "" 0x80059824 InjCtl_qSetUnBal Axis_Xs16 327.6700 InjMass 16 0.00 327.6700 FORMAT "%8.4" EXTENDED_LIMITS -327.6800 327.6700 DEPOSIT ABSOLUTE /end AXIS_PTS
/begin AXIS_PTS InjCrv_qPiI1Bas_X_AXIS "gemeinsame X-Achse für Einspritzmengengrundwertkennfelder für Voreinspritzung 1" 0x80053E0C Epm_nEng Axis_Xs16 6000.000 EngN 16 0.00 6000.000 FORMAT "%8.3" EXTENDED_LIMITS -16384.00 16383.50 DEPOSIT ABSOLUTE /end AXIS_PTS
/begin AXIS_PTS InjCrv_qPiI1Bas_Y_AXIS "gemeinsame Y-Achse für Einspritzmengegrundwertkennfelder für Voreinspritzung 1" 0x80053E2E InjCtl_qSetUnBal Axis_Xs16 327.6700 InjMass 16 0.00 327.6700 FORMAT "%8.4" EXTENDED_LIMITS -327.6800 327.6700 DEPOSIT ABSOLUTE /end AXIS_PTS
/begin CHARACTERISTIC InjCrv_qPiI1Des_C "Fernsteuerwert der Einspritzmenge von PiI1" VALUE 0x80053E50 Val_Ws16 100.0000 InjMass 0.00 100.0000 FORMAT "%8.4" EXTENDED_LIMITS -327.6800 327.6700 /end CHARACTERISTIC
/begin CHARACTERISTIC InjCrv_qPiI1DynQCor_MAP "Kennfeld für drehzahlabhängige Mengenkorrektur der Voreinspritzung PiI1" MAP 0x800543F4 Kf_Xs16_Ys16_Ws16 327.6700 InjMassInj 0.00 327.6700 FORMAT "%8.4" EXTENDED_LIMITS -327.6800 327.6700
 /begin AXIS_DESCR STD_AXIS Epm_nEng EngN 16 0.00 6000.000 FORMAT "%8.3" EXTENDED_LIMITS -16384.00 16383.50 DEPOSIT ABSOLUTE /end AXIS_DESCR
 /begin AXIS_DESCR STD_AXIS InjCtl_qSetUnBal InjMass 8 0.00 327.6700 FORMAT "%8.4" EXTENDED_LIMITS -327.6800 327.6700 DEPOSIT ABSOLUTE /end AXIS_DESCR
/end CHARACTERISTIC
/begin CHARACTERISTIC InjCrv_qPiI1ETSCor0Rgn1_GMAP "Motortemperaturabhängiger Basiswert für die Mengenkorrektur 1 der PiI1 für die Regenerationsstufe 1" MAP 0x80056CB8 MapG_Ws16 10.00000 InjMass 0.00 10.00000 FORMAT "%8.5" EXTENDED_LIMITS -327.6800 327.6700
 /begin AXIS_DESCR COM_AXIS Epm_nEng EngN 16 0.00 6000.000 FORMAT "%8.3" EXTENDED_LIMITS -16384.00 16383.50 AXIS_PTS_REF InjCrv_qPiI1ETSCorRgnX_AXIS /end AXIS_DESCR
 /begin AXIS_DESCR COM_AXIS InjCtl_qSetUnBal InjMass 16 0.00 327.6700 FORMAT "%8.4" EXTENDED_LIMITS -327.6800 327.6700 AXIS_PTS_REF InjCrv_qPiI1ETSCorRgnY_AXIS /end AXIS_DESCR
/end CHARACTERISTIC
/begin CHARACTERISTIC InjCrv_qPiI1ETSCor0Rgn2_GMAP "Motortemperaturabhängiger Basiswert für die Mengenkorrektur 2 der PiI1 für die Regenerationsstufe 1" MAP 0x80056EB8 MapG_Ws16 10.00000 InjMass 0.00 10.00000 FORMAT "%8.5" EXTENDED_LIMITS -327.6800 327.6700
 /begin AXIS_DESCR COM_AXIS Epm_nEng EngN 16 0.00 6000.000 FORMAT "%8.3" EXTENDED_LIMITS -16384.00 16383.50 AXIS_PTS_REF InjCrv_qPiI1ETSCorRgnX_AXIS /end AXIS_DESCR
 /begin AXIS_DESCR COM_AXIS InjCtl_qSetUnBal InjMass 16 0.00 327.6700 FORMAT "%8.4" EXTENDED_LIMITS -327.6800 327.6700 AXIS_PTS_REF InjCrv_qPiI1ETSCorRgnY_AXIS /end AXIS_DESCR
/end CHARACTERISTIC
/begin CHARACTERISTIC InjCrv_qPiI1ETSCor11_MAP "motortemperaturabhängiges Einspritzmengenkorrekturkennfeld -1 für PiI1 und PiI2" MAP 0x80054528 Kf_Xs16_Ys16_Ws16 655.3500 InjMassInj -327.6800 327.6700 FORMAT "%8.4"
 /begin AXIS_DESCR STD_AXIS Epm_nEng EngN 16 -16384.00 16383.50 FORMAT "%8.2" DEPOSIT ABSOLUTE /end AXIS_DESCR
 /begin AXIS_DESCR STD_AXIS InjCtl_qSetUnBal InjMass 16 -327.6800 327.6700 FORMAT "%8.4" DEPOSIT ABSOLUTE /end AXIS_DESCR
/end CHARACTERISTIC
/begin CHARACTERISTIC InjCrv_qPiI1ETSCor12_MAP "motortemperaturabhängiges Mengenkorrekturkennfeld für PiI1 bei aktiver PiI2" MAP 0x8005476C Kf_Xs16_Ys16_Ws16 655.3500 InjMassInj -327.6800 327.6700 FORMAT "%8.4"
 /begin AXIS_DESCR STD_AXIS Epm_nEng EngN 16 -16384.00 16383.50 FORMAT "%8.2" DEPOSIT ABSOLUTE /end AXIS_DESCR
 /begin AXIS_DESCR STD_AXIS InjCtl_qSetUnBal InjMass 16 -327.6800 327.6700 FORMAT "%8.4" DEPOSIT ABSOLUTE /end AXIS_DESCR
/end CHARACTERISTIC
/begin CHARACTERISTIC InjCrv_qPiI1ETSCor1Rgn1_GMAP "Motortemperaturabhängiger Basiswert für die Mengenkorrektur 1 der PiI1 für die Regenerationsstufe 2" MAP 0x800570B8 MapG_Ws16 10.00000 InjMass 0.00 10.00000 FORMAT "%8.5" EXTENDED_LIMITS -327.6800 327.6700
 /begin AXIS_DESCR COM_AXIS Epm_nEng EngN 16 0.00 6000.000 FORMAT "%8.3" EXTENDED_LIMITS -16384.00 16383.50 AXIS_PTS_REF InjCrv_qPiI1ETSCorRgnX_AXIS /end AXIS_DESCR
 /begin AXIS_DESCR COM_AXIS InjCtl_qSetUnBal InjMass 16 0.00 327.6700 FORMAT "%8.4" EXTENDED_LIMITS -327.6800 327.6700 AXIS_PTS_REF InjCrv_qPiI1ETSCorRgnY_AXIS /end AXIS_DESCR
/end CHARACTERISTIC
/begin CHARACTERISTIC InjCrv_qPiI1ETSCor1Rgn2_GMAP "Motortemperaturabhängiger Basiswert für die Mengenkorrektur 2 der PiI1 für die Regenerationsstufe 2" MAP 0x800572B8 MapG_Ws16 10.00000 InjMass 0.00 10.00000 FORMAT "%8.5" EXTENDED_LIMITS -327.6800 327.6700
 /begin AXIS_DESCR COM_AXIS Epm_nEng EngN 16 0.00 6000.000 FORMAT "%8.3" EXTENDED_LIMITS -16384.00 16383.50 AXIS_PTS_REF InjCrv_qPiI1ETSCorRgnX_AXIS /end AXIS_DESCR
 /begin AXIS_DESCR COM_AXIS InjCtl_qSetUnBal InjMass 16 0.00 327.6700 FORMAT "%8.4" EXTENDED_LIMITS -327.6800 327.6700 AXIS_PTS_REF InjCrv_qPiI1ETSCorRgnY_AXIS /end AXIS_DESCR
/end CHARACTERISTIC
/begin CHARACTERISTIC InjCrv_qPiI1ETSCor2_MAP "motortemperaturabhängiges Einspritzmengenkorrekturkennfeld 2 für PiI1 und PiI2" MAP 0x800557EC MapG_Ws16 10.00000 InjMass 0.00 10.00000 FORMAT "%8.5" EXTENDED_LIMITS -327.6800 327.6700
 /begin AXIS_DESCR COM_AXIS Epm_nEng EngN 16 0.00 6000.000 FORMAT "%8.3" EXTENDED_LIMITS -16384.00 16383.50 AXIS_PTS_REF InjCrv_qPiI1ETSCor_X_AXIS /end AXIS_DESCR
 /begin AXIS_DESCR COM_AXIS InjCtl_qSetUnBal InjMass 16 0.00 327.6700 FORMAT "%8.4" EXTENDED_LIMITS -327.6800 327.6700 AXIS_PTS_REF InjCrv_qPiI1ETSCor_Y_AXIS /end AXIS_DESCR
/end CHARACTERISTIC
/begin AXIS_PTS InjCrv_qPiI1ETSCorRgnX_AXIS "" 0x800574B8 Epm_nEng Axis_Xs16 6000.000 EngN 16 0.00 6000.000 FORMAT "%8.3" EXTENDED_LIMITS -16384.00 16383.50 DEPOSIT ABSOLUTE /end AXIS_PTS
/begin AXIS_PTS InjCrv_qPiI1ETSCorRgnY_AXIS "" 0x800574DA InjCtl_qSetUnBal Axis_Xs16 327.6700 InjMass 16 0.00 327.6700 FORMAT "%8.4" EXTENDED_LIMITS -327.6800 327.6700 DEPOSIT ABSOLUTE /end AXIS_PTS
/begin CHARACTERISTIC InjCrv_qPiI1ETSCorStrt_MAP "correction value for engine temperature dependent pilot injections quantity correction" MAP 0x800549B0 Kf_Xs16_Ys16_Ws16 655.3500 InjMassInj -327.6800 327.6700 FORMAT "%8.4"
 /begin AXIS_DESCR STD_AXIS Epm_nEng EngN 8 -16384.00 16383.50 FORMAT "%8.2" DEPOSIT ABSOLUTE /end AXIS_DESCR
 /begin AXIS_DESCR STD_AXIS InjCtl_qSetUnBal InjMass 8 -327.6800 327.6700 FORMAT "%8.4" DEPOSIT ABSOLUTE /end AXIS_DESCR
/end CHARACTERISTIC
/begin CHARACTERISTIC InjCrv_qPiI1ETSCor_MAP "motortemperaturabhängiges Mengenkorrekturkennfeld für PiI 1" MAP 0x800559EC MapG_Ws16 10.00000 InjMass 0.00 10.00000 FORMAT "%8.5" EXTENDED_LIMITS -327.6800 327.6700
 /begin AXIS_DESCR COM_AXIS Epm_nEng EngN 16 0.00 6000.000 FORMAT "%8.3" EXTENDED_LIMITS -16384.00 16383.50 AXIS_PTS_REF InjCrv_qPiI1ETSCor_X_AXIS /end AXIS_DESCR
 /begin AXIS_DESCR COM_AXIS InjCtl_qSetUnBal InjMass 16 0.00 327.6700 FORMAT "%8.4" EXTENDED_LIMITS -327.6800 327.6700 AXIS_PTS_REF InjCrv_qPiI1ETSCor_Y_AXIS /end AXIS_DESCR
/end CHARACTERISTIC
/begin AXIS_PTS InjCrv_qPiI1ETSCor_X_AXIS "" 0x80055BEC Epm_nEng Axis_Xs16 6000.000 EngN 16 0.00 6000.000 FORMAT "%8.3" EXTENDED_LIMITS -16384.00 16383.50 DEPOSIT ABSOLUTE /end AXIS_PTS
/begin AXIS_PTS InjCrv_qPiI1ETSCor_Y_AXIS "" 0x80055C0E InjCtl_qSetUnBal Axis_Xs16 327.6700 InjMass 16 0.00 327.6700 FORMAT "%8.4" EXTENDED_LIMITS -327.6800 327.6700 DEPOSIT ABSOLUTE /end AXIS_PTS
/begin CHARACTERISTIC InjCrv_qPiI1Max1_MAP "Einspritzmenge PiI1 Maximalwertekennfeld 1" MAP 0x80053E52 MapG_Ws16 10.00000 InjMass 0.00 10.00000 FORMAT "%8.5" EXTENDED_LIMITS -327.6800 327.6700
 /begin AXIS_DESCR COM_AXIS Epm_nEng EngN 8 0.00 6000.000 FORMAT "%8.3" EXTENDED_LIMITS -16384.00 16383.50 AXIS_PTS_REF InjCrv_qPiI1Max_X_AXIS /end AXIS_DESCR
 /begin AXIS_DESCR COM_AXIS InjCtl_qSetUnBal InjMass 16 0.00 327.6700 FORMAT "%8.4" EXTENDED_LIMITS -327.6800 327.6700 AXIS_PTS_REF InjCrv_qPiI1Max_Y_AXIS /end AXIS_DESCR
/end CHARACTERISTIC
/begin CHARACTERISTIC InjCrv_qPiI1Max2_MAP "Einspritzmenge PiI1 Maximalwertekennfeld 2" MAP 0x80053F52 MapG_Ws16 10.00000 InjMass 0.00 10.00000 FORMAT "%8.5" EXTENDED_LIMITS -327.6800 327.6700
 /begin AXIS_DESCR COM_AXIS Epm_nEng EngN 8 0.00 6000.000 FORMAT "%8.3" EXTENDED_LIMITS -16384.00 16383.50 AXIS_PTS_REF InjCrv_qPiI1Max_X_AXIS /end AXIS_DESCR
 /begin AXIS_DESCR COM_AXIS InjCtl_qSetUnBal InjMass 16 0.00 327.6700 FORMAT "%8.4" EXTENDED_LIMITS -327.6800 327.6700 AXIS_PTS_REF InjCrv_qPiI1Max_Y_AXIS /end AXIS_DESCR
/end CHARACTERISTIC
/begin CHARACTERISTIC InjCrv_qPiI1MaxRgn_MAP "Einspritzmenge PiI1 Maximalwertekennfeld im Regenerationsbetrieb" MAP 0x80059846 Map_Xs16Ys16Ws16 10.00000 InjMass 0.00 10.00000 FORMAT "%8.5" EXTENDED_LIMITS -327.6800 327.6700
 /begin AXIS_DESCR STD_AXIS Epm_nEng EngN 16 0.00 6000.000 FORMAT "%8.3" EXTENDED_LIMITS -16384.00 16383.50 DEPOSIT ABSOLUTE /end AXIS_DESCR
 /begin AXIS_DESCR STD_AXIS InjCtl_qSetUnBal InjMass 16 0.00 327.6700 FORMAT "%8.4" EXTENDED_LIMITS -327.6800 327.6700 DEPOSIT ABSOLUTE /end AXIS_DESCR
/end CHARACTERISTIC
/begin AXIS_PTS InjCrv_qPiI1Max_X_AXIS "gemeinsame X-Achse für Einspritzmengenmaximalwertkennfelder für Voreinspritzung 1" 0x80054052 Epm_nEng Axis_Xs16 6000.000 EngN 8 0.00 6000.000 FORMAT "%8.3" EXTENDED_LIMITS -16384.00 16383.50 DEPOSIT ABSOLUTE /end AXIS_PTS
/begin AXIS_PTS InjCrv_qPiI1Max_Y_AXIS "gemeinsame Y-Achse für Einspritzmengenmaximalwertkennfelder für Voreinspritzung 1" 0x80054064 InjCtl_qSetUnBal Axis_Xs16 327.6700 InjMass 16 0.00 327.6700 FORMAT "%8.4" EXTENDED_LIMITS -327.6800 327.6700 DEPOSIT ABSOLUTE /end AXIS_PTS
/begin CHARACTERISTIC InjCrv_qPiI1MinDiff_C "Minimalmenge zwischen unteren und oberen Hystheresenschwelle für Voreinspritzung 1" VALUE 0x80054086 Val_Ws16 10.00000 InjMass 0.00 10.00000 FORMAT "%8.5" EXTENDED_LIMITS -327.6800 327.6700 /end CHARACTERISTIC
/begin CHARACTERISTIC InjCrv_rOpRngATSHys_C "Ansauglufttemperatur-Hystereseschwelle zur Bestimmung des Betriebsbereichs" VALUE 0x8004F6C4 Val_Ws16 100.0000 Prc 0.00 100.0000 FORMAT "%8.4" EXTENDED_LIMITS -400.0000 399.9878 /end CHARACTERISTIC
/begin CHARACTERISTIC InjCrv_rOpRngETSHys_C "Motortemperatur-Hystereseschwelle zur Bestimmung des Betriebsbereichs" VALUE 0x8004F6C6 Val_Ws16 100.0000 Prc 0.00 100.0000 FORMAT "%8.4" EXTENDED_LIMITS -400.0000 399.9878 /end CHARACTERISTIC
/begin CHARACTERISTIC InjCrv_stInjCharActVal_C "Fernsteuerwert der Einspritzcharakteristik Istwert" VALUE 0x80050656 Val_Wu8 255.0 OneToOne 0.00 255.0 FORMAT "%5.1" /end CHARACTERISTIC
/begin CHARACTERISTIC InjCrv_stInjDstSel_C "Status der Darstellung relativer Zeitabstände der Einspritzungen" VALUE 0x80054088 Val_Wu8 255.0 OneToOne 0.00 255.0 FORMAT "%5.1" /end CHARACTERISTIC
/begin CHARACTERISTIC InjCrv_stPiIRlsGearCor_C "Korrekturwert zur gangabhängigen PiI Freigabekorrektur" VALUE 0x8004F6B8 Val_Wu8 5.000 OneToOne 1.000 6.000 FORMAT "%5.3" EXTENDED_LIMITS 0.00 255.0 /end CHARACTERISTIC
/begin CHARACTERISTIC InjCrv_stPiIRlsGearThres_C "Schwelle zur gangabhängigen PiI Freigabekorrektur" VALUE 0x8004F6B9 Val_Wu8 6.000 OneToOne 0.00 6.000 FORMAT "%5.3" EXTENDED_LIMITS 0.00 255.0 /end CHARACTERISTIC
/begin CHARACTERISTIC InjCrv_stPiIRlsGear_C "PiI Freigabestatus zur gangabhängigen PiI Freigabekorrektur" VALUE 0x8004F6BA Val_Wu8 5.000 OneToOne 1.000 6.000 FORMAT "%5.3" EXTENDED_LIMITS 0.00 255.0 /end CHARACTERISTIC
/begin CHARACTERISTIC InjCrv_stPiIRlsPresAirCor_C "Korrekturwert zur atmosphärendruckabhängigen PiI Freigabekorrektur" VALUE 0x8004F6BB Val_Wu8 5.000 OneToOne 1.000 6.000 FORMAT "%5.3" EXTENDED_LIMITS 0.00 255.0 /end CHARACTERISTIC
/begin CHARACTERISTIC InjCrv_stPiIRlsPresAir_C "PiI Freigabestatus zur atmosphärendruckabhängigen PiI Freigabekorrektur" VALUE 0x8004F6BC Val_Wu8 5.000 OneToOne 1.000 6.000 FORMAT "%5.3" EXTENDED_LIMITS 0.00 255.0 /end CHARACTERISTIC
/begin CHARACTERISTIC InjCrv_stPiIRlsVehSpdCor_C "Korrekturwert zur fahrzeuggeschwindigkeitsabhängigen PiI Freigabekorrektur" VALUE 0x8004F6BD Val_Wu8 5.000 OneToOne 1.000 6.000 FORMAT "%5.3" EXTENDED_LIMITS 0.00 255.0 /end CHARACTERISTIC
/begin CHARACTERISTIC InjCrv_stPiIRlsVehSpd_C "PiI Freigabestatus zur fahrzeuggeschwindigkeitsabhängigen PiI Freigabekorrektur" VALUE 0x8004F6BE Val_Wu8 5.000 OneToOne 1.000 6.000 FORMAT "%5.3" EXTENDED_LIMITS 0.00 255.0 /end CHARACTERISTIC
/begin CHARACTERISTIC InjCrv_stRlsOpRngThresRgn_MAP "Betriebsbereichsschwellen für die Freigabe der Voreinspritzungen im Regenerationsbetrieb" MAP 0x8004F6C8 Map_Xs16Ys16Ws16 4.000000 OneToOne 1.000000 5.000000 FORMAT "%8.6" EXTENDED_LIMITS -32768.00 32767.00
 /begin AXIS_DESCR STD_AXIS InjSys_tEng Temp_Cels 16 -50.14000 199.8600 FORMAT "%8.4" EXTENDED_LIMITS -3549.940 3003.560 DEPOSIT ABSOLUTE /end AXIS_DESCR
 /begin AXIS_DESCR STD_AXIS CACDsT_t Temp_Cels 16 -50.14000 199.8600 FORMAT "%8.4" EXTENDED_LIMITS -3549.940 3003.560 DEPOSIT ABSOLUTE /end AXIS_DESCR
/end CHARACTERISTIC
/begin CHARACTERISTIC InjCrv_stRlsOpRngThres_MAP "Betriebsbereichsschwellen für die Freigabe der Voreinspritzungen" MAP 0x8004F90C Map_Xs16Ys16Ws16 4.000000 OneToOne 1.000000 5.000000 FORMAT "%8.6" EXTENDED_LIMITS -32768.00 32767.00
 /begin AXIS_DESCR STD_AXIS InjSys_tEng Temp_Cels 8 -50.14000 199.8600 FORMAT "%8.4" EXTENDED_LIMITS -3549.940 3003.560 DEPOSIT ABSOLUTE /end AXIS_DESCR
 /begin AXIS_DESCR STD_AXIS CACDsT_t Temp_Cels 8 -50.14000 199.8600 FORMAT "%8.4" EXTENDED_LIMITS -3549.940 3003.560 DEPOSIT ABSOLUTE /end AXIS_DESCR
/end CHARACTERISTIC
/begin CHARACTERISTIC InjCrv_swtPhiMI1Des_C "Schalter des Fernsteuerwerts des Ansteuerbeginns der MI" VALUE 0x80050657 Val_Wu8 1.000 OneToOne 0.00 1.000 FORMAT "%5.3" EXTENDED_LIMITS 0.00 255.0 /end CHARACTERISTIC
/begin CHARACTERISTIC InjCrv_swtPhiPiI1Des_C "Schalter des Fernsteuerwerts des Ansteuerbeginns (Winkelkomponente) der PiI1" VALUE 0x80054089 Val_Wu8 1.000 OneToOne 0.00 1.000 FORMAT "%5.3" EXTENDED_LIMITS 0.00 255.0 /end CHARACTERISTIC
/begin CHARACTERISTIC InjCrv_swtQntMI1Des_C "Schalter des Fernsteuerwerts der Einspritzmenge der MI1" VALUE 0x80050658 Val_Wu8 1.000 OneToOne 0.00 1.000 FORMAT "%5.3" EXTENDED_LIMITS 0.00 255.0 /end CHARACTERISTIC
/begin CHARACTERISTIC InjCrv_swtQntPiI1Des_C "Schalter des Fernsteuerwerts der Einspritzmenge der PiI1" VALUE 0x8005408A Val_Wu8 1.000 OneToOne 0.00 1.000 FORMAT "%5.3" EXTENDED_LIMITS 0.00 255.0 /end CHARACTERISTIC
/begin CHARACTERISTIC InjCrv_swtStInjCharActVal_C "Schalter des Fernsteuerwerts der Einspritzcharakteristik Istwert" VALUE 0x80050659 Val_Wu8 1.000 OneToOne 0.00 1.000 FORMAT "%5.3" EXTENDED_LIMITS 0.00 255.0 /end CHARACTERISTIC
/begin CHARACTERISTIC InjCrv_swtTiPiI1Des_C "Schalter des Fernsteuerwerts des Ansteuerbeginns (Zeitkomponente) der PiI1" VALUE 0x8005408B Val_Wu8 1.000 OneToOne 0.00 1.000 FORMAT "%5.3" EXTENDED_LIMITS 0.00 255.0 /end CHARACTERISTIC
/begin CHARACTERISTIC InjCrv_tiLowNegPT1_C "dq filter time constant neg. slope low range" VALUE 0x8007F688 Kw_Wu32 4294.9672950 TimeDelay_s 0.000001000000000 4294.9672960 FORMAT "%12.7" /end CHARACTERISTIC
/begin CHARACTERISTIC InjCrv_tiLowPosPT1_C "dq filter time constant pos. slope low range" VALUE 0x8007F68C Kw_Wu32 4294.9672950 TimeDelay_s 0.000001000000000 4294.9672960 FORMAT "%12.7" /end CHARACTERISTIC
/begin CHARACTERISTIC InjCrv_tiMidNegPT1_C "dq filter time constant neg. slope medium range" VALUE 0x8007F690 Kw_Wu32 4294.9672950 TimeDelay_s 0.000001000000000 4294.9672960 FORMAT "%12.7" /end CHARACTERISTIC
/begin CHARACTERISTIC InjCrv_tiMidPosPT1_C "dq filter time constant pos. slope medium range" VALUE 0x8007F694 Kw_Wu32 4294.9672950 TimeDelay_s 0.000001000000000 4294.9672960 FORMAT "%12.7" /end CHARACTERISTIC
/begin CHARACTERISTIC InjCrv_tiPiI1ATSCor0Rgn1_GMAP "Lufttemperaturabhängiger Basiswert für Ansteuerbeginnkorrektur 1 für die PiI1 für die Regenerationsstufe 1" MAP 0x800574FC MapG_Ws16 18000.00 InjTime_us -13000.00 5000.00 FORMAT "%8.2" EXTENDED_LIMITS -13107.20 13106.80
 /begin AXIS_DESCR COM_AXIS Epm_nEng EngN 16 0.00 6000.000 FORMAT "%8.3" EXTENDED_LIMITS -16384.00 16383.50 AXIS_PTS_REF InjCrv_tiPiI1ATSCorRgnX_AXIS /end AXIS_DESCR
 /begin AXIS_DESCR COM_AXIS InjCtl_qSetUnBal InjMass 16 0.00 327.6700 FORMAT "%8.4" EXTENDED_LIMITS -327.6800 327.6700 AXIS_PTS_REF InjCrv_tiPiI1ATSCorRgnY_AXIS /end AXIS_DESCR
/end CHARACTERISTIC
/begin CHARACTERISTIC InjCrv_tiPiI1ATSCor0Rgn2_GMAP "Lufttemperaturabhängiger Basiswert für Ansteuerbeginnkorrektur 2 für die PiI1 für die Regenerationsstufe 1" MAP 0x800576FC MapG_Ws16 18000.00 InjTime_us -13000.00 5000.00 FORMAT "%8.2" EXTENDED_LIMITS -13107.20 13106.80
 /begin AXIS_DESCR COM_AXIS Epm_nEng EngN 16 0.00 6000.000 FORMAT "%8.3" EXTENDED_LIMITS -16384.00 16383.50 AXIS_PTS_REF InjCrv_tiPiI1ATSCorRgnX_AXIS /end AXIS_DESCR
 /begin AXIS_DESCR COM_AXIS InjCtl_qSetUnBal InjMass 16 0.00 327.6700 FORMAT "%8.4" EXTENDED_LIMITS -327.6800 327.6700 AXIS_PTS_REF InjCrv_tiPiI1ATSCorRgnY_AXIS /end AXIS_DESCR
/end CHARACTERISTIC
/begin CHARACTERISTIC InjCrv_tiPiI1ATSCor1Rgn1_GMAP "Lufttemperaturabhängiger Basiswert für Ansteuerbeginnkorrektur 1 für die PiI1 für die Regenerationsstufe 2" MAP 0x800578FC MapG_Ws16 18000.00 InjTime_us -13000.00 5000.00 FORMAT "%8.2" EXTENDED_LIMITS -13107.20 13106.80
 /begin AXIS_DESCR COM_AXIS Epm_nEng EngN 16 0.00 6000.000 FORMAT "%8.3" EXTENDED_LIMITS -16384.00 16383.50 AXIS_PTS_REF InjCrv_tiPiI1ATSCorRgnX_AXIS /end AXIS_DESCR
 /begin AXIS_DESCR COM_AXIS InjCtl_qSetUnBal InjMass 16 0.00 327.6700 FORMAT "%8.4" EXTENDED_LIMITS -327.6800 327.6700 AXIS_PTS_REF InjCrv_tiPiI1ATSCorRgnY_AXIS /end AXIS_DESCR
/end CHARACTERISTIC
/begin CHARACTERISTIC InjCrv_tiPiI1ATSCor1Rgn2_GMAP "Lufttemperaturabhängiger Basiswert für Ansteuerbeginnkorrektur 2 für die PiI1 für die Regenerationsstufe 2" MAP 0x80057AFC MapG_Ws16 18000.00 InjTime_us -13000.00 5000.00 FORMAT "%8.2" EXTENDED_LIMITS -13107.20 13106.80
 /begin AXIS_DESCR COM_AXIS Epm_nEng EngN 16 0.00 6000.000 FORMAT "%8.3" EXTENDED_LIMITS -16384.00 16383.50 AXIS_PTS_REF InjCrv_tiPiI1ATSCorRgnX_AXIS /end AXIS_DESCR
 /begin AXIS_DESCR COM_AXIS InjCtl_qSetUnBal InjMass 16 0.00 327.6700 FORMAT "%8.4" EXTENDED_LIMITS -327.6800 327.6700 AXIS_PTS_REF InjCrv_tiPiI1ATSCorRgnY_AXIS /end AXIS_DESCR
/end CHARACTERISTIC
/begin CHARACTERISTIC InjCrv_tiPiI1ATSCor1_MAP "Ansauglufttemperaturabhängiges Korrekturgrundwertekennfeld für die Zeitkomponente des Ansteuerbeginns der PiI1 bei inaktiver PiI2" MAP 0x80058912 Map_Xs16Ys16Ws16 18000.00 InjTime_us -13000.00 5000.00 FORMAT "%8.2" EXTENDED_LIMITS -13107.20 13106.80
 /begin AXIS_DESCR STD_AXIS Epm_nEng EngN 16 0.00 6000.000 FORMAT "%8.3" EXTENDED_LIMITS -16384.00 16383.50 DEPOSIT ABSOLUTE /end AXIS_DESCR
 /begin AXIS_DESCR STD_AXIS InjCtl_qSetUnBal InjMass 8 0.00 327.6700 FORMAT "%8.4" EXTENDED_LIMITS -327.6800 327.6700 DEPOSIT ABSOLUTE /end AXIS_DESCR
/end CHARACTERISTIC
/begin CHARACTERISTIC InjCrv_tiPiI1ATSCor2_MAP "Ansauglufttemperaturabhängiges Korrekturgrundwertekennfeld für die Zeitkomponente des Ansteuerbeginns der PiI1 bei aktiver PiI2" MAP 0x80058A46 Map_Xs16Ys16Ws16 18000.00 InjTime_us -13000.00 5000.00 FORMAT "%8.2" EXTENDED_LIMITS -13107.20 13106.80
 /begin AXIS_DESCR STD_AXIS Epm_nEng EngN 16 0.00 6000.000 FORMAT "%8.3" EXTENDED_LIMITS -16384.00 16383.50 DEPOSIT ABSOLUTE /end AXIS_DESCR
 /begin AXIS_DESCR STD_AXIS InjCtl_qSetUnBal InjMass 8 0.00 327.6700 FORMAT "%8.4" EXTENDED_LIMITS -327.6800 327.6700 DEPOSIT ABSOLUTE /end AXIS_DESCR
/end CHARACTERISTIC
/begin AXIS_PTS InjCrv_tiPiI1ATSCorRgnX_AXIS "" 0x80057CFC Epm_nEng Axis_Xs16 6000.000 EngN 16 0.00 6000.000 FORMAT "%8.3" EXTENDED_LIMITS -16384.00 16383.50 DEPOSIT ABSOLUTE /end AXIS_PTS
/begin AXIS_PTS InjCrv_tiPiI1ATSCorRgnY_AXIS "" 0x80057D1E InjCtl_qSetUnBal Axis_Xs16 327.6700 InjMass 16 0.00 327.6700 FORMAT "%8.4" EXTENDED_LIMITS -327.6800 327.6700 DEPOSIT ABSOLUTE /end AXIS_PTS
/begin CHARACTERISTIC InjCrv_tiPiI1Bas0Rgn1_GMAP "Basiskennfeld für die Zeitkomponente des Ansteuerbeginns der PiI1 für die Regenerationsstufe 1 bei inaktiver PiI2" MAP 0x80059A8A MapG_Ws16 5000.00 InjTime_us 0.00 5000.00 FORMAT "%8.2" EXTENDED_LIMITS -13107.20 13106.80
 /begin AXIS_DESCR COM_AXIS Epm_nEng EngN 16 0.00 6000.000 FORMAT "%8.3" EXTENDED_LIMITS -16384.00 16383.50 AXIS_PTS_REF InjCrv_tiPiI1BasRgnX_AXIS /end AXIS_DESCR
 /begin AXIS_DESCR COM_AXIS InjCtl_qSetUnBal InjMass 16 0.00 327.6700 FORMAT "%8.4" EXTENDED_LIMITS -327.6800 327.6700 AXIS_PTS_REF InjCrv_tiPiI1BasRgnY_AXIS /end AXIS_DESCR
/end CHARACTERISTIC
/begin CHARACTERISTIC InjCrv_tiPiI1Bas0Rgn2_GMAP "Basiskennfeld für die Zeitkomponente des Ansteuerbeginns der PiI1 für die Regenerationsstufe 1 bei aktiver PiI2" MAP 0x80059C8A MapG_Ws16 5000.00 InjTime_us 0.00 5000.00 FORMAT "%8.2" EXTENDED_LIMITS -13107.20 13106.80
 /begin AXIS_DESCR COM_AXIS Epm_nEng EngN 16 0.00 6000.000 FORMAT "%8.3" EXTENDED_LIMITS -16384.00 16383.50 AXIS_PTS_REF InjCrv_tiPiI1BasRgnX_AXIS /end AXIS_DESCR
 /begin AXIS_DESCR COM_AXIS InjCtl_qSetUnBal InjMass 16 0.00 327.6700 FORMAT "%8.4" EXTENDED_LIMITS -327.6800 327.6700 AXIS_PTS_REF InjCrv_tiPiI1BasRgnY_AXIS /end AXIS_DESCR
/end CHARACTERISTIC
/begin CHARACTERISTIC InjCrv_tiPiI1Bas1Rgn1_GMAP "Basiskennfeld für die Zeitkomponente des Ansteuerbeginns der PiI1 für die Regenerationsstufe 2 bei inaktiver PiI2" MAP 0x80059E8A MapG_Ws16 5000.00 InjTime_us 0.00 5000.00 FORMAT "%8.2" EXTENDED_LIMITS -13107.20 13106.80
 /begin AXIS_DESCR COM_AXIS Epm_nEng EngN 16 0.00 6000.000 FORMAT "%8.3" EXTENDED_LIMITS -16384.00 16383.50 AXIS_PTS_REF InjCrv_tiPiI1BasRgnX_AXIS /end AXIS_DESCR
 /begin AXIS_DESCR COM_AXIS InjCtl_qSetUnBal InjMass 16 0.00 327.6700 FORMAT "%8.4" EXTENDED_LIMITS -327.6800 327.6700 AXIS_PTS_REF InjCrv_tiPiI1BasRgnY_AXIS /end AXIS_DESCR
/end CHARACTERISTIC
/begin CHARACTERISTIC InjCrv_tiPiI1Bas1Rgn2_GMAP "Basiskennfeld für die Zeitkomponente des Ansteuerbeginns der PiI1 für die Regenerationsstufe 2 bei aktiver PiI2" MAP 0x8005A08A MapG_Ws16 5000.00 InjTime_us 0.00 5000.00 FORMAT "%8.2" EXTENDED_LIMITS -13107.20 13106.80
 /begin AXIS_DESCR COM_AXIS Epm_nEng EngN 16 0.00 6000.000 FORMAT "%8.3" EXTENDED_LIMITS -16384.00 16383.50 AXIS_PTS_REF InjCrv_tiPiI1BasRgnX_AXIS /end AXIS_DESCR
 /begin AXIS_DESCR COM_AXIS InjCtl_qSetUnBal InjMass 16 0.00 327.6700 FORMAT "%8.4" EXTENDED_LIMITS -327.6800 327.6700 AXIS_PTS_REF InjCrv_tiPiI1BasRgnY_AXIS /end AXIS_DESCR
/end CHARACTERISTIC
/begin AXIS_PTS InjCrv_tiPiI1BasRgnX_AXIS "" 0x8005A28A Epm_nEng Axis_Xs16 6000.000 EngN 16 0.00 6000.000 FORMAT "%8.3" EXTENDED_LIMITS -16384.00 16383.50 DEPOSIT ABSOLUTE /end AXIS_PTS
/begin AXIS_PTS InjCrv_tiPiI1BasRgnY_AXIS "" 0x8005A2AC InjCtl_qSetUnBal Axis_Xs16 327.6700 InjMass 16 0.00 327.6700 FORMAT "%8.4" EXTENDED_LIMITS -327.6800 327.6700 DEPOSIT ABSOLUTE /end AXIS_PTS
/begin CHARACTERISTIC InjCrv_tiPiI1Des_C "Fernsteuerwert des Ansteuerbeginns (Zeitkomponente) der PiI1" VALUE 0x8005408C Val_Ws16 5000.00 InjTime_us 0.00 5000.00 FORMAT "%8.2" EXTENDED_LIMITS -13107.20 13106.80 /end CHARACTERISTIC
/begin CHARACTERISTIC InjCrv_tiPiI1DynCor_MAP "base correction map of pilot injection angle correction" MAP 0x80054A54 Kf_Xs16_Ys16_Ws16 18000.00 InjTime_us -13000.00 5000.00 FORMAT "%8.2" EXTENDED_LIMITS -13107.20 13106.80
 /begin AXIS_DESCR STD_AXIS Epm_nEng EngN 16 0.00 6000.000 FORMAT "%8.3" EXTENDED_LIMITS -16384.00 16383.50 DEPOSIT ABSOLUTE /end AXIS_DESCR
 /begin AXIS_DESCR STD_AXIS InjCtl_qSetUnBal InjMass 8 0.00 327.6700 FORMAT "%8.4" EXTENDED_LIMITS -327.6800 327.6700 DEPOSIT ABSOLUTE /end AXIS_DESCR
/end CHARACTERISTIC
/begin CHARACTERISTIC InjCrv_tiPiI1ETSCor0Rgn1_GMAP "Motortemperaturabhängiger Basiswert für Ansteuerbeginnkorrektur 1 für die PiI1 für die Regenerationsstufe 1" MAP 0x80057D40 MapG_Ws16 18000.00 InjTime_us -13000.00 5000.00 FORMAT "%8.2" EXTENDED_LIMITS -13107.20 13106.80
 /begin AXIS_DESCR COM_AXIS Epm_nEng EngN 16 0.00 6000.000 FORMAT "%8.3" EXTENDED_LIMITS -16384.00 16383.50 AXIS_PTS_REF InjCrv_tiPiI1ETSCorRgnX_AXIS /end AXIS_DESCR
 /begin AXIS_DESCR COM_AXIS InjCtl_qSetUnBal InjMass 16 0.00 327.6700 FORMAT "%8.4" EXTENDED_LIMITS -327.6800 327.6700 AXIS_PTS_REF InjCrv_tiPiI1ETSCorRgnY_AXIS /end AXIS_DESCR
/end CHARACTERISTIC
/begin CHARACTERISTIC InjCrv_tiPiI1ETSCor0Rgn2_GMAP "Motortemperaturabhängiger Basiswert für Ansteuerbeginnkorrektur 2 für die PiI1 für die Regenerationsstufe 1" MAP 0x80057F40 MapG_Ws16 18000.00 InjTime_us -13000.00 5000.00 FORMAT "%8.2" EXTENDED_LIMITS -13107.20 13106.80
 /begin AXIS_DESCR COM_AXIS Epm_nEng EngN 16 0.00 6000.000 FORMAT "%8.3" EXTENDED_LIMITS -16384.00 16383.50 AXIS_PTS_REF InjCrv_tiPiI1ETSCorRgnX_AXIS /end AXIS_DESCR
 /begin AXIS_DESCR COM_AXIS InjCtl_qSetUnBal InjMass 16 0.00 327.6700 FORMAT "%8.4" EXTENDED_LIMITS -327.6800 327.6700 AXIS_PTS_REF InjCrv_tiPiI1ETSCorRgnY_AXIS /end AXIS_DESCR
/end CHARACTERISTIC
/begin CHARACTERISTIC InjCrv_tiPiI1ETSCor11_MAP "motortemperaturabhängiges Korrekturgrundwertekennfeld -1 für die Zeitkomponente Ansteuerbeginn PiI1" MAP 0x80054B88 Kf_Xs16_Ys16_Ws16 18107.20 InjTime_us -13107.20 5000.00 FORMAT "%8.2" EXTENDED_LIMITS -13107.20 13106.80
 /begin AXIS_DESCR STD_AXIS Epm_nEng EngN 16 -16384.00 16383.50 FORMAT "%8.2" DEPOSIT ABSOLUTE /end AXIS_DESCR
 /begin AXIS_DESCR STD_AXIS InjCtl_qSetUnBal InjMass 16 -327.6800 327.6700 FORMAT "%8.4" DEPOSIT ABSOLUTE /end AXIS_DESCR
/end CHARACTERISTIC
/begin CHARACTERISTIC InjCrv_tiPiI1ETSCor12_MAP "motortemperaturabhängiges Korrekturgrundwertekennfeld für die Zeitkomponente des Ansteuerbeginns der PiI1bei aktiver PiI2" MAP 0x80054DCC Kf_Xs16_Ys16_Ws16 18107.20 InjTime_us -13107.20 5000.00 FORMAT "%8.2" EXTENDED_LIMITS -13107.20 13106.80
 /begin AXIS_DESCR STD_AXIS Epm_nEng EngN 10 -16384.00 16383.50 FORMAT "%8.2" DEPOSIT ABSOLUTE /end AXIS_DESCR
 /begin AXIS_DESCR STD_AXIS InjCtl_qSetUnBal InjMass 10 -327.6800 327.6700 FORMAT "%8.4" DEPOSIT ABSOLUTE /end AXIS_DESCR
/end CHARACTERISTIC
/begin CHARACTERISTIC InjCrv_tiPiI1ETSCor1Rgn1_GMAP "Motortemperaturabhängiger Basiswert für Ansteuerbeginnkorrektur 1 für die PiI1 für die Regenerationsstufe 2" MAP 0x80058140 MapG_Ws16 18000.00 InjTime_us -13000.00 5000.00 FORMAT "%8.2" EXTENDED_LIMITS -13107.20 13106.80
 /begin AXIS_DESCR COM_AXIS Epm_nEng EngN 16 0.00 6000.000 FORMAT "%8.3" EXTENDED_LIMITS -16384.00 16383.50 AXIS_PTS_REF InjCrv_tiPiI1ETSCorRgnX_AXIS /end AXIS_DESCR
 /begin AXIS_DESCR COM_AXIS InjCtl_qSetUnBal InjMass 16 0.00 327.6700 FORMAT "%8.4" EXTENDED_LIMITS -327.6800 327.6700 AXIS_PTS_REF InjCrv_tiPiI1ETSCorRgnY_AXIS /end AXIS_DESCR
/end CHARACTERISTIC
/begin CHARACTERISTIC InjCrv_tiPiI1ETSCor1Rgn2_GMAP "Motortemperaturabhängiger Basiswert für Ansteuerbeginnkorrektur 2 für die PiI1 für die Regenerationsstufe 2" MAP 0x80058340 MapG_Ws16 18000.00 InjTime_us -13000.00 5000.00 FORMAT "%8.2" EXTENDED_LIMITS -13107.20 13106.80
 /begin AXIS_DESCR COM_AXIS Epm_nEng EngN 16 0.00 6000.000 FORMAT "%8.3" EXTENDED_LIMITS -16384.00 16383.50 AXIS_PTS_REF InjCrv_tiPiI1ETSCorRgnX_AXIS /end AXIS_DESCR
 /begin AXIS_DESCR COM_AXIS InjCtl_qSetUnBal InjMass 16 0.00 327.6700 FORMAT "%8.4" EXTENDED_LIMITS -327.6800 327.6700 AXIS_PTS_REF InjCrv_tiPiI1ETSCorRgnY_AXIS /end AXIS_DESCR
/end CHARACTERISTIC
/begin CHARACTERISTIC InjCrv_tiPiI1ETSCor1_MAP "motortemperaturabhängiges Korrekturgrundwertekennfeld -1 für die Zeitkomponente Ansteuerbeginn PiI1" MAP 0x80058B7A Map_Xs16Ys16Ws16 18000.00 InjTime_us -13000.00 5000.00 FORMAT "%8.2" EXTENDED_LIMITS -13107.20 13106.80
 /begin AXIS_DESCR STD_AXIS Epm_nEng EngN 16 0.00 6000.000 FORMAT "%8.3" EXTENDED_LIMITS -16384.00 16383.50 DEPOSIT ABSOLUTE /end AXIS_DESCR
 /begin AXIS_DESCR STD_AXIS InjCtl_qSetUnBal InjMass 16 0.00 327.6700 FORMAT "%8.4" EXTENDED_LIMITS -327.6800 327.6700 DEPOSIT ABSOLUTE /end AXIS_DESCR
/end CHARACTERISTIC
/begin CHARACTERISTIC InjCrv_tiPiI1ETSCor2_MAP "motortemperaturabhängiges Korrekturgrundwertekennfeld -2 für die Zeitkomponente Ansteuerbeginn PiI1" MAP 0x80058DBE Map_Xs16Ys16Ws16 18000.00 InjTime_us -13000.00 5000.00 FORMAT "%8.2" EXTENDED_LIMITS -13107.20 13106.80
 /begin AXIS_DESCR STD_AXIS Epm_nEng EngN 16 0.00 6000.000 FORMAT "%8.3" EXTENDED_LIMITS -16384.00 16383.50 DEPOSIT ABSOLUTE /end AXIS_DESCR
 /begin AXIS_DESCR STD_AXIS InjCtl_qSetUnBal InjMass 16 0.00 327.6700 FORMAT "%8.4" EXTENDED_LIMITS -327.6800 327.6700 DEPOSIT ABSOLUTE /end AXIS_DESCR
/end CHARACTERISTIC
/begin AXIS_PTS InjCrv_tiPiI1ETSCorRgnX_AXIS "" 0x80058540 Epm_nEng Axis_Xs16 6000.000 EngN 16 0.00 6000.000 FORMAT "%8.3" EXTENDED_LIMITS -16384.00 16383.50 DEPOSIT ABSOLUTE /end AXIS_PTS
/begin AXIS_PTS InjCrv_tiPiI1ETSCorRgnY_AXIS "" 0x80058562 InjCtl_qSetUnBal Axis_Xs16 327.6700 InjMass 16 0.00 327.6700 FORMAT "%8.4" EXTENDED_LIMITS -327.6800 327.6700 DEPOSIT ABSOLUTE /end AXIS_PTS
/begin CHARACTERISTIC InjCrv_tiPiI1ETSCorStrt_MAP "base correction map for time-component of SOE of PiI1" MAP 0x80054EC0 Kf_Xs16_Ys16_Ws16 18107.20 InjTime_us -13107.20 5000.00 FORMAT "%8.2" EXTENDED_LIMITS -13107.20 13106.80
 /begin AXIS_DESCR STD_AXIS Epm_nEng EngN 8 -16384.00 16383.50 FORMAT "%8.2" DEPOSIT ABSOLUTE /end AXIS_DESCR
 /begin AXIS_DESCR STD_AXIS InjCtl_qSetUnBal InjMass 8 -327.6800 327.6700 FORMAT "%8.4" DEPOSIT ABSOLUTE /end AXIS_DESCR
/end CHARACTERISTIC
/begin CHARACTERISTIC InjCrv_tiPiI1MinRgn_MAP "Mappe des Pil1-Abstands im Fall der Regeneration" MAP 0x8005408E Kf_Xs16_Ys16_Ws16 5000.00 InjTime_us 0.00 5000.00 FORMAT "%8.2" EXTENDED_LIMITS -13107.20 13106.80
 /begin AXIS_DESCR STD_AXIS Epm_nEng EngN 10 0.00 6000.000 FORMAT "%8.3" EXTENDED_LIMITS -16384.00 16383.50 DEPOSIT ABSOLUTE /end AXIS_DESCR
 /begin AXIS_DESCR STD_AXIS InjCtl_qSetUnBal InjMass 10 0.00 327.6700 FORMAT "%8.4" EXTENDED_LIMITS -327.6800 327.6700 DEPOSIT ABSOLUTE /end AXIS_DESCR
/end CHARACTERISTIC
/begin CHARACTERISTIC InjCrv_tiPiI1Min_MAP "Kennfeld zur Ermittlung der minimalen Zeit der PiI1 relativ zur MI" MAP 0x80054182 Kf_Xs16_Ys16_Ws16 5000.00 InjTime_us 0.00 5000.00 FORMAT "%8.2" EXTENDED_LIMITS -13107.20 13106.80
 /begin AXIS_DESCR STD_AXIS Epm_nEng EngN 10 0.00 6000.000 FORMAT "%8.3" EXTENDED_LIMITS -16384.00 16383.50 DEPOSIT ABSOLUTE /end AXIS_DESCR
 /begin AXIS_DESCR STD_AXIS InjCtl_qSetUnBal InjMass 10 0.00 327.6700 FORMAT "%8.4" EXTENDED_LIMITS -327.6800 327.6700 DEPOSIT ABSOLUTE /end AXIS_DESCR
/end CHARACTERISTIC
/begin CHARACTERISTIC InjCrv_tiPiIMax_C "maximale Zeitkomponente PiI, bedingt durch Hardware" VALUE 0x80054276 Val_Ws16 5000.00 InjTime_us 0.00 5000.00 FORMAT "%8.2" EXTENDED_LIMITS -13107.20 13106.80 /end CHARACTERISTIC
/begin CHARACTERISTIC InjCrv_tiUppNegPT1_C "dq filter time constant neg. slope high range" VALUE 0x8007F698 Kw_Wu32 4294.9672950 TimeDelay_s 0.000001000000000 4294.9672960 FORMAT "%12.7" /end CHARACTERISTIC
/begin CHARACTERISTIC InjCrv_tiUppPosPT1_C "dq filter time constant pos. slope high range" VALUE 0x8007F69C Kw_Wu32 4294.9672950 TimeDelay_s 0.000001000000000 4294.9672960 FORMAT "%12.7" /end CHARACTERISTIC
/begin CHARACTERISTIC InjCrv_vVehPiIRlsHigh_C "obere Hystereseschwelle zur fahrzeuggeschwindigkeitsabhängigen PiI Freigabekorrektur" VALUE 0x8004F6C0 Val_Ws16 300.0000 Vel 0.00 300.0000 FORMAT "%8.4" EXTENDED_LIMITS -327.6800 327.6700 /end CHARACTERISTIC
/begin CHARACTERISTIC InjCrv_vVehPiIRlsLow_C "untere Hystereseschwelle zur fahrzeuggeschwindigkeitsabhängigen PiI Freigabekorrektur" VALUE 0x8004F6C2 Val_Ws16 300.0000 Vel 0.00 300.0000 FORMAT "%8.4" EXTENDED_LIMITS -327.6800 327.6700 /end CHARACTERISTIC
/begin MEASUREMENT InjCrv_dpMIDynCor_mp "DT1 gefilterter Atmosphärendruck" SWORD dp_dZ20 1 100 -327680.0 327670.0 FORMAT "%8.1" ECU_ADDRESS 0xC0000C54 /end MEASUREMENT
/begin MEASUREMENT InjCrv_dqSetUnBal "InjCrv_qSetUnBal DT1 filtered" SWORD InjMassPerSec_20ms 1 100 -16384.00 16383.50 FORMAT "%8.2" ECU_ADDRESS 0xD00070BA /end MEASUREMENT
/begin MEASUREMENT InjCrv_dqSetUnBalFltLim "Einspritzmengengradient (Dummy)" SWORD InjMassPerSec_20ms 1 100 -16384.00 16383.50 FORMAT "%8.2" ECU_ADDRESS 0xD00070BC /end MEASUREMENT
/begin MEASUREMENT InjCrv_dqSetUnBalFlt_mp "InjCrv_qSetUnBal DT1 und PT1 filtered" SWORD InjMassPerSec_20ms 1 100 -16384.00 16383.50 FORMAT "%8.2" ECU_ADDRESS 0xC0000C44 /end MEASUREMENT
/begin MEASUREMENT InjCrv_facAPPiI1DynCor_mp "atmosphärendruckabhängiger Gewichtungsfaktor" SWORD Fact 1 100 -4.000000 3.999878 FORMAT "%8.6" ECU_ADDRESS 0xC0000D2A /end MEASUREMENT
/begin MEASUREMENT InjCrv_facAPPiI1DynQCor_mp "Atmosphärendruckabhängiger Gewichtungsfaktor" SWORD Fact 1 100 -4.000000 3.999878 FORMAT "%8.6" ECU_ADDRESS 0xC0000D2C /end MEASUREMENT
/begin MEASUREMENT InjCrv_facDQPiI1DynCor_mp "einspritzmengengradientenabhängiger Gewichtungsfaktor" SWORD Fact 1 100 -4.000000 3.999878 FORMAT "%8.6" ECU_ADDRESS 0xC0000D0E /end MEASUREMENT
/begin MEASUREMENT InjCrv_facDQPiI1DynQCor_mp "einspritzmengengradientenabhängiger Gewichtungsfaktor für Voreinspritzmengenkorrektur" SWORD Fact 1 100 -4.000000 3.999878 FORMAT "%8.6" ECU_ADDRESS 0xC0000D10 /end MEASUREMENT
/begin MEASUREMENT InjCrv_facETPiI1DynCor_mp "motortemperaturabhängiger Gewichtungsfaktor" SWORD Fact 1 100 -4.000000 3.999878 FORMAT "%8.6" ECU_ADDRESS 0xC0000D2E /end MEASUREMENT
/begin MEASUREMENT InjCrv_facETPiI1DynQCor_mp "Motortemperaturabhängiger Gewichtungfaktor" SWORD Fact 1 100 -4.000000 3.999878 FORMAT "%8.6" ECU_ADDRESS 0xC0000D30 /end MEASUREMENT
/begin MEASUREMENT InjCrv_facIAPiI1DynCor_mp "ansauglufttemperaturabhängigen Gewichtungsfaktor der Voreinspritzung PiI1" SWORD Fact 1 100 -4.000000 3.999878 FORMAT "%8.6" ECU_ADDRESS 0xC0000D32 /end MEASUREMENT
/begin MEASUREMENT InjCrv_facMI1ATSSOECorRgn "temperaturabhängige Korrekturfaktoren der Ansaugluft für die MI1 im Regenerationsbetrieb" SWORD Fact 1 100 -4.000000 3.999878 FORMAT "%8.6" ARRAY_SIZE 2 ECU_ADDRESS 0xD00070BE /end MEASUREMENT
/begin MEASUREMENT InjCrv_facMI1DynCor2_mp "dq correction factor MI SOE customer correction II" SWORD Fact 1 100 -4.000000 3.999878 FORMAT "%8.6" ECU_ADDRESS 0xC0000C56 /end MEASUREMENT
/begin MEASUREMENT InjCrv_facMI1DynCorSlow2 "factor depending on atmospheric pressure" SWORD Fact 1 100 -4.000000 3.999878 FORMAT "%8.6" ECU_ADDRESS 0xD00070C2 /end MEASUREMENT
/begin MEASUREMENT InjCrv_facMI1ETSSOECorRgn "motortemperaturabhängige Korrekturfaktoren für die MI1 im Regenerationsbetrieb" SWORD Fact 1 100 -4.000000 3.999878 FORMAT "%8.6" ARRAY_SIZE 2 ECU_ADDRESS 0xD00070C4 /end MEASUREMENT
/begin MEASUREMENT InjCrv_facMI1SOERmpVal_mp "Interpolationsfaktor für die Funktion InjCrv_MIRgnSwtSOE" SWORD CoEOMSwt_S16 1 100 -2.000000 1.999939 FORMAT "%8.6" ECU_ADDRESS 0xC0000C90 /end MEASUREMENT
/begin MEASUREMENT InjCrv_facMIAPSPhiCor1 "atmosphärendruckabhängiger Korrekturfaktor -1 für MI1" SWORD Fact 1 100 -4.000000 3.999878 FORMAT "%8.6" ECU_ADDRESS 0xD00070C8 /end MEASUREMENT
/begin MEASUREMENT InjCrv_facMIAPSPhiCor2 "atmosphärendruckabhängiger Korrekturfaktor -2 für MI1" SWORD Fact 1 100 -4.000000 3.999878 FORMAT "%8.6" ECU_ADDRESS 0xD00070CA /end MEASUREMENT
/begin MEASUREMENT InjCrv_facMIAPSPhiCorStrt "Korrekturfaktur für Atmosphärendruck im Start" SWORD Fact 1 100 -4.000000 3.999878 FORMAT "%8.6" ECU_ADDRESS 0xD00070CC /end MEASUREMENT
/begin MEASUREMENT InjCrv_facMIATSPhiCor1 "ansauglufttemperaturabhängiger Korrekturfaktor -1 für MI1" SWORD Fact 1 100 -4.000000 3.999878 FORMAT "%8.6" ECU_ADDRESS 0xD00070CE /end MEASUREMENT
/begin MEASUREMENT InjCrv_facMIATSPhiCor2 "ansauglufttemperaturabhängiger Korrekturfaktor -2 für MI1" SWORD Fact 1 100 -4.000000 3.999878 FORMAT "%8.6" ECU_ADDRESS 0xD00070D0 /end MEASUREMENT
/begin MEASUREMENT InjCrv_facMIATSPhiCorStrt "Korrekturfaktur für Umgebungstemperatur im Start" SWORD Fact 1 100 -4.000000 3.999878 FORMAT "%8.6" ECU_ADDRESS 0xD00070D2 /end MEASUREMENT
/begin MEASUREMENT InjCrv_facMIDynCor_mp "resultierneder Faktor abhängig von Lufttemperatur und Wassertemperatur" SWORD Fact 1 100 -4.000000 3.999878 FORMAT "%8.6" ECU_ADDRESS 0xC0000C58 /end MEASUREMENT
/begin MEASUREMENT InjCrv_facMIETSPhiCor1 "motortemperaturabhängiger Korrekturfaktor -1 für MI1" SWORD Fact 1 100 -4.000000 3.999878 FORMAT "%8.6" ECU_ADDRESS 0xD00070D8 /end MEASUREMENT
/begin MEASUREMENT InjCrv_facMIETSPhiCor11 "motortemperaturabhängiger Korrekturfaktor -1 für MI1" SWORD Fact 1 100 -4.000000 3.999878 FORMAT "%8.6" ECU_ADDRESS 0xD00070D4 /end MEASUREMENT
/begin MEASUREMENT InjCrv_facMIETSPhiCor12 """motortemperaturabhängiger Korrekturfaktor für MI1 bei inaktiver PiI2""" SWORD Fact 1 100 -4.000000 3.999878 FORMAT "%8.6" ECU_ADDRESS 0xD00070D6 /end MEASUREMENT
/begin MEASUREMENT InjCrv_facMIETSPhiCor2 "motortemperaturabhängiger Korrekturfaktor -2 für MI1" SWORD Fact 1 100 -4.000000 3.999878 FORMAT "%8.6" ECU_ADDRESS 0xD00070DA /end MEASUREMENT
/begin MEASUREMENT InjCrv_facMIETSPhiCorStrt "Korrekturfaktur für Motortemperatur im Start" SWORD Fact 1 100 -4.000000 3.999878 FORMAT "%8.6" ECU_ADDRESS 0xD00070DC /end MEASUREMENT
/begin MEASUREMENT InjCrv_facMIFTSRailCor "Korrekturfaktor für die MI1, abhängig von der kraftstofftemperaturabhängigen Raildruckkorrektur" SWORD Fact 1 100 -4.000000 3.999878 FORMAT "%8.6" ECU_ADDRESS 0xD00070DE /end MEASUREMENT
/begin MEASUREMENT InjCrv_facMIFTSRailCorStrt "Korrekturfaktor für Kraftstofftemperatur im Start" SWORD Fact 1 100 -4.000000 3.999878 FORMAT "%8.6" ECU_ADDRESS 0xD00070E0 /end MEASUREMENT
/begin MEASUREMENT InjCrv_facMIPDynCor_mp "Korrekturfaktor abhängig vom Raildruck" SWORD Fact 1 100 -4.000000 3.999878 FORMAT "%8.6" ECU_ADDRESS 0xC0000C5A /end MEASUREMENT
/begin MEASUREMENT InjCrv_facMIPFltPhiCor "Korrekturfaktor für MI1 in Abhängigkeit der Partikelfilterbeladung" SWORD Fact 1 100 -4.000000 3.999878 FORMAT "%8.6" ECU_ADDRESS 0xD00070E2 /end MEASUREMENT
/begin MEASUREMENT InjCrv_facPiI1APSQCor1 "Atmosphärendruckabhängiger Mengenkorrekturfaktor für PiI1 bei inaktiver PiI2" SWORD Fact 1 100 -4.000000 3.999878 FORMAT "%8.6" ECU_ADDRESS 0xD00070E6 /end MEASUREMENT
/begin MEASUREMENT InjCrv_facPiI1APSQCor2 "Atmosphärendruckabhängiger Mengenkorrekturfaktor für PiI1 bei aktiver PiI2" SWORD Fact 1 100 -4.000000 3.999878 FORMAT "%8.6" ECU_ADDRESS 0xD00070E8 /end MEASUREMENT
/begin MEASUREMENT InjCrv_facPiI1APSQCorRgn1 "Atmosphärendruckabhängiger Mengenkorrekturfaktor 1 für Voreinspritzung 1 im Regenerationsbetrieb" SWORD Fact 1 100 -4.000000 3.999878 FORMAT "%8.6" ARRAY_SIZE 2 ECU_ADDRESS 0xD00070EA /end MEASUREMENT
/begin MEASUREMENT InjCrv_facPiI1APSQCorRgn2 "Atmosphärendruckabhängiger Mengenkorrekturfaktor 2 für Voreinspritzung 1 im Regenerationsbetrieb" SWORD Fact 1 100 -4.000000 3.999878 FORMAT "%8.6" ARRAY_SIZE 2 ECU_ADDRESS 0xD00070EE /end MEASUREMENT
/begin MEASUREMENT InjCrv_facPiI1APSQCorStrt "atmosphärendruckabhängiger Mengenkorrekturfaktor für Voreinspritzung 1 bei inaktiver Voreinspritzung 2 im Startzustand" SWORD Fact 1 100 -4.000000 3.999878 FORMAT "%8.6" ECU_ADDRESS 0xD00070F2 /end MEASUREMENT
/begin MEASUREMENT InjCrv_facPiI1ATSQCor1 "Ansauglufttemperaturabhängiger Mengenkorrekturfaktor für PiI1 bei inaktiver PiI2" SWORD Fact 1 100 -4.000000 3.999878 FORMAT "%8.6" ECU_ADDRESS 0xD00070F4 /end MEASUREMENT
/begin MEASUREMENT InjCrv_facPiI1ATSQCor2 "Ansauglufttemperaturabhängiger Mengenkorrekturfaktor für PiI1 bei aktiver PiI2" SWORD Fact 1 100 -4.000000 3.999878 FORMAT "%8.6" ECU_ADDRESS 0xD00070F6 /end MEASUREMENT
/begin MEASUREMENT InjCrv_facPiI1ATSQCorRgn1 "Ansauglufttemperaturabhängiger Mengenkorrekturfaktor 1 für Voreinspritzung 1 im Regenerationsbetrieb" SWORD Fact 1 100 -4.000000 3.999878 FORMAT "%8.6" ARRAY_SIZE 2 ECU_ADDRESS 0xD00070F8 /end MEASUREMENT
/begin MEASUREMENT InjCrv_facPiI1ATSQCorRgn2 "Ansauglufttemperaturabhängiger Mengenkorrekturfaktor 2 für Voreinspritzung 1 im Regenerationsbetrieb" SWORD Fact 1 100 -4.000000 3.999878 FORMAT "%8.6" ARRAY_SIZE 2 ECU_ADDRESS 0xD00070FC /end MEASUREMENT
/begin MEASUREMENT InjCrv_facPiI1ATSQCorStrt "motortemperaturabhängiger Mengenkorrekturfaktor für Voreinspritzung 1 bei inaktiver Voreinspritzung 2 im Startzustand" SWORD Fact 1 100 -4.000000 3.999878 FORMAT "%8.6" ECU_ADDRESS 0xD0007100 /end MEASUREMENT
/begin MEASUREMENT InjCrv_facPiI1ATSSOECor1 "Ansauglufttemperaturabhängiger Ansteuerbeginnkorrekturfaktor für PiI1 bei inaktiver PiI2" SWORD Fact 1 100 -4.000000 3.999878 FORMAT "%8.6" ECU_ADDRESS 0xD0007102 /end MEASUREMENT
/begin MEASUREMENT InjCrv_facPiI1ATSSOECor2 "Ansauglufttemperaturabhängiger Ansteuerbeginnkorrekturfaktor für PiI1 bei aktiver PiI2" SWORD Fact 1 100 -4.000000 3.999878 FORMAT "%8.6" ECU_ADDRESS 0xD0007104 /end MEASUREMENT
/begin MEASUREMENT InjCrv_facPiI1ATSSOECorRgn1 "Ansauglufttemperaturabhängiger Ansteuerbeginnkorrekturfaktor 1 für Voreinspritzung 1 im Regenerationsbetrieb" SWORD Fact 1 100 -4.000000 3.999878 FORMAT "%8.6" ARRAY_SIZE 2 ECU_ADDRESS 0xD0007106 /end MEASUREMENT
/begin MEASUREMENT InjCrv_facPiI1ATSSOECorRgn2 "Ansauglufttemperaturabhängiger Ansteuerbeginnkorrekturfaktor 2 für Voreinspritzung 1 im Regenerationsbetrieb" SWORD Fact 1 100 -4.000000 3.999878 FORMAT "%8.6" ARRAY_SIZE 2 ECU_ADDRESS 0xD000710A /end MEASUREMENT
/begin MEASUREMENT InjCrv_facPiI1DynQCor "dynamischer Mengenkorrekturfaktor für PiI1" SWORD Fact 1 100 -4.000000 3.999878 FORMAT "%8.6" ECU_ADDRESS 0xD000710E /end MEASUREMENT
/begin MEASUREMENT InjCrv_facPiI1DynSOECor "motortemperatur- und atmosphärendruckabhängiger Winkelkorrekturfaktor für Pil1" SWORD Fact 1 100 -4.000000 3.999878 FORMAT "%8.6" ECU_ADDRESS 0xD0007110 /end MEASUREMENT
/begin MEASUREMENT InjCrv_facPiI1ETSQCor1 "Motortemperaturabhängiger Mengenkorrekturfaktor für PiI1 bei inaktiver PiI2" SWORD Fact 1 100 -4.000000 3.999878 FORMAT "%8.6" ECU_ADDRESS 0xD0007116 /end MEASUREMENT
/begin MEASUREMENT InjCrv_facPiI1ETSQCor11 "motortemperaturabhängiger Mengenkorrekturfaktor -1 für Voreinspritzung 1" SWORD Fact 1 100 -4.000000 3.999878 FORMAT "%8.6" ECU_ADDRESS 0xD0007112 /end MEASUREMENT
/begin MEASUREMENT InjCrv_facPiI1ETSQCor12 "motortemperaturabhängiger Mengenkorrekturfaktor für Voreinspritzung 1 bei inaktiver Voreinspritzung 2" SWORD Fact 1 100 -4.000000 3.999878 FORMAT "%8.6" ECU_ADDRESS 0xD0007114 /end MEASUREMENT
/begin MEASUREMENT InjCrv_facPiI1ETSQCor2 "Motortemperaturabhängiger Mengenkorrekturfaktor für PiI1 bei aktiver PiI2" SWORD Fact 1 100 -4.000000 3.999878 FORMAT "%8.6" ECU_ADDRESS 0xD0007118 /end MEASUREMENT
/begin MEASUREMENT InjCrv_facPiI1ETSQCorRgn1 "Motortemperaturabhängiger Mengenkorrekturfaktor 1 für Voreinspritzung 1 im Regenerationsbetrieb" SWORD Fact 1 100 -4.000000 3.999878 FORMAT "%8.6" ARRAY_SIZE 2 ECU_ADDRESS 0xD000711A /end MEASUREMENT
/begin MEASUREMENT InjCrv_facPiI1ETSQCorRgn2 "Motortemperaturabhängiger Mengenkorrekturfaktor 2 für Voreinspritzung 1 im Regenerationsbetrieb" SWORD Fact 1 100 -4.000000 3.999878 FORMAT "%8.6" ARRAY_SIZE 2 ECU_ADDRESS 0xD000711E /end MEASUREMENT
/begin MEASUREMENT InjCrv_facPiI1ETSQCorStrt "motortemperaturabhängiger Mengenkorrekturfaktor für Voreinspritzung 1 bei inaktiver Voreinspritzung 2 im Startzustand" SWORD Fact 1 100 -4.000000 3.999878 FORMAT "%8.6" ECU_ADDRESS 0xD0007122 /end MEASUREMENT
/begin MEASUREMENT InjCrv_facPiI1ETSSOECor1 "Motortemperaturabhängiger Ansteuerbeginnkorrekturfaktor für PiI1 bei inaktiver PiI2" SWORD Fact 1 100 -4.000000 3.999878 FORMAT "%8.6" ECU_ADDRESS 0xD0007128 /end MEASUREMENT
/begin MEASUREMENT InjCrv_facPiI1ETSSOECor11 "motortemperaturabhängiger Ansteuerbeginnkorrekturfaktor -1 für Voreinspritzung 1" SWORD Fact 1 100 -4.000000 3.999878 FORMAT "%8.6" ECU_ADDRESS 0xD0007124 /end MEASUREMENT
/begin MEASUREMENT InjCrv_facPiI1ETSSOECor12 """motortemperaturabhängiger Ansteuerbeginnkorrekturfaktor für Voreinspritzung 1 bei inaktiver Voreinspritzung 2""" SWORD Fact 1 100 -4.000000 3.999878 FORMAT "%8.6" ECU_ADDRESS 0xD0007126 /end MEASUREMENT
/begin MEASUREMENT InjCrv_facPiI1ETSSOECor2 "Motortemperaturabhängiger Ansteuerbeginnkorrekturfaktor für PiI1 bei aktiver PiI2" SWORD Fact 1 100 -4.000000 3.999878 FORMAT "%8.6" ECU_ADDRESS 0xD000712A /end MEASUREMENT
/begin MEASUREMENT InjCrv_facPiI1ETSSOECorRgn1 "Motortemperaturabhängiger Ansteuerbeginnkorrekturfaktor 1 für Voreinspritzung 1 im Regenerationsbetrieb" SWORD Fact 1 100 -4.000000 3.999878 FORMAT "%8.6" ARRAY_SIZE 2 ECU_ADDRESS 0xD000712C /end MEASUREMENT
/begin MEASUREMENT InjCrv_facPiI1ETSSOECorRgn2 "Motortemperaturabhängiger Ansteuerbeginnkorrekturfaktor 2 für Voreinspritzung 1 im Regenerationsbetrieb" SWORD Fact 1 100 -4.000000 3.999878 FORMAT "%8.6" ARRAY_SIZE 2 ECU_ADDRESS 0xD0007130 /end MEASUREMENT
/begin MEASUREMENT InjCrv_facPiI1ETSSOECorStrt """motortemperaturabhängiger Ansteuerbeginnkorrekturfaktor für Voreinspritzung 1 bei inaktiver Voreinspritzung 2 im Startzustand """ SWORD Fact 1 100 -4.000000 3.999878 FORMAT "%8.6" ECU_ADDRESS 0xD0007134 /end MEASUREMENT
/begin MEASUREMENT InjCrv_facPiI1QntMin_mp "Wichtungsfaktor zum Abschalten der Berechnung Voreinspritzung 1" SWORD Fact1 1 100 -256.0000 255.9922 FORMAT "%8.4" ECU_ADDRESS 0xC0000C94 /end MEASUREMENT
/begin MEASUREMENT InjCrv_facPiI1QntRmpVal_mp "Interpolationsfaktor für die Funktion InjCrv_PiI1RgnSwtQnt" SWORD CoEOMSwt_S16 1 100 -2.000000 1.999939 FORMAT "%8.6" ECU_ADDRESS 0xC0000D8A /end MEASUREMENT
/begin MEASUREMENT InjCrv_facPiI1SOERmpVal_mp "Interpolationsfaktor für die Funktion InjCrv_PiI1RgnSwtSOE" SWORD CoEOMSwt_S16 1 100 -2.000000 1.999939 FORMAT "%8.6" ECU_ADDRESS 0xC0000D8C /end MEASUREMENT
/begin MEASUREMENT InjCrv_phiMI1AddCor1 "kundenspezifischer Korrekturwinkel für die MI bei inaktiver PiI2" SWORD AngleCrS 1 100 -720.0220 720.0000 FORMAT "%8.4" ECU_ADDRESS 0xD0007192 /end MEASUREMENT
/begin MEASUREMENT InjCrv_phiMI1AddCor2 "kundenspezifischer Korrekturwinkel für die MI bei aktiver PiI2" SWORD AngleCrS 1 100 -720.0220 720.0000 FORMAT "%8.4" ECU_ADDRESS 0xD0007194 /end MEASUREMENT
/begin MEASUREMENT InjCrv_phiMI1AddCorRgn "kundenspezificher Korrekturwert der Winkelkomponente für den Ansteuerbeginn der MI1 im Regenerationsbetrieb" SWORD AngleCrS 1 100 -720.0220 720.0000 FORMAT "%8.4" ECU_ADDRESS 0xD0007196 /end MEASUREMENT
/begin MEASUREMENT InjCrv_phiMI1AddCorStrt "correction angle value = f(n, qSetUnBal, ETS)" SWORD AngleCrS 1 100 -720.0220 720.0000 FORMAT "%8.4" ECU_ADDRESS 0xD0007198 /end MEASUREMENT
/begin MEASUREMENT InjCrv_phiMI1ATSCorRgn_mp "Gewichteter Korrekturwert abhängig von der Ansauglufttemperatur abhängig vom Ansteuerbeginn der MI1 im Regenerationsbetrieb" SWORD AngleCrS 1 100 -720.0220 720.0000 FORMAT "%8.4" ARRAY_SIZE 2 ECU_ADDRESS 0xC0000C80 /end MEASUREMENT
/begin MEASUREMENT InjCrv_phiMI1Bas "Grundwert Ansteuerbeginn MI1" SWORD AngleCrS 1 100 -720.0220 720.0000 FORMAT "%8.4" ECU_ADDRESS 0xD000719A /end MEASUREMENT
/begin MEASUREMENT InjCrv_phiMI1BasRgn_mp "Regenerationswert für den Ansteuerbeginn der MI1" SWORD AngleCrS 1 100 -720.0220 720.0000 FORMAT "%8.4" ARRAY_SIZE 2 ECU_ADDRESS 0xC0000C88 /end MEASUREMENT
/begin MEASUREMENT InjCrv_phiMI1Cor_mp "korrigierter Grundwert Ansteuerbeginn MI1" SWORD AngleCrS 1 100 -720.0220 720.0000 FORMAT "%8.4" ECU_ADDRESS 0xC0000C2A /end MEASUREMENT
/begin MEASUREMENT InjCrv_phiMI1Des "gewünschter Bezugswinkel für Beginn der MI1" SWORD AngleCrS 1 100 -720.0220 720.0000 FORMAT "%8.4" ECU_ADDRESS 0xD000719C /end MEASUREMENT
/begin MEASUREMENT InjCrv_phiMI1DesAddByp_mp "Wert des gewünschten Winkels für die Haupteinspritzung vor einem additiven Bypasseingriff" SWORD AngleCrS 1 100 -720.0220 720.0000 FORMAT "%8.4" ECU_ADDRESS 0xC0000C2C /end MEASUREMENT
/begin MEASUREMENT InjCrv_phiMI1DesAdd_mp "Additiver Bypasseingriff für gewünschten Winkel der Haupteinspritzung" SWORD AngleCrS 1 100 -720.0220 720.0000 FORMAT "%8.4" ECU_ADDRESS 0xC0000C2E /end MEASUREMENT
/begin MEASUREMENT InjCrv_phiMI1DesByp_mp "Bypass-Label, Kopie von InjCrv_phiMI1Des" SWORD AngleCrS 1 100 -720.0220 720.0000 FORMAT "%8.4" ECU_ADDRESS 0xC0000C30 /end MEASUREMENT
/begin MEASUREMENT InjCrv_phiMI1DynCor1_mp "MI SOE customer correction 1" SWORD AngleCrS 1 100 -720.0220 720.0000 FORMAT "%8.4" ECU_ADDRESS 0xC0000C5C /end MEASUREMENT
/begin MEASUREMENT InjCrv_phiMI1DynCor2Bas_mp "MI SOE customer correction II, base value" SWORD AngleCrS 1 100 -720.0220 720.0000 FORMAT "%8.4" ECU_ADDRESS 0xC0000C5E /end MEASUREMENT
/begin MEASUREMENT InjCrv_phiMI1DynCor2_mp "Abschließender Wert MI1 SOE der dynamischen Korrektur des Winkels 2" SWORD AngleCrS 1 100 -720.0220 720.0000 FORMAT "%8.4" ECU_ADDRESS 0xC0000C60 /end MEASUREMENT
/begin MEASUREMENT InjCrv_phiMI1DynCor_mp "MI SOE customer correction 1" SWORD AngleCrS 1 100 -720.0220 720.0000 FORMAT "%8.4" ECU_ADDRESS 0xC0000C46 /end MEASUREMENT
/begin MEASUREMENT InjCrv_phiMI1EnvCor1 "Ansteuerbeginnkorrekturwert 1 für MI1 (n sync)" SWORD AngleCrS 1 100 -720.0220 720.0000 FORMAT "%8.4" ECU_ADDRESS 0xD00071A2 /end MEASUREMENT
/begin MEASUREMENT InjCrv_phiMI1EnvCor2 "Ansteuerbeginnkorrekturwert 2 für MI1 (n sync)" SWORD AngleCrS 1 100 -720.0220 720.0000 FORMAT "%8.4" ECU_ADDRESS 0xD00071A4 /end MEASUREMENT
/begin MEASUREMENT InjCrv_phiMI1EnvCorRgn "Ansteuerbeginn Korrekturwinkel für MI1 im Regenerationsbetrieb" SWORD AngleCrS 1 100 -720.0220 720.0000 FORMAT "%8.4" ARRAY_SIZE 2 ECU_ADDRESS 0xD00071A6 /end MEASUREMENT
/begin MEASUREMENT InjCrv_phiMI1ETSCorRgn_mp "Gewichteter Korrekturwert abhängig von der Motortemperatur abhängig vom Ansteuerbeginn der MI1 im Regenerationsbetrieb" SWORD AngleCrS 1 100 -720.0220 720.0000 FORMAT "%8.4" ARRAY_SIZE 2 ECU_ADDRESS 0xC0000C84 /end MEASUREMENT
/begin MEASUREMENT InjCrv_phiMI1Lim_mp "begrenzter Sollwert Ansteuerbeginn MI1" SWORD AngleCrS 1 100 -720.0220 720.0000 FORMAT "%8.4" ECU_ADDRESS 0xC0000C32 /end MEASUREMENT
/begin MEASUREMENT InjCrv_phiMI1Max_mp "frühester Ansteuerbeginn der MI1" SWORD AngleCrS 1 100 -720.0220 720.0000 FORMAT "%8.4" ECU_ADDRESS 0xC0000C34 /end MEASUREMENT
/begin MEASUREMENT InjCrv_phiMI1Rgn "Regenerationswert für den Ansteuerbeginn der MI1" SWORD AngleCrS 1 100 -720.0220 720.0000 FORMAT "%8.4" ARRAY_SIZE 2 ECU_ADDRESS 0xD00071AA /end MEASUREMENT
/begin MEASUREMENT InjCrv_phiMI1RgnAdd_mp "Additiver Bypasseingrif für Winkel der Haupteinspritzung im Regenerationsbetrieb" SWORD AngleCrS 1 100 -720.0220 720.0000 FORMAT "%8.4" ARRAY_SIZE 2 ECU_ADDRESS 0xC0000C8C /end MEASUREMENT
/begin MEASUREMENT InjCrv_phiMI1StrtCor_mp "Korrekturwinkel der HE während des Starts" SWORD AngleCrS 1 100 -720.0220 720.0000 FORMAT "%8.4" ECU_ADDRESS 0xC0000C92 /end MEASUREMENT
/begin MEASUREMENT InjCrv_phiMIAPSCor1_mp "atmosphärendruckabhängiger Korrekturwinkel für den Ansteuerbeginn der MI1 bei inaktiver PiI2" SWORD AngleCrS 1 100 -720.0220 720.0000 FORMAT "%8.4" ECU_ADDRESS 0xC0000C70 /end MEASUREMENT
/begin MEASUREMENT InjCrv_phiMIAPSCor2_mp "atmosphärendruckabhängiger Korrekturwinkel für den Ansteuerbeginn der MI1 bei aktiver PiI2" SWORD AngleCrS 1 100 -720.0220 720.0000 FORMAT "%8.4" ECU_ADDRESS 0xC0000C72 /end MEASUREMENT
/begin MEASUREMENT InjCrv_phiMIAPSCorStrt_mp "Korrekturwert des Phasewinkels für Haupteinspritzung beim Motorstart" SWORD AngleCrS 1 100 -720.0220 720.0000 FORMAT "%8.4" ECU_ADDRESS 0xC0000C48 /end MEASUREMENT
/begin MEASUREMENT InjCrv_phiMIAPSDynCor_mp "Korrekturwert für Ansteuerbeginn der Haupteinspritzung" SWORD AngleCrS 1 100 -720.0220 720.0000 FORMAT "%8.4" ECU_ADDRESS 0xC0000C62 /end MEASUREMENT
/begin MEASUREMENT InjCrv_phiMIATSCor1_mp "ansauglufttemperaturabhängiger Korrekturwinkel für den Ansteuerbeginn der MI1 bei inaktiver PiI2" SWORD AngleCrS 1 100 -720.0220 720.0000 FORMAT "%8.4" ECU_ADDRESS 0xC0000C74 /end MEASUREMENT
/begin MEASUREMENT InjCrv_phiMIATSCor2_mp "ansauglufttemperaturabhängiger Korrekturwinkel für den Ansteuerbeginn der MI1 bei aktiver PiI2" SWORD AngleCrS 1 100 -720.0220 720.0000 FORMAT "%8.4" ECU_ADDRESS 0xC0000C76 /end MEASUREMENT
/begin MEASUREMENT InjCrv_phiMIATSCorStrt_mp "ansauglufttemperaturabhängiger Korrekturwert für den Ansteuerbeginn der MI1 im Startzustand" SWORD AngleCrS 1 100 -720.0220 720.0000 FORMAT "%8.4" ECU_ADDRESS 0xC0000C4A /end MEASUREMENT
/begin MEASUREMENT InjCrv_phiMIDynCor_mp "Korrekturwert für Ansteuerbeginn der Haupteinspritzung" SWORD AngleCrS 1 100 -720.0220 720.0000 FORMAT "%8.4" ECU_ADDRESS 0xC0000C64 /end MEASUREMENT
/begin MEASUREMENT InjCrv_phiMIETSCor11_mp "kühlmitteltemperaturabhängiger Korrekturwert für den Ansteuerbeginn der MI1" SWORD AngleCrS 1 100 -720.0220 720.0000 FORMAT "%8.4" ECU_ADDRESS 0xC0000C4C /end MEASUREMENT
/begin MEASUREMENT InjCrv_phiMIETSCor12_mp "kühlmitteltemperaturabhängiger Korrekturwert für den Ansteuerbeginn der MI1" SWORD AngleCrS 1 100 -720.0220 720.0000 FORMAT "%8.4" ECU_ADDRESS 0xC0000C4E /end MEASUREMENT
/begin MEASUREMENT InjCrv_phiMIETSCor1_mp "motortemperaturabhängiger Korrekturwert 1 für Ansteuerbeginn MI1" SWORD AngleCrS 1 100 -720.0220 720.0000 FORMAT "%8.4" ECU_ADDRESS 0xC0000C78 /end MEASUREMENT
/begin MEASUREMENT InjCrv_phiMIETSCor2_mp "motortemperaturabhängiger Korrekturwert 2 für Ansteuerbeginn MI1" SWORD AngleCrS 1 100 -720.0220 720.0000 FORMAT "%8.4" ECU_ADDRESS 0xC0000C7A /end MEASUREMENT
/begin MEASUREMENT InjCrv_phiMIETSCorStrt_mp "correction angle value = f(n, qSetUnBal, ETS)" SWORD AngleCrS 1 100 -720.0220 720.0000 FORMAT "%8.4" ECU_ADDRESS 0xC0000C50 /end MEASUREMENT
/begin MEASUREMENT InjCrv_phiMIFTSRailCorStrt_mp "correction angle value = f(n, qSetUnBal, FTS,InjCrv_phiMIFTSRailCor_Max, InjCrv_phiMIFTSRailCor_Min)" SWORD AngleCrS 1 100 -720.0220 720.0000 FORMAT "%8.4" ECU_ADDRESS 0xC0000C52 /end MEASUREMENT
/begin MEASUREMENT InjCrv_phiMIFTSRailCor_mp "Ansteuerbeginnkorrekturfaktor für MI1, abhängig von der kraftstofftemperaturabhängigen Raildruckkorrektur" SWORD AngleCrS 1 100 -720.0220 720.0000 FORMAT "%8.4" ECU_ADDRESS 0xC0000C7C /end MEASUREMENT
/begin MEASUREMENT InjCrv_phiMIPDynCor_mp "Korrekturwert für Ansteuerbeginn der Haupteinspritzung" SWORD AngleCrS 1 100 -720.0220 720.0000 FORMAT "%8.4" ECU_ADDRESS 0xC0000C66 /end MEASUREMENT
/begin MEASUREMENT InjCrv_phiMIPFltCor_mp "Korrekturwert für den Ansteuerbeginn der MI1 abhängig von der Partikelfilterbeladung" SWORD AngleCrS 1 100 -720.0220 720.0000 FORMAT "%8.4" ECU_ADDRESS 0xC0000C7E /end MEASUREMENT
/begin MEASUREMENT InjCrv_phiPiI1AbsTot_mp "absoluter Ansteuerbeginn PiI1 aus Winkel- und Zeitkomponente" SWORD AngleCrS 1 100 -720.0220 720.0000 FORMAT "%8.4" ECU_ADDRESS 0xC0000C96 /end MEASUREMENT
/begin MEASUREMENT InjCrv_phiPiI1Abs_mp "absolute Winkelkomponente Anteuerbeginn PiI1" SWORD AngleCrS 1 100 -720.0220 720.0000 FORMAT "%8.4" ECU_ADDRESS 0xC0000C98 /end MEASUREMENT
/begin MEASUREMENT InjCrv_phiPiI1AddCor1 "kundenspezifischer Korrekturwinkel für PiI1 bei inaktiver PiI2" SWORD AngleCrS 1 100 -720.0220 720.0000 FORMAT "%8.4" ECU_ADDRESS 0xD00071AE /end MEASUREMENT
/begin MEASUREMENT InjCrv_phiPiI1AddCor2 "kundenspezifischer Korrekturwinkel für PiI1 bei aktiver PiI2" SWORD AngleCrS 1 100 -720.0220 720.0000 FORMAT "%8.4" ECU_ADDRESS 0xD00071B0 /end MEASUREMENT
/begin MEASUREMENT InjCrv_phiPiI1ATSCor1_mp "Ansauglufttemperaturabhängiger Korrekturgrundwert für die Winkelkomponente des Ansteuerbeginns der PiI1 bei inaktiver PiI2" SWORD AngleCrS 1 100 -720.0220 720.0000 FORMAT "%8.4" ECU_ADDRESS 0xC0000D40 /end MEASUREMENT
/begin MEASUREMENT InjCrv_phiPiI1ATSCor2_mp "Ansauglufttemperaturabhängiger Korrekturgrundwert für die Winkelkomponente des Ansteuerbeginns der PiI1 bei aktiver PiI2" SWORD AngleCrS 1 100 -720.0220 720.0000 FORMAT "%8.4" ECU_ADDRESS 0xC0000D42 /end MEASUREMENT
/begin MEASUREMENT InjCrv_phiPiI1Bas_mp "Winkelkomponente Ansteuerbeginn PiI1 Grundwert" SWORD AngleCrS 1 100 -720.0220 720.0000 FORMAT "%8.4" ECU_ADDRESS 0xC0000C9A /end MEASUREMENT
/begin MEASUREMENT InjCrv_phiPiI1Cor_mp "korrigierter Grundwert Winkelkomponente Ansteuerbeginn PiI1" SWORD AngleCrS 1 100 -720.0220 720.0000 FORMAT "%8.4" ECU_ADDRESS 0xC0000C9C /end MEASUREMENT
/begin MEASUREMENT InjCrv_phiPiI1Des "gewünschter Winkelkomponente Ansteuerbeginn PiI1" SWORD AngleCrS 1 100 -720.0220 720.0000 FORMAT "%8.4" ECU_ADDRESS 0xD00071B2 /end MEASUREMENT
/begin MEASUREMENT InjCrv_phiPiI1DesAdd_mp "Additiver Bypasseingriff für gewünschten Winkel der Voreinspritzung 1 im Regenerationsbetrieb" SWORD AngleCrS 1 100 -720.0220 720.0000 FORMAT "%8.4" ECU_ADDRESS 0xC0000C9E /end MEASUREMENT
/begin MEASUREMENT InjCrv_phiPiI1DesByp_mp "Bypass-Label, Kopie von InjCrv_phiPiI1Des" SWORD AngleCrS 1 100 -720.0220 720.0000 FORMAT "%8.4" ECU_ADDRESS 0xC0000CA0 /end MEASUREMENT
/begin MEASUREMENT InjCrv_phiPiI1EnvCor1 "Korrekturwinkel für PiI1 wenn PiI2 inaktiv" SWORD AngleCrS 1 100 -720.0220 720.0000 FORMAT "%8.4" ECU_ADDRESS 0xD00071B4 /end MEASUREMENT
/begin MEASUREMENT InjCrv_phiPiI1EnvCor2 "Korrekturwinkel für PiI1 wenn PiI2 aktiv" SWORD AngleCrS 1 100 -720.0220 720.0000 FORMAT "%8.4" ECU_ADDRESS 0xD00071B6 /end MEASUREMENT
/begin MEASUREMENT InjCrv_phiPiI1ETSCor1_mp "motortemperaturabhängiger Korrekturgrundwert für die Winkelkomponente des Ansteuerbeginns der PiI1 bei inaktiver PiI2" SWORD AngleCrS 1 100 -720.0220 720.0000 FORMAT "%8.4" ECU_ADDRESS 0xC0000D44 /end MEASUREMENT
/begin MEASUREMENT InjCrv_phiPiI1ETSCor2_mp "motortemperaturabhängiger Korrekturgrundwert für die Winkelkomponente des Ansteuerbeginns der PiI1 bei aktiver PiI2" SWORD AngleCrS 1 100 -720.0220 720.0000 FORMAT "%8.4" ECU_ADDRESS 0xC0000D46 /end MEASUREMENT
/begin MEASUREMENT InjCrv_phiPiI1Rel_mp "Winkelkomponente Ansteuerbeginn PiI1 relaitv zur MI" SWORD AngleCrS 1 100 -720.0220 720.0000 FORMAT "%8.4" ECU_ADDRESS 0xC0000CA2 /end MEASUREMENT
/begin MEASUREMENT InjCrv_phiPiI2Des "gewünschte Winkelkomponente Ansteuerbeginn PiI2" SWORD AngleCrS 1 100 -720.0220 720.0000 FORMAT "%8.4" ECU_ADDRESS 0xD00071BC /end MEASUREMENT
/begin MEASUREMENT InjCrv_phiPiI2DesAdd_mp "Additiver Bypasseingriff für gewünschten Winkel der Voreinspritzung 2" SWORD AngleCrS 1 100 -720.0220 720.0000 FORMAT "%8.4" ECU_ADDRESS 0xC0000CA4 /end MEASUREMENT
/begin MEASUREMENT InjCrv_phiPiI2DesByp_mp "Bypass-Label, Kopie von InjCrv_phiPiI2Des" SWORD AngleCrS 1 100 -720.0220 720.0000 FORMAT "%8.4" ECU_ADDRESS 0xC0000CA6 /end MEASUREMENT
/begin MEASUREMENT InjCrv_phiPiI3Des "gewünschte Winkelkomponente Ansteuerbeginn PiI3" SWORD AngleCrS 1 100 -720.0220 720.0000 FORMAT "%8.4" ECU_ADDRESS 0xD00071C2 /end MEASUREMENT
/begin MEASUREMENT InjCrv_phiPiI3DesAdd_mp "Additiver Bypasseingriff für gewünschten Winkel der Voreinspritzung 3" SWORD AngleCrS 1 100 -720.0220 720.0000 FORMAT "%8.4" ECU_ADDRESS 0xC0000CA8 /end MEASUREMENT
/begin MEASUREMENT InjCrv_phiPiI3DesByp_mp "Bypass-Label, Kopie von InjCrv_phiPiI3Des" SWORD AngleCrS 1 100 -720.0220 720.0000 FORMAT "%8.4" ECU_ADDRESS 0xC0000CAA /end MEASUREMENT
/begin MEASUREMENT InjCrv_pMIDynCor_mp "begrenzte Raildruckdifferenz" SWORD Pres_Rail 1 100 -3276.800 2000.000 FORMAT "%5.3" ECU_ADDRESS 0xC0000C68 /end MEASUREMENT
/begin MEASUREMENT InjCrv_qMI1Des "Wunschmenge Haupteinspritzung" SWORD InjMass 1 100 -327.6800 327.6700 FORMAT "%8.4" ECU_ADDRESS 0xD00071E2 /end MEASUREMENT
/begin MEASUREMENT InjCrv_qMI1DesAddByp_mp "Wert der gewünschten Menge der Haupteinspritzung vor einem additiven Bypasseingriff" SWORD InjMass 1 100 -327.6800 327.6700 FORMAT "%8.4" ECU_ADDRESS 0xC0000C36 /end MEASUREMENT
/begin MEASUREMENT InjCrv_qMI1DesAdd_mp "Additiver Bypasseingriff für gewünschte Menge der Haupteinspritzung" SWORD InjMass 1 100 -327.6800 327.6700 FORMAT "%8.4" ECU_ADDRESS 0xC0000C38 /end MEASUREMENT
/begin MEASUREMENT InjCrv_qMI1DesByp_mp "Bypass-Label, Kopie von InjCrv_qMI1Des" SWORD InjMass 1 100 -327.6800 327.6700 FORMAT "%8.4" ECU_ADDRESS 0xC0000C3A /end MEASUREMENT
/begin MEASUREMENT InjCrv_qMI1MinPiI1_mp "Minimalmenge der MI1 wenn nur PiI1 abgesetzt wird" SWORD InjMass 1 100 -327.6800 327.6700 FORMAT "%8.4" ECU_ADDRESS 0xC0000CAC /end MEASUREMENT
/begin MEASUREMENT InjCrv_qMI1Min_mp "Minimale Einspritzmenge der Haupteinspritzung 1" SWORD InjMass 1 100 -327.6800 327.6700 FORMAT "%8.4" ECU_ADDRESS 0xC0000C3C /end MEASUREMENT
/begin MEASUREMENT InjCrv_qMI1Nrm_mp "Normalmenge der Einspritzung MI1" SWORD InjMass 1 100 -327.6800 327.6700 FORMAT "%8.4" ECU_ADDRESS 0xC0000C3E /end MEASUREMENT
/begin MEASUREMENT InjCrv_qMI1SetLimCnv "" SWORD InjQntInj 1 100 -327.6800 327.6700 FORMAT "%8.4" ECU_ADDRESS 0xD00071E4 /end MEASUREMENT
/begin MEASUREMENT InjCrv_qMI1Set_mp "Sollmenge der Einspritzung MI1" SWORD InjMass 1 100 -327.6800 327.6700 FORMAT "%8.4" ECU_ADDRESS 0xC0000C40 /end MEASUREMENT
/begin MEASUREMENT InjCrv_qPiI1AddCor1 "kundenspezifische Korrekturmenge für PiI1 bei nicht freigegebener PiI2" SWORD InjMassInj 1 100 -327.6800 327.6700 FORMAT "%8.4" ECU_ADDRESS 0xD00071E6 /end MEASUREMENT
/begin MEASUREMENT InjCrv_qPiI1AddCor2 "kundenspezifische Korrekturmenge für PiI1 bei freigegebener PiI2" SWORD InjMassInj 1 100 -327.6800 327.6700 FORMAT "%8.4" ECU_ADDRESS 0xD00071E8 /end MEASUREMENT
/begin MEASUREMENT InjCrv_qPiI1AddCorRgn1 "additiver Korrekturwert für die Mengenkorrektur der PiI1 im Regenerationsbetrieb für nicht freigegebene PiI2" SWORD InjMass 1 100 -327.6800 327.6700 FORMAT "%8.4" ECU_ADDRESS 0xD00071EA /end MEASUREMENT
/begin MEASUREMENT InjCrv_qPiI1AddCorRgn2 "additiver Korrekturwert für die Mengenkorrektur der PiI1 im Regenerationsbetrieb für freigegebene PiI2" SWORD InjMass 1 100 -327.6800 327.6700 FORMAT "%8.4" ECU_ADDRESS 0xD00071EC /end MEASUREMENT
/begin MEASUREMENT InjCrv_qPiI1AddCorStrt "PII1 menge korrektur während des Motor start state" SWORD InjMassInj 1 100 -327.6800 327.6700 FORMAT "%8.4" ECU_ADDRESS 0xD00071EE /end MEASUREMENT
/begin MEASUREMENT InjCrv_qPiI1APSCor1_mp "atmosphärendruckabhängige Korrekturmenge 1 für PiI1 und PiI2" SWORD InjMass 1 100 -327.6800 327.6700 FORMAT "%8.4" ECU_ADDRESS 0xC0000D34 /end MEASUREMENT
/begin MEASUREMENT InjCrv_qPiI1APSCor2_mp "atmosphärendruckabhängige Korrekturmenge 2 für PiI1 und PiI2" SWORD InjMass 1 100 -327.6800 327.6700 FORMAT "%8.4" ECU_ADDRESS 0xC0000D36 /end MEASUREMENT
/begin MEASUREMENT InjCrv_qPiI1APSCorRgn1_mp "Druckabhängiger Basismengenkorrekturwert 1 der Voreinspritzung 1 im Regenerationsbetrieb" SWORD InjMass 1 100 -327.6800 327.6700 FORMAT "%8.4" ARRAY_SIZE 2 ECU_ADDRESS 0xC0000D48 /end MEASUREMENT
/begin MEASUREMENT InjCrv_qPiI1APSCorRgn2_mp "Druckabhängiger Basismengenkorrekturwert 1 der Voreinspritzung 1 im Regenerationsbetrieb" SWORD InjMass 1 100 -327.6800 327.6700 FORMAT "%8.4" ARRAY_SIZE 2 ECU_ADDRESS 0xC0000D4C /end MEASUREMENT
/begin MEASUREMENT InjCrv_qPiI1APSCorStrt_mp "quantity correction value dependent on atmospheric pressure" SWORD InjMassInj 1 100 -327.6800 327.6700 FORMAT "%8.4" ECU_ADDRESS 0xC0000D12 /end MEASUREMENT
/begin MEASUREMENT InjCrv_qPiI1ATSCor1_mp "ansauglufttemperaturabhängige Korrekturmenge 1 für PiI1 und PiI2" SWORD InjMass 1 100 -327.6800 327.6700 FORMAT "%8.4" ECU_ADDRESS 0xC0000D38 /end MEASUREMENT
/begin MEASUREMENT InjCrv_qPiI1ATSCor2_mp "ansauglufttemperaturabhängige Korrekturmenge 2 für PiI1 und PiI2" SWORD InjMass 1 100 -327.6800 327.6700 FORMAT "%8.4" ECU_ADDRESS 0xC0000D3A /end MEASUREMENT
/begin MEASUREMENT InjCrv_qPiI1ATSCorRgn1_mp "Lufttemperaturabhängiger Basismengenkorrekturwert 1 der PiI1 im Regenerationsbetrieb" SWORD InjMass 1 100 -327.6800 327.6700 FORMAT "%8.4" ARRAY_SIZE 2 ECU_ADDRESS 0xC0000D50 /end MEASUREMENT
/begin MEASUREMENT InjCrv_qPiI1ATSCorRgn2_mp "Lufttemperaturabhängiger Basismengenkorrekturwert 2 der PiI1 im Regenerationsbetrieb" SWORD InjMass 1 100 -327.6800 327.6700 FORMAT "%8.4" ARRAY_SIZE 2 ECU_ADDRESS 0xC0000D54 /end MEASUREMENT
/begin MEASUREMENT InjCrv_qPiI1ATSCorStrt_mp "quantity correction value dependent on intake air temperature" SWORD InjMassInj 1 100 -327.6800 327.6700 FORMAT "%8.4" ECU_ADDRESS 0xC0000D14 /end MEASUREMENT
/begin MEASUREMENT InjCrv_qPiI1BasRgn_mp "Basiswert für die Mengenkorrektur der Voreinspritzung 1 im Regenerationsbetrieb" SWORD InjMass 1 100 -327.6800 327.6700 FORMAT "%8.4" ARRAY_SIZE 2 ECU_ADDRESS 0xC0000D78 /end MEASUREMENT
/begin MEASUREMENT InjCrv_qPiI1Bas_mp "Einspritzmenge PiI1 Grundwert" SWORD InjMass 1 100 -327.6800 327.6700 FORMAT "%8.4" ECU_ADDRESS 0xC0000CAE /end MEASUREMENT
/begin MEASUREMENT InjCrv_qPiI1Des "gewünschte Einspritzmenge PiI 1" SWORD InjMass 1 100 -327.6800 327.6700 FORMAT "%8.4" ARRAY_SIZE 6 ECU_ADDRESS 0xD00071F0 /end MEASUREMENT
/begin MEASUREMENT InjCrv_qPiI1DesAdd_mp "Additiver Bypasseingriff für gewünschte Menge der Voreinspritzung 1" SWORD InjMass 1 100 -327.6800 327.6700 FORMAT "%8.4" ARRAY_SIZE 6 ECU_ADDRESS 0xC0000CB0 /end MEASUREMENT
/begin MEASUREMENT InjCrv_qPiI1DesByp_mp "Bypass-Label, Kopie von InjCrv_qPiI1Des" SWORD InjMass 1 100 -327.6800 327.6700 FORMAT "%8.4" ECU_ADDRESS 0xC0000CBC /end MEASUREMENT
/begin MEASUREMENT InjCrv_qPiI1Des_mp "Sollwert der Einspritzmenge von PiI1" SWORD InjMass 1 100 -327.6800 327.6700 FORMAT "%8.4" ECU_ADDRESS 0xC0000CBE /end MEASUREMENT
/begin MEASUREMENT InjCrv_qPiI1DynCorBas_mp "Niedriger Wert PII1 SOE der Mengekorrektur" SWORD InjMassInj 1 100 -327.6800 327.6700 FORMAT "%8.4" ECU_ADDRESS 0xC0000D16 /end MEASUREMENT
/begin MEASUREMENT InjCrv_qPiI1DynCor_mp "Korrekturgrundwert für dynamische Voreinspritzmengenkorrektur" SWORD InjMassInj 1 100 -327.6800 327.6700 FORMAT "%8.4" ECU_ADDRESS 0xC0000D18 /end MEASUREMENT
/begin MEASUREMENT InjCrv_qPiI1EnvCor1 "Korrekturmenge für PiI 1 wenn PiI2 inaktiv" SWORD InjMass 1 100 -327.6800 327.6700 FORMAT "%8.4" ECU_ADDRESS 0xD00071FC /end MEASUREMENT
/begin MEASUREMENT InjCrv_qPiI1EnvCor2 "Korrekturmenge für PiI 1 wenn PiI2 aktiv" SWORD InjMass 1 100 -327.6800 327.6700 FORMAT "%8.4" ECU_ADDRESS 0xD00071FE /end MEASUREMENT
/begin MEASUREMENT InjCrv_qPiI1EnvCorRgn1 "Korrekturmenge 1 für Voreinspritzung 1 im Regenerationsbetrieb" SWORD InjMass 1 100 -327.6800 327.6700 FORMAT "%8.4" ARRAY_SIZE 2 ECU_ADDRESS 0xD0007200 /end MEASUREMENT
/begin MEASUREMENT InjCrv_qPiI1EnvCorRgn2 "Korrekturmenge 2 für Voreinspritzung 1 im Regenerationsbetrieb" SWORD InjMass 1 100 -327.6800 327.6700 FORMAT "%8.4" ARRAY_SIZE 2 ECU_ADDRESS 0xD0007204 /end MEASUREMENT
/begin MEASUREMENT InjCrv_qPiI1ETSCor11_mp "motortemperaturabhängige Korrekturmenge -1 für PiI1 und PiI2" SWORD InjMassInj 1 100 -327.6800 327.6700 FORMAT "%8.4" ECU_ADDRESS 0xC0000D1A /end MEASUREMENT
/begin MEASUREMENT InjCrv_qPiI1ETSCor12_mp """motortemperaturabhängige Korrekturmenge für PiI1 bei inaktiver PiI2""" SWORD InjMassInj 1 100 -327.6800 327.6700 FORMAT "%8.4" ECU_ADDRESS 0xC0000D1C /end MEASUREMENT
/begin MEASUREMENT InjCrv_qPiI1ETSCor1_mp "motortemperaturabhängige Korrekturmenge 1 für PiI1 und PiI2" SWORD InjMass 1 100 -327.6800 327.6700 FORMAT "%8.4" ECU_ADDRESS 0xC0000D3C /end MEASUREMENT
/begin MEASUREMENT InjCrv_qPiI1ETSCor2_mp "motortemperaturabhängige Korrekturmenge 2 für PiI1 und PiI2" SWORD InjMass 1 100 -327.6800 327.6700 FORMAT "%8.4" ECU_ADDRESS 0xC0000D3E /end MEASUREMENT
/begin MEASUREMENT InjCrv_qPiI1ETSCorRgn1_mp "Motortemperaturabhängiger Basismengenkorrekturwert 1 der PiI1 im Regenerationsbetrieb" SWORD InjMass 1 100 -327.6800 327.6700 FORMAT "%8.4" ARRAY_SIZE 2 ECU_ADDRESS 0xC0000D58 /end MEASUREMENT
/begin MEASUREMENT InjCrv_qPiI1ETSCorRgn2_mp "Motortemperaturabhängiger Basismengenkorrekturwert 2 der PiI1 im Regenerationsbetrieb" SWORD InjMass 1 100 -327.6800 327.6700 FORMAT "%8.4" ARRAY_SIZE 2 ECU_ADDRESS 0xC0000D5C /end MEASUREMENT
/begin MEASUREMENT InjCrv_qPiI1ETSCorStrt_mp "quantity correction value dependent on engine temperature" SWORD InjMassInj 1 100 -327.6800 327.6700 FORMAT "%8.4" ECU_ADDRESS 0xC0000D1E /end MEASUREMENT
/begin MEASUREMENT InjCrv_qPiI1MaxRgn_mp "Maximalwert der Korrekturmenge für die Voreinspritzmenge 1 im Regenerationsbetrieb" SWORD InjMass 1 100 -327.6800 327.6700 FORMAT "%8.4" ECU_ADDRESS 0xC0000D7C /end MEASUREMENT
/begin MEASUREMENT InjCrv_qPiI1Max_mp "maximale Einspritzmenge der PiI1" SWORD InjMass 1 100 -327.6800 327.6700 FORMAT "%8.4" ECU_ADDRESS 0xC0000CC0 /end MEASUREMENT
/begin MEASUREMENT InjCrv_qPiI1Rgn "Regenerationswert für die Einspritmenge der PiI1" SWORD InjMass 1 100 -327.6800 327.6700 FORMAT "%8.4" ARRAY_SIZE 2 ECU_ADDRESS 0xD0007208 /end MEASUREMENT
/begin MEASUREMENT InjCrv_qPiI1RgnAdd_mp "Additiver Bypasseingriff für Menge der Voreinspritzung 1 im Regenerationsbetrieb" SWORD InjMass 1 100 -327.6800 327.6700 FORMAT "%8.4" ARRAY_SIZE 2 ECU_ADDRESS 0xC0000D7E /end MEASUREMENT
/begin MEASUREMENT InjCrv_qPiI1SetLimMax_mp "begrenzte maximale Solleinspritzmenge PiI1" SWORD InjMass 1 100 -327.6800 327.6700 FORMAT "%8.4" ECU_ADDRESS 0xC0000CC2 /end MEASUREMENT
/begin MEASUREMENT InjCrv_qPiI1SetLim_mp "begrenzte Solleinspritzmenge PiI1" SWORD InjMass 1 100 -327.6800 327.6700 FORMAT "%8.4" ECU_ADDRESS 0xC0000CC4 /end MEASUREMENT
/begin MEASUREMENT InjCrv_qPiI1Set_mp "Sollwert der Einspritzmenge PiI1" SWORD InjMass 1 100 -327.6800 327.6700 FORMAT "%8.4" ECU_ADDRESS 0xC0000CC6 /end MEASUREMENT
/begin MEASUREMENT InjCrv_qPiI2Des "gewünschte Einspritzmenge PiI 2" SWORD InjMass 1 100 -327.6800 327.6700 FORMAT "%8.4" ARRAY_SIZE 6 ECU_ADDRESS 0xD0007212 /end MEASUREMENT
/begin MEASUREMENT InjCrv_qPiI2DesAdd_mp "Additiver Bypasseingriff für gewünschte Menge der Voreinspritzung 2" SWORD InjMass 1 100 -327.6800 327.6700 FORMAT "%8.4" ARRAY_SIZE 6 ECU_ADDRESS 0xC0000CC8 /end MEASUREMENT
/begin MEASUREMENT InjCrv_qPiI2DesByp_mp "Bypass-Label, Kopie von InjCrv_qPiI2Des" SWORD InjMass 1 100 -327.6800 327.6700 FORMAT "%8.4" ECU_ADDRESS 0xC0000CD4 /end MEASUREMENT
/begin MEASUREMENT InjCrv_qPiI2Des_mp "Sollwert der Einspritzmenge von PiI2" SWORD InjMass 1 100 -327.6800 327.6700 FORMAT "%8.4" ECU_ADDRESS 0xC0000CD6 /end MEASUREMENT
/begin MEASUREMENT InjCrv_qPiI3Des "gewünschte Einspritzmenge PiI 3" SWORD InjMass 1 100 -327.6800 327.6700 FORMAT "%8.4" ARRAY_SIZE 6 ECU_ADDRESS 0xD000722A /end MEASUREMENT
/begin MEASUREMENT InjCrv_qPiI3DesAdd_mp "Additiver Bypasseingriff für gewünschte Menge der Voreinspritzung 3" SWORD InjMass 1 100 -327.6800 327.6700 FORMAT "%8.4" ARRAY_SIZE 6 ECU_ADDRESS 0xC0000CD8 /end MEASUREMENT
/begin MEASUREMENT InjCrv_qPiI3DesByp_mp "Bypass-Label, Kopie von InjCrv_qPiI3Des" SWORD InjMass 1 100 -327.6800 327.6700 FORMAT "%8.4" ECU_ADDRESS 0xC0000CE4 /end MEASUREMENT
/begin MEASUREMENT InjCrv_qPiI3Des_mp "Sollwert der Einspritzmenge von PiI3" SWORD InjMass 1 100 -327.6800 327.6700 FORMAT "%8.4" ECU_ADDRESS 0xC0000CE6 /end MEASUREMENT
/begin MEASUREMENT InjCrv_qPiIMin_mp "minimale Einspritzmenge einer Voreinspritzung, ohne Wellenkorrektur" SWORD InjMass 1 100 -327.6800 327.6700 FORMAT "%8.4" ECU_ADDRESS 0xC0000CE8 /end MEASUREMENT
/begin MEASUREMENT InjCrv_stPiI1_mp "Freigabestatus PiI1" UBYTE OneToOne 1 100 0.00 255.0 FORMAT "%5.1" ECU_ADDRESS 0xC0000CEA /end MEASUREMENT
/begin MEASUREMENT InjCrv_stPiIRlsCor_mp "Freigabestruktur der Voreinspritzung nach Korrekturen" UBYTE OneToOne 1 100 0.00 255.0 FORMAT "%5.1" ECU_ADDRESS 0xC0000C25 /end MEASUREMENT
/begin MEASUREMENT InjCrv_stPiIRlsGearCor_mp "Freigabestruktur der Voreinspritzung nach gangabhängigen Korrekturen" UBYTE OneToOne 1 100 0.00 255.0 FORMAT "%5.1" ECU_ADDRESS 0xC0000C26 /end MEASUREMENT
/begin MEASUREMENT InjCrv_stPiIRlsOpRng_mp "aktueller Betriebsbereich für die Freigabe der Voreinspritzungen" SWORD OneToOne 1 100 -32768.00 32767.00 FORMAT "%8.2" ECU_ADDRESS 0xC0000C28 /end MEASUREMENT
/begin MEASUREMENT InjCrv_stPiIRlsVehSpdCor_mp "Freigabestruktur der Voreinspritzung nach fahrzeuggeschwindigkeitsabhängigen Korrekturen" UBYTE OneToOne 1 100 0.00 255.0 FORMAT "%5.1" ECU_ADDRESS 0xC0000C27 /end MEASUREMENT
/begin MEASUREMENT InjCrv_tAirMI "Selektierte Ansauglufttemperatur für die Haupteinspritzung" SWORD Temp_Cels 1 100 -3549.940 3003.560 FORMAT "%8.3" ECU_ADDRESS 0xD0007276 /end MEASUREMENT
/begin MEASUREMENT InjCrv_tAirPiI "Ansauglufttemperatur für das Subsystem InjCrv" SWORD Temp_Cels 1 100 -3549.940 3003.560 FORMAT "%8.3" ECU_ADDRESS 0xD0007278 /end MEASUREMENT
/begin MEASUREMENT InjCrv_tiDQPT1AddCor2_mp "dq PT1 filter const. in MI SOE correction II" ULONG TimeDelay_s 1 100 0.000001000000000 4294.9672960 FORMAT "%12.7" ECU_ADDRESS 0xC0000C6C /end MEASUREMENT
/begin MEASUREMENT InjCrv_tiMI1ET "geschätzte Ansteuerdauer MI1" SWORD InjTime_us 1 100 -13107.20 5000.00 FORMAT "%8.2" ECU_ADDRESS 0xD000727C /end MEASUREMENT
/begin MEASUREMENT InjCrv_tiPiI1AddCor1 "zusätzliche Korrekturzeit -1 für PiI1 (n sync)" SWORD InjTime_us 1 100 -13107.20 5000.00 FORMAT "%8.2" ECU_ADDRESS 0xD000727E /end MEASUREMENT
/begin MEASUREMENT InjCrv_tiPiI1AddCor2 "zusätzliche Korrekturzeit -2 für PiI1 (n sync)" SWORD InjTime_us 1 100 -13107.20 5000.00 FORMAT "%8.2" ECU_ADDRESS 0xD0007280 /end MEASUREMENT
/begin MEASUREMENT InjCrv_tiPiI1AddCorRgn1 "kundenspezifische Korrekturzeit für PiI1 im Regenerationsbetrieb für nicht freigegebene PiI2" SWORD InjTime_us 1 100 -13107.20 5000.00 FORMAT "%8.2" ECU_ADDRESS 0xD0007282 /end MEASUREMENT
/begin MEASUREMENT InjCrv_tiPiI1AddCorRgn2 "kundenspezifische Korrekturzeit für PiI1 im Regenerationsbetrieb für freigegebene PiI2" SWORD InjTime_us 1 100 -13107.20 5000.00 FORMAT "%8.2" ECU_ADDRESS 0xD0007284 /end MEASUREMENT
/begin MEASUREMENT InjCrv_tiPiI1AddCorStrt "PII1 SOE Zeit korrektur während des Motor start state" SWORD InjTime_us 1 100 -13107.20 5000.00 FORMAT "%8.2" ECU_ADDRESS 0xD0007286 /end MEASUREMENT
/begin MEASUREMENT InjCrv_tiPiI1ATSCor1_mp "Ansauglufttemperaturabhängiger Korrekturgrundwert für die Zeitkomponente des Ansteuerbeginns der PiI1 bei inaktiver PiI2" SWORD InjTime_us 1 100 -13107.20 5000.00 FORMAT "%8.2" ECU_ADDRESS 0xC0000D70 /end MEASUREMENT
/begin MEASUREMENT InjCrv_tiPiI1ATSCor2_mp "Ansauglufttemperaturabhängiger Korrekturgrundwert für die Zeitkomponente des Ansteuerbeginns der PiI1 bei aktiver PiI2" SWORD InjTime_us 1 100 -13107.20 5000.00 FORMAT "%8.2" ECU_ADDRESS 0xC0000D72 /end MEASUREMENT
/begin MEASUREMENT InjCrv_tiPiI1ATSCorRgn1_mp "Lufttemperaturabhängiger Basisansteuerbeginnkorrekturwert 1 der PiI1 im Regenerationsbetrieb" SWORD InjTime_us 1 100 -13107.20 5000.00 FORMAT "%8.2" ARRAY_SIZE 2 ECU_ADDRESS 0xC0000D60 /end MEASUREMENT
/begin MEASUREMENT InjCrv_tiPiI1ATSCorRgn2_mp "Lufttemperaturabhängiger Basisansteuerbeginnkorrekturwert 2 der PiI1 im Regenerationsbetrieb" SWORD InjTime_us 1 100 -13107.20 5000.00 FORMAT "%8.2" ARRAY_SIZE 2 ECU_ADDRESS 0xC0000D64 /end MEASUREMENT
/begin MEASUREMENT InjCrv_tiPiI1BasRgn_mp "Basiswert Ansteuerbeginn der Voreinspritzung 1 im Regenerationsbetrieb" SWORD InjTime_us 1 100 -13107.20 5000.00 FORMAT "%8.2" ARRAY_SIZE 2 ECU_ADDRESS 0xC0000D82 /end MEASUREMENT
/begin MEASUREMENT InjCrv_tiPiI1Bas_mp "Zeitkomponente Ansteuerbeginn PiI1 Grundwert" SWORD InjTime_us 1 100 -13107.20 5000.00 FORMAT "%8.2" ECU_ADDRESS 0xC0000CEC /end MEASUREMENT
/begin MEASUREMENT InjCrv_tiPiI1Cor_mp "korrigierter Grundwert der Zeitkomponente Ansteuerbeginn PiI" SWORD InjTime_us 1 100 -13107.20 5000.00 FORMAT "%8.2" ECU_ADDRESS 0xC0000CEE /end MEASUREMENT
/begin MEASUREMENT InjCrv_tiPiI1Des "gewünschte Zeitkomponente Ansteuerbeginn PiI1" SWORD InjTime_us 1 100 -13107.20 5000.00 FORMAT "%8.2" ECU_ADDRESS 0xD0007288 /end MEASUREMENT
/begin MEASUREMENT InjCrv_tiPiI1DesAdd_mp "Additiver Bypasseingriff für gewünschte Zeit der Voreinspritzung 1" SWORD InjTime_us 1 100 -13107.20 5000.00 FORMAT "%8.2" ECU_ADDRESS 0xC0000CF0 /end MEASUREMENT
/begin MEASUREMENT InjCrv_tiPiI1DesByp_mp "Bypass-Label, Kopie von InjCrv_tiPiI1Des" SWORD InjTime_us 1 100 -13107.20 5000.00 FORMAT "%8.2" ECU_ADDRESS 0xC0000CF2 /end MEASUREMENT
/begin MEASUREMENT InjCrv_tiPiI1DynCorBas_mp "Niedriger Wert PII1 SOE der Zeitkorrektur" SWORD InjTime_us 1 100 -13107.20 5000.00 FORMAT "%8.2" ECU_ADDRESS 0xC0000D20 /end MEASUREMENT
/begin MEASUREMENT InjCrv_tiPiI1DynCor_mp "time correction base value for ET, AP and DQ specific correction" SWORD InjTime_us 1 100 -13107.20 5000.00 FORMAT "%8.2" ECU_ADDRESS 0xC0000D22 /end MEASUREMENT
/begin MEASUREMENT InjCrv_tiPiI1EnvCor1 "Korrekturzeit für PiI1 wenn PiI2 inaktiv" SWORD InjTime_us 1 100 -13107.20 5000.00 FORMAT "%8.2" ECU_ADDRESS 0xD000728A /end MEASUREMENT
/begin MEASUREMENT InjCrv_tiPiI1EnvCor2 "Korrekturzeit für PiI1 wenn PiI2 aktiv" SWORD InjTime_us 1 100 -13107.20 5000.00 FORMAT "%8.2" ECU_ADDRESS 0xD000728C /end MEASUREMENT
/begin MEASUREMENT InjCrv_tiPiI1EnvCorRgn1 "Korrekturansteuerbeginn 1 im Regeneration Betrieb von PiI1" SWORD InjTime_us 1 100 -13107.20 5000.00 FORMAT "%8.2" ARRAY_SIZE 2 ECU_ADDRESS 0xD000728E /end MEASUREMENT
/begin MEASUREMENT InjCrv_tiPiI1EnvCorRgn2 "Korrekturansteuerbeginn 2 im Regeneration Betrieb von PiI1" SWORD InjTime_us 1 100 -13107.20 5000.00 FORMAT "%8.2" ARRAY_SIZE 2 ECU_ADDRESS 0xD0007292 /end MEASUREMENT
/begin MEASUREMENT InjCrv_tiPiI1ETNoCor_mp "geschätzte Ansteuerdauer der PiI1 ohne Korrekturen" SWORD InjTime_us 1 100 -13107.20 5000.00 FORMAT "%8.2" ECU_ADDRESS 0xC0000CF4 /end MEASUREMENT
/begin MEASUREMENT InjCrv_tiPiI1ETSCor11_mp "motortemperaturabhängiger Korrekturgrundwert -1 für die Zeitkomponente Ansteuerbeginn PiI1" SWORD InjTime_us 1 100 -13107.20 5000.00 FORMAT "%8.2" ECU_ADDRESS 0xC0000D24 /end MEASUREMENT
/begin MEASUREMENT InjCrv_tiPiI1ETSCor12_mp "motortemperaturabhängiger Korrekturgrundwert für die Zeitkomponente des Ansteuerbeginns der PiI1 bei inaktiver PiI2" SWORD InjTime_us 1 100 -13107.20 5000.00 FORMAT "%8.2" ECU_ADDRESS 0xC0000D26 /end MEASUREMENT
/begin MEASUREMENT InjCrv_tiPiI1ETSCor1_mp "motortemperaturabhängiger Korrekturgrundwert für die Zeitkomponente des Ansteuerbeginns der PiI1 bei inaktiver PiI2" SWORD InjTime_us 1 100 -13107.20 5000.00 FORMAT "%8.2" ECU_ADDRESS 0xC0000D74 /end MEASUREMENT
/begin MEASUREMENT InjCrv_tiPiI1ETSCor2_mp "motortemperaturabhängiger Korrekturgrundwert für die Zeitkomponente des Ansteuerbeginns der PiI1 bei aktiver PiI2" SWORD InjTime_us 1 100 -13107.20 5000.00 FORMAT "%8.2" ECU_ADDRESS 0xC0000D76 /end MEASUREMENT
/begin MEASUREMENT InjCrv_tiPiI1ETSCorRgn1_mp "Motortemperaturabhängiger Basisansteuerbeginnkorrekturwert 1 der PiI1 im Regenerationsbetrieb" SWORD InjTime_us 1 100 -13107.20 5000.00 FORMAT "%8.2" ARRAY_SIZE 2 ECU_ADDRESS 0xC0000D68 /end MEASUREMENT
/begin MEASUREMENT InjCrv_tiPiI1ETSCorRgn2_mp "Motortemperaturabhängiger Basisansteuerbeginnkorrekturwert 2 der PiI1 im Regenerationsbetrieb" SWORD InjTime_us 1 100 -13107.20 5000.00 FORMAT "%8.2" ARRAY_SIZE 2 ECU_ADDRESS 0xC0000D6C /end MEASUREMENT
/begin MEASUREMENT InjCrv_tiPiI1ETSCorStrt_mp "motortemperaturabhängiger Korrekturgrundwert für die Zeitkomponente des Ansteuerbeginns der PiI1 bei inaktiver PiI2 im Startzust" SWORD InjTime_us 1 100 -13107.20 5000.00 FORMAT "%8.2" ECU_ADDRESS 0xC0000D28 /end MEASUREMENT
/begin MEASUREMENT InjCrv_tiPiI1ET_mp "geschätzte Ansteuerdauer der PiI1" SWORD InjTime_us 1 100 -13107.20 5000.00 FORMAT "%8.2" ECU_ADDRESS 0xC0000CF6 /end MEASUREMENT
/begin MEASUREMENT InjCrv_tiPiI1Hyd_mp "Zeitkomponente Ansteuerbeginn PiI1 für die Berechnung des Ansteuerbeginns der PiI2" SWORD InjTime_us 1 100 -13107.20 5000.00 FORMAT "%8.2" ECU_ADDRESS 0xC0000CF8 /end MEASUREMENT
/begin MEASUREMENT InjCrv_tiPiI1Min_mp "Minimaler Zeitanteil für PiI1 relativ zur MI" SWORD InjTime_us 1 100 -13107.20 5000.00 FORMAT "%8.2" ECU_ADDRESS 0xC0000CFA /end MEASUREMENT
/begin MEASUREMENT InjCrv_tiPiI1RelMI1_mp "Zeitkomponente Ansteuerbeginn PiI1 relativ zur MI1" SWORD InjTime_us 1 100 -13107.20 5000.00 FORMAT "%8.2" ECU_ADDRESS 0xC0000CFC /end MEASUREMENT
/begin MEASUREMENT InjCrv_tiPiI1RelTot_mp "Ansteuerbeginnabstand PiI1 aus Winkel- und Zeitkomponente" SWORD InjTime_us 1 100 -13107.20 5000.00 FORMAT "%8.2" ECU_ADDRESS 0xC0000CFE /end MEASUREMENT
/begin MEASUREMENT InjCrv_tiPiI1Rel_mp "Zeitkomponente Ansteuerbeginn PiI1 relativ zur MI" SWORD InjTime_us 1 100 -13107.20 5000.00 FORMAT "%8.2" ECU_ADDRESS 0xC0000D00 /end MEASUREMENT
/begin MEASUREMENT InjCrv_tiPiI1Rgn "Regenerationswert für die Zeitkomponente des Ansteuerbeginns der PiI1" SWORD InjTime_us 1 100 -13107.20 5000.00 FORMAT "%8.2" ARRAY_SIZE 2 ECU_ADDRESS 0xD0007296 /end MEASUREMENT
/begin MEASUREMENT InjCrv_tiPiI1RgnAdd_mp "Additiver Bypasseingriff für Zeit der Voreinspritzung 1 im Regenerationsbetrieb" SWORD InjTime_us 1 100 -13107.20 5000.00 FORMAT "%8.2" ARRAY_SIZE 2 ECU_ADDRESS 0xC0000D86 /end MEASUREMENT
/begin MEASUREMENT InjCrv_tiPiI1Tot_mp "gesamte Ansteuerdauer der Pil1" SWORD InjTime_us 1 100 -13107.20 5000.00 FORMAT "%8.2" ECU_ADDRESS 0xC0000D02 /end MEASUREMENT
/begin MEASUREMENT InjCrv_tiPiI2Des "gewünschte Zeitkomponente für Ansteuerbeginn PiI2" SWORD InjTime_us 1 100 -13107.20 5000.00 FORMAT "%8.2" ECU_ADDRESS 0xD00072A0 /end MEASUREMENT
/begin MEASUREMENT InjCrv_tiPiI2DesAdd_mp "Additiver Bypasseingriff für gewünschte Zeit der Voreinspritzung 2" SWORD InjTime_us 1 100 -13107.20 5000.00 FORMAT "%8.2" ECU_ADDRESS 0xC0000D04 /end MEASUREMENT
/begin MEASUREMENT InjCrv_tiPiI2DesByp_mp "Bypass-Label, Kopie von InjCrv_tiPiI2Des" SWORD InjTime_us 1 100 -13107.20 5000.00 FORMAT "%8.2" ECU_ADDRESS 0xC0000D06 /end MEASUREMENT
/begin MEASUREMENT InjCrv_volMI1Cor "Einspritzvolumen MI1 mit Korrekturwerten" SWORD InjQntInj 1 100 -327.6800 327.6700 FORMAT "%8.4" ECU_ADDRESS 0xD00072BA /end MEASUREMENT
/begin MEASUREMENT InjCrv_volMI1_mp "Einspritzvolumen MI1" SWORD InjQntInj 1 100 -327.6800 327.6700 FORMAT "%8.4" ECU_ADDRESS 0xC0000C42 /end MEASUREMENT
/begin MEASUREMENT InjCrv_volPiI1Cor_mp "korrigiertes Einspritzvolumen zur Ansteuerdauerabschätzung der PiI1" SWORD InjQntInj 1 100 -327.6800 327.6700 FORMAT "%8.4" ECU_ADDRESS 0xC0000D08 /end MEASUREMENT
/begin MEASUREMENT InjCrv_volPiI1NoCor_mp "Einspritzvolumen ohne Korrekturen zur Ansteuerdauerabschätzung der PiI1" SWORD InjQntInj 1 100 -327.6800 327.6700 FORMAT "%8.4" ECU_ADDRESS 0xC0000D0A /end MEASUREMENT
/begin MEASUREMENT InjCrv_volPiI1_mp "begrenztes Einspritzvolumen PiI1" SWORD InjQntInj 1 100 -327.6800 327.6700 FORMAT "%8.4" ECU_ADDRESS 0xC0000D0C /end MEASUREMENT
/begin FUNCTION InjCrv_CoPiIRlsCor ""
 /begin DEF_CHARACTERISTIC InjCrv_pAirPiIRlsHigh_C InjCrv_pAirPiIRlsLow_C InjCrv_stPiIRlsGearCor_C InjCrv_stPiIRlsGearThres_C InjCrv_stPiIRlsGear_C InjCrv_stPiIRlsPresAirCor_C InjCrv_stPiIRlsPresAir_C InjCrv_stPiIRlsVehSpdCor_C InjCrv_stPiIRlsVehSpd_C InjCrv_vVehPiIRlsHigh_C InjCrv_vVehPiIRlsLow_C /end DEF_CHARACTERISTIC
 /begin LOC_MEASUREMENT InjCrv_stPiIRlsCor_mp InjCrv_stPiIRlsGearCor_mp InjCrv_stPiIRlsVehSpdCor_mp /end LOC_MEASUREMENT
/end FUNCTION
/begin FUNCTION InjCrv_CoPiIRlsOpRng ""
 /begin DEF_CHARACTERISTIC InjCrv_rOpRngATSHys_C InjCrv_rOpRngETSHys_C InjCrv_stRlsOpRngThresRgn_MAP InjCrv_stRlsOpRngThres_MAP /end DEF_CHARACTERISTIC
 /begin IN_MEASUREMENT CACDsT_t InjSys_tEng /end IN_MEASUREMENT
 /begin LOC_MEASUREMENT InjCrv_stPiIRlsOpRng_mp /end LOC_MEASUREMENT
/end FUNCTION
/begin FUNCTION InjCrv_MI ""
 /begin DEF_CHARACTERISTIC InjCrv_phiMI1Bas1BstLP_MAP InjCrv_phiMI1Bas1_MAP InjCrv_phiMI1Bas2BstLP_MAP InjCrv_phiMI1Bas2_MAP InjCrv_phiMI1Bas3_MAP InjCrv_phiMI1Bas4_MAP InjCrv_phiMI1Bas5_MAP InjCrv_phiMI1Des_C InjCrv_phiMI1Max1_MAP InjCrv_phiMI1Max2_MAP InjCrv_phiMI1Max_X_AXIS InjCrv_phiMI1Max_Y_AXIS InjCrv_phiMI1Min_C InjCrv_qMI1Des_C InjCrv_stInjCharActVal_C InjCrv_swtPhiMI1Des_C InjCrv_swtQntMI1Des_C InjCrv_swtStInjCharActVal_C /end DEF_CHARACTERISTIC
 /begin IN_MEASUREMENT CoEng_stShutOffPath Epm_ctCyl Epm_nEng Epm_numCyl FlSys_rhoFl InjCrv_phiMI1AddCor1 InjCrv_phiMI1AddCor2 InjCrv_phiMI1EnvCor1 InjCrv_phiMI1EnvCor2 InjCrv_qPiI1Des InjCrv_qPiI2Des InjCrv_qPiI3Des InjCrv_qPoI2Eff InjCrv_stInjCharActVal InjCrv_stInjCharActValPrg InjCrv_stInjCharRlsPrgVal InjCrv_stInjCharSetVal InjCrv_stMI1Rgn InjCtl_qSetUnBal InjVlv_volMI1CorCyc PCR_stCByVlvOpn RailP_pFlt /end IN_MEASUREMENT
 /begin OUT_MEASUREMENT InjCrv_phiMI1Des InjCrv_qMI1Des InjCrv_tiMI1ET /end OUT_MEASUREMENT
 /begin LOC_MEASUREMENT InjCrv_phiMI1Bas InjCrv_phiMI1Cor_mp InjCrv_phiMI1DesAddByp_mp InjCrv_phiMI1DesAdd_mp InjCrv_phiMI1DesByp_mp InjCrv_phiMI1Lim_mp InjCrv_phiMI1Max_mp InjCrv_qMI1DesAddByp_mp InjCrv_qMI1DesAdd_mp InjCrv_qMI1DesByp_mp InjCrv_qMI1Min_mp InjCrv_qMI1Nrm_mp InjCrv_qMI1SetLimCnv InjCrv_qMI1Set_mp InjCrv_volMI1Cor InjCrv_volMI1_mp /end LOC_MEASUREMENT
/end FUNCTION
/begin FUNCTION InjCrv_MIAddCor ""
 /begin DEF_CHARACTERISTIC InjCrv_dphiMIDyn.Pos_C InjCrv_dphiMIDyn.Neg_C InjCrv_dpMIDynCorDT1.T1_C InjCrv_dpMIDynCorDT1.Kd_C InjCrv_dqFltLowNeg_C InjCrv_dqFltLowPos_C InjCrv_dqFltMidNeg_C InjCrv_dqFltMidPos_C InjCrv_dqSetUnBalMax_C InjCrv_dqSetUnBalMin_C InjCrv_DT1DQMISOECor2.T1_C InjCrv_DT1DQMISOECor2.Kd_C InjCrv_facAPMIDynCor2_CUR InjCrv_facDQMI1DynCor2_CUR InjCrv_facETMIDynCor2_CUR InjCrv_facIAMIDynCor2_CUR InjCrv_facMIATSDynCor_CUR InjCrv_facMICTSDynCor_CUR InjCrv_facMIPDynCor_CUR InjCrv_nMIDynMax_C InjCrv_phiMI1DynCor2_MAP InjCrv_phiMIAPSCorStrt_MAP InjCrv_phiMIAPSDynCor_MAP InjCrv_phiMIATSCorStrt_MAP InjCrv_phiMIDynCor_MAP InjCrv_phiMIDynMax_C InjCrv_phiMIDynMin_C InjCrv_phiMIETSCor11_GMAP InjCrv_phiMIETSCor12_GMAP InjCrv_phiMIETSCor1_X_AXIS InjCrv_phiMIETSCor1_Y_AXIS InjCrv_phiMIETSCorStrt_MAP InjCrv_phiMIFTSRailCorStrtMax_C InjCrv_phiMIFTSRailCorStrtMin_C InjCrv_phiMIFTSRailCorStrt_MAP InjCrv_pMIDynMax_C InjCrv_pMIDynMin_C InjCrv_tiLowNegPT1_C InjCrv_tiLowPosPT1_C InjCrv_tiMidNegPT1_C InjCrv_tiMidPosPT1_C InjCrv_tiUppNegPT1_C InjCrv_tiUppPosPT1_C /end DEF_CHARACTERISTIC
 /begin IN_MEASUREMENT Air_pCACDs CoEng_st EnvP_p Epm_nEng InjCrv_facMIAPSPhiCorStrt InjCrv_facMIATSPhiCorStrt InjCrv_facMIETSPhiCor11 InjCrv_facMIETSPhiCor12 InjCrv_facMIETSPhiCorStrt InjCrv_facMIFTSRailCorStrt InjCrv_swtPiIDblCorMap InjCrv_tAirMI InjCtl_qSetUnBal InjSys_tEng Rail_pSetPointFlTempRedLim Rail_pSetPointFlTempUnLim /end IN_MEASUREMENT
 /begin OUT_MEASUREMENT InjCrv_dpMIDynCor_mp InjCrv_dqSetUnBal InjCrv_dqSetUnBalFltLim InjCrv_facMI1DynCor2_mp InjCrv_facMI1DynCorSlow2 InjCrv_facMIDynCor_mp InjCrv_facMIPDynCor_mp InjCrv_phiMI1AddCor1 InjCrv_phiMI1AddCor2 InjCrv_phiMI1AddCorStrt InjCrv_phiMI1DynCor1_mp InjCrv_phiMI1DynCor2Bas_mp InjCrv_phiMI1DynCor2_mp InjCrv_phiMIAPSDynCor_mp InjCrv_phiMIDynCor_mp InjCrv_phiMIPDynCor_mp InjCrv_pMIDynCor_mp InjCrv_tiDQPT1AddCor2_mp /end OUT_MEASUREMENT
 /begin LOC_MEASUREMENT InjCrv_dqSetUnBalFlt_mp InjCrv_phiMI1DynCor_mp InjCrv_phiMIAPSCorStrt_mp InjCrv_phiMIATSCorStrt_mp InjCrv_phiMIETSCor11_mp InjCrv_phiMIETSCor12_mp InjCrv_phiMIETSCorStrt_mp InjCrv_phiMIFTSRailCorStrt_mp /end LOC_MEASUREMENT
/end FUNCTION
/begin FUNCTION InjCrv_MIAddCorRgn "" /begin OUT_MEASUREMENT InjCrv_phiMI1AddCorRgn /end OUT_MEASUREMENT /end FUNCTION
/begin FUNCTION injcrv_miaddcorslow ""
 /begin DEF_CHARACTERISTIC InjCrv_facMIAPSPhiCorStrt_CUR InjCrv_facMIATSPhiCorStrt_CUR InjCrv_facMIETSPhiCor11_GCUR InjCrv_facMIETSPhiCor12_GCUR InjCrv_facMIETSPhiCor1_AXIS InjCrv_facMIETSPhiCorStrt_CUR InjCrv_facMIFTSRailCorStrt_CUR /end DEF_CHARACTERISTIC
 /begin IN_MEASUREMENT CoEng_st EnvP_p InjCrv_swtPiIDblCorMap InjCrv_tAirMI InjSys_tEng Rail_pSetPointFlTempCor /end IN_MEASUREMENT
 /begin OUT_MEASUREMENT InjCrv_facMIAPSPhiCorStrt InjCrv_facMIATSPhiCorStrt InjCrv_facMIETSPhiCor11 InjCrv_facMIETSPhiCor12 InjCrv_facMIETSPhiCorStrt InjCrv_facMIFTSRailCorStrt /end OUT_MEASUREMENT
/end FUNCTION
/begin FUNCTION InjCrv_MIEnvCor ""
 /begin DEF_CHARACTERISTIC InjCrv_phiMIAPSCor1_MAP InjCrv_phiMIAPSCor2_MAP InjCrv_phiMIAPSCor_X_AXIS InjCrv_phiMIAPSCor_Y_AXIS InjCrv_phiMIATSCor1_MAP InjCrv_phiMIATSCor2_MAP InjCrv_phiMIATSCor_X_AXIS InjCrv_phiMIATSCor_Y_AXIS InjCrv_phiMIETSCor1_MAP InjCrv_phiMIETSCor2_MAP InjCrv_phiMIETSCor_X_AXIS InjCrv_phiMIETSCor_Y_AXIS InjCrv_phiMIFTSRailCorMax_C InjCrv_phiMIFTSRailCorMin_C InjCrv_phiMIFTSRailCor_MAP InjCrv_phiMIPFltCor_MAP /end DEF_CHARACTERISTIC
 /begin IN_MEASUREMENT Epm_nEng InjCrv_facMIAPSPhiCor1 InjCrv_facMIAPSPhiCor2 InjCrv_facMIATSPhiCor1 InjCrv_facMIATSPhiCor2 InjCrv_facMIETSPhiCor1 InjCrv_facMIETSPhiCor2 InjCrv_facMIFTSRailCor InjCrv_facMIPFltPhiCor InjCrv_stMI1RgnTSync InjCrv_swtPiIDblCorMap InjCtl_qSetUnBal /end IN_MEASUREMENT
 /begin OUT_MEASUREMENT InjCrv_phiMI1EnvCor1 InjCrv_phiMI1EnvCor2 /end OUT_MEASUREMENT
 /begin LOC_MEASUREMENT InjCrv_phiMIAPSCor1_mp InjCrv_phiMIAPSCor2_mp InjCrv_phiMIATSCor1_mp InjCrv_phiMIATSCor2_mp InjCrv_phiMIETSCor1_mp InjCrv_phiMIETSCor2_mp InjCrv_phiMIFTSRailCor_mp InjCrv_phiMIPFltCor_mp /end LOC_MEASUREMENT
/end FUNCTION
/begin FUNCTION InjCrv_MIEnvCorRgn ""
 /begin DEF_CHARACTERISTIC InjCrv_phiMI1ATSCor0Rgn_GMAP InjCrv_phiMI1ATSCor1Rgn_GMAP InjCrv_phiMI1ATSCorRgnX_AXIS InjCrv_phiMI1ATSCorRgnY_AXIS InjCrv_phiMI1ETSCor0Rgn_GMAP InjCrv_phiMI1ETSCor1Rgn_GMAP InjCrv_phiMI1ETSCorRgnX_AXIS InjCrv_phiMI1ETSCorRgnY_AXIS /end DEF_CHARACTERISTIC
 /begin IN_MEASUREMENT Epm_nEng InjCrv_facMI1ATSSOECorRgn InjCrv_facMI1ETSSOECorRgn InjCrv_stMI1RgnTSync InjCtl_qSetUnBal /end IN_MEASUREMENT
 /begin OUT_MEASUREMENT InjCrv_phiMI1EnvCorRgn /end OUT_MEASUREMENT
 /begin LOC_MEASUREMENT InjCrv_phiMI1ATSCorRgn_mp InjCrv_phiMI1ETSCorRgn_mp /end LOC_MEASUREMENT
/end FUNCTION
/begin FUNCTION InjCrv_MIEnvCorSlow ""
 /begin DEF_CHARACTERISTIC InjCrv_ctATSMISel_C InjCrv_facMIAPSPhiCor1_CUR InjCrv_facMIAPSPhiCor2_CUR InjCrv_facMIAPSPhiCor_AXIS InjCrv_facMIATSPhiCor1_CUR InjCrv_facMIATSPhiCor2_CUR InjCrv_facMIATSPhiCor_AXIS InjCrv_facMIETSPhiCor1_CUR InjCrv_facMIETSPhiCor2_CUR InjCrv_facMIETSPhiCor_AXIS InjCrv_facMIFTSRailCor_CUR InjCrv_facMIPFltPhiCor_CUR /end DEF_CHARACTERISTIC
 /begin IN_MEASUREMENT AirSys_tFld CACDsT_t EnvP_p Exh_pFltPPFltUs InjCrv_swtPiIDblCorMap InjSys_tEng Rail_pSetPointFlTempCor /end IN_MEASUREMENT
 /begin OUT_MEASUREMENT InjCrv_facMIAPSPhiCor1 InjCrv_facMIAPSPhiCor2 InjCrv_facMIATSPhiCor1 InjCrv_facMIATSPhiCor2 InjCrv_facMIETSPhiCor1 InjCrv_facMIETSPhiCor2 InjCrv_facMIFTSRailCor InjCrv_facMIPFltPhiCor InjCrv_tAirMI /end OUT_MEASUREMENT
/end FUNCTION
/begin FUNCTION InjCrv_MIEnvCorSlowRgn ""
 /begin DEF_CHARACTERISTIC InjCrv_facMI1ATSSOECor0Rgn_GCUR InjCrv_facMI1ATSSOECor1Rgn_GCUR InjCrv_facMI1ATSSOECorRgn_AXIS InjCrv_facMI1ETSSOECor0Rgn_GCUR InjCrv_facMI1ETSSOECor1Rgn_GCUR InjCrv_facMI1ETSSOECorRgn_AXIS /end DEF_CHARACTERISTIC
 /begin IN_MEASUREMENT InjCrv_tAirMI InjSys_tEng /end IN_MEASUREMENT
 /begin OUT_MEASUREMENT InjCrv_facMI1ATSSOECorRgn InjCrv_facMI1ETSSOECorRgn /end OUT_MEASUREMENT
/end FUNCTION
/begin FUNCTION InjCrv_MIRgn ""
 /begin DEF_CHARACTERISTIC InjCrv_phiMI1Bas0Rgn1_GMAP InjCrv_phiMI1Bas0Rgn2_GMAP InjCrv_phiMI1Bas0Rgn3_GMAP InjCrv_phiMI1Bas1Rgn1_GMAP InjCrv_phiMI1Bas1Rgn2_GMAP InjCrv_phiMI1Bas1Rgn3_GMAP InjCrv_phiMI1BasRgn1X_AXIS InjCrv_phiMI1BasRgn1Y_AXIS InjCrv_phiMI1BasRgn2X_AXIS InjCrv_phiMI1BasRgn2Y_AXIS InjCrv_phiMI1BasRgn3X_AXIS InjCrv_phiMI1BasRgn3Y_AXIS InjCrv_qMI1Cor_MAP /end DEF_CHARACTERISTIC
 /begin IN_MEASUREMENT Epm_nEng InjCrv_phiMI1AddCorRgn InjCrv_phiMI1EnvCorRgn InjCrv_stInjCharActVal InjCrv_stMI1Rgn InjCtl_qSetUnBal /end IN_MEASUREMENT
 /begin OUT_MEASUREMENT InjCrv_phiMI1Rgn /end OUT_MEASUREMENT
 /begin LOC_MEASUREMENT InjCrv_phiMI1BasRgn_mp InjCrv_phiMI1RgnAdd_mp /end LOC_MEASUREMENT
/end FUNCTION
/begin FUNCTION InjCrv_MIRgnLib ""
 /begin DEF_CHARACTERISTIC InjCrv_facMI1SOERmp0Val_GCUR InjCrv_facMI1SOERmp1Val_GCUR InjCrv_facMI1SOERmpValX_AXIS /end DEF_CHARACTERISTIC
 /begin IN_MEASUREMENT CoEOM_facRmpVal InjCrv_phiMI1Rgn InjCrv_stMI1Rgn InjCrv_stMI1RmpSel /end IN_MEASUREMENT
 /begin LOC_MEASUREMENT InjCrv_facMI1SOERmpVal_mp /end LOC_MEASUREMENT
/end FUNCTION
/begin FUNCTION InjCrv_MISOERgn "" /end FUNCTION
/begin FUNCTION InjCrv_MIStrt "" /begin DEF_CHARACTERISTIC InjCrv_phiMI1BasStrt_MAP /end DEF_CHARACTERISTIC /begin IN_MEASUREMENT CoEng_st Epm_nEng InjCrv_phiMI1AddCorStrt InjCtl_qSetUnBal /end IN_MEASUREMENT /begin LOC_MEASUREMENT InjCrv_phiMI1StrtCor_mp /end LOC_MEASUREMENT /end FUNCTION
/begin FUNCTION InjCrv_PiI1 ""
 /begin DEF_CHARACTERISTIC InjCrv_facPiI1QntMin_CUR InjCrv_phiPiI1Des_C InjCrv_phiPiIMax_C InjCrv_qMI1MinPiI1DiffHys_C InjCrv_qPiI1Bas1_MAP InjCrv_qPiI1Bas2_MAP InjCrv_qPiI1Bas_X_AXIS InjCrv_qPiI1Bas_Y_AXIS InjCrv_qPiI1Des_C InjCrv_qPiI1Max1_MAP InjCrv_qPiI1Max2_MAP InjCrv_qPiI1Max_X_AXIS InjCrv_qPiI1Max_Y_AXIS InjCrv_qPiI1MinDiff_C InjCrv_stInjDstSel_C InjCrv_swtPhiPiI1Des_C InjCrv_swtQntPiI1Des_C InjCrv_swtTiPiI1Des_C InjCrv_tiPiI1Des_C InjCrv_tiPiI1MinRgn_MAP InjCrv_tiPiI1Min_MAP InjCrv_tiPiIMax_C /end DEF_CHARACTERISTIC
 /begin REF_CHARACTERISTIC InjCrv_stInjCharActVal_C InjCrv_swtStInjCharActVal_C /end REF_CHARACTERISTIC
 /begin IN_MEASUREMENT CoEng_stShutOffPath Epm_ctCyl Epm_nEng Epm_numCyl FlSys_rhoFl InjCrv_phiMI1Des InjCrv_phiPiI1AddCor1 InjCrv_phiPiI1AddCor2 InjCrv_phiPiI1EnvCor1 InjCrv_phiPiI1EnvCor2 InjCrv_qPiI1AddCor1 InjCrv_qPiI1AddCor2 InjCrv_qPiI1EnvCor1 InjCrv_qPiI1EnvCor2 InjCrv_stInjCharActVal InjCrv_stInjCharActValPrg InjCrv_stInjCharRlsPrgVal InjCrv_stInjCharSetVal InjCrv_stPiI1Rgn InjCrv_tiPiI1AddCor1 InjCrv_tiPiI1AddCor2 InjCrv_tiPiI1EnvCor1 InjCrv_tiPiI1EnvCor2 InjCtl_qSetUnBal InjVlv_tiPse InjVlv_volPiI1CorCyc PFltRgn_st QWC_st RailP_pFlt /end IN_MEASUREMENT
 /begin OUT_MEASUREMENT InjCrv_phiPiI1Des InjCrv_phiPiI2Des InjCrv_phiPiI3Des InjCrv_qPiI1Des InjCrv_qPiI2Des InjCrv_qPiI3Des InjCrv_tiPiI1Des InjCrv_tiPiI2Des /end OUT_MEASUREMENT
 /begin LOC_MEASUREMENT InjCrv_facPiI1QntMin_mp InjCrv_phiPiI1AbsTot_mp InjCrv_phiPiI1Abs_mp InjCrv_phiPiI1Bas_mp InjCrv_phiPiI1Cor_mp InjCrv_phiPiI1DesAdd_mp InjCrv_phiPiI1DesByp_mp InjCrv_phiPiI1Rel_mp InjCrv_phiPiI2DesAdd_mp InjCrv_phiPiI2DesByp_mp InjCrv_phiPiI3DesAdd_mp InjCrv_phiPiI3DesByp_mp InjCrv_qMI1MinPiI1_mp InjCrv_qPiI1Bas_mp InjCrv_qPiI1DesAdd_mp InjCrv_qPiI1DesByp_mp InjCrv_qPiI1Des_mp InjCrv_qPiI1Max_mp InjCrv_qPiI1SetLimMax_mp InjCrv_qPiI1SetLim_mp InjCrv_qPiI1Set_mp InjCrv_qPiI2DesAdd_mp InjCrv_qPiI2DesByp_mp InjCrv_qPiI2Des_mp InjCrv_qPiI3DesAdd_mp InjCrv_qPiI3DesByp_mp InjCrv_qPiI3Des_mp InjCrv_qPiIMin_mp InjCrv_stPiI1_mp InjCrv_tiPiI1Bas_mp InjCrv_tiPiI1Cor_mp InjCrv_tiPiI1DesAdd_mp InjCrv_tiPiI1DesByp_mp InjCrv_tiPiI1ETNoCor_mp InjCrv_tiPiI1ET_mp InjCrv_tiPiI1Hyd_mp InjCrv_tiPiI1Min_mp InjCrv_tiPiI1RelMI1_mp InjCrv_tiPiI1RelTot_mp InjCrv_tiPiI1Rel_mp InjCrv_tiPiI1Tot_mp InjCrv_tiPiI2DesAdd_mp InjCrv_tiPiI2DesByp_mp InjCrv_volPiI1Cor_mp InjCrv_volPiI1NoCor_mp InjCrv_volPiI1_mp /end LOC_MEASUREMENT
/end FUNCTION
/begin FUNCTION InjCrv_PiI1AddCor ""
 /begin DEF_CHARACTERISTIC InjCrv_facDQPiI1DynCor_CUR InjCrv_facDQPiI1DynQCor_CUR InjCrv_qPiI1APSCorStrt_MAP InjCrv_qPiI1ATSCorStrt_MAP InjCrv_qPiI1DynQCor_MAP InjCrv_qPiI1ETSCor11_MAP InjCrv_qPiI1ETSCor12_MAP InjCrv_qPiI1ETSCorStrt_MAP InjCrv_tiPiI1DynCor_MAP InjCrv_tiPiI1ETSCor11_MAP InjCrv_tiPiI1ETSCor12_MAP InjCrv_tiPiI1ETSCorStrt_MAP /end DEF_CHARACTERISTIC
 /begin IN_MEASUREMENT CoEng_st Epm_nEng InjCrv_dqSetUnBalFltLim InjCrv_facPiI1APSQCorStrt InjCrv_facPiI1ATSQCorStrt InjCrv_facPiI1DynQCor InjCrv_facPiI1DynSOECor InjCrv_facPiI1ETSQCor11 InjCrv_facPiI1ETSQCor12 InjCrv_facPiI1ETSQCorStrt InjCrv_facPiI1ETSSOECor11 InjCrv_facPiI1ETSSOECor12 InjCrv_facPiI1ETSSOECorStrt InjCrv_swtPiIDblCorMap InjCtl_qSetUnBal /end IN_MEASUREMENT
 /begin OUT_MEASUREMENT InjCrv_phiPiI1AddCor1 InjCrv_phiPiI1AddCor2 InjCrv_qPiI1AddCor1 InjCrv_qPiI1AddCor2 InjCrv_qPiI1AddCorStrt InjCrv_tiPiI1AddCor1 InjCrv_tiPiI1AddCor2 InjCrv_tiPiI1AddCorStrt /end OUT_MEASUREMENT
 /begin LOC_MEASUREMENT InjCrv_facDQPiI1DynCor_mp InjCrv_facDQPiI1DynQCor_mp InjCrv_qPiI1APSCorStrt_mp InjCrv_qPiI1ATSCorStrt_mp InjCrv_qPiI1DynCorBas_mp InjCrv_qPiI1DynCor_mp InjCrv_qPiI1ETSCor11_mp InjCrv_qPiI1ETSCor12_mp InjCrv_qPiI1ETSCorStrt_mp InjCrv_tiPiI1DynCorBas_mp InjCrv_tiPiI1DynCor_mp InjCrv_tiPiI1ETSCor11_mp InjCrv_tiPiI1ETSCor12_mp InjCrv_tiPiI1ETSCorStrt_mp /end LOC_MEASUREMENT
/end FUNCTION
/begin FUNCTION InjCrv_PiI1AddCorRgn ""
 /begin OUT_MEASUREMENT InjCrv_qPiI1AddCorRgn1 InjCrv_qPiI1AddCorRgn2 InjCrv_tiPiI1AddCorRgn1 InjCrv_tiPiI1AddCorRgn2 /end OUT_MEASUREMENT
/end FUNCTION
/begin FUNCTION injcrv_pii1addcorslow ""
 /begin DEF_CHARACTERISTIC InjCrv_facAPPiI1DynCor_CUR InjCrv_facAPPiI1DynQCor_CUR InjCrv_facETPiI1DynCor_CUR InjCrv_facETPiI1DynQCor_CUR InjCrv_facIAPiI1DynCor_CUR InjCrv_facPiI1APSQCorStrt_CUR InjCrv_facPiI1ATSQCorStrt_CUR InjCrv_facPiI1ETSQCor11_CUR InjCrv_facPiI1ETSQCor12_CUR InjCrv_facPiI1ETSQCorStrt_CUR InjCrv_facPiI1ETSSOECor11_CUR InjCrv_facPiI1ETSSOECor12_CUR InjCrv_facPiI1ETSSOECorStrt_CUR /end DEF_CHARACTERISTIC
 /begin IN_MEASUREMENT CoEng_st EnvP_p InjCrv_swtPiIDblCorMap InjCrv_tAirPiI InjSys_tEng /end IN_MEASUREMENT
 /begin OUT_MEASUREMENT InjCrv_facPiI1APSQCorStrt InjCrv_facPiI1ATSQCorStrt InjCrv_facPiI1DynQCor InjCrv_facPiI1DynSOECor InjCrv_facPiI1ETSQCor11 InjCrv_facPiI1ETSQCor12 InjCrv_facPiI1ETSQCorStrt InjCrv_facPiI1ETSSOECor11 InjCrv_facPiI1ETSSOECor12 InjCrv_facPiI1ETSSOECorStrt /end OUT_MEASUREMENT
 /begin LOC_MEASUREMENT InjCrv_facAPPiI1DynCor_mp InjCrv_facAPPiI1DynQCor_mp InjCrv_facETPiI1DynCor_mp InjCrv_facETPiI1DynQCor_mp InjCrv_facIAPiI1DynCor_mp /end LOC_MEASUREMENT
/end FUNCTION
/begin FUNCTION InjCrv_PiI1EnvCor ""
 /begin DEF_CHARACTERISTIC InjCrv_qPiI1APSCor2_MAP InjCrv_qPiI1APSCor_MAP InjCrv_qPiI1APSCor_X_AXIS InjCrv_qPiI1APSCor_Y_AXIS InjCrv_qPiI1ATSCor2_MAP InjCrv_qPiI1ATSCor_MAP InjCrv_qPiI1ATSCor_X_AXIS InjCrv_qPiI1ATSCor_Y_AXIS InjCrv_qPiI1ETSCor2_MAP InjCrv_qPiI1ETSCor_MAP InjCrv_qPiI1ETSCor_X_AXIS InjCrv_qPiI1ETSCor_Y_AXIS /end DEF_CHARACTERISTIC
 /begin IN_MEASUREMENT Epm_nEng InjCrv_facPiI1APSQCor1 InjCrv_facPiI1APSQCor2 InjCrv_facPiI1ATSQCor1 InjCrv_facPiI1ATSQCor2 InjCrv_facPiI1ATSSOECor1 InjCrv_facPiI1ATSSOECor2 InjCrv_facPiI1ETSQCor1 InjCrv_facPiI1ETSQCor2 InjCrv_facPiI1ETSSOECor1 InjCrv_facPiI1ETSSOECor2 InjCrv_stPiI1RgnTSync InjCrv_stPiI2RgnTSync InjCrv_swtPiIDblCorMap InjCtl_qSetUnBal /end IN_MEASUREMENT
 /begin OUT_MEASUREMENT InjCrv_phiPiI1EnvCor1 InjCrv_phiPiI1EnvCor2 InjCrv_qPiI1EnvCor1 InjCrv_qPiI1EnvCor2 InjCrv_tiPiI1EnvCor1 InjCrv_tiPiI1EnvCor2 /end OUT_MEASUREMENT
 /begin LOC_MEASUREMENT InjCrv_qPiI1APSCor1_mp InjCrv_qPiI1APSCor2_mp InjCrv_qPiI1ATSCor1_mp InjCrv_qPiI1ATSCor2_mp InjCrv_qPiI1ETSCor1_mp InjCrv_qPiI1ETSCor2_mp /end LOC_MEASUREMENT
/end FUNCTION
/begin FUNCTION InjCrv_PiI1EnvCorPhi ""
 /begin LOC_MEASUREMENT InjCrv_phiPiI1ATSCor1_mp InjCrv_phiPiI1ATSCor2_mp InjCrv_phiPiI1ETSCor1_mp InjCrv_phiPiI1ETSCor2_mp /end LOC_MEASUREMENT
/end FUNCTION
/begin FUNCTION InjCrv_PiI1EnvCorRgn ""
 /begin DEF_CHARACTERISTIC InjCrv_qPiI1APSCor0Rgn1_GMAP InjCrv_qPiI1APSCor0Rgn2_GMAP InjCrv_qPiI1APSCor1Rgn1_GMAP InjCrv_qPiI1APSCor1Rgn2_GMAP InjCrv_qPiI1APSCorRgnX_AXIS InjCrv_qPiI1APSCorRgnY_AXIS InjCrv_qPiI1ATSCor0Rgn1_GMAP InjCrv_qPiI1ATSCor0Rgn2_GMAP InjCrv_qPiI1ATSCor1Rgn1_GMAP InjCrv_qPiI1ATSCor1Rgn2_GMAP InjCrv_qPiI1ATSCorRgnX_AXIS InjCrv_qPiI1ATSCorRgnY_AXIS InjCrv_qPiI1ETSCor0Rgn1_GMAP InjCrv_qPiI1ETSCor0Rgn2_GMAP InjCrv_qPiI1ETSCor1Rgn1_GMAP InjCrv_qPiI1ETSCor1Rgn2_GMAP InjCrv_qPiI1ETSCorRgnX_AXIS InjCrv_qPiI1ETSCorRgnY_AXIS InjCrv_tiPiI1ATSCor0Rgn1_GMAP InjCrv_tiPiI1ATSCor0Rgn2_GMAP InjCrv_tiPiI1ATSCor1Rgn1_GMAP InjCrv_tiPiI1ATSCor1Rgn2_GMAP InjCrv_tiPiI1ATSCorRgnX_AXIS InjCrv_tiPiI1ATSCorRgnY_AXIS InjCrv_tiPiI1ETSCor0Rgn1_GMAP InjCrv_tiPiI1ETSCor0Rgn2_GMAP InjCrv_tiPiI1ETSCor1Rgn1_GMAP InjCrv_tiPiI1ETSCor1Rgn2_GMAP InjCrv_tiPiI1ETSCorRgnX_AXIS InjCrv_tiPiI1ETSCorRgnY_AXIS /end DEF_CHARACTERISTIC
 /begin IN_MEASUREMENT Epm_nEng InjCrv_facPiI1APSQCorRgn1 InjCrv_facPiI1APSQCorRgn2 InjCrv_facPiI1ATSQCorRgn1 InjCrv_facPiI1ATSQCorRgn2 InjCrv_facPiI1ATSSOECorRgn1 InjCrv_facPiI1ATSSOECorRgn2 InjCrv_facPiI1ETSQCorRgn1 InjCrv_facPiI1ETSQCorRgn2 InjCrv_facPiI1ETSSOECorRgn1 InjCrv_facPiI1ETSSOECorRgn2 InjCrv_stPiI1RgnTSync InjCrv_swtPiIDblCorMap InjCtl_qSetUnBal /end IN_MEASUREMENT
 /begin OUT_MEASUREMENT InjCrv_qPiI1EnvCorRgn1 InjCrv_qPiI1EnvCorRgn2 InjCrv_tiPiI1EnvCorRgn1 InjCrv_tiPiI1EnvCorRgn2 /end OUT_MEASUREMENT
 /begin LOC_MEASUREMENT InjCrv_qPiI1APSCorRgn1_mp InjCrv_qPiI1APSCorRgn2_mp InjCrv_qPiI1ATSCorRgn1_mp InjCrv_qPiI1ATSCorRgn2_mp InjCrv_qPiI1ETSCorRgn1_mp InjCrv_qPiI1ETSCorRgn2_mp InjCrv_tiPiI1ATSCorRgn1_mp InjCrv_tiPiI1ATSCorRgn2_mp InjCrv_tiPiI1ETSCorRgn1_mp InjCrv_tiPiI1ETSCorRgn2_mp /end LOC_MEASUREMENT
/end FUNCTION
/begin FUNCTION InjCrv_PiI1EnvCorSlow ""
 /begin DEF_CHARACTERISTIC InjCrv_ctATSPiISel_C InjCrv_facPiI1APSQCor1_CUR InjCrv_facPiI1APSQCor2_CUR InjCrv_facPiI1APSQCor_AXIS InjCrv_facPiI1ATSQCor1_CUR InjCrv_facPiI1ATSQCor2_CUR InjCrv_facPiI1ATSQCor_AXIS InjCrv_facPiI1ATSSOECor1_CUR InjCrv_facPiI1ATSSOECor2_CUR InjCrv_facPiI1ATSSOECor_AXIS InjCrv_facPiI1ETSQCor1_CUR InjCrv_facPiI1ETSQCor2_CUR InjCrv_facPiI1ETSQCor_AXIS InjCrv_facPiI1ETSSOECor1_CUR InjCrv_facPiI1ETSSOECor2_CUR InjCrv_facPiI1ETSSOECor_AXIS /end DEF_CHARACTERISTIC
 /begin IN_MEASUREMENT AirSys_tFld CACDsT_t EnvP_p InjCrv_swtPiIDblCorMap InjSys_tEng /end IN_MEASUREMENT
 /begin OUT_MEASUREMENT InjCrv_facPiI1APSQCor1 InjCrv_facPiI1APSQCor2 InjCrv_facPiI1ATSQCor1 InjCrv_facPiI1ATSQCor2 InjCrv_facPiI1ATSSOECor1 InjCrv_facPiI1ATSSOECor2 InjCrv_facPiI1ETSQCor1 InjCrv_facPiI1ETSQCor2 InjCrv_facPiI1ETSSOECor1 InjCrv_facPiI1ETSSOECor2 InjCrv_tAirPiI /end OUT_MEASUREMENT
/end FUNCTION
/begin FUNCTION InjCrv_PiI1EnvCorSlowRgn ""
 /begin DEF_CHARACTERISTIC InjCrv_facPiI1APSQCor0Rgn1_GCUR InjCrv_facPiI1APSQCor0Rgn2_GCUR InjCrv_facPiI1APSQCor1Rgn1_GCUR InjCrv_facPiI1APSQCor1Rgn2_GCUR InjCrv_facPiI1APSQCorRgn_AXIS InjCrv_facPiI1ATSQCor0Rgn1_GCUR InjCrv_facPiI1ATSQCor0Rgn2_GCUR InjCrv_facPiI1ATSQCor1Rgn1_GCUR InjCrv_facPiI1ATSQCor1Rgn2_GCUR InjCrv_facPiI1ATSQCorRgn_AXIS InjCrv_facPiI1ATSSOECor0Rgn1_CUR InjCrv_facPiI1ATSSOECor0Rgn2_CUR InjCrv_facPiI1ATSSOECor1Rgn1_CUR InjCrv_facPiI1ATSSOECor1Rgn2_CUR InjCrv_facPiI1ATSSOECorRgn_AXIS InjCrv_facPiI1ETSQCor0Rgn1_GCUR InjCrv_facPiI1ETSQCor0Rgn2_GCUR InjCrv_facPiI1ETSQCor1Rgn1_GCUR InjCrv_facPiI1ETSQCor1Rgn2_GCUR InjCrv_facPiI1ETSQCorRgn_AXIS InjCrv_facPiI1ETSSOECor0Rgn1_CUR InjCrv_facPiI1ETSSOECor0Rgn2_CUR InjCrv_facPiI1ETSSOECor1Rgn1_CUR InjCrv_facPiI1ETSSOECor1Rgn2_CUR InjCrv_facPiI1ETSSOECorRgn_AXIS /end DEF_CHARACTERISTIC
 /begin IN_MEASUREMENT EnvP_p InjCrv_swtPiIDblCorMap InjCrv_tAirPiI InjSys_tEng /end IN_MEASUREMENT
 /begin OUT_MEASUREMENT InjCrv_facPiI1APSQCorRgn1 InjCrv_facPiI1APSQCorRgn2 InjCrv_facPiI1ATSQCorRgn1 InjCrv_facPiI1ATSQCorRgn2 InjCrv_facPiI1ATSSOECorRgn1 InjCrv_facPiI1ATSSOECorRgn2 InjCrv_facPiI1ETSQCorRgn1 InjCrv_facPiI1ETSQCorRgn2 InjCrv_facPiI1ETSSOECorRgn1 InjCrv_facPiI1ETSSOECorRgn2 /end OUT_MEASUREMENT
/end FUNCTION
/begin FUNCTION InjCrv_PiI1EnvCorTi ""
 /begin DEF_CHARACTERISTIC InjCrv_tiPiI1ATSCor1_MAP InjCrv_tiPiI1ATSCor2_MAP InjCrv_tiPiI1ETSCor1_MAP InjCrv_tiPiI1ETSCor2_MAP /end DEF_CHARACTERISTIC
 /begin IN_MEASUREMENT Epm_nEng InjCtl_qSetUnBal /end IN_MEASUREMENT
 /begin LOC_MEASUREMENT InjCrv_tiPiI1ATSCor1_mp InjCrv_tiPiI1ATSCor2_mp InjCrv_tiPiI1ETSCor1_mp InjCrv_tiPiI1ETSCor2_mp /end LOC_MEASUREMENT
/end FUNCTION
/begin FUNCTION InjCrv_PiI1Rgn ""
 /begin DEF_CHARACTERISTIC InjCrv_qPiI1Bas0Rgn1_GMAP InjCrv_qPiI1Bas0Rgn2_GMAP InjCrv_qPiI1Bas1Rgn1_GMAP InjCrv_qPiI1Bas1Rgn2_GMAP InjCrv_qPiI1BasRgnX_AXIS InjCrv_qPiI1BasRgnY_AXIS InjCrv_qPiI1MaxRgn_MAP InjCrv_tiPiI1Bas0Rgn1_GMAP InjCrv_tiPiI1Bas0Rgn2_GMAP InjCrv_tiPiI1Bas1Rgn1_GMAP InjCrv_tiPiI1Bas1Rgn2_GMAP InjCrv_tiPiI1BasRgnX_AXIS InjCrv_tiPiI1BasRgnY_AXIS /end DEF_CHARACTERISTIC
 /begin IN_MEASUREMENT Epm_nEng InjCrv_qPiI1AddCorRgn1 InjCrv_qPiI1AddCorRgn2 InjCrv_qPiI1EnvCorRgn1 InjCrv_qPiI1EnvCorRgn2 InjCrv_stInjCharSetVal InjCrv_stPiI1Rgn InjCrv_tiPiI1AddCorRgn1 InjCrv_tiPiI1AddCorRgn2 InjCrv_tiPiI1EnvCorRgn1 InjCrv_tiPiI1EnvCorRgn2 InjCtl_qSetUnBal /end IN_MEASUREMENT
 /begin OUT_MEASUREMENT InjCrv_qPiI1Rgn InjCrv_tiPiI1Rgn /end OUT_MEASUREMENT
 /begin LOC_MEASUREMENT InjCrv_qPiI1BasRgn_mp InjCrv_qPiI1MaxRgn_mp InjCrv_qPiI1RgnAdd_mp InjCrv_tiPiI1BasRgn_mp InjCrv_tiPiI1RgnAdd_mp /end LOC_MEASUREMENT
/end FUNCTION
/begin FUNCTION InjCrv_PiI1RgnLib ""
 /begin DEF_CHARACTERISTIC InjCrv_facPiI1QntRmp0Val_GCUR InjCrv_facPiI1QntRmp1Val_GCUR InjCrv_facPiI1QntRmpValX_AXIS InjCrv_facPiI1SOERmp0Val_GCUR InjCrv_facPiI1SOERmp1Val_GCUR InjCrv_facPiI1SOERmpValX_AXIS /end DEF_CHARACTERISTIC
 /begin IN_MEASUREMENT CoEOM_facRmpVal InjCrv_qPiI1Rgn InjCrv_stPiI1Rgn InjCrv_stPiI1RmpSel InjCrv_tiPiI1Rgn /end IN_MEASUREMENT
 /begin LOC_MEASUREMENT InjCrv_facPiI1QntRmpVal_mp InjCrv_facPiI1SOERmpVal_mp /end LOC_MEASUREMENT
/end FUNCTION
/begin FUNCTION InjCrv_PiI1SOEPhiBas "" /end FUNCTION
/begin COMPU_METHOD DEFAULT_FORMULA "DEFAULT_FORMULA" RAT_FUNC "%7.0" "" COEFFS 0 1 0 0 0 1 /end COMPU_METHOD
/begin COMPU_METHOD DEFAULT_FORMULA "DEFAULT_FORMULA" RAT_FUNC "%7.0" "" COEFFS 0 1 0 0 0 1 /end COMPU_METHOD
/begin COMPU_METHOD DEFAULT_FORMULA "DEFAULT_FORMULA" RAT_FUNC "%7.0" "" COEFFS 0 1 0 0 0 1 /end COMPU_METHOD
/begin COMPU_METHOD DEFAULT_FORMULA "DEFAULT_FORMULA" RAT_FUNC "%7.0" "" COEFFS 0 1 0 0 0 1 /end COMPU_METHOD
/begin COMPU_METHOD AngleCrS "" RAT_FUNC "%6.4" "deg CrS" COEFFS 0 45.5097222222222 0 0 0 1 /end COMPU_METHOD
/begin COMPU_METHOD CoEOMSwt_S16 "" RAT_FUNC "%7.6" "-" COEFFS 0 16384 0 0 0 1 /end COMPU_METHOD
/begin COMPU_METHOD dp_dZ20 "" RAT_FUNC "%6.1" "hPa/s" COEFFS 0 0.1 0 0 0 1 /end COMPU_METHOD
/begin COMPU_METHOD EngN "" RAT_FUNC "%6.3" "rpm" COEFFS 0 2 0 0 0 1 /end COMPU_METHOD
/begin COMPU_METHOD Fact "" RAT_FUNC "%6.5" "-" COEFFS 0 8192 0 0 0 1 /end COMPU_METHOD
/begin COMPU_METHOD Fact1 "" RAT_FUNC "%6.4" "-" COEFFS 0 128 0 0 0 1 /end COMPU_METHOD
/begin COMPU_METHOD IndSysTempFldSel "" TAB_VERB "%6.3" "-" COMPU_TAB_REF IndSysTempFldSel /end COMPU_METHOD
/begin COMPU_VTAB IndSysTempFldSel "" TAB_VERB 3 0 "CACDsT_t" 1 "AFST_t" 2 "EnvT_t" /end COMPU_VTAB
/begin COMPU_METHOD InjMass "" RAT_FUNC "%6.4" "mg/hub" COEFFS 0 100 0 0 0 1 /end COMPU_METHOD
/begin COMPU_METHOD InjMassInj "" RAT_FUNC "%6.4" "mg/inj" COEFFS 0 100 0 0 0 1 /end COMPU_METHOD
/begin COMPU_METHOD InjMassPerSec_20ms "" RAT_FUNC "%6.3" "mg/hub/s" COEFFS 0 2 0 0 0 1 /end COMPU_METHOD
/begin COMPU_METHOD InjQntInj "" RAT_FUNC "%6.4" "mm^3/inj" COEFFS 0 100 0 0 0 1 /end COMPU_METHOD
/begin COMPU_METHOD InjTime_us "" RAT_FUNC "%6.3" "us" COEFFS 0 2.5 0 0 0 1 /end COMPU_METHOD
/begin COMPU_METHOD Kd_PerSec_20ms "" RAT_FUNC "%6.5" "1/s" COEFFS 0 1310.72 0 0 0 1 /end COMPU_METHOD
/begin COMPU_METHOD Kd_Pres2dpdt "" RAT_FUNC "%8.7" "hPa/sec/hPa" COEFFS 0 131072 0 0 0 1 /end COMPU_METHOD
/begin COMPU_METHOD OneToOne "" RAT_FUNC "%6.2" "-" COEFFS 0 1 0 0 0 1 /end COMPU_METHOD
/begin COMPU_METHOD Prc "" RAT_FUNC "%6.4" "%" COEFFS 0 81.92 0 0 0 1 /end COMPU_METHOD
/begin COMPU_METHOD Pres_hPa "" RAT_FUNC "%6.2" "hPa" COEFFS 0 1 0 0 0 1 /end COMPU_METHOD
/begin COMPU_METHOD Pres_Rail "" RAT_FUNC "%4.3" "bar" COEFFS 0 10.000000 0 0 0 1 /end COMPU_METHOD
/begin COMPU_METHOD RmpCrsAg_InjCrv "" RAT_FUNC "%6.5" "deg CrS/s" COEFFS 0 2982.52515555555 0 0 0 1 /end COMPU_METHOD
/begin COMPU_METHOD Temp_Cels "" RAT_FUNC "%6.1" "deg C" COEFFS 0 10 2731.4 0 0 1 /end COMPU_METHOD
/begin COMPU_METHOD TimeDelay_s "" RAT_FUNC "%12.4" "s" COEFFS 0 0 1 0 0.00023283064365387 0 /end COMPU_METHOD
/begin COMPU_METHOD Vel "" RAT_FUNC "%6.4" "km/h" COEFFS 0 100 0 0 0 1 /end COMPU_METHOD
/begin RECORD_LAYOUT Axis_Xs16 NO_AXIS_PTS_X 1 SWORD AXIS_PTS_X 2 SWORD INDEX_INCR DIRECT /end RECORD_LAYOUT
/begin RECORD_LAYOUT CurG_Ws16 FNC_VALUES 1 SWORD COLUMN_DIR DIRECT /end RECORD_LAYOUT
/begin RECORD_LAYOUT Cur_Xs16Ws16 NO_AXIS_PTS_X 1 SWORD AXIS_PTS_X 2 SWORD INDEX_INCR DIRECT FNC_VALUES 3 SWORD COLUMN_DIR DIRECT /end RECORD_LAYOUT
/begin RECORD_LAYOUT Gkf_Ws16 FNC_VALUES 1 SWORD COLUMN_DIR DIRECT /end RECORD_LAYOUT
/begin RECORD_LAYOUT Gkl_Ws16 FNC_VALUES 1 SWORD COLUMN_DIR DIRECT /end RECORD_LAYOUT
/begin RECORD_LAYOUT GSst_Xs16 NO_AXIS_PTS_X 1 SWORD AXIS_PTS_X 2 SWORD INDEX_INCR DIRECT /end RECORD_LAYOUT
/begin RECORD_LAYOUT Kf_Xs16_Ys16_Ws16 NO_AXIS_PTS_X 1 SWORD NO_AXIS_PTS_Y 2 SWORD AXIS_PTS_X 3 SWORD INDEX_INCR DIRECT AXIS_PTS_Y 4 SWORD INDEX_INCR DIRECT FNC_VALUES 5 SWORD COLUMN_DIR DIRECT /end RECORD_LAYOUT
/begin RECORD_LAYOUT Kl_Xs16_Ws16 NO_AXIS_PTS_X 1 SWORD AXIS_PTS_X 2 SWORD INDEX_INCR DIRECT FNC_VALUES 3 SWORD COLUMN_DIR DIRECT /end RECORD_LAYOUT
/begin RECORD_LAYOUT Kw_Ws16 FNC_VALUES 1 SWORD COLUMN_DIR DIRECT /end RECORD_LAYOUT
/begin RECORD_LAYOUT Kw_Ws32 FNC_VALUES 1 SLONG COLUMN_DIR DIRECT /end RECORD_LAYOUT
/begin RECORD_LAYOUT Kw_Wu32 FNC_VALUES 1 ULONG COLUMN_DIR DIRECT /end RECORD_LAYOUT
/begin RECORD_LAYOUT MapG_Ws16 FNC_VALUES 1 SWORD COLUMN_DIR DIRECT /end RECORD_LAYOUT
/begin RECORD_LAYOUT Map_Xs16Ys16Ws16 NO_AXIS_PTS_X 1 SWORD NO_AXIS_PTS_Y 2 SWORD AXIS_PTS_X 3 SWORD INDEX_INCR DIRECT AXIS_PTS_Y 4 SWORD INDEX_INCR DIRECT FNC_VALUES 5 SWORD COLUMN_DIR DIRECT /end RECORD_LAYOUT
/begin RECORD_LAYOUT Val_Ws16 FNC_VALUES 1 SWORD COLUMN_DIR DIRECT /end RECORD_LAYOUT
/begin RECORD_LAYOUT Val_Wu8 FNC_VALUES 1 UBYTE COLUMN_DIR DIRECT /end RECORD_LAYOUT
/end MODULE
/end PROJECT
