ASAP2_VERSION 1 3
/begin PROJECT _715C360B "basisme9"
/begin HEADER "" VERSION "_715C360B" PROJECT_NO _715C360B /end HEADER
/begin MODULE DIM ""
/begin MOD_COMMON "" BYTE_ORDER MSB_FIRST ALIGNMENT_BYTE 1 ALIGNMENT_WORD 2 ALIGNMENT_LONG 2 ALIGNMENT_FLOAT32_IEEE 4 /end MOD_COMMON
/begin CHARACTERISTIC CDCBREMS "Codewort CARB: Bremspedalgeber" VAL_BLK 0xFD0AA8 KwbUw 65535.00 dez 0.00 65535.00 FORMAT "%8.2" NUMBER 4 /end CHARACTERISTIC
/begin CHARACTERISTIC CDCBWF "Codewort CARB: PWG Bewegung" VAL_BLK 0xFD0AB0 KwbUw 65535.00 dez 0.00 65535.00 FORMAT "%8.2" NUMBER 4 /end CHARACTERISTIC
/begin CHARACTERISTIC CDCDGEN "Codewort Carb Behoerdentester Generator" VAL_BLK 0xFD0AF0 KwbWU16 65535.00 dez 0.00 65535.00 FORMAT "%8.2" NUMBER 4 /end CHARACTERISTIC
/begin CHARACTERISTIC CDCDGENBS "Codewort Carb Behoerdentester Kommunikation" VAL_BLK 0xFD0AF8 KwbWU16 65535.00 dez 0.00 65535.00 FORMAT "%8.2" NUMBER 4 /end CHARACTERISTIC
/begin CHARACTERISTIC CDCDSU "Codewort CARB: Drucksensor Umgebung" VAL_BLK 0xFD0B38 KwbUw 65535.00 dez 0.00 65535.00 FORMAT "%8.2" NUMBER 4 /end CHARACTERISTIC
/begin CHARACTERISTIC CDCDWA "Codewort CARB: Diebstahlwarnanlage" VAL_BLK 0xFD0B98 KwbUw 65535.00 dez 0.00 65535.00 FORMAT "%8.2" NUMBER 4 /end CHARACTERISTIC
/begin CHARACTERISTIC CDCDZKU0 "Codewort CARB:	Z¸ndspule 0" VAL_BLK 0xFD0BA0 KwbWU16 65535.00 dez 0.00 65535.00 FORMAT "%8.2" NUMBER 4 /end CHARACTERISTIC
/begin CHARACTERISTIC CDCDZKU1 "Codewort CARB:	Z¸ndspule 1" VAL_BLK 0xFD0BA8 KwbWU16 65535.00 dez 0.00 65535.00 FORMAT "%8.2" NUMBER 4 /end CHARACTERISTIC
/begin CHARACTERISTIC CDCDZKU2 "Codewort CARB:	Z¸ndspule 2" VAL_BLK 0xFD0BB0 KwbWU16 65535.00 dez 0.00 65535.00 FORMAT "%8.2" NUMBER 4 /end CHARACTERISTIC
/begin CHARACTERISTIC CDCDZKU3 "Codewort CARB:	Z¸ndspule 3" VAL_BLK 0xFD0BB8 KwbWU16 65535.00 dez 0.00 65535.00 FORMAT "%8.2" NUMBER 4 /end CHARACTERISTIC
/begin CHARACTERISTIC CDCDZKU4 "Codewort CARB:	Z¸ndspule 4" VAL_BLK 0xFD0BC0 KwbWU16 65535.00 dez 0.00 65535.00 FORMAT "%8.2" NUMBER 4 /end CHARACTERISTIC
/begin CHARACTERISTIC CDCDZKU5 "Codewort CARB:	Z¸ndspule 5" VAL_BLK 0xFD0BC8 KwbWU16 65535.00 dez 0.00 65535.00 FORMAT "%8.2" NUMBER 4 /end CHARACTERISTIC
/begin CHARACTERISTIC CDCDZKU6 "Codewort CARB:	Z¸ndspule 6" VAL_BLK 0xFD0BD0 KwbWU16 65535.00 dez 0.00 65535.00 FORMAT "%8.2" NUMBER 4 /end CHARACTERISTIC
/begin CHARACTERISTIC CDCDZKU7 "Codewort CARB:	Z¸ndspule 7" VAL_BLK 0xFD0BD8 KwbWU16 65535.00 dez 0.00 65535.00 FORMAT "%8.2" NUMBER 4 /end CHARACTERISTIC
/begin CHARACTERISTIC CDCEGFE "Codewort CARB: Lasterfassung" VAL_BLK 0xFD0BE0 KwbUw 65535.00 dez 0.00 65535.00 FORMAT "%8.2" NUMBER 4 /end CHARACTERISTIC
/begin CHARACTERISTIC CDCFP1P "Codewort CARB: Poti 1, Fahrpedal" VAL_BLK 0xFD0C50 KwbUw 65535.00 dez 0.00 65535.00 FORMAT "%8.2" NUMBER 4 /end CHARACTERISTIC
/begin CHARACTERISTIC CDCFP2P "Codewort CARB: Poti 2, Fahrpedal" VAL_BLK 0xFD0C58 KwbUw 65535.00 dez 0.00 65535.00 FORMAT "%8.2" NUMBER 4 /end CHARACTERISTIC
/begin CHARACTERISTIC CDCFPP "Codewort CARB: Fahrpedal" VAL_BLK 0xFD0C60 KwbUw 65535.00 dez 0.00 65535.00 FORMAT "%8.2" NUMBER 4 /end CHARACTERISTIC
/begin CHARACTERISTIC CDCMDB "Codewort CARB: Momentbegrenzung Sollmoment" VAL_BLK 0xFD0DF0 KwbUw 65535.00 dez 0.00 65535.00 FORMAT "%8.2" NUMBER 4 /end CHARACTERISTIC
/begin CHARACTERISTIC CDCMFL "Codewort CARB: Multifunktionslenkrad" VAL_BLK 0xFD0E00 KwbWU16 65535.00 dez 0.00 65535.00 FORMAT "%8.2" NUMBER 4 /end CHARACTERISTIC
/begin CHARACTERISTIC CDCTA "Codewort CARB: TANS" VAL_BLK 0xFD0EA0 KwbUw 65535.00 dez 0.00 65535.00 FORMAT "%8.2" NUMBER 4 /end CHARACTERISTIC
/begin CHARACTERISTIC CDCTKA "Codewort CARB: Temperatur K¸hlerausgang" VAL_BLK 0xFD0EC0 KwbUw 65535.00 dez 0.00 65535.00 FORMAT "%8.2" NUMBER 4 /end CHARACTERISTIC
/begin CHARACTERISTIC CDCTM "Codewort CARB: Motortemperatur TMOT" VAL_BLK 0xFD0EC8 KwbUw 65535.00 dez 0.00 65535.00 FORMAT "%8.2" NUMBER 4 /end CHARACTERISTIC
/begin CHARACTERISTIC CDCTUM "Codewort CARB: Umgebungs(-luft)-Temperatur TUM" VAL_BLK 0xFD0ED8 KwbUw 65535.00 dez 0.00 65535.00 FORMAT "%8.2" NUMBER 4 /end CHARACTERISTIC
/begin CHARACTERISTIC CDCUB "Codewort CARB: Batteriespannung UB (Bordnetz)" VAL_BLK 0xFD0EE0 KwbWU16 65535.00 dez 0.00 65535.00 FORMAT "%8.2" NUMBER 4 /end CHARACTERISTIC
/begin CHARACTERISTIC CDCUBR "Codewort CARB: UBR Bordnetzspannung ¸ber Hauptrelais" VAL_BLK 0xFD0EE8 KwbUw 65535.00 dez 0.00 65535.00 FORMAT "%8.2" NUMBER 4 /end CHARACTERISTIC
/begin CHARACTERISTIC CDCUFMV "Codewort CARB: Funktions¸berwachung: Momentenvergleich" VAL_BLK 0xFD0EF0 KwbUw 65535.00 dez 0.00 65535.00 FORMAT "%8.2" NUMBER 4 /end CHARACTERISTIC
/begin CHARACTERISTIC CDCUFNC "Codewort CARB: Funktions¸berwachung: Drehzahlgeber-, Zuleitung- oder SG-Fehler" VAL_BLK 0xFD0EF8 KwbUw 65535.00 dez 0.00 65535.00 FORMAT "%8.2" NUMBER 4 /end CHARACTERISTIC
/begin CHARACTERISTIC CDCUFRLIP "Codewort CARB: Funktions¸berwachung: Lastsensor-, Zuleitung- oder SG-Fehler" VAL_BLK 0xFD0F00 KwbUw 65535.00 dez 0.00 65535.00 FORMAT "%8.2" NUMBER 4 /end CHARACTERISTIC
/begin CHARACTERISTIC CDCUFSGA "Codewort CARB: Funktions¸berwachung: Steuerger‰te-Fehler Gruppe a" VAL_BLK 0xFD0F08 KwbUw 65535.00 dez 0.00 65535.00 FORMAT "%8.2" NUMBER 4 /end CHARACTERISTIC
/begin CHARACTERISTIC CDCUFSGB "Codewort CARB: Funktions¸berwachung: Steuerger‰te-Fehler Gruppe b" VAL_BLK 0xFD0F10 KwbUw 65535.00 dez 0.00 65535.00 FORMAT "%8.2" NUMBER 4 /end CHARACTERISTIC
/begin CHARACTERISTIC CDCUFSGC "Codewort CARB: Funktions¸berwachung: Steuerger‰te-Fehler Gruppe c" VAL_BLK 0xFD0F18 KwbUw 65535.00 dez 0.00 65535.00 FORMAT "%8.2" NUMBER 4 /end CHARACTERISTIC
/begin CHARACTERISTIC CDCUFSPSC "Codewort CARB: Funktions¸berwachung: Pedalwertgeber-, Zuleitung- oder SG-Fehler" VAL_BLK 0xFD0F20 KwbUw 65535.00 dez 0.00 65535.00 FORMAT "%8.2" NUMBER 4 /end CHARACTERISTIC
/begin CHARACTERISTIC CDCURRAM "Codewort CARB: Rechner¸berwachung: RAM" VAL_BLK 0xFD0F28 KwbUw 65535.00 dez 0.00 65535.00 FORMAT "%8.2" NUMBER 4 /end CHARACTERISTIC
/begin CHARACTERISTIC CDCURROM "Codewort CARB: Rechner¸berwachung: ROM" VAL_BLK 0xFD0F30 KwbUw 65535.00 dez 0.00 65535.00 FORMAT "%8.2" NUMBER 4 /end CHARACTERISTIC
/begin CHARACTERISTIC CDCURRST "Codewort CARB: Rechner¸berwachung: Reset" VAL_BLK 0xFD0F38 KwbUw 65535.00 dez 0.00 65535.00 FORMAT "%8.2" NUMBER 4 /end CHARACTERISTIC
/begin CHARACTERISTIC CDCVFZ "Codewort CARB: Fahrzeug-Geschwindigkeit" VAL_BLK 0xFD0F40 KwbUw 65535.00 dez 0.00 65535.00 FORMAT "%8.2" NUMBER 4 /end CHARACTERISTIC
/begin CHARACTERISTIC CDCWCA "Codewort CARB: Wegfahrsperre Wechselcode-Ablage" VAL_BLK 0xFD0F48 KwbUw 65535.00 dez 0.00 65535.00 FORMAT "%8.2" NUMBER 4 /end CHARACTERISTIC
/begin CHARACTERISTIC CDCWFS "Codewort CARB: Wegfahrsperre" VAL_BLK 0xFD0F50 KwbUw 65535.00 dez 0.00 65535.00 FORMAT "%8.2" NUMBER 4 /end CHARACTERISTIC
/begin CHARACTERISTIC CDKBREMS "Codewort Kunde: BREMS (Bremsschalter)" VALUE 0xFD0F72 KwUw 65535.00 dez 0.00 65535.00 FORMAT "%8.2" /end CHARACTERISTIC
/begin CHARACTERISTIC CDKBWF "Codewort Kunde: PWG Bewegung" VALUE 0xFD0F74 KwUw 65535.00 dez 0.00 65535.00 FORMAT "%8.2" /end CHARACTERISTIC
/begin CHARACTERISTIC CDKDGEN "Codewort Kunde Generator" VALUE 0xFD0F84 KwWU16 65535.00 dez 0.00 65535.00 FORMAT "%8.2" /end CHARACTERISTIC
/begin CHARACTERISTIC CDKDGENBS "Codewort Kunde Kommunikation" VALUE 0xFD0F86 KwWU16 65535.00 dez 0.00 65535.00 FORMAT "%8.2" /end CHARACTERISTIC
/begin CHARACTERISTIC CDKDSU "Codewort Kunde: Drucksensor Umgebung" VALUE 0xFD0F96 KwUw 65535.00 dez 0.00 65535.00 FORMAT "%8.2" /end CHARACTERISTIC
/begin CHARACTERISTIC CDKDWA "Codewort Kunde: Diebstahlwarnanlage" VALUE 0xFD0FAE KwUw 65535.00 dez 0.00 65535.00 FORMAT "%8.2" /end CHARACTERISTIC
/begin CHARACTERISTIC CDKDZKU0 "Codewort Kunde:	Z¸ndspule 0" VALUE 0xFD0FB0 KwWU16 65535.00 dez 0.00 65535.00 FORMAT "%8.2" /end CHARACTERISTIC
/begin CHARACTERISTIC CDKDZKU1 "Codewort Kunde:	Z¸ndspule 1" VALUE 0xFD0FB2 KwWU16 65535.00 dez 0.00 65535.00 FORMAT "%8.2" /end CHARACTERISTIC
/begin CHARACTERISTIC CDKDZKU2 "Codewort Kunde:	Z¸ndspule 2" VALUE 0xFD0FB4 KwWU16 65535.00 dez 0.00 65535.00 FORMAT "%8.2" /end CHARACTERISTIC
/begin CHARACTERISTIC CDKDZKU3 "Codewort Kunde:	Z¸ndspule 3" VALUE 0xFD0FB6 KwWU16 65535.00 dez 0.00 65535.00 FORMAT "%8.2" /end CHARACTERISTIC
/begin CHARACTERISTIC CDKDZKU4 "Codewort Kunde:	Z¸ndspule 4" VALUE 0xFD0FB8 KwWU16 65535.00 dez 0.00 65535.00 FORMAT "%8.2" /end CHARACTERISTIC
/begin CHARACTERISTIC CDKDZKU5 "Codewort Kunde:	Z¸ndspule 5" VALUE 0xFD0FBA KwWU16 65535.00 dez 0.00 65535.00 FORMAT "%8.2" /end CHARACTERISTIC
/begin CHARACTERISTIC CDKDZKU6 "Codewort Kunde:	Z¸ndspule 6" VALUE 0xFD0FBC KwWU16 65535.00 dez 0.00 65535.00 FORMAT "%8.2" /end CHARACTERISTIC
/begin CHARACTERISTIC CDKDZKU7 "Codewort Kunde:	Z¸ndspule 7" VALUE 0xFD0FBE KwWU16 65535.00 dez 0.00 65535.00 FORMAT "%8.2" /end CHARACTERISTIC
/begin CHARACTERISTIC CDKEGFE "Codewort Kunde: Lasterfassung" VALUE 0xFD0FC0 KwUw 65535.00 dez 0.00 65535.00 FORMAT "%8.2" /end CHARACTERISTIC
/begin CHARACTERISTIC CDKFP1P "Codewort Kunde: Poti 1, Fahrpedal" VALUE 0xFD0FDC KwUw 65535.00 dez 0.00 65535.00 FORMAT "%8.2" /end CHARACTERISTIC
/begin CHARACTERISTIC CDKFP2P "Codewort Kunde: Poti 2, Fahrpedal" VALUE 0xFD0FDE KwUw 65535.00 dez 0.00 65535.00 FORMAT "%8.2" /end CHARACTERISTIC
/begin CHARACTERISTIC CDKFPP "Codewort Kunde: Poti Fahrpedal" VALUE 0xFD0FE0 KwUw 65535.00 dez 0.00 65535.00 FORMAT "%8.2" /end CHARACTERISTIC
/begin CHARACTERISTIC CDKMDB "Codewort Kunde: Momentbegrenzung Sollmoment" VALUE 0xFD1044 KwUw 65535.00 dez 0.00 65535.00 FORMAT "%8.2" /end CHARACTERISTIC
/begin CHARACTERISTIC CDKMFL "Codewort Kunde: Multifunktionslenkrad" VALUE 0xFD1048 KwWU16 65535.00 dez 0.00 65535.00 FORMAT "%8.2" /end CHARACTERISTIC
/begin CHARACTERISTIC CDKTA "Codewort Kunde:	TANS" VALUE 0xFD1070 KwUw 65535.00 dez 0.00 65535.00 FORMAT "%8.2" /end CHARACTERISTIC
/begin CHARACTERISTIC CDKTKA "Codewort Kunde: Temperatur am K¸hlerausgang" VALUE 0xFD1078 KwUw 65535.00 dez 0.00 65535.00 FORMAT "%8.2" /end CHARACTERISTIC
/begin CHARACTERISTIC CDKTM "Codewort Kunde: TMOT" VALUE 0xFD107A KwUw 65535.00 dez 0.00 65535.00 FORMAT "%8.2" /end CHARACTERISTIC
/begin CHARACTERISTIC CDKTUM "Codewort Kunde: Umgebungstemperatur" VALUE 0xFD107E KwUw 65535.00 dez 0.00 65535.00 FORMAT "%8.2" /end CHARACTERISTIC
/begin CHARACTERISTIC CDKUB "Codewort Kunde:	UB" VALUE 0xFD1080 KwWU16 65535.00 dez 0.00 65535.00 FORMAT "%8.2" /end CHARACTERISTIC
/begin CHARACTERISTIC CDKUBR "" VALUE 0xFD1082 KwUw 65535.00 dez 0.00 65535.00 FORMAT "%8.2" /end CHARACTERISTIC
/begin CHARACTERISTIC CDKUFMV "Codewort Kunde: Funktions¸berwachung: Momentenvergleich" VALUE 0xFD1084 KwUw 65535.00 dez 0.00 65535.00 FORMAT "%8.2" /end CHARACTERISTIC
/begin CHARACTERISTIC CDKUFNC "Codewort Kunde: Funktions¸berwachung: Drehzahlgeber-, Zuleitung- oder SG-Fehler" VALUE 0xFD1086 KwUw 65535.00 dez 0.00 65535.00 FORMAT "%8.2" /end CHARACTERISTIC
/begin CHARACTERISTIC CDKUFRLIP "Codewort Kunde: Funktions¸berwachung: Lastsensor-, Zuleitung- oder SG-Fehler" VALUE 0xFD1088 KwUw 65535.00 dez 0.00 65535.00 FORMAT "%8.2" /end CHARACTERISTIC
/begin CHARACTERISTIC CDKUFSGA "Codewort Kunde: Funktions¸berwachung: Steuerger‰te-Fehler Gruppe a" VALUE 0xFD108A KwUw 65535.00 dez 0.00 65535.00 FORMAT "%8.2" /end CHARACTERISTIC
/begin CHARACTERISTIC CDKUFSGB "Codewort Kunde: Funktions¸berwachung: Steuerger‰te-Fehler Gruppe b" VALUE 0xFD108C KwUw 65535.00 dez 0.00 65535.00 FORMAT "%8.2" /end CHARACTERISTIC
/begin CHARACTERISTIC CDKUFSGC "Codewort Kunde: Funktions¸berwachung: Steuerger‰te-Fehler Gruppe c" VALUE 0xFD108E KwUw 65535.00 dez 0.00 65535.00 FORMAT "%8.2" /end CHARACTERISTIC
/begin CHARACTERISTIC CDKUFSPSC "Codewort Kunde: Funktions¸berwachung: Pedalwertgeber-, Zuleitung- oder SG-Fehler" VALUE 0xFD1090 KwUw 65535.00 dez 0.00 65535.00 FORMAT "%8.2" /end CHARACTERISTIC
/begin CHARACTERISTIC CDKURRAM "Codewort Kunde: Rechner¸berwachung: RAM" VALUE 0xFD1092 KwUw 65535.00 dez 0.00 65535.00 FORMAT "%8.2" /end CHARACTERISTIC
/begin CHARACTERISTIC CDKURROM "Codewort Kunde: Rechner¸berwachung: ROM" VALUE 0xFD1094 KwUw 65535.00 dez 0.00 65535.00 FORMAT "%8.2" /end CHARACTERISTIC
/begin CHARACTERISTIC CDKURRST "Codewort Kunde: Rechner¸berwachung: Reset" VALUE 0xFD1096 KwUw 65535.00 dez 0.00 65535.00 FORMAT "%8.2" /end CHARACTERISTIC
/begin CHARACTERISTIC CDKVFZ "Codewort Kunde:	Fahrzeug-Geschwindigkeit" VALUE 0xFD1098 KwUw 65535.00 dez 0.00 65535.00 FORMAT "%8.2" /end CHARACTERISTIC
/begin CHARACTERISTIC CDKWCA "Codewort Kunde: Wegfahrsperre Wechselcode-Ablage" VALUE 0xFD109A KwUw 65535.00 dez 0.00 65535.00 FORMAT "%8.2" /end CHARACTERISTIC
/begin CHARACTERISTIC CDKWFS "Codewort Kunde: Wegfahrsperre" VALUE 0xFD109C KwUw 65535.00 dez 0.00 65535.00 FORMAT "%8.2" /end CHARACTERISTIC
/begin CHARACTERISTIC CDTBREMS "Fehlerpfadcode: BREMS (Bremsschalter)" VALUE 0xFD10B2 KwUw 65535.00 dez 0.00 65535.00 FORMAT "%8.2" /end CHARACTERISTIC
/begin CHARACTERISTIC CDTBWF "Codewort Tester: PWG Bewegung" VALUE 0xFD10B4 KwUw 65535.00 dez 0.00 65535.00 FORMAT "%8.2" /end CHARACTERISTIC
/begin CHARACTERISTIC CDTDGEN "Codewort Tester Generator" VALUE 0xFD10C4 KwWU16 65535.00 dez 0.00 65535.00 FORMAT "%8.2" /end CHARACTERISTIC
/begin CHARACTERISTIC CDTDGENBS "codewort Tester Kommunikation" VALUE 0xFD10C6 KwWU16 65535.00 dez 0.00 65535.00 FORMAT "%8.2" /end CHARACTERISTIC
/begin CHARACTERISTIC CDTDSU "Codewort Tester: Drucksensor Umgebung" VALUE 0xFD10D6 KwUw 65535.00 dez 0.00 65535.00 FORMAT "%8.2" /end CHARACTERISTIC
/begin CHARACTERISTIC CDTDWA "Codewort Tester: Diebstahlwarnanlage" VALUE 0xFD10EE KwUw 65535.00 dez 0.00 65535.00 FORMAT "%8.2" /end CHARACTERISTIC
/begin CHARACTERISTIC CDTDZKU0 "Codewort Tester: Z¸ndspule 0" VALUE 0xFD10F0 KwWU16 65535.00 dez 0.00 65535.00 FORMAT "%8.2" /end CHARACTERISTIC
/begin CHARACTERISTIC CDTDZKU1 "Codewort Tester: Z¸ndspule 1" VALUE 0xFD10F2 KwWU16 65535.00 dez 0.00 65535.00 FORMAT "%8.2" /end CHARACTERISTIC
/begin CHARACTERISTIC CDTDZKU2 "Codewort Tester: Z¸ndspule 2" VALUE 0xFD10F4 KwWU16 65535.00 dez 0.00 65535.00 FORMAT "%8.2" /end CHARACTERISTIC
/begin CHARACTERISTIC CDTDZKU3 "Codewort Tester: Z¸ndspule 3" VALUE 0xFD10F6 KwWU16 65535.00 dez 0.00 65535.00 FORMAT "%8.2" /end CHARACTERISTIC
/begin CHARACTERISTIC CDTDZKU4 "Codewort Tester: Z¸ndspule 4" VALUE 0xFD10F8 KwWU16 65535.00 dez 0.00 65535.00 FORMAT "%8.2" /end CHARACTERISTIC
/begin CHARACTERISTIC CDTDZKU5 "Codewort Tester: Z¸ndspule 5" VALUE 0xFD10FA KwWU16 65535.00 dez 0.00 65535.00 FORMAT "%8.2" /end CHARACTERISTIC
/begin CHARACTERISTIC CDTDZKU6 "Codewort Tester: Z¸ndspule 6" VALUE 0xFD10FC KwWU16 65535.00 dez 0.00 65535.00 FORMAT "%8.2" /end CHARACTERISTIC
/begin CHARACTERISTIC CDTDZKU7 "Codewort Tester: Z¸ndspule 7" VALUE 0xFD10FE KwWU16 65535.00 dez 0.00 65535.00 FORMAT "%8.2" /end CHARACTERISTIC
/begin CHARACTERISTIC CDTEGFE "Codeowort Tester: Eingangsgrˆﬂe F¸llungserfassung" VALUE 0xFD1100 KwUw 65535.00 dez 0.00 65535.00 FORMAT "%8.2" /end CHARACTERISTIC
/begin CHARACTERISTIC CDTFP1P "Codewort Tester: Poti 1, Fahrpedal" VALUE 0xFD111C KwUw 65535.00 dez 0.00 65535.00 FORMAT "%8.2" /end CHARACTERISTIC
/begin CHARACTERISTIC CDTFP2P "Codewort Tester: Poti 2, Fahrpedal" VALUE 0xFD111E KwUw 65535.00 dez 0.00 65535.00 FORMAT "%8.2" /end CHARACTERISTIC
/begin CHARACTERISTIC CDTFPP "Codewort Tester: Poti Fahrpedal" VALUE 0xFD1120 KwUw 65535.00 dez 0.00 65535.00 FORMAT "%8.2" /end CHARACTERISTIC
/begin CHARACTERISTIC CDTMDB "Codewort Tester: Momentbegrenzung Sollmoment" VALUE 0xFD1184 KwUw 65535.00 dez 0.00 65535.00 FORMAT "%8.2" /end CHARACTERISTIC
/begin CHARACTERISTIC CDTMFL "Codewort Tester: Multifunktionslenkrad" VALUE 0xFD1188 KwWU16 65535.00 dez 0.00 65535.00 FORMAT "%8.2" /end CHARACTERISTIC
/begin CHARACTERISTIC CDTTA "Codewort Tester: TANS" VALUE 0xFD11B0 KwUw 65535.00 dez 0.00 65535.00 FORMAT "%8.2" /end CHARACTERISTIC
/begin CHARACTERISTIC CDTTKA "Codewort Tester: Temperatur K¸hlerausgang" VALUE 0xFD11B8 KwUw 65535.00 dez 0.00 65535.00 FORMAT "%8.2" /end CHARACTERISTIC
/begin CHARACTERISTIC CDTTM "Codewort Tester: TMOT" VALUE 0xFD11BA KwUw 65535.00 dez 0.00 65535.00 FORMAT "%8.2" /end CHARACTERISTIC
/begin CHARACTERISTIC CDTTUM "Codewort Tester: Umgebungstemperatur TUM" VALUE 0xFD11BE KwUw 65535.00 dez 0.00 65535.00 FORMAT "%8.2" /end CHARACTERISTIC
/begin CHARACTERISTIC CDTUB "Codewort Tester: UB" VALUE 0xFD11C0 KwWU16 65535.00 dez 0.00 65535.00 FORMAT "%8.2" /end CHARACTERISTIC
/begin CHARACTERISTIC CDTUBR "Codewort Tester: UBR Bordnetzspannung ¸ber Hauptrelais" VALUE 0xFD11C2 KwUw 65535.00 dez 0.00 65535.00 FORMAT "%8.2" /end CHARACTERISTIC
/begin CHARACTERISTIC CDTUFMV "Codewort Tester: Funktions¸berwachung: Momentenvergleich" VALUE 0xFD11C4 KwUw 65535.00 dez 0.00 65535.00 FORMAT "%8.2" /end CHARACTERISTIC
/begin CHARACTERISTIC CDTUFNC "Codewort Tester: Fkt¸berwachung: Drehzahlgeber-, Zuleitung- oder SG-Fehler" VALUE 0xFD11C6 KwUw 65535.00 dez 0.00 65535.00 FORMAT "%8.2" /end CHARACTERISTIC
/begin CHARACTERISTIC CDTUFRLIP "Codewort Tester: Fkt¸berwachung: Lastsensor-, Zuleitung- oder SG-Fehler" VALUE 0xFD11C8 KwUw 65535.00 dez 0.00 65535.00 FORMAT "%8.2" /end CHARACTERISTIC
/begin CHARACTERISTIC CDTUFSGA "Codewort Tester: Funktions¸berwachung: Steuerger‰te-Fehler Gruppe a" VALUE 0xFD11CA KwUw 65535.00 dez 0.00 65535.00 FORMAT "%8.2" /end CHARACTERISTIC
/begin CHARACTERISTIC CDTUFSGB "Codewort Tester: Funktions¸berwachung: Steuerger‰te-Fehler Gruppe b" VALUE 0xFD11CC KwUw 65535.00 dez 0.00 65535.00 FORMAT "%8.2" /end CHARACTERISTIC
/begin CHARACTERISTIC CDTUFSGC "Codewort Tester: Funktions¸berwachung: Steuerger‰te-Fehler Gruppe c" VALUE 0xFD11CE KwUw 65535.00 dez 0.00 65535.00 FORMAT "%8.2" /end CHARACTERISTIC
/begin CHARACTERISTIC CDTUFSPSC "Codewort Tester: Fkt¸berwachung: Pedalwertgeber-, Zuleitung- oder SG-Fehler" VALUE 0xFD11D0 KwUw 65535.00 dez 0.00 65535.00 FORMAT "%8.2" /end CHARACTERISTIC
/begin CHARACTERISTIC CDTURRAM "Codewort Tester: Rechner¸berwachung: RAM" VALUE 0xFD11D2 KwUw 65535.00 dez 0.00 65535.00 FORMAT "%8.2" /end CHARACTERISTIC
/begin CHARACTERISTIC CDTURROM "Codewort Tester: Rechner¸berwachung: ROM" VALUE 0xFD11D4 KwUw 65535.00 dez 0.00 65535.00 FORMAT "%8.2" /end CHARACTERISTIC
/begin CHARACTERISTIC CDTURRST "Codewort Tester: Rechner¸berwachung: Reset" VALUE 0xFD11D6 KwUw 65535.00 dez 0.00 65535.00 FORMAT "%8.2" /end CHARACTERISTIC
/begin CHARACTERISTIC CDTVFZ "Codewort Tester: Fahrzeug-Geschwindigkeit" VALUE 0xFD11D8 KwUw 65535.00 dez 0.00 65535.00 FORMAT "%8.2" /end CHARACTERISTIC
/begin CHARACTERISTIC CDTWCA "Codewort Tester: Wegfahrsperre Wechselcode-Ablage" VALUE 0xFD11DA KwUw 65535.00 dez 0.00 65535.00 FORMAT "%8.2" /end CHARACTERISTIC
/begin CHARACTERISTIC CDTWFS "Codewort Tester: Wegfahrsperre" VALUE 0xFD11DC KwUw 65535.00 dez 0.00 65535.00 FORMAT "%8.2" /end CHARACTERISTIC
/begin CHARACTERISTIC CLABREMS "Fehlerklasse: BREMS (Bremsschalter)" VALUE 0xFD06A7 KwUb 255.0 dez 0.00 255.0 FORMAT "%5.1" /end CHARACTERISTIC
/begin CHARACTERISTIC CLABWF "Fehlerklasse:  PWG Bewegung" VALUE 0xFD06A8 KwUb 255.0 dez 0.00 255.0 FORMAT "%5.1" /end CHARACTERISTIC
/begin CHARACTERISTIC CLADGEN "Verwaltungsklasse Entprelldaten Generator" VALUE 0xFD06B0 KwWU8 255.0 dez 0.00 255.0 FORMAT "%5.1" /end CHARACTERISTIC
/begin CHARACTERISTIC CLADGENBS "Verwaltungsklasse Entprelldaten Kommunikation" VALUE 0xFD06B1 KwWU8 255.0 dez 0.00 255.0 FORMAT "%5.1" /end CHARACTERISTIC
/begin CHARACTERISTIC CLADSU "Fehlerklasse: Umgebungsdrucksensor" VALUE 0xFD06B9 KwUb 255.0 dez 0.00 255.0 FORMAT "%5.1" /end CHARACTERISTIC
/begin CHARACTERISTIC CLADWA "Fehlerklasse: Diebstahlwarnanlage" VALUE 0xFD06C5 KwUb 255.0 dez 0.00 255.0 FORMAT "%5.1" /end CHARACTERISTIC
/begin CHARACTERISTIC CLADZKU0 "Fehlerklasse: Z¸ndspule 0" VALUE 0xFD06C6 KwWU8 255.0 dez 0.00 255.0 FORMAT "%5.1" /end CHARACTERISTIC
/begin CHARACTERISTIC CLADZKU1 "Fehlerklasse: Z¸ndspule 1" VALUE 0xFD06C7 KwWU8 255.0 dez 0.00 255.0 FORMAT "%5.1" /end CHARACTERISTIC
/begin CHARACTERISTIC CLADZKU2 "Fehlerklasse: Z¸ndspule 2" VALUE 0xFD06C8 KwWU8 255.0 dez 0.00 255.0 FORMAT "%5.1" /end CHARACTERISTIC
/begin CHARACTERISTIC CLADZKU3 "Fehlerklasse: Z¸ndspule 3" VALUE 0xFD06C9 KwWU8 255.0 dez 0.00 255.0 FORMAT "%5.1" /end CHARACTERISTIC
/begin CHARACTERISTIC CLADZKU4 "Fehlerklasse: Z¸ndspule 4" VALUE 0xFD06CA KwWU8 255.0 dez 0.00 255.0 FORMAT "%5.1" /end CHARACTERISTIC
/begin CHARACTERISTIC CLADZKU5 "Fehlerklasse: Z¸ndspule 5" VALUE 0xFD06CB KwWU8 255.0 dez 0.00 255.0 FORMAT "%5.1" /end CHARACTERISTIC
/begin CHARACTERISTIC CLADZKU6 "Fehlerklasse: Z¸ndspule 6" VALUE 0xFD06CC KwWU8 255.0 dez 0.00 255.0 FORMAT "%5.1" /end CHARACTERISTIC
/begin CHARACTERISTIC CLADZKU7 "Fehlerklasse: Z¸ndspule 7" VALUE 0xFD06CD KwWU8 255.0 dez 0.00 255.0 FORMAT "%5.1" /end CHARACTERISTIC
/begin CHARACTERISTIC CLAEGFE "Fehlerklasse: Lasterfassung" VALUE 0xFD06CE KwUb 255.0 dez 0.00 255.0 FORMAT "%5.1" /end CHARACTERISTIC
/begin CHARACTERISTIC CLAFP1P "Fehlerklasse: Poti 1, Fahrpedal" VALUE 0xFD06DC KwUb 255.0 dez 0.00 255.0 FORMAT "%5.1" /end CHARACTERISTIC
/begin CHARACTERISTIC CLAFP2P "Fehlerklasse: Poti 2, Fahrpedal" VALUE 0xFD06DD KwUb 255.0 dez 0.00 255.0 FORMAT "%5.1" /end CHARACTERISTIC
/begin CHARACTERISTIC CLAFPP "Fehlerklasse: Poti Fahrpedal" VALUE 0xFD06DE KwUb 255.0 dez 0.00 255.0 FORMAT "%5.1" /end CHARACTERISTIC
/begin CHARACTERISTIC CLAMDB "Fehlerklasse: Momentbgrenzung Sollmoment" VALUE 0xFD0710 KwUb 255.0 dez 0.00 255.0 FORMAT "%5.1" /end CHARACTERISTIC
/begin CHARACTERISTIC CLAMFL "Fehlerklasse: Multifunktionslenkrad" VALUE 0xFD0712 KwWU8 255.0 dez 0.00 255.0 FORMAT "%5.1" /end CHARACTERISTIC
/begin CHARACTERISTIC CLATA "Fehlerklasse: Ansauglufttemperatur TANS (/Ladeluft-)" VALUE 0xFD0726 KwUb 255.0 dez 0.00 255.0 FORMAT "%5.1" /end CHARACTERISTIC
/begin CHARACTERISTIC CLATKA "Fehlerklasse: Temperatur K¸hlerausgang" VALUE 0xFD072A KwUb 255.0 dez 0.00 255.0 FORMAT "%5.1" /end CHARACTERISTIC
/begin CHARACTERISTIC CLATM "Fehlerklasse: Motortemperatur TMOT" VALUE 0xFD072B KwUb 255.0 dez 0.00 255.0 FORMAT "%5.1" /end CHARACTERISTIC
/begin CHARACTERISTIC CLATUM "Fehlerklasse: Umgebungstemperatur TUM" VALUE 0xFD072D KwUb 255.0 dez 0.00 255.0 FORMAT "%5.1" /end CHARACTERISTIC
/begin CHARACTERISTIC CLAUB "Fehlerklasse: Batteriespannung UB (Bordnetz)" VALUE 0xFD072E KwWU8 255.0 dez 0.00 255.0 FORMAT "%5.1" /end CHARACTERISTIC
/begin CHARACTERISTIC CLAUBR "Fehlerklasse: UBR Bordnetzspannung ¸ber Hauptrelais" VALUE 0xFD072F KwUb 255.0 dez 0.00 255.0 FORMAT "%5.1" /end CHARACTERISTIC
/begin CHARACTERISTIC CLAUFMV "Fehlerklasse: Funktions¸berwachung: Momentenvergleich" VALUE 0xFD0730 KwUb 255.0 dez 0.00 255.0 FORMAT "%5.1" /end CHARACTERISTIC
/begin CHARACTERISTIC CLAUFNC "Fehlerklasse: Funktions¸berwachung: Drehzahlgeber-, Zuleitung- oder SG-Fehler" VALUE 0xFD0731 KwUb 255.0 dez 0.00 255.0 FORMAT "%5.1" /end CHARACTERISTIC
/begin CHARACTERISTIC CLAUFRLIP "Fehlerklasse: Funktions¸berwachung: Lastsensor-, Zuleitung- oder SG-Fehler" VALUE 0xFD0732 KwUb 255.0 dez 0.00 255.0 FORMAT "%5.1" /end CHARACTERISTIC
/begin CHARACTERISTIC CLAUFSGA "Fehlerklasse: Funktions¸berwachung: Steuerger‰te-Fehler Gruppe a" VALUE 0xFD0733 KwUb 255.0 dez 0.00 255.0 FORMAT "%5.1" /end CHARACTERISTIC
/begin CHARACTERISTIC CLAUFSGB "Fehlerklasse: Funktions¸berwachung: Steuerger‰te-Fehler Gruppe b" VALUE 0xFD0734 KwUb 255.0 dez 0.00 255.0 FORMAT "%5.1" /end CHARACTERISTIC
/begin CHARACTERISTIC CLAUFSGC "Fehlerklasse: Funktions¸berwachung: Steuerger‰te-Fehler Gruppe c" VALUE 0xFD0735 KwUb 255.0 dez 0.00 255.0 FORMAT "%5.1" /end CHARACTERISTIC
/begin CHARACTERISTIC CLAUFSPSC "Fehlerklasse: Funktions¸berwachung: Pedalwertgeber-, Zuleitung- oder SG-Fehler" VALUE 0xFD0736 KwUb 255.0 dez 0.00 255.0 FORMAT "%5.1" /end CHARACTERISTIC
/begin CHARACTERISTIC CLAURRAM "Fehlerklasse: Rechner¸berwachung: RAM" VALUE 0xFD0737 KwUb 255.0 dez 0.00 255.0 FORMAT "%5.1" /end CHARACTERISTIC
/begin CHARACTERISTIC CLAURROM "Fehlerklasse: Rechner¸berwachung: ROM" VALUE 0xFD0738 KwUb 255.0 dez 0.00 255.0 FORMAT "%5.1" /end CHARACTERISTIC
/begin CHARACTERISTIC CLAURRST "Fehlerklasse: Rechner¸berwachung: Reset" VALUE 0xFD0739 KwUb 255.0 dez 0.00 255.0 FORMAT "%5.1" /end CHARACTERISTIC
/begin CHARACTERISTIC CLAVFZ "Fehlerklasse: Geschwindigkeitssignal" VALUE 0xFD073A KwUb 255.0 dez 0.00 255.0 FORMAT "%5.1" /end CHARACTERISTIC
/begin CHARACTERISTIC CLAWCA "Fehlerklasse: Wegfahrsperre Wechselcode- Ablage" VALUE 0xFD073B KwUb 255.0 dez 0.00 255.0 FORMAT "%5.1" /end CHARACTERISTIC
/begin CHARACTERISTIC CLAWFS "Fehlerklasse: Wegfahrsperre" VALUE 0xFD073C KwUb 255.0 dez 0.00 255.0 FORMAT "%5.1" /end CHARACTERISTIC
/begin CHARACTERISTIC DELTA_U_O "Hersteller-garantierter mechanischer Verstellweg" VALUE 0xFCD00A KwUw 319.9951 spg_uw_b5 0.00 319.9951 FORMAT "%8.4" /end CHARACTERISTIC
/begin CHARACTERISTIC DELTA_U_OS "" VALUE 0xFCD00C KwUw 319.9951 spg_uw_b5 0.00 319.9951 FORMAT "%8.4" /end CHARACTERISTIC
/begin CHARACTERISTIC DISAERSATZ "Ersatzsollwert" VALUE 0xFCCEDC KwUb 99.61 PCENT 0.00 99.61 FORMAT "%5.2" /end CHARACTERISTIC
/begin CHARACTERISTIC DISAIMN "Min. Grenzwert f¸r I-Regleranteil" VALUE 0xFCD00E KwUw 199.997 vnstv_q0p00305s32768 -100.000 99.9969 /end CHARACTERISTIC
/begin CHARACTERISTIC DISAIMX "Max. Grenzwert f¸r I-Regleranteil" VALUE 0xFCD010 KwUw 199.997 vnstv_q0p00305s32768 -100.000 99.9969 /end CHARACTERISTIC
/begin CHARACTERISTIC DISALMN "Grenzwert f¸r Erfolg von erstem Lernschritt" VALUE 0xFCD012 KwUw 319.9951 spg_uw_b5 0.00 319.9951 FORMAT "%8.4" /end CHARACTERISTIC
/begin CHARACTERISTIC DISAMN "Min. Grenzwert f¸r P-Regleranteil" VALUE 0xFCD014 KwSw 199.997 vnstv_q0p00305 -100.000 99.9969 FORMAT "%7.3" /end CHARACTERISTIC
/begin CHARACTERISTIC DISAMX "Max. Grenzwert f¸r P-Regleranteil" VALUE 0xFCD016 KwSw 199.997 vnstv_q0p00305 -100.000 99.9969 FORMAT "%7.3" /end CHARACTERISTIC
/begin CHARACTERISTIC DISA_BEGR "Dynamikbegrenzung" VALUE 0xFCD018 KwUw 199.997 vnstv_q0p00305 0.00 199.997 FORMAT "%7.3" /end CHARACTERISTIC
/begin CHARACTERISTIC DISA_KL_I "Kennlinie f¸r Regler, I-Anteil" CURVE 0xFC21DA KlAUwSstUwWUw 199.997 vnstv_q0p00305s32768 -100.000 99.9969
 /begin AXIS_DESCR STD_AXIS D_disa_kl vnstv_q0p00305s32768 16 -100.000 99.9969 DEPOSIT ABSOLUTE /end AXIS_DESCR
/end CHARACTERISTIC
/begin CHARACTERISTIC DISA_KL_P "Kennlinie f¸r Regler, P-Anteil" CURVE 0xFC221C KlAUwSstUwWUw 199.997 vnstv_q0p00305s32768 -100.000 99.9969
 /begin AXIS_DESCR STD_AXIS D_disa_kl vnstv_q0p00305s32768 16 -100.000 99.9969 DEPOSIT ABSOLUTE /end AXIS_DESCR
/end CHARACTERISTIC
/begin CHARACTERISTIC DISA_RAMP "Steigung der Rampe f¸r Lernen UMA" VALUE 0xFCD01A KwUw 319.9951 spg_uw_b5 0.00 319.9951 FORMAT "%8.4" /end CHARACTERISTIC
/begin CHARACTERISTIC DISA_SAVE "Sicherheitsabstand von OMA bzw. UMA im geregelten Betrieb" VALUE 0xFCD01C KwUw 199.997 vnstv_q0p00305 0.00 199.997 FORMAT "%7.3" /end CHARACTERISTIC
/begin CHARACTERISTIC DISA_TOT "Totzone Disa-Regler" VALUE 0xFCD01E KwUw 199.997 vnstv_q0p00305 0.00 199.997 FORMAT "%7.3" /end CHARACTERISTIC
/begin CHARACTERISTIC DISA_U "Initialisierungswert f¸r Disa_Uma / unterer Anschlag" VALUE 0xFCD020 KwUw 319.9951 spg_uw_b5 0.00 319.9951 FORMAT "%8.4" /end CHARACTERISTIC
/begin CHARACTERISTIC DISA_UMN "Minimalwert f¸r Disa_Uma / unterer Anschlag" VALUE 0xFCD022 KwUw 319.9951 spg_uw_b5 0.00 319.9951 FORMAT "%8.4" /end CHARACTERISTIC
/begin CHARACTERISTIC DITVAUS "Tastverh‰ltnisvorgabe f¸r DISA-Ansteuerung Ausschalten" CURVE 0xFCD024 KlAUbSstUbWUw 655.3500 di_uw_q0p01 0.00 655.3500 FORMAT "%8.4"
 /begin AXIS_DESCR STD_AXIS Di_cnt di_uw_q0p01 6 0.00 2.550 FORMAT "%5.3" DEPOSIT ABSOLUTE /end AXIS_DESCR
/end CHARACTERISTIC
/begin CHARACTERISTIC DITVEIN "Tastverh‰ltnisvorgabe f¸r DISA-Ansteuerung Einschalten" CURVE 0xFCD038 KlAUbSstUbWUw 655.3500 di_uw_q0p01 0.00 655.3500 FORMAT "%8.4"
 /begin AXIS_DESCR STD_AXIS Di_cnt di_uw_q0p01 6 0.00 2.550 FORMAT "%5.3" DEPOSIT ABSOLUTE /end AXIS_DESCR
/end CHARACTERISTIC
/begin CHARACTERISTIC Di_dir "Umschalten der DISA Schaltrichtung" VALUE 0xFCCEDD KwUb 255.0 dez 0.00 255.0 FORMAT "%5.1" /end CHARACTERISTIC
/begin CHARACTERISTIC DI_ENDE "Ende Schaltvorgang" VALUE 0xFCCEDE KwUb 2.550 di_uw_q0p01 0.00 2.550 FORMAT "%5.3" /end CHARACTERISTIC
/begin CHARACTERISTIC DI_HYST "Disa Hysterese_Schwelle" VALUE 0xFCCEDF KwUb 49.61 PCENT 50.00 99.61 FORMAT "%5.2" /end CHARACTERISTIC
/begin CHARACTERISTIC DI_LSTART "Sollwert f¸r ersten Lernschritt" VALUE 0xFCD04C KwUw 319.9951 spg_uw_b5 0.00 319.9951 FORMAT "%8.4" /end CHARACTERISTIC
/begin CHARACTERISTIC DI_SCHALT "DISA im Schalt- bzw. Regelmodus" VALUE 0xFCCEE0 KwUb 255.0 dez 0.00 255.0 FORMAT "%5.1" /end CHARACTERISTIC
/begin CHARACTERISTIC DI_SMIN "Minimaler Sollwert, unterhalb dem noch gelernt werden darf" VALUE 0xFCCEE1 KwUb 99.61 PCENT 0.00 99.61 FORMAT "%5.2" /end CHARACTERISTIC
/begin CHARACTERISTIC DI_STDELTA "Tolerierte Verstellung zwischen Abstellen und n‰chstem Start" VALUE 0xFCD04E KwUw 319.9951 spg_uw_b5 0.00 319.9951 FORMAT "%8.4" /end CHARACTERISTIC
/begin CHARACTERISTIC DI_T1 "Startwert f¸r Timer 1: Zeitdauer bis 1. Lernschritt fertig" VALUE 0xFCD050 KwUw 655.3500 t10msxs_uw_b655p35 0.00 655.3500 FORMAT "%8.4" /end CHARACTERISTIC
/begin CHARACTERISTIC DI_T2 "Startwert f¸r Timer 2: Zeitdauer bis Abbruch von 2. Lernschritt" VALUE 0xFCD052 KwUw 655.3500 t10msxs_uw_b655p35 0.00 655.3500 FORMAT "%8.4" /end CHARACTERISTIC
/begin CHARACTERISTIC DI_TANS_MN "Untere Grenze Ansaugtemp." VALUE 0xFCCEE2 KwUb 191.3 temp_ub_q0p75_o48 -48.00 143.3 FORMAT "%5.1" /end CHARACTERISTIC
/begin CHARACTERISTIC DI_TANS_MX "Obere Grenze Ansaugtemp." VALUE 0xFCCEE3 KwUb 191.3 temp_ub_q0p75_o48 -48.00 143.3 FORMAT "%5.1" /end CHARACTERISTIC
/begin CHARACTERISTIC DI_UB_MN "Minimale Batteriespannung" VALUE 0xFCCEE4 KwUb 24.02 spg_ubatt 0.00 24.02 FORMAT "%5.2" /end CHARACTERISTIC
/begin CHARACTERISTIC DI_UMAMN "" VALUE 0xFCD054 KwUw 199.997 vnstv_q0p00305 0.00 199.997 FORMAT "%7.3" /end CHARACTERISTIC
/begin CHARACTERISTIC EBEN "Bypass-Hauptschalter" VALUE 0xFC1182 KwWU8 1.000 dez 0.00 1.000 FORMAT "%5.3" /end CHARACTERISTIC
/begin CHARACTERISTIC EBMISS_T "" VALUE 0xFC117E KwWU16 65535.00 dez 0.00 65535.00 FORMAT "%8.2" /end CHARACTERISTIC
/begin CHARACTERISTIC EBMISS_Y "" VALUE 0xFC1180 KwWU16 65535.00 dez 0.00 65535.00 FORMAT "%8.2" /end CHARACTERISTIC
/begin CHARACTERISTIC FFTBREMS "Freeze Frame Tabelle: Pedalwertgeber Bremse" VAL_BLK 0xFD0764 KwbUb 255.0 dez 0.00 255.0 FORMAT "%5.1" NUMBER 4 /end CHARACTERISTIC
/begin CHARACTERISTIC FFTBWF "Freeze Frame Tabelle: PWG Bewegung" VAL_BLK 0xFD0768 KwbUb 255.0 dez 0.00 255.0 FORMAT "%5.1" NUMBER 4 /end CHARACTERISTIC
/begin CHARACTERISTIC FFTDGEN "Freeze Frame Table Generator" VAL_BLK 0xFD0788 KwbWU8 255.0 dez 0.00 255.0 FORMAT "%5.1" NUMBER 4 /end CHARACTERISTIC
/begin CHARACTERISTIC FFTDGENBS "Freeze Frame Table Kommunikation" VAL_BLK 0xFD078C KwbWU8 255.0 dez 0.00 255.0 FORMAT "%5.1" NUMBER 4 /end CHARACTERISTIC
/begin CHARACTERISTIC FFTDSU "Freeze Frame Tabelle: Umgebungsdrucksensor" VAL_BLK 0xFD07AC KwbUb 255.0 dez 0.00 255.0 FORMAT "%5.1" NUMBER 4 /end CHARACTERISTIC
/begin CHARACTERISTIC FFTDWA "Freeze Frame Tabelle: Diebstahlwarnanlage" VAL_BLK 0xFD07DC KwbUb 255.0 dez 0.00 255.0 FORMAT "%5.1" NUMBER 4 /end CHARACTERISTIC
/begin CHARACTERISTIC FFTDZKU0 "Freeze Frame Tabelle: Z¸ndspule 0" VAL_BLK 0xFD07E0 KwbWU8 255.0 dez 0.00 255.0 FORMAT "%5.1" NUMBER 4 /end CHARACTERISTIC
/begin CHARACTERISTIC FFTDZKU1 "Freeze Frame Tabelle: Z¸ndspule 1" VAL_BLK 0xFD07E4 KwbWU8 255.0 dez 0.00 255.0 FORMAT "%5.1" NUMBER 4 /end CHARACTERISTIC
/begin CHARACTERISTIC FFTDZKU2 "Freeze Frame Tabelle: Z¸ndspule 2" VAL_BLK 0xFD07E8 KwbWU8 255.0 dez 0.00 255.0 FORMAT "%5.1" NUMBER 4 /end CHARACTERISTIC
/begin CHARACTERISTIC FFTDZKU3 "Freeze Frame Tabelle: Z¸ndspule 3" VAL_BLK 0xFD07EC KwbWU8 255.0 dez 0.00 255.0 FORMAT "%5.1" NUMBER 4 /end CHARACTERISTIC
/begin CHARACTERISTIC FFTDZKU4 "Freeze Frame Tabelle: Z¸ndspule 4" VAL_BLK 0xFD07F0 KwbWU8 255.0 dez 0.00 255.0 FORMAT "%5.1" NUMBER 4 /end CHARACTERISTIC
/begin CHARACTERISTIC FFTDZKU5 "Freeze Frame Tabelle: Z¸ndspule 5" VAL_BLK 0xFD07F4 KwbWU8 255.0 dez 0.00 255.0 FORMAT "%5.1" NUMBER 4 /end CHARACTERISTIC
/begin CHARACTERISTIC FFTDZKU6 "Freeze Frame Tabelle: Z¸ndspule 6" VAL_BLK 0xFD07F8 KwbWU8 255.0 dez 0.00 255.0 FORMAT "%5.1" NUMBER 4 /end CHARACTERISTIC
/begin CHARACTERISTIC FFTDZKU7 "Freeze Frame Tabelle: Z¸ndspule 7" VAL_BLK 0xFD07FC KwbWU8 255.0 dez 0.00 255.0 FORMAT "%5.1" NUMBER 4 /end CHARACTERISTIC
/begin CHARACTERISTIC FFTEGFE "Freeze Frame Tabelle: Lasterfassung" VAL_BLK 0xFD0800 KwbUb 255.0 dez 0.00 255.0 FORMAT "%5.1" NUMBER 4 /end CHARACTERISTIC
/begin CHARACTERISTIC FFTFP1P "Freeze Frame Tabelle: Poti 1, Fahrpedal" VAL_BLK 0xFD0838 KwbUb 255.0 dez 0.00 255.0 FORMAT "%5.1" NUMBER 4 /end CHARACTERISTIC
/begin CHARACTERISTIC FFTFP2P "Freeze Frame Tabelle: Poti 2, Fahrpedal" VAL_BLK 0xFD083C KwbUb 255.0 dez 0.00 255.0 FORMAT "%5.1" NUMBER 4 /end CHARACTERISTIC
/begin CHARACTERISTIC FFTFPP "Freeze Frame Tabelle: Poti Fahrpedal" VAL_BLK 0xFD0840 KwbUb 255.0 dez 0.00 255.0 FORMAT "%5.1" NUMBER 4 /end CHARACTERISTIC
/begin CHARACTERISTIC FFTMDB "Freeze Frame Tabelle: Momentbegrenzung Sollmoment" VAL_BLK 0xFD0908 KwbUb 255.0 dez 0.00 255.0 FORMAT "%5.1" NUMBER 4 /end CHARACTERISTIC
/begin CHARACTERISTIC FFTMFL "Freeze Frame Tabelle: Multifunktionslenkrad" VAL_BLK 0xFD0910 KwbWU8 255.0 dez 0.00 255.0 FORMAT "%5.1" NUMBER 4 /end CHARACTERISTIC
/begin CHARACTERISTIC FFTTA "Freeze Frame Tabelle: Ansauglufttemperatur TANS (/Ladeluft-)" VAL_BLK 0xFD0960 KwbUb 255.0 dez 0.00 255.0 FORMAT "%5.1" NUMBER 4 /end CHARACTERISTIC
/begin CHARACTERISTIC FFTTKA "Freeze Frame Tabelle: Temperatur K¸hlerausgang" VAL_BLK 0xFD0970 KwbUb 255.0 dez 0.00 255.0 FORMAT "%5.1" NUMBER 4 /end CHARACTERISTIC
/begin CHARACTERISTIC FFTTM "Freeze Frame Tabelle: Motortemperatur TMOT" VAL_BLK 0xFD0974 KwbUb 255.0 dez 0.00 255.0 FORMAT "%5.1" NUMBER 4 /end CHARACTERISTIC
/begin CHARACTERISTIC FFTTUM "Freeze Frame Tabelle: Umgebungstemperatur TUM" VAL_BLK 0xFD097C KwbUb 255.0 dez 0.00 255.0 FORMAT "%5.1" NUMBER 4 /end CHARACTERISTIC
/begin CHARACTERISTIC FFTUB "Freeze Frame Tabelle: Batteriespannung UB (Bordnetz)" VAL_BLK 0xFD0980 KwbWU8 255.0 dez 0.00 255.0 FORMAT "%5.1" NUMBER 4 /end CHARACTERISTIC
/begin CHARACTERISTIC FFTUBR "Freeze Frame Tabelle: Bordnetzspannung ¸ber Hauptrelais UBR" VAL_BLK 0xFD0984 KwbUb 255.0 dez 0.00 255.0 FORMAT "%5.1" NUMBER 4 /end CHARACTERISTIC
/begin CHARACTERISTIC FFTUFMV "Freeze Frame Tabelle: Funktions¸berwachung: Momentenvergleich" VAL_BLK 0xFD0988 KwbUb 255.0 dez 0.00 255.0 FORMAT "%5.1" NUMBER 4 /end CHARACTERISTIC
/begin CHARACTERISTIC FFTUFNC "Freeze Frame Tabelle: Fkt¸berwachung: Drehzahlgeber-, Zuleitung- oder SG-Fehler" VAL_BLK 0xFD098C KwbUb 255.0 dez 0.00 255.0 FORMAT "%5.1" NUMBER 4 /end CHARACTERISTIC
/begin CHARACTERISTIC FFTUFRLIP "Freeze Frame Tabelle: Fkt¸berwachung: Lastsensor-, Zuleitung- oder SG-Fehler" VAL_BLK 0xFD0990 KwbUb 255.0 dez 0.00 255.0 FORMAT "%5.1" NUMBER 4 /end CHARACTERISTIC
/begin CHARACTERISTIC FFTUFSGA "Freeze Frame Tabelle: Funktions¸berwachung: Steuerger‰te-Fehler Gruppe a" VAL_BLK 0xFD0994 KwbUb 255.0 dez 0.00 255.0 FORMAT "%5.1" NUMBER 4 /end CHARACTERISTIC
/begin CHARACTERISTIC FFTUFSGB "Freeze Frame Tabelle: Funktions¸berwachung: Steuerger‰te-Fehler Gruppe b" VAL_BLK 0xFD0998 KwbUb 255.0 dez 0.00 255.0 FORMAT "%5.1" NUMBER 4 /end CHARACTERISTIC
/begin CHARACTERISTIC FFTUFSGC "Freeze Frame Tabelle: Funktions¸berwachung: Steuerger‰te-Fehler Gruppe c" VAL_BLK 0xFD099C KwbUb 255.0 dez 0.00 255.0 FORMAT "%5.1" NUMBER 4 /end CHARACTERISTIC
/begin CHARACTERISTIC FFTUFSPSC "Freeze Frame Tabelle: Fkt¸berwachung: Pedalwertgeber-, Zuleitung- oder SG-Fehler" VAL_BLK 0xFD09A0 KwbUb 255.0 dez 0.00 255.0 FORMAT "%5.1" NUMBER 4 /end CHARACTERISTIC
/begin CHARACTERISTIC FFTURRAM "Freeze Frame Tabelle: Rechner¸berwachung: RAM" VAL_BLK 0xFD09A4 KwbUb 255.0 dez 0.00 255.0 FORMAT "%5.1" NUMBER 4 /end CHARACTERISTIC
/begin CHARACTERISTIC FFTURROM "Freeze Frame Tabelle: Rechner¸berwachung: ROM" VAL_BLK 0xFD09A8 KwbUb 255.0 dez 0.00 255.0 FORMAT "%5.1" NUMBER 4 /end CHARACTERISTIC
/begin CHARACTERISTIC FFTURRST "Freeze Frame Tabelle: Rechner¸berwachung: Reset" VAL_BLK 0xFD09AC KwbUb 255.0 dez 0.00 255.0 FORMAT "%5.1" NUMBER 4 /end CHARACTERISTIC
/begin CHARACTERISTIC FFTVFZ "Freeze Frame Tabelle: Geschwindigkeitssignal" VAL_BLK 0xFD09B0 KwbUb 255.0 dez 0.00 255.0 FORMAT "%5.1" NUMBER 4 /end CHARACTERISTIC
/begin CHARACTERISTIC FFTWCA "Freeze Frame Tabelle: Wegfahrsperre Wechselcode- Ablage" VAL_BLK 0xFD09B4 KwbUb 255.0 dez 0.00 255.0 FORMAT "%5.1" NUMBER 4 /end CHARACTERISTIC
/begin CHARACTERISTIC FFTWFS "Freeze Frame Tabelle: Wegfahrsperre" VAL_BLK 0xFD09B8 KwbUb 255.0 dez 0.00 255.0 FORMAT "%5.1" NUMBER 4 /end CHARACTERISTIC
/begin CHARACTERISTIC FRINH1 "Multiplikativer Faktor f¸r RIN Sollwert hinter Kat" CURVE 0xFCCB94 KlAUbSstUbWUb 63.75 fak_ub_b64 0.00 63.75 FORMAT "%5.2"
 /begin AXIS_DESCR STD_AXIS tkatmf temp_ub_q5_o50 5 -50.00 1225. FORMAT "%5.0" DEPOSIT ABSOLUTE /end AXIS_DESCR
/end CHARACTERISTIC
/begin CHARACTERISTIC FRINV1 "Multiplikativer Faktor f¸r RIN Sollwert vor Kat" CURVE 0xFCCBA0 KlAUbSstUbWUb 63.75 fak_ub_b64 0.00 63.75 FORMAT "%5.2"
 /begin AXIS_DESCR STD_AXIS tabgmf temp_ub_q5_o50 5 -50.00 1225. FORMAT "%5.0" DEPOSIT ABSOLUTE /end AXIS_DESCR
/end CHARACTERISTIC
/begin CHARACTERISTIC FWMLHFMMN "Wichtungsfaktor f¸r minimale HFM-Luftmassen Schwelle in Abh‰ngigkeit von d.Hˆhe" CURVE 0xFCD4A0 KlAUwSstUwWUw 0.9999847 fak_uw_b1 0.00 0.9999847 FORMAT "%9.7"
 /begin AXIS_DESCR STD_AXIS fho_w fak_uw_b4 2 0.00 3.999939 FORMAT "%8.6" DEPOSIT ABSOLUTE /end AXIS_DESCR
/end CHARACTERISTIC
/begin CHARACTERISTIC GENPDTIME "Predrivetime f¸r Ladekontrollampe KL61" VALUE 0xFC8470 KwWU8 25.50 t100msxs_ub_b25p5 0.00 25.50 FORMAT "%5.2" /end CHARACTERISTIC
/begin CHARACTERISTIC GEN_DNMIN "Motordrehzahlschwelle  f¸r Auswertung der Generatordiagnose" VALUE 0xFC846C KwWU16 16383.75 nmot_uw_q0p25 0.00 16383.75 FORMAT "%8.2" /end CHARACTERISTIC
/begin CHARACTERISTIC GFBSUTERR "Entprellzeit Fehlereintrag Kommunikation unplausibel" VALUE 0xFC8471 KwWU8 25.50 t100msxs_ub_b25p5 0.00 25.50 FORMAT "%5.2" /end CHARACTERISTIC
/begin CHARACTERISTIC GFBSUTHEAL "Entprellzeit Fehlerheilung Kommunikation unplausibel" VALUE 0xFC8472 KwWU8 25.50 t100msxs_ub_b25p5 0.00 25.50 FORMAT "%5.2" /end CHARACTERISTIC
/begin CHARACTERISTIC GFELTERR "Entprellzeit Fehlereintrag elekt. Fehler" VALUE 0xFC8473 KwWU8 25.50 t100msxs_ub_b25p5 0.00 25.50 FORMAT "%5.2" /end CHARACTERISTIC
/begin CHARACTERISTIC GFELTHEAL "Entprellzeit Fehlerheilung elekt. Fehler" VALUE 0xFC8474 KwWU8 25.50 t100msxs_ub_b25p5 0.00 25.50 FORMAT "%5.2" /end CHARACTERISTIC
/begin CHARACTERISTIC GFHTTERR "Entprellzeit Fehlereintrag Ueberhitzung" VALUE 0xFC8475 KwWU8 25.50 t100msxs_ub_b25p5 0.00 25.50 FORMAT "%5.2" /end CHARACTERISTIC
/begin CHARACTERISTIC GFHTTHEAL "Entprellzeit Fehlerheilung Ueberhitzung" VALUE 0xFC8476 KwWU8 25.50 t100msxs_ub_b25p5 0.00 25.50 FORMAT "%5.2" /end CHARACTERISTIC
/begin CHARACTERISTIC GFMETERR "Entprellzeit Fehlereintrag mechanischer Fehler" VALUE 0xFC8477 KwWU8 25.50 t100msxs_ub_b25p5 0.00 25.50 FORMAT "%5.2" /end CHARACTERISTIC
/begin CHARACTERISTIC GFMETHEAL "Entprellzeit Fehlerheilung mechanischer Fehler" VALUE 0xFC8478 KwWU8 25.50 t100msxs_ub_b25p5 0.00 25.50 FORMAT "%5.2" /end CHARACTERISTIC
/begin CHARACTERISTIC GFNOBTERR "Entprellzeit Fehlereintrag f. keine Kommunikation" VALUE 0xFC8479 KwWU8 25.50 t100msxs_ub_b25p5 0.00 25.50 FORMAT "%5.2" /end CHARACTERISTIC
/begin CHARACTERISTIC GFNOBTHEAL "Entprellzeit Fehlerheilung f. keine Kommunikation" VALUE 0xFC847A KwWU8 25.50 t100msxs_ub_b25p5 0.00 25.50 FORMAT "%5.2" /end CHARACTERISTIC
/begin CHARACTERISTIC KFMLDMN "ML-Schwelle f¸r B_minflr-Diagnose HFM/HLM" MAP 0xFCD4AA KfAxUwAyUwSstxUwSstyUwWSw 6553.500 m_sw_q0p1 -3276.800 3276.700 FORMAT "%8.3"
 /begin AXIS_DESCR STD_AXIS wdkbadmn_w relDK_q0p02441 8 -800.0000 799.9756 FORMAT "%8.4" DEPOSIT ABSOLUTE /end AXIS_DESCR
 /begin AXIS_DESCR STD_AXIS nmot_w nmot_uw_q0p25 8 0.00 16383.75 FORMAT "%8.2" DEPOSIT ABSOLUTE /end AXIS_DESCR
/end CHARACTERISTIC
/begin CHARACTERISTIC KFMLDMX "ML-Schwelle f¸r B_maxflr-Diagnose HFM/HLM" MAP 0xFCD54E KfAxUwAyUwSstxUwSstyUwWUw 6553.500 m_sw_q0p1 0.00 6553.500 FORMAT "%8.3"
 /begin AXIS_DESCR STD_AXIS wdkbadmx_w relDK_q0p02441 8 -800.0000 799.9756 FORMAT "%8.4" DEPOSIT ABSOLUTE /end AXIS_DESCR
 /begin AXIS_DESCR STD_AXIS nmot_w nmot_uw_q0p25 8 0.00 16383.75 FORMAT "%8.2" DEPOSIT ABSOLUTE /end AXIS_DESCR
/end CHARACTERISTIC
/begin CHARACTERISTIC KFRINH "Kennfeld f¸r Nernst-Innenwiderstand hinter Kat" MAP 0xFCCBAC KfAxUbAyUbSstxUbSstyUbWUb 2040. r_q8 0.00 2040. FORMAT "%5.0"
 /begin AXIS_DESCR STD_AXIS tkatmf temp_ub_q5_o50 5 -50.00 1225. FORMAT "%5.0" DEPOSIT ABSOLUTE /end AXIS_DESCR
 /begin AXIS_DESCR STD_AXIS phlsnhf fak_ub_q0p01 3 0.00 2.550 FORMAT "%5.3" DEPOSIT ABSOLUTE /end AXIS_DESCR
/end CHARACTERISTIC
/begin CHARACTERISTIC KFRINV "Kennfeld f¸r Nernst-Innenwiderstand vor Kat" MAP 0xFCCBCC KfAxUbAyUbSstxUbSstyUbWUb 2040. r_q8 0.00 2040. FORMAT "%5.0"
 /begin AXIS_DESCR STD_AXIS tabgmf temp_ub_q5_o50 5 -50.00 1225. FORMAT "%5.0" DEPOSIT ABSOLUTE /end AXIS_DESCR
 /begin AXIS_DESCR STD_AXIS phlsnvf fak_ub_q0p01 3 0.00 2.550 FORMAT "%5.3" DEPOSIT ABSOLUTE /end AXIS_DESCR
/end CHARACTERISTIC
/begin CHARACTERISTIC KLDISATVUB "Wichtung TV ¸ber Betriebsspannung wegen Powermanagement" CURVE 0xFC21CC KlAUbSstUbWUb 1.992 fak_ub_b2 0.00 1.992 FORMAT "%5.3"
 /begin AXIS_DESCR STD_AXIS ub spg_ubatt 6 0.00 24.02 FORMAT "%5.2" DEPOSIT ABSOLUTE /end AXIS_DESCR
/end CHARACTERISTIC
/begin CHARACTERISTIC MLHFMMN "minimale HFM-Luftmassen Schwelle zum R¸cksetzen des Min-Fehlers" VALUE 0xFCD5F2 KwUw 6553.500 m_q0p1 0.00 6553.500 FORMAT "%8.3" /end CHARACTERISTIC
/begin CHARACTERISTIC MSKGENDFP "Bitmaske Generator Fehler-> DFP" VALUE 0xFC847B KwWU8 255.0 dez 0.00 255.0 FORMAT "%5.1" /end CHARACTERISTIC
/begin CHARACTERISTIC MSKGENKL61 "Bitmaske fuer Generatorfehler -> Ladekontrolle" VALUE 0xFC847C KwWU8 255.0 dez 0.00 255.0 FORMAT "%5.1" /end CHARACTERISTIC
/begin CHARACTERISTIC SDISALERN "Schalter Start Lernvorgang UMA" VALUE 0xFCCEE5 KwUb 255.0 dez 0.00 255.0 FORMAT "%5.1" /end CHARACTERISTIC
/begin CHARACTERISTIC SNMBSDKL61 "" VALUE 0xFC846E KwWU16 16383.75 nmot_uw_q0p25 0.00 16383.75 FORMAT "%8.2" /end CHARACTERISTIC
/begin CHARACTERISTIC SRYAGR "Schwelle f¸r Readiness-Bildung Abgasr¸ckf¸hrungs-Diagnose" VALUE 0xFC1185 KwUb 255.0 dez 0.00 255.0 FORMAT "%5.1" /end CHARACTERISTIC
/begin CHARACTERISTIC SRYHS "Schwelle f¸r Readiness-Bildung Sondenheizungs-Diagnose" VALUE 0xFC1186 KwUb 255.0 dez 0.00 255.0 FORMAT "%5.1" /end CHARACTERISTIC
/begin CHARACTERISTIC SRYKAT "Schwelle f¸r Readiness-Bildung Katalysator-Diagnose" VALUE 0xFC1187 KwUb 255.0 dez 0.00 255.0 FORMAT "%5.1" /end CHARACTERISTIC
/begin CHARACTERISTIC SRYLS "Schwelle f¸r Readiness-Bildung Lambdasonden-Diagnose" VALUE 0xFC1188 KwUb 255.0 dez 0.00 255.0 FORMAT "%5.1" /end CHARACTERISTIC
/begin CHARACTERISTIC SRYSLS "Schwelle f¸r Readiness-Bildung Sekund‰rluft-Diagnose" VALUE 0xFC1189 KwUb 255.0 dez 0.00 255.0 FORMAT "%5.1" /end CHARACTERISTIC
/begin CHARACTERISTIC SRYTES "Schwelle f¸r Readiness-Bildung Tankentl¸ftungs-Diagnose" VALUE 0xFCC94A KwUb 255.0 dez 0.00 255.0 FORMAT "%5.1" /end CHARACTERISTIC
/begin CHARACTERISTIC TADHMN "untere Temperaturschwelle f¸r die Heizerdiagnose" VALUE 0xFC1E72 KwUb 1275. temp_ub_q5_o50 -50.00 1225. FORMAT "%5.0" /end CHARACTERISTIC
/begin CHARACTERISTIC TADHMX "obere Temperaturschwelle f¸r die Heizerdiagnose" VALUE 0xFCCBC5 KwUb 1275. temp_ub_q5_o50 -50.00 1225. FORMAT "%5.0" /end CHARACTERISTIC
/begin CHARACTERISTIC TDMLHFM "Zeitverzˆgerung f¸r das Setzen von B_ehfm" VALUE 0xFC3874 KwUb 2.540 t10msxs_ub_b2p55 0.01000 2.550 FORMAT "%5.3" /end CHARACTERISTIC
/begin CHARACTERISTIC TDMLMN "Entprellzeit HFM-(Hauptlastgeber-)Fehlererkennung Minimalwert" VALUE 0xFCD496 KwUb 25.50 t100msxs_ub_b25p5 0.00 25.50 FORMAT "%5.2" /end CHARACTERISTIC
/begin CHARACTERISTIC TDMLMX "Entprellzeit HFM-(Hauptlastgeber-)Fehlererkennung Maximalwert" VALUE 0xFCD497 KwUb 25.50 t100msxs_ub_b25p5 0.00 25.50 FORMAT "%5.2" /end CHARACTERISTIC
/begin CHARACTERISTIC TDMLNF "Entprellzeit HFM-(Hauptlastgeber-)Diagnose mit i.O.-Meldung" VALUE 0xFCD498 KwUb 25.50 t100msxs_ub_b25p5 0.00 25.50 FORMAT "%5.2" /end CHARACTERISTIC
/begin CHARACTERISTIC TDMLST "Entprellzeit HFM-(Hauptlastgeber-)Fehlererkennung im Start" VALUE 0xFCD499 KwUb 25.50 t100msxs_ub_b25p5 0.00 25.50 FORMAT "%5.2" /end CHARACTERISTIC
/begin CHARACTERISTIC TDUBHFM "Zeit f¸r HFM-Diagnose mit u < UBHFM" VALUE 0xFCD49A KwUb 25.40 t100msxs_ub_b25p5 0.1000 25.50 FORMAT "%5.2" /end CHARACTERISTIC
/begin CHARACTERISTIC TSFBREMS "Fehlersummenzeit: BREMS (Bremsschalter)" VALUE 0xFD09C9 KwUb 255.0 dez 0.00 255.0 FORMAT "%5.1" /end CHARACTERISTIC
/begin CHARACTERISTIC TSFBWF "Fehlersummenzeit: PWG Bewegung" VALUE 0xFD09CA KwUb 255.0 dez 0.00 255.0 FORMAT "%5.1" /end CHARACTERISTIC
/begin CHARACTERISTIC TSFDGEN "Fehlersummenzeit Generator" VALUE 0xFD09D2 KwWU8 255.0 dez 0.00 255.0 FORMAT "%5.1" /end CHARACTERISTIC
/begin CHARACTERISTIC TSFDGENBS "Fehlersummenzeit Kommunikation" VALUE 0xFD09D3 KwWU8 255.0 dez 0.00 255.0 FORMAT "%5.1" /end CHARACTERISTIC
/begin CHARACTERISTIC TSFDSU "Fehlersummenzeit: Drucksensor Umgebung" VALUE 0xFD09DB KwUb 255.0 dez 0.00 255.0 FORMAT "%5.1" /end CHARACTERISTIC
/begin CHARACTERISTIC TSFDWA "Fehlersummenzeit: Diebstahlwarnanlage" VALUE 0xFD09E7 KwUb 255.0 dez 0.00 255.0 FORMAT "%5.1" /end CHARACTERISTIC
/begin CHARACTERISTIC TSFDZKU0 "Fehlersummenzeit: Z¸ndspule 0" VALUE 0xFD09E8 KwWU8 255.0 dez 0.00 255.0 FORMAT "%5.1" /end CHARACTERISTIC
/begin CHARACTERISTIC TSFDZKU1 "Fehlersummenzeit: Z¸ndspule 1" VALUE 0xFD09E9 KwWU8 255.0 dez 0.00 255.0 FORMAT "%5.1" /end CHARACTERISTIC
/begin CHARACTERISTIC TSFDZKU2 "Fehlersummenzeit: Z¸ndspule 2" VALUE 0xFD09EA KwWU8 255.0 dez 0.00 255.0 FORMAT "%5.1" /end CHARACTERISTIC
/begin CHARACTERISTIC TSFDZKU3 "Fehlersummenzeit: Z¸ndspule 3" VALUE 0xFD09EB KwWU8 255.0 dez 0.00 255.0 FORMAT "%5.1" /end CHARACTERISTIC
/begin CHARACTERISTIC TSFDZKU4 "Fehlersummenzeit: Z¸ndspule 4" VALUE 0xFD09EC KwWU8 255.0 dez 0.00 255.0 FORMAT "%5.1" /end CHARACTERISTIC
/begin CHARACTERISTIC TSFDZKU5 "Fehlersummenzeit: Z¸ndspule 5" VALUE 0xFD09ED KwWU8 255.0 dez 0.00 255.0 FORMAT "%5.1" /end CHARACTERISTIC
/begin CHARACTERISTIC TSFDZKU6 "Fehlersummenzeit: Z¸ndspule 6" VALUE 0xFD09EE KwWU8 255.0 dez 0.00 255.0 FORMAT "%5.1" /end CHARACTERISTIC
/begin CHARACTERISTIC TSFDZKU7 "Fehlersummenzeit: Z¸ndspule 7" VALUE 0xFD09EF KwWU8 255.0 dez 0.00 255.0 FORMAT "%5.1" /end CHARACTERISTIC
/begin CHARACTERISTIC TSFEGFE "Fehlersummenzeit: Eingangsgrˆﬂe F¸llunserfassung" VALUE 0xFD09F0 KwUb 255.0 dez 0.00 255.0 FORMAT "%5.1" /end CHARACTERISTIC
/begin CHARACTERISTIC TSFFP1P "Fehlersummenzeit: Poti 1, Fahrpedal" VALUE 0xFD09FE KwUb 255.0 dez 0.00 255.0 FORMAT "%5.1" /end CHARACTERISTIC
/begin CHARACTERISTIC TSFFP2P "Fehlersummenzeit: Poti 2, Fahrpedal" VALUE 0xFD09FF KwUb 255.0 dez 0.00 255.0 FORMAT "%5.1" /end CHARACTERISTIC
/begin CHARACTERISTIC TSFFPP "Fehlersummenzeit: Poti Fahrpedal" VALUE 0xFD0A00 KwUb 255.0 dez 0.00 255.0 FORMAT "%5.1" /end CHARACTERISTIC
/begin CHARACTERISTIC TSFMDB "Fehlersummenzeit: Momentbegrenzung Sollmoment" VALUE 0xFD0A32 KwUb 255.0 dez 0.00 255.0 FORMAT "%5.1" /end CHARACTERISTIC
/begin CHARACTERISTIC TSFMFL "Fehlerschwere : Multifunktionslenkrad" VALUE 0xFD0A34 KwWU8 255.0 dez 0.00 255.0 FORMAT "%5.1" /end CHARACTERISTIC
/begin CHARACTERISTIC TSFTA "Fehlersummenzeit: Ansauglufttemperatur TANS" VALUE 0xFD0A48 KwUb 255.0 dez 0.00 255.0 FORMAT "%5.1" /end CHARACTERISTIC
/begin CHARACTERISTIC TSFTKA "Fehlersummenzeit: Temperatur K¸hlerausgang" VALUE 0xFD0A4C KwUb 255.0 dez 0.00 255.0 FORMAT "%5.1" /end CHARACTERISTIC
/begin CHARACTERISTIC TSFTM "Fehlersummenzeit: Motortemperatur TMOT" VALUE 0xFD0A4D KwUb 255.0 dez 0.00 255.0 FORMAT "%5.1" /end CHARACTERISTIC
/begin CHARACTERISTIC TSFTUM "Fehlersummenzeit: Umgebungstemperatur TUM" VALUE 0xFD0A4F KwUb 255.0 dez 0.00 255.0 FORMAT "%5.1" /end CHARACTERISTIC
/begin CHARACTERISTIC TSFUB "Fehlersummenzeit: Batteriespannung UB (Bordnetz)" VALUE 0xFD0A50 KwWU8 255.0 dez 0.00 255.0 FORMAT "%5.1" /end CHARACTERISTIC
/begin CHARACTERISTIC TSFUBR "Fehlersummenzeit: Bordnetzspannung ¸ber Hauptrelais UBR" VALUE 0xFD0A51 KwUb 255.0 dez 0.00 255.0 FORMAT "%5.1" /end CHARACTERISTIC
/begin CHARACTERISTIC TSFUFMV "Fehlersummenzeit: Funktions¸berwachung: Momentenvergleich" VALUE 0xFD0A52 KwUb 255.0 dez 0.00 255.0 FORMAT "%5.1" /end CHARACTERISTIC
/begin CHARACTERISTIC TSFUFNC "Fehlersummenzeit: Fkt¸berwachung: Drehzahlgeber-, Zuleitung- oder SG-Fehler" VALUE 0xFD0A53 KwUb 255.0 dez 0.00 255.0 FORMAT "%5.1" /end CHARACTERISTIC
/begin CHARACTERISTIC TSFUFRLIP "Fehlersummenzeit: Fkt¸berwachung: Lastsensor-, Zuleitung- oder SG-Fehler" VALUE 0xFD0A54 KwUb 255.0 dez 0.00 255.0 FORMAT "%5.1" /end CHARACTERISTIC
/begin CHARACTERISTIC TSFUFSGA "Fehlersummenzeit: Funktions¸berwachung: Steuerger‰te-Fehler Gruppe a" VALUE 0xFD0A55 KwUb 255.0 dez 0.00 255.0 FORMAT "%5.1" /end CHARACTERISTIC
/begin CHARACTERISTIC TSFUFSGB "Fehlersummenzeit: Funktions¸berwachung: Steuerger‰te-Fehler Gruppe b" VALUE 0xFD0A56 KwUb 255.0 dez 0.00 255.0 FORMAT "%5.1" /end CHARACTERISTIC
/begin CHARACTERISTIC TSFUFSGC "Fehlersummenzeit: Funktions¸berwachung: Steuerger‰te-Fehler Gruppe c" VALUE 0xFD0A57 KwUb 255.0 dez 0.00 255.0 FORMAT "%5.1" /end CHARACTERISTIC
/begin CHARACTERISTIC TSFUFSPSC "Fehlersummenzeit: Fkt¸berwachung: Pedalwertgeber-, Zuleitung- oder SG-Fehler" VALUE 0xFD0A58 KwUb 255.0 dez 0.00 255.0 FORMAT "%5.1" /end CHARACTERISTIC
/begin CHARACTERISTIC TSFURRAM "Fehlersummenzeit: Rechner¸berwachung: RAM" VALUE 0xFD0A59 KwUb 255.0 dez 0.00 255.0 FORMAT "%5.1" /end CHARACTERISTIC
/begin CHARACTERISTIC TSFURROM "Fehlersummenzeit: Rechner¸berwachung: ROM" VALUE 0xFD0A5A KwUb 255.0 dez 0.00 255.0 FORMAT "%5.1" /end CHARACTERISTIC
/begin CHARACTERISTIC TSFURRST "Fehlersummenzeit: Rechner¸berwachung: Reset" VALUE 0xFD0A5B KwUb 255.0 dez 0.00 255.0 FORMAT "%5.1" /end CHARACTERISTIC
/begin CHARACTERISTIC TSFVFZ "Fehlersummenzeit: Fahrzeug-Geschwindigkeit" VALUE 0xFD0A5C KwUb 255.0 dez 0.00 255.0 FORMAT "%5.1" /end CHARACTERISTIC
/begin CHARACTERISTIC TSFWCA "Fehlersummenzeit: Wegfahrsperre Wechselcode-Ablage" VALUE 0xFD0A5D KwUb 255.0 dez 0.00 255.0 FORMAT "%5.1" /end CHARACTERISTIC
/begin CHARACTERISTIC TSFWFS "Fehlersummenzeit: Wegfahrsperre" VALUE 0xFD0A5E KwUb 255.0 dez 0.00 255.0 FORMAT "%5.1" /end CHARACTERISTIC
/begin CHARACTERISTIC TVFHS "Entprellzeit f¸r Heizerendstufe" VALUE 0xFCCBC6 KwUb 2.550 t10msxs_ub_b2p55 0.00 2.550 FORMAT "%5.3" /end CHARACTERISTIC
/begin CHARACTERISTIC TVHSEE "Entprellzeit f¸r Heizerendstufenfehler" VALUE 0xFCCBC7 KwUb 12.75 t50msxs_q0p05 0.00 12.75 FORMAT "%5.2" /end CHARACTERISTIC
/begin CHARACTERISTIC TVRIF "Verzˆgerungszeit f¸r Ri-Fehler" VALUE 0xFCCBC8 KwUb 255.0 t1sxs_ub_b255 0.00 255.0 FORMAT "%5.1" /end CHARACTERISTIC
/begin CHARACTERISTIC UADHFMMN "min. Spannungswert f¸r Diagnose HFM im Start" VALUE 0xFCD49B KwUb 4.845 spg_ub_q0p019 0.00 4.845 FORMAT "%5.3" /end CHARACTERISTIC
/begin CHARACTERISTIC UADHFMMX "max. Spannungswert f¸r Diagnose HFM im Start" VALUE 0xFCD49C KwUb 4.845 spg_ub_q0p019 0.00 4.845 FORMAT "%5.3" /end CHARACTERISTIC
/begin CHARACTERISTIC UBDLSMX "obere Batteriespannungsschwelle f¸r die  Sonden-Diagnose" VALUE 0xFCCBC9 KwUb 24.02 spg_ub 0.00 24.02 FORMAT "%5.2" /end CHARACTERISTIC
/begin CHARACTERISTIC UBHFM "Batteriespannungsschwelle zur Umschaltung auf Ersatzlastsignal" VALUE 0xFCD49D KwUb 24.02 spg_ubatt 0.00 24.02 FORMAT "%5.2" /end CHARACTERISTIC
/begin CHARACTERISTIC UHDMN "Schwellwert f¸r bestromte Heizerendstufe" VALUE 0xFCCBCA KwUb 4.980 spg_ub_b5 0.00 4.980 FORMAT "%5.3" /end CHARACTERISTIC
/begin CHARACTERISTIC UHDMX "Schwellwert f¸r stromlose Heizerendstufe" VALUE 0xFCCBCB KwUb 4.980 spg_ub_b5 0.00 4.980 FORMAT "%5.3" /end CHARACTERISTIC
/begin CHARACTERISTIC UNWDHFM "Umdrehungen Nockenwelle f¸r Fehlerentprellung Diagnose HFM" VALUE 0xFCD49E KwUb 255.0 dez 0.00 255.0 FORMAT "%5.1" /end CHARACTERISTIC
/begin CHARACTERISTIC WLSU "Kennfeld Sollwert f¸r geregelten Betrieb" MAP 0xFCCEE8 KfAxUbAyUbSstxUbSstyUbWUb 99.61 PCENT 0.00 99.61 FORMAT "%5.2"
 /begin AXIS_DESCR STD_AXIS nmot nmot_ub_q40 16 0.00 10200. FORMAT "%5.0" DEPOSIT ABSOLUTE /end AXIS_DESCR
 /begin AXIS_DESCR STD_AXIS rl rel_ub_q0p75 16 0.00 191.3 FORMAT "%5.1" DEPOSIT ABSOLUTE /end AXIS_DESCR
/end CHARACTERISTIC
/begin CHARACTERISTIC ZKARIH "Filterzeitkonst.f¸r Nachbildung Dynamik der Keramiktemp. aus Abgastemp. h.Kat" VALUE 0xFCCBE6 KwUw 6553.50000 zk100msxs_uw_b6553 0.100001526 6553.60000 FORMAT "%10.5" /end CHARACTERISTIC
/begin CHARACTERISTIC ZKARIV "Filterzeitkonst.f¸r Nachbildung Dynamik der Keramiktemp. aus Abgastemp. v.Kat" VALUE 0xFCCBE8 KwUw 6553.50000 zk100msxs_uw_b6553 0.100001526 6553.60000 FORMAT "%10.5" /end CHARACTERISTIC
/begin CHARACTERISTIC ZKPRIH "Filter f¸r Nachbildung Dynamik der Sondenkeramiktemp.aus el.Heizleistung h.Kat" VALUE 0xFCCBEA KwUw 6553.50000 zk100msxs_uw_b6553 0.100001526 6553.60000 FORMAT "%10.5" /end CHARACTERISTIC
/begin CHARACTERISTIC ZKPRIV "Filter f¸r Nachbildung Dynamik der Sondenkeramiktemp.aus el.Heizleistung v.Kat" VALUE 0xFCCBEC KwUw 6553.50000 zk100msxs_uw_b6553 0.100001526 6553.60000 FORMAT "%10.5" /end CHARACTERISTIC
/begin CHARACTERISTIC ZMLRO "Zeitkonstante mlroh-Tiefpaﬂ bei Diagnose HFM/HLM" VALUE 0xFC3875 KwUb 2.54000 zk10msxs_ub_b2p55 0.0100000 2.55000 FORMAT "%7.5" /end CHARACTERISTIC
/begin MEASUREMENT B_1stbsder "" UBYTE B_TRUE 1 100 0 1 FORMAT "%13.11" ECU_ADDRESS 0x5B8919 /end MEASUREMENT
/begin MEASUREMENT B_agrrdy "Bedingung AGR gepr¸ft f¸r 'ready-Byte'" UBYTE B_TRUE 1 100 0 1 BIT_MASK 0x80 FORMAT "%13.11" ECU_ADDRESS 0x3FD804 /end MEASUREMENT
/begin MEASUREMENT B_auxerr "" UBYTE B_TRUE 1 100 0 1 FORMAT "%13.11" ECU_ADDRESS 0x5B891A /end MEASUREMENT
/begin MEASUREMENT B_bebrems "Bedingung Bandende-Funktionsanforderung Bremsschalter" UWORD B_TRUE 1 100 0 1 BIT_MASK 0x20 FORMAT "%13.11" ECU_ADDRESS 0x3FDD28 /end MEASUREMENT
/begin MEASUREMENT B_bebwf "Bedingung Bandendeanford. f¸r Bewegungsfehler FPM" UWORD B_TRUE 1 100 0 1 BIT_MASK 0x20 FORMAT "%13.11" ECU_ADDRESS 0x3FDD2A /end MEASUREMENT
/begin MEASUREMENT B_bedgen "" UWORD B_TRUE 1 100 0 1 BIT_MASK 0x20 FORMAT "%13.11" ECU_ADDRESS 0x3FDD3A /end MEASUREMENT
/begin MEASUREMENT B_bedgenbs "" UWORD B_TRUE 1 100 0 1 BIT_MASK 0x20 FORMAT "%13.11" ECU_ADDRESS 0x3FDD3C /end MEASUREMENT
/begin MEASUREMENT B_bedsu "Bedingung: Bandende-Funktionsanforderung DSU" UWORD B_TRUE 1 100 0 1 BIT_MASK 0x20 FORMAT "%13.11" ECU_ADDRESS 0x3FDD4C /end MEASUREMENT
/begin MEASUREMENT B_bedwa "" UWORD B_TRUE 1 100 0 1 BIT_MASK 0x20 FORMAT "%13.11" ECU_ADDRESS 0x3FDD64 /end MEASUREMENT
/begin MEASUREMENT B_bedzku0 "DSM Information : Z¸ndkreisdiagnose" UWORD B_TRUE 1 100 0 1 BIT_MASK 0x20 FORMAT "%13.11" ECU_ADDRESS 0x3FDD66 /end MEASUREMENT
/begin MEASUREMENT B_bedzku1 "DSM Information : Z¸ndkreisdiagnose" UWORD B_TRUE 1 100 0 1 BIT_MASK 0x20 FORMAT "%13.11" ECU_ADDRESS 0x3FDD68 /end MEASUREMENT
/begin MEASUREMENT B_bedzku2 "DSM Information : Z¸ndkreisdiagnose" UWORD B_TRUE 1 100 0 1 BIT_MASK 0x20 FORMAT "%13.11" ECU_ADDRESS 0x3FDD6A /end MEASUREMENT
/begin MEASUREMENT B_bedzku3 "DSM Information : Z¸ndkreisdiagnose" UWORD B_TRUE 1 100 0 1 BIT_MASK 0x20 FORMAT "%13.11" ECU_ADDRESS 0x3FDD6C /end MEASUREMENT
/begin MEASUREMENT B_bedzku4 "DSM Information : Z¸ndkreisdiagnose" UWORD B_TRUE 1 100 0 1 BIT_MASK 0x20 FORMAT "%13.11" ECU_ADDRESS 0x3FDD6E /end MEASUREMENT
/begin MEASUREMENT B_bedzku5 "DSM Information : Z¸ndkreisdiagnose" UWORD B_TRUE 1 100 0 1 BIT_MASK 0x20 FORMAT "%13.11" ECU_ADDRESS 0x3FDD70 /end MEASUREMENT
/begin MEASUREMENT B_bedzku6 "DSM Information : Z¸ndkreisdiagnose" UWORD B_TRUE 1 100 0 1 BIT_MASK 0x20 FORMAT "%13.11" ECU_ADDRESS 0x3FDD72 /end MEASUREMENT
/begin MEASUREMENT B_bedzku7 "DSM Information : Z¸ndkreisdiagnose" UWORD B_TRUE 1 100 0 1 BIT_MASK 0x20 FORMAT "%13.11" ECU_ADDRESS 0x3FDD74 /end MEASUREMENT
/begin MEASUREMENT B_beegfe "Bedingung: Bandende-Anforderung bei Eingangsgrˆﬂen der F¸llungserfassung" UWORD B_TRUE 1 100 0 1 BIT_MASK 0x20 FORMAT "%13.11" ECU_ADDRESS 0x3FDD76 /end MEASUREMENT
/begin MEASUREMENT B_befp1p "Bedingung Bandendeanford. f¸r Fehler Poti1 FPM" UWORD B_TRUE 1 100 0 1 BIT_MASK 0x20 FORMAT "%13.11" ECU_ADDRESS 0x3FDD92 /end MEASUREMENT
/begin MEASUREMENT B_befp2p "Bedingung Bandendeanford. f¸r Fehler Poti2 FPM" UWORD B_TRUE 1 100 0 1 BIT_MASK 0x20 FORMAT "%13.11" ECU_ADDRESS 0x3FDD94 /end MEASUREMENT
/begin MEASUREMENT B_befpp "Bedingung Bandendeanford. f¸r Fehler FPM" UWORD B_TRUE 1 100 0 1 BIT_MASK 0x20 FORMAT "%13.11" ECU_ADDRESS 0x3FDD96 /end MEASUREMENT
/begin MEASUREMENT B_bemdb "Bedingung Bandende-Funktionsanforderung MDB" UWORD B_TRUE 1 100 0 1 BIT_MASK 0x20 FORMAT "%13.11" ECU_ADDRESS 0x3FDDFA /end MEASUREMENT
/begin MEASUREMENT B_bemfl "" UWORD B_TRUE 1 100 0 1 BIT_MASK 0x20 FORMAT "%13.11" ECU_ADDRESS 0x3FDDFE /end MEASUREMENT
/begin MEASUREMENT B_beta "Bedingung Bandende-Funktionsanforderung Ansauglufttemperaturf¸hler" UWORD B_TRUE 1 100 0 1 BIT_MASK 0x20 FORMAT "%13.11" ECU_ADDRESS 0x3FDE26 /end MEASUREMENT
/begin MEASUREMENT B_betka "" UWORD B_TRUE 1 100 0 1 BIT_MASK 0x20 FORMAT "%13.11" ECU_ADDRESS 0x3FDE2E /end MEASUREMENT
/begin MEASUREMENT B_betm "Bedingung Bandende-Funktionsanforderung Motortemperaturf¸hler" UWORD B_TRUE 1 100 0 1 BIT_MASK 0x20 FORMAT "%13.11" ECU_ADDRESS 0x3FDE30 /end MEASUREMENT
/begin MEASUREMENT B_betum "Bedingung Bandende-Funktionsanforderung" UWORD B_TRUE 1 100 0 1 BIT_MASK 0x20 FORMAT "%13.11" ECU_ADDRESS 0x3FDE34 /end MEASUREMENT
/begin MEASUREMENT B_beub "Bedingung: Bandendefunktionanford. f¸r Batteriespannung (Bordnetz)" UWORD B_TRUE 1 100 0 1 BIT_MASK 0x20 FORMAT "%13.11" ECU_ADDRESS 0x3FDE36 /end MEASUREMENT
/begin MEASUREMENT B_beubr "Bedingung: Bandendefunktionanford. f¸r Batteriespannung (Bordnetz)" UWORD B_TRUE 1 100 0 1 BIT_MASK 0x20 FORMAT "%13.11" ECU_ADDRESS 0x3FDE38 /end MEASUREMENT
/begin MEASUREMENT B_beufmv "Bedingung Bandende:Fkt¸berwachung-Anforderung" UWORD B_TRUE 1 100 0 1 BIT_MASK 0x20 FORMAT "%13.11" ECU_ADDRESS 0x3FDE3A /end MEASUREMENT
/begin MEASUREMENT B_beufnc "Bedingung Bandende:Fkt¸berwachung-Anforderung" UWORD B_TRUE 1 100 0 1 BIT_MASK 0x20 FORMAT "%13.11" ECU_ADDRESS 0x3FDE3C /end MEASUREMENT
/begin MEASUREMENT B_beufrlip "Bedingung Bandende:Fkt¸berwachung-Anforderung" UWORD B_TRUE 1 100 0 1 BIT_MASK 0x20 FORMAT "%13.11" ECU_ADDRESS 0x3FDE3E /end MEASUREMENT
/begin MEASUREMENT B_beufsga "Bedingung Bandende:Fkt¸berwachung-Anforderung" UWORD B_TRUE 1 100 0 1 BIT_MASK 0x20 FORMAT "%13.11" ECU_ADDRESS 0x3FDE40 /end MEASUREMENT
/begin MEASUREMENT B_beufsgb "Bedingung Bandende:Fkt¸berwachung-Anforderung" UWORD B_TRUE 1 100 0 1 BIT_MASK 0x20 FORMAT "%13.11" ECU_ADDRESS 0x3FDE42 /end MEASUREMENT
/begin MEASUREMENT B_beufsgc "Bedingung Bandende:Fkt¸berwachung-Anforderung" UWORD B_TRUE 1 100 0 1 BIT_MASK 0x20 FORMAT "%13.11" ECU_ADDRESS 0x3FDE44 /end MEASUREMENT
/begin MEASUREMENT B_beufspsc "Bedingung Bandende:Fkt¸berwachung-Anforderung" UWORD B_TRUE 1 100 0 1 BIT_MASK 0x20 FORMAT "%13.11" ECU_ADDRESS 0x3FDE46 /end MEASUREMENT
/begin MEASUREMENT B_beurram "" UWORD B_TRUE 1 100 0 1 BIT_MASK 0x20 FORMAT "%13.11" ECU_ADDRESS 0x3FDE48 /end MEASUREMENT
/begin MEASUREMENT B_beurrom "" UWORD B_TRUE 1 100 0 1 BIT_MASK 0x20 FORMAT "%13.11" ECU_ADDRESS 0x3FDE4A /end MEASUREMENT
/begin MEASUREMENT B_beurrst "" UWORD B_TRUE 1 100 0 1 BIT_MASK 0x20 FORMAT "%13.11" ECU_ADDRESS 0x3FDE4C /end MEASUREMENT
/begin MEASUREMENT B_bevfz "Bedingung Bandende-Funktionsanforderung f¸r Fehlerpfad Fahrzeuggeschwindigkeit" UWORD B_TRUE 1 100 0 1 BIT_MASK 0x20 FORMAT "%13.11" ECU_ADDRESS 0x3FDE4E /end MEASUREMENT
/begin MEASUREMENT B_bewca "" UWORD B_TRUE 1 100 0 1 BIT_MASK 0x20 FORMAT "%13.11" ECU_ADDRESS 0x3FDE50 /end MEASUREMENT
/begin MEASUREMENT B_bewfs "" UWORD B_TRUE 1 100 0 1 BIT_MASK 0x20 FORMAT "%13.11" ECU_ADDRESS 0x3FDE52 /end MEASUREMENT
/begin MEASUREMENT B_bkbrems "Bedingung Ersatzwert aktiv: BREMS (Bremsschalter)" UWORD B_TRUE 1 100 0 1 BIT_MASK 0x40 FORMAT "%13.11" ECU_ADDRESS 0x3FDD28 /end MEASUREMENT
/begin MEASUREMENT B_bkbwf "Flag f¸r Ersatzwert: PWG Bewegung" UWORD B_TRUE 1 100 0 1 BIT_MASK 0x40 FORMAT "%13.11" ECU_ADDRESS 0x3FDD2A /end MEASUREMENT
/begin MEASUREMENT B_bkdgen "" UWORD B_TRUE 1 100 0 1 BIT_MASK 0x40 FORMAT "%13.11" ECU_ADDRESS 0x3FDD3A /end MEASUREMENT
/begin MEASUREMENT B_bkdgenbs "" UWORD B_TRUE 1 100 0 1 BIT_MASK 0x40 FORMAT "%13.11" ECU_ADDRESS 0x3FDD3C /end MEASUREMENT
/begin MEASUREMENT B_bkdsu "Bedingung: Umgebungsdrucksensor" UWORD B_TRUE 1 100 0 1 BIT_MASK 0x40 FORMAT "%13.11" ECU_ADDRESS 0x3FDD4C /end MEASUREMENT
/begin MEASUREMENT B_bkdwa "Bedingung: Diebstahlwarnanlage" UWORD B_TRUE 1 100 0 1 BIT_MASK 0x40 FORMAT "%13.11" ECU_ADDRESS 0x3FDD64 /end MEASUREMENT
/begin MEASUREMENT B_bkdzku0 "DSM Information : Z¸ndkreisdiagnose" UWORD B_TRUE 1 100 0 1 BIT_MASK 0x40 FORMAT "%13.11" ECU_ADDRESS 0x3FDD66 /end MEASUREMENT
/begin MEASUREMENT B_bkdzku1 "DSM Information : Z¸ndkreisdiagnose" UWORD B_TRUE 1 100 0 1 BIT_MASK 0x40 FORMAT "%13.11" ECU_ADDRESS 0x3FDD68 /end MEASUREMENT
/begin MEASUREMENT B_bkdzku2 "DSM Information : Z¸ndkreisdiagnose" UWORD B_TRUE 1 100 0 1 BIT_MASK 0x40 FORMAT "%13.11" ECU_ADDRESS 0x3FDD6A /end MEASUREMENT
/begin MEASUREMENT B_bkdzku3 "DSM Information : Z¸ndkreisdiagnose" UWORD B_TRUE 1 100 0 1 BIT_MASK 0x40 FORMAT "%13.11" ECU_ADDRESS 0x3FDD6C /end MEASUREMENT
/begin MEASUREMENT B_bkdzku4 "DSM Information : Z¸ndkreisdiagnose" UWORD B_TRUE 1 100 0 1 BIT_MASK 0x40 FORMAT "%13.11" ECU_ADDRESS 0x3FDD6E /end MEASUREMENT
/begin MEASUREMENT B_bkdzku5 "DSM Information : Z¸ndkreisdiagnose" UWORD B_TRUE 1 100 0 1 BIT_MASK 0x40 FORMAT "%13.11" ECU_ADDRESS 0x3FDD70 /end MEASUREMENT
/begin MEASUREMENT B_bkdzku6 "DSM Information : Z¸ndkreisdiagnose" UWORD B_TRUE 1 100 0 1 BIT_MASK 0x40 FORMAT "%13.11" ECU_ADDRESS 0x3FDD72 /end MEASUREMENT
/begin MEASUREMENT B_bkdzku7 "DSM Information : Z¸ndkreisdiagnose" UWORD B_TRUE 1 100 0 1 BIT_MASK 0x40 FORMAT "%13.11" ECU_ADDRESS 0x3FDD74 /end MEASUREMENT
/begin MEASUREMENT B_bkegfe "Bedingung: Ersatzwert aktiv bei Eingangsgrˆﬂen der F¸llungserfassung" UWORD B_TRUE 1 100 0 1 BIT_MASK 0x40 FORMAT "%13.11" ECU_ADDRESS 0x3FDD76 /end MEASUREMENT
/begin MEASUREMENT B_bkfp1p "Bedingung: Fahrpedal 1.Potentiometer aktiv" UWORD B_TRUE 1 100 0 1 BIT_MASK 0x40 FORMAT "%13.11" ECU_ADDRESS 0x3FDD92 /end MEASUREMENT
/begin MEASUREMENT B_bkfp2p "Bedingung: Fahrpedal 2.Potentiometer aktiv" UWORD B_TRUE 1 100 0 1 BIT_MASK 0x40 FORMAT "%13.11" ECU_ADDRESS 0x3FDD94 /end MEASUREMENT
/begin MEASUREMENT B_bkfpp "Bedingung: Fahrpedal Potentiometer aktiv" UWORD B_TRUE 1 100 0 1 BIT_MASK 0x40 FORMAT "%13.11" ECU_ADDRESS 0x3FDD96 /end MEASUREMENT
/begin MEASUREMENT B_bkmdb "Bedingung: Momentan¸berwachung (bergrenzt dauerhaft) aktiv" UWORD B_TRUE 1 100 0 1 BIT_MASK 0x40 FORMAT "%13.11" ECU_ADDRESS 0x3FDDFA /end MEASUREMENT
/begin MEASUREMENT B_bkmfl "" UWORD B_TRUE 1 100 0 1 BIT_MASK 0x40 FORMAT "%13.11" ECU_ADDRESS 0x3FDDFE /end MEASUREMENT
/begin MEASUREMENT B_bkta "Bedingung Ersatzwert f¸r Ansauglufttemperatur (/Ladelufttemp.)" UWORD B_TRUE 1 100 0 1 BIT_MASK 0x40 FORMAT "%13.11" ECU_ADDRESS 0x3FDE26 /end MEASUREMENT
/begin MEASUREMENT B_bktka "Bedingung Ersatzwert f¸r Temperatur K¸hlerausgang" UWORD B_TRUE 1 100 0 1 BIT_MASK 0x40 FORMAT "%13.11" ECU_ADDRESS 0x3FDE2E /end MEASUREMENT
/begin MEASUREMENT B_bktm "Bedingung Ersatzwert f¸r Motortemperatur" UWORD B_TRUE 1 100 0 1 BIT_MASK 0x40 FORMAT "%13.11" ECU_ADDRESS 0x3FDE30 /end MEASUREMENT
/begin MEASUREMENT B_bktum "Bedingung Ersatzwert f¸r Umgebumgstemperatur" UWORD B_TRUE 1 100 0 1 BIT_MASK 0x40 FORMAT "%13.11" ECU_ADDRESS 0x3FDE34 /end MEASUREMENT
/begin MEASUREMENT B_bkub "Bedingung Ersatzwert f¸r Batteriespannung (Bordnetz)" UWORD B_TRUE 1 100 0 1 BIT_MASK 0x40 FORMAT "%13.11" ECU_ADDRESS 0x3FDE36 /end MEASUREMENT
/begin MEASUREMENT B_bkubr "Bedingung Ersatzwert f¸r Batteriespannung (Bordnetz)" UWORD B_TRUE 1 100 0 1 BIT_MASK 0x40 FORMAT "%13.11" ECU_ADDRESS 0x3FDE38 /end MEASUREMENT
/begin MEASUREMENT B_bkufmv "Bedingung: Funktios¸berwachung Momentanvergleich aktiv" UWORD B_TRUE 1 100 0 1 BIT_MASK 0x40 FORMAT "%13.11" ECU_ADDRESS 0x3FDE3A /end MEASUREMENT
/begin MEASUREMENT B_bkufnc "Bedingung Ersatzwert aktiv:Funktions¸berwachung" UWORD B_TRUE 1 100 0 1 BIT_MASK 0x40 FORMAT "%13.11" ECU_ADDRESS 0x3FDE3C /end MEASUREMENT
/begin MEASUREMENT B_bkufrlip "Bedingung Ersatzwert aktiv:Funktions¸berwachung" UWORD B_TRUE 1 100 0 1 BIT_MASK 0x40 FORMAT "%13.11" ECU_ADDRESS 0x3FDE3E /end MEASUREMENT
/begin MEASUREMENT B_bkufsga "Bedingung Ersatzwert aktiv:Funktions¸berwachung" UWORD B_TRUE 1 100 0 1 BIT_MASK 0x40 FORMAT "%13.11" ECU_ADDRESS 0x3FDE40 /end MEASUREMENT
/begin MEASUREMENT B_bkufsgb "Bedingung Ersatzwert aktiv:Funktions¸berwachung" UWORD B_TRUE 1 100 0 1 BIT_MASK 0x40 FORMAT "%13.11" ECU_ADDRESS 0x3FDE42 /end MEASUREMENT
/begin MEASUREMENT B_bkufsgc "Bedingung Ersatzwert aktiv:Funktions¸berwachung" UWORD B_TRUE 1 100 0 1 BIT_MASK 0x40 FORMAT "%13.11" ECU_ADDRESS 0x3FDE44 /end MEASUREMENT
/begin MEASUREMENT B_bkufspsc "Bedingung Ersatzwert aktiv:Funktions¸berwachung" UWORD B_TRUE 1 100 0 1 BIT_MASK 0x40 FORMAT "%13.11" ECU_ADDRESS 0x3FDE46 /end MEASUREMENT
/begin MEASUREMENT B_bkurram "Bedingung: Rechner¸berwachung: RAM" UWORD B_TRUE 1 100 0 1 BIT_MASK 0x40 FORMAT "%13.11" ECU_ADDRESS 0x3FDE48 /end MEASUREMENT
/begin MEASUREMENT B_bkurrom "Bedingung: Rechner¸berwachung: ROM" UWORD B_TRUE 1 100 0 1 BIT_MASK 0x40 FORMAT "%13.11" ECU_ADDRESS 0x3FDE4A /end MEASUREMENT
/begin MEASUREMENT B_bkurrst "Bedingung: Rechner¸berwachung: RESET" UWORD B_TRUE 1 100 0 1 BIT_MASK 0x40 FORMAT "%13.11" ECU_ADDRESS 0x3FDE4C /end MEASUREMENT
/begin MEASUREMENT B_bkvfz "Bedingung Ersatzwert aktiv: Fahrzeuggeschwindigkeitssignal" UWORD B_TRUE 1 100 0 1 BIT_MASK 0x40 FORMAT "%13.11" ECU_ADDRESS 0x3FDE4E /end MEASUREMENT
/begin MEASUREMENT B_bkwca "Bedingung: Wegfahrsperre Wechselcode-Ablage" UWORD B_TRUE 1 100 0 1 BIT_MASK 0x40 FORMAT "%13.11" ECU_ADDRESS 0x3FDE50 /end MEASUREMENT
/begin MEASUREMENT B_bkwfs "Bedingung: Wegfahrsperre" UWORD B_TRUE 1 100 0 1 BIT_MASK 0x40 FORMAT "%13.11" ECU_ADDRESS 0x3FDE52 /end MEASUREMENT
/begin MEASUREMENT B_canoff "CAN Controller Zustand: BUS_OFF" UBYTE B_TRUE 1 100 0 1 BIT_MASK 0x1 FORMAT "%13.11" ECU_ADDRESS 0x5B8AD4 /end MEASUREMENT
/begin MEASUREMENT B_cdiagoff "Bedingung: CAN-Diagnose aus, bei Flashprogrammierung ¸ber CAN" UBYTE B_TRUE 1 100 0 1 BIT_MASK 0x1 FORMAT "%13.11" ECU_ADDRESS 0x5B8AD5 /end MEASUREMENT
/begin MEASUREMENT B_clbrems "Bedingung Fehlerpfad BREMS (Bremsschalter) lˆschen" UWORD B_TRUE 1 100 0 1 BIT_MASK 0x80 FORMAT "%13.11" ECU_ADDRESS 0x3FDD28 /end MEASUREMENT
/begin MEASUREMENT B_clbwf "Flag f¸r Lˆschung: PWG Bewegung" UWORD B_TRUE 1 100 0 1 BIT_MASK 0x80 FORMAT "%13.11" ECU_ADDRESS 0x3FDD2A /end MEASUREMENT
/begin MEASUREMENT B_cldgen "" UWORD B_TRUE 1 100 0 1 BIT_MASK 0x80 FORMAT "%13.11" ECU_ADDRESS 0x3FDD3A /end MEASUREMENT
/begin MEASUREMENT B_cldgenbs "" UWORD B_TRUE 1 100 0 1 BIT_MASK 0x80 FORMAT "%13.11" ECU_ADDRESS 0x3FDD3C /end MEASUREMENT
/begin MEASUREMENT B_cldsu "Bedingung: Fehlerpfad Umgebungsdrucksensor lˆschen" UWORD B_TRUE 1 100 0 1 BIT_MASK 0x80 FORMAT "%13.11" ECU_ADDRESS 0x3FDD4C /end MEASUREMENT
/begin MEASUREMENT B_cldwa "Bedingung lˆschen: Diebstahlwarnanlage" UWORD B_TRUE 1 100 0 1 BIT_MASK 0x80 FORMAT "%13.11" ECU_ADDRESS 0x3FDD64 /end MEASUREMENT
/begin MEASUREMENT B_cldzku0 "lˆschen prim.Z¸ndkreis Zyl.0" UWORD B_TRUE 1 100 0 1 BIT_MASK 0x80 FORMAT "%13.11" ECU_ADDRESS 0x3FDD66 /end MEASUREMENT
/begin MEASUREMENT B_cldzku1 "lˆschen prim.Z¸ndkreis Zyl.1" UWORD B_TRUE 1 100 0 1 BIT_MASK 0x80 FORMAT "%13.11" ECU_ADDRESS 0x3FDD68 /end MEASUREMENT
/begin MEASUREMENT B_cldzku2 "lˆschen prim.Z¸ndkreis Zyl.2" UWORD B_TRUE 1 100 0 1 BIT_MASK 0x80 FORMAT "%13.11" ECU_ADDRESS 0x3FDD6A /end MEASUREMENT
/begin MEASUREMENT B_cldzku3 "lˆschen prim.Z¸ndkreis Zyl.3" UWORD B_TRUE 1 100 0 1 BIT_MASK 0x80 FORMAT "%13.11" ECU_ADDRESS 0x3FDD6C /end MEASUREMENT
/begin MEASUREMENT B_cldzku4 "lˆschen prim.Z¸ndkreis Zyl.4" UWORD B_TRUE 1 100 0 1 BIT_MASK 0x80 FORMAT "%13.11" ECU_ADDRESS 0x3FDD6E /end MEASUREMENT
/begin MEASUREMENT B_cldzku5 "lˆschen prim.Z¸ndkreis Zyl.5" UWORD B_TRUE 1 100 0 1 BIT_MASK 0x80 FORMAT "%13.11" ECU_ADDRESS 0x3FDD70 /end MEASUREMENT
/begin MEASUREMENT B_cldzku6 "lˆschen prim.Z¸ndkreis Zyl.6" UWORD B_TRUE 1 100 0 1 BIT_MASK 0x80 FORMAT "%13.11" ECU_ADDRESS 0x3FDD72 /end MEASUREMENT
/begin MEASUREMENT B_cldzku7 "lˆschen prim.Z¸ndkreis Zyl.7" UWORD B_TRUE 1 100 0 1 BIT_MASK 0x80 FORMAT "%13.11" ECU_ADDRESS 0x3FDD74 /end MEASUREMENT
/begin MEASUREMENT B_clegfe "Bedingung Fehlerpfad EGFE lˆschen" UWORD B_TRUE 1 100 0 1 BIT_MASK 0x80 FORMAT "%13.11" ECU_ADDRESS 0x3FDD76 /end MEASUREMENT
/begin MEASUREMENT B_clfp1p "Flag f¸r Lˆschmaﬂnahmen: Fahrpedal 1. Poti" UWORD B_TRUE 1 100 0 1 BIT_MASK 0x80 FORMAT "%13.11" ECU_ADDRESS 0x3FDD92 /end MEASUREMENT
/begin MEASUREMENT B_clfp2p "Flag f¸r Lˆschmaﬂnahmen: Fahrpedal 2. Poti" UWORD B_TRUE 1 100 0 1 BIT_MASK 0x80 FORMAT "%13.11" ECU_ADDRESS 0x3FDD94 /end MEASUREMENT
/begin MEASUREMENT B_clfpp "Bedingung Fehlerpfad FPP (Fahrpedal-Poti) lˆschen" UWORD B_TRUE 1 100 0 1 BIT_MASK 0x80 FORMAT "%13.11" ECU_ADDRESS 0x3FDD96 /end MEASUREMENT
/begin MEASUREMENT B_clmdb "Flag f¸r Lˆschung: Momentenbegrenzung begrenzt dauerhaft" UWORD B_TRUE 1 100 0 1 BIT_MASK 0x80 FORMAT "%13.11" ECU_ADDRESS 0x3FDDFA /end MEASUREMENT
/begin MEASUREMENT B_clmfl "Bedingung Fehlerflag ""Multifunktionslenkrad"" lˆschen" UWORD B_TRUE 1 100 0 1 BIT_MASK 0x80 FORMAT "%13.11" ECU_ADDRESS 0x3FDDFE /end MEASUREMENT
/begin MEASUREMENT B_clta "Bedingung Fehlerpfad Ansauglufttemperatur (/Ladeluft-) TANS lˆschen" UWORD B_TRUE 1 100 0 1 BIT_MASK 0x80 FORMAT "%13.11" ECU_ADDRESS 0x3FDE26 /end MEASUREMENT
/begin MEASUREMENT B_cltka "Bedingung Fehlerpfad Temperatur K¸hlerausgang TKA lˆschen" UWORD B_TRUE 1 100 0 1 BIT_MASK 0x80 FORMAT "%13.11" ECU_ADDRESS 0x3FDE2E /end MEASUREMENT
/begin MEASUREMENT B_cltm "Bedingung Fehlerpfad Motortemperatur TMOT lˆschen" UWORD B_TRUE 1 100 0 1 BIT_MASK 0x80 FORMAT "%13.11" ECU_ADDRESS 0x3FDE30 /end MEASUREMENT
/begin MEASUREMENT B_cltum "Bedingung Fehlerpfad Umgebungstemperatur TUM  lˆschen" UWORD B_TRUE 1 100 0 1 BIT_MASK 0x80 FORMAT "%13.11" ECU_ADDRESS 0x3FDE34 /end MEASUREMENT
/begin MEASUREMENT B_club "Bedingung Fehlerpfad Batteriespannung (Bordnetz) lˆschen" UWORD B_TRUE 1 100 0 1 BIT_MASK 0x80 FORMAT "%13.11" ECU_ADDRESS 0x3FDE36 /end MEASUREMENT
/begin MEASUREMENT B_clubr "Bedingung Fehlerpfad Bordspannung ¸ber Hauptrelais  lˆschen" UWORD B_TRUE 1 100 0 1 BIT_MASK 0x80 FORMAT "%13.11" ECU_ADDRESS 0x3FDE38 /end MEASUREMENT
/begin MEASUREMENT B_clufmv "Flag f¸r Lˆschung: Funktions¸berwachung: Momentenvergleich" UWORD B_TRUE 1 100 0 1 BIT_MASK 0x80 FORMAT "%13.11" ECU_ADDRESS 0x3FDE3A /end MEASUREMENT
/begin MEASUREMENT B_clufnc "Flag f¸r Lˆschung: Fkt¸berwachung: Drehzahlgeber-, Zuleitung- oder SG-Fehler" UWORD B_TRUE 1 100 0 1 BIT_MASK 0x80 FORMAT "%13.11" ECU_ADDRESS 0x3FDE3C /end MEASUREMENT
/begin MEASUREMENT B_clufrlip "Flag f¸r Lˆschung: Fkt¸berwachung: Lastsensor-, Zuleitung- oder SG-Fehler" UWORD B_TRUE 1 100 0 1 BIT_MASK 0x80 FORMAT "%13.11" ECU_ADDRESS 0x3FDE3E /end MEASUREMENT
/begin MEASUREMENT B_clufsga "Flag f¸r Lˆschung: Funktions¸berwachung: Steuerger‰te-Fehler Gruppe a" UWORD B_TRUE 1 100 0 1 BIT_MASK 0x80 FORMAT "%13.11" ECU_ADDRESS 0x3FDE40 /end MEASUREMENT
/begin MEASUREMENT B_clufsgb "Flag f¸r Lˆschung: Funktions¸berwachung: Steuerger‰te-Fehler Gruppe b" UWORD B_TRUE 1 100 0 1 BIT_MASK 0x80 FORMAT "%13.11" ECU_ADDRESS 0x3FDE42 /end MEASUREMENT
/begin MEASUREMENT B_clufsgc "Flag f¸r Lˆschung: Funktions¸berwachung: Steuerger‰te-Fehler Gruppe c" UWORD B_TRUE 1 100 0 1 BIT_MASK 0x80 FORMAT "%13.11" ECU_ADDRESS 0x3FDE44 /end MEASUREMENT
/begin MEASUREMENT B_clufspsc "Flag f¸r Lˆschung: Fkt¸berwachung: Pedalwertgeber-, Zuleitung- oder SG-Fehler" UWORD B_TRUE 1 100 0 1 BIT_MASK 0x80 FORMAT "%13.11" ECU_ADDRESS 0x3FDE46 /end MEASUREMENT
/begin MEASUREMENT B_clurram "Flag f¸r Lˆschung: Rechner¸berwachung: RAM" UWORD B_TRUE 1 100 0 1 BIT_MASK 0x80 FORMAT "%13.11" ECU_ADDRESS 0x3FDE48 /end MEASUREMENT
/begin MEASUREMENT B_clurrom "Flag f¸r Lˆschung: Rechner¸berwachung: ROM" UWORD B_TRUE 1 100 0 1 BIT_MASK 0x80 FORMAT "%13.11" ECU_ADDRESS 0x3FDE4A /end MEASUREMENT
/begin MEASUREMENT B_clurrst "Flag f¸r Lˆschung: Rechner¸berwachung: Reset" UWORD B_TRUE 1 100 0 1 BIT_MASK 0x80 FORMAT "%13.11" ECU_ADDRESS 0x3FDE4C /end MEASUREMENT
/begin MEASUREMENT B_clvfz "Bedingung Fehlerpfad VFZ (Fahrzeuggeschwindigkeit) lˆschen" UWORD B_TRUE 1 100 0 1 BIT_MASK 0x80 FORMAT "%13.11" ECU_ADDRESS 0x3FDE4E /end MEASUREMENT
/begin MEASUREMENT B_clwca "Bedingung lˆschen: Wegfahrsperre Wechselcode-Ablage" UWORD B_TRUE 1 100 0 1 BIT_MASK 0x80 FORMAT "%13.11" ECU_ADDRESS 0x3FDE50 /end MEASUREMENT
/begin MEASUREMENT B_clwfs "Bedingung Wegfahrsperre lˆschen" UWORD B_TRUE 1 100 0 1 BIT_MASK 0x80 FORMAT "%13.11" ECU_ADDRESS 0x3FDE52 /end MEASUREMENT
/begin MEASUREMENT B_diagtimeout "" UBYTE B_TRUE 1 100 0 1 BIT_MASK 0x1 FORMAT "%13.11" ECU_ADDRESS 0x5B8AD6 /end MEASUREMENT
/begin MEASUREMENT B_disa "Rover" UBYTE B_TRUE 1 100 0 1 BIT_MASK 0x1 FORMAT "%13.11" ECU_ADDRESS 0x5B86B1 /end MEASUREMENT
/begin MEASUREMENT B_disalern "Wird gesetzt, sobald ein Lernvorgang erfolgreich war" UBYTE dez 1 100 0 255 FORMAT "%5.1" ECU_ADDRESS 0x3FDBCE /end MEASUREMENT
/begin MEASUREMENT B_disa_ersatz "" UBYTE B_TRUE 1 100 0 1 BIT_MASK 0x1 FORMAT "%13.11" ECU_ADDRESS 0x3FBD1C /end MEASUREMENT
/begin MEASUREMENT B_di_ausschalt "" UBYTE B_TRUE 1 100 0 1 BIT_MASK 0x2 FORMAT "%13.11" ECU_ADDRESS 0x5B86B1 /end MEASUREMENT
/begin MEASUREMENT B_di_einschalt "" UBYTE B_TRUE 1 100 0 1 BIT_MASK 0x4 FORMAT "%13.11" ECU_ADDRESS 0x5B86B1 /end MEASUREMENT
/begin MEASUREMENT B_drvddmtl "" UBYTE B_TRUE 1 100 0 1 BIT_MASK 0x4 FORMAT "%13.11" ECU_ADDRESS 0x5B8E23 /end MEASUREMENT
/begin MEASUREMENT B_drvdldp "" UBYTE B_TRUE 1 100 0 1 BIT_MASK 0x2 FORMAT "%13.11" ECU_ADDRESS 0x5B8E23 /end MEASUREMENT
/begin MEASUREMENT B_drvdtev "" UBYTE B_TRUE 1 100 0 1 BIT_MASK 0x1 FORMAT "%13.11" ECU_ADDRESS 0x5B8E23 /end MEASUREMENT
/begin MEASUREMENT B_dtimer "" UBYTE B_TRUE 1 100 0 1 BIT_MASK 0x1 FORMAT "%13.11" ECU_ADDRESS 0x5B8AD7 /end MEASUREMENT
/begin MEASUREMENT B_ebDavT "Bedingung ETK_Bypass Daten verf¸gbar" UBYTE B_TRUE 1 100 0 1 BIT_MASK 0x1 FORMAT "%13.11" ECU_ADDRESS 0x5B8AD8 /end MEASUREMENT
/begin MEASUREMENT B_ebDavY "ETK-Bypass Daten vorhanden" UBYTE B_TRUE 1 100 0 1 BIT_MASK 0x1 FORMAT "%13.11" ECU_ADDRESS 0x5B8AD9 /end MEASUREMENT
/begin MEASUREMENT B_ehfm "Bedingung Fehler HFM (ohne Entprellung)" UBYTE B_TRUE 1 100 0 1 BIT_MASK 0x1 FORMAT "%13.11" ECU_ADDRESS 0x3FBD1F /end MEASUREMENT
/begin MEASUREMENT B_ehfm1 "Bedingung Fehler HFM (ohne Entprellung) (Zwischengrˆﬂe ohne Abfrage von UBAT)" UBYTE B_TRUE 1 100 0 1 BIT_MASK 0x1 FORMAT "%13.11" ECU_ADDRESS 0x3FBD20 /end MEASUREMENT
/begin MEASUREMENT B_ehfs "Bedingung Ersatzwert Hauptf¸llungssensor" UBYTE B_TRUE 1 100 0 1 BIT_MASK 0x1 FORMAT "%13.11" ECU_ADDRESS 0x3FBD21 /end MEASUREMENT
/begin MEASUREMENT B_elmi "Bedingung Error Luftmasse bei Initialisierung" UBYTE B_TRUE 1 100 0 1 BIT_MASK 0x1 FORMAT "%13.11" ECU_ADDRESS 0x3FBD22 /end MEASUREMENT
/begin MEASUREMENT B_fadwa "" UWORD B_TRUE 1 100 0 1 BIT_MASK 0x10 FORMAT "%13.11" ECU_ADDRESS 0x3FDD64 /end MEASUREMENT
/begin MEASUREMENT B_fawca "" UWORD B_TRUE 1 100 0 1 BIT_MASK 0x10 FORMAT "%13.11" ECU_ADDRESS 0x3FDE50 /end MEASUREMENT
/begin MEASUREMENT B_fawfs "" UWORD B_TRUE 1 100 0 1 BIT_MASK 0x10 FORMAT "%13.11" ECU_ADDRESS 0x3FDE52 /end MEASUREMENT
/begin MEASUREMENT B_ftbrems "Bedingung: Fehlereintrag durch Tester f¸r Bremsschalter" UWORD B_TRUE 1 100 0 1 BIT_MASK 0x10 FORMAT "%13.11" ECU_ADDRESS 0x3FDD28 /end MEASUREMENT
/begin MEASUREMENT B_ftbwf "Bedingung Fehlereintrag durch Tester f¸r Bewegungsfehler FPM" UWORD B_TRUE 1 100 0 1 BIT_MASK 0x10 FORMAT "%13.11" ECU_ADDRESS 0x3FDD2A /end MEASUREMENT
/begin MEASUREMENT B_ftdgen "" UWORD B_TRUE 1 100 0 1 BIT_MASK 0x10 FORMAT "%13.11" ECU_ADDRESS 0x3FDD3A /end MEASUREMENT
/begin MEASUREMENT B_ftdgenbs "" UWORD B_TRUE 1 100 0 1 BIT_MASK 0x10 FORMAT "%13.11" ECU_ADDRESS 0x3FDD3C /end MEASUREMENT
/begin MEASUREMENT B_ftdsu "Bedingung: Fehlereintrag durch Tester f¸r DSU" UWORD B_TRUE 1 100 0 1 BIT_MASK 0x10 FORMAT "%13.11" ECU_ADDRESS 0x3FDD4C /end MEASUREMENT
/begin MEASUREMENT B_ftdzku0 "DSM Information : Z¸ndkreisdiagnose" UWORD B_TRUE 1 100 0 1 BIT_MASK 0x10 FORMAT "%13.11" ECU_ADDRESS 0x3FDD66 /end MEASUREMENT
/begin MEASUREMENT B_ftdzku1 "DSM Information : Z¸ndkreisdiagnose" UWORD B_TRUE 1 100 0 1 BIT_MASK 0x10 FORMAT "%13.11" ECU_ADDRESS 0x3FDD68 /end MEASUREMENT
/begin MEASUREMENT B_ftdzku2 "DSM Information : Z¸ndkreisdiagnose" UWORD B_TRUE 1 100 0 1 BIT_MASK 0x10 FORMAT "%13.11" ECU_ADDRESS 0x3FDD6A /end MEASUREMENT
/begin MEASUREMENT B_ftdzku3 "DSM Information : Z¸ndkreisdiagnose" UWORD B_TRUE 1 100 0 1 BIT_MASK 0x10 FORMAT "%13.11" ECU_ADDRESS 0x3FDD6C /end MEASUREMENT
/begin MEASUREMENT B_ftdzku4 "DSM Information : Z¸ndkreisdiagnose" UWORD B_TRUE 1 100 0 1 BIT_MASK 0x10 FORMAT "%13.11" ECU_ADDRESS 0x3FDD6E /end MEASUREMENT
/begin MEASUREMENT B_ftdzku5 "DSM Information : Z¸ndkreisdiagnose" UWORD B_TRUE 1 100 0 1 BIT_MASK 0x10 FORMAT "%13.11" ECU_ADDRESS 0x3FDD70 /end MEASUREMENT
/begin MEASUREMENT B_ftdzku6 "DSM Information : Z¸ndkreisdiagnose" UWORD B_TRUE 1 100 0 1 BIT_MASK 0x10 FORMAT "%13.11" ECU_ADDRESS 0x3FDD72 /end MEASUREMENT
/begin MEASUREMENT B_ftdzku7 "DSM Information : Z¸ndkreisdiagnose" UWORD B_TRUE 1 100 0 1 BIT_MASK 0x10 FORMAT "%13.11" ECU_ADDRESS 0x3FDD74 /end MEASUREMENT
/begin MEASUREMENT B_ftegfe "Bedingung: Fehlereintrag durch Tester f¸r DEGFE" UWORD B_TRUE 1 100 0 1 BIT_MASK 0x10 FORMAT "%13.11" ECU_ADDRESS 0x3FDD76 /end MEASUREMENT
/begin MEASUREMENT B_ftfp1p "Bedingung Fehlereintrag durch Tester f¸r Poti1 FPM" UWORD B_TRUE 1 100 0 1 BIT_MASK 0x10 FORMAT "%13.11" ECU_ADDRESS 0x3FDD92 /end MEASUREMENT
/begin MEASUREMENT B_ftfp2p "Bedingung Fehlereintrag durch Tester f¸r Poti2 FPM" UWORD B_TRUE 1 100 0 1 BIT_MASK 0x10 FORMAT "%13.11" ECU_ADDRESS 0x3FDD94 /end MEASUREMENT
/begin MEASUREMENT B_ftfpp "Bedingung Fehlereintrag durch Tester f¸r FPM" UWORD B_TRUE 1 100 0 1 BIT_MASK 0x10 FORMAT "%13.11" ECU_ADDRESS 0x3FDD96 /end MEASUREMENT
/begin MEASUREMENT B_ftmdb "Bedingung: Fehlereintrag durch Tester f¸r MDB" UWORD B_TRUE 1 100 0 1 BIT_MASK 0x10 FORMAT "%13.11" ECU_ADDRESS 0x3FDDFA /end MEASUREMENT
/begin MEASUREMENT B_ftmfl "" UWORD B_TRUE 1 100 0 1 BIT_MASK 0x10 FORMAT "%13.11" ECU_ADDRESS 0x3FDDFE /end MEASUREMENT
/begin MEASUREMENT B_ftta "Bedingung Fehlereintrag durch Tester Ansauglufttemperatur" UWORD B_TRUE 1 100 0 1 BIT_MASK 0x10 FORMAT "%13.11" ECU_ADDRESS 0x3FDE26 /end MEASUREMENT
/begin MEASUREMENT B_fttka "" UWORD B_TRUE 1 100 0 1 BIT_MASK 0x10 FORMAT "%13.11" ECU_ADDRESS 0x3FDE2E /end MEASUREMENT
/begin MEASUREMENT B_fttm "Bedingung Fehlereintrag durch Tester f¸r Motor-/K¸hlmittel-Temperatur" UWORD B_TRUE 1 100 0 1 BIT_MASK 0x10 FORMAT "%13.11" ECU_ADDRESS 0x3FDE30 /end MEASUREMENT
/begin MEASUREMENT B_fttum "Bedingung: Fehlereintrag durch Tester" UWORD B_TRUE 1 100 0 1 BIT_MASK 0x10 FORMAT "%13.11" ECU_ADDRESS 0x3FDE34 /end MEASUREMENT
/begin MEASUREMENT B_ftub "Bedingung Fehlereintrag durch Tester f¸r Batteriespannung (Bordnetz)" UWORD B_TRUE 1 100 0 1 BIT_MASK 0x10 FORMAT "%13.11" ECU_ADDRESS 0x3FDE36 /end MEASUREMENT
/begin MEASUREMENT B_ftubr "Bedingung Fehlereintrag durch Tester f¸r Batteriespannung (Bordnetz)" UWORD B_TRUE 1 100 0 1 BIT_MASK 0x10 FORMAT "%13.11" ECU_ADDRESS 0x3FDE38 /end MEASUREMENT
/begin MEASUREMENT B_ftufmv "Bedingung: Fehlereintrag durch Tester: Momentvergleich" UWORD B_TRUE 1 100 0 1 BIT_MASK 0x10 FORMAT "%13.11" ECU_ADDRESS 0x3FDE3A /end MEASUREMENT
/begin MEASUREMENT B_ftufnc "Bedingung: Fehlereintrag durch Tester:Drehzahlgeber-,Zuleitung oder SG-Fehler" UWORD B_TRUE 1 100 0 1 BIT_MASK 0x10 FORMAT "%13.11" ECU_ADDRESS 0x3FDE3C /end MEASUREMENT
/begin MEASUREMENT B_ftufrlip "Bedingung: Fehlereintrag durch Tester: Lastsensor-,Zuleitung- oder SG-Fehler" UWORD B_TRUE 1 100 0 1 BIT_MASK 0x10 FORMAT "%13.11" ECU_ADDRESS 0x3FDE3E /end MEASUREMENT
/begin MEASUREMENT B_ftufsga "Bedingung: Fehlereintrag durch Tester: SG-Fehler Gruppe a" UWORD B_TRUE 1 100 0 1 BIT_MASK 0x10 FORMAT "%13.11" ECU_ADDRESS 0x3FDE40 /end MEASUREMENT
/begin MEASUREMENT B_ftufsgb "Bedingung: Fehlereintrag durch Tester: SG-Fehler Gruppe b" UWORD B_TRUE 1 100 0 1 BIT_MASK 0x10 FORMAT "%13.11" ECU_ADDRESS 0x3FDE42 /end MEASUREMENT
/begin MEASUREMENT B_ftufsgc "Bedingung: Fehlereintrag durch Tester: SG-Fehler Gruppe c" UWORD B_TRUE 1 100 0 1 BIT_MASK 0x10 FORMAT "%13.11" ECU_ADDRESS 0x3FDE44 /end MEASUREMENT
/begin MEASUREMENT B_ftufspsc "Bedingung: Fehlereintrag durch Tester:Pedalwertgeber-,Zuleitung oder SG-Fehler" UWORD B_TRUE 1 100 0 1 BIT_MASK 0x10 FORMAT "%13.11" ECU_ADDRESS 0x3FDE46 /end MEASUREMENT
/begin MEASUREMENT B_fturram "" UWORD B_TRUE 1 100 0 1 BIT_MASK 0x10 FORMAT "%13.11" ECU_ADDRESS 0x3FDE48 /end MEASUREMENT
/begin MEASUREMENT B_fturrom "" UWORD B_TRUE 1 100 0 1 BIT_MASK 0x10 FORMAT "%13.11" ECU_ADDRESS 0x3FDE4A /end MEASUREMENT
/begin MEASUREMENT B_fturrst "" UWORD B_TRUE 1 100 0 1 BIT_MASK 0x10 FORMAT "%13.11" ECU_ADDRESS 0x3FDE4C /end MEASUREMENT
/begin MEASUREMENT B_ftvfz "Bedingung Fehlereintrag durch Tester f¸r Fehlerpfad VFZ" UWORD B_TRUE 1 100 0 1 BIT_MASK 0x10 FORMAT "%13.11" ECU_ADDRESS 0x3FDE4E /end MEASUREMENT
/begin MEASUREMENT B_gfbsupep "" UBYTE B_TRUE 1 100 0 1 FORMAT "%13.11" ECU_ADDRESS 0x5B891B /end MEASUREMENT
/begin MEASUREMENT B_gfelep "" UBYTE B_TRUE 1 100 0 1 FORMAT "%13.11" ECU_ADDRESS 0x5B891C /end MEASUREMENT
/begin MEASUREMENT B_gfhtep "" UBYTE B_TRUE 1 100 0 1 FORMAT "%13.11" ECU_ADDRESS 0x5B891D /end MEASUREMENT
/begin MEASUREMENT B_gfmeep "" UBYTE B_TRUE 1 100 0 1 FORMAT "%13.11" ECU_ADDRESS 0x5B891E /end MEASUREMENT
/begin MEASUREMENT B_gfnobsep "" UBYTE B_TRUE 1 100 0 1 FORMAT "%13.11" ECU_ADDRESS 0x5B891F /end MEASUREMENT
/begin MEASUREMENT B_hfm "Bedingung HFM messbereit" UBYTE B_TRUE 1 100 0 1 BIT_MASK 0x1 FORMAT "%13.11" ECU_ADDRESS 0x3FBD23 /end MEASUREMENT
/begin MEASUREMENT B_hsrdy "Bedingung Sondenheizung gepr¸ft f¸r 'ready-Byte'" UBYTE B_TRUE 1 100 0 1 BIT_MASK 0x40 FORMAT "%13.11" ECU_ADDRESS 0x3FD804 /end MEASUREMENT
/begin MEASUREMENT B_kathrdy "Bedingung Katalysator-Heizungen gepr¸ft f¸r 'ready-Byte'" UBYTE B_TRUE 1 100 0 1 BIT_MASK 0x2 FORMAT "%13.11" ECU_ADDRESS 0x3FD804 /end MEASUREMENT
/begin MEASUREMENT B_katrdy "Bedingung Katalysatoren gepr¸ft f¸r 'ready-Byte'" UBYTE B_TRUE 1 100 0 1 BIT_MASK 0x1 FORMAT "%13.11" ECU_ADDRESS 0x3FD804 /end MEASUREMENT
/begin MEASUREMENT B_kkrdy "Bedingung Klimak¸hlmittel gepr¸ft f¸r 'ready-Byte'" UBYTE B_TRUE 1 100 0 1 BIT_MASK 0x10 FORMAT "%13.11" ECU_ADDRESS 0x3FD804 /end MEASUREMENT
/begin MEASUREMENT B_kl61 "Bedingung Klemme 61" UBYTE B_TRUE 1 100 0 1 FORMAT "%13.11" ECU_ADDRESS 0x5B8B66 /end MEASUREMENT
/begin MEASUREMENT B_lsrdy "Bedingung Lambda-Sonden gepr¸ft f¸r 'ready-Byte'" UBYTE B_TRUE 1 100 0 1 BIT_MASK 0x20 FORMAT "%13.11" ECU_ADDRESS 0x3FD804 /end MEASUREMENT
/begin MEASUREMENT B_mnbrems "Fehlertyp BREMS (Bremssschalter): Minimalwert unterschritten" UWORD B_TRUE 1 100 0 1 BIT_MASK 0x200 FORMAT "%13.11" ECU_ADDRESS 0x3FDD28 /end MEASUREMENT
/begin MEASUREMENT B_mnbwf "Fehlertyp min.: PWG Bewegung" UWORD B_TRUE 1 100 0 1 BIT_MASK 0x200 FORMAT "%13.11" ECU_ADDRESS 0x3FDD2A /end MEASUREMENT
/begin MEASUREMENT B_mndgen "" UWORD B_TRUE 1 100 0 1 BIT_MASK 0x200 FORMAT "%13.11" ECU_ADDRESS 0x3FDD3A /end MEASUREMENT
/begin MEASUREMENT B_mndgenbs "" UWORD B_TRUE 1 100 0 1 BIT_MASK 0x200 FORMAT "%13.11" ECU_ADDRESS 0x3FDD3C /end MEASUREMENT
/begin MEASUREMENT B_mndsu "Bedingung: min-Fehler Umgebungsdrucksensor" UWORD B_TRUE 1 100 0 1 BIT_MASK 0x200 FORMAT "%13.11" ECU_ADDRESS 0x3FDD4C /end MEASUREMENT
/begin MEASUREMENT B_mndwa "Fehlertyp min.: Diebstahlwarnanlage" UWORD B_TRUE 1 100 0 1 BIT_MASK 0x200 FORMAT "%13.11" ECU_ADDRESS 0x3FDD64 /end MEASUREMENT
/begin MEASUREMENT B_mndzku0 "Minfehler Z¸ndkreis¸berwachung" UWORD B_TRUE 1 100 0 1 BIT_MASK 0x200 FORMAT "%13.11" ECU_ADDRESS 0x3FDD66 /end MEASUREMENT
/begin MEASUREMENT B_mndzku1 "Minfehler Z¸ndkreis¸berwachung" UWORD B_TRUE 1 100 0 1 BIT_MASK 0x200 FORMAT "%13.11" ECU_ADDRESS 0x3FDD68 /end MEASUREMENT
/begin MEASUREMENT B_mndzku2 "Minfehler Z¸ndkreis¸berwachung" UWORD B_TRUE 1 100 0 1 BIT_MASK 0x200 FORMAT "%13.11" ECU_ADDRESS 0x3FDD6A /end MEASUREMENT
/begin MEASUREMENT B_mndzku3 "Minfehler Z¸ndkreis¸berwachung" UWORD B_TRUE 1 100 0 1 BIT_MASK 0x200 FORMAT "%13.11" ECU_ADDRESS 0x3FDD6C /end MEASUREMENT
/begin MEASUREMENT B_mndzku4 "Minfehler Z¸ndkreis¸berwachung" UWORD B_TRUE 1 100 0 1 BIT_MASK 0x200 FORMAT "%13.11" ECU_ADDRESS 0x3FDD6E /end MEASUREMENT
/begin MEASUREMENT B_mndzku5 "Minfehler Z¸ndkreis¸berwachung" UWORD B_TRUE 1 100 0 1 BIT_MASK 0x200 FORMAT "%13.11" ECU_ADDRESS 0x3FDD70 /end MEASUREMENT
/begin MEASUREMENT B_mndzku6 "Minfehler Z¸ndkreis¸berwachung" UWORD B_TRUE 1 100 0 1 BIT_MASK 0x200 FORMAT "%13.11" ECU_ADDRESS 0x3FDD72 /end MEASUREMENT
/begin MEASUREMENT B_mndzku7 "Minfehler Z¸ndkreis¸berwachung" UWORD B_TRUE 1 100 0 1 BIT_MASK 0x200 FORMAT "%13.11" ECU_ADDRESS 0x3FDD74 /end MEASUREMENT
/begin MEASUREMENT B_mnegfe "Bedingung: MIN-Fehler Eingangsgrˆﬂen F¸llungserfassung" UWORD B_TRUE 1 100 0 1 BIT_MASK 0x200 FORMAT "%13.11" ECU_ADDRESS 0x3FDD76 /end MEASUREMENT
/begin MEASUREMENT B_mnfhsh "Kurzschluﬂ Heizung Lambdasonde hinter Kat nach Masse" UBYTE B_TRUE 1 100 0 1 BIT_MASK 0x1 FORMAT "%13.11" ECU_ADDRESS 0x3FBC87 /end MEASUREMENT
/begin MEASUREMENT B_mnfhsv "Kurzschluﬂ Heizung Lambdasonde vor Kat nach Masse" UBYTE B_TRUE 1 100 0 1 BIT_MASK 0x1 FORMAT "%13.11" ECU_ADDRESS 0x3FBC88 /end MEASUREMENT
/begin MEASUREMENT B_mnfp1p "Fehlertyp min.: Fahrpedal 1. Poti" UWORD B_TRUE 1 100 0 1 BIT_MASK 0x200 FORMAT "%13.11" ECU_ADDRESS 0x3FDD92 /end MEASUREMENT
/begin MEASUREMENT B_mnfp2p "Fehlertyp min.: Fahrpedal 2. Poti" UWORD B_TRUE 1 100 0 1 BIT_MASK 0x200 FORMAT "%13.11" ECU_ADDRESS 0x3FDD94 /end MEASUREMENT
/begin MEASUREMENT B_mnfpp "Fehlertyp min.: Fahrpedal Potentiometer" UWORD B_TRUE 1 100 0 1 BIT_MASK 0x200 FORMAT "%13.11" ECU_ADDRESS 0x3FDD96 /end MEASUREMENT
/begin MEASUREMENT B_mnhfm "Bedingung untere Plausibilit‰tsschwelle unterschritten" UBYTE B_TRUE 1 100 0 1 BIT_MASK 0x1 FORMAT "%13.11" ECU_ADDRESS 0x3FBD24 /end MEASUREMENT
/begin MEASUREMENT B_mnmdb "Fehlertyp min.: Momentan¸berwachung begrenzt dauerhaft" UWORD B_TRUE 1 100 0 1 BIT_MASK 0x200 FORMAT "%13.11" ECU_ADDRESS 0x3FDDFA /end MEASUREMENT
/begin MEASUREMENT B_mnmfl "Fehlerart Minfehler: MFL-Signal weist Frequenzfehler auf" UWORD B_TRUE 1 100 0 1 BIT_MASK 0x200 FORMAT "%13.11" ECU_ADDRESS 0x3FDDFE /end MEASUREMENT
/begin MEASUREMENT B_mnta "Fehlertyp: Minimalwertunterschreitung Ansauglufttemperatur TANS" UWORD B_TRUE 1 100 0 1 BIT_MASK 0x200 FORMAT "%13.11" ECU_ADDRESS 0x3FDE26 /end MEASUREMENT
/begin MEASUREMENT B_mntka "Fehlertyp: Minimalwertunterschreitung Temperatur K¸hlerausgang" UWORD B_TRUE 1 100 0 1 BIT_MASK 0x200 FORMAT "%13.11" ECU_ADDRESS 0x3FDE2E /end MEASUREMENT
/begin MEASUREMENT B_mntm "Fehlertyp: Minimalwertunterschreitung Motortemperatur" UWORD B_TRUE 1 100 0 1 BIT_MASK 0x200 FORMAT "%13.11" ECU_ADDRESS 0x3FDE30 /end MEASUREMENT
/begin MEASUREMENT B_mntum "Fehlertyp: Minimalwertunterschreitung Umgebungstemperatur" UWORD B_TRUE 1 100 0 1 BIT_MASK 0x200 FORMAT "%13.11" ECU_ADDRESS 0x3FDE34 /end MEASUREMENT
/begin MEASUREMENT B_mnub "Fehlertyp: Minimalwertunterschreitung Batteriespannung (Bordnetz)" UWORD B_TRUE 1 100 0 1 BIT_MASK 0x200 FORMAT "%13.11" ECU_ADDRESS 0x3FDE36 /end MEASUREMENT
/begin MEASUREMENT B_mnubr "Fehlertyp: Minimalwertunterschreitung Bordnetzspannung ¸ber Hauptrelais" UWORD B_TRUE 1 100 0 1 BIT_MASK 0x200 FORMAT "%13.11" ECU_ADDRESS 0x3FDE38 /end MEASUREMENT
/begin MEASUREMENT B_mnufmv "Fehlertyp min.: Funktions¸berwachung: Momentenvergleich" UWORD B_TRUE 1 100 0 1 BIT_MASK 0x200 FORMAT "%13.11" ECU_ADDRESS 0x3FDE3A /end MEASUREMENT
/begin MEASUREMENT B_mnufnc "Fehlertyp min.:Fkt¸berwachung:Drehzahlgeber-,Zuleitung- oder SG-Fehler" UWORD B_TRUE 1 100 0 1 BIT_MASK 0x200 FORMAT "%13.11" ECU_ADDRESS 0x3FDE3C /end MEASUREMENT
/begin MEASUREMENT B_mnufrlip "Fehlertyp min.: Fkt¸berw: Lastsensor-, Zuleitung- oder SG-Fehler (ei_dps_um)" UWORD B_TRUE 1 100 0 1 BIT_MASK 0x200 FORMAT "%13.11" ECU_ADDRESS 0x3FDE3E /end MEASUREMENT
/begin MEASUREMENT B_mnufsga "Fehlertyp min.: Funktions¸berwachung: Steuerger‰te-Fehler Gruppe a (ei_zwc_um)" UWORD B_TRUE 1 100 0 1 BIT_MASK 0x200 FORMAT "%13.11" ECU_ADDRESS 0x3FDE40 /end MEASUREMENT
/begin MEASUREMENT B_mnufsgb "Fehlertyp min.: Funktions¸berwachung: Steuerger‰te-Fehler Gruppe b (ei_rkti_um)" UWORD B_TRUE 1 100 0 1 BIT_MASK 0x200 FORMAT "%13.11" ECU_ADDRESS 0x3FDE42 /end MEASUREMENT
/begin MEASUREMENT B_mnufsgc "Fehlertyp min.:Fkt¸berwachung:SG-Fehler Gruppe c" UWORD B_TRUE 1 100 0 1 BIT_MASK 0x200 FORMAT "%13.11" ECU_ADDRESS 0x3FDE44 /end MEASUREMENT
/begin MEASUREMENT B_mnufspsc "Fehlertyp min.:Fkt¸berwachung:Pedalwertgeber-,Zuleitung- oder SG-Fehler" UWORD B_TRUE 1 100 0 1 BIT_MASK 0x200 FORMAT "%13.11" ECU_ADDRESS 0x3FDE46 /end MEASUREMENT
/begin MEASUREMENT B_mnurram "Fehlertyp min.: Rechner¸berwachung: RAM" UWORD B_TRUE 1 100 0 1 BIT_MASK 0x200 FORMAT "%13.11" ECU_ADDRESS 0x3FDE48 /end MEASUREMENT
/begin MEASUREMENT B_mnurrom "Fehlertyp min.: Rechner¸berwachung: ROM" UWORD B_TRUE 1 100 0 1 BIT_MASK 0x200 FORMAT "%13.11" ECU_ADDRESS 0x3FDE4A /end MEASUREMENT
/begin MEASUREMENT B_mnurrst "Fehlertyp min.: Rechner¸berwachung: Reset" UWORD B_TRUE 1 100 0 1 BIT_MASK 0x200 FORMAT "%13.11" ECU_ADDRESS 0x3FDE4C /end MEASUREMENT
/begin MEASUREMENT B_mnvfz "Fehlertyp min,: Fahrzeuggeschwindigkeit" UWORD B_TRUE 1 100 0 1 BIT_MASK 0x200 FORMAT "%13.11" ECU_ADDRESS 0x3FDE4E /end MEASUREMENT
/begin MEASUREMENT B_mnwca "Fehlertyp min.: Wegfahrsperre Wechselcode-Ablage" UWORD B_TRUE 1 100 0 1 BIT_MASK 0x200 FORMAT "%13.11" ECU_ADDRESS 0x3FDE50 /end MEASUREMENT
/begin MEASUREMENT B_mnwfs "Fehlertyp min.: Wegfahrsperre" UWORD B_TRUE 1 100 0 1 BIT_MASK 0x200 FORMAT "%13.11" ECU_ADDRESS 0x3FDE52 /end MEASUREMENT
/begin MEASUREMENT B_mxbrems "Fehlertyp BREMS (Bremsschalter): Maximalwert ¸berschritten" UWORD B_TRUE 1 100 0 1 BIT_MASK 0x100 FORMAT "%13.11" ECU_ADDRESS 0x3FDD28 /end MEASUREMENT
/begin MEASUREMENT B_mxbwf "Fehlertyp max.: PWG Bewegung" UWORD B_TRUE 1 100 0 1 BIT_MASK 0x100 FORMAT "%13.11" ECU_ADDRESS 0x3FDD2A /end MEASUREMENT
/begin MEASUREMENT B_mxdgen "" UWORD B_TRUE 1 100 0 1 BIT_MASK 0x100 FORMAT "%13.11" ECU_ADDRESS 0x3FDD3A /end MEASUREMENT
/begin MEASUREMENT B_mxdgenbs "" UWORD B_TRUE 1 100 0 1 BIT_MASK 0x100 FORMAT "%13.11" ECU_ADDRESS 0x3FDD3C /end MEASUREMENT
/begin MEASUREMENT B_mxdsu "Bedingung: max-Fehler Umgebungsdrucksensor" UWORD B_TRUE 1 100 0 1 BIT_MASK 0x100 FORMAT "%13.11" ECU_ADDRESS 0x3FDD4C /end MEASUREMENT
/begin MEASUREMENT B_mxdwa "Fehlertyp max.: Diebstahlwarnanlage" UWORD B_TRUE 1 100 0 1 BIT_MASK 0x100 FORMAT "%13.11" ECU_ADDRESS 0x3FDD64 /end MEASUREMENT
/begin MEASUREMENT B_mxdzku0 "Maxfehler Z¸ndkreis¸berwachung" UWORD B_TRUE 1 100 0 1 BIT_MASK 0x100 FORMAT "%13.11" ECU_ADDRESS 0x3FDD66 /end MEASUREMENT
/begin MEASUREMENT B_mxdzku1 "Maxfehler Z¸ndkreis¸berwachung" UWORD B_TRUE 1 100 0 1 BIT_MASK 0x100 FORMAT "%13.11" ECU_ADDRESS 0x3FDD68 /end MEASUREMENT
/begin MEASUREMENT B_mxdzku2 "Maxfehler Z¸ndkreis¸berwachung" UWORD B_TRUE 1 100 0 1 BIT_MASK 0x100 FORMAT "%13.11" ECU_ADDRESS 0x3FDD6A /end MEASUREMENT
/begin MEASUREMENT B_mxdzku3 "Maxfehler Z¸ndkreis¸berwachung" UWORD B_TRUE 1 100 0 1 BIT_MASK 0x100 FORMAT "%13.11" ECU_ADDRESS 0x3FDD6C /end MEASUREMENT
/begin MEASUREMENT B_mxdzku4 "Maxfehler Z¸ndkreis¸berwachung" UWORD B_TRUE 1 100 0 1 BIT_MASK 0x100 FORMAT "%13.11" ECU_ADDRESS 0x3FDD6E /end MEASUREMENT
/begin MEASUREMENT B_mxdzku5 "Maxfehler Z¸ndkreis¸berwachung" UWORD B_TRUE 1 100 0 1 BIT_MASK 0x100 FORMAT "%13.11" ECU_ADDRESS 0x3FDD70 /end MEASUREMENT
/begin MEASUREMENT B_mxdzku6 "Maxfehler Z¸ndkreis¸berwachung" UWORD B_TRUE 1 100 0 1 BIT_MASK 0x100 FORMAT "%13.11" ECU_ADDRESS 0x3FDD72 /end MEASUREMENT
/begin MEASUREMENT B_mxdzku7 "Maxfehler Z¸ndkreis¸berwachung" UWORD B_TRUE 1 100 0 1 BIT_MASK 0x100 FORMAT "%13.11" ECU_ADDRESS 0x3FDD74 /end MEASUREMENT
/begin MEASUREMENT B_mxegfe "Bedingung: MAX-Fehler Eingangsgrˆﬂen F¸llungserfassung" UWORD B_TRUE 1 100 0 1 BIT_MASK 0x100 FORMAT "%13.11" ECU_ADDRESS 0x3FDD76 /end MEASUREMENT
/begin MEASUREMENT B_mxfhsh "Kurzschluﬂ Heizung Lambdasonde hinter Kat nach UB" UBYTE B_TRUE 1 100 0 1 BIT_MASK 0x1 FORMAT "%13.11" ECU_ADDRESS 0x3FBC89 /end MEASUREMENT
/begin MEASUREMENT B_mxfhsv "Kurzschluﬂ Heizung Lambdasonde vor Kat nach UB" UBYTE B_TRUE 1 100 0 1 BIT_MASK 0x1 FORMAT "%13.11" ECU_ADDRESS 0x3FBC8A /end MEASUREMENT
/begin MEASUREMENT B_mxfp1p "Fehlertyp max.: Fahrpedal 1. Poti" UWORD B_TRUE 1 100 0 1 BIT_MASK 0x100 FORMAT "%13.11" ECU_ADDRESS 0x3FDD92 /end MEASUREMENT
/begin MEASUREMENT B_mxfp2p "Fehlertyp max.: Fahrpedal 2. Poti" UWORD B_TRUE 1 100 0 1 BIT_MASK 0x100 FORMAT "%13.11" ECU_ADDRESS 0x3FDD94 /end MEASUREMENT
/begin MEASUREMENT B_mxfpp "Fehlertyp max.: Fahrpedal Potentiometer" UWORD B_TRUE 1 100 0 1 BIT_MASK 0x100 FORMAT "%13.11" ECU_ADDRESS 0x3FDD96 /end MEASUREMENT
/begin MEASUREMENT B_mxhfm "Bedingung obere Plausibilit‰tsschwelle HFM ¸berschritten" UBYTE B_TRUE 1 100 0 1 BIT_MASK 0x1 FORMAT "%13.11" ECU_ADDRESS 0x3FBD25 /end MEASUREMENT
/begin MEASUREMENT B_mxmdb "Fehlerart: Maximal zul‰ssiges Sollmoment wird dauerhaft ¸berschritten" UWORD B_TRUE 1 100 0 1 BIT_MASK 0x100 FORMAT "%13.11" ECU_ADDRESS 0x3FDDFA /end MEASUREMENT
/begin MEASUREMENT B_mxmfl "Fehlerart Maxfehler: MFL-Signal weist Toggelbitfehler auf" UWORD B_TRUE 1 100 0 1 BIT_MASK 0x100 FORMAT "%13.11" ECU_ADDRESS 0x3FDDFE /end MEASUREMENT
/begin MEASUREMENT B_mxta "Fehlertyp: Maximalwert¸berschreitung Ansauglufttemperatur TANS" UWORD B_TRUE 1 100 0 1 BIT_MASK 0x100 FORMAT "%13.11" ECU_ADDRESS 0x3FDE26 /end MEASUREMENT
/begin MEASUREMENT B_mxtka "Fehlertyp: Maximalwert¸berschreitung Temperatur K¸hlerausgang" UWORD B_TRUE 1 100 0 1 BIT_MASK 0x100 FORMAT "%13.11" ECU_ADDRESS 0x3FDE2E /end MEASUREMENT
/begin MEASUREMENT B_mxtm "Fehlertyp: Maximalwert¸berschreitung Motortemperatur" UWORD B_TRUE 1 100 0 1 BIT_MASK 0x100 FORMAT "%13.11" ECU_ADDRESS 0x3FDE30 /end MEASUREMENT
/begin MEASUREMENT B_mxtum "Fehlertyp: Maximalwert¸berschreitung Umgebungstemperatur" UWORD B_TRUE 1 100 0 1 BIT_MASK 0x100 FORMAT "%13.11" ECU_ADDRESS 0x3FDE34 /end MEASUREMENT
/begin MEASUREMENT B_mxub "Fehlertyp: Maximalwert¸berschreitung Batteriespannung (Bordnetz)" UWORD B_TRUE 1 100 0 1 BIT_MASK 0x100 FORMAT "%13.11" ECU_ADDRESS 0x3FDE36 /end MEASUREMENT
/begin MEASUREMENT B_mxubr "Fehlertyp: Maximalwert¸berschreitung Bordnetzspannung ¸ber Hauptrelais" UWORD B_TRUE 1 100 0 1 BIT_MASK 0x100 FORMAT "%13.11" ECU_ADDRESS 0x3FDE38 /end MEASUREMENT
/begin MEASUREMENT B_mxufmv "Fehlertyp max.: Funktions¸berwachung: Momentenvergleich" UWORD B_TRUE 1 100 0 1 BIT_MASK 0x100 FORMAT "%13.11" ECU_ADDRESS 0x3FDE3A /end MEASUREMENT
/begin MEASUREMENT B_mxufnc "Fehlertyp max.:Fkt¸berwachung:Drehzahlgeber-,Zuleitung- oder SG-Fehler" UWORD B_TRUE 1 100 0 1 BIT_MASK 0x100 FORMAT "%13.11" ECU_ADDRESS 0x3FDE3C /end MEASUREMENT
/begin MEASUREMENT B_mxufrlip "Fehlertyp max.:Fkt¸berwachung:Lastsensor-,Zuleitung oder SG-Fehler" UWORD B_TRUE 1 100 0 1 BIT_MASK 0x100 FORMAT "%13.11" ECU_ADDRESS 0x3FDE3E /end MEASUREMENT
/begin MEASUREMENT B_mxufsga "Fehlertyp max.: Funktions¸berwachung: Steuerger‰te-Fehler Gruppe a (ei_rlc_um)" UWORD B_TRUE 1 100 0 1 BIT_MASK 0x100 FORMAT "%13.11" ECU_ADDRESS 0x3FDE40 /end MEASUREMENT
/begin MEASUREMENT B_mxufsgb "Fehlertyp max.: Funktions¸berwachung: Steuerger‰te-Fehler Gruppe b (ei_gkc_um)" UWORD B_TRUE 1 100 0 1 BIT_MASK 0x100 FORMAT "%13.11" ECU_ADDRESS 0x3FDE42 /end MEASUREMENT
/begin MEASUREMENT B_mxufsgc "Fehlertyp max.: Funktions¸berwachung: Steuerger‰te-Fehler Gruppe c (ei_tpu_um)" UWORD B_TRUE 1 100 0 1 BIT_MASK 0x100 FORMAT "%13.11" ECU_ADDRESS 0x3FDE44 /end MEASUREMENT
/begin MEASUREMENT B_mxufspsc "Fehlertyp max.:Fkt¸berwachung:Pedalwergeber-,Zuleitung-oder SG-Fehler" UWORD B_TRUE 1 100 0 1 BIT_MASK 0x100 FORMAT "%13.11" ECU_ADDRESS 0x3FDE46 /end MEASUREMENT
/begin MEASUREMENT B_mxurram "Fehlertyp max.: Rechner¸berwachung: RAM" UWORD B_TRUE 1 100 0 1 BIT_MASK 0x100 FORMAT "%13.11" ECU_ADDRESS 0x3FDE48 /end MEASUREMENT
/begin MEASUREMENT B_mxurrom "Fehlertyp max.: Rechner¸berwachung: ROM" UWORD B_TRUE 1 100 0 1 BIT_MASK 0x100 FORMAT "%13.11" ECU_ADDRESS 0x3FDE4A /end MEASUREMENT
/begin MEASUREMENT B_mxurrst "Fehlertyp max.: Rechner¸berwachung: Reset" UWORD B_TRUE 1 100 0 1 BIT_MASK 0x100 FORMAT "%13.11" ECU_ADDRESS 0x3FDE4C /end MEASUREMENT
/begin MEASUREMENT B_mxvfz "Fehlertyp max.: Fahrzeuggeschwindigkeit" UWORD B_TRUE 1 100 0 1 BIT_MASK 0x100 FORMAT "%13.11" ECU_ADDRESS 0x3FDE4E /end MEASUREMENT
/begin MEASUREMENT B_mxwca "Fehlertyp max.: Wegfahrsperre Wechselcode-Ablage" UWORD B_TRUE 1 100 0 1 BIT_MASK 0x100 FORMAT "%13.11" ECU_ADDRESS 0x3FDE50 /end MEASUREMENT
/begin MEASUREMENT B_mxwfs "Fehlertyp max.: Wegfahrsperre" UWORD B_TRUE 1 100 0 1 BIT_MASK 0x100 FORMAT "%13.11" ECU_ADDRESS 0x3FDE52 /end MEASUREMENT
/begin MEASUREMENT B_npbrems "Fehlertyp BREMS (Bremsschalter): Pr¸fresultat nicht plausibel" UWORD B_TRUE 1 100 0 1 BIT_MASK 0x800 FORMAT "%13.11" ECU_ADDRESS 0x3FDD28 /end MEASUREMENT
/begin MEASUREMENT B_npbwf "Fehlertyp unplaus.: PWG Bewegung" UWORD B_TRUE 1 100 0 1 BIT_MASK 0x800 FORMAT "%13.11" ECU_ADDRESS 0x3FDD2A /end MEASUREMENT
/begin MEASUREMENT B_npdgen "" UWORD B_TRUE 1 100 0 1 BIT_MASK 0x800 FORMAT "%13.11" ECU_ADDRESS 0x3FDD3A /end MEASUREMENT
/begin MEASUREMENT B_npdgenbs "" UWORD B_TRUE 1 100 0 1 BIT_MASK 0x800 FORMAT "%13.11" ECU_ADDRESS 0x3FDD3C /end MEASUREMENT
/begin MEASUREMENT B_npdsu "Bedingung: Umgebungsdrucksensor nicht plausibel" UWORD B_TRUE 1 100 0 1 BIT_MASK 0x800 FORMAT "%13.11" ECU_ADDRESS 0x3FDD4C /end MEASUREMENT
/begin MEASUREMENT B_npdwa "Fehlertyp unplausibel: Diebstahlwarnanlage" UWORD B_TRUE 1 100 0 1 BIT_MASK 0x800 FORMAT "%13.11" ECU_ADDRESS 0x3FDD64 /end MEASUREMENT
/begin MEASUREMENT B_npdzku0 "Fehler  nicht plausibles Signal Z¸ndkreis¸berwachung" UWORD B_TRUE 1 100 0 1 BIT_MASK 0x800 FORMAT "%13.11" ECU_ADDRESS 0x3FDD66 /end MEASUREMENT
/begin MEASUREMENT B_npdzku1 "Fehler  nicht plausibles Signal Z¸ndkreis¸berwachung" UWORD B_TRUE 1 100 0 1 BIT_MASK 0x800 FORMAT "%13.11" ECU_ADDRESS 0x3FDD68 /end MEASUREMENT
/begin MEASUREMENT B_npdzku2 "Fehler  nicht plausibles Signal Z¸ndkreis¸berwachung" UWORD B_TRUE 1 100 0 1 BIT_MASK 0x800 FORMAT "%13.11" ECU_ADDRESS 0x3FDD6A /end MEASUREMENT
/begin MEASUREMENT B_npdzku3 "Fehler  nicht plausibles Signal Z¸ndkreis¸berwachung" UWORD B_TRUE 1 100 0 1 BIT_MASK 0x800 FORMAT "%13.11" ECU_ADDRESS 0x3FDD6C /end MEASUREMENT
/begin MEASUREMENT B_npdzku4 "Fehler  nicht plausibles Signal Z¸ndkreis¸berwachung" UWORD B_TRUE 1 100 0 1 BIT_MASK 0x800 FORMAT "%13.11" ECU_ADDRESS 0x3FDD6E /end MEASUREMENT
/begin MEASUREMENT B_npdzku5 "Fehler  nicht plausibles Signal Z¸ndkreis¸berwachung" UWORD B_TRUE 1 100 0 1 BIT_MASK 0x800 FORMAT "%13.11" ECU_ADDRESS 0x3FDD70 /end MEASUREMENT
/begin MEASUREMENT B_npdzku6 "Fehler  nicht plausibles Signal Z¸ndkreis¸berwachung" UWORD B_TRUE 1 100 0 1 BIT_MASK 0x800 FORMAT "%13.11" ECU_ADDRESS 0x3FDD72 /end MEASUREMENT
/begin MEASUREMENT B_npdzku7 "Fehler  nicht plausibles Signal Z¸ndkreis¸berwachung" UWORD B_TRUE 1 100 0 1 BIT_MASK 0x800 FORMAT "%13.11" ECU_ADDRESS 0x3FDD74 /end MEASUREMENT
/begin MEASUREMENT B_npegfe "Bedingung: unplausibler Wert bei den Eingangsgrˆﬂen der F¸llungserfassung" UWORD B_TRUE 1 100 0 1 BIT_MASK 0x800 FORMAT "%13.11" ECU_ADDRESS 0x3FDD76 /end MEASUREMENT
/begin MEASUREMENT B_npfhsh "Nernstwiderstand Sonde hinter Kat zu groﬂ" UBYTE B_TRUE 1 100 0 1 BIT_MASK 0x1 FORMAT "%13.11" ECU_ADDRESS 0x3FBC8B /end MEASUREMENT
/begin MEASUREMENT B_npfhsv "Nernstwiderstand Sonde vor Kat zu groﬂ" UBYTE B_TRUE 1 100 0 1 BIT_MASK 0x1 FORMAT "%13.11" ECU_ADDRESS 0x3FBC8C /end MEASUREMENT
/begin MEASUREMENT B_npfp1p "Fehlertyp unplaus.: Fahrpedal 1. Poti" UWORD B_TRUE 1 100 0 1 BIT_MASK 0x800 FORMAT "%13.11" ECU_ADDRESS 0x3FDD92 /end MEASUREMENT
/begin MEASUREMENT B_npfp2p "Fehlertyp unplaus.: Fahrpedal 2. Poti" UWORD B_TRUE 1 100 0 1 BIT_MASK 0x800 FORMAT "%13.11" ECU_ADDRESS 0x3FDD94 /end MEASUREMENT
/begin MEASUREMENT B_npfpp "Bedingung unplausible Potisignale vom Fahrpedal" UWORD B_TRUE 1 100 0 1 BIT_MASK 0x800 FORMAT "%13.11" ECU_ADDRESS 0x3FDD96 /end MEASUREMENT
/begin MEASUREMENT B_npmdb "Nicht plausibler Fehler: Momentan¸berwachung begrenzt dauerhaft" UWORD B_TRUE 1 100 0 1 BIT_MASK 0x800 FORMAT "%13.11" ECU_ADDRESS 0x3FDDFA /end MEASUREMENT
/begin MEASUREMENT B_npmfl "Fehlerart NP: MFL-Signal nicht plausibel" UWORD B_TRUE 1 100 0 1 BIT_MASK 0x800 FORMAT "%13.11" ECU_ADDRESS 0x3FDDFE /end MEASUREMENT
/begin MEASUREMENT B_npta "Fehlertyp unplaus.: Ansauglufttemperatur TANS (-Ladeluft)" UWORD B_TRUE 1 100 0 1 BIT_MASK 0x800 FORMAT "%13.11" ECU_ADDRESS 0x3FDE26 /end MEASUREMENT
/begin MEASUREMENT B_nptka "" UWORD B_TRUE 1 100 0 1 BIT_MASK 0x800 FORMAT "%13.11" ECU_ADDRESS 0x3FDE2E /end MEASUREMENT
/begin MEASUREMENT B_nptm "Fehlerart: Motortemperatursignal nicht plausibel gg¸. Modell" UWORD B_TRUE 1 100 0 1 BIT_MASK 0x800 FORMAT "%13.11" ECU_ADDRESS 0x3FDE30 /end MEASUREMENT
/begin MEASUREMENT B_nptum "Fehlerart: Signal Umgebungstemperatur unplausibel" UWORD B_TRUE 1 100 0 1 BIT_MASK 0x800 FORMAT "%13.11" ECU_ADDRESS 0x3FDE34 /end MEASUREMENT
/begin MEASUREMENT B_npub "Fehlerart: Batteriespannungssignal nicht plausibel" UWORD B_TRUE 1 100 0 1 BIT_MASK 0x800 FORMAT "%13.11" ECU_ADDRESS 0x3FDE36 /end MEASUREMENT
/begin MEASUREMENT B_npubr "Fehlerart: Signal von Bordspannung ¸ber Hauptrelais nicht plausibel" UWORD B_TRUE 1 100 0 1 BIT_MASK 0x800 FORMAT "%13.11" ECU_ADDRESS 0x3FDE38 /end MEASUREMENT
/begin MEASUREMENT B_npufmv "Fehlertyp unplaus.: Funktions¸berwachung: Momentenvergleich" UWORD B_TRUE 1 100 0 1 BIT_MASK 0x800 FORMAT "%13.11" ECU_ADDRESS 0x3FDE3A /end MEASUREMENT
/begin MEASUREMENT B_npufnc "Fehlertyp unplaus.: Fkt¸berwachung: Drehzahlgeber-, Zuleitung- oder SG-Fehler" UWORD B_TRUE 1 100 0 1 BIT_MASK 0x800 FORMAT "%13.11" ECU_ADDRESS 0x3FDE3C /end MEASUREMENT
/begin MEASUREMENT B_npufrlip "Fehlertyp unplaus.: Fkt¸berw: Lastsensor-, Zuleitung-oder SG-Fehler (ei_rlip_um)" UWORD B_TRUE 1 100 0 1 BIT_MASK 0x800 FORMAT "%13.11" ECU_ADDRESS 0x3FDE3E /end MEASUREMENT
/begin MEASUREMENT B_npufsga "Fehlertyp unplaus.: Funktions¸berwach: Steuerger‰te-Fehler Gruppe a (ei_reac_um)" UWORD B_TRUE 1 100 0 1 BIT_MASK 0x800 FORMAT "%13.11" ECU_ADDRESS 0x3FDE40 /end MEASUREMENT
/begin MEASUREMENT B_npufsgb "Fehlertyp unplaus.: Funktions¸berwach: Steuerger‰te-Fehler Gruppe b (ei_ipa_um)" UWORD B_TRUE 1 100 0 1 BIT_MASK 0x800 FORMAT "%13.11" ECU_ADDRESS 0x3FDE42 /end MEASUREMENT
/begin MEASUREMENT B_npufsgc "Fehlertyp unplaus.:Funktions¸berwachung:SG-Fehler Gruppe c" UWORD B_TRUE 1 100 0 1 BIT_MASK 0x800 FORMAT "%13.11" ECU_ADDRESS 0x3FDE44 /end MEASUREMENT
/begin MEASUREMENT B_npufspsc "Fehlertyp unplaus.: Fkt¸berwachung: Pedalwertgeber-, Zuleitung- oder SG-Fehler" UWORD B_TRUE 1 100 0 1 BIT_MASK 0x800 FORMAT "%13.11" ECU_ADDRESS 0x3FDE46 /end MEASUREMENT
/begin MEASUREMENT B_npurram "Fehlertyp unplaus: Rechner¸berwachung: RAM" UWORD B_TRUE 1 100 0 1 BIT_MASK 0x800 FORMAT "%13.11" ECU_ADDRESS 0x3FDE48 /end MEASUREMENT
/begin MEASUREMENT B_npurrom "Fehlertyp unplaus.: Rechner¸berwachung: ROM" UWORD B_TRUE 1 100 0 1 BIT_MASK 0x800 FORMAT "%13.11" ECU_ADDRESS 0x3FDE4A /end MEASUREMENT
/begin MEASUREMENT B_npurrst "Fehlertyp unplaus: Rechner¸berwachung: Reset" UWORD B_TRUE 1 100 0 1 BIT_MASK 0x800 FORMAT "%13.11" ECU_ADDRESS 0x3FDE4C /end MEASUREMENT
/begin MEASUREMENT B_npvfz "Fehlerart: Fahrzeuggeschwindigkeit nicht plausibel" UWORD B_TRUE 1 100 0 1 BIT_MASK 0x800 FORMAT "%13.11" ECU_ADDRESS 0x3FDE4E /end MEASUREMENT
/begin MEASUREMENT B_npwca "Fehlertyp unplausibel: Wegfahrsperre Wechselcode-Ablage" UWORD B_TRUE 1 100 0 1 BIT_MASK 0x800 FORMAT "%13.11" ECU_ADDRESS 0x3FDE50 /end MEASUREMENT
/begin MEASUREMENT B_npwfs "Fehlerart: Wegfahrsperre" UWORD B_TRUE 1 100 0 1 BIT_MASK 0x800 FORMAT "%13.11" ECU_ADDRESS 0x3FDE52 /end MEASUREMENT
/begin MEASUREMENT B_oeldr "Bedingung ÷ldruck" UBYTE B_TRUE 1 100 0 1 BIT_MASK 0x1 FORMAT "%13.11" ECU_ADDRESS 0x3FBBFE /end MEASUREMENT
/begin MEASUREMENT B_rdytes "Bedingung ready-Info des Tankentl¸ftungssystems  zum ‹bertrag ins  'ready-Byte'" UBYTE B_TRUE 1 100 0 1 BIT_MASK 0x1 FORMAT "%13.11" ECU_ADDRESS 0x3FD808 /end MEASUREMENT
/begin MEASUREMENT B_sibrems "Fehlertyp BREMS (Bremsschalter): Signal inaktiv" UWORD B_TRUE 1 100 0 1 BIT_MASK 0x400 FORMAT "%13.11" ECU_ADDRESS 0x3FDD28 /end MEASUREMENT
/begin MEASUREMENT B_sibwf "Fehlertyp sig.: PWG Bewegung" UWORD B_TRUE 1 100 0 1 BIT_MASK 0x400 FORMAT "%13.11" ECU_ADDRESS 0x3FDD2A /end MEASUREMENT
/begin MEASUREMENT B_sidgen "" UWORD B_TRUE 1 100 0 1 BIT_MASK 0x400 FORMAT "%13.11" ECU_ADDRESS 0x3FDD3A /end MEASUREMENT
/begin MEASUREMENT B_sidgenbs "" UWORD B_TRUE 1 100 0 1 BIT_MASK 0x400 FORMAT "%13.11" ECU_ADDRESS 0x3FDD3C /end MEASUREMENT
/begin MEASUREMENT B_sidsu "Fehlerart: Umgebungsdrucksensor" UWORD B_TRUE 1 100 0 1 BIT_MASK 0x400 FORMAT "%13.11" ECU_ADDRESS 0x3FDD4C /end MEASUREMENT
/begin MEASUREMENT B_sidwa "Fehlertyp Signal: Diebstahlwarnanlage" UWORD B_TRUE 1 100 0 1 BIT_MASK 0x400 FORMAT "%13.11" ECU_ADDRESS 0x3FDD64 /end MEASUREMENT
/begin MEASUREMENT B_sidzku0 "Signalabfall Z¸ndkreis¸berwachung" UWORD B_TRUE 1 100 0 1 BIT_MASK 0x400 FORMAT "%13.11" ECU_ADDRESS 0x3FDD66 /end MEASUREMENT
/begin MEASUREMENT B_sidzku1 "Signalabfall Z¸ndkreis¸berwachung" UWORD B_TRUE 1 100 0 1 BIT_MASK 0x400 FORMAT "%13.11" ECU_ADDRESS 0x3FDD68 /end MEASUREMENT
/begin MEASUREMENT B_sidzku2 "Signalabfall Z¸ndkreis¸berwachung" UWORD B_TRUE 1 100 0 1 BIT_MASK 0x400 FORMAT "%13.11" ECU_ADDRESS 0x3FDD6A /end MEASUREMENT
/begin MEASUREMENT B_sidzku3 "Signalabfall Z¸ndkreis¸berwachung" UWORD B_TRUE 1 100 0 1 BIT_MASK 0x400 FORMAT "%13.11" ECU_ADDRESS 0x3FDD6C /end MEASUREMENT
/begin MEASUREMENT B_sidzku4 "Signalabfall Z¸ndkreis¸berwachung" UWORD B_TRUE 1 100 0 1 BIT_MASK 0x400 FORMAT "%13.11" ECU_ADDRESS 0x3FDD6E /end MEASUREMENT
/begin MEASUREMENT B_sidzku5 "Signalabfall Z¸ndkreis¸berwachung" UWORD B_TRUE 1 100 0 1 BIT_MASK 0x400 FORMAT "%13.11" ECU_ADDRESS 0x3FDD70 /end MEASUREMENT
/begin MEASUREMENT B_sidzku6 "Signalabfall Z¸ndkreis¸berwachung" UWORD B_TRUE 1 100 0 1 BIT_MASK 0x400 FORMAT "%13.11" ECU_ADDRESS 0x3FDD72 /end MEASUREMENT
/begin MEASUREMENT B_sidzku7 "Signalfehler Z¸ndkreis¸berwachung" UWORD B_TRUE 1 100 0 1 BIT_MASK 0x400 FORMAT "%13.11" ECU_ADDRESS 0x3FDD74 /end MEASUREMENT
/begin MEASUREMENT B_siegfe "Bedingung: Signal Fehler bei den Eingangsgrˆﬂen der F¸llungserfassung" UWORD B_TRUE 1 100 0 1 BIT_MASK 0x400 FORMAT "%13.11" ECU_ADDRESS 0x3FDD76 /end MEASUREMENT
/begin MEASUREMENT B_sifhsh "Lastabfall Sondenheizung hinter Kat" UBYTE B_TRUE 1 100 0 1 BIT_MASK 0x1 FORMAT "%13.11" ECU_ADDRESS 0x3FBC8D /end MEASUREMENT
/begin MEASUREMENT B_sifhsv "Lastabfall Sondenheizung vor Kat" UBYTE B_TRUE 1 100 0 1 BIT_MASK 0x1 FORMAT "%13.11" ECU_ADDRESS 0x3FBC8E /end MEASUREMENT
/begin MEASUREMENT B_sifp1p "Fehlerart: Fahrpedal 1.Potentiometer" UWORD B_TRUE 1 100 0 1 BIT_MASK 0x400 FORMAT "%13.11" ECU_ADDRESS 0x3FDD92 /end MEASUREMENT
/begin MEASUREMENT B_sifp2p "Fehlerart: Fahrpedal 2.Potentiometer" UWORD B_TRUE 1 100 0 1 BIT_MASK 0x400 FORMAT "%13.11" ECU_ADDRESS 0x3FDD94 /end MEASUREMENT
/begin MEASUREMENT B_sifpp "Fehlerart: Fahrpedal Potentiometer" UWORD B_TRUE 1 100 0 1 BIT_MASK 0x400 FORMAT "%13.11" ECU_ADDRESS 0x3FDD96 /end MEASUREMENT
/begin MEASUREMENT B_simdb "Fehlertyp: Momentan¸berwachung begrenzt dauerhaft" UWORD B_TRUE 1 100 0 1 BIT_MASK 0x400 FORMAT "%13.11" ECU_ADDRESS 0x3FDDFA /end MEASUREMENT
/begin MEASUREMENT B_simfl "Signalfehler Multifunktionslenkrad" UWORD B_TRUE 1 100 0 1 BIT_MASK 0x400 FORMAT "%13.11" ECU_ADDRESS 0x3FDDFE /end MEASUREMENT
/begin MEASUREMENT B_sita "Fehlertyp: Ansauglufttemperatur TANS (-Ladeluft)" UWORD B_TRUE 1 100 0 1 BIT_MASK 0x400 FORMAT "%13.11" ECU_ADDRESS 0x3FDE26 /end MEASUREMENT
/begin MEASUREMENT B_sitka "" UWORD B_TRUE 1 100 0 1 BIT_MASK 0x400 FORMAT "%13.11" ECU_ADDRESS 0x3FDE2E /end MEASUREMENT
/begin MEASUREMENT B_sitm "Fehlerart: Motortemperaturschwelle f¸r Lambdaregelungsfreigabe nicht erreicht" UWORD B_TRUE 1 100 0 1 BIT_MASK 0x400 FORMAT "%13.11" ECU_ADDRESS 0x3FDE30 /end MEASUREMENT
/begin MEASUREMENT B_situm "Fehlerart: Signal Umgebungstemperatur inaktiv" UWORD B_TRUE 1 100 0 1 BIT_MASK 0x400 FORMAT "%13.11" ECU_ADDRESS 0x3FDE34 /end MEASUREMENT
/begin MEASUREMENT B_siub "Fehlertyp: Umweltbedingungen" UWORD B_TRUE 1 100 0 1 BIT_MASK 0x400 FORMAT "%13.11" ECU_ADDRESS 0x3FDE36 /end MEASUREMENT
/begin MEASUREMENT B_siubr "Fehlerart: Signalfehler Leitungsabfall Bordnetzspannung ¸ber Hauptrelais" UWORD B_TRUE 1 100 0 1 BIT_MASK 0x400 FORMAT "%13.11" ECU_ADDRESS 0x3FDE38 /end MEASUREMENT
/begin MEASUREMENT B_siufmv "Fehlertyp sig.: Funktions¸berwachung: Momentenvergleich" UWORD B_TRUE 1 100 0 1 BIT_MASK 0x400 FORMAT "%13.11" ECU_ADDRESS 0x3FDE3A /end MEASUREMENT
/begin MEASUREMENT B_siufnc "Fehlertyp signal:Fkt¸berwachung:Drehzahlgeber-,Zuleitung oder SG-Fehler" UWORD B_TRUE 1 100 0 1 BIT_MASK 0x400 FORMAT "%13.11" ECU_ADDRESS 0x3FDE3C /end MEASUREMENT
/begin MEASUREMENT B_siufrlip "Fehlertyp sig.: Fkt¸berw: Lastsensor-, Zuleitung- oder SG-Fehler (ei_vvt_um)" UWORD B_TRUE 1 100 0 1 BIT_MASK 0x400 FORMAT "%13.11" ECU_ADDRESS 0x3FDE3E /end MEASUREMENT
/begin MEASUREMENT B_siufsga "Fehlertyp sig.: Funktions¸berwachung: Steuerger‰te-Fehler Gruppe a (ei_adcc_um)" UWORD B_TRUE 1 100 0 1 BIT_MASK 0x400 FORMAT "%13.11" ECU_ADDRESS 0x3FDE40 /end MEASUREMENT
/begin MEASUREMENT B_siufsgb "Fehlertyp sig.: Funktions¸berwachung: Steuerger‰te-Fehler Gruppe b (ei_varc_um)" UWORD B_TRUE 1 100 0 1 BIT_MASK 0x400 FORMAT "%13.11" ECU_ADDRESS 0x3FDE42 /end MEASUREMENT
/begin MEASUREMENT B_siufsgc "Fehlertyp signal:Fkt¸berwachung:SG-Fehler Gruppe c" UWORD B_TRUE 1 100 0 1 BIT_MASK 0x400 FORMAT "%13.11" ECU_ADDRESS 0x3FDE44 /end MEASUREMENT
/begin MEASUREMENT B_siufspsc "Fehlertyp signal:Fkt¸berwachung:Pedalwertgeber-,Zuleitung oder SG-Fehler" UWORD B_TRUE 1 100 0 1 BIT_MASK 0x400 FORMAT "%13.11" ECU_ADDRESS 0x3FDE46 /end MEASUREMENT
/begin MEASUREMENT B_siurram "Fehlertyp sig.: Rechner¸berwachung: RAM" UWORD B_TRUE 1 100 0 1 BIT_MASK 0x400 FORMAT "%13.11" ECU_ADDRESS 0x3FDE48 /end MEASUREMENT
/begin MEASUREMENT B_siurrom "Fehlertyp sig.: Rechner¸berwachung: ROM" UWORD B_TRUE 1 100 0 1 BIT_MASK 0x400 FORMAT "%13.11" ECU_ADDRESS 0x3FDE4A /end MEASUREMENT
/begin MEASUREMENT B_siurrst "Fehlertyp sig.: Rechner¸berwachung: Reset" UWORD B_TRUE 1 100 0 1 BIT_MASK 0x400 FORMAT "%13.11" ECU_ADDRESS 0x3FDE4C /end MEASUREMENT
/begin MEASUREMENT B_sivfz "Bedingung fehlendes Signal Fahrzeuggeschwindigkeit" UWORD B_TRUE 1 100 0 1 BIT_MASK 0x400 FORMAT "%13.11" ECU_ADDRESS 0x3FDE4E /end MEASUREMENT
/begin MEASUREMENT B_siwca "Fehlertyp Signal: Wegfahrsperre Wechselcode-Ablage" UWORD B_TRUE 1 100 0 1 BIT_MASK 0x400 FORMAT "%13.11" ECU_ADDRESS 0x3FDE50 /end MEASUREMENT
/begin MEASUREMENT B_siwfs "Fehlerart: Wegfahrsperre" UWORD B_TRUE 1 100 0 1 BIT_MASK 0x400 FORMAT "%13.11" ECU_ADDRESS 0x3FDE52 /end MEASUREMENT
/begin MEASUREMENT B_slsrdy "Bedingung SLS gepr¸ft f¸r 'ready-Byte'" UBYTE B_TRUE 1 100 0 1 BIT_MASK 0x8 FORMAT "%13.11" ECU_ADDRESS 0x3FD804 /end MEASUREMENT
/begin MEASUREMENT B_su "Bedingung Saugrohrumschaltung" UBYTE B_TRUE 1 100 0 1 BIT_MASK 0x1 FORMAT "%13.11" ECU_ADDRESS 0x3FBD1D /end MEASUREMENT
/begin MEASUREMENT B_tesrdy "Bedingung TES gepr¸ft f¸r 'ready-Byte'" UBYTE B_TRUE 1 100 0 1 BIT_MASK 0x4 FORMAT "%13.11" ECU_ADDRESS 0x3FD804 /end MEASUREMENT
/begin MEASUREMENT cryddmtl "Counter f¸r Readinessbildung Leckdiagnose DDMTL" UBYTE dez 1 100 0 255 FORMAT "%5.1" ECU_ADDRESS 0x3FD805 /end MEASUREMENT
/begin MEASUREMENT crydldp "Counter f¸r Readinessbildung Leckdiagnose DLDP" UBYTE dez 1 100 0 255 FORMAT "%5.1" ECU_ADDRESS 0x3FD806 /end MEASUREMENT
/begin MEASUREMENT crydtev "Counter f¸r Readinessbildung TEV-Diagnose DTEV" UBYTE dez 1 100 0 255 FORMAT "%5.1" ECU_ADDRESS 0x3FD807 /end MEASUREMENT
/begin MEASUREMENT cryhs "Counter f¸r Readinessbildung Sondenheizungs-Diagnose" UBYTE dez 1 100 0 255 FORMAT "%5.1" ECU_ADDRESS 0x3FD800 /end MEASUREMENT
/begin MEASUREMENT crykat "Counter f¸r Readinessbildung Katalysator-Diagnose" UBYTE dez 1 100 0 255 FORMAT "%5.1" ECU_ADDRESS 0x3FD801 /end MEASUREMENT
/begin MEASUREMENT cryls "Counter f¸r Readinessbildung Lambdasonden-Diagnose" UBYTE dez 1 100 0 255 FORMAT "%5.1" ECU_ADDRESS 0x3FD802 /end MEASUREMENT
/begin MEASUREMENT crysls "Counter f¸r Readinessbildung Sekund‰rluft-Diagnose" UBYTE dez 1 100 0 255 FORMAT "%5.1" ECU_ADDRESS 0x3FD803 /end MEASUREMENT
/begin MEASUREMENT diagtime "" UBYTE dez 1 100 0 255 FORMAT "%5.1" ECU_ADDRESS 0x5B8B87 /end MEASUREMENT
/begin MEASUREMENT Dicntlern "Z‰hler: Anzahl der Lernversuche" UBYTE dez 1 100 0 255 FORMAT "%5.1" ECU_ADDRESS 0x3FDBCF /end MEASUREMENT
/begin MEASUREMENT Dicntlfehl "Z‰hler: Anzahl der der fehlgeschlagenen Lernversuche" UBYTE dez 1 100 0 255 FORMAT "%5.1" ECU_ADDRESS 0x3FDBD0 /end MEASUREMENT
/begin MEASUREMENT DIMCTESausbits1 "" UBYTE dez 1 100 0 255 FORMAT "%5.1" ECU_ADDRESS 0x5B8E23 /end MEASUREMENT
/begin MEASUREMENT DIMCTESausbitsNOV1 "" UBYTE dez 1 100 0 255 FORMAT "%5.1" ECU_ADDRESS 0x3FD808 /end MEASUREMENT
/begin MEASUREMENT Disaaus_i "Reglerausgang i-Regler" UWORD vnstv_q0p00305s32768 1 100 -100 99.9969 ECU_ADDRESS 0x5B86B2 /end MEASUREMENT
/begin MEASUREMENT Disaaus_p "Reglerausgang p-Regler" UWORD vnstv_q0p00305s32768 1 100 -100 99.9969 ECU_ADDRESS 0x5B86B4 /end MEASUREMENT
/begin MEASUREMENT Disaaus_w "Regelausgang" SWORD vnstv_q0p00305 1 100 -100 99.9969 FORMAT "%7.3" ECU_ADDRESS 0x5B95E4 /end MEASUREMENT
/begin MEASUREMENT Disa_dir "" UBYTE dez 1 100 0 255 FORMAT "%5.1" ECU_ADDRESS 0x5B86AA /end MEASUREMENT
/begin MEASUREMENT Disa_ist "Istwert bei geregelter Saugrohrumschaltung" UWORD vnstv_q0p00305 1 100 0 199.997 FORMAT "%7.3" ECU_ADDRESS 0x5B86B6 /end MEASUREMENT
/begin MEASUREMENT Disa_lern "Hilfsgrˆsse zur Disa-UMA-Erkennung" UBYTE dez 1 100 0 255 FORMAT "%5.1" ECU_ADDRESS 0x5B86AB /end MEASUREMENT
/begin MEASUREMENT Disa_soll "Disa Sollwert" UBYTE PCENT 1 100 0 99.6094 FORMAT "%5.2" ECU_ADDRESS 0x5B86AC /end MEASUREMENT
/begin MEASUREMENT Disa_spgnv "Letzter gemessener Ist-Spannungswert beim Abstellen" UWORD spg_uw_b5 1 100 0 319.995 FORMAT "%8.4" ECU_ADDRESS 0x3FDBD2 /end MEASUREMENT
/begin MEASUREMENT Disa_st "DISA Status Start-/Abstellstellung" UBYTE dez 1 100 0 255 FORMAT "%5.1" ECU_ADDRESS 0x5B86AD /end MEASUREMENT
/begin MEASUREMENT Disa_uma "Disa UMA Lernwert" UWORD spg_uw_b5 1 100 0 319.995 FORMAT "%8.4" ECU_ADDRESS 0x3FDBD4 /end MEASUREMENT
/begin MEASUREMENT Disolakt "Sollwert f¸r DISA-Regelung" UWORD vnstv_q0p00305 1 100 0 199.997 FORMAT "%7.3" ECU_ADDRESS 0x5B86B8 /end MEASUREMENT
/begin MEASUREMENT Ditv_aus "Tastverh‰ltnis f¸r DISA-Stellmotor" UWORD di_uw_q0p01 1 100 0 655.35 FORMAT "%8.4" ECU_ADDRESS 0x5B86BA /end MEASUREMENT
/begin MEASUREMENT Di_cnt "Z‰hler zur Bestimmung der Schaltzeit des DISA-Stellmotors" UBYTE di_uw_q0p01 1 100 0 2.55 FORMAT "%5.3" ECU_ADDRESS 0x5B86AE /end MEASUREMENT
/begin MEASUREMENT Di_lernst "Lernvorgang: aktuelle Lernstufe" UBYTE dez 1 100 0 255 FORMAT "%5.1" ECU_ADDRESS 0x5B86AF /end MEASUREMENT
/begin MEASUREMENT Di_lfehl "Fehlerflag Lernen" UBYTE dez 1 100 0 255 FORMAT "%5.1" ECU_ADDRESS 0x5B86B0 /end MEASUREMENT
/begin MEASUREMENT D_disa_kl "Delta Kennlinie" UWORD vnstv_q0p00305s32768 1 100 -100 99.9969 ECU_ADDRESS 0x5B86BC /end MEASUREMENT
/begin MEASUREMENT D_disa_v "" SWORD vnstv_q0p00305 1 100 -100 99.9969 FORMAT "%7.3" ECU_ADDRESS 0x5B86BE /end MEASUREMENT
/begin MEASUREMENT D_disa_w "Regelabweichung" SWORD vnstv_q0p00305 1 100 -100 99.9969 FORMAT "%7.3" ECU_ADDRESS 0x5B86C0 /end MEASUREMENT
/begin MEASUREMENT EAS_lsp1hk "" UBYTE B_TRUE 1 100 0 1 BIT_MASK 0x1 FORMAT "%13.11" ECU_ADDRESS 0x3FBBFF /end MEASUREMENT
/begin MEASUREMENT EAS_lsp1vk "" UBYTE B_TRUE 1 100 0 1 BIT_MASK 0x1 FORMAT "%13.11" ECU_ADDRESS 0x3FBC00 /end MEASUREMENT
/begin MEASUREMENT EAS_lsp2hk "" UBYTE B_TRUE 1 100 0 1 BIT_MASK 0x1 FORMAT "%13.11" ECU_ADDRESS 0x3FBC01 /end MEASUREMENT
/begin MEASUREMENT EAS_lsp2vk "" UBYTE B_TRUE 1 100 0 1 BIT_MASK 0x1 FORMAT "%13.11" ECU_ADDRESS 0x3FBC02 /end MEASUREMENT
/begin MEASUREMENT ebCtrNewT "" UBYTE dez 1 100 0 255 FORMAT "%5.1" ECU_ADDRESS 0x5B8B88 /end MEASUREMENT
/begin MEASUREMENT ebCtrNewY "" UBYTE dez 1 100 0 255 FORMAT "%5.1" ECU_ADDRESS 0x5B8B89 /end MEASUREMENT
/begin MEASUREMENT ebCtrOldT "" UBYTE dez 1 100 0 255 FORMAT "%5.1" ECU_ADDRESS 0x5B8B8A /end MEASUREMENT
/begin MEASUREMENT ebCtrOldY "" UBYTE dez 1 100 0 255 FORMAT "%5.1" ECU_ADDRESS 0x5B8B8B /end MEASUREMENT
/begin MEASUREMENT ebMissT "" UWORD dez 1 100 0 65535 FORMAT "%8.2" ECU_ADDRESS 0x5B94CC /end MEASUREMENT
/begin MEASUREMENT ebMissY "" UWORD dez 1 100 0 65535 FORMAT "%8.2" ECU_ADDRESS 0x5B94CE /end MEASUREMENT
/begin MEASUREMENT en_gendiag "Disgnose Freigabe Gen.Fehler" UBYTE B_TRUE 1 100 0 1 FORMAT "%13.11" ECU_ADDRESS 0x5B8920 /end MEASUREMENT
/begin MEASUREMENT ES_fgrs "Drehzahlregler Schalter" UBYTE B_TRUE 1 100 0 1 BIT_MASK 0x1 FORMAT "%13.11" ECU_ADDRESS 0x3FBC03 /end MEASUREMENT
/begin MEASUREMENT ES_fgrsb "Drehzahlregler Beschleunigung" UBYTE B_TRUE 1 100 0 1 BIT_MASK 0x1 FORMAT "%13.11" ECU_ADDRESS 0x3FBC04 /end MEASUREMENT
/begin MEASUREMENT ES_fgrsv "Verzˆgerungsdrehzahlregler" UBYTE B_TRUE 1 100 0 1 BIT_MASK 0x1 FORMAT "%13.11" ECU_ADDRESS 0x3FBC05 /end MEASUREMENT
/begin MEASUREMENT ES_sfdisa "Output Status Flag DISA (H-Bridge Driver)" UBYTE B_TRUE 1 100 0 1 BIT_MASK 0x1 FORMAT "%13.11" ECU_ADDRESS 0x3FBC06 /end MEASUREMENT
/begin MEASUREMENT ES_sfmdk "" UBYTE B_TRUE 1 100 0 1 BIT_MASK 0x1 FORMAT "%13.11" ECU_ADDRESS 0x3FBC07 /end MEASUREMENT
/begin MEASUREMENT ES_wda "" UBYTE B_TRUE 1 100 0 1 BIT_MASK 0x1 FORMAT "%13.11" ECU_ADDRESS 0x3FBC08 /end MEASUREMENT
/begin MEASUREMENT evsup1 "Funktionskennungsbyte f¸r Ausgabe SAE J1979 Mode2" UBYTE dez 1 100 0 255 FORMAT "%5.1" ECU_ADDRESS 0x5B8E22 /end MEASUREMENT
/begin MEASUREMENT E_brems "Fehlerflag: BREMS (Bremsschalter)" UWORD B_TRUE 1 100 0 1 BIT_MASK 0x1 FORMAT "%13.11" ECU_ADDRESS 0x3FDD28 /end MEASUREMENT
/begin MEASUREMENT E_bwf "Errorflag: PWG Bewegung" UWORD B_TRUE 1 100 0 1 BIT_MASK 0x1 FORMAT "%13.11" ECU_ADDRESS 0x3FDD2A /end MEASUREMENT
/begin MEASUREMENT E_dgen "" UWORD B_TRUE 1 100 0 1 BIT_MASK 0x1 FORMAT "%13.11" ECU_ADDRESS 0x3FDD3A /end MEASUREMENT
/begin MEASUREMENT E_dgenbs "" UWORD B_TRUE 1 100 0 1 BIT_MASK 0x1 FORMAT "%13.11" ECU_ADDRESS 0x3FDD3C /end MEASUREMENT
/begin MEASUREMENT E_dsu "Errorflag: Umgebungsdrucksensor" UWORD B_TRUE 1 100 0 1 BIT_MASK 0x1 FORMAT "%13.11" ECU_ADDRESS 0x3FDD4C /end MEASUREMENT
/begin MEASUREMENT E_dwa "Errorflag: Diebstahlwarnanlage" UWORD B_TRUE 1 100 0 1 BIT_MASK 0x1 FORMAT "%13.11" ECU_ADDRESS 0x3FDD64 /end MEASUREMENT
/begin MEASUREMENT E_dzku0 "Fehler : Z¸ndkreisfehler" UWORD B_TRUE 1 100 0 1 BIT_MASK 0x1 FORMAT "%13.11" ECU_ADDRESS 0x3FDD66 /end MEASUREMENT
/begin MEASUREMENT E_dzku1 "Fehler : Z¸ndkreisfehler" UWORD B_TRUE 1 100 0 1 BIT_MASK 0x1 FORMAT "%13.11" ECU_ADDRESS 0x3FDD68 /end MEASUREMENT
/begin MEASUREMENT E_dzku2 "Fehler : Z¸ndkreisfehler" UWORD B_TRUE 1 100 0 1 BIT_MASK 0x1 FORMAT "%13.11" ECU_ADDRESS 0x3FDD6A /end MEASUREMENT
/begin MEASUREMENT E_dzku3 "Fehler : Z¸ndkreisfehler" UWORD B_TRUE 1 100 0 1 BIT_MASK 0x1 FORMAT "%13.11" ECU_ADDRESS 0x3FDD6C /end MEASUREMENT
/begin MEASUREMENT E_dzku4 "Fehler : Z¸ndkreisfehler" UWORD B_TRUE 1 100 0 1 BIT_MASK 0x1 FORMAT "%13.11" ECU_ADDRESS 0x3FDD6E /end MEASUREMENT
/begin MEASUREMENT E_dzku5 "Fehler : Z¸ndkreisfehler" UWORD B_TRUE 1 100 0 1 BIT_MASK 0x1 FORMAT "%13.11" ECU_ADDRESS 0x3FDD70 /end MEASUREMENT
/begin MEASUREMENT E_dzku6 "Fehler : Z¸ndkreisfehler" UWORD B_TRUE 1 100 0 1 BIT_MASK 0x1 FORMAT "%13.11" ECU_ADDRESS 0x3FDD72 /end MEASUREMENT
/begin MEASUREMENT E_dzku7 "Fehler : Z¸ndkreisfehler" UWORD B_TRUE 1 100 0 1 BIT_MASK 0x1 FORMAT "%13.11" ECU_ADDRESS 0x3FDD74 /end MEASUREMENT
/begin MEASUREMENT E_egfe "Errorflag: Eingangsgrˆﬂen F¸llungserfassung" UWORD B_TRUE 1 100 0 1 BIT_MASK 0x1 FORMAT "%13.11" ECU_ADDRESS 0x3FDD76 /end MEASUREMENT
/begin MEASUREMENT E_fp1p "Errorflag: Fahrpedal 1. Poti" UWORD B_TRUE 1 100 0 1 BIT_MASK 0x1 FORMAT "%13.11" ECU_ADDRESS 0x3FDD92 /end MEASUREMENT
/begin MEASUREMENT E_fp2p "Errorflag: Fahrpedal 2. Poti" UWORD B_TRUE 1 100 0 1 BIT_MASK 0x1 FORMAT "%13.11" ECU_ADDRESS 0x3FDD94 /end MEASUREMENT
/begin MEASUREMENT E_fpp "Errorflag Fahrpedal-Poti" UWORD B_TRUE 1 100 0 1 BIT_MASK 0x1 FORMAT "%13.11" ECU_ADDRESS 0x3FDD96 /end MEASUREMENT
/begin MEASUREMENT E_mdb "Errorflag: Momenten¸berwachung begrenzt dauerhaft" UWORD B_TRUE 1 100 0 1 BIT_MASK 0x1 FORMAT "%13.11" ECU_ADDRESS 0x3FDDFA /end MEASUREMENT
/begin MEASUREMENT E_mfl "Errorflag: Multifunktionslenkrad  (MFL)" UWORD B_TRUE 1 100 0 1 BIT_MASK 0x1 FORMAT "%13.11" ECU_ADDRESS 0x3FDDFE /end MEASUREMENT
/begin MEASUREMENT E_ta "Errorflag: Ansauglufttemperatur" UWORD B_TRUE 1 100 0 1 BIT_MASK 0x1 FORMAT "%13.11" ECU_ADDRESS 0x3FDE26 /end MEASUREMENT
/begin MEASUREMENT E_TKA "Errorflag: Temperatur K¸hlerausgang" UWORD B_TRUE 1 100 0 1 BIT_MASK 0x1 FORMAT "%13.11" ECU_ADDRESS 0x3FDE2E /end MEASUREMENT
/begin MEASUREMENT E_tm "Errorflag: TMOT" UWORD B_TRUE 1 100 0 1 BIT_MASK 0x1 FORMAT "%13.11" ECU_ADDRESS 0x3FDE30 /end MEASUREMENT
/begin MEASUREMENT E_tum "Errorflag:  Umgebungstemperatur tumg" UWORD B_TRUE 1 100 0 1 BIT_MASK 0x1 FORMAT "%13.11" ECU_ADDRESS 0x3FDE34 /end MEASUREMENT
/begin MEASUREMENT E_ub "Errorflag: UB" UWORD B_TRUE 1 100 0 1 BIT_MASK 0x1 FORMAT "%13.11" ECU_ADDRESS 0x3FDE36 /end MEASUREMENT
/begin MEASUREMENT E_ubr "Errorflag: Bordnetzspannung ¸ber Hauptrelais UBR" UWORD B_TRUE 1 100 0 1 BIT_MASK 0x1 FORMAT "%13.11" ECU_ADDRESS 0x3FDE38 /end MEASUREMENT
/begin MEASUREMENT E_ufmv "Errorflag: Funktions¸berwachung: Momentenvergleich" UWORD B_TRUE 1 100 0 1 BIT_MASK 0x1 FORMAT "%13.11" ECU_ADDRESS 0x3FDE3A /end MEASUREMENT
/begin MEASUREMENT E_ufnc "Errorflag: Fkt¸berwachung: Drehzahlgeber-, Zuleitung- oder Steuerger‰te-Fehler" UWORD B_TRUE 1 100 0 1 BIT_MASK 0x1 FORMAT "%13.11" ECU_ADDRESS 0x3FDE3C /end MEASUREMENT
/begin MEASUREMENT E_ufrlip "Errorflag: Fkt¸berwachung: Lastsensor-, Zuleitung- oder Steuerger‰te-Fehler" UWORD B_TRUE 1 100 0 1 BIT_MASK 0x1 FORMAT "%13.11" ECU_ADDRESS 0x3FDE3E /end MEASUREMENT
/begin MEASUREMENT E_ufsga "Errorflag: Funktions¸berwachung: Steuerger‰te-Fehler Gruppe a" UWORD B_TRUE 1 100 0 1 BIT_MASK 0x1 FORMAT "%13.11" ECU_ADDRESS 0x3FDE40 /end MEASUREMENT
/begin MEASUREMENT E_ufsgb "Errorflag: Funktions¸berwachung: Steuerger‰te-Fehler Gruppe b" UWORD B_TRUE 1 100 0 1 BIT_MASK 0x1 FORMAT "%13.11" ECU_ADDRESS 0x3FDE42 /end MEASUREMENT
/begin MEASUREMENT E_ufsgc "Errorflag: Funktions¸berwachung: Steuerger‰te-Fehler Gruppe c" UWORD B_TRUE 1 100 0 1 BIT_MASK 0x1 FORMAT "%13.11" ECU_ADDRESS 0x3FDE44 /end MEASUREMENT
/begin MEASUREMENT E_ufspsc "Errorflag: Fkt¸berwachung: Pedalwertgeber-, Zuleitung- oder Steuerger‰te-Fehler" UWORD B_TRUE 1 100 0 1 BIT_MASK 0x1 FORMAT "%13.11" ECU_ADDRESS 0x3FDE46 /end MEASUREMENT
/begin MEASUREMENT E_urram "Errorflag: Rechner¸berwachung: RAM" UWORD B_TRUE 1 100 0 1 BIT_MASK 0x1 FORMAT "%13.11" ECU_ADDRESS 0x3FDE48 /end MEASUREMENT
/begin MEASUREMENT E_urrom "Errorflag: Rechner¸berwachung: ROM" UWORD B_TRUE 1 100 0 1 BIT_MASK 0x1 FORMAT "%13.11" ECU_ADDRESS 0x3FDE4A /end MEASUREMENT
/begin MEASUREMENT E_urrst "Errorflag: Rechner¸berwachung: Reset" UWORD B_TRUE 1 100 0 1 BIT_MASK 0x1 FORMAT "%13.11" ECU_ADDRESS 0x3FDE4C /end MEASUREMENT
/begin MEASUREMENT E_vfz "Errorflag: Fahrzeug-Geschwindigkeit" UWORD B_TRUE 1 100 0 1 BIT_MASK 0x1 FORMAT "%13.11" ECU_ADDRESS 0x3FDE4E /end MEASUREMENT
/begin MEASUREMENT E_wca "Errorflag: Wegfahrsperre Wechselcode-Ablage" UWORD B_TRUE 1 100 0 1 BIT_MASK 0x1 FORMAT "%13.11" ECU_ADDRESS 0x3FDE50 /end MEASUREMENT
/begin MEASUREMENT E_wfs "Errorflag: Wegfahrsperre" UWORD B_TRUE 1 100 0 1 BIT_MASK 0x1 FORMAT "%13.11" ECU_ADDRESS 0x3FDE52 /end MEASUREMENT
/begin MEASUREMENT fwmlhfm "gewichteter MLHFMMN in Abh‰ngigkeit von Faktor Hˆhe" UWORD m_q0p1 1 100 0 6553.5 FORMAT "%8.3" ECU_ADDRESS 0x5B86F6 /end MEASUREMENT
/begin MEASUREMENT genfbsak "Uebertragungsfehler kodiert fuer Fehlereintrag" UBYTE DEZ 1 100 0 255 FORMAT "%5.1" ECU_ADDRESS 0x5B8927 /end MEASUREMENT
/begin MEASUREMENT genstatroh "Status Generator" UBYTE dez 1 100 0 255 FORMAT "%5.1" ECU_ADDRESS 0x5B8CB0 /end MEASUREMENT
/begin MEASUREMENT gfbsuctr "Entprellzaehler fuer Generatortyp unplausibel" UBYTE t100msxs_ub_b25p5 1 100 0 25.5 FORMAT "%5.2" ECU_ADDRESS 0x5B8928 /end MEASUREMENT
/begin MEASUREMENT gfehlin1 "lokale Kopie Fehlerinput" UBYTE B_TRUE 1 100 0 1 FORMAT "%13.11" ECU_ADDRESS 0x5B8921 /end MEASUREMENT
/begin MEASUREMENT gfehlin2 "lokale Kopie Fehlerinput" UBYTE B_TRUE 1 100 0 1 FORMAT "%13.11" ECU_ADDRESS 0x5B8922 /end MEASUREMENT
/begin MEASUREMENT gfehlin3 "lokale Kopie Fehlerinput" UBYTE B_TRUE 1 100 0 1 FORMAT "%13.11" ECU_ADDRESS 0x5B8923 /end MEASUREMENT
/begin MEASUREMENT gfehlin4 "lokale Kopie Fehlerinput" UBYTE B_TRUE 1 100 0 1 FORMAT "%13.11" ECU_ADDRESS 0x5B8924 /end MEASUREMENT
/begin MEASUREMENT gfehlin5 "lokale Kopie Fehlerinput" UBYTE B_TRUE 1 100 0 1 FORMAT "%13.11" ECU_ADDRESS 0x5B8925 /end MEASUREMENT
/begin MEASUREMENT gfelctr "Entprellzaehler fuer elektrischen Fehler" UBYTE t100msxs_ub_b25p5 1 100 0 25.5 FORMAT "%5.2" ECU_ADDRESS 0x5B8929 /end MEASUREMENT
/begin MEASUREMENT gfhtctr "Entprellzaehler fuer Generator Ueberhitzung" UBYTE t100msxs_ub_b25p5 1 100 0 25.5 FORMAT "%5.2" ECU_ADDRESS 0x5B892A /end MEASUREMENT
/begin MEASUREMENT gfmectr "Entprellzaehler fuer mechanischen Fehler" UBYTE t100msxs_ub_b25p5 1 100 0 25.5 FORMAT "%5.2" ECU_ADDRESS 0x5B892B /end MEASUREMENT
/begin MEASUREMENT gfnobctr "Entprellzaehler fuer BSD Kommunikation unterbrochen" UBYTE t100msxs_ub_b25p5 1 100 0 25.5 FORMAT "%5.2" ECU_ADDRESS 0x5B892C /end MEASUREMENT
/begin MEASUREMENT kl61loc "Kl61 lokal" UBYTE B_TRUE 1 100 0 1 FORMAT "%13.11" ECU_ADDRESS 0x5B8926 /end MEASUREMENT
/begin MEASUREMENT mldmn_w "minimale Luftmasse aus Kennfeld KFMLDMN" SWORD m_q0p1 1 100 -3276.8 3276.7 FORMAT "%8.3" ECU_ADDRESS 0x5B915A /end MEASUREMENT
/begin MEASUREMENT mldmx_w "maximale Luftmasse aus Kennfeld KFMLDMX" UWORD m_q0p1 1 100 0 6553.5 FORMAT "%8.3" ECU_ADDRESS 0x5B915C /end MEASUREMENT
/begin MEASUREMENT mlhfmf_w "gefilterter Luftmassen HFM-Mittelwert 16Bit-Wert" UWORD m_q0p1 1 100 0 6553.5 FORMAT "%8.3" ECU_ADDRESS 0x5B915E /end MEASUREMENT
/begin MEASUREMENT phlsnhf "normierte Heizleistung der Lambdasonde hinter Kat, gefiltert" UBYTE fak_ub_q0p01 1 100 0 2.55 FORMAT "%5.3" ECU_ADDRESS 0x5B865A /end MEASUREMENT
/begin MEASUREMENT phlsnvf "normierte Heizleistung der Lambdasonde vor Kat, gefiltert" UBYTE fak_ub_q0p01 1 100 0 2.55 FORMAT "%5.3" ECU_ADDRESS 0x5B865B /end MEASUREMENT
/begin MEASUREMENT ready "readiness-Byte f¸r Ausgabe SAE J1979 Mode2" UBYTE dez 1 100 0 255 FORMAT "%5.1" ECU_ADDRESS 0x3FD804 /end MEASUREMENT
/begin MEASUREMENT rememberP3Max "" ULONG dez 1 100 0 4.29497e+009 FORMAT "%13.2" ECU_ADDRESS 0x5B9838 /end MEASUREMENT
/begin MEASUREMENT rinkfh "Innenwiderstand Nernstzelle der Lambdasonde aus Kennfeld vor Kat" UBYTE r_q8 1 100 0 2040 FORMAT "%5.0" ECU_ADDRESS 0x5B865C /end MEASUREMENT
/begin MEASUREMENT rinkfv "Innenwiderstand Nernstzelle der Lambdasonde aus Kennfeld vor Kat" UBYTE r_q8 1 100 0 2040 FORMAT "%5.0" ECU_ADDRESS 0x5B865D /end MEASUREMENT
/begin MEASUREMENT rinsh_w "Grenzwert Innenwiderstand Nernstzelle der Lambdasonde hinter Kat" UWORD r_uw_q2 1 100 0 131070 FORMAT "%8.1" ECU_ADDRESS 0x5B8660 /end MEASUREMENT
/begin MEASUREMENT rinsv_w "Grenzwert Innenwiderstand Nernstzelle der Lambdasonde vor Kat" UWORD r_uw_q2 1 100 0 131070 FORMAT "%8.1" ECU_ADDRESS 0x5B8662 /end MEASUREMENT
/begin MEASUREMENT sfpbrems "Status Fehlerpfad BREMS: Bremsschalter" UWORD dez 1 100 0 65535 FORMAT "%8.2" ECU_ADDRESS 0x3FDD28 /end MEASUREMENT
/begin MEASUREMENT sfpbwf "Statuswort:  PWG Bewegung" UWORD dez 1 100 0 65535 FORMAT "%8.2" ECU_ADDRESS 0x3FDD2A /end MEASUREMENT
/begin MEASUREMENT sfpdgen "" UWORD dez 1 100 0 65535 FORMAT "%8.2" ECU_ADDRESS 0x3FDD3A /end MEASUREMENT
/begin MEASUREMENT sfpdgenbs "" UWORD dez 1 100 0 65535 FORMAT "%8.2" ECU_ADDRESS 0x3FDD3C /end MEASUREMENT
/begin MEASUREMENT sfpdsu "Status Fehlerpfad: Umgebungsdrucksensor" UWORD dez 1 100 0 65535 FORMAT "%8.2" ECU_ADDRESS 0x3FDD4C /end MEASUREMENT
/begin MEASUREMENT sfpdwa "Status Fehlerpfad: Diebstahlwarnanlage" UWORD dez 1 100 0 65535 FORMAT "%8.2" ECU_ADDRESS 0x3FDD64 /end MEASUREMENT
/begin MEASUREMENT sfpdzku0 "Fehlerpuffer Z¸ndkreisfehler" UWORD dez 1 100 0 65535 FORMAT "%8.2" ECU_ADDRESS 0x3FDD66 /end MEASUREMENT
/begin MEASUREMENT sfpdzku1 "Fehlerpuffer Z¸ndkreisfehler" UWORD dez 1 100 0 65535 FORMAT "%8.2" ECU_ADDRESS 0x3FDD68 /end MEASUREMENT
/begin MEASUREMENT sfpdzku2 "Fehlerpuffer Z¸ndkreisfehler" UWORD dez 1 100 0 65535 FORMAT "%8.2" ECU_ADDRESS 0x3FDD6A /end MEASUREMENT
/begin MEASUREMENT sfpdzku3 "Fehlerpuffer Z¸ndkreisfehler" UWORD dez 1 100 0 65535 FORMAT "%8.2" ECU_ADDRESS 0x3FDD6C /end MEASUREMENT
/begin MEASUREMENT sfpdzku4 "Fehlerpuffer Z¸ndkreisfehler" UWORD dez 1 100 0 65535 FORMAT "%8.2" ECU_ADDRESS 0x3FDD6E /end MEASUREMENT
/begin MEASUREMENT sfpdzku5 "Fehlerpuffer Z¸ndkreisfehler" UWORD dez 1 100 0 65535 FORMAT "%8.2" ECU_ADDRESS 0x3FDD70 /end MEASUREMENT
/begin MEASUREMENT sfpdzku6 "Fehlerpuffer Z¸ndkreisfehler" UWORD dez 1 100 0 65535 FORMAT "%8.2" ECU_ADDRESS 0x3FDD72 /end MEASUREMENT
/begin MEASUREMENT sfpdzku7 "Fehlerpuffer Z¸ndkreisfehler" UWORD dez 1 100 0 65535 FORMAT "%8.2" ECU_ADDRESS 0x3FDD74 /end MEASUREMENT
/begin MEASUREMENT sfpegfe "Status Fehlerpfad: Diagose der Eingangsgrˆﬂen der F¸llungserfassung" UWORD dez 1 100 0 65535 FORMAT "%8.2" ECU_ADDRESS 0x3FDD76 /end MEASUREMENT
/begin MEASUREMENT sfpfp1p "Status Fehlerpfad: Fahrpedal 1.Potentiometer" UWORD dez 1 100 0 65535 FORMAT "%8.2" ECU_ADDRESS 0x3FDD92 /end MEASUREMENT
/begin MEASUREMENT sfpfp2p "Status Fehlerpfad: Fahrpedal 2.Potentiometer" UWORD dez 1 100 0 65535 FORMAT "%8.2" ECU_ADDRESS 0x3FDD94 /end MEASUREMENT
/begin MEASUREMENT sfpfpp "Status Fehlerpfad: Fahrpedal Potentiometer" UWORD dez 1 100 0 65535 FORMAT "%8.2" ECU_ADDRESS 0x3FDD96 /end MEASUREMENT
/begin MEASUREMENT sfpmdb "Status Fehlerpfad: Momentan¸berwachung begrenzt dauerhaft" UWORD dez 1 100 0 65535 FORMAT "%8.2" ECU_ADDRESS 0x3FDDFA /end MEASUREMENT
/begin MEASUREMENT sfpmfl "Statuswort: Multifunktionslenkrad" UWORD dez 1 100 0 65535 FORMAT "%8.2" ECU_ADDRESS 0x3FDDFE /end MEASUREMENT
/begin MEASUREMENT sfpta "Status Fehlerpfad: Ansauglufttemperatur (Ladeluft-) TANS" UWORD dez 1 100 0 65535 FORMAT "%8.2" ECU_ADDRESS 0x3FDE26 /end MEASUREMENT
/begin MEASUREMENT sfptka "Status Fehlerpfad: Temperatur K¸hlerausgang" UWORD dez 1 100 0 65535 FORMAT "%8.2" ECU_ADDRESS 0x3FDE2E /end MEASUREMENT
/begin MEASUREMENT sfptm "Status Fehlerpfad: Motortemperatur TMOT" UWORD dez 1 100 0 65535 FORMAT "%8.2" ECU_ADDRESS 0x3FDE30 /end MEASUREMENT
/begin MEASUREMENT sfptum "Status Fehlerpfad: Umgebungstemperatur TUM" UWORD dez 1 100 0 65535 FORMAT "%8.2" ECU_ADDRESS 0x3FDE34 /end MEASUREMENT
/begin MEASUREMENT sfpub "Status Fehlerpfad: Batteriespannung UB (Bordnetz)" UWORD dez 1 100 0 65535 FORMAT "%8.2" ECU_ADDRESS 0x3FDE36 /end MEASUREMENT
/begin MEASUREMENT sfpubr "Status Fehlerpfad: Bordnetzspannung ¸ber Hauptrelais UBR" UWORD dez 1 100 0 65535 FORMAT "%8.2" ECU_ADDRESS 0x3FDE38 /end MEASUREMENT
/begin MEASUREMENT sfpufmv "Statuswort: Funktions¸berwachung: Momentenvergleich" UWORD dez 1 100 0 65535 FORMAT "%8.2" ECU_ADDRESS 0x3FDE3A /end MEASUREMENT
/begin MEASUREMENT sfpufnc "Statuswort: Funktions¸berwachung:Drehzahlgeber-,Zuleitung- oder SG-Fehler" UWORD dez 1 100 0 65535 FORMAT "%8.2" ECU_ADDRESS 0x3FDE3C /end MEASUREMENT
/begin MEASUREMENT sfpufrlip "Statuswort: Funktions¸berwachung:Lastsensor-,Zuleitung oder SG-Fehler" UWORD dez 1 100 0 65535 FORMAT "%8.2" ECU_ADDRESS 0x3FDE3E /end MEASUREMENT
/begin MEASUREMENT sfpufsga "Statuswort: Funktions¸berwachung:SG-Fehler Gruppe a" UWORD dez 1 100 0 65535 FORMAT "%8.2" ECU_ADDRESS 0x3FDE40 /end MEASUREMENT
/begin MEASUREMENT sfpufsgb "Statuswort: Funktions¸berwachung:SG-Fehler Gruppe b" UWORD dez 1 100 0 65535 FORMAT "%8.2" ECU_ADDRESS 0x3FDE42 /end MEASUREMENT
/begin MEASUREMENT sfpufsgc "Statuswort: Funktions¸berwachung:SG-Fehler Gruppe c" UWORD dez 1 100 0 65535 FORMAT "%8.2" ECU_ADDRESS 0x3FDE44 /end MEASUREMENT
/begin MEASUREMENT sfpufspsc "Statuswort: Funktions¸berwachung:Pedalwergeber-,Zuleitung-oder SG-Fehler" UWORD dez 1 100 0 65535 FORMAT "%8.2" ECU_ADDRESS 0x3FDE46 /end MEASUREMENT
/begin MEASUREMENT sfpurram "Statuswort: Rechner¸berwachung: RAM" UWORD dez 1 100 0 65535 FORMAT "%8.2" ECU_ADDRESS 0x3FDE48 /end MEASUREMENT
/begin MEASUREMENT sfpurrom "Statuswort: Rechner¸berwachung: ROM" UWORD dez 1 100 0 65535 FORMAT "%8.2" ECU_ADDRESS 0x3FDE4A /end MEASUREMENT
/begin MEASUREMENT sfpurrst "Statuswort: Rechner¸berwachung: Reset" UWORD dez 1 100 0 65535 FORMAT "%8.2" ECU_ADDRESS 0x3FDE4C /end MEASUREMENT
/begin MEASUREMENT sfpvfz "Status Fehlerpfad: Fahrzeuggeschwindigkeit" UWORD dez 1 100 0 65535 FORMAT "%8.2" ECU_ADDRESS 0x3FDE4E /end MEASUREMENT
/begin MEASUREMENT sfpwca "Status Fehlerpfad: Wegfahrsperre Wechselcode-Ablage" UWORD dez 1 100 0 65535 FORMAT "%8.2" ECU_ADDRESS 0x3FDE50 /end MEASUREMENT
/begin MEASUREMENT sfpwfs "Status Fehlerpfad: Wegfahrsperre" UWORD dez 1 100 0 65535 FORMAT "%8.2" ECU_ADDRESS 0x3FDE52 /end MEASUREMENT
/begin MEASUREMENT St_di "Status Disa" UBYTE dez 1 100 0 255 FORMAT "%5.1" ECU_ADDRESS 0x5B86B1 /end MEASUREMENT
/begin MEASUREMENT st_gen "Generatorstatus" UBYTE dez 1 100 0 255 FORMAT "%5.1" ECU_ADDRESS 0x5B8CB1 /end MEASUREMENT
/begin MEASUREMENT S_bls "Schalter Bremslicht" UBYTE B_TRUE 1 100 0 1 BIT_MASK 0x1 FORMAT "%13.11" ECU_ADDRESS 0x3FBC09 /end MEASUREMENT
/begin MEASUREMENT S_brs "Schalter Bremstest" UBYTE B_TRUE 1 100 0 1 BIT_MASK 0x1 FORMAT "%13.11" ECU_ADDRESS 0x3FBC0A /end MEASUREMENT
/begin MEASUREMENT S_hz "Schalter Heizung" UBYTE B_TRUE 1 100 0 1 BIT_MASK 0x1 FORMAT "%13.11" ECU_ADDRESS 0x3FBC0B /end MEASUREMENT
/begin MEASUREMENT S_kl15 "Schalter Klemme 15" UBYTE B_TRUE 1 100 0 1 BIT_MASK 0x1 FORMAT "%13.11" ECU_ADDRESS 0x3FBC0C /end MEASUREMENT
/begin MEASUREMENT S_kupp "Schalter Kupplung" UBYTE B_TRUE 1 100 0 1 BIT_MASK 0x1 FORMAT "%13.11" ECU_ADDRESS 0x3FBC0D /end MEASUREMENT
/begin MEASUREMENT tabgmf "gefilterte Abgastemperatur aus Modell" UBYTE temp_ub_q5_o50 1 100 -50 1225 FORMAT "%5.0" ECU_ADDRESS 0x5B865E /end MEASUREMENT
/begin MEASUREMENT tkatmf "gefilterte Katalysatortemperatur aus Modell" UBYTE temp_ub_q5_o50 1 100 -50 1225 FORMAT "%5.0" ECU_ADDRESS 0x5B865F /end MEASUREMENT
/begin MEASUREMENT TYP_brems "Fehlertyp: Gebergrˆﬂe Bremsschalter" UWORD B_TRUE 1 100 0 1 BIT_MASK 0xf00 FORMAT "%13.11" ECU_ADDRESS 0x3FDD28 /end MEASUREMENT
/begin MEASUREMENT TYP_bwf "Fehlertyp:  PWG Bewegung" UWORD B_TRUE 1 100 0 1 BIT_MASK 0xf00 FORMAT "%13.11" ECU_ADDRESS 0x3FDD2A /end MEASUREMENT
/begin MEASUREMENT TYP_dgen "" UWORD B_TRUE 1 100 0 1 BIT_MASK 0xf00 FORMAT "%13.11" ECU_ADDRESS 0x3FDD3A /end MEASUREMENT
/begin MEASUREMENT TYP_dgenbs "" UWORD B_TRUE 1 100 0 1 BIT_MASK 0xf00 FORMAT "%13.11" ECU_ADDRESS 0x3FDD3C /end MEASUREMENT
/begin MEASUREMENT TYP_dsu "" UWORD B_TRUE 1 100 0 1 BIT_MASK 0xf00 FORMAT "%13.11" ECU_ADDRESS 0x3FDD4C /end MEASUREMENT
/begin MEASUREMENT TYP_dwa "" UWORD B_TRUE 1 100 0 1 BIT_MASK 0xf00 FORMAT "%13.11" ECU_ADDRESS 0x3FDD64 /end MEASUREMENT
/begin MEASUREMENT TYP_dzku0 "" UWORD B_TRUE 1 100 0 1 BIT_MASK 0xf00 FORMAT "%13.11" ECU_ADDRESS 0x3FDD66 /end MEASUREMENT
/begin MEASUREMENT TYP_dzku1 "" UWORD B_TRUE 1 100 0 1 BIT_MASK 0xf00 FORMAT "%13.11" ECU_ADDRESS 0x3FDD68 /end MEASUREMENT
/begin MEASUREMENT TYP_dzku2 "" UWORD B_TRUE 1 100 0 1 BIT_MASK 0xf00 FORMAT "%13.11" ECU_ADDRESS 0x3FDD6A /end MEASUREMENT
/begin MEASUREMENT TYP_dzku3 "" UWORD B_TRUE 1 100 0 1 BIT_MASK 0xf00 FORMAT "%13.11" ECU_ADDRESS 0x3FDD6C /end MEASUREMENT
/begin MEASUREMENT TYP_dzku4 "" UWORD B_TRUE 1 100 0 1 BIT_MASK 0xf00 FORMAT "%13.11" ECU_ADDRESS 0x3FDD6E /end MEASUREMENT
/begin MEASUREMENT TYP_dzku5 "" UWORD B_TRUE 1 100 0 1 BIT_MASK 0xf00 FORMAT "%13.11" ECU_ADDRESS 0x3FDD70 /end MEASUREMENT
/begin MEASUREMENT TYP_dzku6 "" UWORD B_TRUE 1 100 0 1 BIT_MASK 0xf00 FORMAT "%13.11" ECU_ADDRESS 0x3FDD72 /end MEASUREMENT
/begin MEASUREMENT TYP_dzku7 "" UWORD B_TRUE 1 100 0 1 BIT_MASK 0xf00 FORMAT "%13.11" ECU_ADDRESS 0x3FDD74 /end MEASUREMENT
/begin MEASUREMENT TYP_egfe "" UWORD B_TRUE 1 100 0 1 BIT_MASK 0xf00 FORMAT "%13.11" ECU_ADDRESS 0x3FDD76 /end MEASUREMENT
/begin MEASUREMENT TYP_fp1p "" UWORD B_TRUE 1 100 0 1 BIT_MASK 0xf00 FORMAT "%13.11" ECU_ADDRESS 0x3FDD92 /end MEASUREMENT
/begin MEASUREMENT TYP_fp2p "" UWORD B_TRUE 1 100 0 1 BIT_MASK 0xf00 FORMAT "%13.11" ECU_ADDRESS 0x3FDD94 /end MEASUREMENT
/begin MEASUREMENT TYP_fpp "" UWORD B_TRUE 1 100 0 1 BIT_MASK 0xf00 FORMAT "%13.11" ECU_ADDRESS 0x3FDD96 /end MEASUREMENT
/begin MEASUREMENT TYP_mdb "Fehlertyp: Momentenbegrenzung (begrenzt dauerhaft) aktiv" UWORD B_TRUE 1 100 0 1 BIT_MASK 0xf00 FORMAT "%13.11" ECU_ADDRESS 0x3FDDFA /end MEASUREMENT
/begin MEASUREMENT TYP_mfl "" UWORD B_TRUE 1 100 0 1 BIT_MASK 0xf00 FORMAT "%13.11" ECU_ADDRESS 0x3FDDFE /end MEASUREMENT
/begin MEASUREMENT TYP_ta "" UWORD B_TRUE 1 100 0 1 BIT_MASK 0xf00 FORMAT "%13.11" ECU_ADDRESS 0x3FDE26 /end MEASUREMENT
/begin MEASUREMENT TYP_tka "" UWORD B_TRUE 1 100 0 1 BIT_MASK 0xf00 FORMAT "%13.11" ECU_ADDRESS 0x3FDE2E /end MEASUREMENT
/begin MEASUREMENT TYP_tm "" UWORD B_TRUE 1 100 0 1 BIT_MASK 0xf00 FORMAT "%13.11" ECU_ADDRESS 0x3FDE30 /end MEASUREMENT
/begin MEASUREMENT TYP_tum "" UWORD B_TRUE 1 100 0 1 BIT_MASK 0xf00 FORMAT "%13.11" ECU_ADDRESS 0x3FDE34 /end MEASUREMENT
/begin MEASUREMENT TYP_ub "" UWORD B_TRUE 1 100 0 1 BIT_MASK 0xf00 FORMAT "%13.11" ECU_ADDRESS 0x3FDE36 /end MEASUREMENT
/begin MEASUREMENT TYP_ubr "" UWORD B_TRUE 1 100 0 1 BIT_MASK 0xf00 FORMAT "%13.11" ECU_ADDRESS 0x3FDE38 /end MEASUREMENT
/begin MEASUREMENT TYP_ufmv "Fehlertyp: Funktions¸berwachung: Momentenvergleich" UWORD B_TRUE 1 100 0 1 BIT_MASK 0xf00 FORMAT "%13.11" ECU_ADDRESS 0x3FDE3A /end MEASUREMENT
/begin MEASUREMENT TYP_ufnc "" UWORD B_TRUE 1 100 0 1 BIT_MASK 0xf00 FORMAT "%13.11" ECU_ADDRESS 0x3FDE3C /end MEASUREMENT
/begin MEASUREMENT TYP_ufrlip "" UWORD B_TRUE 1 100 0 1 BIT_MASK 0xf00 FORMAT "%13.11" ECU_ADDRESS 0x3FDE3E /end MEASUREMENT
/begin MEASUREMENT TYP_ufsga "" UWORD B_TRUE 1 100 0 1 BIT_MASK 0xf00 FORMAT "%13.11" ECU_ADDRESS 0x3FDE40 /end MEASUREMENT
/begin MEASUREMENT TYP_ufsgb "" UWORD B_TRUE 1 100 0 1 BIT_MASK 0xf00 FORMAT "%13.11" ECU_ADDRESS 0x3FDE42 /end MEASUREMENT
/begin MEASUREMENT TYP_ufsgc "" UWORD B_TRUE 1 100 0 1 BIT_MASK 0xf00 FORMAT "%13.11" ECU_ADDRESS 0x3FDE44 /end MEASUREMENT
/begin MEASUREMENT TYP_ufspsc "" UWORD B_TRUE 1 100 0 1 BIT_MASK 0xf00 FORMAT "%13.11" ECU_ADDRESS 0x3FDE46 /end MEASUREMENT
/begin MEASUREMENT TYP_urram "Fehlertyp: Rechner¸berwachung: RAM" UWORD B_TRUE 1 100 0 1 BIT_MASK 0xf00 FORMAT "%13.11" ECU_ADDRESS 0x3FDE48 /end MEASUREMENT
/begin MEASUREMENT TYP_urrom "Fehlertyp: Rechner¸berwachung: ROM" UWORD B_TRUE 1 100 0 1 BIT_MASK 0xf00 FORMAT "%13.11" ECU_ADDRESS 0x3FDE4A /end MEASUREMENT
/begin MEASUREMENT TYP_urrst "Fehlertyp: Rechner¸berwachung: Reset" UWORD B_TRUE 1 100 0 1 BIT_MASK 0xf00 FORMAT "%13.11" ECU_ADDRESS 0x3FDE4C /end MEASUREMENT
/begin MEASUREMENT TYP_vfz "" UWORD B_TRUE 1 100 0 1 BIT_MASK 0xf00 FORMAT "%13.11" ECU_ADDRESS 0x3FDE4E /end MEASUREMENT
/begin MEASUREMENT TYP_wca "" UWORD B_TRUE 1 100 0 1 BIT_MASK 0xf00 FORMAT "%13.11" ECU_ADDRESS 0x3FDE50 /end MEASUREMENT
/begin MEASUREMENT TYP_wfs "" UWORD B_TRUE 1 100 0 1 BIT_MASK 0xf00 FORMAT "%13.11" ECU_ADDRESS 0x3FDE52 /end MEASUREMENT
/begin MEASUREMENT t_disa1 "Timer 1" UWORD t10msxs_uw_b655p35 1 100 0 655.35 FORMAT "%8.4" ECU_ADDRESS 0x5B86C2 /end MEASUREMENT
/begin MEASUREMENT t_disa2 "Timer 2" UWORD t10msxs_uw_b655p35 1 100 0 655.35 FORMAT "%8.4" ECU_ADDRESS 0x5B86C4 /end MEASUREMENT
/begin MEASUREMENT wdkbadmn_w "Winkel-DK f¸r Adressierung von KFMLDMN" SWORD relDK_q0p02441 1 100 -800 799.976 FORMAT "%8.4" ECU_ADDRESS 0x5B9160 /end MEASUREMENT
/begin MEASUREMENT wdkbadmx_w "Winkel-DK f¸r Adressierung von KFMLDMX" SWORD relDK_q0p02441 1 100 -800 799.976 FORMAT "%8.4" ECU_ADDRESS 0x5B9162 /end MEASUREMENT
/begin MEASUREMENT Z_brems "Zyklusflag: BREMS (Bremsschalter)" UWORD B_TRUE 1 100 0 1 BIT_MASK 0x2 FORMAT "%13.11" ECU_ADDRESS 0x3FDD28 /end MEASUREMENT
/begin MEASUREMENT Z_bwf "Zyklusflag: PWG Bewegung" UWORD B_TRUE 1 100 0 1 BIT_MASK 0x2 FORMAT "%13.11" ECU_ADDRESS 0x3FDD2A /end MEASUREMENT
/begin MEASUREMENT Z_dgen "" UWORD B_TRUE 1 100 0 1 BIT_MASK 0x2 FORMAT "%13.11" ECU_ADDRESS 0x3FDD3A /end MEASUREMENT
/begin MEASUREMENT Z_dgenbs "" UWORD B_TRUE 1 100 0 1 BIT_MASK 0x2 FORMAT "%13.11" ECU_ADDRESS 0x3FDD3C /end MEASUREMENT
/begin MEASUREMENT Z_dsu "Zyklusflag: Umgebungsdrucksensor" UWORD B_TRUE 1 100 0 1 BIT_MASK 0x2 FORMAT "%13.11" ECU_ADDRESS 0x3FDD4C /end MEASUREMENT
/begin MEASUREMENT Z_dwa "Zyklusflag: Diebstahlwarnanlage" UWORD B_TRUE 1 100 0 1 BIT_MASK 0x2 FORMAT "%13.11" ECU_ADDRESS 0x3FDD64 /end MEASUREMENT
/begin MEASUREMENT Z_dzku0 "Zyklusflag Z¸ndkreisdiagnose" UWORD B_TRUE 1 100 0 1 BIT_MASK 0x2 FORMAT "%13.11" ECU_ADDRESS 0x3FDD66 /end MEASUREMENT
/begin MEASUREMENT Z_dzku1 "Zyklusflag Z¸ndkreisdiagnose" UWORD B_TRUE 1 100 0 1 BIT_MASK 0x2 FORMAT "%13.11" ECU_ADDRESS 0x3FDD68 /end MEASUREMENT
/begin MEASUREMENT Z_dzku2 "Zyklusflag Z¸ndkreisdiagnose" UWORD B_TRUE 1 100 0 1 BIT_MASK 0x2 FORMAT "%13.11" ECU_ADDRESS 0x3FDD6A /end MEASUREMENT
/begin MEASUREMENT Z_dzku3 "Zyklusflag Z¸ndkreisdiagnose" UWORD B_TRUE 1 100 0 1 BIT_MASK 0x2 FORMAT "%13.11" ECU_ADDRESS 0x3FDD6C /end MEASUREMENT
/begin MEASUREMENT Z_dzku4 "Zyklusflag Z¸ndkreisdiagnose" UWORD B_TRUE 1 100 0 1 BIT_MASK 0x2 FORMAT "%13.11" ECU_ADDRESS 0x3FDD6E /end MEASUREMENT
/begin MEASUREMENT Z_dzku5 "Zyklusflag Z¸ndkreisdiagnose" UWORD B_TRUE 1 100 0 1 BIT_MASK 0x2 FORMAT "%13.11" ECU_ADDRESS 0x3FDD70 /end MEASUREMENT
/begin MEASUREMENT Z_dzku6 "Zyklusflag Z¸ndkreisdiagnose" UWORD B_TRUE 1 100 0 1 BIT_MASK 0x2 FORMAT "%13.11" ECU_ADDRESS 0x3FDD72 /end MEASUREMENT
/begin MEASUREMENT Z_dzku7 "Zyklusflag Z¸ndkreisdiagnose" UWORD B_TRUE 1 100 0 1 BIT_MASK 0x2 FORMAT "%13.11" ECU_ADDRESS 0x3FDD74 /end MEASUREMENT
/begin MEASUREMENT Z_egfe "Zyklusflag: Eingangsgrˆﬂen F¸llungserfassung" UWORD B_TRUE 1 100 0 1 BIT_MASK 0x2 FORMAT "%13.11" ECU_ADDRESS 0x3FDD76 /end MEASUREMENT
/begin MEASUREMENT Z_fp1p "Zyklusflag: Fahrpedal 1. Poti" UWORD B_TRUE 1 100 0 1 BIT_MASK 0x2 FORMAT "%13.11" ECU_ADDRESS 0x3FDD92 /end MEASUREMENT
/begin MEASUREMENT Z_fp2p "Zyklusflag: Fahrpedal 2. Poti" UWORD B_TRUE 1 100 0 1 BIT_MASK 0x2 FORMAT "%13.11" ECU_ADDRESS 0x3FDD94 /end MEASUREMENT
/begin MEASUREMENT Z_fpp "Zyklusflag Fahrpedal-Poti" UWORD B_TRUE 1 100 0 1 BIT_MASK 0x2 FORMAT "%13.11" ECU_ADDRESS 0x3FDD96 /end MEASUREMENT
/begin MEASUREMENT Z_mdb "Zyklusflag: Momentenbegrenzung begrenzt dauerhaft" UWORD B_TRUE 1 100 0 1 BIT_MASK 0x2 FORMAT "%13.11" ECU_ADDRESS 0x3FDDFA /end MEASUREMENT
/begin MEASUREMENT Z_mfl "Zyklusflag: Multifunktionslenrad (MFL)" UWORD B_TRUE 1 100 0 1 BIT_MASK 0x2 FORMAT "%13.11" ECU_ADDRESS 0x3FDDFE /end MEASUREMENT
/begin MEASUREMENT Z_ta "Zyklusflag: TANS" UWORD B_TRUE 1 100 0 1 BIT_MASK 0x2 FORMAT "%13.11" ECU_ADDRESS 0x3FDE26 /end MEASUREMENT
/begin MEASUREMENT Z_TKA "Zyklusflag Temperatur K¸hlerausgang" UWORD B_TRUE 1 100 0 1 BIT_MASK 0x2 FORMAT "%13.11" ECU_ADDRESS 0x3FDE2E /end MEASUREMENT
/begin MEASUREMENT Z_tm "Zyklusflag:	TMOT" UWORD B_TRUE 1 100 0 1 BIT_MASK 0x2 FORMAT "%13.11" ECU_ADDRESS 0x3FDE30 /end MEASUREMENT
/begin MEASUREMENT Z_tum "Zyklusflag: Umgebungstemperatur TUM" UWORD B_TRUE 1 100 0 1 BIT_MASK 0x2 FORMAT "%13.11" ECU_ADDRESS 0x3FDE34 /end MEASUREMENT
/begin MEASUREMENT Z_ub "Zyklusflag:	UB" UWORD B_TRUE 1 100 0 1 BIT_MASK 0x2 FORMAT "%13.11" ECU_ADDRESS 0x3FDE36 /end MEASUREMENT
/begin MEASUREMENT Z_ubr "Zyklusflag: Bordnetzspannung ¸ber Hauptrelais UBR" UWORD B_TRUE 1 100 0 1 BIT_MASK 0x2 FORMAT "%13.11" ECU_ADDRESS 0x3FDE38 /end MEASUREMENT
/begin MEASUREMENT Z_ufmv "Zyklusflag: Funktions¸berwachung: Momentenvergleich" UWORD B_TRUE 1 100 0 1 BIT_MASK 0x2 FORMAT "%13.11" ECU_ADDRESS 0x3FDE3A /end MEASUREMENT
/begin MEASUREMENT Z_ufnc "Zyklusflag: Funktions¸berwachung: Drehzahlgeber-, Zuleitung- oder SG-Fehler" UWORD B_TRUE 1 100 0 1 BIT_MASK 0x2 FORMAT "%13.11" ECU_ADDRESS 0x3FDE3C /end MEASUREMENT
/begin MEASUREMENT Z_ufrlip "Zyklusflag: Funktions¸berwachung: Lastsensor-, Zuleitung- oder SG-Fehler" UWORD B_TRUE 1 100 0 1 BIT_MASK 0x2 FORMAT "%13.11" ECU_ADDRESS 0x3FDE3E /end MEASUREMENT
/begin MEASUREMENT Z_ufsga "Zyklusflag: Funktions¸berwachung: Steuerger‰te-Fehler Gruppe a" UWORD B_TRUE 1 100 0 1 BIT_MASK 0x2 FORMAT "%13.11" ECU_ADDRESS 0x3FDE40 /end MEASUREMENT
/begin MEASUREMENT Z_ufsgb "Zyklusflag: Funktions¸berwachung: Steuerger‰te-Fehler Gruppe b" UWORD B_TRUE 1 100 0 1 BIT_MASK 0x2 FORMAT "%13.11" ECU_ADDRESS 0x3FDE42 /end MEASUREMENT
/begin MEASUREMENT Z_ufsgc "Zyklusflag: Funktions¸berwachung: Steuerger‰te-Fehler Gruppe c" UWORD B_TRUE 1 100 0 1 BIT_MASK 0x2 FORMAT "%13.11" ECU_ADDRESS 0x3FDE44 /end MEASUREMENT
/begin MEASUREMENT Z_ufspsc "Zyklusflag: Funktions¸berwachung: Pedalwertgeber-, Zuleitung- oder SG-Fehler" UWORD B_TRUE 1 100 0 1 BIT_MASK 0x2 FORMAT "%13.11" ECU_ADDRESS 0x3FDE46 /end MEASUREMENT
/begin MEASUREMENT Z_urram "Zyklusflag: Rechner¸berwachung: RAM" UWORD B_TRUE 1 100 0 1 BIT_MASK 0x2 FORMAT "%13.11" ECU_ADDRESS 0x3FDE48 /end MEASUREMENT
/begin MEASUREMENT Z_urrom "Zyklusflag: Rechner¸berwachung: ROM" UWORD B_TRUE 1 100 0 1 BIT_MASK 0x2 FORMAT "%13.11" ECU_ADDRESS 0x3FDE4A /end MEASUREMENT
/begin MEASUREMENT Z_urrst "Zyklusflag: Rechner¸berwachung: Reset" UWORD B_TRUE 1 100 0 1 BIT_MASK 0x2 FORMAT "%13.11" ECU_ADDRESS 0x3FDE4C /end MEASUREMENT
/begin MEASUREMENT Z_vfz "Zyklusflag: Fahrzeug-Geschwindigkeit" UWORD B_TRUE 1 100 0 1 BIT_MASK 0x2 FORMAT "%13.11" ECU_ADDRESS 0x3FDE4E /end MEASUREMENT
/begin MEASUREMENT Z_wca "Zyklusflag: Wegfahrsperre Wechselcode-Ablage" UWORD B_TRUE 1 100 0 1 BIT_MASK 0x2 FORMAT "%13.11" ECU_ADDRESS 0x3FDE50 /end MEASUREMENT
/begin MEASUREMENT Z_wfs "Zyklusflag: Wegfahrsperre" UWORD B_TRUE 1 100 0 1 BIT_MASK 0x2 FORMAT "%13.11" ECU_ADDRESS 0x3FDE52 /end MEASUREMENT
/begin FUNCTION DFPM_DUF ""
 /begin DEF_CHARACTERISTIC CDCUFMV CDCUFNC CDCUFRLIP CDCUFSGA CDCUFSGB CDCUFSGC CDCUFSPSC CDKUFMV CDKUFNC CDKUFRLIP CDKUFSGA CDKUFSGB CDKUFSGC CDKUFSPSC CDTUFMV CDTUFNC CDTUFRLIP CDTUFSGA CDTUFSGB CDTUFSGC CDTUFSPSC CLAUFMV CLAUFNC CLAUFRLIP CLAUFSGA CLAUFSGB CLAUFSGC CLAUFSPSC FFTUFMV FFTUFNC FFTUFRLIP FFTUFSGA FFTUFSGB FFTUFSGC FFTUFSPSC TSFUFMV TSFUFNC TSFUFRLIP TSFUFSGA TSFUFSGB TSFUFSGC TSFUFSPSC /end DEF_CHARACTERISTIC
 /begin OUT_MEASUREMENT B_beufmv B_beufnc B_beufrlip B_beufsga B_beufsgb B_beufsgc B_beufspsc B_bkufmv B_bkufnc B_bkufrlip B_bkufsga B_bkufsgb B_bkufsgc B_bkufspsc B_clufmv B_clufnc B_clufrlip B_clufsga B_clufsgb B_clufsgc B_clufspsc B_ftufmv B_ftufnc B_ftufrlip B_ftufsga B_ftufsgb B_ftufsgc B_ftufspsc B_mnufmv B_mnufnc B_mnufrlip B_mnufsga B_mnufsgb B_mnufsgc B_mnufspsc B_mxufmv B_mxufnc B_mxufrlip B_mxufsga B_mxufsgb B_mxufsgc B_mxufspsc B_npufmv B_npufnc B_npufrlip B_npufsga B_npufsgb B_npufsgc B_npufspsc B_siufmv B_siufnc B_siufrlip B_siufsga B_siufsgb B_siufsgc B_siufspsc E_ufmv E_ufnc E_ufrlip E_ufsga E_ufsgb E_ufsgc E_ufspsc sfpufmv sfpufnc sfpufrlip sfpufsga sfpufsgb sfpufsgc sfpufspsc TYP_ufmv TYP_ufnc TYP_ufrlip TYP_ufsga TYP_ufsgb TYP_ufsgc TYP_ufspsc Z_ufmv Z_ufnc Z_ufrlip Z_ufsga Z_ufsgb Z_ufsgc Z_ufspsc /end OUT_MEASUREMENT
/end FUNCTION
/begin FUNCTION DFPM_DUR ""
 /begin DEF_CHARACTERISTIC CDCURRAM CDCURROM CDCURRST CDKURRAM CDKURROM CDKURRST CDTURRAM CDTURROM CDTURRST CLAURRAM CLAURROM CLAURRST FFTURRAM FFTURROM FFTURRST TSFURRAM TSFURROM TSFURRST /end DEF_CHARACTERISTIC
 /begin OUT_MEASUREMENT B_beurram B_beurrom B_beurrst B_bkurram B_bkurrom B_bkurrst B_clurram B_clurrom B_clurrst B_fturram B_fturrom B_fturrst B_mnurram B_mnurrom B_mnurrst B_mxurram B_mxurrom B_mxurrst B_npurram B_npurrom B_npurrst B_siurram B_siurrom B_siurrst E_urram E_urrom E_urrst sfpurram sfpurrom sfpurrst TYP_urram TYP_urrom TYP_urrst Z_urram Z_urrom Z_urrst /end OUT_MEASUREMENT
/end FUNCTION
/begin FUNCTION DFPM_DVFZ "" /begin DEF_CHARACTERISTIC CDCVFZ CDKVFZ CDTVFZ CLAVFZ FFTVFZ TSFVFZ /end DEF_CHARACTERISTIC
 /begin OUT_MEASUREMENT B_bevfz B_bkvfz B_clvfz B_ftvfz B_mnvfz B_mxvfz B_npvfz B_sivfz E_vfz sfpvfz TYP_vfz Z_vfz /end OUT_MEASUREMENT
/end FUNCTION
/begin FUNCTION DFPM_DZKU ""
 /begin DEF_CHARACTERISTIC CDCDZKU0 CDCDZKU1 CDCDZKU2 CDCDZKU3 CDCDZKU4 CDCDZKU5 CDCDZKU6 CDCDZKU7 CDKDZKU0 CDKDZKU1 CDKDZKU2 CDKDZKU3 CDKDZKU4 CDKDZKU5 CDKDZKU6 CDKDZKU7 CDTDZKU0 CDTDZKU1 CDTDZKU2 CDTDZKU3 CDTDZKU4 CDTDZKU5 CDTDZKU6 CDTDZKU7 CLADZKU0 CLADZKU1 CLADZKU2 CLADZKU3 CLADZKU4 CLADZKU5 CLADZKU6 CLADZKU7 FFTDZKU0 FFTDZKU1 FFTDZKU2 FFTDZKU3 FFTDZKU4 FFTDZKU5 FFTDZKU6 FFTDZKU7 TSFDZKU0 TSFDZKU1 TSFDZKU2 TSFDZKU3 TSFDZKU4 TSFDZKU5 TSFDZKU6 TSFDZKU7 /end DEF_CHARACTERISTIC
 /begin OUT_MEASUREMENT B_bedzku0 B_bedzku1 B_bedzku2 B_bedzku3 B_bedzku4 B_bedzku5 B_bedzku6 B_bedzku7 B_bkdzku0 B_bkdzku1 B_bkdzku2 B_bkdzku3 B_bkdzku4 B_bkdzku5 B_bkdzku6 B_bkdzku7 B_cldzku0 B_cldzku1 B_cldzku2 B_cldzku3 B_cldzku4 B_cldzku5 B_cldzku6 B_cldzku7 B_ftdzku0 B_ftdzku1 B_ftdzku2 B_ftdzku3 B_ftdzku4 B_ftdzku5 B_ftdzku6 B_ftdzku7 B_mndzku0 B_mndzku1 B_mndzku2 B_mndzku3 B_mndzku4 B_mndzku5 B_mndzku6 B_mndzku7 B_mxdzku0 B_mxdzku1 B_mxdzku2 B_mxdzku3 B_mxdzku4 B_mxdzku5 B_mxdzku6 B_mxdzku7 B_npdzku0 B_npdzku1 B_npdzku2 B_npdzku3 B_npdzku4 B_npdzku5 B_npdzku6 B_npdzku7 B_sidzku0 B_sidzku1 B_sidzku2 B_sidzku3 B_sidzku4 B_sidzku5 B_sidzku6 B_sidzku7 E_dzku0 E_dzku1 E_dzku2 E_dzku3 E_dzku4 E_dzku5 E_dzku6 E_dzku7 sfpdzku0 sfpdzku1 sfpdzku2 sfpdzku3 sfpdzku4 sfpdzku5 sfpdzku6 sfpdzku7 TYP_dzku0 TYP_dzku1 TYP_dzku2 TYP_dzku3 TYP_dzku4 TYP_dzku5 TYP_dzku6 TYP_dzku7 Z_dzku0 Z_dzku1 Z_dzku2 Z_dzku3 Z_dzku4 Z_dzku5 Z_dzku6 Z_dzku7 /end OUT_MEASUREMENT
/end FUNCTION
/begin FUNCTION DFPM_EGFE "" /begin DEF_CHARACTERISTIC CDCEGFE CDKEGFE CDTEGFE CLAEGFE FFTEGFE TSFEGFE /end DEF_CHARACTERISTIC
 /begin OUT_MEASUREMENT B_beegfe B_bkegfe B_clegfe B_ftegfe B_mnegfe B_mxegfe B_npegfe B_siegfe E_egfe sfpegfe TYP_egfe Z_egfe /end OUT_MEASUREMENT
/end FUNCTION
/begin FUNCTION DFPM_FSPVDGEN "FSPVDGEN.exported"
 /begin DEF_CHARACTERISTIC CDCDGEN CDCDGENBS CDKDGEN CDKDGENBS CDTDGEN CDTDGENBS CLADGEN CLADGENBS FFTDGEN FFTDGENBS TSFDGEN TSFDGENBS /end DEF_CHARACTERISTIC
 /begin OUT_MEASUREMENT B_bedgen B_bedgenbs B_bkdgen B_bkdgenbs B_cldgen B_cldgenbs B_ftdgen B_ftdgenbs B_mndgen B_mndgenbs B_mxdgen B_mxdgenbs B_npdgen B_npdgenbs B_sidgen B_sidgenbs E_dgen E_dgenbs sfpdgen sfpdgenbs TYP_dgen TYP_dgenbs Z_dgen Z_dgenbs /end OUT_MEASUREMENT
/end FUNCTION
/begin FUNCTION DFPM_GGDSAS "" /begin DEF_CHARACTERISTIC CDCDSU CDKDSU CDTDSU CLADSU FFTDSU TSFDSU /end DEF_CHARACTERISTIC
 /begin OUT_MEASUREMENT B_bedsu B_bkdsu B_cldsu B_ftdsu B_mndsu B_mxdsu B_npdsu B_sidsu E_dsu sfpdsu TYP_dsu Z_dsu /end OUT_MEASUREMENT
/end FUNCTION
/begin FUNCTION DFPM_GGEGAS "" /begin DEF_CHARACTERISTIC CDCBREMS CDKBREMS CDTBREMS CLABREMS FFTBREMS TSFBREMS /end DEF_CHARACTERISTIC
 /begin OUT_MEASUREMENT B_bebrems B_bkbrems B_clbrems B_ftbrems B_mnbrems B_mxbrems B_npbrems B_sibrems E_brems sfpbrems TYP_brems Z_brems /end OUT_MEASUREMENT
/end FUNCTION
/begin FUNCTION DFPM_GGMFL "" /begin DEF_CHARACTERISTIC CDCMFL CDKMFL CDTMFL CLAMFL FFTMFL TSFMFL /end DEF_CHARACTERISTIC
 /begin OUT_MEASUREMENT B_bemfl B_bkmfl B_clmfl B_ftmfl B_mnmfl B_mxmfl B_npmfl B_simfl E_mfl sfpmfl TYP_mfl Z_mfl /end OUT_MEASUREMENT
/end FUNCTION
/begin FUNCTION DFPM_GGPED ""
 /begin DEF_CHARACTERISTIC CDCBWF CDCFP1P CDCFP2P CDCFPP CDKBWF CDKFP1P CDKFP2P CDKFPP CDTBWF CDTFP1P CDTFP2P CDTFPP CLABWF CLAFP1P CLAFP2P CLAFPP FFTBWF FFTFP1P FFTFP2P FFTFPP TSFBWF TSFFP1P TSFFP2P TSFFPP /end DEF_CHARACTERISTIC
 /begin OUT_MEASUREMENT B_bebwf B_befp1p B_befp2p B_befpp B_bkbwf B_bkfp1p B_bkfp2p B_bkfpp B_clbwf B_clfp1p B_clfp2p B_clfpp B_ftbwf B_ftfp1p B_ftfp2p B_ftfpp B_mnbwf B_mnfp1p B_mnfp2p B_mnfpp B_mxbwf B_mxfp1p B_mxfp2p B_mxfpp B_npbwf B_npfp1p B_npfp2p B_npfpp B_sibwf B_sifp1p B_sifp2p B_sifpp E_bwf E_fp1p E_fp2p E_fpp sfpbwf sfpfp1p sfpfp2p sfpfpp TYP_bwf TYP_fp1p TYP_fp2p TYP_fpp Z_bwf Z_fp1p Z_fp2p Z_fpp /end OUT_MEASUREMENT
/end FUNCTION
/begin FUNCTION DFPM_GGTFA "" /begin DEF_CHARACTERISTIC CDCTA CDKTA CDTTA CLATA FFTTA TSFTA /end DEF_CHARACTERISTIC
 /begin OUT_MEASUREMENT B_beta B_bkta B_clta B_ftta B_mnta B_mxta B_npta B_sita E_ta sfpta TYP_ta Z_ta /end OUT_MEASUREMENT
/end FUNCTION
/begin FUNCTION DFPM_GGTFM "" /begin DEF_CHARACTERISTIC CDCTM CDKTM CDTTM CLATM FFTTM TSFTM /end DEF_CHARACTERISTIC
 /begin OUT_MEASUREMENT B_betm B_bktm B_cltm B_fttm B_mntm B_mxtm B_nptm B_sitm E_tm sfptm TYP_tm Z_tm /end OUT_MEASUREMENT
/end FUNCTION
/begin FUNCTION DFPM_GGTFUMG "" /begin DEF_CHARACTERISTIC CDCTUM CDKTUM CDTTUM CLATUM FFTTUM TSFTUM /end DEF_CHARACTERISTIC
 /begin OUT_MEASUREMENT B_betum B_bktum B_cltum B_fttum B_mntum B_mxtum B_nptum B_situm E_tum sfptum TYP_tum Z_tum /end OUT_MEASUREMENT
/end FUNCTION
/begin FUNCTION DFPM_GGTKA "" /begin DEF_CHARACTERISTIC CDCTKA CDKTKA CDTTKA CLATKA FFTTKA TSFTKA /end DEF_CHARACTERISTIC
 /begin OUT_MEASUREMENT B_betka B_bktka B_cltka B_fttka B_mntka B_mxtka B_nptka B_sitka E_TKA sfptka TYP_tka Z_TKA /end OUT_MEASUREMENT
/end FUNCTION
/begin FUNCTION DFPM_GGUB "" /begin DEF_CHARACTERISTIC CDCUB CDKUB CDTUB CLAUB FFTUB TSFUB /end DEF_CHARACTERISTIC
 /begin OUT_MEASUREMENT B_beub B_bkub B_club B_ftub B_mnub B_mxub B_npub B_siub E_ub sfpub TYP_ub Z_ub /end OUT_MEASUREMENT
/end FUNCTION
/begin FUNCTION DFPM_GGUBR "" /begin DEF_CHARACTERISTIC CDCUBR CDKUBR CDTUBR CLAUBR FFTUBR TSFUBR /end DEF_CHARACTERISTIC
 /begin OUT_MEASUREMENT B_beubr B_bkubr B_clubr B_ftubr B_mnubr B_mxubr B_npubr B_siubr E_ubr sfpubr TYP_ubr Z_ubr /end OUT_MEASUREMENT
/end FUNCTION
/begin FUNCTION DFPM_MDKOG "" /begin DEF_CHARACTERISTIC CDCMDB CDKMDB CDTMDB CLAMDB FFTMDB TSFMDB /end DEF_CHARACTERISTIC
 /begin OUT_MEASUREMENT B_bemdb B_bkmdb B_clmdb B_ftmdb B_mnmdb B_mxmdb B_npmdb B_simdb E_mdb sfpmdb TYP_mdb Z_mdb /end OUT_MEASUREMENT
/end FUNCTION
/begin FUNCTION DFPM_WFS ""
 /begin DEF_CHARACTERISTIC CDCDWA CDCWCA CDCWFS CDKDWA CDKWCA CDKWFS CDTDWA CDTWCA CDTWFS CLADWA CLAWCA CLAWFS FFTDWA FFTWCA FFTWFS TSFDWA TSFWCA TSFWFS /end DEF_CHARACTERISTIC
 /begin OUT_MEASUREMENT B_bedwa B_bewca B_bewfs B_bkdwa B_bkwca B_bkwfs B_cldwa B_clwca B_clwfs B_fadwa B_fawca B_fawfs B_mndwa B_mnwca B_mnwfs B_mxdwa B_mxwca B_mxwfs B_npdwa B_npwca B_npwfs B_sidwa B_siwca B_siwfs E_dwa E_wca E_wfs sfpdwa sfpwca sfpwfs TYP_dwa TYP_wca TYP_wfs Z_dwa Z_wca Z_wfs /end OUT_MEASUREMENT
/end FUNCTION
/begin FUNCTION DFRZ "OBDII; Beschreibung 'freeze frame'" /end FUNCTION
/begin FUNCTION DGEN "DGEN.exportedDiagnose BSD-Generator und KL61-Bildung"
 /begin DEF_CHARACTERISTIC GENPDTIME GEN_DNMIN GFBSUTERR GFBSUTHEAL GFELTERR GFELTHEAL GFHTTERR GFHTTHEAL GFMETERR GFMETHEAL GFNOBTERR GFNOBTHEAL MSKGENDFP MSKGENKL61 SNMBSDKL61 /end DEF_CHARACTERISTIC
 /begin IN_MEASUREMENT B_genfbsd B_genfel B_genfht B_genfkupl B_genfme B_genfprl B_genoff B_gfbsupak B_gfelak B_gfhtak B_gfmeak B_gfnobsak B_nmot nmot_w /end IN_MEASUREMENT
 /begin OUT_MEASUREMENT B_1stbsder B_auxerr B_gfbsupep B_gfelep B_gfhtep B_gfmeep B_gfnobsep B_kl61 genfbsak genstatroh st_gen /end OUT_MEASUREMENT
 /begin LOC_MEASUREMENT en_gendiag gfbsuctr gfehlin1 gfehlin2 gfehlin3 gfehlin4 gfehlin5 gfelctr gfhtctr gfmectr gfnobctr kl61loc /end LOC_MEASUREMENT
/end FUNCTION
/begin FUNCTION DHFM "Diagnose; Plausibilit‰tspr¸fung HFM"
 /begin DEF_CHARACTERISTIC FWMLHFMMN KFMLDMN KFMLDMX MLHFMMN TDMLHFM TDMLMN TDMLMX TDMLNF TDMLST TDUBHFM UADHFMMN UADHFMMX UBHFM UNWDHFM ZMLRO /end DEF_CHARACTERISTIC
 /begin REF_CHARACTERISTIC MLOFS /end REF_CHARACTERISTIC
 /begin IN_MEASUREMENT B_edks B_stend fho_w mlhfmm_w nmot_w ub uhfm_w uzkw_w wdkba_w /end IN_MEASUREMENT
 /begin OUT_MEASUREMENT B_ehfm B_ehfm1 B_ehfs B_elmi B_hfm fwmlhfm /end OUT_MEASUREMENT
 /begin LOC_MEASUREMENT B_mnhfm B_mxhfm mldmn_w mldmx_w mlhfmf_w wdkbadmn_w wdkbadmx_w /end LOC_MEASUREMENT
/end FUNCTION
/begin FUNCTION DHLS "Diagnose; Sondenheizung"
 /begin DEF_CHARACTERISTIC FRINH1 FRINV1 KFRINH KFRINV TADHMN TADHMX TVFHS TVHSEE TVRIF UBDLSMX UHDMN UHDMX ZKARIH ZKARIV ZKPRIH ZKPRIV /end DEF_CHARACTERISTIC
 /begin REF_CHARACTERISTIC UBDLS /end REF_CHARACTERISTIC
 /begin IN_MEASUREMENT B_atmtpa B_atmtpk B_cdhsh B_cdhsv B_hshe B_hshe2 B_hsve B_hsve2 B_nmot B_pwf B_rinh B_rinv B_rinv2 cd_bits1_w phlsnh phlsnh2 phlsnv phlsnv2 rinh_w rinv2_w rinv_w tabgm tkatm ub uhsh uhsh2 uhsv uhsv2 /end IN_MEASUREMENT
 /begin OUT_MEASUREMENT phlsnhf phlsnvf rinkfh rinkfv rinsh_w rinsv_w tabgmf tkatmf /end OUT_MEASUREMENT
 /begin LOC_MEASUREMENT B_mnfhsh B_mnfhsv B_mxfhsh B_mxfhsv B_npfhsh B_npfhsv B_sifhsh B_sifhsv /end LOC_MEASUREMENT
/end FUNCTION
/begin FUNCTION DIAGTIME "Deaktivierung CAN-Betrieb ¸ber Tester" /begin IN_MEASUREMENT B_hwpwf B_wakeup nmot_w /end IN_MEASUREMENT
 /begin OUT_MEASUREMENT B_canoff B_cdiagoff B_diagtimeout B_dtimer diagtime rememberP3Max /end OUT_MEASUREMENT
/end FUNCTION
/begin FUNCTION DIGIN ""
 /begin OUT_MEASUREMENT B_oeldr EAS_lsp1hk EAS_lsp1vk EAS_lsp2hk EAS_lsp2vk ES_fgrs ES_fgrsb ES_fgrsv ES_sfdisa ES_sfmdk ES_wda S_bls S_brs S_hz S_kl15 S_kupp /end OUT_MEASUREMENT
/end FUNCTION
/begin FUNCTION DIGOUT ""
 /begin IN_MEASUREMENT AS_dimdk AS_elue3 AS_epee AS_hr AS_mar AS_nl AS_psoff AS_spv AS_wp B_akr B_ausc_act B_bkvp B_btebl B_btekp B_bthsh B_bthsv B_btkos B_btmls3 B_btslp B_ebl B_eblet B_ekp B_ekpet B_hshe B_hshet B_hsve B_hsvet B_koe B_koset B_mls3et B_slp B_slpet B_slv /end IN_MEASUREMENT
/end FUNCTION
/begin FUNCTION DIMC "OBDII; inspection/maintenance-ready" /begin DEF_CHARACTERISTIC SRYAGR SRYHS SRYKAT SRYLS SRYSLS /end DEF_CHARACTERISTIC
 /begin IN_MEASUREMENT B_cdagr B_cddmtl B_cdhsv B_cdkat B_cdldp B_cdlsv B_cdsls B_cdtes B_katfz B_pwf B_rdytes cd_bits1_w cd_bits2_w /end IN_MEASUREMENT
 /begin OUT_MEASUREMENT B_agrrdy B_hsrdy B_kathrdy B_katrdy B_kkrdy B_lsrdy B_slsrdy B_tesrdy evsup1 ready /end OUT_MEASUREMENT
 /begin LOC_MEASUREMENT cryhs crykat cryls crysls /end LOC_MEASUREMENT
/end FUNCTION
/begin FUNCTION DIMCTES "Diagnose; Inspection-Maintenance Code, Tankentl¸ftungssystem" /begin DEF_CHARACTERISTIC SRYTES /end DEF_CHARACTERISTIC /begin IN_MEASUREMENT B_cddmtl B_cdtes /end IN_MEASUREMENT
 /begin OUT_MEASUREMENT B_drvddmtl B_drvdldp B_drvdtev B_rdytes cryddmtl crydldp crydtev DIMCTESausbits1 DIMCTESausbitsNOV1 /end OUT_MEASUREMENT
/end FUNCTION
/begin FUNCTION DISA "Differentielle Sauganlage (BMW)"
 /begin DEF_CHARACTERISTIC DELTA_U_O DELTA_U_OS DISAERSATZ DISAIMN DISAIMX DISALMN DISAMN DISAMX DISA_BEGR DISA_KL_I DISA_KL_P DISA_RAMP DISA_SAVE DISA_TOT DISA_U DISA_UMN DITVAUS DITVEIN Di_dir DI_ENDE DI_HYST DI_LSTART DI_SCHALT DI_SMIN DI_STDELTA DI_T1 DI_T2 DI_TANS_MN DI_TANS_MX DI_UB_MN DI_UMAMN KLDISATVUB SDISALERN WLSU /end DEF_CHARACTERISTIC
 /begin IN_MEASUREMENT B_btdisa B_kl15 B_pwf B_st B_stend disatst Disa_spg E_disasch nmot rl startddisa tans tka ub wdkba /end IN_MEASUREMENT
 /begin OUT_MEASUREMENT B_disa B_disalern B_disa_ersatz B_di_ausschalt B_di_einschalt B_su Dicntlern Dicntlfehl Disaaus_i Disaaus_p Disaaus_w Disa_dir Disa_ist Disa_lern Disa_soll Disa_spgnv Disa_st Disa_uma Disolakt Ditv_aus Di_cnt Di_lernst Di_lfehl D_disa_kl D_disa_v D_disa_w St_di t_disa1 t_disa2 /end OUT_MEASUREMENT
/end FUNCTION
/begin FUNCTION DISTAB "" /begin DEF_CHARACTERISTIC EBEN EBMISS_T EBMISS_Y /end DEF_CHARACTERISTIC
 /begin OUT_MEASUREMENT B_ebDavT B_ebDavY ebCtrNewT ebCtrNewY ebCtrOldT ebCtrOldY ebMissT ebMissY /end OUT_MEASUREMENT
/end FUNCTION
/begin COMPU_METHOD B_TRUE "boolsche Zust‰nde, positive Logik" TAB_VERB "%6.3" "" COMPU_TAB_REF B_TRUE /end COMPU_METHOD
/begin COMPU_VTAB B_TRUE "boolsche Zust‰nde, positive Logik" TAB_VERB 2 0 "----" 1 "TRUE" /end COMPU_VTAB
/begin COMPU_METHOD DEZ "1 : 1 Umrechnug (dez/hex)" RAT_FUNC "%6.2" "" COEFFS 0 1 0 0 0 1 /end COMPU_METHOD
/begin COMPU_METHOD dez "1 : 1 Umrechnug (dez/hex)" RAT_FUNC "%6.2" "" COEFFS 0 1 0 0 0 1 /end COMPU_METHOD
/begin COMPU_METHOD di_uw_q0p01 "" RAT_FUNC "%6.4" "" COEFFS 0 100 0 0 0 1 /end COMPU_METHOD
/begin COMPU_METHOD fak_ub_b2 "" RAT_FUNC "%6.4" "-" COEFFS 0 256 0 0 0 2 /end COMPU_METHOD
/begin COMPU_METHOD fak_ub_b64 "" RAT_FUNC "%6.3" "-" COEFFS 0 256 0 0 0 64 /end COMPU_METHOD
/begin COMPU_METHOD fak_ub_q0p01 "" RAT_FUNC "%6.4" "-" COEFFS 0 1 0 0 0 0.01 /end COMPU_METHOD
/begin COMPU_METHOD fak_uw_b1 "" RAT_FUNC "%7.6" "-" COEFFS 0 65536 0 0 0 1 /end COMPU_METHOD
/begin COMPU_METHOD fak_uw_b4 "" RAT_FUNC "%7.6" "-" COEFFS 0 65536 0 0 0 4 /end COMPU_METHOD
/begin COMPU_METHOD m_q0p1 "" RAT_FUNC "%6.3" "kg/h" COEFFS 0 10 0 0 0 1 /end COMPU_METHOD
/begin COMPU_METHOD m_sw_q0p1 "" RAT_FUNC "%6.3" "kg/h" COEFFS 0 1 0 0 0 0.1 /end COMPU_METHOD
/begin COMPU_METHOD nmot_ub_q40 "" RAT_FUNC "%6.1" "1/min" COEFFS 0 1 0 0 0 40 /end COMPU_METHOD
/begin COMPU_METHOD nmot_uw_q0p25 "" RAT_FUNC "%6.3" "1/min" COEFFS 0 1 0 0 0 0.25 /end COMPU_METHOD
/begin COMPU_METHOD PCENT "Prozent" RAT_FUNC "%6.3" "%" COEFFS 0 256 0 0 0 100 /end COMPU_METHOD
/begin COMPU_METHOD relDK_q0p02441 "" RAT_FUNC "%6.4" "%DK" COEFFS 0 65536 0 0 0 1600 /end COMPU_METHOD
/begin COMPU_METHOD rel_ub_q0p75 "" RAT_FUNC "%6.3" "%" COEFFS 0 1 0 0 0 0.75 /end COMPU_METHOD
/begin COMPU_METHOD r_q8 "" RAT_FUNC "%6.2" "Ohm" COEFFS 0 1 0 0 0 8 /end COMPU_METHOD
/begin COMPU_METHOD r_uw_q2 "" RAT_FUNC "%6.2" "Ohm" COEFFS 0 1 0 0 0 2 /end COMPU_METHOD
/begin COMPU_METHOD spg_ub "" RAT_FUNC "%6.3" "V" COEFFS 0 1 0 0 0 0.0942 /end COMPU_METHOD
/begin COMPU_METHOD spg_ubatt "" RAT_FUNC "%6.3" "V" COEFFS 0 1 0 0 0 0.0942 /end COMPU_METHOD
/begin COMPU_METHOD spg_ub_b5 "" RAT_FUNC "%6.4" "V" COEFFS 0 256 0 0 0 5 /end COMPU_METHOD
/begin COMPU_METHOD spg_ub_q0p019 "" RAT_FUNC "%6.4" "V" COEFFS 0 1 0 0 0 0.019 /end COMPU_METHOD
/begin COMPU_METHOD spg_uw_b5 "" RAT_FUNC "%6.4" "V" COEFFS 0 1024 0 0 0 5 /end COMPU_METHOD
/begin COMPU_METHOD t100msxs_ub_b25p5 "" RAT_FUNC "%6.3" "s" COEFFS 0 1 0 0 0 0.1 /end COMPU_METHOD
/begin COMPU_METHOD t10msxs_ub_b2p55 "" RAT_FUNC "%6.4" "s" COEFFS 0 1 0 0 0 0.01 /end COMPU_METHOD
/begin COMPU_METHOD t10msxs_uw_b655p35 "" RAT_FUNC "%6.4" "s" COEFFS 0 1 0 0 0 0.01 /end COMPU_METHOD
/begin COMPU_METHOD t1sxs_ub_b255 "" RAT_FUNC "%6.2" "s" COEFFS 0 1 0 0 0 1 /end COMPU_METHOD
/begin COMPU_METHOD t50msxs_q0p05 "" RAT_FUNC "%6.4" "s" COEFFS 0 1 0 0 0 0.05 /end COMPU_METHOD
/begin COMPU_METHOD temp_ub_q0p75_o48 "" RAT_FUNC "%6.2" "Grad C" COEFFS 0 1 48 0 0 0.75 /end COMPU_METHOD
/begin COMPU_METHOD temp_ub_q5_o50 "" RAT_FUNC "%6.2" "Grad C" COEFFS 0 1 50 0 0 5 /end COMPU_METHOD
/begin COMPU_METHOD vnstv_q0p00305 "" RAT_FUNC "%7.5" "%" COEFFS 0 327.68 0 0 0 1 /end COMPU_METHOD
/begin COMPU_METHOD vnstv_q0p00305s32768 "" RAT_FUNC "%7.3" "%" COEFFS 0 327.68 32768 0 0 1 /end COMPU_METHOD
/begin COMPU_METHOD zk100msxs_uw_b6553 "" RAT_FUNC "%10.3" "s" COEFFS 0 0 65536 0 10 0 /end COMPU_METHOD
/begin COMPU_METHOD zk10msxs_ub_b2p55 "" RAT_FUNC "%6.4" "s" COEFFS 0 0 255 0 100 0 /end COMPU_METHOD
/begin RECORD_LAYOUT KfAxUbAyUbSstxUbSstyUbWUb NO_AXIS_PTS_X 1 UBYTE NO_AXIS_PTS_Y 2 UBYTE AXIS_PTS_X 3 UBYTE INDEX_INCR DIRECT AXIS_PTS_Y 4 UBYTE INDEX_INCR DIRECT FNC_VALUES 5 UBYTE COLUMN_DIR DIRECT /end RECORD_LAYOUT
/begin RECORD_LAYOUT KfAxUwAyUwSstxUwSstyUwWSw NO_AXIS_PTS_X 1 UWORD NO_AXIS_PTS_Y 2 UWORD AXIS_PTS_X 3 UWORD INDEX_INCR DIRECT AXIS_PTS_Y 4 UWORD INDEX_INCR DIRECT FNC_VALUES 5 SWORD COLUMN_DIR DIRECT /end RECORD_LAYOUT
/begin RECORD_LAYOUT KfAxUwAyUwSstxUwSstyUwWUw NO_AXIS_PTS_X 1 UWORD NO_AXIS_PTS_Y 2 UWORD AXIS_PTS_X 3 UWORD INDEX_INCR DIRECT AXIS_PTS_Y 4 UWORD INDEX_INCR DIRECT FNC_VALUES 5 UWORD COLUMN_DIR DIRECT /end RECORD_LAYOUT
/begin RECORD_LAYOUT KlAUbSstUbWUb NO_AXIS_PTS_X 1 UBYTE AXIS_PTS_X 2 UBYTE INDEX_INCR DIRECT FNC_VALUES 3 UBYTE COLUMN_DIR DIRECT /end RECORD_LAYOUT
/begin RECORD_LAYOUT KlAUbSstUbWUw NO_AXIS_PTS_X 1 UBYTE AXIS_PTS_X 2 UBYTE INDEX_INCR DIRECT FNC_VALUES 3 UWORD COLUMN_DIR DIRECT /end RECORD_LAYOUT
/begin RECORD_LAYOUT KlAUwSstUwWUw NO_AXIS_PTS_X 1 UWORD AXIS_PTS_X 2 UWORD INDEX_INCR DIRECT FNC_VALUES 3 UWORD COLUMN_DIR DIRECT /end RECORD_LAYOUT
/begin RECORD_LAYOUT KwbUb FNC_VALUES 1 UBYTE COLUMN_DIR DIRECT /end RECORD_LAYOUT
/begin RECORD_LAYOUT KwbUw FNC_VALUES 1 UWORD COLUMN_DIR DIRECT /end RECORD_LAYOUT
/begin RECORD_LAYOUT KwbWU16 FNC_VALUES 1 UWORD COLUMN_DIR DIRECT /end RECORD_LAYOUT
/begin RECORD_LAYOUT KwbWU8 FNC_VALUES 1 UBYTE COLUMN_DIR DIRECT /end RECORD_LAYOUT
/begin RECORD_LAYOUT KwSw FNC_VALUES 1 SWORD COLUMN_DIR DIRECT /end RECORD_LAYOUT
/begin RECORD_LAYOUT KwUb FNC_VALUES 1 UBYTE COLUMN_DIR DIRECT /end RECORD_LAYOUT
/begin RECORD_LAYOUT KwUw FNC_VALUES 1 UWORD COLUMN_DIR DIRECT /end RECORD_LAYOUT
/begin RECORD_LAYOUT KwWU16 FNC_VALUES 1 UWORD COLUMN_DIR DIRECT /end RECORD_LAYOUT
/begin RECORD_LAYOUT KwWU8 FNC_VALUES 1 UBYTE COLUMN_DIR DIRECT /end RECORD_LAYOUT
/end MODULE
/end PROJECT
