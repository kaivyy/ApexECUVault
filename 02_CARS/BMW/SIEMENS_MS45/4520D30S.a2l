ASAP2_VERSION 1 31
/begin PROJECT MS45 "BMW Motorsteuerung R6"
/begin HEADER "_default_HeaderComment" PROJECT_NO _52 /end HEADER
/begin MODULE _default_ModuleName "_default_ModuleLongIdentifier"
/begin MOD_COMMON "_default_ModCommonComment" DEPOSIT ABSOLUTE BYTE_ORDER MSB_FIRST ALIGNMENT_BYTE 1 ALIGNMENT_WORD 2 ALIGNMENT_LONG 4 ALIGNMENT_FLOAT32_IEEE 4 ALIGNMENT_FLOAT64_IEEE 8 /end MOD_COMMON
/begin MEASUREMENT TCO_DIF "" SBYTE _CNV_A_R_LINEAR_____1_CM 1 100. -96. 95.25 ECU_ADDRESS 0x3fe531 FORMAT "%3.1" /end MEASUREMENT
/begin AXIS_PTS ldpm_n_32_28 "" 0x43d19 N_32 _REC_AXS_20_u1 8160. _CNV_A_R_LINEAR_____5_CM 12 0. 8160. FORMAT "%4.0" /end AXIS_PTS
/begin AXIS_PTS ldpm_gear_ef_1 "" 0x43bd6 GEAR_EF _REC_AXS_20_u1 12. _CNV_A_R_LINEAR_____12_CM 13 0. 12. FORMAT "%3.0" /end AXIS_PTS
/begin AXIS_PTS ldpm_n_32__ef "" 0x43d7a N_32 _REC_AXS_20_u1 8160. _CNV_A_R_LINEAR_____5_CM 5 0. 8160. FORMAT "%4.0" /end AXIS_PTS
/begin AXIS_PTS ldp_maf__thd_is_er_diag "" 0x43464 MAF _REC_AXS_20_u1 1389. _CNV_A_R_LINEAR_____18_CM 4 0. 1389. FORMAT "%4.0" /end AXIS_PTS
/begin AXIS_PTS ldp_n__thd_is_er_diag "" 0x4481a N _REC_AXS_20_u2 816. _CNV_A_R_LINEAR_____17_CM 4 0. 8160. FORMAT "%4.0" /end AXIS_PTS
/begin AXIS_PTS ldp_tco__fac_thd_is_er_diag "" 0x4385d TCO _REC_AXS_20_u1 190.5 _CNV_A_R_LINEAR_____0_CM 8 -48. 142.5 FORMAT "%5.1" /end AXIS_PTS
/begin MEASUREMENT ERR_INFO_STAT "" UBYTE _CNV_S_2_RANGE______21_R_CM 1 100. 0. 255. ECU_ADDRESS 0x3fd594 /end MEASUREMENT
/begin MEASUREMENT ERR_INFO_STAT "" UBYTE _CNV_S_2_RANGE______21_R_CM 1 100. 0. 255. ECU_ADDRESS 0x3fd590 /end MEASUREMENT
/begin AXIS_PTS ldpm_vs_wheel_grd_mmv_thd "" 0x440e0 VS _REC_AXS_20_u1 255. _CNV_A_R_LINEAR_____13_CM 9 0. 255. FORMAT "%3.0" /end AXIS_PTS
/begin AXIS_PTS ldp_vb_sof "" 0x43af4 VB _REC_AXS_20_u1 25.8984 _CNV_A_R_LINEAR_____26_CM 8 0. 25.8984 FORMAT "%3.1" /end AXIS_PTS
/begin AXIS_PTS ldp_tia_sof "" 0x439fb TIA _REC_AXS_20_u1 190.5 _CNV_A_R_LINEAR_____0_CM 8 -48. 142.5 FORMAT "%5.1" /end AXIS_PTS
/begin AXIS_PTS ldpm_t_sof_act "" 0x4545e T_SOF_ACT _REC_AXS_20_u2 655.35 _CNV_A_R_LINEAR_____27_CM 15 0. 655.35 FORMAT "%6.2" /end AXIS_PTS
/begin AXIS_PTS ldp_pv_av_sof_req_1 "" 0x437c3 PV_AV_SOF_REQ _REC_AXS_20_u1 99.609375 _CNV_A_R_LINEAR_____4_CM 4 0. 99.609375 FORMAT "%4.1" /end AXIS_PTS
/begin AXIS_PTS ldp_pv_av_sof_req_2 "" 0x437c8 PV_AV_SOF_REQ _REC_AXS_20_u1 99.609375 _CNV_A_R_LINEAR_____4_CM 4 0. 99.609375 FORMAT "%4.1" /end AXIS_PTS
/begin AXIS_PTS ldp_pv_av_sof_req_3 "" 0x437cd PV_AV_SOF_REQ _REC_AXS_20_u1 99.609375 _CNV_A_R_LINEAR_____4_CM 4 0. 99.609375 FORMAT "%4.1" /end AXIS_PTS
/begin AXIS_PTS ldp_pv_av_sof_req_4 "" 0x437d2 PV_AV_SOF_REQ _REC_AXS_20_u1 99.609375 _CNV_A_R_LINEAR_____4_CM 4 0. 99.609375 FORMAT "%4.1" /end AXIS_PTS
/begin AXIS_PTS ldp_pv_av_sof_req_5 "" 0x437d7 PV_AV_SOF_REQ _REC_AXS_20_u1 99.609375 _CNV_A_R_LINEAR_____4_CM 4 0. 99.609375 FORMAT "%4.1" /end AXIS_PTS
/begin AXIS_PTS ldp_pv_av_sof_req_0 "" 0x437be PV_AV_SOF_REQ _REC_AXS_20_u1 99.609375 _CNV_A_R_LINEAR_____4_CM 4 0. 99.609375 FORMAT "%4.1" /end AXIS_PTS
/begin AXIS_PTS ldp_pv_av_sof_req_6 "" 0x437dc PV_AV_SOF_REQ _REC_AXS_20_u1 99.609375 _CNV_A_R_LINEAR_____4_CM 4 0. 99.609375 FORMAT "%4.1" /end AXIS_PTS
/begin AXIS_PTS ldp_n_sof_req_1 "" 0x448ec N_SOF_REQ _REC_AXS_20_u2 8160. _CNV_A_R_LINEAR_____17_CM 6 0. 8160. FORMAT "%4.0" /end AXIS_PTS
/begin AXIS_PTS ldp_n_sof_req_2 "" 0x448fa N_SOF_REQ _REC_AXS_20_u2 8160. _CNV_A_R_LINEAR_____17_CM 6 0. 8160. FORMAT "%4.0" /end AXIS_PTS
/begin AXIS_PTS ldp_n_sof_req_3 "" 0x44908 N_SOF_REQ _REC_AXS_20_u2 8160. _CNV_A_R_LINEAR_____17_CM 6 0. 8160. FORMAT "%4.0" /end AXIS_PTS
/begin AXIS_PTS ldp_n_sof_req_4 "" 0x44916 N_SOF_REQ _REC_AXS_20_u2 8160. _CNV_A_R_LINEAR_____17_CM 6 0. 8160. FORMAT "%4.0" /end AXIS_PTS
/begin AXIS_PTS ldp_n_sof_req_5 "" 0x44924 N_SOF_REQ _REC_AXS_20_u2 8160. _CNV_A_R_LINEAR_____17_CM 6 0. 8160. FORMAT "%4.0" /end AXIS_PTS
/begin AXIS_PTS ldp_n_sof_req_0 "" 0x448de N_SOF_REQ _REC_AXS_20_u2 8160. _CNV_A_R_LINEAR_____17_CM 6 0. 8160. FORMAT "%4.0" /end AXIS_PTS
/begin AXIS_PTS ldp_n_sof_req_6 "" 0x44932 N_SOF_REQ _REC_AXS_20_u2 8160. _CNV_A_R_LINEAR_____17_CM 6 0. 8160. FORMAT "%4.0" /end AXIS_PTS
/begin AXIS_PTS ldpm_n_32__t_acc "" 0x43de4 N_32 _REC_AXS_20_u1 8160. _CNV_A_R_LINEAR_____5_CM 3 0. 8160. FORMAT "%4.0" /end AXIS_PTS
/begin AXIS_PTS ldp_vs__amp_raw_cor "" 0x43b24 VS _REC_AXS_20_u1 255. _CNV_A_R_LINEAR_____13_CM 8 0. 255. FORMAT "%3.0" /end AXIS_PTS
/begin AXIS_PTS ldp_v_amp_1__amp_raw "" 0x44d02 V_AMP _REC_AXS_20_u2 4.99511719 _CNV_A_R_LINEAR_____33_CM 8 0. 4.99511719 FORMAT "%5.3" /end AXIS_PTS
/begin AXIS_PTS ldp_v_amp_2__amp_raw "" 0x44d14 V_AMP _REC_AXS_20_u2 4.99511719 _CNV_A_R_LINEAR_____33_CM 8 0. 4.99511719 FORMAT "%5.3" /end AXIS_PTS
/begin AXIS_PTS ldp_n_vs_ratio_gr_mt "" 0x43785 N_VS_RATIO _REC_AXS_20_u1 255. _CNV_A_R_LINEAR_____10_CM 13 0. 255. FORMAT "%3.0" /end AXIS_PTS
/begin AXIS_PTS ldpm_n_2_3 "" 0x45250 N _REC_AXS_20_u2 816. _CNV_A_R_LINEAR_____17_CM 16 0. 8160. FORMAT "%4.0" /end AXIS_PTS
/begin AXIS_PTS ldpm_cam_edge_nr_0__win_chk "" 0x43b65 CAM_EDGE_NR_0 _REC_AXS_20_u1 3. _CNV_A_R_LINEAR_____10_CM 4 0. 3. FORMAT "%2.0" /end AXIS_PTS
/begin AXIS_PTS ldpm_cam_edge_nr_1__win_chk "" 0x43b6a CAM_EDGE_NR_1 _REC_AXS_20_u1 3. _CNV_A_R_LINEAR_____10_CM 4 0. 3. FORMAT "%2.0" /end AXIS_PTS
/begin AXIS_PTS ldpm_ctr_km_can "" 0x44ed2 CTR_KM_CAN _REC_AXS_20_u2 655340. _CNV_A_R_LINEAR_____80_CM 4 0. 655340. FORMAT "%6.0" /end AXIS_PTS
/begin AXIS_PTS ldp_vs_fil__tq_gs_inc_mon "" 0x44e38 VS_FIL _REC_AXS_20_u2 511.99218 _CNV_A_R_LINEAR_____78_CM 6 0. 511.99218 FORMAT "%7.3" /end AXIS_PTS
/begin AXIS_PTS ldp_n_32__tq_gs_inc_mon "" 0x4363c N_32 _REC_AXS_20_u1 8160. _CNV_A_R_LINEAR_____5_CM 6 0. 8160. FORMAT "%4.0" /end AXIS_PTS
/begin AXIS_PTS ldpm_tco_2 "" 0x43f6d TCO _REC_AXS_20_u1 190.5 _CNV_A_R_LINEAR_____0_CM 8 -48. 142.5 FORMAT "%5.1" /end AXIS_PTS
/begin AXIS_PTS ldp_flow_cor_cps_ip_cppwm "" 0x4439a FLOW_COR_CPS _REC_AXS_20_u2 7.99987793 _CNV_A_R_LINEAR_____99_CM 12 0. 7.99987793 FORMAT "%7.4" /end AXIS_PTS
/begin AXIS_PTS ldpm_prs_cps_ip_cppwm "" 0x453d4 PRS_CPS _REC_AXS_20_u2 5434. _CNV_A_R_LINEAR_____102_CM 12 -2717. 2717. FORMAT "%7.2" /end AXIS_PTS
/begin AXIS_PTS ldp_amp_ip_fac_amp_cp "" 0x44114 AMP _REC_AXS_20_u2 5434. _CNV_A_R_LINEAR_____43_CM 6 0. 5434. FORMAT "%7.2" /end AXIS_PTS
/begin AXIS_PTS ldp_tia_thr_ip_fac_tia_cp "" 0x43a04 TIA _REC_AXS_20_u1 190.5 _CNV_A_R_LINEAR_____0_CM 6 -48. 142.5 FORMAT "%5.1" /end AXIS_PTS
/begin AXIS_PTS ldp_cl_ip_rel_flow_fac_cp "" 0x441f4 CL _REC_AXS_20_u2 1.999878 _CNV_A_R_LINEAR_____108_CM 6 0. 1.999878 FORMAT "%6.4" /end AXIS_PTS
/begin AXIS_PTS ldpm_maf_ip_rel_flow_max_cps "" 0x43c93 MAF _REC_AXS_20_u1 69.45 _CNV_A_R_LINEAR_____18_CM 12 0. 1389. FORMAT "%4.0" /end AXIS_PTS
/begin AXIS_PTS ldpm_cl_mmv_ip_nr_step_cl "" 0x44ea8 CL_MMV _REC_AXS_20_u2 9.9998474e-002 _CNV_A_R_LINEAR_____45_CM 3 0. 1.99996948 FORMAT "%7.5" /end AXIS_PTS
/begin AXIS_PTS ldp_tco_ip_rel_fuel_max_cp_cor "" 0x43921 TCO _REC_AXS_20_u1 190.5 _CNV_A_R_LINEAR_____0_CM 5 -48. 142.5 FORMAT "%5.1" /end AXIS_PTS
/begin AXIS_PTS ldpm_vb_ip_cppwm_vb "" 0x440a5 VB _REC_AXS_20_u1 25.8984 _CNV_A_R_LINEAR_____26_CM 8 0. 25.8984 FORMAT "%3.1" /end AXIS_PTS
/begin AXIS_PTS ldp_cppwm_ref_ip_cppwm_cor_frq "" 0x43383 CPPWM_REF _REC_AXS_20_u1 99.609375 _CNV_A_R_LINEAR_____4_CM 8 0. 99.609375 FORMAT "%5.1" /end AXIS_PTS
/begin AXIS_PTS ldp_cl_mmv_ip_t_max_cp "" 0x4421e CL_MMV _REC_AXS_20_u2 1.99996948 _CNV_A_R_LINEAR_____45_CM 6 0. 1.99996948 FORMAT "%6.4" /end AXIS_PTS
/begin AXIS_PTS ldpm_t_ctl_cru_1 "" 0x43f1f T_CTL_CRU _REC_AXS_20_u1 2.55 _CNV_A_R_LINEAR_____14_CM 5 0. 25.5 FORMAT "%4.1" /end AXIS_PTS
/begin AXIS_PTS ldp_vs_dif_cru__fac_prop_cru "" 0x44e12 VS_DIF_CRU _REC_AXS_20_u2 511.9921875 _CNV_A_R_LINEAR_____132_CM 4 -256. 255.9921875 FORMAT "%7.3" /end AXIS_PTS
/begin AXIS_PTS ldpm_vs_sp_dif_cru_1 "" 0x456a6 VS_SP_DIF_CRU _REC_AXS_20_u2 511.9921875 _CNV_A_R_LINEAR_____132_CM 5 -256. 255.9921875 FORMAT "%7.3" /end AXIS_PTS
/begin AXIS_PTS ldpm_n_21 "" 0x43cae N_32 _REC_AXS_20_u1 8160. _CNV_A_R_LINEAR_____5_CM 3 0. 8160. FORMAT "%4.0" /end AXIS_PTS
/begin AXIS_PTS ldpm_vs_sp_cru_1 "" 0x4569a VS_SP_CRU _REC_AXS_20_u2 511.99218 _CNV_A_R_LINEAR_____78_CM 5 0. 511.99218 FORMAT "%7.3" /end AXIS_PTS
/begin AXIS_PTS ldpm_ac_cru__fac_tq_cru "" 0x44e46 AC_CRU _REC_AXS_20_u2 31.43952 _CNV_A_R_LINEAR_____136_CM 6 -15.72 15.71952 FORMAT "%8.4" /end AXIS_PTS
/begin AXIS_PTS ldpm_gear__fac_tq_cru "" 0x43bbb GEAR _REC_AXS_20_u1 255. _CNV_A_R_LINEAR_____10_CM 12 0. 255. FORMAT "%3.0" /end AXIS_PTS
/begin AXIS_PTS ldp_n_32__fac_tq_cru "" 0x434f5 N_32 _REC_AXS_20_u1 816. _CNV_A_R_LINEAR_____5_CM 5 0. 8160. FORMAT "%4.0" /end AXIS_PTS
/begin AXIS_PTS ldpm_fac_tq_cru_1 "" 0x44f68 FAC_TQ_CRU _REC_AXS_20_u2 99.99847412 _CNV_A_R_LINEAR_____94_CM 3 0. 99.99847412 /end AXIS_PTS
/begin AXIS_PTS ldp_vls_cyc_ratio_mv_1_ip_fac "" 0x43b04 VLS_CYC_RATIO_MV_1 _REC_AXS_20_u1 1.984375 _CNV_A_R_LINEAR_____141_CM 6 0. 1.984375 FORMAT "%4.2" /end AXIS_PTS
/begin AXIS_PTS ldp_vls_cyc_ratio_mv_2_ip_fac "" 0x43b0b VLS_CYC_RATIO_MV_2 _REC_AXS_20_u1 1.984375 _CNV_A_R_LINEAR_____141_CM 6 0. 1.984375 FORMAT "%4.2" /end AXIS_PTS
/begin AXIS_PTS ldp_maf_kgh_ip_fac_maf_1_cyl "" 0x4464c MAF_KGH _REC_AXS_20_u2 2047.96875 _CNV_A_R_LINEAR_____101_CM 6 0. 2047.96875 FORMAT "%7.2" /end AXIS_PTS
/begin AXIS_PTS ldp_maf_kgh_ip_fac_maf_2_cyl "" 0x4465a MAF_KGH _REC_AXS_20_u2 2047.96875 _CNV_A_R_LINEAR_____101_CM 6 0. 2047.96875 FORMAT "%7.2" /end AXIS_PTS
/begin AXIS_PTS ldpm_n_1_cybl "" 0x4522c N _REC_AXS_20_u2 8160. _CNV_A_R_LINEAR_____17_CM 8 0. 8160. FORMAT "%4.0" /end AXIS_PTS
/begin AXIS_PTS ldpm_n_2_cybl "" 0x45272 N _REC_AXS_20_u2 8160. _CNV_A_R_LINEAR_____17_CM 6 0. 8160. FORMAT "%4.0" /end AXIS_PTS
/begin AXIS_PTS ldp_maf_ip_dly_cyl_lam "" 0x4458c MAF _REC_AXS_20_u2 1389. _CNV_A_R_LINEAR_____95_CM 8 0. 1389. FORMAT "%7.2" /end AXIS_PTS
/begin AXIS_PTS ldp_maf_ip_vls_dif_val "" 0x445d8 MAF _REC_AXS_20_u2 1389. _CNV_A_R_LINEAR_____95_CM 8 0. 1389. FORMAT "%7.2" /end AXIS_PTS
/begin AXIS_PTS ldp_vls_dif_val_ip_ti_ad_cyl "" 0x44de0 VLS_DIF_VAL _REC_AXS_20_u2 1.275 _CNV_A_R_LINEAR_____147_CM 8 -0.6375 0.6375 FORMAT "%7.5" /end AXIS_PTS
/begin AXIS_PTS ldp_vls_dif_val_ip_ti_cyl "" 0x44df2 VLS_DIF_VAL _REC_AXS_20_u2 1.275 _CNV_A_R_LINEAR_____147_CM 6 -0.6375 0.6375 FORMAT "%7.5" /end AXIS_PTS
/begin AXIS_PTS ldp_lamb_sp_ip_fac_vls_dif_lamb "" 0x44498 LAMB_SP _REC_AXS_20_u2 31.99902344 _CNV_A_R_LINEAR_____148_CM 4 0. 31.99902344 FORMAT "%7.4" /end AXIS_PTS
/begin AXIS_PTS ldp_maf_kgh__crlc_vls_down "" 0x445ea MAF_KGH _REC_AXS_20_u2 2047.96875 _CNV_A_R_LINEAR_____101_CM 6 0. 2047.96875 FORMAT "%6.2" /end AXIS_PTS
/begin AXIS_PTS ldp_ftl__t_cur_dmtl_stat "" 0x433b1 FTL _REC_AXS_20_u1 126. _CNV_A_R_LINEAR_____85_CM 8 0. 126. FORMAT "%3.0" /end AXIS_PTS
/begin AXIS_PTS ldp_ftl__t_small_leak_test "" 0x433c0 FTL _REC_AXS_20_u1 126. _CNV_A_R_LINEAR_____85_CM 5 0. 126. FORMAT "%3.0" /end AXIS_PTS
/begin AXIS_PTS ldp_vb_dmtl_fil__fac_cur_dmtl "" 0x44db2 VB_DMTL_FIL _REC_AXS_20_u2 26. _CNV_A_R_LINEAR_____156_CM 6 0. 26. FORMAT "%7.4" /end AXIS_PTS
/begin AXIS_PTS ldpm_cur_dmtldifrefroughleak_1 "" 0x44ef0 CUR_DMTL_DIF_REF_ROUGH_LEAK _REC_AXS_20_u2 400. _CNV_A_R_LINEAR_____151_CM 8 0. 400. FORMAT "%7.3" /end AXIS_PTS
/begin AXIS_PTS ldp_ftl__t_rough_leak_test "" 0x433ba FTL _REC_AXS_20_u1 126. _CNV_A_R_LINEAR_____85_CM 5 0. 126. FORMAT "%3.0" /end AXIS_PTS
/begin AXIS_PTS ldp_n_ecf__n_ecf_min_accin "" 0x43725 N_ECF _REC_AXS_20_u1 15. _CNV_A_R_LINEAR_____10_CM 16 0. 15. FORMAT "%2.0" /end AXIS_PTS
/begin AXIS_PTS ldp_tco__temp_sub_ecf_ini "" 0x438d2 TCO _REC_AXS_20_u1 190.5 _CNV_A_R_LINEAR_____0_CM 6 -48. 142.5 FORMAT "%5.1" /end AXIS_PTS
/begin AXIS_PTS ldp_n_ecf_cor_fil__n_perc_ecf "" 0x43736 N_ECF_COR_FIL _REC_AXS_20_u1 15.9375 _CNV_A_R_LINEAR_____40_CM 6 0. 15.9375 FORMAT "%5.2" /end AXIS_PTS
/begin AXIS_PTS ldp_tco_ex__n_ecf "" 0x438ff TCO_EX _REC_AXS_20_u1 190.5 _CNV_A_R_LINEAR_____0_CM 6 -48. 142.5 FORMAT "%5.1" /end AXIS_PTS
/begin AXIS_PTS ldp_tam__temp_sub_ecf_ini "" 0x43823 TAM _REC_AXS_20_u1 190.5 _CNV_A_R_LINEAR_____0_CM 6 -48. 142.5 FORMAT "%5.1" /end AXIS_PTS
/begin AXIS_PTS ldpm_temp_mmv_sub_cat_ecf_1 "" 0x44044 TEMP_MMV_SUB_CAT_ECF _REC_AXS_20_u1 1020. _CNV_A_R_LINEAR_____160_CM 6 -33. 987. FORMAT "%3.0" /end AXIS_PTS
/begin AXIS_PTS ldp_vs__n_ecf_vs_cor "" 0x43b34 VS _REC_AXS_20_u1 255. _CNV_A_R_LINEAR_____13_CM 5 0. 255. FORMAT "%3.0" /end AXIS_PTS
/begin AXIS_PTS ldp_temp_gb__n_ecf_temp_gb "" 0x439aa TEMP_GB _REC_AXS_20_u1 255. _CNV_A_R_LINEAR_____3_CM 6 -40. 215. FORMAT "%3.0" /end AXIS_PTS
/begin AXIS_PTS ldp_n_32_vff_efp "" 0x436e9 N_32 _REC_AXS_20_u1 8160. _CNV_A_R_LINEAR_____5_CM 8 0. 8160. FORMAT "%4.0" /end AXIS_PTS
/begin AXIS_PTS ldp_tco_t_efp_ast_max "" 0x43992 TCO _REC_AXS_20_u1 190.5 _CNV_A_R_LINEAR_____0_CM 6 -48. 142.5 FORMAT "%5.1" /end AXIS_PTS
/begin AXIS_PTS ldp_ftl_vff_vepu_ftl "" 0x433cd FTL _REC_AXS_20_u1 127. _CNV_A_R_LINEAR_____85_CM 6 0. 127. FORMAT "%3.0" /end AXIS_PTS
/begin AXIS_PTS ldp_ftl_dif_vff_vepu_ftl_dif "" 0x433c6 FTL_DIF _REC_AXS_20_u1 127. _CNV_A_R_LINEAR_____85_CM 6 0. 127. FORMAT "%3.0" /end AXIS_PTS
/begin AXIS_PTS ldpm_n_32__egr_ratio_s "" 0x43d96 N_32 _REC_AXS_20_u1 8160. _CNV_A_R_LINEAR_____5_CM 12 0. 8160. FORMAT "%4.0" /end AXIS_PTS
/begin AXIS_PTS ldpm_mff_sp_s__egr_ratio_s "" 0x45196 MFF_SP_S _REC_AXS_20_u2 1389. _CNV_A_R_LINEAR_____95_CM 12 0. 1389. FORMAT "%7.2" /end AXIS_PTS
/begin AXIS_PTS ldpm_maf__egr_ratio_hom "" 0x4507e MAF _REC_AXS_20_u2 1389. _CNV_A_R_LINEAR_____95_CM 12 0. 1389. FORMAT "%7.2" /end AXIS_PTS
/begin AXIS_PTS ldp_maf_ip_egr_ratio_min "" 0x4459e MAF _REC_AXS_20_u2 1389. _CNV_A_R_LINEAR_____95_CM 4 0. 1389. FORMAT "%7.2" /end AXIS_PTS
/begin AXIS_PTS ldpm_n_32__egr_ratio_hom "" 0x43d89 N_32 _REC_AXS_20_u1 8160. _CNV_A_R_LINEAR_____5_CM 12 0. 8160. FORMAT "%4.0" /end AXIS_PTS
/begin AXIS_PTS ldp_maf_ip_er_std_thd "" 0x445a8 MAF _REC_AXS_20_u2 1389. _CNV_A_R_LINEAR_____95_CM 2 0. 1389. FORMAT "%7.2" /end AXIS_PTS
/begin AXIS_PTS ldp_n_32_ip_egr_ratio_min "" 0x43664 N_32 _REC_AXS_20_u1 8160. _CNV_A_R_LINEAR_____5_CM 4 0. 8160. FORMAT "%4.0" /end AXIS_PTS
/begin AXIS_PTS ldp_n_32_ip_er_std_thd "" 0x43669 N_32 _REC_AXS_20_u1 8160. _CNV_A_R_LINEAR_____5_CM 2 0. 8160. FORMAT "%4.0" /end AXIS_PTS
/begin AXIS_PTS ldp_ar_red_sp_egr_stk_sp_egr "" 0x441b8 AR_RED_SP_EGR _REC_AXS_20_u2 58.592855 _CNV_A_R_LINEAR_____171_CM 12 0. 58.592855 FORMAT "%7.4" /end AXIS_PTS
/begin AXIS_PTS ldpm_stk_dif_egr "" 0x43f15 STK_DIF_EGR _REC_AXS_20_u1 99.609375 _CNV_A_R_LINEAR_____117_CM 9 -50. 49.609375 FORMAT "%6.2" /end AXIS_PTS
/begin AXIS_PTS ldp_stk_sp_egr__egrpwm_prev "" 0x437fd STK_SP_EGR _REC_AXS_20_u1 99.609375 _CNV_A_R_LINEAR_____4_CM 12 0. 99.609375 FORMAT "%4.1" /end AXIS_PTS
/begin AXIS_PTS ldpm_er_egr "" 0x44f28 ER_EGR _REC_AXS_20_u2 651.55 _CNV_A_R_LINEAR_____175_CM 6 -325.78 325.77 FORMAT "%8.3" /end AXIS_PTS
/begin AXIS_PTS ldp_tco__fac_tco_egr "" 0x43856 TCO _REC_AXS_20_u1 190.5 _CNV_A_R_LINEAR_____0_CM 6 -48. 142.5 FORMAT "%5.1" /end AXIS_PTS
/begin AXIS_PTS ldp_maf_cyl__egr_ratio_inc "" 0x44512 MAF_CYL _REC_AXS_20_u2 2047.96875 _CNV_A_R_LINEAR_____101_CM 6 0. 2047.96875 FORMAT "%7.2" /end AXIS_PTS
/begin MEASUREMENT CYCNR_PUC "" UWORD _CNV_A_R_LINEAR_____10_CM 1 100. 0. 65535. ECU_ADDRESS 0x3fe312 FORMAT "%5.0" /end MEASUREMENT
/begin MEASUREMENT N_HYS_PUC "" UBYTE _CNV_A_R_LINEAR_____5_CM 1 100. 0. 8160. ECU_ADDRESS 0x3fe317 FORMAT "%4.0" /end MEASUREMENT
/begin MEASUREMENT N_MIN_PUC "" UBYTE _CNV_A_R_LINEAR_____5_CM 1 100. 0. 8160. ECU_ADDRESS 0x3fe316 FORMAT "%4.0" /end MEASUREMENT
/begin AXIS_PTS ldpm_tco_1_6 "" 0x43f47 TCO _REC_AXS_20_u1 28.575 _CNV_A_R_LINEAR_____0_CM 6 -48. 142.5 FORMAT "%5.1" /end AXIS_PTS
/begin AXIS_PTS ldpm_gr_mt_3 "" 0x43c17 GR_MT _REC_AXS_20_u1 255. _CNV_A_R_LINEAR_____10_CM 13 0. 255. FORMAT "%3.0" /end AXIS_PTS
/begin AXIS_PTS ldpm_gr_at_3 "" 0x43bf2 GR_AT _REC_AXS_20_u1 255. _CNV_A_R_LINEAR_____10_CM 13 0. 255. FORMAT "%3.0" /end AXIS_PTS
/begin MEASUREMENT ERR_INFO_STAT "" UBYTE _CNV_S_2_RANGE______21_R_CM 1 100. 0. 255. ECU_ADDRESS 0x3fd420 /end MEASUREMENT
/begin MEASUREMENT ERR_INFO_STAT "" UBYTE _CNV_S_2_RANGE______21_R_CM 1 100. 0. 255. ECU_ADDRESS 0x3fd424 /end MEASUREMENT
/begin MEASUREMENT ERR_INFO_STAT "" UBYTE _CNV_S_2_RANGE______21_R_CM 1 100. 0. 255. ECU_ADDRESS 0x3fd428 /end MEASUREMENT
/begin MEASUREMENT ERR_INFO_STAT "" UBYTE _CNV_S_2_RANGE______21_R_CM 1 100. 0. 255. ECU_ADDRESS 0x3fd42c /end MEASUREMENT
/begin MEASUREMENT ERR_INFO_STAT "" UBYTE _CNV_S_2_RANGE______21_R_CM 1 100. 0. 255. ECU_ADDRESS 0x3fd430 /end MEASUREMENT
/begin MEASUREMENT ERR_INFO_STAT "" UBYTE _CNV_S_2_RANGE______21_R_CM 1 100. 0. 255. ECU_ADDRESS 0x3fd434 /end MEASUREMENT
/begin MEASUREMENT ERR_INFO_STAT "" UBYTE _CNV_S_2_RANGE______21_R_CM 1 100. 0. 255. ECU_ADDRESS 0x3fd6a4 /end MEASUREMENT
/begin MEASUREMENT ERR_INFO_STAT "" UBYTE _CNV_S_2_RANGE______21_R_CM 1 100. 0. 255. ECU_ADDRESS 0x3fd6a8 /end MEASUREMENT
/begin MEASUREMENT CTR_ABC_END_DIAG_VLS_UP_MIN_COLD "" UBYTE _CNV_A_R_LINEAR_____12_CM 1 100. 0. 255. ECU_ADDRESS 0x3fd6a9 FORMAT "%3.0" /end MEASUREMENT
/begin MEASUREMENT ERR_INFO_STAT "" UBYTE _CNV_S_2_RANGE______21_R_CM 1 100. 0. 255. ECU_ADDRESS 0x3fd604 /end MEASUREMENT
/begin MEASUREMENT ERR_INFO_STAT "" UBYTE _CNV_S_2_RANGE______21_R_CM 1 100. 0. 255. ECU_ADDRESS 0x3fd634 /end MEASUREMENT
/begin MEASUREMENT ERR_INFO_STAT "" UBYTE _CNV_S_2_RANGE______21_R_CM 1 100. 0. 255. ECU_ADDRESS 0x3fd3f4 /end MEASUREMENT
/begin MEASUREMENT ERR_INFO_STAT "" UBYTE _CNV_S_2_RANGE______21_R_CM 1 100. 0. 255. ECU_ADDRESS 0x3fd3f8 /end MEASUREMENT
/begin MEASUREMENT ERR_INFO_STAT "" UBYTE _CNV_S_2_RANGE______21_R_CM 1 100. 0. 255. ECU_ADDRESS 0x3fd600 /end MEASUREMENT
/begin MEASUREMENT ERR_INFO_STAT "" UBYTE _CNV_S_2_RANGE______21_R_CM 1 100. 0. 255. ECU_ADDRESS 0x3fd348 /end MEASUREMENT
/begin MEASUREMENT ERR_INFO_STAT "" UBYTE _CNV_S_2_RANGE______21_R_CM 1 100. 0. 255. ECU_ADDRESS 0x3fd34c /end MEASUREMENT
/begin MEASUREMENT ERR_INFO_STAT "" UBYTE _CNV_S_2_RANGE______21_R_CM 1 100. 0. 255. ECU_ADDRESS 0x3fd69c /end MEASUREMENT
/begin MEASUREMENT ERR_INFO_STAT "" UBYTE _CNV_S_2_RANGE______21_R_CM 1 100. 0. 255. ECU_ADDRESS 0x3fd6a0 /end MEASUREMENT
/begin MEASUREMENT ERR_INFO_STAT "" UBYTE _CNV_S_2_RANGE______21_R_CM 1 100. 0. 255. ECU_ADDRESS 0x3fd668 /end MEASUREMENT
/begin MEASUREMENT ERR_INFO_STAT "" UBYTE _CNV_S_2_RANGE______21_R_CM 1 100. 0. 255. ECU_ADDRESS 0x3fd3b8 /end MEASUREMENT
/begin MEASUREMENT ERR_INFO_STAT "" UBYTE _CNV_S_2_RANGE______21_R_CM 1 100. 0. 255. ECU_ADDRESS 0x3fd568 /end MEASUREMENT
/begin MEASUREMENT ERR_INFO_STAT "" UBYTE _CNV_S_2_RANGE______21_R_CM 1 100. 0. 255. ECU_ADDRESS 0x3fd498 /end MEASUREMENT
/begin MEASUREMENT ERR_INFO_STAT "" UBYTE _CNV_S_2_RANGE______21_R_CM 1 100. 0. 255. ECU_ADDRESS 0x3fd3bc /end MEASUREMENT
/begin MEASUREMENT ERR_INFO_STAT "" UBYTE _CNV_S_2_RANGE______21_R_CM 1 100. 0. 255. ECU_ADDRESS 0x3fd3c0 /end MEASUREMENT
/begin MEASUREMENT ERR_INFO_STAT "" UBYTE _CNV_S_2_RANGE______21_R_CM 1 100. 0. 255. ECU_ADDRESS 0x3fd53c /end MEASUREMENT
/begin MEASUREMENT ERR_INFO_STAT "" UBYTE _CNV_S_2_RANGE______21_R_CM 1 100. 0. 255. ECU_ADDRESS 0x3fd65c /end MEASUREMENT
/begin MEASUREMENT ERR_INFO_STAT "" UBYTE _CNV_S_2_RANGE______21_R_CM 1 100. 0. 255. ECU_ADDRESS 0x3fd4c8 /end MEASUREMENT
/begin MEASUREMENT ERR_INFO_STAT "" UBYTE _CNV_S_2_RANGE______21_R_CM 1 100. 0. 255. ECU_ADDRESS 0x3fd4e0 /end MEASUREMENT
/begin MEASUREMENT ERR_INFO_STAT "" UBYTE _CNV_S_2_RANGE______21_R_CM 1 100. 0. 255. ECU_ADDRESS 0x3fd640 /end MEASUREMENT
/begin MEASUREMENT ERR_INFO_STAT "" UBYTE _CNV_S_2_RANGE______21_R_CM 1 100. 0. 255. ECU_ADDRESS 0x3fd4ec /end MEASUREMENT
/begin MEASUREMENT ERR_INFO_STAT "" UBYTE _CNV_S_2_RANGE______21_R_CM 1 100. 0. 255. ECU_ADDRESS 0x3fd4e4 /end MEASUREMENT
/begin MEASUREMENT ERR_INFO_STAT "" UBYTE _CNV_S_2_RANGE______21_R_CM 1 100. 0. 255. ECU_ADDRESS 0x3fd648 /end MEASUREMENT
/begin MEASUREMENT ERR_INFO_STAT "" UBYTE _CNV_S_2_RANGE______21_R_CM 1 100. 0. 255. ECU_ADDRESS 0x3fd59c /end MEASUREMENT
/begin MEASUREMENT ERR_INFO_STAT "" UBYTE _CNV_S_2_RANGE______21_R_CM 1 100. 0. 255. ECU_ADDRESS 0x3fd5a0 /end MEASUREMENT
/begin MEASUREMENT ERR_INFO_STAT "" UBYTE _CNV_S_2_RANGE______21_R_CM 1 100. 0. 255. ECU_ADDRESS 0x3fd354 /end MEASUREMENT
/begin MEASUREMENT ERR_INFO_STAT "" UBYTE _CNV_S_2_RANGE______21_R_CM 1 100. 0. 255. ECU_ADDRESS 0x3fd4d0 /end MEASUREMENT
/begin MEASUREMENT ERR_INFO_STAT "" UBYTE _CNV_S_2_RANGE______21_R_CM 1 100. 0. 255. ECU_ADDRESS 0x3fd578 /end MEASUREMENT
/begin MEASUREMENT ERR_INFO_STAT "" UBYTE _CNV_S_2_RANGE______21_R_CM 1 100. 0. 255. ECU_ADDRESS 0x3fd48c /end MEASUREMENT
/begin MEASUREMENT ERR_INFO_STAT "" UBYTE _CNV_S_2_RANGE______21_R_CM 1 100. 0. 255. ECU_ADDRESS 0x3fd66c /end MEASUREMENT
/begin MEASUREMENT ERR_INFO_STAT "" UBYTE _CNV_S_2_RANGE______21_R_CM 1 100. 0. 255. ECU_ADDRESS 0x3fd584 /end MEASUREMENT
/begin MEASUREMENT ERR_INFO_STAT "" UBYTE _CNV_S_2_RANGE______21_R_CM 1 100. 0. 255. ECU_ADDRESS 0x3fd6bc /end MEASUREMENT
/begin MEASUREMENT ERR_INFO_STAT "" UBYTE _CNV_S_2_RANGE______21_R_CM 1 100. 0. 255. ECU_ADDRESS 0x3fd6c0 /end MEASUREMENT
/begin MEASUREMENT ERR_INFO_STAT "" UBYTE _CNV_S_2_RANGE______21_R_CM 1 100. 0. 255. ECU_ADDRESS 0x3fd4ac /end MEASUREMENT
/begin MEASUREMENT ERR_INFO_STAT "" UBYTE _CNV_S_2_RANGE______21_R_CM 1 100. 0. 255. ECU_ADDRESS 0x3fd4b0 /end MEASUREMENT
/begin MEASUREMENT ERR_INFO_STAT "" UBYTE _CNV_S_2_RANGE______21_R_CM 1 100. 0. 255. ECU_ADDRESS 0x3fd63c /end MEASUREMENT
/begin MEASUREMENT ERR_INFO_STAT "" UBYTE _CNV_S_2_RANGE______21_R_CM 1 100. 0. 255. ECU_ADDRESS 0x3fd64c /end MEASUREMENT
/begin MEASUREMENT ERR_INFO_STAT "" UBYTE _CNV_S_2_RANGE______21_R_CM 1 100. 0. 255. ECU_ADDRESS 0x3fd558 /end MEASUREMENT
/begin MEASUREMENT ERR_INFO_STAT "" UBYTE _CNV_S_2_RANGE______21_R_CM 1 100. 0. 255. ECU_ADDRESS 0x3fd514 /end MEASUREMENT
/begin MEASUREMENT ERR_INFO_STAT "" UBYTE _CNV_S_2_RANGE______21_R_CM 1 100. 0. 255. ECU_ADDRESS 0x3fd518 /end MEASUREMENT
/begin MEASUREMENT ERR_INFO_STAT "" UBYTE _CNV_S_2_RANGE______21_R_CM 1 100. 0. 255. ECU_ADDRESS 0x3fd4c0 /end MEASUREMENT
/begin MEASUREMENT ERR_INFO_STAT "" UBYTE _CNV_S_2_RANGE______21_R_CM 1 100. 0. 255. ECU_ADDRESS 0x3fd3dc /end MEASUREMENT
/begin MEASUREMENT ERR_INFO_STAT "" UBYTE _CNV_S_2_RANGE______21_R_CM 1 100. 0. 255. ECU_ADDRESS 0x3fd3e0 /end MEASUREMENT
/begin MEASUREMENT ERR_INFO_STAT "" UBYTE _CNV_S_2_RANGE______21_R_CM 1 100. 0. 255. ECU_ADDRESS 0x3fd614 /end MEASUREMENT
/begin MEASUREMENT ERR_INFO_STAT "" UBYTE _CNV_S_2_RANGE______21_R_CM 1 100. 0. 255. ECU_ADDRESS 0x3fd508 /end MEASUREMENT
/begin MEASUREMENT ERR_INFO_STAT "" UBYTE _CNV_S_2_RANGE______21_R_CM 1 100. 0. 255. ECU_ADDRESS 0x3fd5f0 /end MEASUREMENT
/begin MEASUREMENT ERR_INFO_STAT "" UBYTE _CNV_S_2_RANGE______21_R_CM 1 100. 0. 255. ECU_ADDRESS 0x3fd61c /end MEASUREMENT
/begin MEASUREMENT ERR_INFO_STAT "" UBYTE _CNV_S_2_RANGE______21_R_CM 1 100. 0. 255. ECU_ADDRESS 0x3fd5c4 /end MEASUREMENT
/begin MEASUREMENT ERR_INFO_STAT "" UBYTE _CNV_S_2_RANGE______21_R_CM 1 100. 0. 255. ECU_ADDRESS 0x3fd5a4 /end MEASUREMENT
/begin MEASUREMENT ERR_INFO_STAT "" UBYTE _CNV_S_2_RANGE______21_R_CM 1 100. 0. 255. ECU_ADDRESS 0x3fd5a8 /end MEASUREMENT
/begin MEASUREMENT ERR_INFO_STAT "" UBYTE _CNV_S_2_RANGE______21_R_CM 1 100. 0. 255. ECU_ADDRESS 0x3fd418 /end MEASUREMENT
/begin MEASUREMENT ERR_INFO_STAT "" UBYTE _CNV_S_2_RANGE______21_R_CM 1 100. 0. 255. ECU_ADDRESS 0x3fd41c /end MEASUREMENT
/begin MEASUREMENT ERR_INFO_STAT "" UBYTE _CNV_S_2_RANGE______21_R_CM 1 100. 0. 255. ECU_ADDRESS 0x3fd6ac /end MEASUREMENT
/begin MEASUREMENT ERR_INFO_STAT "" UBYTE _CNV_S_2_RANGE______21_R_CM 1 100. 0. 255. ECU_ADDRESS 0x3fd6b0 /end MEASUREMENT
/begin MEASUREMENT ERR_INFO_STAT "" UBYTE _CNV_S_2_RANGE______21_R_CM 1 100. 0. 255. ECU_ADDRESS 0x3fd490 /end MEASUREMENT
/begin MEASUREMENT ERR_INFO_STAT "" UBYTE _CNV_S_2_RANGE______21_R_CM 1 100. 0. 255. ECU_ADDRESS 0x3fd494 /end MEASUREMENT
/begin MEASUREMENT ERR_INFO_STAT "" UBYTE _CNV_S_2_RANGE______21_R_CM 1 100. 0. 255. ECU_ADDRESS 0x3fd62c /end MEASUREMENT
/begin MEASUREMENT ERR_INFO_STAT "" UBYTE _CNV_S_2_RANGE______21_R_CM 1 100. 0. 255. ECU_ADDRESS 0x3fd374 /end MEASUREMENT
/begin MEASUREMENT ERR_INFO_STAT "" UBYTE _CNV_S_2_RANGE______21_R_CM 1 100. 0. 255. ECU_ADDRESS 0x3fd378 /end MEASUREMENT
/begin MEASUREMENT ERR_INFO_STAT "" UBYTE _CNV_S_2_RANGE______21_R_CM 1 100. 0. 255. ECU_ADDRESS 0x3fd50c /end MEASUREMENT
/begin MEASUREMENT ERR_INFO_STAT "" UBYTE _CNV_S_2_RANGE______21_R_CM 1 100. 0. 255. ECU_ADDRESS 0x3fd6e4 /end MEASUREMENT
/begin MEASUREMENT ERR_INFO_STAT "" UBYTE _CNV_S_2_RANGE______21_R_CM 1 100. 0. 255. ECU_ADDRESS 0x3fd6e8 /end MEASUREMENT
/begin MEASUREMENT ERR_INFO_STAT "" UBYTE _CNV_S_2_RANGE______21_R_CM 1 100. 0. 255. ECU_ADDRESS 0x3fd3c4 /end MEASUREMENT
/begin MEASUREMENT ERR_INFO_STAT "" UBYTE _CNV_S_2_RANGE______21_R_CM 1 100. 0. 255. ECU_ADDRESS 0x3fd3c8 /end MEASUREMENT
/begin MEASUREMENT ERR_INFO_STAT "" UBYTE _CNV_S_2_RANGE______21_R_CM 1 100. 0. 255. ECU_ADDRESS 0x3fd4b8 /end MEASUREMENT
/begin MEASUREMENT ERR_INFO_STAT "" UBYTE _CNV_S_2_RANGE______21_R_CM 1 100. 0. 255. ECU_ADDRESS 0x3fd474 /end MEASUREMENT
/begin MEASUREMENT ERR_INFO_STAT "" UBYTE _CNV_S_2_RANGE______21_R_CM 1 100. 0. 255. ECU_ADDRESS 0x3fd544 /end MEASUREMENT
/begin MEASUREMENT ERR_INFO_STAT "" UBYTE _CNV_S_2_RANGE______21_R_CM 1 100. 0. 255. ECU_ADDRESS 0x3fd680 /end MEASUREMENT
/begin MEASUREMENT ERR_INFO_STAT "" UBYTE _CNV_S_2_RANGE______21_R_CM 1 100. 0. 255. ECU_ADDRESS 0x3fd468 /end MEASUREMENT
/begin MEASUREMENT ERR_INFO_STAT "" UBYTE _CNV_S_2_RANGE______21_R_CM 1 100. 0. 255. ECU_ADDRESS 0x3fd46c /end MEASUREMENT
/begin MEASUREMENT ERR_INFO_STAT "" UBYTE _CNV_S_2_RANGE______21_R_CM 1 100. 0. 255. ECU_ADDRESS 0x3fd3ec /end MEASUREMENT
/begin MEASUREMENT ERR_INFO_STAT "" UBYTE _CNV_S_2_RANGE______21_R_CM 1 100. 0. 255. ECU_ADDRESS 0x3fd570 /end MEASUREMENT
/begin MEASUREMENT ERR_INFO_STAT "" UBYTE _CNV_S_2_RANGE______21_R_CM 1 100. 0. 255. ECU_ADDRESS 0x3fd620 /end MEASUREMENT
/begin MEASUREMENT ERR_INFO_STAT "" UBYTE _CNV_S_2_RANGE______21_R_CM 1 100. 0. 255. ECU_ADDRESS 0x3fd414 /end MEASUREMENT
/begin MEASUREMENT ERR_INFO_STAT "" UBYTE _CNV_S_2_RANGE______21_R_CM 1 100. 0. 255. ECU_ADDRESS 0x3fd5ec /end MEASUREMENT
/begin MEASUREMENT ERR_INFO_STAT "" UBYTE _CNV_S_2_RANGE______21_R_CM 1 100. 0. 255. ECU_ADDRESS 0x3fd5e4 /end MEASUREMENT
/begin MEASUREMENT ERR_INFO_STAT "" UBYTE _CNV_S_2_RANGE______21_R_CM 1 100. 0. 255. ECU_ADDRESS 0x3fd3e4 /end MEASUREMENT
/begin MEASUREMENT ERR_INFO_STAT "" UBYTE _CNV_S_2_RANGE______21_R_CM 1 100. 0. 255. ECU_ADDRESS 0x3fd3e8 /end MEASUREMENT
/begin MEASUREMENT ERR_INFO_STAT "" UBYTE _CNV_S_2_RANGE______21_R_CM 1 100. 0. 255. ECU_ADDRESS 0x3fd564 /end MEASUREMENT
/begin MEASUREMENT ERR_INFO_STAT "" UBYTE _CNV_S_2_RANGE______21_R_CM 1 100. 0. 255. ECU_ADDRESS 0x3fd5d0 /end MEASUREMENT
/begin MEASUREMENT ERR_INFO_STAT "" UBYTE _CNV_S_2_RANGE______21_R_CM 1 100. 0. 255. ECU_ADDRESS 0x3fd37c /end MEASUREMENT
/begin MEASUREMENT ERR_INFO_STAT "" UBYTE _CNV_S_2_RANGE______21_R_CM 1 100. 0. 255. ECU_ADDRESS 0x3fd380 /end MEASUREMENT
/begin MEASUREMENT ERR_INFO_STAT "" UBYTE _CNV_S_2_RANGE______21_R_CM 1 100. 0. 255. ECU_ADDRESS 0x3fd5fc /end MEASUREMENT
/begin MEASUREMENT ERR_INFO_STAT "" UBYTE _CNV_S_2_RANGE______21_R_CM 1 100. 0. 255. ECU_ADDRESS 0x3fd554 /end MEASUREMENT
/begin MEASUREMENT ERR_INFO_STAT "" UBYTE _CNV_S_2_RANGE______21_R_CM 1 100. 0. 255. ECU_ADDRESS 0x3fd560 /end MEASUREMENT
/begin MEASUREMENT ERR_INFO_STAT "" UBYTE _CNV_S_2_RANGE______21_R_CM 1 100. 0. 255. ECU_ADDRESS 0x3fd5d4 /end MEASUREMENT
/begin MEASUREMENT ERR_INFO_STAT "" UBYTE _CNV_S_2_RANGE______21_R_CM 1 100. 0. 255. ECU_ADDRESS 0x3fd5d8 /end MEASUREMENT
/begin MEASUREMENT ERR_INFO_STAT "" UBYTE _CNV_S_2_RANGE______21_R_CM 1 100. 0. 255. ECU_ADDRESS 0x3fd450 /end MEASUREMENT
/begin MEASUREMENT ERR_INFO_STAT "" UBYTE _CNV_S_2_RANGE______21_R_CM 1 100. 0. 255. ECU_ADDRESS 0x3fd454 /end MEASUREMENT
/begin MEASUREMENT ERR_INFO_STAT "" UBYTE _CNV_S_2_RANGE______21_R_CM 1 100. 0. 255. ECU_ADDRESS 0x3fd6c4 /end MEASUREMENT
/begin MEASUREMENT ERR_INFO_STAT "" UBYTE _CNV_S_2_RANGE______21_R_CM 1 100. 0. 255. ECU_ADDRESS 0x3fd6c8 /end MEASUREMENT
/begin MEASUREMENT ERR_INFO_STAT "" UBYTE _CNV_S_2_RANGE______21_R_CM 1 100. 0. 255. ECU_ADDRESS 0x3fd5c8 /end MEASUREMENT
/begin MEASUREMENT ERR_INFO_STAT "" UBYTE _CNV_S_2_RANGE______21_R_CM 1 100. 0. 255. ECU_ADDRESS 0x3fd358 /end MEASUREMENT
/begin MEASUREMENT ERR_INFO_STAT "" UBYTE _CNV_S_2_RANGE______21_R_CM 1 100. 0. 255. ECU_ADDRESS 0x3fd4c4 /end MEASUREMENT
/begin MEASUREMENT ERR_INFO_STAT "" UBYTE _CNV_S_2_RANGE______21_R_CM 1 100. 0. 255. ECU_ADDRESS 0x3fd630 /end MEASUREMENT
/begin MEASUREMENT ERR_INFO_STAT "" UBYTE _CNV_S_2_RANGE______21_R_CM 1 100. 0. 255. ECU_ADDRESS 0x3fd67c /end MEASUREMENT
/begin MEASUREMENT ERR_INFO_STAT "" UBYTE _CNV_S_2_RANGE______21_R_CM 1 100. 0. 255. ECU_ADDRESS 0x3fd5dc /end MEASUREMENT
/begin MEASUREMENT ERR_INFO_STAT "" UBYTE _CNV_S_2_RANGE______21_R_CM 1 100. 0. 255. ECU_ADDRESS 0x3fd5e0 /end MEASUREMENT
/begin MEASUREMENT ERR_INFO_STAT "" UBYTE _CNV_S_2_RANGE______21_R_CM 1 100. 0. 255. ECU_ADDRESS 0x3fd3fc /end MEASUREMENT
/begin MEASUREMENT ERR_INFO_STAT "" UBYTE _CNV_S_2_RANGE______21_R_CM 1 100. 0. 255. ECU_ADDRESS 0x3fd400 /end MEASUREMENT
/begin MEASUREMENT ERR_INFO_STAT "" UBYTE _CNV_S_2_RANGE______21_R_CM 1 100. 0. 255. ECU_ADDRESS 0x3fd458 /end MEASUREMENT
/begin MEASUREMENT ERR_INFO_STAT "" UBYTE _CNV_S_2_RANGE______21_R_CM 1 100. 0. 255. ECU_ADDRESS 0x3fd45c /end MEASUREMENT
/begin MEASUREMENT ERR_INFO_STAT "" UBYTE _CNV_S_2_RANGE______21_R_CM 1 100. 0. 255. ECU_ADDRESS 0x3fd47c /end MEASUREMENT
/begin MEASUREMENT ERR_INFO_STAT "" UBYTE _CNV_S_2_RANGE______21_R_CM 1 100. 0. 255. ECU_ADDRESS 0x3fd49c /end MEASUREMENT
/begin MEASUREMENT ERR_INFO_STAT "" UBYTE _CNV_S_2_RANGE______21_R_CM 1 100. 0. 255. ECU_ADDRESS 0x3fd480 /end MEASUREMENT
/begin MEASUREMENT ERR_INFO_STAT "" UBYTE _CNV_S_2_RANGE______21_R_CM 1 100. 0. 255. ECU_ADDRESS 0x3fd484 /end MEASUREMENT
/begin MEASUREMENT ERR_INFO_STAT "" UBYTE _CNV_S_2_RANGE______21_R_CM 1 100. 0. 255. ECU_ADDRESS 0x3fd360 /end MEASUREMENT
/begin MEASUREMENT ERR_INFO_STAT "" UBYTE _CNV_S_2_RANGE______21_R_CM 1 100. 0. 255. ECU_ADDRESS 0x3fd3b4 /end MEASUREMENT
/begin MEASUREMENT ERR_INFO_STAT "" UBYTE _CNV_S_2_RANGE______21_R_CM 1 100. 0. 255. ECU_ADDRESS 0x3fd5c0 /end MEASUREMENT
/begin MEASUREMENT ERR_INFO_STAT "" UBYTE _CNV_S_2_RANGE______21_R_CM 1 100. 0. 255. ECU_ADDRESS 0x3fd3cc /end MEASUREMENT
/begin MEASUREMENT ERR_INFO_STAT "" UBYTE _CNV_S_2_RANGE______21_R_CM 1 100. 0. 255. ECU_ADDRESS 0x3fd3d0 /end MEASUREMENT
/begin MEASUREMENT ERR_INFO_STAT "" UBYTE _CNV_S_2_RANGE______21_R_CM 1 100. 0. 255. ECU_ADDRESS 0x3fd4f0 /end MEASUREMENT
/begin MEASUREMENT ERR_INFO_STAT "" UBYTE _CNV_S_2_RANGE______21_R_CM 1 100. 0. 255. ECU_ADDRESS 0x3fd5f4 /end MEASUREMENT
/begin MEASUREMENT ERR_INFO_STAT "" UBYTE _CNV_S_2_RANGE______21_R_CM 1 100. 0. 255. ECU_ADDRESS 0x3fd674 /end MEASUREMENT
/begin MEASUREMENT ERR_INFO_STAT "" UBYTE _CNV_S_2_RANGE______21_R_CM 1 100. 0. 255. ECU_ADDRESS 0x3fd548 /end MEASUREMENT
/begin MEASUREMENT ERR_INFO_STAT "" UBYTE _CNV_S_2_RANGE______21_R_CM 1 100. 0. 255. ECU_ADDRESS 0x3fd4b4 /end MEASUREMENT
/begin MEASUREMENT ERR_INFO_STAT "" UBYTE _CNV_S_2_RANGE______21_R_CM 1 100. 0. 255. ECU_ADDRESS 0x3fd470 /end MEASUREMENT
/begin MEASUREMENT ERR_INFO_STAT "" UBYTE _CNV_S_2_RANGE______21_R_CM 1 100. 0. 255. ECU_ADDRESS 0x3fd3ac /end MEASUREMENT
/begin MEASUREMENT ERR_INFO_STAT "" UBYTE _CNV_S_2_RANGE______21_R_CM 1 100. 0. 255. ECU_ADDRESS 0x3fd404 /end MEASUREMENT
/begin MEASUREMENT ERR_INFO_STAT "" UBYTE _CNV_S_2_RANGE______21_R_CM 1 100. 0. 255. ECU_ADDRESS 0x3fd3b0 /end MEASUREMENT
/begin MEASUREMENT ERR_INFO_STAT "" UBYTE _CNV_S_2_RANGE______21_R_CM 1 100. 0. 255. ECU_ADDRESS 0x3fd408 /end MEASUREMENT
/begin MEASUREMENT ERR_INFO_STAT "" UBYTE _CNV_S_2_RANGE______21_R_CM 1 100. 0. 255. ECU_ADDRESS 0x3fd3a4 /end MEASUREMENT
/begin MEASUREMENT ERR_INFO_STAT "" UBYTE _CNV_S_2_RANGE______21_R_CM 1 100. 0. 255. ECU_ADDRESS 0x3fd3a8 /end MEASUREMENT
/begin MEASUREMENT ERR_INFO_STAT "" UBYTE _CNV_S_2_RANGE______21_R_CM 1 100. 0. 255. ECU_ADDRESS 0x3fd4bc /end MEASUREMENT
/begin MEASUREMENT ERR_INFO_STAT "" UBYTE _CNV_S_2_RANGE______21_R_CM 1 100. 0. 255. ECU_ADDRESS 0x3fd410 /end MEASUREMENT
/begin MEASUREMENT ERR_INFO_STAT "" UBYTE _CNV_S_2_RANGE______21_R_CM 1 100. 0. 255. ECU_ADDRESS 0x3fd510 /end MEASUREMENT
/begin MEASUREMENT ERR_INFO_STAT "" UBYTE _CNV_S_2_RANGE______21_R_CM 1 100. 0. 255. ECU_ADDRESS 0x3fd628 /end MEASUREMENT
/begin MEASUREMENT ERR_INFO_STAT "" UBYTE _CNV_S_2_RANGE______21_R_CM 1 100. 0. 255. ECU_ADDRESS 0x3fd5b4 /end MEASUREMENT
/begin MEASUREMENT ERR_INFO_STAT "" UBYTE _CNV_S_2_RANGE______21_R_CM 1 100. 0. 255. ECU_ADDRESS 0x3fd5b8 /end MEASUREMENT
/begin MEASUREMENT ERR_INFO_STAT "" UBYTE _CNV_S_2_RANGE______21_R_CM 1 100. 0. 255. ECU_ADDRESS 0x3fd6dc /end MEASUREMENT
/begin MEASUREMENT ERR_INFO_STAT "" UBYTE _CNV_S_2_RANGE______21_R_CM 1 100. 0. 255. ECU_ADDRESS 0x3fd6e0 /end MEASUREMENT
/begin MEASUREMENT ERR_INFO_STAT "" UBYTE _CNV_S_2_RANGE______21_R_CM 1 100. 0. 255. ECU_ADDRESS 0x3fd40c /end MEASUREMENT
/begin MEASUREMENT ERR_INFO_STAT "" UBYTE _CNV_S_2_RANGE______21_R_CM 1 100. 0. 255. ECU_ADDRESS 0x3fd4a0 /end MEASUREMENT
/begin MEASUREMENT ERR_INFO_STAT "" UBYTE _CNV_S_2_RANGE______21_R_CM 1 100. 0. 255. ECU_ADDRESS 0x3fd610 /end MEASUREMENT
/begin MEASUREMENT ERR_INFO_STAT "" UBYTE _CNV_S_2_RANGE______21_R_CM 1 100. 0. 255. ECU_ADDRESS 0x3fd618 /end MEASUREMENT
/begin MEASUREMENT ERR_INFO_STAT "" UBYTE _CNV_S_2_RANGE______21_R_CM 1 100. 0. 255. ECU_ADDRESS 0x3fd438 /end MEASUREMENT
/begin MEASUREMENT ERR_INFO_STAT "" UBYTE _CNV_S_2_RANGE______21_R_CM 1 100. 0. 255. ECU_ADDRESS 0x3fd43c /end MEASUREMENT
/begin MEASUREMENT ERR_INFO_STAT "" UBYTE _CNV_S_2_RANGE______21_R_CM 1 100. 0. 255. ECU_ADDRESS 0x3fd440 /end MEASUREMENT
/begin MEASUREMENT ERR_INFO_STAT "" UBYTE _CNV_S_2_RANGE______21_R_CM 1 100. 0. 255. ECU_ADDRESS 0x3fd444 /end MEASUREMENT
/begin MEASUREMENT ERR_INFO_STAT "" UBYTE _CNV_S_2_RANGE______21_R_CM 1 100. 0. 255. ECU_ADDRESS 0x3fd448 /end MEASUREMENT
/begin MEASUREMENT ERR_INFO_STAT "" UBYTE _CNV_S_2_RANGE______21_R_CM 1 100. 0. 255. ECU_ADDRESS 0x3fd44c /end MEASUREMENT
/begin MEASUREMENT ERR_INFO_STAT "" UBYTE _CNV_S_2_RANGE______21_R_CM 1 100. 0. 255. ECU_ADDRESS 0x3fd6b4 /end MEASUREMENT
/begin MEASUREMENT ERR_INFO_STAT "" UBYTE _CNV_S_2_RANGE______21_R_CM 1 100. 0. 255. ECU_ADDRESS 0x3fd6b8 /end MEASUREMENT
/begin MEASUREMENT ERR_INFO_STAT "" UBYTE _CNV_S_2_RANGE______21_R_CM 1 100. 0. 255. ECU_ADDRESS 0x3fd350 /end MEASUREMENT
/begin MEASUREMENT ERR_INFO_STAT "" UBYTE _CNV_S_2_RANGE______21_R_CM 1 100. 0. 255. ECU_ADDRESS 0x3fd524 /end MEASUREMENT
/begin MEASUREMENT ERR_INFO_STAT "" UBYTE _CNV_S_2_RANGE______21_R_CM 1 100. 0. 255. ECU_ADDRESS 0x3fd54c /end MEASUREMENT
/begin MEASUREMENT ERR_INFO_STAT "" UBYTE _CNV_S_2_RANGE______21_R_CM 1 100. 0. 255. ECU_ADDRESS 0x3fd364 /end MEASUREMENT
/begin MEASUREMENT ERR_INFO_STAT "" UBYTE _CNV_S_2_RANGE______21_R_CM 1 100. 0. 255. ECU_ADDRESS 0x3fd368 /end MEASUREMENT
/begin MEASUREMENT ERR_INFO_STAT "" UBYTE _CNV_S_2_RANGE______21_R_CM 1 100. 0. 255. ECU_ADDRESS 0x3fd460 /end MEASUREMENT
/begin MEASUREMENT ERR_INFO_STAT "" UBYTE _CNV_S_2_RANGE______21_R_CM 1 100. 0. 255. ECU_ADDRESS 0x3fd500 /end MEASUREMENT
/begin MEASUREMENT ERR_INFO_STAT "" UBYTE _CNV_S_2_RANGE______21_R_CM 1 100. 0. 255. ECU_ADDRESS 0x3fd464 /end MEASUREMENT
/begin MEASUREMENT ERR_INFO_STAT "" UBYTE _CNV_S_2_RANGE______21_R_CM 1 100. 0. 255. ECU_ADDRESS 0x3fd3d4 /end MEASUREMENT
/begin MEASUREMENT ERR_INFO_STAT "" UBYTE _CNV_S_2_RANGE______21_R_CM 1 100. 0. 255. ECU_ADDRESS 0x3fd3d8 /end MEASUREMENT
/begin MEASUREMENT ERR_INFO_STAT "" UBYTE _CNV_S_2_RANGE______21_R_CM 1 100. 0. 255. ECU_ADDRESS 0x3fd588 /end MEASUREMENT
/begin MEASUREMENT ERR_INFO_STAT "" UBYTE _CNV_S_2_RANGE______21_R_CM 1 100. 0. 255. ECU_ADDRESS 0x3fd4d4 /end MEASUREMENT
/begin MEASUREMENT ERR_INFO_STAT "" UBYTE _CNV_S_2_RANGE______21_R_CM 1 100. 0. 255. ECU_ADDRESS 0x3fd58c /end MEASUREMENT
/begin MEASUREMENT ERR_INFO_STAT "" UBYTE _CNV_S_2_RANGE______21_R_CM 1 100. 0. 255. ECU_ADDRESS 0x3fd678 /end MEASUREMENT
/begin MEASUREMENT ERR_INFO_STAT "" UBYTE _CNV_S_2_RANGE______21_R_CM 1 100. 0. 255. ECU_ADDRESS 0x3fd4fc /end MEASUREMENT
/begin MEASUREMENT ERR_INFO_STAT "" UBYTE _CNV_S_2_RANGE______21_R_CM 1 100. 0. 255. ECU_ADDRESS 0x3fd36c /end MEASUREMENT
/begin MEASUREMENT ERR_INFO_STAT "" UBYTE _CNV_S_2_RANGE______21_R_CM 1 100. 0. 255. ECU_ADDRESS 0x3fd51c /end MEASUREMENT
/begin MEASUREMENT ERR_INFO_STAT "" UBYTE _CNV_S_2_RANGE______21_R_CM 1 100. 0. 255. ECU_ADDRESS 0x3fd370 /end MEASUREMENT
/begin MEASUREMENT CTR_ABC_END_DIAG_VLS_DOWN_MIN_CO "" UBYTE _CNV_A_R_LINEAR_____12_CM 1 100. 0. 255. ECU_ADDRESS 0x3fd371 FORMAT "%3.0" /end MEASUREMENT
/begin MEASUREMENT ERR_INFO_STAT "" UBYTE _CNV_S_2_RANGE______21_R_CM 1 100. 0. 255. ECU_ADDRESS 0x3fd520 /end MEASUREMENT
/begin MEASUREMENT ERR_INFO_STAT "" UBYTE _CNV_S_2_RANGE______21_R_CM 1 100. 0. 255. ECU_ADDRESS 0x3fd5f8 /end MEASUREMENT
/begin MEASUREMENT LV_ERR_MIS_LOW_FUEL "??????????????????????????????" UBYTE _CNV_S_2_RANGE______21_R_CM 1 100. 0. 255. ECU_ADDRESS 0x3fd53f /end MEASUREMENT
/begin AXIS_PTS ldp_amp_ip_load_clc_amp "" 0x4413e AMP _REC_AXS_20_u2 5434. _CNV_A_R_LINEAR_____43_CM 6 0. 5434. FORMAT "%7.2" /end AXIS_PTS
/begin AXIS_PTS ldp_n_32_ip_load_clc "" 0x436ad N_32 _REC_AXS_20_u1 8160. _CNV_A_R_LINEAR_____5_CM 8 0. 8160. FORMAT "%4.0" /end AXIS_PTS
/begin AXIS_PTS ldp_maf_ip_load_clc "" 0x445c6 MAF _REC_AXS_20_u2 1389. _CNV_A_R_LINEAR_____95_CM 8 0. 1389. FORMAT "%7.2" /end AXIS_PTS
/begin AXIS_PTS ldp_tfpa_ip_fac_fpapwm "" 0x439b1 TFPA _REC_AXS_20_u1 190.5 _CNV_A_R_LINEAR_____0_CM 6 -48. 142.5 FORMAT "%5.1" /end AXIS_PTS
/begin AXIS_PTS ldpm_fpa_mff_fusl "" 0x44f94 FPA_MFF _REC_AXS_20_u2 377.81 _CNV_A_R_LINEAR_____192_CM 8 0. 377.81 FORMAT "%7.2" /end AXIS_PTS
/begin AXIS_PTS ldpm_fup_dif_dly_fusl "" 0x44fb8 FUP_DIF_DLY _REC_AXS_20_u2 173888. _CNV_A_R_LINEAR_____194_CM 8 -86945.33 86942.67 FORMAT "%9.2" /end AXIS_PTS
/begin AXIS_PTS ldp_vb_ip_fpapwm "" 0x43add VB _REC_AXS_20_u1 26. _CNV_A_R_LINEAR_____53_CM 8 0. 26. FORMAT "%4.1" /end AXIS_PTS
/begin AXIS_PTS ldp_vb_ip_fpapwm_max "" 0x43ae6 VB _REC_AXS_20_u1 26. _CNV_A_R_LINEAR_____53_CM 8 0. 26. FORMAT "%4.1" /end AXIS_PTS
/begin AXIS_PTS ldp_mff_sp_ip_fup_sp_hom "" 0x44746 MFF_SP _REC_AXS_20_u2 1389. _CNV_A_R_LINEAR_____95_CM 10 0. 1389. FORMAT "%7.2" /end AXIS_PTS
/begin AXIS_PTS ldp_n_32_ip_fup_sp_hom "" 0x43689 N_32 _REC_AXS_20_u1 8160. _CNV_A_R_LINEAR_____5_CM 8 0. 8160. FORMAT "%4.0" /end AXIS_PTS
/begin AXIS_PTS ldpm_n_32_2_s "" 0x43d4a N_32 _REC_AXS_20_u1 8160. _CNV_A_R_LINEAR_____5_CM 8 0. 8160. FORMAT "%4.0" /end AXIS_PTS
/begin AXIS_PTS ldpm_mff_sp_s_2_s "" 0x45184 MFF_SP_S_2 _REC_AXS_20_u2 1389. _CNV_A_R_LINEAR_____95_CM 8 0. 1389. FORMAT "%7.2" /end AXIS_PTS
/begin AXIS_PTS ldp_tco_ip_fup_sp_st "" 0x43906 TCO _REC_AXS_20_u1 190.5 _CNV_A_R_LINEAR_____0_CM 8 -48. 142.5 FORMAT "%5.1" /end AXIS_PTS
/begin AXIS_PTS ldp_fup_sp_dif_ip_fac_fup_sp "" 0x443f4 ONLINE_DUMMY _REC_AXS_20_u2 173888. _CNV_A_R_LINEAR_____194_CM 8 -86945.33 86942.67 FORMAT "%9.2" /end AXIS_PTS
/begin AXIS_PTS ldp_fup_sp_pctl_ip_fpapwm_bas "" 0x44406 FUP_SP_PCTL _REC_AXS_20_u2 173888. _CNV_A_R_LINEAR_____190_CM 8 0. 173888. FORMAT "%6.0" /end AXIS_PTS
/begin AXIS_PTS ldp_n_32_ip_fac_fpapwm_bas "" 0x4366c N_32 _REC_AXS_20_u1 8160. _CNV_A_R_LINEAR_____5_CM 8 0. 8160. FORMAT "%4.0" /end AXIS_PTS
/begin AXIS_PTS ldp_mff_sp_ip_fac_fpapwm_bas "" 0x44734 MFF_SP _REC_AXS_20_u2 1389. _CNV_A_R_LINEAR_____95_CM 8 0. 1389. FORMAT "%7.2" /end AXIS_PTS
/begin AXIS_PTS ldp_lamb_sp__iga_bas_lamb "" 0x44466 LAMB_SP _REC_AXS_20_u2 31.99902344 _CNV_A_R_LINEAR_____148_CM 8 0. 31.99902344 FORMAT "%7.4" /end AXIS_PTS
/begin AXIS_PTS ldp_tco__fac_iga_ch_tco "" 0x4383f TCO _REC_AXS_20_u1 190.5 _CNV_A_R_LINEAR_____0_CM 8 -48. 142.5 FORMAT "%6.2" /end AXIS_PTS
/begin AXIS_PTS ldpm_n_32_1_iga "" 0x43ceb N_32 _REC_AXS_20_u1 8160. _CNV_A_R_LINEAR_____5_CM 8 0. 8160. FORMAT "%4.0" /end AXIS_PTS
/begin AXIS_PTS ldpm_t_ast_1_iga "" 0x45416 T_AST _REC_AXS_20_u2 6553.5 _CNV_A_R_LINEAR_____14_CM 8 0. 6553.5 FORMAT "%6.1" /end AXIS_PTS
/begin AXIS_PTS ldpm_tco_st_1_iga "" 0x44002 TCO_ST _REC_AXS_20_u1 190.5 _CNV_A_R_LINEAR_____0_CM 8 -48. 142.5 FORMAT "%5.1" /end AXIS_PTS
/begin AXIS_PTS ldp_fac_tq_req_clu__crlc_tq_add "" 0x44390 FAC_TQ_REQ_CLU _REC_AXS_20_u2 1.99996948 _CNV_A_R_LINEAR_____45_CM 4 0. 1.99996948 FORMAT "%7.5" /end AXIS_PTS
/begin AXIS_PTS ldpm_n_32_2_iga "" 0x43d26 N_32 _REC_AXS_20_u1 8160. _CNV_A_R_LINEAR_____5_CM 8 0. 8160. FORMAT "%4.0" /end AXIS_PTS
/begin AXIS_PTS ldpm_maf_hb_1_iga "" 0x43c51 MAF_HB _REC_AXS_20_u1 1389. _CNV_A_R_LINEAR_____18_CM 8 0. 1389. FORMAT "%4.0" /end AXIS_PTS
/begin AXIS_PTS ldp_tco__iga_bas_temp_cor "" 0x4386b TCO _REC_AXS_20_u1 190.5 _CNV_A_R_LINEAR_____0_CM 6 -48. 142.5 FORMAT "%5.1" /end AXIS_PTS
/begin AXIS_PTS ldp_tia__iga_bas_temp_cor "" 0x439c2 TIA _REC_AXS_20_u1 28.575 _CNV_A_R_LINEAR_____0_CM 6 -48. 142.5 FORMAT "%5.1" /end AXIS_PTS
/begin AXIS_PTS ldpm_n_32_fac_iga_pos_neg "" 0x43e2e N_32 _REC_AXS_20_u1 8160. _CNV_A_R_LINEAR_____5_CM 8 0. 8160. FORMAT "%4.0" /end AXIS_PTS
/begin AXIS_PTS ldp_maf_fac_iga_pos_neg "" 0x43473 MAF _REC_AXS_20_u1 1389. _CNV_A_R_LINEAR_____18_CM 6 0. 1389. FORMAT "%4.0" /end AXIS_PTS
/begin AXIS_PTS ldpm_tco__iga_egr "" 0x43fa2 TCO _REC_AXS_20_u1 190.5 _CNV_A_R_LINEAR_____0_CM 8 -48. 142.5 FORMAT "%5.1" /end AXIS_PTS
/begin AXIS_PTS ldp_n_32__iga_egr_s "" 0x4352e N_32 _REC_AXS_20_u1 8160. _CNV_A_R_LINEAR_____5_CM 5 0. 8160. FORMAT "%4.0" /end AXIS_PTS
/begin AXIS_PTS ldp_mff_sp_s__egr_iga "" 0x4475c MFF_SP_S _REC_AXS_20_u2 1389. _CNV_A_R_LINEAR_____95_CM 5 0. 1389. FORMAT "%7.2" /end AXIS_PTS
/begin AXIS_PTS ldp_egr_ratio_cor_2__iga_bas "" 0x442f4 EGR_RATIO_COR_2 _REC_AXS_20_u2 99.99847412 _CNV_A_R_LINEAR_____205_CM 6 0. 99.99847412 /end AXIS_PTS
/begin AXIS_PTS ldp_cyc_cast_ip_iga_dif_min_cyc "" 0x4426a CYC_CAST _REC_AXS_20_u2 65535. _CNV_A_R_LINEAR_____10_CM 8 0. 65535. FORMAT "%5.0" /end AXIS_PTS
/begin AXIS_PTS ldpm_n_32_2_igsp "" 0x43d2f N_32 _REC_AXS_20_u1 8160. _CNV_A_R_LINEAR_____5_CM 8 0. 8160. FORMAT "%4.0" /end AXIS_PTS
/begin AXIS_PTS ldpm_maf_hb_2_igsp "" 0x43c5a MAF_HB _REC_AXS_20_u1 1389. _CNV_A_R_LINEAR_____18_CM 6 0. 1389. FORMAT "%4.0" /end AXIS_PTS
/begin AXIS_PTS ldp_lamb_sp_iga_ref_lamb "" 0x44478 LAMB_SP _REC_AXS_20_u2 31.99902344 _CNV_A_R_LINEAR_____148_CM 8 0. 31.99902344 FORMAT "%7.4" /end AXIS_PTS
/begin AXIS_PTS ldp_n_iga_ref_temp "" 0x43758 N_32 _REC_AXS_20_u1 8160. _CNV_A_R_LINEAR_____5_CM 8 0. 8160. FORMAT "%4.0" /end AXIS_PTS
/begin AXIS_PTS ldp_maf_iga_ref_temp "" 0x4348c MAF _REC_AXS_20_u1 1389. _CNV_A_R_LINEAR_____18_CM 6 0. 1389. FORMAT "%4.0" /end AXIS_PTS
/begin AXIS_PTS ldp_tia__iga_ref_temp_fac "" 0x439c9 TIA _REC_AXS_20_u1 190.5 _CNV_A_R_LINEAR_____0_CM 6 -48. 142.5 FORMAT "%5.1" /end AXIS_PTS
/begin AXIS_PTS ldp_n__iga_ref_vvt "" 0x436f9 N_32 _REC_AXS_20_u1 8160. _CNV_A_R_LINEAR_____5_CM 16 0. 8160. FORMAT "%4.0" /end AXIS_PTS
/begin AXIS_PTS ldp_tco__iga_ref_temp_fac "" 0x43872 TCO _REC_AXS_20_u1 190.5 _CNV_A_R_LINEAR_____0_CM 6 -48. 142.5 FORMAT "%5.1" /end AXIS_PTS
/begin AXIS_PTS ldp_maf__iga_ref_vvt "" 0x43450 MAF _REC_AXS_20_u1 1389. _CNV_A_R_LINEAR_____18_CM 12 0. 1389. FORMAT "%4.0" /end AXIS_PTS
/begin AXIS_PTS ldp_egr_ratio_cor__iga_ref_egr "" 0x44302 EGR_RATIO_COR _REC_AXS_20_u2 99.99847412 _CNV_A_R_LINEAR_____94_CM 6 0. 99.99847412 /end AXIS_PTS
/begin AXIS_PTS ldp_maf__iga_ref_port "" 0x444a2 MAF _REC_AXS_20_u2 1389. _CNV_A_R_LINEAR_____95_CM 8 0. 1389. FORMAT "%7.2" /end AXIS_PTS
/begin AXIS_PTS ldp_n_32__iga_bas_port "" 0x43508 N_32 _REC_AXS_20_u1 8160. _CNV_A_R_LINEAR_____5_CM 8 0. 8160. FORMAT "%4.0" /end AXIS_PTS
/begin AXIS_PTS ldp_port_av__fac_iga_bas_port "" 0x449a6 PORT_AV _REC_AXS_20_u2 99.99847412 _CNV_A_R_LINEAR_____207_CM 8 0. 99.99847412 /end AXIS_PTS
/begin AXIS_PTS ldp_mff_sp__iga_bas_s "" 0x4471a MFF_SP _REC_AXS_20_u2 1389. _CNV_A_R_LINEAR_____95_CM 12 0. 1389. FORMAT "%7.2" /end AXIS_PTS
/begin AXIS_PTS ldp_n_32__iga_bas_s "" 0x43511 N_32 _REC_AXS_20_u1 816. _CNV_A_R_LINEAR_____5_CM 16 0. 8160. FORMAT "%4.0" /end AXIS_PTS
/begin AXIS_PTS ldp_eff_iga_sp_iga_dif_sp "" 0x44294 EFF_IGA_SP _REC_AXS_20_u2 1.99996948 _CNV_A_R_LINEAR_____45_CM 16 0. 1.99996948 FORMAT "%7.5" /end AXIS_PTS
/begin AXIS_PTS ldp_cyc_st_ip_iga_st_cyc_st_cor "" 0x43391 CYC_ST _REC_AXS_20_u1 255. _CNV_A_R_LINEAR_____10_CM 6 0. 255. FORMAT "%3.0" /end AXIS_PTS
/begin AXIS_PTS ldp_n_ip_iga_st_bas "" 0x448be N _REC_AXS_20_u2 8160. _CNV_A_R_LINEAR_____17_CM 6 0. 8160. FORMAT "%4.0" /end AXIS_PTS
/begin AXIS_PTS ldp_amp_ip_iga_st_amp_cor "" 0x44130 AMP _REC_AXS_20_u2 5434. _CNV_A_R_LINEAR_____43_CM 6 0. 5434. FORMAT "%7.2" /end AXIS_PTS
/begin AXIS_PTS ldp_teg_dyn_hys "" 0x44ac4 TEG_DYN_HYS _REC_AXS_20_u2 2047. _CNV_A_R_LINEAR_____211_CM 16 0. 2047. FORMAT "%7.2" /end AXIS_PTS
/begin AXIS_PTS ldp_n__v_dur_igc_min "" 0x4371e N_32 _REC_AXS_20_u1 816. _CNV_A_R_LINEAR_____5_CM 6 0. 8160. FORMAT "%4.0" /end AXIS_PTS
/begin AXIS_PTS ldp_maf__v_dur_igc_min "" 0x4346e MAF _REC_AXS_20_u1 138.9 _CNV_A_R_LINEAR_____18_CM 4 0. 1389. FORMAT "%4.0" /end AXIS_PTS
/begin AXIS_PTS ldp_n_dif_cor__tq_i_dt_is "" 0x44832 N_DIF_COR _REC_AXS_20_u2 65535. _CNV_A_R_LINEAR_____213_CM 12 -32768. 32767. FORMAT "%6.0" /end AXIS_PTS
/begin AXIS_PTS ldp_n_dif_cor_p_d_dt_is "" 0x4484c N_DIF_COR _REC_AXS_20_u2 65535. _CNV_A_R_LINEAR_____213_CM 12 -32768. 32767. FORMAT "%6.0" /end AXIS_PTS
/begin AXIS_PTS ldp_n_dif_cor_p_d_is "" 0x44866 N_DIF_COR _REC_AXS_20_u2 65535. _CNV_A_R_LINEAR_____213_CM 12 -32768. 32767. FORMAT "%6.0" /end AXIS_PTS
/begin AXIS_PTS ldp_n_dif_cor_tq_i_is "" 0x44880 N_DIF_COR _REC_AXS_20_u2 65535. _CNV_A_R_LINEAR_____213_CM 12 -32768. 32767. FORMAT "%6.0" /end AXIS_PTS
/begin AXIS_PTS ldp_n_grd_p_d_dt_is "" 0x4373d N_GRD _REC_AXS_20_u1 8160. _CNV_A_R_LINEAR_____219_CM 8 -4096. 4064. FORMAT "%5.0" /end AXIS_PTS
/begin AXIS_PTS ldp_n_grd_p_d_is "" 0x43746 N_GRD _REC_AXS_20_u1 8160. _CNV_A_R_LINEAR_____219_CM 8 -4096. 4064. FORMAT "%5.0" /end AXIS_PTS
/begin AXIS_PTS ldp_n_grd_tq_i_is "" 0x4374f N_GRD _REC_AXS_20_u1 8160. _CNV_A_R_LINEAR_____219_CM 8 -4096. 4064. FORMAT "%5.0" /end AXIS_PTS
/begin AXIS_PTS ldp_t_ast__fac_n_grd_is "" 0x44a40 T_AST _REC_AXS_20_u2 6553.5 _CNV_A_R_LINEAR_____14_CM 8 0. 6553.5 FORMAT "%5.1" /end AXIS_PTS
/begin AXIS_PTS ldp_tco__fac_n_grd_is "" 0x4384d TCO _REC_AXS_20_u1 190.5 _CNV_A_R_LINEAR_____0_CM 8 -48. 142.5 FORMAT "%6.2" /end AXIS_PTS
/begin AXIS_PTS ldpm_tco_is_1 "" 0x43fe7 TCO _REC_AXS_20_u1 190.5 _CNV_A_R_LINEAR_____0_CM 8 -48. 142.5 FORMAT "%5.1" /end AXIS_PTS
/begin AXIS_PTS ldpm_gr_mt_2 "" 0x43c0e GR_MT _REC_AXS_20_u1 255. _CNV_A_R_LINEAR_____10_CM 8 0. 255. FORMAT "%3.0" /end AXIS_PTS
/begin AXIS_PTS ldp_n_t_n_dif_ofs_pred "" 0x44952 N _REC_AXS_20_u2 8160. _CNV_A_R_LINEAR_____17_CM 8 0. 8160. FORMAT "%4.0" /end AXIS_PTS
/begin AXIS_PTS ldp_n_dif_pred_tq_add_is_bol "" 0x448ac N_DIF_PREF _REC_AXS_20_u2 65535. _CNV_A_R_LINEAR_____213_CM 8 -32768. 32767. FORMAT "%6.0" /end AXIS_PTS
/begin AXIS_PTS ldp_nr_pat__pat_ind "" 0x43793 NUMMER_DES_ABSCHALTPATTERNS _REC_AXS_20_u1 255. _CNV_A_R_LINEAR_____10_CM 7 0. 255. FORMAT "%3.0" /end AXIS_PTS
/begin AXIS_PTS ldpm_tco_st_4 "" 0x44024 TCO_ST _REC_AXS_20_u1 190.5 _CNV_A_R_LINEAR_____0_CM 8 -48. 142.5 FORMAT "%5.1" /end AXIS_PTS
/begin AXIS_PTS ldpm_n_11 "ldpm 6 points N for IGA" 0x451d2 N _REC_AXS_20_u2 8160. _CNV_A_R_LINEAR_____17_CM 16 0. 8160. FORMAT "%4.0" /end AXIS_PTS
/begin AXIS_PTS ldpm_maf_ivvt_1 "" 0x45104 MAF_IVVT _REC_AXS_20_u2 1389. _CNV_A_R_LINEAR_____95_CM 6 0. 1389. FORMAT "%7.2" /end AXIS_PTS
/begin AXIS_PTS ldpm_tco_17 "" 0x43f3e TCO _REC_AXS_20_u1 190.5 _CNV_A_R_LINEAR_____0_CM 8 -48. 142.5 FORMAT "%5.1" /end AXIS_PTS
/begin AXIS_PTS ldpm_tco_st_1_ivvt "" 0x4400b TCO_ST _REC_AXS_20_u1 190.5 _CNV_A_R_LINEAR_____0_CM 8 -48. 142.5 FORMAT "%5.1" /end AXIS_PTS
/begin AXIS_PTS ldpm_t_ast_1_ivvt "" 0x45428 T_AST _REC_AXS_20_u2 6553.5 _CNV_A_R_LINEAR_____14_CM 8 0. 6553.5 FORMAT "%6.1" /end AXIS_PTS
/begin AXIS_PTS ldp_n_32__fac_cam_sp_ch_opp "" 0x447ac N_32 _REC_AXS_20_u2 8160. _CNV_A_R_LINEAR_____17_CM 4 0. 8160. FORMAT "%4.0" /end AXIS_PTS
/begin AXIS_PTS ldp_dip__fac_cam_sp_ch_opp "" 0x4428a DIP _REC_AXS_20_u2 5434. _CNV_A_R_LINEAR_____43_CM 4 0. 5434. FORMAT "%7.2" /end AXIS_PTS
/begin AXIS_PTS ldp_state_cmb_ctl_id_cmb_ivvt "" 0x437ea STATE_CMB_CTL _REC_AXS_20_u1 8. _CNV_A_R_LINEAR_____10_CM 9 0. 8. FORMAT "%2.0" /end AXIS_PTS
/begin AXIS_PTS ldpm_cam_mdl_dif_ivvt "" 0x43b6f CAM_MDL_DIF_IVVT _REC_AXS_20_u1 60. _CNV_A_R_LINEAR_____75_CM 8 0. 60. /end AXIS_PTS
/begin AXIS_PTS ldpm_dly_ivvt_1_ivvt "" 0x43b97 DLY_IVVT_IN _REC_AXS_20_u1 2550. _CNV_A_R_LINEAR_____23_CM 6 0. 2550. FORMAT "%4.0" /end AXIS_PTS
/begin AXIS_PTS ldpm_n_32_4_ivvt "" 0x43d5f N_32 _REC_AXS_20_u1 8160. _CNV_A_R_LINEAR_____5_CM 4 0. 8160. FORMAT "%4.0" /end AXIS_PTS
/begin MEASUREMENT T_ADD_MIN_IVVT_ADH_IN_1 "Offset on energization time due to adhesion detection - inlet" UBYTE _CNV_A_R_LINEAR_____239_CM 1 100. 0. 159.375 ECU_ADDRESS 0x3fc79e FORMAT "%6.1" /end MEASUREMENT
/begin MEASUREMENT LV_ADH_CDN_IVVT_IN_1 "Logical variable: adhesion detection conditions inlet cam i fullfilled (=1) / not fullfilled (=0)" UBYTE _CNV_S_2_RANGE______28_CM 1 100. 0. 1. ECU_ADDRESS 0x3fc7a1 /end MEASUREMENT
/begin MEASUREMENT T_SUM_ADH_IVVT_IN_1 "Energization time integral inlet cam i" UBYTE _CNV_A_R_LINEAR_____239_CM 1 100. 0. 159.375 ECU_ADDRESS 0x3fc7a0 FORMAT "%6.1" /end MEASUREMENT
/begin MEASUREMENT T_DLY_ADH_IVVT_IN_1 "Reaction time before adhesion detection inlet cam" UWORD _CNV_A_R_LINEAR_____239_CM 1 100. 0. 40959.375 ECU_ADDRESS 0x3fc798 FORMAT "%7.1" /end MEASUREMENT
/begin MEASUREMENT CAM_ADH_OLD_IN_1 "Inlet cam position at start of reaction time" UBYTE _CNV_A_R_LINEAR_____234_CM 1 100. 60. 155.625 ECU_ADDRESS 0x3fc79a FORMAT "%8.3" /end MEASUREMENT
/begin MEASUREMENT CAM_ADH_ACT_IN_1 "Inlet cam position closest to cam set point during reaction time" UBYTE _CNV_A_R_LINEAR_____234_CM 1 100. 60. 155.625 ECU_ADDRESS 0x3fc79b FORMAT "%8.3" /end MEASUREMENT
/begin MEASUREMENT CAM_ADJ_DIF_ADH_IVVT_IN_1 "De-jittered movement  of inlet cam in target direction during reaction delay time" SWORD _CNV_A_R_LINEAR_____75_CM 1 100. -60. 60. ECU_ADDRESS 0x3fc79c FORMAT "%7.3" /end MEASUREMENT
/begin MEASUREMENT LV_ERR_IVVT_MEC_ASS_IN_1 "Logivcal variable for mechanical error assumed on inlet cam i" UBYTE _CNV_S_2_RANGE______28_CM 1 100. 0. 1. ECU_ADDRESS 0x3fc7a2 /end MEASUREMENT
/begin MEASUREMENT T_DRIFT_IVVTHPWM_IN_1 "Time period for calculation of drift speed inlet cam" ULONG _CNV_A_R_LINEAR_____248_CM 1 100. 0. 17179869180. ECU_ADDRESS 0x3fc7c0 FORMAT "%11.0" /end MEASUREMENT
/begin MEASUREMENT LV_IVVTPWM_EXT_ADJ_IN_1 "activation bit for external adjustment inlet CAM" UBYTE _CNV_S_2_RANGE______28_CM 1 100. 0. 1. ECU_ADDRESS 0x3fc7de /end MEASUREMENT
/begin MEASUREMENT IVVTPWM_EXT_ADJ_IN_1 "Pulse width modulated signal for external adjustment of inlet CAM" UBYTE _CNV_A_R_LINEAR_____4_CM 1 100. 0. 99.609375 ECU_ADDRESS 0x3fc7dd FORMAT "%4.1" /end MEASUREMENT
/begin MEASUREMENT T_DRIFT_IVVTHPWM_IN_2 "Time period for calculation of drift speed inlet cam" ULONG _CNV_A_R_LINEAR_____248_CM 1 100. 0. 17179869180. ECU_ADDRESS 0x3fc8b8 FORMAT "%11.0" /end MEASUREMENT
/begin MEASUREMENT T_ADD_MIN_IVVT_ADH_IN_2 "Offset on energization time due to adhesion detection - inlet" UBYTE _CNV_A_R_LINEAR_____239_CM 1 100. 0. 159.375 ECU_ADDRESS 0x3fc896 FORMAT "%6.1" /end MEASUREMENT
/begin MEASUREMENT LV_ADH_CDN_IVVT_IN_2 "Logical variable: adhesion detection conditions inlet cam i fullfilled (=1) / not fullfilled (=0)" UBYTE _CNV_S_2_RANGE______28_CM 1 100. 0. 1. ECU_ADDRESS 0x3fc899 /end MEASUREMENT
/begin MEASUREMENT T_SUM_ADH_IVVT_IN_2 "Energization time integral inlet cam i" UBYTE _CNV_A_R_LINEAR_____239_CM 1 100. 0. 159.375 ECU_ADDRESS 0x3fc898 FORMAT "%6.1" /end MEASUREMENT
/begin MEASUREMENT T_DLY_ADH_IVVT_IN_2 "Reaction time before adhesion detection inlet cam" UWORD _CNV_A_R_LINEAR_____239_CM 1 100. 0. 40959.375 ECU_ADDRESS 0x3fc890 FORMAT "%7.1" /end MEASUREMENT
/begin MEASUREMENT CAM_ADH_OLD_IN_2 "Inlet cam position at start of reaction time" UBYTE _CNV_A_R_LINEAR_____234_CM 1 100. 60. 155.625 ECU_ADDRESS 0x3fc892 FORMAT "%8.3" /end MEASUREMENT
/begin MEASUREMENT CAM_ADH_ACT_IN_2 "Inlet cam position closest to cam set point during reaction time" UBYTE _CNV_A_R_LINEAR_____234_CM 1 100. 60. 155.625 ECU_ADDRESS 0x3fc893 FORMAT "%8.3" /end MEASUREMENT
/begin MEASUREMENT CAM_ADJ_DIF_ADH_IVVT_IN_2 "De-jittered movement  of inlet cam in target direction during reaction delay time" SWORD _CNV_A_R_LINEAR_____75_CM 1 100. -60. 60. ECU_ADDRESS 0x3fc894 FORMAT "%7.3" /end MEASUREMENT
/begin MEASUREMENT LV_ERR_IVVT_MEC_ASS_IN_2 "Logivcal variable for mechanical error assumed on inlet cam i" UBYTE _CNV_S_2_RANGE______28_CM 1 100. 0. 1. ECU_ADDRESS 0x3fc89a /end MEASUREMENT
/begin MEASUREMENT LV_IVVTPWM_EXT_ADJ_IN_2 "activation bit for external adjustment inlet CAM" UBYTE _CNV_S_2_RANGE______28_CM 1 100. 0. 1. ECU_ADDRESS 0x3fc8d6 /end MEASUREMENT
/begin MEASUREMENT IVVTPWM_EXT_ADJ_IN_2 "Pulse width modulated signal for external adjustment of inlet CAM" UBYTE _CNV_A_R_LINEAR_____4_CM 1 100. 0. 99.609375 ECU_ADDRESS 0x3fc8d5 FORMAT "%4.1" /end MEASUREMENT
/begin MEASUREMENT T_ADD_MIN_IVVT_ADH_EX_1 "Offset on energization time due to adhesion detection - exhaust" UBYTE _CNV_A_R_LINEAR_____239_CM 1 100. 0. 159.375 ECU_ADDRESS 0x3fc9ae FORMAT "%6.1" /end MEASUREMENT
/begin MEASUREMENT LV_ADH_CDN_IVVT_EX_1 "Logical variable: adhesion detection conditions exhaust cam i fullfilled (=1) / not fullfilled (=0)" UBYTE _CNV_S_2_RANGE______28_CM 1 100. 0. 1. ECU_ADDRESS 0x3fc9b1 /end MEASUREMENT
/begin MEASUREMENT T_SUM_ADH_IVVT_EX_1 "Energization time integral exhaust cam i" UBYTE _CNV_A_R_LINEAR_____239_CM 1 100. 0. 159.375 ECU_ADDRESS 0x3fc9b0 FORMAT "%6.1" /end MEASUREMENT
/begin MEASUREMENT T_DLY_ADH_IVVT_EX_1 "Reaction time before adhesion detection exhaust cam" UWORD _CNV_A_R_LINEAR_____239_CM 1 100. 0. 40959.375 ECU_ADDRESS 0x3fc9a8 FORMAT "%7.1" /end MEASUREMENT
/begin MEASUREMENT CAM_ADH_OLD_EX_1 "Exhaust cam position at start of reaction time" UBYTE _CNV_A_R_LINEAR_____231_CM 1 100. -40. -135.625 ECU_ADDRESS 0x3fc9aa FORMAT "%8.3" /end MEASUREMENT
/begin MEASUREMENT CAM_ADH_ACT_EX_1 "Exhaust cam position closest to cam set point during reaction time" UBYTE _CNV_A_R_LINEAR_____231_CM 1 100. -40. -135.625 ECU_ADDRESS 0x3fc9ab FORMAT "%8.3" /end MEASUREMENT
/begin MEASUREMENT CAM_ADJ_DIF_ADH_IVVT_EX_1 "De-jittered movement  of exhaust cam in target direction during reaction delay time" SWORD _CNV_A_R_LINEAR_____75_CM 1 100. -60. 60. ECU_ADDRESS 0x3fc9ac FORMAT "%7.3" /end MEASUREMENT
/begin MEASUREMENT LV_ERR_IVVT_MEC_ASS_EX_1 "Logivcal variable for mechanical error assumed on exhaust cam i" UBYTE _CNV_S_2_RANGE______28_CM 1 100. 0. 1. ECU_ADDRESS 0x3fc9b2 /end MEASUREMENT
/begin MEASUREMENT T_DRIFT_IVVTHPWM_EX_1 "Time period for calculation of drift speed exhaust cam" ULONG _CNV_A_R_LINEAR_____248_CM 1 100. 0. 17179869180. ECU_ADDRESS 0x3fc9d0 FORMAT "%11.0" /end MEASUREMENT
/begin MEASUREMENT LV_IVVTPWM_EXT_ADJ_EX_1 "activation bit for external adjustment exhaust CAM" UBYTE _CNV_S_2_RANGE______28_CM 1 100. 0. 1. ECU_ADDRESS 0x3fc9ee /end MEASUREMENT
/begin MEASUREMENT IVVTPWM_EXT_ADJ_EX_1 "Pulse width modulated signal for external adjustment of exhaust CAM" UBYTE _CNV_A_R_LINEAR_____4_CM 1 100. 0. 99.609375 ECU_ADDRESS 0x3fc9ed FORMAT "%4.1" /end MEASUREMENT
/begin MEASUREMENT T_DRIFT_IVVTHPWM_EX_2 "Time period for calculation of drift speed exhaust cam" ULONG _CNV_A_R_LINEAR_____248_CM 1 100. 0. 17179869180. ECU_ADDRESS 0x3fcac8 FORMAT "%11.0" /end MEASUREMENT
/begin MEASUREMENT T_ADD_MIN_IVVT_ADH_EX_2 "Offset on energization time due to adhesion detection - exhaust" UBYTE _CNV_A_R_LINEAR_____239_CM 1 100. 0. 159.375 ECU_ADDRESS 0x3fcaa6 FORMAT "%6.1" /end MEASUREMENT
/begin MEASUREMENT T_SUM_ADH_IVVT_EX_2 "Energization time integral exhaust cam i" UBYTE _CNV_A_R_LINEAR_____239_CM 1 100. 0. 159.375 ECU_ADDRESS 0x3fcaa8 FORMAT "%6.1" /end MEASUREMENT
/begin MEASUREMENT T_DLY_ADH_IVVT_EX_2 "Reaction time before adhesion detection exhaust cam" UWORD _CNV_A_R_LINEAR_____239_CM 1 100. 0. 40959.375 ECU_ADDRESS 0x3fcaa0 FORMAT "%7.1" /end MEASUREMENT
/begin MEASUREMENT CAM_ADH_OLD_EX_2 "Exhaust cam position at start of reaction time" UBYTE _CNV_A_R_LINEAR_____231_CM 1 100. -40. -135.625 ECU_ADDRESS 0x3fcaa2 FORMAT "%8.3" /end MEASUREMENT
/begin MEASUREMENT CAM_ADH_ACT_EX_2 "Exhaust cam position closest to cam set point during reaction time" UBYTE _CNV_A_R_LINEAR_____231_CM 1 100. -40. -135.625 ECU_ADDRESS 0x3fcaa3 FORMAT "%8.3" /end MEASUREMENT
/begin MEASUREMENT CAM_ADJ_DIF_ADH_IVVT_EX_2 "De-jittered movement  of exhaust cam in target direction during reaction delay time" SWORD _CNV_A_R_LINEAR_____75_CM 1 100. -60. 60. ECU_ADDRESS 0x3fcaa4 FORMAT "%7.3" /end MEASUREMENT
/begin MEASUREMENT LV_ERR_IVVT_MEC_ASS_EX_2 "Logivcal variable for mechanical error assumed on exhaust cam i" UBYTE _CNV_S_2_RANGE______28_CM 1 100. 0. 1. ECU_ADDRESS 0x3fcaaa /end MEASUREMENT
/begin MEASUREMENT LV_ADH_CDN_IVVT_EX_2 "Logical variable: adhesion detection conditions exhaust cam i fullfilled (=1) / not fullfilled (=0)" UBYTE _CNV_S_2_RANGE______28_CM 1 100. 0. 1. ECU_ADDRESS 0x3fcaa9 /end MEASUREMENT
/begin MEASUREMENT LV_IVVTPWM_EXT_ADJ_EX_2 "activation bit for external adjustment exhaust CAM" UBYTE _CNV_S_2_RANGE______28_CM 1 100. 0. 1. ECU_ADDRESS 0x3fcae6 /end MEASUREMENT
/begin MEASUREMENT IVVTPWM_EXT_ADJ_EX_2 "Pulse width modulated signal for external adjustment of exhaust CAM" UBYTE _CNV_A_R_LINEAR_____4_CM 1 100. 0. 99.609375 ECU_ADDRESS 0x3fcae5 FORMAT "%4.1" /end MEASUREMENT
/begin AXIS_PTS ldpm_cam_edge_nr "" 0x43b60 CAM_EDGE_NR _REC_AXS_20_u1 3. _CNV_A_R_LINEAR_____10_CM 4 0. 3. FORMAT "%2.0" /end AXIS_PTS
/begin AXIS_PTS ldp_vb__ivvtpwm "" 0x43abd VB _REC_AXS_20_u1 25.8984 _CNV_A_R_LINEAR_____26_CM 4 0. 25.8984 FORMAT "%3.1" /end AXIS_PTS
/begin AXIS_PTS ldp_vb__fac_ivvtpwm "" 0x43ab0 VB _REC_AXS_20_u1 26. _CNV_A_R_LINEAR_____53_CM 3 0. 26. FORMAT "%4.1" /end AXIS_PTS
/begin AXIS_PTS ldp_vb_ip_ivvthpwm "" 0x43aef VB _REC_AXS_20_u1 26. _CNV_A_R_LINEAR_____53_CM 4 0. 26. FORMAT "%4.1" /end AXIS_PTS
/begin AXIS_PTS ldpm_cam_dif_ivvt "" 0x44e9c CAM_DIF_IVVT _REC_AXS_20_u2 120. _CNV_A_R_LINEAR_____251_CM 5 -60. 60. FORMAT "%7.3" /end AXIS_PTS
/begin AXIS_PTS ldp_vel_drift_ip_ivvthpwm_cor "" 0x43afd VEL_DRIFT _REC_AXS_20_u1 95.625 _CNV_A_R_LINEAR_____247_CM 6 0. 95.625 FORMAT "%5.2" /end AXIS_PTS
/begin AXIS_PTS ldp_t_drift_ivvthpwm "" 0x44a88 T_DRIFT _REC_AXS_20_u2 65535. _CNV_A_R_LINEAR_____252_CM 6 0. 65535. FORMAT "%5.0" /end AXIS_PTS
/begin AXIS_PTS ldpm_mff_mmv "" 0x45176 MFF_MMV _REC_AXS_20_u2 1389. _CNV_A_R_LINEAR_____95_CM 6 0. 1389. FORMAT "%7.2" /end AXIS_PTS
/begin AXIS_PTS ldp_vo_fac_ivvt "" 0x43b1b VO _REC_AXS_20_u1 95.625 _CNV_A_R_LINEAR_____75_CM 8 0. 95.625 FORMAT "%5.2" /end AXIS_PTS
/begin AXIS_PTS ldpm_n_4_9 "" 0x43eb2 N_KNK _REC_AXS_20_u1 8160. _CNV_A_R_LINEAR_____5_CM 3 0. 8160. FORMAT "%4.0" /end AXIS_PTS
/begin AXIS_PTS ldpm_n_6_4 "" 0x43eb6 N_KNK _REC_AXS_20_u1 8160. _CNV_A_R_LINEAR_____5_CM 4 0. 8160. FORMAT "%4.0" /end AXIS_PTS
/begin AXIS_PTS ldpm_n_iga_max_knk "" 0x43ed0 N_32 _REC_AXS_20_u1 8160. _CNV_A_R_LINEAR_____5_CM 8 0. 8160. FORMAT "%4.0" /end AXIS_PTS
/begin AXIS_PTS ldpm_maf_iga_max_knk "" 0x43c83 MAF _REC_AXS_20_u1 1389. _CNV_A_R_LINEAR_____18_CM 8 0. 1389. FORMAT "%4.0" /end AXIS_PTS
/begin AXIS_PTS ldp_tco__fac_iga_max_knk "" 0x43848 TCO _REC_AXS_20_u1 190.5 _CNV_A_R_LINEAR_____0_CM 4 -48. 142.5 FORMAT "%5.1" /end AXIS_PTS
/begin AXIS_PTS ldp_tia__fac_iga_max_knk "" 0x439b8 TIA _REC_AXS_20_u1 190.5 _CNV_A_R_LINEAR_____0_CM 4 -48. 142.5 FORMAT "%5.1" /end AXIS_PTS
/begin AXIS_PTS ldp_n_32__maf_min_knk_ad_2 "" 0x4358c N_32 _REC_AXS_20_u1 8160. _CNV_A_R_LINEAR_____5_CM 16 0. 8160. FORMAT "%4.0" /end AXIS_PTS
/begin AXIS_PTS ldp_tia__ip_fac_ron_ad_max "" 0x439d0 TIA _REC_AXS_20_u1 190.5 _CNV_A_R_LINEAR_____0_CM 4 -48. 142.5 FORMAT "%5.1" /end AXIS_PTS
/begin AXIS_PTS ldp_tco__ip_fac_ron_ad_max "" 0x43879 TCO _REC_AXS_20_u1 190.5 _CNV_A_R_LINEAR_____0_CM 4 -48. 142.5 FORMAT "%5.1" /end AXIS_PTS
/begin AXIS_PTS ldpm_n_32_3_iga "" 0x43d53 N_32 _REC_AXS_20_u1 8160. _CNV_A_R_LINEAR_____5_CM 4 0. 8160. FORMAT "%4.0" /end AXIS_PTS
/begin AXIS_PTS ldp_maf_iga__iga_tra_knk "" 0x43487 MAF _REC_AXS_20_u1 1389. _CNV_A_R_LINEAR_____18_CM 4 0. 1389. FORMAT "%4.0" /end AXIS_PTS
/begin AXIS_PTS ldpm_n_32_7 "" 0x43d75 N_32 _REC_AXS_20_u1 8160. _CNV_A_R_LINEAR_____5_CM 4 0. 8160. FORMAT "%4.0" /end AXIS_PTS
/begin AXIS_PTS ldp_fac_ron_ad_fac_iga_tra "" 0x433a8 FAC_RON_AD _REC_AXS_20_u1 0.99610001 _CNV_A_R_LINEAR_____20_CM 3 0. 0.99610001 FORMAT "%5.3" /end AXIS_PTS
/begin AXIS_PTS ldp_tia_fac_iga_tra "" 0x439d5 TIA _REC_AXS_20_u1 190.5 _CNV_A_R_LINEAR_____0_CM 4 -48. 142.5 FORMAT "%5.1" /end AXIS_PTS
/begin AXIS_PTS ldpm_gear_1 "" 0x43bb4 GEAR _REC_AXS_20_u1 7. _CNV_A_R_LINEAR_____10_CM 6 0. 7. FORMAT "%2.0" /end AXIS_PTS
/begin AXIS_PTS ldp_vs_fac_iga_tra_gear_mt "" 0x43b48 VS _REC_AXS_20_u1 255. _CNV_A_R_LINEAR_____13_CM 6 0. 255. FORMAT "%3.0" /end AXIS_PTS
/begin AXIS_PTS ldp_vs_fac_iga_tra_gear_at "" 0x43b41 VS _REC_AXS_20_u1 255. _CNV_A_R_LINEAR_____13_CM 6 0. 255. FORMAT "%3.0" /end AXIS_PTS
/begin AXIS_PTS ldpm_n_32_1_lamb_ctl "" 0x43cf9 N_32 _REC_AXS_20_u1 8160. _CNV_A_R_LINEAR_____5_CM 8 0. 8160. FORMAT "%4.0" /end AXIS_PTS
/begin AXIS_PTS ldpm_maf_1_lamb_ctl "" 0x45006 MAF _REC_AXS_20_u2 1389. _CNV_A_R_LINEAR_____95_CM 8 0. 1389. FORMAT "%7.2" /end AXIS_PTS
/begin AXIS_PTS ldpm_maf_2_lamb_ctl "" 0x4504c MAF _REC_AXS_20_u2 1389. _CNV_A_R_LINEAR_____95_CM 8 0. 1389. FORMAT "%7.2" /end AXIS_PTS
/begin AXIS_PTS ldpm_tco_1_lam "" 0x43f57 TCO _REC_AXS_20_u1 190.5 _CNV_A_R_LINEAR_____0_CM 6 -48. 142.5 FORMAT "%5.1" /end AXIS_PTS
/begin AXIS_PTS ldpm_n_32_2_lamb_ctl "" 0x43d41 N_32 _REC_AXS_20_u1 8160. _CNV_A_R_LINEAR_____5_CM 8 0. 8160. FORMAT "%4.0" /end AXIS_PTS
/begin AXIS_PTS ldp_maf_cyl_ip_crlc_lam_mv_lpf "" 0x4453c MAF_CYL _REC_AXS_20_u2 2047.96875 _CNV_A_R_LINEAR_____101_CM 6 0. 2047.96875 FORMAT "%7.2" /end AXIS_PTS
/begin AXIS_PTS ldpm_teg_cat_up_mdl_1_lam "" 0x4549a TEG_CAT_UP_MDL _REC_AXS_20_u2 1507.3 _CNV_A_R_LINEAR_____269_CM 6 -48. 1459.3 FORMAT "%7.2" /end AXIS_PTS
/begin AXIS_PTS ldp_mff_ad_add_mmv_delta_add "" 0x446ea MFF_AD_FAC_MMV_DELTA_ADD _REC_AXS_20_u2 1389.97 _CNV_A_R_LINEAR_____270_CM 8 -695. 694.97 FORMAT "%7.2" /end AXIS_PTS
/begin AXIS_PTS ldpm_tco_1_mff_ad "" 0x43f5e TCO _REC_AXS_20_u1 190.5 _CNV_A_R_LINEAR_____0_CM 5 -48. 142.5 FORMAT "%5.1" /end AXIS_PTS
/begin AXIS_PTS ldp_mff_ad_add_mmv_2_mff_add "" 0x446de MFF_AD_ADD_MMV _REC_AXS_20_u2 1389.97 _CNV_A_R_LINEAR_____270_CM 5 -695. 694.97 FORMAT "%7.2" /end AXIS_PTS
/begin AXIS_PTS ldp_mff_ad_fac_mmv_2_mff_fac "" 0x446fc MFF_AD_FAC_MMV _REC_AXS_20_u2 99.99847412 _CNV_A_R_LINEAR_____143_CM 5 -50. 49.99847412 FORMAT "%7.3" /end AXIS_PTS
/begin AXIS_PTS ldpm_n_32_1_mff_ad "" 0x43d0b N_32 _REC_AXS_20_u1 8160. _CNV_A_R_LINEAR_____5_CM 6 0. 8160. FORMAT "%4.0" /end AXIS_PTS
/begin AXIS_PTS ldpm_n_32_maf_mff_ad_max "" 0x43e71 N_32 _REC_AXS_20_u1 816. _CNV_A_R_LINEAR_____5_CM 6 0. 8160. FORMAT "%4.0" /end AXIS_PTS
/begin AXIS_PTS ldpm_n_32_maf_mff_ad_min "" 0x43e78 N_32 _REC_AXS_20_u1 816. _CNV_A_R_LINEAR_____5_CM 6 0. 8160. FORMAT "%4.0" /end AXIS_PTS
/begin AXIS_PTS ldp_mff_ad_fac_mmv_delta "" 0x44708 MFF_AD_FAC_MMV_DELTA _REC_AXS_20_u2 99.99847412 _CNV_A_R_LINEAR_____143_CM 8 -50. 49.99847412 FORMAT "%7.3" /end AXIS_PTS
/begin AXIS_PTS ldpm_maf_1_lasp "" 0x45018 MAF _REC_AXS_20_u2 1389. _CNV_A_R_LINEAR_____95_CM 8 0. 1389. FORMAT "%7.2" /end AXIS_PTS
/begin AXIS_PTS ldpm_n_32_1_lasp "" 0x43d02 N_32 _REC_AXS_20_u1 8160. _CNV_A_R_LINEAR_____5_CM 8 0. 8160. FORMAT "%4.0" /end AXIS_PTS
/begin AXIS_PTS ldp_n_32_ip_lamb_afl_1 "" 0x43692 N_32 _REC_AXS_20_u1 8160. _CNV_A_R_LINEAR_____5_CM 8 0. 8160. FORMAT "%4.0" /end AXIS_PTS
/begin AXIS_PTS ldp_tqi_req_slow_ip_lamb_afl_1 "" 0x44cc4 TQI_REQ_SLOW _REC_AXS_20_u2 2047.96875 _CNV_A_R_LINEAR_____218_CM 8 -1024. 1023.96875 FORMAT "%6.2" /end AXIS_PTS
/begin AXIS_PTS ldp_tco_st_ip_lamb_bas_wup_cor "" 0x43972 TCO_ST _REC_AXS_20_u1 190.5 _CNV_A_R_LINEAR_____0_CM 8 -48. 142.5 FORMAT "%5.1" /end AXIS_PTS
/begin AXIS_PTS ldp_n_32_ip_lamb_hom_afl "" 0x4369b N_32 _REC_AXS_20_u1 8160. _CNV_A_R_LINEAR_____5_CM 8 0. 8160. FORMAT "%4.0" /end AXIS_PTS
/begin AXIS_PTS ldp_tqi_req_slow_ip_lamb_hom_afl "" 0x44cd6 TQI_REQ_SLOW _REC_AXS_20_u2 2047.96875 _CNV_A_R_LINEAR_____218_CM 8 -1024. 1023.96875 FORMAT "%6.2" /end AXIS_PTS
/begin AXIS_PTS ldp_tco_ip_lamb_bas_wup_cor "" 0x4390f TCO _REC_AXS_20_u1 190.5 _CNV_A_R_LINEAR_____0_CM 8 -48. 142.5 FORMAT "%5.1" /end AXIS_PTS
/begin AXIS_PTS ldp_n_32_ip_fac_lamb_wup "" 0x43675 N_32 _REC_AXS_20_u1 8160. _CNV_A_R_LINEAR_____5_CM 6 0. 8160. FORMAT "%4.0" /end AXIS_PTS
/begin AXIS_PTS ldp_n_32_ip_fac_lamb_wup_is "" 0x4367c N_32 _REC_AXS_20_u1 8160. _CNV_A_R_LINEAR_____5_CM 3 0. 8160. FORMAT "%4.0" /end AXIS_PTS
/begin AXIS_PTS ldp_maf_ip_fac_lamb_wup "" 0x445ae MAF _REC_AXS_20_u2 1389. _CNV_A_R_LINEAR_____95_CM 6 0. 1389. FORMAT "%7.2" /end AXIS_PTS
/begin AXIS_PTS ldp_maf_ip_fac_lamb_wup_is "" 0x445bc MAF _REC_AXS_20_u2 1389. _CNV_A_R_LINEAR_____95_CM 4 0. 1389. FORMAT "%7.2" /end AXIS_PTS
/begin AXIS_PTS ldp_tco__lamb_add_afl_ch "" 0x4387e TCO _REC_AXS_20_u1 190.5 _CNV_A_R_LINEAR_____0_CM 8 -48. 142.5 FORMAT "%5.1" /end AXIS_PTS
/begin AXIS_PTS ldp_t_ast__lamb_add_afl_ch "" 0x44a52 T_AST _REC_AXS_20_u2 983.025 _CNV_A_R_LINEAR_____14_CM 8 0. 6553.5 FORMAT "%5.1" /end AXIS_PTS
/begin AXIS_PTS ldp_tqi_req_slow__lamb_ch_rgl "" 0x44c8e TQI_REQ_SLOW _REC_AXS_20_u2 2047.96875 _CNV_A_R_LINEAR_____218_CM 8 -1024. 1023.96875 FORMAT "%6.2" /end AXIS_PTS
/begin AXIS_PTS ldp_n_32__lamb_ch_rgl "" 0x43557 N_32 _REC_AXS_20_u1 8160. _CNV_A_R_LINEAR_____5_CM 8 0. 8160. FORMAT "%4.0" /end AXIS_PTS
/begin AXIS_PTS ldp_tqi_req_slow__lamb_ch_is "" 0x44c7c TQI_REQ_SLOW _REC_AXS_20_u2 2047.96875 _CNV_A_R_LINEAR_____218_CM 8 -1024. 1023.96875 FORMAT "%6.2" /end AXIS_PTS
/begin AXIS_PTS ldp_n_32__lamb_ch_is "" 0x4354e N_32 _REC_AXS_20_u1 8160. _CNV_A_R_LINEAR_____5_CM 8 0. 8160. FORMAT "%4.0" /end AXIS_PTS
/begin AXIS_PTS ldp_t_cop_i__teg_cop "" 0x4381c T_COP _REC_AXS_20_u1 127.5 _CNV_A_R_LINEAR_____275_CM 6 0. 127.5 FORMAT "%5.1" /end AXIS_PTS
/begin AXIS_PTS ldp_fac_cop_i__teg_cop "" 0x44344 FAC_COP _REC_AXS_20_u2 1.99996948 _CNV_A_R_LINEAR_____45_CM 16 0. 1.99996948 FORMAT "%7.5" /end AXIS_PTS
/begin AXIS_PTS ldpm_eff_iga_av_teg_i__teg_cop "" 0x44f10 EFF_IGA_AV_TEG _REC_AXS_20_u2 1.99996948 _CNV_A_R_LINEAR_____45_CM 4 0. 1.99996948 FORMAT "%7.5" /end AXIS_PTS
/begin MEASUREMENT LV_INH_DIAG_CHK_LS_DOWN_1 "Inhibit sensor signal plausibility active test" UBYTE _CNV_S_2_RANGE______28_CM 1 100. 0. 1. ECU_ADDRESS 0x3fa924 /end MEASUREMENT
/begin MEASUREMENT VLS_DOWN_1 "" UWORD _CNV_A_R_LINEAR_____33_CM 1 100. 0. 4.99511719 ECU_ADDRESS 0x3fa8b4 FORMAT "%5.3" /end MEASUREMENT
/begin MEASUREMENT VLS_DOWN_BOL_1 "Variable switching threshold for calculation of VLS_DOWN_MMV_MIN_1" UWORD _CNV_A_R_LINEAR_____33_CM 1 100. 0. 4.99511719 ECU_ADDRESS 0x3fa8b6 FORMAT "%5.3" /end MEASUREMENT
/begin MEASUREMENT VLS_DOWN_TOL_1 "Variable switching threshold for calculation of VLS_DOWN_MMV_MAX_1" UWORD _CNV_A_R_LINEAR_____33_CM 1 100. 0. 4.99511719 ECU_ADDRESS 0x3fa8b8 FORMAT "%5.3" /end MEASUREMENT
/begin MEASUREMENT VLS_DOWN_MMV_MAX_1 "Mean oxygen sensor rich voltage" UWORD _CNV_A_R_LINEAR_____256_CM 1 100. 0. 4.99992371 ECU_ADDRESS 0x3fa8ba FORMAT "%7.5" /end MEASUREMENT
/begin MEASUREMENT VLS_DOWN_MMV_MIN_1 "Mean oxygen sensor lean voltage" UWORD _CNV_A_R_LINEAR_____256_CM 1 100. 0. 4.99992371 ECU_ADDRESS 0x3fa8bc FORMAT "%7.5" /end MEASUREMENT
/begin MEASUREMENT VLS_DOWN_MMV_HYS_1 "Variable hysteresis used to determine switching thresholds" UWORD _CNV_A_R_LINEAR_____281_CM 1 100. 0. 1. ECU_ADDRESS 0x3fa8be FORMAT "%7.5" /end MEASUREMENT
/begin MEASUREMENT DRV1_VLS_DOWN_MMV_1 "Mean of buffer containing 1st derivative of VLS_DOWN_1 signal" SWORD _CNV_A_R_LINEAR_____282_CM 1 100. -2.5 2.4999 ECU_ADDRESS 0x3fa8c2 FORMAT "%7.4" /end MEASUREMENT
/begin MEASUREMENT DRV1_VLS_DOWN_ABS_MAX_1 "Absolute maximum value within buffer containing 1st derivative of VLS_DOWN_1 signal" UWORD _CNV_A_R_LINEAR_____283_CM 1 100. 0. 4.9999237 ECU_ADDRESS 0x3fa8c0 FORMAT "%6.4" /end MEASUREMENT
/begin MEASUREMENT LV_END_DIAG_WIN_FSD_1 "End diagnosis cycle for similar conditions window" ULONG _CNV_S_2_RANGE______28_CM 1 100. 0. 1. ECU_ADDRESS 0x3fa740 BIT_MASK 0x80000000 /end MEASUREMENT
/begin MEASUREMENT LV_LAM_MV_LDC_1 "" UBYTE _CNV_S_2_RANGE______28_CM 1 100. 0. 1. ECU_ADDRESS 0x3fa708 /end MEASUREMENT
/begin MEASUREMENT LV_INH_DIAG_CHK_LS_DOWN_2 "Inhibit sensor signal plausibility active test" UBYTE _CNV_S_2_RANGE______28_CM 1 100. 0. 1. ECU_ADDRESS 0x3fac3c /end MEASUREMENT
/begin MEASUREMENT VLS_DOWN_2 "" UWORD _CNV_A_R_LINEAR_____33_CM 1 100. 0. 4.99511719 ECU_ADDRESS 0x3fabcc FORMAT "%5.3" /end MEASUREMENT
/begin MEASUREMENT VLS_DOWN_BOL_2 "Variable switching threshold for calculation of VLS_DOWN_MMV_MIN_1" UWORD _CNV_A_R_LINEAR_____33_CM 1 100. 0. 4.99511719 ECU_ADDRESS 0x3fabce FORMAT "%5.3" /end MEASUREMENT
/begin MEASUREMENT VLS_DOWN_TOL_2 "Variable switching threshold for calculation of VLS_DOWN_MMV_MAX_1" UWORD _CNV_A_R_LINEAR_____33_CM 1 100. 0. 4.99511719 ECU_ADDRESS 0x3fabd0 FORMAT "%5.3" /end MEASUREMENT
/begin MEASUREMENT VLS_DOWN_MMV_MAX_2 "Mean oxygen sensor rich voltage" UWORD _CNV_A_R_LINEAR_____256_CM 1 100. 0. 4.99992371 ECU_ADDRESS 0x3fabd2 FORMAT "%7.5" /end MEASUREMENT
/begin MEASUREMENT VLS_DOWN_MMV_MIN_2 "Mean oxygen sensor lean voltage" UWORD _CNV_A_R_LINEAR_____256_CM 1 100. 0. 4.99992371 ECU_ADDRESS 0x3fabd4 FORMAT "%7.5" /end MEASUREMENT
/begin MEASUREMENT VLS_DOWN_MMV_HYS_2 "Variable hysteresis used to determine switching thresholds" UWORD _CNV_A_R_LINEAR_____281_CM 1 100. 0. 1. ECU_ADDRESS 0x3fabd6 FORMAT "%7.5" /end MEASUREMENT
/begin MEASUREMENT DRV1_VLS_DOWN_MMV_2 "Mean of buffer containing 1st derivative of VLS_DOWN_1 signal" SWORD _CNV_A_R_LINEAR_____282_CM 1 100. -2.5 2.4999 ECU_ADDRESS 0x3fabda FORMAT "%7.4" /end MEASUREMENT
/begin MEASUREMENT DRV1_VLS_DOWN_ABS_MAX_2 "Absolute maximum value within buffer containing 1st derivative of VLS_DOWN_1 signal" UWORD _CNV_A_R_LINEAR_____283_CM 1 100. 0. 4.9999237 ECU_ADDRESS 0x3fabd8 FORMAT "%6.4" /end MEASUREMENT
/begin MEASUREMENT LV_END_DIAG_WIN_FSD_2 "End diagnosis cycle for similar conditions window" ULONG _CNV_S_2_RANGE______28_CM 1 100. 0. 1. ECU_ADDRESS 0x3faa58 BIT_MASK 0x80000000 /end MEASUREMENT
/begin MEASUREMENT LV_LAM_MV_LDC_2 "" UBYTE _CNV_S_2_RANGE______28_CM 1 100. 0. 1. ECU_ADDRESS 0x3faa20 /end MEASUREMENT
/begin AXIS_PTS ldp_n__lamb_fl "" 0x4370a N_32 _REC_AXS_20_u1 8160. _CNV_A_R_LINEAR_____5_CM 12 0. 8160. FORMAT "%4.0" /end AXIS_PTS
/begin AXIS_PTS ldp_tco__lamb_ref_add "" 0x43890 TCO _REC_AXS_20_u1 190.5 _CNV_A_R_LINEAR_____0_CM 6 -48. 142.5 FORMAT "%5.1" /end AXIS_PTS
/begin AXIS_PTS ldp_n__lamb_ref "" 0x43717 N_32 _REC_AXS_20_u1 816. _CNV_A_R_LINEAR_____5_CM 6 0. 8160. FORMAT "%4.0" /end AXIS_PTS
/begin AXIS_PTS ldp_maf__lamb_ref "" 0x4345d MAF _REC_AXS_20_u1 1389. _CNV_A_R_LINEAR_____18_CM 6 0. 1389. FORMAT "%4.0" /end AXIS_PTS
/begin AXIS_PTS ldp_ntl_ip_lamb_rgn_fac_mdl "" 0x4497a NTL _REC_AXS_20_u2 10485.6 _CNV_A_R_LINEAR_____309_CM 8 0. 10485.6 FORMAT "%7.1" /end AXIS_PTS
/begin AXIS_PTS ldp_vls_down_ip_lamb_rgn "" 0x44e00 VLS_DOWN _REC_AXS_20_u2 4.99511719 _CNV_A_R_LINEAR_____33_CM 8 0. 4.99511719 FORMAT "%5.3" /end AXIS_PTS
/begin AXIS_PTS ldp_n_32_ip_lamb_rgn_afr "" 0x436a4 N_32 _REC_AXS_20_u1 8160. _CNV_A_R_LINEAR_____5_CM 8 0. 8160. FORMAT "%4.0" /end AXIS_PTS
/begin AXIS_PTS ldp_maf_ip_lamb_rgn_afr "" 0x4349c MAF _REC_AXS_20_u1 1389. _CNV_A_R_LINEAR_____18_CM 8 0. 1389. FORMAT "%4.0" /end AXIS_PTS
/begin AXIS_PTS ldp_tqi_req_slow__lamb_sawup "" 0x44ca0 TQI_REQ_SLOW _REC_AXS_20_u2 2047.96875 _CNV_A_R_LINEAR_____218_CM 8 -1024. 1023.96875 FORMAT "%6.2" /end AXIS_PTS
/begin AXIS_PTS ldp_tqi_req_slow__lamb_sawup_is "" 0x44cb2 TQI_REQ_SLOW _REC_AXS_20_u2 2047.96875 _CNV_A_R_LINEAR_____218_CM 8 -1024. 1023.96875 FORMAT "%6.2" /end AXIS_PTS
/begin AXIS_PTS ldp_n_32__lamb_sawup "" 0x43571 N_32 _REC_AXS_20_u1 8160. _CNV_A_R_LINEAR_____5_CM 8 0. 8160. FORMAT "%4.0" /end AXIS_PTS
/begin AXIS_PTS ldp_n_32__lamb_sawup_is "" 0x4357a N_32 _REC_AXS_20_u1 8160. _CNV_A_R_LINEAR_____5_CM 8 0. 8160. FORMAT "%4.0" /end AXIS_PTS
/begin AXIS_PTS ldp_t_ast__lamb_add_sawup "" 0x44a64 T_AST _REC_AXS_20_u2 6553.5 _CNV_A_R_LINEAR_____14_CM 8 0. 6553.5 FORMAT "%6.1" /end AXIS_PTS
/begin AXIS_PTS ldp_tco__lamb_add_sawup "" 0x43887 TCO _REC_AXS_20_u1 190.5 _CNV_A_R_LINEAR_____0_CM 8 -48. 142.5 FORMAT "%5.1" /end AXIS_PTS
/begin AXIS_PTS ldp_eff_lamb_sp__lamb_dif_sp "" 0x442b6 EFF_LAMB_SP _REC_AXS_20_u2 0.199996948 _CNV_A_R_LINEAR_____45_CM 16 0. 1.99996948 FORMAT "%7.5" /end AXIS_PTS
/begin AXIS_PTS ldp_n_32__lamb_iga_afl "" 0x43560 N_32 _REC_AXS_20_u1 8160. _CNV_A_R_LINEAR_____5_CM 16 0. 8160. FORMAT "%4.0" /end AXIS_PTS
/begin AXIS_PTS ldp_maf_hb__lamb_iga_afl "" 0x4347a MAF_HB _REC_AXS_20_u1 1389. _CNV_A_R_LINEAR_____18_CM 12 0. 1389. FORMAT "%4.0" /end AXIS_PTS
/begin AXIS_PTS ldp_tco_ip_lamb_scc "" 0x43918 TCO _REC_AXS_20_u1 190.5 _CNV_A_R_LINEAR_____0_CM 8 -48. 142.5 FORMAT "%5.1" /end AXIS_PTS
/begin AXIS_PTS ldpm_n_32 "" 0x43ccc N_32 _REC_AXS_20_u1 8160. _CNV_A_R_LINEAR_____5_CM 6 0. 8160. FORMAT "%4.0" /end AXIS_PTS
/begin AXIS_PTS ldp_n_ip_vls_sp_dly "" 0x4376a N_32 _REC_AXS_20_u1 8160. _CNV_A_R_LINEAR_____5_CM 8 0. 8160. FORMAT "%4.0" /end AXIS_PTS
/begin AXIS_PTS ldp_maf_ip_vls_sp_dly "" 0x434a5 MAF _REC_AXS_20_u1 1389. _CNV_A_R_LINEAR_____18_CM 8 0. 1389. FORMAT "%4.0" /end AXIS_PTS
/begin AXIS_PTS ldp_n_ip_fac_lam_dly "" 0x43761 N_32 _REC_AXS_20_u1 8160. _CNV_A_R_LINEAR_____5_CM 8 0. 8160. FORMAT "%4.0" /end AXIS_PTS
/begin AXIS_PTS ldp_maf_ip_fac_lam_dly "" 0x43493 MAF _REC_AXS_20_u1 1389. _CNV_A_R_LINEAR_____18_CM 8 0. 1389. FORMAT "%4.0" /end AXIS_PTS
/begin AXIS_PTS ldp_maf_kgh_ip_fac_dly_p "" 0x4463e MAF_KGH _REC_AXS_20_u2 2047.96875 _CNV_A_R_LINEAR_____101_CM 6 0. 2047.96875 FORMAT "%6.2" /end AXIS_PTS
/begin AXIS_PTS ldpm_vls_dif_dly "" 0x45632 VLS_DIF_DLY _REC_AXS_20_u2 9.99034 _CNV_A_R_LINEAR_____313_CM 12 -4.99517 4.99517 FORMAT "%5.3" /end AXIS_PTS
/begin AXIS_PTS ldpm_cat_ip_fac_cat_dly "" 0x43b7f CAT_DIAG_1 _REC_AXS_20_u1 1.9968 _CNV_A_R_LINEAR_____314_CM 6 0. 1.9968 FORMAT "%4.2" /end AXIS_PTS
/begin AXIS_PTS ldp_maf_kgh_ip_crlc_dly_i "" 0x44630 MAF_KGH _REC_AXS_20_u2 2047.96875 _CNV_A_R_LINEAR_____101_CM 6 0. 2047.96875 FORMAT "%6.2" /end AXIS_PTS
/begin AXIS_PTS ldp_maf_int_puc "" 0x4457e MAF_INT_PUC _REC_AXS_20_u2 1820.398 _CNV_A_R_LINEAR_____277_CM 6 0. 1820.398 FORMAT "%7.2" /end AXIS_PTS
/begin AXIS_PTS ldp_temp_main_cat "" 0x44b06 TEMP_MAIN_CAT _REC_AXS_20_u2 1023.984375 _CNV_A_R_LINEAR_____305_CM 6 -33. 990.984375 FORMAT "%6.2" /end AXIS_PTS
/begin AXIS_PTS ldp_maf_cyl "" 0x44504 MAF_CYL _REC_AXS_20_u2 2047.96875 _CNV_A_R_LINEAR_____101_CM 6 0. 2047.96875 FORMAT "%7.2" /end AXIS_PTS
/begin AXIS_PTS ldp_quo_maf_int_purge "" 0x437e1 QUO_MAF_INT_PURGE _REC_AXS_20_u1 0.9960940000000002 _CNV_A_R_LINEAR_____44_CM 8 0. 0.996094 FORMAT "%5.3" /end AXIS_PTS
/begin AXIS_PTS ldpm_cat_diag "" 0x43b78 CAT_DIAG _REC_AXS_20_u1 1.984375 _CNV_A_R_LINEAR_____141_CM 6 0. 1.984375 FORMAT "%4.2" /end AXIS_PTS
/begin AXIS_PTS ldp_temp_pcat "" 0x44b14 TEMP_PCAT _REC_AXS_20_u2 1023.984375 _CNV_A_R_LINEAR_____305_CM 6 -33. 990.984375 FORMAT "%6.2" /end AXIS_PTS
/begin AXIS_PTS ldp_r_down_ls_ip_ttip_ls_down "" 0x44a04 R_DOWN_LS _REC_AXS_20_u2 65535. _CNV_A_R_LINEAR_____285_CM 8 0. 65535. FORMAT "%5.0" /end AXIS_PTS
/begin AXIS_PTS ldp_r_up_ls_ip_ttip_ls_up "" 0x44a16 R_UP_LS _REC_AXS_20_u2 65535. _CNV_A_R_LINEAR_____285_CM 8 0. 65535. FORMAT "%5.0" /end AXIS_PTS
/begin AXIS_PTS ldpm_temp_ls_ini_1_egcp "" 0x45550 TEMP_LS_INI _REC_AXS_20_u2 4095.938 _CNV_A_R_LINEAR_____326_CM 6 -2048. 2047.938 FORMAT "%8.2" /end AXIS_PTS
/begin AXIS_PTS ldp_vs_fac_v_efc_teg "" 0x43b4f VS _REC_AXS_20_u1 255. _CNV_A_R_LINEAR_____13_CM 6 0. 255. FORMAT "%3.0" /end AXIS_PTS
/begin AXIS_PTS ldpm_teg_cat_down_mdl_1_egcp "" 0x4547e TEG_CAT_DOWN_MDL _REC_AXS_20_u2 2047. _CNV_A_R_LINEAR_____211_CM 6 0. 2047. FORMAT "%7.2" /end AXIS_PTS
/begin AXIS_PTS ldpm_temp_ls_down_ini_1_egcp "" 0x45542 TEMP_LS_INI _REC_AXS_20_u2 4095.938 _CNV_A_R_LINEAR_____326_CM 6 -2048. 2047.938 FORMAT "%8.2" /end AXIS_PTS
/begin AXIS_PTS ldp_n_32_ip_v_efc_lsh_down_ctl "" 0x436cb N_32 _REC_AXS_20_u1 8160. _CNV_A_R_LINEAR_____5_CM 6 0. 8160. FORMAT "%4.0" /end AXIS_PTS
/begin AXIS_PTS ldp_vs_ip_fac_v_efc_down_teg "" 0x43b56 VS _REC_AXS_20_u1 255. _CNV_A_R_LINEAR_____13_CM 6 0. 255. FORMAT "%3.0" /end AXIS_PTS
/begin AXIS_PTS ldpm_tco_st_1_laco "" 0x44014 TCO_ST _REC_AXS_20_u1 190.5 _CNV_A_R_LINEAR_____0_CM 6 -48. 142.5 FORMAT "%5.1" /end AXIS_PTS
/begin AXIS_PTS ldp_tco_st_t_dly_ls_ready "" 0x4397b TCO_ST _REC_AXS_20_u1 190.5 _CNV_A_R_LINEAR_____0_CM 8 -48. 142.5 FORMAT "%5.1" /end AXIS_PTS
/begin AXIS_PTS ldpm_n_32__ti_lam "" 0x43de8 N_32 _REC_AXS_20_u1 8160. _CNV_A_R_LINEAR_____5_CM 8 0. 8160. FORMAT "%4.0" /end AXIS_PTS
/begin AXIS_PTS ldpm_maf__ti_lam "" 0x45098 MAF _REC_AXS_20_u2 1389. _CNV_A_R_LINEAR_____95_CM 8 0. 1389. FORMAT "%7.2" /end AXIS_PTS
/begin AXIS_PTS ldp_id_maf_tab_1 "" 0x433e9 INDEX_1 _REC_AXS_20_u1 255. _CNV_A_R_LINEAR_____10_CM 16 0. 255. FORMAT "%3.0" /end AXIS_PTS
/begin AXIS_PTS ldp_id_maf_tab_2 "" 0x433fa INDEX_2 _REC_AXS_20_u1 255. _CNV_A_R_LINEAR_____10_CM 16 0. 255. FORMAT "%3.0" /end AXIS_PTS
/begin AXIS_PTS ldpm_tia_maf_mdl_con_1 "" 0x44052 TIA _REC_AXS_20_u1 190.5 _CNV_A_R_LINEAR_____0_CM 8 -48. 142.5 FORMAT "%5.1" /end AXIS_PTS
/begin AXIS_PTS ldp_teg_egr_maf_egr_con_1 "" 0x44ae6 TEG_EGR _REC_AXS_20_u2 2047. _CNV_A_R_LINEAR_____211_CM 8 0. 2047. FORMAT "%7.2" /end AXIS_PTS
/begin AXIS_PTS ldpm_n_32_ar_red "" 0x43e27 N_32 _REC_AXS_20_u1 816. _CNV_A_R_LINEAR_____5_CM 6 0. 8160. FORMAT "%4.0" /end AXIS_PTS
/begin AXIS_PTS ldpm_pq_estim_maf_isa_fac_ofs "" 0x453b2 PQ_ESTIM _REC_AXS_20_u2 0.99998474 _CNV_A_R_LINEAR_____31_CM 16 0. 0.99998474 FORMAT "%7.5" /end AXIS_PTS
/begin AXIS_PTS ldpm_ar_red_isa_bas_maf_isa_fac "" 0x44e74 AR_RED_ISA_BAS _REC_AXS_20_u2 58.592855 _CNV_A_R_LINEAR_____171_CM 6 0. 58.592855 FORMAT "%7.4" /end AXIS_PTS
/begin AXIS_PTS ldpm_maf_mes__vol_im "" 0x45144 MAF_MES _REC_AXS_20_u2 1389. _CNV_A_R_LINEAR_____95_CM 6 0. 1389. FORMAT "%7.2" /end AXIS_PTS
/begin AXIS_PTS ldpm_n_32__vol_im "" 0x43e17 N_32 _REC_AXS_20_u1 8160. _CNV_A_R_LINEAR_____5_CM 8 0. 8160. FORMAT "%4.0" /end AXIS_PTS
/begin AXIS_PTS ldpm_n_32__vol_im_is "" 0x43e20 N_32 _REC_AXS_20_u1 8160. _CNV_A_R_LINEAR_____5_CM 6 0. 8160. FORMAT "%4.0" /end AXIS_PTS
/begin AXIS_PTS ldp_n__pq_sp_puls "" 0x4480c N _REC_AXS_20_u2 816. _CNV_A_R_LINEAR_____17_CM 6 0. 8160. FORMAT "%4.0" /end AXIS_PTS
/begin AXIS_PTS ldpm_pq_ar_red "" 0x45386 PQ _REC_AXS_20_u2 0.99998474 _CNV_A_R_LINEAR_____31_CM 4 0. 0.99998474 FORMAT "%7.5" /end AXIS_PTS
/begin AXIS_PTS ldpm_maf_kgh_t_1_hfm "" 0x4513a MAF_KGH _REC_AXS_20_u2 204.796875 _CNV_A_R_LINEAR_____101_CM 4 0. 2047.96875 FORMAT "%7.2" /end AXIS_PTS
/begin AXIS_PTS ldpm_n_ar_red "" 0x43ebb N_32 _REC_AXS_20_u1 8160. _CNV_A_R_LINEAR_____5_CM 6 0. 8160. FORMAT "%4.0" /end AXIS_PTS
/begin AXIS_PTS ldpm_pq__fac_ar_red_cor "" 0x45374 PQ _REC_AXS_20_u2 0.99998474 _CNV_A_R_LINEAR_____31_CM 8 0. 0.99998474 FORMAT "%7.5" /end AXIS_PTS
/begin AXIS_PTS ldp_t_seg_t_1_ratio_crlc_hfm "" 0x44aa8 T_SEG_T_1_RATIO _REC_AXS_20_u2 7.99987793 _CNV_A_R_LINEAR_____348_CM 6 0. 7.99987793 FORMAT "%6.4" /end AXIS_PTS
/begin AXIS_PTS ldp_ar_red_ad_add_dif "" 0x4418c AR_RED_AD_ADD_DIF _REC_AXS_20_u2 58.592855 _CNV_A_R_LINEAR_____171_CM 4 0. 58.592855 FORMAT "%7.4" /end AXIS_PTS
/begin AXIS_PTS ldp_n_32_ar_red_egr "" 0x43656 N_32 _REC_AXS_20_u1 816. _CNV_A_R_LINEAR_____5_CM 6 0. 8160. FORMAT "%4.0" /end AXIS_PTS
/begin AXIS_PTS ldp_stk_av_egr_ar_red_egr "" 0x437f4 STK_AV_EGR _REC_AXS_20_u1 99.609375 _CNV_A_R_LINEAR_____4_CM 8 0. 99.609375 FORMAT "%5.2" /end AXIS_PTS
/begin AXIS_PTS ldpm_maf_cyl_ex "" 0x450aa MAF_CYL _REC_AXS_20_u2 2047.96875 _CNV_A_R_LINEAR_____101_CM 8 0. 2047.96875 FORMAT "%6.2" /end AXIS_PTS
/begin AXIS_PTS ldp_n_32__ip_t_vim_eff_vol "" 0x43546 N_32 _REC_AXS_20_u1 8160. _CNV_A_R_LINEAR_____5_CM 2 0. 8160. FORMAT "%4.0" /end AXIS_PTS
/begin AXIS_PTS ldp_maf_cyl_amp_dec "" 0x44532 MAF_CYL _REC_AXS_20_u2 2047.96875 _CNV_A_R_LINEAR_____101_CM 4 0. 2047.96875 FORMAT "%6.2" /end AXIS_PTS
/begin AXIS_PTS ldpm_fac_port_deac__eff_vol "" 0x44f56 FAC_PORT_DEAC _REC_AXS_20_u2 0.99998474 _CNV_A_R_LINEAR_____31_CM 8 0. 0.99998474 FORMAT "%7.5" /end AXIS_PTS
/begin AXIS_PTS ldpm_exc_av_rel__eff_vol "" 0x44f36 EXV_AV_REL _REC_AXS_20_u2 99.99847412 _CNV_A_R_LINEAR_____94_CM 8 0. 99.99847412 /end AXIS_PTS
/begin AXIS_PTS ldp_maf_kgh_mes_bas "" 0x44668 MAF_KGH_MES_BAS _REC_AXS_20_u2 2047.96875 _CNV_A_R_LINEAR_____101_CM 16 0. 2047.96875 FORMAT "%7.2" /end AXIS_PTS
/begin AXIS_PTS ldpm_vo__eff_vol "" 0x440b7 VO _REC_AXS_20_u1 95.625 _CNV_A_R_LINEAR_____75_CM 12 0. 95.625 FORMAT "%5.2" /end AXIS_PTS
/begin AXIS_PTS ldp_n_32_ip_crlc_eff_vol_temp "" 0x4365d N_32 _REC_AXS_20_u1 8160. _CNV_A_R_LINEAR_____5_CM 6 0. 8160. FORMAT "%4.0" /end AXIS_PTS
/begin AXIS_PTS ldpm_amp__eff_vol_amp "" 0x44e66 AMP _REC_AXS_20_u2 5434. _CNV_A_R_LINEAR_____43_CM 6 0. 5434. FORMAT "%7.2" /end AXIS_PTS
/begin AXIS_PTS ldpm_n_32__eff_vol_cor "" 0x43d80 N_32 _REC_AXS_20_u1 8160. _CNV_A_R_LINEAR_____5_CM 8 0. 8160. FORMAT "%4.0" /end AXIS_PTS
/begin AXIS_PTS ldpm_maf__eff_vol_cor "" 0x4506c MAF _REC_AXS_20_u2 1389. _CNV_A_R_LINEAR_____95_CM 8 0. 1389. FORMAT "%7.2" /end AXIS_PTS
/begin AXIS_PTS ldpm_n__eff_vol "" 0x452a2 N _REC_AXS_20_u2 8160. _CNV_A_R_LINEAR_____17_CM 18 0. 8160. FORMAT "%4.0" /end AXIS_PTS
/begin AXIS_PTS ldpm_vim_av__eff_vol "" 0x45620 VIM_AV _REC_AXS_20_u2 199.9969 _CNV_A_R_LINEAR_____352_CM 8 0. 199.9969 FORMAT "%7.3" /end AXIS_PTS
/begin AXIS_PTS ldpm_cam_av_mv_in__eff_vol "" 0x44e82 CAM_AV_MV_IN _REC_AXS_20_u2 1535.9765625 _CNV_A_R_LINEAR_____350_CM 12 -768. 767.9765625 FORMAT "%7.2" /end AXIS_PTS
/begin AXIS_PTS ldp_n_32__pq_egr_sp "" 0x435f1 N_32 _REC_AXS_20_u1 816. _CNV_A_R_LINEAR_____5_CM 8 0. 8160. FORMAT "%4.0" /end AXIS_PTS
/begin AXIS_PTS ldp_n_32__fac_maf_max_s "" 0x434e3 N_32 _REC_AXS_20_u1 816. _CNV_A_R_LINEAR_____5_CM 8 0. 8160. FORMAT "%4.0" /end AXIS_PTS
/begin AXIS_PTS ldp_mff_sp_s__fac_maf_max_s "" 0x44776 MFF_SP_S _REC_AXS_20_u2 1389. _CNV_A_R_LINEAR_____95_CM 6 0. 1389. FORMAT "%7.2" /end AXIS_PTS
/begin AXIS_PTS ldp_maf_dif_s__eff_maf_s "" 0x4455c MAF_DIF_S _REC_AXS_20_u2 1389. _CNV_A_R_LINEAR_____354_CM 16 -694.5 694.5 FORMAT "%7.2" /end AXIS_PTS
/begin AXIS_PTS ldp_mff_sp_s__pq_egr_sp "" 0x44784 MFF_SP_S _REC_AXS_20_u2 1389. _CNV_A_R_LINEAR_____95_CM 6 0. 1389. FORMAT "%7.2" /end AXIS_PTS
/begin AXIS_PTS ldp_maf_turb_ratio__maf_sp_isa "" 0x434b7 MAF_TURBO_RATIO_MAX _REC_AXS_20_u1 3.984375 _CNV_A_R_LINEAR_____195_CM 8 0. 3.984375 FORMAT "%4.2" /end AXIS_PTS
/begin AXIS_PTS ldp_n_32__crlc_maf_diag "" 0x434ce N_32 _REC_AXS_20_u1 8160. _CNV_A_R_LINEAR_____5_CM 4 0. 8160. FORMAT "%4.0" /end AXIS_PTS
/begin AXIS_PTS ldpm_pq_turb_sys "" 0x43ef3 PQ_TURB_SYS _REC_AXS_20_u1 0.99610001 _CNV_A_R_LINEAR_____20_CM 6 0. 0.99610001 FORMAT "%5.3" /end AXIS_PTS
/begin AXIS_PTS ldp_isapwm_isa__fac_pq_isa "" 0x44418 ISAPWM_ISA _REC_AXS_20_u2 99.99847412 _CNV_A_R_LINEAR_____94_CM 4 0. 99.99847412 /end AXIS_PTS
/begin AXIS_PTS ldp_n_32_mon__maf_sub_mon "" 0x402ef N_32_MON _REC_AXS_20_u1 8160. _CNV_A_R_LINEAR_____5_CM 8 0. 8160. FORMAT "%4.0" /end AXIS_PTS
/begin AXIS_PTS ldp_pq_turb_sys_mon__fac_pq_isa "" 0x4032b PQ_TURB_SYS_MON _REC_AXS_20_u1 0.9960940000000002 _CNV_A_R_LINEAR_____253_CM 6 0. 0.996094 FORMAT "%5.3" /end AXIS_PTS
/begin AXIS_PTS ldp_tps_av_mon__fac_tps_isa_mon "" 0x40367 TPS_AV_MON _REC_AXS_20_u1 11.95 _CNV_A_R_LINEAR_____357_CM 6 0. 119.5 FORMAT "%5.1" /end AXIS_PTS
/begin AXIS_PTS ldp_tps_av_mon__maf_sub_mon "" 0x4036e TPS_AV_MON _REC_AXS_20_u1 11.95 _CNV_A_R_LINEAR_____357_CM 8 0. 119.5 FORMAT "%5.1" /end AXIS_PTS
/begin AXIS_PTS ldp_isapwm_isa__fac_pq_isa_mon "" 0x402b0 ISAPWM_ISA _REC_AXS_20_u2 14.999771118 _CNV_A_R_LINEAR_____94_CM 4 0. 99.99847412 /end AXIS_PTS
/begin AXIS_PTS ldp_amp__fac_maf_sub_cor_mon "" 0x402a2 AMP _REC_AXS_20_u2 5434. _CNV_A_R_LINEAR_____43_CM 6 0. 5434. FORMAT "%7.2" /end AXIS_PTS
/begin AXIS_PTS ldp_n_32_mon__pq_mon "" 0x402f8 N_32_MON _REC_AXS_20_u1 816. _CNV_A_R_LINEAR_____5_CM 8 0. 8160. FORMAT "%4.0" /end AXIS_PTS
/begin AXIS_PTS ldp_tps_sum_av_mon__pq_mon "" 0x40377 TPS_SUM_AV_MON _REC_AXS_20_u1 119.5 _CNV_A_R_LINEAR_____357_CM 8 0. 119.5 FORMAT "%5.1" /end AXIS_PTS
/begin AXIS_PTS ldp_tia__fac_maf_sub_cor_mon "Correction factor for MAF_SUB_COR_MON calculation" 0x40360 TIA _REC_AXS_20_u1 190.5 _CNV_A_R_LINEAR_____0_CM 6 -48. 142.5 FORMAT "%5.1" /end AXIS_PTS
/begin AXIS_PTS ldp_v_map_map_mes_bas "" 0x44d26 V_MAP _REC_AXS_20_u2 4.5 _CNV_A_R_LINEAR_____358_CM 2 0. 5. FORMAT "%5.3" /end AXIS_PTS
/begin AXIS_PTS ldp_maf__mff_cor_1 "" 0x444b4 MAF _REC_AXS_20_u2 138.9 _CNV_A_R_LINEAR_____95_CM 12 0. 1389. FORMAT "%7.2" /end AXIS_PTS
/begin AXIS_PTS ldp_maf__mff_cor_2 "" 0x444ce MAF _REC_AXS_20_u2 138.9 _CNV_A_R_LINEAR_____95_CM 12 0. 1389. FORMAT "%7.2" /end AXIS_PTS
/begin AXIS_PTS ldp_n__mff_cor_1 "" 0x447c8 N _REC_AXS_20_u2 816. _CNV_A_R_LINEAR_____17_CM 16 0. 8160. FORMAT "%4.0" /end AXIS_PTS
/begin AXIS_PTS ldp_n__mff_cor_2 "" 0x447ea N _REC_AXS_20_u2 816. _CNV_A_R_LINEAR_____17_CM 16 0. 8160. FORMAT "%4.0" /end AXIS_PTS
/begin AXIS_PTS ldpm_tqi_sp_mff_s "" 0x455da TQI_SP_MFF _REC_AXS_20_u2 1023.96875 _CNV_A_R_LINEAR_____48_CM 12 0. 1023.96875 FORMAT "%7.2" /end AXIS_PTS
/begin AXIS_PTS ldp_tps_dif__mtcpwm_p "" 0x44b80 TPS_DIF _REC_AXS_20_u2 239. _CNV_A_R_LINEAR_____361_CM 8 -119.5 119.5 FORMAT "%8.3" /end AXIS_PTS
/begin AXIS_PTS ldp_tps_dif__mtcpwm_i "" 0x44b6e TPS_DIF _REC_AXS_20_u2 239. _CNV_A_R_LINEAR_____361_CM 8 -119.5 119.5 FORMAT "%8.3" /end AXIS_PTS
/begin AXIS_PTS ldp_tps_av_lih_dif_mtcpwm_i "" 0x44b5c TPS_AV_LIH_DIF _REC_AXS_20_u2 239. _CNV_A_R_LINEAR_____361_CM 8 -119.5 119.5 FORMAT "%8.3" /end AXIS_PTS
/begin AXIS_PTS ldp_tps_dif_grd__mtcpwm_d "" 0x44b92 TPS_DIF_GRD _REC_AXS_20_u2 239. _CNV_A_R_LINEAR_____361_CM 8 -119.5 119.5 FORMAT "%8.3" /end AXIS_PTS
/begin AXIS_PTS ldp_tps_sp_lih_dif__mtcpwm_add "" 0x44be0 TPS_SP_LIH_DIF _REC_AXS_20_u2 239. _CNV_A_R_LINEAR_____361_CM 8 -119.5 119.5 FORMAT "%8.3" /end AXIS_PTS
/begin AXIS_PTS ldp_vb__mtcpwm_vb_fac "" 0x43ac2 VB _REC_AXS_20_u1 25.8984 _CNV_A_R_LINEAR_____26_CM 8 0. 25.8984 FORMAT "%3.1" /end AXIS_PTS
/begin MEASUREMENT SEG_NR "" UBYTE _CNV_A_R_LINEAR_____10_CM 1 100. 0. 255. ECU_ADDRESS 0x3fcc26 FORMAT "%3.0" /end MEASUREMENT
/begin AXIS_PTS ldpm_n_tooth__eoi_st "" 0x4535c N_TOOTH _REC_AXS_20_u2 816. _CNV_A_R_LINEAR_____17_CM 4 0. 8160. FORMAT "%4.0" /end AXIS_PTS
/begin AXIS_PTS ldpm_tco__eoi_tco "" 0x43f89 TCO _REC_AXS_20_u1 19.05 _CNV_A_R_LINEAR_____0_CM 8 -48. 142.5 FORMAT "%5.1" /end AXIS_PTS
/begin AXIS_PTS ldpm_tco_n_sp_2 "" 0x43ff9 TCO _REC_AXS_20_u1 190.5 _CNV_A_R_LINEAR_____0_CM 8 -48. 142.5 FORMAT "%5.1" /end AXIS_PTS
/begin AXIS_PTS ldpm_tco_n_sp_1 "" 0x43ff0 TCO _REC_AXS_20_u1 190.5 _CNV_A_R_LINEAR_____0_CM 8 -48. 142.5 FORMAT "%5.1" /end AXIS_PTS
/begin AXIS_PTS ldpm_t_ast_n_sp_1 "" 0x4543a T_AST _REC_AXS_20_u2 6553.5 _CNV_A_R_LINEAR_____14_CM 8 0. 6553.5 FORMAT "%6.1" /end AXIS_PTS
/begin AXIS_PTS ldpm_ctr_km_can_n_sp_1 "" 0x44ee6 CTR_KM_CAN _REC_AXS_20_u2 655350. _CNV_A_R_LINEAR_____80_CM 4 0. 655350. FORMAT "%7.0" /end AXIS_PTS
/begin AXIS_PTS ldp_toil_ip_n_sp_is_cs "" 0x43a25 TOIL _REC_AXS_20_u1 200. _CNV_A_R_LINEAR_____3_CM 8 -40. 160. FORMAT "%3.0" /end AXIS_PTS
/begin AXIS_PTS ldp_n_32_n_grd_thd "" 0x436d2 N_32 _REC_AXS_20_u1 8160. _CNV_A_R_LINEAR_____5_CM 8 0. 8160. FORMAT "%4.0" /end AXIS_PTS
/begin AXIS_PTS ldpm_gear "" 0x43baa GEAR _REC_AXS_20_u1 255. _CNV_A_R_LINEAR_____10_CM 9 0. 255. FORMAT "%3.0" /end AXIS_PTS
/begin AXIS_PTS ldp_pv_av__n_max_mtc_cur_off "" 0x437a4 PV_AV _REC_AXS_20_u1 99.609375 _CNV_A_R_LINEAR_____4_CM 4 0. 99.609375 FORMAT "%5.2" /end AXIS_PTS
/begin AXIS_PTS ldp_toil__n_max_2 "" 0x43a17 TOIL _REC_AXS_20_u1 200. _CNV_A_R_LINEAR_____3_CM 4 -40. 160. FORMAT "%3.0" /end AXIS_PTS
/begin AXIS_PTS ldp_toil__n_max_1 "" 0x43a12 TOIL _REC_AXS_20_u1 200. _CNV_A_R_LINEAR_____3_CM 4 -40. 160. FORMAT "%3.0" /end AXIS_PTS
/begin MEASUREMENT TQI "" UBYTE _CNV_A_R_LINEAR_____84_CM 1 100. 0. 255. ECU_ADDRESS 0x3fcd2b FORMAT "%3.0" /end MEASUREMENT
/begin MEASUREMENT LV_FMY_EXIT_ST "" UBYTE _CNV_S_2_RANGE______11_CM 1 100. 0. 1. ECU_ADDRESS 0x3fcd30 BIT_MASK 0x1 /end MEASUREMENT
/begin MEASUREMENT LV_MAX_ERR_FSD_1 "" UBYTE _CNV_S_2_RANGE______21_R_CM 1 100. 0. 255. ECU_ADDRESS 0x3fcd31 /end MEASUREMENT
/begin MEASUREMENT LV_MIN_ERR_FSD_1 "" UBYTE _CNV_S_2_RANGE______21_R_CM 1 100. 0. 255. ECU_ADDRESS 0x3fcd35 /end MEASUREMENT
/begin MEASUREMENT CYCNR_ST "" UWORD _CNV_A_R_LINEAR_____10_CM 1 100. 0. 65535. ECU_ADDRESS 0x3fcd20 FORMAT "%5.0" /end MEASUREMENT
/begin AXIS_PTS ldpm_n_32__lam_cat "" 0x43dc7 N_32 _REC_AXS_20_u1 8160. _CNV_A_R_LINEAR_____5_CM 6 0. 8160. FORMAT "%4.0" /end AXIS_PTS
/begin AXIS_PTS ldp_maf__o2_int_max_at "" 0x444e8 MAF _REC_AXS_20_u2 1389. _CNV_A_R_LINEAR_____95_CM 6 0. 1389. FORMAT "%7.2" /end AXIS_PTS
/begin AXIS_PTS ldp_maf__o2_int_max_mt "" 0x444f6 MAF _REC_AXS_20_u2 1389. _CNV_A_R_LINEAR_____95_CM 6 0. 1389. FORMAT "%7.2" /end AXIS_PTS
/begin AXIS_PTS ldp_n_32__o2_int_max_mt "" 0x435d5 N_32 _REC_AXS_20_u1 8160. _CNV_A_R_LINEAR_____5_CM 6 0. 8160. FORMAT "%4.0" /end AXIS_PTS
/begin AXIS_PTS ldp_n_32__o2_int_max_at "" 0x435ce N_32 _REC_AXS_20_u1 8160. _CNV_A_R_LINEAR_____5_CM 6 0. 8160. FORMAT "%4.0" /end AXIS_PTS
/begin AXIS_PTS ldp_sum_vls_cat_o2 "" 0x44a32 SUM_VLS_CAT_O2 _REC_AXS_20_u2 4294967295. _CNV_A_R_LINEAR_____385_CM 6 0. 4294967295. FORMAT "%11.0" /end AXIS_PTS
/begin AXIS_PTS ldpm_vls_down "" 0x4564c VLS_DOWN_1 _REC_AXS_20_u2 4.99511719 _CNV_A_R_LINEAR_____33_CM 6 0. 4.99511719 FORMAT "%5.3" /end AXIS_PTS
/begin AXIS_PTS ldp_toil_max__stop_dec_fsd "" 0x43a39 TOIL_MAX _REC_AXS_20_u1 200. _CNV_A_R_LINEAR_____3_CM 4 -40. 160. FORMAT "%3.0" /end AXIS_PTS
/begin AXIS_PTS ldp_tco_st__stop_inc_fsd "" 0x43956 TCO_ST _REC_AXS_20_u1 190.5 _CNV_A_R_LINEAR_____0_CM 4 -48. 142.5 FORMAT "%5.1" /end AXIS_PTS
/begin AXIS_PTS ldpm_maf_kgh_1_t_vls_cycnr "" 0x4512c MAF_KGH _REC_AXS_20_u2 2047.96875 _CNV_A_R_LINEAR_____101_CM 6 0. 2047.96875 FORMAT "%7.2" /end AXIS_PTS
/begin AXIS_PTS ldpm_n_32_1_t_vls_cyc "" 0x43d12 N_32 _REC_AXS_20_u1 8160. _CNV_A_R_LINEAR_____5_CM 6 0. 8160. FORMAT "%4.0" /end AXIS_PTS
/begin AXIS_PTS ldpm_maf_2_t_vls_cyc "" 0x4505e MAF _REC_AXS_20_u2 1389. _CNV_A_R_LINEAR_____95_CM 6 0. 1389. FORMAT "%7.2" /end AXIS_PTS
/begin AXIS_PTS ldp_maf_kgh__vls_down_max_cycnr "" 0x4461e MAF_KGH _REC_AXS_20_u2 2047.96875 _CNV_A_R_LINEAR_____101_CM 8 0. 2047.96875 FORMAT "%7.2" /end AXIS_PTS
/begin AXIS_PTS ldp_maf_kgh__fac_maf_lsh_down "" 0x445f8 MAF_KGH _REC_AXS_20_u2 2047.96875 _CNV_A_R_LINEAR_____101_CM 6 0. 2047.96875 FORMAT "%7.2" /end AXIS_PTS
/begin AXIS_PTS ldp_maf_kgh__fac_maf_lsh_up "" 0x44606 MAF_KGH _REC_AXS_20_u2 2047.96875 _CNV_A_R_LINEAR_____101_CM 6 0. 2047.96875 FORMAT "%7.2" /end AXIS_PTS
/begin AXIS_PTS ldp_v_toil__toil "" 0x43a8f V_TOIL _REC_AXS_20_u1 4.998 _CNV_A_R_LINEAR_____38_CM 16 0. 4.998 FORMAT "%6.4" /end AXIS_PTS
/begin AXIS_PTS ldp_opg_rel_st_ip_opg_sp_st_isa "" 0x4498c OPG_REG_ST _REC_AXS_20_u2 99.99847412 _CNV_A_R_LINEAR_____94_CM 12 0. 99.99847412 /end AXIS_PTS
/begin AXIS_PTS ldp_amp_ip_fac_amp_opg_st_isa "" 0x44122 AMP _REC_AXS_20_u2 5434. _CNV_A_R_LINEAR_____43_CM 6 0. 5434. FORMAT "%7.2" /end AXIS_PTS
/begin AXIS_PTS ldp_tia_ip_fac_tia_opg_st_isa "" 0x439ea TIA _REC_AXS_20_u1 190.5 _CNV_A_R_LINEAR_____0_CM 6 -48. 142.5 FORMAT "%5.1" /end AXIS_PTS
/begin AXIS_PTS ldp_pv_av_ip_opg_rel_st_isa_pv "" 0x437b0 PV_AV _REC_AXS_20_u1 99.609375 _CNV_A_R_LINEAR_____4_CM 6 0. 99.609375 FORMAT "%4.1" /end AXIS_PTS
/begin AXIS_PTS ldp_n_32__port_sp_s "" 0x435ea N_32 _REC_AXS_20_u1 816. _CNV_A_R_LINEAR_____5_CM 6 0. 8160. FORMAT "%4.0" /end AXIS_PTS
/begin AXIS_PTS ldp_exc_sp_rel__vlft_sp "" 0x4432a EXC_SP_REL _REC_AXS_20_u2 99.99847412 _CNV_A_R_LINEAR_____94_CM 12 0. 99.99847412 /end AXIS_PTS
/begin AXIS_PTS ldp_portpwm__port_sp_phy "" 0x449b8 PORTPWM _REC_AXS_20_u2 99.99847412 _CNV_A_R_LINEAR_____94_CM 12 0. 99.99847412 /end AXIS_PTS
/begin AXIS_PTS ldp_fac_tq_req__port_sp_s "" 0x44382 FAC_TQ_REQ _REC_AXS_20_u2 1.99996948 _CNV_A_R_LINEAR_____45_CM 6 0. 1.99996948 FORMAT "%7.5" /end AXIS_PTS
/begin AXIS_PTS ldp_v_port__port_av "" 0x44d2c V_PORT _REC_AXS_20_u2 4.99511719 _CNV_A_R_LINEAR_____33_CM 12 0. 4.99511719 FORMAT "%5.3" /end AXIS_PTS
/begin AXIS_PTS ldp_tco__tcoport_sp "" 0x438c9 TCO _REC_AXS_20_u1 190.5 _CNV_A_R_LINEAR_____0_CM 8 -48. 142.5 FORMAT "%5.1" /end AXIS_PTS
/begin AXIS_PTS ldp_n_32__port_sp_afs "" 0x435e3 N_32 _REC_AXS_20_u1 816. _CNV_A_R_LINEAR_____5_CM 6 0. 8160. FORMAT "%4.0" /end AXIS_PTS
/begin AXIS_PTS ldp_n_32__port_sp_afl "" 0x435dc N_32 _REC_AXS_20_u1 816. _CNV_A_R_LINEAR_____5_CM 6 0. 8160. FORMAT "%4.0" /end AXIS_PTS
/begin AXIS_PTS ldp_fac_tq_req__port_sp_afs "" 0x44374 FAC_TQ_REQ _REC_AXS_20_u2 1.99996948 _CNV_A_R_LINEAR_____45_CM 6 0. 1.99996948 FORMAT "%7.5" /end AXIS_PTS
/begin AXIS_PTS ldp_fac_tq_req__port_sp_afl "" 0x44366 FAC_TQ_REQ _REC_AXS_20_u2 1.99996948 _CNV_A_R_LINEAR_____45_CM 6 0. 1.99996948 FORMAT "%7.5" /end AXIS_PTS
/begin AXIS_PTS ldp_n_32__pv_lih_max "" 0x435fa N_32 _REC_AXS_20_u1 816. _CNV_A_R_LINEAR_____5_CM 6 0. 8160. FORMAT "%4.0" /end AXIS_PTS
/begin AXIS_PTS ldpm_vs_fil__pv_fac_cor "" 0x4567a VS_FIL _REC_AXS_20_u2 51.199218 _CNV_A_R_LINEAR_____290_CM 8 0. 511.99218 FORMAT "%7.3" /end AXIS_PTS
/begin AXIS_PTS ldpm_n_dif__pv_fac_cor "" 0x452d6 N_DIF _REC_AXS_20_u2 6553.5 _CNV_A_R_LINEAR_____213_CM 6 -32768. 32767. FORMAT "%6.0" /end AXIS_PTS
/begin AXIS_PTS ldpm_n__pv_fac_cor "" 0x452c8 N _REC_AXS_20_u2 815.9 _CNV_A_R_LINEAR_____17_CM 6 1. 8160. FORMAT "%4.0" /end AXIS_PTS
/begin AXIS_PTS ldpm_pv_av_raw__pv_fac_cor "" 0x43f07 PV_AV_RAW _REC_AXS_20_u1 9.9609375 _CNV_A_R_LINEAR_____4_CM 6 0. 99.609375 FORMAT "%4.1" /end AXIS_PTS
/begin AXIS_PTS ldpm_n_32__fac_tq_req_driv "" 0x43dac N_32 _REC_AXS_20_u1 8160. _CNV_A_R_LINEAR_____5_CM 8 0. 8160. FORMAT "%4.0" /end AXIS_PTS
/begin AXIS_PTS ldpm_fac_tq_cru_dcc "" 0x44f70 FAC_TQ_REQ_CRU _REC_AXS_20_u2 1.99996948 _CNV_A_R_LINEAR_____45_CM 8 0. 1.99996948 FORMAT "%7.5" /end AXIS_PTS
/begin AXIS_PTS ldp_v_pvs_min "" 0x44d46 V_PVS_MIN _REC_AXS_20_u2 4.99511719 _CNV_A_R_LINEAR_____33_CM 2 0. 4.99511719 FORMAT "%5.3" /end AXIS_PTS
/begin AXIS_PTS ldp_pv_av_min_mon_ip_pv_mon "" 0x4033b PV_AV_MIN _REC_AXS_20_u1 99.609375 _CNV_A_R_LINEAR_____4_CM 6 0. 99.609375 FORMAT "%4.1" /end AXIS_PTS
/begin AXIS_PTS ldpm_tco_st_1_sair "" 0x4401b TCO_ST _REC_AXS_20_u1 190.5 _CNV_A_R_LINEAR_____0_CM 8 -48. 142.5 FORMAT "%5.1" /end AXIS_PTS
/begin AXIS_PTS ldpm_n_32_maf_sa_deac "" 0x43e88 N_32 _REC_AXS_20_u1 8160. _CNV_A_R_LINEAR_____5_CM 8 0. 8160. FORMAT "%4.0" /end AXIS_PTS
/begin AXIS_PTS ldpm_n_32_maf_sa_act "" 0x43e7f N_32 _REC_AXS_20_u1 8160. _CNV_A_R_LINEAR_____5_CM 8 0. 8160. FORMAT "%4.0" /end AXIS_PTS
/begin AXIS_PTS ldp_ctr_km_can "" 0x44258 CTR_KM_CAN _REC_AXS_20_u2 655350. _CNV_A_R_LINEAR_____80_CM 8 0. 655350. FORMAT "%7.0" /end AXIS_PTS
/begin AXIS_PTS ldp_tco_st_id_t_dly_diag_sa "" 0x43969 TCO _REC_AXS_20_u1 190.5 _CNV_A_R_LINEAR_____0_CM 8 -48. 142.5 FORMAT "%5.1" /end AXIS_PTS
/begin AXIS_PTS ldp_tia_id_tco_min_diag_sa "" 0x439e3 TIA _REC_AXS_20_u1 190.5 _CNV_A_R_LINEAR_____0_CM 6 -48. 142.5 FORMAT "%5.1" /end AXIS_PTS
/begin AXIS_PTS ldpm_fac_amp "" 0x44f48 FAC_AMP _REC_AXS_20_u2 1.99996948 _CNV_A_R_LINEAR_____45_CM 6 0. 1.99996948 FORMAT "%7.5" /end AXIS_PTS
/begin AXIS_PTS ldp_n_32__maf_max_diag_sa "" 0x43583 N_32 _REC_AXS_20_u1 816. _CNV_A_R_LINEAR_____5_CM 8 0. 8160. FORMAT "%4.0" /end AXIS_PTS
/begin AXIS_PTS ldpm_n_32_id_saf_kgh_diag_min "" 0x43e40 N_32 _REC_AXS_20_u1 8160. _CNV_A_R_LINEAR_____5_CM 8 0. 8160. FORMAT "%4.0" /end AXIS_PTS
/begin AXIS_PTS ldpm_n_32_id_saf_kgh_diag_max "" 0x43e37 N_32 _REC_AXS_20_u1 8160. _CNV_A_R_LINEAR_____5_CM 8 0. 8160. FORMAT "%4.0" /end AXIS_PTS
/begin AXIS_PTS ldpm_maf_id_saf_kgh_diag_min "" 0x43c73 MAF _REC_AXS_20_u1 1389. _CNV_A_R_LINEAR_____18_CM 8 0. 1389. FORMAT "%4.0" /end AXIS_PTS
/begin AXIS_PTS ldpm_maf_id_saf_kgh_diag_max "" 0x43c6a MAF _REC_AXS_20_u1 1389. _CNV_A_R_LINEAR_____18_CM 8 0. 1389. FORMAT "%4.0" /end AXIS_PTS
/begin AXIS_PTS ldp_maf_cyl__saf_mdl "secondary air mass flow depending of MAF_CYL" 0x44520 MAF_CYL _REC_AXS_20_u2 2047.96875 _CNV_A_R_LINEAR_____101_CM 8 0. 2047.96875 FORMAT "%7.2" /end AXIS_PTS
/begin AXIS_PTS ldp_amp__saf_cor_amp "correction of secondary air mass flow depending of ambient pressure" 0x44102 AMP _REC_AXS_20_u2 5434. _CNV_A_R_LINEAR_____43_CM 8 0. 5434. FORMAT "%7.2" /end AXIS_PTS
/begin AXIS_PTS ldp_vb__saf_cor_vb "correction of secondary air mass flow depending of battery voltage" 0x43acb VB _REC_AXS_20_u1 26. _CNV_A_R_LINEAR_____53_CM 8 0. 26. FORMAT "%4.1" /end AXIS_PTS
/begin AXIS_PTS ldp_tam_ip_saf_cor_tam "correction of secondary air mass flow depending of ambient temperature" 0x4382a TIA _REC_AXS_20_u1 190.5 _CNV_A_R_LINEAR_____0_CM 8 -48. 142.5 FORMAT "%5.1" /end AXIS_PTS
/begin AXIS_PTS ldp_maf_kgh__tco_sub_inc "" 0x44614 MAF_KGH _REC_AXS_20_u2 2047.96875 _CNV_A_R_LINEAR_____101_CM 4 0. 2047.96875 FORMAT "%7.2" /end AXIS_PTS
/begin AXIS_PTS ldpm_tco_st__tco_dif_diag "" 0x44036 TCO_ST _REC_AXS_20_u1 190.5 _CNV_A_R_LINEAR_____0_CM 6 -48. 142.5 FORMAT "%5.1" /end AXIS_PTS
/begin AXIS_PTS ldp_vs_fil__tq_gs_inc "" 0x44e2a VS_FIL _REC_AXS_20_u2 511.99218 _CNV_A_R_LINEAR_____78_CM 6 0. 511.99218 FORMAT "%7.3" /end AXIS_PTS
/begin AXIS_PTS ldp_n_32__tq_gs_inc "" 0x43635 N_32 _REC_AXS_20_u1 8160. _CNV_A_R_LINEAR_____5_CM 6 0. 8160. FORMAT "%4.0" /end AXIS_PTS
/begin AXIS_PTS ldp_v_tecu__tecu "" 0x44d6e V_TECU _REC_AXS_20_u2 4.495605471 _CNV_A_R_LINEAR_____33_CM 16 0. 4.99511719 FORMAT "%5.3" /end AXIS_PTS
/begin AXIS_PTS ldp_v_teg__teg "" 0x44d90 V_TEG _REC_AXS_20_u2 4.99511719 _CNV_A_R_LINEAR_____33_CM 16 0. 4.99511719 FORMAT "%5.3" /end AXIS_PTS
/begin AXIS_PTS ldpm_teg_stat_eng_pre "" 0x454dc TEG_STAT _REC_AXS_20_u2 1507.3 _CNV_A_R_LINEAR_____269_CM 6 -48. 1459.3 FORMAT "%7.2" /end AXIS_PTS
/begin AXIS_PTS ldpm_egr_ratio__teg "" 0x44f1a EGR_RATIO _REC_AXS_20_u2 99.99847412 _CNV_A_R_LINEAR_____94_CM 6 0. 99.99847412 /end AXIS_PTS
/begin AXIS_PTS ldpm_temp_toil_dif__fac_temp "" 0x45590 TEMP_TOIL_DIF _REC_AXS_20_u2 404. _CNV_A_R_LINEAR_____420_CM 6 -202. 202. FORMAT "%6.1" /end AXIS_PTS
/begin AXIS_PTS ldpm_lamb_sp_teg__fac_cor "" 0x44fca LAMB_SP_TEG _REC_AXS_20_u2 31.99902344 _CNV_A_R_LINEAR_____148_CM 16 0. 31.99902344 FORMAT "%7.4" /end AXIS_PTS
/begin AXIS_PTS ldpm_nr_cyl_scc_teg__fac_scc "" 0x43ee4 NR_CYL_SCC_TEG _REC_AXS_20_u1 13. _CNV_A_R_LINEAR_____411_CM 14 0. 13. FORMAT "%4.1" /end AXIS_PTS
/begin AXIS_PTS ldpm_ecfpwm_ecf__fac_cor "" 0x43b9e ECFPWM_ECF _REC_AXS_20_u1 99.609375 _CNV_A_R_LINEAR_____4_CM 6 0. 99.609375 FORMAT "%4.1" /end AXIS_PTS
/begin AXIS_PTS ldp_teg_stat__fac_tam "" 0x44af8 TEG_STAT _REC_AXS_20_u2 1507.3 _CNV_A_R_LINEAR_____269_CM 6 -48. 1459.3 FORMAT "%7.2" /end AXIS_PTS
/begin AXIS_PTS ldpm_tam_dew__fac_teg "" 0x43f2e TAM_DEW _REC_AXS_20_u1 190.5 _CNV_A_R_LINEAR_____0_CM 6 -48. 142.5 FORMAT "%5.1" /end AXIS_PTS
/begin AXIS_PTS ldpm_t_es_dew__fac_teg "" 0x4544c T_ES_DEW _REC_AXS_20_u2 65535. _CNV_A_R_LINEAR_____35_CM 8 0. 65535. FORMAT "%5.0" /end AXIS_PTS
/begin AXIS_PTS ldpm_temp_toil_dif__crlc_teg "" 0x4557e TEMP_TOIL_DIF _REC_AXS_20_u2 404. _CNV_A_R_LINEAR_____420_CM 8 -202. 202. FORMAT "%6.1" /end AXIS_PTS
/begin AXIS_PTS ldpm_temp_tco_dif__crlc_teg "" 0x4556c TEMP_TCO_DIF _REC_AXS_20_u2 404. _CNV_A_R_LINEAR_____421_CM 8 -202. 202. FORMAT "%6.1" /end AXIS_PTS
/begin AXIS_PTS ldpm_maf_int_puc__crlc_teg "" 0x450d8 MAF_INT_PUC _REC_AXS_20_u2 1820.398 _CNV_A_R_LINEAR_____277_CM 8 0. 1820.398 FORMAT "%7.2" /end AXIS_PTS
/begin AXIS_PTS ldpm_n_teg__vs_teg "" 0x4534a N_TEG _REC_AXS_20_u2 8160. _CNV_A_R_LINEAR_____17_CM 8 0. 8160. FORMAT "%4.0" /end AXIS_PTS
/begin AXIS_PTS ldpm_tco_st__dew "" 0x4402d TCO_ST _REC_AXS_20_u1 190.5 _CNV_A_R_LINEAR_____0_CM 8 -48. 142.5 FORMAT "%5.1" /end AXIS_PTS
/begin AXIS_PTS ldpm_teg_wall_cat_up_mdl_1 "" 0x454fc TEG_WALL_CAT_UP_MDL _REC_AXS_20_u2 1507.3 _CNV_A_R_LINEAR_____269_CM 8 -48. 1459.3 FORMAT "%7.2" /end AXIS_PTS
/begin AXIS_PTS ldpm_teg_wall_cat_down_mdl_1 "" 0x454ea TEG_WALL_CAT_DOWN_MDL _REC_AXS_20_u2 1507.3 _CNV_A_R_LINEAR_____269_CM 8 -48. 1459.3 FORMAT "%7.2" /end AXIS_PTS
/begin AXIS_PTS ldp_vs__fac_vs_teg "" 0x43b2d VS _REC_AXS_20_u1 255. _CNV_A_R_LINEAR_____13_CM 6 0. 255. FORMAT "%3.0" /end AXIS_PTS
/begin AXIS_PTS ldp_pow_dif_max__add_teg_iga "" 0x449d2 POW_DIF_MAX _REC_AXS_20_u2 434.0555000000001 _CNV_A_R_LINEAR_____423_CM 6 0. 434.0555 FORMAT "%7.3" /end AXIS_PTS
/begin AXIS_PTS ldpm_vo_dif_teg__teg_stat "" 0x4565a VO_DIF_TEG _REC_AXS_20_u2 191.25 _CNV_A_R_LINEAR_____424_CM 6 -95.625 95.625 FORMAT "%5.1" /end AXIS_PTS
/begin AXIS_PTS ldpm_eff_iga_av_teg_cor "" 0x44f02 EFF_IGA_AV_TEG_COR _REC_AXS_20_u2 1.99996948 _CNV_A_R_LINEAR_____45_CM 6 0. 1.99996948 FORMAT "%7.5" /end AXIS_PTS
/begin AXIS_PTS ldpm_teg_stat__crlc_dec "" 0x454a8 TEG_STAT _REC_AXS_20_u2 1507.3 _CNV_A_R_LINEAR_____269_CM 12 -48. 1459.3 FORMAT "%7.2" /end AXIS_PTS
/begin AXIS_PTS ldpm_teg_wall_stat__crlc_dec "" 0x4550e TEG_WALL_STAT _REC_AXS_20_u2 1507.3 _CNV_A_R_LINEAR_____269_CM 12 -48. 1459.3 FORMAT "%7.2" /end AXIS_PTS
/begin AXIS_PTS ldpm_teg_stat__crlc_inc "" 0x454c2 TEG_STAT _REC_AXS_20_u2 1507.3 _CNV_A_R_LINEAR_____269_CM 12 -48. 1459.3 FORMAT "%7.2" /end AXIS_PTS
/begin AXIS_PTS ldpm_teg_wall_stat__crlc_inc "" 0x45528 TEG_WALL_STAT _REC_AXS_20_u2 1507.3 _CNV_A_R_LINEAR_____269_CM 12 -48. 1459.3 FORMAT "%7.2" /end AXIS_PTS
/begin AXIS_PTS ldpm_maf_teg__vs_teg "" 0x45164 MAF_TEG _REC_AXS_20_u2 1389. _CNV_A_R_LINEAR_____95_CM 8 0. 1389. FORMAT "%7.2" /end AXIS_PTS
/begin AXIS_PTS ldpm_vs__fac_cor_vs_teg_ecf "" 0x440d2 VS _REC_AXS_20_u1 255. _CNV_A_R_LINEAR_____13_CM 6 0. 255. FORMAT "%3.0" /end AXIS_PTS
/begin AXIS_PTS ldpm_vs_cor_teg__fac_cor "" 0x440d9 VS_COR_TEG _REC_AXS_20_u1 255. _CNV_A_R_LINEAR_____13_CM 6 0. 255. FORMAT "%3.0" /end AXIS_PTS
/begin AXIS_PTS ldpm_temp_toil_dif_fac_temp "" 0x4559e TEMP_TOIL_DIF _REC_AXS_20_u2 404. _CNV_A_R_LINEAR_____429_CM 6 -202. 202. FORMAT "%6.1" /end AXIS_PTS
/begin AXIS_PTS ldp_vs_cor_teg_up_1__fac_cor "" 0x43b3a VS_COR_TEG_UP_1 _REC_AXS_20_u1 255. _CNV_A_R_LINEAR_____13_CM 6 0. 255. FORMAT "%3.0" /end AXIS_PTS
/begin AXIS_PTS ldpm_vs__fac_cor_vs_teg "" 0x440cb VS _REC_AXS_20_u1 255. _CNV_A_R_LINEAR_____13_CM 6 0. 255. FORMAT "%3.0" /end AXIS_PTS
/begin AXIS_PTS ldp_maf_kgh_sp__amp_dec "" 0x4468a MAF_KGH_SP _REC_AXS_20_u2 2047.96875 _CNV_A_R_LINEAR_____101_CM 4 0. 2047.96875 FORMAT "%6.2" /end AXIS_PTS
/begin AXIS_PTS ldp_maf_sp__tps_sp_mdl_max "" 0x44694 MAF_SP _REC_AXS_20_u2 1389. _CNV_A_R_LINEAR_____95_CM 4 0. 1389. FORMAT "%7.2" /end AXIS_PTS
/begin AXIS_PTS ldp_n_32__tps_sp_mdl_max "" 0x43615 N_32 _REC_AXS_20_u1 816. _CNV_A_R_LINEAR_____5_CM 8 0. 8160. FORMAT "%4.0" /end AXIS_PTS
/begin AXIS_PTS ldp_pq_sp__crlc_ar_red_sp "" 0x449e0 PQ_SP _REC_AXS_20_u2 0.99998474 _CNV_A_R_LINEAR_____31_CM 8 0. 0.99998474 FORMAT "%7.5" /end AXIS_PTS
/begin AXIS_PTS ldp_ar_red_sp_mmv "" 0x441d2 AR_RED_SP_MMV _REC_AXS_20_u2 58.592855 _CNV_A_R_LINEAR_____171_CM 16 0. 58.592855 FORMAT "%7.4" /end AXIS_PTS
/begin AXIS_PTS ldp_pq_sp_isa "" 0x449f2 PQ_SP_ISA _REC_AXS_20_u2 0.99998474 _CNV_A_R_LINEAR_____31_CM 8 0. 0.99998474 FORMAT "%7.5" /end AXIS_PTS
/begin AXIS_PTS ldp_ar_red_isa_sp_mmv "" 0x44196 AR_RED_ISA_SP_MMV _REC_AXS_20_u2 58.592855 _CNV_A_R_LINEAR_____171_CM 16 0. 58.592855 FORMAT "%7.4" /end AXIS_PTS
/begin AXIS_PTS ldp_maf_turb_ratio "" 0x434ae MAF_TURB_RATIO _REC_AXS_20_u1 0.99610001 _CNV_A_R_LINEAR_____20_CM 8 0. 0.99610001 FORMAT "%5.3" /end AXIS_PTS
/begin AXIS_PTS ldpm_vb_1 "" 0x4409c VB _REC_AXS_20_u1 25.8984 _CNV_A_R_LINEAR_____26_CM 8 0. 25.8984 FORMAT "%3.1" /end AXIS_PTS
/begin AXIS_PTS ldp_n_32__isapwm_isa_pwl "" 0x43549 N_32 _REC_AXS_20_u1 8160. _CNV_A_R_LINEAR_____5_CM 4 0. 8160. FORMAT "%4.0" /end AXIS_PTS
/begin AXIS_PTS ldp_amp_mes_ti_st_amp_fac "" 0x4415a AMP _REC_AXS_20_u2 5434. _CNV_A_R_LINEAR_____43_CM 6 0. 5434. FORMAT "%7.2" /end AXIS_PTS
/begin AXIS_PTS ldp_tco__mff_lgrd_ast "" 0x4389c TCO _REC_AXS_20_u1 190.5 _CNV_A_R_LINEAR_____0_CM 8 -48. 142.5 FORMAT "%5.1" /end AXIS_PTS
/begin AXIS_PTS ldpm_tco__mff_cst "" 0x43fb0 TCO _REC_AXS_20_u1 19.05 _CNV_A_R_LINEAR_____0_CM 8 -48. 142.5 FORMAT "%5.1" /end AXIS_PTS
/begin AXIS_PTS ldp_cyc__mff_cst "" 0x4338c CYC _REC_AXS_20_u1 255. _CNV_A_R_LINEAR_____10_CM 4 0. 255. FORMAT "%3.0" /end AXIS_PTS
/begin AXIS_PTS ldp_tia_ip_ti_cast "" 0x439f8 TIA _REC_AXS_20_u1 28.575 _CNV_A_R_LINEAR_____0_CM 2 -48. 142.5 FORMAT "%5.1" /end AXIS_PTS
/begin AXIS_PTS ldp_cyc_cast_ip_ti_deac_cast "" 0x4427c CYC_CAST _REC_AXS_20_u2 65535. _CNV_A_R_LINEAR_____10_CM 6 0. 65535. FORMAT "%5.0" /end AXIS_PTS
/begin AXIS_PTS ldpm_tco_3 "" 0x43f76 TCO _REC_AXS_20_u1 190.5 _CNV_A_R_LINEAR_____0_CM 8 -48. 142.5 FORMAT "%5.1" /end AXIS_PTS
/begin AXIS_PTS ldp_n_tooth__mff_cst "" 0x44964 N_TOOTH _REC_AXS_20_u2 816. _CNV_A_R_LINEAR_____17_CM 3 0. 8160. FORMAT "%4.0" /end AXIS_PTS
/begin AXIS_PTS ldp_vb__ti_add_dly "" 0x43ad4 VB _REC_AXS_20_u1 3.107808 _CNV_A_R_LINEAR_____26_CM 8 0. 25.8984 FORMAT "%3.1" /end AXIS_PTS
/begin AXIS_PTS ldp_fup_map_dif__ti_add_dly "Injector dead time correction" 0x443d4 FUP_MAP_DIF _REC_AXS_20_u2 17388.8 _CNV_A_R_LINEAR_____190_CM 6 0. 173888. FORMAT "%6.0" /end AXIS_PTS
/begin AXIS_PTS ldp_ti_hom__eoi_bas "" 0x44b22 TI_HOM _REC_AXS_20_u2 26.214 _CNV_A_R_LINEAR_____208_CM 6 0. 262.14 FORMAT "%7.3" /end AXIS_PTS
/begin AXIS_PTS ldp_vlft_av__cam_op_in_vvl "" 0x44dd2 VLFT_AV _REC_AXS_20_u2 65.535 _CNV_A_R_LINEAR_____387_CM 6 0. 65.535 /end AXIS_PTS
/begin AXIS_PTS ldp_n_32__eoi_bas "" 0x434dc N_32 _REC_AXS_20_u1 816. _CNV_A_R_LINEAR_____5_CM 6 0. 8160. FORMAT "%4.0" /end AXIS_PTS
/begin AXIS_PTS ldp_n__eoi_dif_s "" 0x436f2 N_32 _REC_AXS_20_u1 8160. _CNV_A_R_LINEAR_____5_CM 6 0. 8160. FORMAT "%4.0" /end AXIS_PTS
/begin AXIS_PTS ldp_mff_sp_s__eoi_dif_s "" 0x44768 MFF_SP_S _REC_AXS_20_u2 1389. _CNV_A_R_LINEAR_____95_CM 6 0. 1389. FORMAT "%7.2" /end AXIS_PTS
/begin AXIS_PTS ldp_tco__eoi_min_tipr "" 0x43833 TCO _REC_AXS_20_u1 190.5 _CNV_A_R_LINEAR_____0_CM 8 -48. 142.5 FORMAT "%5.1" /end AXIS_PTS
/begin AXIS_PTS ldp_cycnr_cst__fac_tipr_deac "" 0x43398 CYCNR_CST _REC_AXS_20_u1 7. _CNV_A_R_LINEAR_____10_CM 6 0. 7. FORMAT "%2.0" /end AXIS_PTS
/begin AXIS_PTS ldp_tco__mffpr_cst "" 0x438a5 TCO _REC_AXS_20_u1 190.5 _CNV_A_R_LINEAR_____0_CM 8 -48. 142.5 FORMAT "%5.1" /end AXIS_PTS
/begin AXIS_PTS ldp_tco__mffpr_fac_st_es "" 0x438ae TCO _REC_AXS_20_u1 190.5 _CNV_A_R_LINEAR_____0_CM 8 -48. 142.5 FORMAT "%5.1" /end AXIS_PTS
/begin AXIS_PTS ldpm_tco__ti_st_rest "" 0x43fc2 TCO _REC_AXS_20_u1 28.575 _CNV_A_R_LINEAR_____0_CM 8 -48. 142.5 FORMAT "%5.1" /end AXIS_PTS
/begin AXIS_PTS ldp_tco_stop__fac_rest "" 0x43989 TCO_STOP _REC_AXS_20_u1 28.575 _CNV_A_R_LINEAR_____0_CM 8 -48. 142.5 FORMAT "%5.1" /end AXIS_PTS
/begin AXIS_PTS ldpm_tco__fac_stall "" 0x43f92 TCO _REC_AXS_20_u1 28.575 _CNV_A_R_LINEAR_____0_CM 8 -48. 142.5 FORMAT "%5.1" /end AXIS_PTS
/begin AXIS_PTS ldp_t_es__rest "" 0x44a96 T_ES _REC_AXS_20_u2 9830.25 _CNV_A_R_LINEAR_____35_CM 8 0. 65535. FORMAT "%5.0" /end AXIS_PTS
/begin AXIS_PTS ldp_t_ast_rest "" 0x44a76 T_AST_REST _REC_AXS_20_u2 983.025 _CNV_A_R_LINEAR_____14_CM 8 0. 6553.5 FORMAT "%6.1" /end AXIS_PTS
/begin AXIS_PTS ldpm_maf_hb__ti_wup "" 0x43c61 MAF_HB _REC_AXS_20_u1 1389. _CNV_A_R_LINEAR_____18_CM 8 0. 1389. FORMAT "%4.0" /end AXIS_PTS
/begin AXIS_PTS ldpm_tco__ti_wup "" 0x43fcb TCO _REC_AXS_20_u1 190.5 _CNV_A_R_LINEAR_____0_CM 8 -48. 142.5 FORMAT "%5.1" /end AXIS_PTS
/begin AXIS_PTS ldp_tco_st__ti_tco_wup "" 0x4395b TCO_ST _REC_AXS_20_u1 190.5 _CNV_A_R_LINEAR_____0_CM 3 -48. 142.5 FORMAT "%5.1" /end AXIS_PTS
/begin AXIS_PTS ldp_vo__ti_vo_wup "" 0x43b12 VO _REC_AXS_20_u1 95.625 _CNV_A_R_LINEAR_____75_CM 8 0. 95.625 FORMAT "%5.2" /end AXIS_PTS
/begin AXIS_PTS ldpm_n_32__ti_wup "" 0x43df1 N_32 _REC_AXS_20_u1 8160. _CNV_A_R_LINEAR_____5_CM 8 0. 8160. FORMAT "%4.0" /end AXIS_PTS
/begin AXIS_PTS ldp_map_dif__fac_ti_vo_wup "" 0x446cc MAP_DIF _REC_AXS_20_u2 5434. _CNV_A_R_LINEAR_____43_CM 8 0. 5434. FORMAT "%7.2" /end AXIS_PTS
/begin AXIS_PTS ldp_map__ti_fac_n_map "" 0x446ba MAP _REC_AXS_20_u2 5434. _CNV_A_R_LINEAR_____43_CM 8 0. 5434. FORMAT "%7.2" /end AXIS_PTS
/begin AXIS_PTS ldp_n_32__ti_fac_n_map "" 0x43607 N_32 _REC_AXS_20_u1 8160. _CNV_A_R_LINEAR_____5_CM 8 0. 8160. FORMAT "%4.0" /end AXIS_PTS
/begin AXIS_PTS ldp_toil_ti_fac_tia_toil "" 0x43a62 TOIL _REC_AXS_20_u1 200. _CNV_A_R_LINEAR_____3_CM 6 -40. 160. FORMAT "%3.0" /end AXIS_PTS
/begin AXIS_PTS ldp_tia_ti_fac_tia_toil "" 0x43a0b TIA _REC_AXS_20_u1 190.5 _CNV_A_R_LINEAR_____0_CM 6 -48. 142.5 FORMAT "%5.1" /end AXIS_PTS
/begin AXIS_PTS ldp_tco__ti_fac_tco "" 0x438d9 TCO _REC_AXS_20_u1 190.5 _CNV_A_R_LINEAR_____0_CM 3 -48. 142.5 FORMAT "%5.1" /end AXIS_PTS
/begin MEASUREMENT TIA_SUB "" UBYTE _CNV_A_R_LINEAR_____0_CM 1 100. -48. 142.5 ECU_ADDRESS 0x3fcc99 FORMAT "%3.0" /end MEASUREMENT
/begin AXIS_PTS ldp_v_tia_tia "" 0x43a7e V_TIA _REC_AXS_20_u1 4.447265625 _CNV_A_R_LINEAR_____437_CM 16 3.90625e-002 4.98046875 FORMAT "%5.3" /end AXIS_PTS
/begin AXIS_PTS ldpm_tco__reac "" 0x43fb9 TCO _REC_AXS_20_u1 190.5 _CNV_A_R_LINEAR_____0_CM 8 -48. 142.5 FORMAT "%5.1" /end AXIS_PTS
/begin AXIS_PTS ldp_map__fac_mff_map_wf "" 0x446b0 MAP _REC_AXS_20_u2 5434. _CNV_A_R_LINEAR_____43_CM 4 0. 5434. FORMAT "%7.2" /end AXIS_PTS
/begin AXIS_PTS ldpm_n_32__reac "" 0x43ddb N_32 _REC_AXS_20_u1 8160. _CNV_A_R_LINEAR_____5_CM 8 0. 8160. FORMAT "%4.0" /end AXIS_PTS
/begin AXIS_PTS ldpm_cycnr_reac__reac "" 0x43b86 CYCNR_REAC _REC_AXS_20_u1 15. _CNV_A_R_LINEAR_____10_CM 16 1. 16. FORMAT "%2.0" /end AXIS_PTS
/begin AXIS_PTS ldp_tco_ip_tmag_ivvt "" 0x43927 TCO _REC_AXS_20_u1 190.5 _CNV_A_R_LINEAR_____0_CM 10 -48. 142.5 FORMAT "%6.2" /end AXIS_PTS
/begin AXIS_PTS ldp_toil_ip_tmag_ivvt "" 0x43a2e TOIL _REC_AXS_20_u1 200. _CNV_A_R_LINEAR_____3_CM 10 -40. 160. FORMAT "%3.0" /end AXIS_PTS
/begin AXIS_PTS ldp_pv_av_ip_tps_sp_st_pv "" 0x437b7 PV_AV _REC_AXS_20_u1 99.609375 _CNV_A_R_LINEAR_____4_CM 6 0. 99.609375 FORMAT "%4.1" /end AXIS_PTS
/begin AXIS_PTS ldp_tia_ip_fac_tia_tps_sp_st "" 0x439f1 TIA _REC_AXS_20_u1 190.5 _CNV_A_R_LINEAR_____0_CM 6 -48. 142.5 FORMAT "%5.1" /end AXIS_PTS
/begin AXIS_PTS ldp_amp_ip_tps_sp_st_amp "" 0x4414c AMP _REC_AXS_20_u2 5434. _CNV_A_R_LINEAR_____43_CM 6 0. 5434. FORMAT "%7.2" /end AXIS_PTS
/begin AXIS_PTS ldp_tps_rel_st_ip_tps_sp_st "" 0x44ba4 TPS_REL_ST _REC_AXS_20_u2 99.99847412 _CNV_A_R_LINEAR_____94_CM 12 0. 99.99847412 /end AXIS_PTS
/begin AXIS_PTS ldpm_tco__fac_tco_tqi "" 0x43f9b TCO _REC_AXS_20_u1 190.5 _CNV_A_R_LINEAR_____0_CM 6 -48. 142.5 FORMAT "%5.1" /end AXIS_PTS
/begin AXIS_PTS ldpm_n_32_6 "" 0x43d64 N_32 _REC_AXS_20_u1 8160. _CNV_A_R_LINEAR_____5_CM 16 0. 8160. FORMAT "%4.0" /end AXIS_PTS
/begin AXIS_PTS ldp_tps_av__maf_1_diag "" 0x44b30 TPS_AV _REC_AXS_20_u2 119.5 _CNV_A_R_LINEAR_____440_CM 16 0. 119.5 FORMAT "%7.3" /end AXIS_PTS
/begin AXIS_PTS ldp_n_32__tps_max_ratio_diag "" 0x43610 N_32 _REC_AXS_20_u1 8160. _CNV_A_R_LINEAR_____5_CM 4 0. 8160. FORMAT "%4.0" /end AXIS_PTS
/begin AXIS_PTS ldp_n_32_tps_sp_pwl "" 0x436db N_32 _REC_AXS_20_u1 816. _CNV_A_R_LINEAR_____5_CM 4 0. 8160. FORMAT "%4.0" /end AXIS_PTS
/begin AXIS_PTS ldp_pv_av__tps_sp_ext "" 0x437a9 PV_AV _REC_AXS_20_u1 99.609375 _CNV_A_R_LINEAR_____4_CM 6 0. 99.609375 FORMAT "%4.1" /end AXIS_PTS
/begin AXIS_PTS ldp_n_ip_tps_sp_lgrd_st "" 0x448cc N _REC_AXS_20_u2 8160. _CNV_A_R_LINEAR_____17_CM 8 0. 8160. FORMAT "%4.0" /end AXIS_PTS
/begin AXIS_PTS ldp_tco_ip_tps_sp_lgrd_st "" 0x43932 TCO _REC_AXS_20_u1 190.5 _CNV_A_R_LINEAR_____0_CM 8 -48. 142.5 FORMAT "%5.1" /end AXIS_PTS
/begin AXIS_PTS ldp_t_acc_ip_fac_tq_loss_acc_on "" 0x43813 T_ACC _REC_AXS_20_u1 2.55 _CNV_A_R_LINEAR_____27_CM 8 0. 2.55 FORMAT "%4.2" /end AXIS_PTS
/begin AXIS_PTS ldp_n_32_ip_fac_tq_loss_acc_on "" 0x43680 N_32 _REC_AXS_20_u1 8160. _CNV_A_R_LINEAR_____5_CM 8 0. 8160. FORMAT "%4.0" /end AXIS_PTS
/begin AXIS_PTS ldp_n_32_ip_tq_add_acc "" 0x436b6 N_32 _REC_AXS_20_u1 8160. _CNV_A_R_LINEAR_____5_CM 6 0. 8160. FORMAT "%4.0" /end AXIS_PTS
/begin AXIS_PTS ldp_t_acc_fac_tq_loss_acc "" 0x4380a T_ACC _REC_AXS_20_u1 2.55 _CNV_A_R_LINEAR_____27_CM 8 0. 2.55 FORMAT "%4.2" /end AXIS_PTS
/begin AXIS_PTS ldp_n_32__tq_add_heat_acc "" 0x4361e N_32 _REC_AXS_20_u1 8160. _CNV_A_R_LINEAR_____5_CM 6 0. 8160. FORMAT "%4.0" /end AXIS_PTS
/begin AXIS_PTS ldpm_gr_at_100 "" 0x43be4 GR_AT _REC_AXS_20_u1 255. _CNV_A_R_LINEAR_____10_CM 13 0. 255. FORMAT "%3.0" /end AXIS_PTS
/begin AXIS_PTS ldpm_gr_mt_100 "" 0x43c00 GR_MT _REC_AXS_20_u1 255. _CNV_A_R_LINEAR_____10_CM 13 0. 255. FORMAT "%3.0" /end AXIS_PTS
/begin AXIS_PTS ldp_n_32__fac_tq_aj "" 0x434ec N_32 _REC_AXS_20_u1 8160. _CNV_A_R_LINEAR_____5_CM 8 0. 8160. FORMAT "%4.0" /end AXIS_PTS
/begin AXIS_PTS ldp_gear__fac_tq_aj "" 0x433d4 GEAR _REC_AXS_20_u1 6. _CNV_A_R_LINEAR_____10_CM 6 0. 6. FORMAT "%1.0" /end AXIS_PTS
/begin AXIS_PTS ldpm_ac_veh_trv_tcs "" 0x44e54 AC_VEH_TRV_TCS _REC_AXS_20_u2 102.35 _CNV_A_R_LINEAR_____451_CM 8 -51.175 51.175 FORMAT "%7.3" /end AXIS_PTS
/begin AXIS_PTS ldpm_vs_fil "" 0x45668 VS_FIL _REC_AXS_20_u2 511.99218 _CNV_A_R_LINEAR_____78_CM 8 0. 511.99218 FORMAT "%7.3" /end AXIS_PTS
/begin AXIS_PTS ldpm_n_32__tq_loss_ars "" 0x43dfa N_32 _REC_AXS_20_u1 8160. _CNV_A_R_LINEAR_____5_CM 8 0. 8160. FORMAT "%4.0" /end AXIS_PTS
/begin AXIS_PTS ldp_tq_loss_ars_sp_can_max "" 0x44c24 TQ_LOSS_ARS_SP_CAN _REC_AXS_20_u2 2047.96875 _CNV_A_R_LINEAR_____218_CM 8 -1024. 1023.96875 FORMAT "%6.2" /end AXIS_PTS
/begin AXIS_PTS ldp_tq_loss_ars_av_can_max "" 0x44c12 TQ_LOSS_ARS_AV_CAN _REC_AXS_20_u2 2047.96875 _CNV_A_R_LINEAR_____218_CM 8 -1024. 1023.96875 FORMAT "%6.2" /end AXIS_PTS
/begin MEASUREMENT N_RATIO_CONV "" UBYTE _CNV_A_R_LINEAR_____253_CM 1 100. 0. 0.996094 ECU_ADDRESS 0x3fe7a3 FORMAT "%4.3" /end MEASUREMENT
/begin AXIS_PTS ldp_tco__tq_clu_amt "" 0x438dd TCO _REC_AXS_20_u1 190.5 _CNV_A_R_LINEAR_____0_CM 6 -48. 142.5 FORMAT "%5.1" /end AXIS_PTS
/begin AXIS_PTS ldp_n_dif__tq_clu_amt "" 0x44824 N_DIF _REC_AXS_20_u2 65535. _CNV_A_R_LINEAR_____213_CM 6 -32768. 32767. FORMAT "%6.0" /end AXIS_PTS
/begin AXIS_PTS ldp_n_32_ip_tq_add_conv "" 0x436c4 N_32 _REC_AXS_20_u1 8160. _CNV_A_R_LINEAR_____5_CM 6 0. 8160. FORMAT "%4.0" /end AXIS_PTS
/begin AXIS_PTS ldp_n_32_ip_tq_add_amt "" 0x436bd N_32 _REC_AXS_20_u1 8160. _CNV_A_R_LINEAR_____5_CM 6 0. 8160. FORMAT "%4.0" /end AXIS_PTS
/begin AXIS_PTS ldp_vs_fil__tq_clu_amt "" 0x44e1c VS_FIL _REC_AXS_20_u2 511.99218 _CNV_A_R_LINEAR_____78_CM 6 0. 511.99218 FORMAT "%7.3" /end AXIS_PTS
/begin AXIS_PTS ldp_n_ratio_conv_fac_tq_conv "" 0x43773 N_RATIO_CONV _REC_AXS_20_u1 0.9960940000000002 _CNV_A_R_LINEAR_____44_CM 8 0. 0.996094 FORMAT "%5.3" /end AXIS_PTS
/begin AXIS_PTS ldp_toil_t_dly_n_sp_is "" 0x43a47 TOIL _REC_AXS_20_u1 200. _CNV_A_R_LINEAR_____3_CM 8 -40. 160. FORMAT "%3.0" /end AXIS_PTS
/begin AXIS_PTS ldp_toil_t_dly_conv "" 0x43a3e TOIL _REC_AXS_20_u1 200. _CNV_A_R_LINEAR_____3_CM 8 -40. 160. FORMAT "%3.0" /end AXIS_PTS
/begin AXIS_PTS ldp_toil_fac_conv "" 0x43a1c TOIL _REC_AXS_20_u1 200. _CNV_A_R_LINEAR_____3_CM 8 -40. 160. FORMAT "%3.0" /end AXIS_PTS
/begin AXIS_PTS ldp_gr_at_n_tur "" 0x433db GR_AT _REC_AXS_20_u1 8. _CNV_A_R_LINEAR_____10_CM 13 0. 8. FORMAT "%1.0" /end AXIS_PTS
/begin AXIS_PTS ldp_n_32__tq_conv "" 0x4362c N_32 _REC_AXS_20_u1 8160. _CNV_A_R_LINEAR_____5_CM 8 0. 8160. FORMAT "%4.0" /end AXIS_PTS
/begin AXIS_PTS ldp_vs_n_tur "" 0x43b5d VS _REC_AXS_20_u1 255. _CNV_A_R_LINEAR_____13_CM 2 0. 255. FORMAT "%3.0" /end AXIS_PTS
/begin AXIS_PTS ldp_tq_conv_can__tq_conv "" 0x44bf2 TQ_CONV_CAN _REC_AXS_20_u2 2047.96875 _CNV_A_R_LINEAR_____218_CM 8 -1024. 1023.96875 FORMAT "%6.2" /end AXIS_PTS
/begin AXIS_PTS ldp_cl_mmv "" 0x44202 CL_MMV _REC_AXS_20_u2 7.99987793 _CNV_A_R_LINEAR_____348_CM 6 0. 7.99987793 FORMAT "%6.4" /end AXIS_PTS
/begin AXIS_PTS ldpm_n_100 "" 0x451b0 N _REC_AXS_20_u2 8160. _CNV_A_R_LINEAR_____17_CM 16 0. 8160. FORMAT "%4.0" /end AXIS_PTS
/begin AXIS_PTS ldp_maf_cyl_stk__tqfr "" 0x4454a MAF _REC_AXS_20_u2 1389. _CNV_A_R_LINEAR_____95_CM 8 0. 1389. FORMAT "%7.2" /end AXIS_PTS
/begin AXIS_PTS ldp_tco__tqfr_add "" 0x438e4 TCO _REC_AXS_20_u1 190.5 _CNV_A_R_LINEAR_____0_CM 8 -48. 142.5 FORMAT "%5.1" /end AXIS_PTS
/begin AXIS_PTS ldp_toil_tqfr_add "" 0x43a69 TOIL _REC_AXS_20_u1 200. _CNV_A_R_LINEAR_____3_CM 8 -40. 160. FORMAT "%3.0" /end AXIS_PTS
/begin AXIS_PTS ldp_n_tq_loss_lim "" 0x4496c N _REC_AXS_20_u2 8160. _CNV_A_R_LINEAR_____17_CM 6 0. 8160. FORMAT "%4.0" /end AXIS_PTS
/begin AXIS_PTS ldp_tco_tq_loss_lim "" 0x439a3 TCO _REC_AXS_20_u1 190.5 _CNV_A_R_LINEAR_____0_CM 6 -48. 142.5 FORMAT "%5.1" /end AXIS_PTS
/begin AXIS_PTS ldp_tco_st__tqfr_st "" 0x43964 TCO_ST _REC_AXS_20_u1 190.5 _CNV_A_R_LINEAR_____0_CM 4 -48. 142.5 FORMAT "%5.1" /end AXIS_PTS
/begin AXIS_PTS ldp_tco_st__tqfr_dec_st "" 0x4395f TCO_ST _REC_AXS_20_u1 190.5 _CNV_A_R_LINEAR_____0_CM 4 -48. 142.5 FORMAT "%5.1" /end AXIS_PTS
/begin AXIS_PTS ldp_eff_scc_sp__nr_pat_scc "" 0x442d8 EFF_SCC_SP _REC_AXS_20_u2 1.99996948 _CNV_A_R_LINEAR_____45_CM 13 0. 1.99996948 FORMAT "%7.5" /end AXIS_PTS
/begin AXIS_PTS ldp_tco_ip_tq_st "" 0x4393b TCO _REC_AXS_20_u1 190.5 _CNV_A_R_LINEAR_____0_CM 8 -48. 142.5 FORMAT "%5.1" /end AXIS_PTS
/begin AXIS_PTS ldp_n_dif_ip_tq_st "" 0x4489a N_DIF _REC_AXS_20_u2 65535. _CNV_A_R_LINEAR_____213_CM 8 -32768. 32767. FORMAT "%6.0" /end AXIS_PTS
/begin AXIS_PTS ldp_n_32_mon__tqi_ref_mon "" 0x40313 N_32_MON _REC_AXS_20_u1 8160. _CNV_A_R_LINEAR_____5_CM 6 0. 8160. FORMAT "%4.0" /end AXIS_PTS
/begin AXIS_PTS ldp_maf_mon__tqi_ref_mon "" 0x402cc MAF_MON _REC_AXS_20_u1 1389. _CNV_A_R_LINEAR_____18_CM 8 0. 1389. FORMAT "%4.0" /end AXIS_PTS
/begin AXIS_PTS ldp_n_32_mon__iga_ref_mon "" 0x402e6 N_32_MON _REC_AXS_20_u1 8160. _CNV_A_R_LINEAR_____5_CM 8 0. 8160. FORMAT "%4.0" /end AXIS_PTS
/begin AXIS_PTS ldp_maf_mon__iga_ref_mon "" 0x402c3 MAF_MON _REC_AXS_20_u1 1389. _CNV_A_R_LINEAR_____18_CM 8 0. 1389. FORMAT "%4.0" /end AXIS_PTS
/begin AXIS_PTS ldp_iga_dif_av_mon__eff_iga_mon "" 0x402ba IGA_DIF_AV_MON _REC_AXS_20_u1 -95.625 _CNV_A_R_LINEAR_____203_CM 8 0. -95.625 FORMAT "%6.2" /end AXIS_PTS
/begin AXIS_PTS ldpm_n_fac_tq_req_driv "" 0x452e4 N _REC_AXS_20_u2 8160. _CNV_A_R_LINEAR_____17_CM 12 0. 8160. FORMAT "%4.0" /end AXIS_PTS
/begin AXIS_PTS ldpm_pv_av_fac_tq_req_driv "" 0x43efa PV_AV _REC_AXS_20_u1 99.609375 _CNV_A_R_LINEAR_____4_CM 12 0. 99.609375 FORMAT "%4.1" /end AXIS_PTS
/begin AXIS_PTS ldp_n_sp_is_ratio "" 0x44940 N_SP_IS_RATIO _REC_AXS_20_u2 7.99987793 _CNV_A_R_LINEAR_____348_CM 8 0. 7.99987793 FORMAT "%6.4" /end AXIS_PTS
/begin AXIS_PTS ldp_ecfpwm_ecf__pow_loss_ecf "" 0x4339f ECFPWM_ECF _REC_AXS_20_u1 99.609375 _CNV_A_R_LINEAR_____4_CM 8 0. 99.609375 FORMAT "%4.1" /end AXIS_PTS
/begin AXIS_PTS ldpm_n_32__maf_min_pu "" 0x43dce N_32 _REC_AXS_20_u1 8160. _CNV_A_R_LINEAR_____5_CM 12 0. 8160. FORMAT "%4.0" /end AXIS_PTS
/begin AXIS_PTS ldpm_tco__maf_min_pu "" 0x43fab TCO _REC_AXS_20_u1 190.5 _CNV_A_R_LINEAR_____0_CM 4 -48. 142.5 FORMAT "%5.1" /end AXIS_PTS
/begin AXIS_PTS ldp_mff_sp_s__tqi_ref_s "" 0x44792 MFF_SP_S _REC_AXS_20_u2 1389. _CNV_A_R_LINEAR_____95_CM 12 0. 1389. FORMAT "%7.2" /end AXIS_PTS
/begin MEASUREMENT TQ_DIF_TRA "" SWORD _CNV_A_R_LINEAR_____48_CM 1 100. -1024. 1023.96875 ECU_ADDRESS 0x3fe810 FORMAT "%6.2" /end MEASUREMENT
/begin AXIS_PTS ldp_n_32__tqi_dif_lim "" 0x402e1 N_32 _REC_AXS_20_u1 8160. _CNV_A_R_LINEAR_____5_CM 4 0. 8160. FORMAT "%4.0" /end AXIS_PTS
/begin AXIS_PTS ldp_tqi_sp_mon__tqi_dif_lim "" 0x40380 TQI_SP_MON _REC_AXS_20_u1 510. _CNV_A_R_LINEAR_____88_CM 4 0. 510. FORMAT "%3.0" /end AXIS_PTS
/begin AXIS_PTS ldp_tqi_sp_mon__tqi_dif_max_mon "" 0x40385 TQI_SP_MON _REC_AXS_20_u1 510. _CNV_A_R_LINEAR_____88_CM 4 0. 510. FORMAT "%3.0" /end AXIS_PTS
/begin AXIS_PTS ldp_n_32_mon__tqi_dif_max_mon "" 0x4030e N_32_MON _REC_AXS_20_u1 8160. _CNV_A_R_LINEAR_____5_CM 4 0. 8160. FORMAT "%4.0" /end AXIS_PTS
/begin AXIS_PTS ldp_n_dif_sp_is_mon_ip_tq_mon "maximum PD-part depending on speed deviation to idle speed setpoint" 0x40326 N_DIF_SP_IS_MON _REC_AXS_20_u1 8160. _CNV_A_R_LINEAR_____378_CM 4 -4096. 4064. FORMAT "%5.0" /end AXIS_PTS
/begin AXIS_PTS ldp_tco_mon_ip_fac_tq_p_d_mon "" 0x4034f TCO_MON _REC_AXS_20_u1 190.5 _CNV_A_R_LINEAR_____0_CM 5 -48. 142.5 FORMAT "%4.0" /end AXIS_PTS
/begin AXIS_PTS ldp_tco_mon_ip_n_sp_is_mon "" 0x40355 TCO_MON _REC_AXS_20_u1 190.5 _CNV_A_R_LINEAR_____0_CM 5 -48. 142.5 FORMAT "%5.1" /end AXIS_PTS
/begin AXIS_PTS ldp_n_tq_add_st "" 0x4377c N_32 _REC_AXS_20_u1 8160. _CNV_A_R_LINEAR_____5_CM 8 0. 8160. FORMAT "%4.0" /end AXIS_PTS
/begin AXIS_PTS ldp_tco_tq_add_st "" 0x4399e TCO _REC_AXS_20_u1 190.5 _CNV_A_R_LINEAR_____0_CM 4 -48. 142.5 FORMAT "%5.1" /end AXIS_PTS
/begin AXIS_PTS ldp_n_32_tq_add_tra "" 0x436e0 N_32 _REC_AXS_20_u1 8160. _CNV_A_R_LINEAR_____5_CM 8 0. 8160. FORMAT "%4.0" /end AXIS_PTS
/begin AXIS_PTS ldp_tq_req_dif_tra_fac_tq_tra "" 0x44c36 TQ_REQ_DIF_TRA _REC_AXS_20_u2 1023.96875 _CNV_A_R_LINEAR_____48_CM 6 0. 1023.96875 FORMAT "%7.2" /end AXIS_PTS
/begin AXIS_PTS ldp_n_32_mon__tq_loss_min_mon "" 0x40301 N_32_MON _REC_AXS_20_u1 8160. _CNV_A_R_LINEAR_____5_CM 5 0. 8160. FORMAT "%4.0" /end AXIS_PTS
/begin AXIS_PTS ldp_tco_mon__tq_loss_min_mon "" 0x40342 TCO_MON _REC_AXS_20_u1 190.5 _CNV_A_R_LINEAR_____0_CM 5 -48. 142.5 FORMAT "%4.0" /end AXIS_PTS
/begin AXIS_PTS ldp_n_32_mon__tq_max_clu_max_mon "" 0x40307 N_32_MON _REC_AXS_20_u1 8160. _CNV_A_R_LINEAR_____5_CM 6 0. 8160. FORMAT "%4.0" /end AXIS_PTS
/begin AXIS_PTS ldp_n_dif_mon_ip_tq_min_mon "" 0x40321 N_DIF_SP_IS_MON _REC_AXS_20_u1 8160. _CNV_A_R_LINEAR_____378_CM 4 -4096. 4064. FORMAT "%5.0" /end AXIS_PTS
/begin AXIS_PTS ldp_n_32_mon_ip_tqi_min_pu_mon "" 0x4031a N_32_MON _REC_AXS_20_u1 8160. _CNV_A_R_LINEAR_____5_CM 6 0. 8160. FORMAT "%4.0" /end AXIS_PTS
/begin AXIS_PTS ldp_tco_mon_ip_fac_conv_mon "" 0x40348 TCO_MON _REC_AXS_20_u1 190.5 _CNV_A_R_LINEAR_____0_CM 6 -48. 142.5 FORMAT "%5.1" /end AXIS_PTS
/begin AXIS_PTS ldp_tco_mon_ip_tqi_min_pu_mon "" 0x4035b TCO_MON _REC_AXS_20_u1 190.5 _CNV_A_R_LINEAR_____0_CM 4 -48. 142.5 FORMAT "%5.1" /end AXIS_PTS
/begin AXIS_PTS ldpm_gear__tq_p_max "" 0x43bc8 GEAR _REC_AXS_20_u1 12. _CNV_A_R_LINEAR_____12_CM 13 0. 12. FORMAT "%3.0" /end AXIS_PTS
/begin AXIS_PTS ldpm_vs_fil__tq_p_max "" 0x4568c VS_FIL _REC_AXS_20_u2 511.99218 _CNV_A_R_LINEAR_____78_CM 6 0. 511.99218 FORMAT "%7.3" /end AXIS_PTS
/begin AXIS_PTS ldp_ang_pste__tq_loss_pste "" 0x4417a ANG_PSTE _REC_AXS_20_u2 2867.2 _CNV_A_R_LINEAR_____465_CM 8 -1433.6 1433.6 FORMAT "%8.2" /end AXIS_PTS
/begin AXIS_PTS ldp_vel_ang_pste__tq_loss_pste "" 0x44dc0 VEL_ANG_PSTE _REC_AXS_20_u2 2867.2 _CNV_A_R_LINEAR_____466_CM 8 -1433.6 1433.6 FORMAT "%8.2" /end AXIS_PTS
/begin AXIS_PTS ldp_ang_pste__tq_add_pste "" 0x44168 ANG_PSTE _REC_AXS_20_u2 2867.2 _CNV_A_R_LINEAR_____465_CM 8 -1433.6 1433.6 FORMAT "%8.2" /end AXIS_PTS
/begin AXIS_PTS ldp_n__fac_tq_add_pste "" 0x447b6 N _REC_AXS_20_u2 8160. _CNV_A_R_LINEAR_____17_CM 8 0. 8160. FORMAT "%4.0" /end AXIS_PTS
/begin AXIS_PTS ldp_n_32__fac_tq_req_driv_mon "" 0x402d8 N_32_MON _REC_AXS_20_u1 8160. _CNV_A_R_LINEAR_____5_CM 8 0. 8160. FORMAT "%4.0" /end AXIS_PTS
/begin AXIS_PTS ldp_pv_av__fac_tq_req_driv_mon "" 0x40332 PV_AV_MON _REC_AXS_20_u1 99.609375 _CNV_A_R_LINEAR_____4_CM 8 0. 99.609375 FORMAT "%5.2" /end AXIS_PTS
/begin AXIS_PTS ldp_tia_fac_n_vim "" 0x439da TIA _REC_AXS_20_u1 190.5 _CNV_A_R_LINEAR_____0_CM 8 -48. 142.5 FORMAT "%5.1" /end AXIS_PTS
/begin AXIS_PTS ldp_seg_ctr_fac_wf "" 0x44a28 SEG_CTR_FAC_WF _REC_AXS_20_u2 65535. _CNV_A_R_LINEAR_____178_CM 4 0. 65535. FORMAT "%5.0" /end AXIS_PTS
/begin AXIS_PTS ldp_tco_st_ti_fac_wf "" 0x43984 TCO_ST _REC_AXS_20_u1 190.5 _CNV_A_R_LINEAR_____0_CM 4 -48. 142.5 FORMAT "%5.1" /end AXIS_PTS
/begin AXIS_PTS ldp_tco_ti_wf_thd "" 0x43999 TCO _REC_AXS_20_u1 28.575 _CNV_A_R_LINEAR_____0_CM 4 -48. 142.5 FORMAT "%5.1" /end AXIS_PTS
/begin AXIS_PTS ldpm_maf_6 "" 0x43c3b MAF _REC_AXS_20_u1 1389. _CNV_A_R_LINEAR_____18_CM 8 0. 1389. FORMAT "%4.0" /end AXIS_PTS
/begin AXIS_PTS ldpm_n_29 "" 0x43cb2 N_32 _REC_AXS_20_u1 8160. _CNV_A_R_LINEAR_____5_CM 8 0. 8160. FORMAT "%4.0" /end AXIS_PTS
/begin AXIS_PTS ldpm_tco_15 "" 0x43f35 TCO _REC_AXS_20_u1 190.5 _CNV_A_R_LINEAR_____0_CM 8 -48. 142.5 FORMAT "%5.1" /end AXIS_PTS
/begin AXIS_PTS ldpm_tib_ti_wf_thd "" 0x455ac TIB _REC_AXS_20_u2 262.14 _CNV_A_R_LINEAR_____208_CM 4 0. 262.14 FORMAT "%7.3" /end AXIS_PTS
/begin AXIS_PTS ldpm_vo_1 "" 0x440ae VO _REC_AXS_20_u1 95.625 _CNV_A_R_LINEAR_____75_CM 8 0. 95.625 FORMAT "%4.1" /end AXIS_PTS
/begin AXIS_PTS ldp_maf_sp_tqi "" 0x4469e MAF_SP_TQI _REC_AXS_20_u2 1389. _CNV_A_R_LINEAR_____95_CM 8 0. 1389. FORMAT "%7.2" /end AXIS_PTS
/begin AXIS_PTS ldp_tia__fac_ti_wf "" 0x439bd TIA _REC_AXS_20_u1 190.5 _CNV_A_R_LINEAR_____0_CM 4 -48. 142.5 FORMAT "%5.1" /end AXIS_PTS
/begin AXIS_PTS ldp_tco__fac_ti_wf "" 0x43866 TCO _REC_AXS_20_u1 190.5 _CNV_A_R_LINEAR_____0_CM 4 -48. 142.5 FORMAT "%5.1" /end AXIS_PTS
/begin AXIS_PTS ldpm_n_32__seg_ad_cor "" 0x42113 LDPM_N_32__SEG_AD_COR _REC_AXS_20_u1 8160. _CNV_A_R_LINEAR_____5_CM 6 0. 8160. FORMAT "%4.0" /end AXIS_PTS
/begin AXIS_PTS ldp_maf__maf_dif_max_er_ad "" 0x42204 LDP_MAF__MAF_DIF_MAX_ER_AD _REC_AXS_20_u2 1389. _CNV_A_R_LINEAR_____95_CM 6 0. 1389. FORMAT "%7.2" /end AXIS_PTS
/begin AXIS_PTS ldp_tps_av__tps_grd_max_er_ad "" 0x42212 LDP_TPS_AV__TPS_GRD_MAX_ER_AD _REC_AXS_20_u2 119.5 _CNV_A_R_LINEAR_____226_CM 6 0. 119.5 FORMAT "%7.3" /end AXIS_PTS
/begin AXIS_PTS ldp_load_mis__load_mis_dif_max "" 0x421f6 LDP_LOAD_MIS__LOAD_MIS_DIF_MAX _REC_AXS_20_u2 100. _CNV_A_R_LINEAR_____368_CM 6 0. 100. FORMAT "%7.3" /end AXIS_PTS
/begin AXIS_PTS ldp_load_mis__fac_add_er_0_at "" 0x4214e LDP_LOAD_MIS__FAC_ADD_ER_0_AT _REC_AXS_20_u2 99.99694824000001 _CNV_A_R_LINEAR_____172_CM 6 0. 99.99694824 /end AXIS_PTS
/begin AXIS_PTS ldp_load_mis__fac_add_er_0_mt "" 0x4215c LDP_LOAD_MIS__FAC_ADD_ER_0_MT _REC_AXS_20_u2 99.99694824000001 _CNV_A_R_LINEAR_____172_CM 6 0. 99.99694824 /end AXIS_PTS
/begin AXIS_PTS ldp_load_mis__fac_add_er_1_at "" 0x4216a LDP_LOAD_MIS__FAC_ADD_ER_1_AT _REC_AXS_20_u2 99.99694824000001 _CNV_A_R_LINEAR_____172_CM 6 0. 99.99694824 /end AXIS_PTS
/begin AXIS_PTS ldpm_load_mis__fac_add_er_1_at "" 0x42220 LDPM_LOAD_MIS__FAC_ADD_ER_1_AT _REC_AXS_20_u2 99.99694824000001 _CNV_A_R_LINEAR_____172_CM 6 0. 99.99694824 /end AXIS_PTS
/begin AXIS_PTS ldp_load_mis__fac_add_er_1_mt "" 0x42178 LDP_LOAD_MIS__FAC_ADD_ER_1_MT _REC_AXS_20_u2 99.99694824000001 _CNV_A_R_LINEAR_____172_CM 6 0. 99.99694824 /end AXIS_PTS
/begin AXIS_PTS ldp_load_mis__fac_add_er_2_at "" 0x42186 LDP_LOAD_MIS__FAC_ADD_ER_2_AT _REC_AXS_20_u2 99.99694824000001 _CNV_A_R_LINEAR_____172_CM 6 0. 99.99694824 /end AXIS_PTS
/begin AXIS_PTS ldp_load_mis__fac_add_er_2_mt "" 0x42194 LDP_LOAD_MIS__FAC_ADD_ER_2_MT _REC_AXS_20_u2 99.99694824000001 _CNV_A_R_LINEAR_____172_CM 6 0. 99.99694824 /end AXIS_PTS
/begin AXIS_PTS ldp_load_mis__fac_add_er_3_at "" 0x421a2 LDP_LOAD_MIS__FAC_ADD_ER_3_AT _REC_AXS_20_u2 99.99694824000001 _CNV_A_R_LINEAR_____172_CM 6 0. 99.99694824 /end AXIS_PTS
/begin AXIS_PTS ldp_load_mis__fac_add_er_3_mt "" 0x421b0 LDP_LOAD_MIS__FAC_ADD_ER_3_MT _REC_AXS_20_u2 99.99694824000001 _CNV_A_R_LINEAR_____172_CM 6 0. 99.99694824 /end AXIS_PTS
/begin AXIS_PTS ldp_load_mis__fac_add_er_4_at "" 0x421be LDP_LOAD_MIS__FAC_ADD_ER_4_AT _REC_AXS_20_u2 99.99694824000001 _CNV_A_R_LINEAR_____172_CM 6 0. 99.99694824 /end AXIS_PTS
/begin AXIS_PTS ldp_load_mis__fac_add_er_4_mt "" 0x421cc LDP_LOAD_MIS__FAC_ADD_ER_4_MT _REC_AXS_20_u2 99.99694824000001 _CNV_A_R_LINEAR_____172_CM 6 0. 99.99694824 /end AXIS_PTS
/begin AXIS_PTS ldp_load_mis__fac_add_er_5_at "" 0x421da LDP_LOAD_MIS__FAC_ADD_ER_5_AT _REC_AXS_20_u2 99.99694824000001 _CNV_A_R_LINEAR_____172_CM 6 0. 99.99694824 /end AXIS_PTS
/begin AXIS_PTS ldp_load_mis__fac_add_er_5_mt "" 0x421e8 LDP_LOAD_MIS__FAC_ADD_ER_5_MT _REC_AXS_20_u2 99.99694824000001 _CNV_A_R_LINEAR_____172_CM 6 0. 99.99694824 /end AXIS_PTS
/begin AXIS_PTS ldp_load_ip_fac_load_drv2_er_at "" 0x4211a LDP_LOAD_IP_FAC_LOAD_DRV2_ER_AT _REC_AXS_20_u2 99.99694824000001 _CNV_A_R_LINEAR_____172_CM 12 0. 99.99694824 /end AXIS_PTS
/begin AXIS_PTS ldp_load_ip_fac_load_drv2_er_mt "" 0x42134 LDP_LOAD_IP_FAC_LOAD_DRV2_ER_MT _REC_AXS_20_u2 99.99694824000001 _CNV_A_R_LINEAR_____172_CM 12 0. 99.99694824 /end AXIS_PTS
/begin AXIS_PTS ldp_n_32_ip_fac_n_drv2_er_at "" 0x420a5 LDP_N_32_IP_FAC_N_DRV2_ER_AT _REC_AXS_20_u1 8160. _CNV_A_R_LINEAR_____5_CM 12 0. 8160. FORMAT "%4.0" /end AXIS_PTS
/begin AXIS_PTS ldp_n_32_ip_fac_n_drv2_er_mt "" 0x420b2 LDP_N_32_IP_FAC_N_DRV2_ER_MT _REC_AXS_20_u1 8160. _CNV_A_R_LINEAR_____5_CM 12 0. 8160. FORMAT "%4.0" /end AXIS_PTS
/begin AXIS_PTS ldp_n_32_ip_crlc_drv2_er_at "" 0x4208b LDP_N_32_IP_CRLC_DRV2_ER_AT _REC_AXS_20_u1 8160. _CNV_A_R_LINEAR_____5_CM 12 0. 8160. FORMAT "%4.0" /end AXIS_PTS
/begin AXIS_PTS ldp_n_32_ip_crlc_drv2_er_mt "" 0x42098 LDP_N_32_IP_CRLC_DRV2_ER_MT _REC_AXS_20_u1 8160. _CNV_A_R_LINEAR_____5_CM 12 0. 8160. FORMAT "%4.0" /end AXIS_PTS
/begin AXIS_PTS ldpm_n_32__fac_er_0_at "" 0x420bf LDPM_N_32__FAC_ER_0_AT _REC_AXS_20_u1 8160. _CNV_A_R_LINEAR_____5_CM 6 0. 8160. FORMAT "%4.0" /end AXIS_PTS
/begin AXIS_PTS ldpm_n_32__fac_er_0_mt "" 0x420c6 LDPM_N_32__FAC_ER_0_MT _REC_AXS_20_u1 8160. _CNV_A_R_LINEAR_____5_CM 6 0. 8160. FORMAT "%4.0" /end AXIS_PTS
/begin AXIS_PTS ldpm_n_32__fac_er_1_at "" 0x420cd LDPM_N_32__FAC_ER_1_AT _REC_AXS_20_u1 8160. _CNV_A_R_LINEAR_____5_CM 6 0. 8160. FORMAT "%4.0" /end AXIS_PTS
/begin AXIS_PTS ldpm_n_32__fac_er_1_mt "" 0x420d4 LDPM_N_32__FAC_ER_1_MT _REC_AXS_20_u1 8160. _CNV_A_R_LINEAR_____5_CM 6 0. 8160. FORMAT "%4.0" /end AXIS_PTS
/begin AXIS_PTS ldpm_n_32__fac_er_2_at "" 0x420db LDPM_N_32__FAC_ER_2_AT _REC_AXS_20_u1 8160. _CNV_A_R_LINEAR_____5_CM 6 0. 8160. FORMAT "%4.0" /end AXIS_PTS
/begin AXIS_PTS ldpm_n_32__fac_er_2_mt "" 0x420e2 LDPM_N_32__FAC_ER_2_MT _REC_AXS_20_u1 8160. _CNV_A_R_LINEAR_____5_CM 6 0. 8160. FORMAT "%4.0" /end AXIS_PTS
/begin AXIS_PTS ldpm_n_32__fac_er_3_at "" 0x420e9 LDPM_N_32__FAC_ER_3_AT _REC_AXS_20_u1 8160. _CNV_A_R_LINEAR_____5_CM 6 0. 8160. FORMAT "%4.0" /end AXIS_PTS
/begin AXIS_PTS ldpm_n_32__fac_er_3_mt "" 0x420f0 LDPM_N_32__FAC_ER_3_MT _REC_AXS_20_u1 8160. _CNV_A_R_LINEAR_____5_CM 6 0. 8160. FORMAT "%4.0" /end AXIS_PTS
/begin AXIS_PTS ldpm_n_32__fac_er_4_at "" 0x420f7 LDPM_N_32__FAC_ER_4_AT _REC_AXS_20_u1 8160. _CNV_A_R_LINEAR_____5_CM 6 0. 8160. FORMAT "%4.0" /end AXIS_PTS
/begin AXIS_PTS ldpm_n_32__fac_er_4_mt "" 0x420fe LDPM_N_32__FAC_ER_4_MT _REC_AXS_20_u1 8160. _CNV_A_R_LINEAR_____5_CM 6 0. 8160. FORMAT "%4.0" /end AXIS_PTS
/begin AXIS_PTS ldpm_n_32__fac_er_5_at "" 0x42105 LDPM_N_32__FAC_ER_5_AT _REC_AXS_20_u1 8160. _CNV_A_R_LINEAR_____5_CM 6 0. 8160. FORMAT "%4.0" /end AXIS_PTS
/begin AXIS_PTS ldpm_n_32__fac_er_5_mt "" 0x4210c LDPM_N_32__FAC_ER_5_MT _REC_AXS_20_u1 8160. _CNV_A_R_LINEAR_____5_CM 6 0. 8160. FORMAT "%4.0" /end AXIS_PTS
/begin MEASUREMENT B_DSLFA "" UBYTE _CNV_A_R_LINEAR_____12_CM 1 100. 0. 255. ECU_ADDRESS 0x3fc5b1 BIT_MASK 0x1 /end MEASUREMENT
/begin MEASUREMENT B_FASLS "" UBYTE _CNV_A_R_LINEAR_____12_CM 1 100. 0. 255. ECU_ADDRESS 0x3fc5b2 BIT_MASK 0x1 /end MEASUREMENT
/begin MEASUREMENT IMLPR "Relatives Luftmassenintegral bei Katheizung" UBYTE _CNV_R_R_fak_q0p003_514_CM 1 100. 0. 0.99609375 ECU_ADDRESS 0x3fc5b0 FORMAT "%8.4" /end MEASUREMENT
/begin MEASUREMENT BSDCONTROL "" UBYTE _CNV_R_R_igen_ub_q1_483_CM 1 100. 0. 255. ECU_ADDRESS 0x3faf8c FORMAT "%5.1" /end MEASUREMENT
/begin MEASUREMENT BSDDATA "" UBYTE _CNV_R_R_igen_ub_q1_483_CM 1 100. 0. 255. ECU_ADDRESS 0x3faf85 FORMAT "%5.1" /end MEASUREMENT
/begin MEASUREMENT BSDREGADR "" UBYTE _CNV_R_R_igen_ub_q1_483_CM 1 100. 0. 255. ECU_ADDRESS 0x3faf84 FORMAT "%5.1" /end MEASUREMENT
/begin MEASUREMENT OZPERMBITS1_1S "???" UBYTE _CNV_A_R_LINEAR_____10_CM 1 100. 0. 255. ECU_ADDRESS 0x3fb3a7 FORMAT "%3.0" /end MEASUREMENT
/begin MEASUREMENT B_OZDPERM "Bedingung Delta Er-Ermittlung aktiv" UBYTE _CNV_A_R_LINEAR_____10_CM 1 100. 0. 255. ECU_ADDRESS 0x3fb3a7 FORMAT "%3.0" BIT_MASK 0x80 /end MEASUREMENT
/begin MEASUREMENT B_OZER0OK "Bedingung Permittivität beim letztem Ölwechsel endgültig berechnet" UBYTE _CNV_A_R_LINEAR_____10_CM 1 100. 0. 255. ECU_ADDRESS 0x3fb3a7 FORMAT "%3.0" BIT_MASK 0x40 /end MEASUREMENT
/begin MEASUREMENT B_OZERPLT "Bedingung Ausheizzeit erfüllt" UBYTE _CNV_A_R_LINEAR_____10_CM 1 100. 0. 255. ECU_ADDRESS 0x3fb3a7 FORMAT "%3.0" BIT_MASK 0x20 /end MEASUREMENT
/begin MEASUREMENT B_OZREGSTG "Bedingung Schieberegistersteuerung" UBYTE _CNV_A_R_LINEAR_____10_CM 1 100. 0. 255. ECU_ADDRESS 0x3fb3a7 FORMAT "%3.0" BIT_MASK 0x10 /end MEASUREMENT
/begin MEASUREMENT B_OZERANZ "Bedingung für Anzeige Restweg aus Er" UBYTE _CNV_A_R_LINEAR_____10_CM 1 100. 0. 255. ECU_ADDRESS 0x3fb3a7 FORMAT "%3.0" BIT_MASK 0x8 /end MEASUREMENT
/begin MEASUREMENT OZPERMBITS3_1S "???" UBYTE _CNV_A_R_LINEAR_____10_CM 1 100. 0. 255. ECU_ADDRESS 0x3fb3a8 FORMAT "%3.0" /end MEASUREMENT
/begin MEASUREMENT B_OZPER0OK "Bedingung gültiger Start-Permittivitätswert" UBYTE _CNV_A_R_LINEAR_____10_CM 1 100. 0. 255. ECU_ADDRESS 0x3fb3a8 FORMAT "%3.0" BIT_MASK 0x80 /end MEASUREMENT
/begin MEASUREMENT B_CALCDPER "Bedingung für Berechnung Restweg aus Er" UBYTE _CNV_A_R_LINEAR_____10_CM 1 100. 0. 255. ECU_ADDRESS 0x3fb3a8 FORMAT "%3.0" BIT_MASK 0x40 /end MEASUREMENT
/begin MEASUREMENT OZRESTKMBITS_1S "???" UBYTE _CNV_A_R_LINEAR_____10_CM 1 100. 0. 255. ECU_ADDRESS 0x3fb3c0 FORMAT "%3.0" /end MEASUREMENT
/begin MEASUREMENT B_OZCNTINI "Bedingung für Initialisierung Ölzeitzähler" UBYTE _CNV_A_R_LINEAR_____10_CM 1 100. 0. 255. ECU_ADDRESS 0x3fb3c0 FORMAT "%3.0" BIT_MASK 0x80 /end MEASUREMENT
/begin MEASUREMENT B_RWANZ0 "Bedingung für Restweganzeige = NULL" UBYTE _CNV_A_R_LINEAR_____10_CM 1 100. 0. 255. ECU_ADDRESS 0x3fb3c0 FORMAT "%3.0" BIT_MASK 0x40 /end MEASUREMENT
/begin MEASUREMENT N_IDLIBS "" UBYTE _CNV_R_R_igen_ub_q1_483_CM 1 100. 0. 255. ECU_ADDRESS 0x3fc59b FORMAT "%8.4" /end MEASUREMENT
/begin MEASUREMENT UIBS "" UBYTE _CNV_R_R_spg_gencan_69_CM 1 100. 10.6 16.975 ECU_ADDRESS 0x3fc59c FORMAT "%8.4" /end MEASUREMENT
/begin AXIS_PTS ldp_tq_loss_alter_1__tq_alter "" 0x44c04 TQ_LOSS_ALTER_1 _REC_AXS_20_u2 2047.96875 _CNV_A_R_LINEAR_____218_CM 6 -1024. 1023.96875 FORMAT "%6.2" /end AXIS_PTS
/begin AXIS_PTS ldp_n_32__tq_alter "" 0x43625 N_32 _REC_AXS_20_u1 816. _CNV_A_R_LINEAR_____5_CM 6 0. 8160. FORMAT "%4.0" /end AXIS_PTS
/begin AXIS_PTS ldp_iga_dif_av__eff_iga_mon2 "" 0x4342d IGA_DIF_AV_MON2 _REC_AXS_20_u1 -95.625 _CNV_A_R_LINEAR_____203_CM 8 0. -95.625 FORMAT "%6.2" /end AXIS_PTS
/begin AXIS_PTS ldp_maf__iga_ref_mon2 "" 0x43447 MAF_MON2 _REC_AXS_20_u1 1389. _CNV_A_R_LINEAR_____18_CM 8 0. 1389. FORMAT "%4.0" /end AXIS_PTS
/begin AXIS_PTS ldp_maf__tqi_ref_mon2 "" 0x43469 MAF_MON2 _REC_AXS_20_u1 1389. _CNV_A_R_LINEAR_____18_CM 4 0. 1389. FORMAT "%4.0" /end AXIS_PTS
/begin AXIS_PTS ldp_n_32__iga_ref_mon2 "" 0x43534 N_32_MON2 _REC_AXS_20_u1 8160. _CNV_A_R_LINEAR_____5_CM 8 0. 8160. FORMAT "%4.0" /end AXIS_PTS
/begin AXIS_PTS ldp_n_32__tqi_dif_max_mon2 "" 0x4364a N_32_MON2 _REC_AXS_20_u1 8160. _CNV_A_R_LINEAR_____5_CM 4 0. 8160. FORMAT "%4.0" /end AXIS_PTS
/begin AXIS_PTS ldp_n_32__tqi_ref_mon2 "" 0x4364f N_32_MON2 _REC_AXS_20_u1 8160. _CNV_A_R_LINEAR_____5_CM 6 0. 8160. FORMAT "%4.0" /end AXIS_PTS
/begin AXIS_PTS ldp_tqi_sp__tqi_dif_max_mon2 "" 0x43a79 TQI_SP_MON2 _REC_AXS_20_u1 510. _CNV_A_R_LINEAR_____88_CM 4 0. 510. FORMAT "%3.0" /end AXIS_PTS
/begin AXIS_PTS ldp_n_32__fac_tq_req_driv_mon2 "" 0x434ff N_32_MON2 _REC_AXS_20_u1 8160. _CNV_A_R_LINEAR_____5_CM 8 0. 8160. FORMAT "%4.0" /end AXIS_PTS
/begin AXIS_PTS ldp_pv_av__fac_tq_req_driv_mon2 "" 0x4379b PV_AV_MON2 _REC_AXS_20_u1 99.609375 _CNV_A_R_LINEAR_____4_CM 8 0. 99.609375 FORMAT "%5.2" /end AXIS_PTS
/begin AXIS_PTS ldpm_tst_rec_idx_mon2 "" 0x4408f VAL_MO3_TST_REC_IDX_MO2 _REC_AXS_20_u1 9. _CNV_A_R_LINEAR_____10_CM 12 0. 9. FORMAT "%2.0" /end AXIS_PTS
/begin AXIS_PTS ldpm_tst_rec "" 0x44082 VAL_MO3_TST_REC_IDX_MO2 _REC_AXS_20_u1 12. _CNV_A_R_LINEAR_____10_CM 12 0. 12. FORMAT "%3.0" /end AXIS_PTS
/begin AXIS_PTS ldp_lamb_dif__eff_lamb "" 0x44444 LAMB_DIF _REC_AXS_20_u2 63.99902344 _CNV_A_R_LINEAR_____273_CM 16 -32. 31.99902344 FORMAT "%8.4" /end AXIS_PTS
/begin AXIS_PTS ldpm_n_2_9 "" 0x43cbb N _REC_AXS_20_u1 8160. _CNV_A_R_LINEAR_____5_CM 16 0. 8160. FORMAT "%4.0" /end AXIS_PTS
/begin AXIS_PTS ldp_tps_av_id_tps_grd_bol_ae "" 0x44b52 TPS_AV _REC_AXS_20_u2 11.95 _CNV_A_R_LINEAR_____226_CM 4 0. 119.5 FORMAT "%7.3" /end AXIS_PTS
/begin AXIS_PTS ldp_n_32__fac_tq_req_clu_is "" 0x434fb N_32 _REC_AXS_20_u1 8160. _CNV_A_R_LINEAR_____5_CM 3 0. 8160. FORMAT "%4.0" /end AXIS_PTS
/begin AXIS_PTS ldp_tq_accin_can__tq_loss_acc "" 0x43a72 TQ_ACCIN_CAN _REC_AXS_20_u1 31. _CNV_A_R_LINEAR_____84_CM 6 0. 31. FORMAT "%3.0" /end AXIS_PTS
/begin AXIS_PTS ldpm_tia_1 "" 0x4404b TIA _REC_AXS_20_u1 190.5 _CNV_A_R_LINEAR_____0_CM 6 -48. 142.5 FORMAT "%5.1" /end AXIS_PTS
/begin AXIS_PTS ldp_n_32__tq_loss_acc "" 0x43643 N_32 _REC_AXS_20_u1 8160. _CNV_A_R_LINEAR_____5_CM 6 0. 8160. FORMAT "%4.0" /end AXIS_PTS
/begin AXIS_PTS ldp_v_tco__tco "" 0x44d4c V_TCO _REC_AXS_20_u2 4.425292971 _CNV_A_R_LINEAR_____578_CM 16 7.8125e-002 4.99511719 FORMAT "%5.3" /end AXIS_PTS
/begin AXIS_PTS ldpm_ctr_km_can_1 "" 0x44edc CTR_KM_CAN _REC_AXS_20_u2 655350. _CNV_A_R_LINEAR_____80_CM 4 0. 655350. FORMAT "%7.0" /end AXIS_PTS
/begin AXIS_PTS ldp_2_id_err_dtc_mis "" 0x440f0 ID_ERR_DTC_MIS _REC_AXS_20_u2 65535. _CNV_A_R_LINEAR_____10_CM 8 0. 65535. FORMAT "%5.0" /end AXIS_PTS
/begin AXIS_PTS ldp_1_id_err_dtc_mis "" 0x440ea ID_ERR_DTC_MIS _REC_AXS_20_u2 65535. _CNV_A_R_LINEAR_____10_CM 2 0. 65535. FORMAT "%5.0" /end AXIS_PTS
/begin AXIS_PTS ldpm_maf_1_9 "" 0x43c36 MAF_KNK _REC_AXS_20_u1 69.45 _CNV_A_R_LINEAR_____18_CM 4 0. 1389. FORMAT "%4.0" /end AXIS_PTS
/begin AXIS_PTS ldpm_n_32_ip_egr_ratio "" 0x43e49 N_32 _REC_AXS_20_u1 8160. _CNV_A_R_LINEAR_____5_CM 12 0. 8160. FORMAT "%4.0" /end AXIS_PTS
/begin AXIS_PTS ldpm_maf_ip_egr_ratio "" 0x450ea MAF _REC_AXS_20_u2 1389. _CNV_A_R_LINEAR_____95_CM 12 0. 1389. FORMAT "%7.2" /end AXIS_PTS
/begin AXIS_PTS ldpm_tco_1_igsp "" 0x43f4e TCO _REC_AXS_20_u1 190.5 _CNV_A_R_LINEAR_____0_CM 8 -48. 142.5 FORMAT "%5.1" /end AXIS_PTS
/begin AXIS_PTS ldp_n_23 "" 0x434c0 N_32 _REC_AXS_20_u1 816. _CNV_A_R_LINEAR_____5_CM 6 0. 8160. FORMAT "%4.0" /end AXIS_PTS
/begin AXIS_PTS ldpm_n_14 "" 0x45202 N _REC_AXS_20_u2 8160. _CNV_A_R_LINEAR_____17_CM 20 0. 8160. FORMAT "%4.0" /end AXIS_PTS
/begin AXIS_PTS ldpm_maf_2 "" 0x4502a MAF _REC_AXS_20_u2 69.45 _CNV_A_R_LINEAR_____95_CM 16 0. 1389. FORMAT "%7.2" /end AXIS_PTS
/begin AXIS_PTS ldpm_tco_9 "" 0x43f7f TCO _REC_AXS_20_u1 28.575 _CNV_A_R_LINEAR_____0_CM 9 -48. 142.5 FORMAT "%5.1" /end AXIS_PTS
/begin AXIS_PTS ldp_iga_dif_eff_iga "" 0x43436 IGA_DIF_REF _REC_AXS_20_u1 -95.625 _CNV_A_R_LINEAR_____203_CM 16 0. -95.625 FORMAT "%5.1" /end AXIS_PTS
/begin AXIS_PTS ldpm_n_32__tqi_min_pu "" 0x43e0a N_32 _REC_AXS_20_u1 8160. _CNV_A_R_LINEAR_____5_CM 12 0. 8160. FORMAT "%4.0" /end AXIS_PTS
/begin AXIS_PTS ldpm_tco__tqi_min_pu "" 0x43fdb TCO _REC_AXS_20_u1 190.5 _CNV_A_R_LINEAR_____0_CM 4 -48. 142.5 FORMAT "%5.1" /end AXIS_PTS
/begin AXIS_PTS ldpm_teg_cat_up_mdl_1_egcp "" 0x4548c TEG_CAT_UP_MDL _REC_AXS_20_u2 2047. _CNV_A_R_LINEAR_____211_CM 6 0. 2047. FORMAT "%7.2" /end AXIS_PTS
/begin AXIS_PTS ldpm_n_32_1_egcp "" 0x43ce4 N_32 _REC_AXS_20_u1 8160. _CNV_A_R_LINEAR_____5_CM 6 0. 8160. FORMAT "%4.0" /end AXIS_PTS
/begin AXIS_PTS ldpm_maf_cyl_ip_rel_flow_inc_cp "" 0x450bc MAF_CYL _REC_AXS_20_u2 2047.96875 _CNV_A_R_LINEAR_____101_CM 6 0. 2047.96875 FORMAT "%6.2" /end AXIS_PTS
/begin AXIS_PTS ldpm_n_32_ip_rel_flow_max_cps "" 0x43e64 N_32 _REC_AXS_20_u1 8160. _CNV_A_R_LINEAR_____5_CM 12 0. 8160. FORMAT "%4.0" /end AXIS_PTS
/begin AXIS_PTS ldpm_n_32_ip_fuel_dly_cps "" 0x43e56 N_32 _REC_AXS_20_u1 8160. _CNV_A_R_LINEAR_____5_CM 6 0. 8160. FORMAT "%4.0" /end AXIS_PTS
/begin AXIS_PTS ldp_eoi__prs_inc_cmp "" 0x44310 EOI_HOM _REC_AXS_20_u2 36. _CNV_A_R_LINEAR_____75_CM 12 0. 720. FORMAT "%6.2" /end AXIS_PTS
/begin AXIS_PTS ldp_crk_inj__prs_inc_cmp "" 0x44236 CRK_INJ _REC_AXS_20_u2 30. _CNV_A_R_LINEAR_____75_CM 16 0. 600. FORMAT "%5.1" /end AXIS_PTS
/begin AXIS_PTS ldpm_prs_dec_inj__fac_ti_prs "" 0x453ee FUP _REC_AXS_20_u2 173888. _CNV_A_R_LINEAR_____190_CM 12 0. 173888. FORMAT "%6.0" /end AXIS_PTS
/begin AXIS_PTS ldpm_n_32_s "" 0x43e91 N_32 _REC_AXS_20_u1 8160. _CNV_A_R_LINEAR_____5_CM 16 0. 8160. FORMAT "%4.0" /end AXIS_PTS
/begin AXIS_PTS ldp_tps_seg_ar_red_thr "" 0x44bbe TPS_SEG _REC_AXS_20_u2 119.5 _CNV_A_R_LINEAR_____226_CM 16 0. 119.5 /end AXIS_PTS
/begin AXIS_PTS ldpm_pq_estim_id_maf_fac_ofs "" 0x45390 PQ_ESTIM _REC_AXS_20_u2 0.99998474 _CNV_A_R_LINEAR_____31_CM 16 0. 0.99998474 FORMAT "%7.5" /end AXIS_PTS
/begin AXIS_PTS ldpm_n_1_thro "" 0x4523e N _REC_AXS_20_u2 8160. _CNV_A_R_LINEAR_____17_CM 8 0. 8160. FORMAT "%4.0" /end AXIS_PTS
/begin AXIS_PTS ldpm_tco_1_thro "" 0x43f64 TCO _REC_AXS_20_u1 190.5 _CNV_A_R_LINEAR_____0_CM 8 -48. 142.5 FORMAT "%5.1" /end AXIS_PTS
/begin AXIS_PTS ldp_isapwm_mmv "" 0x44422 ISAPWM_MMV _REC_AXS_20_u2 99.99847412 _CNV_A_R_LINEAR_____94_CM 16 0. 99.99847412 /end AXIS_PTS
/begin AXIS_PTS ldpm_tco_st_tco_lam_min "" 0x4403d TCO_ST _REC_AXS_20_u1 190.5 _CNV_A_R_LINEAR_____0_CM 6 -48. 142.5 FORMAT "%5.1" /end AXIS_PTS
/begin AXIS_PTS ldpm_t_vls_cyc_afl_hld "" 0x43f25 T_VLS_CYC_AFL_HLD _REC_AXS_20_u1 2.55 _CNV_A_R_LINEAR_____27_CM 8 0. 2.55 FORMAT "%4.2" /end AXIS_PTS
/begin AXIS_PTS ldp_maf_sub__maf_sub_thd_mon "" 0x402d5 MAF_SUB _REC_AXS_20_u1 1389. _CNV_A_R_LINEAR_____18_CM 2 0. 1389. FORMAT "%4.0" /end AXIS_PTS
/begin AXIS_PTS ldp_tqi_sp_maf__maf_sp "" 0x44ce8 TQI_SP_MAF _REC_AXS_20_u2 1023.96875 _CNV_A_R_LINEAR_____48_CM 12 0. 1023.96875 FORMAT "%7.2" /end AXIS_PTS
/begin AXIS_PTS ldpm_maf_100 "" 0x44fec MAF _REC_AXS_20_u2 1389. _CNV_A_R_LINEAR_____95_CM 12 0. 1389. FORMAT "%7.2" /end AXIS_PTS
/begin AXIS_PTS ldpm_n_32_100 "" 0x43cd3 N_32 _REC_AXS_20_u1 8160. _CNV_A_R_LINEAR_____5_CM 16 0. 8160. FORMAT "%4.0" /end AXIS_PTS
/begin AXIS_PTS ldpm_n_32_3_ivvt "" 0x43d58 N_32 _REC_AXS_20_u1 8160. _CNV_A_R_LINEAR_____5_CM 6 0. 8160. FORMAT "%4.0" /end AXIS_PTS
/begin AXIS_PTS ldpm_n_32_2_ivvt "" 0x43d38 N_32 _REC_AXS_20_u1 8160. _CNV_A_R_LINEAR_____5_CM 8 0. 8160. FORMAT "%4.0" /end AXIS_PTS
/begin AXIS_PTS ldpm_tmag_ivvt_1_ivvt "" 0x4405b TMAG _REC_AXS_20_u1 200. _CNV_A_R_LINEAR_____3_CM 12 -40. 160. FORMAT "%3.0" /end AXIS_PTS
/begin AXIS_PTS ldpm_n_13 "" 0x451f4 N _REC_AXS_20_u2 8160. _CNV_A_R_LINEAR_____17_CM 6 0. 8160. FORMAT "%4.0" /end AXIS_PTS
/begin AXIS_PTS ldpm_n_5 "" 0x45280 N _REC_AXS_20_u2 8160. _CNV_A_R_LINEAR_____17_CM 16 0. 8160. FORMAT "%4.0" /end AXIS_PTS
/begin AXIS_PTS ldpm_maf_ivvt_2 "" 0x45112 MAF _REC_AXS_20_u2 1389. _CNV_A_R_LINEAR_____95_CM 12 0. 1389. FORMAT "%7.2" /end AXIS_PTS
/begin AXIS_PTS ldpm_toil_2_ivvt "" 0x44071 TOIL _REC_AXS_20_u1 200. _CNV_A_R_LINEAR_____3_CM 6 -40. 160. FORMAT "%3.0" /end AXIS_PTS
/begin AXIS_PTS ldpm_n_32_1_ivvt "" 0x43cf4 N_32 _REC_AXS_20_u1 8160. _CNV_A_R_LINEAR_____5_CM 4 0. 8160. FORMAT "%4.0" /end AXIS_PTS
/begin AXIS_PTS ldpm_toil_1_ivvt "" 0x44068 TOIL _REC_AXS_20_u1 200. _CNV_A_R_LINEAR_____3_CM 8 -40. 160. FORMAT "%3.0" /end AXIS_PTS
/begin AXIS_PTS ldpm_maf_teg__teg_stat "" 0x45152 MAF_TEG _REC_AXS_20_u2 1389. _CNV_A_R_LINEAR_____95_CM 8 0. 1389. FORMAT "%7.2" /end AXIS_PTS
/begin AXIS_PTS ldpm_n_teg__teg_stat "" 0x45338 N_TEG _REC_AXS_20_u2 8160. _CNV_A_R_LINEAR_____17_CM 8 0. 8160. FORMAT "%4.0" /end AXIS_PTS
/begin AXIS_PTS ldpm_saf_kgh__fac_cor_saf "" 0x45408 SAF_KGH _REC_AXS_20_u2 1023.984375 _CNV_A_R_LINEAR_____41_CM 6 0. 1023.984375 FORMAT "%7.2" /end AXIS_PTS
/begin MEASUREMENT CKS_CRC_ECU "" ULONG _CNV_A_R_LINEAR_____12_CM 1 100. 0. 4294967295. ECU_ADDRESS 0x3f9850 FORMAT "%11.0" /end MEASUREMENT
/begin MEASUREMENT STATE_IV "" UWORD _CNV_A_R_LINEAR_____10_CM 1 100. 0. 65535. ECU_ADDRESS 0x3fbfc6 FORMAT "%5.0" /end MEASUREMENT
/begin MEASUREMENT B_IDLGSPEC "Bedingung LLR-Anforderung" UBYTE _CNV_A_R_LINEAR_____12_CM 1 100. 0. 255. ECU_ADDRESS 0x3fa473 BIT_MASK 0x1 /end MEASUREMENT
/begin MEASUREMENT B_NOCTRGEN "Bedingung Ladespannungvorgabe ignoriert" UBYTE _CNV_A_R_LINEAR_____12_CM 1 100. 0. 255. ECU_ADDRESS 0x3fb1d5 BIT_MASK 0x1 /end MEASUREMENT
/begin MEASUREMENT TBATT "Batterietemperatur" UBYTE _CNV_R_R_temp_uw_q0_504_CM 1 100. -48. 143.25 ECU_ADDRESS 0x3fb1cb FORMAT "%6.2" /end MEASUREMENT
/begin MEASUREMENT UGENSLP "" UWORD _CNV_R_R_spg_sw_q0p_576_CM 1 100. 0. 16. ECU_ADDRESS 0x3fb1d6 FORMAT "%8.4" /end MEASUREMENT
/begin MEASUREMENT CYL_ID_SAM_TRIG "" UBYTE _CNV_A_R_LINEAR_____588_CM 1 100. 1. 4. ECU_ADDRESS 0x45f10a FORMAT "%1.0" /end MEASUREMENT
/begin AXIS_PTS ldpm_n_h_prs_st "" 0x452fe N_32 _REC_AXS_20_u2 8160. _CNV_A_R_LINEAR_____17_CM 8 0. 8160. FORMAT "%4.0" /end AXIS_PTS
/begin AXIS_PTS ldpm_tco_h_prs "" 0x43fe0 TCO _REC_AXS_20_u1 190.5 _CNV_A_R_LINEAR_____0_CM 6 -48. 142.5 FORMAT "%5.1" /end AXIS_PTS
/begin AXIS_PTS ldpm_n_32__fup_sp "" 0x43db5 N_32 _REC_AXS_20_u1 8160. _CNV_A_R_LINEAR_____5_CM 8 0. 8160. FORMAT "%4.0" /end AXIS_PTS
/begin AXIS_PTS ldpm_n_32__fup_sp_s "" 0x43dbe N_32 _REC_AXS_20_u1 8160. _CNV_A_R_LINEAR_____5_CM 8 0. 8160. FORMAT "%4.0" /end AXIS_PTS
/begin AXIS_PTS ldp_fup_sp__fpapwm_bas "" 0x443e2 FUP_SP _REC_AXS_20_u2 173888. _CNV_A_R_LINEAR_____190_CM 8 0. 173888. FORMAT "%6.0" /end AXIS_PTS
/begin AXIS_PTS ldpm_fup_dif__fpapwm "" 0x44fa6 FUP_DIF _REC_AXS_20_u2 173888. _CNV_A_R_LINEAR_____194_CM 8 -86945.33 86942.67 FORMAT "%9.2" /end AXIS_PTS
/begin AXIS_PTS ldpm_tqi_sp__fup_sp "" 0x455c8 TQI_SP _REC_AXS_20_u2 1023.96875 _CNV_A_R_LINEAR_____48_CM 8 0. 1023.96875 FORMAT "%7.2" /end AXIS_PTS
/begin AXIS_PTS ldpm_fpa_mff__fpapwm "" 0x44f82 FPA_MFF _REC_AXS_20_u2 1511.232 _CNV_A_R_LINEAR_____591_CM 8 0. 1511.232 FORMAT "%7.2" /end AXIS_PTS
/begin AXIS_PTS ldpm_tco__tqi_av_min_er "" 0x43fd4 TCO _REC_AXS_20_u1 190.5 _CNV_A_R_LINEAR_____0_CM 6 -48. 142.5 FORMAT "%5.1" /end AXIS_PTS
/begin AXIS_PTS ldpm_n_32__tqi_av_min_er "" 0x43e03 N_32 _REC_AXS_20_u1 8160. _CNV_A_R_LINEAR_____5_CM 6 0. 8160. FORMAT "%4.0" /end AXIS_PTS
/begin AXIS_PTS ldpm_tqi_av__fac_er "" 0x455b6 TQI_AV _REC_AXS_20_u2 1023.96875 _CNV_A_R_LINEAR_____48_CM 8 0. 1023.96875 FORMAT "%7.2" /end AXIS_PTS
/begin AXIS_PTS ldp_tqi_av__mis_fac_thd_iv_er "" 0x44c6e TQI_AV _REC_AXS_20_u2 1023.96875 _CNV_A_R_LINEAR_____48_CM 6 0. 1023.96875 FORMAT "%7.2" /end AXIS_PTS
/begin AXIS_PTS ldp_id_saf_tab_1 "" 0x4340b INDEX_1 _REC_AXS_20_u1 255. _CNV_A_R_LINEAR_____10_CM 16 0. 255. FORMAT "%3.0" /end AXIS_PTS
/begin AXIS_PTS ldp_id_saf_tab_2 "" 0x4341c INDEX_2 _REC_AXS_20_u1 255. _CNV_A_R_LINEAR_____10_CM 16 0. 255. FORMAT "%3.0" /end AXIS_PTS
/begin AXIS_PTS ldpm_n_32__fac_er "" 0x43da3 N_32 _REC_AXS_20_u1 8160. _CNV_A_R_LINEAR_____5_CM 8 0. 8160. FORMAT "%4.0" /end AXIS_PTS
/begin AXIS_PTS ldpm_n_id_crk_acq "" 0x4532a N _REC_AXS_20_u2 8160. _CNV_A_R_LINEAR_____17_CM 6 0. 8160. FORMAT "%4.0" /end AXIS_PTS
/begin AXIS_PTS ldpm_n_id_cam_acq "" 0x45310 N _REC_AXS_20_u2 8160. _CNV_A_R_LINEAR_____17_CM 12 0. 8160. FORMAT "%4.0" /end AXIS_PTS
/begin AXIS_PTS ldp_n_32__mis_fac_thd_iv_er "" 0x435c3 N_32 _REC_AXS_20_u1 8160. _CNV_A_R_LINEAR_____5_CM 10 0. 8160. FORMAT "%4.0" /end AXIS_PTS
/begin AXIS_PTS ldp_n_32__mis_fac_afs "" 0x435b5 N_32 _REC_AXS_20_u1 8160. _CNV_A_R_LINEAR_____5_CM 6 0. 8160. FORMAT "%4.0" /end AXIS_PTS
/begin AXIS_PTS ldp_n_32__mis_fac_afl "" 0x435ae N_32 _REC_AXS_20_u1 8160. _CNV_A_R_LINEAR_____5_CM 6 0. 8160. FORMAT "%4.0" /end AXIS_PTS
/begin AXIS_PTS ldp_n_32__mis_fac_s "" 0x435bc N_32 _REC_AXS_20_u1 8160. _CNV_A_R_LINEAR_____5_CM 6 0. 8160. FORMAT "%4.0" /end AXIS_PTS
/begin AXIS_PTS ldp_tqi_av__mis_fac_s "" 0x44c60 TQI_AV _REC_AXS_20_u2 2047.96875 _CNV_A_R_LINEAR_____218_CM 6 -1024. 1023.96875 FORMAT "%6.2" /end AXIS_PTS
/begin AXIS_PTS ldp_tqi_av__mis_fac_afl "" 0x44c44 TQI_AV _REC_AXS_20_u2 2047.96875 _CNV_A_R_LINEAR_____218_CM 6 -1024. 1023.96875 FORMAT "%6.2" /end AXIS_PTS
/begin AXIS_PTS ldp_tqi_av__mis_fac_afs "" 0x44c52 TQI_AV _REC_AXS_20_u2 2047.96875 _CNV_A_R_LINEAR_____218_CM 6 -1024. 1023.96875 FORMAT "%6.2" /end AXIS_PTS
/begin AXIS_PTS ldp_vb__fpapwm_fac "" 0x43ab4 VB _REC_AXS_20_u1 25.8984 _CNV_A_R_LINEAR_____26_CM 8 0. 25.8984 FORMAT "%3.1" /end AXIS_PTS
/begin AXIS_PTS ldpm_clas_a_id_clas_fmy "" 0x44eb0 CLAS_ID_CLAS_A_FMY _REC_AXS_20_u2 65535. _CNV_A_R_LINEAR_____10_CM 16 0. 65535. FORMAT "%5.0" /end AXIS_PTS
/begin AXIS_PTS ldp_clas_b_id_clas_fmy "" 0x4422c CLAS_ID_CLAS_B_FMY _REC_AXS_20_u2 65535. _CNV_A_R_LINEAR_____10_CM 4 0. 65535. FORMAT "%5.0" /end AXIS_PTS
/begin AXIS_PTS ldp_n_32__iga_ref_port "" 0x4353d N_32 _REC_AXS_20_u1 8160. _CNV_A_R_LINEAR_____5_CM 8 0. 8160. FORMAT "%4.0" /end AXIS_PTS
/begin AXIS_PTS ldpm_maf_cyl_ip_rel_flow_max_cp "" 0x43c44 MAF_CYL _REC_AXS_20_u1 1389. _CNV_A_R_LINEAR_____18_CM 12 0. 1389. FORMAT "%4.0" /end AXIS_PTS
/begin AXIS_PTS ldpm_n_32_ip_rel_flow_cps_s "" 0x43e5d N_32 _REC_AXS_20_u1 8160. _CNV_A_R_LINEAR_____5_CM 6 0. 8160. FORMAT "%4.0" /end AXIS_PTS
/begin AXIS_PTS ldpm_maf_ip_rel_flow_cps_s "" 0x43c8c MAF _REC_AXS_20_u1 69.45 _CNV_A_R_LINEAR_____18_CM 6 0. 1389. FORMAT "%4.0" /end AXIS_PTS
/begin AXIS_PTS ldpm_tqi_sp_s_cp "" 0x455f4 TQI_SP _REC_AXS_20_u2 1023.96875 _CNV_A_R_LINEAR_____48_CM 12 0. 1023.96875 FORMAT "%7.2" /end AXIS_PTS
/begin AXIS_PTS ldpm_frq_req_cp "" 0x43ba5 FRQ_REQ_CP _REC_AXS_20_u1 255. _CNV_A_R_LINEAR_____115_CM 4 0. 255. FORMAT "%3.0" /end AXIS_PTS
/begin AXIS_PTS ldpm_maf_cyl_ip_ti_lam_cor_crlc "" 0x450ca MAF_CYL _REC_AXS_20_u2 2047.96875 _CNV_A_R_LINEAR_____101_CM 6 0. 2047.96875 FORMAT "%6.2" /end AXIS_PTS
/begin AXIS_PTS ldp_cl_mmv_ip_rel_flow_fac_cp "" 0x44210 CL_MMV _REC_AXS_20_u2 7.99987793 _CNV_A_R_LINEAR_____348_CM 6 0. 7.99987793 FORMAT "%6.4" /end AXIS_PTS
/begin AXIS_PTS ldp_n_32__pvs_dec_cru "" 0x43601 N_32 _REC_AXS_20_u1 816. _CNV_A_R_LINEAR_____5_CM 5 0. 8160. FORMAT "%4.0" /end AXIS_PTS
/begin AXIS_PTS ldp_n_32__iga_egr_afl "" 0x43522 N_32 _REC_AXS_20_u1 8160. _CNV_A_R_LINEAR_____5_CM 5 0. 8160. FORMAT "%4.0" /end AXIS_PTS
/begin AXIS_PTS ldp_lamb_sp_ip_fac_lamb_egr "" 0x4448a LAMB_SP _REC_AXS_20_u2 31.99902344 _CNV_A_R_LINEAR_____148_CM 6 0. 31.99902344 FORMAT "%7.4" /end AXIS_PTS
/begin AXIS_PTS ldp_n_32__iga_egr_afr "" 0x43528 N_32 _REC_AXS_20_u1 8160. _CNV_A_R_LINEAR_____5_CM 5 0. 8160. FORMAT "%4.0" /end AXIS_PTS
/begin AXIS_PTS ldp_fmy_dtc "" 0x443b4 DTC _REC_AXS_20_u2 5. _CNV_A_R_LINEAR_____12_CM 6 0. 5. FORMAT "%2.0" /end AXIS_PTS
/begin AXIS_PTS ldp_fmy_envd "" 0x433ac ENVD _REC_AXS_20_u1 3. _CNV_A_R_LINEAR_____12_CM 4 0. 3. FORMAT "%2.0" /end AXIS_PTS
/begin AXIS_PTS ldp_n_32__crlc_eff_vol_cor "" 0x434c7 N_32 _REC_AXS_20_u1 8160. _CNV_A_R_LINEAR_____5_CM 6 0. 8160. FORMAT "%4.0" /end AXIS_PTS
/begin AXIS_PTS ldp_n_32__maf_sp_isa "" 0x4359d N_32 _REC_AXS_20_u1 816. _CNV_A_R_LINEAR_____5_CM 16 0. 8160. FORMAT "%4.0" /end AXIS_PTS
/begin AXIS_PTS ldp_teg_dyn__v_efc_lsh_up_ctl "" 0x44ab6 TEG_DYN _REC_AXS_20_u2 2047. _CNV_A_R_LINEAR_____211_CM 6 0. 2047. FORMAT "%7.2" /end AXIS_PTS
/begin AXIS_PTS ldpm_n_35 "" 0x43ea2 N_32 _REC_AXS_20_u1 8160. _CNV_A_R_LINEAR_____5_CM 6 0. 8160. FORMAT "%4.0" /end AXIS_PTS
/begin AXIS_PTS ldp_cat_diag "" 0x4337c CAT_DIAG _REC_AXS_20_u1 1.9968 _CNV_A_R_LINEAR_____314_CM 6 0. 1.9968 FORMAT "%4.2" /end AXIS_PTS
/begin AXIS_PTS ldpm_temp_main_cat "" 0x4555e TEMP_MAIN_CAT _REC_AXS_20_u2 1023.984375 _CNV_A_R_LINEAR_____305_CM 6 -33. 990.984375 FORMAT "%6.2" /end AXIS_PTS
/begin AXIS_PTS ldpm_n_110 "" 0x43ca5 N_32 _REC_AXS_20_u1 8160. _CNV_A_R_LINEAR_____5_CM 8 0. 8160. FORMAT "%4.0" /end AXIS_PTS
/begin AXIS_PTS ldpm_gr_tra_at_2 "" 0x43c25 GR_AT _REC_AXS_20_u1 255. _CNV_A_R_LINEAR_____10_CM 7 0. 255. FORMAT "%3.0" /end AXIS_PTS
/begin AXIS_PTS ldpm_gr_tra_mt_2 "" 0x43c2d GR_MT _REC_AXS_20_u1 255. _CNV_A_R_LINEAR_____10_CM 8 0. 255. FORMAT "%3.0" /end AXIS_PTS
/begin AXIS_PTS ldp_toil_t_ramp_conv_pos "" 0x43a59 TOIL _REC_AXS_20_u1 200. _CNV_A_R_LINEAR_____3_CM 8 -40. 160. FORMAT "%3.0" /end AXIS_PTS
/begin AXIS_PTS ldp_toil_t_ramp_conv_neg "" 0x43a50 TOIL _REC_AXS_20_u1 200. _CNV_A_R_LINEAR_____3_CM 8 -40. 160. FORMAT "%3.0" /end AXIS_PTS
/begin AXIS_PTS ldpm_toil_3_ivvt "" 0x44078 TOIL _REC_AXS_20_u1 203. _CNV_A_R_LINEAR_____592_CM 4 -48. 155. FORMAT "%5.1" /end AXIS_PTS
/begin AXIS_PTS ldpm_toil_4_ivvt "" 0x4407d TOIL _REC_AXS_20_u1 203. _CNV_A_R_LINEAR_____592_CM 4 -48. 155. FORMAT "%5.1" /end AXIS_PTS
/begin AXIS_PTS ldpm_vo__teg_stat "" 0x440c4 VO _REC_AXS_20_u1 95.625 _CNV_A_R_LINEAR_____75_CM 6 0. 95.625 FORMAT "%5.2" /end AXIS_PTS
/begin AXIS_PTS ldpm_pow_dif__fac_cor "" 0x45366 POW_DIF _REC_AXS_20_u2 434.0555000000001 _CNV_A_R_LINEAR_____423_CM 6 0. 434.0555 FORMAT "%7.3" /end AXIS_PTS
/begin AXIS_PTS ldpm_vb__td "" 0x4560e VB _REC_AXS_20_u2 28.7055 _CNV_A_R_LINEAR_____210_CM 8 0. 28.7055 FORMAT "%5.2" /end AXIS_PTS
/begin COMPU_METHOD _CNV_A_R_LINEAR_____0_CM "" RAT_FUNC "%6.3" "°C" COEFFS 0 1.333333333333333 64. 0 0 1 /end COMPU_METHOD
/begin COMPU_METHOD _CNV_A_R_LINEAR_____1_CM "" RAT_FUNC "%6.3" "°C" COEFFS 0 1.333333333333333 0. 0 0 1 /end COMPU_METHOD
/begin COMPU_METHOD _CNV_A_R_LINEAR_____3_CM "" RAT_FUNC "%6.3" "°C" COEFFS 0 1. 40. 0 0 1 /end COMPU_METHOD
/begin COMPU_METHOD _CNV_A_R_LINEAR_____4_CM "" RAT_FUNC "%6.3" "%" COEFFS 0 2.56 0. 0 0 1 /end COMPU_METHOD
/begin COMPU_METHOD _CNV_A_R_LINEAR_____5_CM "" RAT_FUNC "%6.3" "rpm" COEFFS 0 3.125e-002 0. 0 0 1 /end COMPU_METHOD
/begin COMPU_METHOD _CNV_A_R_LINEAR_____10_CM "" RAT_FUNC "%6.3" "-" COEFFS 0 1. 0. 0 0 1 /end COMPU_METHOD
/begin COMPU_METHOD _CNV_S_2_RANGE______11_CM "" TAB_VERB "%6.3" "-" COMPU_TAB_REF _CNV_S_2_RANGE______11 /end COMPU_METHOD
/begin COMPU_VTAB _CNV_S_2_RANGE______11 "" TAB_VERB 2 0 "0" 1 "1" /end COMPU_VTAB
/begin COMPU_METHOD _CNV_A_R_LINEAR_____12_CM "" RAT_FUNC "%6.3" "[-]" COEFFS 0 1. 0. 0 0 1 /end COMPU_METHOD
/begin COMPU_METHOD _CNV_A_R_LINEAR_____13_CM "" RAT_FUNC "%6.3" "km/h" COEFFS 0 1. 0. 0 0 1 /end COMPU_METHOD
/begin COMPU_METHOD _CNV_A_R_LINEAR_____14_CM "" RAT_FUNC "%6.3" "s" COEFFS 0 10. 0. 0 0 1 /end COMPU_METHOD
/begin COMPU_METHOD _CNV_A_R_LINEAR_____17_CM "" RAT_FUNC "%6.3" "rpm" COEFFS 0 1. 0. 0 0 1 /end COMPU_METHOD
/begin COMPU_METHOD _CNV_A_R_LINEAR_____18_CM "" RAT_FUNC "%6.3" "mg/stk" COEFFS 0 0.183585313174946 0. 0 0 1 /end COMPU_METHOD
/begin COMPU_METHOD _CNV_A_R_LINEAR_____20_CM "" RAT_FUNC "%6.3" "-" COEFFS 0 255.9983911655618 0. 0 0 1 /end COMPU_METHOD
/begin COMPU_METHOD _CNV_S_2_RANGE______21_R_CM "" TAB_VERB "%6.3" "[-]" COMPU_TAB_REF _CNV_S_2_RANGE______21_R /end COMPU_METHOD
/begin COMPU_VTAB_RANGE _CNV_S_2_RANGE______21_R "" 2 0 0 "0" 1 255 "1" /end COMPU_VTAB_RANGE
/begin COMPU_METHOD _CNV_A_R_LINEAR_____23_CM "" RAT_FUNC "%6.3" "ms" COEFFS 0 0.1 0. 0 0 1 /end COMPU_METHOD
/begin COMPU_METHOD _CNV_A_R_LINEAR_____26_CM "" RAT_FUNC "%6.3" "V" COEFFS 0 9.846168103048838 0. 0 0 1 /end COMPU_METHOD
/begin COMPU_METHOD _CNV_A_R_LINEAR_____27_CM "" RAT_FUNC "%6.3" "s" COEFFS 0 100. 0. 0 0 1 /end COMPU_METHOD
/begin COMPU_METHOD _CNV_S_2_RANGE______28_CM "" TAB_VERB "%6.3" "[-]" COMPU_TAB_REF _CNV_S_2_RANGE______28 /end COMPU_METHOD
/begin COMPU_VTAB _CNV_S_2_RANGE______28 "" TAB_VERB 2 0 "0" 1 "1" /end COMPU_VTAB
/begin COMPU_METHOD _CNV_A_R_LINEAR_____31_CM "" RAT_FUNC "%6.3" "-" COEFFS 0 65536.00007936121 0. 0 0 1 /end COMPU_METHOD
/begin COMPU_METHOD _CNV_A_R_LINEAR_____33_CM "" RAT_FUNC "%6.3" "V" COEFFS 0 204.7999998974999 0. 0 0 1 /end COMPU_METHOD
/begin COMPU_METHOD _CNV_A_R_LINEAR_____35_CM "" RAT_FUNC "%6.3" "min" COEFFS 0 1. 0. 0 0 1 /end COMPU_METHOD
/begin COMPU_METHOD _CNV_A_R_LINEAR_____38_CM "" RAT_FUNC "%6.3" "V" COEFFS 0 51.0204081632653 0. 0 0 1 /end COMPU_METHOD
/begin COMPU_METHOD _CNV_A_R_LINEAR_____40_CM "" RAT_FUNC "%6.3" "-" COEFFS 0 16. 0. 0 0 1 /end COMPU_METHOD
/begin COMPU_METHOD _CNV_A_R_LINEAR_____41_CM "" RAT_FUNC "%6.3" "kg/h" COEFFS 0 64. 0. 0 0 1 /end COMPU_METHOD
/begin COMPU_METHOD _CNV_A_R_LINEAR_____43_CM "" RAT_FUNC "%6.3" "hPa" COEFFS 0 12.06017666543982 0. 0 0 1 /end COMPU_METHOD
/begin COMPU_METHOD _CNV_A_R_LINEAR_____44_CM "" RAT_FUNC "%6.3" "[-]" COEFFS 0 255.9999357490357 0. 0 0 1 /end COMPU_METHOD
/begin COMPU_METHOD _CNV_A_R_LINEAR_____45_CM "" RAT_FUNC "%6.3" "-" COEFFS 0 32768.00003968061 0. 0 0 1 /end COMPU_METHOD
/begin COMPU_METHOD _CNV_A_R_LINEAR_____48_CM "" RAT_FUNC "%6.3" "Nm" COEFFS 0 32. 0. 0 0 1 /end COMPU_METHOD
/begin COMPU_METHOD _CNV_A_R_LINEAR_____53_CM "" RAT_FUNC "%6.3" "V" COEFFS 0 9.807692307692308 0. 0 0 1 /end COMPU_METHOD
/begin COMPU_METHOD _CNV_R_R_spg_gencan_69_CM "" RAT_FUNC "%6.3" "V" COEFFS 0. 40. -424. 0. 0. 1. /end COMPU_METHOD
/begin COMPU_METHOD _CNV_A_R_LINEAR_____75_CM "" RAT_FUNC "%6.3" "°CRK" COEFFS 0 2.666666666666667 0. 0 0 1 /end COMPU_METHOD
/begin COMPU_METHOD _CNV_A_R_LINEAR_____78_CM "" RAT_FUNC "%6.3" "km/h" COEFFS 0 128.0000018750286 0. 0 0 1 /end COMPU_METHOD
/begin COMPU_METHOD _CNV_A_R_LINEAR_____80_CM "" RAT_FUNC "%6.3" "km" COEFFS 0 0.1 0. 0 0 1 /end COMPU_METHOD
/begin COMPU_METHOD _CNV_A_R_LINEAR_____84_CM "" RAT_FUNC "%6.3" "Nm" COEFFS 0 1. 0. 0 0 1 /end COMPU_METHOD
/begin COMPU_METHOD _CNV_A_R_LINEAR_____85_CM "" RAT_FUNC "%6.3" "l" COEFFS 0 1. 0. 0 0 1 /end COMPU_METHOD
/begin COMPU_METHOD _CNV_A_R_LINEAR_____88_CM "" RAT_FUNC "%6.3" "Nm" COEFFS 0 0.5 0. 0 0 1 /end COMPU_METHOD
/begin COMPU_METHOD _CNV_A_R_LINEAR_____94_CM "" RAT_FUNC "%6.3" "%" COEFFS 0 655.3600000071681 0. 0 0 1 /end COMPU_METHOD
/begin COMPU_METHOD _CNV_A_R_LINEAR_____95_CM "" RAT_FUNC "%6.3" "mg/stk" COEFFS 0 47.18142548596112 0. 0 0 1 /end COMPU_METHOD
/begin COMPU_METHOD _CNV_A_R_LINEAR_____99_CM "" RAT_FUNC "%6.3" "kg/h" COEFFS 0 8191.999999679995 0. 0 0 1 /end COMPU_METHOD
/begin COMPU_METHOD _CNV_A_R_LINEAR_____101_CM "" RAT_FUNC "%6.3" "kg/h" COEFFS 0 32. 0. 0 0 1 /end COMPU_METHOD
/begin COMPU_METHOD _CNV_A_R_LINEAR_____102_CM "" RAT_FUNC "%6.3" "hPa" COEFFS 0 12.06017666543982 32767.5 0 0 1 /end COMPU_METHOD
/begin COMPU_METHOD _CNV_A_R_LINEAR_____108_CM "" RAT_FUNC "%6.3" "[-]" COEFFS 0 32769.4989394353 0. 0 0 1 /end COMPU_METHOD
/begin COMPU_METHOD _CNV_A_R_LINEAR_____115_CM "" RAT_FUNC "%6.3" "Hz" COEFFS 0 1. 0. 0 0 1 /end COMPU_METHOD
/begin COMPU_METHOD _CNV_A_R_LINEAR_____117_CM "" RAT_FUNC "%6.3" "%" COEFFS 0 2.56 128. 0 0 1 /end COMPU_METHOD
/begin COMPU_METHOD _CNV_A_R_LINEAR_____132_CM "" RAT_FUNC "%6.3" "km/h" COEFFS 0 128. 32768. 0 0 1 /end COMPU_METHOD
/begin COMPU_METHOD _CNV_A_R_LINEAR_____136_CM "" RAT_FUNC "%6.3" "%" COEFFS 0 2084.478388983038 32768.00027481336 0 0 1 /end COMPU_METHOD
/begin COMPU_METHOD _CNV_A_R_LINEAR_____141_CM "" RAT_FUNC "%6.3" "-" COEFFS 0 64. 0. 0 0 1 /end COMPU_METHOD
/begin COMPU_METHOD _CNV_A_R_LINEAR_____143_CM "" RAT_FUNC "%6.3" "%" COEFFS 0 655.3600000071681 32768.00000035841 0 0 1 /end COMPU_METHOD
/begin COMPU_METHOD _CNV_A_R_LINEAR_____147_CM "" RAT_FUNC "%6.3" "V" COEFFS 0 51400. 32767.5 0 0 1 /end COMPU_METHOD
/begin COMPU_METHOD _CNV_A_R_LINEAR_____148_CM "" RAT_FUNC "%6.3" "-" COEFFS 0 1023.999999919998 0. 0 0 1 /end COMPU_METHOD
/begin COMPU_METHOD _CNV_A_R_LINEAR_____151_CM "" RAT_FUNC "%6.3" "mA" COEFFS 0 163.8375 0. 0 0 1 /end COMPU_METHOD
/begin COMPU_METHOD _CNV_A_R_LINEAR_____156_CM "" RAT_FUNC "%6.3" "V" COEFFS 0 2510.769230769231 0. 0 0 1 /end COMPU_METHOD
/begin COMPU_METHOD _CNV_A_R_LINEAR_____160_CM "" RAT_FUNC "%6.3" "°C" COEFFS 0 0.25 8.25 0 0 1 /end COMPU_METHOD
/begin COMPU_METHOD _CNV_A_R_LINEAR_____171_CM "" RAT_FUNC "%6.3" "cm²" COEFFS 0 1118.481084425738 0. 0 0 1 /end COMPU_METHOD
/begin COMPU_METHOD _CNV_A_R_LINEAR_____172_CM "" RAT_FUNC "%6.3" "%" COEFFS 0 327.6800000071683 0. 0 0 1 /end COMPU_METHOD
/begin COMPU_METHOD _CNV_A_R_LINEAR_____175_CM "" RAT_FUNC "%6.3" "1/s^2" COEFFS 0 100.5832246182181 32768.00291612309 0 0 1 /end COMPU_METHOD
/begin COMPU_METHOD _CNV_A_R_LINEAR_____178_CM "" RAT_FUNC "%6.3" "Seg" COEFFS 0 1. 0. 0 0 1 /end COMPU_METHOD
/begin COMPU_METHOD _CNV_A_R_LINEAR_____190_CM "" RAT_FUNC "%6.3" "hPa" COEFFS 0 0.3768805207949945 0. 0 0 1 /end COMPU_METHOD
/begin COMPU_METHOD _CNV_A_R_LINEAR_____192_CM "" RAT_FUNC "%6.3" "g/s" COEFFS 0 43.36306609142162 0. 0 0 1 /end COMPU_METHOD
/begin COMPU_METHOD _CNV_A_R_LINEAR_____194_CM "" RAT_FUNC "%6.3" "hPa" COEFFS 0 0.3768805207949945 32768.00125109265 0 0 1 /end COMPU_METHOD
/begin COMPU_METHOD _CNV_A_R_LINEAR_____195_CM "" RAT_FUNC "%6.3" "[-]" COEFFS 0 64. 0. 0 0 1 /end COMPU_METHOD
/begin COMPU_METHOD _CNV_A_R_LINEAR_____203_CM "" RAT_FUNC "%6.3" "°CRK" COEFFS 0 -2.666666666666667 0. 0 0 1 /end COMPU_METHOD
/begin COMPU_METHOD _CNV_A_R_LINEAR_____205_CM "" RAT_FUNC "%6.3" "-" COEFFS 0 655.3600000071681 0. 0 0 1 /end COMPU_METHOD
/begin COMPU_METHOD _CNV_A_R_LINEAR_____207_CM "" RAT_FUNC "%6.3" "°PORT" COEFFS 0 655.3600000071681 0. 0 0 1 /end COMPU_METHOD
/begin COMPU_METHOD _CNV_A_R_LINEAR_____208_CM "" RAT_FUNC "%6.3" "ms" COEFFS 0 250. 0. 0 0 1 /end COMPU_METHOD
/begin COMPU_METHOD _CNV_A_R_LINEAR_____210_CM "" RAT_FUNC "%6.3" "V" COEFFS 0 35.63776976537597 0. 0 0 1 /end COMPU_METHOD
/begin COMPU_METHOD _CNV_A_R_LINEAR_____211_CM "" RAT_FUNC "%6.3" "°C" COEFFS 0 16. 0. 0 0 1 /end COMPU_METHOD
/begin COMPU_METHOD _CNV_A_R_LINEAR_____213_CM "" RAT_FUNC "%6.3" "rpm" COEFFS 0 1. 32768. 0 0 1 /end COMPU_METHOD
/begin COMPU_METHOD _CNV_A_R_LINEAR_____218_CM "" RAT_FUNC "%6.3" "Nm" COEFFS 0 32. 32768. 0 0 1 /end COMPU_METHOD
/begin COMPU_METHOD _CNV_A_R_LINEAR_____219_CM "" RAT_FUNC "%6.3" "rpm/s" COEFFS 0 3.125e-002 128. 0 0 1 /end COMPU_METHOD
/begin COMPU_METHOD _CNV_A_R_LINEAR_____226_CM "" RAT_FUNC "%6.3" "°TPS" COEFFS 0 137.0962343096234 0. 0 0 1 /end COMPU_METHOD
/begin COMPU_METHOD _CNV_A_R_LINEAR_____231_CM "" RAT_FUNC "%6.3" "°CRK" COEFFS 0 -2.666666666666667 -106.6666666666667 0 0 1 /end COMPU_METHOD
/begin COMPU_METHOD _CNV_A_R_LINEAR_____234_CM "" RAT_FUNC "%6.3" "°CRK" COEFFS 0 2.666666666666667 -160. 0 0 1 /end COMPU_METHOD
/begin COMPU_METHOD _CNV_A_R_LINEAR_____239_CM "" RAT_FUNC "%6.3" "ms" COEFFS 0 1.6 0. 0 0 1 /end COMPU_METHOD
/begin COMPU_METHOD _CNV_A_R_LINEAR_____247_CM "" RAT_FUNC "%6.3" "°CRK/s" COEFFS 0 2.666666666666667 0. 0 0 1 /end COMPU_METHOD
/begin COMPU_METHOD _CNV_A_R_LINEAR_____248_CM "" RAT_FUNC "%6.3" "µs" COEFFS 0 0.25 0. 0 0 1 /end COMPU_METHOD
/begin COMPU_METHOD _CNV_A_R_LINEAR_____251_CM "" RAT_FUNC "%6.3" "°CRK" COEFFS 0 2.666666666666667 160. 0 0 1 /end COMPU_METHOD
/begin COMPU_METHOD _CNV_A_R_LINEAR_____252_CM "" RAT_FUNC "%6.3" "ms" COEFFS 0 1. 0. 0 0 1 /end COMPU_METHOD
/begin COMPU_METHOD _CNV_A_R_LINEAR_____253_CM "" RAT_FUNC "%6.3" "-" COEFFS 0 255.9999357490357 0. 0 0 1 /end COMPU_METHOD
/begin COMPU_METHOD _CNV_A_R_LINEAR_____256_CM "" RAT_FUNC "%6.3" "V" COEFFS 0 13107.19998965744 0. 0 0 1 /end COMPU_METHOD
/begin COMPU_METHOD _CNV_A_R_LINEAR_____269_CM "" RAT_FUNC "%6.3" "°C" COEFFS 0 43.47840509520334 2086.96344456976 0 0 1 /end COMPU_METHOD
/begin COMPU_METHOD _CNV_A_R_LINEAR_____270_CM "" RAT_FUNC "%6.3" "mg/stk" COEFFS 0 47.14849960790521 32768.20722749412 0 0 1 /end COMPU_METHOD
/begin COMPU_METHOD _CNV_A_R_LINEAR_____273_CM "" RAT_FUNC "%6.3" "[-]" COEFFS 0 1023.999999959999 32767.99999871998 0 0 1 /end COMPU_METHOD
/begin COMPU_METHOD _CNV_A_R_LINEAR_____275_CM "" RAT_FUNC "%6.3" "s" COEFFS 0 2. 0. 0 0 1 /end COMPU_METHOD
/begin COMPU_METHOD _CNV_A_R_LINEAR_____277_CM "" RAT_FUNC "%6.3" "g" COEFFS 0 36.00036915004301 0. 0 0 1 /end COMPU_METHOD
/begin COMPU_METHOD _CNV_A_R_LINEAR_____281_CM "" RAT_FUNC "%6.3" "V" COEFFS 0 13107. 0. 0 0 1 /end COMPU_METHOD
/begin COMPU_METHOD _CNV_A_R_LINEAR_____282_CM "" RAT_FUNC "%6.3" "V/10ms" COEFFS 0 13107.26214524291 0.1553631072602002 0 0 1 /end COMPU_METHOD
/begin COMPU_METHOD _CNV_A_R_LINEAR_____283_CM "" RAT_FUNC "%6.3" "V/10ms" COEFFS 0 13107.20001587224 0. 0 0 1 /end COMPU_METHOD
/begin COMPU_METHOD _CNV_A_R_LINEAR_____285_CM "" RAT_FUNC "%6.3" "ohm" COEFFS 0 1. 0. 0 0 1 /end COMPU_METHOD
/begin COMPU_METHOD _CNV_A_R_LINEAR_____290_CM "" RAT_FUNC "%6.3" "kg/h" COEFFS 0 128.0000018750286 0. 0 0 1 /end COMPU_METHOD
/begin COMPU_METHOD _CNV_A_R_LINEAR_____305_CM "" RAT_FUNC "%6.3" "°C" COEFFS 0 64. 2112. 0 0 1 /end COMPU_METHOD
/begin COMPU_METHOD _CNV_A_R_LINEAR_____309_CM "" RAT_FUNC "%6.3" "mg" COEFFS 0 6.25 0. 0 0 1 /end COMPU_METHOD
/begin COMPU_METHOD _CNV_A_R_LINEAR_____313_CM "" RAT_FUNC "%6.3" "V" COEFFS 0 204.8979314017341 1023.5 0 0 1 /end COMPU_METHOD
/begin COMPU_METHOD _CNV_A_R_LINEAR_____314_CM "" RAT_FUNC "%6.3" "-" COEFFS 0 63.60176282051283 0. 0 0 1 /end COMPU_METHOD
/begin COMPU_METHOD _CNV_A_R_LINEAR_____326_CM "" RAT_FUNC "%6.3" "°C" COEFFS 0 15.99999804684544 32767.99599993945 0 0 1 /end COMPU_METHOD
/begin COMPU_METHOD _CNV_A_R_LINEAR_____348_CM "" RAT_FUNC "%6.3" "-" COEFFS 0 8191.999999679995 0. 0 0 1 /end COMPU_METHOD
/begin COMPU_METHOD _CNV_A_R_LINEAR_____350_CM "" RAT_FUNC "%6.3" "°CRK" COEFFS 0 42.66666666666666 32768. 0 0 1 /end COMPU_METHOD
/begin COMPU_METHOD _CNV_A_R_LINEAR_____352_CM "" RAT_FUNC "%6.3" "%" COEFFS 0 327.6800790412251 0. 0 0 1 /end COMPU_METHOD
/begin COMPU_METHOD _CNV_A_R_LINEAR_____354_CM "" RAT_FUNC "%6.3" "mg/stk" COEFFS 0 47.18142548596112 32767.5 0 0 1 /end COMPU_METHOD
/begin COMPU_METHOD _CNV_A_R_LINEAR_____357_CM "" RAT_FUNC "%6.3" "°TPS" COEFFS 0 2.133891213389121 0. 0 0 1 /end COMPU_METHOD
/begin COMPU_METHOD _CNV_A_R_LINEAR_____358_CM "" RAT_FUNC "%6.3" "V" COEFFS 0 204.8 0. 0 0 1 /end COMPU_METHOD
/begin COMPU_METHOD _CNV_A_R_LINEAR_____361_CM "" RAT_FUNC "%6.3" "°TPS" COEFFS 0 137.0962343096234 16383. 0 0 1 /end COMPU_METHOD
/begin COMPU_METHOD _CNV_A_R_LINEAR_____368_CM "" RAT_FUNC "%6.3" "%" COEFFS 0 327.67 0. 0 0 1 /end COMPU_METHOD
/begin COMPU_METHOD _CNV_A_R_LINEAR_____378_CM "" RAT_FUNC "%6.3" "rpm" COEFFS 0 3.125e-002 128. 0 0 1 /end COMPU_METHOD
/begin COMPU_METHOD _CNV_A_R_LINEAR_____385_CM "" RAT_FUNC "%6.3" "[-]" COEFFS 0 1.525855623540901e-005 0. 0 0 1 /end COMPU_METHOD
/begin COMPU_METHOD _CNV_A_R_LINEAR_____387_CM "" RAT_FUNC "%6.3" "mm" COEFFS 0 1000. 0. 0 0 1 /end COMPU_METHOD
/begin COMPU_METHOD _CNV_A_R_LINEAR_____411_CM "" RAT_FUNC "%6.3" "-" COEFFS 0 2. 0. 0 0 1 /end COMPU_METHOD
/begin COMPU_METHOD _CNV_A_R_LINEAR_____420_CM "" RAT_FUNC "%6.3" "°C" COEFFS 0 1.262376237623762 255. 0 0 1 /end COMPU_METHOD
/begin COMPU_METHOD _CNV_A_R_LINEAR_____421_CM "" RAT_FUNC "%6.3" "°C" COEFFS 0 1.331683168316832 269. 0 0 1 /end COMPU_METHOD
/begin COMPU_METHOD _CNV_A_R_LINEAR_____423_CM "" RAT_FUNC "%6.3" "KW" COEFFS 0 149.2228528379436 0. 0 0 1 /end COMPU_METHOD
/begin COMPU_METHOD _CNV_A_R_LINEAR_____424_CM "" RAT_FUNC "%6.3" "°CRK" COEFFS 0 2.666666666666667 255. 0 0 1 /end COMPU_METHOD
/begin COMPU_METHOD _CNV_A_R_LINEAR_____429_CM "" RAT_FUNC "%6.3" "°C" COEFFS 0 1.264851485148515 255.5 0 0 1 /end COMPU_METHOD
/begin COMPU_METHOD _CNV_A_R_LINEAR_____437_CM "" RAT_FUNC "%6.3" "V" COEFFS 0 51.2 0. 0 0 1 /end COMPU_METHOD
/begin COMPU_METHOD _CNV_A_R_LINEAR_____440_CM "" RAT_FUNC "%6.3" "°TPS" COEFFS 0 548.4100418410042 0. 0 0 1 /end COMPU_METHOD
/begin COMPU_METHOD _CNV_A_R_LINEAR_____451_CM "" RAT_FUNC "%6.3" "m/s²" COEFFS 0 640.2931118710308 32768. 0 0 1 /end COMPU_METHOD
/begin COMPU_METHOD _CNV_A_R_LINEAR_____465_CM "" RAT_FUNC "%6.3" "°STW" COEFFS 0 22.8564453125 32768. 0 0 1 /end COMPU_METHOD
/begin COMPU_METHOD _CNV_A_R_LINEAR_____466_CM "" RAT_FUNC "%6.3" "°STW/s" COEFFS 0 22.8564453125 32768. 0 0 1 /end COMPU_METHOD
/begin COMPU_METHOD _CNV_R_R_igen_ub_q1_483_CM "" RAT_FUNC "%6.3" "[-]" COEFFS 0. 1. 0. 0. 0. 1. /end COMPU_METHOD
/begin COMPU_METHOD _CNV_R_R_temp_uw_q0_504_CM "" RAT_FUNC "%6.3" "Grad C" COEFFS 0. 1. 48. 0. 0. 0.75 /end COMPU_METHOD
/begin COMPU_METHOD _CNV_R_R_fak_q0p003_514_CM "" RAT_FUNC "%6.3" "[-]" COEFFS 0. 256. 0. 0. 0. 1. /end COMPU_METHOD
/begin COMPU_METHOD _CNV_R_R_spg_sw_q0p_576_CM "" RAT_FUNC "%6.3" "V" COEFFS 0. 1000. 0. 0. 0. 1. /end COMPU_METHOD
/begin COMPU_METHOD _CNV_A_R_LINEAR_____578_CM "" RAT_FUNC "%6.3" "V" COEFFS 0 204.7999998958713 8.135057072422569e-009 0 0 1 /end COMPU_METHOD
/begin COMPU_METHOD _CNV_A_R_LINEAR_____588_CM "" RAT_FUNC "%6.3" "-" COEFFS 0 1. -1. 0 0 1 /end COMPU_METHOD
/begin COMPU_METHOD _CNV_A_R_LINEAR_____591_CM "" RAT_FUNC "%6.3" "g/s" COEFFS 0 43.3652807775378 0. 0 0 1 /end COMPU_METHOD
/begin COMPU_METHOD _CNV_A_R_LINEAR_____592_CM "" RAT_FUNC "%6.3" "°C" COEFFS 0 1.25615763546798 60.29556650246305 0 0 1 /end COMPU_METHOD
/begin RECORD_LAYOUT _REC_AXS_20_u1 NO_AXIS_PTS_X 1 UBYTE AXIS_PTS_X 2 UBYTE INDEX_INCR DIRECT /end RECORD_LAYOUT
/begin RECORD_LAYOUT _REC_AXS_20_u2 NO_AXIS_PTS_X 1 UWORD AXIS_PTS_X 2 UWORD INDEX_INCR DIRECT /end RECORD_LAYOUT
/begin FUNCTION X__HP_DDS_EXPA2_DEFAULT_FUNC__ "X__HP_DDS_EXPA2_DEFAULT_FUNC__"
 /begin DEF_CHARACTERISTIC ldpm_n_32_28 ldpm_gear_ef_1 ldpm_n_32__ef ldp_maf__thd_is_er_diag ldp_n__thd_is_er_diag ldp_tco__fac_thd_is_er_diag ldpm_vs_wheel_grd_mmv_thd ldp_vb_sof ldp_tia_sof ldpm_t_sof_act ldp_pv_av_sof_req_1 ldp_pv_av_sof_req_2 ldp_pv_av_sof_req_3 ldp_pv_av_sof_req_4 ldp_pv_av_sof_req_5 ldp_pv_av_sof_req_0 ldp_pv_av_sof_req_6 ldp_n_sof_req_1 ldp_n_sof_req_2 ldp_n_sof_req_3 ldp_n_sof_req_4 ldp_n_sof_req_5 ldp_n_sof_req_0 ldp_n_sof_req_6 ldpm_n_32__t_acc ldp_vs__amp_raw_cor ldp_v_amp_1__amp_raw ldp_v_amp_2__amp_raw ldp_n_vs_ratio_gr_mt ldpm_n_2_3 ldpm_cam_edge_nr_0__win_chk ldpm_cam_edge_nr_1__win_chk ldpm_ctr_km_can ldp_vs_fil__tq_gs_inc_mon ldp_n_32__tq_gs_inc_mon ldpm_tco_2 ldp_flow_cor_cps_ip_cppwm ldpm_prs_cps_ip_cppwm ldp_amp_ip_fac_amp_cp ldp_tia_thr_ip_fac_tia_cp ldp_cl_ip_rel_flow_fac_cp ldpm_maf_ip_rel_flow_max_cps ldpm_cl_mmv_ip_nr_step_cl ldp_tco_ip_rel_fuel_max_cp_cor ldpm_vb_ip_cppwm_vb ldp_cppwm_ref_ip_cppwm_cor_frq ldp_cl_mmv_ip_t_max_cp ldpm_t_ctl_cru_1 ldp_vs_dif_cru__fac_prop_cru ldpm_vs_sp_dif_cru_1 ldpm_n_21 ldpm_vs_sp_cru_1 ldpm_ac_cru__fac_tq_cru ldpm_gear__fac_tq_cru ldp_n_32__fac_tq_cru ldpm_fac_tq_cru_1 ldp_vls_cyc_ratio_mv_1_ip_fac ldp_vls_cyc_ratio_mv_2_ip_fac ldp_maf_kgh_ip_fac_maf_1_cyl ldp_maf_kgh_ip_fac_maf_2_cyl ldpm_n_1_cybl ldpm_n_2_cybl ldp_maf_ip_dly_cyl_lam ldp_maf_ip_vls_dif_val ldp_vls_dif_val_ip_ti_ad_cyl ldp_vls_dif_val_ip_ti_cyl ldp_lamb_sp_ip_fac_vls_dif_lamb ldp_maf_kgh__crlc_vls_down ldp_ftl__t_cur_dmtl_stat ldp_ftl__t_small_leak_test ldp_vb_dmtl_fil__fac_cur_dmtl ldpm_cur_dmtldifrefroughleak_1 ldp_ftl__t_rough_leak_test ldp_n_ecf__n_ecf_min_accin ldp_tco__temp_sub_ecf_ini ldp_n_ecf_cor_fil__n_perc_ecf ldp_tco_ex__n_ecf ldp_tam__temp_sub_ecf_ini ldpm_temp_mmv_sub_cat_ecf_1 ldp_vs__n_ecf_vs_cor ldp_temp_gb__n_ecf_temp_gb ldp_n_32_vff_efp ldp_tco_t_efp_ast_max ldp_ftl_vff_vepu_ftl ldp_ftl_dif_vff_vepu_ftl_dif ldpm_n_32__egr_ratio_s ldpm_mff_sp_s__egr_ratio_s ldpm_maf__egr_ratio_hom ldp_maf_ip_egr_ratio_min ldpm_n_32__egr_ratio_hom ldp_maf_ip_er_std_thd ldp_n_32_ip_egr_ratio_min ldp_n_32_ip_er_std_thd ldp_ar_red_sp_egr_stk_sp_egr ldpm_stk_dif_egr ldp_stk_sp_egr__egrpwm_prev ldpm_er_egr ldp_tco__fac_tco_egr ldp_maf_cyl__egr_ratio_inc ldpm_tco_1_6 ldpm_gr_mt_3 ldpm_gr_at_3 ldp_amp_ip_load_clc_amp ldp_n_32_ip_load_clc ldp_maf_ip_load_clc ldp_tfpa_ip_fac_fpapwm ldpm_fpa_mff_fusl ldpm_fup_dif_dly_fusl ldp_vb_ip_fpapwm ldp_vb_ip_fpapwm_max ldp_mff_sp_ip_fup_sp_hom ldp_n_32_ip_fup_sp_hom ldpm_n_32_2_s ldpm_mff_sp_s_2_s ldp_tco_ip_fup_sp_st ldp_fup_sp_dif_ip_fac_fup_sp ldp_fup_sp_pctl_ip_fpapwm_bas ldp_n_32_ip_fac_fpapwm_bas ldp_mff_sp_ip_fac_fpapwm_bas ldp_lamb_sp__iga_bas_lamb ldp_tco__fac_iga_ch_tco ldpm_n_32_1_iga ldpm_t_ast_1_iga ldpm_tco_st_1_iga ldp_fac_tq_req_clu__crlc_tq_add ldpm_n_32_2_iga ldpm_maf_hb_1_iga ldp_tco__iga_bas_temp_cor ldp_tia__iga_bas_temp_cor ldpm_n_32_fac_iga_pos_neg ldp_maf_fac_iga_pos_neg ldpm_tco__iga_egr ldp_n_32__iga_egr_s ldp_mff_sp_s__egr_iga ldp_egr_ratio_cor_2__iga_bas ldp_cyc_cast_ip_iga_dif_min_cyc ldpm_n_32_2_igsp ldpm_maf_hb_2_igsp ldp_lamb_sp_iga_ref_lamb ldp_n_iga_ref_temp ldp_maf_iga_ref_temp ldp_tia__iga_ref_temp_fac ldp_n__iga_ref_vvt ldp_tco__iga_ref_temp_fac ldp_maf__iga_ref_vvt ldp_egr_ratio_cor__iga_ref_egr ldp_maf__iga_ref_port ldp_n_32__iga_bas_port ldp_port_av__fac_iga_bas_port ldp_mff_sp__iga_bas_s ldp_n_32__iga_bas_s ldp_eff_iga_sp_iga_dif_sp ldp_cyc_st_ip_iga_st_cyc_st_cor ldp_n_ip_iga_st_bas ldp_amp_ip_iga_st_amp_cor ldp_teg_dyn_hys ldp_n__v_dur_igc_min ldp_maf__v_dur_igc_min ldp_n_dif_cor__tq_i_dt_is ldp_n_dif_cor_p_d_dt_is ldp_n_dif_cor_p_d_is ldp_n_dif_cor_tq_i_is ldp_n_grd_p_d_dt_is ldp_n_grd_p_d_is ldp_n_grd_tq_i_is ldp_t_ast__fac_n_grd_is ldp_tco__fac_n_grd_is ldpm_tco_is_1 ldpm_gr_mt_2 ldp_n_t_n_dif_ofs_pred ldp_n_dif_pred_tq_add_is_bol ldp_nr_pat__pat_ind ldpm_tco_st_4 ldpm_n_11 ldpm_maf_ivvt_1 ldpm_tco_17 ldpm_tco_st_1_ivvt ldpm_t_ast_1_ivvt ldp_n_32__fac_cam_sp_ch_opp ldp_dip__fac_cam_sp_ch_opp ldp_state_cmb_ctl_id_cmb_ivvt ldpm_cam_mdl_dif_ivvt ldpm_dly_ivvt_1_ivvt ldpm_n_32_4_ivvt ldpm_cam_edge_nr ldp_vb__ivvtpwm ldp_vb__fac_ivvtpwm ldp_vb_ip_ivvthpwm ldpm_cam_dif_ivvt ldp_vel_drift_ip_ivvthpwm_cor ldp_t_drift_ivvthpwm ldpm_mff_mmv ldp_vo_fac_ivvt ldpm_n_4_9 ldpm_n_6_4 ldpm_n_iga_max_knk ldpm_maf_iga_max_knk ldp_tco__fac_iga_max_knk ldp_tia__fac_iga_max_knk ldp_n_32__maf_min_knk_ad_2 ldp_tia__ip_fac_ron_ad_max ldp_tco__ip_fac_ron_ad_max ldpm_n_32_3_iga ldp_maf_iga__iga_tra_knk ldpm_n_32_7 ldp_fac_ron_ad_fac_iga_tra ldp_tia_fac_iga_tra ldpm_gear_1 ldp_vs_fac_iga_tra_gear_mt ldp_vs_fac_iga_tra_gear_at ldpm_n_32_1_lamb_ctl ldpm_maf_1_lamb_ctl ldpm_maf_2_lamb_ctl ldpm_tco_1_lam ldpm_n_32_2_lamb_ctl ldp_maf_cyl_ip_crlc_lam_mv_lpf ldpm_teg_cat_up_mdl_1_lam ldp_mff_ad_add_mmv_delta_add ldpm_tco_1_mff_ad ldp_mff_ad_add_mmv_2_mff_add ldp_mff_ad_fac_mmv_2_mff_fac ldpm_n_32_1_mff_ad ldpm_n_32_maf_mff_ad_max ldpm_n_32_maf_mff_ad_min ldp_mff_ad_fac_mmv_delta ldpm_maf_1_lasp ldpm_n_32_1_lasp ldp_n_32_ip_lamb_afl_1 ldp_tqi_req_slow_ip_lamb_afl_1 ldp_tco_st_ip_lamb_bas_wup_cor ldp_n_32_ip_lamb_hom_afl ldp_tqi_req_slow_ip_lamb_hom_afl ldp_tco_ip_lamb_bas_wup_cor ldp_n_32_ip_fac_lamb_wup ldp_n_32_ip_fac_lamb_wup_is ldp_maf_ip_fac_lamb_wup ldp_maf_ip_fac_lamb_wup_is ldp_tco__lamb_add_afl_ch ldp_t_ast__lamb_add_afl_ch ldp_tqi_req_slow__lamb_ch_rgl ldp_n_32__lamb_ch_rgl ldp_tqi_req_slow__lamb_ch_is ldp_n_32__lamb_ch_is ldp_t_cop_i__teg_cop ldp_fac_cop_i__teg_cop ldpm_eff_iga_av_teg_i__teg_cop ldp_n__lamb_fl ldp_tco__lamb_ref_add ldp_n__lamb_ref ldp_maf__lamb_ref ldp_ntl_ip_lamb_rgn_fac_mdl ldp_vls_down_ip_lamb_rgn ldp_n_32_ip_lamb_rgn_afr ldp_maf_ip_lamb_rgn_afr ldp_tqi_req_slow__lamb_sawup ldp_tqi_req_slow__lamb_sawup_is ldp_n_32__lamb_sawup ldp_n_32__lamb_sawup_is ldp_t_ast__lamb_add_sawup ldp_tco__lamb_add_sawup ldp_eff_lamb_sp__lamb_dif_sp ldp_n_32__lamb_iga_afl ldp_maf_hb__lamb_iga_afl ldp_tco_ip_lamb_scc ldpm_n_32 ldp_n_ip_vls_sp_dly ldp_maf_ip_vls_sp_dly ldp_n_ip_fac_lam_dly ldp_maf_ip_fac_lam_dly ldp_maf_kgh_ip_fac_dly_p ldpm_vls_dif_dly ldpm_cat_ip_fac_cat_dly ldp_maf_kgh_ip_crlc_dly_i ldp_maf_int_puc ldp_temp_main_cat ldp_maf_cyl ldp_quo_maf_int_purge ldpm_cat_diag ldp_temp_pcat ldp_r_down_ls_ip_ttip_ls_down ldp_r_up_ls_ip_ttip_ls_up ldpm_temp_ls_ini_1_egcp ldp_vs_fac_v_efc_teg ldpm_teg_cat_down_mdl_1_egcp ldpm_temp_ls_down_ini_1_egcp ldp_n_32_ip_v_efc_lsh_down_ctl ldp_vs_ip_fac_v_efc_down_teg ldpm_tco_st_1_laco ldp_tco_st_t_dly_ls_ready ldpm_n_32__ti_lam ldpm_maf__ti_lam ldp_id_maf_tab_1 ldp_id_maf_tab_2 ldpm_tia_maf_mdl_con_1 ldp_teg_egr_maf_egr_con_1 ldpm_n_32_ar_red ldpm_pq_estim_maf_isa_fac_ofs ldpm_ar_red_isa_bas_maf_isa_fac ldpm_maf_mes__vol_im ldpm_n_32__vol_im ldpm_n_32__vol_im_is ldp_n__pq_sp_puls ldpm_pq_ar_red ldpm_maf_kgh_t_1_hfm ldpm_n_ar_red ldpm_pq__fac_ar_red_cor ldp_t_seg_t_1_ratio_crlc_hfm ldp_ar_red_ad_add_dif ldp_n_32_ar_red_egr ldp_stk_av_egr_ar_red_egr ldpm_maf_cyl_ex ldp_n_32__ip_t_vim_eff_vol ldp_maf_cyl_amp_dec ldpm_fac_port_deac__eff_vol ldpm_exc_av_rel__eff_vol ldp_maf_kgh_mes_bas ldpm_vo__eff_vol ldp_n_32_ip_crlc_eff_vol_temp ldpm_amp__eff_vol_amp ldpm_n_32__eff_vol_cor ldpm_maf__eff_vol_cor ldpm_n__eff_vol ldpm_vim_av__eff_vol ldpm_cam_av_mv_in__eff_vol ldp_n_32__pq_egr_sp ldp_n_32__fac_maf_max_s ldp_mff_sp_s__fac_maf_max_s ldp_maf_dif_s__eff_maf_s ldp_mff_sp_s__pq_egr_sp ldp_maf_turb_ratio__maf_sp_isa ldp_n_32__crlc_maf_diag ldpm_pq_turb_sys ldp_isapwm_isa__fac_pq_isa ldp_n_32_mon__maf_sub_mon ldp_pq_turb_sys_mon__fac_pq_isa ldp_tps_av_mon__fac_tps_isa_mon ldp_tps_av_mon__maf_sub_mon ldp_isapwm_isa__fac_pq_isa_mon ldp_amp__fac_maf_sub_cor_mon ldp_n_32_mon__pq_mon ldp_tps_sum_av_mon__pq_mon ldp_tia__fac_maf_sub_cor_mon ldp_v_map_map_mes_bas ldp_maf__mff_cor_1 ldp_maf__mff_cor_2 ldp_n__mff_cor_1 ldp_n__mff_cor_2 ldpm_tqi_sp_mff_s ldp_tps_dif__mtcpwm_p ldp_tps_dif__mtcpwm_i ldp_tps_av_lih_dif_mtcpwm_i ldp_tps_dif_grd__mtcpwm_d ldp_tps_sp_lih_dif__mtcpwm_add ldp_vb__mtcpwm_vb_fac ldpm_n_tooth__eoi_st ldpm_tco__eoi_tco ldpm_tco_n_sp_2 ldpm_tco_n_sp_1 ldpm_t_ast_n_sp_1 ldpm_ctr_km_can_n_sp_1 ldp_toil_ip_n_sp_is_cs ldp_n_32_n_grd_thd ldpm_gear ldp_pv_av__n_max_mtc_cur_off ldp_toil__n_max_2 ldp_toil__n_max_1 ldpm_n_32__lam_cat ldp_maf__o2_int_max_at ldp_maf__o2_int_max_mt ldp_n_32__o2_int_max_mt ldp_n_32__o2_int_max_at ldp_sum_vls_cat_o2 ldpm_vls_down ldp_toil_max__stop_dec_fsd ldp_tco_st__stop_inc_fsd ldpm_maf_kgh_1_t_vls_cycnr ldpm_n_32_1_t_vls_cyc ldpm_maf_2_t_vls_cyc ldp_maf_kgh__vls_down_max_cycnr ldp_maf_kgh__fac_maf_lsh_down ldp_maf_kgh__fac_maf_lsh_up ldp_v_toil__toil ldp_opg_rel_st_ip_opg_sp_st_isa ldp_amp_ip_fac_amp_opg_st_isa ldp_tia_ip_fac_tia_opg_st_isa ldp_pv_av_ip_opg_rel_st_isa_pv ldp_n_32__port_sp_s ldp_exc_sp_rel__vlft_sp ldp_portpwm__port_sp_phy ldp_fac_tq_req__port_sp_s ldp_v_port__port_av ldp_tco__tcoport_sp ldp_n_32__port_sp_afs ldp_n_32__port_sp_afl ldp_fac_tq_req__port_sp_afs ldp_fac_tq_req__port_sp_afl ldp_n_32__pv_lih_max ldpm_vs_fil__pv_fac_cor ldpm_n_dif__pv_fac_cor ldpm_n__pv_fac_cor ldpm_pv_av_raw__pv_fac_cor ldpm_n_32__fac_tq_req_driv ldpm_fac_tq_cru_dcc ldp_v_pvs_min ldp_pv_av_min_mon_ip_pv_mon ldpm_tco_st_1_sair ldpm_n_32_maf_sa_deac ldpm_n_32_maf_sa_act ldp_ctr_km_can ldp_tco_st_id_t_dly_diag_sa ldp_tia_id_tco_min_diag_sa ldpm_fac_amp ldp_n_32__maf_max_diag_sa ldpm_n_32_id_saf_kgh_diag_min ldpm_n_32_id_saf_kgh_diag_max ldpm_maf_id_saf_kgh_diag_min ldpm_maf_id_saf_kgh_diag_max ldp_maf_cyl__saf_mdl ldp_amp__saf_cor_amp ldp_vb__saf_cor_vb ldp_tam_ip_saf_cor_tam ldp_maf_kgh__tco_sub_inc ldpm_tco_st__tco_dif_diag ldp_vs_fil__tq_gs_inc ldp_n_32__tq_gs_inc ldp_v_tecu__tecu ldp_v_teg__teg ldpm_teg_stat_eng_pre ldpm_egr_ratio__teg ldpm_temp_toil_dif__fac_temp ldpm_lamb_sp_teg__fac_cor ldpm_nr_cyl_scc_teg__fac_scc ldpm_ecfpwm_ecf__fac_cor ldp_teg_stat__fac_tam ldpm_tam_dew__fac_teg ldpm_t_es_dew__fac_teg ldpm_temp_toil_dif__crlc_teg ldpm_temp_tco_dif__crlc_teg ldpm_maf_int_puc__crlc_teg ldpm_n_teg__vs_teg ldpm_tco_st__dew ldpm_teg_wall_cat_up_mdl_1 ldpm_teg_wall_cat_down_mdl_1 ldp_vs__fac_vs_teg ldp_pow_dif_max__add_teg_iga ldpm_vo_dif_teg__teg_stat ldpm_eff_iga_av_teg_cor ldpm_teg_stat__crlc_dec ldpm_teg_wall_stat__crlc_dec ldpm_teg_stat__crlc_inc ldpm_teg_wall_stat__crlc_inc ldpm_maf_teg__vs_teg ldpm_vs__fac_cor_vs_teg_ecf ldpm_vs_cor_teg__fac_cor ldpm_temp_toil_dif_fac_temp ldp_vs_cor_teg_up_1__fac_cor ldpm_vs__fac_cor_vs_teg ldp_maf_kgh_sp__amp_dec ldp_maf_sp__tps_sp_mdl_max ldp_n_32__tps_sp_mdl_max ldp_pq_sp__crlc_ar_red_sp ldp_ar_red_sp_mmv ldp_pq_sp_isa ldp_ar_red_isa_sp_mmv ldp_maf_turb_ratio ldpm_vb_1 ldp_n_32__isapwm_isa_pwl ldp_amp_mes_ti_st_amp_fac ldp_tco__mff_lgrd_ast ldpm_tco__mff_cst ldp_cyc__mff_cst ldp_tia_ip_ti_cast ldp_cyc_cast_ip_ti_deac_cast ldpm_tco_3 ldp_n_tooth__mff_cst ldp_vb__ti_add_dly ldp_fup_map_dif__ti_add_dly ldp_ti_hom__eoi_bas ldp_vlft_av__cam_op_in_vvl ldp_n_32__eoi_bas ldp_n__eoi_dif_s ldp_mff_sp_s__eoi_dif_s ldp_tco__eoi_min_tipr ldp_cycnr_cst__fac_tipr_deac ldp_tco__mffpr_cst ldp_tco__mffpr_fac_st_es ldpm_tco__ti_st_rest ldp_tco_stop__fac_rest ldpm_tco__fac_stall ldp_t_es__rest ldp_t_ast_rest ldpm_maf_hb__ti_wup ldpm_tco__ti_wup ldp_tco_st__ti_tco_wup ldp_vo__ti_vo_wup ldpm_n_32__ti_wup ldp_map_dif__fac_ti_vo_wup ldp_map__ti_fac_n_map ldp_n_32__ti_fac_n_map ldp_toil_ti_fac_tia_toil ldp_tia_ti_fac_tia_toil ldp_tco__ti_fac_tco ldp_v_tia_tia ldpm_tco__reac ldp_map__fac_mff_map_wf ldpm_n_32__reac ldpm_cycnr_reac__reac ldp_tco_ip_tmag_ivvt ldp_toil_ip_tmag_ivvt ldp_pv_av_ip_tps_sp_st_pv ldp_tia_ip_fac_tia_tps_sp_st ldp_amp_ip_tps_sp_st_amp ldp_tps_rel_st_ip_tps_sp_st ldpm_tco__fac_tco_tqi ldpm_n_32_6 ldp_tps_av__maf_1_diag ldp_n_32__tps_max_ratio_diag ldp_n_32_tps_sp_pwl ldp_pv_av__tps_sp_ext ldp_n_ip_tps_sp_lgrd_st ldp_tco_ip_tps_sp_lgrd_st ldp_t_acc_ip_fac_tq_loss_acc_on ldp_n_32_ip_fac_tq_loss_acc_on ldp_n_32_ip_tq_add_acc ldp_t_acc_fac_tq_loss_acc ldp_n_32__tq_add_heat_acc ldpm_gr_at_100 ldpm_gr_mt_100 ldp_n_32__fac_tq_aj ldp_gear__fac_tq_aj ldpm_ac_veh_trv_tcs ldpm_vs_fil ldpm_n_32__tq_loss_ars ldp_tq_loss_ars_sp_can_max ldp_tq_loss_ars_av_can_max ldp_tco__tq_clu_amt ldp_n_dif__tq_clu_amt ldp_n_32_ip_tq_add_conv ldp_n_32_ip_tq_add_amt ldp_vs_fil__tq_clu_amt ldp_n_ratio_conv_fac_tq_conv ldp_toil_t_dly_n_sp_is ldp_toil_t_dly_conv ldp_toil_fac_conv ldp_gr_at_n_tur ldp_n_32__tq_conv ldp_vs_n_tur ldp_tq_conv_can__tq_conv ldp_cl_mmv ldpm_n_100 ldp_maf_cyl_stk__tqfr ldp_tco__tqfr_add ldp_toil_tqfr_add ldp_n_tq_loss_lim ldp_tco_tq_loss_lim ldp_tco_st__tqfr_st ldp_tco_st__tqfr_dec_st ldp_eff_scc_sp__nr_pat_scc ldp_tco_ip_tq_st ldp_n_dif_ip_tq_st ldp_n_32_mon__tqi_ref_mon ldp_maf_mon__tqi_ref_mon ldp_n_32_mon__iga_ref_mon ldp_maf_mon__iga_ref_mon ldp_iga_dif_av_mon__eff_iga_mon ldpm_n_fac_tq_req_driv ldpm_pv_av_fac_tq_req_driv ldp_n_sp_is_ratio ldp_ecfpwm_ecf__pow_loss_ecf ldpm_n_32__maf_min_pu ldpm_tco__maf_min_pu ldp_mff_sp_s__tqi_ref_s ldp_n_32__tqi_dif_lim ldp_tqi_sp_mon__tqi_dif_lim ldp_tqi_sp_mon__tqi_dif_max_mon ldp_n_32_mon__tqi_dif_max_mon ldp_n_dif_sp_is_mon_ip_tq_mon ldp_tco_mon_ip_fac_tq_p_d_mon ldp_tco_mon_ip_n_sp_is_mon ldp_n_tq_add_st ldp_tco_tq_add_st ldp_n_32_tq_add_tra ldp_tq_req_dif_tra_fac_tq_tra ldp_n_32_mon__tq_loss_min_mon ldp_tco_mon__tq_loss_min_mon ldp_n_32_mon__tq_max_clu_max_mon ldp_n_dif_mon_ip_tq_min_mon ldp_n_32_mon_ip_tqi_min_pu_mon ldp_tco_mon_ip_fac_conv_mon ldp_tco_mon_ip_tqi_min_pu_mon ldpm_gear__tq_p_max ldpm_vs_fil__tq_p_max ldp_ang_pste__tq_loss_pste ldp_vel_ang_pste__tq_loss_pste ldp_ang_pste__tq_add_pste ldp_n__fac_tq_add_pste ldp_n_32__fac_tq_req_driv_mon ldp_pv_av__fac_tq_req_driv_mon ldp_tia_fac_n_vim ldp_seg_ctr_fac_wf ldp_tco_st_ti_fac_wf ldp_tco_ti_wf_thd ldpm_maf_6 ldpm_n_29 ldpm_tco_15 ldpm_tib_ti_wf_thd ldpm_vo_1 ldp_maf_sp_tqi ldp_tia__fac_ti_wf ldp_tco__fac_ti_wf ldpm_n_32__seg_ad_cor ldp_maf__maf_dif_max_er_ad ldp_tps_av__tps_grd_max_er_ad ldp_load_mis__load_mis_dif_max ldp_load_mis__fac_add_er_0_at ldp_load_mis__fac_add_er_0_mt ldp_load_mis__fac_add_er_1_at ldpm_load_mis__fac_add_er_1_at ldp_load_mis__fac_add_er_1_mt ldp_load_mis__fac_add_er_2_at ldp_load_mis__fac_add_er_2_mt ldp_load_mis__fac_add_er_3_at ldp_load_mis__fac_add_er_3_mt ldp_load_mis__fac_add_er_4_at ldp_load_mis__fac_add_er_4_mt ldp_load_mis__fac_add_er_5_at ldp_load_mis__fac_add_er_5_mt ldp_load_ip_fac_load_drv2_er_at ldp_load_ip_fac_load_drv2_er_mt ldp_n_32_ip_fac_n_drv2_er_at ldp_n_32_ip_fac_n_drv2_er_mt ldp_n_32_ip_crlc_drv2_er_at ldp_n_32_ip_crlc_drv2_er_mt ldpm_n_32__fac_er_0_at ldpm_n_32__fac_er_0_mt ldpm_n_32__fac_er_1_at ldpm_n_32__fac_er_1_mt ldpm_n_32__fac_er_2_at ldpm_n_32__fac_er_2_mt ldpm_n_32__fac_er_3_at ldpm_n_32__fac_er_3_mt ldpm_n_32__fac_er_4_at ldpm_n_32__fac_er_4_mt ldpm_n_32__fac_er_5_at ldpm_n_32__fac_er_5_mt ldp_tq_loss_alter_1__tq_alter ldp_n_32__tq_alter ldp_iga_dif_av__eff_iga_mon2 ldp_maf__iga_ref_mon2 ldp_maf__tqi_ref_mon2 ldp_n_32__iga_ref_mon2 ldp_n_32__tqi_dif_max_mon2 ldp_n_32__tqi_ref_mon2 ldp_tqi_sp__tqi_dif_max_mon2 ldp_n_32__fac_tq_req_driv_mon2 ldp_pv_av__fac_tq_req_driv_mon2 ldpm_tst_rec_idx_mon2 ldpm_tst_rec ldp_lamb_dif__eff_lamb ldpm_n_2_9 ldp_tps_av_id_tps_grd_bol_ae ldp_n_32__fac_tq_req_clu_is ldp_tq_accin_can__tq_loss_acc ldpm_tia_1 ldp_n_32__tq_loss_acc ldp_v_tco__tco ldpm_ctr_km_can_1 ldp_2_id_err_dtc_mis ldp_1_id_err_dtc_mis ldpm_maf_1_9 ldpm_n_32_ip_egr_ratio ldpm_maf_ip_egr_ratio ldpm_tco_1_igsp ldp_n_23 ldpm_n_14 ldpm_maf_2 ldpm_tco_9 ldp_iga_dif_eff_iga ldpm_n_32__tqi_min_pu ldpm_tco__tqi_min_pu ldpm_teg_cat_up_mdl_1_egcp ldpm_n_32_1_egcp ldpm_maf_cyl_ip_rel_flow_inc_cp ldpm_n_32_ip_rel_flow_max_cps ldpm_n_32_ip_fuel_dly_cps ldp_eoi__prs_inc_cmp ldp_crk_inj__prs_inc_cmp ldpm_prs_dec_inj__fac_ti_prs ldpm_n_32_s ldp_tps_seg_ar_red_thr ldpm_pq_estim_id_maf_fac_ofs ldpm_n_1_thro ldpm_tco_1_thro ldp_isapwm_mmv ldpm_tco_st_tco_lam_min ldpm_t_vls_cyc_afl_hld ldp_maf_sub__maf_sub_thd_mon ldp_tqi_sp_maf__maf_sp ldpm_maf_100 ldpm_n_32_100 ldpm_n_32_3_ivvt ldpm_n_32_2_ivvt ldpm_tmag_ivvt_1_ivvt ldpm_n_13 ldpm_n_5 ldpm_maf_ivvt_2 ldpm_toil_2_ivvt ldpm_n_32_1_ivvt ldpm_toil_1_ivvt ldpm_maf_teg__teg_stat ldpm_n_teg__teg_stat ldpm_saf_kgh__fac_cor_saf ldpm_n_h_prs_st ldpm_tco_h_prs ldpm_n_32__fup_sp ldpm_n_32__fup_sp_s ldp_fup_sp__fpapwm_bas ldpm_fup_dif__fpapwm ldpm_tqi_sp__fup_sp ldpm_fpa_mff__fpapwm ldpm_tco__tqi_av_min_er ldpm_n_32__tqi_av_min_er ldpm_tqi_av__fac_er ldp_tqi_av__mis_fac_thd_iv_er ldp_id_saf_tab_1 ldp_id_saf_tab_2 ldpm_n_32__fac_er ldpm_n_id_crk_acq ldpm_n_id_cam_acq ldp_n_32__mis_fac_thd_iv_er ldp_n_32__mis_fac_afs ldp_n_32__mis_fac_afl ldp_n_32__mis_fac_s ldp_tqi_av__mis_fac_s ldp_tqi_av__mis_fac_afl ldp_tqi_av__mis_fac_afs ldp_vb__fpapwm_fac ldpm_clas_a_id_clas_fmy ldp_clas_b_id_clas_fmy ldp_n_32__iga_ref_port ldpm_maf_cyl_ip_rel_flow_max_cp ldpm_n_32_ip_rel_flow_cps_s ldpm_maf_ip_rel_flow_cps_s ldpm_tqi_sp_s_cp ldpm_frq_req_cp ldpm_maf_cyl_ip_ti_lam_cor_crlc ldp_cl_mmv_ip_rel_flow_fac_cp ldp_n_32__pvs_dec_cru ldp_n_32__iga_egr_afl ldp_lamb_sp_ip_fac_lamb_egr ldp_n_32__iga_egr_afr ldp_fmy_dtc ldp_fmy_envd ldp_n_32__crlc_eff_vol_cor ldp_n_32__maf_sp_isa ldp_teg_dyn__v_efc_lsh_up_ctl ldpm_n_35 ldp_cat_diag ldpm_temp_main_cat ldpm_n_110 ldpm_gr_tra_at_2 ldpm_gr_tra_mt_2 ldp_toil_t_ramp_conv_pos ldp_toil_t_ramp_conv_neg ldpm_toil_3_ivvt ldpm_toil_4_ivvt ldpm_vo__teg_stat ldpm_pow_dif__fac_cor ldpm_vb__td /end DEF_CHARACTERISTIC
 /begin OUT_MEASUREMENT TCO_DIF CYCNR_PUC N_HYS_PUC N_MIN_PUC LV_ERR_MIS_LOW_FUEL T_ADD_MIN_IVVT_ADH_IN_1 LV_ADH_CDN_IVVT_IN_1 T_SUM_ADH_IVVT_IN_1 T_DLY_ADH_IVVT_IN_1 CAM_ADH_OLD_IN_1 CAM_ADH_ACT_IN_1 CAM_ADJ_DIF_ADH_IVVT_IN_1 LV_ERR_IVVT_MEC_ASS_IN_1 T_DRIFT_IVVTHPWM_IN_1 LV_IVVTPWM_EXT_ADJ_IN_1 IVVTPWM_EXT_ADJ_IN_1 T_DRIFT_IVVTHPWM_IN_2 T_ADD_MIN_IVVT_ADH_IN_2 LV_ADH_CDN_IVVT_IN_2 T_SUM_ADH_IVVT_IN_2 T_DLY_ADH_IVVT_IN_2 CAM_ADH_OLD_IN_2 CAM_ADH_ACT_IN_2 CAM_ADJ_DIF_ADH_IVVT_IN_2 LV_ERR_IVVT_MEC_ASS_IN_2 LV_IVVTPWM_EXT_ADJ_IN_2 IVVTPWM_EXT_ADJ_IN_2 T_ADD_MIN_IVVT_ADH_EX_1 LV_ADH_CDN_IVVT_EX_1 T_SUM_ADH_IVVT_EX_1 T_DLY_ADH_IVVT_EX_1 CAM_ADH_OLD_EX_1 CAM_ADH_ACT_EX_1 CAM_ADJ_DIF_ADH_IVVT_EX_1 LV_ERR_IVVT_MEC_ASS_EX_1 T_DRIFT_IVVTHPWM_EX_1 LV_IVVTPWM_EXT_ADJ_EX_1 IVVTPWM_EXT_ADJ_EX_1 T_DRIFT_IVVTHPWM_EX_2 T_ADD_MIN_IVVT_ADH_EX_2 T_SUM_ADH_IVVT_EX_2 T_DLY_ADH_IVVT_EX_2 CAM_ADH_OLD_EX_2 CAM_ADH_ACT_EX_2 CAM_ADJ_DIF_ADH_IVVT_EX_2 LV_ERR_IVVT_MEC_ASS_EX_2 LV_ADH_CDN_IVVT_EX_2 LV_IVVTPWM_EXT_ADJ_EX_2 IVVTPWM_EXT_ADJ_EX_2 LV_INH_DIAG_CHK_LS_DOWN_1 VLS_DOWN_1 VLS_DOWN_BOL_1 VLS_DOWN_TOL_1 VLS_DOWN_MMV_MAX_1 VLS_DOWN_MMV_MIN_1 VLS_DOWN_MMV_HYS_1 DRV1_VLS_DOWN_MMV_1 DRV1_VLS_DOWN_ABS_MAX_1 LV_END_DIAG_WIN_FSD_1 LV_LAM_MV_LDC_1 LV_INH_DIAG_CHK_LS_DOWN_2 VLS_DOWN_2 VLS_DOWN_BOL_2 VLS_DOWN_TOL_2 VLS_DOWN_MMV_MAX_2 VLS_DOWN_MMV_MIN_2 VLS_DOWN_MMV_HYS_2 DRV1_VLS_DOWN_MMV_2 DRV1_VLS_DOWN_ABS_MAX_2 LV_END_DIAG_WIN_FSD_2 LV_LAM_MV_LDC_2 SEG_NR TQI LV_FMY_EXIT_ST LV_MAX_ERR_FSD_1 LV_MIN_ERR_FSD_1 CYCNR_ST TIA_SUB N_RATIO_CONV TQ_DIF_TRA B_DSLFA B_FASLS IMLPR BSDCONTROL BSDDATA BSDREGADR OZPERMBITS1_1S B_OZDPERM B_OZER0OK B_OZERPLT B_OZREGSTG B_OZERANZ OZPERMBITS3_1S B_OZPER0OK B_CALCDPER OZRESTKMBITS_1S B_OZCNTINI B_RWANZ0 N_IDLIBS UIBS CKS_CRC_ECU STATE_IV B_IDLGSPEC B_NOCTRGEN TBATT UGENSLP CYL_ID_SAM_TRIG /end OUT_MEASUREMENT
/end FUNCTION
/end MODULE
/end PROJECT
