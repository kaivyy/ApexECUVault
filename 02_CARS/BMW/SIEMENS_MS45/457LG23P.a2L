ASAP2_VERSION 1 31
/begin PROJECT MS45 "BMW Motorsteuerung R6"
/begin HEADER "_default_HeaderComment" PROJECT_NO _57 /end HEADER
/begin MODULE _default_ModuleName "_default_ModuleLongIdentifier"
/begin MOD_COMMON "_default_ModCommonComment" DEPOSIT ABSOLUTE BYTE_ORDER MSB_FIRST ALIGNMENT_BYTE 1 ALIGNMENT_WORD 2 ALIGNMENT_LONG 4 ALIGNMENT_FLOAT32_IEEE 4 ALIGNMENT_FLOAT64_IEEE 8 /end MOD_COMMON
/begin CHARACTERISTIC c_cam_grd_ad_max_ivvt "" VALUE 0xffe4063d _REC_VAL_20_u1 95.625 _CNV_A_R_LINEAR_____232_CM 0. 95.625 DISPLAY_IDENTIFIER C_CAM_GRD_AD_MAX_IVVT /end CHARACTERISTIC
/begin CHARACTERISTIC c_cam_grd_ad_max_st_ivvt "" VALUE 0xffe4063e _REC_VAL_20_u1 95.625 _CNV_A_R_LINEAR_____232_CM 0. 95.625 DISPLAY_IDENTIFIER C_CAM_GRD_AD_MAX_ST_IVVT /end CHARACTERISTIC
/begin CHARACTERISTIC c_crlc_ref_ivvt "" VALUE 0xffe40690 _REC_VAL_20_u1 0.9960940000000002 _CNV_A_R_LINEAR_____50_CM 0. 0.996094 DISPLAY_IDENTIFIER C_CRLC_REF_IVVT FORMAT "%5.3" /end CHARACTERISTIC
/begin CHARACTERISTIC id_sum_cam_ad_ivvt "" CURVE 0xffe40a89 _REC_CUR_20_u1_u1 255. _CNV_A_R_LINEAR_____0_CM 0. 255. DISPLAY_IDENTIFIER ID_SUM_CAM_AD_IVVT FORMAT "%3.0"
 /begin AXIS_DESCR COM_AXIS toil _CNV_A_R_LINEAR_____14_CM 6 -40. 160. FORMAT "%3.0" AXIS_PTS_REF ldpm_toil_2_ivvt /end AXIS_DESCR
/end CHARACTERISTIC
/begin CHARACTERISTIC c_cam_raw_dyw_ivvt_in "" VALUE 0xffe4064a _REC_VAL_20_u1 95.625 _CNV_A_R_LINEAR_____82_CM 0. 95.625 DISPLAY_IDENTIFIER C_CAM_RAW_DYW_IVVT_IN /end CHARACTERISTIC
/begin CHARACTERISTIC c_crlc_cam_ad_ivvt "" VALUE 0xffe4067d _REC_VAL_20_u1 0.9960940000000002 _CNV_A_R_LINEAR_____50_CM 0. 0.996094 DISPLAY_IDENTIFIER C_CRLC_CAM_AD_IVVT FORMAT "%5.3" /end CHARACTERISTIC
/begin CHARACTERISTIC c_crlc_cam_ad_st_ivvt "" VALUE 0xffe4067e _REC_VAL_20_u1 0.9960940000000002 _CNV_A_R_LINEAR_____50_CM 0. 0.996094 DISPLAY_IDENTIFIER C_CRLC_CAM_AD_ST_IVVT FORMAT "%5.3" /end CHARACTERISTIC
/begin CHARACTERISTIC c_t_min_ref_req_ivvt "" VALUE 0xffe408b8 _REC_VAL_20_u1 25.5 _CNV_A_R_LINEAR_____24_CM 0. 25.5 DISPLAY_IDENTIFIER C_T_MIN_REF_REQ_IVVT FORMAT "%4.1" /end CHARACTERISTIC
/begin CHARACTERISTIC c_tco_add_cam_ref_ivvt "" VALUE 0xffe408ec _REC_VAL_20_u1 190.5 _CNV_A_R_LINEAR_____12_CM 0. 190.5 DISPLAY_IDENTIFIER C_TCO_ADD_CAM_REF_IVVT FORMAT "%6.2" /end CHARACTERISTIC
/begin MEASUREMENT lv_cam_ad_req_ivvt "" UBYTE _CNV_A_R_LINEAR_____0_CM 1 100. 0. 1. DISPLAY_IDENTIFIER LV_CAM_AD_REQ_IVVT ECU_ADDRESS 0x3fe4a1 FORMAT "%1.0" BIT_MASK 0x1 /end MEASUREMENT
/begin MEASUREMENT lv_cam_ad_di_ivvt "Adaptation disabled" UBYTE _CNV_A_R_LINEAR_____0_CM 1 100. 0. 1. DISPLAY_IDENTIFIER LV_CAM_AD_DI_IVVT ECU_ADDRESS 0x3fe4a2 FORMAT "%1.0" BIT_MASK 0x1 /end MEASUREMENT
/begin MEASUREMENT lv_cam_ad_avl_ivvt "" UBYTE _CNV_A_R_LINEAR_____0_CM 1 100. 0. 1. DISPLAY_IDENTIFIER LV_CAM_AD_AVL_IVVT ECU_ADDRESS 0x3fe4a0 FORMAT "%1.0" BIT_MASK 0x1 /end MEASUREMENT
/begin MEASUREMENT lv_cam_ad_nvmy_vld "Valid Adaptation values in non-volatile memory available" UBYTE _CNV_A_R_LINEAR_____0_CM 1 100. 0. 1. DISPLAY_IDENTIFIER LV_CAM_AD_NVMY_VLD ECU_ADDRESS 0x3fe4a3 FORMAT "%1.0" BIT_MASK 0x1 /end MEASUREMENT
/begin CHARACTERISTIC c_cam_raw_dyw_ivvt_ex "" VALUE 0xffe40649 _REC_VAL_20_u1 95.625 _CNV_A_R_LINEAR_____82_CM 0. 95.625 DISPLAY_IDENTIFIER C_CAM_RAW_DYW_IVVT_EX /end CHARACTERISTIC
/begin MEASUREMENT ctr_cam_ad_ivvt "Counter for camshaft Adaptations after engine start" UBYTE _CNV_A_R_LINEAR_____0_CM 1 100. 0. 255. DISPLAY_IDENTIFIER CTR_CAM_AD_IVVT ECU_ADDRESS 0x3fe4a7 FORMAT "%3.0" /end MEASUREMENT
/begin CHARACTERISTIC c_cyc_cam_pos_dly_park "Number of segments for CAM-position filtering" VALUE 0xffe406d8 _REC_VAL_20_u1 255. _CNV_A_R_LINEAR_____0_CM 0. 255. DISPLAY_IDENTIFIER C_CYC_CAM_POS_DLY_PARK FORMAT "%3.0" /end CHARACTERISTIC
/begin CHARACTERISTIC c_n_cam_ad_bol "Lower engine speed level of forbidden zone for CAM-Adaptation" VALUE 0xffe407d3 _REC_VAL_20_u1 8160. _CNV_A_R_LINEAR_____15_CM 0. 8160. DISPLAY_IDENTIFIER C_N_CAM_AD_BOL FORMAT "%4.0" /end CHARACTERISTIC
/begin CHARACTERISTIC c_n_cam_ad_tol "Upper engine speed level of forbidden zone for CAM-Adaptation" VALUE 0xffe407d4 _REC_VAL_20_u1 8160. _CNV_A_R_LINEAR_____15_CM 0. 8160. DISPLAY_IDENTIFIER C_N_CAM_AD_TOL FORMAT "%4.0" /end CHARACTERISTIC
/begin CHARACTERISTIC c_ctr_cam_ad_ivvt_max "Maximum number of IVVT end position Adaptations after engine start" VALUE 0xffe406a1 _REC_VAL_20_u1 255. _CNV_A_R_LINEAR_____0_CM 0. 255. DISPLAY_IDENTIFIER C_CTR_CAM_AD_IVVT_MAX FORMAT "%3.0" /end CHARACTERISTIC
/begin CHARACTERISTIC c_t_dly_cam_ad_ivvt "Delay time after transition \"enable\" to \"Adaptation\" before Adaptation calculation starts" VALUE 0xffe40875 _REC_VAL_20_u1 2.55 _CNV_A_R_LINEAR_____4_CM 0. 2.55 DISPLAY_IDENTIFIER C_T_DLY_CAM_AD_IVVT FORMAT "%4.2" /end CHARACTERISTIC
/begin MEASUREMENT tco_cam_ref_req_bol "minimum TCO for request of CAM adaptation" UBYTE _CNV_A_R_LINEAR_____11_CM 1 100. -48. 142.5 DISPLAY_IDENTIFIER TCO_CAM_REF_REQ_BOL ECU_ADDRESS 0x3fe4a6 FORMAT "%5.1" /end MEASUREMENT
/begin MEASUREMENT tco_cam_ref_req_tol "maximum TCO for request of CAM adaptation" UBYTE _CNV_A_R_LINEAR_____11_CM 1 100. -48. 142.5 DISPLAY_IDENTIFIER TCO_CAM_REF_REQ_TOL ECU_ADDRESS 0x3fe4a5 FORMAT "%5.1" /end MEASUREMENT
/begin CHARACTERISTIC c_cam_hys_ad_ivvt "" VALUE 0xffe4063f _REC_VAL_20_u1 47.625 _CNV_A_R_LINEAR_____82_CM 0. 47.625 DISPLAY_IDENTIFIER C_CAM_HYS_AD_IVVT /end CHARACTERISTIC
/begin CHARACTERISTIC c_cam_hys_ref_ivvt "" VALUE 0xffe40642 _REC_VAL_20_u1 95.625 _CNV_A_R_LINEAR_____82_CM 0. 95.625 DISPLAY_IDENTIFIER C_CAM_HYS_REF_IVVT /end CHARACTERISTIC
/begin CHARACTERISTIC c_cam_ini_in "valve spread angle inlet camshafts with IVVT passive" VALUE 0xffe40645 _REC_VAL_20_u1 95.625 _CNV_A_R_LINEAR_____230_CM 60. 155.625 DISPLAY_IDENTIFIER C_CAM_INI_IN FORMAT "%5.1" /end CHARACTERISTIC
/begin CHARACTERISTIC c_cam_ini_ex "valve spread angle exhaust camshaft  with IVVT passive" VALUE 0xffe40644 _REC_VAL_20_u1 -95.625 _CNV_A_R_LINEAR_____227_CM -40. -135.625 DISPLAY_IDENTIFIER C_CAM_INI_EX FORMAT "%5.1" /end CHARACTERISTIC
/begin AXIS_PTS ldpm_toil_2_ivvt "" 0xffe4147a toil _REC_AXS_20_u1 200. _CNV_A_R_LINEAR_____14_CM 6 -40. 160. DISPLAY_IDENTIFIER LDPM_TOIL_2_IVVT FORMAT "%3.0" /end AXIS_PTS
/begin CHARACTERISTIC c_cam_dif_max_ivvt_park "Maximum deviation for activation of IVVT parking function" VALUE 0xffe40639 _REC_VAL_20_u1 95.625 _CNV_A_R_LINEAR_____82_CM 0. 95.625 DISPLAY_IDENTIFIER C_CAM_DIF_MAX_IVVT_PARK FORMAT "%5.2" /end CHARACTERISTIC
/begin CHARACTERISTIC c_cam_drift_max_ivvt_park "Maximum deviation for recognizing of IVVT drift from park function" VALUE 0xffe4063b _REC_VAL_20_u1 95.625 _CNV_A_R_LINEAR_____82_CM 0. 95.625 DISPLAY_IDENTIFIER C_CAM_DRIFT_MAX_IVVT_PARK FORMAT "%5.2" /end CHARACTERISTIC
/begin CHARACTERISTIC c_toil_min_diag_ivvt_park "Maximum threshold of TOIL for activation of IVVT parking position diagnosis" VALUE 0xffe40977 _REC_VAL_20_u1 200. _CNV_A_R_LINEAR_____14_CM -40. 160. DISPLAY_IDENTIFIER C_TOIL_MIN_DIAG_IVVT_PARK FORMAT "%3.0" /end CHARACTERISTIC
/begin CHARACTERISTIC c_tco_min_diag_ivvt_park "Maximum threshold of TCO for activation of IVVT parking position diagnosis" VALUE 0xffe40910 _REC_VAL_20_u1 190.5 _CNV_A_R_LINEAR_____11_CM -48. 142.5 DISPLAY_IDENTIFIER C_TCO_MIN_DIAG_IVVT_PARK FORMAT "%5.1" /end CHARACTERISTIC
/begin MEASUREMENT lv_act_ivvt_park "Conditions for parking of IVVT are fulfilled" UBYTE _CNV_A_R_LINEAR_____0_CM 1 100. 0. 1. DISPLAY_IDENTIFIER LV_ACT_IVVT_PARK ECU_ADDRESS 0x3fe4a4 FORMAT "%1.0" BIT_MASK 0x1 /end MEASUREMENT
/begin MEASUREMENT lv_is_ivvt_diag_park "Diagnosis of parkposition enable" UBYTE _CNV_A_R_LINEAR_____0_CM 1 100. 0. 1. DISPLAY_IDENTIFIER LV_IS_IVVT_DIAG_PARK ECU_ADDRESS 0x3fe4a8 FORMAT "%1.0" BIT_MASK 0x1 /end MEASUREMENT
/begin CHARACTERISTIC c_fac_hld_dly "Count of delay times before transition from HLD_DLY to HLD_ADAP" VALUE 0xffe40739 _REC_VAL_20_u1 1.55 _CNV_A_R_LINEAR_____233_CM 1. 2.55 DISPLAY_IDENTIFIER C_FAC_HLD_DLY FORMAT "%4.2" /end CHARACTERISTIC
/begin CHARACTERISTIC ip_t_fac_adc_ivvt_ex "" MAP 0xffe4e88e _REC_MAP_20_u2_u1_u1 639.9902344 _CNV_A_R_LINEAR_____234_CM 0. 639.9902344 DISPLAY_IDENTIFIER IP_T_FAC_ADC_IVVT_EX FORMAT "%7.3"
 /begin AXIS_DESCR COM_AXIS n_32 _CNV_A_R_LINEAR_____15_CM 8 0. 8160. FORMAT "%4.0" AXIS_PTS_REF ldpm_n_32_2_ivvt /end AXIS_DESCR
 /begin AXIS_DESCR COM_AXIS toil _CNV_A_R_LINEAR_____14_CM 8 -40. 160. FORMAT "%3.0" AXIS_PTS_REF ldpm_toil_1_ivvt /end AXIS_DESCR
/end CHARACTERISTIC
/begin CHARACTERISTIC ip_t_fac_adc_ivvt_in "" MAP 0xffe4e90e _REC_MAP_20_u2_u1_u1 639.9902344 _CNV_A_R_LINEAR_____234_CM 0. 639.9902344 DISPLAY_IDENTIFIER IP_T_FAC_ADC_IVVT_IN FORMAT "%7.3"
 /begin AXIS_DESCR COM_AXIS n_32 _CNV_A_R_LINEAR_____15_CM 8 0. 8160. FORMAT "%4.0" AXIS_PTS_REF ldpm_n_32_2_ivvt /end AXIS_DESCR
 /begin AXIS_DESCR COM_AXIS toil _CNV_A_R_LINEAR_____14_CM 8 -40. 160. FORMAT "%3.0" AXIS_PTS_REF ldpm_toil_1_ivvt /end AXIS_DESCR
/end CHARACTERISTIC
/begin CHARACTERISTIC ip_t_fac_rtd_ivvt_ex "" MAP 0xffe4e98e _REC_MAP_20_u2_u1_u1 639.9902344 _CNV_A_R_LINEAR_____234_CM 0. 639.9902344 DISPLAY_IDENTIFIER IP_T_FAC_RTD_IVVT_EX FORMAT "%7.3"
 /begin AXIS_DESCR COM_AXIS n_32 _CNV_A_R_LINEAR_____15_CM 8 0. 8160. FORMAT "%4.0" AXIS_PTS_REF ldpm_n_32_2_ivvt /end AXIS_DESCR
 /begin AXIS_DESCR COM_AXIS toil _CNV_A_R_LINEAR_____14_CM 8 -40. 160. FORMAT "%3.0" AXIS_PTS_REF ldpm_toil_1_ivvt /end AXIS_DESCR
/end CHARACTERISTIC
/begin CHARACTERISTIC ip_fac_ctl_ivvt_in "" CURVE 0xffe40b66 _REC_CUR_20_u1_u1 3.984375 _CNV_A_R_LINEAR_____129_CM 0. 3.984375 DISPLAY_IDENTIFIER IP_FAC_CTL_IVVT_IN FORMAT "%7.5"
 /begin AXIS_DESCR COM_AXIS n_32 _CNV_A_R_LINEAR_____15_CM 6 0. 8160. FORMAT "%4.0" AXIS_PTS_REF ldpm_n_32_3_ivvt /end AXIS_DESCR
/end CHARACTERISTIC
/begin CHARACTERISTIC c_cam_mdl_dif_min_adh "Minimum cam-position error for activation of adhesion detection" VALUE 0xffe403d2 _REC_VAL_20_s2 120. _CNV_A_R_LINEAR_____82_CM -60. 60. DISPLAY_IDENTIFIER C_CAM_MDL_DIF_MIN_ADH FORMAT "%7.3" /end CHARACTERISTIC
/begin CHARACTERISTIC c_fac_t_sum_min_ivvt_adh "Factor on minimum energization time for adhesion detection" VALUE 0xffe40748 _REC_VAL_20_u1 15.9375 _CNV_A_R_LINEAR_____46_CM 0. 15.9375 DISPLAY_IDENTIFIER C_FAC_T_SUM_MIN_IVVT_ADH FORMAT "%5.2" /end CHARACTERISTIC
/begin CHARACTERISTIC c_fac_dly_ivvt_adh "Factor on minimum energization time for adhesion detection" VALUE 0xffe40734 _REC_VAL_20_u1 15.9375 _CNV_A_R_LINEAR_____46_CM 0. 15.9375 DISPLAY_IDENTIFIER C_FAC_DLY_IVVT_ADH FORMAT "%5.2" /end CHARACTERISTIC
/begin CHARACTERISTIC c_cam_adj_dif_adh_in "Treshold for minimum movement in target direction for adhesion detection inlet cam" VALUE 0xffe403d0 _REC_VAL_20_s2 120. _CNV_A_R_LINEAR_____82_CM -60. 60. DISPLAY_IDENTIFIER C_CAM_ADJ_DIF_ADH_IN FORMAT "%7.3" /end CHARACTERISTIC
/begin CHARACTERISTIC c_cam_adj_dif_adh_ex "Treshold for minimum movement in target direction for adhesion detection exhaust cam" VALUE 0xffe403ce _REC_VAL_20_s2 120. _CNV_A_R_LINEAR_____82_CM -60. 60. DISPLAY_IDENTIFIER C_CAM_ADJ_DIF_ADH_EX FORMAT "%7.3" /end CHARACTERISTIC
/begin CHARACTERISTIC c_cam_adh_hys "Hysteresis for movement detection in adhesion detection " VALUE 0xffe40634 _REC_VAL_20_u1 95.625 _CNV_A_R_LINEAR_____82_CM 0. 95.625 DISPLAY_IDENTIFIER C_CAM_ADH_HYS FORMAT "%5.2" /end CHARACTERISTIC
/begin CHARACTERISTIC ip_toil_min_ivvt_diag "Minimum oil temperature for adhesion detection and mechanical IVVT-diagnosis" CURVE 0xffe40ebb _REC_CUR_20_u1_u1 200. _CNV_A_R_LINEAR_____14_CM -40. 160. DISPLAY_IDENTIFIER IP_TOIL_MIN_IVVT_DIAG FORMAT "%3.0"
 /begin AXIS_DESCR COM_AXIS n_32 _CNV_A_R_LINEAR_____15_CM 4 0. 8160. FORMAT "%4.0" AXIS_PTS_REF ldpm_n_32_4_ivvt /end AXIS_DESCR
/end CHARACTERISTIC
/begin CHARACTERISTIC ip_toil_max_ivvt_diag "Maximum oil temperature for adhesion detection and mechanical IVVT-diagnosis" CURVE 0xffe40eb7 _REC_CUR_20_u1_u1 200. _CNV_A_R_LINEAR_____14_CM -40. 160. DISPLAY_IDENTIFIER IP_TOIL_MAX_IVVT_DIAG FORMAT "%3.0"
 /begin AXIS_DESCR COM_AXIS n_32 _CNV_A_R_LINEAR_____15_CM 4 0. 8160. FORMAT "%4.0" AXIS_PTS_REF ldpm_n_32_4_ivvt /end AXIS_DESCR
/end CHARACTERISTIC
/begin CHARACTERISTIC ip_t_fac_rtd_ivvt_in "" MAP 0xffe4ea0e _REC_MAP_20_u2_u1_u1 639.9902344 _CNV_A_R_LINEAR_____234_CM 0. 639.9902344 DISPLAY_IDENTIFIER IP_T_FAC_RTD_IVVT_IN FORMAT "%7.3"
 /begin AXIS_DESCR COM_AXIS n_32 _CNV_A_R_LINEAR_____15_CM 8 0. 8160. FORMAT "%4.0" AXIS_PTS_REF ldpm_n_32_2_ivvt /end AXIS_DESCR
 /begin AXIS_DESCR COM_AXIS toil _CNV_A_R_LINEAR_____14_CM 8 -40. 160. FORMAT "%3.0" AXIS_PTS_REF ldpm_toil_1_ivvt /end AXIS_DESCR
/end CHARACTERISTIC
/begin CHARACTERISTIC ip_t_dly_add_adc_ivvt_in "" CURVE 0xffe40e04 _REC_CUR_20_u1_u1 159.375 _CNV_A_R_LINEAR_____235_CM 0. 159.375 DISPLAY_IDENTIFIER IP_T_DLY_ADD_ADC_IVVT_IN FORMAT "%6.1"
 /begin AXIS_DESCR COM_AXIS toil _CNV_A_R_LINEAR_____14_CM 8 -40. 160. FORMAT "%3.0" AXIS_PTS_REF ldpm_toil_1_ivvt /end AXIS_DESCR
/end CHARACTERISTIC
/begin CHARACTERISTIC ip_t_dly_add_adc_ivvt_ex "" CURVE 0xffe40dfc _REC_CUR_20_u1_u1 159.375 _CNV_A_R_LINEAR_____235_CM 0. 159.375 DISPLAY_IDENTIFIER IP_T_DLY_ADD_ADC_IVVT_EX FORMAT "%6.1"
 /begin AXIS_DESCR COM_AXIS toil _CNV_A_R_LINEAR_____14_CM 8 -40. 160. FORMAT "%3.0" AXIS_PTS_REF ldpm_toil_1_ivvt /end AXIS_DESCR
/end CHARACTERISTIC
/begin CHARACTERISTIC ip_t_dly_add_rtd_ivvt_ex "" CURVE 0xffe40e0c _REC_CUR_20_u1_u1 159.375 _CNV_A_R_LINEAR_____235_CM 0. 159.375 DISPLAY_IDENTIFIER IP_T_DLY_ADD_RTD_IVVT_EX FORMAT "%6.1"
 /begin AXIS_DESCR COM_AXIS toil _CNV_A_R_LINEAR_____14_CM 8 -40. 160. FORMAT "%3.0" AXIS_PTS_REF ldpm_toil_1_ivvt /end AXIS_DESCR
/end CHARACTERISTIC
/begin CHARACTERISTIC ip_t_dly_add_rtd_ivvt_in "" CURVE 0xffe40e14 _REC_CUR_20_u1_u1 159.375 _CNV_A_R_LINEAR_____235_CM 0. 159.375 DISPLAY_IDENTIFIER IP_T_DLY_ADD_RTD_IVVT_IN FORMAT "%6.1"
 /begin AXIS_DESCR COM_AXIS toil _CNV_A_R_LINEAR_____14_CM 8 -40. 160. FORMAT "%3.0" AXIS_PTS_REF ldpm_toil_1_ivvt /end AXIS_DESCR
/end CHARACTERISTIC
/begin CHARACTERISTIC ip_fac_ctl_ivvt_ex "" CURVE 0xffe40b60 _REC_CUR_20_u1_u1 3.984375 _CNV_A_R_LINEAR_____129_CM 0. 3.984375 DISPLAY_IDENTIFIER IP_FAC_CTL_IVVT_EX FORMAT "%7.5"
 /begin AXIS_DESCR COM_AXIS n_32 _CNV_A_R_LINEAR_____15_CM 6 0. 8160. FORMAT "%4.0" AXIS_PTS_REF ldpm_n_32_3_ivvt /end AXIS_DESCR
/end CHARACTERISTIC
/begin CHARACTERISTIC ip_t_ctl_adc_ivvt_ex "" MAP 0xffe46fdb _REC_MAP_20_u1_u1_u1 159.375 _CNV_A_R_LINEAR_____235_CM 0. 159.375 DISPLAY_IDENTIFIER IP_T_CTL_ADC_IVVT_EX FORMAT "%6.1"
 /begin AXIS_DESCR COM_AXIS ivvt_in_1.struct_ctl_ivvt.cam_mdl_dif_ivvt _CNV_A_R_LINEAR_____82_CM 8 0. 60. AXIS_PTS_REF ldpm_cam_mdl_dif_ivvt /end AXIS_DESCR
 /begin AXIS_DESCR COM_AXIS ivvt_in_1.struct_ctl_ivvt.dly_ivvt _CNV_A_R_LINEAR_____31_CM 6 0. 2550. FORMAT "%4.0" AXIS_PTS_REF ldpm_dly_ivvt_1_ivvt /end AXIS_DESCR
/end CHARACTERISTIC
/begin CHARACTERISTIC ip_t_ctl_adc_ivvt_in "" MAP 0xffe4700b _REC_MAP_20_u1_u1_u1 159.375 _CNV_A_R_LINEAR_____235_CM 0. 159.375 DISPLAY_IDENTIFIER IP_T_CTL_ADC_IVVT_IN FORMAT "%6.1"
 /begin AXIS_DESCR COM_AXIS ivvt_in_1.struct_ctl_ivvt.cam_mdl_dif_ivvt _CNV_A_R_LINEAR_____82_CM 8 0. 60. AXIS_PTS_REF ldpm_cam_mdl_dif_ivvt /end AXIS_DESCR
 /begin AXIS_DESCR COM_AXIS ivvt_in_1.struct_ctl_ivvt.dly_ivvt _CNV_A_R_LINEAR_____31_CM 6 0. 2550. FORMAT "%4.0" AXIS_PTS_REF ldpm_dly_ivvt_1_ivvt /end AXIS_DESCR
/end CHARACTERISTIC
/begin CHARACTERISTIC ip_t_ctl_rtd_ivvt_in "" MAP 0xffe4706b _REC_MAP_20_u1_u1_u1 159.375 _CNV_A_R_LINEAR_____235_CM 0. 159.375 DISPLAY_IDENTIFIER IP_T_CTL_RTD_IVVT_IN FORMAT "%6.1"
 /begin AXIS_DESCR COM_AXIS ivvt_in_1.struct_ctl_ivvt.cam_mdl_dif_ivvt _CNV_A_R_LINEAR_____82_CM 8 0. 60. AXIS_PTS_REF ldpm_cam_mdl_dif_ivvt /end AXIS_DESCR
 /begin AXIS_DESCR COM_AXIS ivvt_in_1.struct_ctl_ivvt.dly_ivvt _CNV_A_R_LINEAR_____31_CM 6 0. 2550. FORMAT "%4.0" AXIS_PTS_REF ldpm_dly_ivvt_1_ivvt /end AXIS_DESCR
/end CHARACTERISTIC
/begin CHARACTERISTIC ip_t_ctl_rtd_ivvt_ex "" MAP 0xffe4703b _REC_MAP_20_u1_u1_u1 159.375 _CNV_A_R_LINEAR_____235_CM 0. 159.375 DISPLAY_IDENTIFIER IP_T_CTL_RTD_IVVT_EX FORMAT "%6.1"
 /begin AXIS_DESCR COM_AXIS ivvt_in_1.struct_ctl_ivvt.cam_mdl_dif_ivvt _CNV_A_R_LINEAR_____82_CM 8 0. 60. AXIS_PTS_REF ldpm_cam_mdl_dif_ivvt /end AXIS_DESCR
 /begin AXIS_DESCR COM_AXIS ivvt_in_1.struct_ctl_ivvt.dly_ivvt _CNV_A_R_LINEAR_____31_CM 6 0. 2550. FORMAT "%4.0" AXIS_PTS_REF ldpm_dly_ivvt_1_ivvt /end AXIS_DESCR
/end CHARACTERISTIC
/begin CHARACTERISTIC ip_t_sum_min_adc_ivvt_ex "" MAP 0xffe478db _REC_MAP_20_u1_u1_u1 158.75 _CNV_A_R_LINEAR_____235_CM 0.625 159.375 DISPLAY_IDENTIFIER IP_T_SUM_MIN_ADC_IVVT_EX FORMAT "%7.3"
 /begin AXIS_DESCR COM_AXIS n_32 _CNV_A_R_LINEAR_____15_CM 4 0. 8160. FORMAT "%4.0" AXIS_PTS_REF ldpm_n_32_1_ivvt /end AXIS_DESCR
 /begin AXIS_DESCR COM_AXIS toil _CNV_A_R_LINEAR_____14_CM 8 -40. 160. FORMAT "%3.0" AXIS_PTS_REF ldpm_toil_1_ivvt /end AXIS_DESCR
/end CHARACTERISTIC
/begin CHARACTERISTIC ip_t_sum_min_adc_ivvt_in "" MAP 0xffe478fb _REC_MAP_20_u1_u1_u1 158.75 _CNV_A_R_LINEAR_____235_CM 0.625 159.375 DISPLAY_IDENTIFIER IP_T_SUM_MIN_ADC_IVVT_IN FORMAT "%7.3"
 /begin AXIS_DESCR COM_AXIS n_32 _CNV_A_R_LINEAR_____15_CM 4 0. 8160. FORMAT "%4.0" AXIS_PTS_REF ldpm_n_32_1_ivvt /end AXIS_DESCR
 /begin AXIS_DESCR COM_AXIS toil _CNV_A_R_LINEAR_____14_CM 8 -40. 160. FORMAT "%3.0" AXIS_PTS_REF ldpm_toil_1_ivvt /end AXIS_DESCR
/end CHARACTERISTIC
/begin CHARACTERISTIC ip_t_sum_min_rtd_ivvt_in "" MAP 0xffe4793b _REC_MAP_20_u1_u1_u1 158.75 _CNV_A_R_LINEAR_____235_CM 0.625 159.375 DISPLAY_IDENTIFIER IP_T_SUM_MIN_RTD_IVVT_IN FORMAT "%7.3"
 /begin AXIS_DESCR COM_AXIS n_32 _CNV_A_R_LINEAR_____15_CM 4 0. 8160. FORMAT "%4.0" AXIS_PTS_REF ldpm_n_32_1_ivvt /end AXIS_DESCR
 /begin AXIS_DESCR COM_AXIS toil _CNV_A_R_LINEAR_____14_CM 8 -40. 160. FORMAT "%3.0" AXIS_PTS_REF ldpm_toil_1_ivvt /end AXIS_DESCR
/end CHARACTERISTIC
/begin CHARACTERISTIC ip_t_sum_min_rtd_ivvt_ex "" MAP 0xffe4791b _REC_MAP_20_u1_u1_u1 158.75 _CNV_A_R_LINEAR_____235_CM 0.625 159.375 DISPLAY_IDENTIFIER IP_T_SUM_MIN_RTD_IVVT_EX FORMAT "%7.3"
 /begin AXIS_DESCR COM_AXIS n_32 _CNV_A_R_LINEAR_____15_CM 4 0. 8160. FORMAT "%4.0" AXIS_PTS_REF ldpm_n_32_1_ivvt /end AXIS_DESCR
 /begin AXIS_DESCR COM_AXIS toil _CNV_A_R_LINEAR_____14_CM 8 -40. 160. FORMAT "%3.0" AXIS_PTS_REF ldpm_toil_1_ivvt /end AXIS_DESCR
/end CHARACTERISTIC
/begin CHARACTERISTIC c_t_add_min_ivvt_adh_in "Increment of energization time in case adhesion detected on inlet cam" VALUE 0xffe4085b _REC_VAL_20_u1 159.375 _CNV_A_R_LINEAR_____235_CM 0. 159.375 DISPLAY_IDENTIFIER C_T_ADD_MIN_IVVT_ADH_IN FORMAT "%6.1" /end CHARACTERISTIC
/begin CHARACTERISTIC c_t_add_min_ivvt_adh_ex "Increment of energization time in case adhesion detected on exhaust cam" VALUE 0xffe4085a _REC_VAL_20_u1 159.375 _CNV_A_R_LINEAR_____235_CM 0. 159.375 DISPLAY_IDENTIFIER C_T_ADD_MIN_IVVT_ADH_EX FORMAT "%6.1" /end CHARACTERISTIC
/begin CHARACTERISTIC c_t_add_min_ivvt_adh_max "Increment of energization time in case adhesion detected on exhaust cam" VALUE 0xffe4085c _REC_VAL_20_u1 159.375 _CNV_A_R_LINEAR_____235_CM 0. 159.375 DISPLAY_IDENTIFIER C_T_ADD_MIN_IVVT_ADH_MAX FORMAT "%6.1" /end CHARACTERISTIC
/begin AXIS_PTS ldpm_cam_mdl_dif_ivvt "" 0xffe48347 ivvt_in_1.struct_ctl_ivvt.cam_mdl_dif_ivvt _REC_AXS_20_u1 60. _CNV_A_R_LINEAR_____82_CM 8 0. 60. DISPLAY_IDENTIFIER LDPM_CAM_MDL_DIF_IVVT /end AXIS_PTS
/begin AXIS_PTS ldpm_dly_ivvt_1_ivvt "" 0xffe41342 ivvt_in_1.struct_ctl_ivvt.dly_ivvt _REC_AXS_20_u1 2550. _CNV_A_R_LINEAR_____31_CM 6 0. 2550. DISPLAY_IDENTIFIER LDPM_DLY_IVVT_1_IVVT FORMAT "%4.0" /end AXIS_PTS
/begin AXIS_PTS ldpm_n_32_4_ivvt "" 0xffe413a8 n_32 _REC_AXS_20_u1 8160. _CNV_A_R_LINEAR_____15_CM 4 0. 8160. DISPLAY_IDENTIFIER LDPM_N_32_4_IVVT FORMAT "%4.0" /end AXIS_PTS
/begin AXIS_PTS ldpm_n_32_3_ivvt "" 0xffe413a1 n_32 _REC_AXS_20_u1 8160. _CNV_A_R_LINEAR_____15_CM 6 0. 8160. DISPLAY_IDENTIFIER LDPM_N_32_3_IVVT FORMAT "%4.0" /end AXIS_PTS
/begin AXIS_PTS ldpm_n_32_2_ivvt "" 0xffe484aa n_32 _REC_AXS_20_u1 8160. _CNV_A_R_LINEAR_____15_CM 8 0. 8160. DISPLAY_IDENTIFIER LDPM_N_32_2_IVVT FORMAT "%4.0" /end AXIS_PTS
/begin AXIS_PTS ldpm_n_32_1_ivvt "" 0xffe41390 n_32 _REC_AXS_20_u1 8160. _CNV_A_R_LINEAR_____15_CM 4 0. 8160. DISPLAY_IDENTIFIER LDPM_N_32_1_IVVT FORMAT "%4.0" /end AXIS_PTS
/begin AXIS_PTS ldpm_toil_1_ivvt "" 0xffe486d5 toil _REC_AXS_20_u1 200. _CNV_A_R_LINEAR_____14_CM 8 -40. 160. DISPLAY_IDENTIFIER LDPM_TOIL_1_IVVT FORMAT "%3.0" /end AXIS_PTS
/begin CHARACTERISTIC c_cam_dif_min_dly_ivvt "" VALUE 0xffe4063a _REC_VAL_20_u1 47.625 _CNV_A_R_LINEAR_____82_CM 0. 47.625 DISPLAY_IDENTIFIER C_CAM_DIF_MIN_DLY_IVVT /end CHARACTERISTIC
/begin CHARACTERISTIC ip_dly_adc_ivvt_ex "" MAP 0xffe44e2e _REC_MAP_20_u1_u1_u1 2550. _CNV_A_R_LINEAR_____31_CM 0. 2550. DISPLAY_IDENTIFIER IP_DLY_ADC_IVVT_EX FORMAT "%4.0"
 /begin AXIS_DESCR COM_AXIS n_32 _CNV_A_R_LINEAR_____15_CM 8 0. 8160. FORMAT "%4.0" AXIS_PTS_REF ldpm_n_32_2_ivvt /end AXIS_DESCR
 /begin AXIS_DESCR COM_AXIS toil _CNV_A_R_LINEAR_____14_CM 8 -40. 160. FORMAT "%3.0" AXIS_PTS_REF ldpm_toil_1_ivvt /end AXIS_DESCR
/end CHARACTERISTIC
/begin CHARACTERISTIC ip_dly_adc_ivvt_in "" MAP 0xffe44e6e _REC_MAP_20_u1_u1_u1 2550. _CNV_A_R_LINEAR_____31_CM 0. 2550. DISPLAY_IDENTIFIER IP_DLY_ADC_IVVT_IN FORMAT "%4.0"
 /begin AXIS_DESCR COM_AXIS n_32 _CNV_A_R_LINEAR_____15_CM 8 0. 8160. FORMAT "%4.0" AXIS_PTS_REF ldpm_n_32_2_ivvt /end AXIS_DESCR
 /begin AXIS_DESCR COM_AXIS toil _CNV_A_R_LINEAR_____14_CM 8 -40. 160. FORMAT "%3.0" AXIS_PTS_REF ldpm_toil_1_ivvt /end AXIS_DESCR
/end CHARACTERISTIC
/begin CHARACTERISTIC ip_dly_rtd_ivvt_ex "" MAP 0xffe44eae _REC_MAP_20_u1_u1_u1 2550. _CNV_A_R_LINEAR_____31_CM 0. 2550. DISPLAY_IDENTIFIER IP_DLY_RTD_IVVT_EX FORMAT "%4.0"
 /begin AXIS_DESCR COM_AXIS n_32 _CNV_A_R_LINEAR_____15_CM 8 0. 8160. FORMAT "%4.0" AXIS_PTS_REF ldpm_n_32_2_ivvt /end AXIS_DESCR
 /begin AXIS_DESCR COM_AXIS toil _CNV_A_R_LINEAR_____14_CM 8 -40. 160. FORMAT "%3.0" AXIS_PTS_REF ldpm_toil_1_ivvt /end AXIS_DESCR
/end CHARACTERISTIC
/begin CHARACTERISTIC ip_dly_rtd_ivvt_in "" MAP 0xffe44eee _REC_MAP_20_u1_u1_u1 2550. _CNV_A_R_LINEAR_____31_CM 0. 2550. DISPLAY_IDENTIFIER IP_DLY_RTD_IVVT_IN FORMAT "%4.0"
 /begin AXIS_DESCR COM_AXIS n_32 _CNV_A_R_LINEAR_____15_CM 8 0. 8160. FORMAT "%4.0" AXIS_PTS_REF ldpm_n_32_2_ivvt /end AXIS_DESCR
 /begin AXIS_DESCR COM_AXIS toil _CNV_A_R_LINEAR_____14_CM 8 -40. 160. FORMAT "%3.0" AXIS_PTS_REF ldpm_toil_1_ivvt /end AXIS_DESCR
/end CHARACTERISTIC
/begin MEASUREMENT ivvt_in.struct_dly_ivvt.dly_adc_ivvt "" UBYTE _CNV_A_R_LINEAR_____31_CM 1 100. 0. 2550. DISPLAY_IDENTIFIER DLY_ADC_IVVT_IN ECU_ADDRESS 0x3fc10c FORMAT "%4.0" /end MEASUREMENT
/begin MEASUREMENT ivvt_in.struct_dly_ivvt.dly_rtd_ivvt "" UBYTE _CNV_A_R_LINEAR_____31_CM 1 100. 0. 2550. DISPLAY_IDENTIFIER DLY_RTD_IVVT_IN ECU_ADDRESS 0x3fc10d FORMAT "%4.0" /end MEASUREMENT
/begin MEASUREMENT ivvt_in.struct_pwm_dyw_ivvt.cam_sp_dyw_ivvt "" UBYTE _CNV_A_R_LINEAR_____230_CM 1 100. 60. 155.625 DISPLAY_IDENTIFIER CAM_SP_DYW_IVVT_IN ECU_ADDRESS 0x3fc10a FORMAT "%7.3" /end MEASUREMENT
/begin MEASUREMENT ivvt_in.struct_pwm_dyw_ivvt.lv_cam_sp_dyw_ivvt "" UBYTE _CNV_A_R_LINEAR_____0_CM 1 100. 0. 1. DISPLAY_IDENTIFIER LV_CAM_SP_DYW_IVVT_IN ECU_ADDRESS 0x3fc10b FORMAT "%1.0" /end MEASUREMENT
/begin MEASUREMENT ivvt_in_1.struct_ctl_ivvt.cam_mdl_dif_ivvt "" SWORD _CNV_A_R_LINEAR_____82_CM 1 100. -60. 60. DISPLAY_IDENTIFIER CAM_MDL_DIF_IVVT_IN_1 ECU_ADDRESS 0x3fc03a BYTE_ORDER MSB_LAST FORMAT "%7.3" /end MEASUREMENT
/begin MEASUREMENT ivvt_in_1.struct_ctl_ivvt.dly_ivvt "" UBYTE _CNV_A_R_LINEAR_____31_CM 1 100. 0. 2550. DISPLAY_IDENTIFIER DLY_IVVT_IN_1 ECU_ADDRESS 0x3fc07c FORMAT "%4.0" /end MEASUREMENT
/begin MEASUREMENT ivvt_in_1.struct_ctl_ivvt.cam_mdl_ivvt "" UWORD _CNV_A_R_LINEAR_____237_CM 1 100. 60. 155.9985 DISPLAY_IDENTIFIER CAM_MDL_IVVT_IN_1 ECU_ADDRESS 0x3fc0a2 BYTE_ORDER MSB_LAST FORMAT "%7.3" /end MEASUREMENT
/begin MEASUREMENT ivvt_in_1.struct_ctl_ivvt.cam_mdl_dly_not_ivvt "" UWORD _CNV_A_R_LINEAR_____237_CM 1 100. 60. 155.9985 DISPLAY_IDENTIFIER CAM_MDL_DLY_NOT_IVVT_IN_1 ECU_ADDRESS 0x3fc0a0 BYTE_ORDER MSB_LAST FORMAT "%7.3" /end MEASUREMENT
/begin MEASUREMENT ivvt_in_1.struct_ctl_ivvt.cam_sp_dif_ivvt "" SWORD _CNV_A_R_LINEAR_____82_CM 1 100. -60. 60. DISPLAY_IDENTIFIER CAM_SP_DIF_IVVT_IN_1 ECU_ADDRESS 0x3fc020 BYTE_ORDER MSB_LAST FORMAT "%7.3" /end MEASUREMENT
/begin MEASUREMENT ivvt_in_1.struct_ctl_ivvt.t_ctl_i_ivvt "" SWORD _CNV_A_R_LINEAR_____235_CM 1 100. -20480. 20479.375 DISPLAY_IDENTIFIER T_CTL_I_IVVT_IN_1 ECU_ADDRESS 0x3fc03e BYTE_ORDER MSB_LAST FORMAT "%8.1" /end MEASUREMENT
/begin MEASUREMENT ivvt_in_1.struct_ctl_ivvt.t_ctl_ivvt "" SWORD _CNV_A_R_LINEAR_____235_CM 1 100. -20480. 20479.375 DISPLAY_IDENTIFIER T_CTL_IVVT_IN_1 ECU_ADDRESS 0x3fc03c BYTE_ORDER MSB_LAST FORMAT "%8.1" /end MEASUREMENT
/begin MEASUREMENT ivvt_in_1.struct_ctl_ivvt.t_ivvt "" SWORD _CNV_A_R_LINEAR_____235_CM 1 100. -20480. 20479.375 DISPLAY_IDENTIFIER T_IVVT_IN_1 ECU_ADDRESS 0x3fc032 BYTE_ORDER MSB_LAST FORMAT "%8.1" /end MEASUREMENT
/begin MEASUREMENT ivvt_in_1.struct_ctl_ivvt.t_sum_ivvt "" SWORD _CNV_A_R_LINEAR_____235_CM 1 100. -20480. 20479.375 DISPLAY_IDENTIFIER T_SUM_IVVT_IN_1 ECU_ADDRESS 0x3fc030 BYTE_ORDER MSB_LAST FORMAT "%8.1" /end MEASUREMENT
/begin MEASUREMENT ivvt_in_1.struct_ctl_ivvt.t_slv_ivvt "" SWORD _CNV_A_R_LINEAR_____235_CM 1 100. -20480. 20479.375 DISPLAY_IDENTIFIER T_SLV_IVVT_IN_1 ECU_ADDRESS 0x3fc07a BYTE_ORDER MSB_LAST FORMAT "%8.1" /end MEASUREMENT
/begin MEASUREMENT ivvt_in_1.struct_ctl_ivvt.t_stop_adj_ivvt "" ULONG _CNV_A_R_LINEAR_____238_CM 1 100. 0. 17179869180. DISPLAY_IDENTIFIER T_STOP_ADJ_IVVT_IN_1 ECU_ADDRESS 0x3fc094 BYTE_ORDER MSB_LAST FORMAT "%11.0" /end MEASUREMENT
/begin MEASUREMENT ivvt_in_1.struct_ctl_ivvt.t_act_ivvt "" ULONG _CNV_A_R_LINEAR_____238_CM 1 100. 0. 17179869180. DISPLAY_IDENTIFIER T_ACT_IVVT_IN_1 ECU_ADDRESS 0x3fc09c BYTE_ORDER MSB_LAST FORMAT "%11.0" /end MEASUREMENT
/begin MEASUREMENT ivvt_in_1.struct_ctl_ivvt.t_ctl_i_lim_ivvt "" SWORD _CNV_A_R_LINEAR_____235_CM 1 100. -20480. 20479.375 DISPLAY_IDENTIFIER T_CTL_I_LIM_IVVT_IN_1 ECU_ADDRESS 0x3fc040 BYTE_ORDER MSB_LAST FORMAT "%8.1" /end MEASUREMENT
/begin MEASUREMENT ivvt_in_1.struct_ctl_ivvt.t_st_adj_ivvt "" ULONG _CNV_A_R_LINEAR_____238_CM 1 100. 0. 17179869180. DISPLAY_IDENTIFIER T_ST_ADJ_IVVT_IN_1 ECU_ADDRESS 0x3fc098 BYTE_ORDER MSB_LAST FORMAT "%11.0" /end MEASUREMENT
/begin MEASUREMENT ivvt_in_1.struct_ctl_ivvt.t_adj_old_ivvt "" UWORD _CNV_A_R_LINEAR_____235_CM 1 100. 0. 40959.375 DISPLAY_IDENTIFIER T_ADJ_OLD_IVVT_IN_1 ECU_ADDRESS 0x3fc08e BYTE_ORDER MSB_LAST FORMAT "%7.1" /end MEASUREMENT
/begin MEASUREMENT ivvt_in_1.struct_ctl_ivvt.t_lim_ivvt "" SWORD _CNV_A_R_LINEAR_____235_CM 1 100. -20480. 20479.375 DISPLAY_IDENTIFIER T_LIM_IVVT_IN_1 ECU_ADDRESS 0x3fc07e BYTE_ORDER MSB_LAST FORMAT "%8.1" /end MEASUREMENT
/begin MEASUREMENT ivvt_in_1.struct_ctl_ivvt.t_ctl_i_lim_1_ivvt "" SWORD _CNV_A_R_LINEAR_____235_CM 1 100. -20480. 20479.375 DISPLAY_IDENTIFIER T_CTL_I_LIM_1_IVVT_IN_1 ECU_ADDRESS 0x3fc042 BYTE_ORDER MSB_LAST FORMAT "%8.1" /end MEASUREMENT
/begin MEASUREMENT ivvt_in_1.struct_ctl_ivvt.t_sum_tmp_ivvt "" SWORD _CNV_A_R_LINEAR_____235_CM 1 100. -20480. 20479.375 DISPLAY_IDENTIFIER T_SUM_TMP_IVVT_IN_1 ECU_ADDRESS 0x3fc08a BYTE_ORDER MSB_LAST FORMAT "%8.1" /end MEASUREMENT
/begin MEASUREMENT ivvt_in_1.struct_ctl_ivvt.t_sum_subt_ivvt "" UWORD _CNV_A_R_LINEAR_____235_CM 1 100. 0. 40959.375 DISPLAY_IDENTIFIER T_SUM_SUBT_IVVT_IN_1 ECU_ADDRESS 0x3fc080 BYTE_ORDER MSB_LAST FORMAT "%7.1" /end MEASUREMENT
/begin MEASUREMENT ivvt_in_1.struct_ctl_ivvt.t_adj_new_ivvt "" UWORD _CNV_A_R_LINEAR_____235_CM 1 100. 0. 40959.375 DISPLAY_IDENTIFIER T_ADJ_NEW_IVVT_IN_1 ECU_ADDRESS 0x3fc08c BYTE_ORDER MSB_LAST FORMAT "%7.1" /end MEASUREMENT
/begin MEASUREMENT ivvt_in_1.struct_ctl_ivvt.t_sum_if_ivvt "" UWORD _CNV_A_R_LINEAR_____238_CM 1 100. 0. 262140. DISPLAY_IDENTIFIER T_SUM_IF_IVVT_IN_1 ECU_ADDRESS 0x3fc036 BYTE_ORDER MSB_LAST FORMAT "%6.0" /end MEASUREMENT
/begin MEASUREMENT ivvt_in_1.struct_ctl_ivvt.cam_dif_ivvt "" SWORD _CNV_A_R_LINEAR_____82_CM 1 100. -60. 60. DISPLAY_IDENTIFIER CAM_DIF_IVVT_IN_1 ECU_ADDRESS 0x3fc022 BYTE_ORDER MSB_LAST FORMAT "%7.3" /end MEASUREMENT
/begin MEASUREMENT ivvt_in_1.struct_ctl_ivvt.cam_clc_delta "" UWORD _CNV_A_R_LINEAR_____239_CM 1 100. 0. 95.99850000000001 DISPLAY_IDENTIFIER CAM_CLC_DELTA_IN_1 ECU_ADDRESS 0x3fc0a4 BYTE_ORDER MSB_LAST /end MEASUREMENT
/begin MEASUREMENT ivvt_in_1.struct_ctl_ivvt.lv_adj_pos_ivvt "" UBYTE _CNV_A_R_LINEAR_____0_CM 1 100. 0. 1. DISPLAY_IDENTIFIER LV_ADJ_POS_IVVT_IN_1 ECU_ADDRESS 0x3fc025 FORMAT "%1.0" /end MEASUREMENT
/begin MEASUREMENT ivvt_in_1.struct_ctl_ivvt.lv_adj_chg_dir_ivvt "" UBYTE _CNV_A_R_LINEAR_____0_CM 1 100. 0. 1. DISPLAY_IDENTIFIER LV_ADJ_CHG_DIR_IVVT_IN_1 ECU_ADDRESS 0x3fc024 FORMAT "%1.0" /end MEASUREMENT
/begin MEASUREMENT ivvt_in_1.struct_ctl_ivvt.lv_hld_req_ivvt "" UBYTE _CNV_A_R_LINEAR_____0_CM 1 100. 0. 1. DISPLAY_IDENTIFIER LV_HLD_REQ_IVVT_IN_1 ECU_ADDRESS 0x3fc034 FORMAT "%1.0" /end MEASUREMENT
/begin MEASUREMENT ivvt_in_1.struct_ctl_ivvt.lv_mdl_adc_ivvt "" UBYTE _CNV_A_R_LINEAR_____0_CM 1 100. 0. 1. DISPLAY_IDENTIFIER LV_MDL_ADC_IVVT_IN_1 ECU_ADDRESS 0x3fc077 FORMAT "%1.0" /end MEASUREMENT
/begin MEASUREMENT ivvt_in_1.struct_ctl_ivvt.state_ivvt_pwm "" ULONG _CNV_S_3_STATE_IVVT_240_CM 1 100. 0. 2. DISPLAY_IDENTIFIER STATE_IVVT_PWM_IN_1 ECU_ADDRESS 0x3fc02c BYTE_ORDER MSB_LAST /end MEASUREMENT
/begin MEASUREMENT ivvt_in_1.struct_ctl_ivvt.state_ivvt_act "" ULONG _CNV_S_5_STATE_IVVT_241_CM 1 100. 0. 4. DISPLAY_IDENTIFIER STATE_IVVT_ACT_IN_1 ECU_ADDRESS 0x3fc028 BYTE_ORDER MSB_LAST /end MEASUREMENT
/begin MEASUREMENT ivvt_in_1.struct_pos_ivvt.cam "" UBYTE _CNV_A_R_LINEAR_____230_CM 1 100. 60. 155.625 DISPLAY_IDENTIFIER CAM_IN_1 ECU_ADDRESS 0x3fbffc FORMAT "%7.3" /end MEASUREMENT
/begin MEASUREMENT ivvt_in_1.struct_pos_ivvt.cam_ref_ivvt "" UWORD _CNV_A_R_LINEAR_____237_CM 1 100. 60. 155.9985 DISPLAY_IDENTIFIER CAM_REF_IVVT_IN_1 ECU_ADDRESS 0x3fc000 BYTE_ORDER MSB_LAST FORMAT "%7.3" /end MEASUREMENT
/begin MEASUREMENT ivvt_in_1.struct_pos_ivvt.cam_ad_ivvt_0 "" SWORD _CNV_A_R_LINEAR_____242_CM 1 100. -48. 47.9985 DISPLAY_IDENTIFIER CAM_AD_IVVT_IN_1_0 ECU_ADDRESS 0x3fc002 BYTE_ORDER MSB_LAST FORMAT "%7.3" /end MEASUREMENT
/begin MEASUREMENT ivvt_in_1.struct_pos_ivvt.cam_ref_dif_ivvt "" SWORD _CNV_A_R_LINEAR_____82_CM 1 100. -95.625 95.625 DISPLAY_IDENTIFIER CAM_REF_DIF_IVVT_IN_1 ECU_ADDRESS 0x3fc008 BYTE_ORDER MSB_LAST FORMAT "%7.3" /end MEASUREMENT
/begin MEASUREMENT ivvt_in_1.struct_pos_ivvt.cam_raw_dyw_ivvt "" UBYTE _CNV_A_R_LINEAR_____230_CM 1 100. 60. 155.625 DISPLAY_IDENTIFIER CAM_RAW_DYW_IVVT_IN_1 ECU_ADDRESS 0x3fc00d FORMAT "%7.3" /end MEASUREMENT
/begin MEASUREMENT ivvt_in_1.struct_pos_ivvt.lv_cam_raw_dyw_ivvt "" UBYTE _CNV_A_R_LINEAR_____0_CM 1 100. 0. 1. DISPLAY_IDENTIFIER LV_CAM_RAW_DYW_IVVT_IN_1 ECU_ADDRESS 0x3fc00a FORMAT "%1.0" /end MEASUREMENT
/begin MEASUREMENT ivvt_in_1.struct_pos_ivvt.cam_ref_raw "" UBYTE _CNV_A_R_LINEAR_____230_CM 1 100. 60. 155.625 DISPLAY_IDENTIFIER CAM_REF_RAW_IN_1 ECU_ADDRESS 0x3fc00e FORMAT "%7.3" /end MEASUREMENT
/begin MEASUREMENT ivvt_in_1.struct_pos_ivvt.cam_ad_ivvt_1 "" SWORD _CNV_A_R_LINEAR_____242_CM 1 100. -48. 47.9985 DISPLAY_IDENTIFIER CAM_AD_IVVT_IN_1_1 ECU_ADDRESS 0x3fc004 BYTE_ORDER MSB_LAST FORMAT "%7.3" /end MEASUREMENT
/begin MEASUREMENT ivvt_in_1.struct_pos_ivvt.cam_ad_ivvt_2 "" SWORD _CNV_A_R_LINEAR_____242_CM 1 100. -48. 47.9985 DISPLAY_IDENTIFIER CAM_AD_IVVT_IN_1_2 ECU_ADDRESS 0x3fc006 BYTE_ORDER MSB_LAST FORMAT "%7.3" /end MEASUREMENT
/begin MEASUREMENT ivvt_in_1.struct_pos_ivvt.cam_park "last valid inlet cam position befor engine stop" UBYTE _CNV_A_R_LINEAR_____230_CM 1 100. 60. 155.625 DISPLAY_IDENTIFIER CAM_IN_PARK_1 ECU_ADDRESS 0x3fc012 FORMAT "%5.1" /end MEASUREMENT
/begin MEASUREMENT ivvt_in_1.struct_pos_ivvt.ctr_cam_dif_ivvt_park " Counter for too high deviation from setpoint in IVVT parking function" UBYTE _CNV_A_R_LINEAR_____0_CM 1 100. 0. 255. DISPLAY_IDENTIFIER CTR_CAM_DIF_IVVT_PARK_IN_1 ECU_ADDRESS 0x3fc013 FORMAT "%3.0" /end MEASUREMENT
/begin MEASUREMENT ivvt_in_1.struct_pos_ivvt.ctr_cam_drift_ivvt_park "Counter for too high camshaft drift in IVVT parking function" UBYTE _CNV_A_R_LINEAR_____0_CM 1 100. 0. 255. DISPLAY_IDENTIFIER CTR_CAM_DRIFT_IVVT_PARK_IN_1 ECU_ADDRESS 0x3fc014 FORMAT "%3.0" /end MEASUREMENT
/begin MEASUREMENT ivvt_in_1.struct_dly_mes_ivvt.dly_mes_adc_ivvt "" UBYTE _CNV_A_R_LINEAR_____31_CM 1 100. 0. 2550. DISPLAY_IDENTIFIER DLY_MES_ADC_IVVT_IN_1 ECU_ADDRESS 0x3fc0bc FORMAT "%4.0" /end MEASUREMENT
/begin MEASUREMENT ivvt_in_1.struct_dly_mes_ivvt.dly_mes_rtd_ivvt "" UBYTE _CNV_A_R_LINEAR_____31_CM 1 100. 0. 2550. DISPLAY_IDENTIFIER DLY_MES_RTD_IVVT_IN_1 ECU_ADDRESS 0x3fc0bd FORMAT "%4.0" /end MEASUREMENT
/begin MEASUREMENT ivvt_in_1.struct_pwm_ivvt.ivvtpwm "" UBYTE _CNV_A_R_LINEAR_____9_CM 1 100. 0. 99.609375 DISPLAY_IDENTIFIER IVVTPWM_IN_1 ECU_ADDRESS 0x3fc0da /end MEASUREMENT
/begin MEASUREMENT ivvt_in_1.struct_pwm_ivvt.sum_cyc_adh_ivvt "" UWORD _CNV_A_R_LINEAR_____0_CM 1 100. 0. 6000. DISPLAY_IDENTIFIER SUM_CYC_ADH_IVVT_IN_1 ECU_ADDRESS 0x3fc0cc BYTE_ORDER MSB_LAST FORMAT "%4.0" /end MEASUREMENT
/begin MEASUREMENT ivvt_in_1.struct_pwm_ivvt.ivvthpwm_adh "" SBYTE _CNV_A_R_LINEAR_____9_CM 1 100. -50. 49.609375 DISPLAY_IDENTIFIER IVVTHPWM_ADH_IN_1 ECU_ADDRESS 0x3fc0db FORMAT "%6.2" /end MEASUREMENT
/begin MEASUREMENT ivvt_in_1.struct_pwm_ivvt.ivvthpwm_adh_save "" SBYTE _CNV_A_R_LINEAR_____9_CM 1 100. -50. 49.609375 DISPLAY_IDENTIFIER IVVTHPWM_ADH_SAVE_IN_1 ECU_ADDRESS 0x3fc0dc FORMAT "%6.2" /end MEASUREMENT
/begin MEASUREMENT ivvt_in_1.struct_pwm_ivvt.lv_adh_act_ivvt "" UBYTE _CNV_A_R_LINEAR_____0_CM 1 100. 0. 1. DISPLAY_IDENTIFIER LV_ADH_ACT_IVVT_IN_1 ECU_ADDRESS 0x3fc0dd FORMAT "%1.0" /end MEASUREMENT
/begin MEASUREMENT ivvt_in_1.struct_pwm_ivvt.lv_adh_end_ivvt "" UBYTE _CNV_A_R_LINEAR_____0_CM 1 100. 0. 1. DISPLAY_IDENTIFIER LV_ADH_END_IVVT_IN_1 ECU_ADDRESS 0x3fc0de FORMAT "%1.0" /end MEASUREMENT
/begin MEASUREMENT ivvt_in_1.struct_pwm_ivvt.sum_state_act_adj_ivvt "" UBYTE _CNV_A_R_LINEAR_____0_CM 1 100. 0. 255. DISPLAY_IDENTIFIER SUM_STATE_ACT_ADJ_IVVT_IN_1 ECU_ADDRESS 0x3fc0df FORMAT "%3.0" /end MEASUREMENT
/begin MEASUREMENT ivvt_in_1.struct_pwm_ivvt.vel_drift_ivvthpwm "" SWORD _CNV_A_R_LINEAR_____243_CM 1 100. -95.625 95.625 DISPLAY_IDENTIFIER VEL_DRIFT_IVVTHPWM_IN_1 ECU_ADDRESS 0x3fc0ce BYTE_ORDER MSB_LAST FORMAT "%7.3" /end MEASUREMENT
/begin MEASUREMENT ivvt_in_1.struct_pwm_ivvt.ivvthpwm_ad "" UBYTE _CNV_A_R_LINEAR_____132_CM 1 100. -50. 49.609375 DISPLAY_IDENTIFIER IVVTHPWM_AD_IN_1 ECU_ADDRESS 0x3fc0e4 FORMAT "%6.2" /end MEASUREMENT
/begin MEASUREMENT ivvt_ex_1.struct_ctl_ivvt.cam_mdl_dif_ivvt "" SWORD _CNV_A_R_LINEAR_____82_CM 1 100. -60. 60. DISPLAY_IDENTIFIER CAM_MDL_DIF_IVVT_EX_1 ECU_ADDRESS 0x3fc156 BYTE_ORDER MSB_LAST FORMAT "%7.3" /end MEASUREMENT
/begin MEASUREMENT ivvt_ex_1.struct_ctl_ivvt.dly_ivvt "" UBYTE _CNV_A_R_LINEAR_____31_CM 1 100. 0. 2550. DISPLAY_IDENTIFIER DLY_IVVT_EX_1 ECU_ADDRESS 0x3fc198 FORMAT "%4.0" /end MEASUREMENT
/begin MEASUREMENT ivvt_ex_1.struct_ctl_ivvt.cam_mdl_ivvt "" UWORD _CNV_A_R_LINEAR_____245_CM 1 100. -40. -135.9985 DISPLAY_IDENTIFIER CAM_MDL_IVVT_EX_1 ECU_ADDRESS 0x3fc1be BYTE_ORDER MSB_LAST FORMAT "%8.3" /end MEASUREMENT
/begin MEASUREMENT ivvt_ex_1.struct_ctl_ivvt.cam_mdl_dly_not_ivvt "" UWORD _CNV_A_R_LINEAR_____245_CM 1 100. -40. -135.9985 DISPLAY_IDENTIFIER CAM_MDL_DLY_NOT_IVVT_EX_1 ECU_ADDRESS 0x3fc1bc BYTE_ORDER MSB_LAST FORMAT "%8.3" /end MEASUREMENT
/begin MEASUREMENT ivvt_ex_1.struct_ctl_ivvt.cam_sp_dif_ivvt "" SWORD _CNV_A_R_LINEAR_____82_CM 1 100. -60. 60. DISPLAY_IDENTIFIER CAM_SP_DIF_IVVT_EX_1 ECU_ADDRESS 0x3fc13c BYTE_ORDER MSB_LAST FORMAT "%7.3" /end MEASUREMENT
/begin MEASUREMENT ivvt_ex_1.struct_ctl_ivvt.t_ctl_ivvt "" SWORD _CNV_A_R_LINEAR_____235_CM 1 100. -20480. 20479.375 DISPLAY_IDENTIFIER T_CTL_IVVT_EX_1 ECU_ADDRESS 0x3fc158 BYTE_ORDER MSB_LAST FORMAT "%8.1" /end MEASUREMENT
/begin MEASUREMENT ivvt_ex_1.struct_ctl_ivvt.t_ctl_i_ivvt "" SWORD _CNV_A_R_LINEAR_____235_CM 1 100. -20480. 20479.375 DISPLAY_IDENTIFIER T_CTL_I_IVVT_EX_1 ECU_ADDRESS 0x3fc15a BYTE_ORDER MSB_LAST FORMAT "%8.1" /end MEASUREMENT
/begin MEASUREMENT ivvt_ex_1.struct_ctl_ivvt.t_ivvt "" SWORD _CNV_A_R_LINEAR_____235_CM 1 100. -20480. 20479.375 DISPLAY_IDENTIFIER T_IVVT_EX_1 ECU_ADDRESS 0x3fc14e BYTE_ORDER MSB_LAST FORMAT "%8.1" /end MEASUREMENT
/begin MEASUREMENT ivvt_ex_1.struct_ctl_ivvt.t_sum_ivvt "" SWORD _CNV_A_R_LINEAR_____235_CM 1 100. -20480. 20479.375 DISPLAY_IDENTIFIER T_SUM_IVVT_EX_1 ECU_ADDRESS 0x3fc14c BYTE_ORDER MSB_LAST FORMAT "%8.1" /end MEASUREMENT
/begin MEASUREMENT ivvt_ex_1.struct_ctl_ivvt.t_slv_ivvt "" SWORD _CNV_A_R_LINEAR_____235_CM 1 100. -20480. 20479.375 DISPLAY_IDENTIFIER T_SLV_IVVT_EX_1 ECU_ADDRESS 0x3fc196 BYTE_ORDER MSB_LAST FORMAT "%8.1" /end MEASUREMENT
/begin MEASUREMENT ivvt_ex_1.struct_ctl_ivvt.t_stop_adj_ivvt "" ULONG _CNV_A_R_LINEAR_____238_CM 1 100. 0. 17179869180. DISPLAY_IDENTIFIER T_STOP_ADJ_IVVT_EX_1 ECU_ADDRESS 0x3fc1b0 BYTE_ORDER MSB_LAST FORMAT "%11.0" /end MEASUREMENT
/begin MEASUREMENT ivvt_ex_1.struct_ctl_ivvt.t_act_ivvt "" ULONG _CNV_A_R_LINEAR_____238_CM 1 100. 0. 17179869180. DISPLAY_IDENTIFIER T_ACT_IVVT_EX_1 ECU_ADDRESS 0x3fc1b8 BYTE_ORDER MSB_LAST FORMAT "%11.0" /end MEASUREMENT
/begin MEASUREMENT ivvt_ex_1.struct_ctl_ivvt.t_ctl_i_lim_ivvt "" SWORD _CNV_A_R_LINEAR_____235_CM 1 100. -20480. 20479.375 DISPLAY_IDENTIFIER T_CTL_I_LIM_IVVT_EX_1 ECU_ADDRESS 0x3fc15c BYTE_ORDER MSB_LAST FORMAT "%8.1" /end MEASUREMENT
/begin MEASUREMENT ivvt_ex_1.struct_ctl_ivvt.t_st_adj_ivvt "" ULONG _CNV_A_R_LINEAR_____238_CM 1 100. 0. 17179869180. DISPLAY_IDENTIFIER T_ST_ADJ_IVVT_EX_1 ECU_ADDRESS 0x3fc1b4 BYTE_ORDER MSB_LAST FORMAT "%11.0" /end MEASUREMENT
/begin MEASUREMENT ivvt_ex_1.struct_ctl_ivvt.t_adj_old_ivvt "" UWORD _CNV_A_R_LINEAR_____235_CM 1 100. 0. 40959.375 DISPLAY_IDENTIFIER T_ADJ_OLD_IVVT_EX_1 ECU_ADDRESS 0x3fc1aa BYTE_ORDER MSB_LAST FORMAT "%7.1" /end MEASUREMENT
/begin MEASUREMENT ivvt_ex_1.struct_ctl_ivvt.t_lim_ivvt "" SWORD _CNV_A_R_LINEAR_____235_CM 1 100. -20480. 20479.375 DISPLAY_IDENTIFIER T_LIM_IVVT_EX_1 ECU_ADDRESS 0x3fc19a BYTE_ORDER MSB_LAST FORMAT "%8.1" /end MEASUREMENT
/begin MEASUREMENT ivvt_ex_1.struct_ctl_ivvt.t_ctl_i_lim_1_ivvt "" SWORD _CNV_A_R_LINEAR_____235_CM 1 100. -20480. 20479.375 DISPLAY_IDENTIFIER T_CTL_I_LIM_1_IVVT_EX_1 ECU_ADDRESS 0x3fc15e BYTE_ORDER MSB_LAST FORMAT "%8.1" /end MEASUREMENT
/begin MEASUREMENT ivvt_ex_1.struct_ctl_ivvt.t_sum_tmp_ivvt "" SWORD _CNV_A_R_LINEAR_____235_CM 1 100. -20480. 20479.375 DISPLAY_IDENTIFIER T_SUM_TMP_IVVT_EX_1 ECU_ADDRESS 0x3fc1a6 BYTE_ORDER MSB_LAST FORMAT "%8.1" /end MEASUREMENT
/begin MEASUREMENT ivvt_ex_1.struct_ctl_ivvt.t_sum_subt_ivvt "" UWORD _CNV_A_R_LINEAR_____235_CM 1 100. 0. 40959.375 DISPLAY_IDENTIFIER T_SUM_SUBT_IVVT_EX_1 ECU_ADDRESS 0x3fc19c BYTE_ORDER MSB_LAST FORMAT "%7.1" /end MEASUREMENT
/begin MEASUREMENT ivvt_ex_1.struct_ctl_ivvt.t_adj_new_ivvt "" UWORD _CNV_A_R_LINEAR_____235_CM 1 100. 0. 40959.375 DISPLAY_IDENTIFIER T_ADJ_NEW_IVVT_EX_1 ECU_ADDRESS 0x3fc1a8 BYTE_ORDER MSB_LAST FORMAT "%7.1" /end MEASUREMENT
/begin MEASUREMENT ivvt_ex_1.struct_ctl_ivvt.t_sum_if_ivvt "" UWORD _CNV_A_R_LINEAR_____238_CM 1 100. 0. 262140. DISPLAY_IDENTIFIER T_SUM_IF_IVVT_EX_1 ECU_ADDRESS 0x3fc152 BYTE_ORDER MSB_LAST FORMAT "%6.0" /end MEASUREMENT
/begin MEASUREMENT ivvt_ex_1.struct_ctl_ivvt.cam_dif_ivvt "" SWORD _CNV_A_R_LINEAR_____82_CM 1 100. -60. 60. DISPLAY_IDENTIFIER CAM_DIF_IVVT_EX_1 ECU_ADDRESS 0x3fc13e BYTE_ORDER MSB_LAST FORMAT "%7.3" /end MEASUREMENT
/begin MEASUREMENT ivvt_ex_1.struct_ctl_ivvt.cam_clc_delta "" UWORD _CNV_A_R_LINEAR_____239_CM 1 100. 0. 95.99850000000001 DISPLAY_IDENTIFIER CAM_CLC_DELTA_EX_1 ECU_ADDRESS 0x3fc1c0 BYTE_ORDER MSB_LAST /end MEASUREMENT
/begin MEASUREMENT ivvt_ex_1.struct_ctl_ivvt.lv_adj_pos_ivvt "" UBYTE _CNV_A_R_LINEAR_____0_CM 1 100. 0. 1. DISPLAY_IDENTIFIER LV_ADJ_POS_IVVT_EX_1 ECU_ADDRESS 0x3fc141 FORMAT "%1.0" /end MEASUREMENT
/begin MEASUREMENT ivvt_ex_1.struct_ctl_ivvt.lv_adj_chg_dir_ivvt "" UBYTE _CNV_A_R_LINEAR_____0_CM 1 100. 0. 1. DISPLAY_IDENTIFIER LV_ADJ_CHG_DIR_IVVT_EX_1 ECU_ADDRESS 0x3fc140 FORMAT "%1.0" /end MEASUREMENT
/begin MEASUREMENT ivvt_ex_1.struct_ctl_ivvt.lv_hld_req_ivvt "" UBYTE _CNV_A_R_LINEAR_____0_CM 1 100. 0. 1. DISPLAY_IDENTIFIER LV_HLD_REQ_IVVT_EX_1 ECU_ADDRESS 0x3fc150 FORMAT "%1.0" /end MEASUREMENT
/begin MEASUREMENT ivvt_ex_1.struct_ctl_ivvt.lv_mdl_adc_ivvt "" UBYTE _CNV_A_R_LINEAR_____0_CM 1 100. 0. 1. DISPLAY_IDENTIFIER LV_MDL_ADC_IVVT_EX_1 ECU_ADDRESS 0x3fc193 FORMAT "%1.0" /end MEASUREMENT
/begin MEASUREMENT ivvt_ex_1.struct_ctl_ivvt.state_ivvt_act "" ULONG _CNV_S_5_STATE_IVVT_241_CM 1 100. 0. 4. DISPLAY_IDENTIFIER STATE_IVVT_ACT_EX_1 ECU_ADDRESS 0x3fc144 BYTE_ORDER MSB_LAST /end MEASUREMENT
/begin MEASUREMENT ivvt_ex_1.struct_ctl_ivvt.state_ivvt_pwm "" ULONG _CNV_S_3_STATE_IVVT_240_CM 1 100. 0. 2. DISPLAY_IDENTIFIER STATE_IVVT_PWM_EX_1 ECU_ADDRESS 0x3fc148 BYTE_ORDER MSB_LAST /end MEASUREMENT
/begin MEASUREMENT ivvt_ex_1.struct_pos_ivvt.cam "" UBYTE _CNV_A_R_LINEAR_____227_CM 1 100. -40. -135.625 DISPLAY_IDENTIFIER CAM_EX_1 ECU_ADDRESS 0x3fc118 FORMAT "%8.3" /end MEASUREMENT
/begin MEASUREMENT ivvt_ex_1.struct_pos_ivvt.cam_ref_ivvt "" UWORD _CNV_A_R_LINEAR_____245_CM 1 100. -40. -135.9985 DISPLAY_IDENTIFIER CAM_REF_IVVT_EX_1 ECU_ADDRESS 0x3fc11c BYTE_ORDER MSB_LAST FORMAT "%8.3" /end MEASUREMENT
/begin MEASUREMENT ivvt_ex_1.struct_pos_ivvt.cam_ad_ivvt_0 "" SWORD _CNV_A_R_LINEAR_____242_CM 1 100. -48. 47.9985 DISPLAY_IDENTIFIER CAM_AD_IVVT_EX_1_0 ECU_ADDRESS 0x3fc11e BYTE_ORDER MSB_LAST FORMAT "%7.3" /end MEASUREMENT
/begin MEASUREMENT ivvt_ex_1.struct_pos_ivvt.cam_ref_dif_ivvt "" SWORD _CNV_A_R_LINEAR_____82_CM 1 100. -95.625 95.625 DISPLAY_IDENTIFIER CAM_REF_DIF_IVVT_EX_1 ECU_ADDRESS 0x3fc124 BYTE_ORDER MSB_LAST FORMAT "%7.3" /end MEASUREMENT
/begin MEASUREMENT ivvt_ex_1.struct_pos_ivvt.cam_raw_dyw_ivvt "" UBYTE _CNV_A_R_LINEAR_____227_CM 1 100. -40. -135.625 DISPLAY_IDENTIFIER CAM_RAW_DYW_IVVT_EX_1 ECU_ADDRESS 0x3fc129 FORMAT "%8.3" /end MEASUREMENT
/begin MEASUREMENT ivvt_ex_1.struct_pos_ivvt.lv_cam_raw_dyw_ivvt "" UBYTE _CNV_A_R_LINEAR_____0_CM 1 100. 0. 1. DISPLAY_IDENTIFIER LV_CAM_RAW_DYW_IVVT_EX_1 ECU_ADDRESS 0x3fc126 FORMAT "%1.0" /end MEASUREMENT
/begin MEASUREMENT ivvt_ex_1.struct_pos_ivvt.cam_ref_raw "" UBYTE _CNV_A_R_LINEAR_____227_CM 1 100. -40. -135.625 DISPLAY_IDENTIFIER CAM_REF_RAW_EX_1 ECU_ADDRESS 0x3fc12a FORMAT "%8.3" /end MEASUREMENT
/begin MEASUREMENT ivvt_ex_1.struct_pos_ivvt.cam_ad_ivvt_1 "" SWORD _CNV_A_R_LINEAR_____242_CM 1 100. -48. 47.9985 DISPLAY_IDENTIFIER CAM_AD_IVVT_EX_1_1 ECU_ADDRESS 0x3fc120 BYTE_ORDER MSB_LAST FORMAT "%7.3" /end MEASUREMENT
/begin MEASUREMENT ivvt_ex_1.struct_pos_ivvt.cam_ad_ivvt_2 "" SWORD _CNV_A_R_LINEAR_____242_CM 1 100. -48. 47.9985 DISPLAY_IDENTIFIER CAM_AD_IVVT_EX_1_2 ECU_ADDRESS 0x3fc122 BYTE_ORDER MSB_LAST FORMAT "%7.3" /end MEASUREMENT
/begin MEASUREMENT ivvt_ex_1.struct_pos_ivvt.cam_park "last valid exhaust cam position befor engine stop" UBYTE _CNV_A_R_LINEAR_____227_CM 1 100. -40. -135.625 DISPLAY_IDENTIFIER CAM_EX_PARK_1 ECU_ADDRESS 0x3fc12e FORMAT "%8.3" /end MEASUREMENT
/begin MEASUREMENT ivvt_ex_1.struct_pos_ivvt.ctr_cam_dif_ivvt_park " Counter for too high deviation from setpoint in IVVT parking function" UBYTE _CNV_A_R_LINEAR_____0_CM 1 100. 0. 255. DISPLAY_IDENTIFIER CTR_CAM_DIF_IVVT_PARK_EX_1 ECU_ADDRESS 0x3fc12f FORMAT "%3.0" /end MEASUREMENT
/begin MEASUREMENT ivvt_ex_1.struct_pos_ivvt.ctr_cam_drift_ivvt_park "Counter for too high camshaft drift in IVVT parking function" UBYTE _CNV_A_R_LINEAR_____0_CM 1 100. 0. 255. DISPLAY_IDENTIFIER CTR_CAM_DRIFT_IVVT_PARK_EX_1 ECU_ADDRESS 0x3fc130 FORMAT "%3.0" /end MEASUREMENT
/begin MEASUREMENT ivvt_ex_1.struct_dly_mes_ivvt.dly_mes_adc_ivvt "" UBYTE _CNV_A_R_LINEAR_____31_CM 1 100. 0. 2550. DISPLAY_IDENTIFIER DLY_MES_ADC_IVVT_EX_1 ECU_ADDRESS 0x3fc1d8 FORMAT "%4.0" /end MEASUREMENT
/begin MEASUREMENT ivvt_ex_1.struct_dly_mes_ivvt.dly_mes_rtd_ivvt "" UBYTE _CNV_A_R_LINEAR_____31_CM 1 100. 0. 2550. DISPLAY_IDENTIFIER DLY_MES_RTD_IVVT_EX_1 ECU_ADDRESS 0x3fc1d9 FORMAT "%4.0" /end MEASUREMENT
/begin MEASUREMENT ivvt_ex_1.struct_pwm_ivvt.ivvtpwm "" UBYTE _CNV_A_R_LINEAR_____9_CM 1 100. 0. 99.609375 DISPLAY_IDENTIFIER IVVTPWM_EX_1 ECU_ADDRESS 0x3fc1f6 /end MEASUREMENT
/begin MEASUREMENT ivvt_ex_1.struct_pwm_ivvt.sum_cyc_adh_ivvt "" UWORD _CNV_A_R_LINEAR_____0_CM 1 100. 0. 6000. DISPLAY_IDENTIFIER SUM_CYC_ADH_IVVT_EX_1 ECU_ADDRESS 0x3fc1e8 BYTE_ORDER MSB_LAST FORMAT "%4.0" /end MEASUREMENT
/begin MEASUREMENT ivvt_ex_1.struct_pwm_ivvt.ivvthpwm_adh "" SBYTE _CNV_A_R_LINEAR_____9_CM 1 100. -50. 49.609375 DISPLAY_IDENTIFIER IVVTHPWM_ADH_EX_1 ECU_ADDRESS 0x3fc1f7 FORMAT "%6.2" /end MEASUREMENT
/begin MEASUREMENT ivvt_ex_1.struct_pwm_ivvt.ivvthpwm_adh_save "" SBYTE _CNV_A_R_LINEAR_____9_CM 1 100. -50. 49.609375 DISPLAY_IDENTIFIER IVVTHPWM_ADH_SAVE_EX_1 ECU_ADDRESS 0x3fc1f8 FORMAT "%6.2" /end MEASUREMENT
/begin MEASUREMENT ivvt_ex_1.struct_pwm_ivvt.lv_adh_act_ivvt "" UBYTE _CNV_A_R_LINEAR_____0_CM 1 100. 0. 1. DISPLAY_IDENTIFIER LV_ADH_ACT_IVVT_EX_1 ECU_ADDRESS 0x3fc1f9 FORMAT "%1.0" /end MEASUREMENT
/begin MEASUREMENT ivvt_ex_1.struct_pwm_ivvt.lv_adh_end_ivvt "" UBYTE _CNV_A_R_LINEAR_____0_CM 1 100. 0. 1. DISPLAY_IDENTIFIER LV_ADH_END_IVVT_EX_1 ECU_ADDRESS 0x3fc1fa FORMAT "%1.0" /end MEASUREMENT
/begin MEASUREMENT ivvt_ex_1.struct_pwm_ivvt.sum_state_act_adj_ivvt "" UBYTE _CNV_A_R_LINEAR_____0_CM 1 100. 0. 255. DISPLAY_IDENTIFIER SUM_STATE_ACT_ADJ_IVVT_EX_1 ECU_ADDRESS 0x3fc1fb FORMAT "%3.0" /end MEASUREMENT
/begin MEASUREMENT ivvt_ex_1.struct_pwm_ivvt.vel_drift_ivvthpwm "" SWORD _CNV_A_R_LINEAR_____243_CM 1 100. -95.625 95.625 DISPLAY_IDENTIFIER VEL_DRIFT_IVVTHPWM_EX_1 ECU_ADDRESS 0x3fc1ea BYTE_ORDER MSB_LAST FORMAT "%7.3" /end MEASUREMENT
/begin MEASUREMENT ivvt_ex_1.struct_pwm_ivvt.ivvthpwm_ad "" UBYTE _CNV_A_R_LINEAR_____132_CM 1 100. -50. 49.609375 DISPLAY_IDENTIFIER IVVTHPWM_AD_EX_1 ECU_ADDRESS 0x3fc200 FORMAT "%6.2" /end MEASUREMENT
/begin MEASUREMENT ivvt_ex.struct_dly_ivvt.dly_adc_ivvt "" UBYTE _CNV_A_R_LINEAR_____31_CM 1 100. 0. 2550. DISPLAY_IDENTIFIER DLY_ADC_IVVT_EX ECU_ADDRESS 0x3fc228 FORMAT "%4.0" /end MEASUREMENT
/begin MEASUREMENT ivvt_ex.struct_dly_ivvt.dly_rtd_ivvt "" UBYTE _CNV_A_R_LINEAR_____31_CM 1 100. 0. 2550. DISPLAY_IDENTIFIER DLY_RTD_IVVT_EX ECU_ADDRESS 0x3fc229 FORMAT "%4.0" /end MEASUREMENT
/begin MEASUREMENT ivvt_ex.struct_pwm_dyw_ivvt.cam_sp_dyw_ivvt "" UBYTE _CNV_A_R_LINEAR_____227_CM 1 100. -40. -135.625 DISPLAY_IDENTIFIER CAM_SP_DYW_IVVT_EX ECU_ADDRESS 0x3fc226 FORMAT "%8.3" /end MEASUREMENT
/begin MEASUREMENT ivvt_ex.struct_pwm_dyw_ivvt.lv_cam_sp_dyw_ivvt "" UBYTE _CNV_A_R_LINEAR_____0_CM 1 100. 0. 1. DISPLAY_IDENTIFIER LV_CAM_SP_DYW_IVVT_EX ECU_ADDRESS 0x3fc227 FORMAT "%1.0" /end MEASUREMENT
/begin CHARACTERISTIC ip_fac_ivvtpwm "" CURVE 0xffe40ba2 _REC_CUR_20_u1_u1 1.9921875 _CNV_A_R_LINEAR_____117_CM 0. 1.9921875 DISPLAY_IDENTIFIER IP_FAC_IVVTPWM FORMAT "%5.3"
 /begin AXIS_DESCR COM_AXIS vb _CNV_A_R_LINEAR_____60_CM 3 0. 26. FORMAT "%4.1" AXIS_PTS_REF ldp_vb__fac_ivvtpwm /end AXIS_DESCR
/end CHARACTERISTIC
/begin CHARACTERISTIC ip_ivvthpwm "" MAP 0xffe46ad4 _REC_MAP_20_u1_u1_u1 99.609375 _CNV_A_R_LINEAR_____9_CM 0. 99.609375 DISPLAY_IDENTIFIER IP_IVVTHPWM
 /begin AXIS_DESCR COM_AXIS tmag_ivvt _CNV_A_R_LINEAR_____14_CM 12 -40. 160. FORMAT "%3.0" AXIS_PTS_REF ldpm_tmag_ivvt_1_ivvt /end AXIS_DESCR
 /begin AXIS_DESCR COM_AXIS vb _CNV_A_R_LINEAR_____60_CM 4 0. 26. FORMAT "%4.1" AXIS_PTS_REF ldp_vb_ip_ivvthpwm /end AXIS_DESCR
/end CHARACTERISTIC
/begin CHARACTERISTIC c_ivvtpwm_ad_ofs_ex "" VALUE 0xffe4038e _REC_VAL_20_s1 99.609375 _CNV_A_R_LINEAR_____9_CM -50. 49.609375 DISPLAY_IDENTIFIER C_IVVTPWM_AD_OFS_EX FORMAT "%6.2" /end CHARACTERISTIC
/begin CHARACTERISTIC c_ivvtpwm_adc_ex "" VALUE 0xffe4077e _REC_VAL_20_u1 99.609375 _CNV_A_R_LINEAR_____9_CM 0. 99.609375 DISPLAY_IDENTIFIER C_IVVTPWM_ADC_EX /end CHARACTERISTIC
/begin CHARACTERISTIC c_ivvtpwm_adc_in "" VALUE 0xffe4077f _REC_VAL_20_u1 99.609375 _CNV_A_R_LINEAR_____9_CM 0. 99.609375 DISPLAY_IDENTIFIER C_IVVTPWM_ADC_IN /end CHARACTERISTIC
/begin CHARACTERISTIC c_ivvtpwm_rtd_ex "" VALUE 0xffe40780 _REC_VAL_20_u1 99.609375 _CNV_A_R_LINEAR_____9_CM 0. 99.609375 DISPLAY_IDENTIFIER C_IVVTPWM_RTD_EX /end CHARACTERISTIC
/begin CHARACTERISTIC c_ivvtpwm_rtd_in "" VALUE 0xffe40781 _REC_VAL_20_u1 99.609375 _CNV_A_R_LINEAR_____9_CM 0. 99.609375 DISPLAY_IDENTIFIER C_IVVTPWM_RTD_IN /end CHARACTERISTIC
/begin CHARACTERISTIC c_cam_hys_adh_ivvt "" VALUE 0xffe40640 _REC_VAL_20_u1 60. _CNV_A_R_LINEAR_____82_CM 0. 60. DISPLAY_IDENTIFIER C_CAM_HYS_ADH_IVVT /end CHARACTERISTIC
/begin CHARACTERISTIC c_cam_hys_rst_adh_ivvt "" VALUE 0xffe40643 _REC_VAL_20_u1 60. _CNV_A_R_LINEAR_____82_CM 0. 60. DISPLAY_IDENTIFIER C_CAM_HYS_RST_ADH_IVVT /end CHARACTERISTIC
/begin CHARACTERISTIC c_cam_sp_dif_adh_ivvt "" VALUE 0xffe4064b _REC_VAL_20_u1 60. _CNV_A_R_LINEAR_____82_CM 0. 60. DISPLAY_IDENTIFIER C_CAM_SP_DIF_ADH_IVVT /end CHARACTERISTIC
/begin CHARACTERISTIC c_cyc_max_adh_ivvt "" VALUE 0xffe406d9 _REC_VAL_20_u1 255. _CNV_A_R_LINEAR_____0_CM 0. 255. DISPLAY_IDENTIFIER C_CYC_MAX_ADH_IVVT FORMAT "%3.0" /end CHARACTERISTIC
/begin CHARACTERISTIC c_sum_seg_dly_ivvthpwm "" VALUE 0xffe40855 _REC_VAL_20_u1 254. _CNV_A_R_LINEAR_____0_CM 1. 255. DISPLAY_IDENTIFIER C_SUM_SEG_DLY_IVVTHPWM FORMAT "%3.0" /end CHARACTERISTIC
/begin MEASUREMENT t_dly_mes_ivvt "" UWORD _CNV_A_R_LINEAR_____31_CM 1 100. 0. 655350. DISPLAY_IDENTIFIER T_DLY_MES_IVVT ECU_ADDRESS 0x3fd348 BYTE_ORDER MSB_LAST FORMAT "%6.0" /end MEASUREMENT
/begin CHARACTERISTIC c_ivvthpwm_ad_min "" VALUE 0xffe4077d _REC_VAL_20_u1 99.609375 _CNV_A_R_LINEAR_____132_CM -50. 49.609375 DISPLAY_IDENTIFIER C_IVVTHPWM_AD_MIN FORMAT "%6.2" /end CHARACTERISTIC
/begin CHARACTERISTIC c_ivvthpwm_ad_max "" VALUE 0xffe4077c _REC_VAL_20_u1 99.609375 _CNV_A_R_LINEAR_____132_CM -50. 49.609375 DISPLAY_IDENTIFIER C_IVVTHPWM_AD_MAX FORMAT "%6.2" /end CHARACTERISTIC
/begin CHARACTERISTIC ip_cyc_min_adh_ivvt "" CURVE 0xffe41c24 _REC_CUR_20_u2_u1 6000. _CNV_A_R_LINEAR_____0_CM 0. 6000. DISPLAY_IDENTIFIER IP_CYC_MIN_ADH_IVVT FORMAT "%4.0"
 /begin AXIS_DESCR COM_AXIS n_32 _CNV_A_R_LINEAR_____15_CM 4 0. 8160. FORMAT "%4.0" AXIS_PTS_REF ldpm_n_32_1_ivvt /end AXIS_DESCR
/end CHARACTERISTIC
/begin CHARACTERISTIC ip_ivvthpwm_adh "" CURVE 0xffe40cd9 _REC_CUR_20_u1_u2 49.609375 _CNV_A_R_LINEAR_____9_CM 0. 49.609375 DISPLAY_IDENTIFIER IP_IVVTHPWM_ADH
 /begin AXIS_DESCR COM_AXIS online_dummy _CNV_A_R_LINEAR_____247_CM 5 -60. 60. FORMAT "%7.3" AXIS_PTS_REF ldpm_cam_dif_ivvt /end AXIS_DESCR
/end CHARACTERISTIC
/begin CHARACTERISTIC ip_ivvthpwm_adh_cyc_in "" CURVE 0xffe40ce3 _REC_CUR_20_u1_u2 255. _CNV_A_R_LINEAR_____0_CM 0. 255. DISPLAY_IDENTIFIER IP_IVVTHPWM_ADH_CYC_IN FORMAT "%3.0"
 /begin AXIS_DESCR COM_AXIS online_dummy _CNV_A_R_LINEAR_____247_CM 5 -60. 60. FORMAT "%7.3" AXIS_PTS_REF ldpm_cam_dif_ivvt /end AXIS_DESCR
/end CHARACTERISTIC
/begin CHARACTERISTIC ip_ivvthpwm_adh_cyc_ex "" CURVE 0xffe40cde _REC_CUR_20_u1_u2 255. _CNV_A_R_LINEAR_____0_CM 0. 255. DISPLAY_IDENTIFIER IP_IVVTHPWM_ADH_CYC_EX FORMAT "%3.0"
 /begin AXIS_DESCR COM_AXIS online_dummy _CNV_A_R_LINEAR_____247_CM 5 -60. 60. FORMAT "%7.3" AXIS_PTS_REF ldpm_cam_dif_ivvt /end AXIS_DESCR
/end CHARACTERISTIC
/begin CHARACTERISTIC id_ivvthpwm_cor_ad "" MAP 0xffe4411c _REC_MAP_20_u1_u1_u2 49.609375 _CNV_A_R_LINEAR_____9_CM 0. 49.609375 DISPLAY_IDENTIFIER ID_IVVTHPWM_COR_AD
 /begin AXIS_DESCR COM_AXIS online_dummy _CNV_A_R_LINEAR_____243_CM 6 0. 95.625 FORMAT "%5.2" AXIS_PTS_REF ldp_vel_drift_ip_ivvthpwm_cor /end AXIS_DESCR
 /begin AXIS_DESCR COM_AXIS online_dummy _CNV_A_R_LINEAR_____142_CM 6 0. 65535. FORMAT "%5.0" AXIS_PTS_REF ldp_t_drift_ivvthpwm /end AXIS_DESCR
/end CHARACTERISTIC
/begin AXIS_PTS ldp_vb__fac_ivvtpwm "" 0xffe412e2 vb _REC_AXS_20_u1 26. _CNV_A_R_LINEAR_____60_CM 3 0. 26. DISPLAY_IDENTIFIER LDP_VB__FAC_IVVTPWM FORMAT "%4.1" /end AXIS_PTS
/begin AXIS_PTS ldp_vb_ip_ivvthpwm "" 0xffe412ed vb _REC_AXS_20_u1 26. _CNV_A_R_LINEAR_____60_CM 4 0. 26. DISPLAY_IDENTIFIER LDP_VB_IP_IVVTHPWM FORMAT "%4.1" /end AXIS_PTS
/begin AXIS_PTS ldpm_cam_dif_ivvt "" 0xffe5176c online_dummy _REC_AXS_20_u2 120. _CNV_A_R_LINEAR_____247_CM 5 -60. 60. DISPLAY_IDENTIFIER LDPM_CAM_DIF_IVVT FORMAT "%7.3" /end AXIS_PTS
/begin AXIS_PTS ldp_vel_drift_ip_ivvthpwm_cor "" 0xffe412f2 online_dummy _REC_AXS_20_u1 95.625 _CNV_A_R_LINEAR_____243_CM 6 0. 95.625 DISPLAY_IDENTIFIER LDP_VEL_DRIFT_IP_IVVTHPWM_COR FORMAT "%5.2" /end AXIS_PTS
/begin AXIS_PTS ldp_t_drift_ivvthpwm "" 0xffe512ce online_dummy _REC_AXS_20_u2 65535. _CNV_A_R_LINEAR_____142_CM 6 0. 65535. DISPLAY_IDENTIFIER LDP_T_DRIFT_IVVTHPWM FORMAT "%5.0" /end AXIS_PTS
/begin CHARACTERISTIC ivvthpwm_ad_ex_1 "" CURVE 0x3fee4a _REC_CUR_20_u1_u1 99.609375 _CNV_A_R_LINEAR_____132_CM -50. 49.609375 READ_ONLY DISPLAY_IDENTIFIER IVVTHPWM_AD_EX_1 FORMAT "%6.2" MAX_REFRESH 4 100
 /begin AXIS_DESCR COM_AXIS tmag_ivvt _CNV_A_R_LINEAR_____14_CM 12 -40. 160. FORMAT "%3.0" AXIS_PTS_REF ldpm_tmag_ivvt_1_ivvt /end AXIS_DESCR
/end CHARACTERISTIC
/begin AXIS_PTS ldpm_tmag_ivvt_1_ivvt "" 0xffe486c8 tmag_ivvt _REC_AXS_20_u1 200. _CNV_A_R_LINEAR_____14_CM 12 -40. 160. DISPLAY_IDENTIFIER LDPM_TMAG_IVVT_1_IVVT FORMAT "%3.0" /end AXIS_PTS
/begin CHARACTERISTIC ivvthpwm_ad_in_1 "" CURVE 0x3fee3e _REC_CUR_20_u1_u1 99.609375 _CNV_A_R_LINEAR_____132_CM -50. 49.609375 READ_ONLY DISPLAY_IDENTIFIER IVVTHPWM_AD_IN_1 FORMAT "%6.2" MAX_REFRESH 4 100
 /begin AXIS_DESCR COM_AXIS tmag_ivvt _CNV_A_R_LINEAR_____14_CM 12 -40. 160. FORMAT "%3.0" AXIS_PTS_REF ldpm_tmag_ivvt_1_ivvt /end AXIS_DESCR
/end CHARACTERISTIC
/begin CHARACTERISTIC ip_tmag_ivvt "" MAP 0xffe47e1b _REC_MAP_20_u1_u1_u1 200. _CNV_A_R_LINEAR_____14_CM -40. 160. DISPLAY_IDENTIFIER IP_TMAG_IVVT FORMAT "%3.0"
 /begin AXIS_DESCR COM_AXIS toil _CNV_A_R_LINEAR_____14_CM 10 -40. 160. FORMAT "%3.0" AXIS_PTS_REF ldp_toil_ip_tmag_ivvt /end AXIS_DESCR
 /begin AXIS_DESCR COM_AXIS tco _CNV_A_R_LINEAR_____11_CM 10 -48. 142.5 FORMAT "%6.2" AXIS_PTS_REF ldp_tco_ip_tmag_ivvt /end AXIS_DESCR
/end CHARACTERISTIC
/begin MEASUREMENT tmag_ivvt "" UBYTE _CNV_A_R_LINEAR_____14_CM 1 100. -40. 160. DISPLAY_IDENTIFIER TMAG_IVVT ECU_ADDRESS 0x3fe4d0 FORMAT "%3.0" /end MEASUREMENT
/begin AXIS_PTS ldp_tco_ip_tmag_ivvt "" 0xffe48237 tco _REC_AXS_20_u1 190.5 _CNV_A_R_LINEAR_____11_CM 10 -48. 142.5 DISPLAY_IDENTIFIER LDP_TCO_IP_TMAG_IVVT FORMAT "%6.2" /end AXIS_PTS
/begin AXIS_PTS ldp_toil_ip_tmag_ivvt "" 0xffe482ae toil _REC_AXS_20_u1 200. _CNV_A_R_LINEAR_____14_CM 10 -40. 160. DISPLAY_IDENTIFIER LDP_TOIL_IP_TMAG_IVVT FORMAT "%3.0" /end AXIS_PTS
/begin CHARACTERISTIC CRENGOF "Offset für Strombedarf Motor" VALUE 0xffe5a154 _REC_VAL_20_u1 127. _CNV_R_R_i_vvt_ub_q_542_CM -63.5 63.5 FORMAT "%8.4" /end CHARACTERISTIC
/begin CHARACTERISTIC CRVVTOF "Stromoffset VVT" VALUE 0xffe5a156 _REC_VAL_20_u1 64. _CNV_R_R_i_vvt_ub_q_542_CM 0. 64. FORMAT "%8.4" /end CHARACTERISTIC
/begin CHARACTERISTIC KFELUPWM "Strom E-Lüfter über pwm und ub" MAP 0xffe5a098 _REC_MAP_52_u2_u2_u2 64. _CNV_R_R_i_eluft_q0_543_CM 0. 64. FORMAT "%8.4"
 /begin AXIS_DESCR STD_AXIS taml_tmp _CNV_R_R_rel_ub_b10_544_CM 7 0. 100. FORMAT "%8.4" /end AXIS_DESCR
 /begin AXIS_DESCR STD_AXIS vfzg_tmp _CNV_R_R_vfzg_ub_q1_545_CM 7 0. 318.75 FORMAT "%8.4" /end AXIS_DESCR
/end CHARACTERISTIC
/begin CHARACTERISTIC KLELTEMP "Temperaturfaktor Elüfter" CURVE 0xffe5a11a _REC_CUR_52_u2_u2 1.9921875 _CNV_R_R_fak_ub_b2_546_CM 0. 1.9921875 FORMAT "%8.4"
 /begin AXIS_DESCR STD_AXIS tans_tmp _CNV_R_R_temp_uw_q0_547_CM 6 -48. 143.25 FORMAT "%8.4" /end AXIS_DESCR
/end CHARACTERISTIC
/begin CHARACTERISTIC CRVVTNOT "Wert vvt_iges bei vvt_es Fehlersignal" VALUE 0xffe5a155 _REC_VAL_20_u1 127.5 _CNV_R_R_i_vvt_ub_q_542_CM -63.5 64. FORMAT "%8.4" /end CHARACTERISTIC
/begin CHARACTERISTIC KLELSLP "Kennlinie E-Lüfter Strom" CURVE 0xffe5a14a _REC_CUR_52_UBYTE_u2_u1 255. _CNV_R_R_i_eluft_q0_543_CM 0. 255. FORMAT "%8.4"
 /begin AXIS_DESCR STD_AXIS ub_tmp _CNV_R_R_spg_ubatt_548_CM 3 0. 24.021 FORMAT "%8.4" /end AXIS_DESCR
/end CHARACTERISTIC
/begin MEASUREMENT faktubel "Faktor Lüfterstrom aus Geschwindigkeit" UWORD _CNV_R_R_fak_ub_b2_546_CM 1 100. 0. 1.9921875 DISPLAY_IDENTIFIER FAKTUBEL ECU_ADDRESS 0x3fa9b2 BYTE_ORDER MSB_LAST FORMAT "%8.4" /end MEASUREMENT
/begin MEASUREMENT i_eluvfzg "Lüfterstrom ohne Geschwindigkeitseinfluss" UWORD _CNV_R_R_i_eluft_q0_543_CM 1 100. 0. 128. DISPLAY_IDENTIFIER I_ELUVFZG ECU_ADDRESS 0x3fa9b8 BYTE_ORDER MSB_LAST FORMAT "%8.4" /end MEASUREMENT
/begin MEASUREMENT vfzg_tmp "temp. Fahrzeuggeschwindigkeit" UWORD _CNV_R_R_vfzg_ub_q1_545_CM 1 100. 0. 318.75 DISPLAY_IDENTIFIER VFZG_TMP ECU_ADDRESS 0x3fa9c4 BYTE_ORDER MSB_LAST FORMAT "%8.4" /end MEASUREMENT
/begin CHARACTERISTIC KLELUB "Kennlinie für Batteriespannungskorrektur E-lüfter" CURVE 0xffe5a134 _REC_CUR_52_u2_u2 1.9921875 _CNV_R_R_fak_ub_b2_546_CM 0. 1.9921875 FORMAT "%8.4"
 /begin AXIS_DESCR STD_AXIS ub_tmp _CNV_R_R_spg_ubatt_548_CM 5 0. 24.021 FORMAT "%8.4" /end AXIS_DESCR
/end CHARACTERISTIC
/begin MEASUREMENT fakttansel "Ansaugluftfaktor E-Lüfterstrom" UWORD _CNV_R_R_fak_ub_b2_546_CM 1 100. 0. 1.9921875 DISPLAY_IDENTIFIER FAKTTANSEL ECU_ADDRESS 0x3fa9b0 BYTE_ORDER MSB_LAST FORMAT "%8.4" /end MEASUREMENT
/begin MEASUREMENT i_elu_vvt "Strom E-Lüfter und VVT-System" UWORD _CNV_R_R_i_eluft_q0_543_CM 1 100. 0. 4095.9375 DISPLAY_IDENTIFIER I_ELU_VVT ECU_ADDRESS 0x3fa9ba BYTE_ORDER MSB_LAST FORMAT "%8.4" /end MEASUREMENT
/begin MEASUREMENT i_eluefter "E-Lüfter Stromaufnahme" UWORD _CNV_R_R_i_eluft_q0_543_CM 1 100. 0. 128. DISPLAY_IDENTIFIER I_ELUEFTER ECU_ADDRESS 0x3fa9b4 BYTE_ORDER MSB_LAST FORMAT "%8.4" /end MEASUREMENT
/begin MEASUREMENT i_elupwm "E-Lüfterstrom ohne Temperaturabhängigkeit" UWORD _CNV_R_R_i_eluft_q0_543_CM 1 100. 0. 64. DISPLAY_IDENTIFIER I_ELUPWM ECU_ADDRESS 0x3fa9b6 BYTE_ORDER MSB_LAST FORMAT "%8.4" /end MEASUREMENT
/begin MEASUREMENT taml_tmp "temporäres Tastverhältnis E-Lüfter" UWORD _CNV_R_R_rel_ub_b10_544_CM 1 100. 0. 100. DISPLAY_IDENTIFIER TAML_TMP ECU_ADDRESS 0x3fa9be BYTE_ORDER MSB_LAST FORMAT "%8.4" /end MEASUREMENT
/begin MEASUREMENT tans_tmp "temporäre Ansaugluft" UWORD _CNV_R_R_temp_ub_q0_549_CM 1 100. -48. 143.25 DISPLAY_IDENTIFIER TANS_TMP ECU_ADDRESS 0x3fa9c0 BYTE_ORDER MSB_LAST FORMAT "%8.4" /end MEASUREMENT
/begin MEASUREMENT ub_tmp "temporäre Batteriespannung" UWORD _CNV_R_R_spg_ubatt_548_CM 1 100. 0. 24.021 DISPLAY_IDENTIFIER UB_TMP ECU_ADDRESS 0x3fa9c2 BYTE_ORDER MSB_LAST FORMAT "%8.4" /end MEASUREMENT
/begin MEASUREMENT vvt_ib1_2 "Gesamtstrom VVT Bank1 bzw 4Zyl. und Bank2" UWORD _CNV_R_R_i_vvt_ub_q_542_CM 1 100. 0. 128. DISPLAY_IDENTIFIER VVT_IB1_2 ECU_ADDRESS 0x3fa9c6 BYTE_ORDER MSB_LAST FORMAT "%8.4" /end MEASUREMENT
/begin MEASUREMENT vvt_iges "Strombedarf des gesamten VVT-Systems" UWORD _CNV_R_R_i_eluft_q0_543_CM 1 100. 0. 192. DISPLAY_IDENTIFIER VVT_IGES ECU_ADDRESS 0x3fa9c8 BYTE_ORDER MSB_LAST FORMAT "%8.4" /end MEASUREMENT
/begin MEASUREMENT i_slp "berechnete Groesse Strombedarf Sekundärluftpumpe" UWORD _CNV_R_R_i_eluft_q0_543_CM 1 100. 0. 255. DISPLAY_IDENTIFIER I_SLP ECU_ADDRESS 0x3fa9bc BYTE_ORDER MSB_LAST FORMAT "%8.4" /end MEASUREMENT
/begin CHARACTERISTIC DFRUTYP "DF-Rückschaltungstyp für LLR-Anhebung" VALUE 0xffe5a3e7 _REC_VAL_20_u1 255. _CNV_R_R_dez_550_CM 0. 255. FORMAT "%8.4" /end CHARACTERISTIC
/begin CHARACTERISTIC IGENLLRANH "Generatorstromabstand für LL-Anhebung" VALUE 0xffe5a3e8 _REC_VAL_20_u1 254. _CNV_R_R_dez_550_CM 0. 254. FORMAT "%8.4" /end CHARACTERISTIC
/begin CHARACTERISTIC LLRABS_DF "DF-Schwelle für LL-Absenkung" VALUE 0xffe5a3e9 _REC_VAL_20_u1 99.609375 _CNV_R_R_PCENT_551_CM 0. 99.609375 FORMAT "%8.4" /end CHARACTERISTIC
/begin CHARACTERISTIC LLRANH_DF "DF-Schwelle für LL-Anhebung" VALUE 0xffe5a3ea _REC_VAL_20_u1 99.609375 _CNV_R_R_PCENT_551_CM 0. 99.609375 FORMAT "%8.4" /end CHARACTERISTIC
/begin CHARACTERISTIC NTWBGLLGEN "Notlaufwert Leerlaufanhebung bei Generatorfehler" VALUE 0xffe5a3eb _REC_VAL_20_u1 1. _CNV_R_R_dez_550_CM 0. 1. FORMAT "%8.4" /end CHARACTERISTIC
/begin CHARACTERISTIC PRELLDFAH "Prellzeit für LLR-Anhebung" VALUE 0xffe5a3ec _REC_VAL_20_u1 25.5 _CNV_R_R_t100msxs_u_552_CM 0. 25.5 FORMAT "%8.4" /end CHARACTERISTIC
/begin CHARACTERISTIC PRELLDFRF "Prellzeit für LLR-Absenkung" VALUE 0xffe5a3ed _REC_VAL_20_u1 25.5 _CNV_R_R_t100msxs_u_552_CM 0. 25.5 FORMAT "%8.4" /end CHARACTERISTIC
/begin CHARACTERISTIC KFDFIGEN0 "inv. Generator-DF-Ausgang" MAP 0xffe5a157 _REC_MAP_52_u1_u1_u1 99.609375 _CNV_R_R_PCENT_551_CM 0. 99.609375 FORMAT "%8.4"
 /begin AXIS_DESCR STD_AXIS NO_INPUT_QUANTITY _CNV_R_R_dez_550_CM 8 0. 255. FORMAT "%8.4" /end AXIS_DESCR
 /begin AXIS_DESCR STD_AXIS NO_INPUT_QUANTITY _CNV_R_R_dez_550_CM 8 0. 255. FORMAT "%8.4" /end AXIS_DESCR
/end CHARACTERISTIC
/begin CHARACTERISTIC KFDFIGEN1 "inv. Generator-DF-Ausgang" MAP 0xffe5a1a9 _REC_MAP_52_u1_u1_u1 99.609375 _CNV_R_R_PCENT_551_CM 0. 99.609375 FORMAT "%8.4"
 /begin AXIS_DESCR STD_AXIS NO_INPUT_QUANTITY _CNV_R_R_dez_550_CM 8 0. 255. FORMAT "%8.4" /end AXIS_DESCR
 /begin AXIS_DESCR STD_AXIS NO_INPUT_QUANTITY _CNV_R_R_dez_550_CM 8 0. 255. FORMAT "%8.4" /end AXIS_DESCR
/end CHARACTERISTIC
/begin CHARACTERISTIC KFDFIGEN2 "inv. Generator-DF-Ausgang" MAP 0xffe5a1fb _REC_MAP_52_u1_u1_u1 99.609375 _CNV_R_R_PCENT_551_CM 0. 99.609375 FORMAT "%8.4"
 /begin AXIS_DESCR STD_AXIS NO_INPUT_QUANTITY _CNV_R_R_dez_550_CM 8 0. 255. FORMAT "%8.4" /end AXIS_DESCR
 /begin AXIS_DESCR STD_AXIS NO_INPUT_QUANTITY _CNV_R_R_dez_550_CM 8 0. 255. FORMAT "%8.4" /end AXIS_DESCR
/end CHARACTERISTIC
/begin CHARACTERISTIC KFDFIGEN3 "inv. Generator-DF-Ausgang" MAP 0xffe5a24d _REC_MAP_52_u1_u1_u1 99.609375 _CNV_R_R_PCENT_551_CM 0. 99.609375 FORMAT "%8.4"
 /begin AXIS_DESCR STD_AXIS NO_INPUT_QUANTITY _CNV_R_R_dez_550_CM 8 0. 255. FORMAT "%8.4" /end AXIS_DESCR
 /begin AXIS_DESCR STD_AXIS NO_INPUT_QUANTITY _CNV_R_R_dez_550_CM 8 0. 255. FORMAT "%8.4" /end AXIS_DESCR
/end CHARACTERISTIC
/begin CHARACTERISTIC KFDFIGEN4 "inv. Generator-DF-Ausgang" MAP 0xffe5a29f _REC_MAP_52_u1_u1_u1 99.609375 _CNV_R_R_PCENT_551_CM 0. 99.609375 FORMAT "%8.4"
 /begin AXIS_DESCR STD_AXIS NO_INPUT_QUANTITY _CNV_R_R_dez_550_CM 8 0. 255. FORMAT "%8.4" /end AXIS_DESCR
 /begin AXIS_DESCR STD_AXIS NO_INPUT_QUANTITY _CNV_R_R_dez_550_CM 8 0. 255. FORMAT "%8.4" /end AXIS_DESCR
/end CHARACTERISTIC
/begin CHARACTERISTIC KFDFIGEN5 "inv. Generator-DF-Ausgang" MAP 0xffe5a2f1 _REC_MAP_52_u1_u1_u1 99.609375 _CNV_R_R_PCENT_551_CM 0. 99.609375 FORMAT "%8.4"
 /begin AXIS_DESCR STD_AXIS NO_INPUT_QUANTITY _CNV_R_R_dez_550_CM 8 0. 255. FORMAT "%8.4" /end AXIS_DESCR
 /begin AXIS_DESCR STD_AXIS NO_INPUT_QUANTITY _CNV_R_R_dez_550_CM 8 0. 255. FORMAT "%8.4" /end AXIS_DESCR
/end CHARACTERISTIC
/begin CHARACTERISTIC KFDFIGEN6 "inv. Generator-DF-Ausgang" MAP 0xffe5a343 _REC_MAP_52_u1_u1_u1 99.609375 _CNV_R_R_PCENT_551_CM 0. 99.609375 FORMAT "%8.4"
 /begin AXIS_DESCR STD_AXIS NO_INPUT_QUANTITY _CNV_R_R_dez_550_CM 8 0. 255. FORMAT "%8.4" /end AXIS_DESCR
 /begin AXIS_DESCR STD_AXIS NO_INPUT_QUANTITY _CNV_R_R_dez_550_CM 8 0. 255. FORMAT "%8.4" /end AXIS_DESCR
/end CHARACTERISTIC
/begin CHARACTERISTIC KFDFIGEN7 "inv. Generator-DF-Ausgang" MAP 0xffe5a395 _REC_MAP_52_u1_u1_u1 99.609375 _CNV_R_R_PCENT_551_CM 0. 99.609375 FORMAT "%8.4"
 /begin AXIS_DESCR STD_AXIS NO_INPUT_QUANTITY _CNV_R_R_dez_550_CM 8 0. 255. FORMAT "%8.4" /end AXIS_DESCR
 /begin AXIS_DESCR STD_AXIS NO_INPUT_QUANTITY _CNV_R_R_dez_550_CM 8 0. 255. FORMAT "%8.4" /end AXIS_DESCR
/end CHARACTERISTIC
/begin MEASUREMENT n_idlgspec "" UBYTE _CNV_R_R_dez_550_CM 1 100. 0. 255. DISPLAY_IDENTIFIER N_IDLGSPEC ECU_ADDRESS 0x3fa9d3 FORMAT "%8.4" /end MEASUREMENT
/begin MEASUREMENT B_hysllrah "Bedingung LL-Anhebunghysterese" UBYTE _CNV_A_R_LINEAR_____22_CM 1 100. 0. 255. DISPLAY_IDENTIFIER B_HYSLLRAH ECU_ADDRESS 0x3fa9ce BIT_MASK 0x1 /end MEASUREMENT
/begin MEASUREMENT gendfvorhs "DF-Signal Vorhersage" UBYTE _CNV_R_R_PCENT_551_CM 1 100. 0. 99.609375 DISPLAY_IDENTIFIER GENDFVORHS ECU_ADDRESS 0x3fa9cf FORMAT "%8.4" /end MEASUREMENT
/begin MEASUREMENT genikaltmp "temporärer Kaltstrom" UWORD _CNV_R_R_igen_uw_q0_553_CM 1 100. 0. 2047.9688 DISPLAY_IDENTIFIER GENIKALTMP ECU_ADDRESS 0x3fa9d0 BYTE_ORDER MSB_LAST FORMAT "%8.4" /end MEASUREMENT
/begin MEASUREMENT genitemp2 "temporärer Warmstrom" UWORD _CNV_R_R_igen_uw_q0_553_CM 1 100. 0. 2047.9688 DISPLAY_IDENTIFIER GENITEMP2 ECU_ADDRESS 0x3fa9d1 BYTE_ORDER MSB_LAST FORMAT "%8.4" /end MEASUREMENT
/begin MEASUREMENT igenrllrah "Generatorstrom mit Vorlaufreserve" UBYTE _CNV_R_R_dez_550_CM 1 100. 0. 254. DISPLAY_IDENTIFIER IGENRLLRAH ECU_ADDRESS 0x3fa9d2 FORMAT "%8.4" /end MEASUREMENT
/begin MEASUREMENT ngsllm "Generatorleerlaufdrehzahl" UWORD _CNV_R_R_ngen_uw_q0_554_CM 1 100. 0. 32767.5 DISPLAY_IDENTIFIER NGSLLM ECU_ADDRESS 0x3fa9cc BYTE_ORDER MSB_LAST FORMAT "%8.4" /end MEASUREMENT
/begin MEASUREMENT ufgentmp2 "temporärer Generatorspannungsollwert" UBYTE _CNV_R_R_spg_ugen_555_CM 1 100. 10.6 36.1 DISPLAY_IDENTIFIER UFGENTMP2 ECU_ADDRESS 0x3fa9d4 FORMAT "%8.4" /end MEASUREMENT
/begin CHARACTERISTIC GEN_DNMIN "" VALUE 0xffe5a3ee _REC_VAL_20_u2 16383.75 _CNV_A_R_LINEAR_____556_CM 0. 16383.75 FORMAT "%8.2" /end CHARACTERISTIC
/begin CHARACTERISTIC GENPDTIME "" VALUE 0xffe5a3f2 _REC_VAL_20_u1 25500. _CNV_A_R_LINEAR_____557_CM 0. 25500. FORMAT "%5.0" /end CHARACTERISTIC
/begin CHARACTERISTIC GFBSUTERR "Entprellzeit Fehlereintrag Kommunikation unplausibel" VALUE 0xffe5a3f3 _REC_VAL_20_u1 25.5 _CNV_R_R_t100msxs_u_552_CM 0. 25.5 FORMAT "%8.4" /end CHARACTERISTIC
/begin CHARACTERISTIC GFBSUTHEAL "Entprellzeit Fehlerheilung Kommunikation unplausibel" VALUE 0xffe5a3f4 _REC_VAL_20_u1 25.5 _CNV_R_R_t100msxs_u_552_CM 0. 25.5 FORMAT "%8.4" /end CHARACTERISTIC
/begin CHARACTERISTIC GFELTERR "Entprellzeit Fehlereintrag elekt. Fehler" VALUE 0xffe5a3f5 _REC_VAL_20_u1 25.5 _CNV_R_R_t100msxs_u_552_CM 0. 25.5 FORMAT "%8.4" /end CHARACTERISTIC
/begin CHARACTERISTIC GFELTHEAL "Entprellzeit Fehlerheilung elekt. Fehler" VALUE 0xffe5a3f6 _REC_VAL_20_u1 25.5 _CNV_R_R_t100msxs_u_552_CM 0. 25.5 FORMAT "%8.4" /end CHARACTERISTIC
/begin CHARACTERISTIC GFHTTERR "Entprellzeit Fehlereintrag Ueberhitzung" VALUE 0xffe5a3f7 _REC_VAL_20_u1 25.5 _CNV_R_R_t100msxs_u_552_CM 0. 25.5 FORMAT "%8.4" /end CHARACTERISTIC
/begin CHARACTERISTIC GFHTTHEAL "Entprellzeit Fehlerheilung Ueberhitzung" VALUE 0xffe5a3f8 _REC_VAL_20_u1 25.5 _CNV_R_R_t100msxs_u_552_CM 0. 25.5 FORMAT "%8.4" /end CHARACTERISTIC
/begin CHARACTERISTIC GFMETERR "Entprellzeit Fehlereintrag mechanischer Fehler" VALUE 0xffe5a3f9 _REC_VAL_20_u1 25.5 _CNV_R_R_t100msxs_u_552_CM 0. 25.5 FORMAT "%8.4" /end CHARACTERISTIC
/begin CHARACTERISTIC GFMETHEAL "Entprellzeit Fehlerheilung mechanischer Fehler" VALUE 0xffe5a3fa _REC_VAL_20_u1 25.5 _CNV_R_R_t100msxs_u_552_CM 0. 25.5 FORMAT "%8.4" /end CHARACTERISTIC
/begin CHARACTERISTIC GFNOBTERR "Entprellzeit Fehlereintrag f. keine Kommunikation" VALUE 0xffe5a3fb _REC_VAL_20_u1 25.5 _CNV_R_R_t100msxs_u_552_CM 0. 25.5 FORMAT "%8.4" /end CHARACTERISTIC
/begin CHARACTERISTIC GFNOBTHEAL "Entprellzeit Fehlerheilung f. keine Kommunikation" VALUE 0xffe5a3fc _REC_VAL_20_u1 25.5 _CNV_R_R_t100msxs_u_552_CM 0. 25.5 FORMAT "%8.4" /end CHARACTERISTIC
/begin CHARACTERISTIC MSKGENDFP "Bitmaske Generator Fehler-> DFP" VALUE 0xffe5a3fd _REC_VAL_20_u1 255. _CNV_R_R_dez_550_CM 0. 255. FORMAT "%8.4" /end CHARACTERISTIC
/begin CHARACTERISTIC MSKGENKL61 "Bitmaske fuer Generatorfehler -> Ladekontrolle" VALUE 0xffe5a3fe _REC_VAL_20_u1 255. _CNV_R_R_dez_550_CM 0. 255. FORMAT "%8.4" /end CHARACTERISTIC
/begin CHARACTERISTIC SNMBSDKL61 "Generatornotmotordrehzalschwelle KL61-Unterdrueckung" VALUE 0xffe5a3f0 _REC_VAL_20_u2 16383.75 _CNV_R_R_nmot_uw_q0_558_CM 0. 16383.75 FORMAT "%8.4" /end CHARACTERISTIC
/begin MEASUREMENT genstatroh "Status Generator" UBYTE _CNV_A_R_LINEAR_____0_CM 1 100. 0. 255. DISPLAY_IDENTIFIER GENSTATROH ECU_ADDRESS 0x3fa379 FORMAT "%3.0" /end MEASUREMENT
/begin MEASUREMENT st_gen "Generatorstatus" UBYTE _CNV_A_R_LINEAR_____0_CM 1 100. 0. 3. DISPLAY_IDENTIFIER ST_GEN ECU_ADDRESS 0x3fa37a FORMAT "%2.0" /end MEASUREMENT
/begin MEASUREMENT B_1stbsder "Hilfsbit für Generatornotlaufdrehzahlfunktion" UBYTE _CNV_A_R_LINEAR_____22_CM 1 100. 0. 255. DISPLAY_IDENTIFIER B_1STBSDER ECU_ADDRESS 0x3fa9d5 BIT_MASK 0x1 /end MEASUREMENT
/begin MEASUREMENT B_auxerr "Bedingung AUX (wird momentan nicht benutzt)" UBYTE _CNV_A_R_LINEAR_____22_CM 1 100. 0. 255. DISPLAY_IDENTIFIER B_AUXERR ECU_ADDRESS 0x3fa9d6 BIT_MASK 0x1 /end MEASUREMENT
/begin MEASUREMENT B_gfbsupep "Bedingung Generatortyp unplausibel, entprellt" UBYTE _CNV_A_R_LINEAR_____22_CM 1 100. 0. 255. DISPLAY_IDENTIFIER B_GFBSUPEP ECU_ADDRESS 0x3fa9d7 BIT_MASK 0x1 /end MEASUREMENT
/begin MEASUREMENT B_gfelep "Bedingung elektrischer Fehler, entprellt" UBYTE _CNV_A_R_LINEAR_____22_CM 1 100. 0. 255. DISPLAY_IDENTIFIER B_GFELEP ECU_ADDRESS 0x3fa9d8 BIT_MASK 0x1 /end MEASUREMENT
/begin MEASUREMENT B_gfhtep "Bedingung Generator Ueberhitzung, entprellt" UBYTE _CNV_A_R_LINEAR_____22_CM 1 100. 0. 255. DISPLAY_IDENTIFIER B_GFHTEP ECU_ADDRESS 0x3fa9d9 BIT_MASK 0x1 /end MEASUREMENT
/begin MEASUREMENT B_gfmeep "Bedingung mechanischer Fehler, entprellt" UBYTE _CNV_A_R_LINEAR_____22_CM 1 100. 0. 255. DISPLAY_IDENTIFIER B_GFMEEP ECU_ADDRESS 0x3fa9da BIT_MASK 0x1 /end MEASUREMENT
/begin MEASUREMENT B_gfnobsep "Bedingung BSD Kommunikationsverlust, entprellt" UBYTE _CNV_A_R_LINEAR_____22_CM 1 100. 0. 255. DISPLAY_IDENTIFIER B_GFNOBSEP ECU_ADDRESS 0x3fa9db BIT_MASK 0x1 /end MEASUREMENT
/begin MEASUREMENT en_gendiag "Disgnose Freigabe Gen.Fehler" UBYTE _CNV_A_R_LINEAR_____22_CM 1 100. 0. 255. DISPLAY_IDENTIFIER EN_GENDIAG ECU_ADDRESS 0x3fa9dc BIT_MASK 0x1 /end MEASUREMENT
/begin MEASUREMENT genfbsak "BSD Uebertragungsfehler kodiert fuer FSPVDGEN" UBYTE _CNV_R_R_dez_550_CM 1 100. 0. 255. DISPLAY_IDENTIFIER GENFBSAK ECU_ADDRESS 0x3fa9e3 FORMAT "%8.4" /end MEASUREMENT
/begin MEASUREMENT gfbsuctr "Entprellzaehler fuer Generatortyp unplausibel" UBYTE _CNV_R_R_t100msxs_u_552_CM 1 100. 0. 25.5 DISPLAY_IDENTIFIER GFBSUCTR ECU_ADDRESS 0x3fa9e4 FORMAT "%8.4" /end MEASUREMENT
/begin MEASUREMENT gfehlin1 "lokale Kopie Fehlerinput" UBYTE _CNV_A_R_LINEAR_____22_CM 1 100. 0. 255. DISPLAY_IDENTIFIER GFEHLIN1 ECU_ADDRESS 0x3fa9dd BIT_MASK 0x1 /end MEASUREMENT
/begin MEASUREMENT gfehlin2 "lokale Kopie Fehlerinput" UBYTE _CNV_A_R_LINEAR_____22_CM 1 100. 0. 255. DISPLAY_IDENTIFIER GFEHLIN2 ECU_ADDRESS 0x3fa9de BIT_MASK 0x1 /end MEASUREMENT
/begin MEASUREMENT gfehlin3 "lokale Kopie Fehlerinput" UBYTE _CNV_A_R_LINEAR_____22_CM 1 100. 0. 255. DISPLAY_IDENTIFIER GFEHLIN3 ECU_ADDRESS 0x3fa9df BIT_MASK 0x1 /end MEASUREMENT
/begin MEASUREMENT gfehlin4 "lokale Kopie Fehlerinput" UBYTE _CNV_A_R_LINEAR_____22_CM 1 100. 0. 255. DISPLAY_IDENTIFIER GFEHLIN4 ECU_ADDRESS 0x3fa9e0 BIT_MASK 0x1 /end MEASUREMENT
/begin MEASUREMENT gfehlin5 "lokale Kopie Fehlerinput" UBYTE _CNV_A_R_LINEAR_____22_CM 1 100. 0. 255. DISPLAY_IDENTIFIER GFEHLIN5 ECU_ADDRESS 0x3fa9e1 BIT_MASK 0x1 /end MEASUREMENT
/begin MEASUREMENT gfelctr "Entprellzaehler fuer elektrischen Fehler" UBYTE _CNV_R_R_t100msxs_u_552_CM 1 100. 0. 25.5 DISPLAY_IDENTIFIER GFELCTR ECU_ADDRESS 0x3fa9e5 FORMAT "%8.4" /end MEASUREMENT
/begin MEASUREMENT gfhtctr "Entprellzaehler fuer Generator Ueberhitzung" UBYTE _CNV_R_R_t100msxs_u_552_CM 1 100. 0. 25.5 DISPLAY_IDENTIFIER GFHTCTR ECU_ADDRESS 0x3fa9e6 FORMAT "%8.4" /end MEASUREMENT
/begin MEASUREMENT gfmectr "Entprellzaehler fuer mechanischen Fehler" UBYTE _CNV_R_R_t100msxs_u_552_CM 1 100. 0. 25.5 DISPLAY_IDENTIFIER GFMECTR ECU_ADDRESS 0x3fa9e7 FORMAT "%8.4" /end MEASUREMENT
/begin MEASUREMENT gfnobctr "Entprellzaehler fuer BSD Kommunikation unterbrochen" UBYTE _CNV_R_R_t100msxs_u_552_CM 1 100. 0. 25.5 DISPLAY_IDENTIFIER GFNOBCTR ECU_ADDRESS 0x3fa9e8 FORMAT "%8.4" /end MEASUREMENT
/begin MEASUREMENT kl61loc "Kl61 lokal" UBYTE _CNV_A_R_LINEAR_____22_CM 1 100. 0. 255. DISPLAY_IDENTIFIER KL61LOC ECU_ADDRESS 0x3fa9e2 BIT_MASK 0x1 /end MEASUREMENT
/begin MEASUREMENT tlrfgen "received load response time from alternator" UBYTE _CNV_A_R_LINEAR_____24_CM 1 100. 0. 25.5 DISPLAY_IDENTIFIER TLRFGEN ECU_ADDRESS 0x3fe421 FORMAT "%4.1" /end MEASUREMENT
/begin MEASUREMENT ufgen "received alternator voltage" UBYTE _CNV_A_R_LINEAR_____585_CM 1 100. 10.6 16.9 DISPLAY_IDENTIFIER UFGEN ECU_ADDRESS 0x3fe422 FORMAT "%4.1" /end MEASUREMENT
/begin MEASUREMENT B_genfel "alternator failure: electrical" UBYTE _CNV_S_2_RANGE______2_CM 1 100. 0. 1. DISPLAY_IDENTIFIER B_GENFEL ECU_ADDRESS 0x3fe423 /end MEASUREMENT
/begin MEASUREMENT B_genfht "alternator failure: high temperature" UBYTE _CNV_S_2_RANGE______2_CM 1 100. 0. 1. DISPLAY_IDENTIFIER B_GENFHT ECU_ADDRESS 0x3fe424 /end MEASUREMENT
/begin MEASUREMENT B_genfme "alternator failure: mechanical" UBYTE _CNV_S_2_RANGE______2_CM 1 100. 0. 1. DISPLAY_IDENTIFIER B_GENFME ECU_ADDRESS 0x3fe425 /end MEASUREMENT
/begin MEASUREMENT B_genfbsd "alternator failure: BSD interface" UBYTE _CNV_S_2_RANGE______2_CM 1 100. 0. 1. DISPLAY_IDENTIFIER B_GENFBSD ECU_ADDRESS 0x3fe426 /end MEASUREMENT
/begin CHARACTERISTIC c_vb_min_bsd_diag "Battery voltage threshold of power management diagnosis" VALUE 0xffe409b9 _REC_VAL_20_u1 26. _CNV_A_R_LINEAR_____60_CM 0. 26. DISPLAY_IDENTIFIER C_VB_MIN_BSD_DIAG FORMAT "%4.1" /end CHARACTERISTIC
/begin MEASUREMENT B_etum "Bedingung Fehler in Umgebungstemperatur" UBYTE _CNV_S_2_B_TRUE_582_CM 1 100. 0. 1. DISPLAY_IDENTIFIER B_ETUM ECU_ADDRESS 0x3fe3f6 BIT_MASK 0x1 /end MEASUREMENT
/begin MEASUREMENT B_inibumg "Hilfsbedingung Batterietemperaturumgebungsberechung" UBYTE _CNV_S_2_B_TRUE_582_CM 1 100. 0. 1. DISPLAY_IDENTIFIER B_INIBUMG ECU_ADDRESS 0x3faa48 BIT_MASK 0x1 /end MEASUREMENT
/begin MEASUREMENT B_taerr "Bedingung Ansaugluftfehler" UBYTE _CNV_S_2_B_TRUE_582_CM 1 100. 0. 1. DISPLAY_IDENTIFIER B_TAERR ECU_ADDRESS 0x3fe3ef BIT_MASK 0x1 /end MEASUREMENT
/begin MEASUREMENT B_tns "Bedingung Tag/Nachtlicht" UBYTE _CNV_S_2_B_TRUE_582_CM 1 100. 0. 1. DISPLAY_IDENTIFIER B_TNS ECU_ADDRESS 0x3fe3e1 BIT_MASK 0x1 /end MEASUREMENT
/begin MEASUREMENT B_tumers "Bedingung Ansaugluftersatzwert" UBYTE _CNV_S_2_B_TRUE_582_CM 1 100. 0. 1. DISPLAY_IDENTIFIER B_TUMERS ECU_ADDRESS 0x3fe3f0 BIT_MASK 0x1 /end MEASUREMENT
/begin MEASUREMENT batt_a1 "Temp-Variable" FLOAT32_IEEE _CNV_A_R_LINEAR_____22_CM 1 100. -2147483648. 4294967295. DISPLAY_IDENTIFIER BATT_A1 ECU_ADDRESS 0x3fa3b4 FORMAT "%8.4" /end MEASUREMENT
/begin MEASUREMENT batt_a2 "Temp-Variable" FLOAT32_IEEE _CNV_A_R_LINEAR_____22_CM 1 100. -2147483648. 4294967295. DISPLAY_IDENTIFIER BATT_A2 ECU_ADDRESS 0x3fa3b8 FORMAT "%8.4" /end MEASUREMENT
/begin MEASUREMENT batt_c10 "Temp-Variable" FLOAT32_IEEE _CNV_A_R_LINEAR_____22_CM 1 100. -2147483648. 4294967295. DISPLAY_IDENTIFIER BATT_C10 ECU_ADDRESS 0x3fa3bc FORMAT "%8.4" /end MEASUREMENT
/begin MEASUREMENT batt_c11 "Temp-Variable" FLOAT32_IEEE _CNV_A_R_LINEAR_____22_CM 1 100. -2147483648. 4294967295. DISPLAY_IDENTIFIER BATT_C11 ECU_ADDRESS 0x3fa3c0 FORMAT "%8.4" /end MEASUREMENT
/begin MEASUREMENT batt_c12 "Temp-Variable" FLOAT32_IEEE _CNV_A_R_LINEAR_____22_CM 1 100. -2147483648. 4294967295. DISPLAY_IDENTIFIER BATT_C12 ECU_ADDRESS 0x3fa3c4 FORMAT "%8.4" /end MEASUREMENT
/begin MEASUREMENT batt_c13 "Temp-Variable" FLOAT32_IEEE _CNV_A_R_LINEAR_____22_CM 1 100. -2147483648. 4294967295. DISPLAY_IDENTIFIER BATT_C13 ECU_ADDRESS 0x3fa3c8 FORMAT "%8.4" /end MEASUREMENT
/begin MEASUREMENT batt_c14 "Temp-Variable" FLOAT32_IEEE _CNV_A_R_LINEAR_____22_CM 1 100. -2147483648. 4294967295. DISPLAY_IDENTIFIER BATT_C14 ECU_ADDRESS 0x3fa3cc FORMAT "%8.4" /end MEASUREMENT
/begin MEASUREMENT batt_c8 "Temp-Variable" FLOAT32_IEEE _CNV_A_R_LINEAR_____22_CM 1 100. -2147483648. 4294967295. DISPLAY_IDENTIFIER BATT_C8 ECU_ADDRESS 0x3fa3d0 FORMAT "%8.4" /end MEASUREMENT
/begin MEASUREMENT batt_c9 "Temp-Variable" FLOAT32_IEEE _CNV_A_R_LINEAR_____22_CM 1 100. -2147483648. 4294967295. DISPLAY_IDENTIFIER BATT_C9 ECU_ADDRESS 0x3fa3d4 FORMAT "%8.4" /end MEASUREMENT
/begin MEASUREMENT batt_d1 "Temp-Variable" FLOAT32_IEEE _CNV_A_R_LINEAR_____22_CM 1 100. -2147483648. 4294967295. DISPLAY_IDENTIFIER BATT_D1 ECU_ADDRESS 0x3fa3d8 FORMAT "%8.4" /end MEASUREMENT
/begin MEASUREMENT batt_e1 "Temp-Variable" FLOAT32_IEEE _CNV_A_R_LINEAR_____22_CM 1 100. -2147483648. 4294967295. DISPLAY_IDENTIFIER BATT_E1 ECU_ADDRESS 0x3fa3dc FORMAT "%8.4" /end MEASUREMENT
/begin MEASUREMENT batt_e2 "Temp-Variable" FLOAT32_IEEE _CNV_A_R_LINEAR_____22_CM 1 100. -2147483648. 4294967295. DISPLAY_IDENTIFIER BATT_E2 ECU_ADDRESS 0x3fa3e0 FORMAT "%8.4" /end MEASUREMENT
/begin MEASUREMENT batt_e3 "Temp-Variable" FLOAT32_IEEE _CNV_A_R_LINEAR_____22_CM 1 100. -2147483648. 4294967295. DISPLAY_IDENTIFIER BATT_E3 ECU_ADDRESS 0x3fa3e4 FORMAT "%8.4" /end MEASUREMENT
/begin MEASUREMENT batt_e4 "Temp-Variable" FLOAT32_IEEE _CNV_A_R_LINEAR_____22_CM 1 100. -2147483648. 4294967295. DISPLAY_IDENTIFIER BATT_E4 ECU_ADDRESS 0x3fa3e8 FORMAT "%8.4" /end MEASUREMENT
/begin MEASUREMENT batt_e5 "Temp-Variable" FLOAT32_IEEE _CNV_A_R_LINEAR_____22_CM 1 100. -2147483648. 4294967295. DISPLAY_IDENTIFIER BATT_E5 ECU_ADDRESS 0x3fa3ec FORMAT "%8.4" /end MEASUREMENT
/begin MEASUREMENT batt_e6 "Temp-Variable" FLOAT32_IEEE _CNV_A_R_LINEAR_____22_CM 1 100. -2147483648. 4294967295. DISPLAY_IDENTIFIER BATT_E6 ECU_ADDRESS 0x3fa3f0 FORMAT "%8.4" /end MEASUREMENT
/begin MEASUREMENT batt_tfil "Zeitkonstante Batterie" FLOAT32_IEEE _CNV_A_R_LINEAR_____22_CM 1 100. -2147483648. 4294967295. DISPLAY_IDENTIFIER BATT_TFIL ECU_ADDRESS 0x3fa3f4 FORMAT "%8.4" /end MEASUREMENT
/begin MEASUREMENT batt_w0 "Temp-Variable" FLOAT32_IEEE _CNV_A_R_LINEAR_____22_CM 1 100. -2147483648. 4294967295. DISPLAY_IDENTIFIER BATT_W0 ECU_ADDRESS 0x3fa3f8 FORMAT "%8.4" /end MEASUREMENT
/begin MEASUREMENT batto_a "Temp-Variable" FLOAT32_IEEE _CNV_A_R_LINEAR_____22_CM 1 100. -2147483648. 4294967295. DISPLAY_IDENTIFIER BATTO_A ECU_ADDRESS 0x3fa38c FORMAT "%8.4" /end MEASUREMENT
/begin MEASUREMENT batto_a1 "Temp-Variable" FLOAT32_IEEE _CNV_A_R_LINEAR_____22_CM 1 100. -2147483648. 4294967295. DISPLAY_IDENTIFIER BATTO_A1 ECU_ADDRESS 0x3fa390 FORMAT "%8.4" /end MEASUREMENT
/begin MEASUREMENT batto_b "Temp-Variable" FLOAT32_IEEE _CNV_A_R_LINEAR_____22_CM 1 100. -2147483648. 4294967295. DISPLAY_IDENTIFIER BATTO_B ECU_ADDRESS 0x3fa394 FORMAT "%8.4" /end MEASUREMENT
/begin MEASUREMENT batto_c "Temp-Variable" FLOAT32_IEEE _CNV_A_R_LINEAR_____22_CM 1 100. -2147483648. 4294967295. DISPLAY_IDENTIFIER BATTO_C ECU_ADDRESS 0x3fa398 FORMAT "%8.4" /end MEASUREMENT
/begin MEASUREMENT batto_c1 "Temp-Variable" FLOAT32_IEEE _CNV_A_R_LINEAR_____22_CM 1 100. -2147483648. 4294967295. DISPLAY_IDENTIFIER BATTO_C1 ECU_ADDRESS 0x3fa39c FORMAT "%8.4" /end MEASUREMENT
/begin MEASUREMENT batto_c2 "Temp-Variable" FLOAT32_IEEE _CNV_A_R_LINEAR_____22_CM 1 100. -2147483648. 4294967295. DISPLAY_IDENTIFIER BATTO_C2 ECU_ADDRESS 0x3fa3a0 FORMAT "%8.4" /end MEASUREMENT
/begin MEASUREMENT batto_c3 "Temp-Variable" FLOAT32_IEEE _CNV_A_R_LINEAR_____22_CM 1 100. -2147483648. 4294967295. DISPLAY_IDENTIFIER BATTO_C3 ECU_ADDRESS 0x3fa3a4 FORMAT "%8.4" /end MEASUREMENT
/begin MEASUREMENT batto_c4 "Temp-Variable" FLOAT32_IEEE _CNV_A_R_LINEAR_____22_CM 1 100. -2147483648. 4294967295. DISPLAY_IDENTIFIER BATTO_C4 ECU_ADDRESS 0x3fa3a8 FORMAT "%8.4" /end MEASUREMENT
/begin MEASUREMENT batto_c6 "Temp-Variable" FLOAT32_IEEE _CNV_A_R_LINEAR_____22_CM 1 100. -2147483648. 4294967295. DISPLAY_IDENTIFIER BATTO_C6 ECU_ADDRESS 0x3fa3ac FORMAT "%8.4" /end MEASUREMENT
/begin MEASUREMENT batto_c7 "Temp-Variable" FLOAT32_IEEE _CNV_A_R_LINEAR_____22_CM 1 100. -2147483648. 4294967295. DISPLAY_IDENTIFIER BATTO_C7 ECU_ADDRESS 0x3fa3b0 FORMAT "%8.4" /end MEASUREMENT
/begin MEASUREMENT battort "Batterieeinbauort" UBYTE _CNV_R_R_dez_550_CM 1 100. 0. 255. DISPLAY_IDENTIFIER BATTORT ECU_ADDRESS 0x3faa4a FORMAT "%8.4" /end MEASUREMENT
/begin MEASUREMENT cobattort "Codierzelle Batterieeinbauort" UBYTE _CNV_R_R_dez_550_CM 1 100. 0. 255. DISPLAY_IDENTIFIER COBATTORT ECU_ADDRESS 0x3faa4b FORMAT "%8.4" /end MEASUREMENT
/begin MEASUREMENT ctrgenutar "Generatorsollspannung" UBYTE _CNV_R_R_spg_gencan_592_CM 1 100. 10.6 16.975 DISPLAY_IDENTIFIER CTRGENUTAR ECU_ADDRESS 0x3fa388 FORMAT "%8.4" /end MEASUREMENT
/begin MEASUREMENT dbet_alf "Batterieaplphawert" FLOAT32_IEEE _CNV_A_R_LINEAR_____22_CM 1 100. -2147483648. 4294967295. DISPLAY_IDENTIFIER DBET_ALF ECU_ADDRESS 0x3fa400 FORMAT "%8.4" /end MEASUREMENT
/begin MEASUREMENT dbetalf_t "Temp-Variable" FLOAT32_IEEE _CNV_A_R_LINEAR_____22_CM 1 100. -2147483648. 4294967295. DISPLAY_IDENTIFIER DBETALF_T ECU_ADDRESS 0x3fa3fc FORMAT "%8.4" /end MEASUREMENT
/begin MEASUREMENT dt_tumg "delta T-Umgebung" FLOAT32_IEEE _CNV_A_R_LINEAR_____22_CM 1 100. -2147483648. 4294967295. DISPLAY_IDENTIFIER DT_TUMG ECU_ADDRESS 0x3fa404 FORMAT "%8.4" /end MEASUREMENT
/begin MEASUREMENT end_init "Temp-Variable Initialisierungsende" UBYTE _CNV_S_2_B_TRUE_582_CM 1 100. 0. 1. DISPLAY_IDENTIFIER END_INIT ECU_ADDRESS 0x3faa49 BIT_MASK 0x1 /end MEASUREMENT
/begin MEASUREMENT imlatm "ntegr. Luftmassenfluss ab Motorstart bis Maxwert" UBYTE _CNV_R_R_m_ub_b23p3_593_CM 1 100. 0. 23.210667 DISPLAY_IDENTIFIER IMLATM ECU_ADDRESS 0x3fe3f1 FORMAT "%8.4" /end MEASUREMENT
/begin MEASUREMENT t_batt_ini "Startwert Batterietemperatur" FLOAT32_IEEE _CNV_A_R_LINEAR_____22_CM 1 100. -2147483648. 4294967295. DISPLAY_IDENTIFIER T_BATT_INI ECU_ADDRESS 0x3fa420 FORMAT "%8.4" /end MEASUREMENT
/begin MEASUREMENT t_battabst "Batterieabstelltemperatur" FLOAT32_IEEE _CNV_A_R_LINEAR_____22_CM 1 100. -2147483648. 4294967295. DISPLAY_IDENTIFIER T_BATTABST ECU_ADDRESS 0x3facb0 FORMAT "%8.4" /end MEASUREMENT
/begin MEASUREMENT t_umgabst "Abstell-Aussentemperatur" SBYTE _CNV_R_R_temp_q1_594_CM 1 100. -128. 127. DISPLAY_IDENTIFIER T_UMGABST ECU_ADDRESS 0x3faca8 FORMAT "%8.4" /end MEASUREMENT
/begin MEASUREMENT t_umgabstf "letzte Aussentemperatur" FLOAT32_IEEE _CNV_A_R_LINEAR_____22_CM 1 100. -2147483648. 4294967295. DISPLAY_IDENTIFIER T_UMGABSTF ECU_ADDRESS 0x3fa424 FORMAT "%8.4" /end MEASUREMENT
/begin MEASUREMENT tabst_fl "Abstellzeit in float" FLOAT32_IEEE _CNV_A_R_LINEAR_____22_CM 1 100. -2147483648. 4294967295. DISPLAY_IDENTIFIER TABST_FL ECU_ADDRESS 0x3fa408 FORMAT "%8.4" /end MEASUREMENT
/begin MEASUREMENT tans "Ansaugluft" UBYTE _CNV_R_R_temp_uw_q0_547_CM 1 100. -48. 143.25 DISPLAY_IDENTIFIER TANS ECU_ADDRESS 0x3fe3d6 FORMAT "%8.4" /end MEASUREMENT
/begin MEASUREMENT tansf "Ansaugluft in float" FLOAT32_IEEE _CNV_A_R_LINEAR_____22_CM 1 100. -2147483648. 4294967295. DISPLAY_IDENTIFIER TANSF ECU_ADDRESS 0x3fa40c FORMAT "%8.4" /end MEASUREMENT
/begin MEASUREMENT tbatinmanf "Initwert Batterietmperatur Hand temp." FLOAT32_IEEE _CNV_A_R_LINEAR_____22_CM 1 100. -2147483648. 4294967295. DISPLAY_IDENTIFIER TBATINMANF ECU_ADDRESS 0x3fa410 FORMAT "%8.4" /end MEASUREMENT
/begin MEASUREMENT tbatstiniv "Starttemperatur Batterie vorne" FLOAT32_IEEE _CNV_A_R_LINEAR_____22_CM 1 100. -2147483648. 4294967295. DISPLAY_IDENTIFIER TBATSTINIV ECU_ADDRESS 0x3fa414 FORMAT "%8.4" /end MEASUREMENT
/begin MEASUREMENT tumg_ers "Aussentemperatur oder Ersatzwert" SBYTE _CNV_R_R_temp_q1_594_CM 1 100. -128. 127. DISPLAY_IDENTIFIER TUMG_ERS ECU_ADDRESS 0x3faa4e FORMAT "%8.4" /end MEASUREMENT
/begin MEASUREMENT tumgbatold "vorherige Batterieumgebungstemperatur" FLOAT32_IEEE _CNV_A_R_LINEAR_____22_CM 1 100. -2147483648. 4294967295. DISPLAY_IDENTIFIER TUMGBATOLD ECU_ADDRESS 0x3fa418 FORMAT "%8.4" /end MEASUREMENT
/begin MEASUREMENT tumgbattab "Abstell-Umgebungstemperatur Batterie" FLOAT32_IEEE _CNV_A_R_LINEAR_____22_CM 1 100. -2147483648. 4294967295. DISPLAY_IDENTIFIER TUMGBATTAB ECU_ADDRESS 0x3facac FORMAT "%8.4" /end MEASUREMENT
/begin MEASUREMENT tumgcan "Aussentemperatur via CAN" SBYTE _CNV_R_R_temp_q1_594_CM 1 100. -128. 127. DISPLAY_IDENTIFIER TUMGCAN ECU_ADDRESS 0x3fe3e0 FORMAT "%8.4" /end MEASUREMENT
/begin MEASUREMENT tumgcanf "aktuelle Aussentemperatur float" FLOAT32_IEEE _CNV_A_R_LINEAR_____22_CM 1 100. -2147483648. 4294967295. DISPLAY_IDENTIFIER TUMGCANF ECU_ADDRESS 0x3fa41c FORMAT "%8.4" /end MEASUREMENT
/begin MEASUREMENT tumgtemp "Umgebungstemperatur Ersatz" SBYTE _CNV_R_R_temp_q1_594_CM 1 100. -128. 127. DISPLAY_IDENTIFIER TUMGTEMP ECU_ADDRESS 0x3faa4d FORMAT "%8.4" /end MEASUREMENT
/begin MEASUREMENT vfzgf "Fahrzeuggeschwindigkeit in float" FLOAT32_IEEE _CNV_A_R_LINEAR_____22_CM 1 100. 0. 65535. DISPLAY_IDENTIFIER VFZGF ECU_ADDRESS 0x3faa50 FORMAT "%8.4" /end MEASUREMENT
/begin CHARACTERISTIC APPTBATINI "Enable Applikation Initwert Batterietemperatur" VALUE 0xffe5b680 _REC_VAL_20_u1 255. _CNV_R_R_dez_550_CM 0. 255. FORMAT "%8.4" /end CHARACTERISTIC
/begin CHARACTERISTIC BATT_ALFAH "Alphatau-Wert Batterie hinten" VALUE 0xffe5b6a0 _REC_VAL_20_S4 0.9999900000000002 _CNV_A_R_LINEAR_____22_CM 1.e-005 1. FORMAT "%8.4" /end CHARACTERISTIC
/begin CHARACTERISTIC BATT_ALFAV "Alphatau-Wert Batterie vorne" VALUE 0xffe5b6a4 _REC_VAL_20_S4 0.9999900000000002 _CNV_A_R_LINEAR_____22_CM 1.e-005 1. FORMAT "%8.4" /end CHARACTERISTIC
/begin CHARACTERISTIC BATT_BETAV "Beta-Wert Batterie vorne" VALUE 0xffe5b6a8 _REC_VAL_20_S4 0.9999900000000002 _CNV_A_R_LINEAR_____22_CM 1.e-005 1. FORMAT "%8.4" /end CHARACTERISTIC
/begin CHARACTERISTIC BATTHTAUVG "Zeitkonstante Batterie hinten bei VFZG>" VALUE 0xffe5b690 _REC_VAL_20_S4 1. _CNV_A_R_LINEAR_____22_CM 0. 1. FORMAT "%8.4" /end CHARACTERISTIC
/begin CHARACTERISTIC BATTHTAUVK "Zeitkonstante Batterie hinten bei VFZG<" VALUE 0xffe5b694 _REC_VAL_20_S4 1. _CNV_A_R_LINEAR_____22_CM 0. 1. FORMAT "%8.4" /end CHARACTERISTIC
/begin CHARACTERISTIC BATTORT0 "Batterieeinbauort No1" VALUE 0xffe5b681 _REC_VAL_20_u1 255. _CNV_R_R_dez_550_CM 0. 255. FORMAT "%8.4" /end CHARACTERISTIC
/begin CHARACTERISTIC BATTORT2 "Batterieeinbauort No2" VALUE 0xffe5b682 _REC_VAL_20_u1 255. _CNV_R_R_dez_550_CM 0. 255. FORMAT "%8.4" /end CHARACTERISTIC
/begin CHARACTERISTIC BATTVTAUVG "Zeitkonstante Batterie vorne bei VFZG>" VALUE 0xffe5b698 _REC_VAL_20_S4 1. _CNV_A_R_LINEAR_____22_CM 0. 1. FORMAT "%8.4" /end CHARACTERISTIC
/begin CHARACTERISTIC BATTVTAUVK "Zeitkonstante Batterie bei VFZG<Zeitkonstante Batterie bei VFZG>" VALUE 0xffe5b69c _REC_VAL_20_S4 1. _CNV_A_R_LINEAR_____22_CM 0. 1. FORMAT "%8.4" /end CHARACTERISTIC
/begin CHARACTERISTIC BATVFZGTAU "VFZG-Umschaltschwelle TAU Batterie" VALUE 0xffe5b683 _REC_VAL_20_u1 318.75 _CNV_R_R_vfzg_ub_q1_545_CM 0. 318.75 FORMAT "%8.4" /end CHARACTERISTIC
/begin CHARACTERISTIC CWBATTCOD "Enable Handcodierung" VALUE 0xffe5b684 _REC_VAL_20_u1 1. _CNV_R_R_dez_550_CM 0. 1. FORMAT "%8.4" /end CHARACTERISTIC
/begin CHARACTERISTIC DTANSKOR "Ansaugluftmodelloffset Aussentemperatur" VALUE 0xffe5b685 _REC_VAL_20_s1 255. _CNV_R_R_temp_q1_594_CM -128. 127. FORMAT "%8.4" /end CHARACTERISTIC
/begin CHARACTERISTIC ILMINUMG "integrierte Lufmassenschwelle Aussentemperaturmodell" VALUE 0xffe5b686 _REC_VAL_20_u1 23.210667 _CNV_R_R_m_ub_b23p3_593_CM 0. 23.210667 FORMAT "%8.4" /end CHARACTERISTIC
/begin CHARACTERISTIC KLBATTLSTR "Geschwindigkeitsfaktor Batterieumgebungstemperatur" CURVE 0xffe5b500 _REC_CUR_52_ULONG_S4_S4 65534.9 _CNV_A_R_LINEAR_____22_CM 0.1 65535. FORMAT "%8.4"
 /begin AXIS_DESCR STD_AXIS vfzgf _CNV_A_R_LINEAR_____22_CM 6 0. 65535. FORMAT "%8.4" /end AXIS_DESCR
/end CHARACTERISTIC
/begin CHARACTERISTIC KLEXPALH "Funktion EXP(-ALPHA*tabst_w) hinten" CURVE 0xffe5b534 _REC_CUR_52_ULONG_S4_S4 1. _CNV_A_R_LINEAR_____22_CM 0. 1. FORMAT "%8.4"
 /begin AXIS_DESCR STD_AXIS tabst_fl _CNV_A_R_LINEAR_____22_CM 11 0. 65535. FORMAT "%8.4" /end AXIS_DESCR
/end CHARACTERISTIC
/begin CHARACTERISTIC KLEXPALV "Funktion EXP(-ALPHA*tabst_w) hinten" CURVE 0xffe5b590 _REC_CUR_52_ULONG_S4_S4 1. _CNV_A_R_LINEAR_____22_CM 0. 1. FORMAT "%8.4"
 /begin AXIS_DESCR STD_AXIS tabst_fl _CNV_A_R_LINEAR_____22_CM 11 0. 65535. FORMAT "%8.4" /end AXIS_DESCR
/end CHARACTERISTIC
/begin CHARACTERISTIC KLEXPBETAV "Funktion EXP (-BETA*tabst_w)" CURVE 0xffe5b5ec _REC_CUR_52_ULONG_S4_S4 1. _CNV_A_R_LINEAR_____22_CM 0. 1. FORMAT "%8.4"
 /begin AXIS_DESCR STD_AXIS tabst_fl _CNV_A_R_LINEAR_____22_CM 11 0. 65535. FORMAT "%8.4" /end AXIS_DESCR
/end CHARACTERISTIC
/begin CHARACTERISTIC LADEKENNL "Batterieladespannungskennlinie" CURVE 0xffe5b648 _REC_CUR_52_ULONG_S4_S4 16. _CNV_A_R_LINEAR_____22_CM 0. 16. FORMAT "%8.4"
 /begin AXIS_DESCR STD_AXIS t_battabst _CNV_A_R_LINEAR_____22_CM 6 -2147483648. 4294967295. FORMAT "%8.4" /end AXIS_DESCR
/end CHARACTERISTIC
/begin CHARACTERISTIC LBATTMAX "maximale Batterieladespannung Licht aus" VALUE 0xffe5b6ac _REC_VAL_20_S4 16. _CNV_A_R_LINEAR_____22_CM 0. 16. FORMAT "%8.4" /end CHARACTERISTIC
/begin CHARACTERISTIC LBATTMIN "minmale Batterieladespannung Licht an" VALUE 0xffe5b6b0 _REC_VAL_20_S4 16. _CNV_A_R_LINEAR_____22_CM 0. 16. FORMAT "%8.4" /end CHARACTERISTIC
/begin CHARACTERISTIC MCOBATTORT "Codierung Hand Batterieeinbauort" VALUE 0xffe5b687 _REC_VAL_20_u1 2. _CNV_R_R_dez_550_CM 0. 2. FORMAT "%8.4" /end CHARACTERISTIC
/begin CHARACTERISTIC NMINUMG "Drehzahlschwelle Aussentemperaturmodell" VALUE 0xffe5b688 _REC_VAL_20_u1 10200. _CNV_R_R_nmot_ub_q4_560_CM 0. 10200. FORMAT "%8.4" /end CHARACTERISTIC
/begin CHARACTERISTIC OFTUMGCAN "Offset Umgebungstemperatur CAN" VALUE 0xffe5b689 _REC_VAL_20_s1 255. _CNV_R_R_temp_q1_594_CM -128. 127. FORMAT "%8.4" /end CHARACTERISTIC
/begin CHARACTERISTIC OFULADE "Offset Ladekennlinie Batthinten" VALUE 0xffe5b6b4 _REC_VAL_20_S4 16. _CNV_A_R_LINEAR_____22_CM 0. 16. FORMAT "%8.4" /end CHARACTERISTIC
/begin CHARACTERISTIC PLBATTUMG "Plausibilisierung-Schwelle Batterieumgebungstemperatur" VALUE 0xffe5b6b8 _REC_VAL_20_S4 6442450943. _CNV_A_R_LINEAR_____22_CM -2147483648. 4294967295. FORMAT "%8.4" /end CHARACTERISTIC
/begin CHARACTERISTIC TBATINIMAN "Applikation INITWERT Batterietemperatur" VALUE 0xffe5b68a _REC_VAL_20_u1 191.25 _CNV_R_R_temp_uw_q0_547_CM -48. 143.25 FORMAT "%8.4" /end CHARACTERISTIC
/begin CHARACTERISTIC TBATTFTAUV "Zeitkonstante 5*Tau Batterievorne" VALUE 0xffe5b67c _REC_VAL_20_u2 65535. _CNV_R_R_dez_550_CM 0. 65535. FORMAT "%8.4" /end CHARACTERISTIC
/begin CHARACTERISTIC TBATTTAUFH "Zeitkonstante Batterie 5*Tau hinten" VALUE 0xffe5b6bc _REC_VAL_20_S4 65535. _CNV_A_R_LINEAR_____22_CM 0. 65535. FORMAT "%8.4" /end CHARACTERISTIC
/begin CHARACTERISTIC TUMGINI "Initialisierungswert Aussentemperaturmodell" VALUE 0xffe5b68b _REC_VAL_20_s1 255. _CNV_R_R_temp_q1_594_CM -128. 127. FORMAT "%8.4" /end CHARACTERISTIC
/begin CHARACTERISTIC TUMGTAU "Zeitkonstante 5*Tau Aussentemperatur" VALUE 0xffe5b67e _REC_VAL_20_u2 65535. _CNV_R_R_dez_550_CM 0. 65535. FORMAT "%8.4" /end CHARACTERISTIC
/begin CHARACTERISTIC UBATTNORM "Batterienormspannung" VALUE 0xffe5b6c0 _REC_VAL_20_S4 6442450943. _CNV_A_R_LINEAR_____22_CM -2147483648. 4294967295. FORMAT "%8.4" /end CHARACTERISTIC
/begin CHARACTERISTIC ULADE_TAU "Batterieladespannungs Zeitkonstante" VALUE 0xffe5b6c4 _REC_VAL_20_S4 1. _CNV_A_R_LINEAR_____22_CM 0. 1. FORMAT "%8.4" /end CHARACTERISTIC
/begin CHARACTERISTIC VMINUMG "Fahrzeuggeschwindigkeitsschwelle Aussentemperaturmodell" VALUE 0xffe5b68c _REC_VAL_20_u1 318.75 _CNV_R_R_vfzg_ub_q1_545_CM 0. 318.75 FORMAT "%8.4" /end CHARACTERISTIC
/begin CHARACTERISTIC GENLDDFMAX "Schwell Anzeige maximaler Auslastungsgrad Generator" VALUE 0xffe5b6e8 _REC_VAL_20_u1 99.609375 _CNV_R_R_PCENT_551_CM 0. 99.609375 FORMAT "%8.4" /end CHARACTERISTIC
/begin CHARACTERISTIC KLGENLDST "Auslastungsgrad Generator" CURVE 0xffe5b6c8 _REC_CUR_52_u2_u2 100. _CNV_R_R_PCENT_551_CM 0. 100. FORMAT "%8.4"
 /begin AXIS_DESCR STD_AXIS gentemp _CNV_R_R_temp_uw_q0_547_CM 6 -48. 336. FORMAT "%8.4" /end AXIS_DESCR
/end CHARACTERISTIC
/begin CHARACTERISTIC DFMODE "DF-Mode-Schalter themermisch/elektrisch" VALUE 0xffe5b6e4 _REC_VAL_20_u1 255. _CNV_R_R_dez_550_CM 0. 255. FORMAT "%8.4" /end CHARACTERISTIC
/begin CHARACTERISTIC DFS_MAX "DF-Auslastung Maximalschwelle" VALUE 0xffe5b6e5 _REC_VAL_20_u1 99.609375 _CNV_R_R_PCENT_551_CM 0. 99.609375 FORMAT "%8.4" /end CHARACTERISTIC
/begin CHARACTERISTIC DFS_MIN "DF-Auslastung Minimalschwelle" VALUE 0xffe5b6e6 _REC_VAL_20_u1 99.609375 _CNV_R_R_PCENT_551_CM 0. 99.609375 FORMAT "%8.4" /end CHARACTERISTIC
/begin CHARACTERISTIC DFS_MITT "DF-Auslastung Mittelschwelle" VALUE 0xffe5b6e7 _REC_VAL_20_u1 99.609375 _CNV_R_R_PCENT_551_CM 0. 99.609375 FORMAT "%8.4" /end CHARACTERISTIC
/begin CHARACTERISTIC TNNSTART "Zeittriggerschwelle nach Motorstart" VALUE 0xffe5b6e2 _REC_VAL_20_u2 655.35 _CNV_R_R_t10msxs_uw_595_CM 0. 655.35 FORMAT "%8.4" /end CHARACTERISTIC
/begin MEASUREMENT st_ldstgen "Lastzustand Generator elektrisch/thermisch" UBYTE _CNV_R_R_dez_550_CM 1 100. 0. 255. DISPLAY_IDENTIFIER ST_LDSTGEN ECU_ADDRESS 0x3fa42a FORMAT "%8.4" /end MEASUREMENT
/begin MEASUREMENT dffgenflo "DF-Signal temp" FLOAT32_IEEE _CNV_A_R_LINEAR_____22_CM 1 100. 0. 4294967295. DISPLAY_IDENTIFIER DFFGENFLO ECU_ADDRESS 0x3faa54 /end MEASUREMENT
/begin MEASUREMENT dfmonitor "DF-Monitor für FASTA" UBYTE _CNV_R_R_PCENT_551_CM 1 100. 0. 99.609375 DISPLAY_IDENTIFIER DFMONITOR ECU_ADDRESS 0x3facb4 FORMAT "%8.4" /end MEASUREMENT
/begin MEASUREMENT dfsumme "DFMonitor Summe FASTA" FLOAT32_IEEE _CNV_A_R_LINEAR_____22_CM 1 100. 0. 4294967295. DISPLAY_IDENTIFIER DFSUMME ECU_ADDRESS 0x3facb8 /end MEASUREMENT
/begin MEASUREMENT dfwanzahl "DF-Wertezähler" FLOAT32_IEEE _CNV_A_R_LINEAR_____22_CM 1 100. 1. 4294967295. DISPLAY_IDENTIFIER DFWANZAHL ECU_ADDRESS 0x3facbc /end MEASUREMENT
/begin CHARACTERISTIC B_APP_LLAH "Manuelle Umschaltung auf LL-Anhebung HAND" VALUE 0xffe5b6e9 _REC_VAL_20_u1 255. _CNV_R_R_dez_550_CM 0. 255. FORMAT "%8.4" /end CHARACTERISTIC
/begin CHARACTERISTIC GENLLAHAPP "Manuelle Leerlaufdrehzahlanhebung" VALUE 0xffe5b6ea _REC_VAL_20_u1 255. _CNV_R_R_dez_550_CM 0. 255. FORMAT "%8.4" /end CHARACTERISTIC
/begin CHARACTERISTIC NSUBO "nsoll bei Batterieladebilanz zu niedrig" VALUE 0xffe5b6eb _REC_VAL_20_u1 2550. _CNV_R_R_nmot_ub_q1_596_CM 0. 2550. FORMAT "%8.4" /end CHARACTERISTIC
/begin CHARACTERISTIC NSUBU "nsoll bei Batterieladebilanz io" VALUE 0xffe5b6ec _REC_VAL_20_u1 2550. _CNV_R_R_nmot_ub_q1_596_CM 0. 2550. FORMAT "%8.4" /end CHARACTERISTIC
/begin MEASUREMENT B_nsub "Bedingung für Solldrehzahlanhebung bei niedriger Batterieladebilanz" UBYTE _CNV_A_R_LINEAR_____22_CM 1 100. 0. 255. DISPLAY_IDENTIFIER B_NSUB ECU_ADDRESS 0x3fa42c BIT_MASK 0x1 /end MEASUREMENT
/begin MEASUREMENT nslb "Lerrlaufdrehzahl von Ladebilanz Batterie" UBYTE _CNV_R_R_nmot_ub_q1_596_CM 1 100. 0. 2550. DISPLAY_IDENTIFIER NSLB ECU_ADDRESS 0x3fa42d FORMAT "%8.4" /end MEASUREMENT
/begin MEASUREMENT B_fs "Bedingung Fahrstufe" UBYTE _CNV_A_R_LINEAR_____22_CM 1 100. 0. 255. DISPLAY_IDENTIFIER B_FS ECU_ADDRESS 0x3fe3d3 BIT_MASK 0x1 /end MEASUREMENT
/begin MEASUREMENT B_genslp "" UBYTE _CNV_S_2_B_TRUE_582_CM 1 100. 0. 1. DISPLAY_IDENTIFIER B_GENSLP ECU_ADDRESS 0x3fe3e5 BIT_MASK 0x1 /end MEASUREMENT
/begin CHARACTERISTIC lc_pow_cord_inh "Configuration of alternator powermanagement" VALUE 0xffe40fc7 _REC_VAL_20_u1 1. _CNV_A_R_LINEAR_____22_CM 0. 1. DISPLAY_IDENTIFIER LC_POW_CORD_INH FORMAT "%1.0" /end CHARACTERISTIC
/begin MEASUREMENT B_kl61 "Bedingung KL61" UBYTE _CNV_S_2_RANGE______2_CM 1 100. 0. 1. DISPLAY_IDENTIFIER B_KL61 ECU_ADDRESS 0x3fa378 /end MEASUREMENT
/begin CHARACTERISTIC EN_MDGEN "Enable Generatormomenteinrechung" VALUE 0xffe5b4c7 _REC_VAL_20_u1 255. _CNV_R_R_dez_550_CM 0. 255. FORMAT "%8.4" /end CHARACTERISTIC
/begin CHARACTERISTIC GEN_IG_OF "Offsetwert Generatorstrom" VALUE 0xffe5b45a _REC_VAL_20_u2 254. _CNV_R_R_igen_uw_q0_553_CM 0. 254. FORMAT "%8.4" /end CHARACTERISTIC
/begin CHARACTERISTIC GENITYP "Generatorstrotyp 0=gerechnet / 1=gemessen" VALUE 0xffe5b4d0 _REC_VAL_20_u1 1. _CNV_R_R_dez_550_CM 0. 1. FORMAT "%8.4" /end CHARACTERISTIC
/begin CHARACTERISTIC GENTEMPAPP "Geneeratortemperatur mauelle Vorgabe" VALUE 0xffe5b458 _REC_VAL_20_u2 384. _CNV_R_R_temp_uw_q0_547_CM -48. 336. FORMAT "%8.4" /end CHARACTERISTIC
/begin CHARACTERISTIC GENTEMPMAN "Manuelle Generatorvorgabe" VALUE 0xffe5b4d9 _REC_VAL_20_u1 255. _CNV_R_R_dez_550_CM 0. 255. FORMAT "%8.4" /end CHARACTERISTIC
/begin CHARACTERISTIC GENTYP "Generatortyp" VALUE 0xffe5b4e3 _REC_VAL_20_u1 255. _CNV_R_R_dez_550_CM 0. 255. FORMAT "%8.4" /end CHARACTERISTIC
/begin CHARACTERISTIC GENUMGTYP "Generatorluftumgebung" VALUE 0xffe5b4ec _REC_VAL_20_u1 255. _CNV_R_R_dez_550_CM 0. 255. FORMAT "%8.4" /end CHARACTERISTIC
/begin CHARACTERISTIC TSTCNTEN "Enable TestCounter" VALUE 0xffe5b4f5 _REC_VAL_20_u1 1. _CNV_R_R_dez_550_CM 0. 1. FORMAT "%8.4" /end CHARACTERISTIC
/begin CHARACTERISTIC TSTFIL_IN "Testfilter Eingang" VALUE 0xffe5b45c _REC_VAL_20_u2 768. _CNV_R_R_gendt_q0p0_663_CM 0. 768. FORMAT "%8.4" /end CHARACTERISTIC
/begin CHARACTERISTIC TSTFIL_INI "Initialisierung Testfilter" VALUE 0xffe5b4f6 _REC_VAL_20_u1 255. _CNV_R_R_dez_550_CM 0. 255. FORMAT "%8.4" /end CHARACTERISTIC
/begin CHARACTERISTIC ZMGENIG "Zeitkonstante Generatorstrom" VALUE 0xffe5b45e _REC_VAL_20_u2 1.9999695 _CNV_R_R_genzmig_uw_664_CM 0. 1.9999695 FORMAT "%8.4" /end CHARACTERISTIC
/begin CHARACTERISTIC ZMTESTFIL "Zeitkonstante Testfilter" VALUE 0xffe5b4c4 _REC_VAL_20_u2 0.99998474 _CNV_R_R_genzmst_uw_665_CM 0. 0.99998474 FORMAT "%8.4" /end CHARACTERISTIC
/begin CHARACTERISTIC ENGENTANS "Schwelle Motortemperatur fuer Freigabe Generaturansaugluft " VALUE 0xffe5b4c6 _REC_VAL_20_u1 191.25 _CNV_R_R_temp_uw_q0_547_CM -48. 143.25 FORMAT "%8.4" /end CHARACTERISTIC
/begin CHARACTERISTIC GENTMOTDT "Offset Generatorwassertemperatur" VALUE 0xffe5b4da _REC_VAL_20_u1 191.25 _CNV_R_R_temp_uw_q0_547_CM -48. 143.25 FORMAT "%8.4" /end CHARACTERISTIC
/begin CHARACTERISTIC GENVFZGSW "geschwindigkeitsabhängige Generatoransaugluftschwelle" VALUE 0xffe5b4ed _REC_VAL_20_u1 318.75 _CNV_R_R_vfzg_ub_q1_545_CM 0. 318.75 FORMAT "%8.4" /end CHARACTERISTIC
/begin CHARACTERISTIC KLIGENMESS "Transferfunktion I_Generator" CURVE 0xffe5b12c _REC_CUR_32_u2_u2 511.99219 _CNV_R_R_fak_uw_b51_666_CM 0. 511.99219 FORMAT "%8.4"
 /begin AXIS_DESCR STD_AXIS igenmess _CNV_R_R_dez_550_CM 4 0. 1024. FORMAT "%8.4" /end AXIS_DESCR
/end CHARACTERISTIC
/begin CHARACTERISTIC KLRTHFAK0 "RTHfaktor ueber Generatorstrom" CURVE 0xffe5b2c6 _REC_CUR_32_u1_u1 3.984375 _CNV_R_R_fak_ub_b4_598_CM 0. 3.984375 FORMAT "%8.4"
 /begin AXIS_DESCR STD_AXIS geni_end _CNV_R_R_dez_550_CM 11 0. 254. FORMAT "%8.4" /end AXIS_DESCR
/end CHARACTERISTIC
/begin CHARACTERISTIC PRELLGTMOT "Prellzeit für Tmot-Schwelle" VALUE 0xffe5b4f2 _REC_VAL_20_u1 255. _CNV_R_R_dez_550_CM 0. 255. FORMAT "%8.4" /end CHARACTERISTIC
/begin CHARACTERISTIC ZMGENSTHZ0 "Zeitkonstante Generatorstator0 Aufheizung" VALUE 0xffe5b480 _REC_VAL_20_u2 0.99998474 _CNV_R_R_genzmst_uw_665_CM 0. 0.99998474 FORMAT "%8.4" /end CHARACTERISTIC
/begin CHARACTERISTIC ZMGENSTKL0 "Zeitkonstante Abkühlung Generator0" VALUE 0xffe5b490 _REC_VAL_20_u2 0.99998474 _CNV_R_R_genzmst_uw_665_CM 0. 0.99998474 FORMAT "%8.4" /end CHARACTERISTIC
/begin CHARACTERISTIC ZMGENTWA "Zeitkonstante Generatorstatorwasser" VALUE 0xffe5b4a0 _REC_VAL_20_u2 0.99998474 _CNV_R_R_genzmst_uw_665_CM 0. 0.99998474 FORMAT "%8.4" /end CHARACTERISTIC
/begin CHARACTERISTIC GENDIFAK0 "Stromfaktor Diode0" VALUE 0xffe5b4c8 _REC_VAL_20_u1 0.99609375 _CNV_R_R_fak_ub_b1_586_CM 0. 0.99609375 FORMAT "%8.4" /end CHARACTERISTIC
/begin CHARACTERISTIC GENDIFAK1 "Stromfaktor Diode1" VALUE 0xffe5b4c9 _REC_VAL_20_u1 0.99609375 _CNV_R_R_fak_ub_b1_586_CM 0. 0.99609375 FORMAT "%8.4" /end CHARACTERISTIC
/begin CHARACTERISTIC GENDIFAK2 "Stromfaktor Diode2" VALUE 0xffe5b4ca _REC_VAL_20_u1 0.99609375 _CNV_R_R_fak_ub_b1_586_CM 0. 0.99609375 FORMAT "%8.4" /end CHARACTERISTIC
/begin CHARACTERISTIC GENDIFAK3 "Stromfaktor Diode3" VALUE 0xffe5b4cb _REC_VAL_20_u1 0.99609375 _CNV_R_R_fak_ub_b1_586_CM 0. 0.99609375 FORMAT "%8.4" /end CHARACTERISTIC
/begin CHARACTERISTIC GENDIFAK4 "Stromfaktor Diode4" VALUE 0xffe5b4cc _REC_VAL_20_u1 0.99609375 _CNV_R_R_fak_ub_b1_586_CM 0. 0.99609375 FORMAT "%8.4" /end CHARACTERISTIC
/begin CHARACTERISTIC GENDIFAK5 "Stromfaktor Diode" VALUE 0xffe5b4cd _REC_VAL_20_u1 0.99609375 _CNV_R_R_fak_ub_b1_586_CM 0. 0.99609375 FORMAT "%8.4" /end CHARACTERISTIC
/begin CHARACTERISTIC GENDIFAK6 "Stromfaktor Diode6" VALUE 0xffe5b4ce _REC_VAL_20_u1 0.99609375 _CNV_R_R_fak_ub_b1_586_CM 0. 0.99609375 FORMAT "%8.4" /end CHARACTERISTIC
/begin CHARACTERISTIC GENDIFAK7 "Stromfaktor Diode7" VALUE 0xffe5b4cf _REC_VAL_20_u1 0.99609375 _CNV_R_R_fak_ub_b1_586_CM 0. 0.99609375 FORMAT "%8.4" /end CHARACTERISTIC
/begin CHARACTERISTIC GENRS0_0 "Generatorstatorwiderstand0 bei 25°" VALUE 0xffe5b448 _REC_VAL_20_u2 0.99998474 _CNV_R_R_genrstator_667_CM 0. 0.99998474 FORMAT "%8.4" /end CHARACTERISTIC
/begin CHARACTERISTIC GENRS0_1 "Generatorstatorwiderstand1 bei 25°" VALUE 0xffe5b44a _REC_VAL_20_u2 0.99998474 _CNV_R_R_genrstator_667_CM 0. 0.99998474 FORMAT "%8.4" /end CHARACTERISTIC
/begin CHARACTERISTIC GENRS0_2 "Generatorstatorwiderstand2 bei 25°" VALUE 0xffe5b44c _REC_VAL_20_u2 0.99998474 _CNV_R_R_genrstator_667_CM 0. 0.99998474 FORMAT "%8.4" /end CHARACTERISTIC
/begin CHARACTERISTIC GENRS0_3 "Generatorstatorwiderstand3 bei 25°" VALUE 0xffe5b44e _REC_VAL_20_u2 0.99998474 _CNV_R_R_genrstator_667_CM 0. 0.99998474 FORMAT "%8.4" /end CHARACTERISTIC
/begin CHARACTERISTIC GENRS0_4 "Generatorstatorwiderstand4 bei 25°" VALUE 0xffe5b450 _REC_VAL_20_u2 0.99998474 _CNV_R_R_genrstator_667_CM 0. 0.99998474 FORMAT "%8.4" /end CHARACTERISTIC
/begin CHARACTERISTIC GENRS0_5 "Generatorstatorwiderstand5 bei 25°" VALUE 0xffe5b452 _REC_VAL_20_u2 0.99998474 _CNV_R_R_genrstator_667_CM 0. 0.99998474 FORMAT "%8.4" /end CHARACTERISTIC
/begin CHARACTERISTIC GENRS0_6 "Generatorstatorwiderstand6 bei 25°" VALUE 0xffe5b454 _REC_VAL_20_u2 0.99998474 _CNV_R_R_genrstator_667_CM 0. 0.99998474 FORMAT "%8.4" /end CHARACTERISTIC
/begin CHARACTERISTIC GENRS0_7 "Generatorstatorwiderstand7 bei 25°" VALUE 0xffe5b456 _REC_VAL_20_u2 0.99998474 _CNV_R_R_genrstator_667_CM 0. 0.99998474 FORMAT "%8.4" /end CHARACTERISTIC
/begin CHARACTERISTIC GENSTFAK0 "Stromfaktor Statorspule0" VALUE 0xffe5b4d1 _REC_VAL_20_u1 0.99609375 _CNV_R_R_fak_ub_b1_586_CM 0. 0.99609375 FORMAT "%8.4" /end CHARACTERISTIC
/begin CHARACTERISTIC GENSTFAK1 "Stromfaktor Statorspule" VALUE 0xffe5b4d2 _REC_VAL_20_u1 0.99609375 _CNV_R_R_fak_ub_b1_586_CM 0. 0.99609375 FORMAT "%8.4" /end CHARACTERISTIC
/begin CHARACTERISTIC GENSTFAK2 "Stromfaktor Statorspule2" VALUE 0xffe5b4d3 _REC_VAL_20_u1 0.99609375 _CNV_R_R_fak_ub_b1_586_CM 0. 0.99609375 FORMAT "%8.4" /end CHARACTERISTIC
/begin CHARACTERISTIC GENSTFAK3 "Stromfaktor Statorspule3" VALUE 0xffe5b4d4 _REC_VAL_20_u1 0.99609375 _CNV_R_R_fak_ub_b1_586_CM 0. 0.99609375 FORMAT "%8.4" /end CHARACTERISTIC
/begin CHARACTERISTIC GENSTFAK4 "Stromfaktor Statorspule4" VALUE 0xffe5b4d5 _REC_VAL_20_u1 0.99609375 _CNV_R_R_fak_ub_b1_586_CM 0. 0.99609375 FORMAT "%8.4" /end CHARACTERISTIC
/begin CHARACTERISTIC GENSTFAK5 "Stromfaktor Statorspule5" VALUE 0xffe5b4d6 _REC_VAL_20_u1 0.99609375 _CNV_R_R_fak_ub_b1_586_CM 0. 0.99609375 FORMAT "%8.4" /end CHARACTERISTIC
/begin CHARACTERISTIC GENSTFAK6 "Stromfaktor Statorspule6" VALUE 0xffe5b4d7 _REC_VAL_20_u1 0.99609375 _CNV_R_R_fak_ub_b1_586_CM 0. 0.99609375 FORMAT "%8.4" /end CHARACTERISTIC
/begin CHARACTERISTIC GENSTFAK7 "Stromfaktor Statorspule7" VALUE 0xffe5b4d8 _REC_VAL_20_u1 0.99609375 _CNV_R_R_fak_ub_b1_586_CM 0. 0.99609375 FORMAT "%8.4" /end CHARACTERISTIC
/begin CHARACTERISTIC GENTMOTOF0 "Offset Generatoransaugluft" VALUE 0xffe5b4db _REC_VAL_20_u1 191.25 _CNV_R_R_temp_uw_q0_547_CM -48. 143.25 FORMAT "%8.4" /end CHARACTERISTIC
/begin CHARACTERISTIC GENTMOTOF1 "Offset Generatoransaugluft" VALUE 0xffe5b4dc _REC_VAL_20_u1 191.25 _CNV_R_R_temp_uw_q0_547_CM -48. 143.25 FORMAT "%8.4" /end CHARACTERISTIC
/begin CHARACTERISTIC GENTMOTOF2 "Offset Generatoransaugluft" VALUE 0xffe5b4dd _REC_VAL_20_u1 191.25 _CNV_R_R_temp_uw_q0_547_CM -48. 143.25 FORMAT "%8.4" /end CHARACTERISTIC
/begin CHARACTERISTIC GENTMOTOF3 "Offset Generatoransaugluft" VALUE 0xffe5b4de _REC_VAL_20_u1 191.25 _CNV_R_R_temp_uw_q0_547_CM -48. 143.25 FORMAT "%8.4" /end CHARACTERISTIC
/begin CHARACTERISTIC GENTMOTOF4 "Offset Generatoransaugluft" VALUE 0xffe5b4df _REC_VAL_20_u1 191.25 _CNV_R_R_temp_uw_q0_547_CM -48. 143.25 FORMAT "%8.4" /end CHARACTERISTIC
/begin CHARACTERISTIC GENTMOTOF5 "Offset Generatoransaugluft" VALUE 0xffe5b4e0 _REC_VAL_20_u1 191.25 _CNV_R_R_temp_uw_q0_547_CM -48. 143.25 FORMAT "%8.4" /end CHARACTERISTIC
/begin CHARACTERISTIC GENTMOTOF6 "Offset Generatoransaugluft" VALUE 0xffe5b4e1 _REC_VAL_20_u1 191.25 _CNV_R_R_temp_uw_q0_547_CM -48. 143.25 FORMAT "%8.4" /end CHARACTERISTIC
/begin CHARACTERISTIC GENTMOTOF7 "Offset Generatoransaugluft" VALUE 0xffe5b4e2 _REC_VAL_20_u1 191.25 _CNV_R_R_temp_uw_q0_547_CM -48. 143.25 FORMAT "%8.4" /end CHARACTERISTIC
/begin CHARACTERISTIC GENTYPFELD "Generatorkennfeldzuordnung" VAL_BLK 0xffe5b426 _REC_VAL_2_u1 255. _CNV_R_R_dez_550_CM 0. 255. FORMAT "%8.4" NUMBER 32 /end CHARACTERISTIC
/begin CHARACTERISTIC IGBASIS "Generatorgrundstrombedarf FZG " VALUE 0xffe5b4ee _REC_VAL_20_u1 255. _CNV_R_R_dez_550_CM 0. 255. FORMAT "%8.4" /end CHARACTERISTIC
/begin CHARACTERISTIC IGBASISOFF "Generatorgrundstrombedarf FZG bei Genred" VALUE 0xffe5b4ef _REC_VAL_20_u1 255. _CNV_R_R_dez_550_CM 0. 255. FORMAT "%8.4" /end CHARACTERISTIC
/begin CHARACTERISTIC KFGENWETA0 "Wirkungsgrad0 Generator mit 2*PI" MAP 0xffe5a464 _REC_MAP_32_u1_u1_u2 7.96875 _CNV_R_R_geneta_q0p_668_CM 0. 7.96875 FORMAT "%8.4" /begin AXIS_DESCR STD_AXIS igm _CNV_R_R_dez_550_CM 8 0. 255. FORMAT "%8.4" /end AXIS_DESCR
 /begin AXIS_DESCR STD_AXIS ngen_w _CNV_R_R_ngen_uw_q0_554_CM 8 0. 32767.5 FORMAT "%8.4" /end AXIS_DESCR
/end CHARACTERISTIC
/begin CHARACTERISTIC KFGENWETA1 "Wirkungsgrad1 Generator mit 2*PI" MAP 0xffe5a4be _REC_MAP_32_u1_u1_u2 7.96875 _CNV_R_R_geneta_q0p_668_CM 0. 7.96875 FORMAT "%8.4" /begin AXIS_DESCR STD_AXIS igm _CNV_R_R_dez_550_CM 8 0. 255. FORMAT "%8.4" /end AXIS_DESCR
 /begin AXIS_DESCR STD_AXIS ngen_w _CNV_R_R_ngen_uw_q0_554_CM 8 0. 32767.5 FORMAT "%8.4" /end AXIS_DESCR
/end CHARACTERISTIC
/begin CHARACTERISTIC KFGENWETA2 "Wirkungsgrad2 Generator mit 2*PI" MAP 0xffe5a518 _REC_MAP_32_u1_u1_u2 7.96875 _CNV_R_R_geneta_q0p_668_CM 0. 7.96875 FORMAT "%8.4" /begin AXIS_DESCR STD_AXIS igm _CNV_R_R_dez_550_CM 8 0. 255. FORMAT "%8.4" /end AXIS_DESCR
 /begin AXIS_DESCR STD_AXIS ngen_w _CNV_R_R_ngen_uw_q0_554_CM 8 0. 32767.5 FORMAT "%8.4" /end AXIS_DESCR
/end CHARACTERISTIC
/begin CHARACTERISTIC KFGENWETA3 "Wirkungsgrad3 Generator mit 2*PI" MAP 0xffe5a572 _REC_MAP_32_u1_u1_u2 7.96875 _CNV_R_R_geneta_q0p_668_CM 0. 7.96875 FORMAT "%8.4" /begin AXIS_DESCR STD_AXIS igm _CNV_R_R_dez_550_CM 8 0. 255. FORMAT "%8.4" /end AXIS_DESCR
 /begin AXIS_DESCR STD_AXIS ngen_w _CNV_R_R_ngen_uw_q0_554_CM 8 0. 32767.5 FORMAT "%8.4" /end AXIS_DESCR
/end CHARACTERISTIC
/begin CHARACTERISTIC KFGENWETA4 "Wirkungsgrad4 Generator mit 2*PI" MAP 0xffe5a5cc _REC_MAP_32_u1_u1_u2 7.96875 _CNV_R_R_geneta_q0p_668_CM 0. 7.96875 FORMAT "%8.4" /begin AXIS_DESCR STD_AXIS igm _CNV_R_R_dez_550_CM 8 0. 255. FORMAT "%8.4" /end AXIS_DESCR
 /begin AXIS_DESCR STD_AXIS ngen_w _CNV_R_R_ngen_uw_q0_554_CM 8 0. 32767.5 FORMAT "%8.4" /end AXIS_DESCR
/end CHARACTERISTIC
/begin CHARACTERISTIC KFGENWETA5 "Wirkungsgrad5 Generator mit 2*PI" MAP 0xffe5a626 _REC_MAP_32_u1_u1_u2 7.96875 _CNV_R_R_geneta_q0p_668_CM 0. 7.96875 FORMAT "%8.4" /begin AXIS_DESCR STD_AXIS igm _CNV_R_R_dez_550_CM 8 0. 255. FORMAT "%8.4" /end AXIS_DESCR
 /begin AXIS_DESCR STD_AXIS ngen_w _CNV_R_R_ngen_uw_q0_554_CM 8 0. 32767.5 FORMAT "%8.4" /end AXIS_DESCR
/end CHARACTERISTIC
/begin CHARACTERISTIC KFGENWETA6 "Wirkungsgrad6 Generator mit 2*PI" MAP 0xffe5a680 _REC_MAP_32_u1_u1_u2 7.96875 _CNV_R_R_geneta_q0p_668_CM 0. 7.96875 FORMAT "%8.4" /begin AXIS_DESCR STD_AXIS igm _CNV_R_R_dez_550_CM 8 0. 255. FORMAT "%8.4" /end AXIS_DESCR
 /begin AXIS_DESCR STD_AXIS ngen_w _CNV_R_R_ngen_uw_q0_554_CM 8 0. 32767.5 FORMAT "%8.4" /end AXIS_DESCR
/end CHARACTERISTIC
/begin CHARACTERISTIC KFGENWETA7 "Wirkungsgrad7 Generator mit 2*PI" MAP 0xffe5a6da _REC_MAP_32_u1_u1_u2 7.96875 _CNV_R_R_geneta_q0p_668_CM 0. 7.96875 FORMAT "%8.4" /begin AXIS_DESCR STD_AXIS igm _CNV_R_R_dez_550_CM 8 0. 255. FORMAT "%8.4" /end AXIS_DESCR
 /begin AXIS_DESCR STD_AXIS ngen_w _CNV_R_R_ngen_uw_q0_554_CM 8 0. 32767.5 FORMAT "%8.4" /end AXIS_DESCR
/end CHARACTERISTIC
/begin CHARACTERISTIC KFIGENDF0 "Generatorstrom0 DF-Kennfeld" MAP 0xffe5ac14 _REC_MAP_32_u1_u1_u1 255. _CNV_R_R_dez_550_CM 0. 255. FORMAT "%8.4"
 /begin AXIS_DESCR STD_AXIS dffgen _CNV_R_R_PCENT_551_CM 7 0. 99.609375 FORMAT "%8.4" /end AXIS_DESCR
 /begin AXIS_DESCR STD_AXIS genitemp _CNV_R_R_dez_550_CM 8 0. 255. FORMAT "%8.4" /end AXIS_DESCR
/end CHARACTERISTIC
/begin CHARACTERISTIC KFIGENDF1 "Generatorstrom1 DF-Kennfeld" MAP 0xffe5ac5d _REC_MAP_32_u1_u1_u1 255. _CNV_R_R_dez_550_CM 0. 255. FORMAT "%8.4"
 /begin AXIS_DESCR STD_AXIS dffgen _CNV_R_R_PCENT_551_CM 7 0. 99.609375 FORMAT "%8.4" /end AXIS_DESCR
 /begin AXIS_DESCR STD_AXIS genitemp _CNV_R_R_dez_550_CM 8 0. 255. FORMAT "%8.4" /end AXIS_DESCR
/end CHARACTERISTIC
/begin CHARACTERISTIC KFIGENDF2 "Generatorstrom2 DF-Kennfeld" MAP 0xffe5aca6 _REC_MAP_32_u1_u1_u1 255. _CNV_R_R_dez_550_CM 0. 255. FORMAT "%8.4"
 /begin AXIS_DESCR STD_AXIS dffgen _CNV_R_R_PCENT_551_CM 7 0. 99.609375 FORMAT "%8.4" /end AXIS_DESCR
 /begin AXIS_DESCR STD_AXIS genitemp _CNV_R_R_dez_550_CM 8 0. 255. FORMAT "%8.4" /end AXIS_DESCR
/end CHARACTERISTIC
/begin CHARACTERISTIC KFIGENDF3 "Generatorstrom3 DF-Kennfeld" MAP 0xffe5acef _REC_MAP_32_u1_u1_u1 255. _CNV_R_R_dez_550_CM 0. 255. FORMAT "%8.4"
 /begin AXIS_DESCR STD_AXIS dffgen _CNV_R_R_PCENT_551_CM 7 0. 99.609375 FORMAT "%8.4" /end AXIS_DESCR
 /begin AXIS_DESCR STD_AXIS genitemp _CNV_R_R_dez_550_CM 8 0. 255. FORMAT "%8.4" /end AXIS_DESCR
/end CHARACTERISTIC
/begin CHARACTERISTIC KFIGENDF4 "Generatorstrom4 DF-Kennfeld" MAP 0xffe5ad38 _REC_MAP_32_u1_u1_u1 255. _CNV_R_R_dez_550_CM 0. 255. FORMAT "%8.4"
 /begin AXIS_DESCR STD_AXIS dffgen _CNV_R_R_PCENT_551_CM 7 0. 99.609375 FORMAT "%8.4" /end AXIS_DESCR
 /begin AXIS_DESCR STD_AXIS genitemp _CNV_R_R_dez_550_CM 8 0. 255. FORMAT "%8.4" /end AXIS_DESCR
/end CHARACTERISTIC
/begin CHARACTERISTIC KFIGENDF5 "Generatorstrom5 DF-Kennfeld" MAP 0xffe5ad81 _REC_MAP_32_u1_u1_u1 255. _CNV_R_R_dez_550_CM 0. 255. FORMAT "%8.4"
 /begin AXIS_DESCR STD_AXIS dffgen _CNV_R_R_PCENT_551_CM 7 0. 99.609375 FORMAT "%8.4" /end AXIS_DESCR
 /begin AXIS_DESCR STD_AXIS genitemp _CNV_R_R_dez_550_CM 8 0. 255. FORMAT "%8.4" /end AXIS_DESCR
/end CHARACTERISTIC
/begin CHARACTERISTIC KFIGENDF6 "Generatorstrom6 DF-Kennfeld" MAP 0xffe5adca _REC_MAP_32_u1_u1_u1 255. _CNV_R_R_dez_550_CM 0. 255. FORMAT "%8.4"
 /begin AXIS_DESCR STD_AXIS dffgen _CNV_R_R_PCENT_551_CM 7 0. 99.609375 FORMAT "%8.4" /end AXIS_DESCR
 /begin AXIS_DESCR STD_AXIS genitemp _CNV_R_R_dez_550_CM 8 0. 255. FORMAT "%8.4" /end AXIS_DESCR
/end CHARACTERISTIC
/begin CHARACTERISTIC KFIGENDF7 "Generatorstrom7 DF-Kennfeld" MAP 0xffe5ae13 _REC_MAP_32_u1_u1_u1 255. _CNV_R_R_dez_550_CM 0. 255. FORMAT "%8.4"
 /begin AXIS_DESCR STD_AXIS dffgen _CNV_R_R_PCENT_551_CM 7 0. 99.609375 FORMAT "%8.4" /end AXIS_DESCR
 /begin AXIS_DESCR STD_AXIS genitemp _CNV_R_R_dez_550_CM 8 0. 255. FORMAT "%8.4" /end AXIS_DESCR
/end CHARACTERISTIC
/begin CHARACTERISTIC KLFPDIODE0 "Verlustleistungsfaktor eines Diodenpaars0" CURVE 0xffe5ae5c _REC_CUR_32_u2_u2 1.9921875 _CNV_R_R_fak_ub_b2_546_CM 0. 1.9921875 FORMAT "%8.4"
 /begin AXIS_DESCR STD_AXIS gentemp _CNV_R_R_temp_uw_q0_547_CM 5 -48. 336. FORMAT "%8.4" /end AXIS_DESCR
/end CHARACTERISTIC
/begin CHARACTERISTIC KLFPDIODE1 "Verlustleistungsfaktor eines Diodenpaars1" CURVE 0xffe5ae72 _REC_CUR_32_u2_u2 1.9921875 _CNV_R_R_fak_ub_b2_546_CM 0. 1.9921875 FORMAT "%8.4"
 /begin AXIS_DESCR STD_AXIS gentemp _CNV_R_R_temp_uw_q0_547_CM 5 -48. 336. FORMAT "%8.4" /end AXIS_DESCR
/end CHARACTERISTIC
/begin CHARACTERISTIC KLFPDIODE2 "Verlustleistungsfaktor eines Diodenpaars2" CURVE 0xffe5ae88 _REC_CUR_32_u2_u2 1.9921875 _CNV_R_R_fak_ub_b2_546_CM 0. 1.9921875 FORMAT "%8.4"
 /begin AXIS_DESCR STD_AXIS gentemp _CNV_R_R_temp_uw_q0_547_CM 5 -48. 336. FORMAT "%8.4" /end AXIS_DESCR
/end CHARACTERISTIC
/begin CHARACTERISTIC KLFPDIODE3 "Verlustleistungsfaktor eines Diodenpaars" CURVE 0xffe5ae9e _REC_CUR_32_u2_u2 1.9921875 _CNV_R_R_fak_ub_b2_546_CM 0. 1.9921875 FORMAT "%8.4"
 /begin AXIS_DESCR STD_AXIS gentemp _CNV_R_R_temp_uw_q0_547_CM 5 -48. 336. FORMAT "%8.4" /end AXIS_DESCR
/end CHARACTERISTIC
/begin CHARACTERISTIC KLFPDIODE4 "Verlustleistungsfaktor eines Diodenpaars4" CURVE 0xffe5aeb4 _REC_CUR_32_u2_u2 1.9921875 _CNV_R_R_fak_ub_b2_546_CM 0. 1.9921875 FORMAT "%8.4"
 /begin AXIS_DESCR STD_AXIS gentemp _CNV_R_R_temp_uw_q0_547_CM 5 -48. 336. FORMAT "%8.4" /end AXIS_DESCR
/end CHARACTERISTIC
/begin CHARACTERISTIC KLFPDIODE5 "Verlustleistungsfaktor eines Diodenpaars5" CURVE 0xffe5aeca _REC_CUR_32_u2_u2 1.9921875 _CNV_R_R_fak_ub_b2_546_CM 0. 1.9921875 FORMAT "%8.4"
 /begin AXIS_DESCR STD_AXIS gentemp _CNV_R_R_temp_uw_q0_547_CM 5 -48. 336. FORMAT "%8.4" /end AXIS_DESCR
/end CHARACTERISTIC
/begin CHARACTERISTIC KLFPDIODE6 "Verlustleistungsfaktor eines Diodenpaars6" CURVE 0xffe5aee0 _REC_CUR_32_u2_u2 1.9921875 _CNV_R_R_fak_ub_b2_546_CM 0. 1.9921875 FORMAT "%8.4"
 /begin AXIS_DESCR STD_AXIS gentemp _CNV_R_R_temp_uw_q0_547_CM 5 -48. 336. FORMAT "%8.4" /end AXIS_DESCR
/end CHARACTERISTIC
/begin CHARACTERISTIC KLFPDIODE7 "Verlustleistungsfaktor eines Diodenpaars7" CURVE 0xffe5aef6 _REC_CUR_32_u2_u2 1.9921875 _CNV_R_R_fak_ub_b2_546_CM 0. 1.9921875 FORMAT "%8.4"
 /begin AXIS_DESCR STD_AXIS gentemp _CNV_R_R_temp_uw_q0_547_CM 5 -48. 336. FORMAT "%8.4" /end AXIS_DESCR
/end CHARACTERISTIC
/begin CHARACTERISTIC KLGENEXP0 "Abkühlkurve Generator0" CURVE 0xffe5af0c _REC_CUR_32_u2_u2 1. _CNV_R_R_fak_ub_b1_586_CM 0. 1. FORMAT "%8.4"
 /begin AXIS_DESCR STD_AXIS tabst_w _CNV_R_R_dez_550_CM 13 0. 65535. FORMAT "%8.4" /end AXIS_DESCR
/end CHARACTERISTIC
/begin CHARACTERISTIC KLGENEXP1 "Abkühlkurve Generator1" CURVE 0xffe5af42 _REC_CUR_32_u2_u2 1. _CNV_R_R_fak_ub_b1_586_CM 0. 1. FORMAT "%8.4"
 /begin AXIS_DESCR STD_AXIS tabst_w _CNV_R_R_dez_550_CM 13 0. 65535. FORMAT "%8.4" /end AXIS_DESCR
/end CHARACTERISTIC
/begin CHARACTERISTIC KLGENEXP2 "Abkühlkurve Generator2" CURVE 0xffe5af78 _REC_CUR_32_u2_u2 1. _CNV_R_R_fak_ub_b1_586_CM 0. 1. FORMAT "%8.4"
 /begin AXIS_DESCR STD_AXIS tabst_w _CNV_R_R_dez_550_CM 13 0. 65535. FORMAT "%8.4" /end AXIS_DESCR
/end CHARACTERISTIC
/begin CHARACTERISTIC KLGENEXP3 "Abkühlkurve Generator3" CURVE 0xffe5afae _REC_CUR_32_u2_u2 1. _CNV_R_R_fak_ub_b1_586_CM 0. 1. FORMAT "%8.4"
 /begin AXIS_DESCR STD_AXIS tabst_w _CNV_R_R_dez_550_CM 13 0. 65535. FORMAT "%8.4" /end AXIS_DESCR
/end CHARACTERISTIC
/begin CHARACTERISTIC KLGENEXP4 "Abkühlkurve Generator4" CURVE 0xffe5afe4 _REC_CUR_32_u2_u2 1. _CNV_R_R_fak_ub_b1_586_CM 0. 1. FORMAT "%8.4"
 /begin AXIS_DESCR STD_AXIS tabst_w _CNV_R_R_dez_550_CM 13 0. 65535. FORMAT "%8.4" /end AXIS_DESCR
/end CHARACTERISTIC
/begin CHARACTERISTIC KLGENEXP5 "Abkühlkurve Generator5" CURVE 0xffe5b01a _REC_CUR_32_u2_u2 1. _CNV_R_R_fak_ub_b1_586_CM 0. 1. FORMAT "%8.4"
 /begin AXIS_DESCR STD_AXIS tabst_w _CNV_R_R_dez_550_CM 13 0. 65535. FORMAT "%8.4" /end AXIS_DESCR
/end CHARACTERISTIC
/begin CHARACTERISTIC KLGENEXP6 "Abkühlkurve Generator6" CURVE 0xffe5b050 _REC_CUR_32_u2_u2 1. _CNV_R_R_fak_ub_b1_586_CM 0. 1. FORMAT "%8.4"
 /begin AXIS_DESCR STD_AXIS tabst_w _CNV_R_R_dez_550_CM 13 0. 65535. FORMAT "%8.4" /end AXIS_DESCR
/end CHARACTERISTIC
/begin CHARACTERISTIC KLGENEXP7 "Abkühlkurve Generator7" CURVE 0xffe5b086 _REC_CUR_32_u2_u2 1. _CNV_R_R_fak_ub_b1_586_CM 0. 1. FORMAT "%8.4"
 /begin AXIS_DESCR STD_AXIS tabst_w _CNV_R_R_dez_550_CM 13 0. 65535. FORMAT "%8.4" /end AXIS_DESCR
/end CHARACTERISTIC
/begin CHARACTERISTIC KLGENTETA0 "Temperatur_eta_faktor Generator0" CURVE 0xffe5b0bc _REC_CUR_32_u2_u2 2. _CNV_R_R_fak_ub_b1_586_CM 0. 2. FORMAT "%8.4"
 /begin AXIS_DESCR STD_AXIS gentemp _CNV_R_R_temp_uw_q0_547_CM 3 -48. 336. FORMAT "%8.4" /end AXIS_DESCR
/end CHARACTERISTIC
/begin CHARACTERISTIC KLGENTETA1 "Temperatur_eta_faktor Generator1" CURVE 0xffe5b0ca _REC_CUR_32_u2_u2 2. _CNV_R_R_fak_ub_b1_586_CM 0. 2. FORMAT "%8.4"
 /begin AXIS_DESCR STD_AXIS gentemp _CNV_R_R_temp_uw_q0_547_CM 3 -48. 336. FORMAT "%8.4" /end AXIS_DESCR
/end CHARACTERISTIC
/begin CHARACTERISTIC KLGENTETA2 "Temperatur_eta_faktor Generator2" CURVE 0xffe5b0d8 _REC_CUR_32_u2_u2 2. _CNV_R_R_fak_ub_b1_586_CM 0. 2. FORMAT "%8.4"
 /begin AXIS_DESCR STD_AXIS gentemp _CNV_R_R_temp_uw_q0_547_CM 3 -48. 336. FORMAT "%8.4" /end AXIS_DESCR
/end CHARACTERISTIC
/begin CHARACTERISTIC KLGENTETA3 "Temperatur_eta_faktor Generator3" CURVE 0xffe5b0e6 _REC_CUR_32_u2_u2 2. _CNV_R_R_fak_ub_b1_586_CM 0. 2. FORMAT "%8.4"
 /begin AXIS_DESCR STD_AXIS gentemp _CNV_R_R_temp_uw_q0_547_CM 3 -48. 336. FORMAT "%8.4" /end AXIS_DESCR
/end CHARACTERISTIC
/begin CHARACTERISTIC KLGENTETA4 "Temperatur_eta_faktor Generator4" CURVE 0xffe5b0f4 _REC_CUR_32_u2_u2 2. _CNV_R_R_fak_ub_b1_586_CM 0. 2. FORMAT "%8.4"
 /begin AXIS_DESCR STD_AXIS gentemp _CNV_R_R_temp_uw_q0_547_CM 3 -48. 336. FORMAT "%8.4" /end AXIS_DESCR
/end CHARACTERISTIC
/begin CHARACTERISTIC KLGENTETA5 "Temperatur_eta_faktor Generator5" CURVE 0xffe5b102 _REC_CUR_32_u2_u2 2. _CNV_R_R_fak_ub_b1_586_CM 0. 2. FORMAT "%8.4"
 /begin AXIS_DESCR STD_AXIS gentemp _CNV_R_R_temp_uw_q0_547_CM 3 -48. 336. FORMAT "%8.4" /end AXIS_DESCR
/end CHARACTERISTIC
/begin CHARACTERISTIC KLGENTETA6 "Temperatur_eta_faktor Generator6" CURVE 0xffe5b110 _REC_CUR_32_u2_u2 2. _CNV_R_R_fak_ub_b1_586_CM 0. 2. FORMAT "%8.4"
 /begin AXIS_DESCR STD_AXIS gentemp _CNV_R_R_temp_uw_q0_547_CM 3 -48. 336. FORMAT "%8.4" /end AXIS_DESCR
/end CHARACTERISTIC
/begin CHARACTERISTIC KLGENTETA7 "Temperatur_eta_faktor Generator7" CURVE 0xffe5b11e _REC_CUR_32_u2_u2 2. _CNV_R_R_fak_ub_b1_586_CM 0. 2. FORMAT "%8.4"
 /begin AXIS_DESCR STD_AXIS gentemp _CNV_R_R_temp_uw_q0_547_CM 3 -48. 336. FORMAT "%8.4" /end AXIS_DESCR
/end CHARACTERISTIC
/begin CHARACTERISTIC KLRTH0FAK0 "RTHfaktor0 ueber Generatorstrom" CURVE 0xffe5b20e _REC_CUR_32_u1_u1 3.984375 _CNV_R_R_fak_ub_b4_598_CM 0. 3.984375 FORMAT "%8.4"
 /begin AXIS_DESCR STD_AXIS geni_end _CNV_R_R_dez_550_CM 11 0. 254. FORMAT "%8.4" /end AXIS_DESCR
/end CHARACTERISTIC
/begin CHARACTERISTIC KLRTH0FAK1 "RTHfaktor1 ueber Generatorstrom" CURVE 0xffe5b225 _REC_CUR_32_u1_u1 3.984375 _CNV_R_R_fak_ub_b4_598_CM 0. 3.984375 FORMAT "%8.4"
 /begin AXIS_DESCR STD_AXIS geni_end _CNV_R_R_dez_550_CM 11 0. 254. FORMAT "%8.4" /end AXIS_DESCR
/end CHARACTERISTIC
/begin CHARACTERISTIC KLRTH0FAK2 "RTHfaktor 2 ueber Generatorstrom" CURVE 0xffe5b23c _REC_CUR_32_u1_u1 3.96875 _CNV_R_R_fak_ub_b4_598_CM 0. 3.96875 FORMAT "%8.4"
 /begin AXIS_DESCR STD_AXIS geni_end _CNV_R_R_dez_550_CM 11 0. 254. FORMAT "%8.4" /end AXIS_DESCR
/end CHARACTERISTIC
/begin CHARACTERISTIC KLRTH0FAK3 "RTHfaktor3 ueber Generatorstrom" CURVE 0xffe5b253 _REC_CUR_32_u1_u1 3.984375 _CNV_R_R_fak_ub_b4_598_CM 0. 3.984375 FORMAT "%8.4"
 /begin AXIS_DESCR STD_AXIS geni_end _CNV_R_R_dez_550_CM 11 0. 254. FORMAT "%8.4" /end AXIS_DESCR
/end CHARACTERISTIC
/begin CHARACTERISTIC KLRTH0FAK4 "RTHfaktor4 ueber Generatorstrom" CURVE 0xffe5b26a _REC_CUR_32_u1_u1 3.984375 _CNV_R_R_fak_ub_b4_598_CM 0. 3.984375 FORMAT "%8.4"
 /begin AXIS_DESCR STD_AXIS geni_end _CNV_R_R_dez_550_CM 11 0. 254. FORMAT "%8.4" /end AXIS_DESCR
/end CHARACTERISTIC
/begin CHARACTERISTIC KLRTH0FAK5 "RTHfaktor5 ueber Generatorstrom" CURVE 0xffe5b281 _REC_CUR_32_u1_u1 3.984375 _CNV_R_R_fak_ub_b4_598_CM 0. 3.984375 FORMAT "%8.4"
 /begin AXIS_DESCR STD_AXIS geni_end _CNV_R_R_dez_550_CM 11 0. 254. FORMAT "%8.4" /end AXIS_DESCR
/end CHARACTERISTIC
/begin CHARACTERISTIC KLRTH0FAK6 "RTHfaktor6 ueber Generatorstrom" CURVE 0xffe5b298 _REC_CUR_32_u1_u1 3.984375 _CNV_R_R_fak_ub_b4_598_CM 0. 3.984375 FORMAT "%8.4"
 /begin AXIS_DESCR STD_AXIS geni_end _CNV_R_R_dez_550_CM 11 0. 254. FORMAT "%8.4" /end AXIS_DESCR
/end CHARACTERISTIC
/begin CHARACTERISTIC KLRTH0FAK7 "RTHfaktor7 ueber Generatorstrom" CURVE 0xffe5b2af _REC_CUR_32_u1_u1 3.984375 _CNV_R_R_fak_ub_b4_598_CM 0. 3.984375 FORMAT "%8.4"
 /begin AXIS_DESCR STD_AXIS geni_end _CNV_R_R_dez_550_CM 11 0. 254. FORMAT "%8.4" /end AXIS_DESCR
/end CHARACTERISTIC
/begin CHARACTERISTIC KLRTHFAK1 "RTHfaktor1 ueber Generatorstrom Fahrt" CURVE 0xffe5b2dd _REC_CUR_32_u1_u1 3.984375 _CNV_R_R_fak_ub_b4_598_CM 0. 3.984375 FORMAT "%8.4"
 /begin AXIS_DESCR STD_AXIS geni_end _CNV_R_R_dez_550_CM 11 0. 254. FORMAT "%8.4" /end AXIS_DESCR
/end CHARACTERISTIC
/begin CHARACTERISTIC KLRTHFAK2 "RTHfaktor2 ueber Generatorstrom Fahrt" CURVE 0xffe5b2f4 _REC_CUR_32_u1_u1 3.984375 _CNV_R_R_fak_ub_b4_598_CM 0. 3.984375 FORMAT "%8.4"
 /begin AXIS_DESCR STD_AXIS geni_end _CNV_R_R_dez_550_CM 11 0. 254. FORMAT "%8.4" /end AXIS_DESCR
/end CHARACTERISTIC
/begin CHARACTERISTIC KLRTHFAK3 "RTHfaktor3 ueber Generatorstrom Fahrt" CURVE 0xffe5b30b _REC_CUR_32_u1_u1 3.984375 _CNV_R_R_fak_ub_b4_598_CM 0. 3.984375 FORMAT "%8.4"
 /begin AXIS_DESCR STD_AXIS geni_end _CNV_R_R_dez_550_CM 11 0. 254. FORMAT "%8.4" /end AXIS_DESCR
/end CHARACTERISTIC
/begin CHARACTERISTIC KLRTHFAK4 "RTHfaktor4 ueber Generatorstrom Fahrt" CURVE 0xffe5b322 _REC_CUR_32_u1_u1 3.984375 _CNV_R_R_fak_ub_b4_598_CM 0. 3.984375 FORMAT "%8.4"
 /begin AXIS_DESCR STD_AXIS geni_end _CNV_R_R_dez_550_CM 11 0. 254. FORMAT "%8.4" /end AXIS_DESCR
/end CHARACTERISTIC
/begin CHARACTERISTIC KLRTHFAK5 "RTHfaktor5 ueber Generatorstrom Fahrt" CURVE 0xffe5b339 _REC_CUR_32_u1_u1 3.984375 _CNV_R_R_fak_ub_b4_598_CM 0. 3.984375 FORMAT "%8.4"
 /begin AXIS_DESCR STD_AXIS geni_end _CNV_R_R_dez_550_CM 11 0. 254. FORMAT "%8.4" /end AXIS_DESCR
/end CHARACTERISTIC
/begin CHARACTERISTIC KLRTHFAK6 "RTHfaktor6 ueber Generatorstrom Fahrt" CURVE 0xffe5b350 _REC_CUR_32_u1_u1 3.984375 _CNV_R_R_fak_ub_b4_598_CM 0. 3.984375 FORMAT "%8.4"
 /begin AXIS_DESCR STD_AXIS geni_end _CNV_R_R_dez_550_CM 11 0. 254. FORMAT "%8.4" /end AXIS_DESCR
/end CHARACTERISTIC
/begin CHARACTERISTIC KLRTHFAK7 "RTHfaktor7 ueber Generatorstrom Fahrt" CURVE 0xffe5b367 _REC_CUR_32_u1_u1 3.984375 _CNV_R_R_fak_ub_b4_598_CM 0. 3.984375 FORMAT "%8.4"
 /begin AXIS_DESCR STD_AXIS geni_end _CNV_R_R_dez_550_CM 11 0. 254. FORMAT "%8.4" /end AXIS_DESCR
/end CHARACTERISTIC
/begin CHARACTERISTIC KLRTHGEN0 "RTH-Kennfeld Generator0" CURVE 0xffe5b13e _REC_CUR_32_u2_u2 1. _CNV_R_R_fak_uw_b64_669_CM 0. 1. FORMAT "%8.4"
 /begin AXIS_DESCR STD_AXIS ngen_w _CNV_R_R_ngen_uw_q0_554_CM 6 0. 32767.5 FORMAT "%8.4" /end AXIS_DESCR
/end CHARACTERISTIC
/begin CHARACTERISTIC KLRTHGEN1 "RTH-Kennfeld Generator1" CURVE 0xffe5b158 _REC_CUR_32_u2_u2 1. _CNV_R_R_fak_uw_b64_669_CM 0. 1. FORMAT "%8.4"
 /begin AXIS_DESCR STD_AXIS ngen_w _CNV_R_R_ngen_uw_q0_554_CM 6 0. 32767.5 FORMAT "%8.4" /end AXIS_DESCR
/end CHARACTERISTIC
/begin CHARACTERISTIC KLRTHGEN2 "RTH-Kennfeld Generator2" CURVE 0xffe5b172 _REC_CUR_32_u2_u2 1. _CNV_R_R_fak_uw_b64_669_CM 0. 1. FORMAT "%8.4"
 /begin AXIS_DESCR STD_AXIS ngen_w _CNV_R_R_ngen_uw_q0_554_CM 6 0. 32767.5 FORMAT "%8.4" /end AXIS_DESCR
/end CHARACTERISTIC
/begin CHARACTERISTIC KLRTHGEN3 "RTH-Kennfeld Generator3" CURVE 0xffe5b18c _REC_CUR_32_u2_u2 1. _CNV_R_R_fak_uw_b64_669_CM 0. 1. FORMAT "%8.4"
 /begin AXIS_DESCR STD_AXIS ngen_w _CNV_R_R_ngen_uw_q0_554_CM 6 0. 32767.5 FORMAT "%8.4" /end AXIS_DESCR
/end CHARACTERISTIC
/begin CHARACTERISTIC KLRTHGEN4 "RTH-Kennfeld Generator4" CURVE 0xffe5b1a6 _REC_CUR_32_u2_u2 1. _CNV_R_R_fak_uw_b64_669_CM 0. 1. FORMAT "%8.4"
 /begin AXIS_DESCR STD_AXIS ngen_w _CNV_R_R_ngen_uw_q0_554_CM 6 0. 32767.5 FORMAT "%8.4" /end AXIS_DESCR
/end CHARACTERISTIC
/begin CHARACTERISTIC KLRTHGEN5 "RTH-Kennfeld Generator5" CURVE 0xffe5b1c0 _REC_CUR_32_u2_u2 1. _CNV_R_R_fak_uw_b64_669_CM 0. 1. FORMAT "%8.4"
 /begin AXIS_DESCR STD_AXIS ngen_w _CNV_R_R_ngen_uw_q0_554_CM 6 0. 32767.5 FORMAT "%8.4" /end AXIS_DESCR
/end CHARACTERISTIC
/begin CHARACTERISTIC KLRTHGEN6 "RTH-Kennfeld Generator6" CURVE 0xffe5b1da _REC_CUR_32_u2_u2 1. _CNV_R_R_fak_uw_b64_669_CM 0. 1. FORMAT "%8.4"
 /begin AXIS_DESCR STD_AXIS ngen_w _CNV_R_R_ngen_uw_q0_554_CM 6 0. 32767.5 FORMAT "%8.4" /end AXIS_DESCR
/end CHARACTERISTIC
/begin CHARACTERISTIC KLRTHGEN7 "RTH-Kennfeld Generator7" CURVE 0xffe5b1f4 _REC_CUR_32_u2_u2 1. _CNV_R_R_fak_uw_b64_669_CM 0. 1. FORMAT "%8.4"
 /begin AXIS_DESCR STD_AXIS ngen_w _CNV_R_R_ngen_uw_q0_554_CM 6 0. 32767.5 FORMAT "%8.4" /end AXIS_DESCR
/end CHARACTERISTIC
/begin CHARACTERISTIC KLTANSGEN0 "Kennlinie Generatoransaugluft0" CURVE 0xffe5b37e _REC_CUR_32_u1_u1 191.25 _CNV_R_R_temp_uw_q0_547_CM -48. 143.25 FORMAT "%8.4"
 /begin AXIS_DESCR STD_AXIS vfzg _CNV_R_R_vfzg_ub_q1_545_CM 10 0. 318.75 FORMAT "%8.4" /end AXIS_DESCR
/end CHARACTERISTIC
/begin CHARACTERISTIC KLTANSGEN1 "Kennlinie Generatoransaugluft1" CURVE 0xffe5b393 _REC_CUR_32_u1_u1 191.25 _CNV_R_R_temp_uw_q0_547_CM -48. 143.25 FORMAT "%8.4"
 /begin AXIS_DESCR STD_AXIS vfzg _CNV_R_R_vfzg_ub_q1_545_CM 10 0. 318.75 FORMAT "%8.4" /end AXIS_DESCR
/end CHARACTERISTIC
/begin CHARACTERISTIC KLTANSGEN2 "Kennlinie Generatoransaugluft2" CURVE 0xffe5b3a8 _REC_CUR_32_u1_u1 191.25 _CNV_R_R_temp_uw_q0_547_CM -48. 143.25 FORMAT "%8.4"
 /begin AXIS_DESCR STD_AXIS vfzg _CNV_R_R_vfzg_ub_q1_545_CM 10 0. 318.75 FORMAT "%8.4" /end AXIS_DESCR
/end CHARACTERISTIC
/begin CHARACTERISTIC KLTANSGEN3 "Kennlinie Generatoransaugluft3" CURVE 0xffe5b3bd _REC_CUR_32_u1_u1 191.25 _CNV_R_R_temp_uw_q0_547_CM -48. 143.25 FORMAT "%8.4"
 /begin AXIS_DESCR STD_AXIS vfzg _CNV_R_R_vfzg_ub_q1_545_CM 10 0. 318.75 FORMAT "%8.4" /end AXIS_DESCR
/end CHARACTERISTIC
/begin CHARACTERISTIC KLTANSGEN4 "Kennlinie Generatoransaugluft4" CURVE 0xffe5b3d2 _REC_CUR_32_u1_u1 191.25 _CNV_R_R_temp_uw_q0_547_CM -48. 143.25 FORMAT "%8.4"
 /begin AXIS_DESCR STD_AXIS vfzg _CNV_R_R_vfzg_ub_q1_545_CM 10 0. 318.75 FORMAT "%8.4" /end AXIS_DESCR
/end CHARACTERISTIC
/begin CHARACTERISTIC KLTANSGEN5 "Kennlinie Generatoransaugluft5" CURVE 0xffe5b3e7 _REC_CUR_32_u1_u1 191.25 _CNV_R_R_temp_uw_q0_547_CM -48. 143.25 FORMAT "%8.4"
 /begin AXIS_DESCR STD_AXIS vfzg _CNV_R_R_vfzg_ub_q1_545_CM 10 0. 318.75 FORMAT "%8.4" /end AXIS_DESCR
/end CHARACTERISTIC
/begin CHARACTERISTIC KLTANSGEN6 "Kennlinie Generatoransaugluft6" CURVE 0xffe5b3fc _REC_CUR_32_u1_u1 191.25 _CNV_R_R_temp_uw_q0_547_CM -48. 143.25 FORMAT "%8.4"
 /begin AXIS_DESCR STD_AXIS vfzg _CNV_R_R_vfzg_ub_q1_545_CM 10 0. 318.75 FORMAT "%8.4" /end AXIS_DESCR
/end CHARACTERISTIC
/begin CHARACTERISTIC KLTANSGEN7 "Kennlinie Generatoransaugluft7" CURVE 0xffe5b411 _REC_CUR_32_u1_u1 191.25 _CNV_R_R_temp_uw_q0_547_CM -48. 143.25 FORMAT "%8.4"
 /begin AXIS_DESCR STD_AXIS vfzg _CNV_R_R_vfzg_ub_q1_545_CM 10 0. 318.75 FORMAT "%8.4" /end AXIS_DESCR
/end CHARACTERISTIC
/begin CHARACTERISTIC MANAWNUMM "manuelle Kennfeldauswahlnummeroffset" VALUE 0xffe5b4f1 _REC_VAL_20_u1 255. _CNV_R_R_dez_550_CM 0. 255. FORMAT "%8.4" /end CHARACTERISTIC
/begin CHARACTERISTIC S_IGMISCH "Schalter IG-Mischung" VALUE 0xffe5b4f3 _REC_VAL_20_u1 1. _CNV_S_2_B_TRUE_582_CM 0. 1. BIT_MASK 0x1 /end CHARACTERISTIC
/begin CHARACTERISTIC TIGMISCH "Verzögerungzeit IGMISCH" VALUE 0xffe5b4f4 _REC_VAL_20_u1 2.55 _CNV_R_R_t10msxs_uw_595_CM 0. 2.55 FORMAT "%8.4" /end CHARACTERISTIC
/begin CHARACTERISTIC UDIODERMS0 "RMS-Schwellspannung Generatordiode0" VALUE 0xffe5b4f7 _REC_VAL_20_u1 1.9921875 _CNV_R_R_fak_ub_b2_546_CM 0. 1.9921875 FORMAT "%8.4" /end CHARACTERISTIC
/begin CHARACTERISTIC UDIODERMS1 "RMS-Schwellspannung Generatordiode1" VALUE 0xffe5b4f8 _REC_VAL_20_u1 1.9921875 _CNV_R_R_fak_ub_b2_546_CM 0. 1.9921875 FORMAT "%8.4" /end CHARACTERISTIC
/begin CHARACTERISTIC UDIODERMS2 "RMS-Schwellspannung Generatordiode2" VALUE 0xffe5b4f9 _REC_VAL_20_u1 1.9921875 _CNV_R_R_fak_ub_b2_546_CM 0. 1.9921875 FORMAT "%8.4" /end CHARACTERISTIC
/begin CHARACTERISTIC UDIODERMS3 "RMS-Schwellspannung Generatordiode3" VALUE 0xffe5b4fa _REC_VAL_20_u1 1.9921875 _CNV_R_R_fak_ub_b2_546_CM 0. 1.9921875 FORMAT "%8.4" /end CHARACTERISTIC
/begin CHARACTERISTIC UDIODERMS4 "RMS-Schwellspannung Generatordiode4" VALUE 0xffe5b4fb _REC_VAL_20_u1 1.9921875 _CNV_R_R_fak_ub_b2_546_CM 0. 1.9921875 FORMAT "%8.4" /end CHARACTERISTIC
/begin CHARACTERISTIC UDIODERMS5 "RMS-Schwellspannung Generatordiode5" VALUE 0xffe5b4fc _REC_VAL_20_u1 1.9921875 _CNV_R_R_fak_ub_b2_546_CM 0. 1.9921875 FORMAT "%8.4" /end CHARACTERISTIC
/begin CHARACTERISTIC UDIODERMS6 "RMS-Schwellspannung Generatordiode6" VALUE 0xffe5b4fd _REC_VAL_20_u1 1.9921875 _CNV_R_R_fak_ub_b2_546_CM 0. 1.9921875 FORMAT "%8.4" /end CHARACTERISTIC
/begin CHARACTERISTIC UDIODERMS7 "RMS-Schwellspannung Generatordiode7" VALUE 0xffe5b4fe _REC_VAL_20_u1 1.9921875 _CNV_R_R_fak_ub_b2_546_CM 0. 1.9921875 FORMAT "%8.4" /end CHARACTERISTIC
/begin CHARACTERISTIC ZMGENS0HZ0 "Zeitkonstante Generatorstator0 Aufheizung im Stand" VALUE 0xffe5b460 _REC_VAL_20_u2 0.99998474 _CNV_R_R_genzmst_uw_665_CM 0. 0.99998474 FORMAT "%8.4" /end CHARACTERISTIC
/begin CHARACTERISTIC ZMGENS0HZ1 "Zeitkonstante Generatorstator1 Aufheizung im Stand" VALUE 0xffe5b462 _REC_VAL_20_u2 0.99998474 _CNV_R_R_genzmst_uw_665_CM 0. 0.99998474 FORMAT "%8.4" /end CHARACTERISTIC
/begin CHARACTERISTIC ZMGENS0HZ2 "Zeitkonstante Generatorstator2 Aufheizung im Stand" VALUE 0xffe5b464 _REC_VAL_20_u2 0.99998474 _CNV_R_R_genzmst_uw_665_CM 0. 0.99998474 FORMAT "%8.4" /end CHARACTERISTIC
/begin CHARACTERISTIC ZMGENS0HZ3 "Zeitkonstante Generatorstator3 Aufheizung im Stand" VALUE 0xffe5b466 _REC_VAL_20_u2 0.99998474 _CNV_R_R_genzmst_uw_665_CM 0. 0.99998474 FORMAT "%8.4" /end CHARACTERISTIC
/begin CHARACTERISTIC ZMGENS0HZ4 "Zeitkonstante Generatorstator4 Aufheizung im Stand" VALUE 0xffe5b468 _REC_VAL_20_u2 0.99998474 _CNV_R_R_genzmst_uw_665_CM 0. 0.99998474 FORMAT "%8.4" /end CHARACTERISTIC
/begin CHARACTERISTIC ZMGENS0HZ5 "Zeitkonstante Generatorstator5 Aufheizung im Stand" VALUE 0xffe5b46a _REC_VAL_20_u2 0.99998474 _CNV_R_R_genzmst_uw_665_CM 0. 0.99998474 FORMAT "%8.4" /end CHARACTERISTIC
/begin CHARACTERISTIC ZMGENS0HZ6 "Zeitkonstante Generatorstator6 Aufheizung im Stand" VALUE 0xffe5b46c _REC_VAL_20_u2 0.99998474 _CNV_R_R_genzmst_uw_665_CM 0. 0.99998474 FORMAT "%8.4" /end CHARACTERISTIC
/begin CHARACTERISTIC ZMGENS0HZ7 "Zeitkonstante Generatorstator7 Aufheizung im Stand" VALUE 0xffe5b46e _REC_VAL_20_u2 0.99998474 _CNV_R_R_genzmst_uw_665_CM 0. 0.99998474 FORMAT "%8.4" /end CHARACTERISTIC
/begin CHARACTERISTIC ZMGENS0KL0 "Zeitkonstante Abkühlung Generator im Stand0" VALUE 0xffe5b470 _REC_VAL_20_u2 0.99998474 _CNV_R_R_genzmst_uw_665_CM 0. 0.99998474 FORMAT "%8.4" /end CHARACTERISTIC
/begin CHARACTERISTIC ZMGENS0KL1 "Zeitkonstante Abkühlung Generator im Stand1" VALUE 0xffe5b472 _REC_VAL_20_u2 0.99998474 _CNV_R_R_genzmst_uw_665_CM 0. 0.99998474 FORMAT "%8.4" /end CHARACTERISTIC
/begin CHARACTERISTIC ZMGENS0KL2 "Zeitkonstante Abkühlung Generator im Stand2" VALUE 0xffe5b474 _REC_VAL_20_u2 0.99998474 _CNV_R_R_genzmst_uw_665_CM 0. 0.99998474 FORMAT "%8.4" /end CHARACTERISTIC
/begin CHARACTERISTIC ZMGENS0KL3 "Zeitkonstante Abkühlung Generator im Stand3" VALUE 0xffe5b476 _REC_VAL_20_u2 0.99998474 _CNV_R_R_genzmst_uw_665_CM 0. 0.99998474 FORMAT "%8.4" /end CHARACTERISTIC
/begin CHARACTERISTIC ZMGENS0KL4 "Zeitkonstante Abkühlung Generator im Stand4" VALUE 0xffe5b478 _REC_VAL_20_u2 0.99998474 _CNV_R_R_genzmst_uw_665_CM 0. 0.99998474 FORMAT "%8.4" /end CHARACTERISTIC
/begin CHARACTERISTIC ZMGENS0KL5 "Zeitkonstante Abkühlung Generator im Stand5" VALUE 0xffe5b47a _REC_VAL_20_u2 0.99998474 _CNV_R_R_genzmst_uw_665_CM 0. 0.99998474 FORMAT "%8.4" /end CHARACTERISTIC
/begin CHARACTERISTIC ZMGENS0KL6 "Zeitkonstante Abkühlung Generator im Stand6" VALUE 0xffe5b47c _REC_VAL_20_u2 0.99998474 _CNV_R_R_genzmst_uw_665_CM 0. 0.99998474 FORMAT "%8.4" /end CHARACTERISTIC
/begin CHARACTERISTIC ZMGENS0KL7 "Zeitkonstante Abkühlung Generator im Stand7" VALUE 0xffe5b47e _REC_VAL_20_u2 0.99998474 _CNV_R_R_genzmst_uw_665_CM 0. 0.99998474 FORMAT "%8.4" /end CHARACTERISTIC
/begin CHARACTERISTIC ZMGENSTHZ1 "Zeitkonstante Generatorstator1 Aufheizung" VALUE 0xffe5b482 _REC_VAL_20_u2 0.99998474 _CNV_R_R_genzmst_uw_665_CM 0. 0.99998474 FORMAT "%8.4" /end CHARACTERISTIC
/begin CHARACTERISTIC ZMGENSTHZ2 "Zeitkonstante Generatorstator2 Aufheizung" VALUE 0xffe5b484 _REC_VAL_20_u2 0.99998474 _CNV_R_R_genzmst_uw_665_CM 0. 0.99998474 FORMAT "%8.4" /end CHARACTERISTIC
/begin CHARACTERISTIC ZMGENSTHZ3 "Zeitkonstante Generatorstator3 Aufheizung" VALUE 0xffe5b486 _REC_VAL_20_u2 0.99998474 _CNV_R_R_genzmst_uw_665_CM 0. 0.99998474 FORMAT "%8.4" /end CHARACTERISTIC
/begin CHARACTERISTIC ZMGENSTHZ4 "Zeitkonstante Generatorstator4 Aufheizung" VALUE 0xffe5b488 _REC_VAL_20_u2 0.99998474 _CNV_R_R_genzmst_uw_665_CM 0. 0.99998474 FORMAT "%8.4" /end CHARACTERISTIC
/begin CHARACTERISTIC ZMGENSTHZ5 "Zeitkonstante Generatorstator5 Aufheizung" VALUE 0xffe5b48a _REC_VAL_20_u2 0.99998474 _CNV_R_R_genzmst_uw_665_CM 0. 0.99998474 FORMAT "%8.4" /end CHARACTERISTIC
/begin CHARACTERISTIC ZMGENSTHZ6 "Zeitkonstante Generatorstator6 Aufheizung" VALUE 0xffe5b48c _REC_VAL_20_u2 0.99998474 _CNV_R_R_genzmst_uw_665_CM 0. 0.99998474 FORMAT "%8.4" /end CHARACTERISTIC
/begin CHARACTERISTIC ZMGENSTHZ7 "Zeitkonstante Generatorstator7 Aufheizung" VALUE 0xffe5b48e _REC_VAL_20_u2 0.99998474 _CNV_R_R_genzmst_uw_665_CM 0. 0.99998474 FORMAT "%8.4" /end CHARACTERISTIC
/begin CHARACTERISTIC ZMGENSTKL1 "Zeitkonstante Abkühlung Generator1" VALUE 0xffe5b492 _REC_VAL_20_u2 0.99998474 _CNV_R_R_genzmst_uw_665_CM 0. 0.99998474 FORMAT "%8.4" /end CHARACTERISTIC
/begin CHARACTERISTIC ZMGENSTKL2 "Zeitkonstante Abkühlung Generator2" VALUE 0xffe5b494 _REC_VAL_20_u2 0.99998474 _CNV_R_R_genzmst_uw_665_CM 0. 0.99998474 FORMAT "%8.4" /end CHARACTERISTIC
/begin CHARACTERISTIC ZMGENSTKL3 "Zeitkonstante Abkühlung Generator3" VALUE 0xffe5b496 _REC_VAL_20_u2 0.99998474 _CNV_R_R_genzmst_uw_665_CM 0. 0.99998474 FORMAT "%8.4" /end CHARACTERISTIC
/begin CHARACTERISTIC ZMGENSTKL4 "Zeitkonstante Abkühlung Generator4" VALUE 0xffe5b498 _REC_VAL_20_u2 0.99998474 _CNV_R_R_genzmst_uw_665_CM 0. 0.99998474 FORMAT "%8.4" /end CHARACTERISTIC
/begin CHARACTERISTIC ZMGENSTKL5 "Zeitkonstante Abkühlung Generator5" VALUE 0xffe5b49a _REC_VAL_20_u2 0.99998474 _CNV_R_R_genzmst_uw_665_CM 0. 0.99998474 FORMAT "%8.4" /end CHARACTERISTIC
/begin CHARACTERISTIC ZMGENSTKL6 "Zeitkonstante Abkühlung Generator6" VALUE 0xffe5b49c _REC_VAL_20_u2 0.99998474 _CNV_R_R_genzmst_uw_665_CM 0. 0.99998474 FORMAT "%8.4" /end CHARACTERISTIC
/begin CHARACTERISTIC ZMGENSTKL7 "Zeitkonstante Abkühlung Generator7" VALUE 0xffe5b49e _REC_VAL_20_u2 0.99998474 _CNV_R_R_genzmst_uw_665_CM 0. 0.99998474 FORMAT "%8.4" /end CHARACTERISTIC
/begin CHARACTERISTIC ZMGN0TANS0 "Zeitkonstante Generatoransaugluft0 bei vfzg = 0" VALUE 0xffe5b4a2 _REC_VAL_20_u2 0.99998474 _CNV_R_R_genzmst_uw_665_CM 0. 0.99998474 FORMAT "%8.4" /end CHARACTERISTIC
/begin CHARACTERISTIC ZMGN0TANS1 "Zeitkonstante Generatoransaugluft1 bei vfzg = 0" VALUE 0xffe5b4a4 _REC_VAL_20_u2 0.99998474 _CNV_R_R_genzmst_uw_665_CM 0. 0.99998474 FORMAT "%8.4" /end CHARACTERISTIC
/begin CHARACTERISTIC ZMGN0TANS2 "Zeitkonstante Generatoransaugluft2 bei vfzg = 0" VALUE 0xffe5b4a6 _REC_VAL_20_u2 0.99998474 _CNV_R_R_genzmst_uw_665_CM 0. 0.99998474 FORMAT "%8.4" /end CHARACTERISTIC
/begin CHARACTERISTIC ZMGN0TANS3 "Zeitkonstante Generatoransaugluft3 bei vfzg = 0" VALUE 0xffe5b4a8 _REC_VAL_20_u2 0.99998474 _CNV_R_R_genzmst_uw_665_CM 0. 0.99998474 FORMAT "%8.4" /end CHARACTERISTIC
/begin CHARACTERISTIC ZMGN0TANS4 "Zeitkonstante Generatoransaugluft4 bei vfzg = 0" VALUE 0xffe5b4aa _REC_VAL_20_u2 0.99998474 _CNV_R_R_genzmst_uw_665_CM 0. 0.99998474 FORMAT "%8.4" /end CHARACTERISTIC
/begin CHARACTERISTIC ZMGN0TANS5 "Zeitkonstante Generatoransaugluft5 bei vfzg = 0" VALUE 0xffe5b4ac _REC_VAL_20_u2 0.99998474 _CNV_R_R_genzmst_uw_665_CM 0. 0.99998474 FORMAT "%8.4" /end CHARACTERISTIC
/begin CHARACTERISTIC ZMGN0TANS6 "Zeitkonstante Generatoransaugluft6 bei vfzg = 0" VALUE 0xffe5b4ae _REC_VAL_20_u2 0.99998474 _CNV_R_R_genzmst_uw_665_CM 0. 0.99998474 FORMAT "%8.4" /end CHARACTERISTIC
/begin CHARACTERISTIC ZMGN0TANS7 "Zeitkonstante Generatoransaugluft7 bei vfzg = 0" VALUE 0xffe5b4b0 _REC_VAL_20_u2 0.99998474 _CNV_R_R_genzmst_uw_665_CM 0. 0.99998474 FORMAT "%8.4" /end CHARACTERISTIC
/begin CHARACTERISTIC ZMGNTANS0 "Zeitkonstante Generatoransaugluft0" VALUE 0xffe5b4b2 _REC_VAL_20_u2 0.99998474 _CNV_R_R_genzmst_uw_665_CM 0. 0.99998474 FORMAT "%8.4" /end CHARACTERISTIC
/begin CHARACTERISTIC ZMGNTANS1 "Zeitkonstante Generatoransaugluft1" VALUE 0xffe5b4b4 _REC_VAL_20_u2 0.99998474 _CNV_R_R_genzmst_uw_665_CM 0. 0.99998474 FORMAT "%8.4" /end CHARACTERISTIC
/begin CHARACTERISTIC ZMGNTANS2 "Zeitkonstante Generatoransaugluft2" VALUE 0xffe5b4b6 _REC_VAL_20_u2 0.99998474 _CNV_R_R_genzmst_uw_665_CM 0. 0.99998474 FORMAT "%8.4" /end CHARACTERISTIC
/begin CHARACTERISTIC ZMGNTANS3 "Zeitkonstante Generatoransaugluft3" VALUE 0xffe5b4b8 _REC_VAL_20_u2 0.99998474 _CNV_R_R_genzmst_uw_665_CM 0. 0.99998474 FORMAT "%8.4" /end CHARACTERISTIC
/begin CHARACTERISTIC ZMGNTANS4 "Zeitkonstante Generatoransaugluft4" VALUE 0xffe5b4ba _REC_VAL_20_u2 0.99998474 _CNV_R_R_genzmst_uw_665_CM 0. 0.99998474 FORMAT "%8.4" /end CHARACTERISTIC
/begin CHARACTERISTIC ZMGNTANS5 "Zeitkonstante Generatoransaugluft5" VALUE 0xffe5b4bc _REC_VAL_20_u2 0.99998474 _CNV_R_R_genzmst_uw_665_CM 0. 0.99998474 FORMAT "%8.4" /end CHARACTERISTIC
/begin CHARACTERISTIC ZMGNTANS6 "Zeitkonstante Generatoransaugluft6" VALUE 0xffe5b4be _REC_VAL_20_u2 0.99998474 _CNV_R_R_genzmst_uw_665_CM 0. 0.99998474 FORMAT "%8.4" /end CHARACTERISTIC
/begin CHARACTERISTIC ZMGNTANS7 "Zeitkonstante Generatoransaugluft7" VALUE 0xffe5b4c0 _REC_VAL_20_u2 0.99998474 _CNV_R_R_genzmst_uw_665_CM 0. 0.99998474 FORMAT "%8.4" /end CHARACTERISTIC
/begin CHARACTERISTIC ZMIGMISCH "Zeitkonstante IG Mischung" VALUE 0xffe5b4c2 _REC_VAL_20_u2 0.99998474 _CNV_R_R_genzmst_uw_665_CM 0. 0.99998474 FORMAT "%8.4" /end CHARACTERISTIC
/begin MEASUREMENT ugen "Generatorsollspannung" UBYTE _CNV_R_R_spg_ugen_555_CM 1 100. 10.6 36.1 DISPLAY_IDENTIFIER UGEN ECU_ADDRESS 0x3fe41f FORMAT "%8.4" /end MEASUREMENT
/begin MEASUREMENT B_genfkupl "Generatortyp unplausibel" UBYTE _CNV_S_2_B_TRUE_582_CM 1 100. 0. 1. DISPLAY_IDENTIFIER B_GENFKUPL ECU_ADDRESS 0x3fe3f4 BIT_MASK 0x1 /end MEASUREMENT
/begin MEASUREMENT B_gfbsupak "Bedingung Generatortyp unplausibel" UBYTE _CNV_S_2_B_TRUE_582_CM 1 100. 0. 1. DISPLAY_IDENTIFIER B_GFBSUPAK ECU_ADDRESS 0x3fe3e9 BIT_MASK 0x1 /end MEASUREMENT
/begin MEASUREMENT B_gfelak "Generatorfehler elektrisch vorhanden" UBYTE _CNV_S_2_B_TRUE_582_CM 1 100. 0. 1. DISPLAY_IDENTIFIER B_GFELAK ECU_ADDRESS 0x3fe3ea BIT_MASK 0x1 /end MEASUREMENT
/begin MEASUREMENT B_gfmeak "Generatorfehler elektrisch vorhanden" UBYTE _CNV_S_2_B_TRUE_582_CM 1 100. 0. 1. DISPLAY_IDENTIFIER B_GFMEAK ECU_ADDRESS 0x3fe3eb BIT_MASK 0x1 /end MEASUREMENT
/begin MEASUREMENT B_gfnobsak "Kommunikationsfehler Generator" UBYTE _CNV_S_2_B_TRUE_582_CM 1 100. 0. 1. DISPLAY_IDENTIFIER B_GFNOBSAK ECU_ADDRESS 0x3fe3ed BIT_MASK 0x1 /end MEASUREMENT
/begin MEASUREMENT igenmess "gemessener Generatorstrom" UWORD _CNV_R_R_dez_550_CM 1 100. 0. 1024. DISPLAY_IDENTIFIER IGENMESS ECU_ADDRESS 0x3fd202 BYTE_ORDER MSB_LAST FORMAT "%8.4" /end MEASUREMENT
/begin MEASUREMENT genmanufak "Generatorhersteller" UBYTE _CNV_R_R_dez_550_CM 1 100. 0. 255. DISPLAY_IDENTIFIER GENMANUFAK ECU_ADDRESS 0x3fe407 FORMAT "%8.4" /end MEASUREMENT
/begin MEASUREMENT gentypkenn "Generatortyp" UBYTE _CNV_R_R_dez_550_CM 1 100. 0. 255. DISPLAY_IDENTIFIER GENTYPKENN ECU_ADDRESS 0x3fe408 FORMAT "%8.4" /end MEASUREMENT
/begin CHARACTERISTIC S_RDGENTYP "Abfrage Generatortyp und Hersteller" VALUE 0xffe4052f _REC_VAL_20_u1 255. _CNV_R_R_dez_550_CM 0. 255. FORMAT "%8.4" /end CHARACTERISTIC
/begin CHARACTERISTIC GENUEBSETZ0 "Generatoruebersetzung0" VALUE 0xffe5b4e4 _REC_VAL_20_u1 3.984375 _CNV_R_R_fak_ub_b4_598_CM 0. 3.984375 FORMAT "%8.4" /end CHARACTERISTIC
/begin CHARACTERISTIC GENUEBSETZ1 "Generatoruebersetzung1" VALUE 0xffe5b4e5 _REC_VAL_20_u1 3.984375 _CNV_R_R_fak_ub_b4_598_CM 0. 3.984375 FORMAT "%8.4" /end CHARACTERISTIC
/begin CHARACTERISTIC GENUEBSETZ2 "Generatoruebersetzung2" VALUE 0xffe5b4e6 _REC_VAL_20_u1 3.984375 _CNV_R_R_fak_ub_b4_598_CM 0. 3.984375 FORMAT "%8.4" /end CHARACTERISTIC
/begin CHARACTERISTIC GENUEBSETZ3 "Generatoruebersetzung3" VALUE 0xffe5b4e7 _REC_VAL_20_u1 3.984375 _CNV_R_R_fak_ub_b4_598_CM 0. 3.984375 FORMAT "%8.4" /end CHARACTERISTIC
/begin CHARACTERISTIC GENUEBSETZ4 "Generatoruebersetzung4" VALUE 0xffe5b4e8 _REC_VAL_20_u1 3.984375 _CNV_R_R_fak_ub_b4_598_CM 0. 3.984375 FORMAT "%8.4" /end CHARACTERISTIC
/begin CHARACTERISTIC GENUEBSETZ5 "Generatoruebersetzung5" VALUE 0xffe5b4e9 _REC_VAL_20_u1 3.984375 _CNV_R_R_fak_ub_b4_598_CM 0. 3.984375 FORMAT "%8.4" /end CHARACTERISTIC
/begin CHARACTERISTIC GENUEBSETZ6 "Generatoruebersetzung6" VALUE 0xffe5b4ea _REC_VAL_20_u1 3.984375 _CNV_R_R_fak_ub_b4_598_CM 0. 3.984375 FORMAT "%8.4" /end CHARACTERISTIC
/begin CHARACTERISTIC GENUEBSETZ7 "Generatoruebersetzung7" VALUE 0xffe5b4eb _REC_VAL_20_u1 3.984375 _CNV_R_R_fak_ub_b4_598_CM 0. 3.984375 FORMAT "%8.4" /end CHARACTERISTIC
/begin CHARACTERISTIC KFIGENKA0 "Kaltkennfeld 0 Generator" MAP 0xffe5a734 _REC_MAP_32_u1_u1_u2 255. _CNV_R_R_dez_550_CM 0. 255. FORMAT "%8.4"
 /begin AXIS_DESCR STD_AXIS ugen _CNV_R_R_spg_ugen_555_CM 7 10.6 36.1 FORMAT "%8.4" /end AXIS_DESCR
 /begin AXIS_DESCR STD_AXIS ngen_w _CNV_R_R_ngen_uw_q0_554_CM 9 0. 32767.5 FORMAT "%8.4" /end AXIS_DESCR
/end CHARACTERISTIC
/begin CHARACTERISTIC KFIGENKA1 "Kaltkennfeld 1 Generator" MAP 0xffe5a790 _REC_MAP_32_u1_u1_u2 255. _CNV_R_R_dez_550_CM 0. 255. FORMAT "%8.4"
 /begin AXIS_DESCR STD_AXIS ugen _CNV_R_R_spg_ugen_555_CM 7 10.6 36.1 FORMAT "%8.4" /end AXIS_DESCR
 /begin AXIS_DESCR STD_AXIS ngen_w _CNV_R_R_ngen_uw_q0_554_CM 9 0. 32767.5 FORMAT "%8.4" /end AXIS_DESCR
/end CHARACTERISTIC
/begin CHARACTERISTIC KFIGENKA2 "Kaltkennfeld 2 Generator" MAP 0xffe5a7ec _REC_MAP_32_u1_u1_u2 255. _CNV_R_R_dez_550_CM 0. 255. FORMAT "%8.4"
 /begin AXIS_DESCR STD_AXIS ugen _CNV_R_R_spg_ugen_555_CM 7 10.6 36.1 FORMAT "%8.4" /end AXIS_DESCR
 /begin AXIS_DESCR STD_AXIS ngen_w _CNV_R_R_ngen_uw_q0_554_CM 9 0. 32767.5 FORMAT "%8.4" /end AXIS_DESCR
/end CHARACTERISTIC
/begin CHARACTERISTIC KFIGENKA3 "Kaltkennfeld 3 Generator" MAP 0xffe5a848 _REC_MAP_32_u1_u1_u2 255. _CNV_R_R_dez_550_CM 0. 255. FORMAT "%8.4"
 /begin AXIS_DESCR STD_AXIS ugen _CNV_R_R_spg_ugen_555_CM 7 10.6 36.1 FORMAT "%8.4" /end AXIS_DESCR
 /begin AXIS_DESCR STD_AXIS ngen_w _CNV_R_R_ngen_uw_q0_554_CM 9 0. 32767.5 FORMAT "%8.4" /end AXIS_DESCR
/end CHARACTERISTIC
/begin CHARACTERISTIC KFIGENKA4 "Kaltkennfeld 4 Generator" MAP 0xffe5a8a4 _REC_MAP_32_u1_u1_u2 255. _CNV_R_R_dez_550_CM 0. 255. FORMAT "%8.4"
 /begin AXIS_DESCR STD_AXIS ugen _CNV_R_R_spg_ugen_555_CM 7 10.6 36.1 FORMAT "%8.4" /end AXIS_DESCR
 /begin AXIS_DESCR STD_AXIS ngen_w _CNV_R_R_ngen_uw_q0_554_CM 9 0. 32767.5 FORMAT "%8.4" /end AXIS_DESCR
/end CHARACTERISTIC
/begin CHARACTERISTIC KFIGENKA5 "Kaltkennfeld 5 Generator" MAP 0xffe5a900 _REC_MAP_32_u1_u1_u2 255. _CNV_R_R_dez_550_CM 0. 255. FORMAT "%8.4"
 /begin AXIS_DESCR STD_AXIS ugen _CNV_R_R_spg_ugen_555_CM 7 10.6 36.1 FORMAT "%8.4" /end AXIS_DESCR
 /begin AXIS_DESCR STD_AXIS ngen_w _CNV_R_R_ngen_uw_q0_554_CM 9 0. 32767.5 FORMAT "%8.4" /end AXIS_DESCR
/end CHARACTERISTIC
/begin CHARACTERISTIC KFIGENKA6 "Kaltkennfeld 6 Generator" MAP 0xffe5a95c _REC_MAP_32_u1_u1_u2 255. _CNV_R_R_dez_550_CM 0. 255. FORMAT "%8.4"
 /begin AXIS_DESCR STD_AXIS ugen _CNV_R_R_spg_ugen_555_CM 7 10.6 36.1 FORMAT "%8.4" /end AXIS_DESCR
 /begin AXIS_DESCR STD_AXIS ngen_w _CNV_R_R_ngen_uw_q0_554_CM 9 0. 32767.5 FORMAT "%8.4" /end AXIS_DESCR
/end CHARACTERISTIC
/begin CHARACTERISTIC KFIGENKA7 "Kaltkennfeld 7 Generator" MAP 0xffe5a9b8 _REC_MAP_32_u1_u1_u2 255. _CNV_R_R_dez_550_CM 0. 255. FORMAT "%8.4"
 /begin AXIS_DESCR STD_AXIS ugen _CNV_R_R_spg_ugen_555_CM 7 10.6 36.1 FORMAT "%8.4" /end AXIS_DESCR
 /begin AXIS_DESCR STD_AXIS ngen_w _CNV_R_R_ngen_uw_q0_554_CM 9 0. 32767.5 FORMAT "%8.4" /end AXIS_DESCR
/end CHARACTERISTIC
/begin CHARACTERISTIC KFIGENWA0 "Warmkennfeld 0 Generator" MAP 0xffe5aa14 _REC_MAP_32_u1_u1_u2 255. _CNV_R_R_dez_550_CM 0. 255. FORMAT "%8.4"
 /begin AXIS_DESCR STD_AXIS genikaltun _CNV_R_R_dez_550_CM 6 0. 255. FORMAT "%8.4" /end AXIS_DESCR
 /begin AXIS_DESCR STD_AXIS gentempend _CNV_R_R_temp_uw_q0_547_CM 7 -48. 336. FORMAT "%8.4" /end AXIS_DESCR
/end CHARACTERISTIC
/begin CHARACTERISTIC KFIGENWA1 "Warmkennfeld 1 Generator" MAP 0xffe5aa54 _REC_MAP_32_u1_u1_u2 255. _CNV_R_R_dez_550_CM 0. 255. FORMAT "%8.4"
 /begin AXIS_DESCR STD_AXIS genikaltun _CNV_R_R_dez_550_CM 6 0. 255. FORMAT "%8.4" /end AXIS_DESCR
 /begin AXIS_DESCR STD_AXIS gentempend _CNV_R_R_temp_uw_q0_547_CM 7 -48. 336. FORMAT "%8.4" /end AXIS_DESCR
/end CHARACTERISTIC
/begin CHARACTERISTIC KFIGENWA2 "Warmkennfeld 2 Generator" MAP 0xffe5aa94 _REC_MAP_32_u1_u1_u2 255. _CNV_R_R_dez_550_CM 0. 255. FORMAT "%8.4"
 /begin AXIS_DESCR STD_AXIS genikaltun _CNV_R_R_dez_550_CM 6 0. 255. FORMAT "%8.4" /end AXIS_DESCR
 /begin AXIS_DESCR STD_AXIS gentempend _CNV_R_R_temp_uw_q0_547_CM 7 -48. 336. FORMAT "%8.4" /end AXIS_DESCR
/end CHARACTERISTIC
/begin CHARACTERISTIC KFIGENWA3 "Warmkennfeld  3 Generator" MAP 0xffe5aad4 _REC_MAP_32_u1_u1_u2 255. _CNV_R_R_dez_550_CM 0. 255. FORMAT "%8.4"
 /begin AXIS_DESCR STD_AXIS genikaltun _CNV_R_R_dez_550_CM 6 0. 255. FORMAT "%8.4" /end AXIS_DESCR
 /begin AXIS_DESCR STD_AXIS gentempend _CNV_R_R_temp_uw_q0_547_CM 7 -48. 336. FORMAT "%8.4" /end AXIS_DESCR
/end CHARACTERISTIC
/begin CHARACTERISTIC KFIGENWA4 "Warmkennfeld 4 Generator" MAP 0xffe5ab14 _REC_MAP_32_u1_u1_u2 255. _CNV_R_R_dez_550_CM 0. 255. FORMAT "%8.4"
 /begin AXIS_DESCR STD_AXIS genikaltun _CNV_R_R_dez_550_CM 6 0. 255. FORMAT "%8.4" /end AXIS_DESCR
 /begin AXIS_DESCR STD_AXIS gentempend _CNV_R_R_temp_uw_q0_547_CM 7 -48. 336. FORMAT "%8.4" /end AXIS_DESCR
/end CHARACTERISTIC
/begin CHARACTERISTIC KFIGENWA5 "Warmkennfeld 5 Generator" MAP 0xffe5ab54 _REC_MAP_32_u1_u1_u2 255. _CNV_R_R_dez_550_CM 0. 255. FORMAT "%8.4"
 /begin AXIS_DESCR STD_AXIS genikaltun _CNV_R_R_dez_550_CM 6 0. 255. FORMAT "%8.4" /end AXIS_DESCR
 /begin AXIS_DESCR STD_AXIS gentempend _CNV_R_R_temp_uw_q0_547_CM 7 -48. 336. FORMAT "%8.4" /end AXIS_DESCR
/end CHARACTERISTIC
/begin CHARACTERISTIC KFIGENWA6 "Warmkennfeld 6 Generator" MAP 0xffe5ab94 _REC_MAP_32_u1_u1_u2 255. _CNV_R_R_dez_550_CM 0. 255. FORMAT "%8.4"
 /begin AXIS_DESCR STD_AXIS genikaltun _CNV_R_R_dez_550_CM 6 0. 255. FORMAT "%8.4" /end AXIS_DESCR
 /begin AXIS_DESCR STD_AXIS gentempend _CNV_R_R_temp_uw_q0_547_CM 7 -48. 336. FORMAT "%8.4" /end AXIS_DESCR
/end CHARACTERISTIC
/begin CHARACTERISTIC KFIGENWA7 "Warmkennfeld 7 Generator " MAP 0xffe5abd4 _REC_MAP_32_u1_u1_u2 255. _CNV_R_R_dez_550_CM 0. 255. FORMAT "%8.4"
 /begin AXIS_DESCR STD_AXIS genikaltun _CNV_R_R_dez_550_CM 6 0. 255. FORMAT "%8.4" /end AXIS_DESCR
 /begin AXIS_DESCR STD_AXIS gentempend _CNV_R_R_temp_uw_q0_547_CM 7 -48. 336. FORMAT "%8.4" /end AXIS_DESCR
/end CHARACTERISTIC
/begin MEASUREMENT st_craweng "Strombedarf Motor" UBYTE _CNV_R_R_dez_550_CM 1 100. 0. 254. DISPLAY_IDENTIFIER ST_CRAWENG ECU_ADDRESS 0x3fa9ca FORMAT "%8.4" /end MEASUREMENT
/begin MEASUREMENT B_firstemp "Bedingung Generatorstarttemperatur-Berechnung" UBYTE _CNV_S_2_B_TRUE_582_CM 1 100. 0. 1. DISPLAY_IDENTIFIER B_FIRSTEMP ECU_ADDRESS 0x3fa380 BIT_MASK 0x1 /end MEASUREMENT
/begin MEASUREMENT B_gene "Generatormoment enable/disable" UBYTE _CNV_S_2_B_TRUE_582_CM 1 100. 0. 1. DISPLAY_IDENTIFIER B_GENE ECU_ADDRESS 0x3fa381 BIT_MASK 0x1 /end MEASUREMENT
/begin MEASUREMENT B_heizen "Bedingung Generator in Heizphase" UBYTE _CNV_S_2_B_TRUE_582_CM 1 100. 0. 1. DISPLAY_IDENTIFIER B_HEIZEN ECU_ADDRESS 0x3fa383 BIT_MASK 0x1 /end MEASUREMENT
/begin MEASUREMENT gen_teta "Wirkungsgrad Generator W*PI temperaturkompensiert" UWORD _CNV_R_R_geneta_q0p_668_CM 1 100. 0. 32. DISPLAY_IDENTIFIER GEN_TETA ECU_ADDRESS 0x3faa14 BYTE_ORDER MSB_LAST FORMAT "%8.4" /end MEASUREMENT
/begin MEASUREMENT gen_weta "Wirkungsgrad Generator mit Omega*PI" UBYTE _CNV_R_R_geneta_q0p_668_CM 1 100. 0. 7.96875 DISPLAY_IDENTIFIER GEN_WETA ECU_ADDRESS 0x3faa41 FORMAT "%8.4" /end MEASUREMENT
/begin MEASUREMENT genalfak2 "Winderstands-Alpha-Faktor" UWORD _CNV_R_R_genalfak_u_670_CM 1 100. 0. 2.999939 DISPLAY_IDENTIFIER GENALFAK2 ECU_ADDRESS 0x3fa9f0 BYTE_ORDER MSB_LAST FORMAT "%8.4" /end MEASUREMENT
/begin MEASUREMENT gendts "Temperaturerhoehung im Generatorstator" UWORD _CNV_R_R_gendt_q0p0_663_CM 1 100. 0. 768. DISPLAY_IDENTIFIER GENDTS ECU_ADDRESS 0x3fa9f2 BYTE_ORDER MSB_LAST FORMAT "%8.4" /end MEASUREMENT
/begin MEASUREMENT gendts_s1 "Temperaturerhöhung einer Statorspule und Diodenpaar" UWORD _CNV_R_R_gendt_q0p0_663_CM 1 100. 0. 192. DISPLAY_IDENTIFIER GENDTS_S1 ECU_ADDRESS 0x3fa9f6 BYTE_ORDER MSB_LAST FORMAT "%8.4" /end MEASUREMENT
/begin MEASUREMENT gendtsvor "Temp-Variable" UWORD _CNV_R_R_gendt_q0p0_663_CM 1 100. 0. 768. DISPLAY_IDENTIFIER GENDTSVOR ECU_ADDRESS 0x3fa9f4 BYTE_ORDER MSB_LAST FORMAT "%8.4" /end MEASUREMENT
/begin MEASUREMENT genfeta "Generatorwirkungsgrad Berechnnugsterm" ULONG _CNV_R_R_geneta_q0p_668_CM 1 100. 3.125e-002 8191.875 DISPLAY_IDENTIFIER GENFETA ECU_ADDRESS 0x3faa2c BYTE_ORDER MSB_LAST FORMAT "%8.4" /end MEASUREMENT
/begin MEASUREMENT geni_difk "mittlerer Diodenstrom" UWORD _CNV_R_R_igen_uw_q0_553_CM 1 100. 0. 255. DISPLAY_IDENTIFIER GENI_DIFK ECU_ADDRESS 0x3fa9fe BYTE_ORDER MSB_LAST FORMAT "%8.4" /end MEASUREMENT
/begin MEASUREMENT geni_end "Generatorstrom gemessen / gerechnet" UBYTE _CNV_R_R_dez_550_CM 1 100. 0. 254. DISPLAY_IDENTIFIER GENI_END ECU_ADDRESS 0x3faa3f FORMAT "%8.4" /end MEASUREMENT
/begin MEASUREMENT geni_stfk "mittlerer Statorstrom" UWORD _CNV_R_R_igen_uw_q0_553_CM 1 100. 0. 255. DISPLAY_IDENTIFIER GENI_STFK ECU_ADDRESS 0x3faa00 BYTE_ORDER MSB_LAST FORMAT "%8.4" /end MEASUREMENT
/begin MEASUREMENT geni2_st "mittlerer quadratischer Statorstrom" UWORD _CNV_R_R_dez_550_CM 1 100. 0. 65535. DISPLAY_IDENTIFIER GENI2_ST ECU_ADDRESS 0x3fa9f8 BYTE_ORDER MSB_LAST FORMAT "%8.4" /end MEASUREMENT
/begin MEASUREMENT genig "Generatorstrom gesamt" UBYTE _CNV_R_R_dez_550_CM 1 100. 0. 255. DISPLAY_IDENTIFIER GENIG ECU_ADDRESS 0x3faa3c FORMAT "%8.4" /end MEASUREMENT
/begin MEASUREMENT genikaltun "DF korrektiert ueber Generatordrehzahl" UBYTE _CNV_R_R_dez_550_CM 1 100. 0. 255. DISPLAY_IDENTIFIER GENIKALTUN ECU_ADDRESS 0x3faa3d FORMAT "%8.4" /end MEASUREMENT
/begin MEASUREMENT geninafil "Generatorstrom nach Filter" UWORD _CNV_R_R_igen_uw_q0_553_CM 1 100. 0. 256. DISPLAY_IDENTIFIER GENINAFIL ECU_ADDRESS 0x3fa9fa BYTE_ORDER MSB_LAST FORMAT "%8.4" /end MEASUREMENT
/begin MEASUREMENT genivorfil "Generatorstrom vor Filter" UWORD _CNV_R_R_igen_uw_q0_553_CM 1 100. 0. 256. DISPLAY_IDENTIFIER GENIVORFIL ECU_ADDRESS 0x3fa9fc BYTE_ORDER MSB_LAST FORMAT "%8.4" /end MEASUREMENT
/begin MEASUREMENT genrs "Statorwiderstand" UWORD _CNV_R_R_genrstator_667_CM 1 100. 0. 0.99998474 DISPLAY_IDENTIFIER GENRS ECU_ADDRESS 0x3faa02 BYTE_ORDER MSB_LAST FORMAT "%8.4" /end MEASUREMENT
/begin MEASUREMENT genspv "Generatorstatorverlustleistung" UWORD _CNV_R_R_genpv_uw_q_671_CM 1 100. 0. 2047.9688 DISPLAY_IDENTIFIER GENSPV ECU_ADDRESS 0x3faa04 BYTE_ORDER MSB_LAST FORMAT "%8.4" /end MEASUREMENT
/begin MEASUREMENT genspv_1 "Verlustleistung einer Statorspule" ULONG _CNV_R_R_genpv_ul_672_CM 1 100. 0. 262144. DISPLAY_IDENTIFIER GENSPV_1 ECU_ADDRESS 0x3faa30 BYTE_ORDER MSB_LAST FORMAT "%8.4" /end MEASUREMENT
/begin MEASUREMENT genspv_2 "Verlustleistung eines Diodenpaars" ULONG _CNV_R_R_genpv_ul_672_CM 1 100. 0. 262144. DISPLAY_IDENTIFIER GENSPV_2 ECU_ADDRESS 0x3faa34 BYTE_ORDER MSB_LAST FORMAT "%8.4" /end MEASUREMENT
/begin MEASUREMENT gensttemp "Generatorstarttemperatur" UWORD _CNV_R_R_temp_uw_q0_547_CM 1 100. -48. 336. DISPLAY_IDENTIFIER GENSTTEMP ECU_ADDRESS 0x3faa06 BYTE_ORDER MSB_LAST FORMAT "%8.4" /end MEASUREMENT
/begin MEASUREMENT gentemp "Generatortemperatur" UWORD _CNV_R_R_temp_uw_q0_547_CM 1 100. -48. 336. DISPLAY_IDENTIFIER GENTEMP ECU_ADDRESS 0x3faa0c BYTE_ORDER MSB_LAST FORMAT "%8.4" /end MEASUREMENT
/begin MEASUREMENT gentempab "Abstelltemperatur Generator" UWORD _CNV_R_R_temp_uw_q0_547_CM 1 100. -48. 336. DISPLAY_IDENTIFIER GENTEMPAB ECU_ADDRESS 0x3faca6 BYTE_ORDER MSB_LAST FORMAT "%8.4" /end MEASUREMENT
/begin MEASUREMENT gentempdt "Temperaturdifferenz zwischen Abstelltemperatur und Umgebungstemperatur" SWORD _CNV_R_R_temp_sw_q0_673_CM 1 100. -48. 384. DISPLAY_IDENTIFIER GENTEMPDT ECU_ADDRESS 0x3faa0e BYTE_ORDER MSB_LAST FORMAT "%8.4" /end MEASUREMENT
/begin MEASUREMENT gentempend "Generatortemperatur endgültig" UWORD _CNV_R_R_temp_uw_q0_547_CM 1 100. -48. 336. DISPLAY_IDENTIFIER GENTEMPEND ECU_ADDRESS 0x3faa10 BYTE_ORDER MSB_LAST FORMAT "%8.4" /end MEASUREMENT
/begin MEASUREMENT gentempexp "Delta Abkühltemperatur" SWORD _CNV_R_R_temp_sw_q0_673_CM 1 100. -48. 384. DISPLAY_IDENTIFIER GENTEMPEXP ECU_ADDRESS 0x3faa12 BYTE_ORDER MSB_LAST FORMAT "%8.4" /end MEASUREMENT
/begin MEASUREMENT gentempfil "gefilterte Generatortemperatur" UWORD _CNV_R_R_gendt_q0p0_663_CM 1 100. 0. 768. DISPLAY_IDENTIFIER GENTEMPFIL ECU_ADDRESS 0x3fa37c BYTE_ORDER MSB_LAST FORMAT "%8.4" /end MEASUREMENT
/begin MEASUREMENT igen400A "gemmessener Generatorstrom 400A-Bereich" UWORD _CNV_R_R_fak_uw_b51_666_CM 1 100. 0. 511.99219 DISPLAY_IDENTIFIER IGEN400A ECU_ADDRESS 0x3faa16 BYTE_ORDER MSB_LAST FORMAT "%8.4" /end MEASUREMENT
/begin MEASUREMENT md_gennm "gefiltertes Generatormoment absolut Ausgang" UWORD _CNV_R_R_md_ub_q0p0_674_CM 1 100. 0. 128. DISPLAY_IDENTIFIER MD_GENNM ECU_ADDRESS 0x3faa20 BYTE_ORDER MSB_LAST FORMAT "%8.4" /end MEASUREMENT
/begin MEASUREMENT MDNORMTMP "temporäre MDNORM" UBYTE _CNV_R_R_md_ub_q16_675_CM 1 100. 16. 1008. ECU_ADDRESS 0x3fa384 FORMAT "%8.4" /end MEASUREMENT
/begin MEASUREMENT ngen_w "Generatordrehzahl" UWORD _CNV_R_R_ngen_uw_q0_554_CM 1 100. 0. 32767.5 DISPLAY_IDENTIFIER NGEN_W ECU_ADDRESS 0x3fa37e BYTE_ORDER MSB_LAST FORMAT "%8.4" /end MEASUREMENT
/begin MEASUREMENT nmots "Motordrehzahl U/s" UBYTE _CNV_R_R_dez_550_CM 1 100. 0. 255. DISPLAY_IDENTIFIER NMOTS ECU_ADDRESS 0x3faa45 FORMAT "%8.4" /end MEASUREMENT
/begin MEASUREMENT pgenab "elektrische Generatorleistung" ULONG _CNV_R_R_genpv_uw_q_671_CM 1 100. 0. 4096. DISPLAY_IDENTIFIER PGENAB ECU_ADDRESS 0x3faa38 BYTE_ORDER MSB_LAST FORMAT "%8.4" /end MEASUREMENT
/begin MEASUREMENT tstcountv "Testcounter-Wert" UWORD _CNV_R_R_dez_550_CM 1 100. 0. 65535. DISPLAY_IDENTIFIER TSTCOUNTV ECU_ADDRESS 0x3faa22 BYTE_ORDER MSB_LAST FORMAT "%8.4" /end MEASUREMENT
/begin MEASUREMENT tstfil_out "Testfilter Ausgang" UWORD _CNV_R_R_gendt_q0p0_663_CM 1 100. 0. 768. DISPLAY_IDENTIFIER TSTFIL_OUT ECU_ADDRESS 0x3faa24 BYTE_ORDER MSB_LAST FORMAT "%8.4" /end MEASUREMENT
/begin MEASUREMENT tstlocini "Temp-Variable" UBYTE _CNV_S_2_B_TRUE_582_CM 1 100. 0. 1. DISPLAY_IDENTIFIER TSTLOCINI ECU_ADDRESS 0x3fa385 BIT_MASK 0x1 /end MEASUREMENT
/begin MEASUREMENT gentans "Generatoransauglufttemperatur" UWORD _CNV_R_R_temp_uw_q0_547_CM 1 100. -48. 336. DISPLAY_IDENTIFIER GENTANS ECU_ADDRESS 0x3faa08 BYTE_ORDER MSB_LAST FORMAT "%8.4" /end MEASUREMENT
/begin MEASUREMENT gentansend "Generatoransaugluftendwert" UWORD _CNV_R_R_temp_uw_q0_547_CM 1 100. -48. 143.25 DISPLAY_IDENTIFIER GENTANSEND ECU_ADDRESS 0x3faa0a BYTE_ORDER MSB_LAST FORMAT "%8.4" /end MEASUREMENT
/begin MEASUREMENT B_generken "Anfoderung der Generatorerkennung" UBYTE _CNV_S_2_B_TRUE_582_CM 1 100. 0. 1. DISPLAY_IDENTIFIER B_GENERKEN ECU_ADDRESS 0x3fa382 BIT_MASK 0x1 /end MEASUREMENT
/begin MEASUREMENT dib_ig "Delta Ibasis zu genig" SWORD _CNV_R_R_dez_550_CM 1 100. -255. 255. DISPLAY_IDENTIFIER DIB_IG ECU_ADDRESS 0x3fa9ec BYTE_ORDER MSB_LAST FORMAT "%8.4" /end MEASUREMENT
/begin MEASUREMENT fdib_ig "Faktor bewerte Delta I" SWORD _CNV_R_R_dez_550_CM 1 100. -255. 255. DISPLAY_IDENTIFIER FDIB_IG ECU_ADDRESS 0x3fa9ee BYTE_ORDER MSB_LAST FORMAT "%8.4" /end MEASUREMENT
/begin MEASUREMENT genawnumm "Generatorkennfeldnummer" UBYTE _CNV_R_R_dez_550_CM 1 100. 0. 255. DISPLAY_IDENTIFIER GENAWNUMM ECU_ADDRESS 0x3faca4 FORMAT "%8.4" /end MEASUREMENT
/begin MEASUREMENT gendi_spv "mittlerer quadratischer Diodenstrom" ULONG _CNV_R_R_genpv_ul_672_CM 1 100. 0. 510. DISPLAY_IDENTIFIER GENDI_SPV ECU_ADDRESS 0x3faa28 BYTE_ORDER MSB_LAST FORMAT "%8.4" /end MEASUREMENT
/begin MEASUREMENT gennummer "erkannte Generatornummer" UBYTE _CNV_R_R_dez_550_CM 1 100. 0. 255. DISPLAY_IDENTIFIER GENNUMMER ECU_ADDRESS 0x3faa40 FORMAT "%8.4" /end MEASUREMENT
/begin MEASUREMENT ibasis "Basis Strombedarf FZG mit SLP" UBYTE _CNV_R_R_dez_550_CM 1 100. 0. 255. DISPLAY_IDENTIFIER IBASIS ECU_ADDRESS 0x3faa42 FORMAT "%8.4" /end MEASUREMENT
/begin MEASUREMENT igm "Generatormischstrom" UBYTE _CNV_R_R_dez_550_CM 1 100. 0. 255. DISPLAY_IDENTIFIER IGM ECU_ADDRESS 0x3faa43 FORMAT "%8.4" /end MEASUREMENT
/begin MEASUREMENT igvor "Stromwert nach Überblendung" UBYTE _CNV_R_R_dez_550_CM 1 100. 0. 255. DISPLAY_IDENTIFIER IGVOR ECU_ADDRESS 0x3faa44 FORMAT "%8.4" /end MEASUREMENT
/begin MEASUREMENT mdgenrel_w "relatives Generatormoment Ausgang" UWORD _CNV_R_R_rel_uw_b10_653_CM 1 100. 0. 99.998474 DISPLAY_IDENTIFIER MDGENREL_W ECU_ADDRESS 0x3faa1c BYTE_ORDER MSB_LAST FORMAT "%8.4" /end MEASUREMENT
/begin MEASUREMENT mdgenvf_w "relatives Generatordrehmoment" UWORD _CNV_R_R_rel_uw_b10_653_CM 1 100. 0. 99.998474 DISPLAY_IDENTIFIER MDGENVF_W ECU_ADDRESS 0x3faa1e BYTE_ORDER MSB_LAST FORMAT "%8.4" /end MEASUREMENT
/begin MEASUREMENT ugen_tmp "Sollspannung vom Generator" UWORD _CNV_R_R_spg_ugen_555_CM 1 100. 10.6 16. DISPLAY_IDENTIFIER UGEN_TMP ECU_ADDRESS 0x3faa26 BYTE_ORDER MSB_LAST FORMAT "%8.4" /end MEASUREMENT
/begin MEASUREMENT B_genactiv "Bedingung Generatorinterface aktiv" SBYTE _CNV_S_2_B_TRUE_582_CM 1 100. 0. 1. DISPLAY_IDENTIFIER B_GENACTIV ECU_ADDRESS 0x3fe428 BIT_MASK 0x1 /end MEASUREMENT
/begin MEASUREMENT mdgenfil_w "gefiltertes Generatormoment absolut" UWORD _CNV_R_R_md_ub_q0p0_674_CM 1 100. 0. 128. DISPLAY_IDENTIFIER MDGENFIL_W ECU_ADDRESS 0x3faa18 BYTE_ORDER MSB_LAST FORMAT "%8.4" /end MEASUREMENT
/begin MEASUREMENT mdgennmufi "Generatormoment absolut" UWORD _CNV_R_R_md_ub_q0p0_674_CM 1 100. 0. 128. DISPLAY_IDENTIFIER MDGENNMUFI ECU_ADDRESS 0x3faa1a BYTE_ORDER MSB_LAST FORMAT "%8.4" /end MEASUREMENT
/begin CHARACTERISTIC GENMDNMOF "Offset des Generatormoments" VALUE 0xffe5b446 _REC_VAL_20_u2 128. _CNV_R_R_md_ub_q0p0_674_CM 0. 128. FORMAT "%8.4" /end CHARACTERISTIC
/begin CHARACTERISTIC IGNOTWERT "Generatornotlaufwert bei BSD-Ausfall" VALUE 0xffe5b4f0 _REC_VAL_20_u1 255. _CNV_R_R_dez_550_CM 0. 255. FORMAT "%8.4" /end CHARACTERISTIC
/begin CHARACTERISTIC KFMDGENFIL "Kennfeld Zeitkonstante Generatormomentfilterung" MAP 0xffe5a400 _REC_MAP_32_u2_u2_u2 0.99998474 _CNV_R_R_genzmst_uw_665_CM 0. 0.99998474 FORMAT "%8.4"
 /begin AXIS_DESCR STD_AXIS mdgenrel_w _CNV_R_R_md_ub_q0p0_674_CM 6 0. 128. FORMAT "%8.4" /end AXIS_DESCR
 /begin AXIS_DESCR STD_AXIS nmot_w _CNV_R_R_nmot_uw_q0_558_CM 6 0. 16383.75 FORMAT "%8.4" /end AXIS_DESCR
/end CHARACTERISTIC
/begin MEASUREMENT nmot_w "" UWORD _CNV_R_R_nmot_uw_q0_636_CM 1 100. 0. 16383.75 DISPLAY_IDENTIFIER NMOT_W ECU_ADDRESS 0x3fd1fc BYTE_ORDER MSB_LAST FORMAT "%8.4" /end MEASUREMENT
/begin MEASUREMENT genitemp "" UBYTE _CNV_R_R_dez_550_CM 1 100. 0. 255. DISPLAY_IDENTIFIER GENITEMP ECU_ADDRESS 0x3faa3e FORMAT "%8.4" /end MEASUREMENT
/begin MEASUREMENT dffgen "DF-Signal Generator" UBYTE _CNV_R_R_rel_ub_b10_574_CM 1 100. 0. 100. DISPLAY_IDENTIFIER DFFGEN ECU_ADDRESS 0x3fe420 FORMAT "%8.4" /end MEASUREMENT
/begin CHARACTERISTIC GENOFFTIME "maximale Generatorauszeit" VALUE 0xffe5b794 _REC_VAL_20_u2 6553.5 _CNV_R_R_t100msxs_u_552_CM 0. 6553.5 FORMAT "%8.4" /end CHARACTERISTIC
/begin CHARACTERISTIC GENUMAX "maximale Generatorspannung" VALUE 0xffe5b796 _REC_VAL_20_u2 16. _CNV_R_R_spg_sw_q0p_678_CM 0. 16. FORMAT "%8.4" /end CHARACTERISTIC
/begin CHARACTERISTIC GENURAMP "Spannungsinkrement fuer Rampe" VALUE 0xffe5b798 _REC_VAL_20_u2 20. _CNV_R_R_spg_sw_q0p_678_CM 0. 20. FORMAT "%8.4" /end CHARACTERISTIC
/begin CHARACTERISTIC GENURAMPOF "Spannungsinkrement fuer Rampe, Generator ausschalten" VALUE 0xffe5b79a _REC_VAL_20_u2 20. _CNV_R_R_spg_sw_q0p_678_CM 0. 20. FORMAT "%8.4" /end CHARACTERISTIC
/begin CHARACTERISTIC S_GOFFRAMP "Schalter Sprung auf 10,6V unverzoegert" VALUE 0xffe5b7a5 _REC_VAL_20_u1 255. _CNV_R_R_dez_550_CM 0. 255. FORMAT "%8.4" /end CHARACTERISTIC
/begin CHARACTERISTIC UGENOFF "Generatorauschaltspannung bei vfzg = 0" VALUE 0xffe5b7a0 _REC_VAL_20_u2 16. _CNV_R_R_spg_sw_q0p_678_CM 0. 16. FORMAT "%8.4" /end CHARACTERISTIC
/begin CHARACTERISTIC B_APP_UGEN "Umschaltung auf manuelle Generatorspannungsvorgabe" VALUE 0xffe5b7a4 _REC_VAL_20_u1 255. _CNV_R_R_dez_550_CM 0. 255. FORMAT "%8.4" /end CHARACTERISTIC
/begin CHARACTERISTIC T_VERB_ON "Verzugszeit Verbraucherzuschaltung nach Aufhebung Genertorreduzierung" VALUE 0xffe5b7a6 _REC_VAL_20_u1 25.5 _CNV_R_R_t100msxs_u_552_CM 0. 25.5 FORMAT "%8.4" /end CHARACTERISTIC
/begin CHARACTERISTIC UGENOFFV0 "Generatorauschaltspannung bei vfzg != 0" VALUE 0xffe5b7a2 _REC_VAL_20_u2 16. _CNV_R_R_spg_sw_q0p_678_CM 0. 16. FORMAT "%8.4" /end CHARACTERISTIC
/begin CHARACTERISTIC GEN_APP_UG "Manuelle Generatorspannungsvorgabe" VALUE 0xffe5b79c _REC_VAL_20_u2 16. _CNV_R_R_spg_sw_q0p_678_CM 0. 16. FORMAT "%8.4" /end CHARACTERISTIC
/begin MEASUREMENT B_genoffok "Bedingung Generatorabschaltfreigabe Sicherheitstimer" UBYTE _CNV_R_R_dez_550_CM 1 100. 0. 1. DISPLAY_IDENTIFIER B_GENOFFOK ECU_ADDRESS 0x3fa435 FORMAT "%2.0" BIT_MASK 0x1 /end MEASUREMENT
/begin MEASUREMENT B_1stugen "Bedingung ctrgenutar noch nicht gueltig" UBYTE _CNV_R_R_dez_550_CM 1 100. 0. 1. DISPLAY_IDENTIFIER B_1STUGEN ECU_ADDRESS 0x3faa5a FORMAT "%2.0" BIT_MASK 0x1 /end MEASUREMENT
/begin MEASUREMENT ugloc "lokale Generatorspannung" SWORD _CNV_R_R_spg_sw_q0p_678_CM 1 100. 0. 30. DISPLAY_IDENTIFIER UGLOC ECU_ADDRESS 0x3faa5e BYTE_ORDER MSB_LAST FORMAT "%8.4" /end MEASUREMENT
/begin MEASUREMENT uramp "" SWORD _CNV_R_R_spg_sw_q0p_678_CM 1 100. 0. 30. DISPLAY_IDENTIFIER URAMP ECU_ADDRESS 0x3faa66 BYTE_ORDER MSB_LAST FORMAT "%8.4" /end MEASUREMENT
/begin MEASUREMENT B_noctrgen "Bedingung Ladespannungvorgabe ignoriert" UBYTE _CNV_R_R_dez_550_CM 1 100. 0. 1. DISPLAY_IDENTIFIER B_NOCTRGEN ECU_ADDRESS 0x3faa5b FORMAT "%2.0" BIT_MASK 0x1 /end MEASUREMENT
/begin MEASUREMENT B_crashgen "Bedingung Crashabschaltung Generator" UBYTE _CNV_R_R_dez_550_CM 1 100. 0. 1. DISPLAY_IDENTIFIER B_CRASHGEN ECU_ADDRESS 0x3fe40c FORMAT "%2.0" BIT_MASK 0x1 /end MEASUREMENT
/begin MEASUREMENT B_genoff "Bedingung Generator ausgeschaltet" UBYTE _CNV_R_R_dez_550_CM 1 100. 0. 1. DISPLAY_IDENTIFIER B_GENOFF ECU_ADDRESS 0x3fa432 FORMAT "%2.0" BIT_MASK 0x1 /end MEASUREMENT
/begin MEASUREMENT B_genoff2 "Bedingung Generator2 ausgeschaltet" UBYTE _CNV_R_R_dez_550_CM 1 100. 0. 1. DISPLAY_IDENTIFIER B_GENOFF2 ECU_ADDRESS 0x3fa433 FORMAT "%2.0" BIT_MASK 0x1 /end MEASUREMENT
/begin MEASUREMENT B_genoffmd "Bedingung Generatus-off-Anforderung" UBYTE _CNV_R_R_dez_550_CM 1 100. 0. 1. DISPLAY_IDENTIFIER B_GENOFFMD ECU_ADDRESS 0x3fa434 FORMAT "%2.0" BIT_MASK 0x1 /end MEASUREMENT
/begin MEASUREMENT B_gentoggl "Bedindung Toggel Generatorauswahl" UBYTE _CNV_R_R_dez_550_CM 1 100. 0. 1. DISPLAY_IDENTIFIER B_GENTOGGL ECU_ADDRESS 0x3facc0 FORMAT "%2.0" BIT_MASK 0x1 /end MEASUREMENT
/begin MEASUREMENT B_ulcp "Bedingung ULCP aktiv" UBYTE _CNV_R_R_dez_550_CM 1 100. 0. 1. DISPLAY_IDENTIFIER B_ULCP ECU_ADDRESS 0x3fa437 FORMAT "%2.0" BIT_MASK 0x1 /end MEASUREMENT
/begin MEASUREMENT B_verb_off "Bedingung elektr. Verbraucher AUS" UBYTE _CNV_R_R_dez_550_CM 1 100. 0. 1. DISPLAY_IDENTIFIER B_VERB_OFF ECU_ADDRESS 0x3faa5c FORMAT "%2.0" BIT_MASK 0x1 /end MEASUREMENT
/begin MEASUREMENT ugen2 "Generatosspannungssollwert für Generator2" UBYTE _CNV_R_R_spg_ugen_555_CM 1 100. 10.6 36.1 DISPLAY_IDENTIFIER UGEN2 ECU_ADDRESS 0x3fa436 FORMAT "%8.4" /end MEASUREMENT
/begin MEASUREMENT ugsoll "Generatorsollspannung Basis" UWORD _CNV_R_R_spg_sw_q0p_678_CM 1 100. 0. 16. DISPLAY_IDENTIFIER UGSOLL ECU_ADDRESS 0x3faa60 BYTE_ORDER MSB_LAST FORMAT "%8.4" /end MEASUREMENT
/begin MEASUREMENT ugsollred "reduzierte Generatorsollspannung" UWORD _CNV_R_R_spg_sw_q0p_678_CM 1 100. 0. 16. DISPLAY_IDENTIFIER UGSOLLRED ECU_ADDRESS 0x3faa62 BYTE_ORDER MSB_LAST FORMAT "%8.4" /end MEASUREMENT
/begin MEASUREMENT ugsolltmp "reduzierte Zwischengeneratorsollspannung" UWORD _CNV_R_R_spg_sw_q0p_678_CM 1 100. 0. 16. DISPLAY_IDENTIFIER UGSOLLTMP ECU_ADDRESS 0x3faa64 BYTE_ORDER MSB_LAST FORMAT "%8.4" /end MEASUREMENT
/begin CHARACTERISTIC UGENDELTA "Generatoroffsetdelta für 2-Generatorregelung" VALUE 0xffe5b79e _REC_VAL_20_u2 16. _CNV_R_R_spg_sw_q0p_678_CM 0. 16. FORMAT "%8.4" /end CHARACTERISTIC
/begin COMPU_METHOD _CNV_A_R_LINEAR_____0_CM "" RAT_FUNC "%6.3" "-" COEFFS 0 1. 0. 0 0 1 /end COMPU_METHOD
/begin COMPU_METHOD _CNV_S_2_RANGE______2_CM "" TAB_VERB "%6.3" "[-]" COMPU_TAB_REF _CNV_S_2_RANGE______2 /end COMPU_METHOD
/begin COMPU_VTAB _CNV_S_2_RANGE______2 "" TAB_VERB 2 0 "0" 1 "1" /end COMPU_VTAB
/begin COMPU_METHOD _CNV_A_R_LINEAR_____4_CM "" RAT_FUNC "%6.3" "s" COEFFS 0 100. 0. 0 0 1 /end COMPU_METHOD
/begin COMPU_METHOD _CNV_A_R_LINEAR_____9_CM "" RAT_FUNC "%6.3" "%" COEFFS 0 2.56 0. 0 0 1 /end COMPU_METHOD
/begin COMPU_METHOD _CNV_A_R_LINEAR_____11_CM "" RAT_FUNC "%6.3" "°C" COEFFS 0 1.333333333333333 64. 0 0 1 /end COMPU_METHOD
/begin COMPU_METHOD _CNV_A_R_LINEAR_____12_CM "" RAT_FUNC "%6.3" "°C" COEFFS 0 1.333333333333333 0. 0 0 1 /end COMPU_METHOD
/begin COMPU_METHOD _CNV_A_R_LINEAR_____14_CM "" RAT_FUNC "%6.3" "°C" COEFFS 0 1. 40. 0 0 1 /end COMPU_METHOD
/begin COMPU_METHOD _CNV_A_R_LINEAR_____15_CM "" RAT_FUNC "%6.3" "rpm" COEFFS 0 3.125e-002 0. 0 0 1 /end COMPU_METHOD
/begin COMPU_METHOD _CNV_A_R_LINEAR_____22_CM "" RAT_FUNC "%6.3" "[-]" COEFFS 0 1. 0. 0 0 1 /end COMPU_METHOD
/begin COMPU_METHOD _CNV_A_R_LINEAR_____24_CM "" RAT_FUNC "%6.3" "s" COEFFS 0 10. 0. 0 0 1 /end COMPU_METHOD
/begin COMPU_METHOD _CNV_A_R_LINEAR_____31_CM "" RAT_FUNC "%6.3" "ms" COEFFS 0 0.1 0. 0 0 1 /end COMPU_METHOD
/begin COMPU_METHOD _CNV_A_R_LINEAR_____46_CM "" RAT_FUNC "%6.3" "-" COEFFS 0 16. 0. 0 0 1 /end COMPU_METHOD
/begin COMPU_METHOD _CNV_A_R_LINEAR_____50_CM "" RAT_FUNC "%6.3" "[-]" COEFFS 0 255.9999357490357 0. 0 0 1 /end COMPU_METHOD
/begin COMPU_METHOD _CNV_A_R_LINEAR_____60_CM "" RAT_FUNC "%6.3" "V" COEFFS 0 9.807692307692308 0. 0 0 1 /end COMPU_METHOD
/begin COMPU_METHOD _CNV_A_R_LINEAR_____82_CM "" RAT_FUNC "%6.3" "°CRK" COEFFS 0 2.666666666666667 0. 0 0 1 /end COMPU_METHOD
/begin COMPU_METHOD _CNV_A_R_LINEAR_____117_CM "" RAT_FUNC "%6.3" "-" COEFFS 0 128. 0. 0 0 1 /end COMPU_METHOD
/begin COMPU_METHOD _CNV_A_R_LINEAR_____129_CM "" RAT_FUNC "%6.3" "[-]" COEFFS 0 64. 0. 0 0 1 /end COMPU_METHOD
/begin COMPU_METHOD _CNV_A_R_LINEAR_____132_CM "" RAT_FUNC "%6.3" "%" COEFFS 0 2.56 128. 0 0 1 /end COMPU_METHOD
/begin COMPU_METHOD _CNV_A_R_LINEAR_____142_CM "" RAT_FUNC "%6.3" "ms" COEFFS 0 1. 0. 0 0 1 /end COMPU_METHOD
/begin COMPU_METHOD _CNV_A_R_LINEAR_____227_CM "" RAT_FUNC "%6.3" "°CRK" COEFFS 0 -2.666666666666667 -106.6666666666667 0 0 1 /end COMPU_METHOD
/begin COMPU_METHOD _CNV_A_R_LINEAR_____230_CM "" RAT_FUNC "%6.3" "°CRK" COEFFS 0 2.666666666666667 -160. 0 0 1 /end COMPU_METHOD
/begin COMPU_METHOD _CNV_A_R_LINEAR_____232_CM "" RAT_FUNC "%6.3" "°CRK/rev" COEFFS 0 2.666666666666667 0. 0 0 1 /end COMPU_METHOD
/begin COMPU_METHOD _CNV_A_R_LINEAR_____233_CM "" RAT_FUNC "%6.3" "-" COEFFS 0 100. -1.4210854715202e-014 0 0 1 /end COMPU_METHOD
/begin COMPU_METHOD _CNV_A_R_LINEAR_____234_CM "" RAT_FUNC "%6.3" "ms/0.375°CRK" COEFFS 0 102.399999996 0. 0 0 1 /end COMPU_METHOD
/begin COMPU_METHOD _CNV_A_R_LINEAR_____235_CM "" RAT_FUNC "%6.3" "ms" COEFFS 0 1.6 0. 0 0 1 /end COMPU_METHOD
/begin COMPU_METHOD _CNV_A_R_LINEAR_____237_CM "" RAT_FUNC "%6.3" "°CRK" COEFFS 0 682.666916670573 -40960.01500023438 0 0 1 /end COMPU_METHOD
/begin COMPU_METHOD _CNV_A_R_LINEAR_____238_CM "" RAT_FUNC "%6.3" "us" COEFFS 0 0.25 0. 0 0 1 /end COMPU_METHOD
/begin COMPU_METHOD _CNV_A_R_LINEAR_____239_CM "" RAT_FUNC "%6.3" "°CRK" COEFFS 0 682.666916670573 0. 0 0 1 /end COMPU_METHOD
/begin COMPU_METHOD _CNV_S_3_STATE_IVVT_240_CM "" TAB_VERB "%6.3" "-" COMPU_TAB_REF _CNV_S_3_STATE_IVVT_240 /end COMPU_METHOD
/begin COMPU_VTAB _CNV_S_3_STATE_IVVT_240 "" TAB_VERB 3 0 "HLD" 1 "RTD" 2 "ADC" /end COMPU_VTAB
/begin COMPU_METHOD _CNV_S_5_STATE_IVVT_241_CM "" TAB_VERB "%6.3" "-" COMPU_TAB_REF _CNV_S_5_STATE_IVVT_241 /end COMPU_METHOD
/begin COMPU_VTAB _CNV_S_5_STATE_IVVT_241 "" TAB_VERB 5 0 "INIT" 1 "HLD_DLY" 2 "HLD_ADAP" 3 "ADJ" 4 "END_POS" /end COMPU_VTAB
/begin COMPU_METHOD _CNV_A_R_LINEAR_____242_CM "" RAT_FUNC "%6.3" "°CRK" COEFFS 0 682.666916670573 1.200018750387244e-002 0 0 1 /end COMPU_METHOD
/begin COMPU_METHOD _CNV_A_R_LINEAR_____243_CM "" RAT_FUNC "%6.3" "°CRK/s" COEFFS 0 2.666666666666667 0. 0 0 1 /end COMPU_METHOD
/begin COMPU_METHOD _CNV_A_R_LINEAR_____245_CM "" RAT_FUNC "%6.3" "°CRK" COEFFS 0 -682.666916670573 -27306.67666682292 0 0 1 /end COMPU_METHOD
/begin COMPU_METHOD _CNV_A_R_LINEAR_____247_CM "" RAT_FUNC "%6.3" "°CRK" COEFFS 0 2.666666666666667 160. 0 0 1 /end COMPU_METHOD
/begin COMPU_METHOD _CNV_R_R_i_vvt_ub_q_542_CM "" RAT_FUNC "%6.3" "A" COEFFS 0. 1. 63.5 0. 0. 0.5 /end COMPU_METHOD
/begin COMPU_METHOD _CNV_R_R_i_eluft_q0_543_CM "" RAT_FUNC "%6.3" "A" COEFFS 0. 65536. 0. 0. 0. 4096. /end COMPU_METHOD
/begin COMPU_METHOD _CNV_R_R_rel_ub_b10_544_CM "" RAT_FUNC "%6.3" "[-]" COEFFS 0. 255. 0. 0. 0. 100. /end COMPU_METHOD
/begin COMPU_METHOD _CNV_R_R_vfzg_ub_q1_545_CM "" RAT_FUNC "%6.3" "[-]" COEFFS 0. 1. 0. 0. 0. 1.25 /end COMPU_METHOD
/begin COMPU_METHOD _CNV_R_R_fak_ub_b2_546_CM "" RAT_FUNC "%6.3" "[-]" COEFFS 0. 256. 0. 0. 0. 2. /end COMPU_METHOD
/begin COMPU_METHOD _CNV_R_R_temp_uw_q0_547_CM "" RAT_FUNC "%6.3" "[-]" COEFFS 0. 1. 48. 0. 0. 0.75 /end COMPU_METHOD
/begin COMPU_METHOD _CNV_R_R_spg_ubatt_548_CM "" RAT_FUNC "%6.3" "[-]" COEFFS 0. 1. 0. 0. 0. 9.420000000000001e-002 /end COMPU_METHOD
/begin COMPU_METHOD _CNV_R_R_temp_ub_q0_549_CM "" RAT_FUNC "%6.3" "°C" COEFFS 0. 1. 48. 0. 0. 0.75 /end COMPU_METHOD
/begin COMPU_METHOD _CNV_R_R_dez_550_CM "" RAT_FUNC "%6.3" "[-]" COEFFS 0. 1. 0. 0. 0. 1. /end COMPU_METHOD
/begin COMPU_METHOD _CNV_R_R_PCENT_551_CM "" RAT_FUNC "%6.3" "[-]" COEFFS 0. 256. 0. 0. 0. 100. /end COMPU_METHOD
/begin COMPU_METHOD _CNV_R_R_t100msxs_u_552_CM "" RAT_FUNC "%6.3" "[-]" COEFFS 0. 1. 0. 0. 0. 0.1 /end COMPU_METHOD
/begin COMPU_METHOD _CNV_R_R_igen_uw_q0_553_CM "" RAT_FUNC "%6.3" "A" COEFFS 0. 65536. 0. 0. 0. 2048. /end COMPU_METHOD
/begin COMPU_METHOD _CNV_R_R_ngen_uw_q0_554_CM "" RAT_FUNC "%6.3" "U/min" COEFFS 0. 1. 0. 0. 0. 0.5 /end COMPU_METHOD
/begin COMPU_METHOD _CNV_R_R_spg_ugen_555_CM "" RAT_FUNC "%6.3" "[-]" COEFFS 0. 10. -106. 0. 0. 1. /end COMPU_METHOD
/begin COMPU_METHOD _CNV_A_R_LINEAR_____556_CM "" RAT_FUNC "%6.3" "rpm" COEFFS 0 4. 0. 0 0 1 /end COMPU_METHOD
/begin COMPU_METHOD _CNV_A_R_LINEAR_____557_CM "" RAT_FUNC "%6.3" "ms" COEFFS 0 1.e-002 0. 0 0 1 /end COMPU_METHOD
/begin COMPU_METHOD _CNV_R_R_nmot_uw_q0_558_CM "" RAT_FUNC "%6.3" "[-]" COEFFS 0. 1. 0. 0. 0. 0.25 /end COMPU_METHOD
/begin COMPU_METHOD _CNV_R_R_nmot_ub_q4_560_CM "" RAT_FUNC "%6.3" "[-]" COEFFS 0. 1. 0. 0. 0. 40. /end COMPU_METHOD
/begin COMPU_METHOD _CNV_R_R_rel_ub_b10_574_CM "" RAT_FUNC "%6.3" "%" COEFFS 0. 255. 0. 0. 0. 100. /end COMPU_METHOD
/begin COMPU_METHOD _CNV_S_2_B_TRUE_582_CM "" TAB_VERB "%6.3" "[-]" COMPU_TAB_REF _CNV_S_2_B_TRUE_582 /end COMPU_METHOD
/begin COMPU_VTAB _CNV_S_2_B_TRUE_582 "" TAB_VERB 2 0 "----" 1 "TRUE" /end COMPU_VTAB
/begin COMPU_METHOD _CNV_A_R_LINEAR_____585_CM "" RAT_FUNC "%6.3" "V" COEFFS 0 10. -106. 0 0 1 /end COMPU_METHOD
/begin COMPU_METHOD _CNV_R_R_fak_ub_b1_586_CM "" RAT_FUNC "%6.3" "[-]" COEFFS 0. 256. 0. 0. 0. 1. /end COMPU_METHOD
/begin COMPU_METHOD _CNV_R_R_spg_gencan_592_CM "" RAT_FUNC "%6.3" "[-]" COEFFS 0. 40. -424. 0. 0. 1. /end COMPU_METHOD
/begin COMPU_METHOD _CNV_R_R_m_ub_b23p3_593_CM "" RAT_FUNC "%6.3" "[-]" COEFFS 0. 2812.5 0. 0. 0. 256. /end COMPU_METHOD
/begin COMPU_METHOD _CNV_R_R_temp_q1_594_CM "" RAT_FUNC "%6.3" "°C" COEFFS 0. 1. 0. 0. 0. 1. /end COMPU_METHOD
/begin COMPU_METHOD _CNV_R_R_t10msxs_uw_595_CM "" RAT_FUNC "%6.3" "[-]" COEFFS 0. 1. 0. 0. 0. 1.e-002 /end COMPU_METHOD
/begin COMPU_METHOD _CNV_R_R_nmot_ub_q1_596_CM "" RAT_FUNC "%6.3" "[-]" COEFFS 0. 1. 0. 0. 0. 10. /end COMPU_METHOD
/begin COMPU_METHOD _CNV_R_R_fak_ub_b4_598_CM "" RAT_FUNC "%6.3" "[-]" COEFFS 0. 256. 0. 0. 0. 4. /end COMPU_METHOD
/begin COMPU_METHOD _CNV_R_R_nmot_uw_q0_636_CM "" RAT_FUNC "%6.3" "1/min" COEFFS 0. 1. 0. 0. 0. 0.25 /end COMPU_METHOD
/begin COMPU_METHOD _CNV_R_R_rel_uw_b10_653_CM "" RAT_FUNC "%6.3" "[-]" COEFFS 0. 65536. 0. 0. 0. 100. /end COMPU_METHOD
/begin COMPU_METHOD _CNV_R_R_gendt_q0p0_663_CM "" RAT_FUNC "%6.3" "°K" COEFFS 0. 1. 0. 0. 0. 0.75 /end COMPU_METHOD
/begin COMPU_METHOD _CNV_R_R_genzmig_uw_664_CM "" RAT_FUNC "%6.3" "[-]" COEFFS 0. 65536. 0. 0. 0. 2. /end COMPU_METHOD
/begin COMPU_METHOD _CNV_R_R_genzmst_uw_665_CM "" RAT_FUNC "%6.3" "[-]" COEFFS 0. 65536. 0. 0. 0. 1. /end COMPU_METHOD
/begin COMPU_METHOD _CNV_R_R_fak_uw_b51_666_CM "" RAT_FUNC "%6.3" "[-]" COEFFS 0. 65536. 0. 0. 0. 512. /end COMPU_METHOD
/begin COMPU_METHOD _CNV_R_R_genrstator_667_CM "" RAT_FUNC "%6.3" "Ohm" COEFFS 0. 65536. 0. 0. 0. 1. /end COMPU_METHOD
/begin COMPU_METHOD _CNV_R_R_geneta_q0p_668_CM "" RAT_FUNC "%6.3" "-" COEFFS 0. 256. 0. 0. 0. 8. /end COMPU_METHOD
/begin COMPU_METHOD _CNV_R_R_fak_uw_b64_669_CM "" RAT_FUNC "%6.3" "[-]" COEFFS 0. 65536. 0. 0. 0. 64. /end COMPU_METHOD
/begin COMPU_METHOD _CNV_R_R_genalfak_u_670_CM "" RAT_FUNC "%6.3" "[-]" COEFFS 0. 65536. 0. 0. 0. 4. /end COMPU_METHOD
/begin COMPU_METHOD _CNV_R_R_genpv_uw_q_671_CM "" RAT_FUNC "%6.3" "W" COEFFS 0. 65536. 0. 0. 0. 2048. /end COMPU_METHOD
/begin COMPU_METHOD _CNV_R_R_genpv_ul_672_CM "" RAT_FUNC "%6.3" "W" COEFFS 0. 4294970000. 0. 0. 0. 262144. /end COMPU_METHOD
/begin COMPU_METHOD _CNV_R_R_temp_sw_q0_673_CM "" RAT_FUNC "%6.3" "[-]" COEFFS 0. 4. 0. 0. 0. 3. /end COMPU_METHOD
/begin COMPU_METHOD _CNV_R_R_md_ub_q0p0_674_CM "" RAT_FUNC "%6.3" "Nm" COEFFS 0. 1024. 0. 0. 0. 256. /end COMPU_METHOD
/begin COMPU_METHOD _CNV_R_R_md_ub_q16_675_CM "" RAT_FUNC "%6.3" "[-]" COEFFS 0. 1. 0. 0. 0. 16. /end COMPU_METHOD
/begin COMPU_METHOD _CNV_R_R_spg_sw_q0p_678_CM "" RAT_FUNC "%6.3" "V" COEFFS 0. 1000. 0. 0. 0. 1. /end COMPU_METHOD
/begin RECORD_LAYOUT _REC_VAL_20_u1 FNC_VALUES 1 UBYTE COLUMN_DIR DIRECT /end RECORD_LAYOUT
/begin RECORD_LAYOUT _REC_VAL_20_u2 FNC_VALUES 1 UWORD COLUMN_DIR DIRECT /end RECORD_LAYOUT
/begin RECORD_LAYOUT _REC_CUR_20_u2_u1 FNC_VALUES 1 UWORD COLUMN_DIR DIRECT /end RECORD_LAYOUT
/begin RECORD_LAYOUT _REC_AXS_20_u1 NO_AXIS_PTS_X 1 UBYTE AXIS_PTS_X 2 UBYTE INDEX_INCR DIRECT /end RECORD_LAYOUT
/begin RECORD_LAYOUT _REC_MAP_20_u1_u1_u1 FNC_VALUES 1 UBYTE COLUMN_DIR DIRECT /end RECORD_LAYOUT
/begin RECORD_LAYOUT _REC_CUR_20_u1_u1 FNC_VALUES 1 UBYTE COLUMN_DIR DIRECT /end RECORD_LAYOUT
/begin RECORD_LAYOUT _REC_AXS_20_u2 NO_AXIS_PTS_X 1 UWORD AXIS_PTS_X 2 UWORD INDEX_INCR DIRECT /end RECORD_LAYOUT
/begin RECORD_LAYOUT _REC_MAP_20_u1_u1_u2 FNC_VALUES 1 UBYTE COLUMN_DIR DIRECT /end RECORD_LAYOUT
/begin RECORD_LAYOUT _REC_CUR_20_u1_u2 FNC_VALUES 1 UBYTE COLUMN_DIR DIRECT /end RECORD_LAYOUT
/begin RECORD_LAYOUT _REC_MAP_20_u2_u1_u1 FNC_VALUES 1 UWORD COLUMN_DIR DIRECT /end RECORD_LAYOUT
/begin RECORD_LAYOUT _REC_VAL_20_s1 FNC_VALUES 1 SBYTE COLUMN_DIR DIRECT /end RECORD_LAYOUT
/begin RECORD_LAYOUT _REC_VAL_20_s2 FNC_VALUES 1 SWORD COLUMN_DIR DIRECT /end RECORD_LAYOUT
/begin RECORD_LAYOUT _REC_MAP_52_u2_u2_u2 NO_AXIS_PTS_X 1 UWORD NO_AXIS_PTS_Y 2 UWORD AXIS_PTS_X 3 UWORD INDEX_INCR DIRECT AXIS_PTS_Y 4 UWORD INDEX_INCR DIRECT FNC_VALUES 5 UWORD COLUMN_DIR DIRECT /end RECORD_LAYOUT
/begin RECORD_LAYOUT _REC_CUR_52_u2_u2 NO_AXIS_PTS_X 1 UWORD AXIS_PTS_X 2 UWORD INDEX_INCR DIRECT FNC_VALUES 3 UWORD COLUMN_DIR DIRECT /end RECORD_LAYOUT
/begin RECORD_LAYOUT _REC_CUR_52_UBYTE_u2_u1 NO_AXIS_PTS_X 1 UBYTE AXIS_PTS_X 2 UBYTE INDEX_INCR DIRECT FNC_VALUES 3 UWORD COLUMN_DIR DIRECT /end RECORD_LAYOUT
/begin RECORD_LAYOUT _REC_MAP_52_u1_u1_u1 NO_AXIS_PTS_X 1 UBYTE NO_AXIS_PTS_Y 2 UBYTE AXIS_PTS_X 3 UBYTE INDEX_INCR DIRECT AXIS_PTS_Y 4 UBYTE INDEX_INCR DIRECT FNC_VALUES 5 UBYTE COLUMN_DIR DIRECT /end RECORD_LAYOUT
/begin RECORD_LAYOUT _REC_VAL_2_u1 FNC_VALUES 1 UBYTE COLUMN_DIR DIRECT /end RECORD_LAYOUT
/begin RECORD_LAYOUT _REC_CUR_32_u1_u1 NO_AXIS_PTS_X 1 UBYTE AXIS_PTS_X 2 UBYTE INDEX_INCR DIRECT FNC_VALUES 3 UBYTE COLUMN_DIR DIRECT /end RECORD_LAYOUT
/begin RECORD_LAYOUT _REC_VAL_20_S4 FNC_VALUES 1 FLOAT32_IEEE COLUMN_DIR DIRECT /end RECORD_LAYOUT
/begin RECORD_LAYOUT _REC_CUR_52_ULONG_S4_S4 NO_AXIS_PTS_X 1 ULONG AXIS_PTS_X 2 FLOAT32_IEEE INDEX_INCR DIRECT FNC_VALUES 3 FLOAT32_IEEE COLUMN_DIR DIRECT /end RECORD_LAYOUT
/begin RECORD_LAYOUT _REC_CUR_32_u2_u2 NO_AXIS_PTS_X 1 UWORD AXIS_PTS_X 2 UWORD INDEX_INCR DIRECT FNC_VALUES 3 UWORD COLUMN_DIR DIRECT /end RECORD_LAYOUT
/begin RECORD_LAYOUT _REC_MAP_32_u1_u1_u2 NO_AXIS_PTS_X 1 UBYTE NO_AXIS_PTS_Y 2 UBYTE AXIS_PTS_X 3 UBYTE INDEX_INCR DIRECT AXIS_PTS_Y 4 UWORD INDEX_INCR DIRECT FNC_VALUES 5 UBYTE COLUMN_DIR DIRECT /end RECORD_LAYOUT
/begin RECORD_LAYOUT _REC_MAP_32_u1_u1_u1 NO_AXIS_PTS_X 1 UBYTE NO_AXIS_PTS_Y 2 UBYTE AXIS_PTS_X 3 UBYTE INDEX_INCR DIRECT AXIS_PTS_Y 4 UBYTE INDEX_INCR DIRECT FNC_VALUES 5 UBYTE COLUMN_DIR DIRECT /end RECORD_LAYOUT
/begin RECORD_LAYOUT _REC_MAP_32_u2_u2_u2 NO_AXIS_PTS_X 1 UWORD NO_AXIS_PTS_Y 2 UWORD AXIS_PTS_X 3 UWORD INDEX_INCR DIRECT AXIS_PTS_Y 4 UWORD INDEX_INCR DIRECT FNC_VALUES 5 UWORD COLUMN_DIR DIRECT /end RECORD_LAYOUT
/begin FUNCTION AUX_Power_Management "_Power Management"
 /begin DEF_CHARACTERISTIC CRENGOF CRVVTOF KFELUPWM KLELTEMP CRVVTNOT KLELSLP KLELUB DFRUTYP IGENLLRANH LLRABS_DF LLRANH_DF NTWBGLLGEN PRELLDFAH PRELLDFRF KFDFIGEN0 KFDFIGEN1 KFDFIGEN2 KFDFIGEN3 KFDFIGEN4 KFDFIGEN5 KFDFIGEN6 KFDFIGEN7 GEN_DNMIN GENPDTIME GFBSUTERR GFBSUTHEAL GFELTERR GFELTHEAL GFHTTERR GFHTTHEAL GFMETERR GFMETHEAL GFNOBTERR GFNOBTHEAL MSKGENDFP MSKGENKL61 SNMBSDKL61 c_vb_min_bsd_diag APPTBATINI BATT_ALFAH BATT_ALFAV BATT_BETAV BATTHTAUVG BATTHTAUVK BATTORT0 BATTORT2 BATTVTAUVG BATTVTAUVK BATVFZGTAU CWBATTCOD DTANSKOR ILMINUMG KLBATTLSTR KLEXPALH KLEXPALV KLEXPBETAV LADEKENNL LBATTMAX LBATTMIN MCOBATTORT NMINUMG OFTUMGCAN OFULADE PLBATTUMG TBATINIMAN TBATTFTAUV TBATTTAUFH TUMGINI TUMGTAU UBATTNORM ULADE_TAU VMINUMG GENLDDFMAX KLGENLDST DFMODE DFS_MAX DFS_MIN DFS_MITT TNNSTART B_APP_LLAH GENLLAHAPP NSUBO NSUBU lc_pow_cord_inh EN_MDGEN GEN_IG_OF GENITYP GENTEMPAPP GENTEMPMAN GENTYP GENUMGTYP TSTCNTEN TSTFIL_IN TSTFIL_INI ZMGENIG ZMTESTFIL ENGENTANS GENTMOTDT GENVFZGSW KLIGENMESS KLRTHFAK0 PRELLGTMOT ZMGENSTHZ0 ZMGENSTKL0 ZMGENTWA GENDIFAK0 GENDIFAK1 GENDIFAK2 GENDIFAK3 GENDIFAK4 GENDIFAK5 GENDIFAK6 GENDIFAK7 GENRS0_0 GENRS0_1 GENRS0_2 GENRS0_3 GENRS0_4 GENRS0_5 GENRS0_6 GENRS0_7 GENSTFAK0 GENSTFAK1 GENSTFAK2 GENSTFAK3 GENSTFAK4 GENSTFAK5 GENSTFAK6 GENSTFAK7 GENTMOTOF0 GENTMOTOF1 GENTMOTOF2 GENTMOTOF3 GENTMOTOF4 GENTMOTOF5 GENTMOTOF6 GENTMOTOF7 GENTYPFELD IGBASIS IGBASISOFF KFGENWETA0 KFGENWETA1 KFGENWETA2 KFGENWETA3 KFGENWETA4 KFGENWETA5 KFGENWETA6 KFGENWETA7 KFIGENDF0 KFIGENDF1 KFIGENDF2 KFIGENDF3 KFIGENDF4 KFIGENDF5 KFIGENDF6 KFIGENDF7 KLFPDIODE0 KLFPDIODE1 KLFPDIODE2 KLFPDIODE3 KLFPDIODE4 KLFPDIODE5 KLFPDIODE6 KLFPDIODE7 KLGENEXP0 KLGENEXP1 KLGENEXP2 KLGENEXP3 KLGENEXP4 KLGENEXP5 KLGENEXP6 KLGENEXP7 KLGENTETA0 KLGENTETA1 KLGENTETA2 KLGENTETA3 KLGENTETA4 KLGENTETA5 KLGENTETA6 KLGENTETA7 KLRTH0FAK0 KLRTH0FAK1 KLRTH0FAK2 KLRTH0FAK3 KLRTH0FAK4 KLRTH0FAK5 KLRTH0FAK6 KLRTH0FAK7 KLRTHFAK1 KLRTHFAK2 KLRTHFAK3 KLRTHFAK4 KLRTHFAK5 KLRTHFAK6 KLRTHFAK7 KLRTHGEN0 KLRTHGEN1 KLRTHGEN2 KLRTHGEN3 KLRTHGEN4 KLRTHGEN5 KLRTHGEN6 KLRTHGEN7 KLTANSGEN0 KLTANSGEN1 KLTANSGEN2 KLTANSGEN3 KLTANSGEN4 KLTANSGEN5 KLTANSGEN6 KLTANSGEN7 MANAWNUMM S_IGMISCH TIGMISCH UDIODERMS0 UDIODERMS1 UDIODERMS2 UDIODERMS3 UDIODERMS4 UDIODERMS5 UDIODERMS6 UDIODERMS7 ZMGENS0HZ0 ZMGENS0HZ1 ZMGENS0HZ2 ZMGENS0HZ3 ZMGENS0HZ4 ZMGENS0HZ5 ZMGENS0HZ6 ZMGENS0HZ7 ZMGENS0KL0 ZMGENS0KL1 ZMGENS0KL2 ZMGENS0KL3 ZMGENS0KL4 ZMGENS0KL5 ZMGENS0KL6 ZMGENS0KL7 ZMGENSTHZ1 ZMGENSTHZ2 ZMGENSTHZ3 ZMGENSTHZ4 ZMGENSTHZ5 ZMGENSTHZ6 ZMGENSTHZ7 ZMGENSTKL1 ZMGENSTKL2 ZMGENSTKL3 ZMGENSTKL4 ZMGENSTKL5 ZMGENSTKL6 ZMGENSTKL7 ZMGN0TANS0 ZMGN0TANS1 ZMGN0TANS2 ZMGN0TANS3 ZMGN0TANS4 ZMGN0TANS5 ZMGN0TANS6 ZMGN0TANS7 ZMGNTANS0 ZMGNTANS1 ZMGNTANS2 ZMGNTANS3 ZMGNTANS4 ZMGNTANS5 ZMGNTANS6 ZMGNTANS7 ZMIGMISCH S_RDGENTYP GENUEBSETZ0 GENUEBSETZ1 GENUEBSETZ2 GENUEBSETZ3 GENUEBSETZ4 GENUEBSETZ5 GENUEBSETZ6 GENUEBSETZ7 KFIGENKA0 KFIGENKA1 KFIGENKA2 KFIGENKA3 KFIGENKA4 KFIGENKA5 KFIGENKA6 KFIGENKA7 KFIGENWA0 KFIGENWA1 KFIGENWA2 KFIGENWA3 KFIGENWA4 KFIGENWA5 KFIGENWA6 KFIGENWA7 GENMDNMOF IGNOTWERT KFMDGENFIL GENOFFTIME GENUMAX GENURAMP GENURAMPOF S_GOFFRAMP UGENOFF B_APP_UGEN T_VERB_ON UGENOFFV0 GEN_APP_UG UGENDELTA /end DEF_CHARACTERISTIC
 /begin OUT_MEASUREMENT faktubel i_eluvfzg vfzg_tmp fakttansel i_elu_vvt i_eluefter i_elupwm taml_tmp tans_tmp ub_tmp vvt_ib1_2 vvt_iges i_slp n_idlgspec B_hysllrah gendfvorhs genikaltmp genitemp2 igenrllrah ngsllm ufgentmp2 genstatroh st_gen B_1stbsder B_auxerr B_gfbsupep B_gfelep B_gfhtep B_gfmeep B_gfnobsep en_gendiag genfbsak gfbsuctr gfehlin1 gfehlin2 gfehlin3 gfehlin4 gfehlin5 gfelctr gfhtctr gfmectr gfnobctr kl61loc tlrfgen ufgen B_genfel B_genfht B_genfme B_genfbsd B_etum B_inibumg B_taerr B_tns B_tumers batt_a1 batt_a2 batt_c10 batt_c11 batt_c12 batt_c13 batt_c14 batt_c8 batt_c9 batt_d1 batt_e1 batt_e2 batt_e3 batt_e4 batt_e5 batt_e6 batt_tfil batt_w0 batto_a batto_a1 batto_b batto_c batto_c1 batto_c2 batto_c3 batto_c4 batto_c6 batto_c7 battort cobattort ctrgenutar dbet_alf dbetalf_t dt_tumg end_init imlatm t_batt_ini t_battabst t_umgabst t_umgabstf tabst_fl tans tansf tbatinmanf tbatstiniv tumg_ers tumgbatold tumgbattab tumgcan tumgcanf tumgtemp vfzgf st_ldstgen dffgenflo dfmonitor dfsumme dfwanzahl B_nsub nslb B_fs B_genslp B_kl61 ugen B_genfkupl B_gfbsupak B_gfelak B_gfmeak B_gfnobsak igenmess genmanufak gentypkenn st_craweng B_firstemp B_gene B_heizen gen_teta gen_weta genalfak2 gendts gendts_s1 gendtsvor genfeta geni_difk geni_end geni_stfk geni2_st genig genikaltun geninafil genivorfil genrs genspv genspv_1 genspv_2 gensttemp gentemp gentempab gentempdt gentempend gentempexp gentempfil igen400A md_gennm MDNORMTMP ngen_w nmots pgenab tstcountv tstfil_out tstlocini gentans gentansend B_generken dib_ig fdib_ig genawnumm gendi_spv gennummer ibasis igm igvor mdgenrel_w mdgenvf_w ugen_tmp B_genactiv mdgenfil_w mdgennmufi nmot_w genitemp dffgen B_genoffok B_1stugen ugloc uramp B_noctrgen B_crashgen B_genoff B_genoff2 B_genoffmd B_gentoggl B_ulcp B_verb_off ugen2 ugsoll ugsollred ugsolltmp /end OUT_MEASUREMENT
/end FUNCTION
/begin FUNCTION AUX_Calculating_the_pulse_width_ "_Calculating the pulse width modulation"
 /begin DEF_CHARACTERISTIC ip_fac_ivvtpwm ip_ivvthpwm c_ivvtpwm_ad_ofs_ex c_ivvtpwm_adc_ex c_ivvtpwm_adc_in c_ivvtpwm_rtd_ex c_ivvtpwm_rtd_in c_cam_hys_adh_ivvt c_cam_hys_rst_adh_ivvt c_cam_sp_dif_adh_ivvt c_cyc_max_adh_ivvt c_sum_seg_dly_ivvthpwm c_ivvthpwm_ad_min c_ivvthpwm_ad_max ip_cyc_min_adh_ivvt ip_ivvthpwm_adh ip_ivvthpwm_adh_cyc_in ip_ivvthpwm_adh_cyc_ex id_ivvthpwm_cor_ad ivvthpwm_ad_ex_1 ivvthpwm_ad_in_1 /end DEF_CHARACTERISTIC
 /begin OUT_MEASUREMENT ivvt_in.struct_pwm_dyw_ivvt.cam_sp_dyw_ivvt ivvt_in.struct_pwm_dyw_ivvt.lv_cam_sp_dyw_ivvt ivvt_in_1.struct_pwm_ivvt.ivvtpwm ivvt_in_1.struct_pwm_ivvt.sum_cyc_adh_ivvt ivvt_in_1.struct_pwm_ivvt.ivvthpwm_adh ivvt_in_1.struct_pwm_ivvt.ivvthpwm_adh_save ivvt_in_1.struct_pwm_ivvt.lv_adh_act_ivvt ivvt_in_1.struct_pwm_ivvt.lv_adh_end_ivvt ivvt_in_1.struct_pwm_ivvt.sum_state_act_adj_ivvt ivvt_in_1.struct_pwm_ivvt.vel_drift_ivvthpwm ivvt_in_1.struct_pwm_ivvt.ivvthpwm_ad ivvt_ex_1.struct_pwm_ivvt.ivvtpwm ivvt_ex_1.struct_pwm_ivvt.sum_cyc_adh_ivvt ivvt_ex_1.struct_pwm_ivvt.ivvthpwm_adh ivvt_ex_1.struct_pwm_ivvt.ivvthpwm_adh_save ivvt_ex_1.struct_pwm_ivvt.lv_adh_act_ivvt ivvt_ex_1.struct_pwm_ivvt.lv_adh_end_ivvt ivvt_ex_1.struct_pwm_ivvt.sum_state_act_adj_ivvt ivvt_ex_1.struct_pwm_ivvt.vel_drift_ivvthpwm ivvt_ex_1.struct_pwm_ivvt.ivvthpwm_ad ivvt_ex.struct_pwm_dyw_ivvt.cam_sp_dyw_ivvt ivvt_ex.struct_pwm_dyw_ivvt.lv_cam_sp_dyw_ivvt t_dly_mes_ivvt /end OUT_MEASUREMENT
/end FUNCTION
/begin FUNCTION AUX_Coil_substitute_temperature "_Coil substitute temperature" /begin DEF_CHARACTERISTIC ip_tmag_ivvt /end DEF_CHARACTERISTIC /begin OUT_MEASUREMENT tmag_ivvt /end OUT_MEASUREMENT /end FUNCTION
/begin FUNCTION AUX_Calculation_of_delay "_Calculation of delay"
 /begin DEF_CHARACTERISTIC c_cam_dif_min_dly_ivvt ip_dly_adc_ivvt_ex ip_dly_adc_ivvt_in ip_dly_rtd_ivvt_ex ip_dly_rtd_ivvt_in /end DEF_CHARACTERISTIC
 /begin OUT_MEASUREMENT ivvt_in.struct_dly_ivvt.dly_adc_ivvt ivvt_in.struct_dly_ivvt.dly_rtd_ivvt ivvt_in_1.struct_dly_mes_ivvt.dly_mes_adc_ivvt ivvt_in_1.struct_dly_mes_ivvt.dly_mes_rtd_ivvt ivvt_ex_1.struct_dly_mes_ivvt.dly_mes_adc_ivvt ivvt_ex_1.struct_dly_mes_ivvt.dly_mes_rtd_ivvt ivvt_ex.struct_dly_ivvt.dly_adc_ivvt ivvt_ex.struct_dly_ivvt.dly_rtd_ivvt /end OUT_MEASUREMENT
/end FUNCTION
/begin FUNCTION AUX_IVVT_Controller "_IVVT-Controller"
 /begin DEF_CHARACTERISTIC c_fac_hld_dly ip_t_fac_adc_ivvt_ex ip_t_fac_adc_ivvt_in ip_t_fac_rtd_ivvt_ex ip_fac_ctl_ivvt_in c_cam_mdl_dif_min_adh c_fac_t_sum_min_ivvt_adh c_fac_dly_ivvt_adh c_cam_adj_dif_adh_in c_cam_adj_dif_adh_ex c_cam_adh_hys ip_toil_min_ivvt_diag ip_toil_max_ivvt_diag ip_t_fac_rtd_ivvt_in ip_t_dly_add_adc_ivvt_in ip_t_dly_add_adc_ivvt_ex ip_t_dly_add_rtd_ivvt_ex ip_t_dly_add_rtd_ivvt_in ip_fac_ctl_ivvt_ex ip_t_ctl_adc_ivvt_ex ip_t_ctl_adc_ivvt_in ip_t_ctl_rtd_ivvt_in ip_t_ctl_rtd_ivvt_ex ip_t_sum_min_adc_ivvt_ex ip_t_sum_min_adc_ivvt_in ip_t_sum_min_rtd_ivvt_in ip_t_sum_min_rtd_ivvt_ex c_t_add_min_ivvt_adh_in c_t_add_min_ivvt_adh_ex c_t_add_min_ivvt_adh_max /end DEF_CHARACTERISTIC
 /begin OUT_MEASUREMENT ivvt_in_1.struct_ctl_ivvt.cam_mdl_dif_ivvt ivvt_in_1.struct_ctl_ivvt.dly_ivvt ivvt_in_1.struct_ctl_ivvt.cam_mdl_ivvt ivvt_in_1.struct_ctl_ivvt.cam_mdl_dly_not_ivvt ivvt_in_1.struct_ctl_ivvt.cam_sp_dif_ivvt ivvt_in_1.struct_ctl_ivvt.t_ctl_i_ivvt ivvt_in_1.struct_ctl_ivvt.t_ctl_ivvt ivvt_in_1.struct_ctl_ivvt.t_ivvt ivvt_in_1.struct_ctl_ivvt.t_sum_ivvt ivvt_in_1.struct_ctl_ivvt.t_slv_ivvt ivvt_in_1.struct_ctl_ivvt.t_stop_adj_ivvt ivvt_in_1.struct_ctl_ivvt.t_act_ivvt ivvt_in_1.struct_ctl_ivvt.t_ctl_i_lim_ivvt ivvt_in_1.struct_ctl_ivvt.t_st_adj_ivvt ivvt_in_1.struct_ctl_ivvt.t_adj_old_ivvt ivvt_in_1.struct_ctl_ivvt.t_lim_ivvt ivvt_in_1.struct_ctl_ivvt.t_ctl_i_lim_1_ivvt ivvt_in_1.struct_ctl_ivvt.t_sum_tmp_ivvt ivvt_in_1.struct_ctl_ivvt.t_sum_subt_ivvt ivvt_in_1.struct_ctl_ivvt.t_adj_new_ivvt ivvt_in_1.struct_ctl_ivvt.t_sum_if_ivvt ivvt_in_1.struct_ctl_ivvt.cam_dif_ivvt ivvt_in_1.struct_ctl_ivvt.cam_clc_delta ivvt_in_1.struct_ctl_ivvt.lv_adj_pos_ivvt ivvt_in_1.struct_ctl_ivvt.lv_adj_chg_dir_ivvt ivvt_in_1.struct_ctl_ivvt.lv_hld_req_ivvt ivvt_in_1.struct_ctl_ivvt.lv_mdl_adc_ivvt ivvt_in_1.struct_ctl_ivvt.state_ivvt_pwm ivvt_in_1.struct_ctl_ivvt.state_ivvt_act ivvt_ex_1.struct_ctl_ivvt.cam_mdl_dif_ivvt ivvt_ex_1.struct_ctl_ivvt.dly_ivvt ivvt_ex_1.struct_ctl_ivvt.cam_mdl_ivvt ivvt_ex_1.struct_ctl_ivvt.cam_mdl_dly_not_ivvt ivvt_ex_1.struct_ctl_ivvt.cam_sp_dif_ivvt ivvt_ex_1.struct_ctl_ivvt.t_ctl_ivvt ivvt_ex_1.struct_ctl_ivvt.t_ctl_i_ivvt ivvt_ex_1.struct_ctl_ivvt.t_ivvt ivvt_ex_1.struct_ctl_ivvt.t_sum_ivvt ivvt_ex_1.struct_ctl_ivvt.t_slv_ivvt ivvt_ex_1.struct_ctl_ivvt.t_stop_adj_ivvt ivvt_ex_1.struct_ctl_ivvt.t_act_ivvt ivvt_ex_1.struct_ctl_ivvt.t_ctl_i_lim_ivvt ivvt_ex_1.struct_ctl_ivvt.t_st_adj_ivvt ivvt_ex_1.struct_ctl_ivvt.t_adj_old_ivvt ivvt_ex_1.struct_ctl_ivvt.t_lim_ivvt ivvt_ex_1.struct_ctl_ivvt.t_ctl_i_lim_1_ivvt ivvt_ex_1.struct_ctl_ivvt.t_sum_tmp_ivvt ivvt_ex_1.struct_ctl_ivvt.t_sum_subt_ivvt ivvt_ex_1.struct_ctl_ivvt.t_adj_new_ivvt ivvt_ex_1.struct_ctl_ivvt.t_sum_if_ivvt ivvt_ex_1.struct_ctl_ivvt.cam_dif_ivvt ivvt_ex_1.struct_ctl_ivvt.cam_clc_delta ivvt_ex_1.struct_ctl_ivvt.lv_adj_pos_ivvt ivvt_ex_1.struct_ctl_ivvt.lv_adj_chg_dir_ivvt ivvt_ex_1.struct_ctl_ivvt.lv_hld_req_ivvt ivvt_ex_1.struct_ctl_ivvt.lv_mdl_adc_ivvt ivvt_ex_1.struct_ctl_ivvt.state_ivvt_act ivvt_ex_1.struct_ctl_ivvt.state_ivvt_pwm /end OUT_MEASUREMENT
/end FUNCTION
/begin FUNCTION AUX_Adaptation_of_reference_and_ "_Adaptation of reference and non-reference edges"
 /begin DEF_CHARACTERISTIC c_cam_grd_ad_max_ivvt c_cam_grd_ad_max_st_ivvt c_crlc_ref_ivvt id_sum_cam_ad_ivvt c_cam_raw_dyw_ivvt_in c_crlc_cam_ad_ivvt c_crlc_cam_ad_st_ivvt c_t_min_ref_req_ivvt c_tco_add_cam_ref_ivvt c_cam_raw_dyw_ivvt_ex c_cyc_cam_pos_dly_park c_n_cam_ad_bol c_n_cam_ad_tol c_ctr_cam_ad_ivvt_max c_t_dly_cam_ad_ivvt c_cam_hys_ad_ivvt c_cam_hys_ref_ivvt c_cam_ini_in c_cam_ini_ex c_cam_dif_max_ivvt_park c_cam_drift_max_ivvt_park c_toil_min_diag_ivvt_park c_tco_min_diag_ivvt_park /end DEF_CHARACTERISTIC
 /begin OUT_MEASUREMENT lv_cam_ad_req_ivvt lv_cam_ad_di_ivvt lv_cam_ad_avl_ivvt lv_cam_ad_nvmy_vld ctr_cam_ad_ivvt tco_cam_ref_req_bol tco_cam_ref_req_tol lv_act_ivvt_park lv_is_ivvt_diag_park ivvt_in_1.struct_pos_ivvt.cam ivvt_in_1.struct_pos_ivvt.cam_ref_ivvt ivvt_in_1.struct_pos_ivvt.cam_ad_ivvt_0 ivvt_in_1.struct_pos_ivvt.cam_ref_dif_ivvt ivvt_in_1.struct_pos_ivvt.cam_raw_dyw_ivvt ivvt_in_1.struct_pos_ivvt.lv_cam_raw_dyw_ivvt ivvt_in_1.struct_pos_ivvt.cam_ref_raw ivvt_in_1.struct_pos_ivvt.cam_ad_ivvt_1 ivvt_in_1.struct_pos_ivvt.cam_ad_ivvt_2 ivvt_in_1.struct_pos_ivvt.cam_park ivvt_in_1.struct_pos_ivvt.ctr_cam_dif_ivvt_park ivvt_in_1.struct_pos_ivvt.ctr_cam_drift_ivvt_park ivvt_ex_1.struct_pos_ivvt.cam ivvt_ex_1.struct_pos_ivvt.cam_ref_ivvt ivvt_ex_1.struct_pos_ivvt.cam_ad_ivvt_0 ivvt_ex_1.struct_pos_ivvt.cam_ref_dif_ivvt ivvt_ex_1.struct_pos_ivvt.cam_raw_dyw_ivvt ivvt_ex_1.struct_pos_ivvt.lv_cam_raw_dyw_ivvt ivvt_ex_1.struct_pos_ivvt.cam_ref_raw ivvt_ex_1.struct_pos_ivvt.cam_ad_ivvt_1 ivvt_ex_1.struct_pos_ivvt.cam_ad_ivvt_2 ivvt_ex_1.struct_pos_ivvt.cam_park ivvt_ex_1.struct_pos_ivvt.ctr_cam_dif_ivvt_park ivvt_ex_1.struct_pos_ivvt.ctr_cam_drift_ivvt_park /end OUT_MEASUREMENT
/end FUNCTION
/end MODULE
/end PROJECT
