ASAP2_VERSION 1 41
/begin PROJECT MSD70 "Spray Guided DI-System with Piezo Injectors for 6-Cylinder"
/begin HEADER "_default_HeaderComment" PROJECT_NO _0B /end HEADER
/begin MODULE _default_ModuleName "_default_ModuleLongIdentifier"
/begin MOD_COMMON "_default_ModCommonComment" DEPOSIT ABSOLUTE BYTE_ORDER MSB_LAST ALIGNMENT_BYTE 1 ALIGNMENT_WORD 2 ALIGNMENT_LONG 2 ALIGNMENT_FLOAT32_IEEE 2 ALIGNMENT_FLOAT64_IEEE 4 /end MOD_COMMON
/begin AXIS_PTS ldpm_t_afl_cyc_hld_1_egcp "" 0xa1001b00 online_dummy _REC_AXS_20_u1 2.55 _CNV_A_R_LINEAR_____3_CM 8 0. 2.55 FORMAT "%4.2" /end AXIS_PTS
/begin AXIS_PTS ldpm_maf_kgh_1_egcp "" 0xa1001aa0 maf_kgh _REC_AXS_20_u2 2047.96875 _CNV_A_R_LINEAR_____207_CM 8 0. 2047.96875 FORMAT "%10.5" /end AXIS_PTS
/begin AXIS_PTS ldpm_maf_kgh_3_egcp "" 0xa1001ab4 maf_kgh _REC_AXS_20_u2 2047.96875 _CNV_A_R_LINEAR_____207_CM 6 0. 2047.96875 FORMAT "%10.5" /end AXIS_PTS
/begin CHARACTERISTIC c_ctr_icplsl_dec "Decrement of counter used to approximate emptying of WRAF sensor pumped oxygen reference" VALUE 0xa100204d _REC_VAL_20_u1 255. _CNV_A_R_LINEAR_____0_CM 0. 255. DISPLAY_IDENTIFIER C_CTR_ICPLSL_DEC FORMAT "%3.0" /end CHARACTERISTIC
/begin CHARACTERISTIC c_ctr_icplsl_inc "Increment of counter used to approximate filling of WRAF sensor pumped oxygen reference" VALUE 0xa100204e _REC_VAL_20_u1 255. _CNV_A_R_LINEAR_____0_CM 0. 255. DISPLAY_IDENTIFIER C_CTR_ICPLSL_INC FORMAT "%3.0" /end CHARACTERISTIC
/begin CHARACTERISTIC c_ctr_icplsl_thd "Threshold of counter used to approximate filling & emptying of WRAF sensor pumped oxygen reference" VALUE 0xa1002050 _REC_VAL_20_u2 65535. _CNV_A_R_LINEAR_____0_CM 0. 65535. DISPLAY_IDENTIFIER C_CTR_ICPLSL_THD FORMAT "%5.0" /end CHARACTERISTIC
/begin CHARACTERISTIC lc_icplsl_act "Boolean flag indicating whether upstream WRAF sensors are of type pumped-reference or not" VALUE 0xa10022e0 _REC_VAL_20_u1 1. _CNV_A_R_LINEAR_____0_CM 0. 1. DISPLAY_IDENTIFIER LC_ICPLSL_ACT FORMAT "%1.0" /end CHARACTERISTIC
/begin CHARACTERISTIC lc_icplsl_ena_lsl_if "Boolean flag permitting manual activation / deactivation of pumped-reference current (Icp)" VALUE 0xa10022e1 _REC_VAL_20_u1 1. _CNV_A_R_LINEAR_____0_CM 0. 1. DISPLAY_IDENTIFIER LC_ICPLSL_ENA_LSL_IF FORMAT "%1.0" /end CHARACTERISTIC
/begin CHARACTERISTIC lc_iplsl_ctl_ena_man_lsl_if "Boolean flag requesting activation / deactivation of pump current control during manual control" VALUE 0xa10022e3 _REC_VAL_20_u1 1. _CNV_A_R_LINEAR_____0_CM 0. 1. DISPLAY_IDENTIFIER LC_IPLSL_CTL_ENA_MAN_LSL_IF FORMAT "%1.0" /end CHARACTERISTIC
/begin AXIS_PTS ldp_lamb_sp_ip_r_it_iplsl "" 0xa1001908 online_dummy _REC_AXS_20_u2 31.9990234375 _CNV_A_R_LINEAR_____122_CM 8 0. 31.9990234375 FORMAT "%7.4" /end AXIS_PTS
/begin CHARACTERISTIC c_r_it_iplsl_agi_add "Additive ageing constant for WRAF sensor internal pump cell DC resistance" VALUE 0xa100216e _REC_VAL_20_u2 16383.75 _CNV_A_R_EGCP_LINEA_316_CM 0. 16383.75 DISPLAY_IDENTIFIER C_R_IT_IPLSL_AGI_ADD FORMAT "%9.2" /end CHARACTERISTIC
/begin CHARACTERISTIC c_icplsl_pwl_lsl_if "Configuration of pumping current for WRAF sensor oxygen reference  (Icp) during power latch phase" VALUE 0xa10020a7 _REC_VAL_20_u1 31. _CNV_A_R_LINEAR_____0_CM 0. 31. DISPLAY_IDENTIFIER C_ICPLSL_PWL_LSL_IF FORMAT "%2.0" /end CHARACTERISTIC
/begin CHARACTERISTIC c_vplsl_thd_vnlsl_lim "Pumping voltage (Vp) thrshold below which Icp cut-off /Vn overvoltage conditions are detected" VALUE 0xa10022d0 _REC_VAL_20_s1 6.422813 _CNV_A_R_EGCP_LINEA_317_CM -3.224 3.198813 DISPLAY_IDENTIFIER C_VPLSL_THD_VNLSL_LIM FORMAT "%5.2" /end CHARACTERISTIC
/begin CHARACTERISTIC c_ctr_iplsl_ctl_ena_nr_cyc "Number of cycles for pulsed activation of pump control" VALUE 0xa1002054 _REC_VAL_20_u1 255. _CNV_A_R_LINEAR_____0_CM 0. 255. DISPLAY_IDENTIFIER C_CTR_IPLSL_CTL_ENA_NR_CYC FORMAT "%3.0" /end CHARACTERISTIC
/begin CHARACTERISTIC c_ctr_iplsl_ctl_ena_pwm_on "Threshold for duration of \"Ip on\" phase during pulsed activation of pump current" VALUE 0xa1002056 _REC_VAL_20_u1 255. _CNV_A_R_LINEAR_____0_CM 0. 255. DISPLAY_IDENTIFIER C_CTR_IPLSL_CTL_ENA_PWM_ON FORMAT "%3.0" /end CHARACTERISTIC
/begin CHARACTERISTIC c_ctr_iplsl_ctl_ena_pwm_off "Threshold for duration of \"Ip off\" phase during pulsed activation of pump current" VALUE 0xa1002055 _REC_VAL_20_u1 255. _CNV_A_R_LINEAR_____0_CM 0. 255. DISPLAY_IDENTIFIER C_CTR_IPLSL_CTL_ENA_PWM_OFF FORMAT "%3.0" /end CHARACTERISTIC
/begin CHARACTERISTIC c_ttip_thd_iplsl_act_ls_up "Ceramic temperature above which Ip control loop may be activated" VALUE 0xa100224e _REC_VAL_20_s2 4095.9375 _CNV_A_R_LINEAR_____123_CM -2048. 2047.9375 DISPLAY_IDENTIFIER C_TTIP_THD_IPLSL_ACT_LS_UP FORMAT "%10.4" /end CHARACTERISTIC
/begin CHARACTERISTIC c_t_dly_iplsl_ctl_ena "Delay to be exceeded from switching on of pump current control to setting validity flag" VALUE 0xa10021ac _REC_VAL_20_u1 2.55 _CNV_A_R_LINEAR_____3_CM 0. 2.55 DISPLAY_IDENTIFIER C_T_DLY_IPLSL_CTL_ENA FORMAT "%4.2" /end CHARACTERISTIC
/begin CHARACTERISTIC c_t_dly_max_vnlsl_lim_act "Delay from determining Icp cut-off / Vn voltage to forced revokation of Ip control loop disable flag" VALUE 0xa10021b6 _REC_VAL_20_u2 655.35 _CNV_A_R_LINEAR_____3_CM 0. 655.35 DISPLAY_IDENTIFIER C_T_DLY_MAX_VNLSL_LIM_ACT FORMAT "%6.2" /end CHARACTERISTIC
/begin CHARACTERISTIC c_ttip_thd_icplsl_inc_ls_up "Ceramic temperature above which Ip can be switched to elevated values (warm sensor)" VALUE 0xa100224c _REC_VAL_20_s2 4095.9375 _CNV_A_R_LINEAR_____123_CM -2048. 2047.9375 DISPLAY_IDENTIFIER C_TTIP_THD_ICPLSL_INC_LS_UP FORMAT "%10.4" /end CHARACTERISTIC
/begin CHARACTERISTIC c_lamb_thd_max_vnlsl_lim "Maximum value of lambda threshold for Vn overvoltage / reverse Icp cut-off monitoring" VALUE 0xa1002104 _REC_VAL_20_u2 31.9990234375 _CNV_A_R_LINEAR_____122_CM 0. 31.9990234375 DISPLAY_IDENTIFIER C_LAMB_THD_MAX_VNLSL_LIM FORMAT "%7.4" /end CHARACTERISTIC
/begin CHARACTERISTIC c_lamb_thd_max_vplsl_lim "Maximum value of lambda threshold for Vp limitation" VALUE 0xa1002106 _REC_VAL_20_u2 31.9990234375 _CNV_A_R_LINEAR_____122_CM 0. 31.9990234375 DISPLAY_IDENTIFIER C_LAMB_THD_MAX_VPLSL_LIM FORMAT "%7.4" /end CHARACTERISTIC
/begin CHARACTERISTIC c_lamb_sp_min_iplsl_ctl_ena "Minimum value of lambda setpoint for activation of Ip control loop" VALUE 0xa10020fe _REC_VAL_20_u2 31.9990234375 _CNV_A_R_LINEAR_____122_CM 0. 31.9990234375 DISPLAY_IDENTIFIER C_LAMB_SP_MIN_IPLSL_CTL_ENA FORMAT "%7.4" /end CHARACTERISTIC
/begin CHARACTERISTIC c_lamb_sp_max_iplsl_ctl_ena "Maximum value of lambda setpoint for activation of Ip control loop" VALUE 0xa10020fc _REC_VAL_20_u2 31.9990234375 _CNV_A_R_LINEAR_____122_CM 0. 31.9990234375 DISPLAY_IDENTIFIER C_LAMB_SP_MAX_IPLSL_CTL_ENA FORMAT "%7.4" /end CHARACTERISTIC
/begin AXIS_PTS ldp_r_it_ls_up_ip_r_it_iplsl "" 0xa1001998 online_dummy _REC_AXS_20_u2 16383.75 _CNV_A_R_EGCP_LINEA_316_CM 8 0. 16383.75 FORMAT "%9.2" /end AXIS_PTS
/begin AXIS_PTS ldp_ttip_ls_ip_ctr_icplsl_thd "" 0xa1001a00 online_dummy _REC_AXS_20_u2 4095.9375 _CNV_A_R_EGCP_LINEA_315_CM 3 -2048. 2047.9375 FORMAT "%10.4" /end AXIS_PTS
/begin AXIS_PTS ldp_icplsl_ip_ctr_icplsl_thd "" 0xa10018ca online_dummy _REC_AXS_20_u1 31. _CNV_A_R_LINEAR_____0_CM 3 0. 31. FORMAT "%2.0" /end AXIS_PTS
/begin AXIS_PTS ldp_lamb_ip_icplsl_iplsl_ena "" 0xa10018f0 online_dummy _REC_AXS_20_u2 31.9990234375 _CNV_A_R_LINEAR_____122_CM 3 0. 31.9990234375 FORMAT "%7.4" /end AXIS_PTS
/begin AXIS_PTS ldp_lamb_sp_ip_icplsl_iplsl_di "" 0xa10018f8 online_dummy _REC_AXS_20_u2 31.9990234375 _CNV_A_R_LINEAR_____122_CM 3 0. 31.9990234375 FORMAT "%7.4" /end AXIS_PTS
/begin AXIS_PTS ldp_lamb_sp_ip_icplsl_wup "" 0xa1001900 online_dummy _REC_AXS_20_u2 31.9990234375 _CNV_A_R_LINEAR_____122_CM 3 0. 31.9990234375 FORMAT "%7.4" /end AXIS_PTS
/begin AXIS_PTS ldp_saf_kgh_ip_icplsl_iplsl_di "" 0xa10019d4 online_dummy _REC_AXS_20_u2 1023.984375 _CNV_A_R_LINEAR_____318_CM 3 0. 1023.984375 FORMAT "%11.6" /end AXIS_PTS
/begin AXIS_PTS ldp_saf_kgh_ip_icplsl_wup "" 0xa10019dc online_dummy _REC_AXS_20_u2 1023.984375 _CNV_A_R_LINEAR_____318_CM 3 0. 1023.984375 FORMAT "%11.6" /end AXIS_PTS
/begin CHARACTERISTIC ip_r_it_iplsl "Internal DC resistance of WRAF sensor pump cell" MAP 0xa1001dd8 _REC_MAP_20_u2_u2_u2 16383.75 _CNV_A_R_EGCP_LINEA_316_CM 0. 16383.75 DISPLAY_IDENTIFIER IP_R_IT_IPLSL FORMAT "%9.2"
 /begin AXIS_DESCR COM_AXIS online_dummy _CNV_A_R_EGCP_LINEA_316_CM 8 0. 16383.75 FORMAT "%9.2" AXIS_PTS_REF ldp_r_it_ls_up_ip_r_it_iplsl /end AXIS_DESCR
 /begin AXIS_DESCR COM_AXIS online_dummy _CNV_A_R_LINEAR_____122_CM 8 0. 31.9990234375 FORMAT "%7.4" AXIS_PTS_REF ldp_lamb_sp_ip_r_it_iplsl /end AXIS_DESCR
/end CHARACTERISTIC
/begin CHARACTERISTIC id_ctr_icplsl_thd "Variable threshold of counter used to approximate filling and emptying of WRAF sensor pumped reference area" MAP 0xa1001b54 _REC_MAP_20_u2_u2_u1 65535. _CNV_A_R_LINEAR_____0_CM 0. 65535. DISPLAY_IDENTIFIER ID_CTR_ICPLSL_THD FORMAT "%5.0"
 /begin AXIS_DESCR COM_AXIS online_dummy _CNV_A_R_EGCP_LINEA_315_CM 3 -2048. 2047.9375 FORMAT "%10.4" AXIS_PTS_REF ldp_ttip_ls_ip_ctr_icplsl_thd /end AXIS_DESCR
 /begin AXIS_DESCR COM_AXIS online_dummy _CNV_A_R_LINEAR_____0_CM 3 0. 31. FORMAT "%2.0" AXIS_PTS_REF ldp_icplsl_ip_ctr_icplsl_thd /end AXIS_DESCR
/end CHARACTERISTIC
/begin CHARACTERISTIC ip_lsl_if_icplsl_iplsl_ctl_ena "Configuration of current to pump reference air (Icp) with Ip control enabled" CURVE 0xa1001dd4 _REC_CUR_20_u1_u2 31. _CNV_A_R_LINEAR_____0_CM 0. 31. DISPLAY_IDENTIFIER IP_LSL_IF_ICPLSL_IPLSL_CTL_ENA FORMAT "%2.0"
 /begin AXIS_DESCR COM_AXIS online_dummy _CNV_A_R_LINEAR_____122_CM 3 0. 31.9990234375 FORMAT "%7.4" AXIS_PTS_REF ldp_lamb_ip_icplsl_iplsl_ena /end AXIS_DESCR
/end CHARACTERISTIC
/begin CHARACTERISTIC id_lsl_if_icplsl_iplsl_ctl_di "Configuration of current to pump reference air (Icp) with Ip control disabled and warm WRAF sensor" MAP 0xa1001b80 _REC_MAP_20_u1_u2_u2 31. _CNV_A_R_LINEAR_____0_CM 0. 31. DISPLAY_IDENTIFIER ID_LSL_IF_ICPLSL_IPLSL_CTL_DI FORMAT "%2.0"
 /begin AXIS_DESCR COM_AXIS online_dummy _CNV_A_R_LINEAR_____122_CM 3 0. 31.9990234375 FORMAT "%7.4" AXIS_PTS_REF ldp_lamb_sp_ip_icplsl_iplsl_di /end AXIS_DESCR
 /begin AXIS_DESCR COM_AXIS online_dummy _CNV_A_R_LINEAR_____318_CM 3 0. 1023.984375 FORMAT "%11.6" AXIS_PTS_REF ldp_saf_kgh_ip_icplsl_iplsl_di /end AXIS_DESCR
/end CHARACTERISTIC
/begin CHARACTERISTIC id_lsl_if_icplsl_wup "Configuration of current to pump reference air (Icp) with Ip control disabled and cold WRAF sensor" MAP 0xa1001b8c _REC_MAP_20_u1_u2_u2 31. _CNV_A_R_LINEAR_____0_CM 0. 31. DISPLAY_IDENTIFIER ID_LSL_IF_ICPLSL_WUP FORMAT "%2.0"
 /begin AXIS_DESCR COM_AXIS online_dummy _CNV_A_R_LINEAR_____122_CM 3 0. 31.9990234375 FORMAT "%7.4" AXIS_PTS_REF ldp_lamb_sp_ip_icplsl_wup /end AXIS_DESCR
 /begin AXIS_DESCR COM_AXIS online_dummy _CNV_A_R_LINEAR_____318_CM 3 0. 1023.984375 FORMAT "%11.6" AXIS_PTS_REF ldp_saf_kgh_ip_icplsl_wup /end AXIS_DESCR
/end CHARACTERISTIC
/begin CHARACTERISTIC c_r_it_iplsl_agi_fac "Multiplicative ageing factor for WRAF sensor internal pump cell DC resistance" VALUE 0xa1002170 _REC_VAL_20_u1 7.96875 _CNV_A_R_LINEAR_____184_CM 0. 7.96875 DISPLAY_IDENTIFIER C_R_IT_IPLSL_AGI_FAC FORMAT "%4.2" /end CHARACTERISTIC
/begin CHARACTERISTIC c_t_icplsl_dly_pwl "Delay time for limited Icp supply during ECU power latch" VALUE 0xa10021ce _REC_VAL_20_u2 655.35 _CNV_A_R_LINEAR_____3_CM 0. 655.35 DISPLAY_IDENTIFIER C_T_ICPLSL_DLY_PWL FORMAT "%6.2" /end CHARACTERISTIC
/begin CHARACTERISTIC c_t_iplsl_not_vld_vb_l_inc "Delay time for possible occurence of increased heater coupling due to permanent battery undervoltage" VALUE 0xa10021d2 _REC_VAL_20_u2 655.35 _CNV_A_R_LINEAR_____3_CM 0. 655.35 DISPLAY_IDENTIFIER C_T_IPLSL_NOT_VLD_VB_L_INC FORMAT "%6.2" /end CHARACTERISTIC
/begin CHARACTERISTIC c_t_iplsl_not_vld_vb_l_dec "Delay time for revocation of indicated increased heater coupling " VALUE 0xa10021d0 _REC_VAL_20_u2 655.35 _CNV_A_R_LINEAR_____3_CM 0. 655.35 DISPLAY_IDENTIFIER C_T_IPLSL_NOT_VLD_VB_L_DEC FORMAT "%6.2" /end CHARACTERISTIC
/begin CHARACTERISTIC c_vb_l_thd_iplsl_not_vld "Battery undervoltage threshold for possible increase of heater-coupling" VALUE 0xa1002270 _REC_VAL_20_u1 25.8984375 _CNV_A_R_LINEAR_____289_CM 0. 25.8984375 DISPLAY_IDENTIFIER C_VB_L_THD_IPLSL_NOT_VLD FORMAT "%9.6" /end CHARACTERISTIC
/begin CHARACTERISTIC lc_vb_l_sim_man "Switch for simulation of battery undervoltage which can be used for function testing" VALUE 0xa1002319 _REC_VAL_20_u1 1. _CNV_A_R_LINEAR_____0_CM 0. 1. DISPLAY_IDENTIFIER LC_VB_L_SIM_MAN FORMAT "%1.0" /end CHARACTERISTIC
/begin CHARACTERISTIC lc_iplsl_ctl_ena_man_swi_lsl_if "Boolean flag permitting manual activation / deactivation of pump current control" VALUE 0xa10022e4 _REC_VAL_20_u1 1. _CNV_A_R_LINEAR_____0_CM 0. 1. DISPLAY_IDENTIFIER LC_IPLSL_CTL_ENA_MAN_SWI_LSL_IF FORMAT "%1.0" /end CHARACTERISTIC
/begin CHARACTERISTIC c_vb_min_iplsl_ctl_ena "Threshold value of battery voltage for accurate operation of ATIC42" VALUE 0xa1002273 _REC_VAL_20_u1 25.8984375 _CNV_A_R_LINEAR_____289_CM 0. 25.8984375 DISPLAY_IDENTIFIER C_VB_MIN_IPLSL_CTL_ENA FORMAT "%9.6" /end CHARACTERISTIC
/begin CHARACTERISTIC lc_lsh_down[0] "Boolean variable to enable oxygen sensor heating" VALUE 0xa10022fc _REC_VAL_20_u1 1. _CNV_S_2_RANGE__0___1_CM 0. 1. DISPLAY_IDENTIFIER LC_LSH_DOWN[1] /end CHARACTERISTIC
/begin CHARACTERISTIC lc_lsh_down[1] "Boolean variable to enable oxygen sensor heating" VALUE 0xa10022fd _REC_VAL_20_u1 1. _CNV_S_2_RANGE__0___1_CM 0. 1. DISPLAY_IDENTIFIER LC_LSH_DOWN[2] /end CHARACTERISTIC
/begin MEASUREMENT lshpwm_up_man "Heater driver PWM duty cycle - manual adjustment via application system" UBYTE _CNV_A_R_LINEAR_____5_CM 1 100. 0. 99.609375 DISPLAY_IDENTIFIER LSHPWM_UP_MAN ECU_ADDRESS 0xc0001965 FORMAT "%9.6" /end MEASUREMENT
/begin MEASUREMENT v_efc_lsh_up_man "Effective output value of heater voltage via application system" UWORD _CNV_A_R_LINEAR_____140_CM 1 100. 0. 26. DISPLAY_IDENTIFIER V_EFC_LSH_UP_MAN ECU_ADDRESS 0xc000196a FORMAT "%7.4" /end MEASUREMENT
/begin CHARACTERISTIC lc_lsh_up[0] "Boolean variable to enable oxygen sensor heating" VALUE 0xa10022fe _REC_VAL_20_u1 1. _CNV_S_2_RANGE__0___1_CM 0. 1. DISPLAY_IDENTIFIER LC_LSH_UP[1] /end CHARACTERISTIC
/begin CHARACTERISTIC lc_lsh_up[1] "Boolean variable to enable oxygen sensor heating" VALUE 0xa10022ff _REC_VAL_20_u1 1. _CNV_S_2_RANGE__0___1_CM 0. 1. DISPLAY_IDENTIFIER LC_LSH_UP[2] /end CHARACTERISTIC
/begin CHARACTERISTIC lc_lsh_up_cll_ctl[0] "Boolean variable to enable closed loop oxygen sensor heater control" VALUE 0xa1002300 _REC_VAL_20_u1 1. _CNV_S_2_RANGE__0___1_CM 0. 1. DISPLAY_IDENTIFIER LC_LSH_UP_CLL_CTL[1] /end CHARACTERISTIC
/begin CHARACTERISTIC lc_lsh_up_cll_ctl[1] "Boolean variable to enable closed loop oxygen sensor heater control" VALUE 0xa1002301 _REC_VAL_20_u1 1. _CNV_S_2_RANGE__0___1_CM 0. 1. DISPLAY_IDENTIFIER LC_LSH_UP_CLL_CTL[2] /end CHARACTERISTIC
/begin CHARACTERISTIC lc_lshpwm_up_man_adj[0] "Boolean variable to enable oxygen sensor heating via application system" VALUE 0xa1002304 _REC_VAL_20_u1 1. _CNV_S_2_RANGE__0___1_CM 0. 1. DISPLAY_IDENTIFIER LC_LSHPWM_UP_MAN_ADJ[1] /end CHARACTERISTIC
/begin CHARACTERISTIC lc_lshpwm_up_man_adj[1] "Boolean variable to enable oxygen sensor heating via application system" VALUE 0xa1002305 _REC_VAL_20_u1 1. _CNV_S_2_RANGE__0___1_CM 0. 1. DISPLAY_IDENTIFIER LC_LSHPWM_UP_MAN_ADJ[2] /end CHARACTERISTIC
/begin CHARACTERISTIC c_inc_v_efc_man "Effective heater voltage increment to raise temperature via application system" VALUE 0xa10020a8 _REC_VAL_20_u1 1.625 _CNV_A_R_EGCP_LINEA_321_CM 0. 1.625 DISPLAY_IDENTIFIER C_INC_V_EFC_MAN FORMAT "%5.3" /end CHARACTERISTIC
/begin CHARACTERISTIC c_v_efc_man "Maximum permitted effective heater voltage via application system" VALUE 0xa100225e _REC_VAL_20_u1 26. _CNV_A_R_LINEAR_____36_CM 0. 26. DISPLAY_IDENTIFIER C_V_EFC_MAN FORMAT "%4.1" /end CHARACTERISTIC
/begin CHARACTERISTIC c_tam_max_lsl_gain_ad "Maximum ambient temperature to allow fuel cut Ip determination" VALUE 0xa100220c _REC_VAL_20_u1 190.5 _CNV_A_R_LINEAR_____16_CM -48. 142.5 DISPLAY_IDENTIFIER C_TAM_MAX_LSL_GAIN_AD FORMAT "%6.2" /end CHARACTERISTIC
/begin CHARACTERISTIC c_amp_min_lsl_gain_ad "Minimum ambient pressure to allow fuel cut Ip determination" VALUE 0xa1002028 _REC_VAL_20_u2 5434. _CNV_A_R_LINEAR_____26_CM 0. 5434. DISPLAY_IDENTIFIER C_AMP_MIN_LSL_GAIN_AD FORMAT "%7.2" /end CHARACTERISTIC
/begin CHARACTERISTIC c_tco_min_lsl_gain_ad "Minimum coolant temperature to allow fuel cut Ip determination" VALUE 0xa100221a _REC_VAL_20_u1 190.5 _CNV_A_R_LINEAR_____16_CM -48. 142.5 DISPLAY_IDENTIFIER C_TCO_MIN_LSL_GAIN_AD FORMAT "%6.2" /end CHARACTERISTIC
/begin CHARACTERISTIC c_ttip_max_lsl_gain_ad "Maximum tip temperature to allow fuel cut Ip determination" VALUE 0xa100223e _REC_VAL_20_s2 4095.9375 _CNV_A_R_LINEAR_____123_CM -2048. 2047.9375 DISPLAY_IDENTIFIER C_TTIP_MAX_LSL_GAIN_AD FORMAT "%10.4" /end CHARACTERISTIC
/begin CHARACTERISTIC c_ttip_min_lsl_gain_ad "Minimum tip temperature to allow fuel cut Ip determination" VALUE 0xa1002244 _REC_VAL_20_s2 4095.9375 _CNV_A_R_LINEAR_____123_CM -2048. 2047.9375 DISPLAY_IDENTIFIER C_TTIP_MIN_LSL_GAIN_AD FORMAT "%10.4" /end CHARACTERISTIC
/begin CHARACTERISTIC c_n_32_min_lsl_gain_ad "Minimum engine speed to allow fuel cut Ip determination" VALUE 0xa100215a _REC_VAL_20_u1 8160. _CNV_A_R_LINEAR_____9_CM 0. 8160. DISPLAY_IDENTIFIER C_N_32_MIN_LSL_GAIN_AD FORMAT "%4.0" /end CHARACTERISTIC
/begin CHARACTERISTIC c_crlc_iplsl_cor_fcut "Correlation constant for filtering of corrected pumping current " VALUE 0xa1002030 _REC_VAL_20_u2 0.9999847412109381 _CNV_A_R_LINEAR_____68_CM 0. 0.9999847412109381 DISPLAY_IDENTIFIER C_CRLC_IPLSL_COR_FCUT FORMAT "%7.5" /end CHARACTERISTIC
/begin CHARACTERISTIC c_crlc_iplsl_mv_vld "Correlation constant for filtering of valid Ip samples (is also time constant for adaptation)" VALUE 0xa1002032 _REC_VAL_20_u2 0.9999847412109381 _CNV_A_R_LINEAR_____68_CM 0. 0.9999847412109381 DISPLAY_IDENTIFIER C_CRLC_IPLSL_MV_VLD FORMAT "%7.5" /end CHARACTERISTIC
/begin CHARACTERISTIC c_iplsl_vari_thd_max_purge "Maximum variance of the low pass filtered pumping current to confirm stable conditions " VALUE 0xa10020b4 _REC_VAL_20_u4 634.636864 _CNV_A_R_EGCP_LINEA_325_CM 0. 634.636864 DISPLAY_IDENTIFIER C_IPLSL_VARI_THD_MAX_PURGE FORMAT "%11.6" /end CHARACTERISTIC
/begin CHARACTERISTIC c_iplsl_vari_thd_min_purge "Minimum variance of the low pass filtered pumping current to confirm that sensor is operable" VALUE 0xa10020b8 _REC_VAL_20_u4 634.636864 _CNV_A_R_EGCP_LINEA_325_CM 0. 634.636864 DISPLAY_IDENTIFIER C_IPLSL_VARI_THD_MIN_PURGE FORMAT "%11.6" /end CHARACTERISTIC
/begin CHARACTERISTIC c_iplsl_cor_grd_thd_fcut "Maximum gradient of low pass filtered pumping correct to detect stable conditions (end of PURGE)" VALUE 0xa10020aa _REC_VAL_20_s2 25.191 _CNV_A_R_LINEAR_____326_CM -12.596 12.595 DISPLAY_IDENTIFIER C_IPLSL_COR_GRD_THD_FCUT FORMAT "%8.4" /end CHARACTERISTIC
/begin CHARACTERISTIC c_fac_iplsl_cor_thd_fcut "Factor for minimum threshold of the low pass filtered pumping current to detect stable conditions (end of PURGE)" VALUE 0xa100208c _REC_VAL_20_u1 0.99609375 _CNV_A_R_LINEAR_____27_CM 0. 0.99609375 DISPLAY_IDENTIFIER C_FAC_IPLSL_COR_THD_FCUT FORMAT "%5.3" /end CHARACTERISTIC
/begin CHARACTERISTIC c_fac_lsl_gain_ad_lim_max "Maximum threshold for WRAF sensor gain adaptation" VALUE 0xa1002092 _REC_VAL_20_u2 1.99996948242188 _CNV_A_R_LINEAR_____8_CM 0. 1.99996948242188 DISPLAY_IDENTIFIER C_FAC_LSL_GAIN_AD_LIM_MAX FORMAT "%7.5" /end CHARACTERISTIC
/begin CHARACTERISTIC c_fac_lsl_gain_ad_lim_min "Minimum threshold for WRAF sensor gain adaptation" VALUE 0xa1002094 _REC_VAL_20_u2 1.99996948242188 _CNV_A_R_LINEAR_____8_CM 0. 1.99996948242188 DISPLAY_IDENTIFIER C_FAC_LSL_GAIN_AD_LIM_MIN FORMAT "%7.5" /end CHARACTERISTIC
/begin CHARACTERISTIC c_iplsl_mv_vld_vari_max "Maximum permitted variance of valid Ip sample to allow adaptation" VALUE 0xa10020ae _REC_VAL_20_u4 634.636864 _CNV_A_R_EGCP_LINEA_325_CM 0. 634.636864 DISPLAY_IDENTIFIER C_IPLSL_MV_VLD_VARI_MAX FORMAT "%11.6" /end CHARACTERISTIC
/begin CHARACTERISTIC c_nr_gear_min_lsl_gain_ad "Minimum gear to allow fuel cut Ip determination" VALUE 0xa100216a _REC_VAL_20_u1 255. _CNV_A_R_LINEAR_____0_CM 0. 255. DISPLAY_IDENTIFIER C_NR_GEAR_MIN_LSL_GAIN_AD FORMAT "%3.0" /end CHARACTERISTIC
/begin CHARACTERISTIC lc_fac_lsl_gain_ad_lim_rst "Switch for reset of adaptation factor to one when exceeding thresholds, or for adoption of threshold value, resp." VALUE 0xa10022de _REC_VAL_20_u1 1. _CNV_A_R_LINEAR_____0_CM 0. 1. DISPLAY_IDENTIFIER LC_FAC_LSL_GAIN_AD_LIM_RST FORMAT "%1.0" /end CHARACTERISTIC
/begin CHARACTERISTIC lc_fac_lsl_gain_ad_ena "Enable adoption of WRAF sensor gain adaptation factor" VALUE 0xa10022dd _REC_VAL_20_u1 1. _CNV_A_R_LINEAR_____0_CM 0. 1. DISPLAY_IDENTIFIER LC_FAC_LSL_GAIN_AD_ENA FORMAT "%1.0" /end CHARACTERISTIC
/begin CHARACTERISTIC lc_map_puc_lim_act_not_vld "Flag to ignore activation of limitation of MAP during PUC by torque management" VALUE 0xa100230d _REC_VAL_20_u1 1. _CNV_A_R_LINEAR_____0_CM 0. 1. DISPLAY_IDENTIFIER LC_MAP_PUC_LIM_ACT_NOT_VLD FORMAT "%1.0" /end CHARACTERISTIC
/begin CHARACTERISTIC lc_lsl_gain_ad_test "Manual enable of LV_LSL_GAIN_AD_REQ_i for test purposes" VALUE 0xa1002309 _REC_VAL_20_u1 1. _CNV_A_R_LINEAR_____0_CM 0. 1. DISPLAY_IDENTIFIER LC_LSL_GAIN_AD_TEST FORMAT "%1.0" /end CHARACTERISTIC
/begin AXIS_PTS ldp_amp_ip_fac_cor_iplsl_amp "" 0xa100189c amp _REC_AXS_20_u2 5434. _CNV_A_R_LINEAR_____26_CM 12 0. 5434. FORMAT "%7.2" /end AXIS_PTS
/begin AXIS_PTS ldp_maf_kgh_ip_fac_cor_iplsl "" 0xa1001934 maf_kgh _REC_AXS_20_u2 2047.96875 _CNV_A_R_LINEAR_____207_CM 12 0. 2047.96875 FORMAT "%10.5" /end AXIS_PTS
/begin AXIS_PTS ldp_n_32_ip_fac_cor_iplsl "" 0xa1001964 n_32 _REC_AXS_20_u1 8160. _CNV_A_R_LINEAR_____9_CM 16 0. 8160. FORMAT "%4.0" /end AXIS_PTS
/begin AXIS_PTS ldp_ttip_mes_ls_up_ip_fac_iplsl "" 0xa1001a1c online_dummy _REC_AXS_20_u2 4095.9375 _CNV_A_R_EGCP_LINEA_315_CM 8 -2048. 2047.9375 FORMAT "%10.4" /end AXIS_PTS
/begin AXIS_PTS ldp_iplsl_chg_purge_ip_iplsl "" 0xa10018d0 online_dummy _REC_AXS_20_u2 25.191 _CNV_A_R_EGCP_LINEA_327_CM 4 -12.596 12.595 FORMAT "%8.4" /end AXIS_PTS
/begin CHARACTERISTIC ip_fac_cor_iplsl_amp "Factor for AMP correction" CURVE 0xa1001bd0 _REC_CUR_20_u2_u2 1.99996948242188 _CNV_A_R_LINEAR_____8_CM 0. 1.99996948242188 DISPLAY_IDENTIFIER IP_FAC_COR_IPLSL_AMP FORMAT "%7.5"
 /begin AXIS_DESCR COM_AXIS amp _CNV_A_R_LINEAR_____26_CM 12 0. 5434. FORMAT "%7.2" AXIS_PTS_REF ldp_amp_ip_fac_cor_iplsl_amp /end AXIS_DESCR
/end CHARACTERISTIC
/begin CHARACTERISTIC ip_fac_cor_iplsl_maf_kgh "Factor for MAF correction" CURVE 0xa1001bf0 _REC_CUR_20_u2_u2 1.99996948242188 _CNV_A_R_LINEAR_____8_CM 0. 1.99996948242188 DISPLAY_IDENTIFIER IP_FAC_COR_IPLSL_MAF_KGH FORMAT "%7.5"
 /begin AXIS_DESCR COM_AXIS maf_kgh _CNV_A_R_LINEAR_____207_CM 12 0. 2047.96875 FORMAT "%10.5" AXIS_PTS_REF ldp_maf_kgh_ip_fac_cor_iplsl /end AXIS_DESCR
/end CHARACTERISTIC
/begin CHARACTERISTIC ip_fac_cor_iplsl_n_32 "Factor for engine speed correction" CURVE 0xa1001c08 _REC_CUR_20_u2_u1 1.99996948242188 _CNV_A_R_LINEAR_____8_CM 0. 1.99996948242188 DISPLAY_IDENTIFIER IP_FAC_COR_IPLSL_N_32 FORMAT "%7.5"
 /begin AXIS_DESCR COM_AXIS n_32 _CNV_A_R_LINEAR_____9_CM 16 0. 8160. FORMAT "%4.0" AXIS_PTS_REF ldp_n_32_ip_fac_cor_iplsl /end AXIS_DESCR
/end CHARACTERISTIC
/begin CHARACTERISTIC ip_fac_cor_iplsl_ttip_mes_ls_up "Factor for tip temperature correction" CURVE 0xa1001c48 _REC_CUR_20_u2_u2 1.99996948242188 _CNV_A_R_LINEAR_____8_CM 0. 1.99996948242188 DISPLAY_IDENTIFIER IP_FAC_COR_IPLSL_TTIP_MES_LS_UP FORMAT "%7.5"
 /begin AXIS_DESCR COM_AXIS online_dummy _CNV_A_R_EGCP_LINEA_315_CM 8 -2048. 2047.9375 FORMAT "%10.4" AXIS_PTS_REF ldp_ttip_mes_ls_up_ip_fac_iplsl /end AXIS_DESCR
/end CHARACTERISTIC
/begin CHARACTERISTIC ip_fac_cor_iplsl_chg_purge "Factor for residual gas after purging correction" CURVE 0xa1001be8 _REC_CUR_20_u2_u2 1.99996948242188 _CNV_A_R_LINEAR_____8_CM 0. 1.99996948242188 DISPLAY_IDENTIFIER IP_FAC_COR_IPLSL_CHG_PURGE FORMAT "%7.5"
 /begin AXIS_DESCR COM_AXIS online_dummy _CNV_A_R_EGCP_LINEA_327_CM 4 -12.596 12.595 FORMAT "%8.4" AXIS_PTS_REF ldp_iplsl_chg_purge_ip_iplsl /end AXIS_DESCR
/end CHARACTERISTIC
/begin MEASUREMENT lv_map_puc_lim_req_lsl_gain_ad "Status flag for request of limitation of MAP during next PUC phase from torque management" UBYTE _CNV_S_2_RANGE__0___1_CM 1 100. 0. 1. DISPLAY_IDENTIFIER LV_MAP_PUC_LIM_REQ_LSL_GAIN_AD ECU_ADDRESS 0xd0002da7 BIT_MASK 0x1 /end MEASUREMENT
/begin CHARACTERISTIC lc_lsl_gain_ad_ena "Enable WRAF sensor gain adaptation" VALUE 0xa1002307 _REC_VAL_20_u1 1. _CNV_A_R_LINEAR_____0_CM 0. 1. DISPLAY_IDENTIFIER LC_LSL_GAIN_AD_ENA FORMAT "%1.0" /end CHARACTERISTIC
/begin CHARACTERISTIC lc_fac_lsl_gain_ad_man_adj_ena "Enable manual adjustment of WRAF sensor gain adaptation factor" VALUE 0xa10022df _REC_VAL_20_u1 1. _CNV_A_R_LINEAR_____0_CM 0. 1. DISPLAY_IDENTIFIER LC_FAC_LSL_GAIN_AD_MAN_ADJ_ENA FORMAT "%1.0" /end CHARACTERISTIC
/begin CHARACTERISTIC c_iplsl_nom_purge "Nominal pumping current at fuel cut " VALUE 0xa10020b2 _REC_VAL_20_s2 25.191 _CNV_A_R_LINEAR_____328_CM -12.596 12.595 DISPLAY_IDENTIFIER C_IPLSL_NOM_PURGE FORMAT "%8.4" /end CHARACTERISTIC
/begin CHARACTERISTIC c_fac_lsl_gain_ad_man_adj "Value for manual adjustment of WRAF sensor gain adaptation factor" VALUE 0xa1002096 _REC_VAL_20_u2 1.99996948242188 _CNV_A_R_LINEAR_____8_CM 0. 1.99996948242188 DISPLAY_IDENTIFIER C_FAC_LSL_GAIN_AD_MAN_ADJ FORMAT "%7.5" /end CHARACTERISTIC
/begin CHARACTERISTIC c_n_32_max_lsl_gain_ad "Maximum engine speed to allow fuel cut Ip determination" VALUE 0xa1002159 _REC_VAL_20_u1 8160. _CNV_A_R_LINEAR_____9_CM 0. 8160. DISPLAY_IDENTIFIER C_N_32_MAX_LSL_GAIN_AD FORMAT "%4.0" /end CHARACTERISTIC
/begin CHARACTERISTIC c_t_acq_iplsl_purge "Duration of Ip acquisition and averaging" VALUE 0xa100217a _REC_VAL_20_u1 25.4 _CNV_A_R_LINEAR_____4_CM 0.1 25.5 DISPLAY_IDENTIFIER C_T_ACQ_IPLSL_PURGE FORMAT "%4.1" /end CHARACTERISTIC
/begin CHARACTERISTIC c_t_dly_iplsl_cor_mmv_fcut_vld "Delay time for retry of gain adaptation upon detection of possible saturation effects on Ip measurement" VALUE 0xa10021ab _REC_VAL_20_u1 25.4 _CNV_A_R_LINEAR_____4_CM 0.1 25.5 DISPLAY_IDENTIFIER C_T_DLY_IPLSL_COR_MMV_FCUT_VLD FORMAT "%4.1" /end CHARACTERISTIC
/begin CHARACTERISTIC lc_map_puc_lim_req_lsl_gain_ad "Enable request to torque management for limitation of MAP during PUC" VALUE 0xa100230e _REC_VAL_20_u1 1. _CNV_A_R_LINEAR_____0_CM 0. 1. DISPLAY_IDENTIFIER LC_MAP_PUC_LIM_REQ_LSL_GAIN_AD FORMAT "%1.0" /end CHARACTERISTIC
/begin CHARACTERISTIC lc_iplsl_gain_sel_lsl_gain_ad "Determines which Ip gain has to be active during execution of gain adaptation ( '0' = gain8, '1' = gain16 )" VALUE 0xa10022e5 _REC_VAL_20_u1 1. _CNV_A_R_LINEAR_____0_CM 0. 1. DISPLAY_IDENTIFIER LC_IPLSL_GAIN_SEL_LSL_GAIN_AD FORMAT "%1.0" /end CHARACTERISTIC
/begin CHARACTERISTIC c_n_32_bol_lsl_gain_ad "Additional bottom limit above which  fuel cut Ip determination is allowed to take place" VALUE 0xa1002158 _REC_VAL_20_u1 8160. _CNV_A_R_LINEAR_____9_CM 0. 8160. DISPLAY_IDENTIFIER C_N_32_BOL_LSL_GAIN_AD FORMAT "%4.0" /end CHARACTERISTIC
/begin CHARACTERISTIC c_n_32_tol_lsl_gain_ad "Additional top limit below which  fuel cut Ip determination is allowed to take place" VALUE 0xa100215b _REC_VAL_20_u1 8160. _CNV_A_R_LINEAR_____9_CM 0. 8160. DISPLAY_IDENTIFIER C_N_32_TOL_LSL_GAIN_AD FORMAT "%4.0" /end CHARACTERISTIC
/begin CHARACTERISTIC lc_lsl_gain_ad_ena_all_opm "Logical constant to enable gain adaption in all engine operation modes" VALUE 0xa1002308 _REC_VAL_20_u1 1. _CNV_A_R_LINEAR_____0_CM 0. 1. DISPLAY_IDENTIFIER LC_LSL_GAIN_AD_ENA_ALL_OPM FORMAT "%1.0" /end CHARACTERISTIC
/begin MEASUREMENT egcp[0].egcp_struct_acctlifa0.ctr_icplsl "Counter used to approximate filling & emptying of WRAF sensor pumped reference area" UWORD _CNV_A_R_LINEAR_____0_CM 1 100. 0. 65535. DISPLAY_IDENTIFIER CTR_ICPLSL[1] ECU_ADDRESS 0xd0001900 FORMAT "%5.0" /end MEASUREMENT
/begin MEASUREMENT egcp[0].egcp_struct_acctlifa0.ctr_icplsl_max "Delay for filling and emptying of WRAF sensor pumped reference area" UWORD _CNV_A_R_LINEAR_____0_CM 1 100. 0. 65535. DISPLAY_IDENTIFIER CTR_ICPLSL_MAX[1] ECU_ADDRESS 0xd0001902 FORMAT "%5.0" /end MEASUREMENT
/begin MEASUREMENT egcp[0].egcp_struct_acctlifa0.t_icplsl_dly_pwl "Delay timer for limited Icp supply during ECU power latch" UWORD _CNV_A_R_LINEAR_____3_CM 1 100. 0. 655.35 DISPLAY_IDENTIFIER T_ICPLSL_DLY_PWL[1] ECU_ADDRESS 0xd0001904 FORMAT "%6.2" /end MEASUREMENT
/begin MEASUREMENT egcp[0].egcp_struct_acctlifa0.lamb_thd_vplsl_lim "Threshold for Vp limitation in terms of lambda" UWORD _CNV_A_R_LINEAR_____122_CM 1 100. 0. 31.9990234375 DISPLAY_IDENTIFIER LAMB_THD_VPLSL_LIM[1] ECU_ADDRESS 0xd0001906 FORMAT "%7.4" /end MEASUREMENT
/begin MEASUREMENT egcp[0].egcp_struct_acctlifa0.lamb_thd_tmp_vplsl_lim "Intermediate storage variable of threshold for Vp limitation in terms of lambda" UWORD _CNV_A_R_LINEAR_____122_CM 1 100. 0. 31.9990234375 DISPLAY_IDENTIFIER LAMB_THD_TMP_VPLSL_LIM[1] ECU_ADDRESS 0xd0001908 FORMAT "%7.4" /end MEASUREMENT
/begin MEASUREMENT egcp[0].egcp_struct_acctlifa0.t_dly_vnlsl_lim_act "Timer for limitation of duration of Ip control loop inhibition due to Icp cut-off / Vn overvoltage conditions" UWORD _CNV_A_R_LINEAR_____3_CM 1 100. 0. 655.35 DISPLAY_IDENTIFIER T_DLY_VNLSL_LIM_ACT[1] ECU_ADDRESS 0xd000190a FORMAT "%6.2" /end MEASUREMENT
/begin MEASUREMENT egcp[0].egcp_struct_acctlifa0.t_iplsl_not_vld_vb_l "Delay timer for possible occurence of increased heater coupling due to permanent battery undervoltage" UWORD _CNV_A_R_LINEAR_____3_CM 1 100. 0. 655.35 DISPLAY_IDENTIFIER T_IPLSL_NOT_VLD_VB_L[1] ECU_ADDRESS 0xd000190c FORMAT "%6.2" /end MEASUREMENT
/begin MEASUREMENT egcp[0].egcp_struct_acctlifa0.t_iplsl_not_vld_vb_l_thd "Upper limit of delay timer for possible occurence of increased heater coupling" UWORD _CNV_A_R_LINEAR_____3_CM 1 100. 0. 655.35 DISPLAY_IDENTIFIER T_IPLSL_NOT_VLD_VB_L_THD[1] ECU_ADDRESS 0xd000190e FORMAT "%6.2" /end MEASUREMENT
/begin MEASUREMENT egcp[0].egcp_struct_acctlifa0.r_it_iplsl "Internal DC resistance of WRAF sensor pump cell" UWORD _CNV_A_R_EGCP_LINEA_316_CM 1 100. 0. 16383.75 DISPLAY_IDENTIFIER R_IT_IPLSL[1] ECU_ADDRESS 0xd0001910 FORMAT "%9.2" /end MEASUREMENT
/begin MEASUREMENT egcp[0].egcp_struct_acctlifa0.vplsl "Voltage across WRAF sensor pump cell (VIP-VG)" SBYTE _CNV_A_R_EGCP_LINEA_317_CM 1 100. -3.224 3.198813 DISPLAY_IDENTIFIER VPLSL[1] ECU_ADDRESS 0xd0001912 FORMAT "%5.2" /end MEASUREMENT
/begin MEASUREMENT egcp[0].egcp_struct_acctlifa0.t_dly_iplsl_ctl_ena "Delay timer for validation of Ip after enabling of Ip control loop" UBYTE _CNV_A_R_LINEAR_____3_CM 1 100. 0. 2.55 DISPLAY_IDENTIFIER T_DLY_IPLSL_CTL_ENA[1] ECU_ADDRESS 0xd0001913 FORMAT "%4.2" /end MEASUREMENT
/begin MEASUREMENT egcp[0].egcp_struct_acctlifa0.icplsl_lsl_if "Value of the pumping current for filling of WRAF sensor oxygen reference (Icp)" UBYTE _CNV_A_R_LINEAR_____0_CM 1 100. 0. 31. DISPLAY_IDENTIFIER ICPLSL_LSL_IF[1] ECU_ADDRESS 0xd0001914 FORMAT "%2.0" /end MEASUREMENT
/begin MEASUREMENT egcp[0].egcp_struct_acctlifa0.ctr_iplsl_ctl_ena_nr_cyc "Cycle counter for pulsed activation of pump current" UBYTE _CNV_A_R_LINEAR_____0_CM 1 100. 0. 255. DISPLAY_IDENTIFIER CTR_IPLSL_CTL_ENA_NR_CYC[1] ECU_ADDRESS 0xd0001915 FORMAT "%3.0" /end MEASUREMENT
/begin MEASUREMENT egcp[0].egcp_struct_acctlifa0.ctr_iplsl_ctl_ena_pwm_on "Counter for duration of \" Ip on \" phase during pulsed activation of pump current " UBYTE _CNV_A_R_LINEAR_____0_CM 1 100. 0. 255. DISPLAY_IDENTIFIER CTR_IPLSL_CTL_ENA_PWM_ON[1] ECU_ADDRESS 0xd0001916 FORMAT "%3.0" /end MEASUREMENT
/begin MEASUREMENT egcp[0].egcp_struct_acctlifa0.ctr_iplsl_ctl_ena_pwm_off "Counter for duration of \" Ip off \" phase during pulsed activation of pump current " UBYTE _CNV_A_R_LINEAR_____0_CM 1 100. 0. 255. DISPLAY_IDENTIFIER CTR_IPLSL_CTL_ENA_PWM_OFF[1] ECU_ADDRESS 0xd0001917 FORMAT "%3.0" /end MEASUREMENT
/begin MEASUREMENT egcp[0].egcp_struct_acctlifa0.lv_icplsl_ena_lsl_if "Boolean flag requesting activation / deactivation of pumped-reference pumping current (Icp)" UBYTE _CNV_S_2_RANGE__0___1_CM 1 100. 0. 1. DISPLAY_IDENTIFIER LV_ICPLSL_ENA_LSL_IF[1] ECU_ADDRESS 0xd0001918 BIT_MASK 0x1 /end MEASUREMENT
/begin MEASUREMENT egcp[0].egcp_struct_acctlifa0.lv_icplsl_vld "Boolean flag indicating that WRAF pumped reference is filled" UBYTE _CNV_S_2_RANGE__0___1_CM 1 100. 0. 1. DISPLAY_IDENTIFIER LV_ICPLSL_VLD[1] ECU_ADDRESS 0xd0001919 BIT_MASK 0x1 /end MEASUREMENT
/begin MEASUREMENT egcp[0].egcp_struct_acctlifa0.lv_iplsl_ctl_ena_lsl_if "Boolean flag requesting activation / deactivation of pump current (Ip) Controller" UBYTE _CNV_S_2_RANGE__0___1_CM 1 100. 0. 1. DISPLAY_IDENTIFIER LV_IPLSL_CTL_ENA_LSL_IF[1] ECU_ADDRESS 0xd000191a BIT_MASK 0x1 /end MEASUREMENT
/begin MEASUREMENT egcp[0].egcp_struct_acctlifa0.lv_iplsl_ctl_inh_vplsl_lim "Boolean flag indicating that pump current control is inhibited by active active pumping voltage (Vp) limitation conditions" UBYTE _CNV_S_2_RANGE__0___1_CM 1 100. 0. 1. DISPLAY_IDENTIFIER LV_IPLSL_CTL_INH_VPLSL_LIM[1] ECU_ADDRESS 0xd000191b BIT_MASK 0x1 /end MEASUREMENT
/begin MEASUREMENT egcp[0].egcp_struct_acctlifa0.lv_iplsl_vld "Boolean flag indicating that WRAF sensor pump current is valid" UBYTE _CNV_S_2_RANGE__0___1_CM 1 100. 0. 1. DISPLAY_IDENTIFIER LV_IPLSL_VLD[1] ECU_ADDRESS 0xd000191c BIT_MASK 0x1 /end MEASUREMENT
/begin MEASUREMENT egcp[0].egcp_struct_acctlifa0.lv_iplsl_ctl_ena_pls_act "Boolean flag indicating that pulsed activation of pump current is active" UBYTE _CNV_S_2_RANGE__0___1_CM 1 100. 0. 1. DISPLAY_IDENTIFIER LV_IPLSL_CTL_ENA_PLS_ACT[1] ECU_ADDRESS 0xd000191d BIT_MASK 0x1 /end MEASUREMENT
/begin MEASUREMENT egcp[0].egcp_struct_acctlifa0.lv_lamb_ls_up_vld "Boolean flag indicating that lambda signal from WRAF system is reliable and up-to-date" UBYTE _CNV_S_2_RANGE__0___1_CM 1 100. 0. 1. DISPLAY_IDENTIFIER LV_LAMB_LS_UP_VLD[1] ECU_ADDRESS 0xd000191e BIT_MASK 0x1 /end MEASUREMENT
/begin MEASUREMENT egcp[0].egcp_struct_acctlifa0.lv_iplsl_ctl_inh_vnlsl_lim "Boolean flag indicating that pump current control is inhibited by active Icp cut-off / Vn overvoltage conditions" UBYTE _CNV_S_2_RANGE__0___1_CM 1 100. 0. 1. DISPLAY_IDENTIFIER LV_IPLSL_CTL_INH_VNLSL_LIM[1] ECU_ADDRESS 0xd000191f BIT_MASK 0x1 /end MEASUREMENT
/begin MEASUREMENT egcp[0].egcp_struct_acctlifa0.lv_vplsl_lim_act "Boolean flag indicating active pumping voltage (Vp) limitation conditions" UBYTE _CNV_S_2_RANGE__0___1_CM 1 100. 0. 1. DISPLAY_IDENTIFIER LV_VPLSL_LIM_ACT[1] ECU_ADDRESS 0xd0001920 BIT_MASK 0x1 /end MEASUREMENT
/begin MEASUREMENT egcp[0].egcp_struct_acctlifa0.lv_iplsl_not_vld_vb_l "Boolean flag indicating that increased heater-coupling due to permanent battery undervoltage might be present" UBYTE _CNV_S_2_RANGE__0___1_CM 1 100. 0. 1. DISPLAY_IDENTIFIER LV_IPLSL_NOT_VLD_VB_L[1] ECU_ADDRESS 0xd0001921 BIT_MASK 0x1 /end MEASUREMENT
/begin MEASUREMENT egcp[0].egcp_struct_acctllshdi0.temp_ini_ls_down "Oxygen sensor temperature at start" SWORD _CNV_A_R_LINEAR_____123_CM 1 100. -2048. 2047.9375 DISPLAY_IDENTIFIER TEMP_INI_LS_DOWN[1] ECU_ADDRESS 0xd0001932 FORMAT "%10.4" /end MEASUREMENT
/begin MEASUREMENT egcp[0].egcp_struct_acctllshdi0.lshpwm_ext_ls_down "Downstream heater PWM duty cycle preset from external tester" UBYTE _CNV_A_R_LINEAR_____5_CM 1 100. 0. 99.609375 DISPLAY_IDENTIFIER LSHPWM_EXT_LS_DOWN[1] ECU_ADDRESS 0xd0001934 FORMAT "%9.6" /end MEASUREMENT
/begin MEASUREMENT egcp[0].egcp_struct_acctllshdi0.lv_inh_lsh_down "Boolean flag indicating project specific application conditions for heating not met" UBYTE _CNV_S_2_RANGE__0___1_CM 1 100. 0. 1. DISPLAY_IDENTIFIER LV_INH_LSH_DOWN[1] ECU_ADDRESS 0xd0001935 BIT_MASK 0x1 /end MEASUREMENT
/begin MEASUREMENT egcp[0].egcp_struct_acctllshi0.temp_ini_ls_up "Oxygen sensor temperature at engine start" SWORD _CNV_A_R_LINEAR_____123_CM 1 100. -2048. 2047.9375 DISPLAY_IDENTIFIER TEMP_INI_LS_UP[1] ECU_ADDRESS 0xd0001936 FORMAT "%10.4" /end MEASUREMENT
/begin MEASUREMENT egcp[0].egcp_struct_acctllshi0.lshpwm_ext_ls_up "Upstream heater PWM duty cycle preset from external tester" UBYTE _CNV_A_R_LINEAR_____5_CM 1 100. 0. 99.609375 DISPLAY_IDENTIFIER LSHPWM_EXT_LS_UP[1] ECU_ADDRESS 0xd0001938 FORMAT "%9.6" /end MEASUREMENT
/begin MEASUREMENT egcp[0].egcp_struct_acctllshi0.lv_inh_lsh_ctl_cll_lsh_up "Boolean flag indicating project specific application conditions closed loop heater control not met" UBYTE _CNV_S_2_RANGE__0___1_CM 1 100. 0. 1. DISPLAY_IDENTIFIER LV_INH_LSH_CTL_CLL_LSH_UP[1] ECU_ADDRESS 0xd0001939 BIT_MASK 0x1 /end MEASUREMENT
/begin MEASUREMENT egcp[0].egcp_struct_acctllshi0.lv_inh_lsh_up "Boolean flag indicating project specific application conditions for heating not met" UBYTE _CNV_S_2_RANGE__0___1_CM 1 100. 0. 1. DISPLAY_IDENTIFIER LV_INH_LSH_UP[1] ECU_ADDRESS 0xd000193a BIT_MASK 0x1 /end MEASUREMENT
/begin MEASUREMENT egcp[0].egcp_struct_adcprlsl2.iplsl_vari_purge "Variance of corrected pumping current during fuel cut at purged condition" ULONG _CNV_A_R_EGCP_LINEA_325_CM 1 100. 0. 634.636864 DISPLAY_IDENTIFIER IPLSL_VARI_PURGE[1] ECU_ADDRESS 0xd0001978 FORMAT "%11.6" /end MEASUREMENT
/begin MEASUREMENT egcp[0].egcp_struct_adcprlsl2.iplsl_vari_vld_fcut "Moving variance of valid samples of pumping current during fuel cut" ULONG _CNV_A_R_EGCP_LINEA_325_CM 1 100. 0. 634.636864 DISPLAY_IDENTIFIER IPLSL_VARI_VLD_FCUT[1] ECU_ADDRESS 0xd000197c FORMAT "%11.6" /end MEASUREMENT
/begin MEASUREMENT egcp[0].egcp_struct_adcprlsl2.iplsl_purge "Compensated (excluding factor for gain adaptation)  pumping current during fuel cut at purged condition" SWORD _CNV_A_R_LINEAR_____328_CM 1 100. -12.596 12.595 DISPLAY_IDENTIFIER IPLSL_PURGE[1] ECU_ADDRESS 0xd0001980 FORMAT "%8.4" /end MEASUREMENT
/begin MEASUREMENT egcp[0].egcp_struct_adcprlsl2.iplsl_cor_mmv_fcut "Moving mean value of corrected pumping current during fuel cut" SWORD _CNV_A_R_LINEAR_____328_CM 1 100. -12.596 12.595 DISPLAY_IDENTIFIER IPLSL_COR_MMV_FCUT[1] ECU_ADDRESS 0xd0001982 FORMAT "%8.4" /end MEASUREMENT
/begin MEASUREMENT egcp[0].egcp_struct_adcprlsl2.iplsl_mv_purge "Arithmetic mean of compensated pumping current during fuel cut at purged condition" SWORD _CNV_A_R_LINEAR_____328_CM 1 100. -12.596 12.595 DISPLAY_IDENTIFIER IPLSL_MV_PURGE[1] ECU_ADDRESS 0xd0001984 FORMAT "%8.4" /end MEASUREMENT
/begin MEASUREMENT egcp[0].egcp_struct_adcprlsl2.iplsl_cor_beg_purge "Corrected pumping current during fuel cut at begin of purged condition" SWORD _CNV_A_R_LINEAR_____328_CM 1 100. -12.596 12.595 DISPLAY_IDENTIFIER IPLSL_COR_BEG_PURGE[1] ECU_ADDRESS 0xd0001986 FORMAT "%8.4" /end MEASUREMENT
/begin MEASUREMENT egcp[0].egcp_struct_adcprlsl2.iplsl_cor_chg_purge "Change of corrected pumping current during acquisition at purged condition" SWORD _CNV_A_R_LINEAR_____328_CM 1 100. -12.596 12.595 DISPLAY_IDENTIFIER IPLSL_COR_CHG_PURGE[1] ECU_ADDRESS 0xd0001988 FORMAT "%8.4" /end MEASUREMENT
/begin MEASUREMENT egcp[0].egcp_struct_adcprlsl2.iplsl_mmv_vld_fcut "Moving mean of valid samples of pumping current during fuel cut" SWORD _CNV_A_R_LINEAR_____328_CM 1 100. -12.596 12.595 DISPLAY_IDENTIFIER IPLSL_MMV_VLD_FCUT[1] ECU_ADDRESS 0xd000198a FORMAT "%8.4" /end MEASUREMENT
/begin MEASUREMENT egcp[0].egcp_struct_adcprlsl2.fac_lsl_gain_ad "Adaptive factor for WRAF sensor gain" UWORD _CNV_A_R_LINEAR_____8_CM 1 100. 0. 1.99996948242188 DISPLAY_IDENTIFIER FAC_LSL_GAIN_AD[1] ECU_ADDRESS 0xd000198c FORMAT "%7.5" /end MEASUREMENT
/begin MEASUREMENT egcp[0].egcp_struct_adcprlsl2.t_acq_iplsl_purge "Timer for acquisition interval of compensated pumping current during fuel cut at purged condition" UBYTE _CNV_A_R_LINEAR_____4_CM 1 100. 0. 25.5 DISPLAY_IDENTIFIER T_ACQ_IPLSL_PURGE[1] ECU_ADDRESS 0xd000198e FORMAT "%4.1" /end MEASUREMENT
/begin MEASUREMENT egcp[0].egcp_struct_adcprlsl2.t_dly_iplsl_cor_mmv_fcut_vld "Delay timer for retry of gain adaptation upon detection of possible saturation effects on Ip measurement" UBYTE _CNV_A_R_LINEAR_____4_CM 1 100. 0. 25.5 DISPLAY_IDENTIFIER T_DLY_IPLSL_COR_MMV_FCUT_VLD[1] ECU_ADDRESS 0xd000198f FORMAT "%4.1" /end MEASUREMENT
/begin MEASUREMENT egcp[0].egcp_struct_adcprlsl2.state_iplsl_ad_fcut "State of fuel cut gain adaptation procedure" UBYTE _CNV_S_5_EGCP_RANGE_339_CM 1 100. 0. 4. DISPLAY_IDENTIFIER STATE_IPLSL_AD_FCUT[1] ECU_ADDRESS 0xd0001990 /end MEASUREMENT
/begin MEASUREMENT egcp[0].egcp_struct_adcprlsl2.state_iplsl_gain_ad "State of WRAF sensor gain adaptation factor" UBYTE _CNV_S_4_EGCP_RANGE_340_CM 1 100. 0. 3. DISPLAY_IDENTIFIER STATE_IPLSL_GAIN_AD[1] ECU_ADDRESS 0xd0001991 /end MEASUREMENT
/begin MEASUREMENT egcp[0].egcp_struct_adcprlsl2.lv_lsl_gain_ad_req "Request for fuel cut Ip measurement" UBYTE _CNV_S_2_RANGE__0___1_CM 1 100. 0. 1. DISPLAY_IDENTIFIER LV_LSL_GAIN_AD_REQ[1] ECU_ADDRESS 0xd0001992 BIT_MASK 0x1 /end MEASUREMENT
/begin MEASUREMENT egcp[0].egcp_struct_adcprlsl2.lv_lsl_gain_ad_req_vld "Validation of request for fuel cut Ip measurement" UBYTE _CNV_S_2_RANGE__0___1_CM 1 100. 0. 1. DISPLAY_IDENTIFIER LV_LSL_GAIN_AD_REQ_VLD[1] ECU_ADDRESS 0xd0001993 BIT_MASK 0x1 /end MEASUREMENT
/begin MEASUREMENT egcp[0].egcp_struct_adcprlsl2.lv_iplsl_vld_fcut "Valid Ip sample has been acquired during current fuel cut" UBYTE _CNV_S_2_RANGE__0___1_CM 1 100. 0. 1. DISPLAY_IDENTIFIER LV_IPLSL_VLD_FCUT[1] ECU_ADDRESS 0xd0001994 BIT_MASK 0x1 /end MEASUREMENT
/begin MEASUREMENT egcp[0].egcp_struct_adcprlsl2.lv_lsl_fcut_mes_rep_inh "Status flag indicating successful fuel cut Ip measurement during current PUC phase" UBYTE _CNV_S_2_RANGE__0___1_CM 1 100. 0. 1. DISPLAY_IDENTIFIER LV_LSL_FCUT_MES_REP_INH[1] ECU_ADDRESS 0xd0001995 BIT_MASK 0x1 /end MEASUREMENT
/begin MEASUREMENT egcp[0].egcp_struct_adcprlsl2.lv_lsl_fcut_mes_not_plaus "Actual fuel cut Ip measurement not plausible" UBYTE _CNV_S_2_RANGE__0___1_CM 1 100. 0. 1. DISPLAY_IDENTIFIER LV_LSL_FCUT_MES_NOT_PLAUS[1] ECU_ADDRESS 0xd0001996 BIT_MASK 0x1 /end MEASUREMENT
/begin MEASUREMENT egcp[0].egcp_struct_adcprlsl2.lv_lsl_gain_ad_fcut_not_ok "Factor for gain adaptation out of valid range" UBYTE _CNV_S_2_RANGE__0___1_CM 1 100. 0. 1. DISPLAY_IDENTIFIER LV_LSL_GAIN_AD_FCUT_NOT_OK[1] ECU_ADDRESS 0xd0001997 BIT_MASK 0x1 /end MEASUREMENT
/begin MEASUREMENT egcp[0].egcp_struct_adcprlsl2.lv_fac_lsl_gain_ad_lim_max "Status flag for limitation of WRAF gain adaptation factor to maximum" UBYTE _CNV_S_2_RANGE__0___1_CM 1 100. 0. 1. DISPLAY_IDENTIFIER LV_FAC_LSL_GAIN_AD_LIM_MAX[1] ECU_ADDRESS 0xd0001998 BIT_MASK 0x1 /end MEASUREMENT
/begin MEASUREMENT egcp[0].egcp_struct_adcprlsl2.lv_fac_lsl_gain_ad_lim_min "Status flag for limitation of WRAF gain adaptation factor to minimum" UBYTE _CNV_S_2_RANGE__0___1_CM 1 100. 0. 1. DISPLAY_IDENTIFIER LV_FAC_LSL_GAIN_AD_LIM_MIN[1] ECU_ADDRESS 0xd0001999 BIT_MASK 0x1 /end MEASUREMENT
/begin MEASUREMENT egcp[0].egcp_struct_adcprlsl2.lv_iplsl_cor_mmv_fcut_vld "Boolean flag stating validity of latest moving mean value of corrected pumping current during PUC" UBYTE _CNV_S_2_RANGE__0___1_CM 1 100. 0. 1. DISPLAY_IDENTIFIER LV_IPLSL_COR_MMV_FCUT_VLD[1] ECU_ADDRESS 0xd000199a BIT_MASK 0x1 /end MEASUREMENT
/begin MEASUREMENT egcp[0].egcp_struct_adcprlsli2.lv_inh_lsl_gain_ad "WRAF sensor Gain Adaptation: application incidences for inhibition" UBYTE _CNV_S_2_RANGE__0___1_CM 1 100. 0. 1. DISPLAY_IDENTIFIER LV_INH_LSL_GAIN_AD[1] ECU_ADDRESS 0xd000199c BIT_MASK 0x1 /end MEASUREMENT
/begin MEASUREMENT egcp[0].egcp_struct_sigcv0.vls_up_raw "Raw value of upstream oxygen sensor voltage" UWORD _CNV_A_R_LINEAR_____2_CM 1 100. 0. 4.9951171875 DISPLAY_IDENTIFIER VLS_UP_RAW[1] ECU_ADDRESS 0xd00019b4 FORMAT "%5.3" /end MEASUREMENT
/begin MEASUREMENT egcp[0].egcp_struct_sigcv0.vls_down "Downstream oxygen sensor voltage" UWORD _CNV_A_R_LINEAR_____2_CM 1 100. 0. 4.9951171875 DISPLAY_IDENTIFIER VLS_DOWN[1] ECU_ADDRESS 0xd00019b6 FORMAT "%5.3" /end MEASUREMENT
/begin MEASUREMENT egcp[0].egcp_struct_sigcv0.v_temp_ls_up "Upstream lambda sensor temperature voltage" UWORD _CNV_A_R_LINEAR_____2_CM 1 100. 0. 4.9951171875 DISPLAY_IDENTIFIER V_TEMP_LS_UP[1] ECU_ADDRESS 0xd00019b8 FORMAT "%5.3" /end MEASUREMENT
/begin MEASUREMENT egcp[0].egcp_struct_ispclls0.ctr_afl_cyc "Counter indicating number of air fuel cycles" UWORD _CNV_A_R_LINEAR_____0_CM 1 100. 0. 65535. DISPLAY_IDENTIFIER CTR_AFL_CYC[1] ECU_ADDRESS 0xd00019bc FORMAT "%5.0" /end MEASUREMENT
/begin MEASUREMENT egcp[0].egcp_struct_ispclls0.t_afr_cyc "Rich mixture cycle time" UWORD _CNV_A_R_LINEAR_____3_CM 1 100. 0. 655.35 DISPLAY_IDENTIFIER T_AFR_CYC[1] ECU_ADDRESS 0xd00019be FORMAT "%6.2" /end MEASUREMENT
/begin MEASUREMENT egcp[0].egcp_struct_ispclls0.t_afl_cyc "Lean mixture cycle time" UWORD _CNV_A_R_LINEAR_____3_CM 1 100. 0. 655.35 DISPLAY_IDENTIFIER T_AFL_CYC[1] ECU_ADDRESS 0xd00019c0 FORMAT "%6.2" /end MEASUREMENT
/begin MEASUREMENT egcp[0].egcp_struct_ispclls0.t_afl_cyc_hld "Lean mixture cycle time, held until next new value available" UWORD _CNV_A_R_LINEAR_____3_CM 1 100. 0. 655.35 DISPLAY_IDENTIFIER T_AFL_CYC_HLD[1] ECU_ADDRESS 0xd00019c2 FORMAT "%6.2" /end MEASUREMENT
/begin MEASUREMENT egcp[0].egcp_struct_ispclls0.t_sum_afl_afr_cyc "Lean plus rich mixture cycle time; time of last forced lambda stimulation period" UWORD _CNV_A_R_LINEAR_____3_CM 1 100. 0. 655.35 DISPLAY_IDENTIFIER T_SUM_AFL_AFR_CYC[1] ECU_ADDRESS 0xd00019c4 FORMAT "%6.2" /end MEASUREMENT
/begin MEASUREMENT egcp[0].egcp_struct_ispclls0.lv_afl "Boolean flag indicating detection of lean Air-Fuel mixture when set" UBYTE _CNV_S_2_RANGE__0___1_CM 1 100. 0. 1. DISPLAY_IDENTIFIER LV_AFL[1] ECU_ADDRESS 0xd00019c6 BIT_MASK 0x1 /end MEASUREMENT
/begin MEASUREMENT egcp[0].egcp_struct_outdglsh0.err_diag_lsh_up "diagnosis condition for each symptom of upstream heater diagnosis OBD I" UBYTE _CNV_A_R_LINEAR_____0_CM 1 100. 0. 7. DISPLAY_IDENTIFIER ERR_DIAG_LSH_UP[1] ECU_ADDRESS 0xd00019c8 FORMAT "%3.0" /end MEASUREMENT
/begin MEASUREMENT egcp[0].egcp_struct_outdglsh0.cdn_diag_lsh_up "Diagnosis condition for each symptom of upstream heater diagnosis OBD I" UBYTE _CNV_A_R_LINEAR_____0_CM 1 100. 0. 7. DISPLAY_IDENTIFIER CDN_DIAG_LSH_UP[1] ECU_ADDRESS 0xd00019c9 FORMAT "%3.0" /end MEASUREMENT
/begin MEASUREMENT egcp[0].egcp_struct_outdglsh0.lv_lsh_scg_act_lsh_up "Boolean flag indicating that debounce for upstream heater OBD I SCG diagnosis active" UBYTE _CNV_S_2_RANGE__0___1_CM 1 100. 0. 1. DISPLAY_IDENTIFIER LV_LSH_SCG_ACT_LSH_UP[1] ECU_ADDRESS 0xd00019ca /end MEASUREMENT
/begin MEASUREMENT egcp[0].egcp_struct_outdglshd0.err_diag_lsh_down "raw value of error symptom for downstream heater diagnosis OBD I" UBYTE _CNV_A_R_LINEAR_____0_CM 1 100. 0. 7. DISPLAY_IDENTIFIER ERR_DIAG_LSH_DOWN[1] ECU_ADDRESS 0xd00019ce FORMAT "%3.0" /end MEASUREMENT
/begin MEASUREMENT egcp[0].egcp_struct_outdglshd0.cdn_diag_lsh_down "Diagnosis condition for each symptom of downstream heater diagnosis OBD I" UBYTE _CNV_A_R_LINEAR_____0_CM 1 100. 0. 7. DISPLAY_IDENTIFIER CDN_DIAG_LSH_DOWN[1] ECU_ADDRESS 0xd00019cf FORMAT "%3.0" /end MEASUREMENT
/begin MEASUREMENT egcp[0].egcp_struct_pladglsd2.lv_diag_cdn_plaus_ls_down "Boolean flag, plausibility check on downstream oxygen sensor signal possible" UBYTE _CNV_S_2_RANGE__0___1_CM 1 100. 0. 1. DISPLAY_IDENTIFIER LV_DIAG_CDN_PLAUS_LS_DOWN[1] ECU_ADDRESS 0xd00019d2 BIT_MASK 0x1 /end MEASUREMENT
/begin MEASUREMENT egcp[0].egcp_struct_pladglsd2.lv_err_plaus_ls_down "Boolean flag, error plausibility check on downstream oxygen sensor signal" UBYTE _CNV_S_2_RANGE__0___1_CM 1 100. 0. 1. DISPLAY_IDENTIFIER LV_ERR_PLAUS_LS_DOWN[1] ECU_ADDRESS 0xd00019d3 BIT_MASK 0x1 /end MEASUREMENT
/begin MEASUREMENT egcp[0].egcp_struct_pladglsd2.lv_diag_puc_chg_ls_down "reminder flag for fuel cut off was active" UBYTE _CNV_S_2_RANGE__0___1_CM 1 100. 0. 1. DISPLAY_IDENTIFIER LV_DIAG_PUC_CHG_LS_DOWN[1] ECU_ADDRESS 0xd00019d4 BIT_MASK 0x1 /end MEASUREMENT
/begin MEASUREMENT egcp[0].egcp_struct_pladglsd2.maf_int_puc_not_ls_down_diag "MAF integral out of PUC in case of certain load threshold exceeded" UWORD _CNV_A_R_LINEAR_____329_CM 1 100. 0. 2912.66666666667 DISPLAY_IDENTIFIER MAF_INT_PUC_NOT_LS_DOWN_DIAG[1] ECU_ADDRESS 0xd00019d6 FORMAT "%7.2" /end MEASUREMENT
/begin MEASUREMENT egcp[0].egcp_struct_sigcvif1.state_lsl_if_spi_rd "Bit-field, mapping verified contents of ATIC42 Configuration Register" UBYTE _CNV_A_R_LINEAR_____0_CM 1 100. 0. 255. DISPLAY_IDENTIFIER STATE_LSL_IF_SPI_RD[1] ECU_ADDRESS 0xd00019dc FORMAT "%3.0" /end MEASUREMENT
/begin MEASUREMENT egcp[0].egcp_struct_sigcvif1.state_lsl_if_conf_spi_rd "Content of the configuration register comprising sensor disconnection time delay and Icp value" UBYTE _CNV_A_R_LINEAR_____0_CM 1 100. 0. 255. DISPLAY_IDENTIFIER STATE_LSL_IF_CONF_SPI_RD[1] ECU_ADDRESS 0xd00019dd FORMAT "%3.0" /end MEASUREMENT
/begin MEASUREMENT egcp[0].egcp_struct_sigcvif1.ctr_err_lsl_if_spi_wr "Counter indicating number of invalid INIT_REG_x write validation cycles which have been detected" UBYTE _CNV_A_R_LINEAR_____0_CM 1 100. 0. 255. DISPLAY_IDENTIFIER CTR_ERR_LSL_IF_SPI_WR[1] ECU_ADDRESS 0xd00019de FORMAT "%3.0" /end MEASUREMENT
/begin MEASUREMENT egcp[0].egcp_struct_sigcvif1.frq_r_it_osc_lsl_if_spi_rd "Content of the configuration register comprising  Ri-measurement frequency and bit for pin selective disabling " UBYTE _CNV_A_R_LINEAR_____0_CM 1 100. 0. 127. DISPLAY_IDENTIFIER FRQ_R_IT_OSC_LSL_IF_SPI_RD[1] ECU_ADDRESS 0xd00019df FORMAT "%3.0" /end MEASUREMENT
/begin MEASUREMENT egcp[0].egcp_struct_sigcvif1.state_err_vnlsl "Diagnosis status of the Nernst Cell positive pin." UBYTE _CNV_S_3_EGCP_RANGE_341_CM 1 100. 0. 2. DISPLAY_IDENTIFIER STATE_ERR_VNLSL[1] ECU_ADDRESS 0xd00019e0 /end MEASUREMENT
/begin MEASUREMENT egcp[0].egcp_struct_sigcvif1.state_err_vglsl "Diagnosis status of the Virtual Ground pin." UBYTE _CNV_S_3_EGCP_RANGE_341_CM 1 100. 0. 2. DISPLAY_IDENTIFIER STATE_ERR_VGLSL[1] ECU_ADDRESS 0xd00019e1 /end MEASUREMENT
/begin MEASUREMENT egcp[0].egcp_struct_sigcvif1.state_err_viplsl "Diagnosis status of the Pump Cell pin." UBYTE _CNV_S_3_EGCP_RANGE_341_CM 1 100. 0. 2. DISPLAY_IDENTIFIER STATE_ERR_VIPLSL[1] ECU_ADDRESS 0xd00019e2 /end MEASUREMENT
/begin MEASUREMENT egcp[0].egcp_struct_sigcvif1.state_err_vrclsl "Diagnosis status of the Calibration Resistance pin." UBYTE _CNV_S_3_EGCP_RANGE_341_CM 1 100. 0. 2. DISPLAY_IDENTIFIER STATE_ERR_VRCLSL[1] ECU_ADDRESS 0xd00019e3 /end MEASUREMENT
/begin MEASUREMENT egcp[0].egcp_struct_sigcvif1.state_err_iplsl "Diagnosis status of the Pumping Current." UBYTE _CNV_S_3_EGCP_RANGE_342_CM 1 100. 0. 2. DISPLAY_IDENTIFIER STATE_ERR_IPLSL[1] ECU_ADDRESS 0xd00019e4 /end MEASUREMENT
/begin MEASUREMENT egcp[0].egcp_struct_sigcvif1.state_err_lsl "OBDI General Status" UBYTE _CNV_S_2_EGCP_RANGE_343_CM 1 100. 0. 1. DISPLAY_IDENTIFIER STATE_ERR_LSL[1] ECU_ADDRESS 0xd00019e5 /end MEASUREMENT
/begin MEASUREMENT egcp[0].egcp_struct_sigcvif1.lv_lsl_deac "Boolean flag indicating pending OBDI signal fault " UBYTE _CNV_S_2_RANGE__0___1_CM 1 100. 0. 1. DISPLAY_IDENTIFIER LV_LSL_DEAC[1] ECU_ADDRESS 0xd00019e6 BIT_MASK 0x1 /end MEASUREMENT
/begin MEASUREMENT egcp[0].egcp_struct_sigcvif1.lv_vplsl_lim "Boolean flag indicating that Pump Cell voltage has reached its limits" UBYTE _CNV_S_2_RANGE__0___1_CM 1 100. 0. 1. DISPLAY_IDENTIFIER LV_VPLSL_LIM[1] ECU_ADDRESS 0xd00019e7 BIT_MASK 0x1 /end MEASUREMENT
/begin MEASUREMENT egcp[0].egcp_struct_sigcvif1.lv_vnlsl_lim "Boolean flag indicating overvoltage at Nernst Cell positive pin" UBYTE _CNV_S_2_RANGE__0___1_CM 1 100. 0. 1. DISPLAY_IDENTIFIER LV_VNLSL_LIM[1] ECU_ADDRESS 0xd00019e8 BIT_MASK 0x1 /end MEASUREMENT
/begin MEASUREMENT egcp[0].egcp_struct_sigcvif1.ctr_err_lsl_if_spi_it_osc_ena "Counter indicating number of invalid transmissions of \"R_IT_OSC_ENA\" bit" UBYTE _CNV_A_R_LINEAR_____0_CM 1 100. 0. 255. DISPLAY_IDENTIFIER CTR_ERR_LSL_IF_SPI_IT_OSC_ENA[1] ECU_ADDRESS 0xd00019e9 FORMAT "%3.0" /end MEASUREMENT
/begin MEASUREMENT egcp[0].egcp_struct_sigcvif2.state_lsl_if_spi_wr "Bit-field mapping of contents to be written to ATIC42 INIT_REG_1" UBYTE _CNV_A_R_LINEAR_____0_CM 1 100. 0. 255. DISPLAY_IDENTIFIER STATE_LSL_IF_SPI_WR[1] ECU_ADDRESS 0xd00019ea FORMAT "%3.0" /end MEASUREMENT
/begin MEASUREMENT egcp[0].egcp_struct_sigcvif2.state_lsl_if_conf_spi_wr "Mapping of contents to be written to ATIC42 INIT_REG_1" UBYTE _CNV_A_R_LINEAR_____0_CM 1 100. 0. 255. DISPLAY_IDENTIFIER STATE_LSL_IF_CONF_SPI_WR[1] ECU_ADDRESS 0xd00019eb FORMAT "%3.0" /end MEASUREMENT
/begin MEASUREMENT egcp[0].egcp_struct_sigcvif2.lv_lsl_if_spi_rst_end "Boolean flag indicating general status of  ATIC42 initialisation after RESET" UBYTE _CNV_S_2_RANGE__0___1_CM 1 100. 0. 1. DISPLAY_IDENTIFIER LV_LSL_IF_SPI_RST_END[1] ECU_ADDRESS 0xd00019ec BIT_MASK 0x1 /end MEASUREMENT
/begin MEASUREMENT egcp[0].egcp_struct_sigcvifi2.t_dly_di_lsl_if "Configuration of the Sensor Protection Time" UBYTE _CNV_A_R_LINEAR_____0_CM 1 100. 0. 7. DISPLAY_IDENTIFIER T_DLY_DI_LSL_IF[1] ECU_ADDRESS 0xd00019ee FORMAT "%3.0" /end MEASUREMENT
/begin MEASUREMENT egcp[0].egcp_struct_sigcvifi2.lv_lsl_ena_lsl_if "Boolean flag to enable/disable WRAF sensor connection" UBYTE _CNV_S_2_RANGE__0___1_CM 1 100. 0. 1. DISPLAY_IDENTIFIER LV_LSL_ENA_LSL_IF[1] ECU_ADDRESS 0xd00019ef BIT_MASK 0x1 /end MEASUREMENT
/begin MEASUREMENT egcp[0].egcp_struct_sigcvifi2.lv_lsl_if_rst "Boolean flag to reset the ATIC42" UBYTE _CNV_S_2_RANGE__0___1_CM 1 100. 0. 1. DISPLAY_IDENTIFIER LV_LSL_IF_RST[1] ECU_ADDRESS 0xd00019f0 BIT_MASK 0x1 /end MEASUREMENT
/begin MEASUREMENT egcp[0].egcp_struct_sigcvifi2.lv_ctr_err_lsl_if_spi_man_inc "BSW interface for manual increase of value of SPI communication error counter" UBYTE _CNV_S_2_RANGE__0___1_CM 1 100. 0. 1. DISPLAY_IDENTIFIER LV_CTR_ERR_LSL_IF_SPI_MAN_INC[1] ECU_ADDRESS 0xd00019f1 BIT_MASK 0x1 /end MEASUREMENT
/begin MEASUREMENT egcp[0].egcp_struct_sigcvlsl2.lamb_sp_fil_delta_rise "Acquired lambda model value at the rising edge of heater PWM" UWORD _CNV_A_R_LINEAR_____23_CM 1 100. 0. 1.99993896484375 DISPLAY_IDENTIFIER LAMB_SP_FIL_DELTA_RISE[1] ECU_ADDRESS 0xd0001a08 FORMAT "%7.5" /end MEASUREMENT
/begin MEASUREMENT egcp[0].egcp_struct_sigcvlsl2.lamb_sp_fil_delta_fall "Acquired lambda model value at the falling edge of heater PWM" UWORD _CNV_A_R_LINEAR_____23_CM 1 100. 0. 1.99993896484375 DISPLAY_IDENTIFIER LAMB_SP_FIL_DELTA_FALL[1] ECU_ADDRESS 0xd0001a0a FORMAT "%7.5" /end MEASUREMENT
/begin MEASUREMENT egcp[0].egcp_struct_sigcvlsl2.vls_up_delta_rise "Acquired oxygen sensor voltage at the rising edge of heater PWM" UWORD _CNV_A_R_LINEAR_____2_CM 1 100. 0. 4.9951171875 DISPLAY_IDENTIFIER VLS_UP_DELTA_RISE[1] ECU_ADDRESS 0xd0001a0c FORMAT "%5.3" /end MEASUREMENT
/begin MEASUREMENT egcp[0].egcp_struct_sigcvlsl2.vls_up_delta_fall "Acquired oxygen sensor voltage at the falling edge of heater PWM" UWORD _CNV_A_R_LINEAR_____2_CM 1 100. 0. 4.9951171875 DISPLAY_IDENTIFIER VLS_UP_DELTA_FALL[1] ECU_ADDRESS 0xd0001a0e FORMAT "%5.3" /end MEASUREMENT
/begin MEASUREMENT egcp[0].egcp_struct_sigcvrid0.vls_down_mmv_drv1_thd_min "Lower variable VLS_DOWN gradient threshold" SWORD _CNV_A_R_EGCP_LINEA_344_CM 1 100. -2.5 2.499924 DISPLAY_IDENTIFIER VLS_DOWN_MMV_DRV1_THD_MIN[1] ECU_ADDRESS 0xd0001a10 FORMAT "%8.5" /end MEASUREMENT
/begin MEASUREMENT egcp[0].egcp_struct_sigcvrid0.vls_down_mmv_drv1_thd_max "Upper variable VLS_DOWN gradient threshold" SWORD _CNV_A_R_EGCP_LINEA_344_CM 1 100. -2.5 2.499924 DISPLAY_IDENTIFIER VLS_DOWN_MMV_DRV1_THD_MAX[1] ECU_ADDRESS 0xd0001a12 FORMAT "%8.5" /end MEASUREMENT
/begin MEASUREMENT egcp[0].egcp_struct_sigcvrid0.ttip_mes_ls_down "Downstream oxygen sensor ceramic temperature" SWORD _CNV_A_R_LINEAR_____123_CM 1 100. -2048. 2047.9375 DISPLAY_IDENTIFIER TTIP_MES_LS_DOWN[1] ECU_ADDRESS 0xd0001a14 FORMAT "%10.4" /end MEASUREMENT
/begin MEASUREMENT egcp[0].egcp_struct_sigcvrid0.ttip_mes_tol_ls_down "Downstream oxygen sensor ceramic temperature, Upper limit, Unfiltered" SWORD _CNV_A_R_LINEAR_____123_CM 1 100. -2048. 2047.9375 DISPLAY_IDENTIFIER TTIP_MES_TOL_LS_DOWN[1] ECU_ADDRESS 0xd0001a16 FORMAT "%10.4" /end MEASUREMENT
/begin MEASUREMENT egcp[0].egcp_struct_sigcvrid0.ttip_mes_bol_ls_down "Downstream oxygen sensor ceramic temperature, Lower limit, Unfiltered" SWORD _CNV_A_R_LINEAR_____123_CM 1 100. -2048. 2047.9375 DISPLAY_IDENTIFIER TTIP_MES_BOL_LS_DOWN[1] ECU_ADDRESS 0xd0001a18 FORMAT "%10.4" /end MEASUREMENT
/begin MEASUREMENT egcp[0].egcp_struct_sigcvrid0.ttip_mes_tol_mmv_ls_down "Downstream oxygen sensor ceramic temperature, Upper limit, Filtered" SWORD _CNV_A_R_LINEAR_____123_CM 1 100. -2048. 2047.9375 DISPLAY_IDENTIFIER TTIP_MES_TOL_MMV_LS_DOWN[1] ECU_ADDRESS 0xd0001a1a FORMAT "%10.4" /end MEASUREMENT
/begin MEASUREMENT egcp[0].egcp_struct_sigcvrid0.ttip_mes_bol_mmv_ls_down "Downstream oxygen sensor ceramic temperature, Lower limit, Filtered" SWORD _CNV_A_R_LINEAR_____123_CM 1 100. -2048. 2047.9375 DISPLAY_IDENTIFIER TTIP_MES_BOL_MMV_LS_DOWN[1] ECU_ADDRESS 0xd0001a1c FORMAT "%10.4" /end MEASUREMENT
/begin MEASUREMENT egcp[0].egcp_struct_sigcvrid0.ctr_cycnr_r_it_ls_down_vld "Handshake counter indicating the number of valid resistance values determined since initial activation" UWORD _CNV_A_R_LINEAR_____0_CM 1 100. 0. 65535. DISPLAY_IDENTIFIER CTR_CYCNR_R_IT_LS_DOWN_VLD[1] ECU_ADDRESS 0xd0001a1e FORMAT "%5.0" /end MEASUREMENT
/begin MEASUREMENT egcp[0].egcp_struct_sigcvrid0.pow_mmv_lsh_down "Moving mean value of downstream oxygen sensor heater power" UWORD _CNV_A_R_EGCP_LINEA_348_CM 1 100. 0. 84.498711 DISPLAY_IDENTIFIER POW_MMV_LSH_DOWN[1] ECU_ADDRESS 0xd0001a20 /end MEASUREMENT
/begin MEASUREMENT egcp[0].egcp_struct_sigcvrid0.r_it_ls_down "Internal resistance of downstream oxygen sensor (Released)" UWORD _CNV_A_R_LINEAR_____332_CM 1 100. 0. 65535. DISPLAY_IDENTIFIER R_IT_LS_DOWN[1] ECU_ADDRESS 0xd0001a22 FORMAT "%5.0" /end MEASUREMENT
/begin MEASUREMENT egcp[0].egcp_struct_sigcvrid0.r_it_mes_ls_down "Internal resistance of downstream oxygen sensor (Measured)" UWORD _CNV_A_R_LINEAR_____332_CM 1 100. 0. 65535. DISPLAY_IDENTIFIER R_IT_MES_LS_DOWN[1] ECU_ADDRESS 0xd0001a24 FORMAT "%5.0" /end MEASUREMENT
/begin MEASUREMENT egcp[0].egcp_struct_sigcvrid0.r_it_mdl_ls_down_new "Internal resistance of downstream oxygen sensor (Modelled for new sensor)" UWORD _CNV_A_R_LINEAR_____332_CM 1 100. 0. 65535. DISPLAY_IDENTIFIER R_IT_MDL_LS_DOWN_NEW[1] ECU_ADDRESS 0xd0001a26 FORMAT "%5.0" /end MEASUREMENT
/begin MEASUREMENT egcp[0].egcp_struct_sigcvrid0.t_sample_r_it_ls_down "Time measured between internal resistance samples" UWORD _CNV_A_R_LINEAR_____3_CM 1 100. 0. 655.35 DISPLAY_IDENTIFIER T_SAMPLE_R_IT_LS_DOWN[1] ECU_ADDRESS 0xd0001a28 FORMAT "%6.2" /end MEASUREMENT
/begin MEASUREMENT egcp[0].egcp_struct_sigcvrid0.ttip_ref_mdl_mmv_ls_down "Reference of downstream oxygen sensor ceramic temperature (Modelled for new sensor)" UWORD _CNV_A_R_LINEAR_____204_CM 1 100. -273.15 1774.7875 DISPLAY_IDENTIFIER TTIP_REF_MDL_MMV_LS_DOWN[1] ECU_ADDRESS 0xd0001a2a FORMAT "%9.4" /end MEASUREMENT
/begin MEASUREMENT egcp[0].egcp_struct_sigcvrid0.vls_down_cur_pump_on "Downstream oxygen sensor voltage C_T_CUR_PUMP_ON_LS_DOWN after switching on pump current switch" UWORD _CNV_A_R_LINEAR_____2_CM 1 100. 0. 4.9951171875 DISPLAY_IDENTIFIER VLS_DOWN_CUR_PUMP_ON[1] ECU_ADDRESS 0xd0001a2c FORMAT "%5.3" /end MEASUREMENT
/begin MEASUREMENT egcp[0].egcp_struct_sigcvrid0.vls_down_cur_pump_off "Downstream oxygen sensor voltage prior to switching on pump current switch" UWORD _CNV_A_R_LINEAR_____2_CM 1 100. 0. 4.9951171875 DISPLAY_IDENTIFIER VLS_DOWN_CUR_PUMP_OFF[1] ECU_ADDRESS 0xd0001a2e FORMAT "%5.3" /end MEASUREMENT
/begin MEASUREMENT egcp[0].egcp_struct_sigcvrid0.fac_t_vls_down_mmv_drv1 "Multiplicative factor modifies DRV1_VLS_DOWN_MMV_MIN_THD dependent on T_VLS_CYC_AFL_HLD" UBYTE _CNV_A_R_EGCP_LINEA_349_CM 1 100. 0. 63.75 DISPLAY_IDENTIFIER FAC_T_VLS_DOWN_MMV_DRV1[1] ECU_ADDRESS 0xd0001a30 FORMAT "%5.2" /end MEASUREMENT
/begin MEASUREMENT egcp[0].egcp_struct_sigcvrid0.fac_t_vls_down_mmv_drv1_abs "Multiplicative factor modifies C_VLS_DOWN_MMV_DRV1_ABS_MAX dependent on T_VLS_CYC_AFL_HLD" UBYTE _CNV_A_R_EVAC_LINEA_314_CM 1 100. 0. 15.9375 DISPLAY_IDENTIFIER FAC_T_VLS_DOWN_MMV_DRV1_ABS[1] ECU_ADDRESS 0xd0001a31 FORMAT "%7.4" /end MEASUREMENT
/begin MEASUREMENT egcp[0].egcp_struct_sigcvrid0.t_afl_cyc_hld_r_it_ls_down "Lean mixture cycle time (measured upstream), held until next threshold crossing downstream" UBYTE _CNV_A_R_LINEAR_____3_CM 1 100. 0. 2.55 DISPLAY_IDENTIFIER T_AFL_CYC_HLD_R_IT_LS_DOWN[1] ECU_ADDRESS 0xd0001a32 FORMAT "%4.2" /end MEASUREMENT
/begin MEASUREMENT egcp[0].egcp_struct_sigcvrid0.lv_r_it_req_ls_down "Boolean flag indicating that conditions have been met and resistance determination requested" UBYTE _CNV_S_2_RANGE__0___1_CM 1 100. 0. 1. DISPLAY_IDENTIFIER LV_R_IT_REQ_LS_DOWN[1] ECU_ADDRESS 0xd0001a33 BIT_MASK 0x1 /end MEASUREMENT
/begin MEASUREMENT egcp[0].egcp_struct_sigcvrid0.lv_r_it_det_ls_down "Boolean flag indicating that resistance has already been determined (lock out)" UBYTE _CNV_S_2_RANGE__0___1_CM 1 100. 0. 1. DISPLAY_IDENTIFIER LV_R_IT_DET_LS_DOWN[1] ECU_ADDRESS 0xd0001a34 BIT_MASK 0x1 /end MEASUREMENT
/begin MEASUREMENT egcp[0].egcp_struct_sigcvrid0.lv_vls_down_drv1_cdn_r_ls "Boolean flag indicating that low gradient condition met" UBYTE _CNV_S_2_RANGE__0___1_CM 1 100. 0. 1. DISPLAY_IDENTIFIER LV_VLS_DOWN_DRV1_CDN_R_LS[1] ECU_ADDRESS 0xd0001a35 BIT_MASK 0x1 /end MEASUREMENT
/begin MEASUREMENT egcp[0].egcp_struct_sigcvrid0.lv_vls_down_rng_cdn_r_ls "Boolean flag indicating that VLS_DOWN at low gradient condition met" UBYTE _CNV_S_2_RANGE__0___1_CM 1 100. 0. 1. DISPLAY_IDENTIFIER LV_VLS_DOWN_RNG_CDN_R_LS[1] ECU_ADDRESS 0xd0001a36 BIT_MASK 0x1 /end MEASUREMENT
/begin MEASUREMENT egcp[0].egcp_struct_sigcvtipa0.ttip_mes_ls_up "Oxygen sensor ceramic temperature" SWORD _CNV_A_R_LINEAR_____123_CM 1 100. -2048. 2047.9375 DISPLAY_IDENTIFIER TTIP_MES_LS_UP[1] ECU_ADDRESS 0xd0001a3c FORMAT "%10.4" /end MEASUREMENT
/begin MEASUREMENT egcp[0].egcp_struct_sigcvtipa0.r_it_ls_up "Oxygen sensor element internal resistance" UWORD _CNV_A_R_EGCP_LINEA_316_CM 1 100. 0. 16383.75 DISPLAY_IDENTIFIER R_IT_LS_UP[1] ECU_ADDRESS 0xd0001a3e FORMAT "%9.2" /end MEASUREMENT
/begin MEASUREMENT egcp[0].egcp_struct_sigcvtipa0.tcc_v_ofs_mes_r_it_ls_up "Counter incremented for every measured offset voltage in resistance measurement mode" UWORD _CNV_A_R_LINEAR_____0_CM 1 100. 0. 65535. DISPLAY_IDENTIFIER TCC_V_OFS_MES_R_IT_LS_UP[1] ECU_ADDRESS 0xd0001a40 FORMAT "%5.0" /end MEASUREMENT
/begin MEASUREMENT egcp[0].egcp_struct_sigcvtipa0.tcc_v_ofs_adj_r_it_ls_up "Counter incremented for every offset voltage in resistance adjust mode" UWORD _CNV_A_R_LINEAR_____0_CM 1 100. 0. 65535. DISPLAY_IDENTIFIER TCC_V_OFS_ADJ_R_IT_LS_UP[1] ECU_ADDRESS 0xd0001a42 FORMAT "%5.0" /end MEASUREMENT
/begin MEASUREMENT egcp[0].egcp_struct_sigcvtipa0.tcc_fac_gain_h_r_it_ls_up "Counter incremented for every high gain adjust measurement" UWORD _CNV_A_R_LINEAR_____0_CM 1 100. 0. 65535. DISPLAY_IDENTIFIER TCC_FAC_GAIN_H_R_IT_LS_UP[1] ECU_ADDRESS 0xd0001a44 FORMAT "%5.0" /end MEASUREMENT
/begin MEASUREMENT egcp[0].egcp_struct_sigcvtipa0.tcc_fac_gain_l_r_it_ls_up "Counter incremented for every low gain adjust measurement" UWORD _CNV_A_R_LINEAR_____0_CM 1 100. 0. 65535. DISPLAY_IDENTIFIER TCC_FAC_GAIN_L_R_IT_LS_UP[1] ECU_ADDRESS 0xd0001a46 FORMAT "%5.0" /end MEASUREMENT
/begin MEASUREMENT egcp[0].egcp_struct_sigcvtipa0.tcc_err_v_ofs_mes_r_it_ls_up "Counter incremented for every invalid offset voltage in resistance measurement mode" UWORD _CNV_A_R_LINEAR_____0_CM 1 100. 0. 65535. DISPLAY_IDENTIFIER TCC_ERR_V_OFS_MES_R_IT_LS_UP[1] ECU_ADDRESS 0xd0001a48 FORMAT "%5.0" /end MEASUREMENT
/begin MEASUREMENT egcp[0].egcp_struct_sigcvtipa0.tcc_err_v_ofs_adj_r_it_ls_up "Counter incremented for every invalid offset voltage in resistance adjust mode" UWORD _CNV_A_R_LINEAR_____0_CM 1 100. 0. 65535. DISPLAY_IDENTIFIER TCC_ERR_V_OFS_ADJ_R_IT_LS_UP[1] ECU_ADDRESS 0xd0001a4a FORMAT "%5.0" /end MEASUREMENT
/begin MEASUREMENT egcp[0].egcp_struct_sigcvtipa0.tcc_err_fac_gain_h_r_ls_up "Counter incremented for every invalid high gain adjust measurement" UWORD _CNV_A_R_LINEAR_____0_CM 1 100. 0. 65535. DISPLAY_IDENTIFIER TCC_ERR_FAC_GAIN_H_R_LS_UP[1] ECU_ADDRESS 0xd0001a4c FORMAT "%5.0" /end MEASUREMENT
/begin MEASUREMENT egcp[0].egcp_struct_sigcvtipa0.tcc_err_fac_gain_l_r_ls_up "Counter incremented for every invalid low gain adjust measurement" UWORD _CNV_A_R_LINEAR_____0_CM 1 100. 0. 65535. DISPLAY_IDENTIFIER TCC_ERR_FAC_GAIN_L_R_LS_UP[1] ECU_ADDRESS 0xd0001a4e FORMAT "%5.0" /end MEASUREMENT
/begin MEASUREMENT egcp[0].egcp_struct_sigcvtipa0.v_ofs_adj_r_it_ls_up "Internal resistance determination circuit offset in resistance adjust mode" UWORD _CNV_A_R_EGCP_LINEA_350_CM 1 100. 0. 4.995 DISPLAY_IDENTIFIER V_OFS_ADJ_R_IT_LS_UP[1] ECU_ADDRESS 0xd0001a50 FORMAT "%5.3" /end MEASUREMENT
/begin MEASUREMENT egcp[0].egcp_struct_sigcvtipa0.v_ofs_mes_r_it_ls_up "Internal resistance determination circuit offset in resistance measurement mode" UWORD _CNV_A_R_EGCP_LINEA_350_CM 1 100. 0. 4.995 DISPLAY_IDENTIFIER V_OFS_MES_R_IT_LS_UP[1] ECU_ADDRESS 0xd0001a52 FORMAT "%5.3" /end MEASUREMENT
/begin MEASUREMENT egcp[0].egcp_struct_sigcvtipa0.fac_gain_h_r_it_ls_up "High gain of oxygen sensor internal resistance determination circuit" UWORD _CNV_A_R_EGCP_LINEA_351_CM 1 100. 0. 23.999634 DISPLAY_IDENTIFIER FAC_GAIN_H_R_IT_LS_UP[1] ECU_ADDRESS 0xd0001a54 FORMAT "%7.4" /end MEASUREMENT
/begin MEASUREMENT egcp[0].egcp_struct_sigcvtipa0.fac_gain_l_r_it_ls_up "Low gain of oxygen sensor internal resistance determination circuit" UWORD _CNV_A_R_EGCP_LINEA_351_CM 1 100. 0. 23.999634 DISPLAY_IDENTIFIER FAC_GAIN_L_R_IT_LS_UP[1] ECU_ADDRESS 0xd0001a56 FORMAT "%7.4" /end MEASUREMENT
/begin MEASUREMENT egcp[0].egcp_struct_sigcvtipa0.frq_r_it_osc_lsl_if_spi_wr "Variable indicating coded information for requested Ri determination oscillator frequency" UBYTE _CNV_A_R_LINEAR_____0_CM 1 100. 0. 127. DISPLAY_IDENTIFIER FRQ_R_IT_OSC_LSL_IF_SPI_WR[1] ECU_ADDRESS 0xd0001a58 FORMAT "%3.0" /end MEASUREMENT
/begin MEASUREMENT egcp[0].egcp_struct_sigcvtipa0.state_ttip_mes_ls_up "State variable indicating current state of function" UBYTE _CNV_S_5_EGCP_RANGE_352_CM 1 100. 0. 4. DISPLAY_IDENTIFIER STATE_TTIP_MES_LS_UP[1] ECU_ADDRESS 0xd0001a59 /end MEASUREMENT
/begin MEASUREMENT egcp[0].egcp_struct_sigcvtipa0.t_dly_r_it_iplsl_ctl_act "Delay timer for freeze of Ri signal upon activation of Ip loop" UBYTE _CNV_A_R_LINEAR_____3_CM 1 100. 0. 2.55 DISPLAY_IDENTIFIER T_DLY_R_IT_IPLSL_CTL_ACT[1] ECU_ADDRESS 0xd0001a5a FORMAT "%4.2" /end MEASUREMENT
/begin MEASUREMENT egcp[0].egcp_struct_sigcvtipa0.lv_fac_gain_h_vld_r_it_ls_up "Boolean flag indicating measured high gain valid" UBYTE _CNV_S_2_RANGE__0___1_CM 1 100. 0. 1. DISPLAY_IDENTIFIER LV_FAC_GAIN_H_VLD_R_IT_LS_UP[1] ECU_ADDRESS 0xd0001a5b BIT_MASK 0x1 /end MEASUREMENT
/begin MEASUREMENT egcp[0].egcp_struct_sigcvtipa0.lv_fac_gain_l_vld_r_it_ls_up "Boolean flag indicating measured low gain valid" UBYTE _CNV_S_2_RANGE__0___1_CM 1 100. 0. 1. DISPLAY_IDENTIFIER LV_FAC_GAIN_L_VLD_R_IT_LS_UP[1] ECU_ADDRESS 0xd0001a5c BIT_MASK 0x1 /end MEASUREMENT
/begin MEASUREMENT egcp[0].egcp_struct_sigcvtipa0.lv_r_it_cal_ena_lsl_if "Boolean flag requesting WRAF interface internal resistance adjust mode to be enabled" UBYTE _CNV_S_2_RANGE__0___1_CM 1 100. 0. 1. DISPLAY_IDENTIFIER LV_R_IT_CAL_ENA_LSL_IF[1] ECU_ADDRESS 0xd0001a5d BIT_MASK 0x1 /end MEASUREMENT
/begin MEASUREMENT egcp[0].egcp_struct_sigcvtipa0.lv_r_it_osc_ena_lsl_if "Boolean flag requesting WRAF interface internal oscillator to be enabled" UBYTE _CNV_S_2_RANGE__0___1_CM 1 100. 0. 1. DISPLAY_IDENTIFIER LV_R_IT_OSC_ENA_LSL_IF[1] ECU_ADDRESS 0xd0001a5e BIT_MASK 0x1 /end MEASUREMENT
/begin MEASUREMENT egcp[0].egcp_struct_sigcvtipa0.lv_r_it_swi_rng_lsl_if "Boolean flag requesting WRAF interface to select internal resistance gain (range)" UBYTE _CNV_S_2_RANGE__0___1_CM 1 100. 0. 1. DISPLAY_IDENTIFIER LV_R_IT_SWI_RNG_LSL_IF[1] ECU_ADDRESS 0xd0001a5f BIT_MASK 0x1 /end MEASUREMENT
/begin MEASUREMENT egcp[0].egcp_struct_sigcvtipa0.lv_ttip_mes_vld_ls_up "Boolean flag indicating validity of oxygen sensor ceramic temperature TTIP_MES_LS_UP[NC_CBK_EX_NR]" UBYTE _CNV_S_2_RANGE__0___1_CM 1 100. 0. 1. DISPLAY_IDENTIFIER LV_TTIP_MES_VLD_LS_UP[1] ECU_ADDRESS 0xd0001a60 BIT_MASK 0x1 /end MEASUREMENT
/begin MEASUREMENT egcp[0].egcp_struct_sigcvtipa0.lv_v_ofs_adj_vld_r_it_ls_up "Boolean flag indicating offset in resistance adjust mode valid" UBYTE _CNV_S_2_RANGE__0___1_CM 1 100. 0. 1. DISPLAY_IDENTIFIER LV_V_OFS_ADJ_VLD_R_IT_LS_UP[1] ECU_ADDRESS 0xd0001a61 BIT_MASK 0x1 /end MEASUREMENT
/begin MEASUREMENT egcp[0].egcp_struct_sigcvtipa0.lv_v_ofs_mes_vld_r_it_ls_up "Boolean flag indicating offset in resistance measurement mode valid" UBYTE _CNV_S_2_RANGE__0___1_CM 1 100. 0. 1. DISPLAY_IDENTIFIER LV_V_OFS_MES_VLD_R_IT_LS_UP[1] ECU_ADDRESS 0xd0001a62 BIT_MASK 0x1 /end MEASUREMENT
/begin MEASUREMENT egcp[0].egcp_struct_sigcvtipa0.lv_v_ref_vld_r_it_ls_up "Boolean flag indicating internal resistance determination circuit references valid" UBYTE _CNV_S_2_RANGE__0___1_CM 1 100. 0. 1. DISPLAY_IDENTIFIER LV_V_REF_VLD_R_IT_LS_UP[1] ECU_ADDRESS 0xd0001a63 BIT_MASK 0x1 /end MEASUREMENT
/begin MEASUREMENT egcp[0].egcp_struct_sigcvtipa0.lv_r_it_req_ls_up "Boolean flag indicating that conditions have been met and resistance determination requested" UBYTE _CNV_S_2_RANGE__0___1_CM 1 100. 0. 1. DISPLAY_IDENTIFIER LV_R_IT_REQ_LS_UP[1] ECU_ADDRESS 0xd0001a64 BIT_MASK 0x1 /end MEASUREMENT
/begin MEASUREMENT egcp[0].egcp_struct_sigcvtipai0.lv_inh_ttip_ls_up "Boolean flag indicating that upstream oxygen sensor ceramic temperature determination shall be inhibited " UBYTE _CNV_S_2_RANGE__0___1_CM 1 100. 0. 1. DISPLAY_IDENTIFIER LV_INH_TTIP_LS_UP[1] ECU_ADDRESS 0xd0001a66 BIT_MASK 0x1 /end MEASUREMENT
/begin MEASUREMENT egcp[0].egcp_struct_sigdglsd1.t_act_pls_diag_scg_ls_down "Delay time for final diagnosis activation " UWORD _CNV_A_R_LINEAR_____4_CM 1 100. 0. 6553.5 DISPLAY_IDENTIFIER T_ACT_PLS_DIAG_SCG_LS_DOWN[1] ECU_ADDRESS 0xd0001a68 FORMAT "%6.1" /end MEASUREMENT
/begin MEASUREMENT egcp[0].egcp_struct_sigdglsd1.t_act_pls_diag_oc_ls_down "Delay time for final diagnosis activation " UWORD _CNV_A_R_LINEAR_____4_CM 1 100. 0. 6553.5 DISPLAY_IDENTIFIER T_ACT_PLS_DIAG_OC_LS_DOWN[1] ECU_ADDRESS 0xd0001a6a FORMAT "%6.1" /end MEASUREMENT
/begin MEASUREMENT egcp[0].egcp_struct_sigdglsd1.t_cdn_diag_oc_ls_down "Detection time for status OC before diagnosis" UWORD _CNV_A_R_LINEAR_____4_CM 1 100. 0. 6553.5 DISPLAY_IDENTIFIER T_CDN_DIAG_OC_LS_DOWN[1] ECU_ADDRESS 0xd0001a6c FORMAT "%6.1" /end MEASUREMENT
/begin MEASUREMENT egcp[0].egcp_struct_sigdglsd1.ctr_r_upd_diag_scg_ls_down "Value of handshake counter for last valid resistance value used for short circuit to ground diagnosis" UWORD _CNV_A_R_LINEAR_____0_CM 1 100. 0. 65535. DISPLAY_IDENTIFIER CTR_R_UPD_DIAG_SCG_LS_DOWN[1] ECU_ADDRESS 0xd0001a6e FORMAT "%5.0" /end MEASUREMENT
/begin MEASUREMENT egcp[0].egcp_struct_sigdglsd1.ctr_r_upd_diag_oc_ls_down "Value of handshake counter for last valid resistance value used for diagnosis" UWORD _CNV_A_R_LINEAR_____0_CM 1 100. 0. 65535. DISPLAY_IDENTIFIER CTR_R_UPD_DIAG_OC_LS_DOWN[1] ECU_ADDRESS 0xd0001a70 FORMAT "%5.0" /end MEASUREMENT
/begin MEASUREMENT egcp[0].egcp_struct_sigdglsd1.ctr_sym_diag_scg_ls_down "Detection time for SCG " UBYTE _CNV_A_R_LINEAR_____0_CM 1 100. 0. 255. DISPLAY_IDENTIFIER CTR_SYM_DIAG_SCG_LS_DOWN[1] ECU_ADDRESS 0xd0001a72 FORMAT "%3.0" /end MEASUREMENT
/begin MEASUREMENT egcp[0].egcp_struct_sigdglsd1.lv_err_el_ls_down "Boolean error flag, electrical fault currently present on downstream oxygen sensor signal" UBYTE _CNV_S_2_RANGE__0___1_CM 1 100. 0. 1. DISPLAY_IDENTIFIER LV_ERR_EL_LS_DOWN[1] ECU_ADDRESS 0xd0001a73 BIT_MASK 0x1 /end MEASUREMENT
/begin MEASUREMENT egcp[0].egcp_struct_sigdglsd1.lv_diag_act_req_ls_down "Request for starting the downstream sensor active plausibility check" UBYTE _CNV_S_2_RANGE__0___1_CM 1 100. 0. 1. DISPLAY_IDENTIFIER LV_DIAG_ACT_REQ_LS_DOWN[1] ECU_ADDRESS 0xd0001a74 BIT_MASK 0x1 /end MEASUREMENT
/begin MEASUREMENT egcp[0].egcp_struct_sigdglsd1.lv_r_it_vld_diag_oc_ls_down "Valid conditions of resistance of downstream oxygen sensor open circuit diagnosis" UBYTE _CNV_S_2_RANGE__0___1_CM 1 100. 0. 1. DISPLAY_IDENTIFIER LV_R_IT_VLD_DIAG_OC_LS_DOWN[1] ECU_ADDRESS 0xd0001a75 BIT_MASK 0x1 /end MEASUREMENT
/begin MEASUREMENT egcp[0].egcp_struct_sigdglsd1.lv_t_cdn_diag_oc_ls_down "Boolean error flag, short to plus fault currently present on downstream oxygen sensor signal" UBYTE _CNV_S_2_RANGE__0___1_CM 1 100. 0. 1. DISPLAY_IDENTIFIER LV_T_CDN_DIAG_OC_LS_DOWN[1] ECU_ADDRESS 0xd0001a76 BIT_MASK 0x1 /end MEASUREMENT
/begin MEASUREMENT egcp[0].egcp_struct_sigcvlsl3.vls_up "Upstream Oxygen sensor voltage" UWORD _CNV_A_R_LINEAR_____2_CM 1 100. 0. 4.9951171875 DISPLAY_IDENTIFIER VLS_UP[1] ECU_ADDRESS 0xd0001b9a FORMAT "%5.3" /end MEASUREMENT
/begin MEASUREMENT egcp[0].egcp_struct_sigcvlsl3.vls_up_10_raw "Raw value of WRAF sensor voltage signal - Recurrence 10.0 msec" UWORD _CNV_A_R_LINEAR_____2_CM 1 100. 0. 4.9951171875 DISPLAY_IDENTIFIER VLS_UP_10_RAW[1] ECU_ADDRESS 0xd0001b9c FORMAT "%5.3" /end MEASUREMENT
/begin MEASUREMENT egcp[0].egcp_struct_sigcvlsl3.lv_vls_up_vld "Boolean flag indicating whether clipping of the WRAF sensor signal is taking place (1 - No clipping, 0 - clipping)" UBYTE _CNV_S_2_RANGE__0___1_CM 1 100. 0. 1. DISPLAY_IDENTIFIER LV_VLS_UP_VLD[1] ECU_ADDRESS 0xd0001b9e BIT_MASK 0x1 /end MEASUREMENT
/begin MEASUREMENT egcp[0].egcp_struct_sigcvlsl3.lv_vls_up_init "Boolean flag indicating the buffer initialisation after switching between Gain 16 & Gain 8 values of WRAF Controller or after Offset adjustment of WRAF sensor" UBYTE _CNV_S_2_RANGE__0___1_CM 1 100. 0. 1. DISPLAY_IDENTIFIER LV_VLS_UP_INIT[1] ECU_ADDRESS 0xd0001b9f BIT_MASK 0x1 /end MEASUREMENT
/begin MEASUREMENT egcp[0].egcp_struct_adcprlsli1.lv_inh_lsl_ofs_adj "Boolean flag indicating that upstream oxygen sensor Ip offset adjustment shall be inhibited" UBYTE _CNV_S_2_RANGE__0___1_CM 1 100. 0. 1. DISPLAY_IDENTIFIER LV_INH_LSL_OFS_ADJ[1] ECU_ADDRESS 0xd0001ba6 BIT_MASK 0x1 /end MEASUREMENT
/begin MEASUREMENT egcp[1].egcp_struct_acctlifa0.ctr_icplsl "Counter used to approximate filling & emptying of WRAF sensor pumped reference area" UWORD _CNV_A_R_LINEAR_____0_CM 1 100. 0. 65535. DISPLAY_IDENTIFIER CTR_ICPLSL[2] ECU_ADDRESS 0xd0001bf0 FORMAT "%5.0" /end MEASUREMENT
/begin MEASUREMENT egcp[1].egcp_struct_acctlifa0.ctr_icplsl_max "Delay for filling and emptying of WRAF sensor pumped reference area" UWORD _CNV_A_R_LINEAR_____0_CM 1 100. 0. 65535. DISPLAY_IDENTIFIER CTR_ICPLSL_MAX[2] ECU_ADDRESS 0xd0001bf2 FORMAT "%5.0" /end MEASUREMENT
/begin MEASUREMENT egcp[1].egcp_struct_acctlifa0.t_icplsl_dly_pwl "Delay timer for limited Icp supply during ECU power latch" UWORD _CNV_A_R_LINEAR_____3_CM 1 100. 0. 655.35 DISPLAY_IDENTIFIER T_ICPLSL_DLY_PWL[2] ECU_ADDRESS 0xd0001bf4 FORMAT "%6.2" /end MEASUREMENT
/begin MEASUREMENT egcp[1].egcp_struct_acctlifa0.lamb_thd_vplsl_lim "Threshold for Vp limitation in terms of lambda" UWORD _CNV_A_R_LINEAR_____122_CM 1 100. 0. 31.9990234375 DISPLAY_IDENTIFIER LAMB_THD_VPLSL_LIM[2] ECU_ADDRESS 0xd0001bf6 FORMAT "%7.4" /end MEASUREMENT
/begin MEASUREMENT egcp[1].egcp_struct_acctlifa0.lamb_thd_tmp_vplsl_lim "Intermediate storage variable of threshold for Vp limitation in terms of lambda" UWORD _CNV_A_R_LINEAR_____122_CM 1 100. 0. 31.9990234375 DISPLAY_IDENTIFIER LAMB_THD_TMP_VPLSL_LIM[2] ECU_ADDRESS 0xd0001bf8 FORMAT "%7.4" /end MEASUREMENT
/begin MEASUREMENT egcp[1].egcp_struct_acctlifa0.t_dly_vnlsl_lim_act "Timer for limitation of duration of Ip control loop inhibition due to Icp cut-off / Vn overvoltage conditions" UWORD _CNV_A_R_LINEAR_____3_CM 1 100. 0. 655.35 DISPLAY_IDENTIFIER T_DLY_VNLSL_LIM_ACT[2] ECU_ADDRESS 0xd0001bfa FORMAT "%6.2" /end MEASUREMENT
/begin MEASUREMENT egcp[1].egcp_struct_acctlifa0.t_iplsl_not_vld_vb_l "Delay timer for possible occurence of increased heater coupling due to permanent battery undervoltage" UWORD _CNV_A_R_LINEAR_____3_CM 1 100. 0. 655.35 DISPLAY_IDENTIFIER T_IPLSL_NOT_VLD_VB_L[2] ECU_ADDRESS 0xd0001bfc FORMAT "%6.2" /end MEASUREMENT
/begin MEASUREMENT egcp[1].egcp_struct_acctlifa0.t_iplsl_not_vld_vb_l_thd "Upper limit of delay timer for possible occurence of increased heater coupling" UWORD _CNV_A_R_LINEAR_____3_CM 1 100. 0. 655.35 DISPLAY_IDENTIFIER T_IPLSL_NOT_VLD_VB_L_THD[2] ECU_ADDRESS 0xd0001bfe FORMAT "%6.2" /end MEASUREMENT
/begin MEASUREMENT egcp[1].egcp_struct_acctlifa0.r_it_iplsl "Internal DC resistance of WRAF sensor pump cell" UWORD _CNV_A_R_EGCP_LINEA_316_CM 1 100. 0. 16383.75 DISPLAY_IDENTIFIER R_IT_IPLSL[2] ECU_ADDRESS 0xd0001c00 FORMAT "%9.2" /end MEASUREMENT
/begin MEASUREMENT egcp[1].egcp_struct_acctlifa0.vplsl "Voltage across WRAF sensor pump cell (VIP-VG)" SBYTE _CNV_A_R_EGCP_LINEA_317_CM 1 100. -3.224 3.198813 DISPLAY_IDENTIFIER VPLSL[2] ECU_ADDRESS 0xd0001c02 FORMAT "%5.2" /end MEASUREMENT
/begin MEASUREMENT egcp[1].egcp_struct_acctlifa0.t_dly_iplsl_ctl_ena "Delay timer for validation of Ip after enabling of Ip control loop" UBYTE _CNV_A_R_LINEAR_____3_CM 1 100. 0. 2.55 DISPLAY_IDENTIFIER T_DLY_IPLSL_CTL_ENA[2] ECU_ADDRESS 0xd0001c03 FORMAT "%4.2" /end MEASUREMENT
/begin MEASUREMENT egcp[1].egcp_struct_acctlifa0.icplsl_lsl_if "Value of the pumping current for filling of WRAF sensor oxygen reference (Icp)" UBYTE _CNV_A_R_LINEAR_____0_CM 1 100. 0. 31. DISPLAY_IDENTIFIER ICPLSL_LSL_IF[2] ECU_ADDRESS 0xd0001c04 FORMAT "%2.0" /end MEASUREMENT
/begin MEASUREMENT egcp[1].egcp_struct_acctlifa0.ctr_iplsl_ctl_ena_nr_cyc "Cycle counter for pulsed activation of pump current" UBYTE _CNV_A_R_LINEAR_____0_CM 1 100. 0. 255. DISPLAY_IDENTIFIER CTR_IPLSL_CTL_ENA_NR_CYC[2] ECU_ADDRESS 0xd0001c05 FORMAT "%3.0" /end MEASUREMENT
/begin MEASUREMENT egcp[1].egcp_struct_acctlifa0.ctr_iplsl_ctl_ena_pwm_on "Counter for duration of \" Ip on \" phase during pulsed activation of pump current " UBYTE _CNV_A_R_LINEAR_____0_CM 1 100. 0. 255. DISPLAY_IDENTIFIER CTR_IPLSL_CTL_ENA_PWM_ON[2] ECU_ADDRESS 0xd0001c06 FORMAT "%3.0" /end MEASUREMENT
/begin MEASUREMENT egcp[1].egcp_struct_acctlifa0.ctr_iplsl_ctl_ena_pwm_off "Counter for duration of \" Ip off \" phase during pulsed activation of pump current " UBYTE _CNV_A_R_LINEAR_____0_CM 1 100. 0. 255. DISPLAY_IDENTIFIER CTR_IPLSL_CTL_ENA_PWM_OFF[2] ECU_ADDRESS 0xd0001c07 FORMAT "%3.0" /end MEASUREMENT
/begin MEASUREMENT egcp[1].egcp_struct_acctlifa0.lv_icplsl_ena_lsl_if "Boolean flag requesting activation / deactivation of pumped-reference pumping current (Icp)" UBYTE _CNV_S_2_RANGE__0___1_CM 1 100. 0. 1. DISPLAY_IDENTIFIER LV_ICPLSL_ENA_LSL_IF[2] ECU_ADDRESS 0xd0001c08 BIT_MASK 0x1 /end MEASUREMENT
/begin MEASUREMENT egcp[1].egcp_struct_acctlifa0.lv_icplsl_vld "Boolean flag indicating that WRAF pumped reference is filled" UBYTE _CNV_S_2_RANGE__0___1_CM 1 100. 0. 1. DISPLAY_IDENTIFIER LV_ICPLSL_VLD[2] ECU_ADDRESS 0xd0001c09 BIT_MASK 0x1 /end MEASUREMENT
/begin MEASUREMENT egcp[1].egcp_struct_acctlifa0.lv_iplsl_ctl_ena_lsl_if "Boolean flag requesting activation / deactivation of pump current (Ip) Controller" UBYTE _CNV_S_2_RANGE__0___1_CM 1 100. 0. 1. DISPLAY_IDENTIFIER LV_IPLSL_CTL_ENA_LSL_IF[2] ECU_ADDRESS 0xd0001c0a BIT_MASK 0x1 /end MEASUREMENT
/begin MEASUREMENT egcp[1].egcp_struct_acctlifa0.lv_iplsl_ctl_inh_vplsl_lim "Boolean flag indicating that pump current control is inhibited by active active pumping voltage (Vp) limitation conditions" UBYTE _CNV_S_2_RANGE__0___1_CM 1 100. 0. 1. DISPLAY_IDENTIFIER LV_IPLSL_CTL_INH_VPLSL_LIM[2] ECU_ADDRESS 0xd0001c0b BIT_MASK 0x1 /end MEASUREMENT
/begin MEASUREMENT egcp[1].egcp_struct_acctlifa0.lv_iplsl_vld "Boolean flag indicating that WRAF sensor pump current is valid" UBYTE _CNV_S_2_RANGE__0___1_CM 1 100. 0. 1. DISPLAY_IDENTIFIER LV_IPLSL_VLD[2] ECU_ADDRESS 0xd0001c0c BIT_MASK 0x1 /end MEASUREMENT
/begin MEASUREMENT egcp[1].egcp_struct_acctlifa0.lv_iplsl_ctl_ena_pls_act "Boolean flag indicating that pulsed activation of pump current is active" UBYTE _CNV_S_2_RANGE__0___1_CM 1 100. 0. 1. DISPLAY_IDENTIFIER LV_IPLSL_CTL_ENA_PLS_ACT[2] ECU_ADDRESS 0xd0001c0d BIT_MASK 0x1 /end MEASUREMENT
/begin MEASUREMENT egcp[1].egcp_struct_acctlifa0.lv_lamb_ls_up_vld "Boolean flag indicating that lambda signal from WRAF system is reliable and up-to-date" UBYTE _CNV_S_2_RANGE__0___1_CM 1 100. 0. 1. DISPLAY_IDENTIFIER LV_LAMB_LS_UP_VLD[2] ECU_ADDRESS 0xd0001c0e BIT_MASK 0x1 /end MEASUREMENT
/begin MEASUREMENT egcp[1].egcp_struct_acctlifa0.lv_iplsl_ctl_inh_vnlsl_lim "Boolean flag indicating that pump current control is inhibited by active Icp cut-off / Vn overvoltage conditions" UBYTE _CNV_S_2_RANGE__0___1_CM 1 100. 0. 1. DISPLAY_IDENTIFIER LV_IPLSL_CTL_INH_VNLSL_LIM[2] ECU_ADDRESS 0xd0001c0f BIT_MASK 0x1 /end MEASUREMENT
/begin MEASUREMENT egcp[1].egcp_struct_acctlifa0.lv_vplsl_lim_act "Boolean flag indicating active pumping voltage (Vp) limitation conditions" UBYTE _CNV_S_2_RANGE__0___1_CM 1 100. 0. 1. DISPLAY_IDENTIFIER LV_VPLSL_LIM_ACT[2] ECU_ADDRESS 0xd0001c10 BIT_MASK 0x1 /end MEASUREMENT
/begin MEASUREMENT egcp[1].egcp_struct_acctlifa0.lv_iplsl_not_vld_vb_l "Boolean flag indicating that increased heater-coupling due to permanent battery undervoltage might be present" UBYTE _CNV_S_2_RANGE__0___1_CM 1 100. 0. 1. DISPLAY_IDENTIFIER LV_IPLSL_NOT_VLD_VB_L[2] ECU_ADDRESS 0xd0001c11 BIT_MASK 0x1 /end MEASUREMENT
/begin MEASUREMENT egcp[1].egcp_struct_acctllshdi0.temp_ini_ls_down "Oxygen sensor temperature at start" SWORD _CNV_A_R_LINEAR_____123_CM 1 100. -2048. 2047.9375 DISPLAY_IDENTIFIER TEMP_INI_LS_DOWN[2] ECU_ADDRESS 0xd0001c22 FORMAT "%10.4" /end MEASUREMENT
/begin MEASUREMENT egcp[1].egcp_struct_acctllshdi0.lshpwm_ext_ls_down "Downstream heater PWM duty cycle preset from external tester" UBYTE _CNV_A_R_LINEAR_____5_CM 1 100. 0. 99.609375 DISPLAY_IDENTIFIER LSHPWM_EXT_LS_DOWN[2] ECU_ADDRESS 0xd0001c24 FORMAT "%9.6" /end MEASUREMENT
/begin MEASUREMENT egcp[1].egcp_struct_acctllshdi0.lv_inh_lsh_down "Boolean flag indicating project specific application conditions for heating not met" UBYTE _CNV_S_2_RANGE__0___1_CM 1 100. 0. 1. DISPLAY_IDENTIFIER LV_INH_LSH_DOWN[2] ECU_ADDRESS 0xd0001c25 BIT_MASK 0x1 /end MEASUREMENT
/begin MEASUREMENT egcp[1].egcp_struct_acctllshi0.temp_ini_ls_up "Oxygen sensor temperature at engine start" SWORD _CNV_A_R_LINEAR_____123_CM 1 100. -2048. 2047.9375 DISPLAY_IDENTIFIER TEMP_INI_LS_UP[2] ECU_ADDRESS 0xd0001c26 FORMAT "%10.4" /end MEASUREMENT
/begin MEASUREMENT egcp[1].egcp_struct_acctllshi0.lshpwm_ext_ls_up "Upstream heater PWM duty cycle preset from external tester" UBYTE _CNV_A_R_LINEAR_____5_CM 1 100. 0. 99.609375 DISPLAY_IDENTIFIER LSHPWM_EXT_LS_UP[2] ECU_ADDRESS 0xd0001c28 FORMAT "%9.6" /end MEASUREMENT
/begin MEASUREMENT egcp[1].egcp_struct_acctllshi0.lv_inh_lsh_ctl_cll_lsh_up "Boolean flag indicating project specific application conditions closed loop heater control not met" UBYTE _CNV_S_2_RANGE__0___1_CM 1 100. 0. 1. DISPLAY_IDENTIFIER LV_INH_LSH_CTL_CLL_LSH_UP[2] ECU_ADDRESS 0xd0001c29 BIT_MASK 0x1 /end MEASUREMENT
/begin MEASUREMENT egcp[1].egcp_struct_acctllshi0.lv_inh_lsh_up "Boolean flag indicating project specific application conditions for heating not met" UBYTE _CNV_S_2_RANGE__0___1_CM 1 100. 0. 1. DISPLAY_IDENTIFIER LV_INH_LSH_UP[2] ECU_ADDRESS 0xd0001c2a BIT_MASK 0x1 /end MEASUREMENT
/begin MEASUREMENT egcp[1].egcp_struct_adcprlsl2.iplsl_vari_purge "Variance of corrected pumping current during fuel cut at purged condition" ULONG _CNV_A_R_EGCP_LINEA_325_CM 1 100. 0. 634.636864 DISPLAY_IDENTIFIER IPLSL_VARI_PURGE[2] ECU_ADDRESS 0xd0001c68 FORMAT "%11.6" /end MEASUREMENT
/begin MEASUREMENT egcp[1].egcp_struct_adcprlsl2.iplsl_vari_vld_fcut "Moving variance of valid samples of pumping current during fuel cut" ULONG _CNV_A_R_EGCP_LINEA_325_CM 1 100. 0. 634.636864 DISPLAY_IDENTIFIER IPLSL_VARI_VLD_FCUT[2] ECU_ADDRESS 0xd0001c6c FORMAT "%11.6" /end MEASUREMENT
/begin MEASUREMENT egcp[1].egcp_struct_adcprlsl2.iplsl_purge "Compensated (excluding factor for gain adaptation)  pumping current during fuel cut at purged condition" SWORD _CNV_A_R_LINEAR_____328_CM 1 100. -12.596 12.595 DISPLAY_IDENTIFIER IPLSL_PURGE[2] ECU_ADDRESS 0xd0001c70 FORMAT "%8.4" /end MEASUREMENT
/begin MEASUREMENT egcp[1].egcp_struct_adcprlsl2.iplsl_cor_mmv_fcut "Moving mean value of corrected pumping current during fuel cut" SWORD _CNV_A_R_LINEAR_____328_CM 1 100. -12.596 12.595 DISPLAY_IDENTIFIER IPLSL_COR_MMV_FCUT[2] ECU_ADDRESS 0xd0001c72 FORMAT "%8.4" /end MEASUREMENT
/begin MEASUREMENT egcp[1].egcp_struct_adcprlsl2.iplsl_mv_purge "Arithmetic mean of compensated pumping current during fuel cut at purged condition" SWORD _CNV_A_R_LINEAR_____328_CM 1 100. -12.596 12.595 DISPLAY_IDENTIFIER IPLSL_MV_PURGE[2] ECU_ADDRESS 0xd0001c74 FORMAT "%8.4" /end MEASUREMENT
/begin MEASUREMENT egcp[1].egcp_struct_adcprlsl2.iplsl_cor_beg_purge "Corrected pumping current during fuel cut at begin of purged condition" SWORD _CNV_A_R_LINEAR_____328_CM 1 100. -12.596 12.595 DISPLAY_IDENTIFIER IPLSL_COR_BEG_PURGE[2] ECU_ADDRESS 0xd0001c76 FORMAT "%8.4" /end MEASUREMENT
/begin MEASUREMENT egcp[1].egcp_struct_adcprlsl2.iplsl_cor_chg_purge "Change of corrected pumping current during acquisition at purged condition" SWORD _CNV_A_R_LINEAR_____328_CM 1 100. -12.596 12.595 DISPLAY_IDENTIFIER IPLSL_COR_CHG_PURGE[2] ECU_ADDRESS 0xd0001c78 FORMAT "%8.4" /end MEASUREMENT
/begin MEASUREMENT egcp[1].egcp_struct_adcprlsl2.iplsl_mmv_vld_fcut "Moving mean of valid samples of pumping current during fuel cut" SWORD _CNV_A_R_LINEAR_____328_CM 1 100. -12.596 12.595 DISPLAY_IDENTIFIER IPLSL_MMV_VLD_FCUT[2] ECU_ADDRESS 0xd0001c7a FORMAT "%8.4" /end MEASUREMENT
/begin MEASUREMENT egcp[1].egcp_struct_adcprlsl2.fac_lsl_gain_ad "Adaptive factor for WRAF sensor gain" UWORD _CNV_A_R_LINEAR_____8_CM 1 100. 0. 1.99996948242188 DISPLAY_IDENTIFIER FAC_LSL_GAIN_AD[2] ECU_ADDRESS 0xd0001c7c FORMAT "%7.5" /end MEASUREMENT
/begin MEASUREMENT egcp[1].egcp_struct_adcprlsl2.t_acq_iplsl_purge "Timer for acquisition interval of compensated pumping current during fuel cut at purged condition" UBYTE _CNV_A_R_LINEAR_____4_CM 1 100. 0. 25.5 DISPLAY_IDENTIFIER T_ACQ_IPLSL_PURGE[2] ECU_ADDRESS 0xd0001c7e FORMAT "%4.1" /end MEASUREMENT
/begin MEASUREMENT egcp[1].egcp_struct_adcprlsl2.t_dly_iplsl_cor_mmv_fcut_vld "Delay timer for retry of gain adaptation upon detection of possible saturation effects on Ip measurement" UBYTE _CNV_A_R_LINEAR_____4_CM 1 100. 0. 25.5 DISPLAY_IDENTIFIER T_DLY_IPLSL_COR_MMV_FCUT_VLD[2] ECU_ADDRESS 0xd0001c7f FORMAT "%4.1" /end MEASUREMENT
/begin MEASUREMENT egcp[1].egcp_struct_adcprlsl2.state_iplsl_ad_fcut "State of fuel cut gain adaptation procedure" UBYTE _CNV_S_5_EGCP_RANGE_339_CM 1 100. 0. 4. DISPLAY_IDENTIFIER STATE_IPLSL_AD_FCUT[2] ECU_ADDRESS 0xd0001c80 /end MEASUREMENT
/begin MEASUREMENT egcp[1].egcp_struct_adcprlsl2.state_iplsl_gain_ad "State of WRAF sensor gain adaptation factor" UBYTE _CNV_S_4_EGCP_RANGE_340_CM 1 100. 0. 3. DISPLAY_IDENTIFIER STATE_IPLSL_GAIN_AD[2] ECU_ADDRESS 0xd0001c81 /end MEASUREMENT
/begin MEASUREMENT egcp[1].egcp_struct_adcprlsl2.lv_lsl_gain_ad_req "Request for fuel cut Ip measurement" UBYTE _CNV_S_2_RANGE__0___1_CM 1 100. 0. 1. DISPLAY_IDENTIFIER LV_LSL_GAIN_AD_REQ[2] ECU_ADDRESS 0xd0001c82 BIT_MASK 0x1 /end MEASUREMENT
/begin MEASUREMENT egcp[1].egcp_struct_adcprlsl2.lv_lsl_gain_ad_req_vld "Validation of request for fuel cut Ip measurement" UBYTE _CNV_S_2_RANGE__0___1_CM 1 100. 0. 1. DISPLAY_IDENTIFIER LV_LSL_GAIN_AD_REQ_VLD[2] ECU_ADDRESS 0xd0001c83 BIT_MASK 0x1 /end MEASUREMENT
/begin MEASUREMENT egcp[1].egcp_struct_adcprlsl2.lv_iplsl_vld_fcut "Valid Ip sample has been acquired during current fuel cut" UBYTE _CNV_S_2_RANGE__0___1_CM 1 100. 0. 1. DISPLAY_IDENTIFIER LV_IPLSL_VLD_FCUT[2] ECU_ADDRESS 0xd0001c84 BIT_MASK 0x1 /end MEASUREMENT
/begin MEASUREMENT egcp[1].egcp_struct_adcprlsl2.lv_lsl_fcut_mes_rep_inh "Status flag indicating successful fuel cut Ip measurement during current PUC phase" UBYTE _CNV_S_2_RANGE__0___1_CM 1 100. 0. 1. DISPLAY_IDENTIFIER LV_LSL_FCUT_MES_REP_INH[2] ECU_ADDRESS 0xd0001c85 BIT_MASK 0x1 /end MEASUREMENT
/begin MEASUREMENT egcp[1].egcp_struct_adcprlsl2.lv_lsl_fcut_mes_not_plaus "Actual fuel cut Ip measurement not plausible" UBYTE _CNV_S_2_RANGE__0___1_CM 1 100. 0. 1. DISPLAY_IDENTIFIER LV_LSL_FCUT_MES_NOT_PLAUS[2] ECU_ADDRESS 0xd0001c86 BIT_MASK 0x1 /end MEASUREMENT
/begin MEASUREMENT egcp[1].egcp_struct_adcprlsl2.lv_lsl_gain_ad_fcut_not_ok "Factor for gain adaptation out of valid range" UBYTE _CNV_S_2_RANGE__0___1_CM 1 100. 0. 1. DISPLAY_IDENTIFIER LV_LSL_GAIN_AD_FCUT_NOT_OK[2] ECU_ADDRESS 0xd0001c87 BIT_MASK 0x1 /end MEASUREMENT
/begin MEASUREMENT egcp[1].egcp_struct_adcprlsl2.lv_fac_lsl_gain_ad_lim_max "Status flag for limitation of WRAF gain adaptation factor to maximum" UBYTE _CNV_S_2_RANGE__0___1_CM 1 100. 0. 1. DISPLAY_IDENTIFIER LV_FAC_LSL_GAIN_AD_LIM_MAX[2] ECU_ADDRESS 0xd0001c88 BIT_MASK 0x1 /end MEASUREMENT
/begin MEASUREMENT egcp[1].egcp_struct_adcprlsl2.lv_fac_lsl_gain_ad_lim_min "Status flag for limitation of WRAF gain adaptation factor to minimum" UBYTE _CNV_S_2_RANGE__0___1_CM 1 100. 0. 1. DISPLAY_IDENTIFIER LV_FAC_LSL_GAIN_AD_LIM_MIN[2] ECU_ADDRESS 0xd0001c89 BIT_MASK 0x1 /end MEASUREMENT
/begin MEASUREMENT egcp[1].egcp_struct_adcprlsl2.lv_iplsl_cor_mmv_fcut_vld "Boolean flag stating validity of latest moving mean value of corrected pumping current during PUC" UBYTE _CNV_S_2_RANGE__0___1_CM 1 100. 0. 1. DISPLAY_IDENTIFIER LV_IPLSL_COR_MMV_FCUT_VLD[2] ECU_ADDRESS 0xd0001c8a BIT_MASK 0x1 /end MEASUREMENT
/begin MEASUREMENT egcp[1].egcp_struct_adcprlsli2.lv_inh_lsl_gain_ad "WRAF sensor Gain Adaptation: application incidences for inhibition" UBYTE _CNV_S_2_RANGE__0___1_CM 1 100. 0. 1. DISPLAY_IDENTIFIER LV_INH_LSL_GAIN_AD[2] ECU_ADDRESS 0xd0001c8c BIT_MASK 0x1 /end MEASUREMENT
/begin MEASUREMENT egcp[1].egcp_struct_sigcv0.vls_up_raw "Raw value of upstream oxygen sensor voltage" UWORD _CNV_A_R_LINEAR_____2_CM 1 100. 0. 4.9951171875 DISPLAY_IDENTIFIER VLS_UP_RAW[2] ECU_ADDRESS 0xd0001ca4 FORMAT "%5.3" /end MEASUREMENT
/begin MEASUREMENT egcp[1].egcp_struct_sigcv0.vls_down "Downstream oxygen sensor voltage" UWORD _CNV_A_R_LINEAR_____2_CM 1 100. 0. 4.9951171875 DISPLAY_IDENTIFIER VLS_DOWN[2] ECU_ADDRESS 0xd0001ca6 FORMAT "%5.3" /end MEASUREMENT
/begin MEASUREMENT egcp[1].egcp_struct_sigcv0.v_temp_ls_up "Upstream lambda sensor temperature voltage" UWORD _CNV_A_R_LINEAR_____2_CM 1 100. 0. 4.9951171875 DISPLAY_IDENTIFIER V_TEMP_LS_UP[2] ECU_ADDRESS 0xd0001ca8 FORMAT "%5.3" /end MEASUREMENT
/begin MEASUREMENT egcp[1].egcp_struct_ispclls0.ctr_afl_cyc "Counter indicating number of air fuel cycles" UWORD _CNV_A_R_LINEAR_____0_CM 1 100. 0. 65535. DISPLAY_IDENTIFIER CTR_AFL_CYC[2] ECU_ADDRESS 0xd0001cac FORMAT "%5.0" /end MEASUREMENT
/begin MEASUREMENT egcp[1].egcp_struct_ispclls0.t_afr_cyc "Rich mixture cycle time" UWORD _CNV_A_R_LINEAR_____3_CM 1 100. 0. 655.35 DISPLAY_IDENTIFIER T_AFR_CYC[2] ECU_ADDRESS 0xd0001cae FORMAT "%6.2" /end MEASUREMENT
/begin MEASUREMENT egcp[1].egcp_struct_ispclls0.t_afl_cyc "Lean mixture cycle time" UWORD _CNV_A_R_LINEAR_____3_CM 1 100. 0. 655.35 DISPLAY_IDENTIFIER T_AFL_CYC[2] ECU_ADDRESS 0xd0001cb0 FORMAT "%6.2" /end MEASUREMENT
/begin MEASUREMENT egcp[1].egcp_struct_ispclls0.t_afl_cyc_hld "Lean mixture cycle time, held until next new value available" UWORD _CNV_A_R_LINEAR_____3_CM 1 100. 0. 655.35 DISPLAY_IDENTIFIER T_AFL_CYC_HLD[2] ECU_ADDRESS 0xd0001cb2 FORMAT "%6.2" /end MEASUREMENT
/begin MEASUREMENT egcp[1].egcp_struct_ispclls0.t_sum_afl_afr_cyc "Lean plus rich mixture cycle time; time of last forced lambda stimulation period" UWORD _CNV_A_R_LINEAR_____3_CM 1 100. 0. 655.35 DISPLAY_IDENTIFIER T_SUM_AFL_AFR_CYC[2] ECU_ADDRESS 0xd0001cb4 FORMAT "%6.2" /end MEASUREMENT
/begin MEASUREMENT egcp[1].egcp_struct_ispclls0.lv_afl "Boolean flag indicating detection of lean Air-Fuel mixture when set" UBYTE _CNV_S_2_RANGE__0___1_CM 1 100. 0. 1. DISPLAY_IDENTIFIER LV_AFL[2] ECU_ADDRESS 0xd0001cb6 BIT_MASK 0x1 /end MEASUREMENT
/begin MEASUREMENT egcp[1].egcp_struct_outdglsh0.err_diag_lsh_up "diagnosis condition for each symptom of upstream heater diagnosis OBD I" UBYTE _CNV_A_R_LINEAR_____0_CM 1 100. 0. 7. DISPLAY_IDENTIFIER ERR_DIAG_LSH_UP[2] ECU_ADDRESS 0xd0001cb8 FORMAT "%3.0" /end MEASUREMENT
/begin MEASUREMENT egcp[1].egcp_struct_outdglsh0.cdn_diag_lsh_up "Diagnosis condition for each symptom of upstream heater diagnosis OBD I" UBYTE _CNV_A_R_LINEAR_____0_CM 1 100. 0. 7. DISPLAY_IDENTIFIER CDN_DIAG_LSH_UP[2] ECU_ADDRESS 0xd0001cb9 FORMAT "%3.0" /end MEASUREMENT
/begin MEASUREMENT egcp[1].egcp_struct_outdglsh0.lv_lsh_scg_act_lsh_up "Boolean flag indicating that debounce for upstream heater OBD I SCG diagnosis active" UBYTE _CNV_S_2_RANGE__0___1_CM 1 100. 0. 1. DISPLAY_IDENTIFIER LV_LSH_SCG_ACT_LSH_UP[2] ECU_ADDRESS 0xd0001cba /end MEASUREMENT
/begin MEASUREMENT egcp[1].egcp_struct_outdglshd0.err_diag_lsh_down "raw value of error symptom for downstream heater diagnosis OBD I" UBYTE _CNV_A_R_LINEAR_____0_CM 1 100. 0. 7. DISPLAY_IDENTIFIER ERR_DIAG_LSH_DOWN[2] ECU_ADDRESS 0xd0001cbe FORMAT "%3.0" /end MEASUREMENT
/begin MEASUREMENT egcp[1].egcp_struct_outdglshd0.cdn_diag_lsh_down "Diagnosis condition for each symptom of downstream heater diagnosis OBD I" UBYTE _CNV_A_R_LINEAR_____0_CM 1 100. 0. 7. DISPLAY_IDENTIFIER CDN_DIAG_LSH_DOWN[2] ECU_ADDRESS 0xd0001cbf FORMAT "%3.0" /end MEASUREMENT
/begin MEASUREMENT egcp[1].egcp_struct_pladglsd2.lv_diag_cdn_plaus_ls_down "Boolean flag, plausibility check on downstream oxygen sensor signal possible" UBYTE _CNV_S_2_RANGE__0___1_CM 1 100. 0. 1. DISPLAY_IDENTIFIER LV_DIAG_CDN_PLAUS_LS_DOWN[2] ECU_ADDRESS 0xd0001cc2 BIT_MASK 0x1 /end MEASUREMENT
/begin MEASUREMENT egcp[1].egcp_struct_pladglsd2.lv_err_plaus_ls_down "Boolean flag, error plausibility check on downstream oxygen sensor signal" UBYTE _CNV_S_2_RANGE__0___1_CM 1 100. 0. 1. DISPLAY_IDENTIFIER LV_ERR_PLAUS_LS_DOWN[2] ECU_ADDRESS 0xd0001cc3 BIT_MASK 0x1 /end MEASUREMENT
/begin MEASUREMENT egcp[1].egcp_struct_pladglsd2.lv_diag_puc_chg_ls_down "reminder flag for fuel cut off was active" UBYTE _CNV_S_2_RANGE__0___1_CM 1 100. 0. 1. DISPLAY_IDENTIFIER LV_DIAG_PUC_CHG_LS_DOWN[2] ECU_ADDRESS 0xd0001cc4 BIT_MASK 0x1 /end MEASUREMENT
/begin MEASUREMENT egcp[1].egcp_struct_pladglsd2.maf_int_puc_not_ls_down_diag "MAF integral out of PUC in case of certain load threshold exceeded" UWORD _CNV_A_R_LINEAR_____329_CM 1 100. 0. 2912.66666666667 DISPLAY_IDENTIFIER MAF_INT_PUC_NOT_LS_DOWN_DIAG[2] ECU_ADDRESS 0xd0001cc6 FORMAT "%7.2" /end MEASUREMENT
/begin MEASUREMENT egcp[1].egcp_struct_sigcvif1.state_lsl_if_spi_rd "Bit-field, mapping verified contents of ATIC42 Configuration Register" UBYTE _CNV_A_R_LINEAR_____0_CM 1 100. 0. 255. DISPLAY_IDENTIFIER STATE_LSL_IF_SPI_RD[2] ECU_ADDRESS 0xd0001ccc FORMAT "%3.0" /end MEASUREMENT
/begin MEASUREMENT egcp[1].egcp_struct_sigcvif1.state_lsl_if_conf_spi_rd "Content of the configuration register comprising sensor disconnection time delay and Icp value" UBYTE _CNV_A_R_LINEAR_____0_CM 1 100. 0. 255. DISPLAY_IDENTIFIER STATE_LSL_IF_CONF_SPI_RD[2] ECU_ADDRESS 0xd0001ccd FORMAT "%3.0" /end MEASUREMENT
/begin MEASUREMENT egcp[1].egcp_struct_sigcvif1.ctr_err_lsl_if_spi_wr "Counter indicating number of invalid INIT_REG_x write validation cycles which have been detected" UBYTE _CNV_A_R_LINEAR_____0_CM 1 100. 0. 255. DISPLAY_IDENTIFIER CTR_ERR_LSL_IF_SPI_WR[2] ECU_ADDRESS 0xd0001cce FORMAT "%3.0" /end MEASUREMENT
/begin MEASUREMENT egcp[1].egcp_struct_sigcvif1.frq_r_it_osc_lsl_if_spi_rd "Content of the configuration register comprising  Ri-measurement frequency and bit for pin selective disabling " UBYTE _CNV_A_R_LINEAR_____0_CM 1 100. 0. 127. DISPLAY_IDENTIFIER FRQ_R_IT_OSC_LSL_IF_SPI_RD[2] ECU_ADDRESS 0xd0001ccf FORMAT "%3.0" /end MEASUREMENT
/begin MEASUREMENT egcp[1].egcp_struct_sigcvif1.state_err_vnlsl "Diagnosis status of the Nernst Cell positive pin." UBYTE _CNV_S_3_EGCP_RANGE_341_CM 1 100. 0. 2. DISPLAY_IDENTIFIER STATE_ERR_VNLSL[2] ECU_ADDRESS 0xd0001cd0 /end MEASUREMENT
/begin MEASUREMENT egcp[1].egcp_struct_sigcvif1.state_err_vglsl "Diagnosis status of the Virtual Ground pin." UBYTE _CNV_S_3_EGCP_RANGE_341_CM 1 100. 0. 2. DISPLAY_IDENTIFIER STATE_ERR_VGLSL[2] ECU_ADDRESS 0xd0001cd1 /end MEASUREMENT
/begin MEASUREMENT egcp[1].egcp_struct_sigcvif1.state_err_viplsl "Diagnosis status of the Pump Cell pin." UBYTE _CNV_S_3_EGCP_RANGE_341_CM 1 100. 0. 2. DISPLAY_IDENTIFIER STATE_ERR_VIPLSL[2] ECU_ADDRESS 0xd0001cd2 /end MEASUREMENT
/begin MEASUREMENT egcp[1].egcp_struct_sigcvif1.state_err_vrclsl "Diagnosis status of the Calibration Resistance pin." UBYTE _CNV_S_3_EGCP_RANGE_341_CM 1 100. 0. 2. DISPLAY_IDENTIFIER STATE_ERR_VRCLSL[2] ECU_ADDRESS 0xd0001cd3 /end MEASUREMENT
/begin MEASUREMENT egcp[1].egcp_struct_sigcvif1.state_err_iplsl "Diagnosis status of the Pumping Current." UBYTE _CNV_S_3_EGCP_RANGE_342_CM 1 100. 0. 2. DISPLAY_IDENTIFIER STATE_ERR_IPLSL[2] ECU_ADDRESS 0xd0001cd4 /end MEASUREMENT
/begin MEASUREMENT egcp[1].egcp_struct_sigcvif1.state_err_lsl "OBDI General Status" UBYTE _CNV_S_2_EGCP_RANGE_343_CM 1 100. 0. 1. DISPLAY_IDENTIFIER STATE_ERR_LSL[2] ECU_ADDRESS 0xd0001cd5 /end MEASUREMENT
/begin MEASUREMENT egcp[1].egcp_struct_sigcvif1.lv_lsl_deac "Boolean flag indicating pending OBDI signal fault " UBYTE _CNV_S_2_RANGE__0___1_CM 1 100. 0. 1. DISPLAY_IDENTIFIER LV_LSL_DEAC[2] ECU_ADDRESS 0xd0001cd6 BIT_MASK 0x1 /end MEASUREMENT
/begin MEASUREMENT egcp[1].egcp_struct_sigcvif1.lv_vplsl_lim "Boolean flag indicating that Pump Cell voltage has reached its limits" UBYTE _CNV_S_2_RANGE__0___1_CM 1 100. 0. 1. DISPLAY_IDENTIFIER LV_VPLSL_LIM[2] ECU_ADDRESS 0xd0001cd7 BIT_MASK 0x1 /end MEASUREMENT
/begin MEASUREMENT egcp[1].egcp_struct_sigcvif1.lv_vnlsl_lim "Boolean flag indicating overvoltage at Nernst Cell positive pin" UBYTE _CNV_S_2_RANGE__0___1_CM 1 100. 0. 1. DISPLAY_IDENTIFIER LV_VNLSL_LIM[2] ECU_ADDRESS 0xd0001cd8 BIT_MASK 0x1 /end MEASUREMENT
/begin MEASUREMENT egcp[1].egcp_struct_sigcvif1.ctr_err_lsl_if_spi_it_osc_ena "Counter indicating number of invalid transmissions of \"R_IT_OSC_ENA\" bit" UBYTE _CNV_A_R_LINEAR_____0_CM 1 100. 0. 255. DISPLAY_IDENTIFIER CTR_ERR_LSL_IF_SPI_IT_OSC_ENA[2] ECU_ADDRESS 0xd0001cd9 FORMAT "%3.0" /end MEASUREMENT
/begin MEASUREMENT egcp[1].egcp_struct_sigcvif2.state_lsl_if_spi_wr "Bit-field mapping of contents to be written to ATIC42 INIT_REG_1" UBYTE _CNV_A_R_LINEAR_____0_CM 1 100. 0. 255. DISPLAY_IDENTIFIER STATE_LSL_IF_SPI_WR[2] ECU_ADDRESS 0xd0001cda FORMAT "%3.0" /end MEASUREMENT
/begin MEASUREMENT egcp[1].egcp_struct_sigcvif2.state_lsl_if_conf_spi_wr "Mapping of contents to be written to ATIC42 INIT_REG_1" UBYTE _CNV_A_R_LINEAR_____0_CM 1 100. 0. 255. DISPLAY_IDENTIFIER STATE_LSL_IF_CONF_SPI_WR[2] ECU_ADDRESS 0xd0001cdb FORMAT "%3.0" /end MEASUREMENT
/begin MEASUREMENT egcp[1].egcp_struct_sigcvif2.lv_lsl_if_spi_rst_end "Boolean flag indicating general status of  ATIC42 initialisation after RESET" UBYTE _CNV_S_2_RANGE__0___1_CM 1 100. 0. 1. DISPLAY_IDENTIFIER LV_LSL_IF_SPI_RST_END[2] ECU_ADDRESS 0xd0001cdc BIT_MASK 0x1 /end MEASUREMENT
/begin MEASUREMENT egcp[1].egcp_struct_sigcvifi2.t_dly_di_lsl_if "Configuration of the Sensor Protection Time" UBYTE _CNV_A_R_LINEAR_____0_CM 1 100. 0. 7. DISPLAY_IDENTIFIER T_DLY_DI_LSL_IF[2] ECU_ADDRESS 0xd0001cde FORMAT "%3.0" /end MEASUREMENT
/begin MEASUREMENT egcp[1].egcp_struct_sigcvifi2.lv_lsl_ena_lsl_if "Boolean flag to enable/disable WRAF sensor connection" UBYTE _CNV_S_2_RANGE__0___1_CM 1 100. 0. 1. DISPLAY_IDENTIFIER LV_LSL_ENA_LSL_IF[2] ECU_ADDRESS 0xd0001cdf BIT_MASK 0x1 /end MEASUREMENT
/begin MEASUREMENT egcp[1].egcp_struct_sigcvifi2.lv_lsl_if_rst "Boolean flag to reset the ATIC42" UBYTE _CNV_S_2_RANGE__0___1_CM 1 100. 0. 1. DISPLAY_IDENTIFIER LV_LSL_IF_RST[2] ECU_ADDRESS 0xd0001ce0 BIT_MASK 0x1 /end MEASUREMENT
/begin MEASUREMENT egcp[1].egcp_struct_sigcvifi2.lv_ctr_err_lsl_if_spi_man_inc "BSW interface for manual increase of value of SPI communication error counter" UBYTE _CNV_S_2_RANGE__0___1_CM 1 100. 0. 1. DISPLAY_IDENTIFIER LV_CTR_ERR_LSL_IF_SPI_MAN_INC[2] ECU_ADDRESS 0xd0001ce1 BIT_MASK 0x1 /end MEASUREMENT
/begin MEASUREMENT egcp[1].egcp_struct_sigcvlsl2.lamb_sp_fil_delta_rise "Acquired lambda model value at the rising edge of heater PWM" UWORD _CNV_A_R_LINEAR_____23_CM 1 100. 0. 1.99993896484375 DISPLAY_IDENTIFIER LAMB_SP_FIL_DELTA_RISE[2] ECU_ADDRESS 0xd0001cf8 FORMAT "%7.5" /end MEASUREMENT
/begin MEASUREMENT egcp[1].egcp_struct_sigcvlsl2.lamb_sp_fil_delta_fall "Acquired lambda model value at the falling edge of heater PWM" UWORD _CNV_A_R_LINEAR_____23_CM 1 100. 0. 1.99993896484375 DISPLAY_IDENTIFIER LAMB_SP_FIL_DELTA_FALL[2] ECU_ADDRESS 0xd0001cfa FORMAT "%7.5" /end MEASUREMENT
/begin MEASUREMENT egcp[1].egcp_struct_sigcvlsl2.vls_up_delta_rise "Acquired oxygen sensor voltage at the rising edge of heater PWM" UWORD _CNV_A_R_LINEAR_____2_CM 1 100. 0. 4.9951171875 DISPLAY_IDENTIFIER VLS_UP_DELTA_RISE[2] ECU_ADDRESS 0xd0001cfc FORMAT "%5.3" /end MEASUREMENT
/begin MEASUREMENT egcp[1].egcp_struct_sigcvlsl2.vls_up_delta_fall "Acquired oxygen sensor voltage at the falling edge of heater PWM" UWORD _CNV_A_R_LINEAR_____2_CM 1 100. 0. 4.9951171875 DISPLAY_IDENTIFIER VLS_UP_DELTA_FALL[2] ECU_ADDRESS 0xd0001cfe FORMAT "%5.3" /end MEASUREMENT
/begin MEASUREMENT egcp[1].egcp_struct_sigcvrid0.vls_down_mmv_drv1_thd_min "Lower variable VLS_DOWN gradient threshold" SWORD _CNV_A_R_EGCP_LINEA_344_CM 1 100. -2.5 2.499924 DISPLAY_IDENTIFIER VLS_DOWN_MMV_DRV1_THD_MIN[2] ECU_ADDRESS 0xd0001d00 FORMAT "%8.5" /end MEASUREMENT
/begin MEASUREMENT egcp[1].egcp_struct_sigcvrid0.vls_down_mmv_drv1_thd_max "Upper variable VLS_DOWN gradient threshold" SWORD _CNV_A_R_EGCP_LINEA_344_CM 1 100. -2.5 2.499924 DISPLAY_IDENTIFIER VLS_DOWN_MMV_DRV1_THD_MAX[2] ECU_ADDRESS 0xd0001d02 FORMAT "%8.5" /end MEASUREMENT
/begin MEASUREMENT egcp[1].egcp_struct_sigcvrid0.ttip_mes_ls_down "Downstream oxygen sensor ceramic temperature" SWORD _CNV_A_R_LINEAR_____123_CM 1 100. -2048. 2047.9375 DISPLAY_IDENTIFIER TTIP_MES_LS_DOWN[2] ECU_ADDRESS 0xd0001d04 FORMAT "%10.4" /end MEASUREMENT
/begin MEASUREMENT egcp[1].egcp_struct_sigcvrid0.ttip_mes_tol_ls_down "Downstream oxygen sensor ceramic temperature, Upper limit, Unfiltered" SWORD _CNV_A_R_LINEAR_____123_CM 1 100. -2048. 2047.9375 DISPLAY_IDENTIFIER TTIP_MES_TOL_LS_DOWN[2] ECU_ADDRESS 0xd0001d06 FORMAT "%10.4" /end MEASUREMENT
/begin MEASUREMENT egcp[1].egcp_struct_sigcvrid0.ttip_mes_bol_ls_down "Downstream oxygen sensor ceramic temperature, Lower limit, Unfiltered" SWORD _CNV_A_R_LINEAR_____123_CM 1 100. -2048. 2047.9375 DISPLAY_IDENTIFIER TTIP_MES_BOL_LS_DOWN[2] ECU_ADDRESS 0xd0001d08 FORMAT "%10.4" /end MEASUREMENT
/begin MEASUREMENT egcp[1].egcp_struct_sigcvrid0.ttip_mes_tol_mmv_ls_down "Downstream oxygen sensor ceramic temperature, Upper limit, Filtered" SWORD _CNV_A_R_LINEAR_____123_CM 1 100. -2048. 2047.9375 DISPLAY_IDENTIFIER TTIP_MES_TOL_MMV_LS_DOWN[2] ECU_ADDRESS 0xd0001d0a FORMAT "%10.4" /end MEASUREMENT
/begin MEASUREMENT egcp[1].egcp_struct_sigcvrid0.ttip_mes_bol_mmv_ls_down "Downstream oxygen sensor ceramic temperature, Lower limit, Filtered" SWORD _CNV_A_R_LINEAR_____123_CM 1 100. -2048. 2047.9375 DISPLAY_IDENTIFIER TTIP_MES_BOL_MMV_LS_DOWN[2] ECU_ADDRESS 0xd0001d0c FORMAT "%10.4" /end MEASUREMENT
/begin MEASUREMENT egcp[1].egcp_struct_sigcvrid0.ctr_cycnr_r_it_ls_down_vld "Handshake counter indicating the number of valid resistance values determined since initial activation" UWORD _CNV_A_R_LINEAR_____0_CM 1 100. 0. 65535. DISPLAY_IDENTIFIER CTR_CYCNR_R_IT_LS_DOWN_VLD[2] ECU_ADDRESS 0xd0001d0e FORMAT "%5.0" /end MEASUREMENT
/begin MEASUREMENT egcp[1].egcp_struct_sigcvrid0.pow_mmv_lsh_down "Moving mean value of downstream oxygen sensor heater power" UWORD _CNV_A_R_EGCP_LINEA_348_CM 1 100. 0. 84.498711 DISPLAY_IDENTIFIER POW_MMV_LSH_DOWN[2] ECU_ADDRESS 0xd0001d10 /end MEASUREMENT
/begin MEASUREMENT egcp[1].egcp_struct_sigcvrid0.r_it_ls_down "Internal resistance of downstream oxygen sensor (Released)" UWORD _CNV_A_R_LINEAR_____332_CM 1 100. 0. 65535. DISPLAY_IDENTIFIER R_IT_LS_DOWN[2] ECU_ADDRESS 0xd0001d12 FORMAT "%5.0" /end MEASUREMENT
/begin MEASUREMENT egcp[1].egcp_struct_sigcvrid0.r_it_mes_ls_down "Internal resistance of downstream oxygen sensor (Measured)" UWORD _CNV_A_R_LINEAR_____332_CM 1 100. 0. 65535. DISPLAY_IDENTIFIER R_IT_MES_LS_DOWN[2] ECU_ADDRESS 0xd0001d14 FORMAT "%5.0" /end MEASUREMENT
/begin MEASUREMENT egcp[1].egcp_struct_sigcvrid0.r_it_mdl_ls_down_new "Internal resistance of downstream oxygen sensor (Modelled for new sensor)" UWORD _CNV_A_R_LINEAR_____332_CM 1 100. 0. 65535. DISPLAY_IDENTIFIER R_IT_MDL_LS_DOWN_NEW[2] ECU_ADDRESS 0xd0001d16 FORMAT "%5.0" /end MEASUREMENT
/begin MEASUREMENT egcp[1].egcp_struct_sigcvrid0.t_sample_r_it_ls_down "Time measured between internal resistance samples" UWORD _CNV_A_R_LINEAR_____3_CM 1 100. 0. 655.35 DISPLAY_IDENTIFIER T_SAMPLE_R_IT_LS_DOWN[2] ECU_ADDRESS 0xd0001d18 FORMAT "%6.2" /end MEASUREMENT
/begin MEASUREMENT egcp[1].egcp_struct_sigcvrid0.ttip_ref_mdl_mmv_ls_down "Reference of downstream oxygen sensor ceramic temperature (Modelled for new sensor)" UWORD _CNV_A_R_LINEAR_____204_CM 1 100. -273.15 1774.7875 DISPLAY_IDENTIFIER TTIP_REF_MDL_MMV_LS_DOWN[2] ECU_ADDRESS 0xd0001d1a FORMAT "%9.4" /end MEASUREMENT
/begin MEASUREMENT egcp[1].egcp_struct_sigcvrid0.vls_down_cur_pump_on "Downstream oxygen sensor voltage C_T_CUR_PUMP_ON_LS_DOWN after switching on pump current switch" UWORD _CNV_A_R_LINEAR_____2_CM 1 100. 0. 4.9951171875 DISPLAY_IDENTIFIER VLS_DOWN_CUR_PUMP_ON[2] ECU_ADDRESS 0xd0001d1c FORMAT "%5.3" /end MEASUREMENT
/begin MEASUREMENT egcp[1].egcp_struct_sigcvrid0.vls_down_cur_pump_off "Downstream oxygen sensor voltage prior to switching on pump current switch" UWORD _CNV_A_R_LINEAR_____2_CM 1 100. 0. 4.9951171875 DISPLAY_IDENTIFIER VLS_DOWN_CUR_PUMP_OFF[2] ECU_ADDRESS 0xd0001d1e FORMAT "%5.3" /end MEASUREMENT
/begin MEASUREMENT egcp[1].egcp_struct_sigcvrid0.fac_t_vls_down_mmv_drv1 "Multiplicative factor modifies DRV1_VLS_DOWN_MMV_MIN_THD dependent on T_VLS_CYC_AFL_HLD" UBYTE _CNV_A_R_EGCP_LINEA_349_CM 1 100. 0. 63.75 DISPLAY_IDENTIFIER FAC_T_VLS_DOWN_MMV_DRV1[2] ECU_ADDRESS 0xd0001d20 FORMAT "%5.2" /end MEASUREMENT
/begin MEASUREMENT egcp[1].egcp_struct_sigcvrid0.fac_t_vls_down_mmv_drv1_abs "Multiplicative factor modifies C_VLS_DOWN_MMV_DRV1_ABS_MAX dependent on T_VLS_CYC_AFL_HLD" UBYTE _CNV_A_R_EVAC_LINEA_314_CM 1 100. 0. 15.9375 DISPLAY_IDENTIFIER FAC_T_VLS_DOWN_MMV_DRV1_ABS[2] ECU_ADDRESS 0xd0001d21 FORMAT "%7.4" /end MEASUREMENT
/begin MEASUREMENT egcp[1].egcp_struct_sigcvrid0.t_afl_cyc_hld_r_it_ls_down "Lean mixture cycle time (measured upstream), held until next threshold crossing downstream" UBYTE _CNV_A_R_LINEAR_____3_CM 1 100. 0. 2.55 DISPLAY_IDENTIFIER T_AFL_CYC_HLD_R_IT_LS_DOWN[2] ECU_ADDRESS 0xd0001d22 FORMAT "%4.2" /end MEASUREMENT
/begin MEASUREMENT egcp[1].egcp_struct_sigcvrid0.lv_r_it_req_ls_down "Boolean flag indicating that conditions have been met and resistance determination requested" UBYTE _CNV_S_2_RANGE__0___1_CM 1 100. 0. 1. DISPLAY_IDENTIFIER LV_R_IT_REQ_LS_DOWN[2] ECU_ADDRESS 0xd0001d23 BIT_MASK 0x1 /end MEASUREMENT
/begin MEASUREMENT egcp[1].egcp_struct_sigcvrid0.lv_r_it_det_ls_down "Boolean flag indicating that resistance has already been determined (lock out)" UBYTE _CNV_S_2_RANGE__0___1_CM 1 100. 0. 1. DISPLAY_IDENTIFIER LV_R_IT_DET_LS_DOWN[2] ECU_ADDRESS 0xd0001d24 BIT_MASK 0x1 /end MEASUREMENT
/begin MEASUREMENT egcp[1].egcp_struct_sigcvrid0.lv_vls_down_drv1_cdn_r_ls "Boolean flag indicating that low gradient condition met" UBYTE _CNV_S_2_RANGE__0___1_CM 1 100. 0. 1. DISPLAY_IDENTIFIER LV_VLS_DOWN_DRV1_CDN_R_LS[2] ECU_ADDRESS 0xd0001d25 BIT_MASK 0x1 /end MEASUREMENT
/begin MEASUREMENT egcp[1].egcp_struct_sigcvrid0.lv_vls_down_rng_cdn_r_ls "Boolean flag indicating that VLS_DOWN at low gradient condition met" UBYTE _CNV_S_2_RANGE__0___1_CM 1 100. 0. 1. DISPLAY_IDENTIFIER LV_VLS_DOWN_RNG_CDN_R_LS[2] ECU_ADDRESS 0xd0001d26 BIT_MASK 0x1 /end MEASUREMENT
/begin MEASUREMENT egcp[1].egcp_struct_sigcvtipa0.ttip_mes_ls_up "Oxygen sensor ceramic temperature" SWORD _CNV_A_R_LINEAR_____123_CM 1 100. -2048. 2047.9375 DISPLAY_IDENTIFIER TTIP_MES_LS_UP[2] ECU_ADDRESS 0xd0001d2c FORMAT "%10.4" /end MEASUREMENT
/begin MEASUREMENT egcp[1].egcp_struct_sigcvtipa0.r_it_ls_up "Oxygen sensor element internal resistance" UWORD _CNV_A_R_EGCP_LINEA_316_CM 1 100. 0. 16383.75 DISPLAY_IDENTIFIER R_IT_LS_UP[2] ECU_ADDRESS 0xd0001d2e FORMAT "%9.2" /end MEASUREMENT
/begin MEASUREMENT egcp[1].egcp_struct_sigcvtipa0.tcc_v_ofs_mes_r_it_ls_up "Counter incremented for every measured offset voltage in resistance measurement mode" UWORD _CNV_A_R_LINEAR_____0_CM 1 100. 0. 65535. DISPLAY_IDENTIFIER TCC_V_OFS_MES_R_IT_LS_UP[2] ECU_ADDRESS 0xd0001d30 FORMAT "%5.0" /end MEASUREMENT
/begin MEASUREMENT egcp[1].egcp_struct_sigcvtipa0.tcc_v_ofs_adj_r_it_ls_up "Counter incremented for every offset voltage in resistance adjust mode" UWORD _CNV_A_R_LINEAR_____0_CM 1 100. 0. 65535. DISPLAY_IDENTIFIER TCC_V_OFS_ADJ_R_IT_LS_UP[2] ECU_ADDRESS 0xd0001d32 FORMAT "%5.0" /end MEASUREMENT
/begin MEASUREMENT egcp[1].egcp_struct_sigcvtipa0.tcc_fac_gain_h_r_it_ls_up "Counter incremented for every high gain adjust measurement" UWORD _CNV_A_R_LINEAR_____0_CM 1 100. 0. 65535. DISPLAY_IDENTIFIER TCC_FAC_GAIN_H_R_IT_LS_UP[2] ECU_ADDRESS 0xd0001d34 FORMAT "%5.0" /end MEASUREMENT
/begin MEASUREMENT egcp[1].egcp_struct_sigcvtipa0.tcc_fac_gain_l_r_it_ls_up "Counter incremented for every low gain adjust measurement" UWORD _CNV_A_R_LINEAR_____0_CM 1 100. 0. 65535. DISPLAY_IDENTIFIER TCC_FAC_GAIN_L_R_IT_LS_UP[2] ECU_ADDRESS 0xd0001d36 FORMAT "%5.0" /end MEASUREMENT
/begin MEASUREMENT egcp[1].egcp_struct_sigcvtipa0.tcc_err_v_ofs_mes_r_it_ls_up "Counter incremented for every invalid offset voltage in resistance measurement mode" UWORD _CNV_A_R_LINEAR_____0_CM 1 100. 0. 65535. DISPLAY_IDENTIFIER TCC_ERR_V_OFS_MES_R_IT_LS_UP[2] ECU_ADDRESS 0xd0001d38 FORMAT "%5.0" /end MEASUREMENT
/begin MEASUREMENT egcp[1].egcp_struct_sigcvtipa0.tcc_err_v_ofs_adj_r_it_ls_up "Counter incremented for every invalid offset voltage in resistance adjust mode" UWORD _CNV_A_R_LINEAR_____0_CM 1 100. 0. 65535. DISPLAY_IDENTIFIER TCC_ERR_V_OFS_ADJ_R_IT_LS_UP[2] ECU_ADDRESS 0xd0001d3a FORMAT "%5.0" /end MEASUREMENT
/begin MEASUREMENT egcp[1].egcp_struct_sigcvtipa0.tcc_err_fac_gain_h_r_ls_up "Counter incremented for every invalid high gain adjust measurement" UWORD _CNV_A_R_LINEAR_____0_CM 1 100. 0. 65535. DISPLAY_IDENTIFIER TCC_ERR_FAC_GAIN_H_R_LS_UP[2] ECU_ADDRESS 0xd0001d3c FORMAT "%5.0" /end MEASUREMENT
/begin MEASUREMENT egcp[1].egcp_struct_sigcvtipa0.tcc_err_fac_gain_l_r_ls_up "Counter incremented for every invalid low gain adjust measurement" UWORD _CNV_A_R_LINEAR_____0_CM 1 100. 0. 65535. DISPLAY_IDENTIFIER TCC_ERR_FAC_GAIN_L_R_LS_UP[2] ECU_ADDRESS 0xd0001d3e FORMAT "%5.0" /end MEASUREMENT
/begin MEASUREMENT egcp[1].egcp_struct_sigcvtipa0.v_ofs_adj_r_it_ls_up "Internal resistance determination circuit offset in resistance adjust mode" UWORD _CNV_A_R_EGCP_LINEA_350_CM 1 100. 0. 4.995 DISPLAY_IDENTIFIER V_OFS_ADJ_R_IT_LS_UP[2] ECU_ADDRESS 0xd0001d40 FORMAT "%5.3" /end MEASUREMENT
/begin MEASUREMENT egcp[1].egcp_struct_sigcvtipa0.v_ofs_mes_r_it_ls_up "Internal resistance determination circuit offset in resistance measurement mode" UWORD _CNV_A_R_EGCP_LINEA_350_CM 1 100. 0. 4.995 DISPLAY_IDENTIFIER V_OFS_MES_R_IT_LS_UP[2] ECU_ADDRESS 0xd0001d42 FORMAT "%5.3" /end MEASUREMENT
/begin MEASUREMENT egcp[1].egcp_struct_sigcvtipa0.fac_gain_h_r_it_ls_up "High gain of oxygen sensor internal resistance determination circuit" UWORD _CNV_A_R_EGCP_LINEA_351_CM 1 100. 0. 23.999634 DISPLAY_IDENTIFIER FAC_GAIN_H_R_IT_LS_UP[2] ECU_ADDRESS 0xd0001d44 FORMAT "%7.4" /end MEASUREMENT
/begin MEASUREMENT egcp[1].egcp_struct_sigcvtipa0.fac_gain_l_r_it_ls_up "Low gain of oxygen sensor internal resistance determination circuit" UWORD _CNV_A_R_EGCP_LINEA_351_CM 1 100. 0. 23.999634 DISPLAY_IDENTIFIER FAC_GAIN_L_R_IT_LS_UP[2] ECU_ADDRESS 0xd0001d46 FORMAT "%7.4" /end MEASUREMENT
/begin MEASUREMENT egcp[1].egcp_struct_sigcvtipa0.frq_r_it_osc_lsl_if_spi_wr "Variable indicating coded information for requested Ri determination oscillator frequency" UBYTE _CNV_A_R_LINEAR_____0_CM 1 100. 0. 127. DISPLAY_IDENTIFIER FRQ_R_IT_OSC_LSL_IF_SPI_WR[2] ECU_ADDRESS 0xd0001d48 FORMAT "%3.0" /end MEASUREMENT
/begin MEASUREMENT egcp[1].egcp_struct_sigcvtipa0.state_ttip_mes_ls_up "State variable indicating current state of function" UBYTE _CNV_S_5_EGCP_RANGE_352_CM 1 100. 0. 4. DISPLAY_IDENTIFIER STATE_TTIP_MES_LS_UP[2] ECU_ADDRESS 0xd0001d49 /end MEASUREMENT
/begin MEASUREMENT egcp[1].egcp_struct_sigcvtipa0.t_dly_r_it_iplsl_ctl_act "Delay timer for freeze of Ri signal upon activation of Ip loop" UBYTE _CNV_A_R_LINEAR_____3_CM 1 100. 0. 2.55 DISPLAY_IDENTIFIER T_DLY_R_IT_IPLSL_CTL_ACT[2] ECU_ADDRESS 0xd0001d4a FORMAT "%4.2" /end MEASUREMENT
/begin MEASUREMENT egcp[1].egcp_struct_sigcvtipa0.lv_fac_gain_h_vld_r_it_ls_up "Boolean flag indicating measured high gain valid" UBYTE _CNV_S_2_RANGE__0___1_CM 1 100. 0. 1. DISPLAY_IDENTIFIER LV_FAC_GAIN_H_VLD_R_IT_LS_UP[2] ECU_ADDRESS 0xd0001d4b BIT_MASK 0x1 /end MEASUREMENT
/begin MEASUREMENT egcp[1].egcp_struct_sigcvtipa0.lv_fac_gain_l_vld_r_it_ls_up "Boolean flag indicating measured low gain valid" UBYTE _CNV_S_2_RANGE__0___1_CM 1 100. 0. 1. DISPLAY_IDENTIFIER LV_FAC_GAIN_L_VLD_R_IT_LS_UP[2] ECU_ADDRESS 0xd0001d4c BIT_MASK 0x1 /end MEASUREMENT
/begin MEASUREMENT egcp[1].egcp_struct_sigcvtipa0.lv_r_it_cal_ena_lsl_if "Boolean flag requesting WRAF interface internal resistance adjust mode to be enabled" UBYTE _CNV_S_2_RANGE__0___1_CM 1 100. 0. 1. DISPLAY_IDENTIFIER LV_R_IT_CAL_ENA_LSL_IF[2] ECU_ADDRESS 0xd0001d4d BIT_MASK 0x1 /end MEASUREMENT
/begin MEASUREMENT egcp[1].egcp_struct_sigcvtipa0.lv_r_it_osc_ena_lsl_if "Boolean flag requesting WRAF interface internal oscillator to be enabled" UBYTE _CNV_S_2_RANGE__0___1_CM 1 100. 0. 1. DISPLAY_IDENTIFIER LV_R_IT_OSC_ENA_LSL_IF[2] ECU_ADDRESS 0xd0001d4e BIT_MASK 0x1 /end MEASUREMENT
/begin MEASUREMENT egcp[1].egcp_struct_sigcvtipa0.lv_r_it_swi_rng_lsl_if "Boolean flag requesting WRAF interface to select internal resistance gain (range)" UBYTE _CNV_S_2_RANGE__0___1_CM 1 100. 0. 1. DISPLAY_IDENTIFIER LV_R_IT_SWI_RNG_LSL_IF[2] ECU_ADDRESS 0xd0001d4f BIT_MASK 0x1 /end MEASUREMENT
/begin MEASUREMENT egcp[1].egcp_struct_sigcvtipa0.lv_ttip_mes_vld_ls_up "Boolean flag indicating validity of oxygen sensor ceramic temperature TTIP_MES_LS_UP[NC_CBK_EX_NR]" UBYTE _CNV_S_2_RANGE__0___1_CM 1 100. 0. 1. DISPLAY_IDENTIFIER LV_TTIP_MES_VLD_LS_UP[2] ECU_ADDRESS 0xd0001d50 BIT_MASK 0x1 /end MEASUREMENT
/begin MEASUREMENT egcp[1].egcp_struct_sigcvtipa0.lv_v_ofs_adj_vld_r_it_ls_up "Boolean flag indicating offset in resistance adjust mode valid" UBYTE _CNV_S_2_RANGE__0___1_CM 1 100. 0. 1. DISPLAY_IDENTIFIER LV_V_OFS_ADJ_VLD_R_IT_LS_UP[2] ECU_ADDRESS 0xd0001d51 BIT_MASK 0x1 /end MEASUREMENT
/begin MEASUREMENT egcp[1].egcp_struct_sigcvtipa0.lv_v_ofs_mes_vld_r_it_ls_up "Boolean flag indicating offset in resistance measurement mode valid" UBYTE _CNV_S_2_RANGE__0___1_CM 1 100. 0. 1. DISPLAY_IDENTIFIER LV_V_OFS_MES_VLD_R_IT_LS_UP[2] ECU_ADDRESS 0xd0001d52 BIT_MASK 0x1 /end MEASUREMENT
/begin MEASUREMENT egcp[1].egcp_struct_sigcvtipa0.lv_v_ref_vld_r_it_ls_up "Boolean flag indicating internal resistance determination circuit references valid" UBYTE _CNV_S_2_RANGE__0___1_CM 1 100. 0. 1. DISPLAY_IDENTIFIER LV_V_REF_VLD_R_IT_LS_UP[2] ECU_ADDRESS 0xd0001d53 BIT_MASK 0x1 /end MEASUREMENT
/begin MEASUREMENT egcp[1].egcp_struct_sigcvtipa0.lv_r_it_req_ls_up "Boolean flag indicating that conditions have been met and resistance determination requested" UBYTE _CNV_S_2_RANGE__0___1_CM 1 100. 0. 1. DISPLAY_IDENTIFIER LV_R_IT_REQ_LS_UP[2] ECU_ADDRESS 0xd0001d54 BIT_MASK 0x1 /end MEASUREMENT
/begin MEASUREMENT egcp[1].egcp_struct_sigcvtipai0.lv_inh_ttip_ls_up "Boolean flag indicating that upstream oxygen sensor ceramic temperature determination shall be inhibited " UBYTE _CNV_S_2_RANGE__0___1_CM 1 100. 0. 1. DISPLAY_IDENTIFIER LV_INH_TTIP_LS_UP[2] ECU_ADDRESS 0xd0001d56 BIT_MASK 0x1 /end MEASUREMENT
/begin MEASUREMENT egcp[1].egcp_struct_sigdglsd1.t_act_pls_diag_scg_ls_down "Delay time for final diagnosis activation " UWORD _CNV_A_R_LINEAR_____4_CM 1 100. 0. 6553.5 DISPLAY_IDENTIFIER T_ACT_PLS_DIAG_SCG_LS_DOWN[2] ECU_ADDRESS 0xd0001d58 FORMAT "%6.1" /end MEASUREMENT
/begin MEASUREMENT egcp[1].egcp_struct_sigdglsd1.t_act_pls_diag_oc_ls_down "Delay time for final diagnosis activation " UWORD _CNV_A_R_LINEAR_____4_CM 1 100. 0. 6553.5 DISPLAY_IDENTIFIER T_ACT_PLS_DIAG_OC_LS_DOWN[2] ECU_ADDRESS 0xd0001d5a FORMAT "%6.1" /end MEASUREMENT
/begin MEASUREMENT egcp[1].egcp_struct_sigdglsd1.t_cdn_diag_oc_ls_down "Detection time for status OC before diagnosis" UWORD _CNV_A_R_LINEAR_____4_CM 1 100. 0. 6553.5 DISPLAY_IDENTIFIER T_CDN_DIAG_OC_LS_DOWN[2] ECU_ADDRESS 0xd0001d5c FORMAT "%6.1" /end MEASUREMENT
/begin MEASUREMENT egcp[1].egcp_struct_sigdglsd1.ctr_r_upd_diag_scg_ls_down "Value of handshake counter for last valid resistance value used for short circuit to ground diagnosis" UWORD _CNV_A_R_LINEAR_____0_CM 1 100. 0. 65535. DISPLAY_IDENTIFIER CTR_R_UPD_DIAG_SCG_LS_DOWN[2] ECU_ADDRESS 0xd0001d5e FORMAT "%5.0" /end MEASUREMENT
/begin MEASUREMENT egcp[1].egcp_struct_sigdglsd1.ctr_r_upd_diag_oc_ls_down "Value of handshake counter for last valid resistance value used for diagnosis" UWORD _CNV_A_R_LINEAR_____0_CM 1 100. 0. 65535. DISPLAY_IDENTIFIER CTR_R_UPD_DIAG_OC_LS_DOWN[2] ECU_ADDRESS 0xd0001d60 FORMAT "%5.0" /end MEASUREMENT
/begin MEASUREMENT egcp[1].egcp_struct_sigdglsd1.ctr_sym_diag_scg_ls_down "Detection time for SCG " UBYTE _CNV_A_R_LINEAR_____0_CM 1 100. 0. 255. DISPLAY_IDENTIFIER CTR_SYM_DIAG_SCG_LS_DOWN[2] ECU_ADDRESS 0xd0001d62 FORMAT "%3.0" /end MEASUREMENT
/begin MEASUREMENT egcp[1].egcp_struct_sigdglsd1.lv_err_el_ls_down "Boolean error flag, electrical fault currently present on downstream oxygen sensor signal" UBYTE _CNV_S_2_RANGE__0___1_CM 1 100. 0. 1. DISPLAY_IDENTIFIER LV_ERR_EL_LS_DOWN[2] ECU_ADDRESS 0xd0001d63 BIT_MASK 0x1 /end MEASUREMENT
/begin MEASUREMENT egcp[1].egcp_struct_sigdglsd1.lv_diag_act_req_ls_down "Request for starting the downstream sensor active plausibility check" UBYTE _CNV_S_2_RANGE__0___1_CM 1 100. 0. 1. DISPLAY_IDENTIFIER LV_DIAG_ACT_REQ_LS_DOWN[2] ECU_ADDRESS 0xd0001d64 BIT_MASK 0x1 /end MEASUREMENT
/begin MEASUREMENT egcp[1].egcp_struct_sigdglsd1.lv_r_it_vld_diag_oc_ls_down "Valid conditions of resistance of downstream oxygen sensor open circuit diagnosis" UBYTE _CNV_S_2_RANGE__0___1_CM 1 100. 0. 1. DISPLAY_IDENTIFIER LV_R_IT_VLD_DIAG_OC_LS_DOWN[2] ECU_ADDRESS 0xd0001d65 BIT_MASK 0x1 /end MEASUREMENT
/begin MEASUREMENT egcp[1].egcp_struct_sigdglsd1.lv_t_cdn_diag_oc_ls_down "Boolean error flag, short to plus fault currently present on downstream oxygen sensor signal" UBYTE _CNV_S_2_RANGE__0___1_CM 1 100. 0. 1. DISPLAY_IDENTIFIER LV_T_CDN_DIAG_OC_LS_DOWN[2] ECU_ADDRESS 0xd0001d66 BIT_MASK 0x1 /end MEASUREMENT
/begin MEASUREMENT egcp[1].egcp_struct_sigcvlsl3.vls_up "Upstream Oxygen sensor voltage" UWORD _CNV_A_R_LINEAR_____2_CM 1 100. 0. 4.9951171875 DISPLAY_IDENTIFIER VLS_UP[2] ECU_ADDRESS 0xd0001e8a FORMAT "%5.3" /end MEASUREMENT
/begin MEASUREMENT egcp[1].egcp_struct_sigcvlsl3.vls_up_10_raw "Raw value of WRAF sensor voltage signal - Recurrence 10.0 msec" UWORD _CNV_A_R_LINEAR_____2_CM 1 100. 0. 4.9951171875 DISPLAY_IDENTIFIER VLS_UP_10_RAW[2] ECU_ADDRESS 0xd0001e8c FORMAT "%5.3" /end MEASUREMENT
/begin MEASUREMENT egcp[1].egcp_struct_sigcvlsl3.lv_vls_up_vld "Boolean flag indicating whether clipping of the WRAF sensor signal is taking place (1 - No clipping, 0 - clipping)" UBYTE _CNV_S_2_RANGE__0___1_CM 1 100. 0. 1. DISPLAY_IDENTIFIER LV_VLS_UP_VLD[2] ECU_ADDRESS 0xd0001e8e BIT_MASK 0x1 /end MEASUREMENT
/begin MEASUREMENT egcp[1].egcp_struct_sigcvlsl3.lv_vls_up_init "Boolean flag indicating the buffer initialisation after switching between Gain 16 & Gain 8 values of WRAF Controller or after Offset adjustment of WRAF sensor" UBYTE _CNV_S_2_RANGE__0___1_CM 1 100. 0. 1. DISPLAY_IDENTIFIER LV_VLS_UP_INIT[2] ECU_ADDRESS 0xd0001e8f BIT_MASK 0x1 /end MEASUREMENT
/begin MEASUREMENT egcp[1].egcp_struct_adcprlsli1.lv_inh_lsl_ofs_adj "Boolean flag indicating that upstream oxygen sensor Ip offset adjustment shall be inhibited" UBYTE _CNV_S_2_RANGE__0___1_CM 1 100. 0. 1. DISPLAY_IDENTIFIER LV_INH_LSL_OFS_ADJ[2] ECU_ADDRESS 0xd0001e96 BIT_MASK 0x1 /end MEASUREMENT
/begin CHARACTERISTIC c_lshpwm_max_diag_lsh_up "Maximum O2-Sensor heater duty cycle to perform the electrical diagnosis" VALUE 0xa100210c _REC_VAL_20_u1 99.609375 _CNV_A_R_LINEAR_____5_CM 0. 99.609375 DISPLAY_IDENTIFIER C_LSHPWM_MAX_DIAG_LSH_UP FORMAT "%9.6" /end CHARACTERISTIC
/begin CHARACTERISTIC c_teg_dyn_min_diag_lsh_up "Minimum exhaust gas temperature threshold to permit SCP to set fault during LSH power rise state" VALUE 0xa1002224 _REC_VAL_20_u2 2047.9375 _CNV_A_R_LINEAR_____204_CM -273.15 1774.7875 DISPLAY_IDENTIFIER C_TEG_DYN_MIN_DIAG_LSH_UP FORMAT "%9.4" /end CHARACTERISTIC
/begin CHARACTERISTIC c_lshpwm_min_diag_lsh_up "Minimum O2-Sensor heater duty cycle to perform the electrical diagnosis" VALUE 0xa1002110 _REC_VAL_20_u1 99.609375 _CNV_A_R_LINEAR_____5_CM 0. 99.609375 DISPLAY_IDENTIFIER C_LSHPWM_MIN_DIAG_LSH_UP FORMAT "%9.6" /end CHARACTERISTIC
/begin MEASUREMENT lv_err_lsh_up_1 "Error flag for upstream heater diagnosis OBD I after debouncing " UBYTE _CNV_S_2_RANGE__0___1_CM 1 100. 0. 1. DISPLAY_IDENTIFIER LV_ERR_LSH_UP[1] ECU_ADDRESS 0xd0003499 BIT_MASK 0x1 /end MEASUREMENT
/begin MEASUREMENT lv_err_lsh_up_2 "Error flag for upstream heater diagnosis OBD I after debouncing " UBYTE _CNV_S_2_RANGE__0___1_CM 1 100. 0. 1. DISPLAY_IDENTIFIER LV_ERR_LSH_UP[2] ECU_ADDRESS 0xd00034b2 BIT_MASK 0x1 /end MEASUREMENT
/begin CHARACTERISTIC c_abc_inc_lsh_up "Antibounce counter increment" VALUE 0xa1002018 _REC_VAL_20_u1 255. _CNV_A_R_LINEAR_____0_CM 0. 255. DISPLAY_IDENTIFIER C_ABC_INC_LSH_UP FORMAT "%3.0" /end CHARACTERISTIC
/begin CHARACTERISTIC c_abc_max_lsh_up "Maximum value for Antibounce counter" VALUE 0xa1002023 _REC_VAL_20_u1 254. _CNV_A_R_LINEAR_____0_CM 1. 255. DISPLAY_IDENTIFIER C_ABC_MAX_LSH_UP FORMAT "%3.0" /end CHARACTERISTIC
/begin CHARACTERISTIC c_lshpwm_max_diag_lsh_down "Maximum O2-Sensor heater duty cycle to perform the electrical diagnosis" VALUE 0xa100210a _REC_VAL_20_u1 99.609375 _CNV_A_R_LINEAR_____5_CM 0. 99.609375 DISPLAY_IDENTIFIER C_LSHPWM_MAX_DIAG_LSH_DOWN FORMAT "%9.6" /end CHARACTERISTIC
/begin CHARACTERISTIC c_lshpwm_min_diag_lsh_down "Minimum O2-Sensor heater duty cycle to perform the electrical diagnosis" VALUE 0xa100210e _REC_VAL_20_u1 99.609375 _CNV_A_R_LINEAR_____5_CM 0. 99.609375 DISPLAY_IDENTIFIER C_LSHPWM_MIN_DIAG_LSH_DOWN FORMAT "%9.6" /end CHARACTERISTIC
/begin MEASUREMENT lv_err_lsh_down_1 "Error flag for downstream heater diagnosis OBD I after debouncing " UBYTE _CNV_S_2_RANGE__0___1_CM 1 100. 0. 1. DISPLAY_IDENTIFIER LV_ERR_LSH_DOWN[1] ECU_ADDRESS 0xd000349a BIT_MASK 0x1 /end MEASUREMENT
/begin MEASUREMENT lv_err_lsh_down_2 "Error flag for downstream heater diagnosis OBD I after debouncing " UBYTE _CNV_S_2_RANGE__0___1_CM 1 100. 0. 1. DISPLAY_IDENTIFIER LV_ERR_LSH_DOWN[2] ECU_ADDRESS 0xd00034b3 BIT_MASK 0x1 /end MEASUREMENT
/begin CHARACTERISTIC c_teg_dyn_min_diag_lsh_down "Minimum exhaust gas temperature threshold to permit SCP to set fault during LSH power rise state" VALUE 0xa1002222 _REC_VAL_20_u2 2047.9375 _CNV_A_R_LINEAR_____204_CM -273.15 1774.7875 DISPLAY_IDENTIFIER C_TEG_DYN_MIN_DIAG_LSH_DOWN FORMAT "%9.4" /end CHARACTERISTIC
/begin CHARACTERISTIC c_abc_inc_lsh_down "Antibounce counter increment" VALUE 0xa1002017 _REC_VAL_20_u1 255. _CNV_A_R_LINEAR_____0_CM 0. 255. DISPLAY_IDENTIFIER C_ABC_INC_LSH_DOWN FORMAT "%3.0" /end CHARACTERISTIC
/begin CHARACTERISTIC c_abc_max_lsh_down "Maximum value for Antibounce counter" VALUE 0xa1002022 _REC_VAL_20_u1 254. _CNV_A_R_LINEAR_____0_CM 1. 255. DISPLAY_IDENTIFIER C_ABC_MAX_LSH_DOWN FORMAT "%3.0" /end CHARACTERISTIC
/begin MEASUREMENT lv_err_puc_ls_down_1 "Boolean error flag, PUC plausibility fault currently present on downstream oxygen sensor signal" UBYTE _CNV_S_2_RANGE__0___1_CM 1 100. 0. 1. DISPLAY_IDENTIFIER LV_ERR_PUC_LS_DOWN[1] ECU_ADDRESS 0xd0003495 BIT_MASK 0x1 /end MEASUREMENT
/begin MEASUREMENT lv_err_fl_ls_down_1 "Boolean error flag, FL plausibility fault currently present on downstream oxygen sensor signal" UBYTE _CNV_S_2_RANGE__0___1_CM 1 100. 0. 1. DISPLAY_IDENTIFIER LV_ERR_FL_LS_DOWN[1] ECU_ADDRESS 0xd0003496 BIT_MASK 0x1 /end MEASUREMENT
/begin CHARACTERISTIC c_maf_int_max_diag_fl_ls_down "Maximum threshold for MAF integral to end downstream FL signal plausibility" VALUE 0xa1002122 _REC_VAL_20_u2 1820.42 _CNV_A_R_LINEAR_____356_CM 0. 1820.42 DISPLAY_IDENTIFIER C_MAF_INT_MAX_DIAG_FL_LS_DOWN FORMAT "%7.2" /end CHARACTERISTIC
/begin CHARACTERISTIC c_maf_int_min_diag_puc_ls_down "Minimum threshold for MAF integral required to start downstream PUC signal plausibility" VALUE 0xa1002128 _REC_VAL_20_u2 2912.666666666671 _CNV_A_R_LINEAR_____329_CM 0. 2912.66666666667 DISPLAY_IDENTIFIER C_MAF_INT_MIN_DIAG_PUC_LS_DOWN FORMAT "%7.2" /end CHARACTERISTIC
/begin CHARACTERISTIC c_maf_int_min_diag_fl_ls_down "Minimum threshold for MAF integral required to start downstream FL signal plausibility" VALUE 0xa1002126 _REC_VAL_20_u2 1820.42 _CNV_A_R_LINEAR_____356_CM 0. 1820.42 DISPLAY_IDENTIFIER C_MAF_INT_MIN_DIAG_FL_LS_DOWN FORMAT "%7.2" /end CHARACTERISTIC
/begin CHARACTERISTIC c_vls_min_diag_puc_ls_down "VLS voltage threshold for PUC fault detection" VALUE 0xa10022aa _REC_VAL_20_u2 4.9951171875 _CNV_A_R_LINEAR_____2_CM 0. 4.9951171875 DISPLAY_IDENTIFIER C_VLS_MIN_DIAG_PUC_LS_DOWN FORMAT "%5.3" /end CHARACTERISTIC
/begin CHARACTERISTIC c_vls_max_diag_fl_ls_down "VLS voltage threshold for FL fault detection" VALUE 0xa10022a8 _REC_VAL_20_u2 4.9951171875 _CNV_A_R_LINEAR_____2_CM 0. 4.9951171875 DISPLAY_IDENTIFIER C_VLS_MAX_DIAG_FL_LS_DOWN FORMAT "%5.3" /end CHARACTERISTIC
/begin MEASUREMENT lv_err_fl_ls_down_2 "Boolean error flag, FL plausibility fault currently present on downstream oxygen sensor signal" UBYTE _CNV_S_2_RANGE__0___1_CM 1 100. 0. 1. DISPLAY_IDENTIFIER LV_ERR_FL_LS_DOWN[2] ECU_ADDRESS 0xd00034af BIT_MASK 0x1 /end MEASUREMENT
/begin MEASUREMENT lv_err_puc_ls_down_2 "Boolean error flag, PUC plausibility fault currently present on downstream oxygen sensor signal" UBYTE _CNV_S_2_RANGE__0___1_CM 1 100. 0. 1. DISPLAY_IDENTIFIER LV_ERR_PUC_LS_DOWN[2] ECU_ADDRESS 0xd00034ae BIT_MASK 0x1 /end MEASUREMENT
/begin MEASUREMENT maf_int_fl "integral of air mass flow  while FL active" UWORD _CNV_A_R_LINEAR_____356_CM 1 100. 0. 1820.42 DISPLAY_IDENTIFIER MAF_INT_FL ECU_ADDRESS 0xd0002534 FORMAT "%7.2" /end MEASUREMENT
/begin CHARACTERISTIC c_maf_int_max_diag_puc_ls_down "Maximum threshold for MAF integral to end downstream PUC signal plausibility" VALUE 0xa1002124 _REC_VAL_20_u2 2912.666666666671 _CNV_A_R_LINEAR_____329_CM 0. 2912.66666666667 DISPLAY_IDENTIFIER C_MAF_INT_MAX_DIAG_PUC_LS_DOWN FORMAT "%7.2" /end CHARACTERISTIC
/begin CHARACTERISTIC c_maf_int_puc_not_ls_down_diag "minimum threshold for MAF integral out of PUC required to start downstream PUC signal plausibility" VALUE 0xa1002132 _REC_VAL_20_u2 2912.666666666671 _CNV_A_R_LINEAR_____329_CM 0. 2912.66666666667 DISPLAY_IDENTIFIER C_MAF_INT_PUC_NOT_LS_DOWN_DIAG FORMAT "%7.2" /end CHARACTERISTIC
/begin CHARACTERISTIC c_fac_maf_int_ls_down_diag "factor for impact of fuel cut off phase to the sensor themperature" VALUE 0xa1002098 _REC_VAL_20_u1 31.875 _CNV_A_R_EGCP_LINEA_370_CM 0. 31.875 DISPLAY_IDENTIFIER C_FAC_MAF_INT_LS_DOWN_DIAG /end CHARACTERISTIC
/begin CHARACTERISTIC c_maf_kgh_min_ls_down_diag "minimum MAF_KGH to start MAF integral" VALUE 0xa1002148 _REC_VAL_20_u2 2047.96875 _CNV_A_R_LINEAR_____207_CM 0. 2047.96875 DISPLAY_IDENTIFIER C_MAF_KGH_MIN_LS_DOWN_DIAG FORMAT "%10.5" /end CHARACTERISTIC
/begin CHARACTERISTIC c_state_lsl_if_spi_wr_ini "Initialisation data of SPI register INIT_REG_1" VALUE 0xa1002179 _REC_VAL_20_u1 255. _CNV_A_R_LINEAR_____0_CM 0. 255. DISPLAY_IDENTIFIER C_STATE_LSL_IF_SPI_WR_INI FORMAT "%3.0" /end CHARACTERISTIC
/begin CHARACTERISTIC c_state_lsl_if_conf_spi_wr_ini "Initialisation data of SPI register INIT_REG_2" VALUE 0xa1002178 _REC_VAL_20_u1 255. _CNV_A_R_LINEAR_____0_CM 0. 255. DISPLAY_IDENTIFIER C_STATE_LSL_IF_CONF_SPI_WR_INI FORMAT "%3.0" /end CHARACTERISTIC
/begin CHARACTERISTIC c_t_dly_di_lsl_if "Configuration of sensor protection time" VALUE 0xa100219c _REC_VAL_20_u1 7. _CNV_A_R_LINEAR_____0_CM 0. 7. DISPLAY_IDENTIFIER C_T_DLY_DI_LSL_IF FORMAT "%3.0" /end CHARACTERISTIC
/begin CHARACTERISTIC lc_ctr_err_lsl_if_spi_man_inc "Switch to manually increase value of SPI communication error counter within BSW" VALUE 0xa10022d5 _REC_VAL_20_u1 1. _CNV_A_R_LINEAR_____0_CM 0. 1. DISPLAY_IDENTIFIER LC_CTR_ERR_LSL_IF_SPI_MAN_INC FORMAT "%1.0" /end CHARACTERISTIC
/begin MEASUREMENT vls_up_cyl_sel[0] "upstream oxygen sensor acquisition (cylinder individual)" UWORD _CNV_A_R_LINEAR_____2_CM 1 100. 0. 4.9951171875 DISPLAY_IDENTIFIER VLS_UP_CYL_SEL[0] ECU_ADDRESS 0xd0002538 FORMAT "%5.3" /end MEASUREMENT
/begin MEASUREMENT vls_up_cyl_sel[1] "upstream oxygen sensor acquisition (cylinder individual)" UWORD _CNV_A_R_LINEAR_____2_CM 1 100. 0. 4.9951171875 DISPLAY_IDENTIFIER VLS_UP_CYL_SEL[1] ECU_ADDRESS 0xd000253a FORMAT "%5.3" /end MEASUREMENT
/begin MEASUREMENT vls_up_cyl_sel[2] "upstream oxygen sensor acquisition (cylinder individual)" UWORD _CNV_A_R_LINEAR_____2_CM 1 100. 0. 4.9951171875 DISPLAY_IDENTIFIER VLS_UP_CYL_SEL[2] ECU_ADDRESS 0xd000253c FORMAT "%5.3" /end MEASUREMENT
/begin MEASUREMENT vls_up_cyl_sel[3] "upstream oxygen sensor acquisition (cylinder individual)" UWORD _CNV_A_R_LINEAR_____2_CM 1 100. 0. 4.9951171875 DISPLAY_IDENTIFIER VLS_UP_CYL_SEL[3] ECU_ADDRESS 0xd000253e FORMAT "%5.3" /end MEASUREMENT
/begin MEASUREMENT vls_up_cyl_sel[4] "upstream oxygen sensor acquisition (cylinder individual)" UWORD _CNV_A_R_LINEAR_____2_CM 1 100. 0. 4.9951171875 DISPLAY_IDENTIFIER VLS_UP_CYL_SEL[4] ECU_ADDRESS 0xd0002540 FORMAT "%5.3" /end MEASUREMENT
/begin MEASUREMENT vls_up_cyl_sel[5] "upstream oxygen sensor acquisition (cylinder individual)" UWORD _CNV_A_R_LINEAR_____2_CM 1 100. 0. 4.9951171875 DISPLAY_IDENTIFIER VLS_UP_CYL_SEL[5] ECU_ADDRESS 0xd0002542 FORMAT "%5.3" /end MEASUREMENT
/begin MEASUREMENT ctr_vls_up_cyl_sel_trig[0] "cylinder selective update counter for trigger event " UBYTE _CNV_A_R_LINEAR_____0_CM 1 100. 0. 255. DISPLAY_IDENTIFIER CTR_VLS_UP_CYL_SEL_TRIG[0] ECU_ADDRESS 0xd0002dac FORMAT "%3.0" /end MEASUREMENT
/begin MEASUREMENT ctr_vls_up_cyl_sel_trig[1] "cylinder selective update counter for trigger event " UBYTE _CNV_A_R_LINEAR_____0_CM 1 100. 0. 255. DISPLAY_IDENTIFIER CTR_VLS_UP_CYL_SEL_TRIG[1] ECU_ADDRESS 0xd0002dad FORMAT "%3.0" /end MEASUREMENT
/begin MEASUREMENT ctr_vls_up_cyl_sel_trig[2] "cylinder selective update counter for trigger event " UBYTE _CNV_A_R_LINEAR_____0_CM 1 100. 0. 255. DISPLAY_IDENTIFIER CTR_VLS_UP_CYL_SEL_TRIG[2] ECU_ADDRESS 0xd0002dae FORMAT "%3.0" /end MEASUREMENT
/begin MEASUREMENT ctr_vls_up_cyl_sel_trig[3] "cylinder selective update counter for trigger event " UBYTE _CNV_A_R_LINEAR_____0_CM 1 100. 0. 255. DISPLAY_IDENTIFIER CTR_VLS_UP_CYL_SEL_TRIG[3] ECU_ADDRESS 0xd0002daf FORMAT "%3.0" /end MEASUREMENT
/begin MEASUREMENT ctr_vls_up_cyl_sel_trig[4] "cylinder selective update counter for trigger event " UBYTE _CNV_A_R_LINEAR_____0_CM 1 100. 0. 255. DISPLAY_IDENTIFIER CTR_VLS_UP_CYL_SEL_TRIG[4] ECU_ADDRESS 0xd0002db0 FORMAT "%3.0" /end MEASUREMENT
/begin MEASUREMENT ctr_vls_up_cyl_sel_trig[5] "cylinder selective update counter for trigger event " UBYTE _CNV_A_R_LINEAR_____0_CM 1 100. 0. 255. DISPLAY_IDENTIFIER CTR_VLS_UP_CYL_SEL_TRIG[5] ECU_ADDRESS 0xd0002db1 FORMAT "%3.0" /end MEASUREMENT
/begin MEASUREMENT nr_value_buf_sum "Number of values to be taken from VLS_BUF_SUM for mean value calculation" UBYTE _CNV_A_R_LINEAR_____0_CM 1 100. 0. 255. DISPLAY_IDENTIFIER NR_VALUE_BUF_SUM ECU_ADDRESS 0xd0002db5 FORMAT "%3.0" /end MEASUREMENT
/begin MEASUREMENT nr_vls_up_raw_buf_idx "Index for the ring buffer VLS_UP_RAW_BUF as well as the Counter to trigger the mean value calculation of WRAF sensor signal" UBYTE _CNV_A_R_LINEAR_____0_CM 1 100. 0. 255. DISPLAY_IDENTIFIER NR_VLS_UP_RAW_BUF_IDX ECU_ADDRESS 0xd0002db6 FORMAT "%3.0" /end MEASUREMENT
/begin MEASUREMENT nr_vls_up_raw_sample_mv "Total number of samples required for mean value calculation" UBYTE _CNV_A_R_LINEAR_____0_CM 1 100. 0. 255. DISPLAY_IDENTIFIER NR_VLS_UP_RAW_SAMPLE_MV ECU_ADDRESS 0xd0002db7 FORMAT "%3.0" /end MEASUREMENT
/begin MEASUREMENT nr_value_buf_sample "Number of values to be taken from NR_BUF_SAMPLE for mean value calculation" UBYTE _CNV_A_R_LINEAR_____0_CM 1 100. 0. 255. DISPLAY_IDENTIFIER NR_VALUE_BUF_SAMPLE ECU_ADDRESS 0xd0002db4 FORMAT "%3.0" /end MEASUREMENT
/begin MEASUREMENT nr_sample_2_sum "Number of samples taken for Intermediate Sum 2" UBYTE _CNV_A_R_LINEAR_____0_CM 1 100. 0. 255. DISPLAY_IDENTIFIER NR_SAMPLE_2_SUM ECU_ADDRESS 0xd0002db3 FORMAT "%3.0" /end MEASUREMENT
/begin MEASUREMENT t_seg_len "Actual segment time measured in msec" UBYTE _CNV_A_R_EGCP_LINEA_367_CM 1 100. 0. 0.255 DISPLAY_IDENTIFIER T_SEG_LEN ECU_ADDRESS 0xd0002dbe FORMAT "%5.3" /end MEASUREMENT
/begin CHARACTERISTIC c_vls_up_thd_tol "Upper voltage threshold for WRAF sensor signal" VALUE 0xa10022ce _REC_VAL_20_u2 4.9951171875 _CNV_A_R_LINEAR_____2_CM 0. 4.9951171875 DISPLAY_IDENTIFIER C_VLS_UP_THD_TOL FORMAT "%5.3" /end CHARACTERISTIC
/begin CHARACTERISTIC lc_vls_up_mv_on "Calibration flag to switch between raw value and filtered value" VALUE 0xa100231b _REC_VAL_20_u1 1. _CNV_A_R_LINEAR_____0_CM 0. 1. DISPLAY_IDENTIFIER LC_VLS_UP_MV_ON FORMAT "%1.0" /end CHARACTERISTIC
/begin CHARACTERISTIC c_vls_up_thd_bol "Lower voltage threshold for WRAF sensor signal" VALUE 0xa10022cc _REC_VAL_20_u2 4.9951171875 _CNV_A_R_LINEAR_____2_CM 0. 4.9951171875 DISPLAY_IDENTIFIER C_VLS_UP_THD_BOL FORMAT "%5.3" /end CHARACTERISTIC
/begin MEASUREMENT nr_sample_1_sum "Number of samples taken for Intermediate Sum 1" UBYTE _CNV_A_R_LINEAR_____0_CM 1 100. 0. 255. DISPLAY_IDENTIFIER NR_SAMPLE_1_SUM ECU_ADDRESS 0xd0002db2 FORMAT "%3.0" /end MEASUREMENT
/begin MEASUREMENT egcp_struct_sigcvlsl3_loc[0].vls_up_tot_sum_mv "Total sum of raw signal voltages taken for mean value calculation" ULONG _CNV_A_R_EGCP_LINEA_371_CM 1 100. 0. 20971520. DISPLAY_IDENTIFIER VLS_UP_TOT_SUM_MV[1] ECU_ADDRESS 0xc00018ac FORMAT "%12.3" /end MEASUREMENT
/begin MEASUREMENT egcp_struct_sigcvlsl3_loc[0].vls_up_inter_1_sum "Intermediate sum 1" UWORD _CNV_A_R_EGCP_LINEA_194_CM 1 100. 0. 319.995117 DISPLAY_IDENTIFIER VLS_UP_INTER_1_SUM[1] ECU_ADDRESS 0xc00018b0 FORMAT "%7.3" /end MEASUREMENT
/begin MEASUREMENT egcp_struct_sigcvlsl3_loc[0].vls_up_inter_2_sum "Intermediate sum 2" UWORD _CNV_A_R_EGCP_LINEA_194_CM 1 100. 0. 319.995117 DISPLAY_IDENTIFIER VLS_UP_INTER_2_SUM[1] ECU_ADDRESS 0xc00018b2 FORMAT "%7.3" /end MEASUREMENT
/begin MEASUREMENT egcp_struct_sigcvlsl3_loc[0].vls_up_mv "Mean value of Upstream Oxygen sensor voltage" UWORD _CNV_A_R_LINEAR_____2_CM 1 100. 0. 4.9951171875 DISPLAY_IDENTIFIER VLS_UP_MV[1] ECU_ADDRESS 0xc00018d0 FORMAT "%5.3" /end MEASUREMENT
/begin MEASUREMENT egcp_struct_sigcvlsl3_loc[0].nr_sample_tot_mv "Total number of samples taken for mean value calculation" UBYTE _CNV_A_R_LINEAR_____0_CM 1 100. 0. 255. DISPLAY_IDENTIFIER NR_SAMPLE_TOT_MV[1] ECU_ADDRESS 0xc00018e8 FORMAT "%3.0" /end MEASUREMENT
/begin MEASUREMENT egcp_struct_sigcvlsl3_loc[0].nr_vls_up_buf_idx "Index for the ring buffer NR_BUF_SAMPLE" UBYTE _CNV_A_R_LINEAR_____0_CM 1 100. 0. 255. DISPLAY_IDENTIFIER NR_VLS_UP_BUF_IDX[1] ECU_ADDRESS 0xc00018f1 FORMAT "%3.0" /end MEASUREMENT
/begin MEASUREMENT egcp_struct_sigcvlsl3_loc[0].state_lsl_if_spi_rd_old "past initialization status register information for WRAF controller" UBYTE _CNV_A_R_LINEAR_____0_CM 1 100. 0. 255. DISPLAY_IDENTIFIER STATE_LSL_IF_SPI_RD_OLD[1] ECU_ADDRESS 0xc00018f2 FORMAT "%3.0" /end MEASUREMENT
/begin MEASUREMENT egcp_struct_sigcvlsl3_loc[0].state_lsl_if_spi_wr_old "past initialization write status register information for WRAF controller" UBYTE _CNV_A_R_LINEAR_____0_CM 1 100. 0. 255. DISPLAY_IDENTIFIER STATE_LSL_IF_SPI_WR_OLD[1] ECU_ADDRESS 0xc00018f4 FORMAT "%3.0" /end MEASUREMENT
/begin MEASUREMENT egcp_struct_sigcvlsl3_loc[0].t_dly_vls_up_init "reset timer for LV_VLS_UP_INIT" UBYTE _CNV_A_R_LINEAR_____3_CM 1 100. 0. 2.55 DISPLAY_IDENTIFIER T_DLY_VLS_UP_INIT[1] ECU_ADDRESS 0xc00018f6 FORMAT "%4.2" /end MEASUREMENT
/begin MEASUREMENT egcp_struct_sigcvlsl3_loc[1].vls_up_tot_sum_mv "Total sum of raw signal voltages taken for mean value calculation" ULONG _CNV_A_R_EGCP_LINEA_371_CM 1 100. 0. 20971520. DISPLAY_IDENTIFIER VLS_UP_TOT_SUM_MV[2] ECU_ADDRESS 0xc0001900 FORMAT "%12.3" /end MEASUREMENT
/begin MEASUREMENT egcp_struct_sigcvlsl3_loc[1].vls_up_inter_1_sum "Intermediate sum 1" UWORD _CNV_A_R_EGCP_LINEA_194_CM 1 100. 0. 319.995117 DISPLAY_IDENTIFIER VLS_UP_INTER_1_SUM[2] ECU_ADDRESS 0xc0001904 FORMAT "%7.3" /end MEASUREMENT
/begin MEASUREMENT egcp_struct_sigcvlsl3_loc[1].vls_up_inter_2_sum "Intermediate sum 2" UWORD _CNV_A_R_EGCP_LINEA_194_CM 1 100. 0. 319.995117 DISPLAY_IDENTIFIER VLS_UP_INTER_2_SUM[2] ECU_ADDRESS 0xc0001906 FORMAT "%7.3" /end MEASUREMENT
/begin MEASUREMENT egcp_struct_sigcvlsl3_loc[1].vls_up_mv "Mean value of Upstream Oxygen sensor voltage" UWORD _CNV_A_R_LINEAR_____2_CM 1 100. 0. 4.9951171875 DISPLAY_IDENTIFIER VLS_UP_MV[2] ECU_ADDRESS 0xc0001924 FORMAT "%5.3" /end MEASUREMENT
/begin MEASUREMENT egcp_struct_sigcvlsl3_loc[1].nr_sample_tot_mv "Total number of samples taken for mean value calculation" UBYTE _CNV_A_R_LINEAR_____0_CM 1 100. 0. 255. DISPLAY_IDENTIFIER NR_SAMPLE_TOT_MV[2] ECU_ADDRESS 0xc000193c FORMAT "%3.0" /end MEASUREMENT
/begin MEASUREMENT egcp_struct_sigcvlsl3_loc[1].nr_vls_up_buf_idx "Index for the ring buffer NR_BUF_SAMPLE" UBYTE _CNV_A_R_LINEAR_____0_CM 1 100. 0. 255. DISPLAY_IDENTIFIER NR_VLS_UP_BUF_IDX[2] ECU_ADDRESS 0xc0001945 FORMAT "%3.0" /end MEASUREMENT
/begin MEASUREMENT egcp_struct_sigcvlsl3_loc[1].state_lsl_if_spi_rd_old "past initialization status register information for WRAF controller" UBYTE _CNV_A_R_LINEAR_____0_CM 1 100. 0. 255. DISPLAY_IDENTIFIER STATE_LSL_IF_SPI_RD_OLD[2] ECU_ADDRESS 0xc0001946 FORMAT "%3.0" /end MEASUREMENT
/begin MEASUREMENT egcp_struct_sigcvlsl3_loc[1].state_lsl_if_spi_wr_old "past initialization write status register information for WRAF controller" UBYTE _CNV_A_R_LINEAR_____0_CM 1 100. 0. 255. DISPLAY_IDENTIFIER STATE_LSL_IF_SPI_WR_OLD[2] ECU_ADDRESS 0xc0001948 FORMAT "%3.0" /end MEASUREMENT
/begin MEASUREMENT egcp_struct_sigcvlsl3_loc[1].t_dly_vls_up_init "reset timer for LV_VLS_UP_INIT" UBYTE _CNV_A_R_LINEAR_____3_CM 1 100. 0. 2.55 DISPLAY_IDENTIFIER T_DLY_VLS_UP_INIT[2] ECU_ADDRESS 0xc000194a FORMAT "%4.2" /end MEASUREMENT
/begin CHARACTERISTIC c_t_dly_vls_up_init "reset timer for LV_VLS_UP_INIT, Initial value = 1" VALUE 0xa10021c1 _REC_VAL_20_u1 2.54 _CNV_A_R_LINEAR_____372_CM 1.e-002 2.55 DISPLAY_IDENTIFIER C_T_DLY_VLS_UP_INIT FORMAT "%4.2" /end CHARACTERISTIC
/begin CHARACTERISTIC c_t_dly_vls_up_init_max "initial value for delay timer in case of gain switching or offset adjustment" VALUE 0xa10021c2 _REC_VAL_20_u1 2.54 _CNV_A_R_LINEAR_____372_CM 1.e-002 2.55 DISPLAY_IDENTIFIER C_T_DLY_VLS_UP_INIT_MAX FORMAT "%4.2" /end CHARACTERISTIC
/begin CHARACTERISTIC c_t_cur_pump_on_ls_down "Duration for pump current active" VALUE 0xa1002186 _REC_VAL_20_u1 8.e-003 _CNV_A_R_EGCP_LINEA_367_CM 0. 8.e-003 DISPLAY_IDENTIFIER C_T_CUR_PUMP_ON_LS_DOWN FORMAT "%5.3" /end CHARACTERISTIC
/begin CHARACTERISTIC c_t_cur_pump_off_ls_down "Minimum delay between consecutive pump current activation" VALUE 0xa1002184 _REC_VAL_20_u2 655.35 _CNV_A_R_LINEAR_____3_CM 0. 655.35 DISPLAY_IDENTIFIER C_T_CUR_PUMP_OFF_LS_DOWN FORMAT "%6.2" /end CHARACTERISTIC
/begin CHARACTERISTIC c_t_dly_cur_pump_ls_down "Duration in which VLS_DOWN[NC_CBK_EX_NR] signal masked directly after Ri determination" VALUE 0xa100219b _REC_VAL_20_u1 0.255 _CNV_A_R_EGCP_LINEA_367_CM 0. 0.255 DISPLAY_IDENTIFIER C_T_DLY_CUR_PUMP_LS_DOWN FORMAT "%5.3" /end CHARACTERISTIC
/begin CHARACTERISTIC c_vls_down_mmv_min_rng_bol_r_it "Permitted range of VLS_DOWN[NC_CBK_EX_NR] below VLS_DOWN_MMV_MIN[NC_CBK_EX_NR] at low gradient for Ri determination" VALUE 0xa100229e _REC_VAL_20_u2 4.99992370605469 _CNV_A_R_EGCP_LINEA_346_CM 0. 4.99992370605469 DISPLAY_IDENTIFIER C_VLS_DOWN_MMV_MIN_RNG_BOL_R_IT FORMAT "%7.5" /end CHARACTERISTIC
/begin CHARACTERISTIC c_vls_down_mmv_min_rng_tol_r_it "Permitted range of VLS_DOWN[NC_CBK_EX_NR] above VLS_DOWN_MMV_MIN[NC_CBK_EX_NR] at low gradient for Ri determination" VALUE 0xa10022a0 _REC_VAL_20_u2 4.99992370605469 _CNV_A_R_EGCP_LINEA_346_CM 0. 4.99992370605469 DISPLAY_IDENTIFIER C_VLS_DOWN_MMV_MIN_RNG_TOL_R_IT FORMAT "%7.5" /end CHARACTERISTIC
/begin CHARACTERISTIC c_vls_down_mmv_drv1_thd_min "Minimum threshold for mean 1st derivative of VLS_DOWN[NC_CBK_EX_NR] signal for Ri determination" VALUE 0xa100229a _REC_VAL_20_s2 4.999924 _CNV_A_R_EGCP_LINEA_344_CM -2.5 2.499924 DISPLAY_IDENTIFIER C_VLS_DOWN_MMV_DRV1_THD_MIN FORMAT "%8.5" /end CHARACTERISTIC
/begin CHARACTERISTIC c_vls_down_mmv_drv1_thd_max "Maximum threshold for mean 1st derivative of VLS_DOWN[NC_CBK_EX_NR] signal for Ri determination" VALUE 0xa1002298 _REC_VAL_20_s2 4.999924 _CNV_A_R_EGCP_LINEA_344_CM -2.5 2.499924 DISPLAY_IDENTIFIER C_VLS_DOWN_MMV_DRV1_THD_MAX FORMAT "%8.5" /end CHARACTERISTIC
/begin CHARACTERISTIC c_fac_vls_down_mmv_drv1_thd "Multiplicative factor used to weight gradient thresholds dependent on VLS_DOWN_MMV_xxx[NC_CBK_EX_NR] amplitude" VALUE 0xa10020a1 _REC_VAL_20_u1 1.9921875 _CNV_A_R_LINEAR_____100_CM 0. 1.9921875 DISPLAY_IDENTIFIER C_FAC_VLS_DOWN_MMV_DRV1_THD FORMAT "%8.6" /end CHARACTERISTIC
/begin CHARACTERISTIC c_ctr_afl_cyc_min_ri_it_ls_down "Min. no. AF cycles post lambda controller activation to permit use of T_VLS_CYC_AFL_HLD dependency" VALUE 0xa1002046 _REC_VAL_20_u2 65535. _CNV_A_R_LINEAR_____0_CM 0. 65535. DISPLAY_IDENTIFIER C_CTR_AFL_CYC_MIN_RI_IT_LS_DOWN FORMAT "%5.0" /end CHARACTERISTIC
/begin CHARACTERISTIC c_maf_kgh_max_r_it_ls_down "Maximum MAF_KGH threshold for activation of internal resistance determination" VALUE 0xa1002140 _REC_VAL_20_u2 2047.96875 _CNV_A_R_LINEAR_____207_CM 0. 2047.96875 DISPLAY_IDENTIFIER C_MAF_KGH_MAX_R_IT_LS_DOWN FORMAT "%10.5" /end CHARACTERISTIC
/begin CHARACTERISTIC c_fac_vls_down_mmv_drv1_thd_min "Hysteresis factor of DRV1_VLS_DOWN_MMV_MIN governing limiting of DRV1_VLS_DOWN_MMV_MIN_THD" VALUE 0xa10020a2 _REC_VAL_20_u1 0.99609375 _CNV_A_R_LINEAR_____27_CM 0. 0.99609375 DISPLAY_IDENTIFIER C_FAC_VLS_DOWN_MMV_DRV1_THD_MIN FORMAT "%5.3" /end CHARACTERISTIC
/begin CHARACTERISTIC c_fac_r_it_err_neg_ls_down "Internal resistance measurement negative error (i.e. 100% to 0%)" VALUE 0xa100209c _REC_VAL_20_u1 0.99609375 _CNV_A_R_LINEAR_____27_CM 0. 0.99609375 DISPLAY_IDENTIFIER C_FAC_R_IT_ERR_NEG_LS_DOWN FORMAT "%5.3" /end CHARACTERISTIC
/begin CHARACTERISTIC c_fac_r_it_err_pos_ls_down "Internal resistance measurement positive error (i.e. 0% to 100%)" VALUE 0xa100209d _REC_VAL_20_u1 0.99609375 _CNV_A_R_LINEAR_____27_CM 0. 0.99609375 DISPLAY_IDENTIFIER C_FAC_R_IT_ERR_POS_LS_DOWN FORMAT "%5.3" /end CHARACTERISTIC
/begin CHARACTERISTIC c_crlc_pow_mmv_lsh_down "Correlation (filter) constant for moving mean value of downstream heater power" VALUE 0xa100203b _REC_VAL_20_u1 0.99609375 _CNV_A_R_LINEAR_____27_CM 0. 0.99609375 DISPLAY_IDENTIFIER C_CRLC_POW_MMV_LSH_DOWN FORMAT "%5.3" /end CHARACTERISTIC
/begin CHARACTERISTIC c_crlc_ttip_fall_r_it_ls_down "Correlation (filter) constant for falling ceramic temperature, limit calculation" VALUE 0xa100203c _REC_VAL_20_u1 0.99609375 _CNV_A_R_LINEAR_____116_CM 0. 0.99609375 DISPLAY_IDENTIFIER C_CRLC_TTIP_FALL_R_IT_LS_DOWN FORMAT "%5.3" /end CHARACTERISTIC
/begin CHARACTERISTIC c_crlc_ttip_rise_r_it_ls_down "Correlation (filter) constant for rising ceramic temperature, limit calculation" VALUE 0xa100203d _REC_VAL_20_u1 0.99609375 _CNV_A_R_LINEAR_____116_CM 0. 0.99609375 DISPLAY_IDENTIFIER C_CRLC_TTIP_RISE_R_IT_LS_DOWN FORMAT "%5.3" /end CHARACTERISTIC
/begin CHARACTERISTIC lc_r_it_vld_inh_ls_down "Boolean flag inhibiting internal resistance determination validity function" VALUE 0xa1002311 _REC_VAL_20_u1 1. _CNV_A_R_LINEAR_____0_CM 0. 1. DISPLAY_IDENTIFIER LC_R_IT_VLD_INH_LS_DOWN FORMAT "%1.0" /end CHARACTERISTIC
/begin CHARACTERISTIC ip_crlc_ttip_ref_mdl_ls_down "Correlation map for calculation of reference downstream tip temperature (modelled for new sensor)" CURVE 0xa1001bb8 _REC_CUR_20_u1_u2 0.99609375 _CNV_A_R_LINEAR_____27_CM 0. 0.99609375 DISPLAY_IDENTIFIER IP_CRLC_TTIP_REF_MDL_LS_DOWN FORMAT "%5.3"
 /begin AXIS_DESCR COM_AXIS maf_kgh _CNV_A_R_LINEAR_____207_CM 8 0. 2047.96875 FORMAT "%10.5" AXIS_PTS_REF ldpm_maf_kgh_1_egcp /end AXIS_DESCR
/end CHARACTERISTIC
/begin AXIS_PTS ldp_ttip_ref_mdl_mmv_ls_down_r "" 0xa1001a30 online_dummy _REC_AXS_20_u2 2047.9375 _CNV_A_R_LINEAR_____204_CM 8 -273.15 1774.7875 FORMAT "%9.4" /end AXIS_PTS
/begin CHARACTERISTIC ip_fac_t_drv1_vls_down_mmv "Multiplicative factor modifies DRV1_VLS_DOWN_MMV_MIN_THD dependent on T_VLS_CYC_AFL_HLD" CURVE 0xa1001cf8 _REC_CUR_20_u1_u1 63.75 _CNV_A_R_EGCP_LINEA_349_CM 0. 63.75 DISPLAY_IDENTIFIER IP_FAC_T_DRV1_VLS_DOWN_MMV FORMAT "%5.2"
 /begin AXIS_DESCR COM_AXIS online_dummy _CNV_A_R_LINEAR_____3_CM 8 0. 2.55 FORMAT "%4.2" AXIS_PTS_REF ldpm_t_afl_cyc_hld_1_egcp /end AXIS_DESCR
/end CHARACTERISTIC
/begin CHARACTERISTIC ip_fac_t_vls_down_mmv_drv1_abs "Multiplicative factor modifies C_VLS_DOWN_MMV_DRV1_ABS_MAX dependent on T_VLS_CYC_AFL_HLD" CURVE 0xa1001d00 _REC_CUR_20_u1_u1 15.9375 _CNV_A_R_EVAC_LINEA_314_CM 0. 15.9375 DISPLAY_IDENTIFIER IP_FAC_T_VLS_DOWN_MMV_DRV1_ABS FORMAT "%7.4"
 /begin AXIS_DESCR COM_AXIS online_dummy _CNV_A_R_LINEAR_____3_CM 8 0. 2.55 FORMAT "%4.2" AXIS_PTS_REF ldpm_t_afl_cyc_hld_1_egcp /end AXIS_DESCR
/end CHARACTERISTIC
/begin CHARACTERISTIC ip_r_it_mdl_ls_down_new "Internal resistance of a new downstream oxygen sensor (modelled)" MAP 0xa1001e58 _REC_MAP_20_u2_u2_u2 65535. _CNV_A_R_LINEAR_____332_CM 0. 65535. DISPLAY_IDENTIFIER IP_R_IT_MDL_LS_DOWN_NEW FORMAT "%5.0"
 /begin AXIS_DESCR COM_AXIS online_dummy _CNV_A_R_EGCP_LINEA_348_CM 8 0. 84.498711 AXIS_PTS_REF ldp_pow_mmv_lsh_down_ip_ls_down /end AXIS_DESCR
 /begin AXIS_DESCR COM_AXIS online_dummy _CNV_A_R_LINEAR_____204_CM 8 -273.15 1774.7875 FORMAT "%9.4" AXIS_PTS_REF ldp_ttip_ref_mdl_mmv_ls_down_r /end AXIS_DESCR
/end CHARACTERISTIC
/begin CHARACTERISTIC ip_ttip_mes_ls_down "Oxygen sensor temperature vs. internal resistance characteristic" CURVE 0xa1001fa0 _REC_CUR_20_u2_u2 2047.9375 _CNV_A_R_LINEAR_____123_CM 0. 2047.9375 DISPLAY_IDENTIFIER IP_TTIP_MES_LS_DOWN FORMAT "%7.2"
 /begin AXIS_DESCR COM_AXIS online_dummy _CNV_A_R_LINEAR_____332_CM 8 0. 65535. FORMAT "%5.0" AXIS_PTS_REF ldp_r_it_mes_ls_down_ip_ls_down /end AXIS_DESCR
/end CHARACTERISTIC
/begin AXIS_PTS ldp_pow_mmv_lsh_down_ip_ls_down "" 0xa1001978 online_dummy _REC_AXS_20_u2 84.498711 _CNV_A_R_EGCP_LINEA_348_CM 8 0. 84.498711 /end AXIS_PTS
/begin AXIS_PTS ldp_r_it_mes_ls_down_ip_ls_down "" 0xa10019c0 online_dummy _REC_AXS_20_u2 65535. _CNV_A_R_LINEAR_____332_CM 8 0. 65535. FORMAT "%5.0" /end AXIS_PTS
/begin CHARACTERISTIC c_vls_down_mmv_drv1_abs_max "Threshold for absolute maximum 1st derivative of VLS_DOWN[NC_CBK_EX_NR] signal for Ri determination" VALUE 0xa1002296 _REC_VAL_20_u2 4.99992370605469 _CNV_A_R_EGCP_LINEA_346_CM 0. 4.99992370605469 DISPLAY_IDENTIFIER C_VLS_DOWN_MMV_DRV1_ABS_MAX FORMAT "%7.5" /end CHARACTERISTIC
/begin CHARACTERISTIC c_vls_hys_r_it_ls_down "Voltage hysteresis for evaluation if VLS_DOWN[i] shall be masked after Ri determination" VALUE 0xa10022a6 _REC_VAL_20_u2 4.9951171875 _CNV_A_R_LINEAR_____2_CM 0. 4.9951171875 DISPLAY_IDENTIFIER C_VLS_HYS_R_IT_LS_DOWN FORMAT "%5.3" /end CHARACTERISTIC
/begin CHARACTERISTIC c_teg_min_cur_pump_on_ls_down "Temperature threshold for the activation of sensor pumping" VALUE 0xa100222e _REC_VAL_20_u2 2047.9375 _CNV_A_R_LINEAR_____204_CM -273.15 1774.7875 DISPLAY_IDENTIFIER C_TEG_MIN_CUR_PUMP_ON_LS_DOWN FORMAT "%9.4" /end CHARACTERISTIC
/begin AXIS_PTS ldp_r_it_ls_up_ip_ttip_ls_up "" 0xa10019ac online_dummy _REC_AXS_20_u2 16383.75 _CNV_A_R_EGCP_LINEA_316_CM 8 0. 16383.75 FORMAT "%9.2" /end AXIS_PTS
/begin CHARACTERISTIC ip_ttip_mes_ls_up "Oxygen sensor temperature vs. internal resistance characteristic" CURVE 0xa1001fb0 _REC_CUR_20_u2_u2 2047.9375 _CNV_A_R_LINEAR_____123_CM 0. 2047.9375 DISPLAY_IDENTIFIER IP_TTIP_MES_LS_UP FORMAT "%7.2"
 /begin AXIS_DESCR COM_AXIS online_dummy _CNV_A_R_EGCP_LINEA_316_CM 8 0. 16383.75 FORMAT "%9.2" AXIS_PTS_REF ldp_r_it_ls_up_ip_ttip_ls_up /end AXIS_DESCR
/end CHARACTERISTIC
/begin CHARACTERISTIC c_t_dly_ofs_adj_r_it_ls_up "Delay required from switching from internal resistance measurement offset to adjust offset mode" VALUE 0xa10021b9 _REC_VAL_20_u1 2.55 _CNV_A_R_LINEAR_____3_CM 0. 2.55 DISPLAY_IDENTIFIER C_T_DLY_OFS_ADJ_R_IT_LS_UP FORMAT "%4.2" /end CHARACTERISTIC
/begin CHARACTERISTIC c_t_dly_fac_gain_r_it_ls_up "Delay required from switching from internal resistance adjust offset to adjust gain mode" VALUE 0xa10021aa _REC_VAL_20_u1 2.55 _CNV_A_R_LINEAR_____3_CM 0. 2.55 DISPLAY_IDENTIFIER C_T_DLY_FAC_GAIN_R_IT_LS_UP FORMAT "%4.2" /end CHARACTERISTIC
/begin CHARACTERISTIC c_t_dly_clc_r_it_ls_up "Delay required from switching from internal resistance adjust gain to measurement mode" VALUE 0xa100219a _REC_VAL_20_u1 2.55 _CNV_A_R_LINEAR_____3_CM 0. 2.55 DISPLAY_IDENTIFIER C_T_DLY_CLC_R_IT_LS_UP FORMAT "%4.2" /end CHARACTERISTIC
/begin CHARACTERISTIC c_t_dly_ofs_mes_r_it_ls_up "Delay required from switching oscillator off or internal resistance measurement to measurement offset mode" VALUE 0xa10021ba _REC_VAL_20_u1 2.55 _CNV_A_R_LINEAR_____3_CM 0. 2.55 DISPLAY_IDENTIFIER C_T_DLY_OFS_MES_R_IT_LS_UP FORMAT "%4.2" /end CHARACTERISTIC
/begin CHARACTERISTIC c_t_max_v_ofs_adj_r_it_ls_up "Maximum permitted time for offset measurement in adjust mode" VALUE 0xa10021ea _REC_VAL_20_u2 655.35 _CNV_A_R_LINEAR_____3_CM 0. 655.35 DISPLAY_IDENTIFIER C_T_MAX_V_OFS_ADJ_R_IT_LS_UP FORMAT "%6.2" /end CHARACTERISTIC
/begin CHARACTERISTIC c_t_max_fac_gain_r_it_ls_up "Maximum permitted time for gain adjust measurement" VALUE 0xa10021de _REC_VAL_20_u2 655.35 _CNV_A_R_LINEAR_____3_CM 0. 655.35 DISPLAY_IDENTIFIER C_T_MAX_FAC_GAIN_R_IT_LS_UP FORMAT "%6.2" /end CHARACTERISTIC
/begin CHARACTERISTIC c_t_max_v_ofs_mes_r_it_ls_up "Maximum permitted time for offset measurement in measurement mode" VALUE 0xa10021ec _REC_VAL_20_u2 655.35 _CNV_A_R_LINEAR_____3_CM 0. 655.35 DISPLAY_IDENTIFIER C_T_MAX_V_OFS_MES_R_IT_LS_UP FORMAT "%6.2" /end CHARACTERISTIC
/begin CHARACTERISTIC c_v_dif_max_ofs_adj_r_it_ls_up "Maximum permitted deviation of V_OFS_ADJ_R_IT_LS_UP[NC_CBK_EX_NR] to nominal reference value" VALUE 0xa1002250 _REC_VAL_20_u2 4.995 _CNV_A_R_EGCP_LINEA_350_CM 0. 4.995 DISPLAY_IDENTIFIER C_V_DIF_MAX_OFS_ADJ_R_IT_LS_UP FORMAT "%5.3" /end CHARACTERISTIC
/begin CHARACTERISTIC c_v_dif_max_ofs_mes_r_it_ls_up "Maximum permitted deviation of V_OFS_MES_R_IT_LS_UP[NC_CBK_EX_NR] to nominal reference value" VALUE 0xa1002252 _REC_VAL_20_u2 4.995 _CNV_A_R_EGCP_LINEA_350_CM 0. 4.995 DISPLAY_IDENTIFIER C_V_DIF_MAX_OFS_MES_R_IT_LS_UP FORMAT "%5.3" /end CHARACTERISTIC
/begin CHARACTERISTIC lc_r_rng_req_ls_up_lsl_if "Boolean flag selecting internal resistance determination circuit gain when manual switching enabled" VALUE 0xa1002312 _REC_VAL_20_u1 1. _CNV_A_R_LINEAR_____0_CM 0. 1. DISPLAY_IDENTIFIER LC_R_RNG_REQ_LS_UP_LSL_IF FORMAT "%1.0" /end CHARACTERISTIC
/begin CHARACTERISTIC lc_r_rng_req_swi_ls_up_lsl_if "Boolean flag enabling manual switching of internal resistance determination circuit gain" VALUE 0xa1002313 _REC_VAL_20_u1 1. _CNV_A_R_LINEAR_____0_CM 0. 1. DISPLAY_IDENTIFIER LC_R_RNG_REQ_SWI_LS_UP_LSL_IF FORMAT "%1.0" /end CHARACTERISTIC
/begin CHARACTERISTIC c_fac_gain_r_it_ls_up "Factor used when determining high gain = (C_R_IT_REF_LS_UP+R5+R6)/(5V*(R5+R6)" VALUE 0xa1002088 _REC_VAL_20_u2 76.7988 _CNV_A_R_EGCP_LINEA_373_CM 0. 76.7988 DISPLAY_IDENTIFIER C_FAC_GAIN_R_IT_LS_UP /end CHARACTERISTIC
/begin CHARACTERISTIC c_r_it_ref_ls_up "Reference current pulse resistor for internal resistance determination circuit = (R2*R1)/(R2+R1)" VALUE 0xa1002176 _REC_VAL_20_u2 65535. _CNV_A_R_LINEAR_____332_CM 0. 65535. DISPLAY_IDENTIFIER C_R_IT_REF_LS_UP FORMAT "%5.0" /end CHARACTERISTIC
/begin CHARACTERISTIC c_fac_gain_h_dif_r_it_ls_up "Maximum permitted deviation of measured FAC_GAIN_H_R_IT_LS_UP[NC_CBK_EX_NR] from nominal reference value" VALUE 0xa1002080 _REC_VAL_20_u2 23.999634 _CNV_A_R_EGCP_LINEA_351_CM 0. 23.999634 DISPLAY_IDENTIFIER C_FAC_GAIN_H_DIF_R_IT_LS_UP FORMAT "%7.4" /end CHARACTERISTIC
/begin CHARACTERISTIC c_fac_gain_h_r_it_ls_up "Reference high gain for internal resistance determination circuit" VALUE 0xa1002082 _REC_VAL_20_u2 23.999634 _CNV_A_R_EGCP_LINEA_351_CM 0. 23.999634 DISPLAY_IDENTIFIER C_FAC_GAIN_H_R_IT_LS_UP FORMAT "%7.4" /end CHARACTERISTIC
/begin CHARACTERISTIC c_fac_gain_l_dif_r_it_ls_up "Maximum permitted deviation of measured FAC_GAIN_L_R_IT_LS_UP[NC_CBK_EX_NR] from nominal reference value" VALUE 0xa1002084 _REC_VAL_20_u2 23.999634 _CNV_A_R_EGCP_LINEA_351_CM 0. 23.999634 DISPLAY_IDENTIFIER C_FAC_GAIN_L_DIF_R_IT_LS_UP FORMAT "%7.4" /end CHARACTERISTIC
/begin CHARACTERISTIC c_fac_gain_l_r_it_ls_up "Reference low gain for internal resistance determination circuit" VALUE 0xa1002086 _REC_VAL_20_u2 23.999634 _CNV_A_R_EGCP_LINEA_351_CM 0. 23.999634 DISPLAY_IDENTIFIER C_FAC_GAIN_L_R_IT_LS_UP FORMAT "%7.4" /end CHARACTERISTIC
/begin CHARACTERISTIC c_v_ofs_ref_r_it_ls_up "Reference offset voltage for internal resistance determination circuit" VALUE 0xa100226e _REC_VAL_20_u2 4.995 _CNV_A_R_EGCP_LINEA_350_CM 0. 4.995 DISPLAY_IDENTIFIER C_V_OFS_REF_R_IT_LS_UP FORMAT "%5.3" /end CHARACTERISTIC
/begin CHARACTERISTIC c_frq_r_it_osc_lsl_if "Coded information for Ri determination oscillator frequency" VALUE 0xa10020a6 _REC_VAL_20_u1 127. _CNV_A_R_LINEAR_____0_CM 0. 127. DISPLAY_IDENTIFIER C_FRQ_R_IT_OSC_LSL_IF FORMAT "%3.0" /end CHARACTERISTIC
/begin CHARACTERISTIC lc_v_ref_r_it_ls_up "Boolean flag enabling internal resistance determination circuit reference measurement" VALUE 0xa1002318 _REC_VAL_20_u1 1. _CNV_A_R_LINEAR_____0_CM 0. 1. DISPLAY_IDENTIFIER LC_V_REF_R_IT_LS_UP FORMAT "%1.0" /end CHARACTERISTIC
/begin CHARACTERISTIC c_t_dly_r_it_iplsl_ctl_act "Delay time for freeze of Ri signal upon activation of Ip loop" VALUE 0xa10021be _REC_VAL_20_u1 2.55 _CNV_A_R_LINEAR_____3_CM 0. 2.55 DISPLAY_IDENTIFIER C_T_DLY_R_IT_IPLSL_CTL_ACT FORMAT "%4.2" /end CHARACTERISTIC
/begin CHARACTERISTIC c_ctr_min_diag_scg_ls_down "Minimum duration required for continious low VLS_DOWN[i] detection" VALUE 0xa1002060 _REC_VAL_20_u1 255. _CNV_A_R_LINEAR_____0_CM 0. 255. DISPLAY_IDENTIFIER C_CTR_MIN_DIAG_SCG_LS_DOWN FORMAT "%3.0" /end CHARACTERISTIC
/begin CHARACTERISTIC c_maf_kgh_min_diag_scg_ls_down "Minimum MAF_KGH flow required for continious low VLS_DOWN[i] detection" VALUE 0xa1002146 _REC_VAL_20_u2 2047.96875 _CNV_A_R_LINEAR_____207_CM 0. 2047.96875 DISPLAY_IDENTIFIER C_MAF_KGH_MIN_DIAG_SCG_LS_DOWN FORMAT "%10.5" /end CHARACTERISTIC
/begin CHARACTERISTIC c_vls_thd_diag_scp_ls_down "Oxygen sensor voltage threshold over which short to Vbatt present" VALUE 0xa10022bc _REC_VAL_20_u2 4.9951171875 _CNV_A_R_LINEAR_____2_CM 0. 4.9951171875 DISPLAY_IDENTIFIER C_VLS_THD_DIAG_SCP_LS_DOWN FORMAT "%5.3" /end CHARACTERISTIC
/begin CHARACTERISTIC c_r_it_max_diag_scg_ls_down "Maximum resistance threshold oxygen sensor internal resistance during short to ground sensor" VALUE 0xa1002172 _REC_VAL_20_u2 65535. _CNV_A_R_LINEAR_____332_CM 0. 65535. DISPLAY_IDENTIFIER C_R_IT_MAX_DIAG_SCG_LS_DOWN FORMAT "%5.0" /end CHARACTERISTIC
/begin CHARACTERISTIC c_r_it_min_diag_oc_ls_down "Minimum resistance threshold oxygen sensor internal resistance during open circuit sensor" VALUE 0xa1002174 _REC_VAL_20_u2 65535. _CNV_A_R_LINEAR_____332_CM 0. 65535. DISPLAY_IDENTIFIER C_R_IT_MIN_DIAG_OC_LS_DOWN FORMAT "%5.0" /end CHARACTERISTIC
/begin CHARACTERISTIC c_t_cdn_diag_oc_ls_down "Minimum required duration where voltage lies outside of the limits for operable sensor to detect fault" VALUE 0xa1002182 _REC_VAL_20_u2 6553.5 _CNV_A_R_LINEAR_____4_CM 0. 6553.5 DISPLAY_IDENTIFIER C_T_CDN_DIAG_OC_LS_DOWN FORMAT "%6.1" /end CHARACTERISTIC
/begin CHARACTERISTIC c_t_dly_diag_oc_ls_down "Minimum required duration where voltage lies outside of the limits for operable sensor to detect fault" VALUE 0xa10021a2 _REC_VAL_20_u2 6553.5 _CNV_A_R_LINEAR_____4_CM 0. 6553.5 DISPLAY_IDENTIFIER C_T_DLY_DIAG_OC_LS_DOWN FORMAT "%6.1" /end CHARACTERISTIC
/begin CHARACTERISTIC c_t_dly_diag_scg_ls_down "Minimum duration required for low VLS_DOWN[i] detection" VALUE 0xa10021a6 _REC_VAL_20_u2 6553.5 _CNV_A_R_LINEAR_____4_CM 0. 6553.5 DISPLAY_IDENTIFIER C_T_DLY_DIAG_SCG_LS_DOWN FORMAT "%6.1" /end CHARACTERISTIC
/begin CHARACTERISTIC c_vls_thd_diag_scg_ls_down "Oxygen sensor voltage threshold under which short to GND may be present" VALUE 0xa10022ba _REC_VAL_20_u2 4.9951171875 _CNV_A_R_LINEAR_____2_CM 0. 4.9951171875 DISPLAY_IDENTIFIER C_VLS_THD_DIAG_SCG_LS_DOWN FORMAT "%5.3" /end CHARACTERISTIC
/begin CHARACTERISTIC c_vls_afl_thd_diag_oc_ls_down "Oxygen sensor voltage-lean mixture threshold for diagnosis" VALUE 0xa1002276 _REC_VAL_20_u2 4.9951171875 _CNV_A_R_LINEAR_____2_CM 0. 4.9951171875 DISPLAY_IDENTIFIER C_VLS_AFL_THD_DIAG_OC_LS_DOWN FORMAT "%5.3" /end CHARACTERISTIC
/begin CHARACTERISTIC c_vls_afr_thd_diag_oc_ls_down "Oxygen sensor voltage-rich mixture threshold for diagnosis" VALUE 0xa100227a _REC_VAL_20_u2 4.9951171875 _CNV_A_R_LINEAR_____2_CM 0. 4.9951171875 DISPLAY_IDENTIFIER C_VLS_AFR_THD_DIAG_OC_LS_DOWN FORMAT "%5.3" /end CHARACTERISTIC
/begin MEASUREMENT lv_err_scp_ls_down_1 "Boolean error flag, short to plus fault currently present on downstream oxygen sensor signal" UBYTE _CNV_S_2_RANGE__0___1_CM 1 100. 0. 1. DISPLAY_IDENTIFIER LV_ERR_SCP_LS_DOWN[1] ECU_ADDRESS 0xd0003493 BIT_MASK 0x1 /end MEASUREMENT
/begin MEASUREMENT lv_err_scg_ls_down_1 "Boolean error flag, short to ground fault currently present on downstream oxygen sensor signal" UBYTE _CNV_S_2_RANGE__0___1_CM 1 100. 0. 1. DISPLAY_IDENTIFIER LV_ERR_SCG_LS_DOWN[1] ECU_ADDRESS 0xd0003492 BIT_MASK 0x1 /end MEASUREMENT
/begin MEASUREMENT lv_err_oc_ls_down_1 "Boolean error flag, open circuit fault currently present on downstream oxygen sensor signal" UBYTE _CNV_S_2_RANGE__0___1_CM 1 100. 0. 1. DISPLAY_IDENTIFIER LV_ERR_OC_LS_DOWN[1] ECU_ADDRESS 0xd0003494 BIT_MASK 0x1 /end MEASUREMENT
/begin MEASUREMENT lv_err_oc_ls_down_2 "Boolean error flag, open circuit fault currently present on downstream oxygen sensor signal" UBYTE _CNV_S_2_RANGE__0___1_CM 1 100. 0. 1. DISPLAY_IDENTIFIER LV_ERR_OC_LS_DOWN[2] ECU_ADDRESS 0xd00034ad BIT_MASK 0x1 /end MEASUREMENT
/begin MEASUREMENT lv_err_scg_ls_down_2 "Boolean error flag, short to ground fault currently present on downstream oxygen sensor signal" UBYTE _CNV_S_2_RANGE__0___1_CM 1 100. 0. 1. DISPLAY_IDENTIFIER LV_ERR_SCG_LS_DOWN[2] ECU_ADDRESS 0xd00034ab BIT_MASK 0x1 /end MEASUREMENT
/begin MEASUREMENT lv_err_scp_ls_down_2 "Boolean error flag, short to plus fault currently present on downstream oxygen sensor signal" UBYTE _CNV_S_2_RANGE__0___1_CM 1 100. 0. 1. DISPLAY_IDENTIFIER LV_ERR_SCP_LS_DOWN[2] ECU_ADDRESS 0xd00034ac BIT_MASK 0x1 /end MEASUREMENT
/begin CHARACTERISTIC c_teg_dyn_min_diag_oc_ls_down "Minimum requested exhaust gas temperature for diagnosis" VALUE 0xa1002226 _REC_VAL_20_u2 2047.9375 _CNV_A_R_LINEAR_____204_CM -273.15 1774.7875 DISPLAY_IDENTIFIER C_TEG_DYN_MIN_DIAG_OC_LS_DOWN FORMAT "%9.4" /end CHARACTERISTIC
/begin COMPU_METHOD _CNV_A_R_LINEAR_____0_CM "" RAT_FUNC "%6.3" "-" COEFFS 0 1. 0. 0 0 1 /end COMPU_METHOD
/begin COMPU_METHOD _CNV_S_2_RANGE__0___1_CM "" TAB_VERB "%6.3" "-" COMPU_TAB_REF _CNV_S_2_RANGE__0___1 /end COMPU_METHOD
/begin COMPU_VTAB _CNV_S_2_RANGE__0___1 "" TAB_VERB 2 0 "0" 1 "1" /end COMPU_VTAB
/begin COMPU_METHOD _CNV_A_R_LINEAR_____2_CM "" RAT_FUNC "%6.3" "V" COEFFS 0 204.8 0. 0 0 1 /end COMPU_METHOD
/begin COMPU_METHOD _CNV_A_R_LINEAR_____3_CM "" RAT_FUNC "%6.3" "s" COEFFS 0 100. 0. 0 0 1 /end COMPU_METHOD
/begin COMPU_METHOD _CNV_A_R_LINEAR_____4_CM "" RAT_FUNC "%6.3" "s" COEFFS 0 10. 0. 0 0 1 /end COMPU_METHOD
/begin COMPU_METHOD _CNV_A_R_LINEAR_____5_CM "" RAT_FUNC "%6.3" "%" COEFFS 0 2.56 0. 0 0 1 /end COMPU_METHOD
/begin COMPU_METHOD _CNV_A_R_LINEAR_____8_CM "" RAT_FUNC "%6.3" "-" COEFFS 0 32767.99999999992 0. 0 0 1 /end COMPU_METHOD
/begin COMPU_METHOD _CNV_A_R_LINEAR_____9_CM "" RAT_FUNC "%6.3" "rpm" COEFFS 0 3.125e-002 0. 0 0 1 /end COMPU_METHOD
/begin COMPU_METHOD _CNV_A_R_LINEAR_____16_CM "" RAT_FUNC "%6.3" "°C" COEFFS 0 1.333333333333333 64. 0 0 1 /end COMPU_METHOD
/begin COMPU_METHOD _CNV_A_R_LINEAR_____23_CM "" RAT_FUNC "%6.3" "-" COEFFS 0 16384. 0. 0 0 1 /end COMPU_METHOD
/begin COMPU_METHOD _CNV_A_R_LINEAR_____26_CM "" RAT_FUNC "%6.3" "hPa" COEFFS 0 12.06017666543982 0. 0 0 1 /end COMPU_METHOD
/begin COMPU_METHOD _CNV_A_R_LINEAR_____27_CM "" RAT_FUNC "%6.3" "-" COEFFS 0 256. 0. 0 0 1 /end COMPU_METHOD
/begin COMPU_METHOD _CNV_A_R_LINEAR_____36_CM "" RAT_FUNC "%6.3" "V" COEFFS 0 9.807692307692308 0. 0 0 1 /end COMPU_METHOD
/begin COMPU_METHOD _CNV_A_R_LINEAR_____68_CM "" RAT_FUNC "%6.3" "-" COEFFS 0 65535.99999999996 0. 0 0 1 /end COMPU_METHOD
/begin COMPU_METHOD _CNV_A_R_LINEAR_____100_CM "" RAT_FUNC "%6.3" "-" COEFFS 0 128. 0. 0 0 1 /end COMPU_METHOD
/begin COMPU_METHOD _CNV_A_R_LINEAR_____116_CM "" RAT_FUNC "%6.3" "1/s" COEFFS 0 256. 0. 0 0 1 /end COMPU_METHOD
/begin COMPU_METHOD _CNV_A_R_LINEAR_____122_CM "" RAT_FUNC "%6.3" "-" COEFFS 0 1024. 0. 0 0 1 /end COMPU_METHOD
/begin COMPU_METHOD _CNV_A_R_LINEAR_____123_CM "" RAT_FUNC "%6.3" "°C" COEFFS 0 16. 0. 0 0 1 /end COMPU_METHOD
/begin COMPU_METHOD _CNV_A_R_LINEAR_____140_CM "" RAT_FUNC "%6.3" "V" COEFFS 0 2510.769230769231 0. 0 0 1 /end COMPU_METHOD
/begin COMPU_METHOD _CNV_A_R_LINEAR_____184_CM "" RAT_FUNC "%6.3" "-" COEFFS 0 32. 0. 0 0 1 /end COMPU_METHOD
/begin COMPU_METHOD _CNV_A_R_EGCP_LINEA_194_CM "" RAT_FUNC "%6.3" "V" COEFFS 0 204.8000001200018 0. 0 0 1 /end COMPU_METHOD
/begin COMPU_METHOD _CNV_A_R_LINEAR_____204_CM "" RAT_FUNC "%6.3" "°C" COEFFS 0 16. 4370.4 0 0 1 /end COMPU_METHOD
/begin COMPU_METHOD _CNV_A_R_LINEAR_____207_CM "" RAT_FUNC "%6.3" "kg/h" COEFFS 0 32. 0. 0 0 1 /end COMPU_METHOD
/begin COMPU_METHOD _CNV_A_R_LINEAR_____289_CM "Battery voltage" RAT_FUNC "%6.3" "V" COEFFS 0 9.846153846153847 0. 0 0 1 /end COMPU_METHOD
/begin COMPU_METHOD _CNV_A_R_EVAC_LINEA_314_CM "" RAT_FUNC "%6.3" "-" COEFFS 0 16. 0. 0 0 1 /end COMPU_METHOD
/begin COMPU_METHOD _CNV_A_R_EGCP_LINEA_315_CM "Battery voltage" RAT_FUNC "%6.3" "°C" COEFFS 0 16. 32768. 0 0 1 /end COMPU_METHOD
/begin COMPU_METHOD _CNV_A_R_EGCP_LINEA_316_CM "" RAT_FUNC "%6.3" "Ohm" COEFFS 0 4. 0. 0 0 1 /end COMPU_METHOD
/begin COMPU_METHOD _CNV_A_R_EGCP_LINEA_317_CM "Battery voltage" RAT_FUNC "%6.3" "V" COEFFS 0 39.70223015990035 -9.964481279212123e-006 0 0 1 /end COMPU_METHOD
/begin COMPU_METHOD _CNV_A_R_LINEAR_____318_CM "" RAT_FUNC "%6.3" "kg/h" COEFFS 0 64. 0. 0 0 1 /end COMPU_METHOD
/begin COMPU_METHOD _CNV_A_R_EGCP_LINEA_321_CM "Battery voltage" RAT_FUNC "%6.3" "V/100ms" COEFFS 0 156.9230769230769 0. 0 0 1 /end COMPU_METHOD
/begin COMPU_METHOD _CNV_A_R_EGCP_LINEA_325_CM "" RAT_FUNC "%6.3" "(mA)²" COEFFS 0 6767598.194547993 0. 0 0 1 /end COMPU_METHOD
/begin COMPU_METHOD _CNV_A_R_LINEAR_____326_CM "" RAT_FUNC "%6.3" "mA/100ms" COEFFS 0 2601.524353935929 0.8007621769647813 0 0 1 /end COMPU_METHOD
/begin COMPU_METHOD _CNV_A_R_EGCP_LINEA_327_CM "" RAT_FUNC "%6.3" "mA" COEFFS 0 2601.524353935929 32768.80076217697 0 0 1 /end COMPU_METHOD
/begin COMPU_METHOD _CNV_A_R_LINEAR_____328_CM "" RAT_FUNC "%6.3" "mA" COEFFS 0 2601.524353935929 0.8007621769647813 0 0 1 /end COMPU_METHOD
/begin COMPU_METHOD _CNV_A_R_LINEAR_____329_CM "" RAT_FUNC "%6.3" "g" COEFFS 0 22.49999999999997 0. 0 0 1 /end COMPU_METHOD
/begin COMPU_METHOD _CNV_A_R_LINEAR_____332_CM "" RAT_FUNC "%6.3" "Ohm" COEFFS 0 1. 0. 0 0 1 /end COMPU_METHOD
/begin COMPU_METHOD _CNV_S_5_EGCP_RANGE_339_CM "" TAB_VERB "%6.3" "-" COMPU_TAB_REF _CNV_S_5_EGCP_RANGE_339 /end COMPU_METHOD
/begin COMPU_VTAB _CNV_S_5_EGCP_RANGE_339 "" TAB_VERB 5 0 "0: INIT" 1 "1: WAIT" 2 "2: PURGE" 3 "3: ACQ" 4 "4: ADAPT" /end COMPU_VTAB
/begin COMPU_METHOD _CNV_S_4_EGCP_RANGE_340_CM "" TAB_VERB "%6.3" "-" COMPU_TAB_REF _CNV_S_4_EGCP_RANGE_340 /end COMPU_METHOD
/begin COMPU_VTAB _CNV_S_4_EGCP_RANGE_340 "" TAB_VERB 4 0 "0: in_range" 1 "1: low_limit" 2 "2: high_limit" 3 "3: impossible" /end COMPU_VTAB
/begin COMPU_METHOD _CNV_S_3_EGCP_RANGE_341_CM "" TAB_VERB "%6.3" "-" COMPU_TAB_REF _CNV_S_3_EGCP_RANGE_341 /end COMPU_METHOD
/begin COMPU_VTAB _CNV_S_3_EGCP_RANGE_341 "" TAB_VERB 3 0 "NO_FAULT" 1 "SCG" 2 "SCB" /end COMPU_VTAB
/begin COMPU_METHOD _CNV_S_3_EGCP_RANGE_342_CM "" TAB_VERB "%6.3" "-" COMPU_TAB_REF _CNV_S_3_EGCP_RANGE_342 /end COMPU_METHOD
/begin COMPU_VTAB _CNV_S_3_EGCP_RANGE_342 "" TAB_VERB 3 0 "NO_FAULT" 1 "CURRENT_LOW" 2 "CURRENT_HIGH" /end COMPU_VTAB
/begin COMPU_METHOD _CNV_S_2_EGCP_RANGE_343_CM "" TAB_VERB "%6.3" "-" COMPU_TAB_REF _CNV_S_2_EGCP_RANGE_343 /end COMPU_METHOD
/begin COMPU_VTAB _CNV_S_2_EGCP_RANGE_343 "" TAB_VERB 2 0 "NO_FAULT" 1 "FAULT" /end COMPU_VTAB
/begin COMPU_METHOD _CNV_A_R_EGCP_LINEA_344_CM "Battery voltage" RAT_FUNC "%6.3" "V/10ms" COEFFS 0 13107.19922942829 -1.926429285958875e-003 0 0 1 /end COMPU_METHOD
/begin COMPU_METHOD _CNV_A_R_EGCP_LINEA_346_CM "Battery voltage" RAT_FUNC "%6.3" "V" COEFFS 0 13107.19999999999 0. 0 0 1 /end COMPU_METHOD
/begin COMPU_METHOD _CNV_A_R_EGCP_LINEA_348_CM "" RAT_FUNC "%6.3" "W" COEFFS 0 775.5739611223182 0. 0 0 1 /end COMPU_METHOD
/begin COMPU_METHOD _CNV_A_R_EGCP_LINEA_349_CM "" RAT_FUNC "%6.3" "-" COEFFS 0 4. 0. 0 0 1 /end COMPU_METHOD
/begin COMPU_METHOD _CNV_A_R_EGCP_LINEA_350_CM "" RAT_FUNC "%6.3" "V" COEFFS 0 819.2192192192192 0. 0 0 1 /end COMPU_METHOD
/begin COMPU_METHOD _CNV_A_R_EGCP_LINEA_351_CM "" RAT_FUNC "%6.3" "-" COEFFS 0 2730.666642666301 0. 0 0 1 /end COMPU_METHOD
/begin COMPU_METHOD _CNV_S_5_EGCP_RANGE_352_CM "" TAB_VERB "%6.3" "-" COMPU_TAB_REF _CNV_S_5_EGCP_RANGE_352 /end COMPU_METHOD
/begin COMPU_VTAB _CNV_S_5_EGCP_RANGE_352 "" TAB_VERB 5 0 "OFF" 1 "MES_OFS" 2 "ADJ_OFS" 3 "ADJ_GAIN" 4 "MES" /end COMPU_VTAB
/begin COMPU_METHOD _CNV_A_R_LINEAR_____356_CM "" RAT_FUNC "%6.3" "g" COEFFS 0 35.99993408114611 0. 0 0 1 /end COMPU_METHOD
/begin COMPU_METHOD _CNV_A_R_EGCP_LINEA_367_CM "" RAT_FUNC "%6.3" "s" COEFFS 0 1000. 0. 0 0 1 /end COMPU_METHOD
/begin COMPU_METHOD _CNV_A_R_EGCP_LINEA_370_CM "" RAT_FUNC "%6.3" "-" COEFFS 0 8. 0. 0 0 1 /end COMPU_METHOD
/begin COMPU_METHOD _CNV_A_R_EGCP_LINEA_371_CM "" RAT_FUNC "%6.3" "V" COEFFS 0 204.7999999523163 0. 0 0 1 /end COMPU_METHOD
/begin COMPU_METHOD _CNV_A_R_LINEAR_____372_CM "" RAT_FUNC "%6.3" "s" COEFFS 0 100. 1.110223024625157e-016 0 0 1 /end COMPU_METHOD
/begin COMPU_METHOD _CNV_A_R_EGCP_LINEA_373_CM "Battery voltage" RAT_FUNC "%6.3" "1/V" COEFFS 0 853.3336458382162 0. 0 0 1 /end COMPU_METHOD
/begin RECORD_LAYOUT _REC_VAL_20_u1 FNC_VALUES 1 UBYTE COLUMN_DIR DIRECT /end RECORD_LAYOUT
/begin RECORD_LAYOUT _REC_VAL_20_u2 FNC_VALUES 1 UWORD COLUMN_DIR DIRECT /end RECORD_LAYOUT
/begin RECORD_LAYOUT _REC_AXS_20_u1 NO_AXIS_PTS_X 1 UBYTE AXIS_PTS_X 2 UBYTE INDEX_INCR DIRECT /end RECORD_LAYOUT
/begin RECORD_LAYOUT _REC_CUR_20_u1_u1 FNC_VALUES 1 UBYTE COLUMN_DIR DIRECT /end RECORD_LAYOUT
/begin RECORD_LAYOUT _REC_VAL_20_s2 FNC_VALUES 1 SWORD COLUMN_DIR DIRECT /end RECORD_LAYOUT
/begin RECORD_LAYOUT _REC_MAP_20_u2_u2_u1 FNC_VALUES 1 UWORD COLUMN_DIR DIRECT /end RECORD_LAYOUT
/begin RECORD_LAYOUT _REC_AXS_20_u2 NO_AXIS_PTS_X 1 UWORD AXIS_PTS_X 2 UWORD INDEX_INCR DIRECT /end RECORD_LAYOUT
/begin RECORD_LAYOUT _REC_CUR_20_u2_u1 FNC_VALUES 1 UWORD COLUMN_DIR DIRECT /end RECORD_LAYOUT
/begin RECORD_LAYOUT _REC_CUR_20_u2_u2 FNC_VALUES 1 UWORD COLUMN_DIR DIRECT /end RECORD_LAYOUT
/begin RECORD_LAYOUT _REC_VAL_20_s1 FNC_VALUES 1 SBYTE COLUMN_DIR DIRECT /end RECORD_LAYOUT
/begin RECORD_LAYOUT _REC_CUR_20_u1_u2 FNC_VALUES 1 UBYTE COLUMN_DIR DIRECT /end RECORD_LAYOUT
/begin RECORD_LAYOUT _REC_MAP_20_u2_u2_u2 FNC_VALUES 1 UWORD COLUMN_DIR DIRECT /end RECORD_LAYOUT
/begin RECORD_LAYOUT _REC_MAP_20_u1_u2_u2 FNC_VALUES 1 UBYTE COLUMN_DIR DIRECT /end RECORD_LAYOUT
/begin RECORD_LAYOUT _REC_VAL_20_u4 FNC_VALUES 1 ULONG COLUMN_DIR DIRECT /end RECORD_LAYOUT
/begin FUNCTION EGCP_WRAF_sensor_control "_WRAF_sensor_control"
 /begin DEF_CHARACTERISTIC c_ctr_icplsl_dec c_ctr_icplsl_inc c_ctr_icplsl_thd lc_icplsl_act lc_icplsl_ena_lsl_if lc_iplsl_ctl_ena_man_lsl_if ldp_lamb_sp_ip_r_it_iplsl c_r_it_iplsl_agi_add c_icplsl_pwl_lsl_if c_vplsl_thd_vnlsl_lim c_ctr_iplsl_ctl_ena_nr_cyc c_ctr_iplsl_ctl_ena_pwm_on c_ctr_iplsl_ctl_ena_pwm_off c_ttip_thd_iplsl_act_ls_up c_t_dly_iplsl_ctl_ena c_t_dly_max_vnlsl_lim_act c_ttip_thd_icplsl_inc_ls_up c_lamb_thd_max_vnlsl_lim c_lamb_thd_max_vplsl_lim c_lamb_sp_min_iplsl_ctl_ena c_lamb_sp_max_iplsl_ctl_ena ldp_r_it_ls_up_ip_r_it_iplsl ldp_ttip_ls_ip_ctr_icplsl_thd ldp_icplsl_ip_ctr_icplsl_thd ldp_lamb_ip_icplsl_iplsl_ena ldp_lamb_sp_ip_icplsl_iplsl_di ldp_lamb_sp_ip_icplsl_wup ldp_saf_kgh_ip_icplsl_iplsl_di ldp_saf_kgh_ip_icplsl_wup ip_r_it_iplsl id_ctr_icplsl_thd ip_lsl_if_icplsl_iplsl_ctl_ena id_lsl_if_icplsl_iplsl_ctl_di id_lsl_if_icplsl_wup c_r_it_iplsl_agi_fac c_t_icplsl_dly_pwl c_t_iplsl_not_vld_vb_l_inc c_t_iplsl_not_vld_vb_l_dec c_vb_l_thd_iplsl_not_vld lc_vb_l_sim_man lc_iplsl_ctl_ena_man_swi_lsl_if c_vb_min_iplsl_ctl_ena /end DEF_CHARACTERISTIC
 /begin OUT_MEASUREMENT egcp[0].egcp_struct_acctlifa0.ctr_icplsl egcp[0].egcp_struct_acctlifa0.ctr_icplsl_max egcp[0].egcp_struct_acctlifa0.t_icplsl_dly_pwl egcp[0].egcp_struct_acctlifa0.lamb_thd_vplsl_lim egcp[0].egcp_struct_acctlifa0.lamb_thd_tmp_vplsl_lim egcp[0].egcp_struct_acctlifa0.t_dly_vnlsl_lim_act egcp[0].egcp_struct_acctlifa0.t_iplsl_not_vld_vb_l egcp[0].egcp_struct_acctlifa0.t_iplsl_not_vld_vb_l_thd egcp[0].egcp_struct_acctlifa0.r_it_iplsl egcp[0].egcp_struct_acctlifa0.vplsl egcp[0].egcp_struct_acctlifa0.t_dly_iplsl_ctl_ena egcp[0].egcp_struct_acctlifa0.icplsl_lsl_if egcp[0].egcp_struct_acctlifa0.ctr_iplsl_ctl_ena_nr_cyc egcp[0].egcp_struct_acctlifa0.ctr_iplsl_ctl_ena_pwm_on egcp[0].egcp_struct_acctlifa0.ctr_iplsl_ctl_ena_pwm_off egcp[0].egcp_struct_acctlifa0.lv_icplsl_ena_lsl_if egcp[0].egcp_struct_acctlifa0.lv_icplsl_vld egcp[0].egcp_struct_acctlifa0.lv_iplsl_ctl_ena_lsl_if egcp[0].egcp_struct_acctlifa0.lv_iplsl_ctl_inh_vplsl_lim egcp[0].egcp_struct_acctlifa0.lv_iplsl_vld egcp[0].egcp_struct_acctlifa0.lv_iplsl_ctl_ena_pls_act egcp[0].egcp_struct_acctlifa0.lv_lamb_ls_up_vld egcp[0].egcp_struct_acctlifa0.lv_iplsl_ctl_inh_vnlsl_lim egcp[0].egcp_struct_acctlifa0.lv_vplsl_lim_act egcp[0].egcp_struct_acctlifa0.lv_iplsl_not_vld_vb_l egcp[1].egcp_struct_acctlifa0.ctr_icplsl egcp[1].egcp_struct_acctlifa0.ctr_icplsl_max egcp[1].egcp_struct_acctlifa0.t_icplsl_dly_pwl egcp[1].egcp_struct_acctlifa0.lamb_thd_vplsl_lim egcp[1].egcp_struct_acctlifa0.lamb_thd_tmp_vplsl_lim egcp[1].egcp_struct_acctlifa0.t_dly_vnlsl_lim_act egcp[1].egcp_struct_acctlifa0.t_iplsl_not_vld_vb_l egcp[1].egcp_struct_acctlifa0.t_iplsl_not_vld_vb_l_thd egcp[1].egcp_struct_acctlifa0.r_it_iplsl egcp[1].egcp_struct_acctlifa0.vplsl egcp[1].egcp_struct_acctlifa0.t_dly_iplsl_ctl_ena egcp[1].egcp_struct_acctlifa0.icplsl_lsl_if egcp[1].egcp_struct_acctlifa0.ctr_iplsl_ctl_ena_nr_cyc egcp[1].egcp_struct_acctlifa0.ctr_iplsl_ctl_ena_pwm_on egcp[1].egcp_struct_acctlifa0.ctr_iplsl_ctl_ena_pwm_off egcp[1].egcp_struct_acctlifa0.lv_icplsl_ena_lsl_if egcp[1].egcp_struct_acctlifa0.lv_icplsl_vld egcp[1].egcp_struct_acctlifa0.lv_iplsl_ctl_ena_lsl_if egcp[1].egcp_struct_acctlifa0.lv_iplsl_ctl_inh_vplsl_lim egcp[1].egcp_struct_acctlifa0.lv_iplsl_vld egcp[1].egcp_struct_acctlifa0.lv_iplsl_ctl_ena_pls_act egcp[1].egcp_struct_acctlifa0.lv_lamb_ls_up_vld egcp[1].egcp_struct_acctlifa0.lv_iplsl_ctl_inh_vnlsl_lim egcp[1].egcp_struct_acctlifa0.lv_vplsl_lim_act egcp[1].egcp_struct_acctlifa0.lv_iplsl_not_vld_vb_l /end OUT_MEASUREMENT
/end FUNCTION
/begin FUNCTION EGCP_WRAF_GAIN_AD_fuel_cut_off "_WRAF_GAIN_AD_fuel_cut_off"
 /begin DEF_CHARACTERISTIC c_tam_max_lsl_gain_ad c_amp_min_lsl_gain_ad c_tco_min_lsl_gain_ad c_ttip_max_lsl_gain_ad c_ttip_min_lsl_gain_ad c_n_32_min_lsl_gain_ad c_crlc_iplsl_cor_fcut c_crlc_iplsl_mv_vld c_iplsl_vari_thd_max_purge c_iplsl_vari_thd_min_purge c_iplsl_cor_grd_thd_fcut c_fac_iplsl_cor_thd_fcut c_fac_lsl_gain_ad_lim_max c_fac_lsl_gain_ad_lim_min c_iplsl_mv_vld_vari_max c_nr_gear_min_lsl_gain_ad lc_fac_lsl_gain_ad_lim_rst lc_fac_lsl_gain_ad_ena lc_map_puc_lim_act_not_vld lc_lsl_gain_ad_test ldp_amp_ip_fac_cor_iplsl_amp ldp_maf_kgh_ip_fac_cor_iplsl ldp_n_32_ip_fac_cor_iplsl ldp_ttip_mes_ls_up_ip_fac_iplsl ldp_iplsl_chg_purge_ip_iplsl ip_fac_cor_iplsl_amp ip_fac_cor_iplsl_maf_kgh ip_fac_cor_iplsl_n_32 ip_fac_cor_iplsl_ttip_mes_ls_up ip_fac_cor_iplsl_chg_purge lc_lsl_gain_ad_ena lc_fac_lsl_gain_ad_man_adj_ena c_iplsl_nom_purge c_fac_lsl_gain_ad_man_adj c_n_32_max_lsl_gain_ad c_t_acq_iplsl_purge c_t_dly_iplsl_cor_mmv_fcut_vld lc_map_puc_lim_req_lsl_gain_ad lc_iplsl_gain_sel_lsl_gain_ad c_n_32_bol_lsl_gain_ad c_n_32_tol_lsl_gain_ad /end DEF_CHARACTERISTIC
 /begin OUT_MEASUREMENT lv_map_puc_lim_req_lsl_gain_ad egcp[0].egcp_struct_adcprlsl2.iplsl_vari_purge egcp[0].egcp_struct_adcprlsl2.iplsl_vari_vld_fcut egcp[0].egcp_struct_adcprlsl2.iplsl_purge egcp[0].egcp_struct_adcprlsl2.iplsl_cor_mmv_fcut egcp[0].egcp_struct_adcprlsl2.iplsl_mv_purge egcp[0].egcp_struct_adcprlsl2.iplsl_cor_beg_purge egcp[0].egcp_struct_adcprlsl2.iplsl_cor_chg_purge egcp[0].egcp_struct_adcprlsl2.iplsl_mmv_vld_fcut egcp[0].egcp_struct_adcprlsl2.fac_lsl_gain_ad egcp[0].egcp_struct_adcprlsl2.t_acq_iplsl_purge egcp[0].egcp_struct_adcprlsl2.t_dly_iplsl_cor_mmv_fcut_vld egcp[0].egcp_struct_adcprlsl2.state_iplsl_ad_fcut egcp[0].egcp_struct_adcprlsl2.state_iplsl_gain_ad egcp[0].egcp_struct_adcprlsl2.lv_lsl_gain_ad_req egcp[0].egcp_struct_adcprlsl2.lv_lsl_gain_ad_req_vld egcp[0].egcp_struct_adcprlsl2.lv_iplsl_vld_fcut egcp[0].egcp_struct_adcprlsl2.lv_lsl_fcut_mes_rep_inh egcp[0].egcp_struct_adcprlsl2.lv_lsl_fcut_mes_not_plaus egcp[0].egcp_struct_adcprlsl2.lv_lsl_gain_ad_fcut_not_ok egcp[0].egcp_struct_adcprlsl2.lv_fac_lsl_gain_ad_lim_max egcp[0].egcp_struct_adcprlsl2.lv_fac_lsl_gain_ad_lim_min egcp[0].egcp_struct_adcprlsl2.lv_iplsl_cor_mmv_fcut_vld egcp[1].egcp_struct_adcprlsl2.iplsl_vari_purge egcp[1].egcp_struct_adcprlsl2.iplsl_vari_vld_fcut egcp[1].egcp_struct_adcprlsl2.iplsl_purge egcp[1].egcp_struct_adcprlsl2.iplsl_cor_mmv_fcut egcp[1].egcp_struct_adcprlsl2.iplsl_mv_purge egcp[1].egcp_struct_adcprlsl2.iplsl_cor_beg_purge egcp[1].egcp_struct_adcprlsl2.iplsl_cor_chg_purge egcp[1].egcp_struct_adcprlsl2.iplsl_mmv_vld_fcut egcp[1].egcp_struct_adcprlsl2.fac_lsl_gain_ad egcp[1].egcp_struct_adcprlsl2.t_acq_iplsl_purge egcp[1].egcp_struct_adcprlsl2.t_dly_iplsl_cor_mmv_fcut_vld egcp[1].egcp_struct_adcprlsl2.state_iplsl_ad_fcut egcp[1].egcp_struct_adcprlsl2.state_iplsl_gain_ad egcp[1].egcp_struct_adcprlsl2.lv_lsl_gain_ad_req egcp[1].egcp_struct_adcprlsl2.lv_lsl_gain_ad_req_vld egcp[1].egcp_struct_adcprlsl2.lv_iplsl_vld_fcut egcp[1].egcp_struct_adcprlsl2.lv_lsl_fcut_mes_rep_inh egcp[1].egcp_struct_adcprlsl2.lv_lsl_fcut_mes_not_plaus egcp[1].egcp_struct_adcprlsl2.lv_lsl_gain_ad_fcut_not_ok egcp[1].egcp_struct_adcprlsl2.lv_fac_lsl_gain_ad_lim_max egcp[1].egcp_struct_adcprlsl2.lv_fac_lsl_gain_ad_lim_min egcp[1].egcp_struct_adcprlsl2.lv_iplsl_cor_mmv_fcut_vld /end OUT_MEASUREMENT
/end FUNCTION
/begin FUNCTION EGCP_Air_fuel_cycle_evaluation "_Air_fuel_cycle_evaluation"
 /begin OUT_MEASUREMENT egcp[0].egcp_struct_ispclls0.ctr_afl_cyc egcp[0].egcp_struct_ispclls0.t_afr_cyc egcp[0].egcp_struct_ispclls0.t_afl_cyc egcp[0].egcp_struct_ispclls0.t_afl_cyc_hld egcp[0].egcp_struct_ispclls0.t_sum_afl_afr_cyc egcp[0].egcp_struct_ispclls0.lv_afl egcp[1].egcp_struct_ispclls0.ctr_afl_cyc egcp[1].egcp_struct_ispclls0.t_afr_cyc egcp[1].egcp_struct_ispclls0.t_afl_cyc egcp[1].egcp_struct_ispclls0.t_afl_cyc_hld egcp[1].egcp_struct_ispclls0.t_sum_afl_afr_cyc egcp[1].egcp_struct_ispclls0.lv_afl /end OUT_MEASUREMENT
/end FUNCTION
/begin FUNCTION EGCP_WRAF_GAIN_AD_fuel_cutoff_AI "_A_I_WRAF_GAIN_AD_fuel_cut_off" /begin DEF_CHARACTERISTIC lc_lsl_gain_ad_ena_all_opm /end DEF_CHARACTERISTIC
 /begin OUT_MEASUREMENT egcp[0].egcp_struct_adcprlsli2.lv_inh_lsl_gain_ad egcp[1].egcp_struct_adcprlsli2.lv_inh_lsl_gain_ad /end OUT_MEASUREMENT
/end FUNCTION
/begin FUNCTION EGCP_A_I_upstream_ls_heater_mng "_A_I_upstream_ls_heater_mng"
 /begin DEF_CHARACTERISTIC lc_lsh_up[0] lc_lsh_up[1] lc_lsh_up_cll_ctl[0] lc_lsh_up_cll_ctl[1] lc_lshpwm_up_man_adj[0] lc_lshpwm_up_man_adj[1] c_inc_v_efc_man c_v_efc_man /end DEF_CHARACTERISTIC
 /begin OUT_MEASUREMENT lshpwm_up_man v_efc_lsh_up_man egcp[0].egcp_struct_acctllshi0.temp_ini_ls_up egcp[0].egcp_struct_acctllshi0.lshpwm_ext_ls_up egcp[0].egcp_struct_acctllshi0.lv_inh_lsh_ctl_cll_lsh_up egcp[0].egcp_struct_acctllshi0.lv_inh_lsh_up egcp[1].egcp_struct_acctllshi0.temp_ini_ls_up egcp[1].egcp_struct_acctllshi0.lshpwm_ext_ls_up egcp[1].egcp_struct_acctllshi0.lv_inh_lsh_ctl_cll_lsh_up egcp[1].egcp_struct_acctllshi0.lv_inh_lsh_up /end OUT_MEASUREMENT
/end FUNCTION
/begin FUNCTION EGCP_A_I_downstream_ls_heat_mng "_A_I_downstream_ls_heat_mng" /begin DEF_CHARACTERISTIC lc_lsh_down[0] lc_lsh_down[1] /end DEF_CHARACTERISTIC
 /begin OUT_MEASUREMENT egcp[0].egcp_struct_acctllshdi0.temp_ini_ls_down egcp[0].egcp_struct_acctllshdi0.lshpwm_ext_ls_down egcp[0].egcp_struct_acctllshdi0.lv_inh_lsh_down egcp[1].egcp_struct_acctllshdi0.temp_ini_ls_down egcp[1].egcp_struct_acctllshdi0.lshpwm_ext_ls_down egcp[1].egcp_struct_acctllshdi0.lv_inh_lsh_down /end OUT_MEASUREMENT
/end FUNCTION
/begin FUNCTION EGCP_Offset_adj_oxygen_sens__AI "Offset_adj_oxygen_sens__AI"
 /begin OUT_MEASUREMENT egcp[0].egcp_struct_adcprlsli1.lv_inh_lsl_ofs_adj egcp[1].egcp_struct_adcprlsli1.lv_inh_lsl_ofs_adj /end OUT_MEASUREMENT
/end FUNCTION
/begin FUNCTION C_2_EGCP "C_2_EGCP"
 /begin SUB_FUNCTION EGCP_Exhaust_gas_composition EGCP_Sig_ACQ_cyl_individual_LAM EGCP_WRAF_interface_ATIC42 EGCP_ACQ_ls_V_LAMB_model_value /end SUB_FUNCTION
/end FUNCTION
/begin FUNCTION EGCP_Exhaust_gas_composition "_Exhaust_gas_composition"
 /begin OUT_MEASUREMENT egcp[0].egcp_struct_sigcv0.vls_up_raw egcp[0].egcp_struct_sigcv0.vls_down egcp[0].egcp_struct_sigcv0.v_temp_ls_up egcp[1].egcp_struct_sigcv0.vls_up_raw egcp[1].egcp_struct_sigcv0.vls_down egcp[1].egcp_struct_sigcv0.v_temp_ls_up /end OUT_MEASUREMENT
/end FUNCTION
/begin FUNCTION EGCP_Sig_ACQ_cyl_individual_LAM "_Sig_ACQ_cyl_individual_LAM"
 /begin OUT_MEASUREMENT vls_up_cyl_sel[0] vls_up_cyl_sel[1] vls_up_cyl_sel[2] vls_up_cyl_sel[3] vls_up_cyl_sel[4] vls_up_cyl_sel[5] ctr_vls_up_cyl_sel_trig[0] ctr_vls_up_cyl_sel_trig[1] ctr_vls_up_cyl_sel_trig[2] ctr_vls_up_cyl_sel_trig[3] ctr_vls_up_cyl_sel_trig[4] ctr_vls_up_cyl_sel_trig[5] /end OUT_MEASUREMENT
/end FUNCTION
/begin FUNCTION EGCP_WRAF_interface_ATIC42 "_WRAF_interface_ATIC42"
 /begin OUT_MEASUREMENT egcp[0].egcp_struct_sigcvif1.state_lsl_if_spi_rd egcp[0].egcp_struct_sigcvif1.state_lsl_if_conf_spi_rd egcp[0].egcp_struct_sigcvif1.ctr_err_lsl_if_spi_wr egcp[0].egcp_struct_sigcvif1.frq_r_it_osc_lsl_if_spi_rd egcp[0].egcp_struct_sigcvif1.state_err_vnlsl egcp[0].egcp_struct_sigcvif1.state_err_vglsl egcp[0].egcp_struct_sigcvif1.state_err_viplsl egcp[0].egcp_struct_sigcvif1.state_err_vrclsl egcp[0].egcp_struct_sigcvif1.state_err_iplsl egcp[0].egcp_struct_sigcvif1.state_err_lsl egcp[0].egcp_struct_sigcvif1.lv_lsl_deac egcp[0].egcp_struct_sigcvif1.lv_vplsl_lim egcp[0].egcp_struct_sigcvif1.lv_vnlsl_lim egcp[0].egcp_struct_sigcvif1.ctr_err_lsl_if_spi_it_osc_ena egcp[1].egcp_struct_sigcvif1.state_lsl_if_spi_rd egcp[1].egcp_struct_sigcvif1.state_lsl_if_conf_spi_rd egcp[1].egcp_struct_sigcvif1.ctr_err_lsl_if_spi_wr egcp[1].egcp_struct_sigcvif1.frq_r_it_osc_lsl_if_spi_rd egcp[1].egcp_struct_sigcvif1.state_err_vnlsl egcp[1].egcp_struct_sigcvif1.state_err_vglsl egcp[1].egcp_struct_sigcvif1.state_err_viplsl egcp[1].egcp_struct_sigcvif1.state_err_vrclsl egcp[1].egcp_struct_sigcvif1.state_err_iplsl egcp[1].egcp_struct_sigcvif1.state_err_lsl egcp[1].egcp_struct_sigcvif1.lv_lsl_deac egcp[1].egcp_struct_sigcvif1.lv_vplsl_lim egcp[1].egcp_struct_sigcvif1.lv_vnlsl_lim egcp[1].egcp_struct_sigcvif1.ctr_err_lsl_if_spi_it_osc_ena /end OUT_MEASUREMENT
/end FUNCTION
/begin FUNCTION EGCP_ACQ_ls_V_LAMB_model_value "_ACQ_ls_V_LAMB_model_value"
 /begin OUT_MEASUREMENT egcp[0].egcp_struct_sigcvlsl2.lamb_sp_fil_delta_rise egcp[0].egcp_struct_sigcvlsl2.lamb_sp_fil_delta_fall egcp[0].egcp_struct_sigcvlsl2.vls_up_delta_rise egcp[0].egcp_struct_sigcvlsl2.vls_up_delta_fall egcp[1].egcp_struct_sigcvlsl2.lamb_sp_fil_delta_rise egcp[1].egcp_struct_sigcvlsl2.lamb_sp_fil_delta_fall egcp[1].egcp_struct_sigcvlsl2.vls_up_delta_rise egcp[1].egcp_struct_sigcvlsl2.vls_up_delta_fall /end OUT_MEASUREMENT
/end FUNCTION
/begin FUNCTION C_4_EGCP "C_4_EGCP"
 /begin DEF_CHARACTERISTIC ldpm_t_afl_cyc_hld_1_egcp ldpm_maf_kgh_1_egcp ldpm_maf_kgh_3_egcp /end DEF_CHARACTERISTIC
 /begin OUT_MEASUREMENT egcp_struct_sigcvlsl3_loc[0].vls_up_tot_sum_mv egcp_struct_sigcvlsl3_loc[0].vls_up_inter_1_sum egcp_struct_sigcvlsl3_loc[0].vls_up_inter_2_sum egcp_struct_sigcvlsl3_loc[0].vls_up_mv egcp_struct_sigcvlsl3_loc[0].nr_sample_tot_mv egcp_struct_sigcvlsl3_loc[0].nr_vls_up_buf_idx egcp_struct_sigcvlsl3_loc[0].state_lsl_if_spi_rd_old egcp_struct_sigcvlsl3_loc[0].state_lsl_if_spi_wr_old egcp_struct_sigcvlsl3_loc[0].t_dly_vls_up_init egcp_struct_sigcvlsl3_loc[1].vls_up_tot_sum_mv egcp_struct_sigcvlsl3_loc[1].vls_up_inter_1_sum egcp_struct_sigcvlsl3_loc[1].vls_up_inter_2_sum egcp_struct_sigcvlsl3_loc[1].vls_up_mv egcp_struct_sigcvlsl3_loc[1].nr_sample_tot_mv egcp_struct_sigcvlsl3_loc[1].nr_vls_up_buf_idx egcp_struct_sigcvlsl3_loc[1].state_lsl_if_spi_rd_old egcp_struct_sigcvlsl3_loc[1].state_lsl_if_spi_wr_old egcp_struct_sigcvlsl3_loc[1].t_dly_vls_up_init /end OUT_MEASUREMENT
 /begin SUB_FUNCTION EGCP_Downstream_ls_R_det EGCP_ls_ceramic_temperature EGCP_WRAF_IF_BSW_ASW_ATIC42 EGCP_Appl_Inc_ATIC42_ASW_BSW_IF EGCP_Appl_Inc_ls_temperature EGCP_Appl_Inc_downst_ls_intern_R EGCP_WRAF_Sensr_Sig_Processing /end SUB_FUNCTION
/end FUNCTION
/begin FUNCTION EGCP_Downstream_ls_R_det "_Downstream_ls_R_det"
 /begin DEF_CHARACTERISTIC c_t_cur_pump_on_ls_down c_t_cur_pump_off_ls_down c_t_dly_cur_pump_ls_down c_vls_down_mmv_min_rng_bol_r_it c_vls_down_mmv_min_rng_tol_r_it c_vls_down_mmv_drv1_thd_min c_vls_down_mmv_drv1_thd_max c_fac_vls_down_mmv_drv1_thd c_ctr_afl_cyc_min_ri_it_ls_down c_maf_kgh_max_r_it_ls_down c_fac_vls_down_mmv_drv1_thd_min c_fac_r_it_err_neg_ls_down c_fac_r_it_err_pos_ls_down c_crlc_pow_mmv_lsh_down c_crlc_ttip_fall_r_it_ls_down c_crlc_ttip_rise_r_it_ls_down lc_r_it_vld_inh_ls_down ip_crlc_ttip_ref_mdl_ls_down ldp_ttip_ref_mdl_mmv_ls_down_r ip_fac_t_drv1_vls_down_mmv ip_fac_t_vls_down_mmv_drv1_abs ip_r_it_mdl_ls_down_new ip_ttip_mes_ls_down ldp_pow_mmv_lsh_down_ip_ls_down ldp_r_it_mes_ls_down_ip_ls_down c_vls_down_mmv_drv1_abs_max c_vls_hys_r_it_ls_down c_teg_min_cur_pump_on_ls_down /end DEF_CHARACTERISTIC
 /begin OUT_MEASUREMENT egcp[0].egcp_struct_sigcvrid0.vls_down_mmv_drv1_thd_min egcp[0].egcp_struct_sigcvrid0.vls_down_mmv_drv1_thd_max egcp[0].egcp_struct_sigcvrid0.ttip_mes_ls_down egcp[0].egcp_struct_sigcvrid0.ttip_mes_tol_ls_down egcp[0].egcp_struct_sigcvrid0.ttip_mes_bol_ls_down egcp[0].egcp_struct_sigcvrid0.ttip_mes_tol_mmv_ls_down egcp[0].egcp_struct_sigcvrid0.ttip_mes_bol_mmv_ls_down egcp[0].egcp_struct_sigcvrid0.ctr_cycnr_r_it_ls_down_vld egcp[0].egcp_struct_sigcvrid0.pow_mmv_lsh_down egcp[0].egcp_struct_sigcvrid0.r_it_ls_down egcp[0].egcp_struct_sigcvrid0.r_it_mes_ls_down egcp[0].egcp_struct_sigcvrid0.r_it_mdl_ls_down_new egcp[0].egcp_struct_sigcvrid0.t_sample_r_it_ls_down egcp[0].egcp_struct_sigcvrid0.ttip_ref_mdl_mmv_ls_down egcp[0].egcp_struct_sigcvrid0.vls_down_cur_pump_on egcp[0].egcp_struct_sigcvrid0.vls_down_cur_pump_off egcp[0].egcp_struct_sigcvrid0.fac_t_vls_down_mmv_drv1 egcp[0].egcp_struct_sigcvrid0.fac_t_vls_down_mmv_drv1_abs egcp[0].egcp_struct_sigcvrid0.t_afl_cyc_hld_r_it_ls_down egcp[0].egcp_struct_sigcvrid0.lv_r_it_req_ls_down egcp[0].egcp_struct_sigcvrid0.lv_r_it_det_ls_down egcp[0].egcp_struct_sigcvrid0.lv_vls_down_drv1_cdn_r_ls egcp[0].egcp_struct_sigcvrid0.lv_vls_down_rng_cdn_r_ls egcp[1].egcp_struct_sigcvrid0.vls_down_mmv_drv1_thd_min egcp[1].egcp_struct_sigcvrid0.vls_down_mmv_drv1_thd_max egcp[1].egcp_struct_sigcvrid0.ttip_mes_ls_down egcp[1].egcp_struct_sigcvrid0.ttip_mes_tol_ls_down egcp[1].egcp_struct_sigcvrid0.ttip_mes_bol_ls_down egcp[1].egcp_struct_sigcvrid0.ttip_mes_tol_mmv_ls_down egcp[1].egcp_struct_sigcvrid0.ttip_mes_bol_mmv_ls_down egcp[1].egcp_struct_sigcvrid0.ctr_cycnr_r_it_ls_down_vld egcp[1].egcp_struct_sigcvrid0.pow_mmv_lsh_down egcp[1].egcp_struct_sigcvrid0.r_it_ls_down egcp[1].egcp_struct_sigcvrid0.r_it_mes_ls_down egcp[1].egcp_struct_sigcvrid0.r_it_mdl_ls_down_new egcp[1].egcp_struct_sigcvrid0.t_sample_r_it_ls_down egcp[1].egcp_struct_sigcvrid0.ttip_ref_mdl_mmv_ls_down egcp[1].egcp_struct_sigcvrid0.vls_down_cur_pump_on egcp[1].egcp_struct_sigcvrid0.vls_down_cur_pump_off egcp[1].egcp_struct_sigcvrid0.fac_t_vls_down_mmv_drv1 egcp[1].egcp_struct_sigcvrid0.fac_t_vls_down_mmv_drv1_abs egcp[1].egcp_struct_sigcvrid0.t_afl_cyc_hld_r_it_ls_down egcp[1].egcp_struct_sigcvrid0.lv_r_it_req_ls_down egcp[1].egcp_struct_sigcvrid0.lv_r_it_det_ls_down egcp[1].egcp_struct_sigcvrid0.lv_vls_down_drv1_cdn_r_ls egcp[1].egcp_struct_sigcvrid0.lv_vls_down_rng_cdn_r_ls /end OUT_MEASUREMENT
/end FUNCTION
/begin FUNCTION EGCP_ls_ceramic_temperature "_ls_ceramic_temperature"
 /begin DEF_CHARACTERISTIC ldp_r_it_ls_up_ip_ttip_ls_up ip_ttip_mes_ls_up c_t_dly_ofs_adj_r_it_ls_up c_t_dly_fac_gain_r_it_ls_up c_t_dly_clc_r_it_ls_up c_t_dly_ofs_mes_r_it_ls_up c_t_max_v_ofs_adj_r_it_ls_up c_t_max_fac_gain_r_it_ls_up c_t_max_v_ofs_mes_r_it_ls_up c_v_dif_max_ofs_adj_r_it_ls_up c_v_dif_max_ofs_mes_r_it_ls_up lc_r_rng_req_ls_up_lsl_if lc_r_rng_req_swi_ls_up_lsl_if c_fac_gain_r_it_ls_up c_r_it_ref_ls_up c_fac_gain_h_dif_r_it_ls_up c_fac_gain_h_r_it_ls_up c_fac_gain_l_dif_r_it_ls_up c_fac_gain_l_r_it_ls_up c_v_ofs_ref_r_it_ls_up c_frq_r_it_osc_lsl_if lc_v_ref_r_it_ls_up c_t_dly_r_it_iplsl_ctl_act /end DEF_CHARACTERISTIC
 /begin OUT_MEASUREMENT egcp[0].egcp_struct_sigcvtipa0.ttip_mes_ls_up egcp[0].egcp_struct_sigcvtipa0.r_it_ls_up egcp[0].egcp_struct_sigcvtipa0.tcc_v_ofs_mes_r_it_ls_up egcp[0].egcp_struct_sigcvtipa0.tcc_v_ofs_adj_r_it_ls_up egcp[0].egcp_struct_sigcvtipa0.tcc_fac_gain_h_r_it_ls_up egcp[0].egcp_struct_sigcvtipa0.tcc_fac_gain_l_r_it_ls_up egcp[0].egcp_struct_sigcvtipa0.tcc_err_v_ofs_mes_r_it_ls_up egcp[0].egcp_struct_sigcvtipa0.tcc_err_v_ofs_adj_r_it_ls_up egcp[0].egcp_struct_sigcvtipa0.tcc_err_fac_gain_h_r_ls_up egcp[0].egcp_struct_sigcvtipa0.tcc_err_fac_gain_l_r_ls_up egcp[0].egcp_struct_sigcvtipa0.v_ofs_adj_r_it_ls_up egcp[0].egcp_struct_sigcvtipa0.v_ofs_mes_r_it_ls_up egcp[0].egcp_struct_sigcvtipa0.fac_gain_h_r_it_ls_up egcp[0].egcp_struct_sigcvtipa0.fac_gain_l_r_it_ls_up egcp[0].egcp_struct_sigcvtipa0.frq_r_it_osc_lsl_if_spi_wr egcp[0].egcp_struct_sigcvtipa0.state_ttip_mes_ls_up egcp[0].egcp_struct_sigcvtipa0.t_dly_r_it_iplsl_ctl_act egcp[0].egcp_struct_sigcvtipa0.lv_fac_gain_h_vld_r_it_ls_up egcp[0].egcp_struct_sigcvtipa0.lv_fac_gain_l_vld_r_it_ls_up egcp[0].egcp_struct_sigcvtipa0.lv_r_it_cal_ena_lsl_if egcp[0].egcp_struct_sigcvtipa0.lv_r_it_osc_ena_lsl_if egcp[0].egcp_struct_sigcvtipa0.lv_r_it_swi_rng_lsl_if egcp[0].egcp_struct_sigcvtipa0.lv_ttip_mes_vld_ls_up egcp[0].egcp_struct_sigcvtipa0.lv_v_ofs_adj_vld_r_it_ls_up egcp[0].egcp_struct_sigcvtipa0.lv_v_ofs_mes_vld_r_it_ls_up egcp[0].egcp_struct_sigcvtipa0.lv_v_ref_vld_r_it_ls_up egcp[0].egcp_struct_sigcvtipa0.lv_r_it_req_ls_up egcp[1].egcp_struct_sigcvtipa0.ttip_mes_ls_up egcp[1].egcp_struct_sigcvtipa0.r_it_ls_up egcp[1].egcp_struct_sigcvtipa0.tcc_v_ofs_mes_r_it_ls_up egcp[1].egcp_struct_sigcvtipa0.tcc_v_ofs_adj_r_it_ls_up egcp[1].egcp_struct_sigcvtipa0.tcc_fac_gain_h_r_it_ls_up egcp[1].egcp_struct_sigcvtipa0.tcc_fac_gain_l_r_it_ls_up egcp[1].egcp_struct_sigcvtipa0.tcc_err_v_ofs_mes_r_it_ls_up egcp[1].egcp_struct_sigcvtipa0.tcc_err_v_ofs_adj_r_it_ls_up egcp[1].egcp_struct_sigcvtipa0.tcc_err_fac_gain_h_r_ls_up egcp[1].egcp_struct_sigcvtipa0.tcc_err_fac_gain_l_r_ls_up egcp[1].egcp_struct_sigcvtipa0.v_ofs_adj_r_it_ls_up egcp[1].egcp_struct_sigcvtipa0.v_ofs_mes_r_it_ls_up egcp[1].egcp_struct_sigcvtipa0.fac_gain_h_r_it_ls_up egcp[1].egcp_struct_sigcvtipa0.fac_gain_l_r_it_ls_up egcp[1].egcp_struct_sigcvtipa0.frq_r_it_osc_lsl_if_spi_wr egcp[1].egcp_struct_sigcvtipa0.state_ttip_mes_ls_up egcp[1].egcp_struct_sigcvtipa0.t_dly_r_it_iplsl_ctl_act egcp[1].egcp_struct_sigcvtipa0.lv_fac_gain_h_vld_r_it_ls_up egcp[1].egcp_struct_sigcvtipa0.lv_fac_gain_l_vld_r_it_ls_up egcp[1].egcp_struct_sigcvtipa0.lv_r_it_cal_ena_lsl_if egcp[1].egcp_struct_sigcvtipa0.lv_r_it_osc_ena_lsl_if egcp[1].egcp_struct_sigcvtipa0.lv_r_it_swi_rng_lsl_if egcp[1].egcp_struct_sigcvtipa0.lv_ttip_mes_vld_ls_up egcp[1].egcp_struct_sigcvtipa0.lv_v_ofs_adj_vld_r_it_ls_up egcp[1].egcp_struct_sigcvtipa0.lv_v_ofs_mes_vld_r_it_ls_up egcp[1].egcp_struct_sigcvtipa0.lv_v_ref_vld_r_it_ls_up egcp[1].egcp_struct_sigcvtipa0.lv_r_it_req_ls_up /end OUT_MEASUREMENT
/end FUNCTION
/begin FUNCTION EGCP_WRAF_IF_BSW_ASW_ATIC42 "_WRAF_IF_BSW_ASW_ATIC42" /begin DEF_CHARACTERISTIC c_state_lsl_if_spi_wr_ini c_state_lsl_if_conf_spi_wr_ini /end DEF_CHARACTERISTIC
 /begin OUT_MEASUREMENT egcp[0].egcp_struct_sigcvif2.state_lsl_if_spi_wr egcp[0].egcp_struct_sigcvif2.state_lsl_if_conf_spi_wr egcp[0].egcp_struct_sigcvif2.lv_lsl_if_spi_rst_end egcp[1].egcp_struct_sigcvif2.state_lsl_if_spi_wr egcp[1].egcp_struct_sigcvif2.state_lsl_if_conf_spi_wr egcp[1].egcp_struct_sigcvif2.lv_lsl_if_spi_rst_end /end OUT_MEASUREMENT
/end FUNCTION
/begin FUNCTION EGCP_Appl_Inc_ATIC42_ASW_BSW_IF "_Appl_Inc_ATIC42_ASW_BSW_IF" /begin DEF_CHARACTERISTIC c_t_dly_di_lsl_if lc_ctr_err_lsl_if_spi_man_inc /end DEF_CHARACTERISTIC
 /begin OUT_MEASUREMENT egcp[0].egcp_struct_sigcvifi2.t_dly_di_lsl_if egcp[0].egcp_struct_sigcvifi2.lv_lsl_ena_lsl_if egcp[0].egcp_struct_sigcvifi2.lv_lsl_if_rst egcp[0].egcp_struct_sigcvifi2.lv_ctr_err_lsl_if_spi_man_inc egcp[1].egcp_struct_sigcvifi2.t_dly_di_lsl_if egcp[1].egcp_struct_sigcvifi2.lv_lsl_ena_lsl_if egcp[1].egcp_struct_sigcvifi2.lv_lsl_if_rst egcp[1].egcp_struct_sigcvifi2.lv_ctr_err_lsl_if_spi_man_inc /end OUT_MEASUREMENT
/end FUNCTION
/begin FUNCTION EGCP_Appl_Inc_ls_temperature "_Appl_Inc_ls_temperature"
 /begin OUT_MEASUREMENT egcp[0].egcp_struct_sigcvtipai0.lv_inh_ttip_ls_up egcp[1].egcp_struct_sigcvtipai0.lv_inh_ttip_ls_up /end OUT_MEASUREMENT
/end FUNCTION
/begin FUNCTION EGCP_Appl_Inc_downst_ls_intern_R "_Appl_Inc_ls_internal_R" /end FUNCTION
/begin FUNCTION EGCP_WRAF_Sensr_Sig_Processing "WRAF_Sensr_Sig_Processing"
 /begin DEF_CHARACTERISTIC c_vls_up_thd_tol lc_vls_up_mv_on c_vls_up_thd_bol c_t_dly_vls_up_init c_t_dly_vls_up_init_max /end DEF_CHARACTERISTIC
 /begin OUT_MEASUREMENT egcp[0].egcp_struct_sigcvlsl3.vls_up egcp[0].egcp_struct_sigcvlsl3.vls_up_10_raw egcp[0].egcp_struct_sigcvlsl3.lv_vls_up_vld egcp[0].egcp_struct_sigcvlsl3.lv_vls_up_init egcp[1].egcp_struct_sigcvlsl3.vls_up egcp[1].egcp_struct_sigcvlsl3.vls_up_10_raw egcp[1].egcp_struct_sigcvlsl3.lv_vls_up_vld egcp[1].egcp_struct_sigcvlsl3.lv_vls_up_init nr_value_buf_sum nr_vls_up_raw_buf_idx nr_vls_up_raw_sample_mv nr_value_buf_sample nr_sample_2_sum t_seg_len nr_sample_1_sum /end OUT_MEASUREMENT
/end FUNCTION
/begin FUNCTION C_A_EGCP "C_A_EGCP"
 /begin SUB_FUNCTION EGCP_Upst_ls_heat_OBDI_diag EGCP_Downst_ls_sig_mon EGCP_Downst_ls_heat_OBDI_diag EGCP_Signal_plausibily_mon EGCP_HW_based_DIAG_ATIC42 EGCP_WRAF_sensor_ctl_DIAG EGCP_A_I_WRAF_sens_electric_DIAG EGCP_A_I_WRAF_sens_ctl_DIAG EGCP_A_I_upst_ls_heat_OBDI_DIAG EGCP_downst_ls_heat_OBDI_DIAG_AI EGCP_A_I_downst_ls_probe_DIAG /end SUB_FUNCTION
/end FUNCTION
/begin FUNCTION EGCP_Upst_ls_heat_OBDI_diag "_Upstream_ls_heat_OBDI_diag"
 /begin DEF_CHARACTERISTIC c_lshpwm_max_diag_lsh_up c_teg_dyn_min_diag_lsh_up c_lshpwm_min_diag_lsh_up c_abc_inc_lsh_up c_abc_max_lsh_up /end DEF_CHARACTERISTIC
 /begin OUT_MEASUREMENT egcp[0].egcp_struct_outdglsh0.err_diag_lsh_up egcp[0].egcp_struct_outdglsh0.cdn_diag_lsh_up egcp[0].egcp_struct_outdglsh0.lv_lsh_scg_act_lsh_up egcp[1].egcp_struct_outdglsh0.err_diag_lsh_up egcp[1].egcp_struct_outdglsh0.cdn_diag_lsh_up egcp[1].egcp_struct_outdglsh0.lv_lsh_scg_act_lsh_up lv_err_lsh_up_1 lv_err_lsh_up_2 /end OUT_MEASUREMENT
/end FUNCTION
/begin FUNCTION EGCP_Downst_ls_sig_mon "_Downstream_ls_sig_mon"
 /begin DEF_CHARACTERISTIC c_ctr_min_diag_scg_ls_down c_maf_kgh_min_diag_scg_ls_down c_vls_thd_diag_scp_ls_down c_r_it_max_diag_scg_ls_down c_r_it_min_diag_oc_ls_down c_t_cdn_diag_oc_ls_down c_t_dly_diag_oc_ls_down c_t_dly_diag_scg_ls_down c_vls_thd_diag_scg_ls_down c_vls_afl_thd_diag_oc_ls_down c_vls_afr_thd_diag_oc_ls_down c_teg_dyn_min_diag_oc_ls_down /end DEF_CHARACTERISTIC
 /begin OUT_MEASUREMENT egcp[0].egcp_struct_sigdglsd1.t_act_pls_diag_scg_ls_down egcp[0].egcp_struct_sigdglsd1.t_act_pls_diag_oc_ls_down egcp[0].egcp_struct_sigdglsd1.t_cdn_diag_oc_ls_down egcp[0].egcp_struct_sigdglsd1.ctr_r_upd_diag_scg_ls_down egcp[0].egcp_struct_sigdglsd1.ctr_r_upd_diag_oc_ls_down egcp[0].egcp_struct_sigdglsd1.ctr_sym_diag_scg_ls_down egcp[0].egcp_struct_sigdglsd1.lv_err_el_ls_down egcp[0].egcp_struct_sigdglsd1.lv_diag_act_req_ls_down egcp[0].egcp_struct_sigdglsd1.lv_r_it_vld_diag_oc_ls_down egcp[0].egcp_struct_sigdglsd1.lv_t_cdn_diag_oc_ls_down egcp[1].egcp_struct_sigdglsd1.t_act_pls_diag_scg_ls_down egcp[1].egcp_struct_sigdglsd1.t_act_pls_diag_oc_ls_down egcp[1].egcp_struct_sigdglsd1.t_cdn_diag_oc_ls_down egcp[1].egcp_struct_sigdglsd1.ctr_r_upd_diag_scg_ls_down egcp[1].egcp_struct_sigdglsd1.ctr_r_upd_diag_oc_ls_down egcp[1].egcp_struct_sigdglsd1.ctr_sym_diag_scg_ls_down egcp[1].egcp_struct_sigdglsd1.lv_err_el_ls_down egcp[1].egcp_struct_sigdglsd1.lv_diag_act_req_ls_down egcp[1].egcp_struct_sigdglsd1.lv_r_it_vld_diag_oc_ls_down egcp[1].egcp_struct_sigdglsd1.lv_t_cdn_diag_oc_ls_down lv_err_scp_ls_down_1 lv_err_scg_ls_down_1 lv_err_oc_ls_down_1 lv_err_oc_ls_down_2 lv_err_scg_ls_down_2 lv_err_scp_ls_down_2 /end OUT_MEASUREMENT
/end FUNCTION
/begin FUNCTION EGCP_Downst_ls_heat_OBDI_diag "_Downstream_ls_heat_OBDI_diag"
 /begin DEF_CHARACTERISTIC c_lshpwm_max_diag_lsh_down c_lshpwm_min_diag_lsh_down c_teg_dyn_min_diag_lsh_down c_abc_inc_lsh_down c_abc_max_lsh_down /end DEF_CHARACTERISTIC
 /begin OUT_MEASUREMENT egcp[0].egcp_struct_outdglshd0.err_diag_lsh_down egcp[0].egcp_struct_outdglshd0.cdn_diag_lsh_down egcp[1].egcp_struct_outdglshd0.err_diag_lsh_down egcp[1].egcp_struct_outdglshd0.cdn_diag_lsh_down lv_err_lsh_down_1 lv_err_lsh_down_2 /end OUT_MEASUREMENT
/end FUNCTION
/begin FUNCTION EGCP_Signal_plausibily_mon "_Signal_plausibily_mon"
 /begin DEF_CHARACTERISTIC c_maf_int_max_diag_fl_ls_down c_maf_int_min_diag_puc_ls_down c_maf_int_min_diag_fl_ls_down c_vls_min_diag_puc_ls_down c_vls_max_diag_fl_ls_down c_maf_int_max_diag_puc_ls_down c_maf_int_puc_not_ls_down_diag c_fac_maf_int_ls_down_diag c_maf_kgh_min_ls_down_diag /end DEF_CHARACTERISTIC
 /begin OUT_MEASUREMENT egcp[0].egcp_struct_pladglsd2.lv_diag_cdn_plaus_ls_down egcp[0].egcp_struct_pladglsd2.lv_err_plaus_ls_down egcp[0].egcp_struct_pladglsd2.lv_diag_puc_chg_ls_down egcp[0].egcp_struct_pladglsd2.maf_int_puc_not_ls_down_diag egcp[1].egcp_struct_pladglsd2.lv_diag_cdn_plaus_ls_down egcp[1].egcp_struct_pladglsd2.lv_err_plaus_ls_down egcp[1].egcp_struct_pladglsd2.lv_diag_puc_chg_ls_down egcp[1].egcp_struct_pladglsd2.maf_int_puc_not_ls_down_diag lv_err_puc_ls_down_1 lv_err_fl_ls_down_1 lv_err_fl_ls_down_2 lv_err_puc_ls_down_2 maf_int_fl /end OUT_MEASUREMENT
/end FUNCTION
/end MODULE
/end PROJECT
