ASAP2_VERSION 1 31
/begin PROJECT MS45 "BMW Motorsteuerung R6"
/begin HEADER "_default_HeaderComment" PROJECT_NO _56 /end HEADER
/begin MODULE _default_ModuleName "_default_ModuleLongIdentifier"
/begin MOD_COMMON "_default_ModCommonComment" DEPOSIT ABSOLUTE BYTE_ORDER MSB_FIRST ALIGNMENT_BYTE 1 ALIGNMENT_WORD 2 ALIGNMENT_LONG 4 ALIGNMENT_FLOAT32_IEEE 4 ALIGNMENT_FLOAT64_IEEE 8 /end MOD_COMMON
/begin MEASUREMENT lv_inh_diag_ebox_cfa "E-Box cooling fan diagnosis: application incidence to inhibit the diagnosis" UBYTE _CNV_S_2_RANGE______0_CM 1 100. 0. 1. DISPLAY_IDENTIFIER LV_INH_DIAG_EBOX_CFA ECU_ADDRESS 0x3fe405 /end MEASUREMENT
/begin CHARACTERISTIC lc_inh_cat_diag_man_deac "Manual deactivation of cat diagnosis inhibition condition" VALUE 0x00f2a _REC_VAL_20_u1 1. _CNV_S_2_RANGE______0_CM 0. 1. DISPLAY_IDENTIFIER LC_INH_CAT_DIAG_MAN_DEAC /end CHARACTERISTIC
/begin MEASUREMENT lv_inh_diagcps "activation condition for Functional check CPS, irreversible" UBYTE _CNV_S_2_RANGE______0_CM 1 100. 0. 1. DISPLAY_IDENTIFIER LV_INH_DIAGCPS ECU_ADDRESS 0x3fdec1 BIT_MASK 0x1 /end MEASUREMENT
/begin MEASUREMENT lv_di_diagcps "activation condition for Functional check CPS, reversible" UBYTE _CNV_S_2_RANGE______0_CM 1 100. 0. 1. DISPLAY_IDENTIFIER LV_DI_DIAGCPS ECU_ADDRESS 0x3fdec2 BIT_MASK 0x1 /end MEASUREMENT
/begin CHARACTERISTIC c_tco_min_diagcps_1 "min. temperature for FC CPS/ Step1 (CL diagnosis)" VALUE 0x00883 _REC_VAL_20_u1 190.5 _CNV_A_R_LINEAR_____12_CM -48. 142.5 DISPLAY_IDENTIFIER C_TCO_MIN_DIAGCPS_1 FORMAT "%5.1" /end CHARACTERISTIC
/begin MEASUREMENT flow_sp_cp_diagcps "Flow setpoint through the CPS during Functional check CPS" UWORD _CNV_A_R_LINEAR_____111_CM 1 100. 0. 7.99987793 DISPLAY_IDENTIFIER FLOW_SP_CP_DIAGCPS ECU_ADDRESS 0x3fcee0 BYTE_ORDER MSB_LAST FORMAT "%7.4" /end MEASUREMENT
/begin MEASUREMENT state_diagcps "State - Functional check CPS" UBYTE _CNV_S_6_STATE_DIAG_187_CM 1 100. 0. 5. DISPLAY_IDENTIFIER STATE_DIAGCPS ECU_ADDRESS 0x3fdec3 /end MEASUREMENT
/begin MEASUREMENT lv_act_diagcps "Indication for Functional check cps (step 2 or 3) being activated" UBYTE _CNV_S_2_RANGE______0_CM 1 100. 0. 1. DISPLAY_IDENTIFIER LV_ACT_DIAGCPS ECU_ADDRESS 0x3fdecf BIT_MASK 0x1 /end MEASUREMENT
/begin MEASUREMENT lv_maf_diagcps_0 "Auxiliary bit for step 3 - Functional check CPS" UBYTE _CNV_S_2_RANGE______0_CM 1 100. 0. 1. DISPLAY_IDENTIFIER LV_MAF_DIAGCPS_0 ECU_ADDRESS 0x3fdecd BIT_MASK 0x1 /end MEASUREMENT
/begin MEASUREMENT lv_maf_diagcps_1 "Auxiliary bit for step 3 - Functional check CPS" UBYTE _CNV_S_2_RANGE______0_CM 1 100. 0. 1. DISPLAY_IDENTIFIER LV_MAF_DIAGCPS_1 ECU_ADDRESS 0x3fdece BIT_MASK 0x1 /end MEASUREMENT
/begin MEASUREMENT lv_n_dif_diagcps "Auxiliary bit for step 2 - Functional check CPS" UBYTE _CNV_S_2_RANGE______0_CM 1 100. 0. 1. DISPLAY_IDENTIFIER LV_N_DIF_DIAGCPS ECU_ADDRESS 0x3fded0 BIT_MASK 0x1 /end MEASUREMENT
/begin MEASUREMENT lv_supp_accin_diagcps "Bit to suppress the air conditioning compressor request signal - Functional check CPS" UBYTE _CNV_S_2_RANGE______0_CM 1 100. 0. 1. DISPLAY_IDENTIFIER LV_SUPP_ACCIN_DIAGCPS ECU_ADDRESS 0x3fded1 BIT_MASK 0x1 /end MEASUREMENT
/begin MEASUREMENT maf_diagcps "MAF value on start of step 3 - Functional check CPS" UWORD _CNV_A_R_LINEAR_____106_CM 1 100. 0. 1389. DISPLAY_IDENTIFIER MAF_DIAGCPS ECU_ADDRESS 0x3fceec BYTE_ORDER MSB_LAST FORMAT "%7.2" /end MEASUREMENT
/begin MEASUREMENT n_diagcps "N value on starting the time C_T_DIAGCPS_N_2" UWORD _CNV_A_R_LINEAR_____11_CM 1 100. 0. 8160. DISPLAY_IDENTIFIER N_DIAGCPS ECU_ADDRESS 0x3fceee BYTE_ORDER MSB_LAST FORMAT "%4.0" /end MEASUREMENT
/begin MEASUREMENT sum_flow_sp_diagcps_eol "Number of step 2 loops which have been passed if EOL-Test is active - fuctional check CPS" UBYTE _CNV_A_R_LINEAR_____188_CM 1 100. 0. 255. DISPLAY_IDENTIFIER SUM_FLOW_SP_DIAGCPS_EOL ECU_ADDRESS 0x3fdec4 FORMAT "%3.0" /end MEASUREMENT
/begin MEASUREMENT sum_flow_sp_diagcps "Number of step 2 loops which have been passed - Functional check CPS" UBYTE _CNV_A_R_LINEAR_____188_CM 1 100. 0. 255. DISPLAY_IDENTIFIER SUM_FLOW_SP_DIAGCPS ECU_ADDRESS 0x3fdec5 FORMAT "%3.0" /end MEASUREMENT
/begin MEASUREMENT sum_diag_diagcps_eol "Number of diagnoses if EOL-Test is active - Functional check CPS" UBYTE _CNV_A_R_LINEAR_____188_CM 1 100. 0. 255. DISPLAY_IDENTIFIER SUM_DIAG_DIAGCPS_EOL ECU_ADDRESS 0x3fdec6 FORMAT "%3.0" /end MEASUREMENT
/begin MEASUREMENT sum_diag_diagcps "Number of diagnoses - Functional check CPS" UBYTE _CNV_A_R_LINEAR_____188_CM 1 100. 0. 255. DISPLAY_IDENTIFIER SUM_DIAG_DIAGCPS ECU_ADDRESS 0x3fdec7 FORMAT "%3.0" /end MEASUREMENT
/begin MEASUREMENT t_diagcps_dly "Delay time - Functional check CPS" UBYTE _CNV_A_R_LINEAR_____24_CM 1 100. 0.1 25.5 DISPLAY_IDENTIFIER T_DIAGCPS_DLY ECU_ADDRESS 0x3fdec8 FORMAT "%4.1" /end MEASUREMENT
/begin MEASUREMENT t_diagcps_maf "Time for active FLOW_SP offset - Functional check CPS" UBYTE _CNV_A_R_LINEAR_____24_CM 1 100. 0.1 25.5 DISPLAY_IDENTIFIER T_DIAGCPS_MAF ECU_ADDRESS 0x3fded4 FORMAT "%4.1" /end MEASUREMENT
/begin MEASUREMENT t_diagcps_n_1 "1st time interval for N-DIF-Diagnosis - Functional check CPS" UBYTE _CNV_A_R_LINEAR_____24_CM 1 100. 0.1 25.5 DISPLAY_IDENTIFIER T_DIAGCPS_N_1 ECU_ADDRESS 0x3fdec9 FORMAT "%4.1" /end MEASUREMENT
/begin MEASUREMENT t_diagcps_n_2 "2nd time interval for N-DIF-Diagnosis - Functional check CPS" UBYTE _CNV_A_R_LINEAR_____24_CM 1 100. 0.1 25.5 DISPLAY_IDENTIFIER T_DIAGCPS_N_2 ECU_ADDRESS 0x3fdeca FORMAT "%4.1" /end MEASUREMENT
/begin MEASUREMENT t_diagcps_n_3 "3rd time interval for N-DIF-Diagnosis - Functional check CPS" UBYTE _CNV_A_R_LINEAR_____24_CM 1 100. 0.1 25.5 DISPLAY_IDENTIFIER T_DIAGCPS_N_3 ECU_ADDRESS 0x3fdecb FORMAT "%4.1" /end MEASUREMENT
/begin MEASUREMENT isapwm_mmv_diagcps "Moving mean value of ISAPWM (RAM cell) - Functional check CPS" UWORD _CNV_A_R_LINEAR_____9_CM 1 100. 0. 99.99847412 DISPLAY_IDENTIFIER ISAPWM_MMV_DIAGCPS ECU_ADDRESS 0x3fcee4 BYTE_ORDER MSB_LAST /end MEASUREMENT
/begin MEASUREMENT lv_isapwm_dyw_diagcps "Indication for limited dynamic condition - Functional check CPS" UBYTE _CNV_S_2_RANGE______0_CM 1 100. 0. 1. DISPLAY_IDENTIFIER LV_ISAPWM_DYW_DIAGCPS ECU_ADDRESS 0x3fded2 BIT_MASK 0x1 /end MEASUREMENT
/begin CHARACTERISTIC c_cl_mmv_diagcps "Moving mean value of canister load for Functional check CPS" VALUE 0x014b2 _REC_VAL_20_u2 1.99996948 _CNV_A_R_LINEAR_____21_CM 0. 1.99996948 DISPLAY_IDENTIFIER C_CL_MMV_DIAGCPS FORMAT "%7.5" /end CHARACTERISTIC
/begin CHARACTERISTIC c_flow_sp_diagcps_maf "Flow setpoint offset in step 3 - Functional check CPS " VALUE 0x015c2 _REC_VAL_20_u2 7.99987793 _CNV_A_R_LINEAR_____111_CM 0. 7.99987793 DISPLAY_IDENTIFIER C_FLOW_SP_DIAGCPS_MAF FORMAT "%7.4" /end CHARACTERISTIC
/begin CHARACTERISTIC c_flow_sp_diagcps_n "Flow setpoint offset in step 2 - Functional check CPS " VALUE 0x015c4 _REC_VAL_20_u2 7.99987793 _CNV_A_R_LINEAR_____111_CM 0. 7.99987793 DISPLAY_IDENTIFIER C_FLOW_SP_DIAGCPS_N FORMAT "%7.4" /end CHARACTERISTIC
/begin CHARACTERISTIC c_lgrd_flow_sp_neg_diagcps "Limitation gradient for closing the CPS- funtional check CPS" VALUE 0x0161e _REC_VAL_20_u2 7.99987793 _CNV_A_R_LINEAR_____189_CM 0. 7.99987793 DISPLAY_IDENTIFIER C_LGRD_FLOW_SP_NEG_DIAGCPS FORMAT "%7.4" /end CHARACTERISTIC
/begin CHARACTERISTIC c_lgrd_flow_sp_pos_diagcps "Limitation gradient for opening the CPS- funtional check CPS" VALUE 0x01620 _REC_VAL_20_u2 7.99987793 _CNV_A_R_LINEAR_____189_CM 0. 7.99987793 DISPLAY_IDENTIFIER C_LGRD_FLOW_SP_POS_DIAGCPS FORMAT "%7.4" /end CHARACTERISTIC
/begin CHARACTERISTIC c_maf_diagcps "Delta MAF for MAF decrease - Functional check CPS" VALUE 0x01646 _REC_VAL_20_u2 1389. _CNV_A_R_LINEAR_____106_CM 0. 1389. DISPLAY_IDENTIFIER C_MAF_DIAGCPS FORMAT "%7.2" /end CHARACTERISTIC
/begin CHARACTERISTIC c_n_diagcps "Threshold for engine speed increase in step 2 - Functional check CPS" VALUE 0x016da _REC_VAL_20_u2 8159. _CNV_A_R_LINEAR_____11_CM 1. 8160. DISPLAY_IDENTIFIER C_N_DIAGCPS FORMAT "%4.0" /end CHARACTERISTIC
/begin CHARACTERISTIC c_n_dif_diagcps "Condition for IS engine speed difference - Functional check CPS" VALUE 0x016de _REC_VAL_20_u2 8159. _CNV_A_R_LINEAR_____11_CM 1. 8160. DISPLAY_IDENTIFIER C_N_DIF_DIAGCPS FORMAT "%4.0" /end CHARACTERISTIC
/begin CHARACTERISTIC c_sum_flow_sp_diagcps_max "Max. number of step 2 loops which have been passed - Functional check CPS" VALUE 0x007cd _REC_VAL_20_u1 255. _CNV_A_R_LINEAR_____188_CM 0. 255. DISPLAY_IDENTIFIER C_SUM_FLOW_SP_DIAGCPS_MAX FORMAT "%3.0" /end CHARACTERISTIC
/begin CHARACTERISTIC c_sum_diagcps_max "Counter limit of C_SUM_DIAGCPS - funtional check CPS" VALUE 0x007c8 _REC_VAL_20_u1 255. _CNV_A_R_LINEAR_____188_CM 0. 255. DISPLAY_IDENTIFIER C_SUM_DIAGCPS_MAX FORMAT "%3.0" /end CHARACTERISTIC
/begin CHARACTERISTIC c_t_diagcps_maf "Time for active FLOW_SP offset C_FLOW_SP_DIAGCPS_MAF - Functional check CPS" VALUE 0x007ea _REC_VAL_20_u1 25.4 _CNV_A_R_LINEAR_____24_CM 0.1 25.5 DISPLAY_IDENTIFIER C_T_DIAGCPS_MAF FORMAT "%4.1" /end CHARACTERISTIC
/begin CHARACTERISTIC c_t_diagcps_n_1 "Time interval after expiry of which the cycle of step 2 is repeated - Functional check CPS" VALUE 0x007eb _REC_VAL_20_u1 25.4 _CNV_A_R_LINEAR_____24_CM 0.1 25.5 DISPLAY_IDENTIFIER C_T_DIAGCPS_N_1 FORMAT "%4.1" /end CHARACTERISTIC
/begin CHARACTERISTIC c_t_diagcps_n_2 "Time as from setting C_FLOW_SP_DIAGCPS_N - Functional check CPS" VALUE 0x007ec _REC_VAL_20_u1 25.4 _CNV_A_R_LINEAR_____24_CM 0.1 25.5 DISPLAY_IDENTIFIER C_T_DIAGCPS_N_2 FORMAT "%4.1" /end CHARACTERISTIC
/begin CHARACTERISTIC c_t_diagcps_n_3 "Time for increasing FLOW_SP - Functional check CPS" VALUE 0x007ed _REC_VAL_20_u1 25.4 _CNV_A_R_LINEAR_____24_CM 0.1 25.5 DISPLAY_IDENTIFIER C_T_DIAGCPS_N_3 FORMAT "%4.1" /end CHARACTERISTIC
/begin CHARACTERISTIC c_t_diagcps_dly "Delay time - Functional check CPS" VALUE 0x007e9 _REC_VAL_20_u1 25.4 _CNV_A_R_LINEAR_____24_CM 0.1 25.5 DISPLAY_IDENTIFIER C_T_DIAGCPS_DLY FORMAT "%3.1" /end CHARACTERISTIC
/begin CHARACTERISTIC c_crlc_isapwm_diagcps "Correlation constant for calculation of ISAPWM_MMV_DIAGCPS" VALUE 0x014d4 _REC_VAL_20_u2 1. _CNV_A_R_LINEAR_____190_CM 0. 1. DISPLAY_IDENTIFIER C_CRLC_ISAPWM_DIAGCPS FORMAT "%7.5" /end CHARACTERISTIC
/begin CHARACTERISTIC c_isapwm_dyw_diagcps "Dynamic window around ISAPWM_MMV_DIAGCPS" VALUE 0x015e2 _REC_VAL_20_u2 99.99847412 _CNV_A_R_LINEAR_____9_CM 0. 99.99847412 DISPLAY_IDENTIFIER C_ISAPWM_DYW_DIAGCPS FORMAT "%5.2" /end CHARACTERISTIC
/begin CHARACTERISTIC c_maf_max_diagcps "MAF condition functional check CPS" VALUE 0x016a6 _REC_VAL_20_u2 1389. _CNV_A_R_LINEAR_____106_CM 0. 1389. DISPLAY_IDENTIFIER C_MAF_MAX_DIAGCPS FORMAT "%7.2" /end CHARACTERISTIC
/begin MEASUREMENT flow_sp_cps_old "Last EVAP calculated flow set point through the CPS before start of FC CPS" UWORD _CNV_A_R_LINEAR_____111_CM 1 100. 0. 7.99987793 DISPLAY_IDENTIFIER FLOW_SP_CPS_OLD ECU_ADDRESS 0x3fcee2 BYTE_ORDER MSB_LAST FORMAT "%7.4" /end MEASUREMENT
/begin MEASUREMENT sum_diag_diagcps_sae "Output mode06h -  Step 2" UBYTE _CNV_A_R_LINEAR_____188_CM 1 100. 0. 255. DISPLAY_IDENTIFIER SUM_DIAG_DIAGCPS_SAE ECU_ADDRESS 0x3fdecc FORMAT "%3.0" /end MEASUREMENT
/begin MEASUREMENT maf_diagcps_sae "Output mode06h - Step 3" UWORD _CNV_A_R_LINEAR_____106_CM 1 100. 0. 1389. DISPLAY_IDENTIFIER MAF_DIAGCPS_SAE ECU_ADDRESS 0x3fcee8 BYTE_ORDER MSB_LAST FORMAT "%4.0" /end MEASUREMENT
/begin MEASUREMENT maf_diagcps_thd_sae "Output mode06h - Step 3" UWORD _CNV_A_R_LINEAR_____106_CM 1 100. 0. 1389. DISPLAY_IDENTIFIER MAF_DIAGCPS_THD_SAE ECU_ADDRESS 0x3fceea BYTE_ORDER MSB_LAST FORMAT "%4.0" /end MEASUREMENT
/begin MEASUREMENT cl_mmv_sae "Output mode06h -  Step 1" UWORD _CNV_A_R_LINEAR_____21_CM 1 100. 0. 1.99996948 DISPLAY_IDENTIFIER CL_MMV_SAE ECU_ADDRESS 0x3fcee6 BYTE_ORDER MSB_LAST FORMAT "%7.5" /end MEASUREMENT
/begin CHARACTERISTIC c_tco_min_diagcps "min. temperature for Functional check CPS" VALUE 0x00882 _REC_VAL_20_u1 190.5 _CNV_A_R_LINEAR_____12_CM -48. 142.5 DISPLAY_IDENTIFIER C_TCO_MIN_DIAGCPS FORMAT "%5.1" /end CHARACTERISTIC
/begin CHARACTERISTIC c_sum_flow_sp_diagcps_eol "EOL-test: max. number of step 2 loops which have been passed - functional check CPS" VALUE 0x007cc _REC_VAL_20_u1 255. _CNV_A_R_LINEAR_____188_CM 0. 255. DISPLAY_IDENTIFIER C_SUM_FLOW_SP_DIAGCPS_EOL FORMAT "%3.0" /end CHARACTERISTIC
/begin CHARACTERISTIC c_sum_diagcps_eol "EOL-test: Counter limit of SUM_DIAGCPS_EOL - functional check CPS" VALUE 0x007c7 _REC_VAL_20_u1 255. _CNV_A_R_LINEAR_____188_CM 0. 255. DISPLAY_IDENTIFIER C_SUM_DIAGCPS_EOL FORMAT "%3.0" /end CHARACTERISTIC
/begin MEASUREMENT lv_eol_cps_err "LV indicating error of functional check CPS (step 2) after EOL - test" UBYTE _CNV_S_2_RANGE______0_CM 1 100. 0. 1. DISPLAY_IDENTIFIER LV_EOL_CPS_ERR ECU_ADDRESS 0x3fded3 /end MEASUREMENT
/begin MEASUREMENT lv_err_diagcps "Indication for faulty functions - functioanl check CPS" UBYTE _CNV_S_2_RANGE______2_R_CM 1 100. 0. 255. DISPLAY_IDENTIFIER LV_ERR_DIAGCPS ECU_ADDRESS 0x3fbaa0 /end MEASUREMENT
/begin CHARACTERISTIC id_clas_b_fmt "" MAP 0x03c9c _REC_MAP_20_u1_u2_u2 255. _CNV_A_R_LINEAR_____1_CM 0. 255. DISPLAY_IDENTIFIER ID_CLAS_B_FMT FORMAT "%3.0"
 /begin AXIS_DESCR COM_AXIS online_dummy _CNV_A_R_LINEAR_____1_CM 16 0. 65535. FORMAT "%5.0" AXIS_PTS_REF ldpm_clas_a_id_clas_fmy /end AXIS_DESCR
 /begin AXIS_DESCR COM_AXIS online_dummy _CNV_A_R_LINEAR_____1_CM 4 0. 65535. FORMAT "%5.0" AXIS_PTS_REF ldp_clas_b_id_clas_fmy /end AXIS_DESCR
/end CHARACTERISTIC
/begin CHARACTERISTIC id_clas_a_fmt "" CURVE 0x03c8c _REC_CUR_20_u1_u2 255. _CNV_A_R_LINEAR_____1_CM 0. 255. DISPLAY_IDENTIFIER ID_CLAS_A_FMT FORMAT "%3.0"
 /begin AXIS_DESCR COM_AXIS online_dummy _CNV_A_R_LINEAR_____1_CM 16 0. 65535. FORMAT "%5.0" AXIS_PTS_REF ldpm_clas_a_id_clas_fmy /end AXIS_DESCR
/end CHARACTERISTIC
/begin CHARACTERISTIC fmy_id_toil.c_err_clas "" VALUE 0x01bda _REC_VAL_20_u1 255. _CNV_A_R_LINEAR_____1_CM 0. 255. DISPLAY_IDENTIFIER C_ERR_CLAS_TOIL FORMAT "%3.0" /end CHARACTERISTIC
/begin CHARACTERISTIC fmy_id_tco_ex.c_err_clas "" VALUE 0x01bec _REC_VAL_20_u1 255. _CNV_A_R_LINEAR_____1_CM 0. 255. DISPLAY_IDENTIFIER C_ERR_CLAS_TCO_EX FORMAT "%3.0" /end CHARACTERISTIC
/begin CHARACTERISTIC fmy_id_tia.c_err_clas "" VALUE 0x01bfe _REC_VAL_20_u1 255. _CNV_A_R_LINEAR_____1_CM 0. 255. DISPLAY_IDENTIFIER C_ERR_CLAS_TIA FORMAT "%3.0" /end CHARACTERISTIC
/begin CHARACTERISTIC fmy_id_amp.c_err_clas "" VALUE 0x01c10 _REC_VAL_20_u1 255. _CNV_A_R_LINEAR_____1_CM 0. 255. DISPLAY_IDENTIFIER C_ERR_CLAS_AMP FORMAT "%3.0" /end CHARACTERISTIC
/begin CHARACTERISTIC fmy_id_maf.c_err_clas "" VALUE 0x01c22 _REC_VAL_20_u1 255. _CNV_A_R_LINEAR_____1_CM 0. 255. DISPLAY_IDENTIFIER C_ERR_CLAS_MAF FORMAT "%3.0" /end CHARACTERISTIC
/begin CHARACTERISTIC fmy_id_vls_down_max_1.c_err_clas "" VALUE 0x01c34 _REC_VAL_20_u1 255. _CNV_A_R_LINEAR_____1_CM 0. 255. DISPLAY_IDENTIFIER C_ERR_CLAS_VLS_DOWN_MAX_1 FORMAT "%3.0" /end CHARACTERISTIC
/begin CHARACTERISTIC fmy_id_vls_down_max_2.c_err_clas "" VALUE 0x01c46 _REC_VAL_20_u1 255. _CNV_A_R_LINEAR_____1_CM 0. 255. DISPLAY_IDENTIFIER C_ERR_CLAS_VLS_DOWN_MAX_2 FORMAT "%3.0" /end CHARACTERISTIC
/begin CHARACTERISTIC fmy_id_vls_down_min_cold_1.c_err_clas "" VALUE 0x01c58 _REC_VAL_20_u1 255. _CNV_A_R_LINEAR_____1_CM 0. 255. DISPLAY_IDENTIFIER C_ERR_CLAS_VLS_DOWN_MIN_COLD_1 FORMAT "%3.0" /end CHARACTERISTIC
/begin CHARACTERISTIC fmy_id_vls_down_min_cold_2.c_err_clas "" VALUE 0x01c6a _REC_VAL_20_u1 255. _CNV_A_R_LINEAR_____1_CM 0. 255. DISPLAY_IDENTIFIER C_ERR_CLAS_VLS_DOWN_MIN_COLD_2 FORMAT "%3.0" /end CHARACTERISTIC
/begin CHARACTERISTIC fmy_id_vls_down_min_1.c_err_clas "" VALUE 0x01c7c _REC_VAL_20_u1 255. _CNV_A_R_LINEAR_____1_CM 0. 255. DISPLAY_IDENTIFIER C_ERR_CLAS_VLS_DOWN_MIN_1 FORMAT "%3.0" /end CHARACTERISTIC
/begin CHARACTERISTIC fmy_id_vls_down_min_2.c_err_clas "" VALUE 0x01c8e _REC_VAL_20_u1 255. _CNV_A_R_LINEAR_____1_CM 0. 255. DISPLAY_IDENTIFIER C_ERR_CLAS_VLS_DOWN_MIN_2 FORMAT "%3.0" /end CHARACTERISTIC
/begin CHARACTERISTIC fmy_id_vls_down_oc_1.c_err_clas "" VALUE 0x01ca0 _REC_VAL_20_u1 255. _CNV_A_R_LINEAR_____1_CM 0. 255. DISPLAY_IDENTIFIER C_ERR_CLAS_VLS_DOWN_OC_1 FORMAT "%3.0" /end CHARACTERISTIC
/begin CHARACTERISTIC fmy_id_vls_down_oc_2.c_err_clas "" VALUE 0x01cb2 _REC_VAL_20_u1 255. _CNV_A_R_LINEAR_____1_CM 0. 255. DISPLAY_IDENTIFIER C_ERR_CLAS_VLS_DOWN_OC_2 FORMAT "%3.0" /end CHARACTERISTIC
/begin CHARACTERISTIC fmy_id_iv_0.c_err_clas "" VALUE 0x01cc4 _REC_VAL_20_u1 255. _CNV_A_R_LINEAR_____1_CM 0. 255. DISPLAY_IDENTIFIER C_ERR_CLAS_IV_0 FORMAT "%3.0" /end CHARACTERISTIC
/begin CHARACTERISTIC fmy_id_iv_1.c_err_clas "" VALUE 0x01cd6 _REC_VAL_20_u1 255. _CNV_A_R_LINEAR_____1_CM 0. 255. DISPLAY_IDENTIFIER C_ERR_CLAS_IV_1 FORMAT "%3.0" /end CHARACTERISTIC
/begin CHARACTERISTIC fmy_id_iv_2.c_err_clas "" VALUE 0x01ce8 _REC_VAL_20_u1 255. _CNV_A_R_LINEAR_____1_CM 0. 255. DISPLAY_IDENTIFIER C_ERR_CLAS_IV_2 FORMAT "%3.0" /end CHARACTERISTIC
/begin CHARACTERISTIC fmy_id_iv_3.c_err_clas "" VALUE 0x01cfa _REC_VAL_20_u1 255. _CNV_A_R_LINEAR_____1_CM 0. 255. DISPLAY_IDENTIFIER C_ERR_CLAS_IV_3 FORMAT "%3.0" /end CHARACTERISTIC
/begin CHARACTERISTIC fmy_id_iv_4.c_err_clas "" VALUE 0x01d0c _REC_VAL_20_u1 255. _CNV_A_R_LINEAR_____1_CM 0. 255. DISPLAY_IDENTIFIER C_ERR_CLAS_IV_4 FORMAT "%3.0" /end CHARACTERISTIC
/begin CHARACTERISTIC fmy_id_iv_5.c_err_clas "" VALUE 0x01d1e _REC_VAL_20_u1 255. _CNV_A_R_LINEAR_____1_CM 0. 255. DISPLAY_IDENTIFIER C_ERR_CLAS_IV_5 FORMAT "%3.0" /end CHARACTERISTIC
/begin CHARACTERISTIC fmy_id_lsh_up_1.c_err_clas "" VALUE 0x01d30 _REC_VAL_20_u1 255. _CNV_A_R_LINEAR_____1_CM 0. 255. DISPLAY_IDENTIFIER C_ERR_CLAS_LSH_UP_1 FORMAT "%3.0" /end CHARACTERISTIC
/begin CHARACTERISTIC fmy_id_lsh_up_2.c_err_clas "" VALUE 0x01d42 _REC_VAL_20_u1 255. _CNV_A_R_LINEAR_____1_CM 0. 255. DISPLAY_IDENTIFIER C_ERR_CLAS_LSH_UP_2 FORMAT "%3.0" /end CHARACTERISTIC
/begin CHARACTERISTIC fmy_id_lsh_down_1.c_err_clas "" VALUE 0x01d54 _REC_VAL_20_u1 255. _CNV_A_R_LINEAR_____1_CM 0. 255. DISPLAY_IDENTIFIER C_ERR_CLAS_LSH_DOWN_1 FORMAT "%3.0" /end CHARACTERISTIC
/begin CHARACTERISTIC fmy_id_lsh_down_2.c_err_clas "" VALUE 0x01d66 _REC_VAL_20_u1 255. _CNV_A_R_LINEAR_____1_CM 0. 255. DISPLAY_IDENTIFIER C_ERR_CLAS_LSH_DOWN_2 FORMAT "%3.0" /end CHARACTERISTIC
/begin CHARACTERISTIC fmy_id_rly_efp.c_err_clas "" VALUE 0x01d78 _REC_VAL_20_u1 255. _CNV_A_R_LINEAR_____1_CM 0. 255. DISPLAY_IDENTIFIER C_ERR_CLAS_RLY_EFP FORMAT "%3.0" /end CHARACTERISTIC
/begin CHARACTERISTIC fmy_id_cps.c_err_clas "" VALUE 0x01d8a _REC_VAL_20_u1 255. _CNV_A_R_LINEAR_____1_CM 0. 255. DISPLAY_IDENTIFIER C_ERR_CLAS_CPS FORMAT "%3.0" /end CHARACTERISTIC
/begin CHARACTERISTIC fmy_id_mec_ivvt_in_1.c_err_clas "" VALUE 0x01d9c _REC_VAL_20_u1 255. _CNV_A_R_LINEAR_____1_CM 0. 255. DISPLAY_IDENTIFIER C_ERR_CLAS_MEC_IVVT_IN_1 FORMAT "%3.0" /end CHARACTERISTIC
/begin CHARACTERISTIC fmy_id_mec_ivvt_ex_1.c_err_clas "" VALUE 0x01dae _REC_VAL_20_u1 255. _CNV_A_R_LINEAR_____1_CM 0. 255. DISPLAY_IDENTIFIER C_ERR_CLAS_MEC_IVVT_EX_1 FORMAT "%3.0" /end CHARACTERISTIC
/begin CHARACTERISTIC fmy_id_ref_ivvt_in_1.c_err_clas "" VALUE 0x01dc0 _REC_VAL_20_u1 255. _CNV_A_R_LINEAR_____1_CM 0. 255. DISPLAY_IDENTIFIER C_ERR_CLAS_REF_IVVT_IN_1 FORMAT "%3.0" /end CHARACTERISTIC
/begin CHARACTERISTIC fmy_id_ref_ivvt_ex_1.c_err_clas "" VALUE 0x01dd2 _REC_VAL_20_u1 255. _CNV_A_R_LINEAR_____1_CM 0. 255. DISPLAY_IDENTIFIER C_ERR_CLAS_REF_IVVT_EX_1 FORMAT "%3.0" /end CHARACTERISTIC
/begin CHARACTERISTIC fmy_id_slv_ivvt_in_1.c_err_clas "" VALUE 0x01de4 _REC_VAL_20_u1 255. _CNV_A_R_LINEAR_____1_CM 0. 255. DISPLAY_IDENTIFIER C_ERR_CLAS_SLV_IVVT_IN_1 FORMAT "%3.0" /end CHARACTERISTIC
/begin CHARACTERISTIC fmy_id_slv_ivvt_ex_1.c_err_clas "" VALUE 0x01df6 _REC_VAL_20_u1 255. _CNV_A_R_LINEAR_____1_CM 0. 255. DISPLAY_IDENTIFIER C_ERR_CLAS_SLV_IVVT_EX_1 FORMAT "%3.0" /end CHARACTERISTIC
/begin CHARACTERISTIC fmy_id_park_ivvt_in_1.c_err_clas "" VALUE 0x01e08 _REC_VAL_20_u1 255. _CNV_A_R_LINEAR_____1_CM 0. 255. DISPLAY_IDENTIFIER C_ERR_CLAS_PARK_IVVT_IN_1 FORMAT "%3.0" /end CHARACTERISTIC
/begin CHARACTERISTIC fmy_id_park_ivvt_ex_1.c_err_clas "" VALUE 0x01e1a _REC_VAL_20_u1 255. _CNV_A_R_LINEAR_____1_CM 0. 255. DISPLAY_IDENTIFIER C_ERR_CLAS_PARK_IVVT_EX_1 FORMAT "%3.0" /end CHARACTERISTIC
/begin CHARACTERISTIC fmy_id_ecu_cks.c_err_clas "" VALUE 0x01e2c _REC_VAL_20_u1 255. _CNV_A_R_LINEAR_____1_CM 0. 255. DISPLAY_IDENTIFIER C_ERR_CLAS_ECU_CKS FORMAT "%3.0" /end CHARACTERISTIC
/begin CHARACTERISTIC fmy_id_toil_level.c_err_clas "" VALUE 0x01e3e _REC_VAL_20_u1 255. _CNV_A_R_LINEAR_____1_CM 0. 255. DISPLAY_IDENTIFIER C_ERR_CLAS_TOIL_LEVEL FORMAT "%3.0" /end CHARACTERISTIC
/begin CHARACTERISTIC fmy_id_tout_etcu_1.c_err_clas "" VALUE 0x01e50 _REC_VAL_20_u1 255. _CNV_A_R_LINEAR_____1_CM 0. 255. DISPLAY_IDENTIFIER C_ERR_CLAS_TOUT_ETCU_1 FORMAT "%3.0" /end CHARACTERISTIC
/begin CHARACTERISTIC fmy_id_tout_etcu_2.c_err_clas "" VALUE 0x01e62 _REC_VAL_20_u1 255. _CNV_A_R_LINEAR_____1_CM 0. 255. DISPLAY_IDENTIFIER C_ERR_CLAS_TOUT_ETCU_2 FORMAT "%3.0" /end CHARACTERISTIC
/begin CHARACTERISTIC fmy_id_tout_icl_2.c_err_clas "" VALUE 0x01e74 _REC_VAL_20_u1 255. _CNV_A_R_LINEAR_____1_CM 0. 255. DISPLAY_IDENTIFIER C_ERR_CLAS_TOUT_ICL_2 FORMAT "%3.0" /end CHARACTERISTIC
/begin CHARACTERISTIC fmy_id_tout_icl_3.c_err_clas "" VALUE 0x01e86 _REC_VAL_20_u1 255. _CNV_A_R_LINEAR_____1_CM 0. 255. DISPLAY_IDENTIFIER C_ERR_CLAS_TOUT_ICL_3 FORMAT "%3.0" /end CHARACTERISTIC
/begin CHARACTERISTIC fmy_id_tout_asr_1.c_err_clas "" VALUE 0x01e98 _REC_VAL_20_u1 255. _CNV_A_R_LINEAR_____1_CM 0. 255. DISPLAY_IDENTIFIER C_ERR_CLAS_TOUT_ASR_1 FORMAT "%3.0" /end CHARACTERISTIC
/begin CHARACTERISTIC fmy_id_tout_asr_3.c_err_clas "" VALUE 0x01eaa _REC_VAL_20_u1 255. _CNV_A_R_LINEAR_____1_CM 0. 255. DISPLAY_IDENTIFIER C_ERR_CLAS_TOUT_ASR_3 FORMAT "%3.0" /end CHARACTERISTIC
/begin CHARACTERISTIC fmy_id_tout_asr_4.c_err_clas "" VALUE 0x01ebc _REC_VAL_20_u1 255. _CNV_A_R_LINEAR_____1_CM 0. 255. DISPLAY_IDENTIFIER C_ERR_CLAS_TOUT_ASR_4 FORMAT "%3.0" /end CHARACTERISTIC
/begin CHARACTERISTIC fmy_id_tout_pste_1.c_err_clas "" VALUE 0x01ece _REC_VAL_20_u1 255. _CNV_A_R_LINEAR_____1_CM 0. 255. DISPLAY_IDENTIFIER C_ERR_CLAS_TOUT_PSTE_1 FORMAT "%3.0" /end CHARACTERISTIC
/begin CHARACTERISTIC fmy_id_tout_amt_1.c_err_clas "" VALUE 0x01ee0 _REC_VAL_20_u1 255. _CNV_A_R_LINEAR_____1_CM 0. 255. DISPLAY_IDENTIFIER C_ERR_CLAS_TOUT_AMT_1 FORMAT "%3.0" /end CHARACTERISTIC
/begin CHARACTERISTIC fmy_id_vs.c_err_clas "" VALUE 0x01ef2 _REC_VAL_20_u1 255. _CNV_A_R_LINEAR_____1_CM 0. 255. DISPLAY_IDENTIFIER C_ERR_CLAS_VS FORMAT "%3.0" /end CHARACTERISTIC
/begin CHARACTERISTIC fmy_id_knks_1.c_err_clas "" VALUE 0x01f04 _REC_VAL_20_u1 255. _CNV_A_R_LINEAR_____1_CM 0. 255. DISPLAY_IDENTIFIER C_ERR_CLAS_KNKS_1 FORMAT "%3.0" /end CHARACTERISTIC
/begin CHARACTERISTIC fmy_id_knks_2.c_err_clas "" VALUE 0x01f16 _REC_VAL_20_u1 255. _CNV_A_R_LINEAR_____1_CM 0. 255. DISPLAY_IDENTIFIER C_ERR_CLAS_KNKS_2 FORMAT "%3.0" /end CHARACTERISTIC
/begin CHARACTERISTIC fmy_id_td_igc_cut_0.c_err_clas "" VALUE 0x01f28 _REC_VAL_20_u1 255. _CNV_A_R_LINEAR_____1_CM 0. 255. DISPLAY_IDENTIFIER C_ERR_CLAS_TD_IGC_CUT_0 FORMAT "%3.0" /end CHARACTERISTIC
/begin CHARACTERISTIC fmy_id_td_igc_cut_1.c_err_clas "" VALUE 0x01f3a _REC_VAL_20_u1 255. _CNV_A_R_LINEAR_____1_CM 0. 255. DISPLAY_IDENTIFIER C_ERR_CLAS_TD_IGC_CUT_1 FORMAT "%3.0" /end CHARACTERISTIC
/begin CHARACTERISTIC fmy_id_td_igc_cut_2.c_err_clas "" VALUE 0x01f4c _REC_VAL_20_u1 255. _CNV_A_R_LINEAR_____1_CM 0. 255. DISPLAY_IDENTIFIER C_ERR_CLAS_TD_IGC_CUT_2 FORMAT "%3.0" /end CHARACTERISTIC
/begin CHARACTERISTIC fmy_id_td_igc_cut_3.c_err_clas "" VALUE 0x01f5e _REC_VAL_20_u1 255. _CNV_A_R_LINEAR_____1_CM 0. 255. DISPLAY_IDENTIFIER C_ERR_CLAS_TD_IGC_CUT_3 FORMAT "%3.0" /end CHARACTERISTIC
/begin CHARACTERISTIC fmy_id_td_igc_cut_4.c_err_clas "" VALUE 0x01f70 _REC_VAL_20_u1 255. _CNV_A_R_LINEAR_____1_CM 0. 255. DISPLAY_IDENTIFIER C_ERR_CLAS_TD_IGC_CUT_4 FORMAT "%3.0" /end CHARACTERISTIC
/begin CHARACTERISTIC fmy_id_td_igc_cut_5.c_err_clas "" VALUE 0x01f82 _REC_VAL_20_u1 255. _CNV_A_R_LINEAR_____1_CM 0. 255. DISPLAY_IDENTIFIER C_ERR_CLAS_TD_IGC_CUT_5 FORMAT "%3.0" /end CHARACTERISTIC
/begin CHARACTERISTIC fmy_id_dur_igc_0.c_err_clas "" VALUE 0x01f94 _REC_VAL_20_u1 255. _CNV_A_R_LINEAR_____1_CM 0. 255. DISPLAY_IDENTIFIER C_ERR_CLAS_DUR_IGC_0 FORMAT "%3.0" /end CHARACTERISTIC
/begin CHARACTERISTIC fmy_id_dur_igc_1.c_err_clas "" VALUE 0x01fa6 _REC_VAL_20_u1 255. _CNV_A_R_LINEAR_____1_CM 0. 255. DISPLAY_IDENTIFIER C_ERR_CLAS_DUR_IGC_1 FORMAT "%3.0" /end CHARACTERISTIC
/begin CHARACTERISTIC fmy_id_dur_igc_2.c_err_clas "" VALUE 0x01fb8 _REC_VAL_20_u1 255. _CNV_A_R_LINEAR_____1_CM 0. 255. DISPLAY_IDENTIFIER C_ERR_CLAS_DUR_IGC_2 FORMAT "%3.0" /end CHARACTERISTIC
/begin CHARACTERISTIC fmy_id_dur_igc_3.c_err_clas "" VALUE 0x01fca _REC_VAL_20_u1 255. _CNV_A_R_LINEAR_____1_CM 0. 255. DISPLAY_IDENTIFIER C_ERR_CLAS_DUR_IGC_3 FORMAT "%3.0" /end CHARACTERISTIC
/begin CHARACTERISTIC fmy_id_dur_igc_4.c_err_clas "" VALUE 0x01fdc _REC_VAL_20_u1 255. _CNV_A_R_LINEAR_____1_CM 0. 255. DISPLAY_IDENTIFIER C_ERR_CLAS_DUR_IGC_4 FORMAT "%3.0" /end CHARACTERISTIC
/begin CHARACTERISTIC fmy_id_dur_igc_5.c_err_clas "" VALUE 0x01fee _REC_VAL_20_u1 255. _CNV_A_R_LINEAR_____1_CM 0. 255. DISPLAY_IDENTIFIER C_ERR_CLAS_DUR_IGC_5 FORMAT "%3.0" /end CHARACTERISTIC
/begin CHARACTERISTIC fmy_id_tps_1.c_err_clas "" VALUE 0x02000 _REC_VAL_20_u1 255. _CNV_A_R_LINEAR_____1_CM 0. 255. DISPLAY_IDENTIFIER C_ERR_CLAS_TPS_1 FORMAT "%3.0" /end CHARACTERISTIC
/begin CHARACTERISTIC fmy_id_tps_2.c_err_clas "" VALUE 0x02012 _REC_VAL_20_u1 255. _CNV_A_R_LINEAR_____1_CM 0. 255. DISPLAY_IDENTIFIER C_ERR_CLAS_TPS_2 FORMAT "%3.0" /end CHARACTERISTIC
/begin CHARACTERISTIC fmy_id_tps_maf_1.c_err_clas "" VALUE 0x02024 _REC_VAL_20_u1 255. _CNV_A_R_LINEAR_____1_CM 0. 255. DISPLAY_IDENTIFIER C_ERR_CLAS_TPS_MAF_1 FORMAT "%3.0" /end CHARACTERISTIC
/begin CHARACTERISTIC fmy_id_tps_maf_2.c_err_clas "" VALUE 0x02036 _REC_VAL_20_u1 255. _CNV_A_R_LINEAR_____1_CM 0. 255. DISPLAY_IDENTIFIER C_ERR_CLAS_TPS_MAF_2 FORMAT "%3.0" /end CHARACTERISTIC
/begin CHARACTERISTIC fmy_id_v_ref_1.c_err_clas "" VALUE 0x02048 _REC_VAL_20_u1 255. _CNV_A_R_LINEAR_____1_CM 0. 255. DISPLAY_IDENTIFIER C_ERR_CLAS_V_REF_1 FORMAT "%3.0" /end CHARACTERISTIC
/begin CHARACTERISTIC fmy_id_v_ref_2.c_err_clas "" VALUE 0x0205a _REC_VAL_20_u1 255. _CNV_A_R_LINEAR_____1_CM 0. 255. DISPLAY_IDENTIFIER C_ERR_CLAS_V_REF_2 FORMAT "%3.0" /end CHARACTERISTIC
/begin CHARACTERISTIC fmy_id_pvs_1.c_err_clas "" VALUE 0x0206c _REC_VAL_20_u1 255. _CNV_A_R_LINEAR_____1_CM 0. 255. DISPLAY_IDENTIFIER C_ERR_CLAS_PVS_1 FORMAT "%3.0" /end CHARACTERISTIC
/begin CHARACTERISTIC fmy_id_pvs_2.c_err_clas "" VALUE 0x0207e _REC_VAL_20_u1 255. _CNV_A_R_LINEAR_____1_CM 0. 255. DISPLAY_IDENTIFIER C_ERR_CLAS_PVS_2 FORMAT "%3.0" /end CHARACTERISTIC
/begin CHARACTERISTIC fmy_id_pvs_ratio.c_err_clas "" VALUE 0x02090 _REC_VAL_20_u1 255. _CNV_A_R_LINEAR_____1_CM 0. 255. DISPLAY_IDENTIFIER C_ERR_CLAS_PVS_RATIO FORMAT "%3.0" /end CHARACTERISTIC
/begin CHARACTERISTIC fmy_id_pvs_double.c_err_clas "" VALUE 0x020a2 _REC_VAL_20_u1 255. _CNV_A_R_LINEAR_____1_CM 0. 255. DISPLAY_IDENTIFIER C_ERR_CLAS_PVS_DOUBLE FORMAT "%3.0" /end CHARACTERISTIC
/begin CHARACTERISTIC fmy_id_pvs_bls_not_plaus.c_err_clas "" VALUE 0x020b4 _REC_VAL_20_u1 255. _CNV_A_R_LINEAR_____1_CM 0. 255. DISPLAY_IDENTIFIER C_ERR_CLAS_PVS_BLS_NOT_PLAUS FORMAT "%3.0" /end CHARACTERISTIC
/begin CHARACTERISTIC fmy_id_mtc_dr.c_err_clas "" VALUE 0x020c6 _REC_VAL_20_u1 255. _CNV_A_R_LINEAR_____1_CM 0. 255. DISPLAY_IDENTIFIER C_ERR_CLAS_MTC_DR FORMAT "%3.0" /end CHARACTERISTIC
/begin CHARACTERISTIC fmy_id_mtc_ctl_1.c_err_clas "" VALUE 0x020d8 _REC_VAL_20_u1 255. _CNV_A_R_LINEAR_____1_CM 0. 255. DISPLAY_IDENTIFIER C_ERR_CLAS_MTC_CTL_1 FORMAT "%3.0" /end CHARACTERISTIC
/begin CHARACTERISTIC fmy_id_mtc_ctl_2.c_err_clas "" VALUE 0x020ea _REC_VAL_20_u1 255. _CNV_A_R_LINEAR_____1_CM 0. 255. DISPLAY_IDENTIFIER C_ERR_CLAS_MTC_CTL_2 FORMAT "%3.0" /end CHARACTERISTIC
/begin CHARACTERISTIC fmy_id_mtc_ctl_3.c_err_clas "" VALUE 0x020fc _REC_VAL_20_u1 255. _CNV_A_R_LINEAR_____1_CM 0. 255. DISPLAY_IDENTIFIER C_ERR_CLAS_MTC_CTL_3 FORMAT "%3.0" /end CHARACTERISTIC
/begin CHARACTERISTIC fmy_id_tps_ad.c_err_clas "" VALUE 0x0210e _REC_VAL_20_u1 255. _CNV_A_R_LINEAR_____1_CM 0. 255. DISPLAY_IDENTIFIER C_ERR_CLAS_TPS_AD FORMAT "%3.0" /end CHARACTERISTIC
/begin CHARACTERISTIC fmy_id_tps_ad_bol.c_err_clas "" VALUE 0x02120 _REC_VAL_20_u1 255. _CNV_A_R_LINEAR_____1_CM 0. 255. DISPLAY_IDENTIFIER C_ERR_CLAS_TPS_AD_BOL FORMAT "%3.0" /end CHARACTERISTIC
/begin CHARACTERISTIC fmy_id_tps_st_chk_1.c_err_clas "" VALUE 0x02132 _REC_VAL_20_u1 255. _CNV_A_R_LINEAR_____1_CM 0. 255. DISPLAY_IDENTIFIER C_ERR_CLAS_TPS_ST_CHK_1 FORMAT "%3.0" /end CHARACTERISTIC
/begin CHARACTERISTIC fmy_id_tps_st_chk_2.c_err_clas "" VALUE 0x02144 _REC_VAL_20_u1 255. _CNV_A_R_LINEAR_____1_CM 0. 255. DISPLAY_IDENTIFIER C_ERR_CLAS_TPS_ST_CHK_2 FORMAT "%3.0" /end CHARACTERISTIC
/begin CHARACTERISTIC fmy_id_gen.c_err_clas "" VALUE 0x02156 _REC_VAL_20_u1 255. _CNV_A_R_LINEAR_____1_CM 0. 255. DISPLAY_IDENTIFIER C_ERR_CLAS_GEN FORMAT "%3.0" /end CHARACTERISTIC
/begin CHARACTERISTIC fmy_id_gen_if.c_err_clas "" VALUE 0x02168 _REC_VAL_20_u1 255. _CNV_A_R_LINEAR_____1_CM 0. 255. DISPLAY_IDENTIFIER C_ERR_CLAS_GEN_IF FORMAT "%3.0" /end CHARACTERISTIC
/begin CHARACTERISTIC fmy_id_gen_diag.c_err_clas "" VALUE 0x0217a _REC_VAL_20_u1 255. _CNV_A_R_LINEAR_____1_CM 0. 255. DISPLAY_IDENTIFIER C_ERR_CLAS_GEN_DIAG FORMAT "%3.0" /end CHARACTERISTIC
/begin CHARACTERISTIC fmy_id_vim.c_err_clas "" VALUE 0x0218c _REC_VAL_20_u1 255. _CNV_A_R_LINEAR_____1_CM 0. 255. DISPLAY_IDENTIFIER C_ERR_CLAS_VIM FORMAT "%3.0" /end CHARACTERISTIC
/begin CHARACTERISTIC fmy_id_cam_per_0.c_err_clas "" VALUE 0x0219e _REC_VAL_20_u1 255. _CNV_A_R_LINEAR_____1_CM 0. 255. DISPLAY_IDENTIFIER C_ERR_CLAS_CAM_PER_0 FORMAT "%3.0" /end CHARACTERISTIC
/begin CHARACTERISTIC fmy_id_cam_per_1.c_err_clas "" VALUE 0x021b0 _REC_VAL_20_u1 255. _CNV_A_R_LINEAR_____1_CM 0. 255. DISPLAY_IDENTIFIER C_ERR_CLAS_CAM_PER_1 FORMAT "%3.0" /end CHARACTERISTIC
/begin CHARACTERISTIC fmy_id_cam_psn_0.c_err_clas "" VALUE 0x021c2 _REC_VAL_20_u1 255. _CNV_A_R_LINEAR_____1_CM 0. 255. DISPLAY_IDENTIFIER C_ERR_CLAS_CAM_PSN_0 FORMAT "%3.0" /end CHARACTERISTIC
/begin CHARACTERISTIC fmy_id_cam_psn_1.c_err_clas "" VALUE 0x021d4 _REC_VAL_20_u1 255. _CNV_A_R_LINEAR_____1_CM 0. 255. DISPLAY_IDENTIFIER C_ERR_CLAS_CAM_PSN_1 FORMAT "%3.0" /end CHARACTERISTIC
/begin CHARACTERISTIC fmy_id_cam_0_not_plaus.c_err_clas "" VALUE 0x021e6 _REC_VAL_20_u1 255. _CNV_A_R_LINEAR_____1_CM 0. 255. DISPLAY_IDENTIFIER C_ERR_CLAS_CAM_0_NOT_PLAUS FORMAT "%3.0" /end CHARACTERISTIC
/begin CHARACTERISTIC fmy_id_cam_1_not_plaus.c_err_clas "" VALUE 0x021f8 _REC_VAL_20_u1 255. _CNV_A_R_LINEAR_____1_CM 0. 255. DISPLAY_IDENTIFIER C_ERR_CLAS_CAM_1_NOT_PLAUS FORMAT "%3.0" /end CHARACTERISTIC
/begin CHARACTERISTIC fmy_id_eng_psn.c_err_clas "" VALUE 0x0220a _REC_VAL_20_u1 255. _CNV_A_R_LINEAR_____1_CM 0. 255. DISPLAY_IDENTIFIER C_ERR_CLAS_ENG_PSN FORMAT "%3.0" /end CHARACTERISTIC
/begin CHARACTERISTIC fmy_id_tooth_per.c_err_clas "" VALUE 0x0221c _REC_VAL_20_u1 255. _CNV_A_R_LINEAR_____1_CM 0. 255. DISPLAY_IDENTIFIER C_ERR_CLAS_TOOTH_PER FORMAT "%3.0" /end CHARACTERISTIC
/begin CHARACTERISTIC fmy_id_tpu_syn.c_err_clas "" VALUE 0x0222e _REC_VAL_20_u1 255. _CNV_A_R_LINEAR_____1_CM 0. 255. DISPLAY_IDENTIFIER C_ERR_CLAS_TPU_SYN FORMAT "%3.0" /end CHARACTERISTIC
/begin CHARACTERISTIC fmy_id_crk_not_plaus.c_err_clas "" VALUE 0x02240 _REC_VAL_20_u1 255. _CNV_A_R_LINEAR_____1_CM 0. 255. DISPLAY_IDENTIFIER C_ERR_CLAS_CRK_NOT_PLAUS FORMAT "%3.0" /end CHARACTERISTIC
/begin CHARACTERISTIC fmy_id_tout_txu_1.c_err_clas "" VALUE 0x02252 _REC_VAL_20_u1 255. _CNV_A_R_LINEAR_____1_CM 0. 255. DISPLAY_IDENTIFIER C_ERR_CLAS_TOUT_TXU_1 FORMAT "%3.0" /end CHARACTERISTIC
/begin CHARACTERISTIC fmy_id_can_boff.c_err_clas "" VALUE 0x02264 _REC_VAL_20_u1 255. _CNV_A_R_LINEAR_____1_CM 0. 255. DISPLAY_IDENTIFIER C_ERR_CLAS_CAN_BOFF FORMAT "%3.0" /end CHARACTERISTIC
/begin CHARACTERISTIC fmy_id_rly_main.c_err_clas "" VALUE 0x02276 _REC_VAL_20_u1 255. _CNV_A_R_LINEAR_____1_CM 0. 255. DISPLAY_IDENTIFIER C_ERR_CLAS_RLY_MAIN FORMAT "%3.0" /end CHARACTERISTIC
/begin CHARACTERISTIC fmy_id_rly_main_dly.c_err_clas "" VALUE 0x02288 _REC_VAL_20_u1 255. _CNV_A_R_LINEAR_____1_CM 0. 255. DISPLAY_IDENTIFIER C_ERR_CLAS_RLY_MAIN_DLY FORMAT "%3.0" /end CHARACTERISTIC
/begin CHARACTERISTIC fmy_id_rly_accout.c_err_clas "" VALUE 0x0229a _REC_VAL_20_u1 255. _CNV_A_R_LINEAR_____1_CM 0. 255. DISPLAY_IDENTIFIER C_ERR_CLAS_RLY_ACCOUT FORMAT "%3.0" /end CHARACTERISTIC
/begin CHARACTERISTIC fmy_id_sap.c_err_clas "" VALUE 0x022ac _REC_VAL_20_u1 255. _CNV_A_R_LINEAR_____1_CM 0. 255. DISPLAY_IDENTIFIER C_ERR_CLAS_SAP FORMAT "%3.0" /end CHARACTERISTIC
/begin CHARACTERISTIC fmy_id_sav.c_err_clas "" VALUE 0x022be _REC_VAL_20_u1 255. _CNV_A_R_LINEAR_____1_CM 0. 255. DISPLAY_IDENTIFIER C_ERR_CLAS_SAV FORMAT "%3.0" /end CHARACTERISTIC
/begin CHARACTERISTIC fmy_id_ecf.c_err_clas "" VALUE 0x022d0 _REC_VAL_20_u1 255. _CNV_A_R_LINEAR_____1_CM 0. 255. DISPLAY_IDENTIFIER C_ERR_CLAS_ECF FORMAT "%3.0" /end CHARACTERISTIC
/begin CHARACTERISTIC fmy_id_tco_plaus.c_err_clas "" VALUE 0x022e2 _REC_VAL_20_u1 255. _CNV_A_R_LINEAR_____1_CM 0. 255. DISPLAY_IDENTIFIER C_ERR_CLAS_TCO_PLAUS FORMAT "%3.0" /end CHARACTERISTIC
/begin CHARACTERISTIC fmy_id_tco_el.c_err_clas "" VALUE 0x022f4 _REC_VAL_20_u1 255. _CNV_A_R_LINEAR_____1_CM 0. 255. DISPLAY_IDENTIFIER C_ERR_CLAS_TCO_EL FORMAT "%3.0" /end CHARACTERISTIC
/begin CHARACTERISTIC fmy_id_tco_grd.c_err_clas "" VALUE 0x02306 _REC_VAL_20_u1 255. _CNV_A_R_LINEAR_____1_CM 0. 255. DISPLAY_IDENTIFIER C_ERR_CLAS_TCO_GRD FORMAT "%3.0" /end CHARACTERISTIC
/begin CHARACTERISTIC fmy_id_tco_stuck.c_err_clas "" VALUE 0x02318 _REC_VAL_20_u1 255. _CNV_A_R_LINEAR_____1_CM 0. 255. DISPLAY_IDENTIFIER C_ERR_CLAS_TCO_STUCK FORMAT "%3.0" /end CHARACTERISTIC
/begin CHARACTERISTIC fmy_id_ect_el.c_err_clas "" VALUE 0x0232a _REC_VAL_20_u1 255. _CNV_A_R_LINEAR_____1_CM 0. 255. DISPLAY_IDENTIFIER C_ERR_CLAS_ECT_EL FORMAT "%3.0" /end CHARACTERISTIC
/begin CHARACTERISTIC fmy_id_ect_mec.c_err_clas "" VALUE 0x0233c _REC_VAL_20_u1 255. _CNV_A_R_LINEAR_____1_CM 0. 255. DISPLAY_IDENTIFIER C_ERR_CLAS_ECT_MEC FORMAT "%3.0" /end CHARACTERISTIC
/begin CHARACTERISTIC fmy_id_isc.c_err_clas "" VALUE 0x0234e _REC_VAL_20_u1 255. _CNV_A_R_LINEAR_____1_CM 0. 255. DISPLAY_IDENTIFIER C_ERR_CLAS_ISC FORMAT "%3.0" /end CHARACTERISTIC
/begin CHARACTERISTIC fmy_id_im_bls_plaus.c_err_clas "" VALUE 0x02360 _REC_VAL_20_u1 255. _CNV_A_R_LINEAR_____1_CM 0. 255. DISPLAY_IDENTIFIER C_ERR_CLAS_IM_BLS_PLAUS FORMAT "%3.0" /end CHARACTERISTIC
/begin CHARACTERISTIC fmy_id_im_bts_plaus.c_err_clas "" VALUE 0x02372 _REC_VAL_20_u1 255. _CNV_A_R_LINEAR_____1_CM 0. 255. DISPLAY_IDENTIFIER C_ERR_CLAS_IM_BTS_PLAUS FORMAT "%3.0" /end CHARACTERISTIC
/begin CHARACTERISTIC fmy_id_msw_tog.c_err_clas "" VALUE 0x02384 _REC_VAL_20_u1 255. _CNV_A_R_LINEAR_____1_CM 0. 255. DISPLAY_IDENTIFIER C_ERR_CLAS_MSW_TOG FORMAT "%3.0" /end CHARACTERISTIC
/begin CHARACTERISTIC fmy_id_msw_2.c_err_clas "" VALUE 0x02396 _REC_VAL_20_u1 255. _CNV_A_R_LINEAR_____1_CM 0. 255. DISPLAY_IDENTIFIER C_ERR_CLAS_MSW_2 FORMAT "%3.0" /end CHARACTERISTIC
/begin CHARACTERISTIC fmy_id_msw_3.c_err_clas "" VALUE 0x023a8 _REC_VAL_20_u1 255. _CNV_A_R_LINEAR_____1_CM 0. 255. DISPLAY_IDENTIFIER C_ERR_CLAS_MSW_3 FORMAT "%3.0" /end CHARACTERISTIC
/begin CHARACTERISTIC fmy_id_isa_1.c_err_clas "" VALUE 0x023ba _REC_VAL_20_u1 255. _CNV_A_R_LINEAR_____1_CM 0. 255. DISPLAY_IDENTIFIER C_ERR_CLAS_ISA_1 FORMAT "%3.0" /end CHARACTERISTIC
/begin CHARACTERISTIC fmy_id_isa_2.c_err_clas "" VALUE 0x023cc _REC_VAL_20_u1 255. _CNV_A_R_LINEAR_____1_CM 0. 255. DISPLAY_IDENTIFIER C_ERR_CLAS_ISA_2 FORMAT "%3.0" /end CHARACTERISTIC
/begin CHARACTERISTIC fmy_id_seg_t_ad.c_err_clas "" VALUE 0x023de _REC_VAL_20_u1 255. _CNV_A_R_LINEAR_____1_CM 0. 255. DISPLAY_IDENTIFIER C_ERR_CLAS_SEG_T_AD FORMAT "%3.0" /end CHARACTERISTIC
/begin CHARACTERISTIC fmy_id_seg_t.c_err_clas "" VALUE 0x023f0 _REC_VAL_20_u1 255. _CNV_A_R_LINEAR_____1_CM 0. 255. DISPLAY_IDENTIFIER C_ERR_CLAS_SEG_T FORMAT "%3.0" /end CHARACTERISTIC
/begin CHARACTERISTIC fmy_id_mis_0.c_err_clas "" VALUE 0x02402 _REC_VAL_20_u1 255. _CNV_A_R_LINEAR_____1_CM 0. 255. DISPLAY_IDENTIFIER C_ERR_CLAS_MIS_0 FORMAT "%3.0" /end CHARACTERISTIC
/begin CHARACTERISTIC fmy_id_mis_1.c_err_clas "" VALUE 0x02414 _REC_VAL_20_u1 255. _CNV_A_R_LINEAR_____1_CM 0. 255. DISPLAY_IDENTIFIER C_ERR_CLAS_MIS_1 FORMAT "%3.0" /end CHARACTERISTIC
/begin CHARACTERISTIC fmy_id_mis_2.c_err_clas "" VALUE 0x02426 _REC_VAL_20_u1 255. _CNV_A_R_LINEAR_____1_CM 0. 255. DISPLAY_IDENTIFIER C_ERR_CLAS_MIS_2 FORMAT "%3.0" /end CHARACTERISTIC
/begin CHARACTERISTIC fmy_id_mis_3.c_err_clas "" VALUE 0x02438 _REC_VAL_20_u1 255. _CNV_A_R_LINEAR_____1_CM 0. 255. DISPLAY_IDENTIFIER C_ERR_CLAS_MIS_3 FORMAT "%3.0" /end CHARACTERISTIC
/begin CHARACTERISTIC fmy_id_mis_4.c_err_clas "" VALUE 0x0244a _REC_VAL_20_u1 255. _CNV_A_R_LINEAR_____1_CM 0. 255. DISPLAY_IDENTIFIER C_ERR_CLAS_MIS_4 FORMAT "%3.0" /end CHARACTERISTIC
/begin CHARACTERISTIC fmy_id_mis_5.c_err_clas "" VALUE 0x0245c _REC_VAL_20_u1 255. _CNV_A_R_LINEAR_____1_CM 0. 255. DISPLAY_IDENTIFIER C_ERR_CLAS_MIS_5 FORMAT "%3.0" /end CHARACTERISTIC
/begin CHARACTERISTIC fmy_id_mis_low_fuel.c_err_clas "" VALUE 0x0246e _REC_VAL_20_u1 255. _CNV_A_R_LINEAR_____1_CM 0. 255. DISPLAY_IDENTIFIER C_ERR_CLAS_MIS_LOW_FUEL FORMAT "%3.0" /end CHARACTERISTIC
/begin CHARACTERISTIC fmy_id_mis_mpl.c_err_clas "" VALUE 0x02480 _REC_VAL_20_u1 255. _CNV_A_R_LINEAR_____1_CM 0. 255. DISPLAY_IDENTIFIER C_ERR_CLAS_MIS_MPL FORMAT "%3.0" /end CHARACTERISTIC
/begin CHARACTERISTIC fmy_id_conv_mon_1.c_err_clas "" VALUE 0x02492 _REC_VAL_20_u1 255. _CNV_A_R_LINEAR_____1_CM 0. 255. DISPLAY_IDENTIFIER C_ERR_CLAS_CONV_MON_1 FORMAT "%3.0" /end CHARACTERISTIC
/begin CHARACTERISTIC fmy_id_n_32_mon_1.c_err_clas "" VALUE 0x024a4 _REC_VAL_20_u1 255. _CNV_A_R_LINEAR_____1_CM 0. 255. DISPLAY_IDENTIFIER C_ERR_CLAS_N_32_MON_1 FORMAT "%3.0" /end CHARACTERISTIC
/begin CHARACTERISTIC fmy_id_pvs_mon_1.c_err_clas "" VALUE 0x024b6 _REC_VAL_20_u1 255. _CNV_A_R_LINEAR_____1_CM 0. 255. DISPLAY_IDENTIFIER C_ERR_CLAS_PVS_MON_1 FORMAT "%3.0" /end CHARACTERISTIC
/begin CHARACTERISTIC fmy_id_maf_tps_mon_1.c_err_clas "" VALUE 0x024c8 _REC_VAL_20_u1 255. _CNV_A_R_LINEAR_____1_CM 0. 255. DISPLAY_IDENTIFIER C_ERR_CLAS_MAF_TPS_MON_1 FORMAT "%3.0" /end CHARACTERISTIC
/begin CHARACTERISTIC fmy_id_tq_dif_isc_mon_1.c_err_clas "" VALUE 0x024da _REC_VAL_20_u1 255. _CNV_A_R_LINEAR_____1_CM 0. 255. DISPLAY_IDENTIFIER C_ERR_CLAS_TQ_DIF_ISC_MON_1 FORMAT "%3.0" /end CHARACTERISTIC
/begin CHARACTERISTIC fmy_id_tq_req_mon_1.c_err_clas "" VALUE 0x024ec _REC_VAL_20_u1 255. _CNV_A_R_LINEAR_____1_CM 0. 255. DISPLAY_IDENTIFIER C_ERR_CLAS_TQ_REQ_MON_1 FORMAT "%3.0" /end CHARACTERISTIC
/begin CHARACTERISTIC fmy_id_tq_ext_mon_1.c_err_clas "" VALUE 0x024fe _REC_VAL_20_u1 255. _CNV_A_R_LINEAR_____1_CM 0. 255. DISPLAY_IDENTIFIER C_ERR_CLAS_TQ_EXT_MON_1 FORMAT "%3.0" /end CHARACTERISTIC
/begin CHARACTERISTIC fmy_id_tqi_av_mon_1.c_err_clas "" VALUE 0x02510 _REC_VAL_20_u1 255. _CNV_A_R_LINEAR_____1_CM 0. 255. DISPLAY_IDENTIFIER C_ERR_CLAS_TQI_AV_MON_1 FORMAT "%3.0" /end CHARACTERISTIC
/begin CHARACTERISTIC fmy_id_tqi_n_max_mon_1.c_err_clas "" VALUE 0x02522 _REC_VAL_20_u1 255. _CNV_A_R_LINEAR_____1_CM 0. 255. DISPLAY_IDENTIFIER C_ERR_CLAS_TQI_N_MAX_MON_1 FORMAT "%3.0" /end CHARACTERISTIC
/begin CHARACTERISTIC fmy_id_cru_inh_mon_1.c_err_clas "" VALUE 0x02534 _REC_VAL_20_u1 255. _CNV_A_R_LINEAR_____1_CM 0. 255. DISPLAY_IDENTIFIER C_ERR_CLAS_CRU_INH_MON_1 FORMAT "%3.0" /end CHARACTERISTIC
/begin CHARACTERISTIC fmy_id_tqi_n_max_nvmy_mon.c_err_clas "" VALUE 0x02546 _REC_VAL_20_u1 255. _CNV_A_R_LINEAR_____1_CM 0. 255. DISPLAY_IDENTIFIER C_ERR_CLAS_TQI_N_MAX_NVMY_MON FORMAT "%3.0" /end CHARACTERISTIC
/begin CHARACTERISTIC fmy_id_sa_safm.c_err_clas "" VALUE 0x02558 _REC_VAL_20_u1 255. _CNV_A_R_LINEAR_____1_CM 0. 255. DISPLAY_IDENTIFIER C_ERR_CLAS_SA_SAFM FORMAT "%3.0" /end CHARACTERISTIC
/begin CHARACTERISTIC fmy_id_sa_sap.c_err_clas "" VALUE 0x0256a _REC_VAL_20_u1 255. _CNV_A_R_LINEAR_____1_CM 0. 255. DISPLAY_IDENTIFIER C_ERR_CLAS_SA_SAP FORMAT "%3.0" /end CHARACTERISTIC
/begin CHARACTERISTIC fmy_id_sa_sys.c_err_clas "" VALUE 0x0257c _REC_VAL_20_u1 255. _CNV_A_R_LINEAR_____1_CM 0. 255. DISPLAY_IDENTIFIER C_ERR_CLAS_SA_SYS FORMAT "%3.0" /end CHARACTERISTIC
/begin CHARACTERISTIC fmy_id_sa_sav.c_err_clas "" VALUE 0x0258e _REC_VAL_20_u1 255. _CNV_A_R_LINEAR_____1_CM 0. 255. DISPLAY_IDENTIFIER C_ERR_CLAS_SA_SAV FORMAT "%3.0" /end CHARACTERISTIC
/begin CHARACTERISTIC fmy_id_imob_1.c_err_clas "" VALUE 0x025a0 _REC_VAL_20_u1 255. _CNV_A_R_LINEAR_____1_CM 0. 255. DISPLAY_IDENTIFIER C_ERR_CLAS_IMOB_1 FORMAT "%3.0" /end CHARACTERISTIC
/begin CHARACTERISTIC fmy_id_imob_2.c_err_clas "" VALUE 0x025b2 _REC_VAL_20_u1 255. _CNV_A_R_LINEAR_____1_CM 0. 255. DISPLAY_IDENTIFIER C_ERR_CLAS_IMOB_2 FORMAT "%3.0" /end CHARACTERISTIC
/begin CHARACTERISTIC fmy_id_imob_3.c_err_clas "" VALUE 0x025c4 _REC_VAL_20_u1 255. _CNV_A_R_LINEAR_____1_CM 0. 255. DISPLAY_IDENTIFIER C_ERR_CLAS_IMOB_3 FORMAT "%3.0" /end CHARACTERISTIC
/begin CHARACTERISTIC fmy_id_fsd_1.c_err_clas "" VALUE 0x025d6 _REC_VAL_20_u1 255. _CNV_A_R_LINEAR_____1_CM 0. 255. DISPLAY_IDENTIFIER C_ERR_CLAS_FSD_1 FORMAT "%3.0" /end CHARACTERISTIC
/begin CHARACTERISTIC fmy_id_fsd_2.c_err_clas "" VALUE 0x025e8 _REC_VAL_20_u1 255. _CNV_A_R_LINEAR_____1_CM 0. 255. DISPLAY_IDENTIFIER C_ERR_CLAS_FSD_2 FORMAT "%3.0" /end CHARACTERISTIC
/begin CHARACTERISTIC fmy_id_ls_down_swt_1.c_err_clas "" VALUE 0x025fa _REC_VAL_20_u1 255. _CNV_A_R_LINEAR_____1_CM 0. 255. DISPLAY_IDENTIFIER C_ERR_CLAS_LS_DOWN_SWT_1 FORMAT "%3.0" /end CHARACTERISTIC
/begin CHARACTERISTIC fmy_id_ls_down_swt_2.c_err_clas "" VALUE 0x0260c _REC_VAL_20_u1 255. _CNV_A_R_LINEAR_____1_CM 0. 255. DISPLAY_IDENTIFIER C_ERR_CLAS_LS_DOWN_SWT_2 FORMAT "%3.0" /end CHARACTERISTIC
/begin CHARACTERISTIC fmy_id_ls_down_pue_1.c_err_clas "" VALUE 0x0261e _REC_VAL_20_u1 255. _CNV_A_R_LINEAR_____1_CM 0. 255. DISPLAY_IDENTIFIER C_ERR_CLAS_LS_DOWN_PUE_1 FORMAT "%3.0" /end CHARACTERISTIC
/begin CHARACTERISTIC fmy_id_ls_down_pue_2.c_err_clas "" VALUE 0x02630 _REC_VAL_20_u1 255. _CNV_A_R_LINEAR_____1_CM 0. 255. DISPLAY_IDENTIFIER C_ERR_CLAS_LS_DOWN_PUE_2 FORMAT "%3.0" /end CHARACTERISTIC
/begin CHARACTERISTIC fmy_id_ef.c_err_clas "" VALUE 0x02642 _REC_VAL_20_u1 255. _CNV_A_R_LINEAR_____1_CM 0. 255. DISPLAY_IDENTIFIER C_ERR_CLAS_EF FORMAT "%3.0" /end CHARACTERISTIC
/begin CHARACTERISTIC fmy_id_tecu.c_err_clas "" VALUE 0x02654 _REC_VAL_20_u1 255. _CNV_A_R_LINEAR_____1_CM 0. 255. DISPLAY_IDENTIFIER C_ERR_CLAS_TECU FORMAT "%3.0" /end CHARACTERISTIC
/begin CHARACTERISTIC fmy_id_ebox_cfa.c_err_clas "" VALUE 0x02666 _REC_VAL_20_u1 255. _CNV_A_R_LINEAR_____1_CM 0. 255. DISPLAY_IDENTIFIER C_ERR_CLAS_EBOX_CFA FORMAT "%3.0" /end CHARACTERISTIC
/begin CHARACTERISTIC fmy_id_ecu_ram.c_err_clas "" VALUE 0x02678 _REC_VAL_20_u1 255. _CNV_A_R_LINEAR_____1_CM 0. 255. DISPLAY_IDENTIFIER C_ERR_CLAS_ECU_RAM FORMAT "%3.0" /end CHARACTERISTIC
/begin CHARACTERISTIC fmy_id_tqi_lim.c_err_clas "" VALUE 0x0268a _REC_VAL_20_u1 255. _CNV_A_R_LINEAR_____1_CM 0. 255. DISPLAY_IDENTIFIER C_ERR_CLAS_TQI_LIM FORMAT "%3.0" /end CHARACTERISTIC
/begin CHARACTERISTIC fmy_id_obd2_lsh_down_1.c_err_clas "" VALUE 0x0269c _REC_VAL_20_u1 255. _CNV_A_R_LINEAR_____1_CM 0. 255. DISPLAY_IDENTIFIER C_ERR_CLAS_OBD2_LSH_DOWN_1 FORMAT "%3.0" /end CHARACTERISTIC
/begin CHARACTERISTIC fmy_id_obd2_lsh_down_2.c_err_clas "" VALUE 0x026ae _REC_VAL_20_u1 255. _CNV_A_R_LINEAR_____1_CM 0. 255. DISPLAY_IDENTIFIER C_ERR_CLAS_OBD2_LSH_DOWN_2 FORMAT "%3.0" /end CHARACTERISTIC
/begin CHARACTERISTIC fmy_id_dmtls.c_err_clas "" VALUE 0x026c0 _REC_VAL_20_u1 255. _CNV_A_R_LINEAR_____1_CM 0. 255. DISPLAY_IDENTIFIER C_ERR_CLAS_DMTLS FORMAT "%3.0" /end CHARACTERISTIC
/begin CHARACTERISTIC fmy_id_dmtl_pump.c_err_clas "" VALUE 0x026d2 _REC_VAL_20_u1 255. _CNV_A_R_LINEAR_____1_CM 0. 255. DISPLAY_IDENTIFIER C_ERR_CLAS_DMTL_PUMP FORMAT "%3.0" /end CHARACTERISTIC
/begin CHARACTERISTIC fmy_id_dmtlm.c_err_clas "" VALUE 0x026e4 _REC_VAL_20_u1 255. _CNV_A_R_LINEAR_____1_CM 0. 255. DISPLAY_IDENTIFIER C_ERR_CLAS_DMTLM FORMAT "%3.0" /end CHARACTERISTIC
/begin CHARACTERISTIC fmy_id_dmtl_leak.c_err_clas "" VALUE 0x026f6 _REC_VAL_20_u1 255. _CNV_A_R_LINEAR_____1_CM 0. 255. DISPLAY_IDENTIFIER C_ERR_CLAS_DMTL_LEAK FORMAT "%3.0" /end CHARACTERISTIC
/begin CHARACTERISTIC fmy_id_sof.c_err_clas "" VALUE 0x02708 _REC_VAL_20_u1 255. _CNV_A_R_LINEAR_____1_CM 0. 255. DISPLAY_IDENTIFIER C_ERR_CLAS_SOF FORMAT "%3.0" /end CHARACTERISTIC
/begin CHARACTERISTIC fmy_id_sof_req.c_err_clas "" VALUE 0x0271a _REC_VAL_20_u1 255. _CNV_A_R_LINEAR_____1_CM 0. 255. DISPLAY_IDENTIFIER C_ERR_CLAS_SOF_REQ FORMAT "%3.0" /end CHARACTERISTIC
/begin CHARACTERISTIC fmy_id_rly_st.c_err_clas "" VALUE 0x0272c _REC_VAL_20_u1 255. _CNV_A_R_LINEAR_____1_CM 0. 255. DISPLAY_IDENTIFIER C_ERR_CLAS_RLY_ST FORMAT "%3.0" /end CHARACTERISTIC
/begin CHARACTERISTIC fmy_id_bsd.c_err_clas "" VALUE 0x0273e _REC_VAL_20_u1 255. _CNV_A_R_LINEAR_____1_CM 0. 255. DISPLAY_IDENTIFIER C_ERR_CLAS_BSD FORMAT "%3.0" /end CHARACTERISTIC
/begin CHARACTERISTIC fmy_id_poil_swi.c_err_clas "" VALUE 0x02750 _REC_VAL_20_u1 255. _CNV_A_R_LINEAR_____1_CM 0. 255. DISPLAY_IDENTIFIER C_ERR_CLAS_POIL_SWI FORMAT "%3.0" /end CHARACTERISTIC
/begin CHARACTERISTIC fmy_id_tout_efp.c_err_clas "" VALUE 0x02762 _REC_VAL_20_u1 255. _CNV_A_R_LINEAR_____1_CM 0. 255. DISPLAY_IDENTIFIER C_ERR_CLAS_TOUT_EFP FORMAT "%3.0" /end CHARACTERISTIC
/begin CHARACTERISTIC fmy_id_diagcps.c_err_clas "" VALUE 0x02774 _REC_VAL_20_u1 255. _CNV_A_R_LINEAR_____1_CM 0. 255. DISPLAY_IDENTIFIER C_ERR_CLAS_DIAGCPS FORMAT "%3.0" /end CHARACTERISTIC
/begin CHARACTERISTIC fmy_id_tq_gs_inc_plaus.c_err_clas "" VALUE 0x02786 _REC_VAL_20_u1 255. _CNV_A_R_LINEAR_____1_CM 0. 255. DISPLAY_IDENTIFIER C_ERR_CLAS_TQ_GS_INC_PLAUS FORMAT "%3.0" /end CHARACTERISTIC
/begin CHARACTERISTIC fmy_id_dcc.c_err_clas "" VALUE 0x02798 _REC_VAL_20_u1 255. _CNV_A_R_LINEAR_____1_CM 0. 255. DISPLAY_IDENTIFIER C_ERR_CLAS_DCC FORMAT "%3.0" /end CHARACTERISTIC
/begin CHARACTERISTIC fmy_id_ecras.c_err_clas "" VALUE 0x027aa _REC_VAL_20_u1 255. _CNV_A_R_LINEAR_____1_CM 0. 255. DISPLAY_IDENTIFIER C_ERR_CLAS_ECRAS FORMAT "%3.0" /end CHARACTERISTIC
/begin CHARACTERISTIC fmy_id_dmtlh.c_err_clas "" VALUE 0x027bc _REC_VAL_20_u1 255. _CNV_A_R_LINEAR_____1_CM 0. 255. DISPLAY_IDENTIFIER C_ERR_CLAS_DMTLH FORMAT "%3.0" /end CHARACTERISTIC
/begin CHARACTERISTIC fmy_id_cs.c_err_clas "" VALUE 0x027ce _REC_VAL_20_u1 255. _CNV_A_R_LINEAR_____1_CM 0. 255. DISPLAY_IDENTIFIER C_ERR_CLAS_CS FORMAT "%3.0" /end CHARACTERISTIC
/begin CHARACTERISTIC fmy_id_spi_mps.c_err_clas "" VALUE 0x027e0 _REC_VAL_20_u1 255. _CNV_A_R_LINEAR_____1_CM 0. 255. DISPLAY_IDENTIFIER C_ERR_CLAS_SPI_MPS FORMAT "%3.0" /end CHARACTERISTIC
/begin CHARACTERISTIC fmy_id_spi_knk.c_err_clas "" VALUE 0x027f2 _REC_VAL_20_u1 255. _CNV_A_R_LINEAR_____1_CM 0. 255. DISPLAY_IDENTIFIER C_ERR_CLAS_SPI_KNK FORMAT "%3.0" /end CHARACTERISTIC
/begin CHARACTERISTIC fmy_id_bn_tq_dcc.c_err_clas "" VALUE 0x02804 _REC_VAL_20_u1 255. _CNV_A_R_LINEAR_____1_CM 0. 255. DISPLAY_IDENTIFIER C_ERR_CLAS_BN_TQ_DCC FORMAT "%3.0" /end CHARACTERISTIC
/begin CHARACTERISTIC fmy_id_bn_tq_pste_2.c_err_clas "" VALUE 0x02816 _REC_VAL_20_u1 255. _CNV_A_R_LINEAR_____1_CM 0. 255. DISPLAY_IDENTIFIER C_ERR_CLAS_BN_TQ_PSTE_2 FORMAT "%3.0" /end CHARACTERISTIC
/begin CHARACTERISTIC fmy_id_bn_ars.c_err_clas "" VALUE 0x02828 _REC_VAL_20_u1 255. _CNV_A_R_LINEAR_____1_CM 0. 255. DISPLAY_IDENTIFIER C_ERR_CLAS_BN_ARS FORMAT "%3.0" /end CHARACTERISTIC
/begin CHARACTERISTIC fmy_id_bn_cas.c_err_clas "" VALUE 0x0283a _REC_VAL_20_u1 255. _CNV_A_R_LINEAR_____1_CM 0. 255. DISPLAY_IDENTIFIER C_ERR_CLAS_BN_CAS FORMAT "%3.0" /end CHARACTERISTIC
/begin CHARACTERISTIC fmy_id_bn_tq_tcs.c_err_clas "" VALUE 0x0284c _REC_VAL_20_u1 255. _CNV_A_R_LINEAR_____1_CM 0. 255. DISPLAY_IDENTIFIER C_ERR_CLAS_BN_TQ_TCS FORMAT "%3.0" /end CHARACTERISTIC
/begin CHARACTERISTIC fmy_id_bn_vs_tcs.c_err_clas "" VALUE 0x0285e _REC_VAL_20_u1 255. _CNV_A_R_LINEAR_____1_CM 0. 255. DISPLAY_IDENTIFIER C_ERR_CLAS_BN_VS_TCS FORMAT "%3.0" /end CHARACTERISTIC
/begin CHARACTERISTIC fmy_id_bn_tcs.c_err_clas "" VALUE 0x02870 _REC_VAL_20_u1 255. _CNV_A_R_LINEAR_____1_CM 0. 255. DISPLAY_IDENTIFIER C_ERR_CLAS_BN_TCS FORMAT "%3.0" /end CHARACTERISTIC
/begin CHARACTERISTIC fmy_id_bn_tq_etcu.c_err_clas "" VALUE 0x02882 _REC_VAL_20_u1 255. _CNV_A_R_LINEAR_____1_CM 0. 255. DISPLAY_IDENTIFIER C_ERR_CLAS_BN_TQ_ETCU FORMAT "%3.0" /end CHARACTERISTIC
/begin CHARACTERISTIC fmy_id_bn_etcu.c_err_clas "" VALUE 0x02894 _REC_VAL_20_u1 255. _CNV_A_R_LINEAR_____1_CM 0. 255. DISPLAY_IDENTIFIER C_ERR_CLAS_BN_ETCU FORMAT "%3.0" /end CHARACTERISTIC
/begin CHARACTERISTIC fmy_id_bn_tq_amt.c_err_clas "" VALUE 0x028a6 _REC_VAL_20_u1 255. _CNV_A_R_LINEAR_____1_CM 0. 255. DISPLAY_IDENTIFIER C_ERR_CLAS_BN_TQ_AMT FORMAT "%3.0" /end CHARACTERISTIC
/begin CHARACTERISTIC fmy_id_bn_acc.c_err_clas "" VALUE 0x028b8 _REC_VAL_20_u1 255. _CNV_A_R_LINEAR_____1_CM 0. 255. DISPLAY_IDENTIFIER C_ERR_CLAS_BN_ACC FORMAT "%3.0" /end CHARACTERISTIC
/begin CHARACTERISTIC fmy_id_bn_t_icl.c_err_clas "" VALUE 0x028ca _REC_VAL_20_u1 255. _CNV_A_R_LINEAR_____1_CM 0. 255. DISPLAY_IDENTIFIER C_ERR_CLAS_BN_T_ICL FORMAT "%3.0" /end CHARACTERISTIC
/begin CHARACTERISTIC fmy_id_bn_veh_mod.c_err_clas "" VALUE 0x028dc _REC_VAL_20_u1 255. _CNV_A_R_LINEAR_____1_CM 0. 255. DISPLAY_IDENTIFIER C_ERR_CLAS_BN_VEH_MOD FORMAT "%3.0" /end CHARACTERISTIC
/begin CHARACTERISTIC fmy_id_bn_km_icl.c_err_clas "" VALUE 0x028ee _REC_VAL_20_u1 255. _CNV_A_R_LINEAR_____1_CM 0. 255. DISPLAY_IDENTIFIER C_ERR_CLAS_BN_KM_ICL FORMAT "%3.0" /end CHARACTERISTIC
/begin CHARACTERISTIC fmy_id_bn_icl.c_err_clas "" VALUE 0x02900 _REC_VAL_20_u1 255. _CNV_A_R_LINEAR_____1_CM 0. 255. DISPLAY_IDENTIFIER C_ERR_CLAS_BN_ICL FORMAT "%3.0" /end CHARACTERISTIC
/begin CHARACTERISTIC fmy_id_bn_pow_vb.c_err_clas "" VALUE 0x02912 _REC_VAL_20_u1 255. _CNV_A_R_LINEAR_____1_CM 0. 255. DISPLAY_IDENTIFIER C_ERR_CLAS_BN_POW_VB FORMAT "%3.0" /end CHARACTERISTIC
/begin CHARACTERISTIC fmy_id_bn_pow_gen.c_err_clas "" VALUE 0x02924 _REC_VAL_20_u1 255. _CNV_A_R_LINEAR_____1_CM 0. 255. DISPLAY_IDENTIFIER C_ERR_CLAS_BN_POW_GEN FORMAT "%3.0" /end CHARACTERISTIC
/begin CHARACTERISTIC fmy_id_bn_msw.c_err_clas "" VALUE 0x02936 _REC_VAL_20_u1 255. _CNV_A_R_LINEAR_____1_CM 0. 255. DISPLAY_IDENTIFIER C_ERR_CLAS_BN_MSW FORMAT "%3.0" /end CHARACTERISTIC
/begin CHARACTERISTIC fmy_id_bn_ang_pste.c_err_clas "" VALUE 0x02948 _REC_VAL_20_u1 255. _CNV_A_R_LINEAR_____1_CM 0. 255. DISPLAY_IDENTIFIER C_ERR_CLAS_BN_ANG_PSTE FORMAT "%3.0" /end CHARACTERISTIC
/begin CHARACTERISTIC fmy_id_bn_efp.c_err_clas "" VALUE 0x0295a _REC_VAL_20_u1 255. _CNV_A_R_LINEAR_____1_CM 0. 255. DISPLAY_IDENTIFIER C_ERR_CLAS_BN_EFP FORMAT "%3.0" /end CHARACTERISTIC
/begin CHARACTERISTIC fmy_id_load_tps_plaus.c_err_clas "" VALUE 0x0296c _REC_VAL_20_u1 255. _CNV_A_R_LINEAR_____1_CM 0. 255. DISPLAY_IDENTIFIER C_ERR_CLAS_LOAD_TPS_PLAUS FORMAT "%3.0" /end CHARACTERISTIC
/begin CHARACTERISTIC fmy_id_efp_crash.c_err_clas "" VALUE 0x0297e _REC_VAL_20_u1 255. _CNV_A_R_LINEAR_____1_CM 0. 255. DISPLAY_IDENTIFIER C_ERR_CLAS_EFP_CRASH FORMAT "%3.0" /end CHARACTERISTIC
/begin CHARACTERISTIC fmy_id_efp.c_err_clas "" VALUE 0x02990 _REC_VAL_20_u1 255. _CNV_A_R_LINEAR_____1_CM 0. 255. DISPLAY_IDENTIFIER C_ERR_CLAS_EFP FORMAT "%3.0" /end CHARACTERISTIC
/begin CHARACTERISTIC fmy_id_locan_boff.c_err_clas "" VALUE 0x029a2 _REC_VAL_20_u1 255. _CNV_A_R_LINEAR_____1_CM 0. 255. DISPLAY_IDENTIFIER C_ERR_CLAS_LOCAN_BOFF FORMAT "%3.0" /end CHARACTERISTIC
/begin CHARACTERISTIC fmy_id_chg_ls_up.c_err_clas "" VALUE 0x029b4 _REC_VAL_20_u1 255. _CNV_A_R_LINEAR_____1_CM 0. 255. DISPLAY_IDENTIFIER C_ERR_CLAS_CHG_LS_UP FORMAT "%3.0" /end CHARACTERISTIC
/begin CHARACTERISTIC fmy_id_chg_ls_down.c_err_clas "" VALUE 0x029c6 _REC_VAL_20_u1 255. _CNV_A_R_LINEAR_____1_CM 0. 255. DISPLAY_IDENTIFIER C_ERR_CLAS_CHG_LS_DOWN FORMAT "%3.0" /end CHARACTERISTIC
/begin CHARACTERISTIC fmy_id_qoil_sens.c_err_clas "" VALUE 0x029d8 _REC_VAL_20_u1 255. _CNV_A_R_LINEAR_____1_CM 0. 255. DISPLAY_IDENTIFIER C_ERR_CLAS_QOIL_SENS FORMAT "%3.0" /end CHARACTERISTIC
/begin CHARACTERISTIC fmy_id_bat_sens.c_err_clas "" VALUE 0x029ea _REC_VAL_20_u1 255. _CNV_A_R_LINEAR_____1_CM 0. 255. DISPLAY_IDENTIFIER C_ERR_CLAS_BAT_SENS FORMAT "%3.0" /end CHARACTERISTIC
/begin CHARACTERISTIC fmy_id_bat_sens_it.c_err_clas "" VALUE 0x029fc _REC_VAL_20_u1 255. _CNV_A_R_LINEAR_____1_CM 0. 255. DISPLAY_IDENTIFIER C_ERR_CLAS_BAT_SENS_IT FORMAT "%3.0" /end CHARACTERISTIC
/begin CHARACTERISTIC fmy_id_bat_sens_it_el.c_err_clas "" VALUE 0x02a0e _REC_VAL_20_u1 255. _CNV_A_R_LINEAR_____1_CM 0. 255. DISPLAY_IDENTIFIER C_ERR_CLAS_BAT_SENS_IT_EL FORMAT "%3.0" /end CHARACTERISTIC
/begin CHARACTERISTIC fmy_id_ecu_nvmy.c_err_clas "" VALUE 0x02a20 _REC_VAL_20_u1 255. _CNV_A_R_LINEAR_____1_CM 0. 255. DISPLAY_IDENTIFIER C_ERR_CLAS_ECU_NVMY FORMAT "%3.0" /end CHARACTERISTIC
/begin CHARACTERISTIC fmy_id_gs.c_err_clas "" VALUE 0x02a32 _REC_VAL_20_u1 255. _CNV_A_R_LINEAR_____1_CM 0. 255. DISPLAY_IDENTIFIER C_ERR_CLAS_GS FORMAT "%3.0" /end CHARACTERISTIC
/begin CHARACTERISTIC fmy_id_obd2_lsh_up_1.c_err_clas "" VALUE 0x02a56 _REC_VAL_20_u1 255. _CNV_A_R_LINEAR_____1_CM 0. 255. DISPLAY_IDENTIFIER C_ERR_CLAS_OBD2_LSH_UP_1 FORMAT "%3.0" /end CHARACTERISTIC
/begin CHARACTERISTIC fmy_id_obd2_lsh_up_2.c_err_clas "" VALUE 0x02a68 _REC_VAL_20_u1 255. _CNV_A_R_LINEAR_____1_CM 0. 255. DISPLAY_IDENTIFIER C_ERR_CLAS_OBD2_LSH_UP_2 FORMAT "%3.0" /end CHARACTERISTIC
/begin CHARACTERISTIC fmy_id_cat_diag_1.c_err_clas "" VALUE 0x02a7a _REC_VAL_20_u1 255. _CNV_A_R_LINEAR_____1_CM 0. 255. DISPLAY_IDENTIFIER C_ERR_CLAS_CAT_DIAG_1 FORMAT "%3.0" /end CHARACTERISTIC
/begin CHARACTERISTIC fmy_id_cat_diag_2.c_err_clas "" VALUE 0x02a8c _REC_VAL_20_u1 255. _CNV_A_R_LINEAR_____1_CM 0. 255. DISPLAY_IDENTIFIER C_ERR_CLAS_CAT_DIAG_2 FORMAT "%3.0" /end CHARACTERISTIC
/begin CHARACTERISTIC fmy_id_chk_ls_down_1.c_err_clas "" VALUE 0x02a9e _REC_VAL_20_u1 255. _CNV_A_R_LINEAR_____1_CM 0. 255. DISPLAY_IDENTIFIER C_ERR_CLAS_CHK_LS_DOWN_1 FORMAT "%3.0" /end CHARACTERISTIC
/begin CHARACTERISTIC fmy_id_chk_ls_down_2.c_err_clas "" VALUE 0x02ab0 _REC_VAL_20_u1 255. _CNV_A_R_LINEAR_____1_CM 0. 255. DISPLAY_IDENTIFIER C_ERR_CLAS_CHK_LS_DOWN_2 FORMAT "%3.0" /end CHARACTERISTIC
/begin CHARACTERISTIC fmy_id_vls_up_min_cold_1.c_err_clas "" VALUE 0x02ac2 _REC_VAL_20_u1 255. _CNV_A_R_LINEAR_____1_CM 0. 255. DISPLAY_IDENTIFIER C_ERR_CLAS_VLS_UP_MIN_COLD_1 FORMAT "%3.0" /end CHARACTERISTIC
/begin CHARACTERISTIC fmy_id_vls_up_min_cold_2.c_err_clas "" VALUE 0x02ad4 _REC_VAL_20_u1 255. _CNV_A_R_LINEAR_____1_CM 0. 255. DISPLAY_IDENTIFIER C_ERR_CLAS_VLS_UP_MIN_COLD_2 FORMAT "%3.0" /end CHARACTERISTIC
/begin CHARACTERISTIC fmy_id_vls_up_min_1.c_err_clas "" VALUE 0x02ae6 _REC_VAL_20_u1 255. _CNV_A_R_LINEAR_____1_CM 0. 255. DISPLAY_IDENTIFIER C_ERR_CLAS_VLS_UP_MIN_1 FORMAT "%3.0" /end CHARACTERISTIC
/begin CHARACTERISTIC fmy_id_vls_up_min_2.c_err_clas "" VALUE 0x02af8 _REC_VAL_20_u1 255. _CNV_A_R_LINEAR_____1_CM 0. 255. DISPLAY_IDENTIFIER C_ERR_CLAS_VLS_UP_MIN_2 FORMAT "%3.0" /end CHARACTERISTIC
/begin CHARACTERISTIC fmy_id_vls_up_max_1.c_err_clas "" VALUE 0x02b0a _REC_VAL_20_u1 255. _CNV_A_R_LINEAR_____1_CM 0. 255. DISPLAY_IDENTIFIER C_ERR_CLAS_VLS_UP_MAX_1 FORMAT "%3.0" /end CHARACTERISTIC
/begin CHARACTERISTIC fmy_id_vls_up_max_2.c_err_clas "" VALUE 0x02b1c _REC_VAL_20_u1 255. _CNV_A_R_LINEAR_____1_CM 0. 255. DISPLAY_IDENTIFIER C_ERR_CLAS_VLS_UP_MAX_2 FORMAT "%3.0" /end CHARACTERISTIC
/begin CHARACTERISTIC fmy_id_vls_up_oc_1.c_err_clas "" VALUE 0x02b2e _REC_VAL_20_u1 255. _CNV_A_R_LINEAR_____1_CM 0. 255. DISPLAY_IDENTIFIER C_ERR_CLAS_VLS_UP_OC_1 FORMAT "%3.0" /end CHARACTERISTIC
/begin CHARACTERISTIC fmy_id_vls_up_oc_2.c_err_clas "" VALUE 0x02b40 _REC_VAL_20_u1 255. _CNV_A_R_LINEAR_____1_CM 0. 255. DISPLAY_IDENTIFIER C_ERR_CLAS_VLS_UP_OC_2 FORMAT "%3.0" /end CHARACTERISTIC
/begin CHARACTERISTIC fmy_id_vls_up_puc_1.c_err_clas "" VALUE 0x02b52 _REC_VAL_20_u1 255. _CNV_A_R_LINEAR_____1_CM 0. 255. DISPLAY_IDENTIFIER C_ERR_CLAS_VLS_UP_PUC_1 FORMAT "%3.0" /end CHARACTERISTIC
/begin CHARACTERISTIC fmy_id_vls_up_puc_2.c_err_clas "" VALUE 0x02b64 _REC_VAL_20_u1 255. _CNV_A_R_LINEAR_____1_CM 0. 255. DISPLAY_IDENTIFIER C_ERR_CLAS_VLS_UP_PUC_2 FORMAT "%3.0" /end CHARACTERISTIC
/begin CHARACTERISTIC fmy_id_vls_up_stk_1.c_err_clas "" VALUE 0x02b76 _REC_VAL_20_u1 255. _CNV_A_R_LINEAR_____1_CM 0. 255. DISPLAY_IDENTIFIER C_ERR_CLAS_VLS_UP_STK_1 FORMAT "%3.0" /end CHARACTERISTIC
/begin CHARACTERISTIC fmy_id_vls_up_stk_2.c_err_clas "" VALUE 0x02b88 _REC_VAL_20_u1 255. _CNV_A_R_LINEAR_____1_CM 0. 255. DISPLAY_IDENTIFIER C_ERR_CLAS_VLS_UP_STK_2 FORMAT "%3.0" /end CHARACTERISTIC
/begin CHARACTERISTIC fmy_id_lam_dly_1.c_err_clas "" VALUE 0x02b9a _REC_VAL_20_u1 255. _CNV_A_R_LINEAR_____1_CM 0. 255. DISPLAY_IDENTIFIER C_ERR_CLAS_LAM_DLY_1 FORMAT "%3.0" /end CHARACTERISTIC
/begin CHARACTERISTIC fmy_id_lam_dly_2.c_err_clas "" VALUE 0x02bac _REC_VAL_20_u1 255. _CNV_A_R_LINEAR_____1_CM 0. 255. DISPLAY_IDENTIFIER C_ERR_CLAS_LAM_DLY_2 FORMAT "%3.0" /end CHARACTERISTIC
/begin CHARACTERISTIC fmy_id_ls_up_swt_1.c_err_clas "" VALUE 0x02bbe _REC_VAL_20_u1 255. _CNV_A_R_LINEAR_____1_CM 0. 255. DISPLAY_IDENTIFIER C_ERR_CLAS_LS_UP_SWT_1 FORMAT "%3.0" /end CHARACTERISTIC
/begin CHARACTERISTIC fmy_id_ls_up_swt_2.c_err_clas "" VALUE 0x02bd0 _REC_VAL_20_u1 255. _CNV_A_R_LINEAR_____1_CM 0. 255. DISPLAY_IDENTIFIER C_ERR_CLAS_LS_UP_SWT_2 FORMAT "%3.0" /end CHARACTERISTIC
/begin CHARACTERISTIC fmy_id_ls_up_frq_1.c_err_clas "" VALUE 0x02be2 _REC_VAL_20_u1 255. _CNV_A_R_LINEAR_____1_CM 0. 255. DISPLAY_IDENTIFIER C_ERR_CLAS_LS_UP_FRQ_1 FORMAT "%3.0" /end CHARACTERISTIC
/begin CHARACTERISTIC fmy_id_ls_up_frq_2.c_err_clas "" VALUE 0x02bf4 _REC_VAL_20_u1 255. _CNV_A_R_LINEAR_____1_CM 0. 255. DISPLAY_IDENTIFIER C_ERR_CLAS_LS_UP_FRQ_2 FORMAT "%3.0" /end CHARACTERISTIC
/begin MEASUREMENT load_clc "Calculated load" UBYTE _CNV_A_R_LINEAR_____10_CM 1 100. 0. 99.609375 DISPLAY_IDENTIFIER LOAD_CLC ECU_ADDRESS 0x3fdb7a FORMAT "%4.1" /end MEASUREMENT
/begin MEASUREMENT state_ls_1 "Fuel system status bank i" UBYTE _CNV_S_4_STATE_LS_196_CM 1 100. 1. 8. DISPLAY_IDENTIFIER STATE_LS_1 ECU_ADDRESS 0x3fdb7b /end MEASUREMENT
/begin MEASUREMENT state_ls_2 "Fuel system status bank i" UBYTE _CNV_S_4_STATE_LS_196_CM 1 100. 1. 8. DISPLAY_IDENTIFIER STATE_LS_2 ECU_ADDRESS 0x3fdb7c /end MEASUREMENT
/begin AXIS_PTS ldp_amp_ip_load_clc_amp "" 0x108de amp _REC_AXS_20_u2 5434. _CNV_A_R_LINEAR_____49_CM 6 0. 5434. DISPLAY_IDENTIFIER LDP_AMP_IP_LOAD_CLC_AMP FORMAT "%7.2" /end AXIS_PTS
/begin AXIS_PTS ldp_n_32_ip_load_clc "" 0x07c91 n_32 _REC_AXS_20_u1 8160. _CNV_A_R_LINEAR_____16_CM 8 0. 8160. DISPLAY_IDENTIFIER LDP_N_32_IP_LOAD_CLC FORMAT "%4.0" /end AXIS_PTS
/begin AXIS_PTS ldp_maf_ip_load_clc "" 0x10ca0 maf _REC_AXS_20_u2 1389. _CNV_A_R_LINEAR_____106_CM 8 0. 1389. DISPLAY_IDENTIFIER LDP_MAF_IP_LOAD_CLC FORMAT "%7.2" /end AXIS_PTS
/begin CHARACTERISTIC ip_load_clc_amp__amp "Atmospheric pressure ratio" CURVE 0x00c93 _REC_CUR_20_u1_u2 1.99220002 _CNV_A_R_LINEAR_____39_CM 0. 1.99220002 DISPLAY_IDENTIFIER IP_LOAD_CLC_AMP__AMP FORMAT "%5.3"
 /begin AXIS_DESCR COM_AXIS amp _CNV_A_R_LINEAR_____49_CM 6 0. 5434. FORMAT "%7.2" AXIS_PTS_REF ldp_amp_ip_load_clc_amp /end AXIS_DESCR
/end CHARACTERISTIC
/begin CHARACTERISTIC ip_load_clc__n_32__maf "Airflow ratio" MAP 0x06948 _REC_MAP_20_u1_u1_u2 0.9960940000000002 _CNV_A_R_LINEAR_____50_CM 0. 0.996094 DISPLAY_IDENTIFIER IP_LOAD_CLC__N_32__MAF FORMAT "%5.3"
 /begin AXIS_DESCR COM_AXIS n_32 _CNV_A_R_LINEAR_____16_CM 8 0. 8160. FORMAT "%4.0" AXIS_PTS_REF ldp_n_32_ip_load_clc /end AXIS_DESCR
 /begin AXIS_DESCR COM_AXIS maf _CNV_A_R_LINEAR_____106_CM 8 0. 1389. FORMAT "%7.2" AXIS_PTS_REF ldp_maf_ip_load_clc /end AXIS_DESCR
/end CHARACTERISTIC
/begin MEASUREMENT lv_inh_diag_fsd_cp "Deactivation bit for fuel system diagnosis due to internal states of the CP-function" UBYTE _CNV_S_2_RANGE______0_CM 1 100. 0. 1. DISPLAY_IDENTIFIER LV_INH_DIAG_FSD_CP ECU_ADDRESS 0x3fe4cc BIT_MASK 0x1 /end MEASUREMENT
/begin CHARACTERISTIC lc_inh_fsd_man_deac "Manual deactivation of FSD inhibitation" VALUE 0x00f36 _REC_VAL_20_u1 1. _CNV_A_R_LINEAR_____22_CM 0. 1. DISPLAY_IDENTIFIER LC_INH_FSD_MAN_DEAC FORMAT "%2.0" /end CHARACTERISTIC
/begin MEASUREMENT lv_err_det_fsd_1 "Error detection flag FSD diagnosis" UBYTE _CNV_S_2_RANGE______0_CM 1 100. 0. 1. DISPLAY_IDENTIFIER LV_ERR_DET_FSD_1 ECU_ADDRESS 0x3fe4c9 BIT_MASK 0x1 /end MEASUREMENT
/begin MEASUREMENT lv_err_det_fsd_2 "Error detection flag FSD diagnosis" UBYTE _CNV_S_2_RANGE______0_CM 1 100. 0. 1. DISPLAY_IDENTIFIER LV_ERR_DET_FSD_2 ECU_ADDRESS 0x3fe4ca BIT_MASK 0x1 /end MEASUREMENT
/begin CHARACTERISTIC c_cl_mmv_max_fsd "Maximum value for CL_MMV to permit FSD" VALUE 0x014b6 _REC_VAL_20_u2 1.99996948 _CNV_A_R_LINEAR_____21_CM 0. 1.99996948 DISPLAY_IDENTIFIER C_CL_MMV_MAX_FSD FORMAT "%7.5" /end CHARACTERISTIC
/begin CHARACTERISTIC c_tco_min_fsd_pu "Minimum coolent tempeature for FSD stop during PU" VALUE 0x00889 _REC_VAL_20_u1 190.5 _CNV_A_R_LINEAR_____12_CM -48. 142.5 DISPLAY_IDENTIFIER C_TCO_MIN_FSD_PU FORMAT "%5.1" /end CHARACTERISTIC
/begin CHARACTERISTIC c_t_dly_fsd_pu "Time after end of PU before restart of FSD" VALUE 0x017ee _REC_VAL_20_u2 1310.7 _CNV_A_R_LINEAR_____197_CM 0. 1310.7 DISPLAY_IDENTIFIER C_T_DLY_FSD_PU FORMAT "%7.2" /end CHARACTERISTIC
/begin CHARACTERISTIC c_t_dly_fsd_reac "Time after end of PUC before restart of FSD" VALUE 0x017f0 _REC_VAL_20_u2 1310.7 _CNV_A_R_LINEAR_____197_CM 0. 1310.7 DISPLAY_IDENTIFIER C_T_DLY_FSD_REAC FORMAT "%7.2" /end CHARACTERISTIC
/begin CHARACTERISTIC c_t_ti_add_wf_dec_sum "Time after end of PUC before restart of FSD" VALUE 0x0083e _REC_VAL_20_u1 5.1 _CNV_A_R_LINEAR_____197_CM 0. 5.1 DISPLAY_IDENTIFIER C_T_TI_ADD_WF_DEC_SUM FORMAT "%4.2" /end CHARACTERISTIC
/begin CHARACTERISTIC c_ti_add_wf_dec "Time after end of PUC before restart of FSD" VALUE 0x0191a _REC_VAL_20_u2 131.068 _CNV_A_R_LINEAR_____198_CM 0. 131.068 DISPLAY_IDENTIFIER C_TI_ADD_WF_DEC FORMAT "%7.3" /end CHARACTERISTIC
/begin CHARACTERISTIC c_ti_add_wf_min_ldc "Time after end of PUC before restart of FSD" VALUE 0x0191c _REC_VAL_20_u2 131.068 _CNV_A_R_LINEAR_____198_CM 0. 131.068 DISPLAY_IDENTIFIER C_TI_ADD_WF_MIN_LDC FORMAT "%7.3" /end CHARACTERISTIC
/begin CHARACTERISTIC c_ti_add_wf_sum_max "Time after end of PUC before restart of FSD" VALUE 0x0191e _REC_VAL_20_u2 262.14 _CNV_A_R_LINEAR_____198_CM 0. 262.14 DISPLAY_IDENTIFIER C_TI_ADD_WF_SUM_MAX FORMAT "%7.3" /end CHARACTERISTIC
/begin MEASUREMENT ti_add_wf_sum "Sum of TI_ADD_WF over threshold" UWORD _CNV_A_R_LINEAR_____198_CM 1 100. 0. 262.14 DISPLAY_IDENTIFIER TI_ADD_WF_SUM ECU_ADDRESS 0x3fd706 BYTE_ORDER MSB_LAST FORMAT "%7.3" /end MEASUREMENT
/begin MEASUREMENT t_ti_add_wf_dec_sum "time counter for decrementation of ti_add_wf_sum" UBYTE _CNV_A_R_LINEAR_____197_CM 1 100. 0. 5.1 DISPLAY_IDENTIFIER T_TI_ADD_WF_DEC_SUM ECU_ADDRESS 0x3fe4cd FORMAT "%4.2" /end MEASUREMENT
/begin MEASUREMENT lv_ldc_fsd "Limited dynamic of FSD concerning wall film" UBYTE _CNV_S_2_RANGE______0_CM 1 100. 0. 1. DISPLAY_IDENTIFIER LV_LDC_FSD ECU_ADDRESS 0x3fe4d1 BIT_MASK 0x1 /end MEASUREMENT
/begin MEASUREMENT lv_inh_diag_fsd "fuel system diagnosis: application incidence to inhibit the diagnosis" UBYTE _CNV_S_2_RANGE______0_CM 1 100. 0. 1. DISPLAY_IDENTIFIER LV_INH_DIAG_FSD ECU_ADDRESS 0x3fe4cb BIT_MASK 0x1 /end MEASUREMENT
/begin MEASUREMENT lam_bank_1.lsh_down_obd2.pow_int_obd2_lsh_down "Integral indicates measure of cooling energy of exhaust gas at sensor location" UWORD _CNV_A_R_LINEAR_____291_CM 1 100. 0. 65535. DISPLAY_IDENTIFIER POW_INT_OBD2_LSH_DOWN_1 ECU_ADDRESS 0x3fc32a BYTE_ORDER MSB_LAST FORMAT "%5.0" /end MEASUREMENT
/begin MEASUREMENT lam_bank_1.lsh_down_obd2.state_obd2_lsh_down "Indicates current phase of oxygen sensor heater OBDII diagnosis" UBYTE _CNV_S_9_STATE_OBD2_292_CM 1 100. 0. 8. DISPLAY_IDENTIFIER STATE_OBD2_LSH_DOWN_1 ECU_ADDRESS 0x3fc328 /end MEASUREMENT
/begin MEASUREMENT lam_bank_1.lsh_down_obd2.tcc_obd2_lsh_down "Number of completed valid diagnosis cycles" UWORD _CNV_A_R_LINEAR_____22_CM 1 100. 0. 1023. DISPLAY_IDENTIFIER TCC_OBD2_LSH_DOWN_1 ECU_ADDRESS 0x3fc32c BYTE_ORDER MSB_LAST FORMAT "%4.0" /end MEASUREMENT
/begin MEASUREMENT lam_bank_1.lsh_down_obd2.frc_obd2_lsh_down "Number of faults detected during valid diagnosis cycles" UWORD _CNV_A_R_LINEAR_____22_CM 1 100. 0. 1023. DISPLAY_IDENTIFIER FRC_OBD2_LSH_DOWN_1 ECU_ADDRESS 0x3fc32e BYTE_ORDER MSB_LAST FORMAT "%4.0" /end MEASUREMENT
/begin MEASUREMENT lam_bank_1.lsh_down_obd2.ctr_cycnr_r_obd2_lsh_down "Value of handshake counter for last valid resistance value used for diagnosis" UWORD _CNV_A_R_LINEAR_____1_CM 1 100. 0. 65535. DISPLAY_IDENTIFIER CTR_CYCNR_R_OBD2_LSH_DOWN_1 ECU_ADDRESS 0x3fc330 BYTE_ORDER MSB_LAST FORMAT "%5.0" /end MEASUREMENT
/begin MEASUREMENT lam_bank_1.lsh_down_obd2.r_down_ls_obd2_lsh_down "Most current upstream oxygen sensor internal resistance used for diagnosis cycle, Mode 6 information" UWORD _CNV_A_R_LINEAR_____1_CM 1 100. 0. 65535. DISPLAY_IDENTIFIER R_DOWN_LS_OBD2_LSH_DOWN_1 ECU_ADDRESS 0x3fc332 BYTE_ORDER MSB_LAST FORMAT "%5.0" /end MEASUREMENT
/begin MEASUREMENT lam_bank_1.lsh_down_obd2.temp_dif_obd2_lsh_down "Indicates difference in temperature between set operating temperature & exhaust gas at sensor location" UWORD _CNV_A_R_LINEAR_____14_CM 1 100. 0. 2047. DISPLAY_IDENTIFIER TEMP_DIF_OBD2_LSH_DOWN_1 ECU_ADDRESS 0x3fc336 BYTE_ORDER MSB_LAST FORMAT "%4.0" /end MEASUREMENT
/begin MEASUREMENT lam_bank_2.lsh_down_obd2.pow_int_obd2_lsh_down "Integral indicates measure of cooling energy of exhaust gas at sensor location" UWORD _CNV_A_R_LINEAR_____291_CM 1 100. 0. 65535. DISPLAY_IDENTIFIER POW_INT_OBD2_LSH_DOWN_2 ECU_ADDRESS 0x3fc68e BYTE_ORDER MSB_LAST FORMAT "%5.0" /end MEASUREMENT
/begin MEASUREMENT lam_bank_2.lsh_down_obd2.state_obd2_lsh_down "Indicates current phase of oxygen sensor heater OBDII diagnosis" UBYTE _CNV_S_9_STATE_OBD2_292_CM 1 100. 0. 8. DISPLAY_IDENTIFIER STATE_OBD2_LSH_DOWN_2 ECU_ADDRESS 0x3fc68c /end MEASUREMENT
/begin MEASUREMENT lam_bank_2.lsh_down_obd2.tcc_obd2_lsh_down "Number of completed valid diagnosis cycles" UWORD _CNV_A_R_LINEAR_____22_CM 1 100. 0. 1023. DISPLAY_IDENTIFIER TCC_OBD2_LSH_DOWN_2 ECU_ADDRESS 0x3fc690 BYTE_ORDER MSB_LAST FORMAT "%4.0" /end MEASUREMENT
/begin MEASUREMENT lam_bank_2.lsh_down_obd2.frc_obd2_lsh_down "Number of faults detected during valid diagnosis cycles" UWORD _CNV_A_R_LINEAR_____22_CM 1 100. 0. 1023. DISPLAY_IDENTIFIER FRC_OBD2_LSH_DOWN_2 ECU_ADDRESS 0x3fc692 BYTE_ORDER MSB_LAST FORMAT "%4.0" /end MEASUREMENT
/begin MEASUREMENT lam_bank_2.lsh_down_obd2.ctr_cycnr_r_obd2_lsh_down "Value of handshake counter for last valid resistance value used for diagnosis" UWORD _CNV_A_R_LINEAR_____1_CM 1 100. 0. 65535. DISPLAY_IDENTIFIER CTR_CYCNR_R_OBD2_LSH_DOWN_2 ECU_ADDRESS 0x3fc694 BYTE_ORDER MSB_LAST FORMAT "%5.0" /end MEASUREMENT
/begin MEASUREMENT lam_bank_2.lsh_down_obd2.r_down_ls_obd2_lsh_down "Most current upstream oxygen sensor internal resistance used for diagnosis cycle, Mode 6 information" UWORD _CNV_A_R_LINEAR_____1_CM 1 100. 0. 65535. DISPLAY_IDENTIFIER R_DOWN_LS_OBD2_LSH_DOWN_2 ECU_ADDRESS 0x3fc696 BYTE_ORDER MSB_LAST FORMAT "%5.0" /end MEASUREMENT
/begin MEASUREMENT lam_bank_2.lsh_down_obd2.temp_dif_obd2_lsh_down "Indicates difference in temperature between set operating temperature & exhaust gas at sensor location" UWORD _CNV_A_R_LINEAR_____14_CM 1 100. 0. 2047. DISPLAY_IDENTIFIER TEMP_DIF_OBD2_LSH_DOWN_2 ECU_ADDRESS 0x3fc69a BYTE_ORDER MSB_LAST FORMAT "%4.0" /end MEASUREMENT
/begin MEASUREMENT lv_err_chg_ls_down "Debounced error: downstream sensor of bank 1 and 2 interchanged" UBYTE _CNV_S_2_RANGE______2_R_CM 1 100. 0. 255. DISPLAY_IDENTIFIER LV_ERR_CHG_LS_DOWN ECU_ADDRESS 0x3fbb24 /end MEASUREMENT
/begin CHARACTERISTIC c_t_end_diag_chg_ls_up "Max. time to set LV_END_... = 1" VALUE 0x01834 _REC_VAL_20_u2 6553.5 _CNV_A_R_LINEAR_____24_CM 0. 6553.5 DISPLAY_IDENTIFIER C_T_END_DIAG_CHG_LS_UP FORMAT "%6.1" /end CHARACTERISTIC
/begin CHARACTERISTIC c_t_end_diag_chg_ls_down "Max. time to set LV_END_... = 1" VALUE 0x01832 _REC_VAL_20_u2 65535. _CNV_A_R_LINEAR_____30_CM 0. 65535. DISPLAY_IDENTIFIER C_T_END_DIAG_CHG_LS_DOWN FORMAT "%5.0" /end CHARACTERISTIC
/begin CHARACTERISTIC c_maf_int_diag_chg_ls_up "Max. MAF integral value when ERR_SYM_... ne \"NO_SYM\"" VALUE 0x0165c _REC_VAL_20_u2 1820.398 _CNV_A_R_LINEAR_____271_CM 0. 1820.398 DISPLAY_IDENTIFIER C_MAF_INT_DIAG_CHG_LS_UP FORMAT "%7.2" /end CHARACTERISTIC
/begin MEASUREMENT lv_err_chg_ls_up "Debounced error: upstream sensor of bank 1 and 2 interchanged" UBYTE _CNV_S_2_RANGE______2_R_CM 1 100. 0. 255. DISPLAY_IDENTIFIER LV_ERR_CHG_LS_UP ECU_ADDRESS 0x3fbb20 /end MEASUREMENT
/begin MEASUREMENT t_end_diag_chg_ls_up "Timer to set LV_END_...= 1" UWORD _CNV_A_R_LINEAR_____24_CM 1 100. 0. 6553.5 DISPLAY_IDENTIFIER T_END_DIAG_CHG_LS_UP ECU_ADDRESS 0x3fd732 BYTE_ORDER MSB_LAST FORMAT "%6.1" /end MEASUREMENT
/begin MEASUREMENT t_end_diag_chg_ls_down "Timer to set LV_END_...= 1" UWORD _CNV_A_R_LINEAR_____30_CM 1 100. 0. 65535. DISPLAY_IDENTIFIER T_END_DIAG_CHG_LS_DOWN ECU_ADDRESS 0x3fd734 BYTE_ORDER MSB_LAST FORMAT "%5.0" /end MEASUREMENT
/begin MEASUREMENT maf_int_diag_chg_ls_up "MAF integral value when ERR_SYM_...ne \"NO_SYM\"" UWORD _CNV_A_R_LINEAR_____271_CM 1 100. 0. 1820.398 DISPLAY_IDENTIFIER MAF_INT_DIAG_CHG_LS_UP ECU_ADDRESS 0x3fd730 BYTE_ORDER MSB_LAST FORMAT "%7.2" /end MEASUREMENT
/begin CHARACTERISTIC c_max_ti_lam_cor_chg_ls_up "Max. Threshold to detect a interchanged sensor" VALUE 0x0041e _REC_VAL_20_s2 99.99847412 _CNV_A_R_LINEAR_____109_CM -50. 49.99847412 DISPLAY_IDENTIFIER C_MAX_TI_LAM_COR_CHG_LS_UP FORMAT "%7.3" /end CHARACTERISTIC
/begin CHARACTERISTIC c_min_ti_lam_cor_chg_ls_up "Min. Threshold to detect a interchanged sensor" VALUE 0x0042c _REC_VAL_20_s2 99.99847412 _CNV_A_R_LINEAR_____109_CM -50. 49.99847412 DISPLAY_IDENTIFIER C_MIN_TI_LAM_COR_CHG_LS_UP FORMAT "%7.3" /end CHARACTERISTIC
/begin MEASUREMENT lv_inh_diag_chg_ls_up "inhibit diagnosis swapped upstream sensors" UBYTE _CNV_S_2_RANGE______0_CM 1 100. 0. 1. DISPLAY_IDENTIFIER LV_INH_DIAG_CHG_LS_UP ECU_ADDRESS 0x3fe4ed /end MEASUREMENT
/begin MEASUREMENT lv_inh_diag_chg_ls_down "inhibit diagnosis swapped downstream sensors" UBYTE _CNV_S_2_RANGE______0_CM 1 100. 0. 1. DISPLAY_IDENTIFIER LV_INH_DIAG_CHG_LS_DOWN ECU_ADDRESS 0x3fe4ee /end MEASUREMENT
/begin MEASUREMENT maf_kgh_mes_bas "Raw air-mass flow measured (without correction, to be used for diagnosis only)" UWORD _CNV_A_R_LINEAR_____113_CM 1 100. 0. 2047.96875 DISPLAY_IDENTIFIER MAF_KGH_MES_BAS ECU_ADDRESS 0x3fcf2c BYTE_ORDER MSB_LAST FORMAT "%7.2" /end MEASUREMENT
/begin MEASUREMENT maf_mes "Mass air flow per segment" UWORD _CNV_A_R_LINEAR_____106_CM 1 100. 0. 1389. DISPLAY_IDENTIFIER MAF_MES ECU_ADDRESS 0x3fcf2e BYTE_ORDER MSB_LAST FORMAT "%6.2" /end MEASUREMENT
/begin MEASUREMENT maf_kgh_mes "Mass air flow per segment measured" UWORD _CNV_A_R_LINEAR_____113_CM 1 100. 0. 2047.96875 DISPLAY_IDENTIFIER MAF_KGH_MES ECU_ADDRESS 0x3fcf2a BYTE_ORDER MSB_LAST FORMAT "%7.2" /end MEASUREMENT
/begin AXIS_PTS ldp_n__pq_sp_puls "" 0x10ef8 n _REC_AXS_20_u2 816. _CNV_A_R_LINEAR_____11_CM 6 0. 8160. DISPLAY_IDENTIFIER LDP_N__PQ_SP_PULS FORMAT "%4.0" /end AXIS_PTS
/begin CHARACTERISTIC ip_pq_sp_puls "PQ-threshold for LV_MAF_PULS" CURVE 0x0d5de _REC_CUR_20_u2_u2 0.99998474 _CNV_A_R_LINEAR_____37_CM 0. 0.99998474 DISPLAY_IDENTIFIER IP_PQ_SP_PULS FORMAT "%7.5"
 /begin AXIS_DESCR COM_AXIS n _CNV_A_R_LINEAR_____11_CM 6 0. 8160. FORMAT "%4.0" AXIS_PTS_REF ldp_n__pq_sp_puls /end AXIS_DESCR
/end CHARACTERISTIC
/begin CHARACTERISTIC c_pq_sp_hys_puls "Hysteresis for PQ-threshold for LV_MAF_PULS" VALUE 0x01748 _REC_VAL_20_u2 0.99998474 _CNV_A_R_LINEAR_____37_CM 0. 0.99998474 DISPLAY_IDENTIFIER C_PQ_SP_HYS_PULS FORMAT "%7.5" /end CHARACTERISTIC
/begin MEASUREMENT lv_maf_puls "Boolean for wrong air flow acquisition" UBYTE _CNV_S_2_RANGE______0_CM 1 100. 0. 1. DISPLAY_IDENTIFIER LV_MAF_PULS ECU_ADDRESS 0x3fdf93 /end MEASUREMENT
/begin MEASUREMENT maf_cyl_stk "Air mass flow out of the intake manifold per stroke" UWORD _CNV_A_R_LINEAR_____106_CM 1 100. 0. 1389. DISPLAY_IDENTIFIER MAF_CYL_STK ECU_ADDRESS 0x3fcf3c BYTE_ORDER MSB_LAST FORMAT "%6.2" /end MEASUREMENT
/begin MEASUREMENT maf_kgh_clc "Calculated value of MAF_KGH out of manifold model" UWORD _CNV_A_R_LINEAR_____113_CM 1 100. 0. 2047.96875 DISPLAY_IDENTIFIER MAF_KGH_CLC ECU_ADDRESS 0x3fcf36 BYTE_ORDER MSB_LAST FORMAT "%7.2" /end MEASUREMENT
/begin MEASUREMENT map_egr "Residual gas partial pressure in the manifold" UWORD _CNV_A_R_LINEAR_____49_CM 1 100. 0. 5434. DISPLAY_IDENTIFIER MAP_EGR ECU_ADDRESS 0x3fcf4c BYTE_ORDER MSB_LAST FORMAT "%7.2" /end MEASUREMENT
/begin MEASUREMENT map_egr_pred "Predicted residual gas partial manifold air pressure" UWORD _CNV_A_R_LINEAR_____49_CM 1 100. 0. 5434. DISPLAY_IDENTIFIER MAP_EGR_PRED ECU_ADDRESS 0x3fcf78 BYTE_ORDER MSB_LAST FORMAT "%7.2" /end MEASUREMENT
/begin MEASUREMENT map_fg_pred "Predicted fresh gas partial manifold air pressure" UWORD _CNV_A_R_LINEAR_____49_CM 1 100. 0. 5434. DISPLAY_IDENTIFIER MAP_FG_PRED ECU_ADDRESS 0x3fcf7a BYTE_ORDER MSB_LAST FORMAT "%7.2" /end MEASUREMENT
/begin MEASUREMENT map_pred "Predicted manifold air pressure" UWORD _CNV_A_R_LINEAR_____49_CM 1 100. 0. 5434. DISPLAY_IDENTIFIER MAP_PRED ECU_ADDRESS 0x3fcf76 BYTE_ORDER MSB_LAST FORMAT "%7.2" /end MEASUREMENT
/begin MEASUREMENT map_fg "Fresh gas partial pressure in the manifold" UWORD _CNV_A_R_LINEAR_____49_CM 1 100. 0. 5434. DISPLAY_IDENTIFIER MAP_FG ECU_ADDRESS 0x3fcf56 BYTE_ORDER MSB_LAST FORMAT "%7.2" /end MEASUREMENT
/begin MEASUREMENT pq "Pressure quotient at the throttle" UWORD _CNV_A_R_LINEAR_____37_CM 1 100. 0. 0.99998474 DISPLAY_IDENTIFIER PQ ECU_ADDRESS 0x3fcf54 BYTE_ORDER MSB_LAST FORMAT "%7.5" /end MEASUREMENT
/begin MEASUREMENT pq_egr "Pressure quotient at the EGR - valve" UWORD _CNV_A_R_LINEAR_____37_CM 1 100. 0. 0.99998474 DISPLAY_IDENTIFIER PQ_EGR ECU_ADDRESS 0x3fcf4e BYTE_ORDER MSB_LAST FORMAT "%7.5" /end MEASUREMENT
/begin MEASUREMENT pq_egr_estim "Estimated pressure quotient at the EGR - valve" UWORD _CNV_A_R_LINEAR_____37_CM 1 100. 0. 0.99998474 DISPLAY_IDENTIFIER PQ_EGR_ESTIM ECU_ADDRESS 0x3fcf82 BYTE_ORDER MSB_LAST FORMAT "%7.5" /end MEASUREMENT
/begin MEASUREMENT maf_thr "Air mass flow at the throttle" UWORD _CNV_A_R_LINEAR_____113_CM 1 100. 0. 2047.96875 DISPLAY_IDENTIFIER MAF_THR ECU_ADDRESS 0x3fcf38 BYTE_ORDER MSB_LAST FORMAT "%7.2" /end MEASUREMENT
/begin MEASUREMENT maf_egr "Air mass flow at the EGR -valve" UWORD _CNV_A_R_LINEAR_____113_CM 1 100. 0. 2047.96875 DISPLAY_IDENTIFIER MAF_EGR ECU_ADDRESS 0x3fcf4a BYTE_ORDER MSB_LAST FORMAT "%7.2" /end MEASUREMENT
/begin MEASUREMENT map_drv1 "First derivative of  intake  manifold pressure " SWORD _CNV_A_R_LINEAR_____326_CM 1 100. -82.91625999999999 82.91377 DISPLAY_IDENTIFIER MAP_DRV1 ECU_ADDRESS 0x3fcf5a BYTE_ORDER MSB_LAST FORMAT "%7.3" /end MEASUREMENT
/begin MEASUREMENT map_egr_drv1 "First derivative of  intake  manifold residual gas pressure " SWORD _CNV_A_R_LINEAR_____326_CM 1 100. -82.91625999999999 82.91377 DISPLAY_IDENTIFIER MAP_EGR_DRV1 ECU_ADDRESS 0x3fcf74 BYTE_ORDER MSB_LAST FORMAT "%5.3" /end MEASUREMENT
/begin MEASUREMENT maf_egr_con_1 "sqrt(2x/((x-1)*RA*TEG_EGR)) with x = kappa = 1.4" UWORD _CNV_A_R_LINEAR_____327_CM 1 100. 0. 2.06019e-002 DISPLAY_IDENTIFIER MAF_EGR_CON_1 ECU_ADDRESS 0x3fcf42 BYTE_ORDER MSB_LAST FORMAT "%8.7" /end MEASUREMENT
/begin MEASUREMENT maf_fac_ofs "Offset of the air flow equation for the throttle air mass flow" UWORD _CNV_A_R_LINEAR_____328_CM 1 100. 0. 8.880330000000001 DISPLAY_IDENTIFIER MAF_FAC_OFS ECU_ADDRESS 0x3fcf50 BYTE_ORDER MSB_LAST FORMAT "%6.4" /end MEASUREMENT
/begin MEASUREMENT maf_fac_ofs_egr "Offset of the air flow equation for the EGR air mass flow" UWORD _CNV_A_R_LINEAR_____328_CM 1 100. 0. 8.880330000000001 DISPLAY_IDENTIFIER MAF_FAC_OFS_EGR ECU_ADDRESS 0x3fcf44 BYTE_ORDER MSB_LAST FORMAT "%6.4" /end MEASUREMENT
/begin MEASUREMENT maf_fac_slop "Slope of the air flow equation for the throttle air mass flow" UWORD _CNV_A_R_LINEAR_____328_CM 1 100. 0. 8.880330000000001 DISPLAY_IDENTIFIER MAF_FAC_SLOP ECU_ADDRESS 0x3fcf52 BYTE_ORDER MSB_LAST FORMAT "%6.4" /end MEASUREMENT
/begin CHARACTERISTIC ip_maf_mdl_con_1__tia "Temperature influence air flow function at the throttle" CURVE 0x0c6b6 _REC_CUR_20_u2_u1 2.06019e-002 _CNV_A_R_LINEAR_____327_CM 0. 2.06019e-002 DISPLAY_IDENTIFIER IP_MAF_MDL_CON_1__TIA FORMAT "%8.7"
 /begin AXIS_DESCR COM_AXIS tia _CNV_A_R_LINEAR_____12_CM 8 -48. 142.5 FORMAT "%5.1" AXIS_PTS_REF ldpm_tia_maf_mdl_con_1 /end AXIS_DESCR
/end CHARACTERISTIC
/begin CHARACTERISTIC ip_maf_egr_con_1__teg_egr "Temperature influence air flow function at the EGR-Valve" CURVE 0x0c652 _REC_CUR_20_u2_u2 2.06019e-002 _CNV_A_R_LINEAR_____327_CM 0. 2.06019e-002 DISPLAY_IDENTIFIER IP_MAF_EGR_CON_1__TEG_EGR FORMAT "%8.7"
 /begin AXIS_DESCR COM_AXIS teg_egr _CNV_A_R_LINEAR_____7_CM 8 0. 2047. FORMAT "%7.2" AXIS_PTS_REF ldp_teg_egr_maf_egr_con_1 /end AXIS_DESCR
/end CHARACTERISTIC
/begin CHARACTERISTIC ip_pred_fac__n "Prediction factor" CURVE 0x00d64 _REC_CUR_20_u1_u1 7.96875 _CNV_A_R_LINEAR_____235_CM 0. 7.96875 DISPLAY_IDENTIFIER IP_PRED_FAC__N FORMAT "%4.2"
 /begin AXIS_DESCR COM_AXIS n_32 _CNV_A_R_LINEAR_____16_CM 6 0. 8160. FORMAT "%4.0" AXIS_PTS_REF ldpm_n_32_ar_red /end AXIS_DESCR
/end CHARACTERISTIC
/begin MEASUREMENT maf_cyl "Mass air flow out of intake manifold" UWORD _CNV_A_R_LINEAR_____113_CM 1 100. 0. 2047.96875 DISPLAY_IDENTIFIER MAF_CYL ECU_ADDRESS 0x3fcf3a BYTE_ORDER MSB_LAST FORMAT "%7.2" /end MEASUREMENT
/begin MEASUREMENT maf_fg_cyl "Fresh air mass flow in the cylinder" UWORD _CNV_A_R_LINEAR_____113_CM 1 100. 0. 2047.96875 DISPLAY_IDENTIFIER MAF_FG_CYL ECU_ADDRESS 0x3fcf62 BYTE_ORDER MSB_LAST FORMAT "%7.2" /end MEASUREMENT
/begin MEASUREMENT maf_fg_cyl_stk "Fresh air mass flow in the cylinder per stroke" UWORD _CNV_A_R_LINEAR_____106_CM 1 100. 0. 1389. DISPLAY_IDENTIFIER MAF_FG_CYL_STK ECU_ADDRESS 0x3fcf64 BYTE_ORDER MSB_LAST FORMAT "%7.2" /end MEASUREMENT
/begin MEASUREMENT fac_maf_max "Ratio between MAF und MAX_COR" UWORD _CNV_A_R_LINEAR_____21_CM 1 100. 0. 1.99996948 DISPLAY_IDENTIFIER FAC_MAF_MAX ECU_ADDRESS 0x3fcf68 BYTE_ORDER MSB_LAST FORMAT "%7.5" /end MEASUREMENT
/begin CHARACTERISTIC c_maf_mmv_dif_crlc "MAF moving mean value filtering factor" VALUE 0x00728 _REC_VAL_20_u1 9.960940000000002e-002 _CNV_A_R_LINEAR_____50_CM 0. 0.996094 DISPLAY_IDENTIFIER C_MAF_MMV_DIF_CRLC FORMAT "%5.3" /end CHARACTERISTIC
/begin MEASUREMENT maf_fac_slop_egr "Slope of the air flow equation for the EGR mass air flow" UWORD _CNV_A_R_LINEAR_____328_CM 1 100. 0. 8.880330000000001 DISPLAY_IDENTIFIER MAF_FAC_SLOP_EGR ECU_ADDRESS 0x3fcf46 BYTE_ORDER MSB_LAST FORMAT "%6.4" /end MEASUREMENT
/begin MEASUREMENT maf_mdl_con_1 "sqrt(2x/((x-1)*RA*TIA)) with x = kappa = 1.4" UWORD _CNV_A_R_LINEAR_____327_CM 1 100. 0. 2.06019e-002 DISPLAY_IDENTIFIER MAF_MDL_CON_1 ECU_ADDRESS 0x3fcf40 BYTE_ORDER MSB_LAST FORMAT "%8.7" /end MEASUREMENT
/begin MEASUREMENT maf_mdl_con_0 "sqrt(2x/((x-1)*RA*TIA)) with x = kappa = 1.4" UWORD _CNV_A_R_LINEAR_____329_CM 1 100. 0. 58352820. DISPLAY_IDENTIFIER MAF_MDL_CON_0 ECU_ADDRESS 0x3fcf3e BYTE_ORDER MSB_LAST FORMAT "%9.0" /end MEASUREMENT
/begin MEASUREMENT map "Manifold air pressure" UWORD _CNV_A_R_LINEAR_____49_CM 1 100. 0. 5434. DISPLAY_IDENTIFIER MAP ECU_ADDRESS 0x3fcf58 BYTE_ORDER MSB_LAST FORMAT "%7.2" /end MEASUREMENT
/begin MEASUREMENT maf_kgh "Mass air flow per segment" UWORD _CNV_A_R_LINEAR_____113_CM 1 100. 0. 2047.96875 DISPLAY_IDENTIFIER MAF_KGH ECU_ADDRESS 0x3fcf5e BYTE_ORDER MSB_LAST FORMAT "%7.2" /end MEASUREMENT
/begin MEASUREMENT maf_dif "Mass air flow difference per segment" SWORD _CNV_A_R_LINEAR_____255_CM 1 100. -694.5 694.478806 DISPLAY_IDENTIFIER MAF_DIF ECU_ADDRESS 0x3fcf5c BYTE_ORDER MSB_LAST FORMAT "%7.2" /end MEASUREMENT
/begin MEASUREMENT maf_isa_fac_ofs "offset of the air flow equation for the throttle air mass flow for ISA" UWORD _CNV_A_R_LINEAR_____328_CM 1 100. 0. 8.880330000000001 DISPLAY_IDENTIFIER MAF_ISA_FAC_OFS ECU_ADDRESS 0x3fcf6c BYTE_ORDER MSB_LAST FORMAT "%6.4" /end MEASUREMENT
/begin MEASUREMENT maf_isa_fac_slop "slope of the air flow equation for the throttle air mass flow for ISA" UWORD _CNV_A_R_LINEAR_____328_CM 1 100. 0. 8.880330000000001 DISPLAY_IDENTIFIER MAF_ISA_FAC_SLOP ECU_ADDRESS 0x3fcf6e BYTE_ORDER MSB_LAST FORMAT "%6.4" /end MEASUREMENT
/begin MEASUREMENT maf_thr_isa_tot "total air mass flow at the throttle and ISA valve" UWORD _CNV_A_R_LINEAR_____113_CM 1 100. 0. 2047.96875 DISPLAY_IDENTIFIER MAF_THR_ISA_TOT ECU_ADDRESS 0x3fcf72 BYTE_ORDER MSB_LAST FORMAT "%7.2" /end MEASUREMENT
/begin MEASUREMENT maf_isa "air mass flow at the ISA valve" UWORD _CNV_A_R_LINEAR_____113_CM 1 100. 0. 2047.96875 DISPLAY_IDENTIFIER MAF_ISA ECU_ADDRESS 0x3fcf70 BYTE_ORDER MSB_LAST FORMAT "%7.2" /end MEASUREMENT
/begin AXIS_PTS ldpm_tia_maf_mdl_con_1 "" 0x0825c tia _REC_AXS_20_u1 190.5 _CNV_A_R_LINEAR_____12_CM 8 -48. 142.5 DISPLAY_IDENTIFIER LDPM_TIA_MAF_MDL_CON_1 FORMAT "%5.1" /end AXIS_PTS
/begin AXIS_PTS ldp_teg_egr_maf_egr_con_1 "" 0x111dc teg_egr _REC_AXS_20_u2 2047. _CNV_A_R_LINEAR_____7_CM 8 0. 2047. DISPLAY_IDENTIFIER LDP_TEG_EGR_MAF_EGR_CON_1 FORMAT "%7.2" /end AXIS_PTS
/begin AXIS_PTS ldpm_n_32_ar_red "" 0x0135e n_32 _REC_AXS_20_u1 816. _CNV_A_R_LINEAR_____16_CM 6 0. 8160. DISPLAY_IDENTIFIER LDPM_N_32_AR_RED FORMAT "%4.0" /end AXIS_PTS
/begin CHARACTERISTIC id_maf_fac_ofs__pq_estim "Offset air flow function" CURVE 0x083b4 _REC_CUR_20_u2_u2 8.880330000000001 _CNV_A_R_LINEAR_____328_CM 0. 8.880330000000001 DISPLAY_IDENTIFIER ID_MAF_FAC_OFS__PQ_ESTIM FORMAT "%6.4"
 /begin AXIS_DESCR COM_AXIS pq_estim _CNV_A_R_LINEAR_____37_CM 16 0. 0.99998474 FORMAT "%7.5" AXIS_PTS_REF ldpm_pq_estim_id_maf_fac_ofs /end AXIS_DESCR
/end CHARACTERISTIC
/begin CHARACTERISTIC id_maf_fac_slop__pq_estim "Slope air flow function" CURVE 0x083d4 _REC_CUR_20_u2_u2 8.880330000000001 _CNV_A_R_LINEAR_____328_CM 0. 8.880330000000001 DISPLAY_IDENTIFIER ID_MAF_FAC_SLOP__PQ_ESTIM FORMAT "%6.4"
 /begin AXIS_DESCR COM_AXIS pq_estim _CNV_A_R_LINEAR_____37_CM 16 0. 0.99998474 FORMAT "%7.5" AXIS_PTS_REF ldpm_pq_estim_id_maf_fac_ofs /end AXIS_DESCR
/end CHARACTERISTIC
/begin MEASUREMENT egr_ratio "MAF_EGR/MAF_CYL" UWORD _CNV_A_R_LINEAR_____9_CM 1 100. 0. 99.99847412 DISPLAY_IDENTIFIER EGR_RATIO ECU_ADDRESS 0x3fcf48 BYTE_ORDER MSB_LAST /end MEASUREMENT
/begin MEASUREMENT lv_h_load_maf_thr "logical value for 'very high load'" UBYTE _CNV_S_2_RANGE______0_CM 1 100. 0. 1. DISPLAY_IDENTIFIER LV_H_LOAD_MAF_THR ECU_ADDRESS 0x3fdf99 /end MEASUREMENT
/begin CHARACTERISTIC c_pq_thd "Calculation threshold for manifold pressure; typical value 0,9900 (FD70H)" VALUE 0x01750 _REC_VAL_20_u2 0.99998474 _CNV_A_R_LINEAR_____37_CM 0. 0.99998474 DISPLAY_IDENTIFIER C_PQ_THD FORMAT "%7.5" /end CHARACTERISTIC
/begin CHARACTERISTIC c_pq_thd_hys "hysteresis for calculation threshold for MAP and MAF" VALUE 0x01752 _REC_VAL_20_u2 0.99998474 _CNV_A_R_LINEAR_____37_CM 0. 0.99998474 DISPLAY_IDENTIFIER C_PQ_THD_HYS FORMAT "%7.5" /end CHARACTERISTIC
/begin MEASUREMENT pq_estim "" UWORD _CNV_A_R_LINEAR_____37_CM 1 100. 0. 0.99998474 DISPLAY_IDENTIFIER PQ_ESTIM ECU_ADDRESS 0x3fcf7e BYTE_ORDER MSB_LAST FORMAT "%7.5" /end MEASUREMENT
/begin MEASUREMENT pq_isa_estim "estimated pressure quotient at idle speed actuator" UWORD _CNV_A_R_LINEAR_____37_CM 1 100. 0. 0.99998474 DISPLAY_IDENTIFIER PQ_ISA_ESTIM ECU_ADDRESS 0x3fcf80 BYTE_ORDER MSB_LAST FORMAT "%7.5" /end MEASUREMENT
/begin MEASUREMENT map_estim "estimated manifold pressure" UWORD _CNV_A_R_LINEAR_____49_CM 1 100. 0. 5434. DISPLAY_IDENTIFIER MAP_ESTIM ECU_ADDRESS 0x3fcf7c BYTE_ORDER MSB_LAST FORMAT "%7.2" /end MEASUREMENT
/begin CHARACTERISTIC c_ra "Error detection threshold for maximum deviation" VALUE 0x0176a _REC_VAL_20_u2 574. _CNV_A_R_LINEAR_____330_CM 0. 574. DISPLAY_IDENTIFIER C_RA FORMAT "%5.1" /end CHARACTERISTIC
/begin AXIS_PTS ldpm_maf_mes__vol_im "" 0x117e0 maf_mes _REC_AXS_20_u2 1389. _CNV_A_R_LINEAR_____106_CM 6 0. 1389. DISPLAY_IDENTIFIER LDPM_MAF_MES__VOL_IM FORMAT "%7.2" /end AXIS_PTS
/begin CHARACTERISTIC ip_vol_im_neg "effective intake manifold volume at decreasing load in PL and ST" MAP 0x107c6 _REC_MAP_20_u2_u2_u1 48.34583154310096 _CNV_A_R_LINEAR_____331_CM 3.68860679518273e-003 241.7328463223 DISPLAY_IDENTIFIER IP_VOL_IM_NEG FORMAT "%7.3"
 /begin AXIS_DESCR COM_AXIS maf_mes _CNV_A_R_LINEAR_____106_CM 6 0. 1389. FORMAT "%7.2" AXIS_PTS_REF ldpm_maf_mes__vol_im /end AXIS_DESCR
 /begin AXIS_DESCR COM_AXIS n_32 _CNV_A_R_LINEAR_____16_CM 8 0. 8160. FORMAT "%4.0" AXIS_PTS_REF ldpm_n_32__vol_im /end AXIS_DESCR
/end CHARACTERISTIC
/begin CHARACTERISTIC ip_vol_im_is "effective intake manifold volume at increasing load in IS, PU and PUC" MAP 0x10736 _REC_MAP_20_u2_u2_u1 48.34583154310096 _CNV_A_R_LINEAR_____331_CM 3.68860679518273e-003 241.7328463223 DISPLAY_IDENTIFIER IP_VOL_IM_IS FORMAT "%7.3"
 /begin AXIS_DESCR COM_AXIS maf_mes _CNV_A_R_LINEAR_____106_CM 6 0. 1389. FORMAT "%7.2" AXIS_PTS_REF ldpm_maf_mes__vol_im /end AXIS_DESCR
 /begin AXIS_DESCR COM_AXIS n_32 _CNV_A_R_LINEAR_____16_CM 6 0. 8160. FORMAT "%4.0" AXIS_PTS_REF ldpm_n_32__vol_im_is /end AXIS_DESCR
/end CHARACTERISTIC
/begin CHARACTERISTIC ip_vol_im "effective intake manifold volume at increasing load in PL and ST" MAP 0x106d6 _REC_MAP_20_u2_u2_u1 48.34583154310096 _CNV_A_R_LINEAR_____331_CM 3.68860679518273e-003 241.7328463223 DISPLAY_IDENTIFIER IP_VOL_IM FORMAT "%7.3"
 /begin AXIS_DESCR COM_AXIS maf_mes _CNV_A_R_LINEAR_____106_CM 6 0. 1389. FORMAT "%7.2" AXIS_PTS_REF ldpm_maf_mes__vol_im /end AXIS_DESCR
 /begin AXIS_DESCR COM_AXIS n_32 _CNV_A_R_LINEAR_____16_CM 8 0. 8160. FORMAT "%4.0" AXIS_PTS_REF ldpm_n_32__vol_im /end AXIS_DESCR
/end CHARACTERISTIC
/begin CHARACTERISTIC ip_vol_im_is_neg "effective intake manifold volume at decreasing load in IS, PU and PUC" MAP 0x1077e _REC_MAP_20_u2_u2_u1 48.34583154310096 _CNV_A_R_LINEAR_____331_CM 3.68860679518273e-003 241.7328463223 DISPLAY_IDENTIFIER IP_VOL_IM_IS_NEG FORMAT "%7.3"
 /begin AXIS_DESCR COM_AXIS maf_mes _CNV_A_R_LINEAR_____106_CM 6 0. 1389. FORMAT "%7.2" AXIS_PTS_REF ldpm_maf_mes__vol_im /end AXIS_DESCR
 /begin AXIS_DESCR COM_AXIS n_32 _CNV_A_R_LINEAR_____16_CM 6 0. 8160. FORMAT "%4.0" AXIS_PTS_REF ldpm_n_32__vol_im_is /end AXIS_DESCR
/end CHARACTERISTIC
/begin MEASUREMENT maf "Air mass (predicted) for calculation of basic fuel injection" UWORD _CNV_A_R_LINEAR_____106_CM 1 100. 0. 1389. DISPLAY_IDENTIFIER MAF ECU_ADDRESS 0x3fcf34 BYTE_ORDER MSB_LAST FORMAT "%6.2" /end MEASUREMENT
/begin MEASUREMENT vol_im "effective intake manifold volume" UWORD _CNV_A_R_LINEAR_____331_CM 1 100. 3.68860679518273e-003 241.7328463223 DISPLAY_IDENTIFIER VOL_IM ECU_ADDRESS 0x3fcf8e BYTE_ORDER MSB_LAST FORMAT "%7.3" /end MEASUREMENT
/begin AXIS_PTS ldpm_n_32__vol_im "" 0x080c3 n_32 _REC_AXS_20_u1 8160. _CNV_A_R_LINEAR_____16_CM 8 0. 8160. DISPLAY_IDENTIFIER LDPM_N_32__VOL_IM FORMAT "%4.0" /end AXIS_PTS
/begin AXIS_PTS ldpm_n_32__vol_im_is "" 0x01357 n_32 _REC_AXS_20_u1 8160. _CNV_A_R_LINEAR_____16_CM 6 0. 8160. DISPLAY_IDENTIFIER LDPM_N_32__VOL_IM_IS FORMAT "%4.0" /end AXIS_PTS
/begin CHARACTERISTIC c_maf_mmv_hys "Threshold for detecting raising MAF_MMV" VALUE 0x016b6 _REC_VAL_20_u2 694.5 _CNV_A_R_LINEAR_____332_CM 0. 694.5 DISPLAY_IDENTIFIER C_MAF_MMV_HYS FORMAT "%6.2" /end CHARACTERISTIC
/begin MEASUREMENT maf_mmv "MAF moving mean value" UWORD _CNV_A_R_LINEAR_____106_CM 1 100. 0. 1389. DISPLAY_IDENTIFIER MAF_MMV ECU_ADDRESS 0x3fcf60 BYTE_ORDER MSB_LAST FORMAT "%6.2" /end MEASUREMENT
/begin AXIS_PTS ldp_pq__ip_pq_isa "" 0x110a4 online_dummy _REC_AXS_20_u2 0.99998474 _CNV_A_R_LINEAR_____37_CM 16 0. 0.99998474 DISPLAY_IDENTIFIER LDP_PQ__IP_PQ_ISA FORMAT "%7.5" /end AXIS_PTS
/begin AXIS_PTS ldp_ar_red__ip_pq_isa "" 0x1092c online_dummy _REC_AXS_20_u2 58.592855 _CNV_A_R_LINEAR_____333_CM 8 0. 58.592855 DISPLAY_IDENTIFIER LDP_AR_RED__IP_PQ_ISA FORMAT "%7.4" /end AXIS_PTS
/begin CHARACTERISTIC ip_pq_isa "correction map for pressure quotient at ISA" MAP 0x0d4de _REC_MAP_20_u2_u2_u2 0.99998474 _CNV_A_R_LINEAR_____37_CM 0. 0.99998474 DISPLAY_IDENTIFIER IP_PQ_ISA FORMAT "%7.5"
 /begin AXIS_DESCR COM_AXIS online_dummy _CNV_A_R_LINEAR_____37_CM 16 0. 0.99998474 FORMAT "%7.5" AXIS_PTS_REF ldp_pq__ip_pq_isa /end AXIS_DESCR
 /begin AXIS_DESCR COM_AXIS online_dummy _CNV_A_R_LINEAR_____333_CM 8 0. 58.592855 FORMAT "%7.4" AXIS_PTS_REF ldp_ar_red__ip_pq_isa /end AXIS_DESCR
/end CHARACTERISTIC
/begin MEASUREMENT t_seg_imm "segment-time for intake manifold model" UWORD _CNV_A_R_LINEAR_____198_CM 1 100. 0. 262.14 DISPLAY_IDENTIFIER T_SEG_IMM ECU_ADDRESS 0x3fcf6a BYTE_ORDER MSB_LAST FORMAT "%7.3" /end MEASUREMENT
/begin CHARACTERISTIC ip_t_vim_eff_vol "transition time volumetric efficiency at VIM switching" CURVE 0x00e35 _REC_CUR_20_u1_u1 2.55 _CNV_A_R_LINEAR_____4_CM 0. 2.55 DISPLAY_IDENTIFIER IP_T_VIM_EFF_VOL FORMAT "%4.2"
 /begin AXIS_DESCR COM_AXIS n_32 _CNV_A_R_LINEAR_____16_CM 2 0. 8160. FORMAT "%4.0" AXIS_PTS_REF ldp_n_32__ip_t_vim_eff_vol /end AXIS_DESCR
/end CHARACTERISTIC
/begin AXIS_PTS ldp_n_32__ip_t_vim_eff_vol "" 0x0102e n_32 _REC_AXS_20_u1 8160. _CNV_A_R_LINEAR_____16_CM 2 0. 8160. DISPLAY_IDENTIFIER LDP_N_32__IP_T_VIM_EFF_VOL FORMAT "%4.0" /end AXIS_PTS
/begin CHARACTERISTIC ip_eff_vol_slop_cam_in_vim " Slope of the cylinder air-mass flow dependant on intake cam phasing, VIM_AV = 100%" MAP 0x0a22a _REC_MAP_20_u2_u2_u2 12.05964 _CNV_A_R_LINEAR_____346_CM -6.029912009 6.029727991 DISPLAY_IDENTIFIER IP_EFF_VOL_SLOP_CAM_IN_VIM FORMAT "%7.4"
 /begin AXIS_DESCR COM_AXIS n _CNV_A_R_LINEAR_____11_CM 18 0. 8160. FORMAT "%4.0" AXIS_PTS_REF ldpm_n__eff_vol /end AXIS_DESCR
 /begin AXIS_DESCR COM_AXIS cam_av_mv_in _CNV_A_R_LINEAR_____347_CM 12 -768. 767.9765625 FORMAT "%7.2" AXIS_PTS_REF ldpm_cam_av_mv_in__eff_vol /end AXIS_DESCR
/end CHARACTERISTIC
/begin CHARACTERISTIC ip_eff_vol_slop_cam_vo_vim "Slope of the cylinder air-mass flow dependant on valve overlap, VIM_AV = 100%" MAP 0x0a58a _REC_MAP_20_u2_u2_u1 12.05964 _CNV_A_R_LINEAR_____346_CM -6.029912009 6.029727991 DISPLAY_IDENTIFIER IP_EFF_VOL_SLOP_CAM_VO_VIM FORMAT "%7.4"
 /begin AXIS_DESCR COM_AXIS n _CNV_A_R_LINEAR_____11_CM 18 0. 8160. FORMAT "%4.0" AXIS_PTS_REF ldpm_n__eff_vol /end AXIS_DESCR
 /begin AXIS_DESCR COM_AXIS vo _CNV_A_R_LINEAR_____82_CM 12 0. 95.625 FORMAT "%5.2" AXIS_PTS_REF ldpm_vo__eff_vol /end AXIS_DESCR
/end CHARACTERISTIC
/begin CHARACTERISTIC ip_eff_vol_ofs_vim "Offset of the cylinder air-mass flow, VIM_AV = 100%" MAP 0x09ebe _REC_MAP_20_u2_u2_u1 2047.96875 _CNV_A_R_LINEAR_____113_CM 0. 2047.96875 DISPLAY_IDENTIFIER IP_EFF_VOL_OFS_VIM FORMAT "%6.2"
 /begin AXIS_DESCR COM_AXIS n _CNV_A_R_LINEAR_____11_CM 18 0. 8160. FORMAT "%4.0" AXIS_PTS_REF ldpm_n__eff_vol /end AXIS_DESCR
 /begin AXIS_DESCR COM_AXIS vo _CNV_A_R_LINEAR_____82_CM 12 0. 95.625 FORMAT "%5.2" AXIS_PTS_REF ldpm_vo__eff_vol /end AXIS_DESCR
/end CHARACTERISTIC
/begin MEASUREMENT eff_vol_slop "slope of the volumetric efficiency" UWORD _CNV_A_R_LINEAR_____348_CM 1 100. 0. 12.05964 DISPLAY_IDENTIFIER EFF_VOL_SLOP ECU_ADDRESS 0x3fcffe BYTE_ORDER MSB_LAST FORMAT "%7.4" /end MEASUREMENT
/begin CHARACTERISTIC ip_eff_vol_ofs "Offset of the cylinder air-mass flow, VIM_AV = 0%" MAP 0x09cde _REC_MAP_20_u2_u2_u1 2047.96875 _CNV_A_R_LINEAR_____113_CM 0. 2047.96875 DISPLAY_IDENTIFIER IP_EFF_VOL_OFS FORMAT "%6.2"
 /begin AXIS_DESCR COM_AXIS n _CNV_A_R_LINEAR_____11_CM 18 0. 8160. FORMAT "%4.0" AXIS_PTS_REF ldpm_n__eff_vol /end AXIS_DESCR
 /begin AXIS_DESCR COM_AXIS vo _CNV_A_R_LINEAR_____82_CM 12 0. 95.625 FORMAT "%5.2" AXIS_PTS_REF ldpm_vo__eff_vol /end AXIS_DESCR
/end CHARACTERISTIC
/begin CHARACTERISTIC ip_eff_vol_ofs_amp "Ambient pressure correction of the offset cylinder mass air flow" CURVE 0x09e8e _REC_CUR_20_u2_u2 1.99996948 _CNV_A_R_LINEAR_____21_CM 0. 1.99996948 DISPLAY_IDENTIFIER IP_EFF_VOL_OFS_AMP FORMAT "%7.5"
 /begin AXIS_DESCR COM_AXIS amp _CNV_A_R_LINEAR_____49_CM 6 0. 5434. FORMAT "%7.2" AXIS_PTS_REF ldpm_amp__eff_vol_amp /end AXIS_DESCR
/end CHARACTERISTIC
/begin CHARACTERISTIC ip_amp_dec__maf_cyl "pressure decrease in the air cleaner ( max. Value 100 hPa)" CURVE 0x01aaa _REC_CUR_20_u2_u2 5434. _CNV_A_R_LINEAR_____49_CM 0. 5434. DISPLAY_IDENTIFIER IP_AMP_DEC__MAF_CYL FORMAT "%7.2"
 /begin AXIS_DESCR COM_AXIS maf_cyl _CNV_A_R_LINEAR_____113_CM 4 0. 2047.96875 FORMAT "%6.2" AXIS_PTS_REF ldp_maf_cyl_amp_dec /end AXIS_DESCR
/end CHARACTERISTIC
/begin CHARACTERISTIC lc_amp_inp_ena "Default logical variable enabled for the input of the airfilter" VALUE 0x00f00 _REC_VAL_20_u1 1. _CNV_S_2_RANGE______0_CM 0. 1. DISPLAY_IDENTIFIER LC_AMP_INP_ENA /end CHARACTERISTIC
/begin MEASUREMENT prs_up_thr "Pressure upstream the throttle" UWORD _CNV_A_R_LINEAR_____49_CM 1 100. 0. 5434. DISPLAY_IDENTIFIER PRS_UP_THR ECU_ADDRESS 0x3fcff8 BYTE_ORDER MSB_LAST FORMAT "%7.2" /end MEASUREMENT
/begin CHARACTERISTIC c_tcyl_stnd "standard temperature in cylinder" VALUE 0x008af _REC_VAL_20_u1 28.575 _CNV_A_R_LINEAR_____12_CM -48. 142.5 DISPLAY_IDENTIFIER C_TCYL_STND FORMAT "%5.1" /end CHARACTERISTIC
/begin CHARACTERISTIC c_tco_stnd "standard coolant temperature" VALUE 0x0089b _REC_VAL_20_u1 28.575 _CNV_A_R_LINEAR_____12_CM -48. 142.5 DISPLAY_IDENTIFIER C_TCO_STND FORMAT "%5.1" /end CHARACTERISTIC
/begin CHARACTERISTIC c_tia_im_stnd "standard intake air temperature" VALUE 0x008ce _REC_VAL_20_u1 28.575 _CNV_A_R_LINEAR_____12_CM -48. 142.5 DISPLAY_IDENTIFIER C_TIA_IM_STND FORMAT "%5.1" /end CHARACTERISTIC
/begin MEASUREMENT prs_up_thr_max "Maximum pressure upstream the throttle" UWORD _CNV_A_R_LINEAR_____49_CM 1 100. 0. 5434. DISPLAY_IDENTIFIER PRS_UP_THR_MAX ECU_ADDRESS 0x3fcffa BYTE_ORDER MSB_LAST FORMAT "%7.2" /end MEASUREMENT
/begin MEASUREMENT eff_vol_temp_cor "volumetric efficiency correction factor due to temperature effects" UWORD _CNV_A_R_LINEAR_____21_CM 1 100. 0. 1.99996948 DISPLAY_IDENTIFIER EFF_VOL_TEMP_COR ECU_ADDRESS 0x3fd00c BYTE_ORDER MSB_LAST FORMAT "%7.5" /end MEASUREMENT
/begin MEASUREMENT eff_vol_temp_cor_mmv "filtered volumetric efficiency correction factor due to temperature effects" UWORD _CNV_A_R_LINEAR_____21_CM 1 100. 0. 1.99996948 DISPLAY_IDENTIFIER EFF_VOL_TEMP_COR_MMV ECU_ADDRESS 0x3fd00e BYTE_ORDER MSB_LAST FORMAT "%7.5" /end MEASUREMENT
/begin CHARACTERISTIC ip_eff_vol_slop_cam_vo "Slope of the cylinder air-mass flow dependant on valve overlap, VIM_AV = 0%" MAP 0x0a3da _REC_MAP_20_u2_u2_u1 12.05964 _CNV_A_R_LINEAR_____346_CM -6.029912009 6.029727991 DISPLAY_IDENTIFIER IP_EFF_VOL_SLOP_CAM_VO FORMAT "%7.4"
 /begin AXIS_DESCR COM_AXIS n _CNV_A_R_LINEAR_____11_CM 18 0. 8160. FORMAT "%4.0" AXIS_PTS_REF ldpm_n__eff_vol /end AXIS_DESCR
 /begin AXIS_DESCR COM_AXIS vo _CNV_A_R_LINEAR_____82_CM 12 0. 95.625 FORMAT "%5.2" AXIS_PTS_REF ldpm_vo__eff_vol /end AXIS_DESCR
/end CHARACTERISTIC
/begin CHARACTERISTIC ip_eff_vol_slop_cam_in "Slope of the cylinder air-mass flow dependant on intake cam phasing, VIM_AV = 0%" MAP 0x0a07a _REC_MAP_20_u2_u2_u2 12.05964 _CNV_A_R_LINEAR_____346_CM -6.029912009 6.029727991 DISPLAY_IDENTIFIER IP_EFF_VOL_SLOP_CAM_IN FORMAT "%7.4"
 /begin AXIS_DESCR COM_AXIS n _CNV_A_R_LINEAR_____11_CM 18 0. 8160. FORMAT "%4.0" AXIS_PTS_REF ldpm_n__eff_vol /end AXIS_DESCR
 /begin AXIS_DESCR COM_AXIS cam_av_mv_in _CNV_A_R_LINEAR_____347_CM 12 -768. 767.9765625 FORMAT "%7.2" AXIS_PTS_REF ldpm_cam_av_mv_in__eff_vol /end AXIS_DESCR
/end CHARACTERISTIC
/begin CHARACTERISTIC ip_crlc_eff_vol_temp_cor "Volumetric efficiency filtering" CURVE 0x00a58 _REC_CUR_20_u1_u1 0.9960940000000002 _CNV_A_R_LINEAR_____50_CM 0. 0.996094 DISPLAY_IDENTIFIER IP_CRLC_EFF_VOL_TEMP_COR FORMAT "%5.3"
 /begin AXIS_DESCR COM_AXIS n_32 _CNV_A_R_LINEAR_____16_CM 6 0. 8160. FORMAT "%4.0" AXIS_PTS_REF ldp_n_32_ip_crlc_eff_vol_temp /end AXIS_DESCR
/end CHARACTERISTIC
/begin CHARACTERISTIC ip_eff_tco_fac__n_32__maf "Volumetric efficiency weighting factor versus cooling temperature" MAP 0x04b7e _REC_MAP_20_u1_u1_u2 0.9960940000000002 _CNV_A_R_LINEAR_____50_CM 0. 0.996094 DISPLAY_IDENTIFIER IP_EFF_TCO_FAC__N_32__MAF FORMAT "%5.3"
 /begin AXIS_DESCR COM_AXIS n_32 _CNV_A_R_LINEAR_____16_CM 8 0. 8160. FORMAT "%4.0" AXIS_PTS_REF ldpm_n_32__eff_vol_cor /end AXIS_DESCR
 /begin AXIS_DESCR COM_AXIS maf _CNV_A_R_LINEAR_____106_CM 8 0. 1389. FORMAT "%7.2" AXIS_PTS_REF ldpm_maf__eff_vol_cor /end AXIS_DESCR
/end CHARACTERISTIC
/begin CHARACTERISTIC ip_eff_tia_im_fac__n_32__maf "Volumetric effiency weighting factor versus intake manifold gas temperature" MAP 0x04bbe _REC_MAP_20_u1_u1_u2 0.9960940000000002 _CNV_A_R_LINEAR_____50_CM 0. 0.996094 DISPLAY_IDENTIFIER IP_EFF_TIA_IM_FAC__N_32__MAF FORMAT "%5.3"
 /begin AXIS_DESCR COM_AXIS n_32 _CNV_A_R_LINEAR_____16_CM 8 0. 8160. FORMAT "%4.0" AXIS_PTS_REF ldpm_n_32__eff_vol_cor /end AXIS_DESCR
 /begin AXIS_DESCR COM_AXIS maf _CNV_A_R_LINEAR_____106_CM 8 0. 1389. FORMAT "%7.2" AXIS_PTS_REF ldpm_maf__eff_vol_cor /end AXIS_DESCR
/end CHARACTERISTIC
/begin CHARACTERISTIC ip_eff_vol_slop_amp "Ambient pressure correction of the slope cylinder mass air flow" CURVE 0x0a06e _REC_CUR_20_u2_u2 1.99996948 _CNV_A_R_LINEAR_____21_CM 0. 1.99996948 DISPLAY_IDENTIFIER IP_EFF_VOL_SLOP_AMP FORMAT "%7.5"
 /begin AXIS_DESCR COM_AXIS amp _CNV_A_R_LINEAR_____49_CM 6 0. 5434. FORMAT "%7.2" AXIS_PTS_REF ldpm_amp__eff_vol_amp /end AXIS_DESCR
/end CHARACTERISTIC
/begin CHARACTERISTIC ip_eff_vol_ofs_max "Offset of gasflow into cylinder at WOT and standard conditions" CURVE 0x09e9a _REC_CUR_20_u2_u2 2047.96875 _CNV_A_R_LINEAR_____113_CM 0. 2047.96875 DISPLAY_IDENTIFIER IP_EFF_VOL_OFS_MAX FORMAT "%7.2"
 /begin AXIS_DESCR COM_AXIS n _CNV_A_R_LINEAR_____11_CM 18 0. 8160. FORMAT "%4.0" AXIS_PTS_REF ldpm_n__eff_vol /end AXIS_DESCR
/end CHARACTERISTIC
/begin CHARACTERISTIC ip_eff_vol_slop_max "Slope of gasflow into cylinder at WOT and standard conditions" CURVE 0x0a73a _REC_CUR_20_u2_u2 12.05964 _CNV_A_R_LINEAR_____348_CM 0. 12.05964 DISPLAY_IDENTIFIER IP_EFF_VOL_SLOP_MAX FORMAT "%7.4"
 /begin AXIS_DESCR COM_AXIS n _CNV_A_R_LINEAR_____11_CM 18 0. 8160. FORMAT "%4.0" AXIS_PTS_REF ldpm_n__eff_vol /end AXIS_DESCR
/end CHARACTERISTIC
/begin MEASUREMENT eff_vol_ofs_max_cor "max possible offset of the volumetric efficiency" UWORD _CNV_A_R_LINEAR_____113_CM 1 100. 0. 2047.96875 DISPLAY_IDENTIFIER EFF_VOL_OFS_MAX_COR ECU_ADDRESS 0x3fd000 BYTE_ORDER MSB_LAST FORMAT "%7.2" /end MEASUREMENT
/begin MEASUREMENT eff_vol_ofs "offset of the volumetric efficiency" UWORD _CNV_A_R_LINEAR_____113_CM 1 100. 0. 2047.96875 DISPLAY_IDENTIFIER EFF_VOL_OFS ECU_ADDRESS 0x3fcffc BYTE_ORDER MSB_LAST FORMAT "%7.2" /end MEASUREMENT
/begin MEASUREMENT eff_vol_slop_max_cor "max possible slope of the volumetric efficiency" UWORD _CNV_A_R_LINEAR_____348_CM 1 100. 0. 12.05964 DISPLAY_IDENTIFIER EFF_VOL_SLOP_MAX_COR ECU_ADDRESS 0x3fd002 BYTE_ORDER MSB_LAST FORMAT "%7.4" /end MEASUREMENT
/begin AXIS_PTS ldp_maf_cyl_amp_dec "" 0x10c0a maf_cyl _REC_AXS_20_u2 2047.96875 _CNV_A_R_LINEAR_____113_CM 4 0. 2047.96875 DISPLAY_IDENTIFIER LDP_MAF_CYL_AMP_DEC FORMAT "%6.2" /end AXIS_PTS
/begin AXIS_PTS ldpm_vo__eff_vol "" 0x082b9 vo _REC_AXS_20_u1 95.625 _CNV_A_R_LINEAR_____82_CM 12 0. 95.625 DISPLAY_IDENTIFIER LDPM_VO__EFF_VOL FORMAT "%5.2" /end AXIS_PTS
/begin AXIS_PTS ldp_n_32_ip_crlc_eff_vol_temp "" 0x01086 n_32 _REC_AXS_20_u1 8160. _CNV_A_R_LINEAR_____16_CM 6 0. 8160. DISPLAY_IDENTIFIER LDP_N_32_IP_CRLC_EFF_VOL_TEMP FORMAT "%4.0" /end AXIS_PTS
/begin AXIS_PTS ldpm_amp__eff_vol_amp "" 0x1156a amp _REC_AXS_20_u2 5434. _CNV_A_R_LINEAR_____49_CM 6 0. 5434. DISPLAY_IDENTIFIER LDPM_AMP__EFF_VOL_AMP FORMAT "%7.2" /end AXIS_PTS
/begin AXIS_PTS ldpm_n_32__eff_vol_cor "" 0x0806a n_32 _REC_AXS_20_u1 8160. _CNV_A_R_LINEAR_____16_CM 8 0. 8160. DISPLAY_IDENTIFIER LDPM_N_32__EFF_VOL_COR FORMAT "%4.0" /end AXIS_PTS
/begin AXIS_PTS ldpm_maf__eff_vol_cor "" 0x11722 maf _REC_AXS_20_u2 1389. _CNV_A_R_LINEAR_____106_CM 8 0. 1389. DISPLAY_IDENTIFIER LDPM_MAF__EFF_VOL_COR FORMAT "%7.2" /end AXIS_PTS
/begin AXIS_PTS ldpm_n__eff_vol "" 0x11912 n _REC_AXS_20_u2 8160. _CNV_A_R_LINEAR_____11_CM 18 0. 8160. DISPLAY_IDENTIFIER LDPM_N__EFF_VOL FORMAT "%4.0" /end AXIS_PTS
/begin AXIS_PTS ldpm_cam_av_mv_in__eff_vol "" 0x11586 cam_av_mv_in _REC_AXS_20_u2 1535.9765625 _CNV_A_R_LINEAR_____347_CM 12 -768. 767.9765625 DISPLAY_IDENTIFIER LDPM_CAM_AV_MV_IN__EFF_VOL FORMAT "%7.2" /end AXIS_PTS
/begin MEASUREMENT eff_vol_ofs_bas "Basic total value volumetric efficiency - offset" UWORD _CNV_A_R_LINEAR_____113_CM 1 100. 0. 2047.96875 DISPLAY_IDENTIFIER EFF_VOL_OFS_BAS ECU_ADDRESS 0x3fd014 BYTE_ORDER MSB_LAST FORMAT "%7.2" /end MEASUREMENT
/begin MEASUREMENT eff_vol_slop_bas "Basic total value  volumetric efficiency - slope" UWORD _CNV_A_R_LINEAR_____348_CM 1 100. 0. 12.05964 DISPLAY_IDENTIFIER EFF_VOL_SLOP_BAS ECU_ADDRESS 0x3fd016 BYTE_ORDER MSB_LAST FORMAT "%7.4" /end MEASUREMENT
/begin MEASUREMENT eff_vol_ofs_bas_goal "Basic goal value volumetric efficiency - offset" UWORD _CNV_A_R_LINEAR_____113_CM 1 100. 0. 2047.96875 DISPLAY_IDENTIFIER EFF_VOL_OFS_BAS_GOAL ECU_ADDRESS 0x3fd018 BYTE_ORDER MSB_LAST FORMAT "%7.2" /end MEASUREMENT
/begin MEASUREMENT eff_vol_slop_bas_goal "Basic goal value  volumetric efficiency - slope" UWORD _CNV_A_R_LINEAR_____348_CM 1 100. 0. 12.05964 DISPLAY_IDENTIFIER EFF_VOL_SLOP_BAS_GOAL ECU_ADDRESS 0x3fd01a BYTE_ORDER MSB_LAST FORMAT "%7.4" /end MEASUREMENT
/begin MEASUREMENT eff_vol_ofs_bas_0 "Basic value volumetric efficiency for VIM position 0 - offset" UWORD _CNV_A_R_LINEAR_____113_CM 1 100. 0. 2047.96875 DISPLAY_IDENTIFIER EFF_VOL_OFS_BAS_0 ECU_ADDRESS 0x3fd020 BYTE_ORDER MSB_LAST FORMAT "%7.2" /end MEASUREMENT
/begin MEASUREMENT eff_vol_slop_bas_0 "Basic value  volumetric efficiency for VIM position 0 - slope" UWORD _CNV_A_R_LINEAR_____348_CM 1 100. 0. 12.05964 DISPLAY_IDENTIFIER EFF_VOL_SLOP_BAS_0 ECU_ADDRESS 0x3fd022 BYTE_ORDER MSB_LAST FORMAT "%7.4" /end MEASUREMENT
/begin MEASUREMENT eff_vol_ofs_bas_1 "Basic value volumetric efficiency for VIM position 1 - offset" UWORD _CNV_A_R_LINEAR_____113_CM 1 100. 0. 2047.96875 DISPLAY_IDENTIFIER EFF_VOL_OFS_BAS_1 ECU_ADDRESS 0x3fd024 BYTE_ORDER MSB_LAST FORMAT "%7.2" /end MEASUREMENT
/begin MEASUREMENT eff_vol_slop_bas_1 "Basic value  volumetric efficiency for VIM position 1 - slope" UWORD _CNV_A_R_LINEAR_____348_CM 1 100. 0. 12.05964 DISPLAY_IDENTIFIER EFF_VOL_SLOP_BAS_1 ECU_ADDRESS 0x3fd026 BYTE_ORDER MSB_LAST FORMAT "%7.4" /end MEASUREMENT
/begin MEASUREMENT lv_inh_load_tps_plaus "boolean flag to stop the load/TPS rationality check" UBYTE _CNV_S_2_RANGE______0_CM 1 100. 0. 1. DISPLAY_IDENTIFIER LV_INH_LOAD_TPS_PLAUS ECU_ADDRESS 0x3fdfab BIT_MASK 0x1 /end MEASUREMENT
/begin MEASUREMENT lv_err_mec_isa "Error present idle speed actuator is jammed mechanical" UBYTE _CNV_S_2_RANGE______0_CM 1 100. 0. 1. DISPLAY_IDENTIFIER LV_ERR_MEC_ISA ECU_ADDRESS 0x3fdfac BIT_MASK 0x1 /end MEASUREMENT
/begin CHARACTERISTIC c_n_dif_crlc "Correlation factor for N_DIF_MMV calculation" VALUE 0x00763 _REC_VAL_20_u1 0.9960940000000002 _CNV_A_R_LINEAR_____50_CM 0. 0.996094 DISPLAY_IDENTIFIER C_N_DIF_CRLC FORMAT "%5.3" /end CHARACTERISTIC
/begin CHARACTERISTIC c_n_dif_min_mmv "Minimum filtering constant" VALUE 0x00444 _REC_VAL_20_s2 408. _CNV_A_R_LINEAR_____11_CM -4080. 0. DISPLAY_IDENTIFIER C_N_DIF_MIN_MMV FORMAT "%6.0" /end CHARACTERISTIC
/begin MEASUREMENT n_dif_cor "Idle speed control value" SWORD _CNV_A_R_LINEAR_____11_CM 1 100. -4096. 4064. DISPLAY_IDENTIFIER N_DIF_COR ECU_ADDRESS 0x3fd1a4 BYTE_ORDER MSB_LAST FORMAT "%4.0" /end MEASUREMENT
/begin MEASUREMENT n_dif_mmv "N_DIF moving mean value" SWORD _CNV_A_R_LINEAR_____11_CM 1 100. -8160. 8160. DISPLAY_IDENTIFIER N_DIF_MMV ECU_ADDRESS 0x3fd1a8 BYTE_ORDER MSB_LAST FORMAT "%4.0" /end MEASUREMENT
/begin MEASUREMENT n_max_tol_st "Top level end of start engine speed" UBYTE _CNV_A_R_LINEAR_____16_CM 1 100. 0. 8160. DISPLAY_IDENTIFIER N_MAX_TOL_ST ECU_ADDRESS 0x3fe085 FORMAT "%4.0" /end MEASUREMENT
/begin CHARACTERISTIC c_n_dif_fac "Weighting factor for the idle speed variable controller" VALUE 0x00764 _REC_VAL_20_u1 0.9960940000000002 _CNV_A_R_LINEAR_____50_CM 0. 0.996094 DISPLAY_IDENTIFIER C_N_DIF_FAC FORMAT "%5.3" /end CHARACTERISTIC
/begin CHARACTERISTIC ip_dri_acin_n_sp_is "Nominal idle speed with DRIVE (A/T) engaged and air conditioner switched on" CURVE 0x09b62 _REC_CUR_20_u2_u1 8160. _CNV_A_R_LINEAR_____11_CM 0. 8160. DISPLAY_IDENTIFIER IP_DRI_ACIN_N_SP_IS FORMAT "%4.0"
 /begin AXIS_DESCR COM_AXIS tco _CNV_A_R_LINEAR_____12_CM 8 -48. 142.5 FORMAT "%5.1" AXIS_PTS_REF ldpm_tco_n_sp_1 /end AXIS_DESCR
/end CHARACTERISTIC
/begin MEASUREMENT n_dif_st "Engine speed deviation N_MAX_TOL_ST - N" SWORD _CNV_A_R_LINEAR_____11_CM 1 100. -32768. 32767. DISPLAY_IDENTIFIER N_DIF_ST ECU_ADDRESS 0x3fd1a6 BYTE_ORDER MSB_LAST FORMAT "%6.0" /end MEASUREMENT
/begin MEASUREMENT n_sp_is_ratio "Ratio actual engine speed versus engine speed setpoint at idle" UWORD _CNV_A_R_LINEAR_____345_CM 1 100. 0. 7.99987793 DISPLAY_IDENTIFIER N_SP_IS_RATIO ECU_ADDRESS 0x3fd1aa BYTE_ORDER MSB_LAST FORMAT "%6.4" /end MEASUREMENT
/begin CHARACTERISTIC ip_dri_n_sp_is "Nominal idle speed with DRIVE  (A/T) engaged" CURVE 0x09bf2 _REC_CUR_20_u2_u1 8160. _CNV_A_R_LINEAR_____11_CM 0. 8160. DISPLAY_IDENTIFIER IP_DRI_N_SP_IS FORMAT "%4.0"
 /begin AXIS_DESCR COM_AXIS tco _CNV_A_R_LINEAR_____12_CM 8 -48. 142.5 FORMAT "%5.1" AXIS_PTS_REF ldpm_tco_n_sp_1 /end AXIS_DESCR
/end CHARACTERISTIC
/begin CHARACTERISTIC ip_n_sp_is_lih "Idle speed setpoint in case of limp home" CURVE 0x0cf6e _REC_CUR_20_u2_u1 8160. _CNV_A_R_LINEAR_____11_CM 0. 8160. DISPLAY_IDENTIFIER IP_N_SP_IS_LIH FORMAT "%4.0"
 /begin AXIS_DESCR COM_AXIS tco _CNV_A_R_LINEAR_____12_CM 8 -48. 142.5 FORMAT "%5.1" AXIS_PTS_REF ldpm_tco_n_sp_1 /end AXIS_DESCR
/end CHARACTERISTIC
/begin CHARACTERISTIC ip_dri_n_sp_is_lih "Idle speed setpoint in case of limp home and engaged drivetrain" CURVE 0x09c02 _REC_CUR_20_u2_u1 8160. _CNV_A_R_LINEAR_____11_CM 0. 8160. DISPLAY_IDENTIFIER IP_DRI_N_SP_IS_LIH FORMAT "%4.0"
 /begin AXIS_DESCR COM_AXIS tco _CNV_A_R_LINEAR_____12_CM 8 -48. 142.5 FORMAT "%5.1" AXIS_PTS_REF ldpm_tco_n_sp_1 /end AXIS_DESCR
/end CHARACTERISTIC
/begin CHARACTERISTIC ip_n_sp_is "Nominal idle speed without additional load on the engine" CURVE 0x0cf3e _REC_CUR_20_u2_u1 8160. _CNV_A_R_LINEAR_____11_CM 0. 8160. DISPLAY_IDENTIFIER IP_N_SP_IS FORMAT "%4.0"
 /begin AXIS_DESCR COM_AXIS tco _CNV_A_R_LINEAR_____12_CM 8 -48. 142.5 FORMAT "%5.1" AXIS_PTS_REF ldpm_tco_n_sp_1 /end AXIS_DESCR
/end CHARACTERISTIC
/begin MEASUREMENT n_dif "Engine speed deviation N_SP_IS_N" SWORD _CNV_A_R_LINEAR_____11_CM 1 100. -4096. 4064. DISPLAY_IDENTIFIER N_DIF ECU_ADDRESS 0x3fd1a2 BYTE_ORDER MSB_LAST FORMAT "%4.0" /end MEASUREMENT
/begin MEASUREMENT n_sp_is_pow "Active nominal idle speed setpoint by power management active" UWORD _CNV_A_R_LINEAR_____11_CM 1 100. 0. 8160. DISPLAY_IDENTIFIER N_SP_IS_POW ECU_ADDRESS 0x3fd1ae BYTE_ORDER MSB_LAST FORMAT "%4.0" /end MEASUREMENT
/begin MEASUREMENT n_sp_is_ch "idle speed setpoint for CAT heating" UWORD _CNV_A_R_LINEAR_____11_CM 1 100. 0. 8160. DISPLAY_IDENTIFIER N_SP_IS_CH ECU_ADDRESS 0x3fd1ac BYTE_ORDER MSB_LAST FORMAT "%4.0" /end MEASUREMENT
/begin MEASUREMENT n_sp_is_2 "basis idle speed setpoint" UWORD _CNV_A_R_LINEAR_____11_CM 1 100. 0. 8160. DISPLAY_IDENTIFIER N_SP_IS_2 ECU_ADDRESS 0x3fd1a0 BYTE_ORDER MSB_LAST FORMAT "%4.0" /end MEASUREMENT
/begin MEASUREMENT n_sp_is_3 "greatest of all idle speed setpoints" UWORD _CNV_A_R_LINEAR_____11_CM 1 100. 0. 8160. DISPLAY_IDENTIFIER N_SP_IS_3 ECU_ADDRESS 0x3fd1b0 BYTE_ORDER MSB_LAST FORMAT "%4.0" /end MEASUREMENT
/begin MEASUREMENT lv_req_heat_n_sp_is "LV Idle Speed setpoint required from heating control unit" UBYTE _CNV_S_2_RANGE______0_CM 1 100. 0. 1. DISPLAY_IDENTIFIER LV_REQ_HEAT_N_SP_IS ECU_ADDRESS 0x3fe087 /end MEASUREMENT
/begin CHARACTERISTIC ip_acin_n_sp_is "Nominal idle speed with air conditioner switched on" CURVE 0x08ae4 _REC_CUR_20_u2_u1 8160. _CNV_A_R_LINEAR_____11_CM 0. 8160. DISPLAY_IDENTIFIER IP_ACIN_N_SP_IS FORMAT "%4.0"
 /begin AXIS_DESCR COM_AXIS tco _CNV_A_R_LINEAR_____12_CM 8 -48. 142.5 FORMAT "%5.1" AXIS_PTS_REF ldpm_tco_n_sp_1 /end AXIS_DESCR
/end CHARACTERISTIC
/begin CHARACTERISTIC ip_fac_n_sp_ofs_kwp "TCO factor for N_SP_OFS_KWP" CURVE 0x00b4c _REC_CUR_20_u1_u1 0.99610001 _CNV_A_R_LINEAR_____29_CM 0. 0.99610001 DISPLAY_IDENTIFIER IP_FAC_N_SP_OFS_KWP FORMAT "%5.3"
 /begin AXIS_DESCR COM_AXIS tco _CNV_A_R_LINEAR_____12_CM 8 -48. 142.5 FORMAT "%5.1" AXIS_PTS_REF ldpm_tco_n_sp_1 /end AXIS_DESCR
/end CHARACTERISTIC
/begin CHARACTERISTIC ip_dri_n_sp_ch "Max. idle speed during CAT heating with drive engaged" MAP 0x09b72 _REC_MAP_20_u2_u1_u2 8160. _CNV_A_R_LINEAR_____11_CM 0. 8160. DISPLAY_IDENTIFIER IP_DRI_N_SP_CH FORMAT "%4.0"
 /begin AXIS_DESCR COM_AXIS tco _CNV_A_R_LINEAR_____12_CM 8 -48. 142.5 FORMAT "%5.1" AXIS_PTS_REF ldpm_tco_n_sp_2 /end AXIS_DESCR
 /begin AXIS_DESCR COM_AXIS t_ast _CNV_A_R_LINEAR_____24_CM 8 0. 6553.5 FORMAT "%6.1" AXIS_PTS_REF ldpm_t_ast_n_sp_1 /end AXIS_DESCR
/end CHARACTERISTIC
/begin CHARACTERISTIC ip_n_sp_ch "Max. idle speed during CAT heating with no drive engaged" MAP 0x0cebe _REC_MAP_20_u2_u1_u2 8160. _CNV_A_R_LINEAR_____11_CM 0. 8160. DISPLAY_IDENTIFIER IP_N_SP_CH FORMAT "%4.0"
 /begin AXIS_DESCR COM_AXIS tco _CNV_A_R_LINEAR_____12_CM 8 -48. 142.5 FORMAT "%5.1" AXIS_PTS_REF ldpm_tco_n_sp_2 /end AXIS_DESCR
 /begin AXIS_DESCR COM_AXIS t_ast _CNV_A_R_LINEAR_____24_CM 8 0. 6553.5 FORMAT "%6.1" AXIS_PTS_REF ldpm_t_ast_n_sp_1 /end AXIS_DESCR
/end CHARACTERISTIC
/begin CHARACTERISTIC ip_fac_dri_n_sp_ch "Interpolation factor idle speed during CAT heating with drive engaged" MAP 0x04d92 _REC_MAP_20_u1_u1_u2 0.99610001 _CNV_A_R_LINEAR_____29_CM 0. 0.99610001 DISPLAY_IDENTIFIER IP_FAC_DRI_N_SP_CH FORMAT "%5.3"
 /begin AXIS_DESCR COM_AXIS tco _CNV_A_R_LINEAR_____12_CM 8 -48. 142.5 FORMAT "%5.1" AXIS_PTS_REF ldpm_tco_n_sp_2 /end AXIS_DESCR
 /begin AXIS_DESCR COM_AXIS ctr_km_can _CNV_A_R_LINEAR_____88_CM 4 0. 655350. FORMAT "%7.0" AXIS_PTS_REF ldpm_ctr_km_can_n_sp_1 /end AXIS_DESCR
/end CHARACTERISTIC
/begin CHARACTERISTIC ip_fac_n_sp_ch "Interpolation factor idle speed during CAT heating with no drive engaged" MAP 0x05056 _REC_MAP_20_u1_u1_u2 0.99610001 _CNV_A_R_LINEAR_____29_CM 0. 0.99610001 DISPLAY_IDENTIFIER IP_FAC_N_SP_CH FORMAT "%5.3"
 /begin AXIS_DESCR COM_AXIS tco _CNV_A_R_LINEAR_____12_CM 8 -48. 142.5 FORMAT "%5.1" AXIS_PTS_REF ldpm_tco_n_sp_2 /end AXIS_DESCR
 /begin AXIS_DESCR COM_AXIS ctr_km_can _CNV_A_R_LINEAR_____88_CM 4 0. 655350. FORMAT "%7.0" AXIS_PTS_REF ldpm_ctr_km_can_n_sp_1 /end AXIS_DESCR
/end CHARACTERISTIC
/begin CHARACTERISTIC ip_n_sp_dec_ch "Gradient limitation idle speed after catalyst heating" CURVE 0x00d32 _REC_CUR_20_u1_u1 0.4980468800000001 _CNV_A_R_LINEAR_____369_CM 0. 0.49804688 DISPLAY_IDENTIFIER IP_N_SP_DEC_CH FORMAT "%5.3"
 /begin AXIS_DESCR COM_AXIS tco _CNV_A_R_LINEAR_____12_CM 8 -48. 142.5 FORMAT "%5.1" AXIS_PTS_REF ldpm_tco_n_sp_2 /end AXIS_DESCR
/end CHARACTERISTIC
/begin CHARACTERISTIC ip_t_ast_min_n_sp_is_cs "Minimum delay time after start for drive-off-support idle speed" CURVE 0x0dd76 _REC_CUR_20_u2_u1 6553.5 _CNV_A_R_LINEAR_____24_CM 0. 6553.5 DISPLAY_IDENTIFIER IP_T_AST_MIN_N_SP_IS_CS FORMAT "%6.1"
 /begin AXIS_DESCR COM_AXIS tco _CNV_A_R_LINEAR_____12_CM 8 -48. 142.5 FORMAT "%5.1" AXIS_PTS_REF ldpm_tco_n_sp_1 /end AXIS_DESCR
/end CHARACTERISTIC
/begin CHARACTERISTIC c_n_sp_ofs_kwp_max "Upper threshold for tester offset" VALUE 0x0171c _REC_VAL_20_u2 32767. _CNV_A_R_LINEAR_____11_CM 0. 32767. DISPLAY_IDENTIFIER C_N_SP_OFS_KWP_MAX FORMAT "%5.0" /end CHARACTERISTIC
/begin CHARACTERISTIC c_n_sp_ofs_kwp_min "Lower threshold for tester offset" VALUE 0x0171e _REC_VAL_20_u2 32767. _CNV_A_R_LINEAR_____370_CM -32768. -1. DISPLAY_IDENTIFIER C_N_SP_OFS_KWP_MIN FORMAT "%6.0" /end CHARACTERISTIC
/begin CHARACTERISTIC c_tam_n_sp_heat "Ambient temperature threshold idle speed at heater request" VALUE 0x00851 _REC_VAL_20_u1 190.5 _CNV_A_R_LINEAR_____12_CM -48. 142.5 DISPLAY_IDENTIFIER C_TAM_N_SP_HEAT FORMAT "%5.1" /end CHARACTERISTIC
/begin CHARACTERISTIC c_tam_hys "Ambient temperature threshold idle speed at heater request" VALUE 0x00849 _REC_VAL_20_u1 48. _CNV_A_R_LINEAR_____13_CM 0. 48. DISPLAY_IDENTIFIER C_TAM_HYS FORMAT "%4.1" /end CHARACTERISTIC
/begin CHARACTERISTIC c_n_sp_heat_mt "Idle speed at heater request, manual transmission vehicle" VALUE 0x01716 _REC_VAL_20_u2 8160. _CNV_A_R_LINEAR_____11_CM 0. 8160. DISPLAY_IDENTIFIER C_N_SP_HEAT_MT FORMAT "%4.0" /end CHARACTERISTIC
/begin CHARACTERISTIC c_n_sp_heat_at "Idle speed at heater request, automatic transmission vehicle" VALUE 0x01714 _REC_VAL_20_u2 8160. _CNV_A_R_LINEAR_____11_CM 0. 8160. DISPLAY_IDENTIFIER C_N_SP_HEAT_AT FORMAT "%4.0" /end CHARACTERISTIC
/begin CHARACTERISTIC c_n_sp_inc_cs "Increment engine speed setpoint for drive-off-support" VALUE 0x0078c _REC_VAL_20_u1 7.93775 _CNV_A_R_LINEAR_____371_CM 3.125e-002 7.969 DISPLAY_IDENTIFIER C_N_SP_INC_CS FORMAT "%4.2" /end CHARACTERISTIC
/begin CHARACTERISTIC c_n_sp_dec_cs "Decrement engine speed setpoint for drive-off-support" VALUE 0x0078a _REC_VAL_20_u1 7.93775 _CNV_A_R_LINEAR_____371_CM 3.125e-002 7.969 DISPLAY_IDENTIFIER C_N_SP_DEC_CS FORMAT "%4.2" /end CHARACTERISTIC
/begin CHARACTERISTIC c_toil_min_n_sp_at "Oil temperature value switch to C_N_SP_TOIL_AT" VALUE 0x008ec _REC_VAL_20_u1 200. _CNV_A_R_LINEAR_____15_CM -40. 160. DISPLAY_IDENTIFIER C_TOIL_MIN_N_SP_AT FORMAT "%3.0" /end CHARACTERISTIC
/begin CHARACTERISTIC c_toil_hys_n_sp_at "Hysteresis for oil temperature value switch" VALUE 0x008e2 _REC_VAL_20_u1 128. _CNV_A_R_LINEAR_____14_CM 0. 128. DISPLAY_IDENTIFIER C_TOIL_HYS_N_SP_AT FORMAT "%3.0" /end CHARACTERISTIC
/begin CHARACTERISTIC c_n_sp_toil_at "Minimum idle speed when TOIL is above C_TOIL_MIN_N_SP_AT" VALUE 0x01720 _REC_VAL_20_u2 8160. _CNV_A_R_LINEAR_____11_CM 0. 8160. DISPLAY_IDENTIFIER C_N_SP_TOIL_AT FORMAT "%4.0" /end CHARACTERISTIC
/begin AXIS_PTS ldpm_tco_n_sp_2 "" 0x08226 tco _REC_AXS_20_u1 190.5 _CNV_A_R_LINEAR_____12_CM 8 -48. 142.5 DISPLAY_IDENTIFIER LDPM_TCO_N_SP_2 FORMAT "%5.1" /end AXIS_PTS
/begin AXIS_PTS ldpm_tco_n_sp_1 "" 0x0821d tco _REC_AXS_20_u1 190.5 _CNV_A_R_LINEAR_____12_CM 8 -48. 142.5 DISPLAY_IDENTIFIER LDPM_TCO_N_SP_1 FORMAT "%5.1" /end AXIS_PTS
/begin AXIS_PTS ldpm_t_ast_n_sp_1 "" 0x11b12 t_ast _REC_AXS_20_u2 6553.5 _CNV_A_R_LINEAR_____24_CM 8 0. 6553.5 DISPLAY_IDENTIFIER LDPM_T_AST_N_SP_1 FORMAT "%6.1" /end AXIS_PTS
/begin AXIS_PTS ldpm_ctr_km_can_n_sp_1 "" 0x115ec ctr_km_can _REC_AXS_20_u2 655350. _CNV_A_R_LINEAR_____88_CM 4 0. 655350. DISPLAY_IDENTIFIER LDPM_CTR_KM_CAN_N_SP_1 FORMAT "%7.0" /end AXIS_PTS
/begin CHARACTERISTIC c_n_sp_lgrd_is_lih "Nominal idle speed change limitation with active limp home" VALUE 0x0078e _REC_VAL_20_u1 12.7 _CNV_A_R_LINEAR_____372_CM 0.25 63.75 DISPLAY_IDENTIFIER C_N_SP_LGRD_IS_LIH FORMAT "%5.2" /end CHARACTERISTIC
/begin CHARACTERISTIC c_n_sp_is_sa_eol "Idle speed setpoint during the \"secondary air function end of line test'" VALUE 0x01718 _REC_VAL_20_u2 8160. _CNV_A_R_LINEAR_____11_CM 0. 8160. DISPLAY_IDENTIFIER C_N_SP_IS_SA_EOL FORMAT "%4.0" /end CHARACTERISTIC
/begin CHARACTERISTIC c_n_sp_lgrd_is "Nominal idle speed change limitation" VALUE 0x0078d _REC_VAL_20_u1 12.7 _CNV_A_R_LINEAR_____372_CM 0.25 63.75 DISPLAY_IDENTIFIER C_N_SP_LGRD_IS FORMAT "%5.2" /end CHARACTERISTIC
/begin CHARACTERISTIC c_n_sp_dec_is_ch_dri "Idle speed change limitation during catalyst heating and LV_DRI = 1" VALUE 0x0078b _REC_VAL_20_u1 3.175 _CNV_A_R_LINEAR_____373_CM 6.25e-002 15.9375 DISPLAY_IDENTIFIER C_N_SP_DEC_IS_CH_DRI FORMAT "%7.4" /end CHARACTERISTIC
/begin MEASUREMENT n_sp_is "resulting idle speed setpoint" UWORD _CNV_A_R_LINEAR_____11_CM 1 100. 0. 8160. DISPLAY_IDENTIFIER N_SP_IS ECU_ADDRESS 0x3fd19e BYTE_ORDER MSB_LAST FORMAT "%4.0" /end MEASUREMENT
/begin MEASUREMENT lv_n_sp_is_cs "1: conditions for increased idle speed / torque reserve for drive-off-support fulfilled" UBYTE _CNV_S_2_RANGE______5_CM 1 100. 0. 1. DISPLAY_IDENTIFIER LV_N_SP_IS_CS ECU_ADDRESS 0x3fe086 BIT_MASK 0x1 /end MEASUREMENT
/begin AXIS_PTS ldpm_toil_ip_n_sp_is_cs "" 0x0827b toil _REC_AXS_20_u1 200. _CNV_A_R_LINEAR_____15_CM 8 -40. 160. DISPLAY_IDENTIFIER LDPM_TOIL_IP_N_SP_IS_CS FORMAT "%3.0" /end AXIS_PTS
/begin CHARACTERISTIC ip_n_sp_is_cs "Idle speed setpoint for drive-off-support - manual transmission" CURVE 0x0cf4e _REC_CUR_20_u2_u1 8160. _CNV_A_R_LINEAR_____11_CM 0. 8160. DISPLAY_IDENTIFIER IP_N_SP_IS_CS FORMAT "%4.0"
 /begin AXIS_DESCR COM_AXIS toil _CNV_A_R_LINEAR_____15_CM 8 -40. 160. FORMAT "%3.0" AXIS_PTS_REF ldpm_toil_ip_n_sp_is_cs /end AXIS_DESCR
/end CHARACTERISTIC
/begin CHARACTERISTIC ip_n_sp_is_cs_amt "Idle speed setpoint for drive-off-support - automated manual transmission" CURVE 0x0cf5e _REC_CUR_20_u2_u1 8160. _CNV_A_R_LINEAR_____11_CM 0. 8160. DISPLAY_IDENTIFIER IP_N_SP_IS_CS_AMT FORMAT "%4.0"
 /begin AXIS_DESCR COM_AXIS toil _CNV_A_R_LINEAR_____15_CM 8 -40. 160. FORMAT "%3.0" AXIS_PTS_REF ldpm_toil_ip_n_sp_is_cs /end AXIS_DESCR
/end CHARACTERISTIC
/begin CHARACTERISTIC c_dri_vs_min_vb "Minimum vehicle speed for activating battery charging in case LV_DRI = 1" VALUE 0x006ab _REC_VAL_20_u1 255. _CNV_A_R_LINEAR_____23_CM 0. 255. DISPLAY_IDENTIFIER C_DRI_VS_MIN_VB FORMAT "%3.0" /end CHARACTERISTIC
/begin CHARACTERISTIC c_vs_max_n_sp_cs "Maximum vehicle speed for drive-off-support" VALUE 0x00952 _REC_VAL_20_u1 255. _CNV_A_R_LINEAR_____23_CM 0. 255. DISPLAY_IDENTIFIER C_VS_MAX_N_SP_CS FORMAT "%3.0" /end CHARACTERISTIC
/begin CHARACTERISTIC c_vs_hys_n_sp_cs "vehicle speed hysteresis for VS threshold drive off support" VALUE 0x00944 _REC_VAL_20_u1 255. _CNV_A_R_LINEAR_____23_CM 0. 255. DISPLAY_IDENTIFIER C_VS_HYS_N_SP_CS FORMAT "%3.0" /end CHARACTERISTIC
/begin CHARACTERISTIC lc_is_n_sp_cs_dis "LC to switch on/off LV_IS  condition for drive off support" VALUE 0x00f47 _REC_VAL_20_u1 1. _CNV_A_R_LINEAR_____1_CM 0. 1. DISPLAY_IDENTIFIER LC_IS_N_SP_CS_DIS FORMAT "%2.0" /end CHARACTERISTIC
/begin AXIS_PTS ldpm_gear "" 0x07f19 gear _REC_AXS_20_u1 255. _CNV_A_R_LINEAR_____1_CM 9 0. 255. DISPLAY_IDENTIFIER LDPM_GEAR FORMAT "%3.0" /end AXIS_PTS
/begin MEASUREMENT n_max_thd "Actual engine speed limit" UWORD _CNV_A_R_LINEAR_____11_CM 1 100. 0. 8160. DISPLAY_IDENTIFIER N_MAX_THD ECU_ADDRESS 0x3fd1e2 BYTE_ORDER MSB_LAST FORMAT "%4.0" /end MEASUREMENT
/begin MEASUREMENT n_max_thd_1 "Actual engine speed limit depending on TOIL-orange area (BN2000)" UWORD _CNV_A_R_LINEAR_____11_CM 1 100. 0. 8160. DISPLAY_IDENTIFIER N_MAX_THD_1 ECU_ADDRESS 0x3fd1e4 BYTE_ORDER MSB_LAST FORMAT "%4.0" /end MEASUREMENT
/begin MEASUREMENT n_max_thd_2 "Actual engine speed limit depending on TOIL-red area (BN2000)" UWORD _CNV_A_R_LINEAR_____11_CM 1 100. 0. 8160. DISPLAY_IDENTIFIER N_MAX_THD_2 ECU_ADDRESS 0x3fd1e6 BYTE_ORDER MSB_LAST FORMAT "%4.0" /end MEASUREMENT
/begin MEASUREMENT lv_vs_max "Boolean for vehicle speed limitation active" UBYTE _CNV_S_2_RANGE______0_CM 1 100. 0. 1. DISPLAY_IDENTIFIER LV_VS_MAX ECU_ADDRESS 0x3fe095 /end MEASUREMENT
/begin MEASUREMENT vs_ratio "Ratio between vehicle speed limit and actual vehicle speed" UWORD _CNV_A_R_LINEAR_____378_CM 1 100. 0. 31.99951171875 DISPLAY_IDENTIFIER VS_RATIO ECU_ADDRESS 0x3fd1ea BYTE_ORDER MSB_LAST FORMAT "%7.4" /end MEASUREMENT
/begin CHARACTERISTIC ip_n_max_mtc_cur_off__pv_av "Engine speed limit for limp home modus due MTC error" CURVE 0x01b12 _REC_CUR_20_u2_u1 8160. _CNV_A_R_LINEAR_____11_CM 0. 8160. DISPLAY_IDENTIFIER IP_N_MAX_MTC_CUR_OFF__PV_AV FORMAT "%4.0"
 /begin AXIS_DESCR COM_AXIS pv_av _CNV_A_R_LINEAR_____10_CM 4 0. 99.609375 FORMAT "%5.2" AXIS_PTS_REF ldp_pv_av__n_max_mtc_cur_off /end AXIS_DESCR
/end CHARACTERISTIC
/begin CHARACTERISTIC c_n_max_mtc_lih "Engine speed limitation in case of fault detected by throttle monitoring or ETC safety concept" VALUE 0x01706 _REC_VAL_20_u2 8160. _CNV_A_R_LINEAR_____11_CM 0. 8160. DISPLAY_IDENTIFIER C_N_MAX_MTC_LIH FORMAT "%4.0" /end CHARACTERISTIC
/begin CHARACTERISTIC c_vs_max "Vehicle speed limitation threshold" VALUE 0x00945 _REC_VAL_20_u1 255. _CNV_A_R_LINEAR_____23_CM 0. 255. DISPLAY_IDENTIFIER C_VS_MAX FORMAT "%3.0" /end CHARACTERISTIC
/begin CHARACTERISTIC c_n_max_thd_min "Minimum allowed engine speed threshold" VALUE 0x01708 _REC_VAL_20_u2 8160. _CNV_A_R_LINEAR_____11_CM 0. 8160. DISPLAY_IDENTIFIER C_N_MAX_THD_MIN FORMAT "%4.0" /end CHARACTERISTIC
/begin MEASUREMENT n_max_vs_max "Engine speed limit in case of vehicle speed limitation" UWORD _CNV_A_R_LINEAR_____11_CM 1 100. 0. 8160. DISPLAY_IDENTIFIER N_MAX_VS_MAX ECU_ADDRESS 0x3fd1e8 BYTE_ORDER MSB_LAST FORMAT "%4.0" /end MEASUREMENT
/begin CHARACTERISTIC c_vs_max_amt "Vehicle speed limitation threshold - SSG" VALUE 0x00947 _REC_VAL_20_u1 255. _CNV_A_R_LINEAR_____23_CM 0. 255. DISPLAY_IDENTIFIER C_VS_MAX_AMT FORMAT "%3.0" /end CHARACTERISTIC
/begin CHARACTERISTIC ip_n_max_2__toil "engine speed limit (red area) depending on TOIL - BN2000" CURVE 0x01b0a _REC_CUR_20_u2_u1 8160. _CNV_A_R_LINEAR_____11_CM 0. 8160. DISPLAY_IDENTIFIER IP_N_MAX_2__TOIL FORMAT "%4.0"
 /begin AXIS_DESCR COM_AXIS toil _CNV_A_R_LINEAR_____15_CM 4 -40. 160. FORMAT "%3.0" AXIS_PTS_REF ldp_toil__n_max_2 /end AXIS_DESCR
/end CHARACTERISTIC
/begin CHARACTERISTIC ip_n_max_1__toil "engine speed limit (orange area) depending on TOIL - BN2000" CURVE 0x01b02 _REC_CUR_20_u2_u1 8160. _CNV_A_R_LINEAR_____11_CM 0. 8160. DISPLAY_IDENTIFIER IP_N_MAX_1__TOIL FORMAT "%4.0"
 /begin AXIS_DESCR COM_AXIS toil _CNV_A_R_LINEAR_____15_CM 4 -40. 160. FORMAT "%3.0" AXIS_PTS_REF ldp_toil__n_max_1 /end AXIS_DESCR
/end CHARACTERISTIC
/begin CHARACTERISTIC c_n_max_amt_add "offset for engine speed limit during gear shift phase 1 and 2" VALUE 0x016f0 _REC_VAL_20_u2 979.2000000000001 _CNV_A_R_LINEAR_____11_CM 0. 8160. DISPLAY_IDENTIFIER C_N_MAX_AMT_ADD FORMAT "%4.0" /end CHARACTERISTIC
/begin CHARACTERISTIC c_n_max_amt_gp "engine speed limit in case of SSG-error (gear protection active, LV_GP=1)" VALUE 0x016f2 _REC_VAL_20_u2 979.2000000000001 _CNV_A_R_LINEAR_____11_CM 0. 8160. DISPLAY_IDENTIFIER C_N_MAX_AMT_GP FORMAT "%4.0" /end CHARACTERISTIC
/begin AXIS_PTS ldp_pv_av__n_max_mtc_cur_off "" 0x010e4 pv_av _REC_AXS_20_u1 99.609375 _CNV_A_R_LINEAR_____10_CM 4 0. 99.609375 DISPLAY_IDENTIFIER LDP_PV_AV__N_MAX_MTC_CUR_OFF FORMAT "%5.2" /end AXIS_PTS
/begin AXIS_PTS ldp_toil__n_max_2 "" 0x01236 toil _REC_AXS_20_u1 200. _CNV_A_R_LINEAR_____15_CM 4 -40. 160. DISPLAY_IDENTIFIER LDP_TOIL__N_MAX_2 FORMAT "%3.0" /end AXIS_PTS
/begin AXIS_PTS ldp_toil__n_max_1 "" 0x01231 toil _REC_AXS_20_u1 200. _CNV_A_R_LINEAR_____15_CM 4 -40. 160. DISPLAY_IDENTIFIER LDP_TOIL__N_MAX_1 FORMAT "%3.0" /end AXIS_PTS
/begin CHARACTERISTIC id_n_max_mt "Basic Engine speed limit MT-Vehicle" CURVE 0x086a4 _REC_CUR_20_u2_u1 8160. _CNV_A_R_LINEAR_____11_CM 0. 8160. DISPLAY_IDENTIFIER ID_N_MAX_MT FORMAT "%4.0"
 /begin AXIS_DESCR COM_AXIS gear _CNV_A_R_LINEAR_____1_CM 9 0. 255. FORMAT "%3.0" AXIS_PTS_REF ldpm_gear /end AXIS_DESCR
/end CHARACTERISTIC
/begin CHARACTERISTIC id_n_max_amt "Basic Engine speed limit AMT-Vehicle" CURVE 0x0864a _REC_CUR_20_u2_u1 8160. _CNV_A_R_LINEAR_____11_CM 0. 8160. DISPLAY_IDENTIFIER ID_N_MAX_AMT FORMAT "%4.0"
 /begin AXIS_DESCR COM_AXIS gear _CNV_A_R_LINEAR_____1_CM 9 0. 255. FORMAT "%3.0" AXIS_PTS_REF ldpm_gear /end AXIS_DESCR
/end CHARACTERISTIC
/begin CHARACTERISTIC id_n_max_at "Basic Engine speed limit AT-Vehicle" CURVE 0x0865c _REC_CUR_20_u2_u1 8160. _CNV_A_R_LINEAR_____11_CM 0. 8160. DISPLAY_IDENTIFIER ID_N_MAX_AT FORMAT "%4.0"
 /begin AXIS_DESCR COM_AXIS gear _CNV_A_R_LINEAR_____1_CM 9 0. 255. FORMAT "%3.0" AXIS_PTS_REF ldpm_gear /end AXIS_DESCR
/end CHARACTERISTIC
/begin CHARACTERISTIC id_n_max_h_mt "Increased engine speed limit MT-vehicle" CURVE 0x08692 _REC_CUR_20_u2_u1 8160. _CNV_A_R_LINEAR_____11_CM 0. 8160. DISPLAY_IDENTIFIER ID_N_MAX_H_MT FORMAT "%4.0"
 /begin AXIS_DESCR COM_AXIS gear _CNV_A_R_LINEAR_____1_CM 9 0. 255. FORMAT "%3.0" AXIS_PTS_REF ldpm_gear /end AXIS_DESCR
/end CHARACTERISTIC
/begin CHARACTERISTIC id_n_max_h_amt "Increased engine speed limit AMT-vehicle" CURVE 0x0866e _REC_CUR_20_u2_u1 8160. _CNV_A_R_LINEAR_____11_CM 0. 8160. DISPLAY_IDENTIFIER ID_N_MAX_H_AMT FORMAT "%4.0"
 /begin AXIS_DESCR COM_AXIS gear _CNV_A_R_LINEAR_____1_CM 9 0. 255. FORMAT "%3.0" AXIS_PTS_REF ldpm_gear /end AXIS_DESCR
/end CHARACTERISTIC
/begin CHARACTERISTIC id_n_max_h_at "Increased engine speed limit AT-vehicle" CURVE 0x08680 _REC_CUR_20_u2_u1 8160. _CNV_A_R_LINEAR_____11_CM 0. 8160. DISPLAY_IDENTIFIER ID_N_MAX_H_AT FORMAT "%4.0"
 /begin AXIS_DESCR COM_AXIS gear _CNV_A_R_LINEAR_____1_CM 9 0. 255. FORMAT "%3.0" AXIS_PTS_REF ldpm_gear /end AXIS_DESCR
/end CHARACTERISTIC
/begin CHARACTERISTIC id_t_n_max_h_amt "Time for increased engine speed limit,AMT vehicle" CURVE 0x03fbd _REC_CUR_20_u1_u1 25.5 _CNV_A_R_LINEAR_____24_CM 0. 25.5 DISPLAY_IDENTIFIER ID_T_N_MAX_H_AMT FORMAT "%4.1"
 /begin AXIS_DESCR COM_AXIS gear _CNV_A_R_LINEAR_____1_CM 9 0. 255. FORMAT "%3.0" AXIS_PTS_REF ldpm_gear /end AXIS_DESCR
/end CHARACTERISTIC
/begin CHARACTERISTIC id_t_n_max_h_mt "Time for increased engine speed limit, MT vehicle" CURVE 0x03fcf _REC_CUR_20_u1_u1 25.5 _CNV_A_R_LINEAR_____24_CM 0. 25.5 DISPLAY_IDENTIFIER ID_T_N_MAX_H_MT FORMAT "%4.1"
 /begin AXIS_DESCR COM_AXIS gear _CNV_A_R_LINEAR_____1_CM 9 0. 255. FORMAT "%3.0" AXIS_PTS_REF ldpm_gear /end AXIS_DESCR
/end CHARACTERISTIC
/begin CHARACTERISTIC id_t_n_max_h_at "Time for increased engine speed limit, AT vehicle" CURVE 0x03fc6 _REC_CUR_20_u1_u1 25.5 _CNV_A_R_LINEAR_____24_CM 0. 25.5 DISPLAY_IDENTIFIER ID_T_N_MAX_H_AT FORMAT "%4.1"
 /begin AXIS_DESCR COM_AXIS gear _CNV_A_R_LINEAR_____1_CM 9 0. 255. FORMAT "%3.0" AXIS_PTS_REF ldpm_gear /end AXIS_DESCR
/end CHARACTERISTIC
/begin CHARACTERISTIC id_n_dec_n_max_h_mt "Stepwidth to basic engine speed limit, MT vehicle" CURVE 0x08638 _REC_CUR_20_u2_u1 2048. _CNV_A_R_LINEAR_____11_CM 0. 2048. DISPLAY_IDENTIFIER ID_N_DEC_N_MAX_H_MT FORMAT "%4.0"
 /begin AXIS_DESCR COM_AXIS gear _CNV_A_R_LINEAR_____1_CM 9 0. 255. FORMAT "%3.0" AXIS_PTS_REF ldpm_gear /end AXIS_DESCR
/end CHARACTERISTIC
/begin CHARACTERISTIC id_n_dec_n_max_h_amt "Stepwidth to basic engine speed limit, AMT vehicle" CURVE 0x08614 _REC_CUR_20_u2_u1 2048. _CNV_A_R_LINEAR_____11_CM 0. 2048. DISPLAY_IDENTIFIER ID_N_DEC_N_MAX_H_AMT FORMAT "%4.0"
 /begin AXIS_DESCR COM_AXIS gear _CNV_A_R_LINEAR_____1_CM 9 0. 255. FORMAT "%3.0" AXIS_PTS_REF ldpm_gear /end AXIS_DESCR
/end CHARACTERISTIC
/begin CHARACTERISTIC id_n_dec_n_max_h_at "Stepwidth to basic engine speed limit, AT vehicle" CURVE 0x08626 _REC_CUR_20_u2_u1 2048. _CNV_A_R_LINEAR_____11_CM 0. 2048. DISPLAY_IDENTIFIER ID_N_DEC_N_MAX_H_AT FORMAT "%4.0"
 /begin AXIS_DESCR COM_AXIS gear _CNV_A_R_LINEAR_____1_CM 9 0. 255. FORMAT "%3.0" AXIS_PTS_REF ldpm_gear /end AXIS_DESCR
/end CHARACTERISTIC
/begin CHARACTERISTIC c_n_max_dri_rvl "Engine speed limit AT-vehicle in reverse gear" VALUE 0x016f6 _REC_VAL_20_u2 8160. _CNV_A_R_LINEAR_____11_CM 0. 8160. DISPLAY_IDENTIFIER C_N_MAX_DRI_RVL FORMAT "%4.0" /end CHARACTERISTIC
/begin CHARACTERISTIC c_vs_thd_n_max_h_mt "VS threshold for increased engine speed limit, MT vehicle" VALUE 0x00963 _REC_VAL_20_u1 255. _CNV_A_R_LINEAR_____23_CM 0. 255. DISPLAY_IDENTIFIER C_VS_THD_N_MAX_H_MT FORMAT "%3.0" /end CHARACTERISTIC
/begin CHARACTERISTIC c_vs_thd_n_max_h_amt "VS threshold for increased engine speed limit, AMT vehicle" VALUE 0x00961 _REC_VAL_20_u1 255. _CNV_A_R_LINEAR_____23_CM 0. 255. DISPLAY_IDENTIFIER C_VS_THD_N_MAX_H_AMT FORMAT "%3.0" /end CHARACTERISTIC
/begin CHARACTERISTIC c_vs_thd_n_max_h_at "VS threshold for increased engine speed limit, AT vehicle" VALUE 0x00962 _REC_VAL_20_u1 255. _CNV_A_R_LINEAR_____23_CM 0. 255. DISPLAY_IDENTIFIER C_VS_THD_N_MAX_H_AT FORMAT "%3.0" /end CHARACTERISTIC
/begin CHARACTERISTIC c_t_max_n_max_h_amt "Maximum time after exceeding the VS threshold, AMT vehicle" VALUE 0x0081f _REC_VAL_20_u1 25.5 _CNV_A_R_LINEAR_____24_CM 0. 25.5 DISPLAY_IDENTIFIER C_T_MAX_N_MAX_H_AMT FORMAT "%4.1" /end CHARACTERISTIC
/begin CHARACTERISTIC c_t_max_n_max_h_at "Maximum time after exceeding the VS threshold, AT vehicle" VALUE 0x00820 _REC_VAL_20_u1 25.5 _CNV_A_R_LINEAR_____24_CM 0. 25.5 DISPLAY_IDENTIFIER C_T_MAX_N_MAX_H_AT FORMAT "%4.1" /end CHARACTERISTIC
/begin CHARACTERISTIC c_t_max_n_max_h_mt "Maximum time after exceeding the VS threshold, MT vehicle" VALUE 0x00821 _REC_VAL_20_u1 25.5 _CNV_A_R_LINEAR_____24_CM 0. 25.5 DISPLAY_IDENTIFIER C_T_MAX_N_MAX_H_MT FORMAT "%4.1" /end CHARACTERISTIC
/begin MEASUREMENT lv_n_max_h "Boolean for Increased Engine speed limitation active" UBYTE _CNV_S_2_RANGE______5_CM 1 100. 0. 1. DISPLAY_IDENTIFIER LV_N_MAX_H ECU_ADDRESS 0x3fe09c BIT_MASK 0x1 /end MEASUREMENT
/begin MEASUREMENT lv_n_max_etc_lih "Engine speed limitation active" UBYTE _CNV_S_2_RANGE______5_CM 1 100. 0. 1. DISPLAY_IDENTIFIER LV_N_MAX_ETC_LIH ECU_ADDRESS 0x3fe096 BIT_MASK 0x1 /end MEASUREMENT
/begin MEASUREMENT lv_err_lam_dly_1 "Status diagnostic result of lambda trim control" UBYTE _CNV_S_2_RANGE______2_R_CM 1 100. 0. 255. DISPLAY_IDENTIFIER LV_ERR_LAM_DLY_1 ECU_ADDRESS 0x3fbb8c /end MEASUREMENT
/begin CHARACTERISTIC c_t_lam_dly_ad_max "???" VALUE 0x00460 _REC_VAL_20_s2 1279.9804688 _CNV_A_R_LINEAR_____272_CM -640. 639.9804688 DISPLAY_IDENTIFIER C_T_LAM_DLY_AD_MAX FORMAT "%7.2" /end CHARACTERISTIC
/begin CHARACTERISTIC c_t_lam_dly_ad_min "???" VALUE 0x00462 _REC_VAL_20_s2 1279.9804688 _CNV_A_R_LINEAR_____272_CM -640. 639.9804688 DISPLAY_IDENTIFIER C_T_LAM_DLY_AD_MIN FORMAT "%7.2" /end CHARACTERISTIC
/begin MEASUREMENT lv_err_lam_dly_2 "Status diagnostic result of lambda trim control" UBYTE _CNV_S_2_RANGE______2_R_CM 1 100. 0. 255. DISPLAY_IDENTIFIER LV_ERR_LAM_DLY_2 ECU_ADDRESS 0x3fbb90 /end MEASUREMENT
/begin MEASUREMENT lv_inh_diag_lam_dly_1 "Inhibition condition for the dynamic fuel trim diagnosis" UBYTE _CNV_S_2_RANGE______0_CM 1 100. 0. 1. DISPLAY_IDENTIFIER LV_INH_DIAG_LAM_DLY_1 ECU_ADDRESS 0x3fe4c7 /end MEASUREMENT
/begin MEASUREMENT lv_inh_diag_lam_dly_2 "Inhibition condition for the dynamic fuel trim diagnosis" UBYTE _CNV_S_2_RANGE______0_CM 1 100. 0. 1. DISPLAY_IDENTIFIER LV_INH_DIAG_LAM_DLY_2 ECU_ADDRESS 0x3fe4c8 /end MEASUREMENT
/begin CHARACTERISTIC c_pwm_min_obd2_lsh_down "Minimum permitted heater effective voltage PWM for upstream LSH OBDII diagnosis " VALUE 0x007b5 _REC_VAL_20_u1 99.609375 _CNV_A_R_LINEAR_____10_CM 0. 99.609375 DISPLAY_IDENTIFIER C_PWM_MIN_OBD2_LSH_DOWN FORMAT "%4.1" /end CHARACTERISTIC
/begin CHARACTERISTIC c_pwm_max_obd2_lsh_down "Maximum permitted heater effective voltage PWM for upstream LSH OBDII diagnosis " VALUE 0x007b3 _REC_VAL_20_u1 99.609375 _CNV_A_R_LINEAR_____10_CM 0. 99.609375 DISPLAY_IDENTIFIER C_PWM_MAX_OBD2_LSH_DOWN FORMAT "%4.1" /end CHARACTERISTIC
/begin CHARACTERISTIC c_t_dly_obd2_lsh_down "Minimum delay prior to checking status of OBDI heater / signal faults" VALUE 0x00804 _REC_VAL_20_u1 255. _CNV_A_R_LINEAR_____30_CM 0. 255. DISPLAY_IDENTIFIER C_T_DLY_OBD2_LSH_DOWN FORMAT "%3.0" /end CHARACTERISTIC
/begin CHARACTERISTIC c_temp_min_obd2_lsh_down "Temperature threshold under which downstream LSH OBDII diagnosis activated" VALUE 0x01904 _REC_VAL_20_u2 2047. _CNV_A_R_LINEAR_____7_CM 0. 2047. DISPLAY_IDENTIFIER C_TEMP_MIN_OBD2_LSH_DOWN FORMAT "%7.2" /end CHARACTERISTIC
/begin CHARACTERISTIC c_temp_set_obd2_lsh_down "Set temperature fordownstream LSH operation used to generate power integral" VALUE 0x01908 _REC_VAL_20_u2 2047. _CNV_A_R_LINEAR_____7_CM 0. 2047. DISPLAY_IDENTIFIER C_TEMP_SET_OBD2_LSH_DOWN FORMAT "%7.2" /end CHARACTERISTIC
/begin CHARACTERISTIC c_egy_min_obd2_lsh_down "Measure of minimum required cooling energy required atdownstream sensor prior to checking Ri threshold" VALUE 0x01542 _REC_VAL_20_u2 65535. _CNV_A_R_LINEAR_____291_CM 0. 65535. DISPLAY_IDENTIFIER C_EGY_MIN_OBD2_LSH_DOWN FORMAT "%5.0" /end CHARACTERISTIC
/begin CHARACTERISTIC c_tcc_obd2_lsh_down "Number of valid downstream LSH OBDII diagnosis cycles over which statistic evaluation to be carried out" VALUE 0x018c8 _REC_VAL_20_u2 1023. _CNV_A_R_LINEAR_____22_CM 0. 1023. DISPLAY_IDENTIFIER C_TCC_OBD2_LSH_DOWN FORMAT "%4.0" /end CHARACTERISTIC
/begin CHARACTERISTIC c_frc_obd2_lsh_down "Fault detection threshold, when exceeded, heater is determined to be defective during driving cycle" VALUE 0x015c6 _REC_VAL_20_u2 1023. _CNV_A_R_LINEAR_____22_CM 0. 1023. DISPLAY_IDENTIFIER C_FRC_OBD2_LSH_DOWN FORMAT "%4.0" /end CHARACTERISTIC
/begin CHARACTERISTIC ip_r_thd_obd2_lsh_down "Internal resistance threshold, when exceeded, heater is determined to be defective for current diagnosis cycle:" CURVE 0x01b24 _REC_CUR_20_u2_u2 65535. _CNV_A_R_LINEAR_____279_CM 0. 65535. DISPLAY_IDENTIFIER IP_R_THD_OBD2_LSH_DOWN FORMAT "%5.0"
 /begin AXIS_DESCR COM_AXIS lam_bank_1.ls_down_cur.r_down_ls_mdl_sens_new _CNV_A_R_LINEAR_____279_CM 4 0. 65535. FORMAT "%5.0" AXIS_PTS_REF ldp_r_down_ls_mdl_sens_new_r_thd /end AXIS_DESCR
/end CHARACTERISTIC
/begin AXIS_PTS ldp_r_down_ls_mdl_sens_new_r_thd "" 0x11118 lam_bank_1.ls_down_cur.r_down_ls_mdl_sens_new _REC_AXS_20_u2 65535. _CNV_A_R_LINEAR_____279_CM 4 0. 65535. DISPLAY_IDENTIFIER LDP_R_DOWN_LS_MDL_SENS_NEW_R_THD FORMAT "%5.0" /end AXIS_PTS
/begin AXIS_PTS ldp_maf_kgh__fac_maf_lsh_down "" 0x10cd2 maf_kgh _REC_AXS_20_u2 2047.96875 _CNV_A_R_LINEAR_____113_CM 6 0. 2047.96875 DISPLAY_IDENTIFIER LDP_MAF_KGH__FAC_MAF_LSH_DOWN FORMAT "%7.2" /end AXIS_PTS
/begin CHARACTERISTIC ip_fac_maf_lsh_down "Factor reflecting forced convection influence of cooling area, gas velocity and heat transfer coefficient" CURVE 0x00b3c _REC_CUR_20_u1_u2 15.9375 _CNV_A_R_LINEAR_____46_CM 0. 15.9375 DISPLAY_IDENTIFIER IP_FAC_MAF_LSH_DOWN FORMAT "%5.2"
 /begin AXIS_DESCR COM_AXIS maf_kgh _CNV_A_R_LINEAR_____113_CM 6 0. 2047.96875 FORMAT "%7.2" AXIS_PTS_REF ldp_maf_kgh__fac_maf_lsh_down /end AXIS_DESCR
/end CHARACTERISTIC
/begin CHARACTERISTIC ip_fac_teg_mdl_ls_down "Factor for internal resistance threshold depending on exhaust gas temperature" CURVE 0x00bb2 _REC_CUR_20_u1_u2 127.5 _CNV_A_R_LINEAR_____388_CM 0. 127.5 DISPLAY_IDENTIFIER IP_FAC_TEG_MDL_LS_DOWN FORMAT "%5.1"
 /begin AXIS_DESCR COM_AXIS online_dummy _CNV_A_R_LINEAR_____7_CM 8 0. 2047. FORMAT "%7.2" AXIS_PTS_REF ldp_ttip_ref_ls_down_ip_fac_teg /end AXIS_DESCR
/end CHARACTERISTIC
/begin AXIS_PTS ldp_ttip_ref_ls_down_ip_fac_teg "" 0x113f2 online_dummy _REC_AXS_20_u2 2047. _CNV_A_R_LINEAR_____7_CM 8 0. 2047. DISPLAY_IDENTIFIER LDP_TTIP_REF_LS_DOWN_IP_FAC_TEG FORMAT "%7.2" /end AXIS_PTS
/begin CHARACTERISTIC c_map_drv1_max_load_tps_plaus "" VALUE 0x0041a _REC_VAL_20_s2 165.8 _CNV_A_R_LINEAR_____258_CM -82.90000000000001 82.90000000000001 DISPLAY_IDENTIFIER C_MAP_DRV1_MAX_LOAD_TPS_PLAUS FORMAT "%7.3" /end CHARACTERISTIC
/begin CHARACTERISTIC c_map_drv1_min_load_tps_plaus "" VALUE 0x0041c _REC_VAL_20_s2 165.8 _CNV_A_R_LINEAR_____258_CM -82.90000000000001 82.90000000000001 DISPLAY_IDENTIFIER C_MAP_DRV1_MIN_LOAD_TPS_PLAUS FORMAT "%7.3" /end CHARACTERISTIC
/begin CHARACTERISTIC c_n_max_load_tps_plaus "" VALUE 0x01704 _REC_VAL_20_u2 8160. _CNV_A_R_LINEAR_____11_CM 0. 8160. DISPLAY_IDENTIFIER C_N_MAX_LOAD_TPS_PLAUS FORMAT "%4.0" /end CHARACTERISTIC
/begin CHARACTERISTIC c_n_min_load_tps_plaus "" VALUE 0x0170e _REC_VAL_20_u2 8160. _CNV_A_R_LINEAR_____11_CM 0. 8160. DISPLAY_IDENTIFIER C_N_MIN_LOAD_TPS_PLAUS FORMAT "%4.0" /end CHARACTERISTIC
/begin MEASUREMENT lv_amp_ctl_rst "Control bit for resetting of pressure controller" UBYTE _CNV_S_2_RANGE______0_CM 1 100. 0. 1. DISPLAY_IDENTIFIER LV_AMP_CTL_RST ECU_ADDRESS 0x3fe4e6 BIT_MASK 0x1 /end MEASUREMENT
/begin MEASUREMENT lv_ar_red_ctl_rst "Control bit for resetting of reduced area controller" UBYTE _CNV_S_2_RANGE______0_CM 1 100. 0. 1. DISPLAY_IDENTIFIER LV_AR_RED_CTL_RST ECU_ADDRESS 0x3fe4e7 BIT_MASK 0x1 /end MEASUREMENT
/begin MEASUREMENT lv_ratio_chk_err "Boolean for actual value MAF or TPS ratio check is present" UBYTE _CNV_S_2_RANGE______0_CM 1 100. 0. 1. DISPLAY_IDENTIFIER LV_RATIO_CHK_ERR ECU_ADDRESS 0x3fe4e8 BIT_MASK 0x1 /end MEASUREMENT
/begin CHARACTERISTIC c_amp_mdl_dif_max "Upper threshold for pressure controller plausibility check" VALUE 0x003ac _REC_VAL_20_s2 5434. _CNV_A_R_LINEAR_____108_CM -2717.04 2716.96 DISPLAY_IDENTIFIER C_AMP_MDL_DIF_MAX FORMAT "%8.2" /end CHARACTERISTIC
/begin CHARACTERISTIC c_amp_mdl_dif_min "Lower threshold for pressure controller plausibility check" VALUE 0x003ae _REC_VAL_20_s2 5434. _CNV_A_R_LINEAR_____108_CM -2717.04 2716.96 DISPLAY_IDENTIFIER C_AMP_MDL_DIF_MIN FORMAT "%8.2" /end CHARACTERISTIC
/begin CHARACTERISTIC c_crlc_maf_dif_hfm_mmv "Constant for MAF_DIF_MFM filtering" VALUE 0x0062f _REC_VAL_20_u1 0.9960940000000002 _CNV_A_R_LINEAR_____50_CM 0. 0.996094 DISPLAY_IDENTIFIER C_CRLC_MAF_DIF_HFM_MMV FORMAT "%5.3" /end CHARACTERISTIC
/begin CHARACTERISTIC c_pq_maf_plaus "Treshold for switching off the diagnosis" VALUE 0x01746 _REC_VAL_20_u2 0.9999847 _CNV_A_R_LINEAR_____389_CM 0. 0.9999847 DISPLAY_IDENTIFIER C_PQ_MAF_PLAUS FORMAT "%7.5" /end CHARACTERISTIC
/begin CHARACTERISTIC c_maf_dif_hfm_mdl_mmv "Threshold  for detecting to high difference between air mass differences" VALUE 0x01648 _REC_VAL_20_u2 2047.96875 _CNV_A_R_LINEAR_____113_CM 0. 2047.96875 DISPLAY_IDENTIFIER C_MAF_DIF_HFM_MDL_MMV FORMAT "%7.2" /end CHARACTERISTIC
/begin CHARACTERISTIC c_maf_turb_ratio_min_isa_check "Threshold for detecting ISA error" VALUE 0x00729 _REC_VAL_20_u1 0.9960940000000002 _CNV_A_R_LINEAR_____50_CM 0. 0.996094 DISPLAY_IDENTIFIER C_MAF_TURB_RATIO_MIN_ISA_CHECK FORMAT "%5.3" /end CHARACTERISTIC
/begin CHARACTERISTIC c_t_err_isa_amp_plaus "Threshold to distinguish between ISA and AMP error" VALUE 0x0080e _REC_VAL_20_u1 25.5 _CNV_A_R_LINEAR_____24_CM 0. 25.5 DISPLAY_IDENTIFIER C_T_ERR_ISA_AMP_PLAUS FORMAT "%4.1" /end CHARACTERISTIC
/begin MEASUREMENT ar_red_tot_bas "Sum of AR_RED_BAS and AR_RED_ISA_BAS" UWORD _CNV_A_R_LINEAR_____333_CM 1 100. 0. 58.592855 DISPLAY_IDENTIFIER AR_RED_TOT_BAS ECU_ADDRESS 0x3fd722 BYTE_ORDER MSB_LAST FORMAT "%7.4" /end MEASUREMENT
/begin CHARACTERISTIC ip_ar_red_dif_max "Maximum basic reduced opening area at the throttle and at ISA for detecting error" CURVE 0x08b30 _REC_CUR_20_u2_u2 99.99847412 _CNV_A_R_LINEAR_____159_CM -50. 49.99847412 DISPLAY_IDENTIFIER IP_AR_RED_DIF_MAX FORMAT "%7.3"
 /begin AXIS_DESCR COM_AXIS ar_red_tot_bas _CNV_A_R_LINEAR_____333_CM 6 0. 58.592855 FORMAT "%7.4" AXIS_PTS_REF ldpm_ar_red_tot_bas /end AXIS_DESCR
/end CHARACTERISTIC
/begin CHARACTERISTIC ip_ar_red_dif_min "Minimum basic reduced opening area at the throttle and ISA for detecting error" CURVE 0x08b3c _REC_CUR_20_u2_u2 99.99847412 _CNV_A_R_LINEAR_____159_CM -50. 49.99847412 DISPLAY_IDENTIFIER IP_AR_RED_DIF_MIN FORMAT "%7.3"
 /begin AXIS_DESCR COM_AXIS ar_red_tot_bas _CNV_A_R_LINEAR_____333_CM 6 0. 58.592855 FORMAT "%7.4" AXIS_PTS_REF ldpm_ar_red_tot_bas /end AXIS_DESCR
/end CHARACTERISTIC
/begin MEASUREMENT lv_sym_load "Load difference exists" UBYTE _CNV_A_R_LINEAR_____22_CM 1 100. 0. 1. DISPLAY_IDENTIFIER LV_SYM_LOAD ECU_ADDRESS 0x3fe4ec FORMAT "%1.0" /end MEASUREMENT
/begin MEASUREMENT maf_kgh_mff "Mass air flow calculated out of mass fuel flow" UWORD _CNV_A_R_LINEAR_____113_CM 1 100. 0. 2047.96875 DISPLAY_IDENTIFIER MAF_KGH_MFF ECU_ADDRESS 0x3fd724 BYTE_ORDER MSB_LAST FORMAT "%7.2" /end MEASUREMENT
/begin MEASUREMENT maf_thr_opl "Mass air flow at Throttle without adjusting on HFM" UWORD _CNV_A_R_LINEAR_____113_CM 1 100. 0. 2047.96875 DISPLAY_IDENTIFIER MAF_THR_OPL ECU_ADDRESS 0x3fd726 BYTE_ORDER MSB_LAST FORMAT "%7.2" /end MEASUREMENT
/begin MEASUREMENT maf_isa_opl "Mass air flow at ISA without adjusting on HFM" UWORD _CNV_A_R_LINEAR_____113_CM 1 100. 0. 2047.96875 DISPLAY_IDENTIFIER MAF_ISA_OPL ECU_ADDRESS 0x3fd728 BYTE_ORDER MSB_LAST FORMAT "%7.2" /end MEASUREMENT
/begin MEASUREMENT maf_thr_isa_tot_opl "Mass air flow without adjusting on HFM" UWORD _CNV_A_R_LINEAR_____113_CM 1 100. 0. 2047.96875 DISPLAY_IDENTIFIER MAF_THR_ISA_TOT_OPL ECU_ADDRESS 0x3fd72a BYTE_ORDER MSB_LAST FORMAT "%7.2" /end MEASUREMENT
/begin MEASUREMENT maf_dif_hfm_mmv "Filtered difference between MAF_KGH_MFF and MAF_KGH_MES" SWORD _CNV_A_R_LINEAR_____113_CM 1 100. -1024. 1023.96875 DISPLAY_IDENTIFIER MAF_DIF_HFM_MMV ECU_ADDRESS 0x3fd72c BYTE_ORDER MSB_LAST FORMAT "%8.2" /end MEASUREMENT
/begin MEASUREMENT maf_dif_mdl_mmv "Filtered difference between MAF_KGH_MFF and MAF_THR_ISA_TOT_OPL" SWORD _CNV_A_R_LINEAR_____113_CM 1 100. -1024. 1023.96875 DISPLAY_IDENTIFIER MAF_DIF_MDL_MMV ECU_ADDRESS 0x3fd72e BYTE_ORDER MSB_LAST FORMAT "%8.2" /end MEASUREMENT
/begin MEASUREMENT t_err_isa_plaus "Timer for detecting ISA error" UBYTE _CNV_A_R_LINEAR_____24_CM 1 100. 0. 25.5 DISPLAY_IDENTIFIER T_ERR_ISA_PLAUS ECU_ADDRESS 0x3fe4e9 FORMAT "%4.1" /end MEASUREMENT
/begin MEASUREMENT t_err_amp_plaus "Timer for detecting AMP error" UBYTE _CNV_A_R_LINEAR_____24_CM 1 100. 0. 25.5 DISPLAY_IDENTIFIER T_ERR_AMP_PLAUS ECU_ADDRESS 0x3fe4ea FORMAT "%4.1" /end MEASUREMENT
/begin AXIS_PTS ldpm_ar_red_tot_bas "" 0x11578 ar_red_tot_bas _REC_AXS_20_u2 58.592855 _CNV_A_R_LINEAR_____333_CM 6 0. 58.592855 DISPLAY_IDENTIFIER LDPM_AR_RED_TOT_BAS FORMAT "%7.4" /end AXIS_PTS
/begin CHARACTERISTIC c_crlc_maf_dif_mdl_mmv "Constant for MAF_DIF_MDL filtering" VALUE 0x00630 _REC_VAL_20_u1 0.9960940000000002 _CNV_A_R_LINEAR_____50_CM 0. 0.996094 DISPLAY_IDENTIFIER C_CRLC_MAF_DIF_MDL_MMV FORMAT "%5.3" /end CHARACTERISTIC
/begin MEASUREMENT lv_sap_cnl "SAP break-off in case of  mechanically jammed SAV before plausibility check" UBYTE _CNV_S_2_RANGE______0_CM 1 100. 0. 1. DISPLAY_IDENTIFIER LV_SAP_CNL ECU_ADDRESS 0x3fe0dc /end MEASUREMENT
/begin MEASUREMENT state_diag_sa_ls "State_SA diagnosis" UBYTE _CNV_S_9_STATE_DIAG_404_CM 1 100. 0. 8. DISPLAY_IDENTIFIER STATE_DIAG_SA_LS ECU_ADDRESS 0x3fe0da /end MEASUREMENT
/begin MEASUREMENT lv_sa_min_flow_diag "State Minimum secondary air flow rate diagnosis condition" UBYTE _CNV_S_2_RANGE______191_CM 1 100. 0. 1. DISPLAY_IDENTIFIER LV_SA_MIN_FLOW_DIAG ECU_ADDRESS 0x3fe0dd BIT_MASK 0x1 /end MEASUREMENT
/begin MEASUREMENT lv_sa_min_flow_diag_eol "Minimum secondary air flow rate diagnosis is finished" UBYTE _CNV_S_2_RANGE______191_CM 1 100. 0. 1. DISPLAY_IDENTIFIER LV_SA_MIN_FLOW_DIAG_EOL ECU_ADDRESS 0x3fe0de BIT_MASK 0x1 /end MEASUREMENT
/begin MEASUREMENT lv_inh_diag_sa "Secondary air system diagnosis: application incidence to inhibit the diagnosis" UBYTE _CNV_S_2_RANGE______0_CM 1 100. 0. 1. DISPLAY_IDENTIFIER LV_INH_DIAG_SA ECU_ADDRESS 0x3fe0ea /end MEASUREMENT
/begin MEASUREMENT lv_err_obd2_lsh_down_1 "Boolean flag indicating that fault is present and has been debounced" UBYTE _CNV_S_2_RANGE______2_R_CM 1 100. 0. 255. DISPLAY_IDENTIFIER LV_ERR_OBD2_LSH_DOWN_1 ECU_ADDRESS 0x3fba70 /end MEASUREMENT
/begin MEASUREMENT lv_err_obd2_lsh_down_2 "Boolean flag indicating that fault is present and has been debounced" UBYTE _CNV_S_2_RANGE______2_R_CM 1 100. 0. 255. DISPLAY_IDENTIFIER LV_ERR_OBD2_LSH_DOWN_2 ECU_ADDRESS 0x3fba74 /end MEASUREMENT
/begin MEASUREMENT state_diag_sa_safm "States of secondary air system diagnosis" UBYTE _CNV_S_7_STATE_DIAG_406_CM 1 100. 0. 6. DISPLAY_IDENTIFIER STATE_DIAG_SA_SAFM ECU_ADDRESS 0x3fe0ee /end MEASUREMENT
/begin MEASUREMENT state_diag_sa_err "Error states of secondary air system diagnosis" UBYTE _CNV_S_7_STATE_DIAG_407_CM 1 100. 0. 6. DISPLAY_IDENTIFIER STATE_DIAG_SA_ERR ECU_ADDRESS 0x3fe0f3 /end MEASUREMENT
/begin MEASUREMENT lv_safm_monit_diag_end "Control flag signals the end of SAFM diagnosis(1.1)" UBYTE _CNV_S_2_RANGE______0_CM 1 100. 0. 1. DISPLAY_IDENTIFIER LV_SAFM_MONIT_DIAG_END ECU_ADDRESS 0x3fe0f5 /end MEASUREMENT
/begin MEASUREMENT lv_sa_min_diag_end "Control flag signals the end of minimum or maximum deviation diagnosis(1.2)" UBYTE _CNV_S_2_RANGE______0_CM 1 100. 0. 1. DISPLAY_IDENTIFIER LV_SA_MIN_DIAG_END ECU_ADDRESS 0x3fe0f6 /end MEASUREMENT
/begin MEASUREMENT lv_sav_diag_end "Control flag signals the end of SAV diagnosis(1.3)" UBYTE _CNV_S_2_RANGE______0_CM 1 100. 0. 1. DISPLAY_IDENTIFIER LV_SAV_DIAG_END ECU_ADDRESS 0x3fe0f7 /end MEASUREMENT
/begin MEASUREMENT lv_sa_t_diag_start "Control flag signals the start of the diagnose timer" UBYTE _CNV_S_2_RANGE______0_CM 1 100. 0. 1. DISPLAY_IDENTIFIER LV_SA_T_DIAG_START ECU_ADDRESS 0x3fe0f8 /end MEASUREMENT
/begin MEASUREMENT ctr_safm_diag "Counter for Min/Max of SAF_KGH during SAFM diagnosis active" UWORD _CNV_A_R_LINEAR_____1_CM 1 100. 0. 65534. DISPLAY_IDENTIFIER CTR_SAFM_DIAG ECU_ADDRESS 0x3fd266 BYTE_ORDER MSB_LAST FORMAT "%5.0" /end MEASUREMENT
/begin MEASUREMENT saf_kgh_max_diag "Maximum value of SAF_KGH during the time ctr_safm_diag or ctr_sav_thd" UWORD _CNV_A_R_LINEAR_____47_CM 1 100. 0. 1023.984375 DISPLAY_IDENTIFIER SAF_KGH_MAX_DIAG ECU_ADDRESS 0x3fd268 BYTE_ORDER MSB_LAST FORMAT "%7.2" /end MEASUREMENT
/begin MEASUREMENT saf_kgh_min_diag "Minimum value of SAF_KGH during the time ctr_safm_diag or ctr_sav_thd" UWORD _CNV_A_R_LINEAR_____47_CM 1 100. 0. 1023.984375 DISPLAY_IDENTIFIER SAF_KGH_MIN_DIAG ECU_ADDRESS 0x3fd26a BYTE_ORDER MSB_LAST FORMAT "%7.2" /end MEASUREMENT
/begin MEASUREMENT sum_saf_diag_max "Number of  maximum air flow diagnosis steps" UWORD _CNV_A_R_LINEAR_____1_CM 1 100. 0. 65534. DISPLAY_IDENTIFIER SUM_SAF_DIAG_MAX ECU_ADDRESS 0x3fd26e BYTE_ORDER MSB_LAST FORMAT "%5.0" /end MEASUREMENT
/begin MEASUREMENT sum_saf_diag_quo_max "Sum of diagnosis value maximum air flow" ULONG _CNV_A_R_LINEAR_____408_CM 1 100. 0. 16711170. DISPLAY_IDENTIFIER SUM_SAF_DIAG_QUO_MAX ECU_ADDRESS 0x3fc8e0 BYTE_ORDER MSB_LAST FORMAT "%12.3" /end MEASUREMENT
/begin MEASUREMENT saf_diag_quo_max "Diagnosis value of maximum air flow (weighted)" UWORD _CNV_A_R_LINEAR_____408_CM 1 100. 0. 255. DISPLAY_IDENTIFIER SAF_DIAG_QUO_MAX ECU_ADDRESS 0x3fd270 BYTE_ORDER MSB_LAST FORMAT "%7.3" /end MEASUREMENT
/begin MEASUREMENT sum_saf_diag_min "Number of  minimum air flow diagnosis steps" UWORD _CNV_A_R_LINEAR_____1_CM 1 100. 0. 65534. DISPLAY_IDENTIFIER SUM_SAF_DIAG_MIN ECU_ADDRESS 0x3fd272 BYTE_ORDER MSB_LAST FORMAT "%5.0" /end MEASUREMENT
/begin MEASUREMENT sum_saf_diag_quo_min "Sum of diagnosis value minimum air flow" ULONG _CNV_A_R_LINEAR_____408_CM 1 100. 0. 16711170. DISPLAY_IDENTIFIER SUM_SAF_DIAG_QUO_MIN ECU_ADDRESS 0x3fc8e4 BYTE_ORDER MSB_LAST FORMAT "%12.3" /end MEASUREMENT
/begin MEASUREMENT saf_diag_quo_min "Diagnosis value of minimum air flow (weighted)" UWORD _CNV_A_R_LINEAR_____408_CM 1 100. 0. 255. DISPLAY_IDENTIFIER SAF_DIAG_QUO_MIN ECU_ADDRESS 0x3fd274 BYTE_ORDER MSB_LAST FORMAT "%7.3" /end MEASUREMENT
/begin MEASUREMENT saf_kgh_diag "Difference of model and actual value of SAF" SWORD _CNV_A_R_LINEAR_____409_CM 1 100. -512. 511.98 DISPLAY_IDENTIFIER SAF_KGH_DIAG ECU_ADDRESS 0x3fd27e BYTE_ORDER MSB_LAST FORMAT "%7.3" /end MEASUREMENT
/begin MEASUREMENT saf_kgh_dif_sav_diag "Difference of minimum and maximum value of SAF_KGH_xxx_DIAG during the SAV-diagnosis" UWORD _CNV_A_R_LINEAR_____47_CM 1 100. 0. 1023.984375 DISPLAY_IDENTIFIER SAF_KGH_DIF_SAV_DIAG ECU_ADDRESS 0x3fd276 BYTE_ORDER MSB_LAST FORMAT "%7.2" /end MEASUREMENT
/begin MEASUREMENT lv_sap_sav_cnl "End of Secondary air injection in reason of SA error" UBYTE _CNV_S_2_RANGE______0_CM 1 100. 0. 1. DISPLAY_IDENTIFIER LV_SAP_SAV_CNL ECU_ADDRESS 0x3fe0f1 /end MEASUREMENT
/begin CHARACTERISTIC id_saf_kgh_diag_min "minimum deviation of air mass flow without emissions-deterioration" MAP 0x03ed5 _REC_MAP_20_u1_u1_u1 63.75 _CNV_A_R_LINEAR_____410_CM 0. 63.75 DISPLAY_IDENTIFIER ID_SAF_KGH_DIAG_MIN
 /begin AXIS_DESCR COM_AXIS n_32 _CNV_A_R_LINEAR_____16_CM 8 0. 8160. FORMAT "%4.0" AXIS_PTS_REF ldpm_n_32_id_saf_kgh_diag_min /end AXIS_DESCR
 /begin AXIS_DESCR COM_AXIS maf _CNV_A_R_LINEAR_____27_CM 8 0. 1389. FORMAT "%4.0" AXIS_PTS_REF ldpm_maf_id_saf_kgh_diag_min /end AXIS_DESCR
/end CHARACTERISTIC
/begin CHARACTERISTIC id_saf_kgh_diag_max "Detection of leaky in the secondary air system" MAP 0x03e95 _REC_MAP_20_u1_u1_u1 63.75 _CNV_A_R_LINEAR_____410_CM 0. 63.75 DISPLAY_IDENTIFIER ID_SAF_KGH_DIAG_MAX
 /begin AXIS_DESCR COM_AXIS n_32 _CNV_A_R_LINEAR_____16_CM 8 0. 8160. FORMAT "%4.0" AXIS_PTS_REF ldpm_n_32_id_saf_kgh_diag_max /end AXIS_DESCR
 /begin AXIS_DESCR COM_AXIS maf _CNV_A_R_LINEAR_____27_CM 8 0. 1389. FORMAT "%4.0" AXIS_PTS_REF ldpm_maf_id_saf_kgh_diag_max /end AXIS_DESCR
/end CHARACTERISTIC
/begin CHARACTERISTIC c_sum_saf_diag_min "Counter for minimum air flow deviation" VALUE 0x0179c _REC_VAL_20_u2 65534. _CNV_A_R_LINEAR_____1_CM 0. 65534. DISPLAY_IDENTIFIER C_SUM_SAF_DIAG_MIN FORMAT "%5.0" /end CHARACTERISTIC
/begin CHARACTERISTIC c_saf_diag_min "Error detection threshold for minimum deviation" VALUE 0x01778 _REC_VAL_20_u2 255. _CNV_A_R_LINEAR_____408_CM 0. 255. DISPLAY_IDENTIFIER C_SAF_DIAG_MIN FORMAT "%7.3" /end CHARACTERISTIC
/begin CHARACTERISTIC c_saf_diag_max "Error detection threshold for maximum deviation" VALUE 0x01776 _REC_VAL_20_u2 255. _CNV_A_R_LINEAR_____408_CM 0. 255. DISPLAY_IDENTIFIER C_SAF_DIAG_MAX FORMAT "%7.3" /end CHARACTERISTIC
/begin CHARACTERISTIC c_t_dly_diag_safm "Time delay of SAFM-diagnosis" VALUE 0x017e8 _REC_VAL_20_u2 6553.5 _CNV_A_R_LINEAR_____24_CM 0. 6553.5 DISPLAY_IDENTIFIER C_T_DLY_DIAG_SAFM FORMAT "%6.1" /end CHARACTERISTIC
/begin CHARACTERISTIC c_saf_kgh_dif "Difference threshold for error detection \"SA-tube blocked\"" VALUE 0x0177a _REC_VAL_20_u2 1023.984375 _CNV_A_R_LINEAR_____47_CM 0. 1023.984375 DISPLAY_IDENTIFIER C_SAF_KGH_DIF FORMAT "%7.2" /end CHARACTERISTIC
/begin CHARACTERISTIC c_saf_mes_thd "Absolute threshold for detection SAP is started" VALUE 0x01780 _REC_VAL_20_u2 1023.984375 _CNV_A_R_LINEAR_____47_CM 0. 1023.984375 DISPLAY_IDENTIFIER C_SAF_MES_THD FORMAT "%7.2" /end CHARACTERISTIC
/begin CHARACTERISTIC c_t_max_diag_sav "Maximum operating life of SAV-diagnosis" VALUE 0x0185c _REC_VAL_20_u2 6553.5 _CNV_A_R_LINEAR_____24_CM 0. 6553.5 DISPLAY_IDENTIFIER C_T_MAX_DIAG_SAV FORMAT "%6.1" /end CHARACTERISTIC
/begin CHARACTERISTIC c_sum_sav_thd "Number of check-up" VALUE 0x007d0 _REC_VAL_20_u1 255. _CNV_A_R_LINEAR_____1_CM 0. 255. DISPLAY_IDENTIFIER C_SUM_SAV_THD FORMAT "%3.0" /end CHARACTERISTIC
/begin CHARACTERISTIC c_saf_kgh_dif_sav_diag "Difference threshold for error detection \"SAV_ERR\"" VALUE 0x0177c _REC_VAL_20_u2 1023.984375 _CNV_A_R_LINEAR_____47_CM 0. 1023.984375 DISPLAY_IDENTIFIER C_SAF_KGH_DIF_SAV_DIAG FORMAT "%7.2" /end CHARACTERISTIC
/begin CHARACTERISTIC c_maf_kgh_min_saf "MAF-threshold for start of SAV-diagnosis" VALUE 0x01692 _REC_VAL_20_u2 16383.75 _CNV_A_R_LINEAR_____410_CM 0. 16383.75 DISPLAY_IDENTIFIER C_MAF_KGH_MIN_SAF FORMAT "%7.1" /end CHARACTERISTIC
/begin CHARACTERISTIC c_t_dly_diag_sav "Delelaytime after end of secondary air function for start of SAV-diagnosis" VALUE 0x017ec _REC_VAL_20_u2 6553.5 _CNV_A_R_LINEAR_____24_CM 0. 6553.5 DISPLAY_IDENTIFIER C_T_DLY_DIAG_SAV FORMAT "%6.1" /end CHARACTERISTIC
/begin AXIS_PTS ldpm_n_32_id_saf_kgh_diag_min "" 0x080de n_32 _REC_AXS_20_u1 8160. _CNV_A_R_LINEAR_____16_CM 8 0. 8160. DISPLAY_IDENTIFIER LDPM_N_32_ID_SAF_KGH_DIAG_MIN FORMAT "%4.0" /end AXIS_PTS
/begin AXIS_PTS ldpm_n_32_id_saf_kgh_diag_max "" 0x080d5 n_32 _REC_AXS_20_u1 8160. _CNV_A_R_LINEAR_____16_CM 8 0. 8160. DISPLAY_IDENTIFIER LDPM_N_32_ID_SAF_KGH_DIAG_MAX FORMAT "%4.0" /end AXIS_PTS
/begin AXIS_PTS ldpm_maf_id_saf_kgh_diag_min "" 0x07fba maf _REC_AXS_20_u1 1389. _CNV_A_R_LINEAR_____27_CM 8 0. 1389. DISPLAY_IDENTIFIER LDPM_MAF_ID_SAF_KGH_DIAG_MIN FORMAT "%4.0" /end AXIS_PTS
/begin AXIS_PTS ldpm_maf_id_saf_kgh_diag_max "" 0x07fb1 maf _REC_AXS_20_u1 1389. _CNV_A_R_LINEAR_____27_CM 8 0. 1389. DISPLAY_IDENTIFIER LDPM_MAF_ID_SAF_KGH_DIAG_MAX FORMAT "%4.0" /end AXIS_PTS
/begin MEASUREMENT sum_sav_thd "Counter for Min/Max of SAF_KGH during SAV diagnosis active" UBYTE _CNV_A_R_LINEAR_____1_CM 1 100. 0. 255. DISPLAY_IDENTIFIER SUM_SAV_THD ECU_ADDRESS 0x3fe0f4 FORMAT "%3.0" /end MEASUREMENT
/begin MEASUREMENT t_dly_intr_diag_safm "Time delay after secair interrupt to continue the SA monitoring" UBYTE _CNV_A_R_LINEAR_____24_CM 1 100. 0. 25.5 DISPLAY_IDENTIFIER T_DLY_INTR_DIAG_SAFM ECU_ADDRESS 0x3fe0ef FORMAT "%4.1" /end MEASUREMENT
/begin CHARACTERISTIC c_t_dly_intr_diag_safm "Time delay after leaving the STATE_SA = INTERRUPT to continue the SA monitoring" VALUE 0x007f8 _REC_VAL_20_u1 25.5 _CNV_A_R_LINEAR_____24_CM 0. 25.5 DISPLAY_IDENTIFIER C_T_DLY_INTR_DIAG_SAFM FORMAT "%4.1" /end CHARACTERISTIC
/begin MEASUREMENT saf_diag_max "Mean diagnosis value of maximum air flow " UWORD _CNV_A_R_LINEAR_____408_CM 1 100. 0. 255. DISPLAY_IDENTIFIER SAF_DIAG_MAX ECU_ADDRESS 0x3fd264 BYTE_ORDER MSB_LAST FORMAT "%7.3" /end MEASUREMENT
/begin MEASUREMENT saf_diag_max_sae "Mean diagnosis value of maximum air flow for SAE" UWORD _CNV_A_R_LINEAR_____408_CM 1 100. 0. 255. DISPLAY_IDENTIFIER SAF_DIAG_MAX_SAE ECU_ADDRESS 0x3fd25e BYTE_ORDER MSB_LAST FORMAT "%7.3" /end MEASUREMENT
/begin MEASUREMENT saf_diag_min_sae "Mean diagnosis value of minimum air flow for SAE" UWORD _CNV_A_R_LINEAR_____408_CM 1 100. 0. 255. DISPLAY_IDENTIFIER SAF_DIAG_MIN_SAE ECU_ADDRESS 0x3fd25c BYTE_ORDER MSB_LAST FORMAT "%7.3" /end MEASUREMENT
/begin MEASUREMENT saf_kgh_dif "Difference of minimum and maximum value of SAF_KGH_xxx_DIAG " UWORD _CNV_A_R_LINEAR_____47_CM 1 100. 0. 1023.984375 DISPLAY_IDENTIFIER SAF_KGH_DIF ECU_ADDRESS 0x3fd26c BYTE_ORDER MSB_LAST FORMAT "%7.2" /end MEASUREMENT
/begin MEASUREMENT saf_kgh_dif_sae "Difference of minimum and maximum value for SAE" UWORD _CNV_A_R_LINEAR_____47_CM 1 100. 0. 1023.984375 DISPLAY_IDENTIFIER SAF_KGH_DIF_SAE ECU_ADDRESS 0x3fd260 BYTE_ORDER MSB_LAST FORMAT "%7.2" /end MEASUREMENT
/begin MEASUREMENT lv_err_sa_sys "Present failure: Minimum secair flow rate failure after filtering" UBYTE _CNV_S_2_RANGE______2_R_CM 1 100. 0. 255. DISPLAY_IDENTIFIER LV_ERR_SA_SYS ECU_ADDRESS 0x3fba30 /end MEASUREMENT
/begin MEASUREMENT lv_err_sa_safm "Present failure: Component Secondary air flow meter failure" UBYTE _CNV_S_2_RANGE______2_R_CM 1 100. 0. 255. DISPLAY_IDENTIFIER LV_ERR_SA_SAFM ECU_ADDRESS 0x3fba28 /end MEASUREMENT
/begin CHARACTERISTIC c_saf_mdl_cor_eol "Secondary air model value correction in reason of EOL-test" VALUE 0x00456 _REC_VAL_20_s2 1023.98 _CNV_A_R_LINEAR_____409_CM -512. 511.98 DISPLAY_IDENTIFIER C_SAF_MDL_COR_EOL FORMAT "%7.3" /end CHARACTERISTIC
/begin CHARACTERISTIC c_t_dly_diag_safm_eol "Time delay of SAFM-diagnosis for EOL-Test" VALUE 0x017ea _REC_VAL_20_u2 6553.5 _CNV_A_R_LINEAR_____24_CM 0. 6553.5 DISPLAY_IDENTIFIER C_T_DLY_DIAG_SAFM_EOL FORMAT "%6.1" /end CHARACTERISTIC
/begin CHARACTERISTIC c_maf_kgh_min_saf_eol "MAF-threshold for start of SAV-diagnosis for EOL-Test" VALUE 0x01694 _REC_VAL_20_u2 16383.75 _CNV_A_R_LINEAR_____410_CM 0. 16383.75 DISPLAY_IDENTIFIER C_MAF_KGH_MIN_SAF_EOL FORMAT "%7.1" /end CHARACTERISTIC
/begin MEASUREMENT saf_diag_min "Mean diagnosis value of minimum air flow" UWORD _CNV_A_R_LINEAR_____408_CM 1 100. 0. 255. DISPLAY_IDENTIFIER SAF_DIAG_MIN ECU_ADDRESS 0x3fd262 BYTE_ORDER MSB_LAST FORMAT "%7.3" /end MEASUREMENT
/begin MEASUREMENT sum_saf_kgh "Sum of SAF value during SAFM_SAFM_MONIT" ULONG _CNV_A_R_LINEAR_____45_CM 1 100. 0. 67108863.98 DISPLAY_IDENTIFIER SUM_SAF_KGH ECU_ADDRESS 0x3fc8e8 BYTE_ORDER MSB_LAST FORMAT "%11.2" /end MEASUREMENT
/begin CHARACTERISTIC c_sum_saf_diag_max "Counter for maximum air flow deviation" VALUE 0x0179a _REC_VAL_20_u2 65534. _CNV_A_R_LINEAR_____1_CM 0. 65534. DISPLAY_IDENTIFIER C_SUM_SAF_DIAG_MAX FORMAT "%5.0" /end CHARACTERISTIC
/begin CHARACTERISTIC c_sum_saf_kgh "Cumulated SAF_KGH threshold to detect SAFM-error" VALUE 0x0179e _REC_VAL_20_u2 16383.75 _CNV_A_R_LINEAR_____410_CM 0. 16383.75 DISPLAY_IDENTIFIER C_SUM_SAF_KGH FORMAT "%7.1" /end CHARACTERISTIC
/begin CHARACTERISTIC c_saf_kgh_safm "Cumulated SAF_KGH threshold to detect SAFM stucked" VALUE 0x0177e _REC_VAL_20_u2 16383.75 _CNV_A_R_LINEAR_____410_CM 0. 16383.75 DISPLAY_IDENTIFIER C_SAF_KGH_SAFM FORMAT "%7.1" /end CHARACTERISTIC
/begin AXIS_PTS ldp_tco_st_id_sum_safm_diag "" 0x07e1e tco_st _REC_AXS_20_u1 190.5 _CNV_A_R_LINEAR_____12_CM 8 -48. 142.5 DISPLAY_IDENTIFIER LDP_TCO_ST_ID_SUM_SAFM_DIAG FORMAT "%5.1" /end AXIS_PTS
/begin CHARACTERISTIC id_sum_safm_diag "Number of measurements for diagnosis" CURVE 0x0899c _REC_CUR_20_u2_u1 65534. _CNV_A_R_LINEAR_____1_CM 0. 65534. DISPLAY_IDENTIFIER ID_SUM_SAFM_DIAG FORMAT "%5.0"
 /begin AXIS_DESCR COM_AXIS tco_st _CNV_A_R_LINEAR_____12_CM 8 -48. 142.5 FORMAT "%5.1" AXIS_PTS_REF ldp_tco_st_id_sum_safm_diag /end AXIS_DESCR
/end CHARACTERISTIC
/begin CHARACTERISTIC lc_inh_safm_man_deac "Constant to switch of the inhibition (=1)" VALUE 0x00f42 _REC_VAL_20_u1 1. _CNV_A_R_LINEAR_____22_CM 0. 1. DISPLAY_IDENTIFIER LC_INH_SAFM_MAN_DEAC FORMAT "%1.0" /end CHARACTERISTIC
/begin MEASUREMENT lv_err_load_tps_plaus "Boolean that indicates inconsistencies between actual load and throttle position (if set)" UBYTE _CNV_S_2_RANGE______2_R_CM 1 100. 0. 255. DISPLAY_IDENTIFIER LV_ERR_LOAD_TPS_PLAUS ECU_ADDRESS 0x3fbb10 /end MEASUREMENT
/begin CHARACTERISTIC c_maf_max_diag_sa "Maximum load for interrupt the SA diagnosis" VALUE 0x016a4 _REC_VAL_20_u2 1389. _CNV_A_R_LINEAR_____106_CM 0. 1389. DISPLAY_IDENTIFIER C_MAF_MAX_DIAG_SA FORMAT "%7.2" /end CHARACTERISTIC
/begin MEASUREMENT vs_edge_av.edge_ctr "actual value of vehicle speed tooth counter" UWORD _CNV_A_R_LINEAR_____1_CM 1 100. 0. 65535. DISPLAY_IDENTIFIER VS_EDGE_CTR_AV ECU_ADDRESS 0x3fd3fe BYTE_ORDER MSB_LAST FORMAT "%5.0" /end MEASUREMENT
/begin MEASUREMENT vs_edge_av.edge_t "actual timestamp of last tooth" UWORD _CNV_A_R_LINEAR_____486_CM 1 100. 0. 524.28 DISPLAY_IDENTIFIER VS_EDGE_T_AV ECU_ADDRESS 0x3fd400 BYTE_ORDER MSB_LAST FORMAT "%7.3" /end MEASUREMENT
/begin CHARACTERISTIC c_vs_min_run "minimum vehicle speed for detection of running vehicle" VALUE 0x0095d _REC_VAL_20_u1 25.5 _CNV_A_R_LINEAR_____23_CM 0. 255. DISPLAY_IDENTIFIER C_VS_MIN_RUN FORMAT "%3.0" /end CHARACTERISTIC
/begin MEASUREMENT lv_vs_run "Boolean for running vehicle" UBYTE _CNV_S_2_RANGE______0_CM 1 100. 0. 1. DISPLAY_IDENTIFIER LV_VS_RUN ECU_ADDRESS 0x3fe23f BIT_MASK 0x1 /end MEASUREMENT
/begin CHARACTERISTIC c_t_vst "Time delay for detection of vehicle speed" VALUE 0x00846 _REC_VAL_20_u1 19. _CNV_A_R_LINEAR_____31_CM 10. 200. DISPLAY_IDENTIFIER C_T_VST FORMAT "%3.0" /end CHARACTERISTIC
/begin CHARACTERISTIC c_vs_edge_sum_min "Minimum number of wheel segments for evaluation of vehicle speedy gonzales" VALUE 0x00941 _REC_VAL_20_u1 25.4 _CNV_A_R_LINEAR_____1_CM 1. 255. DISPLAY_IDENTIFIER C_VS_EDGE_SUM_MIN FORMAT "%3.0" /end CHARACTERISTIC
/begin MEASUREMENT vs_sens "vehicle speed calculated from vehicle speed sensor" UWORD _CNV_A_R_LINEAR_____85_CM 1 100. 0. 511.99218 DISPLAY_IDENTIFIER VS_SENS ECU_ADDRESS 0x3fd402 BYTE_ORDER MSB_LAST FORMAT "%7.3" /end MEASUREMENT
/begin MEASUREMENT vs_sens_grd "Vehicle speed gradient calculated from VS_SENS" SWORD _CNV_A_R_LINEAR_____487_CM 1 100. -256. 255.9921875 DISPLAY_IDENTIFIER VS_SENS_GRD ECU_ADDRESS 0x3fd40e BYTE_ORDER MSB_LAST FORMAT "%8.3" /end MEASUREMENT
/begin MEASUREMENT lv_vst "boolean for stopped vehicle" UBYTE _CNV_S_2_RANGE______0_CM 1 100. 0. 1. DISPLAY_IDENTIFIER LV_VST ECU_ADDRESS 0x3fe240 BIT_MASK 0x1 /end MEASUREMENT
/begin CHARACTERISTIC c_vs_fac "" VALUE 0x0144c _REC_VAL_20_u4 0.291271 _CNV_A_R_LINEAR_____488_CM 0. 0.291271 DISPLAY_IDENTIFIER C_VS_FAC FORMAT "%10.9" /end CHARACTERISTIC
/begin MEASUREMENT vs "vehicle speed" UBYTE _CNV_A_R_LINEAR_____23_CM 1 100. 0. 255. DISPLAY_IDENTIFIER VS ECU_ADDRESS 0x3fe23e FORMAT "%3.0" /end MEASUREMENT
/begin AXIS_PTS ldpm_pq_estim_id_maf_fac_ofs "" 0x11a78 pq_estim _REC_AXS_20_u2 0.99998474 _CNV_A_R_LINEAR_____37_CM 16 0. 0.99998474 DISPLAY_IDENTIFIER LDPM_PQ_ESTIM_ID_MAF_FAC_OFS FORMAT "%7.5" /end AXIS_PTS
/begin AXIS_PTS ldpm_clas_a_id_clas_fmy "" 0x115ac online_dummy _REC_AXS_20_u2 65535. _CNV_A_R_LINEAR_____1_CM 16 0. 65535. DISPLAY_IDENTIFIER LDPM_CLAS_A_ID_CLAS_FMY FORMAT "%5.0" /end AXIS_PTS
/begin AXIS_PTS ldp_clas_b_id_clas_fmy "" 0x109b6 online_dummy _REC_AXS_20_u2 65535. _CNV_A_R_LINEAR_____1_CM 4 0. 65535. DISPLAY_IDENTIFIER LDP_CLAS_B_ID_CLAS_FMY FORMAT "%5.0" /end AXIS_PTS
/begin MEASUREMENT fmy_ctr_diag_dc_end[0] "Number of DC with diagnosis DIAGCPS done since first power up" UWORD _CNV_A_R_LINEAR_____1_CM 1 100. 0. 65535. DISPLAY_IDENTIFIER CTR_DIAG_DC_END_DIAGCPS ECU_ADDRESS 0x3fcd96 BYTE_ORDER MSB_LAST FORMAT "%5.0" /end MEASUREMENT
/begin MEASUREMENT fmy_ctr_diag_dc_end[1] "Number of DC with diagnosis CAT_DIAG_1 done since first power up" UWORD _CNV_A_R_LINEAR_____1_CM 1 100. 0. 65535. DISPLAY_IDENTIFIER CTR_DIAG_DC_END_CAT_DIAG_1 ECU_ADDRESS 0x3fcd98 BYTE_ORDER MSB_LAST FORMAT "%5.0" /end MEASUREMENT
/begin MEASUREMENT fmy_ctr_diag_dc_end[2] "Number of DC with diagnosis CAT_DIAG_2 done since first power up" UWORD _CNV_A_R_LINEAR_____1_CM 1 100. 0. 65535. DISPLAY_IDENTIFIER CTR_DIAG_DC_END_CAT_DIAG_2 ECU_ADDRESS 0x3fcd9a BYTE_ORDER MSB_LAST FORMAT "%5.0" /end MEASUREMENT
/begin MEASUREMENT fmy_ctr_diag_dc_end[3] "Number of DC with diagnosis SA_SAP done since first power up" UWORD _CNV_A_R_LINEAR_____1_CM 1 100. 0. 65535. DISPLAY_IDENTIFIER CTR_DIAG_DC_END_SA_SAP ECU_ADDRESS 0x3fcd9c BYTE_ORDER MSB_LAST FORMAT "%5.0" /end MEASUREMENT
/begin MEASUREMENT fmy_ctr_diag_dc_end[4] "Number of DC with diagnosis SA_SAFM done since first power up" UWORD _CNV_A_R_LINEAR_____1_CM 1 100. 0. 65535. DISPLAY_IDENTIFIER CTR_DIAG_DC_END_SA_SAFM ECU_ADDRESS 0x3fcd9e BYTE_ORDER MSB_LAST FORMAT "%5.0" /end MEASUREMENT
/begin MEASUREMENT fmy_ctr_diag_dc_end[5] "Number of DC with diagnosis SA_SAV done since first power up" UWORD _CNV_A_R_LINEAR_____1_CM 1 100. 0. 65535. DISPLAY_IDENTIFIER CTR_DIAG_DC_END_SA_SAV ECU_ADDRESS 0x3fcda0 BYTE_ORDER MSB_LAST FORMAT "%5.0" /end MEASUREMENT
/begin MEASUREMENT fmy_ctr_diag_dc_end[6] "Number of DC with diagnosis SA_SYS done since first power up" UWORD _CNV_A_R_LINEAR_____1_CM 1 100. 0. 65535. DISPLAY_IDENTIFIER CTR_DIAG_DC_END_SA_SYS ECU_ADDRESS 0x3fcda2 BYTE_ORDER MSB_LAST FORMAT "%5.0" /end MEASUREMENT
/begin MEASUREMENT fmy_ctr_diag_dc_end[7] "Number of DC with diagnosis ECT_MEC done since first power up" UWORD _CNV_A_R_LINEAR_____1_CM 1 100. 0. 65535. DISPLAY_IDENTIFIER CTR_DIAG_DC_END_ECT_MEC ECU_ADDRESS 0x3fcda4 BYTE_ORDER MSB_LAST FORMAT "%5.0" /end MEASUREMENT
/begin MEASUREMENT fmy_ctr_diag_dc_end[8] "Number of DC with diagnosis CHK_LS_DOWN_1 done since first power up" UWORD _CNV_A_R_LINEAR_____1_CM 1 100. 0. 65535. DISPLAY_IDENTIFIER CTR_DIAG_DC_END_CHK_LS_DOWN_1 ECU_ADDRESS 0x3fcda6 BYTE_ORDER MSB_LAST FORMAT "%5.0" /end MEASUREMENT
/begin MEASUREMENT fmy_ctr_diag_dc_end[9] "Number of DC with diagnosisCHK_LS_DOWN_2 done since first power up" UWORD _CNV_A_R_LINEAR_____1_CM 1 100. 0. 65535. DISPLAY_IDENTIFIER CTR_DIAG_DC_END_CHK_LS_DOWN_2 ECU_ADDRESS 0x3fcda8 BYTE_ORDER MSB_LAST FORMAT "%5.0" /end MEASUREMENT
/begin MEASUREMENT fmy_ctr_diag_dc_end[10] "Number of DC with diagnosis TCO_PLAUS done since first power up" UWORD _CNV_A_R_LINEAR_____1_CM 1 100. 0. 65535. DISPLAY_IDENTIFIER CTR_DIAG_DC_END_TCO_PLAUS ECU_ADDRESS 0x3fcdaa BYTE_ORDER MSB_LAST FORMAT "%5.0" /end MEASUREMENT
/begin MEASUREMENT fmy_ctr_diag_dc_end[11] "Number of DC with diagnosis TCO_STUCK done since first power up" UWORD _CNV_A_R_LINEAR_____1_CM 1 100. 0. 65535. DISPLAY_IDENTIFIER CTR_DIAG_DC_END_TCO_STUCK ECU_ADDRESS 0x3fcdac BYTE_ORDER MSB_LAST FORMAT "%5.0" /end MEASUREMENT
/begin MEASUREMENT fmy_ctr_diag_dc_end[12] "Number of DC with diagnosis TCO_PLAUS done since first power up" UWORD _CNV_A_R_LINEAR_____1_CM 1 100. 0. 65535. DISPLAY_IDENTIFIER CTR_DIAG_DC_END_O3_CONC ECU_ADDRESS 0x3fcdae BYTE_ORDER MSB_LAST FORMAT "%5.0" /end MEASUREMENT
/begin MEASUREMENT ctr_cycnr_dc_end "Quantity of DC-s (ended) since first ECU power-up" UWORD _CNV_A_R_LINEAR_____1_CM 1 100. 0. 65535. DISPLAY_IDENTIFIER CTR_CYCNR_DC_END ECU_ADDRESS 0x3fcd94 BYTE_ORDER MSB_LAST FORMAT "%5.0" /end MEASUREMENT
/begin COMPU_METHOD _CNV_S_2_RANGE______0_CM "" TAB_VERB "%6.3" "[-]" COMPU_TAB_REF _CNV_S_2_RANGE______0 /end COMPU_METHOD
/begin COMPU_VTAB _CNV_S_2_RANGE______0 "" TAB_VERB 2 0 "0" 1 "1" /end COMPU_VTAB
/begin COMPU_METHOD _CNV_A_R_LINEAR_____1_CM "" RAT_FUNC "%6.3" "-" COEFFS 0 1. 0. 0 0 1 /end COMPU_METHOD
/begin COMPU_METHOD _CNV_S_2_RANGE______2_R_CM "" TAB_VERB "%6.3" "[-]" COMPU_TAB_REF _CNV_S_2_RANGE______2_R /end COMPU_METHOD
/begin COMPU_VTAB_RANGE _CNV_S_2_RANGE______2_R "" 2 0 0 "0" 1 255 "1" /end COMPU_VTAB_RANGE
/begin COMPU_METHOD _CNV_A_R_LINEAR_____4_CM "" RAT_FUNC "%6.3" "s" COEFFS 0 100. 0. 0 0 1 /end COMPU_METHOD
/begin COMPU_METHOD _CNV_S_2_RANGE______5_CM "" TAB_VERB "%6.3" "-" COMPU_TAB_REF _CNV_S_2_RANGE______5 /end COMPU_METHOD
/begin COMPU_VTAB _CNV_S_2_RANGE______5 "" TAB_VERB 2 0 "0" 1 "1" /end COMPU_VTAB
/begin COMPU_METHOD _CNV_A_R_LINEAR_____7_CM "" RAT_FUNC "%6.3" "°C" COEFFS 0 16. 0. 0 0 1 /end COMPU_METHOD
/begin COMPU_METHOD _CNV_A_R_LINEAR_____9_CM "" RAT_FUNC "%6.3" "%" COEFFS 0 655.3600000071681 0. 0 0 1 /end COMPU_METHOD
/begin COMPU_METHOD _CNV_A_R_LINEAR_____10_CM "" RAT_FUNC "%6.3" "%" COEFFS 0 2.56 0. 0 0 1 /end COMPU_METHOD
/begin COMPU_METHOD _CNV_A_R_LINEAR_____11_CM "" RAT_FUNC "%6.3" "rpm" COEFFS 0 1. 0. 0 0 1 /end COMPU_METHOD
/begin COMPU_METHOD _CNV_A_R_LINEAR_____12_CM "" RAT_FUNC "%6.3" "°C" COEFFS 0 1.333333333333333 64. 0 0 1 /end COMPU_METHOD
/begin COMPU_METHOD _CNV_A_R_LINEAR_____13_CM "" RAT_FUNC "%6.3" "°C" COEFFS 0 1.333333333333333 0. 0 0 1 /end COMPU_METHOD
/begin COMPU_METHOD _CNV_A_R_LINEAR_____14_CM "" RAT_FUNC "%6.3" "°C" COEFFS 0 1. 0. 0 0 1 /end COMPU_METHOD
/begin COMPU_METHOD _CNV_A_R_LINEAR_____15_CM "" RAT_FUNC "%6.3" "°C" COEFFS 0 1. 40. 0 0 1 /end COMPU_METHOD
/begin COMPU_METHOD _CNV_A_R_LINEAR_____16_CM "" RAT_FUNC "%6.3" "rpm" COEFFS 0 3.125e-002 0. 0 0 1 /end COMPU_METHOD
/begin COMPU_METHOD _CNV_A_R_LINEAR_____21_CM "" RAT_FUNC "%6.3" "-" COEFFS 0 32768.00003968061 0. 0 0 1 /end COMPU_METHOD
/begin COMPU_METHOD _CNV_A_R_LINEAR_____22_CM "" RAT_FUNC "%6.3" "[-]" COEFFS 0 1. 0. 0 0 1 /end COMPU_METHOD
/begin COMPU_METHOD _CNV_A_R_LINEAR_____23_CM "" RAT_FUNC "%6.3" "km/h" COEFFS 0 1. 0. 0 0 1 /end COMPU_METHOD
/begin COMPU_METHOD _CNV_A_R_LINEAR_____24_CM "" RAT_FUNC "%6.3" "s" COEFFS 0 10. 0. 0 0 1 /end COMPU_METHOD
/begin COMPU_METHOD _CNV_A_R_LINEAR_____27_CM "" RAT_FUNC "%6.3" "mg/stk" COEFFS 0 0.183585313174946 0. 0 0 1 /end COMPU_METHOD
/begin COMPU_METHOD _CNV_A_R_LINEAR_____29_CM "" RAT_FUNC "%6.3" "-" COEFFS 0 255.9983911655618 0. 0 0 1 /end COMPU_METHOD
/begin COMPU_METHOD _CNV_A_R_LINEAR_____30_CM "" RAT_FUNC "%6.3" "s" COEFFS 0 1. 0. 0 0 1 /end COMPU_METHOD
/begin COMPU_METHOD _CNV_A_R_LINEAR_____31_CM "" RAT_FUNC "%6.3" "ms" COEFFS 0 0.1 0. 0 0 1 /end COMPU_METHOD
/begin COMPU_METHOD _CNV_A_R_LINEAR_____37_CM "" RAT_FUNC "%6.3" "-" COEFFS 0 65536.00007936121 0. 0 0 1 /end COMPU_METHOD
/begin COMPU_METHOD _CNV_A_R_LINEAR_____39_CM "" RAT_FUNC "%6.3" "-" COEFFS 0 127.9991955827809 0. 0 0 1 /end COMPU_METHOD
/begin COMPU_METHOD _CNV_A_R_LINEAR_____45_CM "" RAT_FUNC "%6.3" "kg/h" COEFFS 0 64.00000000417234 0. 0 0 1 /end COMPU_METHOD
/begin COMPU_METHOD _CNV_A_R_LINEAR_____46_CM "" RAT_FUNC "%6.3" "-" COEFFS 0 16. 0. 0 0 1 /end COMPU_METHOD
/begin COMPU_METHOD _CNV_A_R_LINEAR_____47_CM "" RAT_FUNC "%6.3" "kg/h" COEFFS 0 64. 0. 0 0 1 /end COMPU_METHOD
/begin COMPU_METHOD _CNV_A_R_LINEAR_____49_CM "" RAT_FUNC "%6.3" "hPa" COEFFS 0 12.06017666543982 0. 0 0 1 /end COMPU_METHOD
/begin COMPU_METHOD _CNV_A_R_LINEAR_____50_CM "" RAT_FUNC "%6.3" "[-]" COEFFS 0 255.9999357490357 0. 0 0 1 /end COMPU_METHOD
/begin COMPU_METHOD _CNV_A_R_LINEAR_____82_CM "" RAT_FUNC "%6.3" "°CRK" COEFFS 0 2.666666666666667 0. 0 0 1 /end COMPU_METHOD
/begin COMPU_METHOD _CNV_A_R_LINEAR_____85_CM "" RAT_FUNC "%6.3" "km/h" COEFFS 0 128.0000018750286 0. 0 0 1 /end COMPU_METHOD
/begin COMPU_METHOD _CNV_A_R_LINEAR_____88_CM "" RAT_FUNC "%6.3" "km" COEFFS 0 0.1 0. 0 0 1 /end COMPU_METHOD
/begin COMPU_METHOD _CNV_A_R_LINEAR_____106_CM "" RAT_FUNC "%6.3" "mg/stk" COEFFS 0 47.18142548596112 0. 0 0 1 /end COMPU_METHOD
/begin COMPU_METHOD _CNV_A_R_LINEAR_____108_CM "" RAT_FUNC "%6.3" "hPa" COEFFS 0 12.06017666543982 -1.759293338545831e-002 0 0 1 /end COMPU_METHOD
/begin COMPU_METHOD _CNV_A_R_LINEAR_____109_CM "" RAT_FUNC "%6.3" "%" COEFFS 0 655.3600000071681 3.584063961170614e-007 0 0 1 /end COMPU_METHOD
/begin COMPU_METHOD _CNV_A_R_LINEAR_____111_CM "" RAT_FUNC "%6.3" "kg/h" COEFFS 0 8191.999999679995 0. 0 0 1 /end COMPU_METHOD
/begin COMPU_METHOD _CNV_A_R_LINEAR_____113_CM "" RAT_FUNC "%6.3" "kg/h" COEFFS 0 32. 0. 0 0 1 /end COMPU_METHOD
/begin COMPU_METHOD _CNV_A_R_LINEAR_____159_CM "" RAT_FUNC "%6.3" "%" COEFFS 0 655.3600000071681 32768.00000035841 0 0 1 /end COMPU_METHOD
/begin COMPU_METHOD _CNV_S_6_STATE_DIAG_187_CM "" TAB_VERB "%6.3" "-" COMPU_TAB_REF _CNV_S_6_STATE_DIAG_187 /end COMPU_METHOD
/begin COMPU_VTAB _CNV_S_6_STATE_DIAG_187 "" TAB_VERB 6 0 "STEP_INIT" 1 "STEP_1" 2 "STEP_2" 3 "STEP_3" 4 "CPS_RAMP" 5 "LOCK_STEP" /end COMPU_VTAB
/begin COMPU_METHOD _CNV_A_R_LINEAR_____188_CM "" RAT_FUNC "%6.3" "cyc" COEFFS 0 1. 0. 0 0 1 /end COMPU_METHOD
/begin COMPU_METHOD _CNV_A_R_LINEAR_____189_CM "" RAT_FUNC "%6.3" "kg/h" COEFFS 0 8191.874997772622 1. 0 0 1 /end COMPU_METHOD
/begin COMPU_METHOD _CNV_A_R_LINEAR_____190_CM "" RAT_FUNC "%6.3" "-" COEFFS 0 65535. 0. 0 0 1 /end COMPU_METHOD
/begin COMPU_METHOD _CNV_S_2_RANGE______191_CM "" TAB_VERB "%6.3" "[-]" COMPU_TAB_REF _CNV_S_2_RANGE______191 /end COMPU_METHOD
/begin COMPU_VTAB _CNV_S_2_RANGE______191 "" TAB_VERB 2 0 "PASSIVE" 1 "ACTIVE" /end COMPU_VTAB
/begin COMPU_METHOD _CNV_S_4_STATE_LS_196_CM "" TAB_VERB "%6.3" "[-]" COMPU_TAB_REF _CNV_S_4_STATE_LS_196 /end COMPU_METHOD
/begin COMPU_VTAB _CNV_S_4_STATE_LS_196 "" TAB_VERB 4 1 "OL_CDN" 2 "CL" 4 "OL_INTR" 8 "OL_ERR" /end COMPU_VTAB
/begin COMPU_METHOD _CNV_A_R_LINEAR_____197_CM "" RAT_FUNC "%6.3" "s" COEFFS 0 50. 0. 0 0 1 /end COMPU_METHOD
/begin COMPU_METHOD _CNV_A_R_LINEAR_____198_CM "" RAT_FUNC "%6.3" "ms" COEFFS 0 250. 0. 0 0 1 /end COMPU_METHOD
/begin COMPU_METHOD _CNV_A_R_LINEAR_____235_CM "" RAT_FUNC "%6.3" "-" COEFFS 0 32. 0. 0 0 1 /end COMPU_METHOD
/begin COMPU_METHOD _CNV_A_R_LINEAR_____255_CM "" RAT_FUNC "%6.3" "mg/stk" COEFFS 0 47.18214541280769 -1.080506262951531e-005 0 0 1 /end COMPU_METHOD
/begin COMPU_METHOD _CNV_A_R_LINEAR_____258_CM "" RAT_FUNC "%6.3" "hPa/ms" COEFFS 0 395.2653799758745 -0.5 0 0 1 /end COMPU_METHOD
/begin COMPU_METHOD _CNV_A_R_LINEAR_____271_CM "" RAT_FUNC "%6.3" "g" COEFFS 0 36.00036915004301 0. 0 0 1 /end COMPU_METHOD
/begin COMPU_METHOD _CNV_A_R_LINEAR_____272_CM "" RAT_FUNC "%6.3" "ms" COEFFS 0 51.19999999799997 -1.280015567317605e-006 0 0 1 /end COMPU_METHOD
/begin COMPU_METHOD _CNV_A_R_LINEAR_____279_CM "" RAT_FUNC "%6.3" "ohm" COEFFS 0 1. 0. 0 0 1 /end COMPU_METHOD
/begin COMPU_METHOD _CNV_A_R_LINEAR_____291_CM "" RAT_FUNC "%6.3" "J" COEFFS 0 1. 0. 0 0 1 /end COMPU_METHOD
/begin COMPU_METHOD _CNV_S_9_STATE_OBD2_292_CM "" TAB_VERB "%6.3" "[-]" COMPU_TAB_REF _CNV_S_9_STATE_OBD2_292 /end COMPU_METHOD
/begin COMPU_VTAB _CNV_S_9_STATE_OBD2_292 "" TAB_VERB 9 0 "DIAG_OFF" 1 "DIAG_INIT" 2 "LS_READY" 3 "OBD1_DLY" 4 "OBD1_CHK" 5 "TEG_THD" 6 "POW_INT" 7 "DIAG_ACT" 8 "DIAG_END" /end COMPU_VTAB
/begin COMPU_METHOD _CNV_A_R_LINEAR_____326_CM "" RAT_FUNC "%6.3" "hPa/ms" COEFFS 0 395.1938017499002 -7.983716819580877e-003 0 0 1 /end COMPU_METHOD
/begin COMPU_METHOD _CNV_A_R_LINEAR_____327_CM "" RAT_FUNC "%6.3" "s/m" COEFFS 0 3181017.284813537 0. 0 0 1 /end COMPU_METHOD
/begin COMPU_METHOD _CNV_A_R_LINEAR_____328_CM "" RAT_FUNC "%6.3" "-" COEFFS 0 7379.793318491542 0. 0 0 1 /end COMPU_METHOD
/begin COMPU_METHOD _CNV_A_R_LINEAR_____329_CM "" RAT_FUNC "%6.3" "1/(s^2*m)" COEFFS 0 5.615152789530994e-004 0. 0 0 1 /end COMPU_METHOD
/begin COMPU_METHOD _CNV_A_R_LINEAR_____330_CM "" RAT_FUNC "%6.3" "J/(kg K)" COEFFS 0 0.89198606271777 0. 0 0 1 /end COMPU_METHOD
/begin COMPU_METHOD _CNV_A_R_LINEAR_____331_CM "" RAT_FUNC "%6.3" "dm^3" COEFFS 0 271.1050690753992 -1.110223024625157e-015 0 0 1 /end COMPU_METHOD
/begin COMPU_METHOD _CNV_A_R_LINEAR_____332_CM "" RAT_FUNC "%6.3" "mg/stk" COEFFS 0 47.18070554355651 0. 0 0 1 /end COMPU_METHOD
/begin COMPU_METHOD _CNV_A_R_LINEAR_____333_CM "" RAT_FUNC "%6.3" "cm²" COEFFS 0 1118.481084425738 0. 0 0 1 /end COMPU_METHOD
/begin COMPU_METHOD _CNV_A_R_LINEAR_____345_CM "" RAT_FUNC "%6.3" "-" COEFFS 0 8191.999999679995 0. 0 0 1 /end COMPU_METHOD
/begin COMPU_METHOD _CNV_A_R_LINEAR_____346_CM "" RAT_FUNC "%6.3" "kg/(h*hPa)" COEFFS 0 5434.241818163727 32767.99999915545 0 0 1 /end COMPU_METHOD
/begin COMPU_METHOD _CNV_A_R_LINEAR_____347_CM "" RAT_FUNC "%6.3" "°CRK" COEFFS 0 42.66666666666666 32768. 0 0 1 /end COMPU_METHOD
/begin COMPU_METHOD _CNV_A_R_LINEAR_____348_CM "" RAT_FUNC "%6.3" "kg/(h*hPa)" COEFFS 0 5434.241818163727 0. 0 0 1 /end COMPU_METHOD
/begin COMPU_METHOD _CNV_A_R_LINEAR_____369_CM "" RAT_FUNC "%6.3" "rpm" COEFFS 0 511.9999948599216 0. 0 0 1 /end COMPU_METHOD
/begin COMPU_METHOD _CNV_A_R_LINEAR_____370_CM "" RAT_FUNC "%6.3" "rpm" COEFFS 0 1. 65536. 0 0 1 /end COMPU_METHOD
/begin COMPU_METHOD _CNV_A_R_LINEAR_____371_CM "" RAT_FUNC "%6.3" "rpm" COEFFS 0 31.99899215772732 3.149507102140348e-005 0 0 1 /end COMPU_METHOD
/begin COMPU_METHOD _CNV_A_R_LINEAR_____372_CM "" RAT_FUNC "%6.3" "rpm/10ms" COEFFS 0 4. 0. 0 0 1 /end COMPU_METHOD
/begin COMPU_METHOD _CNV_A_R_LINEAR_____373_CM "" RAT_FUNC "%6.3" "rpm/10ms" COEFFS 0 16. 0. 0 0 1 /end COMPU_METHOD
/begin COMPU_METHOD _CNV_A_R_LINEAR_____378_CM "" RAT_FUNC "%6.3" "-" COEFFS 0 2048. 0. 0 0 1 /end COMPU_METHOD
/begin COMPU_METHOD _CNV_A_R_LINEAR_____388_CM "" RAT_FUNC "%6.3" "-" COEFFS 0 2. 0. 0 0 1 /end COMPU_METHOD
/begin COMPU_METHOD _CNV_A_R_LINEAR_____389_CM "" RAT_FUNC "%6.3" "-" COEFFS 0 65536.00270084133 0. 0 0 1 /end COMPU_METHOD
/begin COMPU_METHOD _CNV_S_9_STATE_DIAG_404_CM "" TAB_VERB "%6.3" "[-]" COMPU_TAB_REF _CNV_S_9_STATE_DIAG_404 /end COMPU_METHOD
/begin COMPU_VTAB _CNV_S_9_STATE_DIAG_404 "" TAB_VERB 9 0 "SA_DIAG_INACT" 1 "SA_DIAG_DLY" 2 "SA_MIN_DIAG" 3 "SA_DIAG_INTR" 4 "SAV_DIAG_DLY" 5 "SA_DIAG_SAV" 6 "SA_DIAG_CHK" 7 "SA_DIAG_END" 8 "SA_DIAG_CNL" /end COMPU_VTAB
/begin COMPU_METHOD _CNV_S_7_STATE_DIAG_406_CM "" TAB_VERB "%6.3" "[-]" COMPU_TAB_REF _CNV_S_7_STATE_DIAG_406 /end COMPU_METHOD
/begin COMPU_VTAB _CNV_S_7_STATE_DIAG_406 "" TAB_VERB 7 0 "SAFM_DIAG_OFF" 1 "SAFM_SAFM_MONIT" 2 "SAFM_MIN_DIAG" 3 "SAFM_WAIT_SAV_DIAG" 4 "SAFM_SAV_DIAG" 5 "SAFM_DIAG_END" 6 "SAFM_DIAG_CNL" /end COMPU_VTAB
/begin COMPU_METHOD _CNV_S_7_STATE_DIAG_407_CM "" TAB_VERB "%6.3" "[-]" COMPU_TAB_REF _CNV_S_7_STATE_DIAG_407 /end COMPU_METHOD
/begin COMPU_VTAB _CNV_S_7_STATE_DIAG_407 "" TAB_VERB 7 0 "NO_ERR" 1 "SAFM_ERR" 2 "SAP_ERR" 3 "SAV_ERR" 4 "MIN_SAF_ERR" 5 "SA_CONF_ERR" 6 "SAV_1_ERR" /end COMPU_VTAB
/begin COMPU_METHOD _CNV_A_R_LINEAR_____408_CM "" RAT_FUNC "%6.3" "kg/h" COEFFS 0 256. 0. 0 0 1 /end COMPU_METHOD
/begin COMPU_METHOD _CNV_A_R_LINEAR_____409_CM "" RAT_FUNC "%6.3" "kg/h" COEFFS 0 64.00027344284068 0.1400027344279806 0 0 1 /end COMPU_METHOD
/begin COMPU_METHOD _CNV_A_R_LINEAR_____410_CM "" RAT_FUNC "%6.3" "kg/h" COEFFS 0 4. 0. 0 0 1 /end COMPU_METHOD
/begin COMPU_METHOD _CNV_A_R_LINEAR_____486_CM "" RAT_FUNC "%6.3" "ms" COEFFS 0 125. 0. 0 0 1 /end COMPU_METHOD
/begin COMPU_METHOD _CNV_A_R_LINEAR_____487_CM "" RAT_FUNC "%6.3" "(km/h)/10ms" COEFFS 0 128. 0. 0 0 1 /end COMPU_METHOD
/begin COMPU_METHOD _CNV_A_R_LINEAR_____488_CM "" RAT_FUNC "%6.3" "m" COEFFS 0 57600021.97266463 0. 0 0 1 /end COMPU_METHOD
/begin RECORD_LAYOUT _REC_VAL_20_u1 FNC_VALUES 1 UBYTE COLUMN_DIR DIRECT /end RECORD_LAYOUT
/begin RECORD_LAYOUT _REC_VAL_20_u2 FNC_VALUES 1 UWORD COLUMN_DIR DIRECT /end RECORD_LAYOUT
/begin RECORD_LAYOUT _REC_CUR_20_u2_u1 FNC_VALUES 1 UWORD COLUMN_DIR DIRECT /end RECORD_LAYOUT
/begin RECORD_LAYOUT _REC_AXS_20_u1 NO_AXIS_PTS_X 1 UBYTE AXIS_PTS_X 2 UBYTE INDEX_INCR DIRECT /end RECORD_LAYOUT
/begin RECORD_LAYOUT _REC_MAP_20_u1_u1_u1 FNC_VALUES 1 UBYTE COLUMN_DIR DIRECT /end RECORD_LAYOUT
/begin RECORD_LAYOUT _REC_CUR_20_u1_u1 FNC_VALUES 1 UBYTE COLUMN_DIR DIRECT /end RECORD_LAYOUT
/begin RECORD_LAYOUT _REC_AXS_20_u2 NO_AXIS_PTS_X 1 UWORD AXIS_PTS_X 2 UWORD INDEX_INCR DIRECT /end RECORD_LAYOUT
/begin RECORD_LAYOUT _REC_MAP_20_u1_u1_u2 FNC_VALUES 1 UBYTE COLUMN_DIR DIRECT /end RECORD_LAYOUT
/begin RECORD_LAYOUT _REC_MAP_20_u2_u2_u1 FNC_VALUES 1 UWORD COLUMN_DIR DIRECT /end RECORD_LAYOUT
/begin RECORD_LAYOUT _REC_CUR_20_u1_u2 FNC_VALUES 1 UBYTE COLUMN_DIR DIRECT /end RECORD_LAYOUT
/begin RECORD_LAYOUT _REC_CUR_20_u2_u2 FNC_VALUES 1 UWORD COLUMN_DIR DIRECT /end RECORD_LAYOUT
/begin RECORD_LAYOUT _REC_VAL_20_u4 FNC_VALUES 1 ULONG COLUMN_DIR DIRECT /end RECORD_LAYOUT
/begin RECORD_LAYOUT _REC_VAL_20_s2 FNC_VALUES 1 SWORD COLUMN_DIR DIRECT /end RECORD_LAYOUT
/begin RECORD_LAYOUT _REC_MAP_20_u2_u1_u2 FNC_VALUES 1 UWORD COLUMN_DIR DIRECT /end RECORD_LAYOUT
/begin RECORD_LAYOUT _REC_MAP_20_u1_u2_u2 FNC_VALUES 1 UBYTE COLUMN_DIR DIRECT /end RECORD_LAYOUT
/begin RECORD_LAYOUT _REC_MAP_20_u2_u2_u2 FNC_VALUES 1 UWORD COLUMN_DIR DIRECT /end RECORD_LAYOUT
/begin FUNCTION OBD_Failure_class "_Failure class"
 /begin DEF_CHARACTERISTIC id_clas_b_fmt id_clas_a_fmt fmy_id_toil.c_err_clas fmy_id_tco_ex.c_err_clas fmy_id_tia.c_err_clas fmy_id_amp.c_err_clas fmy_id_maf.c_err_clas fmy_id_vls_down_max_1.c_err_clas fmy_id_vls_down_max_2.c_err_clas fmy_id_vls_down_min_cold_1.c_err_clas fmy_id_vls_down_min_cold_2.c_err_clas fmy_id_vls_down_min_1.c_err_clas fmy_id_vls_down_min_2.c_err_clas fmy_id_vls_down_oc_1.c_err_clas fmy_id_vls_down_oc_2.c_err_clas fmy_id_iv_0.c_err_clas fmy_id_iv_1.c_err_clas fmy_id_iv_2.c_err_clas fmy_id_iv_3.c_err_clas fmy_id_iv_4.c_err_clas fmy_id_iv_5.c_err_clas fmy_id_lsh_up_1.c_err_clas fmy_id_lsh_up_2.c_err_clas fmy_id_lsh_down_1.c_err_clas fmy_id_lsh_down_2.c_err_clas fmy_id_rly_efp.c_err_clas fmy_id_cps.c_err_clas fmy_id_mec_ivvt_in_1.c_err_clas fmy_id_mec_ivvt_ex_1.c_err_clas fmy_id_ref_ivvt_in_1.c_err_clas fmy_id_ref_ivvt_ex_1.c_err_clas fmy_id_slv_ivvt_in_1.c_err_clas fmy_id_slv_ivvt_ex_1.c_err_clas fmy_id_park_ivvt_in_1.c_err_clas fmy_id_park_ivvt_ex_1.c_err_clas fmy_id_ecu_cks.c_err_clas fmy_id_toil_level.c_err_clas fmy_id_tout_etcu_1.c_err_clas fmy_id_tout_etcu_2.c_err_clas fmy_id_tout_icl_2.c_err_clas fmy_id_tout_icl_3.c_err_clas fmy_id_tout_asr_1.c_err_clas fmy_id_tout_asr_3.c_err_clas fmy_id_tout_asr_4.c_err_clas fmy_id_tout_pste_1.c_err_clas fmy_id_tout_amt_1.c_err_clas fmy_id_vs.c_err_clas fmy_id_knks_1.c_err_clas fmy_id_knks_2.c_err_clas fmy_id_td_igc_cut_0.c_err_clas fmy_id_td_igc_cut_1.c_err_clas fmy_id_td_igc_cut_2.c_err_clas fmy_id_td_igc_cut_3.c_err_clas fmy_id_td_igc_cut_4.c_err_clas fmy_id_td_igc_cut_5.c_err_clas fmy_id_dur_igc_0.c_err_clas fmy_id_dur_igc_1.c_err_clas fmy_id_dur_igc_2.c_err_clas fmy_id_dur_igc_3.c_err_clas fmy_id_dur_igc_4.c_err_clas fmy_id_dur_igc_5.c_err_clas fmy_id_tps_1.c_err_clas fmy_id_tps_2.c_err_clas fmy_id_tps_maf_1.c_err_clas fmy_id_tps_maf_2.c_err_clas fmy_id_v_ref_1.c_err_clas fmy_id_v_ref_2.c_err_clas fmy_id_pvs_1.c_err_clas fmy_id_pvs_2.c_err_clas fmy_id_pvs_ratio.c_err_clas fmy_id_pvs_double.c_err_clas fmy_id_pvs_bls_not_plaus.c_err_clas fmy_id_mtc_dr.c_err_clas fmy_id_mtc_ctl_1.c_err_clas fmy_id_mtc_ctl_2.c_err_clas fmy_id_mtc_ctl_3.c_err_clas fmy_id_tps_ad.c_err_clas fmy_id_tps_ad_bol.c_err_clas fmy_id_tps_st_chk_1.c_err_clas fmy_id_tps_st_chk_2.c_err_clas fmy_id_gen.c_err_clas fmy_id_gen_if.c_err_clas fmy_id_gen_diag.c_err_clas fmy_id_vim.c_err_clas fmy_id_cam_per_0.c_err_clas fmy_id_cam_per_1.c_err_clas fmy_id_cam_psn_0.c_err_clas fmy_id_cam_psn_1.c_err_clas fmy_id_cam_0_not_plaus.c_err_clas fmy_id_cam_1_not_plaus.c_err_clas fmy_id_eng_psn.c_err_clas fmy_id_tooth_per.c_err_clas fmy_id_tpu_syn.c_err_clas fmy_id_crk_not_plaus.c_err_clas fmy_id_tout_txu_1.c_err_clas fmy_id_can_boff.c_err_clas fmy_id_rly_main.c_err_clas fmy_id_rly_main_dly.c_err_clas fmy_id_rly_accout.c_err_clas fmy_id_sap.c_err_clas fmy_id_sav.c_err_clas fmy_id_ecf.c_err_clas fmy_id_tco_plaus.c_err_clas fmy_id_tco_el.c_err_clas fmy_id_tco_grd.c_err_clas fmy_id_tco_stuck.c_err_clas fmy_id_ect_el.c_err_clas fmy_id_ect_mec.c_err_clas fmy_id_isc.c_err_clas fmy_id_im_bls_plaus.c_err_clas fmy_id_im_bts_plaus.c_err_clas fmy_id_msw_tog.c_err_clas fmy_id_msw_2.c_err_clas fmy_id_msw_3.c_err_clas fmy_id_isa_1.c_err_clas fmy_id_isa_2.c_err_clas fmy_id_seg_t_ad.c_err_clas fmy_id_seg_t.c_err_clas fmy_id_mis_0.c_err_clas fmy_id_mis_1.c_err_clas fmy_id_mis_2.c_err_clas fmy_id_mis_3.c_err_clas fmy_id_mis_4.c_err_clas fmy_id_mis_5.c_err_clas fmy_id_mis_low_fuel.c_err_clas fmy_id_mis_mpl.c_err_clas fmy_id_conv_mon_1.c_err_clas fmy_id_n_32_mon_1.c_err_clas fmy_id_pvs_mon_1.c_err_clas fmy_id_maf_tps_mon_1.c_err_clas fmy_id_tq_dif_isc_mon_1.c_err_clas fmy_id_tq_req_mon_1.c_err_clas fmy_id_tq_ext_mon_1.c_err_clas fmy_id_tqi_av_mon_1.c_err_clas fmy_id_tqi_n_max_mon_1.c_err_clas fmy_id_cru_inh_mon_1.c_err_clas fmy_id_tqi_n_max_nvmy_mon.c_err_clas fmy_id_sa_safm.c_err_clas fmy_id_sa_sap.c_err_clas fmy_id_sa_sys.c_err_clas fmy_id_sa_sav.c_err_clas fmy_id_imob_1.c_err_clas fmy_id_imob_2.c_err_clas fmy_id_imob_3.c_err_clas fmy_id_fsd_1.c_err_clas fmy_id_fsd_2.c_err_clas fmy_id_ls_down_swt_1.c_err_clas fmy_id_ls_down_swt_2.c_err_clas fmy_id_ls_down_pue_1.c_err_clas fmy_id_ls_down_pue_2.c_err_clas fmy_id_ef.c_err_clas fmy_id_tecu.c_err_clas fmy_id_ebox_cfa.c_err_clas fmy_id_ecu_ram.c_err_clas fmy_id_tqi_lim.c_err_clas fmy_id_obd2_lsh_down_1.c_err_clas fmy_id_obd2_lsh_down_2.c_err_clas fmy_id_dmtls.c_err_clas fmy_id_dmtl_pump.c_err_clas fmy_id_dmtlm.c_err_clas fmy_id_dmtl_leak.c_err_clas fmy_id_sof.c_err_clas fmy_id_sof_req.c_err_clas fmy_id_rly_st.c_err_clas fmy_id_bsd.c_err_clas fmy_id_poil_swi.c_err_clas fmy_id_tout_efp.c_err_clas fmy_id_diagcps.c_err_clas fmy_id_tq_gs_inc_plaus.c_err_clas fmy_id_dcc.c_err_clas fmy_id_ecras.c_err_clas fmy_id_dmtlh.c_err_clas fmy_id_cs.c_err_clas fmy_id_spi_mps.c_err_clas fmy_id_spi_knk.c_err_clas fmy_id_bn_tq_dcc.c_err_clas fmy_id_bn_tq_pste_2.c_err_clas fmy_id_bn_ars.c_err_clas fmy_id_bn_cas.c_err_clas fmy_id_bn_tq_tcs.c_err_clas fmy_id_bn_vs_tcs.c_err_clas fmy_id_bn_tcs.c_err_clas fmy_id_bn_tq_etcu.c_err_clas fmy_id_bn_etcu.c_err_clas fmy_id_bn_tq_amt.c_err_clas fmy_id_bn_acc.c_err_clas fmy_id_bn_t_icl.c_err_clas fmy_id_bn_veh_mod.c_err_clas fmy_id_bn_km_icl.c_err_clas fmy_id_bn_icl.c_err_clas fmy_id_bn_pow_vb.c_err_clas fmy_id_bn_pow_gen.c_err_clas fmy_id_bn_msw.c_err_clas fmy_id_bn_ang_pste.c_err_clas fmy_id_bn_efp.c_err_clas fmy_id_load_tps_plaus.c_err_clas fmy_id_efp_crash.c_err_clas fmy_id_efp.c_err_clas fmy_id_locan_boff.c_err_clas fmy_id_chg_ls_up.c_err_clas fmy_id_chg_ls_down.c_err_clas fmy_id_qoil_sens.c_err_clas fmy_id_bat_sens.c_err_clas fmy_id_bat_sens_it.c_err_clas fmy_id_bat_sens_it_el.c_err_clas fmy_id_ecu_nvmy.c_err_clas fmy_id_gs.c_err_clas fmy_id_obd2_lsh_up_1.c_err_clas fmy_id_obd2_lsh_up_2.c_err_clas fmy_id_cat_diag_1.c_err_clas fmy_id_cat_diag_2.c_err_clas fmy_id_chk_ls_down_1.c_err_clas fmy_id_chk_ls_down_2.c_err_clas fmy_id_vls_up_min_cold_1.c_err_clas fmy_id_vls_up_min_cold_2.c_err_clas fmy_id_vls_up_min_1.c_err_clas fmy_id_vls_up_min_2.c_err_clas fmy_id_vls_up_max_1.c_err_clas fmy_id_vls_up_max_2.c_err_clas fmy_id_vls_up_oc_1.c_err_clas fmy_id_vls_up_oc_2.c_err_clas fmy_id_vls_up_puc_1.c_err_clas fmy_id_vls_up_puc_2.c_err_clas fmy_id_vls_up_stk_1.c_err_clas fmy_id_vls_up_stk_2.c_err_clas fmy_id_lam_dly_1.c_err_clas fmy_id_lam_dly_2.c_err_clas fmy_id_ls_up_swt_1.c_err_clas fmy_id_ls_up_swt_2.c_err_clas fmy_id_ls_up_frq_1.c_err_clas fmy_id_ls_up_frq_2.c_err_clas /end DEF_CHARACTERISTIC
/end FUNCTION
/begin FUNCTION OBD_Application_incidences_for_f "_Application incidences for fuel system diagnosis"
 /begin DEF_CHARACTERISTIC lc_inh_fsd_man_deac c_cl_mmv_max_fsd c_tco_min_fsd_pu c_t_dly_fsd_pu c_t_dly_fsd_reac c_t_ti_add_wf_dec_sum c_ti_add_wf_dec c_ti_add_wf_min_ldc c_ti_add_wf_sum_max /end DEF_CHARACTERISTIC
 /begin OUT_MEASUREMENT lv_inh_diag_fsd_cp lv_err_det_fsd_1 lv_err_det_fsd_2 ti_add_wf_sum t_ti_add_wf_dec_sum lv_ldc_fsd lv_inh_diag_fsd /end OUT_MEASUREMENT
/end FUNCTION
/begin FUNCTION OBD_Application_incidence_cataly "_Application incidence catalyst efficiency diagnosis (OSC Method)" /begin DEF_CHARACTERISTIC lc_inh_cat_diag_man_deac /end DEF_CHARACTERISTIC /end FUNCTION
/begin FUNCTION OBD_Downstream_oxygen_sensor_hea "_Downstream oxygen sensor heater OBDII monitoring"
 /begin DEF_CHARACTERISTIC c_pwm_min_obd2_lsh_down c_pwm_max_obd2_lsh_down c_t_dly_obd2_lsh_down c_temp_min_obd2_lsh_down c_temp_set_obd2_lsh_down c_egy_min_obd2_lsh_down c_tcc_obd2_lsh_down c_frc_obd2_lsh_down ip_r_thd_obd2_lsh_down ldp_r_down_ls_mdl_sens_new_r_thd ip_fac_maf_lsh_down ip_fac_teg_mdl_ls_down /end DEF_CHARACTERISTIC
 /begin OUT_MEASUREMENT lam_bank_1.lsh_down_obd2.pow_int_obd2_lsh_down lam_bank_1.lsh_down_obd2.state_obd2_lsh_down lam_bank_1.lsh_down_obd2.tcc_obd2_lsh_down lam_bank_1.lsh_down_obd2.frc_obd2_lsh_down lam_bank_1.lsh_down_obd2.ctr_cycnr_r_obd2_lsh_down lam_bank_1.lsh_down_obd2.r_down_ls_obd2_lsh_down lam_bank_1.lsh_down_obd2.temp_dif_obd2_lsh_down lam_bank_2.lsh_down_obd2.pow_int_obd2_lsh_down lam_bank_2.lsh_down_obd2.state_obd2_lsh_down lam_bank_2.lsh_down_obd2.tcc_obd2_lsh_down lam_bank_2.lsh_down_obd2.frc_obd2_lsh_down lam_bank_2.lsh_down_obd2.ctr_cycnr_r_obd2_lsh_down lam_bank_2.lsh_down_obd2.r_down_ls_obd2_lsh_down lam_bank_2.lsh_down_obd2.temp_dif_obd2_lsh_down lv_err_obd2_lsh_down_1 lv_err_obd2_lsh_down_2 /end OUT_MEASUREMENT
/end FUNCTION
/begin FUNCTION OBD_SA_system_diagnosis_through_ "_SA system diagnosis through SAF - determination"
 /begin DEF_CHARACTERISTIC id_saf_kgh_diag_min id_saf_kgh_diag_max c_sum_saf_diag_min c_saf_diag_min c_saf_diag_max c_t_dly_diag_safm c_saf_kgh_dif c_saf_mes_thd c_t_max_diag_sav c_sum_sav_thd c_saf_kgh_dif_sav_diag c_maf_kgh_min_saf c_t_dly_diag_sav c_t_dly_intr_diag_safm c_saf_mdl_cor_eol c_t_dly_diag_safm_eol c_maf_kgh_min_saf_eol c_sum_saf_diag_max c_sum_saf_kgh c_saf_kgh_safm id_sum_safm_diag /end DEF_CHARACTERISTIC
 /begin OUT_MEASUREMENT state_diag_sa_safm state_diag_sa_err lv_safm_monit_diag_end lv_sa_min_diag_end lv_sav_diag_end lv_sa_t_diag_start ctr_safm_diag saf_kgh_max_diag saf_kgh_min_diag sum_saf_diag_max sum_saf_diag_quo_max saf_diag_quo_max sum_saf_diag_min sum_saf_diag_quo_min saf_diag_quo_min saf_kgh_diag saf_kgh_dif_sav_diag lv_sap_sav_cnl sum_sav_thd t_dly_intr_diag_safm saf_diag_max saf_diag_max_sae saf_diag_min_sae saf_kgh_dif saf_kgh_dif_sae lv_err_sa_sys lv_err_sa_safm saf_diag_min sum_saf_kgh /end OUT_MEASUREMENT
/end FUNCTION
/begin FUNCTION OBD_Application_incidences_for_S "_Application incidences for SA system monitoring through SAFM" /begin DEF_CHARACTERISTIC lc_inh_safm_man_deac c_maf_max_diag_sa /end DEF_CHARACTERISTIC
 /begin OUT_MEASUREMENT lv_inh_diag_ebox_cfa lv_sap_cnl state_diag_sa_ls lv_sa_min_flow_diag lv_sa_min_flow_diag_eol lv_inh_diag_sa /end OUT_MEASUREMENT
/end FUNCTION
/begin FUNCTION OBD_Functional_Check_CPS "_Functional Check CPS"
 /begin DEF_CHARACTERISTIC c_tco_min_diagcps_1 c_cl_mmv_diagcps c_flow_sp_diagcps_maf c_flow_sp_diagcps_n c_lgrd_flow_sp_neg_diagcps c_lgrd_flow_sp_pos_diagcps c_maf_diagcps c_n_diagcps c_n_dif_diagcps c_sum_flow_sp_diagcps_max c_sum_diagcps_max c_t_diagcps_maf c_t_diagcps_n_1 c_t_diagcps_n_2 c_t_diagcps_n_3 c_t_diagcps_dly c_crlc_isapwm_diagcps c_isapwm_dyw_diagcps c_maf_max_diagcps c_tco_min_diagcps c_sum_flow_sp_diagcps_eol c_sum_diagcps_eol /end DEF_CHARACTERISTIC
 /begin OUT_MEASUREMENT lv_inh_diagcps lv_di_diagcps flow_sp_cp_diagcps state_diagcps lv_act_diagcps lv_maf_diagcps_0 lv_maf_diagcps_1 lv_n_dif_diagcps lv_supp_accin_diagcps maf_diagcps n_diagcps sum_flow_sp_diagcps_eol sum_flow_sp_diagcps sum_diag_diagcps_eol sum_diag_diagcps t_diagcps_dly t_diagcps_maf t_diagcps_n_1 t_diagcps_n_2 t_diagcps_n_3 isapwm_mmv_diagcps lv_isapwm_dyw_diagcps flow_sp_cps_old sum_diag_diagcps_sae maf_diagcps_sae maf_diagcps_thd_sae cl_mmv_sae lv_eol_cps_err lv_err_diagcps /end OUT_MEASUREMENT
/end FUNCTION
/begin FUNCTION OBD_Load_Throttle_position_ratio "_Load-Throttle position rationality check"
 /begin DEF_CHARACTERISTIC c_map_drv1_max_load_tps_plaus c_map_drv1_min_load_tps_plaus c_n_max_load_tps_plaus c_n_min_load_tps_plaus c_amp_mdl_dif_max c_amp_mdl_dif_min c_crlc_maf_dif_hfm_mmv c_pq_maf_plaus c_maf_dif_hfm_mdl_mmv c_maf_turb_ratio_min_isa_check c_t_err_isa_amp_plaus ip_ar_red_dif_max ip_ar_red_dif_min c_crlc_maf_dif_mdl_mmv /end DEF_CHARACTERISTIC
 /begin OUT_MEASUREMENT lv_amp_ctl_rst lv_ar_red_ctl_rst lv_ratio_chk_err ar_red_tot_bas lv_sym_load maf_kgh_mff maf_thr_opl maf_isa_opl maf_thr_isa_tot_opl maf_dif_hfm_mmv maf_dif_mdl_mmv t_err_isa_plaus t_err_amp_plaus lv_err_load_tps_plaus /end OUT_MEASUREMENT
/end FUNCTION
/begin FUNCTION OBD_Application_incidences_Load_ "_Application incidences Load-Throttle position rationality check" /begin OUT_MEASUREMENT lv_inh_load_tps_plaus lv_err_mec_isa /end OUT_MEASUREMENT /end FUNCTION
/begin FUNCTION OBD_Application_incidence_Oxygen "_Application incidence Oxygen Sensor Swapped Signal Diagnosis for binary lambda control" /begin OUT_MEASUREMENT lv_inh_diag_chg_ls_up lv_inh_diag_chg_ls_down /end OUT_MEASUREMENT /end FUNCTION
/begin FUNCTION OBD_Oxygen_Sensor_Interchanged_S "_Oxygen Sensor Interchanged Signal Diagnosis"
 /begin DEF_CHARACTERISTIC c_t_end_diag_chg_ls_up c_t_end_diag_chg_ls_down c_maf_int_diag_chg_ls_up c_max_ti_lam_cor_chg_ls_up c_min_ti_lam_cor_chg_ls_up /end DEF_CHARACTERISTIC
 /begin OUT_MEASUREMENT lv_err_chg_ls_down lv_err_chg_ls_up t_end_diag_chg_ls_up t_end_diag_chg_ls_down maf_int_diag_chg_ls_up /end OUT_MEASUREMENT
/end FUNCTION
/begin FUNCTION OBD_OBD_II_diagnosis_of_the_lamb "_OBD II diagnosis of the lambda trim control" /begin DEF_CHARACTERISTIC c_t_lam_dly_ad_max c_t_lam_dly_ad_min /end DEF_CHARACTERISTIC /begin OUT_MEASUREMENT lv_err_lam_dly_1 lv_err_lam_dly_2 /end OUT_MEASUREMENT /end FUNCTION
/begin FUNCTION OBD_Application_incidences_of_Dy "_Application incidences of Dynamic fuel trim diagnosis" /begin OUT_MEASUREMENT lv_inh_diag_lam_dly_1 lv_inh_diag_lam_dly_2 /end OUT_MEASUREMENT /end FUNCTION
/begin FUNCTION OBD_Application_incidence_enviro "_Application incidence environmental data" /begin DEF_CHARACTERISTIC ip_load_clc_amp__amp ip_load_clc__n_32__maf /end DEF_CHARACTERISTIC /begin OUT_MEASUREMENT load_clc state_ls_1 state_ls_2 /end OUT_MEASUREMENT /end FUNCTION
/begin FUNCTION OBD_Application_incidences_of_th "_Application incidences of the function Oxygen sensor downstream active plausibility check" /end FUNCTION
/begin FUNCTION OBD_Statistical_data_for_once_pe "_Statistical data for once per DC diagnosis"
 /begin OUT_MEASUREMENT fmy_ctr_diag_dc_end[0] fmy_ctr_diag_dc_end[1] fmy_ctr_diag_dc_end[2] fmy_ctr_diag_dc_end[3] fmy_ctr_diag_dc_end[4] fmy_ctr_diag_dc_end[5] fmy_ctr_diag_dc_end[6] fmy_ctr_diag_dc_end[7] fmy_ctr_diag_dc_end[8] fmy_ctr_diag_dc_end[9] fmy_ctr_diag_dc_end[10] fmy_ctr_diag_dc_end[11] fmy_ctr_diag_dc_end[12] ctr_cycnr_dc_end /end OUT_MEASUREMENT
/end FUNCTION
/begin FUNCTION SYS_System_Variables "SYS"
 /begin SUB_FUNCTION SYS_Engine_speed_setpoint_calcul SYS_Engine_speed_limit_coordinat SYS_Mass_airflow_variables SYS_Intake_manifold_model SYS_Pressure_decrease_in_the_air SYS_Volumetric_efficiency SYS_Vehicle_speed_variables SYS_Battery_voltage SYS_Coolant_temperature SYS_Air_temperature SYS_Exhaust_temperature_variable SYS_Determination_of_accelerator SYS_IVVT_Variables SYS_Gear_ratio_detection SYS_Drive_train_engaged SYS_Clutch_switch_detection SYS_Input_messages SYS_Oil_temperature SYS_Ambient_pressure_variables SYS_System_variables_in_the_exha SYS_Reduced_area_controller SYS_Ambient_Pressure_Control SYS_Engine_speed_calculation SYS_Fuel_pressure_acquisition SYS_Detection_of_Driver_Passive SYS_System_variables_for_and_fro SYS_ECU_state SYS_Pressure_Variables SYS_Engine_off_duration SYS_Calculation_of_the_basic_red SYS_Total_running_time SYS_Determination_of_Throttle_Po _Intake_manifold_model SYS_Vol_Eff_Cor_due_to_VIM_Influ SYS_ECU_Temperature SYS_Vol_Eff_Cor_due_to_Port_Flap SYS_Output_signals_of_the_DME_to SYS_Check_Sum_Calculation SYS_Multiplexed_segment_synchron SYS_Oil_temperature_and_level_se SYS_Evaporative_Emission_Control SYS_BN2000_interface_torque_dist SYS_Application_incidences_for_o SYS_Driving_off_assistance /end SUB_FUNCTION
/end FUNCTION
/begin FUNCTION SYS_Engine_speed_setpoint_calcul "_Engine speed setpoint calculation"
 /begin DEF_CHARACTERISTIC c_n_dif_crlc c_n_dif_min_mmv c_n_dif_fac ip_dri_acin_n_sp_is ip_dri_n_sp_is ip_n_sp_is_lih ip_dri_n_sp_is_lih ip_n_sp_is ip_acin_n_sp_is ip_fac_n_sp_ofs_kwp ip_dri_n_sp_ch ip_n_sp_ch ip_fac_dri_n_sp_ch ip_fac_n_sp_ch ip_n_sp_dec_ch ip_t_ast_min_n_sp_is_cs c_n_sp_ofs_kwp_max c_n_sp_ofs_kwp_min c_tam_n_sp_heat c_tam_hys c_n_sp_heat_mt c_n_sp_heat_at c_n_sp_inc_cs c_n_sp_dec_cs c_toil_min_n_sp_at c_toil_hys_n_sp_at c_n_sp_toil_at c_n_sp_lgrd_is_lih c_n_sp_is_sa_eol c_n_sp_lgrd_is c_n_sp_dec_is_ch_dri ip_n_sp_is_cs ip_n_sp_is_cs_amt c_dri_vs_min_vb c_vs_max_n_sp_cs c_vs_hys_n_sp_cs lc_is_n_sp_cs_dis /end DEF_CHARACTERISTIC
 /begin OUT_MEASUREMENT n_dif_cor n_dif_mmv n_max_tol_st n_dif_st n_sp_is_ratio n_dif n_sp_is_pow n_sp_is_ch n_sp_is_2 n_sp_is_3 lv_req_heat_n_sp_is n_sp_is lv_n_sp_is_cs /end OUT_MEASUREMENT
/end FUNCTION
/begin FUNCTION SYS_Engine_speed_limit_coordinat "_Engine speed limit coordination"
 /begin DEF_CHARACTERISTIC ip_n_max_mtc_cur_off__pv_av c_n_max_mtc_lih c_vs_max c_n_max_thd_min c_vs_max_amt ip_n_max_2__toil ip_n_max_1__toil c_n_max_amt_add c_n_max_amt_gp id_n_max_mt id_n_max_amt id_n_max_at id_n_max_h_mt id_n_max_h_amt id_n_max_h_at id_t_n_max_h_amt id_t_n_max_h_mt id_t_n_max_h_at id_n_dec_n_max_h_mt id_n_dec_n_max_h_amt id_n_dec_n_max_h_at c_n_max_dri_rvl c_vs_thd_n_max_h_mt c_vs_thd_n_max_h_amt c_vs_thd_n_max_h_at c_t_max_n_max_h_amt c_t_max_n_max_h_at c_t_max_n_max_h_mt /end DEF_CHARACTERISTIC
 /begin OUT_MEASUREMENT n_max_thd n_max_thd_1 n_max_thd_2 lv_vs_max vs_ratio n_max_vs_max lv_n_max_h lv_n_max_etc_lih /end OUT_MEASUREMENT
/end FUNCTION
/begin FUNCTION SYS_Mass_airflow_variables "_Mass airflow variables"
 /begin DEF_CHARACTERISTIC ip_pq_sp_puls c_pq_sp_hys_puls c_maf_mmv_dif_crlc c_maf_mmv_hys /end DEF_CHARACTERISTIC
 /begin OUT_MEASUREMENT maf_kgh_mes_bas maf_mes maf_kgh_mes lv_maf_puls maf_kgh maf_dif maf_mmv /end OUT_MEASUREMENT
/end FUNCTION
/begin FUNCTION SYS_Intake_manifold_model "_Intake manifold model"
 /begin DEF_CHARACTERISTIC ip_maf_mdl_con_1__tia ip_maf_egr_con_1__teg_egr ip_pred_fac__n id_maf_fac_ofs__pq_estim id_maf_fac_slop__pq_estim c_pq_thd c_pq_thd_hys c_ra ip_vol_im_neg ip_vol_im_is ip_vol_im ip_vol_im_is_neg ip_pq_isa /end DEF_CHARACTERISTIC
 /begin OUT_MEASUREMENT maf_cyl_stk maf_kgh_clc map_egr map_egr_pred map_fg_pred map_pred map_fg pq pq_egr pq_egr_estim maf_thr maf_egr map_drv1 map_egr_drv1 maf_egr_con_1 maf_fac_ofs maf_fac_ofs_egr maf_fac_slop maf_cyl maf_fg_cyl maf_fg_cyl_stk fac_maf_max maf_fac_slop_egr maf_mdl_con_1 maf_mdl_con_0 map maf_isa_fac_ofs maf_isa_fac_slop maf_thr_isa_tot maf_isa egr_ratio lv_h_load_maf_thr pq_estim pq_isa_estim map_estim maf vol_im t_seg_imm /end OUT_MEASUREMENT
/end FUNCTION
/begin FUNCTION SYS_Pressure_decrease_in_the_air "_Pressure decrease in the air filter" /begin DEF_CHARACTERISTIC ip_amp_dec__maf_cyl lc_amp_inp_ena /end DEF_CHARACTERISTIC /begin OUT_MEASUREMENT prs_up_thr prs_up_thr_max /end OUT_MEASUREMENT /end FUNCTION
/begin FUNCTION SYS_Volumetric_efficiency "_Volumetric efficiency"
 /begin DEF_CHARACTERISTIC ip_t_vim_eff_vol ip_eff_vol_slop_cam_in_vim ip_eff_vol_slop_cam_vo_vim ip_eff_vol_ofs_vim ip_eff_vol_ofs ip_eff_vol_ofs_amp c_tcyl_stnd c_tco_stnd c_tia_im_stnd ip_eff_vol_slop_cam_vo ip_eff_vol_slop_cam_in ip_crlc_eff_vol_temp_cor ip_eff_tco_fac__n_32__maf ip_eff_tia_im_fac__n_32__maf ip_eff_vol_slop_amp ip_eff_vol_ofs_max ip_eff_vol_slop_max /end DEF_CHARACTERISTIC
 /begin OUT_MEASUREMENT eff_vol_slop eff_vol_temp_cor eff_vol_temp_cor_mmv eff_vol_ofs_max_cor eff_vol_ofs eff_vol_slop_max_cor eff_vol_ofs_bas eff_vol_slop_bas eff_vol_ofs_bas_goal eff_vol_slop_bas_goal eff_vol_ofs_bas_0 eff_vol_slop_bas_0 eff_vol_ofs_bas_1 eff_vol_slop_bas_1 /end OUT_MEASUREMENT
/end FUNCTION
/begin FUNCTION SYS_Vehicle_speed_variables "_Vehicle speed variables" /begin DEF_CHARACTERISTIC c_vs_min_run c_t_vst c_vs_edge_sum_min c_vs_fac /end DEF_CHARACTERISTIC
 /begin OUT_MEASUREMENT vs_edge_av.edge_ctr vs_edge_av.edge_t lv_vs_run vs_sens vs_sens_grd lv_vst vs /end OUT_MEASUREMENT
/end FUNCTION
/end MODULE
/end PROJECT
