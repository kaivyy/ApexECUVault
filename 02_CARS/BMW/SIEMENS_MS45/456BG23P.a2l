ASAP2_VERSION 1 31
/begin PROJECT MS45 "BMW Motorsteuerung R6"
/begin HEADER "_default_HeaderComment" PROJECT_NO _56 /end HEADER
/begin MODULE _default_ModuleName "_default_ModuleLongIdentifier"
/begin MOD_COMMON "_default_ModCommonComment" DEPOSIT ABSOLUTE BYTE_ORDER MSB_FIRST ALIGNMENT_BYTE 1 ALIGNMENT_WORD 2 ALIGNMENT_LONG 4 ALIGNMENT_FLOAT32_IEEE 4 ALIGNMENT_FLOAT64_IEEE 8 /end MOD_COMMON
/begin MEASUREMENT lv_off_iv_mon "Request for disable of MTC power stage by main controller" UBYTE _CNV_S_2_RANGE______5_CM 1 100. 0. 1. DISPLAY_IDENTIFIER LV_OFF_IV_MON ECU_ADDRESS 0x3fe64d BIT_MASK 0x1 /end MEASUREMENT
/begin MEASUREMENT lv_off_mtc_iv_mu_mon "Request for wrong answers of the instruction set test to the monitoring unit in order to disable MTC and IV" UBYTE _CNV_S_2_RANGE______5_CM 1 100. 0. 1. DISPLAY_IDENTIFIER LV_OFF_MTC_IV_MU_MON ECU_ADDRESS 0x3fe64e BIT_MASK 0x1 /end MEASUREMENT
/begin MEASUREMENT lv_off_mtc_mon "Request for disable of MTC power stage by main controller" UBYTE _CNV_S_2_RANGE______5_CM 1 100. 0. 1. DISPLAY_IDENTIFIER LV_OFF_MTC_MON ECU_ADDRESS 0x3fe64b BIT_MASK 0x1 /end MEASUREMENT
/begin MEASUREMENT lv_n_lim_req_mon "Request for engine speed limitation" UBYTE _CNV_S_2_RANGE______5_CM 1 100. 0. 1. DISPLAY_IDENTIFIER LV_N_LIM_REQ_MON ECU_ADDRESS 0x3fe64c BIT_MASK 0x1 /end MEASUREMENT
/begin MEASUREMENT lv_sof_swi_req_mon "Sport Mode required by switch" UBYTE _CNV_S_2_RANGE______5_CM 1 100. 0. 1. DISPLAY_IDENTIFIER LV_SOF_SWI_REQ_MON ECU_ADDRESS 0x3fe694 /end MEASUREMENT
/begin MEASUREMENT lv_sof_swi_mon "Sport Mode switch acting" UBYTE _CNV_S_2_RANGE______5_CM 1 100. 0. 1. DISPLAY_IDENTIFIER LV_SOF_SWI_MON ECU_ADDRESS 0x3fe6a2 /end MEASUREMENT
/begin MEASUREMENT lv_rng_l_mon "Logical variable for engaged low range monitoring" UBYTE _CNV_S_2_RANGE______0_CM 1 100. 0. 1. DISPLAY_IDENTIFIER LV_RNG_L_MON ECU_ADDRESS 0x3fe695 /end MEASUREMENT
/begin MEASUREMENT lv_rng_l_req_mon "Activation condition for low-range-mode" UBYTE _CNV_S_2_RANGE______0_CM 1 100. 0. 1. DISPLAY_IDENTIFIER LV_RNG_L_REQ_MON ECU_ADDRESS 0x3fe696 /end MEASUREMENT
/begin MEASUREMENT lv_err_sof_inh_mon "Error flag sport mode switch request monitoring" UBYTE _CNV_S_2_RANGE______2_R_CM 1 100. 0. 255. DISPLAY_IDENTIFIER LV_ERR_SOF_INH_MON ECU_ADDRESS 0x3fe697 /end MEASUREMENT
/begin MEASUREMENT abc_sof_inh_mon "Error flag sport mode switch request monitoring" UBYTE _CNV_A_R_LINEAR_____1_CM 1 100. 0. 255. DISPLAY_IDENTIFIER ABC_SOF_INH_MON ECU_ADDRESS 0x3fe698 FORMAT "%3.0" /end MEASUREMENT
/begin CHARACTERISTIC c_v_sof_swi_on_tol_mon "Voltage-Treshold top limit for sport mode ON" VALUE 0x120fa _REC_VAL_20_u2 4.99511719 _CNV_A_R_LINEAR_____3_CM 0. 4.99511719 DISPLAY_IDENTIFIER C_V_SOF_SWI_ON_TOL_MON FORMAT "%5.3" /end CHARACTERISTIC
/begin CHARACTERISTIC c_v_sof_swi_on_bol_mon "Voltage-Treshold bottom limit for sport mode ON" VALUE 0x120f8 _REC_VAL_20_u2 4.99511719 _CNV_A_R_LINEAR_____3_CM 0. 4.99511719 DISPLAY_IDENTIFIER C_V_SOF_SWI_ON_BOL_MON FORMAT "%5.3" /end CHARACTERISTIC
/begin CHARACTERISTIC lc_var_sof_swi_mon "Calibration sport switch (1 on / 0 off)" VALUE 0x11fdd _REC_VAL_20_u1 1. _CNV_A_R_LINEAR_____1_CM 0. 1. DISPLAY_IDENTIFIER LC_VAR_SOF_SWI_MON FORMAT "%2.0" /end CHARACTERISTIC
/begin CHARACTERISTIC lc_rng_l_mon "Manual switch for low range detection monitoring" VALUE 0x11fd9 _REC_VAL_20_u1 1. _CNV_A_R_LINEAR_____22_CM 0. 1. DISPLAY_IDENTIFIER LC_RNG_L_MON FORMAT "%1.0" /end CHARACTERISTIC
/begin CHARACTERISTIC lc_conf_city_ena_mon "Enable city mode off condition (1 on / 0 off)" VALUE 0x11fd7 _REC_VAL_20_u1 1. _CNV_A_R_LINEAR_____1_CM 0. 1. DISPLAY_IDENTIFIER LC_CONF_CITY_ENA_MON FORMAT "%2.0" /end CHARACTERISTIC
/begin CHARACTERISTIC c_pv_av_sof_min_mon "PV_AV threshold for activation IP_FAC_TQ_REQ_DRIV_RNG_L_MON" VALUE 0x11d83 _REC_VAL_20_u1 99.609375 _CNV_A_R_LINEAR_____10_CM 0. 99.609375 DISPLAY_IDENTIFIER C_PV_AV_SOF_MIN_MON FORMAT "%4.1" /end CHARACTERISTIC
/begin CHARACTERISTIC c_fac_tq_req_driv_sof_max_mon "Scaling factor threshold for activation IP_FAC_TQ_REQ_DRIV_RNG_L_MON" VALUE 0x11d76 _REC_VAL_20_u1 1.99220002 _CNV_A_R_LINEAR_____39_CM 0. 1.99220002 DISPLAY_IDENTIFIER C_FAC_TQ_REQ_DRIV_SOF_MAX_MON FORMAT "%5.3" /end CHARACTERISTIC
/begin CHARACTERISTIC c_pv_av_grd_sof_max_mon "Pedal value gradient rheshold for recognition of LV_RNG_L_MON" VALUE 0x11d82 _REC_VAL_20_u1 2490.234 _CNV_A_R_LINEAR_____40_CM -1250. 1240.234 DISPLAY_IDENTIFIER C_PV_AV_GRD_SOF_MAX_MON FORMAT "%6.1" /end CHARACTERISTIC
/begin CHARACTERISTIC c_t_pv_av_grd_sof_max_mon "Minimum time for pedal value gradient for recognition of LV_RNG_L_MON" VALUE 0x11d95 _REC_VAL_20_u1 10.2 _CNV_A_R_LINEAR_____41_CM 0. 10.2 DISPLAY_IDENTIFIER C_T_PV_AV_GRD_SOF_MAX_MON FORMAT "%5.2" /end CHARACTERISTIC
/begin CHARACTERISTIC lc_rng_l_man_as_mon "Calibration constant for to activate IP_FAC_TQ_REQ_DRIV_RNG_L (low range mode) in case if LV_RNG_L = 0 (default value = 0)" VALUE 0x11fd8 _REC_VAL_20_u1 1. _CNV_A_R_LINEAR_____1_CM 0. 1. DISPLAY_IDENTIFIER LC_RNG_L_MAN_AS_MON FORMAT "%2.0" /end CHARACTERISTIC
/begin CHARACTERISTIC c_v_sof_swi_min_mon "Input voltage threshold min" VALUE 0x120f6 _REC_VAL_20_u2 4.99511719 _CNV_A_R_LINEAR_____3_CM 0. 4.99511719 DISPLAY_IDENTIFIER C_V_SOF_SWI_MIN_MON FORMAT "%5.3" /end CHARACTERISTIC
/begin CHARACTERISTIC c_v_sof_swi_max_mon "Input voltage threshold max" VALUE 0x120f4 _REC_VAL_20_u2 4.99511719 _CNV_A_R_LINEAR_____3_CM 0. 4.99511719 DISPLAY_IDENTIFIER C_V_SOF_SWI_MAX_MON FORMAT "%5.3" /end CHARACTERISTIC
/begin MEASUREMENT lv_err_conv_mon_1 "A/D conversion error reflect to level 1" UBYTE _CNV_S_2_RANGE______2_R_CM 1 100. 0. 255. DISPLAY_IDENTIFIER LV_ERR_CONV_MON_1 ECU_ADDRESS 0x3fb9fc BIT_MASK 0x1 /end MEASUREMENT
/begin CHARACTERISTIC c_can_vb_min_diag_mon "Threshold of battery voltage for CAN diagnosis" VALUE 0x11d70 _REC_VAL_20_u1 26. _CNV_A_R_LINEAR_____60_CM 0. 26. DISPLAY_IDENTIFIER C_CAN_VB_MIN_DIAG_MON FORMAT "%4.1" /end CHARACTERISTIC
/begin CHARACTERISTIC c_t_msr_inh_mon "Delay time for disable of MSR torque demand in monitoring level" VALUE 0x11d94 _REC_VAL_20_u1 10.2 _CNV_A_R_LINEAR_____41_CM 0. 10.2 DISPLAY_IDENTIFIER C_T_MSR_INH_MON FORMAT "%5.2" /end CHARACTERISTIC
/begin CHARACTERISTIC c_tqi_stnd_mon "Maximum indicated engine torque (scalling factor for torque demands from CAN)" VALUE 0x11da5 _REC_VAL_20_u1 510. _CNV_A_R_LINEAR_____101_CM 0. 510. DISPLAY_IDENTIFIER C_TQI_STND_MON FORMAT "%4.0" /end CHARACTERISTIC
/begin MEASUREMENT tqi_msr_mon "Torque demand from drag control" UBYTE _CNV_A_R_LINEAR_____101_CM 1 100. 0. 510. DISPLAY_IDENTIFIER TQI_MSR_MON ECU_ADDRESS 0x3fe5ed FORMAT "%4.0" /end MEASUREMENT
/begin MEASUREMENT t_msr_inh_mon "Timer for inhibition of MSR torque demand in monitoring level" UBYTE _CNV_A_R_LINEAR_____41_CM 1 100. 0. 10.2 DISPLAY_IDENTIFIER T_MSR_INH_MON ECU_ADDRESS 0x3fe5ee FORMAT "%5.2" /end MEASUREMENT
/begin MEASUREMENT abc_msr_inh_mon "Anti bounce counter for fault in MSR present" UBYTE _CNV_A_R_LINEAR_____1_CM 1 100. 0. 255. DISPLAY_IDENTIFIER ABC_MSR_INH_MON ECU_ADDRESS 0x3fe602 FORMAT "%3.0" /end MEASUREMENT
/begin MEASUREMENT tq_msr_mon "Torque demand from drag control BN 2000" SWORD _CNV_A_R_LINEAR_____55_CM 1 100. -1024. 1023.96875 DISPLAY_IDENTIFIER TQ_MSR_MON ECU_ADDRESS 0x3fda30 BYTE_ORDER MSB_LAST FORMAT "%8.2" /end MEASUREMENT
/begin MEASUREMENT tq_dcc_mon "DCC torque request for monitoring" SWORD _CNV_A_R_LINEAR_____55_CM 1 100. -1024. 1023.96875 DISPLAY_IDENTIFIER TQ_DCC_MON ECU_ADDRESS 0x3fda32 BYTE_ORDER MSB_LAST FORMAT "%8.2" /end MEASUREMENT
/begin MEASUREMENT abc_dcc_inh_mon "Anti bounce counter for fault in DCC present" UBYTE _CNV_A_R_LINEAR_____1_CM 1 100. 0. 255. DISPLAY_IDENTIFIER ABC_DCC_INH_MON ECU_ADDRESS 0x3fe604 FORMAT "%3.0" /end MEASUREMENT
/begin MEASUREMENT lv_err_dcc_rev_mon "Reversible DCC error mon" UBYTE _CNV_S_2_RANGE______2_R_CM 1 100. 0. 255. DISPLAY_IDENTIFIER LV_ERR_DCC_REV_MON ECU_ADDRESS 0x3fe638 /end MEASUREMENT
/begin MEASUREMENT t_dcc_brake_det_mon "Irreversible DCC error mon" UBYTE _CNV_A_R_LINEAR_____41_CM 1 100. 0. 10.2 DISPLAY_IDENTIFIER T_DCC_BRAKE_DET_MON ECU_ADDRESS 0x3fe610 FORMAT "%5.2" /end MEASUREMENT
/begin MEASUREMENT lv_err_dcc_inh_mon "Logical variable for fault in DCC present" UBYTE _CNV_S_2_RANGE______2_R_CM 1 100. 0. 255. DISPLAY_IDENTIFIER LV_ERR_DCC_INH_MON ECU_ADDRESS 0x3fe5f7 /end MEASUREMENT
/begin MEASUREMENT t_dcc_inh_mon "Timer for inhibition of DCC torque demand in monitoring level" UBYTE _CNV_A_R_LINEAR_____41_CM 1 100. 0. 10.2 DISPLAY_IDENTIFIER T_DCC_INH_MON ECU_ADDRESS 0x3fe5ef FORMAT "%5.2" /end MEASUREMENT
/begin MEASUREMENT state_err_amt_mon "State of AMT Error intervention" UBYTE _CNV_A_R_LINEAR_____1_CM 1 100. 0. 255. DISPLAY_IDENTIFIER STATE_ERR_AMT_MON ECU_ADDRESS 0x3fe5f2 FORMAT "%3.0" /end MEASUREMENT
/begin MEASUREMENT t_state_amt_1_diag_mon "Intervention  in shift phase 1" UBYTE _CNV_A_R_LINEAR_____41_CM 1 100. 0. 10.2 DISPLAY_IDENTIFIER T_STATE_AMT_1_DIAG_MON ECU_ADDRESS 0x3fe612 FORMAT "%5.2" /end MEASUREMENT
/begin MEASUREMENT t_state_amt_2_diag_mon "Intervention  in shift phase 2" UBYTE _CNV_A_R_LINEAR_____41_CM 1 100. 0. 10.2 DISPLAY_IDENTIFIER T_STATE_AMT_2_DIAG_MON ECU_ADDRESS 0x3fe614 FORMAT "%5.2" /end MEASUREMENT
/begin MEASUREMENT t_state_amt_3_diag_mon "Intervention  in shift phase 3" UBYTE _CNV_A_R_LINEAR_____41_CM 1 100. 0. 10.2 DISPLAY_IDENTIFIER T_STATE_AMT_3_DIAG_MON ECU_ADDRESS 0x3fe616 FORMAT "%5.2" /end MEASUREMENT
/begin MEASUREMENT t_state_clu_amt_diag_mon "Timer clutch state 3" UBYTE _CNV_A_R_LINEAR_____41_CM 1 100. 0. 10.2 DISPLAY_IDENTIFIER T_STATE_CLU_AMT_DIAG_MON ECU_ADDRESS 0x3fe618 FORMAT "%5.2" /end MEASUREMENT
/begin MEASUREMENT t_tqi_amt_diag_mon "Intervention timer  1 or 3" UBYTE _CNV_A_R_LINEAR_____41_CM 1 100. 0. 10.2 DISPLAY_IDENTIFIER T_TQI_AMT_DIAG_MON ECU_ADDRESS 0x3fe61c FORMAT "%5.2" /end MEASUREMENT
/begin MEASUREMENT tqi_amt_plaus_mon "Plausibility torque" UBYTE _CNV_A_R_LINEAR_____101_CM 1 100. 0. 510. DISPLAY_IDENTIFIER TQI_AMT_PLAUS_MON ECU_ADDRESS 0x3fe61e FORMAT "%3.0" /end MEASUREMENT
/begin MEASUREMENT tqi_gs_mon "Torque demand from drag control  CAN 11H" UBYTE _CNV_A_R_LINEAR_____101_CM 1 100. 0. 510. DISPLAY_IDENTIFIER TQI_GS_MON ECU_ADDRESS 0x3fe5f3 FORMAT "%3.0" /end MEASUREMENT
/begin MEASUREMENT lv_err_amt_inh_mon "Logical variable for fault in MSR present" UBYTE _CNV_S_2_RANGE______2_R_CM 1 100. 0. 255. DISPLAY_IDENTIFIER LV_ERR_AMT_INH_MON ECU_ADDRESS 0x3fe5fa /end MEASUREMENT
/begin MEASUREMENT t_amt_inh_mon "Timer for inhibition of AMT torque demand in monitoring level" UBYTE _CNV_A_R_LINEAR_____41_CM 1 100. 0. 10.2 DISPLAY_IDENTIFIER T_AMT_INH_MON ECU_ADDRESS 0x3fe5f1 FORMAT "%5.2" /end MEASUREMENT
/begin MEASUREMENT t_gs_inh_mon "Timer for inhibition of GS torque demand in monitoring level" UBYTE _CNV_A_R_LINEAR_____41_CM 1 100. 0. 10.2 DISPLAY_IDENTIFIER T_GS_INH_MON ECU_ADDRESS 0x3fe5f4 FORMAT "%5.2" /end MEASUREMENT
/begin MEASUREMENT tq_gs_mon "Engine torgue request of EGS  Checked torque value in monitoring level" SWORD _CNV_A_R_LINEAR_____55_CM 1 100. -1024. 1023.96875 DISPLAY_IDENTIFIER TQ_GS_MON ECU_ADDRESS 0x3fda36 BYTE_ORDER MSB_LAST FORMAT "%8.2" /end MEASUREMENT
/begin MEASUREMENT lv_err_gs_inh_mon "Logical variable for fault in GS present" UBYTE _CNV_S_2_RANGE______2_R_CM 1 100. 0. 255. DISPLAY_IDENTIFIER LV_ERR_GS_INH_MON ECU_ADDRESS 0x3fe5f9 /end MEASUREMENT
/begin MEASUREMENT lv_err_tq_gs_inc_plaus_mon "GS torque increase not plausible" UBYTE _CNV_S_2_RANGE______2_R_CM 1 100. 0. 255. DISPLAY_IDENTIFIER LV_ERR_TQ_GS_INC_PLAUS_MON ECU_ADDRESS 0x3fe5fd /end MEASUREMENT
/begin MEASUREMENT state_gs_plaus_mon "State GS torque increase not plausible bit coded" UBYTE _CNV_A_R_LINEAR_____1_CM 1 100. 0. 63. DISPLAY_IDENTIFIER STATE_GS_PLAUS_MON ECU_ADDRESS 0x3fe5f5 FORMAT "%2.0" /end MEASUREMENT
/begin MEASUREMENT lv_int_max_tq_gs_inc_mon "Gs requested torque value to high and not plausible" UBYTE _CNV_S_2_RANGE______0_CM 1 100. 0. 1. DISPLAY_IDENTIFIER LV_INT_MAX_TQ_GS_INC_MON ECU_ADDRESS 0x3fe5fc /end MEASUREMENT
/begin MEASUREMENT int_tq_gs_inc_mon "Integrated Torque request EGS" UWORD _CNV_A_R_LINEAR_____102_CM 1 100. 0. 204.7 DISPLAY_IDENTIFIER INT_TQ_GS_INC_MON ECU_ADDRESS 0x3fda38 BYTE_ORDER MSB_LAST FORMAT "%7.3" /end MEASUREMENT
/begin MEASUREMENT lv_vs_min_tq_gs_inc_mon "GS about VS torque increase not plausible" UBYTE _CNV_S_2_RANGE______0_CM 1 100. 0. 1. DISPLAY_IDENTIFIER LV_VS_MIN_TQ_GS_INC_MON ECU_ADDRESS 0x3fe5fb /end MEASUREMENT
/begin MEASUREMENT ctr_t_vs_tq_gs_inc_mon "Vehicle speed threshold time delay" UBYTE _CNV_A_R_LINEAR_____41_CM 1 100. 0. 10.2 DISPLAY_IDENTIFIER CTR_T_VS_TQ_GS_INC_MON ECU_ADDRESS 0x3fe620 FORMAT "%5.2" /end MEASUREMENT
/begin MEASUREMENT ctr_t_ac_tq_gs_inc_mon "AC counter time delay" UBYTE _CNV_A_R_LINEAR_____41_CM 1 100. 0. 10.2 DISPLAY_IDENTIFIER CTR_T_AC_TQ_GS_INC_MON ECU_ADDRESS 0x3fe622 FORMAT "%5.2" /end MEASUREMENT
/begin MEASUREMENT lv_ac_max_tq_gs_inc_mon "GS about AC requested torque value to high and not plausible" UBYTE _CNV_S_2_RANGE______0_CM 1 100. 0. 1. DISPLAY_IDENTIFIER LV_AC_MAX_TQ_GS_INC_MON ECU_ADDRESS 0x3fe5fe /end MEASUREMENT
/begin MEASUREMENT lv_t_min_tq_gs_inc_deac_mon "Minimum time between two requests to low" UBYTE _CNV_S_2_RANGE______0_CM 1 100. 0. 1. DISPLAY_IDENTIFIER LV_T_MIN_TQ_GS_INC_DEAC_MON ECU_ADDRESS 0x3fe5ff /end MEASUREMENT
/begin MEASUREMENT ctr_t_max_tq_gs_inc_mon "Counter MAX time limit threshold time" UBYTE _CNV_A_R_LINEAR_____41_CM 1 100. 0. 10.2 DISPLAY_IDENTIFIER CTR_T_MAX_TQ_GS_INC_MON ECU_ADDRESS 0x3fe626 FORMAT "%5.2" /end MEASUREMENT
/begin MEASUREMENT lv_t_max_tq_gs_inc_mon "Requesting time to long" UBYTE _CNV_S_2_RANGE______0_CM 1 100. 0. 1. DISPLAY_IDENTIFIER LV_T_MAX_TQ_GS_INC_MON ECU_ADDRESS 0x3fe600 /end MEASUREMENT
/begin MEASUREMENT lv_tq_max_tq_gs_inc_mon "Inegrated torque to high" UBYTE _CNV_S_2_RANGE______0_CM 1 100. 0. 1. DISPLAY_IDENTIFIER LV_TQ_MAX_TQ_GS_INC_MON ECU_ADDRESS 0x3fe601 /end MEASUREMENT
/begin MEASUREMENT ctr_t_dif_min_tq_gs_inc_mon "Minimum time between two requests to low" UBYTE _CNV_A_R_LINEAR_____41_CM 1 100. 0. 10.2 DISPLAY_IDENTIFIER CTR_T_DIF_MIN_TQ_GS_INC_MON ECU_ADDRESS 0x3fe624 FORMAT "%5.2" /end MEASUREMENT
/begin MEASUREMENT ctr_t_tq_max_tq_gs_inc_mon "Min time limit threshold time delay" UBYTE _CNV_A_R_LINEAR_____41_CM 1 100. 0. 10.2 DISPLAY_IDENTIFIER CTR_T_TQ_MAX_TQ_GS_INC_MON ECU_ADDRESS 0x3fe628 FORMAT "%5.2" /end MEASUREMENT
/begin CHARACTERISTIC c_t_dcc_inh_mon "Delay time for disable of DCC torque demand in monitoring level" VALUE 0x11d87 _REC_VAL_20_u1 10.2 _CNV_A_R_LINEAR_____41_CM 0. 10.2 DISPLAY_IDENTIFIER C_T_DCC_INH_MON FORMAT "%5.2" /end CHARACTERISTIC
/begin CHARACTERISTIC c_t_max_brake_det_dcc_mon "Maximum Brake delay timer" VALUE 0x11d8d _REC_VAL_20_u1 10.2 _CNV_A_R_LINEAR_____41_CM 0. 10.2 DISPLAY_IDENTIFIER C_T_MAX_BRAKE_DET_DCC_MON FORMAT "%5.2" /end CHARACTERISTIC
/begin CHARACTERISTIC c_vs_fil_amt_mon "Vehicle speed threshold  engine stop" VALUE 0x12100 _REC_VAL_20_u2 511.99218 _CNV_A_R_LINEAR_____85_CM 0. 511.99218 DISPLAY_IDENTIFIER C_VS_FIL_AMT_MON FORMAT "%7.3" /end CHARACTERISTIC
/begin CHARACTERISTIC c_t_max_state_amt_1_diag_mon "Max Intervention  in shift phase 1" VALUE 0x11d8e _REC_VAL_20_u1 10.2 _CNV_A_R_LINEAR_____41_CM 0. 10.2 DISPLAY_IDENTIFIER C_T_MAX_STATE_AMT_1_DIAG_MON FORMAT "%5.2" /end CHARACTERISTIC
/begin CHARACTERISTIC c_t_max_state_amt_2_diag_mon "Max Intervention  in shift phase 2" VALUE 0x11d8f _REC_VAL_20_u1 10.2 _CNV_A_R_LINEAR_____41_CM 0. 10.2 DISPLAY_IDENTIFIER C_T_MAX_STATE_AMT_2_DIAG_MON FORMAT "%5.2" /end CHARACTERISTIC
/begin CHARACTERISTIC c_tqi_amt_diag_mon "Plausibility torque intervention hysteresis" VALUE 0x11da2 _REC_VAL_20_u1 510. _CNV_A_R_LINEAR_____101_CM 0. 510. DISPLAY_IDENTIFIER C_TQI_AMT_DIAG_MON FORMAT "%3.0" /end CHARACTERISTIC
/begin CHARACTERISTIC c_t_max_state_amt_3_diag_mon "Max Intervention  in shift phase 3" VALUE 0x11d90 _REC_VAL_20_u1 10.2 _CNV_A_R_LINEAR_____41_CM 0. 10.2 DISPLAY_IDENTIFIER C_T_MAX_STATE_AMT_3_DIAG_MON FORMAT "%5.2" /end CHARACTERISTIC
/begin CHARACTERISTIC c_t_max_tqi_amt_diag_mon "Max. timer shift intervention phase 1or 3" VALUE 0x11d93 _REC_VAL_20_u1 10.2 _CNV_A_R_LINEAR_____41_CM 0. 10.2 DISPLAY_IDENTIFIER C_T_MAX_TQI_AMT_DIAG_MON FORMAT "%5.2" /end CHARACTERISTIC
/begin CHARACTERISTIC c_tqi_amt_cond_diag_mon "Torque at shift phase 0" VALUE 0x11da1 _REC_VAL_20_u1 510. _CNV_A_R_LINEAR_____101_CM 0. 510. DISPLAY_IDENTIFIER C_TQI_AMT_COND_DIAG_MON FORMAT "%3.0" /end CHARACTERISTIC
/begin CHARACTERISTIC c_tqi_amt_can_es_mon "Torque at engine stop" VALUE 0x11da0 _REC_VAL_20_u1 510. _CNV_A_R_LINEAR_____101_CM 0. 510. DISPLAY_IDENTIFIER C_TQI_AMT_CAN_ES_MON FORMAT "%3.0" /end CHARACTERISTIC
/begin CHARACTERISTIC c_t_max_state_clu_amt_diag_mon "Max. time at clutch" VALUE 0x11d91 _REC_VAL_20_u1 10.2 _CNV_A_R_LINEAR_____41_CM 0. 10.2 DISPLAY_IDENTIFIER C_T_MAX_STATE_CLU_AMT_DIAG_MON FORMAT "%5.2" /end CHARACTERISTIC
/begin CHARACTERISTIC c_t_amt_inh_mon "Delay time for disable of AMT torque demand in monitoring level" VALUE 0x11d85 _REC_VAL_20_u1 10.2 _CNV_A_R_LINEAR_____41_CM 0. 10.2 DISPLAY_IDENTIFIER C_T_AMT_INH_MON FORMAT "%5.2" /end CHARACTERISTIC
/begin CHARACTERISTIC c_t_gs_inh_mon "Delay time for disable of GS torque demand in monitoring level" VALUE 0x11d8c _REC_VAL_20_u1 10.2 _CNV_A_R_LINEAR_____41_CM 0. 10.2 DISPLAY_IDENTIFIER C_T_GS_INH_MON FORMAT "%5.2" /end CHARACTERISTIC
/begin CHARACTERISTIC c_vs_min_tq_gs_inc_mon "Vehicle speed threshold" VALUE 0x12102 _REC_VAL_20_u2 511.99218 _CNV_A_R_LINEAR_____85_CM 0. 511.99218 DISPLAY_IDENTIFIER C_VS_MIN_TQ_GS_INC_MON FORMAT "%7.3" /end CHARACTERISTIC
/begin CHARACTERISTIC c_t_dly_min_vs_tq_gs_inc_mon "Vehicle speed threshold time delay" VALUE 0x11d8a _REC_VAL_20_u1 10.2 _CNV_A_R_LINEAR_____41_CM 0. 10.2 DISPLAY_IDENTIFIER C_T_DLY_MIN_VS_TQ_GS_INC_MON FORMAT "%5.2" /end CHARACTERISTIC
/begin CHARACTERISTIC c_crlc_tq_gs_inc_plaus_mon "Corelation of torque request " VALUE 0x11d72 _REC_VAL_20_u1 0.9960940000000002 _CNV_A_R_LINEAR_____50_CM 0. 0.996094 DISPLAY_IDENTIFIER C_CRLC_TQ_GS_INC_PLAUS_MON FORMAT "%5.3" /end CHARACTERISTIC
/begin CHARACTERISTIC c_int_max_tq_gs_inc_mon "Max value integrated torque" VALUE 0x120dc _REC_VAL_20_u2 204.7 _CNV_A_R_LINEAR_____102_CM 0. 204.7 DISPLAY_IDENTIFIER C_INT_MAX_TQ_GS_INC_MON FORMAT "%7.3" /end CHARACTERISTIC
/begin CHARACTERISTIC c_int_min_tq_gs_inc_mon "Min value integrated torque" VALUE 0x120de _REC_VAL_20_u2 204.7 _CNV_A_R_LINEAR_____102_CM 0. 204.7 DISPLAY_IDENTIFIER C_INT_MIN_TQ_GS_INC_MON FORMAT "%7.3" /end CHARACTERISTIC
/begin CHARACTERISTIC c_t_dly_ac_max_tq_gs_inc_mon "AC threshold time delay" VALUE 0x11d89 _REC_VAL_20_u1 10.2 _CNV_A_R_LINEAR_____41_CM 0. 10.2 DISPLAY_IDENTIFIER C_T_DLY_AC_MAX_TQ_GS_INC_MON FORMAT "%5.2" /end CHARACTERISTIC
/begin CHARACTERISTIC c_t_max_tq_gs_inc_mon "Min time limit threshold time delay" VALUE 0x11d92 _REC_VAL_20_u1 10.2 _CNV_A_R_LINEAR_____41_CM 0. 10.2 DISPLAY_IDENTIFIER C_T_MAX_TQ_GS_INC_MON FORMAT "%5.2" /end CHARACTERISTIC
/begin CHARACTERISTIC c_t_dly_tq_max_tq_gs_inc_mon "Min time limit threshold time delay" VALUE 0x11d8b _REC_VAL_20_u1 10.2 _CNV_A_R_LINEAR_____41_CM 0. 10.2 DISPLAY_IDENTIFIER C_T_DLY_TQ_MAX_TQ_GS_INC_MON FORMAT "%5.2" /end CHARACTERISTIC
/begin AXIS_PTS ldp_vs_fil__tq_gs_inc_mon "" 0x1220e vs_fil _REC_AXS_20_u2 511.99218 _CNV_A_R_LINEAR_____85_CM 6 0. 511.99218 DISPLAY_IDENTIFIER LDP_VS_FIL__TQ_GS_INC_MON FORMAT "%7.3" /end AXIS_PTS
/begin AXIS_PTS ldp_n_32__tq_gs_inc_mon "" 0x12023 n_32 _REC_AXS_20_u1 8160. _CNV_A_R_LINEAR_____16_CM 6 0. 8160. DISPLAY_IDENTIFIER LDP_N_32__TQ_GS_INC_MON FORMAT "%4.0" /end AXIS_PTS
/begin CHARACTERISTIC ip_ac_max_tq_gs_inc_mon "Acceleration threshold" CURVE 0x12104 _REC_CUR_20_u2_u2 102.35 _CNV_A_R_LINEAR_____103_CM -51.175 51.175 DISPLAY_IDENTIFIER IP_AC_MAX_TQ_GS_INC_MON FORMAT "%7.4"
 /begin AXIS_DESCR COM_AXIS vs_fil _CNV_A_R_LINEAR_____85_CM 6 0. 511.99218 FORMAT "%7.3" AXIS_PTS_REF ldp_vs_fil__tq_gs_inc_mon /end AXIS_DESCR
/end CHARACTERISTIC
/begin CHARACTERISTIC ip_tq_max_tq_gs_inc_mon "Maximum requested torque EGS " CURVE 0x1215a _REC_CUR_20_u2_u1 1023.96875 _CNV_A_R_LINEAR_____55_CM 0. 1023.96875 DISPLAY_IDENTIFIER IP_TQ_MAX_TQ_GS_INC_MON FORMAT "%7.2"
 /begin AXIS_DESCR COM_AXIS n_32 _CNV_A_R_LINEAR_____16_CM 6 0. 8160. FORMAT "%4.0" AXIS_PTS_REF ldp_n_32__tq_gs_inc_mon /end AXIS_DESCR
/end CHARACTERISTIC
/begin MEASUREMENT abc_amt_inh_mon "Anti bounce counter for fault in AMT present" UBYTE _CNV_A_R_LINEAR_____1_CM 1 100. 0. 255. DISPLAY_IDENTIFIER ABC_AMT_INH_MON ECU_ADDRESS 0x3fe606 FORMAT "%3.0" /end MEASUREMENT
/begin MEASUREMENT state_amt_old_mon "Previos shift phase3 " UBYTE _CNV_A_R_LINEAR_____1_CM 1 100. 0. 3. DISPLAY_IDENTIFIER STATE_AMT_OLD_MON ECU_ADDRESS 0x3fe61a FORMAT "%2.0" /end MEASUREMENT
/begin MEASUREMENT lv_err_dcc_irrev_mon "Irreversible DCC error mon" UBYTE _CNV_S_2_RANGE______2_R_CM 1 100. 0. 255. DISPLAY_IDENTIFIER LV_ERR_DCC_IRREV_MON ECU_ADDRESS 0x3fe63a /end MEASUREMENT
/begin MEASUREMENT lv_dcc_off_ecu_mon "Irreversible DCC error mon" UBYTE _CNV_S_2_RANGE______2_R_CM 1 100. 0. 255. DISPLAY_IDENTIFIER LV_DCC_OFF_ECU_MON ECU_ADDRESS 0x3fe5f8 /end MEASUREMENT
/begin MEASUREMENT tq_amt_mon "Engine torgue request of AMT  Checked torque value in monitoring level" SWORD _CNV_A_R_LINEAR_____55_CM 1 100. -1024. 1023.96875 DISPLAY_IDENTIFIER TQ_AMT_MON ECU_ADDRESS 0x3fda34 BYTE_ORDER MSB_LAST FORMAT "%8.2" /end MEASUREMENT
/begin MEASUREMENT tqi_amt_mon "Torque demand from AMT control CAN11H" UBYTE _CNV_A_R_LINEAR_____101_CM 1 100. 0. 510. DISPLAY_IDENTIFIER TQI_AMT_MON ECU_ADDRESS 0x3fe5f0 FORMAT "%3.0" /end MEASUREMENT
/begin MEASUREMENT abc_gs_inh_mon "Anti bounce counter for fault in GS present" UBYTE _CNV_A_R_LINEAR_____1_CM 1 100. 0. 255. DISPLAY_IDENTIFIER ABC_GS_INH_MON ECU_ADDRESS 0x3fe608 FORMAT "%3.0" /end MEASUREMENT
/begin CHARACTERISTIC c_int_tq_gs_inc_rest_mon "Minimum integrated GS intervention torque" VALUE 0x120e0 _REC_VAL_20_u2 204.7 _CNV_A_R_LINEAR_____102_CM 0. 204.7 DISPLAY_IDENTIFIER C_INT_TQ_GS_INC_REST_MON FORMAT "%7.3" /end CHARACTERISTIC
/begin CHARACTERISTIC c_t_dif_min_tq_gs_inc_mon "Min time limit threshold time delay" VALUE 0x11d88 _REC_VAL_20_u1 10.2 _CNV_A_R_LINEAR_____41_CM 0. 10.2 DISPLAY_IDENTIFIER C_T_DIF_MIN_TQ_GS_INC_MON FORMAT "%5.2" /end CHARACTERISTIC
/begin MEASUREMENT lv_err_tq_ext_mon_1 "Max torque at clutch monitoring error reflect to level 1" UBYTE _CNV_S_2_RANGE______5_CM 1 100. 0. 1. DISPLAY_IDENTIFIER LV_ERR_TQ_EXT_MON_1 ECU_ADDRESS 0x3fba14 BIT_MASK 0x1 /end MEASUREMENT
/begin CHARACTERISTIC c_vs_min_cru_mon "Minimum threshold for vehicle speed control active" VALUE 0x11daf _REC_VAL_20_u1 510. _CNV_A_R_LINEAR_____156_CM 0. 510. DISPLAY_IDENTIFIER C_VS_MIN_CRU_MON FORMAT "%3.0" /end CHARACTERISTIC
/begin CHARACTERISTIC c_t_cru_inh_mon "Delay time for disable of cruise control charge demand in monitoring level" VALUE 0x11d86 _REC_VAL_20_u1 10.2 _CNV_A_R_LINEAR_____41_CM 0. 10.2 DISPLAY_IDENTIFIER C_T_CRU_INH_MON FORMAT "%5.2" /end CHARACTERISTIC
/begin MEASUREMENT t_cru_inh_mon "Timer for inhibition of cruise control charge demand in monitoring level" UBYTE _CNV_A_R_LINEAR_____41_CM 1 100. 0. 10.2 DISPLAY_IDENTIFIER T_CRU_INH_MON ECU_ADDRESS 0x3fe645 FORMAT "%5.2" /end MEASUREMENT
/begin MEASUREMENT fac_tq_req_cru_mon "Charge demand from cruise control" UWORD _CNV_A_R_LINEAR_____21_CM 1 100. 0. 1.99996948 DISPLAY_IDENTIFIER FAC_TQ_REQ_CRU_MON ECU_ADDRESS 0x3fda44 BYTE_ORDER MSB_LAST FORMAT "%7.5" /end MEASUREMENT
/begin MEASUREMENT abc_cru_inh_mon "Anti bounce counter for fault in cruise conditions present" UBYTE _CNV_A_R_LINEAR_____1_CM 1 100. 0. 255. DISPLAY_IDENTIFIER ABC_CRU_INH_MON ECU_ADDRESS 0x3fe648 FORMAT "%3.0" /end MEASUREMENT
/begin MEASUREMENT lv_err_cru_inh_mon_1 "CRU monitoring error reflect to level 1" UBYTE _CNV_S_2_RANGE______5_CM 1 100. 0. 1. DISPLAY_IDENTIFIER LV_ERR_CRU_INH_MON_1 ECU_ADDRESS 0x3fba20 BIT_MASK 0x1 /end MEASUREMENT
/begin CHARACTERISTIC c_maf_sub_mmv_crlc_mon "Correlation constant for MAF_SUB_MON filter" VALUE 0x120e2 _REC_VAL_20_u2 0.99998474 _CNV_A_R_LINEAR_____37_CM 0. 0.99998474 DISPLAY_IDENTIFIER C_MAF_SUB_MMV_CRLC_MON FORMAT "%7.5" /end CHARACTERISTIC
/begin CHARACTERISTIC c_n_tps_min_diag_mon "Minimum engine speed for diagnosis of TPS ratio error" VALUE 0x11d81 _REC_VAL_20_u1 816. _CNV_A_R_LINEAR_____16_CM 0. 8160. DISPLAY_IDENTIFIER C_N_TPS_MIN_DIAG_MON FORMAT "%4.0" /end CHARACTERISTIC
/begin CHARACTERISTIC c_tps_slop_mon "nominal value of TPS slope" VALUE 0x11d9b _REC_VAL_20_u1 3.199 _CNV_A_R_LINEAR_____351_CM 0. 31.99 DISPLAY_IDENTIFIER C_TPS_SLOP_MON FORMAT "%4.1" /end CHARACTERISTIC
/begin CHARACTERISTIC c_v_tps_ad_el_bol_1_mon "Upper limit of V_TPS_AD_EL_BOL_1" VALUE 0x11daa _REC_VAL_20_u1 4.998 _CNV_A_R_LINEAR_____44_CM 0. 4.998 DISPLAY_IDENTIFIER C_V_TPS_AD_EL_BOL_1_MON FORMAT "%5.3" /end CHARACTERISTIC
/begin CHARACTERISTIC c_v_tps_ad_el_bol_2_mon "Lower limit of V_TPS_AD_EL_BOL_2" VALUE 0x11dab _REC_VAL_20_u1 4.998 _CNV_A_R_LINEAR_____44_CM 0. 4.998 DISPLAY_IDENTIFIER C_V_TPS_AD_EL_BOL_2_MON FORMAT "%5.3" /end CHARACTERISTIC
/begin CHARACTERISTIC c_v_tps_max_mon "Maximum nominal voltage of the TPS fully opened" VALUE 0x11dac _REC_VAL_20_u1 4.998 _CNV_A_R_LINEAR_____44_CM 0. 4.998 DISPLAY_IDENTIFIER C_V_TPS_MAX_MON FORMAT "%6.4" /end CHARACTERISTIC
/begin CHARACTERISTIC c_v_tps_ratio_hys_mon "Maximum TPS ratio error allowed" VALUE 0x11dad _REC_VAL_20_u1 4.998 _CNV_A_R_LINEAR_____44_CM 0. 4.998 DISPLAY_IDENTIFIER C_V_TPS_RATIO_HYS_MON FORMAT "%5.3" /end CHARACTERISTIC
/begin CHARACTERISTIC ip_fac_tps_isa_mon "calculation factor TPS -> ISAPWM" CURVE 0x11e31 _REC_CUR_20_u1_u1 106.24 _CNV_A_R_LINEAR_____352_CM 0. 106.24 DISPLAY_IDENTIFIER IP_FAC_TPS_ISA_MON FORMAT "%5.1"
 /begin AXIS_DESCR COM_AXIS tps_av_mon _CNV_A_R_LINEAR_____353_CM 6 0. 119.5 FORMAT "%5.1" AXIS_PTS_REF ldp_tps_av_mon__fac_tps_isa_mon /end AXIS_DESCR
/end CHARACTERISTIC
/begin CHARACTERISTIC ip_maf_max_isa_mon "max. MAF_KGH (ISA)" CURVE 0x1211c _REC_CUR_20_u2_u1 2047.96875 _CNV_A_R_LINEAR_____113_CM 0. 2047.96875 DISPLAY_IDENTIFIER IP_MAF_MAX_ISA_MON FORMAT "%7.2"
 /begin AXIS_DESCR COM_AXIS pq_turb_sys_mon _CNV_A_R_LINEAR_____354_CM 6 0. 0.996094 FORMAT "%5.3" AXIS_PTS_REF ldp_pq_turb_sys_mon__fac_pq_isa /end AXIS_DESCR
/end CHARACTERISTIC
/begin CHARACTERISTIC ip_fac_pq_isa_mon "correction factor intake manifold / turbulence pressure" CURVE 0x11e2d _REC_CUR_20_u1_u2 0.19921875 _CNV_A_R_LINEAR_____115_CM 0. 1.9921875 DISPLAY_IDENTIFIER IP_FAC_PQ_ISA_MON FORMAT "%5.3"
 /begin AXIS_DESCR COM_AXIS isapwm _CNV_A_R_LINEAR_____9_CM 4 0. 99.99847412 AXIS_PTS_REF ldp_isapwm__fac_pq_isa_mon /end AXIS_DESCR
/end CHARACTERISTIC
/begin CHARACTERISTIC c_n_min_maf_diag_mon "Minimum engine speed threshold for diagnosis of the MAF signal" VALUE 0x11d7e _REC_VAL_20_u1 816. _CNV_A_R_LINEAR_____16_CM 0. 8160. DISPLAY_IDENTIFIER C_N_MIN_MAF_DIAG_MON FORMAT "%4.0" /end CHARACTERISTIC
/begin CHARACTERISTIC ip_pq_mon "pressure ratio main collector" MAP 0x11f43 _REC_MAP_20_u1_u1_u1 0.9960940000000002 _CNV_A_R_LINEAR_____354_CM 0. 0.996094 DISPLAY_IDENTIFIER IP_PQ_MON FORMAT "%5.3"
 /begin AXIS_DESCR COM_AXIS n_32_mon _CNV_A_R_LINEAR_____16_CM 8 0. 8160. FORMAT "%4.0" AXIS_PTS_REF ldp_n_32_mon__pq_mon /end AXIS_DESCR
 /begin AXIS_DESCR COM_AXIS tps_sum_av_mon _CNV_A_R_LINEAR_____353_CM 8 0. 119.5 FORMAT "%5.1" AXIS_PTS_REF ldp_tps_sum_av_mon__pq_mon /end AXIS_DESCR
/end CHARACTERISTIC
/begin CHARACTERISTIC ip_fac_maf_sub_cor_mon "Correction factor for MAF_SUB_COR_MON calculation" MAP 0x11e09 _REC_MAP_20_u1_u1_u2 1.9921875 _CNV_A_R_LINEAR_____115_CM 0. 1.9921875 DISPLAY_IDENTIFIER IP_FAC_MAF_SUB_COR_MON FORMAT "%5.3"
 /begin AXIS_DESCR COM_AXIS tia _CNV_A_R_LINEAR_____12_CM 6 -48. 142.5 FORMAT "%5.1" AXIS_PTS_REF ldp_tia__fac_maf_sub_cor_mon /end AXIS_DESCR
 /begin AXIS_DESCR COM_AXIS amp _CNV_A_R_LINEAR_____49_CM 6 0. 5434. FORMAT "%7.2" AXIS_PTS_REF ldp_amp__fac_maf_sub_cor_mon /end AXIS_DESCR
/end CHARACTERISTIC
/begin CHARACTERISTIC ip_maf_sub_mon "MAF substitute" MAP 0x11efc _REC_MAP_20_u1_u1_u1 138.9 _CNV_A_R_LINEAR_____27_CM 0. 1389. DISPLAY_IDENTIFIER IP_MAF_SUB_MON FORMAT "%4.0"
 /begin AXIS_DESCR COM_AXIS n_32_mon _CNV_A_R_LINEAR_____16_CM 8 0. 8160. FORMAT "%4.0" AXIS_PTS_REF ldp_n_32_mon__maf_sub_mon /end AXIS_DESCR
 /begin AXIS_DESCR COM_AXIS tps_av_mon _CNV_A_R_LINEAR_____353_CM 8 0. 119.5 FORMAT "%5.1" AXIS_PTS_REF ldp_tps_av_mon__maf_sub_mon /end AXIS_DESCR
/end CHARACTERISTIC
/begin CHARACTERISTIC ip_maf_sub_thd_mon "Threshold for MAF_MON error detection" CURVE 0x11f3c _REC_CUR_20_u1_u1 138.9 _CNV_A_R_LINEAR_____27_CM 0. 1389. DISPLAY_IDENTIFIER IP_MAF_SUB_THD_MON FORMAT "%4.0"
 /begin AXIS_DESCR COM_AXIS maf_sub_1 _CNV_A_R_LINEAR_____27_CM 2 0. 1389. FORMAT "%4.0" AXIS_PTS_REF ldp_maf_sub__maf_sub_thd_mon /end AXIS_DESCR
/end CHARACTERISTIC
/begin AXIS_PTS ldp_n_32_mon__maf_sub_mon "" 0x12038 n_32_mon _REC_AXS_20_u1 8160. _CNV_A_R_LINEAR_____16_CM 8 0. 8160. DISPLAY_IDENTIFIER LDP_N_32_MON__MAF_SUB_MON FORMAT "%4.0" /end AXIS_PTS
/begin AXIS_PTS ldp_pq_turb_sys_mon__fac_pq_isa "" 0x12074 pq_turb_sys_mon _REC_AXS_20_u1 0.9960940000000002 _CNV_A_R_LINEAR_____354_CM 6 0. 0.996094 DISPLAY_IDENTIFIER LDP_PQ_TURB_SYS_MON__FAC_PQ_ISA FORMAT "%5.3" /end AXIS_PTS
/begin AXIS_PTS ldp_tps_av_mon__fac_tps_isa_mon "" 0x120b0 tps_av_mon _REC_AXS_20_u1 11.95 _CNV_A_R_LINEAR_____353_CM 6 0. 119.5 DISPLAY_IDENTIFIER LDP_TPS_AV_MON__FAC_TPS_ISA_MON FORMAT "%5.1" /end AXIS_PTS
/begin AXIS_PTS ldp_tps_av_mon__maf_sub_mon "" 0x120b7 tps_av_mon _REC_AXS_20_u1 11.95 _CNV_A_R_LINEAR_____353_CM 8 0. 119.5 DISPLAY_IDENTIFIER LDP_TPS_AV_MON__MAF_SUB_MON FORMAT "%5.1" /end AXIS_PTS
/begin AXIS_PTS ldp_amp__fac_maf_sub_cor_mon "" 0x121ea amp _REC_AXS_20_u2 5434. _CNV_A_R_LINEAR_____49_CM 6 0. 5434. DISPLAY_IDENTIFIER LDP_AMP__FAC_MAF_SUB_COR_MON FORMAT "%7.2" /end AXIS_PTS
/begin AXIS_PTS ldp_n_32_mon__pq_mon "" 0x12041 n_32_mon _REC_AXS_20_u1 816. _CNV_A_R_LINEAR_____16_CM 8 0. 8160. DISPLAY_IDENTIFIER LDP_N_32_MON__PQ_MON FORMAT "%4.0" /end AXIS_PTS
/begin AXIS_PTS ldp_tps_sum_av_mon__pq_mon "" 0x120c0 tps_sum_av_mon _REC_AXS_20_u1 119.5 _CNV_A_R_LINEAR_____353_CM 8 0. 119.5 DISPLAY_IDENTIFIER LDP_TPS_SUM_AV_MON__PQ_MON FORMAT "%5.1" /end AXIS_PTS
/begin AXIS_PTS ldp_tia__fac_maf_sub_cor_mon "Correction factor for MAF_SUB_COR_MON calculation" 0x120a9 tia _REC_AXS_20_u1 190.5 _CNV_A_R_LINEAR_____12_CM 6 -48. 142.5 DISPLAY_IDENTIFIER LDP_TIA__FAC_MAF_SUB_COR_MON FORMAT "%5.1" /end AXIS_PTS
/begin AXIS_PTS ldp_isapwm__fac_pq_isa_mon "" 0x12204 isapwm _REC_AXS_20_u2 14.999771118 _CNV_A_R_LINEAR_____9_CM 4 0. 99.99847412 DISPLAY_IDENTIFIER LDP_ISAPWM__FAC_PQ_ISA_MON /end AXIS_PTS
/begin MEASUREMENT abc_maf_mon "Anti bounce counter MAF signal" UBYTE _CNV_A_R_LINEAR_____1_CM 1 100. 0. 255. DISPLAY_IDENTIFIER ABC_MAF_MON ECU_ADDRESS 0x3fe665 FORMAT "%3.0" /end MEASUREMENT
/begin MEASUREMENT abc_tps_ratio_mon "Anti bounce counter TPS ratio error" UBYTE _CNV_A_R_LINEAR_____1_CM 1 100. 0. 255. DISPLAY_IDENTIFIER ABC_TPS_RATIO_MON ECU_ADDRESS 0x3fe663 FORMAT "%3.0" /end MEASUREMENT
/begin MEASUREMENT maf_mon "Mass air flow signal used monitoring level" UBYTE _CNV_A_R_LINEAR_____27_CM 1 100. 0. 1389. DISPLAY_IDENTIFIER MAF_MON ECU_ADDRESS 0x3fe655 FORMAT "%4.0" /end MEASUREMENT
/begin MEASUREMENT maf_sub_mon "MAF substitute" UBYTE _CNV_A_R_LINEAR_____27_CM 1 100. 0. 1389. DISPLAY_IDENTIFIER MAF_SUB_MON ECU_ADDRESS 0x3fe65e FORMAT "%4.0" /end MEASUREMENT
/begin MEASUREMENT pq_turb_sys_mon "ISA pressure quotient" UBYTE _CNV_A_R_LINEAR_____354_CM 1 100. 0. 0.996094 DISPLAY_IDENTIFIER PQ_TURB_SYS_MON ECU_ADDRESS 0x3fe661 FORMAT "%5.3" /end MEASUREMENT
/begin MEASUREMENT tps_av_mon "TPS actual value" UBYTE _CNV_A_R_LINEAR_____353_CM 1 100. 0. 119.5 DISPLAY_IDENTIFIER TPS_AV_MON ECU_ADDRESS 0x3fe657 FORMAT "%5.1" /end MEASUREMENT
/begin MEASUREMENT tps_sum_av_mon "total throttle angel actual value" UBYTE _CNV_A_R_LINEAR_____353_CM 1 100. 0. 119.5 DISPLAY_IDENTIFIER TPS_SUM_AV_MON ECU_ADDRESS 0x3fe65a FORMAT "%5.1" /end MEASUREMENT
/begin MEASUREMENT v_tps_1_mon "Adapted TPS signal channel 1" UBYTE _CNV_A_R_LINEAR_____44_CM 1 100. 0. 4.998 DISPLAY_IDENTIFIER V_TPS_1_MON ECU_ADDRESS 0x3fe65c FORMAT "%5.3" /end MEASUREMENT
/begin MEASUREMENT v_tps_2_mon "Adapted TPS signal channel 2" UBYTE _CNV_A_R_LINEAR_____44_CM 1 100. 0. 4.998 DISPLAY_IDENTIFIER V_TPS_2_MON ECU_ADDRESS 0x3fe65d FORMAT "%5.3" /end MEASUREMENT
/begin MEASUREMENT maf_sub_cor_mmv_mon "Low pass filtered MAF_SUB_COR_MON" UBYTE _CNV_A_R_LINEAR_____27_CM 1 100. 0. 1389. DISPLAY_IDENTIFIER MAF_SUB_COR_MMV_MON ECU_ADDRESS 0x3fe656 FORMAT "%4.0" /end MEASUREMENT
/begin MEASUREMENT maf_sub_tps_mon "MAF substitute (TPS)" UBYTE _CNV_A_R_LINEAR_____27_CM 1 100. 0. 1389. DISPLAY_IDENTIFIER MAF_SUB_TPS_MON ECU_ADDRESS 0x3fe660 FORMAT "%4.0" /end MEASUREMENT
/begin MEASUREMENT maf_sub_isa_mon "MAF substitute (ISA)" UBYTE _CNV_A_R_LINEAR_____27_CM 1 100. 0. 1389. DISPLAY_IDENTIFIER MAF_SUB_ISA_MON ECU_ADDRESS 0x3fe65f FORMAT "%4.0" /end MEASUREMENT
/begin MEASUREMENT lv_err_maf_tps_mon_1 "MAF / TPS monitoring error reflect to level 1" UBYTE _CNV_S_2_RANGE______5_CM 1 100. 0. 1. DISPLAY_IDENTIFIER LV_ERR_MAF_TPS_MON_1 ECU_ADDRESS 0x3fba08 BIT_MASK 0x1 /end MEASUREMENT
/begin CHARACTERISTIC c_n_max_mtc_lih_thd_mon "Speed threshold for the detection of a fault in the engine speed limitation" VALUE 0x11d7d _REC_VAL_20_u1 8160. _CNV_A_R_LINEAR_____16_CM 0. 8160. DISPLAY_IDENTIFIER C_N_MAX_MTC_LIH_THD_MON FORMAT "%4.0" /end CHARACTERISTIC
/begin MEASUREMENT lv_err_tqi_n_max_mon "Fault currently present in engine speed limitation" UBYTE _CNV_S_2_RANGE______5_CM 1 100. 0. 1. DISPLAY_IDENTIFIER LV_ERR_TQI_N_MAX_MON ECU_ADDRESS 0x3fe67d BIT_MASK 0x1 /end MEASUREMENT
/begin MEASUREMENT abc_tqi_n_max_mon "Anti-bounce-counter for fault in engine speed limitation" UBYTE _CNV_A_R_LINEAR_____1_CM 1 100. 0. 255. DISPLAY_IDENTIFIER ABC_TQI_N_MAX_MON ECU_ADDRESS 0x3fe67e FORMAT "%3.0" /end MEASUREMENT
/begin MEASUREMENT lv_err_tqi_n_max_mon_1 "Torque limitation monitoring error reflect to level 1" UBYTE _CNV_S_2_RANGE______5_CM 1 100. 0. 1. DISPLAY_IDENTIFIER LV_ERR_TQI_N_MAX_MON_1 ECU_ADDRESS 0x3fba1c BIT_MASK 0x1 /end MEASUREMENT
/begin CHARACTERISTIC c_n_32_dif_rel_max_mon "Max. relative difference between N_32 and N_32_SUB_MON" VALUE 0x120e4 _REC_VAL_20_u2 255. _CNV_A_R_LINEAR_____379_CM 0. 255. DISPLAY_IDENTIFIER C_N_32_DIF_REL_MAX_MON FORMAT "%8.4" /end CHARACTERISTIC
/begin MEASUREMENT n_32_mon "Engine speed (monitoring level)" UBYTE _CNV_A_R_LINEAR_____16_CM 1 100. 0. 8160. DISPLAY_IDENTIFIER N_32_MON ECU_ADDRESS 0x3fe681 FORMAT "%4.0" /end MEASUREMENT
/begin MEASUREMENT n_32_sub_mon "Engine speed substitute monitoring level" UBYTE _CNV_A_R_LINEAR_____16_CM 1 100. 0. 8160. DISPLAY_IDENTIFIER N_32_SUB_MON ECU_ADDRESS 0x3fe682 FORMAT "%4.0" /end MEASUREMENT
/begin MEASUREMENT abc_n_32_mon "Anti bounce counter N_32_RATIO error" UBYTE _CNV_A_R_LINEAR_____1_CM 1 100. 0. 255. DISPLAY_IDENTIFIER ABC_N_32_MON ECU_ADDRESS 0x3fe685 FORMAT "%3.0" /end MEASUREMENT
/begin MEASUREMENT lv_err_n_32_mon_1 "Engine speed monitoring error reflect to level 1" UBYTE _CNV_S_2_RANGE______5_CM 1 100. 0. 1. DISPLAY_IDENTIFIER LV_ERR_N_32_MON_1 ECU_ADDRESS 0x3fba00 BIT_MASK 0x1 /end MEASUREMENT
/begin CHARACTERISTIC c_n_32_min_mon "Lower limit for using the relative error concept" VALUE 0x11d78 _REC_VAL_20_u1 8160. _CNV_A_R_LINEAR_____16_CM 0. 8160. DISPLAY_IDENTIFIER C_N_32_MIN_MON FORMAT "%4.0" /end CHARACTERISTIC
/begin CHARACTERISTIC c_n_32_lim_mon "Lower limit of denominator for relative error calculation" VALUE 0x11d77 _REC_VAL_20_u1 8128. _CNV_A_R_LINEAR_____16_CM 32. 8160. DISPLAY_IDENTIFIER C_N_32_LIM_MON FORMAT "%4.0" /end CHARACTERISTIC
/begin MEASUREMENT n_32_dif_rel_mon "Relative engine speed deviation monitoring level" UWORD _CNV_A_R_LINEAR_____379_CM 1 100. 0. 255. DISPLAY_IDENTIFIER N_32_DIF_REL_MON ECU_ADDRESS 0x3fda68 BYTE_ORDER MSB_LAST FORMAT "%8.4" /end MEASUREMENT
/begin MEASUREMENT t_seg_sw_mon "Segment time determind by the mean of a software timer" ULONG _CNV_A_R_LINEAR_____380_CM 1 100. 0. 4294967295. DISPLAY_IDENTIFIER T_SEG_SW_MON ECU_ADDRESS 0x3fcd28 BYTE_ORDER MSB_LAST FORMAT "%10.0" /end MEASUREMENT
/begin MEASUREMENT lv_err_pvs_mon_1 "PVS monitoring error reflect to level 1" UBYTE _CNV_S_2_RANGE______5_CM 1 100. 0. 1. DISPLAY_IDENTIFIER LV_ERR_PVS_MON_1 ECU_ADDRESS 0x3fba04 BIT_MASK 0x1 /end MEASUREMENT
/begin CHARACTERISTIC ip_eff_iga_mon "Basic ignition efficiency (process monitoring)" CURVE 0x11e01 _REC_CUR_20_u1_u1 1.9921875 _CNV_A_R_LINEAR_____115_CM 0. 1.9921875 DISPLAY_IDENTIFIER IP_EFF_IGA_MON FORMAT "%5.3"
 /begin AXIS_DESCR COM_AXIS iga_dif_av _CNV_A_R_LINEAR_____204_CM 8 0. -95.625 FORMAT "%6.2" AXIS_PTS_REF ldp_iga_dif_av_mon__eff_iga_mon /end AXIS_DESCR
/end CHARACTERISTIC
/begin CHARACTERISTIC ip_iga_ref_mon "Reference ignition angle (process monitoring)" MAP 0x11ebc _REC_MAP_20_u1_u1_u1 95.625 _CNV_A_R_LINEAR_____203_CM -35.625 60. DISPLAY_IDENTIFIER IP_IGA_REF_MON FORMAT "%5.1"
 /begin AXIS_DESCR COM_AXIS n_32_mon _CNV_A_R_LINEAR_____16_CM 8 0. 8160. FORMAT "%4.0" AXIS_PTS_REF ldp_n_32_mon__iga_ref_mon /end AXIS_DESCR
 /begin AXIS_DESCR COM_AXIS maf_mon _CNV_A_R_LINEAR_____27_CM 8 0. 1389. FORMAT "%4.0" AXIS_PTS_REF ldp_maf_mon__iga_ref_mon /end AXIS_DESCR
/end CHARACTERISTIC
/begin CHARACTERISTIC ip_tqi_ref_mon "Indicated engine torque at reference conditions (process monitoring)" MAP 0x11fa7 _REC_MAP_20_u1_u1_u1 510. _CNV_A_R_LINEAR_____101_CM 0. 510. DISPLAY_IDENTIFIER IP_TQI_REF_MON FORMAT "%3.0"
 /begin AXIS_DESCR COM_AXIS n_32_mon _CNV_A_R_LINEAR_____16_CM 6 0. 8160. FORMAT "%4.0" AXIS_PTS_REF ldp_n_32_mon__tqi_ref_mon /end AXIS_DESCR
 /begin AXIS_DESCR COM_AXIS maf_mon _CNV_A_R_LINEAR_____27_CM 8 0. 1389. FORMAT "%4.0" AXIS_PTS_REF ldp_maf_mon__tqi_ref_mon /end AXIS_DESCR
/end CHARACTERISTIC
/begin CHARACTERISTIC c_iga_ref_egr_cor_lim_mon "maximum permitted ignition angle correction for EGR active" VALUE 0x11d38 _REC_VAL_20_s1 95.625 _CNV_A_R_LINEAR_____82_CM -48. 47.625 DISPLAY_IDENTIFIER C_IGA_REF_EGR_COR_LIM_MON FORMAT "%5.1" /end CHARACTERISTIC
/begin AXIS_PTS ldp_n_32_mon__tqi_ref_mon "" 0x1205c n_32_mon _REC_AXS_20_u1 8160. _CNV_A_R_LINEAR_____16_CM 6 0. 8160. DISPLAY_IDENTIFIER LDP_N_32_MON__TQI_REF_MON FORMAT "%4.0" /end AXIS_PTS
/begin AXIS_PTS ldp_maf_mon__tqi_ref_mon "" 0x1200e maf_mon _REC_AXS_20_u1 1389. _CNV_A_R_LINEAR_____27_CM 8 0. 1389. DISPLAY_IDENTIFIER LDP_MAF_MON__TQI_REF_MON FORMAT "%4.0" /end AXIS_PTS
/begin AXIS_PTS ldp_n_32_mon__iga_ref_mon "" 0x1202f n_32_mon _REC_AXS_20_u1 8160. _CNV_A_R_LINEAR_____16_CM 8 0. 8160. DISPLAY_IDENTIFIER LDP_N_32_MON__IGA_REF_MON FORMAT "%4.0" /end AXIS_PTS
/begin AXIS_PTS ldp_maf_mon__iga_ref_mon "" 0x11fff maf_mon _REC_AXS_20_u1 1389. _CNV_A_R_LINEAR_____27_CM 8 0. 1389. DISPLAY_IDENTIFIER LDP_MAF_MON__IGA_REF_MON FORMAT "%4.0" /end AXIS_PTS
/begin AXIS_PTS ldp_iga_dif_av_mon__eff_iga_mon "" 0x11ff6 iga_dif_av _REC_AXS_20_u1 -95.625 _CNV_A_R_LINEAR_____204_CM 8 0. -95.625 DISPLAY_IDENTIFIER LDP_IGA_DIF_AV_MON__EFF_IGA_MON FORMAT "%6.2" /end AXIS_PTS
/begin MEASUREMENT tqi_av_mon "Actual indicated engine torque (process monitoring)" UBYTE _CNV_A_R_LINEAR_____101_CM 1 100. 0. 510. DISPLAY_IDENTIFIER TQI_AV_MON ECU_ADDRESS 0x3fe6ab FORMAT "%3.0" /end MEASUREMENT
/begin MEASUREMENT eff_iga_av_mon "actual ignition efficiency for torque monitoring" UBYTE _CNV_A_R_LINEAR_____115_CM 1 100. 0. 1.9921875 DISPLAY_IDENTIFIER EFF_IGA_AV_MON ECU_ADDRESS 0x3fe6ad FORMAT "%5.3" /end MEASUREMENT
/begin MEASUREMENT iga_ref_cor_mon "reference ignition angle for torque monitoring (corrected by EGR influence)" UBYTE _CNV_A_R_LINEAR_____203_CM 1 100. -35.625 60. DISPLAY_IDENTIFIER IGA_REF_COR_MON ECU_ADDRESS 0x3fe6b1 FORMAT "%5.1" /end MEASUREMENT
/begin MEASUREMENT eff_scc_av_1_mon "actual ignition efficiency for torque monitoring" UBYTE _CNV_A_R_LINEAR_____115_CM 1 100. 0. 1.9921875 DISPLAY_IDENTIFIER EFF_SCC_AV_1_MON ECU_ADDRESS 0x3fe6ae FORMAT "%5.3" /end MEASUREMENT
/begin MEASUREMENT eff_scc_av_2_mon "actual ignition efficiency for torque monitoring" UBYTE _CNV_A_R_LINEAR_____115_CM 1 100. 0. 1.9921875 DISPLAY_IDENTIFIER EFF_SCC_AV_2_MON ECU_ADDRESS 0x3fe6af FORMAT "%5.3" /end MEASUREMENT
/begin MEASUREMENT eff_scc_av_mon "actual ignition efficiency for torque monitoring" UBYTE _CNV_A_R_LINEAR_____115_CM 1 100. 0. 1.9921875 DISPLAY_IDENTIFIER EFF_SCC_AV_MON ECU_ADDRESS 0x3fe6b0 FORMAT "%5.3" /end MEASUREMENT
/begin CHARACTERISTIC ip_tqi_dif_max_mon "Threshold for diagnosis of engine torque overflow" MAP 0x11f97 _REC_MAP_20_u1_u1_u1 510. _CNV_A_R_LINEAR_____101_CM 0. 510. DISPLAY_IDENTIFIER IP_TQI_DIF_MAX_MON FORMAT "%3.0"
 /begin AXIS_DESCR COM_AXIS n_32_mon _CNV_A_R_LINEAR_____16_CM 4 0. 8160. FORMAT "%4.0" AXIS_PTS_REF ldp_n_32_mon__tqi_dif_max_mon /end AXIS_DESCR
 /begin AXIS_DESCR COM_AXIS tqi_sp_mon _CNV_A_R_LINEAR_____101_CM 4 0. 510. FORMAT "%3.0" AXIS_PTS_REF ldp_tqi_sp_mon__tqi_dif_max_mon /end AXIS_DESCR
/end CHARACTERISTIC
/begin AXIS_PTS ldp_tqi_sp_mon__tqi_dif_max_mon "" 0x120ce tqi_sp_mon _REC_AXS_20_u1 510. _CNV_A_R_LINEAR_____101_CM 4 0. 510. DISPLAY_IDENTIFIER LDP_TQI_SP_MON__TQI_DIF_MAX_MON FORMAT "%3.0" /end AXIS_PTS
/begin AXIS_PTS ldp_n_32_mon__tqi_dif_max_mon "" 0x12057 n_32_mon _REC_AXS_20_u1 8160. _CNV_A_R_LINEAR_____16_CM 4 0. 8160. DISPLAY_IDENTIFIER LDP_N_32_MON__TQI_DIF_MAX_MON FORMAT "%4.0" /end AXIS_PTS
/begin MEASUREMENT tqi_dif_max_mon "Permitted deviation between actual and desired indicated engine torque" UBYTE _CNV_A_R_LINEAR_____101_CM 1 100. 0. 510. DISPLAY_IDENTIFIER TQI_DIF_MAX_MON ECU_ADDRESS 0x3fe6b6 FORMAT "%3.0" /end MEASUREMENT
/begin MEASUREMENT tqi_dif_mon "Deviation between actual and desired indicated engine torque" UBYTE _CNV_A_R_LINEAR_____101_CM 1 100. 0. 510. DISPLAY_IDENTIFIER TQI_DIF_MON ECU_ADDRESS 0x3fe6b5 FORMAT "%3.0" /end MEASUREMENT
/begin MEASUREMENT abc_tqi_av_mon "Anti-bounce-counter for fault in torque generation" UBYTE _CNV_A_R_LINEAR_____1_CM 1 100. 0. 255. DISPLAY_IDENTIFIER ABC_TQI_AV_MON ECU_ADDRESS 0x3fe6b3 FORMAT "%3.0" /end MEASUREMENT
/begin MEASUREMENT lv_err_tqi_av_mon_1 "Actual indicated engine torque monitoring error reflect to level 1" UBYTE _CNV_S_2_RANGE______5_CM 1 100. 0. 1. DISPLAY_IDENTIFIER LV_ERR_TQI_AV_MON_1 ECU_ADDRESS 0x3fba18 BIT_MASK 0x1 /end MEASUREMENT
/begin MEASUREMENT tqi_dif_max_ofs_mon "Permitted deviation offset" UBYTE _CNV_A_R_LINEAR_____95_CM 1 100. 0. 255. DISPLAY_IDENTIFIER TQI_DIF_MAX_OFS_MON ECU_ADDRESS 0x3fe6b7 FORMAT "%3.0" /end MEASUREMENT
/begin CHARACTERISTIC c_dec_tqi_dif_max_mon "Decrement after start condition" VALUE 0x11d73 _REC_VAL_20_u1 254. _CNV_A_R_LINEAR_____95_CM 1. 255. DISPLAY_IDENTIFIER C_DEC_TQI_DIF_MAX_MON FORMAT "%3.0" /end CHARACTERISTIC
/begin CHARACTERISTIC c_tqi_dif_max_ofs_mon "Offset after start condition" VALUE 0x11da3 _REC_VAL_20_u1 255. _CNV_A_R_LINEAR_____95_CM 0. 255. DISPLAY_IDENTIFIER C_TQI_DIF_MAX_OFS_MON FORMAT "%3.0" /end CHARACTERISTIC
/begin MEASUREMENT lv_err_tq_dif_isc_mon_1 "ISC monitoring error reflect to level 1" UBYTE _CNV_S_2_RANGE______5_CM 1 100. 0. 1. DISPLAY_IDENTIFIER LV_ERR_TQ_DIF_ISC_MON_1 ECU_ADDRESS 0x3fba0c BIT_MASK 0x1 /end MEASUREMENT
/begin CHARACTERISTIC ip_tq_max_clu_max_mon "maximum value for maximum torque at clutch" CURVE 0x11f8d _REC_CUR_20_u1_u1 510. _CNV_A_R_LINEAR_____101_CM 0. 510. DISPLAY_IDENTIFIER IP_TQ_MAX_CLU_MAX_MON FORMAT "%3.0"
 /begin AXIS_DESCR COM_AXIS n_32_mon _CNV_A_R_LINEAR_____16_CM 6 0. 8160. FORMAT "%4.0" AXIS_PTS_REF ldp_n_32_mon__tq_max_clu_max_mon /end AXIS_DESCR
/end CHARACTERISTIC
/begin AXIS_PTS ldp_n_32_mon__tq_max_clu_max_mon "" 0x12050 n_32_mon _REC_AXS_20_u1 8160. _CNV_A_R_LINEAR_____16_CM 6 0. 8160. DISPLAY_IDENTIFIER LDP_N_32_MON__TQ_MAX_CLU_MAX_MON FORMAT "%4.0" /end AXIS_PTS
/begin MEASUREMENT lv_err_tq_max_clu_mon "Fault currently present in torque generation, symptom 'maximum torque at clutch'" UBYTE _CNV_S_2_RANGE______5_CM 1 100. 0. 1. DISPLAY_IDENTIFIER LV_ERR_TQ_MAX_CLU_MON ECU_ADDRESS 0x3fe6d4 BIT_MASK 0x1 /end MEASUREMENT
/begin MEASUREMENT tq_max_clu_mon "monitored maximum torque at clutch" SWORD _CNV_A_R_LINEAR_____55_CM 1 100. -1024. 1023.96875 DISPLAY_IDENTIFIER TQ_MAX_CLU_MON ECU_ADDRESS 0x3fda8a BYTE_ORDER MSB_LAST FORMAT "%8.2" /end MEASUREMENT
/begin MEASUREMENT tq_max_clu_dif_mon "difference of monitored and modelled maximum torque at clutch" SBYTE _CNV_A_R_LINEAR_____101_CM 1 100. -256. 254. DISPLAY_IDENTIFIER TQ_MAX_CLU_DIF_MON ECU_ADDRESS 0x3fe6d5 FORMAT "%3.0" /end MEASUREMENT
/begin MEASUREMENT abc_tq_max_clu_mon "Anti bounce counter for monitoring of maximum torque at clutch" UBYTE _CNV_A_R_LINEAR_____1_CM 1 100. 0. 255. DISPLAY_IDENTIFIER ABC_TQ_MAX_CLU_MON ECU_ADDRESS 0x3fe6d6 FORMAT "%3.0" /end MEASUREMENT
/begin MEASUREMENT lv_err_tq_req_mon_1 "Min torque at clutch monitoring error reflect to level 1" UBYTE _CNV_S_2_RANGE______5_CM 1 100. 0. 1. DISPLAY_IDENTIFIER LV_ERR_TQ_REQ_MON_1 ECU_ADDRESS 0x3fba10 BIT_MASK 0x1 /end MEASUREMENT
/begin CHARACTERISTIC c_n_st_max_mon "maximum start end speed" VALUE 0x11d80 _REC_VAL_20_u1 8160. _CNV_A_R_LINEAR_____16_CM 0. 8160. DISPLAY_IDENTIFIER C_N_ST_MAX_MON FORMAT "%4.0" /end CHARACTERISTIC
/begin MEASUREMENT lv_err_tq_min_clu_mon "Fault currently present in torque generation, symptom 'minimum torque at clutch'" UBYTE _CNV_S_2_RANGE______5_CM 1 100. 0. 1. DISPLAY_IDENTIFIER LV_ERR_TQ_MIN_CLU_MON ECU_ADDRESS 0x3fe6d9 BIT_MASK 0x1 /end MEASUREMENT
/begin MEASUREMENT tq_min_clu_mon "monitored minimum torque at clutch" SWORD _CNV_A_R_LINEAR_____55_CM 1 100. -1024. 1023.96875 DISPLAY_IDENTIFIER TQ_MIN_CLU_MON ECU_ADDRESS 0x3fda8e BYTE_ORDER MSB_LAST FORMAT "%8.2" /end MEASUREMENT
/begin MEASUREMENT abc_tq_min_clu_mon "Anti bounce counter for monitoring of minimum torque at clutch" UBYTE _CNV_A_R_LINEAR_____1_CM 1 100. 0. 255. DISPLAY_IDENTIFIER ABC_TQ_MIN_CLU_MON ECU_ADDRESS 0x3fe6db FORMAT "%3.0" /end MEASUREMENT
/begin MEASUREMENT tq_min_clu_dif_mon "difference of monitored and modelled minimum torque at clutch" SWORD _CNV_A_R_LINEAR_____55_CM 1 100. -1024. 1023.96875 DISPLAY_IDENTIFIER TQ_MIN_CLU_DIF_MON ECU_ADDRESS 0x3fda90 BYTE_ORDER MSB_LAST FORMAT "%8.2" /end MEASUREMENT
/begin MEASUREMENT tq_min_clu_mdl_1_mon "Temporary variable for calculation of modelled minimum torque at clutch" SWORD _CNV_A_R_LINEAR_____55_CM 1 100. -1024. 1023.96875 DISPLAY_IDENTIFIER TQ_MIN_CLU_MDL_1_MON ECU_ADDRESS 0x3fda94 BYTE_ORDER MSB_LAST FORMAT "%8.2" /end MEASUREMENT
/begin MEASUREMENT tq_min_clu_mdl_2_mon "Temporary variable for calculation of modelled minimum torque at clutch" SWORD _CNV_A_R_LINEAR_____55_CM 1 100. -1024. 1023.96875 DISPLAY_IDENTIFIER TQ_MIN_CLU_MDL_2_MON ECU_ADDRESS 0x3fda96 BYTE_ORDER MSB_LAST FORMAT "%8.2" /end MEASUREMENT
/begin MEASUREMENT tq_min_clu_mdl_mon "modelled value of mimimum torque at clutch" SWORD _CNV_A_R_LINEAR_____55_CM 1 100. -1024. 1023.96875 DISPLAY_IDENTIFIER TQ_MIN_CLU_MDL_MON ECU_ADDRESS 0x3fda98 BYTE_ORDER MSB_LAST FORMAT "%8.2" /end MEASUREMENT
/begin MEASUREMENT tq_conv_max_mon "modelled vaue of maximum converter torque" UBYTE _CNV_A_R_LINEAR_____101_CM 1 100. 0. 510. DISPLAY_IDENTIFIER TQ_CONV_MAX_MON ECU_ADDRESS 0x3fe6da FORMAT "%3.0" /end MEASUREMENT
/begin MEASUREMENT tq_st_mon "modelled value of start torque" UWORD _CNV_A_R_LINEAR_____55_CM 1 100. 0. 1023.96875 DISPLAY_IDENTIFIER TQ_ST_MON ECU_ADDRESS 0x3fda9c BYTE_ORDER MSB_LAST FORMAT "%7.2" /end MEASUREMENT
/begin AXIS_PTS ldp_n_dif_mon_ip_tq_min_mon "" 0x1206f n_dif_sp_is_mon _REC_AXS_20_u1 8160. _CNV_A_R_LINEAR_____215_CM 4 -4096. 4064. DISPLAY_IDENTIFIER LDP_N_DIF_MON_IP_TQ_MIN_MON FORMAT "%5.0" /end AXIS_PTS
/begin AXIS_PTS ldp_n_32_mon_ip_tqi_min_pu_mon "" 0x12063 n_32_mon _REC_AXS_20_u1 8160. _CNV_A_R_LINEAR_____16_CM 6 0. 8160. DISPLAY_IDENTIFIER LDP_N_32_MON_IP_TQI_MIN_PU_MON FORMAT "%4.0" /end AXIS_PTS
/begin AXIS_PTS ldp_tco_mon_ip_fac_conv_mon "" 0x12091 tco_mon _REC_AXS_20_u1 190.5 _CNV_A_R_LINEAR_____12_CM 6 -48. 142.5 DISPLAY_IDENTIFIER LDP_TCO_MON_IP_FAC_CONV_MON FORMAT "%5.1" /end AXIS_PTS
/begin AXIS_PTS ldp_tco_mon_ip_tqi_min_pu_mon "" 0x120a4 tco_mon _REC_AXS_20_u1 190.5 _CNV_A_R_LINEAR_____12_CM 4 -48. 142.5 DISPLAY_IDENTIFIER LDP_TCO_MON_IP_TQI_MIN_PU_MON FORMAT "%5.1" /end AXIS_PTS
/begin CHARACTERISTIC ip_tq_min_clu_max_mon "maximum value for minimum torque at clutch" CURVE 0x11f93 _REC_CUR_20_u1_u1 510. _CNV_A_R_LINEAR_____101_CM 0. 510. DISPLAY_IDENTIFIER IP_TQ_MIN_CLU_MAX_MON FORMAT "%3.0"
 /begin AXIS_DESCR COM_AXIS n_dif_sp_is_mon _CNV_A_R_LINEAR_____215_CM 4 -4096. 4064. FORMAT "%5.0" AXIS_PTS_REF ldp_n_dif_mon_ip_tq_min_mon /end AXIS_DESCR
/end CHARACTERISTIC
/begin CHARACTERISTIC ip_fac_conv_mon "Converter torque characteristics" CURVE 0x12110 _REC_CUR_20_u2_u1 4.88e-004 _CNV_A_R_LINEAR_____459_CM 0. 4.88e-004 DISPLAY_IDENTIFIER IP_FAC_CONV_MON FORMAT "%10.9"
 /begin AXIS_DESCR COM_AXIS tco_mon _CNV_A_R_LINEAR_____12_CM 6 -48. 142.5 FORMAT "%5.1" AXIS_PTS_REF ldp_tco_mon_ip_fac_conv_mon /end AXIS_DESCR
/end CHARACTERISTIC
/begin CHARACTERISTIC ip_tqi_min_req_pu_mon "Minimum requested indicated torque in PU phase" MAP 0x121ba _REC_MAP_20_u2_u1_u1 1023.96875 _CNV_A_R_LINEAR_____55_CM 0. 1023.96875 DISPLAY_IDENTIFIER IP_TQI_MIN_REQ_PU_MON FORMAT "%7.2"
 /begin AXIS_DESCR COM_AXIS n_32_mon _CNV_A_R_LINEAR_____16_CM 6 0. 8160. FORMAT "%4.0" AXIS_PTS_REF ldp_n_32_mon_ip_tqi_min_pu_mon /end AXIS_DESCR
 /begin AXIS_DESCR COM_AXIS tco_mon _CNV_A_R_LINEAR_____12_CM 4 -48. 142.5 FORMAT "%5.1" AXIS_PTS_REF ldp_tco_mon_ip_tqi_min_pu_mon /end AXIS_DESCR
/end CHARACTERISTIC
/begin CHARACTERISTIC c_t_tqi_mon "Dead time for torque decrease" VALUE 0x11d97 _REC_VAL_20_u1 10.2 _CNV_A_R_LINEAR_____41_CM 0. 10.2 DISPLAY_IDENTIFIER C_T_TQI_MON FORMAT "%5.2" /end CHARACTERISTIC
/begin CHARACTERISTIC c_tqi_sp_dec_max_mon "Maximum negative gradient of desired indicated engine torque" VALUE 0x11da4 _REC_VAL_20_u1 31.875 _CNV_A_R_LINEAR_____479_CM 0. 31.875 DISPLAY_IDENTIFIER C_TQI_SP_DEC_MAX_MON FORMAT "%5.2" /end CHARACTERISTIC
/begin CHARACTERISTIC ip_fac_tq_req_driv_mon "Scaling factor for requested torque at clutch from driver" MAP 0x11e3c _REC_MAP_20_u1_u1_u1 1.9921875 _CNV_A_R_LINEAR_____115_CM 0. 1.9921875 DISPLAY_IDENTIFIER IP_FAC_TQ_REQ_DRIV_MON FORMAT "%5.3"
 /begin AXIS_DESCR COM_AXIS n_32_mon _CNV_A_R_LINEAR_____16_CM 8 0. 8160. FORMAT "%4.0" AXIS_PTS_REF ldp_n_32__fac_tq_req_driv_mon /end AXIS_DESCR
 /begin AXIS_DESCR COM_AXIS pv_av_mon _CNV_A_R_LINEAR_____10_CM 8 0. 99.609375 FORMAT "%5.2" AXIS_PTS_REF ldp_pv_av__fac_tq_req_driv_mon /end AXIS_DESCR
/end CHARACTERISTIC
/begin AXIS_PTS ldp_n_32__fac_tq_req_driv_mon "" 0x1201a n_32_mon _REC_AXS_20_u1 8160. _CNV_A_R_LINEAR_____16_CM 8 0. 8160. DISPLAY_IDENTIFIER LDP_N_32__FAC_TQ_REQ_DRIV_MON FORMAT "%4.0" /end AXIS_PTS
/begin AXIS_PTS ldp_pv_av__fac_tq_req_driv_mon "" 0x1207b pv_av_mon _REC_AXS_20_u1 99.609375 _CNV_A_R_LINEAR_____10_CM 8 0. 99.609375 DISPLAY_IDENTIFIER LDP_PV_AV__FAC_TQ_REQ_DRIV_MON FORMAT "%5.2" /end AXIS_PTS
/begin MEASUREMENT fac_tq_req_driv_mon "Scaling factor for requested torque at clutch from driver" UBYTE _CNV_A_R_LINEAR_____39_CM 1 100. 0. 1.99220002 DISPLAY_IDENTIFIER FAC_TQ_REQ_DRIV_MON ECU_ADDRESS 0x3fe6df FORMAT "%5.3" /end MEASUREMENT
/begin CHARACTERISTIC ip_fac_tq_req_driv_rng_l_mon "Scaling factor for requested torque at clutch from driver in low range mode" MAP 0x11e7c _REC_MAP_20_u1_u1_u1 1.9921875 _CNV_A_R_LINEAR_____115_CM 0. 1.9921875 DISPLAY_IDENTIFIER IP_FAC_TQ_REQ_DRIV_RNG_L_MON FORMAT "%5.3"
 /begin AXIS_DESCR COM_AXIS n_32_mon _CNV_A_R_LINEAR_____16_CM 8 0. 8160. FORMAT "%4.0" AXIS_PTS_REF ldp_n_32__fac_tq_req_driv_mon /end AXIS_DESCR
 /begin AXIS_DESCR COM_AXIS pv_av_mon _CNV_A_R_LINEAR_____10_CM 8 0. 99.609375 FORMAT "%5.2" AXIS_PTS_REF ldp_pv_av__fac_tq_req_driv_mon /end AXIS_DESCR
/end CHARACTERISTIC
/begin MEASUREMENT tqi_req_tot_mon "Desired non-delayed indicated engine torque" UBYTE _CNV_A_R_LINEAR_____101_CM 1 100. 0. 510. DISPLAY_IDENTIFIER TQI_REQ_TOT_MON ECU_ADDRESS 0x3fe6e3 FORMAT "%3.0" /end MEASUREMENT
/begin MEASUREMENT tqi_sp_mon "Desired indicated engine torque" UBYTE _CNV_A_R_LINEAR_____101_CM 1 100. 0. 510. DISPLAY_IDENTIFIER TQI_SP_MON ECU_ADDRESS 0x3fe6de FORMAT "%7.3" /end MEASUREMENT
/begin MEASUREMENT fac_tq_req_mon "Scaling factor for requested torque at clutch from driver" UBYTE _CNV_A_R_LINEAR_____39_CM 1 100. 0. 1.99220002 DISPLAY_IDENTIFIER FAC_TQ_REQ_MON ECU_ADDRESS 0x3fe6e2 FORMAT "%5.3" /end MEASUREMENT
/begin MEASUREMENT sf_1_mon2.bf.lv_tqi_mon_act_mon2_sf "" ULONG _CNV_S_2_RANGE______0_CM 1 100. 0. 1. DISPLAY_IDENTIFIER LV_TQI_MON_ACT_MON2 ECU_ADDRESS 0x3fcd30 BYTE_ORDER MSB_LAST BIT_MASK 0x10000 /end MEASUREMENT
/begin MEASUREMENT sf_1_mon2.bf.lv_n_lim_etc_mon2_sf "" ULONG _CNV_S_2_RANGE______0_CM 1 100. 0. 1. DISPLAY_IDENTIFIER LV_N_LIM_ETC_MON2 ECU_ADDRESS 0x3fcd30 BYTE_ORDER MSB_LAST BIT_MASK 0x20000 /end MEASUREMENT
/begin MEASUREMENT sf_1_mon2.bf.lv_err_conv_mon2_sf "" ULONG _CNV_S_2_RANGE______0_CM 1 100. 0. 1. DISPLAY_IDENTIFIER LV_ERR_CONV_MON2 ECU_ADDRESS 0x3fcd30 BYTE_ORDER MSB_LAST BIT_MASK 0x40000 /end MEASUREMENT
/begin MEASUREMENT sf_1_mon2.bf.lv_err_n_32_mon2_sf "" ULONG _CNV_S_2_RANGE______0_CM 1 100. 0. 1. DISPLAY_IDENTIFIER LV_ERR_N_32_MON2 ECU_ADDRESS 0x3fcd30 BYTE_ORDER MSB_LAST BIT_MASK 0x80000 /end MEASUREMENT
/begin MEASUREMENT sf_1_mon2.bf.lv_err_tq_dif_p_d_is_mon2_sf "" ULONG _CNV_S_2_RANGE______0_CM 1 100. 0. 1. DISPLAY_IDENTIFIER LV_ERR_TQ_DIF_P_D_IS_MON2 ECU_ADDRESS 0x3fcd30 BYTE_ORDER MSB_LAST BIT_MASK 0x100000 /end MEASUREMENT
/begin MEASUREMENT sf_1_mon2.bf.lv_err_tq_dif_i_is_mon2_sf "" ULONG _CNV_S_2_RANGE______0_CM 1 100. 0. 1. DISPLAY_IDENTIFIER LV_ERR_TQ_DIF_I_IS_MON2 ECU_ADDRESS 0x3fcd30 BYTE_ORDER MSB_LAST BIT_MASK 0x200000 /end MEASUREMENT
/begin MEASUREMENT sf_1_mon2.bf.lv_err_tq_loss_mon2_sf "" ULONG _CNV_S_2_RANGE______0_CM 1 100. 0. 1. DISPLAY_IDENTIFIER LV_ERR_TQ_LOSS_MON2 ECU_ADDRESS 0x3fcd30 BYTE_ORDER MSB_LAST BIT_MASK 0x400000 /end MEASUREMENT
/begin MEASUREMENT sf_1_mon2.bf.lv_err_tq_min_clu_mon2_sf "" ULONG _CNV_S_2_RANGE______0_CM 1 100. 0. 1. DISPLAY_IDENTIFIER LV_ERR_TQ_MIN_CLU_MON2 ECU_ADDRESS 0x3fcd30 BYTE_ORDER MSB_LAST BIT_MASK 0x800000 /end MEASUREMENT
/begin MEASUREMENT sf_1_mon2.bf.lv_err_tq_max_clu_mon2_sf "" ULONG _CNV_S_2_RANGE______0_CM 1 100. 0. 1. DISPLAY_IDENTIFIER LV_ERR_TQ_MAX_CLU_MON2 ECU_ADDRESS 0x3fcd30 BYTE_ORDER MSB_LAST BIT_MASK 0x1000000 /end MEASUREMENT
/begin MEASUREMENT sf_1_mon2.bf.lv_err_pvs_mon2_sf "" ULONG _CNV_S_2_RANGE______0_CM 1 100. 0. 1. DISPLAY_IDENTIFIER LV_ERR_PVS_MON2 ECU_ADDRESS 0x3fcd30 BYTE_ORDER MSB_LAST BIT_MASK 0x2000000 /end MEASUREMENT
/begin MEASUREMENT sf_1_mon2.bf.lv_err_tps_mon2_sf "" ULONG _CNV_S_2_RANGE______0_CM 1 100. 0. 1. DISPLAY_IDENTIFIER LV_ERR_TPS_MON2 ECU_ADDRESS 0x3fcd30 BYTE_ORDER MSB_LAST BIT_MASK 0x4000000 /end MEASUREMENT
/begin MEASUREMENT sf_1_mon2.bf.lv_err_maf_mon2_sf "" ULONG _CNV_S_2_RANGE______0_CM 1 100. 0. 1. DISPLAY_IDENTIFIER LV_ERR_MAF_MON2 ECU_ADDRESS 0x3fcd30 BYTE_ORDER MSB_LAST BIT_MASK 0x8000000 /end MEASUREMENT
/begin MEASUREMENT sf_1_mon2.word "" UWORD _CNV_A_R_LINEAR_____1_CM 1 100. 0. 65535. DISPLAY_IDENTIFIER SF_1_MON2 ECU_ADDRESS 0x3fcd30 BYTE_ORDER MSB_LAST FORMAT "%5.0" /end MEASUREMENT
/begin MEASUREMENT sf_2_mon2.bf.val_mo3_pwr_stag_dis_mc_mon2_sf "" ULONG _CNV_S_2_RANGE______0_CM 1 100. 0. 1. DISPLAY_IDENTIFIER LV_ERR_TMP_MU_MON2 ECU_ADDRESS 0x3fcd2c BYTE_ORDER MSB_LAST BIT_MASK 0x400000 /end MEASUREMENT
/begin MEASUREMENT sf_2_mon2.bf.lv_err_tran_ena_mon2_sf "" ULONG _CNV_S_2_RANGE______0_CM 1 100. 0. 1. DISPLAY_IDENTIFIER LV_ERR_TRAN_ENA_MON2 ECU_ADDRESS 0x3fcd2c BYTE_ORDER MSB_LAST BIT_MASK 0x800000 /end MEASUREMENT
/begin MEASUREMENT sf_2_mon2.bf.lv_n_lim_req_mon2_sf "" ULONG _CNV_S_2_RANGE______0_CM 1 100. 0. 1. DISPLAY_IDENTIFIER LV_N_LIM_REQ_MON2 ECU_ADDRESS 0x3fcd2c BYTE_ORDER MSB_LAST BIT_MASK 0x4000000 /end MEASUREMENT
/begin MEASUREMENT sf_2_mon2.bf.lv_off_mtc_iv_mu_mon2_sf "" ULONG _CNV_S_2_RANGE______0_CM 1 100. 0. 1. DISPLAY_IDENTIFIER LV_OFF_MTC_IV_MU_MON2 ECU_ADDRESS 0x3fcd2c BYTE_ORDER MSB_LAST BIT_MASK 0x8000000 /end MEASUREMENT
/begin MEASUREMENT sf_2_mon2.bf.lv_off_iv_mon2_sf "" ULONG _CNV_S_2_RANGE______0_CM 1 100. 0. 1. DISPLAY_IDENTIFIER LV_OFF_IV_MON2 ECU_ADDRESS 0x3fcd2c BYTE_ORDER MSB_LAST BIT_MASK 0x10000000 /end MEASUREMENT
/begin MEASUREMENT sf_2_mon2.bf.lv_off_mtc_mon2_sf "" ULONG _CNV_S_2_RANGE______0_CM 1 100. 0. 1. DISPLAY_IDENTIFIER LV_OFF_MTC_MON2 ECU_ADDRESS 0x3fcd2c BYTE_ORDER MSB_LAST BIT_MASK 0x20000000 /end MEASUREMENT
/begin MEASUREMENT sf_2_mon2.bf.lv_err_tqi_av_mon2_sf "" ULONG _CNV_S_2_RANGE______0_CM 1 100. 0. 1. DISPLAY_IDENTIFIER LV_ERR_TQI_AV_MON2 ECU_ADDRESS 0x3fcd2c BYTE_ORDER MSB_LAST BIT_MASK 0x40000000 /end MEASUREMENT
/begin MEASUREMENT sf_2_mon2.bf.lv_err_tqi_n_max_mon2_sf "" ULONG _CNV_S_2_RANGE______0_CM 1 100. 0. 1. DISPLAY_IDENTIFIER LV_ERR_TQI_N_MAX_MON2 ECU_ADDRESS 0x3fcd2c BYTE_ORDER MSB_LAST BIT_MASK 0x80000000 /end MEASUREMENT
/begin MEASUREMENT sf_2_mon2.word "" UWORD _CNV_A_R_LINEAR_____1_CM 1 100. 0. 65535. DISPLAY_IDENTIFIER SF_2_MON2 ECU_ADDRESS 0x3fcd2c BYTE_ORDER MSB_LAST FORMAT "%5.0" /end MEASUREMENT
/begin MEASUREMENT state_iv_mon2.bf.lv_prev_state_iv0_mon2_sf "" ULONG _CNV_S_2_RANGE______0_CM 1 100. 0. 1. DISPLAY_IDENTIFIER LV_PREV_STATE_IV0_MON2 ECU_ADDRESS 0x3fcd34 BYTE_ORDER MSB_LAST BIT_MASK 0x10000 /end MEASUREMENT
/begin MEASUREMENT state_iv_mon2.bf.lv_prev_state_iv1_mon2_sf "" ULONG _CNV_S_2_RANGE______0_CM 1 100. 0. 1. DISPLAY_IDENTIFIER LV_PREV_STATE_IV1_MON2 ECU_ADDRESS 0x3fcd34 BYTE_ORDER MSB_LAST BIT_MASK 0x20000 /end MEASUREMENT
/begin MEASUREMENT state_iv_mon2.bf.lv_prev_state_iv2_mon2_sf "" ULONG _CNV_S_2_RANGE______0_CM 1 100. 0. 1. DISPLAY_IDENTIFIER LV_PREV_STATE_IV2_MON2 ECU_ADDRESS 0x3fcd34 BYTE_ORDER MSB_LAST BIT_MASK 0x40000 /end MEASUREMENT
/begin MEASUREMENT state_iv_mon2.bf.lv_prev_state_iv3_mon2_sf "" ULONG _CNV_S_2_RANGE______0_CM 1 100. 0. 1. DISPLAY_IDENTIFIER LV_PREV_STATE_IV3_MON2 ECU_ADDRESS 0x3fcd34 BYTE_ORDER MSB_LAST BIT_MASK 0x80000 /end MEASUREMENT
/begin MEASUREMENT state_iv_mon2.bf.lv_prev_state_iv4_mon2_sf "" ULONG _CNV_S_2_RANGE______0_CM 1 100. 0. 1. DISPLAY_IDENTIFIER LV_PREV_STATE_IV4_MON2 ECU_ADDRESS 0x3fcd34 BYTE_ORDER MSB_LAST BIT_MASK 0x100000 /end MEASUREMENT
/begin MEASUREMENT state_iv_mon2.bf.lv_prev_state_iv5_mon2_sf "" ULONG _CNV_S_2_RANGE______0_CM 1 100. 0. 1. DISPLAY_IDENTIFIER LV_PREV_STATE_IV5_MON2 ECU_ADDRESS 0x3fcd34 BYTE_ORDER MSB_LAST BIT_MASK 0x200000 /end MEASUREMENT
/begin MEASUREMENT state_iv_mon2.word "" UWORD _CNV_A_R_LINEAR_____1_CM 1 100. 0. 65535. DISPLAY_IDENTIFIER STATE_IV_MON2 ECU_ADDRESS 0x3fcd34 BYTE_ORDER MSB_LAST FORMAT "%5.0" /end MEASUREMENT
/begin CHARACTERISTIC c_n_max_mtc_lih_thd_mon2 "" VALUE 0x00775 _REC_VAL_20_u1 8160. _CNV_A_R_LINEAR_____16_CM 0. 8160. DISPLAY_IDENTIFIER C_N_MAX_MTC_LIH_THD_MON2 FORMAT "%4.0" /end CHARACTERISTIC
/begin CHARACTERISTIC c_tqi_sp_dec_max_mon2 "" VALUE 0x008fe _REC_VAL_20_u1 31.875 _CNV_A_R_LINEAR_____479_CM 0. 31.875 DISPLAY_IDENTIFIER C_TQI_SP_DEC_MAX_MON2 FORMAT "%5.2" /end CHARACTERISTIC
/begin CHARACTERISTIC c_t_tqi_mon2 "" VALUE 0x00843 _REC_VAL_20_u1 10.2 _CNV_A_R_LINEAR_____41_CM 0. 10.2 DISPLAY_IDENTIFIER C_T_TQI_MON2 FORMAT "%5.2" /end CHARACTERISTIC
/begin CHARACTERISTIC c_iga_ref_egr_cor_lim_mon2 "maximum permitted ignition angle correction for EGR active" VALUE 0x0038b _REC_VAL_20_s1 95.625 _CNV_A_R_LINEAR_____82_CM -48. 47.625 DISPLAY_IDENTIFIER C_IGA_REF_EGR_COR_LIM_MON2 FORMAT "%5.1" /end CHARACTERISTIC
/begin CHARACTERISTIC lc_val_mo2_ans "" VALUE 0x00f9b _REC_VAL_20_u1 1. _CNV_A_R_LINEAR_____1_CM 0. 1. DISPLAY_IDENTIFIER LC_VAL_MO2_ANS FORMAT "%2.0" /end CHARACTERISTIC
/begin CHARACTERISTIC id_n_32_mon2__idx "Motordrehzahl" CURVE 0x03df8 _REC_CUR_20_u1_u1 8160. _CNV_A_R_LINEAR_____16_CM 0. 8160. DISPLAY_IDENTIFIER ID_N_32_MON2__IDX FORMAT "%4.0"
 /begin AXIS_DESCR COM_AXIS val_mo3_tst_rec_idx_mo2 _CNV_A_R_LINEAR_____1_CM 12 0. 11. FORMAT "%2.0" AXIS_PTS_REF ldpm_val_mo3_tst_rec_idx_mo2 /end AXIS_DESCR
/end CHARACTERISTIC
/begin CHARACTERISTIC id_sf_2_mon2__idx "Logische Startwerte Tabelle 2" CURVE 0x0896c _REC_CUR_20_u2_u1 65535. _CNV_A_R_LINEAR_____1_CM 0. 65535. DISPLAY_IDENTIFIER ID_SF_2_MON2__IDX FORMAT "%5.0"
 /begin AXIS_DESCR COM_AXIS val_mo3_tst_rec_idx_mo2 _CNV_A_R_LINEAR_____1_CM 12 0. 11. FORMAT "%2.0" AXIS_PTS_REF ldpm_val_mo3_tst_rec_idx_mo2 /end AXIS_DESCR
/end CHARACTERISTIC
/begin CHARACTERISTIC ip_tqi_dif_max_mon2 "Diagnoseschwelle Drehmomentenüberlauf (Prozesskontrolle 2)" MAP 0x07a0f _REC_MAP_20_u1_u1_u1 510. _CNV_A_R_LINEAR_____101_CM 0. 510. DISPLAY_IDENTIFIER IP_TQI_DIF_MAX_MON2 FORMAT "%3.0"
 /begin AXIS_DESCR COM_AXIS n_32_mon2 _CNV_A_R_LINEAR_____16_CM 4 0. 8160. FORMAT "%4.0" AXIS_PTS_REF ldp_n_32__tqi_dif_max_mon2 /end AXIS_DESCR
 /begin AXIS_DESCR COM_AXIS tqi_sp_mon2 _CNV_A_R_LINEAR_____101_CM 4 0. 510. FORMAT "%3.0" AXIS_PTS_REF ldp_tqi_sp__tqi_dif_max_mon2 /end AXIS_DESCR
/end CHARACTERISTIC
/begin CHARACTERISTIC id_tq_max_clu_mon2__idx "Monitored maximum torque at clutch" CURVE 0x03c2c _REC_CUR_20_s2_u1 2047.96875 _CNV_A_R_LINEAR_____55_CM -1024. 1023.96875 DISPLAY_IDENTIFIER ID_TQ_MAX_CLU_MON2__IDX FORMAT "%8.2"
 /begin AXIS_DESCR COM_AXIS val_mo3_tst_rec_idx_mo2 _CNV_A_R_LINEAR_____1_CM 12 0. 11. FORMAT "%2.0" AXIS_PTS_REF ldpm_val_mo3_tst_rec_idx_mo2 /end AXIS_DESCR
/end CHARACTERISTIC
/begin CHARACTERISTIC id_state_iv_mon2__idx "Status der Einspritzventile im letzten Zyklus" CURVE 0x08984 _REC_CUR_20_u2_u1 65535. _CNV_A_R_LINEAR_____1_CM 0. 65535. DISPLAY_IDENTIFIER ID_STATE_IV_MON2__IDX FORMAT "%5.0"
 /begin AXIS_DESCR COM_AXIS val_mo3_tst_rec_idx_mo2 _CNV_A_R_LINEAR_____1_CM 12 0. 11. FORMAT "%2.0" AXIS_PTS_REF ldpm_val_mo3_tst_rec_idx_mo2 /end AXIS_DESCR
/end CHARACTERISTIC
/begin CHARACTERISTIC id_iga_ref_egr_cor_mon2__idx "Ignition angle correction for EGR" CURVE 0x03bc0 _REC_CUR_20_s1_u1 95.625 _CNV_A_R_LINEAR_____82_CM -48. 47.625 DISPLAY_IDENTIFIER ID_IGA_REF_EGR_COR_MON2__IDX FORMAT "%5.1"
 /begin AXIS_DESCR COM_AXIS val_mo3_tst_rec_idx_mo2 _CNV_A_R_LINEAR_____1_CM 12 0. 11. FORMAT "%2.0" AXIS_PTS_REF ldpm_val_mo3_tst_rec_idx_mo2 /end AXIS_DESCR
/end CHARACTERISTIC
/begin CHARACTERISTIC id_t_tqi_mon2__idx "Totzeit für Verzögerung des Sollmoments" CURVE 0x03fea _REC_CUR_20_u1_u1 10.2 _CNV_A_R_LINEAR_____41_CM 0. 10.2 DISPLAY_IDENTIFIER ID_T_TQI_MON2__IDX FORMAT "%5.2"
 /begin AXIS_DESCR COM_AXIS val_mo3_tst_rec_idx_mo2 _CNV_A_R_LINEAR_____1_CM 12 0. 11. FORMAT "%2.0" AXIS_PTS_REF ldpm_val_mo3_tst_rec_idx_mo2 /end AXIS_DESCR
/end CHARACTERISTIC
/begin CHARACTERISTIC id_tqi_sp_mon2__idx "Sollmoment" CURVE 0x0409e _REC_CUR_20_u1_u1 510. _CNV_A_R_LINEAR_____101_CM 0. 510. DISPLAY_IDENTIFIER ID_TQI_SP_MON2__IDX FORMAT "%3.0"
 /begin AXIS_DESCR COM_AXIS val_mo3_tst_rec_idx_mo2 _CNV_A_R_LINEAR_____1_CM 12 0. 11. FORMAT "%2.0" AXIS_PTS_REF ldpm_val_mo3_tst_rec_idx_mo2 /end AXIS_DESCR
/end CHARACTERISTIC
/begin CHARACTERISTIC id_abc_tqi_av_mon2__idx "Entprellzähler für Überwachung des aktuell indizierten Motormoments" CURVE 0x03c5c _REC_CUR_20_u1_u1 255. _CNV_A_R_LINEAR_____1_CM 0. 255. DISPLAY_IDENTIFIER ID_ABC_TQI_AV_MON2__IDX FORMAT "%3.0"
 /begin AXIS_DESCR COM_AXIS val_mo3_tst_rec_idx_mo2 _CNV_A_R_LINEAR_____1_CM 12 0. 11. FORMAT "%2.0" AXIS_PTS_REF ldpm_val_mo3_tst_rec_idx_mo2 /end AXIS_DESCR
/end CHARACTERISTIC
/begin CHARACTERISTIC ip_fac_tq_req_driv_mon2 "Scaling factor for requested torque at clutch from driver" MAP 0x0566c _REC_MAP_20_u1_u1_u1 1.9921875 _CNV_A_R_LINEAR_____115_CM 0. 1.9921875 DISPLAY_IDENTIFIER IP_FAC_TQ_REQ_DRIV_MON2 FORMAT "%5.3"
 /begin AXIS_DESCR COM_AXIS n_32_mon2 _CNV_A_R_LINEAR_____16_CM 8 0. 8160. FORMAT "%4.0" AXIS_PTS_REF ldp_n_32__fac_tq_req_driv_mon2 /end AXIS_DESCR
 /begin AXIS_DESCR COM_AXIS pv_av_mon2 _CNV_A_R_LINEAR_____10_CM 8 0. 99.609375 FORMAT "%5.2" AXIS_PTS_REF ldp_pv_av__fac_tq_req_driv_mon2 /end AXIS_DESCR
/end CHARACTERISTIC
/begin CHARACTERISTIC ip_tqi_ref_mon2 "" MAP 0x07a1f _REC_MAP_20_u1_u1_u1 510. _CNV_A_R_LINEAR_____101_CM 0. 510. DISPLAY_IDENTIFIER IP_TQI_REF_MON2 FORMAT "%3.0"
 /begin AXIS_DESCR COM_AXIS n_32_mon2 _CNV_A_R_LINEAR_____16_CM 6 0. 8160. FORMAT "%4.0" AXIS_PTS_REF ldp_n_32__tqi_ref_mon2 /end AXIS_DESCR
 /begin AXIS_DESCR COM_AXIS maf_mon2 _CNV_A_R_LINEAR_____27_CM 8 0. 1389. FORMAT "%4.0" AXIS_PTS_REF ldp_maf__tqi_ref_mon2 /end AXIS_DESCR
/end CHARACTERISTIC
/begin CHARACTERISTIC id_abc_tqi_n_max_mon2__idx "Entprellzähler für Überwachung der Drehzahlbegrenzung" CURVE 0x03c68 _REC_CUR_20_u1_u1 255. _CNV_A_R_LINEAR_____1_CM 0. 255. DISPLAY_IDENTIFIER ID_ABC_TQI_N_MAX_MON2__IDX FORMAT "%3.0"
 /begin AXIS_DESCR COM_AXIS val_mo3_tst_rec_idx_mo2 _CNV_A_R_LINEAR_____1_CM 12 0. 11. FORMAT "%2.0" AXIS_PTS_REF ldpm_val_mo3_tst_rec_idx_mo2 /end AXIS_DESCR
/end CHARACTERISTIC
/begin CHARACTERISTIC ip_eff_iga_mon2 "" CURVE 0x00a90 _REC_CUR_20_u1_u1 1.9921875 _CNV_A_R_LINEAR_____115_CM 0. 1.9921875 DISPLAY_IDENTIFIER IP_EFF_IGA_MON2 FORMAT "%5.3"
 /begin AXIS_DESCR COM_AXIS iga_dif_av _CNV_A_R_LINEAR_____204_CM 8 0. -95.625 FORMAT "%6.2" AXIS_PTS_REF ldp_iga_dif_av__eff_iga_mon2 /end AXIS_DESCR
/end CHARACTERISTIC
/begin CHARACTERISTIC id_tq_dif_p_d_is_mon2__idx "P- and D- controller output for idle speed control" CURVE 0x03bcc _REC_CUR_20_s2_u1 2047.96875 _CNV_A_R_LINEAR_____55_CM -1024. 1023.96875 DISPLAY_IDENTIFIER ID_TQ_DIF_P_D_IS_MON2__IDX FORMAT "%8.2"
 /begin AXIS_DESCR COM_AXIS val_mo3_tst_rec_idx_mo2 _CNV_A_R_LINEAR_____1_CM 12 0. 11. FORMAT "%2.0" AXIS_PTS_REF ldpm_val_mo3_tst_rec_idx_mo2 /end AXIS_DESCR
/end CHARACTERISTIC
/begin CHARACTERISTIC id_tq_egs_mon2__idx "Torque demand from EGS" CURVE 0x03be4 _REC_CUR_20_s2_u1 2047.96875 _CNV_A_R_LINEAR_____55_CM -1024. 1023.96875 DISPLAY_IDENTIFIER ID_TQ_EGS_MON2__IDX FORMAT "%8.2"
 /begin AXIS_DESCR COM_AXIS val_mo3_tst_rec_idx_mo2 _CNV_A_R_LINEAR_____1_CM 12 0. 11. FORMAT "%2.0" AXIS_PTS_REF ldpm_val_mo3_tst_rec_idx_mo2 /end AXIS_DESCR
/end CHARACTERISTIC
/begin CHARACTERISTIC id_iga_igc_mon2__idx "Zündwinkel" CURVE 0x03da0 _REC_CUR_20_u1_u1 95.625 _CNV_A_R_LINEAR_____203_CM -35.625 60. DISPLAY_IDENTIFIER ID_IGA_IGC_MON2__IDX FORMAT "%5.1"
 /begin AXIS_DESCR COM_AXIS val_mo3_tst_rec_idx_mo2 _CNV_A_R_LINEAR_____1_CM 12 0. 11. FORMAT "%2.0" AXIS_PTS_REF ldpm_val_mo3_tst_rec_idx_mo2 /end AXIS_DESCR
/end CHARACTERISTIC
/begin CHARACTERISTIC id_tq_esp_mon2__idx "Torque demand from EPS" CURVE 0x03bfc _REC_CUR_20_s2_u1 2047.96875 _CNV_A_R_LINEAR_____55_CM -1024. 1023.96875 DISPLAY_IDENTIFIER ID_TQ_ESP_MON2__IDX FORMAT "%8.2"
 /begin AXIS_DESCR COM_AXIS val_mo3_tst_rec_idx_mo2 _CNV_A_R_LINEAR_____1_CM 12 0. 11. FORMAT "%2.0" AXIS_PTS_REF ldpm_val_mo3_tst_rec_idx_mo2 /end AXIS_DESCR
/end CHARACTERISTIC
/begin CHARACTERISTIC id_maf_mon2__idx "Luftmasse" CURVE 0x03dec _REC_CUR_20_u1_u1 1389. _CNV_A_R_LINEAR_____27_CM 0. 1389. DISPLAY_IDENTIFIER ID_MAF_MON2__IDX FORMAT "%4.0"
 /begin AXIS_DESCR COM_AXIS val_mo3_tst_rec_idx_mo2 _CNV_A_R_LINEAR_____1_CM 12 0. 11. FORMAT "%2.0" AXIS_PTS_REF ldpm_val_mo3_tst_rec_idx_mo2 /end AXIS_DESCR
/end CHARACTERISTIC
/begin CHARACTERISTIC id_pv_av_mon2__idx "Pedalwert" CURVE 0x03e89 _REC_CUR_20_u1_u1 99.609375 _CNV_A_R_LINEAR_____10_CM 0. 99.609375 DISPLAY_IDENTIFIER ID_PV_AV_MON2__IDX FORMAT "%4.1"
 /begin AXIS_DESCR COM_AXIS val_mo3_tst_rec_idx_mo2 _CNV_A_R_LINEAR_____1_CM 12 0. 11. FORMAT "%2.0" AXIS_PTS_REF ldpm_val_mo3_tst_rec_idx_mo2 /end AXIS_DESCR
/end CHARACTERISTIC
/begin CHARACTERISTIC id_tq_loss_mon2__idx "Torque losses" CURVE 0x03c14 _REC_CUR_20_s2_u1 2047.96875 _CNV_A_R_LINEAR_____55_CM -1024. 1023.96875 DISPLAY_IDENTIFIER ID_TQ_LOSS_MON2__IDX FORMAT "%8.2"
 /begin AXIS_DESCR COM_AXIS val_mo3_tst_rec_idx_mo2 _CNV_A_R_LINEAR_____1_CM 12 0. 11. FORMAT "%2.0" AXIS_PTS_REF ldpm_val_mo3_tst_rec_idx_mo2 /end AXIS_DESCR
/end CHARACTERISTIC
/begin CHARACTERISTIC ip_iga_ref_mon2 "Referenz-Zündwinkel (Prozesskontrolle 2)" MAP 0x06360 _REC_MAP_20_u1_u1_u1 95.625 _CNV_A_R_LINEAR_____203_CM -35.625 60. DISPLAY_IDENTIFIER IP_IGA_REF_MON2 FORMAT "%5.1"
 /begin AXIS_DESCR COM_AXIS n_32_mon2 _CNV_A_R_LINEAR_____16_CM 8 0. 8160. FORMAT "%4.0" AXIS_PTS_REF ldp_n_32__iga_ref_mon2 /end AXIS_DESCR
 /begin AXIS_DESCR COM_AXIS maf_mon2 _CNV_A_R_LINEAR_____27_CM 8 0. 1389. FORMAT "%4.0" AXIS_PTS_REF ldp_maf__iga_ref_mon2 /end AXIS_DESCR
/end CHARACTERISTIC
/begin CHARACTERISTIC id_sf_1_mon2__idx "Logische Startwerte Tabelle 1" CURVE 0x08954 _REC_CUR_20_u2_u1 65535. _CNV_A_R_LINEAR_____1_CM 0. 65535. DISPLAY_IDENTIFIER ID_SF_1_MON2__IDX FORMAT "%5.0"
 /begin AXIS_DESCR COM_AXIS val_mo3_tst_rec_idx_mo2 _CNV_A_R_LINEAR_____1_CM 12 0. 11. FORMAT "%2.0" AXIS_PTS_REF ldpm_val_mo3_tst_rec_idx_mo2 /end AXIS_DESCR
/end CHARACTERISTIC
/begin CHARACTERISTIC id_tq_min_clu_mon2__idx "Monitored minimum torque at clutch" CURVE 0x03c44 _REC_CUR_20_s2_u1 2047.96875 _CNV_A_R_LINEAR_____55_CM -1024. 1023.96875 DISPLAY_IDENTIFIER ID_TQ_MIN_CLU_MON2__IDX FORMAT "%8.2"
 /begin AXIS_DESCR COM_AXIS val_mo3_tst_rec_idx_mo2 _CNV_A_R_LINEAR_____1_CM 12 0. 11. FORMAT "%2.0" AXIS_PTS_REF ldpm_val_mo3_tst_rec_idx_mo2 /end AXIS_DESCR
/end CHARACTERISTIC
/begin CHARACTERISTIC id_fac_tq_req_cru_mon2__idx "Torque demand from cruise control" CURVE 0x03d57 _REC_CUR_20_u1_u1 1.99220002 _CNV_A_R_LINEAR_____39_CM 0. 1.99220002 DISPLAY_IDENTIFIER ID_FAC_TQ_REQ_CRU_MON2__IDX FORMAT "%5.3"
 /begin AXIS_DESCR COM_AXIS val_mo3_tst_rec_idx_mo2 _CNV_A_R_LINEAR_____1_CM 12 0. 11. FORMAT "%2.0" AXIS_PTS_REF ldpm_val_mo3_tst_rec_idx_mo2 /end AXIS_DESCR
/end CHARACTERISTIC
/begin CHARACTERISTIC id_inh_swi_iv_mon2__idx "shut off request for cylinder x" CURVE 0x0839c _REC_CUR_20_u2_u1 65535. _CNV_A_R_LINEAR_____1_CM 0. 65535. DISPLAY_IDENTIFIER ID_INH_SWI_IV_MON2__IDX FORMAT "%5.0"
 /begin AXIS_DESCR COM_AXIS val_mo3_tst_rec_idx_mo2 _CNV_A_R_LINEAR_____1_CM 12 0. 11. FORMAT "%2.0" AXIS_PTS_REF ldpm_val_mo3_tst_rec_idx_mo2 /end AXIS_DESCR
/end CHARACTERISTIC
/begin AXIS_PTS ldp_iga_dif_av__eff_iga_mon2 "" 0x07b44 iga_dif_av _REC_AXS_20_u1 -95.625 _CNV_A_R_LINEAR_____204_CM 8 0. -95.625 DISPLAY_IDENTIFIER LDP_IGA_DIF_AV__EFF_IGA_MON2 FORMAT "%6.2" /end AXIS_PTS
/begin AXIS_PTS ldp_maf__iga_ref_mon2 "" 0x07b5e maf_mon2 _REC_AXS_20_u1 1389. _CNV_A_R_LINEAR_____27_CM 8 0. 1389. DISPLAY_IDENTIFIER LDP_MAF__IGA_REF_MON2 FORMAT "%4.0" /end AXIS_PTS
/begin AXIS_PTS ldp_maf__tqi_ref_mon2 "" 0x07b74 maf_mon2 _REC_AXS_20_u1 1389. _CNV_A_R_LINEAR_____27_CM 8 0. 1389. DISPLAY_IDENTIFIER LDP_MAF__TQI_REF_MON2 FORMAT "%4.0" /end AXIS_PTS
/begin AXIS_PTS ldp_n_32__iga_ref_mon2 "" 0x07bf1 n_32_mon2 _REC_AXS_20_u1 8160. _CNV_A_R_LINEAR_____16_CM 8 0. 8160. DISPLAY_IDENTIFIER LDP_N_32__IGA_REF_MON2 FORMAT "%4.0" /end AXIS_PTS
/begin AXIS_PTS ldp_n_32__tqi_dif_max_mon2 "" 0x01073 n_32_mon2 _REC_AXS_20_u1 8160. _CNV_A_R_LINEAR_____16_CM 4 0. 8160. DISPLAY_IDENTIFIER LDP_N_32__TQI_DIF_MAX_MON2 FORMAT "%4.0" /end AXIS_PTS
/begin AXIS_PTS ldp_n_32__tqi_ref_mon2 "" 0x01078 n_32_mon2 _REC_AXS_20_u1 8160. _CNV_A_R_LINEAR_____16_CM 6 0. 8160. DISPLAY_IDENTIFIER LDP_N_32__TQI_REF_MON2 FORMAT "%4.0" /end AXIS_PTS
/begin AXIS_PTS ldp_tqi_sp__tqi_dif_max_mon2 "" 0x0125c tqi_sp_mon2 _REC_AXS_20_u1 510. _CNV_A_R_LINEAR_____101_CM 4 0. 510. DISPLAY_IDENTIFIER LDP_TQI_SP__TQI_DIF_MAX_MON2 FORMAT "%3.0" /end AXIS_PTS
/begin AXIS_PTS ldp_n_32__fac_tq_req_driv_mon2 "" 0x07bdf n_32_mon2 _REC_AXS_20_u1 8160. _CNV_A_R_LINEAR_____16_CM 8 0. 8160. DISPLAY_IDENTIFIER LDP_N_32__FAC_TQ_REQ_DRIV_MON2 FORMAT "%4.0" /end AXIS_PTS
/begin AXIS_PTS ldp_pv_av__fac_tq_req_driv_mon2 "" 0x07d31 pv_av_mon2 _REC_AXS_20_u1 99.609375 _CNV_A_R_LINEAR_____10_CM 8 0. 99.609375 DISPLAY_IDENTIFIER LDP_PV_AV__FAC_TQ_REQ_DRIV_MON2 FORMAT "%5.2" /end AXIS_PTS
/begin MEASUREMENT val_mo2_ans_tst "" UWORD _CNV_A_R_LINEAR_____1_CM 1 100. 0. 65535. DISPLAY_IDENTIFIER VAL_MO2_ANS_TST ECU_ADDRESS 0x3fda9e BYTE_ORDER MSB_LAST FORMAT "%5.0" /end MEASUREMENT
/begin AXIS_PTS ldpm_val_mo3_tst_rec_idx_mo2 "" 0x08291 val_mo3_tst_rec_idx_mo2 _REC_AXS_20_u1 11. _CNV_A_R_LINEAR_____1_CM 12 0. 11. DISPLAY_IDENTIFIER LDPM_VAL_MO3_TST_REC_IDX_MO2 FORMAT "%2.0" /end AXIS_PTS
/begin CHARACTERISTIC id_lv_rng_l_req_mon2__idx "Switch condition of progression" CURVE 0x03dd0 _REC_CUR_20_u1_u1 1. _CNV_A_R_LINEAR_____1_CM 0. 1. DISPLAY_IDENTIFIER ID_LV_RNG_L_REQ_MON2__IDX FORMAT "%2.0"
 /begin AXIS_DESCR COM_AXIS val_mo3_tst_rec_idx_mo2 _CNV_A_R_LINEAR_____1_CM 12 0. 11. FORMAT "%2.0" AXIS_PTS_REF ldpm_val_mo3_tst_rec_idx_mo2 /end AXIS_DESCR
/end CHARACTERISTIC
/begin MEASUREMENT fac_tq_req_mon2 "Scaling factor for requested torque at clutch from driver" UBYTE _CNV_A_R_LINEAR_____39_CM 1 100. 0. 1.99220002 DISPLAY_IDENTIFIER FAC_TQ_REQ_MON2 ECU_ADDRESS 0x3fe6ed FORMAT "%5.3" /end MEASUREMENT
/begin MEASUREMENT fac_tq_req_driv_mon2 "Scaling factor for requested torque at clutch from driver" UBYTE _CNV_A_R_LINEAR_____39_CM 1 100. 0. 1.99220002 DISPLAY_IDENTIFIER FAC_TQ_REQ_DRIV_MON2 ECU_ADDRESS 0x3fe6ef FORMAT "%5.3" /end MEASUREMENT
/begin CHARACTERISTIC ip_fac_tq_req_driv_rng_l_mon2 "Scaling factor for requested torque at clutch from driver rng_l" MAP 0x056ac _REC_MAP_20_u1_u1_u1 1.9921875 _CNV_A_R_LINEAR_____115_CM 0. 1.9921875 DISPLAY_IDENTIFIER IP_FAC_TQ_REQ_DRIV_RNG_L_MON2 FORMAT "%5.3"
 /begin AXIS_DESCR COM_AXIS n_32_mon2 _CNV_A_R_LINEAR_____16_CM 8 0. 8160. FORMAT "%4.0" AXIS_PTS_REF ldp_n_32__fac_tq_req_driv_mon2 /end AXIS_DESCR
 /begin AXIS_DESCR COM_AXIS pv_av_mon2 _CNV_A_R_LINEAR_____10_CM 8 0. 99.609375 FORMAT "%5.2" AXIS_PTS_REF ldp_pv_av__fac_tq_req_driv_mon2 /end AXIS_DESCR
/end CHARACTERISTIC
/begin MEASUREMENT tq_esp_mon2 "Torque demand from ESP" SWORD _CNV_A_R_LINEAR_____55_CM 1 100. -1024. 1023.96875 DISPLAY_IDENTIFIER TQ_ESP_MON2 ECU_ADDRESS 0x3fdaa4 BYTE_ORDER MSB_LAST FORMAT "%8.2" /end MEASUREMENT
/begin MEASUREMENT tq_loss_mon2 "Torque losses" SWORD _CNV_A_R_LINEAR_____55_CM 1 100. -1024. 1023.96875 DISPLAY_IDENTIFIER TQ_LOSS_MON2 ECU_ADDRESS 0x3fdaa6 BYTE_ORDER MSB_LAST FORMAT "%8.2" /end MEASUREMENT
/begin MEASUREMENT tqi_av_mon2 "" UBYTE _CNV_A_R_LINEAR_____101_CM 1 100. 0. 510. DISPLAY_IDENTIFIER TQI_AV_MON2 ECU_ADDRESS 0x3fe6f0 FORMAT "%3.0" /end MEASUREMENT
/begin MEASUREMENT pv_av_mon2 "Pedal value" UBYTE _CNV_A_R_LINEAR_____10_CM 1 100. 0. 99.609375 DISPLAY_IDENTIFIER PV_AV_MON2 ECU_ADDRESS 0x3fe6e6 FORMAT "%4.1" /end MEASUREMENT
/begin MEASUREMENT fac_tq_req_cru_mon2 "Torque demand from cruise control" UBYTE _CNV_A_R_LINEAR_____39_CM 1 100. 0. 1.99220002 DISPLAY_IDENTIFIER FAC_TQ_REQ_CRU_MON2 ECU_ADDRESS 0x3fe6e7 FORMAT "%5.3" /end MEASUREMENT
/begin MEASUREMENT tq_dif_p_d_is_mon2 "P- and D- controller output for idle speed control" SWORD _CNV_A_R_LINEAR_____55_CM 1 100. -1024. 1023.96875 DISPLAY_IDENTIFIER TQ_DIF_P_D_IS_MON2 ECU_ADDRESS 0x3fdaac BYTE_ORDER MSB_LAST FORMAT "%8.2" /end MEASUREMENT
/begin MEASUREMENT tq_min_clu_mon2 "Monitored minimum torque at clutch" SWORD _CNV_A_R_LINEAR_____55_CM 1 100. -1024. 1023.96875 DISPLAY_IDENTIFIER TQ_MIN_CLU_MON2 ECU_ADDRESS 0x3fdaa8 BYTE_ORDER MSB_LAST FORMAT "%8.2" /end MEASUREMENT
/begin MEASUREMENT maf_mon2 "" UBYTE _CNV_A_R_LINEAR_____27_CM 1 100. 0. 1389. DISPLAY_IDENTIFIER MAF_MON2 ECU_ADDRESS 0x3fe6e9 FORMAT "%4.0" /end MEASUREMENT
/begin MEASUREMENT abc_tqi_av_mon2 "" UBYTE _CNV_A_R_LINEAR_____1_CM 1 100. 0. 255. DISPLAY_IDENTIFIER ABC_TQI_AV_MON2 ECU_ADDRESS 0x3fe6f6 FORMAT "%3.0" /end MEASUREMENT
/begin MEASUREMENT n_32_mon2 "" UBYTE _CNV_A_R_LINEAR_____16_CM 1 100. 0. 8160. DISPLAY_IDENTIFIER N_32_MON2 ECU_ADDRESS 0x3fe6e8 FORMAT "%4.0" /end MEASUREMENT
/begin MEASUREMENT tq_max_clu_mon2 "Monitored maximum torque at clutch" SWORD _CNV_A_R_LINEAR_____55_CM 1 100. -1024. 1023.96875 DISPLAY_IDENTIFIER TQ_MAX_CLU_MON2 ECU_ADDRESS 0x3fdaaa BYTE_ORDER MSB_LAST FORMAT "%8.2" /end MEASUREMENT
/begin MEASUREMENT tqi_dif_max_mon2 "" UBYTE _CNV_A_R_LINEAR_____101_CM 1 100. 0. 510. DISPLAY_IDENTIFIER TQI_DIF_MAX_MON2 ECU_ADDRESS 0x3fe6f8 FORMAT "%3.0" /end MEASUREMENT
/begin MEASUREMENT iga_ref_egr_cor_mon2 "Ingition angle correction for EGR" SBYTE _CNV_A_R_LINEAR_____82_CM 1 100. -48. 47.625 DISPLAY_IDENTIFIER IGA_REF_EGR_COR_MON2 ECU_ADDRESS 0x3fe6fa FORMAT "%5.1" /end MEASUREMENT
/begin MEASUREMENT iga_ref_cor_mon2 "reference ignition angle for torque monitoring (corrected by EGR influence)" UBYTE _CNV_A_R_LINEAR_____203_CM 1 100. -35.625 60. DISPLAY_IDENTIFIER IGA_REF_COR_MON2 ECU_ADDRESS 0x3fe6f5 FORMAT "%5.1" /end MEASUREMENT
/begin MEASUREMENT tqi_dif_mon2 "" UBYTE _CNV_A_R_LINEAR_____101_CM 1 100. 0. 510. DISPLAY_IDENTIFIER TQI_DIF_MON2 ECU_ADDRESS 0x3fe6f7 FORMAT "%3.0" /end MEASUREMENT
/begin MEASUREMENT abc_tqi_n_max_mon2 "" UBYTE _CNV_A_R_LINEAR_____1_CM 1 100. 0. 255. DISPLAY_IDENTIFIER ABC_TQI_N_MAX_MON2 ECU_ADDRESS 0x3fe6f9 FORMAT "%3.0" /end MEASUREMENT
/begin MEASUREMENT tqi_req_tot_mon2 "" UBYTE _CNV_A_R_LINEAR_____101_CM 1 100. 0. 510. DISPLAY_IDENTIFIER TQI_REQ_TOT_MON2 ECU_ADDRESS 0x3fe6ec FORMAT "%3.0" /end MEASUREMENT
/begin MEASUREMENT iga_igc_mon2 "" UBYTE _CNV_A_R_LINEAR_____203_CM 1 100. -35.625 60. DISPLAY_IDENTIFIER IGA_IGC_MON2 ECU_ADDRESS 0x3fe6ea FORMAT "%5.1" /end MEASUREMENT
/begin MEASUREMENT tqi_sp_mon2 "" UBYTE _CNV_A_R_LINEAR_____101_CM 1 100. 0. 510. DISPLAY_IDENTIFIER TQI_SP_MON2 ECU_ADDRESS 0x3fe6eb FORMAT "%3.0" /end MEASUREMENT
/begin MEASUREMENT tq_egs_mon2 "Torque demand from EGS" SWORD _CNV_A_R_LINEAR_____55_CM 1 100. -1024. 1023.96875 DISPLAY_IDENTIFIER TQ_EGS_MON2 ECU_ADDRESS 0x3fdaa2 BYTE_ORDER MSB_LAST FORMAT "%8.2" /end MEASUREMENT
/begin MEASUREMENT eff_iga_av_mon2 "actual ignition efficiency for torque monitoring" UBYTE _CNV_A_R_LINEAR_____115_CM 1 100. 0. 1.9921875 DISPLAY_IDENTIFIER EFF_IGA_AV_MON2 ECU_ADDRESS 0x3fe6f1 FORMAT "%5.3" /end MEASUREMENT
/begin MEASUREMENT eff_scc_av_2_mon2 "actual ignition efficiency for torque monitoring" UBYTE _CNV_A_R_LINEAR_____115_CM 1 100. 0. 1.9921875 DISPLAY_IDENTIFIER EFF_SCC_AV_2_MON2 ECU_ADDRESS 0x3fe6f3 FORMAT "%5.3" /end MEASUREMENT
/begin MEASUREMENT eff_scc_av_mon2 "actual ignition efficiency for torque monitoring" UBYTE _CNV_A_R_LINEAR_____115_CM 1 100. 0. 1.9921875 DISPLAY_IDENTIFIER EFF_SCC_AV_MON2 ECU_ADDRESS 0x3fe6f4 FORMAT "%5.3" /end MEASUREMENT
/begin MEASUREMENT eff_scc_av_1_mon2 "actual ignition efficiency for torque monitoring" UBYTE _CNV_A_R_LINEAR_____115_CM 1 100. 0. 1.9921875 DISPLAY_IDENTIFIER EFF_SCC_AV_1_MON2 ECU_ADDRESS 0x3fe6f2 FORMAT "%5.3" /end MEASUREMENT
/begin MEASUREMENT t_tqi_mon2 "" UBYTE _CNV_A_R_LINEAR_____41_CM 1 100. 0. 10.2 DISPLAY_IDENTIFIER T_TQI_MON2 ECU_ADDRESS 0x3fe6ee FORMAT "%5.2" /end MEASUREMENT
/begin MEASUREMENT inh_swi_iv_mon2 "shut of request for cylinder x" UWORD _CNV_A_R_LINEAR_____1_CM 1 100. 1. 65535. DISPLAY_IDENTIFIER INH_SWI_IV_MON2 ECU_ADDRESS 0x3fdaa0 BYTE_ORDER MSB_LAST FORMAT "%5.0" /end MEASUREMENT
/begin MEASUREMENT val_mo3_av_cal_cks_high "" ULONG _CNV_A_R_LINEAR_____1_CM 1 100. 0. 4294967295. DISPLAY_IDENTIFIER VAL_MO3_AV_CAL_CKS_HIGH ECU_ADDRESS 0x3fcd3c BYTE_ORDER MSB_LAST FORMAT "%11.0" /end MEASUREMENT
/begin MEASUREMENT val_mo3_av_cal_cks_low "" ULONG _CNV_A_R_LINEAR_____1_CM 1 100. 0. 4294967295. DISPLAY_IDENTIFIER VAL_MO3_AV_CAL_CKS_LOW ECU_ADDRESS 0x3fcd38 BYTE_ORDER MSB_LAST FORMAT "%11.0" /end MEASUREMENT
/begin CHARACTERISTIC val_mo3_cal_cks_high "setpoint of CAL data (high) ROM test process monitoring" VALUE 0x01450 _REC_VAL_20_u4 4294967295. _CNV_A_R_LINEAR_____22_CM 0. 4294967295. DISPLAY_IDENTIFIER VAL_MO3_CAL_CKS_HIGH FORMAT "%11.0" /end CHARACTERISTIC
/begin CHARACTERISTIC val_mo3_cal_cks_low "setpoint of CAL data (low) ROM test process monitoring" VALUE 0x01454 _REC_VAL_20_u4 4294967295. _CNV_A_R_LINEAR_____22_CM 0. 4294967295. DISPLAY_IDENTIFIER VAL_MO3_CAL_CKS_LOW FORMAT "%11.0" /end CHARACTERISTIC
/begin CHARACTERISTIC val_mo3_swi_cal_cks "switch to set the fault of the CAL data ROM test inactive (A5h means inactive)" VALUE 0x0143f _REC_VAL_20_u1 255. _CNV_A_R_LINEAR_____1_CM 0. 255. DISPLAY_IDENTIFIER VAL_MO3_SWI_CAL_CKS FORMAT "%3.0" /end CHARACTERISTIC
/begin CHARACTERISTIC val_mo3_ans_cpm_tab "assignment table for answer of copy of process monitoring" CURVE 0x11d1e _REC_CUR_20_u2_u1 65535. _CNV_A_R_LINEAR_____1_CM 0. 65535. DISPLAY_IDENTIFIER VAL_MO3_ANS_CPM_TAB FORMAT "%5.0"
 /begin AXIS_DESCR COM_AXIS val_mo3_tst_rec_idx_mo2 _CNV_A_R_LINEAR_____1_CM 12 0. 12. FORMAT "%3.0" AXIS_PTS_REF ldpm_tst_rec /end AXIS_DESCR
/end CHARACTERISTIC
/begin MEASUREMENT val_mo2_ans "" UWORD _CNV_A_R_LINEAR_____1_CM 1 100. 0. 65535. DISPLAY_IDENTIFIER VAL_MO2_ANS ECU_ADDRESS 0x3fdb48 BYTE_ORDER MSB_LAST FORMAT "%5.0" /end MEASUREMENT
/begin MEASUREMENT val_mo3_err_code_mc "error code of an error dtected by the MC" UBYTE _CNV_A_R_LINEAR_____1_CM 1 100. 0. 255. DISPLAY_IDENTIFIER VAL_MO3_ERR_CODE_MC ECU_ADDRESS 0x3fa0a2 FORMAT "%3.0" /end MEASUREMENT
/begin MEASUREMENT val_mo3_err_code_mu "error code of an error dtected by the MU" UBYTE _CNV_A_R_LINEAR_____1_CM 1 100. 0. 255. DISPLAY_IDENTIFIER VAL_MO3_ERR_CODE_MU ECU_ADDRESS 0x3fe7b6 FORMAT "%3.0" /end MEASUREMENT
/begin MEASUREMENT val_mo3_predrive_act "active flag of PREDRIVE CHECK" UBYTE _CNV_S_2_RANGE______0_CM 1 100. 0. 1. DISPLAY_IDENTIFIER VAL_MO3_PREDRIVE_ACT ECU_ADDRESS 0x3fe7b1 /end MEASUREMENT
/begin MEASUREMENT val_mo3_pwr_stag_dis_mc "" UBYTE _CNV_S_2_RANGE______5_CM 1 100. 0. 1. DISPLAY_IDENTIFIER VAL_MO3_PWR_STAG_DIS_MC ECU_ADDRESS 0x3fe7af BIT_MASK 0x1 /end MEASUREMENT
/begin MEASUREMENT val_mo3_pwr_stag_dis_mu "" UBYTE _CNV_S_2_RANGE______5_CM 1 100. 0. 1. DISPLAY_IDENTIFIER VAL_MO3_PWR_STAG_DIS_MU ECU_ADDRESS 0x3fe7b0 BIT_MASK 0x1 /end MEASUREMENT
/begin MEASUREMENT val_mo3_rst_ctr_mc "reset counter on MC" UBYTE _CNV_A_R_LINEAR_____1_CM 1 100. 0. 255. DISPLAY_IDENTIFIER VAL_MO3_RST_CTR_MC ECU_ADDRESS 0x3fa0ae FORMAT "%3.0" /end MEASUREMENT
/begin MEASUREMENT val_mo3_rst_ctr_mu "reset counter on MU" UBYTE _CNV_A_R_LINEAR_____1_CM 1 100. 0. 255. DISPLAY_IDENTIFIER VAL_MO3_RST_CTR_MU ECU_ADDRESS 0x3fe7b7 FORMAT "%3.0" /end MEASUREMENT
/begin MEASUREMENT val_mo3_tst_rec_idx_mo2 "index for the test records of copy of Process Monitoring" UBYTE _CNV_A_R_LINEAR_____1_CM 1 100. 0. 255. DISPLAY_IDENTIFIER VAL_MO3_TST_REC_IDX_MO2 ECU_ADDRESS 0x3fe7ae FORMAT "%3.0" /end MEASUREMENT
/begin AXIS_PTS ldpm_tst_rec "" 0x08284 val_mo3_tst_rec_idx_mo2 _REC_AXS_20_u1 12. _CNV_A_R_LINEAR_____1_CM 12 0. 12. DISPLAY_IDENTIFIER LDPM_TST_REC FORMAT "%3.0" /end AXIS_PTS
/begin MEASUREMENT lv_err_n_32_mon "Logical variable for ratio error between N_32_MON and N_32_SUB_MON" UBYTE _CNV_S_2_RANGE______5_CM 1 100. 0. 1. DISPLAY_IDENTIFIER LV_ERR_N_32_MON ECU_ADDRESS 0x3fe683 BIT_MASK 0x1 /end MEASUREMENT
/begin MEASUREMENT lv_err_tps_mon "Logical variable for different TPS diagnosis between L1 and L2" UBYTE _CNV_S_2_RANGE______5_CM 1 100. 0. 1. DISPLAY_IDENTIFIER LV_ERR_TPS_MON ECU_ADDRESS 0x3fe658 BIT_MASK 0x1 /end MEASUREMENT
/begin MEASUREMENT lv_err_tqi_av_mon "Fault currently present in torque generation" UBYTE _CNV_S_2_RANGE______5_CM 1 100. 0. 1. DISPLAY_IDENTIFIER LV_ERR_TQI_AV_MON ECU_ADDRESS 0x3fe6b2 BIT_MASK 0x1 /end MEASUREMENT
/begin MEASUREMENT lv_err_msr_inh_mon "Logical variable for fault in MSR present" UBYTE _CNV_S_2_RANGE______5_CM 1 100. 0. 1. DISPLAY_IDENTIFIER LV_ERR_MSR_INH_MON ECU_ADDRESS 0x3fe5f6 BIT_MASK 0x1 /end MEASUREMENT
/begin MEASUREMENT lv_err_cru_inh_mon "Logival variable for inhibition of cruise control" UBYTE _CNV_S_2_RANGE______5_CM 1 100. 0. 1. DISPLAY_IDENTIFIER LV_ERR_CRU_INH_MON ECU_ADDRESS 0x3fe646 BIT_MASK 0x1 /end MEASUREMENT
/begin MEASUREMENT lv_err_maf_mon "Logical variable for error in mass air flow signal" UBYTE _CNV_S_2_RANGE______5_CM 1 100. 0. 1. DISPLAY_IDENTIFIER LV_ERR_MAF_MON ECU_ADDRESS 0x3fe659 BIT_MASK 0x1 /end MEASUREMENT
/begin MEASUREMENT B_eb_busy "" UBYTE _CNV_S_2_B_TRUE_530_CM 1 100. 0. 1. DISPLAY_IDENTIFIER B_EB_BUSY ECU_ADDRESS 0x3fab2a BIT_MASK 0x1 /end MEASUREMENT
/begin MEASUREMENT B_eb_txok "" UBYTE _CNV_S_2_B_TRUE_530_CM 1 100. 0. 1. DISPLAY_IDENTIFIER B_EB_TXOK ECU_ADDRESS 0x3fab2e BIT_MASK 0x1 /end MEASUREMENT
/begin MEASUREMENT B_eb_write "" UBYTE _CNV_S_2_B_TRUE_530_CM 1 100. 0. 1. DISPLAY_IDENTIFIER B_EB_WRITE ECU_ADDRESS 0x3fab2f BIT_MASK 0x1 /end MEASUREMENT
/begin MEASUREMENT B_ibfbsd "" UBYTE _CNV_S_2_B_TRUE_530_CM 1 100. 0. 1. DISPLAY_IDENTIFIER B_IBFBSD ECU_ADDRESS 0x3fab30 BIT_MASK 0x1 /end MEASUREMENT
/begin MEASUREMENT B_ibfebsd "" UBYTE _CNV_S_2_B_TRUE_530_CM 1 100. 0. 1. DISPLAY_IDENTIFIER B_IBFEBSD ECU_ADDRESS 0x3fab2b BIT_MASK 0x1 /end MEASUREMENT
/begin MEASUREMENT B_ibunplau "" UBYTE _CNV_S_2_B_TRUE_530_CM 1 100. 0. 1. DISPLAY_IDENTIFIER B_IBUNPLAU ECU_ADDRESS 0x3fab31 BIT_MASK 0x1 /end MEASUREMENT
/begin MEASUREMENT B_startfgk "" UBYTE _CNV_S_2_B_TRUE_530_CM 1 100. 0. 1. DISPLAY_IDENTIFIER B_STARTFGK ECU_ADDRESS 0x3fab32 BIT_MASK 0x1 /end MEASUREMENT
/begin MEASUREMENT chk16_erom "" UWORD _CNV_R_R_dez_498_CM 1 100. 0. 65535. DISPLAY_IDENTIFIER CHK16_EROM ECU_ADDRESS 0x3fab36 BYTE_ORDER MSB_LAST FORMAT "%6.2" /end MEASUREMENT
/begin MEASUREMENT chkpara "" UWORD _CNV_R_R_dez_498_CM 1 100. 0. 65535. DISPLAY_IDENTIFIER CHKPARA ECU_ADDRESS 0x3fab38 BYTE_ORDER MSB_LAST FORMAT "%6.2" /end MEASUREMENT
/begin MEASUREMENT ebsd_adr "" UBYTE _CNV_R_R_dez_498_CM 1 100. 0. 255. DISPLAY_IDENTIFIER EBSD_ADR ECU_ADDRESS 0x3fab2c FORMAT "%6.2" /end MEASUREMENT
/begin MEASUREMENT ebsd_errdir "" UBYTE _CNV_S_2_B_TRUE_530_CM 1 100. 0. 1. DISPLAY_IDENTIFIER EBSD_ERRDIR ECU_ADDRESS 0x3fab33 BIT_MASK 0x1 /end MEASUREMENT
/begin MEASUREMENT ebsd_errep "" UBYTE _CNV_R_R_dez_498_CM 1 100. 0. 255. DISPLAY_IDENTIFIER EBSD_ERREP ECU_ADDRESS 0x3fab76 FORMAT "%6.2" /end MEASUREMENT
/begin MEASUREMENT ebsd_errin "" UBYTE _CNV_R_R_dez_498_CM 1 100. 0. 255. DISPLAY_IDENTIFIER EBSD_ERRIN ECU_ADDRESS 0x3fab77 FORMAT "%6.2" /end MEASUREMENT
/begin MEASUREMENT ebsd_nbyt "" UBYTE _CNV_R_R_dez_498_CM 1 100. 0. 255. DISPLAY_IDENTIFIER EBSD_NBYT ECU_ADDRESS 0x3fab2d FORMAT "%6.2" /end MEASUREMENT
/begin MEASUREMENT ebsd_varin "" UBYTE _CNV_R_R_dez_498_CM 1 100. 0. 255. DISPLAY_IDENTIFIER EBSD_VARIN ECU_ADDRESS 0x3fab78 FORMAT "%6.2" /end MEASUREMENT
/begin MEASUREMENT ercntchksu "" UWORD _CNV_R_R_dez_498_CM 1 100. 0. 65535. DISPLAY_IDENTIFIER ERCNTCHKSU ECU_ADDRESS 0x3fab3a BYTE_ORDER MSB_LAST FORMAT "%6.2" /end MEASUREMENT
/begin MEASUREMENT ercntcksub "" UBYTE _CNV_R_R_dez_498_CM 1 100. 0. 255. DISPLAY_IDENTIFIER ERCNTCKSUB ECU_ADDRESS 0x3fab79 FORMAT "%6.2" /end MEASUREMENT
/begin MEASUREMENT ercntparib "" UBYTE _CNV_R_R_dez_498_CM 1 100. 0. 255. DISPLAY_IDENTIFIER ERCNTPARIB ECU_ADDRESS 0x3fab7a FORMAT "%6.2" /end MEASUREMENT
/begin MEASUREMENT ercntparit "" UWORD _CNV_R_R_dez_498_CM 1 100. 0. 65535. DISPLAY_IDENTIFIER ERCNTPARIT ECU_ADDRESS 0x3fab3c BYTE_ORDER MSB_LAST FORMAT "%6.2" /end MEASUREMENT
/begin MEASUREMENT ercntunteb "" UBYTE _CNV_R_R_dez_498_CM 1 100. 0. 255. DISPLAY_IDENTIFIER ERCNTUNTEB ECU_ADDRESS 0x3fab7b FORMAT "%6.2" /end MEASUREMENT
/begin MEASUREMENT ercntunter "" UWORD _CNV_R_R_dez_498_CM 1 100. 0. 65535. DISPLAY_IDENTIFIER ERCNTUNTER ECU_ADDRESS 0x3fab3e BYTE_ORDER MSB_LAST FORMAT "%6.2" /end MEASUREMENT
/begin MEASUREMENT ibatt_10 "" UWORD _CNV_R_R_dez_498_CM 1 100. 0. 65535. DISPLAY_IDENTIFIER IBATT_10 ECU_ADDRESS 0x3fab40 BYTE_ORDER MSB_LAST FORMAT "%6.2" /end MEASUREMENT
/begin MEASUREMENT ibatt_1000 "" UWORD _CNV_R_R_dez_498_CM 1 100. 0. 65535. DISPLAY_IDENTIFIER IBATT_1000 ECU_ADDRESS 0x3fab42 BYTE_ORDER MSB_LAST FORMAT "%6.2" /end MEASUREMENT
/begin MEASUREMENT ibatt_200 "" UWORD _CNV_R_R_dez_498_CM 1 100. 0. 65535. DISPLAY_IDENTIFIER IBATT_200 ECU_ADDRESS 0x3fab44 BYTE_ORDER MSB_LAST FORMAT "%6.2" /end MEASUREMENT
/begin MEASUREMENT ibatt_w "" UWORD _CNV_R_R_i_uw_q0p08_569_CM 1 100. -200. 5042.8 DISPLAY_IDENTIFIER IBATT_W ECU_ADDRESS 0x3fab46 BYTE_ORDER MSB_LAST FORMAT "%7.2" /end MEASUREMENT
/begin MEASUREMENT ibcntreseb "" UBYTE _CNV_R_R_dez_498_CM 1 100. 0. 255. DISPLAY_IDENTIFIER IBCNTRESEB ECU_ADDRESS 0x3fab7c FORMAT "%6.2" /end MEASUREMENT
/begin MEASUREMENT ibcntreset "" UWORD _CNV_R_R_dez_498_CM 1 100. 0. 65535. DISPLAY_IDENTIFIER IBCNTRESET ECU_ADDRESS 0x3fab48 BYTE_ORDER MSB_LAST FORMAT "%6.2" /end MEASUREMENT
/begin MEASUREMENT ibcntupdat "" UBYTE _CNV_R_R_dez_498_CM 1 100. 0. 255. DISPLAY_IDENTIFIER IBCNTUPDAT ECU_ADDRESS 0x3fab7d FORMAT "%6.2" /end MEASUREMENT
/begin MEASUREMENT ibhwversi "" UBYTE _CNV_R_R_dez_498_CM 1 100. 0. 255. DISPLAY_IDENTIFIER IBHWVERSI ECU_ADDRESS 0x3fab7e FORMAT "%6.2" /end MEASUREMENT
/begin MEASUREMENT ibswbase "" UBYTE _CNV_R_R_dez_498_CM 1 100. 0. 255. DISPLAY_IDENTIFIER IBSWBASE ECU_ADDRESS 0x3fab7f FORMAT "%6.2" /end MEASUREMENT
/begin MEASUREMENT ibswchang "" UBYTE _CNV_R_R_dez_498_CM 1 100. 0. 255. DISPLAY_IDENTIFIER IBSWCHANG ECU_ADDRESS 0x3fab80 FORMAT "%6.2" /end MEASUREMENT
/begin MEASUREMENT ibs_errors "" UBYTE _CNV_R_R_dez_498_CM 1 100. 0. 255. DISPLAY_IDENTIFIER IBS_ERRORS ECU_ADDRESS 0x3fab81 FORMAT "%6.2" /end MEASUREMENT
/begin MEASUREMENT ibs_msgind "" UBYTE _CNV_R_R_dez_498_CM 1 100. 0. 255. DISPLAY_IDENTIFIER IBS_MSGIND ECU_ADDRESS 0x3fab82 FORMAT "%6.2" /end MEASUREMENT
/begin MEASUREMENT ibs_msgrdy "" UBYTE _CNV_S_2_B_TRUE_530_CM 1 100. 0. 1. DISPLAY_IDENTIFIER IBS_MSGRDY ECU_ADDRESS 0x3fab34 BIT_MASK 0x1 /end MEASUREMENT
/begin MEASUREMENT ibs_msgsta "" UBYTE _CNV_R_R_dez_498_CM 1 100. 0. 255. DISPLAY_IDENTIFIER IBS_MSGSTA ECU_ADDRESS 0x3fab83 FORMAT "%6.2" /end MEASUREMENT
/begin MEASUREMENT ibs_msgwri "" UBYTE _CNV_S_2_B_TRUE_530_CM 1 100. 0. 1. DISPLAY_IDENTIFIER IBS_MSGWRI ECU_ADDRESS 0x3fab35 BIT_MASK 0x1 /end MEASUREMENT
/begin MEASUREMENT ibs_reg4 "" UBYTE _CNV_R_R_dez_498_CM 1 100. 0. 255. DISPLAY_IDENTIFIER IBS_REG4 ECU_ADDRESS 0x3fab84 FORMAT "%6.2" /end MEASUREMENT
/begin MEASUREMENT ibs_reg5 "" UBYTE _CNV_R_R_dez_498_CM 1 100. 0. 255. DISPLAY_IDENTIFIER IBS_REG5 ECU_ADDRESS 0x3fab85 FORMAT "%6.2" /end MEASUREMENT
/begin MEASUREMENT ibs_start "" UBYTE _CNV_R_R_dez_498_CM 1 100. 0. 255. DISPLAY_IDENTIFIER IBS_START ECU_ADDRESS 0x3fab86 FORMAT "%6.2" /end MEASUREMENT
/begin MEASUREMENT ib_chk16 "" UWORD _CNV_R_R_dez_498_CM 1 100. 0. 65535. DISPLAY_IDENTIFIER IB_CHK16 ECU_ADDRESS 0x3fab4a BYTE_ORDER MSB_LAST FORMAT "%6.2" /end MEASUREMENT
/begin MEASUREMENT ib_parlen "" UBYTE _CNV_R_R_dez_498_CM 1 100. 0. 255. DISPLAY_IDENTIFIER IB_PARLEN ECU_ADDRESS 0x3fab87 FORMAT "%6.2" /end MEASUREMENT
/begin MEASUREMENT isoc0 "" UWORD _CNV_R_R_i_uw_q0p02_570_CM 1 100. -200. 1110.7 DISPLAY_IDENTIFIER ISOC0 ECU_ADDRESS 0x3fab4c BYTE_ORDER MSB_LAST FORMAT "%6.1" /end MEASUREMENT
/begin MEASUREMENT itnstart "" UWORD _CNV_R_R_i_ub_q0p02_571_CM 1 100. 0. 1310.7 DISPLAY_IDENTIFIER ITNSTART ECU_ADDRESS 0x3fab4e BYTE_ORDER MSB_LAST FORMAT "%7.4" /end MEASUREMENT
/begin MEASUREMENT ivorstart "" UWORD _CNV_R_R_i_uw_q0p02_570_CM 1 100. -200. 1110.7 DISPLAY_IDENTIFIER IVORSTART ECU_ADDRESS 0x3fab50 BYTE_ORDER MSB_LAST FORMAT "%6.1" /end MEASUREMENT
/begin MEASUREMENT ktib_chk16 "" UWORD _CNV_R_R_dez_498_CM 1 100. 0. 65535. DISPLAY_IDENTIFIER KTIB_CHK16 ECU_ADDRESS 0x3fab52 BYTE_ORDER MSB_LAST FORMAT "%6.2" /end MEASUREMENT
/begin MEASUREMENT kt_IbsStatus "" UBYTE _CNV_R_R_dez_498_CM 1 100. 0. 255. DISPLAY_IDENTIFIER KT_IBSSTATUS ECU_ADDRESS 0x3fab88 FORMAT "%6.2" /end MEASUREMENT
/begin MEASUREMENT kt_OldIbsStatus "" UBYTE _CNV_R_R_dez_498_CM 1 100. 0. 255. DISPLAY_IDENTIFIER KT_OLDIBSSTATUS ECU_ADDRESS 0x3fab89 FORMAT "%6.2" /end MEASUREMENT
/begin MEASUREMENT qelad "" UWORD _CNV_R_R_qlad_uw_q0_572_CM 1 100. 0. 1193.03 DISPLAY_IDENTIFIER QELAD ECU_ADDRESS 0x3fab54 BYTE_ORDER MSB_LAST FORMAT "%6.4" /end MEASUREMENT
/begin MEASUREMENT qeladsoc0 "" UWORD _CNV_R_R_qlad_uw_q0_572_CM 1 100. 0. 1193.03 DISPLAY_IDENTIFIER QELADSOC0 ECU_ADDRESS 0x3fab56 BYTE_ORDER MSB_LAST FORMAT "%6.4" /end MEASUREMENT
/begin MEASUREMENT qlad "" UWORD _CNV_R_R_qlad_uw_q0_572_CM 1 100. 0. 1193.03 DISPLAY_IDENTIFIER QLAD ECU_ADDRESS 0x3fab58 BYTE_ORDER MSB_LAST FORMAT "%6.4" /end MEASUREMENT
/begin MEASUREMENT qladsoc0 "" UWORD _CNV_R_R_qlad_uw_q0_572_CM 1 100. 0. 1193.03 DISPLAY_IDENTIFIER QLADSOC0 ECU_ADDRESS 0x3fab5a BYTE_ORDER MSB_LAST FORMAT "%6.4" /end MEASUREMENT
/begin MEASUREMENT t1histiruh "" UWORD _CNV_R_R_dez_498_CM 1 100. 0. 65535. DISPLAY_IDENTIFIER T1HISTIRUH ECU_ADDRESS 0x3fab5c BYTE_ORDER MSB_LAST FORMAT "%6.2" /end MEASUREMENT
/begin MEASUREMENT t2histiruh "" UWORD _CNV_R_R_dez_498_CM 1 100. 0. 65535. DISPLAY_IDENTIFIER T2HISTIRUH ECU_ADDRESS 0x3fab5e BYTE_ORDER MSB_LAST FORMAT "%6.2" /end MEASUREMENT
/begin MEASUREMENT t3histiruh "" UWORD _CNV_R_R_dez_498_CM 1 100. 0. 65535. DISPLAY_IDENTIFIER T3HISTIRUH ECU_ADDRESS 0x3fab60 BYTE_ORDER MSB_LAST FORMAT "%6.2" /end MEASUREMENT
/begin MEASUREMENT t4histiruh "" UWORD _CNV_R_R_dez_498_CM 1 100. 0. 65535. DISPLAY_IDENTIFIER T4HISTIRUH ECU_ADDRESS 0x3fab62 BYTE_ORDER MSB_LAST FORMAT "%6.2" /end MEASUREMENT
/begin MEASUREMENT tbatt "" UBYTE _CNV_R_R_temp_uw_q0_525_CM 1 100. -48. 143.25 DISPLAY_IDENTIFIER TBATT ECU_ADDRESS 0x3faa4c FORMAT "%6.2" /end MEASUREMENT
/begin MEASUREMENT tbattroh "" UWORD _CNV_R_R_dez_498_CM 1 100. 0. 65535. DISPLAY_IDENTIFIER TBATTROH ECU_ADDRESS 0x3fab64 BYTE_ORDER MSB_LAST FORMAT "%6.2" /end MEASUREMENT
/begin MEASUREMENT tbattsoc0 "" UBYTE _CNV_R_R_temp_uw_q0_525_CM 1 100. -48. 143.25 DISPLAY_IDENTIFIER TBATTSOC0 ECU_ADDRESS 0x3fab8a FORMAT "%6.2" /end MEASUREMENT
/begin MEASUREMENT tbatt_max "" UBYTE _CNV_R_R_temp_uw_q0_525_CM 1 100. -48. 143.25 DISPLAY_IDENTIFIER TBATT_MAX ECU_ADDRESS 0x3fab8b FORMAT "%6.2" /end MEASUREMENT
/begin MEASUREMENT tbatt_maxi "" UBYTE _CNV_R_R_dez_498_CM 1 100. 0. 255. DISPLAY_IDENTIFIER TBATT_MAXI ECU_ADDRESS 0x3fab8c FORMAT "%6.2" /end MEASUREMENT
/begin MEASUREMENT tbatt_min "" UBYTE _CNV_R_R_temp_uw_q0_525_CM 1 100. -48. 143.25 DISPLAY_IDENTIFIER TBATT_MIN ECU_ADDRESS 0x3fab8d FORMAT "%6.2" /end MEASUREMENT
/begin MEASUREMENT tbatt_mini "" UBYTE _CNV_R_R_dez_498_CM 1 100. 0. 255. DISPLAY_IDENTIFIER TBATT_MINI ECU_ADDRESS 0x3fab8e FORMAT "%6.2" /end MEASUREMENT
/begin MEASUREMENT tbatt_tmp "" UBYTE _CNV_R_R_dez_498_CM 1 100. 0. 255. DISPLAY_IDENTIFIER TBATT_TMP ECU_ADDRESS 0x3fab8f FORMAT "%6.2" /end MEASUREMENT
/begin MEASUREMENT u1soc0 "" UWORD _CNV_R_R_spg_uw_q0p_573_CM 1 100. 6. 22.3837 DISPLAY_IDENTIFIER U1SOC0 ECU_ADDRESS 0x3fab66 BYTE_ORDER MSB_LAST FORMAT "%9.5" /end MEASUREMENT
/begin MEASUREMENT u2soc0 "" UWORD _CNV_R_R_spg_uw_q0p_573_CM 1 100. 6. 22.3837 DISPLAY_IDENTIFIER U2SOC0 ECU_ADDRESS 0x3fab68 BYTE_ORDER MSB_LAST FORMAT "%9.5" /end MEASUREMENT
/begin MEASUREMENT u3soc0 "" UWORD _CNV_R_R_spg_uw_q0p_573_CM 1 100. 6. 22.3837 DISPLAY_IDENTIFIER U3SOC0 ECU_ADDRESS 0x3fab6a BYTE_ORDER MSB_LAST FORMAT "%9.5" /end MEASUREMENT
/begin MEASUREMENT ubatthiroh "" UWORD _CNV_R_R_dez_498_CM 1 100. 0. 65535. DISPLAY_IDENTIFIER UBATTHIROH ECU_ADDRESS 0x3fab6c BYTE_ORDER MSB_LAST FORMAT "%6.2" /end MEASUREMENT
/begin MEASUREMENT ubattloroh "" UWORD _CNV_R_R_dez_498_CM 1 100. 0. 65535. DISPLAY_IDENTIFIER UBATTLOROH ECU_ADDRESS 0x3fab6e BYTE_ORDER MSB_LAST FORMAT "%6.2" /end MEASUREMENT
/begin MEASUREMENT ubatt_w "" UWORD _CNV_R_R_spg_uw_q0p_573_CM 1 100. 6. 22.3837 DISPLAY_IDENTIFIER UBATT_W ECU_ADDRESS 0x3fab70 BYTE_ORDER MSB_LAST FORMAT "%9.5" /end MEASUREMENT
/begin MEASUREMENT unind "" UBYTE _CNV_R_R_dez_498_CM 1 100. 0. 255. DISPLAY_IDENTIFIER UNIND ECU_ADDRESS 0x3fab90 FORMAT "%6.2" /end MEASUREMENT
/begin MEASUREMENT utnstart "" UWORD _CNV_R_R_spg_uw_q0p_573_CM 1 100. 6. 22.3837 DISPLAY_IDENTIFIER UTNSTART ECU_ADDRESS 0x3fab72 BYTE_ORDER MSB_LAST FORMAT "%9.5" /end MEASUREMENT
/begin MEASUREMENT uvorstart "" UWORD _CNV_R_R_spg_uw_q0p_573_CM 1 100. 6. 22.3837 DISPLAY_IDENTIFIER UVORSTART ECU_ADDRESS 0x3fab74 BYTE_ORDER MSB_LAST FORMAT "%9.5" /end MEASUREMENT
/begin CHARACTERISTIC ENABSDIBS "" VALUE 0x1a082 _REC_VAL_20_u1 255. _CNV_R_R_dez_498_CM 0. 255. FORMAT "%6.2" /end CHARACTERISTIC
/begin CHARACTERISTIC ENISOC0 "" VALUE 0x1a083 _REC_VAL_20_u1 255. _CNV_R_R_dez_498_CM 0. 255. FORMAT "%6.2" /end CHARACTERISTIC
/begin CHARACTERISTIC ENUSOC0 "" VALUE 0x1a084 _REC_VAL_20_u1 255. _CNV_R_R_dez_498_CM 0. 255. FORMAT "%6.2" /end CHARACTERISTIC
/begin CHARACTERISTIC ERREPEAT "" VALUE 0x1a085 _REC_VAL_20_u1 255. _CNV_R_R_dez_498_CM 0. 255. FORMAT "%6.2" /end CHARACTERISTIC
/begin CHARACTERISTIC IBSTSTERR "" VALUE 0x1a086 _REC_VAL_20_u1 255. _CNV_R_R_dez_498_CM 0. 255. FORMAT "%6.2" /end CHARACTERISTIC
/begin CHARACTERISTIC IBSVERSION "" VAL_BLK 0x1b839 _REC_VAL_2_u1 255. _CNV_R_R_dez_498_CM 0. 255. FORMAT "%6.2" NUMBER 16 /end CHARACTERISTIC
/begin CHARACTERISTIC IBUNPLADEL "" VALUE 0x1a087 _REC_VAL_20_u1 255. _CNV_R_R_dez_498_CM 0. 255. FORMAT "%6.2" /end CHARACTERISTIC
/begin CHARACTERISTIC ISLEEPGRZ "" VALUE 0x1a088 _REC_VAL_20_u1 255. _CNV_R_R_dez_498_CM 0. 255. FORMAT "%6.2" /end CHARACTERISTIC
/begin CHARACTERISTIC ISTARTTRIG "" VALUE 0x1a089 _REC_VAL_20_u1 255. _CNV_R_R_dez_498_CM 0. 255. FORMAT "%6.2" /end CHARACTERISTIC
/begin CHARACTERISTIC IWAKEUPGRZ "" VALUE 0x1a08a _REC_VAL_20_u1 255. _CNV_R_R_dez_498_CM 0. 255. FORMAT "%6.2" /end CHARACTERISTIC
/begin CHARACTERISTIC KLIBSTEMP1 "" CURVE 0x1b82e _REC_CUR_32_u1_u1 191.3 _CNV_R_R_temp_uw_q0_525_CM -48. 143.3 FORMAT "%6.2"
 /begin AXIS_DESCR STD_AXIS tbatt_tmp _CNV_R_R_dez_498_CM 5 0. 255. FORMAT "%6.2" /end AXIS_DESCR
/end CHARACTERISTIC
/begin CHARACTERISTIC T1SCHWELLE "" VALUE 0x1a08b _REC_VAL_20_u1 255. _CNV_R_R_dez_498_CM 0. 255. FORMAT "%6.2" /end CHARACTERISTIC
/begin CHARACTERISTIC T1SOC0 "" VALUE 0x1a08c _REC_VAL_20_u1 255. _CNV_R_R_dez_498_CM 0. 255. FORMAT "%6.2" /end CHARACTERISTIC
/begin CHARACTERISTIC T2SCHWELLE "" VALUE 0x1a08d _REC_VAL_20_u1 255. _CNV_R_R_dez_498_CM 0. 255. FORMAT "%6.2" /end CHARACTERISTIC
/begin CHARACTERISTIC T2SOC0 "" VALUE 0x1a08e _REC_VAL_20_u1 255. _CNV_R_R_dez_498_CM 0. 255. FORMAT "%6.2" /end CHARACTERISTIC
/begin CHARACTERISTIC T3SCHWELLE "" VALUE 0x1a08f _REC_VAL_20_u1 255. _CNV_R_R_dez_498_CM 0. 255. FORMAT "%6.2" /end CHARACTERISTIC
/begin CHARACTERISTIC T3SOC0 "" VALUE 0x1a090 _REC_VAL_20_u1 255. _CNV_R_R_dez_498_CM 0. 255. FORMAT "%6.2" /end CHARACTERISTIC
/begin CHARACTERISTIC TNUSTART "" VALUE 0x1a091 _REC_VAL_20_u1 255. _CNV_R_R_dez_498_CM 0. 255. FORMAT "%6.2" /end CHARACTERISTIC
/begin CHARACTERISTIC TNUSTARTFL "" VALUE 0x1a092 _REC_VAL_20_u1 255. _CNV_R_R_dez_498_CM 0. 255. FORMAT "%6.2" /end CHARACTERISTIC
/begin CHARACTERISTIC TPT1TICO "" VALUE 0x1b84a _REC_VAL_20_u2 65535. _CNV_R_R_dez_498_CM 0. 65535. FORMAT "%6.2" /end CHARACTERISTIC
/begin CHARACTERISTIC TPT1USTFGK "" VALUE 0x1a093 _REC_VAL_20_u1 255. _CNV_R_R_dez_498_CM 0. 255. FORMAT "%6.2" /end CHARACTERISTIC
/begin CHARACTERISTIC TSLEEPRUH "" VALUE 0x1a094 _REC_VAL_20_u1 255. _CNV_R_R_dez_498_CM 0. 255. FORMAT "%6.2" /end CHARACTERISTIC
/begin CHARACTERISTIC TUPT1SOC0 "" VALUE 0x1a095 _REC_VAL_20_u1 255. _CNV_R_R_dez_498_CM 0. 255. FORMAT "%6.2" /end CHARACTERISTIC
/begin CHARACTERISTIC USOC0GRENZ "" VALUE 0x1a096 _REC_VAL_20_u1 255. _CNV_R_R_dez_498_CM 0. 255. FORMAT "%6.2" /end CHARACTERISTIC
/begin MEASUREMENT B_ifbsa7 "" UBYTE _CNV_A_R_LINEAR_____22_CM 1 100. 0. 255. DISPLAY_IDENTIFIER B_IFBSA7 ECU_ADDRESS 0x3fabaa BIT_MASK 0x1 /end MEASUREMENT
/begin MEASUREMENT B_ifupla7 "" UBYTE _CNV_A_R_LINEAR_____22_CM 1 100. 0. 255. DISPLAY_IDENTIFIER B_IFUPLA7 ECU_ADDRESS 0x3fabab BIT_MASK 0x1 /end MEASUREMENT
/begin MEASUREMENT n_idlibs "Leerlaufdrehzahlvorgabe von LC-Powermanagement" UBYTE _CNV_R_R_dez_498_CM 1 100. 0. 255. DISPLAY_IDENTIFIER N_IDLIBS ECU_ADDRESS 0x3fabac FORMAT "%8.4" /end MEASUREMENT
/begin CHARACTERISTIC B_IFBSAKAP "Appl-para. für Bedingung Fehler vom BSD" VALUE 0x1b85c _REC_VAL_20_u1 0. _CNV_R_R_dez_498_CM 0. 255. FORMAT "%8.4" /end CHARACTERISTIC
/begin CHARACTERISTIC B_IFUPLAAP "Apll-par. für Bedg. Fehler vom IBS" VALUE 0x1b85d _REC_VAL_20_u1 0. _CNV_R_R_dez_498_CM 0. 255. FORMAT "%8.4" /end CHARACTERISTIC
/begin CHARACTERISTIC DFLLMIN "DF unterhalb derer die LLDZanh. zurueckgenommen wird." VALUE 0x1b85e _REC_VAL_20_u1 0. _CNV_R_R_rel_ub_b10_522_CM 0. 100. FORMAT "%8.4" /end CHARACTERISTIC
/begin CHARACTERISTIC DSOCLLANH "Delta zur Startfaehigkeitsgrenze, bei der die LLDZanh aktiviert wird." VALUE 0x1b858 _REC_VAL_20_u2 0. _CNV_R_R_fak_q0p004_574_CM 0. 100. FORMAT "%8.4" /end CHARACTERISTIC
/begin CHARACTERISTIC LLANHAPP "LLDZanh.-level, falls Generator fehlerhaft ist." VALUE 0x1b85f _REC_VAL_20_u1 0. _CNV_R_R_dez_498_CM 0. 255. FORMAT "%8.4" /end CHARACTERISTIC
/begin CHARACTERISTIC LLPMAPP "Handapplikationswert von Leerlaufdrehzahlvorgabe von LC-Powermanagement, aktiviert durch S_N_IDLIBS" VALUE 0x1b860 _REC_VAL_20_u1 0. _CNV_R_R_dez_498_CM 0. 255. FORMAT "%8.4" /end CHARACTERISTIC
/begin CHARACTERISTIC NLLMIN "Motordrehzahl unterhalb derer die LLDZanh. zurueckgenommen wird." VALUE 0x1b85a _REC_VAL_20_u2 0. _CNV_R_R_nmot_uw_q0_575_CM 0. 10000. FORMAT "%8.4" /end CHARACTERISTIC
/begin CHARACTERISTIC S_B_IFBSAK "manueller Schalter für Fehler BSD" VALUE 0x1b861 _REC_VAL_20_u1 0. _CNV_R_R_dez_498_CM 0. 255. FORMAT "%8.4" /end CHARACTERISTIC
/begin CHARACTERISTIC S_B_IFPLAK "manueller Schalter für Fehler IBS" VALUE 0x1b862 _REC_VAL_20_u1 0. _CNV_R_R_dez_498_CM 0. 255. FORMAT "%8.4" /end CHARACTERISTIC
/begin CHARACTERISTIC S_N_IDLIBS "Schalter zum manuellen Setzen von LL aktiv" VALUE 0x1b863 _REC_VAL_20_u1 0. _CNV_R_R_dez_498_CM 0. 255. FORMAT "%8.4" /end CHARACTERISTIC
/begin MEASUREMENT all2ptc "" UWORD _CNV_R_R_fak_uw_q0p_576_CM 1 100. -500. 550. DISPLAY_IDENTIFIER ALL2PTC ECU_ADDRESS 0x3fabc2 BYTE_ORDER MSB_LAST FORMAT "%9.5" /end MEASUREMENT
/begin MEASUREMENT allptcfilt "" UWORD _CNV_R_R_fak_uw_q0p_576_CM 1 100. 0. 550. DISPLAY_IDENTIFIER ALLPTCFILT ECU_ADDRESS 0x3fabc4 BYTE_ORDER MSB_LAST FORMAT "%9.3" /end MEASUREMENT
/begin MEASUREMENT B_dubt "" UBYTE _CNV_S_2_B_TRUE_530_CM 1 100. 0. 1. DISPLAY_IDENTIFIER B_DUBT ECU_ADDRESS 0x3fabb0 /end MEASUREMENT
/begin MEASUREMENT B_enwake7 "" UBYTE _CNV_S_2_B_TRUE_530_CM 1 100. 0. 1. DISPLAY_IDENTIFIER B_ENWAKE7 ECU_ADDRESS 0x3fabb1 /end MEASUREMENT
/begin MEASUREMENT B_enwakeup "" UBYTE _CNV_S_2_B_TRUE_530_CM 1 100. 0. 1. DISPLAY_IDENTIFIER B_ENWAKEUP ECU_ADDRESS 0x3fabb2 /end MEASUREMENT
/begin MEASUREMENT B_ibsakt7 "" UBYTE _CNV_S_2_B_TRUE_530_CM 1 100. 0. 1. DISPLAY_IDENTIFIER B_IBSAKT7 ECU_ADDRESS 0x3fabb3 /end MEASUREMENT
/begin MEASUREMENT B_ifbsak7 "" UBYTE _CNV_S_2_B_TRUE_530_CM 1 100. 0. 1. DISPLAY_IDENTIFIER B_IFBSAK7 ECU_ADDRESS 0x3fabb4 /end MEASUREMENT
/begin MEASUREMENT B_ifuplak7 "" UBYTE _CNV_S_2_B_TRUE_530_CM 1 100. 0. 1. DISPLAY_IDENTIFIER B_IFUPLAK7 ECU_ADDRESS 0x3fabb5 /end MEASUREMENT
/begin MEASUREMENT B_kl15_old "" UBYTE _CNV_S_2_B_TRUE_530_CM 1 100. 0. 1. DISPLAY_IDENTIFIER B_KL15_OLD ECU_ADDRESS 0x3fabb6 /end MEASUREMENT
/begin MEASUREMENT B_moteasy "" UBYTE _CNV_S_2_B_TRUE_530_CM 1 100. 0. 1. DISPLAY_IDENTIFIER B_MOTEASY ECU_ADDRESS 0x3fabb7 /end MEASUREMENT
/begin MEASUREMENT B_motover "" UBYTE _CNV_S_2_B_TRUE_530_CM 1 100. 0. 1. DISPLAY_IDENTIFIER B_MOTOVER ECU_ADDRESS 0x3fabb8 /end MEASUREMENT
/begin MEASUREMENT B_notlauf "" UBYTE _CNV_S_2_B_TRUE_530_CM 1 100. 0. 1. DISPLAY_IDENTIFIER B_NOTLAUF ECU_ADDRESS 0x3fabb9 /end MEASUREMENT
/begin MEASUREMENT B_pcoschg7 "" UBYTE _CNV_S_2_B_TRUE_530_CM 1 100. 0. 1. DISPLAY_IDENTIFIER B_PCOSCHG7 ECU_ADDRESS 0x3fabba /end MEASUREMENT
/begin MEASUREMENT B_PIReset "" UBYTE _CNV_S_2_B_TRUE_530_CM 1 100. 0. 1. DISPLAY_IDENTIFIER B_PIRESET ECU_ADDRESS 0x3fabbb /end MEASUREMENT
/begin MEASUREMENT B_pmbsdanf "" UBYTE _CNV_S_2_B_TRUE_530_CM 1 100. 0. 1. DISPLAY_IDENTIFIER B_PMBSDANF ECU_ADDRESS 0x3fabbc /end MEASUREMENT
/begin MEASUREMENT B_pmvsdanf "" UBYTE _CNV_S_2_B_TRUE_530_CM 1 100. 0. 1. DISPLAY_IDENTIFIER B_PMVSDANF ECU_ADDRESS 0x3fabbd /end MEASUREMENT
/begin MEASUREMENT B_socnpl7 "" UBYTE _CNV_S_2_B_TRUE_530_CM 1 100. 0. 1. DISPLAY_IDENTIFIER B_SOCNPL7 ECU_ADDRESS 0x3fabbe /end MEASUREMENT
/begin MEASUREMENT B_ubtlow "" UBYTE _CNV_S_2_B_TRUE_530_CM 1 100. 0. 1. DISPLAY_IDENTIFIER B_UBTLOW ECU_ADDRESS 0x3fabbf /end MEASUREMENT
/begin MEASUREMENT B_uloreset "" UBYTE _CNV_S_2_B_TRUE_530_CM 1 100. 0. 1. DISPLAY_IDENTIFIER B_ULORESET ECU_ADDRESS 0x3fabc0 /end MEASUREMENT
/begin MEASUREMENT cbattnenn "" UBYTE _CNV_R_R_cbatt_ub_b_577_CM 1 100. 1. 255. DISPLAY_IDENTIFIER CBATTNENN ECU_ADDRESS 0x3fac28 FORMAT "%7.3" /end MEASUREMENT
/begin MEASUREMENT cbattnenn7 "" UBYTE _CNV_R_R_cbatt_ub_b_577_CM 1 100. 1. 255. DISPLAY_IDENTIFIER CBATTNENN7 ECU_ADDRESS 0x3fac29 FORMAT "%7.3" /end MEASUREMENT
/begin MEASUREMENT cfallpi "" UWORD _CNV_R_R_fak_uw_q0p_576_CM 1 100. 0. 150. DISPLAY_IDENTIFIER CFALLPI ECU_ADDRESS 0x3fabc6 BYTE_ORDER MSB_LAST FORMAT "%9.5" /end MEASUREMENT
/begin MEASUREMENT ctrcbr "" UBYTE _CNV_R_R_dez_498_CM 1 100. 0. 255. DISPLAY_IDENTIFIER CTRCBR ECU_ADDRESS 0x3fac2a FORMAT "%5.1" /end MEASUREMENT
/begin MEASUREMENT ctrcbr7 "" UBYTE _CNV_R_R_dez_498_CM 1 100. 0. 255. DISPLAY_IDENTIFIER CTRCBR7 ECU_ADDRESS 0x3fac2b FORMAT "%5.1" /end MEASUREMENT
/begin MEASUREMENT ctrcbrmem "" UBYTE _CNV_R_R_dez_498_CM 1 100. 0. 255. DISPLAY_IDENTIFIER CTRCBRMEM ECU_ADDRESS 0x3fac2c FORMAT "%5.1" /end MEASUREMENT
/begin MEASUREMENT ctrpcos "" UBYTE _CNV_R_R_dez_498_CM 1 100. 0. 3. DISPLAY_IDENTIFIER CTRPCOS ECU_ADDRESS 0x3facc5 FORMAT "%5.3" /end MEASUREMENT
/begin MEASUREMENT ctrpcos7 "" UBYTE _CNV_R_R_dez_498_CM 1 100. 0. 3. DISPLAY_IDENTIFIER CTRPCOS7 ECU_ADDRESS 0x3fac2d FORMAT "%5.3" /end MEASUREMENT
/begin MEASUREMENT ctrpcosmem "" UBYTE _CNV_R_R_dez_498_CM 1 100. 0. 3. DISPLAY_IDENTIFIER CTRPCOSMEM ECU_ADDRESS 0x3fac2e FORMAT "%5.3" /end MEASUREMENT
/begin MEASUREMENT ctrprio "" UBYTE _CNV_R_R_dez_498_CM 1 100. 0. 7. DISPLAY_IDENTIFIER CTRPRIO ECU_ADDRESS 0x3fac2f FORMAT "%5.3" /end MEASUREMENT
/begin MEASUREMENT ctrprio7 "" UBYTE _CNV_R_R_dez_498_CM 1 100. 0. 7. DISPLAY_IDENTIFIER CTRPRIO7 ECU_ADDRESS 0x3fac30 FORMAT "%5.3" /end MEASUREMENT
/begin MEASUREMENT ctrpriocf "" UBYTE _CNV_R_R_dez_498_CM 1 100. 0. 7. DISPLAY_IDENTIFIER CTRPRIOCF ECU_ADDRESS 0x3fac31 FORMAT "%5.3" /end MEASUREMENT
/begin MEASUREMENT ctrpriocf7 "" UBYTE _CNV_R_R_dez_498_CM 1 100. 0. 7. DISPLAY_IDENTIFIER CTRPRIOCF7 ECU_ADDRESS 0x3fac32 FORMAT "%5.3" /end MEASUREMENT
/begin MEASUREMENT ctrpriocfm "" UBYTE _CNV_R_R_dez_498_CM 1 100. 0. 7. DISPLAY_IDENTIFIER CTRPRIOCFM ECU_ADDRESS 0x3fac33 FORMAT "%5.3" /end MEASUREMENT
/begin MEASUREMENT ctrpriomem "" UBYTE _CNV_R_R_dez_498_CM 1 100. 0. 7. DISPLAY_IDENTIFIER CTRPRIOMEM ECU_ADDRESS 0x3fac34 FORMAT "%5.3" /end MEASUREMENT
/begin MEASUREMENT ctrpwrcf "" UWORD _CNV_R_R_dez_498_CM 1 100. 0. 65535. DISPLAY_IDENTIFIER CTRPWRCF ECU_ADDRESS 0x3fabc8 BYTE_ORDER MSB_LAST FORMAT "%8.2" /end MEASUREMENT
/begin MEASUREMENT ctrpwrcos "" UWORD _CNV_R_R_dez_498_CM 1 100. 0. 65535. DISPLAY_IDENTIFIER CTRPWRCOS ECU_ADDRESS 0x3fabca BYTE_ORDER MSB_LAST FORMAT "%8.2" /end MEASUREMENT
/begin MEASUREMENT ctrpwrcos7 "" UWORD _CNV_R_R_dez_498_CM 1 100. 0. 65535. DISPLAY_IDENTIFIER CTRPWRCOS7 ECU_ADDRESS 0x3fabcc BYTE_ORDER MSB_LAST FORMAT "%8.2" /end MEASUREMENT
/begin MEASUREMENT ctrpwrdf "" UWORD _CNV_R_R_dez_498_CM 1 100. 0. 65535. DISPLAY_IDENTIFIER CTRPWRDF ECU_ADDRESS 0x3fabce BYTE_ORDER MSB_LAST FORMAT "%8.2" /end MEASUREMENT
/begin MEASUREMENT ctrpwrmem "" UWORD _CNV_R_R_dez_498_CM 1 100. 0. 65535. DISPLAY_IDENTIFIER CTRPWRMEM ECU_ADDRESS 0x3fabd0 BYTE_ORDER MSB_LAST FORMAT "%8.2" /end MEASUREMENT
/begin MEASUREMENT ctrpwspcos "" UBYTE _CNV_R_R_fak_q0p5_578_CM 1 100. 0. 127.5 DISPLAY_IDENTIFIER CTRPWSPCOS ECU_ADDRESS 0x3fac35 FORMAT "%5.1" /end MEASUREMENT
/begin MEASUREMENT ctrpwspcs7 "" UBYTE _CNV_R_R_fak_q0p5_578_CM 1 100. 0. 127.5 DISPLAY_IDENTIFIER CTRPWSPCS7 ECU_ADDRESS 0x3fac36 FORMAT "%5.1" /end MEASUREMENT
/begin MEASUREMENT df2pi "" UWORD _CNV_R_R_fak_uw_q0p_576_CM 1 100. -100. 100. DISPLAY_IDENTIFIER DF2PI ECU_ADDRESS 0x3fabd2 BYTE_ORDER MSB_LAST FORMAT "%9.5" /end MEASUREMENT
/begin MEASUREMENT dfall2pi "" UWORD _CNV_R_R_fak_uw_q0p_576_CM 1 100. -500. 500. DISPLAY_IDENTIFIER DFALL2PI ECU_ADDRESS 0x3fabd4 BYTE_ORDER MSB_LAST FORMAT "%9.5" /end MEASUREMENT
/begin MEASUREMENT dfallpi "" UWORD _CNV_R_R_fak_uw_q0p_576_CM 1 100. 0. 450. DISPLAY_IDENTIFIER DFALLPI ECU_ADDRESS 0x3fabd6 BYTE_ORDER MSB_LAST FORMAT "%9.3" /end MEASUREMENT
/begin MEASUREMENT dffgen7 "" UBYTE _CNV_R_R_rel_ub_b10_522_CM 1 100. 0. 100. DISPLAY_IDENTIFIER DFFGEN7 ECU_ADDRESS 0x3fac37 FORMAT "%5.1" /end MEASUREMENT
/begin MEASUREMENT dff_filt7 "" UBYTE _CNV_R_R_rel_ub_b10_522_CM 1 100. 0. 100. DISPLAY_IDENTIFIER DFF_FILT7 ECU_ADDRESS 0x3fac38 FORMAT "%5.1" /end MEASUREMENT
/begin MEASUREMENT dfpi2ptc "" UWORD _CNV_R_R_fak_uw_q0p_576_CM 1 100. 0. 100. DISPLAY_IDENTIFIER DFPI2PTC ECU_ADDRESS 0x3fabd8 BYTE_ORDER MSB_LAST FORMAT "%9.5" /end MEASUREMENT
/begin MEASUREMENT dfpt1filt "" UBYTE _CNV_R_R_rel_ub_b10_522_CM 1 100. 0. 100. DISPLAY_IDENTIFIER DFPT1FILT ECU_ADDRESS 0x3fac3a /end MEASUREMENT
/begin MEASUREMENT dfpt1ptc "" UBYTE _CNV_R_R_rel_ub_b10_522_CM 1 100. 0. 100. DISPLAY_IDENTIFIER DFPT1PTC ECU_ADDRESS 0x3fac3b /end MEASUREMENT
/begin MEASUREMENT dfpt1_2ptc "" UWORD _CNV_R_R_fak_uw_q0p_576_CM 1 100. -100. 100. DISPLAY_IDENTIFIER DFPT1_2PTC ECU_ADDRESS 0x3fabda BYTE_ORDER MSB_LAST FORMAT "%9.5" /end MEASUREMENT
/begin MEASUREMENT dsoc2pi "" UWORD _CNV_R_R_fak_uw_q0p_576_CM 1 100. -150. 150. DISPLAY_IDENTIFIER DSOC2PI ECU_ADDRESS 0x3fabdc BYTE_ORDER MSB_LAST FORMAT "%9.5" /end MEASUREMENT
/begin MEASUREMENT dsoc2ptc "" UWORD _CNV_R_R_fak_uw_q0p_576_CM 1 100. -150. 150. DISPLAY_IDENTIFIER DSOC2PTC ECU_ADDRESS 0x3fabde BYTE_ORDER MSB_LAST FORMAT "%9.5" /end MEASUREMENT
/begin MEASUREMENT dsoc_old "" UWORD _CNV_R_R_fak_q0p004_574_CM 1 100. -100. 100. DISPLAY_IDENTIFIER DSOC_OLD ECU_ADDRESS 0x3fabe0 BYTE_ORDER MSB_LAST FORMAT "%7.3" /end MEASUREMENT
/begin MEASUREMENT ehz_pwloc2 "" UBYTE _CNV_R_R_rel_ub_b10_522_CM 1 100. 0. 100. DISPLAY_IDENTIFIER EHZ_PWLOC2 ECU_ADDRESS 0x3fac3c FORMAT "%5.1" /end MEASUREMENT
/begin MEASUREMENT hkw_iant2 "" SWORD _CNV_R_R_rel_ub_b10_522_CM 1 100. -100. 100. DISPLAY_IDENTIFIER HKW_IANT2 ECU_ADDRESS 0x3fabe2 BYTE_ORDER MSB_LAST FORMAT "%8.4" /end MEASUREMENT
/begin MEASUREMENT hkw_ki2 "" UWORD _CNV_R_R_fak_uw_q0p_579_CM 1 100. 0. 10. DISPLAY_IDENTIFIER HKW_KI2 ECU_ADDRESS 0x3fabe4 BYTE_ORDER MSB_LAST FORMAT "%8.5" /end MEASUREMENT
/begin MEASUREMENT hkw_kp2 "" UWORD _CNV_R_R_fak_uw_q0p_579_CM 1 100. 0. 10. DISPLAY_IDENTIFIER HKW_KP2 ECU_ADDRESS 0x3fabe6 BYTE_ORDER MSB_LAST FORMAT "%8.5" /end MEASUREMENT
/begin MEASUREMENT hkw_lpgv2 "" UBYTE _CNV_R_R_rel_ub_b10_522_CM 1 100. 0. 100. DISPLAY_IDENTIFIER HKW_LPGV2 ECU_ADDRESS 0x3fac3d FORMAT "%5.1" /end MEASUREMENT
/begin MEASUREMENT hkw_pant2 "" SWORD _CNV_R_R_rel_ub_b10_522_CM 1 100. -1000. 1000. DISPLAY_IDENTIFIER HKW_PANT2 ECU_ADDRESS 0x3fabe8 BYTE_ORDER MSB_LAST FORMAT "%8.3" /end MEASUREMENT
/begin MEASUREMENT hkw_pi2 "" SWORD _CNV_R_R_rel_ub_b10_522_CM 1 100. -2000. 2000. DISPLAY_IDENTIFIER HKW_PI2 ECU_ADDRESS 0x3fabea BYTE_ORDER MSB_LAST FORMAT "%8.3" /end MEASUREMENT
/begin MEASUREMENT hkw_rdiff2 "" UBYTE _CNV_R_R_rel_ub_b10_522_CM 1 100. 0. 100. DISPLAY_IDENTIFIER HKW_RDIFF2 ECU_ADDRESS 0x3fac3e FORMAT "%5.1" /end MEASUREMENT
/begin MEASUREMENT hkw_sel_i2 "" UBYTE _CNV_R_R_dez_498_CM 1 100. 0. 10. DISPLAY_IDENTIFIER HKW_SEL_I2 ECU_ADDRESS 0x3fac3f FORMAT "%5.2" /end MEASUREMENT
/begin MEASUREMENT hkw_sel_p2 "" UBYTE _CNV_R_R_dez_498_CM 1 100. 0. 10. DISPLAY_IDENTIFIER HKW_SEL_P2 ECU_ADDRESS 0x3fac40 FORMAT "%5.2" /end MEASUREMENT
/begin MEASUREMENT hkw_sv2 "" UBYTE _CNV_R_R_rel_ub_b10_522_CM 1 100. 0. 100. DISPLAY_IDENTIFIER HKW_SV2 ECU_ADDRESS 0x3fac41 FORMAT "%5.1" /end MEASUREMENT
/begin MEASUREMENT ibatt_w7 "" UWORD _CNV_R_R_i_uw_q0p08_569_CM 1 100. -200. 1000. DISPLAY_IDENTIFIER IBATT_W7 ECU_ADDRESS 0x3fabec BYTE_ORDER MSB_LAST FORMAT "%7.2" /end MEASUREMENT
/begin MEASUREMENT ibtdiff "" UWORD _CNV_R_R_i_uw_q0p08_569_CM 1 100. -200. 2000. DISPLAY_IDENTIFIER IBTDIFF ECU_ADDRESS 0x3fabee BYTE_ORDER MSB_LAST FORMAT "%7.2" /end MEASUREMENT
/begin MEASUREMENT ibtdiff2pi "" UWORD _CNV_R_R_fak_uw_q0p_576_CM 1 100. -100. 100. DISPLAY_IDENTIFIER IBTDIFF2PI ECU_ADDRESS 0x3fabf0 BYTE_ORDER MSB_LAST FORMAT "%9.5" /end MEASUREMENT
/begin MEASUREMENT ibtsoll "" UWORD _CNV_R_R_i_uw_q0p08_569_CM 1 100. -200. 1000. DISPLAY_IDENTIFIER IBTSOLL ECU_ADDRESS 0x3fabf2 BYTE_ORDER MSB_LAST FORMAT "%7.2" /end MEASUREMENT
/begin MEASUREMENT idiff2ptc "" UWORD _CNV_R_R_fak_uw_q0p_576_CM 1 100. -100. 100. DISPLAY_IDENTIFIER IDIFF2PTC ECU_ADDRESS 0x3fabf4 BYTE_ORDER MSB_LAST FORMAT "%9.5" /end MEASUREMENT
/begin MEASUREMENT igenrest "" UBYTE _CNV_R_R_dez_498_CM 1 100. 0. 255. DISPLAY_IDENTIFIER IGENREST ECU_ADDRESS 0x3fac42 FORMAT "%5.1" /end MEASUREMENT
/begin MEASUREMENT ikurzogrz7 "" UBYTE _CNV_R_R_i_ub_q5p12_580_CM 1 100. 0. 998.4 DISPLAY_IDENTIFIER IKURZOGRZ7 ECU_ADDRESS 0x3fac43 FORMAT "%5.0" /end MEASUREMENT
/begin MEASUREMENT ikurzugrz7 "" UBYTE _CNV_R_R_i_ub_q5p12_580_CM 1 100. 0. 998.4 DISPLAY_IDENTIFIER IKURZUGRZ7 ECU_ADDRESS 0x3fac44 FORMAT "%5.0" /end MEASUREMENT
/begin MEASUREMENT ikurz_ogrz "" UBYTE _CNV_R_R_i_ub_q5p12_580_CM 1 100. 0. 998.4 DISPLAY_IDENTIFIER IKURZ_OGRZ ECU_ADDRESS 0x3fac45 FORMAT "%5.0" /end MEASUREMENT
/begin MEASUREMENT ikurz_ugrz "" UBYTE _CNV_R_R_i_ub_q5p12_580_CM 1 100. 0. 998.4 DISPLAY_IDENTIFIER IKURZ_UGRZ ECU_ADDRESS 0x3fac46 FORMAT "%5.0" /end MEASUREMENT
/begin MEASUREMENT ind_priocf "" UBYTE _CNV_R_R_dez_498_CM 1 100. 0. 6. DISPLAY_IDENTIFIER IND_PRIOCF ECU_ADDRESS 0x3fac47 FORMAT "%5.3" /end MEASUREMENT
/begin MEASUREMENT ind_priodf "" UBYTE _CNV_R_R_dez_498_CM 1 100. 0. 6. DISPLAY_IDENTIFIER IND_PRIODF ECU_ADDRESS 0x3fac48 FORMAT "%5.3" /end MEASUREMENT
/begin MEASUREMENT ind_pwrcf "" UBYTE _CNV_R_R_dez_498_CM 1 100. 0. 6. DISPLAY_IDENTIFIER IND_PWRCF ECU_ADDRESS 0x3fac49 FORMAT "%5.3" /end MEASUREMENT
/begin MEASUREMENT ind_pwrcos "" UBYTE _CNV_R_R_dez_498_CM 1 100. 0. 13. DISPLAY_IDENTIFIER IND_PWRCOS ECU_ADDRESS 0x3fac4a FORMAT "%5.2" /end MEASUREMENT
/begin MEASUREMENT isoll "" UWORD _CNV_R_R_i_uw_q0p08_569_CM 1 100. -200. 1000. DISPLAY_IDENTIFIER ISOLL ECU_ADDRESS 0x3fabf6 BYTE_ORDER MSB_LAST FORMAT "%7.2" /end MEASUREMENT
/begin MEASUREMENT isolldiff "" UWORD _CNV_R_R_i_uw_q0p08_569_CM 1 100. -200. 1000. DISPLAY_IDENTIFIER ISOLLDIFF ECU_ADDRESS 0x3fabf8 BYTE_ORDER MSB_LAST FORMAT "%7.2" /end MEASUREMENT
/begin MEASUREMENT iwakegrz7 "" UBYTE _CNV_R_R_i_ub_q0p02_571_CM 1 100. 0. 4. DISPLAY_IDENTIFIER IWAKEGRZ7 ECU_ADDRESS 0x3fac4b FORMAT "%7.5" /end MEASUREMENT
/begin MEASUREMENT kbmcount "" UBYTE _CNV_R_R_t_q0p1_581_CM 1 100. 0. 25.5 DISPLAY_IDENTIFIER KBMCOUNT ECU_ADDRESS 0x3fac4d FORMAT "%5.2" /end MEASUREMENT
/begin MEASUREMENT mem "" UBYTE _CNV_R_R_fak_q0p5_578_CM 1 100. 0. 127.5 DISPLAY_IDENTIFIER MEM ECU_ADDRESS 0x3fac4e FORMAT "%5.1" /end MEASUREMENT
/begin MEASUREMENT memprio1 "" UWORD _CNV_R_R_fak_uw_b51_582_CM 1 100. 0. 511.992 DISPLAY_IDENTIFIER MEMPRIO1 ECU_ADDRESS 0x3fabfa BYTE_ORDER MSB_LAST FORMAT "%8.4" /end MEASUREMENT
/begin MEASUREMENT memprio2 "" UWORD _CNV_R_R_fak_uw_b51_582_CM 1 100. 0. 511.992 DISPLAY_IDENTIFIER MEMPRIO2 ECU_ADDRESS 0x3fabfc BYTE_ORDER MSB_LAST FORMAT "%8.4" /end MEASUREMENT
/begin MEASUREMENT mempriocf1 "" UWORD _CNV_R_R_fak_uw_b51_582_CM 1 100. 0. 511.992 DISPLAY_IDENTIFIER MEMPRIOCF1 ECU_ADDRESS 0x3fabfe BYTE_ORDER MSB_LAST FORMAT "%8.4" /end MEASUREMENT
/begin MEASUREMENT mempriocf2 "" UWORD _CNV_R_R_fak_uw_b51_582_CM 1 100. 0. 511.992 DISPLAY_IDENTIFIER MEMPRIOCF2 ECU_ADDRESS 0x3fac00 BYTE_ORDER MSB_LAST FORMAT "%8.4" /end MEASUREMENT
/begin MEASUREMENT memptc1 "" UWORD _CNV_R_R_fak_uw_b51_582_CM 1 100. 0. 511.992 DISPLAY_IDENTIFIER MEMPTC1 ECU_ADDRESS 0x3fac02 BYTE_ORDER MSB_LAST FORMAT "%8.4" /end MEASUREMENT
/begin MEASUREMENT memptc2 "" UWORD _CNV_R_R_fak_uw_b51_582_CM 1 100. 0. 511.992 DISPLAY_IDENTIFIER MEMPTC2 ECU_ADDRESS 0x3fac04 BYTE_ORDER MSB_LAST FORMAT "%8.4" /end MEASUREMENT
/begin MEASUREMENT pgen2ptc "" UWORD _CNV_R_R_fak_uw_q0p_576_CM 1 100. -100. 0. DISPLAY_IDENTIFIER PGEN2PTC ECU_ADDRESS 0x3fac06 BYTE_ORDER MSB_LAST FORMAT "%9.5" /end MEASUREMENT
/begin MEASUREMENT pgenrest "" UWORD _CNV_R_R_fak_q0p1_583_CM 1 100. 0. 6400. DISPLAY_IDENTIFIER PGENREST ECU_ADDRESS 0x3fac08 BYTE_ORDER MSB_LAST /end MEASUREMENT
/begin MEASUREMENT picntr "" UBYTE _CNV_R_R_t_q0p1_581_CM 1 100. 0. 25.5 DISPLAY_IDENTIFIER PICNTR ECU_ADDRESS 0x3fac4f FORMAT "%5.2" /end MEASUREMENT
/begin MEASUREMENT pmbscount "" UBYTE _CNV_R_R_dez_498_CM 1 100. 0. 255. DISPLAY_IDENTIFIER PMBSCOUNT ECU_ADDRESS 0x3fac50 FORMAT "%5.1" /end MEASUREMENT
/begin MEASUREMENT pmvscount "" UBYTE _CNV_R_R_dez_498_CM 1 100. 0. 255. DISPLAY_IDENTIFIER PMVSCOUNT ECU_ADDRESS 0x3fac51 FORMAT "%5.1" /end MEASUREMENT
/begin MEASUREMENT priocf_loc "" UBYTE _CNV_R_R_dez_498_CM 1 100. 0. 7. DISPLAY_IDENTIFIER PRIOCF_LOC ECU_ADDRESS 0x3fac52 FORMAT "%6.2" /end MEASUREMENT
/begin MEASUREMENT ptc_pwr "" UBYTE _CNV_R_R_fak_q0p5_578_CM 1 100. 0. 127.5 DISPLAY_IDENTIFIER PTC_PWR ECU_ADDRESS 0x3fac53 FORMAT "%5.1" /end MEASUREMENT
/begin MEASUREMENT ptc_pwr7 "" UBYTE _CNV_R_R_fak_q0p5_578_CM 1 100. 0. 127.5 DISPLAY_IDENTIFIER PTC_PWR7 ECU_ADDRESS 0x3fac54 FORMAT "%5.1" /end MEASUREMENT
/begin MEASUREMENT rqpcos "" UBYTE _CNV_R_R_dez_498_CM 1 100. 0. 3. DISPLAY_IDENTIFIER RQPCOS ECU_ADDRESS 0x3fac55 FORMAT "%5.3" /end MEASUREMENT
/begin MEASUREMENT rqpcos7 "" UBYTE _CNV_R_R_dez_498_CM 1 100. 0. 3. DISPLAY_IDENTIFIER RQPCOS7 ECU_ADDRESS 0x3fac56 FORMAT "%5.3" /end MEASUREMENT
/begin MEASUREMENT rqpcosmem "" UBYTE _CNV_R_R_dez_498_CM 1 100. 0. 3. DISPLAY_IDENTIFIER RQPCOSMEM ECU_ADDRESS 0x3fac57 FORMAT "%5.3" /end MEASUREMENT
/begin MEASUREMENT selspcos "" UBYTE _CNV_R_R_dez_498_CM 1 100. 0. 15. DISPLAY_IDENTIFIER SELSPCOS ECU_ADDRESS 0x3fac58 FORMAT "%5.2" /end MEASUREMENT
/begin MEASUREMENT selspcos7 "" UBYTE _CNV_R_R_dez_498_CM 1 100. 0. 15. DISPLAY_IDENTIFIER SELSPCOS7 ECU_ADDRESS 0x3fac59 FORMAT "%5.2" /end MEASUREMENT
/begin MEASUREMENT selspcosme "" UBYTE _CNV_R_R_dez_498_CM 1 100. 0. 15. DISPLAY_IDENTIFIER SELSPCOSME ECU_ADDRESS 0x3fac5a FORMAT "%5.2" /end MEASUREMENT
/begin MEASUREMENT stpcos "" UBYTE _CNV_R_R_dez_498_CM 1 100. 0. 3. DISPLAY_IDENTIFIER STPCOS ECU_ADDRESS 0x3fac5b FORMAT "%5.3" /end MEASUREMENT
/begin MEASUREMENT stpcos7 "" UBYTE _CNV_R_R_dez_498_CM 1 100. 0. 3. DISPLAY_IDENTIFIER STPCOS7 ECU_ADDRESS 0x3fac5c FORMAT "%5.3" /end MEASUREMENT
/begin MEASUREMENT stpcosmem "" UBYTE _CNV_R_R_dez_498_CM 1 100. 0. 3. DISPLAY_IDENTIFIER STPCOSMEM ECU_ADDRESS 0x3fac5d FORMAT "%5.3" /end MEASUREMENT
/begin MEASUREMENT tbatt7 "" UBYTE _CNV_R_R_temp_uw_q0_525_CM 1 100. -48. 125.25 DISPLAY_IDENTIFIER TBATT7 ECU_ADDRESS 0x3fac5e FORMAT "%6.2" /end MEASUREMENT
/begin MEASUREMENT ubatt_w7 "" UWORD _CNV_R_R_spg_uw_q0p_573_CM 1 100. 6. 16. DISPLAY_IDENTIFIER UBATT_W7 ECU_ADDRESS 0x3fac0a BYTE_ORDER MSB_LAST FORMAT "%9.6" /end MEASUREMENT
/begin MEASUREMENT ubdiff "" UWORD _CNV_R_R_spg_q0p977_584_CM 1 100. -32. 31.999 DISPLAY_IDENTIFIER UBDIFF ECU_ADDRESS 0x3fac0c BYTE_ORDER MSB_LAST FORMAT "%9.6" /end MEASUREMENT
/begin MEASUREMENT ubdiff2pi "" UWORD _CNV_R_R_fak_uw_q0p_576_CM 1 100. -100. 100. DISPLAY_IDENTIFIER UBDIFF2PI ECU_ADDRESS 0x3fac0e BYTE_ORDER MSB_LAST FORMAT "%9.5" /end MEASUREMENT
/begin MEASUREMENT ubdifffilt "" UWORD _CNV_R_R_spg_q0p977_584_CM 1 100. -32. 31.999 DISPLAY_IDENTIFIER UBDIFFFILT ECU_ADDRESS 0x3fac10 BYTE_ORDER MSB_LAST FORMAT "%9.4" /end MEASUREMENT
/begin MEASUREMENT ubdiffptc "" UWORD _CNV_R_R_spg_q0p977_584_CM 1 100. -32. 31.999 DISPLAY_IDENTIFIER UBDIFFPTC ECU_ADDRESS 0x3fac12 BYTE_ORDER MSB_LAST FORMAT "%9.6" /end MEASUREMENT
/begin MEASUREMENT ubt "" UWORD _CNV_R_R_spg_uw_q0p_585_CM 1 100. 0. 61.425 DISPLAY_IDENTIFIER UBT ECU_ADDRESS 0x3fac14 BYTE_ORDER MSB_LAST FORMAT "%9.6" /end MEASUREMENT
/begin MEASUREMENT ubt7 "" UWORD _CNV_R_R_spg_uw_q0p_585_CM 1 100. 0. 61.425 DISPLAY_IDENTIFIER UBT7 ECU_ADDRESS 0x3fac16 BYTE_ORDER MSB_LAST FORMAT "%9.6" /end MEASUREMENT
/begin MEASUREMENT ubt7mem "" UWORD _CNV_R_R_spg_uw_q0p_586_CM 1 100. -61.425 61.425 DISPLAY_IDENTIFIER UBT7MEM ECU_ADDRESS 0x3fac18 BYTE_ORDER MSB_LAST FORMAT "%9.6" /end MEASUREMENT
/begin MEASUREMENT ubt7old "" UWORD _CNV_R_R_spg_uw_q0p_585_CM 1 100. 0. 61.425 DISPLAY_IDENTIFIER UBT7OLD ECU_ADDRESS 0x3fac1a BYTE_ORDER MSB_LAST FORMAT "%9.6" /end MEASUREMENT
/begin MEASUREMENT ubtpt12ptc "" UWORD _CNV_R_R_fak_uw_q0p_576_CM 1 100. -100. 100. DISPLAY_IDENTIFIER UBTPT12PTC ECU_ADDRESS 0x3fac1c BYTE_ORDER MSB_LAST FORMAT "%9.5" /end MEASUREMENT
/begin MEASUREMENT ubtpt1ptc "" UWORD _CNV_R_R_spg_q0p977_584_CM 1 100. -32. 31.999 DISPLAY_IDENTIFIER UBTPT1PTC ECU_ADDRESS 0x3fac1e BYTE_ORDER MSB_LAST FORMAT "%9.4" /end MEASUREMENT
/begin MEASUREMENT udeltaabsc "" ULONG _CNV_R_R_spg_uw_q0p_585_CM 1 100. 0. 61.425 DISPLAY_IDENTIFIER UDELTAABSC ECU_ADDRESS 0x3fac24 BYTE_ORDER MSB_LAST FORMAT "%9.6" /end MEASUREMENT
/begin MEASUREMENT udeltac "" UWORD _CNV_R_R_spg_uw_q0p_586_CM 1 100. -491.505 491.52 DISPLAY_IDENTIFIER UDELTAC ECU_ADDRESS 0x3fac20 BYTE_ORDER MSB_LAST FORMAT "%9.5" /end MEASUREMENT
/begin MEASUREMENT ulev "" UBYTE _CNV_R_R_dez_498_CM 1 100. 0. 15. DISPLAY_IDENTIFIER ULEV ECU_ADDRESS 0x3fac5f FORMAT "%5.2" /end MEASUREMENT
/begin MEASUREMENT ulev7 "" UBYTE _CNV_R_R_dez_498_CM 1 100. 0. 15. DISPLAY_IDENTIFIER ULEV7 ECU_ADDRESS 0x3fac60 FORMAT "%5.2" /end MEASUREMENT
/begin MEASUREMENT ulevmem "" UBYTE _CNV_R_R_dez_498_CM 1 100. 0. 15. DISPLAY_IDENTIFIER ULEVMEM ECU_ADDRESS 0x3fac61 FORMAT "%5.2" /end MEASUREMENT
/begin MEASUREMENT ulow "" UBYTE _CNV_R_R_dez_498_CM 1 100. 0. 255. DISPLAY_IDENTIFIER ULOW ECU_ADDRESS 0x3fac62 FORMAT "%5.1" /end MEASUREMENT
/begin MEASUREMENT ulowtimer "" UBYTE _CNV_R_R_t_q0p1_581_CM 1 100. 0. 25.5 DISPLAY_IDENTIFIER ULOWTIMER ECU_ADDRESS 0x3fac63 FORMAT "%5.2" /end MEASUREMENT
/begin CHARACTERISTIC ARY_PRIO "" VAL_BLK 0x1bb2c _REC_VAL_2_s1 7. _CNV_R_R_dez_498_CM 0. 7. FORMAT "%5.3" NUMBER 6 /end CHARACTERISTIC
/begin CHARACTERISTIC ARY_PRIOCF "" VAL_BLK 0x1bb32 _REC_VAL_2_u1 7. _CNV_R_R_dez_498_CM 0. 7. FORMAT "%5.3" NUMBER 7 /end CHARACTERISTIC
/begin CHARACTERISTIC ARY_PWRCF "" VAL_BLK 0x1babc _REC_VAL_2_u2 65535. _CNV_R_R_dez_498_CM 0. 65535. FORMAT "%8.2" NUMBER 7 /end CHARACTERISTIC
/begin CHARACTERISTIC ARY_PWRDF "" VAL_BLK 0x1baca _REC_VAL_2_u2 65535. _CNV_R_R_dez_498_CM 0. 65535. FORMAT "%8.2" NUMBER 14 /end CHARACTERISTIC
/begin CHARACTERISTIC B_SOCNPAPP "" VALUE 0x1bb62 _REC_VAL_20_u1 255. _CNV_R_R_dez_498_CM 0. 255. FORMAT "%5.1" /end CHARACTERISTIC
/begin CHARACTERISTIC CBATTAPP "" VALUE 0x1bb63 _REC_VAL_20_u1 254. _CNV_R_R_cbatt_ub_b_577_CM 1. 255. FORMAT "%7.3" /end CHARACTERISTIC
/begin CHARACTERISTIC CTRCBRAPP "" VALUE 0x1bb64 _REC_VAL_20_u1 255. _CNV_R_R_dez_498_CM 0. 255. FORMAT "%5.1" /end CHARACTERISTIC
/begin CHARACTERISTIC CTRPCOSAPP "" VALUE 0x1bb65 _REC_VAL_20_u1 3. _CNV_R_R_dez_498_CM 0. 3. FORMAT "%5.3" /end CHARACTERISTIC
/begin CHARACTERISTIC CTRPRIOAPP "" VALUE 0x1bb66 _REC_VAL_20_u1 7. _CNV_R_R_dez_498_CM 0. 7. FORMAT "%5.3" /end CHARACTERISTIC
/begin CHARACTERISTIC C_RESET_PI "" VALUE 0x1bb67 _REC_VAL_20_u1 25.5 _CNV_R_R_t_q0p1_581_CM 0. 25.5 FORMAT "%5.2" /end CHARACTERISTIC
/begin CHARACTERISTIC DFFGEN_APP "" VALUE 0x1bb68 _REC_VAL_20_u1 100. _CNV_R_R_rel_ub_b10_522_CM 0. 100. FORMAT "%5.1" /end CHARACTERISTIC
/begin CHARACTERISTIC DFFILT_APP "" VALUE 0x1bb69 _REC_VAL_20_u1 100. _CNV_R_R_rel_ub_b10_522_CM 0. 100. FORMAT "%5.1" /end CHARACTERISTIC
/begin CHARACTERISTIC DSOCPRIO4 "" VALUE 0x1bb3e _REC_VAL_20_u2 200. _CNV_R_R_fak_q0p004_574_CM -100. 100. FORMAT "%7.3" /end CHARACTERISTIC
/begin CHARACTERISTIC DSOCPRIO5 "" VALUE 0x1bb40 _REC_VAL_20_u2 200. _CNV_R_R_fak_q0p004_574_CM -100. 100. FORMAT "%7.3" /end CHARACTERISTIC
/begin CHARACTERISTIC DSOCPRIO6 "" VALUE 0x1bb42 _REC_VAL_20_u2 200. _CNV_R_R_fak_q0p004_574_CM -100. 100. FORMAT "%7.3" /end CHARACTERISTIC
/begin CHARACTERISTIC EHZOLDAPP "" VALUE 0x1bb6c _REC_VAL_20_u1 127.5 _CNV_R_R_fak_q0p5_578_CM 0. 127.5 FORMAT "%5.1" /end CHARACTERISTIC
/begin CHARACTERISTIC HKW_dT "" VALUE 0x1bb44 _REC_VAL_20_u2 1. _CNV_R_R_fak_uw_q0p_579_CM 0. 1. DISPLAY_IDENTIFIER HKW_DT FORMAT "%8.6" /end CHARACTERISTIC
/begin CHARACTERISTIC HKW_IKL2 "" VALUE 0x1bb46 _REC_VAL_20_u2 10. _CNV_R_R_fak_uw_q0p_579_CM 0. 10. FORMAT "%8.5" /end CHARACTERISTIC
/begin CHARACTERISTIC HKW_ING2 "" VALUE 0x1bb48 _REC_VAL_20_u2 10. _CNV_R_R_fak_uw_q0p_579_CM 0. 10. FORMAT "%8.5" /end CHARACTERISTIC
/begin CHARACTERISTIC HKW_IPG2 "" VALUE 0x1bb4a _REC_VAL_20_u2 10. _CNV_R_R_fak_uw_q0p_579_CM 0. 10. FORMAT "%8.5" /end CHARACTERISTIC
/begin CHARACTERISTIC HKW_IWIN2 "" VALUE 0x1bb6d _REC_VAL_20_u1 100. _CNV_R_R_rel_ub_b10_522_CM 0. 100. FORMAT "%5.1" /end CHARACTERISTIC
/begin CHARACTERISTIC HKW_NSTMX2 "" VALUE 0x1bb6e _REC_VAL_20_u1 100. _CNV_R_R_rel_ub_b10_522_CM 0. 100. FORMAT "%5.1" /end CHARACTERISTIC
/begin CHARACTERISTIC HKW_PIMAX2 "" VALUE 0x1bb6f _REC_VAL_20_u1 100. _CNV_R_R_rel_ub_b10_522_CM 0. 100. FORMAT "%5.1" /end CHARACTERISTIC
/begin CHARACTERISTIC HKW_PKL2 "" VALUE 0x1bb4c _REC_VAL_20_u2 10. _CNV_R_R_fak_uw_q0p_579_CM 0. 10. FORMAT "%8.5" /end CHARACTERISTIC
/begin CHARACTERISTIC HKW_PNG2 "" VALUE 0x1bb4e _REC_VAL_20_u2 10. _CNV_R_R_fak_uw_q0p_579_CM 0. 10. FORMAT "%8.5" /end CHARACTERISTIC
/begin CHARACTERISTIC HKW_PPG2 "" VALUE 0x1bb50 _REC_VAL_20_u2 10. _CNV_R_R_fak_uw_q0p_579_CM 0. 10. FORMAT "%8.5" /end CHARACTERISTIC
/begin CHARACTERISTIC HKW_PSTMX2 "" VALUE 0x1bb70 _REC_VAL_20_u1 100. _CNV_R_R_rel_ub_b10_522_CM 0. 100. FORMAT "%5.1" /end CHARACTERISTIC
/begin CHARACTERISTIC HKW_PWIN2 "" VALUE 0x1bb71 _REC_VAL_20_u1 100. _CNV_R_R_rel_ub_b10_522_CM 0. 100. FORMAT "%5.1" /end CHARACTERISTIC
/begin CHARACTERISTIC HKW_TGL2 "" VALUE 0x1bb72 _REC_VAL_20_u1 25.4 _CNV_R_R_fak_q0p1_583_CM 0.1 25.5 FORMAT "%5.2" /end CHARACTERISTIC
/begin CHARACTERISTIC HKW_TRGL2 "" VALUE 0x1bb73 _REC_VAL_20_u1 25.4 _CNV_R_R_fak_q0p1_583_CM 0.1 25.5 FORMAT "%5.2" /end CHARACTERISTIC
/begin CHARACTERISTIC IBATT_APP "" VALUE 0x1bb52 _REC_VAL_20_u2 1200. _CNV_R_R_i_uw_q0p08_569_CM -200. 1000. FORMAT "%7.2" /end CHARACTERISTIC
/begin CHARACTERISTIC IBSAKTAPP "" VALUE 0x1bb74 _REC_VAL_20_u1 255. _CNV_R_R_dez_498_CM 0. 255. FORMAT "%5.1" /end CHARACTERISTIC
/begin CHARACTERISTIC IBSWAKEAPP "" VALUE 0x1bb75 _REC_VAL_20_u1 255. _CNV_R_R_dez_498_CM 0. 255. FORMAT "%5.1" /end CHARACTERISTIC
/begin CHARACTERISTIC IFBSAKAPP "" VALUE 0x1bb76 _REC_VAL_20_u1 255. _CNV_R_R_dez_498_CM 0. 255. FORMAT "%5.1" /end CHARACTERISTIC
/begin CHARACTERISTIC IFUPLAKAPP "" VALUE 0x1bb77 _REC_VAL_20_u1 255. _CNV_R_R_dez_498_CM 0. 255. FORMAT "%5.1" /end CHARACTERISTIC
/begin CHARACTERISTIC KBMCNT_APP "" VALUE 0x1bb78 _REC_VAL_20_u1 25.5 _CNV_R_R_t_q0p1_581_CM 0. 25.5 FORMAT "%5.2" /end CHARACTERISTIC
/begin CHARACTERISTIC KDFPTC_LP "" VALUE 0x1bb79 _REC_VAL_20_u1 0.9961 _CNV_R_R_fak_ub_b1_587_CM 0. 0.9961 FORMAT "%6.4" /end CHARACTERISTIC
/begin CHARACTERISTIC KFISOLLPTC "" MAP 0x1b864 _REC_MAP_52_UBYTE_u2_u1_u2 1200. _CNV_R_R_i_uw_q0p08_569_CM -200. 1000. FORMAT "%7.2"
 /begin AXIS_DESCR STD_AXIS tbatt7 _CNV_R_R_temp_uw_q0_525_CM 5 -48. 125.3 FORMAT "%6.2" /end AXIS_DESCR
 /begin AXIS_DESCR STD_AXIS NO_INPUT_QUANTITY _CNV_R_R_fak_q0p004_574_CM 5 -100. 100. FORMAT "%7.3" /end AXIS_DESCR
/end CHARACTERISTIC
/begin CHARACTERISTIC KF_IBTSOLL "" MAP 0x1b8a8 _REC_MAP_52_UBYTE_u2_u1_u2 1200. _CNV_R_R_i_uw_q0p08_569_CM -200. 1000. FORMAT "%7.2"
 /begin AXIS_DESCR STD_AXIS tbatt7 _CNV_R_R_temp_uw_q0_525_CM 5 -48. 125.3 FORMAT "%6.2" /end AXIS_DESCR
 /begin AXIS_DESCR STD_AXIS NO_INPUT_QUANTITY _CNV_R_R_fak_q0p004_574_CM 5 -100. 100. FORMAT "%7.3" /end AXIS_DESCR
/end CHARACTERISTIC
/begin CHARACTERISTIC KLCF2PWRCF "" CURVE 0x1ba74 _REC_CUR_52_UBYTE_u2_u1 65535. _CNV_R_R_dez_498_CM 0. 65535. FORMAT "%8.2"
 /begin AXIS_DESCR STD_AXIS priocf_loc _CNV_R_R_dez_498_CM 4 0. 7. FORMAT "%6.2" /end AXIS_DESCR
/end CHARACTERISTIC
/begin CHARACTERISTIC KLHKWN2 "" CURVE 0x1b8ec _REC_CUR_52_UWORD_u2_u2 100. _CNV_R_R_rel_ub_b10_522_CM 0. 100. FORMAT "%8.4"
 /begin AXIS_DESCR STD_AXIS NO_INPUT_QUANTITY _CNV_R_R_nmot_uw_q0_575_CM 10 0. 16383.75 /end AXIS_DESCR
/end CHARACTERISTIC
/begin CHARACTERISTIC KLPRIO2PTC "" CURVE 0x1b916 _REC_CUR_52_UWORD_u2_u2 100. _CNV_R_R_fak_uw_q0p_576_CM 0. 100. FORMAT "%9.5"
 /begin AXIS_DESCR STD_AXIS dfallpi _CNV_R_R_fak_uw_q0p_576_CM 5 0. 450. FORMAT "%9.3" /end AXIS_DESCR
/end CHARACTERISTIC
/begin CHARACTERISTIC KLPRIO2PWR "" CURVE 0x1ba82 _REC_CUR_52_UBYTE_u2_u1 65535. _CNV_R_R_dez_498_CM 0. 65535. FORMAT "%8.2"
 /begin AXIS_DESCR STD_AXIS priocf_loc _CNV_R_R_dez_498_CM 4 0. 7. FORMAT "%6.2" /end AXIS_DESCR
/end CHARACTERISTIC
/begin CHARACTERISTIC KL_DFPRIO "" CURVE 0x1ba90 _REC_CUR_52_UBYTE_u2_u1 200. _CNV_R_R_fak_uw_q0p_576_CM -100. 100. FORMAT "%9.5" /begin AXIS_DESCR STD_AXIS dfpt1filt _CNV_R_R_rel_ub_b10_522_CM 7 0. 100. /end AXIS_DESCR /end CHARACTERISTIC
/begin CHARACTERISTIC KL_DFPTC "" CURVE 0x1baa6 _REC_CUR_52_UBYTE_u2_u1 200. _CNV_R_R_fak_uw_q0p_576_CM -100. 100. FORMAT "%9.5" /begin AXIS_DESCR STD_AXIS dfpt1ptc _CNV_R_R_rel_ub_b10_522_CM 7 0. 100. /end AXIS_DESCR /end CHARACTERISTIC
/begin CHARACTERISTIC KL_DSOCPTC "" CURVE 0x1b92c _REC_CUR_52_UWORD_u2_u2 300. _CNV_R_R_fak_uw_q0p_576_CM -150. 150. FORMAT "%9.5"
 /begin AXIS_DESCR STD_AXIS NO_INPUT_QUANTITY _CNV_R_R_fak_q0p004_574_CM 9 -100. 100. FORMAT "%7.3" /end AXIS_DESCR
/end CHARACTERISTIC
/begin CHARACTERISTIC KL_I2PTC "" CURVE 0x1b952 _REC_CUR_52_UWORD_u2_u2 200. _CNV_R_R_fak_uw_q0p_576_CM -100. 100. FORMAT "%9.5"
 /begin AXIS_DESCR STD_AXIS isolldiff _CNV_R_R_i_uw_q0p08_569_CM 10 -200. 2000. FORMAT "%7.2" /end AXIS_DESCR
/end CHARACTERISTIC
/begin CHARACTERISTIC KL_IREST "" CURVE 0x1b97c _REC_CUR_52_UWORD_u2_u2 100. _CNV_R_R_fak_uw_q0p_576_CM -100. 0. FORMAT "%9.5" /begin AXIS_DESCR STD_AXIS pgenrest _CNV_R_R_fak_q0p1_583_CM 10 0. 6400. /end AXIS_DESCR /end CHARACTERISTIC
/begin CHARACTERISTIC KL_ISOLLPR "" CURVE 0x1b9a6 _REC_CUR_52_UWORD_u2_u2 200. _CNV_R_R_fak_uw_q0p_576_CM -100. 100. FORMAT "%9.5"
 /begin AXIS_DESCR STD_AXIS ibtdiff _CNV_R_R_i_uw_q0p08_569_CM 10 -200. 2000. FORMAT "%7.2" /end AXIS_DESCR
/end CHARACTERISTIC
/begin CHARACTERISTIC KL_PTC "" CURVE 0x1b9d0 _REC_CUR_52_UWORD_u2_u2 127.5 _CNV_R_R_fak_q0p5_578_CM 0. 127.5 FORMAT "%8.4"
 /begin AXIS_DESCR STD_AXIS allptcfilt _CNV_R_R_fak_uw_q0p_576_CM 10 0. 550. FORMAT "%9.3" /end AXIS_DESCR
/end CHARACTERISTIC
/begin CHARACTERISTIC KL_SOCPRIO "" CURVE 0x1b9fa _REC_CUR_52_UWORD_u2_u2 300. _CNV_R_R_fak_uw_q0p_576_CM -150. 150. FORMAT "%9.5"
 /begin AXIS_DESCR STD_AXIS NO_INPUT_QUANTITY _CNV_R_R_fak_q0p004_574_CM 9 -100. 100. FORMAT "%7.3" /end AXIS_DESCR
/end CHARACTERISTIC
/begin CHARACTERISTIC KL_UBTPRIO "" CURVE 0x1ba20 _REC_CUR_52_UWORD_u2_u2 200. _CNV_R_R_fak_uw_q0p_576_CM -100. 100. FORMAT "%9.5"
 /begin AXIS_DESCR STD_AXIS ubdifffilt _CNV_R_R_spg_q0p977_584_CM 10 -32. 31.999023 FORMAT "%9.4" /end AXIS_DESCR
/end CHARACTERISTIC
/begin CHARACTERISTIC KL_UB_PTC "" CURVE 0x1ba4a _REC_CUR_52_UWORD_u2_u2 200. _CNV_R_R_fak_uw_q0p_576_CM -100. 100. FORMAT "%9.5"
 /begin AXIS_DESCR STD_AXIS ubtpt1ptc _CNV_R_R_spg_q0p977_584_CM 10 -32. 31.999023 FORMAT "%9.4" /end AXIS_DESCR
/end CHARACTERISTIC
/begin CHARACTERISTIC KSOGRZAPP "" VALUE 0x1bb7a _REC_VAL_20_u1 998.4 _CNV_R_R_i_ub_q5p12_580_CM 0. 998.4 FORMAT "%5.0" /end CHARACTERISTIC
/begin CHARACTERISTIC KSUGRZAPP "" VALUE 0x1bb7b _REC_VAL_20_u1 998.4 _CNV_R_R_i_ub_q5p12_580_CM 0. 998.4 FORMAT "%5.0" /end CHARACTERISTIC
/begin CHARACTERISTIC KUBPTC_LP "" VALUE 0x1bb54 _REC_VAL_20_u2 0.9999847 _CNV_R_R_fak_uw_b1_588_CM 0. 0.9999847 FORMAT "%9.7" /end CHARACTERISTIC
/begin CHARACTERISTIC K_DF_LP "" VALUE 0x1bb7c _REC_VAL_20_u1 0.9961 _CNV_R_R_fak_ub_b1_587_CM 0. 0.9961 FORMAT "%6.4" /end CHARACTERISTIC
/begin CHARACTERISTIC K_PTC_PI "" VALUE 0x1bb7d _REC_VAL_20_u1 1. _CNV_R_R_fak_ub_q0p_589_CM 0. 1. FORMAT "%5.3" /end CHARACTERISTIC
/begin CHARACTERISTIC K_PWRCF_PI "" VALUE 0x1bb7e _REC_VAL_20_u1 1. _CNV_R_R_fak_ub_q0p_589_CM 0. 1. FORMAT "%5.3" /end CHARACTERISTIC
/begin CHARACTERISTIC K_PWRDF_PI "" VALUE 0x1bb7f _REC_VAL_20_u1 1. _CNV_R_R_fak_ub_q0p_589_CM 0. 1. FORMAT "%5.3" /end CHARACTERISTIC
/begin CHARACTERISTIC K_UBAT_LP "" VALUE 0x1bb56 _REC_VAL_20_u2 0.9999847 _CNV_R_R_fak_uw_b1_588_CM 0. 0.9999847 FORMAT "%9.7" /end CHARACTERISTIC
/begin CHARACTERISTIC LLPMFILTK "" VALUE 0x1bb80 _REC_VAL_20_u1 1. _CNV_R_R_fak_ub_q0p_589_CM 0. 1. FORMAT "%5.3" /end CHARACTERISTIC
/begin CHARACTERISTIC MN_PRICFPI "" VALUE 0x1bb81 _REC_VAL_20_u1 150. _CNV_R_R_fak_ub_q5p_590_CM 0. 150. FORMAT "%7.3" /end CHARACTERISTIC
/begin CHARACTERISTIC MN_PTC_PI "" VALUE 0x1bb82 _REC_VAL_20_u1 450. _CNV_R_R_fak_ub_q5p_590_CM 0. 450. FORMAT "%7.3" /end CHARACTERISTIC
/begin CHARACTERISTIC MN_PWRDFPI "" VALUE 0x1bb83 _REC_VAL_20_u1 450. _CNV_R_R_fak_ub_q5p_590_CM 0. 450. FORMAT "%7.3" /end CHARACTERISTIC
/begin CHARACTERISTIC MX_PRICFPI "" VALUE 0x1bb84 _REC_VAL_20_u1 150. _CNV_R_R_fak_ub_q5p_590_CM 0. 150. FORMAT "%7.3" /end CHARACTERISTIC
/begin CHARACTERISTIC MX_PTC_PI "" VALUE 0x1bb85 _REC_VAL_20_u1 450. _CNV_R_R_fak_ub_q5p_590_CM 0. 450. FORMAT "%7.3" /end CHARACTERISTIC
/begin CHARACTERISTIC MX_PWRDFPI "" VALUE 0x1bb86 _REC_VAL_20_u1 450. _CNV_R_R_fak_ub_q5p_590_CM 0. 450. FORMAT "%7.3" /end CHARACTERISTIC
/begin CHARACTERISTIC PCOSCHGAPP "" VALUE 0x1bb87 _REC_VAL_20_u1 255. _CNV_R_R_dez_498_CM 0. 255. FORMAT "%5.1" /end CHARACTERISTIC
/begin CHARACTERISTIC PRIOCFAPP "" VALUE 0x1bb88 _REC_VAL_20_u1 7. _CNV_R_R_dez_498_CM 0. 7. FORMAT "%5.3" /end CHARACTERISTIC
/begin CHARACTERISTIC PTCPWRAPP "" VALUE 0x1bb89 _REC_VAL_20_u1 127.5 _CNV_R_R_fak_q0p5_578_CM 0. 127.5 FORMAT "%5.1" /end CHARACTERISTIC
/begin CHARACTERISTIC PWRCOSAPP "" VALUE 0x1bb58 _REC_VAL_20_u2 65535. _CNV_R_R_dez_498_CM 0. 65535. FORMAT "%8.2" /end CHARACTERISTIC
/begin CHARACTERISTIC PWRSPCSAPP "" VALUE 0x1bb8a _REC_VAL_20_u1 127.5 _CNV_R_R_fak_q0p5_578_CM 0. 127.5 FORMAT "%5.1" /end CHARACTERISTIC
/begin CHARACTERISTIC RQPCOSAPP "" VALUE 0x1bb8b _REC_VAL_20_u1 3. _CNV_R_R_dez_498_CM 0. 3. FORMAT "%5.3" /end CHARACTERISTIC
/begin CHARACTERISTIC SELSPCSAPP "" VALUE 0x1bb8c _REC_VAL_20_u1 15. _CNV_R_R_dez_498_CM 0. 15. FORMAT "%5.2" /end CHARACTERISTIC
/begin CHARACTERISTIC STPCOSAPP "" VALUE 0x1bb8d _REC_VAL_20_u1 3. _CNV_R_R_dez_498_CM 0. 3. FORMAT "%5.3" /end CHARACTERISTIC
/begin CHARACTERISTIC S_B_SOCNPL "" VALUE 0x1bb8e _REC_VAL_20_u1 255. _CNV_R_R_dez_498_CM 0. 255. FORMAT "%5.1" /end CHARACTERISTIC
/begin CHARACTERISTIC S_DFFGEN "" VALUE 0x1bb8f _REC_VAL_20_u1 255. _CNV_R_R_dez_498_CM 0. 255. FORMAT "%5.1" /end CHARACTERISTIC
/begin CHARACTERISTIC S_DF_FILT "" VALUE 0x1bb90 _REC_VAL_20_u1 255. _CNV_R_R_dez_498_CM 0. 255. FORMAT "%5.1" /end CHARACTERISTIC
/begin CHARACTERISTIC S_DME2IBS "" VALUE 0x1bb91 _REC_VAL_20_u1 255. _CNV_R_R_dez_498_CM 0. 255. FORMAT "%5.1" /end CHARACTERISTIC
/begin CHARACTERISTIC S_E65PRIO "" VALUE 0x1bb92 _REC_VAL_20_u1 255. _CNV_R_R_dez_498_CM 0. 255. FORMAT "%5.1" /end CHARACTERISTIC
/begin CHARACTERISTIC S_IBATTW "" VALUE 0x1bb93 _REC_VAL_20_u1 255. _CNV_R_R_dez_498_CM 0. 255. FORMAT "%5.1" /end CHARACTERISTIC
/begin CHARACTERISTIC S_IBSAKT7 "" VALUE 0x1bb94 _REC_VAL_20_u1 255. _CNV_R_R_dez_498_CM 0. 255. FORMAT "%5.1" /end CHARACTERISTIC
/begin CHARACTERISTIC S_IFBSAK7 "" VALUE 0x1bb95 _REC_VAL_20_u1 255. _CNV_R_R_dez_498_CM 0. 255. FORMAT "%5.1" /end CHARACTERISTIC
/begin CHARACTERISTIC S_IFUPLAK7 "" VALUE 0x1bb96 _REC_VAL_20_u1 255. _CNV_R_R_dez_498_CM 0. 255. FORMAT "%5.1" /end CHARACTERISTIC
/begin CHARACTERISTIC S_PCOSCHG "" VALUE 0x1bb97 _REC_VAL_20_u1 255. _CNV_R_R_dez_498_CM 0. 255. FORMAT "%5.1" /end CHARACTERISTIC
/begin CHARACTERISTIC S_PRIO_E60 "" VALUE 0x1bb98 _REC_VAL_20_u1 255. _CNV_R_R_dez_498_CM 0. 255. FORMAT "%5.1" /end CHARACTERISTIC
/begin CHARACTERISTIC S_PRIO_E65 "" VALUE 0x1bb99 _REC_VAL_20_u1 255. _CNV_R_R_dez_498_CM 0. 255. FORMAT "%5.1" /end CHARACTERISTIC
/begin CHARACTERISTIC S_PTCOLMAN "" VALUE 0x1bb9a _REC_VAL_20_u1 255. _CNV_R_R_dez_498_CM 0. 255. FORMAT "%5.1" /end CHARACTERISTIC
/begin CHARACTERISTIC S_PTC_OLD "" VALUE 0x1bb9b _REC_VAL_20_u1 255. _CNV_R_R_dez_498_CM 0. 255. FORMAT "%5.1" /end CHARACTERISTIC
/begin CHARACTERISTIC S_TBATT "" VALUE 0x1bb9c _REC_VAL_20_u1 255. _CNV_R_R_dez_498_CM 0. 255. FORMAT "%5.1" /end CHARACTERISTIC
/begin CHARACTERISTIC S_UBATTAPP "" VALUE 0x1bb9d _REC_VAL_20_u1 255. _CNV_R_R_dez_498_CM 0. 255. FORMAT "%5.1" /end CHARACTERISTIC
/begin CHARACTERISTIC TBATT_APP "" VALUE 0x1bb9e _REC_VAL_20_u1 173.3 _CNV_R_R_temp_uw_q0_525_CM -48. 125.3 FORMAT "%5.1" /end CHARACTERISTIC
/begin CHARACTERISTIC t_pmbs "" VALUE 0x1bb9f _REC_VAL_20_u1 255. _CNV_R_R_dez_498_CM 0. 255. DISPLAY_IDENTIFIER T_PMBS FORMAT "%5.1" /end CHARACTERISTIC
/begin CHARACTERISTIC t_pmvs "" VALUE 0x1bba0 _REC_VAL_20_u1 255. _CNV_R_R_dez_498_CM 0. 255. DISPLAY_IDENTIFIER T_PMVS FORMAT "%5.1" /end CHARACTERISTIC
/begin CHARACTERISTIC T_PRIODFPI "" VALUE 0x1bba1 _REC_VAL_20_u1 25.4 _CNV_R_R_fak_q0p1_583_CM 0.1 25.5 FORMAT "%5.2" /end CHARACTERISTIC
/begin CHARACTERISTIC T_PTC_PI "" VALUE 0x1bba2 _REC_VAL_20_u1 25.4 _CNV_R_R_fak_q0p1_583_CM 0.1 25.5 FORMAT "%5.2" /end CHARACTERISTIC
/begin CHARACTERISTIC T_PWRDF_PI "" VALUE 0x1bba3 _REC_VAL_20_u1 25.4 _CNV_R_R_fak_q0p1_583_CM 0.1 25.5 FORMAT "%5.2" /end CHARACTERISTIC
/begin CHARACTERISTIC UBATTW_APP "" VALUE 0x1bb5a _REC_VAL_20_u2 10. _CNV_R_R_spg_uw_q0p_573_CM 6. 16. FORMAT "%9.6" /end CHARACTERISTIC
/begin CHARACTERISTIC UBTAPP "" VALUE 0x1bb5c _REC_VAL_20_u2 61.425 _CNV_R_R_spg_uw_q0p_585_CM 0. 61.425 FORMAT "%9.6" /end CHARACTERISTIC
/begin CHARACTERISTIC UBTLOWMAX "" VALUE 0x1bb5e _REC_VAL_20_u2 10. _CNV_R_R_spg_uw_q0p_573_CM 6. 16. FORMAT "%9.6" /end CHARACTERISTIC
/begin CHARACTERISTIC UBTLOWMIN "" VALUE 0x1bb60 _REC_VAL_20_u2 10. _CNV_R_R_spg_uw_q0p_573_CM 6. 16. FORMAT "%9.6" /end CHARACTERISTIC
/begin CHARACTERISTIC ULEVAPP "" VALUE 0x1bba4 _REC_VAL_20_u1 15. _CNV_R_R_dez_498_CM 0. 15. FORMAT "%5.2" /end CHARACTERISTIC
/begin CHARACTERISTIC ULOWSETAPP "" VALUE 0x1bba5 _REC_VAL_20_u1 25.5 _CNV_R_R_t_q0p1_581_CM 0. 25.5 FORMAT "%5.2" /end CHARACTERISTIC
/begin CHARACTERISTIC WAKEGRZAPP "" VALUE 0x1bba6 _REC_VAL_20_u1 5.1 _CNV_R_R_i_ub_q0p02_571_CM 0. 5.1 FORMAT "%7.5" /end CHARACTERISTIC
/begin CHARACTERISTIC WGH_PRIO "" VAL_BLK 0x1bae6 _REC_VAL_2_u2 450.25 _CNV_R_R_fak_uw_q0p_576_CM 0. 450.25 FORMAT "%9.5" NUMBER 7 /end CHARACTERISTIC
/begin CHARACTERISTIC WGH_PRIOCF "" VAL_BLK 0x1baf4 _REC_VAL_2_u2 150.25 _CNV_R_R_fak_uw_q0p_576_CM 0. 150.25 FORMAT "%9.5" NUMBER 7 /end CHARACTERISTIC
/begin CHARACTERISTIC WGH_PWRCF "" VAL_BLK 0x1bb02 _REC_VAL_2_s2 150.25 _CNV_R_R_fak_uw_q0p_576_CM 0. 150.25 FORMAT "%9.5" NUMBER 7 /end CHARACTERISTIC
/begin CHARACTERISTIC WGH_PWRDF "" VAL_BLK 0x1bb10 _REC_VAL_2_u2 450.25 _CNV_R_R_fak_uw_q0p_576_CM 0. 450.25 FORMAT "%9.5" NUMBER 14 /end CHARACTERISTIC
/begin CHARACTERISTIC DSOCPCOS "" VALUE 0x1bb3c _REC_VAL_20_u2 200. _CNV_R_R_fak_q0p004_574_CM -100. 100. FORMAT "%7.3" /end CHARACTERISTIC
/begin CHARACTERISTIC DSOCHYST "" VALUE 0x1bb3a _REC_VAL_20_u2 200. _CNV_R_R_fak_q0p004_574_CM -100. 100. FORMAT "%7.3" /end CHARACTERISTIC
/begin CHARACTERISTIC DFMIN "" VALUE 0x1bb6b _REC_VAL_20_u1 100. _CNV_R_R_rel_ub_b10_522_CM 0. 100. FORMAT "%5.1" /end CHARACTERISTIC
/begin CHARACTERISTIC DFMAX "" VALUE 0x1bb6a _REC_VAL_20_u1 100. _CNV_R_R_rel_ub_b10_522_CM 0. 100. FORMAT "%5.1" /end CHARACTERISTIC
/begin MEASUREMENT pm_rishow "Innenwiderstand der Batterie aus der Fitberechnung" UBYTE _CNV_R_R_r_q0p1em3_591_CM 1 100. 0. 0.255 DISPLAY_IDENTIFIER PM_RISHOW ECU_ADDRESS 0x3fac78 FORMAT "%8.4" /end MEASUREMENT
/begin MEASUREMENT pm_socfit3 "SoC Filtereingangswert " UWORD _CNV_R_R_rel_uw_b10_523_CM 1 100. 0. 99.998474 DISPLAY_IDENTIFIER PM_SOCFIT3 ECU_ADDRESS 0x3fac76 BYTE_ORDER MSB_LAST FORMAT "%8.4" /end MEASUREMENT
/begin MEASUREMENT pm_ubatts "Hilfswert Spannung aus Fitberechnung" UWORD _CNV_R_R_spg_uw_q0p_573_CM 1 100. 6. 16. DISPLAY_IDENTIFIER PM_UBATTS ECU_ADDRESS 0x3fa47c BYTE_ORDER MSB_LAST FORMAT "%8.4" /end MEASUREMENT
/begin MEASUREMENT soc_fit "SoC aus der Fitformel" UWORD _CNV_R_R_rel_uw_b10_523_CM 1 100. 0. 99.998474 DISPLAY_IDENTIFIER SOC_FIT ECU_ADDRESS 0x3facd4 BYTE_ORDER MSB_LAST FORMAT "%8.4" /end MEASUREMENT
/begin MEASUREMENT ubatts2 "Hilfswert2 Spannung aus Fitberechnung" UWORD _CNV_R_R_spg_uw_q0p_573_CM 1 100. 6. 16. DISPLAY_IDENTIFIER UBATTS2 ECU_ADDRESS 0x3fa47e BYTE_ORDER MSB_LAST FORMAT "%8.4" /end MEASUREMENT
/begin CHARACTERISTIC KFPMRIBATT "Kennfeld Innenwiderstand Batterie" MAP 0x1bc3a _REC_MAP_52_UBYTE_u1_u1_u2 0. _CNV_R_R_r_q0p1em3_591_CM 0. 0.255 FORMAT "%8.4"
 /begin AXIS_DESCR STD_AXIS NO_INPUT_QUANTITY _CNV_R_R_temp_ub_q0_497_CM 4 -48. 143.25 FORMAT "%8.4" /end AXIS_DESCR
 /begin AXIS_DESCR STD_AXIS NO_INPUT_QUANTITY _CNV_R_R_i_uw_q0p08_569_CM 6 -200. 1000. FORMAT "%8.4" /end AXIS_DESCR
/end CHARACTERISTIC
/begin CHARACTERISTIC KLPMSOCVU "SoC-Wert aus der Fitberechnung" CURVE 0x1bc64 _REC_CUR_52_UWORD_u2_u2 0. _CNV_R_R_rel_uw_b10_523_CM 0. 99.998474 FORMAT "%8.4"
 /begin AXIS_DESCR STD_AXIS NO_INPUT_QUANTITY _CNV_R_R_spg_uw_q0p_573_CM 3 6. 16. FORMAT "%8.4" /end AXIS_DESCR
/end CHARACTERISTIC
/begin CHARACTERISTIC S_PMSOCFIT "Schalter zur Applikation SoC aus der Fitberechnung" VALUE 0x1bc76 _REC_VAL_20_u1 0. _CNV_R_R_dez_498_CM 0. 255. FORMAT "%8.4" /end CHARACTERISTIC
/begin CHARACTERISTIC SOCFITAPP "Applikationwert Soc aus der Fitberechnung" VALUE 0x1bc72 _REC_VAL_20_u2 0. _CNV_R_R_rel_uw_b10_523_CM 0. 99.998474 FORMAT "%8.4" /end CHARACTERISTIC
/begin CHARACTERISTIC ZK_PMSOC "Zeitfaktor" VALUE 0x1bc74 _REC_VAL_20_u2 0. _CNV_R_R_fak_uw_b1_588_CM 0. 0.99998474 FORMAT "%8.4" /end CHARACTERISTIC
/begin MEASUREMENT absch_korr "Korrekturwert Abschaltung" UWORD _CNV_R_R_fak_q0p004_574_CM 1 100. -40. 40. DISPLAY_IDENTIFIER ABSCH_KORR ECU_ADDRESS 0x3facd8 BYTE_ORDER MSB_LAST FORMAT "%8.4" /end MEASUREMENT
/begin MEASUREMENT B_abschfit "Bedingung Korrektur Startfähigkeitsgrenze durchgeführt" UBYTE _CNV_A_R_LINEAR_____22_CM 1 100. 0. 255. DISPLAY_IDENTIFIER B_ABSCHFIT ECU_ADDRESS 0x3fac7a BIT_MASK 0x1 /end MEASUREMENT
/begin MEASUREMENT B_pm_fit2 "Bedingung Hilfsvariable Fit 2" UBYTE _CNV_A_R_LINEAR_____22_CM 1 100. 0. 255. DISPLAY_IDENTIFIER B_PM_FIT2 ECU_ADDRESS 0x3fac7c BIT_MASK 0x1 /end MEASUREMENT
/begin MEASUREMENT B_pm_fit3 "Bedingung Hilfsvariable Fit 3" UBYTE _CNV_A_R_LINEAR_____22_CM 1 100. 0. 255. DISPLAY_IDENTIFIER B_PM_FIT3 ECU_ADDRESS 0x3fac7d BIT_MASK 0x1 /end MEASUREMENT
/begin MEASUREMENT B_pmsocini "wird beim INIT wahr um den Timer zurückzusetzen" UBYTE _CNV_A_R_LINEAR_____22_CM 1 100. 0. 255. DISPLAY_IDENTIFIER B_PMSOCINI ECU_ADDRESS 0x3fac7b BIT_MASK 0x1 /end MEASUREMENT
/begin MEASUREMENT B_q_start "Bedingung Startqualität vollständig berechnet" UBYTE _CNV_A_R_LINEAR_____22_CM 1 100. 0. 255. DISPLAY_IDENTIFIER B_Q_START ECU_ADDRESS 0x3fac7e BIT_MASK 0x1 /end MEASUREMENT
/begin MEASUREMENT B_soc_npl "Bedingung SoC-Wert nicht plausibel" UBYTE _CNV_A_R_LINEAR_____22_CM 1 100. 0. 255. DISPLAY_IDENTIFIER B_SOC_NPL ECU_ADDRESS 0x3fac7f BIT_MASK 0x1 /end MEASUREMENT
/begin MEASUREMENT d_soc "Abstand zur Startfähigkeitsgrenze" UWORD _CNV_R_R_fak_q0p004_574_CM 1 100. -100. 100. DISPLAY_IDENTIFIER D_SOC ECU_ADDRESS 0x3facda BYTE_ORDER MSB_LAST FORMAT "%8.4" /end MEASUREMENT
/begin MEASUREMENT d_socw "Delta SoC" UWORD _CNV_R_R_fak_q0p004_574_CM 1 100. -100. 100. DISPLAY_IDENTIFIER D_SOCW ECU_ADDRESS 0x3fac82 BYTE_ORDER MSB_LAST FORMAT "%8.4" /end MEASUREMENT
/begin MEASUREMENT d_socw_1 "Delta SoC" UWORD _CNV_R_R_rel_uw_b10_592_CM 1 100. 0. 99.998474 DISPLAY_IDENTIFIER D_SOCW_1 ECU_ADDRESS 0x3fac84 BYTE_ORDER MSB_LAST FORMAT "%8.4" /end MEASUREMENT
/begin MEASUREMENT pm_ibslog "" UBYTE _CNV_A_R_LINEAR_____22_CM 1 100. 0. 255. DISPLAY_IDENTIFIER PM_IBSLOG ECU_ADDRESS 0x3fac80 BIT_MASK 0x1 /end MEASUREMENT
/begin MEASUREMENT pm_tsrdy "Status Berechnung Tsaison" UBYTE _CNV_A_R_LINEAR_____22_CM 1 100. 0. 255. DISPLAY_IDENTIFIER PM_TSRDY ECU_ADDRESS 0x3facd6 BIT_MASK 0x1 /end MEASUREMENT
/begin MEASUREMENT pmsoc_help "Hilfsvariable für SoC aus der Startfähigkeitsberechnung" UWORD _CNV_R_R_fak_q0p002_593_CM 1 100. 0. 100. DISPLAY_IDENTIFIER PMSOC_HELP ECU_ADDRESS 0x3fac86 BYTE_ORDER MSB_LAST FORMAT "%8.4" /end MEASUREMENT
/begin MEASUREMENT q_startfgk "Abstand zur Startfähigkeitsgrenze" UWORD _CNV_R_R_qlad_uw_q0_572_CM 1 100. 0. 1193.0283 DISPLAY_IDENTIFIER Q_STARTFGK ECU_ADDRESS 0x3facdc BYTE_ORDER MSB_LAST FORMAT "%8.4" /end MEASUREMENT
/begin MEASUREMENT soc_korr "Korrekturwert soc_bila" UWORD _CNV_R_R_fak_q0p004_574_CM 1 100. -100. 100. DISPLAY_IDENTIFIER SOC_KORR ECU_ADDRESS 0x3facde BYTE_ORDER MSB_LAST FORMAT "%8.4" /end MEASUREMENT
/begin MEASUREMENT soc_q_kor "Korrekturwert Genauigkeit Ladezustandsbestimmung" UWORD _CNV_R_R_qlad_uw_q0_572_CM 1 100. 0. 1193.0283 DISPLAY_IDENTIFIER SOC_Q_KOR ECU_ADDRESS 0x3face0 BYTE_ORDER MSB_LAST FORMAT "%8.4" /end MEASUREMENT
/begin MEASUREMENT soc_rel "Relativzähler für Ladezustand SoC" UWORD _CNV_R_R_rel_uw_b10_592_CM 1 100. 0. 99.998474 DISPLAY_IDENTIFIER SOC_REL ECU_ADDRESS 0x3face2 BYTE_ORDER MSB_LAST FORMAT "%8.4" /end MEASUREMENT
/begin MEASUREMENT soc_stfgk "Startfähigkeitsgrenze" UWORD _CNV_R_R_rel_uw_b10_592_CM 1 100. 0. 99.998474 DISPLAY_IDENTIFIER SOC_STFGK ECU_ADDRESS 0x3face4 BYTE_ORDER MSB_LAST FORMAT "%8.4" /end MEASUREMENT
/begin MEASUREMENT soc_stfgkw "SoC Startfähigkeit" UWORD _CNV_R_R_rel_uw_b10_592_CM 1 100. 0. 99.998474 DISPLAY_IDENTIFIER SOC_STFGKW ECU_ADDRESS 0x3fac88 BYTE_ORDER MSB_LAST FORMAT "%8.4" /end MEASUREMENT
/begin MEASUREMENT t_saison "Saison -Temperatur" UWORD _CNV_R_R_temp_uw_q0_594_CM 1 100. -48. 148.605 DISPLAY_IDENTIFIER T_SAISON ECU_ADDRESS 0x3face6 BYTE_ORDER MSB_LAST FORMAT "%8.4" /end MEASUREMENT
/begin MEASUREMENT tsaisonalt "letzter Wert Saisontemperatur" UWORD _CNV_R_R_temp_uw_q0_594_CM 1 100. -48. 148.605 DISPLAY_IDENTIFIER TSAISONALT ECU_ADDRESS 0x3fac8a BYTE_ORDER MSB_LAST FORMAT "%8.4" /end MEASUREMENT
/begin CHARACTERISTIC ABSCHKORA "Applikationswert für Korrektur Abschaltung" VALUE 0x1bc8a _REC_VAL_20_u2 0. _CNV_R_R_fak_q0p004_574_CM -100. 100. FORMAT "%8.4" /end CHARACTERISTIC
/begin CHARACTERISTIC D_AB_KORR1 "Korrekturkonstante 1 für Abschaltung" VALUE 0x1bc90 _REC_VAL_20_u2 0. _CNV_R_R_fak_q0p004_574_CM -100. 100. FORMAT "%8.4" /end CHARACTERISTIC
/begin CHARACTERISTIC D_AB_KORR2 "Korrekturkonstante 2 für Abschaltung" VALUE 0x1bc92 _REC_VAL_20_u2 0. _CNV_R_R_fak_q0p004_574_CM -100. 100. FORMAT "%8.4" /end CHARACTERISTIC
/begin CHARACTERISTIC D_AB_KORR3 "Korrekturkonstante 3 für Abschaltung" VALUE 0x1bc94 _REC_VAL_20_u2 0. _CNV_R_R_fak_q0p004_574_CM -100. 100. FORMAT "%8.4" /end CHARACTERISTIC
/begin CHARACTERISTIC DSOCA "Applikationsgrösse für d_soc" VALUE 0x1bc8c _REC_VAL_20_u2 0. _CNV_R_R_fak_q0p004_574_CM -100. 100. FORMAT "%8.4" /end CHARACTERISTIC
/begin CHARACTERISTIC DSOCABSCH "Applikationsgrösse für d_soc" VALUE 0x1bc8e _REC_VAL_20_u2 0. _CNV_R_R_fak_q0p004_574_CM -100. 100. FORMAT "%8.4" /end CHARACTERISTIC
/begin CHARACTERISTIC I_FIT_AUSW "Grenzwert für die Auswertung des Batteriestromes" VALUE 0x1bc96 _REC_VAL_20_u2 0. _CNV_R_R_i_uw_q0p08_569_CM -200. 1000. FORMAT "%8.4" /end CHARACTERISTIC
/begin CHARACTERISTIC KL_SSOC "soc_s in Abh. von tsaison" CURVE 0x1bc78 _REC_CUR_52_UWORD_u2_u2 0. _CNV_R_R_fak_q0p002_593_CM 0. 100. FORMAT "%8.4"
 /begin AXIS_DESCR STD_AXIS t_saison _CNV_R_R_temp_uw_q0_594_CM 4 -48. 148.605 FORMAT "%8.4" /end AXIS_DESCR
/end CHARACTERISTIC
/begin CHARACTERISTIC PM_TABSMN "Applikationsgrösse für Abstellzeit tabsmn_w" VALUE 0x1bc98 _REC_VAL_20_u2 0. _CNV_R_R_dez_498_CM 0. 65535. FORMAT "%8.4" /end CHARACTERISTIC
/begin CHARACTERISTIC PMTIMERSQ1 "Startwert Timer für soc_quali" VALUE 0x1bca6 _REC_VAL_20_u1 0. _CNV_R_R_t6minxmin__595_CM 0. 1530. FORMAT "%8.4" /end CHARACTERISTIC
/begin CHARACTERISTIC QSOCCL3 "Grenze zur Ladezustandsqualitätsklasse3" VALUE 0x1bc9a _REC_VAL_20_u2 0. _CNV_R_R_qlad_uw_q0_572_CM 0. 1193.0283 FORMAT "%8.4" /end CHARACTERISTIC
/begin CHARACTERISTIC QSTARTFGA "Applikationswert für q_startfgk" VALUE 0x1bc9c _REC_VAL_20_u2 0. _CNV_R_R_qlad_uw_q0_572_CM 0. 1193.0283 FORMAT "%8.4" /end CHARACTERISTIC
/begin CHARACTERISTIC S_ABSCHK "Schalter für Applikationswert absch_korr" VALUE 0x1bca7 _REC_VAL_20_u1 0. _CNV_R_R_dez_498_CM 0. 255. FORMAT "%8.4" /end CHARACTERISTIC
/begin CHARACTERISTIC S_DSOCS "Schalter für Applikationswert Delta SoC" VALUE 0x1bca8 _REC_VAL_20_u1 0. _CNV_R_R_dez_498_CM 0. 255. FORMAT "%8.4" /end CHARACTERISTIC
/begin CHARACTERISTIC S_PMTABSMN "Schalter für Applikation der Abstellzeit tabsmn_w" VALUE 0x1bca9 _REC_VAL_20_u1 0. _CNV_R_R_dez_498_CM 0. 255. FORMAT "%8.4" /end CHARACTERISTIC
/begin CHARACTERISTIC S_QSTARTFK "Schalter für Applikation q_startfgk" VALUE 0x1bcaa _REC_VAL_20_u1 0. _CNV_R_R_dez_498_CM 0. 255. FORMAT "%8.4" /end CHARACTERISTIC
/begin CHARACTERISTIC S_SOCSTAFK "Schalter für Applikation SoC aus der Startfähigkeit" VALUE 0x1bcab _REC_VAL_20_u1 0. _CNV_R_R_dez_498_CM 0. 255. FORMAT "%8.4" /end CHARACTERISTIC
/begin CHARACTERISTIC SOC_STAFGA "Applikationswert für SoC aus der Startfähigkeit" VALUE 0x1bca2 _REC_VAL_20_u2 0. _CNV_R_R_rel_uw_b10_592_CM 0. 99.998474 FORMAT "%8.4" /end CHARACTERISTIC
/begin CHARACTERISTIC SOCFITABW "Applikationskonstante zur Abwertung SoC aus der Fitberechnung" VALUE 0x1bc9e _REC_VAL_20_u2 0. _CNV_R_R_rel_uw_b10_592_CM 0. 99.998474 FORMAT "%8.4" /end CHARACTERISTIC
/begin CHARACTERISTIC SOCFITGRZ "Grenzwert für soc_fit" VALUE 0x1bca0 _REC_VAL_20_u2 0. _CNV_R_R_rel_uw_b10_592_CM 0. 99.998474 FORMAT "%8.4" /end CHARACTERISTIC
/begin CHARACTERISTIC TSAISONFIL "Filterkonstante für t_saison" VALUE 0x1bca4 _REC_VAL_20_u2 0. _CNV_R_R_dez_498_CM 1. 65535. FORMAT "%8.4" /end CHARACTERISTIC
/begin MEASUREMENT B_pm_aux10 "Bedingung Hilfsgrösse 2 f Grenze Innenwiderstand Batterie" UBYTE _CNV_A_R_LINEAR_____22_CM 1 100. 0. 255. DISPLAY_IDENTIFIER B_PM_AUX10 ECU_ADDRESS 0x3fac8e BIT_MASK 0x1 /end MEASUREMENT
/begin MEASUREMENT B_pm_aux11 "Bedingung Hilfsgrösse 3 f. Inenewiderstand" UBYTE _CNV_A_R_LINEAR_____22_CM 1 100. 0. 255. DISPLAY_IDENTIFIER B_PM_AUX11 ECU_ADDRESS 0x3fac8f BIT_MASK 0x1 /end MEASUREMENT
/begin MEASUREMENT B_pm_aux2 "Bedingung Hilfsgrösse2 RS_NMOT1 und B_pmsqrdy" UBYTE _CNV_A_R_LINEAR_____22_CM 1 100. 0. 255. DISPLAY_IDENTIFIER B_PM_AUX2 ECU_ADDRESS 0x3fac90 BIT_MASK 0x1 /end MEASUREMENT
/begin MEASUREMENT B_pm_aux3 "Bedingung Hilfsgrösse RS_START" UBYTE _CNV_A_R_LINEAR_____22_CM 1 100. 0. 255. DISPLAY_IDENTIFIER B_PM_AUX3 ECU_ADDRESS 0x3fac91 BIT_MASK 0x1 /end MEASUREMENT
/begin MEASUREMENT B_pm_aux4 "Bedingung Hilfsgrösse für RS_NMOT2" UBYTE _CNV_A_R_LINEAR_____22_CM 1 100. 0. 255. DISPLAY_IDENTIFIER B_PM_AUX4 ECU_ADDRESS 0x3fac92 BIT_MASK 0x1 /end MEASUREMENT
/begin MEASUREMENT B_pm_aux8 "Bedingung Hilfsgrösse 4 f. Innenwiderstand" UBYTE _CNV_A_R_LINEAR_____22_CM 1 100. 0. 255. DISPLAY_IDENTIFIER B_PM_AUX8 ECU_ADDRESS 0x3fac93 BIT_MASK 0x1 /end MEASUREMENT
/begin MEASUREMENT B_pm_aux9 "Bedingung Hilfsgrösse 1 f. Innenwiderstand Batterie" UBYTE _CNV_A_R_LINEAR_____22_CM 1 100. 0. 255. DISPLAY_IDENTIFIER B_PM_AUX9 ECU_ADDRESS 0x3fac94 BIT_MASK 0x1 /end MEASUREMENT
/begin MEASUREMENT B_pmaux1 "Bedingung Hilfsgrösse RS_NMOT1" UBYTE _CNV_A_R_LINEAR_____22_CM 1 100. 0. 255. DISPLAY_IDENTIFIER B_PMAUX1 ECU_ADDRESS 0x3fac8c BIT_MASK 0x1 /end MEASUREMENT
/begin MEASUREMENT B_pmaux5 "Bedingung Hilfsgrösse Motor steht" UBYTE _CNV_A_R_LINEAR_____22_CM 1 100. 0. 255. DISPLAY_IDENTIFIER B_PMAUX5 ECU_ADDRESS 0x3fac8d BIT_MASK 0x1 /end MEASUREMENT
/begin MEASUREMENT B_pmsqrdy "Bedingung Berechnung Startqualität fertig" UBYTE _CNV_A_R_LINEAR_____22_CM 1 100. 0. 255. DISPLAY_IDENTIFIER B_PMSQRDY ECU_ADDRESS 0x3face8 BIT_MASK 0x1 /end MEASUREMENT
/begin MEASUREMENT B_pmstartq "Bedingung Startqualität" UBYTE _CNV_A_R_LINEAR_____22_CM 1 100. 0. 255. DISPLAY_IDENTIFIER B_PMSTARTQ ECU_ADDRESS 0x3face9 BIT_MASK 0x1 /end MEASUREMENT
/begin MEASUREMENT B_resetsta "Bedingung Reset Startauswertung" UBYTE _CNV_A_R_LINEAR_____22_CM 1 100. 0. 255. DISPLAY_IDENTIFIER B_RESETSTA ECU_ADDRESS 0x3fac95 BIT_MASK 0x1 /end MEASUREMENT
/begin MEASUREMENT idelta "Differenz der Startströme" UWORD _CNV_R_R_i_ub_q0p02_571_CM 1 100. 2.e-002 1000. DISPLAY_IDENTIFIER IDELTA ECU_ADDRESS 0x3fa480 BYTE_ORDER MSB_LAST FORMAT "%8.4" /end MEASUREMENT
/begin MEASUREMENT nnstartb "Motordrehzahl nach Motorstart als Byte" UBYTE _CNV_R_R_nmot_ub_q1_596_CM 1 100. 0. 2550. DISPLAY_IDENTIFIER NNSTARTB ECU_ADDRESS 0x3fa482 FORMAT "%8.4" /end MEASUREMENT
/begin MEASUREMENT pmstartsta "Schalter für Ablaufsteuerung" UBYTE _CNV_R_R_dez_498_CM 1 100. 0. 255. DISPLAY_IDENTIFIER PMSTARTSTA ECU_ADDRESS 0x3fa483 FORMAT "%8.4" /end MEASUREMENT
/begin MEASUREMENT rin_start "Innenwiderstand Batterie beim Start" UBYTE _CNV_R_R_r_q0p125_597_CM 1 100. 0. 31.875 DISPLAY_IDENTIFIER RIN_START ECU_ADDRESS 0x3fa484 FORMAT "%8.4" /end MEASUREMENT
/begin MEASUREMENT status "" UBYTE _CNV_A_R_LINEAR_____22_CM 1 100. 0. 255. DISPLAY_IDENTIFIER STATUS ECU_ADDRESS 0x3fdf52 BIT_MASK 0x1 /end MEASUREMENT
/begin MEASUREMENT u_grenz "Grenzwert Spannung" UBYTE _CNV_R_R_spg_ub_q0p_598_CM 1 100. 6. 22.32 DISPLAY_IDENTIFIER U_GRENZ ECU_ADDRESS 0x3fa485 FORMAT "%8.4" /end MEASUREMENT
/begin CHARACTERISTIC KLUNSTART "Startspannung abhängig v.Motordrehzahl" CURVE 0x1bcac _REC_CUR_52_UBYTE_u1_u1 0. _CNV_R_R_spg_ub_q0p_598_CM 6. 22.32 FORMAT "%8.4"
 /begin AXIS_DESCR STD_AXIS NO_INPUT_QUANTITY _CNV_R_R_nmot_ub_q1_596_CM 2 0. 2550. FORMAT "%8.4" /end AXIS_DESCR
/end CHARACTERISTIC
/begin CHARACTERISTIC KLUTSTART "Startspannung in Abhängigkeit von Temperatur Batterie" CURVE 0x1bcb1 _REC_CUR_52_UBYTE_s1_u1 0. _CNV_R_R_spg_q0p064_599_CM -8.128 8.128 FORMAT "%8.4"
 /begin AXIS_DESCR STD_AXIS NO_INPUT_QUANTITY _CNV_R_R_temp_ub_q0_497_CM 3 -48. 143.25 FORMAT "%8.4" /end AXIS_DESCR
/end CHARACTERISTIC
/begin CHARACTERISTIC RIN_GRENZ "Grenzwert Innenwiderstand Batt" VALUE 0x1bcba _REC_VAL_20_u1 0. _CNV_R_R_r_q0p125_597_CM 0. 31.875 FORMAT "%8.4" /end CHARACTERISTIC
/begin CHARACTERISTIC S_PM_TEST1 "Applikationsschalter um die Startberechnung zu erzwingen" VALUE 0x1bcbc _REC_VAL_20_u1 0. _CNV_R_R_dez_498_CM 0. 255. FORMAT "%8.4" /end CHARACTERISTIC
/begin CHARACTERISTIC S_PMSTARTQ "Applikationsschalter f. B_pmstartq" VALUE 0x1bcbb _REC_VAL_20_u1 0. _CNV_R_R_dez_498_CM 0. 255. FORMAT "%8.4" /end CHARACTERISTIC
/begin CHARACTERISTIC S_RIN "Schalter Applikation Innenwiderstandsprüfung" VALUE 0x1bcbd _REC_VAL_20_u1 0. _CNV_R_R_dez_498_CM 0. 255. FORMAT "%8.4" /end CHARACTERISTIC
/begin CHARACTERISTIC USTARTGRZ "Spannungsgrenzwert für Startauswertung " VALUE 0x1bcb8 _REC_VAL_20_u2 0. _CNV_R_R_spg_uw_q0p_573_CM 6. 16. FORMAT "%8.4" /end CHARACTERISTIC
/begin MEASUREMENT B_genclcon "Wird auf true gesetzt wenn Motor und Generator bereits T_B_NMOT-Sekunden laufen." UBYTE _CNV_A_R_LINEAR_____22_CM 1 100. 0. 255. DISPLAY_IDENTIFIER B_GENCLCON ECU_ADDRESS 0x3fac96 BIT_MASK 0x1 /end MEASUREMENT
/begin MEASUREMENT B_ifbsk7 "" UBYTE _CNV_A_R_LINEAR_____22_CM 1 100. 0. 255. DISPLAY_IDENTIFIER B_IFBSK7 ECU_ADDRESS 0x3fac97 BIT_MASK 0x1 /end MEASUREMENT
/begin MEASUREMENT B_ifplak7 "" UBYTE _CNV_A_R_LINEAR_____22_CM 1 100. 0. 255. DISPLAY_IDENTIFIER B_IFPLAK7 ECU_ADDRESS 0x3fac98 BIT_MASK 0x1 /end MEASUREMENT
/begin MEASUREMENT t_bnmotakt "Zeit nachdem der Motor laeuft, hoert nach T_B_NMOT Sekunden auf." UBYTE _CNV_R_R_t_q1_600_CM 1 100. 0. 255. DISPLAY_IDENTIFIER T_BNMOTAKT ECU_ADDRESS 0x3fac9c FORMAT "%8.4" /end MEASUREMENT
/begin MEASUREMENT t_delta "Zeit, die seit letzem Prozessaufruf verstrichen ist. Dient zur Taskkompatibilitaet." UBYTE _CNV_R_R_t_q1_600_CM 1 100. 0. 255. DISPLAY_IDENTIFIER T_DELTA ECU_ADDRESS 0x3fac9d FORMAT "%8.4" /end MEASUREMENT
/begin MEASUREMENT ubattsoll "Batteriesollspannung aufgrund Batterietemperatur und Batt.-ladezustand. Weitere Nutzung in PMPRSVCALC." UWORD _CNV_R_R_spg_uw_q0p_573_CM 1 100. 6. 16. DISPLAY_IDENTIFIER UBATTSOLL ECU_ADDRESS 0x3fac9a BYTE_ORDER MSB_LAST FORMAT "%8.4" /end MEASUREMENT
/begin MEASUREMENT ubattsoll7 "lokales ubattsoll" UBYTE _CNV_R_R_spg_ub_q0p_598_CM 1 100. 6. 17. DISPLAY_IDENTIFIER UBATTSOLL7 ECU_ADDRESS 0x3fac9e FORMAT "%8.4" /end MEASUREMENT
/begin MEASUREMENT udelta "Delta zw. Battsollspg und Battspg" SBYTE _CNV_R_R_spg_q0p064_599_CM 1 100. -8.192 8.128 DISPLAY_IDENTIFIER UDELTA ECU_ADDRESS 0x3fac9f FORMAT "%8.4" /end MEASUREMENT
/begin MEASUREMENT udeltaabs "Absolutwert von udelta" UBYTE _CNV_R_R_spg_q0p064_599_CM 1 100. 0. 16.32 DISPLAY_IDENTIFIER UDELTAABS ECU_ADDRESS 0x3faca0 FORMAT "%8.4" /end MEASUREMENT
/begin MEASUREMENT uibs "Generatorspannungsvorgabe von IBS" UBYTE _CNV_R_R_spg_gencan_76_CM 1 100. 10.6 16.975 DISPLAY_IDENTIFIER UIBS ECU_ADDRESS 0x3faca1 FORMAT "%8.4" /end MEASUREMENT
/begin MEASUREMENT uibs7 "lokales uibs" UBYTE _CNV_R_R_spg_gencan_76_CM 1 100. 10.6 16.975 DISPLAY_IDENTIFIER UIBS7 ECU_ADDRESS 0x3faca2 FORMAT "%8.4" /end MEASUREMENT
/begin CHARACTERISTIC B_IFBSAAPP "Appl-para. für Bedingung Fehler vom BSD" VALUE 0x1bcdb _REC_VAL_20_u1 0. _CNV_R_R_dez_498_CM 0. 255. FORMAT "%8.4" /end CHARACTERISTIC
/begin CHARACTERISTIC B_IFUPLAPP "Apll-par. für Bedg. Fehler vom IBS" VALUE 0x1bcdc _REC_VAL_20_u1 0. _CNV_R_R_dez_498_CM 0. 255. FORMAT "%8.4" /end CHARACTERISTIC
/begin CHARACTERISTIC DFOVERRIDE "Schwellwert wann Generator als ueberlastet erkannt wird" VALUE 0x1bcdd _REC_VAL_20_u1 0. _CNV_R_R_rel_ub_b10_522_CM 0. 100. FORMAT "%8.4" /end CHARACTERISTIC
/begin CHARACTERISTIC KFUSOLL "Batteriesollspannung aufgrund der Temperatur und soc." MAP 0x1bcbe _REC_MAP_52_UBYTE_u1_u1_u2 0. _CNV_R_R_spg_ub_q0p_598_CM 6. 17.008 FORMAT "%8.4"
 /begin AXIS_DESCR STD_AXIS NO_INPUT_QUANTITY _CNV_R_R_temp_ub_q0_497_CM 3 -48. 125. FORMAT "%8.4" /end AXIS_DESCR
 /begin AXIS_DESCR STD_AXIS NO_INPUT_QUANTITY _CNV_R_R_rel_uw_b10_523_CM 3 0. 99.998474 FORMAT "%8.4" /end AXIS_DESCR
/end CHARACTERISTIC
/begin CHARACTERISTIC KLUSOLL "Batteriesollspannung aufgrund von tbatt" CURVE 0x1bcd4 _REC_CUR_52_UBYTE_u1_u1 0. _CNV_R_R_spg_ub_q0p_598_CM 6. 17.008 FORMAT "%8.4"
 /begin AXIS_DESCR STD_AXIS NO_INPUT_QUANTITY _CNV_R_R_temp_ub_q0_497_CM 3 -48. 125.25 FORMAT "%8.4" /end AXIS_DESCR
/end CHARACTERISTIC
/begin CHARACTERISTIC PMUBAT_MAX "Max. zugelassene Batteriespg " VALUE 0x1bcde _REC_VAL_20_u1 0. _CNV_R_R_spg_ub_q0p_598_CM 6. 17. FORMAT "%8.4" /end CHARACTERISTIC
/begin CHARACTERISTIC PMUBAT_MIN "Min. zugelassene Batteriespg" VALUE 0x1bcdf _REC_VAL_20_u1 0. _CNV_R_R_spg_ub_q0p_598_CM 6. 17. FORMAT "%8.4" /end CHARACTERISTIC
/begin CHARACTERISTIC PMUGEN_MAX "Max zugelassene Generatorspg" VALUE 0x1bce0 _REC_VAL_20_u1 0. _CNV_R_R_spg_gencan_76_CM 10.6 16.975 FORMAT "%8.4" /end CHARACTERISTIC
/begin CHARACTERISTIC PMUGEN_MIN "Min zugelassene Generatorspg" VALUE 0x1bce1 _REC_VAL_20_u1 0. _CNV_R_R_spg_gencan_76_CM 10.6 16.975 FORMAT "%8.4" /end CHARACTERISTIC
/begin CHARACTERISTIC S_B_IFBSAC "manueller Schalter für Fehler BSD" VALUE 0x1bce2 _REC_VAL_20_u1 0. _CNV_R_R_dez_498_CM 0. 255. FORMAT "%8.4" /end CHARACTERISTIC
/begin CHARACTERISTIC S_B_IFUPLA "manueller Schalter für Fehler IBS" VALUE 0x1bce3 _REC_VAL_20_u1 0. _CNV_R_R_dez_498_CM 0. 255. FORMAT "%8.4" /end CHARACTERISTIC
/begin CHARACTERISTIC S_UIBS "Schalter für UIBS, wenn True dann uibs=UIBSAPP" VALUE 0x1bce4 _REC_VAL_20_u1 0. _CNV_R_R_dez_498_CM 0. 255. FORMAT "%8.4" /end CHARACTERISTIC
/begin CHARACTERISTIC T_B_NMOT "Zeit nach Motorlauf, wo die stufenweise (USTEPMIN) Berechnung von uibs aktiviert wird." VALUE 0x1bce5 _REC_VAL_20_u1 0. _CNV_R_R_t_q1_600_CM 0. 255. FORMAT "%8.4" /end CHARACTERISTIC
/begin CHARACTERISTIC T_PMUGEN "Taskzeit von PMUGENCALC, = Zeit wo die stufenweise Setzung von uibs berechnet wird." VALUE 0x1bce6 _REC_VAL_20_u1 0. _CNV_R_R_t_q1_600_CM 0. 255. FORMAT "%8.4" /end CHARACTERISTIC
/begin CHARACTERISTIC UGENNORM "Generator Normspannung" VALUE 0x1bce7 _REC_VAL_20_u1 0. _CNV_R_R_spg_gencan_76_CM 10.6 16.975 FORMAT "%8.4" /end CHARACTERISTIC
/begin CHARACTERISTIC UIBSAPP "Manueller Applikationswert von Uibs an UGENKOR" VALUE 0x1bce8 _REC_VAL_20_u1 0. _CNV_R_R_spg_gencan_76_CM 10.6 16.975 FORMAT "%8.4" /end CHARACTERISTIC
/begin CHARACTERISTIC USTEPMIN "Min. Delta zw. Battsollspg und Battspg damit uibs veraendert wird." VALUE 0x1bce9 _REC_VAL_20_u1 0. _CNV_R_R_spg_q0p05_601_CM 0. 12.75 FORMAT "%8.4" /end CHARACTERISTIC
/begin AXIS_PTS ldp_maf_sub__maf_sub_thd_mon "" 0x12017 maf_sub_1 _REC_AXS_20_u1 1389. _CNV_A_R_LINEAR_____27_CM 2 0. 1389. DISPLAY_IDENTIFIER LDP_MAF_SUB__MAF_SUB_THD_MON FORMAT "%4.0" /end AXIS_PTS
/begin MEASUREMENT bios_test_ecu_ram "actual value of RAM test" UBYTE _CNV_A_R_LINEAR_____1_CM 1 100. 0. 255. DISPLAY_IDENTIFIER BIOS_TEST_ECU_RAM ECU_ADDRESS 0x3fb2e5 FORMAT "%3.0" /end MEASUREMENT
/begin MEASUREMENT bios_test_ecu_ram_cpl "actual complement value of RAM test" UBYTE _CNV_A_R_LINEAR_____1_CM 1 100. 0. 255. DISPLAY_IDENTIFIER BIOS_TEST_ECU_RAM_CPL ECU_ADDRESS 0x3fb2e6 FORMAT "%3.0" /end MEASUREMENT
/begin MEASUREMENT B_soc_pwf "Uo Kalibrierung durchgeführt" UBYTE _CNV_A_R_LINEAR_____22_CM 1 100. 0. 255. DISPLAY_IDENTIFIER B_SOC_PWF ECU_ADDRESS 0x3fac65 BIT_MASK 0x1 /end MEASUREMENT
/begin MEASUREMENT B_soccalc "Uo Kalibrierung durchgeführt" UBYTE _CNV_A_R_LINEAR_____22_CM 1 100. 0. 255. DISPLAY_IDENTIFIER B_SOCCALC ECU_ADDRESS 0x3fac64 BIT_MASK 0x1 /end MEASUREMENT
/begin MEASUREMENT cbatt_lo "Nennkapazität Batterie, lokal" UBYTE _CNV_R_R_dez_498_CM 1 100. 20. 150. DISPLAY_IDENTIFIER CBATT_LO ECU_ADDRESS 0x3fac72 FORMAT "%8.4" /end MEASUREMENT
/begin MEASUREMENT d_qelad "Delta Kapazität entladen" UWORD _CNV_R_R_qlad_uw_q0_572_CM 1 100. 0. 1193.0283 DISPLAY_IDENTIFIER D_QELAD ECU_ADDRESS 0x3fac66 BYTE_ORDER MSB_LAST FORMAT "%8.4" /end MEASUREMENT
/begin MEASUREMENT d_qlad "Delta Kapazität geladen" UWORD _CNV_R_R_qlad_uw_q0_572_CM 1 100. 0. 1193.0283 DISPLAY_IDENTIFIER D_QLAD ECU_ADDRESS 0x3fac68 BYTE_ORDER MSB_LAST FORMAT "%8.4" /end MEASUREMENT
/begin MEASUREMENT ib_commcnt "Zähler Taskaufrufe zwischen periodischer Abfrage qlad und qelad" UBYTE _CNV_R_R_dez_498_CM 1 100. 0. 255. DISPLAY_IDENTIFIER IB_COMMCNT ECU_ADDRESS 0x3fac73 FORMAT "%8.4" /end MEASUREMENT
/begin MEASUREMENT ib_commsta "Statemaschine zeiger zur Abfrage qlad und qelad" UBYTE _CNV_R_R_dez_498_CM 1 100. 0. 255. DISPLAY_IDENTIFIER IB_COMMSTA ECU_ADDRESS 0x3fac74 FORMAT "%8.4" /end MEASUREMENT
/begin MEASUREMENT isoc0loc "Batteriestrom zum Zeitpunkt der Ruhespannungsmessung (lokal)" UWORD _CNV_R_R_i_uw_q0p02_570_CM 1 100. -200. 1110.7 DISPLAY_IDENTIFIER ISOC0LOC ECU_ADDRESS 0x3fac6a BYTE_ORDER MSB_LAST FORMAT "%8.4" /end MEASUREMENT
/begin MEASUREMENT q_bila "Kapazität Batterie (long)" ULONG _CNV_R_R_qlad_ul_q2_622_CM 1 100. 0. 150. DISPLAY_IDENTIFIER Q_BILA ECU_ADDRESS 0x3facd0 BYTE_ORDER MSB_LAST FORMAT "%8.4" /end MEASUREMENT
/begin MEASUREMENT qeladold "Kapazität Entladen vor Abstellen" UWORD _CNV_R_R_qlad_uw_q0_572_CM 1 100. 0. 1193.0283 DISPLAY_IDENTIFIER QELADOLD ECU_ADDRESS 0x3facc8 BYTE_ORDER MSB_LAST FORMAT "%8.4" /end MEASUREMENT
/begin MEASUREMENT qladold "Kapazität Getladen vor Abstellen" UWORD _CNV_R_R_qlad_uw_q0_572_CM 1 100. 0. 1193.0283 DISPLAY_IDENTIFIER QLADOLD ECU_ADDRESS 0x3facca BYTE_ORDER MSB_LAST FORMAT "%8.4" /end MEASUREMENT
/begin MEASUREMENT sco_b_loc "lokal soc_bila f. KFSOCLF" UWORD _CNV_R_R_rel_uw_b10_523_CM 1 100. 0. 99.998474 DISPLAY_IDENTIFIER SCO_B_LOC ECU_ADDRESS 0x3faccc BYTE_ORDER MSB_LAST FORMAT "%8.4" /end MEASUREMENT
/begin MEASUREMENT soc_bila "Ladezustand durch Bilanzierung und Ruhespannungsmessung ermittelt" UWORD _CNV_R_R_rel_uw_b10_523_CM 1 100. 0. 99.998474 DISPLAY_IDENTIFIER SOC_BILA ECU_ADDRESS 0x3fac6c BYTE_ORDER MSB_LAST FORMAT "%8.4" /end MEASUREMENT
/begin MEASUREMENT soc_q_loc "lokaler Zähler Genauigkeit Ladeztustandsbestimmung" UWORD _CNV_R_R_qlad_uw_q0_572_CM 1 100. 0. 1193.0283 DISPLAY_IDENTIFIER SOC_Q_LOC ECU_ADDRESS 0x3facce BYTE_ORDER MSB_LAST FORMAT "%8.4" /end MEASUREMENT
/begin MEASUREMENT soc_quali "Zähler Genauigkeit Ladeztustandsbestimmung" UWORD _CNV_R_R_qlad_uw_q0_572_CM 1 100. 0. 1193.0283 DISPLAY_IDENTIFIER SOC_QUALI ECU_ADDRESS 0x3fac6e BYTE_ORDER MSB_LAST FORMAT "%8.4" /end MEASUREMENT
/begin MEASUREMENT tsocloc "Batterietemperatur zum Zeitpunkt der Ruhespannungsmessung (lokal)" UBYTE _CNV_R_R_temp_ub_q0_497_CM 1 100. -48. 143.25 DISPLAY_IDENTIFIER TSOCLOC ECU_ADDRESS 0x3fac75 FORMAT "%8.4" /end MEASUREMENT
/begin MEASUREMENT ubatt0 "Aus Wertetripel ausgewählter Ruhespannungswert" UWORD _CNV_R_R_spg_uw_q0p_573_CM 1 100. 6. 22.38375 DISPLAY_IDENTIFIER UBATT0 ECU_ADDRESS 0x3fac70 BYTE_ORDER MSB_LAST FORMAT "%8.4" /end MEASUREMENT
/begin CHARACTERISTIC CBATT_DEF "Ersatzwert Batteriekapazität" VALUE 0x1bc34 _REC_VAL_20_u1 0. _CNV_R_R_dez_498_CM 1. 255. FORMAT "%8.4" /end CHARACTERISTIC
/begin CHARACTERISTIC IB_COMMVAL "Anzahl Taskaufrufe zwischen periodischer Abfrage qlad und qelad" VALUE 0x1bc35 _REC_VAL_20_u1 0. _CNV_R_R_dez_498_CM 0. 255. FORMAT "%8.4" /end CHARACTERISTIC
/begin CHARACTERISTIC KFSOC0UBIB "Ladezustand in Abhängigkeit von Ruhespannung und Strom" MAP 0x1bba8 _REC_MAP_52_UWORD_u2_u2_u2 0. _CNV_R_R_rel_uw_b10_523_CM 0. 99.998474 FORMAT "%8.4"
 /begin AXIS_DESCR STD_AXIS NO_INPUT_QUANTITY _CNV_R_R_spg_uw_q0p_573_CM 3 6. 22.38375 FORMAT "%8.4" /end AXIS_DESCR
 /begin AXIS_DESCR STD_AXIS isoc0loc _CNV_R_R_i_uw_q0p02_570_CM 10 -200. 1110.7 FORMAT "%8.4" /end AXIS_DESCR
/end CHARACTERISTIC
/begin CHARACTERISTIC KFSOCLF "Ladefaktor in Abhängigkeit von Temperatur und Ladezustand" MAP 0x1bc02 _REC_MAP_52_UBYTE_u1_u1_u2 0. _CNV_R_R_fak_uw_b10_623_CM 1.5625e-002 3.984375 FORMAT "%8.4"
 /begin AXIS_DESCR STD_AXIS NO_INPUT_QUANTITY _CNV_R_R_temp_ub_q0_497_CM 3 -48. 143.25 FORMAT "%8.4" /end AXIS_DESCR
 /begin AXIS_DESCR STD_AXIS NO_INPUT_QUANTITY _CNV_R_R_rel_uw_b10_523_CM 3 0. 99.998474 FORMAT "%8.4" /end AXIS_DESCR
/end CHARACTERISTIC
/begin CHARACTERISTIC KLSOC0TEMP "Temperaturabhängige Stromkorrektur für Ruhespannungsmessung" CURVE 0x1bc18 _REC_CUR_52_UBYTE_u1_u1 0. _CNV_R_R_fak_uw_b51_582_CM 0. 1.9921875 FORMAT "%8.4"
 /begin AXIS_DESCR STD_AXIS tsocloc _CNV_R_R_temp_ub_q0_497_CM 5 -48. 143.25 FORMAT "%8.4" /end AXIS_DESCR
/end CHARACTERISTIC
/begin CHARACTERISTIC PMQ_UX "Ruhespannung Extrapolationsteiler" VALUE 0x1bc36 _REC_VAL_20_u1 0. _CNV_R_R_dez_498_CM 1. 255. FORMAT "%8.4" /end CHARACTERISTIC
/begin CHARACTERISTIC Q_BILAPWF "Defaultwert für q_bila nach Powerfail" VALUE 0x1bc30 _REC_VAL_20_u4 0. _CNV_R_R_qlad_ul_q2_622_CM 0. 1193.0465 FORMAT "%8.4" /end CHARACTERISTIC
/begin CHARACTERISTIC QSOCCL1 "Grenze zur Ladezustandsqualitätsklasse1" VALUE 0x1bc24 _REC_VAL_20_u2 0. _CNV_R_R_qlad_uw_q0_572_CM 0. 1193.0283 FORMAT "%8.4" /end CHARACTERISTIC
/begin CHARACTERISTIC QSOCCL2 "Grenze zur Ladezustandsqualitätsklasse2" VALUE 0x1bc26 _REC_VAL_20_u2 0. _CNV_R_R_qlad_uw_q0_572_CM 0. 1193.0283 FORMAT "%8.4" /end CHARACTERISTIC
/begin CHARACTERISTIC S_BSOCCALC "Enable Rücksetzten Ruhespannungen IBS" VALUE 0x1bc37 _REC_VAL_20_u1 0. _CNV_R_R_dez_498_CM 0. 255. FORMAT "%8.4" /end CHARACTERISTIC
/begin CHARACTERISTIC S_SOC_BILA "Schalter für Applik. soc_bila" VALUE 0x1bc38 _REC_VAL_20_u1 0. _CNV_R_R_dez_498_CM 0. 255. FORMAT "%8.4" /end CHARACTERISTIC
/begin CHARACTERISTIC S_SOC_QUAL "Schalter für Applik. soc_quali" VALUE 0x1bc39 _REC_VAL_20_u1 0. _CNV_R_R_dez_498_CM 0. 255. FORMAT "%8.4" /end CHARACTERISTIC
/begin CHARACTERISTIC SOC_BILAWA "Applikationswert soc_bila" VALUE 0x1bc28 _REC_VAL_20_u2 0. _CNV_R_R_rel_uw_b10_523_CM 0. 99.998474 FORMAT "%8.4" /end CHARACTERISTIC
/begin CHARACTERISTIC SOC_Q_PWF "Ladezustandsqualität nach Powerfail" VALUE 0x1bc2c _REC_VAL_20_u2 0. _CNV_R_R_qlad_uw_q0_572_CM 0. 1193.0283 FORMAT "%8.4" /end CHARACTERISTIC
/begin CHARACTERISTIC SOC_QUALIA "Applikationswert soc_quali" VALUE 0x1bc2a _REC_VAL_20_u2 0. _CNV_R_R_rel_uw_b10_523_CM 0. 99.998474 FORMAT "%8.4" /end CHARACTERISTIC
/begin COMPU_METHOD _CNV_S_2_RANGE______0_CM "" TAB_VERB "%6.3" "[-]" COMPU_TAB_REF _CNV_S_2_RANGE______0 /end COMPU_METHOD
/begin COMPU_VTAB _CNV_S_2_RANGE______0 "" TAB_VERB 2 0 "0" 1 "1" /end COMPU_VTAB
/begin COMPU_METHOD _CNV_A_R_LINEAR_____1_CM "" RAT_FUNC "%6.3" "-" COEFFS 0 1. 0. 0 0 1 /end COMPU_METHOD
/begin COMPU_METHOD _CNV_S_2_RANGE______2_R_CM "" TAB_VERB "%6.3" "[-]" COMPU_TAB_REF _CNV_S_2_RANGE______2_R /end COMPU_METHOD
/begin COMPU_VTAB_RANGE _CNV_S_2_RANGE______2_R "" 2 0 0 "0" 1 255 "1" /end COMPU_VTAB_RANGE
/begin COMPU_METHOD _CNV_A_R_LINEAR_____3_CM "" RAT_FUNC "%6.3" "V" COEFFS 0 204.7999998974999 0. 0 0 1 /end COMPU_METHOD
/begin COMPU_METHOD _CNV_S_2_RANGE______5_CM "" TAB_VERB "%6.3" "-" COMPU_TAB_REF _CNV_S_2_RANGE______5 /end COMPU_METHOD
/begin COMPU_VTAB _CNV_S_2_RANGE______5 "" TAB_VERB 2 0 "0" 1 "1" /end COMPU_VTAB
/begin COMPU_METHOD _CNV_A_R_LINEAR_____9_CM "" RAT_FUNC "%6.3" "%" COEFFS 0 655.3600000071681 0. 0 0 1 /end COMPU_METHOD
/begin COMPU_METHOD _CNV_A_R_LINEAR_____10_CM "" RAT_FUNC "%6.3" "%" COEFFS 0 2.56 0. 0 0 1 /end COMPU_METHOD
/begin COMPU_METHOD _CNV_A_R_LINEAR_____12_CM "" RAT_FUNC "%6.3" "°C" COEFFS 0 1.333333333333333 64. 0 0 1 /end COMPU_METHOD
/begin COMPU_METHOD _CNV_A_R_LINEAR_____16_CM "" RAT_FUNC "%6.3" "rpm" COEFFS 0 3.125e-002 0. 0 0 1 /end COMPU_METHOD
/begin COMPU_METHOD _CNV_A_R_LINEAR_____21_CM "" RAT_FUNC "%6.3" "-" COEFFS 0 32768.00003968061 0. 0 0 1 /end COMPU_METHOD
/begin COMPU_METHOD _CNV_A_R_LINEAR_____22_CM "" RAT_FUNC "%6.3" "[-]" COEFFS 0 1. 0. 0 0 1 /end COMPU_METHOD
/begin COMPU_METHOD _CNV_A_R_LINEAR_____27_CM "" RAT_FUNC "%6.3" "mg/stk" COEFFS 0 0.183585313174946 0. 0 0 1 /end COMPU_METHOD
/begin COMPU_METHOD _CNV_A_R_LINEAR_____37_CM "" RAT_FUNC "%6.3" "-" COEFFS 0 65536.00007936121 0. 0 0 1 /end COMPU_METHOD
/begin COMPU_METHOD _CNV_A_R_LINEAR_____39_CM "" RAT_FUNC "%6.3" "-" COEFFS 0 127.9991955827809 0. 0 0 1 /end COMPU_METHOD
/begin COMPU_METHOD _CNV_A_R_LINEAR_____40_CM "" RAT_FUNC "%6.3" "%/s" COEFFS 0 0.1024000154202376 128.000019275297 0 0 1 /end COMPU_METHOD
/begin COMPU_METHOD _CNV_A_R_LINEAR_____41_CM "" RAT_FUNC "%6.3" "s" COEFFS 0 25. 0. 0 0 1 /end COMPU_METHOD
/begin COMPU_METHOD _CNV_A_R_LINEAR_____44_CM "" RAT_FUNC "%6.3" "V" COEFFS 0 51.0204081632653 0. 0 0 1 /end COMPU_METHOD
/begin COMPU_METHOD _CNV_A_R_LINEAR_____49_CM "" RAT_FUNC "%6.3" "hPa" COEFFS 0 12.06017666543982 0. 0 0 1 /end COMPU_METHOD
/begin COMPU_METHOD _CNV_A_R_LINEAR_____50_CM "" RAT_FUNC "%6.3" "[-]" COEFFS 0 255.9999357490357 0. 0 0 1 /end COMPU_METHOD
/begin COMPU_METHOD _CNV_A_R_LINEAR_____55_CM "" RAT_FUNC "%6.3" "Nm" COEFFS 0 32. 0. 0 0 1 /end COMPU_METHOD
/begin COMPU_METHOD _CNV_A_R_LINEAR_____60_CM "" RAT_FUNC "%6.3" "V" COEFFS 0 9.807692307692308 0. 0 0 1 /end COMPU_METHOD
/begin COMPU_METHOD _CNV_R_R_spg_gencan_76_CM "" RAT_FUNC "%6.3" "V" COEFFS 0. 40. -424. 0. 0. 1. /end COMPU_METHOD
/begin COMPU_METHOD _CNV_A_R_LINEAR_____82_CM "" RAT_FUNC "%6.3" "°CRK" COEFFS 0 2.666666666666667 0. 0 0 1 /end COMPU_METHOD
/begin COMPU_METHOD _CNV_A_R_LINEAR_____85_CM "" RAT_FUNC "%6.3" "km/h" COEFFS 0 128.0000018750286 0. 0 0 1 /end COMPU_METHOD
/begin COMPU_METHOD _CNV_A_R_LINEAR_____95_CM "" RAT_FUNC "%6.3" "Nm" COEFFS 0 1. 0. 0 0 1 /end COMPU_METHOD
/begin COMPU_METHOD _CNV_A_R_LINEAR_____101_CM "" RAT_FUNC "%6.3" "Nm" COEFFS 0 0.5 0. 0 0 1 /end COMPU_METHOD
/begin COMPU_METHOD _CNV_A_R_LINEAR_____102_CM "" RAT_FUNC "%6.3" "Nms" COEFFS 0 320.1514411333659 0. 0 0 1 /end COMPU_METHOD
/begin COMPU_METHOD _CNV_A_R_LINEAR_____103_CM "" RAT_FUNC "%6.3" "m/s²" COEFFS 0 640. 32768. 0 0 1 /end COMPU_METHOD
/begin COMPU_METHOD _CNV_A_R_LINEAR_____113_CM "" RAT_FUNC "%6.3" "kg/h" COEFFS 0 32. 0. 0 0 1 /end COMPU_METHOD
/begin COMPU_METHOD _CNV_A_R_LINEAR_____115_CM "" RAT_FUNC "%6.3" "-" COEFFS 0 128. 0. 0 0 1 /end COMPU_METHOD
/begin COMPU_METHOD _CNV_A_R_LINEAR_____156_CM "" RAT_FUNC "%6.3" "km/h" COEFFS 0 0.5 0. 0 0 1 /end COMPU_METHOD
/begin COMPU_METHOD _CNV_A_R_LINEAR_____203_CM "" RAT_FUNC "%6.3" "°CRK" COEFFS 0 2.666666666666667 95. 0 0 1 /end COMPU_METHOD
/begin COMPU_METHOD _CNV_A_R_LINEAR_____204_CM "" RAT_FUNC "%6.3" "°CRK" COEFFS 0 -2.666666666666667 0. 0 0 1 /end COMPU_METHOD
/begin COMPU_METHOD _CNV_A_R_LINEAR_____215_CM "" RAT_FUNC "%6.3" "rpm" COEFFS 0 3.125e-002 128. 0 0 1 /end COMPU_METHOD
/begin COMPU_METHOD _CNV_A_R_LINEAR_____351_CM "" RAT_FUNC "%6.3" "°TPS/V" COEFFS 0 7.971241012816505 0. 0 0 1 /end COMPU_METHOD
/begin COMPU_METHOD _CNV_A_R_LINEAR_____352_CM "" RAT_FUNC "%6.3" "%/°TPS" COEFFS 0 2.400225903614458 0. 0 0 1 /end COMPU_METHOD
/begin COMPU_METHOD _CNV_A_R_LINEAR_____353_CM "" RAT_FUNC "%6.3" "°TPS" COEFFS 0 2.133891213389121 0. 0 0 1 /end COMPU_METHOD
/begin COMPU_METHOD _CNV_A_R_LINEAR_____354_CM "" RAT_FUNC "%6.3" "-" COEFFS 0 255.9999357490357 0. 0 0 1 /end COMPU_METHOD
/begin COMPU_METHOD _CNV_A_R_LINEAR_____379_CM "" RAT_FUNC "%6.3" "-" COEFFS 0 257. 0. 0 0 1 /end COMPU_METHOD
/begin COMPU_METHOD _CNV_A_R_LINEAR_____380_CM "" RAT_FUNC "%6.3" "µs" COEFFS 0 1. 0. 0 0 1 /end COMPU_METHOD
/begin COMPU_METHOD _CNV_A_R_LINEAR_____459_CM "" RAT_FUNC "%6.3" "Nm/rpm*rpm" COEFFS 0 134293032.7868853 0. 0 0 1 /end COMPU_METHOD
/begin COMPU_METHOD _CNV_A_R_LINEAR_____479_CM "" RAT_FUNC "%6.3" "Nm" COEFFS 0 8. 0. 0 0 1 /end COMPU_METHOD
/begin COMPU_METHOD _CNV_R_R_temp_ub_q0_497_CM "" RAT_FUNC "%6.3" "°C" COEFFS 0. 1. 48. 0. 0. 0.75 /end COMPU_METHOD
/begin COMPU_METHOD _CNV_R_R_dez_498_CM "" RAT_FUNC "%6.3" "[-]" COEFFS 0. 1. 0. 0. 0. 1. /end COMPU_METHOD
/begin COMPU_METHOD _CNV_R_R_rel_ub_b10_522_CM "" RAT_FUNC "%6.3" "%" COEFFS 0. 255. 0. 0. 0. 100. /end COMPU_METHOD
/begin COMPU_METHOD _CNV_R_R_rel_uw_b10_523_CM "" RAT_FUNC "%6.3" "%" COEFFS 0. 65536. 0. 0. 0. 100. /end COMPU_METHOD
/begin COMPU_METHOD _CNV_R_R_temp_uw_q0_525_CM "" RAT_FUNC "%6.3" "Grad C" COEFFS 0. 1. 48. 0. 0. 0.75 /end COMPU_METHOD
/begin COMPU_METHOD _CNV_S_2_B_TRUE_530_CM "" TAB_VERB "%6.3" "[-]" COMPU_TAB_REF _CNV_S_2_B_TRUE_530 /end COMPU_METHOD
/begin COMPU_VTAB _CNV_S_2_B_TRUE_530 "" TAB_VERB 2 0 "----" 1 "TRUE" /end COMPU_VTAB
/begin COMPU_METHOD _CNV_R_R_i_uw_q0p08_569_CM "" RAT_FUNC "%6.3" "A" COEFFS 0. 1. 200. 0. 0. 8.e-002 /end COMPU_METHOD
/begin COMPU_METHOD _CNV_R_R_i_uw_q0p02_570_CM "" RAT_FUNC "%6.3" "A" COEFFS 0. 1. 200. 0. 0. 2.e-002 /end COMPU_METHOD
/begin COMPU_METHOD _CNV_R_R_i_ub_q0p02_571_CM "" RAT_FUNC "%6.3" "A" COEFFS 0. 1. 0. 0. 0. 2.e-002 /end COMPU_METHOD
/begin COMPU_METHOD _CNV_R_R_qlad_uw_q0_572_CM "" RAT_FUNC "%6.3" "Ah" COEFFS 0. 3600000. 0. 0. 0. 65536. /end COMPU_METHOD
/begin COMPU_METHOD _CNV_R_R_spg_uw_q0p_573_CM "" RAT_FUNC "%6.3" "V" COEFFS 0. 1. -6. 0. 0. 2.5e-004 /end COMPU_METHOD
/begin COMPU_METHOD _CNV_R_R_fak_q0p004_574_CM "" RAT_FUNC "%6.3" "%" COEFFS 0. 1. 100. 0. 0. 4.e-003 /end COMPU_METHOD
/begin COMPU_METHOD _CNV_R_R_nmot_uw_q0_575_CM "" RAT_FUNC "%6.3" "1/min" COEFFS 0. 1. 0. 0. 0. 0.25 /end COMPU_METHOD
/begin COMPU_METHOD _CNV_R_R_fak_uw_q0p_576_CM "" RAT_FUNC "%6.3" "[-]" COEFFS 0. 1. 500. 0. 0. 0.25 /end COMPU_METHOD
/begin COMPU_METHOD _CNV_R_R_cbatt_ub_b_577_CM "" RAT_FUNC "%6.3" "Ah" COEFFS 0. 1. 0. 0. 0. 1. /end COMPU_METHOD
/begin COMPU_METHOD _CNV_R_R_fak_q0p5_578_CM "" RAT_FUNC "%6.3" "-" COEFFS 0. 2. 0. 0. 0. 1. /end COMPU_METHOD
/begin COMPU_METHOD _CNV_R_R_fak_uw_q0p_579_CM "" RAT_FUNC "%6.3" "-" COEFFS 0. 65536. 0. 0. 0. 65.536 /end COMPU_METHOD
/begin COMPU_METHOD _CNV_R_R_i_ub_q5p12_580_CM "" RAT_FUNC "%6.3" "A" COEFFS 0. 100. 0. 0. 0. 512. /end COMPU_METHOD
/begin COMPU_METHOD _CNV_R_R_t_q0p1_581_CM "" RAT_FUNC "%6.3" "s" COEFFS 0. 10. 0. 0. 0. 1. /end COMPU_METHOD
/begin COMPU_METHOD _CNV_R_R_fak_uw_b51_582_CM "" RAT_FUNC "%6.3" "-" COEFFS 0. 65536. 0. 0. 0. 512. /end COMPU_METHOD
/begin COMPU_METHOD _CNV_R_R_fak_q0p1_583_CM "" RAT_FUNC "%6.3" "-" COEFFS 0. 1. 0. 0. 0. 0.1 /end COMPU_METHOD
/begin COMPU_METHOD _CNV_R_R_spg_q0p977_584_CM "" RAT_FUNC "%6.3" "[-]" COEFFS 0. 1. 32. 0. 0. 9.765625e-004 /end COMPU_METHOD
/begin COMPU_METHOD _CNV_R_R_spg_uw_q0p_585_CM "" RAT_FUNC "%6.3" "V" COEFFS 0. 1. 0. 0. 0. 1.5e-002 /end COMPU_METHOD
/begin COMPU_METHOD _CNV_R_R_spg_uw_q0p_586_CM "" RAT_FUNC "%6.3" "V" COEFFS 0. 1. 491.505 0. 0. 1.5e-002 /end COMPU_METHOD
/begin COMPU_METHOD _CNV_R_R_fak_ub_b1_587_CM "" RAT_FUNC "%6.3" "-" COEFFS 0. 256. 0. 0. 0. 1. /end COMPU_METHOD
/begin COMPU_METHOD _CNV_R_R_fak_uw_b1_588_CM "" RAT_FUNC "%6.3" "-" COEFFS 0. 65536. 0. 0. 0. 1. /end COMPU_METHOD
/begin COMPU_METHOD _CNV_R_R_fak_ub_q0p_589_CM "" RAT_FUNC "%6.3" "-" COEFFS 0. 255. 0. 0. 0. 1. /end COMPU_METHOD
/begin COMPU_METHOD _CNV_R_R_fak_ub_q5p_590_CM "" RAT_FUNC "%6.3" "[-]" COEFFS 0. 1. 0. 0. 0. 5. /end COMPU_METHOD
/begin COMPU_METHOD _CNV_R_R_r_q0p1em3_591_CM "" RAT_FUNC "%6.3" "Ohm" COEFFS 0. 1000. 0. 0. 0. 1. /end COMPU_METHOD
/begin COMPU_METHOD _CNV_R_R_rel_uw_b10_592_CM "" RAT_FUNC "%6.3" "[-]" COEFFS 0. 65536. 0. 0. 0. 100. /end COMPU_METHOD
/begin COMPU_METHOD _CNV_R_R_fak_q0p002_593_CM "" RAT_FUNC "%6.3" "%" COEFFS 0. 500. 0. 0. 0. 1. /end COMPU_METHOD
/begin COMPU_METHOD _CNV_R_R_temp_uw_q0_594_CM "" RAT_FUNC "%6.3" "°C" COEFFS 0. 1. 48. 0. 0. 3.e-003 /end COMPU_METHOD
/begin COMPU_METHOD _CNV_R_R_t6minxmin__595_CM "" RAT_FUNC "%6.3" "[-]" COEFFS 0. 1. 0. 0. 0. 6. /end COMPU_METHOD
/begin COMPU_METHOD _CNV_R_R_nmot_ub_q1_596_CM "" RAT_FUNC "%6.3" "1/min" COEFFS 0. 1. 0. 0. 0. 10. /end COMPU_METHOD
/begin COMPU_METHOD _CNV_R_R_r_q0p125_597_CM "" RAT_FUNC "%6.3" "mOhm" COEFFS 0. 256. 0. 0. 0. 32. /end COMPU_METHOD
/begin COMPU_METHOD _CNV_R_R_spg_ub_q0p_598_CM "" RAT_FUNC "%6.3" "V" COEFFS 0. 1. -6. 0. 0. 6.4e-002 /end COMPU_METHOD
/begin COMPU_METHOD _CNV_R_R_spg_q0p064_599_CM "" RAT_FUNC "%6.3" "V" COEFFS 0. 1. 0. 0. 0. 6.4e-002 /end COMPU_METHOD
/begin COMPU_METHOD _CNV_R_R_t_q1_600_CM "" RAT_FUNC "%6.3" "s" COEFFS 0. 1. 0. 0. 0. 1. /end COMPU_METHOD
/begin COMPU_METHOD _CNV_R_R_spg_q0p05_601_CM "" RAT_FUNC "%6.3" "V" COEFFS 0. 20. 0. 0. 0. 1. /end COMPU_METHOD
/begin COMPU_METHOD _CNV_R_R_qlad_ul_q2_622_CM "" RAT_FUNC "%6.3" "Ah" COEFFS 0. 3600000. 0. 0. 0. 1. /end COMPU_METHOD
/begin COMPU_METHOD _CNV_R_R_fak_uw_b10_623_CM "" RAT_FUNC "%6.3" "-" COEFFS 0. 65536. 0. 0. 0. 1024. /end COMPU_METHOD
/begin RECORD_LAYOUT _REC_VAL_20_u1 FNC_VALUES 1 UBYTE COLUMN_DIR DIRECT /end RECORD_LAYOUT
/begin RECORD_LAYOUT _REC_VAL_20_u2 FNC_VALUES 1 UWORD COLUMN_DIR DIRECT /end RECORD_LAYOUT
/begin RECORD_LAYOUT _REC_CUR_20_u2_u1 FNC_VALUES 1 UWORD COLUMN_DIR DIRECT /end RECORD_LAYOUT
/begin RECORD_LAYOUT _REC_AXS_20_u1 NO_AXIS_PTS_X 1 UBYTE AXIS_PTS_X 2 UBYTE INDEX_INCR DIRECT /end RECORD_LAYOUT
/begin RECORD_LAYOUT _REC_MAP_20_u1_u1_u1 FNC_VALUES 1 UBYTE COLUMN_DIR DIRECT /end RECORD_LAYOUT
/begin RECORD_LAYOUT _REC_CUR_20_u1_u1 FNC_VALUES 1 UBYTE COLUMN_DIR DIRECT /end RECORD_LAYOUT
/begin RECORD_LAYOUT _REC_AXS_20_u2 NO_AXIS_PTS_X 1 UWORD AXIS_PTS_X 2 UWORD INDEX_INCR DIRECT /end RECORD_LAYOUT
/begin RECORD_LAYOUT _REC_MAP_20_u1_u1_u2 FNC_VALUES 1 UBYTE COLUMN_DIR DIRECT /end RECORD_LAYOUT
/begin RECORD_LAYOUT _REC_CUR_20_u1_u2 FNC_VALUES 1 UBYTE COLUMN_DIR DIRECT /end RECORD_LAYOUT
/begin RECORD_LAYOUT _REC_MAP_20_u2_u1_u1 FNC_VALUES 1 UWORD COLUMN_DIR DIRECT /end RECORD_LAYOUT
/begin RECORD_LAYOUT _REC_CUR_20_u2_u2 FNC_VALUES 1 UWORD COLUMN_DIR DIRECT /end RECORD_LAYOUT
/begin RECORD_LAYOUT _REC_VAL_20_s1 FNC_VALUES 1 SBYTE COLUMN_DIR DIRECT /end RECORD_LAYOUT
/begin RECORD_LAYOUT _REC_VAL_20_u4 FNC_VALUES 1 ULONG COLUMN_DIR DIRECT /end RECORD_LAYOUT
/begin RECORD_LAYOUT _REC_CUR_20_s2_u1 FNC_VALUES 1 SWORD COLUMN_DIR DIRECT /end RECORD_LAYOUT
/begin RECORD_LAYOUT _REC_CUR_52_UBYTE_u2_u1 NO_AXIS_PTS_X 1 UBYTE AXIS_PTS_X 2 UBYTE INDEX_INCR DIRECT FNC_VALUES 3 UWORD COLUMN_DIR DIRECT /end RECORD_LAYOUT
/begin RECORD_LAYOUT _REC_CUR_52_UBYTE_s1_u1 NO_AXIS_PTS_X 1 UBYTE AXIS_PTS_X 2 UBYTE INDEX_INCR DIRECT FNC_VALUES 3 SBYTE COLUMN_DIR DIRECT /end RECORD_LAYOUT
/begin RECORD_LAYOUT _REC_CUR_52_UWORD_u2_u2 NO_AXIS_PTS_X 1 UWORD AXIS_PTS_X 2 UWORD INDEX_INCR DIRECT FNC_VALUES 3 UWORD COLUMN_DIR DIRECT /end RECORD_LAYOUT
/begin RECORD_LAYOUT _REC_CUR_52_UBYTE_u1_u1 NO_AXIS_PTS_X 1 UBYTE AXIS_PTS_X 2 UBYTE INDEX_INCR DIRECT FNC_VALUES 3 UBYTE COLUMN_DIR DIRECT /end RECORD_LAYOUT
/begin RECORD_LAYOUT _REC_MAP_52_UBYTE_u1_u1_u2 NO_AXIS_PTS_X 1 UBYTE NO_AXIS_PTS_Y 2 UBYTE AXIS_PTS_X 3 UBYTE INDEX_INCR DIRECT AXIS_PTS_Y 4 UWORD INDEX_INCR DIRECT FNC_VALUES 5 UBYTE COLUMN_DIR DIRECT /end RECORD_LAYOUT
/begin RECORD_LAYOUT _REC_CUR_20_s1_u1 FNC_VALUES 1 SBYTE COLUMN_DIR DIRECT /end RECORD_LAYOUT
/begin RECORD_LAYOUT _REC_VAL_2_u1 FNC_VALUES 1 UBYTE COLUMN_DIR DIRECT /end RECORD_LAYOUT
/begin RECORD_LAYOUT _REC_CUR_32_u1_u1 NO_AXIS_PTS_X 1 UBYTE AXIS_PTS_X 2 UBYTE INDEX_INCR DIRECT FNC_VALUES 3 UBYTE COLUMN_DIR DIRECT /end RECORD_LAYOUT
/begin RECORD_LAYOUT _REC_VAL_2_s1 FNC_VALUES 1 SBYTE COLUMN_DIR DIRECT /end RECORD_LAYOUT
/begin RECORD_LAYOUT _REC_VAL_2_u2 FNC_VALUES 1 UWORD COLUMN_DIR DIRECT /end RECORD_LAYOUT
/begin RECORD_LAYOUT _REC_MAP_52_UBYTE_u2_u1_u2 NO_AXIS_PTS_X 1 UBYTE NO_AXIS_PTS_Y 2 UBYTE AXIS_PTS_X 3 UBYTE INDEX_INCR DIRECT AXIS_PTS_Y 4 UWORD INDEX_INCR DIRECT FNC_VALUES 5 UWORD COLUMN_DIR DIRECT /end RECORD_LAYOUT
/begin RECORD_LAYOUT _REC_VAL_2_s2 FNC_VALUES 1 SWORD COLUMN_DIR DIRECT /end RECORD_LAYOUT
/begin RECORD_LAYOUT _REC_MAP_52_UWORD_u2_u2_u2 NO_AXIS_PTS_X 1 UWORD NO_AXIS_PTS_Y 2 UWORD AXIS_PTS_X 3 UWORD INDEX_INCR DIRECT AXIS_PTS_Y 4 UWORD INDEX_INCR DIRECT FNC_VALUES 5 UWORD COLUMN_DIR DIRECT /end RECORD_LAYOUT
/begin FUNCTION MON_Monitoring_of_minimum_torque "_Monitoring of minimum torque at clutch"
 /begin DEF_CHARACTERISTIC c_n_st_max_mon ip_tq_min_clu_max_mon ip_fac_conv_mon ip_tqi_min_req_pu_mon /end DEF_CHARACTERISTIC
 /begin OUT_MEASUREMENT lv_err_tq_min_clu_mon tq_min_clu_mon abc_tq_min_clu_mon tq_min_clu_dif_mon tq_min_clu_mdl_1_mon tq_min_clu_mdl_2_mon tq_min_clu_mdl_mon tq_conv_max_mon tq_st_mon /end OUT_MEASUREMENT
/end FUNCTION
/begin FUNCTION MON_Monitoring_of_maximum_torque "_Monitoring of maximum torque at clutch" /begin DEF_CHARACTERISTIC ip_tq_max_clu_max_mon /end DEF_CHARACTERISTIC
 /begin OUT_MEASUREMENT lv_err_tq_max_clu_mon tq_max_clu_mon tq_max_clu_dif_mon abc_tq_max_clu_mon /end OUT_MEASUREMENT
/end FUNCTION
/begin FUNCTION MON_Monitoring_of_engine_speed "_Monitoring of engine speed" /begin DEF_CHARACTERISTIC c_n_32_dif_rel_max_mon c_n_32_min_mon c_n_32_lim_mon /end DEF_CHARACTERISTIC
 /begin OUT_MEASUREMENT n_32_mon n_32_sub_mon abc_n_32_mon n_32_dif_rel_mon t_seg_sw_mon lv_err_n_32_mon /end OUT_MEASUREMENT
/end FUNCTION
/begin FUNCTION MON_Desired_indicated_engine_tor "_Desired indicated engine torque"
 /begin DEF_CHARACTERISTIC c_t_tqi_mon c_tqi_sp_dec_max_mon ip_fac_tq_req_driv_mon ip_fac_tq_req_driv_rng_l_mon /end DEF_CHARACTERISTIC
 /begin OUT_MEASUREMENT tqi_req_tot_mon tqi_sp_mon fac_tq_req_mon /end OUT_MEASUREMENT
/end FUNCTION
/begin FUNCTION MON_Actual_indicated_engine_torq "_Actual indicated engine torque"
 /begin DEF_CHARACTERISTIC ip_eff_iga_mon ip_iga_ref_mon ip_tqi_ref_mon c_iga_ref_egr_cor_lim_mon /end DEF_CHARACTERISTIC
 /begin OUT_MEASUREMENT tqi_av_mon eff_iga_av_mon iga_ref_cor_mon eff_scc_av_1_mon eff_scc_av_2_mon eff_scc_av_mon /end OUT_MEASUREMENT
/end FUNCTION
/begin FUNCTION MON_Monitoring_of_actual_indicat "_Monitoring of actual indicated engine torque"
 /begin DEF_CHARACTERISTIC ip_tqi_dif_max_mon c_dec_tqi_dif_max_mon c_tqi_dif_max_ofs_mon /end DEF_CHARACTERISTIC
 /begin OUT_MEASUREMENT tqi_dif_max_mon tqi_dif_mon abc_tqi_av_mon tqi_dif_max_ofs_mon lv_err_tqi_av_mon /end OUT_MEASUREMENT
/end FUNCTION
/begin FUNCTION MON_Monitoring_of_engine_speed_l "_Monitoring of engine speed limitation" /begin DEF_CHARACTERISTIC c_n_max_mtc_lih_thd_mon /end DEF_CHARACTERISTIC /begin OUT_MEASUREMENT lv_err_tqi_n_max_mon abc_tqi_n_max_mon /end OUT_MEASUREMENT /end FUNCTION
/begin FUNCTION MON_Fault_reaction_of_process_mo "_Fault reaction of process monitoring"
 /begin OUT_MEASUREMENT lv_off_iv_mon lv_off_mtc_iv_mu_mon lv_off_mtc_mon lv_n_lim_req_mon /end OUT_MEASUREMENT
/end FUNCTION
/begin FUNCTION MON_Can_signals "_Can-signals"
 /begin DEF_CHARACTERISTIC c_can_vb_min_diag_mon c_t_msr_inh_mon c_tqi_stnd_mon c_t_dcc_inh_mon c_t_max_brake_det_dcc_mon c_vs_fil_amt_mon c_t_max_state_amt_1_diag_mon c_t_max_state_amt_2_diag_mon c_tqi_amt_diag_mon c_t_max_state_amt_3_diag_mon c_t_max_tqi_amt_diag_mon c_tqi_amt_cond_diag_mon c_tqi_amt_can_es_mon c_t_max_state_clu_amt_diag_mon c_t_amt_inh_mon c_t_gs_inh_mon c_vs_min_tq_gs_inc_mon c_t_dly_min_vs_tq_gs_inc_mon c_crlc_tq_gs_inc_plaus_mon c_int_max_tq_gs_inc_mon c_int_min_tq_gs_inc_mon c_t_dly_ac_max_tq_gs_inc_mon c_t_max_tq_gs_inc_mon c_t_dly_tq_max_tq_gs_inc_mon ip_ac_max_tq_gs_inc_mon ip_tq_max_tq_gs_inc_mon c_int_tq_gs_inc_rest_mon c_t_dif_min_tq_gs_inc_mon /end DEF_CHARACTERISTIC
 /begin OUT_MEASUREMENT tqi_msr_mon t_msr_inh_mon abc_msr_inh_mon tq_msr_mon tq_dcc_mon abc_dcc_inh_mon lv_err_dcc_rev_mon t_dcc_brake_det_mon lv_err_dcc_inh_mon t_dcc_inh_mon state_err_amt_mon t_state_amt_1_diag_mon t_state_amt_2_diag_mon t_state_amt_3_diag_mon t_state_clu_amt_diag_mon t_tqi_amt_diag_mon tqi_amt_plaus_mon tqi_gs_mon lv_err_amt_inh_mon t_amt_inh_mon t_gs_inh_mon tq_gs_mon lv_err_gs_inh_mon lv_err_tq_gs_inc_plaus_mon state_gs_plaus_mon lv_int_max_tq_gs_inc_mon int_tq_gs_inc_mon lv_vs_min_tq_gs_inc_mon ctr_t_vs_tq_gs_inc_mon ctr_t_ac_tq_gs_inc_mon lv_ac_max_tq_gs_inc_mon lv_t_min_tq_gs_inc_deac_mon ctr_t_max_tq_gs_inc_mon lv_t_max_tq_gs_inc_mon lv_tq_max_tq_gs_inc_mon ctr_t_dif_min_tq_gs_inc_mon ctr_t_tq_max_tq_gs_inc_mon abc_amt_inh_mon state_amt_old_mon lv_err_dcc_irrev_mon lv_dcc_off_ecu_mon tq_amt_mon tqi_amt_mon abc_gs_inh_mon lv_err_msr_inh_mon /end OUT_MEASUREMENT
/end FUNCTION
/begin FUNCTION MON_Monitoring_of_cruse_control_ "_Monitoring of cruse control conditions" /begin DEF_CHARACTERISTIC c_vs_min_cru_mon c_t_cru_inh_mon /end DEF_CHARACTERISTIC
 /begin OUT_MEASUREMENT t_cru_inh_mon fac_tq_req_cru_mon abc_cru_inh_mon lv_err_cru_inh_mon /end OUT_MEASUREMENT
/end FUNCTION
/begin FUNCTION MON_Monitoring_of_mass_air_flow_ "_Monitoring of mass air flow signal (MAF)"
 /begin DEF_CHARACTERISTIC c_maf_sub_mmv_crlc_mon c_n_tps_min_diag_mon c_tps_slop_mon c_v_tps_ad_el_bol_1_mon c_v_tps_ad_el_bol_2_mon c_v_tps_max_mon c_v_tps_ratio_hys_mon ip_fac_tps_isa_mon ip_maf_max_isa_mon ip_fac_pq_isa_mon c_n_min_maf_diag_mon ip_pq_mon ip_fac_maf_sub_cor_mon ip_maf_sub_mon ip_maf_sub_thd_mon /end DEF_CHARACTERISTIC
 /begin OUT_MEASUREMENT abc_maf_mon abc_tps_ratio_mon maf_mon maf_sub_mon pq_turb_sys_mon tps_av_mon tps_sum_av_mon v_tps_1_mon v_tps_2_mon maf_sub_cor_mmv_mon maf_sub_tps_mon maf_sub_isa_mon lv_err_tps_mon lv_err_maf_mon /end OUT_MEASUREMENT
/end FUNCTION
/begin FUNCTION MON_Errors "_Errors"
 /begin OUT_MEASUREMENT lv_err_conv_mon_1 lv_err_tq_ext_mon_1 lv_err_cru_inh_mon_1 lv_err_maf_tps_mon_1 lv_err_tqi_n_max_mon_1 lv_err_n_32_mon_1 lv_err_pvs_mon_1 lv_err_tqi_av_mon_1 lv_err_tq_dif_isc_mon_1 lv_err_tq_req_mon_1 /end OUT_MEASUREMENT
/end FUNCTION
/begin FUNCTION MON_Processor_Monitoring_by_copy "_Processor Monitoring by copy of Process Monitoring"
 /begin DEF_CHARACTERISTIC c_n_max_mtc_lih_thd_mon2 c_tqi_sp_dec_max_mon2 c_t_tqi_mon2 c_iga_ref_egr_cor_lim_mon2 lc_val_mo2_ans id_n_32_mon2__idx id_sf_2_mon2__idx ip_tqi_dif_max_mon2 id_tq_max_clu_mon2__idx id_state_iv_mon2__idx id_iga_ref_egr_cor_mon2__idx id_t_tqi_mon2__idx id_tqi_sp_mon2__idx id_abc_tqi_av_mon2__idx ip_fac_tq_req_driv_mon2 ip_tqi_ref_mon2 id_abc_tqi_n_max_mon2__idx ip_eff_iga_mon2 id_tq_dif_p_d_is_mon2__idx id_tq_egs_mon2__idx id_iga_igc_mon2__idx id_tq_esp_mon2__idx id_maf_mon2__idx id_pv_av_mon2__idx id_tq_loss_mon2__idx ip_iga_ref_mon2 id_sf_1_mon2__idx id_tq_min_clu_mon2__idx id_fac_tq_req_cru_mon2__idx id_inh_swi_iv_mon2__idx id_lv_rng_l_req_mon2__idx ip_fac_tq_req_driv_rng_l_mon2 val_mo3_swi_cal_cks /end DEF_CHARACTERISTIC
 /begin OUT_MEASUREMENT fac_tq_req_driv_mon sf_1_mon2.bf.lv_tqi_mon_act_mon2_sf sf_1_mon2.bf.lv_n_lim_etc_mon2_sf sf_1_mon2.bf.lv_err_conv_mon2_sf sf_1_mon2.bf.lv_err_n_32_mon2_sf sf_1_mon2.bf.lv_err_tq_dif_p_d_is_mon2_sf sf_1_mon2.bf.lv_err_tq_dif_i_is_mon2_sf sf_1_mon2.bf.lv_err_tq_loss_mon2_sf sf_1_mon2.bf.lv_err_tq_min_clu_mon2_sf sf_1_mon2.bf.lv_err_tq_max_clu_mon2_sf sf_1_mon2.bf.lv_err_pvs_mon2_sf sf_1_mon2.bf.lv_err_tps_mon2_sf sf_1_mon2.bf.lv_err_maf_mon2_sf sf_1_mon2.word sf_2_mon2.bf.val_mo3_pwr_stag_dis_mc_mon2_sf sf_2_mon2.bf.lv_err_tran_ena_mon2_sf sf_2_mon2.bf.lv_n_lim_req_mon2_sf sf_2_mon2.bf.lv_off_mtc_iv_mu_mon2_sf sf_2_mon2.bf.lv_off_iv_mon2_sf sf_2_mon2.bf.lv_off_mtc_mon2_sf sf_2_mon2.bf.lv_err_tqi_av_mon2_sf sf_2_mon2.bf.lv_err_tqi_n_max_mon2_sf sf_2_mon2.word state_iv_mon2.bf.lv_prev_state_iv0_mon2_sf state_iv_mon2.bf.lv_prev_state_iv1_mon2_sf state_iv_mon2.bf.lv_prev_state_iv2_mon2_sf state_iv_mon2.bf.lv_prev_state_iv3_mon2_sf state_iv_mon2.bf.lv_prev_state_iv4_mon2_sf state_iv_mon2.bf.lv_prev_state_iv5_mon2_sf state_iv_mon2.word val_mo2_ans_tst fac_tq_req_mon2 fac_tq_req_driv_mon2 tq_esp_mon2 tq_loss_mon2 tqi_av_mon2 pv_av_mon2 fac_tq_req_cru_mon2 tq_dif_p_d_is_mon2 tq_min_clu_mon2 maf_mon2 abc_tqi_av_mon2 n_32_mon2 tq_max_clu_mon2 tqi_dif_max_mon2 iga_ref_egr_cor_mon2 iga_ref_cor_mon2 tqi_dif_mon2 abc_tqi_n_max_mon2 tqi_req_tot_mon2 iga_igc_mon2 tqi_sp_mon2 tq_egs_mon2 eff_iga_av_mon2 eff_scc_av_2_mon2 eff_scc_av_mon2 eff_scc_av_1_mon2 t_tqi_mon2 inh_swi_iv_mon2 val_mo3_av_cal_cks_high val_mo3_av_cal_cks_low val_mo2_ans /end OUT_MEASUREMENT
/end FUNCTION
/begin FUNCTION MON_Processor_Monitoring "_Processor Monitoring"
 /begin DEF_CHARACTERISTIC val_mo3_cal_cks_high val_mo3_cal_cks_low val_mo3_ans_cpm_tab /end DEF_CHARACTERISTIC
 /begin OUT_MEASUREMENT val_mo3_predrive_act val_mo3_tst_rec_idx_mo2 bios_test_ecu_ram bios_test_ecu_ram_cpl /end OUT_MEASUREMENT
/end FUNCTION
/begin FUNCTION MON_Fault_Reaction_of_Processor_ "_Fault Reaction of Processor Monitoring"
 /begin OUT_MEASUREMENT val_mo3_err_code_mc val_mo3_err_code_mu val_mo3_pwr_stag_dis_mc val_mo3_pwr_stag_dis_mu val_mo3_rst_ctr_mc val_mo3_rst_ctr_mu /end OUT_MEASUREMENT
/end FUNCTION
/begin FUNCTION MON_Monitoring_of_sport_switch ""
 /begin DEF_CHARACTERISTIC c_v_sof_swi_on_tol_mon c_v_sof_swi_on_bol_mon lc_var_sof_swi_mon lc_rng_l_mon lc_conf_city_ena_mon c_pv_av_sof_min_mon c_fac_tq_req_driv_sof_max_mon c_pv_av_grd_sof_max_mon c_t_pv_av_grd_sof_max_mon lc_rng_l_man_as_mon c_v_sof_swi_min_mon c_v_sof_swi_max_mon /end DEF_CHARACTERISTIC
 /begin OUT_MEASUREMENT lv_sof_swi_req_mon lv_sof_swi_mon lv_rng_l_mon lv_rng_l_req_mon lv_err_sof_inh_mon abc_sof_inh_mon /end OUT_MEASUREMENT
/end FUNCTION
/begin FUNCTION KT_IBS ""
 /begin DEF_CHARACTERISTIC ENABSDIBS ENISOC0 ENUSOC0 ERREPEAT IBSTSTERR IBSVERSION IBUNPLADEL ISLEEPGRZ ISTARTTRIG IWAKEUPGRZ KLIBSTEMP1 T1SCHWELLE T1SOC0 T2SCHWELLE T2SOC0 T3SCHWELLE T3SOC0 TNUSTART TNUSTARTFL TPT1TICO TPT1USTFGK TSLEEPRUH TUPT1SOC0 USOC0GRENZ /end DEF_CHARACTERISTIC
 /begin OUT_MEASUREMENT B_eb_busy B_eb_txok B_eb_write B_ibfbsd B_ibfebsd B_ibunplau B_startfgk chk16_erom chkpara ebsd_adr ebsd_errdir ebsd_errep ebsd_errin ebsd_nbyt ebsd_varin ercntchksu ercntcksub ercntparib ercntparit ercntunteb ercntunter ibatt_10 ibatt_1000 ibatt_200 ibatt_w ibcntreseb ibcntreset ibcntupdat ibhwversi ibswbase ibswchang ibs_errors ibs_msgind ibs_msgrdy ibs_msgsta ibs_msgwri ibs_reg4 ibs_reg5 ibs_start ib_chk16 ib_parlen isoc0 itnstart ivorstart ktib_chk16 kt_IbsStatus kt_OldIbsStatus qelad qeladsoc0 qlad qladsoc0 t1histiruh t2histiruh t3histiruh t4histiruh tbatt tbattroh tbattsoc0 tbatt_max tbatt_maxi tbatt_min tbatt_mini tbatt_tmp u1soc0 u2soc0 u3soc0 ubatthiroh ubattloroh ubatt_w unind utnstart uvorstart /end OUT_MEASUREMENT
/end FUNCTION
/begin FUNCTION LLPMCTRL ""
 /begin DEF_CHARACTERISTIC B_IFBSAKAP B_IFUPLAAP DFLLMIN DSOCLLANH LLANHAPP LLPMAPP NLLMIN S_B_IFBSAK S_B_IFPLAK S_N_IDLIBS /end DEF_CHARACTERISTIC
 /begin OUT_MEASUREMENT B_ifbsa7 B_ifupla7 n_idlibs /end OUT_MEASUREMENT
/end FUNCTION
/begin FUNCTION PMPDIAG "" /end FUNCTION
/begin FUNCTION PMPRSVCALC ""
 /begin DEF_CHARACTERISTIC ARY_PRIO ARY_PRIOCF ARY_PWRCF ARY_PWRDF B_SOCNPAPP CBATTAPP CTRCBRAPP CTRPCOSAPP CTRPRIOAPP C_RESET_PI DFFGEN_APP DFFILT_APP DSOCPRIO4 DSOCPRIO5 DSOCPRIO6 EHZOLDAPP HKW_dT HKW_IKL2 HKW_ING2 HKW_IPG2 HKW_IWIN2 HKW_NSTMX2 HKW_PIMAX2 HKW_PKL2 HKW_PNG2 HKW_PPG2 HKW_PSTMX2 HKW_PWIN2 HKW_TGL2 HKW_TRGL2 IBATT_APP IBSAKTAPP IBSWAKEAPP IFBSAKAPP IFUPLAKAPP KBMCNT_APP KDFPTC_LP KFISOLLPTC KF_IBTSOLL KLCF2PWRCF KLHKWN2 KLPRIO2PTC KLPRIO2PWR KL_DFPRIO KL_DFPTC KL_DSOCPTC KL_I2PTC KL_IREST KL_ISOLLPR KL_PTC KL_SOCPRIO KL_UBTPRIO KL_UB_PTC KSOGRZAPP KSUGRZAPP KUBPTC_LP K_DF_LP K_PTC_PI K_PWRCF_PI K_PWRDF_PI K_UBAT_LP LLPMFILTK MN_PRICFPI MN_PTC_PI MN_PWRDFPI MX_PRICFPI MX_PTC_PI MX_PWRDFPI PCOSCHGAPP PRIOCFAPP PTCPWRAPP PWRCOSAPP PWRSPCSAPP RQPCOSAPP SELSPCSAPP STPCOSAPP S_B_SOCNPL S_DFFGEN S_DF_FILT S_DME2IBS S_E65PRIO S_IBATTW S_IBSAKT7 S_IFBSAK7 S_IFUPLAK7 S_PCOSCHG S_PRIO_E60 S_PRIO_E65 S_PTCOLMAN S_PTC_OLD S_TBATT S_UBATTAPP TBATT_APP t_pmbs t_pmvs T_PRIODFPI T_PTC_PI T_PWRDF_PI UBATTW_APP UBTAPP UBTLOWMAX UBTLOWMIN ULEVAPP ULOWSETAPP WAKEGRZAPP WGH_PRIO WGH_PRIOCF WGH_PWRCF WGH_PWRDF DSOCPCOS DSOCHYST DFMIN DFMAX /end DEF_CHARACTERISTIC
 /begin OUT_MEASUREMENT all2ptc allptcfilt B_dubt B_enwake7 B_enwakeup B_ibsakt7 B_ifbsak7 B_ifuplak7 B_kl15_old B_moteasy B_motover B_notlauf B_pcoschg7 B_PIReset B_pmbsdanf B_pmvsdanf B_socnpl7 B_ubtlow B_uloreset cbattnenn cbattnenn7 cfallpi ctrcbr ctrcbr7 ctrcbrmem ctrpcos ctrpcos7 ctrpcosmem ctrprio ctrprio7 ctrpriocf ctrpriocf7 ctrpriocfm ctrpriomem ctrpwrcf ctrpwrcos ctrpwrcos7 ctrpwrdf ctrpwrmem ctrpwspcos ctrpwspcs7 df2pi dfall2pi dfallpi dffgen7 dff_filt7 dfpi2ptc dfpt1filt dfpt1ptc dfpt1_2ptc dsoc2pi dsoc2ptc dsoc_old ehz_pwloc2 hkw_iant2 hkw_ki2 hkw_kp2 hkw_lpgv2 hkw_pant2 hkw_pi2 hkw_rdiff2 hkw_sel_i2 hkw_sel_p2 hkw_sv2 ibatt_w7 ibtdiff ibtdiff2pi ibtsoll idiff2ptc igenrest ikurzogrz7 ikurzugrz7 ikurz_ogrz ikurz_ugrz ind_priocf ind_priodf ind_pwrcf ind_pwrcos isoll isolldiff iwakegrz7 kbmcount mem memprio1 memprio2 mempriocf1 mempriocf2 memptc1 memptc2 pgen2ptc pgenrest picntr pmbscount pmvscount priocf_loc ptc_pwr ptc_pwr7 rqpcos rqpcos7 rqpcosmem selspcos selspcos7 selspcosme stpcos stpcos7 stpcosmem tbatt7 ubatt_w7 ubdiff ubdiff2pi ubdifffilt ubdiffptc ubt ubt7 ubt7mem ubt7old ubtpt12ptc ubtpt1ptc udeltaabsc udeltac ulev ulev7 ulevmem ulow ulowtimer /end OUT_MEASUREMENT
/end FUNCTION
/begin FUNCTION PMSOCFIT "" /begin DEF_CHARACTERISTIC KFPMRIBATT KLPMSOCVU S_PMSOCFIT SOCFITAPP ZK_PMSOC /end DEF_CHARACTERISTIC /begin OUT_MEASUREMENT pm_rishow pm_socfit3 pm_ubatts soc_fit ubatts2 /end OUT_MEASUREMENT /end FUNCTION
/begin FUNCTION PMSOCKOR ""
 /begin DEF_CHARACTERISTIC ABSCHKORA D_AB_KORR1 D_AB_KORR2 D_AB_KORR3 DSOCA DSOCABSCH I_FIT_AUSW KL_SSOC PM_TABSMN PMTIMERSQ1 QSOCCL3 QSTARTFGA S_ABSCHK S_DSOCS S_PMTABSMN S_QSTARTFK S_SOCSTAFK SOC_STAFGA SOCFITABW SOCFITGRZ TSAISONFIL /end DEF_CHARACTERISTIC
 /begin OUT_MEASUREMENT absch_korr B_abschfit B_pm_fit2 B_pm_fit3 B_pmsocini B_q_start B_soc_npl d_soc d_socw d_socw_1 pm_ibslog pm_tsrdy pmsoc_help q_startfgk soc_korr soc_q_kor soc_rel soc_stfgk soc_stfgkw t_saison tsaisonalt /end OUT_MEASUREMENT
/end FUNCTION
/begin FUNCTION PMSOCSTART ""
 /begin DEF_CHARACTERISTIC KLUNSTART KLUTSTART RIN_GRENZ S_PM_TEST1 S_PMSTARTQ S_RIN USTARTGRZ /end DEF_CHARACTERISTIC
 /begin OUT_MEASUREMENT B_pm_aux10 B_pm_aux11 B_pm_aux2 B_pm_aux3 B_pm_aux4 B_pm_aux8 B_pm_aux9 B_pmaux1 B_pmaux5 B_pmsqrdy B_pmstartq B_resetsta idelta nnstartb pmstartsta rin_start status u_grenz /end OUT_MEASUREMENT
/end FUNCTION
/begin FUNCTION PMUGENCALC ""
 /begin DEF_CHARACTERISTIC B_IFBSAAPP B_IFUPLAPP DFOVERRIDE KFUSOLL KLUSOLL PMUBAT_MAX PMUBAT_MIN PMUGEN_MAX PMUGEN_MIN S_B_IFBSAC S_B_IFUPLA S_UIBS T_B_NMOT T_PMUGEN UGENNORM UIBSAPP USTEPMIN /end DEF_CHARACTERISTIC
 /begin OUT_MEASUREMENT B_genclcon B_ifbsk7 B_ifplak7 t_bnmotakt t_delta ubattsoll ubattsoll7 udelta udeltaabs uibs uibs7 /end OUT_MEASUREMENT
/end FUNCTION
/begin FUNCTION PMSOCCALC ""
 /begin DEF_CHARACTERISTIC CBATT_DEF IB_COMMVAL KFSOC0UBIB KFSOCLF KLSOC0TEMP PMQ_UX Q_BILAPWF QSOCCL1 QSOCCL2 S_BSOCCALC S_SOC_BILA S_SOC_QUAL SOC_BILAWA SOC_Q_PWF SOC_QUALIA /end DEF_CHARACTERISTIC
 /begin OUT_MEASUREMENT B_soc_pwf B_soccalc cbatt_lo d_qelad d_qlad ib_commcnt ib_commsta isoc0loc q_bila qeladold qladold sco_b_loc soc_bila soc_q_loc soc_quali tsocloc ubatt0 /end OUT_MEASUREMENT
/end FUNCTION
/end MODULE
/end PROJECT
