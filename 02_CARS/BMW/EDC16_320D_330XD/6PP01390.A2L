ASAP2_VERSION 1 3
/begin PROJECT P390 "BMW DDE6.2 6-Zylinder VP0.1 11.11.2003 CAN12H"
/begin HEADER "" VERSION "VP01_6Z_CAN12H" PROJECT_NO P390 /end HEADER
/begin MODULE DIM ""
/begin MOD_COMMON "" BYTE_ORDER MSB_FIRST ALIGNMENT_BYTE 1 ALIGNMENT_WORD 2 ALIGNMENT_LONG 4 ALIGNMENT_FLOAT32_IEEE 4 /end MOD_COMMON
/begin CHARACTERISTIC CW_BATTCOD "Enable Handcodierung" VALUE 0xc15a9 TKW_VV_VV_UB 100.0 Def_st_ub_q1 0.0 2.0000 /begin FUNCTION_LIST LBATTCAL /end FUNCTION_LIST /end CHARACTERISTIC
/begin CHARACTERISTIC CW_BNS_LR "" VALUE 0xc16bc TKW_VV_VV_UB 100.0 Def_st_ub_q1 0.0 1.0000 /begin FUNCTION_LIST LOADRESP /end FUNCTION_LIST /end CHARACTERISTIC
/begin CHARACTERISTIC KF_LORESP "Kennfeld Loadresponse ueber Motordrehzahl und rel. Luftmasse" MAP 0xc1724 TKF_SW_SW_UB 100.0 Def_td_ub_q0p1 0.0 25.5000 /begin FUNCTION_LIST LOADRESP /end FUNCTION_LIST /begin AXIS_DESCR STD_AXIS Nkw Def_n_sw_q1p0 6 -32768.0000 32767.0000 /end AXIS_DESCR
 /begin AXIS_DESCR STD_AXIS Rf Def_rf_sw_q0p01 6 -327.6800 327.6700 FORMAT "%7.4" /end AXIS_DESCR
/end CHARACTERISTIC
/begin CHARACTERISTIC KF_TW "Kennfeld Tuningwahrscheinlichkeit" MAP 0xc1e98 TKF_UW_UW_UW 100.0 Def_f_uw_b100 0.0 99.9984 /begin FUNCTION_LIST MANDETEK /end FUNCTION_LIST /begin AXIS_DESCR STD_AXIS Twhydr Def_f_uw_b100 6 0.0 99.9984 FORMAT "%6.3" /end AXIS_DESCR /begin AXIS_DESCR STD_AXIS Twluft Def_f_uw_b100 6 0.0 99.9984 FORMAT "%6.3" /end AXIS_DESCR FORMAT "%6.3" /end CHARACTERISTIC
/begin CHARACTERISTIC KF_ZLRESOF "Kennfeld Generatorausschaltzeit bei Stillstand" MAP 0xc1702 TKF_UW_SW_UB 100.0 Def_td_ub_q1 0.0 255.0000 /begin FUNCTION_LIST LOADRESP /end FUNCTION_LIST
 /begin AXIS_DESCR STD_AXIS Tmot_start Def_t_sw_q0p01 4 -327.6800 327.6700 FORMAT "%5.2" /end AXIS_DESCR
 /begin AXIS_DESCR STD_AXIS Km_st Def_km_uw_q10 4 0.0 655350.0000 /end AXIS_DESCR
/end CHARACTERISTIC
/begin CHARACTERISTIC KF_ZLRRESOFV "Kennfeld Generatorausschaltzeit bei Fahrt" MAP 0xc16e0 TKF_UW_SW_UB 100.0 Def_td_ub_q1 0.0 255.0000 /begin FUNCTION_LIST LOADRESP /end FUNCTION_LIST
 /begin AXIS_DESCR STD_AXIS Tmot_start Def_t_sw_q0p01 4 -327.6800 327.6700 FORMAT "%5.2" /end AXIS_DESCR
 /begin AXIS_DESCR STD_AXIS Km_st Def_km_uw_q10 4 0.0 655350.0000 /end AXIS_DESCR
/end CHARACTERISTIC
/begin CHARACTERISTIC KL_BATTLSTR "Geschwindigkeitsfaktor Batterieumgebungstemperatur" CURVE 0xc15f8 TKL_UW_VV_UW 100.0 Def_f_uw_b256 0.0 255.9960 /begin FUNCTION_LIST LBATTCAL /end FUNCTION_LIST /begin AXIS_DESCR STD_AXIS V Def_v_uw_q1p0 6 0.0 360.0000 /end AXIS_DESCR FORMAT "%6.3" /end CHARACTERISTIC
/begin CHARACTERISTIC KL_EXPALH "Funktion EXP(-ALPHA*tabst_w) hinten" CURVE 0xc1640 TKL_UW_VV_UW 100.0 Def_f_uw_b1 0.0 9.99984741210938e-1 /begin FUNCTION_LIST LBATTCAL /end FUNCTION_LIST /begin AXIS_DESCR STD_AXIS Tn_abstell Def_st_uw_q1 11 0.0 65535.0000 /end AXIS_DESCR /end CHARACTERISTIC
/begin CHARACTERISTIC KL_EXPALV "Funktion EXP(-ALPHA*tabst_w) hinten" CURVE 0xc1612 TKL_UW_VV_UW 100.0 Def_f_uw_b1 0.0 9.99984741210938e-1 /begin FUNCTION_LIST LBATTCAL /end FUNCTION_LIST /begin AXIS_DESCR STD_AXIS Tn_abstell Def_st_uw_q1 11 0.0 65535.0000 /end AXIS_DESCR /end CHARACTERISTIC
/begin CHARACTERISTIC KL_EXPBETAV "Funktion EXP (-BETA*tabst_w)" CURVE 0xc15ca TKL_UW_VV_UW 100.0 Def_f_uw_b1 0.0 9.99984741210938e-1 /begin FUNCTION_LIST LBATTCAL /end FUNCTION_LIST /begin AXIS_DESCR STD_AXIS Tn_abstell Def_st_uw_q1 11 0.0 65535.0000 /end AXIS_DESCR /end CHARACTERISTIC
/begin CHARACTERISTIC KL_GENLDST "Auslastungsgrad Generator" CURVE 0xc1678 TKL_SW_VV_UB 100.0 Def_f_ub_b100 0.0 99.6093 /begin FUNCTION_LIST LDSTGEN /end FUNCTION_LIST
 /begin AXIS_DESCR STD_AXIS Tgen Def_t_sw_q0p1 6 -3276.8000 3276.7000 FORMAT "%4.1" /end AXIS_DESCR
/end CHARACTERISTIC
/begin CHARACTERISTIC KL_LADEKENNL "Batterieladespannungskennlinie" CURVE 0xc15b0 TKL_SW_VV_SW 100.0 Def_u_sw_b128 0.0 127.9960 /begin FUNCTION_LIST LBATTCAL /end FUNCTION_LIST
 /begin AXIS_DESCR STD_AXIS T_battabst Def_t_sw_q0p1 6 -3276.8000 3276.7000 FORMAT "%4.1" /end AXIS_DESCR
 FORMAT "%6.3" /end CHARACTERISTIC
/begin CHARACTERISTIC KL_LORESPM "Motorabhängiger Loadresponse-Faktor" CURVE 0xc16cc TKL_SW_VV_UB 100.0 Def_f_ub_b4 0.0 3.9843 /begin FUNCTION_LIST LOADRESP /end FUNCTION_LIST
 /begin AXIS_DESCR STD_AXIS Tmot Def_t_sw_q0p01 6 -327.6800 327.6700 FORMAT "%5.2" /end AXIS_DESCR
/end CHARACTERISTIC
/begin CHARACTERISTIC KL_OZLN "y = ln x" CURVE 0xc1f92 TKL_UW_VV_SW 100.0 Def_f_sw_b1 -1.0000 9.99969482421875e-1 /begin FUNCTION_LIST OZNIVDL /end FUNCTION_LIST /begin AXIS_DESCR STD_AXIS NO_INPUT_QUANTITY Def_f_uw_b2 6 0.0 1.9999 /end AXIS_DESCR /end CHARACTERISTIC
/begin CHARACTERISTIC KL_OZNMNIVKL "Kennlinie für Drehzahlkorrektur des Niveaus" CURVE 0xc1fac TKL_SW_VV_SB 100.0 Def_niv_sb_b37p5 -37.5000 37.2070 /begin FUNCTION_LIST OZNIVDL /end FUNCTION_LIST /begin AXIS_DESCR STD_AXIS N_ozmw Def_n_sw_q1p0 16 -32768.0000 32767.0000 /end AXIS_DESCR /end CHARACTERISTIC
/begin CHARACTERISTIC KL_OZPERMKL "Skalierungskennlinie Permittivität" CURVE 0xc1f0e TKL_UW_VV_UW 100.0 Def_perm_uw_b6 0.0 5.9999 /begin FUNCTION_LIST OZGG /end FUNCTION_LIST /begin AXIS_DESCR STD_AXIS Oz_permt Def_dez_uw_q1 2 0.0 65535.0000 /end AXIS_DESCR /end CHARACTERISTIC
/begin CHARACTERISTIC KL_OZTEMPKL "" CURVE 0xc1f18 TKL_UW_VV_SW 100.0 Def_t_sw_q0p1 -3276.8000 3276.7000 /begin FUNCTION_LIST OZGG /end FUNCTION_LIST /begin AXIS_DESCR STD_AXIS Oz_tempt Def_dez_uw_q1 2 0.0 65535.0000 /end AXIS_DESCR FORMAT "%4.1" /end CHARACTERISTIC
/begin CHARACTERISTIC KL_TKTOENIV "Umstetzung Tk -> Oelnivau" CURVE 0xc1fde TKL_UW_VV_UW 100.0 Def_td_uw_q0p1 0.0 6553.5000 /begin FUNCTION_LIST OZNIVDL /end FUNCTION_LIST
 /begin AXIS_DESCR STD_AXIS Td_og_tk Def_td_uw_q0p1 7 0.0 6553.5000 FORMAT "%4.1" /end AXIS_DESCR
 FORMAT "%4.1" /end CHARACTERISTIC
/begin CHARACTERISTIC KL_TOGNKOR "" CURVE 0xc201a TKL_SW_VV_SB 100.0 Def_niv_sb_b37p5 -37.5000 37.2070 /begin FUNCTION_LIST OZNIVDL /end FUNCTION_LIST
 /begin AXIS_DESCR STD_AXIS NO_INPUT_QUANTITY Def_n_sw_q1p0 16 -32768.0000 32767.0000 /end AXIS_DESCR
/end CHARACTERISTIC
/begin CHARACTERISTIC KL_TVTOEL "" CURVE 0xc1ffc TKL_UW_VV_SW 100.0 Def_t_sw_q0p1 -3276.8000 3276.7000 /begin FUNCTION_LIST OZNIVDL /end FUNCTION_LIST
 /begin AXIS_DESCR STD_AXIS K_PT1TOEL Def_td_uw_q0p1 7 0.0 6553.5000 FORMAT "%4.1" /end AXIS_DESCR
 FORMAT "%4.1" /end CHARACTERISTIC
/begin CHARACTERISTIC KL_TWHYDR "Kennlinie Tuningwahrscheinlichkeit Hydraulik" CURVE 0xc1e76 TKL_UW_VV_UW 100.0 Def_f_uw_b100 0.0 99.9984 /begin FUNCTION_LIST MANDETEK /end FUNCTION_LIST /begin AXIS_DESCR STD_AXIS Twhydrcnt Def_dez_uw_q1 8 0.0 65535.0000 /end AXIS_DESCR FORMAT "%6.3" /end CHARACTERISTIC
/begin CHARACTERISTIC KL_TWLUFT "Kennlinie Tuningwahrscheinlichkeit Luft" CURVE 0xc1e54 TKL_UW_VV_UW 100.0 Def_f_uw_b100 0.0 99.9984 /begin FUNCTION_LIST MANDETEK /end FUNCTION_LIST /begin AXIS_DESCR STD_AXIS Twluftcnt Def_dez_uw_q1 8 0.0 65535.0000 /end AXIS_DESCR FORMAT "%6.3" /end CHARACTERISTIC
/begin CHARACTERISTIC K_APPTBATINI "Enable Applikation Initwert Batterietemperatur" VALUE 0xc15aa TKW_VV_VV_UB 100.0 Def_st_ub_q1 0.0 255.0000 /begin FUNCTION_LIST LBATTCAL /end FUNCTION_LIST /end CHARACTERISTIC
/begin CHARACTERISTIC K_APPUPLLDST "Applikationswert St_ldstgen für Nachlauf" VALUE 0xc1670 TKW_VV_VV_UB 100.0 Def_st_ub_q1 0.0 255.0000 /begin FUNCTION_LIST LDSTGEN /end FUNCTION_LIST /end CHARACTERISTIC
/begin CHARACTERISTIC K_APP_LLAH "Kennwert zum Umschalten auf Applikationskonstante" VALUE 0xc169c TKW_VV_VV_UB 100.0 Def_st_ub_q1 0.0 255.0000 /begin FUNCTION_LIST LLRANH /end FUNCTION_LIST /end CHARACTERISTIC
/begin CHARACTERISTIC K_BATTHTAUVG "Zeitkonstante Batterie hinten bei VFZG>" VALUE 0xc1588 TKW_VV_VV_UW 100.0 Def_f_uw_b1 0.0 9.99984741210938e-1 /begin FUNCTION_LIST LBATTCAL /end FUNCTION_LIST /end CHARACTERISTIC
/begin CHARACTERISTIC K_BATTHTAUVK "Zeitkonstante Batterie hinten bei VFZG<" VALUE 0xc158a TKW_VV_VV_UW 100.0 Def_f_uw_b1 0.0 9.99984741210938e-1 /begin FUNCTION_LIST LBATTCAL /end FUNCTION_LIST /end CHARACTERISTIC
/begin CHARACTERISTIC K_BATTORT0 "Batterieeinbauort No1" VALUE 0xc15ab TKW_VV_VV_UB 100.0 Def_st_ub_q1 0.0 2.0000 /begin FUNCTION_LIST LBATTCAL /end FUNCTION_LIST /end CHARACTERISTIC
/begin CHARACTERISTIC K_BATTORT2 "Batterieeinbauort No2" VALUE 0xc15ac TKW_VV_VV_UB 100.0 Def_st_ub_q1 0.0 2.0000 /begin FUNCTION_LIST LBATTCAL /end FUNCTION_LIST /end CHARACTERISTIC
/begin CHARACTERISTIC K_BATTVTAUVG "Zeitkonstante Batterie vorne bei VFZG>" VALUE 0xc158c TKW_VV_VV_UW 100.0 Def_f_uw_b1 0.0 9.99984741210938e-1 /begin FUNCTION_LIST LBATTCAL /end FUNCTION_LIST /end CHARACTERISTIC
/begin CHARACTERISTIC K_BATTVTAUVK "Zeitkonstante Batterie bei VFZG<Zeitkonstante Batterie bei VFZG>" VALUE 0xc158e TKW_VV_VV_UW 100.0 Def_f_uw_b1 0.0 9.99984741210938e-1 /begin FUNCTION_LIST LBATTCAL /end FUNCTION_LIST /end CHARACTERISTIC
/begin CHARACTERISTIC K_BATT_ALFAH "Alphatau-Wert Batterie hinten" VALUE 0xc1590 TKW_VV_VV_UW 100.0 Def_f_uw_b1 1.52587890625e-5 9.99984741210938e-1 /begin FUNCTION_LIST LBATTCAL /end FUNCTION_LIST /end CHARACTERISTIC
/begin CHARACTERISTIC K_BATT_ALFAV "Alphatau-Wert Batterie vorne" VALUE 0xc1592 TKW_VV_VV_UW 100.0 Def_f_uw_b1 1.52587890625e-5 9.99984741210938e-1 /begin FUNCTION_LIST LBATTCAL /end FUNCTION_LIST /end CHARACTERISTIC
/begin CHARACTERISTIC K_BATT_BETAV "Beta-Wert Batterie vorne" VALUE 0xc1594 TKW_VV_VV_UW 100.0 Def_f_uw_b1 1.52587890625e-5 9.99984741210938e-1 /begin FUNCTION_LIST LBATTCAL /end FUNCTION_LIST /end CHARACTERISTIC
/begin CHARACTERISTIC K_BATVFZGTAU "VFZG-Umschaltschwelle TAU Batterie" VALUE 0xc1596 TKW_VV_VV_UW 100.0 Def_v_uw_q1p0 0.0 65535.0000 /begin FUNCTION_LIST LBATTCAL /end FUNCTION_LIST /end CHARACTERISTIC
/begin CHARACTERISTIC K_BGAPP "Applikationswert Generatorbegrenzung über Maximalmoment" VALUE 0xc16bd TKW_VV_VV_UB 100.0 Identity 0.0 1.0000 /begin FUNCTION_LIST LOADRESP /end FUNCTION_LIST /end CHARACTERISTIC
/begin CHARACTERISTIC K_CW_OZ "" VALUE 0xc1f22 TKW_VV_VV_UW 100.0 Def_dez_uw_q1 0.0 65535.0000 /begin FUNCTION_LIST OZNIVDL /end FUNCTION_LIST /end CHARACTERISTIC
/begin CHARACTERISTIC K_DFLLMIN "DF unterhalb derer die LLDZanh. zurueckgenommen wird." VALUE 0xc1692 TKW_VV_VV_UB 100.0 Def_f_ub_b100 0.0 99.6093 /begin FUNCTION_LIST LLPMCTRL /end FUNCTION_LIST /end CHARACTERISTIC
/begin CHARACTERISTIC K_DFMAX "Obere Schwelle DF Signal" VALUE 0xc1693 TKW_VV_VV_UB 100.0 Def_f_ub_b100 0.0 99.6093 /begin FUNCTION_LIST LLPMCTRL /end FUNCTION_LIST /end CHARACTERISTIC
/begin CHARACTERISTIC K_DFMODE "DF-Mode-Schalter themermisch/elektrisch" VALUE 0xc1671 TKW_VV_VV_UB 100.0 Def_st_ub_q1 0.0 255.0000 /begin FUNCTION_LIST LDSTGEN /end FUNCTION_LIST /end CHARACTERISTIC
/begin CHARACTERISTIC K_DFS_MAX "DF-Auslastung Maximalschwelle" VALUE 0xc1672 TKW_VV_VV_UB 100.0 Def_f_ub_b100 0.0 99.6093 /begin FUNCTION_LIST LDSTGEN /end FUNCTION_LIST /end CHARACTERISTIC
/begin CHARACTERISTIC K_DFS_MIN "DF-Auslastung Minimalschwelle" VALUE 0xc1673 TKW_VV_VV_UB 100.0 Def_f_ub_b100 0.0 99.6093 /begin FUNCTION_LIST LDSTGEN /end FUNCTION_LIST /end CHARACTERISTIC
/begin CHARACTERISTIC K_DFS_MITT "DF-Auslastung Mittelschwelle" VALUE 0xc1674 TKW_VV_VV_UB 100.0 Def_f_ub_b100 0.0 99.6093 /begin FUNCTION_LIST LDSTGEN /end FUNCTION_LIST /end CHARACTERISTIC
/begin CHARACTERISTIC K_DI1000DT "" VALUE 0xc1546 TKW_VV_VV_UB 100.0 Def_td_ub_q0p05 0.0 12.7500 /begin FUNCTION_LIST KT_IBS /end FUNCTION_LIST /end CHARACTERISTIC
/begin CHARACTERISTIC K_DI1000STG "" VALUE 0xc1544 TKW_VV_VV_UB 100.0 Def_i_ub_q0p08 0.0 20.4000 /begin FUNCTION_LIST KT_IBS /end FUNCTION_LIST /end CHARACTERISTIC
/begin CHARACTERISTIC K_DI1000TGRZ "" VALUE 0xc153b TKW_VV_VV_UB 100.0 Def_td_ub_q1 0.0 255.0000 /begin FUNCTION_LIST KT_IBS /end FUNCTION_LIST /end CHARACTERISTIC
/begin CHARACTERISTIC K_DI200DT "" VALUE 0xc1545 TKW_VV_VV_UB 100.0 Def_td_ub_q0p05 0.0 12.7500 /begin FUNCTION_LIST KT_IBS /end FUNCTION_LIST /end CHARACTERISTIC
/begin CHARACTERISTIC K_DI200STG "" VALUE 0xc1543 TKW_VV_VV_UB 100.0 Def_i_ub_q0p02 0.0 5.1000 /begin FUNCTION_LIST KT_IBS /end FUNCTION_LIST /end CHARACTERISTIC
/begin CHARACTERISTIC K_DIHIGHGRZ "" VALUE 0xc153f TKW_VV_VV_UB 100.0 Def_i_ub_q0p08 0.0 20.4000 /begin FUNCTION_LIST KT_IBS /end FUNCTION_LIST /end CHARACTERISTIC
/begin CHARACTERISTIC K_DILOWGRZ "" VALUE 0xc153e TKW_VV_VV_UB 100.0 Def_i_ub_q0p02 0.0 5.1000 /begin FUNCTION_LIST KT_IBS /end FUNCTION_LIST /end CHARACTERISTIC
/begin CHARACTERISTIC K_DIPL5 "" VALUE 0xc1549 TKW_VV_VV_UB 100.0 Def_dez_ub_q1 0.0 255.0000 /begin FUNCTION_LIST KT_IBS /end FUNCTION_LIST /end CHARACTERISTIC
/begin CHARACTERISTIC K_DIPL6 "" VALUE 0xc154a TKW_VV_VV_UB 100.0 Def_dez_ub_q1 0.0 255.0000 /begin FUNCTION_LIST KT_IBS /end FUNCTION_LIST /end CHARACTERISTIC
/begin CHARACTERISTIC K_DIPL7 "" VALUE 0xc154b TKW_VV_VV_UB 100.0 Def_dez_ub_q1 0.0 255.0000 /begin FUNCTION_LIST KT_IBS /end FUNCTION_LIST /end CHARACTERISTIC
/begin CHARACTERISTIC K_DIPL8 "" VALUE 0xc154c TKW_VV_VV_UB 100.0 Def_dez_ub_q1 0.0 255.0000 /begin FUNCTION_LIST KT_IBS /end FUNCTION_LIST /end CHARACTERISTIC
/begin CHARACTERISTIC K_DKL15FIL "" VALUE 0xc1541 TKW_VV_VV_UB 100.0 Def_td_ub_q0p00625 0.0 1.5937 /begin FUNCTION_LIST KT_IBS /end FUNCTION_LIST /end CHARACTERISTIC
/begin CHARACTERISTIC K_DOLNIV "Hysteresis Töns oelverb und oelverl" VALUE 0xc1f60 TKW_VV_VV_UB 100.0 Def_td_ub_q0p5 0.0 127.5000 /begin FUNCTION_LIST OZNIVDL /end FUNCTION_LIST /end CHARACTERISTIC
/begin CHARACTERISTIC K_DSOCHYST "Hystereschwelle SOC" VALUE 0xc168c TKW_VV_VV_SW 100.0 Def_f_sw_b100 -100.0000 99.9969 /begin FUNCTION_LIST LLPMCTRL /end FUNCTION_LIST FORMAT "%6.3" /end CHARACTERISTIC
/begin CHARACTERISTIC K_DSOCLLANH "Abstand zur Stfgrz, bei der die LLDZanh aktiviert wird." VALUE 0xc168e TKW_VV_VV_SW 100.0 Def_f_sw_b100 -100.0000 99.9969 /begin FUNCTION_LIST LLPMCTRL /end FUNCTION_LIST FORMAT "%6.3" /end CHARACTERISTIC
/begin CHARACTERISTIC K_DTANSKOR "Ansaugluftmodelloffset Aussentemperatur" VALUE 0xc1578 TKW_VV_VV_SW 100.0 Def_t_sw_q0p1 -3276.8000 3276.7000 /begin FUNCTION_LIST LBATTCAL /end FUNCTION_LIST FORMAT "%4.1" /end CHARACTERISTIC
/begin CHARACTERISTIC K_DTMAXGRZI "" VALUE 0xc153d TKW_VV_VV_UB 100.0 Def_td_ub_q1 0.0 255.0000 /begin FUNCTION_LIST KT_IBS /end FUNCTION_LIST /end CHARACTERISTIC
/begin CHARACTERISTIC K_DUIGRZ "" VALUE 0xc153c TKW_VV_VV_UB 100.0 Def_i_ub_q0p02 0.0 5.1000 /begin FUNCTION_LIST KT_IBS /end FUNCTION_LIST /end CHARACTERISTIC
/begin CHARACTERISTIC K_DUMINTGRZ "" VALUE 0xc1540 TKW_VV_VV_UB 100.0 Def_td_ub_q0p05 0.0 12.7500 /begin FUNCTION_LIST KT_IBS /end FUNCTION_LIST /end CHARACTERISTIC
/begin CHARACTERISTIC K_DUREFMAX "" VALUE 0xc1542 TKW_VV_VV_UB 100.0 Def_u_ub_q0p0196 0.0 4.9980 /begin FUNCTION_LIST KT_IBS /end FUNCTION_LIST /end CHARACTERISTIC
/begin CHARACTERISTIC K_DUREFMINI "" VALUE 0xc154d TKW_VV_VV_UB 100.0 Def_u_ub_q0p0196 0.0 4.9980 /begin FUNCTION_LIST KT_IBS /end FUNCTION_LIST /end CHARACTERISTIC
/begin CHARACTERISTIC K_ENABSDIBS "kt_ibs enable Kommunikation" VALUE 0xc1560 TKW_VV_VV_UB 100.0 Def_dez_ub_q1 0.0 255.0000 /begin FUNCTION_LIST KT_IBS /end FUNCTION_LIST /end CHARACTERISTIC
/begin CHARACTERISTIC K_ENAPPLGOFF "Enable Generatorauschaltsteuerung" VALUE 0xc16be TKW_VV_VV_UB 100.0 Def_st_ub_q1 0.0 255.0000 /begin FUNCTION_LIST LOADRESP /end FUNCTION_LIST /end CHARACTERISTIC
/begin CHARACTERISTIC K_ENAPPLRESP "Enable Handsteuerung Loadresponse" VALUE 0xc16bf TKW_VV_VV_UB 100.0 Def_st_ub_q1 0.0 255.0000 /begin FUNCTION_LIST LOADRESP /end FUNCTION_LIST /end CHARACTERISTIC
/begin CHARACTERISTIC K_ENISOC0 "" VALUE 0xc152c TKW_VV_VV_UB 100.0 Def_i_ub_q0p02 0.0 5.1000 /begin FUNCTION_LIST KT_IBS /end FUNCTION_LIST /end CHARACTERISTIC
/begin CHARACTERISTIC K_ENUSOC0 "" VALUE 0xc152d TKW_VV_VV_UB 100.0 Def_u_ub_q0p064_o6 6.0000 22.3200 /begin FUNCTION_LIST KT_IBS /end FUNCTION_LIST /end CHARACTERISTIC
/begin CHARACTERISTIC K_ERREPEAT "EBSD Fehler repeat" VALUE 0xc1561 TKW_VV_VV_UB 100.0 Def_dez_ub_q1 0.0 255.0000 /begin FUNCTION_LIST KT_IBS /end FUNCTION_LIST /end CHARACTERISTIC
/begin CHARACTERISTIC K_FHOGNMN "minimaler Wichtungsfaktor fuer minimale HFM-Luftmassen Schwelle in Abhaengigkeit von d.Hoehe fuer Generatorreduzierung" VALUE 0xc16c0 TKW_VV_VV_UB 100.0 Def_f_ub_b4 0.0 3.9843 /begin FUNCTION_LIST LOADRESP /end FUNCTION_LIST /end CHARACTERISTIC
/begin CHARACTERISTIC K_FHYDR "Konstante Fehler Hydraulikpfad" VALUE 0xc1e2c TKW_VV_VV_UL 100.0 Def_f_ul_b262144 0.0 196596.0001 /begin FUNCTION_LIST MANDETEK /end FUNCTION_LIST /end CHARACTERISTIC
/begin CHARACTERISTIC K_FHYDRMAX "Konstante max. Fehler Hydraulikpfad" VALUE 0xc1e30 TKW_VV_VV_UL 100.0 Def_f_ul_b262144 0.0 196596.0001 /begin FUNCTION_LIST MANDETEK /end FUNCTION_LIST /end CHARACTERISTIC
/begin CHARACTERISTIC K_FHYDRMIN "Konstante max. Fehler Hydraulikpfad" VALUE 0xc1e34 TKW_VV_VV_UL 100.0 Def_f_ul_b262144 0.0 196596.0001 /begin FUNCTION_LIST MANDETEK /end FUNCTION_LIST /end CHARACTERISTIC
/begin CHARACTERISTIC K_FIDMANHYDR "Konstante Funktionsidentifier Mandetek Hydraulikpfad" VALUE 0xc1e44 TKW_VV_VV_UB 100.0 Def_dez_ub_q1 0.0 255.0000 /begin FUNCTION_LIST MANDETEK /end FUNCTION_LIST /end CHARACTERISTIC
/begin CHARACTERISTIC K_FIDMANLUFT "Konstante Funktionsidentifier Mandetek Luftpfad" VALUE 0xc1e45 TKW_VV_VV_UB 100.0 Def_dez_ub_q1 0.0 255.0000 /begin FUNCTION_LIST MANDETEK /end FUNCTION_LIST /end CHARACTERISTIC
/begin CHARACTERISTIC K_FLAISTMAX "Faktor La_ist max" VALUE 0xc1e46 TKW_VV_VV_UB 100.0 Def_f_ub_b2 0.0 1.9921 /begin FUNCTION_LIST MANDETEK /end FUNCTION_LIST /end CHARACTERISTIC
/begin CHARACTERISTIC K_FLAISTMIN "Faktor La_ist min" VALUE 0xc1e47 TKW_VV_VV_UB 100.0 Def_f_ub_b2 0.0 1.9921 /begin FUNCTION_LIST MANDETEK /end FUNCTION_LIST /end CHARACTERISTIC
/begin CHARACTERISTIC K_FLUFT "Konstante Fehler Luftpfad" VALUE 0xc1e38 TKW_VV_VV_UL 100.0 Def_f_ul_b262144 0.0 262128.0002 /begin FUNCTION_LIST MANDETEK /end FUNCTION_LIST /end CHARACTERISTIC
/begin CHARACTERISTIC K_FLUFTMAX "Konstante max. Fehler lUFTpfad" VALUE 0xc1e3c TKW_VV_VV_UL 100.0 Def_f_ul_b262144 0.0 262128.0002 /begin FUNCTION_LIST MANDETEK /end FUNCTION_LIST /end CHARACTERISTIC
/begin CHARACTERISTIC K_FLUFTMIN "Konstante mIN. Fehler lUFTpfad" VALUE 0xc1e40 TKW_VV_VV_UL 100.0 Def_f_ul_b262144 0.0 262128.0002 /begin FUNCTION_LIST MANDETEK /end FUNCTION_LIST /end CHARACTERISTIC
/begin CHARACTERISTIC K_FMEISTMAX "Faktor Me_ist max" VALUE 0xc1e48 TKW_VV_VV_UB 100.0 Def_f_ub_b2 0.0 1.9921 /begin FUNCTION_LIST MANDETEK /end FUNCTION_LIST /end CHARACTERISTIC
/begin CHARACTERISTIC K_FMEISTMIN "Faktor Me_ist min" VALUE 0xc1e49 TKW_VV_VV_UB 100.0 Def_f_ub_b2 0.0 1.9921 /begin FUNCTION_LIST MANDETEK /end FUNCTION_LIST /end CHARACTERISTIC
/begin CHARACTERISTIC K_FMLMAX "Faktor Ml max" VALUE 0xc1e4a TKW_VV_VV_UB 100.0 Def_f_ub_b2 0.0 1.9921 /begin FUNCTION_LIST MANDETEK /end FUNCTION_LIST /end CHARACTERISTIC
/begin CHARACTERISTIC K_FMLMIN "Faktor Ml min" VALUE 0xc1e4b TKW_VV_VV_UB 100.0 Def_f_ub_b2 0.0 1.9921 /begin FUNCTION_LIST MANDETEK /end FUNCTION_LIST /end CHARACTERISTIC
/begin CHARACTERISTIC K_FPLDMAX "Faktor Pld max" VALUE 0xc1e4c TKW_VV_VV_UB 100.0 Def_f_ub_b2 0.0 1.9921 /begin FUNCTION_LIST MANDETEK /end FUNCTION_LIST /end CHARACTERISTIC
/begin CHARACTERISTIC K_FPLDMIN "Faktor Pld min" VALUE 0xc1e4d TKW_VV_VV_UB 100.0 Def_f_ub_b2 0.0 1.9921 /begin FUNCTION_LIST MANDETEK /end FUNCTION_LIST /end CHARACTERISTIC
/begin CHARACTERISTIC K_FTVAGRMAX "Faktor Tvagr max" VALUE 0xc1e4e TKW_VV_VV_UB 100.0 Def_f_ub_b2 0.0 1.9921 /begin FUNCTION_LIST MANDETEK /end FUNCTION_LIST /end CHARACTERISTIC
/begin CHARACTERISTIC K_FTVAGRMIN "Faktor Tvagr min" VALUE 0xc1e4f TKW_VV_VV_UB 100.0 Def_f_ub_b2 0.0 1.9921 /begin FUNCTION_LIST MANDETEK /end FUNCTION_LIST /end CHARACTERISTIC
/begin CHARACTERISTIC K_FTVPLDMAX "Faktor Tvpldmax" VALUE 0xc1e50 TKW_VV_VV_UB 100.0 Def_f_ub_b2 0.0 1.9921 /begin FUNCTION_LIST MANDETEK /end FUNCTION_LIST /end CHARACTERISTIC
/begin CHARACTERISTIC K_FTVPLDMIN "Faktor Tvpld min" VALUE 0xc1e51 TKW_VV_VV_UB 100.0 Def_f_ub_b2 0.0 1.9921 /begin FUNCTION_LIST MANDETEK /end FUNCTION_LIST /end CHARACTERISTIC
/begin CHARACTERISTIC K_GENLDDFMAX "Schwell Anzeige maximaler Auslastungsgrad Generator" VALUE 0xc1675 TKW_VV_VV_UB 100.0 Def_f_ub_b100 0.0 99.6093 /begin FUNCTION_LIST LDSTGEN /end FUNCTION_LIST /end CHARACTERISTIC
/begin CHARACTERISTIC K_GENLLAHAPP "Applikationskonstente zum Setzen B_idlespec" VALUE 0xc169d TKW_VV_VV_UB 100.0 Def_st_ub_q1 0.0 255.0000 /begin FUNCTION_LIST LLRANH /end FUNCTION_LIST /end CHARACTERISTIC
/begin CHARACTERISTIC K_GHYDRLA "Kennwerteblock für Gewicht Hydraulikpfad La_ist1" VAL_BLK 0xc1d3a TKW_VV_VV_UW 100.0 Def_f_uw_b16 0.0 15.9997 /begin FUNCTION_LIST MANDETEK /end FUNCTION_LIST NUMBER 120 FORMAT "%7.4" /end CHARACTERISTIC
/begin CHARACTERISTIC K_GHYDRME "Kennwerteblock für Gewicht Hydraulikpfad Me_ist" VAL_BLK 0xc179a TKW_VV_VV_SW 100.0 Def_me_sw_q0p01 0.0 327.6700 /begin FUNCTION_LIST MANDETEK /end FUNCTION_LIST NUMBER 120 FORMAT "%6.3" /end CHARACTERISTIC
/begin CHARACTERISTIC K_GHYDRML "Kennwerteblock für Gewicht Hydraulikpfad Ml" VAL_BLK 0xc188a TKW_VV_VV_SW 100.0 Def_ml_sw_q0p1 0.0 3276.7000 /begin FUNCTION_LIST MANDETEK /end FUNCTION_LIST NUMBER 120 FORMAT "%5.2" /end CHARACTERISTIC
/begin CHARACTERISTIC K_GLUFTML "Kennwerteblock für Gewicht Luftpfad Ml" VAL_BLK 0xc197a TKW_VV_VV_SW 100.0 Def_ml_sw_q0p1 0.0 3276.7000 /begin FUNCTION_LIST MANDETEK /end FUNCTION_LIST NUMBER 120 FORMAT "%5.2" /end CHARACTERISTIC
/begin CHARACTERISTIC K_GLUFTPLD "Kennwerteblock für Gewicht Luftpfad Pld" VAL_BLK 0xc1a6a TKW_VV_VV_SW 100.0 Def_p_sw_q1 0.0 32767.0000 /begin FUNCTION_LIST MANDETEK /end FUNCTION_LIST NUMBER 120 FORMAT "%4.1" /end CHARACTERISTIC
/begin CHARACTERISTIC K_GLUFTTVAGR "Kennwerteblock für Gewicht Luftpfad Tastverhältnis Agr" VAL_BLK 0xc1b5a TKW_VV_VV_SW 100.0 Def_tv_sw_q0p01 0.0 327.6700 /begin FUNCTION_LIST MANDETEK /end FUNCTION_LIST NUMBER 120 FORMAT "%6.3" /end CHARACTERISTIC
/begin CHARACTERISTIC K_GLUFTTVPLD "Kennwerteblock für Gewicht Luftpfad Tastverhältnis Pld" VAL_BLK 0xc1c4a TKW_VV_VV_SW 100.0 Def_tv_sw_q0p01 0.0 327.6700 /begin FUNCTION_LIST MANDETEK /end FUNCTION_LIST NUMBER 120 FORMAT "%6.3" /end CHARACTERISTIC
/begin CHARACTERISTIC K_IBSTSTERR "EBSD Fehler repeat" VALUE 0xc1563 TKW_VV_VV_UB 100.0 Def_dez_ub_q1 0.0 255.0000 /begin FUNCTION_LIST KT_IBS /end FUNCTION_LIST /end CHARACTERISTIC
/begin CHARACTERISTIC K_IBSVERSION "Liste der kompatiblen IBS SW- Versionen" VAL_BLK 0xc1550 TKW_VV_VV_UB 100.0 Def_dez_ub_q1 0.0 255.0000 /begin FUNCTION_LIST KT_IBS /end FUNCTION_LIST NUMBER 16 /end CHARACTERISTIC
/begin CHARACTERISTIC K_IBTEMPMAXI "" VALUE 0xc154e TKW_VV_VV_UB 100.0 Def_dez_ub_q1 0.0 255.0000 /begin FUNCTION_LIST KT_IBS /end FUNCTION_LIST /end CHARACTERISTIC
/begin CHARACTERISTIC K_IBTEMPMINI "" VALUE 0xc154f TKW_VV_VV_UB 100.0 Def_dez_ub_q1 0.0 255.0000 /begin FUNCTION_LIST KT_IBS /end FUNCTION_LIST /end CHARACTERISTIC
/begin CHARACTERISTIC K_IBUNPLADEL "EBSD Fehler repeat" VALUE 0xc1562 TKW_VV_VV_UB 100.0 Def_dez_ub_q1 0.0 255.0000 /begin FUNCTION_LIST KT_IBS /end FUNCTION_LIST /end CHARACTERISTIC
/begin CHARACTERISTIC K_IERRFIL "Filterkonstante für Filterung Erregerstrom" VALUE 0xc1676 TKW_VV_VV_UB 100.0 Def_f_ub_b1 0.0040 0.9960 /begin FUNCTION_LIST LDSTGEN /end FUNCTION_LIST /end CHARACTERISTIC
/begin CHARACTERISTIC K_ILMINUMG "integrierte Lufmassenschwelle Aussentemperaturmodell" VALUE 0xc1598 TKW_VV_VV_UW 100.0 Def_lm_uw_q0p000444 0.0 29.1266 /begin FUNCTION_LIST LBATTCAL /end FUNCTION_LIST FORMAT "%7.4" /end CHARACTERISTIC
/begin CHARACTERISTIC K_ISLEEPGRZ "" VALUE 0xc153a TKW_VV_VV_UB 100.0 Def_i_ub_q0p02 0.0 5.1000 /begin FUNCTION_LIST KT_IBS /end FUNCTION_LIST /end CHARACTERISTIC
/begin CHARACTERISTIC K_ISTARTTRIG "" VALUE 0xc1531 TKW_VV_VV_UB 100.0 Def_i_ub_q5p12 0.0 1305.6000 /begin FUNCTION_LIST KT_IBS /end FUNCTION_LIST /end CHARACTERISTIC
/begin CHARACTERISTIC K_LAISTO "Konstante Obergrenze Lambda" VALUE 0xc178e TKW_VV_VV_UW 100.0 Def_f_uw_b16 0.0 15.9997 /begin FUNCTION_LIST MANDETEK /end FUNCTION_LIST FORMAT "%7.4" /end CHARACTERISTIC
/begin CHARACTERISTIC K_LAISTTO "Konstante Obergrenze Lambdatotzone" VALUE 0xc1790 TKW_VV_VV_UW 100.0 Def_f_uw_b16 0.0 15.9997 /begin FUNCTION_LIST MANDETEK /end FUNCTION_LIST FORMAT "%7.4" /end CHARACTERISTIC
/begin CHARACTERISTIC K_LAISTTU "Konstante Untergrenze Lambdatotzone" VALUE 0xc1792 TKW_VV_VV_UW 100.0 Def_f_uw_b16 0.0 15.9997 /begin FUNCTION_LIST MANDETEK /end FUNCTION_LIST FORMAT "%7.4" /end CHARACTERISTIC
/begin CHARACTERISTIC K_LAISTU "Konstante Untergrenze Lambda" VALUE 0xc1794 TKW_VV_VV_UW 100.0 Def_f_uw_b16 0.0 15.9997 /begin FUNCTION_LIST MANDETEK /end FUNCTION_LIST FORMAT "%7.4" /end CHARACTERISTIC
/begin CHARACTERISTIC K_LAMAX "Konstante maximales Lambda" VALUE 0xc1796 TKW_VV_VV_UW 100.0 Def_f_uw_b16 0.0625 15.9997 /begin FUNCTION_LIST MANDETEK /end FUNCTION_LIST FORMAT "%7.4" /end CHARACTERISTIC
/begin CHARACTERISTIC K_LAMIN "Konstante minimales Lambda" VALUE 0xc1798 TKW_VV_VV_UW 100.0 Def_f_uw_b16 0.0 15.9997 /begin FUNCTION_LIST MANDETEK /end FUNCTION_LIST FORMAT "%7.4" /end CHARACTERISTIC
/begin CHARACTERISTIC K_LBATTMAXK "maximale Batterieladespannung Kofferraum" VALUE 0xc156a TKW_VV_VV_SW 100.0 Def_u_sw_b128 0.0 127.9960 /begin FUNCTION_LIST LBATTCAL /end FUNCTION_LIST FORMAT "%6.3" /end CHARACTERISTIC
/begin CHARACTERISTIC K_LBATTMAXM "maximale Batterieladespannung" VALUE 0xc156c TKW_VV_VV_SW 100.0 Def_u_sw_b128 0.0 127.9960 /begin FUNCTION_LIST LBATTCAL /end FUNCTION_LIST FORMAT "%6.3" /end CHARACTERISTIC
/begin CHARACTERISTIC K_LBATTMIN "minmale Batterieladespannung Licht an" VALUE 0xc156e TKW_VV_VV_SW 100.0 Def_u_sw_b128 0.0 127.9960 /begin FUNCTION_LIST LBATTCAL /end FUNCTION_LIST FORMAT "%6.3" /end CHARACTERISTIC
/begin CHARACTERISTIC K_LBATTTUMG "" VALUE 0xc1570 TKW_VV_VV_SW 100.0 Def_t_sw_q0p1 -3276.8000 3276.7000 /begin FUNCTION_LIST LBATTCAL /end FUNCTION_LIST FORMAT "%4.1" /end CHARACTERISTIC
/begin CHARACTERISTIC K_LBATTTUMGBA "" VALUE 0xc1572 TKW_VV_VV_SW 100.0 Def_t_sw_q0p1 -3276.8000 3276.7000 /begin FUNCTION_LIST LBATTCAL /end FUNCTION_LIST FORMAT "%4.1" /end CHARACTERISTIC
/begin CHARACTERISTIC K_LERNRATE "s" VALUE 0xc1e52 TKW_VV_VV_UB 100.0 Def_f_ub_b1 0.0 0.9960 /begin FUNCTION_LIST MANDETEK /end FUNCTION_LIST /end CHARACTERISTIC
/begin CHARACTERISTIC K_LLANHAPP "LLDZanh.-level, falls Generator fehlerhaft ist." VALUE 0xc1694 TKW_VV_VV_UB 100.0 Def_st_ub_q1 0.0 255.0000 /begin FUNCTION_LIST LLPMCTRL /end FUNCTION_LIST /end CHARACTERISTIC
/begin CHARACTERISTIC K_LLPMAPP "Handapplikationswert für Leerlaufdrehzahlvorgabe" VALUE 0xc1695 TKW_VV_VV_UB 100.0 Def_st_ub_q1 0.0 255.0000 /begin FUNCTION_LIST LLPMCTRL /end FUNCTION_LIST /end CHARACTERISTIC
/begin CHARACTERISTIC K_LRBNS "" VALUE 0xc16c1 TKW_VV_VV_UB 100.0 Def_td_ub_q0p1 0.0 25.5000 /begin FUNCTION_LIST LOADRESP /end FUNCTION_LIST /end CHARACTERISTIC
/begin CHARACTERISTIC K_LRESPAPP "Load-Response Applikation" VALUE 0xc16c2 TKW_VV_VV_UB 100.0 Def_td_ub_q0p1 0.0 25.5000 /begin FUNCTION_LIST LOADRESP /end FUNCTION_LIST /end CHARACTERISTIC
/begin CHARACTERISTIC K_LRMAXG "" VALUE 0xc16c3 TKW_VV_VV_UB 100.0 Def_td_ub_q0p1 0.0 25.5000 /begin FUNCTION_LIST LOADRESP /end FUNCTION_LIST /end CHARACTERISTIC
/begin CHARACTERISTIC K_MCOBATTORT "Codierung Hand Batterieeinbauort" VALUE 0xc15ad TKW_VV_VV_UB 100.0 Def_st_ub_q1 0.0 2.0000 /begin FUNCTION_LIST LBATTCAL /end FUNCTION_LIST /end CHARACTERISTIC
/begin CHARACTERISTIC K_MDGNHYS "Hysterese für Drehzahlschwelle Generator-Maximalmomentbegrenzung" VALUE 0xc16a0 TKW_VV_VV_SW 100.0 Def_n_sw_q1p0 -32768.0000 32767.0000 /begin FUNCTION_LIST LOADRESP /end FUNCTION_LIST /end CHARACTERISTIC
/begin CHARACTERISTIC K_MDGNMAX "Maximaldrehzahl für Generator-Maximalmomentbegrenzung" VALUE 0xc16a2 TKW_VV_VV_SW 100.0 Def_n_sw_q1p0 -32768.0000 32767.0000 /begin FUNCTION_LIST LOADRESP /end FUNCTION_LIST /end CHARACTERISTIC
/begin CHARACTERISTIC K_MEISTO "Konstante Obergrenze aktuelle Einspritzmasse" VALUE 0xc1762 TKW_VV_VV_SW 100.0 Def_me_sw_q0p01 0.0 327.6700 /begin FUNCTION_LIST MANDETEK /end FUNCTION_LIST FORMAT "%6.3" /end CHARACTERISTIC
/begin CHARACTERISTIC K_MEISTU "Konstante Untergrenze aktuelle Einspritzmasse" VALUE 0xc1764 TKW_VV_VV_SW 100.0 Def_me_sw_q0p01 0.0 327.6700 /begin FUNCTION_LIST MANDETEK /end FUNCTION_LIST FORMAT "%6.3" /end CHARACTERISTIC
/begin CHARACTERISTIC K_MEMAX "Konstante maximale Einspritzmasse" VALUE 0xc1766 TKW_VV_VV_SW 100.0 Def_me_sw_q0p01 1.2800 327.6700 /begin FUNCTION_LIST MANDETEK /end FUNCTION_LIST FORMAT "%6.3" /end CHARACTERISTIC
/begin CHARACTERISTIC K_MEMIN "Konstante minimale Einspritzmasse" VALUE 0xc1768 TKW_VV_VV_SW 100.0 Def_me_sw_q0p01 0.0 327.6700 /begin FUNCTION_LIST MANDETEK /end FUNCTION_LIST FORMAT "%6.3" /end CHARACTERISTIC
/begin CHARACTERISTIC K_MGMAXAPP "Applikationswert Genratormaximalmoment" VALUE 0xc16a4 TKW_VV_VV_SW 100.0 Def_m_sw_q0p1 -3276.8000 3276.7000 /begin FUNCTION_LIST LOADRESP /end FUNCTION_LIST FORMAT "%5.2" /end CHARACTERISTIC
/begin CHARACTERISTIC K_MLMAX "Konstante maximale Luftmasse pro Zylinder" VALUE 0xc176a TKW_VV_VV_SW 100.0 Def_ml_sw_q0p1 12.8000 3276.7000 /begin FUNCTION_LIST MANDETEK /end FUNCTION_LIST FORMAT "%5.2" /end CHARACTERISTIC
/begin CHARACTERISTIC K_MLMIN "Konstante minimale Luftmasse pro Zylinder" VALUE 0xc176c TKW_VV_VV_SW 100.0 Def_ml_sw_q0p1 0.0 3276.7000 /begin FUNCTION_LIST MANDETEK /end FUNCTION_LIST FORMAT "%5.2" /end CHARACTERISTIC
/begin CHARACTERISTIC K_MLO "Konstante Obergrenze Luftmasse pro Zylinder" VALUE 0xc176e TKW_VV_VV_SW 100.0 Def_ml_sw_q0p1 0.0 3276.7000 /begin FUNCTION_LIST MANDETEK /end FUNCTION_LIST FORMAT "%5.2" /end CHARACTERISTIC
/begin CHARACTERISTIC K_MLU "Konstante Untergrenze Luftmasse pro Zylinder" VALUE 0xc1770 TKW_VV_VV_SW 100.0 Def_ml_sw_q0p1 0.0 3276.7000 /begin FUNCTION_LIST MANDETEK /end FUNCTION_LIST FORMAT "%5.2" /end CHARACTERISTIC
/begin CHARACTERISTIC K_NACHFUELL12 "Nachfüll Erste Balken von Peistab" VALUE 0xc1f61 TKW_VV_VV_UB 100.0 Def_dez_ub_q1 0.0 255.0000 /begin FUNCTION_LIST OZNIVDL /end FUNCTION_LIST /end CHARACTERISTIC
/begin CHARACTERISTIC K_NACHFUELL25 "Nachfüll Zweite Balken von Peistab" VALUE 0xc1f62 TKW_VV_VV_UB 100.0 Def_dez_ub_q1 0.0 255.0000 /begin FUNCTION_LIST OZNIVDL /end FUNCTION_LIST /end CHARACTERISTIC
/begin CHARACTERISTIC K_NACHFUELL38 "Nachfüll Dritte Balken von Peistab" VALUE 0xc1f63 TKW_VV_VV_UB 100.0 Def_dez_ub_q1 0.0 255.0000 /begin FUNCTION_LIST OZNIVDL /end FUNCTION_LIST /end CHARACTERISTIC
/begin CHARACTERISTIC K_NACHFUELL53 "Nachfüll Vierte Balken von Peistab" VALUE 0xc1f64 TKW_VV_VV_UB 100.0 Def_dez_ub_q1 0.0 255.0000 /begin FUNCTION_LIST OZNIVDL /end FUNCTION_LIST /end CHARACTERISTIC
/begin CHARACTERISTIC K_NACHFUELL69 "Nachfüll Fünfte Balken von Peistab" VALUE 0xc1f65 TKW_VV_VV_UB 100.0 Def_dez_ub_q1 0.0 255.0000 /begin FUNCTION_LIST OZNIVDL /end FUNCTION_LIST /end CHARACTERISTIC
/begin CHARACTERISTIC K_NACHFUELL85 "Nachfüll Sechte Balken von Peistab" VALUE 0xc1f66 TKW_VV_VV_UB 100.0 Def_dez_ub_q1 0.0 255.0000 /begin FUNCTION_LIST OZNIVDL /end FUNCTION_LIST /end CHARACTERISTIC
/begin CHARACTERISTIC K_NACHFUELL95 "Nachfüll Siebte Balken von Peistab" VALUE 0xc1f67 TKW_VV_VV_UB 100.0 Def_dez_ub_q1 0.0 255.0000 /begin FUNCTION_LIST OZNIVDL /end FUNCTION_LIST /end CHARACTERISTIC
/begin CHARACTERISTIC K_NKWMANDET "Konstante Motordrehzahlschwelle Manipulationserkennung" VALUE 0xc1772 TKW_VV_VV_SW 100.0 Def_n_sw_q1p0 -32768.0000 32767.0000 /begin FUNCTION_LIST MANDETEK /end FUNCTION_LIST /end CHARACTERISTIC
/begin CHARACTERISTIC K_NKW_SCH "" VALUE 0xc169e TKW_VV_VV_SW 100.0 Def_n_sw_q1p0 0.0 32767.0000 /begin FUNCTION_LIST LOADRESP /end FUNCTION_LIST /end CHARACTERISTIC
/begin CHARACTERISTIC K_NLLMIN "Motordrehzahl unterhalb derer die LLDZanh. zurueckgenommen wird." VALUE 0xc1690 TKW_VV_VV_SW 100.0 Def_n_sw_q1p0 -32768.0000 32767.0000 /begin FUNCTION_LIST LLPMCTRL /end FUNCTION_LIST /end CHARACTERISTIC
/begin CHARACTERISTIC K_NMINUMG "Drehzahlschwelle Aussentemperaturmodell" VALUE 0xc157a TKW_VV_VV_SW 100.0 Def_n_sw_q1p0 0.0 32767.0000 /begin FUNCTION_LIST LBATTCAL /end FUNCTION_LIST /end CHARACTERISTIC
/begin CHARACTERISTIC K_NMXGENOF "Motordrehzahlschwelle für Generatorzuschaltung" VALUE 0xc16a6 TKW_VV_VV_SW 100.0 Def_n_sw_q1p0 -32768.0000 32767.0000 /begin FUNCTION_LIST LOADRESP /end FUNCTION_LIST /end CHARACTERISTIC
/begin CHARACTERISTIC K_NSUBO "N_soll bei Batterieladebilanz zu niedrig" VALUE 0xc1698 TKW_VV_VV_SW 100.0 Def_n_sw_q1p0 0.0 32767.0000 /begin FUNCTION_LIST LLRANH /end FUNCTION_LIST /end CHARACTERISTIC
/begin CHARACTERISTIC K_NSUBU "N_soll bei Ladebilanz iO" VALUE 0xc169a TKW_VV_VV_SW 100.0 Def_n_sw_q1p0 0.0 32767.0000 /begin FUNCTION_LIST LLRANH /end FUNCTION_LIST /end CHARACTERISTIC
/begin CHARACTERISTIC K_OFTUMGCAN "Offset Umgebungstemperatur CAN" VALUE 0xc157c TKW_VV_VV_SW 100.0 Def_t_sw_q0p1 -3276.8000 3276.7000 /begin FUNCTION_LIST LBATTCAL /end FUNCTION_LIST FORMAT "%4.1" /end CHARACTERISTIC
/begin CHARACTERISTIC K_OFULADE "Offset Ladekennlinie Batthinten" VALUE 0xc157e TKW_VV_VV_SW 100.0 Def_u_sw_b128 -128.0000 127.9960 /begin FUNCTION_LIST LBATTCAL /end FUNCTION_LIST FORMAT "%6.3" /end CHARACTERISTIC
/begin CHARACTERISTIC K_ORIVERZ "Töns Orientierungsmessung Verzögerung" VALUE 0xc1f68 TKW_VV_VV_UB 100.0 Def_dez_ub_q1 0.0 255.0000 /begin FUNCTION_LIST OZNIVDL /end FUNCTION_LIST /end CHARACTERISTIC
/begin CHARACTERISTIC K_OZALTLANG "Erlaubte Differenz Schwelle (letze 3 Langmw)" VALUE 0xc1f69 TKW_VV_VV_UB 100.0 Def_niv_ub_b75 0.0 74.7070 /begin FUNCTION_LIST OZNIVDL /end FUNCTION_LIST /end CHARACTERISTIC
/begin CHARACTERISTIC K_OZBESCHAUS "Zahl Ausgeblendet bei Lengsbescheunigung" VALUE 0xc1f6a TKW_VV_VV_UB 100.0 Def_dez_ub_q1 0.0 255.0000 /begin FUNCTION_LIST OZNIVDL /end FUNCTION_LIST /end CHARACTERISTIC
/begin CHARACTERISTIC K_OZBZKMSTK1 "Bezugsintervall" VALUE 0xc1f0a TKW_VV_VV_UB 100.0 Def_km_ub_q1000 0.0 255000.0000 /begin FUNCTION_LIST OZGG /end FUNCTION_LIST /end CHARACTERISTIC
/begin CHARACTERISTIC K_OZKEINLUFT "1 = Luftausblendung deaktiviert" VALUE 0xc1f6b TKW_VV_VV_UB 100.0 Def_dez_ub_q1 0.0 255.0000 /begin FUNCTION_LIST OZNIVDL /end FUNCTION_LIST /end CHARACTERISTIC
/begin CHARACTERISTIC K_OZKMUPL "" VALUE 0xc1f02 TKW_VV_VV_UW 100.0 Def_km_uw_q10 0.0 655350.0000 /begin FUNCTION_LIST OZGG /end FUNCTION_LIST /end CHARACTERISTIC
/begin CHARACTERISTIC K_OZKRZKOR "Korrektur von Orientierungswert für Peilstab" VALUE 0xc1f24 TKW_VV_VV_SW 100.0 Def_f_sw_b32 -32.0000 31.9990 /begin FUNCTION_LIST OZNIVDL /end FUNCTION_LIST FORMAT "%7.4" /end CHARACTERISTIC
/begin CHARACTERISTIC K_OZKRZORTZ "Toleranz für Orientierungsmessung " VALUE 0xc1f6c TKW_VV_VV_UB 100.0 Def_f_ub_b2 0.0 1.9921 /begin FUNCTION_LIST OZNIVDL /end FUNCTION_LIST /end CHARACTERISTIC
/begin CHARACTERISTIC K_OZLANGLIM1 "Schwelle für langen Mittelwert Ölniveau (Vebrauchswarnung)" VALUE 0xc1efa TKW_VV_VV_UB 100.0 Def_niv_ub_b75 0.0 74.7070 /begin FUNCTION_LIST OZBG /end FUNCTION_LIST /end CHARACTERISTIC
/begin CHARACTERISTIC K_OZLANGLIM2 "Schwelle für langen Mittelwert Ölniveau (Verlustwarnung)" VALUE 0xc1efb TKW_VV_VV_UB 100.0 Def_niv_ub_b75 0.0 74.7070 /begin FUNCTION_LIST OZBG /end FUNCTION_LIST /end CHARACTERISTIC
/begin CHARACTERISTIC K_OZLBESCHN "Negative Längsbeschleunigung Ausblendung-Schwelle " VALUE 0xc1f5c TKW_VV_VV_SB 100.0 Def_ac_sb_q0p25 -32.0000 31.7500 /begin FUNCTION_LIST OZNIVDL /end FUNCTION_LIST /end CHARACTERISTIC
/begin CHARACTERISTIC K_OZLBESCHP "Positive Längsbeschleunigung Ausblendung-Schwelle " VALUE 0xc1f5d TKW_VV_VV_SB 100.0 Def_ac_sb_q0p25 -32.0000 31.7500 /begin FUNCTION_LIST OZNIVDL /end FUNCTION_LIST /end CHARACTERISTIC
/begin CHARACTERISTIC K_OZLIM1HEAL "Schwelle für Rücknahme der Ölniveauwarnung Verbrauch" VALUE 0xc1efc TKW_VV_VV_UB 100.0 Def_niv_ub_b75 0.0 74.7070 /begin FUNCTION_LIST OZBG /end FUNCTION_LIST /end CHARACTERISTIC
/begin CHARACTERISTIC K_OZLIM2HEAL "Schwelle für Rücknahme der Ölniveauwarnung Verlust" VALUE 0xc1efd TKW_VV_VV_UB 100.0 Def_niv_ub_b75 0.0 74.7070 /begin FUNCTION_LIST OZBG /end FUNCTION_LIST /end CHARACTERISTIC
/begin CHARACTERISTIC K_OZLUFTMAX "Plausibel max luftsprung" VALUE 0xc1f42 TKW_VV_VV_UW 100.0 Def_p_uw_q039 0.0 2559.9609 /begin FUNCTION_LIST OZNIVDL /end FUNCTION_LIST FORMAT "%6.3" /end CHARACTERISTIC
/begin CHARACTERISTIC K_OZMWK "Anzahl der Messwerte für Kurzzeit-Mittelwert Niveau" VALUE 0xc1f6d TKW_VV_VV_UB 100.0 Def_dez_ub_q1 0.0 255.0000 /begin FUNCTION_LIST OZNIVDL /end FUNCTION_LIST /end CHARACTERISTIC
/begin CHARACTERISTIC K_OZMWL "Anzahl der Messwerte für Langzeit-Mittelwert Niveau" VALUE 0xc1f44 TKW_VV_VV_UW 100.0 Def_dez_uw_q1 0.0 65535.0000 /begin FUNCTION_LIST OZNIVDL /end FUNCTION_LIST /end CHARACTERISTIC
/begin CHARACTERISTIC K_OZMWOR "Anzahl der Messwerte für Orientierungsmessung" VALUE 0xc1f46 TKW_VV_VV_UW 100.0 Def_dez_uw_q1 0.0 65535.0000 /begin FUNCTION_LIST OZNIVDL /end FUNCTION_LIST /end CHARACTERISTIC
/begin CHARACTERISTIC K_OZMWV "Anzahl der Messwerte für vorgezogenen Mittelwert Niveau" VALUE 0xc1f48 TKW_VV_VV_UW 100.0 Def_dez_uw_q1 0.0 65535.0000 /begin FUNCTION_LIST OZNIVDL /end FUNCTION_LIST /end CHARACTERISTIC
/begin CHARACTERISTIC K_OZMXSLOPE "Maximale erlaubt Steigung" VALUE 0xc1f6e TKW_VV_VV_UB 100.0 Def_f_ub_b0p5 0.0 0.4980 /begin FUNCTION_LIST OZNIVDL /end FUNCTION_LIST /end CHARACTERISTIC
/begin CHARACTERISTIC K_OZNFCNT "Anzahl Werte für Nachfüllerkennung" VALUE 0xc1f58 TKW_VV_VV_UL 100.0 Def_dez_ul_q1 0.0 4294967295.0000 /begin FUNCTION_LIST OZNIVDL /end FUNCTION_LIST /end CHARACTERISTIC
/begin CHARACTERISTIC K_OZNFDELTA "Niveaudelta für die Nachfüllerkennung Peilstab" VALUE 0xc1f6f TKW_VV_VV_UB 100.0 Def_niv_ub_b75 0.0 74.7070 /begin FUNCTION_LIST OZNIVDL /end FUNCTION_LIST /end CHARACTERISTIC
/begin CHARACTERISTIC K_OZNFERR "Nachfüllmengenanzeige bei PreCheck OK" VALUE 0xc1f70 TKW_VV_VV_UB 100.0 Def_dez_ub_q1 0.0 255.0000 /begin FUNCTION_LIST OZNIVDL /end FUNCTION_LIST /end CHARACTERISTIC
/begin CHARACTERISTIC K_OZNFML "Nachfüllmengenanzeige bei " VALUE 0xc1f71 TKW_VV_VV_UB 100.0 Def_dez_ub_q1 0.0 255.0000 /begin FUNCTION_LIST OZNIVDL /end FUNCTION_LIST /end CHARACTERISTIC
/begin CHARACTERISTIC K_OZNFOELCKO "Nachfüllmengenanzeige bei PreCheck KO" VALUE 0xc1f72 TKW_VV_VV_UB 100.0 Def_dez_ub_q1 0.0 255.0000 /begin FUNCTION_LIST OZNIVDL /end FUNCTION_LIST /end CHARACTERISTIC
/begin CHARACTERISTIC K_OZNFOELCOK "Nachfüllmengenanzeige bei PreCheck OK" VALUE 0xc1f73 TKW_VV_VV_UB 100.0 Def_dez_ub_q1 0.0 255.0000 /begin FUNCTION_LIST OZNIVDL /end FUNCTION_LIST /end CHARACTERISTIC
/begin CHARACTERISTIC K_OZNFTMPMAX "obere Temperaturgrenze für Nachfüllerkennung" VALUE 0xc1f26 TKW_VV_VV_SW 100.0 Def_t_sw_q0p1 -3276.8000 3276.7000 /begin FUNCTION_LIST OZNIVDL /end FUNCTION_LIST FORMAT "%4.1" /end CHARACTERISTIC
/begin CHARACTERISTIC K_OZNFTMPMIN "untere Temperaturgrenze für Nachfüllerkennung" VALUE 0xc1f28 TKW_VV_VV_SW 100.0 Def_t_sw_q0p1 -3276.8000 3276.7000 /begin FUNCTION_LIST OZNIVDL /end FUNCTION_LIST FORMAT "%4.1" /end CHARACTERISTIC
/begin CHARACTERISTIC K_OZNIVKL "" VALUE 0xc1f0b TKW_VV_VV_UB 100.0 Def_niv_ub_b75 0.0 74.7070 /begin FUNCTION_LIST OZGG /end FUNCTION_LIST /end CHARACTERISTIC
/begin CHARACTERISTIC K_OZNIVMMLIT "Umrechnungsfaktor für Ölniveau von mm in Liter" VALUE 0xc1f74 TKW_VV_VV_UB 100.0 Def_f_ub_b0p25 0.0 0.2490 /begin FUNCTION_LIST OZNIVDL /end FUNCTION_LIST /end CHARACTERISTIC
/begin CHARACTERISTIC K_OZNIVNFM05 "Niveauschwelle für Erkennung 0,5 Liter nachgefüllt" VALUE 0xc1f75 TKW_VV_VV_UB 100.0 Def_f_ub_b8 0.0 7.9687 /begin FUNCTION_LIST OZNIVDL /end FUNCTION_LIST /end CHARACTERISTIC
/begin CHARACTERISTIC K_OZNIVNFM10 "Niveauschwelle für Erkennung 1,0 Liter nachgefüllt" VALUE 0xc1f76 TKW_VV_VV_UB 100.0 Def_f_ub_b8 0.0 7.9687 /begin FUNCTION_LIST OZNIVDL /end FUNCTION_LIST /end CHARACTERISTIC
/begin CHARACTERISTIC K_OZNMOTMAX "obere Drehzahlgrenze für drehzahlkorrigierten Niveaumittelwert" VALUE 0xc1f2a TKW_VV_VV_SW 100.0 Def_n_sw_q1p0 -32768.0000 32767.0000 /begin FUNCTION_LIST OZNIVDL /end FUNCTION_LIST /end CHARACTERISTIC
/begin CHARACTERISTIC K_OZNMOTMIN "untere Drehzahlgrenze für drehzahlkorrigierten Niveaumittelwert" VALUE 0xc1f2c TKW_VV_VV_SW 100.0 Def_n_sw_q1p0 -32768.0000 32767.0000 /begin FUNCTION_LIST OZNIVDL /end FUNCTION_LIST /end CHARACTERISTIC
/begin CHARACTERISTIC K_OZOELCOK "PreDriveCheck-Schwelle" VALUE 0xc1f77 TKW_VV_VV_UB 100.0 Def_niv_ub_b75 0.0 74.7070 /begin FUNCTION_LIST OZNIVDL /end FUNCTION_LIST /end CHARACTERISTIC
/begin CHARACTERISTIC K_OZOELKMPL "gefahrene Strecke nach Ölwechsel, ab wo Er-Auswertung erfolgt" VALUE 0xc2054 TKW_VV_VV_UW 100.0 Def_km_uw_q10 0.0 655350.0000 /begin FUNCTION_LIST OZPERM /end FUNCTION_LIST /end CHARACTERISTIC
/begin CHARACTERISTIC K_OZOELVERB "Ölverbrauch" VALUE 0xc1f4a TKW_VV_VV_UW 100.0 Def_dez_uw_q1 0.0 65535.0000 /begin FUNCTION_LIST OZNIVDL /end FUNCTION_LIST /end CHARACTERISTIC
/begin CHARACTERISTIC K_OZORIVERZ "QLT Orientierungsmessung Verzögerung" VALUE 0xc1f78 TKW_VV_VV_UB 100.0 Def_dez_ub_q1 0.0 255.0000 /begin FUNCTION_LIST OZNIVDL /end FUNCTION_LIST /end CHARACTERISTIC
/begin CHARACTERISTIC K_OZORLIM2 "Schwelle für Orientierungswert Ölniveau (Verlustwarnung)" VALUE 0xc1efe TKW_VV_VV_UB 100.0 Def_niv_ub_b75 0.0 74.7070 /begin FUNCTION_LIST OZBG /end FUNCTION_LIST /end CHARACTERISTIC
/begin CHARACTERISTIC K_OZORNKW "Drehzahl Schwelle Orientierungsmessung QLT" VALUE 0xc1f2e TKW_VV_VV_SW 100.0 Def_n_sw_q1p0 -32768.0000 32767.0000 /begin FUNCTION_LIST OZNIVDL /end FUNCTION_LIST /end CHARACTERISTIC
/begin CHARACTERISTIC K_OZPEIL12 "Erste Balken von Peistab" VALUE 0xc1f79 TKW_VV_VV_UB 100.0 Def_niv_ub_b75 0.0 74.7070 /begin FUNCTION_LIST OZNIVDL /end FUNCTION_LIST /end CHARACTERISTIC
/begin CHARACTERISTIC K_OZPEIL25 "Zweite Balken von Peistab" VALUE 0xc1f7a TKW_VV_VV_UB 100.0 Def_niv_ub_b75 0.0 74.7070 /begin FUNCTION_LIST OZNIVDL /end FUNCTION_LIST /end CHARACTERISTIC
/begin CHARACTERISTIC K_OZPEIL38 "Dritte Balken von Peistab" VALUE 0xc1f7b TKW_VV_VV_UB 100.0 Def_niv_ub_b75 0.0 74.7070 /begin FUNCTION_LIST OZNIVDL /end FUNCTION_LIST /end CHARACTERISTIC
/begin CHARACTERISTIC K_OZPEIL53 "Vierte Balken von Peistab" VALUE 0xc1f7c TKW_VV_VV_UB 100.0 Def_niv_ub_b75 0.0 74.7070 /begin FUNCTION_LIST OZNIVDL /end FUNCTION_LIST /end CHARACTERISTIC
/begin CHARACTERISTIC K_OZPEIL69 "Fünfte Balken von Peistab" VALUE 0xc1f7d TKW_VV_VV_UB 100.0 Def_niv_ub_b75 0.0 74.7070 /begin FUNCTION_LIST OZNIVDL /end FUNCTION_LIST /end CHARACTERISTIC
/begin CHARACTERISTIC K_OZPEIL85 "Sechte Balken von Peistab" VALUE 0xc1f7e TKW_VV_VV_UB 100.0 Def_niv_ub_b75 0.0 74.7070 /begin FUNCTION_LIST OZNIVDL /end FUNCTION_LIST /end CHARACTERISTIC
/begin CHARACTERISTIC K_OZPEIL95 "Siebte Balken von Peistab" VALUE 0xc1f7f TKW_VV_VV_UB 100.0 Def_niv_ub_b75 0.0 74.7070 /begin FUNCTION_LIST OZNIVDL /end FUNCTION_LIST /end CHARACTERISTIC
/begin CHARACTERISTIC K_OZPEILDO "Delta + Hysteresis Langmw Peilstab" VALUE 0xc1f80 TKW_VV_VV_UB 100.0 Def_niv_ub_b75 0.0 74.7070 /begin FUNCTION_LIST OZNIVDL /end FUNCTION_LIST /end CHARACTERISTIC
/begin CHARACTERISTIC K_OZPEILDU "Delta - Hysteresis Langmw Peilstab" VALUE 0xc1f81 TKW_VV_VV_UB 100.0 Def_niv_ub_b75 0.0 74.7070 /begin FUNCTION_LIST OZNIVDL /end FUNCTION_LIST /end CHARACTERISTIC
/begin CHARACTERISTIC K_OZPEILERR "Balkenanzeige im Fehlerfall" VALUE 0xc1f82 TKW_VV_VV_UB 100.0 Def_dez_ub_q1 0.0 255.0000 /begin FUNCTION_LIST OZNIVDL /end FUNCTION_LIST /end CHARACTERISTIC
/begin CHARACTERISTIC K_OZPEILML "Balkenanzeige bei " VALUE 0xc1f83 TKW_VV_VV_UB 100.0 Def_dez_ub_q1 0.0 255.0000 /begin FUNCTION_LIST OZNIVDL /end FUNCTION_LIST /end CHARACTERISTIC
/begin CHARACTERISTIC K_OZPEILOELCKO "Balkenanzeige bei ÖlCheck KO" VALUE 0xc1f84 TKW_VV_VV_UB 100.0 Def_dez_ub_q1 0.0 255.0000 /begin FUNCTION_LIST OZNIVDL /end FUNCTION_LIST /end CHARACTERISTIC
/begin CHARACTERISTIC K_OZPEILOELCOK "Balkenanzeige bei ÖlCheck OK" VALUE 0xc1f85 TKW_VV_VV_UB 100.0 Def_dez_ub_q1 0.0 255.0000 /begin FUNCTION_LIST OZNIVDL /end FUNCTION_LIST /end CHARACTERISTIC
/begin CHARACTERISTIC K_OZPERMCOK5 "minimale Anzahl der Messwerte für einen gültigen Permittivitätswert" VALUE 0xc2056 TKW_VV_VV_UW 100.0 Def_dez_uw_q1 0.0 65535.0000 /begin FUNCTION_LIST OZPERM /end FUNCTION_LIST /end CHARACTERISTIC
/begin CHARACTERISTIC K_OZPERMMIN "minimaler Permittivitätswert für gültige Auswertung" VALUE 0xc2058 TKW_VV_VV_UW 100.0 Def_perm_uw_b6 0.0 5.9999 /begin FUNCTION_LIST OZPERM /end FUNCTION_LIST /end CHARACTERISTIC
/begin CHARACTERISTIC K_OZPERMMNIV "Niveauschwelle für gültige Permittivitätsauswertung" VALUE 0xc2062 TKW_VV_VV_UB 100.0 Def_niv_ub_b75 0.0 74.7070 /begin FUNCTION_LIST OZPERM /end FUNCTION_LIST /end CHARACTERISTIC
/begin CHARACTERISTIC K_OZPERMNK3 "Drehzahlschwelle für Er-Ausblendung" VALUE 0xc204c TKW_VV_VV_SW 100.0 Def_n_sw_q1p0 -32768.0000 32767.0000 /begin FUNCTION_LIST OZPERM /end FUNCTION_LIST /end CHARACTERISTIC
/begin CHARACTERISTIC K_OZPERMRMIN "Grenze für Niveauberechnung aus Permittivität" VALUE 0xc1f04 TKW_VV_VV_UW 100.0 Def_dez_uw_q1 0.0 65535.0000 /begin FUNCTION_LIST OZGG /end FUNCTION_LIST /end CHARACTERISTIC
/begin CHARACTERISTIC K_OZPERMTIK6 "Mittelungszeitraum Permittivität" VALUE 0xc205a TKW_VV_VV_UW 100.0 Def_td_uw_q1 0.0 65535.0000 /begin FUNCTION_LIST OZPERM /end FUNCTION_LIST /end CHARACTERISTIC
/begin CHARACTERISTIC K_OZPERMTIK8 "Ausheizzeit" VALUE 0xc205c TKW_VV_VV_UW 100.0 Def_td_uw_q1 0.0 65535.0000 /begin FUNCTION_LIST OZPERM /end FUNCTION_LIST /end CHARACTERISTIC
/begin CHARACTERISTIC K_OZPERMTIK9 "maximale Zeit nach B_ozpermpl = true, Neustart und oztempf < OZPERMTI in der eine gültige Messung erfolgen kann (Kaltzeitschwelle)" VALUE 0xc205e TKW_VV_VV_UW 100.0 Def_td_uw_q1 0.0 65535.0000 /begin FUNCTION_LIST OZPERM /end FUNCTION_LIST /end CHARACTERISTIC
/begin CHARACTERISTIC K_OZPERMTK12 "Untere Temperaturgrenze Messfenster Permittivität" VALUE 0xc204e TKW_VV_VV_SW 100.0 Def_t_sw_q0p1 -3276.8000 3276.7000 /begin FUNCTION_LIST OZPERM /end FUNCTION_LIST FORMAT "%4.1" /end CHARACTERISTIC
/begin CHARACTERISTIC K_OZPERMTK13 "Obere Temperaturgrenze Messfenster Permittivität" VALUE 0xc2050 TKW_VV_VV_SW 100.0 Def_t_sw_q0p1 -3276.8000 3276.7000 /begin FUNCTION_LIST OZPERM /end FUNCTION_LIST FORMAT "%4.1" /end CHARACTERISTIC
/begin CHARACTERISTIC K_OZPERMTK4 "Abklingzeit Drehzahlschwelle" VALUE 0xc2060 TKW_VV_VV_UW 100.0 Def_td_uw_q1 0.0 65535.0000 /begin FUNCTION_LIST OZPERM /end FUNCTION_LIST /end CHARACTERISTIC
/begin CHARACTERISTIC K_OZPERMTK7 "Ausheiztemperatur" VALUE 0xc2052 TKW_VV_VV_SW 100.0 Def_t_sw_q0p1 -3276.8000 3276.7000 /begin FUNCTION_LIST OZPERM /end FUNCTION_LIST FORMAT "%4.1" /end CHARACTERISTIC
/begin CHARACTERISTIC K_OZPRREFMAX "Maximum für Referenzpermittivität" VALUE 0xc1f06 TKW_VV_VV_UW 100.0 Def_dez_uw_q1 0.0 1024.0000 /begin FUNCTION_LIST OZGG /end FUNCTION_LIST /end CHARACTERISTIC
/begin CHARACTERISTIC K_OZPRREFMIN "Minimum für Referenzpermittivität" VALUE 0xc1f08 TKW_VV_VV_UW 100.0 Def_dez_uw_q1 0.0 1024.0000 /begin FUNCTION_LIST OZGG /end FUNCTION_LIST /end CHARACTERISTIC
/begin CHARACTERISTIC K_OZQBESCHN "Negative Querbeschleunigung Ausblendung-Schwelle " VALUE 0xc1f5e TKW_VV_VV_SB 100.0 Def_ac_sb_q0p25 -32.0000 31.7500 /begin FUNCTION_LIST OZNIVDL /end FUNCTION_LIST /end CHARACTERISTIC
/begin CHARACTERISTIC K_OZQBESCHP "Positive Querbeschleunigung Ausblendung-Schwelle " VALUE 0xc1f5f TKW_VV_VV_SB 100.0 Def_ac_sb_q0p25 -32.0000 31.7500 /begin FUNCTION_LIST OZNIVDL /end FUNCTION_LIST /end CHARACTERISTIC
/begin CHARACTERISTIC K_OZRESBOST "Delay für die Rücksetzung der Tester-Bos-Anforderung" VALUE 0xc1f0c TKW_VV_VV_UB 100.0 Def_dez_ub_q1 0.0 255.0000 /begin FUNCTION_LIST OZGG /end FUNCTION_LIST /end CHARACTERISTIC
/begin CHARACTERISTIC K_OZSTMINW "Minimale Strecke für die Steigungserkennung" VALUE 0xc1f4c TKW_VV_VV_UW 100.0 Def_f_uw_b10 0.0 9.9998 /begin FUNCTION_LIST OZNIVDL /end FUNCTION_LIST FORMAT "%7.4" /end CHARACTERISTIC
/begin CHARACTERISTIC K_OZSTZYK "" VALUE 0xc1f0d TKW_VV_VV_UB 100.0 Def_dez_ub_q1 0.0 255.0000 /begin FUNCTION_LIST OZGG /end FUNCTION_LIST /end CHARACTERISTIC
/begin CHARACTERISTIC K_OZTEMPBW "Temperaturschwelle Öltemperatur Motor betriebswarm" VALUE 0xc1f30 TKW_VV_VV_SW 100.0 Def_t_sw_q0p1 -3276.8000 3276.7000 /begin FUNCTION_LIST OZNIVDL /end FUNCTION_LIST FORMAT "%4.1" /end CHARACTERISTIC
/begin CHARACTERISTIC K_OZTORMAX "Temperaturschwelle für Orientierungsmessung" VALUE 0xc1f32 TKW_VV_VV_SW 100.0 Def_t_sw_q0p1 -3276.8000 3276.7000 /begin FUNCTION_LIST OZNIVDL /end FUNCTION_LIST FORMAT "%4.1" /end CHARACTERISTIC
/begin CHARACTERISTIC K_OZTORMIN "Mindest Temperatur für OrientierungMw QLT" VALUE 0xc1f34 TKW_VV_VV_SW 100.0 Def_t_sw_q0p01 -327.6800 327.6700 /begin FUNCTION_LIST OZNIVDL /end FUNCTION_LIST FORMAT "%5.2" /end CHARACTERISTIC
/begin CHARACTERISTIC K_OZVERBDKM "Delta km für die Ölverbrauch-Berechnung" VALUE 0xc1f4e TKW_VV_VV_UW 100.0 Def_km_uw_q10 0.0 655350.0000 /begin FUNCTION_LIST OZNIVDL /end FUNCTION_LIST /end CHARACTERISTIC
/begin CHARACTERISTIC K_OZVERBFAK "Faktor für die Anpassung des Ölverbrauches" VALUE 0xc1f86 TKW_VV_VV_UB 100.0 Def_f_ub_b8 0.0 7.9687 /begin FUNCTION_LIST OZNIVDL /end FUNCTION_LIST /end CHARACTERISTIC
/begin CHARACTERISTIC K_OZVORLIM1 "Schwelle für vorgezogenen Mittelwert Ölniveau (Vebrauchswarnung)" VALUE 0xc1eff TKW_VV_VV_UB 100.0 Def_niv_ub_b75 0.0 74.7070 /begin FUNCTION_LIST OZBG /end FUNCTION_LIST /end CHARACTERISTIC
/begin CHARACTERISTIC K_OZVORLIM2 "Schwelle für vorgezogenen Mittelwert Ölniveau (Verlustwarnung)" VALUE 0xc1f00 TKW_VV_VV_UB 100.0 Def_niv_ub_b75 0.0 74.7070 /begin FUNCTION_LIST OZBG /end FUNCTION_LIST /end CHARACTERISTIC
/begin CHARACTERISTIC K_OZVORMV "Korrektur von Vormw für Peilstab" VALUE 0xc1f36 TKW_VV_VV_SW 100.0 Def_f_sw_b32 -32.0000 31.9990 /begin FUNCTION_LIST OZNIVDL /end FUNCTION_LIST FORMAT "%7.4" /end CHARACTERISTIC
/begin CHARACTERISTIC K_OZZEITST "Delta Zeit für Luftdruck messsung" VALUE 0xc1f87 TKW_VV_VV_UB 100.0 Def_td_ub_q1 0.0 255.0000 /begin FUNCTION_LIST OZNIVDL /end FUNCTION_LIST /end CHARACTERISTIC
/begin CHARACTERISTIC K_PLBATTUMG "Plausibilisierung-Schwelle Batterieumgebungstemperatur" VALUE 0xc1580 TKW_VV_VV_SW 100.0 Def_t_sw_q0p1 0.0 3276.7000 /begin FUNCTION_LIST LBATTCAL /end FUNCTION_LIST FORMAT "%4.1" /end CHARACTERISTIC
/begin CHARACTERISTIC K_PLDMAX "Konstante maximalr Ladedruck" VALUE 0xc1774 TKW_VV_VV_SW 100.0 Def_p_sw_q1 128.0000 32767.0000 /begin FUNCTION_LIST MANDETEK /end FUNCTION_LIST FORMAT "%4.1" /end CHARACTERISTIC
/begin CHARACTERISTIC K_PLDMIN "Konstante minimaler Ladedruck" VALUE 0xc1776 TKW_VV_VV_SW 100.0 Def_p_sw_q1 0.0 32767.0000 /begin FUNCTION_LIST MANDETEK /end FUNCTION_LIST FORMAT "%4.1" /end CHARACTERISTIC
/begin CHARACTERISTIC K_PLDO "Konstante Obergrenze Ladedruck" VALUE 0xc1778 TKW_VV_VV_SW 100.0 Def_p_sw_q1 0.0 32767.0000 /begin FUNCTION_LIST MANDETEK /end FUNCTION_LIST FORMAT "%4.1" /end CHARACTERISTIC
/begin CHARACTERISTIC K_PLDU "Konstante Untergrenze Ladedruck" VALUE 0xc177a TKW_VV_VV_SW 100.0 Def_p_sw_q1 0.0 32767.0000 /begin FUNCTION_LIST MANDETEK /end FUNCTION_LIST FORMAT "%4.1" /end CHARACTERISTIC
/begin CHARACTERISTIC K_PT1NMOT "Konstant für Lowpass Filter Drehzahl Töns" VALUE 0xc1f88 TKW_VV_VV_UB 100.0 Def_f_ub_b100 0.0 99.6093 /begin FUNCTION_LIST OZNIVDL /end FUNCTION_LIST /end CHARACTERISTIC
/begin CHARACTERISTIC K_PT1TOEL "Konstant für Lowpass Filter ÖltemperaturTöns" VALUE 0xc1f50 TKW_VV_VV_UW 100.0 Def_f_uw_b100 0.0 99.9984 /begin FUNCTION_LIST OZNIVDL /end FUNCTION_LIST FORMAT "%6.3" /end CHARACTERISTIC
/begin CHARACTERISTIC K_RLEITUNGK "Widerstand Ladeleitung Batterie Kofferraum" VALUE 0xc15a4 TKW_VV_VV_UB 100.0 Def_f_ub_b32 0.0 31.8750 /begin FUNCTION_LIST LBATTCAL /end FUNCTION_LIST /end CHARACTERISTIC
/begin CHARACTERISTIC K_RLEITUNGM "Widerstand Ladeleitung Batterie Motorraum" VALUE 0xc15a5 TKW_VV_VV_UB 100.0 Def_f_ub_b32 0.0 31.8750 /begin FUNCTION_LIST LBATTCAL /end FUNCTION_LIST /end CHARACTERISTIC
/begin CHARACTERISTIC K_RLMXGENOF "relative Luftfüllungschwelle für Generatorzuschaltung" VALUE 0xc16a8 TKW_VV_VV_SW 100.0 Def_rf_sw_q0p01 -327.6800 327.6700 /begin FUNCTION_LIST LOADRESP /end FUNCTION_LIST FORMAT "%7.4" /end CHARACTERISTIC
/begin CHARACTERISTIC K_SLEEPWAIT "" VALUE 0xc1566 TKW_VV_VV_UB 100.0 ident 0.0 255.0000 /begin FUNCTION_LIST KT_IBS /end FUNCTION_LIST /end CHARACTERISTIC
/begin CHARACTERISTIC K_S_CLERRIBS "IBS Fehlerlöschen schaltbar" VALUE 0xc1564 TKW_VV_VV_UB 100.0 Def_dez_ub_q1 0.0 255.0000 /begin FUNCTION_LIST KT_IBS /end FUNCTION_LIST /end CHARACTERISTIC
/begin CHARACTERISTIC K_T1SCHWELLE "" VALUE 0xc1537 TKW_VV_VV_UB 100.0 Def_i_ub_q0p04 0.0 10.2000 /begin FUNCTION_LIST KT_IBS /end FUNCTION_LIST /end CHARACTERISTIC
/begin CHARACTERISTIC K_T1SOC0 "" VALUE 0xc152e TKW_VV_VV_UB 100.0 Def_td_ub_q256 0.0 65280.0000 /begin FUNCTION_LIST KT_IBS /end FUNCTION_LIST /end CHARACTERISTIC
/begin CHARACTERISTIC K_T2SCHWELLE "" VALUE 0xc1538 TKW_VV_VV_UB 100.0 Def_i_ub_q0p04 0.0 10.2000 /begin FUNCTION_LIST KT_IBS /end FUNCTION_LIST /end CHARACTERISTIC
/begin CHARACTERISTIC K_T2SOC0 "" VALUE 0xc152f TKW_VV_VV_UB 100.0 Def_td_ub_q256 0.0 65280.0000 /begin FUNCTION_LIST KT_IBS /end FUNCTION_LIST /end CHARACTERISTIC
/begin CHARACTERISTIC K_T3SCHWELLE "" VALUE 0xc1539 TKW_VV_VV_UB 100.0 Def_i_ub_q0p04 0.0 10.2000 /begin FUNCTION_LIST KT_IBS /end FUNCTION_LIST /end CHARACTERISTIC
/begin CHARACTERISTIC K_T3SOC0 "" VALUE 0xc1530 TKW_VV_VV_UB 100.0 Def_td_ub_q256 0.0 65280.0000 /begin FUNCTION_LIST KT_IBS /end FUNCTION_LIST /end CHARACTERISTIC
/begin CHARACTERISTIC K_TABSTGNMN "minimale Abstellzeit für Generatorreduzierung" VALUE 0xc16b2 TKW_VV_VV_UW 100.0 Def_st_uw_q1 0.0 65535.0000 /begin FUNCTION_LIST LOADRESP /end FUNCTION_LIST /end CHARACTERISTIC
/begin CHARACTERISTIC K_TABSTGNMX "maximale Abstellzeit für Generatorreduzierung" VALUE 0xc16b4 TKW_VV_VV_UW 100.0 Def_st_uw_q1 0.0 65535.0000 /begin FUNCTION_LIST LOADRESP /end FUNCTION_LIST /end CHARACTERISTIC
/begin CHARACTERISTIC K_TATMGENOF "Motordrehzahlschwelle  Katalysatortemperatur" VALUE 0xc16aa TKW_VV_VV_SW 100.0 Def_t_sw_q0p1 -3276.8000 3276.7000 /begin FUNCTION_LIST LOADRESP /end FUNCTION_LIST FORMAT "%4.1" /end CHARACTERISTIC
/begin CHARACTERISTIC K_TBATINIMAN "Applikation INITWERT Batterietemperatur" VALUE 0xc1582 TKW_VV_VV_SW 100.0 Def_t_sw_q0p1 0.0 3276.7000 /begin FUNCTION_LIST LBATTCAL /end FUNCTION_LIST FORMAT "%4.1" /end CHARACTERISTIC
/begin CHARACTERISTIC K_TBATTFTAUV "Zeitkonstante 5*Tau Batterievorne" VALUE 0xc159a TKW_VV_VV_UW 100.0 Def_st_uw_q1 0.0 65535.0000 /begin FUNCTION_LIST LBATTCAL /end FUNCTION_LIST /end CHARACTERISTIC
/begin CHARACTERISTIC K_TBATTTAUFH "Zeitkonstante Batterie 5*Tau hinten" VALUE 0xc159c TKW_VV_VV_UW 100.0 Def_st_uw_q1 0.0 65535.0000 /begin FUNCTION_LIST LBATTCAL /end FUNCTION_LIST /end CHARACTERISTIC
/begin CHARACTERISTIC K_TGENOFVL "Generatorsabschaltzeit bei Vollastbeschleunigung" VALUE 0xc16c4 TKW_VV_VV_UB 100.0 Def_dez_ub_q1 0.0 255.0000 /begin FUNCTION_LIST LOADRESP /end FUNCTION_LIST /end CHARACTERISTIC
/begin CHARACTERISTIC K_TIMERDLY "Verzoegerungszeit für Startwertberechnung" VALUE 0xc15a6 TKW_VV_VV_UB 100.0 Def_dez_ub_q1 0.0 255.0000 /begin FUNCTION_LIST LBATTCAL /end FUNCTION_LIST /end CHARACTERISTIC
/begin CHARACTERISTIC K_TLORESPST "Startloadresponse" VALUE 0xc16c5 TKW_VV_VV_UB 100.0 Def_td_ub_q0p1 0.0 25.5000 /begin FUNCTION_LIST LOADRESP /end FUNCTION_LIST /end CHARACTERISTIC
/begin CHARACTERISTIC K_TMOTABGNMN "minimale Motorabstelltemperatur für Generatorreduzierung" VALUE 0xc16ac TKW_VV_VV_SW 100.0 Def_t_sw_q0p01 -327.6800 327.6700 /begin FUNCTION_LIST LOADRESP /end FUNCTION_LIST FORMAT "%5.2" /end CHARACTERISTIC
/begin CHARACTERISTIC K_TMPCOM_DIV "" VALUE 0xc1548 TKW_VV_VV_UB 100.0 Def_dez_ub_q1 0.0 255.0000 /begin FUNCTION_LIST KT_IBS /end FUNCTION_LIST /end CHARACTERISTIC
/begin CHARACTERISTIC K_TMPCOM_MUL "" VALUE 0xc1547 TKW_VV_VV_UB 100.0 Def_dez_ub_q1 0.0 255.0000 /begin FUNCTION_LIST KT_IBS /end FUNCTION_LIST /end CHARACTERISTIC
/begin CHARACTERISTIC K_TNNSTART "Zeittriggerschwelle nach Motorstart" VALUE 0xc166e TKW_VV_VV_UW 100.0 Def_td_uw_q0p01 0.0 655.3500 /begin FUNCTION_LIST LDSTGEN /end FUNCTION_LIST FORMAT "%5.2" /end CHARACTERISTIC
/begin CHARACTERISTIC K_TNUSTART "" VALUE 0xc1532 TKW_VV_VV_UB 100.0 Def_td_ub_q0p0125 0.0 3.1875 /begin FUNCTION_LIST KT_IBS /end FUNCTION_LIST /end CHARACTERISTIC
/begin CHARACTERISTIC K_TNUSTARTFL "" VALUE 0xc1533 TKW_VV_VV_UB 100.0 Def_td_ub_q0p002_o01 0.0100 0.5200 /begin FUNCTION_LIST KT_IBS /end FUNCTION_LIST /end CHARACTERISTIC
/begin CHARACTERISTIC K_TOGANZ "" VALUE 0xc1f52 TKW_VV_VV_UW 100.0 Def_dez_uw_q1 1.0000 3000.0000 /begin FUNCTION_LIST OZNIVDL /end FUNCTION_LIST /end CHARACTERISTIC
/begin CHARACTERISTIC K_TOGKURZANZ "" VALUE 0xc1f54 TKW_VV_VV_UW 100.0 Def_dez_uw_q1 1.0000 1000.0000 /begin FUNCTION_LIST OZNIVDL /end FUNCTION_LIST /end CHARACTERISTIC
/begin CHARACTERISTIC K_TOGMWK "" VALUE 0xc1f89 TKW_VV_VV_UB 100.0 Def_dez_ub_q1 1.0000 100.0000 /begin FUNCTION_LIST OZNIVDL /end FUNCTION_LIST /end CHARACTERISTIC
/begin CHARACTERISTIC K_TOGNMAX "" VALUE 0xc1f38 TKW_VV_VV_SW 100.0 Def_n_sw_q1p0 -32768.0000 32767.0000 /begin FUNCTION_LIST OZNIVDL /end FUNCTION_LIST /end CHARACTERISTIC
/begin CHARACTERISTIC K_TOGNMIN "" VALUE 0xc1f3a TKW_VV_VV_SW 100.0 Def_n_sw_q1p0 -32768.0000 32767.0000 /begin FUNCTION_LIST OZNIVDL /end FUNCTION_LIST /end CHARACTERISTIC
/begin CHARACTERISTIC K_TOGORIANZ "" VALUE 0xc1f8a TKW_VV_VV_UB 100.0 Def_dez_ub_q1 1.0000 255.0000 /begin FUNCTION_LIST OZNIVDL /end FUNCTION_LIST /end CHARACTERISTIC
/begin CHARACTERISTIC K_TOGTMORIMAX "Tmot Schwelle Orientierungsmessung" VALUE 0xc1f3c TKW_VV_VV_SW 100.0 Def_t_sw_q0p01 -327.6800 327.6700 /begin FUNCTION_LIST OZNIVDL /end FUNCTION_LIST FORMAT "%5.2" /end CHARACTERISTIC
/begin CHARACTERISTIC K_TOGTMORIMIN "Mindest Temperatur für OrientirungMw Töns" VALUE 0xc1f3e TKW_VV_VV_SW 100.0 Def_t_sw_q0p01 -327.6800 327.6700 /begin FUNCTION_LIST OZNIVDL /end FUNCTION_LIST FORMAT "%5.2" /end CHARACTERISTIC
/begin CHARACTERISTIC K_TOGTMOT "" VALUE 0xc1f40 TKW_VV_VV_SW 100.0 Def_t_sw_q0p01 -327.6800 327.6700 /begin FUNCTION_LIST OZNIVDL /end FUNCTION_LIST FORMAT "%5.2" /end CHARACTERISTIC
/begin CHARACTERISTIC K_TOGVERBKZ "" VALUE 0xc1f8b TKW_VV_VV_UB 100.0 Def_td_ub_q0p5 0.0 127.5000 /begin FUNCTION_LIST OZNIVDL /end FUNCTION_LIST /end CHARACTERISTIC
/begin CHARACTERISTIC K_TOGVERBNOR "" VALUE 0xc1f8c TKW_VV_VV_UB 100.0 Def_td_ub_q0p5 0.0 127.5000 /begin FUNCTION_LIST OZNIVDL /end FUNCTION_LIST /end CHARACTERISTIC
/begin CHARACTERISTIC K_TOGVERLKZ "" VALUE 0xc1f8d TKW_VV_VV_UB 100.0 Def_td_ub_q0p5 0.0 127.5000 /begin FUNCTION_LIST OZNIVDL /end FUNCTION_LIST /end CHARACTERISTIC
/begin CHARACTERISTIC K_TOGVERLNOR "" VALUE 0xc1f8e TKW_VV_VV_UB 100.0 Def_td_ub_q0p5 0.0 127.5000 /begin FUNCTION_LIST OZNIVDL /end FUNCTION_LIST /end CHARACTERISTIC
/begin CHARACTERISTIC K_TOGVERLORI "" VALUE 0xc1f8f TKW_VV_VV_UB 100.0 Def_td_ub_q0p5 0.0 127.5000 /begin FUNCTION_LIST OZNIVDL /end FUNCTION_LIST /end CHARACTERISTIC
/begin CHARACTERISTIC K_TOGVERZOEG "" VALUE 0xc1f90 TKW_VV_VV_UB 100.0 Def_dez_ub_q1 0.0 255.0000 /begin FUNCTION_LIST OZNIVDL /end FUNCTION_LIST /end CHARACTERISTIC
/begin CHARACTERISTIC K_TPT1TICO "" VALUE 0xc1528 TKW_VV_VV_UW 100.0 Def_td_uw_q0p05 0.0 3276.7500 /begin FUNCTION_LIST KT_IBS /end FUNCTION_LIST FORMAT "%5.2" /end CHARACTERISTIC
/begin CHARACTERISTIC K_TRTYP "" VALUE 0xc1f56 TKW_VV_VV_UW 100.0 Def_td_uw_q0p01 0.0 655.3500 /begin FUNCTION_LIST OZNIVDL /end FUNCTION_LIST FORMAT "%5.2" /end CHARACTERISTIC
/begin CHARACTERISTIC K_TSLEEPRUH "" VALUE 0xc1536 TKW_VV_VV_UB 100.0 Def_td_ub_q16 0.0 4080.0000 /begin FUNCTION_LIST KT_IBS /end FUNCTION_LIST /end CHARACTERISTIC
/begin CHARACTERISTIC K_TUMGGNMN "minimale Umgebungstemperatur für Generatorreduzierung" VALUE 0xc16ae TKW_VV_VV_SW 100.0 Def_t_sw_q0p1 -3276.8000 3276.7000 /begin FUNCTION_LIST LOADRESP /end FUNCTION_LIST FORMAT "%4.1" /end CHARACTERISTIC
/begin CHARACTERISTIC K_TUMGGNMX "maximale Umgebungstemperatur für Generatorreduzierung" VALUE 0xc16b0 TKW_VV_VV_SW 100.0 Def_t_sw_q0p1 -3276.8000 3276.7000 /begin FUNCTION_LIST LOADRESP /end FUNCTION_LIST FORMAT "%4.1" /end CHARACTERISTIC
/begin CHARACTERISTIC K_TUMGINI "Initialisierungswert Aussentemperaturmodell" VALUE 0xc1584 TKW_VV_VV_SW 100.0 Def_t_sw_q0p1 -3276.8000 3276.7000 /begin FUNCTION_LIST LBATTCAL /end FUNCTION_LIST FORMAT "%4.1" /end CHARACTERISTIC
/begin CHARACTERISTIC K_TUMGTAU "Zeitkonstante 5*Tau Aussentemperatur" VALUE 0xc159e TKW_VV_VV_UW 100.0 Def_st_uw_q1 0.0 65535.0000 /begin FUNCTION_LIST LBATTCAL /end FUNCTION_LIST /end CHARACTERISTIC
/begin CHARACTERISTIC K_TVAGRMAX "Konstante maximales Tastverhältnis AGR-Steller" VALUE 0xc177c TKW_VV_VV_SW 100.0 Def_tv_sw_q0p01 1.2800 327.6700 /begin FUNCTION_LIST MANDETEK /end FUNCTION_LIST FORMAT "%6.3" /end CHARACTERISTIC
/begin CHARACTERISTIC K_TVAGRMIN "Konstante minimales Tastverhältnis AGR-Steller" VALUE 0xc177e TKW_VV_VV_SW 100.0 Def_tv_sw_q0p01 0.0 327.6700 /begin FUNCTION_LIST MANDETEK /end FUNCTION_LIST FORMAT "%6.3" /end CHARACTERISTIC
/begin CHARACTERISTIC K_TVAGRO "Konstante Obergrenze Tastverhältnis AGR-Steller" VALUE 0xc1780 TKW_VV_VV_SW 100.0 Def_tv_sw_q0p01 0.0 327.6700 /begin FUNCTION_LIST MANDETEK /end FUNCTION_LIST FORMAT "%6.3" /end CHARACTERISTIC
/begin CHARACTERISTIC K_TVAGRU "Konstante Untergrenze Tastverhältnis AGR-Steller" VALUE 0xc1782 TKW_VV_VV_SW 100.0 Def_tv_sw_q0p01 0.0 327.6700 /begin FUNCTION_LIST MANDETEK /end FUNCTION_LIST FORMAT "%6.3" /end CHARACTERISTIC
/begin CHARACTERISTIC K_TVLOFHYST "Hysterese Generatorvollastabschaltung" VALUE 0xc16c6 TKW_VV_VV_UB 100.0 Def_dez_ub_q1 0.0 255.0000 /begin FUNCTION_LIST LOADRESP /end FUNCTION_LIST /end CHARACTERISTIC
/begin CHARACTERISTIC K_TVPLDMAX "Konstante maximales Tastverhältnis Ladedrucksteller" VALUE 0xc1784 TKW_VV_VV_SW 100.0 Def_tv_sw_q0p01 1.2800 327.6700 /begin FUNCTION_LIST MANDETEK /end FUNCTION_LIST FORMAT "%6.3" /end CHARACTERISTIC
/begin CHARACTERISTIC K_TVPLDMIN "Konstante minimales Tastverhältnis Ladedrucksteller" VALUE 0xc1786 TKW_VV_VV_SW 100.0 Def_tv_sw_q0p01 0.0 327.6700 /begin FUNCTION_LIST MANDETEK /end FUNCTION_LIST FORMAT "%6.3" /end CHARACTERISTIC
/begin CHARACTERISTIC K_TVPLDO "Konstante Obergrenze Tastverhältnis Ladedrucksteller" VALUE 0xc1788 TKW_VV_VV_SW 100.0 Def_tv_sw_q0p01 0.0 327.6700 /begin FUNCTION_LIST MANDETEK /end FUNCTION_LIST FORMAT "%6.3" /end CHARACTERISTIC
/begin CHARACTERISTIC K_TVPLDU "Konstante Untergrenze Tastverhältnis Ladedrucksteller" VALUE 0xc178a TKW_VV_VV_SW 100.0 Def_tv_sw_q0p01 0.0 327.6700 /begin FUNCTION_LIST MANDETEK /end FUNCTION_LIST FORMAT "%6.3" /end CHARACTERISTIC
/begin CHARACTERISTIC K_T_CLERRIBS "" VALUE 0xc1565 TKW_VV_VV_UB 100.0 Def_dez_ub_q1 0.0 255.0000 /begin FUNCTION_LIST KT_IBS /end FUNCTION_LIST /end CHARACTERISTIC
/begin CHARACTERISTIC K_T_UTIEFSET "" VALUE 0xc1535 TKW_VV_VV_UB 100.0 Def_td_ub_q1 0.0 255.0000 /begin FUNCTION_LIST KT_IBS /end FUNCTION_LIST /end CHARACTERISTIC
/begin CHARACTERISTIC K_UBATTNORM "Batterienormspannung" VALUE 0xc1586 TKW_VV_VV_SW 100.0 Def_u_sw_b128 -128.0000 127.9960 /begin FUNCTION_LIST LBATTCAL /end FUNCTION_LIST FORMAT "%6.3" /end CHARACTERISTIC
/begin CHARACTERISTIC K_UBW_TNSTART "Wartezeit nach Start" VALUE 0xc1568 TKW_VV_VV_UW 100.0 Def_td_uw_q0p01 0.0 655.3500 /begin FUNCTION_LIST LAYER /end FUNCTION_LIST FORMAT "%5.2" /end CHARACTERISTIC
/begin CHARACTERISTIC K_UKOMPK "Applikationswert Kompensationsspannung Kafferraum" VALUE 0xc1574 TKW_VV_VV_UW 100.0 Def_u_uw_q0p0942 0.0 1.9782 /begin FUNCTION_LIST LBATTCAL /end FUNCTION_LIST FORMAT "%4.1" /end CHARACTERISTIC
/begin CHARACTERISTIC K_UKOMPM "Applikationswert Kompensationsspannung Motorraum" VALUE 0xc1576 TKW_VV_VV_UW 100.0 Def_u_uw_q0p0942 0.0 2.0000 /begin FUNCTION_LIST LBATTCAL /end FUNCTION_LIST FORMAT "%4.1" /end CHARACTERISTIC
/begin CHARACTERISTIC K_ULADE_TAU "Batterieladespannungs Zeitkonstante" VALUE 0xc15a0 TKW_VV_VV_UW 100.0 Def_f_uw_b1 0.0 9.99984741210938e-1 /begin FUNCTION_LIST LBATTCAL /end FUNCTION_LIST /end CHARACTERISTIC
/begin CHARACTERISTIC K_UTIEFAPP "" VALUE 0xc1534 TKW_VV_VV_UB 100.0 Def_u_ub_q0p064_o6 6.0000 22.3200 /begin FUNCTION_LIST KT_IBS /end FUNCTION_LIST /end CHARACTERISTIC
/begin CHARACTERISTIC K_VGENOFMN "Geschwindigkeitgeneratorabschaltschwelle bei Vollastbeschleunigung" VALUE 0xc16b6 TKW_VV_VV_UW 100.0 Def_v_uw_q1p0 0.0 65535.0000 /begin FUNCTION_LIST LOADRESP /end FUNCTION_LIST /end CHARACTERISTIC
/begin CHARACTERISTIC K_VGENOGMX "Geschwindigkeitgeneratorzuschaltschwelle bei Vollastbeschleunigung" VALUE 0xc16b8 TKW_VV_VV_UW 100.0 Def_v_uw_q1p0 0.0 65535.0000 /begin FUNCTION_LIST LOADRESP /end FUNCTION_LIST /end CHARACTERISTIC
/begin CHARACTERISTIC K_VMINUMG "Fahrzeuggeschwindigkeitsschwelle Aussentemperaturmodell" VALUE 0xc15a2 TKW_VV_VV_UW 100.0 Def_v_uw_q1p0 0.0 65535.0000 /begin FUNCTION_LIST LBATTCAL /end FUNCTION_LIST /end CHARACTERISTIC
/begin CHARACTERISTIC K_VZLORESOFV "Geschwindigkeitsschwelle für Generatorzuschaltung" VALUE 0xc16ba TKW_VV_VV_UW 100.0 Def_v_uw_q1p0 0.0 65535.0000 /begin FUNCTION_LIST LOADRESP /end FUNCTION_LIST /end CHARACTERISTIC
/begin CHARACTERISTIC K_WPEDMANDET "Konstante Pedalwertgeber Manipulationserkennung" VALUE 0xc178c TKW_VV_VV_SW 100.0 Def_tv_sw_q0p0244 -800.0000 799.9755 /begin FUNCTION_LIST MANDETEK /end FUNCTION_LIST FORMAT "%5.2" /end CHARACTERISTIC
/begin CHARACTERISTIC S_LBATT1 "Applikationsschalter1 Auswahl Ersatztemperatur" VALUE 0xc15a7 TKW_VV_VV_UB 100.0 Identity 0.0 1.0000 /begin FUNCTION_LIST LBATTCAL /end FUNCTION_LIST /end CHARACTERISTIC
/begin CHARACTERISTIC S_LBATT2 "Applikationsschalter2 Auswahl Ersatztemperatur" VALUE 0xc15a8 TKW_VV_VV_UB 100.0 Identity 0.0 1.0000 /begin FUNCTION_LIST LBATTCAL /end FUNCTION_LIST /end CHARACTERISTIC
/begin CHARACTERISTIC S_LBATTAPPL "" VALUE 0xc15ae TKW_VV_VV_UB 100.0 Identity 0.0 1.0000 /begin FUNCTION_LIST LBATTCAL /end FUNCTION_LIST /end CHARACTERISTIC
/begin CHARACTERISTIC S_LORESLL "Schalter Kennlinienausschaltzeit " VALUE 0xc16c7 TKW_VV_VV_UB 100.0 Identity 0.0 1.0000 /begin FUNCTION_LIST LOADRESP /end FUNCTION_LIST /end CHARACTERISTIC
/begin CHARACTERISTIC S_MGAPP "Schalter für Applikationswert Genratormaximalmoment" VALUE 0xc16c8 TKW_VV_VV_UB 100.0 Identity 0.0 1.0000 /begin FUNCTION_LIST LOADRESP /end FUNCTION_LIST /end CHARACTERISTIC
/begin CHARACTERISTIC S_N_IDLIBS "Schalter zum manuellen Setzen von LL aktiv" VALUE 0xc1696 TKW_VV_VV_UB 100.0 Identity 0.0 1.0000 /begin FUNCTION_LIST LLPMCTRL /end FUNCTION_LIST /end CHARACTERISTIC
/begin CHARACTERISTIC S_SAPP "Schalter für Applikationswert Begrenzungsstrategie" VALUE 0xc16c9 TKW_VV_VV_UB 100.0 Identity 0.0 1.0000 /begin FUNCTION_LIST LOADRESP /end FUNCTION_LIST /end CHARACTERISTIC
/begin CHARACTERISTIC S_TLACTIV "" VALUE 0xc16ca TKW_VV_VV_UB 100.0 Identity 0.0 1.0000 /begin FUNCTION_LIST LOADRESP /end FUNCTION_LIST /end CHARACTERISTIC
/begin MEASUREMENT Abst_hydr "Abstand Hydraulikpfadpfad" ULONG Def_f_ul_b262144 0 0 0.0 11.9998 ECU_ADDRESS 0x7FD9DC /begin FUNCTION_LIST MANDETEK /end FUNCTION_LIST /end MEASUREMENT
/begin MEASUREMENT Abst_luft "Abstand Luftpfad" ULONG Def_f_ul_b262144 0 0 0.0 15.9997 ECU_ADDRESS 0x7FD9E0 /begin FUNCTION_LIST MANDETEK /end FUNCTION_LIST /end MEASUREMENT
/begin MEASUREMENT Abst_temp1 "Abstand Hydraulikpfad temporär 1" UWORD Def_f_uw_b4 0 0 0.0 3.9999 ECU_ADDRESS 0x7FD9A2 /begin FUNCTION_LIST MANDETEK /end FUNCTION_LIST /end MEASUREMENT
/begin MEASUREMENT Abst_temp2 "Abstand Hydraulikpfad temporär 2" UWORD Def_f_uw_b4 0 0 0.0 3.9999 ECU_ADDRESS 0x7FD9A4 /begin FUNCTION_LIST MANDETEK /end FUNCTION_LIST /end MEASUREMENT
/begin MEASUREMENT Abst_temp3 "Abstand Hydraulikpfad temporär 3" UWORD Def_f_uw_b4 0 0 0.0 3.9999 ECU_ADDRESS 0x7FD9A6 /begin FUNCTION_LIST MANDETEK /end FUNCTION_LIST /end MEASUREMENT
/begin MEASUREMENT Abst_temp4 "Abstand Luftpfad temporär 5" UWORD Def_f_uw_b4 0 0 0.0 3.9999 ECU_ADDRESS 0x7FD9A8 /begin FUNCTION_LIST MANDETEK /end FUNCTION_LIST /end MEASUREMENT
/begin MEASUREMENT Abst_temp5 "Abstand Luftpfad temporär 6" UWORD Def_f_uw_b4 0 0 0.0 3.9999 ECU_ADDRESS 0x7FD9AA /begin FUNCTION_LIST MANDETEK /end FUNCTION_LIST /end MEASUREMENT
/begin MEASUREMENT Abst_temp6 "Abstand Luftpfad temporär 7" UWORD Def_f_uw_b4 0 0 0.0 3.9999 ECU_ADDRESS 0x7FD9AC /begin FUNCTION_LIST MANDETEK /end FUNCTION_LIST /end MEASUREMENT
/begin MEASUREMENT Abst_temp7 "Abstand Luftpfad temporär 8" UWORD Def_f_uw_b4 0 0 0.0 3.9999 ECU_ADDRESS 0x7FD9AE /begin FUNCTION_LIST MANDETEK /end FUNCTION_LIST /end MEASUREMENT
/begin MEASUREMENT Acfzgl "Fahrzeuglängsbeschleunigung" SBYTE Def_ac_sb_q0p25 0 0 -32.0000 31.7500 ECU_ADDRESS 0x7FBE72 /begin FUNCTION_LIST LAYER /end FUNCTION_LIST /end MEASUREMENT
/begin MEASUREMENT Acfzgq "Fahrzeugquerbeschleunigung" SBYTE Def_ac_sb_q0p25 0 0 -32.0000 31.7500 ECU_ADDRESS 0x7FBE73 /begin FUNCTION_LIST LAYER /end FUNCTION_LIST /end MEASUREMENT
/begin MEASUREMENT Batt_class "Klassifizierung der in diesem Fzg. eingebauten Batterie" UBYTE Def_dez_ub_q1 0 0 0.0 255.0000 ECU_ADDRESS 0x7FD82C /begin FUNCTION_LIST LAYER /end FUNCTION_LIST /end MEASUREMENT
/begin MEASUREMENT Batt_coort "Codierter Batterieeinbauort" UBYTE Def_dez_ub_q1 0 0 0.0 255.0000 ECU_ADDRESS 0x7FBEA6 /begin FUNCTION_LIST LAYER /end FUNCTION_LIST /end MEASUREMENT
/begin MEASUREMENT Batt_ort "Batterieeinbauort" UBYTE Def_st_ub_q1 0 0 0.0 255.0000 ECU_ADDRESS 0x7FD87E /begin FUNCTION_LIST LBATTCAL /end FUNCTION_LIST /end MEASUREMENT
/begin MEASUREMENT Batt_tfil "Zeitkonstante Batterie" UWORD Def_f_uw_b1 0 0 0.0 9.99984741210938e-1 ECU_ADDRESS 0x7FD87A /begin FUNCTION_LIST LBATTCAL /end FUNCTION_LIST /end MEASUREMENT
/begin MEASUREMENT Bordnetz "Ausgewähltes Bordnetz(0x01 => CAN11H, 0x02 => CAN12H(BN2000))" UBYTE Def_st_ub_q1 0 0 0.0 255.0000 ECU_ADDRESS 0x7FBEA7 /begin FUNCTION_LIST LAYER /end FUNCTION_LIST /end MEASUREMENT
/begin MEASUREMENT Bosbtvfbk "Rest-Verfügbarkeit Motoröl in Prozent" UBYTE Def_dez_ub_q1 0 0 0.0 255.0000 ECU_ADDRESS 0x7FDD6E /begin FUNCTION_LIST OZBG /end FUNCTION_LIST /end MEASUREMENT
/begin MEASUREMENT Bosbtvfbkt "Verfügbarkeit vom Tester" UBYTE Def_dez_ub_q1 0 0 0.0 255.0000 ECU_ADDRESS 0x7FBE6F /begin FUNCTION_LIST LAYER /end FUNCTION_LIST /end MEASUREMENT
/begin MEASUREMENT Bosfxid2 "Zieltermin_Monat_BOS_Rückstellung_2" SWORD Def_dez_sw_q1 0 0 -32768.0000 32767.0000 ECU_ADDRESS 0x7FDD6A /begin FUNCTION_LIST OZBG /end FUNCTION_LIST /end MEASUREMENT
/begin MEASUREMENT Bosfxid2r "ID_Funktion_BOS_Rückstellung_2" UWORD Def_dez_uw_q1 0 0 0.0 65535.0000 ECU_ADDRESS 0x7FD846 /begin FUNCTION_LIST LAYER /end FUNCTION_LIST /end MEASUREMENT
/begin MEASUREMENT Bosid2 "Zieltermin_Monat_BOS_Rückstellung_2" UBYTE Def_dez_ub_q1 0 0 0.0 255.0000 ECU_ADDRESS 0x7FDD6F /begin FUNCTION_LIST OZBG /end FUNCTION_LIST /end MEASUREMENT
/begin MEASUREMENT Bosid2r "ID_2_BOS_Rückstellung_2" UBYTE Def_dez_ub_q1 0 0 0.0 255.0000 ECU_ADDRESS 0x7FD844 /begin FUNCTION_LIST LAYER /end FUNCTION_LIST /end MEASUREMENT
/begin MEASUREMENT Bosjziel "Zieltermin_Monat_BOS_Rückstellung_2" UBYTE Def_dez_ub_q1 0 0 0.0 255.0000 ECU_ADDRESS 0x7FDD70 /begin FUNCTION_LIST OZBG /end FUNCTION_LIST /end MEASUREMENT
/begin MEASUREMENT Bosjzielr "Zieltermin_Monat_BOS_Rückstellung_2" UBYTE Def_dez_ub_q1 0 0 0.0 255.0000 ECU_ADDRESS 0x7FD848 /begin FUNCTION_LIST LAYER /end FUNCTION_LIST /end MEASUREMENT
/begin MEASUREMENT Bosjzielt "Zieltermin_Jahr vom Tester" UBYTE Def_dez_ub_q1 0 0 0.0 255.0000 ECU_ADDRESS 0x7FBF34 /begin FUNCTION_LIST LAYER /end FUNCTION_LIST /end MEASUREMENT
/begin MEASUREMENT Bosmziel "Zieltermin_Monat_BOS_Meldung_2" UBYTE Def_dez_ub_q1 0 0 0.0 255.0000 ECU_ADDRESS 0x7FDD71 /begin FUNCTION_LIST OZBG /end FUNCTION_LIST /end MEASUREMENT
/begin MEASUREMENT Bosmzielr "Zieltermin_Jahr_BOS_Rückstellung_2" UBYTE Def_dez_ub_q1 0 0 0.0 255.0000 ECU_ADDRESS 0x7FD849 /begin FUNCTION_LIST LAYER /end FUNCTION_LIST /end MEASUREMENT
/begin MEASUREMENT Bosmzielt "Zieltermin_Monat vom Tester" UBYTE Def_dez_ub_q1 0 0 0.0 255.0000 ECU_ADDRESS 0x7FBF33 /begin FUNCTION_LIST LAYER /end FUNCTION_LIST /end MEASUREMENT
/begin MEASUREMENT Bosprog2 "Prognose_Intervall_Zeit_BOS_Meldung_2" UBYTE Def_dez_ub_q1 0 0 0.0 255.0000 ECU_ADDRESS 0x7FDD72 /begin FUNCTION_LIST OZBG /end FUNCTION_LIST /end MEASUREMENT
/begin MEASUREMENT Bosprog2r "Prognose_Intervall_Zeit_BOS_Rückstellung_2" UBYTE Def_dez_ub_q1 0 0 0.0 255.0000 ECU_ADDRESS 0x7FD84A /begin FUNCTION_LIST LAYER /end FUNCTION_LIST /end MEASUREMENT
/begin MEASUREMENT Bosprog2t "Prognose_Intervall_Zeit vom Tester" UBYTE Def_dez_ub_q1 0 0 0.0 255.0000 ECU_ADDRESS 0x7FBF35 /begin FUNCTION_LIST LAYER /end FUNCTION_LIST /end MEASUREMENT
/begin MEASUREMENT Bosres "Zieltermin_Monat_BOS_Rückstellung_2" UBYTE Def_dez_ub_q1 0 0 0.0 255.0000 ECU_ADDRESS 0x7FDD73 /begin FUNCTION_LIST OZBG /end FUNCTION_LIST /end MEASUREMENT
/begin MEASUREMENT Bosrlsm "Ausgabewert Restlaufstrecke Motoröl" SWORD Def_km_sw_q10 0 0 -327680.0000 327670.0000 ECU_ADDRESS 0x7FDD6C /begin FUNCTION_LIST OZBG /end FUNCTION_LIST /end MEASUREMENT
/begin MEASUREMENT Bosrlsmr "Restlaufstrecke Motoröl vom Kombi" SWORD Def_km_sw_q10 0 0 -327680.0000 327670.0000 ECU_ADDRESS 0x7FBF2E /begin FUNCTION_LIST LAYER /end FUNCTION_LIST /end MEASUREMENT
/begin MEASUREMENT Bosrlsmt "Restlaufstrecke Motoröl vom Kombi" SWORD Def_km_sw_q10 0 0 -327680.0000 327670.0000 ECU_ADDRESS 0x7FBF30 /begin FUNCTION_LIST LAYER /end FUNCTION_LIST /end MEASUREMENT
/begin MEASUREMENT Bosrw2 "Prognose_Intervall_Weg_BOS_Meldung_2" UBYTE Def_km_ub_q1000 0 0 0.0 255000.0000 ECU_ADDRESS 0x7FDD74 /begin FUNCTION_LIST OZBG /end FUNCTION_LIST /end MEASUREMENT
/begin MEASUREMENT Bosrw2r "Prognose_Intervall_Weg_BOS_Rückstellung_2" UBYTE Def_km_ub_q1000 0 0 0.0 255000.0000 ECU_ADDRESS 0x7FD84B /begin FUNCTION_LIST LAYER /end FUNCTION_LIST /end MEASUREMENT
/begin MEASUREMENT Bosrw2t "Prognose_Intervall_Weg vom Tester" UBYTE Def_km_ub_q1000 0 0 0.0 255000.0000 ECU_ADDRESS 0x7FBF32 /begin FUNCTION_LIST LAYER /end FUNCTION_LIST /end MEASUREMENT
/begin MEASUREMENT Bosstate "Einheit der BOS-Info (km)" UBYTE Def_dez_ub_q1 0 0 0.0 255.0000 ECU_ADDRESS 0x7FDD81 /begin FUNCTION_LIST OZBG /end FUNCTION_LIST /end MEASUREMENT
/begin MEASUREMENT Bosv "Verfügbarkeit vom Kombi" UBYTE Def_dez_ub_q1 0 0 0.0 255.0000 ECU_ADDRESS 0x7FBE74 /begin FUNCTION_LIST LAYER /end FUNCTION_LIST /end MEASUREMENT
/begin MEASUREMENT Bsdcontrol "3 Byte Schnittstelle für kt_ibs" UBYTE Def_dez_ub_q1 0 0 0.0 255.0000 ECU_ADDRESS 0x7FBEA8 /begin FUNCTION_LIST LAYER /end FUNCTION_LIST /end MEASUREMENT
/begin MEASUREMENT Bsddata "3 Byte Schnittstelle kt_ibs" UBYTE Def_dez_ub_q1 0 0 0.0 255.0000 ECU_ADDRESS 0x7FBEA9 /begin FUNCTION_LIST LAYER /end FUNCTION_LIST /end MEASUREMENT
/begin MEASUREMENT Bsdgencv "Chipversion Generator 1" UBYTE Def_st_ub_q1 0 0 0.0 255.0000 ECU_ADDRESS 0x7FBEAA /begin FUNCTION_LIST LAYER /end FUNCTION_LIST /end MEASUREMENT
/begin MEASUREMENT Bsdgencv2 "Chipversion Generatorregler 2" UBYTE Def_st_ub_q1 0 0 0.0 255.0000 ECU_ADDRESS 0x7FBEAB /begin FUNCTION_LIST LAYER /end FUNCTION_LIST /end MEASUREMENT
/begin MEASUREMENT Bsdgenregv "Reglerversion Generator 1" UBYTE Def_st_ub_q1 0 0 0.0 255.0000 ECU_ADDRESS 0x7FBEAC /begin FUNCTION_LIST LAYER /end FUNCTION_LIST /end MEASUREMENT
/begin MEASUREMENT Bsdgenregv2 "Reglerversion Generator 2" UBYTE Def_st_ub_q1 0 0 0.0 255.0000 ECU_ADDRESS 0x7FBEAD /begin FUNCTION_LIST LAYER /end FUNCTION_LIST /end MEASUREMENT
/begin MEASUREMENT Bsdregadr "3 Byte Schnittstelle für kt_ibs" UBYTE Def_dez_ub_q1 0 0 0.0 255.0000 ECU_ADDRESS 0x7FBEAE /begin FUNCTION_LIST LAYER /end FUNCTION_LIST /end MEASUREMENT
/begin MEASUREMENT Chk16_ibs "Checksumme Parameter aus IBS" UWORD Def_dez_uw_q1 0 0 0.0 65535.0000 ECU_ADDRESS 0x7FD7D0 /begin FUNCTION_LIST KT_IBS /end FUNCTION_LIST /end MEASUREMENT
/begin MEASUREMENT Chkpara "Checksumme Parameter intern" UWORD Def_dez_uw_q1 0 0 0.0 65535.0000 ECU_ADDRESS 0x7FD7D2 /begin FUNCTION_LIST KT_IBS /end FUNCTION_LIST /end MEASUREMENT
/begin MEASUREMENT Comcontrol "Kontrolle Diagnose Modul DIBS" UBYTE Def_dez_ub_q1 0 0 0.0 255.0000 ECU_ADDRESS 0x7FD7F1 /begin FUNCTION_LIST KT_IBS /end FUNCTION_LIST /end MEASUREMENT
/begin MEASUREMENT Dffgen "ss_msv.dat" UBYTE Def_f_ub_b100 0 0 0.0 99.6093 ECU_ADDRESS 0x7FD88F /begin FUNCTION_LIST LDSTGEN /end FUNCTION_LIST /end MEASUREMENT
/begin MEASUREMENT Dfgrob "Grobwert Auslastungsgrad Generator 1" UBYTE Def_st_ub_q1 0 0 0.0 255.0000 ECU_ADDRESS 0x7FBEAF /begin FUNCTION_LIST LAYER /end FUNCTION_LIST /end MEASUREMENT
/begin MEASUREMENT Dfgrob2 "Grobwert Auslastungsgrad Generator 2" UBYTE Def_st_ub_q1 0 0 0.0 255.0000 ECU_ADDRESS 0x7FBEB0 /begin FUNCTION_LIST LAYER /end FUNCTION_LIST /end MEASUREMENT
/begin MEASUREMENT Dfmonitor "DF-Monitor für FASTA" UBYTE Def_f_ub_b100 0 0 0.0 99.6093 ECU_ADDRESS 0x7FD888 /begin FUNCTION_LIST LDSTGEN /end FUNCTION_LIST /end MEASUREMENT
/begin MEASUREMENT Dfpropval "" UWORD Def_f_uw_b32 0 0 0.0 31.9995 ECU_ADDRESS 0x7FD88C /begin FUNCTION_LIST LDSTGEN /end FUNCTION_LIST /end MEASUREMENT
/begin MEASUREMENT Dfsiggen "Auslastungsgrad Generator 1" UBYTE Def_f_ub_b100 0 0 0.0 99.6093 ECU_ADDRESS 0x7FBEB1 /begin FUNCTION_LIST LAYER /end FUNCTION_LIST /end MEASUREMENT
/begin MEASUREMENT Dfsiggen2 "Auslastungsgrad Generator 2" UBYTE Def_f_ub_b100 0 0 0.0 99.6093 ECU_ADDRESS 0x7FBEB2 /begin FUNCTION_LIST LAYER /end FUNCTION_LIST /end MEASUREMENT
/begin MEASUREMENT Dfsumme "DFMonitor Summe FASTA" FLOAT32_IEEE Def_f_r32 0 0 1.0000 340282346638528860000000000000000000000.0 ECU_ADDRESS 0x7FD880 /begin FUNCTION_LIST LDSTGEN /end FUNCTION_LIST /end MEASUREMENT
/begin MEASUREMENT Dfwanzahl "DF-Wertezähler" FLOAT32_IEEE Def_f_r32 0 0 1.0000 340282346638528860000000000000000000000.0 ECU_ADDRESS 0x7FD884 /begin FUNCTION_LIST LDSTGEN /end FUNCTION_LIST /end MEASUREMENT
/begin MEASUREMENT Dmd_gen "Maximaler Momentenanstieg Motor für Generator" SWORD Def_dm_sw_q0p1 0 0 -3276.8000 3276.7000 ECU_ADDRESS 0x7FBEB4 /begin FUNCTION_LIST LAYER /end FUNCTION_LIST /end MEASUREMENT
/begin MEASUREMENT Ebsd_adr "EBSD Adresse im IBS" UBYTE Def_dez_ub_q1 0 0 0.0 255.0000 ECU_ADDRESS 0x7FD805 /begin FUNCTION_LIST KT_IBS /end FUNCTION_LIST /end MEASUREMENT
/begin MEASUREMENT Ebsd_errdir "EBSD Übertragungsrichtung bei Fehler" UBYTE Def_dez_ub_q1 0 0 0.0 255.0000 ECU_ADDRESS 0x7FD806 /begin FUNCTION_LIST KT_IBS /end FUNCTION_LIST /end MEASUREMENT
/begin MEASUREMENT Ebsd_errep "EBSD Fehler repeat timer" UBYTE Def_dez_ub_q1 0 0 0.0 255.0000 ECU_ADDRESS 0x7FD808 /begin FUNCTION_LIST KT_IBS /end FUNCTION_LIST /end MEASUREMENT
/begin MEASUREMENT Ebsd_errin "EBSD Index bei Fehler" UBYTE Def_dez_ub_q1 0 0 0.0 255.0000 ECU_ADDRESS 0x7FD807 /begin FUNCTION_LIST KT_IBS /end FUNCTION_LIST /end MEASUREMENT
/begin MEASUREMENT Ebsd_nbyt "Länge EBSD Variable" UBYTE Def_dez_ub_q1 0 0 0.0 255.0000 ECU_ADDRESS 0x7FD803 /begin FUNCTION_LIST KT_IBS /end FUNCTION_LIST /end MEASUREMENT
/begin MEASUREMENT Ebsd_timo "EBSD Fehler timeout counter" UBYTE Def_dez_ub_q1 0 0 0.0 255.0000 ECU_ADDRESS 0x7FD809 /begin FUNCTION_LIST KT_IBS /end FUNCTION_LIST /end MEASUREMENT
/begin MEASUREMENT Ebsd_varin "Index EBSD Variable" UBYTE Def_dez_ub_q1 0 0 0.0 255.0000 ECU_ADDRESS 0x7FD802 /begin FUNCTION_LIST KT_IBS /end FUNCTION_LIST /end MEASUREMENT
/begin MEASUREMENT F_hydr "Fehler Hydraulikpfadpfad relativ" ULONG Def_f_ul_b262144 0 0 0.0 196596.0001 ECU_ADDRESS 0x7FD9E4 /begin FUNCTION_LIST MANDETEK /end FUNCTION_LIST /end MEASUREMENT
/begin MEASUREMENT F_hydra "Fehler Hydraulikpfadpfad absolut" ULONG Def_f_ul_b262144 0 0 0.0 11.9998 ECU_ADDRESS 0x7FD9E8 /begin FUNCTION_LIST MANDETEK /end FUNCTION_LIST /end MEASUREMENT
/begin MEASUREMENT F_luft "Fehler Luftpfadpfad relativ" ULONG Def_f_ul_b262144 0 0 0.0 262128.0002 ECU_ADDRESS 0x7FD9EC /begin FUNCTION_LIST MANDETEK /end FUNCTION_LIST /end MEASUREMENT
/begin MEASUREMENT F_lufta "Fehler Luftpfad absolut" ULONG Def_f_ul_b262144 0 0 0.0 15.9997 ECU_ADDRESS 0x7FD9F0 /begin FUNCTION_LIST MANDETEK /end FUNCTION_LIST /end MEASUREMENT
/begin MEASUREMENT Fahrzeug "Fahrzeugtypbezeichnung (E60 = 60, E65 = 65, E46 = 46)" UBYTE Def_dez_ub_q1 0 0 0.0 255.0000 ECU_ADDRESS 0x7FBEB6 /begin FUNCTION_LIST LAYER /end FUNCTION_LIST /end MEASUREMENT
/begin MEASUREMENT Fho "Korrekturfaktor Höhe" UWORD Def_f_uw_b2 0 0 0.0 1.9999 ECU_ADDRESS 0x7FBEB8 /begin FUNCTION_LIST LAYER /end FUNCTION_LIST /end MEASUREMENT
/begin MEASUREMENT Fhydr_temp1 "rel. Fehler Hydraulikpfad temporär 1" ULONG Def_f_ul_b262144 0 0 0.0 65532.0000 ECU_ADDRESS 0x7FD9F4 /begin FUNCTION_LIST MANDETEK /end FUNCTION_LIST /end MEASUREMENT
/begin MEASUREMENT Fhydr_temp2 "rel. Fehler Hydraulikpfad temporär 2" ULONG Def_f_ul_b262144 0 0 0.0 65532.0000 ECU_ADDRESS 0x7FD9F8 /begin FUNCTION_LIST MANDETEK /end FUNCTION_LIST /end MEASUREMENT
/begin MEASUREMENT Fhydr_temp3 "rel. Fehler Hydraulikpfad temporär 3" ULONG Def_f_ul_b262144 0 0 0.0 65532.0000 ECU_ADDRESS 0x7FD9FC /begin FUNCTION_LIST MANDETEK /end FUNCTION_LIST /end MEASUREMENT
/begin MEASUREMENT Fid_manhydr "Funktionsidentifier Mandetek Hydraulikpfad" UBYTE Def_dez_ub_q1 0 0 0.0 255.0000 ECU_ADDRESS 0x7FBF47 /begin FUNCTION_LIST LAYER /end FUNCTION_LIST /end MEASUREMENT
/begin MEASUREMENT Fid_manluft "Funktionsidentifier Mandetek Luftpfad" UBYTE Def_dez_ub_q1 0 0 0.0 255.0000 ECU_ADDRESS 0x7FBF46 /begin FUNCTION_LIST LAYER /end FUNCTION_LIST /end MEASUREMENT
/begin MEASUREMENT Fluft_temp1 "rel. Fehler Luftpfad temporär 1" ULONG Def_f_ul_b262144 0 0 0.0 65532.0000 ECU_ADDRESS 0x7FDA00 /begin FUNCTION_LIST MANDETEK /end FUNCTION_LIST /end MEASUREMENT
/begin MEASUREMENT Fluft_temp2 "rel. Fehler Luftpfad temporär 2" ULONG Def_f_ul_b262144 0 0 0.0 65532.0000 ECU_ADDRESS 0x7FDA04 /begin FUNCTION_LIST MANDETEK /end FUNCTION_LIST /end MEASUREMENT
/begin MEASUREMENT Fluft_temp3 "rel. Fehler Luftpfad temporär 3" ULONG Def_f_ul_b262144 0 0 0.0 65532.0000 ECU_ADDRESS 0x7FDA08 /begin FUNCTION_LIST MANDETEK /end FUNCTION_LIST /end MEASUREMENT
/begin MEASUREMENT Fluft_temp4 "rel. Fehler Luftpfad temporär 4" ULONG Def_f_ul_b262144 0 0 0.0 65532.0000 ECU_ADDRESS 0x7FDA0C /begin FUNCTION_LIST MANDETEK /end FUNCTION_LIST /end MEASUREMENT
/begin MEASUREMENT Fsclctr "Hilfszaehler IBS Fehler loeschen" UBYTE Def_dez_ub_q1 0 0 0.0 255.0000 ECU_ADDRESS 0x7FD80B /begin FUNCTION_LIST KT_IBS /end FUNCTION_LIST /end MEASUREMENT
/begin MEASUREMENT Gangi "Aktueller Gang intern" UBYTE Def_dez_ub_q1 0 0 0.0 255.0000 ECU_ADDRESS 0x7FBE75 /begin FUNCTION_LIST LAYER /end FUNCTION_LIST /end MEASUREMENT
/begin MEASUREMENT Gen_manufak "Herstellercode Generator 1" UBYTE Def_st_ub_q1 0 0 0.0 255.0000 ECU_ADDRESS 0x7FBEBA /begin FUNCTION_LIST LAYER /end FUNCTION_LIST /end MEASUREMENT
/begin MEASUREMENT Gen_manufak2 "Herstellercode Generator 2" UBYTE Def_st_ub_q1 0 0 0.0 255.0000 ECU_ADDRESS 0x7FBEBB /begin FUNCTION_LIST LAYER /end FUNCTION_LIST /end MEASUREMENT
/begin MEASUREMENT Gen_typkenn "Kennung Generatortyp Gen 1" UBYTE Def_st_ub_q1 0 0 0.0 255.0000 ECU_ADDRESS 0x7FBEBC /begin FUNCTION_LIST LAYER /end FUNCTION_LIST /end MEASUREMENT
/begin MEASUREMENT Gen_typkenn2 "Kennung Generatortyp Gen 2" UBYTE Def_st_ub_q1 0 0 0.0 255.0000 ECU_ADDRESS 0x7FBEBD /begin FUNCTION_LIST LAYER /end FUNCTION_LIST /end MEASUREMENT
/begin MEASUREMENT Gewh "Gewicht Hydraulikpfad" UBYTE Def_dez_ub_q1 0 0 0.0 255.0000 ECU_ADDRESS 0x7FDA10 /begin FUNCTION_LIST MANDETEK /end FUNCTION_LIST /end MEASUREMENT
/begin MEASUREMENT Gewl "Gewicht Luftpfad" UBYTE Def_dez_ub_q1 0 0 0.0 255.0000 ECU_ADDRESS 0x7FDA11 /begin FUNCTION_LIST MANDETEK /end FUNCTION_LIST /end MEASUREMENT
/begin MEASUREMENT Ghydrla "Gewicht Hydraulikpfad La_ist1" UBYTE Def_f_ub_b2 0 0 0.0079 1.9921 ECU_ADDRESS 0x7FDA14 ARRAY_SIZE 120 /begin FUNCTION_LIST MANDETEK /end FUNCTION_LIST /end MEASUREMENT
/begin MEASUREMENT Ghydrme "Gewicht Hydraulikpfad Me_ist" UBYTE Def_f_ub_b2 0 0 0.0079 1.9921 ECU_ADDRESS 0x7FDA8C ARRAY_SIZE 120 /begin FUNCTION_LIST MANDETEK /end FUNCTION_LIST /end MEASUREMENT
/begin MEASUREMENT Ghydrml "Gewicht Hydraulikpfad Ml" UBYTE Def_f_ub_b2 0 0 0.0079 1.9921 ECU_ADDRESS 0x7FDB04 ARRAY_SIZE 120 /begin FUNCTION_LIST MANDETEK /end FUNCTION_LIST /end MEASUREMENT
/begin MEASUREMENT Gluftml "Gewicht Luftpfad Ml" UBYTE Def_f_ub_b2 0 0 0.0079 1.9921 ECU_ADDRESS 0x7FDB7C ARRAY_SIZE 120 /begin FUNCTION_LIST MANDETEK /end FUNCTION_LIST /end MEASUREMENT
/begin MEASUREMENT Gluftpld "Gewicht Luftpfad Pld" UBYTE Def_f_ub_b2 0 0 0.0079 1.9921 ECU_ADDRESS 0x7FDBF4 ARRAY_SIZE 120 /begin FUNCTION_LIST MANDETEK /end FUNCTION_LIST /end MEASUREMENT
/begin MEASUREMENT Glufttvagr "Gewicht Luftpfad Tastverhältnis Agr" UBYTE Def_f_ub_b2 0 0 0.0079 1.9921 ECU_ADDRESS 0x7FDC6C ARRAY_SIZE 120 /begin FUNCTION_LIST MANDETEK /end FUNCTION_LIST /end MEASUREMENT
/begin MEASUREMENT Glufttvpld "Gewicht Luftpfad Tastverhältnis Pld" UBYTE Def_f_ub_b2 0 0 0.0079 1.9921 ECU_ADDRESS 0x7FDCE4 ARRAY_SIZE 120 /begin FUNCTION_LIST MANDETEK /end FUNCTION_LIST /end MEASUREMENT
/begin MEASUREMENT Hydrstat "Zähler für quasistationären Zustand Hydraulikpfad" UBYTE Def_dez_ub_q1 0 0 0.0 255.0000 ECU_ADDRESS 0x7FDD5C /begin FUNCTION_LIST MANDETEK /end FUNCTION_LIST /end MEASUREMENT
/begin MEASUREMENT I_batt "Batteriestrom von IBS gemessen" UWORD Def_i_uw_q0p08_o200 0 0 -200.0000 5042.8000 ECU_ADDRESS 0x7FD796 /begin FUNCTION_LIST KT_IBS /end FUNCTION_LIST /end MEASUREMENT
/begin MEASUREMENT I_pregelv "Strom Raildruckregelventil" SWORD Def_i_sw_q0039 0 0 -128.0000 127.9960 ECU_ADDRESS 0x7FBEA4 /begin FUNCTION_LIST LAYER /end FUNCTION_LIST /end MEASUREMENT
/begin MEASUREMENT I_soc0 "Strom bei Ruhespannungsmessung" SWORD Def_i_sw_q0p02 0 0 -655.3600 655.3400 ECU_ADDRESS 0x7FD7A6 /begin FUNCTION_LIST KT_IBS /end FUNCTION_LIST /end MEASUREMENT
/begin MEASUREMENT I_tnstart "Batteriestrom im Start" UWORD Def_i_uw_q0p02 0 0 0.0 1310.7000 ECU_ADDRESS 0x7FD7BA /begin FUNCTION_LIST KT_IBS /end FUNCTION_LIST /end MEASUREMENT
/begin MEASUREMENT I_vorstart "Batteriestrom vor Start" UWORD Def_i_uw_q0p02_o200 0 0 -200.0000 1110.7000 ECU_ADDRESS 0x7FD7B8 /begin FUNCTION_LIST KT_IBS /end FUNCTION_LIST /end MEASUREMENT
/begin MEASUREMENT I_zme "Strom Zumeßeinheit" SWORD Def_i_sw_q0039 0 0 -128.0000 127.9960 ECU_ADDRESS 0x7FBEA2 /begin FUNCTION_LIST LAYER /end FUNCTION_LIST /end MEASUREMENT
/begin MEASUREMENT Ib_chk16 "Checksumme EBSD Übertragung aus IBS" UWORD Def_dez_uw_q1 0 0 0.0 65535.0000 ECU_ADDRESS 0x7FD7CE /begin FUNCTION_LIST KT_IBS /end FUNCTION_LIST /end MEASUREMENT
/begin MEASUREMENT Ib_parlen "Länge IBS Parameterliste" UBYTE Def_dez_ub_q1 0 0 0.0 255.0000 ECU_ADDRESS 0x7FD7F8 /begin FUNCTION_LIST KT_IBS /end FUNCTION_LIST /end MEASUREMENT
/begin MEASUREMENT Ibhwversi "IBS Hardware Version" UBYTE Def_dez_ub_q1 0 0 0.0 255.0000 ECU_ADDRESS 0x7FD7F7 /begin FUNCTION_LIST KT_IBS /end FUNCTION_LIST /end MEASUREMENT
/begin MEASUREMENT Ibs_errors "Fehler Reg. aus IBS gelesen" UBYTE Def_dez_ub_q1 0 0 0.0 255.0000 ECU_ADDRESS 0x7FD7EC /begin FUNCTION_LIST KT_IBS /end FUNCTION_LIST /end MEASUREMENT
/begin MEASUREMENT Ibs_msgind "Index auf EBSD Botschaft" UBYTE Def_dez_ub_q1 0 0 0.0 255.0000 ECU_ADDRESS 0x7FD7ED /begin FUNCTION_LIST KT_IBS /end FUNCTION_LIST /end MEASUREMENT
/begin MEASUREMENT Ibs_msgsta "EBSD Fehler Status" UBYTE Def_dez_ub_q1 0 0 0.0 255.0000 ECU_ADDRESS 0x7FD7EE /begin FUNCTION_LIST KT_IBS /end FUNCTION_LIST /end MEASUREMENT
/begin MEASUREMENT Ibs_reg5 "IBS Register 5 Var.not used: now St_ibsreg5" UBYTE Def_dez_ub_q1 0 0 0.0 255.0000 ECU_ADDRESS 0x7FD7EB /begin FUNCTION_LIST KT_IBS /end FUNCTION_LIST /end MEASUREMENT
/begin MEASUREMENT Ibs_start "Status Statemachine Startup Kommunikation" UBYTE Def_dez_ub_q1 0 0 0.0 255.0000 ECU_ADDRESS 0x7FD7F0 /begin FUNCTION_LIST KT_IBS /end FUNCTION_LIST /end MEASUREMENT
/begin MEASUREMENT Ibsbclctri "IBS Fehlerzähler" UBYTE Def_dez_ub_q1 0 0 0.0 255.0000 ECU_ADDRESS 0x7FD7FA /begin FUNCTION_LIST KT_IBS /end FUNCTION_LIST /end MEASUREMENT
/begin MEASUREMENT Ibsborctr "IBS Fehlerzähler" UWORD Def_dez_uw_q1 0 0 0.0 65535.0000 ECU_ADDRESS 0x7FD79A /begin FUNCTION_LIST KT_IBS /end FUNCTION_LIST /end MEASUREMENT
/begin MEASUREMENT Ibsdncsctr "IBS Fehlerzähler download checksum" UBYTE Def_dez_ub_q1 0 0 0.0 255.0000 ECU_ADDRESS 0x7FD7FE /begin FUNCTION_LIST KT_IBS /end FUNCTION_LIST /end MEASUREMENT
/begin MEASUREMENT Ibseromctr "IBS Fehlerzähler" UBYTE Def_dez_ub_q1 0 0 0.0 255.0000 ECU_ADDRESS 0x7FD7FB /begin FUNCTION_LIST KT_IBS /end FUNCTION_LIST /end MEASUREMENT
/begin MEASUREMENT Ibsiicctri "IBS Fehlerzähler" UBYTE Def_dez_ub_q1 0 0 0.0 255.0000 ECU_ADDRESS 0x7FD7F9 /begin FUNCTION_LIST KT_IBS /end FUNCTION_LIST /end MEASUREMENT
/begin MEASUREMENT Ibslvdctr "IBS Fehlerzähler" UWORD Def_dez_uw_q1 0 0 0.0 65535.0000 ECU_ADDRESS 0x7FD794 /begin FUNCTION_LIST KT_IBS /end FUNCTION_LIST /end MEASUREMENT
/begin MEASUREMENT Ibsporctr "IBS Fehlerzähler power on" UWORD Def_dez_uw_q1 0 0 0.0 65535.0000 ECU_ADDRESS 0x7FD79E /begin FUNCTION_LIST KT_IBS /end FUNCTION_LIST /end MEASUREMENT
/begin MEASUREMENT Ibspromctr "IBS Fehlerzähler" UBYTE Def_dez_ub_q1 0 0 0.0 255.0000 ECU_ADDRESS 0x7FD7FD /begin FUNCTION_LIST KT_IBS /end FUNCTION_LIST /end MEASUREMENT
/begin MEASUREMENT Ibsptyctr "IBS Fehlerzähler BSD parity" UWORD Def_dez_uw_q1 0 0 0.0 65535.0000 ECU_ADDRESS 0x7FD7A0 /begin FUNCTION_LIST KT_IBS /end FUNCTION_LIST /end MEASUREMENT
/begin MEASUREMENT Ibsramctr "IBS Fehlerzähler" UBYTE Def_dez_ub_q1 0 0 0.0 255.0000 ECU_ADDRESS 0x7FD7FC /begin FUNCTION_LIST KT_IBS /end FUNCTION_LIST /end MEASUREMENT
/begin MEASUREMENT Ibswbase "IBS Software Baseline" UBYTE Def_dez_ub_q1 0 0 0.0 255.0000 ECU_ADDRESS 0x7FD7F5 /begin FUNCTION_LIST KT_IBS /end FUNCTION_LIST /end MEASUREMENT
/begin MEASUREMENT Ibswchang "IBS Software Änderungs Status" UBYTE Def_dez_ub_q1 0 0 0.0 255.0000 ECU_ADDRESS 0x7FD7F6 /begin FUNCTION_LIST KT_IBS /end FUNCTION_LIST /end MEASUREMENT
/begin MEASUREMENT Ibswdtctr "IBS Fehlerzähler watchdog" UWORD Def_dez_uw_q1 0 0 0.0 65535.0000 ECU_ADDRESS 0x7FD79C /begin FUNCTION_LIST KT_IBS /end FUNCTION_LIST /end MEASUREMENT
/begin MEASUREMENT Id_bosmg "Kennung für BOS-Meldung = Ölservice-Info" UWORD Def_dez_uw_q1 0 0 0.0 65535.0000 ECU_ADDRESS 0x7FDD7E /begin FUNCTION_LIST OZBG /end FUNCTION_LIST /end MEASUREMENT
/begin MEASUREMENT Id_bosmgt "Kennung für BOS-Meldung vom Tester" UBYTE Def_dez_ub_q1 0 0 0.0 255.0000 ECU_ADDRESS 0x7FDD82 /begin FUNCTION_LIST OZBG /end FUNCTION_LIST /end MEASUREMENT
/begin MEASUREMENT Id_bosmsg "Kennung für BOS-Meldung vom Kombi" UBYTE Def_dez_ub_q1 0 0 0.0 255.0000 ECU_ADDRESS 0x7FDD83 /begin FUNCTION_LIST OZBG /end FUNCTION_LIST /end MEASUREMENT
/begin MEASUREMENT Id_bosrst "ID für BOS-Reset vom Kombi" UBYTE Def_dez_ub_q1 0 0 0.0 255.0000 ECU_ADDRESS 0x7FBE76 /begin FUNCTION_LIST LAYER /end FUNCTION_LIST /end MEASUREMENT
/begin MEASUREMENT Id_bosrtt "Kennung vom Tester für Ölservice" UBYTE Def_dez_ub_q1 0 0 0.0 255.0000 ECU_ADDRESS 0x7FBE70 /begin FUNCTION_LIST LAYER /end FUNCTION_LIST /end MEASUREMENT
/begin MEASUREMENT Id_bosrtw "ID für Motoröl vom Kombi" UWORD Def_dez_uw_q1 0 0 0.0 65535.0000 ECU_ADDRESS 0x7FBE78 /begin FUNCTION_LIST LAYER /end FUNCTION_LIST /end MEASUREMENT
/begin MEASUREMENT Ierr "Erregerstrom Generator1" UBYTE Def_i_ub_q0p125 0 0 0.0 31.8750 ECU_ADDRESS 0x7FBEBE /begin FUNCTION_LIST LAYER /end FUNCTION_LIST /end MEASUREMENT
/begin MEASUREMENT Ierr2 "Erregerstrom Generator 2" UBYTE Def_i_ub_q0p125 0 0 0.0 31.8750 ECU_ADDRESS 0x7FBEBF /begin FUNCTION_LIST LAYER /end FUNCTION_LIST /end MEASUREMENT
/begin MEASUREMENT Ierr_fil "Gefilterter Erregerstrom" UBYTE Def_i_ub_q0p125 0 0 0.0 31.8750 ECU_ADDRESS 0x7FD88E /begin FUNCTION_LIST LDSTGEN /end FUNCTION_LIST /end MEASUREMENT
/begin MEASUREMENT Ierrfgrenz "Kopie begrenzter Erregerstrom Generator 1" UBYTE Def_i_ub_q0p125 0 0 0.0 31.8750 ECU_ADDRESS 0x7FBEC0 /begin FUNCTION_LIST LAYER /end FUNCTION_LIST /end MEASUREMENT
/begin MEASUREMENT Ierrfgrenz2 "Kopie begrenzter Erregerstrom Generator 2" UBYTE Def_i_ub_q0p125 0 0 0.0 31.8750 ECU_ADDRESS 0x7FBEC1 /begin FUNCTION_LIST LAYER /end FUNCTION_LIST /end MEASUREMENT
/begin MEASUREMENT Ierrgrenz2 "Grenzertrregerstrom" UBYTE Def_i_ub_q0p125 0 0 0.0 31.8750 ECU_ADDRESS 0x7FBEC2 /begin FUNCTION_LIST LAYER /end FUNCTION_LIST /end MEASUREMENT
/begin MEASUREMENT Ikurz_ogr "Obere Grenze Kurzschlussstrom vom CAS" UBYTE Def_i_ub_q10 0 0 0.0 2550.0000 ECU_ADDRESS 0x7FD82D /begin FUNCTION_LIST LAYER /end FUNCTION_LIST /end MEASUREMENT
/begin MEASUREMENT Ikurz_ugr "Untere Grenze Kurzschlussstrom vom CAS" UBYTE Def_i_ub_q10 0 0 0.0 2550.0000 ECU_ADDRESS 0x7FD82E /begin FUNCTION_LIST LAYER /end FUNCTION_LIST /end MEASUREMENT
/begin MEASUREMENT Ivvtmot_mw " " SWORD Def_i_sw_q0p0625 0 0 -2048.0000 2047.9375 ECU_ADDRESS 0x7FBEC4 ARRAY_SIZE 6 /begin FUNCTION_LIST LAYER /end FUNCTION_LIST /end MEASUREMENT
/begin MEASUREMENT Ivvtmot_mw2 " " SWORD Def_i_sw_q0p0625 0 0 -2048.0000 2047.9375 ECU_ADDRESS 0x7FBED0 ARRAY_SIZE 6 /begin FUNCTION_LIST LAYER /end FUNCTION_LIST /end MEASUREMENT
/begin MEASUREMENT Iwakeupgr "Fahrzeugspezifischer Ruhestrom" UBYTE Def_i_ub_q0p001 0 0 0.0 0.2550 ECU_ADDRESS 0x7FD82F /begin FUNCTION_LIST LAYER /end FUNCTION_LIST /end MEASUREMENT
/begin MEASUREMENT Km_st "Kilometerstand" UWORD Def_km_uw_q10 0 0 0.0 655350.0000 ECU_ADDRESS 0x7FBEDC /begin FUNCTION_LIST LAYER /end FUNCTION_LIST /end MEASUREMENT
/begin MEASUREMENT Km_st_1 "Wegstrecke_km auf 1km genau" ULONG Def_dez_ul_q1 0 0 0.0 2147483647.0000 ECU_ADDRESS 0x7FD84C /begin FUNCTION_LIST LAYER /end FUNCTION_LIST /end MEASUREMENT
/begin MEASUREMENT Kt_ibsstatus "Status BSD Statemachine" UBYTE Def_dez_ub_q1 0 0 0.0 255.0000 ECU_ADDRESS 0x7FD7EF /begin FUNCTION_LIST KT_IBS /end FUNCTION_LIST /end MEASUREMENT
/begin MEASUREMENT Ktib_chk16 "Checksumme EBSD Übertragung intern" UWORD Def_dez_uw_q1 0 0 0.0 65535.0000 ECU_ADDRESS 0x7FD7CC /begin FUNCTION_LIST KT_IBS /end FUNCTION_LIST /end MEASUREMENT
/begin MEASUREMENT Ktupcsctr "kt_ibs Fehlerzähler EBSD Checksumme" UWORD Def_dez_uw_q1 0 0 0.0 65535.0000 ECU_ADDRESS 0x7FD7CA /begin FUNCTION_LIST KT_IBS /end FUNCTION_LIST /end MEASUREMENT
/begin MEASUREMENT Kvaverbr "Kraftstoffverbrauch (Einspritzmenge in Microliter)" UWORD Def_dez_uw_q1 0 0 0.0 65535.0000 ECU_ADDRESS 0x7FBE7A /begin FUNCTION_LIST LAYER /end FUNCTION_LIST /end MEASUREMENT
/begin MEASUREMENT L_pwmout "Tastverhältnis E-Lüfter" UBYTE Def_tv_ub_q0p390625 0 0 0.0 99.6093 ECU_ADDRESS 0x7FBEDE /begin FUNCTION_LIST LAYER /end FUNCTION_LIST /end MEASUREMENT
/begin MEASUREMENT La_ist1 "Lambdaistwert" UWORD Def_f_uw_b16 0 0 0.0 15.9997 ECU_ADDRESS 0x7FBF3E /begin FUNCTION_LIST LAYER /end FUNCTION_LIST /end MEASUREMENT
/begin MEASUREMENT La_n "Lambdawert normiert" UBYTE Def_f_ub_b2 0 0 0.0 1.9921 ECU_ADDRESS 0x7FDD5D /begin FUNCTION_LIST MANDETEK /end FUNCTION_LIST /end MEASUREMENT
/begin MEASUREMENT Loadresp "" UBYTE Def_td_ub_q0p1 0 0 0.0 25.5000 ECU_ADDRESS 0x7FD89C /begin FUNCTION_LIST LOADRESP /end FUNCTION_LIST /end MEASUREMENT
/begin MEASUREMENT Luftstat "Zähler für quasistationären Zustand Luftpfad" UBYTE Def_dez_ub_q1 0 0 0.0 255.0000 ECU_ADDRESS 0x7FDD5E /begin FUNCTION_LIST MANDETEK /end FUNCTION_LIST /end MEASUREMENT
/begin MEASUREMENT Md_grenz "Maximalmoment Generator an BSDII" SWORD Def_m_sw_q0p1 0 0 -3276.8000 3276.7000 ECU_ADDRESS 0x7FD896 /begin FUNCTION_LIST LOADRESP /end FUNCTION_LIST /end MEASUREMENT
/begin MEASUREMENT Md_mgmax "Maximalmoment Generator" SWORD Def_m_sw_q0p1 0 0 -3276.8000 3276.7000 ECU_ADDRESS 0x7FBE9C /begin FUNCTION_LIST LAYER /end FUNCTION_LIST /end MEASUREMENT
/begin MEASUREMENT Me_ist "Einspritzmasse aktuell" SWORD Def_me_sw_q0p01 0 0 -327.6800 327.6700 ECU_ADDRESS 0x7FBF3C /begin FUNCTION_LIST LAYER /end FUNCTION_LIST /end MEASUREMENT
/begin MEASUREMENT Me_n "Einspritzmasse normiert" UBYTE Def_f_ub_b2 0 0 0.0 1.9921 ECU_ADDRESS 0x7FDD5F /begin FUNCTION_LIST MANDETEK /end FUNCTION_LIST /end MEASUREMENT
/begin MEASUREMENT Ml "Luftmasse pro Zylinder" SWORD Def_ml_sw_q0p1 0 0 -3276.8000 3276.7000 ECU_ADDRESS 0x7FBF3A /begin FUNCTION_LIST LAYER /end FUNCTION_LIST /end MEASUREMENT
/begin MEASUREMENT Mlh_n "Luftmasse pro Zylinder normiert Hydraulikpfad" UBYTE Def_f_ub_b2 0 0 0.0 1.9921 ECU_ADDRESS 0x7FDD60 /begin FUNCTION_LIST MANDETEK /end FUNCTION_LIST /end MEASUREMENT
/begin MEASUREMENT Mll_n "Luftmasse pro Zylinder normiert Luftpfad" UBYTE Def_f_ub_b2 0 0 0.0 1.9921 ECU_ADDRESS 0x7FDD61 /begin FUNCTION_LIST MANDETEK /end FUNCTION_LIST /end MEASUREMENT
/begin MEASUREMENT Mslui "Integr. Luftmasse" UWORD Def_lm_uw_q0p000444 0 0 0.0 29.1266 ECU_ADDRESS 0x7FBEE0 /begin FUNCTION_LIST LAYER /end FUNCTION_LIST /end MEASUREMENT
/begin MEASUREMENT N_idlibs "Leerlaufdrehzahlvorgabe von LC-Powermanagement" UBYTE Def_st_ub_q1 0 0 0.0 255.0000 ECU_ADDRESS 0x7FC0BE /begin FUNCTION_LIST LLPMCTRL /end FUNCTION_LIST /end MEASUREMENT
/begin MEASUREMENT N_idlms "Leerlaufdrehzahlanhebung von Powermodul" UBYTE Def_st_ub_q1 0 0 0.0 255.0000 ECU_ADDRESS 0x7FBEE6 /begin FUNCTION_LIST LAYER /end FUNCTION_LIST /end MEASUREMENT
/begin MEASUREMENT N_nstart "Motordrehzahl nach Motorstart" SWORD Def_n_sw_q1p0 0 0 -32768.0000 32767.0000 ECU_ADDRESS 0x7FD88A /begin FUNCTION_LIST LDSTGEN /end FUNCTION_LIST /end MEASUREMENT
/begin MEASUREMENT N_ozmw "kurzzeitiger Mittelwert Drehzahl" SWORD Def_n_sw_q1p0 0 0 -32767.0000 32767.0000 ECU_ADDRESS 0x7FDDE6 /begin FUNCTION_LIST OZNIVDL /end FUNCTION_LIST /end MEASUREMENT
/begin MEASUREMENT Nkw "Drehzahl" SWORD Def_n_sw_q1p0 0 0 -32768.0000 32767.0000 ECU_ADDRESS 0x7FBEE2 /begin FUNCTION_LIST LAYER /end FUNCTION_LIST /end MEASUREMENT
/begin MEASUREMENT Nslb "N_soll Korrektur von Ladebilanz Batterie" SWORD Def_n_sw_q1p0 0 0 0.0 32767.0000 ECU_ADDRESS 0x7FD892 /begin FUNCTION_LIST LLRANH /end FUNCTION_LIST /end MEASUREMENT
/begin MEASUREMENT Nsllm "Solldrehzahl im Leerlauf ohne Fahrstufe" SWORD Def_n_sw_q1p0 0 0 -32768.0000 32767.0000 ECU_ADDRESS 0x7FBEE4 /begin FUNCTION_LIST LAYER /end FUNCTION_LIST /end MEASUREMENT
/begin MEASUREMENT Oz_datstat "Status Anzeige Uhrzeit Datum" UBYTE Def_dez_ub_q1 0 0 0.0 255.0000 ECU_ADDRESS 0x7FBF2C /begin FUNCTION_LIST LAYER /end FUNCTION_LIST /end MEASUREMENT
/begin MEASUREMENT Oz_dkm "" UWORD Def_f_uw_b10 0 0 0.0 9.9998 ECU_ADDRESS 0x7FDDEE /begin FUNCTION_LIST OZNIVDL /end FUNCTION_LIST /end MEASUREMENT
/begin MEASUREMENT Oz_dpermsi "" SBYTE Def_dez_sb_q1 0 0 -128.0000 127.0000 ECU_ADDRESS 0x7FDE5C /begin FUNCTION_LIST OZPERM /end FUNCTION_LIST /end MEASUREMENT
/begin MEASUREMENT Oz_hoehe "" SWORD Def_f_sw_b8 0 0 -8.0000 7.9997 ECU_ADDRESS 0x7FDDE8 /begin FUNCTION_LIST OZNIVDL /end FUNCTION_LIST /end MEASUREMENT
/begin MEASUREMENT Oz_kmlow "Kilometerstand letzter Ölwechsel" SWORD Def_km_sw_q10 0 0 -327680.0000 327670.0000 ECU_ADDRESS 0x7FDD88 /begin FUNCTION_LIST OZGG /end FUNCTION_LIST /end MEASUREMENT
/begin MEASUREMENT Oz_kmreg "Schieberegister Kilometerstand" UWORD Def_km_uw_q10 0 0 0.0 655350.0000 ECU_ADDRESS 0x7FDE16 ARRAY_SIZE 15 /begin FUNCTION_LIST OZPERM /end FUNCTION_LIST /end MEASUREMENT
/begin MEASUREMENT Oz_krzcnt "" UBYTE Def_dez_ub_q1 0 0 0.0 255.0000 ECU_ADDRESS 0x7FDDF4 /begin FUNCTION_LIST OZNIVDL /end FUNCTION_LIST /end MEASUREMENT
/begin MEASUREMENT Oz_krzmw "" UBYTE Def_niv_ub_b75 0 0 0.0 74.7070 ECU_ADDRESS 0x7FDDF5 /begin FUNCTION_LIST OZNIVDL /end FUNCTION_LIST /end MEASUREMENT
/begin MEASUREMENT Oz_krzmwkor "" UBYTE Def_niv_ub_b75 0 0 0.0 74.7070 ECU_ADDRESS 0x7FDDF6 /begin FUNCTION_LIST OZNIVDL /end FUNCTION_LIST /end MEASUREMENT
/begin MEASUREMENT Oz_krzor "kurzzeitiger Mittelwert Orientierungsmessung Niveau" UBYTE Def_niv_ub_b75 0 0 0.0 74.7070 ECU_ADDRESS 0x7FDE07 /begin FUNCTION_LIST OZNIVDL /end FUNCTION_LIST /end MEASUREMENT
/begin MEASUREMENT Oz_langmw "Langzeitmittelwert berechnet" UBYTE Def_niv_ub_b75 0 0 0.0 74.7070 ECU_ADDRESS 0x7FDDDC /begin FUNCTION_LIST OZNIVDL /end FUNCTION_LIST /end MEASUREMENT
/begin MEASUREMENT Oz_leit_dum "" UBYTE Def_dez_ub_q1 0 0 0.0 255.0000 ECU_ADDRESS 0x7FC49C /begin FUNCTION_LIST OZLEIT /end FUNCTION_LIST /end MEASUREMENT
/begin MEASUREMENT Oz_lf1c "Länderfaktor 1 codiert" UBYTE Def_lf_ub_q0p01 0 0 0.0 2.5500 ECU_ADDRESS 0x7FBE6D /begin FUNCTION_LIST LAYER /end FUNCTION_LIST /end MEASUREMENT
/begin MEASUREMENT Oz_lf2c "Länderfaktor 2 codiert" UBYTE Def_lf_ub_q0p01 0 0 0.0 2.5500 ECU_ADDRESS 0x7FBE6E /begin FUNCTION_LIST LAYER /end FUNCTION_LIST /end MEASUREMENT
/begin MEASUREMENT Oz_lgmwcnt "" UBYTE Def_dez_ub_q1 0 0 0.0 255.0000 ECU_ADDRESS 0x7FDDF7 /begin FUNCTION_LIST OZNIVDL /end FUNCTION_LIST /end MEASUREMENT
/begin MEASUREMENT Oz_lowcnt "Zähler zur Sicherung der Ölwechselinformationen" UBYTE Def_dez_ub_q1 0 0 0.0 255.0000 ECU_ADDRESS 0x7FDDC0 /begin FUNCTION_LIST OZGG /end FUNCTION_LIST /end MEASUREMENT
/begin MEASUREMENT Oz_lowkm "Register für KM-Stand beim Ölwechsel" UWORD Def_km_uw_q10 0 0 0.0 655350.0000 ECU_ADDRESS 0x7FDD9A ARRAY_SIZE 6 /begin FUNCTION_LIST OZGG /end FUNCTION_LIST /end MEASUREMENT
/begin MEASUREMENT Oz_lowperex "Register für extrapoliertes Er beim Ölwechsel" UWORD Def_perm_uw_b6 0 0 0.0 5.9999 ECU_ADDRESS 0x7FDDA6 ARRAY_SIZE 6 /begin FUNCTION_LIST OZGG /end FUNCTION_LIST /end MEASUREMENT
/begin MEASUREMENT Oz_lowperm0 "Register für Er nach Ölwechsel" UWORD Def_perm_uw_b6 0 0 0.0 5.9999 ECU_ADDRESS 0x7FDDB2 ARRAY_SIZE 6 /begin FUNCTION_LIST OZGG /end FUNCTION_LIST /end MEASUREMENT
/begin MEASUREMENT Oz_lowrwanz "Register für Restweganzeige beim Ölwechsel" SWORD Def_km_sw_q10 0 0 -327680.0000 327670.0000 ECU_ADDRESS 0x7FDD8E ARRAY_SIZE 6 /begin FUNCTION_LIST OZGG /end FUNCTION_LIST /end MEASUREMENT
/begin MEASUREMENT Oz_lp "oz level picture" UBYTE Def_dez_ub_q1 0 0 0.0 255.0000 ECU_ADDRESS 0x7FDE08 /begin FUNCTION_LIST OZNIVDL /end FUNCTION_LIST /end MEASUREMENT
/begin MEASUREMENT Oz_lv "oz level value" UBYTE Def_dez_ub_q1 0 0 0.0 255.0000 ECU_ADDRESS 0x7FDE09 /begin FUNCTION_LIST OZNIVDL /end FUNCTION_LIST /end MEASUREMENT
/begin MEASUREMENT Oz_manip "geänderter Servicezähler" UBYTE Def_dez_ub_q1 0 0 0.0 255.0000 ECU_ADDRESS 0x7FDDCE /begin FUNCTION_LIST OZGG /end FUNCTION_LIST /end MEASUREMENT
/begin MEASUREMENT Oz_manipt "Manipulation" UBYTE Def_dez_ub_q1 0 0 0.0 255.0000 ECU_ADDRESS 0x7FDDC1 /begin FUNCTION_LIST OZGG /end FUNCTION_LIST /end MEASUREMENT
/begin MEASUREMENT Oz_niv "Ölniveau ungefiltert" UBYTE Def_niv_ub_b75 0 0 0.0 74.7070 ECU_ADDRESS 0x7FDDCF /begin FUNCTION_LIST OZGG /end FUNCTION_LIST /end MEASUREMENT
/begin MEASUREMENT Oz_nivakt "Aktuelles Niveau für den Tester" UBYTE Def_niv_ub_b75 0 0 0.0 74.7070 ECU_ADDRESS 0x7FDE0A /begin FUNCTION_LIST OZNIVDL /end FUNCTION_LIST /end MEASUREMENT
/begin MEASUREMENT Oz_nivkm "letzter Kilometerstand bei dem ein neuer Langzeitmittelwert Niveau vorlag und kein Öl nachgefüllt wurde" UWORD Def_km_uw_q10 0 0 0.0 655350.0000 ECU_ADDRESS 0x7FDE34 /begin FUNCTION_LIST OZPERM /end FUNCTION_LIST /end MEASUREMENT
/begin MEASUREMENT Oz_nivkrzt "Kurzmittelwert-Niveau für den Tester" UBYTE Def_niv_ub_b75 0 0 0.0 74.7070 ECU_ADDRESS 0x7FDE0B /begin FUNCTION_LIST OZNIVDL /end FUNCTION_LIST /end MEASUREMENT
/begin MEASUREMENT Oz_nivlangt "Langmittelwert für den Tester" UBYTE Def_niv_ub_b75 0 0 0.0 74.7070 ECU_ADDRESS 0x7FDDDD /begin FUNCTION_LIST OZNIVDL /end FUNCTION_LIST /end MEASUREMENT
/begin MEASUREMENT Oz_nivnfm "Nachfüllmenge" UBYTE Def_niv_ub_b8 0 0 0.0 7.9687 ECU_ADDRESS 0x7FDE0C /begin FUNCTION_LIST OZNIVDL /end FUNCTION_LIST /end MEASUREMENT
/begin MEASUREMENT Oz_nivr "Rohwert Ölniveau vom Sensor" UBYTE Def_dez_ub_q1 0 0 0.0 255.0000 ECU_ADDRESS 0x7FBE7C /begin FUNCTION_LIST LAYER /end FUNCTION_LIST /end MEASUREMENT
/begin MEASUREMENT Oz_nivt "begrenzter Niveau-Rohwert" UBYTE Def_dez_ub_q1 0 0 0.0 255.0000 ECU_ADDRESS 0x7FDDD4 /begin FUNCTION_LIST OZGG /end FUNCTION_LIST /end MEASUREMENT
/begin MEASUREMENT Oz_nmotf "" SWORD Def_n_sw_q1p0 0 0 -32768.0000 32767.0000 ECU_ADDRESS 0x7FDDEA /begin FUNCTION_LIST OZNIVDL /end FUNCTION_LIST /end MEASUREMENT
/begin MEASUREMENT Oz_oelkm "Ölkilometer" UWORD Def_km_uw_q10 0 0 0.0 655350.0000 ECU_ADDRESS 0x7FDD8A /begin FUNCTION_LIST OZGG /end FUNCTION_LIST /end MEASUREMENT
/begin MEASUREMENT Oz_oelnivak "" UBYTE Def_td_ub_q0p5 0 0 0.0 127.5000 ECU_ADDRESS 0x7FDDF8 /begin FUNCTION_LIST OZNIVDL /end FUNCTION_LIST /end MEASUREMENT
/begin MEASUREMENT Oz_oelnivaknk "" UBYTE Def_td_ub_q0p5 0 0 0.0 127.5000 ECU_ADDRESS 0x7FDDF9 /begin FUNCTION_LIST OZNIVDL /end FUNCTION_LIST /end MEASUREMENT
/begin MEASUREMENT Oz_oelnivkurz "" UBYTE Def_td_ub_q0p5 0 0 0.0 127.5000 ECU_ADDRESS 0x7FDDFA /begin FUNCTION_LIST OZNIVDL /end FUNCTION_LIST /end MEASUREMENT
/begin MEASUREMENT Oz_oelnivnorm "" UBYTE Def_td_ub_q0p5 0 0 0.0 127.5000 ECU_ADDRESS 0x7FDDFB /begin FUNCTION_LIST OZNIVDL /end FUNCTION_LIST /end MEASUREMENT
/begin MEASUREMENT Oz_oelnivori "" UBYTE Def_td_ub_q0p5 0 0 0.0 127.5000 ECU_ADDRESS 0x7FDDFC /begin FUNCTION_LIST OZNIVDL /end FUNCTION_LIST /end MEASUREMENT
/begin MEASUREMENT Oz_oelverbr "Berechneter Ölverbrauch" UWORD Def_dez_uw_q1 0 0 0.0 65535.0000 ECU_ADDRESS 0x7FDDDE /begin FUNCTION_LIST OZNIVDL /end FUNCTION_LIST /end MEASUREMENT
/begin MEASUREMENT Oz_oriverzz "" UBYTE Def_dez_ub_q1 0 0 0.0 255.0000 ECU_ADDRESS 0x7FDDFD /begin FUNCTION_LIST OZNIVDL /end FUNCTION_LIST /end MEASUREMENT
/begin MEASUREMENT Oz_peil "" UBYTE Def_niv_ub_b75 0 0 0.0 74.7070 ECU_ADDRESS 0x7FDDFE /begin FUNCTION_LIST OZNIVDL /end FUNCTION_LIST /end MEASUREMENT
/begin MEASUREMENT Oz_peilalt "" UBYTE Def_niv_ub_b75 0 0 0.0 74.7070 ECU_ADDRESS 0x7FDDFF /begin FUNCTION_LIST OZNIVDL /end FUNCTION_LIST /end MEASUREMENT
/begin MEASUREMENT Oz_peilalt1 "" UBYTE Def_niv_ub_b75 0 0 0.0 74.7070 ECU_ADDRESS 0x7FDE00 /begin FUNCTION_LIST OZNIVDL /end FUNCTION_LIST /end MEASUREMENT
/begin MEASUREMENT Oz_peilalt2 "" UBYTE Def_niv_ub_b75 0 0 0.0 74.7070 ECU_ADDRESS 0x7FDE01 /begin FUNCTION_LIST OZNIVDL /end FUNCTION_LIST /end MEASUREMENT
/begin MEASUREMENT Oz_peilaltanz "" UBYTE Def_niv_ub_b75 0 0 0.0 74.7070 ECU_ADDRESS 0x7FDDE4 /begin FUNCTION_LIST OZNIVDL /end FUNCTION_LIST /end MEASUREMENT
/begin MEASUREMENT Oz_peilkm "Max Ziel km im Fehlerfall" UWORD Def_km_uw_q10 0 0 0.0 655350.0000 ECU_ADDRESS 0x7FDDF0 /begin FUNCTION_LIST OZNIVDL /end FUNCTION_LIST /end MEASUREMENT
/begin MEASUREMENT Oz_peilkmalt "Km Stand beim 1. Sensorfehler" UWORD Def_km_uw_q10 0 0 0.0 655350.0000 ECU_ADDRESS 0x7FDDE0 /begin FUNCTION_LIST OZNIVDL /end FUNCTION_LIST /end MEASUREMENT
/begin MEASUREMENT Oz_perm "Permittivität ungefiltert" UWORD Def_perm_uw_b6 0 0 0.0 5.9999 ECU_ADDRESS 0x7FDDC6 /begin FUNCTION_LIST OZGG /end FUNCTION_LIST /end MEASUREMENT
/begin MEASUREMENT Oz_permakt "Permittivität für den Tester" UWORD Def_perm_uw_b6 0 0 0.0 5.9999 ECU_ADDRESS 0x7FDDC8 /begin FUNCTION_LIST OZGG /end FUNCTION_LIST /end MEASUREMENT
/begin MEASUREMENT Oz_permanz "Anzahl der Messwerte im Schieberegister" SBYTE Def_dez_sb_q1 0 0 -128.0000 127.0000 ECU_ADDRESS 0x7FDE58 /begin FUNCTION_LIST OZPERM /end FUNCTION_LIST /end MEASUREMENT
/begin MEASUREMENT Oz_permex "Permittivität für Bewertung aufbereitet (extrapoliert)" UWORD Def_perm_uw_b6 0 0 0.0 5.9999 ECU_ADDRESS 0x7FDE12 /begin FUNCTION_LIST OZPERM /end FUNCTION_LIST /end MEASUREMENT
/begin MEASUREMENT Oz_permlow "aufbereitete Permittivität bei letztem Ölwechsel" UWORD Def_perm_uw_b6 0 0 0.0 5.9999 ECU_ADDRESS 0x7FDE14 /begin FUNCTION_LIST OZPERM /end FUNCTION_LIST /end MEASUREMENT
/begin MEASUREMENT Oz_permoff "Offset für Permittivitätskorrektur" UWORD Def_perm_uw_b6 0 0 0.0 5.9999 ECU_ADDRESS 0x7FDE5A /begin FUNCTION_LIST OZPERM /end FUNCTION_LIST /end MEASUREMENT
/begin MEASUREMENT Oz_permoff_oz "Offset für Permittivitätskorrektur" SWORD Def_perm_sw_b6 0 0 -6.0000 5.9998 ECU_ADDRESS 0x7FDE10 /begin FUNCTION_LIST OZPERM /end FUNCTION_LIST /end MEASUREMENT
/begin MEASUREMENT Oz_permr "Rohwert Permittivität vom Sensor" UWORD Def_dez_uw_q1 0 0 0.0 65535.0000 ECU_ADDRESS 0x7FBE7E /begin FUNCTION_LIST LAYER /end FUNCTION_LIST /end MEASUREMENT
/begin MEASUREMENT Oz_permreg "Schieberegister Permittivität" UWORD Def_perm_uw_b6 0 0 0.0 5.9999 ECU_ADDRESS 0x7FDE36 ARRAY_SIZE 15 /begin FUNCTION_LIST OZPERM /end FUNCTION_LIST /end MEASUREMENT
/begin MEASUREMENT Oz_permt "begrenzter Permittivitäts-Rohwert" UWORD Def_dez_uw_q1 0 0 0.0 1024.0000 ECU_ADDRESS 0x7FDDCA /begin FUNCTION_LIST OZGG /end FUNCTION_LIST /end MEASUREMENT
/begin MEASUREMENT Oz_perref "Ersatzpermittivität" UWORD Def_dez_uw_q1 0 0 0.0 1024.0000 ECU_ADDRESS 0x7FDDBE /begin FUNCTION_LIST OZGG /end FUNCTION_LIST /end MEASUREMENT
/begin MEASUREMENT Oz_prfstrg "Zähler für Delta Er-Ermittlung" UWORD Def_dez_uw_q1 0 0 0.0 65535.0000 ECU_ADDRESS 0x7FDE54 /begin FUNCTION_LIST OZPERM /end FUNCTION_LIST /end MEASUREMENT
/begin MEASUREMENT Oz_reset "Zieltermin_Monat_BOS_Rückstellung_2" UBYTE Def_dez_ub_q1 0 0 0.0 255.0000 ECU_ADDRESS 0x7FDD84 /begin FUNCTION_LIST OZBG /end FUNCTION_LIST /end MEASUREMENT
/begin MEASUREMENT Oz_resetr "Status der Resetart vom Kombi" UBYTE Def_dez_ub_q1 0 0 0.0 255.0000 ECU_ADDRESS 0x7FBF36 /begin FUNCTION_LIST LAYER /end FUNCTION_LIST /end MEASUREMENT
/begin MEASUREMENT Oz_rwpeil "Restweg laut Peilstab" SWORD Def_km_sw_q10 0 0 -327680.0000 327670.0000 ECU_ADDRESS 0x7FDDDA /begin FUNCTION_LIST OZNIVDL /end FUNCTION_LIST /end MEASUREMENT
/begin MEASUREMENT Oz_rwprueck "" UBYTE Def_km_ub_q1000 0 0 0.0 255000.0000 ECU_ADDRESS 0x7FDDD0 /begin FUNCTION_LIST OZGG /end FUNCTION_LIST /end MEASUREMENT
/begin MEASUREMENT Oz_rwrueck "" SWORD Def_km_sw_q10 0 0 -327680.0000 327670.0000 ECU_ADDRESS 0x7FDDC2 /begin FUNCTION_LIST OZGG /end FUNCTION_LIST /end MEASUREMENT
/begin MEASUREMENT Oz_status "Statusinfo vom Sensor" UBYTE Def_dez_ub_q1 0 0 0.0 255.0000 ECU_ADDRESS 0x7FBE80 /begin FUNCTION_LIST LAYER /end FUNCTION_LIST /end MEASUREMENT
/begin MEASUREMENT Oz_steigung "" SWORD Def_f_sw_b64 0 0 -64.0000 63.9980 ECU_ADDRESS 0x7FDDEC /begin FUNCTION_LIST OZNIVDL /end FUNCTION_LIST /end MEASUREMENT
/begin MEASUREMENT Oz_svcntchg "geänderter Servicezähler" UBYTE Def_dez_ub_q1 0 0 0.0 255.0000 ECU_ADDRESS 0x7FDDD1 /begin FUNCTION_LIST OZGG /end FUNCTION_LIST /end MEASUREMENT
/begin MEASUREMENT Oz_temp "Öltemperatur ungefiltert" SWORD Def_t_sw_q0p1 0 0 -3276.8000 3276.7000 ECU_ADDRESS 0x7FDDC4 /begin FUNCTION_LIST OZGG /end FUNCTION_LIST /end MEASUREMENT
/begin MEASUREMENT Oz_tempakt "Ausgabe Öltemperatur für den Tester" SWORD Def_t_sw_q0p1 0 0 -3276.8000 3276.7000 ECU_ADDRESS 0x7FDD76 /begin FUNCTION_LIST OZBG /end FUNCTION_LIST /end MEASUREMENT
/begin MEASUREMENT Oz_tempr "Rohwert Öltemperatur vom Sensor" UBYTE Def_dez_ub_q1 0 0 0.0 255.0000 ECU_ADDRESS 0x7FBE81 /begin FUNCTION_LIST LAYER /end FUNCTION_LIST /end MEASUREMENT
/begin MEASUREMENT Oz_tempt "begrenzter Temperatur-Rohwert" UWORD Def_dez_uw_q1 0 0 0.0 65535.0000 ECU_ADDRESS 0x7FDDCC /begin FUNCTION_LIST OZGG /end FUNCTION_LIST /end MEASUREMENT
/begin MEASUREMENT Oz_testtoel1 "" SWORD Def_t_sw_q0p1 0 0 -3276.8000 3276.7000 ECU_ADDRESS 0x7FDD78 /begin FUNCTION_LIST OZBG /end FUNCTION_LIST /end MEASUREMENT
/begin MEASUREMENT Oz_testtoel2 "" SWORD Def_t_sw_q0p1 0 0 -3276.8000 3276.7000 ECU_ADDRESS 0x7FDDF2 /begin FUNCTION_LIST OZNIVDL /end FUNCTION_LIST /end MEASUREMENT
/begin MEASUREMENT Oz_todeltime "Zähler Ausheizzeit (nichtflüchtig)" UWORD Def_td_uw_q1 0 0 0.0 65535.0000 ECU_ADDRESS 0x7FDE56 /begin FUNCTION_LIST OZPERM /end FUNCTION_LIST /end MEASUREMENT
/begin MEASUREMENT Oz_tog_i "" UBYTE Def_dez_ub_q1 0 0 0.0 255.0000 ECU_ADDRESS 0x7FDE02 /begin FUNCTION_LIST OZNIVDL /end FUNCTION_LIST /end MEASUREMENT
/begin MEASUREMENT Oz_togbwi "" UBYTE Def_dez_ub_q1 0 0 0.0 255.0000 ECU_ADDRESS 0x7FDE03 /begin FUNCTION_LIST OZNIVDL /end FUNCTION_LIST /end MEASUREMENT
/begin MEASUREMENT Oz_togki "" UBYTE Def_dez_ub_q1 0 0 0.0 255.0000 ECU_ADDRESS 0x7FDE04 /begin FUNCTION_LIST OZNIVDL /end FUNCTION_LIST /end MEASUREMENT
/begin MEASUREMENT Oz_verbkmalt "Km-Stand letzter Ölverbrauch-Berechnung" UWORD Def_km_uw_q10 0 0 0.0 655350.0000 ECU_ADDRESS 0x7FDDE2 /begin FUNCTION_LIST OZNIVDL /end FUNCTION_LIST /end MEASUREMENT
/begin MEASUREMENT Oz_verbnivalt "Ölniveau letzter Ölverbrauch-Berechnung" UBYTE Def_niv_ub_b75 0 0 0.0 74.7070 ECU_ADDRESS 0x7FDDE5 /begin FUNCTION_LIST OZNIVDL /end FUNCTION_LIST /end MEASUREMENT
/begin MEASUREMENT Oz_vfbdmew "Verfügbarkeit aus Kombi bei DME-Wechsel" SBYTE Def_dez_sb_q1 0 0 -128.0000 127.0000 ECU_ADDRESS 0x7FDD8C /begin FUNCTION_LIST OZGG /end FUNCTION_LIST /end MEASUREMENT
/begin MEASUREMENT Oz_vormw "vorgezogener Mittelwert Niveau" UBYTE Def_niv_ub_b75 0 0 0.0 74.7070 ECU_ADDRESS 0x7FDE0D /begin FUNCTION_LIST OZNIVDL /end FUNCTION_LIST /end MEASUREMENT
/begin MEASUREMENT Oz_vormwcnt "" UBYTE Def_dez_ub_q1 0 0 0.0 255.0000 ECU_ADDRESS 0x7FDE05 /begin FUNCTION_LIST OZNIVDL /end FUNCTION_LIST /end MEASUREMENT
/begin MEASUREMENT Oz_zjbdmew "" UBYTE Def_dez_ub_q1 0 0 0.0 255.0000 ECU_ADDRESS 0x7FDDD2 /begin FUNCTION_LIST OZGG /end FUNCTION_LIST /end MEASUREMENT
/begin MEASUREMENT Oz_zmbdmew "" UBYTE Def_dez_ub_q1 0 0 0.0 255.0000 ECU_ADDRESS 0x7FDDD3 /begin FUNCTION_LIST OZGG /end FUNCTION_LIST /end MEASUREMENT
/begin MEASUREMENT P_gle "Glühleistung" UWORD Def_p_uw_q0p039 0 0 0.0 2559.9609 ECU_ADDRESS 0x7FBEA0 /begin FUNCTION_LIST LAYER /end FUNCTION_LIST /end MEASUREMENT
/begin MEASUREMENT Pld "Ladedruck" SWORD Def_p_sw_q1 0 0 -32768.0000 32767.0000 ECU_ADDRESS 0x7FBF40 /begin FUNCTION_LIST LAYER /end FUNCTION_LIST /end MEASUREMENT
/begin MEASUREMENT Pld_n "Ladedruck normiert" UBYTE Def_f_ub_b2 0 0 0.0 1.9921 ECU_ADDRESS 0x7FDD62 /begin FUNCTION_LIST MANDETEK /end FUNCTION_LIST /end MEASUREMENT
/begin MEASUREMENT Pmsv "Angemeldete Powermanagment Standverbraucher" UBYTE Def_dez_ub_q1 0 0 0.0 255.0000 ECU_ADDRESS 0x7FD830 ARRAY_SIZE 15 /begin FUNCTION_LIST LAYER /end FUNCTION_LIST /end MEASUREMENT
/begin MEASUREMENT Pu "Umgebungsdruck" UWORD Def_p_uw_q0p039 0 0 0.0 2559.9609 ECU_ADDRESS 0x7FBE82 /begin FUNCTION_LIST LAYER /end FUNCTION_LIST /end MEASUREMENT
/begin MEASUREMENT Pwg_ist "Pedalwert Fahrerwunsch in %" SWORD Def_wdk_sw_q0p0244 0 0 -800.0000 799.9755 ECU_ADDRESS 0x7FBE84 /begin FUNCTION_LIST LAYER /end FUNCTION_LIST /end MEASUREMENT
/begin MEASUREMENT Qelad "Delta Batterieentladung" UWORD Def_ql_uw_q0p0182 0 0 0.0 1192.7502 ECU_ADDRESS 0x7FD7A4 /begin FUNCTION_LIST KT_IBS /end FUNCTION_LIST /end MEASUREMENT
/begin MEASUREMENT Qeladsoc0 "Entladung bei Ruhespannungsmessung" UWORD Def_ql_uw_q0p0182 0 0 0.0 1192.7502 ECU_ADDRESS 0x7FD7B2 /begin FUNCTION_LIST KT_IBS /end FUNCTION_LIST /end MEASUREMENT
/begin MEASUREMENT Qlad "Delta Batterieladung" UWORD Def_ql_uw_q0p0182 0 0 0.0 1192.7502 ECU_ADDRESS 0x7FD7A2 /begin FUNCTION_LIST KT_IBS /end FUNCTION_LIST /end MEASUREMENT
/begin MEASUREMENT Qladsoc0 "Ladung bei Ruhespannungsmessung" UWORD Def_ql_uw_q0p0182 0 0 0.0 1192.7502 ECU_ADDRESS 0x7FD7B0 /begin FUNCTION_LIST KT_IBS /end FUNCTION_LIST /end MEASUREMENT
/begin MEASUREMENT R5cyctim "Timer f. zyklisches Senden IBS Reg. 5" UBYTE Def_dez_ub_q1 0 0 0.0 255.0000 ECU_ADDRESS 0x7FD80A /begin FUNCTION_LIST KT_IBS /end FUNCTION_LIST /end MEASUREMENT
/begin MEASUREMENT Rf "Relative Luftfuellung" SWORD Def_rf_sw_q0p01 0 0 -327.6800 327.6700 ECU_ADDRESS 0x7FBEE8 /begin FUNCTION_LIST LAYER /end FUNCTION_LIST /end MEASUREMENT
/begin MEASUREMENT Sigmanla "Ringpuffer La_ist1" UWORD Def_f_uw_b16 0 0 0.0 15.9997 ECU_ADDRESS 0x7FD9B0 ARRAY_SIZE 20 /begin FUNCTION_LIST MANDETEK /end FUNCTION_LIST /end MEASUREMENT
/begin MEASUREMENT Sigmanme "Ringpuffer Einspritzmasse aktuell" SWORD Def_me_sw_q0p01 0 0 -327.6800 327.6700 ECU_ADDRESS 0x7FD8B2 ARRAY_SIZE 20 /begin FUNCTION_LIST MANDETEK /end FUNCTION_LIST /end MEASUREMENT
/begin MEASUREMENT Sigmanmlh "Ringpuffer Luftmasse pro Zylinder (Hydraulikpfad)" SWORD Def_ml_sw_q0p1 0 0 -3276.8000 3276.7000 ECU_ADDRESS 0x7FD8DA ARRAY_SIZE 20 /begin FUNCTION_LIST MANDETEK /end FUNCTION_LIST /end MEASUREMENT
/begin MEASUREMENT Sigmanmll "Ringpuffer Luftmasse pro Zylinder (Luftpfad)" SWORD Def_ml_sw_q0p1 0 0 -3276.8000 3276.7000 ECU_ADDRESS 0x7FD902 ARRAY_SIZE 20 /begin FUNCTION_LIST MANDETEK /end FUNCTION_LIST /end MEASUREMENT
/begin MEASUREMENT Sigmanpld "Ringpuffer Ladedruck" SWORD Def_p_sw_q1 0 0 -32768.0000 32767.0000 ECU_ADDRESS 0x7FD92A ARRAY_SIZE 20 /begin FUNCTION_LIST MANDETEK /end FUNCTION_LIST /end MEASUREMENT
/begin MEASUREMENT Sigmantvagr "Ringpuffer Tastverhältnis AGR-Steller" SWORD Def_tv_sw_q0p01 0 0 -327.6800 327.6700 ECU_ADDRESS 0x7FD952 ARRAY_SIZE 20 /begin FUNCTION_LIST MANDETEK /end FUNCTION_LIST /end MEASUREMENT
/begin MEASUREMENT Sigmantvpld "Ringpuffer Tastverhältnis Ladedrucksteller" SWORD Def_tv_sw_q0p01 0 0 -327.6800 327.6700 ECU_ADDRESS 0x7FD97A ARRAY_SIZE 20 /begin FUNCTION_LIST MANDETEK /end FUNCTION_LIST /end MEASUREMENT
/begin MEASUREMENT Snibs "Seriennummer" ULONG Def_dez_ul_q1 0 0 0.0 2147483647.0000 ECU_ADDRESS 0x7FD7E0 /begin FUNCTION_LIST KT_IBS /end FUNCTION_LIST /end MEASUREMENT
/begin MEASUREMENT St_ckl15 "Klemmensignale vom CAN" UBYTE Def_dez_ub_q1 0 0 0.0 255.0000 ECU_ADDRESS 0x7FBEEA /begin FUNCTION_LIST LAYER /end FUNCTION_LIST /end MEASUREMENT
/begin MEASUREMENT St_ckl15.B_ckl30 "Bedingung Klemme R (über CAN)" UBYTE Def_bit_ub_1 0 0 0.0 255.0 ECU_ADDRESS 0x7FBEEA /begin FUNCTION_LIST LAYER /end FUNCTION_LIST BIT_MASK 0x2 /end MEASUREMENT
/begin MEASUREMENT St_ckl15.B_ckl50 "Bedingung Klemme 50 (vom CAN)" UBYTE Def_bit_ub_0 0 0 0.0 255.0 ECU_ADDRESS 0x7FBEEA /begin FUNCTION_LIST LAYER /end FUNCTION_LIST BIT_MASK 0x1 /end MEASUREMENT
/begin MEASUREMENT St_egs "Statusbyte Automatikgetriebe" UBYTE Def_st_ub_q1 0 0 0.0 255.0000 ECU_ADDRESS 0x7FBEEB /begin FUNCTION_LIST LAYER /end FUNCTION_LIST /end MEASUREMENT
/begin MEASUREMENT St_egs.B_fs "Bedingung Fahrstufe" UBYTE Def_bit_ub_0 0 0 0.0 255.0 ECU_ADDRESS 0x7FBEEB /begin FUNCTION_LIST LAYER /end FUNCTION_LIST BIT_MASK 0x1 /end MEASUREMENT
/begin MEASUREMENT St_elu "Status elu" UBYTE Def_st_ub_q1 0 0 0.0 255.0000 ECU_ADDRESS 0x7FD851 /begin FUNCTION_LIST LAYER /end FUNCTION_LIST /end MEASUREMENT
/begin MEASUREMENT St_elu.B_elu600 "Bedingung Elüftertyp" UBYTE Def_bit_ub_0 0 0 0.0 255.0 ECU_ADDRESS 0x7FD851 /begin FUNCTION_LIST LAYER /end FUNCTION_LIST BIT_MASK 0x1 /end MEASUREMENT
/begin MEASUREMENT St_genallg "Allgemeine Eingangsbits" UBYTE Def_st_ub_q1 0 0 0.0 255.0000 ECU_ADDRESS 0x7FBEEC /begin FUNCTION_LIST LAYER /end FUNCTION_LIST /end MEASUREMENT
/begin MEASUREMENT St_genallg.B_abliactiv "Bedingung Abblendlicht aktiv" UBYTE Def_bit_ub_1 0 0 0.0 255.0 ECU_ADDRESS 0x7FBEEC /begin FUNCTION_LIST LAYER /end FUNCTION_LIST BIT_MASK 0x2 /end MEASUREMENT
/begin MEASUREMENT St_genallg.B_bsdprot1 "Bedingung BSD Protokollinhalt für BSD1 Regler" UBYTE Def_bit_ub_3 0 0 0.0 255.0 ECU_ADDRESS 0x7FBEEC /begin FUNCTION_LIST LAYER /end FUNCTION_LIST BIT_MASK 0x8 /end MEASUREMENT
/begin MEASUREMENT St_genallg.B_bsdprot2 "Bedingung BSD Protokollinhalt für BSD 2 Regler" UBYTE Def_bit_ub_4 0 0 0.0 255.0 ECU_ADDRESS 0x7FBEEC /begin FUNCTION_LIST LAYER /end FUNCTION_LIST BIT_MASK 0x10 /end MEASUREMENT
/begin MEASUREMENT St_genallg.B_gen2inst "2. Generator installiert" UBYTE Def_bit_ub_2 0 0 0.0 255.0 ECU_ADDRESS 0x7FBEEC /begin FUNCTION_LIST LAYER /end FUNCTION_LIST BIT_MASK 0x4 /end MEASUREMENT
/begin MEASUREMENT St_genallg.B_iliactiv "Bedingung Innenlicht aktiv" UBYTE Def_bit_ub_0 0 0 0.0 255.0 ECU_ADDRESS 0x7FBEEC /begin FUNCTION_LIST LAYER /end FUNCTION_LIST BIT_MASK 0x1 /end MEASUREMENT
/begin MEASUREMENT St_genallg.B_rd_gentyp "Bedingung Schalter APK zum Auslesen Hersteller und Generatortyp" UBYTE Def_bit_ub_5 0 0 0.0 255.0 ECU_ADDRESS 0x7FBEEC /begin FUNCTION_LIST LAYER /end FUNCTION_LIST BIT_MASK 0x20 /end MEASUREMENT
/begin MEASUREMENT St_generator "Statusbyte Generator" UBYTE Def_st_ub_q1 0 0 0.0 255.0000 ECU_ADDRESS 0x7FBEED /begin FUNCTION_LIST LAYER /end FUNCTION_LIST /end MEASUREMENT
/begin MEASUREMENT St_generator.B_crashgen "Bedingung Generator abschalten bei Crash" UBYTE Def_bit_ub_6 0 0 0.0 255.0 ECU_ADDRESS 0x7FBEED /begin FUNCTION_LIST LAYER /end FUNCTION_LIST BIT_MASK 0x40 /end MEASUREMENT
/begin MEASUREMENT St_generator.B_genactiv "Bedingung Generatorinterface aktiv" UBYTE Def_bit_ub_0 0 0 0.0 255.0 ECU_ADDRESS 0x7FBEED /begin FUNCTION_LIST LAYER /end FUNCTION_LIST BIT_MASK 0x1 /end MEASUREMENT
/begin MEASUREMENT St_generator.B_genfbsd "Bedingung Kommunikationsverlust BSD Generator" UBYTE Def_bit_ub_2 0 0 0.0 255.0 ECU_ADDRESS 0x7FBEED /begin FUNCTION_LIST LAYER /end FUNCTION_LIST BIT_MASK 0x4 /end MEASUREMENT
/begin MEASUREMENT St_generator.B_genfel "Bedingung Generatorfehler elektrisch" UBYTE Def_bit_ub_3 0 0 0.0 255.0 ECU_ADDRESS 0x7FBEED /begin FUNCTION_LIST LAYER /end FUNCTION_LIST BIT_MASK 0x8 /end MEASUREMENT
/begin MEASUREMENT St_generator.B_genfht "Bedingung Generatorzustand hohe Temparatur" UBYTE Def_bit_ub_4 0 0 0.0 255.0 ECU_ADDRESS 0x7FBEED /begin FUNCTION_LIST LAYER /end FUNCTION_LIST BIT_MASK 0x10 /end MEASUREMENT
/begin MEASUREMENT St_generator.B_genfme "Bedingung Generatorfehler mechanisch" UBYTE Def_bit_ub_5 0 0 0.0 255.0 ECU_ADDRESS 0x7FBEED /begin FUNCTION_LIST LAYER /end FUNCTION_LIST BIT_MASK 0x20 /end MEASUREMENT
/begin MEASUREMENT St_generator2 "Statuswort für 2. Generator" UBYTE Def_st_ub_q1 0 0 0.0 255.0000 ECU_ADDRESS 0x7FBEEE /begin FUNCTION_LIST LAYER /end FUNCTION_LIST /end MEASUREMENT
/begin MEASUREMENT St_generator2.B_genactiv2 "Bedingung Generatorinterface Gen 2 activ" UBYTE Def_bit_ub_0 0 0 0.0 255.0 ECU_ADDRESS 0x7FBEEE /begin FUNCTION_LIST LAYER /end FUNCTION_LIST BIT_MASK 0x1 /end MEASUREMENT
/begin MEASUREMENT St_generator2.B_genfbsd2 "Kommunikationsverlust BSD Generator 2" UBYTE Def_bit_ub_2 0 0 0.0 255.0 ECU_ADDRESS 0x7FBEEE /begin FUNCTION_LIST LAYER /end FUNCTION_LIST BIT_MASK 0x4 /end MEASUREMENT
/begin MEASUREMENT St_generator2.B_genfel2 "Generatorfehler elektrisch Generator 2" UBYTE Def_bit_ub_3 0 0 0.0 255.0 ECU_ADDRESS 0x7FBEEE /begin FUNCTION_LIST LAYER /end FUNCTION_LIST BIT_MASK 0x8 /end MEASUREMENT
/begin MEASUREMENT St_generator2.B_genfht2 "Generatorfehler Übertemperatur Gen 2" UBYTE Def_bit_ub_4 0 0 0.0 255.0 ECU_ADDRESS 0x7FBEEE /begin FUNCTION_LIST LAYER /end FUNCTION_LIST BIT_MASK 0x10 /end MEASUREMENT
/begin MEASUREMENT St_generator2.B_genfme2 "Generatorfehler Mechanisch Generator 2" UBYTE Def_bit_ub_5 0 0 0.0 255.0 ECU_ADDRESS 0x7FBEEE /begin FUNCTION_LIST LAYER /end FUNCTION_LIST BIT_MASK 0x20 /end MEASUREMENT
/begin MEASUREMENT St_genll "LR Eingänge" UBYTE Def_st_ub_q1 0 0 0.0 255.0000 ECU_ADDRESS 0x7FBEEF /begin FUNCTION_LIST LAYER /end FUNCTION_LIST /end MEASUREMENT
/begin MEASUREMENT St_genll.B_lrfoff "Kopie Drehzahlschwelle für LR-Funktion Generator 1 aktiv" UBYTE Def_bit_ub_0 0 0 0.0 255.0 ECU_ADDRESS 0x7FBEEF /begin FUNCTION_LIST LAYER /end FUNCTION_LIST BIT_MASK 0x1 /end MEASUREMENT
/begin MEASUREMENT St_genll.B_lrfoff2 "Kopie Drehzahlschwelle für LR-Funktion Generator 2 aktiv" UBYTE Def_bit_ub_1 0 0 0.0 255.0 ECU_ADDRESS 0x7FBEEF /begin FUNCTION_LIST LAYER /end FUNCTION_LIST BIT_MASK 0x2 /end MEASUREMENT
/begin MEASUREMENT St_genll.B_lrreg1ak "LR-Register 1 aktiv Generator 1" UBYTE Def_bit_ub_2 0 0 0.0 255.0 ECU_ADDRESS 0x7FBEEF /begin FUNCTION_LIST LAYER /end FUNCTION_LIST BIT_MASK 0x4 /end MEASUREMENT
/begin MEASUREMENT St_genll.B_lrreg1ak2 "LR-Register 1 aktiv Generator 2" UBYTE Def_bit_ub_3 0 0 0.0 255.0 ECU_ADDRESS 0x7FBEEF /begin FUNCTION_LIST LAYER /end FUNCTION_LIST BIT_MASK 0x8 /end MEASUREMENT
/begin MEASUREMENT St_ibebsd1 "Statuswort ibebsd1" UBYTE Def_st_ub_q1 0 0 0.0 255.0000 ECU_ADDRESS 0x7FD7F2 /begin FUNCTION_LIST KT_IBS /end FUNCTION_LIST /end MEASUREMENT
/begin MEASUREMENT St_ibebsd1.B_eb_busy "Bedingung EBSD Übertragungsrichtung schreiben" UBYTE Def_bit_ub_3 0 0 0.0 255.0 ECU_ADDRESS 0x7FD7F2 /begin FUNCTION_LIST KT_IBS /end FUNCTION_LIST BIT_MASK 0x8 /end MEASUREMENT
/begin MEASUREMENT St_ibebsd1.B_eb_txok "Bedingung EBSD Übertragungsrichtung schreiben" UBYTE Def_bit_ub_2 0 0 0.0 255.0 ECU_ADDRESS 0x7FD7F2 /begin FUNCTION_LIST KT_IBS /end FUNCTION_LIST BIT_MASK 0x4 /end MEASUREMENT
/begin MEASUREMENT St_ibebsd1.B_ibs_msgrdy "Bedingung EBSD Botschaft von IBS empfangen" UBYTE Def_bit_ub_0 0 0 0.0 255.0 ECU_ADDRESS 0x7FD7F2 /begin FUNCTION_LIST KT_IBS /end FUNCTION_LIST BIT_MASK 0x1 /end MEASUREMENT
/begin MEASUREMENT St_ibebsd1.B_ibs_msgwri "Bedingung EBSD Übertragungsrichtung schreiben" UBYTE Def_bit_ub_1 0 0 0.0 255.0 ECU_ADDRESS 0x7FD7F2 /begin FUNCTION_LIST KT_IBS /end FUNCTION_LIST BIT_MASK 0x2 /end MEASUREMENT
/begin MEASUREMENT St_ibmix "Statuswort ibmix" UBYTE Def_st_ub_q1 0 0 0.0 255.0000 ECU_ADDRESS 0x7FD7F4 /begin FUNCTION_LIST KT_IBS /end FUNCTION_LIST /end MEASUREMENT
/begin MEASUREMENT St_ibmix.B_ibrhilo "toggle Bit Register0/ 1 hi- od. lo byte" UBYTE Def_bit_ub_0 0 0 0.0 255.0 ECU_ADDRESS 0x7FD7F4 /begin FUNCTION_LIST KT_IBS /end FUNCTION_LIST BIT_MASK 0x1 /end MEASUREMENT
/begin MEASUREMENT St_ibmix.B_ibttog "global toggle bit" UBYTE Def_bit_ub_1 0 0 0.0 255.0 ECU_ADDRESS 0x7FD7F4 /begin FUNCTION_LIST KT_IBS /end FUNCTION_LIST BIT_MASK 0x2 /end MEASUREMENT
/begin MEASUREMENT St_ibs "Status ibs" UBYTE Def_st_ub_q1 0 0 0.0 255.0000 ECU_ADDRESS 0x7FD852 /begin FUNCTION_LIST LAYER /end FUNCTION_LIST /end MEASUREMENT
/begin MEASUREMENT St_ibs.B_ibsdetec "Bedingung IBS erkannt" UBYTE Def_bit_ub_0 0 0 0.0 255.0 ECU_ADDRESS 0x7FD852 /begin FUNCTION_LIST LAYER /end FUNCTION_LIST BIT_MASK 0x1 /end MEASUREMENT
/begin MEASUREMENT St_ibserr "Statuswort ibserr" UBYTE Def_st_ub_q1 0 0 0.0 255.0000 ECU_ADDRESS 0x7FD7F3 /begin FUNCTION_LIST KT_IBS /end FUNCTION_LIST /end MEASUREMENT
/begin MEASUREMENT St_ibserr.B_ibfbsd "Bedingung BSD Fehler" UBYTE Def_bit_ub_0 0 0 0.0 255.0 ECU_ADDRESS 0x7FD7F3 /begin FUNCTION_LIST KT_IBS /end FUNCTION_LIST BIT_MASK 0x1 /end MEASUREMENT
/begin MEASUREMENT St_ibserr.B_ibfebsd "Bedingung EBSD Fehler" UBYTE Def_bit_ub_1 0 0 0.0 255.0 ECU_ADDRESS 0x7FD7F3 /begin FUNCTION_LIST KT_IBS /end FUNCTION_LIST BIT_MASK 0x2 /end MEASUREMENT
/begin MEASUREMENT St_ibserr.B_ibunplau "Bedingung IBS Version unplausibel" UBYTE Def_bit_ub_2 0 0 0.0 255.0 ECU_ADDRESS 0x7FD7F3 /begin FUNCTION_LIST KT_IBS /end FUNCTION_LIST BIT_MASK 0x4 /end MEASUREMENT
/begin MEASUREMENT St_ibsreg4 "Statuswort ibsreg4" UBYTE Def_st_ub_q1 0 0 0.0 255.0000 ECU_ADDRESS 0x7FD7E9 /begin FUNCTION_LIST KT_IBS /end FUNCTION_LIST /end MEASUREMENT
/begin MEASUREMENT St_ibsreg4.B_ibspwf "Bedingung IBS powerfail erkannt" UBYTE Def_bit_ub_4 0 0 0.0 255.0 ECU_ADDRESS 0x7FD7E9 /begin FUNCTION_LIST KT_IBS /end FUNCTION_LIST BIT_MASK 0x10 /end MEASUREMENT
/begin MEASUREMENT St_ibsreg4.B_startfgk "Bedingung Startfähigkeit gefährdet" UBYTE Def_bit_ub_0 0 0 0.0 255.0 ECU_ADDRESS 0x7FD7E9 /begin FUNCTION_LIST KT_IBS /end FUNCTION_LIST BIT_MASK 0x1 /end MEASUREMENT
/begin MEASUREMENT St_ibsreg4.B_strtaw "Bedingung Startauswertung gerechnet" UBYTE Def_bit_ub_1 0 0 0.0 255.0 ECU_ADDRESS 0x7FD7E9 /begin FUNCTION_LIST KT_IBS /end FUNCTION_LIST BIT_MASK 0x2 /end MEASUREMENT
/begin MEASUREMENT St_ibsreg4.B_tiefset "Bedingung Tiefentladung" UBYTE Def_bit_ub_5 0 0 0.0 255.0 ECU_ADDRESS 0x7FD7E9 /begin FUNCTION_LIST KT_IBS /end FUNCTION_LIST BIT_MASK 0x20 /end MEASUREMENT
/begin MEASUREMENT St_ibsreg5 "Statuswort ibsreg5" UBYTE Def_st_ub_q1 0 0 0.0 255.0000 ECU_ADDRESS 0x7FD7EA /begin FUNCTION_LIST KT_IBS /end FUNCTION_LIST /end MEASUREMENT
/begin MEASUREMENT St_ibsreg5.B_fsclr "Bedingung IBS interne Fehler loeschen" UBYTE Def_bit_ub_3 0 0 0.0 255.0 ECU_ADDRESS 0x7FD7EA /begin FUNCTION_LIST KT_IBS /end FUNCTION_LIST BIT_MASK 0x8 /end MEASUREMENT
/begin MEASUREMENT St_imdgen_1s "Statuswort" UBYTE Def_st_ub_q1 0 0 0.0 255.0000 ECU_ADDRESS 0x7FBE6C /begin FUNCTION_LIST LAYER /end FUNCTION_LIST /end MEASUREMENT
/begin MEASUREMENT St_imdgen_1s.B_genhtkrit "Diodentemparatur im kritischen Bereich" UBYTE Def_bit_ub_1 0 0 0.0 255.0 ECU_ADDRESS 0x7FBE6C /begin FUNCTION_LIST LAYER /end FUNCTION_LIST BIT_MASK 0x2 /end MEASUREMENT
/begin MEASUREMENT St_imdgen_1s.B_tdiodekrit "Generatormoment enable/disable" UBYTE Def_bit_ub_3 0 0 0.0 255.0 ECU_ADDRESS 0x7FBE6C /begin FUNCTION_LIST LAYER /end FUNCTION_LIST BIT_MASK 0x8 /end MEASUREMENT
/begin MEASUREMENT St_instr3_1 "Status Can Botschaft Instr3 (CAN11)" UBYTE Def_st_ub_q1 0 0 0.0 255.0000 ECU_ADDRESS 0x7FBEF0 /begin FUNCTION_LIST LAYER /end FUNCTION_LIST /end MEASUREMENT
/begin MEASUREMENT St_instr3_1.S_tns "Bedingung aus Schalter Tag-/Nachtbeleuchtung" UBYTE Def_bit_ub_6 0 0 0.0 255.0 ECU_ADDRESS 0x7FBEF0 /begin FUNCTION_LIST LAYER /end FUNCTION_LIST BIT_MASK 0x40 /end MEASUREMENT
/begin MEASUREMENT St_kl15 "Statusbyte Klemme 15" UBYTE Def_st_ub_q1 0 0 0.0 255.0000 ECU_ADDRESS 0x7FBEF1 /begin FUNCTION_LIST LAYER /end FUNCTION_LIST /end MEASUREMENT
/begin MEASUREMENT St_kl15.B_kl15_ep "Bitgröße, Bedingung KL15 gesetzt" UBYTE Def_bit_ub_0 0 0 0.0 255.0 ECU_ADDRESS 0x7FBEF1 /begin FUNCTION_LIST LAYER /end FUNCTION_LIST BIT_MASK 0x1 /end MEASUREMENT
/begin MEASUREMENT St_lbattcal0 "Statuswort" UBYTE Def_st_ub_q1 0 0 0.0 255.0000 ECU_ADDRESS 0x7FD87C /begin FUNCTION_LIST LBATTCAL /end FUNCTION_LIST /end MEASUREMENT
/begin MEASUREMENT St_lbattcal0.B_dly_tbi "" UBYTE Def_bit_ub_5 0 0 0.0 255.0 ECU_ADDRESS 0x7FD87C /begin FUNCTION_LIST LBATTCAL /end FUNCTION_LIST BIT_MASK 0x20 /end MEASUREMENT
/begin MEASUREMENT St_lbattcal0.B_lbatteinih "Ende Initialisierungsphase Lbattcal Batterie hinten" UBYTE Def_bit_ub_0 0 0 0.0 255.0 ECU_ADDRESS 0x7FD87C /begin FUNCTION_LIST LBATTCAL /end FUNCTION_LIST BIT_MASK 0x1 /end MEASUREMENT
/begin MEASUREMENT St_lbattcal0.B_lbatteiniv "Ende Initialisierungsphase Lbattcal Batterie vorne" UBYTE Def_bit_ub_1 0 0 0.0 255.0 ECU_ADDRESS 0x7FD87C /begin FUNCTION_LIST LBATTCAL /end FUNCTION_LIST BIT_MASK 0x2 /end MEASUREMENT
/begin MEASUREMENT St_lbattcal0.B_lbattenh "Enable Batterie hinten" UBYTE Def_bit_ub_2 0 0 0.0 255.0 ECU_ADDRESS 0x7FD87C /begin FUNCTION_LIST LBATTCAL /end FUNCTION_LIST BIT_MASK 0x4 /end MEASUREMENT
/begin MEASUREMENT St_lbattcal0.B_lbattenv "Enable Batterie vorne" UBYTE Def_bit_ub_3 0 0 0.0 255.0 ECU_ADDRESS 0x7FD87C /begin FUNCTION_LIST LBATTCAL /end FUNCTION_LIST BIT_MASK 0x8 /end MEASUREMENT
/begin MEASUREMENT St_lbattcal0.B_lbattinit "Initialisierung LBATTCAL beendet" UBYTE Def_bit_ub_4 0 0 0.0 255.0 ECU_ADDRESS 0x7FD87C /begin FUNCTION_LIST LBATTCAL /end FUNCTION_LIST BIT_MASK 0x10 /end MEASUREMENT
/begin MEASUREMENT St_ldstgen "Lastzustand Generator elektrisch/thermisch" UBYTE Def_st_ub_q1 0 0 0.0 255.0000 ECU_ADDRESS 0x7FD890 /begin FUNCTION_LIST LDSTGEN /end FUNCTION_LIST /end MEASUREMENT
/begin MEASUREMENT St_llr "Statusword Leerlaufregler" UWORD Def_st_uw_q1 0 0 0.0 65535.0000 ECU_ADDRESS 0x7FBEF2 /begin FUNCTION_LIST LAYER /end FUNCTION_LIST /end MEASUREMENT
/begin MEASUREMENT St_llr.B_llrein "wird beim ersten LL-Regler ein gesetzt und nicht mehr geändert" UWORD Def_bit_uw_0 0 0 0.0 65535.0 ECU_ADDRESS 0x7FBEF2 /begin FUNCTION_LIST LAYER /end FUNCTION_LIST BIT_MASK 0x1 /end MEASUREMENT
/begin MEASUREMENT St_llranh0 "Statuswort" UBYTE Def_st_ub_q1 0 0 0.0 255.0000 ECU_ADDRESS 0x7FD894 /begin FUNCTION_LIST LLRANH /end FUNCTION_LIST /end MEASUREMENT
/begin MEASUREMENT St_llranh0.B_idl_tp "Temporäres Berechnungsbit" UBYTE Def_bit_ub_2 0 0 0.0 255.0 ECU_ADDRESS 0x7FD894 /begin FUNCTION_LIST LLRANH /end FUNCTION_LIST BIT_MASK 0x4 /end MEASUREMENT
/begin MEASUREMENT St_llranh0.B_idlgspec "" UBYTE Def_bit_ub_0 0 0 0.0 255.0 ECU_ADDRESS 0x7FD894 /begin FUNCTION_LIST LLRANH /end FUNCTION_LIST BIT_MASK 0x1 /end MEASUREMENT
/begin MEASUREMENT St_llranh0.B_nsub "Bedingung für Solldrehzahlanhebung bei niedriger Batteriespannung" UBYTE Def_bit_ub_1 0 0 0.0 255.0 ECU_ADDRESS 0x7FD894 /begin FUNCTION_LIST LLRANH /end FUNCTION_LIST BIT_MASK 0x2 /end MEASUREMENT
/begin MEASUREMENT St_loadresp0 "Statuswort" UBYTE Def_st_ub_q1 0 0 0.0 255.0000 ECU_ADDRESS 0x7FD898 /begin FUNCTION_LIST LOADRESP /end FUNCTION_LIST /end MEASUREMENT
/begin MEASUREMENT St_loadresp0.B_fub "" UBYTE Def_bit_ub_2 0 0 0.0 255.0 ECU_ADDRESS 0x7FD898 /begin FUNCTION_LIST LOADRESP /end FUNCTION_LIST BIT_MASK 0x4 /end MEASUREMENT
/begin MEASUREMENT St_loadresp0.B_genoffmd "Bedingung Generatorabschaltung im Start" UBYTE Def_bit_ub_1 0 0 0.0 255.0 ECU_ADDRESS 0x7FD898 /begin FUNCTION_LIST LOADRESP /end FUNCTION_LIST BIT_MASK 0x2 /end MEASUREMENT
/begin MEASUREMENT St_loadresp0.B_genoffst "" UBYTE Def_bit_ub_0 0 0 0.0 255.0 ECU_ADDRESS 0x7FD898 /begin FUNCTION_LIST LOADRESP /end FUNCTION_LIST BIT_MASK 0x1 /end MEASUREMENT
/begin MEASUREMENT St_loadresp10ms "Statuswort" UBYTE Def_st_ub_q1 0 0 0.0 255.0000 ECU_ADDRESS 0x7FD899 /begin FUNCTION_LIST LOADRESP /end FUNCTION_LIST /end MEASUREMENT
/begin MEASUREMENT St_loadresp10ms.B_mdgrenz "Bedingung Generator im Modus Momentenbegrenzung" UBYTE Def_bit_ub_0 0 0 0.0 255.0 ECU_ADDRESS 0x7FD899 /begin FUNCTION_LIST LOADRESP /end FUNCTION_LIST BIT_MASK 0x1 /end MEASUREMENT
/begin MEASUREMENT St_loadresp_nv0 "Statuswort" UBYTE Def_st_ub_q1 0 0 0.0 255.0000 ECU_ADDRESS 0x7FD895 /begin FUNCTION_LIST LOADRESP /end FUNCTION_LIST /end MEASUREMENT
/begin MEASUREMENT St_loadresp_nv0.B_genoffvl "Bedingung Generatorabschaltung bei Vollast" UBYTE Def_bit_ub_0 0 0 0.0 255.0 ECU_ADDRESS 0x7FD895 /begin FUNCTION_LIST LOADRESP /end FUNCTION_LIST BIT_MASK 0x1 /end MEASUREMENT
/begin MEASUREMENT St_mandetek "Statuswort" UWORD Def_st_uw_q1 0 0 0.0 65535.0000 ECU_ADDRESS 0x7FD9D8 /begin FUNCTION_LIST MANDETEK /end FUNCTION_LIST /end MEASUREMENT
/begin MEASUREMENT St_mandetek.B_lsuakt "Bedingung für Hydraulikpfadaktivierung temp 4" UWORD Def_bit_uw_8 0 0 0.0 65535.0 ECU_ADDRESS 0x7FD9D8 /begin FUNCTION_LIST MANDETEK /end FUNCTION_LIST BIT_MASK 0x100 /end MEASUREMENT
/begin MEASUREMENT St_mandetek.B_mandetek1 "Bedingung für Hydraulikpfadaktivierung temp 1" UWORD Def_bit_uw_3 0 0 0.0 65535.0 ECU_ADDRESS 0x7FD9D8 /begin FUNCTION_LIST MANDETEK /end FUNCTION_LIST BIT_MASK 0x8 /end MEASUREMENT
/begin MEASUREMENT St_mandetek.B_mandetek2 "Bedingung Freigabe Manipulationserkennung " UWORD Def_bit_uw_4 0 0 0.0 65535.0 ECU_ADDRESS 0x7FD9D8 /begin FUNCTION_LIST MANDETEK /end FUNCTION_LIST BIT_MASK 0x10 /end MEASUREMENT
/begin MEASUREMENT St_mandetek.B_mandetek3 "Bedingung Lambdasonde aktiv" UWORD Def_bit_uw_5 0 0 0.0 65535.0 ECU_ADDRESS 0x7FD9D8 /begin FUNCTION_LIST MANDETEK /end FUNCTION_LIST BIT_MASK 0x20 /end MEASUREMENT
/begin MEASUREMENT St_mandetek.B_mandetek4 "Bedingung Manipulationserkenung Luftpfad aktiv" UWORD Def_bit_uw_6 0 0 0.0 65535.0 ECU_ADDRESS 0x7FD9D8 /begin FUNCTION_LIST MANDETEK /end FUNCTION_LIST BIT_MASK 0x40 /end MEASUREMENT
/begin MEASUREMENT St_mandetek.B_mandetek5 "Bedingung für Hydraulikpfadaktivierung temp. 2" UWORD Def_bit_uw_7 0 0 0.0 65535.0 ECU_ADDRESS 0x7FD9D8 /begin FUNCTION_LIST MANDETEK /end FUNCTION_LIST BIT_MASK 0x80 /end MEASUREMENT
/begin MEASUREMENT St_mandetek.B_mandetekh "Bedingung für Hydraulikpfadaktivierung temp 5" UWORD Def_bit_uw_1 0 0 0.0 65535.0 ECU_ADDRESS 0x7FD9D8 /begin FUNCTION_LIST MANDETEK /end FUNCTION_LIST BIT_MASK 0x2 /end MEASUREMENT
/begin MEASUREMENT St_mandetek.B_mandetekl "Bedingung Manipulationserkenung Hydraulikpfad aktiv" UWORD Def_bit_uw_2 0 0 0.0 65535.0 ECU_ADDRESS 0x7FD9D8 /begin FUNCTION_LIST MANDETEK /end FUNCTION_LIST BIT_MASK 0x4 /end MEASUREMENT
/begin MEASUREMENT St_mandetek.B_mandetekml "Bedingung für Hydraulikpfadaktivierung temp. 3" UWORD Def_bit_uw_0 0 0 0.0 65535.0 ECU_ADDRESS 0x7FD9D8 /begin FUNCTION_LIST MANDETEK /end FUNCTION_LIST BIT_MASK 0x1 /end MEASUREMENT
/begin MEASUREMENT St_master "Statusbyte master" UBYTE Def_st_ub_q1 0 0 0.0 255.0000 ECU_ADDRESS 0x7FBEF4 /begin FUNCTION_LIST LAYER /end FUNCTION_LIST /end MEASUREMENT
/begin MEASUREMENT St_master.B_masterhw "Bedingung Master SG" UBYTE Def_bit_ub_0 0 0 0.0 255.0 ECU_ADDRESS 0x7FBEF4 /begin FUNCTION_LIST LAYER /end FUNCTION_LIST BIT_MASK 0x1 /end MEASUREMENT
/begin MEASUREMENT St_mdna "" UBYTE Def_st_ub_q1 0 0 0.0 255.0000 ECU_ADDRESS 0x7FBEF5 /begin FUNCTION_LIST LAYER /end FUNCTION_LIST /end MEASUREMENT
/begin MEASUREMENT St_mdna.B_lastab "" UBYTE Def_bit_ub_0 0 0 0.0 255.0 ECU_ADDRESS 0x7FBEF5 /begin FUNCTION_LIST LAYER /end FUNCTION_LIST BIT_MASK 0x1 /end MEASUREMENT
/begin MEASUREMENT St_mkwchn "Statuswort Masterkurbelwelle" UBYTE Def_dez_ub_q1 0 0 0.0 255.0000 ECU_ADDRESS 0x7FBEF6 /begin FUNCTION_LIST LAYER /end FUNCTION_LIST /end MEASUREMENT
/begin MEASUREMENT St_mkwchn.B_kwdreht "Bedingung drehende Kurbelwelle erkannt" UBYTE Def_bit_ub_5 0 0 0.0 255.0 ECU_ADDRESS 0x7FBEF6 /begin FUNCTION_LIST LAYER /end FUNCTION_LIST BIT_MASK 0x20 /end MEASUREMENT
/begin MEASUREMENT St_motzustd "Statusword fuer Motorzustand" UWORD Def_st_uw_q1 0 0 0.0 65535.0000 ECU_ADDRESS 0x7FBEF8 /begin FUNCTION_LIST LAYER /end FUNCTION_LIST /end MEASUREMENT
/begin MEASUREMENT St_motzustd.B_ll "Bedingung Leerlauf" UWORD Def_bit_uw_3 0 0 0.0 65535.0 ECU_ADDRESS 0x7FBEF8 /begin FUNCTION_LIST LAYER /end FUNCTION_LIST BIT_MASK 0x8 /end MEASUREMENT
/begin MEASUREMENT St_motzustd.B_vl "Bedingung Vollast" UWORD Def_bit_uw_5 0 0 0.0 65535.0 ECU_ADDRESS 0x7FBEF8 /begin FUNCTION_LIST LAYER /end FUNCTION_LIST BIT_MASK 0x20 /end MEASUREMENT
/begin MEASUREMENT St_oz "Statuswort Eingangsgrößen Ölzustandssensor" UBYTE Def_dez_ub_q1 0 0 0.0 255.0000 ECU_ADDRESS 0x7FBE97 /begin FUNCTION_LIST LAYER /end FUNCTION_LIST /end MEASUREMENT
/begin MEASUREMENT St_oz.B_anhang "Bedingung Anhänger erkannt" UBYTE Def_bit_ub_0 0 0 0.0 255.0 ECU_ADDRESS 0x7FBE97 /begin FUNCTION_LIST LAYER /end FUNCTION_LIST BIT_MASK 0x1 /end MEASUREMENT
/begin MEASUREMENT St_oz.B_ozfbsd "Bedingung Fehler BSD-Kommunikation" UBYTE Def_bit_ub_1 0 0 0.0 255.0 ECU_ADDRESS 0x7FBE97 /begin FUNCTION_LIST LAYER /end FUNCTION_LIST BIT_MASK 0x2 /end MEASUREMENT
/begin MEASUREMENT St_oz_i "Statusbyte für Eingang OZ" UBYTE Def_dez_ub_q1 0 0 0.0 255.0000 ECU_ADDRESS 0x7FBE96 /begin FUNCTION_LIST LAYER /end FUNCTION_LIST /end MEASUREMENT
/begin MEASUREMENT St_oz_i.B_td_og "Bedingung Abkühlzeit gültig" UBYTE Def_bit_ub_0 0 0 0.0 255.0 ECU_ADDRESS 0x7FBE96 /begin FUNCTION_LIST LAYER /end FUNCTION_LIST BIT_MASK 0x1 /end MEASUREMENT
/begin MEASUREMENT St_oz_i.B_td_ogok "Bedingung State-Machine 1x gültig gerechnet" UBYTE Def_bit_ub_4 0 0 0.0 255.0 ECU_ADDRESS 0x7FBE96 /begin FUNCTION_LIST LAYER /end FUNCTION_LIST BIT_MASK 0x10 /end MEASUREMENT
/begin MEASUREMENT St_oz_i.B_toel "Bedingung tr und tv gültig" UBYTE Def_bit_ub_1 0 0 0.0 255.0 ECU_ADDRESS 0x7FBE96 /begin FUNCTION_LIST LAYER /end FUNCTION_LIST BIT_MASK 0x2 /end MEASUREMENT
/begin MEASUREMENT St_ozbg0 "Statuswort" UBYTE Def_st_ub_q1 0 0 0.0 255.0000 ECU_ADDRESS 0x7FDD80 /begin FUNCTION_LIST OZBG /end FUNCTION_LIST /end MEASUREMENT
/begin MEASUREMENT St_ozbg0.B_bosmsgc "Bedingung für Absetzen einer BOS-Meldung" UBYTE Def_bit_ub_0 0 0 0.0 255.0 ECU_ADDRESS 0x7FDD80 /begin FUNCTION_LIST OZBG /end FUNCTION_LIST BIT_MASK 0x1 /end MEASUREMENT
/begin MEASUREMENT St_ozbg0.B_mol_vb "Bedingung Ölverbrauchswarnung" UBYTE Def_bit_ub_1 0 0 0.0 255.0 ECU_ADDRESS 0x7FDD80 /begin FUNCTION_LIST OZBG /end FUNCTION_LIST BIT_MASK 0x2 /end MEASUREMENT
/begin MEASUREMENT St_ozbg0.B_mol_vl "Bedingung Ölverlustwarnung" UBYTE Def_bit_ub_2 0 0 0.0 255.0 ECU_ADDRESS 0x7FDD80 /begin FUNCTION_LIST OZBG /end FUNCTION_LIST BIT_MASK 0x4 /end MEASUREMENT
/begin MEASUREMENT St_ozbg0.B_oeltemp "Bedingung für CAN-Ausgabe der Öltemperatur" UBYTE Def_bit_ub_3 0 0 0.0 255.0 ECU_ADDRESS 0x7FDD80 /begin FUNCTION_LIST OZBG /end FUNCTION_LIST BIT_MASK 0x8 /end MEASUREMENT
/begin MEASUREMENT St_ozbg0.B_oelverb "" UBYTE Def_bit_ub_4 0 0 0.0 255.0 ECU_ADDRESS 0x7FDD80 /begin FUNCTION_LIST OZBG /end FUNCTION_LIST BIT_MASK 0x10 /end MEASUREMENT
/begin MEASUREMENT St_ozbg0.B_oelverl "" UBYTE Def_bit_ub_5 0 0 0.0 255.0 ECU_ADDRESS 0x7FDD80 /begin FUNCTION_LIST OZBG /end FUNCTION_LIST BIT_MASK 0x20 /end MEASUREMENT
/begin MEASUREMENT St_ozbg_nv0 "Statuswort" UBYTE Def_st_ub_q1 0 0 0.0 255.0000 ECU_ADDRESS 0x7FDD68 /begin FUNCTION_LIST OZBG /end FUNCTION_LIST /end MEASUREMENT
/begin MEASUREMENT St_ozbg_nv0.B_ozkl15 "Merker für Einschalten Kl. 15" UBYTE Def_bit_ub_0 0 0 0.0 255.0 ECU_ADDRESS 0x7FDD68 /begin FUNCTION_LIST OZBG /end FUNCTION_LIST BIT_MASK 0x1 /end MEASUREMENT
/begin MEASUREMENT St_ozgg0 "Statuswort" UBYTE Def_st_ub_q1 0 0 0.0 255.0000 ECU_ADDRESS 0x7FDDD5 /begin FUNCTION_LIST OZGG /end FUNCTION_LIST /end MEASUREMENT
/begin MEASUREMENT St_ozgg0.B_oelwech "" UBYTE Def_bit_ub_0 0 0 0.0 255.0 ECU_ADDRESS 0x7FDDD5 /begin FUNCTION_LIST OZGG /end FUNCTION_LIST BIT_MASK 0x1 /end MEASUREMENT
/begin MEASUREMENT St_ozgg0.B_ozniv "BOS Reset (Ölwechsel)" UBYTE Def_bit_ub_1 0 0 0.0 255.0 ECU_ADDRESS 0x7FDDD5 /begin FUNCTION_LIST OZGG /end FUNCTION_LIST BIT_MASK 0x2 /end MEASUREMENT
/begin MEASUREMENT St_ozgg0.B_ozperm "Reset BOS vom Kombi (CAN)" UBYTE Def_bit_ub_2 0 0 0.0 255.0 ECU_ADDRESS 0x7FDDD5 /begin FUNCTION_LIST OZGG /end FUNCTION_LIST BIT_MASK 0x4 /end MEASUREMENT
/begin MEASUREMENT St_ozgg0.B_oztemp "Reset vom Tester" UBYTE Def_bit_ub_3 0 0 0.0 255.0 ECU_ADDRESS 0x7FDDD5 /begin FUNCTION_LIST OZGG /end FUNCTION_LIST BIT_MASK 0x8 /end MEASUREMENT
/begin MEASUREMENT St_ozgg0.B_ozvfchg "Bedingung Ölwechsel erfolgt" UBYTE Def_bit_ub_4 0 0 0.0 255.0 ECU_ADDRESS 0x7FDDD5 /begin FUNCTION_LIST OZGG /end FUNCTION_LIST BIT_MASK 0x10 /end MEASUREMENT
/begin MEASUREMENT St_ozgg0.B_ozvfchgt "Bedingung Permittivitätssignal in Ordnung" UBYTE Def_bit_ub_6 0 0 0.0 255.0 ECU_ADDRESS 0x7FDDD5 /begin FUNCTION_LIST OZGG /end FUNCTION_LIST BIT_MASK 0x40 /end MEASUREMENT
/begin MEASUREMENT St_ozgg0.B_ozzeitdmew "Bedingung Temperatursignal in Ordnung" UBYTE Def_bit_ub_7 0 0 0.0 255.0 ECU_ADDRESS 0x7FDDD5 /begin FUNCTION_LIST OZGG /end FUNCTION_LIST BIT_MASK 0x80 /end MEASUREMENT
/begin MEASUREMENT St_ozgg0.B_svcntchg "Bedingung Niveausignal in Ordnung" UBYTE Def_bit_ub_5 0 0 0.0 255.0 ECU_ADDRESS 0x7FDDD5 /begin FUNCTION_LIST OZGG /end FUNCTION_LIST BIT_MASK 0x20 /end MEASUREMENT
/begin MEASUREMENT St_ozgg1 "Statuswort" UBYTE Def_st_ub_q1 0 0 0.0 255.0000 ECU_ADDRESS 0x7FDDD6 /begin FUNCTION_LIST OZGG /end FUNCTION_LIST /end MEASUREMENT
/begin MEASUREMENT St_ozgg1.B_ozmanip "Bedingung für geänderte Verfügbarkeit vom Kombi" UBYTE Def_bit_ub_2 0 0 0.0 255.0 ECU_ADDRESS 0x7FDDD6 /begin FUNCTION_LIST OZGG /end FUNCTION_LIST BIT_MASK 0x4 /end MEASUREMENT
/begin MEASUREMENT St_ozgg1.B_ozreset "Bedingung für über Tester geänderten Servicezähler" UBYTE Def_bit_ub_5 0 0 0.0 255.0 ECU_ADDRESS 0x7FDDD6 /begin FUNCTION_LIST OZGG /end FUNCTION_LIST BIT_MASK 0x20 /end MEASUREMENT
/begin MEASUREMENT St_ozgg1.B_ozresetcan "" UBYTE Def_bit_ub_4 0 0 0.0 255.0 ECU_ADDRESS 0x7FDDD6 /begin FUNCTION_LIST OZGG /end FUNCTION_LIST BIT_MASK 0x10 /end MEASUREMENT
/begin MEASUREMENT St_ozgg1.B_ozresett "" UBYTE Def_bit_ub_3 0 0 0.0 255.0 ECU_ADDRESS 0x7FDDD6 /begin FUNCTION_LIST OZGG /end FUNCTION_LIST BIT_MASK 0x8 /end MEASUREMENT
/begin MEASUREMENT St_ozgg1.B_ozvfchgc "Bedingung für geänderte Verfügbarkeit" UBYTE Def_bit_ub_0 0 0 0.0 255.0 ECU_ADDRESS 0x7FDDD6 /begin FUNCTION_LIST OZGG /end FUNCTION_LIST BIT_MASK 0x1 /end MEASUREMENT
/begin MEASUREMENT St_ozgg1.B_ozvfchgcc "Bedingung für geänderte Verfügbarkeit vom Kombi über Restweg" UBYTE Def_bit_ub_1 0 0 0.0 255.0 ECU_ADDRESS 0x7FDDD6 /begin FUNCTION_LIST OZGG /end FUNCTION_LIST BIT_MASK 0x2 /end MEASUREMENT
/begin MEASUREMENT St_ozgg_nv0 "Statuswort" UBYTE Def_st_ub_q1 0 0 0.0 255.0000 ECU_ADDRESS 0x7FDD86 /begin FUNCTION_LIST OZGG /end FUNCTION_LIST /end MEASUREMENT
/begin MEASUREMENT St_ozgg_nv0.B_dmeini "Bedingung für neue noch nicht initialisierte DME" UBYTE Def_bit_ub_0 0 0 0.0 255.0 ECU_ADDRESS 0x7FDD86 /begin FUNCTION_LIST OZGG /end FUNCTION_LIST BIT_MASK 0x1 /end MEASUREMENT
/begin MEASUREMENT St_ozgg_nv0.B_dmewech "Bedingung für getauschte DME zur Aktualisierung der BOS-Werte" UBYTE Def_bit_ub_1 0 0 0.0 255.0 ECU_ADDRESS 0x7FDD86 /begin FUNCTION_LIST OZGG /end FUNCTION_LIST BIT_MASK 0x2 /end MEASUREMENT
/begin MEASUREMENT St_ozgg_nv0.B_factoryres "" UBYTE Def_bit_ub_2 0 0 0.0 255.0 ECU_ADDRESS 0x7FDD86 /begin FUNCTION_LIST OZGG /end FUNCTION_LIST BIT_MASK 0x4 /end MEASUREMENT
/begin MEASUREMENT St_oznivdl0 "Statuswort" UBYTE Def_st_ub_q1 0 0 0.0 255.0000 ECU_ADDRESS 0x7FDE06 /begin FUNCTION_LIST OZNIVDL /end FUNCTION_LIST /end MEASUREMENT
/begin MEASUREMENT St_oznivdl0.B_oelnivnorm "Bedingung Orientierungsmessung erfolgt" UBYTE Def_bit_ub_6 0 0 0.0 255.0 ECU_ADDRESS 0x7FDE06 /begin FUNCTION_LIST OZNIVDL /end FUNCTION_LIST BIT_MASK 0x40 /end MEASUREMENT
/begin MEASUREMENT St_oznivdl0.B_ozkrzl "Bedingung vorgezogener Mittelwert berechnet" UBYTE Def_bit_ub_7 0 0 0.0 255.0 ECU_ADDRESS 0x7FDE06 /begin FUNCTION_LIST OZNIVDL /end FUNCTION_LIST BIT_MASK 0x80 /end MEASUREMENT
/begin MEASUREMENT St_oznivdl0.B_ozkrzlkor "" UBYTE Def_bit_ub_5 0 0 0.0 255.0 ECU_ADDRESS 0x7FDE06 /begin FUNCTION_LIST OZNIVDL /end FUNCTION_LIST BIT_MASK 0x20 /end MEASUREMENT
/begin MEASUREMENT St_oznivdl0.B_ozlangmw "" UBYTE Def_bit_ub_2 0 0 0.0 255.0 ECU_ADDRESS 0x7FDE06 /begin FUNCTION_LIST OZNIVDL /end FUNCTION_LIST BIT_MASK 0x4 /end MEASUREMENT
/begin MEASUREMENT St_oznivdl0.B_oznivb "" UBYTE Def_bit_ub_0 0 0 0.0 255.0 ECU_ADDRESS 0x7FDE06 /begin FUNCTION_LIST OZNIVDL /end FUNCTION_LIST BIT_MASK 0x1 /end MEASUREMENT
/begin MEASUREMENT St_oznivdl0.B_ozor "" UBYTE Def_bit_ub_3 0 0 0.0 255.0 ECU_ADDRESS 0x7FDE06 /begin FUNCTION_LIST OZNIVDL /end FUNCTION_LIST BIT_MASK 0x8 /end MEASUREMENT
/begin MEASUREMENT St_oznivdl0.B_ozvormw "Bedingung Langzeit-Mittelwert berechnet" UBYTE Def_bit_ub_4 0 0 0.0 255.0 ECU_ADDRESS 0x7FDE06 /begin FUNCTION_LIST OZNIVDL /end FUNCTION_LIST BIT_MASK 0x10 /end MEASUREMENT
/begin MEASUREMENT St_oznivdl_nv0 "Statuswort" UBYTE Def_st_ub_q1 0 0 0.0 255.0000 ECU_ADDRESS 0x7FDDD8 /begin FUNCTION_LIST OZNIVDL /end FUNCTION_LIST /end MEASUREMENT
/begin MEASUREMENT St_oznivdl_nv0.B_ozlw1 "" UBYTE Def_bit_ub_0 0 0 0.0 255.0 ECU_ADDRESS 0x7FDDD8 /begin FUNCTION_LIST OZNIVDL /end FUNCTION_LIST BIT_MASK 0x1 /end MEASUREMENT
/begin MEASUREMENT St_oznivdl_nv0.B_ozpeilerr "Bedingung mindestens 1 gültiger Langzeitmittelwert war vorhanden" UBYTE Def_bit_ub_1 0 0 0.0 255.0 ECU_ADDRESS 0x7FDDD8 /begin FUNCTION_LIST OZNIVDL /end FUNCTION_LIST BIT_MASK 0x2 /end MEASUREMENT
/begin MEASUREMENT St_ozperm0 "Statuswort" UBYTE Def_st_ub_q1 0 0 0.0 255.0000 ECU_ADDRESS 0x7FDE5D /begin FUNCTION_LIST OZPERM /end FUNCTION_LIST /end MEASUREMENT
/begin MEASUREMENT St_ozperm0.B_calcdper "" UBYTE Def_bit_ub_0 0 0 0.0 255.0 ECU_ADDRESS 0x7FDE5D /begin FUNCTION_LIST OZPERM /end FUNCTION_LIST BIT_MASK 0x1 /end MEASUREMENT
/begin MEASUREMENT St_ozperm0.B_ozpermgl "" UBYTE Def_bit_ub_1 0 0 0.0 255.0 ECU_ADDRESS 0x7FDE5D /begin FUNCTION_LIST OZPERM /end FUNCTION_LIST BIT_MASK 0x2 /end MEASUREMENT
/begin MEASUREMENT St_ozperm0.B_ozpermpl "" UBYTE Def_bit_ub_2 0 0 0.0 255.0 ECU_ADDRESS 0x7FDE5D /begin FUNCTION_LIST OZPERM /end FUNCTION_LIST BIT_MASK 0x4 /end MEASUREMENT
/begin MEASUREMENT St_ozperm0.B_ozpermpld "Bedingung für Berechnung Restweg aus Er" UBYTE Def_bit_ub_3 0 0 0.0 255.0 ECU_ADDRESS 0x7FDE5D /begin FUNCTION_LIST OZPERM /end FUNCTION_LIST BIT_MASK 0x8 /end MEASUREMENT
/begin MEASUREMENT St_ozperm_nv0 "Statuswort" UBYTE Def_st_ub_q1 0 0 0.0 255.0000 ECU_ADDRESS 0x7FDE0E /begin FUNCTION_LIST OZPERM /end FUNCTION_LIST /end MEASUREMENT
/begin MEASUREMENT St_ozperm_nv0.B_ozdperm "Bedingung Delta Er-Ermittlung aktiv" UBYTE Def_bit_ub_4 0 0 0.0 255.0 ECU_ADDRESS 0x7FDE0E /begin FUNCTION_LIST OZPERM /end FUNCTION_LIST BIT_MASK 0x10 /end MEASUREMENT
/begin MEASUREMENT St_ozperm_nv0.B_ozer0ok "Bedingung Permittivität beim letztem Ölwechsel endgültig berechnet" UBYTE Def_bit_ub_3 0 0 0.0 255.0 ECU_ADDRESS 0x7FDE0E /begin FUNCTION_LIST OZPERM /end FUNCTION_LIST BIT_MASK 0x8 /end MEASUREMENT
/begin MEASUREMENT St_ozperm_nv0.B_ozeranz "Bedingung für Anzeige Restweg aus Er" UBYTE Def_bit_ub_1 0 0 0.0 255.0 ECU_ADDRESS 0x7FDE0E /begin FUNCTION_LIST OZPERM /end FUNCTION_LIST BIT_MASK 0x2 /end MEASUREMENT
/begin MEASUREMENT St_ozperm_nv0.B_ozerplt "Bedingung Ausheizzeit erfüllt" UBYTE Def_bit_ub_5 0 0 0.0 255.0 ECU_ADDRESS 0x7FDE0E /begin FUNCTION_LIST OZPERM /end FUNCTION_LIST BIT_MASK 0x20 /end MEASUREMENT
/begin MEASUREMENT St_ozperm_nv0.B_ozper0ok "Bedingung, dass gültiger Start-Permittivitätswert vorliegt" UBYTE Def_bit_ub_0 0 0 0.0 255.0 ECU_ADDRESS 0x7FDE0E /begin FUNCTION_LIST OZPERM /end FUNCTION_LIST BIT_MASK 0x1 /end MEASUREMENT
/begin MEASUREMENT St_ozperm_nv0.B_ozregstg "Bedingung Schieberegistersteuerung" UBYTE Def_bit_ub_2 0 0 0.0 255.0 ECU_ADDRESS 0x7FDE0E /begin FUNCTION_LIST OZPERM /end FUNCTION_LIST BIT_MASK 0x4 /end MEASUREMENT
/begin MEASUREMENT St_pmbnstab "Status pmbnstab" UBYTE Def_st_ub_q1 0 0 0.0 255.0000 ECU_ADDRESS 0x7FD853 /begin FUNCTION_LIST LAYER /end FUNCTION_LIST /end MEASUREMENT
/begin MEASUREMENT St_pmbnstab.B_nachlend "Bedingung Nachlauf beendet" UBYTE Def_bit_ub_0 0 0 0.0 255.0 ECU_ADDRESS 0x7FD853 /begin FUNCTION_LIST LAYER /end FUNCTION_LIST BIT_MASK 0x1 /end MEASUREMENT
/begin MEASUREMENT St_pmi "Statuswort Eingänge LCP" UBYTE Def_dez_ub_q1 0 0 0.0 255.0000 ECU_ADDRESS 0x7FBEFA /begin FUNCTION_LIST LAYER /end FUNCTION_LIST /end MEASUREMENT
/begin MEASUREMENT St_pmi.B_fabttreg "Bedingung Batterietausch registrieren" UBYTE Def_bit_ub_1 0 0 0.0 255.0 ECU_ADDRESS 0x7FBEFA /begin FUNCTION_LIST LAYER /end FUNCTION_LIST BIT_MASK 0x2 /end MEASUREMENT
/begin MEASUREMENT St_pmi.B_fahisrst "Bedingung Histogramm Reset" UBYTE Def_bit_ub_2 0 0 0.0 255.0 ECU_ADDRESS 0x7FBEFA /begin FUNCTION_LIST LAYER /end FUNCTION_LIST BIT_MASK 0x4 /end MEASUREMENT
/begin MEASUREMENT St_pmi_nv "Status pmi_nv" UBYTE Def_st_ub_q1 0 0 0.0 255.0000 ECU_ADDRESS 0x7FD854 /begin FUNCTION_LIST LAYER /end FUNCTION_LIST /end MEASUREMENT
/begin MEASUREMENT St_pmi_nv.B_fapmmess "Bedingung Messmethode PM" UBYTE Def_bit_ub_0 0 0 0.0 255.0 ECU_ADDRESS 0x7FD854 /begin FUNCTION_LIST LAYER /end FUNCTION_LIST BIT_MASK 0x1 /end MEASUREMENT
/begin MEASUREMENT St_pmi_nv.B_ulcp "Bedingung ULCP aktiv" UBYTE Def_bit_ub_1 0 0 0.0 255.0 ECU_ADDRESS 0x7FD854 /begin FUNCTION_LIST LAYER /end FUNCTION_LIST BIT_MASK 0x2 /end MEASUREMENT
/begin MEASUREMENT St_pwf "Statuswert fuer Power-fail" UBYTE Def_st_ub_q1 0 0 0.0 255.0000 ECU_ADDRESS 0x7FBEFB /begin FUNCTION_LIST LAYER /end FUNCTION_LIST /end MEASUREMENT
/begin MEASUREMENT St_pwf.B_pwf "Bedingung Powerfail" UBYTE Def_bit_ub_0 0 0 0.0 255.0 ECU_ADDRESS 0x7FBEFB /begin FUNCTION_LIST LAYER /end FUNCTION_LIST BIT_MASK 0x1 /end MEASUREMENT
/begin MEASUREMENT St_sawe "Statusbyte Schubabschaltung/Wiedereinsetzen" UBYTE Def_st_ub_q1 0 0 0.0 255.0000 ECU_ADDRESS 0x7FBEFC /begin FUNCTION_LIST LAYER /end FUNCTION_LIST /end MEASUREMENT
/begin MEASUREMENT St_sawe.B_sa "Bedingung Schubabschaltung" UBYTE Def_bit_ub_3 0 0 0.0 255.0 ECU_ADDRESS 0x7FBEFC /begin FUNCTION_LIST LAYER /end FUNCTION_LIST BIT_MASK 0x8 /end MEASUREMENT
/begin MEASUREMENT St_sleep "Statuswort Einschlafverhalten" UBYTE Def_st_ub_q1 0 0 0.0 255.0000 ECU_ADDRESS 0x7FD7E8 /begin FUNCTION_LIST KT_IBS /end FUNCTION_LIST /end MEASUREMENT
/begin MEASUREMENT St_sleep.B_sleepwait "Signal Verzoegerung Sleep Indication" UBYTE Def_bit_ub_0 0 0 0.0 255.0 ECU_ADDRESS 0x7FD7E8 /begin FUNCTION_LIST KT_IBS /end FUNCTION_LIST BIT_MASK 0x1 /end MEASUREMENT
/begin MEASUREMENT St_slp "Statusbyte Sekundärluftpumpe" UBYTE Def_st_ub_q1 0 0 0.0 255.0000 ECU_ADDRESS 0x7FBEFD /begin FUNCTION_LIST LAYER /end FUNCTION_LIST /end MEASUREMENT
/begin MEASUREMENT St_slp.B_fasls "Bed. Funktionsanf Sekundärluftsystem" UBYTE Def_bit_ub_0 0 0 0.0 255.0 ECU_ADDRESS 0x7FBEFD /begin FUNCTION_LIST LAYER /end FUNCTION_LIST BIT_MASK 0x1 /end MEASUREMENT
/begin MEASUREMENT St_slp.B_genslp "Bedingung Spannungsanforderung Sekundärluftpumpe" UBYTE Def_bit_ub_2 0 0 0.0 255.0 ECU_ADDRESS 0x7FBEFD /begin FUNCTION_LIST LAYER /end FUNCTION_LIST BIT_MASK 0x4 /end MEASUREMENT
/begin MEASUREMENT St_sls "Statuswort Sekundärluftsystem" UBYTE Def_dez_ub_q1 0 0 0.0 255.0000 ECU_ADDRESS 0x7FBEFE /begin FUNCTION_LIST LAYER /end FUNCTION_LIST /end MEASUREMENT
/begin MEASUREMENT St_sls.B_sls "Bedingung Sekundärluftsystem aktiv" UBYTE Def_bit_ub_0 0 0 0.0 255.0 ECU_ADDRESS 0x7FBEFE /begin FUNCTION_LIST LAYER /end FUNCTION_LIST BIT_MASK 0x1 /end MEASUREMENT
/begin MEASUREMENT St_start "Status Start" UBYTE Def_st_ub_q1 0 0 0.0 255.0000 ECU_ADDRESS 0x7FD850 /begin FUNCTION_LIST LAYER /end FUNCTION_LIST /end MEASUREMENT
/begin MEASUREMENT St_start.B_sta "Bedingung Automatikstart" UBYTE Def_bit_ub_7 0 0 0.0 255.0 ECU_ADDRESS 0x7FD850 /begin FUNCTION_LIST LAYER /end FUNCTION_LIST BIT_MASK 0x80 /end MEASUREMENT
/begin MEASUREMENT St_start.B_startende "Bedingung Startende" UBYTE Def_bit_ub_3 0 0 0.0 255.0 ECU_ADDRESS 0x7FD850 /begin FUNCTION_LIST LAYER /end FUNCTION_LIST BIT_MASK 0x8 /end MEASUREMENT
/begin MEASUREMENT St_tan "Statuswort" UBYTE Def_st_ub_q1 0 0 0.0 255.0000 ECU_ADDRESS 0x7FD87D /begin FUNCTION_LIST LBATTCAL /end FUNCTION_LIST /end MEASUREMENT
/begin MEASUREMENT St_tan.B_taners "Bedingung für Startwertberechnung" UBYTE Def_bit_ub_0 0 0 0.0 255.0 ECU_ADDRESS 0x7FD87D /begin FUNCTION_LIST LBATTCAL /end FUNCTION_LIST BIT_MASK 0x1 /end MEASUREMENT
/begin MEASUREMENT St_tum "Statuswort tum" UBYTE Def_dez_ub_q1 0 0 0.0 255.0000 ECU_ADDRESS 0x7FBE95 /begin FUNCTION_LIST LAYER /end FUNCTION_LIST /end MEASUREMENT
/begin MEASUREMENT St_tum.B_tumers "Bedingung Umgebungstemperaturersatzwert" UBYTE Def_bit_ub_0 0 0 0.0 255.0 ECU_ADDRESS 0x7FBE95 /begin FUNCTION_LIST LAYER /end FUNCTION_LIST BIT_MASK 0x1 /end MEASUREMENT
/begin MEASUREMENT St_zwktibs "Statuswort zwktibs" UBYTE Def_dez_ub_q1 0 0 0.0 255.0000 ECU_ADDRESS 0x7FBEFF /begin FUNCTION_LIST LAYER /end FUNCTION_LIST /end MEASUREMENT
/begin MEASUREMENT St_zwktibs.B_ibsactiv "Bedingung Kommunikation mit IBS vorhanden" UBYTE Def_bit_ub_0 0 0 0.0 255.0 ECU_ADDRESS 0x7FBEFF /begin FUNCTION_LIST LAYER /end FUNCTION_LIST BIT_MASK 0x1 /end MEASUREMENT
/begin MEASUREMENT T1histiruh "Ruhestromhistogramm Klasse 1" UWORD Def_dez_uw_q1 0 0 0.0 65535.0000 ECU_ADDRESS 0x7FD7BC /begin FUNCTION_LIST KT_IBS /end FUNCTION_LIST /end MEASUREMENT
/begin MEASUREMENT T2histiruh "Ruhestromhistogramm Klasse 2" UWORD Def_dez_uw_q1 0 0 0.0 65535.0000 ECU_ADDRESS 0x7FD7BE /begin FUNCTION_LIST KT_IBS /end FUNCTION_LIST /end MEASUREMENT
/begin MEASUREMENT T3histiruh "Ruhestromhistogramm Klasse 3" UWORD Def_dez_uw_q1 0 0 0.0 65535.0000 ECU_ADDRESS 0x7FD7C0 /begin FUNCTION_LIST KT_IBS /end FUNCTION_LIST /end MEASUREMENT
/begin MEASUREMENT T4histiruh "Ruhestromhistogramm Klasse 4" UWORD Def_dez_uw_q1 0 0 0.0 65535.0000 ECU_ADDRESS 0x7FD7C2 /begin FUNCTION_LIST KT_IBS /end FUNCTION_LIST /end MEASUREMENT
/begin MEASUREMENT T_batstiniv "Starttemperatur Batterie vorne" SWORD Def_t_sw_q0p1 0 0 -3276.8000 3276.7000 ECU_ADDRESS 0x7FD86C /begin FUNCTION_LIST LBATTCAL /end FUNCTION_LIST /end MEASUREMENT
/begin MEASUREMENT T_batt_ibs "Batterietemperatur" SWORD Def_t_sw_q0p1 0 0 -3276.8000 3276.7000 ECU_ADDRESS 0x7FD7C4 /begin FUNCTION_LIST KT_IBS /end FUNCTION_LIST /end MEASUREMENT
/begin MEASUREMENT T_batt_ini "Startwert Batterietemperatur" SWORD Def_t_sw_q0p1 0 0 -3276.8000 3276.7000 ECU_ADDRESS 0x7FD86E /begin FUNCTION_LIST LBATTCAL /end FUNCTION_LIST /end MEASUREMENT
/begin MEASUREMENT T_batt_lb "Batterietemperatur" SWORD Def_t_sw_q0p1 0 0 -3276.8000 3276.7000 ECU_ADDRESS 0x7FD866 /begin FUNCTION_LIST LBATTCAL /end FUNCTION_LIST /end MEASUREMENT
/begin MEASUREMENT T_batt_max "Maximale Batt. Temperatur bei Stillstand" SWORD Def_t_sw_q0p1 0 0 -3276.8000 3276.7000 ECU_ADDRESS 0x7FD7C6 /begin FUNCTION_LIST KT_IBS /end FUNCTION_LIST /end MEASUREMENT
/begin MEASUREMENT T_batt_min "Minimale Batt. Temperatur bei Stillstand" SWORD Def_t_sw_q0p1 0 0 -3276.8000 3276.7000 ECU_ADDRESS 0x7FD7C8 /begin FUNCTION_LIST KT_IBS /end FUNCTION_LIST /end MEASUREMENT
/begin MEASUREMENT T_batt_zw "Temporäre Batterietemperatur" SWORD Def_t_sw_q0p1 0 0 -3276.8000 3276.7000 ECU_ADDRESS 0x7FD870 /begin FUNCTION_LIST LBATTCAL /end FUNCTION_LIST /end MEASUREMENT
/begin MEASUREMENT T_batt_zw2 "Temporäre Zwischengroesse" SWORD Def_t_sw_q0p1 0 0 -3276.8000 3276.7000 ECU_ADDRESS 0x7FD872 /begin FUNCTION_LIST LBATTCAL /end FUNCTION_LIST /end MEASUREMENT
/begin MEASUREMENT T_batt_zw3 "" SWORD Def_t_sw_q0p1 0 0 -3276.8000 3276.7000 ECU_ADDRESS 0x7FD874 /begin FUNCTION_LIST LBATTCAL /end FUNCTION_LIST /end MEASUREMENT
/begin MEASUREMENT T_battabst "Batterieabstelltemperatur" SWORD Def_t_sw_q0p1 0 0 -3276.8000 3276.7000 ECU_ADDRESS 0x7FD856 /begin FUNCTION_LIST LBATTCAL /end FUNCTION_LIST /end MEASUREMENT
/begin MEASUREMENT T_battsoc0 "Batterietemperatur bei Ruhespannungsmessung" SWORD Def_t_sw_q0p1 0 0 -3276.8000 3276.7000 ECU_ADDRESS 0x7FD7A8 /begin FUNCTION_LIST KT_IBS /end FUNCTION_LIST /end MEASUREMENT
/begin MEASUREMENT T_battsoci "T_battsoc0, Rohwert aus IBS" UBYTE Def_dez_ub_q1 0 0 0.0 255.0000 ECU_ADDRESS 0x7FD7FF /begin FUNCTION_LIST KT_IBS /end FUNCTION_LIST /end MEASUREMENT
/begin MEASUREMENT T_jahr "Borddatum" UWORD Def_dez_uw_q1 0 0 0.0 65535.0000 ECU_ADDRESS 0x7FBE9A /begin FUNCTION_LIST LAYER /end FUNCTION_LIST /end MEASUREMENT
/begin MEASUREMENT T_monate "Borddatum" UBYTE Def_dez_ub_q1 0 0 0.0 255.0000 ECU_ADDRESS 0x7FBE9E /begin FUNCTION_LIST LAYER /end FUNCTION_LIST /end MEASUREMENT
/begin MEASUREMENT T_tag "Borddatum" UBYTE Def_dez_ub_q1 0 0 0.0 255.0000 ECU_ADDRESS 0x7FBE9F /begin FUNCTION_LIST LAYER /end FUNCTION_LIST /end MEASUREMENT
/begin MEASUREMENT Tans "Ansauglufttemperatur" SWORD Def_t_sw_q0p1 0 0 -3276.8000 3276.7000 ECU_ADDRESS 0x7FBF00 /begin FUNCTION_LIST LAYER /end FUNCTION_LIST /end MEASUREMENT
/begin MEASUREMENT Tbatt_maxi "T_batt_max, Rohwert aus IBS" UBYTE Def_dez_ub_q1 0 0 0.0 255.0000 ECU_ADDRESS 0x7FD800 /begin FUNCTION_LIST KT_IBS /end FUNCTION_LIST /end MEASUREMENT
/begin MEASUREMENT Tbatt_mini "T_batt_min, Rohwert aus IBS" UBYTE Def_dez_ub_q1 0 0 0.0 255.0000 ECU_ADDRESS 0x7FD801 /begin FUNCTION_LIST KT_IBS /end FUNCTION_LIST /end MEASUREMENT
/begin MEASUREMENT Tchip "Chiptemperatur Generator1" SWORD Def_t_sw_q0p1 0 0 -3276.8000 3276.7000 ECU_ADDRESS 0x7FBF02 /begin FUNCTION_LIST LAYER /end FUNCTION_LIST /end MEASUREMENT
/begin MEASUREMENT Tchip2 "Chiptemperatur Generator2" SWORD Def_t_sw_q0p1 0 0 -3276.8000 3276.7000 ECU_ADDRESS 0x7FBF04 /begin FUNCTION_LIST LAYER /end FUNCTION_LIST /end MEASUREMENT
/begin MEASUREMENT Td_f_ierr "Filterzeit Erregerstrom aus BSD-Timingkoordinator" UBYTE Def_td_ub_q0p01 0 0 0.0 2.5500 ECU_ADDRESS 0x7FBF06 /begin FUNCTION_LIST LAYER /end FUNCTION_LIST /end MEASUREMENT
/begin MEASUREMENT Td_og_cnt "Zähler für fallende Flanken im Töns Signal" UBYTE Def_dez_ub_q1 0 0 0.0 255.0000 ECU_ADDRESS 0x7FBE86 /begin FUNCTION_LIST LAYER /end FUNCTION_LIST /end MEASUREMENT
/begin MEASUREMENT Td_og_icnt "Zeit zwischen 2 fallenden Flanken" UWORD Def_dez_uw_q1 0 0 0.0 65535.0000 ECU_ADDRESS 0x7FBE88 /begin FUNCTION_LIST LAYER /end FUNCTION_LIST /end MEASUREMENT
/begin MEASUREMENT Td_og_tk "Abkühlzeit vom TÖNS" UWORD Def_td_uw_q0p1 0 0 0.0 6553.5000 ECU_ADDRESS 0x7FBE8A /begin FUNCTION_LIST LAYER /end FUNCTION_LIST /end MEASUREMENT
/begin MEASUREMENT Td_og_tr "Referntzeit" UWORD Def_td_uw_q0p1 0 0 0.0 6553.5000 ECU_ADDRESS 0x7FBE8C /begin FUNCTION_LIST LAYER /end FUNCTION_LIST /end MEASUREMENT
/begin MEASUREMENT Td_og_tv "Abkühlzeit Vom TÖNS" UWORD Def_td_uw_q0p1 0 0 0.0 6553.5000 ECU_ADDRESS 0x7FBE8E /begin FUNCTION_LIST LAYER /end FUNCTION_LIST /end MEASUREMENT
/begin MEASUREMENT Td_og_uplcnt "Zähler für unplausible Signale" UBYTE Def_dez_ub_q1 0 0 0.0 255.0000 ECU_ADDRESS 0x7FBE90 /begin FUNCTION_LIST LAYER /end FUNCTION_LIST /end MEASUREMENT
/begin MEASUREMENT Td_rdgenreg2 "Auslesezeit für DF-Signal und Diagnose" UBYTE Def_td_ub_q0p1 0 0 0.0 25.5000 ECU_ADDRESS 0x7FBF07 /begin FUNCTION_LIST LAYER /end FUNCTION_LIST /end MEASUREMENT
/begin MEASUREMENT Tkat_mod "Modellierte Katalysatortemperatur" SWORD Def_t_sw_q0p1 0 0 -3276.8000 3276.7000 ECU_ADDRESS 0x7FBF08 /begin FUNCTION_LIST LAYER /end FUNCTION_LIST /end MEASUREMENT
/begin MEASUREMENT Tlrfgen "Kopier Generator1 LR Vorgabe auf Bus gelegt" UBYTE Def_td_ub_q0p1 0 0 0.0 25.5000 ECU_ADDRESS 0x7FBF0A /begin FUNCTION_LIST LAYER /end FUNCTION_LIST /end MEASUREMENT
/begin MEASUREMENT Tlrfgen2 "Kopier Generator2 LR Vorgabe auf Bus gelegt" UBYTE Def_td_ub_q0p1 0 0 0.0 25.5000 ECU_ADDRESS 0x7FBF0B /begin FUNCTION_LIST LAYER /end FUNCTION_LIST /end MEASUREMENT
/begin MEASUREMENT Tlrgen "Sollwert Load- Response- Zeit Generator" UBYTE Def_td_ub_q0p1 0 0 0.0 25.5000 ECU_ADDRESS 0x7FD89A /begin FUNCTION_LIST LOADRESP /end FUNCTION_LIST /end MEASUREMENT
/begin MEASUREMENT Tlrgen2 "Sollwert Load- Response- Zeit Generator2" UBYTE Def_td_ub_q0p1 0 0 0.0 25.5000 ECU_ADDRESS 0x7FD89B /begin FUNCTION_LIST LOADRESP /end FUNCTION_LIST /end MEASUREMENT
/begin MEASUREMENT Tmot "Kühlwassertemperatur" SWORD Def_t_sw_q0p01 0 0 -327.6800 327.6700 ECU_ADDRESS 0x7FBF0C /begin FUNCTION_LIST LAYER /end FUNCTION_LIST /end MEASUREMENT
/begin MEASUREMENT Tmot_abstell "Motorstarttemperatur" SWORD Def_t_sw_q0p01 0 0 -327.6800 327.6700 ECU_ADDRESS 0x7FD840 /begin FUNCTION_LIST LAYER /end FUNCTION_LIST /end MEASUREMENT
/begin MEASUREMENT Tmot_start "Motorstarttemperatur" SWORD Def_t_sw_q0p01 0 0 -327.6800 327.6700 ECU_ADDRESS 0x7FBF0E /begin FUNCTION_LIST LAYER /end FUNCTION_LIST /end MEASUREMENT
/begin MEASUREMENT Tn_abstell "Abstellzeit" UWORD Def_dez_uw_q1 0 0 0.0 65535.0000 ECU_ADDRESS 0x7FBF12 /begin FUNCTION_LIST LAYER /end FUNCTION_LIST /end MEASUREMENT
/begin MEASUREMENT Tn_abstellm "Abstellzeit in Minuten" UWORD Def_dez_uw_q1 0 0 0.0 65535.0000 ECU_ADDRESS 0x7FD842 /begin FUNCTION_LIST LAYER /end FUNCTION_LIST /end MEASUREMENT
/begin MEASUREMENT Tn_start_10 "Zeit nach Startende in 10ms aufgelöst" UWORD Def_td_uw_q0p01 0 0 0.0 655.3500 ECU_ADDRESS 0x7FBF10 /begin FUNCTION_LIST LAYER /end FUNCTION_LIST /end MEASUREMENT
/begin MEASUREMENT Toel "Ausgabewert Motoröltemperatur für LoCAN" SWORD Def_t_sw_q0p1 0 0 -3276.8000 3276.7000 ECU_ADDRESS 0x7FDD7A /begin FUNCTION_LIST OZBG /end FUNCTION_LIST /end MEASUREMENT
/begin MEASUREMENT Toel_mdl "Modelltemperatur Motoröl" SWORD Def_t_sw_q0p1 0 0 -3276.8000 3276.7000 ECU_ADDRESS 0x7FBE92 /begin FUNCTION_LIST LAYER /end FUNCTION_LIST /end MEASUREMENT
/begin MEASUREMENT Toel_oz "Ausgabe Öltemperatur" SWORD Def_t_sw_q0p1 0 0 -3276.8000 3276.7000 ECU_ADDRESS 0x7FDD7C /begin FUNCTION_LIST OZBG /end FUNCTION_LIST /end MEASUREMENT
/begin MEASUREMENT Tumg "Umgebungstemperatur" SWORD Def_t_sw_q0p1 0 0 -3276.8000 3276.7000 ECU_ADDRESS 0x7FBF14 /begin FUNCTION_LIST LAYER /end FUNCTION_LIST /end MEASUREMENT
/begin MEASUREMENT Tumg_abst "Abstell-Aussentemperatur" SWORD Def_t_sw_q0p1 0 0 -3276.8000 3276.7000 ECU_ADDRESS 0x7FD858 /begin FUNCTION_LIST LBATTCAL /end FUNCTION_LIST /end MEASUREMENT
/begin MEASUREMENT Tumg_battab "Abstell-Umgebungstemperatur Batterie" SWORD Def_t_sw_q0p1 0 0 -3276.8000 3276.7000 ECU_ADDRESS 0x7FD85A /begin FUNCTION_LIST LBATTCAL /end FUNCTION_LIST /end MEASUREMENT
/begin MEASUREMENT Tumg_can "Umgebungstemperatur" SWORD Def_t_sw_q0p1 0 0 -3276.8000 3276.7000 ECU_ADDRESS 0x7FBF16 /begin FUNCTION_LIST LAYER /end FUNCTION_LIST /end MEASUREMENT
/begin MEASUREMENT Tumg_dt "Temporäre zwischengroesse" SWORD Def_t_sw_q0p1 0 0 -3276.8000 3276.7000 ECU_ADDRESS 0x7FD876 /begin FUNCTION_LIST LBATTCAL /end FUNCTION_LIST /end MEASUREMENT
/begin MEASUREMENT Tumg_ers "Aussentemperatur oder Ersatzwert" SWORD Def_t_sw_q0p1 0 0 -3276.8000 3276.7000 ECU_ADDRESS 0x7FD868 /begin FUNCTION_LIST LBATTCAL /end FUNCTION_LIST /end MEASUREMENT
/begin MEASUREMENT Tumg_tp "" SWORD Def_t_sw_q0p1 0 0 -3276.8000 3276.7000 ECU_ADDRESS 0x7FD878 /begin FUNCTION_LIST LBATTCAL /end FUNCTION_LIST /end MEASUREMENT
/begin MEASUREMENT Tv_agr "Tastverhältnis AGR-Steller" SWORD Def_tv_sw_q0p01 0 0 -327.6800 327.6700 ECU_ADDRESS 0x7FBF44 /begin FUNCTION_LIST LAYER /end FUNCTION_LIST /end MEASUREMENT
/begin MEASUREMENT Tv_agr_n "Tastverhältnis AGR-Steller normiert" UBYTE Def_f_ub_b2 0 0 0.0 1.9921 ECU_ADDRESS 0x7FDD63 /begin FUNCTION_LIST MANDETEK /end FUNCTION_LIST /end MEASUREMENT
/begin MEASUREMENT Tv_pld "Tastverhältnis Ladedrucksteller" SWORD Def_tv_sw_q0p01 0 0 -327.6800 327.6700 ECU_ADDRESS 0x7FBF42 /begin FUNCTION_LIST LAYER /end FUNCTION_LIST /end MEASUREMENT
/begin MEASUREMENT Tv_pld_n "Tastverhältnis Ladedrucksteller normiert" UBYTE Def_f_ub_b2 0 0 0.0 1.9921 ECU_ADDRESS 0x7FDD64 /begin FUNCTION_LIST MANDETEK /end FUNCTION_LIST /end MEASUREMENT
/begin MEASUREMENT Tw "Tuningwahrscheinlichkeit" UWORD Def_f_uw_b100 0 0 0.0 99.9984 ECU_ADDRESS 0x7FD8A8 /begin FUNCTION_LIST MANDETEK /end FUNCTION_LIST /end MEASUREMENT
/begin MEASUREMENT Twhydr "Tuningwahrscheinlichkeit Hydraulikpfad" UWORD Def_f_uw_b100 0 0 0.0 99.9984 ECU_ADDRESS 0x7FD8AA /begin FUNCTION_LIST MANDETEK /end FUNCTION_LIST /end MEASUREMENT
/begin MEASUREMENT Twhydrcnt "Tuningwahrscheinlichkeitszähler Hydraulokpfad" UWORD Def_dez_uw_q1 0 0 0.0 65535.0000 ECU_ADDRESS 0x7FD8AC /begin FUNCTION_LIST MANDETEK /end FUNCTION_LIST /end MEASUREMENT
/begin MEASUREMENT Twhydrcntg "Zähler Tuningwahrscheinlichk Hydraulikpfad gesamt" ULONG Def_dez_ul_q1 0 0 1.0000 4294967295.0000 ECU_ADDRESS 0x7FD8A0 /begin FUNCTION_LIST MANDETEK /end FUNCTION_LIST /end MEASUREMENT
/begin MEASUREMENT Twluft "Tuningwahrscheinlichkeit Luftpfad" UWORD Def_f_uw_b100 0 0 0.0 99.9984 ECU_ADDRESS 0x7FD8AE /begin FUNCTION_LIST MANDETEK /end FUNCTION_LIST /end MEASUREMENT
/begin MEASUREMENT Twluftcnt "Tuningwahrscheinlichkeitszähler Luftpfad" UWORD Def_dez_uw_q1 0 0 0.0 65535.0000 ECU_ADDRESS 0x7FD8B0 /begin FUNCTION_LIST MANDETEK /end FUNCTION_LIST /end MEASUREMENT
/begin MEASUREMENT Twluftcntg "Zähler Tuningwahrscheinlichkeit Luftpfad gesamt" ULONG Def_dez_ul_q1 0 0 1.0000 4294967264.0000 ECU_ADDRESS 0x7FD8A4 /begin FUNCTION_LIST MANDETEK /end FUNCTION_LIST /end MEASUREMENT
/begin MEASUREMENT U1soc0 "Ruhespannung 1" UWORD Def_u_uw_q0p25em3_o6 0 0 6.0000 22.3837 ECU_ADDRESS 0x7FD7AA /begin FUNCTION_LIST KT_IBS /end FUNCTION_LIST /end MEASUREMENT
/begin MEASUREMENT U2soc0 "Ruhespannung 1" UWORD Def_u_uw_q0p25em3_o6 0 0 6.0000 22.3837 ECU_ADDRESS 0x7FD7AC /begin FUNCTION_LIST KT_IBS /end FUNCTION_LIST /end MEASUREMENT
/begin MEASUREMENT U3soc0 "Ruhespannung 1" UWORD Def_u_uw_q0p25em3_o6 0 0 6.0000 22.3837 ECU_ADDRESS 0x7FD7AE /begin FUNCTION_LIST KT_IBS /end FUNCTION_LIST /end MEASUREMENT
/begin MEASUREMENT U_batt "Batteriespannung von IBS gemessen" UWORD Def_u_uw_q0p25em3_o6 0 0 6.0000 22.3837 ECU_ADDRESS 0x7FD798 /begin FUNCTION_LIST KT_IBS /end FUNCTION_LIST /end MEASUREMENT
/begin MEASUREMENT U_fgen "Kopierter Wert von zum Generator gesendete Sollspannung Generator 1" UWORD Def_u_uw_q0p1 0 0 0.0 6553.5000 ECU_ADDRESS 0x7FBF18 /begin FUNCTION_LIST LAYER /end FUNCTION_LIST /end MEASUREMENT
/begin MEASUREMENT U_fgen2 "Kopierter Wert von zum Generator gesendete Sollspannung Generator 2" UWORD Def_u_uw_q0p1 0 0 0.0 6553.5000 ECU_ADDRESS 0x7FBF1A /begin FUNCTION_LIST LAYER /end FUNCTION_LIST /end MEASUREMENT
/begin MEASUREMENT U_gen_slp "Spannungsanforderung Sekundärluftpumpe" UWORD Def_u_uw_q0p1 0 0 0.0 6553.5000 ECU_ADDRESS 0x7FBF1C /begin FUNCTION_LIST LAYER /end FUNCTION_LIST /end MEASUREMENT
/begin MEASUREMENT U_gensollm "Generatorsollspannung" SWORD Def_u_sw_b128 0 0 -128.0000 127.9960 ECU_ADDRESS 0x7FD86A /begin FUNCTION_LIST LBATTCAL /end FUNCTION_LIST /end MEASUREMENT
/begin MEASUREMENT U_gensollpm "Sollwert Spannung vom Powermodul" SWORD Def_u_sw_b128 0 0 -128.0000 127.9960 ECU_ADDRESS 0x7FBF20 /begin FUNCTION_LIST LAYER /end FUNCTION_LIST /end MEASUREMENT
/begin MEASUREMENT U_kompk "Zwischengröße" UWORD Def_u_uw_q0p0942 0 0 0.0 6173.3970 ECU_ADDRESS 0x7FD85E /begin FUNCTION_LIST LBATTCAL /end FUNCTION_LIST /end MEASUREMENT
/begin MEASUREMENT U_kompm "Zwischengröße" UWORD Def_u_uw_q0p0942 0 0 0.0 94.2000 ECU_ADDRESS 0x7FD860 /begin FUNCTION_LIST LBATTCAL /end FUNCTION_LIST /end MEASUREMENT
/begin MEASUREMENT U_lade "Zwischengröße" SWORD Def_u_sw_b128 0 0 0.0 127.9960 ECU_ADDRESS 0x7FD85C /begin FUNCTION_LIST LBATTCAL /end FUNCTION_LIST /end MEASUREMENT
/begin MEASUREMENT U_tnstart "Spannung im Start" UWORD Def_u_uw_q0p25em3_o6 0 0 6.0000 22.3837 ECU_ADDRESS 0x7FD7B6 /begin FUNCTION_LIST KT_IBS /end FUNCTION_LIST /end MEASUREMENT
/begin MEASUREMENT U_vorstart "Spannung vor Start" UWORD Def_u_uw_q0p25em3_o6 0 0 6.0000 22.3837 ECU_ADDRESS 0x7FD7B4 /begin FUNCTION_LIST KT_IBS /end FUNCTION_LIST /end MEASUREMENT
/begin MEASUREMENT Ub "Bordnetzspannung" UWORD Def_u_uw_q0p0942 0 0 0.0 6173.3970 ECU_ADDRESS 0x7FBF1E /begin FUNCTION_LIST LAYER /end FUNCTION_LIST /end MEASUREMENT
/begin MEASUREMENT Unind "EBSD Puffer Index" UBYTE Def_dez_ub_q1 0 0 0.0 255.0000 ECU_ADDRESS 0x7FD804 /begin FUNCTION_LIST KT_IBS /end FUNCTION_LIST /end MEASUREMENT
/begin MEASUREMENT Uregnom "Nominalspannung Regler Generator 1" UWORD Def_u_uw_q0p1 0 0 0.0 6553.5000 ECU_ADDRESS 0x7FBF22 /begin FUNCTION_LIST LAYER /end FUNCTION_LIST /end MEASUREMENT
/begin MEASUREMENT Uregnom2 "Nominalspannung Regler Generator 2" UWORD Def_u_uw_q0p1 0 0 0.0 6553.5000 ECU_ADDRESS 0x7FBF24 /begin FUNCTION_LIST LAYER /end FUNCTION_LIST /end MEASUREMENT
/begin MEASUREMENT V "Fahrzeuggeschwindigkeit" UWORD Def_v_uw_q1p0 0 0 0.0 360.0000 ECU_ADDRESS 0x7FBF26 /begin FUNCTION_LIST LAYER /end FUNCTION_LIST /end MEASUREMENT
/begin MEASUREMENT W_ub "Ub von AD-Wandler" UBYTE Def_u_ub_q0p0942 0 0 0.0 24.0210 ECU_ADDRESS 0x7FBF28 /begin FUNCTION_LIST LAYER /end FUNCTION_LIST /end MEASUREMENT
/begin MEASUREMENT Wped "Pedalwertgeberposition" SWORD Def_tv_sw_q0p0244 0 0 -800.0000 799.9755 ECU_ADDRESS 0x7FBF38 /begin FUNCTION_LIST LAYER /end FUNCTION_LIST /end MEASUREMENT
/begin MEASUREMENT Z_mandetek1 "Zähler Mandetek1" UBYTE Def_dez_ub_q1 0 0 0.0 255.0000 ECU_ADDRESS 0x7FDD65 /begin FUNCTION_LIST MANDETEK /end FUNCTION_LIST /end MEASUREMENT
/begin MEASUREMENT Z_mandetek2 "Zähler Mandetek2" UBYTE Def_dez_ub_q1 0 0 0.0 255.0000 ECU_ADDRESS 0x7FDD66 /begin FUNCTION_LIST MANDETEK /end FUNCTION_LIST /end MEASUREMENT
/begin MEASUREMENT Zbibs "Zusbaunummer" ULONG Def_dez_ul_q1 0 0 0.0 2147483647.0000 ECU_ADDRESS 0x7FD7DC /begin FUNCTION_LIST KT_IBS /end FUNCTION_LIST /end MEASUREMENT
/begin MEASUREMENT Zrbosmld "anzuzeigender Zähler für durchgeführten Ölservice" UBYTE Def_dez_ub_q1 0 0 0.0 255.0000 ECU_ADDRESS 0x7FDD75 /begin FUNCTION_LIST OZBG /end FUNCTION_LIST /end MEASUREMENT
/begin MEASUREMENT Zrbosr "Servicezähler vom Kombi" UBYTE Def_dez_ub_q1 0 0 0.0 255.0000 ECU_ADDRESS 0x7FBE94 /begin FUNCTION_LIST LAYER /end FUNCTION_LIST /end MEASUREMENT
/begin MEASUREMENT Zrbosrt "Servicezählerwert vom Tester" UBYTE Def_dez_ub_q1 0 0 0.0 255.0000 ECU_ADDRESS 0x7FBE71 /begin FUNCTION_LIST LAYER /end FUNCTION_LIST /end MEASUREMENT
/begin MEASUREMENT Ztageabs "Tagezähler vom Kombi" UWORD Def_dez_uw_q1 0 0 0.0 65535.0000 ECU_ADDRESS 0x7FBF2A /begin FUNCTION_LIST LAYER /end FUNCTION_LIST /end MEASUREMENT
/begin FUNCTION KT_IBS "KT_IBS" /end FUNCTION
/begin FUNCTION LAYER "LAYER" /end FUNCTION
/begin FUNCTION LBATTCAL "LBATTCAL" /end FUNCTION
/begin FUNCTION LDSTGEN "LDSTGEN" /end FUNCTION
/begin FUNCTION LLPMCTRL "LLPMCTRL" /end FUNCTION
/begin FUNCTION LLRANH "LLRANH" /end FUNCTION
/begin FUNCTION LOADRESP "LOADRESP" /end FUNCTION
/begin FUNCTION MANDETEK "MANDETEK" /end FUNCTION
/begin FUNCTION OZBG "OZBG" /end FUNCTION
/begin FUNCTION OZGG "OZGG" /end FUNCTION
/begin FUNCTION OZLEIT "OZLEIT" /end FUNCTION
/begin FUNCTION OZNIVDL "OZNIVDL" /end FUNCTION
/begin FUNCTION OZPERM "OZPERM" /end FUNCTION
/begin COMPU_METHOD Def_ac_sb_q0p25 "Def_ac_sb_q0p25" RAT_FUNC "%4.1" "-" COEFFS 0 4 0 0 0 1 /end COMPU_METHOD
/begin COMPU_METHOD Def_bit_ub_0 "Def_bit_ub_0" TAB_VERB "%5.2" "-" COMPU_TAB_REF Def_bit_ub_0_VTAB /end COMPU_METHOD
/begin COMPU_METHOD Def_bit_ub_1 "Def_bit_ub_1" TAB_VERB "%5.2" "-" COMPU_TAB_REF Def_bit_ub_1_VTAB /end COMPU_METHOD
/begin COMPU_METHOD Def_bit_ub_2 "Def_bit_ub_2" TAB_VERB "%5.2" "-" COMPU_TAB_REF Def_bit_ub_2_VTAB /end COMPU_METHOD
/begin COMPU_METHOD Def_bit_ub_3 "Def_bit_ub_3" TAB_VERB "%5.2" "-" COMPU_TAB_REF Def_bit_ub_3_VTAB /end COMPU_METHOD
/begin COMPU_METHOD Def_bit_ub_4 "Def_bit_ub_4" TAB_VERB "%5.2" "-" COMPU_TAB_REF Def_bit_ub_4_VTAB /end COMPU_METHOD
/begin COMPU_METHOD Def_bit_ub_5 "Def_bit_ub_5" TAB_VERB "%5.2" "-" COMPU_TAB_REF Def_bit_ub_5_VTAB /end COMPU_METHOD
/begin COMPU_METHOD Def_bit_ub_6 "Def_bit_ub_6" TAB_VERB "%5.2" "-" COMPU_TAB_REF Def_bit_ub_6_VTAB /end COMPU_METHOD
/begin COMPU_METHOD Def_bit_ub_7 "Def_bit_ub_7" TAB_VERB "%5.2" "-" COMPU_TAB_REF Def_bit_ub_7_VTAB /end COMPU_METHOD
/begin COMPU_METHOD Def_bit_uw_0 "Def_bit_uw_0" TAB_VERB "%7.2" "-" COMPU_TAB_REF Def_bit_uw_0_VTAB /end COMPU_METHOD
/begin COMPU_METHOD Def_bit_uw_1 "Def_bit_uw_1" TAB_VERB "%7.2" "-" COMPU_TAB_REF Def_bit_uw_1_VTAB /end COMPU_METHOD
/begin COMPU_METHOD Def_bit_uw_2 "Def_bit_uw_2" TAB_VERB "%7.2" "-" COMPU_TAB_REF Def_bit_uw_2_VTAB /end COMPU_METHOD
/begin COMPU_METHOD Def_bit_uw_3 "Def_bit_uw_3" TAB_VERB "%7.2" "-" COMPU_TAB_REF Def_bit_uw_3_VTAB /end COMPU_METHOD
/begin COMPU_METHOD Def_bit_uw_4 "Def_bit_uw_4" TAB_VERB "%7.2" "-" COMPU_TAB_REF Def_bit_uw_4_VTAB /end COMPU_METHOD
/begin COMPU_METHOD Def_bit_uw_5 "Def_bit_uw_5" TAB_VERB "%7.2" "-" COMPU_TAB_REF Def_bit_uw_5_VTAB /end COMPU_METHOD
/begin COMPU_METHOD Def_bit_uw_6 "Def_bit_uw_6" TAB_VERB "%7.2" "-" COMPU_TAB_REF Def_bit_uw_6_VTAB /end COMPU_METHOD
/begin COMPU_METHOD Def_bit_uw_7 "Def_bit_uw_7" TAB_VERB "%7.2" "-" COMPU_TAB_REF Def_bit_uw_7_VTAB /end COMPU_METHOD
/begin COMPU_METHOD Def_bit_uw_8 "Def_bit_uw_8" TAB_VERB "%7.2" "-" COMPU_TAB_REF Def_bit_uw_8_VTAB /end COMPU_METHOD
/begin COMPU_METHOD Def_dez_sb_q1 "Def_dez_sb_q1" RAT_FUNC "%3.0" "-" COEFFS 0 1 0 0 0 1 /end COMPU_METHOD
/begin COMPU_METHOD Def_dez_sw_q1 "Def_dez_sw_q1" RAT_FUNC "%5.0" "-" COEFFS 0 1 0 0 0 1 /end COMPU_METHOD
/begin COMPU_METHOD Def_dez_ub_q1 "Def_dez_ub_q1" RAT_FUNC "%3.0" "-" COEFFS 0 1 0 0 0 1 /end COMPU_METHOD
/begin COMPU_METHOD Def_dez_ul_q1 "Def_dez_ul_q1" RAT_FUNC "%7.0" "-" COEFFS 0 1 0 0 0 1 /end COMPU_METHOD
/begin COMPU_METHOD Def_dez_uw_q1 "Def_dez_uw_q1" RAT_FUNC "%5.0" "-" COEFFS 0 1 0 0 0 1 /end COMPU_METHOD
/begin COMPU_METHOD Def_dm_sw_q0p1 "Def_dm_sw_q0p1" RAT_FUNC "%7.2" "Nm/s" COEFFS 0 10 0 0 0 1 /end COMPU_METHOD
/begin COMPU_METHOD Def_f_r32 "Def_f_r32" RAT_FUNC "%14.7" "-" COEFFS 0 1 0 0 0 1 /end COMPU_METHOD
/begin COMPU_METHOD Def_f_sw_b1 "Def_f_sw_b1" RAT_FUNC "%14.5" "-" COEFFS 0 65536 0 0 0 2 /end COMPU_METHOD
/begin COMPU_METHOD Def_f_sw_b100 "Def_f_sw_b100" RAT_FUNC "%8.3" "-" COEFFS 0 32768 0 0 0 100 /end COMPU_METHOD
/begin COMPU_METHOD Def_f_sw_b32 "Def_f_sw_b32" RAT_FUNC "%9.4" "-" COEFFS 0 32768 0 0 0 32 /end COMPU_METHOD
/begin COMPU_METHOD Def_f_sw_b64 "Def_f_sw_b64" RAT_FUNC "%8.3" "-" COEFFS 0 65536 0 0 0 128 /end COMPU_METHOD
/begin COMPU_METHOD Def_f_sw_b8 "Def_f_sw_b8" RAT_FUNC "%9.4" "-" COEFFS 0 32768 0 0 0 8 /end COMPU_METHOD
/begin COMPU_METHOD Def_f_ub_b0p25 "Def_f_ub_b0p25" RAT_FUNC "%7.4" "-" COEFFS 0 256 0 0 0 0.25 /end COMPU_METHOD
/begin COMPU_METHOD Def_f_ub_b0p5 "Def_f_ub_b0p5" RAT_FUNC "%6.3" "-" COEFFS 0 256 0 0 0 0.5 /end COMPU_METHOD
/begin COMPU_METHOD Def_f_ub_b1 "Def_f_ub_b1" RAT_FUNC "%6.3" "-" COEFFS 0 256 0 0 0 1 /end COMPU_METHOD
/begin COMPU_METHOD Def_f_ub_b100 "Def_f_ub_b100" RAT_FUNC "%5.2" "%" COEFFS 0 256 0 0 0 100 /end COMPU_METHOD
/begin COMPU_METHOD Def_f_ub_b2 "Def_f_ub_b2" RAT_FUNC "%6.3" "-" COEFFS 0 256 0 0 0 2 /end COMPU_METHOD
/begin COMPU_METHOD Def_f_ub_b32 "Def_f_ub_b32" RAT_FUNC "%5.2" "-" COEFFS 0 256 0 0 0 32 /end COMPU_METHOD
/begin COMPU_METHOD Def_f_ub_b4 "Def_f_ub_b4" RAT_FUNC "%5.2" "-" COEFFS 0 256 0 0 0 4 /end COMPU_METHOD
/begin COMPU_METHOD Def_f_ub_b8 "Def_f_ub_b8" RAT_FUNC "%5.2" "-" COEFFS 0 256 0 0 0 8 /end COMPU_METHOD
/begin COMPU_METHOD Def_f_ul_b262144 "Def_f_ul_b262144" RAT_FUNC "%14.5" "" COEFFS 0 16384 0 0 0 1 /end COMPU_METHOD
/begin COMPU_METHOD Def_f_uw_b1 "Def_f_uw_b1" RAT_FUNC "%14.5" "-" COEFFS 0 65536 0 0 0 1 /end COMPU_METHOD
/begin COMPU_METHOD Def_f_uw_b10 "Def_f_uw_b10" RAT_FUNC "%9.4" "%" COEFFS 0 65536 0 0 0 10 /end COMPU_METHOD
/begin COMPU_METHOD Def_f_uw_b100 "Def_f_uw_b100" RAT_FUNC "%8.3" "%" COEFFS 0 65536 0 0 0 100 /end COMPU_METHOD
/begin COMPU_METHOD Def_f_uw_b16 "Def_f_uw_b16" RAT_FUNC "%9.4" "-" COEFFS 0 65536 0 0 0 16 /end COMPU_METHOD
/begin COMPU_METHOD Def_f_uw_b2 "Def_f_uw_b2" RAT_FUNC "%14.5" "-" COEFFS 0 65536 0 0 0 2 /end COMPU_METHOD
/begin COMPU_METHOD Def_f_uw_b256 "Def_f_uw_b256" RAT_FUNC "%8.3" "-" COEFFS 0 65536 0 0 0 256 /end COMPU_METHOD
/begin COMPU_METHOD Def_f_uw_b32 "Def_f_uw_b32" RAT_FUNC "%9.4" "-" COEFFS 0 65536 0 0 0 32 /end COMPU_METHOD
/begin COMPU_METHOD Def_f_uw_b4 "Def_f_uw_b4" RAT_FUNC "%14.5" "-" COEFFS 0 65536 0 0 0 4 /end COMPU_METHOD
/begin COMPU_METHOD Def_i_sw_q0039 "Def_i_sw_q0039" RAT_FUNC "%8.3" "mA" COEFFS 0 256 0 0 0 1 /end COMPU_METHOD
/begin COMPU_METHOD Def_i_sw_q0p02 "Def_i_sw_q0p02" RAT_FUNC "%8.3" "A" COEFFS 0 50 0 0 0 1 /end COMPU_METHOD
/begin COMPU_METHOD Def_i_sw_q0p0625 "Def_i_sw_q0p0625" RAT_FUNC "%8.3" "A" COEFFS 0 1000 0 0 0 62.5 /end COMPU_METHOD
/begin COMPU_METHOD Def_i_ub_q0p001 "Def_i_ub_q0p001" RAT_FUNC "%6.3" "A" COEFFS 0 1000 0 0 0 1 /end COMPU_METHOD
/begin COMPU_METHOD Def_i_ub_q0p02 "Def_i_ub_q0p02" RAT_FUNC "%5.2" "A" COEFFS 0 50 0 0 0 1 /end COMPU_METHOD
/begin COMPU_METHOD Def_i_ub_q0p04 "Def_i_ub_q0p04" RAT_FUNC "%5.2" "A" COEFFS 0 25 0 0 0 1 /end COMPU_METHOD
/begin COMPU_METHOD Def_i_ub_q0p08 "Def_i_ub_q0p08" RAT_FUNC "%5.2" "A" COEFFS 0 25 0 0 0 2 /end COMPU_METHOD
/begin COMPU_METHOD Def_i_ub_q0p125 "Def_i_ub_q0p125" RAT_FUNC "%6.3" "A" COEFFS 0 8 0 0 0 1 /end COMPU_METHOD
/begin COMPU_METHOD Def_i_ub_q10 "Def_i_ub_q10" RAT_FUNC "%5.2" "A" COEFFS 0 1 0 0 0 10 /end COMPU_METHOD
/begin COMPU_METHOD Def_i_ub_q5p12 "Def_i_ub_q5p12" RAT_FUNC "%5.2" "" COEFFS 0 25 0 0 0 128 /end COMPU_METHOD
/begin COMPU_METHOD Def_i_uw_q0p02 "Def_i_uw_q0p02" RAT_FUNC "%8.3" "A" COEFFS 0 1 0 0 0 0.02 /end COMPU_METHOD
/begin COMPU_METHOD Def_i_uw_q0p02_o200 "Def_i_uw_q0p02_o200" RAT_FUNC "%7.2" "A" COEFFS 0 50 10000 0 0 1 /end COMPU_METHOD
/begin COMPU_METHOD Def_i_uw_q0p08_o200 "Def_i_uw_q0p08_o200" RAT_FUNC "%8.3" "" COEFFS 0 25 5000 0 0 2 /end COMPU_METHOD
/begin COMPU_METHOD Def_km_sw_q10 "Def_km_sw_q10" RAT_FUNC "%6.1" "km" COEFFS 0 1 0 0 0 10 /end COMPU_METHOD
/begin COMPU_METHOD Def_km_ub_q1000 "Def_km_ub_q1000" RAT_FUNC "%3.0" "km" COEFFS 0 1 0 0 0 1000 /end COMPU_METHOD
/begin COMPU_METHOD Def_km_uw_q10 "Def_km_uw_q10" RAT_FUNC "%5.0" "km" COEFFS 0 1 0 0 0 10 /end COMPU_METHOD
/begin COMPU_METHOD Def_lf_ub_q0p01 "Def_lf_ub_q0p01" RAT_FUNC "%5.2" "-" COEFFS 0 100 0 0 0 1 /end COMPU_METHOD
/begin COMPU_METHOD Def_lm_uw_q0p000444 "Def_lm_uw_q0p000444" RAT_FUNC "%9.4" "kg" COEFFS 0 2250 0 0 0 1 /end COMPU_METHOD
/begin COMPU_METHOD Def_m_sw_q0p1 "Def_m_sw_q0p1" RAT_FUNC "%7.2" "Nm" COEFFS 0 10 0 0 0 1 /end COMPU_METHOD
/begin COMPU_METHOD Def_me_sw_q0p01 "Def_me_sw_q0p01" RAT_FUNC "%8.3" "mg/cyc" COEFFS 0 100 0 0 0 1 /end COMPU_METHOD
/begin COMPU_METHOD Def_ml_sw_q0p1 "Def_ml_sw_q0p1" RAT_FUNC "%7.2" "mg/Hub" COEFFS 0 10 0 0 0 1 /end COMPU_METHOD
/begin COMPU_METHOD Def_n_sw_q1p0 "Def_n_sw_q1p0" RAT_FUNC "%5.0" "Upm" COEFFS 0 1 0 0 0 1 /end COMPU_METHOD
/begin COMPU_METHOD Def_niv_sb_b37p5 "Def_niv_sb_b37p5" RAT_FUNC "%5.2" "" COEFFS 0 256 0 0 0 75 /end COMPU_METHOD
/begin COMPU_METHOD Def_niv_ub_b75 "Def_niv_ub_b75" RAT_FUNC "%5.2" "" COEFFS 0 256 0 0 0 75 /end COMPU_METHOD
/begin COMPU_METHOD Def_niv_ub_b8 "Def_niv_ub_b8" RAT_FUNC "%5.2" "" COEFFS 0 256 0 0 0 8 /end COMPU_METHOD
/begin COMPU_METHOD Def_p_sw_q1 "Def_p_sw_q1" RAT_FUNC "%6.1" "hPa" COEFFS 0 1 0 0 0 1 /end COMPU_METHOD
/begin COMPU_METHOD Def_p_uw_q039 "Def_p_uw_q039" RAT_FUNC "%8.3" "hPa" COEFFS 0 256 0 0 0 10 /end COMPU_METHOD
/begin COMPU_METHOD Def_p_uw_q0p039 "Def_p_uw_q0p039" RAT_FUNC "%7.2" "hPa" COEFFS 0 256 0 0 0 10 /end COMPU_METHOD
/begin COMPU_METHOD Def_perm_sw_b6 "Def_perm_sw_b6" RAT_FUNC "%9.4" "-" COEFFS 0 65536 0 0 0 12 /end COMPU_METHOD
/begin COMPU_METHOD Def_perm_uw_b6 "Def_perm_uw_b6" RAT_FUNC "%14.5" "-" COEFFS 0 65536 0 0 0 6 /end COMPU_METHOD
/begin COMPU_METHOD Def_ql_uw_q0p0182 "Def_ql_uw_q0p0182" RAT_FUNC "%8.3" "Ah" COEFFS 0 989 0 0 0 18 /end COMPU_METHOD
/begin COMPU_METHOD Def_rf_sw_q0p01 "Def_rf_sw_q0p01" RAT_FUNC "%9.4" "%" COEFFS 0 100 0 0 0 1 /end COMPU_METHOD
/begin COMPU_METHOD Def_st_ub_q1 "Def_st_ub_q1" RAT_FUNC "%3.0" "-" COEFFS 0 1 0 0 0 1 /end COMPU_METHOD
/begin COMPU_METHOD Def_st_uw_q1 "Def_st_uw_q1" RAT_FUNC "%5.0" "-" COEFFS 0 1 0 0 0 1 /end COMPU_METHOD
/begin COMPU_METHOD Def_t_sw_q0p01 "Def_t_sw_q0p01" RAT_FUNC "%7.2" "°C" COEFFS 0 100 0 0 0 1 /end COMPU_METHOD
/begin COMPU_METHOD Def_t_sw_q0p1 "Def_t_sw_q0p1" RAT_FUNC "%6.1" "°C" COEFFS 0 10 0 0 0 1 /end COMPU_METHOD
/begin COMPU_METHOD Def_td_ub_q0p002_o01 "Def_td_ub_q0p002_o01" RAT_FUNC "%6.3" "s" COEFFS 0 -1 0.01 0 0 -0.002 /end COMPU_METHOD
/begin COMPU_METHOD Def_td_ub_q0p00625 "Def_td_ub_q0p00625" RAT_FUNC "%7.4" "s" COEFFS 0 160 0 0 0 1 /end COMPU_METHOD
/begin COMPU_METHOD Def_td_ub_q0p01 "Def_td_ub_q0p01" RAT_FUNC "%5.2" "s" COEFFS 0 100 0 0 0 1 /end COMPU_METHOD
/begin COMPU_METHOD Def_td_ub_q0p0125 "Def_td_ub_q0p0125" RAT_FUNC "%5.2" "s" COEFFS 0 80 0 0 0 1 /end COMPU_METHOD
/begin COMPU_METHOD Def_td_ub_q0p05 "Def_td_ub_q0p05" RAT_FUNC "%5.2" "s" COEFFS 0 20 0 0 0 1 /end COMPU_METHOD
/begin COMPU_METHOD Def_td_ub_q0p1 "Def_td_ub_q0p1" RAT_FUNC "%4.1" "s" COEFFS 0 10 0 0 0 1 /end COMPU_METHOD
/begin COMPU_METHOD Def_td_ub_q0p5 "Def_td_ub_q0p5" RAT_FUNC "%6.3" "s" COEFFS 0 2 0 0 0 1 /end COMPU_METHOD
/begin COMPU_METHOD Def_td_ub_q1 "Def_td_ub_q1" RAT_FUNC "%5.2" "s" COEFFS 0 1 0 0 0 1 /end COMPU_METHOD
/begin COMPU_METHOD Def_td_ub_q16 "Def_td_ub_q16" RAT_FUNC "%5.2" "s" COEFFS 0 1 0 0 0 16 /end COMPU_METHOD
/begin COMPU_METHOD Def_td_ub_q256 "Def_td_ub_q256" RAT_FUNC "%5.2" "s" COEFFS 0 1 0 0 0 256 /end COMPU_METHOD
/begin COMPU_METHOD Def_td_uw_q0p01 "Def_td_uw_q0p01" RAT_FUNC "%7.2" "s" COEFFS 0 100 0 0 0 1 /end COMPU_METHOD
/begin COMPU_METHOD Def_td_uw_q0p05 "Def_td_uw_q0p05" RAT_FUNC "%7.2" "s" COEFFS 0 20 0 0 0 1 /end COMPU_METHOD
/begin COMPU_METHOD Def_td_uw_q0p1 "Def_td_uw_q0p1" RAT_FUNC "%6.1" "s" COEFFS 0 10 0 0 0 1 /end COMPU_METHOD
/begin COMPU_METHOD Def_td_uw_q1 "Def_td_uw_q1" RAT_FUNC "%5.0" "s" COEFFS 0 1 0 0 0 1 /end COMPU_METHOD
/begin COMPU_METHOD Def_tv_sw_q0p01 "Def_tv_sw_q0p01" RAT_FUNC "%8.3" "%" COEFFS 0 100 0 0 0 1 /end COMPU_METHOD
/begin COMPU_METHOD Def_tv_sw_q0p0244 "Def_tv_sw_q0p0244" RAT_FUNC "%7.2" "%" COEFFS 0 4096 0 0 0 100 /end COMPU_METHOD
/begin COMPU_METHOD Def_tv_ub_q0p390625 "Def_tv_ub_q0p390625" RAT_FUNC "%5.2" "%" COEFFS 0 256 0 0 0 100 /end COMPU_METHOD
/begin COMPU_METHOD Def_u_sw_b128 "Def_u_sw_b128" RAT_FUNC "%8.3" "V" COEFFS 0 256 0 0 0 1 /end COMPU_METHOD
/begin COMPU_METHOD Def_u_ub_q0p0196 "Def_u_ub_q0p0196" RAT_FUNC "%7.4" "V" COEFFS 0 1 0 0 0 0.0196 /end COMPU_METHOD
/begin COMPU_METHOD Def_u_ub_q0p064_o6 "Def_u_ub_q0p064_o6" RAT_FUNC "%5.2" "V" COEFFS 0 -125 750 0 0 -8 /end COMPU_METHOD
/begin COMPU_METHOD Def_u_ub_q0p0942 "Def_u_ub_q0p0942" RAT_FUNC "%7.4" "V" COEFFS 0 1 0 0 0 0.0942 /end COMPU_METHOD
/begin COMPU_METHOD Def_u_uw_q0p0942 "Def_u_uw_q0p0942" RAT_FUNC "%6.1" "V" COEFFS 0 1 0 0 0 0.0942 /end COMPU_METHOD
/begin COMPU_METHOD Def_u_uw_q0p1 "Def_u_uw_q0p1" RAT_FUNC "%8.3" "V" COEFFS 0 10 0 0 0 1 /end COMPU_METHOD
/begin COMPU_METHOD Def_u_uw_q0p25em3_o6 "Def_u_uw_q0p25em3_o6" RAT_FUNC "%9.4" "" COEFFS 0 -4000 24000 0 0 -1 /end COMPU_METHOD
/begin COMPU_METHOD Def_v_uw_q1p0 "Def_v_uw_q1p0" RAT_FUNC "%5.0" "km/h" COEFFS 0 1 0 0 0 1 /end COMPU_METHOD
/begin COMPU_METHOD Def_wdk_sw_q0p0244 "Def_wdk_sw_q0p0244" RAT_FUNC "%7.2" "%" COEFFS 0 4096 0 0 0 100 /end COMPU_METHOD
/begin COMPU_METHOD Identity "Identity" RAT_FUNC "%4.1" "-" COEFFS 0 1 0 0 0 1 /end COMPU_METHOD
/begin COMPU_METHOD ident "ident" RAT_FUNC "%4.1" "-" COEFFS 0 1 0 0 0 1 /end COMPU_METHOD
/begin COMPU_VTAB Def_bit_ub_0_VTAB "Def_bit_ub_0_VTAB" TAB_VERB 2 0 "FALSE" 1 "TRUE" /end COMPU_VTAB
/begin COMPU_VTAB Def_bit_ub_1_VTAB "Def_bit_ub_1_VTAB" TAB_VERB 2 0 "FALSE" 1 "TRUE" /end COMPU_VTAB
/begin COMPU_VTAB Def_bit_ub_2_VTAB "Def_bit_ub_2_VTAB" TAB_VERB 2 0 "FALSE" 1 "TRUE" /end COMPU_VTAB
/begin COMPU_VTAB Def_bit_ub_3_VTAB "Def_bit_ub_3_VTAB" TAB_VERB 2 0 "FALSE" 1 "TRUE" /end COMPU_VTAB
/begin COMPU_VTAB Def_bit_ub_4_VTAB "Def_bit_ub_4_VTAB" TAB_VERB 2 0 "FALSE" 1 "TRUE" /end COMPU_VTAB
/begin COMPU_VTAB Def_bit_ub_5_VTAB "Def_bit_ub_5_VTAB" TAB_VERB 2 0 "FALSE" 1 "TRUE" /end COMPU_VTAB
/begin COMPU_VTAB Def_bit_ub_6_VTAB "Def_bit_ub_6_VTAB" TAB_VERB 2 0 "FALSE" 1 "TRUE" /end COMPU_VTAB
/begin COMPU_VTAB Def_bit_ub_7_VTAB "Def_bit_ub_7_VTAB" TAB_VERB 2 0 "FALSE" 1 "TRUE" /end COMPU_VTAB
/begin COMPU_VTAB Def_bit_uw_0_VTAB "Def_bit_uw_0_VTAB" TAB_VERB 2 0 "FALSE" 1 "TRUE" /end COMPU_VTAB
/begin COMPU_VTAB Def_bit_uw_1_VTAB "Def_bit_uw_1_VTAB" TAB_VERB 2 0 "FALSE" 1 "TRUE" /end COMPU_VTAB
/begin COMPU_VTAB Def_bit_uw_2_VTAB "Def_bit_uw_2_VTAB" TAB_VERB 2 0 "FALSE" 1 "TRUE" /end COMPU_VTAB
/begin COMPU_VTAB Def_bit_uw_3_VTAB "Def_bit_uw_3_VTAB" TAB_VERB 2 0 "FALSE" 1 "TRUE" /end COMPU_VTAB
/begin COMPU_VTAB Def_bit_uw_4_VTAB "Def_bit_uw_4_VTAB" TAB_VERB 2 0 "FALSE" 1 "TRUE" /end COMPU_VTAB
/begin COMPU_VTAB Def_bit_uw_5_VTAB "Def_bit_uw_5_VTAB" TAB_VERB 2 0 "FALSE" 1 "TRUE" /end COMPU_VTAB
/begin COMPU_VTAB Def_bit_uw_6_VTAB "Def_bit_uw_6_VTAB" TAB_VERB 2 0 "FALSE" 1 "TRUE" /end COMPU_VTAB
/begin COMPU_VTAB Def_bit_uw_7_VTAB "Def_bit_uw_7_VTAB" TAB_VERB 2 0 "FALSE" 1 "TRUE" /end COMPU_VTAB
/begin COMPU_VTAB Def_bit_uw_8_VTAB "Def_bit_uw_8_VTAB" TAB_VERB 2 0 "FALSE" 1 "TRUE" /end COMPU_VTAB
/begin RECORD_LAYOUT TKF_SW_SW_UB NO_AXIS_PTS_X 1 UBYTE NO_AXIS_PTS_Y 2 UBYTE AXIS_PTS_X 3 SWORD INDEX_INCR DIRECT AXIS_PTS_Y 4 SWORD INDEX_INCR DIRECT FNC_VALUES 5 UBYTE COLUMN_DIR DIRECT /end RECORD_LAYOUT
/begin RECORD_LAYOUT TKF_UW_SW_UB NO_AXIS_PTS_X 1 UBYTE NO_AXIS_PTS_Y 2 UBYTE AXIS_PTS_X 3 SWORD INDEX_INCR DIRECT AXIS_PTS_Y 4 UWORD INDEX_INCR DIRECT FNC_VALUES 5 UBYTE COLUMN_DIR DIRECT /end RECORD_LAYOUT
/begin RECORD_LAYOUT TKF_UW_UW_UW NO_AXIS_PTS_X 1 UBYTE NO_AXIS_PTS_Y 2 UBYTE AXIS_PTS_X 3 UWORD INDEX_INCR DIRECT AXIS_PTS_Y 4 UWORD INDEX_INCR DIRECT FNC_VALUES 5 UWORD COLUMN_DIR DIRECT /end RECORD_LAYOUT
/begin RECORD_LAYOUT TKL_SW_VV_SB NO_AXIS_PTS_X 1 UBYTE RESERVED 2 BYTE AXIS_PTS_X 3 SWORD INDEX_INCR DIRECT FNC_VALUES 4 SBYTE COLUMN_DIR DIRECT /end RECORD_LAYOUT
/begin RECORD_LAYOUT TKL_SW_VV_SW NO_AXIS_PTS_X 1 UBYTE RESERVED 2 BYTE AXIS_PTS_X 3 SWORD INDEX_INCR DIRECT FNC_VALUES 4 SWORD COLUMN_DIR DIRECT /end RECORD_LAYOUT
/begin RECORD_LAYOUT TKL_SW_VV_UB NO_AXIS_PTS_X 1 UBYTE RESERVED 2 BYTE AXIS_PTS_X 3 SWORD INDEX_INCR DIRECT FNC_VALUES 4 UBYTE COLUMN_DIR DIRECT /end RECORD_LAYOUT
/begin RECORD_LAYOUT TKL_UW_VV_SW NO_AXIS_PTS_X 1 UBYTE RESERVED 2 BYTE AXIS_PTS_X 3 UWORD INDEX_INCR DIRECT FNC_VALUES 4 SWORD COLUMN_DIR DIRECT /end RECORD_LAYOUT
/begin RECORD_LAYOUT TKL_UW_VV_UW NO_AXIS_PTS_X 1 UBYTE RESERVED 2 BYTE AXIS_PTS_X 3 UWORD INDEX_INCR DIRECT FNC_VALUES 4 UWORD COLUMN_DIR DIRECT /end RECORD_LAYOUT
/begin RECORD_LAYOUT TKW_VV_VV_SB FNC_VALUES 1 SBYTE COLUMN_DIR DIRECT /end RECORD_LAYOUT
/begin RECORD_LAYOUT TKW_VV_VV_SW FNC_VALUES 1 SWORD COLUMN_DIR DIRECT /end RECORD_LAYOUT
/begin RECORD_LAYOUT TKW_VV_VV_UB FNC_VALUES 1 UBYTE COLUMN_DIR DIRECT /end RECORD_LAYOUT
/begin RECORD_LAYOUT TKW_VV_VV_UL FNC_VALUES 1 ULONG COLUMN_DIR DIRECT /end RECORD_LAYOUT
/begin RECORD_LAYOUT TKW_VV_VV_UW FNC_VALUES 1 UWORD COLUMN_DIR DIRECT /end RECORD_LAYOUT
/end MODULE
/end PROJECT
