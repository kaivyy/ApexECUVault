ASAP2_VERSION 1 30
/begin PROJECT MSS65-inj "Generiert am 14.10.05 um 11:34:36"
/begin HEADER "" VERSION "R341" /end HEADER
/begin MODULE _MSS65-inj "Generiert am 14.10.05 um 11:34:36"
/begin MOD_COMMON "" BYTE_ORDER MSB_FIRST ALIGNMENT_BYTE 1 ALIGNMENT_WORD 2 ALIGNMENT_LONG 4 ALIGNMENT_FLOAT32_IEEE 4 ALIGNMENT_FLOAT64_IEEE 8 /end MOD_COMMON
/begin CHARACTERISTIC K_BNS_CTRINC "bnsctr inkrement" VALUE 0x75AB9 TKW_VV_VV_UB 100.0 FORMULA_0003 0.0 255.0 /end CHARACTERISTIC
/begin CHARACTERISTIC K_BNS_SCHW1 "BN Instabilitätsschwelle 1" VALUE 0x75ABA TKW_VV_VV_UB 100.0 FORMULA_0003 0.0 255.0 /end CHARACTERISTIC
/begin CHARACTERISTIC K_BNS_UBMAX "BN Spg. max. Schwelle" VALUE 0x75ABB TKW_VV_VV_UB 100.0 FORMULA_0490 0.0 24.02099990844727 /end CHARACTERISTIC
/begin CHARACTERISTIC K_BNS_UBMIN "BN Spg. untere Schwelle" VALUE 0x75ABC TKW_VV_VV_UB 100.0 FORMULA_0490 0.0 24.02099990844727 /end CHARACTERISTIC
/begin CHARACTERISTIC K_BNS_VFZG "Schwelle Geschwindigkeit fuer BNS" VALUE 0x75AB6 TKW_VV_VV_UW 100.0 FORMULA_0474 0.0 65535.0 /end CHARACTERISTIC
/begin CHARACTERISTIC K_BNSMAX "Bordnetz Instabil Schwelle" VALUE 0x75AB8 TKW_VV_VV_UB 100.0 FORMULA_0003 0.0 255.0 /end CHARACTERISTIC
/begin CHARACTERISTIC K_CW_OZ "" VALUE 0x7540C TKW_VV_VV_UW 100.0 FORMULA_0010 0.0 65535.0 /end CHARACTERISTIC
/begin CHARACTERISTIC K_CW_OZ_2 "" VALUE 0x753A0 TKW_VV_VV_UW 100.0 FORMULA_0010 0.0 65535.0 /end CHARACTERISTIC
/begin CHARACTERISTIC K_DTOG_UBMIN "" VALUE 0x70882 TKW_VV_VV_UW 100.0 FORMULA_0432 0.0 6173.39697265625 FORMAT "%4.1" /end CHARACTERISTIC
/begin CHARACTERISTIC K_GENMXGRADH "Maximal zulässiger Gradient Chiptemperatur" VALUE 0x75732 TKW_VV_VV_SW 100.0 FORMULA_0431 -3276.800048828125 3276.699951171875 /end CHARACTERISTIC
/begin CHARACTERISTIC K_HTGENDFGRO "Schwelle Generaorauslastung zur E-Lüfteranforderung" VALUE 0x75744 TKW_VV_VV_UB 100.0 FORMULA_0003 0.0 255.0 /end CHARACTERISTIC
/begin CHARACTERISTIC K_I_VERTEIL "Stromverteilung" VALUE 0x75745 TKW_VV_VV_UB 100.0 FORMULA_0465 1.569999940693378e-002 3.984299898147583 /end CHARACTERISTIC
/begin CHARACTERISTIC K_KAT_OBD_CFG "Freigabe KAT-Diagnose" VALUE 0x74FA6 TKW_VV_VV_UW 100.0 FORMULA_0799 0.0 1.0 FORMAT "%5.2" /end CHARACTERISTIC
/begin CHARACTERISTIC K_KAT_OBD_LANK_MW_DELTA_MAX "max. Diff d. akt. Wertes zum MW" VALUE 0x74FAE TKW_VV_VV_UW 100.0 FORMULA_0025 0.0 3.999000072479248 FORMAT "%6.3" /end CHARACTERISTIC
/begin CHARACTERISTIC K_KAT_OBD_LANK_MW_DIFF_MAX "max. Diff d. MW zum vorherigen Zyklus" VALUE 0x74FB0 TKW_VV_VV_UW 100.0 FORMULA_0025 0.0 3.999000072479248 FORMAT "%6.3" /end CHARACTERISTIC
/begin CHARACTERISTIC K_KAT_OBD_LANK_MW_HYS_CHK1 "Hys. um kat_obd_lank_mw f. Verifikation CHK1" VALUE 0x74FF4 TKW_VV_VV_UW 100.0 FORMULA_0025 0.0 9.999999776482582e-003 FORMAT "%6.3" /end CHARACTERISTIC
/begin CHARACTERISTIC K_KAT_OBD_LANK_MW_MAX "max. Mittelwert LAM-NKAT" VALUE 0x74FAA TKW_VV_VV_UW 100.0 FORMULA_0025 0.0 3.999000072479248 FORMAT "%6.3" /end CHARACTERISTIC
/begin CHARACTERISTIC K_KAT_OBD_LANK_MW_MIN "min. Mittelwert LAM-NKAT" VALUE 0x74FAC TKW_VV_VV_UW 100.0 FORMULA_0025 0.0 3.999000072479248 FORMAT "%6.3" /end CHARACTERISTIC
/begin CHARACTERISTIC K_KAT_OBD_M_HUB_CNT "min. Anzahl - Zwangsanregung" VALUE 0x74FA8 TKW_VV_VV_UW 100.0 FORMULA_0010 0.0 65535.0 /end CHARACTERISTIC
/begin CHARACTERISTIC K_KAT_OBD_VERH "Schwelle f. Wichtungsverhaeltnis - Diag.Wert" VALUE 0x74FB4 TKW_VV_VV_UW 100.0 FORMULA_0073 0.0 20.0 FORMAT "%6.3" /end CHARACTERISTIC
/begin CHARACTERISTIC K_KAT_OBD_VERH_SCHWELLE "max. Schelle f. Anzahl d. verworfenen Messungen" VALUE 0x74FB6 TKW_VV_VV_UW 100.0 FORMULA_0010 0.0 65535.0 /end CHARACTERISTIC
/begin CHARACTERISTIC K_KAT_OBD_WERT_MODE6 "max. KAT-Diag.-Schwelle fuer MODE6" VALUE 0x74FB8 TKW_VV_VV_UW 100.0 FORMULA_0025 0.0 3.999000072479248 FORMAT "%6.3" /end CHARACTERISTIC
/begin CHARACTERISTIC K_KAT_OBD_ZYKL_CNT_MAX "max. Anzahl fuer Diag.Zyklus" VALUE 0x74FB2 TKW_VV_VV_UW 100.0 FORMULA_0010 0.0 65535.0 /end CHARACTERISTIC
/begin CHARACTERISTIC K_LAVK_OBD_DXN_KAT_EXD_LAM_SOLL "LAM-SOLL-OFFSET - zusaetzliche Anfettung/Abmagerung" VALUE 0x74FE2 TKW_VV_VV_SW 100.0 FORMULA_0025 -0.1000000014901161 0.1000000014901161 FORMAT "%6.3" /end CHARACTERISTIC
/begin CHARACTERISTIC K_LAVK_OBD_DYN_AMPL_CNT "Anzahl gueltiger Perioden f. MW" VALUE 0x74FD0 TKW_VV_VV_UW 100.0 FORMULA_0010 1.0 65535.0 /end CHARACTERISTIC
/begin CHARACTERISTIC K_LAVK_OBD_DYN_AMPL_MAX "Offset fuer max. Amplitude" VALUE 0x74FCC TKW_VV_VV_UW 100.0 FORMULA_0025 0.0 1.0 FORMAT "%6.3" /end CHARACTERISTIC
/begin CHARACTERISTIC K_LAVK_OBD_DYN_AMPL_MIN "Offset fuer min. Amplitude" VALUE 0x74FCE TKW_VV_VV_UW 100.0 FORMULA_0025 0.0 1.0 FORMAT "%6.3" /end CHARACTERISTIC
/begin CHARACTERISTIC K_LAVK_OBD_DYN_CFG "Freigabe dynamische Sonden-VKAT-Diagnose" VALUE 0x74FC4 TKW_VV_VV_UW 100.0 FORMULA_0799 0.0 1.0 FORMAT "%5.2" /end CHARACTERISTIC
/begin CHARACTERISTIC K_LAVK_OBD_DYN_KAT_EXD_N_SOLL "Prueflauf - angeforderte Drehzahl" VALUE 0x74FDA TKW_VV_VV_SW 100.0 FORMULA_0006 0.0 10000.0 /end CHARACTERISTIC
/begin CHARACTERISTIC K_LAVK_OBD_DYN_KAT_EXD_RF_MAX "max. relative Füllung fuer Ansteuerung dyn. Diag. u. KAT-Diag." VALUE 0x74FDE TKW_VV_VV_SW 100.0 FORMULA_0007 0.0 2.0 FORMAT "%6.3" /end CHARACTERISTIC
/begin CHARACTERISTIC K_LAVK_OBD_DYN_KAT_EXD_RF_MIN "min. relative Füllung fuer Ansteuerung dyn. Diag. u. KAT-Diag." VALUE 0x74FE0 TKW_VV_VV_SW 100.0 FORMULA_0007 0.0 2.0 FORMAT "%6.3" /end CHARACTERISTIC
/begin CHARACTERISTIC K_LAVK_OBD_DYN_KAT_EXD_T "Prueflauf Freigabezeit" VALUE 0x74FDC TKW_VV_VV_UW 100.0 FORMULA_0921 0.0 655.3499755859375 /end CHARACTERISTIC
/begin CHARACTERISTIC K_LAVK_OBD_DYN_LAM_REG_MAX "max. Regelabweichung bei dyn. LA-Diagnose" VALUE 0x74FD6 TKW_VV_VV_UW 100.0 FORMULA_0024 0.0 1.998999953269959 FORMAT "%7.4" /end CHARACTERISTIC
/begin CHARACTERISTIC K_LAVK_OBD_DYN_LAM_REG_MIN "min. Regelabweichung bei dyn. LA-Diagnose" VALUE 0x74FD4 TKW_VV_VV_UW 100.0 FORMULA_0024 0.0 1.998999953269959 FORMAT "%7.4" /end CHARACTERISTIC
/begin CHARACTERISTIC K_LAVK_OBD_DYN_MW_HYS "Delta f. min/max LA-Regeleingriff-Ermittlung" VALUE 0x74FC6 TKW_VV_VV_UW 100.0 FORMULA_0025 0.0 1.990000009536743 FORMAT "%6.3" /end CHARACTERISTIC
/begin CHARACTERISTIC K_LAVK_OBD_DYN_MW_MAX "max. LAM-IST-Toleranzschwelle" VALUE 0x74FC8 TKW_VV_VV_UW 100.0 FORMULA_0025 0.0 3.999000072479248 FORMAT "%6.3" /end CHARACTERISTIC
/begin CHARACTERISTIC K_LAVK_OBD_DYN_MW_MIN "min. LAM-IST-Toleranzschwelle" VALUE 0x74FCA TKW_VV_VV_UW 100.0 FORMULA_0025 0.0 3.999000072479248 FORMAT "%6.3" /end CHARACTERISTIC
/begin CHARACTERISTIC K_LAVK_OBD_DYN_NORM_CNT "Anzahl gueltiger MW f. Diagnosewert" VALUE 0x74FD2 TKW_VV_VV_UW 100.0 FORMULA_0010 1.0 65535.0 /end CHARACTERISTIC
/begin CHARACTERISTIC K_LAVK_OBD_DYN_TE_VOL_SUM "min. TE-Volumenstrom in Motorlauf" VALUE 0x74FF2 TKW_VV_VV_UW 100.0 FORMULA_1023 0.0 2184.5 FORMAT "%5.2" /end CHARACTERISTIC
/begin CHARACTERISTIC K_LAVK_OBD_DYN_WERT_MODE6 "Diagnoseschwelle fuer MODE6" VALUE 0x74FF0 TKW_VV_VV_UW 100.0 FORMULA_0025 0.0 3.999000072479248 FORMAT "%6.3" /end CHARACTERISTIC
/begin CHARACTERISTIC K_NACHFUELL12 "Nachfüll Erste Balken von Peistab" VALUE 0x7545A TKW_VV_VV_UB 100.0 FORMULA_0003 0.0 255.0 /end CHARACTERISTIC
/begin CHARACTERISTIC K_NACHFUELL25 "Nachfüll Zweite Balken von Peistab" VALUE 0x7545B TKW_VV_VV_UB 100.0 FORMULA_0003 0.0 255.0 /end CHARACTERISTIC
/begin CHARACTERISTIC K_NACHFUELL38 "Nachfüll Dritte Balken von Peistab" VALUE 0x7545C TKW_VV_VV_UB 100.0 FORMULA_0003 0.0 255.0 /end CHARACTERISTIC
/begin CHARACTERISTIC K_NACHFUELL53 "Nachfüll Vierte Balken von Peistab" VALUE 0x7545D TKW_VV_VV_UB 100.0 FORMULA_0003 0.0 255.0 /end CHARACTERISTIC
/begin CHARACTERISTIC K_NACHFUELL69 "Nachfüll Fünfte Balken von Peistab" VALUE 0x7545E TKW_VV_VV_UB 100.0 FORMULA_0003 0.0 255.0 /end CHARACTERISTIC
/begin CHARACTERISTIC K_NACHFUELL85 "Nachfüll Sechte Balken von Peistab" VALUE 0x7545F TKW_VV_VV_UB 100.0 FORMULA_0003 0.0 255.0 /end CHARACTERISTIC
/begin CHARACTERISTIC K_NACHFUELL95 "Nachfüll Siebte Balken von Peistab" VALUE 0x75460 TKW_VV_VV_UB 100.0 FORMULA_0003 0.0 255.0 /end CHARACTERISTIC
/begin CHARACTERISTIC K_NGENHTMN1 "Untere Drehzahlschwelle für kritischen Bereich Didentemparatur" VALUE 0x75734 TKW_VV_VV_SW 100.0 FORMULA_0006 0.0 32767.0 /end CHARACTERISTIC
/begin CHARACTERISTIC K_NGENHTMX1 "Obere Drehzahlschwelle für kritischen Bereich Didentemparatur" VALUE 0x75736 TKW_VV_VV_SW 100.0 FORMULA_0006 0.0 32767.0 /end CHARACTERISTIC
/begin CHARACTERISTIC K_O2_LA_TRIM_CFG "Verknuepfung mit Trimmregelung" VALUE 0x74F88 TKW_VV_VV_UW 100.0 FORMULA_1021 0.0 1.0 FORMAT "%5.2" /end CHARACTERISTIC
/begin CHARACTERISTIC K_O2_OBD_CFG "Freigabe O2-Beladung" VALUE 0x74F86 TKW_VV_VV_UW 100.0 FORMULA_0799 0.0 1.0 FORMAT "%5.2" /end CHARACTERISTIC
/begin CHARACTERISTIC K_O2_OBD_DYN_CNT_INC "Counter increments fuer rf_dyn_o2_cnt" VALUE 0x74FEA TKW_VV_VV_UB 100.0 FORMULA_0037 0.0 255.0 /end CHARACTERISTIC
/begin CHARACTERISTIC K_O2_OBD_DYN_DELTA_CNT "Anzahl der dyn Triggers bis status gesetzt wird" VALUE 0x74FE8 TKW_VV_VV_UW 100.0 FORMULA_0080 0.0 65535.0 FORMAT "%5.2" /end CHARACTERISTIC
/begin CHARACTERISTIC K_O2_OBD_DYN_DELTA_PUMP_RF "rf Differnez fuer Dynamikerkennung gegen Pumpen" VALUE 0x74FE6 TKW_VV_VV_SW 100.0 FORMULA_0007 0.0 2.0 FORMAT "%6.3" /end CHARACTERISTIC
/begin CHARACTERISTIC K_O2_OBD_DYN_DELTA_RF "rf Differnez fuer Dynamikerkennung" VALUE 0x74FE4 TKW_VV_VV_SW 100.0 FORMULA_0007 0.0 2.0 FORMAT "%6.3" /end CHARACTERISTIC
/begin CHARACTERISTIC K_O2_OBD_DYN_RF_T "Sperrzeit fuer Ruecknahme rf-Dynamik" VALUE 0x74FEC TKW_VV_VV_UW 100.0 FORMULA_0021 0.0 655.3499755859375 FORMAT "%5.2" /end CHARACTERISTIC
/begin CHARACTERISTIC K_O2_OBD_DYN_T_VERZ "Verzoegerungszeit bei Dynamik" VALUE 0x74F9C TKW_VV_VV_UW 100.0 FORMULA_1022 0.0 65.53500366210938 FORMAT "%5.2" /end CHARACTERISTIC
/begin CHARACTERISTIC K_O2_OBD_LAM_SOLL_OFFS "LAM-SOLL-OFFSET - zusaetzliche Anfettung/Abmagerung" VALUE 0x74FA4 TKW_VV_VV_SW 100.0 FORMULA_0025 -9.999999776482582e-003 9.999999776482582e-003 FORMAT "%6.3" /end CHARACTERISTIC
/begin CHARACTERISTIC K_O2_OBD_LAVK_AD_OFFS_MAX "max. OFFEST-Sonden-Adapt fuer Pulsfreigabe" VALUE 0x74FA0 TKW_VV_VV_SW 100.0 FORMULA_0536 -5000.0 5000.0 /end CHARACTERISTIC
/begin CHARACTERISTIC K_O2_OBD_LAVK_AD_OFFS_MIN "min. OFFEST-Sonden-Adapt. fuer Pulsfreigabe" VALUE 0x74FA2 TKW_VV_VV_SW 100.0 FORMULA_0536 -5000.0 5000.0 /end CHARACTERISTIC
/begin CHARACTERISTIC K_O2_OBD_ML_MIN "min. aufsummierte Luftmassenstr. nach SA_WE" VALUE 0x74FBA TKW_VV_VV_UW 100.0 FORMULA_0792 0.0 65535.0 /end CHARACTERISTIC
/begin CHARACTERISTIC K_O2_OBD_N_MAX "max. Drehzahl f. O2-Beladung" VALUE 0x74F96 TKW_VV_VV_SW 100.0 FORMULA_0006 0.0 10000.0 /end CHARACTERISTIC
/begin CHARACTERISTIC K_O2_OBD_N_MIN "min. Drehzahl f. O2-Beladung" VALUE 0x74F98 TKW_VV_VV_SW 100.0 FORMULA_0006 0.0 10000.0 /end CHARACTERISTIC
/begin CHARACTERISTIC K_O2_OBD_PUMG_MIN "min. Umgebungsdruck" VALUE 0x74F9E TKW_VV_VV_SW 100.0 FORMULA_0075 400.0 1200.0 FORMAT "%4.1" /end CHARACTERISTIC
/begin CHARACTERISTIC K_O2_OBD_RF_MAX "max. relative Füllung f. O2-Beladung" VALUE 0x74F8C TKW_VV_VV_SW 100.0 FORMULA_0007 0.0 2.0 FORMAT "%6.3" /end CHARACTERISTIC
/begin CHARACTERISTIC K_O2_OBD_RF_MIN_HYS "Hysterese f.die min. RF-Schwelle" VALUE 0x74F8E TKW_VV_VV_SW 100.0 FORMULA_0007 0.0 2.0 FORMAT "%6.3" /end CHARACTERISTIC
/begin CHARACTERISTIC K_O2_OBD_RF_T_MIN "Verzoegerungszeit bei RF-MIN-Unterschreitung" VALUE 0x74F9A TKW_VV_VV_UW 100.0 FORMULA_1022 0.0 65.53500366210938 FORMAT "%5.2" /end CHARACTERISTIC
/begin CHARACTERISTIC K_O2_OBD_SA_ML_MAX "max. aufsummierte Luftmassenstr. in SA" VALUE 0x74FBC TKW_VV_VV_UW 100.0 FORMULA_0792 0.0 65535.0 /end CHARACTERISTIC
/begin CHARACTERISTIC K_O2_OBD_T_ML "Verzoegerungszeit - O2-Beladung" VALUE 0x74FD8 TKW_VV_VV_UW 100.0 FORMULA_0800 0.0 65535.0 /end CHARACTERISTIC
/begin CHARACTERISTIC K_O2_OBD_TEV_MAX "max. Konzentration aus AKF" VALUE 0x74FEE TKW_VV_VV_UW 100.0 FORMULA_0199 0.0 2.0 FORMAT "%7.4" /end CHARACTERISTIC
/begin CHARACTERISTIC K_O2_OBD_TKAT_HYS "min. KAT-Temperatur f. O2-Beladung" VALUE 0x74F92 TKW_VV_VV_SW 100.0 FORMULA_0801 -1000.0 1000.0 FORMAT "%4.1" /end CHARACTERISTIC
/begin CHARACTERISTIC K_O2_OBD_TKAT_MAX "max. KAT-Temperatur f. O2-Beladung" VALUE 0x74F94 TKW_VV_VV_SW 100.0 FORMULA_0023 -50.0 1200.0 FORMAT "%4.1" /end CHARACTERISTIC
/begin CHARACTERISTIC K_O2_OBD_TKAT_MIN "min. KAT-Temperatur f. O2-Beladung" VALUE 0x74F90 TKW_VV_VV_SW 100.0 FORMULA_0023 -50.0 1200.0 FORMAT "%4.1" /end CHARACTERISTIC
/begin CHARACTERISTIC K_O2_OBD_TMOT "min. TMOT-Schwelle f. O2-Beladung" VALUE 0x74F8A TKW_VV_VV_SW 100.0 FORMULA_0023 -50.0 170.0 FORMAT "%4.1" /end CHARACTERISTIC
/begin CHARACTERISTIC K_O2_OBD_V_MAX "max. Fahrzeuggeschwindigkeit" VALUE 0x74FC2 TKW_VV_VV_SW 100.0 FORMULA_0076 -80.0 360.0 FORMAT "%4.1" /end CHARACTERISTIC
/begin CHARACTERISTIC K_O2_OBD_V_MIN "min. Fahrzeuggeschwindigkeit" VALUE 0x74FC0 TKW_VV_VV_SW 100.0 FORMULA_0076 -80.0 360.0 FORMAT "%4.1" /end CHARACTERISTIC
/begin CHARACTERISTIC K_O2_OBD_WE_ML_MIN "min. aufsum. Luftmassenstr. nach SA_WE f. lange SA" VALUE 0x74FBE TKW_VV_VV_UW 100.0 FORMULA_0792 0.0 65535.0 /end CHARACTERISTIC
/begin CHARACTERISTIC K_OZABSTELL "Mindestwert für die Übernahme der Abstellzeit" VALUE 0x75438 TKW_VV_VV_UW 100.0 FORMULA_0440 0.0 65535.0 FORMAT "%5.2" /end CHARACTERISTIC
/begin CHARACTERISTIC K_OZALTANZABZ "Abstellzeit für die Ausgabe der letzten Anzeige nach dem Ölcheck" VALUE 0x7543A TKW_VV_VV_UW 100.0 FORMULA_0440 0.0 65535.0 FORMAT "%5.2" /end CHARACTERISTIC
/begin CHARACTERISTIC K_OZANFANZ "BOS-Startanzeigewert Restlaufstrecke" VALUE 0x756D8 TKW_VV_VV_UW 100.0 FORMULA_0437 0.0 655350.0 /end CHARACTERISTIC
/begin CHARACTERISTIC K_OZBESCHAUS "Zahl Ausgeblendet bei Lengsbescheunigung" VALUE 0x75461 TKW_VV_VV_UB 100.0 FORMULA_0003 0.0 255.0 /end CHARACTERISTIC
/begin CHARACTERISTIC K_OZBZKMSTK1 "Bezugsintervall" VALUE 0x753A6 TKW_VV_VV_UB 100.0 FORMULA_0434 0.0 255000.0 /end CHARACTERISTIC
/begin CHARACTERISTIC K_OZDAEMPF "" VALUE 0x756EA TKW_VV_VV_UB 100.0 FORMULA_0457 0.0 0.2489999979734421 /end CHARACTERISTIC
/begin CHARACTERISTIC K_OZDELTOE "Verzögerung für das Schreiben in Fehlerspeicher Töns-Fehler" VALUE 0x70884 TKW_VV_VV_UW 100.0 FORMULA_0010 0.0 65535.0 /end CHARACTERISTIC
/begin CHARACTERISTIC K_OZDIAGNMOT "Mindestdrehzahl zur QLT-Diagnose" VALUE 0x7087C TKW_VV_VV_SW 100.0 FORMULA_0006 -32768.0 32767.0 /end CHARACTERISTIC
/begin CHARACTERISTIC K_OZDIAGNMOT2 "Max Drehzahl zur QLT-Diagnose" VALUE 0x7087E TKW_VV_VV_SW 100.0 FORMULA_0006 -32768.0 32767.0 /end CHARACTERISTIC
/begin CHARACTERISTIC K_OZDIAGSPG "Spannung, unterhalb der die Diagnose ausgeblendet wird" VALUE 0x70886 TKW_VV_VV_UW 100.0 FORMULA_0432 0.0 6173.39697265625 FORMAT "%4.1" /end CHARACTERISTIC
/begin CHARACTERISTIC K_OZDKNIVN "Ersatzwert für die Drehzahlkorrektur bei Oz_peilaltanz = 0" VALUE 0x75462 TKW_VV_VV_UB 100.0 FORMULA_0436 0.0 74.70700073242188 /end CHARACTERISTIC
/begin CHARACTERISTIC K_OZERRD "Entprellzeit Sensor- und Kommunikationsfehler" VALUE 0x70888 TKW_VV_VV_UW 100.0 FORMULA_0010 0.0 65535.0 /end CHARACTERISTIC
/begin CHARACTERISTIC K_OZHEAL "Entprellzeit Fehler-Healing" VALUE 0x7088A TKW_VV_VV_UW 100.0 FORMULA_0010 0.0 65535.0 /end CHARACTERISTIC
/begin CHARACTERISTIC K_OZKMMAXK11 "Maximalintervall" VALUE 0x756DA TKW_VV_VV_UW 100.0 FORMULA_0437 0.0 655350.0 /end CHARACTERISTIC
/begin CHARACTERISTIC K_OZKMUPL "" VALUE 0x753A4 TKW_VV_VV_UW 100.0 FORMULA_0437 0.0 655350.0 /end CHARACTERISTIC
/begin CHARACTERISTIC K_OZKVB96 "Typprüfkraftstoffverbrauch" VALUE 0x756EB TKW_VV_VV_UB 100.0 FORMULA_0458 0.0 31.875 /end CHARACTERISTIC
/begin CHARACTERISTIC K_OZKVB96A "Typprüfkraftstoffverbrauch Automatikgetriebe" VALUE 0x756EC TKW_VV_VV_UB 100.0 FORMULA_0458 0.0 31.875 /end CHARACTERISTIC
/begin CHARACTERISTIC K_OZKVBMXK18 "maximal zulässige Gesamtkraftstoffbonusmenge" VALUE 0x756DC TKW_VV_VV_UW 100.0 FORMULA_0010 0.0 65535.0 /end CHARACTERISTIC
/begin CHARACTERISTIC K_OZKVBOK16 "Kraftstoffbonusmenge in [l] je 0,5l Ölnachfüllung" VALUE 0x756DE TKW_VV_VV_UW 100.0 FORMULA_0010 0.0 65535.0 /end CHARACTERISTIC
/begin CHARACTERISTIC K_OZLBESCHN "Negative Längsbeschleunigung Ausblendung-Schwelle " VALUE 0x7544E TKW_VV_VV_SB 100.0 FORMULA_0448 -32.0 31.75 /end CHARACTERISTIC
/begin CHARACTERISTIC K_OZLBESCHORI "Längsbeschleunigung Ausblendung-Schwelle beim OriMw" VALUE 0x7544F TKW_VV_VV_SB 100.0 FORMULA_0448 -32.0 31.75 /end CHARACTERISTIC
/begin CHARACTERISTIC K_OZLBESCHP "Positive Längsbeschleunigung Ausblendung-Schwelle " VALUE 0x75450 TKW_VV_VV_SB 100.0 FORMULA_0448 -32.0 31.75 /end CHARACTERISTIC
/begin CHARACTERISTIC K_OZLBESCHST "Längsbeschleunigung Ausblendung-Schwelle im Stand" VALUE 0x75451 TKW_VV_VV_SB 100.0 FORMULA_0448 -32.0 31.75 /end CHARACTERISTIC
/begin CHARACTERISTIC K_OZLF1 "Länderfaktor 1 Festwert" VALUE 0x756ED TKW_VV_VV_UB 100.0 FORMULA_0453 0.0 2.549999952316284 /end CHARACTERISTIC
/begin CHARACTERISTIC K_OZLF2 "Länderfaktor 2 Festwert" VALUE 0x756EE TKW_VV_VV_UB 100.0 FORMULA_0453 0.0 2.549999952316284 /end CHARACTERISTIC
/begin CHARACTERISTIC K_OZLUFTMAX "Plausibel max luftsprung" VALUE 0x7543C TKW_VV_VV_UW 100.0 FORMULA_0447 0.0 2559.9609375 FORMAT "%6.3" /end CHARACTERISTIC
/begin CHARACTERISTIC K_OZMAXSLOPE "Maximale erlaubte Steigung" VALUE 0x7541E TKW_VV_VV_SW 100.0 FORMULA_0442 -64.0 63.99800109863281 FORMAT "%5.2" /end CHARACTERISTIC
/begin CHARACTERISTIC K_OZMINSLOPE "Kleinste erlaubte Steigung (<0)" VALUE 0x75420 TKW_VV_VV_SW 100.0 FORMULA_0442 -64.0 63.99800109863281 FORMAT "%5.2" /end CHARACTERISTIC
/begin CHARACTERISTIC K_OZMNKMBO "Wegstrecke ab der eine Bonuszuteilung erfolgt" VALUE 0x756E0 TKW_VV_VV_UW 100.0 FORMULA_0437 0.0 655350.0 /end CHARACTERISTIC
/begin CHARACTERISTIC K_OZMWK "Anzahl der Messwerte für Kurzzeit-Mittelwert Niveau" VALUE 0x75463 TKW_VV_VV_UB 100.0 FORMULA_0003 0.0 255.0 /end CHARACTERISTIC
/begin CHARACTERISTIC K_OZMWL "Anzahl der Messwerte für Langzeit-Mittelwert Niveau" VALUE 0x7543E TKW_VV_VV_UW 100.0 FORMULA_0010 0.0 65535.0 /end CHARACTERISTIC
/begin CHARACTERISTIC K_OZMWOR "Anzahl der Messwerte für Orientierungsmessung" VALUE 0x75440 TKW_VV_VV_UW 100.0 FORMULA_0010 0.0 65535.0 /end CHARACTERISTIC
/begin CHARACTERISTIC K_OZMWV "Anzahl der Messwerte für vorgezogenen Mittelwert Niveau" VALUE 0x75442 TKW_VV_VV_UW 100.0 FORMULA_0010 0.0 65535.0 /end CHARACTERISTIC
/begin CHARACTERISTIC K_OZMXOHK15 "Max Tage für den Ölservice" VALUE 0x756E2 TKW_VV_VV_UW 100.0 FORMULA_0010 0.0 65535.0 /end CHARACTERISTIC
/begin CHARACTERISTIC K_OZNFERR "Nachfüllmengenanzeige bei PreCheck OK" VALUE 0x75464 TKW_VV_VV_UB 100.0 FORMULA_0003 0.0 255.0 /end CHARACTERISTIC
/begin CHARACTERISTIC K_OZNFML "Nachfüllmengenanzeige bei " VALUE 0x75465 TKW_VV_VV_UB 100.0 FORMULA_0003 0.0 255.0 /end CHARACTERISTIC
/begin CHARACTERISTIC K_OZNFOELCKO "Nachfüllmengenanzeige bei PreCheck KO" VALUE 0x75466 TKW_VV_VV_UB 100.0 FORMULA_0003 0.0 255.0 /end CHARACTERISTIC
/begin CHARACTERISTIC K_OZNFOELCOK "Nachfüllmengenanzeige bei PreCheck OK" VALUE 0x75467 TKW_VV_VV_UB 100.0 FORMULA_0003 0.0 255.0 /end CHARACTERISTIC
/begin CHARACTERISTIC K_OZNIVKL "" VALUE 0x753B0 TKW_VV_VV_UB 100.0 FORMULA_0436 0.0 74.70700073242188 /end CHARACTERISTIC
/begin CHARACTERISTIC K_OZNMOTMAX "obere Drehzahlgrenze für drehzahlkorrigierten Niveaumittelwert" VALUE 0x75422 TKW_VV_VV_SW 100.0 FORMULA_0006 -32768.0 32767.0 /end CHARACTERISTIC
/begin CHARACTERISTIC K_OZNMOTMIN "untere Drehzahlgrenze für drehzahlkorrigierten Niveaumittelwert" VALUE 0x75424 TKW_VV_VV_SW 100.0 FORMULA_0006 -32768.0 32767.0 /end CHARACTERISTIC
/begin CHARACTERISTIC K_OZOELCABZ "Minimale Abstellzeit für den ÖlCheck" VALUE 0x75444 TKW_VV_VV_UW 100.0 FORMULA_0440 0.0 65535.0 FORMAT "%5.2" /end CHARACTERISTIC
/begin CHARACTERISTIC K_OZOELCOK "PreDriveCheck-Schwelle" VALUE 0x75468 TKW_VV_VV_UB 100.0 FORMULA_0436 0.0 74.70700073242188 /end CHARACTERISTIC
/begin CHARACTERISTIC K_OZOELCVERZ "Verzögerung für den Ölcheck" VALUE 0x75469 TKW_VV_VV_UB 100.0 FORMULA_0003 0.0 255.0 /end CHARACTERISTIC
/begin CHARACTERISTIC K_OZOELMEN "Ölmenge für den Dieseleintrag" VALUE 0x756EF TKW_VV_VV_UB 100.0 FORMULA_0438 0.0 25.5 /end CHARACTERISTIC
/begin CHARACTERISTIC K_OZOELVERB "Ölverbrauch" VALUE 0x75446 TKW_VV_VV_UW 100.0 FORMULA_0010 0.0 65535.0 /end CHARACTERISTIC
/begin CHARACTERISTIC K_OZORIPEILTZO "Ausgabeniveau für die tote Zone Orientierung-Check Peilstab mit alter Anzeige >= Mitte" VALUE 0x7546A TKW_VV_VV_UB 100.0 FORMULA_0436 0.0 74.70700073242188 /end CHARACTERISTIC
/begin CHARACTERISTIC K_OZORIPEILTZU "Ausgabeniveau für die tote Zone Orientierung-Check Peilstab mit alter Anzeige < Mitte" VALUE 0x7546B TKW_VV_VV_UB 100.0 FORMULA_0436 0.0 74.70700073242188 /end CHARACTERISTIC
/begin CHARACTERISTIC K_OZPEIL12 "Erste Balken von Peistab" VALUE 0x7546C TKW_VV_VV_UB 100.0 FORMULA_0436 0.0 74.70700073242188 /end CHARACTERISTIC
/begin CHARACTERISTIC K_OZPEIL25 "Zweite Balken von Peistab" VALUE 0x7546D TKW_VV_VV_UB 100.0 FORMULA_0436 0.0 74.70700073242188 /end CHARACTERISTIC
/begin CHARACTERISTIC K_OZPEIL38 "Dritte Balken von Peistab" VALUE 0x7546E TKW_VV_VV_UB 100.0 FORMULA_0436 0.0 74.70700073242188 /end CHARACTERISTIC
/begin CHARACTERISTIC K_OZPEIL53 "Vierte Balken von Peistab" VALUE 0x7546F TKW_VV_VV_UB 100.0 FORMULA_0436 0.0 74.70700073242188 /end CHARACTERISTIC
/begin CHARACTERISTIC K_OZPEIL69 "Fünfte Balken von Peistab" VALUE 0x75470 TKW_VV_VV_UB 100.0 FORMULA_0436 0.0 74.70700073242188 /end CHARACTERISTIC
/begin CHARACTERISTIC K_OZPEIL85 "Sechte Balken von Peistab" VALUE 0x75471 TKW_VV_VV_UB 100.0 FORMULA_0436 0.0 74.70700073242188 /end CHARACTERISTIC
/begin CHARACTERISTIC K_OZPEILDO "Delta + Hysterese Peilstab" VALUE 0x75472 TKW_VV_VV_UB 100.0 FORMULA_0436 0.0 74.70700073242188 /end CHARACTERISTIC
/begin CHARACTERISTIC K_OZPEILDOMIN "Delta + Hysterese Peilstab bei Min" VALUE 0x75473 TKW_VV_VV_UB 100.0 FORMULA_0436 0.0 74.70700073242188 /end CHARACTERISTIC
/begin CHARACTERISTIC K_OZPEILDU "Delta - Hysterese Peilstab" VALUE 0x75474 TKW_VV_VV_UB 100.0 FORMULA_0436 0.0 74.70700073242188 /end CHARACTERISTIC
/begin CHARACTERISTIC K_OZPEILDU38 "Delta - Hysterese Peilstab bei 1/4" VALUE 0x75475 TKW_VV_VV_UB 100.0 FORMULA_0436 0.0 74.70700073242188 /end CHARACTERISTIC
/begin CHARACTERISTIC K_OZPEILERR "Balkenanzeige im Fehlerfall" VALUE 0x75476 TKW_VV_VV_UB 100.0 FORMULA_0003 0.0 255.0 /end CHARACTERISTIC
/begin CHARACTERISTIC K_OZPEILKSPR "Max zulässiger Niveau-Unterschied zwischen alten Anzeige und VorMw" VALUE 0x75477 TKW_VV_VV_UB 100.0 FORMULA_0436 0.0 74.70700073242188 /end CHARACTERISTIC
/begin CHARACTERISTIC K_OZPEILLP85 "Bankenanzeige für Niveau bei 85%" VALUE 0x75478 TKW_VV_VV_UB 100.0 FORMULA_0003 0.0 255.0 /end CHARACTERISTIC
/begin CHARACTERISTIC K_OZPEILML "Balkenanzeige bei Messung läuft" VALUE 0x75479 TKW_VV_VV_UB 100.0 FORMULA_0003 0.0 255.0 /end CHARACTERISTIC
/begin CHARACTERISTIC K_OZPEILOELCKO "Balkenanzeige bei ÖlCheck KO" VALUE 0x7547A TKW_VV_VV_UB 100.0 FORMULA_0003 0.0 255.0 /end CHARACTERISTIC
/begin CHARACTERISTIC K_OZPEILOELCOK "Balkenanzeige bei ÖlCheck OK" VALUE 0x7547B TKW_VV_VV_UB 100.0 FORMULA_0003 0.0 255.0 /end CHARACTERISTIC
/begin CHARACTERISTIC K_OZPEILSPRUNG "Max zulässiger Niveau-Unterschied zwischen LangMw" VALUE 0x7547C TKW_VV_VV_UB 100.0 FORMULA_0436 0.0 74.70700073242188 /end CHARACTERISTIC
/begin CHARACTERISTIC K_OZPERBOK17 "Er-Bonusbetrag je 0,5l Ölnachfüllung" VALUE 0x756E4 TKW_VV_VV_UW 100.0 FORMULA_0435 0.0 5.999899864196777 FORMAT "%4.1" /end CHARACTERISTIC
/begin CHARACTERISTIC K_OZPERBRK14 "Begrenzungsfaktor für Restweg aus der Permittivität" VALUE 0x756F0 TKW_VV_VV_UB 100.0 FORMULA_0459 0.0 5.976500034332275 /end CHARACTERISTIC
/begin CHARACTERISTIC K_OZPERMRMIN "Grenze für Niveauberechnung aus Permittivität" VALUE 0x753A8 TKW_VV_VV_UW 100.0 FORMULA_0010 0.0 65535.0 /end CHARACTERISTIC
/begin CHARACTERISTIC K_OZPERXK10 "zulässige Permittivitätsänderung im Ölwechselintervall" VALUE 0x756E6 TKW_VV_VV_UW 100.0 FORMULA_0435 0.0 5.999899864196777 FORMAT "%4.1" /end CHARACTERISTIC
/begin CHARACTERISTIC K_OZPLTEMP "Max Temperatursprung QLT (Plausibilisierung wegen ASIC-Pins Bruch)" VALUE 0x7088E TKW_VV_VV_UB 100.0 FORMULA_0003 0.0 255.0 /end CHARACTERISTIC
/begin CHARACTERISTIC K_OZPLZTEMP "Max unplausibel Sprünge (Plausibilisierung wegen ASIC-Pins Bruch)" VALUE 0x7088F TKW_VV_VV_UB 100.0 FORMULA_0003 0.0 255.0 /end CHARACTERISTIC
/begin CHARACTERISTIC K_OZPRREFMAX "Maximum für Referenzpermittivität" VALUE 0x753AA TKW_VV_VV_UW 100.0 FORMULA_0010 0.0 1024.0 /end CHARACTERISTIC
/begin CHARACTERISTIC K_OZPRREFMIN "Minimum für Referenzpermittivität" VALUE 0x753AC TKW_VV_VV_UW 100.0 FORMULA_0010 0.0 1024.0 /end CHARACTERISTIC
/begin CHARACTERISTIC K_OZQBESCHN "Negative Querbeschleunigung Ausblendung-Schwelle " VALUE 0x75452 TKW_VV_VV_SB 100.0 FORMULA_0448 -32.0 31.75 /end CHARACTERISTIC
/begin CHARACTERISTIC K_OZQBESCHORI "Querbeschleunigung Ausblendung-Schwelle Beim OriMw" VALUE 0x75453 TKW_VV_VV_SB 100.0 FORMULA_0448 -32.0 31.75 /end CHARACTERISTIC
/begin CHARACTERISTIC K_OZQBESCHP "Positive Querbeschleunigung Ausblendung-Schwelle " VALUE 0x75454 TKW_VV_VV_SB 100.0 FORMULA_0448 -32.0 31.75 /end CHARACTERISTIC
/begin CHARACTERISTIC K_OZQBESCHST "Querbeschleunigung Ausblendung-Schwelle im Stand" VALUE 0x75455 TKW_VV_VV_SB 100.0 FORMULA_0448 -32.0 31.75 /end CHARACTERISTIC
/begin CHARACTERISTIC K_OZRESBOST "Delay für die Rücksetzung der Tester-Bos-Anforderung" VALUE 0x753B1 TKW_VV_VV_UB 100.0 FORMULA_0003 0.0 255.0 /end CHARACTERISTIC
/begin CHARACTERISTIC K_OZSTANDVERZ "Verzögerung für Fahrzeug steht" VALUE 0x7547D TKW_VV_VV_UB 100.0 FORMULA_0003 0.0 255.0 /end CHARACTERISTIC
/begin CHARACTERISTIC K_OZSTARTABZ "Mindestlaufzeit für die Übernahme der Abstellzeit" VALUE 0x75448 TKW_VV_VV_UW 100.0 FORMULA_0021 0.0 655.3499755859375 FORMAT "%5.2" /end CHARACTERISTIC
/begin CHARACTERISTIC K_OZSTARTVERZ "QLT Start Verzögerung nach Drehzal" VALUE 0x7547E TKW_VV_VV_UB 100.0 FORMULA_0003 0.0 255.0 /end CHARACTERISTIC
/begin CHARACTERISTIC K_OZSTMINW "Minimale Strecke für die Steigungserkennung" VALUE 0x7544A TKW_VV_VV_UW 100.0 FORMULA_0443 0.0 9.999799728393555 FORMAT "%5.2" /end CHARACTERISTIC
/begin CHARACTERISTIC K_OZSTZYK "" VALUE 0x753B2 TKW_VV_VV_UB 100.0 FORMULA_0003 0.0 255.0 /end CHARACTERISTIC
/begin CHARACTERISTIC K_OZTAGCTERR "Wert für unplausibel Tagezähler" VALUE 0x756E8 TKW_VV_VV_UW 100.0 FORMULA_0010 0.0 65535.0 /end CHARACTERISTIC
/begin CHARACTERISTIC K_OZTEMPBW "Temperaturschwelle Öltemperatur Motor betriebswarm" VALUE 0x75426 TKW_VV_VV_SW 100.0 FORMULA_0431 -3276.800048828125 3276.699951171875 /end CHARACTERISTIC
/begin CHARACTERISTIC K_OZTEMPQERR "Temperaturschwelle für den Permittivitätsfehler" VALUE 0x70880 TKW_VV_VV_SW 100.0 FORMULA_0431 -3276.800048828125 3276.699951171875 /end CHARACTERISTIC
/begin CHARACTERISTIC K_OZTORMAX "Temperaturschwelle für Orientierungsmessung" VALUE 0x75428 TKW_VV_VV_SW 100.0 FORMULA_0431 -3276.800048828125 3276.699951171875 /end CHARACTERISTIC
/begin CHARACTERISTIC K_OZTORMIN "Mindest Temperatur für OrientierungMw QLT" VALUE 0x7542A TKW_VV_VV_SW 100.0 FORMULA_0445 -327.6799926757813 327.6700134277344 FORMAT "%5.2" /end CHARACTERISTIC
/begin CHARACTERISTIC K_OZUEBERF "Schwelle für die Überfüllung" VALUE 0x7547F TKW_VV_VV_UB 100.0 FORMULA_0436 0.0 74.70700073242188 /end CHARACTERISTIC
/begin CHARACTERISTIC K_OZUEBERTEMP "Schwelle für die Ölsübertemperatur-Kontrolle" VALUE 0x756D6 TKW_VV_VV_SW 100.0 FORMULA_0431 -3276.800048828125 3276.699951171875 /end CHARACTERISTIC
/begin CHARACTERISTIC K_OZUEFCNT "Anzahl Werte für Überfüllung" VALUE 0x75480 TKW_VV_VV_UB 100.0 FORMULA_0003 0.0 255.0 /end CHARACTERISTIC
/begin CHARACTERISTIC K_OZUEFNLB "Negative Längsbeschleunigungsgrenze für die Überfüllung" VALUE 0x75456 TKW_VV_VV_SB 100.0 FORMULA_0448 -32.0 31.75 /end CHARACTERISTIC
/begin CHARACTERISTIC K_OZUEFNQB "Negative Querbeschleunigungsgrenze für die Überfüllung" VALUE 0x75457 TKW_VV_VV_SB 100.0 FORMULA_0448 -32.0 31.75 /end CHARACTERISTIC
/begin CHARACTERISTIC K_OZUEFNST "Maximale negative Steigung für die Überfüllungserkenung" VALUE 0x7542C TKW_VV_VV_SW 100.0 FORMULA_0442 -64.0 63.99800109863281 FORMAT "%5.2" /end CHARACTERISTIC
/begin CHARACTERISTIC K_OZUEFODZ "Obere Drehzahlgrenze für die Überfüllungserkennung" VALUE 0x7542E TKW_VV_VV_SW 100.0 FORMULA_0006 -32768.0 32767.0 /end CHARACTERISTIC
/begin CHARACTERISTIC K_OZUEFPLB "Positive Längsbeschleunigungsgrenze für die Überfüllung" VALUE 0x75458 TKW_VV_VV_SB 100.0 FORMULA_0448 -32.0 31.75 /end CHARACTERISTIC
/begin CHARACTERISTIC K_OZUEFPQB "Positive Querbeschleunigungsgrenze für die Überfüllung" VALUE 0x75459 TKW_VV_VV_SB 100.0 FORMULA_0448 -32.0 31.75 /end CHARACTERISTIC
/begin CHARACTERISTIC K_OZUEFPST "Maximale positive Steigung für die Überfüllungserkenung" VALUE 0x75430 TKW_VV_VV_SW 100.0 FORMULA_0442 -64.0 63.99800109863281 FORMAT "%5.2" /end CHARACTERISTIC
/begin CHARACTERISTIC K_OZUEFTEM "Mindestöltemperatur für die Überfüllungserkennung" VALUE 0x75432 TKW_VV_VV_SW 100.0 FORMULA_0431 -3276.800048828125 3276.699951171875 /end CHARACTERISTIC
/begin CHARACTERISTIC K_OZUEFUDZ "Untere Drehzahlgrenze für die Überfüllungserkennung" VALUE 0x75434 TKW_VV_VV_SW 100.0 FORMULA_0006 -32768.0 32767.0 /end CHARACTERISTIC
/begin CHARACTERISTIC K_OZUEFVERZ "Verzögerung für erkennung Überfüllung" VALUE 0x75481 TKW_VV_VV_UB 100.0 FORMULA_0003 0.0 255.0 /end CHARACTERISTIC
/begin CHARACTERISTIC K_OZUTFAK "Faktor für den Kraftstoffverbrauch bei Übertemperatur" VALUE 0x756F1 TKW_VV_VV_UB 100.0 FORMULA_0003 0.0 255.0 /end CHARACTERISTIC
/begin CHARACTERISTIC K_OZVERBDKM "Delta km für die Ölverbrauch-Berechnung" VALUE 0x7544C TKW_VV_VV_UW 100.0 FORMULA_0437 0.0 655350.0 /end CHARACTERISTIC
/begin CHARACTERISTIC K_OZVERBFAK "Faktor für die Anpassung des Ölverbrauches" VALUE 0x75482 TKW_VV_VV_UB 100.0 FORMULA_0449 0.0 7.968699932098389 /end CHARACTERISTIC
/begin CHARACTERISTIC K_OZVERLORI "Schwelle für Orientierungswert Ölniveau (Verlustwarnung)" VALUE 0x7540E TKW_VV_VV_UB 100.0 FORMULA_0436 0.0 74.70700073242188 /end CHARACTERISTIC
/begin CHARACTERISTIC K_OZVERZERRBSD "Verzögerung für Peilstab-Fehlerfall beim BSD-Fehler" VALUE 0x75483 TKW_VV_VV_UB 100.0 FORMULA_0003 0.0 255.0 /end CHARACTERISTIC
/begin CHARACTERISTIC K_OZVORMV "Korrektur von Vormw für Peilstab" VALUE 0x75436 TKW_VV_VV_SW 100.0 FORMULA_0446 -32.0 31.99900054931641 FORMAT "%7.4" /end CHARACTERISTIC
/begin CHARACTERISTIC K_OZVORPEILMIN "Niveau Ausgabe (für die Peilstabanzeige) bei VorMw auf min und LangMw über 1/4" VALUE 0x75484 TKW_VV_VV_UB 100.0 FORMULA_0436 0.0 74.70700073242188 /end CHARACTERISTIC
/begin CHARACTERISTIC K_OZZEITFAKT "Bereich der gesamten Laufstrecke wo die Berechnung des Zeit-RW Beainfluss hat" VALUE 0x756D4 TKW_VV_VV_UB 100.0 FORMULA_0455 0.0 0.9959999918937683 /end CHARACTERISTIC
/begin CHARACTERISTIC K_OZZEITINT "Zeitintervall für Ölwechsel in Monate (CBS4)" VALUE 0x756F2 TKW_VV_VV_UB 100.0 FORMULA_0003 0.0 255.0 /end CHARACTERISTIC
/begin CHARACTERISTIC K_OZZTEMP "Max Zeit mit dem selben Temperaturwert (Plausibilisierung wegen ASIC-Pins Bruch)" VALUE 0x7088C TKW_VV_VV_UW 100.0 FORMULA_0010 0.0 65535.0 /end CHARACTERISTIC
/begin CHARACTERISTIC K_OZZYKCBS "Zeitabstand fürs zyklisch Senden der CBS-Nachricht" VALUE 0x753A2 TKW_VV_VV_UB 100.0 FORMULA_0003 0.0 255.0 /end CHARACTERISTIC
/begin CHARACTERISTIC K_PABG_STAT_TAU "Filterzeitkonstante PABG" VALUE 0x7570A TKW_VV_VV_UB 100.0 FORMULA_0658 1.009999960660934e-002 2.559999942779541 /end CHARACTERISTIC
/begin CHARACTERISTIC K_PCTRL_PROZ_ZYKL "Prozess-Ueberwachungszyklus" VALUE 0x75730 TKW_VV_VV_UB 100.0 FORMULA_0357 0.0 1.274999976158142 /end CHARACTERISTIC
/begin CHARACTERISTIC K_PCTRL_TASK_ZYKL "Task-Ueberwachungszyklus" VALUE 0x7572F TKW_VV_VV_UB 100.0 FORMULA_0357 0.0 1.274999976158142 /end CHARACTERISTIC
/begin CHARACTERISTIC K_PCTRL_TIMEOUT "Timeout der Prozessorueberwachung" VALUE 0x7572E TKW_VV_VV_UB 100.0 FORMULA_0358 0.0 2550.0 /end CHARACTERISTIC
/begin CHARACTERISTIC K_PKS_DIAG_AUFBAU_DELAY "Verzoegerungszeit fuer Druckaufbaudiagnose" VALUE 0x75860 TKW_VV_VV_UW 100.0 FORMULA_0021 0.0 655.0 FORMAT "%5.2" /end CHARACTERISTIC
/begin CHARACTERISTIC K_PKS_DIAG_AUFBAU_MIN "Min-Druck bei Druckaufbau Vorlauf/-Start" VALUE 0x75856 TKW_VV_VV_SW 100.0 FORMULA_0110 0.0 10.0 FORMAT "%6.3" /end CHARACTERISTIC
/begin CHARACTERISTIC K_PKS_DIAG_AUFBAU_TAU "TAU fuer Druckabweichungsintegral" VALUE 0x75858 TKW_VV_VV_UB 100.0 FORMULA_0679 0.1004000008106232 25.60000038146973 /end CHARACTERISTIC
/begin CHARACTERISTIC K_PKS_DIAG_FEHLER_SCHW "Fehlerschwelle fuer Druckabweichung" VALUE 0x7585A TKW_VV_VV_SW 100.0 FORMULA_0110 0.0 10.0 FORMAT "%6.3" /end CHARACTERISTIC
/begin CHARACTERISTIC K_PKS_DIAG_MAX "obere Grenze Kraftstoffdruck" VALUE 0x75848 TKW_VV_VV_SW 100.0 FORMULA_0110 0.0 10.0 FORMAT "%6.3" /end CHARACTERISTIC
/begin CHARACTERISTIC K_PKS_DIAG_MIN "untere Grenze Kraftstoffdruck" VALUE 0x75846 TKW_VV_VV_SW 100.0 FORMULA_0110 0.0 10.0 FORMAT "%6.3" /end CHARACTERISTIC
/begin CHARACTERISTIC K_PKS_ERSATZ "Ersatzwert Kraftstoffdruck" VALUE 0x7584A TKW_VV_VV_SW 100.0 FORMULA_0110 0.0 10.0 FORMAT "%6.3" /end CHARACTERISTIC
/begin CHARACTERISTIC K_PKS_OBD_ABW_TAU "Filterkonstante f. Abweichung Kraftstoffdruck" VALUE 0x75844 TKW_VV_VV_UB 100.0 FORMULA_0679 0.1004000008106232 25.60000038146973 /end CHARACTERISTIC
/begin CHARACTERISTIC K_PKS_OBD_ABW_TAU_QMAX "Filterkonstante bei hohen Volumenstrom" VALUE 0x75845 TKW_VV_VV_UB 100.0 FORMULA_0679 0.1004000008106232 25.60000038146973 /end CHARACTERISTIC
/begin CHARACTERISTIC K_PKS_OBD_AY "Maximale Querbeschleunigung fuer PKS-Diagnose" VALUE 0x75822 TKW_VV_VV_SW 100.0 FORMULA_0123 -20.0 20.0 FORMAT "%5.2" /end CHARACTERISTIC
/begin CHARACTERISTIC K_PKS_OBD_CFG "OBD Kraftstoffsystem Diagnose" VALUE 0x7581A TKW_VV_VV_UB 100.0 FORMULA_1029 0.0 255.0 /end CHARACTERISTIC
/begin CHARACTERISTIC K_PKS_OBD_ERSATZ "Ersatzwert Kraftstoffdruck bei OBD-Fehler" VALUE 0x7584C TKW_VV_VV_SW 100.0 FORMULA_0110 0.0 10.0 FORMAT "%6.3" /end CHARACTERISTIC
/begin CHARACTERISTIC K_PKS_OBD_FST "Minimaler Fuellstand Tank" VALUE 0x75820 TKW_VV_VV_UW 100.0 FORMULA_0610 0.0 32767.5 FORMAT "%4.1" /end CHARACTERISTIC
/begin CHARACTERISTIC K_PKS_OBD_LL_MAX "Kraftstoffdruck Abweichung LL Maximum" VALUE 0x7582E TKW_VV_VV_SW 100.0 FORMULA_0543 -1000.0 1000.0 /end CHARACTERISTIC
/begin CHARACTERISTIC K_PKS_OBD_LL_MIN "Kraftstoffdruck Abweichung LL Minimum" VALUE 0x75830 TKW_VV_VV_SW 100.0 FORMULA_0543 -1000.0 1000.0 /end CHARACTERISTIC
/begin CHARACTERISTIC K_PKS_OBD_PUMG_MIN "Minimaler Umgebungsdruck fuer PKS-Diagnose" VALUE 0x7581C TKW_VV_VV_SW 100.0 FORMULA_0075 400.0 1200.0 FORMAT "%4.1" /end CHARACTERISTIC
/begin CHARACTERISTIC K_PKS_OBD_PUMPE_VL "Vorlaufzeit Kraftstoffpumpe bis Diagnose" VALUE 0x75824 TKW_VV_VV_UW 100.0 FORMULA_1025 0.0 6553.5 FORMAT "%5.2" /end CHARACTERISTIC
/begin CHARACTERISTIC K_PKS_OBD_Q_EKP_MAX "Volumenstrom EKP Maximum" VALUE 0x7583A TKW_VV_VV_SW 100.0 FORMULA_0746 0.0 250.0 FORMAT "%4.1" /end CHARACTERISTIC
/begin CHARACTERISTIC K_PKS_OBD_Q_EKP_MIN "Volumenstrom EKP Minimum" VALUE 0x7583C TKW_VV_VV_SW 100.0 FORMULA_0746 0.0 250.0 FORMAT "%4.1" /end CHARACTERISTIC
/begin CHARACTERISTIC K_PKS_OBD_Q_MAX "Kraftstoffdruck Abweichung Q Maximum" VALUE 0x75836 TKW_VV_VV_SW 100.0 FORMULA_0543 -1000.0 1000.0 /end CHARACTERISTIC
/begin CHARACTERISTIC K_PKS_OBD_Q_MIN "Kraftstoffdruck Abweichung Q Minimum" VALUE 0x75838 TKW_VV_VV_SW 100.0 FORMULA_0543 -1000.0 1000.0 /end CHARACTERISTIC
/begin CHARACTERISTIC K_PKS_OBD_SOLL_DYN_MAX "Maximale Dynamik Kraftstoffpumpen-Solldruck" VALUE 0x7582A TKW_VV_VV_SW 100.0 FORMULA_0110 0.0 10.0 FORMAT "%6.3" /end CHARACTERISTIC
/begin CHARACTERISTIC K_PKS_OBD_TIME_ML_MIN "Sperrzeit Diagnose nach Start" VALUE 0x7584E TKW_VV_VV_UW 100.0 FORMULA_0021 0.0 655.0 FORMAT "%5.2" /end CHARACTERISTIC
/begin CHARACTERISTIC K_PKS_OBD_TL_MAX "Kraftstoffdruck Abweichung TL Maximum" VALUE 0x75832 TKW_VV_VV_SW 100.0 FORMULA_0543 -1000.0 1000.0 /end CHARACTERISTIC
/begin CHARACTERISTIC K_PKS_OBD_TL_MIN "Kraftstoffdruck Abweichung TL Minimum" VALUE 0x75834 TKW_VV_VV_SW 100.0 FORMULA_0543 -1000.0 1000.0 /end CHARACTERISTIC
/begin CHARACTERISTIC K_PKS_OBD_TMOT_MIN "Untergrenze Motortemperatur fuer Diagnose" VALUE 0x7582C TKW_VV_VV_SW 100.0 FORMULA_0023 -50.0 170.0 FORMAT "%4.1" /end CHARACTERISTIC
/begin CHARACTERISTIC K_PKS_OBD_UB_MIN "Minimaler Spannungswert U_KL87 fuer PKS-Diagnose" VALUE 0x7581E TKW_VV_VV_SW 100.0 FORMULA_0008 0.0 28.0 FORMAT "%4.1" /end CHARACTERISTIC
/begin CHARACTERISTIC K_PKS_OBD_VERZ "Vorzoegerung Kraftstoffpumpen-Diagnose nach Dynamik" VALUE 0x75826 TKW_VV_VV_UW 100.0 FORMULA_1025 0.0 6553.5 FORMAT "%5.2" /end CHARACTERISTIC
/begin CHARACTERISTIC K_PKS_OBD_VERZ_Q_MAX "Vorzoegerung Kraftstoffpumpen-Diagnose bei QMAX" VALUE 0x75828 TKW_VV_VV_UW 100.0 FORMULA_1025 0.0 6553.5 FORMAT "%5.2" /end CHARACTERISTIC
/begin CHARACTERISTIC K_PKS_OFFSET "Offset Kraftstoffdrucksensor" VALUE 0x75840 TKW_VV_VV_SW 100.0 FORMULA_0110 -10.0 10.0 FORMAT "%6.3" /end CHARACTERISTIC
/begin CHARACTERISTIC K_PKS_PLAU_INTG_MAX "Minbegrenzung fuer pks_plau_intg" VALUE 0x75852 TKW_VV_VV_UW 100.0 FORMULA_1026 0.0 65.53500366210938 FORMAT "%6.3" /end CHARACTERISTIC
/begin CHARACTERISTIC K_PKS_PLAU_INTG_MIN "Minbegrenzung fuer pks_plau_intg" VALUE 0x75854 TKW_VV_VV_UW 100.0 FORMULA_1026 0.0 65.53500366210938 FORMAT "%6.3" /end CHARACTERISTIC
/begin CHARACTERISTIC K_PKS_PLAU_MAX_I "MAX I-Anteil bis zu der die Plausi durchgefuehrt wird" VALUE 0x7585C TKW_VV_VV_SW 100.0 FORMULA_0161 -3200.0 3199.90234375 FORMAT "%4.1" /end CHARACTERISTIC
/begin CHARACTERISTIC K_PKS_PLAU_MIN_T_REG "Zeit in Regeleung bis die Plausi durchgefuehrt wird" VALUE 0x7585E TKW_VV_VV_UW 100.0 FORMULA_0021 0.0 655.0 FORMAT "%5.2" /end CHARACTERISTIC
/begin CHARACTERISTIC K_PKS_PLAU_QMIN_KVA "Sperrschwelle bei hoher Drezahl und geringem KVA" VALUE 0x75864 TKW_VV_VV_SW 100.0 FORMULA_0746 0.0 500.0 FORMAT "%4.1" /end CHARACTERISTIC
/begin CHARACTERISTIC K_PKS_PLAU_QMIN_N "Sperrschwelle bei hoher Drezahl und geringem KVA" VALUE 0x75862 TKW_VV_VV_SW 100.0 FORMULA_0006 0.0 10000.0 /end CHARACTERISTIC
/begin CHARACTERISTIC K_PKS_PLAU_SCHWELLE "Fehlerschwelle fuer pks_plau_intg" VALUE 0x75850 TKW_VV_VV_SW 100.0 FORMULA_1026 0.0 10.0 FORMAT "%6.3" /end CHARACTERISTIC
/begin CHARACTERISTIC K_PKS_STEIGUNG "Steigung Kraftstoffdrucksensor" VALUE 0x7583E TKW_VV_VV_SW 100.0 FORMULA_1030 0.0 5.0 FORMAT "%6.3" /end CHARACTERISTIC
/begin CHARACTERISTIC K_PKS_TAU "Filterkonstante f. Kraftstoffdruck" VALUE 0x75842 TKW_VV_VV_UB 100.0 FORMULA_0645 5.100000184029341e-003 1.279999971389771 /end CHARACTERISTIC
/begin CHARACTERISTIC K_PKS_TAU_EKP100 "Filterkonstante f. Kraftstoffdruck bei 100%" VALUE 0x75843 TKW_VV_VV_UB 100.0 FORMULA_0645 5.100000184029341e-003 1.279999971389771 /end CHARACTERISTIC
/begin CHARACTERISTIC K_T_BNSDELAY "Delayzeit nach Motorstartende für BNS Überwachung" VALUE 0x75ABD TKW_VV_VV_UB 100.0 FORMULA_0476 0.0 255.0 /end CHARACTERISTIC
/begin CHARACTERISTIC K_TCHIPFIL "Filterkonstante schneller Tchip Filter" VALUE 0x7573E TKW_VV_VV_UW 100.0 FORMULA_0460 0.0 0.9999847412109375 FORMAT "%7.4" /end CHARACTERISTIC
/begin CHARACTERISTIC K_TDNGENKRIT "Verzögerung Generator im kritischen Drehzahlbereich" VALUE 0x75746 TKW_VV_VV_UB 100.0 FORMULA_0476 0.0 255.0 /end CHARACTERISTIC
/begin CHARACTERISTIC K_TDTCHIPKRI "Verzögerung Generatorhochtemperatur" VALUE 0x75747 TKW_VV_VV_UB 100.0 FORMULA_0476 0.0 255.0 /end CHARACTERISTIC
/begin CHARACTERISTIC K_TDTCHIPMX "Verzögerung erhöhte Chiptemperatur" VALUE 0x75748 TKW_VV_VV_UB 100.0 FORMULA_0003 0.0 255.0 /end CHARACTERISTIC
/begin CHARACTERISTIC K_TDUBFZMN "Verzögerung Bordnetzschwelle" VALUE 0x75749 TKW_VV_VV_UB 100.0 FORMULA_0476 0.0 255.0 /end CHARACTERISTIC
/begin CHARACTERISTIC K_TFIGENHT "Filterkonstante verteilter Generatorstrom" VALUE 0x7574A TKW_VV_VV_UB 100.0 FORMULA_0455 4.000000189989805e-003 0.9959999918937683 /end CHARACTERISTIC
/begin CHARACTERISTIC K_TFTDIODE "Filterkonstante Deltatemparatur Diode" VALUE 0x75740 TKW_VV_VV_UW 100.0 FORMULA_0460 1.52587890625e-005 0.9999847412109375 FORMAT "%7.4" /end CHARACTERISTIC
/begin CHARACTERISTIC K_TGENMXGRAD "Schwellwert für Erkennung mayimaler Gradient" VALUE 0x75738 TKW_VV_VV_SW 100.0 FORMULA_0431 -3276.800048828125 3276.699951171875 /end CHARACTERISTIC
/begin CHARACTERISTIC K_TGENMXTHD "Schwellwert für überhöhte Temparatur Generator" VALUE 0x7573A TKW_VV_VV_SW 100.0 FORMULA_0431 -3276.800048828125 3276.699951171875 /end CHARACTERISTIC
/begin CHARACTERISTIC K_TGENRSHT "Reset bei unterschrittener Chiptemperatur" VALUE 0x7573C TKW_VV_VV_SW 100.0 FORMULA_0431 -3276.800048828125 3276.699951171875 /end CHARACTERISTIC
/begin CHARACTERISTIC K_TLCHTEP "Entprellung Hochtemperatur Generator" VALUE 0x7574B TKW_VV_VV_UB 100.0 FORMULA_0476 0.0 255.0 /end CHARACTERISTIC
/begin CHARACTERISTIC K_TOG_CNTMAX "" VALUE 0x70878 TKW_VV_VV_UL 100.0 FORMULA_0000 0.0 4294967295.0 /end CHARACTERISTIC
/begin CHARACTERISTIC K_TOGMAXUNPL "" VALUE 0x70874 TKW_VV_VV_UL 100.0 FORMULA_0000 0.0 4294967295.0 /end CHARACTERISTIC
/begin CHARACTERISTIC K_TOGVERZOEG "" VALUE 0x753B3 TKW_VV_VV_UB 100.0 FORMULA_0003 0.0 255.0 /end CHARACTERISTIC
/begin CHARACTERISTIC K_TRTYP "" VALUE 0x753AE TKW_VV_VV_UW 100.0 FORMULA_0021 0.0 655.3499755859375 FORMAT "%5.2" /end CHARACTERISTIC
/begin CHARACTERISTIC K_UGENHTMN "Schwellwert Bordnetzspannung Reset Generatorstrombefrenzung durch Hochtemperatur" VALUE 0x75742 TKW_VV_VV_UW 100.0 FORMULA_0432 0.0 6173.39697265625 FORMAT "%4.1" /end CHARACTERISTIC
/begin CHARACTERISTIC KF_IERRGREHT "Generatorstrombegrenzung bei Generatorhochtemparatur" MAP 0x757C2 TKF_SW_SW_UB 100.0 FORMULA_0464 0.0 31.875
 /begin AXIS_DESCR STD_AXIS N_gen FORMULA_0006 3 -32768.0 32767.0 MAX_GRAD 0.0 /end AXIS_DESCR
 /begin AXIS_DESCR STD_AXIS Gen_awnumm FORMULA_0010 6 -32768.0 32767.0 MAX_GRAD 0.0 /end AXIS_DESCR
/end CHARACTERISTIC
/begin CHARACTERISTIC KF_KAT_OBD_INT_WICHT "Wichtungskennfeld" MAP 0x75096 TKF_SW_SW_UW 100.0 FORMULA_0073 0.0 2.0 FORMAT "%6.3" /begin AXIS_DESCR STD_AXIS n FORMULA_0006 6 0.0 10000.0 MAX_GRAD 0.0 /end AXIS_DESCR
 /begin AXIS_DESCR STD_AXIS rf FORMULA_0007 6 0.0 2.0 MAX_GRAD 0.0 FORMAT "%6.3" /end AXIS_DESCR
/end CHARACTERISTIC
/begin CHARACTERISTIC KF_KAT_OBD_WICHT_GESAMT "Ermittlung - Gesamtsystemdiagnosewert" MAP 0x750F8 TKF_UW_UW_UW 100.0 FORMULA_0025 0.0 3.999000072479248 FORMAT "%6.3"
 /begin AXIS_DESCR STD_AXIS kat_obd_wert_b1 FORMULA_0025 10 0.0 3.999000072479248 MAX_GRAD 0.0 FORMAT "%6.3" /end AXIS_DESCR
 /begin AXIS_DESCR STD_AXIS kat_obd_wert_b2 FORMULA_0025 10 0.0 3.999000072479248 MAX_GRAD 0.0 FORMAT "%6.3" /end AXIS_DESCR
/end CHARACTERISTIC
/begin CHARACTERISTIC KF_LAVK_OBD_DYN_AMPL_MAX "max. zulaessige Amplitude" MAP 0x751EA TKF_SW_SW_UW 100.0 FORMULA_0025 0.0 1.0 FORMAT "%6.3" /begin AXIS_DESCR STD_AXIS n FORMULA_0006 6 0.0 10000.0 MAX_GRAD 0.0 /end AXIS_DESCR
 /begin AXIS_DESCR STD_AXIS rf FORMULA_0007 6 0.0 2.0 MAX_GRAD 0.0 FORMAT "%6.3" /end AXIS_DESCR
/end CHARACTERISTIC
/begin CHARACTERISTIC KF_LAVK_OBD_DYN_AMPL_MIN "min. zulaessige Amplitude" MAP 0x7524C TKF_SW_SW_UW 100.0 FORMULA_0025 0.0 1.0 FORMAT "%6.3" /begin AXIS_DESCR STD_AXIS n FORMULA_0006 6 0.0 10000.0 MAX_GRAD 0.0 /end AXIS_DESCR
 /begin AXIS_DESCR STD_AXIS rf FORMULA_0007 6 0.0 2.0 MAX_GRAD 0.0 FORMAT "%6.3" /end AXIS_DESCR
/end CHARACTERISTIC
/begin CHARACTERISTIC KF_LAVK_OBD_DYN_WICHT_GESAMT "Ermittlung - Gesamtsystemdiagnosewert" MAP 0x752AE TKF_UW_UW_UW 100.0 FORMULA_0025 0.0 3.999000072479248 FORMAT "%6.3"
 /begin AXIS_DESCR STD_AXIS lavk_obd_dyn_wert_b1 FORMULA_0025 10 0.0 3.999000072479248 MAX_GRAD 0.0 FORMAT "%6.3" /end AXIS_DESCR
 /begin AXIS_DESCR STD_AXIS lavk_obd_dyn_wert_b2 FORMULA_0025 10 0.0 3.999000072479248 MAX_GRAD 0.0 FORMAT "%6.3" /end AXIS_DESCR
/end CHARACTERISTIC
/begin CHARACTERISTIC KF_OZDREHKOR "Drehzahlkorrektur Niveau" MAP 0x755C0 TKF_UW_SW_SW 100.0 FORMULA_0452 -37.5 37.5 FORMAT "%5.2"
 /begin AXIS_DESCR STD_AXIS N_ozmw FORMULA_0006 16 -32768.0 32767.0 MAX_GRAD 0.0 /end AXIS_DESCR
 /begin AXIS_DESCR STD_AXIS Oz_Peilaltanz FORMULA_0451 3 0.0 19199.70703125 MAX_GRAD 0.0 FORMAT "%5.2" /end AXIS_DESCR
/end CHARACTERISTIC
/begin CHARACTERISTIC KF_OZDREHKOR_EINFAHR "Drehzahlkorrektur Niveau Einfahrintervall" MAP 0x75538 TKF_UW_SW_SW 100.0 FORMULA_0452 -37.5 37.5 FORMAT "%5.2"
 /begin AXIS_DESCR STD_AXIS N_ozmw FORMULA_0006 16 -32768.0 32767.0 MAX_GRAD 0.0 /end AXIS_DESCR
 /begin AXIS_DESCR STD_AXIS Oz_Peilaltanz FORMULA_0451 3 0.0 19199.70703125 MAX_GRAD 0.0 FORMAT "%5.2" /end AXIS_DESCR
/end CHARACTERISTIC
/begin CHARACTERISTIC KF_OZKORRNIV "Niveaukorrektur nach Startzeit und Temperatur" MAP 0x75648 TKF_UW_SW_SW 100.0 FORMULA_0451 -37.5 37.5 FORMAT "%5.2"
 /begin AXIS_DESCR STD_AXIS Oz_tempf FORMULA_0431 6 -3276.800048828125 3276.699951171875 MAX_GRAD 0.0 /end AXIS_DESCR
 /begin AXIS_DESCR STD_AXIS Oz_nivzeit FORMULA_0021 4 0.0 655.3499755859375 MAX_GRAD 0.0 FORMAT "%5.2" /end AXIS_DESCR
/end CHARACTERISTIC
/begin CHARACTERISTIC KF_OZKORRORI "Kennfeld für die Korrektur des OriMw mit Abstellzeit und Öltemperatur" MAP 0x75510 TKF_UW_SW_SW 100.0 FORMULA_0451 -37.5 37.20700073242188 FORMAT "%5.2"
 /begin AXIS_DESCR STD_AXIS Toel FORMULA_0431 4 -3276.800048828125 3276.699951171875 MAX_GRAD 0.0 /end AXIS_DESCR
 /begin AXIS_DESCR STD_AXIS Tn_abstellm FORMULA_0440 3 0.0 65535.0 MAX_GRAD 0.0 FORMAT "%5.2" /end AXIS_DESCR
/end CHARACTERISTIC
/begin CHARACTERISTIC KF_OZZEIT "Zusammenführüng Abstellzeit und Startzeit" MAP 0x7568E TKF_UW_UW_UW 100.0 FORMULA_0021 0.0 655.3499755859375 FORMAT "%5.2"
 /begin AXIS_DESCR STD_AXIS Tn_start_10 FORMULA_0021 6 0.0 655.3499755859375 MAX_GRAD 0.0 FORMAT "%5.2" /end AXIS_DESCR
 /begin AXIS_DESCR STD_AXIS Oz_abstellm FORMULA_0440 4 0.0 65535.0 MAX_GRAD 0.0 FORMAT "%5.2" /end AXIS_DESCR
/end CHARACTERISTIC
/begin CHARACTERISTIC KF_TANSGENKO "Kennfeld zur Bestimmung Ansauglufttemparatur Generator" MAP 0x757E8 TKF_SW_SW_SW 100.0 FORMULA_0431 -3276.800048828125 3276.699951171875
 /begin AXIS_DESCR STD_AXIS Tchip_fil_l FORMULA_0431 4 -3276.800048828125 3276.699951171875 MAX_GRAD 0.0 /end AXIS_DESCR
 /begin AXIS_DESCR STD_AXIS N_gen FORMULA_0006 4 -32768.0 32767.0 MAX_GRAD 0.0 /end AXIS_DESCR
/end CHARACTERISTIC
/begin CHARACTERISTIC KF_UFDIODE "Kennfeld für Diodenvorwärtsspannung" MAP 0x7579E TKF_UB_SW_UW 100.0 FORMULA_0483 0.0 319.9950866699219 FORMAT "%6.3"
 /begin AXIS_DESCR STD_AXIS Tans_gen FORMULA_0431 2 -3276.800048828125 3276.699951171875 MAX_GRAD 0.0 /end AXIS_DESCR
 /begin AXIS_DESCR STD_AXIS Gen_awnumm FORMULA_0003 6 0.0 255.0 MAX_GRAD 0.0 /end AXIS_DESCR
/end CHARACTERISTIC
/begin CHARACTERISTIC KL_KAT_OBD_GESAMT_MAX "Diagnoseschwelle - Gesamtsystem-KAT-Diag." CURVE 0x75072 TKL_UW_VV_UW 100.0 FORMULA_0025 0.0 3.999000072479248 FORMAT "%6.3"
 /begin AXIS_DESCR STD_AXIS te_c_akf FORMULA_0199 4 0.0 2.0 MAX_GRAD 0.0 FORMAT "%7.4" /end AXIS_DESCR
/end CHARACTERISTIC
/begin CHARACTERISTIC KL_KAT_OBD_IO_VERZ "Verzoegerung d. Heilung abh. vom Diag.Wert" CURVE 0x7500C TKL_UW_VV_UW 100.0 FORMULA_0021 0.0 655.0 FORMAT "%5.2"
 /begin AXIS_DESCR STD_AXIS kat_obd_wert_nv FORMULA_0025 5 0.0 3.999000072479248 MAX_GRAD 0.0 FORMAT "%6.3" /end AXIS_DESCR
/end CHARACTERISTIC
/begin CHARACTERISTIC KL_KAT_OBD_WERT_MAX "Diagnoseschwelle - max. KAT-Diag." CURVE 0x75060 TKL_UW_VV_UW 100.0 FORMULA_0025 0.0 3.999000072479248 FORMAT "%6.3"
 /begin AXIS_DESCR STD_AXIS te_c_akf FORMULA_0199 4 0.0 2.0 MAX_GRAD 0.0 FORMAT "%7.4" /end AXIS_DESCR
/end CHARACTERISTIC
/begin CHARACTERISTIC KL_LAVK_OBD_DYN_GESAMT_MAX "Diagnoseschwelle - Gesamtsystem-dyn. Sonden-Diag." CURVE 0x75084 TKL_UW_VV_UW 100.0 FORMULA_0025 0.0 3.999000072479248 FORMAT "%6.3"
 /begin AXIS_DESCR STD_AXIS te_c_akf FORMULA_0199 4 0.0 2.0 MAX_GRAD 0.0 FORMAT "%7.4" /end AXIS_DESCR
/end CHARACTERISTIC
/begin CHARACTERISTIC KL_LAVK_OBD_DYN_IO_VERZ "Verzoegerung d. Heilung abh. vom Diag.Wert" CURVE 0x75022 TKL_UW_VV_UW 100.0 FORMULA_0021 0.0 655.0 FORMAT "%5.2"
 /begin AXIS_DESCR STD_AXIS lavk_obd_dyn_wert_nv FORMULA_0025 5 0.0 3.999000072479248 MAX_GRAD 0.0 FORMAT "%6.3" /end AXIS_DESCR
/end CHARACTERISTIC
/begin CHARACTERISTIC KL_LAVK_OBD_DYN_RF_MIN "min. relative Füllung f. dyn. Sondendiag." CURVE 0x7504A TKL_SW_VV_SW 100.0 FORMULA_0007 0.0 2.0 FORMAT "%6.3" /begin AXIS_DESCR STD_AXIS n FORMULA_0006 5 0.0 10000.0 MAX_GRAD 0.0 /end AXIS_DESCR /end CHARACTERISTIC
/begin CHARACTERISTIC KL_LAVK_OBD_DYN_WERT_MAX "Diagnoseschwelle - dyn. Sondendiagnose" CURVE 0x75038 TKL_UW_VV_UW 100.0 FORMULA_0025 0.0 3.999000072479248 FORMAT "%6.3"
 /begin AXIS_DESCR STD_AXIS te_c_akf FORMULA_0199 4 0.0 2.0 MAX_GRAD 0.0 FORMAT "%7.4" /end AXIS_DESCR
/end CHARACTERISTIC
/begin CHARACTERISTIC KL_NELUEFTGE "E-Lüfteranforderung Generator" CURVE 0x7574D TKL_UB_VV_UB 100.0 FORMULA_0475 0.0 99.60929870605469 /begin AXIS_DESCR STD_AXIS Gen_awnumm FORMULA_0003 6 0.0 255.0 MAX_GRAD 0.0 /end AXIS_DESCR /end CHARACTERISTIC
/begin CHARACTERISTIC KL_O2_OBD_RF_MIN "min. relative Füllung f. O2-Beladung" CURVE 0x74FF6 TKL_SW_VV_SW 100.0 FORMULA_0007 0.0 2.0 FORMAT "%6.3" /begin AXIS_DESCR STD_AXIS n FORMULA_0006 5 0.0 10000.0 MAX_GRAD 0.0 /end AXIS_DESCR /end CHARACTERISTIC
/begin CHARACTERISTIC KL_OZBEFKL "Befüllkennlinie" CURVE 0x7540F TKL_UB_VV_UB 100.0 FORMULA_0438 0.0 25.5
 /begin AXIS_DESCR STD_AXIS Oz_nivkrzt FORMULA_0436 6 0.0 74.70700073242188 MAX_GRAD 0.0 /end AXIS_DESCR
/end CHARACTERISTIC
/begin CHARACTERISTIC KL_OZKRZMW2 "Anzahl 10er Pakete für Steigungsberechnung in Abhängigkeit von der gefahrenen Strecke" CURVE 0x754A0 TKL_UW_VV_UB 100.0 FORMULA_0003 0.0 255.0
 /begin AXIS_DESCR STD_AXIS Oz_dkm FORMULA_0443 4 0.0 9.999799728393555 MAX_GRAD 0.0 FORMAT "%5.2" /end AXIS_DESCR
/end CHARACTERISTIC
/begin CHARACTERISTIC KL_OZLBNIV "Korrektur der Längbeschleunigungseffekte beim 10er Paket QLT" CURVE 0x754BC TKL_SB_VV_SB 100.0 FORMULA_0436 -37.5 37.20700073242188
 /begin AXIS_DESCR STD_AXIS Oz_lbmw FORMULA_0444 8 -2.0 1.984300017356873 MAX_GRAD 0.0 /end AXIS_DESCR
/end CHARACTERISTIC
/begin CHARACTERISTIC KL_OZLN "y = ln x" CURVE 0x75486 TKL_UW_VV_SW 100.0 FORMULA_0450 -1.0 0.999969482421875 FORMAT "%5.2"
 /begin AXIS_DESCR STD_AXIS Oz_pzdivp FORMULA_0024 6 0.0 1.999899983406067 MAX_GRAD 0.0 FORMAT "%7.4" /end AXIS_DESCR
/end CHARACTERISTIC
/begin CHARACTERISTIC KL_OZNFDELTA "Delta für die Nachfüllerkennung" CURVE 0x754CE TKL_UB_VV_UB 100.0 FORMULA_0436 0.0 74.70700073242188
 /begin AXIS_DESCR STD_AXIS Oz_peillang FORMULA_0436 6 0.0 74.70700073242188 MAX_GRAD 0.0 /end AXIS_DESCR
/end CHARACTERISTIC
/begin CHARACTERISTIC KL_OZORBERO "Toleranz für Orientierungsmessung nach oben in mm" CURVE 0x754AE TKL_UB_VV_UB 100.0 FORMULA_0436 0.0 74.70700073242188
 /begin AXIS_DESCR STD_AXIS Oz_peillang FORMULA_0436 6 0.0 74.70700073242188 MAX_GRAD 0.0 /end AXIS_DESCR
/end CHARACTERISTIC
/begin CHARACTERISTIC KL_OZPERMKL "Skalierungskennlinie Permittivität" CURVE 0x753B4 TKL_UW_VV_UW 100.0 FORMULA_0435 0.0 5.999899864196777 FORMAT "%4.1" /begin AXIS_DESCR STD_AXIS Oz_permt FORMULA_0010 2 0.0 65535.0 MAX_GRAD 0.0 /end AXIS_DESCR /end CHARACTERISTIC
/begin CHARACTERISTIC KL_OZQBNIV "Korrektur der Querbeschleunigungseffekte beim 10er Paket QLT" CURVE 0x754DC TKL_SB_VV_SB 100.0 FORMULA_0436 -37.5 37.20700073242188
 /begin AXIS_DESCR STD_AXIS Oz_qbmw FORMULA_0444 8 -2.0 1.984300017356873 MAX_GRAD 0.0 /end AXIS_DESCR
/end CHARACTERISTIC
/begin CHARACTERISTIC KL_OZSTNIV "Korrektur der Steigungseffekte beim 20er Paket QLT" CURVE 0x754EE TKL_SW_VV_SW 100.0 FORMULA_0451 -37.5 37.5 FORMAT "%5.2"
 /begin AXIS_DESCR STD_AXIS Oz_steigung FORMULA_0442 8 -64.0 63.99800109863281 MAX_GRAD 0.0 FORMAT "%5.2" /end AXIS_DESCR
/end CHARACTERISTIC
/begin CHARACTERISTIC KL_OZTEMPKL "" CURVE 0x753E0 TKL_UW_VV_SW 100.0 FORMULA_0431 -3276.800048828125 3276.699951171875 /begin AXIS_DESCR STD_AXIS Oz_tempt FORMULA_0010 2 0.0 65535.0 MAX_GRAD 0.0 /end AXIS_DESCR /end CHARACTERISTIC
/begin CHARACTERISTIC KL_OZVERDFAK "Verdünnungsfaktor von Dieseleintrag" CURVE 0x756F4 TKL_UW_VV_UW 100.0 FORMULA_0460 0.0 0.9999847412109375 FORMAT "%7.4"
 /begin AXIS_DESCR STD_AXIS NO_INPUT_QUANTITY FORMULA_0460 5 0.0 0.9998999834060669 MAX_GRAD 0.0 FORMAT "%7.4" /end AXIS_DESCR
/end CHARACTERISTIC
/begin CHARACTERISTIC KL_PABG_STAT_ML "Grundkennfeld relativer PABG" CURVE 0x7570C TKL_SW_VV_SW 100.0 FORMULA_0075 0.0 1500.0 FORMAT "%4.1"
 /begin AXIS_DESCR STD_AXIS ml FORMULA_0103 8 -100.0 1400.0 MAX_GRAD 0.0 FORMAT "%4.1" /end AXIS_DESCR
/end CHARACTERISTIC
/begin CHARACTERISTIC KL_PKS_PLAU_INC "Incrementwerte fuer Abweichungsintegral" CURVE 0x75866 TKL_SW_VV_SW 100.0 FORMULA_1031 -10.0 10.0 FORMAT "%6.3"
 /begin AXIS_DESCR STD_AXIS delta FORMULA_0110 11 -10.0 10.0 MAX_GRAD 0.0 FORMAT "%6.3" /end AXIS_DESCR
/end CHARACTERISTIC
/begin CHARACTERISTIC KL_PKS_TAU_MODELL "TAU fuer TV in Rueckwertsinterpol" CURVE 0x75894 TKL_SW_VV_UW 100.0 FORMULA_1032 9.999999776482582e-003 655.3499755859375 FORMAT "%5.2"
 /begin AXIS_DESCR STD_AXIS kva_q_mot FORMULA_0746 5 0.0 500.0 MAX_GRAD 0.0 FORMAT "%4.1" /end AXIS_DESCR
/end CHARACTERISTIC
/begin CHARACTERISTIC KL_RTHJADIOD "Temperaturkoeffizient der Diode" CURVE 0x75770 TKL_UB_VV_UW 100.0 FORMULA_0462 0.0 99.99839782714844 FORMAT "%5.2" /begin AXIS_DESCR STD_AXIS Gen_awnumm FORMULA_0003 6 0.0 255.0 MAX_GRAD 0.0 /end AXIS_DESCR /end CHARACTERISTIC
/begin CHARACTERISTIC KL_TCHIPOFFS "Offset zur gemessenen Chiptemperatur Herstellerspezifisch" CURVE 0x75784 TKL_UB_VV_SW 100.0 FORMULA_0431 -3276.800048828125 3276.699951171875 /begin AXIS_DESCR STD_AXIS Gen_manufak FORMULA_0003 8 0.0 255.0 MAX_GRAD 0.0 /end AXIS_DESCR /end CHARACTERISTIC
/begin CHARACTERISTIC KL_TKTOENIV "Umstetzung Tk -> Oelnivau" CURVE 0x753EA TKL_UW_VV_UW 100.0 FORMULA_0071 0.0 75.0 FORMAT "%4.1"
 /begin AXIS_DESCR STD_AXIS Td_og_tk FORMULA_0071 8 0.0 6553.5 MAX_GRAD 0.0 FORMAT "%4.1" /end AXIS_DESCR
/end CHARACTERISTIC
/begin CHARACTERISTIC KL_TMAXDIODE "Zulässige Diodenmaximaltemperatur" CURVE 0x7575C TKL_UB_VV_SW 100.0 FORMULA_0431 -3276.800048828125 3276.699951171875 /begin AXIS_DESCR STD_AXIS Gen_awnumm FORMULA_0003 6 0.0 255.0 MAX_GRAD 0.0 /end AXIS_DESCR /end CHARACTERISTIC
/begin CHARACTERISTIC KL_TVTOEL "" CURVE 0x753BE TKL_UW_VV_SW 100.0 FORMULA_0431 -3276.800048828125 3276.699951171875
 /begin AXIS_DESCR STD_AXIS NO_INPUT_QUANTITY FORMULA_0071 8 0.0 6553.5 MAX_GRAD 0.0 FORMAT "%4.1" /end AXIS_DESCR
/end CHARACTERISTIC
/begin CHARACTERISTIC S_BNSCLRAPP "BNS Daten löschen" VALUE 0x75ABE TKW_VV_VV_UB 100.0 FORMULA_0003 0.0 255.0 /end CHARACTERISTIC
/begin CHARACTERISTIC S_HTDETEC "Schalter zur Aktivierung Überwachung Diodentemparatur" VALUE 0x7574C TKW_VV_VV_UB 100.0 FORMULA_0478 0.0 1.0 /end CHARACTERISTIC
/begin CHARACTERISTIC S_OZBSDKOORD "BSD Koordinator aktiv" VALUE 0x70890 TKW_VV_VV_UB 100.0 FORMULA_0003 0.0 255.0 /end CHARACTERISTIC
/begin MEASUREMENT Bnctrmx1s "" UBYTE FORMULA_0003 0 0.0 0.0 255.0 READ_WRITE ECU_ADDRESS 0x3FCAD3 /end MEASUREMENT
/begin MEASUREMENT Bnsctr "Counter Bordnetzspannungsplausibilisierung" UBYTE FORMULA_0003 0 0.0 0.0 255.0 READ_WRITE ECU_ADDRESS 0x3FA90A /end MEASUREMENT
/begin MEASUREMENT Bnsctrant0 "Counter 1 sec-Anteile ohne Grenzwertüberschreitung" ULONG FORMULA_0000 0 0.0 0.0 4294967295.0 READ_WRITE ECU_ADDRESS 0x3FA900 /end MEASUREMENT
/begin MEASUREMENT Bnsctrant1 "Counter 1 sec-Anteile 1. Bereich" UWORD FORMULA_0010 0 0.0 0.0 65535.0 READ_WRITE ECU_ADDRESS 0x3FA904 /end MEASUREMENT
/begin MEASUREMENT Bnsctrant2 "Counter 1 sec-Anteile 2. Bereich" UWORD FORMULA_0010 0 0.0 0.0 65535.0 READ_WRITE ECU_ADDRESS 0x3FA906 /end MEASUREMENT
/begin MEASUREMENT Bnsctrant3 "Counter 1 sec-Anteile 3. Bereich" UWORD FORMULA_0010 0 0.0 0.0 65535.0 READ_WRITE ECU_ADDRESS 0x3FA908 /end MEASUREMENT
/begin MEASUREMENT Bosbtvfbk "Rest-Verfügbarkeit Motoröl in Prozent" UBYTE FORMULA_0003 0 0.0 0.0 255.0 READ_WRITE ECU_ADDRESS 0x3FA88A /end MEASUREMENT
/begin MEASUREMENT Bosfxid2 "Zieltermin_Monat_BOS_Rückstellung_2" SWORD FORMULA_0010 0 0.0 -32768.0 32767.0 READ_WRITE ECU_ADDRESS 0x3FA886 /end MEASUREMENT
/begin MEASUREMENT Bosid2 "Zieltermin_Monat_BOS_Rückstellung_2" UBYTE FORMULA_0003 0 0.0 0.0 255.0 READ_WRITE ECU_ADDRESS 0x3FA88B /end MEASUREMENT
/begin MEASUREMENT Bosjziel "Zieltermin_Monat_BOS_Rückstellung_2" UBYTE FORMULA_0003 0 0.0 0.0 255.0 READ_WRITE ECU_ADDRESS 0x3FA88C /end MEASUREMENT
/begin MEASUREMENT Bosmziel "Zieltermin_Monat_BOS_Meldung_2" UBYTE FORMULA_0003 0 0.0 0.0 255.0 READ_WRITE ECU_ADDRESS 0x3FA88D /end MEASUREMENT
/begin MEASUREMENT Bosprog2 "Prognose_Intervall_Zeit_BOS_Meldung_2" UBYTE FORMULA_0003 0 0.0 0.0 255.0 READ_WRITE ECU_ADDRESS 0x3FA88E /end MEASUREMENT
/begin MEASUREMENT Bosres "Zieltermin_Monat_BOS_Rückstellung_2" UBYTE FORMULA_0003 0 0.0 0.0 255.0 READ_WRITE ECU_ADDRESS 0x3FA88F /end MEASUREMENT
/begin MEASUREMENT Bosrlsm "Ausgabewert Restlaufstrecke Motoröl" SWORD FORMULA_0433 0 0.0 -327680.0 327670.0 READ_WRITE ECU_ADDRESS 0x3FA888 /end MEASUREMENT
/begin MEASUREMENT Bosrw2 "Prognose_Intervall_Weg_BOS_Meldung_2" UBYTE FORMULA_0434 0 0.0 0.0 255000.0 READ_WRITE ECU_ADDRESS 0x3FA890 /end MEASUREMENT
/begin MEASUREMENT Bosstate "Einheit der BOS-Info (km)" UBYTE FORMULA_0003 0 0.0 0.0 255.0 READ_WRITE ECU_ADDRESS 0x3FC9FA /end MEASUREMENT
/begin MEASUREMENT ekp_obd_verz "Verzoegerung Kraftstoffpumpen-Diagnose nach Dynamik" UWORD FORMULA_1025 0 0.0 0.0 6553.5 READ_WRITE ECU_ADDRESS 0x3FCA58 /end MEASUREMENT
/begin MEASUREMENT ekp_obd_vl_t "Vorlaufzeit Kraftstoffpumpe" UWORD FORMULA_1025 0 0.0 0.0 6553.5 READ_WRITE ECU_ADDRESS 0x3FCA56 /end MEASUREMENT
/begin MEASUREMENT Id_bosmg "Kennung für BOS-Meldung = Ölservice-Info" UWORD FORMULA_0010 0 0.0 0.0 65535.0 READ_WRITE ECU_ADDRESS 0x3FC9F8 /end MEASUREMENT
/begin MEASUREMENT Id_bosmgt "Kennung für BOS-Meldung vom Tester" UBYTE FORMULA_0003 0 0.0 0.0 255.0 READ_WRITE ECU_ADDRESS 0x3FC9FB /end MEASUREMENT
/begin MEASUREMENT Id_bosmsg "Kennung für BOS-Meldung vom Kombi" UBYTE FORMULA_0003 0 0.0 0.0 255.0 READ_WRITE ECU_ADDRESS 0x3FC9FC /end MEASUREMENT
/begin MEASUREMENT Ierrgrenz_ht "Grenzerregerstrom durch Überhitzung Dioden" UBYTE FORMULA_0464 0 0.0 0.0 31.875 READ_WRITE ECU_ADDRESS 0x3FCA54 /end MEASUREMENT
/begin MEASUREMENT kat_o2_per_cnt_passiv_b1 "akt, Zahl d. Zwangsperioden in PASSIV" UWORD FORMULA_0010 0 0.0 0.0 65535.0 READ_WRITE ECU_ADDRESS 0x3FC910 /end MEASUREMENT
/begin MEASUREMENT kat_o2_per_cnt_passiv_b2 "akt, Zahl d. Zwangsperioden in PASSIV" UWORD FORMULA_0010 0 0.0 0.0 65535.0 READ_WRITE ECU_ADDRESS 0x3FC912 /end MEASUREMENT
/begin MEASUREMENT kat_obd_fett_mager_b1 "Uebergang zu FETT nach MAGER" UWORD FORMULA_1011 0 0 0.0 255.0 READ_WRITE BIT_MASK 0x1 ECU_ADDRESS 0x3FC90C /end MEASUREMENT
/begin MEASUREMENT kat_obd_fett_mager_b2 "Uebergang zu FETT nach MAGER" UWORD FORMULA_1011 0 0 0.0 255.0 READ_WRITE BIT_MASK 0x1 ECU_ADDRESS 0x3FC90E /end MEASUREMENT
/begin MEASUREMENT kat_obd_gesamt_max "Diagnoseschwelle - Gesamtsystem-KAT-Diag." UWORD FORMULA_0025 0 0.0 0.0 3.999000072479248 READ_WRITE ECU_ADDRESS 0x3FC960 /end MEASUREMENT
/begin MEASUREMENT kat_obd_int_b1 "gemittelte Abweichung zum Mittelwert" UWORD FORMULA_0025 0 0.0 0.0 3.999000072479248 READ_WRITE ECU_ADDRESS 0x3FC944 /end MEASUREMENT
/begin MEASUREMENT kat_obd_int_b2 "gemittelte Abweichung zum Mittelwert" UWORD FORMULA_0025 0 0.0 0.0 3.999000072479248 READ_WRITE ECU_ADDRESS 0x3FC946 /end MEASUREMENT
/begin MEASUREMENT kat_obd_io_t_b1 "Verzoegerung d. Heilung" UWORD FORMULA_0021 0 0.0 0.0 655.0 READ_WRITE ECU_ADDRESS 0x3FC95C /end MEASUREMENT
/begin MEASUREMENT kat_obd_io_t_b2 "Verzoegerung d. Heilung" UWORD FORMULA_0021 0 0.0 0.0 655.0 READ_WRITE ECU_ADDRESS 0x3FC95E /end MEASUREMENT
/begin MEASUREMENT kat_obd_io_verz_b1 "Verzoegerung Fehlerheilung" UWORD FORMULA_1014 0 0 0.0 255.0 READ_WRITE BIT_MASK 0x8 ECU_ADDRESS 0x3FC90C /end MEASUREMENT
/begin MEASUREMENT kat_obd_io_verz_b2 "Verzoegerung Fehlerheilung" UWORD FORMULA_1014 0 0 0.0 255.0 READ_WRITE BIT_MASK 0x8 ECU_ADDRESS 0x3FC90E /end MEASUREMENT
/begin MEASUREMENT kat_obd_lank_chk1_b1 "Verifikationscheck1" UWORD FORMULA_1012 0 0 0.0 255.0 READ_WRITE BIT_MASK 0x2 ECU_ADDRESS 0x3FC90C /end MEASUREMENT
/begin MEASUREMENT kat_obd_lank_chk1_b2 "Verifikationscheck1" UWORD FORMULA_1012 0 0 0.0 255.0 READ_WRITE BIT_MASK 0x2 ECU_ADDRESS 0x3FC90E /end MEASUREMENT
/begin MEASUREMENT kat_obd_lank_chk2_b1 "Verifikationscheck2" UWORD FORMULA_1013 0 0 0.0 255.0 READ_WRITE BIT_MASK 0x4 ECU_ADDRESS 0x3FC90C /end MEASUREMENT
/begin MEASUREMENT kat_obd_lank_chk2_b2 "Verifikationscheck2" UWORD FORMULA_1013 0 0 0.0 255.0 READ_WRITE BIT_MASK 0x4 ECU_ADDRESS 0x3FC90E /end MEASUREMENT
/begin MEASUREMENT kat_obd_lank_diff_b1 "Abweichung des akt. LANK-LA-Werts zum Mittelwert" UWORD FORMULA_0025 0 0.0 0.0 3.999000072479248 READ_WRITE ECU_ADDRESS 0x3FC928 /end MEASUREMENT
/begin MEASUREMENT kat_obd_lank_diff_b2 "Abweichung des akt. LANK-LA-Werts zum Mittelwert" UWORD FORMULA_0025 0 0.0 0.0 3.999000072479248 READ_WRITE ECU_ADDRESS 0x3FC92A /end MEASUREMENT
/begin MEASUREMENT kat_obd_lank_diff_sum_b1 "aufsummierte Abweichung d. akt. Werts zum Mittelwert" ULONG FORMULA_1016 0 0.0 0.0 262143.9999 READ_WRITE ECU_ADDRESS 0x3FC92C /end MEASUREMENT
/begin MEASUREMENT kat_obd_lank_diff_sum_b2 "aufsummierte Abweichung d. akt. Werts zum Mittelwert" ULONG FORMULA_1016 0 0.0 0.0 262143.9999 READ_WRITE ECU_ADDRESS 0x3FC930 /end MEASUREMENT
/begin MEASUREMENT kat_obd_lank_diff_sum_f_b1 "aufsummierte Abweichung zum MW - Zyklus FETT" ULONG FORMULA_1016 0 0.0 0.0 262143.9999 READ_WRITE ECU_ADDRESS 0x3FC934 /end MEASUREMENT
/begin MEASUREMENT kat_obd_lank_diff_sum_f_b2 "aufsummierte Abweichung zum MW - Zyklus FETT" ULONG FORMULA_1016 0 0.0 0.0 262143.9999 READ_WRITE ECU_ADDRESS 0x3FC938 /end MEASUREMENT
/begin MEASUREMENT kat_obd_lank_diff_sum_m_b1 "aufsummierte Abweichung zum MW - Zyklus MAGER" ULONG FORMULA_1016 0 0.0 0.0 262143.9999 READ_WRITE ECU_ADDRESS 0x3FC93C /end MEASUREMENT
/begin MEASUREMENT kat_obd_lank_diff_sum_m_b2 "aufsummierte Abweichung zum MW - Zyklus MAGER" ULONG FORMULA_1016 0 0.0 0.0 262143.9999 READ_WRITE ECU_ADDRESS 0x3FC940 /end MEASUREMENT
/begin MEASUREMENT kat_obd_lank_mw_b1 "gemittelter NKAT-LA-Wert" UWORD FORMULA_0025 0 0.0 0.0 3.999000072479248 READ_WRITE ECU_ADDRESS 0x3FC924 /end MEASUREMENT
/begin MEASUREMENT kat_obd_lank_mw_b2 "gemittelter NKAT-LA-Wert" UWORD FORMULA_0025 0 0.0 0.0 3.999000072479248 READ_WRITE ECU_ADDRESS 0x3FC926 /end MEASUREMENT
/begin MEASUREMENT kat_obd_lank_sum_b1 "aufsummierter NKAT-LA-Wert" ULONG FORMULA_1016 0 0.0 0.0 262143.9999 READ_WRITE ECU_ADDRESS 0x3FC918 /end MEASUREMENT
/begin MEASUREMENT kat_obd_lank_sum_b2 "aufsummierter NKAT-LA-Wert" ULONG FORMULA_1016 0 0.0 0.0 262143.9999 READ_WRITE ECU_ADDRESS 0x3FC91C /end MEASUREMENT
/begin MEASUREMENT kat_obd_st_b1 "KAT-Diagnose Status" UWORD FORMULA_0080 0 0.0 0.0 65535.0 READ_WRITE ECU_ADDRESS 0x3FC90C /end MEASUREMENT
/begin MEASUREMENT kat_obd_st_b2 "KAT-Diagnose Status" UWORD FORMULA_0080 0 0.0 0.0 65535.0 READ_WRITE ECU_ADDRESS 0x3FC90E /end MEASUREMENT
/begin MEASUREMENT kat_obd_t_cnt_b1 "Zaehler - aufsummierten NKAT-LA-Werte" UWORD FORMULA_0010 0 0.0 0.0 65535.0 READ_WRITE ECU_ADDRESS 0x3FC920 /end MEASUREMENT
/begin MEASUREMENT kat_obd_t_cnt_b2 "Zaehler - aufsummierten NKAT-LA-Werte" UWORD FORMULA_0010 0 0.0 0.0 65535.0 READ_WRITE ECU_ADDRESS 0x3FC922 /end MEASUREMENT
/begin MEASUREMENT kat_obd_verh_b1 "Wichtungsverhaeltnis - Diag.Wert" UWORD FORMULA_0073 0 0.0 0.0 20.0 READ_WRITE ECU_ADDRESS 0x3FC954 /end MEASUREMENT
/begin MEASUREMENT kat_obd_verh_b2 "Wichtungsverhaeltnis - Diag.Wert" UWORD FORMULA_0073 0 0.0 0.0 20.0 READ_WRITE ECU_ADDRESS 0x3FC956 /end MEASUREMENT
/begin MEASUREMENT kat_obd_verh_cnt_b1 "Zaehler - verworfene Messungen" UWORD FORMULA_0010 0 0.0 0.0 65535.0 READ_WRITE ECU_ADDRESS 0x3FC958 /end MEASUREMENT
/begin MEASUREMENT kat_obd_verh_cnt_b2 "Zaehler - verworfene Messungen" UWORD FORMULA_0010 0 0.0 0.0 65535.0 READ_WRITE ECU_ADDRESS 0x3FC95A /end MEASUREMENT
/begin MEASUREMENT kat_obd_wert_ermittlung_b1 "Diagnosewert-Ermittlung" UWORD FORMULA_1015 0 0 0.0 255.0 READ_WRITE BIT_MASK 0x10 ECU_ADDRESS 0x3FC90C /end MEASUREMENT
/begin MEASUREMENT kat_obd_wert_ermittlung_b2 "Diagnosewert-Ermittlung" UWORD FORMULA_1015 0 0 0.0 255.0 READ_WRITE BIT_MASK 0x10 ECU_ADDRESS 0x3FC90E /end MEASUREMENT
/begin MEASUREMENT kat_obd_wert_max_b1 "Diagnoseschwelle - max. KAT-Diag." UWORD FORMULA_0025 0 0.0 0.0 3.999000072479248 READ_WRITE ECU_ADDRESS 0x3FC962 /end MEASUREMENT
/begin MEASUREMENT kat_obd_wert_max_b2 "Diagnoseschwelle - max. KAT-Diag." UWORD FORMULA_0025 0 0.0 0.0 3.999000072479248 READ_WRITE ECU_ADDRESS 0x3FC964 /end MEASUREMENT
/begin MEASUREMENT kat_obd_wicht_b1 "gewichtete gem. Abweichung zum Mittelwert" UWORD FORMULA_0025 0 0.0 0.0 3.999000072479248 READ_WRITE ECU_ADDRESS 0x3FC948 /end MEASUREMENT
/begin MEASUREMENT kat_obd_wicht_b2 "gewichtete gem. Abweichung zum Mittelwert" UWORD FORMULA_0025 0 0.0 0.0 3.999000072479248 READ_WRITE ECU_ADDRESS 0x3FC94A /end MEASUREMENT
/begin MEASUREMENT kat_obd_wicht_sum_b1 "aufsum. gewichtete gem. Abweichung z. MW" ULONG FORMULA_1016 0 0.0 0.0 262143.9999 READ_WRITE ECU_ADDRESS 0x3FC94C /end MEASUREMENT
/begin MEASUREMENT kat_obd_wicht_sum_b2 "aufsum. gewichtete gem. Abweichung z. MW" ULONG FORMULA_1016 0 0.0 0.0 262143.9999 READ_WRITE ECU_ADDRESS 0x3FC950 /end MEASUREMENT
/begin MEASUREMENT kat_obd_zust_st_b1 "KAT-Diagnose Zustandsautomat" UWORD FORMULA_1010 0 0.0 0.0 65535.0 READ_WRITE BIT_MASK 0x1F ECU_ADDRESS 0x3FC908 /end MEASUREMENT
/begin MEASUREMENT kat_obd_zust_st_b2 "KAT-Diagnose Zustandsautomat" UWORD FORMULA_1010 0 0.0 0.0 65535.0 READ_WRITE BIT_MASK 0x1F ECU_ADDRESS 0x3FC90A /end MEASUREMENT
/begin MEASUREMENT kat_obd_zykl_cnt_b1 "Anzahl d. gueltigen Zyklen" UWORD FORMULA_0010 0 0.0 0.0 65535.0 READ_WRITE ECU_ADDRESS 0x3FC914 /end MEASUREMENT
/begin MEASUREMENT kat_obd_zykl_cnt_b2 "Anzahl d. gueltigen Zyklen" UWORD FORMULA_0010 0 0.0 0.0 65535.0 READ_WRITE ECU_ADDRESS 0x3FC916 /end MEASUREMENT
/begin MEASUREMENT lavk_obd_dyn_ampl_b1 "Amplitude pro Periode" UWORD FORMULA_0025 0 0.0 0.0 3.999000072479248 READ_WRITE ECU_ADDRESS 0x3FC972 /end MEASUREMENT
/begin MEASUREMENT lavk_obd_dyn_ampl_b2 "Amplitude pro Periode" UWORD FORMULA_0025 0 0.0 0.0 3.999000072479248 READ_WRITE ECU_ADDRESS 0x3FC974 /end MEASUREMENT
/begin MEASUREMENT lavk_obd_dyn_ampl_cnt_b1 "Zaehler - gueltige Perioden" UWORD FORMULA_0010 0 0.0 0.0 65535.0 READ_WRITE ECU_ADDRESS 0x3FC99C /end MEASUREMENT
/begin MEASUREMENT lavk_obd_dyn_ampl_cnt_b2 "Zaehler - gueltige Perioden" UWORD FORMULA_0010 0 0.0 0.0 65535.0 READ_WRITE ECU_ADDRESS 0x3FC99E /end MEASUREMENT
/begin MEASUREMENT lavk_obd_dyn_ampl_max_b1 "max. zulaessige Amplitude" UWORD FORMULA_0025 0 0.0 0.0 3.999000072479248 READ_WRITE ECU_ADDRESS 0x3FC97A /end MEASUREMENT
/begin MEASUREMENT lavk_obd_dyn_ampl_max_b2 "max. zulaessige Amplitude" UWORD FORMULA_0025 0 0.0 0.0 3.999000072479248 READ_WRITE ECU_ADDRESS 0x3FC97C /end MEASUREMENT
/begin MEASUREMENT lavk_obd_dyn_ampl_max_mw_b1 "gem. max. Amplitude" UWORD FORMULA_0025 0 0.0 0.0 3.999000072479248 READ_WRITE ECU_ADDRESS 0x3FC982 /end MEASUREMENT
/begin MEASUREMENT lavk_obd_dyn_ampl_max_mw_b2 "gem. max. Amplitude" UWORD FORMULA_0025 0 0.0 0.0 3.999000072479248 READ_WRITE ECU_ADDRESS 0x3FC984 /end MEASUREMENT
/begin MEASUREMENT lavk_obd_dyn_ampl_min_b1 "min. zulaessige Amplitude" UWORD FORMULA_0025 0 0.0 0.0 3.999000072479248 READ_WRITE ECU_ADDRESS 0x3FC97E /end MEASUREMENT
/begin MEASUREMENT lavk_obd_dyn_ampl_min_b2 "min. zulaessige Amplitude" UWORD FORMULA_0025 0 0.0 0.0 3.999000072479248 READ_WRITE ECU_ADDRESS 0x3FC980 /end MEASUREMENT
/begin MEASUREMENT lavk_obd_dyn_ampl_min_mw_b1 "gem. min. Amplitude" UWORD FORMULA_0025 0 0.0 0.0 3.999000072479248 READ_WRITE ECU_ADDRESS 0x3FC986 /end MEASUREMENT
/begin MEASUREMENT lavk_obd_dyn_ampl_min_mw_b2 "gem. min. Amplitude" UWORD FORMULA_0025 0 0.0 0.0 3.999000072479248 READ_WRITE ECU_ADDRESS 0x3FC988 /end MEASUREMENT
/begin MEASUREMENT lavk_obd_dyn_ampl_mw_b1 "gemittelte Amplitude" UWORD FORMULA_0025 0 0.0 0.0 3.999000072479248 READ_WRITE ECU_ADDRESS 0x3FC976 /end MEASUREMENT
/begin MEASUREMENT lavk_obd_dyn_ampl_mw_b2 "gemittelte Amplitude" UWORD FORMULA_0025 0 0.0 0.0 3.999000072479248 READ_WRITE ECU_ADDRESS 0x3FC978 /end MEASUREMENT
/begin MEASUREMENT lavk_obd_dyn_ampl_sum_b1 "aufsummierte Amplitude" ULONG FORMULA_1016 0 0.0 0.0 262143.9999 READ_WRITE ECU_ADDRESS 0x3FC98C /end MEASUREMENT
/begin MEASUREMENT lavk_obd_dyn_ampl_sum_b2 "aufsummierte Amplitude" ULONG FORMULA_1016 0 0.0 0.0 262143.9999 READ_WRITE ECU_ADDRESS 0x3FC990 /end MEASUREMENT
/begin MEASUREMENT lavk_obd_dyn_exd_b1 "Externe Ansteuerung" UWORD FORMULA_1020 0 0 0.0 255.0 READ_WRITE BIT_MASK 0x800 ECU_ADDRESS 0x3FC966 /end MEASUREMENT
/begin MEASUREMENT lavk_obd_dyn_exd_b2 "Externe Ansteuerung" UWORD FORMULA_1020 0 0 0.0 255.0 READ_WRITE BIT_MASK 0x800 ECU_ADDRESS 0x3FC968 /end MEASUREMENT
/begin MEASUREMENT lavk_obd_dyn_gesamt_max "Diagnoseschwelle - Gesamtsystem dyn. Sondendiag." UWORD FORMULA_0025 0 0.0 0.0 3.999000072479248 READ_WRITE ECU_ADDRESS 0x3FC9B6 /end MEASUREMENT
/begin MEASUREMENT lavk_obd_dyn_io_t_b1 "Verzoegerung d. Heilung" UWORD FORMULA_0021 0 0.0 0.0 655.0 READ_WRITE ECU_ADDRESS 0x3FC9AC /end MEASUREMENT
/begin MEASUREMENT lavk_obd_dyn_io_t_b2 "Verzoegerung d. Heilung" UWORD FORMULA_0021 0 0.0 0.0 655.0 READ_WRITE ECU_ADDRESS 0x3FC9AE /end MEASUREMENT
/begin MEASUREMENT lavk_obd_dyn_io_verz_b1 "Verzoegerung Fehlerheilung" UWORD FORMULA_1007 0 0 0.0 255.0 READ_WRITE BIT_MASK 0x100 ECU_ADDRESS 0x3FC966 /end MEASUREMENT
/begin MEASUREMENT lavk_obd_dyn_io_verz_b2 "Verzoegerung Fehlerheilung" UWORD FORMULA_1007 0 0 0.0 255.0 READ_WRITE BIT_MASK 0x100 ECU_ADDRESS 0x3FC968 /end MEASUREMENT
/begin MEASUREMENT lavk_obd_dyn_kat_exd_lam_soll "zusaetzlicher LAM-SOLL-OFFSET - bei ext. Anforderung" SWORD FORMULA_0025 0 0.0 -2.0 1.998999953269959 READ_WRITE ECU_ADDRESS 0x3FC9B8 /end MEASUREMENT
/begin MEASUREMENT lavk_obd_dyn_kat_exd_t_b1 "Prueflauf Freigabezeit" UWORD FORMULA_0921 0 0.0 0.0 655.3499755859375 READ_WRITE ECU_ADDRESS 0x3FC9A8 /end MEASUREMENT
/begin MEASUREMENT lavk_obd_dyn_kat_exd_t_b2 "Prueflauf Freigabezeit" UWORD FORMULA_0921 0 0.0 0.0 655.3499755859375 READ_WRITE ECU_ADDRESS 0x3FC9AA /end MEASUREMENT
/begin MEASUREMENT lavk_obd_dyn_max_b1 "Ermittlung max. LA-Wert" UWORD FORMULA_1018 0 0 0.0 255.0 READ_WRITE BIT_MASK 0x20 ECU_ADDRESS 0x3FC966 /end MEASUREMENT
/begin MEASUREMENT lavk_obd_dyn_max_b2 "Ermittlung max. LA-Wert" UWORD FORMULA_1018 0 0 0.0 255.0 READ_WRITE BIT_MASK 0x20 ECU_ADDRESS 0x3FC968 /end MEASUREMENT
/begin MEASUREMENT lavk_obd_dyn_min_b1 "Ermittlung min. LA-Wert" UWORD FORMULA_1019 0 0 0.0 255.0 READ_WRITE BIT_MASK 0x40 ECU_ADDRESS 0x3FC966 /end MEASUREMENT
/begin MEASUREMENT lavk_obd_dyn_min_b2 "Ermittlung min. LA-Wert" UWORD FORMULA_1019 0 0 0.0 255.0 READ_WRITE BIT_MASK 0x40 ECU_ADDRESS 0x3FC968 /end MEASUREMENT
/begin MEASUREMENT lavk_obd_dyn_mw_max_b1 "max. Lambda-Regeleingriff pro Periode" UWORD FORMULA_0025 0 0.0 0.0 1.990000009536743 READ_WRITE ECU_ADDRESS 0x3FC96A /end MEASUREMENT
/begin MEASUREMENT lavk_obd_dyn_mw_max_b2 "max. Lambda-Regeleingriff pro Periode" UWORD FORMULA_0025 0 0.0 0.0 1.990000009536743 READ_WRITE ECU_ADDRESS 0x3FC96C /end MEASUREMENT
/begin MEASUREMENT lavk_obd_dyn_mw_min_b1 "min. Lambda-Regeleingriff pro Periode" UWORD FORMULA_0025 0 0.0 0.0 1.990000009536743 READ_WRITE ECU_ADDRESS 0x3FC96E /end MEASUREMENT
/begin MEASUREMENT lavk_obd_dyn_mw_min_b2 "min. Lambda-Regeleingriff pro Periode" UWORD FORMULA_0025 0 0.0 0.0 1.990000009536743 READ_WRITE ECU_ADDRESS 0x3FC970 /end MEASUREMENT
/begin MEASUREMENT lavk_obd_dyn_norm_b1 "normierte Amplitude" UWORD FORMULA_0025 0 0.0 0.0 3.999000072479248 READ_WRITE ECU_ADDRESS 0x3FC9A4 /end MEASUREMENT
/begin MEASUREMENT lavk_obd_dyn_norm_b2 "normierte Amplitude" UWORD FORMULA_0025 0 0.0 0.0 3.999000072479248 READ_WRITE ECU_ADDRESS 0x3FC9A6 /end MEASUREMENT
/begin MEASUREMENT lavk_obd_dyn_norm_cnt_b1 "Zaehler - gueltige Diagnosezyklen" UWORD FORMULA_0010 0 0.0 0.0 65535.0 READ_WRITE ECU_ADDRESS 0x3FC9A0 /end MEASUREMENT
/begin MEASUREMENT lavk_obd_dyn_norm_cnt_b2 "Zaehler - gueltige Diagnosezyklen" UWORD FORMULA_0010 0 0.0 0.0 65535.0 READ_WRITE ECU_ADDRESS 0x3FC9A2 /end MEASUREMENT
/begin MEASUREMENT lavk_obd_dyn_norm_sum_b1 "aufsummierte normierte Amplitude" ULONG FORMULA_1016 0 0.0 0.0 262143.9999 READ_WRITE ECU_ADDRESS 0x3FC994 /end MEASUREMENT
/begin MEASUREMENT lavk_obd_dyn_norm_sum_b2 "aufsummierte normierte Amplitude" ULONG FORMULA_1016 0 0.0 0.0 262143.9999 READ_WRITE ECU_ADDRESS 0x3FC998 /end MEASUREMENT
/begin MEASUREMENT lavk_obd_dyn_rf_min "min. relative Füllung f. dyn. Sondendiag." SWORD FORMULA_0007 0 0.0 0.0 2.0 READ_WRITE ECU_ADDRESS 0x3FC9B4 /end MEASUREMENT
/begin MEASUREMENT lavk_obd_dyn_st_b1 "dynamische LA-VKAT-Diagnose" UWORD FORMULA_0080 0 0.0 0.0 65535.0 READ_WRITE ECU_ADDRESS 0x3FC966 /end MEASUREMENT
/begin MEASUREMENT lavk_obd_dyn_st_b2 "dynamische LA-VKAT-Diagnose" UWORD FORMULA_0080 0 0.0 0.0 65535.0 READ_WRITE ECU_ADDRESS 0x3FC968 /end MEASUREMENT
/begin MEASUREMENT lavk_obd_dyn_wert_max_b1 "Diagnoseschwelle - dyn. Sondendiag." UWORD FORMULA_0025 0 0.0 0.0 3.999000072479248 READ_WRITE ECU_ADDRESS 0x3FC9B0 /end MEASUREMENT
/begin MEASUREMENT lavk_obd_dyn_wert_max_b2 "Diagnoseschwelle - dyn. Sondendiag." UWORD FORMULA_0025 0 0.0 0.0 3.999000072479248 READ_WRITE ECU_ADDRESS 0x3FC9B2 /end MEASUREMENT
/begin MEASUREMENT lavk_obd_dyn_zustand_b1 "Zustand - dynamische LA-VKAT-Diagnose" UWORD FORMULA_1017 0 0.0 0.0 65535.0 READ_WRITE BIT_MASK 0x1F ECU_ADDRESS 0x3FC966 /end MEASUREMENT
/begin MEASUREMENT lavk_obd_dyn_zustand_b2 "Zustand - dynamische LA-VKAT-Diagnose" UWORD FORMULA_1017 0 0.0 0.0 65535.0 READ_WRITE BIT_MASK 0x1F ECU_ADDRESS 0x3FC968 /end MEASUREMENT
/begin MEASUREMENT N_ozmw "kurzzeitiger Mittelwert Drehzahl" SWORD FORMULA_0006 0 0.0 -32767.0 32767.0 READ_WRITE ECU_ADDRESS 0x3FAF5C /end MEASUREMENT
/begin MEASUREMENT Nelueft_gen "Drehzahlanforderung E-Lüfter Generator" UBYTE FORMULA_0475 0 0.0 0.0 99.60929870605469 READ_WRITE ECU_ADDRESS 0x3FCA53 /end MEASUREMENT
/begin MEASUREMENT nwm_ecu_nr "ECU-Nummer" UBYTE FORMULA_0003 0 0.0 0.0 255.0 READ_WRITE ECU_ADDRESS 0x3F8F04 /end MEASUREMENT
/begin MEASUREMENT nwm_RecvCopyMsgUser "MsgUser" UBYTE FORMULA_0003 0 0.0 0.0 255.0 READ_WRITE ARRAY_SIZE 6 ECU_ADDRESS 0x3F8F14 MATRIX_DIM 6 1 1 /end MEASUREMENT
/begin MEASUREMENT Nwm_var_s.flags1 "Flags" UBYTE FORMULA_0003 0 0.0 0.0 255.0 READ_WRITE ECU_ADDRESS 0x3F8EDD /end MEASUREMENT
/begin MEASUREMENT Nwm_var_s.MsgDest "Ring-Destination" UBYTE FORMULA_0993 0 0.0 0.0 255.0 READ_WRITE ECU_ADDRESS 0x3F8EE0 /end MEASUREMENT
/begin MEASUREMENT Nwm_var_s.MsgTyp "Ring-Typ" UBYTE FORMULA_0994 0 0.0 0.0 255.0 READ_WRITE ECU_ADDRESS 0x3F8EE1 /end MEASUREMENT
/begin MEASUREMENT Nwm_var_s.MsgUser1 "Ring-User1" UBYTE FORMULA_0003 0 0.0 0.0 255.0 READ_WRITE ECU_ADDRESS 0x3F8EE2 /end MEASUREMENT
/begin MEASUREMENT Nwm_var_s.MsgUser2 "Ring-User2" UBYTE FORMULA_0003 0 0.0 0.0 255.0 READ_WRITE ECU_ADDRESS 0x3F8EE3 /end MEASUREMENT
/begin MEASUREMENT Nwm_var_s.nwmAction "State of statemachine" UBYTE FORMULA_0995 0 0.0 0.0 255.0 READ_WRITE ECU_ADDRESS 0x3F8EED /end MEASUREMENT
/begin MEASUREMENT Nwm_var_s.rxTxCounter "counter for rx/tx" UBYTE FORMULA_0003 0 0.0 0.0 255.0 READ_WRITE ECU_ADDRESS 0x3F8EF0 /end MEASUREMENT
/begin MEASUREMENT Nwm_var_s.state "Status" UBYTE FORMULA_0003 0 0.0 0.0 255.0 READ_WRITE ECU_ADDRESS 0x3F8EDC /end MEASUREMENT
/begin MEASUREMENT Nwm_var_s.successorEcu "Successor ECU" UBYTE FORMULA_0993 0 0.0 0.0 255.0 READ_WRITE ECU_ADDRESS 0x3F8EEE /end MEASUREMENT
/begin MEASUREMENT Nwm_var_s.timeCounter "Timeout counter" UBYTE FORMULA_0003 0 0.0 0.0 255.0 READ_WRITE ECU_ADDRESS 0x3F8EEC /end MEASUREMENT
/begin MEASUREMENT Nwm_var_s.txEcuNumber "Logical sender number" UBYTE FORMULA_0993 0 0.0 0.0 255.0 READ_WRITE ECU_ADDRESS 0x3F8EEF /end MEASUREMENT
/begin MEASUREMENT nwm_weckverursacher "Weck-Verursacher" UBYTE FORMULA_0993 0 0.0 0.0 255.0 READ_WRITE ECU_ADDRESS 0x3F8F1A /end MEASUREMENT
/begin MEASUREMENT o2_lam_soll_fett_hub_b1 "FETT-HUB" UWORD FORMULA_0844 0 0 0.0 255.0 READ_WRITE BIT_MASK 0x8 ECU_ADDRESS 0x3FC8E8 /end MEASUREMENT
/begin MEASUREMENT o2_lam_soll_fett_hub_b2 "FETT-HUB" UWORD FORMULA_0844 0 0 0.0 255.0 READ_WRITE BIT_MASK 0x8 ECU_ADDRESS 0x3FC8EA /end MEASUREMENT
/begin MEASUREMENT o2_lam_soll_fett_hub_trig_b1 "FETT-HUB nach Adaption" UWORD FORMULA_1002 0 0 0.0 255.0 READ_WRITE BIT_MASK 0x2 ECU_ADDRESS 0x3FC8E8 /end MEASUREMENT
/begin MEASUREMENT o2_lam_soll_fett_hub_trig_b2 "FETT-HUB nach Adaption" UWORD FORMULA_1002 0 0 0.0 255.0 READ_WRITE BIT_MASK 0x2 ECU_ADDRESS 0x3FC8EA /end MEASUREMENT
/begin MEASUREMENT o2_lam_soll_fett_ukp_b1 "Umkehrpunkt im FETT-Hub" UWORD FORMULA_1004 0 0 0.0 255.0 READ_WRITE BIT_MASK 0x20 ECU_ADDRESS 0x3FC8E8 /end MEASUREMENT
/begin MEASUREMENT o2_lam_soll_fett_ukp_b2 "Umkehrpunkt im FETT-Hub" UWORD FORMULA_1004 0 0 0.0 255.0 READ_WRITE BIT_MASK 0x20 ECU_ADDRESS 0x3FC8EA /end MEASUREMENT
/begin MEASUREMENT o2_lam_soll_mager_hub_b1 "MAGER-HUB" UWORD FORMULA_0769 0 0 0.0 255.0 READ_WRITE BIT_MASK 0x10 ECU_ADDRESS 0x3FC8E8 /end MEASUREMENT
/begin MEASUREMENT o2_lam_soll_mager_hub_b2 "MAGER-HUB" UWORD FORMULA_0769 0 0 0.0 255.0 READ_WRITE BIT_MASK 0x10 ECU_ADDRESS 0x3FC8EA /end MEASUREMENT
/begin MEASUREMENT o2_lam_soll_mager_hub_trig_b1 "MAGER-HUB nach Adaption" UWORD FORMULA_1003 0 0 0.0 255.0 READ_WRITE BIT_MASK 0x4 ECU_ADDRESS 0x3FC8E8 /end MEASUREMENT
/begin MEASUREMENT o2_lam_soll_mager_hub_trig_b2 "MAGER-HUB nach Adaption" UWORD FORMULA_1003 0 0 0.0 255.0 READ_WRITE BIT_MASK 0x4 ECU_ADDRESS 0x3FC8EA /end MEASUREMENT
/begin MEASUREMENT o2_lam_soll_mager_per_b1 "Periodendauerberechnung auf MAGER-HUB" UWORD FORMULA_1006 0 0 0.0 255.0 READ_WRITE BIT_MASK 0x80 ECU_ADDRESS 0x3FC8E8 /end MEASUREMENT
/begin MEASUREMENT o2_lam_soll_mager_per_b2 "Periodendauerberechnung auf MAGER-HUB" UWORD FORMULA_1006 0 0 0.0 255.0 READ_WRITE BIT_MASK 0x80 ECU_ADDRESS 0x3FC8EA /end MEASUREMENT
/begin MEASUREMENT o2_lam_soll_mager_ukp_b1 "Umkehrpunkt im MAGER-Hub" UWORD FORMULA_1005 0 0 0.0 255.0 READ_WRITE BIT_MASK 0x40 ECU_ADDRESS 0x3FC8E8 /end MEASUREMENT
/begin MEASUREMENT o2_lam_soll_mager_ukp_b2 "Umkehrpunkt im MAGER-Hub" UWORD FORMULA_1005 0 0 0.0 255.0 READ_WRITE BIT_MASK 0x40 ECU_ADDRESS 0x3FC8EA /end MEASUREMENT
/begin MEASUREMENT o2_lam_soll_pus_b1 "Aktivierung Pulsgenerator" UWORD FORMULA_1001 0 0 0.0 255.0 READ_WRITE BIT_MASK 0x1 ECU_ADDRESS 0x3FC8E8 /end MEASUREMENT
/begin MEASUREMENT o2_lam_soll_pus_b2 "Aktivierung Pulsgenerator" UWORD FORMULA_1001 0 0 0.0 255.0 READ_WRITE BIT_MASK 0x1 ECU_ADDRESS 0x3FC8EA /end MEASUREMENT
/begin MEASUREMENT o2_obd_dyn_t_b1 "Verzoegerungszeit bei Dynamik" UWORD FORMULA_0763 0 0.0 0.0 65535.0 READ_WRITE ECU_ADDRESS 0x3FC900 /end MEASUREMENT
/begin MEASUREMENT o2_obd_dyn_t_b2 "Verzoegerungszeit bei Dynamik" UWORD FORMULA_0763 0 0.0 0.0 65535.0 READ_WRITE ECU_ADDRESS 0x3FC902 /end MEASUREMENT
/begin MEASUREMENT o2_obd_dyn_t_verz_b1 "Verzoegerungszeit nach Dynamik" UWORD FORMULA_1007 0 0 0.0 255.0 READ_WRITE BIT_MASK 0x100 ECU_ADDRESS 0x3FC8E8 /end MEASUREMENT
/begin MEASUREMENT o2_obd_dyn_t_verz_b2 "Verzoegerungszeit nach Dynamik" UWORD FORMULA_1007 0 0 0.0 255.0 READ_WRITE BIT_MASK 0x100 ECU_ADDRESS 0x3FC8EA /end MEASUREMENT
/begin MEASUREMENT o2_obd_lam_soll_offs "LAM-SOLL-OFFSET - zusaetzliche Anfettung/Abmagerung" SWORD FORMULA_0025 0 0.0 -2.0 1.998999953269959 READ_WRITE ARRAY_SIZE 2 ECU_ADDRESS 0x3FC904 MATRIX_DIM 2 1 1 /end MEASUREMENT
/begin MEASUREMENT o2_obd_period_cnt_b1 "Anzahl d. durchgefuehrten Zwangsperioden" UWORD FORMULA_0010 0 0.0 0.0 65535.0 READ_WRITE ECU_ADDRESS 0x3FC8F8 /end MEASUREMENT
/begin MEASUREMENT o2_obd_period_cnt_b2 "Anzahl d. durchgefuehrten Zwangsperioden" UWORD FORMULA_0010 0 0.0 0.0 65535.0 READ_WRITE ECU_ADDRESS 0x3FC8FA /end MEASUREMENT
/begin MEASUREMENT o2_obd_rf_min_schwelle_b1 "RF-MIN-Schwelle" UWORD FORMULA_1009 0 0 0.0 255.0 READ_WRITE BIT_MASK 0x400 ECU_ADDRESS 0x3FC8E8 /end MEASUREMENT
/begin MEASUREMENT o2_obd_rf_min_schwelle_b2 "RF-MIN-Schwelle" UWORD FORMULA_1009 0 0 0.0 255.0 READ_WRITE BIT_MASK 0x400 ECU_ADDRESS 0x3FC8EA /end MEASUREMENT
/begin MEASUREMENT o2_obd_st_b1 "O2-OBD-Status" UWORD FORMULA_0080 0 0.0 0.0 65535.0 READ_WRITE ECU_ADDRESS 0x3FC8E8 /end MEASUREMENT
/begin MEASUREMENT o2_obd_st_b2 "O2-OBD-Status" UWORD FORMULA_0080 0 0.0 0.0 65535.0 READ_WRITE ECU_ADDRESS 0x3FC8EA /end MEASUREMENT
/begin MEASUREMENT o2_obd_t_fett_b1 "Zeit der FETT-Beladung" UWORD FORMULA_0763 0 0.0 0.0 65535.0 READ_WRITE ECU_ADDRESS 0x3FC8F4 /end MEASUREMENT
/begin MEASUREMENT o2_obd_t_fett_b2 "Zeit der FETT-Beladung" UWORD FORMULA_0763 0 0.0 0.0 65535.0 READ_WRITE ECU_ADDRESS 0x3FC8F6 /end MEASUREMENT
/begin MEASUREMENT o2_obd_t_mager_b1 "Zeit der MAGER-Beladung" UWORD FORMULA_0763 0 0.0 0.0 65535.0 READ_WRITE ECU_ADDRESS 0x3FC8F0 /end MEASUREMENT
/begin MEASUREMENT o2_obd_t_mager_b2 "Zeit der MAGER-Beladung" UWORD FORMULA_0763 0 0.0 0.0 65535.0 READ_WRITE ECU_ADDRESS 0x3FC8F2 /end MEASUREMENT
/begin MEASUREMENT o2_obd_t_sum_b1 "Periodendauer d. Zwangsanregung" UWORD FORMULA_0763 0 0.0 0.0 65535.0 READ_WRITE ECU_ADDRESS 0x3FC8EC /end MEASUREMENT
/begin MEASUREMENT o2_obd_t_sum_b2 "Periodendauer d. Zwangsanregung" UWORD FORMULA_0763 0 0.0 0.0 65535.0 READ_WRITE ECU_ADDRESS 0x3FC8EE /end MEASUREMENT
/begin MEASUREMENT o2_obd_tkat_min_b1 "TKAT-MIN-Schwelle" UWORD FORMULA_1008 0 0 0.0 255.0 READ_WRITE BIT_MASK 0x200 ECU_ADDRESS 0x3FC8E8 /end MEASUREMENT
/begin MEASUREMENT o2_obd_tkat_min_b2 "TKAT-MIN-Schwelle" UWORD FORMULA_1008 0 0 0.0 255.0 READ_WRITE BIT_MASK 0x200 ECU_ADDRESS 0x3FC8EA /end MEASUREMENT
/begin MEASUREMENT o2_rf_min_schw_t_b1 "Verzoegerungszeit bei RF-MIN-Verletzung" UWORD FORMULA_0763 0 0.0 0.0 65535.0 READ_WRITE ECU_ADDRESS 0x3FC8FC /end MEASUREMENT
/begin MEASUREMENT o2_rf_min_schw_t_b2 "Verzoegerungszeit bei RF-MIN-Verletzung" UWORD FORMULA_0763 0 0.0 0.0 65535.0 READ_WRITE ECU_ADDRESS 0x3FC8FE /end MEASUREMENT
/begin MEASUREMENT Oz_abstellm "Abstellzeit für OZ" UWORD FORMULA_0440 0 0.0 0.0 65535.0 READ_WRITE ECU_ADDRESS 0x3FA8D2 /end MEASUREMENT
/begin MEASUREMENT Oz_anztoe "Anzahl Werte von Töns in der Sekunde" UBYTE FORMULA_0003 0 0.0 0.0 255.0 READ_WRITE ECU_ADDRESS 0x3FAF52 /end MEASUREMENT
/begin MEASUREMENT Oz_beschcnt "Zähler Beschleunigungsausblendung" UBYTE FORMULA_0003 0 0.0 0.0 255.0 READ_WRITE ECU_ADDRESS 0x3FAF6F /end MEASUREMENT
/begin MEASUREMENT Oz_cttagini "Tag beim Ölwechsel" SWORD FORMULA_0010 0 0.0 -32768.0 32767.0 READ_WRITE ECU_ADDRESS 0x3FA8EC /end MEASUREMENT
/begin MEASUREMENT Oz_diagtoens "Töns Diagnose Byte" UWORD FORMULA_0010 0 0.0 0.0 65535.0 READ_WRITE ECU_ADDRESS 0x3FAAB6 /end MEASUREMENT
/begin MEASUREMENT Oz_dkm "" UWORD FORMULA_0443 0 0.0 0.0 9.999799728393555 READ_WRITE ECU_ADDRESS 0x3FAF64 /end MEASUREMENT
/begin MEASUREMENT Oz_hoehe "" SWORD FORMULA_0441 0 0.0 -8.0 7.99970006942749 READ_WRITE ECU_ADDRESS 0x3FAF5E /end MEASUREMENT
/begin MEASUREMENT Oz_intprog "Prognose_Intervall_Zeit_BOS_Meldung_2" UBYTE FORMULA_0003 0 0.0 0.0 255.0 READ_WRITE ECU_ADDRESS 0x3FCA28 /end MEASUREMENT
/begin MEASUREMENT Oz_kmlow "Kilometerstand letzter Ölwechsel" SWORD FORMULA_0433 0 0.0 -327680.0 327670.0 READ_WRITE ECU_ADDRESS 0x3FA894 /end MEASUREMENT
/begin MEASUREMENT Oz_kmstrw0 "Kilometerstand bei Restweg = Null" UWORD FORMULA_0437 0 0.0 0.0 655350.0 READ_WRITE ECU_ADDRESS 0x3FA8F0 /end MEASUREMENT
/begin MEASUREMENT Oz_krz2cnt "KurzMw 2 Zähler" UBYTE FORMULA_0003 0 0.0 0.0 255.0 READ_WRITE ECU_ADDRESS 0x3FAF70 /end MEASUREMENT
/begin MEASUREMENT Oz_krzcnt "" UBYTE FORMULA_0003 0 0.0 0.0 255.0 READ_WRITE ECU_ADDRESS 0x3FAF71 /end MEASUREMENT
/begin MEASUREMENT Oz_krzkor2 "Mittelwert von zwei KurzMw" UBYTE FORMULA_0436 0 0.0 0.0 74.70700073242188 READ_WRITE ECU_ADDRESS 0x3FAF72 /end MEASUREMENT
/begin MEASUREMENT Oz_krzkor2k "Mittelwert von zwei KurzMw Steigungs korrigiert" UBYTE FORMULA_0436 0 0.0 0.0 74.70700073242188 READ_WRITE ECU_ADDRESS 0x3FAF73 /end MEASUREMENT
/begin MEASUREMENT Oz_krzmw "" UBYTE FORMULA_0436 0 0.0 0.0 74.70700073242188 READ_WRITE ECU_ADDRESS 0x3FAF74 /end MEASUREMENT
/begin MEASUREMENT Oz_krzmwkor "" UBYTE FORMULA_0436 0 0.0 0.0 74.70700073242188 READ_WRITE ECU_ADDRESS 0x3FAF75 /end MEASUREMENT
/begin MEASUREMENT Oz_krzor "kurzzeitiger Mittelwert Orientierungsmessung Niveau" UBYTE FORMULA_0436 0 0.0 0.0 74.70700073242188 READ_WRITE ECU_ADDRESS 0x3FCA11 /end MEASUREMENT
/begin MEASUREMENT Oz_kvbdiff "" ULONG FORMULA_0454 0 0.0 0.0 100.0 READ_WRITE ECU_ADDRESS 0x3FAF80 /end MEASUREMENT
/begin MEASUREMENT Oz_kvbmw "" ULONG FORMULA_0454 0 0.0 0.0 100.0 READ_WRITE ECU_ADDRESS 0x3FA8E4 /end MEASUREMENT
/begin MEASUREMENT Oz_kvbmwtmp "" UWORD FORMULA_0456 0 0.0 0.0 63.99900054931641 READ_WRITE ECU_ADDRESS 0x3FAF8C /end MEASUREMENT
/begin MEASUREMENT Oz_kvbmx "" UWORD FORMULA_0010 0 0.0 0.0 65535.0 READ_WRITE ECU_ADDRESS 0x3FAF8E /end MEASUREMENT
/begin MEASUREMENT Oz_kvbog "zugeteilte Bonuskraftstoffmenge" UWORD FORMULA_0010 0 0.0 0.0 65535.0 READ_WRITE ECU_ADDRESS 0x3FA8F2 /end MEASUREMENT
/begin MEASUREMENT Oz_kvbsm "" ULONG FORMULA_0454 0 0.0 0.0 10000.0 READ_WRITE ECU_ADDRESS 0x3FAF84 /end MEASUREMENT
/begin MEASUREMENT Oz_kvbsm_ul "" ULONG FORMULA_0454 0 0.0 0.0 524287.9998 READ_WRITE ECU_ADDRESS 0x3FA8E8 /end MEASUREMENT
/begin MEASUREMENT Oz_kvbtmp2 "" UWORD FORMULA_0437 0 0.0 0.0 655350.0 READ_WRITE ECU_ADDRESS 0x3FAF90 /end MEASUREMENT
/begin MEASUREMENT Oz_langmw "Langzeitmittelwert berechnet" UBYTE FORMULA_0436 0 0.0 0.0 74.70700073242188 READ_WRITE ECU_ADDRESS 0x3FA8DA /end MEASUREMENT
/begin MEASUREMENT Oz_lbmw "" SBYTE FORMULA_0444 0 0.0 -2.0 1.984300017356873 READ_WRITE ECU_ADDRESS 0x3FAF6C /end MEASUREMENT
/begin MEASUREMENT Oz_lf1t "Länderfaktor 1" UBYTE FORMULA_0453 0 0.0 0.0 2.549999952316284 READ_WRITE ECU_ADDRESS 0x3FA8F8 /end MEASUREMENT
/begin MEASUREMENT Oz_lf2t "Länderfaktor 2" UBYTE FORMULA_0453 0 0.0 0.0 2.549999952316284 READ_WRITE ECU_ADDRESS 0x3FA8F9 /end MEASUREMENT
/begin MEASUREMENT Oz_lgmwcnt "" UBYTE FORMULA_0003 0 0.0 0.0 255.0 READ_WRITE ECU_ADDRESS 0x3FAF76 /end MEASUREMENT
/begin MEASUREMENT Oz_litges "Gesamtverbrauch für Ölwechsel" UWORD FORMULA_0010 0 0.0 0.0 65535.0 READ_WRITE ECU_ADDRESS 0x3FAF92 /end MEASUREMENT
/begin MEASUREMENT Oz_lowcnt "Zähler zur Sicherung der Ölwechselinformationen" UBYTE FORMULA_0003 0 0.0 0.0 255.0 READ_WRITE ECU_ADDRESS 0x3FA8CB /end MEASUREMENT
/begin MEASUREMENT Oz_lowkm "Register für KM-Stand beim Ölwechsel" UWORD FORMULA_0437 0 0.0 0.0 655350.0 READ_WRITE ARRAY_SIZE 6 ECU_ADDRESS 0x3FA8A2 MATRIX_DIM 6 1 1 /end MEASUREMENT
/begin MEASUREMENT Oz_lowperex "Register für extrapoliertes Er beim Ölwechsel" UWORD FORMULA_0435 0 0.0 0.0 5.999899864196777 READ_WRITE ARRAY_SIZE 6 ECU_ADDRESS 0x3FA8AE MATRIX_DIM 6 1 1 /end MEASUREMENT
/begin MEASUREMENT Oz_lowperm0 "Register für Er nach Ölwechsel" UWORD FORMULA_0435 0 0.0 0.0 5.999899864196777 READ_WRITE ARRAY_SIZE 6 ECU_ADDRESS 0x3FA8BA MATRIX_DIM 6 1 1 /end MEASUREMENT
/begin MEASUREMENT Oz_lowrwanz "Register für Restweganzeige beim Ölwechsel" SWORD FORMULA_0433 0 0.0 -327680.0 327670.0 READ_WRITE ARRAY_SIZE 6 ECU_ADDRESS 0x3FA896 MATRIX_DIM 6 1 1 /end MEASUREMENT
/begin MEASUREMENT Oz_lp "oz level picture" UBYTE FORMULA_0003 0 0.0 0.0 255.0 READ_WRITE ECU_ADDRESS 0x3FCA12 /end MEASUREMENT
/begin MEASUREMENT Oz_lv "oz level value" UBYTE FORMULA_0003 0 0.0 0.0 255.0 READ_WRITE ECU_ADDRESS 0x3FCA13 /end MEASUREMENT
/begin MEASUREMENT Oz_manip "Manipulationsbyte" UBYTE FORMULA_0003 0 0.0 0.0 255.0 READ_WRITE ECU_ADDRESS 0x3FCA0A /end MEASUREMENT
/begin MEASUREMENT Oz_manipt "Manipulation" UBYTE FORMULA_0003 0 0.0 0.0 255.0 READ_WRITE ECU_ADDRESS 0x3FA8CC /end MEASUREMENT
/begin MEASUREMENT Oz_niv "Ölniveau ungefiltert" UBYTE FORMULA_0436 0 0.0 0.0 74.70700073242188 READ_WRITE ECU_ADDRESS 0x3FCA0B /end MEASUREMENT
/begin MEASUREMENT Oz_nivakt "Aktuelles Niveau für den Tester" UBYTE FORMULA_0436 0 0.0 0.0 74.70700073242188 READ_WRITE ECU_ADDRESS 0x3FCA14 /end MEASUREMENT
/begin MEASUREMENT Oz_nivkor "Aktuelles Niveau Temperatur korrigiert" UBYTE FORMULA_0436 0 0.0 0.0 74.70700073242188 READ_WRITE ECU_ADDRESS 0x3FAF77 /end MEASUREMENT
/begin MEASUREMENT Oz_nivkrzt "Kurzmittelwert-Niveau für den Tester" UBYTE FORMULA_0436 0 0.0 0.0 74.70700073242188 READ_WRITE ECU_ADDRESS 0x3FCA15 /end MEASUREMENT
/begin MEASUREMENT Oz_nivlanglit "LangMw in Liter" UBYTE FORMULA_0438 0 0.0 0.0 25.5 READ_WRITE ECU_ADDRESS 0x3FAF94 /end MEASUREMENT
/begin MEASUREMENT Oz_nivlangt "Langmittelwert für den Tester" UBYTE FORMULA_0436 0 0.0 0.0 74.70700073242188 READ_WRITE ECU_ADDRESS 0x3FA8DB /end MEASUREMENT
/begin MEASUREMENT Oz_nivlit "Ölniveau in Liter" UBYTE FORMULA_0438 0 0.0 0.0 25.5 READ_WRITE ECU_ADDRESS 0x3FCA16 /end MEASUREMENT
/begin MEASUREMENT Oz_nivnfm "Nachfüllmenge" UBYTE FORMULA_0439 0 0.0 0.0 7.968699932098389 READ_WRITE ECU_ADDRESS 0x3FCA17 /end MEASUREMENT
/begin MEASUREMENT Oz_nivqlt "Ölniveau QLT ungefiltert" UBYTE FORMULA_0436 0 0.0 0.0 74.70700073242188 READ_WRITE ECU_ADDRESS 0x3FAF53 /end MEASUREMENT
/begin MEASUREMENT Oz_nivrers "Ersatzniveau-Rohwert" UBYTE FORMULA_0003 0 0.0 0.0 255.0 READ_WRITE ECU_ADDRESS 0x3FAF54 /end MEASUREMENT
/begin MEASUREMENT Oz_nivt "begrenzter Niveau-Rohwert" UBYTE FORMULA_0003 0 0.0 0.0 255.0 READ_WRITE ECU_ADDRESS 0x3FAF55 /end MEASUREMENT
/begin MEASUREMENT Oz_nivtoe "Ölniveau Töns ungefiltert" UBYTE FORMULA_0436 0 0.0 0.0 74.70700073242188 READ_WRITE ECU_ADDRESS 0x3FAF56 /end MEASUREMENT
/begin MEASUREMENT Oz_nivzeit "Zeit nach dem KF_OZZEIT" UWORD FORMULA_0021 0 0.0 0.0 655.3499755859375 READ_WRITE ECU_ADDRESS 0x3FAF66 /end MEASUREMENT
/begin MEASUREMENT Oz_oelkm "Ölkilometer" UWORD FORMULA_0437 0 0.0 0.0 655350.0 READ_WRITE ECU_ADDRESS 0x3FA8C6 /end MEASUREMENT
/begin MEASUREMENT Oz_oelverbr "Berechneter Ölverbrauch" UWORD FORMULA_0010 0 0.0 0.0 65535.0 READ_WRITE ECU_ADDRESS 0x3FA8D4 /end MEASUREMENT
/begin MEASUREMENT Oz_oelzeit "Öl-Alter in Monate" UWORD FORMULA_0010 0 0.0 0.0 65535.0 READ_WRITE ECU_ADDRESS 0x3FCA22 /end MEASUREMENT
/begin MEASUREMENT Oz_oelzeitt "Öl-Alter in Tage" UWORD FORMULA_0010 0 0.0 0.0 65535.0 READ_WRITE ECU_ADDRESS 0x3FCA24 /end MEASUREMENT
/begin MEASUREMENT Oz_oricnt "Orientierungszähler" UBYTE FORMULA_0003 0 0.0 0.0 255.0 READ_WRITE ECU_ADDRESS 0x3FAF78 /end MEASUREMENT
/begin MEASUREMENT Oz_orikor "OriMw korrigiert" UBYTE FORMULA_0436 0 0.0 0.0 74.70700073242188 READ_WRITE ECU_ADDRESS 0x3FCA18 /end MEASUREMENT
/begin MEASUREMENT Oz_peil "" UBYTE FORMULA_0436 0 0.0 0.0 74.70700073242188 READ_WRITE ECU_ADDRESS 0x3FAF79 /end MEASUREMENT
/begin MEASUREMENT Oz_peilaltanz "Letzter Wert, der die Anzeige geändert hat" UBYTE FORMULA_0436 0 0.0 0.0 74.70700073242188 READ_WRITE ECU_ADDRESS 0x3FA8DC /end MEASUREMENT
/begin MEASUREMENT Oz_peilkm "Max Ziel km im Fehlerfall" UWORD FORMULA_0437 0 0.0 0.0 655350.0 READ_WRITE ECU_ADDRESS 0x3FAF68 /end MEASUREMENT
/begin MEASUREMENT Oz_peilkmalt "Km Stand beim 1. Sensorfehler" UWORD FORMULA_0437 0 0.0 0.0 655350.0 READ_WRITE ECU_ADDRESS 0x3FA8D6 /end MEASUREMENT
/begin MEASUREMENT Oz_peillang "Letzter angeforderter Wert für die Peilstabanzeige" UBYTE FORMULA_0436 0 0.0 0.0 74.70700073242188 READ_WRITE ECU_ADDRESS 0x3FA8DD /end MEASUREMENT
/begin MEASUREMENT Oz_peiloben "Obere Grenze aktuelles Balkens" UBYTE FORMULA_0436 0 0.0 0.0 74.70700073242188 READ_WRITE ECU_ADDRESS 0x3FAF7A /end MEASUREMENT
/begin MEASUREMENT Oz_peilunten "Obere Grenze aktuelles Balkens" UBYTE FORMULA_0436 0 0.0 0.0 74.70700073242188 READ_WRITE ECU_ADDRESS 0x3FAF7B /end MEASUREMENT
/begin MEASUREMENT Oz_perm "Permittivität ungefiltert" UWORD FORMULA_0435 0 0.0 0.0 5.999899864196777 READ_WRITE ECU_ADDRESS 0x3FCA06 /end MEASUREMENT
/begin MEASUREMENT Oz_permakt "Permittivität für den Tester" UWORD FORMULA_0435 0 0.0 0.0 5.999899864196777 READ_WRITE ECU_ADDRESS 0x3FCA08 /end MEASUREMENT
/begin MEASUREMENT Oz_permbog "zugeteilter Permittivitätsbonus" UWORD FORMULA_0435 0 0.0 0.0 5.999899864196777 READ_WRITE ECU_ADDRESS 0x3FA8F4 /end MEASUREMENT
/begin MEASUREMENT Oz_permerrz "" UBYTE FORMULA_0003 0 0.0 0.0 255.0 READ_WRITE ECU_ADDRESS 0x3F992E /end MEASUREMENT
/begin MEASUREMENT Oz_permt "begrenzter Permittivitäts-Rohwert" UWORD FORMULA_0010 0 0.0 0.0 1024.0 READ_WRITE ECU_ADDRESS 0x3FAF4E /end MEASUREMENT
/begin MEASUREMENT Oz_perref "Ersatzpermittivität" UWORD FORMULA_0010 0 0.0 0.0 1024.0 READ_WRITE ECU_ADDRESS 0x3FA8C8 /end MEASUREMENT
/begin MEASUREMENT Oz_pzdivp "Verhältnis oz_luftalt/oz_luftneu" UWORD FORMULA_0024 0 0.0 0.0 1.999899983406067 READ_WRITE ECU_ADDRESS 0x3FAF6A /end MEASUREMENT
/begin MEASUREMENT Oz_qbmw "" SBYTE FORMULA_0444 0 0.0 -2.0 1.984300017356873 READ_WRITE ECU_ADDRESS 0x3FAF6D /end MEASUREMENT
/begin MEASUREMENT Oz_reset "Zieltermin_Monat_BOS_Rückstellung_2" UBYTE FORMULA_0003 0 0.0 0.0 255.0 READ_WRITE ECU_ADDRESS 0x3FC9FD /end MEASUREMENT
/begin MEASUREMENT Oz_rwanz "anzuzeigender Restweg" SWORD FORMULA_0433 0 0.0 -327680.0 327670.0 READ_WRITE ECU_ADDRESS 0x3FA8EE /end MEASUREMENT
/begin MEASUREMENT Oz_rwde "Restweg laut Dieseleintrag" SWORD FORMULA_0433 0 0.0 -327680.0 327670.0 READ_WRITE ECU_ADDRESS 0x3FAF88 /end MEASUREMENT
/begin MEASUREMENT Oz_rwkvb "" SWORD FORMULA_0433 0 0.0 -327680.0 327670.0 READ_WRITE ECU_ADDRESS 0x3FCA1C /end MEASUREMENT
/begin MEASUREMENT Oz_rwp "Zwischengröße Restwegberechnung" SWORD FORMULA_0433 0 0.0 -327680.0 327670.0 READ_WRITE ECU_ADDRESS 0x3FAF8A /end MEASUREMENT
/begin MEASUREMENT Oz_rwpeil "Restweg laut Peilstab" SWORD FORMULA_0433 0 0.0 -327680.0 327670.0 READ_WRITE ECU_ADDRESS 0x3FA8D0 /end MEASUREMENT
/begin MEASUREMENT Oz_rwperm "Restweg aus Permittivität abgeleitet" SWORD FORMULA_0433 0 0.0 -327680.0 327670.0 READ_WRITE ECU_ADDRESS 0x3FCA1E /end MEASUREMENT
/begin MEASUREMENT Oz_rwprog "Prognose_Intervall_Weg_BOS_Meldung_2" UWORD FORMULA_0437 0 0.0 0.0 655350.0 READ_WRITE ECU_ADDRESS 0x3FCA26 /end MEASUREMENT
/begin MEASUREMENT Oz_rwprueck "" UBYTE FORMULA_0434 0 0.0 0.0 255000.0 READ_WRITE ECU_ADDRESS 0x3FA8CD /end MEASUREMENT
/begin MEASUREMENT Oz_rwrueck "" SWORD FORMULA_0433 0 0.0 -327680.0 327670.0 READ_WRITE ECU_ADDRESS 0x3FCA02 /end MEASUREMENT
/begin MEASUREMENT Oz_rwzeit "Restweg laut Zeitverlauf" SWORD FORMULA_0433 0 0.0 -327680.0 327670.0 READ_WRITE ECU_ADDRESS 0x3FCA20 /end MEASUREMENT
/begin MEASUREMENT Oz_steigung "" SWORD FORMULA_0442 0 0.0 -64.0 63.99800109863281 READ_WRITE ECU_ADDRESS 0x3FAF60 /end MEASUREMENT
/begin MEASUREMENT Oz_svcntchg "geänderter Servicezähler" UBYTE FORMULA_0003 0 0.0 0.0 255.0 READ_WRITE ECU_ADDRESS 0x3FCA0C /end MEASUREMENT
/begin MEASUREMENT Oz_temp "Öltemperatur ungefiltert" SWORD FORMULA_0431 0 0.0 -3276.800048828125 3276.699951171875 READ_WRITE ECU_ADDRESS 0x3FCA04 /end MEASUREMENT
/begin MEASUREMENT Oz_tempakt "Ausgabe Öltemperatur für den Tester" SWORD FORMULA_0431 0 0.0 -3276.800048828125 3276.699951171875 READ_WRITE ECU_ADDRESS 0x3FC9F2 /end MEASUREMENT
/begin MEASUREMENT Oz_tempf "" SWORD FORMULA_0431 0 0.0 -3276.800048828125 3276.699951171875 READ_WRITE ECU_ADDRESS 0x3FCA2A /end MEASUREMENT
/begin MEASUREMENT Oz_tempplz "Anzahl der unplausibel Sprünge QLT Temperatur" UBYTE FORMULA_0003 0 0.0 0.0 255.0 READ_WRITE ECU_ADDRESS 0x3FAAB8 /end MEASUREMENT
/begin MEASUREMENT Oz_tempqlt "Öltemperatur qlt ungefiltert" SWORD FORMULA_0431 0 0.0 -3276.800048828125 3276.699951171875 READ_WRITE ECU_ADDRESS 0x3FAF4A /end MEASUREMENT
/begin MEASUREMENT Oz_temprold "Alte QLT Temperatur für die Plausibilisierung" UBYTE FORMULA_0003 0 0.0 0.0 255.0 READ_WRITE ECU_ADDRESS 0x3FAAB9 /end MEASUREMENT
/begin MEASUREMENT Oz_tempt "begrenzter Temperatur-Rohwert" UWORD FORMULA_0010 0 0.0 0.0 65535.0 READ_WRITE ECU_ADDRESS 0x3FAF50 /end MEASUREMENT
/begin MEASUREMENT Oz_temptoe "Öltemperatur Töns ungefiltert" SWORD FORMULA_0431 0 0.0 -3276.800048828125 3276.699951171875 READ_WRITE ECU_ADDRESS 0x3FAF4C /end MEASUREMENT
/begin MEASUREMENT Oz_testtoel2 "" SWORD FORMULA_0431 0 0.0 -3276.800048828125 3276.699951171875 READ_WRITE ECU_ADDRESS 0x3FAF62 /end MEASUREMENT
/begin MEASUREMENT Oz_uefcnt "Zähler Überfüllung" UBYTE FORMULA_0003 0 0.0 0.0 255.0 READ_WRITE ECU_ADDRESS 0x3FAF7C /end MEASUREMENT
/begin MEASUREMENT Oz_uefzcnt "Zwischenzähler Überfüllung" SBYTE FORMULA_0003 0 0.0 -128.0 127.0 READ_WRITE ECU_ADDRESS 0x3FAF6E /end MEASUREMENT
/begin MEASUREMENT Oz_utzeit "Zeit Öl in Übertemperatur" UWORD FORMULA_0010 0 0.0 0.0 65535.0 READ_WRITE ECU_ADDRESS 0x3FA8F6 /end MEASUREMENT
/begin MEASUREMENT Oz_verbkmalt "Km-Stand letzter Ölverbrauch-Berechnung" UWORD FORMULA_0437 0 0.0 0.0 655350.0 READ_WRITE ECU_ADDRESS 0x3FA8D8 /end MEASUREMENT
/begin MEASUREMENT Oz_verbnivalt "Ölniveau letzter Ölverbrauch-Berechnung" UBYTE FORMULA_0436 0 0.0 0.0 74.70700073242188 READ_WRITE ECU_ADDRESS 0x3FA8DE /end MEASUREMENT
/begin MEASUREMENT Oz_vfanz "anzuzeigende Verfügbarkeit" UBYTE FORMULA_0453 0 0.0 0.0 2.549999952316284 READ_WRITE ECU_ADDRESS 0x3FCA29 /end MEASUREMENT
/begin MEASUREMENT Oz_vfbdmew "Verfügbarkeit aus Kombi bei DME-Wechsel" SBYTE FORMULA_0003 0 0.0 -128.0 127.0 READ_WRITE ECU_ADDRESS 0x3FA8CA /end MEASUREMENT
/begin MEASUREMENT Oz_vfkvb "Verfügbarkeit aus Kraftstoffverbrauch" UBYTE FORMULA_0453 0 0.0 0.0 2.549999952316284 READ_WRITE ECU_ADDRESS 0x3FAF95 /end MEASUREMENT
/begin MEASUREMENT Oz_vfperm "Verfügbarkeit aus der Permittivität" UBYTE FORMULA_0453 0 0.0 0.0 2.549999952316284 READ_WRITE ECU_ADDRESS 0x3FAF96 /end MEASUREMENT
/begin MEASUREMENT Oz_vfzeit "Verfügbarkeit aus Zeit" UBYTE FORMULA_0453 0 0.0 0.0 2.549999952316284 READ_WRITE ECU_ADDRESS 0x3FAF97 /end MEASUREMENT
/begin MEASUREMENT Oz_vormw "vorgezogener Mittelwert Niveau" UBYTE FORMULA_0436 0 0.0 0.0 74.70700073242188 READ_WRITE ECU_ADDRESS 0x3FCA19 /end MEASUREMENT
/begin MEASUREMENT Oz_vormwcnt "" UBYTE FORMULA_0003 0 0.0 0.0 255.0 READ_WRITE ECU_ADDRESS 0x3FAF7D /end MEASUREMENT
/begin MEASUREMENT Oz_zieljahr "" UBYTE FORMULA_0003 0 0.0 0.0 255.0 READ_WRITE ECU_ADDRESS 0x3FA8FA /end MEASUREMENT
/begin MEASUREMENT Oz_zielmon "" UBYTE FORMULA_0003 0 0.0 0.0 255.0 READ_WRITE ECU_ADDRESS 0x3FA8FB /end MEASUREMENT
/begin MEASUREMENT Oz_zjbdmew "" UBYTE FORMULA_0003 0 0.0 0.0 255.0 READ_WRITE ECU_ADDRESS 0x3FCA0D /end MEASUREMENT
/begin MEASUREMENT Oz_zmbdmew "" UBYTE FORMULA_0003 0 0.0 0.0 255.0 READ_WRITE ECU_ADDRESS 0x3FCA0E /end MEASUREMENT
/begin MEASUREMENT P_totdiode "Verlustleistung der Diode" UWORD FORMULA_0482 0 0.0 0.0 255.9960021972656 READ_WRITE ECU_ADDRESS 0x3FAFC8 /end MEASUREMENT
/begin MEASUREMENT pabg_b1 "Abgasgegendruck gesamt" SWORD FORMULA_0075 0 0.0 500.0 2000.0 READ_WRITE ECU_ADDRESS 0x3FCA2C /end MEASUREMENT
/begin MEASUREMENT pabg_b1.dif "Diff. Abgasgegendruck zur PUMG" SWORD FORMULA_0075 0 0.0 500.0 2000.0 READ_WRITE ECU_ADDRESS 0x3FCA30 /end MEASUREMENT
/begin MEASUREMENT pabg_b1.pabg_10ms "Abgasgegendruck mit 10ms Filter berechnet" SWORD FORMULA_0075 0 0.0 500.0 2000.0 READ_WRITE ECU_ADDRESS 0x3FCA34 /end MEASUREMENT
/begin MEASUREMENT pabg_b1.stat_roh "Abgasgegendruck ungefiltert" SWORD FORMULA_0075 0 0.0 500.0 2000.0 READ_WRITE ECU_ADDRESS 0x3FCA2E /end MEASUREMENT
/begin MEASUREMENT pabg_b1.tau "Filtertaukonstante" UWORD FORMULA_1024 0 0.0 0.1000000014901161 25.60000038146973 READ_WRITE ECU_ADDRESS 0x3FCA32 /end MEASUREMENT
/begin MEASUREMENT pabg_b2 "Abgasgegendruck gesamt" SWORD FORMULA_0075 0 0.0 500.0 2000.0 READ_WRITE ECU_ADDRESS 0x3FCA36 /end MEASUREMENT
/begin MEASUREMENT pabg_b2.dif "Diff. Abgasgegendruck zur PUMG" SWORD FORMULA_0075 0 0.0 500.0 2000.0 READ_WRITE ECU_ADDRESS 0x3FCA3A /end MEASUREMENT
/begin MEASUREMENT pabg_b2.pabg_10ms "Abgasgegendruck mit 10ms Filter berechnet" SWORD FORMULA_0075 0 0.0 500.0 2000.0 READ_WRITE ECU_ADDRESS 0x3FCA3E /end MEASUREMENT
/begin MEASUREMENT pabg_b2.stat_roh "Abgasgegendruck ungefiltert" SWORD FORMULA_0075 0 0.0 500.0 2000.0 READ_WRITE ECU_ADDRESS 0x3FCA38 /end MEASUREMENT
/begin MEASUREMENT pabg_b2.tau "Filtertaukonstante" UWORD FORMULA_1024 0 0.0 0.1000000014901161 25.60000038146973 READ_WRITE ECU_ADDRESS 0x3FCA3C /end MEASUREMENT
/begin MEASUREMENT pabg_m "Mittelwert Abgasgegendruck" SWORD FORMULA_0075 0 0.0 500.0 2000.0 READ_WRITE ECU_ADDRESS 0x3FCA40 /end MEASUREMENT
/begin MEASUREMENT pctrl_proz "Prozessueberwachung" UWORD FORMULA_0010 0 0.0 0.0 65535.0 READ_WRITE ECU_ADDRESS 0x3FCA4E /end MEASUREMENT
/begin MEASUREMENT pctrl_proz_err "Fehler Prozessueberwachung" UWORD FORMULA_0010 0 0.0 0.0 65535.0 READ_WRITE ECU_ADDRESS 0x3FCA50 /end MEASUREMENT
/begin MEASUREMENT pctrl_proz_tb "Timerwert Prozess-Ueberwachungszyklus" UBYTE FORMULA_0357 0 0.0 0.0 1.274999976158142 READ_WRITE ECU_ADDRESS 0x3FCA49 /end MEASUREMENT
/begin MEASUREMENT pctrl_t_old_ipk "vorheriger Timer Wert aus der IPK" ULONG FORMULA_0000 0 0.0 0.0 4294967295.0 READ_WRITE ECU_ADDRESS 0x3FCA44 /end MEASUREMENT
/begin MEASUREMENT pctrl_task "Taskueberwachung" UBYTE FORMULA_0003 0 0.0 0.0 255.0 READ_WRITE ECU_ADDRESS 0x3FCA4B /end MEASUREMENT
/begin MEASUREMENT pctrl_task_err "Fehler Taskueberwachung" UBYTE FORMULA_0003 0 0.0 0.0 255.0 READ_WRITE ECU_ADDRESS 0x3FCA4C /end MEASUREMENT
/begin MEASUREMENT pctrl_task_tb "Timerwert Task-Ueberwachungszyklus" UBYTE FORMULA_0357 0 0.0 0.0 1.274999976158142 READ_WRITE ECU_ADDRESS 0x3FCA48 /end MEASUREMENT
/begin MEASUREMENT pctrl_tout "Timeout Zaehler" UBYTE FORMULA_0358 0 0.0 0.0 2550.0 READ_WRITE ECU_ADDRESS 0x3FCA4A /end MEASUREMENT
/begin MEASUREMENT pks_ad "eingelesener Spannungswert des Kraftstoffdrucksignals" SWORD FORMULA_0114 0 0.0 0.0 1023.0 READ_WRITE ECU_ADDRESS 0x3FCA5C /end MEASUREMENT
/begin MEASUREMENT pks_aufbau_fehler "Differentzdruck zu PK_PKS_TV100_MIN" SWORD FORMULA_0110 0 0.0 0.0 10.0 READ_WRITE ECU_ADDRESS 0x3FCA66 /end MEASUREMENT
/begin MEASUREMENT pks_ist_roh "Kraftstoffdruck, absolut, ungefiltert" SWORD FORMULA_0110 0 0.0 0.0 10.0 READ_WRITE ECU_ADDRESS 0x3FCA5E /end MEASUREMENT
/begin MEASUREMENT pks_obd_abw_filt "gefiltertes Kraftstoffdruck Ist-Soll Verhaeltniss" SWORD FORMULA_0543 0 0.0 -1000.0 1000.0 READ_WRITE ECU_ADDRESS 0x3FCA5A /end MEASUREMENT
/begin MEASUREMENT pks_obd_zust "Zustandautomat pks_obd" UBYTE FORMULA_1028 0 0.0 0.0 255.0 READ_WRITE ECU_ADDRESS 0x3FCA6B /end MEASUREMENT
/begin MEASUREMENT pks_plau_delta "Delta zwischen Modell und pks_rel" SWORD FORMULA_0110 0 0.0 0.0 10.0 READ_WRITE ECU_ADDRESS 0x3FCA62 /end MEASUREMENT
/begin MEASUREMENT pks_plau_intg "Integrationswert Abweichung Modell zu pks_rel" UWORD FORMULA_1026 0 0.0 0.0 10.0 READ_WRITE ECU_ADDRESS 0x3FCA64 /end MEASUREMENT
/begin MEASUREMENT pks_rel_mdl "Kraftstoffdruck aus Modell" SWORD FORMULA_0110 0 0.0 0.0 10.0 READ_WRITE ECU_ADDRESS 0x3FCA60 /end MEASUREMENT
/begin MEASUREMENT pks_st "Status pks" UBYTE FORMULA_1027 0 0.0 0.0 255.0 READ_WRITE ECU_ADDRESS 0x3FCA6A /end MEASUREMENT
/begin MEASUREMENT pks_tv_mdl_norm "TV fuer PKS-Modell normiert" SWORD FORMULA_0161 0 0.0 -100.0 100.0 READ_WRITE ECU_ADDRESS 0x3FCA68 /end MEASUREMENT
/begin MEASUREMENT St_bns "Statuswort" UBYTE FORMULA_0003 0 0.0 0.0 255.0 READ_WRITE ECU_ADDRESS 0x3FA8FC /end MEASUREMENT
/begin MEASUREMENT St_bns.B_bns "Bordnetzstabilitätsmaßnahmen aktiv" UBYTE FORMULA_0423 0 0 0.0 255.0 READ_WRITE BIT_MASK 0x1 ECU_ADDRESS 0x3FA8FC /end MEASUREMENT
/begin MEASUREMENT St_bns2 "Statuswort" UBYTE FORMULA_0003 0 0.0 0.0 255.0 READ_WRITE ECU_ADDRESS 0x3FCAD2 /end MEASUREMENT
/begin MEASUREMENT St_bns2.B_nachlnd7 "lokales B_nachlaufende" UBYTE FORMULA_0423 0 0 0.0 255.0 READ_WRITE BIT_MASK 0x1 ECU_ADDRESS 0x3FCAD2 /end MEASUREMENT
/begin MEASUREMENT St_dqlt0 "Statuswort" UBYTE FORMULA_0003 0 0.0 0.0 255.0 READ_WRITE ECU_ADDRESS 0x3FBE90 /end MEASUREMENT
/begin MEASUREMENT St_dqlt0.B_ozdiagnmotok "Motordrehzahl ok für die Diagnose" UBYTE FORMULA_0430 0 0 0.0 255.0 READ_WRITE BIT_MASK 0x80 ECU_ADDRESS 0x3FBE90 /end MEASUREMENT
/begin MEASUREMENT St_dqlt0.B_ozerrbsd "BSD global Fehler" UBYTE FORMULA_0429 0 0 0.0 255.0 READ_WRITE BIT_MASK 0x40 ECU_ADDRESS 0x3FBE90 /end MEASUREMENT
/begin MEASUREMENT St_dqlt0.B_ozkttoens "Töns-Sensor verbaut" UBYTE FORMULA_0428 0 0 0.0 255.0 READ_WRITE BIT_MASK 0x20 ECU_ADDRESS 0x3FBE90 /end MEASUREMENT
/begin MEASUREMENT St_dqlt0.B_ozlerr "Messfehler Ölniveau" UBYTE FORMULA_0423 0 0 0.0 255.0 READ_WRITE BIT_MASK 0x1 ECU_ADDRESS 0x3FBE90 /end MEASUREMENT
/begin MEASUREMENT St_dqlt0.B_ozqerr "Messfehler Ölzustand" UBYTE FORMULA_0424 0 0 0.0 255.0 READ_WRITE BIT_MASK 0x2 ECU_ADDRESS 0x3FBE90 /end MEASUREMENT
/begin MEASUREMENT St_dqlt0.B_ozterr "Messfehler Öltemperatur" UBYTE FORMULA_0425 0 0 0.0 255.0 READ_WRITE BIT_MASK 0x4 ECU_ADDRESS 0x3FBE90 /end MEASUREMENT
/begin MEASUREMENT St_dqlt0.B_td_ogerr "" UBYTE FORMULA_0426 0 0 0.0 255.0 READ_WRITE BIT_MASK 0x8 ECU_ADDRESS 0x3FBE90 /end MEASUREMENT
/begin MEASUREMENT St_dqlt0.B_td_ogupl "" UBYTE FORMULA_0427 0 0 0.0 255.0 READ_WRITE BIT_MASK 0x10 ECU_ADDRESS 0x3FBE90 /end MEASUREMENT
/begin MEASUREMENT St_dqlt1 "Statuswort" UBYTE FORMULA_0003 0 0.0 0.0 255.0 READ_WRITE ECU_ADDRESS 0x3FBE91 /end MEASUREMENT
/begin MEASUREMENT St_dqlt1.B_ozerr "Sensorfehler in FS eingetragen" UBYTE FORMULA_0423 0 0 0.0 255.0 READ_WRITE BIT_MASK 0x1 ECU_ADDRESS 0x3FBE91 /end MEASUREMENT
/begin MEASUREMENT St_dqlt1.B_ozfbsd2 "BSD Sensor Fehler von FI_BSD_4" UBYTE FORMULA_0424 0 0 0.0 255.0 READ_WRITE BIT_MASK 0x2 ECU_ADDRESS 0x3FBE91 /end MEASUREMENT
/begin MEASUREMENT St_dqlt1.B_oztemppl "QLT Temperatur unplausibel" UBYTE FORMULA_0425 0 0 0.0 255.0 READ_WRITE BIT_MASK 0x4 ECU_ADDRESS 0x3FBE91 /end MEASUREMENT
/begin MEASUREMENT St_oz_o "Statuswort" UBYTE FORMULA_0003 0 0.0 0.0 255.0 READ_WRITE ECU_ADDRESS 0x3FBE92 /end MEASUREMENT
/begin MEASUREMENT St_oz_o.B_mol_sf "Sensorfehler in FS eingetragen für CC-Meldung" UBYTE FORMULA_0424 0 0 0.0 255.0 READ_WRITE BIT_MASK 0x2 ECU_ADDRESS 0x3FBE92 /end MEASUREMENT
/begin MEASUREMENT St_oz_o.B_oztemic "QLT-Temic verbaut" UBYTE FORMULA_0423 0 0 0.0 255.0 READ_WRITE BIT_MASK 0x1 ECU_ADDRESS 0x3FBE92 /end MEASUREMENT
/begin MEASUREMENT St_ozbg_nv0 "Statuswort" UBYTE FORMULA_0003 0 0.0 0.0 255.0 READ_WRITE ECU_ADDRESS 0x3FA884 /end MEASUREMENT
/begin MEASUREMENT St_ozbg_nv0.B_ozkl15 "Merker für Einschalten Kl. 15" UBYTE FORMULA_0423 0 0 0.0 255.0 READ_WRITE BIT_MASK 0x1 ECU_ADDRESS 0x3FA884 /end MEASUREMENT
/begin MEASUREMENT St_ozbg0 "Statuswort" UBYTE FORMULA_0003 0 0.0 0.0 255.0 READ_WRITE ECU_ADDRESS 0x3FC9F0 /end MEASUREMENT
/begin MEASUREMENT St_ozbg0.B_bosmsgc "Bedingung für Absetzen einer BOS-Meldung" UBYTE FORMULA_0423 0 0 0.0 255.0 READ_WRITE BIT_MASK 0x1 ECU_ADDRESS 0x3FC9F0 /end MEASUREMENT
/begin MEASUREMENT St_ozbg0.B_mol_vb "Bedingung Ölverbrauchswarnung" UBYTE FORMULA_0424 0 0 0.0 255.0 READ_WRITE BIT_MASK 0x2 ECU_ADDRESS 0x3FC9F0 /end MEASUREMENT
/begin MEASUREMENT St_ozbg0.B_mol_vl "Bedingung Ölverlustwarnung" UBYTE FORMULA_0425 0 0 0.0 255.0 READ_WRITE BIT_MASK 0x4 ECU_ADDRESS 0x3FC9F0 /end MEASUREMENT
/begin MEASUREMENT St_ozbg0.B_oeltemp "Bedingung für CAN-Ausgabe der Öltemperatur" UBYTE FORMULA_0426 0 0 0.0 255.0 READ_WRITE BIT_MASK 0x8 ECU_ADDRESS 0x3FC9F0 /end MEASUREMENT
/begin MEASUREMENT St_ozbg0.B_oelverb "" UBYTE FORMULA_0427 0 0 0.0 255.0 READ_WRITE BIT_MASK 0x10 ECU_ADDRESS 0x3FC9F0 /end MEASUREMENT
/begin MEASUREMENT St_ozbg0.B_oelverl "" UBYTE FORMULA_0428 0 0 0.0 255.0 READ_WRITE BIT_MASK 0x20 ECU_ADDRESS 0x3FC9F0 /end MEASUREMENT
/begin MEASUREMENT St_ozgg_nv0 "Statuswort" UBYTE FORMULA_0003 0 0.0 0.0 255.0 READ_WRITE ECU_ADDRESS 0x3FA892 /end MEASUREMENT
/begin MEASUREMENT St_ozgg_nv0.B_dmeini "Bedingung für neue noch nicht initialisierte DME" UBYTE FORMULA_0423 0 0 0.0 255.0 READ_WRITE BIT_MASK 0x1 ECU_ADDRESS 0x3FA892 /end MEASUREMENT
/begin MEASUREMENT St_ozgg_nv0.B_dmewech "Bedingung für getauschte DME zur Aktualisierung der BOS-Werte" UBYTE FORMULA_0424 0 0 0.0 255.0 READ_WRITE BIT_MASK 0x2 ECU_ADDRESS 0x3FA892 /end MEASUREMENT
/begin MEASUREMENT St_ozgg_nv0.B_factoryres "" UBYTE FORMULA_0425 0 0 0.0 255.0 READ_WRITE BIT_MASK 0x4 ECU_ADDRESS 0x3FA892 /end MEASUREMENT
/begin MEASUREMENT St_ozgg0 "Statuswort" UBYTE FORMULA_0003 0 0.0 0.0 255.0 READ_WRITE ECU_ADDRESS 0x3FC9FE /end MEASUREMENT
/begin MEASUREMENT St_ozgg0.B_oelwech "Bedingung Ölwechsel erfolgt" UBYTE FORMULA_0423 0 0 0.0 255.0 READ_WRITE BIT_MASK 0x1 ECU_ADDRESS 0x3FC9FE /end MEASUREMENT
/begin MEASUREMENT St_ozgg0.B_ozniv "Bedingung Niveausignal in Ordnung" UBYTE FORMULA_0424 0 0 0.0 255.0 READ_WRITE BIT_MASK 0x2 ECU_ADDRESS 0x3FC9FE /end MEASUREMENT
/begin MEASUREMENT St_ozgg0.B_ozperm "Bedingung Permittivitätssignal in Ordnung" UBYTE FORMULA_0425 0 0 0.0 255.0 READ_WRITE BIT_MASK 0x4 ECU_ADDRESS 0x3FC9FE /end MEASUREMENT
/begin MEASUREMENT St_ozgg0.B_oztemp "Bedingung Temperatursignal in Ordnung" UBYTE FORMULA_0426 0 0 0.0 255.0 READ_WRITE BIT_MASK 0x8 ECU_ADDRESS 0x3FC9FE /end MEASUREMENT
/begin MEASUREMENT St_ozgg0.B_ozvfchg "Bedingung für geänderte Verfügbarkeit" UBYTE FORMULA_0427 0 0 0.0 255.0 READ_WRITE BIT_MASK 0x10 ECU_ADDRESS 0x3FC9FE /end MEASUREMENT
/begin MEASUREMENT St_ozgg0.B_ozvfchgt "" UBYTE FORMULA_0429 0 0 0.0 255.0 READ_WRITE BIT_MASK 0x40 ECU_ADDRESS 0x3FC9FE /end MEASUREMENT
/begin MEASUREMENT St_ozgg0.B_ozzeitdmew "" UBYTE FORMULA_0430 0 0 0.0 255.0 READ_WRITE BIT_MASK 0x80 ECU_ADDRESS 0x3FC9FE /end MEASUREMENT
/begin MEASUREMENT St_ozgg0.B_svcntchg "Bedingung für über Tester geänderten Servicezähler" UBYTE FORMULA_0428 0 0 0.0 255.0 READ_WRITE BIT_MASK 0x20 ECU_ADDRESS 0x3FC9FE /end MEASUREMENT
/begin MEASUREMENT St_ozgg1 "Statuswort" UBYTE FORMULA_0003 0 0.0 0.0 255.0 READ_WRITE ECU_ADDRESS 0x3FC9FF /end MEASUREMENT
/begin MEASUREMENT St_ozgg1.B_ozmanip "" UBYTE FORMULA_0425 0 0 0.0 255.0 READ_WRITE BIT_MASK 0x4 ECU_ADDRESS 0x3FC9FF /end MEASUREMENT
/begin MEASUREMENT St_ozgg1.B_oznivqlt "Bedingung Niveausignal QLT in Ordnung" UBYTE FORMULA_0430 0 0 0.0 255.0 READ_WRITE BIT_MASK 0x80 ECU_ADDRESS 0x3FC9FF /end MEASUREMENT
/begin MEASUREMENT St_ozgg1.B_oznivtoe "Bedingung Niveausignal Töns in Ordnung" UBYTE FORMULA_0429 0 0 0.0 255.0 READ_WRITE BIT_MASK 0x40 ECU_ADDRESS 0x3FC9FF /end MEASUREMENT
/begin MEASUREMENT St_ozgg1.B_ozreset "BOS Reset (Ölwechsel)" UBYTE FORMULA_0428 0 0 0.0 255.0 READ_WRITE BIT_MASK 0x20 ECU_ADDRESS 0x3FC9FF /end MEASUREMENT
/begin MEASUREMENT St_ozgg1.B_ozresetcan "Reset BOS vom Kombi (CAN)" UBYTE FORMULA_0427 0 0 0.0 255.0 READ_WRITE BIT_MASK 0x10 ECU_ADDRESS 0x3FC9FF /end MEASUREMENT
/begin MEASUREMENT St_ozgg1.B_ozresett "Reset vom Tester" UBYTE FORMULA_0426 0 0 0.0 255.0 READ_WRITE BIT_MASK 0x8 ECU_ADDRESS 0x3FC9FF /end MEASUREMENT
/begin MEASUREMENT St_ozgg1.B_ozvfchgc "Bedingung für geänderte Verfügbarkeit vom Kombi über Restweg" UBYTE FORMULA_0423 0 0 0.0 255.0 READ_WRITE BIT_MASK 0x1 ECU_ADDRESS 0x3FC9FF /end MEASUREMENT
/begin MEASUREMENT St_ozgg1.B_ozvfchgcc "Bedingung für geänderte Verfügbarkeit vom Kombi" UBYTE FORMULA_0424 0 0 0.0 255.0 READ_WRITE BIT_MASK 0x2 ECU_ADDRESS 0x3FC9FF /end MEASUREMENT
/begin MEASUREMENT St_ozgg2 "Statuswort" UBYTE FORMULA_0003 0 0.0 0.0 255.0 READ_WRITE ECU_ADDRESS 0x3FCA00 /end MEASUREMENT
/begin MEASUREMENT St_ozgg2.B_oztempqlt "Bedingung Temperatursignal QLT in Ordnung" UBYTE FORMULA_0423 0 0 0.0 255.0 READ_WRITE BIT_MASK 0x1 ECU_ADDRESS 0x3FCA00 /end MEASUREMENT
/begin MEASUREMENT St_ozgg2.B_oztemptoe "Bedingung Temperatursignal Töns in Ordnung" UBYTE FORMULA_0424 0 0 0.0 255.0 READ_WRITE BIT_MASK 0x2 ECU_ADDRESS 0x3FCA00 /end MEASUREMENT
/begin MEASUREMENT St_ozgg2.B_oztoeok "Bedingung kein Fehler Töns" UBYTE FORMULA_0425 0 0 0.0 255.0 READ_WRITE BIT_MASK 0x4 ECU_ADDRESS 0x3FCA00 /end MEASUREMENT
/begin MEASUREMENT St_oznivdl_nv0 "Statuswort" UBYTE FORMULA_0003 0 0.0 0.0 255.0 READ_WRITE ECU_ADDRESS 0x3FA8CE /end MEASUREMENT
/begin MEASUREMENT St_oznivdl_nv0.B_ozabzlang "Abstellzeit zu lang für die anzeige des letzten Wertes" UBYTE FORMULA_0428 0 0 0.0 255.0 READ_WRITE BIT_MASK 0x20 ECU_ADDRESS 0x3FA8CE /end MEASUREMENT
/begin MEASUREMENT St_oznivdl_nv0.B_ozlmwneu "Langzeit-Mittelwert berechnet in der letzten Fahrt" UBYTE FORMULA_0425 0 0 0.0 255.0 READ_WRITE BIT_MASK 0x4 ECU_ADDRESS 0x3FA8CE /end MEASUREMENT
/begin MEASUREMENT St_oznivdl_nv0.B_oznachf "Nachfüllung erkannt" UBYTE FORMULA_0426 0 0 0.0 255.0 READ_WRITE BIT_MASK 0x8 ECU_ADDRESS 0x3FA8CE /end MEASUREMENT
/begin MEASUREMENT St_oznivdl_nv0.B_ozoelwech "Ölwechsel für die Peilstabanzeige" UBYTE FORMULA_0427 0 0 0.0 255.0 READ_WRITE BIT_MASK 0x10 ECU_ADDRESS 0x3FA8CE /end MEASUREMENT
/begin MEASUREMENT St_oznivdl_nv0.B_ozpeilerr "" UBYTE FORMULA_0424 0 0 0.0 255.0 READ_WRITE BIT_MASK 0x2 ECU_ADDRESS 0x3FA8CE /end MEASUREMENT
/begin MEASUREMENT St_oznivdl0 "Statuswort" UBYTE FORMULA_0003 0 0.0 0.0 255.0 READ_WRITE ECU_ADDRESS 0x3FCA0F /end MEASUREMENT
/begin MEASUREMENT St_oznivdl0.B_ozkrzkor "Bedingung drehzahlkorrigierter Kurzzeit Niveaumittelwert berechnet" UBYTE FORMULA_0424 0 0 0.0 255.0 READ_WRITE BIT_MASK 0x2 ECU_ADDRESS 0x3FCA0F /end MEASUREMENT
/begin MEASUREMENT St_oznivdl0.B_ozkrzl "" UBYTE FORMULA_0430 0 0 0.0 255.0 READ_WRITE BIT_MASK 0x80 ECU_ADDRESS 0x3FCA0F /end MEASUREMENT
/begin MEASUREMENT St_oznivdl0.B_ozkrzlkor "" UBYTE FORMULA_0428 0 0 0.0 255.0 READ_WRITE BIT_MASK 0x20 ECU_ADDRESS 0x3FCA0F /end MEASUREMENT
/begin MEASUREMENT St_oznivdl0.B_ozlangmw "Bedingung Langzeit-Mittelwert berechnet" UBYTE FORMULA_0425 0 0 0.0 255.0 READ_WRITE BIT_MASK 0x4 ECU_ADDRESS 0x3FCA0F /end MEASUREMENT
/begin MEASUREMENT St_oznivdl0.B_ozluft "Umgebungsluftdruck plausibel / Steigungserkennung aktiv" UBYTE FORMULA_0429 0 0 0.0 255.0 READ_WRITE BIT_MASK 0x40 ECU_ADDRESS 0x3FCA0F /end MEASUREMENT
/begin MEASUREMENT St_oznivdl0.B_oznivb "" UBYTE FORMULA_0423 0 0 0.0 255.0 READ_WRITE BIT_MASK 0x1 ECU_ADDRESS 0x3FCA0F /end MEASUREMENT
/begin MEASUREMENT St_oznivdl0.B_ozor "Bedingung Orientierungsmessung erfolgt" UBYTE FORMULA_0426 0 0 0.0 255.0 READ_WRITE BIT_MASK 0x8 ECU_ADDRESS 0x3FCA0F /end MEASUREMENT
/begin MEASUREMENT St_oznivdl0.B_ozvormw "Bedingung vorgezogener Mittelwert berechnet" UBYTE FORMULA_0427 0 0 0.0 255.0 READ_WRITE BIT_MASK 0x10 ECU_ADDRESS 0x3FCA0F /end MEASUREMENT
/begin MEASUREMENT St_oznivdl1 "Statuswort" UBYTE FORMULA_0003 0 0.0 0.0 255.0 READ_WRITE ECU_ADDRESS 0x3FCA10 /end MEASUREMENT
/begin MEASUREMENT St_oznivdl1.B_ozfahrt "Das Fahrzeug hat sich bewegt" UBYTE FORMULA_0427 0 0 0.0 255.0 READ_WRITE BIT_MASK 0x10 ECU_ADDRESS 0x3FCA10 /end MEASUREMENT
/begin MEASUREMENT St_oznivdl1.B_ozkrzkor2 "Ein Mittelwert von zwei KurzMw ist da" UBYTE FORMULA_0423 0 0 0.0 255.0 READ_WRITE BIT_MASK 0x1 ECU_ADDRESS 0x3FCA10 /end MEASUREMENT
/begin MEASUREMENT St_oznivdl1.B_ozkrzkornb "Bedingung drehzahlkorrigierter Kurzzeit Niveaumittelwert und nicht drehzahlbegrenzt berechnet" UBYTE FORMULA_0424 0 0 0.0 255.0 READ_WRITE BIT_MASK 0x2 ECU_ADDRESS 0x3FCA10 /end MEASUREMENT
/begin MEASUREMENT St_oznivdl1.B_ozml "Anforderung Messung läuft" UBYTE FORMULA_0429 0 0 0.0 255.0 READ_WRITE BIT_MASK 0x40 ECU_ADDRESS 0x3FCA10 /end MEASUREMENT
/begin MEASUREMENT St_oznivdl1.B_ozmreset "Reset der Messungen (beim INI2-Sprung)" UBYTE FORMULA_0430 0 0 0.0 255.0 READ_WRITE BIT_MASK 0x80 ECU_ADDRESS 0x3FCA10 /end MEASUREMENT
/begin MEASUREMENT St_oznivdl1.B_ozoelcheck "" UBYTE FORMULA_0425 0 0 0.0 255.0 READ_WRITE BIT_MASK 0x4 ECU_ADDRESS 0x3FCA10 /end MEASUREMENT
/begin MEASUREMENT St_oznivdl1.B_ozoelchok "" UBYTE FORMULA_0426 0 0 0.0 255.0 READ_WRITE BIT_MASK 0x8 ECU_ADDRESS 0x3FCA10 /end MEASUREMENT
/begin MEASUREMENT St_oznivdl1.B_ozueberf "Überfüllung entdeckt" UBYTE FORMULA_0428 0 0 0.0 255.0 READ_WRITE BIT_MASK 0x20 ECU_ADDRESS 0x3FCA10 /end MEASUREMENT
/begin MEASUREMENT St_ozrestkm_0 "Statuswort" UBYTE FORMULA_0003 0 0.0 0.0 255.0 READ_WRITE ECU_ADDRESS 0x3FCA1A /end MEASUREMENT
/begin MEASUREMENT St_ozrestkm_0.B_oznoperm "Keine Berechnung von Permittivität für die Restlaufstrecke" UBYTE FORMULA_0423 0 0 0.0 255.0 READ_WRITE BIT_MASK 0x1 ECU_ADDRESS 0x3FCA1A /end MEASUREMENT
/begin MEASUREMENT St_ozrestkm_nv0 "Statuswort" UBYTE FORMULA_0003 0 0.0 0.0 255.0 READ_WRITE ECU_ADDRESS 0x3FA8E0 /end MEASUREMENT
/begin MEASUREMENT St_ozrestkm_nv0.B_ozcntini "Tageberechnung initialisiert" UBYTE FORMULA_0426 0 0 0.0 255.0 READ_WRITE BIT_MASK 0x8 ECU_ADDRESS 0x3FA8E0 /end MEASUREMENT
/begin MEASUREMENT St_ozrestkm_nv0.B_ozini "" UBYTE FORMULA_0425 0 0 0.0 255.0 READ_WRITE BIT_MASK 0x4 ECU_ADDRESS 0x3FA8E0 /end MEASUREMENT
/begin MEASUREMENT St_ozrestkm_nv0.B_ozvfk "" UBYTE FORMULA_0424 0 0 0.0 255.0 READ_WRITE BIT_MASK 0x2 ECU_ADDRESS 0x3FA8E0 /end MEASUREMENT
/begin MEASUREMENT St_ozrestkm_nv0.B_rwanz0 "Bedingung für Restweganzeige = Null" UBYTE FORMULA_0423 0 0 0.0 255.0 READ_WRITE BIT_MASK 0x1 ECU_ADDRESS 0x3FA8E0 /end MEASUREMENT
/begin MEASUREMENT St_pgentred_1s "Statuswort" UBYTE FORMULA_0003 0 0.0 0.0 255.0 READ_WRITE ECU_ADDRESS 0x3FCA52 /end MEASUREMENT
/begin MEASUREMENT St_pgentred_1s.B_genht "Bedingung Generator Hochtemperatur" UBYTE FORMULA_0423 0 0 0.0 255.0 READ_WRITE BIT_MASK 0x1 ECU_ADDRESS 0x3FCA52 /end MEASUREMENT
/begin MEASUREMENT St_pgentred_1s.B_genhtkrit "" UBYTE FORMULA_0424 0 0 0.0 255.0 READ_WRITE BIT_MASK 0x2 ECU_ADDRESS 0x3FCA52 /end MEASUREMENT
/begin MEASUREMENT St_pgentred_1s.B_genhtkritv "Bedingung kritische Temparatur vor Entprellung" UBYTE FORMULA_0425 0 0 0.0 255.0 READ_WRITE BIT_MASK 0x4 ECU_ADDRESS 0x3FCA52 /end MEASUREMENT
/begin MEASUREMENT St_pgentred_1s.B_genhtmxgra "Maximale Gradient Chiptemparatur überstiegen" UBYTE FORMULA_0427 0 0 0.0 255.0 READ_WRITE BIT_MASK 0x10 ECU_ADDRESS 0x3FCA52 /end MEASUREMENT
/begin MEASUREMENT St_pgentred_1s.B_ierrgrenzh "Grenzstrom aus Hochtemperatur Generator aktiv" UBYTE FORMULA_0428 0 0 0.0 255.0 READ_WRITE BIT_MASK 0x20 ECU_ADDRESS 0x3FCA52 /end MEASUREMENT
/begin MEASUREMENT St_pgentred_1s.B_tdiodekrit "Diodentemparatur im kritischen Bereich" UBYTE FORMULA_0426 0 0 0.0 255.0 READ_WRITE BIT_MASK 0x8 ECU_ADDRESS 0x3FCA52 /end MEASUREMENT
/begin MEASUREMENT T_chipfilsdt "Differenzenquotient schnellgefilterte Chiptemparatur" SWORD FORMULA_0431 0 0.0 -3276.800048828125 3276.699951171875 READ_WRITE ECU_ADDRESS 0x3FAF98 /end MEASUREMENT
/begin MEASUREMENT T_diode "Diodentemparatur" SWORD FORMULA_0431 0 0.0 -3276.800048828125 3276.699951171875 READ_WRITE ECU_ADDRESS 0x3FAF9A /end MEASUREMENT
/begin MEASUREMENT T_diodedelta "Deltatemparatur Diode" SWORD FORMULA_0431 0 0.0 -3276.800048828125 3276.699951171875 READ_WRITE ECU_ADDRESS 0x3FAF9C /end MEASUREMENT
/begin MEASUREMENT Tans_gen "Ansauglufttemparatur Generator" SWORD FORMULA_0431 0 0.0 -3276.800048828125 3276.699951171875 READ_WRITE ECU_ADDRESS 0x3FAF9E /end MEASUREMENT
/begin MEASUREMENT Tchip_fil_l "Wirkliche Chiptemperatur vom Generatorregler als Mittelwert gefiltert" SWORD FORMULA_0431 0 0.0 -3276.800048828125 3276.699951171875 READ_WRITE ECU_ADDRESS 0x3FAFC4 /end MEASUREMENT
/begin MEASUREMENT Tchip_fil_s "Wirkliche Chiptemperatur vom Generatorregler als Mittelwert gefiltert" SWORD FORMULA_0431 0 0.0 -3276.800048828125 3276.699951171875 READ_WRITE ECU_ADDRESS 0x3FAFC6 /end MEASUREMENT
/begin MEASUREMENT Tchip_ist "Wirkliche Chiptemperatur vom Generatorregler" SWORD FORMULA_0431 0 0.0 -3276.800048828125 3276.699951171875 READ_WRITE ECU_ADDRESS 0x3FAFA0 /end MEASUREMENT
/begin MEASUREMENT Tchip_mwa "Array zur Mittelwerbildung Tchip_ist" SWORD FORMULA_0431 0 0.0 -3276.800048828125 3276.699951171875 READ_WRITE ARRAY_SIZE 16 ECU_ADDRESS 0x3FAFA2 MATRIX_DIM 16 1 1 /end MEASUREMENT
/begin MEASUREMENT Tchip_sum "Summenwert Tchip zur Mittelwertbildung" SWORD FORMULA_0431 0 0.0 -3276.800048828125 3276.699951171875 READ_WRITE ECU_ADDRESS 0x3FAFC2 /end MEASUREMENT
/begin MEASUREMENT Toel "Ausgabewert Motoröltemperatur für LoCAN" SWORD FORMULA_0431 0 0.0 -3276.800048828125 3276.699951171875 READ_WRITE ECU_ADDRESS 0x3FC9F4 /end MEASUREMENT
/begin MEASUREMENT Toel_oz "Ausgabe Öltemperatur" SWORD FORMULA_0431 0 0.0 -3276.800048828125 3276.699951171875 READ_WRITE ECU_ADDRESS 0x3FC9F6 /end MEASUREMENT
/begin MEASUREMENT U_vordiode "Diodenvorwärtsspannung" UWORD FORMULA_0483 0 0.0 0.0 319.9950866699219 READ_WRITE ECU_ADDRESS 0x3FAFCA /end MEASUREMENT
/begin MEASUREMENT Z_tchip "Zaehler für Mittelwerbildung Tchip_ist" UBYTE FORMULA_0003 0 0.0 0.0 255.0 READ_WRITE ECU_ADDRESS 0x3FAFCC /end MEASUREMENT
/begin MEASUREMENT Zrbosmld "anzuzeigender Zähler für durchgeführten Ölservice" UBYTE FORMULA_0003 0 0.0 0.0 255.0 READ_WRITE ECU_ADDRESS 0x3FA891 /end MEASUREMENT
/begin COMPU_METHOD FORMULA_0000 "FORMULA_0000" RAT_FUNC "%7.0" "-" COEFFS 0 1 0 0 0 1 /end COMPU_METHOD
/begin COMPU_METHOD FORMULA_0003 "FORMULA_0003" RAT_FUNC "%3.0" "-" COEFFS 0 1 0 0 0 1 /end COMPU_METHOD
/begin COMPU_METHOD FORMULA_0006 "FORMULA_0006" RAT_FUNC "%5.0" "Upm" COEFFS 0 1 0 0 0 1 /end COMPU_METHOD
/begin COMPU_METHOD FORMULA_0007 "FORMULA_0007" RAT_FUNC "%8.3" "-" COEFFS 0 10000.0 0.0 0 0.0 1.0 /end COMPU_METHOD
/begin COMPU_METHOD FORMULA_0008 "FORMULA_0008" RAT_FUNC "%6.1" "V" COEFFS 0 10.0 0.0 0 0.0 1.0 /end COMPU_METHOD
/begin COMPU_METHOD FORMULA_0010 "FORMULA_0010" RAT_FUNC "%5.0" "-" COEFFS 0 1 0 0 0 1 /end COMPU_METHOD
/begin COMPU_METHOD FORMULA_0021 "FORMULA_0021" RAT_FUNC "%7.2" "s" COEFFS 0 100.0 0.0 0 0.0 1.0 /end COMPU_METHOD
/begin COMPU_METHOD FORMULA_0023 "FORMULA_0023" RAT_FUNC "%6.1" "°C" COEFFS 0 10.0 2732.0 0 0.0 1.0 /end COMPU_METHOD
/begin COMPU_METHOD FORMULA_0024 "FORMULA_0024" RAT_FUNC "%9.4" "-" COEFFS 0 32768.0 0.0 0 0.0 1.0 /end COMPU_METHOD
/begin COMPU_METHOD FORMULA_0025 "FORMULA_0025" RAT_FUNC "%8.3" "-" COEFFS 0 16384.0 0.0 0 0.0 1.0 /end COMPU_METHOD
/begin COMPU_METHOD FORMULA_0037 "FORMULA_0037" RAT_FUNC "%5.2" "-" COEFFS 0 1 0 0 0 1 /end COMPU_METHOD
/begin COMPU_METHOD FORMULA_0071 "FORMULA_0071" RAT_FUNC "%6.1" "s" COEFFS 0 10.0 0.0 0 0.0 1.0 /end COMPU_METHOD
/begin COMPU_METHOD FORMULA_0073 "FORMULA_0073" RAT_FUNC "%8.3" "-" COEFFS 0 1024.0 0.0 0 0.0 1.0 /end COMPU_METHOD
/begin COMPU_METHOD FORMULA_0075 "FORMULA_0075" RAT_FUNC "%6.1" "mbar" COEFFS 0 16.0 0.0 0 0.0 1.0 /end COMPU_METHOD
/begin COMPU_METHOD FORMULA_0076 "FORMULA_0076" RAT_FUNC "%6.1" "km/h" COEFFS 0 16.0 0.0 0 0.0 1.0 /end COMPU_METHOD
/begin COMPU_METHOD FORMULA_0080 "FORMULA_0080" RAT_FUNC "%7.2" "-" COEFFS 0 1 0 0 0 1 /end COMPU_METHOD
/begin COMPU_METHOD FORMULA_0103 "FORMULA_0103" RAT_FUNC "%6.1" "kg/h" COEFFS 0 10.0 0.0 0 0.0 1.0 /end COMPU_METHOD
/begin COMPU_METHOD FORMULA_0110 "FORMULA_0110" RAT_FUNC "%8.3" "bar" COEFFS 0 1000.0 0.0 0 0.0 1.0 /end COMPU_METHOD
/begin COMPU_METHOD FORMULA_0114 "FORMULA_0114" RAT_FUNC "%5.0" "digit" COEFFS 0 1 0 0 0 1 /end COMPU_METHOD
/begin COMPU_METHOD FORMULA_0123 "FORMULA_0123" RAT_FUNC "%7.2" "m/(s*s)" COEFFS 0 40.0 0.0 0 0.0 1.0 /end COMPU_METHOD
/begin COMPU_METHOD FORMULA_0161 "FORMULA_0161" RAT_FUNC "%6.1" "%" COEFFS 0 10.24 0.0 0 0.0 1.0 /end COMPU_METHOD
/begin COMPU_METHOD FORMULA_0199 "FORMULA_0199" RAT_FUNC "%9.4" "-" COEFFS 0 16384.0 0.0 0 0.0 1.0 /end COMPU_METHOD
/begin COMPU_METHOD FORMULA_0357 "FORMULA_0357" RAT_FUNC "%5.2" "s" COEFFS 0 200.0 0.0 0 0.0 1.0 /end COMPU_METHOD
/begin COMPU_METHOD FORMULA_0358 "FORMULA_0358" RAT_FUNC "%3.0" "ms" COEFFS 0 0.1 0.0 0 0.0 1.0 /end COMPU_METHOD
/begin COMPU_METHOD FORMULA_0423 "FORMULA_0423" TAB_VERB "%5.2" "-" COMPU_TAB_REF FORMULA_0423_VTAB /end COMPU_METHOD
/begin COMPU_METHOD FORMULA_0424 "FORMULA_0424" TAB_VERB "%5.2" "-" COMPU_TAB_REF FORMULA_0424_VTAB /end COMPU_METHOD
/begin COMPU_METHOD FORMULA_0425 "FORMULA_0425" TAB_VERB "%5.2" "-" COMPU_TAB_REF FORMULA_0425_VTAB /end COMPU_METHOD
/begin COMPU_METHOD FORMULA_0426 "FORMULA_0426" TAB_VERB "%5.2" "-" COMPU_TAB_REF FORMULA_0426_VTAB /end COMPU_METHOD
/begin COMPU_METHOD FORMULA_0427 "FORMULA_0427" TAB_VERB "%5.2" "-" COMPU_TAB_REF FORMULA_0427_VTAB /end COMPU_METHOD
/begin COMPU_METHOD FORMULA_0428 "FORMULA_0428" TAB_VERB "%5.2" "-" COMPU_TAB_REF FORMULA_0428_VTAB /end COMPU_METHOD
/begin COMPU_METHOD FORMULA_0429 "FORMULA_0429" TAB_VERB "%5.2" "-" COMPU_TAB_REF FORMULA_0429_VTAB /end COMPU_METHOD
/begin COMPU_METHOD FORMULA_0430 "FORMULA_0430" TAB_VERB "%5.2" "-" COMPU_TAB_REF FORMULA_0430_VTAB /end COMPU_METHOD
/begin COMPU_METHOD FORMULA_0431 "FORMULA_0431" RAT_FUNC "%5.0" "°C" COEFFS 0 10.0 0.0 0 0.0 1.0 /end COMPU_METHOD
/begin COMPU_METHOD FORMULA_0432 "FORMULA_0432" RAT_FUNC "%6.1" "V" COEFFS 0 10.61571125265393 0.0 0 0.0 1.0 /end COMPU_METHOD
/begin COMPU_METHOD FORMULA_0433 "FORMULA_0433" RAT_FUNC "%6.1" "km" COEFFS 0 0.1 0.0 0 0.0 1.0 /end COMPU_METHOD
/begin COMPU_METHOD FORMULA_0434 "FORMULA_0434" RAT_FUNC "%3.0" "km" COEFFS 0 1.e-003 0.0 0 0.0 1.0 /end COMPU_METHOD
/begin COMPU_METHOD FORMULA_0435 "FORMULA_0435" RAT_FUNC "%6.1" "-" COEFFS 0 10922.66666666667 0.0 0 0.0 1.0 /end COMPU_METHOD
/begin COMPU_METHOD FORMULA_0436 "FORMULA_0436" RAT_FUNC "%5.2" "mm" COEFFS 0 3.413333333333334 0.0 0 0.0 1.0 /end COMPU_METHOD
/begin COMPU_METHOD FORMULA_0437 "FORMULA_0437" RAT_FUNC "%5.0" "km" COEFFS 0 0.1 0.0 0 0.0 1.0 /end COMPU_METHOD
/begin COMPU_METHOD FORMULA_0438 "FORMULA_0438" RAT_FUNC "%5.2" "Liter" COEFFS 0 10.0 0.0 0 0.0 1.0 /end COMPU_METHOD
/begin COMPU_METHOD FORMULA_0439 "FORMULA_0439" RAT_FUNC "%5.2" "mm" COEFFS 0 32.0 0.0 0 0.0 1.0 /end COMPU_METHOD
/begin COMPU_METHOD FORMULA_0440 "FORMULA_0440" RAT_FUNC "%7.2" "min" COEFFS 0 1 0 0 0 1 /end COMPU_METHOD
/begin COMPU_METHOD FORMULA_0441 "FORMULA_0441" RAT_FUNC "%8.3" "" COEFFS 0 4096.0 0.0 0 0.0 1.0 /end COMPU_METHOD
/begin COMPU_METHOD FORMULA_0442 "FORMULA_0442" RAT_FUNC "%7.2" "-" COEFFS 0 512.0 0.0 0 0.0 1.0 /end COMPU_METHOD
/begin COMPU_METHOD FORMULA_0443 "FORMULA_0443" RAT_FUNC "%7.2" "%" COEFFS 0 6553.6 0.0 0 0.0 1.0 /end COMPU_METHOD
/begin COMPU_METHOD FORMULA_0444 "FORMULA_0444" RAT_FUNC "%5.2" "-" COEFFS 0 64.0 0.0 0 0.0 1.0 /end COMPU_METHOD
/begin COMPU_METHOD FORMULA_0445 "FORMULA_0445" RAT_FUNC "%7.2" "°C" COEFFS 0 100.0 0.0 0 0.0 1.0 /end COMPU_METHOD
/begin COMPU_METHOD FORMULA_0446 "FORMULA_0446" RAT_FUNC "%9.4" "-" COEFFS 0 1024.0 0.0 0 0.0 1.0 /end COMPU_METHOD
/begin COMPU_METHOD FORMULA_0447 "FORMULA_0447" RAT_FUNC "%8.3" "hPa" COEFFS 0 25.6 0.0 0 0.0 1.0 /end COMPU_METHOD
/begin COMPU_METHOD FORMULA_0448 "FORMULA_0448" RAT_FUNC "%4.1" "-" COEFFS 0 4.0 0.0 0 0.0 1.0 /end COMPU_METHOD
/begin COMPU_METHOD FORMULA_0449 "FORMULA_0449" RAT_FUNC "%5.2" "-" COEFFS 0 32.0 0.0 0 0.0 1.0 /end COMPU_METHOD
/begin COMPU_METHOD FORMULA_0450 "FORMULA_0450" RAT_FUNC "%7.2" "-" COEFFS 0 32768.0 0.0 0 0.0 1.0 /end COMPU_METHOD
/begin COMPU_METHOD FORMULA_0451 "FORMULA_0451" RAT_FUNC "%7.2" "mm" COEFFS 0 3.413333333333334 0.0 0 0.0 1.0 /end COMPU_METHOD
/begin COMPU_METHOD FORMULA_0452 "FORMULA_0452" RAT_FUNC "%7.2" "mm" COEFFS 0 6.826666666666667 0.0 0 0.0 1.0 /end COMPU_METHOD
/begin COMPU_METHOD FORMULA_0453 "FORMULA_0453" RAT_FUNC "%4.1" "-" COEFFS 0 100.0 0.0 0 0.0 1.0 /end COMPU_METHOD
/begin COMPU_METHOD FORMULA_0454 "FORMULA_0454" RAT_FUNC "%10.3" "" COEFFS 0 8192.0 0.0 0 0.0 1.0 /end COMPU_METHOD
/begin COMPU_METHOD FORMULA_0455 "FORMULA_0455" RAT_FUNC "%5.2" "-" COEFFS 0 256.0 0.0 0 0.0 1.0 /end COMPU_METHOD
/begin COMPU_METHOD FORMULA_0456 "FORMULA_0456" RAT_FUNC "%9.4" "-" COEFFS 0 1024.0 0.0 0 0.0 1.0 /end COMPU_METHOD
/begin COMPU_METHOD FORMULA_0457 "FORMULA_0457" RAT_FUNC "%6.3" "-" COEFFS 0 1024.0 0.0 0 0.0 1.0 /end COMPU_METHOD
/begin COMPU_METHOD FORMULA_0458 "FORMULA_0458" RAT_FUNC "%5.2" "-" COEFFS 0 8.0 0.0 0 0.0 1.0 /end COMPU_METHOD
/begin COMPU_METHOD FORMULA_0459 "FORMULA_0459" RAT_FUNC "%6.3" "°KW" COEFFS 0 42.66666666666666 0.0 0 0.0 1.0 /end COMPU_METHOD
/begin COMPU_METHOD FORMULA_0460 "FORMULA_0460" RAT_FUNC "%9.4" "-" COEFFS 0 65536.0 0.0 0 0.0 1.0 /end COMPU_METHOD
/begin COMPU_METHOD FORMULA_0462 "FORMULA_0462" RAT_FUNC "%7.2" "%" COEFFS 0 655.36 0.0 0 0.0 1.0 /end COMPU_METHOD
/begin COMPU_METHOD FORMULA_0464 "FORMULA_0464" RAT_FUNC "%6.3" "A" COEFFS 0 8.0 0.0 0 0.0 1.0 /end COMPU_METHOD
/begin COMPU_METHOD FORMULA_0465 "FORMULA_0465" RAT_FUNC "%5.2" "-" COEFFS 0 64.0 0.0 0 0.0 1.0 /end COMPU_METHOD
/begin COMPU_METHOD FORMULA_0474 "FORMULA_0474" RAT_FUNC "%5.0" "km/h" COEFFS 0 1 0 0 0 1 /end COMPU_METHOD
/begin COMPU_METHOD FORMULA_0475 "FORMULA_0475" RAT_FUNC "%5.2" "%" COEFFS 0 2.56 0.0 0 0.0 1.0 /end COMPU_METHOD
/begin COMPU_METHOD FORMULA_0476 "FORMULA_0476" RAT_FUNC "%5.2" "min" COEFFS 0 1 0 0 0 1 /end COMPU_METHOD
/begin COMPU_METHOD FORMULA_0478 "FORMULA_0478" RAT_FUNC "%4.1" "-" COEFFS 0 1 0 0 0 1 /end COMPU_METHOD
/begin COMPU_METHOD FORMULA_0482 "FORMULA_0482" RAT_FUNC "%7.2" "%" COEFFS 0 256.0 0.0 0 0.0 1.0 /end COMPU_METHOD
/begin COMPU_METHOD FORMULA_0483 "FORMULA_0483" RAT_FUNC "%8.3" "V" COEFFS 0 204.8 0.0 0 0.0 1.0 /end COMPU_METHOD
/begin COMPU_METHOD FORMULA_0490 "FORMULA_0490" RAT_FUNC "%7.4" "V" COEFFS 0 10.61571125265393 0.0 0 0.0 1.0 /end COMPU_METHOD
/begin COMPU_METHOD FORMULA_0536 "FORMULA_0536" RAT_FUNC "%5.0" "mV" COEFFS 0 0.2048 0.0 0 0.0 1.0 /end COMPU_METHOD
/begin COMPU_METHOD FORMULA_0543 "FORMULA_0543" RAT_FUNC "%5.0" "%" COEFFS 0 1 0 0 0 1 /end COMPU_METHOD
/begin COMPU_METHOD FORMULA_0610 "FORMULA_0610" RAT_FUNC "%6.1" "l" COEFFS 0 2.0 0.0 0 0.0 1.0 /end COMPU_METHOD
/begin COMPU_METHOD FORMULA_0645 "FORMULA_0645" RAT_FUNC "%6.3" "s" COEFFS 0 0 1.28 0 1 0 /end COMPU_METHOD
/begin COMPU_METHOD FORMULA_0658 "FORMULA_0658" RAT_FUNC "%5.2" "s" COEFFS 0 0 2.56 0 1 0 /end COMPU_METHOD
/begin COMPU_METHOD FORMULA_0679 "FORMULA_0679" RAT_FUNC "%5.2" "s" COEFFS 0 0 25.6 0 1 0 /end COMPU_METHOD
/begin COMPU_METHOD FORMULA_0746 "FORMULA_0746" RAT_FUNC "%6.1" "l/h" COEFFS 0 8.0 0.0 0 0.0 1.0 /end COMPU_METHOD
/begin COMPU_METHOD FORMULA_0763 "FORMULA_0763" RAT_FUNC "%5.0" "ms" COEFFS 0 1 0 0 0 1 /end COMPU_METHOD
/begin COMPU_METHOD FORMULA_0769 "FORMULA_0769" TAB_VERB "%7.2" "-" COMPU_TAB_REF FORMULA_0769_VTAB /end COMPU_METHOD
/begin COMPU_METHOD FORMULA_0792 "FORMULA_0792" RAT_FUNC "%5.0" "mg" COEFFS 0 1 0 0 0 1 /end COMPU_METHOD
/begin COMPU_METHOD FORMULA_0799 "FORMULA_0799" TAB_VERB "%7.2" "-" COMPU_TAB_REF FORMULA_0799_VTAB /end COMPU_METHOD
/begin COMPU_METHOD FORMULA_0800 "FORMULA_0800" RAT_FUNC "%5.0" "sec" COEFFS 0 1 0 0 0 1 /end COMPU_METHOD
/begin COMPU_METHOD FORMULA_0801 "FORMULA_0801" RAT_FUNC "%6.1" "°C" COEFFS 0 10.0 0.0 0 0.0 1.0 /end COMPU_METHOD
/begin COMPU_METHOD FORMULA_0844 "FORMULA_0844" TAB_VERB "%7.2" "-" COMPU_TAB_REF FORMULA_0844_VTAB /end COMPU_METHOD
/begin COMPU_METHOD FORMULA_0921 "FORMULA_0921" RAT_FUNC "%5.0" "s" COEFFS 0 100.0 0.0 0 0.0 1.0 /end COMPU_METHOD
/begin COMPU_METHOD FORMULA_0993 "FORMULA_0993" TAB_VERB "%3.0" "-" COMPU_TAB_REF FORMULA_0993_VTAB /end COMPU_METHOD
/begin COMPU_METHOD FORMULA_0994 "FORMULA_0994" TAB_VERB "%3.0" "-" COMPU_TAB_REF FORMULA_0994_VTAB /end COMPU_METHOD
/begin COMPU_METHOD FORMULA_0995 "FORMULA_0995" TAB_VERB "%3.0" "-" COMPU_TAB_REF FORMULA_0995_VTAB /end COMPU_METHOD
/begin COMPU_METHOD FORMULA_1001 "FORMULA_1001" TAB_VERB "%7.2" "-" COMPU_TAB_REF FORMULA_1001_VTAB /end COMPU_METHOD
/begin COMPU_METHOD FORMULA_1002 "FORMULA_1002" TAB_VERB "%7.2" "-" COMPU_TAB_REF FORMULA_1002_VTAB /end COMPU_METHOD
/begin COMPU_METHOD FORMULA_1003 "FORMULA_1003" TAB_VERB "%7.2" "-" COMPU_TAB_REF FORMULA_1003_VTAB /end COMPU_METHOD
/begin COMPU_METHOD FORMULA_1004 "FORMULA_1004" TAB_VERB "%7.2" "-" COMPU_TAB_REF FORMULA_1004_VTAB /end COMPU_METHOD
/begin COMPU_METHOD FORMULA_1005 "FORMULA_1005" TAB_VERB "%7.2" "-" COMPU_TAB_REF FORMULA_1005_VTAB /end COMPU_METHOD
/begin COMPU_METHOD FORMULA_1006 "FORMULA_1006" TAB_VERB "%7.2" "-" COMPU_TAB_REF FORMULA_1006_VTAB /end COMPU_METHOD
/begin COMPU_METHOD FORMULA_1007 "FORMULA_1007" TAB_VERB "%7.2" "-" COMPU_TAB_REF FORMULA_1007_VTAB /end COMPU_METHOD
/begin COMPU_METHOD FORMULA_1008 "FORMULA_1008" TAB_VERB "%7.2" "-" COMPU_TAB_REF FORMULA_1008_VTAB /end COMPU_METHOD
/begin COMPU_METHOD FORMULA_1009 "FORMULA_1009" TAB_VERB "%7.2" "-" COMPU_TAB_REF FORMULA_1009_VTAB /end COMPU_METHOD
/begin COMPU_METHOD FORMULA_1010 "FORMULA_1010" TAB_VERB "%7.2" "-" COMPU_TAB_REF FORMULA_1010_VTAB /end COMPU_METHOD
/begin COMPU_METHOD FORMULA_1011 "FORMULA_1011" TAB_VERB "%7.2" "-" COMPU_TAB_REF FORMULA_1011_VTAB /end COMPU_METHOD
/begin COMPU_METHOD FORMULA_1012 "FORMULA_1012" TAB_VERB "%7.2" "-" COMPU_TAB_REF FORMULA_1012_VTAB /end COMPU_METHOD
/begin COMPU_METHOD FORMULA_1013 "FORMULA_1013" TAB_VERB "%7.2" "-" COMPU_TAB_REF FORMULA_1013_VTAB /end COMPU_METHOD
/begin COMPU_METHOD FORMULA_1014 "FORMULA_1014" TAB_VERB "%7.2" "-" COMPU_TAB_REF FORMULA_1014_VTAB /end COMPU_METHOD
/begin COMPU_METHOD FORMULA_1015 "FORMULA_1015" TAB_VERB "%7.2" "-" COMPU_TAB_REF FORMULA_1015_VTAB /end COMPU_METHOD
/begin COMPU_METHOD FORMULA_1016 "FORMULA_1016" RAT_FUNC "%10.3" "-" COEFFS 0 16384.0 0.0 0 0.0 1.0 /end COMPU_METHOD
/begin COMPU_METHOD FORMULA_1017 "FORMULA_1017" TAB_VERB "%7.2" "-" COMPU_TAB_REF FORMULA_1017_VTAB /end COMPU_METHOD
/begin COMPU_METHOD FORMULA_1018 "FORMULA_1018" TAB_VERB "%7.2" "-" COMPU_TAB_REF FORMULA_1018_VTAB /end COMPU_METHOD
/begin COMPU_METHOD FORMULA_1019 "FORMULA_1019" TAB_VERB "%7.2" "-" COMPU_TAB_REF FORMULA_1019_VTAB /end COMPU_METHOD
/begin COMPU_METHOD FORMULA_1020 "FORMULA_1020" TAB_VERB "%7.2" "-" COMPU_TAB_REF FORMULA_1020_VTAB /end COMPU_METHOD
/begin COMPU_METHOD FORMULA_1021 "FORMULA_1021" TAB_VERB "%7.2" "-" COMPU_TAB_REF FORMULA_1021_VTAB /end COMPU_METHOD
/begin COMPU_METHOD FORMULA_1022 "FORMULA_1022" RAT_FUNC "%7.2" "s" COEFFS 0 1000.0 0.0 0 0.0 1.0 /end COMPU_METHOD
/begin COMPU_METHOD FORMULA_1023 "FORMULA_1023" RAT_FUNC "%7.2" "l" COEFFS 0 30.0 0.0 0 0.0 1.0 /end COMPU_METHOD
/begin COMPU_METHOD FORMULA_1024 "FORMULA_1024" RAT_FUNC "%7.2" "s" COEFFS 0 0 25.6 0 1 0 /end COMPU_METHOD
/begin COMPU_METHOD FORMULA_1025 "FORMULA_1025" RAT_FUNC "%7.2" "s" COEFFS 0 10.0 0.0 0 0.0 1.0 /end COMPU_METHOD
/begin COMPU_METHOD FORMULA_1026 "FORMULA_1026" RAT_FUNC "%8.3" "-" COEFFS 0 1000.0 0.0 0 0.0 1.0 /end COMPU_METHOD
/begin COMPU_METHOD FORMULA_1027 "FORMULA_1027" TAB_VERB "%5.2" "-" COMPU_TAB_REF FORMULA_1027_VTAB /end COMPU_METHOD
/begin COMPU_METHOD FORMULA_1028 "FORMULA_1028" TAB_VERB "%5.2" "-" COMPU_TAB_REF FORMULA_1028_VTAB /end COMPU_METHOD
/begin COMPU_METHOD FORMULA_1029 "FORMULA_1029" TAB_VERB "%5.2" "-" COMPU_TAB_REF FORMULA_1029_VTAB /end COMPU_METHOD
/begin COMPU_METHOD FORMULA_1030 "FORMULA_1030" RAT_FUNC "%8.3" "bar/V" COEFFS 0 5000.0 0.0 0 0.0 1.0 /end COMPU_METHOD
/begin COMPU_METHOD FORMULA_1031 "FORMULA_1031" RAT_FUNC "%8.3" "-/10ms" COEFFS 0 1000.0 0.0 0 0.0 1.0 /end COMPU_METHOD
/begin COMPU_METHOD FORMULA_1032 "FORMULA_1032" RAT_FUNC "%7.2" "s" COEFFS 0 0 655.35 0 1 0 /end COMPU_METHOD
/begin COMPU_VTAB FORMULA_0423_VTAB "FORMULA_0423_VTAB" TAB_VERB 2 0 "FALSE" 1 "TRUE" DEFAULT_VALUE "TRUE" /end COMPU_VTAB
/begin COMPU_VTAB FORMULA_0424_VTAB "FORMULA_0424_VTAB" TAB_VERB 2 0 "FALSE" 1 "TRUE" DEFAULT_VALUE "TRUE" /end COMPU_VTAB
/begin COMPU_VTAB FORMULA_0425_VTAB "FORMULA_0425_VTAB" TAB_VERB 2 0 "FALSE" 1 "TRUE" DEFAULT_VALUE "TRUE" /end COMPU_VTAB
/begin COMPU_VTAB FORMULA_0426_VTAB "FORMULA_0426_VTAB" TAB_VERB 2 0 "FALSE" 1 "TRUE" DEFAULT_VALUE "TRUE" /end COMPU_VTAB
/begin COMPU_VTAB FORMULA_0427_VTAB "FORMULA_0427_VTAB" TAB_VERB 2 0 "FALSE" 1 "TRUE" DEFAULT_VALUE "TRUE" /end COMPU_VTAB
/begin COMPU_VTAB FORMULA_0428_VTAB "FORMULA_0428_VTAB" TAB_VERB 2 0 "FALSE" 1 "TRUE" DEFAULT_VALUE "TRUE" /end COMPU_VTAB
/begin COMPU_VTAB FORMULA_0429_VTAB "FORMULA_0429_VTAB" TAB_VERB 2 0 "FALSE" 1 "TRUE" DEFAULT_VALUE "TRUE" /end COMPU_VTAB
/begin COMPU_VTAB FORMULA_0430_VTAB "FORMULA_0430_VTAB" TAB_VERB 2 0 "FALSE" 1 "TRUE" DEFAULT_VALUE "TRUE" /end COMPU_VTAB
/begin COMPU_VTAB FORMULA_0769_VTAB "FORMULA_0769_VTAB" TAB_VERB 1 0 "inaktiv" DEFAULT_VALUE "aktiv" /end COMPU_VTAB
/begin COMPU_VTAB FORMULA_0799_VTAB "FORMULA_0799_VTAB" TAB_VERB 2 0 "inaktiv" 1 "aktiv" /end COMPU_VTAB
/begin COMPU_VTAB FORMULA_0844_VTAB "FORMULA_0844_VTAB" TAB_VERB 1 0 "inaktiv" DEFAULT_VALUE "aktiv" /end COMPU_VTAB
/begin COMPU_VTAB FORMULA_0993_VTAB "FORMULA_0993_VTAB" TAB_VERB 13 0 "ZGM" 18 "DME1" 19 "DME2" 22 "AFS" 23 "EKP" 24 "SMG" 33 "ACC" 34 "ALC" 35 "ARS" 37 "GRS" 41 "DSC" 42 "EMF" 57 "EDCK" DEFAULT_VALUE "unbekannt" /end COMPU_VTAB
/begin COMPU_VTAB FORMULA_0994_VTAB "FORMULA_0994_VTAB" TAB_VERB 21 1 "Alive" 2 "Ring" 4 "Notlauf" 8 "reserved" 16 "SleepInd" 17 "SleepInd/Alive" 18 "SleepInd/Ring" 20 "SleepInd/Notlauf" 32 "SleepAck" 33 "SleepAck/Alive" 34 "SleepAck/Ring" 36 "SleepAck/Notlauf" 64 "Umlauf" 65 "Umlauf/Alive" 66 "Umlauf/Ring" 68 "Umlauf/Notlauf" 80 "SleepInd" 81 "SleepInd/Alive" 82 "SleepInd/Ring" 84 "SleepInd/Notlauf" 128 "reserved" /end COMPU_VTAB
/begin COMPU_VTAB FORMULA_0995_VTAB "FORMULA_0995_VTAB" TAB_VERB 10 0 "Nothing" 1 "Start" 2 "WaitTockenSnd" 3 "WaitRingMsg" 4 "SndSkippedAlive" 5 "WaitLimp" 6 "PrepSleep" 7 "GoSleep" 8 "Sleep" 128 "Repeat" /end COMPU_VTAB
/begin COMPU_VTAB FORMULA_1001_VTAB "FORMULA_1001_VTAB" TAB_VERB 1 0 "inaktiv" DEFAULT_VALUE "Pulsgenerator" /end COMPU_VTAB
/begin COMPU_VTAB FORMULA_1002_VTAB "FORMULA_1002_VTAB" TAB_VERB 1 0 "-" DEFAULT_VALUE "FETT-Hub-Trigger" /end COMPU_VTAB
/begin COMPU_VTAB FORMULA_1003_VTAB "FORMULA_1003_VTAB" TAB_VERB 1 0 "-" DEFAULT_VALUE "MAGER-Hub-Trigger" /end COMPU_VTAB
/begin COMPU_VTAB FORMULA_1004_VTAB "FORMULA_1004_VTAB" TAB_VERB 1 0 "-" DEFAULT_VALUE "UKP" /end COMPU_VTAB
/begin COMPU_VTAB FORMULA_1005_VTAB "FORMULA_1005_VTAB" TAB_VERB 1 0 "-" DEFAULT_VALUE "UKP" /end COMPU_VTAB
/begin COMPU_VTAB FORMULA_1006_VTAB "FORMULA_1006_VTAB" TAB_VERB 1 0 "-" DEFAULT_VALUE "Berechnung" /end COMPU_VTAB
/begin COMPU_VTAB FORMULA_1007_VTAB "FORMULA_1007_VTAB" TAB_VERB 1 0 "-" DEFAULT_VALUE "aktiv" /end COMPU_VTAB
/begin COMPU_VTAB FORMULA_1008_VTAB "FORMULA_1008_VTAB" TAB_VERB 1 0 "sperrt" DEFAULT_VALUE "Freigabe" /end COMPU_VTAB
/begin COMPU_VTAB FORMULA_1009_VTAB "FORMULA_1009_VTAB" TAB_VERB 1 0 "sperrt" DEFAULT_VALUE "Freigabe" /end COMPU_VTAB
/begin COMPU_VTAB FORMULA_1010_VTAB "FORMULA_1010_VTAB" TAB_VERB 5 1 "PASSIV" 2 "WARTEN" 4 "ZYK MAGER" 8 "ZYK FETT" 16 "ENDE" DEFAULT_VALUE "undef." /end COMPU_VTAB
/begin COMPU_VTAB FORMULA_1011_VTAB "FORMULA_1011_VTAB" TAB_VERB 1 0 "-" DEFAULT_VALUE "FETT->MAGER" /end COMPU_VTAB
/begin COMPU_VTAB FORMULA_1012_VTAB "FORMULA_1012_VTAB" TAB_VERB 1 0 "-" DEFAULT_VALUE "i.O." /end COMPU_VTAB
/begin COMPU_VTAB FORMULA_1013_VTAB "FORMULA_1013_VTAB" TAB_VERB 1 0 "-" DEFAULT_VALUE "i.O." /end COMPU_VTAB
/begin COMPU_VTAB FORMULA_1014_VTAB "FORMULA_1014_VTAB" TAB_VERB 1 0 "-" DEFAULT_VALUE "aktiv" /end COMPU_VTAB
/begin COMPU_VTAB FORMULA_1015_VTAB "FORMULA_1015_VTAB" TAB_VERB 1 0 "-" DEFAULT_VALUE "fertig" /end COMPU_VTAB
/begin COMPU_VTAB FORMULA_1017_VTAB "FORMULA_1017_VTAB" TAB_VERB 5 1 "PASSIV" 2 "WARTEN" 4 "AMPLITUDE" 8 "NORMIERUNG" 16 "ENDE" DEFAULT_VALUE "undef." /end COMPU_VTAB
/begin COMPU_VTAB FORMULA_1018_VTAB "FORMULA_1018_VTAB" TAB_VERB 1 0 "-" DEFAULT_VALUE "MAX-Ermittlung" /end COMPU_VTAB
/begin COMPU_VTAB FORMULA_1019_VTAB "FORMULA_1019_VTAB" TAB_VERB 1 0 "-" DEFAULT_VALUE "MIN-Ermittlung" /end COMPU_VTAB
/begin COMPU_VTAB FORMULA_1020_VTAB "FORMULA_1020_VTAB" TAB_VERB 1 0 "inaktiv" DEFAULT_VALUE "aktiv" /end COMPU_VTAB
/begin COMPU_VTAB FORMULA_1021_VTAB "FORMULA_1021_VTAB" TAB_VERB 2 0 "inaktiv" 1 "TRIMMREGELUNG" /end COMPU_VTAB
/begin COMPU_VTAB FORMULA_1027_VTAB "FORMULA_1027_VTAB" TAB_VERB 2 0 "IO" 1 "100%" DEFAULT_VALUE "ungueltig" /end COMPU_VTAB
/begin COMPU_VTAB FORMULA_1028_VTAB "FORMULA_1028_VTAB" TAB_VERB 4 0 "noDIAG" 1 "LL-100Proz" 2 "TL" 4 "Q-Max" DEFAULT_VALUE "ungueltig" /end COMPU_VTAB
/begin COMPU_VTAB FORMULA_1029_VTAB "FORMULA_1029_VTAB" TAB_VERB 2 0 "Disabled" 1 "Enabled" /end COMPU_VTAB
/begin FUNCTION NO_FUNCTION ""
 /begin DEF_CHARACTERISTIC K_BNS_CTRINC K_BNS_SCHW1 K_BNS_UBMAX K_BNS_UBMIN K_BNS_VFZG K_BNSMAX K_GENMXGRADH K_HTGENDFGRO K_I_VERTEIL K_NGENHTMN1 K_NGENHTMX1 K_T_BNSDELAY K_TCHIPFIL K_TDNGENKRIT K_TDTCHIPKRI K_TDTCHIPMX K_TDUBFZMN K_TFIGENHT K_TFTDIODE K_TGENMXGRAD K_TGENMXTHD K_TGENRSHT K_TLCHTEP K_UGENHTMN KF_IERRGREHT KF_TANSGENKO KF_UFDIODE KL_NELUEFTGE KL_RTHJADIOD KL_TCHIPOFFS KL_TMAXDIODE S_BNSCLRAPP S_HTDETEC /end DEF_CHARACTERISTIC
 /begin OUT_MEASUREMENT Bnctrmx1s Bnsctr Bnsctrant0 Bnsctrant1 Bnsctrant2 Bnsctrant3 Ierrgrenz_ht Nelueft_gen P_totdiode St_bns St_bns.B_bns St_bns2 St_bns2.B_nachlnd7 St_pgentred_1s St_pgentred_1s.B_genht St_pgentred_1s.B_genhtkrit St_pgentred_1s.B_genhtkritv St_pgentred_1s.B_genhtmxgra St_pgentred_1s.B_ierrgrenzh St_pgentred_1s.B_tdiodekrit T_chipfilsdt T_diode T_diodedelta Tans_gen Tchip_fil_l Tchip_fil_s Tchip_ist Tchip_mwa Tchip_sum U_vordiode Z_tchip /end OUT_MEASUREMENT
/end FUNCTION
/begin FUNCTION NWM ""
 /begin OUT_MEASUREMENT nwm_ecu_nr nwm_RecvCopyMsgUser Nwm_var_s.flags1 Nwm_var_s.MsgDest Nwm_var_s.MsgTyp Nwm_var_s.MsgUser1 Nwm_var_s.MsgUser2 Nwm_var_s.nwmAction Nwm_var_s.rxTxCounter Nwm_var_s.state Nwm_var_s.successorEcu Nwm_var_s.timeCounter Nwm_var_s.txEcuNumber nwm_weckverursacher /end OUT_MEASUREMENT
/end FUNCTION
/begin FUNCTION OBD ""
 /begin DEF_CHARACTERISTIC K_KAT_OBD_CFG K_KAT_OBD_LANK_MW_DELTA_MAX K_KAT_OBD_LANK_MW_DIFF_MAX K_KAT_OBD_LANK_MW_HYS_CHK1 K_KAT_OBD_LANK_MW_MAX K_KAT_OBD_LANK_MW_MIN K_KAT_OBD_M_HUB_CNT K_KAT_OBD_VERH K_KAT_OBD_VERH_SCHWELLE K_KAT_OBD_WERT_MODE6 K_KAT_OBD_ZYKL_CNT_MAX K_LAVK_OBD_DXN_KAT_EXD_LAM_SOLL K_LAVK_OBD_DYN_AMPL_CNT K_LAVK_OBD_DYN_AMPL_MAX K_LAVK_OBD_DYN_AMPL_MIN K_LAVK_OBD_DYN_CFG K_LAVK_OBD_DYN_KAT_EXD_N_SOLL K_LAVK_OBD_DYN_KAT_EXD_RF_MAX K_LAVK_OBD_DYN_KAT_EXD_RF_MIN K_LAVK_OBD_DYN_KAT_EXD_T K_LAVK_OBD_DYN_LAM_REG_MAX K_LAVK_OBD_DYN_LAM_REG_MIN K_LAVK_OBD_DYN_MW_HYS K_LAVK_OBD_DYN_MW_MAX K_LAVK_OBD_DYN_MW_MIN K_LAVK_OBD_DYN_NORM_CNT K_LAVK_OBD_DYN_TE_VOL_SUM K_LAVK_OBD_DYN_WERT_MODE6 K_O2_LA_TRIM_CFG K_O2_OBD_CFG K_O2_OBD_DYN_CNT_INC K_O2_OBD_DYN_DELTA_CNT K_O2_OBD_DYN_DELTA_PUMP_RF K_O2_OBD_DYN_DELTA_RF K_O2_OBD_DYN_RF_T K_O2_OBD_DYN_T_VERZ K_O2_OBD_LAM_SOLL_OFFS K_O2_OBD_LAVK_AD_OFFS_MAX K_O2_OBD_LAVK_AD_OFFS_MIN K_O2_OBD_ML_MIN K_O2_OBD_N_MAX K_O2_OBD_N_MIN K_O2_OBD_PUMG_MIN K_O2_OBD_RF_MAX K_O2_OBD_RF_MIN_HYS K_O2_OBD_RF_T_MIN K_O2_OBD_SA_ML_MAX K_O2_OBD_T_ML K_O2_OBD_TEV_MAX K_O2_OBD_TKAT_HYS K_O2_OBD_TKAT_MAX K_O2_OBD_TKAT_MIN K_O2_OBD_TMOT K_O2_OBD_V_MAX K_O2_OBD_V_MIN K_O2_OBD_WE_ML_MIN KF_KAT_OBD_INT_WICHT KF_KAT_OBD_WICHT_GESAMT KF_LAVK_OBD_DYN_AMPL_MAX KF_LAVK_OBD_DYN_AMPL_MIN KF_LAVK_OBD_DYN_WICHT_GESAMT KL_KAT_OBD_GESAMT_MAX KL_KAT_OBD_IO_VERZ KL_KAT_OBD_WERT_MAX KL_LAVK_OBD_DYN_GESAMT_MAX KL_LAVK_OBD_DYN_IO_VERZ KL_LAVK_OBD_DYN_RF_MIN KL_LAVK_OBD_DYN_WERT_MAX KL_O2_OBD_RF_MIN /end DEF_CHARACTERISTIC
 /begin OUT_MEASUREMENT kat_o2_per_cnt_passiv_b1 kat_o2_per_cnt_passiv_b2 kat_obd_fett_mager_b1 kat_obd_fett_mager_b2 kat_obd_gesamt_max kat_obd_int_b1 kat_obd_int_b2 kat_obd_io_t_b1 kat_obd_io_t_b2 kat_obd_io_verz_b1 kat_obd_io_verz_b2 kat_obd_lank_chk1_b1 kat_obd_lank_chk1_b2 kat_obd_lank_chk2_b1 kat_obd_lank_chk2_b2 kat_obd_lank_diff_b1 kat_obd_lank_diff_b2 kat_obd_lank_diff_sum_b1 kat_obd_lank_diff_sum_b2 kat_obd_lank_diff_sum_f_b1 kat_obd_lank_diff_sum_f_b2 kat_obd_lank_diff_sum_m_b1 kat_obd_lank_diff_sum_m_b2 kat_obd_lank_mw_b1 kat_obd_lank_mw_b2 kat_obd_lank_sum_b1 kat_obd_lank_sum_b2 kat_obd_st_b1 kat_obd_st_b2 kat_obd_t_cnt_b1 kat_obd_t_cnt_b2 kat_obd_verh_b1 kat_obd_verh_b2 kat_obd_verh_cnt_b1 kat_obd_verh_cnt_b2 kat_obd_wert_ermittlung_b1 kat_obd_wert_ermittlung_b2 kat_obd_wert_max_b1 kat_obd_wert_max_b2 kat_obd_wicht_b1 kat_obd_wicht_b2 kat_obd_wicht_sum_b1 kat_obd_wicht_sum_b2 kat_obd_zust_st_b1 kat_obd_zust_st_b2 kat_obd_zykl_cnt_b1 kat_obd_zykl_cnt_b2 lavk_obd_dyn_ampl_b1 lavk_obd_dyn_ampl_b2 lavk_obd_dyn_ampl_cnt_b1 lavk_obd_dyn_ampl_cnt_b2 lavk_obd_dyn_ampl_max_b1 lavk_obd_dyn_ampl_max_b2 lavk_obd_dyn_ampl_max_mw_b1 lavk_obd_dyn_ampl_max_mw_b2 lavk_obd_dyn_ampl_min_b1 lavk_obd_dyn_ampl_min_b2 lavk_obd_dyn_ampl_min_mw_b1 lavk_obd_dyn_ampl_min_mw_b2 lavk_obd_dyn_ampl_mw_b1 lavk_obd_dyn_ampl_mw_b2 lavk_obd_dyn_ampl_sum_b1 lavk_obd_dyn_ampl_sum_b2 lavk_obd_dyn_exd_b1 lavk_obd_dyn_exd_b2 lavk_obd_dyn_gesamt_max lavk_obd_dyn_io_t_b1 lavk_obd_dyn_io_t_b2 lavk_obd_dyn_io_verz_b1 lavk_obd_dyn_io_verz_b2 lavk_obd_dyn_kat_exd_lam_soll lavk_obd_dyn_kat_exd_t_b1 lavk_obd_dyn_kat_exd_t_b2 lavk_obd_dyn_max_b1 lavk_obd_dyn_max_b2 lavk_obd_dyn_min_b1 lavk_obd_dyn_min_b2 lavk_obd_dyn_mw_max_b1 lavk_obd_dyn_mw_max_b2 lavk_obd_dyn_mw_min_b1 lavk_obd_dyn_mw_min_b2 lavk_obd_dyn_norm_b1 lavk_obd_dyn_norm_b2 lavk_obd_dyn_norm_cnt_b1 lavk_obd_dyn_norm_cnt_b2 lavk_obd_dyn_norm_sum_b1 lavk_obd_dyn_norm_sum_b2 lavk_obd_dyn_rf_min lavk_obd_dyn_st_b1 lavk_obd_dyn_st_b2 lavk_obd_dyn_wert_max_b1 lavk_obd_dyn_wert_max_b2 lavk_obd_dyn_zustand_b1 lavk_obd_dyn_zustand_b2 o2_lam_soll_fett_hub_b1 o2_lam_soll_fett_hub_b2 o2_lam_soll_fett_hub_trig_b1 o2_lam_soll_fett_hub_trig_b2 o2_lam_soll_fett_ukp_b1 o2_lam_soll_fett_ukp_b2 o2_lam_soll_mager_hub_b1 o2_lam_soll_mager_hub_b2 o2_lam_soll_mager_hub_trig_b1 o2_lam_soll_mager_hub_trig_b2 o2_lam_soll_mager_per_b1 o2_lam_soll_mager_per_b2 o2_lam_soll_mager_ukp_b1 o2_lam_soll_mager_ukp_b2 o2_lam_soll_pus_b1 o2_lam_soll_pus_b2 o2_obd_dyn_t_b1 o2_obd_dyn_t_b2 o2_obd_dyn_t_verz_b1 o2_obd_dyn_t_verz_b2 o2_obd_lam_soll_offs o2_obd_period_cnt_b1 o2_obd_period_cnt_b2 o2_obd_rf_min_schwelle_b1 o2_obd_rf_min_schwelle_b2 o2_obd_st_b1 o2_obd_st_b2 o2_obd_t_fett_b1 o2_obd_t_fett_b2 o2_obd_t_mager_b1 o2_obd_t_mager_b2 o2_obd_t_sum_b1 o2_obd_t_sum_b2 o2_obd_tkat_min_b1 o2_obd_tkat_min_b2 o2_rf_min_schw_t_b1 o2_rf_min_schw_t_b2 /end OUT_MEASUREMENT
/end FUNCTION
/begin FUNCTION Oelsensor-Module ""
 /begin DEF_CHARACTERISTIC K_CW_OZ K_CW_OZ_2 K_DTOG_UBMIN K_NACHFUELL12 K_NACHFUELL25 K_NACHFUELL38 K_NACHFUELL53 K_NACHFUELL69 K_NACHFUELL85 K_NACHFUELL95 K_OZABSTELL K_OZALTANZABZ K_OZANFANZ K_OZBESCHAUS K_OZBZKMSTK1 K_OZDAEMPF K_OZDELTOE K_OZDIAGNMOT K_OZDIAGNMOT2 K_OZDIAGSPG K_OZDKNIVN K_OZERRD K_OZHEAL K_OZKMMAXK11 K_OZKMUPL K_OZKVB96 K_OZKVB96A K_OZKVBMXK18 K_OZKVBOK16 K_OZLBESCHN K_OZLBESCHORI K_OZLBESCHP K_OZLBESCHST K_OZLF1 K_OZLF2 K_OZLUFTMAX K_OZMAXSLOPE K_OZMINSLOPE K_OZMNKMBO K_OZMWK K_OZMWL K_OZMWOR K_OZMWV K_OZMXOHK15 K_OZNFERR K_OZNFML K_OZNFOELCKO K_OZNFOELCOK K_OZNIVKL K_OZNMOTMAX K_OZNMOTMIN K_OZOELCABZ K_OZOELCOK K_OZOELCVERZ K_OZOELMEN K_OZOELVERB K_OZORIPEILTZO K_OZORIPEILTZU K_OZPEIL12 K_OZPEIL25 K_OZPEIL38 K_OZPEIL53 K_OZPEIL69 K_OZPEIL85 K_OZPEILDO K_OZPEILDOMIN K_OZPEILDU K_OZPEILDU38 K_OZPEILERR K_OZPEILKSPR K_OZPEILLP85 K_OZPEILML K_OZPEILOELCKO K_OZPEILOELCOK K_OZPEILSPRUNG K_OZPERBOK17 K_OZPERBRK14 K_OZPERMRMIN K_OZPERXK10 K_OZPLTEMP K_OZPLZTEMP K_OZPRREFMAX K_OZPRREFMIN K_OZQBESCHN K_OZQBESCHORI K_OZQBESCHP K_OZQBESCHST K_OZRESBOST K_OZSTANDVERZ K_OZSTARTABZ K_OZSTARTVERZ K_OZSTMINW K_OZSTZYK K_OZTAGCTERR K_OZTEMPBW K_OZTEMPQERR K_OZTORMAX K_OZTORMIN K_OZUEBERF K_OZUEBERTEMP K_OZUEFCNT K_OZUEFNLB K_OZUEFNQB K_OZUEFNST K_OZUEFODZ K_OZUEFPLB K_OZUEFPQB K_OZUEFPST K_OZUEFTEM K_OZUEFUDZ K_OZUEFVERZ K_OZUTFAK K_OZVERBDKM K_OZVERBFAK K_OZVERLORI K_OZVERZERRBSD K_OZVORMV K_OZVORPEILMIN K_OZZEITFAKT K_OZZEITINT K_OZZTEMP K_OZZYKCBS K_TOG_CNTMAX K_TOGMAXUNPL K_TOGVERZOEG K_TRTYP KF_OZDREHKOR KF_OZDREHKOR_EINFAHR KF_OZKORRNIV KF_OZKORRORI KF_OZZEIT KL_OZBEFKL KL_OZKRZMW2 KL_OZLBNIV KL_OZLN KL_OZNFDELTA KL_OZORBERO KL_OZPERMKL KL_OZQBNIV KL_OZSTNIV KL_OZTEMPKL KL_OZVERDFAK KL_TKTOENIV KL_TVTOEL S_OZBSDKOORD /end DEF_CHARACTERISTIC
 /begin OUT_MEASUREMENT Bosbtvfbk Bosfxid2 Bosid2 Bosjziel Bosmziel Bosprog2 Bosres Bosrlsm Bosrw2 Bosstate Id_bosmg Id_bosmgt Id_bosmsg N_ozmw Oz_abstellm Oz_anztoe Oz_beschcnt Oz_cttagini Oz_diagtoens Oz_dkm Oz_hoehe Oz_intprog Oz_kmlow Oz_kmstrw0 Oz_krz2cnt Oz_krzcnt Oz_krzkor2 Oz_krzkor2k Oz_krzmw Oz_krzmwkor Oz_krzor Oz_kvbdiff Oz_kvbmw Oz_kvbmwtmp Oz_kvbmx Oz_kvbog Oz_kvbsm Oz_kvbsm_ul Oz_kvbtmp2 Oz_langmw Oz_lbmw Oz_lf1t Oz_lf2t Oz_lgmwcnt Oz_litges Oz_lowcnt Oz_lowkm Oz_lowperex Oz_lowperm0 Oz_lowrwanz Oz_lp Oz_lv Oz_manip Oz_manipt Oz_niv Oz_nivakt Oz_nivkor Oz_nivkrzt Oz_nivlanglit Oz_nivlangt Oz_nivlit Oz_nivnfm Oz_nivqlt Oz_nivrers Oz_nivt Oz_nivtoe Oz_nivzeit Oz_oelkm Oz_oelverbr Oz_oelzeit Oz_oelzeitt Oz_oricnt Oz_orikor Oz_peil Oz_peilaltanz Oz_peilkm Oz_peilkmalt Oz_peillang Oz_peiloben Oz_peilunten Oz_perm Oz_permakt Oz_permbog Oz_permerrz Oz_permt Oz_perref Oz_pzdivp Oz_qbmw Oz_reset Oz_rwanz Oz_rwde Oz_rwkvb Oz_rwp Oz_rwpeil Oz_rwperm Oz_rwprog Oz_rwprueck Oz_rwrueck Oz_rwzeit Oz_steigung Oz_svcntchg Oz_temp Oz_tempakt Oz_tempf Oz_tempplz Oz_tempqlt Oz_temprold Oz_tempt Oz_temptoe Oz_testtoel2 Oz_uefcnt Oz_uefzcnt Oz_utzeit Oz_verbkmalt Oz_verbnivalt Oz_vfanz Oz_vfbdmew Oz_vfkvb Oz_vfperm Oz_vfzeit Oz_vormw Oz_vormwcnt Oz_zieljahr Oz_zielmon Oz_zjbdmew Oz_zmbdmew St_dqlt0 St_dqlt0.B_ozdiagnmotok St_dqlt0.B_ozerrbsd St_dqlt0.B_ozkttoens St_dqlt0.B_ozlerr St_dqlt0.B_ozqerr St_dqlt0.B_ozterr St_dqlt0.B_td_ogerr St_dqlt0.B_td_ogupl St_dqlt1 St_dqlt1.B_ozerr St_dqlt1.B_ozfbsd2 St_dqlt1.B_oztemppl St_oz_o St_oz_o.B_mol_sf St_oz_o.B_oztemic St_ozbg_nv0 St_ozbg_nv0.B_ozkl15 St_ozbg0 St_ozbg0.B_bosmsgc St_ozbg0.B_mol_vb St_ozbg0.B_mol_vl St_ozbg0.B_oeltemp St_ozbg0.B_oelverb St_ozbg0.B_oelverl St_ozgg_nv0 St_ozgg_nv0.B_dmeini St_ozgg_nv0.B_dmewech St_ozgg_nv0.B_factoryres St_ozgg0 St_ozgg0.B_oelwech St_ozgg0.B_ozniv St_ozgg0.B_ozperm St_ozgg0.B_oztemp St_ozgg0.B_ozvfchg St_ozgg0.B_ozvfchgt St_ozgg0.B_ozzeitdmew St_ozgg0.B_svcntchg St_ozgg1 St_ozgg1.B_ozmanip St_ozgg1.B_oznivqlt St_ozgg1.B_oznivtoe St_ozgg1.B_ozreset St_ozgg1.B_ozresetcan St_ozgg1.B_ozresett St_ozgg1.B_ozvfchgc St_ozgg1.B_ozvfchgcc St_ozgg2 St_ozgg2.B_oztempqlt St_ozgg2.B_oztemptoe St_ozgg2.B_oztoeok St_oznivdl_nv0 St_oznivdl_nv0.B_ozabzlang St_oznivdl_nv0.B_ozlmwneu St_oznivdl_nv0.B_oznachf St_oznivdl_nv0.B_ozoelwech St_oznivdl_nv0.B_ozpeilerr St_oznivdl0 St_oznivdl0.B_ozkrzkor St_oznivdl0.B_ozkrzl St_oznivdl0.B_ozkrzlkor St_oznivdl0.B_ozlangmw St_oznivdl0.B_ozluft St_oznivdl0.B_oznivb St_oznivdl0.B_ozor St_oznivdl0.B_ozvormw St_oznivdl1 St_oznivdl1.B_ozfahrt St_oznivdl1.B_ozkrzkor2 St_oznivdl1.B_ozkrzkornb St_oznivdl1.B_ozml St_oznivdl1.B_ozmreset St_oznivdl1.B_ozoelcheck St_oznivdl1.B_ozoelchok St_oznivdl1.B_ozueberf St_ozrestkm_0 St_ozrestkm_0.B_oznoperm St_ozrestkm_nv0 St_ozrestkm_nv0.B_ozcntini St_ozrestkm_nv0.B_ozini St_ozrestkm_nv0.B_ozvfk St_ozrestkm_nv0.B_rwanz0 Toel Toel_oz Zrbosmld /end OUT_MEASUREMENT
/end FUNCTION
/begin FUNCTION pabg "" /begin DEF_CHARACTERISTIC K_PABG_STAT_TAU KL_PABG_STAT_ML /end DEF_CHARACTERISTIC
 /begin OUT_MEASUREMENT pabg_b1 pabg_b1.dif pabg_b1.pabg_10ms pabg_b1.stat_roh pabg_b1.tau pabg_b2 pabg_b2.dif pabg_b2.pabg_10ms pabg_b2.stat_roh pabg_b2.tau pabg_m /end OUT_MEASUREMENT
/end FUNCTION
/begin FUNCTION PCTRL "" /begin DEF_CHARACTERISTIC K_PCTRL_PROZ_ZYKL K_PCTRL_TASK_ZYKL K_PCTRL_TIMEOUT /end DEF_CHARACTERISTIC
 /begin OUT_MEASUREMENT pctrl_proz pctrl_proz_err pctrl_proz_tb pctrl_t_old_ipk pctrl_task pctrl_task_err pctrl_task_tb pctrl_tout /end OUT_MEASUREMENT
/end FUNCTION
/begin FUNCTION PKS ""
 /begin DEF_CHARACTERISTIC K_PKS_DIAG_AUFBAU_DELAY K_PKS_DIAG_AUFBAU_MIN K_PKS_DIAG_AUFBAU_TAU K_PKS_DIAG_FEHLER_SCHW K_PKS_DIAG_MAX K_PKS_DIAG_MIN K_PKS_ERSATZ K_PKS_OBD_ABW_TAU K_PKS_OBD_ABW_TAU_QMAX K_PKS_OBD_AY K_PKS_OBD_CFG K_PKS_OBD_ERSATZ K_PKS_OBD_FST K_PKS_OBD_LL_MAX K_PKS_OBD_LL_MIN K_PKS_OBD_PUMG_MIN K_PKS_OBD_PUMPE_VL K_PKS_OBD_Q_EKP_MAX K_PKS_OBD_Q_EKP_MIN K_PKS_OBD_Q_MAX K_PKS_OBD_Q_MIN K_PKS_OBD_SOLL_DYN_MAX K_PKS_OBD_TIME_ML_MIN K_PKS_OBD_TL_MAX K_PKS_OBD_TL_MIN K_PKS_OBD_TMOT_MIN K_PKS_OBD_UB_MIN K_PKS_OBD_VERZ K_PKS_OBD_VERZ_Q_MAX K_PKS_OFFSET K_PKS_PLAU_INTG_MAX K_PKS_PLAU_INTG_MIN K_PKS_PLAU_MAX_I K_PKS_PLAU_MIN_T_REG K_PKS_PLAU_QMIN_KVA K_PKS_PLAU_QMIN_N K_PKS_PLAU_SCHWELLE K_PKS_STEIGUNG K_PKS_TAU K_PKS_TAU_EKP100 KL_PKS_PLAU_INC KL_PKS_TAU_MODELL /end DEF_CHARACTERISTIC
 /begin OUT_MEASUREMENT ekp_obd_verz ekp_obd_vl_t pks_ad pks_aufbau_fehler pks_ist_roh pks_obd_abw_filt pks_obd_zust pks_plau_delta pks_plau_intg pks_rel_mdl pks_st pks_tv_mdl_norm /end OUT_MEASUREMENT
/end FUNCTION
/begin RECORD_LAYOUT TKF_SW_SW_SW FNC_VALUES 5 SWORD COLUMN_DIR DIRECT AXIS_PTS_X 3 SWORD INDEX_INCR DIRECT AXIS_PTS_Y 4 SWORD INDEX_INCR DIRECT NO_AXIS_PTS_X 1 UBYTE NO_AXIS_PTS_Y 2 UBYTE /end RECORD_LAYOUT
/begin RECORD_LAYOUT TKF_SW_SW_UB FNC_VALUES 5 UBYTE COLUMN_DIR DIRECT AXIS_PTS_X 3 SWORD INDEX_INCR DIRECT AXIS_PTS_Y 4 SWORD INDEX_INCR DIRECT NO_AXIS_PTS_X 1 UBYTE NO_AXIS_PTS_Y 2 UBYTE /end RECORD_LAYOUT
/begin RECORD_LAYOUT TKF_SW_SW_UW FNC_VALUES 5 UWORD COLUMN_DIR DIRECT AXIS_PTS_X 3 SWORD INDEX_INCR DIRECT AXIS_PTS_Y 4 SWORD INDEX_INCR DIRECT NO_AXIS_PTS_X 1 UBYTE NO_AXIS_PTS_Y 2 UBYTE /end RECORD_LAYOUT
/begin RECORD_LAYOUT TKF_UB_SW_UW FNC_VALUES 5 UWORD COLUMN_DIR DIRECT AXIS_PTS_X 3 SWORD INDEX_INCR DIRECT AXIS_PTS_Y 4 UBYTE INDEX_INCR DIRECT NO_AXIS_PTS_X 1 UBYTE NO_AXIS_PTS_Y 2 UBYTE /end RECORD_LAYOUT
/begin RECORD_LAYOUT TKF_UW_SW_SW FNC_VALUES 5 SWORD COLUMN_DIR DIRECT AXIS_PTS_X 3 SWORD INDEX_INCR DIRECT AXIS_PTS_Y 4 UWORD INDEX_INCR DIRECT NO_AXIS_PTS_X 1 UBYTE NO_AXIS_PTS_Y 2 UBYTE /end RECORD_LAYOUT
/begin RECORD_LAYOUT TKF_UW_UW_UW FNC_VALUES 5 UWORD COLUMN_DIR DIRECT AXIS_PTS_X 3 UWORD INDEX_INCR DIRECT AXIS_PTS_Y 4 UWORD INDEX_INCR DIRECT NO_AXIS_PTS_X 1 UBYTE NO_AXIS_PTS_Y 2 UBYTE /end RECORD_LAYOUT
/begin RECORD_LAYOUT TKL_SB_VV_SB FNC_VALUES 4 SBYTE COLUMN_DIR DIRECT AXIS_PTS_X 3 SBYTE INDEX_INCR DIRECT NO_AXIS_PTS_X 1 UBYTE RESERVED 2 BYTE /end RECORD_LAYOUT
/begin RECORD_LAYOUT TKL_SW_VV_SW FNC_VALUES 4 SWORD COLUMN_DIR DIRECT AXIS_PTS_X 3 SWORD INDEX_INCR DIRECT NO_AXIS_PTS_X 1 UBYTE RESERVED 2 BYTE /end RECORD_LAYOUT
/begin RECORD_LAYOUT TKL_SW_VV_UW FNC_VALUES 4 UWORD COLUMN_DIR DIRECT AXIS_PTS_X 3 SWORD INDEX_INCR DIRECT NO_AXIS_PTS_X 1 UBYTE RESERVED 2 BYTE /end RECORD_LAYOUT
/begin RECORD_LAYOUT TKL_UB_VV_SW FNC_VALUES 4 SWORD COLUMN_DIR DIRECT AXIS_PTS_X 3 UBYTE INDEX_INCR DIRECT NO_AXIS_PTS_X 1 UBYTE RESERVED 2 BYTE /end RECORD_LAYOUT
/begin RECORD_LAYOUT TKL_UB_VV_UB FNC_VALUES 4 UBYTE COLUMN_DIR DIRECT AXIS_PTS_X 3 UBYTE INDEX_INCR DIRECT NO_AXIS_PTS_X 1 UBYTE RESERVED 2 BYTE /end RECORD_LAYOUT
/begin RECORD_LAYOUT TKL_UB_VV_UW FNC_VALUES 4 UWORD COLUMN_DIR DIRECT AXIS_PTS_X 3 UBYTE INDEX_INCR DIRECT NO_AXIS_PTS_X 1 UBYTE RESERVED 2 BYTE /end RECORD_LAYOUT
/begin RECORD_LAYOUT TKL_UW_VV_SW FNC_VALUES 4 SWORD COLUMN_DIR DIRECT AXIS_PTS_X 3 UWORD INDEX_INCR DIRECT NO_AXIS_PTS_X 1 UBYTE RESERVED 2 BYTE /end RECORD_LAYOUT
/begin RECORD_LAYOUT TKL_UW_VV_UB FNC_VALUES 4 UBYTE COLUMN_DIR DIRECT AXIS_PTS_X 3 UWORD INDEX_INCR DIRECT NO_AXIS_PTS_X 1 UBYTE RESERVED 2 BYTE /end RECORD_LAYOUT
/begin RECORD_LAYOUT TKL_UW_VV_UW FNC_VALUES 4 UWORD COLUMN_DIR DIRECT AXIS_PTS_X 3 UWORD INDEX_INCR DIRECT NO_AXIS_PTS_X 1 UBYTE RESERVED 2 BYTE /end RECORD_LAYOUT
/begin RECORD_LAYOUT TKW_VV_VV_SB FNC_VALUES 1 SBYTE COLUMN_DIR DIRECT /end RECORD_LAYOUT
/begin RECORD_LAYOUT TKW_VV_VV_SW FNC_VALUES 1 SWORD COLUMN_DIR DIRECT /end RECORD_LAYOUT
/begin RECORD_LAYOUT TKW_VV_VV_UB FNC_VALUES 1 UBYTE COLUMN_DIR DIRECT /end RECORD_LAYOUT
/begin RECORD_LAYOUT TKW_VV_VV_UL FNC_VALUES 1 ULONG COLUMN_DIR DIRECT /end RECORD_LAYOUT
/begin RECORD_LAYOUT TKW_VV_VV_UW FNC_VALUES 1 UWORD COLUMN_DIR DIRECT /end RECORD_LAYOUT
/end MODULE
/end PROJECT
