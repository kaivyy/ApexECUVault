ASAP2_VERSION 1 30
/begin PROJECT MSS65-inj "Generiert am 14.10.05 um 11:34:36"
/begin HEADER "" VERSION "R341" /end HEADER
/begin MODULE _MSS65-inj "Generiert am 14.10.05 um 11:34:36"
/begin MOD_COMMON "" BYTE_ORDER MSB_FIRST ALIGNMENT_BYTE 1 ALIGNMENT_WORD 2 ALIGNMENT_LONG 4 ALIGNMENT_FLOAT32_IEEE 4 ALIGNMENT_FLOAT64_IEEE 8 /end MOD_COMMON
/begin CHARACTERISTIC cfg.abgas "Konfigurationsparameter: ABGAS-Variante" VALUE 0x770E9 TKW_VV_VV_UB 100.0 FORMULA_0380 0.0 255.0 /end CHARACTERISTIC
/begin CHARACTERISTIC cfg.baureihe "Konfigurationsparameter: Fz Baureihe" VALUE 0x770E6 TKW_VV_VV_UB 100.0 FORMULA_0377 0.0 255.0 /end CHARACTERISTIC
/begin CHARACTERISTIC cfg.betriebsmode "Konfigurationsparameter: SG Typ" VALUE 0x770ED TKW_VV_VV_UB 100.0 FORMULA_0384 0.0 255.0 /end CHARACTERISTIC
/begin CHARACTERISTIC cfg.canmess "Konfigurationsparameter: CAN-Messtechnik" VALUE 0x770F1 TKW_VV_VV_UB 100.0 FORMULA_0362 0.0 255.0 /end CHARACTERISTIC
/begin CHARACTERISTIC cfg.canstand "Konfigurationsparameter: CAN Stand" VALUE 0x770EC TKW_VV_VV_UB 100.0 FORMULA_0383 0.0 255.0 /end CHARACTERISTIC
/begin CHARACTERISTIC cfg.diagnose "Konfigurationsparameter: Diagnose" VALUE 0x770EA TKW_VV_VV_UB 100.0 FORMULA_0381 0.0 255.0 /end CHARACTERISTIC
/begin CHARACTERISTIC cfg.dsc_typ "Konfigurationsparameter: DSC" VALUE 0x770F0 TKW_VV_VV_UB 100.0 FORMULA_0386 0.0 255.0 /end CHARACTERISTIC
/begin CHARACTERISTIC cfg.getriebetyp "Konfigurationsparameter: Getriebetyp" VALUE 0x770E7 TKW_VV_VV_UB 100.0 FORMULA_0378 0.0 255.0 /end CHARACTERISTIC
/begin CHARACTERISTIC cfg.hil "Konfigurationsparameter: HIL-Betrieb" VALUE 0x770F2 TKW_VV_VV_UB 100.0 FORMULA_0387 0.0 255.0 /end CHARACTERISTIC
/begin CHARACTERISTIC cfg.ipm "Konfigurationsparameter: IPM" VALUE 0x770F3 TKW_VV_VV_UB 100.0 FORMULA_0362 0.0 255.0 /end CHARACTERISTIC
/begin CHARACTERISTIC cfg.la_variante "Konfigurationsparameter: LA-Variante" VALUE 0x770E8 TKW_VV_VV_UB 100.0 FORMULA_0379 0.0 255.0 /end CHARACTERISTIC
/begin CHARACTERISTIC cfg.motortyp "Konfigurationsparameter: Motortyp" VALUE 0x770E4 TKW_VV_VV_UW 100.0 FORMULA_0376 0.0 65535.0 FORMAT "%5.2" /end CHARACTERISTIC
/begin CHARACTERISTIC cfg.peripherie "Konfigurationsparameter: Motorperipherie" VALUE 0x770EF TKW_VV_VV_UB 100.0 FORMULA_0037 0.0 255.0 /end CHARACTERISTIC
/begin CHARACTERISTIC cfg.sg_mode "Steuergeraete Mode" VALUE 0x770EE TKW_VV_VV_UB 100.0 FORMULA_0385 0.0 255.0 BIT_MASK 0xF /end CHARACTERISTIC
/begin CHARACTERISTIC cfg.status "Konfigurationsparameter: SG Status" VALUE 0x770EB TKW_VV_VV_UB 100.0 FORMULA_0382 0.0 255.0 /end CHARACTERISTIC
/begin CHARACTERISTIC K_DMTL_2_STABIL "Stabilkriterium ein oder zweimal zu erfuellen" VALUE 0x707FB TKW_VV_VV_UB 100.0 FORMULA_0650 0.0 255.0 /end CHARACTERISTIC
/begin CHARACTERISTIC K_DMTL_ABBR_FEIN "Anzahl abgebrochene Feindiags" VALUE 0x707A7 TKW_VV_VV_UB 100.0 FORMULA_0545 0.0 255.0 /end CHARACTERISTIC
/begin CHARACTERISTIC K_DMTL_ABBR_FEUCHT "Max Anzahl Feuchteabbrueche ohne MIL" VALUE 0x707A8 TKW_VV_VV_UB 100.0 FORMULA_0545 0.0 255.0 /end CHARACTERISTIC
/begin CHARACTERISTIC K_DMTL_ANZ_DECKEL "Anzahl Deckeldiagnose-Versuche" VALUE 0x707A4 TKW_VV_VV_UB 100.0 FORMULA_0545 0.0 255.0 /end CHARACTERISTIC
/begin CHARACTERISTIC K_DMTL_ANZ_DECKEL_LECK "Max. Anzahl Deckeldiagnosen mit Ergebnis Leck" VALUE 0x707A5 TKW_VV_VV_UB 100.0 FORMULA_0545 0.0 255.0 /end CHARACTERISTIC
/begin CHARACTERISTIC K_DMTL_ANZ_FAHRTEN "Anzahl der langen Fahrten " VALUE 0x707A6 TKW_VV_VV_UB 100.0 FORMULA_0003 0.0 255.0 /end CHARACTERISTIC
/begin CHARACTERISTIC K_DMTL_AY_MAX "Maximale Querbeschleunigung bei Deckeldiagnose" VALUE 0x707AA TKW_VV_VV_SW 100.0 FORMULA_0123 -20.0 20.0 FORMAT "%5.2" /end CHARACTERISTIC
/begin CHARACTERISTIC K_DMTL_CFG "Konfiguration DMTL" VALUE 0x707AC TKW_VV_VV_UB 100.0 FORMULA_0641 0.0 255.0 /end CHARACTERISTIC
/begin CHARACTERISTIC K_DMTL_DI_BETANK "DMTL DeltaStrom Betankungserkennung" VALUE 0x707AE TKW_VV_VV_UW 100.0 FORMULA_0553 0.0 147.4537048339844 FORMAT "%5.2" /end CHARACTERISTIC
/begin CHARACTERISTIC K_DMTL_DI_DECKEL "DMTL DeltaStrom Tankdeckel" VALUE 0x707B0 TKW_VV_VV_UW 100.0 FORMULA_0553 0.0 147.4537048339844 FORMAT "%5.2" /end CHARACTERISTIC
/begin CHARACTERISTIC K_DMTL_DI_STABIL "DeltaStrom Stabil" VALUE 0x707B2 TKW_VV_VV_UW 100.0 FORMULA_0553 0.0 147.4537048339844 FORMAT "%5.2" /end CHARACTERISTIC
/begin CHARACTERISTIC K_DMTL_DU_MAX "Max. Spannungsaenderung ohne Abbruch" VALUE 0x707B4 TKW_VV_VV_UB 100.0 FORMULA_0348 0.0 25.5 /end CHARACTERISTIC
/begin CHARACTERISTIC K_DMTL_FAKT_T_DECKEL "Faktor fuer Deckeldiagnose auf Grobleckzeit" VALUE 0x707FA TKW_VV_VV_UB 100.0 FORMULA_0649 0.0 7.968699932098389 /end CHARACTERISTIC
/begin CHARACTERISTIC K_DMTL_FST_DECKEL_MAX "Max. zul. Fuellstand fuer Deckelmessung" VALUE 0x707B8 TKW_VV_VV_UB 100.0 FORMULA_0559 0.0 127.5 /end CHARACTERISTIC
/begin CHARACTERISTIC K_DMTL_FST_ERSATZ "Ersatzwert bei FST-Fehler" VALUE 0x707B7 TKW_VV_VV_UB 100.0 FORMULA_0559 0.0 127.5 /end CHARACTERISTIC
/begin CHARACTERISTIC K_DMTL_FST_MAX "Max. zul. Fuellstand" VALUE 0x707B5 TKW_VV_VV_UB 100.0 FORMULA_0559 0.0 127.5 /end CHARACTERISTIC
/begin CHARACTERISTIC K_DMTL_FST_MIN "Min. zul. Fuellstand" VALUE 0x707B6 TKW_VV_VV_UB 100.0 FORMULA_0559 0.0 127.5 /end CHARACTERISTIC
/begin CHARACTERISTIC K_DMTL_GROB_OHNE_FEIN "Anzahl Grobleckdiags. ohne Feindiag " VALUE 0x707B9 TKW_VV_VV_UB 100.0 FORMULA_0545 0.0 255.0 /end CHARACTERISTIC
/begin CHARACTERISTIC K_DMTL_I_FAKT_CCDECKEL "Faktor fuer I-ref zur Tankdeckelpruefung" VALUE 0x707BA TKW_VV_VV_UB 100.0 FORMULA_0638 0.0 1.99210000038147 /end CHARACTERISTIC
/begin CHARACTERISTIC K_DMTL_I_FAKT_GROB "Faktor fuer I-ref zur Gobleck" VALUE 0x707BB TKW_VV_VV_UB 100.0 FORMULA_0638 0.0 1.99210000038147 /end CHARACTERISTIC
/begin CHARACTERISTIC K_DMTL_I_FAKT_P "Minimaler Strom-Abfall nach Ventil Umschalten " VALUE 0x707BC TKW_VV_VV_UB 100.0 FORMULA_0642 0.0 1.0 /end CHARACTERISTIC
/begin CHARACTERISTIC K_DMTL_I_KURZSCHL "Stromschwelle fuer Kurzschlußerkennung" VALUE 0x707BE TKW_VV_VV_UW 100.0 FORMULA_0553 0.0 147.4537048339844 FORMAT "%5.2" /end CHARACTERISTIC
/begin CHARACTERISTIC K_DMTL_I_REF_1_2_DIFF "max. Unterschied Ref1 und Ref2" VALUE 0x707C6 TKW_VV_VV_UW 100.0 FORMULA_0553 0.0 147.4537048339844 FORMAT "%5.2" /end CHARACTERISTIC
/begin CHARACTERISTIC K_DMTL_I_REF_DIFF "max. Referenzstromschwankungen" VALUE 0x707C0 TKW_VV_VV_UW 100.0 FORMULA_0553 0.0 147.4537048339844 FORMAT "%5.2" /end CHARACTERISTIC
/begin CHARACTERISTIC K_DMTL_I_REF_MAX "Referenzstrom max." VALUE 0x707C2 TKW_VV_VV_UW 100.0 FORMULA_0553 0.0 147.4537048339844 FORMAT "%5.2" /end CHARACTERISTIC
/begin CHARACTERISTIC K_DMTL_I_REF_MIN "Referenzstrom min." VALUE 0x707C4 TKW_VV_VV_UW 100.0 FORMULA_0553 0.0 147.4537048339844 FORMAT "%5.2" /end CHARACTERISTIC
/begin CHARACTERISTIC K_DMTL_P_MIN "Minimaler Luftdruck fuer Diagnose" VALUE 0x707F8 TKW_VV_VV_SW 100.0 FORMULA_0075 400.0 1200.0 FORMAT "%4.1" /end CHARACTERISTIC
/begin CHARACTERISTIC K_DMTL_START "Robys INCA Startknubbl" VALUE 0x707C8 TKW_VV_VV_UB 100.0 FORMULA_0643 0.0 255.0 /end CHARACTERISTIC
/begin CHARACTERISTIC K_DMTL_T_ABSTELL "min. Abstellzeit fuer Diagnosebeginn" VALUE 0x707DE TKW_VV_VV_UW 100.0 FORMULA_0556 0.0 65535.0 /end CHARACTERISTIC
/begin CHARACTERISTIC K_DMTL_T_AY_DLY "Wartezeit Querbeschleunigung" VALUE 0x707E0 TKW_VV_VV_UB 100.0 FORMULA_0461 0.0 25.5 /end CHARACTERISTIC
/begin CHARACTERISTIC K_DMTL_T_CC_DAUER "Max. Anzeigedauer CC Meldung Tankdeckel" VALUE 0x707E2 TKW_VV_VV_UW 100.0 FORMULA_0071 0.0 6553.5 FORMAT "%4.1" /end CHARACTERISTIC
/begin CHARACTERISTIC K_DMTL_T_DECKEL_ML_MIN "min. Motorlaufzeit fuer Deckel-Diagnosebeginn" VALUE 0x707E4 TKW_VV_VV_UW 100.0 FORMULA_0648 0.0 307.1997985839844 FORMAT "%4.1" /end CHARACTERISTIC
/begin CHARACTERISTIC K_DMTL_T_FEUCHT_DLY "Wartezeit nach Feuchteabbruch" VALUE 0x707E6 TKW_VV_VV_UW 100.0 FORMULA_0071 0.0 6553.5 FORMAT "%4.1" /end CHARACTERISTIC
/begin CHARACTERISTIC K_DMTL_T_KURZSCHL "Wartezeit fuer Kurzschlußerkennung" VALUE 0x707E8 TKW_VV_VV_UB 100.0 FORMULA_0640 0.0 127.5 /end CHARACTERISTIC
/begin CHARACTERISTIC K_DMTL_T_MESS_GES "Max. Gesamtmessdauer (ohne Ref-Messung)" VALUE 0x707EA TKW_VV_VV_UW 100.0 FORMULA_0071 0.0 810.0 FORMAT "%4.1" /end CHARACTERISTIC
/begin CHARACTERISTIC K_DMTL_T_ML_MIN "min. Motorlaufzeit fuer Diagnosebeginn" VALUE 0x707EC TKW_VV_VV_UW 100.0 FORMULA_0648 0.0 307.1997985839844 FORMAT "%4.1" /end CHARACTERISTIC
/begin CHARACTERISTIC K_DMTL_T_REF "Messzeit Referenzstrom" VALUE 0x707EE TKW_VV_VV_UB 100.0 FORMULA_0461 0.0 25.5 /end CHARACTERISTIC
/begin CHARACTERISTIC K_DMTL_T_START_DLY "Wartezeit nach KL15 aus" VALUE 0x707EF TKW_VV_VV_UB 100.0 FORMULA_0461 0.0 25.5 /end CHARACTERISTIC
/begin CHARACTERISTIC K_DMTL_T_VENT_CHK "Zeit fuer Strompruefung nach Ventil umschalten" VALUE 0x707F0 TKW_VV_VV_UB 100.0 FORMULA_0461 0.0 25.5 /end CHARACTERISTIC
/begin CHARACTERISTIC K_DMTL_T_VENT_UM "Zeit schnelle Stromfilterung nach Schalten" VALUE 0x707F1 TKW_VV_VV_UB 100.0 FORMULA_0461 0.0 25.5 /end CHARACTERISTIC
/begin CHARACTERISTIC K_DMTL_TEMP_DECKEL_MAX "Maximaltemperatur fuer Deckeldiagnose" VALUE 0x707CE TKW_VV_VV_SW 100.0 FORMULA_0023 -50.0 170.0 FORMAT "%4.1" /end CHARACTERISTIC
/begin CHARACTERISTIC K_DMTL_TEMP_DECKEL_MIN "Mindesttemperatur fuer Deckeldiagnose" VALUE 0x707D0 TKW_VV_VV_SW 100.0 FORMULA_0023 -50.0 170.0 FORMAT "%4.1" /end CHARACTERISTIC
/begin CHARACTERISTIC K_DMTL_TEMP_MAX "Maximaltemperatur fuer Diagnose" VALUE 0x707CA TKW_VV_VV_SW 100.0 FORMULA_0023 -50.0 170.0 FORMAT "%4.1" /end CHARACTERISTIC
/begin CHARACTERISTIC K_DMTL_TEMP_MIN "Mindesttemperatur fuer Diagnose" VALUE 0x707CC TKW_VV_VV_SW 100.0 FORMULA_0023 -50.0 170.0 FORMAT "%4.1" /end CHARACTERISTIC
/begin CHARACTERISTIC K_DMTL_TEMP_START_MIN "min. Motor Startemperatur" VALUE 0x707D4 TKW_VV_VV_SW 100.0 FORMULA_0023 -50.0 170.0 FORMAT "%4.1" /end CHARACTERISTIC
/begin CHARACTERISTIC K_DMTL_TEMP_VENT_MIN "Mindesttemperatur fuer Ventilcheck" VALUE 0x707D2 TKW_VV_VV_SW 100.0 FORMULA_0023 -50.0 170.0 FORMAT "%4.1" /end CHARACTERISTIC
/begin CHARACTERISTIC K_DMTL_TP_I "Filterzeitkonstante Strom" VALUE 0x707D6 TKW_VV_VV_UW 100.0 FORMULA_0644 0.0 655.3499755859375 FORMAT "%4.1" /end CHARACTERISTIC
/begin CHARACTERISTIC K_DMTL_TP_I_BEG "Filterzeitkonstante Strom zu Beginn" VALUE 0x707D8 TKW_VV_VV_UB 100.0 FORMULA_0645 5.100000184029341e-003 1.279999971389771 /end CHARACTERISTIC
/begin CHARACTERISTIC K_DMTL_TP_I_ROH "Filterzeitkonstante Roh-Strom" VALUE 0x707D9 TKW_VV_VV_UB 100.0 FORMULA_0646 0.0 255.0 /end CHARACTERISTIC
/begin CHARACTERISTIC K_DMTL_TP_I_TANK "Filterzeitkonstante Strom Betankungserkennung" VALUE 0x707DA TKW_VV_VV_UW 100.0 FORMULA_0644 0.0 655.3499755859375 FORMAT "%4.1" /end CHARACTERISTIC
/begin CHARACTERISTIC K_DMTL_TP_UB "Filterzeitkonstante Spannung" VALUE 0x707DC TKW_VV_VV_UB 100.0 FORMULA_0647 0.0 1275.0 /end CHARACTERISTIC
/begin CHARACTERISTIC K_DMTL_UB_MAX "max. Diagnosespannung" VALUE 0x707F2 TKW_VV_VV_SW 100.0 FORMULA_0008 0.0 28.0 FORMAT "%4.1" /end CHARACTERISTIC
/begin CHARACTERISTIC K_DMTL_UB_MIN "min. Diagnosespannung" VALUE 0x707F4 TKW_VV_VV_SW 100.0 FORMULA_0008 0.0 28.0 FORMAT "%4.1" /end CHARACTERISTIC
/begin CHARACTERISTIC K_DMTL_V_MIN "Mindestgeschwindigkeit fuer Betankungserkennung" VALUE 0x707F6 TKW_VV_VV_SW 100.0 FORMULA_0076 -80.0 360.0 FORMAT "%4.1" /end CHARACTERISTIC
/begin CHARACTERISTIC K_SCHALTER_GETR_A0 "Nullpunktadaption Schalter Getriebeleergasse" VALUE 0x76A8E TKW_VV_VV_SW 100.0 FORMULA_0114 0.0 1023.0 /end CHARACTERISTIC
/begin CHARACTERISTIC K_SCHALTER_GETR_DIAG_MAX "Short-to-UB Schwelle" VALUE 0x76A9A TKW_VV_VV_SW 100.0 FORMULA_0114 0.0 1023.0 /end CHARACTERISTIC
/begin CHARACTERISTIC K_SCHALTER_GETR_DIAG_MIN "Short-to-GND Schwelle" VALUE 0x76A98 TKW_VV_VV_SW 100.0 FORMULA_0114 0.0 1023.0 /end CHARACTERISTIC
/begin CHARACTERISTIC K_SCHALTER_GETR_DIAG_N_GETR_EIN_MIN "Mindestdrehzahl Getriebeeingang fuer Diagnose" VALUE 0x76A9E TKW_VV_VV_SW 100.0 FORMULA_0006 0.0 12000.0 /end CHARACTERISTIC
/begin CHARACTERISTIC K_SCHALTER_GETR_DIAG_N_VERH_TAU "Filterkonstante fuer gang_n_verh" VALUE 0x76A9C TKW_VV_VV_UB 100.0 FORMULA_0679 0.1004000008106232 25.60000038146973 /end CHARACTERISTIC
/begin CHARACTERISTIC K_SCHALTER_GETR_DIAG_STABIL "rel. Stabilitätsgrenze Getriebeuebersetzung fuer Diagnose" VALUE 0x76AA2 TKW_VV_VV_UB 100.0 FORMULA_1081 0.0 199.2187042236328 /end CHARACTERISTIC
/begin CHARACTERISTIC K_SCHALTER_GETR_DIAG_T "Timergrenze, um Diagnose zu beenden" VALUE 0x76AA4 TKW_VV_VV_UW 100.0 FORMULA_0071 0.0 6553.5 FORMAT "%4.1" /end CHARACTERISTIC
/begin CHARACTERISTIC K_SCHALTER_GETR_DIAG_V_MIN "Mindestgeschwindigkeit fuer Diagnose" VALUE 0x76AA0 TKW_VV_VV_SW 100.0 FORMULA_0076 -80.0 360.0 FORMAT "%4.1" /end CHARACTERISTIC
/begin CHARACTERISTIC K_SCHALTER_GETR_FIL_TAU "Filterkonstante fuer AD_Wert Getriebeleergasse" VALUE 0x76A90 TKW_VV_VV_UB 100.0 FORMULA_0658 1.009999960660934e-002 2.559999942779541 /end CHARACTERISTIC
/begin CHARACTERISTIC K_SCHALTER_GETR_HYSTERESE_BREITE "Hysterese zwischen Erkennung Leergasse und Gang (in AD Schritten)" VALUE 0x76A96 TKW_VV_VV_SW 100.0 FORMULA_0114 0.0 1023.0 /end CHARACTERISTIC
/begin CHARACTERISTIC K_SCHALTER_GETR_LEERGASSE_MAX "maximaler AD-Wert für Getriebeleergasse" VALUE 0x76A94 TKW_VV_VV_SW 100.0 FORMULA_0114 -1023.0 1023.0 /end CHARACTERISTIC
/begin CHARACTERISTIC K_SCHALTER_GETR_LEERGASSE_MIN "minimaler AD-Wert für Getriebeleergasse" VALUE 0x76A92 TKW_VV_VV_SW 100.0 FORMULA_0114 -1023.0 1023.0 /end CHARACTERISTIC
/begin CHARACTERISTIC K_SCHALTER_KS_N_DIFF "Drehzahldifferenz Motor - Getriebeeingang" VALUE 0x76AB6 TKW_VV_VV_SW 100.0 FORMULA_0006 0.0 10000.0 /end CHARACTERISTIC
/begin CHARACTERISTIC K_SCHALTER_KS_N_DIFF_REF "Schaltschwelle Abstand zur Referenzdrehzahl" VALUE 0x76AB4 TKW_VV_VV_SW 100.0 FORMULA_0006 0.0 10000.0 /end CHARACTERISTIC
/begin CHARACTERISTIC K_SCHALTER_KS_N_HYS "Hysterese Drehzahldifferenz Motor - Getriebeeingang" VALUE 0x76AB8 TKW_VV_VV_SW 100.0 FORMULA_0006 0.0 10000.0 /end CHARACTERISTIC
/begin CHARACTERISTIC K_SCHALTER_KS_N_T "Timer Drehzahldifferenz Motor - Getriebeeingang" VALUE 0x76ABA TKW_VV_VV_UW 100.0 FORMULA_0021 0.0 655.0 FORMAT "%5.2" /end CHARACTERISTIC
/begin CHARACTERISTIC K_SCHALTER_KS_SCHALT_T "Timer Schaltung" VALUE 0x76ABC TKW_VV_VV_UW 100.0 FORMULA_0021 0.0 655.0 FORMAT "%5.2" /end CHARACTERISTIC
/begin CHARACTERISTIC K_SCHALTER_KUPP_DIAG_N "Motordrehzahl, um Diagnosetimer zu starten" VALUE 0x76AB0 TKW_VV_VV_SW 100.0 FORMULA_0006 0.0 10000.0 /end CHARACTERISTIC
/begin CHARACTERISTIC K_SCHALTER_KUPP_DIAG_RF "relative Fuellung, um Diagnosetimer zu starten" VALUE 0x76AAE TKW_VV_VV_SW 100.0 FORMULA_0007 0.0 2.0 FORMAT "%6.3" /end CHARACTERISTIC
/begin CHARACTERISTIC K_SCHALTER_KUPP_DIAG_T "Timergrenze, um Diagnose zu beenden" VALUE 0x76AB2 TKW_VV_VV_UW 100.0 FORMULA_0071 0.0 6553.5 FORMAT "%4.1" /end CHARACTERISTIC
/begin CHARACTERISTIC K_SCHALTER_KUPP_DIAG_V_MAX "Geschwindigkeit, um Diagnosetimer zu starten" VALUE 0x76AAC TKW_VV_VV_SW 100.0 FORMULA_0076 -80.0 360.0 FORMAT "%4.1" /end CHARACTERISTIC
/begin CHARACTERISTIC K_SCHALTER_KUPP_DIAG_V_MIN "Geschwindigkeit, um Diagnose scharf zu schalten" VALUE 0x76AAA TKW_VV_VV_SW 100.0 FORMULA_0076 -80.0 360.0 FORMAT "%4.1" /end CHARACTERISTIC
/begin CHARACTERISTIC K_SCHALTER_KUPP_GESCHL "Schaltschwelle Kupplung geschlossen" VALUE 0x76AA6 TKW_VV_VV_SW 100.0 FORMULA_0114 0.0 1023.0 /end CHARACTERISTIC
/begin CHARACTERISTIC K_SCHALTER_KUPP_OFFEN "Schaltschwelle Kupplung offen" VALUE 0x76AA8 TKW_VV_VV_SW 100.0 FORMULA_0114 0.0 1023.0 /end CHARACTERISTIC
/begin CHARACTERISTIC K_SCHALTER_POEL_N_DELAY "Delay fuer n == 0 bei S_POEL-Diagnose" VALUE 0x76A8C TKW_VV_VV_UW 100.0 FORMULA_0668 0.0 6553500.0 /end CHARACTERISTIC
/begin CHARACTERISTIC K_SCHALTER_POEL_N_DIAG "Oeldruck Drehzahlschwelle" VALUE 0x76A86 TKW_VV_VV_SW 100.0 FORMULA_0006 0.0 10000.0 /end CHARACTERISTIC
/begin CHARACTERISTIC K_SCHALTER_POEL_START_ENDE "Oeldruck-Aufbauzeit" VALUE 0x76A84 TKW_VV_VV_UW 100.0 FORMULA_0021 0.0 655.0 FORMAT "%5.2" /end CHARACTERISTIC
/begin CHARACTERISTIC K_SCHALTER_POEL_T_DIAG "Oeldruck-Sperre" VALUE 0x76A88 TKW_VV_VV_UW 100.0 FORMULA_0021 0.0 655.0 FORMAT "%5.2" /end CHARACTERISTIC
/begin CHARACTERISTIC K_SCHALTER_POEL_TOEL "Schwelle Oeltemperatur im Nachlauf" VALUE 0x76A8A TKW_VV_VV_SW 100.0 FORMULA_0023 -50.0 170.0 FORMAT "%4.1" /end CHARACTERISTIC
/begin CHARACTERISTIC K_SK_CFG "SK-Cfg" VALUE 0x76AD8 TKW_VV_VV_UB 100.0 FORMULA_0368 0.0 255.0 /end CHARACTERISTIC
/begin CHARACTERISTIC K_SK_CRC32 "CRC32-Aktivierung" VALUE 0x76AE6 TKW_VV_VV_UB 100.0 FORMULA_0370 0.0 255.0 /end CHARACTERISTIC
/begin CHARACTERISTIC K_SK_E2_KOMP_ERR_MAX "max. Fehler fuer Komplementvergleich" VALUE 0x76C06 TKW_VV_VV_UB 100.0 FORMULA_0003 0.0 255.0 /end CHARACTERISTIC
/begin CHARACTERISTIC K_SK_EGAS_OFF "DK2 DK1 LLS2 LLS1" VAL_BLK 0x76AF8 TKW_VV_VV_UB 100.0 FORMULA_0003 0.0 255.0 NUMBER 16 /end CHARACTERISTIC
/begin CHARACTERISTIC K_SK_EGAS_OFF_TIME "Zeit bis Egasabschaltung" VALUE 0x76AF2 TKW_VV_VV_UW 100.0 FORMULA_0021 0.0 5.0 FORMAT "%5.2" /end CHARACTERISTIC
/begin CHARACTERISTIC K_SK_FGR_SPERRE "FGR-Sperre" VALUE 0x76AEB TKW_VV_VV_UB 100.0 FORMULA_0003 0.0 255.0 /end CHARACTERISTIC
/begin CHARACTERISTIC K_SK_FM_EGAS_TEST "SK Egastestmaske" VALUE 0x76ADB TKW_VV_VV_UB 100.0 FORMULA_0003 0.0 255.0 /end CHARACTERISTIC
/begin CHARACTERISTIC K_SK_FM_FAIL_ZYL_TEST "SK TI-Testmaske (1=Aus)" VALUE 0x76ADE TKW_VV_VV_UW 100.0 FORMULA_0010 0.0 65535.0 /end CHARACTERISTIC
/begin CHARACTERISTIC K_SK_FM_GEMISCH_TEST "SK Gemischtestmaske" VALUE 0x76ADA TKW_VV_VV_UB 100.0 FORMULA_0003 0.0 255.0 /end CHARACTERISTIC
/begin CHARACTERISTIC K_SK_FM_LAM_TEST "SK LAM-Testmaske" VALUE 0x76AE2 TKW_VV_VV_UB 100.0 FORMULA_0003 0.0 255.0 /end CHARACTERISTIC
/begin CHARACTERISTIC K_SK_FM_MD_TEST "SK Md-Testmaske" VALUE 0x76AE1 TKW_VV_VV_UB 100.0 FORMULA_0003 0.0 255.0 /end CHARACTERISTIC
/begin CHARACTERISTIC K_SK_FM_MVAC_TEST "SK MVAC-Testmaske" VALUE 0x76AE3 TKW_VV_VV_UB 100.0 FORMULA_0369 0.0 255.0 /end CHARACTERISTIC
/begin CHARACTERISTIC K_SK_FM_SMG_TEST "SK SMG-Testmaske" VALUE 0x76AE0 TKW_VV_VV_UB 100.0 FORMULA_0003 0.0 255.0 /end CHARACTERISTIC
/begin CHARACTERISTIC K_SK_FRA_SPERRE "FRA-Sperre" VALUE 0x76AE9 TKW_VV_VV_UB 100.0 FORMULA_0003 0.0 255.0 /end CHARACTERISTIC
/begin CHARACTERISTIC K_SK_HW_AD_DELTA_MAX "Maximal zulaessige Differenz Master-Slave" VALUE 0x76C82 TKW_VV_VV_UB 100.0 FORMULA_1086 0.0 255.0 /end CHARACTERISTIC
/begin CHARACTERISTIC K_SK_HW_AD_ED_ZAEHLER "Filterzaehler bei fehlerhaftem AD-Wert" VALUE 0x76C85 TKW_VV_VV_UB 100.0 FORMULA_0357 0.0 1.274999976158142 /end CHARACTERISTIC
/begin CHARACTERISTIC K_SK_HW_AD_STAT "Maximaler Spannungshub fuer Stationaerbetrieb PWG1" VALUE 0x76C83 TKW_VV_VV_UB 100.0 FORMULA_1086 0.0 255.0 /end CHARACTERISTIC
/begin CHARACTERISTIC K_SK_HW_AD_STAT_ZAEHLER "Zaehler fuer Stationaerbetrieb PWG1" VALUE 0x76C84 TKW_VV_VV_UB 100.0 FORMULA_0357 0.0 1.274999976158142 /end CHARACTERISTIC
/begin CHARACTERISTIC K_SK_KH_SPERRE "KH-Sperre" VALUE 0x76AEA TKW_VV_VV_UB 100.0 FORMULA_0003 0.0 255.0 /end CHARACTERISTIC
/begin CHARACTERISTIC K_SK_LAM_EINGR "Gemisch Boff Zoff DK LLS" VAL_BLK 0x76BD8 TKW_VV_VV_UB 100.0 FORMULA_0372 0.0 255.0 NUMBER 32 /end CHARACTERISTIC
/begin CHARACTERISTIC K_SK_LAM_EINGR_TI "LA-Eingriff bei Teilfeuerung" VALUE 0x76AEF TKW_VV_VV_UB 100.0 FORMULA_0371 0.0 255.0 /end CHARACTERISTIC
/begin CHARACTERISTIC K_SK_LLRA_SPERRE "LLRA-Sperre" VALUE 0x76AE8 TKW_VV_VV_UB 100.0 FORMULA_0003 0.0 255.0 /end CHARACTERISTIC
/begin CHARACTERISTIC K_SK_MAX_OS_ERR "erlaubte OS-Fehler bis zum Reset" VALUE 0x76AE4 TKW_VV_VV_UB 100.0 FORMULA_0003 0.0 255.0 /end CHARACTERISTIC
/begin CHARACTERISTIC K_SK_MAX_RESETS "max. Anzahl von Resets pro SG-Lauf" VALUE 0x76AD9 TKW_VV_VV_UB 100.0 FORMULA_0003 0.0 255.0 /end CHARACTERISTIC
/begin CHARACTERISTIC K_SK_MAX_RESETS_E2 "max. Anzahl von Resets pro SG-Lauf Ebene 2" VALUE 0x76C07 TKW_VV_VV_UB 100.0 FORMULA_0003 0.0 255.0 /end CHARACTERISTIC
/begin CHARACTERISTIC K_SK_MD_BEGR_DK_OFFEN "Begrenzung bei offenen Klappen" VALUE 0x76AEE TKW_VV_VV_UB 100.0 FORMULA_0003 0.0 255.0 /end CHARACTERISTIC
/begin CHARACTERISTIC K_SK_MD_BEGR_EGAS "WDK2 WDK1 DK2 DK1 LLS2 LLS1" VAL_BLK 0x76B08 TKW_VV_VV_UB 100.0 FORMULA_0003 0.0 255.0 NUMBER 64 /end CHARACTERISTIC
/begin CHARACTERISTIC K_SK_MD_BEGR_GEMISCH "VAN KATS FPLAU LAVK PKS" VAL_BLK 0x76BB8 TKW_VV_VV_UB 100.0 FORMULA_0003 0.0 255.0 NUMBER 32 /end CHARACTERISTIC
/begin CHARACTERISTIC K_SK_MD_BEGR_MD "SollIst Mdmin EtaRf LLR" VAL_BLK 0x76BA8 TKW_VV_VV_UB 100.0 FORMULA_0003 0.0 255.0 NUMBER 16 /end CHARACTERISTIC
/begin CHARACTERISTIC K_SK_MD_BEGR_MVAC "ELUP MVAC" VAL_BLK 0x76BFE TKW_VV_VV_UB 100.0 FORMULA_0003 0.0 255.0 NUMBER 4 /end CHARACTERISTIC
/begin CHARACTERISTIC K_SK_MD_BEGR_MVAC_SYS "Begrenzung bei MVAC-Systemfehler" VALUE 0x76AF6 TKW_VV_VV_UB 100.0 FORMULA_0003 0.0 255.0 /end CHARACTERISTIC
/begin CHARACTERISTIC K_SK_MD_BEGR_PWG "pwg_mode" VAL_BLK 0x76BF8 TKW_VV_VV_UB 100.0 FORMULA_0003 0.0 255.0 NUMBER 6 /end CHARACTERISTIC
/begin CHARACTERISTIC K_SK_MD_BEGR_RESET "Begrenzung ab dem 1.Reset" VALUE 0x76AF7 TKW_VV_VV_UB 100.0 FORMULA_0003 0.0 255.0 /end CHARACTERISTIC
/begin CHARACTERISTIC K_SK_MD_BEGR_SMG "CANErr CANSk STAT SABR" VAL_BLK 0x76B98 TKW_VV_VV_UB 100.0 FORMULA_0003 0.0 255.0 NUMBER 16 /end CHARACTERISTIC
/begin CHARACTERISTIC K_SK_MD_BEGR_TI "B2 B1 Z2 Z1" VAL_BLK 0x76B48 TKW_VV_VV_UB 100.0 FORMULA_0003 0.0 255.0 NUMBER 16 /end CHARACTERISTIC
/begin CHARACTERISTIC K_SK_MD_TI_EINGR "Freigabe Teilfeuern" VALUE 0x76AEC TKW_VV_VV_UB 100.0 FORMULA_0003 0.0 255.0 /end CHARACTERISTIC
/begin CHARACTERISTIC K_SK_MD_VL_SPERRE "VL-Sperre" VALUE 0x76AED TKW_VV_VV_UB 100.0 FORMULA_0003 0.0 255.0 /end CHARACTERISTIC
/begin CHARACTERISTIC K_SK_MVAC_KH "ELUP MVAC" VAL_BLK 0x76C02 TKW_VV_VV_UB 100.0 FORMULA_0373 0.0 255.0 NUMBER 4 /end CHARACTERISTIC
/begin CHARACTERISTIC K_SK_PKS_NOTLAUF "PKS-Aktivierung" VALUE 0x76AE7 TKW_VV_VV_UB 100.0 FORMULA_0003 0.0 255.0 /end CHARACTERISTIC
/begin CHARACTERISTIC K_SK_PROZ_ERR "Maske Prozessueberwachung" VALUE 0x76AF4 TKW_VV_VV_UW 100.0 FORMULA_0010 0.0 65535.0 /end CHARACTERISTIC
/begin CHARACTERISTIC K_SK_T_RESET_DELAY_OS "Resetdelay fuer Betriebssystem Fehler" VALUE 0x76AF0 TKW_VV_VV_UB 100.0 FORMULA_0306 0.0 2.0 /end CHARACTERISTIC
/begin CHARACTERISTIC K_SK_TASK_ERR "Maske Taskueberwachung" VALUE 0x76AE5 TKW_VV_VV_UB 100.0 FORMULA_0003 0.0 255.0 /end CHARACTERISTIC
/begin CHARACTERISTIC K_SK_TI_OFF_EGAS "TI2 TI1 DK2 DK1 LLS2 LLS1" VAL_BLK 0x76B58 TKW_VV_VV_UB 100.0 FORMULA_0003 0.0 255.0 NUMBER 64 /end CHARACTERISTIC
/begin CHARACTERISTIC K_SK_ZYL_OFF_MAX "Anzahl der abg. Zyl. pro Bank" VALUE 0x76ADC TKW_VV_VV_UB 100.0 FORMULA_0003 0.0 255.0 /end CHARACTERISTIC
/begin CHARACTERISTIC K_SL_HFM_CFG "Umschaltung Istwert SL-Reg." VALUE 0x76C88 TKW_VV_VV_UB 100.0 FORMULA_1087 0.0 255.0 /end CHARACTERISTIC
/begin CHARACTERISTIC K_SL_HFM_TAU "Filterkonstante Rohwert" VALUE 0x76C86 TKW_VV_VV_UB 100.0 FORMULA_0645 5.100000184029341e-003 1.279999971389771 /end CHARACTERISTIC
/begin CHARACTERISTIC K_SL_I_MAX "I-Anteil Max SL Mengenregelung" VALUE 0x76C8C TKW_VV_VV_SW 100.0 FORMULA_0199 -2.0 1.999899983406067 FORMAT "%7.4" /end CHARACTERISTIC
/begin CHARACTERISTIC K_SL_I_MIN "I-Anteil Min SL Mengenregelung" VALUE 0x76C8E TKW_VV_VV_SW 100.0 FORMULA_0199 -2.0 1.999899983406067 FORMAT "%7.4" /end CHARACTERISTIC
/begin CHARACTERISTIC K_SL_LAM_ABG_TAU "Filterkonstante Rohwert Abgaslambda B1" VALUE 0x76C87 TKW_VV_VV_UB 100.0 FORMULA_0645 5.100000184029341e-003 1.279999971389771 /end CHARACTERISTIC
/begin CHARACTERISTIC K_SL_LAM_MAX_FAK "Motorlambda B2 Korr-Fak. MAX-Wert" VALUE 0x76C98 TKW_VV_VV_SW 100.0 FORMULA_0073 0.0 1.5 FORMAT "%6.3" /end CHARACTERISTIC
/begin CHARACTERISTIC K_SL_LAM_MIN_FAK "Motorlambda B2 Korr-Fak. MIN-Wert" VALUE 0x76C96 TKW_VV_VV_SW 100.0 FORMULA_0073 0.5 1.0 FORMAT "%6.3" /end CHARACTERISTIC
/begin CHARACTERISTIC K_SL_LLS_CFG "Konfig fuer LLS(ZWD)" VALUE 0x76C9A TKW_VV_VV_UB 100.0 FORMULA_1088 0.0 255.0 /end CHARACTERISTIC
/begin CHARACTERISTIC K_SL_ML_HFM_DIAG_MAX "Diagnoseschelle Max" VALUE 0x76C90 TKW_VV_VV_SW 100.0 FORMULA_0103 -100.0 1400.0 FORMAT "%4.1" /end CHARACTERISTIC
/begin CHARACTERISTIC K_SL_ML_HFM_DIAG_MIN "Diagnoseschelle Min" VALUE 0x76C92 TKW_VV_VV_SW 100.0 FORMULA_0103 -100.0 1400.0 FORMAT "%4.1" /end CHARACTERISTIC
/begin CHARACTERISTIC K_SL_ML_HFM_ERSATZ "Ersatzwert im Fehlerfall" VALUE 0x76C94 TKW_VV_VV_SW 100.0 FORMULA_0103 -100.0 1400.0 FORMAT "%4.1" /end CHARACTERISTIC
/begin CHARACTERISTIC K_SL_TKAT_ANSPR "Anspringtemp. Kat fuer NOx-Konv." VALUE 0x76C8A TKW_VV_VV_SW 100.0 FORMULA_0023 -1000.0 1000.0 FORMAT "%4.1" /end CHARACTERISTIC
/begin CHARACTERISTIC K_SLP_PABG_SCHWELLE "Abbruchschwelle durch Abgasgegendruck" VALUE 0x76E6A TKW_VV_VV_SW 100.0 FORMULA_0075 0.0 1000.0 FORMAT "%4.1" /end CHARACTERISTIC
/begin CHARACTERISTIC K_SLP_PABG_TAU "Filterkonstante fuer den Abgasdruck" VALUE 0x76E6C TKW_VV_VV_UB 100.0 FORMULA_0679 0.1004000008106232 25.60000038146973 /end CHARACTERISTIC
/begin CHARACTERISTIC K_SLP_TIME_AUS "Auszeit SLP nach Abschalten" VALUE 0x76E68 TKW_VV_VV_UW 100.0 FORMULA_0593 0.0 65535.0 /end CHARACTERISTIC
/begin CHARACTERISTIC K_SLP_TIME_MAX "Maxlaufzeit der SLP" VALUE 0x76E6E TKW_VV_VV_UW 100.0 FORMULA_0071 0.0 6553.5 FORMAT "%4.1" /end CHARACTERISTIC
/begin CHARACTERISTIC K_SLS_OBD_CFG "SLS-OBD Konfigbyte" VALUE 0x76EFE TKW_VV_VV_UB 100.0 FORMULA_1116 0.0 255.0 /end CHARACTERISTIC
/begin CHARACTERISTIC K_SLS_OBD_DYN_TAU "Filterkonstante fuer sls_obd_ml_dyn" VALUE 0x76F0A TKW_VV_VV_UB 100.0 FORMULA_0658 1.009999960660934e-002 2.559999942779541 /end CHARACTERISTIC
/begin CHARACTERISTIC K_SLS_OBD_ML_MDL_DIFF_MAX "Saturation Gradient Luftmasse Motor" VALUE 0x76F0C TKW_VV_VV_SW 100.0 FORMULA_1113 -100.0 100.0 FORMAT "%4.1" /end CHARACTERISTIC
/begin CHARACTERISTIC K_SLS_OBD_ML_MDL_WICHT "Wichtungsfaktor fuer Dynamik" VALUE 0x76F0E TKW_VV_VV_UW 100.0 FORMULA_0073 0.0 4.0 FORMAT "%6.3" /end CHARACTERISTIC
/begin CHARACTERISTIC K_SLS_OBD_TMOT_MIN "Min. Temp. fuer die Diagnose" VALUE 0x76F1E TKW_VV_VV_SW 100.0 FORMULA_0023 -50.0 170.0 FORMAT "%4.1" /end CHARACTERISTIC
/begin CHARACTERISTIC K_SLS_OBDH_ASV_LI_OPE "Max. Abweichungsintg.-grenze ASV-Diag links haengt offen" VALUE 0x76F16 TKW_VV_VV_SW 100.0 FORMULA_0570 -1.899999976158142 1.899999976158142 FORMAT "%5.2" /end CHARACTERISTIC
/begin CHARACTERISTIC K_SLS_OBDH_ASV_PL_LI_OPE "Max. Abweichungsintg.-grenze ASV-Diag links haengt offen im PL" VALUE 0x76F18 TKW_VV_VV_SW 100.0 FORMULA_0570 -1.899999976158142 1.899999976158142 FORMAT "%5.2" /end CHARACTERISTIC
/begin CHARACTERISTIC K_SLS_OBDH_ASV_PL_RE_OPE "Max. Abweichungsintg.-grenze ASV-Diag rechts haengt offen im PL" VALUE 0x76F12 TKW_VV_VV_SW 100.0 FORMULA_0570 -1.899999976158142 1.899999976158142 FORMAT "%5.2" /end CHARACTERISTIC
/begin CHARACTERISTIC K_SLS_OBDH_ASV_RE_OPE "Max. Abweichungsintg.-grenze ASV-Diag rechts haengt offen" VALUE 0x76F10 TKW_VV_VV_SW 100.0 FORMULA_0570 -1.899999976158142 1.899999976158142 FORMAT "%5.2" /end CHARACTERISTIC
/begin CHARACTERISTIC K_SLS_OBDH_ASV_TAU "Filterkonstante fuer lam_ist und ml_ges der ASV Diag." VALUE 0x76F32 TKW_VV_VV_UB 100.0 FORMULA_0679 0.1004000008106232 25.60000038146973 /end CHARACTERISTIC
/begin CHARACTERISTIC K_SLS_OBDH_DYN_DELTA_RF "Dynamikschwelle RF" VALUE 0x76F06 TKW_VV_VV_SW 100.0 FORMULA_0007 0.0 2.0 FORMAT "%6.3" /end CHARACTERISTIC
/begin CHARACTERISTIC K_SLS_OBDH_DYN_RF_T "Zeit nach Dyn.abbr. durch rf, bevor die Diag weiterlaeuft" VALUE 0x76F08 TKW_VV_VV_UW 100.0 FORMULA_0021 0.0 655.0 FORMAT "%5.2" /end CHARACTERISTIC
/begin CHARACTERISTIC K_SLS_OBDH_EUV_MIN_DEF "Ml-Integralgrenze fuer Erkennung SLV klemmt geschl. Leitung undicht" VALUE 0x76EEE TKW_VV_VV_SW 100.0 FORMULA_1115 -32.76699829101563 32.76699829101563 FORMAT "%6.3" /end CHARACTERISTIC
/begin CHARACTERISTIC K_SLS_OBDH_HFM_MAX "max. Luftmassenintegral fuer plausibles SLS" VALUE 0x76F3C TKW_VV_VV_SW 100.0 FORMULA_1092 -260.0 260.0 FORMAT "%4.1" /end CHARACTERISTIC
/begin CHARACTERISTIC K_SLS_OBDH_HFM_TAU "Tau fuer sl_ml_hfm_fil" VALUE 0x76F34 TKW_VV_VV_UB 100.0 FORMULA_0658 1.009999960660934e-002 2.559999942779541 /end CHARACTERISTIC
/begin CHARACTERISTIC K_SLS_OBDH_HYD_ABBRUCH_AD_MAX "max-AD-Wert fuer Feuchtigkeitsabbruch" VALUE 0x76F3A TKW_VV_VV_SW 100.0 FORMULA_0114 0.0 1023.0 /end CHARACTERISTIC
/begin CHARACTERISTIC K_SLS_OBDH_HYD_ABBRUCH_ML_MAX "ML-Schwelle fuer Feuchtigkeitserkennung Mini-HFM" VALUE 0x76F38 TKW_VV_VV_SW 100.0 FORMULA_1119 -260.0 260.0 FORMAT "%6.3" /end CHARACTERISTIC
/begin CHARACTERISTIC K_SLS_OBDH_MDF_1_MAG "Max. Abweichungsintg.-grenze MDF-Diag B1 magerer als B2" VALUE 0x76F00 TKW_VV_VV_SW 100.0 FORMULA_0570 -1.899999976158142 1.899999976158142 FORMAT "%5.2" /end CHARACTERISTIC
/begin CHARACTERISTIC K_SLS_OBDH_MDF_2_MAG "Max. Abweichungsintg.-grenze MDF-Diag B1 magerer als B2" VALUE 0x76F02 TKW_VV_VV_SW 100.0 FORMULA_0570 -1.899999976158142 1.899999976158142 FORMAT "%5.2" /end CHARACTERISTIC
/begin CHARACTERISTIC K_SLS_OBDH_MDF_CFG "SLS-OBD MDF Konfigbyte" VALUE 0x76EFF TKW_VV_VV_UB 100.0 FORMULA_1117 0.0 255.0 /end CHARACTERISTIC
/begin CHARACTERISTIC K_SLS_OBDH_MDF_MAX_DEF "Max. Abw.Integralgrenze LTG-undicht" VALUE 0x76EF0 TKW_VV_VV_SW 100.0 FORMULA_1115 -32.76699829101563 32.76699829101563 FORMAT "%6.3" /end CHARACTERISTIC
/begin CHARACTERISTIC K_SLS_OBDH_MDF_MIN_DEF "Max. Abw.Integralgrenze MDF zu gering" VALUE 0x76EF2 TKW_VV_VV_SW 100.0 FORMULA_1115 -32.76699829101563 32.76699829101563 FORMAT "%6.3" /end CHARACTERISTIC
/begin CHARACTERISTIC K_SLS_OBDH_MDL_K_EINBAUTEN "Max. Abweichungsintg.-grenze MDF-Diag B1 magerer als B2" VALUE 0x76F04 TKW_VV_VV_UW 100.0 FORMULA_1118 0.0 1.0 FORMAT "%7.4" /end CHARACTERISTIC
/begin CHARACTERISTIC K_SLS_OBDH_ML_MAX "Abbruchlastschwelle bei ml_ges ueber Schelle" VALUE 0x76F2A TKW_VV_VV_SW 100.0 FORMULA_0103 -100.0 1400.0 FORMAT "%4.1" /end CHARACTERISTIC
/begin CHARACTERISTIC K_SLS_OBDH_ML_MIN "Abbruchlastschwelle bei ml_ges unter Schelle" VALUE 0x76F28 TKW_VV_VV_SW 100.0 FORMULA_0103 -100.0 1400.0 FORMAT "%4.1" /end CHARACTERISTIC
/begin CHARACTERISTIC K_SLS_OBDH_ML_TAU "Filterkonstante fuer lam_ist und ml_ges der ML Diag." VALUE 0x76F33 TKW_VV_VV_UB 100.0 FORMULA_0679 0.1004000008106232 25.60000038146973 /end CHARACTERISTIC
/begin CHARACTERISTIC K_SLS_OBDH_ML_TMOT "Schwelle ML-Plausi fuer ASV kleben zu" VALUE 0x76F36 TKW_VV_VV_SW 100.0 FORMULA_0023 -50.0 170.0 FORMAT "%4.1" /end CHARACTERISTIC
/begin CHARACTERISTIC K_SLS_OBDH_MLVERH_MIN "Abbruchlastschwelle bei ml_verh unter Schelle" VALUE 0x76F2C TKW_VV_VV_UB 100.0 FORMULA_0032 0.0 200.0 /end CHARACTERISTIC
/begin CHARACTERISTIC K_SLS_OBDH_N_MAX "Abbruchdrezahl n groesser Schwelle" VALUE 0x76F22 TKW_VV_VV_SW 100.0 FORMULA_0006 0.0 10000.0 /end CHARACTERISTIC
/begin CHARACTERISTIC K_SLS_OBDH_N_MIN "Abbruchdrezahl n kleiner Schwelle" VALUE 0x76F20 TKW_VV_VV_SW 100.0 FORMULA_0006 0.0 10000.0 /end CHARACTERISTIC
/begin CHARACTERISTIC K_SLS_OBDH_PUMG_MIN "Abbruchlastschwelle bei ml_verh unter Schelle" VALUE 0x76F2E TKW_VV_VV_SW 100.0 FORMULA_0075 400.0 1200.0 FORMAT "%4.1" /end CHARACTERISTIC
/begin CHARACTERISTIC K_SLS_OBDH_RF_MAX "Abbruchlastschwelle bei rf ueber Schelle" VALUE 0x76F26 TKW_VV_VV_SW 100.0 FORMULA_0007 0.0 2.0 FORMAT "%6.3" /end CHARACTERISTIC
/begin CHARACTERISTIC K_SLS_OBDH_RF_MIN "Abbruchlastschwelle bei rf unter Schelle" VALUE 0x76F24 TKW_VV_VV_SW 100.0 FORMULA_0007 0.0 2.0 FORMAT "%6.3" /end CHARACTERISTIC
/begin CHARACTERISTIC K_SLS_OBDH_SLP_DEF "Luftmassenintegralgrenze fuer Erkennung SLP defekt" VALUE 0x76EEC TKW_VV_VV_SW 100.0 FORMULA_1115 -32.76699829101563 32.76699829101563 FORMAT "%6.3" /end CHARACTERISTIC
/begin CHARACTERISTIC K_SLS_OBDH_SLV_MAX "Max. ML-Integralgrenze fuer SLV NIO" VALUE 0x76EFC TKW_VV_VV_SW 100.0 FORMULA_1115 -32.76699829101563 32.76699829101563 FORMAT "%6.3" /end CHARACTERISTIC
/begin CHARACTERISTIC K_SLS_OBDH_START_MIN "Mindestluftmassenintegral fuer plausibles SLS" VALUE 0x76EEA TKW_VV_VV_SW 100.0 FORMULA_0563 -32.76699829101563 32.76699829101563 FORMAT "%6.3" /end CHARACTERISTIC
/begin CHARACTERISTIC K_SLS_OBDH_T_AUFHEIZ "Aufheizverzoegerung fuer Mini-HFM" VALUE 0x76EE4 TKW_VV_VV_UB 100.0 FORMULA_0306 0.0 2.5 /end CHARACTERISTIC
/begin CHARACTERISTIC K_SLS_OBDH_T_HFM_DIA "Diagnosezeit fuer Mini-HFM" VALUE 0x76EE6 TKW_VV_VV_UW 100.0 FORMULA_0021 0.0 100.0 FORMAT "%5.2" /end CHARACTERISTIC
/begin CHARACTERISTIC K_SLS_OBDH_T_ML_PLAUSI "Max. Diagnosezeit fuer Luftmassenplausi" VALUE 0x76EE8 TKW_VV_VV_UW 100.0 FORMULA_0021 0.0 100.0 FORMAT "%5.2" /end CHARACTERISTIC
/begin CHARACTERISTIC K_SLS_OBDH_T_SA "Diagnoseabbruch nach time_sa" VALUE 0x76F30 TKW_VV_VV_UW 100.0 FORMULA_0021 0.0 655.0 FORMAT "%5.2" /end CHARACTERISTIC
/begin CHARACTERISTIC K_SLS_OBDH_T_SLV_INT_START "Delay fuer start Diagnose SLV" VALUE 0x76F1A TKW_VV_VV_UW 100.0 FORMULA_0021 0.0 10.0 FORMAT "%5.2" /end CHARACTERISTIC
/begin CHARACTERISTIC K_SLS_OBDH_UB_MIN "UB min. Schwelle fuer die SLS-Diagnose" VALUE 0x76F14 TKW_VV_VV_SW 100.0 FORMULA_0008 0.0 28.0 FORMAT "%4.1" /end CHARACTERISTIC
/begin CHARACTERISTIC K_SLS_OBDH_ZWD_0_MAX "Max. ML-Grenze fuer ZWD 0 Proz. offen" VALUE 0x76EF6 TKW_VV_VV_SW 100.0 FORMULA_0103 0.0 40.0 FORMAT "%4.1" /end CHARACTERISTIC
/begin CHARACTERISTIC K_SLS_OBDH_ZWD_100_MIN "Min. ML-Grenze fuer ZWD 100 Proz. offen" VALUE 0x76EF4 TKW_VV_VV_SW 100.0 FORMULA_0103 0.0 40.0 FORMAT "%4.1" /end CHARACTERISTIC
/begin CHARACTERISTIC K_SLS_OBDH_ZWD_OFF_MAX "Max. ML-Grenze fuer ZWD stromlos" VALUE 0x76EF8 TKW_VV_VV_SW 100.0 FORMULA_0103 0.0 40.0 FORMAT "%4.1" /end CHARACTERISTIC
/begin CHARACTERISTIC K_SLS_OBDH_ZWD_OFF_MIN "Min. ML-Grenze fuer ZWD stromlos" VALUE 0x76EFA TKW_VV_VV_SW 100.0 FORMULA_0103 0.0 40.0 FORMAT "%4.1" /end CHARACTERISTIC
/begin CHARACTERISTIC K_SLS_PL_T_MDF_STOP "MDF Diagnoseende fuer Prueflauf" VALUE 0x76F1C TKW_VV_VV_UW 100.0 FORMULA_0021 0.0 100.0 FORMAT "%5.2" /end CHARACTERISTIC
/begin CHARACTERISTIC K_TE_A_MIN "min. Querschnittsflaeche TEV" VALUE 0x771C4 TKW_VV_VV_UW 100.0 FORMULA_1153 0.0 65.53500366210938 FORMAT "%6.3" /end CHARACTERISTIC
/begin CHARACTERISTIC K_TE_ANZUGSZEIT_OFFS_B1 "Offset Ventil Anzugszeit" VALUE 0x771C6 TKW_VV_VV_UW 100.0 FORMULA_0985 0.0 655.3499755859375 FORMAT "%5.2" /end CHARACTERISTIC
/begin CHARACTERISTIC K_TE_ANZUGSZEIT_OFFS_B2 "Offset Ventil Anzugszeit" VALUE 0x771C8 TKW_VV_VV_UW 100.0 FORMULA_0985 0.0 655.3499755859375 FORMAT "%5.2" /end CHARACTERISTIC
/begin CHARACTERISTIC K_TE_B_ABBR_FST_SUM "B_TE_ABBR nur, wenn fst_sum groesser" VALUE 0x771CA TKW_VV_VV_UW 100.0 FORMULA_0610 0.0 32767.5 FORMAT "%4.1" /end CHARACTERISTIC
/begin CHARACTERISTIC K_TE_B_ABBR_TUMG "B_TE_ABBR nur, wenn tumg kleiner" VALUE 0x771CC TKW_VV_VV_SW 100.0 FORMULA_0023 -50.0 170.0 FORMAT "%4.1" /end CHARACTERISTIC
/begin CHARACTERISTIC K_TE_B_LANG_C_AKF "B_TE_LANG, wenn c_akf groesser" VALUE 0x771D0 TKW_VV_VV_UW 100.0 FORMULA_0199 0.0 2.0 FORMAT "%7.4" /end CHARACTERISTIC
/begin CHARACTERISTIC K_TE_B_LANG_FST_SUM "B_TE_LANG, wenn fst_sum kleiner" VALUE 0x771D2 TKW_VV_VV_UW 100.0 FORMULA_0610 0.0 32767.5 FORMAT "%4.1" /end CHARACTERISTIC
/begin CHARACTERISTIC K_TE_B_LANG_TUMG "B_TE_LANG, wenn tumg groesser" VALUE 0x771D4 TKW_VV_VV_SW 100.0 FORMULA_0023 -50.0 170.0 FORMAT "%4.1" /end CHARACTERISTIC
/begin CHARACTERISTIC K_TE_B_LANG_VOL_SUM "B_TE_LANG, wenn te_vol_ges kleiner" VALUE 0x771CE TKW_VV_VV_UW 100.0 FORMULA_1154 0.0 14316.3388671875 FORMAT "%4.1" /end CHARACTERISTIC
/begin CHARACTERISTIC K_TE_C_AKF_DYN_DELTA_RF "Dynamikschwelle RF für c_akf-Filter stoppen" VALUE 0x771D8 TKW_VV_VV_SW 100.0 FORMULA_0007 0.0 2.0 FORMAT "%6.3" /end CHARACTERISTIC
/begin CHARACTERISTIC K_TE_C_AKF_MIN "Abbruch Spuelen, wenn c_akf kleiner" VALUE 0x771D6 TKW_VV_VV_UW 100.0 FORMULA_0199 0.0 2.0 FORMAT "%7.4" /end CHARACTERISTIC
/begin CHARACTERISTIC K_TE_C_AKF_RESET "RESET C-AKF-Zustandsautomat" VALUE 0x771DA TKW_VV_VV_UB 100.0 FORMULA_0831 0.0 1.0 /end CHARACTERISTIC
/begin CHARACTERISTIC K_TE_C_APPL "RESET C-AKF-Konzentration" VALUE 0x771DC TKW_VV_VV_UW 100.0 FORMULA_0199 0.0 3.999900102615356 FORMAT "%7.4" /end CHARACTERISTIC
/begin CHARACTERISTIC K_TE_C_LERN_RED_TAU "Filterkonstante c_akf reduziertes Lernen" VALUE 0x771DE TKW_VV_VV_UW 100.0 FORMULA_1052 0.1000000014901161 6553.5 FORMAT "%5.2" /end CHARACTERISTIC
/begin CHARACTERISTIC K_TE_C_LERN_TAU "Filterkonstante c_akf normal" VALUE 0x771E0 TKW_VV_VV_UW 100.0 FORMULA_1052 0.1000000014901161 6553.5 FORMAT "%5.2" /end CHARACTERISTIC
/begin CHARACTERISTIC K_TE_C_MAX "max. AKF-Konzentration" VALUE 0x771E2 TKW_VV_VV_UW 100.0 FORMULA_0199 0.0 3.999900102615356 FORMAT "%7.4" /end CHARACTERISTIC
/begin CHARACTERISTIC K_TE_C_MIN "min. AKF-Konzentration" VALUE 0x771E4 TKW_VV_VV_UW 100.0 FORMULA_0199 0.0 2.0 FORMAT "%7.4" /end CHARACTERISTIC
/begin CHARACTERISTIC K_TE_C_ML_SOLL_MG_MIN "min. te_ml_soll_mg fuer C_AKF-Uebernahme" VALUE 0x771EA TKW_VV_VV_UW 100.0 FORMULA_0111 0.0 1023.984313964844 FORMAT "%5.2" /end CHARACTERISTIC
/begin CHARACTERISTIC K_TE_C_STAT_DELTA "max. C-Abweichung f. eingependelte Adapt." VALUE 0x771EC TKW_VV_VV_UW 100.0 FORMULA_0199 0.0 2.0 FORMAT "%7.4" /end CHARACTERISTIC
/begin CHARACTERISTIC K_TE_C_STAT_T "min. Zeit f. eingependelte Adapt." VALUE 0x771EE TKW_VV_VV_UW 100.0 FORMULA_0021 0.0 655.0 FORMAT "%5.2" /end CHARACTERISTIC
/begin CHARACTERISTIC K_TE_C_T_SPUEL_MAX "max. SPUEL-Zeit f. K_TE_C_LERN_TAU" VALUE 0x771E8 TKW_VV_VV_UW 100.0 FORMULA_0071 0.0 6553.5 FORMAT "%4.1" /end CHARACTERISTIC
/begin CHARACTERISTIC K_TE_C_T_SPUEL_MIN "min. SPUEL-Zeit f. K_TE_C_LERN_TAU" VALUE 0x771E6 TKW_VV_VV_UW 100.0 FORMULA_0071 0.0 6553.5 FORMAT "%4.1" /end CHARACTERISTIC
/begin CHARACTERISTIC K_TE_C_X_MIN "min. Spuelluftanteil - zu Uebergang LERNEN" VALUE 0x771F0 TKW_VV_VV_UW 100.0 FORMULA_0024 0.0 1.999899983406067 FORMAT "%7.4" /end CHARACTERISTIC
/begin CHARACTERISTIC K_TE_CFG "Freigabe TE" VALUE 0x771F2 TKW_VV_VV_UB 100.0 FORMULA_1155 0.0 1.0 /end CHARACTERISTIC
/begin CHARACTERISTIC K_TE_DR_REL_MAX_SYNC "n-Schwelle f. sychn. Ansteuerfrequenz" VALUE 0x771F4 TKW_VV_VV_SW 100.0 FORMULA_0106 0.0 199.9938049316406 FORMAT "%5.2" /end CHARACTERISTIC
/begin CHARACTERISTIC K_TE_DYN_DELTA_RF "RF-Delta f. Sperre c_akf-Filterung" VALUE 0x771F6 TKW_VV_VV_SW 100.0 FORMULA_0007 0.0 2.0 FORMAT "%6.3" /end CHARACTERISTIC
/begin CHARACTERISTIC K_TE_DYN_RF_T "Sperrzeit c_akf-Filterung nach rf-Dynamik" VALUE 0x771F8 TKW_VV_VV_UW 100.0 FORMULA_0021 0.0 655.0 FORMAT "%5.2" /end CHARACTERISTIC
/begin CHARACTERISTIC K_TE_GW_F_KATD "Verlaeng. Schliessrampe bei Katdiag" VALUE 0x771FA TKW_VV_VV_UB 100.0 FORMULA_0649 0.0 7.968699932098389 /end CHARACTERISTIC
/begin CHARACTERISTIC K_TE_GW_LAA_FETT "LAA_F_TE-Fett-Schwelle f. GW" VALUE 0x771FC TKW_VV_VV_SW 100.0 FORMULA_0024 -1.0 0.9998999834060669 FORMAT "%7.4" /end CHARACTERISTIC
/begin CHARACTERISTIC K_TE_GW_LAA_HYS "LAA_F_TE-Hysterese f. GW" VALUE 0x77200 TKW_VV_VV_SW 100.0 FORMULA_0024 -1.0 0.9998999834060669 FORMAT "%7.4" /end CHARACTERISTIC
/begin CHARACTERISTIC K_TE_GW_LAA_MAGER "LAA_F_TE-Mager-Schwelle f. GW" VALUE 0x771FE TKW_VV_VV_SW 100.0 FORMULA_0024 -1.0 0.9998999834060669 FORMAT "%7.4" /end CHARACTERISTIC
/begin CHARACTERISTIC K_TE_GW_LAM_DELTA_FETT "LAM_Delta_F-Fett-Schwelle f. GW" VALUE 0x77202 TKW_VV_VV_SW 100.0 FORMULA_0025 -2.0 1.999899983406067 FORMAT "%6.3" /end CHARACTERISTIC
/begin CHARACTERISTIC K_TE_GW_LAM_DELTA_HYS "LAM_Delta_F-Hysterese f. GW" VALUE 0x77206 TKW_VV_VV_UW 100.0 FORMULA_0025 0.0 3.999000072479248 FORMAT "%6.3" /end CHARACTERISTIC
/begin CHARACTERISTIC K_TE_GW_LAM_DELTA_MAGER "LAM_Delta-Mager-Schwelle f. GW" VALUE 0x77204 TKW_VV_VV_SW 100.0 FORMULA_0025 -2.0 1.999899983406067 FORMAT "%6.3" /end CHARACTERISTIC
/begin CHARACTERISTIC K_TE_GW_LAM_REG_FETT "LAM-REG-Fett-Schwelle f. GW" VALUE 0x77208 TKW_VV_VV_UW 100.0 FORMULA_0024 0.0 1.998999953269959 FORMAT "%7.4" /end CHARACTERISTIC
/begin CHARACTERISTIC K_TE_GW_LAM_REG_HYS "LAM-REG-Hysterese f. GW" VALUE 0x7720C TKW_VV_VV_UW 100.0 FORMULA_0024 0.0 1.998999953269959 FORMAT "%7.4" /end CHARACTERISTIC
/begin CHARACTERISTIC K_TE_GW_LAM_REG_MAGER "LAM-REG-Mager-Schwelle f. GW" VALUE 0x7720A TKW_VV_VV_UW 100.0 FORMULA_0024 0.0 1.998999953269959 FORMAT "%7.4" /end CHARACTERISTIC
/begin CHARACTERISTIC K_TE_LAA_F_TE_MCS "MCS-Faktor fuer laa_f_te" VALUE 0x7720E TKW_VV_VV_UB 100.0 FORMULA_0831 0.0 1.0 /end CHARACTERISTIC
/begin CHARACTERISTIC K_TE_LAM_SOLL_MAX "max. LA-SOLL-Schwelle f. TE-Freigabe" VALUE 0x77210 TKW_VV_VV_UW 100.0 FORMULA_0025 0.0 3.999000072479248 FORMAT "%6.3" /end CHARACTERISTIC
/begin CHARACTERISTIC K_TE_LAM_SOLL_MIN "min. LA-SOLL-Schwelle f. TE-Freigabe" VALUE 0x77212 TKW_VV_VV_UW 100.0 FORMULA_0025 0.0 3.999000072479248 FORMAT "%6.3" /end CHARACTERISTIC
/begin CHARACTERISTIC K_TE_M_MAX_ML_CFG "TE_M_MAX_ML - Auswahl" VALUE 0x77214 TKW_VV_VV_UB 100.0 FORMULA_1156 0.0 1.0 /end CHARACTERISTIC
/begin CHARACTERISTIC K_TE_MKS_F_AEBG_SCHW_NEG "Schwelle fuer neg. Rampe" VALUE 0x77218 TKW_VV_VV_SW 100.0 FORMULA_0024 0.0 0.9998999834060669 FORMAT "%7.4" /end CHARACTERISTIC
/begin CHARACTERISTIC K_TE_MKS_F_AEBG_SCHW_POS "Schwelle fuer pos. Rampe" VALUE 0x7721A TKW_VV_VV_SW 100.0 FORMULA_0024 -1.0 0.0 FORMAT "%7.4" /end CHARACTERISTIC
/begin CHARACTERISTIC K_TE_MKS_F_MAX "max Wert fuer te_mks_f" VALUE 0x77216 TKW_VV_VV_UW 100.0 FORMULA_0024 0.0 1.999899983406067 FORMAT "%7.4" /end CHARACTERISTIC
/begin CHARACTERISTIC K_TE_MKS_F_NEG "max. Lambda-Aenderung je Sekunde" VALUE 0x7721C TKW_VV_VV_UW 100.0 FORMULA_1157 0.0 100.0 FORMAT "%5.2" /end CHARACTERISTIC
/begin CHARACTERISTIC K_TE_MKS_F_POS "max. Lambda-Aenderung je Sekunde" VALUE 0x7721E TKW_VV_VV_UW 100.0 FORMULA_1157 0.0 100.0 FORMAT "%5.2" /end CHARACTERISTIC
/begin CHARACTERISTIC K_TE_MKS_LAM_WICHT "Wichtungsfaktor auf lam_delta fuer te_mks_f-Berechnung" VALUE 0x77220 TKW_VV_VV_UB 100.0 FORMULA_0638 0.0 1.99210000038147 /end CHARACTERISTIC
/begin CHARACTERISTIC K_TE_MZYL_SEC_F "Wicht-Fakor auf te_ml_soll fuer sec. Einfluss te_ml_ist" VALUE 0x77221 TKW_VV_VV_UB 100.0 FORMULA_0638 0.0 1.99210000038147 /end CHARACTERISTIC
/begin CHARACTERISTIC K_TE_N_DYN_DELTA "N-Delta f. Erkennung N-stat." VALUE 0x77222 TKW_VV_VV_SW 100.0 FORMULA_0006 0.0 10000.0 /end CHARACTERISTIC
/begin CHARACTERISTIC K_TE_N_MAX_SYNC1 "n-Schwelle f. sychn. Ansteuerfrequenz" VALUE 0x77224 TKW_VV_VV_SW 100.0 FORMULA_0006 0.0 10000.0 /end CHARACTERISTIC
/begin CHARACTERISTIC K_TE_OBD_ANZ "max. Anzahl der Durchlaeufe " VALUE 0x7788A TKW_VV_VV_UB 100.0 FORMULA_0003 0.0 255.0 /end CHARACTERISTIC
/begin CHARACTERISTIC K_TE_OBD_AUSS_DELTA "min. auss_lp_int-Reaktion fuer OK" VALUE 0x77884 TKW_VV_VV_SW 100.0 FORMULA_0706 -200.0 200.0 FORMAT "%4.1" /end CHARACTERISTIC
/begin CHARACTERISTIC K_TE_OBD_AUSS_DELTA_NEG "min. negative auss_lp_int-Reaktion fuer OK" VALUE 0x77886 TKW_VV_VV_SW 100.0 FORMULA_0706 -200.0 200.0 FORMAT "%4.1" /end CHARACTERISTIC
/begin CHARACTERISTIC K_TE_OBD_AUSS_TAU "Filterzeitkonstante fur auss_lp_int_sum" VALUE 0x77888 TKW_VV_VV_UB 100.0 FORMULA_0658 1.009999960660934e-002 2.559999942779541 /end CHARACTERISTIC
/begin CHARACTERISTIC K_TE_OBD_CFG "KKOS-Abwurf / laa_f_bx-Freeze" VALUE 0x7788B TKW_VV_VV_UB 100.0 FORMULA_1165 0.0 255.0 /end CHARACTERISTIC
/begin CHARACTERISTIC K_TE_OBD_LAM_DELTA "min. Reaktion lam_ist_mw fuer OK" VALUE 0x7788C TKW_VV_VV_UW 100.0 FORMULA_0025 0.0 3.999000072479248 FORMAT "%6.3" /end CHARACTERISTIC
/begin CHARACTERISTIC K_TE_OBD_LAM_FREIG "max. Regelabweichung Reglerfreigabe " VALUE 0x7788E TKW_VV_VV_UW 100.0 FORMULA_0025 0.0 3.999000072479248 FORMAT "%6.3" /end CHARACTERISTIC
/begin CHARACTERISTIC K_TE_OBD_LAM_OK "Anzahl noetiger LAM-Reaktionen" VALUE 0x77895 TKW_VV_VV_UB 100.0 FORMULA_0003 0.0 255.0 /end CHARACTERISTIC
/begin CHARACTERISTIC K_TE_OBD_LL_DELAY "Wartezeit nach Erreichen LL" VALUE 0x77890 TKW_VV_VV_UB 100.0 FORMULA_0461 0.0 25.5 /end CHARACTERISTIC
/begin CHARACTERISTIC K_TE_OBD_LL_DELTA "min. ml/n -Reaktion beim Oeffnen fuer OK" VALUE 0x77892 TKW_VV_VV_SW 100.0 FORMULA_0022 -50.0 50.0 FORMAT "%5.2" /end CHARACTERISTIC
/begin CHARACTERISTIC K_TE_OBD_LL_OK "Gesamt-Anzahl noetiger o.K. Reaktionen" VALUE 0x77894 TKW_VV_VV_UB 100.0 FORMULA_0003 0.0 255.0 /end CHARACTERISTIC
/begin CHARACTERISTIC K_TE_OBD_LL_ZU_DELTA "min. ml/n-Reaktion beim Schliessen fuer OK" VALUE 0x77896 TKW_VV_VV_SW 100.0 FORMULA_0022 -50.0 50.0 FORMAT "%5.2" /end CHARACTERISTIC
/begin CHARACTERISTIC K_TE_OBD_LRW_ABBR "Lenkwinkel-Aenderung fuer Abbruch" VALUE 0x77898 TKW_VV_VV_SW 100.0 FORMULA_0132 0.0 1440.109619140625 FORMAT "%5.2" /end CHARACTERISTIC
/begin CHARACTERISTIC K_TE_OBD_MD_GEN_ABBR "Generatormoment-Aenderung fuer Abbruch" VALUE 0x7789A TKW_VV_VV_SW 100.0 FORMULA_0113 -3276.800048828125 3276.699951171875 FORMAT "%5.2" /end CHARACTERISTIC
/begin CHARACTERISTIC K_TE_OBD_MD_KKOS_ABBR "Md-Aenderung KKOS fuer Abbruch" VALUE 0x7789C TKW_VV_VV_SW 100.0 FORMULA_0120 -100.0 1000.0 FORMAT "%4.1" /end CHARACTERISTIC
/begin CHARACTERISTIC K_TE_OBD_ML_MAX "Max. Luftmasse ml_ges" VALUE 0x7789E TKW_VV_VV_SW 100.0 FORMULA_0103 -100.0 1400.0 FORMAT "%4.1" /end CHARACTERISTIC
/begin CHARACTERISTIC K_TE_OBD_ML_TAU "Filterzeitkonstante fur ml_hfm_roh" VALUE 0x77889 TKW_VV_VV_UB 100.0 FORMULA_0658 1.009999960660934e-002 2.559999942779541 /end CHARACTERISTIC
/begin CHARACTERISTIC K_TE_OBD_RAMPE_ABBRUCH "Abbruchrampe TEV" VALUE 0x778A0 TKW_VV_VV_UW 100.0 FORMULA_1166 0.0 100.0 FORMAT "%4.1" /end CHARACTERISTIC
/begin CHARACTERISTIC K_TE_OBD_RAMPE_ZU "Abregelrampe TEV" VALUE 0x778A2 TKW_VV_VV_UW 100.0 FORMULA_1166 0.0 100.0 FORMAT "%4.1" /end CHARACTERISTIC
/begin CHARACTERISTIC K_TE_OBD_T_LAM_REG_OFF "Max. Sperrzeit Lam-Reg" VALUE 0x778A4 TKW_VV_VV_UB 100.0 FORMULA_0461 0.0 25.5 /end CHARACTERISTIC
/begin CHARACTERISTIC K_TE_OBD_T_MESS_OFFEN "Max. Messzeit bei offenen TEV" VALUE 0x778A5 TKW_VV_VV_UB 100.0 FORMULA_0461 0.0 25.5 /end CHARACTERISTIC
/begin CHARACTERISTIC K_TE_OBD_T_MESS_ZU "Max. Messzeit bei geschl. TEV" VALUE 0x778A6 TKW_VV_VV_UB 100.0 FORMULA_0461 0.0 25.5 /end CHARACTERISTIC
/begin CHARACTERISTIC K_TE_OBD_T_ML_MIN "Mindest-Motorlaufzeit" VALUE 0x778A8 TKW_VV_VV_UW 100.0 FORMULA_0021 0.0 655.0 FORMAT "%5.2" /end CHARACTERISTIC
/begin CHARACTERISTIC K_TE_OBD_TOEL_MIN "Mindest TOEL" VALUE 0x778AA TKW_VV_VV_SW 100.0 FORMULA_0023 -50.0 170.0 FORMAT "%4.1" /end CHARACTERISTIC
/begin CHARACTERISTIC K_TE_OBD_TOEL_MIN_EXD "Mindest TOEL für ext. Diagnose" VALUE 0x778AC TKW_VV_VV_SW 100.0 FORMULA_0023 -50.0 170.0 FORMAT "%4.1" /end CHARACTERISTIC
/begin CHARACTERISTIC K_TE_OBD_TV_MAX "Maximale Oeffnung TEV" VALUE 0x778AE TKW_VV_VV_UW 100.0 FORMULA_0107 0.0 100.0 FORMAT "%4.1" /end CHARACTERISTIC
/begin CHARACTERISTIC K_TE_OBD_TZ_ABBR "Zuendwinkelaenderung fuer Abbruch" VALUE 0x778B0 TKW_VV_VV_SW 100.0 FORMULA_0102 -50.0 60.0 FORMAT "%4.1" /end CHARACTERISTIC
/begin CHARACTERISTIC K_TE_OBD_UB_ABBR "Spannungsaenderung fuer Abbruch" VALUE 0x778B2 TKW_VV_VV_SW 100.0 FORMULA_0008 0.0 28.0 FORMAT "%4.1" /end CHARACTERISTIC
/begin CHARACTERISTIC K_TE_R_C3H8 "Gaskonstante C3H8" VALUE 0x77226 TKW_VV_VV_UW 100.0 FORMULA_1133 0.0 65535.0 FORMAT "%6.3" /end CHARACTERISTIC
/begin CHARACTERISTIC K_TE_R_LUFT "Gaskonstante LUFT" VALUE 0x77228 TKW_VV_VV_UW 100.0 FORMULA_1133 0.0 65535.0 FORMAT "%6.3" /end CHARACTERISTIC
/begin CHARACTERISTIC K_TE_RF_DYN_DELTA "RF-Delta f. Erkennung RF-stat." VALUE 0x7722A TKW_VV_VV_SW 100.0 FORMULA_0007 0.0 2.0 FORMAT "%6.3" /end CHARACTERISTIC
/begin CHARACTERISTIC K_TE_STOECH "stoechometrischer Faktor" VALUE 0x7722C TKW_VV_VV_UW 100.0 FORMULA_0806 0.0 511.9920959472656 FORMAT "%5.2" /end CHARACTERISTIC
/begin CHARACTERISTIC K_TE_T_LAA "TE_LAA und SPUELEN_WARTE_LAA Zeit" VALUE 0x7722E TKW_VV_VV_UW 100.0 FORMULA_0071 0.0 6553.5 FORMAT "%4.1" /end CHARACTERISTIC
/begin CHARACTERISTIC K_TE_T_LAA_INI "TE_LAA_INI-Zeit Normalstart" VALUE 0x77232 TKW_VV_VV_UW 100.0 FORMULA_0071 0.0 6553.5 FORMAT "%4.1" /end CHARACTERISTIC
/begin CHARACTERISTIC K_TE_T_LAA_INI_HS "TE_LAA_INI-Zeit nach Heisstart" VALUE 0x77230 TKW_VV_VV_UW 100.0 FORMULA_0071 0.0 6553.5 FORMAT "%4.1" /end CHARACTERISTIC
/begin CHARACTERISTIC K_TE_T_LANG "min te_t_spuel fuer Ueberg. in TE_LAA" VALUE 0x77234 TKW_VV_VV_UW 100.0 FORMULA_0071 0.0 6553.5 FORMAT "%4.1" /end CHARACTERISTIC
/begin CHARACTERISTIC K_TE_T_MIN "min. te_t_spuel bei B_TE_ABBR fuer Uebergang in TE_LAA" VALUE 0x77236 TKW_VV_VV_UW 100.0 FORMULA_0071 0.0 6553.5 FORMAT "%4.1" /end CHARACTERISTIC
/begin CHARACTERISTIC K_TE_T_NORM "max. te_t_spuel bei SPUELEN_KURZ" VALUE 0x77238 TKW_VV_VV_UW 100.0 FORMULA_0071 0.0 6553.5 FORMAT "%4.1" /end CHARACTERISTIC
/begin CHARACTERISTIC K_TE_T_SPUEL_INI "ununterbrech. TE-SPUELEN" VALUE 0x7723A TKW_VV_VV_UW 100.0 FORMULA_0071 0.0 6553.5 FORMAT "%4.1" /end CHARACTERISTIC
/begin CHARACTERISTIC K_TE_TI_MIN_DIFF "Min Abstand ti_tpu zu ti_bj.min" VALUE 0x7723C TKW_VV_VV_UW 100.0 FORMULA_0786 0.0 65.53500366210938 FORMAT "%5.2" /end CHARACTERISTIC
/begin CHARACTERISTIC K_TE_TMOT "TMOT-Schwelle f. Freigabe" VALUE 0x7723E TKW_VV_VV_SW 100.0 FORMULA_0023 -50.0 170.0 FORMAT "%4.1" /end CHARACTERISTIC
/begin CHARACTERISTIC K_TE_TMOT_START_HS "min. tmot_start Heisstarterkennung" VALUE 0x77240 TKW_VV_VV_SW 100.0 FORMULA_0023 -50.0 170.0 FORMAT "%4.1" /end CHARACTERISTIC
/begin CHARACTERISTIC K_TE_TV_MAX "max. Tastverhaeltnis TEV" VALUE 0x77244 TKW_VV_VV_UW 100.0 FORMULA_0107 0.0 100.0 FORMAT "%4.1" /end CHARACTERISTIC
/begin CHARACTERISTIC K_TE_TV_MIN "min. Tastverhaeltnis TEV" VALUE 0x77242 TKW_VV_VV_UW 100.0 FORMULA_0107 0.0 100.0 FORMAT "%4.1" /end CHARACTERISTIC
/begin CHARACTERISTIC K_TE_VAN_DYN_DELTA "VAN_VO-Delta f. Erkennung VAN-VO-stat." VALUE 0x77246 TKW_VV_VV_SW 100.0 FORMULA_0102 -80.0 80.0 FORMAT "%4.1" /end CHARACTERISTIC
/begin CHARACTERISTIC K_TE_X_MKS_APPL "applikativer Soll-MKS-Anteil" VALUE 0x77248 TKW_VV_VV_UW 100.0 FORMULA_0024 0.0 1.999899983406067 FORMAT "%7.4" /end CHARACTERISTIC
/begin CHARACTERISTIC K_TE_X_MKS_CFG "te_x_mks - Auswahl" VALUE 0x7724A TKW_VV_VV_UB 100.0 FORMULA_1158 0.0 1.0 /end CHARACTERISTIC
/begin CHARACTERISTIC K_TE_X_ML_SOLL_APPL_B1 "applikatives te_x_ml_soll" VALUE 0x7724C TKW_VV_VV_UW 100.0 FORMULA_0024 0.0 1.999899983406067 FORMAT "%7.4" /end CHARACTERISTIC
/begin CHARACTERISTIC K_TE_X_ML_SOLL_APPL_B2 "applikatives te_x_ml_soll" VALUE 0x7724E TKW_VV_VV_UW 100.0 FORMULA_0024 0.0 1.999899983406067 FORMAT "%7.4" /end CHARACTERISTIC
/begin CHARACTERISTIC K_TE_X_ML_SOLL_CFG "te_x_ml_soll - Auswahl" VALUE 0x77250 TKW_VV_VV_UW 100.0 FORMULA_1159 0.0 3.0 FORMAT "%5.2" /end CHARACTERISTIC
/begin CHARACTERISTIC K_TE_X_ML_SOLL_MAX "max. Spuelluftanteil f. System" VALUE 0x77252 TKW_VV_VV_UW 100.0 FORMULA_0024 0.0 1.999899983406067 FORMAT "%7.4" /end CHARACTERISTIC
/begin CHARACTERISTIC K_TE_X_ML_SOLL_MIN "min. gewuenschter Durchsatz" VALUE 0x77254 TKW_VV_VV_UW 100.0 FORMULA_0024 0.0 1.999899983406067 FORMAT "%7.4" /end CHARACTERISTIC
/begin CHARACTERISTIC K_TE_ZU_LERN "TEV Zufahrtzeit - LERNEN" VALUE 0x77256 TKW_VV_VV_UW 100.0 FORMULA_0071 0.0 6553.5 FORMAT "%4.1" /end CHARACTERISTIC
/begin CHARACTERISTIC K_TE_ZU_NORM "TEV Zufahrtzeit - Normalbetrieb" VALUE 0x77258 TKW_VV_VV_UW 100.0 FORMULA_0071 0.0 6553.5 FORMAT "%4.1" /end CHARACTERISTIC
/begin CHARACTERISTIC K_TE_ZU_SA "TEV Zufahrtzeit - B_ZUST_SA" VALUE 0x7725A TKW_VV_VV_UW 100.0 FORMULA_0071 0.0 6553.5 FORMAT "%4.1" /end CHARACTERISTIC
/begin CHARACTERISTIC K_TEST "Maxwert" VALUE 0x778CA TKW_VV_VV_UW 100.0 FORMULA_0010 0.0 65535.0 /end CHARACTERISTIC
/begin CHARACTERISTIC K_TEST_LA_BANK1 "Testarray" VALUE 0x778D0 TKW_VV_VV_UB 100.0 FORMULA_0003 0.0 255.0 /end CHARACTERISTIC
/begin CHARACTERISTIC K_TEST_LA_BANK2 "Testarray" VALUE 0x778D1 TKW_VV_VV_UB 100.0 FORMULA_0003 0.0 255.0 /end CHARACTERISTIC
/begin CHARACTERISTIC K_TEST_MD_ZYL1 "Testarray" VALUE 0x778D2 TKW_VV_VV_UB 100.0 FORMULA_0003 0.0 255.0 /end CHARACTERISTIC
/begin CHARACTERISTIC K_TEST_MD_ZYL10 "Testarray" VALUE 0x778DB TKW_VV_VV_UB 100.0 FORMULA_0003 0.0 255.0 /end CHARACTERISTIC
/begin CHARACTERISTIC K_TEST_MD_ZYL11 "Testarray" VALUE 0x778DC TKW_VV_VV_UB 100.0 FORMULA_0003 0.0 255.0 /end CHARACTERISTIC
/begin CHARACTERISTIC K_TEST_MD_ZYL12 "Testarray" VALUE 0x778DD TKW_VV_VV_UB 100.0 FORMULA_0003 0.0 255.0 /end CHARACTERISTIC
/begin CHARACTERISTIC K_TEST_MD_ZYL2 "Testarray" VALUE 0x778D3 TKW_VV_VV_UB 100.0 FORMULA_0003 0.0 255.0 /end CHARACTERISTIC
/begin CHARACTERISTIC K_TEST_MD_ZYL3 "Testarray" VALUE 0x778D4 TKW_VV_VV_UB 100.0 FORMULA_0003 0.0 255.0 /end CHARACTERISTIC
/begin CHARACTERISTIC K_TEST_MD_ZYL4 "Testarray" VALUE 0x778D5 TKW_VV_VV_UB 100.0 FORMULA_0003 0.0 255.0 /end CHARACTERISTIC
/begin CHARACTERISTIC K_TEST_MD_ZYL5 "Testarray" VALUE 0x778D6 TKW_VV_VV_UB 100.0 FORMULA_0003 0.0 255.0 /end CHARACTERISTIC
/begin CHARACTERISTIC K_TEST_MD_ZYL6 "Testarray" VALUE 0x778D7 TKW_VV_VV_UB 100.0 FORMULA_0003 0.0 255.0 /end CHARACTERISTIC
/begin CHARACTERISTIC K_TEST_MD_ZYL7 "Testarray" VALUE 0x778D8 TKW_VV_VV_UB 100.0 FORMULA_0003 0.0 255.0 /end CHARACTERISTIC
/begin CHARACTERISTIC K_TEST_MD_ZYL8 "Testarray" VALUE 0x778D9 TKW_VV_VV_UB 100.0 FORMULA_0003 0.0 255.0 /end CHARACTERISTIC
/begin CHARACTERISTIC K_TEST_MD_ZYL9 "Testarray" VALUE 0x778DA TKW_VV_VV_UB 100.0 FORMULA_0003 0.0 255.0 /end CHARACTERISTIC
/begin CHARACTERISTIC K_TEST_X "Testwert-x" VALUE 0x778CC TKW_VV_VV_UW 100.0 FORMULA_0010 0.0 65535.0 /end CHARACTERISTIC
/begin CHARACTERISTIC K_TEST_Y "Testwert-y" VALUE 0x778CE TKW_VV_VV_UW 100.0 FORMULA_0010 0.0 65535.0 /end CHARACTERISTIC
/begin CHARACTERISTIC KF_SL_LAM_MOT_OFFS "Motorlambdaoffset bei SL" MAP 0x76E06 TKF_SW_SW_SW 100.0 FORMULA_0199 -0.6000000238418579 0.6000000238418579 FORMAT "%7.4"
 /begin AXIS_DESCR STD_AXIS time_ml FORMULA_0021 6 0.0 327.0 MAX_GRAD 0.0 FORMAT "%5.2" /end AXIS_DESCR
 /begin AXIS_DESCR STD_AXIS zust_tmot_start FORMULA_0023 6 -50.0 170.0 MAX_GRAD 0.0 FORMAT "%4.1" /end AXIS_DESCR
/end CHARACTERISTIC
/begin CHARACTERISTIC KF_SL_VORST_TV "Vorsteuerung SL Tastverhaeltnis" MAP 0x76DA4 TKF_SW_SW_SW 100.0 FORMULA_0142 0.0 100.0 FORMAT "%4.1"
 /begin AXIS_DESCR STD_AXIS pabg_diff FORMULA_0075 6 0.0 500.0 MAX_GRAD 0.0 FORMAT "%4.1" /end AXIS_DESCR
 /begin AXIS_DESCR STD_AXIS sl_ml_rel FORMULA_0001 6 0.0 100.0 MAX_GRAD 0.0 FORMAT "%4.1" /end AXIS_DESCR
/end CHARACTERISTIC
/begin CHARACTERISTIC KF_SLP_DAUER_TMOT_START "SLP Laufzeit" MAP 0x76E8A TKF_SW_SW_SW 100.0 FORMULA_0071 0.0 3276.699951171875 FORMAT "%4.1"
 /begin AXIS_DESCR STD_AXIS zust_tmot_start FORMULA_0023 8 -50.0 170.0 MAX_GRAD 0.0 FORMAT "%4.1" /end AXIS_DESCR
 /begin AXIS_DESCR STD_AXIS kat_obd_wert_nv_b1 FORMULA_0025 4 0.0 1.998999953269959 MAX_GRAD 0.0 FORMAT "%6.3" /end AXIS_DESCR
/end CHARACTERISTIC
/begin CHARACTERISTIC KF_TE_ANZUGSZEIT "Anzugszeit TEV" MAP 0x773C2 TKF_UW_UW_UW 100.0 FORMULA_0985 0.0 655.3499755859375 FORMAT "%5.2"
 /begin AXIS_DESCR STD_AXIS te_freq FORMULA_1076 5 10.0 50.0 MAX_GRAD 0.0 FORMAT "%4.1" /end AXIS_DESCR
 /begin AXIS_DESCR STD_AXIS ub FORMULA_0008 5 0.0 28.0 MAX_GRAD 0.0 FORMAT "%4.1" /end AXIS_DESCR
/end CHARACTERISTIC
/begin CHARACTERISTIC KF_TE_GW_RAMPEN "betriebspunktabh. Rampenzeit" MAP 0x7740A TKF_SW_SW_UW 100.0 FORMULA_0071 0.0 6553.5 FORMAT "%4.1"
 /begin AXIS_DESCR STD_AXIS te_lam_delta FORMULA_0025 9 -2.0 1.999899983406067 MAX_GRAD 0.0 FORMAT "%6.3" /end AXIS_DESCR
 /begin AXIS_DESCR STD_AXIS te_c_akf FORMULA_0199 5 0.0 2.0 MAX_GRAD 0.0 FORMAT "%7.4" /end AXIS_DESCR
/end CHARACTERISTIC
/begin CHARACTERISTIC KF_TE_M_MAX_ML "max. Durchfluss Luft bei 100% tv und Normbed." MAP 0x77482 TKF_SW_SW_UW 100.0 FORMULA_0563 0.0 65.53500366210938 FORMAT "%6.3"
 /begin AXIS_DESCR STD_AXIS te_psau_diff FORMULA_0075 12 0.0 2000.0 MAX_GRAD 0.0 FORMAT "%4.1" /end AXIS_DESCR
 /begin AXIS_DESCR STD_AXIS n FORMULA_0006 8 0.0 10000.0 MAX_GRAD 0.0 /end AXIS_DESCR
/end CHARACTERISTIC
/begin CHARACTERISTIC KF_TE_TV_NORM "normiertes Tastverhaeltnis" MAP 0x7756C TKF_UW_UW_UW 100.0 FORMULA_0107 0.0 100.0 FORMAT "%4.1"
 /begin AXIS_DESCR STD_AXIS te_tv_rel FORMULA_0107 11 0.0 100.0 MAX_GRAD 0.0 FORMAT "%4.1" /end AXIS_DESCR
 /begin AXIS_DESCR STD_AXIS te_freq FORMULA_1076 5 10.0 50.0 MAX_GRAD 0.0 FORMAT "%4.1" /end AXIS_DESCR
/end CHARACTERISTIC
/begin CHARACTERISTIC KF_TE_X_SOLL_KATD "Spuelluftanteil bei Katdiagnose" MAP 0x775FC TKF_SW_SW_UW 100.0 FORMULA_0024 0.0 1.999899983406067 FORMAT "%7.4" /begin AXIS_DESCR STD_AXIS n FORMULA_0006 8 0.0 10000.0 MAX_GRAD 0.0 /end AXIS_DESCR
 /begin AXIS_DESCR STD_AXIS psau.asp FORMULA_0075 8 0.0 2000.0 MAX_GRAD 0.0 FORMAT "%4.1" /end AXIS_DESCR
/end CHARACTERISTIC
/begin CHARACTERISTIC KF_TE_X_SOLL_MKS "betriebspunktabh. Kraftstoffanteil" MAP 0x7769E TKF_SW_SW_UW 100.0 FORMULA_0024 0.0 1.999899983406067 FORMAT "%7.4" /begin AXIS_DESCR STD_AXIS n FORMULA_0006 8 0.0 10000.0 MAX_GRAD 0.0 /end AXIS_DESCR
 /begin AXIS_DESCR STD_AXIS psau.asp FORMULA_0075 8 0.0 2000.0 MAX_GRAD 0.0 FORMAT "%4.1" /end AXIS_DESCR
/end CHARACTERISTIC
/begin CHARACTERISTIC KF_TE_X_SOLL_N_PSAU "Spuelluftanteil im Normalbetrieb" MAP 0x77740 TKF_SW_SW_UW 100.0 FORMULA_0024 0.0 1.999899983406067 FORMAT "%7.4" /begin AXIS_DESCR STD_AXIS n FORMULA_0006 8 0.0 10000.0 MAX_GRAD 0.0 /end AXIS_DESCR
 /begin AXIS_DESCR STD_AXIS psau.asp FORMULA_0075 8 0.0 2000.0 MAX_GRAD 0.0 FORMAT "%4.1" /end AXIS_DESCR
/end CHARACTERISTIC
/begin CHARACTERISTIC KF_TE_X_SOLL_NOT "Spuelluftanteil bei NOTLAUF" MAP 0x777E2 TKF_SW_SW_UW 100.0 FORMULA_0024 0.0 1.999899983406067 FORMAT "%7.4" /begin AXIS_DESCR STD_AXIS n FORMULA_0006 8 0.0 10000.0 MAX_GRAD 0.0 /end AXIS_DESCR
 /begin AXIS_DESCR STD_AXIS psau.asp FORMULA_0075 8 0.0 2000.0 MAX_GRAD 0.0 FORMAT "%4.1" /end AXIS_DESCR
/end CHARACTERISTIC
/begin CHARACTERISTIC KF_TEST_XY "Testkennfeld" MAP 0x778F0 TKF_UW_UW_UW 100.0 FORMULA_0010 0.0 65535.0 /begin AXIS_DESCR STD_AXIS ein_x FORMULA_0010 5 0.0 65535.0 MAX_GRAD 0.0 /end AXIS_DESCR /begin AXIS_DESCR STD_AXIS ein_y FORMULA_0010 3 0.0 65535.0 MAX_GRAD 0.0 /end AXIS_DESCR /end CHARACTERISTIC
/begin CHARACTERISTIC KL_DMTL_FST_ERS_LI "Ersatzwert bei Geber Links Fehler" CURVE 0x7080A TKL_UB_VV_UB 100.0 FORMULA_0559 0.0 127.5 /begin AXIS_DESCR STD_AXIS fst_rechts FORMULA_0559 4 0.0 127.5 MAX_GRAD 0.0 /end AXIS_DESCR /end CHARACTERISTIC
/begin CHARACTERISTIC KL_DMTL_FST_ERS_RE "Ersatzwert bei Geber Rechts Fehler" CURVE 0x70814 TKL_UB_VV_UB 100.0 FORMULA_0559 0.0 127.5 /begin AXIS_DESCR STD_AXIS fst_links FORMULA_0559 4 0.0 127.5 MAX_GRAD 0.0 /end AXIS_DESCR /end CHARACTERISTIC
/begin CHARACTERISTIC KL_DMTL_FST_MAX_STAND "Maximaler Fuellstand für Diagnosen im Stand" CURVE 0x707FC TKL_SW_VV_UB 100.0 FORMULA_0559 0.0 127.5
 /begin AXIS_DESCR STD_AXIS can_ay FORMULA_0123 4 -20.0 20.0 MAX_GRAD 0.0 FORMAT "%5.2" /end AXIS_DESCR
/end CHARACTERISTIC
/begin CHARACTERISTIC KL_DMTL_HOEHE_KORR "Korrekturfaktor fuer DMTL T-grob/stabil ueber p_umg" CURVE 0x7081E TKL_SW_VV_UB 100.0 FORMULA_0638 0.0 1.99210000038147
 /begin AXIS_DESCR STD_AXIS pumg FORMULA_0075 3 400.0 1200.0 MAX_GRAD 0.0 FORMAT "%4.1" /end AXIS_DESCR
/end CHARACTERISTIC
/begin CHARACTERISTIC KL_DMTL_I_REF_KORR "Korrektur Referenzstrom fuer Feinleck ueber Fuellstand" CURVE 0x7082A TKL_UB_VV_UB 100.0 FORMULA_0638 0.0 1.99210000038147 /begin AXIS_DESCR STD_AXIS can_fst_sum FORMULA_0559 3 0.0 127.5 MAX_GRAD 0.0 /end AXIS_DESCR /end CHARACTERISTIC
/begin CHARACTERISTIC KL_DMTL_KORR_FAKT "Korrekturfaktor Pumpenstrom ueber Spannung" CURVE 0x70832 TKL_UW_VV_UW 100.0 FORMULA_0073 0.0 2.0 FORMAT "%6.3"
 /begin AXIS_DESCR STD_AXIS dmtl_ub_fil FORMULA_0651 5 0.0 25.0 MAX_GRAD 0.0 FORMAT "%5.2" /end AXIS_DESCR
/end CHARACTERISTIC
/begin CHARACTERISTIC KL_DMTL_T_FEIN_MIN "Minimale Feinleck-Messdauer" CURVE 0x70848 TKL_UB_VV_UB 100.0 FORMULA_0652 0.0 510.0 /begin AXIS_DESCR STD_AXIS can_fst_sum FORMULA_0559 6 0.0 127.5 MAX_GRAD 0.0 /end AXIS_DESCR /end CHARACTERISTIC
/begin CHARACTERISTIC KL_DMTL_T_GROB "Maximale Grobleck-Messdauer" CURVE 0x70856 TKL_UB_VV_UB 100.0 FORMULA_0214 0.0 255.0 /begin AXIS_DESCR STD_AXIS can_fst_sum FORMULA_0559 6 0.0 127.5 MAX_GRAD 0.0 /end AXIS_DESCR /end CHARACTERISTIC
/begin CHARACTERISTIC KL_DMTL_T_STABIL "Stabilzeit fuer Feinleck ueber Fuellstand" CURVE 0x70864 TKL_UB_VV_UB 100.0 FORMULA_0214 0.0 255.0 /begin AXIS_DESCR STD_AXIS can_fst_sum FORMULA_0559 6 0.0 127.5 MAX_GRAD 0.0 /end AXIS_DESCR /end CHARACTERISTIC
/begin CHARACTERISTIC KL_SCHALTER_KS_REG "Kennlinie P-Anteil Regler Kraftschluss" CURVE 0x76ABE TKL_SB_VV_UW 100.0 FORMULA_1082 0.0 8.0 FORMAT "%5.2" /begin AXIS_DESCR STD_AXIS Gang_KS FORMULA_0135 8 -1.0 10.0 MAX_GRAD 0.0 /end AXIS_DESCR /end CHARACTERISTIC
/begin CHARACTERISTIC KL_SL_HFM_AD "Kennlinie Mini HFM" CURVE 0x76D3C TKL_SW_VV_SW 100.0 FORMULA_0103 -100.0 1400.0 FORMAT "%4.1"
 /begin AXIS_DESCR STD_AXIS sl_ml_hfm_ad FORMULA_0114 10 0.0 1023.0 MAX_GRAD 0.0 /end AXIS_DESCR
/end CHARACTERISTIC
/begin CHARACTERISTIC KL_SL_I_ANTEIL "I-Anteil SL-Mengenregelung" CURVE 0x76CBA TKL_SW_VV_SW 100.0 FORMULA_0199 -2.0 1.999899983406067 FORMAT "%7.4"
 /begin AXIS_DESCR STD_AXIS ml FORMULA_0103 7 -100.0 1400.0 MAX_GRAD 0.0 FORMAT "%4.1" /end AXIS_DESCR
/end CHARACTERISTIC
/begin CHARACTERISTIC KL_SL_LAM_I_ANTEIL "I-Anteil Bankabgleich" CURVE 0x76CF2 TKL_SW_VV_SW 100.0 FORMULA_1089 -0.5 0.5 FORMAT "%6.3"
 /begin AXIS_DESCR STD_AXIS Regelabweichung FORMULA_1090 5 -0.5 0.5 MAX_GRAD 0.0 FORMAT "%6.3" /end AXIS_DESCR
/end CHARACTERISTIC
/begin CHARACTERISTIC KL_SL_LAM_MOT_DELAY "Zeitverzoegerung fuer Motorlambda, offset" CURVE 0x76CD8 TKL_SW_VV_UW 100.0 FORMULA_0021 0.0 655.0 FORMAT "%5.2"
 /begin AXIS_DESCR STD_AXIS zust_tmot_start FORMULA_0023 6 -50.0 200.0 MAX_GRAD 0.0 FORMAT "%4.1" /end AXIS_DESCR
/end CHARACTERISTIC
/begin CHARACTERISTIC KL_SL_LAM_MOT_OFFS_TIME_F "Spreitzung time_ml abh. von Katalterung" CURVE 0x76D92 TKL_UW_VV_UW 100.0 FORMULA_0073 0.0 4.0 FORMAT "%6.3"
 /begin AXIS_DESCR STD_AXIS kat_obd_wert_gesamt_nv FORMULA_0025 4 0.0 3.999000072479248 MAX_GRAD 0.0 FORMAT "%6.3" /end AXIS_DESCR
/end CHARACTERISTIC
/begin CHARACTERISTIC KL_SL_LAMSOL_KALT "Soll Abgaslambda fuer kalten Kat" CURVE 0x76D08 TKL_UW_VV_UW 100.0 FORMULA_0025 0.0 3.999000072479248 FORMAT "%6.3"
 /begin AXIS_DESCR STD_AXIS t FORMULA_0021 6 0.0 655.0 MAX_GRAD 0.0 FORMAT "%5.2" /end AXIS_DESCR
/end CHARACTERISTIC
/begin CHARACTERISTIC KL_SL_LAMSOL_WARM "Soll Abgaslambda fuer warmen Kat" CURVE 0x76D22 TKL_UW_VV_UW 100.0 FORMULA_0025 0.0 3.999000072479248 FORMAT "%6.3"
 /begin AXIS_DESCR STD_AXIS t FORMULA_0021 6 0.0 655.0 MAX_GRAD 0.0 FORMAT "%5.2" /end AXIS_DESCR
/end CHARACTERISTIC
/begin CHARACTERISTIC KL_SL_ML_MAX_PABG "SL Max Durchfluss abh. von pabg" CURVE 0x76D78 TKL_SW_VV_SW 100.0 FORMULA_0103 -100.0 1400.0 FORMAT "%4.1"
 /begin AXIS_DESCR STD_AXIS pabg_diff FORMULA_0075 6 0.0 1000.0 MAX_GRAD 0.0 FORMAT "%4.1" /end AXIS_DESCR
/end CHARACTERISTIC
/begin CHARACTERISTIC KL_SL_ML_MAX_UB_FAKT "UB Korrektur" CURVE 0x76D66 TKL_SW_VV_UW 100.0 FORMULA_0073 0.0 4.0 FORMAT "%6.3"
 /begin AXIS_DESCR STD_AXIS ub FORMULA_0008 4 0.0 28.0 MAX_GRAD 0.0 FORMAT "%4.1" /end AXIS_DESCR
/end CHARACTERISTIC
/begin CHARACTERISTIC KL_SL_P_ANTEIL "P-Anteil SL-Mengenregelung" CURVE 0x76C9C TKL_SW_VV_SW 100.0 FORMULA_0199 -2.0 1.999899983406067 FORMAT "%7.4"
 /begin AXIS_DESCR STD_AXIS ml FORMULA_0103 7 -100.0 1400.0 MAX_GRAD 0.0 FORMAT "%4.1" /end AXIS_DESCR
/end CHARACTERISTIC
/begin CHARACTERISTIC KL_SLP_DELAY_TMOT_START "SLP-Delay abhaengig von tmot_start" CURVE 0x76E70 TKL_SW_VV_UW 100.0 FORMULA_0021 0.0 655.0 FORMAT "%5.2"
 /begin AXIS_DESCR STD_AXIS zust_tmot_start FORMULA_0023 6 -50.0 170.0 MAX_GRAD 0.0 FORMAT "%4.1" /end AXIS_DESCR
/end CHARACTERISTIC
/begin CHARACTERISTIC KL_SLS_OBDH_ASV_DIA_T "Diag-Dauer ASV" CURVE 0x76FC0 TKL_SW_VV_UW 100.0 FORMULA_0021 0.0 655.0 FORMAT "%5.2"
 /begin AXIS_DESCR STD_AXIS tabg_vkat_1of2 FORMULA_0023 6 -50.0 170.0 MAX_GRAD 0.0 FORMAT "%4.1" /end AXIS_DESCR
/end CHARACTERISTIC
/begin CHARACTERISTIC KL_SLS_OBDH_ASV_LAM_LEAK_MAX "Schwelle fuer Erkennung auf Leckage" CURVE 0x76FDA TKL_SW_VV_SW 100.0 FORMULA_0025 -0.5 0.5 FORMAT "%6.3"
 /begin AXIS_DESCR STD_AXIS ml_ges FORMULA_0103 4 -100.0 1400.0 MAX_GRAD 0.0 FORMAT "%4.1" /end AXIS_DESCR
/end CHARACTERISTIC
/begin CHARACTERISTIC KL_SLS_OBDH_HFM_DIAG_MIN "Min Luftmassendelta zur Erkennung HFM i.O." CURVE 0x77010 TKL_UW_VV_SW 100.0 FORMULA_0114 0.0 2000.0
 /begin AXIS_DESCR STD_AXIS rf_pt_korr FORMULA_0073 4 0.0 4.0 MAX_GRAD 0.0 FORMAT "%6.3" /end AXIS_DESCR
/end CHARACTERISTIC
/begin CHARACTERISTIC KL_SLS_OBDH_ML_LAM_DIF_MAX "Schwelle fuer Erkennung Durchfluss ML-Plausi" CURVE 0x76FEC TKL_SW_VV_SW 100.0 FORMULA_0025 -0.5 0.5 FORMAT "%6.3"
 /begin AXIS_DESCR STD_AXIS ml_ges FORMULA_0103 4 -100.0 1400.0 MAX_GRAD 0.0 FORMAT "%4.1" /end AXIS_DESCR
/end CHARACTERISTIC
/begin CHARACTERISTIC KL_SLS_OBDH_ML_MDF_DIAG "Einschaltverzoegerung Mindestdurchflussdiagnose" CURVE 0x76F3E TKL_SW_VV_UW 100.0 FORMULA_0021 0.0 655.0 FORMAT "%5.2"
 /begin AXIS_DESCR STD_AXIS tabg_vkat_1of2 FORMULA_0023 6 -50.0 1000.0 MAX_GRAD 0.0 FORMAT "%4.1" /end AXIS_DESCR
/end CHARACTERISTIC
/begin CHARACTERISTIC KL_SLS_OBDH_ML_VOLA_INTG_MAX "Max. Wert fuer Erkennung SLP defekt" CURVE 0x77022 TKL_UW_VV_UW 100.0 FORMULA_0103 0.0 6550.0 FORMAT "%4.1"
 /begin AXIS_DESCR STD_AXIS rf_pt_korr FORMULA_0073 4 0.0 4.0 MAX_GRAD 0.0 FORMAT "%6.3" /end AXIS_DESCR
/end CHARACTERISTIC
/begin CHARACTERISTIC KL_SLS_OBDH_PU_SAU_MIN "Schwelle fuer Diagnoseabbruch psau Underdruck" CURVE 0x76FFE TKL_SW_VV_SW 100.0 FORMULA_0075 0.0 2000.0 FORMAT "%4.1"
 /begin AXIS_DESCR STD_AXIS tmot FORMULA_0023 4 -50.0 170.0 MAX_GRAD 0.0 FORMAT "%4.1" /end AXIS_DESCR
/end CHARACTERISTIC
/begin CHARACTERISTIC KL_SLS_OBDH_SLV_T_DIAG_OFF "Diag-Dauer SLV" CURVE 0x76FA6 TKL_SW_VV_UW 100.0 FORMULA_0021 0.0 655.0 FORMAT "%5.2"
 /begin AXIS_DESCR STD_AXIS tabg_vkat_1of2 FORMULA_0023 6 -50.0 170.0 MAX_GRAD 0.0 FORMAT "%4.1" /end AXIS_DESCR
/end CHARACTERISTIC
/begin CHARACTERISTIC KL_SLS_OBDH_ZWD_T_DIAG_0 "Diag-Dauer ZWD ZWD 0 Proz geoffnet" CURVE 0x76F72 TKL_SW_VV_UW 100.0 FORMULA_0021 0.0 655.0 FORMAT "%5.2"
 /begin AXIS_DESCR STD_AXIS tabg_vkat_1of2 FORMULA_0023 6 -50.0 170.0 MAX_GRAD 0.0 FORMAT "%4.1" /end AXIS_DESCR
/end CHARACTERISTIC
/begin CHARACTERISTIC KL_SLS_OBDH_ZWD_T_DIAG_100 "Diag-Dauer ZWD 100 Proz geoffnet" CURVE 0x76F8C TKL_SW_VV_UW 100.0 FORMULA_0021 0.0 655.0 FORMAT "%5.2"
 /begin AXIS_DESCR STD_AXIS tabg_vkat_1of2 FORMULA_0023 6 -50.0 170.0 MAX_GRAD 0.0 FORMAT "%4.1" /end AXIS_DESCR
/end CHARACTERISTIC
/begin CHARACTERISTIC KL_SLS_OBDH_ZWD_T_DIAG_OFF "Diag-Dauer ZWD stromlos" CURVE 0x76F58 TKL_SW_VV_UW 100.0 FORMULA_0021 0.0 655.0 FORMAT "%5.2"
 /begin AXIS_DESCR STD_AXIS tabg_vkat_1of2 FORMULA_0023 6 -50.0 170.0 MAX_GRAD 0.0 FORMAT "%4.1" /end AXIS_DESCR
/end CHARACTERISTIC
/begin CHARACTERISTIC KL_SPGR_FREQ "Spannungesregler Switchingfreq" CURVE 0x77034 TKL_SW_VV_UW 100.0 FORMULA_1121 228.0 700.0
 /begin AXIS_DESCR STD_AXIS temperatur FORMULA_0023 2 -50.0 170.0 MAX_GRAD 0.0 FORMAT "%4.1" /end AXIS_DESCR
/end CHARACTERISTIC
/begin CHARACTERISTIC KL_STAT_DATA_N "Kennlinie Drehzahl n fuer Statistik" CURVE 0x7703E TKL_SW_VV_SW 100.0 FORMULA_0010 0.0 7.0 /begin AXIS_DESCR STD_AXIS n FORMULA_0006 8 0.0 10000.0 MAX_GRAD 0.0 /end AXIS_DESCR /end CHARACTERISTIC
/begin CHARACTERISTIC KL_STAT_DATA_RF "Kennlinie relative Fuellung rf fuer Statistik" CURVE 0x77060 TKL_SW_VV_SW 100.0 FORMULA_0010 0.0 6.0
 /begin AXIS_DESCR STD_AXIS rf_m FORMULA_0007 7 0.0 2.0 MAX_GRAD 0.0 FORMAT "%6.3" /end AXIS_DESCR
/end CHARACTERISTIC
/begin CHARACTERISTIC KL_STAT_DATA_TDME "Kennlinie ECU-Temperatur tdme fuer Statistik" CURVE 0x770C2 TKL_SW_VV_SW 100.0 FORMULA_0010 0.0 7.0
 /begin AXIS_DESCR STD_AXIS tdme FORMULA_0023 8 -50.0 170.0 MAX_GRAD 0.0 FORMAT "%4.1" /end AXIS_DESCR
/end CHARACTERISTIC
/begin CHARACTERISTIC KL_STAT_DATA_TMOT "Kennlinie Motor-Temperatur tmot fuer Statistik" CURVE 0x7707E TKL_SW_VV_SW 100.0 FORMULA_0010 0.0 7.0
 /begin AXIS_DESCR STD_AXIS tmot FORMULA_0023 8 -50.0 170.0 MAX_GRAD 0.0 FORMAT "%4.1" /end AXIS_DESCR
/end CHARACTERISTIC
/begin CHARACTERISTIC KL_STAT_DATA_TOEL "KL Oel-Temperatur toel am Oelfilterkopf fuer Statistik" CURVE 0x770A0 TKL_SW_VV_SW 100.0 FORMULA_0010 0.0 7.0
 /begin AXIS_DESCR STD_AXIS toel FORMULA_0023 8 -50.0 170.0 MAX_GRAD 0.0 FORMAT "%4.1" /end AXIS_DESCR
/end CHARACTERISTIC
/begin CHARACTERISTIC KL_TE_B_ABBR_VOL_SUM "B_TE_ABBR nur, wenn c_akf kleiner" CURVE 0x7725C TKL_UW_VV_UW 100.0 FORMULA_0199 0.0 2.0 FORMAT "%7.4"
 /begin AXIS_DESCR STD_AXIS te_vol_sum FORMULA_1154 5 0.0 14316.3388671875 MAX_GRAD 0.0 FORMAT "%4.1" /end AXIS_DESCR
/end CHARACTERISTIC
/begin CHARACTERISTIC KL_TE_FREQ "Ansteuerfrequenz TE" CURVE 0x77272 TKL_SW_VV_UW 100.0 FORMULA_1076 10.0 50.0 FORMAT "%4.1" /begin AXIS_DESCR STD_AXIS n FORMULA_0006 10 0.0 10000.0 MAX_GRAD 0.0 /end AXIS_DESCR /end CHARACTERISTIC
/begin CHARACTERISTIC KL_TE_GW_F "Verlaengerung d. Rampenzeit" CURVE 0x7729C TKL_UW_VV_UW 100.0 FORMULA_0073 0.0 4.0 FORMAT "%6.3"
 /begin AXIS_DESCR STD_AXIS ml FORMULA_0103 5 0.0 3276.800048828125 MAX_GRAD 0.0 FORMAT "%4.1" /end AXIS_DESCR
/end CHARACTERISTIC
/begin CHARACTERISTIC KL_TE_GW_LAM_REG_F "Verlaengerung d. Rampenzeit" CURVE 0x772B2 TKL_UW_VV_UW 100.0 FORMULA_0073 0.0 4.0 FORMAT "%6.3"
 /begin AXIS_DESCR STD_AXIS lam_reg_f FORMULA_0024 8 0.0 1.998999953269959 MAX_GRAD 0.0 FORMAT "%7.4" /end AXIS_DESCR
/end CHARACTERISTIC
/begin CHARACTERISTIC KL_TE_GW_TI_MIN "Grenzwert ti_min-Regelung" CURVE 0x772D4 TKL_UW_VV_UW 100.0 FORMULA_0071 0.0 6553.5 FORMAT "%4.1"
 /begin AXIS_DESCR STD_AXIS te_ti_min_diff FORMULA_0786 5 0.0 65.53500366210938 MAX_GRAD 0.0 FORMAT "%5.2" /end AXIS_DESCR
/end CHARACTERISTIC
/begin CHARACTERISTIC KL_TE_MKS_XSI "Ausflusskoeffizient - MKS" CURVE 0x772EA TKL_SW_VV_UW 100.0 FORMULA_0073 0.0 63.99900054931641 FORMAT "%6.3"
 /begin AXIS_DESCR STD_AXIS psau_rel FORMULA_0106 14 0.0 120.0 MAX_GRAD 0.0 FORMAT "%5.2" /end AXIS_DESCR
/end CHARACTERISTIC
/begin CHARACTERISTIC KL_TE_ML_XSI "Ausflusskoeffizient - ML" CURVE 0x77324 TKL_SW_VV_UW 100.0 FORMULA_0073 0.0 63.99900054931641 FORMAT "%6.3"
 /begin AXIS_DESCR STD_AXIS psau_rel FORMULA_0106 14 0.0 120.0 MAX_GRAD 0.0 FORMAT "%5.2" /end AXIS_DESCR
/end CHARACTERISTIC
/begin CHARACTERISTIC KL_TE_OBD_RAMPE "Oeffnungsverlauf beim TEV-Check" CURVE 0x778B4 TKL_UW_VV_UW 100.0 FORMULA_1166 0.0 100.0 FORMAT "%4.1"
 /begin AXIS_DESCR STD_AXIS te_obd_tv FORMULA_0107 5 0.0 100.0 MAX_GRAD 0.0 FORMAT "%4.1" /end AXIS_DESCR
/end CHARACTERISTIC
/begin CHARACTERISTIC KL_TE_SYNC_FREQ "segm.synch. Ansteuerfrequenz" CURVE 0x7735E TKL_SW_VV_UW 100.0 FORMULA_1076 10.0 50.0 FORMAT "%4.1" /begin AXIS_DESCR STD_AXIS n FORMULA_0006 2 0.0 10000.0 MAX_GRAD 0.0 /end AXIS_DESCR /end CHARACTERISTIC
/begin CHARACTERISTIC KL_TE_T_BEGIN_MIN "Verzoegerungszeit - TE-Freigabe" CURVE 0x77368 TKL_SW_VV_UW 100.0 FORMULA_0021 0.0 655.0 FORMAT "%5.2"
 /begin AXIS_DESCR STD_AXIS tmot_start FORMULA_0023 6 -50.0 170.0 MAX_GRAD 0.0 FORMAT "%4.1" /end AXIS_DESCR
/end CHARACTERISTIC
/begin CHARACTERISTIC KL_TE_TI_MIN "TE - TI-Min" CURVE 0x77382 TKL_SW_VV_UW 100.0 FORMULA_0111 0.0 1023.984313964844 FORMAT "%5.2"
 /begin AXIS_DESCR STD_AXIS pks_ist FORMULA_0110 5 0.0 10.0 MAX_GRAD 0.0 FORMAT "%6.3" /end AXIS_DESCR
/end CHARACTERISTIC
/begin CHARACTERISTIC KL_TE_YPS_SQRT "Darstellung Wurzel-Stroemungsgeschwindigkeit" CURVE 0x77398 TKL_UW_VV_UW 100.0 FORMULA_1160 0.0 196605.0
 /begin AXIS_DESCR STD_AXIS te_ml_mks_yps_quad FORMULA_1131 10 0.0 589815.0 MAX_GRAD 0.0 /end AXIS_DESCR
/end CHARACTERISTIC
/begin CHARACTERISTIC KL_TEST_X "Testkennlinie" CURVE 0x778DE TKL_UW_VV_UW 100.0 FORMULA_0080 0.0 65535.0 FORMAT "%5.2" /begin AXIS_DESCR STD_AXIS ein_x FORMULA_0010 4 0.0 65535.0 MAX_GRAD 0.0 /end AXIS_DESCR /end CHARACTERISTIC
/begin MEASUREMENT B_DMTL_2_STABIL "zweite Strom Stabilzeit" UBYTE FORMULA_0635 0 0 0.0 255.0 READ_WRITE BIT_MASK 0x10 ECU_ADDRESS 0x3FBE5A /end MEASUREMENT
/begin MEASUREMENT B_DMTL_CLOSE_TEV "Anforderung TEV schliessen" UBYTE FORMULA_0633 0 0 0.0 255.0 READ_WRITE BIT_MASK 0x4 ECU_ADDRESS 0x3FBE5A /end MEASUREMENT
/begin MEASUREMENT B_DMTL_EXD_START "Anforderung von Diagnosetester" UBYTE FORMULA_0549 0 0 0.0 255.0 READ_WRITE BIT_MASK 0x8 ECU_ADDRESS 0x3FBE5B /end MEASUREMENT
/begin MEASUREMENT B_DMTL_H_EIN "DMTL-Heizungszustand" UBYTE FORMULA_0632 0 0 0.0 255.0 READ_WRITE BIT_MASK 0x2 ECU_ADDRESS 0x3FBE5A /end MEASUREMENT
/begin MEASUREMENT B_DMTL_KURZSCHLUSS "Pumpe hat el. Kurzschluss" UBYTE FORMULA_0634 0 0 0.0 255.0 READ_WRITE BIT_MASK 0x8 ECU_ADDRESS 0x3FBE5A /end MEASUREMENT
/begin MEASUREMENT B_DMTL_MOTORLAUFZEIT "Vorbedingung fuer Diagnose" UBYTE FORMULA_0636 0 0 0.0 255.0 READ_WRITE BIT_MASK 0x20 ECU_ADDRESS 0x3FBE5A /end MEASUREMENT
/begin MEASUREMENT B_DMTL_RUN "Diagnose laeuft gerade" UBYTE FORMULA_0637 0 0 0.0 255.0 READ_WRITE BIT_MASK 0x80 ECU_ADDRESS 0x3FBE5A /end MEASUREMENT
/begin MEASUREMENT B_DMTL_START_DECKEL "Anforderung fuer Deckelpruefung" UBYTE FORMULA_0200 0 0 0.0 255.0 READ_WRITE BIT_MASK 0x1 ECU_ADDRESS 0x3FBE5B /end MEASUREMENT
/begin MEASUREMENT B_DMTL_START_DECKEL_GROB "Anforderung Grobleckdia ohne OBD-Relevanz" UBYTE FORMULA_0550 0 0 0.0 255.0 READ_WRITE BIT_MASK 0x10 ECU_ADDRESS 0x3FBE5B /end MEASUREMENT
/begin MEASUREMENT B_DMTL_START_FEIN "Anforderung fuer Feinleckdiag" UBYTE FORMULA_0548 0 0 0.0 255.0 READ_WRITE BIT_MASK 0x4 ECU_ADDRESS 0x3FBE5B /end MEASUREMENT
/begin MEASUREMENT B_DMTL_START_GROB "Anforderung fuer Grobleckdiag" UBYTE FORMULA_0547 0 0 0.0 255.0 READ_WRITE BIT_MASK 0x2 ECU_ADDRESS 0x3FBE5B /end MEASUREMENT
/begin MEASUREMENT B_DMTL_VENTIL_FEHLER "Elektr. Ventilfehler sperrt TEV" UBYTE FORMULA_0631 0 0 0.0 255.0 READ_WRITE BIT_MASK 0x1 ECU_ADDRESS 0x3FBE5A /end MEASUREMENT
/begin MEASUREMENT B_TE_ABBR "Abbruch SPUELEN" UWORD FORMULA_1137 0 0 0.0 255.0 READ_WRITE BIT_MASK 0x8 ECU_ADDRESS 0x3FCF6C /end MEASUREMENT
/begin MEASUREMENT B_TE_BEGR_LAM_DELTA_b1 "Lambda Soll-Ist Abweichung Begrenzung" UBYTE FORMULA_1126 0 0 0.0 255.0 READ_WRITE BIT_MASK 0x4 ECU_ADDRESS 0x3FCEE8 /end MEASUREMENT
/begin MEASUREMENT B_TE_BEGR_LAM_DELTA_b2 "Lambda Soll-Ist Abweichung Begrenzung" UBYTE FORMULA_1126 0 0 0.0 255.0 READ_WRITE BIT_MASK 0x4 ECU_ADDRESS 0x3FCEE9 /end MEASUREMENT
/begin MEASUREMENT B_TE_BEGR_LAM_REG_b1 "Lambda Regler Begrenzung" UBYTE FORMULA_1124 0 0 0.0 255.0 READ_WRITE BIT_MASK 0x1 ECU_ADDRESS 0x3FCEE8 /end MEASUREMENT
/begin MEASUREMENT B_TE_BEGR_LAM_REG_b2 "Lambda Regler Begrenzung" UBYTE FORMULA_1124 0 0 0.0 255.0 READ_WRITE BIT_MASK 0x1 ECU_ADDRESS 0x3FCEE9 /end MEASUREMENT
/begin MEASUREMENT B_TE_BEGR_TI_MIN_b1 "TI-min Begrenzung" UBYTE FORMULA_1125 0 0 0.0 255.0 READ_WRITE BIT_MASK 0x2 ECU_ADDRESS 0x3FCEE8 /end MEASUREMENT
/begin MEASUREMENT B_TE_BEGR_TI_MIN_b2 "TI-min Begrenzung" UBYTE FORMULA_1125 0 0 0.0 255.0 READ_WRITE BIT_MASK 0x2 ECU_ADDRESS 0x3FCEE9 /end MEASUREMENT
/begin MEASUREMENT B_TE_C_AKF_ADAPT_B1 "C-AKF einadaptiert - Bank1" UWORD FORMULA_1149 0 0 0.0 255.0 READ_WRITE BIT_MASK 0x4000 ECU_ADDRESS 0x3FCF6C /end MEASUREMENT
/begin MEASUREMENT B_TE_C_AKF_ADAPT_B2 "C-AKF einadaptiert - Bank2" UWORD FORMULA_1150 0 0 0.0 255.0 READ_WRITE BIT_MASK 0x8000 ECU_ADDRESS 0x3FCF6C /end MEASUREMENT
/begin MEASUREMENT B_TE_DIAG_SH_TO_UB_B1 "TEV wegen KS_TO_UB sperren" UWORD FORMULA_1147 0 0 0.0 255.0 READ_WRITE BIT_MASK 0x1000 ECU_ADDRESS 0x3FCF6C /end MEASUREMENT
/begin MEASUREMENT B_TE_DIAG_SH_TO_UB_B2 "TEV wegen KS_TO_UB sperren" UWORD FORMULA_1148 0 0 0.0 255.0 READ_WRITE BIT_MASK 0x2000 ECU_ADDRESS 0x3FCF6C /end MEASUREMENT
/begin MEASUREMENT B_TE_LANG "Bedingungen fuer Lang Spuelen" UWORD FORMULA_1139 0 0 0.0 255.0 READ_WRITE BIT_MASK 0x20 ECU_ADDRESS 0x3FCF6C /end MEASUREMENT
/begin MEASUREMENT B_TE_N_STAT_B1 "n-Stationaer Bank1" UWORD FORMULA_1140 0 0 0.0 255.0 READ_WRITE BIT_MASK 0x40 ECU_ADDRESS 0x3FCF6C /end MEASUREMENT
/begin MEASUREMENT B_TE_N_STAT_B2 "n-Stationaer Bank2" UWORD FORMULA_1141 0 0 0.0 255.0 READ_WRITE BIT_MASK 0x80 ECU_ADDRESS 0x3FCF6C /end MEASUREMENT
/begin MEASUREMENT B_TE_NOTSPUELEN_B1 "NOTLAUF-SPUELEN Bank1" UWORD FORMULA_1135 0 0 0.0 255.0 READ_WRITE BIT_MASK 0x2 ECU_ADDRESS 0x3FCF6C /end MEASUREMENT
/begin MEASUREMENT B_TE_NOTSPUELEN_B2 "NOTLAUF-SPUELEN Bank2" UWORD FORMULA_1136 0 0 0.0 255.0 READ_WRITE BIT_MASK 0x4 ECU_ADDRESS 0x3FCF6C /end MEASUREMENT
/begin MEASUREMENT B_TE_RF_STAT_B1 "rf-Stationaer Bank1" UWORD FORMULA_1142 0 0 0.0 255.0 READ_WRITE BIT_MASK 0x100 ECU_ADDRESS 0x3FCF6C /end MEASUREMENT
/begin MEASUREMENT B_TE_RF_STAT_B2 "rf-Stationaer Bank2" UWORD FORMULA_1143 0 0 0.0 255.0 READ_WRITE BIT_MASK 0x200 ECU_ADDRESS 0x3FCF6C /end MEASUREMENT
/begin MEASUREMENT B_TE_STAT "Alles stationaer fuer TE_C_AKF_LERN" UWORD FORMULA_1146 0 0.0 0.0 65535.0 READ_WRITE BIT_MASK 0xFC0 ECU_ADDRESS 0x3FCF6C /end MEASUREMENT
/begin MEASUREMENT B_TE_STOP "STOP-SPUELEN" UWORD FORMULA_1138 0 0 0.0 255.0 READ_WRITE BIT_MASK 0x10 ECU_ADDRESS 0x3FCF6C /end MEASUREMENT
/begin MEASUREMENT B_TE_VAN_STAT_B1 "VAN-Stationaer Bank1" UWORD FORMULA_1144 0 0 0.0 255.0 READ_WRITE BIT_MASK 0x400 ECU_ADDRESS 0x3FCF6C /end MEASUREMENT
/begin MEASUREMENT B_TE_VAN_STAT_B2 "VAN-Stationaer Bank2" UWORD FORMULA_1145 0 0 0.0 255.0 READ_WRITE BIT_MASK 0x800 ECU_ADDRESS 0x3FCF6C /end MEASUREMENT
/begin MEASUREMENT B_TE_ZUL "TE zulaessig" UWORD FORMULA_1134 0 0 0.0 255.0 READ_WRITE BIT_MASK 0x1 ECU_ADDRESS 0x3FCF6C /end MEASUREMENT
/begin MEASUREMENT cfg_boot_st "Bootstaus" ULONG FORMULA_0000 0 0.0 0.0 4294967295.0 READ_WRITE ECU_ADDRESS 0x3F8010 /end MEASUREMENT
/begin MEASUREMENT dmtl_anz_deckel "Anzahl durchgefuehrter Deckeldiagnoseversuche" UBYTE FORMULA_0545 0 0.0 0.0 255.0 READ_WRITE ECU_ADDRESS 0x3FBE50 /end MEASUREMENT
/begin MEASUREMENT dmtl_asc_ay "Querbeschleunigung bei KL15 aktiv" SWORD FORMULA_0123 0 0.0 -20.0 20.0 READ_WRITE ECU_ADDRESS 0x3FBE52 /end MEASUREMENT
/begin MEASUREMENT dmtl_exd_h_st "Status externe Heizungs-Ansteuerung" UBYTE FORMULA_0630 0 0.0 0.0 255.0 READ_WRITE ECU_ADDRESS 0x3FBE58 /end MEASUREMENT
/begin MEASUREMENT dmtl_exd_h_timeout "externe Heizungs-Ansteuerung Timeout " UBYTE FORMULA_0461 0 0.0 0.0 25.5 READ_WRITE ECU_ADDRESS 0x3FBE59 /end MEASUREMENT
/begin MEASUREMENT dmtl_exd_p_st "Status externe Pumpen-Ansteuerung" UBYTE FORMULA_0630 0 0.0 0.0 255.0 READ_WRITE ECU_ADDRESS 0x3FBE54 /end MEASUREMENT
/begin MEASUREMENT dmtl_exd_p_timeout "externe Pumpen-Ansteuerung Timeout" UBYTE FORMULA_0461 0 0.0 0.0 25.5 READ_WRITE ECU_ADDRESS 0x3FBE55 /end MEASUREMENT
/begin MEASUREMENT dmtl_exd_v_st "Status externe Ventil-Ansteuerung" UBYTE FORMULA_0630 0 0.0 0.0 255.0 READ_WRITE ECU_ADDRESS 0x3FBE56 /end MEASUREMENT
/begin MEASUREMENT dmtl_exd_v_timeout "externe Ventil-Ansteuerung Timeout" UBYTE FORMULA_0461 0 0.0 0.0 25.5 READ_WRITE ECU_ADDRESS 0x3FBE57 /end MEASUREMENT
/begin MEASUREMENT dmtl_flags "Flags der DMTL" UBYTE FORMULA_0003 0 0.0 0.0 255.0 READ_WRITE ECU_ADDRESS 0x3FBE5A /end MEASUREMENT
/begin MEASUREMENT dmtl_flags_start "Startbedingungen der DMTL" UBYTE FORMULA_0003 0 0.0 0.0 255.0 READ_WRITE ECU_ADDRESS 0x3FBE5B /end MEASUREMENT
/begin MEASUREMENT dmtl_fst "Verwendeter Fuellstand fuer Diagnose" UBYTE FORMULA_0559 0 0.0 0.0 127.5 READ_WRITE ECU_ADDRESS 0x3FBE5C /end MEASUREMENT
/begin MEASUREMENT dmtl_fst_max "Max. zul. Fuellstand fuer Diagnose" UBYTE FORMULA_0559 0 0.0 0.0 127.5 READ_WRITE ECU_ADDRESS 0x3FBE5D /end MEASUREMENT
/begin MEASUREMENT dmtl_i "DMTL Strom korrigiert" UWORD FORMULA_0553 0 0.0 0.0 147.4537048339844 READ_WRITE ECU_ADDRESS 0x3FBE5E /end MEASUREMENT
/begin MEASUREMENT dmtl_i_deckel "DMTL korrigierter Strom Deckeldia" UWORD FORMULA_0553 0 0.0 0.0 147.4537048339844 READ_WRITE ECU_ADDRESS 0x3FBE60 /end MEASUREMENT
/begin MEASUREMENT dmtl_i_fakt_fein "DMTL Faktor Referenzstrom fuer Feinleck" UBYTE FORMULA_0638 0 0.0 0.0 1.99210000038147 READ_WRITE ECU_ADDRESS 0x3FBE62 /end MEASUREMENT
/begin MEASUREMENT dmtl_i_filt_tank "DMTL Strom korr. und gefiltert fuer Betankung" UWORD FORMULA_0553 0 0.0 0.0 147.4537048339844 READ_WRITE ECU_ADDRESS 0x3FBE64 /end MEASUREMENT
/begin MEASUREMENT dmtl_i_filt_tank.rest "DMTL Strom korr. Filter-Rest fuer Betankung" UWORD FORMULA_0639 0 0.0 0.0 2.249900102615356 READ_WRITE ECU_ADDRESS 0x3FBE66 /end MEASUREMENT
/begin MEASUREMENT dmtl_i_grob "DMTL korrigierter Strom Grobleckdia" UWORD FORMULA_0553 0 0.0 0.0 147.4537048339844 READ_WRITE ECU_ADDRESS 0x3FBE68 /end MEASUREMENT
/begin MEASUREMENT dmtl_i_max "DMTL Strom Maximalwert" UWORD FORMULA_0553 0 0.0 0.0 147.4537048339844 READ_WRITE ECU_ADDRESS 0x3FBE6A /end MEASUREMENT
/begin MEASUREMENT dmtl_i_ref_korr "DMTL korrigierter Strom Referenzleck" UWORD FORMULA_0553 0 0.0 0.0 147.4537048339844 READ_WRITE ECU_ADDRESS 0x3FBE6E /end MEASUREMENT
/begin MEASUREMENT dmtl_i_ref2 "DMTL Strom Referenzleck" UWORD FORMULA_0553 0 0.0 0.0 147.4537048339844 READ_WRITE ECU_ADDRESS 0x3FBE6C /end MEASUREMENT
/begin MEASUREMENT dmtl_i_roh "DMTL Strom roh" UWORD FORMULA_0553 0 0.0 0.0 147.4537048339844 READ_WRITE ECU_ADDRESS 0x3FBE70 /end MEASUREMENT
/begin MEASUREMENT dmtl_i_stabil "DMTL stabiler Strom" UWORD FORMULA_0553 0 0.0 0.0 147.4537048339844 READ_WRITE ECU_ADDRESS 0x3FBE72 /end MEASUREMENT
/begin MEASUREMENT dmtl_korr_fakt "Korrekturfaktor Strom ueber Spannung" UWORD FORMULA_0073 0 0.0 0.0 2.0 READ_WRITE ECU_ADDRESS 0x3FBE74 /end MEASUREMENT
/begin MEASUREMENT dmtl_st "Betriebszustand" UBYTE FORMULA_0555 0 0.0 0.0 255.0 READ_WRITE ECU_ADDRESS 0x3FBE76 /end MEASUREMENT
/begin MEASUREMENT dmtl_t_cc_dauer "Dauer Deckelmeldung seit Losfahren" UWORD FORMULA_0071 0 0.0 0.0 6553.5 READ_WRITE ECU_ADDRESS 0x3FBE78 /end MEASUREMENT
/begin MEASUREMENT dmtl_t_deckel "DMTL Deckelmessdauer" UWORD FORMULA_0071 0 0.0 0.0 6553.5 READ_WRITE ECU_ADDRESS 0x3FBE7C /end MEASUREMENT
/begin MEASUREMENT dmtl_t_fein_min "DMTL min. Feinleckdauer" UWORD FORMULA_0071 0 0.0 0.0 6553.5 READ_WRITE ECU_ADDRESS 0x3FBE7E /end MEASUREMENT
/begin MEASUREMENT dmtl_t_feucht_dly "DMTL Startverzoegerung nach Feuchteabbruch" UWORD FORMULA_0071 0 0.0 0.0 6553.5 READ_WRITE ECU_ADDRESS 0x3FBE80 /end MEASUREMENT
/begin MEASUREMENT dmtl_t_grob "DMTL Grobleckdauer" UWORD FORMULA_0071 0 0.0 0.0 6553.5 READ_WRITE ECU_ADDRESS 0x3FBE7A /end MEASUREMENT
/begin MEASUREMENT dmtl_t_i_filt_beg "Timer fuer schnelle Stromfilterung nach Ventil schalten" UBYTE FORMULA_0461 0 0.0 0.0 25.5 READ_WRITE ECU_ADDRESS 0x3FBE82 /end MEASUREMENT
/begin MEASUREMENT dmtl_t_ks "DMTL Kurzschlusszeit" UBYTE FORMULA_0640 0 0.0 0.0 127.5 READ_WRITE ECU_ADDRESS 0x3FBE83 /end MEASUREMENT
/begin MEASUREMENT dmtl_t_ref "DMTL aktuelle Referenzmeßdauer" UBYTE FORMULA_0461 0 0.0 0.0 25.5 READ_WRITE ECU_ADDRESS 0x3FBE84 /end MEASUREMENT
/begin MEASUREMENT dmtl_t_stabil "DMTL Zeit seit Strom stabil" UWORD FORMULA_0071 0 0.0 0.0 6553.5 READ_WRITE ECU_ADDRESS 0x3FBE86 /end MEASUREMENT
/begin MEASUREMENT dmtl_t_stabil_max "max. DMTL Zeit fuer Strom stabil" UWORD FORMULA_0071 0 0.0 0.0 6553.5 READ_WRITE ECU_ADDRESS 0x3FBE88 /end MEASUREMENT
/begin MEASUREMENT dmtl_t_start_dly "DMTL Startverzoegerung nach KLA" UBYTE FORMULA_0461 0 0.0 0.0 25.5 READ_WRITE ECU_ADDRESS 0x3FBE8A /end MEASUREMENT
/begin MEASUREMENT dmtl_ub_filt "DMTL Gefilterte UB" SWORD FORMULA_0261 0 0.0 0.0 28.0 READ_WRITE ECU_ADDRESS 0x3FBE8C /end MEASUREMENT
/begin MEASUREMENT dmtl_ub_ref "DMTL Gefilterte UB bei Referenzmessung" SWORD FORMULA_0008 0 0.0 0.0 28.0 READ_WRITE ECU_ADDRESS 0x3FBE8E /end MEASUREMENT
/begin MEASUREMENT ml_slp_b1 "Sekund. Pumpe" SWORD FORMULA_0103 0 0.0 -100.0 1400.0 READ_WRITE ECU_ADDRESS 0x3FCE56 /end MEASUREMENT
/begin MEASUREMENT ml_slp_b2 "Sekund. Pumpe" SWORD FORMULA_0103 0 0.0 -100.0 1400.0 READ_WRITE ECU_ADDRESS 0x3FCE58 /end MEASUREMENT
/begin MEASUREMENT schalter_bls_ad_inj "Eingelesener Spannungswert Bremslichtschalter" SWORD FORMULA_0114 0 0.0 0.0 1023.0 READ_WRITE ECU_ADDRESS 0x3FCDD4 /end MEASUREMENT
/begin MEASUREMENT schalter_diag_poel_n_delay "Delay fuer n == 0 bei S_POEL-Diagnose" UWORD FORMULA_0668 0 0.0 0.0 6553500.0 READ_WRITE ECU_ADDRESS 0x3FCDDC /end MEASUREMENT
/begin MEASUREMENT schalter_getr "nullpunktadaptierter Spannungswert vom Getriebeschalter" SWORD FORMULA_0114 0 0.0 0.0 1023.0 READ_WRITE ECU_ADDRESS 0x3FCDE4 /end MEASUREMENT
/begin MEASUREMENT schalter_getr_a0 "Nullpunktadaptionswert vom Getriebeschalter" SWORD FORMULA_0114 0 0.0 0.0 1023.0 READ_WRITE ECU_ADDRESS 0x3FCDE2 /end MEASUREMENT
/begin MEASUREMENT schalter_getr_ad "Eingelesener Spannungswert vom Getriebeschalter" SWORD FORMULA_0114 0 0.0 0.0 1023.0 READ_WRITE ECU_ADDRESS 0x3FCDDE /end MEASUREMENT
/begin MEASUREMENT schalter_getr_diag_timer "Diagnosetimer Getriebeleergassenschalter" UWORD FORMULA_0071 0 0.0 0.0 6553.5 READ_WRITE ECU_ADDRESS 0x3FCDE8 /end MEASUREMENT
/begin MEASUREMENT schalter_getr_fil "gefilterter Spannungswert vom Getriebeschalter" SWORD FORMULA_0114 0 0.0 0.0 1023.0 READ_WRITE ECU_ADDRESS 0x3FCDE0 /end MEASUREMENT
/begin MEASUREMENT schalter_getr_n_verh_fil "Getriebe Eingangsdrehzahl / Abtriebsdrehzahl gefiltert" SWORD FORMULA_0073 0 0.0 -32.0 31.99900054931641 READ_WRITE ECU_ADDRESS 0x3FCDE6 /end MEASUREMENT
/begin MEASUREMENT schalter_ks_alt "alter Schalterzustand Kraftschluss" UWORD FORMULA_1080 0 0 0.0 255.0 READ_WRITE BIT_MASK 0x200 ECU_ADDRESS 0x3FCDF4 /end MEASUREMENT
/begin MEASUREMENT schalter_ks_dn "Delta Motordrehzahl" SWORD FORMULA_0006 0 0.0 -10000.0 10000.0 READ_WRITE ECU_ADDRESS 0x3FCDF8 /end MEASUREMENT
/begin MEASUREMENT schalter_ks_md_eff "effektives Wunschmoment fuer Kraftschluss" SWORD FORMULA_0009 0 0.0 -100.0 1000.0 READ_WRITE ECU_ADDRESS 0x3FCDF6 /end MEASUREMENT
/begin MEASUREMENT schalter_ks_n_diff "Drehzahldifferenz Motor - Getriebeeingang" SWORD FORMULA_0006 0 0.0 0.0 10000.0 READ_WRITE ECU_ADDRESS 0x3FCDFE /end MEASUREMENT
/begin MEASUREMENT schalter_ks_n_diff_ref "Abstand zur Referenzdrehzahl" SWORD FORMULA_0006 0 0.0 -10000.0 10000.0 READ_WRITE ECU_ADDRESS 0x3FCDFC /end MEASUREMENT
/begin MEASUREMENT schalter_ks_n_diff_timer "Timer Drehzahldifferenz Kraftschluss" UWORD FORMULA_0021 0 0.0 0.0 655.0 READ_WRITE ECU_ADDRESS 0x3FCE00 /end MEASUREMENT
/begin MEASUREMENT schalter_ks_n_hys_timer "Timer Hysterese Drehzahldifferenz Kraftschluss" UWORD FORMULA_0021 0 0.0 0.0 655.0 READ_WRITE ECU_ADDRESS 0x3FCE02 /end MEASUREMENT
/begin MEASUREMENT schalter_ks_n_ref "Referenzdrehzahl" SWORD FORMULA_0006 0 0.0 0.0 10000.0 READ_WRITE ECU_ADDRESS 0x3FCDFA /end MEASUREMENT
/begin MEASUREMENT schalter_ks_schalt_timer "Timer Schaltung" UWORD FORMULA_0021 0 0.0 0.0 655.0 READ_WRITE ECU_ADDRESS 0x3FCE04 /end MEASUREMENT
/begin MEASUREMENT schalter_kupp_ad "Eingelesener Spannungswert vom Kupplungsschalter" SWORD FORMULA_0114 0 0.0 0.0 1023.0 READ_WRITE ECU_ADDRESS 0x3FCDEA /end MEASUREMENT
/begin MEASUREMENT schalter_kupp_diag "Status Kupplungsschalter" UWORD FORMULA_1078 0 0 0.0 255.0 READ_WRITE BIT_MASK 0x2 ECU_ADDRESS 0x3FCDEC /end MEASUREMENT
/begin MEASUREMENT schalter_kupp_diag_scharf "Diagnose Kupplungsschalter scharf" UBYTE FORMULA_1079 0 0.0 0.0 255.0 READ_WRITE ECU_ADDRESS 0x3FCDF0 /end MEASUREMENT
/begin MEASUREMENT schalter_kupp_diag_timer "Diagnosetimer Kupplungsschalter" UWORD FORMULA_0071 0 0.0 0.0 6553.5 READ_WRITE ECU_ADDRESS 0x3FCDF2 /end MEASUREMENT
/begin MEASUREMENT schalter_kupp_diag_verz "Status Kupplungsschalter verzoegert" UWORD FORMULA_1078 0 0 0.0 255.0 READ_WRITE BIT_MASK 0x2 ECU_ADDRESS 0x3FCDEE /end MEASUREMENT
/begin MEASUREMENT schalter_poel_ad "Eingelesener Spannungswert vom Oeldruckschalter" SWORD FORMULA_0114 0 0.0 0.0 1023.0 READ_WRITE ECU_ADDRESS 0x3FCDD8 /end MEASUREMENT
/begin MEASUREMENT schalter_poel_time "Diagnosezeit" UWORD FORMULA_0021 0 0.0 0.0 655.0 READ_WRITE ECU_ADDRESS 0x3FCDDA /end MEASUREMENT
/begin MEASUREMENT schalter_sport_ad "Eingelesener Spannungswert vom Sporttaster" SWORD FORMULA_0114 0 0.0 0.0 1023.0 READ_WRITE ECU_ADDRESS 0x3FCDD6 /end MEASUREMENT
/begin MEASUREMENT schalter_st_inj_old "schalter_st_inj_old" UWORD FORMULA_0080 0 0.0 0.0 65535.0 READ_WRITE ARRAY_SIZE 2 ECU_ADDRESS 0x3FCDCE MATRIX_DIM 2 1 1 /end MEASUREMENT
/begin MEASUREMENT schalter_wakeup_ad_inj "Eingelesener Spannungswert Wakeup" SWORD FORMULA_0114 0 0.0 0.0 1023.0 READ_WRITE ECU_ADDRESS 0x3FCDD2 /end MEASUREMENT
/begin MEASUREMENT servo_abschalt_inj "Notabschaltung Servotronic" UBYTE FORMULA_1083 0 0.0 0.0 255.0 READ_WRITE ECU_ADDRESS 0x3FCE06 /end MEASUREMENT
/begin MEASUREMENT sk_e2_byte "Counter Byte-Komplement" UBYTE FORMULA_0003 0 0.0 0.0 255.0 READ_WRITE ECU_ADDRESS 0x3FD60C /end MEASUREMENT
/begin MEASUREMENT sk_e2_byte_err "Fehler Byte-Komplement" UBYTE FORMULA_0003 0 0.0 0.0 255.0 READ_WRITE ECU_ADDRESS 0x3FD60F /end MEASUREMENT
/begin MEASUREMENT sk_e2_fehler "aktueller Ebene2-Fehler" UWORD FORMULA_0374 0 0.0 0.0 65535.0 READ_WRITE ECU_ADDRESS 0x3FE762 /end MEASUREMENT
/begin MEASUREMENT sk_e2_komp_err "Anzahl der Komplement-Fehler" UBYTE FORMULA_0003 0 0.0 0.0 255.0 READ_WRITE ECU_ADDRESS 0x3FD612 /end MEASUREMENT
/begin MEASUREMENT sk_e2_long "Counter Long-Komplement" UBYTE FORMULA_0003 0 0.0 0.0 255.0 READ_WRITE ECU_ADDRESS 0x3FD60E /end MEASUREMENT
/begin MEASUREMENT sk_e2_long_err "Fehler Long-Komplement" UBYTE FORMULA_0003 0 0.0 0.0 255.0 READ_WRITE ECU_ADDRESS 0x3FD611 /end MEASUREMENT
/begin MEASUREMENT sk_e2_word "Counter Word-Komplement" UBYTE FORMULA_0003 0 0.0 0.0 255.0 READ_WRITE ECU_ADDRESS 0x3FD60D /end MEASUREMENT
/begin MEASUREMENT sk_e2_word_err "Fehler Word-Komplement" UBYTE FORMULA_0003 0 0.0 0.0 255.0 READ_WRITE ECU_ADDRESS 0x3FD610 /end MEASUREMENT
/begin MEASUREMENT sk_egas_off_ni "SK-Egasstufe - no Init" UBYTE FORMULA_0167 0 0.0 0.0 255.0 READ_WRITE ECU_ADDRESS 0x3FE760 /end MEASUREMENT
/begin MEASUREMENT sk_egas_off_time_b1 "Zeit bis Egasabschaltung" UWORD FORMULA_0021 0 0.0 0.0 5.0 READ_WRITE ECU_ADDRESS 0x3FCE18 /end MEASUREMENT
/begin MEASUREMENT sk_egas_off_time_b2 "Zeit bis Egasabschaltung" UWORD FORMULA_0021 0 0.0 0.0 5.0 READ_WRITE ECU_ADDRESS 0x3FCE1A /end MEASUREMENT
/begin MEASUREMENT sk_fail_st_zyl "Zusammenfassung Ausblender" UWORD FORMULA_0179 0 0.0 0.0 65535.0 READ_WRITE ECU_ADDRESS 0x3FCE08 /end MEASUREMENT
/begin MEASUREMENT sk_fm_egas_exd "Abschaltung ueber Exd" UBYTE FORMULA_0367 0 0.0 0.0 255.0 READ_WRITE ECU_ADDRESS 0x3FCE0C /end MEASUREMENT
/begin MEASUREMENT sk_fm_gemisch "Eingang Gemisch-Matrix" UBYTE FORMULA_0167 0 0.0 0.0 255.0 READ_WRITE ECU_ADDRESS 0x3FCE0A /end MEASUREMENT
/begin MEASUREMENT sk_fm_lam "Eingang LAM-Matrix" UBYTE FORMULA_0167 0 0.0 0.0 255.0 READ_WRITE ARRAY_SIZE 2 ECU_ADDRESS 0x3FCE11 MATRIX_DIM 2 1 1 /end MEASUREMENT
/begin MEASUREMENT sk_fm_ti "Eingang TI-Matrix" UBYTE FORMULA_0167 0 0.0 0.0 255.0 READ_WRITE ECU_ADDRESS 0x3FCE0B /end MEASUREMENT
/begin MEASUREMENT sk_hw_pwg1_ad_ed_zaehler "Zaehlervariable bei fehlerhaftem AD-Wert" UBYTE FORMULA_0357 0 0.0 0.0 1.274999976158142 READ_WRITE ECU_ADDRESS 0x3FCE26 /end MEASUREMENT
/begin MEASUREMENT sk_hw_pwg1_ad_mode "Zustand der AD-Wandler PWG1-Erfassung" UBYTE FORMULA_1084 0 0.0 0.0 255.0 READ_WRITE ECU_ADDRESS 0x3FCE27 /end MEASUREMENT
/begin MEASUREMENT sk_hw_pwg1m_ad_alt "AD-Wandlerwert PWG1 des Masterprozessors vor 10ms" SWORD FORMULA_0114 0 0.0 0.0 1023.0 READ_WRITE ECU_ADDRESS 0x3FCE20 /end MEASUREMENT
/begin MEASUREMENT sk_hw_pwg1m_ad_zaehler "Zaehlervariable fuer Stationaerbetrieb PWG1-Master" UBYTE FORMULA_0357 0 0.0 0.0 1.274999976158142 READ_WRITE ECU_ADDRESS 0x3FCE24 /end MEASUREMENT
/begin MEASUREMENT sk_hw_pwg1s_ad_alt "AD-Wandlerwert PWG1 des Slaveprozessors vor 10ms" SWORD FORMULA_0114 0 0.0 0.0 1023.0 READ_WRITE ECU_ADDRESS 0x3FCE22 /end MEASUREMENT
/begin MEASUREMENT sk_hw_pwg1s_ad_zaehler "Zaehlervariable fuer Stationaerbetrieb PWG1-Slave" UBYTE FORMULA_0357 0 0.0 0.0 1.274999976158142 READ_WRITE ECU_ADDRESS 0x3FCE25 /end MEASUREMENT
/begin MEASUREMENT sk_md_begr_ni "SK-Begrenzungsstufe - no Init" UBYTE FORMULA_0167 0 0.0 0.0 255.0 READ_WRITE ECU_ADDRESS 0x3FE75F /end MEASUREMENT
/begin MEASUREMENT sk_md_begr_st "Ausloeser MD-Begrenzung" UWORD FORMULA_0011 0 0.0 0.0 65535.0 READ_WRITE ECU_ADDRESS 0x3FCE14 /end MEASUREMENT
/begin MEASUREMENT sk_reset_cnt "Resetzaehler seit Kl15 ein" UBYTE FORMULA_0003 0 0.0 0.0 10.0 READ_WRITE ECU_ADDRESS 0x3FE75E /end MEASUREMENT
/begin MEASUREMENT sk_reset_cnt_e2 "Resetzaehler Ebene 2" UBYTE FORMULA_0003 0 0.0 0.0 10.0 READ_WRITE ECU_ADDRESS 0x3FE764 /end MEASUREMENT
/begin MEASUREMENT sk_t_reset_delay_os "Timer fuer Verzoegerung sk_reset bei OS Fehlern" UWORD FORMULA_0021 0 0.0 0.0 655.0 READ_WRITE ECU_ADDRESS 0x3FCE1E /end MEASUREMENT
/begin MEASUREMENT sk_ti_off_st "Ausloeser TI-Abschaltung" UWORD FORMULA_0011 0 0.0 0.0 65535.0 READ_WRITE ECU_ADDRESS 0x3FCE16 /end MEASUREMENT
/begin MEASUREMENT sk_ti_zyl_off_cnt "Anzahl der Ausblender" UBYTE FORMULA_0003 0 0.0 0.0 12.0 READ_WRITE ECU_ADDRESS 0x3FCE1C /end MEASUREMENT
/begin MEASUREMENT sk_tr_error_cnt "Fehlerzaehler Testrechnung" UBYTE FORMULA_0003 0 0.0 0.0 255.0 READ_WRITE ECU_ADDRESS 0x3FCE10 /end MEASUREMENT
/begin MEASUREMENT sk_tr_error_nr "Fehler Testrechnung" UBYTE FORMULA_0003 0 0.0 0.0 255.0 READ_WRITE ECU_ADDRESS 0x3FCE2A /end MEASUREMENT
/begin MEASUREMENT sk_tr_state "Zustand Testrechnung" UBYTE FORMULA_1085 0 0.0 0.0 255.0 READ_WRITE ECU_ADDRESS 0x3FCE29 /end MEASUREMENT
/begin MEASUREMENT sk_tr_timeout "Timeout - keine Antwort auf TR" UBYTE FORMULA_0461 0 0.0 0.0 25.5 READ_WRITE ECU_ADDRESS 0x3FCE2B /end MEASUREMENT
/begin MEASUREMENT sk_tr_wait "Wartezeit Testrechnung" UBYTE FORMULA_0461 0 0.0 0.0 25.5 READ_WRITE ECU_ADDRESS 0x3FCE28 /end MEASUREMENT
/begin MEASUREMENT sk_ursache "Urache fuer SK-Eingriff" UWORD FORMULA_0011 0 0.0 0.0 65535.0 READ_WRITE ECU_ADDRESS 0x3FE75C /end MEASUREMENT
/begin MEASUREMENT sl_lam_abg_ist "gefilterter Mittelwert Abgaslambda Bank1" UWORD FORMULA_0025 0 0.0 0.0 3.999000072479248 READ_WRITE ECU_ADDRESS 0x3FCE30 /end MEASUREMENT
/begin MEASUREMENT sl_lam_abg_ist_roh "Mittelwert Abgaslambda Bank1" UWORD FORMULA_0025 0 0.0 0.0 3.999000072479248 READ_WRITE ECU_ADDRESS 0x3FCE2E /end MEASUREMENT
/begin MEASUREMENT sl_lam_abg_soll "Soll Abgaslambda" UWORD FORMULA_0025 0 0.0 0.0 3.999000072479248 READ_WRITE ECU_ADDRESS 0x3FCE2C /end MEASUREMENT
/begin MEASUREMENT sl_lam_b2_korr "Korrekturwert Bank2 Lambda" SWORD FORMULA_0073 0 0.0 -4.0 4.0 READ_WRITE ECU_ADDRESS 0x3FCE4E /end MEASUREMENT
/begin MEASUREMENT sl_lam_mot_soll "Lambda Sollwert" UWORD FORMULA_0025 0 0.0 0.0 3.999000072479248 READ_WRITE ARRAY_SIZE 2 ECU_ADDRESS 0x3FCE4A MATRIX_DIM 2 1 1 /end MEASUREMENT
/begin MEASUREMENT sl_lam_mot_soll_roh "Lambda Sollwert roh" UWORD FORMULA_0025 0 0.0 0.0 3.999000072479248 READ_WRITE ARRAY_SIZE 2 ECU_ADDRESS 0x3FCE46 MATRIX_DIM 2 1 1 /end MEASUREMENT
/begin MEASUREMENT sl_ml_hfm_ad "AD-Wert Mini HFM" SWORD FORMULA_0114 0 0.0 0.0 1023.0 READ_WRITE ECU_ADDRESS 0x3FCE32 /end MEASUREMENT
/begin MEASUREMENT sl_ml_hfm_roh "Rohwert SLP-Luftmassenstrom" SWORD FORMULA_0103 0 0.0 -100.0 1400.0 READ_WRITE ECU_ADDRESS 0x3FCE3E /end MEASUREMENT
/begin MEASUREMENT sl_ml_ist "SLP-Luftmasseniststrom Bank1 und 2" SWORD FORMULA_0103 0 0.0 -100.0 1400.0 READ_WRITE ECU_ADDRESS 0x3FCE40 /end MEASUREMENT
/begin MEASUREMENT sl_ml_ist_lam "SLP-Luftmassenstrom gerechnet aus Abgaslambda" SWORD FORMULA_0103 0 0.0 -100.0 1400.0 READ_WRITE ECU_ADDRESS 0x3FCE3A /end MEASUREMENT
/begin MEASUREMENT sl_ml_max "Max. sekundaerer Lufmassenstrom nach rf_pt_korr" SWORD FORMULA_0103 0 0.0 -100.0 1400.0 READ_WRITE ECU_ADDRESS 0x3FCE50 /end MEASUREMENT
/begin MEASUREMENT sl_ml_max_roh "Max. sekundaerer Lufmassenstrom" SWORD FORMULA_0103 0 0.0 -100.0 1400.0 READ_WRITE ECU_ADDRESS 0x3FCE52 /end MEASUREMENT
/begin MEASUREMENT sl_ml_rel "relativer Sekundaerluftmassenstrom" SWORD FORMULA_0001 0 0.0 0.0 100.0 READ_WRITE ECU_ADDRESS 0x3FCE54 /end MEASUREMENT
/begin MEASUREMENT sl_ml_soll "Soll-SLP-Luftmassenstrom gerechnet aus Abgaslambda" SWORD FORMULA_0103 0 0.0 -100.0 1400.0 READ_WRITE ECU_ADDRESS 0x3FCE3C /end MEASUREMENT
/begin MEASUREMENT sl_reg_i "Faktor I-Anteil SL-Mengenregler" SWORD FORMULA_0199 0 0.0 -2.0 1.999899983406067 READ_WRITE ECU_ADDRESS 0x3FCE38 /end MEASUREMENT
/begin MEASUREMENT sl_reg_p "Faktor P-Anteil SL-Mengenregler" SWORD FORMULA_0199 0 0.0 -2.0 1.999899983406067 READ_WRITE ECU_ADDRESS 0x3FCE36 /end MEASUREMENT
/begin MEASUREMENT sl_regler_f "Regelfaktor fuer Vorsteuerung" UWORD FORMULA_0199 0 0.0 0.0 2.0 READ_WRITE ECU_ADDRESS 0x3FCE42 /end MEASUREMENT
/begin MEASUREMENT sl_zwd_vorst_tv "Vorsteuerungstastverh. LLS fuer SL" SWORD FORMULA_0142 0 0.0 0.0 100.0 READ_WRITE ECU_ADDRESS 0x3FCE44 /end MEASUREMENT
/begin MEASUREMENT slp_pabg_dif_max "Abgasgegendruck gefiltert" SWORD FORMULA_0075 0 0.0 0.0 1000.0 READ_WRITE ECU_ADDRESS 0x3FCE5A /end MEASUREMENT
/begin MEASUREMENT sls_exd_st_pl "Externer Ansteuerungsstatus Prueflauf" UBYTE FORMULA_1114 0 0.0 0.0 255.0 READ_WRITE ECU_ADDRESS 0x3FCE92 /end MEASUREMENT
/begin MEASUREMENT sls_obd_abbruch_st "SLS-OBD Abbruchstatus" UWORD FORMULA_1095 0 0.0 0.0 65535.0 READ_WRITE ECU_ADDRESS 0x3FCE76 /end MEASUREMENT
/begin MEASUREMENT sls_obd_abbruch_st_ende "Diagnose abgelaufen" UWORD FORMULA_1111 0 0 0.0 255.0 READ_WRITE BIT_MASK 0x8000 ECU_ADDRESS 0x3FCE76 /end MEASUREMENT
/begin MEASUREMENT sls_obd_abbruch_st_ext_fehler "Fehler aus einem externen Modul" UWORD FORMULA_1102 0 0 0.0 255.0 READ_WRITE BIT_MASK 0x40 ECU_ADDRESS 0x3FCE76 /end MEASUREMENT
/begin MEASUREMENT sls_obd_abbruch_st_ml_max "Luftmasser ueberschritten" UWORD FORMULA_1097 0 0 0.0 255.0 READ_WRITE BIT_MASK 0x2 ECU_ADDRESS 0x3FCE76 /end MEASUREMENT
/begin MEASUREMENT sls_obd_abbruch_st_ml_min "Luftmasse unterschritten" UWORD FORMULA_1105 0 0 0.0 255.0 READ_WRITE BIT_MASK 0x200 ECU_ADDRESS 0x3FCE76 /end MEASUREMENT
/begin MEASUREMENT sls_obd_abbruch_st_ml_verh "Luftmasserverhaeltniss zu gering" UWORD FORMULA_1106 0 0 0.0 255.0 READ_WRITE BIT_MASK 0x400 ECU_ADDRESS 0x3FCE76 /end MEASUREMENT
/begin MEASUREMENT sls_obd_abbruch_st_n_max "N ueberschritten" UWORD FORMULA_1096 0 0 0.0 255.0 READ_WRITE BIT_MASK 0x1 ECU_ADDRESS 0x3FCE76 /end MEASUREMENT
/begin MEASUREMENT sls_obd_abbruch_st_n_min "n unterschritten" UWORD FORMULA_1103 0 0 0.0 255.0 READ_WRITE BIT_MASK 0x80 ECU_ADDRESS 0x3FCE76 /end MEASUREMENT
/begin MEASUREMENT sls_obd_abbruch_st_pu_sau_min "Saugrohrunterdruck zu gering um ASV zu oeffnen" UWORD FORMULA_1110 0 0 0.0 255.0 READ_WRITE BIT_MASK 0x4000 ECU_ADDRESS 0x3FCE76 /end MEASUREMENT
/begin MEASUREMENT sls_obd_abbruch_st_pumg "pumg ueberschritten" UWORD FORMULA_1107 0 0 0.0 255.0 READ_WRITE BIT_MASK 0x800 ECU_ADDRESS 0x3FCE76 /end MEASUREMENT
/begin MEASUREMENT sls_obd_abbruch_st_restl "Wiederholstart" UWORD FORMULA_1101 0 0 0.0 255.0 READ_WRITE BIT_MASK 0x20 ECU_ADDRESS 0x3FCE76 /end MEASUREMENT
/begin MEASUREMENT sls_obd_abbruch_st_rf_max "rf ueberschritten" UWORD FORMULA_1108 0 0 0.0 255.0 READ_WRITE BIT_MASK 0x1000 ECU_ADDRESS 0x3FCE76 /end MEASUREMENT
/begin MEASUREMENT sls_obd_abbruch_st_rf_min "rf unterschritten" UWORD FORMULA_1104 0 0 0.0 255.0 READ_WRITE BIT_MASK 0x100 ECU_ADDRESS 0x3FCE76 /end MEASUREMENT
/begin MEASUREMENT sls_obd_abbruch_st_slp "SLP noch nicht angelaufen fur SLS-OBD" UWORD FORMULA_1100 0 0 0.0 255.0 READ_WRITE BIT_MASK 0x10 ECU_ADDRESS 0x3FCE76 /end MEASUREMENT
/begin MEASUREMENT sls_obd_abbruch_st_t_sa "SA Zeit ueberschritten" UWORD FORMULA_1109 0 0 0.0 255.0 READ_WRITE BIT_MASK 0x2000 ECU_ADDRESS 0x3FCE76 /end MEASUREMENT
/begin MEASUREMENT sls_obd_abbruch_st_tmot "Tmot zu niedrig" UWORD FORMULA_1098 0 0 0.0 255.0 READ_WRITE BIT_MASK 0x4 ECU_ADDRESS 0x3FCE76 /end MEASUREMENT
/begin MEASUREMENT sls_obd_abbruch_st_ub "ub zu gering" UWORD FORMULA_1099 0 0 0.0 255.0 READ_WRITE BIT_MASK 0x8 ECU_ADDRESS 0x3FCE76 /end MEASUREMENT
/begin MEASUREMENT sls_obd_dyn_grad "Dynamik Grad fuer ml" SWORD FORMULA_1113 0 0.0 -3276.800048828125 3276.699951171875 READ_WRITE ECU_ADDRESS 0x3FCE8E /end MEASUREMENT
/begin MEASUREMENT sls_obd_max "min-Wert Speicher fuer die versch. Diagnosestates" SWORD FORMULA_0114 0 0.0 0.0 1023.0 READ_WRITE ECU_ADDRESS 0x3FCE5C /end MEASUREMENT
/begin MEASUREMENT sls_obd_mdl_diff_dyn "Dynamik Grad fuer ml" SWORD FORMULA_0103 0 0.0 -100.0 1400.0 READ_WRITE ECU_ADDRESS 0x3FCE90 /end MEASUREMENT
/begin MEASUREMENT sls_obd_min "min-Wert Speicher fuer die versch. Diagnosestates" SWORD FORMULA_0114 0 0.0 0.0 1023.0 READ_WRITE ECU_ADDRESS 0x3FCE5E /end MEASUREMENT
/begin MEASUREMENT sls_obd_ml_dyn "Dynamik Grad fuer ml" SWORD FORMULA_0103 0 0.0 -100.0 1400.0 READ_WRITE ECU_ADDRESS 0x3FCE8C /end MEASUREMENT
/begin MEASUREMENT sls_obd_timer "Timer der sls-OBD" UWORD FORMULA_0644 0 0.0 0.0 655.0 READ_WRITE ECU_ADDRESS 0x3FCE7A /end MEASUREMENT
/begin MEASUREMENT sls_obdh_diag_st "Diagnosestatus des SL-Systems" ULONG FORMULA_1093 0 0.0 0.0 4294967295.0 READ_WRITE ECU_ADDRESS 0x3FCE70 /end MEASUREMENT
/begin MEASUREMENT sls_obdh_diag_time_on "Time der sls-OBD Diagnoese" UWORD FORMULA_0644 0 0.0 0.0 655.0 READ_WRITE ECU_ADDRESS 0x3FCE7C /end MEASUREMENT
/begin MEASUREMENT sls_obdh_lam_asv_intg_norm "Normiertes Lam-Integral der Soll/-Istabweichung ASV" SWORD FORMULA_0570 0 0.0 -1.899999976158142 1.899999976158142 READ_WRITE ECU_ADDRESS 0x3FCE6C /end MEASUREMENT
/begin MEASUREMENT sls_obdh_lam_intg "Integral Lambdadelta zwischen B1 und B2" SLONG FORMULA_1112 0 0.0 -0.5 0.5 READ_WRITE ECU_ADDRESS 0x3FCE84 /end MEASUREMENT
/begin MEASUREMENT sls_obdh_lam_ist_fil "gefiltertes Lambda ist aus Maxauswahl B1 und B2" UWORD FORMULA_0025 0 0.0 0.0 3.999000072479248 READ_WRITE ECU_ADDRESS 0x3FCE96 /end MEASUREMENT
/begin MEASUREMENT sls_obdh_mdf_max_intg "MAX-Integral der Soll/-Istabweichung" SLONG FORMULA_1091 0 0.0 268435.455 2147483.647 READ_WRITE ECU_ADDRESS 0x3FCE60 /end MEASUREMENT
/begin MEASUREMENT sls_obdh_mdf_max_intg_norm "Normiertes Max-Integral der Soll/-Istabweichung" SWORD FORMULA_0563 0 0.0 -32.76699829101563 32.76699829101563 READ_WRITE ECU_ADDRESS 0x3FCE6A /end MEASUREMENT
/begin MEASUREMENT sls_obdh_mdf_max_intg_s16 "normiertes Max-Integral der Soll/-Istabweichung" SWORD FORMULA_1092 0 0.0 -260.0 260.0 READ_WRITE ECU_ADDRESS 0x3FCE68 /end MEASUREMENT
/begin MEASUREMENT sls_obdh_mdf_min_intg "MIN-Integral der Soll/-Istabweichung" SLONG FORMULA_1091 0 0.0 268435.455 2147483.647 READ_WRITE ECU_ADDRESS 0x3FCE64 /end MEASUREMENT
/begin MEASUREMENT sls_obdh_mdf_ml_soll "Sek.Luftmasse zur MDF" SWORD FORMULA_0103 0 0.0 -100.0 1400.0 READ_WRITE ECU_ADDRESS 0x3FCE78 /end MEASUREMENT
/begin MEASUREMENT sls_obdh_mdf_st "MDF-Fehlermatrix" UWORD FORMULA_1094 0 0.0 0.0 65535.0 READ_WRITE ECU_ADDRESS 0x3FCE74 /end MEASUREMENT
/begin MEASUREMENT sls_obdh_mdl_ml_korr "Verlustanteil aufgrund Leitungsverluste" SWORD FORMULA_0103 0 0.0 -100.0 1400.0 READ_WRITE ECU_ADDRESS 0x3FCE88 /end MEASUREMENT
/begin MEASUREMENT sls_obdh_ml_ges_fil "gefiltertes ml_ges " SWORD FORMULA_0103 0 0.0 -100.0 1400.0 READ_WRITE ECU_ADDRESS 0x3FCE98 /end MEASUREMENT
/begin MEASUREMENT sls_obdh_ml_hfm_fil "gefilterter SLP-Luftmassenstrom" SWORD FORMULA_0103 0 0.0 -100.0 1400.0 READ_WRITE ECU_ADDRESS 0x3FCE9C /end MEASUREMENT
/begin MEASUREMENT sls_obdh_ml_mdl "Modellierter SL-Luftmassenstrom" SWORD FORMULA_0103 0 0.0 -100.0 1400.0 READ_WRITE ECU_ADDRESS 0x3FCE8A /end MEASUREMENT
/begin MEASUREMENT sls_obdh_pu_sau_max "Max. aufgetr. Saugr.-unterdruck bis nach SLS-HFM-Diagnose" SWORD FORMULA_0075 0 0.0 0.0 2000.0 READ_WRITE ECU_ADDRESS 0x3FCE94 /end MEASUREMENT
/begin MEASUREMENT sls_obdh_sl_ml_vola_intg "Integral ueber den Absolutbegrag der Abweichung" UWORD FORMULA_0103 0 0.0 0.0 1400.0 READ_WRITE ECU_ADDRESS 0x3FCE9A /end MEASUREMENT
/begin MEASUREMENT sls_obdh_t_mdf "Timer der MDF-Diagnose" UWORD FORMULA_0644 0 0.0 0.0 655.0 READ_WRITE ECU_ADDRESS 0x3FCE7E /end MEASUREMENT
/begin MEASUREMENT sls_obdh_t_mdf_lam "Timer der MDF-Lambda-Diagnose" UWORD FORMULA_0644 0 0.0 0.0 655.0 READ_WRITE ECU_ADDRESS 0x3FCE80 /end MEASUREMENT
/begin MEASUREMENT slv_exd_timeout "KWP-Ansteuerzeit" UBYTE FORMULA_0461 0 0.0 0.0 25.5 READ_WRITE ECU_ADDRESS 0x3FCE9E /end MEASUREMENT
/begin MEASUREMENT spgr_freq "" UBYTE FORMULA_1120 0 0.0 228.0 700.0 READ_WRITE ECU_ADDRESS 0x3FCE9F /end MEASUREMENT
/begin MEASUREMENT spim_errorcode "Statusvariable der SPI" UBYTE FORMULA_0002 0 0.0 0.0 255.0 READ_WRITE ECU_ADDRESS 0x3FCEA3 /end MEASUREMENT
/begin MEASUREMENT spim_errorcounter "Fehlerzaehler der Spi" UBYTE FORMULA_0003 0 0.0 0.0 255.0 READ_WRITE ECU_ADDRESS 0x3FCEA0 /end MEASUREMENT
/begin MEASUREMENT spim_reqcounter "Anzahl der Auftraege in der Queue" UBYTE FORMULA_0003 0 0.0 0.0 255.0 READ_WRITE ECU_ADDRESS 0x3FCEA1 /end MEASUREMENT
/begin MEASUREMENT spim_status "Statusvariable der SPI" UBYTE FORMULA_0375 0 0.0 0.0 255.0 READ_WRITE ECU_ADDRESS 0x3FCEA2 /end MEASUREMENT
/begin MEASUREMENT stat_data_reset "Freigabe zum Loeschen von n/rf per CBS-Reset" UBYTE FORMULA_0003 0 0.0 0.0 255.0 READ_WRITE ECU_ADDRESS 0x3FCEAC /end MEASUREMENT
/begin MEASUREMENT sys_ed_st "ED Status" UWORD FORMULA_0388 0 0.0 0.0 65535.0 READ_WRITE ECU_ADDRESS 0x3FCEB4 /end MEASUREMENT
/begin MEASUREMENT sys_exc_addr "Exception-Adresse" ULONG FORMULA_0000 0 0.0 0.0 4294967295.0 READ_WRITE ECU_ADDRESS 0x3FE774 /end MEASUREMENT
/begin MEASUREMENT sys_exc_km_ni "Kilometerstand bei Exception" ULONG FORMULA_0027 0 0.0 0.0 16777214.0 READ_WRITE ECU_ADDRESS 0x3FE77C /end MEASUREMENT
/begin MEASUREMENT sys_exc_lr "Linkregister nach Exception" ULONG FORMULA_0000 0 0.0 0.0 4294967295.0 READ_WRITE ECU_ADDRESS 0x3F8018 /end MEASUREMENT
/begin MEASUREMENT sys_exc_n_ni "Drehzahl bei Exception" SWORD FORMULA_0006 0 0.0 0.0 10000.0 READ_WRITE ECU_ADDRESS 0x3FE780 /end MEASUREMENT
/begin MEASUREMENT sys_exc_vec "Exception-Vector" UWORD FORMULA_0015 0 0.0 0.0 65535.0 READ_WRITE ECU_ADDRESS 0x3FE772 /end MEASUREMENT
/begin MEASUREMENT sys_last_reset_st "Letzter Resetstatus" UBYTE FORMULA_0390 0 0.0 0.0 255.0 READ_WRITE ECU_ADDRESS 0x3FCEBC /end MEASUREMENT
/begin MEASUREMENT sys_reset_st "Resetursache" UBYTE FORMULA_0390 0 0.0 0.0 255.0 READ_WRITE ECU_ADDRESS 0x3FE779 /end MEASUREMENT
/begin MEASUREMENT sys_rsr "Reset Status Register" UWORD FORMULA_0010 0 0.0 0.0 65535.0 READ_WRITE ECU_ADDRESS 0x3FE768 /end MEASUREMENT
/begin MEASUREMENT sys_rsr_cnt_sum "Reset-Summenzaehler" UWORD FORMULA_0010 0 0.0 0.0 65535.0 READ_WRITE ECU_ADDRESS 0x3FE76A /end MEASUREMENT
/begin MEASUREMENT sys_rsr_csrs "Checkstop reset" UWORD FORMULA_0395 0 0 0.0 255.0 READ_WRITE BIT_MASK 0x800 ECU_ADDRESS 0x3FE768 /end MEASUREMENT
/begin MEASUREMENT sys_rsr_dbhrs "Debug port hard reset" UWORD FORMULA_0396 0 0 0.0 255.0 READ_WRITE BIT_MASK 0x400 ECU_ADDRESS 0x3FE768 /end MEASUREMENT
/begin MEASUREMENT sys_rsr_dbsrs "Debug port soft reset" UWORD FORMULA_0397 0 0 0.0 255.0 READ_WRITE BIT_MASK 0x200 ECU_ADDRESS 0x3FE768 /end MEASUREMENT
/begin MEASUREMENT sys_rsr_ehrs "External Hreset" UWORD FORMULA_0391 0 0 0.0 255.0 READ_WRITE BIT_MASK 0x8000 ECU_ADDRESS 0x3FE768 /end MEASUREMENT
/begin MEASUREMENT sys_rsr_ersr "External Soft reset" UWORD FORMULA_0392 0 0 0.0 255.0 READ_WRITE BIT_MASK 0x4000 ECU_ADDRESS 0x3FE768 /end MEASUREMENT
/begin MEASUREMENT sys_rsr_ghrst "Glitch detected on HRESET PIN" UWORD FORMULA_0402 0 0 0.0 255.0 READ_WRITE BIT_MASK 0x10 ECU_ADDRESS 0x3FE768 /end MEASUREMENT
/begin MEASUREMENT sys_rsr_gpor "Glitch detected on powern on reset" UWORD FORMULA_0401 0 0 0.0 255.0 READ_WRITE BIT_MASK 0x20 ECU_ADDRESS 0x3FE768 /end MEASUREMENT
/begin MEASUREMENT sys_rsr_gsrst "Glitch detected on SRESET PIN" UWORD FORMULA_0403 0 0 0.0 255.0 READ_WRITE BIT_MASK 0x8 ECU_ADDRESS 0x3FE768 /end MEASUREMENT
/begin MEASUREMENT sys_rsr_ilbc "Illegal bit change reset" UWORD FORMULA_0400 0 0 0.0 255.0 READ_WRITE BIT_MASK 0x40 ECU_ADDRESS 0x3FE768 /end MEASUREMENT
/begin MEASUREMENT sys_rsr_jtrs "Jtag reset" UWORD FORMULA_0398 0 0 0.0 255.0 READ_WRITE BIT_MASK 0x100 ECU_ADDRESS 0x3FE768 /end MEASUREMENT
/begin MEASUREMENT sys_rsr_llrs "Los of lock reset" UWORD FORMULA_0393 0 0 0.0 255.0 READ_WRITE BIT_MASK 0x2000 ECU_ADDRESS 0x3FE768 /end MEASUREMENT
/begin MEASUREMENT sys_rsr_occs "On chip clock reset" UWORD FORMULA_0399 0 0 0.0 255.0 READ_WRITE BIT_MASK 0x80 ECU_ADDRESS 0x3FE768 /end MEASUREMENT
/begin MEASUREMENT sys_rsr_swrs "Software watchdog reset" UWORD FORMULA_0394 0 0 0.0 255.0 READ_WRITE BIT_MASK 0x1000 ECU_ADDRESS 0x3FE768 /end MEASUREMENT
/begin MEASUREMENT sys_sg_fehler "SG internere Fehlernummer" UBYTE FORMULA_0405 0 0.0 0.0 255.0 READ_WRITE ECU_ADDRESS 0x3FE778 /end MEASUREMENT
/begin MEASUREMENT sys_sync_init_t "Hochlauf Zeitmarken" UWORD FORMULA_0406 0 0.0 0.0 16711.42578125 READ_WRITE ARRAY_SIZE 5 ECU_ADDRESS 0x3FE782 MATRIX_DIM 5 1 1 /end MEASUREMENT
/begin MEASUREMENT sys_zust "Betriebszustand des Systems" UWORD FORMULA_0389 0 0.0 0.0 65535.0 READ_WRITE ECU_ADDRESS 0x3FCEB6 /end MEASUREMENT
/begin MEASUREMENT sys_zust_bgnd_cnt "Aufruf Bgnd Task pro 100ms" UWORD FORMULA_0010 0 0.0 0.0 1000.0 READ_WRITE ECU_ADDRESS 0x3FE76E /end MEASUREMENT
/begin MEASUREMENT sys_zust_bgnd_net_min "Background Netto time min" UWORD FORMULA_0404 0 0.0 0.0 2.0 READ_WRITE ECU_ADDRESS 0x3FE770 /end MEASUREMENT
/begin MEASUREMENT sys_zust_cpu_last "CPU Last" UWORD FORMULA_0001 0 0.0 0.0 100.0 READ_WRITE ECU_ADDRESS 0x3FE76C /end MEASUREMENT
/begin MEASUREMENT te_begr_st_b1 "TE-Begrenzungsflags" UBYTE FORMULA_1127 0 0.0 0.0 255.0 READ_WRITE ECU_ADDRESS 0x3FCEE8 /end MEASUREMENT
/begin MEASUREMENT te_begr_st_b2 "TE-Begrenzungsflags" UBYTE FORMULA_1127 0 0.0 0.0 255.0 READ_WRITE ECU_ADDRESS 0x3FCEE9 /end MEASUREMENT
/begin MEASUREMENT te_c_akf_roh_b1 "errechnete AKF-Konzentration - Version 1" UWORD FORMULA_0199 0 0.0 0.0 2.0 READ_WRITE ECU_ADDRESS 0x3FCEEC /end MEASUREMENT
/begin MEASUREMENT te_c_akf_roh_b2 "errechnete AKF-Konzentration - Version 1" UWORD FORMULA_0199 0 0.0 0.0 2.0 READ_WRITE ECU_ADDRESS 0x3FCEEE /end MEASUREMENT
/begin MEASUREMENT te_c_akf_st "Zustand C_AKF-Berechnung" UBYTE FORMULA_1128 0 0.0 0.0 255.0 READ_WRITE ECU_ADDRESS 0x3FCEEA /end MEASUREMENT
/begin MEASUREMENT te_c_akf_tau "Filterkonstante Konzentration - AKF" UWORD FORMULA_1052 0 0.0 0.1000000014901161 6553.5 READ_WRITE ECU_ADDRESS 0x3FCEF0 /end MEASUREMENT
/begin MEASUREMENT te_c_akf_vor_filt "Gemeinsame Konzentration Filterung" UWORD FORMULA_0199 0 0.0 0.0 2.0 READ_WRITE ECU_ADDRESS 0x3FCEF2 /end MEASUREMENT
/begin MEASUREMENT te_d_x_ml_soll_neg_b1 "neg. Gradient - Aenderungsbegrenzung" UWORD FORMULA_1129 0 0.0 0.0 1.999899983406067 READ_WRITE ECU_ADDRESS 0x3FCEF4 /end MEASUREMENT
/begin MEASUREMENT te_d_x_ml_soll_neg_b2 "neg. Gradient - Aenderungsbegrenzung" UWORD FORMULA_1129 0 0.0 0.0 1.999899983406067 READ_WRITE ECU_ADDRESS 0x3FCEF6 /end MEASUREMENT
/begin MEASUREMENT te_d_x_ml_soll_pos_b1 "pos. Gradient - Aenderungsbegrenzung" UWORD FORMULA_1129 0 0.0 0.0 1.999899983406067 READ_WRITE ECU_ADDRESS 0x3FCEF8 /end MEASUREMENT
/begin MEASUREMENT te_d_x_ml_soll_pos_b2 "pos. Gradient - Aenderungsbegrenzung" UWORD FORMULA_1129 0 0.0 0.0 1.999899983406067 READ_WRITE ECU_ADDRESS 0x3FCEFA /end MEASUREMENT
/begin MEASUREMENT te_freq "TE-Ansteuerfrequenz" UWORD FORMULA_1076 0 0.0 10.0 50.0 READ_WRITE ECU_ADDRESS 0x3FCEFC /end MEASUREMENT
/begin MEASUREMENT te_lam_delta_b1 "Diff. aus lam_ist_mw - lam_soll" SWORD FORMULA_0025 0 0.0 -2.0 1.999899983406067 READ_WRITE ECU_ADDRESS 0x3FCF12 /end MEASUREMENT
/begin MEASUREMENT te_lam_delta_b2 "Diff. aus lam_ist_mw - lam_soll" SWORD FORMULA_0025 0 0.0 -2.0 1.999899983406067 READ_WRITE ECU_ADDRESS 0x3FCF14 /end MEASUREMENT
/begin MEASUREMENT te_m_max_b1 "Masse Gemisch bei 100%tv = te_m_mks + te_m_ml" UWORD FORMULA_0563 0 0.0 0.0 65.53500366210938 READ_WRITE ECU_ADDRESS 0x3FCEFE /end MEASUREMENT
/begin MEASUREMENT te_m_max_b2 "Masse Gemisch bei 100%tv = te_m_mks + te_m_ml" UWORD FORMULA_0563 0 0.0 0.0 65.53500366210938 READ_WRITE ECU_ADDRESS 0x3FCF00 /end MEASUREMENT
/begin MEASUREMENT te_m_max_mks_b1 "max. Durchfluss Masse Kraftstoffdampf bei 100% tv" UWORD FORMULA_0563 0 0.0 0.0 65.53500366210938 READ_WRITE ECU_ADDRESS 0x3FCF02 /end MEASUREMENT
/begin MEASUREMENT te_m_max_mks_b2 "max. Durchfluss Masse Kraftstoffdampf bei 100% tv" UWORD FORMULA_0563 0 0.0 0.0 65.53500366210938 READ_WRITE ECU_ADDRESS 0x3FCF04 /end MEASUREMENT
/begin MEASUREMENT te_m_max_ml_b1 "max. Durchfluss Masse Luft bei 100% tv" UWORD FORMULA_0563 0 0.0 0.0 65.53500366210938 READ_WRITE ECU_ADDRESS 0x3FCF06 /end MEASUREMENT
/begin MEASUREMENT te_m_max_ml_b2 "max. Durchfluss Masse Luft bei 100% tv" UWORD FORMULA_0563 0 0.0 0.0 65.53500366210938 READ_WRITE ECU_ADDRESS 0x3FCF08 /end MEASUREMENT
/begin MEASUREMENT te_m_mks_b1 "Masse Kraftstoffdampf bei 100% tv entspr. c_akf" UWORD FORMULA_0563 0 0.0 0.0 65.53500366210938 READ_WRITE ECU_ADDRESS 0x3FCF0E /end MEASUREMENT
/begin MEASUREMENT te_m_mks_b2 "Masse Kraftstoffdampf bei 100% tv entspr. c_akf" UWORD FORMULA_0563 0 0.0 0.0 65.53500366210938 READ_WRITE ECU_ADDRESS 0x3FCF10 /end MEASUREMENT
/begin MEASUREMENT te_m_ml_b1 "Masse Luft bei 100% tv entspr. c_akf" UWORD FORMULA_0563 0 0.0 0.0 65.53500366210938 READ_WRITE ECU_ADDRESS 0x3FCF0A /end MEASUREMENT
/begin MEASUREMENT te_m_ml_b2 "Masse Luft bei 100% tv entspr. c_akf" UWORD FORMULA_0563 0 0.0 0.0 65.53500366210938 READ_WRITE ECU_ADDRESS 0x3FCF0C /end MEASUREMENT
/begin MEASUREMENT te_mks_b1 "begrenzte auszugebende MKS aus TE" UWORD FORMULA_0111 0 0.0 0.0 1023.984313964844 READ_WRITE ECU_ADDRESS 0x3FCF5A /end MEASUREMENT
/begin MEASUREMENT te_mks_b2 "begrenzte auszugebende MKS aus TE" UWORD FORMULA_0111 0 0.0 0.0 1023.984313964844 READ_WRITE ECU_ADDRESS 0x3FCF5C /end MEASUREMENT
/begin MEASUREMENT te_mks_f_b1 "Faktor auf Kraftstoffmasse aus TE" UWORD FORMULA_0024 0 0.0 0.0 1.999899983406067 READ_WRITE ECU_ADDRESS 0x3FCF46 /end MEASUREMENT
/begin MEASUREMENT te_mks_f_b2 "Faktor auf Kraftstoffmasse aus TE" UWORD FORMULA_0024 0 0.0 0.0 1.999899983406067 READ_WRITE ECU_ADDRESS 0x3FCF48 /end MEASUREMENT
/begin MEASUREMENT te_mks_f_delta_b1 "Aenderung te_mks_f_ist ohne K_TE_MKS_F_POS/NEG" UWORD FORMULA_1129 0 0.0 0.0 1.999899983406067 READ_WRITE ECU_ADDRESS 0x3FCF4E /end MEASUREMENT
/begin MEASUREMENT te_mks_f_delta_b2 "Aenderung te_mks_f_ist ohne K_TE_MKS_F_POS/NEG" UWORD FORMULA_1129 0 0.0 0.0 1.999899983406067 READ_WRITE ECU_ADDRESS 0x3FCF50 /end MEASUREMENT
/begin MEASUREMENT te_mks_f_ist_b1 "Aenderungsbegr. Faktor auf Kraftstoffmasse aus TE" UWORD FORMULA_0024 0 0.0 0.0 1.999899983406067 READ_WRITE ECU_ADDRESS 0x3FCF4A /end MEASUREMENT
/begin MEASUREMENT te_mks_f_ist_b2 "Aenderungsbegr. Faktor auf Kraftstoffmasse aus TE" UWORD FORMULA_0024 0 0.0 0.0 1.999899983406067 READ_WRITE ECU_ADDRESS 0x3FCF4C /end MEASUREMENT
/begin MEASUREMENT te_mks_ist_b1 "aktuelle MKS aus TE" UWORD FORMULA_0111 0 0.0 0.0 1023.984313964844 READ_WRITE ECU_ADDRESS 0x3FCF52 /end MEASUREMENT
/begin MEASUREMENT te_mks_ist_b2 "aktuelle MKS aus TE" UWORD FORMULA_0111 0 0.0 0.0 1023.984313964844 READ_WRITE ECU_ADDRESS 0x3FCF54 /end MEASUREMENT
/begin MEASUREMENT te_mks_nue "Wichte - MKS" UWORD FORMULA_1130 0 0.0 0.0 65.53500366210938 READ_WRITE ECU_ADDRESS 0x3FCF28 /end MEASUREMENT
/begin MEASUREMENT te_mks_xsi_b1 "Ausflusskoeffizient - MKS" UWORD FORMULA_0073 0 0.0 0.0 63.99900054931641 READ_WRITE ECU_ADDRESS 0x3FCF2E /end MEASUREMENT
/begin MEASUREMENT te_mks_xsi_b2 "Ausflusskoeffizient - MKS" UWORD FORMULA_0073 0 0.0 0.0 63.99900054931641 READ_WRITE ECU_ADDRESS 0x3FCF30 /end MEASUREMENT
/begin MEASUREMENT te_mks_yps "Stroemungsgeschwindigkeit - MKS" UWORD FORMULA_1132 0 0.0 0.0 65535.0 READ_WRITE ECU_ADDRESS 0x3FCF32 /end MEASUREMENT
/begin MEASUREMENT te_mks_yps_quad "(te_mks_yps)2 - MKS" UWORD FORMULA_1131 0 0.0 0.0 589815.0 READ_WRITE ECU_ADDRESS 0x3FCF2C /end MEASUREMENT
/begin MEASUREMENT te_ml_ist_b1 "Luftmassenstrom je Bank aus te_ml_soll und c_akf" SWORD FORMULA_0103 0 0.0 -100.0 1400.0 READ_WRITE ECU_ADDRESS 0x3FCF16 /end MEASUREMENT
/begin MEASUREMENT te_ml_ist_b2 "Luftmassenstrom je Bank aus te_ml_soll und c_akf" SWORD FORMULA_0103 0 0.0 -100.0 1400.0 READ_WRITE ECU_ADDRESS 0x3FCF18 /end MEASUREMENT
/begin MEASUREMENT te_ml_min_b1 "min. angesaugte Gesamtluft / Anzahl TEV" UWORD FORMULA_0103 0 0.0 0.0 1400.0 READ_WRITE ECU_ADDRESS 0x3FCF1A /end MEASUREMENT
/begin MEASUREMENT te_ml_min_b2 "min. angesaugte Gesamtluft / Anzahl TEV" UWORD FORMULA_0103 0 0.0 0.0 1400.0 READ_WRITE ECU_ADDRESS 0x3FCF1C /end MEASUREMENT
/begin MEASUREMENT te_ml_nue "Wichte - Luft" UWORD FORMULA_1130 0 0.0 0.0 65.53500366210938 READ_WRITE ECU_ADDRESS 0x3FCF1E /end MEASUREMENT
/begin MEASUREMENT te_ml_soll_b1 "SOLL-Massenstrom je TEV auf Luft normiert" UWORD FORMULA_0563 0 0.0 0.0 65.53500366210938 READ_WRITE ECU_ADDRESS 0x3FCF20 /end MEASUREMENT
/begin MEASUREMENT te_ml_soll_b2 "SOLL-Massenstrom je TEV auf Luft normiert" UWORD FORMULA_0563 0 0.0 0.0 65.53500366210938 READ_WRITE ECU_ADDRESS 0x3FCF22 /end MEASUREMENT
/begin MEASUREMENT te_ml_soll_mg_b1 "SOLL-Massenstrom je Zyl auf Luft normiert" UWORD FORMULA_0111 0 0.0 0.0 1023.984313964844 READ_WRITE ECU_ADDRESS 0x3FCF24 /end MEASUREMENT
/begin MEASUREMENT te_ml_soll_mg_b2 "SOLL-Massenstrom je Zyl auf Luft normiert" UWORD FORMULA_0111 0 0.0 0.0 1023.984313964844 READ_WRITE ECU_ADDRESS 0x3FCF26 /end MEASUREMENT
/begin MEASUREMENT te_ml_xsi_b1 "Ausflusskoeffizient - Luft" UWORD FORMULA_0073 0 0.0 0.0 63.99900054931641 READ_WRITE ECU_ADDRESS 0x3FCF34 /end MEASUREMENT
/begin MEASUREMENT te_ml_xsi_b2 "Ausflusskoeffizient - Luft" UWORD FORMULA_0073 0 0.0 0.0 63.99900054931641 READ_WRITE ECU_ADDRESS 0x3FCF36 /end MEASUREMENT
/begin MEASUREMENT te_ml_yps "Stroemungsgeschwindigkeit - Luft" UWORD FORMULA_1132 0 0.0 0.0 65535.0 READ_WRITE ECU_ADDRESS 0x3FCF38 /end MEASUREMENT
/begin MEASUREMENT te_ml_yps_quad "(te_ml_yps)2 - Luft" UWORD FORMULA_1131 0 0.0 0.0 589815.0 READ_WRITE ECU_ADDRESS 0x3FCF2A /end MEASUREMENT
/begin MEASUREMENT te_ml_zyl_real_b1 "mzyl aus TI berechnet" UWORD FORMULA_0111 0 0.0 0.0 1023.984313964844 READ_WRITE ECU_ADDRESS 0x3FCF3E /end MEASUREMENT
/begin MEASUREMENT te_ml_zyl_real_b2 "mzyl aus TI berechnet" UWORD FORMULA_0111 0 0.0 0.0 1023.984313964844 READ_WRITE ECU_ADDRESS 0x3FCF40 /end MEASUREMENT
/begin MEASUREMENT te_mzyl_diff_b1 "Differenz te_mzyl_ohne - te_ml_zyl_real" UWORD FORMULA_0111 0 0.0 0.0 1023.984313964844 READ_WRITE ECU_ADDRESS 0x3FCF42 /end MEASUREMENT
/begin MEASUREMENT te_mzyl_diff_b2 "Differenz te_mzyl_ohne - te_ml_zyl_real" UWORD FORMULA_0111 0 0.0 0.0 1023.984313964844 READ_WRITE ECU_ADDRESS 0x3FCF44 /end MEASUREMENT
/begin MEASUREMENT te_mzyl_ohne_b1 "adaptierter angesaugter Luftmassenstrom ohne TE" UWORD FORMULA_0111 0 0.0 0.0 1023.984313964844 READ_WRITE ECU_ADDRESS 0x3FCF3A /end MEASUREMENT
/begin MEASUREMENT te_mzyl_ohne_b2 "adaptierter angesaugter Luftmassenstrom ohne TE" UWORD FORMULA_0111 0 0.0 0.0 1023.984313964844 READ_WRITE ECU_ADDRESS 0x3FCF3C /end MEASUREMENT
/begin MEASUREMENT te_n_stat_b1 "n, bei der LAA stationaer" SWORD FORMULA_0006 0 0.0 0.0 10000.0 READ_WRITE ECU_ADDRESS 0x3FCF5E /end MEASUREMENT
/begin MEASUREMENT te_n_stat_b2 "n, bei der LAA stationaer" SWORD FORMULA_0006 0 0.0 0.0 10000.0 READ_WRITE ECU_ADDRESS 0x3FCF60 /end MEASUREMENT
/begin MEASUREMENT te_obd_auss_delta_b1 "Auss-Integral Reaktion" SWORD FORMULA_0706 0 0.0 -200.0 200.0 READ_WRITE ECU_ADDRESS 0x3FCFC4 /end MEASUREMENT
/begin MEASUREMENT te_obd_auss_delta_b2 "Auss-Integral Reaktion" SWORD FORMULA_0706 0 0.0 -200.0 200.0 READ_WRITE ECU_ADDRESS 0x3FCFC6 /end MEASUREMENT
/begin MEASUREMENT te_obd_auss_filt_b1 "gefilt. Auss-Integral-Leitwert" SWORD FORMULA_1161 0 0.0 0.0 10.0 READ_WRITE ECU_ADDRESS 0x3FCFC8 /end MEASUREMENT
/begin MEASUREMENT te_obd_auss_filt_b2 "gefilt. Auss-Integral-Leitwert" SWORD FORMULA_1161 0 0.0 0.0 10.0 READ_WRITE ECU_ADDRESS 0x3FCFCA /end MEASUREMENT
/begin MEASUREMENT te_obd_auss_ok_b1 "Anzahl der Integrale OK-Erkennungen" UBYTE FORMULA_0003 0 0.0 0.0 255.0 READ_WRITE ECU_ADDRESS 0x3FCFCC /end MEASUREMENT
/begin MEASUREMENT te_obd_auss_ok_b2 "Anzahl der Integrale OK-Erkennungen" UBYTE FORMULA_0003 0 0.0 0.0 255.0 READ_WRITE ECU_ADDRESS 0x3FCFCD /end MEASUREMENT
/begin MEASUREMENT te_obd_auss_start_b1 "gefilt. Auss-Integral bei Messbeginn" SWORD FORMULA_1161 0 0.0 0.0 10.0 READ_WRITE ECU_ADDRESS 0x3FCFCE /end MEASUREMENT
/begin MEASUREMENT te_obd_auss_start_b2 "gefilt. Auss-Integral bei Messbeginn" SWORD FORMULA_1161 0 0.0 0.0 10.0 READ_WRITE ECU_ADDRESS 0x3FCFD0 /end MEASUREMENT
/begin MEASUREMENT te_obd_kkos_md_start "Md-Aufnahme Klimakompressor" SWORD FORMULA_0120 0 0.0 -100.0 1000.0 READ_WRITE ECU_ADDRESS 0x3FCFD4 /end MEASUREMENT
/begin MEASUREMENT te_obd_lam_max_b1 "Maximalwert Lambda bei Messung" UWORD FORMULA_0025 0 0.0 0.0 3.999000072479248 READ_WRITE ECU_ADDRESS 0x3FCFDA /end MEASUREMENT
/begin MEASUREMENT te_obd_lam_max_b2 "Maximalwert Lambda bei Messung" UWORD FORMULA_0025 0 0.0 0.0 3.999000072479248 READ_WRITE ECU_ADDRESS 0x3FCFDC /end MEASUREMENT
/begin MEASUREMENT te_obd_lam_min_b1 "Minimalwert Lambda bei Messung" UWORD FORMULA_0025 0 0.0 0.0 3.999000072479248 READ_WRITE ECU_ADDRESS 0x3FCFD6 /end MEASUREMENT
/begin MEASUREMENT te_obd_lam_min_b2 "Minimalwert Lambda bei Messung" UWORD FORMULA_0025 0 0.0 0.0 3.999000072479248 READ_WRITE ECU_ADDRESS 0x3FCFD8 /end MEASUREMENT
/begin MEASUREMENT te_obd_lam_ok_b1 "Anzahl der Lambda OK-Erkennungen" UBYTE FORMULA_0003 0 0.0 0.0 255.0 READ_WRITE ECU_ADDRESS 0x3FCFDE /end MEASUREMENT
/begin MEASUREMENT te_obd_lam_ok_b2 "Anzahl der Lambda OK-Erkennungen" UBYTE FORMULA_0003 0 0.0 0.0 255.0 READ_WRITE ECU_ADDRESS 0x3FCFDF /end MEASUREMENT
/begin MEASUREMENT te_obd_ll_cnt "Anzahl der LL Durchlaeufe" UBYTE FORMULA_0003 0 0.0 0.0 255.0 READ_WRITE ECU_ADDRESS 0x3FCFE0 /end MEASUREMENT
/begin MEASUREMENT te_obd_ll_delta "ml/n-Reaktion auf TEV-Aktion" SWORD FORMULA_0022 0 0.0 -50.0 50.0 READ_WRITE ECU_ADDRESS 0x3FCFE2 /end MEASUREMENT
/begin MEASUREMENT te_obd_ll_ok "Anzahl der ml/n OK-Erkennungen" UBYTE FORMULA_0003 0 0.0 0.0 255.0 READ_WRITE ECU_ADDRESS 0x3FCFE4 /end MEASUREMENT
/begin MEASUREMENT te_obd_lrw_start "CAN: Lenkradwinkel" SWORD FORMULA_0132 0 0.0 -1440.153564453125 1440.109619140625 READ_WRITE ECU_ADDRESS 0x3FCFE6 /end MEASUREMENT
/begin MEASUREMENT te_obd_md_gen_start "Generatormoment bei Messbeginn" SWORD FORMULA_0113 0 0.0 -3276.800048828125 3276.699951171875 READ_WRITE ECU_ADDRESS 0x3FCFE8 /end MEASUREMENT
/begin MEASUREMENT te_obd_ml_alt "Wert vor te_tv-Veraenderung" SWORD FORMULA_0103 0 0.0 -100.0 1400.0 READ_WRITE ECU_ADDRESS 0x3FCFEA /end MEASUREMENT
/begin MEASUREMENT te_obd_ml_filt "gefilterte hfm_ml_roh" SWORD FORMULA_1162 0 0.0 0.0 50.0 READ_WRITE ECU_ADDRESS 0x3FCFEC /end MEASUREMENT
/begin MEASUREMENT te_obd_n_alt "Wert vor te_tv-Veraenderung" SWORD FORMULA_0006 0 0.0 0.0 10000.0 READ_WRITE ECU_ADDRESS 0x3FCFEE /end MEASUREMENT
/begin MEASUREMENT te_obd_result_b1 "Ergebnis TEV Funktions-Check" UBYTE FORMULA_1163 0 0.0 0.0 255.0 READ_WRITE ECU_ADDRESS 0x3FCFF0 /end MEASUREMENT
/begin MEASUREMENT te_obd_result_b2 "Ergebnis TEV Funktions-Check" UBYTE FORMULA_1163 0 0.0 0.0 255.0 READ_WRITE ECU_ADDRESS 0x3FCFF1 /end MEASUREMENT
/begin MEASUREMENT te_obd_st "Zustand TEV OBD Funktions-Check" UBYTE FORMULA_1164 0 0.0 0.0 255.0 READ_WRITE ECU_ADDRESS 0x3FCFF2 /end MEASUREMENT
/begin MEASUREMENT te_obd_t_dly "Restzeit im LL bis Messbeginn" UBYTE FORMULA_0461 0 0.0 0.0 25.5 READ_WRITE ECU_ADDRESS 0x3FCFF3 /end MEASUREMENT
/begin MEASUREMENT te_obd_t_lam_reg_off "verbleibende Lam-Reg Sperrzeit" UBYTE FORMULA_0461 0 0.0 0.0 25.5 READ_WRITE ECU_ADDRESS 0x3FCFF4 /end MEASUREMENT
/begin MEASUREMENT te_obd_t_mess "Rest-Messzeit bei te_tv Endwert" UBYTE FORMULA_0461 0 0.0 0.0 25.5 READ_WRITE ECU_ADDRESS 0x3FCFF5 /end MEASUREMENT
/begin MEASUREMENT te_obd_tv_b1 "Tastverhaeltnis vom Funktions-Check" UWORD FORMULA_0107 0 0.0 0.0 100.0 READ_WRITE ECU_ADDRESS 0x3FCFF6 /end MEASUREMENT
/begin MEASUREMENT te_obd_tv_b2 "Tastverhaeltnis vom Funktions-Check" UWORD FORMULA_0107 0 0.0 0.0 100.0 READ_WRITE ECU_ADDRESS 0x3FCFF8 /end MEASUREMENT
/begin MEASUREMENT te_obd_tz_start "Mittl. Zuendwinkel bei Mess-Beginn" SWORD FORMULA_0102 0 0.0 -50.0 60.0 READ_WRITE ECU_ADDRESS 0x3FCFFA /end MEASUREMENT
/begin MEASUREMENT te_obd_ub_start "Ub bei Mess-Beginn" SWORD FORMULA_0008 0 0.0 0.0 28.0 READ_WRITE ECU_ADDRESS 0x3FCFFC /end MEASUREMENT
/begin MEASUREMENT te_psau_diff_b1 "Diff. aus pumg - psau_asp" SWORD FORMULA_0075 0 0.0 0.0 2000.0 READ_WRITE ECU_ADDRESS 0x3FCF62 /end MEASUREMENT
/begin MEASUREMENT te_psau_diff_b2 "Diff. aus pumg - psau_asp" SWORD FORMULA_0075 0 0.0 0.0 2000.0 READ_WRITE ECU_ADDRESS 0x3FCF64 /end MEASUREMENT
/begin MEASUREMENT te_r_gemisch "MISCH-Gaskonstante" UWORD FORMULA_1133 0 0.0 0.0 65535.0 READ_WRITE ECU_ADDRESS 0x3FCF66 /end MEASUREMENT
/begin MEASUREMENT te_rf_stat_b1 "rf, bei der LAA stationaer" SWORD FORMULA_0007 0 0.0 0.0 2.0 READ_WRITE ECU_ADDRESS 0x3FCF68 /end MEASUREMENT
/begin MEASUREMENT te_rf_stat_b2 "rf, bei der LAA stationaer" SWORD FORMULA_0007 0 0.0 0.0 2.0 READ_WRITE ECU_ADDRESS 0x3FCF6A /end MEASUREMENT
/begin MEASUREMENT te_st "allgemeiner TE-Status" UWORD FORMULA_0080 0 0.0 0.0 65535.0 READ_WRITE ECU_ADDRESS 0x3FCF6C /end MEASUREMENT
/begin MEASUREMENT te_t_begin_min "Min. Motorlaufzeit TE-Beginn" UWORD FORMULA_0021 0 0.0 0.0 655.0 READ_WRITE ECU_ADDRESS 0x3FCF6E /end MEASUREMENT
/begin MEASUREMENT te_t_laa "TE-LAA-Zeit" UWORD FORMULA_0071 0 0.0 0.0 6553.5 READ_WRITE ECU_ADDRESS 0x3FCF74 /end MEASUREMENT
/begin MEASUREMENT te_t_laa_ini "TE-LAA-INI-Zeit - ununterbrechbar" UWORD FORMULA_0071 0 0.0 0.0 6553.5 READ_WRITE ECU_ADDRESS 0x3FCF72 /end MEASUREMENT
/begin MEASUREMENT te_t_spuel "SPUEL-Zeit" UWORD FORMULA_0071 0 0.0 0.0 6553.5 READ_WRITE ECU_ADDRESS 0x3FCF70 /end MEASUREMENT
/begin MEASUREMENT te_ti_min_diff_b1 "Abstand ti_tpu zu ti_bj.min" UWORD FORMULA_0786 0 0.0 0.0 65.53500366210938 READ_WRITE ECU_ADDRESS 0x3FCF76 /end MEASUREMENT
/begin MEASUREMENT te_ti_min_diff_b2 "Abstand ti_tpu zu ti_bj.min" UWORD FORMULA_0786 0 0.0 0.0 65.53500366210938 READ_WRITE ECU_ADDRESS 0x3FCF78 /end MEASUREMENT
/begin MEASUREMENT te_tv_norm_b1 "normierte Tastverhaeltnis" UWORD FORMULA_0107 0 0.0 0.0 100.0 READ_WRITE ECU_ADDRESS 0x3FCF7E /end MEASUREMENT
/begin MEASUREMENT te_tv_norm_b2 "normierte Tastverhaeltnis" UWORD FORMULA_0107 0 0.0 0.0 100.0 READ_WRITE ECU_ADDRESS 0x3FCF80 /end MEASUREMENT
/begin MEASUREMENT te_tv_offs_b1 "ub-abhaengiger TV-Offset" UWORD FORMULA_0107 0 0.0 0.0 100.0 READ_WRITE ECU_ADDRESS 0x3FCF82 /end MEASUREMENT
/begin MEASUREMENT te_tv_offs_b2 "ub-abhaengiger TV-Offset" UWORD FORMULA_0107 0 0.0 0.0 100.0 READ_WRITE ECU_ADDRESS 0x3FCF84 /end MEASUREMENT
/begin MEASUREMENT te_tv_rel_b1 "Verhaeltnis te_ml_soll/te_m_max_ml" UWORD FORMULA_0107 0 0.0 0.0 100.0 READ_WRITE ECU_ADDRESS 0x3FCF7A /end MEASUREMENT
/begin MEASUREMENT te_tv_rel_b2 "Verhaeltnis te_ml_soll/te_m_max_ml" UWORD FORMULA_0107 0 0.0 0.0 100.0 READ_WRITE ECU_ADDRESS 0x3FCF7C /end MEASUREMENT
/begin MEASUREMENT te_tv_roh_b1 "ub-gewichtetes TV" UWORD FORMULA_0107 0 0.0 0.0 100.0 READ_WRITE ECU_ADDRESS 0x3FCF86 /end MEASUREMENT
/begin MEASUREMENT te_tv_roh_b2 "ub-gewichtetes TV" UWORD FORMULA_0107 0 0.0 0.0 100.0 READ_WRITE ECU_ADDRESS 0x3FCF88 /end MEASUREMENT
/begin MEASUREMENT te_van_vo_stat_b1 "Ventil_Ueberschneidung fuer LAA-stationaer" SWORD FORMULA_0102 0 0.0 -80.0 80.0 READ_WRITE ECU_ADDRESS 0x3FCF8A /end MEASUREMENT
/begin MEASUREMENT te_van_vo_stat_b2 "Ventil_Ueberschneidung fuer LAA-stationaer" SWORD FORMULA_0102 0 0.0 -80.0 80.0 READ_WRITE ECU_ADDRESS 0x3FCF8C /end MEASUREMENT
/begin MEASUREMENT te_ventil_exd_timeout "Tester Ansteuerzeit" UBYTE FORMULA_0461 0 0.0 0.0 25.5 READ_WRITE ECU_ADDRESS 0x3FCF8E /end MEASUREMENT
/begin MEASUREMENT te_vol_b1 "aktueller Volumenstrom je TEV" UWORD FORMULA_1151 0 0.0 0.0 131.0700073242188 READ_WRITE ECU_ADDRESS 0x3FCF90 /end MEASUREMENT
/begin MEASUREMENT te_vol_b2 "aktueller Volumenstrom je TEV" UWORD FORMULA_1151 0 0.0 0.0 131.0700073242188 READ_WRITE ECU_ADDRESS 0x3FCF92 /end MEASUREMENT
/begin MEASUREMENT te_vol_max_b1 "max. Volumenstrom je TEV bei 100% tv" UWORD FORMULA_1151 0 0.0 0.0 131.0700073242188 READ_WRITE ECU_ADDRESS 0x3FCF94 /end MEASUREMENT
/begin MEASUREMENT te_vol_max_b2 "max. Volumenstrom je TEV bei 100% tv" UWORD FORMULA_1151 0 0.0 0.0 131.0700073242188 READ_WRITE ECU_ADDRESS 0x3FCF96 /end MEASUREMENT
/begin MEASUREMENT te_vol_sum "Summe Volumenstrom AKF in Motorlauf" ULONG FORMULA_1152 0 0.0 0.0 14316.5576 READ_WRITE ECU_ADDRESS 0x3FCF98 /end MEASUREMENT
/begin MEASUREMENT te_x_mks_b1 "Soll-MKS-Anteil aus n und psau" UWORD FORMULA_0024 0 0.0 0.0 1.999899983406067 READ_WRITE ECU_ADDRESS 0x3FCF9C /end MEASUREMENT
/begin MEASUREMENT te_x_mks_b2 "Soll-MKS-Anteil aus n und psau" UWORD FORMULA_0024 0 0.0 0.0 1.999899983406067 READ_WRITE ECU_ADDRESS 0x3FCF9E /end MEASUREMENT
/begin MEASUREMENT te_x_mks_betrieb_b1 "MKS-Anteil auf Luft-Anteil norm, mit ti_min-Begr." UWORD FORMULA_0024 0 0.0 0.0 1.999899983406067 READ_WRITE ECU_ADDRESS 0x3FCFA0 /end MEASUREMENT
/begin MEASUREMENT te_x_mks_betrieb_b2 "MKS-Anteil auf Luft-Anteil norm, mit ti_min-Begr." UWORD FORMULA_0024 0 0.0 0.0 1.999899983406067 READ_WRITE ECU_ADDRESS 0x3FCFA2 /end MEASUREMENT
/begin MEASUREMENT te_x_ml_betrieb_b1 "moeglicher Luftmassenanteil bei 100% tv" UWORD FORMULA_0024 0 0.0 0.0 0.1000000014901161 READ_WRITE ECU_ADDRESS 0x3FCFA4 /end MEASUREMENT
/begin MEASUREMENT te_x_ml_betrieb_b2 "moeglicher Luftmassenanteil bei 100% tv" UWORD FORMULA_0024 0 0.0 0.0 0.1000000014901161 READ_WRITE ECU_ADDRESS 0x3FCFA6 /end MEASUREMENT
/begin MEASUREMENT te_x_ml_gw_neg_b1 "Abregelzeit" UWORD FORMULA_0071 0 0.0 0.0 6553.5 READ_WRITE ECU_ADDRESS 0x3FCFA8 /end MEASUREMENT
/begin MEASUREMENT te_x_ml_gw_neg_b2 "Abregelzeit" UWORD FORMULA_0071 0 0.0 0.0 6553.5 READ_WRITE ECU_ADDRESS 0x3FCFAA /end MEASUREMENT
/begin MEASUREMENT te_x_ml_gw_pos_b1 "Aufregelzeit" UWORD FORMULA_0071 0 0.0 0.0 6553.5 READ_WRITE ECU_ADDRESS 0x3FCFAC /end MEASUREMENT
/begin MEASUREMENT te_x_ml_gw_pos_b2 "Aufregelzeit" UWORD FORMULA_0071 0 0.0 0.0 6553.5 READ_WRITE ECU_ADDRESS 0x3FCFAE /end MEASUREMENT
/begin MEASUREMENT te_x_ml_max_b1 "max. zulaessiger Spuelluftanteil" UWORD FORMULA_0024 0 0.0 0.0 0.1000000014901161 READ_WRITE ECU_ADDRESS 0x3FCFB0 /end MEASUREMENT
/begin MEASUREMENT te_x_ml_max_b2 "max. zulaessiger Spuelluftanteil" UWORD FORMULA_0024 0 0.0 0.0 0.1000000014901161 READ_WRITE ECU_ADDRESS 0x3FCFB2 /end MEASUREMENT
/begin MEASUREMENT te_x_ml_min_b1 "min. Auswahl des zulaessigen Spuelluftanteils" UWORD FORMULA_0024 0 0.0 0.0 0.1000000014901161 READ_WRITE ECU_ADDRESS 0x3FCFB4 /end MEASUREMENT
/begin MEASUREMENT te_x_ml_min_b2 "min. Auswahl des zulaessigen Spuelluftanteils" UWORD FORMULA_0024 0 0.0 0.0 0.1000000014901161 READ_WRITE ECU_ADDRESS 0x3FCFB6 /end MEASUREMENT
/begin MEASUREMENT te_x_ml_n_psau_b1 "Soll-Luftmassenanteil aus n und psau" UWORD FORMULA_0024 0 0.0 0.0 0.1000000014901161 READ_WRITE ECU_ADDRESS 0x3FCFB8 /end MEASUREMENT
/begin MEASUREMENT te_x_ml_n_psau_b2 "Soll-Luftmassenanteil aus n und psau" UWORD FORMULA_0024 0 0.0 0.0 0.1000000014901161 READ_WRITE ECU_ADDRESS 0x3FCFBA /end MEASUREMENT
/begin MEASUREMENT te_x_ml_soll_aebg_b1 "Aenderungsbegr. Soll-Spuelluftanteil" UWORD FORMULA_0024 0 0.0 0.0 0.1000000014901161 READ_WRITE ECU_ADDRESS 0x3FCFBC /end MEASUREMENT
/begin MEASUREMENT te_x_ml_soll_aebg_b2 "Aenderungsbegr. Soll-Spuelluftanteil" UWORD FORMULA_0024 0 0.0 0.0 0.1000000014901161 READ_WRITE ECU_ADDRESS 0x3FCFBE /end MEASUREMENT
/begin MEASUREMENT te_x_ml_ziel_b1 "gewuenschter Spuelluftanteil" UWORD FORMULA_0024 0 0.0 0.0 0.1000000014901161 READ_WRITE ECU_ADDRESS 0x3FCFC0 /end MEASUREMENT
/begin MEASUREMENT te_x_ml_ziel_b2 "gewuenschter Spuelluftanteil" UWORD FORMULA_0024 0 0.0 0.0 0.1000000014901161 READ_WRITE ECU_ADDRESS 0x3FCFC2 /end MEASUREMENT
/begin MEASUREMENT test_kf_ip "Test" UWORD FORMULA_0010 0 0.0 0.0 65535.0 READ_WRITE ECU_ADDRESS 0x3FD002 /end MEASUREMENT
/begin MEASUREMENT test_kl_ip "Test" UWORD FORMULA_0010 0 0.0 0.0 65535.0 READ_WRITE ECU_ADDRESS 0x3FD000 /end MEASUREMENT
/begin MEASUREMENT testvariable "Test" UWORD FORMULA_0010 0 0.0 0.0 65535.0 READ_WRITE ECU_ADDRESS 0x3FCFFE /end MEASUREMENT
/begin MEASUREMENT vers_boot "Booterversion" UWORD FORMULA_0010 0 0.0 0.0 65535.0 READ_WRITE ECU_ADDRESS 0x3F8014 /end MEASUREMENT
/begin MEASUREMENT vers_boot_index "Booterversionsindex" UWORD FORMULA_0010 0 0.0 0.0 65535.0 READ_WRITE ECU_ADDRESS 0x3F8016 /end MEASUREMENT
/begin COMPU_METHOD FORMULA_0000 "FORMULA_0000" RAT_FUNC "%7.0" "-" COEFFS 0 1 0 0 0 1 /end COMPU_METHOD
/begin COMPU_METHOD FORMULA_0001 "FORMULA_0001" RAT_FUNC "%6.1" "%" COEFFS 0 10.0 0.0 0 0.0 1.0 /end COMPU_METHOD
/begin COMPU_METHOD FORMULA_0002 "FORMULA_0002" TAB_VERB "%3.0" "-" COMPU_TAB_REF FORMULA_0002_VTAB /end COMPU_METHOD
/begin COMPU_METHOD FORMULA_0003 "FORMULA_0003" RAT_FUNC "%3.0" "-" COEFFS 0 1 0 0 0 1 /end COMPU_METHOD
/begin COMPU_METHOD FORMULA_0006 "FORMULA_0006" RAT_FUNC "%5.0" "Upm" COEFFS 0 1 0 0 0 1 /end COMPU_METHOD
/begin COMPU_METHOD FORMULA_0007 "FORMULA_0007" RAT_FUNC "%8.3" "-" COEFFS 0 10000.0 0.0 0 0.0 1.0 /end COMPU_METHOD
/begin COMPU_METHOD FORMULA_0008 "FORMULA_0008" RAT_FUNC "%6.1" "V" COEFFS 0 10.0 0.0 0 0.0 1.0 /end COMPU_METHOD
/begin COMPU_METHOD FORMULA_0009 "FORMULA_0009" RAT_FUNC "%6.1" "Nm" COEFFS 0 10.0 0.0 0 0.0 1.0 /end COMPU_METHOD
/begin COMPU_METHOD FORMULA_0010 "FORMULA_0010" RAT_FUNC "%5.0" "-" COEFFS 0 1 0 0 0 1 /end COMPU_METHOD
/begin COMPU_METHOD FORMULA_0011 "FORMULA_0011" TAB_VERB "%5.0" "-" COMPU_TAB_REF FORMULA_0011_VTAB /end COMPU_METHOD
/begin COMPU_METHOD FORMULA_0015 "FORMULA_0015" TAB_VERB "%5.0" "-" COMPU_TAB_REF FORMULA_0015_VTAB /end COMPU_METHOD
/begin COMPU_METHOD FORMULA_0021 "FORMULA_0021" RAT_FUNC "%7.2" "s" COEFFS 0 100.0 0.0 0 0.0 1.0 /end COMPU_METHOD
/begin COMPU_METHOD FORMULA_0022 "FORMULA_0022" RAT_FUNC "%7.2" "%" COEFFS 0 100.0 0.0 0 0.0 1.0 /end COMPU_METHOD
/begin COMPU_METHOD FORMULA_0023 "FORMULA_0023" RAT_FUNC "%6.1" "°C" COEFFS 0 10.0 2732.0 0 0.0 1.0 /end COMPU_METHOD
/begin COMPU_METHOD FORMULA_0024 "FORMULA_0024" RAT_FUNC "%9.4" "-" COEFFS 0 32768.0 0.0 0 0.0 1.0 /end COMPU_METHOD
/begin COMPU_METHOD FORMULA_0025 "FORMULA_0025" RAT_FUNC "%8.3" "-" COEFFS 0 16384.0 0.0 0 0.0 1.0 /end COMPU_METHOD
/begin COMPU_METHOD FORMULA_0027 "FORMULA_0027" RAT_FUNC "%7.0" "km" COEFFS 0 1 0 0 0 1 /end COMPU_METHOD
/begin COMPU_METHOD FORMULA_0032 "FORMULA_0032" RAT_FUNC "%3.0" "%" COEFFS 0 1 0 0 0 1 /end COMPU_METHOD
/begin COMPU_METHOD FORMULA_0037 "FORMULA_0037" RAT_FUNC "%5.2" "-" COEFFS 0 1 0 0 0 1 /end COMPU_METHOD
/begin COMPU_METHOD FORMULA_0071 "FORMULA_0071" RAT_FUNC "%6.1" "s" COEFFS 0 10.0 0.0 0 0.0 1.0 /end COMPU_METHOD
/begin COMPU_METHOD FORMULA_0073 "FORMULA_0073" RAT_FUNC "%8.3" "-" COEFFS 0 1024.0 0.0 0 0.0 1.0 /end COMPU_METHOD
/begin COMPU_METHOD FORMULA_0075 "FORMULA_0075" RAT_FUNC "%6.1" "mbar" COEFFS 0 16.0 0.0 0 0.0 1.0 /end COMPU_METHOD
/begin COMPU_METHOD FORMULA_0076 "FORMULA_0076" RAT_FUNC "%6.1" "km/h" COEFFS 0 16.0 0.0 0 0.0 1.0 /end COMPU_METHOD
/begin COMPU_METHOD FORMULA_0080 "FORMULA_0080" RAT_FUNC "%7.2" "-" COEFFS 0 1 0 0 0 1 /end COMPU_METHOD
/begin COMPU_METHOD FORMULA_0102 "FORMULA_0102" RAT_FUNC "%6.1" "°KW" COEFFS 0 10.0 0.0 0 0.0 1.0 /end COMPU_METHOD
/begin COMPU_METHOD FORMULA_0103 "FORMULA_0103" RAT_FUNC "%6.1" "kg/h" COEFFS 0 10.0 0.0 0 0.0 1.0 /end COMPU_METHOD
/begin COMPU_METHOD FORMULA_0106 "FORMULA_0106" RAT_FUNC "%7.2" "%" COEFFS 0 163.84 0.0 0 0.0 1.0 /end COMPU_METHOD
/begin COMPU_METHOD FORMULA_0107 "FORMULA_0107" RAT_FUNC "%6.1" "%" COEFFS 0 10.24 0.0 0 0.0 1.0 /end COMPU_METHOD
/begin COMPU_METHOD FORMULA_0110 "FORMULA_0110" RAT_FUNC "%8.3" "bar" COEFFS 0 1000.0 0.0 0 0.0 1.0 /end COMPU_METHOD
/begin COMPU_METHOD FORMULA_0111 "FORMULA_0111" RAT_FUNC "%7.2" "mg" COEFFS 0 64.0 0.0 0 0.0 1.0 /end COMPU_METHOD
/begin COMPU_METHOD FORMULA_0113 "FORMULA_0113" RAT_FUNC "%7.2" "Nm" COEFFS 0 10.0 0.0 0 0.0 1.0 /end COMPU_METHOD
/begin COMPU_METHOD FORMULA_0114 "FORMULA_0114" RAT_FUNC "%5.0" "digit" COEFFS 0 1 0 0 0 1 /end COMPU_METHOD
/begin COMPU_METHOD FORMULA_0120 "FORMULA_0120" RAT_FUNC "%6.1" "Nm" COEFFS 0 2.0 0.0 0 0.0 1.0 /end COMPU_METHOD
/begin COMPU_METHOD FORMULA_0123 "FORMULA_0123" RAT_FUNC "%7.2" "m/(s*s)" COEFFS 0 40.0 0.0 0 0.0 1.0 /end COMPU_METHOD
/begin COMPU_METHOD FORMULA_0132 "FORMULA_0132" RAT_FUNC "%7.2" "Grad" COEFFS 0 22.75312855517634 0.0 0 0.0 1.0 /end COMPU_METHOD
/begin COMPU_METHOD FORMULA_0135 "FORMULA_0135" RAT_FUNC "%3.0" ".Gang" COEFFS 0 1 0 0 0 1 /end COMPU_METHOD
/begin COMPU_METHOD FORMULA_0142 "FORMULA_0142" RAT_FUNC "%6.1" "%" COEFFS 0 16.67 0.0 0 0.0 1.0 /end COMPU_METHOD
/begin COMPU_METHOD FORMULA_0167 "FORMULA_0167" TAB_VERB "%3.0" "-" COMPU_TAB_REF FORMULA_0167_VTAB /end COMPU_METHOD
/begin COMPU_METHOD FORMULA_0179 "FORMULA_0179" TAB_VERB "%5.0" "-" COMPU_TAB_REF FORMULA_0179_VTAB /end COMPU_METHOD
/begin COMPU_METHOD FORMULA_0199 "FORMULA_0199" RAT_FUNC "%9.4" "-" COEFFS 0 16384.0 0.0 0 0.0 1.0 /end COMPU_METHOD
/begin COMPU_METHOD FORMULA_0200 "FORMULA_0200" TAB_VERB "%5.2" "-" COMPU_TAB_REF FORMULA_0200_VTAB /end COMPU_METHOD
/begin COMPU_METHOD FORMULA_0214 "FORMULA_0214" RAT_FUNC "%3.0" "s" COEFFS 0 1 0 0 0 1 /end COMPU_METHOD
/begin COMPU_METHOD FORMULA_0261 "FORMULA_0261" RAT_FUNC "%8.3" "V" COEFFS 0 641.469735457881 0.0 0 0.0 1.0 /end COMPU_METHOD
/begin COMPU_METHOD FORMULA_0306 "FORMULA_0306" RAT_FUNC "%5.2" "s" COEFFS 0 100.0 0.0 0 0.0 1.0 /end COMPU_METHOD
/begin COMPU_METHOD FORMULA_0348 "FORMULA_0348" RAT_FUNC "%4.1" "V" COEFFS 0 10.0 0.0 0 0.0 1.0 /end COMPU_METHOD
/begin COMPU_METHOD FORMULA_0357 "FORMULA_0357" RAT_FUNC "%5.2" "s" COEFFS 0 200.0 0.0 0 0.0 1.0 /end COMPU_METHOD
/begin COMPU_METHOD FORMULA_0362 "FORMULA_0362" TAB_VERB "%5.2" "-" COMPU_TAB_REF FORMULA_0362_VTAB /end COMPU_METHOD
/begin COMPU_METHOD FORMULA_0367 "FORMULA_0367" TAB_VERB "%3.0" "-" COMPU_TAB_REF FORMULA_0367_VTAB /end COMPU_METHOD
/begin COMPU_METHOD FORMULA_0368 "FORMULA_0368" TAB_VERB "%5.2" "-" COMPU_TAB_REF FORMULA_0368_VTAB /end COMPU_METHOD
/begin COMPU_METHOD FORMULA_0369 "FORMULA_0369" TAB_VERB "%3.0" "-" COMPU_TAB_REF FORMULA_0369_VTAB /end COMPU_METHOD
/begin COMPU_METHOD FORMULA_0370 "FORMULA_0370" TAB_VERB "%3.0" "-" COMPU_TAB_REF FORMULA_0370_VTAB /end COMPU_METHOD
/begin COMPU_METHOD FORMULA_0371 "FORMULA_0371" TAB_VERB "%3.0" "-" COMPU_TAB_REF FORMULA_0371_VTAB /end COMPU_METHOD
/begin COMPU_METHOD FORMULA_0372 "FORMULA_0372" TAB_VERB "%3.0" "-" COMPU_TAB_REF FORMULA_0372_VTAB /end COMPU_METHOD
/begin COMPU_METHOD FORMULA_0373 "FORMULA_0373" TAB_VERB "%3.0" "-" COMPU_TAB_REF FORMULA_0373_VTAB /end COMPU_METHOD
/begin COMPU_METHOD FORMULA_0374 "FORMULA_0374" TAB_VERB "%5.0" "-" COMPU_TAB_REF FORMULA_0374_VTAB /end COMPU_METHOD
/begin COMPU_METHOD FORMULA_0375 "FORMULA_0375" TAB_VERB "%3.0" "-" COMPU_TAB_REF FORMULA_0375_VTAB /end COMPU_METHOD
/begin COMPU_METHOD FORMULA_0376 "FORMULA_0376" TAB_VERB "%7.2" "-" COMPU_TAB_REF FORMULA_0376_VTAB /end COMPU_METHOD
/begin COMPU_METHOD FORMULA_0377 "FORMULA_0377" TAB_VERB "%5.2" "-" COMPU_TAB_REF FORMULA_0377_VTAB /end COMPU_METHOD
/begin COMPU_METHOD FORMULA_0378 "FORMULA_0378" TAB_VERB "%5.2" "-" COMPU_TAB_REF FORMULA_0378_VTAB /end COMPU_METHOD
/begin COMPU_METHOD FORMULA_0379 "FORMULA_0379" TAB_VERB "%5.2" "-" COMPU_TAB_REF FORMULA_0379_VTAB /end COMPU_METHOD
/begin COMPU_METHOD FORMULA_0380 "FORMULA_0380" TAB_VERB "%5.2" "-" COMPU_TAB_REF FORMULA_0380_VTAB /end COMPU_METHOD
/begin COMPU_METHOD FORMULA_0381 "FORMULA_0381" TAB_VERB "%5.2" "-" COMPU_TAB_REF FORMULA_0381_VTAB /end COMPU_METHOD
/begin COMPU_METHOD FORMULA_0382 "FORMULA_0382" TAB_VERB "%5.2" "-" COMPU_TAB_REF FORMULA_0382_VTAB /end COMPU_METHOD
/begin COMPU_METHOD FORMULA_0383 "FORMULA_0383" TAB_VERB "%5.2" "-" COMPU_TAB_REF FORMULA_0383_VTAB /end COMPU_METHOD
/begin COMPU_METHOD FORMULA_0384 "FORMULA_0384" TAB_VERB "%5.2" "-" COMPU_TAB_REF FORMULA_0384_VTAB /end COMPU_METHOD
/begin COMPU_METHOD FORMULA_0385 "FORMULA_0385" TAB_VERB "%5.2" "-" COMPU_TAB_REF FORMULA_0385_VTAB /end COMPU_METHOD
/begin COMPU_METHOD FORMULA_0386 "FORMULA_0386" TAB_VERB "%5.2" "-" COMPU_TAB_REF FORMULA_0386_VTAB /end COMPU_METHOD
/begin COMPU_METHOD FORMULA_0387 "FORMULA_0387" TAB_VERB "%5.2" "-" COMPU_TAB_REF FORMULA_0387_VTAB /end COMPU_METHOD
/begin COMPU_METHOD FORMULA_0388 "FORMULA_0388" TAB_VERB "%7.2" "-" COMPU_TAB_REF FORMULA_0388_VTAB /end COMPU_METHOD
/begin COMPU_METHOD FORMULA_0389 "FORMULA_0389" TAB_VERB "%7.2" "-" COMPU_TAB_REF FORMULA_0389_VTAB /end COMPU_METHOD
/begin COMPU_METHOD FORMULA_0390 "FORMULA_0390" TAB_VERB "%3.0" "-" COMPU_TAB_REF FORMULA_0390_VTAB /end COMPU_METHOD
/begin COMPU_METHOD FORMULA_0391 "FORMULA_0391" TAB_VERB "%7.2" "-" COMPU_TAB_REF FORMULA_0391_VTAB /end COMPU_METHOD
/begin COMPU_METHOD FORMULA_0392 "FORMULA_0392" TAB_VERB "%7.2" "-" COMPU_TAB_REF FORMULA_0392_VTAB /end COMPU_METHOD
/begin COMPU_METHOD FORMULA_0393 "FORMULA_0393" TAB_VERB "%7.2" "-" COMPU_TAB_REF FORMULA_0393_VTAB /end COMPU_METHOD
/begin COMPU_METHOD FORMULA_0394 "FORMULA_0394" TAB_VERB "%7.2" "-" COMPU_TAB_REF FORMULA_0394_VTAB /end COMPU_METHOD
/begin COMPU_METHOD FORMULA_0395 "FORMULA_0395" TAB_VERB "%7.2" "-" COMPU_TAB_REF FORMULA_0395_VTAB /end COMPU_METHOD
/begin COMPU_METHOD FORMULA_0396 "FORMULA_0396" TAB_VERB "%7.2" "-" COMPU_TAB_REF FORMULA_0396_VTAB /end COMPU_METHOD
/begin COMPU_METHOD FORMULA_0397 "FORMULA_0397" TAB_VERB "%7.2" "-" COMPU_TAB_REF FORMULA_0397_VTAB /end COMPU_METHOD
/begin COMPU_METHOD FORMULA_0398 "FORMULA_0398" TAB_VERB "%7.2" "-" COMPU_TAB_REF FORMULA_0398_VTAB /end COMPU_METHOD
/begin COMPU_METHOD FORMULA_0399 "FORMULA_0399" TAB_VERB "%7.2" "-" COMPU_TAB_REF FORMULA_0399_VTAB /end COMPU_METHOD
/begin COMPU_METHOD FORMULA_0400 "FORMULA_0400" TAB_VERB "%7.2" "-" COMPU_TAB_REF FORMULA_0400_VTAB /end COMPU_METHOD
/begin COMPU_METHOD FORMULA_0401 "FORMULA_0401" TAB_VERB "%7.2" "-" COMPU_TAB_REF FORMULA_0401_VTAB /end COMPU_METHOD
/begin COMPU_METHOD FORMULA_0402 "FORMULA_0402" TAB_VERB "%7.2" "-" COMPU_TAB_REF FORMULA_0402_VTAB /end COMPU_METHOD
/begin COMPU_METHOD FORMULA_0403 "FORMULA_0403" TAB_VERB "%7.2" "-" COMPU_TAB_REF FORMULA_0403_VTAB /end COMPU_METHOD
/begin COMPU_METHOD FORMULA_0404 "FORMULA_0404" RAT_FUNC "%8.3" "ms" COEFFS 0 1000.0 0.0 0 0.0 1.0 /end COMPU_METHOD
/begin COMPU_METHOD FORMULA_0405 "FORMULA_0405" TAB_VERB "%3.0" "-" COMPU_TAB_REF FORMULA_0405_VTAB /end COMPU_METHOD
/begin COMPU_METHOD FORMULA_0406 "FORMULA_0406" RAT_FUNC "%6.1" "ms" COEFFS 0 3.92156862745098 0.0 0 0.0 1.0 /end COMPU_METHOD
/begin COMPU_METHOD FORMULA_0461 "FORMULA_0461" RAT_FUNC "%4.1" "s" COEFFS 0 10.0 0.0 0 0.0 1.0 /end COMPU_METHOD
/begin COMPU_METHOD FORMULA_0545 "FORMULA_0545" RAT_FUNC "%3.0" "Diags" COEFFS 0 1 0 0 0 1 /end COMPU_METHOD
/begin COMPU_METHOD FORMULA_0547 "FORMULA_0547" TAB_VERB "%5.2" "-" COMPU_TAB_REF FORMULA_0547_VTAB /end COMPU_METHOD
/begin COMPU_METHOD FORMULA_0548 "FORMULA_0548" TAB_VERB "%5.2" "-" COMPU_TAB_REF FORMULA_0548_VTAB /end COMPU_METHOD
/begin COMPU_METHOD FORMULA_0549 "FORMULA_0549" TAB_VERB "%5.2" "-" COMPU_TAB_REF FORMULA_0549_VTAB /end COMPU_METHOD
/begin COMPU_METHOD FORMULA_0550 "FORMULA_0550" TAB_VERB "%5.2" "-" COMPU_TAB_REF FORMULA_0550_VTAB /end COMPU_METHOD
/begin COMPU_METHOD FORMULA_0553 "FORMULA_0553" RAT_FUNC "%7.2" "mA" COEFFS 0 444.4444444444445 0.0 0 0.0 1.0 /end COMPU_METHOD
/begin COMPU_METHOD FORMULA_0555 "FORMULA_0555" TAB_VERB "%5.2" "-" COMPU_TAB_REF FORMULA_0555_VTAB /end COMPU_METHOD
/begin COMPU_METHOD FORMULA_0556 "FORMULA_0556" RAT_FUNC "%5.0" "min" COEFFS 0 1 0 0 0 1 /end COMPU_METHOD
/begin COMPU_METHOD FORMULA_0559 "FORMULA_0559" RAT_FUNC "%4.1" "l" COEFFS 0 2.0 0.0 0 0.0 1.0 /end COMPU_METHOD
/begin COMPU_METHOD FORMULA_0563 "FORMULA_0563" RAT_FUNC "%8.3" "kg/h" COEFFS 0 1000.0 0.0 0 0.0 1.0 /end COMPU_METHOD
/begin COMPU_METHOD FORMULA_0570 "FORMULA_0570" RAT_FUNC "%7.2" "-*s" COEFFS 0 16384.0 0.0 0 0.0 1.0 /end COMPU_METHOD
/begin COMPU_METHOD FORMULA_0593 "FORMULA_0593" RAT_FUNC "%5.0" "s" COEFFS 0 1 0 0 0 1 /end COMPU_METHOD
/begin COMPU_METHOD FORMULA_0610 "FORMULA_0610" RAT_FUNC "%6.1" "l" COEFFS 0 2.0 0.0 0 0.0 1.0 /end COMPU_METHOD
/begin COMPU_METHOD FORMULA_0630 "FORMULA_0630" TAB_VERB "%5.2" "-" COMPU_TAB_REF FORMULA_0630_VTAB /end COMPU_METHOD
/begin COMPU_METHOD FORMULA_0631 "FORMULA_0631" TAB_VERB "%5.2" "-" COMPU_TAB_REF FORMULA_0631_VTAB /end COMPU_METHOD
/begin COMPU_METHOD FORMULA_0632 "FORMULA_0632" TAB_VERB "%5.2" "-" COMPU_TAB_REF FORMULA_0632_VTAB /end COMPU_METHOD
/begin COMPU_METHOD FORMULA_0633 "FORMULA_0633" TAB_VERB "%5.2" "-" COMPU_TAB_REF FORMULA_0633_VTAB /end COMPU_METHOD
/begin COMPU_METHOD FORMULA_0634 "FORMULA_0634" TAB_VERB "%5.2" "-" COMPU_TAB_REF FORMULA_0634_VTAB /end COMPU_METHOD
/begin COMPU_METHOD FORMULA_0635 "FORMULA_0635" TAB_VERB "%5.2" "-" COMPU_TAB_REF FORMULA_0635_VTAB /end COMPU_METHOD
/begin COMPU_METHOD FORMULA_0636 "FORMULA_0636" TAB_VERB "%5.2" "-" COMPU_TAB_REF FORMULA_0636_VTAB /end COMPU_METHOD
/begin COMPU_METHOD FORMULA_0637 "FORMULA_0637" TAB_VERB "%5.2" "-" COMPU_TAB_REF FORMULA_0637_VTAB /end COMPU_METHOD
/begin COMPU_METHOD FORMULA_0638 "FORMULA_0638" RAT_FUNC "%5.2" "" COEFFS 0 128.0 0.0 0 0.0 1.0 /end COMPU_METHOD
/begin COMPU_METHOD FORMULA_0639 "FORMULA_0639" RAT_FUNC "%7.2" "uA" COEFFS 0 29127.11111111111 0.0 0 0.0 1.0 /end COMPU_METHOD
/begin COMPU_METHOD FORMULA_0640 "FORMULA_0640" RAT_FUNC "%3.0" "ms" COEFFS 0 2.0 0.0 0 0.0 1.0 /end COMPU_METHOD
/begin COMPU_METHOD FORMULA_0641 "FORMULA_0641" TAB_VERB "%5.2" "-" COMPU_TAB_REF FORMULA_0641_VTAB /end COMPU_METHOD
/begin COMPU_METHOD FORMULA_0642 "FORMULA_0642" RAT_FUNC "%5.2" "" COEFFS 0 255.0 0.0 0 0.0 1.0 /end COMPU_METHOD
/begin COMPU_METHOD FORMULA_0643 "FORMULA_0643" TAB_VERB "%5.2" "-" COMPU_TAB_REF FORMULA_0643_VTAB /end COMPU_METHOD
/begin COMPU_METHOD FORMULA_0644 "FORMULA_0644" RAT_FUNC "%6.1" "s" COEFFS 0 100.0 0.0 0 0.0 1.0 /end COMPU_METHOD
/begin COMPU_METHOD FORMULA_0645 "FORMULA_0645" RAT_FUNC "%6.3" "s" COEFFS 0 0 1.28 0 1 0 /end COMPU_METHOD
/begin COMPU_METHOD FORMULA_0646 "FORMULA_0646" RAT_FUNC "%3.0" "ms" COEFFS 0 1 0 0 0 1 /end COMPU_METHOD
/begin COMPU_METHOD FORMULA_0647 "FORMULA_0647" RAT_FUNC "%3.0" "ms" COEFFS 0 0.2 0.0 0 0.0 1.0 /end COMPU_METHOD
/begin COMPU_METHOD FORMULA_0648 "FORMULA_0648" RAT_FUNC "%6.1" "min" COEFFS 0 5.859377288819253 0.0 0 0.0 1.0 /end COMPU_METHOD
/begin COMPU_METHOD FORMULA_0649 "FORMULA_0649" RAT_FUNC "%5.2" "-" COEFFS 0 32.0 0.0 0 0.0 1.0 /end COMPU_METHOD
/begin COMPU_METHOD FORMULA_0650 "FORMULA_0650" TAB_VERB "%5.2" "-" COMPU_TAB_REF FORMULA_0650_VTAB /end COMPU_METHOD
/begin COMPU_METHOD FORMULA_0651 "FORMULA_0651" RAT_FUNC "%7.2" "V" COEFFS 0 640.0 0.0 0 0.0 1.0 /end COMPU_METHOD
/begin COMPU_METHOD FORMULA_0652 "FORMULA_0652" RAT_FUNC "%3.0" "s" COEFFS 0 0.5 0.0 0 0.0 1.0 /end COMPU_METHOD
/begin COMPU_METHOD FORMULA_0658 "FORMULA_0658" RAT_FUNC "%5.2" "s" COEFFS 0 0 2.56 0 1 0 /end COMPU_METHOD
/begin COMPU_METHOD FORMULA_0668 "FORMULA_0668" RAT_FUNC "%5.0" "ms" COEFFS 0 1.e-002 0.0 0 0.0 1.0 /end COMPU_METHOD
/begin COMPU_METHOD FORMULA_0679 "FORMULA_0679" RAT_FUNC "%5.2" "s" COEFFS 0 0 25.6 0 1 0 /end COMPU_METHOD
/begin COMPU_METHOD FORMULA_0706 "FORMULA_0706" RAT_FUNC "%6.1" "%" COEFFS 0 100.0 0.0 0 0.0 1.0 /end COMPU_METHOD
/begin COMPU_METHOD FORMULA_0786 "FORMULA_0786" RAT_FUNC "%7.2" "ms" COEFFS 0 1000.0 0.0 0 0.0 1.0 /end COMPU_METHOD
/begin COMPU_METHOD FORMULA_0806 "FORMULA_0806" RAT_FUNC "%7.2" "-" COEFFS 0 128.0 0.0 0 0.0 1.0 /end COMPU_METHOD
/begin COMPU_METHOD FORMULA_0831 "FORMULA_0831" TAB_VERB "%5.2" "-" COMPU_TAB_REF FORMULA_0831_VTAB /end COMPU_METHOD
/begin COMPU_METHOD FORMULA_0985 "FORMULA_0985" RAT_FUNC "%7.2" "ms" COEFFS 0 100.0 0.0 0 0.0 1.0 /end COMPU_METHOD
/begin COMPU_METHOD FORMULA_1052 "FORMULA_1052" RAT_FUNC "%7.2" "s" COEFFS 0 0 6553.5 0 1 0 /end COMPU_METHOD
/begin COMPU_METHOD FORMULA_1076 "FORMULA_1076" RAT_FUNC "%6.1" "Hz" COEFFS 0 10.0 0.0 0 0.0 1.0 /end COMPU_METHOD
/begin COMPU_METHOD FORMULA_1078 "FORMULA_1078" TAB_VERB "%7.2" "-" COMPU_TAB_REF FORMULA_1078_VTAB /end COMPU_METHOD
/begin COMPU_METHOD FORMULA_1079 "FORMULA_1079" TAB_VERB "%5.2" "-" COMPU_TAB_REF FORMULA_1079_VTAB /end COMPU_METHOD
/begin COMPU_METHOD FORMULA_1080 "FORMULA_1080" TAB_VERB "%7.2" "-" COMPU_TAB_REF FORMULA_1080_VTAB /end COMPU_METHOD
/begin COMPU_METHOD FORMULA_1081 "FORMULA_1081" RAT_FUNC "%4.1" "%" COEFFS 0 1.28 0.0 0 0.0 1.0 /end COMPU_METHOD
/begin COMPU_METHOD FORMULA_1082 "FORMULA_1082" RAT_FUNC "%7.2" "Nm/Upm" COEFFS 0 5120.0 0.0 0 0.0 1.0 /end COMPU_METHOD
/begin COMPU_METHOD FORMULA_1083 "FORMULA_1083" TAB_VERB "%3.0" "-" COMPU_TAB_REF FORMULA_1083_VTAB /end COMPU_METHOD
/begin COMPU_METHOD FORMULA_1084 "FORMULA_1084" TAB_VERB "%3.0" "-" COMPU_TAB_REF FORMULA_1084_VTAB /end COMPU_METHOD
/begin COMPU_METHOD FORMULA_1085 "FORMULA_1085" TAB_VERB "%3.0" "-" COMPU_TAB_REF FORMULA_1085_VTAB /end COMPU_METHOD
/begin COMPU_METHOD FORMULA_1086 "FORMULA_1086" RAT_FUNC "%3.0" "digit" COEFFS 0 1 0 0 0 1 /end COMPU_METHOD
/begin COMPU_METHOD FORMULA_1087 "FORMULA_1087" TAB_VERB "%5.2" "-" COMPU_TAB_REF FORMULA_1087_VTAB /end COMPU_METHOD
/begin COMPU_METHOD FORMULA_1088 "FORMULA_1088" TAB_VERB "%5.2" "-" COMPU_TAB_REF FORMULA_1088_VTAB /end COMPU_METHOD
/begin COMPU_METHOD FORMULA_1089 "FORMULA_1089" RAT_FUNC "%8.3" "-/100ms" COEFFS 0 32768.0 0.0 0 0.0 1.0 /end COMPU_METHOD
/begin COMPU_METHOD FORMULA_1090 "FORMULA_1090" RAT_FUNC "%8.3" "delta_lam" COEFFS 0 16384.0 0.0 0 0.0 1.0 /end COMPU_METHOD
/begin COMPU_METHOD FORMULA_1091 "FORMULA_1091" RAT_FUNC "%8.1" "kg*s/h" COEFFS 0 1000.0 0.0 0 0.0 1.0 /end COMPU_METHOD
/begin COMPU_METHOD FORMULA_1092 "FORMULA_1092" RAT_FUNC "%6.1" "kg/h" COEFFS 0 125.0 0.0 0 0.0 1.0 /end COMPU_METHOD
/begin COMPU_METHOD FORMULA_1093 "FORMULA_1093" TAB_VERB "%8.1" "-" COMPU_TAB_REF FORMULA_1093_VTAB /end COMPU_METHOD
/begin COMPU_METHOD FORMULA_1094 "FORMULA_1094" TAB_VERB "%6.1" "-" COMPU_TAB_REF FORMULA_1094_VTAB /end COMPU_METHOD
/begin COMPU_METHOD FORMULA_1095 "FORMULA_1095" TAB_VERB "%7.2" "-" COMPU_TAB_REF FORMULA_1095_VTAB /end COMPU_METHOD
/begin COMPU_METHOD FORMULA_1096 "FORMULA_1096" TAB_VERB "%7.2" "-" COMPU_TAB_REF FORMULA_1096_VTAB /end COMPU_METHOD
/begin COMPU_METHOD FORMULA_1097 "FORMULA_1097" TAB_VERB "%7.2" "-" COMPU_TAB_REF FORMULA_1097_VTAB /end COMPU_METHOD
/begin COMPU_METHOD FORMULA_1098 "FORMULA_1098" TAB_VERB "%7.2" "-" COMPU_TAB_REF FORMULA_1098_VTAB /end COMPU_METHOD
/begin COMPU_METHOD FORMULA_1099 "FORMULA_1099" TAB_VERB "%7.2" "-" COMPU_TAB_REF FORMULA_1099_VTAB /end COMPU_METHOD
/begin COMPU_METHOD FORMULA_1100 "FORMULA_1100" TAB_VERB "%7.2" "-" COMPU_TAB_REF FORMULA_1100_VTAB /end COMPU_METHOD
/begin COMPU_METHOD FORMULA_1101 "FORMULA_1101" TAB_VERB "%7.2" "-" COMPU_TAB_REF FORMULA_1101_VTAB /end COMPU_METHOD
/begin COMPU_METHOD FORMULA_1102 "FORMULA_1102" TAB_VERB "%7.2" "-" COMPU_TAB_REF FORMULA_1102_VTAB /end COMPU_METHOD
/begin COMPU_METHOD FORMULA_1103 "FORMULA_1103" TAB_VERB "%7.2" "-" COMPU_TAB_REF FORMULA_1103_VTAB /end COMPU_METHOD
/begin COMPU_METHOD FORMULA_1104 "FORMULA_1104" TAB_VERB "%7.2" "-" COMPU_TAB_REF FORMULA_1104_VTAB /end COMPU_METHOD
/begin COMPU_METHOD FORMULA_1105 "FORMULA_1105" TAB_VERB "%7.2" "-" COMPU_TAB_REF FORMULA_1105_VTAB /end COMPU_METHOD
/begin COMPU_METHOD FORMULA_1106 "FORMULA_1106" TAB_VERB "%7.2" "-" COMPU_TAB_REF FORMULA_1106_VTAB /end COMPU_METHOD
/begin COMPU_METHOD FORMULA_1107 "FORMULA_1107" TAB_VERB "%7.2" "-" COMPU_TAB_REF FORMULA_1107_VTAB /end COMPU_METHOD
/begin COMPU_METHOD FORMULA_1108 "FORMULA_1108" TAB_VERB "%7.2" "-" COMPU_TAB_REF FORMULA_1108_VTAB /end COMPU_METHOD
/begin COMPU_METHOD FORMULA_1109 "FORMULA_1109" TAB_VERB "%7.2" "-" COMPU_TAB_REF FORMULA_1109_VTAB /end COMPU_METHOD
/begin COMPU_METHOD FORMULA_1110 "FORMULA_1110" TAB_VERB "%7.2" "-" COMPU_TAB_REF FORMULA_1110_VTAB /end COMPU_METHOD
/begin COMPU_METHOD FORMULA_1111 "FORMULA_1111" TAB_VERB "%7.2" "-" COMPU_TAB_REF FORMULA_1111_VTAB /end COMPU_METHOD
/begin COMPU_METHOD FORMULA_1112 "FORMULA_1112" RAT_FUNC "%10.3" "-*s" COEFFS 0 16384.0 0.0 0 0.0 1.0 /end COMPU_METHOD
/begin COMPU_METHOD FORMULA_1113 "FORMULA_1113" RAT_FUNC "%6.1" "kg/h/0.01s" COEFFS 0 10.0 0.0 0 0.0 1.0 /end COMPU_METHOD
/begin COMPU_METHOD FORMULA_1114 "FORMULA_1114" TAB_VERB "%5.2" "-" COMPU_TAB_REF FORMULA_1114_VTAB /end COMPU_METHOD
/begin COMPU_METHOD FORMULA_1115 "FORMULA_1115" RAT_FUNC "%8.3" "kg*s/h" COEFFS 0 1000.0 0.0 0 0.0 1.0 /end COMPU_METHOD
/begin COMPU_METHOD FORMULA_1116 "FORMULA_1116" TAB_VERB "%5.2" "-" COMPU_TAB_REF FORMULA_1116_VTAB /end COMPU_METHOD
/begin COMPU_METHOD FORMULA_1117 "FORMULA_1117" TAB_VERB "%5.2" "-" COMPU_TAB_REF FORMULA_1117_VTAB /end COMPU_METHOD
/begin COMPU_METHOD FORMULA_1118 "FORMULA_1118" RAT_FUNC "%9.4" "J/(kg*K*m^4)" COEFFS 0 65535.0 0.0 0 0.0 1.0 /end COMPU_METHOD
/begin COMPU_METHOD FORMULA_1119 "FORMULA_1119" RAT_FUNC "%8.3" "kg/h" COEFFS 0 125.0 0.0 0 0.0 1.0 /end COMPU_METHOD
/begin COMPU_METHOD FORMULA_1120 "FORMULA_1120" RAT_FUNC "%3.0" "kHz" COEFFS 0 0 10000000 0 714 0 /end COMPU_METHOD
/begin COMPU_METHOD FORMULA_1121 "FORMULA_1121" RAT_FUNC "%5.0" "kHz" COEFFS 0 0 10000000 0 714 0 /end COMPU_METHOD
/begin COMPU_METHOD FORMULA_1124 "FORMULA_1124" TAB_VERB "%5.2" "-" COMPU_TAB_REF FORMULA_1124_VTAB /end COMPU_METHOD
/begin COMPU_METHOD FORMULA_1125 "FORMULA_1125" TAB_VERB "%5.2" "-" COMPU_TAB_REF FORMULA_1125_VTAB /end COMPU_METHOD
/begin COMPU_METHOD FORMULA_1126 "FORMULA_1126" TAB_VERB "%5.2" "-" COMPU_TAB_REF FORMULA_1126_VTAB /end COMPU_METHOD
/begin COMPU_METHOD FORMULA_1127 "FORMULA_1127" TAB_VERB "%5.2" "-" COMPU_TAB_REF FORMULA_1127_VTAB /end COMPU_METHOD
/begin COMPU_METHOD FORMULA_1128 "FORMULA_1128" TAB_VERB "%5.2" "-" COMPU_TAB_REF FORMULA_1128_VTAB /end COMPU_METHOD
/begin COMPU_METHOD FORMULA_1129 "FORMULA_1129" RAT_FUNC "%9.4" "1/100ms" COEFFS 0 32768.0 0.0 0 0.0 1.0 /end COMPU_METHOD
/begin COMPU_METHOD FORMULA_1130 "FORMULA_1130" RAT_FUNC "%8.3" "m3/kg" COEFFS 0 1000.0 0.0 0 0.0 1.0 /end COMPU_METHOD
/begin COMPU_METHOD FORMULA_1131 "FORMULA_1131" RAT_FUNC "%5.0" "(kg/(m2*s))2" COEFFS 0 0.1111111111111111 0.0 0 0.0 1.0 /end COMPU_METHOD
/begin COMPU_METHOD FORMULA_1132 "FORMULA_1132" RAT_FUNC "%5.0" "kg/(m2*s)" COEFFS 0 1 0 0 0 1 /end COMPU_METHOD
/begin COMPU_METHOD FORMULA_1133 "FORMULA_1133" RAT_FUNC "%8.3" "J/kg*K" COEFFS 0 1 0 0 0 1 /end COMPU_METHOD
/begin COMPU_METHOD FORMULA_1134 "FORMULA_1134" TAB_VERB "%7.2" "-" COMPU_TAB_REF FORMULA_1134_VTAB /end COMPU_METHOD
/begin COMPU_METHOD FORMULA_1135 "FORMULA_1135" TAB_VERB "%7.2" "-" COMPU_TAB_REF FORMULA_1135_VTAB /end COMPU_METHOD
/begin COMPU_METHOD FORMULA_1136 "FORMULA_1136" TAB_VERB "%7.2" "-" COMPU_TAB_REF FORMULA_1136_VTAB /end COMPU_METHOD
/begin COMPU_METHOD FORMULA_1137 "FORMULA_1137" TAB_VERB "%7.2" "-" COMPU_TAB_REF FORMULA_1137_VTAB /end COMPU_METHOD
/begin COMPU_METHOD FORMULA_1138 "FORMULA_1138" TAB_VERB "%7.2" "-" COMPU_TAB_REF FORMULA_1138_VTAB /end COMPU_METHOD
/begin COMPU_METHOD FORMULA_1139 "FORMULA_1139" TAB_VERB "%7.2" "-" COMPU_TAB_REF FORMULA_1139_VTAB /end COMPU_METHOD
/begin COMPU_METHOD FORMULA_1140 "FORMULA_1140" TAB_VERB "%7.2" "-" COMPU_TAB_REF FORMULA_1140_VTAB /end COMPU_METHOD
/begin COMPU_METHOD FORMULA_1141 "FORMULA_1141" TAB_VERB "%7.2" "-" COMPU_TAB_REF FORMULA_1141_VTAB /end COMPU_METHOD
/begin COMPU_METHOD FORMULA_1142 "FORMULA_1142" TAB_VERB "%7.2" "-" COMPU_TAB_REF FORMULA_1142_VTAB /end COMPU_METHOD
/begin COMPU_METHOD FORMULA_1143 "FORMULA_1143" TAB_VERB "%7.2" "-" COMPU_TAB_REF FORMULA_1143_VTAB /end COMPU_METHOD
/begin COMPU_METHOD FORMULA_1144 "FORMULA_1144" TAB_VERB "%7.2" "-" COMPU_TAB_REF FORMULA_1144_VTAB /end COMPU_METHOD
/begin COMPU_METHOD FORMULA_1145 "FORMULA_1145" TAB_VERB "%7.2" "-" COMPU_TAB_REF FORMULA_1145_VTAB /end COMPU_METHOD
/begin COMPU_METHOD FORMULA_1146 "FORMULA_1146" TAB_VERB "%7.2" "-" COMPU_TAB_REF FORMULA_1146_VTAB /end COMPU_METHOD
/begin COMPU_METHOD FORMULA_1147 "FORMULA_1147" TAB_VERB "%7.2" "-" COMPU_TAB_REF FORMULA_1147_VTAB /end COMPU_METHOD
/begin COMPU_METHOD FORMULA_1148 "FORMULA_1148" TAB_VERB "%7.2" "-" COMPU_TAB_REF FORMULA_1148_VTAB /end COMPU_METHOD
/begin COMPU_METHOD FORMULA_1149 "FORMULA_1149" TAB_VERB "%7.2" "-" COMPU_TAB_REF FORMULA_1149_VTAB /end COMPU_METHOD
/begin COMPU_METHOD FORMULA_1150 "FORMULA_1150" TAB_VERB "%7.2" "-" COMPU_TAB_REF FORMULA_1150_VTAB /end COMPU_METHOD
/begin COMPU_METHOD FORMULA_1151 "FORMULA_1151" RAT_FUNC "%8.3" "l/min" COEFFS 0 500.0 0.0 0 0.0 1.0 /end COMPU_METHOD
/begin COMPU_METHOD FORMULA_1152 "FORMULA_1152" RAT_FUNC "%9.2" "l" COEFFS 0 300000.0 0.0 0 0.0 1.0 /end COMPU_METHOD
/begin COMPU_METHOD FORMULA_1153 "FORMULA_1153" RAT_FUNC "%8.3" "qmm" COEFFS 0 1000.0 0.0 0 0.0 1.0 /end COMPU_METHOD
/begin COMPU_METHOD FORMULA_1154 "FORMULA_1154" RAT_FUNC "%6.1" "l" COEFFS 0 4.57763671875 0.0 0 0.0 1.0 /end COMPU_METHOD
/begin COMPU_METHOD FORMULA_1155 "FORMULA_1155" TAB_VERB "%5.2" "-" COMPU_TAB_REF FORMULA_1155_VTAB /end COMPU_METHOD
/begin COMPU_METHOD FORMULA_1156 "FORMULA_1156" TAB_VERB "%5.2" "-" COMPU_TAB_REF FORMULA_1156_VTAB /end COMPU_METHOD
/begin COMPU_METHOD FORMULA_1157 "FORMULA_1157" RAT_FUNC "%7.2" "%lam/s" COEFFS 0 81.92 0.0 0 0.0 1.0 /end COMPU_METHOD
/begin COMPU_METHOD FORMULA_1158 "FORMULA_1158" TAB_VERB "%5.2" "-" COMPU_TAB_REF FORMULA_1158_VTAB /end COMPU_METHOD
/begin COMPU_METHOD FORMULA_1159 "FORMULA_1159" TAB_VERB "%7.2" "-" COMPU_TAB_REF FORMULA_1159_VTAB /end COMPU_METHOD
/begin COMPU_METHOD FORMULA_1160 "FORMULA_1160" RAT_FUNC "%5.0" "kg/(m2*s)" COEFFS 0 0.3333333333333333 0.0 0 0.0 1.0 /end COMPU_METHOD
/begin COMPU_METHOD FORMULA_1161 "FORMULA_1161" RAT_FUNC "%7.2" "nSs" COEFFS 0 1639.344262295082 0.0 0 0.0 1.0 /end COMPU_METHOD
/begin COMPU_METHOD FORMULA_1162 "FORMULA_1162" RAT_FUNC "%7.2" "kg/h" COEFFS 0 640.0 0.0 0 0.0 1.0 /end COMPU_METHOD
/begin COMPU_METHOD FORMULA_1163 "FORMULA_1163" TAB_VERB "%5.2" "-" COMPU_TAB_REF FORMULA_1163_VTAB /end COMPU_METHOD
/begin COMPU_METHOD FORMULA_1164 "FORMULA_1164" TAB_VERB "%5.2" "-" COMPU_TAB_REF FORMULA_1164_VTAB /end COMPU_METHOD
/begin COMPU_METHOD FORMULA_1165 "FORMULA_1165" TAB_VERB "%5.2" "-" COMPU_TAB_REF FORMULA_1165_VTAB /end COMPU_METHOD
/begin COMPU_METHOD FORMULA_1166 "FORMULA_1166" RAT_FUNC "%6.1" "%/100ms" COEFFS 0 10.24 0.0 0 0.0 1.0 /end COMPU_METHOD
/begin COMPU_VTAB FORMULA_0002_VTAB "FORMULA_0002_VTAB" TAB_VERB 4 0 "in Ordnung" 128 "queue full" 64 "queue fehler" 32 "IRQ illegal" DEFAULT_VALUE "undefiniert" /end COMPU_VTAB
/begin COMPU_VTAB FORMULA_0011_VTAB "FORMULA_0011_VTAB" TAB_VERB 14 0 "kein Fehler" 1 "Egasueberwachung" 2 "Momentenueberwachung" 4 "Einspritzueberwachung" 8 "SMG-Ueberwachung" 16 "Systemfehler" 32 "Stackueberwachung" 64 "Resetanzahl" 128 "Gemischfehler" 512 "CRC-Check" 1024 "Taskueberwachung" 2048 "Prozessueberwachung" 4096 "Pedalwertgeber" 8192 "Mastervac" DEFAULT_VALUE "undef" /end COMPU_VTAB
/begin COMPU_VTAB FORMULA_0015_VTAB "FORMULA_0015_VTAB" TAB_VERB 6 512 "MCI" 768 "DataAcc" 1024 "IntrAcc" 1536 "Align" 1792 "PrgExc" 8192 "NMI" /end COMPU_VTAB
/begin COMPU_VTAB FORMULA_0167_VTAB "FORMULA_0167_VTAB" TAB_VERB 1 0 "kein Fehler" /end COMPU_VTAB
/begin COMPU_VTAB FORMULA_0179_VTAB "FORMULA_0179_VTAB" TAB_VERB 1 0 "alle ein" /end COMPU_VTAB
/begin COMPU_VTAB FORMULA_0200_VTAB "FORMULA_0200_VTAB" TAB_VERB 2 0 "nein" 1 "ja" /end COMPU_VTAB
/begin COMPU_VTAB FORMULA_0362_VTAB "FORMULA_0362_VTAB" TAB_VERB 2 0 "Aus" 1 "Ein" /end COMPU_VTAB
/begin COMPU_VTAB FORMULA_0367_VTAB "FORMULA_0367_VTAB" TAB_VERB 1 0 "Inaktiv" DEFAULT_VALUE "Aktiv" /end COMPU_VTAB
/begin COMPU_VTAB FORMULA_0368_VTAB "FORMULA_0368_VTAB" TAB_VERB 2 0 "SK aus" 1 "SK aktiv" /end COMPU_VTAB
/begin COMPU_VTAB FORMULA_0369_VTAB "FORMULA_0369_VTAB" TAB_VERB 5 0 "Aus" 1 "MVAC" 2 "ELUP" 3 "MVAC+ELUP" 6 "System" /end COMPU_VTAB
/begin COMPU_VTAB FORMULA_0370_VTAB "FORMULA_0370_VTAB" TAB_VERB 8 0 "Inaktiv" 1 "D-CRC" 2 "P-CRC" 3 "PD-CRC" 4 "B-CRC" 5 "BD-CRC" 6 "BP-CRC" 7 "BPD-CRC" /end COMPU_VTAB
/begin COMPU_VTAB FORMULA_0371_VTAB "FORMULA_0371_VTAB" TAB_VERB 8 0 "alle an" 3 "LA" 12 "LAA" 15 "LA+LAA" 48 "Mager" 51 "LA+Mager" 60 "LAA+Mager" 63 "LA+LAA+Mager" /end COMPU_VTAB
/begin COMPU_VTAB FORMULA_0372_VTAB "FORMULA_0372_VTAB" TAB_VERB 8 0 "alle an" 1 "LA" 2 "LAA" 3 "LA+LAA" 4 "Mager" 5 "LA+Mager" 6 "LAA+Mager" 7 "LA+LAA+Mager" /end COMPU_VTAB
/begin COMPU_VTAB FORMULA_0373_VTAB "FORMULA_0373_VTAB" TAB_VERB 2 0 "aktiv" 1 "gesperrt" /end COMPU_VTAB
/begin COMPU_VTAB FORMULA_0374_VTAB "FORMULA_0374_VTAB" TAB_VERB 23 0 "kein Fehler" 5 "Motortemperatur" 6 "Oeltemperatur" 10 "SMG-Schaltablauf" 11 "SMG-Eingriff" 12 "SMG-Sollmoment" 13 "SMG-nGetr" 14 "SMG-Gang" 20 "LLR-Plausi" 21 "Minimalmoment" 22 "Maximalmoment" 23 "Istmoment" 24 "Schleppmoment" 25 "Soll-Istvergleich" 26 "rel. Fahrerwunsch" 30 "Luftmasse" 40 "Drehzahl" 50 "Pedalwert" 60 "Bremslichtschalter" 80 "Komplementvergleich" 85 "Fehler Testrechnung" 86 "Timeout Testrechnung" 90 "Maxdrehzahl" /end COMPU_VTAB
/begin COMPU_VTAB FORMULA_0375_VTAB "FORMULA_0375_VTAB" TAB_VERB 2 0 "frei" 128 "Belegt" DEFAULT_VALUE "undefiniert" /end COMPU_VTAB
/begin COMPU_VTAB FORMULA_0376_VTAB "FORMULA_0376_VTAB" TAB_VERB 5 8192 "S65" 8448 "S65FLACH" 8704 "S65V" 256 "S15" 16384 "S85" DEFAULT_VALUE "undefiniert" /end COMPU_VTAB
/begin COMPU_VTAB FORMULA_0377_VTAB "FORMULA_0377_VTAB" TAB_VERB 7 16 "E60" 17 "E63" 18 "E64" 32 "E65" 64 "E85" 128 "E90" 129 "E91" DEFAULT_VALUE "undefiniert" /end COMPU_VTAB
/begin COMPU_VTAB FORMULA_0378_VTAB "FORMULA_0378_VTAB" TAB_VERB 4 16 "HS" 64 "SMG" 128 "DKG" 255 "CAN_ID" DEFAULT_VALUE "undefiniert" /end COMPU_VTAB
/begin COMPU_VTAB FORMULA_0379_VTAB "FORMULA_0379_VTAB" TAB_VERB 5 1 "ECE" 2 "US" 4 "Golfstaaten" 8 "ZA" 16 "JAPAN" DEFAULT_VALUE "undefiniert" /end COMPU_VTAB
/begin COMPU_VTAB FORMULA_0380_VTAB "FORMULA_0380_VTAB" TAB_VERB 6 16 "EU3" 17 "EU4" 1 "D4" 32 "LEV" 33 "LEV2" 34 "ULEV" DEFAULT_VALUE "undefiniert" /end COMPU_VTAB
/begin COMPU_VTAB FORMULA_0381_VTAB "FORMULA_0381_VTAB" TAB_VERB 3 1 "MIL_OFF" 2 "MIL_FSP" 4 "MIL_ON" DEFAULT_VALUE "undefiniert" /end COMPU_VTAB
/begin COMPU_VTAB FORMULA_0382_VTAB "FORMULA_0382_VTAB" TAB_VERB 2 128 "Serienstand" 1 "Entwicklung" DEFAULT_VALUE "undefiniert" /end COMPU_VTAB
/begin COMPU_VTAB FORMULA_0383_VTAB "FORMULA_0383_VTAB" TAB_VERB 2 1 "CAN 11H" 2 "CAN 12H" DEFAULT_VALUE "undefiniert" /end COMPU_VTAB
/begin COMPU_VTAB FORMULA_0384_VTAB "FORMULA_0384_VTAB" TAB_VERB 3 0 "Fz-Betrieb" 1 "Pruefstand" 2 "Rolle" /end COMPU_VTAB
/begin COMPU_VTAB FORMULA_0385_VTAB "FORMULA_0385_VTAB" TAB_VERB 4 0 "auto Erkennung" 1 "ApplDFlash, rest auto" 2 "ETH aus, rest auto" 3 "ApplDFlash, ETH aus" DEFAULT_VALUE "ungueltig" /end COMPU_VTAB
/begin COMPU_VTAB FORMULA_0386_VTAB "FORMULA_0386_VTAB" TAB_VERB 2 0 "Teves" 1 "Bosch" /end COMPU_VTAB
/begin COMPU_VTAB FORMULA_0387_VTAB "FORMULA_0387_VTAB" TAB_VERB 3 0 "Aus" 1 "dSPACE" 2 "noLoop" /end COMPU_VTAB
/begin COMPU_VTAB FORMULA_0388_VTAB "FORMULA_0388_VTAB" TAB_VERB 2 0 "Dauerbestromung TPU" 1 "Dauerbestromung Treiber" DEFAULT_VALUE "undef" /end COMPU_VTAB
/begin COMPU_VTAB FORMULA_0389_VTAB "FORMULA_0389_VTAB" TAB_VERB 5 1 "Boot" 2 "FpFlash/iD" 4 "FpRAM/iD" 10 "FpFlash/eD" 12 "FpRAM/eD" DEFAULT_VALUE "undefiniert" /end COMPU_VTAB
/begin COMPU_VTAB FORMULA_0390_VTAB "FORMULA_0390_VTAB" TAB_VERB 3 0 "Prozessor" 1 "Selbst" 2 "Kollege" DEFAULT_VALUE "undef" /end COMPU_VTAB
/begin COMPU_VTAB FORMULA_0391_VTAB "FORMULA_0391_VTAB" TAB_VERB 1 0 "no" DEFAULT_VALUE "ja" /end COMPU_VTAB
/begin COMPU_VTAB FORMULA_0392_VTAB "FORMULA_0392_VTAB" TAB_VERB 1 0 "no" DEFAULT_VALUE "ja" /end COMPU_VTAB
/begin COMPU_VTAB FORMULA_0393_VTAB "FORMULA_0393_VTAB" TAB_VERB 1 0 "no" DEFAULT_VALUE "ja" /end COMPU_VTAB
/begin COMPU_VTAB FORMULA_0394_VTAB "FORMULA_0394_VTAB" TAB_VERB 1 0 "no" DEFAULT_VALUE "ja" /end COMPU_VTAB
/begin COMPU_VTAB FORMULA_0395_VTAB "FORMULA_0395_VTAB" TAB_VERB 1 0 "no" DEFAULT_VALUE "ja" /end COMPU_VTAB
/begin COMPU_VTAB FORMULA_0396_VTAB "FORMULA_0396_VTAB" TAB_VERB 1 0 "no" DEFAULT_VALUE "ja" /end COMPU_VTAB
/begin COMPU_VTAB FORMULA_0397_VTAB "FORMULA_0397_VTAB" TAB_VERB 1 0 "no" DEFAULT_VALUE "ja" /end COMPU_VTAB
/begin COMPU_VTAB FORMULA_0398_VTAB "FORMULA_0398_VTAB" TAB_VERB 1 0 "no" DEFAULT_VALUE "ja" /end COMPU_VTAB
/begin COMPU_VTAB FORMULA_0399_VTAB "FORMULA_0399_VTAB" TAB_VERB 1 0 "no" DEFAULT_VALUE "ja" /end COMPU_VTAB
/begin COMPU_VTAB FORMULA_0400_VTAB "FORMULA_0400_VTAB" TAB_VERB 1 0 "no" DEFAULT_VALUE "ja" /end COMPU_VTAB
/begin COMPU_VTAB FORMULA_0401_VTAB "FORMULA_0401_VTAB" TAB_VERB 1 0 "no" DEFAULT_VALUE "ja" /end COMPU_VTAB
/begin COMPU_VTAB FORMULA_0402_VTAB "FORMULA_0402_VTAB" TAB_VERB 1 0 "no" DEFAULT_VALUE "ja" /end COMPU_VTAB
/begin COMPU_VTAB FORMULA_0403_VTAB "FORMULA_0403_VTAB" TAB_VERB 1 0 "no" DEFAULT_VALUE "ja" /end COMPU_VTAB
/begin COMPU_VTAB FORMULA_0405_VTAB "FORMULA_0405_VTAB" TAB_VERB 59 0 "kein Fehler" 1 "Adaptionsdaten CRC32" 2 "Programm CRC32" 3 "Daten CRC32" 4 "undef" 5 "undef" 6 "Watchdog-Reset" 7 "Reset" 8 "CRC Boot" 9 "Reset-MCI" 10 "Reset-Data" 11 "Reset-Instr" 13 "Reset-Align" 14 "Reset-Prog" 15 "Reset-NoFp" 19 "Reset-System" 20 "Reset-Trace" 21 "Reset-FpAss" 22 "Reset-Perform" 23 "Reset-SwEmu" 26 "Reset-InstrProt" 27 "Reset-DataProt" 35 "Reset-DataBrk" 36 "Reset-InstrBrk" 37 "Reset-MaskBrk" 38 "Reset-NMIBrk" 39 "Reset-NMI" 40 "Reset-Reserve" 41 "HW_INDEX zu klein" 42 "ADAPT Loeschen" 43 "ADAPT Schreiben" 44 "ADAPT Hochlauf" 50 "SK-Resetausloesung" 51 "ADC" 52 "TZ-TPU Pin" 53 "TZ-TREIBER Pin" 54 "DSP-Bus" 55 "DSP-Stack" 56 "DSP-Watchdog" 57 "DSP-Programm" 58 "DSP-Daten" 59 "DSP-CRC" 60 "ZUST_NL IGN Timeout" 61 "DSP-Zylinder" 62 "FPGA Init Pin NHigh1" 63 "FPGA Init Pin NHigh2" 64 "FPGA Done Pin NHigh" 65 "FPGA Kennung-CRC32" 66 "RAM" 67 "Register" 68 "TPU RAM" 69 "QADC0 CCW" 70 "QADC1 CCW" 71 "SPI-ATIC39 Chain" 72 "SPI-ATIC35 Chain" 73 "SPI-ATIC29 Chain" 74 "Interne Spannung" 75 "OS-Tasksystem" 76 "OS-Stack" DEFAULT_VALUE "undef" /end COMPU_VTAB
/begin COMPU_VTAB FORMULA_0547_VTAB "FORMULA_0547_VTAB" TAB_VERB 2 0 "nein" 1 "ja" /end COMPU_VTAB
/begin COMPU_VTAB FORMULA_0548_VTAB "FORMULA_0548_VTAB" TAB_VERB 2 0 "nein" 1 "ja" /end COMPU_VTAB
/begin COMPU_VTAB FORMULA_0549_VTAB "FORMULA_0549_VTAB" TAB_VERB 2 0 "nein" 1 "ja" /end COMPU_VTAB
/begin COMPU_VTAB FORMULA_0550_VTAB "FORMULA_0550_VTAB" TAB_VERB 2 0 "nein" 1 "ja" /end COMPU_VTAB
/begin COMPU_VTAB FORMULA_0555_VTAB "FORMULA_0555_VTAB" TAB_VERB 51 0 "AUS" 1 "BEREIT" 2 "WAIT_KLA" 3 "WAIT_V" 4 "WAIT_N" 5 "WAIT_UB" 6 "WAIT_PMIN" 7 "WAIT_TEMP" 8 "WAIT_FST" 9 "WAIT_TEV" 10 "WAIT_EXD" 11 "WAIT_FEHLER_LOESCH" 12 "WAIT_VENTIL" 13 "WAIT_AY" 14 "WAIT_FEUCHT" 20 "START" 21 "REFDIA1" 22 "VENTIL_CHK" 23 "DECKELDIA" 24 "GROBLECKDIA" 25 "FEINLECKDIA" 26 "DECKEL_REFDIA2" 27 "GROB_REFDIA2" 28 "FEIN_REFDIA2" 29 "VENTIL_CHK2" 32 "DECKEL_DICHT" 33 "GROB_DICHT" 34 "FEIN_DICHT" 35 "DECKELLECK" 36 "GROBLECK" 37 "FEINLECK" 40 "ABBRUCH_UB_DIFF" 41 "ABBRUCH_I_REF_DIFF" 42 "ABBRUCH_TEV" 43 "ABBRUCH_KL15" 44 "ABBRUCH_N" 45 "ABBRUCH_V" 46 "ABBRUCH_KS" 47 "ABBRUCH_EXD" 48 "ABBRUCH_REF_ZU_GROSS" 49 "ABBRUCH_REF_ZU_KLEIN" 50 "ABBRUCH_VERSTOPFT" 51 "ABBRUCH_NACHTANK" 52 "ABBRUCH_TANKDECKEL" 53 "ABBRUCH_AIRBAG" 54 "ABBRUCH_I_REF_1/2" 55 "ABBRUCH_DI2" 56 "ABBRUCH_AY" 57 "ABBRUCH_I_REF2_DIFF" 58 "ABBRUCH_UB_MIN" 59 "ABBRUCH_POWER_DOWN" DEFAULT_VALUE "undef" /end COMPU_VTAB
/begin COMPU_VTAB FORMULA_0630_VTAB "FORMULA_0630_VTAB" TAB_VERB 1 0 "AUS" DEFAULT_VALUE "EIN" /end COMPU_VTAB
/begin COMPU_VTAB FORMULA_0631_VTAB "FORMULA_0631_VTAB" TAB_VERB 2 0 "nein" 1 "ks_to_gnd" /end COMPU_VTAB
/begin COMPU_VTAB FORMULA_0632_VTAB "FORMULA_0632_VTAB" TAB_VERB 2 0 "aus" 1 "ein" /end COMPU_VTAB
/begin COMPU_VTAB FORMULA_0633_VTAB "FORMULA_0633_VTAB" TAB_VERB 2 0 "nein" 1 "angefordert" /end COMPU_VTAB
/begin COMPU_VTAB FORMULA_0634_VTAB "FORMULA_0634_VTAB" TAB_VERB 2 0 "o.k" 1 "Kurzschluss" /end COMPU_VTAB
/begin COMPU_VTAB FORMULA_0635_VTAB "FORMULA_0635_VTAB" TAB_VERB 2 0 "1.Stabil" 1 "2.Stabil laeuft" /end COMPU_VTAB
/begin COMPU_VTAB FORMULA_0636_VTAB "FORMULA_0636_VTAB" TAB_VERB 2 0 "nein" 1 "erfuellt" /end COMPU_VTAB
/begin COMPU_VTAB FORMULA_0637_VTAB "FORMULA_0637_VTAB" TAB_VERB 2 0 "aus" 1 "ein" /end COMPU_VTAB
/begin COMPU_VTAB FORMULA_0641_VTAB "FORMULA_0641_VTAB" TAB_VERB 3 0 "Ohne DMTL" 1 "Mit DMTL" 2 "Keine Fehlerheilung" DEFAULT_VALUE "undef." /end COMPU_VTAB
/begin COMPU_VTAB FORMULA_0643_VTAB "FORMULA_0643_VTAB" TAB_VERB 4 0 "Aus" 1 "Deckeldia" 2 "Grobleck" 4 "Feinleck" DEFAULT_VALUE "undef." /end COMPU_VTAB
/begin COMPU_VTAB FORMULA_0650_VTAB "FORMULA_0650_VTAB" TAB_VERB 2 0 "1x Stabilzeit" 1 "2x Stabilzeit" DEFAULT_VALUE "undef." /end COMPU_VTAB
/begin COMPU_VTAB FORMULA_0831_VTAB "FORMULA_0831_VTAB" TAB_VERB 2 0 "inaktiv" 1 "aktiv" /end COMPU_VTAB
/begin COMPU_VTAB FORMULA_1078_VTAB "FORMULA_1078_VTAB" TAB_VERB 1 0 "offen" DEFAULT_VALUE "geschlossen" /end COMPU_VTAB
/begin COMPU_VTAB FORMULA_1079_VTAB "FORMULA_1079_VTAB" TAB_VERB 2 0 "nein" 1 "ja" /end COMPU_VTAB
/begin COMPU_VTAB FORMULA_1080_VTAB "FORMULA_1080_VTAB" TAB_VERB 1 0 "offen" DEFAULT_VALUE "Kraftschluss" /end COMPU_VTAB
/begin COMPU_VTAB FORMULA_1083_VTAB "FORMULA_1083_VTAB" TAB_VERB 2 0 "nicht aktiv" 1 "aktiv" DEFAULT_VALUE "undef" /end COMPU_VTAB
/begin COMPU_VTAB FORMULA_1084_VTAB "FORMULA_1084_VTAB" TAB_VERB 2 0 "Ok" 1 "AD-Err" /end COMPU_VTAB
/begin COMPU_VTAB FORMULA_1085_VTAB "FORMULA_1085_VTAB" TAB_VERB 5 0 "Init" 1 "Wait" 2 "Error_1" 3 "Error_2" 4 "New" /end COMPU_VTAB
/begin COMPU_VTAB FORMULA_1087_VTAB "FORMULA_1087_VTAB" TAB_VERB 2 0 "HFM" 1 "LAM" /end COMPU_VTAB
/begin COMPU_VTAB FORMULA_1088_VTAB "FORMULA_1088_VTAB" TAB_VERB 2 0 "ohne" 1 "mit" DEFAULT_VALUE "schmarn" /end COMPU_VTAB
/begin COMPU_VTAB FORMULA_1093_VTAB "FORMULA_1093_VTAB" TAB_VERB 14 0 "nicht angelaufen" 1 "Mini-HFM IO" 2 "Mini-HFM NIO" 5 "ML-Plausi IO" 9 "SLP inaktiv" 17 "SLV kl.geschl.,Haupt-Ltg verstopft" 37 "MDF IO" 69 "SLS grobe Undichtigkeit" 133 "SLS blockiert" 293 "ZWD IO" 549 "ZWD klemmt" 1317 "SLV IO" 2341 "EUV haengt offen" 4389 "ASV re. haengt offen" /end COMPU_VTAB
/begin COMPU_VTAB FORMULA_1094_VTAB "FORMULA_1094_VTAB" TAB_VERB 7 0 "nicht angelaufen" 1 "MDF DIAG IO" 2 "Max Intg zu gross" 4 "Min Intg zu gross" 16 "LAM B1 gr B2" 32 "LAM B1 kl B2" 34 "LAM B1 gl B2" DEFAULT_VALUE "undef" /end COMPU_VTAB
/begin COMPU_VTAB FORMULA_1095_VTAB "FORMULA_1095_VTAB" TAB_VERB 1 0 "IO" DEFAULT_VALUE "abbruch" /end COMPU_VTAB
/begin COMPU_VTAB FORMULA_1096_VTAB "FORMULA_1096_VTAB" TAB_VERB 2 0 "IO" 1 "abbruch" /end COMPU_VTAB
/begin COMPU_VTAB FORMULA_1097_VTAB "FORMULA_1097_VTAB" TAB_VERB 2 0 "IO" 1 "abbruch" /end COMPU_VTAB
/begin COMPU_VTAB FORMULA_1098_VTAB "FORMULA_1098_VTAB" TAB_VERB 2 0 "IO" 1 "abbruch" /end COMPU_VTAB
/begin COMPU_VTAB FORMULA_1099_VTAB "FORMULA_1099_VTAB" TAB_VERB 2 0 "IO" 1 "abbruch" /end COMPU_VTAB
/begin COMPU_VTAB FORMULA_1100_VTAB "FORMULA_1100_VTAB" TAB_VERB 2 0 "IO" 1 "abbruch" /end COMPU_VTAB
/begin COMPU_VTAB FORMULA_1101_VTAB "FORMULA_1101_VTAB" TAB_VERB 2 0 "IO" 1 "abbruch" /end COMPU_VTAB
/begin COMPU_VTAB FORMULA_1102_VTAB "FORMULA_1102_VTAB" TAB_VERB 2 0 "IO" 1 "abbruch" /end COMPU_VTAB
/begin COMPU_VTAB FORMULA_1103_VTAB "FORMULA_1103_VTAB" TAB_VERB 2 0 "IO" 1 "abbruch" /end COMPU_VTAB
/begin COMPU_VTAB FORMULA_1104_VTAB "FORMULA_1104_VTAB" TAB_VERB 2 0 "IO" 1 "abbruch" /end COMPU_VTAB
/begin COMPU_VTAB FORMULA_1105_VTAB "FORMULA_1105_VTAB" TAB_VERB 2 0 "IO" 1 "abbruch" /end COMPU_VTAB
/begin COMPU_VTAB FORMULA_1106_VTAB "FORMULA_1106_VTAB" TAB_VERB 2 0 "IO" 1 "abbruch" /end COMPU_VTAB
/begin COMPU_VTAB FORMULA_1107_VTAB "FORMULA_1107_VTAB" TAB_VERB 2 0 "IO" 1 "abbruch" /end COMPU_VTAB
/begin COMPU_VTAB FORMULA_1108_VTAB "FORMULA_1108_VTAB" TAB_VERB 2 0 "IO" 1 "abbruch" /end COMPU_VTAB
/begin COMPU_VTAB FORMULA_1109_VTAB "FORMULA_1109_VTAB" TAB_VERB 2 0 "IO" 1 "abbruch" /end COMPU_VTAB
/begin COMPU_VTAB FORMULA_1110_VTAB "FORMULA_1110_VTAB" TAB_VERB 2 0 "IO" 1 "abbruch" /end COMPU_VTAB
/begin COMPU_VTAB FORMULA_1111_VTAB "FORMULA_1111_VTAB" TAB_VERB 2 0 "IO" 1 "abbruch" /end COMPU_VTAB
/begin COMPU_VTAB FORMULA_1114_VTAB "FORMULA_1114_VTAB" TAB_VERB 2 0 "AUS" 1 "AN" DEFAULT_VALUE "undefiniert" /end COMPU_VTAB
/begin COMPU_VTAB FORMULA_1116_VTAB "FORMULA_1116_VTAB" TAB_VERB 5 0 "AUS" 2 "AN-HFM" 4 "AN-LAM" 8 "Prueflauf" 10 "AN-HFM-PL" DEFAULT_VALUE "undefiniert" /end COMPU_VTAB
/begin COMPU_VTAB FORMULA_1117_VTAB "FORMULA_1117_VTAB" TAB_VERB 2 0 "SL_ML_SOLL" 2 "Modell" DEFAULT_VALUE "undefiniert" /end COMPU_VTAB
/begin COMPU_VTAB FORMULA_1124_VTAB "FORMULA_1124_VTAB" TAB_VERB 2 0 "nein" 1 "ja" /end COMPU_VTAB
/begin COMPU_VTAB FORMULA_1125_VTAB "FORMULA_1125_VTAB" TAB_VERB 2 0 "nein" 1 "ja" /end COMPU_VTAB
/begin COMPU_VTAB FORMULA_1126_VTAB "FORMULA_1126_VTAB" TAB_VERB 2 0 "nein" 1 "ja" /end COMPU_VTAB
/begin COMPU_VTAB FORMULA_1127_VTAB "FORMULA_1127_VTAB" TAB_VERB 8 0 "keine" 1 "LAM_REG" 2 "TI_MIN" 3 "LAM_REG+TI_MIN" 4 "LAM_DELTA" 5 "LAM_REG+LAM_DELTA" 6 "TI_MIN+LAM_DELTA" 7 "LAM_REG+TI_MIN+LAM_DELTA" DEFAULT_VALUE "undef" /end COMPU_VTAB
/begin COMPU_VTAB FORMULA_1128_VTAB "FORMULA_1128_VTAB" TAB_VERB 5 0 "RESET" 1 "NICHT_RECHNEN" 2 "NICHT_LERNEN" 4 "LERNEN" 8 "RED_LERNEN" DEFAULT_VALUE "undef" /end COMPU_VTAB
/begin COMPU_VTAB FORMULA_1134_VTAB "FORMULA_1134_VTAB" TAB_VERB 2 0 "gesperrt" 1 "zulaessig" /end COMPU_VTAB
/begin COMPU_VTAB FORMULA_1135_VTAB "FORMULA_1135_VTAB" TAB_VERB 2 0 "nein" 1 "Notlauf" /end COMPU_VTAB
/begin COMPU_VTAB FORMULA_1136_VTAB "FORMULA_1136_VTAB" TAB_VERB 2 0 "nein" 1 "Notlauf" /end COMPU_VTAB
/begin COMPU_VTAB FORMULA_1137_VTAB "FORMULA_1137_VTAB" TAB_VERB 2 0 "nein" 1 "Abbruch" /end COMPU_VTAB
/begin COMPU_VTAB FORMULA_1138_VTAB "FORMULA_1138_VTAB" TAB_VERB 2 0 "nein" 1 "STOP" /end COMPU_VTAB
/begin COMPU_VTAB FORMULA_1139_VTAB "FORMULA_1139_VTAB" TAB_VERB 2 0 "nein" 1 "ja" /end COMPU_VTAB
/begin COMPU_VTAB FORMULA_1140_VTAB "FORMULA_1140_VTAB" TAB_VERB 2 0 "nein" 1 "ja" /end COMPU_VTAB
/begin COMPU_VTAB FORMULA_1141_VTAB "FORMULA_1141_VTAB" TAB_VERB 2 0 "nein" 1 "ja" /end COMPU_VTAB
/begin COMPU_VTAB FORMULA_1142_VTAB "FORMULA_1142_VTAB" TAB_VERB 2 0 "nein" 1 "ja" /end COMPU_VTAB
/begin COMPU_VTAB FORMULA_1143_VTAB "FORMULA_1143_VTAB" TAB_VERB 2 0 "nein" 1 "ja" /end COMPU_VTAB
/begin COMPU_VTAB FORMULA_1144_VTAB "FORMULA_1144_VTAB" TAB_VERB 2 0 "nein" 1 "ja" /end COMPU_VTAB
/begin COMPU_VTAB FORMULA_1145_VTAB "FORMULA_1145_VTAB" TAB_VERB 2 0 "nein" 1 "ja" /end COMPU_VTAB
/begin COMPU_VTAB FORMULA_1146_VTAB "FORMULA_1146_VTAB" TAB_VERB 1 63 "ja" DEFAULT_VALUE "nein" /end COMPU_VTAB
/begin COMPU_VTAB FORMULA_1147_VTAB "FORMULA_1147_VTAB" TAB_VERB 2 0 "i.O." 1 "gesperrt" /end COMPU_VTAB
/begin COMPU_VTAB FORMULA_1148_VTAB "FORMULA_1148_VTAB" TAB_VERB 2 0 "i.O." 1 "gesperrt" /end COMPU_VTAB
/begin COMPU_VTAB FORMULA_1149_VTAB "FORMULA_1149_VTAB" TAB_VERB 2 0 "nein" 1 "ja" /end COMPU_VTAB
/begin COMPU_VTAB FORMULA_1150_VTAB "FORMULA_1150_VTAB" TAB_VERB 2 0 "nein" 1 "ja" /end COMPU_VTAB
/begin COMPU_VTAB FORMULA_1155_VTAB "FORMULA_1155_VTAB" TAB_VERB 3 0 "TE inaktiv" 1 "TE aktiv" 2 "TE hart ein" /end COMPU_VTAB
/begin COMPU_VTAB FORMULA_1156_VTAB "FORMULA_1156_VTAB" TAB_VERB 2 0 "applikativ" 1 "errechnet" /end COMPU_VTAB
/begin COMPU_VTAB FORMULA_1158_VTAB "FORMULA_1158_VTAB" TAB_VERB 2 0 "APPL-Wert" 1 "KF-Wert" /end COMPU_VTAB
/begin COMPU_VTAB FORMULA_1159_VTAB "FORMULA_1159_VTAB" TAB_VERB 4 0 "Rampe B1,B2" 1 "Appl B1, Rampe B2" 2 "Rampe B1, Appl B2" 3 "Appl B1,B2" /end COMPU_VTAB
/begin COMPU_VTAB FORMULA_1163_VTAB "FORMULA_1163_VTAB" TAB_VERB 6 0 "AUS" 1 "MESSEN" 2 "DEFEKT" 3 "OK_LAM" 4 "OK_AUSS" 5 "OK_LL" /end COMPU_VTAB
/begin COMPU_VTAB FORMULA_1164_VTAB "FORMULA_1164_VTAB" TAB_VERB 28 0 "AUS" 1 "WAIT_TOEL" 2 "WAIT_KATH" 3 "WAIT_TESTER" 4 "WAIT_LRW" 5 "WAIT_V" 6 "WAIT_KKOS" 7 "WAIT_GEN" 8 "WAIT_BLS" 9 "WAIT_ML" 10 "WAIT_LL" 11 "WAIT_UB" 12 "WAIT_FEHLER" 13 "WAIT_DMTL" 14 "WAIT_LAM" 15 "WAIT_TZ" 16 "WAIT_PRUEFSTAND" 17 "WAIT_LLR" 18 "START_DELAY" 19 "PRE_SCHL" 20 "PRE_ZU" 21 "TEV_OEFFNEN" 22 "TEV_OFFEN" 23 "TEV_SCHLIESSEN" 24 "TEV_ZU" 25 "ABBRUCH" 26 "FERTIG" 27 "NEUSTART" /end COMPU_VTAB
/begin COMPU_VTAB FORMULA_1165_VTAB "FORMULA_1165_VTAB" TAB_VERB 5 0 "ohne_KKOS_Abwurf LAA_reset" 1 "LAA_freeze" 2 "KKOS_Abwurf" 3 "KKOS_Abwurf LAA_freeze" 4 "RESET" DEFAULT_VALUE "undef." /end COMPU_VTAB
/begin FUNCTION Schalter ""
 /begin DEF_CHARACTERISTIC K_SCHALTER_GETR_A0 K_SCHALTER_GETR_DIAG_MAX K_SCHALTER_GETR_DIAG_MIN K_SCHALTER_GETR_DIAG_N_GETR_EIN_MIN K_SCHALTER_GETR_DIAG_N_VERH_TAU K_SCHALTER_GETR_DIAG_STABIL K_SCHALTER_GETR_DIAG_T K_SCHALTER_GETR_DIAG_V_MIN K_SCHALTER_GETR_FIL_TAU K_SCHALTER_GETR_HYSTERESE_BREITE K_SCHALTER_GETR_LEERGASSE_MAX K_SCHALTER_GETR_LEERGASSE_MIN K_SCHALTER_KS_N_DIFF K_SCHALTER_KS_N_DIFF_REF K_SCHALTER_KS_N_HYS K_SCHALTER_KS_N_T K_SCHALTER_KS_SCHALT_T K_SCHALTER_KUPP_DIAG_N K_SCHALTER_KUPP_DIAG_RF K_SCHALTER_KUPP_DIAG_T K_SCHALTER_KUPP_DIAG_V_MAX K_SCHALTER_KUPP_DIAG_V_MIN K_SCHALTER_KUPP_GESCHL K_SCHALTER_KUPP_OFFEN K_SCHALTER_POEL_N_DELAY K_SCHALTER_POEL_N_DIAG K_SCHALTER_POEL_START_ENDE K_SCHALTER_POEL_T_DIAG K_SCHALTER_POEL_TOEL KL_SCHALTER_KS_REG /end DEF_CHARACTERISTIC
 /begin OUT_MEASUREMENT schalter_bls_ad_inj schalter_diag_poel_n_delay schalter_getr schalter_getr_a0 schalter_getr_ad schalter_getr_diag_timer schalter_getr_fil schalter_getr_n_verh_fil schalter_ks_alt schalter_ks_dn schalter_ks_md_eff schalter_ks_n_diff schalter_ks_n_diff_ref schalter_ks_n_diff_timer schalter_ks_n_hys_timer schalter_ks_n_ref schalter_ks_schalt_timer schalter_kupp_ad schalter_kupp_diag schalter_kupp_diag_scharf schalter_kupp_diag_timer schalter_kupp_diag_verz schalter_poel_ad schalter_poel_time schalter_sport_ad schalter_st_inj_old schalter_wakeup_ad_inj /end OUT_MEASUREMENT
/end FUNCTION
/begin FUNCTION Sekundaerluftreg. ""
 /begin DEF_CHARACTERISTIC K_SL_HFM_CFG K_SL_HFM_TAU K_SL_I_MAX K_SL_I_MIN K_SL_LAM_ABG_TAU K_SL_LAM_MAX_FAK K_SL_LAM_MIN_FAK K_SL_LLS_CFG K_SL_ML_HFM_DIAG_MAX K_SL_ML_HFM_DIAG_MIN K_SL_ML_HFM_ERSATZ K_SL_TKAT_ANSPR KF_SL_LAM_MOT_OFFS KF_SL_VORST_TV KL_SL_HFM_AD KL_SL_I_ANTEIL KL_SL_LAM_I_ANTEIL KL_SL_LAM_MOT_DELAY KL_SL_LAM_MOT_OFFS_TIME_F KL_SL_LAMSOL_KALT KL_SL_LAMSOL_WARM KL_SL_ML_MAX_PABG KL_SL_ML_MAX_UB_FAKT KL_SL_P_ANTEIL /end DEF_CHARACTERISTIC
 /begin OUT_MEASUREMENT ml_slp_b1 ml_slp_b2 sl_lam_abg_ist sl_lam_abg_ist_roh sl_lam_abg_soll sl_lam_b2_korr sl_lam_mot_soll sl_lam_mot_soll_roh sl_ml_hfm_ad sl_ml_hfm_roh sl_ml_ist sl_ml_ist_lam sl_ml_max sl_ml_max_roh sl_ml_rel sl_ml_soll sl_reg_i sl_reg_p sl_regler_f sl_zwd_vorst_tv /end OUT_MEASUREMENT
/end FUNCTION
/begin FUNCTION servo_abschalt "" /begin OUT_MEASUREMENT servo_abschalt_inj /end OUT_MEASUREMENT /end FUNCTION
/begin FUNCTION SG-Konfiguration ""
 /begin DEF_CHARACTERISTIC cfg.abgas cfg.baureihe cfg.betriebsmode cfg.canmess cfg.canstand cfg.diagnose cfg.dsc_typ cfg.getriebetyp cfg.hil cfg.ipm cfg.la_variante cfg.motortyp cfg.peripherie cfg.sg_mode cfg.status /end DEF_CHARACTERISTIC
 /begin OUT_MEASUREMENT cfg_boot_st sys_exc_lr vers_boot vers_boot_index /end OUT_MEASUREMENT
/end FUNCTION
/begin FUNCTION SK-Ebene_2 "" /begin DEF_CHARACTERISTIC K_SK_E2_KOMP_ERR_MAX K_SK_MAX_RESETS_E2 /end DEF_CHARACTERISTIC
 /begin OUT_MEASUREMENT sk_e2_byte sk_e2_byte_err sk_e2_fehler sk_e2_komp_err sk_e2_long sk_e2_long_err sk_e2_word sk_e2_word_err sk_reset_cnt_e2 /end OUT_MEASUREMENT
/end FUNCTION
/begin FUNCTION SK-Manager ""
 /begin DEF_CHARACTERISTIC K_SK_CFG K_SK_CRC32 K_SK_EGAS_OFF K_SK_EGAS_OFF_TIME K_SK_FGR_SPERRE K_SK_FM_EGAS_TEST K_SK_FM_FAIL_ZYL_TEST K_SK_FM_GEMISCH_TEST K_SK_FM_LAM_TEST K_SK_FM_MD_TEST K_SK_FM_MVAC_TEST K_SK_FM_SMG_TEST K_SK_FRA_SPERRE K_SK_HW_AD_DELTA_MAX K_SK_HW_AD_ED_ZAEHLER K_SK_HW_AD_STAT K_SK_HW_AD_STAT_ZAEHLER K_SK_KH_SPERRE K_SK_LAM_EINGR K_SK_LAM_EINGR_TI K_SK_LLRA_SPERRE K_SK_MAX_OS_ERR K_SK_MAX_RESETS K_SK_MD_BEGR_DK_OFFEN K_SK_MD_BEGR_EGAS K_SK_MD_BEGR_GEMISCH K_SK_MD_BEGR_MD K_SK_MD_BEGR_MVAC K_SK_MD_BEGR_MVAC_SYS K_SK_MD_BEGR_PWG K_SK_MD_BEGR_RESET K_SK_MD_BEGR_SMG K_SK_MD_BEGR_TI K_SK_MD_TI_EINGR K_SK_MD_VL_SPERRE K_SK_MVAC_KH K_SK_PKS_NOTLAUF K_SK_PROZ_ERR K_SK_T_RESET_DELAY_OS K_SK_TASK_ERR K_SK_TI_OFF_EGAS K_SK_ZYL_OFF_MAX /end DEF_CHARACTERISTIC
 /begin OUT_MEASUREMENT sk_egas_off_ni sk_egas_off_time_b1 sk_egas_off_time_b2 sk_fail_st_zyl sk_fm_egas_exd sk_fm_gemisch sk_fm_lam sk_fm_ti sk_hw_pwg1_ad_ed_zaehler sk_hw_pwg1_ad_mode sk_hw_pwg1m_ad_alt sk_hw_pwg1m_ad_zaehler sk_hw_pwg1s_ad_alt sk_hw_pwg1s_ad_zaehler sk_md_begr_ni sk_md_begr_st sk_reset_cnt sk_t_reset_delay_os sk_ti_off_st sk_ti_zyl_off_cnt sk_tr_error_cnt sk_tr_error_nr sk_tr_state sk_tr_timeout sk_tr_wait sk_ursache /end OUT_MEASUREMENT
/end FUNCTION
/begin FUNCTION SLP ""
 /begin DEF_CHARACTERISTIC K_SLP_PABG_SCHWELLE K_SLP_PABG_TAU K_SLP_TIME_AUS K_SLP_TIME_MAX KF_SLP_DAUER_TMOT_START KL_SLP_DELAY_TMOT_START /end DEF_CHARACTERISTIC
 /begin OUT_MEASUREMENT slp_pabg_dif_max /end OUT_MEASUREMENT
/end FUNCTION
/begin FUNCTION SLS_OBD ""
 /begin DEF_CHARACTERISTIC K_SLS_OBD_CFG K_SLS_OBD_DYN_TAU K_SLS_OBD_ML_MDL_DIFF_MAX K_SLS_OBD_ML_MDL_WICHT K_SLS_OBD_TMOT_MIN K_SLS_OBDH_ASV_LI_OPE K_SLS_OBDH_ASV_PL_LI_OPE K_SLS_OBDH_ASV_PL_RE_OPE K_SLS_OBDH_ASV_RE_OPE K_SLS_OBDH_ASV_TAU K_SLS_OBDH_DYN_DELTA_RF K_SLS_OBDH_DYN_RF_T K_SLS_OBDH_EUV_MIN_DEF K_SLS_OBDH_HFM_MAX K_SLS_OBDH_HFM_TAU K_SLS_OBDH_HYD_ABBRUCH_AD_MAX K_SLS_OBDH_HYD_ABBRUCH_ML_MAX K_SLS_OBDH_MDF_1_MAG K_SLS_OBDH_MDF_2_MAG K_SLS_OBDH_MDF_CFG K_SLS_OBDH_MDF_MAX_DEF K_SLS_OBDH_MDF_MIN_DEF K_SLS_OBDH_MDL_K_EINBAUTEN K_SLS_OBDH_ML_MAX K_SLS_OBDH_ML_MIN K_SLS_OBDH_ML_TAU K_SLS_OBDH_ML_TMOT K_SLS_OBDH_MLVERH_MIN K_SLS_OBDH_N_MAX K_SLS_OBDH_N_MIN K_SLS_OBDH_PUMG_MIN K_SLS_OBDH_RF_MAX K_SLS_OBDH_RF_MIN K_SLS_OBDH_SLP_DEF K_SLS_OBDH_SLV_MAX K_SLS_OBDH_START_MIN K_SLS_OBDH_T_AUFHEIZ K_SLS_OBDH_T_HFM_DIA K_SLS_OBDH_T_ML_PLAUSI K_SLS_OBDH_T_SA K_SLS_OBDH_T_SLV_INT_START K_SLS_OBDH_UB_MIN K_SLS_OBDH_ZWD_0_MAX K_SLS_OBDH_ZWD_100_MIN K_SLS_OBDH_ZWD_OFF_MAX K_SLS_OBDH_ZWD_OFF_MIN K_SLS_PL_T_MDF_STOP KL_SLS_OBDH_ASV_DIA_T KL_SLS_OBDH_ASV_LAM_LEAK_MAX KL_SLS_OBDH_HFM_DIAG_MIN KL_SLS_OBDH_ML_LAM_DIF_MAX KL_SLS_OBDH_ML_MDF_DIAG KL_SLS_OBDH_ML_VOLA_INTG_MAX KL_SLS_OBDH_PU_SAU_MIN KL_SLS_OBDH_SLV_T_DIAG_OFF KL_SLS_OBDH_ZWD_T_DIAG_0 KL_SLS_OBDH_ZWD_T_DIAG_100 KL_SLS_OBDH_ZWD_T_DIAG_OFF /end DEF_CHARACTERISTIC
 /begin OUT_MEASUREMENT sls_exd_st_pl sls_obd_abbruch_st sls_obd_abbruch_st_ende sls_obd_abbruch_st_ext_fehler sls_obd_abbruch_st_ml_max sls_obd_abbruch_st_ml_min sls_obd_abbruch_st_ml_verh sls_obd_abbruch_st_n_max sls_obd_abbruch_st_n_min sls_obd_abbruch_st_pu_sau_min sls_obd_abbruch_st_pumg sls_obd_abbruch_st_restl sls_obd_abbruch_st_rf_max sls_obd_abbruch_st_rf_min sls_obd_abbruch_st_slp sls_obd_abbruch_st_t_sa sls_obd_abbruch_st_tmot sls_obd_abbruch_st_ub sls_obd_dyn_grad sls_obd_max sls_obd_mdl_diff_dyn sls_obd_min sls_obd_ml_dyn sls_obd_timer sls_obdh_diag_st sls_obdh_diag_time_on sls_obdh_lam_asv_intg_norm sls_obdh_lam_intg sls_obdh_lam_ist_fil sls_obdh_mdf_max_intg sls_obdh_mdf_max_intg_norm sls_obdh_mdf_max_intg_s16 sls_obdh_mdf_min_intg sls_obdh_mdf_ml_soll sls_obdh_mdf_st sls_obdh_mdl_ml_korr sls_obdh_ml_ges_fil sls_obdh_ml_hfm_fil sls_obdh_ml_mdl sls_obdh_pu_sau_max sls_obdh_sl_ml_vola_intg sls_obdh_t_mdf sls_obdh_t_mdf_lam /end OUT_MEASUREMENT
/end FUNCTION
/begin FUNCTION SLV "" /begin OUT_MEASUREMENT slv_exd_timeout /end OUT_MEASUREMENT /end FUNCTION
/begin FUNCTION spgr "" /begin DEF_CHARACTERISTIC KL_SPGR_FREQ /end DEF_CHARACTERISTIC /begin OUT_MEASUREMENT spgr_freq /end OUT_MEASUREMENT /end FUNCTION
/begin FUNCTION spi ""
 /begin OUT_MEASUREMENT spim_errorcode spim_errorcounter spim_reqcounter spim_status /end OUT_MEASUREMENT
/end FUNCTION
/begin FUNCTION SPI_INJ "" /end FUNCTION
/begin FUNCTION stat_data ""
 /begin DEF_CHARACTERISTIC KL_STAT_DATA_N KL_STAT_DATA_RF KL_STAT_DATA_TDME KL_STAT_DATA_TMOT KL_STAT_DATA_TOEL /end DEF_CHARACTERISTIC
 /begin OUT_MEASUREMENT stat_data_reset /end OUT_MEASUREMENT
/end FUNCTION
/begin FUNCTION sw_confg_exd "" /end FUNCTION
/begin FUNCTION Systemvariablen "" /begin IN_MEASUREMENT sys_sypcr /end IN_MEASUREMENT
 /begin OUT_MEASUREMENT sys_ed_st sys_exc_addr sys_exc_km_ni sys_exc_n_ni sys_exc_vec sys_last_reset_st sys_reset_st sys_rsr sys_rsr_cnt_sum sys_rsr_csrs sys_rsr_dbhrs sys_rsr_dbsrs sys_rsr_ehrs sys_rsr_ersr sys_rsr_ghrst sys_rsr_gpor sys_rsr_gsrst sys_rsr_ilbc sys_rsr_jtrs sys_rsr_llrs sys_rsr_occs sys_rsr_swrs sys_sg_fehler sys_sync_init_t sys_zust sys_zust_bgnd_cnt sys_zust_bgnd_net_min sys_zust_cpu_last /end OUT_MEASUREMENT
/end FUNCTION
/begin FUNCTION Tankleckdiagnose ""
 /begin DEF_CHARACTERISTIC K_DMTL_2_STABIL K_DMTL_ABBR_FEIN K_DMTL_ABBR_FEUCHT K_DMTL_ANZ_DECKEL K_DMTL_ANZ_DECKEL_LECK K_DMTL_ANZ_FAHRTEN K_DMTL_AY_MAX K_DMTL_CFG K_DMTL_DI_BETANK K_DMTL_DI_DECKEL K_DMTL_DI_STABIL K_DMTL_DU_MAX K_DMTL_FAKT_T_DECKEL K_DMTL_FST_DECKEL_MAX K_DMTL_FST_ERSATZ K_DMTL_FST_MAX K_DMTL_FST_MIN K_DMTL_GROB_OHNE_FEIN K_DMTL_I_FAKT_CCDECKEL K_DMTL_I_FAKT_GROB K_DMTL_I_FAKT_P K_DMTL_I_KURZSCHL K_DMTL_I_REF_1_2_DIFF K_DMTL_I_REF_DIFF K_DMTL_I_REF_MAX K_DMTL_I_REF_MIN K_DMTL_P_MIN K_DMTL_START K_DMTL_T_ABSTELL K_DMTL_T_AY_DLY K_DMTL_T_CC_DAUER K_DMTL_T_DECKEL_ML_MIN K_DMTL_T_FEUCHT_DLY K_DMTL_T_KURZSCHL K_DMTL_T_MESS_GES K_DMTL_T_ML_MIN K_DMTL_T_REF K_DMTL_T_START_DLY K_DMTL_T_VENT_CHK K_DMTL_T_VENT_UM K_DMTL_TEMP_DECKEL_MAX K_DMTL_TEMP_DECKEL_MIN K_DMTL_TEMP_MAX K_DMTL_TEMP_MIN K_DMTL_TEMP_START_MIN K_DMTL_TEMP_VENT_MIN K_DMTL_TP_I K_DMTL_TP_I_BEG K_DMTL_TP_I_ROH K_DMTL_TP_I_TANK K_DMTL_TP_UB K_DMTL_UB_MAX K_DMTL_UB_MIN K_DMTL_V_MIN KL_DMTL_FST_ERS_LI KL_DMTL_FST_ERS_RE KL_DMTL_FST_MAX_STAND KL_DMTL_HOEHE_KORR KL_DMTL_I_REF_KORR KL_DMTL_KORR_FAKT KL_DMTL_T_FEIN_MIN KL_DMTL_T_GROB KL_DMTL_T_STABIL /end DEF_CHARACTERISTIC
 /begin OUT_MEASUREMENT B_DMTL_2_STABIL B_DMTL_CLOSE_TEV B_DMTL_EXD_START B_DMTL_H_EIN B_DMTL_KURZSCHLUSS B_DMTL_MOTORLAUFZEIT B_DMTL_RUN B_DMTL_START_DECKEL B_DMTL_START_DECKEL_GROB B_DMTL_START_FEIN B_DMTL_START_GROB B_DMTL_VENTIL_FEHLER dmtl_anz_deckel dmtl_asc_ay dmtl_exd_h_st dmtl_exd_h_timeout dmtl_exd_p_st dmtl_exd_p_timeout dmtl_exd_v_st dmtl_exd_v_timeout dmtl_flags dmtl_flags_start dmtl_fst dmtl_fst_max dmtl_i dmtl_i_deckel dmtl_i_fakt_fein dmtl_i_filt_tank dmtl_i_filt_tank.rest dmtl_i_grob dmtl_i_max dmtl_i_ref_korr dmtl_i_ref2 dmtl_i_roh dmtl_i_stabil dmtl_korr_fakt dmtl_st dmtl_t_cc_dauer dmtl_t_deckel dmtl_t_fein_min dmtl_t_feucht_dly dmtl_t_grob dmtl_t_i_filt_beg dmtl_t_ks dmtl_t_ref dmtl_t_stabil dmtl_t_stabil_max dmtl_t_start_dly dmtl_ub_filt dmtl_ub_ref /end OUT_MEASUREMENT
/end FUNCTION
/begin FUNCTION TE ""
 /begin DEF_CHARACTERISTIC K_TE_A_MIN K_TE_ANZUGSZEIT_OFFS_B1 K_TE_ANZUGSZEIT_OFFS_B2 K_TE_B_ABBR_FST_SUM K_TE_B_ABBR_TUMG K_TE_B_LANG_C_AKF K_TE_B_LANG_FST_SUM K_TE_B_LANG_TUMG K_TE_B_LANG_VOL_SUM K_TE_C_AKF_DYN_DELTA_RF K_TE_C_AKF_MIN K_TE_C_AKF_RESET K_TE_C_APPL K_TE_C_LERN_RED_TAU K_TE_C_LERN_TAU K_TE_C_MAX K_TE_C_MIN K_TE_C_ML_SOLL_MG_MIN K_TE_C_STAT_DELTA K_TE_C_STAT_T K_TE_C_T_SPUEL_MAX K_TE_C_T_SPUEL_MIN K_TE_C_X_MIN K_TE_CFG K_TE_DR_REL_MAX_SYNC K_TE_DYN_DELTA_RF K_TE_DYN_RF_T K_TE_GW_F_KATD K_TE_GW_LAA_FETT K_TE_GW_LAA_HYS K_TE_GW_LAA_MAGER K_TE_GW_LAM_DELTA_FETT K_TE_GW_LAM_DELTA_HYS K_TE_GW_LAM_DELTA_MAGER K_TE_GW_LAM_REG_FETT K_TE_GW_LAM_REG_HYS K_TE_GW_LAM_REG_MAGER K_TE_LAA_F_TE_MCS K_TE_LAM_SOLL_MAX K_TE_LAM_SOLL_MIN K_TE_M_MAX_ML_CFG K_TE_MKS_F_AEBG_SCHW_NEG K_TE_MKS_F_AEBG_SCHW_POS K_TE_MKS_F_MAX K_TE_MKS_F_NEG K_TE_MKS_F_POS K_TE_MKS_LAM_WICHT K_TE_MZYL_SEC_F K_TE_N_DYN_DELTA K_TE_N_MAX_SYNC1 K_TE_R_C3H8 K_TE_R_LUFT K_TE_RF_DYN_DELTA K_TE_STOECH K_TE_T_LAA K_TE_T_LAA_INI K_TE_T_LAA_INI_HS K_TE_T_LANG K_TE_T_MIN K_TE_T_NORM K_TE_T_SPUEL_INI K_TE_TI_MIN_DIFF K_TE_TMOT K_TE_TMOT_START_HS K_TE_TV_MAX K_TE_TV_MIN K_TE_VAN_DYN_DELTA K_TE_X_MKS_APPL K_TE_X_MKS_CFG K_TE_X_ML_SOLL_APPL_B1 K_TE_X_ML_SOLL_APPL_B2 K_TE_X_ML_SOLL_CFG K_TE_X_ML_SOLL_MAX K_TE_X_ML_SOLL_MIN K_TE_ZU_LERN K_TE_ZU_NORM K_TE_ZU_SA KF_TE_ANZUGSZEIT KF_TE_GW_RAMPEN KF_TE_M_MAX_ML KF_TE_TV_NORM KF_TE_X_SOLL_KATD KF_TE_X_SOLL_MKS KF_TE_X_SOLL_N_PSAU KF_TE_X_SOLL_NOT KL_TE_B_ABBR_VOL_SUM KL_TE_FREQ KL_TE_GW_F KL_TE_GW_LAM_REG_F KL_TE_GW_TI_MIN KL_TE_MKS_XSI KL_TE_ML_XSI KL_TE_SYNC_FREQ KL_TE_T_BEGIN_MIN KL_TE_TI_MIN KL_TE_YPS_SQRT /end DEF_CHARACTERISTIC
 /begin OUT_MEASUREMENT B_TE_ABBR B_TE_BEGR_LAM_DELTA_b1 B_TE_BEGR_LAM_DELTA_b2 B_TE_BEGR_LAM_REG_b1 B_TE_BEGR_LAM_REG_b2 B_TE_BEGR_TI_MIN_b1 B_TE_BEGR_TI_MIN_b2 B_TE_C_AKF_ADAPT_B1 B_TE_C_AKF_ADAPT_B2 B_TE_DIAG_SH_TO_UB_B1 B_TE_DIAG_SH_TO_UB_B2 B_TE_LANG B_TE_N_STAT_B1 B_TE_N_STAT_B2 B_TE_NOTSPUELEN_B1 B_TE_NOTSPUELEN_B2 B_TE_RF_STAT_B1 B_TE_RF_STAT_B2 B_TE_STAT B_TE_STOP B_TE_VAN_STAT_B1 B_TE_VAN_STAT_B2 B_TE_ZUL te_begr_st_b1 te_begr_st_b2 te_c_akf_roh_b1 te_c_akf_roh_b2 te_c_akf_st te_c_akf_tau te_c_akf_vor_filt te_d_x_ml_soll_neg_b1 te_d_x_ml_soll_neg_b2 te_d_x_ml_soll_pos_b1 te_d_x_ml_soll_pos_b2 te_freq te_lam_delta_b1 te_lam_delta_b2 te_m_max_b1 te_m_max_b2 te_m_max_mks_b1 te_m_max_mks_b2 te_m_max_ml_b1 te_m_max_ml_b2 te_m_mks_b1 te_m_mks_b2 te_m_ml_b1 te_m_ml_b2 te_mks_b1 te_mks_b2 te_mks_f_b1 te_mks_f_b2 te_mks_f_delta_b1 te_mks_f_delta_b2 te_mks_f_ist_b1 te_mks_f_ist_b2 te_mks_ist_b1 te_mks_ist_b2 te_mks_nue te_mks_xsi_b1 te_mks_xsi_b2 te_mks_yps te_mks_yps_quad te_ml_ist_b1 te_ml_ist_b2 te_ml_min_b1 te_ml_min_b2 te_ml_nue te_ml_soll_b1 te_ml_soll_b2 te_ml_soll_mg_b1 te_ml_soll_mg_b2 te_ml_xsi_b1 te_ml_xsi_b2 te_ml_yps te_ml_yps_quad te_ml_zyl_real_b1 te_ml_zyl_real_b2 te_mzyl_diff_b1 te_mzyl_diff_b2 te_mzyl_ohne_b1 te_mzyl_ohne_b2 te_n_stat_b1 te_n_stat_b2 te_psau_diff_b1 te_psau_diff_b2 te_r_gemisch te_rf_stat_b1 te_rf_stat_b2 te_st te_t_begin_min te_t_laa te_t_laa_ini te_t_spuel te_ti_min_diff_b1 te_ti_min_diff_b2 te_tv_norm_b1 te_tv_norm_b2 te_tv_offs_b1 te_tv_offs_b2 te_tv_rel_b1 te_tv_rel_b2 te_tv_roh_b1 te_tv_roh_b2 te_van_vo_stat_b1 te_van_vo_stat_b2 te_ventil_exd_timeout te_vol_b1 te_vol_b2 te_vol_max_b1 te_vol_max_b2 te_vol_sum te_x_mks_b1 te_x_mks_b2 te_x_mks_betrieb_b1 te_x_mks_betrieb_b2 te_x_ml_betrieb_b1 te_x_ml_betrieb_b2 te_x_ml_gw_neg_b1 te_x_ml_gw_neg_b2 te_x_ml_gw_pos_b1 te_x_ml_gw_pos_b2 te_x_ml_max_b1 te_x_ml_max_b2 te_x_ml_min_b1 te_x_ml_min_b2 te_x_ml_n_psau_b1 te_x_ml_n_psau_b2 te_x_ml_soll_aebg_b1 te_x_ml_soll_aebg_b2 te_x_ml_ziel_b1 te_x_ml_ziel_b2 /end OUT_MEASUREMENT
/end FUNCTION
/begin FUNCTION TE_OBD ""
 /begin DEF_CHARACTERISTIC K_TE_OBD_ANZ K_TE_OBD_AUSS_DELTA K_TE_OBD_AUSS_DELTA_NEG K_TE_OBD_AUSS_TAU K_TE_OBD_CFG K_TE_OBD_LAM_DELTA K_TE_OBD_LAM_FREIG K_TE_OBD_LAM_OK K_TE_OBD_LL_DELAY K_TE_OBD_LL_DELTA K_TE_OBD_LL_OK K_TE_OBD_LL_ZU_DELTA K_TE_OBD_LRW_ABBR K_TE_OBD_MD_GEN_ABBR K_TE_OBD_MD_KKOS_ABBR K_TE_OBD_ML_MAX K_TE_OBD_ML_TAU K_TE_OBD_RAMPE_ABBRUCH K_TE_OBD_RAMPE_ZU K_TE_OBD_T_LAM_REG_OFF K_TE_OBD_T_MESS_OFFEN K_TE_OBD_T_MESS_ZU K_TE_OBD_T_ML_MIN K_TE_OBD_TOEL_MIN K_TE_OBD_TOEL_MIN_EXD K_TE_OBD_TV_MAX K_TE_OBD_TZ_ABBR K_TE_OBD_UB_ABBR KL_TE_OBD_RAMPE /end DEF_CHARACTERISTIC
 /begin OUT_MEASUREMENT te_obd_auss_delta_b1 te_obd_auss_delta_b2 te_obd_auss_filt_b1 te_obd_auss_filt_b2 te_obd_auss_ok_b1 te_obd_auss_ok_b2 te_obd_auss_start_b1 te_obd_auss_start_b2 te_obd_kkos_md_start te_obd_lam_max_b1 te_obd_lam_max_b2 te_obd_lam_min_b1 te_obd_lam_min_b2 te_obd_lam_ok_b1 te_obd_lam_ok_b2 te_obd_ll_cnt te_obd_ll_delta te_obd_ll_ok te_obd_lrw_start te_obd_md_gen_start te_obd_ml_alt te_obd_ml_filt te_obd_n_alt te_obd_result_b1 te_obd_result_b2 te_obd_st te_obd_t_dly te_obd_t_lam_reg_off te_obd_t_mess te_obd_tv_b1 te_obd_tv_b2 te_obd_tz_start te_obd_ub_start /end OUT_MEASUREMENT
/end FUNCTION
/begin FUNCTION Testfunktion ""
 /begin DEF_CHARACTERISTIC K_TEST K_TEST_LA_BANK1 K_TEST_LA_BANK2 K_TEST_MD_ZYL1 K_TEST_MD_ZYL10 K_TEST_MD_ZYL11 K_TEST_MD_ZYL12 K_TEST_MD_ZYL2 K_TEST_MD_ZYL3 K_TEST_MD_ZYL4 K_TEST_MD_ZYL5 K_TEST_MD_ZYL6 K_TEST_MD_ZYL7 K_TEST_MD_ZYL8 K_TEST_MD_ZYL9 K_TEST_X K_TEST_Y KF_TEST_XY KL_TEST_X /end DEF_CHARACTERISTIC
 /begin OUT_MEASUREMENT test_kf_ip test_kl_ip testvariable /end OUT_MEASUREMENT
/end FUNCTION
/begin RECORD_LAYOUT TKF_SW_SW_SW FNC_VALUES 5 SWORD COLUMN_DIR DIRECT AXIS_PTS_X 3 SWORD INDEX_INCR DIRECT AXIS_PTS_Y 4 SWORD INDEX_INCR DIRECT NO_AXIS_PTS_X 1 UBYTE NO_AXIS_PTS_Y 2 UBYTE /end RECORD_LAYOUT
/begin RECORD_LAYOUT TKF_SW_SW_UW FNC_VALUES 5 UWORD COLUMN_DIR DIRECT AXIS_PTS_X 3 SWORD INDEX_INCR DIRECT AXIS_PTS_Y 4 SWORD INDEX_INCR DIRECT NO_AXIS_PTS_X 1 UBYTE NO_AXIS_PTS_Y 2 UBYTE /end RECORD_LAYOUT
/begin RECORD_LAYOUT TKF_UW_UW_UW FNC_VALUES 5 UWORD COLUMN_DIR DIRECT AXIS_PTS_X 3 UWORD INDEX_INCR DIRECT AXIS_PTS_Y 4 UWORD INDEX_INCR DIRECT NO_AXIS_PTS_X 1 UBYTE NO_AXIS_PTS_Y 2 UBYTE /end RECORD_LAYOUT
/begin RECORD_LAYOUT TKL_SB_VV_UW FNC_VALUES 4 UWORD COLUMN_DIR DIRECT AXIS_PTS_X 3 SBYTE INDEX_INCR DIRECT NO_AXIS_PTS_X 1 UBYTE RESERVED 2 BYTE /end RECORD_LAYOUT
/begin RECORD_LAYOUT TKL_SW_VV_SW FNC_VALUES 4 SWORD COLUMN_DIR DIRECT AXIS_PTS_X 3 SWORD INDEX_INCR DIRECT NO_AXIS_PTS_X 1 UBYTE RESERVED 2 BYTE /end RECORD_LAYOUT
/begin RECORD_LAYOUT TKL_SW_VV_UB FNC_VALUES 4 UBYTE COLUMN_DIR DIRECT AXIS_PTS_X 3 SWORD INDEX_INCR DIRECT NO_AXIS_PTS_X 1 UBYTE RESERVED 2 BYTE /end RECORD_LAYOUT
/begin RECORD_LAYOUT TKL_SW_VV_UW FNC_VALUES 4 UWORD COLUMN_DIR DIRECT AXIS_PTS_X 3 SWORD INDEX_INCR DIRECT NO_AXIS_PTS_X 1 UBYTE RESERVED 2 BYTE /end RECORD_LAYOUT
/begin RECORD_LAYOUT TKL_UB_VV_UB FNC_VALUES 4 UBYTE COLUMN_DIR DIRECT AXIS_PTS_X 3 UBYTE INDEX_INCR DIRECT NO_AXIS_PTS_X 1 UBYTE RESERVED 2 BYTE /end RECORD_LAYOUT
/begin RECORD_LAYOUT TKL_UW_VV_SW FNC_VALUES 4 SWORD COLUMN_DIR DIRECT AXIS_PTS_X 3 UWORD INDEX_INCR DIRECT NO_AXIS_PTS_X 1 UBYTE RESERVED 2 BYTE /end RECORD_LAYOUT
/begin RECORD_LAYOUT TKL_UW_VV_UW FNC_VALUES 4 UWORD COLUMN_DIR DIRECT AXIS_PTS_X 3 UWORD INDEX_INCR DIRECT NO_AXIS_PTS_X 1 UBYTE RESERVED 2 BYTE /end RECORD_LAYOUT
/begin RECORD_LAYOUT TKW_VV_VV_SW FNC_VALUES 1 SWORD COLUMN_DIR DIRECT /end RECORD_LAYOUT
/begin RECORD_LAYOUT TKW_VV_VV_UB FNC_VALUES 1 UBYTE COLUMN_DIR DIRECT /end RECORD_LAYOUT
/begin RECORD_LAYOUT TKW_VV_VV_UW FNC_VALUES 1 UWORD COLUMN_DIR DIRECT /end RECORD_LAYOUT
/end MODULE
/end PROJECT
