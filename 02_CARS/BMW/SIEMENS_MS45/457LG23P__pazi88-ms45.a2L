ASAP2_VERSION 1 31
/begin PROJECT MS45 "BMW Motorsteuerung R6"
/begin HEADER "_default_HeaderComment" PROJECT_NO _57 /end HEADER
/begin MODULE _default_ModuleName "_default_ModuleLongIdentifier"
/begin MOD_COMMON "_default_ModCommonComment" DEPOSIT ABSOLUTE BYTE_ORDER MSB_FIRST ALIGNMENT_BYTE 1 ALIGNMENT_WORD 2 ALIGNMENT_LONG 4 ALIGNMENT_FLOAT32_IEEE 4 ALIGNMENT_FLOAT64_IEEE 8 /end MOD_COMMON
/begin CHARACTERISTIC c_v_conv_thd_deac_mon "Threshold for A/D-converter test deactivation" VALUE 0xffe51f96 _REC_VAL_20_u1 4.998 _CNV_A_R_LINEAR_____44_CM 0. 4.998 DISPLAY_IDENTIFIER C_V_CONV_THD_DEAC_MON FORMAT "%5.3" /end CHARACTERISTIC
/begin CHARACTERISTIC c_v_pvs_2_conv_ratio_hys_mon "Maximum ratio between PVS channel 2 on main controller and on monitoring unit" VALUE 0xffe51f97 _REC_VAL_20_u1 4.998 _CNV_A_R_LINEAR_____44_CM 0. 4.998 DISPLAY_IDENTIFIER C_V_PVS_2_CONV_RATIO_HYS_MON FORMAT "%5.3" /end CHARACTERISTIC
/begin MEASUREMENT abc_conv_mon "Anti bounce counter ADC error" UBYTE _CNV_A_R_LINEAR_____0_CM 1 100. 0. 255. DISPLAY_IDENTIFIER ABC_CONV_MON ECU_ADDRESS 0x3feb7a FORMAT "%3.0" /end MEASUREMENT
/begin MEASUREMENT lv_err_conv_mon_1 "A/D conversion error reflect to level 1" UBYTE _CNV_S_2_RANGE______1_R_CM 1 100. 0. 255. DISPLAY_IDENTIFIER LV_ERR_CONV_MON_1 ECU_ADDRESS 0x3fb9e8 BIT_MASK 0x1 /end MEASUREMENT
/begin CHARACTERISTIC c_can_vb_min_diag_mon "Threshold of battery voltage for CAN diagnosis" VALUE 0xffe51f60 _REC_VAL_20_u1 26. _CNV_A_R_LINEAR_____60_CM 0. 26. DISPLAY_IDENTIFIER C_CAN_VB_MIN_DIAG_MON FORMAT "%4.1" /end CHARACTERISTIC
/begin CHARACTERISTIC c_t_msr_inh_mon "Delay time for disable of MSR torque demand in monitoring level" VALUE 0xffe51f84 _REC_VAL_20_u1 10.2 _CNV_A_R_LINEAR_____41_CM 0. 10.2 DISPLAY_IDENTIFIER C_T_MSR_INH_MON FORMAT "%5.2" /end CHARACTERISTIC
/begin CHARACTERISTIC c_tqi_stnd_mon "Maximum indicated engine torque (scalling factor for torque demands from CAN)" VALUE 0xffe51f95 _REC_VAL_20_u1 510. _CNV_A_R_LINEAR_____101_CM 0. 510. DISPLAY_IDENTIFIER C_TQI_STND_MON FORMAT "%4.0" /end CHARACTERISTIC
/begin MEASUREMENT tqi_msr_mon "Torque demand from drag control" UBYTE _CNV_A_R_LINEAR_____101_CM 1 100. 0. 510. DISPLAY_IDENTIFIER TQI_MSR_MON ECU_ADDRESS 0x3feb7d FORMAT "%4.0" /end MEASUREMENT
/begin MEASUREMENT t_msr_inh_mon "Timer for inhibition of MSR torque demand in monitoring level" UBYTE _CNV_A_R_LINEAR_____41_CM 1 100. 0. 10.2 DISPLAY_IDENTIFIER T_MSR_INH_MON ECU_ADDRESS 0x3feb7e FORMAT "%5.2" /end MEASUREMENT
/begin MEASUREMENT abc_msr_inh_mon "Anti bounce counter for fault in MSR present" UBYTE _CNV_A_R_LINEAR_____0_CM 1 100. 0. 255. DISPLAY_IDENTIFIER ABC_MSR_INH_MON ECU_ADDRESS 0x3feb92 FORMAT "%3.0" /end MEASUREMENT
/begin MEASUREMENT tq_msr_mon "Torque demand from drag control BN 2000" SWORD _CNV_A_R_LINEAR_____55_CM 1 100. -1024. 1023.96875 DISPLAY_IDENTIFIER TQ_MSR_MON ECU_ADDRESS 0x3fdf2c BYTE_ORDER MSB_LAST FORMAT "%8.2" /end MEASUREMENT
/begin MEASUREMENT tq_dcc_mon "DCC torque request for monitoring" SWORD _CNV_A_R_LINEAR_____55_CM 1 100. -1024. 1023.96875 DISPLAY_IDENTIFIER TQ_DCC_MON ECU_ADDRESS 0x3fdf2e BYTE_ORDER MSB_LAST FORMAT "%8.2" /end MEASUREMENT
/begin MEASUREMENT abc_dcc_inh_mon "Anti bounce counter for fault in DCC present" UBYTE _CNV_A_R_LINEAR_____0_CM 1 100. 0. 255. DISPLAY_IDENTIFIER ABC_DCC_INH_MON ECU_ADDRESS 0x3feb94 FORMAT "%3.0" /end MEASUREMENT
/begin MEASUREMENT lv_err_dcc_rev_mon "Reversible DCC error mon" UBYTE _CNV_S_2_RANGE______1_R_CM 1 100. 0. 255. DISPLAY_IDENTIFIER LV_ERR_DCC_REV_MON ECU_ADDRESS 0x3febc8 /end MEASUREMENT
/begin MEASUREMENT t_dcc_brake_det_mon "Irreversible DCC error mon" UBYTE _CNV_A_R_LINEAR_____41_CM 1 100. 0. 10.2 DISPLAY_IDENTIFIER T_DCC_BRAKE_DET_MON ECU_ADDRESS 0x3feba0 FORMAT "%5.2" /end MEASUREMENT
/begin MEASUREMENT lv_err_dcc_inh_mon "Logical variable for fault in DCC present" UBYTE _CNV_S_2_RANGE______1_R_CM 1 100. 0. 255. DISPLAY_IDENTIFIER LV_ERR_DCC_INH_MON ECU_ADDRESS 0x3feb87 /end MEASUREMENT
/begin MEASUREMENT t_dcc_inh_mon "Timer for inhibition of DCC torque demand in monitoring level" UBYTE _CNV_A_R_LINEAR_____41_CM 1 100. 0. 10.2 DISPLAY_IDENTIFIER T_DCC_INH_MON ECU_ADDRESS 0x3feb7f FORMAT "%5.2" /end MEASUREMENT
/begin MEASUREMENT state_err_amt_mon "State of AMT Error intervention" UBYTE _CNV_A_R_LINEAR_____0_CM 1 100. 0. 255. DISPLAY_IDENTIFIER STATE_ERR_AMT_MON ECU_ADDRESS 0x3feb82 FORMAT "%3.0" /end MEASUREMENT
/begin MEASUREMENT t_state_amt_1_diag_mon "Intervention  in shift phase 1" UBYTE _CNV_A_R_LINEAR_____41_CM 1 100. 0. 10.2 DISPLAY_IDENTIFIER T_STATE_AMT_1_DIAG_MON ECU_ADDRESS 0x3feba2 FORMAT "%5.2" /end MEASUREMENT
/begin MEASUREMENT t_state_amt_2_diag_mon "Intervention  in shift phase 2" UBYTE _CNV_A_R_LINEAR_____41_CM 1 100. 0. 10.2 DISPLAY_IDENTIFIER T_STATE_AMT_2_DIAG_MON ECU_ADDRESS 0x3feba4 FORMAT "%5.2" /end MEASUREMENT
/begin MEASUREMENT t_state_amt_3_diag_mon "Intervention  in shift phase 3" UBYTE _CNV_A_R_LINEAR_____41_CM 1 100. 0. 10.2 DISPLAY_IDENTIFIER T_STATE_AMT_3_DIAG_MON ECU_ADDRESS 0x3feba6 FORMAT "%5.2" /end MEASUREMENT
/begin MEASUREMENT t_state_clu_amt_diag_mon "Timer clutch state 3" UBYTE _CNV_A_R_LINEAR_____41_CM 1 100. 0. 10.2 DISPLAY_IDENTIFIER T_STATE_CLU_AMT_DIAG_MON ECU_ADDRESS 0x3feba8 FORMAT "%5.2" /end MEASUREMENT
/begin MEASUREMENT t_tqi_amt_diag_mon "Intervention timer  1 or 3" UBYTE _CNV_A_R_LINEAR_____41_CM 1 100. 0. 10.2 DISPLAY_IDENTIFIER T_TQI_AMT_DIAG_MON ECU_ADDRESS 0x3febac FORMAT "%5.2" /end MEASUREMENT
/begin MEASUREMENT tqi_amt_plaus_mon "Plausibility torque" UBYTE _CNV_A_R_LINEAR_____101_CM 1 100. 0. 510. DISPLAY_IDENTIFIER TQI_AMT_PLAUS_MON ECU_ADDRESS 0x3febae FORMAT "%3.0" /end MEASUREMENT
/begin MEASUREMENT tqi_gs_mon "Torque demand from drag control  CAN 11H" UBYTE _CNV_A_R_LINEAR_____101_CM 1 100. 0. 510. DISPLAY_IDENTIFIER TQI_GS_MON ECU_ADDRESS 0x3feb83 FORMAT "%3.0" /end MEASUREMENT
/begin MEASUREMENT lv_err_amt_inh_mon "Logical variable for fault in MSR present" UBYTE _CNV_S_2_RANGE______1_R_CM 1 100. 0. 255. DISPLAY_IDENTIFIER LV_ERR_AMT_INH_MON ECU_ADDRESS 0x3feb8a /end MEASUREMENT
/begin MEASUREMENT t_amt_inh_mon "Timer for inhibition of AMT torque demand in monitoring level" UBYTE _CNV_A_R_LINEAR_____41_CM 1 100. 0. 10.2 DISPLAY_IDENTIFIER T_AMT_INH_MON ECU_ADDRESS 0x3feb81 FORMAT "%5.2" /end MEASUREMENT
/begin MEASUREMENT t_gs_inh_mon "Timer for inhibition of GS torque demand in monitoring level" UBYTE _CNV_A_R_LINEAR_____41_CM 1 100. 0. 10.2 DISPLAY_IDENTIFIER T_GS_INH_MON ECU_ADDRESS 0x3feb84 FORMAT "%5.2" /end MEASUREMENT
/begin MEASUREMENT tq_gs_mon "Engine torgue request of EGS  Checked torque value in monitoring level" SWORD _CNV_A_R_LINEAR_____55_CM 1 100. -1024. 1023.96875 DISPLAY_IDENTIFIER TQ_GS_MON ECU_ADDRESS 0x3fdf32 BYTE_ORDER MSB_LAST FORMAT "%8.2" /end MEASUREMENT
/begin MEASUREMENT lv_err_gs_inh_mon "Logical variable for fault in GS present" UBYTE _CNV_S_2_RANGE______1_R_CM 1 100. 0. 255. DISPLAY_IDENTIFIER LV_ERR_GS_INH_MON ECU_ADDRESS 0x3feb89 /end MEASUREMENT
/begin MEASUREMENT lv_err_tq_gs_inc_plaus_mon "GS torque increase not plausible" UBYTE _CNV_S_2_RANGE______1_R_CM 1 100. 0. 255. DISPLAY_IDENTIFIER LV_ERR_TQ_GS_INC_PLAUS_MON ECU_ADDRESS 0x3feb8d /end MEASUREMENT
/begin MEASUREMENT state_gs_plaus_mon "State GS torque increase not plausible bit coded" UBYTE _CNV_A_R_LINEAR_____0_CM 1 100. 0. 63. DISPLAY_IDENTIFIER STATE_GS_PLAUS_MON ECU_ADDRESS 0x3feb85 FORMAT "%2.0" /end MEASUREMENT
/begin MEASUREMENT lv_int_max_tq_gs_inc_mon "Gs requested torque value to high and not plausible" UBYTE _CNV_S_2_RANGE______2_CM 1 100. 0. 1. DISPLAY_IDENTIFIER LV_INT_MAX_TQ_GS_INC_MON ECU_ADDRESS 0x3feb8c /end MEASUREMENT
/begin MEASUREMENT int_tq_gs_inc_mon "Integrated Torque request EGS" UWORD _CNV_A_R_LINEAR_____102_CM 1 100. 0. 204.7 DISPLAY_IDENTIFIER INT_TQ_GS_INC_MON ECU_ADDRESS 0x3fdf34 BYTE_ORDER MSB_LAST FORMAT "%7.3" /end MEASUREMENT
/begin MEASUREMENT lv_vs_min_tq_gs_inc_mon "GS about VS torque increase not plausible" UBYTE _CNV_S_2_RANGE______2_CM 1 100. 0. 1. DISPLAY_IDENTIFIER LV_VS_MIN_TQ_GS_INC_MON ECU_ADDRESS 0x3feb8b /end MEASUREMENT
/begin MEASUREMENT ctr_t_vs_tq_gs_inc_mon "Vehicle speed threshold time delay" UBYTE _CNV_A_R_LINEAR_____41_CM 1 100. 0. 10.2 DISPLAY_IDENTIFIER CTR_T_VS_TQ_GS_INC_MON ECU_ADDRESS 0x3febb0 FORMAT "%5.2" /end MEASUREMENT
/begin MEASUREMENT ctr_t_ac_tq_gs_inc_mon "AC counter time delay" UBYTE _CNV_A_R_LINEAR_____41_CM 1 100. 0. 10.2 DISPLAY_IDENTIFIER CTR_T_AC_TQ_GS_INC_MON ECU_ADDRESS 0x3febb2 FORMAT "%5.2" /end MEASUREMENT
/begin MEASUREMENT lv_ac_max_tq_gs_inc_mon "GS about AC requested torque value to high and not plausible" UBYTE _CNV_S_2_RANGE______2_CM 1 100. 0. 1. DISPLAY_IDENTIFIER LV_AC_MAX_TQ_GS_INC_MON ECU_ADDRESS 0x3feb8e /end MEASUREMENT
/begin MEASUREMENT lv_t_min_tq_gs_inc_deac_mon "Minimum time between two requests to low" UBYTE _CNV_S_2_RANGE______2_CM 1 100. 0. 1. DISPLAY_IDENTIFIER LV_T_MIN_TQ_GS_INC_DEAC_MON ECU_ADDRESS 0x3feb8f /end MEASUREMENT
/begin MEASUREMENT ctr_t_max_tq_gs_inc_mon "Counter MAX time limit threshold time" UBYTE _CNV_A_R_LINEAR_____41_CM 1 100. 0. 10.2 DISPLAY_IDENTIFIER CTR_T_MAX_TQ_GS_INC_MON ECU_ADDRESS 0x3febb6 FORMAT "%5.2" /end MEASUREMENT
/begin MEASUREMENT lv_t_max_tq_gs_inc_mon "Requesting time to long" UBYTE _CNV_S_2_RANGE______2_CM 1 100. 0. 1. DISPLAY_IDENTIFIER LV_T_MAX_TQ_GS_INC_MON ECU_ADDRESS 0x3feb90 /end MEASUREMENT
/begin MEASUREMENT lv_tq_max_tq_gs_inc_mon "Inegrated torque to high" UBYTE _CNV_S_2_RANGE______2_CM 1 100. 0. 1. DISPLAY_IDENTIFIER LV_TQ_MAX_TQ_GS_INC_MON ECU_ADDRESS 0x3feb91 /end MEASUREMENT
/begin MEASUREMENT ctr_t_dif_min_tq_gs_inc_mon "Minimum time between two requests to low" UBYTE _CNV_A_R_LINEAR_____41_CM 1 100. 0. 10.2 DISPLAY_IDENTIFIER CTR_T_DIF_MIN_TQ_GS_INC_MON ECU_ADDRESS 0x3febb4 FORMAT "%5.2" /end MEASUREMENT
/begin MEASUREMENT ctr_t_tq_max_tq_gs_inc_mon "Min time limit threshold time delay" UBYTE _CNV_A_R_LINEAR_____41_CM 1 100. 0. 10.2 DISPLAY_IDENTIFIER CTR_T_TQ_MAX_TQ_GS_INC_MON ECU_ADDRESS 0x3febb8 FORMAT "%5.2" /end MEASUREMENT
/begin CHARACTERISTIC c_t_dcc_inh_mon "Delay time for disable of DCC torque demand in monitoring level" VALUE 0xffe51f77 _REC_VAL_20_u1 10.2 _CNV_A_R_LINEAR_____41_CM 0. 10.2 DISPLAY_IDENTIFIER C_T_DCC_INH_MON FORMAT "%5.2" /end CHARACTERISTIC
/begin CHARACTERISTIC c_t_max_brake_det_dcc_mon "Maximum Brake delay timer" VALUE 0xffe51f7d _REC_VAL_20_u1 10.2 _CNV_A_R_LINEAR_____41_CM 0. 10.2 DISPLAY_IDENTIFIER C_T_MAX_BRAKE_DET_DCC_MON FORMAT "%5.2" /end CHARACTERISTIC
/begin CHARACTERISTIC c_vs_fil_amt_mon "Vehicle speed threshold  engine stop" VALUE 0xffe522f0 _REC_VAL_20_u2 511.99218 _CNV_A_R_LINEAR_____85_CM 0. 511.99218 DISPLAY_IDENTIFIER C_VS_FIL_AMT_MON FORMAT "%7.3" /end CHARACTERISTIC
/begin CHARACTERISTIC c_t_max_state_amt_1_diag_mon "Max Intervention  in shift phase 1" VALUE 0xffe51f7e _REC_VAL_20_u1 10.2 _CNV_A_R_LINEAR_____41_CM 0. 10.2 DISPLAY_IDENTIFIER C_T_MAX_STATE_AMT_1_DIAG_MON FORMAT "%5.2" /end CHARACTERISTIC
/begin CHARACTERISTIC c_t_max_state_amt_2_diag_mon "Max Intervention  in shift phase 2" VALUE 0xffe51f7f _REC_VAL_20_u1 10.2 _CNV_A_R_LINEAR_____41_CM 0. 10.2 DISPLAY_IDENTIFIER C_T_MAX_STATE_AMT_2_DIAG_MON FORMAT "%5.2" /end CHARACTERISTIC
/begin CHARACTERISTIC c_tqi_amt_diag_mon "Plausibility torque intervention hysteresis" VALUE 0xffe51f92 _REC_VAL_20_u1 510. _CNV_A_R_LINEAR_____101_CM 0. 510. DISPLAY_IDENTIFIER C_TQI_AMT_DIAG_MON FORMAT "%3.0" /end CHARACTERISTIC
/begin CHARACTERISTIC c_t_max_state_amt_3_diag_mon "Max Intervention  in shift phase 3" VALUE 0xffe51f80 _REC_VAL_20_u1 10.2 _CNV_A_R_LINEAR_____41_CM 0. 10.2 DISPLAY_IDENTIFIER C_T_MAX_STATE_AMT_3_DIAG_MON FORMAT "%5.2" /end CHARACTERISTIC
/begin CHARACTERISTIC c_t_max_tqi_amt_diag_mon "Max. timer shift intervention phase 1or 3" VALUE 0xffe51f83 _REC_VAL_20_u1 10.2 _CNV_A_R_LINEAR_____41_CM 0. 10.2 DISPLAY_IDENTIFIER C_T_MAX_TQI_AMT_DIAG_MON FORMAT "%5.2" /end CHARACTERISTIC
/begin CHARACTERISTIC c_tqi_amt_cond_diag_mon "Torque at shift phase 0" VALUE 0xffe51f91 _REC_VAL_20_u1 510. _CNV_A_R_LINEAR_____101_CM 0. 510. DISPLAY_IDENTIFIER C_TQI_AMT_COND_DIAG_MON FORMAT "%3.0" /end CHARACTERISTIC
/begin CHARACTERISTIC c_tqi_amt_can_es_mon "Torque at engine stop" VALUE 0xffe51f90 _REC_VAL_20_u1 510. _CNV_A_R_LINEAR_____101_CM 0. 510. DISPLAY_IDENTIFIER C_TQI_AMT_CAN_ES_MON FORMAT "%3.0" /end CHARACTERISTIC
/begin CHARACTERISTIC c_t_max_state_clu_amt_diag_mon "Max. time at clutch" VALUE 0xffe51f81 _REC_VAL_20_u1 10.2 _CNV_A_R_LINEAR_____41_CM 0. 10.2 DISPLAY_IDENTIFIER C_T_MAX_STATE_CLU_AMT_DIAG_MON FORMAT "%5.2" /end CHARACTERISTIC
/begin CHARACTERISTIC c_t_amt_inh_mon "Delay time for disable of AMT torque demand in monitoring level" VALUE 0xffe51f75 _REC_VAL_20_u1 10.2 _CNV_A_R_LINEAR_____41_CM 0. 10.2 DISPLAY_IDENTIFIER C_T_AMT_INH_MON FORMAT "%5.2" /end CHARACTERISTIC
/begin CHARACTERISTIC c_t_gs_inh_mon "Delay time for disable of GS torque demand in monitoring level" VALUE 0xffe51f7c _REC_VAL_20_u1 10.2 _CNV_A_R_LINEAR_____41_CM 0. 10.2 DISPLAY_IDENTIFIER C_T_GS_INH_MON FORMAT "%5.2" /end CHARACTERISTIC
/begin CHARACTERISTIC c_vs_min_tq_gs_inc_mon "Vehicle speed threshold" VALUE 0xffe522f2 _REC_VAL_20_u2 511.99218 _CNV_A_R_LINEAR_____85_CM 0. 511.99218 DISPLAY_IDENTIFIER C_VS_MIN_TQ_GS_INC_MON FORMAT "%7.3" /end CHARACTERISTIC
/begin CHARACTERISTIC c_t_dly_min_vs_tq_gs_inc_mon "Vehicle speed threshold time delay" VALUE 0xffe51f7a _REC_VAL_20_u1 10.2 _CNV_A_R_LINEAR_____41_CM 0. 10.2 DISPLAY_IDENTIFIER C_T_DLY_MIN_VS_TQ_GS_INC_MON FORMAT "%5.2" /end CHARACTERISTIC
/begin CHARACTERISTIC c_crlc_tq_gs_inc_plaus_mon "Corelation of torque request " VALUE 0xffe51f62 _REC_VAL_20_u1 0.9960940000000002 _CNV_A_R_LINEAR_____50_CM 0. 0.996094 DISPLAY_IDENTIFIER C_CRLC_TQ_GS_INC_PLAUS_MON FORMAT "%5.3" /end CHARACTERISTIC
/begin CHARACTERISTIC c_int_max_tq_gs_inc_mon "Max value integrated torque" VALUE 0xffe522cc _REC_VAL_20_u2 204.7 _CNV_A_R_LINEAR_____102_CM 0. 204.7 DISPLAY_IDENTIFIER C_INT_MAX_TQ_GS_INC_MON FORMAT "%7.3" /end CHARACTERISTIC
/begin CHARACTERISTIC c_int_min_tq_gs_inc_mon "Min value integrated torque" VALUE 0xffe522ce _REC_VAL_20_u2 204.7 _CNV_A_R_LINEAR_____102_CM 0. 204.7 DISPLAY_IDENTIFIER C_INT_MIN_TQ_GS_INC_MON FORMAT "%7.3" /end CHARACTERISTIC
/begin CHARACTERISTIC c_t_dly_ac_max_tq_gs_inc_mon "AC threshold time delay" VALUE 0xffe51f79 _REC_VAL_20_u1 10.2 _CNV_A_R_LINEAR_____41_CM 0. 10.2 DISPLAY_IDENTIFIER C_T_DLY_AC_MAX_TQ_GS_INC_MON FORMAT "%5.2" /end CHARACTERISTIC
/begin CHARACTERISTIC c_t_max_tq_gs_inc_mon "Min time limit threshold time delay" VALUE 0xffe51f82 _REC_VAL_20_u1 10.2 _CNV_A_R_LINEAR_____41_CM 0. 10.2 DISPLAY_IDENTIFIER C_T_MAX_TQ_GS_INC_MON FORMAT "%5.2" /end CHARACTERISTIC
/begin CHARACTERISTIC c_t_dly_tq_max_tq_gs_inc_mon "Min time limit threshold time delay" VALUE 0xffe51f7b _REC_VAL_20_u1 10.2 _CNV_A_R_LINEAR_____41_CM 0. 10.2 DISPLAY_IDENTIFIER C_T_DLY_TQ_MAX_TQ_GS_INC_MON FORMAT "%5.2" /end CHARACTERISTIC
/begin AXIS_PTS ldp_vs_fil__tq_gs_inc_mon "" 0xffe523fe vs_fil _REC_AXS_20_u2 511.99218 _CNV_A_R_LINEAR_____85_CM 6 0. 511.99218 DISPLAY_IDENTIFIER LDP_VS_FIL__TQ_GS_INC_MON FORMAT "%7.3" /end AXIS_PTS
/begin AXIS_PTS ldp_n_32__tq_gs_inc_mon "" 0xffe52213 n_32 _REC_AXS_20_u1 8160. _CNV_A_R_LINEAR_____15_CM 6 0. 8160. DISPLAY_IDENTIFIER LDP_N_32__TQ_GS_INC_MON FORMAT "%4.0" /end AXIS_PTS
/begin CHARACTERISTIC ip_ac_max_tq_gs_inc_mon "Acceleration threshold" CURVE 0xffe522f4 _REC_CUR_20_u2_u2 102.35 _CNV_A_R_LINEAR_____103_CM -51.175 51.175 DISPLAY_IDENTIFIER IP_AC_MAX_TQ_GS_INC_MON FORMAT "%7.4"
 /begin AXIS_DESCR COM_AXIS vs_fil _CNV_A_R_LINEAR_____85_CM 6 0. 511.99218 FORMAT "%7.3" AXIS_PTS_REF ldp_vs_fil__tq_gs_inc_mon /end AXIS_DESCR
/end CHARACTERISTIC
/begin CHARACTERISTIC ip_tq_max_tq_gs_inc_mon "Maximum requested torque EGS " CURVE 0xffe5234a _REC_CUR_20_u2_u1 1023.96875 _CNV_A_R_LINEAR_____55_CM 0. 1023.96875 DISPLAY_IDENTIFIER IP_TQ_MAX_TQ_GS_INC_MON FORMAT "%7.2"
 /begin AXIS_DESCR COM_AXIS n_32 _CNV_A_R_LINEAR_____15_CM 6 0. 8160. FORMAT "%4.0" AXIS_PTS_REF ldp_n_32__tq_gs_inc_mon /end AXIS_DESCR
/end CHARACTERISTIC
/begin MEASUREMENT abc_amt_inh_mon "Anti bounce counter for fault in AMT present" UBYTE _CNV_A_R_LINEAR_____0_CM 1 100. 0. 255. DISPLAY_IDENTIFIER ABC_AMT_INH_MON ECU_ADDRESS 0x3feb96 FORMAT "%3.0" /end MEASUREMENT
/begin MEASUREMENT state_amt_old_mon "Previos shift phase3 " UBYTE _CNV_A_R_LINEAR_____0_CM 1 100. 0. 3. DISPLAY_IDENTIFIER STATE_AMT_OLD_MON ECU_ADDRESS 0x3febaa FORMAT "%2.0" /end MEASUREMENT
/begin MEASUREMENT lv_err_dcc_irrev_mon "Irreversible DCC error mon" UBYTE _CNV_S_2_RANGE______1_R_CM 1 100. 0. 255. DISPLAY_IDENTIFIER LV_ERR_DCC_IRREV_MON ECU_ADDRESS 0x3febca /end MEASUREMENT
/begin MEASUREMENT lv_dcc_off_ecu_mon "Irreversible DCC error mon" UBYTE _CNV_S_2_RANGE______1_R_CM 1 100. 0. 255. DISPLAY_IDENTIFIER LV_DCC_OFF_ECU_MON ECU_ADDRESS 0x3feb88 /end MEASUREMENT
/begin MEASUREMENT tq_amt_mon "Engine torgue request of AMT  Checked torque value in monitoring level" SWORD _CNV_A_R_LINEAR_____55_CM 1 100. -1024. 1023.96875 DISPLAY_IDENTIFIER TQ_AMT_MON ECU_ADDRESS 0x3fdf30 BYTE_ORDER MSB_LAST FORMAT "%8.2" /end MEASUREMENT
/begin MEASUREMENT tqi_amt_mon "Torque demand from AMT control CAN11H" UBYTE _CNV_A_R_LINEAR_____101_CM 1 100. 0. 510. DISPLAY_IDENTIFIER TQI_AMT_MON ECU_ADDRESS 0x3feb80 FORMAT "%3.0" /end MEASUREMENT
/begin MEASUREMENT abc_gs_inh_mon "Anti bounce counter for fault in GS present" UBYTE _CNV_A_R_LINEAR_____0_CM 1 100. 0. 255. DISPLAY_IDENTIFIER ABC_GS_INH_MON ECU_ADDRESS 0x3feb98 FORMAT "%3.0" /end MEASUREMENT
/begin CHARACTERISTIC c_int_tq_gs_inc_rest_mon "Minimum integrated GS intervention torque" VALUE 0xffe522d0 _REC_VAL_20_u2 204.7 _CNV_A_R_LINEAR_____102_CM 0. 204.7 DISPLAY_IDENTIFIER C_INT_TQ_GS_INC_REST_MON FORMAT "%7.3" /end CHARACTERISTIC
/begin CHARACTERISTIC c_t_dif_min_tq_gs_inc_mon "Min time limit threshold time delay" VALUE 0xffe51f78 _REC_VAL_20_u1 10.2 _CNV_A_R_LINEAR_____41_CM 0. 10.2 DISPLAY_IDENTIFIER C_T_DIF_MIN_TQ_GS_INC_MON FORMAT "%5.2" /end CHARACTERISTIC
/begin MEASUREMENT lv_err_tq_ext_mon_1 "Max torque at clutch monitoring error reflect to level 1" UBYTE _CNV_S_2_RANGE______21_CM 1 100. 0. 1. DISPLAY_IDENTIFIER LV_ERR_TQ_EXT_MON_1 ECU_ADDRESS 0x3fba00 BIT_MASK 0x1 /end MEASUREMENT
/begin CHARACTERISTIC c_vs_min_cru_mon "Minimum threshold for vehicle speed control active" VALUE 0xffe51f9f _REC_VAL_20_u1 510. _CNV_A_R_LINEAR_____158_CM 0. 510. DISPLAY_IDENTIFIER C_VS_MIN_CRU_MON FORMAT "%3.0" /end CHARACTERISTIC
/begin CHARACTERISTIC c_t_cru_inh_mon "Delay time for disable of cruise control charge demand in monitoring level" VALUE 0xffe51f76 _REC_VAL_20_u1 10.2 _CNV_A_R_LINEAR_____41_CM 0. 10.2 DISPLAY_IDENTIFIER C_T_CRU_INH_MON FORMAT "%5.2" /end CHARACTERISTIC
/begin MEASUREMENT t_cru_inh_mon "Timer for inhibition of cruise control charge demand in monitoring level" UBYTE _CNV_A_R_LINEAR_____41_CM 1 100. 0. 10.2 DISPLAY_IDENTIFIER T_CRU_INH_MON ECU_ADDRESS 0x3febd5 FORMAT "%5.2" /end MEASUREMENT
/begin MEASUREMENT fac_tq_req_cru_mon "Charge demand from cruise control" UWORD _CNV_A_R_LINEAR_____20_CM 1 100. 0. 1.99996948 DISPLAY_IDENTIFIER FAC_TQ_REQ_CRU_MON ECU_ADDRESS 0x3fdf40 BYTE_ORDER MSB_LAST FORMAT "%7.5" /end MEASUREMENT
/begin MEASUREMENT abc_cru_inh_mon "Anti bounce counter for fault in cruise conditions present" UBYTE _CNV_A_R_LINEAR_____0_CM 1 100. 0. 255. DISPLAY_IDENTIFIER ABC_CRU_INH_MON ECU_ADDRESS 0x3febd8 FORMAT "%3.0" /end MEASUREMENT
/begin MEASUREMENT lv_err_cru_inh_mon_1 "CRU monitoring error reflect to level 1" UBYTE _CNV_S_2_RANGE______21_CM 1 100. 0. 1. DISPLAY_IDENTIFIER LV_ERR_CRU_INH_MON_1 ECU_ADDRESS 0x3fba0c BIT_MASK 0x1 /end MEASUREMENT
/begin CHARACTERISTIC c_maf_sub_mmv_crlc_mon "Correlation constant for MAF_SUB_MON filter" VALUE 0xffe522d2 _REC_VAL_20_u2 0.99998474 _CNV_A_R_LINEAR_____37_CM 0. 0.99998474 DISPLAY_IDENTIFIER C_MAF_SUB_MMV_CRLC_MON FORMAT "%7.5" /end CHARACTERISTIC
/begin CHARACTERISTIC c_n_tps_min_diag_mon "Minimum engine speed for diagnosis of TPS ratio error" VALUE 0xffe51f71 _REC_VAL_20_u1 816. _CNV_A_R_LINEAR_____15_CM 0. 8160. DISPLAY_IDENTIFIER C_N_TPS_MIN_DIAG_MON FORMAT "%4.0" /end CHARACTERISTIC
/begin CHARACTERISTIC c_tps_slop_mon "nominal value of TPS slope" VALUE 0xffe51f8b _REC_VAL_20_u1 3.199 _CNV_A_R_LINEAR_____400_CM 0. 31.99 DISPLAY_IDENTIFIER C_TPS_SLOP_MON FORMAT "%4.1" /end CHARACTERISTIC
/begin CHARACTERISTIC c_v_tps_ad_el_bol_1_mon "Upper limit of V_TPS_AD_EL_BOL_1" VALUE 0xffe51f9a _REC_VAL_20_u1 4.998 _CNV_A_R_LINEAR_____44_CM 0. 4.998 DISPLAY_IDENTIFIER C_V_TPS_AD_EL_BOL_1_MON FORMAT "%5.3" /end CHARACTERISTIC
/begin CHARACTERISTIC c_v_tps_ad_el_bol_2_mon "Lower limit of V_TPS_AD_EL_BOL_2" VALUE 0xffe51f9b _REC_VAL_20_u1 4.998 _CNV_A_R_LINEAR_____44_CM 0. 4.998 DISPLAY_IDENTIFIER C_V_TPS_AD_EL_BOL_2_MON FORMAT "%5.3" /end CHARACTERISTIC
/begin CHARACTERISTIC c_v_tps_max_mon "Maximum nominal voltage of the TPS fully opened" VALUE 0xffe51f9c _REC_VAL_20_u1 4.998 _CNV_A_R_LINEAR_____44_CM 0. 4.998 DISPLAY_IDENTIFIER C_V_TPS_MAX_MON FORMAT "%6.4" /end CHARACTERISTIC
/begin CHARACTERISTIC c_v_tps_ratio_hys_mon "Maximum TPS ratio error allowed" VALUE 0xffe51f9d _REC_VAL_20_u1 4.998 _CNV_A_R_LINEAR_____44_CM 0. 4.998 DISPLAY_IDENTIFIER C_V_TPS_RATIO_HYS_MON FORMAT "%5.3" /end CHARACTERISTIC
/begin CHARACTERISTIC ip_fac_tps_isa_mon "calculation factor TPS -> ISAPWM" CURVE 0xffe52021 _REC_CUR_20_u1_u1 106.24 _CNV_A_R_LINEAR_____401_CM 0. 106.24 DISPLAY_IDENTIFIER IP_FAC_TPS_ISA_MON FORMAT "%5.1"
 /begin AXIS_DESCR COM_AXIS tps_av_mon _CNV_A_R_LINEAR_____402_CM 6 0. 119.5 FORMAT "%5.1" AXIS_PTS_REF ldp_tps_av_mon__fac_tps_isa_mon /end AXIS_DESCR
/end CHARACTERISTIC
/begin CHARACTERISTIC ip_maf_max_isa_mon "max. MAF_KGH (ISA)" CURVE 0xffe5230c _REC_CUR_20_u2_u1 2047.96875 _CNV_A_R_LINEAR_____115_CM 0. 2047.96875 DISPLAY_IDENTIFIER IP_MAF_MAX_ISA_MON FORMAT "%7.2"
 /begin AXIS_DESCR COM_AXIS pq_turb_sys_mon _CNV_A_R_LINEAR_____403_CM 6 0. 0.996094 FORMAT "%5.3" AXIS_PTS_REF ldp_pq_turb_sys_mon__fac_pq_isa /end AXIS_DESCR
/end CHARACTERISTIC
/begin CHARACTERISTIC ip_fac_pq_isa_mon "correction factor intake manifold / turbulence pressure" CURVE 0xffe5201d _REC_CUR_20_u1_u2 0.19921875 _CNV_A_R_LINEAR_____117_CM 0. 1.9921875 DISPLAY_IDENTIFIER IP_FAC_PQ_ISA_MON FORMAT "%5.3"
 /begin AXIS_DESCR COM_AXIS isapwm _CNV_A_R_LINEAR_____8_CM 4 0. 99.99847412 AXIS_PTS_REF ldp_isapwm__fac_pq_isa_mon /end AXIS_DESCR
/end CHARACTERISTIC
/begin CHARACTERISTIC c_n_min_maf_diag_mon "Minimum engine speed threshold for diagnosis of the MAF signal" VALUE 0xffe51f6e _REC_VAL_20_u1 816. _CNV_A_R_LINEAR_____15_CM 0. 8160. DISPLAY_IDENTIFIER C_N_MIN_MAF_DIAG_MON FORMAT "%4.0" /end CHARACTERISTIC
/begin CHARACTERISTIC ip_pq_mon "pressure ratio main collector" MAP 0xffe52133 _REC_MAP_20_u1_u1_u1 0.9960940000000002 _CNV_A_R_LINEAR_____403_CM 0. 0.996094 DISPLAY_IDENTIFIER IP_PQ_MON FORMAT "%5.3"
 /begin AXIS_DESCR COM_AXIS n_32_mon _CNV_A_R_LINEAR_____15_CM 8 0. 8160. FORMAT "%4.0" AXIS_PTS_REF ldp_n_32_mon__pq_mon /end AXIS_DESCR
 /begin AXIS_DESCR COM_AXIS tps_sum_av_mon _CNV_A_R_LINEAR_____402_CM 8 0. 119.5 FORMAT "%5.1" AXIS_PTS_REF ldp_tps_sum_av_mon__pq_mon /end AXIS_DESCR
/end CHARACTERISTIC
/begin CHARACTERISTIC ip_fac_maf_sub_cor_mon "Correction factor for MAF_SUB_COR_MON calculation" MAP 0xffe51ff9 _REC_MAP_20_u1_u1_u2 1.9921875 _CNV_A_R_LINEAR_____117_CM 0. 1.9921875 DISPLAY_IDENTIFIER IP_FAC_MAF_SUB_COR_MON FORMAT "%5.3"
 /begin AXIS_DESCR COM_AXIS tia _CNV_A_R_LINEAR_____11_CM 6 -48. 142.5 FORMAT "%5.1" AXIS_PTS_REF ldp_tia__fac_maf_sub_cor_mon /end AXIS_DESCR
 /begin AXIS_DESCR COM_AXIS amp _CNV_A_R_LINEAR_____49_CM 6 0. 5434. FORMAT "%7.2" AXIS_PTS_REF ldp_amp__fac_maf_sub_cor_mon /end AXIS_DESCR
/end CHARACTERISTIC
/begin CHARACTERISTIC ip_maf_sub_mon "MAF substitute" MAP 0xffe520ec _REC_MAP_20_u1_u1_u1 138.9 _CNV_A_R_LINEAR_____27_CM 0. 1389. DISPLAY_IDENTIFIER IP_MAF_SUB_MON FORMAT "%4.0"
 /begin AXIS_DESCR COM_AXIS n_32_mon _CNV_A_R_LINEAR_____15_CM 8 0. 8160. FORMAT "%4.0" AXIS_PTS_REF ldp_n_32_mon__maf_sub_mon /end AXIS_DESCR
 /begin AXIS_DESCR COM_AXIS tps_av_mon _CNV_A_R_LINEAR_____402_CM 8 0. 119.5 FORMAT "%5.1" AXIS_PTS_REF ldp_tps_av_mon__maf_sub_mon /end AXIS_DESCR
/end CHARACTERISTIC
/begin CHARACTERISTIC ip_maf_sub_thd_mon "Threshold for MAF_MON error detection" CURVE 0xffe5212c _REC_CUR_20_u1_u1 138.9 _CNV_A_R_LINEAR_____27_CM 0. 1389. DISPLAY_IDENTIFIER IP_MAF_SUB_THD_MON FORMAT "%4.0"
 /begin AXIS_DESCR COM_AXIS maf_sub_1 _CNV_A_R_LINEAR_____27_CM 2 0. 1389. FORMAT "%4.0" AXIS_PTS_REF ldp_maf_sub__maf_sub_thd_mon /end AXIS_DESCR
/end CHARACTERISTIC
/begin AXIS_PTS ldp_n_32_mon__maf_sub_mon "" 0xffe52228 n_32_mon _REC_AXS_20_u1 8160. _CNV_A_R_LINEAR_____15_CM 8 0. 8160. DISPLAY_IDENTIFIER LDP_N_32_MON__MAF_SUB_MON FORMAT "%4.0" /end AXIS_PTS
/begin AXIS_PTS ldp_pq_turb_sys_mon__fac_pq_isa "" 0xffe52264 pq_turb_sys_mon _REC_AXS_20_u1 0.9960940000000002 _CNV_A_R_LINEAR_____403_CM 6 0. 0.996094 DISPLAY_IDENTIFIER LDP_PQ_TURB_SYS_MON__FAC_PQ_ISA FORMAT "%5.3" /end AXIS_PTS
/begin AXIS_PTS ldp_tps_av_mon__fac_tps_isa_mon "" 0xffe522a0 tps_av_mon _REC_AXS_20_u1 11.95 _CNV_A_R_LINEAR_____402_CM 6 0. 119.5 DISPLAY_IDENTIFIER LDP_TPS_AV_MON__FAC_TPS_ISA_MON FORMAT "%5.1" /end AXIS_PTS
/begin AXIS_PTS ldp_tps_av_mon__maf_sub_mon "" 0xffe522a7 tps_av_mon _REC_AXS_20_u1 11.95 _CNV_A_R_LINEAR_____402_CM 8 0. 119.5 DISPLAY_IDENTIFIER LDP_TPS_AV_MON__MAF_SUB_MON FORMAT "%5.1" /end AXIS_PTS
/begin AXIS_PTS ldp_amp__fac_maf_sub_cor_mon "" 0xffe523da amp _REC_AXS_20_u2 5434. _CNV_A_R_LINEAR_____49_CM 6 0. 5434. DISPLAY_IDENTIFIER LDP_AMP__FAC_MAF_SUB_COR_MON FORMAT "%7.2" /end AXIS_PTS
/begin AXIS_PTS ldp_n_32_mon__pq_mon "" 0xffe52231 n_32_mon _REC_AXS_20_u1 816. _CNV_A_R_LINEAR_____15_CM 8 0. 8160. DISPLAY_IDENTIFIER LDP_N_32_MON__PQ_MON FORMAT "%4.0" /end AXIS_PTS
/begin AXIS_PTS ldp_tps_sum_av_mon__pq_mon "" 0xffe522b0 tps_sum_av_mon _REC_AXS_20_u1 119.5 _CNV_A_R_LINEAR_____402_CM 8 0. 119.5 DISPLAY_IDENTIFIER LDP_TPS_SUM_AV_MON__PQ_MON FORMAT "%5.1" /end AXIS_PTS
/begin AXIS_PTS ldp_tia__fac_maf_sub_cor_mon "Correction factor for MAF_SUB_COR_MON calculation" 0xffe52299 tia _REC_AXS_20_u1 190.5 _CNV_A_R_LINEAR_____11_CM 6 -48. 142.5 DISPLAY_IDENTIFIER LDP_TIA__FAC_MAF_SUB_COR_MON FORMAT "%5.1" /end AXIS_PTS
/begin AXIS_PTS ldp_isapwm__fac_pq_isa_mon "" 0xffe523f4 isapwm _REC_AXS_20_u2 14.999771118 _CNV_A_R_LINEAR_____8_CM 4 0. 99.99847412 DISPLAY_IDENTIFIER LDP_ISAPWM__FAC_PQ_ISA_MON /end AXIS_PTS
/begin MEASUREMENT abc_maf_mon "Anti bounce counter MAF signal" UBYTE _CNV_A_R_LINEAR_____0_CM 1 100. 0. 255. DISPLAY_IDENTIFIER ABC_MAF_MON ECU_ADDRESS 0x3febf5 FORMAT "%3.0" /end MEASUREMENT
/begin MEASUREMENT abc_tps_ratio_mon "Anti bounce counter TPS ratio error" UBYTE _CNV_A_R_LINEAR_____0_CM 1 100. 0. 255. DISPLAY_IDENTIFIER ABC_TPS_RATIO_MON ECU_ADDRESS 0x3febf3 FORMAT "%3.0" /end MEASUREMENT
/begin MEASUREMENT maf_mon "Mass air flow signal used monitoring level" UBYTE _CNV_A_R_LINEAR_____27_CM 1 100. 0. 1389. DISPLAY_IDENTIFIER MAF_MON ECU_ADDRESS 0x3febe5 FORMAT "%4.0" /end MEASUREMENT
/begin MEASUREMENT maf_sub_mon "MAF substitute" UBYTE _CNV_A_R_LINEAR_____27_CM 1 100. 0. 1389. DISPLAY_IDENTIFIER MAF_SUB_MON ECU_ADDRESS 0x3febee FORMAT "%4.0" /end MEASUREMENT
/begin MEASUREMENT pq_turb_sys_mon "ISA pressure quotient" UBYTE _CNV_A_R_LINEAR_____403_CM 1 100. 0. 0.996094 DISPLAY_IDENTIFIER PQ_TURB_SYS_MON ECU_ADDRESS 0x3febf1 FORMAT "%5.3" /end MEASUREMENT
/begin MEASUREMENT tps_av_mon "TPS actual value" UBYTE _CNV_A_R_LINEAR_____402_CM 1 100. 0. 119.5 DISPLAY_IDENTIFIER TPS_AV_MON ECU_ADDRESS 0x3febe7 FORMAT "%5.1" /end MEASUREMENT
/begin MEASUREMENT tps_sum_av_mon "total throttle angel actual value" UBYTE _CNV_A_R_LINEAR_____402_CM 1 100. 0. 119.5 DISPLAY_IDENTIFIER TPS_SUM_AV_MON ECU_ADDRESS 0x3febea FORMAT "%5.1" /end MEASUREMENT
/begin MEASUREMENT v_tps_1_mon "Adapted TPS signal channel 1" UBYTE _CNV_A_R_LINEAR_____44_CM 1 100. 0. 4.998 DISPLAY_IDENTIFIER V_TPS_1_MON ECU_ADDRESS 0x3febec FORMAT "%5.3" /end MEASUREMENT
/begin MEASUREMENT v_tps_2_mon "Adapted TPS signal channel 2" UBYTE _CNV_A_R_LINEAR_____44_CM 1 100. 0. 4.998 DISPLAY_IDENTIFIER V_TPS_2_MON ECU_ADDRESS 0x3febed FORMAT "%5.3" /end MEASUREMENT
/begin MEASUREMENT maf_sub_cor_mmv_mon "Low pass filtered MAF_SUB_COR_MON" UBYTE _CNV_A_R_LINEAR_____27_CM 1 100. 0. 1389. DISPLAY_IDENTIFIER MAF_SUB_COR_MMV_MON ECU_ADDRESS 0x3febe6 FORMAT "%4.0" /end MEASUREMENT
/begin MEASUREMENT maf_sub_tps_mon "MAF substitute (TPS)" UBYTE _CNV_A_R_LINEAR_____27_CM 1 100. 0. 1389. DISPLAY_IDENTIFIER MAF_SUB_TPS_MON ECU_ADDRESS 0x3febf0 FORMAT "%4.0" /end MEASUREMENT
/begin MEASUREMENT maf_sub_isa_mon "MAF substitute (ISA)" UBYTE _CNV_A_R_LINEAR_____27_CM 1 100. 0. 1389. DISPLAY_IDENTIFIER MAF_SUB_ISA_MON ECU_ADDRESS 0x3febef FORMAT "%4.0" /end MEASUREMENT
/begin MEASUREMENT lv_err_maf_tps_mon_1 "MAF / TPS monitoring error reflect to level 1" UBYTE _CNV_S_2_RANGE______21_CM 1 100. 0. 1. DISPLAY_IDENTIFIER LV_ERR_MAF_TPS_MON_1 ECU_ADDRESS 0x3fb9f4 BIT_MASK 0x1 /end MEASUREMENT
/begin MEASUREMENT ctr_mis_det_cyl[0] "Number of misfires events on cylinder [0]  in one DC" UWORD _CNV_A_R_LINEAR_____0_CM 1 100. 0. 65535. DISPLAY_IDENTIFIER CTR_MIS_DET_CYL_0 ECU_ADDRESS 0x3fd548 BYTE_ORDER MSB_LAST FORMAT "%5.0" /end MEASUREMENT
/begin MEASUREMENT ctr_mis_det_cyl[1] "Number of misfires events on cylinder [1] in one DC" UWORD _CNV_A_R_LINEAR_____0_CM 1 100. 0. 65535. DISPLAY_IDENTIFIER CTR_MIS_DET_CYL_1 ECU_ADDRESS 0x3fd54a BYTE_ORDER MSB_LAST FORMAT "%5.0" /end MEASUREMENT
/begin MEASUREMENT ctr_mis_det_cyl[2] "Number of misfires events on cylinder [2] in one DC" UWORD _CNV_A_R_LINEAR_____0_CM 1 100. 0. 65535. DISPLAY_IDENTIFIER CTR_MIS_DET_CYL_2 ECU_ADDRESS 0x3fd54c BYTE_ORDER MSB_LAST FORMAT "%5.0" /end MEASUREMENT
/begin MEASUREMENT ctr_mis_det_cyl[3] "Number of misfires events on cylinder [3] in one DC" UWORD _CNV_A_R_LINEAR_____0_CM 1 100. 0. 65535. DISPLAY_IDENTIFIER CTR_MIS_DET_CYL_3 ECU_ADDRESS 0x3fd54e BYTE_ORDER MSB_LAST FORMAT "%5.0" /end MEASUREMENT
/begin MEASUREMENT ctr_mis_det_cyl[4] "Number of misfires events on cylinder [4] in one DC" UWORD _CNV_A_R_LINEAR_____0_CM 1 100. 0. 65535. DISPLAY_IDENTIFIER CTR_MIS_DET_CYL_4 ECU_ADDRESS 0x3fd550 BYTE_ORDER MSB_LAST FORMAT "%5.0" /end MEASUREMENT
/begin MEASUREMENT ctr_mis_det_cyl[5] "Number of misfires events on cylinder [5] in one DC" UWORD _CNV_A_R_LINEAR_____0_CM 1 100. 0. 65535. DISPLAY_IDENTIFIER CTR_MIS_DET_CYL_5 ECU_ADDRESS 0x3fd552 BYTE_ORDER MSB_LAST FORMAT "%5.0" /end MEASUREMENT
/begin MEASUREMENT ctr_mis_det "Number of misfire events of all cylinders in one DC" UWORD _CNV_A_R_LINEAR_____0_CM 1 100. 0. 65535. DISPLAY_IDENTIFIER CTR_MIS_DET ECU_ADDRESS 0x3fd554 BYTE_ORDER MSB_LAST FORMAT "%5.0" /end MEASUREMENT
/begin MEASUREMENT ctr_seg_mis_act "Number of segments with active misfire detection" ULONG _CNV_A_R_LINEAR_____22_CM 1 100. 0. 4294967295. DISPLAY_IDENTIFIER CTR_SEG_MIS_ACT ECU_ADDRESS 0x3fcbb8 BYTE_ORDER MSB_LAST FORMAT "%11.0" /end MEASUREMENT
/begin CHARACTERISTIC c_v_tps_1_lih_mon "Threshold for detection of throttle position 1 outside limp home position" VALUE 0xffe522ec _REC_VAL_20_u2 4.99511719 _CNV_A_R_LINEAR_____3_CM 0. 4.99511719 DISPLAY_IDENTIFIER C_V_TPS_1_LIH_MON FORMAT "%5.3" /end CHARACTERISTIC
/begin CHARACTERISTIC c_v_tps_2_lih_mon "Threshold for detection of throttle position 2 outside limp home position" VALUE 0xffe522ee _REC_VAL_20_u2 4.99511719 _CNV_A_R_LINEAR_____3_CM 0. 4.99511719 DISPLAY_IDENTIFIER C_V_TPS_2_LIH_MON FORMAT "%5.3" /end CHARACTERISTIC
/begin MEASUREMENT lv_n_lim_etc_mon "Logical variable for activation of engine speed limitation monitoring" UBYTE _CNV_S_2_RANGE______21_CM 1 100. 0. 1. DISPLAY_IDENTIFIER LV_N_LIM_ETC_MON ECU_ADDRESS 0x3febfa BIT_MASK 0x1 /end MEASUREMENT
/begin MEASUREMENT lv_tqi_mon_act_mon "Logical variable for torque monitoring active" UBYTE _CNV_S_2_RANGE______21_CM 1 100. 0. 1. DISPLAY_IDENTIFIER LV_TQI_MON_ACT_MON ECU_ADDRESS 0x3febfb BIT_MASK 0x1 /end MEASUREMENT
/begin MEASUREMENT tq_esp_mon "Engine torgue request of ESP  Checked torque value in monitoring level" SWORD _CNV_A_R_LINEAR_____55_CM 1 100. -1024. 1023.96875 DISPLAY_IDENTIFIER TQ_ESP_MON ECU_ADDRESS 0x3fdf48 BYTE_ORDER MSB_LAST FORMAT "%8.2" /end MEASUREMENT
/begin MEASUREMENT lv_brake_mon "Brake active or brake fault present" UBYTE _CNV_S_2_RANGE______21_CM 1 100. 0. 1. DISPLAY_IDENTIFIER LV_BRAKE_MON ECU_ADDRESS 0x3febfd BIT_MASK 0x1 /end MEASUREMENT
/begin MEASUREMENT lv_im_bts_mon "" UBYTE _CNV_S_2_RANGE______21_CM 1 100. 0. 1. DISPLAY_IDENTIFIER LV_IM_BTS_MON ECU_ADDRESS 0x3fec0b BIT_MASK 0x1 /end MEASUREMENT
/begin MEASUREMENT lv_im_bls_mon "" UBYTE _CNV_S_2_RANGE______21_CM 1 100. 0. 1. DISPLAY_IDENTIFIER LV_IM_BLS_MON ECU_ADDRESS 0x3fec0c BIT_MASK 0x1 /end MEASUREMENT
/begin MEASUREMENT lv_igk_mon "Logical variable for ignition key on" UBYTE _CNV_S_2_RANGE______21_CM 1 100. 0. 1. DISPLAY_IDENTIFIER LV_IGK_MON ECU_ADDRESS 0x3febfc BIT_MASK 0x1 /end MEASUREMENT
/begin MEASUREMENT n_sp_is_mon "Idle speed setpoint used in level 2" UWORD _CNV_A_R_LINEAR_____10_CM 1 100. 0. 8160. DISPLAY_IDENTIFIER N_SP_IS_MON ECU_ADDRESS 0x3fdf44 BYTE_ORDER MSB_LAST FORMAT "%4.0" /end MEASUREMENT
/begin MEASUREMENT tq_egs_mon "Engine torgue request of EGS  Checked torque value in monitoring level" SWORD _CNV_A_R_LINEAR_____55_CM 1 100. -1024. 1023.96875 DISPLAY_IDENTIFIER TQ_EGS_MON ECU_ADDRESS 0x3fdf46 BYTE_ORDER MSB_LAST FORMAT "%8.2" /end MEASUREMENT
/begin MEASUREMENT tq_loss_acc_mon "Air conditioning compressor torque losses" SWORD _CNV_A_R_LINEAR_____55_CM 1 100. -1024. 1023.96875 DISPLAY_IDENTIFIER TQ_LOSS_ACC_MON ECU_ADDRESS 0x3fdf56 BYTE_ORDER MSB_LAST FORMAT "%8.2" /end MEASUREMENT
/begin MEASUREMENT tq_loss_add_mon "Additional torque losses" SWORD _CNV_A_R_LINEAR_____55_CM 1 100. -1024. 1023.96875 DISPLAY_IDENTIFIER TQ_LOSS_ADD_MON ECU_ADDRESS 0x3fdf4a BYTE_ORDER MSB_LAST FORMAT "%8.2" /end MEASUREMENT
/begin MEASUREMENT tq_loss_alter_mon "Additional torque losses" SWORD _CNV_A_R_LINEAR_____55_CM 1 100. -1024. 1023.96875 DISPLAY_IDENTIFIER TQ_LOSS_ALTER_MON ECU_ADDRESS 0x3fdf58 BYTE_ORDER MSB_LAST FORMAT "%8.2" /end MEASUREMENT
/begin MEASUREMENT tq_loss_alter_mdl_mon "Modelled alternator torque losses" SWORD _CNV_A_R_LINEAR_____55_CM 1 100. -1024. 1023.96875 DISPLAY_IDENTIFIER TQ_LOSS_ALTER_MDL_MON ECU_ADDRESS 0x3fdf5a BYTE_ORDER MSB_LAST FORMAT "%8.2" /end MEASUREMENT
/begin MEASUREMENT tq_loss_ars_mon "Anti roll stabilisation torque losses" SWORD _CNV_A_R_LINEAR_____55_CM 1 100. -1024. 1023.96875 DISPLAY_IDENTIFIER TQ_LOSS_ARS_MON ECU_ADDRESS 0x3fdf5c BYTE_ORDER MSB_LAST FORMAT "%8.2" /end MEASUREMENT
/begin MEASUREMENT tq_loss_pste_1_mon "Steering wheel compressor torque losses" SWORD _CNV_A_R_LINEAR_____55_CM 1 100. -1024. 1023.96875 DISPLAY_IDENTIFIER TQ_LOSS_PSTE_1_MON ECU_ADDRESS 0x3fdf60 BYTE_ORDER MSB_LAST FORMAT "%8.2" /end MEASUREMENT
/begin MEASUREMENT tq_loss_pste_mon "Steering wheel compressor torque losses" SWORD _CNV_A_R_LINEAR_____55_CM 1 100. -1024. 1023.96875 DISPLAY_IDENTIFIER TQ_LOSS_PSTE_MON ECU_ADDRESS 0x3fdf5e BYTE_ORDER MSB_LAST FORMAT "%8.2" /end MEASUREMENT
/begin MEASUREMENT tq_loss_pste_2_mon "Steering wheel compressor torque losses" SWORD _CNV_A_R_LINEAR_____55_CM 1 100. -1024. 1023.96875 DISPLAY_IDENTIFIER TQ_LOSS_PSTE_2_MON ECU_ADDRESS 0x3fdf62 BYTE_ORDER MSB_LAST FORMAT "%8.2" /end MEASUREMENT
/begin CHARACTERISTIC c_tq_loss_pste_2_min_mon "minimum additional torque loss for pste 2 active" VALUE 0xffe51f34 _REC_VAL_20_s2 40.96 _CNV_A_R_LINEAR_____55_CM -1024. 0. DISPLAY_IDENTIFIER C_TQ_LOSS_PSTE_2_MIN_MON FORMAT "%6.2" /end CHARACTERISTIC
/begin CHARACTERISTIC c_tq_loss_pste_1_min_mon "minimum additional torque loss for pste 1 active" VALUE 0xffe51f32 _REC_VAL_20_s2 40.96 _CNV_A_R_LINEAR_____55_CM -1024. 0. DISPLAY_IDENTIFIER C_TQ_LOSS_PSTE_1_MIN_MON FORMAT "%6.2" /end CHARACTERISTIC
/begin CHARACTERISTIC c_tq_loss_ars_min_mon "minimum additional torque loss for ars active" VALUE 0xffe51f30 _REC_VAL_20_s2 40.96 _CNV_A_R_LINEAR_____55_CM -1024. 0. DISPLAY_IDENTIFIER C_TQ_LOSS_ARS_MIN_MON FORMAT "%6.2" /end CHARACTERISTIC
/begin CHARACTERISTIC c_tq_loss_add_acc_min_mon "minimum additional torque loss for acc active" VALUE 0xffe51f2c _REC_VAL_20_s2 40.96 _CNV_A_R_LINEAR_____55_CM -1024. 0. DISPLAY_IDENTIFIER C_TQ_LOSS_ADD_ACC_MIN_MON FORMAT "%6.2" /end CHARACTERISTIC
/begin CHARACTERISTIC c_fac_eff_alter_mon "Alternator torque losses low pass" VALUE 0xffe51f64 _REC_VAL_20_u1 0.31875 _CNV_A_R_LINEAR_____48_CM 0. 7.96875 DISPLAY_IDENTIFIER C_FAC_EFF_ALTER_MON FORMAT "%5.3" /end CHARACTERISTIC
/begin CHARACTERISTIC c_fac_n_alter_mon "" VALUE 0xffe51f65 _REC_VAL_20_u1 0.31875 _CNV_A_R_LINEAR_____48_CM 0. 7.96875 DISPLAY_IDENTIFIER C_FAC_N_ALTER_MON FORMAT "%5.3" /end CHARACTERISTIC
/begin CHARACTERISTIC c_tq_loss_alter_lih_mon "minimum torque loss for alter at limp home active" VALUE 0xffe51f2e _REC_VAL_20_s2 40.96 _CNV_A_R_LINEAR_____55_CM -1024. 0. DISPLAY_IDENTIFIER C_TQ_LOSS_ALTER_LIH_MON FORMAT "%6.2" /end CHARACTERISTIC
/begin CHARACTERISTIC c_crlc_alter_mon "Alternator torque losses low pass" VALUE 0xffe51f61 _REC_VAL_20_u1 3.984376e-002 _CNV_A_R_LINEAR_____50_CM 0. 0.996094 DISPLAY_IDENTIFIER C_CRLC_ALTER_MON FORMAT "%5.3" /end CHARACTERISTIC
/begin CHARACTERISTIC c_v_tq_alter_mon "Voltage range of monitoring" VALUE 0xffe51f9e _REC_VAL_20_u1 1.04 _CNV_A_R_LINEAR_____60_CM 0. 26. DISPLAY_IDENTIFIER C_V_TQ_ALTER_MON FORMAT "%4.1" /end CHARACTERISTIC
/begin CHARACTERISTIC id_eff_typ_alter_mon "Alternator torque losses" CURVE 0xffe51fa0 _REC_CUR_20_u1_u1 0.9960940000000002 _CNV_A_R_LINEAR_____50_CM 0. 0.996094 DISPLAY_IDENTIFIER ID_EFF_TYP_ALTER_MON FORMAT "%5.3"
 /begin AXIS_DESCR COM_AXIS genawnumm _CNV_A_R_LINEAR_____0_CM 9 0. 255. FORMAT "%3.0" AXIS_PTS_REF ldp_genawnumm__tq_loss_mon /end AXIS_DESCR
/end CHARACTERISTIC
/begin AXIS_PTS ldp_genawnumm__tq_loss_mon "" 0xffe521dc genawnumm _REC_AXS_20_u1 255. _CNV_A_R_LINEAR_____0_CM 9 0. 255. DISPLAY_IDENTIFIER LDP_GENAWNUMM__TQ_LOSS_MON FORMAT "%3.0" /end AXIS_PTS
/begin AXIS_PTS ldp_dffgen_fil_mon__loss_mon "Alternator torque losses" 0xffe521d5 dffgen_fil_mon _REC_AXS_20_u1 99.609375 _CNV_A_R_LINEAR_____9_CM 6 0. 99.609375 DISPLAY_IDENTIFIER LDP_DFFGEN_FIL_MON__LOSS_MON FORMAT "%5.2" /end AXIS_PTS
/begin MEASUREMENT cur_alter_mon "Currency torque losses monitoring" UBYTE _CNV_A_R_LINEAR_____405_CM 1 100. 0. 255. DISPLAY_IDENTIFIER CUR_ALTER_MON ECU_ADDRESS 0x3fec02 FORMAT "%4.1" /end MEASUREMENT
/begin MEASUREMENT n_alter_mon "Currency torque losses monitoring" UWORD _CNV_A_R_LINEAR_____10_CM 1 100. 0. 65535. DISPLAY_IDENTIFIER N_ALTER_MON ECU_ADDRESS 0x3fdf4e BYTE_ORDER MSB_LAST FORMAT "%5.0" /end MEASUREMENT
/begin MEASUREMENT dffgen_fil_mon "Currency torque losses monitoring" UBYTE _CNV_A_R_LINEAR_____9_CM 1 100. 0. 99.609375 DISPLAY_IDENTIFIER DFFGEN_FIL_MON ECU_ADDRESS 0x3fec03 FORMAT "%5.2" /end MEASUREMENT
/begin AXIS_PTS ldpm_n_alter_mon__tq_loss_mon "Alternator torque losses" 0xffe5240c n_alter_mon _REC_AXS_20_u2 65535. _CNV_A_R_LINEAR_____10_CM 6 0. 65535. DISPLAY_IDENTIFIER LDPM_N_ALTER_MON__TQ_LOSS_MON FORMAT "%5.0" /end AXIS_PTS
/begin CHARACTERISTIC ip_cur_alter_mon "Alternator torque losses" MAP 0xffe51fa9 _REC_MAP_20_u1_u1_u2 255. _CNV_A_R_LINEAR_____405_CM 0. 255. DISPLAY_IDENTIFIER IP_CUR_ALTER_MON FORMAT "%4.1"
 /begin AXIS_DESCR COM_AXIS dffgen_fil_mon _CNV_A_R_LINEAR_____9_CM 6 0. 99.609375 FORMAT "%5.2" AXIS_PTS_REF ldp_dffgen_fil_mon__loss_mon /end AXIS_DESCR
 /begin AXIS_DESCR COM_AXIS n_alter_mon _CNV_A_R_LINEAR_____10_CM 6 0. 65535. FORMAT "%5.0" AXIS_PTS_REF ldpm_n_alter_mon__tq_loss_mon /end AXIS_DESCR
/end CHARACTERISTIC
/begin CHARACTERISTIC ip_eff_alter_mon "Alternator torque losses" MAP 0xffe51fcd _REC_MAP_20_u1_u2_u1 0.9960940000000002 _CNV_A_R_LINEAR_____50_CM 0. 0.996094 DISPLAY_IDENTIFIER IP_EFF_ALTER_MON FORMAT "%5.3"
 /begin AXIS_DESCR COM_AXIS n_alter_mon _CNV_A_R_LINEAR_____10_CM 6 0. 65535. FORMAT "%5.0" AXIS_PTS_REF ldpm_n_alter_mon__tq_loss_mon /end AXIS_DESCR
 /begin AXIS_DESCR COM_AXIS cur_alter_mon _CNV_A_R_LINEAR_____405_CM 6 0. 255. FORMAT "%4.1" AXIS_PTS_REF ldp_cur_alter_mon__tq_loss_mon /end AXIS_DESCR
/end CHARACTERISTIC
/begin AXIS_PTS ldp_cur_alter_mon__tq_loss_mon "" 0xffe521ce cur_alter_mon _REC_AXS_20_u1 255. _CNV_A_R_LINEAR_____405_CM 6 0. 255. DISPLAY_IDENTIFIER LDP_CUR_ALTER_MON__TQ_LOSS_MON FORMAT "%4.1" /end AXIS_PTS
/begin MEASUREMENT state_n_max_mon "Error indication" UWORD _CNV_A_R_LINEAR_____0_CM 1 100. 0. 65535. DISPLAY_IDENTIFIER STATE_N_MAX_MON ECU_ADDRESS 0x3fa0a8 BYTE_ORDER MSB_LAST FORMAT "%5.0" /end MEASUREMENT
/begin CHARACTERISTIC c_n_max_mtc_lih_thd_mon "Speed threshold for the detection of a fault in the engine speed limitation" VALUE 0xffe51f6d _REC_VAL_20_u1 8160. _CNV_A_R_LINEAR_____15_CM 0. 8160. DISPLAY_IDENTIFIER C_N_MAX_MTC_LIH_THD_MON FORMAT "%4.0" /end CHARACTERISTIC
/begin MEASUREMENT lv_err_tqi_n_max_mon "Fault currently present in engine speed limitation" UBYTE _CNV_S_2_RANGE______21_CM 1 100. 0. 1. DISPLAY_IDENTIFIER LV_ERR_TQI_N_MAX_MON ECU_ADDRESS 0x3fec0d BIT_MASK 0x1 /end MEASUREMENT
/begin MEASUREMENT abc_tqi_n_max_mon "Anti-bounce-counter for fault in engine speed limitation" UBYTE _CNV_A_R_LINEAR_____0_CM 1 100. 0. 255. DISPLAY_IDENTIFIER ABC_TQI_N_MAX_MON ECU_ADDRESS 0x3fec0e FORMAT "%3.0" /end MEASUREMENT
/begin MEASUREMENT lv_err_tqi_n_max_mon_1 "Torque limitation monitoring error reflect to level 1" UBYTE _CNV_S_2_RANGE______21_CM 1 100. 0. 1. DISPLAY_IDENTIFIER LV_ERR_TQI_N_MAX_MON_1 ECU_ADDRESS 0x3fba08 BIT_MASK 0x1 /end MEASUREMENT
/begin CHARACTERISTIC c_n_32_dif_rel_max_mon "Max. relative difference between N_32 and N_32_SUB_MON" VALUE 0xffe522d4 _REC_VAL_20_u2 255. _CNV_A_R_LINEAR_____427_CM 0. 255. DISPLAY_IDENTIFIER C_N_32_DIF_REL_MAX_MON FORMAT "%8.4" /end CHARACTERISTIC
/begin MEASUREMENT n_32_mon "Engine speed (monitoring level)" UBYTE _CNV_A_R_LINEAR_____15_CM 1 100. 0. 8160. DISPLAY_IDENTIFIER N_32_MON ECU_ADDRESS 0x3fec11 FORMAT "%4.0" /end MEASUREMENT
/begin MEASUREMENT n_32_sub_mon "Engine speed substitute monitoring level" UBYTE _CNV_A_R_LINEAR_____15_CM 1 100. 0. 8160. DISPLAY_IDENTIFIER N_32_SUB_MON ECU_ADDRESS 0x3fec12 FORMAT "%4.0" /end MEASUREMENT
/begin MEASUREMENT abc_n_32_mon "Anti bounce counter N_32_RATIO error" UBYTE _CNV_A_R_LINEAR_____0_CM 1 100. 0. 255. DISPLAY_IDENTIFIER ABC_N_32_MON ECU_ADDRESS 0x3fec15 FORMAT "%3.0" /end MEASUREMENT
/begin MEASUREMENT lv_err_n_32_mon_1 "Engine speed monitoring error reflect to level 1" UBYTE _CNV_S_2_RANGE______21_CM 1 100. 0. 1. DISPLAY_IDENTIFIER LV_ERR_N_32_MON_1 ECU_ADDRESS 0x3fb9ec BIT_MASK 0x1 /end MEASUREMENT
/begin CHARACTERISTIC c_n_32_min_mon "Lower limit for using the relative error concept" VALUE 0xffe51f68 _REC_VAL_20_u1 8160. _CNV_A_R_LINEAR_____15_CM 0. 8160. DISPLAY_IDENTIFIER C_N_32_MIN_MON FORMAT "%4.0" /end CHARACTERISTIC
/begin CHARACTERISTIC c_n_32_lim_mon "Lower limit of denominator for relative error calculation" VALUE 0xffe51f67 _REC_VAL_20_u1 8128. _CNV_A_R_LINEAR_____15_CM 32. 8160. DISPLAY_IDENTIFIER C_N_32_LIM_MON FORMAT "%4.0" /end CHARACTERISTIC
/begin MEASUREMENT n_32_dif_rel_mon "Relative engine speed deviation monitoring level" UWORD _CNV_A_R_LINEAR_____427_CM 1 100. 0. 255. DISPLAY_IDENTIFIER N_32_DIF_REL_MON ECU_ADDRESS 0x3fdf64 BYTE_ORDER MSB_LAST FORMAT "%8.4" /end MEASUREMENT
/begin MEASUREMENT t_seg_sw_mon "Segment time determind by the mean of a software timer" ULONG _CNV_A_R_LINEAR_____428_CM 1 100. 0. 4294967295. DISPLAY_IDENTIFIER T_SEG_SW_MON ECU_ADDRESS 0x3fd028 BYTE_ORDER MSB_LAST FORMAT "%10.0" /end MEASUREMENT
/begin CHARACTERISTIC c_v_pvs_is_thd_1_mon "Thershold for idle speed PVS channel 1" VALUE 0xffe522e0 _REC_VAL_20_u2 4.99511719 _CNV_A_R_LINEAR_____3_CM 0. 4.99511719 DISPLAY_IDENTIFIER C_V_PVS_IS_THD_1_MON FORMAT "%5.3" /end CHARACTERISTIC
/begin CHARACTERISTIC c_v_pvs_is_thd_2_mon "Thershold for idle speed PVS channel 2" VALUE 0xffe522e2 _REC_VAL_20_u2 4.99511719 _CNV_A_R_LINEAR_____3_CM 0. 4.99511719 DISPLAY_IDENTIFIER C_V_PVS_IS_THD_2_MON FORMAT "%5.3" /end CHARACTERISTIC
/begin CHARACTERISTIC c_v_pvs_slop_1_mon "Slope of the PVS channel 1" VALUE 0xffe51f98 _REC_VAL_20_u1 79.6875 _CNV_A_R_LINEAR_____448_CM 0. 79.6875 DISPLAY_IDENTIFIER C_V_PVS_SLOP_1_MON FORMAT "%4.1" /end CHARACTERISTIC
/begin CHARACTERISTIC c_v_pvs_slop_2_mon "Slope of the PVS channel 2" VALUE 0xffe51f99 _REC_VAL_20_u1 159.375 _CNV_A_R_LINEAR_____452_CM 0. 159.375 DISPLAY_IDENTIFIER C_V_PVS_SLOP_2_MON FORMAT "%5.1" /end CHARACTERISTIC
/begin CHARACTERISTIC c_n_min_pvs_diag_mon "Minimum engine speed for PVS diagnosis" VALUE 0xffe51f6f _REC_VAL_20_u1 816. _CNV_A_R_LINEAR_____15_CM 0. 8160. DISPLAY_IDENTIFIER C_N_MIN_PVS_DIAG_MON FORMAT "%4.0" /end CHARACTERISTIC
/begin CHARACTERISTIC ip_pv_ratio_hys_mon "Maximum PVS ratio error allowed" CURVE 0xffe52173 _REC_CUR_20_u1_u1 99.609375 _CNV_A_R_LINEAR_____9_CM 0. 99.609375 DISPLAY_IDENTIFIER IP_PV_RATIO_HYS_MON FORMAT "%4.1"
 /begin AXIS_DESCR COM_AXIS pv_av_mon _CNV_A_R_LINEAR_____9_CM 6 0. 99.609375 FORMAT "%4.1" AXIS_PTS_REF ldp_pv_av_min_mon_ip_pv_mon /end AXIS_DESCR
/end CHARACTERISTIC
/begin CHARACTERISTIC c_pv_lih_max_mon "Max. pedal position in case of an PVS error" VALUE 0xffe51f74 _REC_VAL_20_u1 99.609375 _CNV_A_R_LINEAR_____9_CM 0. 99.609375 DISPLAY_IDENTIFIER C_PV_LIH_MAX_MON FORMAT "%5.2" /end CHARACTERISTIC
/begin AXIS_PTS ldp_pv_av_min_mon_ip_pv_mon "" 0xffe52274 pv_av_mon _REC_AXS_20_u1 99.609375 _CNV_A_R_LINEAR_____9_CM 6 0. 99.609375 DISPLAY_IDENTIFIER LDP_PV_AV_MIN_MON_IP_PV_MON FORMAT "%4.1" /end AXIS_PTS
/begin MEASUREMENT lv_err_pvs_ratio_mon "Logical variable for ratio-error between PVS channel 1 and 2" UBYTE _CNV_S_2_RANGE______1_R_CM 1 100. 0. 255. DISPLAY_IDENTIFIER LV_ERR_PVS_RATIO_MON ECU_ADDRESS 0x3fec19 BIT_MASK 0x1 /end MEASUREMENT
/begin MEASUREMENT lv_err_vcc_pvs_2_mon "Fault in power supply for PVS_2 present" UBYTE _CNV_S_2_RANGE______1_R_CM 1 100. 0. 255. DISPLAY_IDENTIFIER LV_ERR_VCC_PVS_2_MON ECU_ADDRESS 0x3febff BIT_MASK 0x1 /end MEASUREMENT
/begin MEASUREMENT lv_err_vcc_pvs_1_mon "Fault in power supply for PVS_1 present" UBYTE _CNV_S_2_RANGE______1_R_CM 1 100. 0. 255. DISPLAY_IDENTIFIER LV_ERR_VCC_PVS_1_MON ECU_ADDRESS 0x3febfe BIT_MASK 0x1 /end MEASUREMENT
/begin MEASUREMENT lv_err_vcc_pvs_mon "Fault in power supply for PVS present" UBYTE _CNV_S_2_RANGE______1_R_CM 1 100. 0. 255. DISPLAY_IDENTIFIER LV_ERR_VCC_PVS_MON ECU_ADDRESS 0x3fec00 BIT_MASK 0x1 /end MEASUREMENT
/begin MEASUREMENT pv_av_mon "" UBYTE _CNV_A_R_LINEAR_____9_CM 1 100. 0. 99.609375 DISPLAY_IDENTIFIER PV_AV_MON ECU_ADDRESS 0x3fec18 FORMAT "%4.1" /end MEASUREMENT
/begin MEASUREMENT pv_av_1_mon "degree of activation of the accelerator pedal from PVS-channel 1" UBYTE _CNV_A_R_LINEAR_____9_CM 1 100. 0. 99.609375 DISPLAY_IDENTIFIER PV_AV_1_MON ECU_ADDRESS 0x3fec1b FORMAT "%3.1" /end MEASUREMENT
/begin MEASUREMENT pv_av_2_mon "degree of activation of the accelerator pedal from PVS-channel 2" UBYTE _CNV_A_R_LINEAR_____9_CM 1 100. 0. 99.609375 DISPLAY_IDENTIFIER PV_AV_2_MON ECU_ADDRESS 0x3fec1c FORMAT "%3.1" /end MEASUREMENT
/begin MEASUREMENT abc_pvs_ratio_mon "Anti bounce counter PVS ratio error" UBYTE _CNV_A_R_LINEAR_____0_CM 1 100. 0. 255. DISPLAY_IDENTIFIER ABC_PVS_RATIO_MON ECU_ADDRESS 0x3fec1e FORMAT "%3.0" /end MEASUREMENT
/begin MEASUREMENT lv_err_pvs_mon_1 "PVS monitoring error reflect to level 1" UBYTE _CNV_S_2_RANGE______21_CM 1 100. 0. 1. DISPLAY_IDENTIFIER LV_ERR_PVS_MON_1 ECU_ADDRESS 0x3fb9f0 BIT_MASK 0x1 /end MEASUREMENT
/begin CHARACTERISTIC c_t_tco_grd_max_mon "Minimum time before a new change of TCO_MON is allowed" VALUE 0xffe51f86 _REC_VAL_20_u1 10.2 _CNV_A_R_LINEAR_____41_CM 0. 10.2 DISPLAY_IDENTIFIER C_T_TCO_GRD_MAX_MON FORMAT "%5.2" /end CHARACTERISTIC
/begin CHARACTERISTIC c_tco_grd_max_mon "Maximum negative gradient for the coolant temperature" VALUE 0xffe51f88 _REC_VAL_20_u1 190.5 _CNV_A_R_LINEAR_____12_CM 0. 190.5 DISPLAY_IDENTIFIER C_TCO_GRD_MAX_MON FORMAT "%5.1" /end CHARACTERISTIC
/begin CHARACTERISTIC c_tco_sub_thd_max_mon "Threshold for the max. TCO_SUB temperature while TCO is lower than C_TCO_THD_MIN_MON" VALUE 0xffe51f89 _REC_VAL_20_u1 190.5 _CNV_A_R_LINEAR_____11_CM -48. 142.5 DISPLAY_IDENTIFIER C_TCO_SUB_THD_MAX_MON FORMAT "%5.1" /end CHARACTERISTIC
/begin CHARACTERISTIC c_tco_thd_min_mon "Threshold for the min. TCO temperature while TCO_SUB is higher than C_TCO_SUB_THD_MAX_MON" VALUE 0xffe51f8a _REC_VAL_20_u1 190.5 _CNV_A_R_LINEAR_____11_CM -48. 142.5 DISPLAY_IDENTIFIER C_TCO_THD_MIN_MON FORMAT "%5.1" /end CHARACTERISTIC
/begin MEASUREMENT t_tco_grd_mon "Timer for negative TCO gradient limitation" UBYTE _CNV_A_R_LINEAR_____41_CM 1 100. 0. 10.2 DISPLAY_IDENTIFIER T_TCO_GRD_MON ECU_ADDRESS 0x3fec38 FORMAT "%5.2" /end MEASUREMENT
/begin MEASUREMENT tco_mon "Coolant temperature (monitoring level)" UBYTE _CNV_A_R_LINEAR_____11_CM 1 100. -48. 142.5 DISPLAY_IDENTIFIER TCO_MON ECU_ADDRESS 0x3fec37 FORMAT "%5.1" /end MEASUREMENT
/begin CHARACTERISTIC ip_eff_iga_mon "Basic ignition efficiency (process monitoring)" CURVE 0xffe51ff1 _REC_CUR_20_u1_u1 1.9921875 _CNV_A_R_LINEAR_____117_CM 0. 1.9921875 DISPLAY_IDENTIFIER IP_EFF_IGA_MON FORMAT "%5.3"
 /begin AXIS_DESCR COM_AXIS iga_dif_av _CNV_A_R_LINEAR_____204_CM 8 0. -95.625 FORMAT "%6.2" AXIS_PTS_REF ldp_iga_dif_av_mon__eff_iga_mon /end AXIS_DESCR
/end CHARACTERISTIC
/begin CHARACTERISTIC ip_iga_ref_mon "Reference ignition angle (process monitoring)" MAP 0xffe520ac _REC_MAP_20_u1_u1_u1 95.625 _CNV_A_R_LINEAR_____203_CM -35.625 60. DISPLAY_IDENTIFIER IP_IGA_REF_MON FORMAT "%5.1"
 /begin AXIS_DESCR COM_AXIS n_32_mon _CNV_A_R_LINEAR_____15_CM 8 0. 8160. FORMAT "%4.0" AXIS_PTS_REF ldp_n_32_mon__iga_ref_mon /end AXIS_DESCR
 /begin AXIS_DESCR COM_AXIS maf_mon _CNV_A_R_LINEAR_____27_CM 8 0. 1389. FORMAT "%4.0" AXIS_PTS_REF ldp_maf_mon__iga_ref_mon /end AXIS_DESCR
/end CHARACTERISTIC
/begin CHARACTERISTIC ip_tqi_ref_mon "Indicated engine torque at reference conditions (process monitoring)" MAP 0xffe52197 _REC_MAP_20_u1_u1_u1 510. _CNV_A_R_LINEAR_____101_CM 0. 510. DISPLAY_IDENTIFIER IP_TQI_REF_MON FORMAT "%3.0"
 /begin AXIS_DESCR COM_AXIS n_32_mon _CNV_A_R_LINEAR_____15_CM 6 0. 8160. FORMAT "%4.0" AXIS_PTS_REF ldp_n_32_mon__tqi_ref_mon /end AXIS_DESCR
 /begin AXIS_DESCR COM_AXIS maf_mon _CNV_A_R_LINEAR_____27_CM 8 0. 1389. FORMAT "%4.0" AXIS_PTS_REF ldp_maf_mon__tqi_ref_mon /end AXIS_DESCR
/end CHARACTERISTIC
/begin CHARACTERISTIC c_iga_ref_egr_cor_lim_mon "maximum permitted ignition angle correction for EGR active" VALUE 0xffe51f28 _REC_VAL_20_s1 95.625 _CNV_A_R_LINEAR_____82_CM -48. 47.625 DISPLAY_IDENTIFIER C_IGA_REF_EGR_COR_LIM_MON FORMAT "%5.1" /end CHARACTERISTIC
/begin AXIS_PTS ldp_n_32_mon__tqi_ref_mon "" 0xffe5224c n_32_mon _REC_AXS_20_u1 8160. _CNV_A_R_LINEAR_____15_CM 6 0. 8160. DISPLAY_IDENTIFIER LDP_N_32_MON__TQI_REF_MON FORMAT "%4.0" /end AXIS_PTS
/begin AXIS_PTS ldp_maf_mon__tqi_ref_mon "" 0xffe521fe maf_mon _REC_AXS_20_u1 1389. _CNV_A_R_LINEAR_____27_CM 8 0. 1389. DISPLAY_IDENTIFIER LDP_MAF_MON__TQI_REF_MON FORMAT "%4.0" /end AXIS_PTS
/begin AXIS_PTS ldp_n_32_mon__iga_ref_mon "" 0xffe5221f n_32_mon _REC_AXS_20_u1 8160. _CNV_A_R_LINEAR_____15_CM 8 0. 8160. DISPLAY_IDENTIFIER LDP_N_32_MON__IGA_REF_MON FORMAT "%4.0" /end AXIS_PTS
/begin AXIS_PTS ldp_maf_mon__iga_ref_mon "" 0xffe521ef maf_mon _REC_AXS_20_u1 1389. _CNV_A_R_LINEAR_____27_CM 8 0. 1389. DISPLAY_IDENTIFIER LDP_MAF_MON__IGA_REF_MON FORMAT "%4.0" /end AXIS_PTS
/begin AXIS_PTS ldp_iga_dif_av_mon__eff_iga_mon "" 0xffe521e6 iga_dif_av _REC_AXS_20_u1 -95.625 _CNV_A_R_LINEAR_____204_CM 8 0. -95.625 DISPLAY_IDENTIFIER LDP_IGA_DIF_AV_MON__EFF_IGA_MON FORMAT "%6.2" /end AXIS_PTS
/begin MEASUREMENT tqi_av_mon "Actual indicated engine torque (process monitoring)" UBYTE _CNV_A_R_LINEAR_____101_CM 1 100. 0. 510. DISPLAY_IDENTIFIER TQI_AV_MON ECU_ADDRESS 0x3fec3b FORMAT "%3.0" /end MEASUREMENT
/begin MEASUREMENT eff_iga_av_mon "actual ignition efficiency for torque monitoring" UBYTE _CNV_A_R_LINEAR_____117_CM 1 100. 0. 1.9921875 DISPLAY_IDENTIFIER EFF_IGA_AV_MON ECU_ADDRESS 0x3fec3d FORMAT "%5.3" /end MEASUREMENT
/begin MEASUREMENT iga_ref_cor_mon "reference ignition angle for torque monitoring (corrected by EGR influence)" UBYTE _CNV_A_R_LINEAR_____203_CM 1 100. -35.625 60. DISPLAY_IDENTIFIER IGA_REF_COR_MON ECU_ADDRESS 0x3fec41 FORMAT "%5.1" /end MEASUREMENT
/begin MEASUREMENT eff_scc_av_1_mon "actual ignition efficiency for torque monitoring" UBYTE _CNV_A_R_LINEAR_____117_CM 1 100. 0. 1.9921875 DISPLAY_IDENTIFIER EFF_SCC_AV_1_MON ECU_ADDRESS 0x3fec3e FORMAT "%5.3" /end MEASUREMENT
/begin MEASUREMENT eff_scc_av_2_mon "actual ignition efficiency for torque monitoring" UBYTE _CNV_A_R_LINEAR_____117_CM 1 100. 0. 1.9921875 DISPLAY_IDENTIFIER EFF_SCC_AV_2_MON ECU_ADDRESS 0x3fec3f FORMAT "%5.3" /end MEASUREMENT
/begin MEASUREMENT eff_scc_av_mon "actual ignition efficiency for torque monitoring" UBYTE _CNV_A_R_LINEAR_____117_CM 1 100. 0. 1.9921875 DISPLAY_IDENTIFIER EFF_SCC_AV_MON ECU_ADDRESS 0x3fec40 FORMAT "%5.3" /end MEASUREMENT
/begin CHARACTERISTIC ip_tqi_dif_max_mon "Threshold for diagnosis of engine torque overflow" MAP 0xffe52187 _REC_MAP_20_u1_u1_u1 510. _CNV_A_R_LINEAR_____101_CM 0. 510. DISPLAY_IDENTIFIER IP_TQI_DIF_MAX_MON FORMAT "%3.0"
 /begin AXIS_DESCR COM_AXIS n_32_mon _CNV_A_R_LINEAR_____15_CM 4 0. 8160. FORMAT "%4.0" AXIS_PTS_REF ldp_n_32_mon__tqi_dif_max_mon /end AXIS_DESCR
 /begin AXIS_DESCR COM_AXIS tqi_sp_mon _CNV_A_R_LINEAR_____101_CM 4 0. 510. FORMAT "%3.0" AXIS_PTS_REF ldp_tqi_sp_mon__tqi_dif_max_mon /end AXIS_DESCR
/end CHARACTERISTIC
/begin AXIS_PTS ldp_tqi_sp_mon__tqi_dif_max_mon "" 0xffe522be tqi_sp_mon _REC_AXS_20_u1 510. _CNV_A_R_LINEAR_____101_CM 4 0. 510. DISPLAY_IDENTIFIER LDP_TQI_SP_MON__TQI_DIF_MAX_MON FORMAT "%3.0" /end AXIS_PTS
/begin AXIS_PTS ldp_n_32_mon__tqi_dif_max_mon "" 0xffe52247 n_32_mon _REC_AXS_20_u1 8160. _CNV_A_R_LINEAR_____15_CM 4 0. 8160. DISPLAY_IDENTIFIER LDP_N_32_MON__TQI_DIF_MAX_MON FORMAT "%4.0" /end AXIS_PTS
/begin MEASUREMENT tqi_dif_max_mon "Permitted deviation between actual and desired indicated engine torque" UBYTE _CNV_A_R_LINEAR_____101_CM 1 100. 0. 510. DISPLAY_IDENTIFIER TQI_DIF_MAX_MON ECU_ADDRESS 0x3fec46 FORMAT "%3.0" /end MEASUREMENT
/begin MEASUREMENT tqi_dif_mon "Deviation between actual and desired indicated engine torque" UBYTE _CNV_A_R_LINEAR_____101_CM 1 100. 0. 510. DISPLAY_IDENTIFIER TQI_DIF_MON ECU_ADDRESS 0x3fec45 FORMAT "%3.0" /end MEASUREMENT
/begin MEASUREMENT abc_tqi_av_mon "Anti-bounce-counter for fault in torque generation" UBYTE _CNV_A_R_LINEAR_____0_CM 1 100. 0. 255. DISPLAY_IDENTIFIER ABC_TQI_AV_MON ECU_ADDRESS 0x3fec43 FORMAT "%3.0" /end MEASUREMENT
/begin MEASUREMENT lv_err_tqi_av_mon_1 "Actual indicated engine torque monitoring error reflect to level 1" UBYTE _CNV_S_2_RANGE______21_CM 1 100. 0. 1. DISPLAY_IDENTIFIER LV_ERR_TQI_AV_MON_1 ECU_ADDRESS 0x3fba04 BIT_MASK 0x1 /end MEASUREMENT
/begin MEASUREMENT tqi_dif_max_ofs_mon "Permitted deviation offset" UBYTE _CNV_A_R_LINEAR_____95_CM 1 100. 0. 255. DISPLAY_IDENTIFIER TQI_DIF_MAX_OFS_MON ECU_ADDRESS 0x3fec47 FORMAT "%3.0" /end MEASUREMENT
/begin CHARACTERISTIC c_dec_tqi_dif_max_mon "Decrement after start condition" VALUE 0xffe51f63 _REC_VAL_20_u1 254. _CNV_A_R_LINEAR_____95_CM 1. 255. DISPLAY_IDENTIFIER C_DEC_TQI_DIF_MAX_MON FORMAT "%3.0" /end CHARACTERISTIC
/begin CHARACTERISTIC c_tqi_dif_max_ofs_mon "Offset after start condition" VALUE 0xffe51f93 _REC_VAL_20_u1 255. _CNV_A_R_LINEAR_____95_CM 0. 255. DISPLAY_IDENTIFIER C_TQI_DIF_MAX_OFS_MON FORMAT "%3.0" /end CHARACTERISTIC
/begin CHARACTERISTIC ip_tq_dif_p_d_is_max_mon "maximum PD-part depending on speed deviation to idle speed setpoint" CURVE 0xffe52179 _REC_CUR_20_u1_u1 510. _CNV_A_R_LINEAR_____101_CM 0. 510. DISPLAY_IDENTIFIER IP_TQ_DIF_P_D_IS_MAX_MON FORMAT "%3.0"
 /begin AXIS_DESCR COM_AXIS n_dif_cor_mon _CNV_A_R_LINEAR_____216_CM 4 -4096. 4064. FORMAT "%5.0" AXIS_PTS_REF ldp_n_dif_cor_mon_ip_tq_mon /end AXIS_DESCR
/end CHARACTERISTIC
/begin CHARACTERISTIC ip_fac_tq_dif_p_d_is_mon "maximum scaling factor due to separation of PD-part" CURVE 0xffe52027 _REC_CUR_20_u1_u1 1.9921875 _CNV_A_R_LINEAR_____117_CM 0. 1.9921875 DISPLAY_IDENTIFIER IP_FAC_TQ_DIF_P_D_IS_MON FORMAT "%5.3"
 /begin AXIS_DESCR COM_AXIS tco_mon _CNV_A_R_LINEAR_____11_CM 5 -48. 142.5 FORMAT "%4.0" AXIS_PTS_REF ldp_tco_mon_ip_fac_tq_p_d_mon /end AXIS_DESCR
/end CHARACTERISTIC
/begin CHARACTERISTIC c_n_dif_min_mon "minimum idle speed setpoint deviation for active I-part" VALUE 0xffe51f6c _REC_VAL_20_u1 8160. _CNV_A_R_LINEAR_____216_CM -4096. 4064. DISPLAY_IDENTIFIER C_N_DIF_MIN_MON FORMAT "%5.0" /end CHARACTERISTIC
/begin CHARACTERISTIC c_tq_dif_i_is_max_mon "maximum I-part" VALUE 0xffe51f8d _REC_VAL_20_u1 255. _CNV_A_R_LINEAR_____95_CM 0. 255. DISPLAY_IDENTIFIER C_TQ_DIF_I_IS_MAX_MON FORMAT "%3.0" /end CHARACTERISTIC
/begin CHARACTERISTIC c_tq_pas_i_is_mon "target value for monitoring ramp operation due to ISC deactivation" VALUE 0xffe51f8f _REC_VAL_20_u1 255. _CNV_A_R_LINEAR_____95_CM 0. 255. DISPLAY_IDENTIFIER C_TQ_PAS_I_IS_MON FORMAT "%3.0" /end CHARACTERISTIC
/begin CHARACTERISTIC c_fac_ramp_pos_i_is_mon "Slope for monitoring positive ISC deactivation-ramp operation" VALUE 0xffe522ca _REC_VAL_20_u2 0.9999850000000001 _CNV_A_R_LINEAR_____524_CM 0. 0.999985 DISPLAY_IDENTIFIER C_FAC_RAMP_POS_I_IS_MON FORMAT "%6.4" /end CHARACTERISTIC
/begin CHARACTERISTIC c_fac_ramp_neg_i_is_mon "Slope for monitoring negative ISC deactivation-ramp operation" VALUE 0xffe522c6 _REC_VAL_20_u2 0.9999850000000001 _CNV_A_R_LINEAR_____524_CM 0. 0.999985 DISPLAY_IDENTIFIER C_FAC_RAMP_NEG_I_IS_MON FORMAT "%6.4" /end CHARACTERISTIC
/begin CHARACTERISTIC c_tq_dif_p_d_is_add_mon "Additive constant for PD-part model value" VALUE 0xffe51f8e _REC_VAL_20_u1 255. _CNV_A_R_LINEAR_____95_CM 0. 255. DISPLAY_IDENTIFIER C_TQ_DIF_P_D_IS_ADD_MON FORMAT "%3.0" /end CHARACTERISTIC
/begin CHARACTERISTIC c_tq_dif_i_is_add_mon "additive constant for I-part model value" VALUE 0xffe51f8c _REC_VAL_20_u1 255. _CNV_A_R_LINEAR_____95_CM 0. 255. DISPLAY_IDENTIFIER C_TQ_DIF_I_IS_ADD_MON FORMAT "%3.0" /end CHARACTERISTIC
/begin CHARACTERISTIC c_fac_ramp_neg_p_d_is_mon "Factor for monitoring negative ISC-deactivation-ramp operation of the PD-part" VALUE 0xffe522c8 _REC_VAL_20_u2 3.1875e-002 _CNV_A_R_LINEAR_____525_CM 0. 3.1875e-002 DISPLAY_IDENTIFIER C_FAC_RAMP_NEG_P_D_IS_MON FORMAT "%7.5" /end CHARACTERISTIC
/begin CHARACTERISTIC ip_n_sp_is_mon_max_mon "maximum idle speed setpoint depending on coolant temperature" CURVE 0xffe5212e _REC_CUR_20_u1_u1 8160. _CNV_A_R_LINEAR_____15_CM 0. 8160. DISPLAY_IDENTIFIER IP_N_SP_IS_MON_MAX_MON FORMAT "%4.0"
 /begin AXIS_DESCR COM_AXIS tco_mon _CNV_A_R_LINEAR_____11_CM 5 -48. 142.5 FORMAT "%5.1" AXIS_PTS_REF ldp_tco_mon_ip_n_sp_is_mon /end AXIS_DESCR
/end CHARACTERISTIC
/begin AXIS_PTS ldp_n_dif_cor_mon_ip_tq_mon "maximum PD-part depending on speed deviation to idle speed setpoint" 0xffe5225a n_dif_cor_mon _REC_AXS_20_u1 8160. _CNV_A_R_LINEAR_____216_CM 4 -4096. 4064. DISPLAY_IDENTIFIER LDP_N_DIF_COR_MON_IP_TQ_MON FORMAT "%5.0" /end AXIS_PTS
/begin AXIS_PTS ldp_tco_mon_ip_fac_tq_p_d_mon "" 0xffe52288 tco_mon _REC_AXS_20_u1 190.5 _CNV_A_R_LINEAR_____11_CM 5 -48. 142.5 DISPLAY_IDENTIFIER LDP_TCO_MON_IP_FAC_TQ_P_D_MON FORMAT "%4.0" /end AXIS_PTS
/begin AXIS_PTS ldp_tco_mon_ip_n_sp_is_mon "" 0xffe5228e tco_mon _REC_AXS_20_u1 190.5 _CNV_A_R_LINEAR_____11_CM 5 -48. 142.5 DISPLAY_IDENTIFIER LDP_TCO_MON_IP_N_SP_IS_MON FORMAT "%5.1" /end AXIS_PTS
/begin MEASUREMENT lv_err_tq_dif_p_d_is_mon "Fault currently present in torque generation, symptom 'idle speed controller - PD-part'" UBYTE _CNV_S_2_RANGE______21_CM 1 100. 0. 1. DISPLAY_IDENTIFIER LV_ERR_TQ_DIF_P_D_IS_MON ECU_ADDRESS 0x3fec4b BIT_MASK 0x1 /end MEASUREMENT
/begin MEASUREMENT lv_err_tq_dif_i_is_mon "Fault currently present in torque generation, symptom 'idle speed controller - I-part'" UBYTE _CNV_S_2_RANGE______21_CM 1 100. 0. 1. DISPLAY_IDENTIFIER LV_ERR_TQ_DIF_I_IS_MON ECU_ADDRESS 0x3fec4c BIT_MASK 0x1 /end MEASUREMENT
/begin MEASUREMENT n_dif_sp_is_mon "monitored deviation from actual engine speed to idle speed setpoint" UBYTE _CNV_A_R_LINEAR_____216_CM 1 100. -4096. 4064. DISPLAY_IDENTIFIER N_DIF_SP_IS_MON ECU_ADDRESS 0x3fec49 FORMAT "%5.0" /end MEASUREMENT
/begin MEASUREMENT tq_dif_i_is_mon "monitored I-part of the idle speed controller" SWORD _CNV_A_R_LINEAR_____55_CM 1 100. -1024. 1023.96875 DISPLAY_IDENTIFIER TQ_DIF_I_IS_MON ECU_ADDRESS 0x3fdf68 BYTE_ORDER MSB_LAST FORMAT "%8.2" /end MEASUREMENT
/begin MEASUREMENT tq_dif_i_is_ramp_mon "modelled I-part dring ramp function" SWORD _CNV_A_R_LINEAR_____526_CM 1 100. -256. 255.9921875 DISPLAY_IDENTIFIER TQ_DIF_I_IS_RAMP_MON ECU_ADDRESS 0x3fdf7c BYTE_ORDER MSB_LAST FORMAT "%7.1" /end MEASUREMENT
/begin MEASUREMENT tq_dif_p_d_is_dif_mon "difference between monitored and modelled PD-part" SBYTE _CNV_A_R_LINEAR_____101_CM 1 100. -256. 254. DISPLAY_IDENTIFIER TQ_DIF_P_D_IS_DIF_MON ECU_ADDRESS 0x3fec56 FORMAT "%3.0" /end MEASUREMENT
/begin MEASUREMENT tq_dif_i_is_dif_mon "difference between monitored and modelled I-part" SBYTE _CNV_A_R_LINEAR_____101_CM 1 100. -256. 254. DISPLAY_IDENTIFIER TQ_DIF_I_IS_DIF_MON ECU_ADDRESS 0x3fec57 FORMAT "%3.0" /end MEASUREMENT
/begin MEASUREMENT abc_tq_dif_p_d_is_mon "Anti bounce counter for monitoring of idle speed controller - PD-part" UBYTE _CNV_A_R_LINEAR_____0_CM 1 100. 0. 255. DISPLAY_IDENTIFIER ABC_TQ_DIF_P_D_IS_MON ECU_ADDRESS 0x3fec52 FORMAT "%3.0" /end MEASUREMENT
/begin MEASUREMENT abc_tq_dif_i_is_mon "Anti bounce counter for monitoring of idle speed controller" UBYTE _CNV_A_R_LINEAR_____0_CM 1 100. 0. 255. DISPLAY_IDENTIFIER ABC_TQ_DIF_I_IS_MON ECU_ADDRESS 0x3fec54 FORMAT "%3.0" /end MEASUREMENT
/begin MEASUREMENT tq_dif_p_d_is_mon "monitored PD-part of the idle speed controller" SWORD _CNV_A_R_LINEAR_____55_CM 1 100. -1024. 1023.96875 DISPLAY_IDENTIFIER TQ_DIF_P_D_IS_MON ECU_ADDRESS 0x3fdf66 BYTE_ORDER MSB_LAST FORMAT "%8.2" /end MEASUREMENT
/begin MEASUREMENT tq_dif_p_d_is_ramp_mon "modelled PD-part during ramp function" SWORD _CNV_A_R_LINEAR_____55_CM 1 100. -1024. 1023.96875 DISPLAY_IDENTIFIER TQ_DIF_P_D_IS_RAMP_MON ECU_ADDRESS 0x3fdf76 BYTE_ORDER MSB_LAST FORMAT "%8.2" /end MEASUREMENT
/begin MEASUREMENT tq_add_p_d_is_mon "decrement for modelled PD-part during ramp function" SWORD _CNV_A_R_LINEAR_____526_CM 1 100. -256. 255.9921875 DISPLAY_IDENTIFIER TQ_ADD_P_D_IS_MON ECU_ADDRESS 0x3fdf6a BYTE_ORDER MSB_LAST FORMAT "%7.1" /end MEASUREMENT
/begin MEASUREMENT tq_add_i_is_mon "Decrement for modelled I-part during ramp function" SWORD _CNV_A_R_LINEAR_____526_CM 1 100. -256. 255.9921875 DISPLAY_IDENTIFIER TQ_ADD_I_IS_MON ECU_ADDRESS 0x3fdf6e BYTE_ORDER MSB_LAST FORMAT "%7.1" /end MEASUREMENT
/begin MEASUREMENT state_err_tq_dif_p_d_is_mon "State variable for fault detection in torque generation, symptom 'idle speed controller - PD-part'" UBYTE _CNV_S_3_STATE_ERR__527_CM 1 100. 0. 2. DISPLAY_IDENTIFIER STATE_ERR_TQ_DIF_P_D_IS_MON ECU_ADDRESS 0x3fec4d /end MEASUREMENT
/begin MEASUREMENT state_err_tq_dif_i_is_mon "State variable for fault detection in torque generation, symptom 'idle speed controller -   I-part'" UBYTE _CNV_S_3_STATE_ERR__527_CM 1 100. 0. 2. DISPLAY_IDENTIFIER STATE_ERR_TQ_DIF_I_IS_MON ECU_ADDRESS 0x3fec4e /end MEASUREMENT
/begin MEASUREMENT lv_err_tq_dif_isc_mon_1 "ISC monitoring error reflect to level 1" UBYTE _CNV_S_2_RANGE______21_CM 1 100. 0. 1. DISPLAY_IDENTIFIER LV_ERR_TQ_DIF_ISC_MON_1 ECU_ADDRESS 0x3fb9f8 BIT_MASK 0x1 /end MEASUREMENT
/begin MEASUREMENT n_dif_mmv_mon "N_DIF moving mean value" UBYTE _CNV_A_R_LINEAR_____216_CM 1 100. -4096. 4064. DISPLAY_IDENTIFIER N_DIF_MMV_MON ECU_ADDRESS 0x3fec51 FORMAT "%5.0" /end MEASUREMENT
/begin MEASUREMENT n_dif_cor_mon "Idel speed control variable" UBYTE _CNV_A_R_LINEAR_____216_CM 1 100. -4096. 4064. DISPLAY_IDENTIFIER N_DIF_COR_MON ECU_ADDRESS 0x3fec4a FORMAT "%5.0" /end MEASUREMENT
/begin CHARACTERISTIC c_n_dif_fac_mon "Multiplicative factor for n_dif_cor calculation" VALUE 0xffe51f6b _REC_VAL_20_u1 0.9960940000000002 _CNV_A_R_LINEAR_____50_CM 0. 0.996094 DISPLAY_IDENTIFIER C_N_DIF_FAC_MON FORMAT "%5.3" /end CHARACTERISTIC
/begin CHARACTERISTIC c_n_dif_crlc_high_mon "Correlation factor for n_dif_mmv calculation" VALUE 0xffe51f69 _REC_VAL_20_u1 0.9960940000000002 _CNV_A_R_LINEAR_____50_CM 0. 0.996094 DISPLAY_IDENTIFIER C_N_DIF_CRLC_HIGH_MON FORMAT "%5.3" /end CHARACTERISTIC
/begin CHARACTERISTIC c_n_dif_crlc_low_mon "Correlation factor for n_dif_mmv calculation" VALUE 0xffe51f6a _REC_VAL_20_u1 0.9960940000000002 _CNV_A_R_LINEAR_____50_CM 0. 0.996094 DISPLAY_IDENTIFIER C_N_DIF_CRLC_LOW_MON FORMAT "%5.3" /end CHARACTERISTIC
/begin MEASUREMENT tq_dif_p_d_is_ramp_mon_1 "modelled PD-part during ramp function and in idle" SWORD _CNV_A_R_LINEAR_____55_CM 1 100. -1024. 1023.96875 DISPLAY_IDENTIFIER TQ_DIF_P_D_IS_RAMP_MON_1 ECU_ADDRESS 0x3fdf7a BYTE_ORDER MSB_LAST FORMAT "%8.2" /end MEASUREMENT
/begin MEASUREMENT lv_err_tq_loss_mon "Fault currently present in torque generation, symptom 'torque losses'" UBYTE _CNV_S_2_RANGE______21_CM 1 100. 0. 1. DISPLAY_IDENTIFIER LV_ERR_TQ_LOSS_MON ECU_ADDRESS 0x3fec5f BIT_MASK 0x1 /end MEASUREMENT
/begin MEASUREMENT tq_loss_dif_mon "difference of monitored and modelled torque losses" SBYTE _CNV_A_R_LINEAR_____101_CM 1 100. -256. 254. DISPLAY_IDENTIFIER TQ_LOSS_DIF_MON ECU_ADDRESS 0x3fec5e FORMAT "%3.0" /end MEASUREMENT
/begin MEASUREMENT abc_tq_loss_mon "Anti bounce counter for monitoring of torque losses" UBYTE _CNV_A_R_LINEAR_____0_CM 1 100. 0. 255. DISPLAY_IDENTIFIER ABC_TQ_LOSS_MON ECU_ADDRESS 0x3fec60 FORMAT "%3.0" /end MEASUREMENT
/begin MEASUREMENT tq_loss_mon "Torque losses" SWORD _CNV_A_R_LINEAR_____55_CM 1 100. -1024. 1023.96875 DISPLAY_IDENTIFIER TQ_LOSS_MON ECU_ADDRESS 0x3fdf80 BYTE_ORDER MSB_LAST FORMAT "%8.2" /end MEASUREMENT
/begin MEASUREMENT tqfr_add_mon "Torque losses" SWORD _CNV_A_R_LINEAR_____55_CM 1 100. -1024. 1023.96875 DISPLAY_IDENTIFIER TQFR_ADD_MON ECU_ADDRESS 0x3fdf84 BYTE_ORDER MSB_LAST FORMAT "%8.2" /end MEASUREMENT
/begin AXIS_PTS ldp_maf_mon__tq_loss_mon "" 0xffe521f8 maf_mon _REC_AXS_20_u1 1389. _CNV_A_R_LINEAR_____27_CM 5 0. 1389. DISPLAY_IDENTIFIER LDP_MAF_MON__TQ_LOSS_MON FORMAT "%4.0" /end AXIS_PTS
/begin CHARACTERISTIC ip_tq_loss_min_mon "modelled speed and maf dependent torque losses" MAP 0xffe52318 _REC_MAP_20_u2_u1_u1 1024. _CNV_A_R_LINEAR_____187_CM -1024. 0. DISPLAY_IDENTIFIER IP_TQ_LOSS_MIN_MON FORMAT "%6.2"
 /begin AXIS_DESCR COM_AXIS n_32_mon _CNV_A_R_LINEAR_____15_CM 5 0. 8160. FORMAT "%4.0" AXIS_PTS_REF ldp_n_32_mon__tq_loss_mon /end AXIS_DESCR
 /begin AXIS_DESCR COM_AXIS maf_mon _CNV_A_R_LINEAR_____27_CM 5 0. 1389. FORMAT "%4.0" AXIS_PTS_REF ldp_maf_mon__tq_loss_mon /end AXIS_DESCR
/end CHARACTERISTIC
/begin AXIS_PTS ldp_n_32_mon__tq_loss_mon "" 0xffe5223a n_32_mon _REC_AXS_20_u1 8160. _CNV_A_R_LINEAR_____15_CM 5 0. 8160. DISPLAY_IDENTIFIER LDP_N_32_MON__TQ_LOSS_MON FORMAT "%4.0" /end AXIS_PTS
/begin CHARACTERISTIC ip_tqfr_add_mon "modelled speed and TCO dependent torque losses" CURVE 0xffe52360 _REC_CUR_20_u2_u1 1024. _CNV_A_R_LINEAR_____187_CM -1024. 0. DISPLAY_IDENTIFIER IP_TQFR_ADD_MON FORMAT "%6.2"
 /begin AXIS_DESCR COM_AXIS tco_mon _CNV_A_R_LINEAR_____11_CM 5 -48. 142.5 FORMAT "%5.1" AXIS_PTS_REF ldp_tco_mon__tq_loss_mon /end AXIS_DESCR
/end CHARACTERISTIC
/begin CHARACTERISTIC ip_tqfr_add_km_mon "modelled mileage dependent torque losses" CURVE 0xffe52356 _REC_CUR_20_u2_u2 1024. _CNV_A_R_LINEAR_____187_CM -1024. 0. DISPLAY_IDENTIFIER IP_TQFR_ADD_KM_MON FORMAT "%6.2"
 /begin AXIS_DESCR COM_AXIS ctr_km_can _CNV_A_R_LINEAR_____88_CM 5 0. 655350. FORMAT "%7.0" AXIS_PTS_REF ldp_ctr_km_can__tq_loss_mon /end AXIS_DESCR
/end CHARACTERISTIC
/begin AXIS_PTS ldp_tco_mon__tq_loss_mon "" 0xffe5227b tco_mon _REC_AXS_20_u1 190.5 _CNV_A_R_LINEAR_____11_CM 5 -48. 142.5 DISPLAY_IDENTIFIER LDP_TCO_MON__TQ_LOSS_MON FORMAT "%5.1" /end AXIS_PTS
/begin AXIS_PTS ldp_ctr_km_can__tq_loss_mon "" 0xffe523e8 ctr_km_can _REC_AXS_20_u2 655350. _CNV_A_R_LINEAR_____88_CM 5 0. 655350. DISPLAY_IDENTIFIER LDP_CTR_KM_CAN__TQ_LOSS_MON FORMAT "%7.0" /end AXIS_PTS
/begin CHARACTERISTIC c_tq_dif_is_ad_min_mon "minimum additional torque loss for isc adaptation active" VALUE 0xffe51f2a _REC_VAL_20_s2 40.96 _CNV_A_R_LINEAR_____55_CM -1024. 0. DISPLAY_IDENTIFIER C_TQ_DIF_IS_AD_MIN_MON FORMAT "%6.2" /end CHARACTERISTIC
/begin CHARACTERISTIC ip_tq_max_clu_max_mon "maximum value for maximum torque at clutch" CURVE 0xffe5217d _REC_CUR_20_u1_u1 510. _CNV_A_R_LINEAR_____101_CM 0. 510. DISPLAY_IDENTIFIER IP_TQ_MAX_CLU_MAX_MON FORMAT "%3.0"
 /begin AXIS_DESCR COM_AXIS n_32_mon _CNV_A_R_LINEAR_____15_CM 6 0. 8160. FORMAT "%4.0" AXIS_PTS_REF ldp_n_32_mon__tq_max_clu_max_mon /end AXIS_DESCR
/end CHARACTERISTIC
/begin AXIS_PTS ldp_n_32_mon__tq_max_clu_max_mon "" 0xffe52240 n_32_mon _REC_AXS_20_u1 8160. _CNV_A_R_LINEAR_____15_CM 6 0. 8160. DISPLAY_IDENTIFIER LDP_N_32_MON__TQ_MAX_CLU_MAX_MON FORMAT "%4.0" /end AXIS_PTS
/begin MEASUREMENT lv_err_tq_max_clu_mon "Fault currently present in torque generation, symptom 'maximum torque at clutch'" UBYTE _CNV_S_2_RANGE______21_CM 1 100. 0. 1. DISPLAY_IDENTIFIER LV_ERR_TQ_MAX_CLU_MON ECU_ADDRESS 0x3fec64 BIT_MASK 0x1 /end MEASUREMENT
/begin MEASUREMENT tq_max_clu_mon "monitored maximum torque at clutch" SWORD _CNV_A_R_LINEAR_____55_CM 1 100. -1024. 1023.96875 DISPLAY_IDENTIFIER TQ_MAX_CLU_MON ECU_ADDRESS 0x3fdf86 BYTE_ORDER MSB_LAST FORMAT "%8.2" /end MEASUREMENT
/begin MEASUREMENT tq_max_clu_dif_mon "difference of monitored and modelled maximum torque at clutch" SBYTE _CNV_A_R_LINEAR_____101_CM 1 100. -256. 254. DISPLAY_IDENTIFIER TQ_MAX_CLU_DIF_MON ECU_ADDRESS 0x3fec65 FORMAT "%3.0" /end MEASUREMENT
/begin MEASUREMENT abc_tq_max_clu_mon "Anti bounce counter for monitoring of maximum torque at clutch" UBYTE _CNV_A_R_LINEAR_____0_CM 1 100. 0. 255. DISPLAY_IDENTIFIER ABC_TQ_MAX_CLU_MON ECU_ADDRESS 0x3fec66 FORMAT "%3.0" /end MEASUREMENT
/begin MEASUREMENT lv_err_tq_req_mon_1 "Min torque at clutch monitoring error reflect to level 1" UBYTE _CNV_S_2_RANGE______21_CM 1 100. 0. 1. DISPLAY_IDENTIFIER LV_ERR_TQ_REQ_MON_1 ECU_ADDRESS 0x3fb9fc BIT_MASK 0x1 /end MEASUREMENT
/begin CHARACTERISTIC c_n_st_max_mon "maximum start end speed" VALUE 0xffe51f70 _REC_VAL_20_u1 8160. _CNV_A_R_LINEAR_____15_CM 0. 8160. DISPLAY_IDENTIFIER C_N_ST_MAX_MON FORMAT "%4.0" /end CHARACTERISTIC
/begin MEASUREMENT lv_err_tq_min_clu_mon "Fault currently present in torque generation, symptom 'minimum torque at clutch'" UBYTE _CNV_S_2_RANGE______21_CM 1 100. 0. 1. DISPLAY_IDENTIFIER LV_ERR_TQ_MIN_CLU_MON ECU_ADDRESS 0x3fec69 BIT_MASK 0x1 /end MEASUREMENT
/begin MEASUREMENT tq_min_clu_mon "monitored minimum torque at clutch" SWORD _CNV_A_R_LINEAR_____55_CM 1 100. -1024. 1023.96875 DISPLAY_IDENTIFIER TQ_MIN_CLU_MON ECU_ADDRESS 0x3fdf8a BYTE_ORDER MSB_LAST FORMAT "%8.2" /end MEASUREMENT
/begin MEASUREMENT abc_tq_min_clu_mon "Anti bounce counter for monitoring of minimum torque at clutch" UBYTE _CNV_A_R_LINEAR_____0_CM 1 100. 0. 255. DISPLAY_IDENTIFIER ABC_TQ_MIN_CLU_MON ECU_ADDRESS 0x3fec6b FORMAT "%3.0" /end MEASUREMENT
/begin MEASUREMENT tq_min_clu_dif_mon "difference of monitored and modelled minimum torque at clutch" SWORD _CNV_A_R_LINEAR_____55_CM 1 100. -1024. 1023.96875 DISPLAY_IDENTIFIER TQ_MIN_CLU_DIF_MON ECU_ADDRESS 0x3fdf8c BYTE_ORDER MSB_LAST FORMAT "%8.2" /end MEASUREMENT
/begin MEASUREMENT tq_min_clu_mdl_1_mon "Temporary variable for calculation of modelled minimum torque at clutch" SWORD _CNV_A_R_LINEAR_____55_CM 1 100. -1024. 1023.96875 DISPLAY_IDENTIFIER TQ_MIN_CLU_MDL_1_MON ECU_ADDRESS 0x3fdf90 BYTE_ORDER MSB_LAST FORMAT "%8.2" /end MEASUREMENT
/begin MEASUREMENT tq_min_clu_mdl_2_mon "Temporary variable for calculation of modelled minimum torque at clutch" SWORD _CNV_A_R_LINEAR_____55_CM 1 100. -1024. 1023.96875 DISPLAY_IDENTIFIER TQ_MIN_CLU_MDL_2_MON ECU_ADDRESS 0x3fdf92 BYTE_ORDER MSB_LAST FORMAT "%8.2" /end MEASUREMENT
/begin MEASUREMENT tq_min_clu_mdl_mon "modelled value of mimimum torque at clutch" SWORD _CNV_A_R_LINEAR_____55_CM 1 100. -1024. 1023.96875 DISPLAY_IDENTIFIER TQ_MIN_CLU_MDL_MON ECU_ADDRESS 0x3fdf94 BYTE_ORDER MSB_LAST FORMAT "%8.2" /end MEASUREMENT
/begin MEASUREMENT tq_conv_max_mon "modelled vaue of maximum converter torque" UBYTE _CNV_A_R_LINEAR_____101_CM 1 100. 0. 510. DISPLAY_IDENTIFIER TQ_CONV_MAX_MON ECU_ADDRESS 0x3fec6a FORMAT "%3.0" /end MEASUREMENT
/begin MEASUREMENT tq_st_mon "modelled value of start torque" UWORD _CNV_A_R_LINEAR_____55_CM 1 100. 0. 1023.96875 DISPLAY_IDENTIFIER TQ_ST_MON ECU_ADDRESS 0x3fdf98 BYTE_ORDER MSB_LAST FORMAT "%7.2" /end MEASUREMENT
/begin AXIS_PTS ldp_n_dif_mon_ip_tq_min_mon "" 0xffe5225f n_dif_sp_is_mon _REC_AXS_20_u1 8160. _CNV_A_R_LINEAR_____216_CM 4 -4096. 4064. DISPLAY_IDENTIFIER LDP_N_DIF_MON_IP_TQ_MIN_MON FORMAT "%5.0" /end AXIS_PTS
/begin AXIS_PTS ldp_n_32_mon_ip_tqi_min_pu_mon "" 0xffe52253 n_32_mon _REC_AXS_20_u1 8160. _CNV_A_R_LINEAR_____15_CM 6 0. 8160. DISPLAY_IDENTIFIER LDP_N_32_MON_IP_TQI_MIN_PU_MON FORMAT "%4.0" /end AXIS_PTS
/begin AXIS_PTS ldp_tco_mon_ip_fac_conv_mon "" 0xffe52281 tco_mon _REC_AXS_20_u1 190.5 _CNV_A_R_LINEAR_____11_CM 6 -48. 142.5 DISPLAY_IDENTIFIER LDP_TCO_MON_IP_FAC_CONV_MON FORMAT "%5.1" /end AXIS_PTS
/begin AXIS_PTS ldp_tco_mon_ip_tqi_min_pu_mon "" 0xffe52294 tco_mon _REC_AXS_20_u1 190.5 _CNV_A_R_LINEAR_____11_CM 4 -48. 142.5 DISPLAY_IDENTIFIER LDP_TCO_MON_IP_TQI_MIN_PU_MON FORMAT "%5.1" /end AXIS_PTS
/begin CHARACTERISTIC ip_tq_min_clu_max_mon "maximum value for minimum torque at clutch" CURVE 0xffe52183 _REC_CUR_20_u1_u1 510. _CNV_A_R_LINEAR_____101_CM 0. 510. DISPLAY_IDENTIFIER IP_TQ_MIN_CLU_MAX_MON FORMAT "%3.0"
 /begin AXIS_DESCR COM_AXIS n_dif_sp_is_mon _CNV_A_R_LINEAR_____216_CM 4 -4096. 4064. FORMAT "%5.0" AXIS_PTS_REF ldp_n_dif_mon_ip_tq_min_mon /end AXIS_DESCR
/end CHARACTERISTIC
/begin CHARACTERISTIC ip_fac_conv_mon "Converter torque characteristics" CURVE 0xffe52300 _REC_CUR_20_u2_u1 4.88e-004 _CNV_A_R_LINEAR_____512_CM 0. 4.88e-004 DISPLAY_IDENTIFIER IP_FAC_CONV_MON FORMAT "%10.9"
 /begin AXIS_DESCR COM_AXIS tco_mon _CNV_A_R_LINEAR_____11_CM 6 -48. 142.5 FORMAT "%5.1" AXIS_PTS_REF ldp_tco_mon_ip_fac_conv_mon /end AXIS_DESCR
/end CHARACTERISTIC
/begin CHARACTERISTIC ip_tqi_min_req_pu_mon "Minimum requested indicated torque in PU phase" MAP 0xffe523aa _REC_MAP_20_u2_u1_u1 1023.96875 _CNV_A_R_LINEAR_____55_CM 0. 1023.96875 DISPLAY_IDENTIFIER IP_TQI_MIN_REQ_PU_MON FORMAT "%7.2"
 /begin AXIS_DESCR COM_AXIS n_32_mon _CNV_A_R_LINEAR_____15_CM 6 0. 8160. FORMAT "%4.0" AXIS_PTS_REF ldp_n_32_mon_ip_tqi_min_pu_mon /end AXIS_DESCR
 /begin AXIS_DESCR COM_AXIS tco_mon _CNV_A_R_LINEAR_____11_CM 4 -48. 142.5 FORMAT "%5.1" AXIS_PTS_REF ldp_tco_mon_ip_tqi_min_pu_mon /end AXIS_DESCR
/end CHARACTERISTIC
/begin CHARACTERISTIC c_t_tqi_mon "Dead time for torque decrease" VALUE 0xffe51f87 _REC_VAL_20_u1 10.2 _CNV_A_R_LINEAR_____41_CM 0. 10.2 DISPLAY_IDENTIFIER C_T_TQI_MON FORMAT "%5.2" /end CHARACTERISTIC
/begin CHARACTERISTIC c_tqi_sp_dec_max_mon "Maximum negative gradient of desired indicated engine torque" VALUE 0xffe51f94 _REC_VAL_20_u1 31.875 _CNV_A_R_LINEAR_____531_CM 0. 31.875 DISPLAY_IDENTIFIER C_TQI_SP_DEC_MAX_MON FORMAT "%5.2" /end CHARACTERISTIC
/begin CHARACTERISTIC ip_fac_tq_req_driv_mon "Scaling factor for requested torque at clutch from driver" MAP 0xffe5202c _REC_MAP_20_u1_u1_u1 1.9921875 _CNV_A_R_LINEAR_____117_CM 0. 1.9921875 DISPLAY_IDENTIFIER IP_FAC_TQ_REQ_DRIV_MON FORMAT "%5.3"
 /begin AXIS_DESCR COM_AXIS n_32_mon _CNV_A_R_LINEAR_____15_CM 8 0. 8160. FORMAT "%4.0" AXIS_PTS_REF ldp_n_32__fac_tq_req_driv_mon /end AXIS_DESCR
 /begin AXIS_DESCR COM_AXIS pv_av_mon _CNV_A_R_LINEAR_____9_CM 8 0. 99.609375 FORMAT "%5.2" AXIS_PTS_REF ldp_pv_av__fac_tq_req_driv_mon /end AXIS_DESCR
/end CHARACTERISTIC
/begin AXIS_PTS ldp_n_32__fac_tq_req_driv_mon "" 0xffe5220a n_32_mon _REC_AXS_20_u1 8160. _CNV_A_R_LINEAR_____15_CM 8 0. 8160. DISPLAY_IDENTIFIER LDP_N_32__FAC_TQ_REQ_DRIV_MON FORMAT "%4.0" /end AXIS_PTS
/begin AXIS_PTS ldp_pv_av__fac_tq_req_driv_mon "" 0xffe5226b pv_av_mon _REC_AXS_20_u1 99.609375 _CNV_A_R_LINEAR_____9_CM 8 0. 99.609375 DISPLAY_IDENTIFIER LDP_PV_AV__FAC_TQ_REQ_DRIV_MON FORMAT "%5.2" /end AXIS_PTS
/begin MEASUREMENT fac_tq_req_driv_mon "Scaling factor for requested torque at clutch from driver" UBYTE _CNV_A_R_LINEAR_____39_CM 1 100. 0. 1.99220002 DISPLAY_IDENTIFIER FAC_TQ_REQ_DRIV_MON ECU_ADDRESS 0x3fec6f FORMAT "%5.3" /end MEASUREMENT
/begin CHARACTERISTIC ip_fac_tq_req_driv_rng_l_mon "Scaling factor for requested torque at clutch from driver in low range mode" MAP 0xffe5206c _REC_MAP_20_u1_u1_u1 1.9921875 _CNV_A_R_LINEAR_____117_CM 0. 1.9921875 DISPLAY_IDENTIFIER IP_FAC_TQ_REQ_DRIV_RNG_L_MON FORMAT "%5.3"
 /begin AXIS_DESCR COM_AXIS n_32_mon _CNV_A_R_LINEAR_____15_CM 8 0. 8160. FORMAT "%4.0" AXIS_PTS_REF ldp_n_32__fac_tq_req_driv_mon /end AXIS_DESCR
 /begin AXIS_DESCR COM_AXIS pv_av_mon _CNV_A_R_LINEAR_____9_CM 8 0. 99.609375 FORMAT "%5.2" AXIS_PTS_REF ldp_pv_av__fac_tq_req_driv_mon /end AXIS_DESCR
/end CHARACTERISTIC
/begin MEASUREMENT tqi_req_tot_mon "Desired non-delayed indicated engine torque" UBYTE _CNV_A_R_LINEAR_____101_CM 1 100. 0. 510. DISPLAY_IDENTIFIER TQI_REQ_TOT_MON ECU_ADDRESS 0x3fec73 FORMAT "%3.0" /end MEASUREMENT
/begin MEASUREMENT tqi_sp_mon "Desired indicated engine torque" UBYTE _CNV_A_R_LINEAR_____101_CM 1 100. 0. 510. DISPLAY_IDENTIFIER TQI_SP_MON ECU_ADDRESS 0x3fec6e FORMAT "%7.3" /end MEASUREMENT
/begin MEASUREMENT fac_tq_req_mon "Scaling factor for requested torque at clutch from driver" UBYTE _CNV_A_R_LINEAR_____39_CM 1 100. 0. 1.99220002 DISPLAY_IDENTIFIER FAC_TQ_REQ_MON ECU_ADDRESS 0x3fec72 FORMAT "%5.3" /end MEASUREMENT
/begin MEASUREMENT n_mis "Engine speed for misfire detection - delayed for intake phase analysis of actual diagnosed cylinder" UWORD _CNV_A_R_LINEAR_____10_CM 1 100. 0. 8160. DISPLAY_IDENTIFIER N_MIS ECU_ADDRESS 0x3fd4f6 BYTE_ORDER MSB_LAST FORMAT "%4.0" /end MEASUREMENT
/begin MEASUREMENT load_mis_1 "Normalised engine load for misfire detection - 1 misfire segment before" UWORD _CNV_A_R_LINEAR_____571_CM 1 100. 0. 99.99694824 DISPLAY_IDENTIFIER LOAD_MIS_1 ECU_ADDRESS 0x3fd4fc BYTE_ORDER MSB_LAST /end MEASUREMENT
/begin MEASUREMENT load_mis_2 "Normalised engine load for misfire detection - 2 misfire segment before" UWORD _CNV_A_R_LINEAR_____571_CM 1 100. 0. 99.99694824 DISPLAY_IDENTIFIER LOAD_MIS_2 ECU_ADDRESS 0x3fd4f0 BYTE_ORDER MSB_LAST /end MEASUREMENT
/begin MEASUREMENT load_mis_3 "Normalised engine load for misfire detection - 3 misfire segment before" UWORD _CNV_A_R_LINEAR_____571_CM 1 100. 0. 99.99694824 DISPLAY_IDENTIFIER LOAD_MIS_3 ECU_ADDRESS 0x3fd4fe BYTE_ORDER MSB_LAST /end MEASUREMENT
/begin MEASUREMENT load_grd_mis "Normalised engine load gradient for misfire detection " UWORD _CNV_A_R_LINEAR_____571_CM 1 100. 0. 99.99694824 DISPLAY_IDENTIFIER LOAD_GRD_MIS ECU_ADDRESS 0x3fd4f2 BYTE_ORDER MSB_LAST /end MEASUREMENT
/begin MEASUREMENT load_min_mis "Normalised engine \"zero\" load for misfire detection" UWORD _CNV_A_R_LINEAR_____571_CM 1 100. 0. 99.99694824 DISPLAY_IDENTIFIER LOAD_MIN_MIS ECU_ADDRESS 0x3fd4f4 BYTE_ORDER MSB_LAST /end MEASUREMENT
/begin MEASUREMENT load_mis "Normalised engine load for misfire detection - sampled at current misfire segment" UWORD _CNV_A_R_LINEAR_____571_CM 1 100. 0. 99.99694824 DISPLAY_IDENTIFIER LOAD_MIS ECU_ADDRESS 0x3fd4ee BYTE_ORDER MSB_LAST /end MEASUREMENT
/begin CHARACTERISTIC ip_load_min_afs_mt_mis "Zero load curve vs engine speed in AFS combustion mode, MT vehicle" CURVE 0xffe43820 _REC_CUR_20_u2_u2 99.99694824000001 _CNV_A_R_LINEAR_____571_CM 0. 99.99694824 DISPLAY_IDENTIFIER IP_LOAD_MIN_AFS_MT_MIS
 /begin AXIS_DESCR COM_AXIS n _CNV_A_R_LINEAR_____10_CM 12 0. 8160. FORMAT "%4.0" AXIS_PTS_REF ldp_n__load_min_afs_mt_mis /end AXIS_DESCR
/end CHARACTERISTIC
/begin CHARACTERISTIC ip_load_min_afs_at_mis "Zero load curve vs engine speed in AFS combustion mode, AT vehicle" CURVE 0xffe43808 _REC_CUR_20_u2_u2 99.99694824000001 _CNV_A_R_LINEAR_____571_CM 0. 99.99694824 DISPLAY_IDENTIFIER IP_LOAD_MIN_AFS_AT_MIS
 /begin AXIS_DESCR COM_AXIS n _CNV_A_R_LINEAR_____10_CM 12 0. 8160. FORMAT "%4.0" AXIS_PTS_REF ldp_n__load_min_afs_at_mis /end AXIS_DESCR
/end CHARACTERISTIC
/begin CHARACTERISTIC ip_load_min_afl_mt_mis "Zero load curve vs engine speed in AFL combustion mode, MT vehicle" CURVE 0xffe437f0 _REC_CUR_20_u2_u2 99.99694824000001 _CNV_A_R_LINEAR_____571_CM 0. 99.99694824 DISPLAY_IDENTIFIER IP_LOAD_MIN_AFL_MT_MIS
 /begin AXIS_DESCR COM_AXIS n _CNV_A_R_LINEAR_____10_CM 12 0. 8160. FORMAT "%4.0" AXIS_PTS_REF ldp_n__load_min_afl_mt_mis /end AXIS_DESCR
/end CHARACTERISTIC
/begin CHARACTERISTIC ip_load_min_afl_at_mis "Zero load curve vs engine speed in AFL combustion mode, AT vehicle" CURVE 0xffe437d8 _REC_CUR_20_u2_u2 99.99694824000001 _CNV_A_R_LINEAR_____571_CM 0. 99.99694824 DISPLAY_IDENTIFIER IP_LOAD_MIN_AFL_AT_MIS
 /begin AXIS_DESCR COM_AXIS n _CNV_A_R_LINEAR_____10_CM 12 0. 8160. FORMAT "%4.0" AXIS_PTS_REF ldp_n__load_min_afl_at_mis /end AXIS_DESCR
/end CHARACTERISTIC
/begin CHARACTERISTIC ip_load_min_s_mt_mis "Zero load curve vs engine speed in S combustion mode, MT vehicle" CURVE 0xffe43850 _REC_CUR_20_u2_u2 99.99694824000001 _CNV_A_R_LINEAR_____571_CM 0. 99.99694824 DISPLAY_IDENTIFIER IP_LOAD_MIN_S_MT_MIS
 /begin AXIS_DESCR COM_AXIS n _CNV_A_R_LINEAR_____10_CM 12 0. 8160. FORMAT "%4.0" AXIS_PTS_REF ldp_n__load_min_s_mt_mis /end AXIS_DESCR
/end CHARACTERISTIC
/begin CHARACTERISTIC ip_load_min_s_at_mis "Zero load curve vs engine speed in S combustion mode, AT vehicle" CURVE 0xffe43838 _REC_CUR_20_u2_u2 99.99694824000001 _CNV_A_R_LINEAR_____571_CM 0. 99.99694824 DISPLAY_IDENTIFIER IP_LOAD_MIN_S_AT_MIS
 /begin AXIS_DESCR COM_AXIS n _CNV_A_R_LINEAR_____10_CM 12 0. 8160. FORMAT "%4.0" AXIS_PTS_REF ldp_n__load_min_s_at_mis /end AXIS_DESCR
/end CHARACTERISTIC
/begin CHARACTERISTIC ip_amp_ofs_load_afs_mis "Extra load from zero load curve vs AMP in AFS combustion mode" CURVE 0xffe4375c _REC_CUR_20_u2_u2 99.94 _CNV_A_R_LINEAR_____601_CM -50. 49.94 DISPLAY_IDENTIFIER IP_AMP_OFS_LOAD_AFS_MIS FORMAT "%7.3"
 /begin AXIS_DESCR COM_AXIS amp _CNV_A_R_LINEAR_____49_CM 9 0. 5434. FORMAT "%7.2" AXIS_PTS_REF ldpm_amp__amp_ofs_load_mis /end AXIS_DESCR
/end CHARACTERISTIC
/begin CHARACTERISTIC ip_amp_ofs_load_s_mis "Extra load from zero load curve vs AMP in S combustion mode" CURVE 0xffe4376e _REC_CUR_20_u2_u2 99.94 _CNV_A_R_LINEAR_____601_CM -50. 49.94 DISPLAY_IDENTIFIER IP_AMP_OFS_LOAD_S_MIS FORMAT "%7.3"
 /begin AXIS_DESCR COM_AXIS amp _CNV_A_R_LINEAR_____49_CM 9 0. 5434. FORMAT "%7.2" AXIS_PTS_REF ldpm_amp__amp_ofs_load_mis /end AXIS_DESCR
/end CHARACTERISTIC
/begin CHARACTERISTIC ip_amp_ofs_load_afl_mis "Extra load from zero load curve vs AMP in AFL combustion mode" CURVE 0xffe4374a _REC_CUR_20_u2_u2 99.94 _CNV_A_R_LINEAR_____601_CM -50. 49.94 DISPLAY_IDENTIFIER IP_AMP_OFS_LOAD_AFL_MIS FORMAT "%7.3"
 /begin AXIS_DESCR COM_AXIS amp _CNV_A_R_LINEAR_____49_CM 9 0. 5434. FORMAT "%7.2" AXIS_PTS_REF ldpm_amp__amp_ofs_load_mis /end AXIS_DESCR
/end CHARACTERISTIC
/begin CHARACTERISTIC ip_tco_ofs_load_afl_mis "Extra load from zero load curve vs coolant temperature  in AFL combustion mode" CURVE 0xffe43880 _REC_CUR_20_u2_u1 99.94 _CNV_A_R_LINEAR_____601_CM -50. 49.94 DISPLAY_IDENTIFIER IP_TCO_OFS_LOAD_AFL_MIS FORMAT "%7.3"
 /begin AXIS_DESCR COM_AXIS tco _CNV_A_R_LINEAR_____11_CM 9 -48. 142.5 FORMAT "%5.1" AXIS_PTS_REF ldpm_tco__tco_ofs_load_mis /end AXIS_DESCR
/end CHARACTERISTIC
/begin CHARACTERISTIC ip_tco_ofs_load_s_mis "Extra load from zero load curve vs coolant temperature in S combustion mode" CURVE 0xffe438a4 _REC_CUR_20_u2_u1 99.94 _CNV_A_R_LINEAR_____601_CM -50. 49.94 DISPLAY_IDENTIFIER IP_TCO_OFS_LOAD_S_MIS FORMAT "%7.3"
 /begin AXIS_DESCR COM_AXIS tco _CNV_A_R_LINEAR_____11_CM 9 -48. 142.5 FORMAT "%5.1" AXIS_PTS_REF ldpm_tco__tco_ofs_load_mis /end AXIS_DESCR
/end CHARACTERISTIC
/begin CHARACTERISTIC ip_tco_ofs_load_afs_mis "Extra load from zero load curve vs coolant temperature  in AFS combustion mode" CURVE 0xffe43892 _REC_CUR_20_u2_u1 99.94 _CNV_A_R_LINEAR_____601_CM -50. 49.94 DISPLAY_IDENTIFIER IP_TCO_OFS_LOAD_AFS_MIS FORMAT "%7.3"
 /begin AXIS_DESCR COM_AXIS tco _CNV_A_R_LINEAR_____11_CM 9 -48. 142.5 FORMAT "%5.1" AXIS_PTS_REF ldpm_tco__tco_ofs_load_mis /end AXIS_DESCR
/end CHARACTERISTIC
/begin AXIS_PTS ldp_n_32__fac_thd_iv_s_er "" 0xffe40332 n_32 _REC_AXS_20_u1 8160. _CNV_A_R_LINEAR_____15_CM 6 0. 8160. DISPLAY_IDENTIFIER LDP_N_32__FAC_THD_IV_S_ER FORMAT "%4.0" /end AXIS_PTS
/begin AXIS_PTS ldp_n_32__fac_thd_iv_er "" 0xffe4032b n_32 _REC_AXS_20_u1 8160. _CNV_A_R_LINEAR_____15_CM 6 0. 8160. DISPLAY_IDENTIFIER LDP_N_32__FAC_THD_IV_ER FORMAT "%4.0" /end AXIS_PTS
/begin AXIS_PTS ldp_load_mis__thd_afl_er_is "" 0xffe43d4a load_mis _REC_AXS_20_u2 99.99694824000001 _CNV_A_R_LINEAR_____571_CM 6 0. 99.99694824 DISPLAY_IDENTIFIER LDP_LOAD_MIS__THD_AFL_ER_IS /end AXIS_PTS
/begin AXIS_PTS ldp_load_mis__thd_afs_er_is "" 0xffe43d58 load_mis _REC_AXS_20_u2 99.99694824000001 _CNV_A_R_LINEAR_____571_CM 6 0. 99.99694824 DISPLAY_IDENTIFIER LDP_LOAD_MIS__THD_AFS_ER_IS /end AXIS_PTS
/begin AXIS_PTS ldp_load_mis__thd_s_er_is "" 0xffe43dba load_mis _REC_AXS_20_u2 99.99694824000001 _CNV_A_R_LINEAR_____571_CM 6 0. 99.99694824 DISPLAY_IDENTIFIER LDP_LOAD_MIS__THD_S_ER_IS /end AXIS_PTS
/begin AXIS_PTS ldp_n__thd_afs_er_is "" 0xffe43ec4 n _REC_AXS_20_u2 8159. _CNV_A_R_LINEAR_____10_CM 4 1. 8160. DISPLAY_IDENTIFIER LDP_N__THD_AFS_ER_IS FORMAT "%4.0" /end AXIS_PTS
/begin AXIS_PTS ldp_n__thd_afl_er_is "" 0xffe43eba n _REC_AXS_20_u2 8159. _CNV_A_R_LINEAR_____10_CM 4 1. 8160. DISPLAY_IDENTIFIER LDP_N__THD_AFL_ER_IS FORMAT "%4.0" /end AXIS_PTS
/begin AXIS_PTS ldp_n__thd_s_er_is "" 0xffe43ece n _REC_AXS_20_u2 8159. _CNV_A_R_LINEAR_____10_CM 4 1. 8160. DISPLAY_IDENTIFIER LDP_N__THD_S_ER_IS FORMAT "%4.0" /end AXIS_PTS
/begin AXIS_PTS ldp_tco__fac_thd_er "" 0xffe43737 tco _REC_AXS_20_u1 190.5 _CNV_A_R_LINEAR_____11_CM 8 -48. 142.5 DISPLAY_IDENTIFIER LDP_TCO__FAC_THD_ER FORMAT "%5.1" /end AXIS_PTS
/begin AXIS_PTS ldp_iga_ch_bas__fac_thd_er_ch "" 0xffe40303 iga_ch_bas _REC_AXS_20_u1 95.625 _CNV_A_R_LINEAR_____203_CM 4 -35.625 60. DISPLAY_IDENTIFIER LDP_IGA_CH_BAS__FAC_THD_ER_CH FORMAT "%5.1" /end AXIS_PTS
/begin CHARACTERISTIC ip_thd_at_afl_er "ER threshold for misfire detection in air fuel lean combustion mode, AT vehicle" MAP 0xffe43916 _REC_MAP_20_u2_u2_u1 65535. _CNV_A_R_LINEAR_____572_CM -32768. 32767. DISPLAY_IDENTIFIER IP_THD_AT_AFL_ER FORMAT "%6.0"
 /begin AXIS_DESCR COM_AXIS load_mis _CNV_A_R_LINEAR_____571_CM 6 0. 99.99694824 AXIS_PTS_REF ldp_load_mis__thd_at_afl_er /end AXIS_DESCR
 /begin AXIS_DESCR COM_AXIS n_32 _CNV_A_R_LINEAR_____15_CM 12 0. 8160. FORMAT "%4.0" AXIS_PTS_REF ldp_n_32__thd_at_afl_er /end AXIS_DESCR
/end CHARACTERISTIC
/begin CHARACTERISTIC ip_thd_afl_er_is "ER threshold for misfire detection in air fuel lean combustion mode in idle speed" MAP 0xffe438b6 _REC_MAP_20_u2_u2_u2 65535. _CNV_A_R_LINEAR_____572_CM -32768. 32767. DISPLAY_IDENTIFIER IP_THD_AFL_ER_IS FORMAT "%6.0"
 /begin AXIS_DESCR COM_AXIS load_mis _CNV_A_R_LINEAR_____571_CM 6 0. 99.99694824 AXIS_PTS_REF ldp_load_mis__thd_afl_er_is /end AXIS_DESCR
 /begin AXIS_DESCR COM_AXIS n _CNV_A_R_LINEAR_____10_CM 4 1. 8160. FORMAT "%4.0" AXIS_PTS_REF ldp_n__thd_afl_er_is /end AXIS_DESCR
/end CHARACTERISTIC
/begin CHARACTERISTIC ip_thd_mt_afs_er "ER threshold for misfire detection in air stoichiometric combustion mode, MT vehicle" MAP 0xffe43b56 _REC_MAP_20_u2_u2_u1 65535. _CNV_A_R_LINEAR_____572_CM -32768. 32767. DISPLAY_IDENTIFIER IP_THD_MT_AFS_ER FORMAT "%6.0"
 /begin AXIS_DESCR COM_AXIS load_mis _CNV_A_R_LINEAR_____571_CM 6 0. 99.99694824 AXIS_PTS_REF ldp_load_mis__thd_mt_afs_er /end AXIS_DESCR
 /begin AXIS_DESCR COM_AXIS n_32 _CNV_A_R_LINEAR_____15_CM 12 0. 8160. FORMAT "%4.0" AXIS_PTS_REF ldp_n_32__thd_mt_afs_er /end AXIS_DESCR
/end CHARACTERISTIC
/begin CHARACTERISTIC ip_thd_mt_afl_er "ER threshold for misfire detection in air fuel lean combustion mode, MT vehicle" MAP 0xffe43ac6 _REC_MAP_20_u2_u2_u1 65535. _CNV_A_R_LINEAR_____572_CM -32768. 32767. DISPLAY_IDENTIFIER IP_THD_MT_AFL_ER FORMAT "%6.0"
 /begin AXIS_DESCR COM_AXIS load_mis _CNV_A_R_LINEAR_____571_CM 6 0. 99.99694824 AXIS_PTS_REF ldp_load_mis__thd_mt_afl_er /end AXIS_DESCR
 /begin AXIS_DESCR COM_AXIS n_32 _CNV_A_R_LINEAR_____15_CM 12 0. 8160. FORMAT "%4.0" AXIS_PTS_REF ldp_n_32__thd_mt_afl_er /end AXIS_DESCR
/end CHARACTERISTIC
/begin CHARACTERISTIC ip_thd_afs_er_is "ER threshold for misfire detection in air fuel lean combustion mode in idle speed" MAP 0xffe438e6 _REC_MAP_20_u2_u2_u2 65535. _CNV_A_R_LINEAR_____572_CM -32768. 32767. DISPLAY_IDENTIFIER IP_THD_AFS_ER_IS FORMAT "%6.0"
 /begin AXIS_DESCR COM_AXIS load_mis _CNV_A_R_LINEAR_____571_CM 6 0. 99.99694824 AXIS_PTS_REF ldp_load_mis__thd_afs_er_is /end AXIS_DESCR
 /begin AXIS_DESCR COM_AXIS n _CNV_A_R_LINEAR_____10_CM 4 1. 8160. FORMAT "%4.0" AXIS_PTS_REF ldp_n__thd_afs_er_is /end AXIS_DESCR
/end CHARACTERISTIC
/begin CHARACTERISTIC ip_thd_at_afs_er "ER threshold for misfire detection in air stochiometric combustion mode, AT vehicle" MAP 0xffe439a6 _REC_MAP_20_u2_u2_u1 65535. _CNV_A_R_LINEAR_____572_CM -32768. 32767. DISPLAY_IDENTIFIER IP_THD_AT_AFS_ER FORMAT "%6.0"
 /begin AXIS_DESCR COM_AXIS load_mis _CNV_A_R_LINEAR_____571_CM 6 0. 99.99694824 AXIS_PTS_REF ldp_load_mis__thd_at_afs_er /end AXIS_DESCR
 /begin AXIS_DESCR COM_AXIS n_32 _CNV_A_R_LINEAR_____15_CM 12 0. 8160. FORMAT "%4.0" AXIS_PTS_REF ldp_n_32__thd_at_afs_er /end AXIS_DESCR
/end CHARACTERISTIC
/begin CHARACTERISTIC ip_thd_at_s_er "ER threshold for misfire detection in stratified combustion mode, AT vehicle" MAP 0xffe43a36 _REC_MAP_20_u2_u2_u1 65535. _CNV_A_R_LINEAR_____572_CM -32768. 32767. DISPLAY_IDENTIFIER IP_THD_AT_S_ER FORMAT "%6.0"
 /begin AXIS_DESCR COM_AXIS load_mis _CNV_A_R_LINEAR_____571_CM 6 0. 99.99694824 AXIS_PTS_REF ldp_load_mis__thd_at_s_er /end AXIS_DESCR
 /begin AXIS_DESCR COM_AXIS n_32 _CNV_A_R_LINEAR_____15_CM 12 0. 8160. FORMAT "%4.0" AXIS_PTS_REF ldp_n_32__thd_at_s_er /end AXIS_DESCR
/end CHARACTERISTIC
/begin CHARACTERISTIC ip_thd_mt_s_er "ER threshold for misfire detection in stratified combustion mode, MT vehicle" MAP 0xffe43be6 _REC_MAP_20_u2_u2_u1 65535. _CNV_A_R_LINEAR_____572_CM -32768. 32767. DISPLAY_IDENTIFIER IP_THD_MT_S_ER FORMAT "%6.0"
 /begin AXIS_DESCR COM_AXIS load_mis _CNV_A_R_LINEAR_____571_CM 6 0. 99.99694824 AXIS_PTS_REF ldp_load_mis__thd_mt_s_er /end AXIS_DESCR
 /begin AXIS_DESCR COM_AXIS n_32 _CNV_A_R_LINEAR_____15_CM 12 0. 8160. FORMAT "%4.0" AXIS_PTS_REF ldp_n_32__thd_mt_s_er /end AXIS_DESCR
/end CHARACTERISTIC
/begin CHARACTERISTIC ip_thd_s_er_is "ER threshold for misfire detection in stratified combustion mode in idle speed" MAP 0xffe43c76 _REC_MAP_20_u2_u2_u2 65535. _CNV_A_R_LINEAR_____572_CM -32768. 32767. DISPLAY_IDENTIFIER IP_THD_S_ER_IS FORMAT "%6.0"
 /begin AXIS_DESCR COM_AXIS load_mis _CNV_A_R_LINEAR_____571_CM 6 0. 99.99694824 AXIS_PTS_REF ldp_load_mis__thd_s_er_is /end AXIS_DESCR
 /begin AXIS_DESCR COM_AXIS n _CNV_A_R_LINEAR_____10_CM 4 1. 8160. FORMAT "%4.0" AXIS_PTS_REF ldp_n__thd_s_er_is /end AXIS_DESCR
/end CHARACTERISTIC
/begin CHARACTERISTIC ip_fac_thd_iv_er "Factor for adaptation of the threshold in case of active cylinder cut-off" CURVE 0xffe43790 _REC_CUR_20_u2_u1 1. _CNV_A_R_LINEAR_____191_CM 0. 1. DISPLAY_IDENTIFIER IP_FAC_THD_IV_ER FORMAT "%7.5"
 /begin AXIS_DESCR COM_AXIS n_32 _CNV_A_R_LINEAR_____15_CM 6 0. 8160. FORMAT "%4.0" AXIS_PTS_REF ldp_n_32__fac_thd_iv_er /end AXIS_DESCR
/end CHARACTERISTIC
/begin CHARACTERISTIC ip_fac_thd_er "Temperature dependent threshold reduction" CURVE 0xffe43780 _REC_CUR_20_u2_u1 1.9929 _CNV_A_R_LINEAR_____602_CM 0. 1.9929 DISPLAY_IDENTIFIER IP_FAC_THD_ER FORMAT "%6.4"
 /begin AXIS_DESCR COM_AXIS tco _CNV_A_R_LINEAR_____11_CM 8 -48. 142.5 FORMAT "%5.1" AXIS_PTS_REF ldp_tco__fac_thd_er /end AXIS_DESCR
/end CHARACTERISTIC
/begin CHARACTERISTIC ip_fac_thd_er_ch "Threshold correction depending on IGA for catalyst heating" CURVE 0xffe402ed _REC_CUR_20_u1_u1 1.9921875 _CNV_A_R_LINEAR_____117_CM 0. 1.9921875 DISPLAY_IDENTIFIER IP_FAC_THD_ER_CH FORMAT "%5.3"
 /begin AXIS_DESCR COM_AXIS iga_ch_bas _CNV_A_R_LINEAR_____203_CM 4 -35.625 60. FORMAT "%5.1" AXIS_PTS_REF ldp_iga_ch_bas__fac_thd_er_ch /end AXIS_DESCR
/end CHARACTERISTIC
/begin MEASUREMENT mis_det_cdn_app_inh_nr "Misfiring APP INC detection fade out requests number  (after masking)" UBYTE _CNV_A_R_LINEAR_____0_CM 1 100. 0. 255. DISPLAY_IDENTIFIER MIS_DET_CDN_APP_INH_NR ECU_ADDRESS 0x3fe577 FORMAT "%3.0" /end MEASUREMENT
/begin MEASUREMENT mis_det_cdn_app_inh "Misfiring APP INC detection fade out requests carrier word (before masking)" UWORD _CNV_A_R_LINEAR_____0_CM 1 100. 0. 65535. DISPLAY_IDENTIFIER MIS_DET_CDN_APP_INH ECU_ADDRESS 0x3fd500 BYTE_ORDER MSB_LAST FORMAT "%5.0" /end MEASUREMENT
/begin MEASUREMENT mis_det_cdn_app_inh.lv_inh_map_dif_det_mis "Misfire detection fade out request flag due to MAP_DIF condition" UWORD _CNV_A_R_LINEAR_____0_CM 1 100. 0. 65535. DISPLAY_IDENTIFIER LV_INH_MAP_DIF_DET_MIS ECU_ADDRESS 0x3fd500 BYTE_ORDER MSB_LAST FORMAT "%5.0" BIT_MASK 0x1 /end MEASUREMENT
/begin MEASUREMENT mis_det_cdn_app_inh.lv_inh_tps_grd_det_mis "Misfire detection fade out request flag due to TPS gradient condition" UWORD _CNV_A_R_LINEAR_____0_CM 1 100. 0. 65535. DISPLAY_IDENTIFIER LV_INH_TPS_GRD_DET_MIS ECU_ADDRESS 0x3fd500 BYTE_ORDER MSB_LAST FORMAT "%5.0" BIT_MASK 0x2 /end MEASUREMENT
/begin MEASUREMENT mis_det_cdn_app_inh.lv_inh_load_grd_det_mis "Misfire detection fade out request flag due to LOAD_GRD_MIS condition" UWORD _CNV_A_R_LINEAR_____0_CM 1 100. 0. 65535. DISPLAY_IDENTIFIER LV_INH_LOAD_GRD_DET_MIS ECU_ADDRESS 0x3fd500 BYTE_ORDER MSB_LAST FORMAT "%5.0" BIT_MASK 0x4 /end MEASUREMENT
/begin MEASUREMENT mis_det_cdn_app_inh.lv_inh_iga_dif_det_mis "Misfire detection fade out request flag due to IGA_DIF condition" UWORD _CNV_A_R_LINEAR_____0_CM 1 100. 0. 65535. DISPLAY_IDENTIFIER LV_INH_IGA_DIF_DET_MIS ECU_ADDRESS 0x3fd500 BYTE_ORDER MSB_LAST FORMAT "%5.0" BIT_MASK 0x8 /end MEASUREMENT
/begin MEASUREMENT mis_det_cdn_app_inh.lv_inh_cmb_tra_mis "Misfire detection fade out request flag due to combustion mode transients" UWORD _CNV_A_R_LINEAR_____0_CM 1 100. 0. 65535. DISPLAY_IDENTIFIER LV_INH_CMB_TRA_MIS ECU_ADDRESS 0x3fd500 BYTE_ORDER MSB_LAST FORMAT "%5.0" BIT_MASK 0x10 /end MEASUREMENT
/begin MEASUREMENT mis_det_cdn_app_inh.lv_inh_acc_det_mis "Misfire detection fade out request flag due to Air conditionner transient condition" UWORD _CNV_A_R_LINEAR_____0_CM 1 100. 0. 65535. DISPLAY_IDENTIFIER LV_INH_ACC_DET_MIS ECU_ADDRESS 0x3fd500 BYTE_ORDER MSB_LAST FORMAT "%5.0" BIT_MASK 0x20 /end MEASUREMENT
/begin MEASUREMENT mis_det_cdn_app_inh.lv_inh_cdn_obd_mis "Misfire detection fade out request flag due to OBD1 faults" UWORD _CNV_A_R_LINEAR_____0_CM 1 100. 0. 65535. DISPLAY_IDENTIFIER LV_INH_CDN_OBD_MIS ECU_ADDRESS 0x3fd500 BYTE_ORDER MSB_LAST FORMAT "%5.0" BIT_MASK 0x100 /end MEASUREMENT
/begin MEASUREMENT mis_det_cdn_app_inh.lv_inh_indx_mis "Misfire detection fade out request flag due to misfire detection index trouble" UWORD _CNV_A_R_LINEAR_____0_CM 1 100. 0. 65535. DISPLAY_IDENTIFIER LV_INH_INDX_MIS ECU_ADDRESS 0x3fd500 BYTE_ORDER MSB_LAST FORMAT "%5.0" BIT_MASK 0x200 /end MEASUREMENT
/begin MEASUREMENT mis_det_cdn_app_inh.lv_inh_amt_gs_det_mis "Misfire detection fade out request flag due to AMT - gearbox mode transients" UWORD _CNV_A_R_LINEAR_____0_CM 1 100. 0. 65535. DISPLAY_IDENTIFIER LV_INH_AMT_GS_DET_MIS ECU_ADDRESS 0x3fd500 BYTE_ORDER MSB_LAST FORMAT "%5.0" BIT_MASK 0x400 /end MEASUREMENT
/begin MEASUREMENT iga_mis_1 "Ignition angle 1 misfire segment before" SBYTE _CNV_A_R_LINEAR_____82_CM 1 100. -48. 47.625 DISPLAY_IDENTIFIER IGA_MIS_1 ECU_ADDRESS 0x3fe57b FORMAT "%5.1" /end MEASUREMENT
/begin MEASUREMENT iga_mis_2 "Ignition angle 2 misfire segment before" SBYTE _CNV_A_R_LINEAR_____82_CM 1 100. -48. 47.625 DISPLAY_IDENTIFIER IGA_MIS_2 ECU_ADDRESS 0x3fe57a FORMAT "%5.1" /end MEASUREMENT
/begin MEASUREMENT iga_mis "Ignition angle at current misfire segment" SBYTE _CNV_A_R_LINEAR_____82_CM 1 100. -48. 47.625 DISPLAY_IDENTIFIER IGA_MIS ECU_ADDRESS 0x3fe57c FORMAT "%5.1" /end MEASUREMENT
/begin MEASUREMENT lv_req_app_inh_mis "Misfire detection APP INC fade out request flag" UBYTE _CNV_S_2_RANGE______21_CM 1 100. 0. 1. DISPLAY_IDENTIFIER LV_REQ_APP_INH_MIS ECU_ADDRESS 0x3fe576 /end MEASUREMENT
/begin MEASUREMENT ctr_tot_mis "Overall misfire detection counter" ULONG _CNV_A_R_LINEAR_____22_CM 1 100. 0. 4294967295. DISPLAY_IDENTIFIER CTR_TOT_MIS ECU_ADDRESS 0x3fcbb4 BYTE_ORDER MSB_LAST FORMAT "%11.0" /end MEASUREMENT
/begin CHARACTERISTIC c_mask_app_inh_det_zdly_mis "MIS_DET_CDN_APP_INH carrier structure fade out configuration mask (misfire detection zero delay phase)" VALUE 0xffe40344 _REC_VAL_20_u2 65535. _CNV_A_R_LINEAR_____0_CM 0. 65535. DISPLAY_IDENTIFIER C_MASK_APP_INH_DET_ZDLY_MIS FORMAT "%5.0" /end CHARACTERISTIC
/begin CHARACTERISTIC c_nr_tdc_iga_dif_er "Fade out duration when IGA difference per TDC has been detected" VALUE 0xffe402e7 _REC_VAL_20_u1 255. _CNV_A_R_LINEAR_____0_CM 0. 255. DISPLAY_IDENTIFIER C_NR_TDC_IGA_DIF_ER FORMAT "%3.0" /end CHARACTERISTIC
/begin CHARACTERISTIC c_nr_tdc_cmb_tra_s_mis "Fade out TDC's duration when engine combustion manager enter or leave stratified combustion mode" VALUE 0xffe402e6 _REC_VAL_20_u1 255. _CNV_A_R_LINEAR_____603_CM 0. 255. DISPLAY_IDENTIFIER C_NR_TDC_CMB_TRA_S_MIS FORMAT "%3.0" /end CHARACTERISTIC
/begin CHARACTERISTIC c_nr_tdc_cmb_tra_afl_mis "Fade out TDC's duration when engine combustion manager enter or leave air/fuel lean combustion mode" VALUE 0xffe402e5 _REC_VAL_20_u1 255. _CNV_A_R_LINEAR_____603_CM 0. 255. DISPLAY_IDENTIFIER C_NR_TDC_CMB_TRA_AFL_MIS FORMAT "%3.0" /end CHARACTERISTIC
/begin CHARACTERISTIC ip_tps_grd_max_er "Maximum throttle gradient threshold for fade out condition" CURVE 0xffe436d6 _REC_CUR_20_u1_u2 2987.5 _CNV_A_R_LINEAR_____52_CM 0. 2987.5 DISPLAY_IDENTIFIER IP_TPS_GRD_MAX_ER FORMAT "%6.1"
 /begin AXIS_DESCR COM_AXIS tps_av _CNV_A_R_LINEAR_____53_CM 10 0. 119.5 FORMAT "%7.3" AXIS_PTS_REF ldp_tps_av__tps_grd_max_er /end AXIS_DESCR
/end CHARACTERISTIC
/begin CHARACTERISTIC ip_tps_grd_max_zdly_er "Maximum throttle gradient threshold for fade out condition during zero delay misfire monitoring activation" CURVE 0xffe402f1 _REC_CUR_20_u1_u2 2987.5 _CNV_A_R_LINEAR_____52_CM 0. 2987.5 DISPLAY_IDENTIFIER IP_TPS_GRD_MAX_ZDLY_ER FORMAT "%6.1"
 /begin AXIS_DESCR COM_AXIS tps_av _CNV_A_R_LINEAR_____53_CM 6 0. 119.5 FORMAT "%7.3" AXIS_PTS_REF ldp_tps_av__tps_grd_max_zdly_er /end AXIS_DESCR
/end CHARACTERISTIC
/begin CHARACTERISTIC ip_load_grd_hom_max_mis "Maximum LOAD_MIS gradient for fade out condition in homogeneous combustion modes" CURVE 0xffe437a8 _REC_CUR_20_u2_u2 99.99694824000001 _CNV_A_R_LINEAR_____571_CM 0. 99.99694824 DISPLAY_IDENTIFIER IP_LOAD_GRD_HOM_MAX_MIS
 /begin AXIS_DESCR COM_AXIS load_mis _CNV_A_R_LINEAR_____571_CM 12 0. 99.99694824 AXIS_PTS_REF ldp_load_mis__load_grd_hom_max /end AXIS_DESCR
/end CHARACTERISTIC
/begin CHARACTERISTIC ip_load_grd_s_max_mis "Maximum LOAD_MIS gradient for fade out condition in stratified combustion mode" CURVE 0xffe437c0 _REC_CUR_20_u2_u2 99.99694824000001 _CNV_A_R_LINEAR_____571_CM 0. 99.99694824 DISPLAY_IDENTIFIER IP_LOAD_GRD_S_MAX_MIS
 /begin AXIS_DESCR COM_AXIS load_mis _CNV_A_R_LINEAR_____571_CM 12 0. 99.99694824 AXIS_PTS_REF ldp_load_mis__load_grd_s_max /end AXIS_DESCR
/end CHARACTERISTIC
/begin AXIS_PTS ldp_map__map_dif_max_er "" 0xffe43dda map _REC_AXS_20_u2 5434. _CNV_A_R_LINEAR_____49_CM 12 0. 5434. DISPLAY_IDENTIFIER LDP_MAP__MAP_DIF_MAX_ER FORMAT "%7.2" /end AXIS_PTS
/begin CHARACTERISTIC ip_map_dif_max_er "Maximum MAP gradient (per segment °CRK) for fade out condition" CURVE 0xffe43868 _REC_CUR_20_u2_u2 5434. _CNV_A_R_LINEAR_____49_CM 0. 5434. DISPLAY_IDENTIFIER IP_MAP_DIF_MAX_ER FORMAT "%7.2"
 /begin AXIS_DESCR COM_AXIS map _CNV_A_R_LINEAR_____49_CM 12 0. 5434. FORMAT "%7.2" AXIS_PTS_REF ldp_map__map_dif_max_er /end AXIS_DESCR
/end CHARACTERISTIC
/begin AXIS_PTS ldp_n_32__delta_iga_mis "" 0xffe436e0 n_32 _REC_AXS_20_u1 8160. _CNV_A_R_LINEAR_____15_CM 8 0. 8160. DISPLAY_IDENTIFIER LDP_N_32__DELTA_IGA_MIS FORMAT "%4.0" /end AXIS_PTS
/begin AXIS_PTS ldp_maf__delta_iga_mis "" 0xffe43dc8 maf _REC_AXS_20_u2 1389. _CNV_A_R_LINEAR_____108_CM 8 0. 1389. DISPLAY_IDENTIFIER LDP_MAF__DELTA_IGA_MIS FORMAT "%7.2" /end AXIS_PTS
/begin CHARACTERISTIC ip_delta_iga_mis "Spark advance angle difference at part load for misfire inhibition" MAP 0xffe43576 _REC_MAP_20_u1_u1_u2 47.625 _CNV_A_R_LINEAR_____82_CM 0. 47.625 DISPLAY_IDENTIFIER IP_DELTA_IGA_MIS
 /begin AXIS_DESCR COM_AXIS n_32 _CNV_A_R_LINEAR_____15_CM 8 0. 8160. FORMAT "%4.0" AXIS_PTS_REF ldp_n_32__delta_iga_mis /end AXIS_DESCR
 /begin AXIS_DESCR COM_AXIS maf _CNV_A_R_LINEAR_____108_CM 8 0. 1389. FORMAT "%7.2" AXIS_PTS_REF ldp_maf__delta_iga_mis /end AXIS_DESCR
/end CHARACTERISTIC
/begin CHARACTERISTIC ip_fac_thd_iv_s_er "Factor for adaptation of the threshold in case of active cylinder cut-off in stratified combustion mode" CURVE 0xffe4379c _REC_CUR_20_u2_u1 1. _CNV_A_R_LINEAR_____191_CM 0. 1. DISPLAY_IDENTIFIER IP_FAC_THD_IV_S_ER FORMAT "%7.5"
 /begin AXIS_DESCR COM_AXIS n_32 _CNV_A_R_LINEAR_____15_CM 6 0. 8160. FORMAT "%4.0" AXIS_PTS_REF ldp_n_32__fac_thd_iv_s_er /end AXIS_DESCR
/end CHARACTERISTIC
/begin AXIS_PTS ldpm_amp__amp_ofs_load_mis "" 0xffe43efc amp _REC_AXS_20_u2 5434. _CNV_A_R_LINEAR_____49_CM 9 0. 5434. DISPLAY_IDENTIFIER LDPM_AMP__AMP_OFS_LOAD_MIS FORMAT "%7.2" /end AXIS_PTS
/begin AXIS_PTS ldpm_tco__tco_ofs_load_mis "" 0xffe43740 tco _REC_AXS_20_u1 190.5 _CNV_A_R_LINEAR_____11_CM 9 -48. 142.5 DISPLAY_IDENTIFIER LDPM_TCO__TCO_OFS_LOAD_MIS FORMAT "%5.1" /end AXIS_PTS
/begin CHARACTERISTIC lc_conf_load_mis "LOAD_MIS switch configuration versus engine combustion mode : (=0) LOAD_MIS always relative to TQI_AV (=1) LOAD_MIS relative to MAF in homogeneous combustion modes & relative to TQI_AV in stratified mode" VALUE 0xffe402f8 _REC_VAL_20_u1 1. _CNV_S_2_RANGE______21_CM 0. 1. DISPLAY_IDENTIFIER LC_CONF_LOAD_MIS /end CHARACTERISTIC
/begin CHARACTERISTIC c_tqi_av_max_mis "Maximum torque value to determine engine load ratio scale" VALUE 0xffe4037c _REC_VAL_20_u2 1023.984375 _CNV_A_R_LINEAR_____604_CM 0. 1023.984375 DISPLAY_IDENTIFIER C_TQI_AV_MAX_MIS FORMAT "%7.2" /end CHARACTERISTIC
/begin CHARACTERISTIC c_maf_max_mis "Maximum air mass value to determine engine load ratio scale" VALUE 0xffe4033e _REC_VAL_20_u2 1389. _CNV_A_R_LINEAR_____108_CM 0. 1389. DISPLAY_IDENTIFIER C_MAF_MAX_MIS FORMAT "%7.2" /end CHARACTERISTIC
/begin AXIS_PTS ldp_tps_av__tps_grd_max_er "" 0xffe43ed8 tps_av _REC_AXS_20_u2 119.5 _CNV_A_R_LINEAR_____53_CM 10 0. 119.5 DISPLAY_IDENTIFIER LDP_TPS_AV__TPS_GRD_MAX_ER FORMAT "%7.3" /end AXIS_PTS
/begin AXIS_PTS ldp_tps_av__tps_grd_max_zdly_er "" 0xffe43eee tps_av _REC_AXS_20_u2 11.95 _CNV_A_R_LINEAR_____53_CM 6 0. 119.5 DISPLAY_IDENTIFIER LDP_TPS_AV__TPS_GRD_MAX_ZDLY_ER FORMAT "%7.3" /end AXIS_PTS
/begin AXIS_PTS ldp_load_mis__load_grd_hom_max "" 0xffe43d16 load_mis _REC_AXS_20_u2 99.99694824000001 _CNV_A_R_LINEAR_____571_CM 12 0. 99.99694824 DISPLAY_IDENTIFIER LDP_LOAD_MIS__LOAD_GRD_HOM_MAX /end AXIS_PTS
/begin AXIS_PTS ldp_load_mis__load_grd_s_max "" 0xffe43d30 load_mis _REC_AXS_20_u2 99.99694824000001 _CNV_A_R_LINEAR_____571_CM 12 0. 99.99694824 DISPLAY_IDENTIFIER LDP_LOAD_MIS__LOAD_GRD_S_MAX /end AXIS_PTS
/begin MEASUREMENT thd_er_buf[0] "Misfire detection threshold stack for ER evaluation" SWORD _CNV_A_R_LINEAR_____428_CM 1 100. -32768. 32767. DISPLAY_IDENTIFIER THD_ER_BUF_0 ECU_ADDRESS 0x3fd504 BYTE_ORDER MSB_LAST FORMAT "%6.0" /end MEASUREMENT
/begin MEASUREMENT thd_er_buf[1] "Misfire detection threshold stack for ER evaluation" SWORD _CNV_A_R_LINEAR_____428_CM 1 100. -32768. 32767. DISPLAY_IDENTIFIER THD_ER_BUF_1 ECU_ADDRESS 0x3fd506 BYTE_ORDER MSB_LAST FORMAT "%6.0" /end MEASUREMENT
/begin MEASUREMENT thd_er_buf[2] "Misfire detection threshold stack for ER evaluation" SWORD _CNV_A_R_LINEAR_____428_CM 1 100. -32768. 32767. DISPLAY_IDENTIFIER THD_ER_BUF_2 ECU_ADDRESS 0x3fd508 BYTE_ORDER MSB_LAST FORMAT "%6.0" /end MEASUREMENT
/begin MEASUREMENT thd_er_buf[3] "Misfire detection threshold stack for ER evaluation" SWORD _CNV_A_R_LINEAR_____428_CM 1 100. -32768. 32767. DISPLAY_IDENTIFIER THD_ER_BUF_3 ECU_ADDRESS 0x3fd50a BYTE_ORDER MSB_LAST FORMAT "%6.0" /end MEASUREMENT
/begin MEASUREMENT thd_er_buf[4] "Misfire detection threshold stack for ER evaluation" SWORD _CNV_A_R_LINEAR_____428_CM 1 100. -32768. 32767. DISPLAY_IDENTIFIER THD_ER_BUF_4 ECU_ADDRESS 0x3fd50c BYTE_ORDER MSB_LAST FORMAT "%6.0" /end MEASUREMENT
/begin MEASUREMENT thd_er_buf[5] "Misfire detection threshold stack for ER evaluation" SWORD _CNV_A_R_LINEAR_____428_CM 1 100. -32768. 32767. DISPLAY_IDENTIFIER THD_ER_BUF_5 ECU_ADDRESS 0x3fd50e BYTE_ORDER MSB_LAST FORMAT "%6.0" /end MEASUREMENT
/begin MEASUREMENT thd_er_stnd_buf[0] "Misfire detection threshold stack for ER_STND evaluation" SWORD _CNV_A_R_LINEAR_____0_CM 1 100. -32768. 32767. DISPLAY_IDENTIFIER THD_ER_STND_BUF_0 ECU_ADDRESS 0x3fd512 BYTE_ORDER MSB_LAST FORMAT "%6.0" /end MEASUREMENT
/begin MEASUREMENT thd_er_stnd_buf[1] "Misfire detection threshold stack for ER_STND evaluation" SWORD _CNV_A_R_LINEAR_____0_CM 1 100. -32768. 32767. DISPLAY_IDENTIFIER THD_ER_STND_BUF_1 ECU_ADDRESS 0x3fd514 BYTE_ORDER MSB_LAST FORMAT "%6.0" /end MEASUREMENT
/begin MEASUREMENT thd_er_stnd_buf[2] "Misfire detection threshold stack for ER_STND evaluation" SWORD _CNV_A_R_LINEAR_____0_CM 1 100. -32768. 32767. DISPLAY_IDENTIFIER THD_ER_STND_BUF_2 ECU_ADDRESS 0x3fd516 BYTE_ORDER MSB_LAST FORMAT "%6.0" /end MEASUREMENT
/begin MEASUREMENT thd_er_stnd_buf[3] "Misfire detection threshold stack for ER_STND evaluation" SWORD _CNV_A_R_LINEAR_____0_CM 1 100. -32768. 32767. DISPLAY_IDENTIFIER THD_ER_STND_BUF_3 ECU_ADDRESS 0x3fd518 BYTE_ORDER MSB_LAST FORMAT "%6.0" /end MEASUREMENT
/begin MEASUREMENT thd_er_stnd_buf[4] "Misfire detection threshold stack for ER_STND evaluation" SWORD _CNV_A_R_LINEAR_____0_CM 1 100. -32768. 32767. DISPLAY_IDENTIFIER THD_ER_STND_BUF_4 ECU_ADDRESS 0x3fd51a BYTE_ORDER MSB_LAST FORMAT "%6.0" /end MEASUREMENT
/begin MEASUREMENT thd_er_stnd_buf[5] "Misfire detection threshold stack for ER_STND evaluation" SWORD _CNV_A_R_LINEAR_____0_CM 1 100. -32768. 32767. DISPLAY_IDENTIFIER THD_ER_STND_BUF_5 ECU_ADDRESS 0x3fd51c BYTE_ORDER MSB_LAST FORMAT "%6.0" /end MEASUREMENT
/begin MEASUREMENT iga_dif_mis "Ignition angle difference between 2 misfire segment tasks" SBYTE _CNV_A_R_LINEAR_____82_CM 1 100. -48. 47.625 DISPLAY_IDENTIFIER IGA_DIF_MIS ECU_ADDRESS 0x3fe579 FORMAT "%5.1" /end MEASUREMENT
/begin MEASUREMENT map_dif_mis "Manifold air pressure difference between 2 misfire segment tasks" UWORD _CNV_A_R_LINEAR_____49_CM 1 100. 0. 5434. DISPLAY_IDENTIFIER MAP_DIF_MIS ECU_ADDRESS 0x3fd502 BYTE_ORDER MSB_LAST FORMAT "%7.2" /end MEASUREMENT
/begin MEASUREMENT thd_er_stnd "Misfire detection threshold for current ER_STND value" SWORD _CNV_A_R_LINEAR_____0_CM 1 100. -32768. 32767. DISPLAY_IDENTIFIER THD_ER_STND ECU_ADDRESS 0x3fd4fa BYTE_ORDER MSB_LAST FORMAT "%6.0" /end MEASUREMENT
/begin MEASUREMENT thd_er_stnd_x[0] "Misfire detection thresholds for cylinder ER_STND values" SWORD _CNV_A_R_LINEAR_____0_CM 1 100. -32768. 32767. DISPLAY_IDENTIFIER THD_ER_STND_0 ECU_ADDRESS 0x3fd53c BYTE_ORDER MSB_LAST FORMAT "%6.0" /end MEASUREMENT
/begin MEASUREMENT thd_er_stnd_x[1] "Misfire detection thresholds for cylinder ER_STND values" SWORD _CNV_A_R_LINEAR_____0_CM 1 100. -32768. 32767. DISPLAY_IDENTIFIER THD_ER_STND_1 ECU_ADDRESS 0x3fd53e BYTE_ORDER MSB_LAST FORMAT "%6.0" /end MEASUREMENT
/begin MEASUREMENT thd_er_stnd_x[2] "Misfire detection thresholds for cylinder ER_STND values" SWORD _CNV_A_R_LINEAR_____0_CM 1 100. -32768. 32767. DISPLAY_IDENTIFIER THD_ER_STND_2 ECU_ADDRESS 0x3fd540 BYTE_ORDER MSB_LAST FORMAT "%6.0" /end MEASUREMENT
/begin MEASUREMENT thd_er_stnd_x[3] "Misfire detection thresholds for cylinder ER_STND values" SWORD _CNV_A_R_LINEAR_____0_CM 1 100. -32768. 32767. DISPLAY_IDENTIFIER THD_ER_STND_3 ECU_ADDRESS 0x3fd542 BYTE_ORDER MSB_LAST FORMAT "%6.0" /end MEASUREMENT
/begin MEASUREMENT thd_er_stnd_x[4] "Misfire detection thresholds for cylinder ER_STND values" SWORD _CNV_A_R_LINEAR_____0_CM 1 100. -32768. 32767. DISPLAY_IDENTIFIER THD_ER_STND_4 ECU_ADDRESS 0x3fd544 BYTE_ORDER MSB_LAST FORMAT "%6.0" /end MEASUREMENT
/begin MEASUREMENT thd_er_stnd_x[5] "Misfire detection thresholds for cylinder ER_STND values" SWORD _CNV_A_R_LINEAR_____0_CM 1 100. -32768. 32767. DISPLAY_IDENTIFIER THD_ER_STND_5 ECU_ADDRESS 0x3fd546 BYTE_ORDER MSB_LAST FORMAT "%6.0" /end MEASUREMENT
/begin MEASUREMENT thd_er "Misfire detection threshold for current ER value" SWORD _CNV_A_R_LINEAR_____428_CM 1 100. -32768. 32767. DISPLAY_IDENTIFIER THD_ER ECU_ADDRESS 0x3fd4f8 BYTE_ORDER MSB_LAST FORMAT "%6.0" /end MEASUREMENT
/begin MEASUREMENT thd_er_x[0] "Misfire detection thresholds for cylinder ER values" SWORD _CNV_A_R_LINEAR_____428_CM 1 100. -32768. 32767. DISPLAY_IDENTIFIER THD_ER_0 ECU_ADDRESS 0x3fd530 BYTE_ORDER MSB_LAST FORMAT "%6.0" /end MEASUREMENT
/begin MEASUREMENT thd_er_x[1] "Misfire detection thresholds for cylinder ER values" SWORD _CNV_A_R_LINEAR_____428_CM 1 100. -32768. 32767. DISPLAY_IDENTIFIER THD_ER_1 ECU_ADDRESS 0x3fd532 BYTE_ORDER MSB_LAST FORMAT "%6.0" /end MEASUREMENT
/begin MEASUREMENT thd_er_x[2] "Misfire detection thresholds for cylinder ER values" SWORD _CNV_A_R_LINEAR_____428_CM 1 100. -32768. 32767. DISPLAY_IDENTIFIER THD_ER_2 ECU_ADDRESS 0x3fd534 BYTE_ORDER MSB_LAST FORMAT "%6.0" /end MEASUREMENT
/begin MEASUREMENT thd_er_x[3] "Misfire detection thresholds for cylinder ER values" SWORD _CNV_A_R_LINEAR_____428_CM 1 100. -32768. 32767. DISPLAY_IDENTIFIER THD_ER_3 ECU_ADDRESS 0x3fd536 BYTE_ORDER MSB_LAST FORMAT "%6.0" /end MEASUREMENT
/begin MEASUREMENT thd_er_x[4] "Misfire detection thresholds for cylinder ER values" SWORD _CNV_A_R_LINEAR_____428_CM 1 100. -32768. 32767. DISPLAY_IDENTIFIER THD_ER_4 ECU_ADDRESS 0x3fd538 BYTE_ORDER MSB_LAST FORMAT "%6.0" /end MEASUREMENT
/begin MEASUREMENT thd_er_x[5] "Misfire detection thresholds for cylinder ER values" SWORD _CNV_A_R_LINEAR_____428_CM 1 100. -32768. 32767. DISPLAY_IDENTIFIER THD_ER_5 ECU_ADDRESS 0x3fd53a BYTE_ORDER MSB_LAST FORMAT "%6.0" /end MEASUREMENT
/begin AXIS_PTS ldp_n__load_min_s_mt_mis "" 0xffe43e76 n _REC_AXS_20_u2 8160. _CNV_A_R_LINEAR_____10_CM 12 0. 8160. DISPLAY_IDENTIFIER LDP_N__LOAD_MIN_S_MT_MIS FORMAT "%4.0" /end AXIS_PTS
/begin AXIS_PTS ldp_n__load_min_s_at_mis "" 0xffe43e5c n _REC_AXS_20_u2 8160. _CNV_A_R_LINEAR_____10_CM 12 0. 8160. DISPLAY_IDENTIFIER LDP_N__LOAD_MIN_S_AT_MIS FORMAT "%4.0" /end AXIS_PTS
/begin AXIS_PTS ldp_n__load_min_afs_mt_mis "" 0xffe43e42 n _REC_AXS_20_u2 8160. _CNV_A_R_LINEAR_____10_CM 12 0. 8160. DISPLAY_IDENTIFIER LDP_N__LOAD_MIN_AFS_MT_MIS FORMAT "%4.0" /end AXIS_PTS
/begin AXIS_PTS ldp_n__load_min_afs_at_mis "" 0xffe43e28 n _REC_AXS_20_u2 8160. _CNV_A_R_LINEAR_____10_CM 12 0. 8160. DISPLAY_IDENTIFIER LDP_N__LOAD_MIN_AFS_AT_MIS FORMAT "%4.0" /end AXIS_PTS
/begin AXIS_PTS ldp_n__load_min_afl_mt_mis "" 0xffe43e0e n _REC_AXS_20_u2 8160. _CNV_A_R_LINEAR_____10_CM 12 0. 8160. DISPLAY_IDENTIFIER LDP_N__LOAD_MIN_AFL_MT_MIS FORMAT "%4.0" /end AXIS_PTS
/begin AXIS_PTS ldp_n__load_min_afl_at_mis "" 0xffe43df4 n _REC_AXS_20_u2 8160. _CNV_A_R_LINEAR_____10_CM 12 0. 8160. DISPLAY_IDENTIFIER LDP_N__LOAD_MIN_AFL_AT_MIS FORMAT "%4.0" /end AXIS_PTS
/begin AXIS_PTS ldp_load_mis__thd_mt_afl_er "" 0xffe43d90 load_mis _REC_AXS_20_u2 99.99694824000001 _CNV_A_R_LINEAR_____571_CM 6 0. 99.99694824 DISPLAY_IDENTIFIER LDP_LOAD_MIS__THD_MT_AFL_ER /end AXIS_PTS
/begin AXIS_PTS ldp_load_mis__thd_at_afl_er "" 0xffe43d66 load_mis _REC_AXS_20_u2 99.99694824000001 _CNV_A_R_LINEAR_____571_CM 6 0. 99.99694824 DISPLAY_IDENTIFIER LDP_LOAD_MIS__THD_AT_AFL_ER /end AXIS_PTS
/begin AXIS_PTS ldp_n_32__thd_mt_afl_er "" 0xffe43710 n_32 _REC_AXS_20_u1 8160. _CNV_A_R_LINEAR_____15_CM 12 0. 8160. DISPLAY_IDENTIFIER LDP_N_32__THD_MT_AFL_ER FORMAT "%4.0" /end AXIS_PTS
/begin AXIS_PTS ldp_n_32__thd_at_afl_er "" 0xffe436e9 n_32 _REC_AXS_20_u1 8160. _CNV_A_R_LINEAR_____15_CM 12 0. 8160. DISPLAY_IDENTIFIER LDP_N_32__THD_AT_AFL_ER FORMAT "%4.0" /end AXIS_PTS
/begin AXIS_PTS ldp_load_mis__thd_mt_afs_er "" 0xffe43d9e load_mis _REC_AXS_20_u2 99.99694824000001 _CNV_A_R_LINEAR_____571_CM 6 0. 99.99694824 DISPLAY_IDENTIFIER LDP_LOAD_MIS__THD_MT_AFS_ER /end AXIS_PTS
/begin AXIS_PTS ldp_load_mis__thd_at_afs_er "" 0xffe43d74 load_mis _REC_AXS_20_u2 99.99694824000001 _CNV_A_R_LINEAR_____571_CM 6 0. 99.99694824 DISPLAY_IDENTIFIER LDP_LOAD_MIS__THD_AT_AFS_ER /end AXIS_PTS
/begin AXIS_PTS ldp_load_mis__thd_mt_s_er "" 0xffe43dac load_mis _REC_AXS_20_u2 99.99694824000001 _CNV_A_R_LINEAR_____571_CM 6 0. 99.99694824 DISPLAY_IDENTIFIER LDP_LOAD_MIS__THD_MT_S_ER /end AXIS_PTS
/begin AXIS_PTS ldp_load_mis__thd_at_s_er "" 0xffe43d82 load_mis _REC_AXS_20_u2 99.99694824000001 _CNV_A_R_LINEAR_____571_CM 6 0. 99.99694824 DISPLAY_IDENTIFIER LDP_LOAD_MIS__THD_AT_S_ER /end AXIS_PTS
/begin AXIS_PTS ldp_n_32__thd_mt_s_er "" 0xffe4372a n_32 _REC_AXS_20_u1 8160. _CNV_A_R_LINEAR_____15_CM 12 0. 8160. DISPLAY_IDENTIFIER LDP_N_32__THD_MT_S_ER FORMAT "%4.0" /end AXIS_PTS
/begin AXIS_PTS ldp_n_32__thd_at_s_er "" 0xffe43703 n_32 _REC_AXS_20_u1 8160. _CNV_A_R_LINEAR_____15_CM 12 0. 8160. DISPLAY_IDENTIFIER LDP_N_32__THD_AT_S_ER FORMAT "%4.0" /end AXIS_PTS
/begin AXIS_PTS ldp_n_32__thd_mt_afs_er "" 0xffe4371d n_32 _REC_AXS_20_u1 8160. _CNV_A_R_LINEAR_____15_CM 12 0. 8160. DISPLAY_IDENTIFIER LDP_N_32__THD_MT_AFS_ER FORMAT "%4.0" /end AXIS_PTS
/begin AXIS_PTS ldp_n_32__thd_at_afs_er "" 0xffe436f6 n_32 _REC_AXS_20_u1 8160. _CNV_A_R_LINEAR_____15_CM 12 0. 8160. DISPLAY_IDENTIFIER LDP_N_32__THD_AT_AFS_ER FORMAT "%4.0" /end AXIS_PTS
/begin CHARACTERISTIC c_t_tps_grd_dly_mis "Fade out duration when maximum throttle gradient has been detected" VALUE 0xffe40374 _REC_VAL_20_u2 655.35 _CNV_A_R_LINEAR_____4_CM 0. 655.35 DISPLAY_IDENTIFIER C_T_TPS_GRD_DLY_MIS FORMAT "%5.2" /end CHARACTERISTIC
/begin CHARACTERISTIC c_t_tps_grd_dly_zdly_mis "Fade out duration when maximum throttle gradient has been detected during zero delay starting phase" VALUE 0xffe40376 _REC_VAL_20_u2 655.35 _CNV_A_R_LINEAR_____4_CM 0. 655.35 DISPLAY_IDENTIFIER C_T_TPS_GRD_DLY_ZDLY_MIS FORMAT "%5.2" /end CHARACTERISTIC
/begin CHARACTERISTIC c_t_load_grd_hom_dly_mis "Fade out duration when maximum LOAD_GRD_MIS has been detected in homogeneous combustion  modes" VALUE 0xffe4036c _REC_VAL_20_u2 655.35 _CNV_A_R_LINEAR_____4_CM 0. 655.35 DISPLAY_IDENTIFIER C_T_LOAD_GRD_HOM_DLY_MIS FORMAT "%5.2" /end CHARACTERISTIC
/begin CHARACTERISTIC c_t_load_grd_s_dly_mis "Fade out duration when maximum LOAD_GRD_MIS has been detected in stratified combustion  mode" VALUE 0xffe4036e _REC_VAL_20_u2 655.35 _CNV_A_R_LINEAR_____4_CM 0. 655.35 DISPLAY_IDENTIFIER C_T_LOAD_GRD_S_DLY_MIS FORMAT "%5.2" /end CHARACTERISTIC
/begin CHARACTERISTIC c_t_accout_dly_er "Fade out duration when air-conditioning compressor has been switched on" VALUE 0xffe40364 _REC_VAL_20_u2 655.34 _CNV_A_R_LINEAR_____4_CM 1.e-002 655.35 DISPLAY_IDENTIFIER C_T_ACCOUT_DLY_ER FORMAT "%5.2" /end CHARACTERISTIC
/begin CHARACTERISTIC c_t_map_dif_dly_er "Fade out duration when manifold air pressure gradient has been detected" VALUE 0xffe40370 _REC_VAL_20_u2 655.35 _CNV_A_R_LINEAR_____4_CM 0. 655.35 DISPLAY_IDENTIFIER C_T_MAP_DIF_DLY_ER FORMAT "%5.2" /end CHARACTERISTIC
/begin CHARACTERISTIC c_t_amt_gs_dly_mis "Fade out duration when gearshift of AMT has been detected" VALUE 0xffe40366 _REC_VAL_20_u2 655.35 _CNV_A_R_LINEAR_____4_CM 0. 655.35 DISPLAY_IDENTIFIER C_T_AMT_GS_DLY_MIS FORMAT "%5.2" /end CHARACTERISTIC
/begin CHARACTERISTIC c_mask_app_inh_det_mis "MIS_DET_CDN_APP_INH carrier structure fade out configuration mask (misfire detection nominal phase)" VALUE 0xffe40340 _REC_VAL_20_u2 65535. _CNV_A_R_LINEAR_____0_CM 0. 65535. DISPLAY_IDENTIFIER C_MASK_APP_INH_DET_MIS FORMAT "%5.0" /end CHARACTERISTIC
/begin CHARACTERISTIC c_mask_app_inh_det_mis_is "MIS_DET_CDN_APP_INH carrier structure fade out configuration mask for IS (misfire detection nominal phase)" VALUE 0xffe40342 _REC_VAL_20_u2 65535. _CNV_A_R_LINEAR_____0_CM 0. 65535. DISPLAY_IDENTIFIER C_MASK_APP_INH_DET_MIS_IS FORMAT "%5.0" /end CHARACTERISTIC
/begin MEASUREMENT sum_fac_diag_mis "Sum of the weighting factor from diagnosis combinations for final misfire decision" UWORD _CNV_A_R_LINEAR_____607_CM 1 100. 0. 6. DISPLAY_IDENTIFIER SUM_FAC_DIAG_MIS ECU_ADDRESS 0x3fd556 BYTE_ORDER MSB_LAST FORMAT "%6.4" /end MEASUREMENT
/begin MEASUREMENT fac_igc_diag_mis "Reliability weighting factor for ignition diagnosis (ignition failure detected)" UBYTE _CNV_A_R_LINEAR_____608_CM 1 100. 0. 2. DISPLAY_IDENTIFIER FAC_IGC_DIAG_MIS ECU_ADDRESS 0x3fe598 FORMAT "%6.4" /end MEASUREMENT
/begin MEASUREMENT fac_er_diag_mis "Reliability weighting factor for detection based on misfire detection index (ER)" UBYTE _CNV_A_R_LINEAR_____608_CM 1 100. 0. 2. DISPLAY_IDENTIFIER FAC_ER_DIAG_MIS ECU_ADDRESS 0x3fe597 FORMAT "%6.4" /end MEASUREMENT
/begin MEASUREMENT fac_iv_diag_mis "Reliability weighting factor for injection valve (injection valve failure detected)" UBYTE _CNV_A_R_LINEAR_____608_CM 1 100. 0. 2. DISPLAY_IDENTIFIER FAC_IV_DIAG_MIS ECU_ADDRESS 0x3fe599 FORMAT "%6.4" /end MEASUREMENT
/begin MEASUREMENT lv_ftl_l_diag_mis "Specific request to allow FTL_L symptom storing (misfire detection with low fuel tank level)" UBYTE _CNV_S_2_RANGE______21_CM 1 100. 0. 1. DISPLAY_IDENTIFIER LV_FTL_L_DIAG_MIS ECU_ADDRESS 0x3fe588 /end MEASUREMENT
/begin MEASUREMENT lv_req_app_ctr_mis_a "Specific request to allow out of FTP counting mode even if we are within FTP area" UBYTE _CNV_S_2_RANGE______21_CM 1 100. 0. 1. DISPLAY_IDENTIFIER LV_REQ_APP_CTR_MIS_A ECU_ADDRESS 0x3fe589 /end MEASUREMENT
/begin AXIS_PTS ldp_n_32__fac_er_afl_diag_mis "" 0xffe40308 n_32 _REC_AXS_20_u1 8160. _CNV_A_R_LINEAR_____15_CM 6 0. 8160. DISPLAY_IDENTIFIER LDP_N_32__FAC_ER_AFL_DIAG_MIS FORMAT "%4.0" /end AXIS_PTS
/begin AXIS_PTS ldp_n_32__fac_er_s_diag_mis "" 0xffe40316 n_32 _REC_AXS_20_u1 8160. _CNV_A_R_LINEAR_____15_CM 6 0. 8160. DISPLAY_IDENTIFIER LDP_N_32__FAC_ER_S_DIAG_MIS FORMAT "%4.0" /end AXIS_PTS
/begin AXIS_PTS ldp_n_32__fac_igc_diag_mis "" 0xffe4031d n_32 _REC_AXS_20_u1 8160. _CNV_A_R_LINEAR_____15_CM 6 0. 8160. DISPLAY_IDENTIFIER LDP_N_32__FAC_IGC_DIAG_MIS FORMAT "%4.0" /end AXIS_PTS
/begin AXIS_PTS ldp_n_32__fac_er_afs_diag_mis "" 0xffe4030f n_32 _REC_AXS_20_u1 8160. _CNV_A_R_LINEAR_____15_CM 6 0. 8160. DISPLAY_IDENTIFIER LDP_N_32__FAC_ER_AFS_DIAG_MIS FORMAT "%4.0" /end AXIS_PTS
/begin AXIS_PTS ldp_n_32__fac_iv_diag_mis "" 0xffe40324 n_32 _REC_AXS_20_u1 8160. _CNV_A_R_LINEAR_____15_CM 6 0. 8160. DISPLAY_IDENTIFIER LDP_N_32__FAC_IV_DIAG_MIS FORMAT "%4.0" /end AXIS_PTS
/begin AXIS_PTS ldp_load_mis__fac_er_s_diag_mis "" 0xffe43cec load_mis _REC_AXS_20_u2 99.99694824000001 _CNV_A_R_LINEAR_____571_CM 6 0. 99.99694824 DISPLAY_IDENTIFIER LDP_LOAD_MIS__FAC_ER_S_DIAG_MIS /end AXIS_PTS
/begin AXIS_PTS ldp_load_mis__fac_igc_diag_mis "" 0xffe43cfa load_mis _REC_AXS_20_u2 99.99694824000001 _CNV_A_R_LINEAR_____571_CM 6 0. 99.99694824 DISPLAY_IDENTIFIER LDP_LOAD_MIS__FAC_IGC_DIAG_MIS /end AXIS_PTS
/begin CHARACTERISTIC ip_fac_er_afl_diag_mis "Weighting factor for irregular engine operation (engine speed analysis)" MAP 0xffe435b6 _REC_MAP_20_u1_u1_u2 2. _CNV_A_R_LINEAR_____608_CM 0. 2. DISPLAY_IDENTIFIER IP_FAC_ER_AFL_DIAG_MIS FORMAT "%6.4"
 /begin AXIS_DESCR COM_AXIS n_32 _CNV_A_R_LINEAR_____15_CM 6 0. 8160. FORMAT "%4.0" AXIS_PTS_REF ldp_n_32__fac_er_afl_diag_mis /end AXIS_DESCR
 /begin AXIS_DESCR COM_AXIS load_mis _CNV_A_R_LINEAR_____571_CM 6 0. 99.99694824 AXIS_PTS_REF ldp_load_mis__fac_er_afl_diag /end AXIS_DESCR
/end CHARACTERISTIC
/begin CHARACTERISTIC ip_fac_er_s_diag_mis "Weighting factor for irregular engine operation (engine speed analysis)" MAP 0xffe435fe _REC_MAP_20_u1_u1_u2 2. _CNV_A_R_LINEAR_____608_CM 0. 2. DISPLAY_IDENTIFIER IP_FAC_ER_S_DIAG_MIS FORMAT "%6.4"
 /begin AXIS_DESCR COM_AXIS n_32 _CNV_A_R_LINEAR_____15_CM 6 0. 8160. FORMAT "%4.0" AXIS_PTS_REF ldp_n_32__fac_er_s_diag_mis /end AXIS_DESCR
 /begin AXIS_DESCR COM_AXIS load_mis _CNV_A_R_LINEAR_____571_CM 6 0. 99.99694824 AXIS_PTS_REF ldp_load_mis__fac_er_s_diag_mis /end AXIS_DESCR
/end CHARACTERISTIC
/begin CHARACTERISTIC ip_fac_er_afs_diag_mis "Weighting factor for irregular engine operation (engine speed analysis)" MAP 0xffe435da _REC_MAP_20_u1_u1_u2 2. _CNV_A_R_LINEAR_____608_CM 0. 2. DISPLAY_IDENTIFIER IP_FAC_ER_AFS_DIAG_MIS FORMAT "%6.4"
 /begin AXIS_DESCR COM_AXIS n_32 _CNV_A_R_LINEAR_____15_CM 6 0. 8160. FORMAT "%4.0" AXIS_PTS_REF ldp_n_32__fac_er_afs_diag_mis /end AXIS_DESCR
 /begin AXIS_DESCR COM_AXIS load_mis _CNV_A_R_LINEAR_____571_CM 6 0. 99.99694824 AXIS_PTS_REF ldp_load_mis__fac_er_afs_diag /end AXIS_DESCR
/end CHARACTERISTIC
/begin CHARACTERISTIC ip_fac_igc_diag_mis "Weighting factor for ignition diagnosis (ignition failure detected)" MAP 0xffe43622 _REC_MAP_20_u1_u1_u2 2. _CNV_A_R_LINEAR_____608_CM 0. 2. DISPLAY_IDENTIFIER IP_FAC_IGC_DIAG_MIS FORMAT "%6.4"
 /begin AXIS_DESCR COM_AXIS n_32 _CNV_A_R_LINEAR_____15_CM 6 0. 8160. FORMAT "%4.0" AXIS_PTS_REF ldp_n_32__fac_igc_diag_mis /end AXIS_DESCR
 /begin AXIS_DESCR COM_AXIS load_mis _CNV_A_R_LINEAR_____571_CM 6 0. 99.99694824 AXIS_PTS_REF ldp_load_mis__fac_igc_diag_mis /end AXIS_DESCR
/end CHARACTERISTIC
/begin CHARACTERISTIC ip_fac_iv_diag_mis "Weighting factor for injection valve diagnosis (injection valve failure detected)" MAP 0xffe43646 _REC_MAP_20_u1_u1_u2 2. _CNV_A_R_LINEAR_____608_CM 0. 2. DISPLAY_IDENTIFIER IP_FAC_IV_DIAG_MIS FORMAT "%6.4"
 /begin AXIS_DESCR COM_AXIS n_32 _CNV_A_R_LINEAR_____15_CM 6 0. 8160. FORMAT "%4.0" AXIS_PTS_REF ldp_n_32__fac_iv_diag_mis /end AXIS_DESCR
 /begin AXIS_DESCR COM_AXIS load_mis _CNV_A_R_LINEAR_____571_CM 6 0. 99.99694824 AXIS_PTS_REF ldp_load_mis__fac_iv_diag_mis /end AXIS_DESCR
/end CHARACTERISTIC
/begin AXIS_PTS ldp_load_mis__fac_iv_diag_mis "" 0xffe43d08 load_mis _REC_AXS_20_u2 99.99694824000001 _CNV_A_R_LINEAR_____571_CM 6 0. 99.99694824 DISPLAY_IDENTIFIER LDP_LOAD_MIS__FAC_IV_DIAG_MIS /end AXIS_PTS
/begin AXIS_PTS ldp_load_mis_2__mis_a_fac_afl "" 0xffe43ca6 load_mis_2 _REC_AXS_20_u2 99.99694824000001 _CNV_A_R_LINEAR_____571_CM 6 0. 99.99694824 DISPLAY_IDENTIFIER LDP_LOAD_MIS_2__MIS_A_FAC_AFL /end AXIS_PTS
/begin AXIS_PTS ldp_load_mis_2__mis_a_fac_afs "" 0xffe43cb4 load_mis_2 _REC_AXS_20_u2 99.99694824000001 _CNV_A_R_LINEAR_____571_CM 6 0. 99.99694824 DISPLAY_IDENTIFIER LDP_LOAD_MIS_2__MIS_A_FAC_AFS /end AXIS_PTS
/begin AXIS_PTS ldp_load_mis_2__mis_a_fac_s "" 0xffe43cc2 load_mis_2 _REC_AXS_20_u2 99.99694824000001 _CNV_A_R_LINEAR_____571_CM 6 0. 99.99694824 DISPLAY_IDENTIFIER LDP_LOAD_MIS_2__MIS_A_FAC_S /end AXIS_PTS
/begin CHARACTERISTIC c_mis_nr_off_iv_igcfb "Threshold for number of cylinders shut off due to misfire" VALUE 0xffe402e0 _REC_VAL_20_u1 6. _CNV_A_R_LINEAR_____0_CM 0. 6. DISPLAY_IDENTIFIER C_MIS_NR_OFF_IV_IGCFB FORMAT "%1.0" /end CHARACTERISTIC
/begin CHARACTERISTIC c_teg_cat_up_mis_a_max "TEG Threshold for misfire A counter management" VALUE 0xffe4037a _REC_VAL_20_u2 2047. _CNV_A_R_LINEAR_____6_CM 0. 2047. DISPLAY_IDENTIFIER C_TEG_CAT_UP_MIS_A_MAX FORMAT "%7.2" /end CHARACTERISTIC
/begin CHARACTERISTIC lc_ftl_l_diag_mis "Calibration to enable Low Fuel tank level symptom storing in misfire diagnosis symptom carriers" VALUE 0xffe40300 _REC_VAL_20_u1 1. _CNV_S_2_RANGE______21_CM 0. 1. DISPLAY_IDENTIFIER LC_FTL_L_DIAG_MIS /end CHARACTERISTIC
/begin CHARACTERISTIC lc_ctr_conf_diag_mis "Diagnosis TDC counting mode : counting all TDCs (=0) or only diagnosed TDC's (=1)" VALUE 0xffe402fe _REC_VAL_20_u1 1. _CNV_S_2_RANGE______21_CM 0. 1. DISPLAY_IDENTIFIER LC_CTR_CONF_DIAG_MIS /end CHARACTERISTIC
/begin CHARACTERISTIC ip_mis_a_fac_afl "Catalyst damage weighting factor used for MIS_A counters increment (AFL combustion mode)" MAP 0xffe4366a _REC_MAP_20_u1_u2_u2 100. _CNV_A_R_LINEAR_____0_CM 0. 100. DISPLAY_IDENTIFIER IP_MIS_A_FAC_AFL FORMAT "%3.0"
 /begin AXIS_DESCR COM_AXIS n _CNV_A_R_LINEAR_____10_CM 6 0. 8160. FORMAT "%4.0" AXIS_PTS_REF ldp_n__mis_a_fac_afl /end AXIS_DESCR
 /begin AXIS_DESCR COM_AXIS load_mis_2 _CNV_A_R_LINEAR_____571_CM 6 0. 99.99694824 AXIS_PTS_REF ldp_load_mis_2__mis_a_fac_afl /end AXIS_DESCR
/end CHARACTERISTIC
/begin CHARACTERISTIC ip_mis_a_fac_afs "Catalyst damage weighting factor used for MIS_A counters increment (AFS combustion mode)" MAP 0xffe4368e _REC_MAP_20_u1_u2_u2 100. _CNV_A_R_LINEAR_____0_CM 0. 100. DISPLAY_IDENTIFIER IP_MIS_A_FAC_AFS FORMAT "%3.0"
 /begin AXIS_DESCR COM_AXIS n _CNV_A_R_LINEAR_____10_CM 6 0. 8160. FORMAT "%4.0" AXIS_PTS_REF ldp_n__mis_a_fac_afs /end AXIS_DESCR
 /begin AXIS_DESCR COM_AXIS load_mis_2 _CNV_A_R_LINEAR_____571_CM 6 0. 99.99694824 AXIS_PTS_REF ldp_load_mis_2__mis_a_fac_afs /end AXIS_DESCR
/end CHARACTERISTIC
/begin CHARACTERISTIC ip_mis_a_fac_s "Catalyst damage weighting factor used for MIS_A counters increment (Stratified combustion mode)" MAP 0xffe436b2 _REC_MAP_20_u1_u2_u2 100. _CNV_A_R_LINEAR_____0_CM 0. 100. DISPLAY_IDENTIFIER IP_MIS_A_FAC_S FORMAT "%3.0"
 /begin AXIS_DESCR COM_AXIS n _CNV_A_R_LINEAR_____10_CM 6 0. 8160. FORMAT "%4.0" AXIS_PTS_REF ldp_n__mis_a_fac_s /end AXIS_DESCR
 /begin AXIS_DESCR COM_AXIS load_mis_2 _CNV_A_R_LINEAR_____571_CM 6 0. 99.99694824 AXIS_PTS_REF ldp_load_mis_2__mis_a_fac_s /end AXIS_DESCR
/end CHARACTERISTIC
/begin AXIS_PTS ldp_n__mis_a_fac_afl "" 0xffe43e90 n _REC_AXS_20_u2 8160. _CNV_A_R_LINEAR_____10_CM 6 0. 8160. DISPLAY_IDENTIFIER LDP_N__MIS_A_FAC_AFL FORMAT "%4.0" /end AXIS_PTS
/begin AXIS_PTS ldp_n__mis_a_fac_afs "" 0xffe43e9e n _REC_AXS_20_u2 8160. _CNV_A_R_LINEAR_____10_CM 6 0. 8160. DISPLAY_IDENTIFIER LDP_N__MIS_A_FAC_AFS FORMAT "%4.0" /end AXIS_PTS
/begin AXIS_PTS ldp_n__mis_a_fac_s "" 0xffe43eac n _REC_AXS_20_u2 8160. _CNV_A_R_LINEAR_____10_CM 6 0. 8160. DISPLAY_IDENTIFIER LDP_N__MIS_A_FAC_S FORMAT "%4.0" /end AXIS_PTS
/begin AXIS_PTS ldp_load_mis__fac_er_afs_diag "" 0xffe43cde load_mis _REC_AXS_20_u2 99.99694824000001 _CNV_A_R_LINEAR_____571_CM 6 0. 99.99694824 DISPLAY_IDENTIFIER LDP_LOAD_MIS__FAC_ER_AFS_DIAG /end AXIS_PTS
/begin AXIS_PTS ldp_load_mis__fac_er_afl_diag "" 0xffe43cd0 load_mis _REC_AXS_20_u2 99.99694824000001 _CNV_A_R_LINEAR_____571_CM 6 0. 99.99694824 DISPLAY_IDENTIFIER LDP_LOAD_MIS__FAC_ER_AFL_DIAG /end AXIS_PTS
/begin MEASUREMENT mis_a_fac "Catalyst damage weighting factor to increment cylinder specific counters when misfire is detected" UBYTE _CNV_A_R_LINEAR_____0_CM 1 100. 0. 100. DISPLAY_IDENTIFIER MIS_A_FAC ECU_ADDRESS 0x3fe582 FORMAT "%3.0" /end MEASUREMENT
/begin MEASUREMENT mis_a_fac_buf[0] "Catalyst damage weighting factor buffer" UBYTE _CNV_A_R_LINEAR_____0_CM 1 100. 0. 100. DISPLAY_IDENTIFIER MIS_A_FAC_BUF_0 ECU_ADDRESS 0x3fe590 FORMAT "%3.0" /end MEASUREMENT
/begin MEASUREMENT mis_a_fac_buf[1] "Catalyst damage weighting factor buffer" UBYTE _CNV_A_R_LINEAR_____0_CM 1 100. 0. 100. DISPLAY_IDENTIFIER MIS_A_FAC_BUF_1 ECU_ADDRESS 0x3fe591 FORMAT "%3.0" /end MEASUREMENT
/begin MEASUREMENT mis_a_fac_buf[2] "Catalyst damage weighting factor buffer" UBYTE _CNV_A_R_LINEAR_____0_CM 1 100. 0. 100. DISPLAY_IDENTIFIER MIS_A_FAC_BUF_2 ECU_ADDRESS 0x3fe592 FORMAT "%3.0" /end MEASUREMENT
/begin MEASUREMENT mis_a_fac_buf[3] "Catalyst damage weighting factor buffer" UBYTE _CNV_A_R_LINEAR_____0_CM 1 100. 0. 100. DISPLAY_IDENTIFIER MIS_A_FAC_BUF_3 ECU_ADDRESS 0x3fe593 FORMAT "%3.0" /end MEASUREMENT
/begin MEASUREMENT mis_a_fac_buf[4] "Catalyst damage weighting factor buffer" UBYTE _CNV_A_R_LINEAR_____0_CM 1 100. 0. 100. DISPLAY_IDENTIFIER MIS_A_FAC_BUF_4 ECU_ADDRESS 0x3fe594 FORMAT "%3.0" /end MEASUREMENT
/begin MEASUREMENT mis_a_fac_buf[5] "Catalyst damage weighting factor buffer" UBYTE _CNV_A_R_LINEAR_____0_CM 1 100. 0. 100. DISPLAY_IDENTIFIER MIS_A_FAC_BUF_5 ECU_ADDRESS 0x3fe595 FORMAT "%3.0" /end MEASUREMENT
/begin MEASUREMENT lv_cdn_mis_b1 "CARB B1  misfire criterion monitoring condition" UBYTE _CNV_S_2_RANGE______21_CM 1 100. 0. 1. DISPLAY_IDENTIFIER LV_CDN_MIS_B1 ECU_ADDRESS 0x3fe584 /end MEASUREMENT
/begin MEASUREMENT lv_cdn_mis_a "CARB A misfire criterion monitoring condition" UBYTE _CNV_S_2_RANGE______21_CM 1 100. 0. 1. DISPLAY_IDENTIFIER LV_CDN_MIS_A ECU_ADDRESS 0x3fe583 /end MEASUREMENT
/begin MEASUREMENT lv_cdn_mis_b4 "CARB B4 misfire criterion monitoring condition" UBYTE _CNV_S_2_RANGE______21_CM 1 100. 0. 1. DISPLAY_IDENTIFIER LV_CDN_MIS_B4 ECU_ADDRESS 0x3fe585 /end MEASUREMENT
/begin MEASUREMENT lv_mis_state_b "Project specific name for misfire carb B detected, debounced" UBYTE _CNV_S_2_RANGE______21_CM 1 100. 0. 1. DISPLAY_IDENTIFIER LV_MIS_STATE_B ECU_ADDRESS 0x3fe586 /end MEASUREMENT
/begin MEASUREMENT lv_det_cfm_mis "Flag for individual confirmed misfire detection after crossed diagnosis" UBYTE _CNV_S_2_RANGE______21_CM 1 100. 0. 1. DISPLAY_IDENTIFIER LV_DET_CFM_MIS ECU_ADDRESS 0x3fe587 /end MEASUREMENT
/begin MEASUREMENT lv_err_mis_mpl "Present error flag multiple cylinder misfire" UBYTE _CNV_S_2_RANGE______1_R_CM 1 100. 0. 255. DISPLAY_IDENTIFIER LV_ERR_MIS_MPL ECU_ADDRESS 0x3fb9e4 /end MEASUREMENT
/begin MEASUREMENT lv_err_mis_1 "Present error flag specific cylinder misfire 1" UBYTE _CNV_S_2_RANGE______1_R_CM 1 100. 0. 255. DISPLAY_IDENTIFIER LV_ERR_MIS_1 ECU_ADDRESS 0x3fb9cc /end MEASUREMENT
/begin MEASUREMENT lv_err_mis_2 "Present error flag specific cylinder misfire 2" UBYTE _CNV_S_2_RANGE______1_R_CM 1 100. 0. 255. DISPLAY_IDENTIFIER LV_ERR_MIS_2 ECU_ADDRESS 0x3fb9d0 /end MEASUREMENT
/begin MEASUREMENT lv_err_mis_3 "Present error flag specific cylinder misfire 3" UBYTE _CNV_S_2_RANGE______1_R_CM 1 100. 0. 255. DISPLAY_IDENTIFIER LV_ERR_MIS_3 ECU_ADDRESS 0x3fb9d4 /end MEASUREMENT
/begin MEASUREMENT lv_err_mis_4 "Present error flag specific cylinder misfire 4" UBYTE _CNV_S_2_RANGE______1_R_CM 1 100. 0. 255. DISPLAY_IDENTIFIER LV_ERR_MIS_4 ECU_ADDRESS 0x3fb9d8 /end MEASUREMENT
/begin MEASUREMENT lv_err_mis_5 "Present error flag specific cylinder misfire 5" UBYTE _CNV_S_2_RANGE______1_R_CM 1 100. 0. 255. DISPLAY_IDENTIFIER LV_ERR_MIS_5 ECU_ADDRESS 0x3fb9dc /end MEASUREMENT
/begin MEASUREMENT lv_err_mis_0 "Present error flag specific cylinder misfire 0" UBYTE _CNV_S_2_RANGE______1_R_CM 1 100. 0. 255. DISPLAY_IDENTIFIER LV_ERR_MIS_0 ECU_ADDRESS 0x3fb9c8 /end MEASUREMENT
/begin MEASUREMENT load_max_scdn_mis "Maximal load of similar condition window for LV_ERR_MIS_x" UBYTE _CNV_A_R_LINEAR_____9_CM 1 100. 0. 99.609375 DISPLAY_IDENTIFIER LOAD_MAX_SCDN_MIS ECU_ADDRESS 0x3fe58e /end MEASUREMENT
/begin MEASUREMENT load_min_scdn_mis "Minimal load of similar condition window for LV_ERR_MIS_x" UBYTE _CNV_A_R_LINEAR_____9_CM 1 100. 0. 99.609375 DISPLAY_IDENTIFIER LOAD_MIN_SCDN_MIS ECU_ADDRESS 0x3fe58f /end MEASUREMENT
/begin MEASUREMENT n_min_scdn_mis "Maximal engine speed of similar condition window for LV_ERR_MIS_x" UWORD _CNV_A_R_LINEAR_____10_CM 1 100. 0. 8160. DISPLAY_IDENTIFIER N_MIN_SCDN_MIS ECU_ADDRESS 0x3fe58c BYTE_ORDER MSB_LAST FORMAT "%4.0" /end MEASUREMENT
/begin MEASUREMENT n_max_scdn_mis "Minimal engine speed of similar condition window for LV_ERR_MIS_x" UWORD _CNV_A_R_LINEAR_____10_CM 1 100. 0. 8160. DISPLAY_IDENTIFIER N_MAX_SCDN_MIS ECU_ADDRESS 0x3fe58a BYTE_ORDER MSB_LAST FORMAT "%4.0" /end MEASUREMENT
/begin MEASUREMENT sf_1_mon2.bf.lv_tqi_mon_act_mon2_sf "" ULONG _CNV_S_2_RANGE______2_CM 1 100. 0. 1. DISPLAY_IDENTIFIER LV_TQI_MON_ACT_MON2 ECU_ADDRESS 0x3fd030 BYTE_ORDER MSB_LAST BIT_MASK 0x10000 /end MEASUREMENT
/begin MEASUREMENT sf_1_mon2.bf.lv_n_lim_etc_mon2_sf "" ULONG _CNV_S_2_RANGE______2_CM 1 100. 0. 1. DISPLAY_IDENTIFIER LV_N_LIM_ETC_MON2 ECU_ADDRESS 0x3fd030 BYTE_ORDER MSB_LAST BIT_MASK 0x20000 /end MEASUREMENT
/begin MEASUREMENT sf_1_mon2.bf.lv_err_conv_mon2_sf "" ULONG _CNV_S_2_RANGE______2_CM 1 100. 0. 1. DISPLAY_IDENTIFIER LV_ERR_CONV_MON2 ECU_ADDRESS 0x3fd030 BYTE_ORDER MSB_LAST BIT_MASK 0x40000 /end MEASUREMENT
/begin MEASUREMENT sf_1_mon2.bf.lv_err_n_32_mon2_sf "" ULONG _CNV_S_2_RANGE______2_CM 1 100. 0. 1. DISPLAY_IDENTIFIER LV_ERR_N_32_MON2 ECU_ADDRESS 0x3fd030 BYTE_ORDER MSB_LAST BIT_MASK 0x80000 /end MEASUREMENT
/begin MEASUREMENT sf_1_mon2.bf.lv_err_tq_dif_p_d_is_mon2_sf "" ULONG _CNV_S_2_RANGE______2_CM 1 100. 0. 1. DISPLAY_IDENTIFIER LV_ERR_TQ_DIF_P_D_IS_MON2 ECU_ADDRESS 0x3fd030 BYTE_ORDER MSB_LAST BIT_MASK 0x100000 /end MEASUREMENT
/begin MEASUREMENT sf_1_mon2.bf.lv_err_tq_dif_i_is_mon2_sf "" ULONG _CNV_S_2_RANGE______2_CM 1 100. 0. 1. DISPLAY_IDENTIFIER LV_ERR_TQ_DIF_I_IS_MON2 ECU_ADDRESS 0x3fd030 BYTE_ORDER MSB_LAST BIT_MASK 0x200000 /end MEASUREMENT
/begin MEASUREMENT sf_1_mon2.bf.lv_err_tq_loss_mon2_sf "" ULONG _CNV_S_2_RANGE______2_CM 1 100. 0. 1. DISPLAY_IDENTIFIER LV_ERR_TQ_LOSS_MON2 ECU_ADDRESS 0x3fd030 BYTE_ORDER MSB_LAST BIT_MASK 0x400000 /end MEASUREMENT
/begin MEASUREMENT sf_1_mon2.bf.lv_err_tq_min_clu_mon2_sf "" ULONG _CNV_S_2_RANGE______2_CM 1 100. 0. 1. DISPLAY_IDENTIFIER LV_ERR_TQ_MIN_CLU_MON2 ECU_ADDRESS 0x3fd030 BYTE_ORDER MSB_LAST BIT_MASK 0x800000 /end MEASUREMENT
/begin MEASUREMENT sf_1_mon2.bf.lv_err_tq_max_clu_mon2_sf "" ULONG _CNV_S_2_RANGE______2_CM 1 100. 0. 1. DISPLAY_IDENTIFIER LV_ERR_TQ_MAX_CLU_MON2 ECU_ADDRESS 0x3fd030 BYTE_ORDER MSB_LAST BIT_MASK 0x1000000 /end MEASUREMENT
/begin MEASUREMENT sf_1_mon2.bf.lv_err_pvs_mon2_sf "" ULONG _CNV_S_2_RANGE______2_CM 1 100. 0. 1. DISPLAY_IDENTIFIER LV_ERR_PVS_MON2 ECU_ADDRESS 0x3fd030 BYTE_ORDER MSB_LAST BIT_MASK 0x2000000 /end MEASUREMENT
/begin MEASUREMENT sf_1_mon2.bf.lv_err_tps_mon2_sf "" ULONG _CNV_S_2_RANGE______2_CM 1 100. 0. 1. DISPLAY_IDENTIFIER LV_ERR_TPS_MON2 ECU_ADDRESS 0x3fd030 BYTE_ORDER MSB_LAST BIT_MASK 0x4000000 /end MEASUREMENT
/begin MEASUREMENT sf_1_mon2.bf.lv_err_maf_mon2_sf "" ULONG _CNV_S_2_RANGE______2_CM 1 100. 0. 1. DISPLAY_IDENTIFIER LV_ERR_MAF_MON2 ECU_ADDRESS 0x3fd030 BYTE_ORDER MSB_LAST BIT_MASK 0x8000000 /end MEASUREMENT
/begin MEASUREMENT sf_1_mon2.word "" UWORD _CNV_A_R_LINEAR_____0_CM 1 100. 0. 65535. DISPLAY_IDENTIFIER SF_1_MON2 ECU_ADDRESS 0x3fd030 BYTE_ORDER MSB_LAST FORMAT "%5.0" /end MEASUREMENT
/begin MEASUREMENT sf_2_mon2.bf.val_mo3_pwr_stag_dis_mc_mon2_sf "" ULONG _CNV_S_2_RANGE______2_CM 1 100. 0. 1. DISPLAY_IDENTIFIER LV_ERR_TMP_MU_MON2 ECU_ADDRESS 0x3fd02c BYTE_ORDER MSB_LAST BIT_MASK 0x400000 /end MEASUREMENT
/begin MEASUREMENT sf_2_mon2.bf.lv_err_tran_ena_mon2_sf "" ULONG _CNV_S_2_RANGE______2_CM 1 100. 0. 1. DISPLAY_IDENTIFIER LV_ERR_TRAN_ENA_MON2 ECU_ADDRESS 0x3fd02c BYTE_ORDER MSB_LAST BIT_MASK 0x800000 /end MEASUREMENT
/begin MEASUREMENT sf_2_mon2.bf.lv_n_lim_req_mon2_sf "" ULONG _CNV_S_2_RANGE______2_CM 1 100. 0. 1. DISPLAY_IDENTIFIER LV_N_LIM_REQ_MON2 ECU_ADDRESS 0x3fd02c BYTE_ORDER MSB_LAST BIT_MASK 0x4000000 /end MEASUREMENT
/begin MEASUREMENT sf_2_mon2.bf.lv_off_mtc_iv_mu_mon2_sf "" ULONG _CNV_S_2_RANGE______2_CM 1 100. 0. 1. DISPLAY_IDENTIFIER LV_OFF_MTC_IV_MU_MON2 ECU_ADDRESS 0x3fd02c BYTE_ORDER MSB_LAST BIT_MASK 0x8000000 /end MEASUREMENT
/begin MEASUREMENT sf_2_mon2.bf.lv_off_iv_mon2_sf "" ULONG _CNV_S_2_RANGE______2_CM 1 100. 0. 1. DISPLAY_IDENTIFIER LV_OFF_IV_MON2 ECU_ADDRESS 0x3fd02c BYTE_ORDER MSB_LAST BIT_MASK 0x10000000 /end MEASUREMENT
/begin MEASUREMENT sf_2_mon2.bf.lv_off_mtc_mon2_sf "" ULONG _CNV_S_2_RANGE______2_CM 1 100. 0. 1. DISPLAY_IDENTIFIER LV_OFF_MTC_MON2 ECU_ADDRESS 0x3fd02c BYTE_ORDER MSB_LAST BIT_MASK 0x20000000 /end MEASUREMENT
/begin MEASUREMENT sf_2_mon2.bf.lv_err_tqi_av_mon2_sf "" ULONG _CNV_S_2_RANGE______2_CM 1 100. 0. 1. DISPLAY_IDENTIFIER LV_ERR_TQI_AV_MON2 ECU_ADDRESS 0x3fd02c BYTE_ORDER MSB_LAST BIT_MASK 0x40000000 /end MEASUREMENT
/begin MEASUREMENT sf_2_mon2.bf.lv_err_tqi_n_max_mon2_sf "" ULONG _CNV_S_2_RANGE______2_CM 1 100. 0. 1. DISPLAY_IDENTIFIER LV_ERR_TQI_N_MAX_MON2 ECU_ADDRESS 0x3fd02c BYTE_ORDER MSB_LAST BIT_MASK 0x80000000 /end MEASUREMENT
/begin MEASUREMENT sf_2_mon2.word "" UWORD _CNV_A_R_LINEAR_____0_CM 1 100. 0. 65535. DISPLAY_IDENTIFIER SF_2_MON2 ECU_ADDRESS 0x3fd02c BYTE_ORDER MSB_LAST FORMAT "%5.0" /end MEASUREMENT
/begin MEASUREMENT state_iv_mon2.bf.lv_prev_state_iv0_mon2_sf "" ULONG _CNV_S_2_RANGE______2_CM 1 100. 0. 1. DISPLAY_IDENTIFIER LV_PREV_STATE_IV0_MON2 ECU_ADDRESS 0x3fd034 BYTE_ORDER MSB_LAST BIT_MASK 0x10000 /end MEASUREMENT
/begin MEASUREMENT state_iv_mon2.bf.lv_prev_state_iv1_mon2_sf "" ULONG _CNV_S_2_RANGE______2_CM 1 100. 0. 1. DISPLAY_IDENTIFIER LV_PREV_STATE_IV1_MON2 ECU_ADDRESS 0x3fd034 BYTE_ORDER MSB_LAST BIT_MASK 0x20000 /end MEASUREMENT
/begin MEASUREMENT state_iv_mon2.bf.lv_prev_state_iv2_mon2_sf "" ULONG _CNV_S_2_RANGE______2_CM 1 100. 0. 1. DISPLAY_IDENTIFIER LV_PREV_STATE_IV2_MON2 ECU_ADDRESS 0x3fd034 BYTE_ORDER MSB_LAST BIT_MASK 0x40000 /end MEASUREMENT
/begin MEASUREMENT state_iv_mon2.bf.lv_prev_state_iv3_mon2_sf "" ULONG _CNV_S_2_RANGE______2_CM 1 100. 0. 1. DISPLAY_IDENTIFIER LV_PREV_STATE_IV3_MON2 ECU_ADDRESS 0x3fd034 BYTE_ORDER MSB_LAST BIT_MASK 0x80000 /end MEASUREMENT
/begin MEASUREMENT state_iv_mon2.bf.lv_prev_state_iv4_mon2_sf "" ULONG _CNV_S_2_RANGE______2_CM 1 100. 0. 1. DISPLAY_IDENTIFIER LV_PREV_STATE_IV4_MON2 ECU_ADDRESS 0x3fd034 BYTE_ORDER MSB_LAST BIT_MASK 0x100000 /end MEASUREMENT
/begin MEASUREMENT state_iv_mon2.bf.lv_prev_state_iv5_mon2_sf "" ULONG _CNV_S_2_RANGE______2_CM 1 100. 0. 1. DISPLAY_IDENTIFIER LV_PREV_STATE_IV5_MON2 ECU_ADDRESS 0x3fd034 BYTE_ORDER MSB_LAST BIT_MASK 0x200000 /end MEASUREMENT
/begin MEASUREMENT state_iv_mon2.word "" UWORD _CNV_A_R_LINEAR_____0_CM 1 100. 0. 65535. DISPLAY_IDENTIFIER STATE_IV_MON2 ECU_ADDRESS 0x3fd034 BYTE_ORDER MSB_LAST FORMAT "%5.0" /end MEASUREMENT
/begin CHARACTERISTIC c_n_max_mtc_lih_thd_mon2 "" VALUE 0xffe407e9 _REC_VAL_20_u1 8160. _CNV_A_R_LINEAR_____15_CM 0. 8160. DISPLAY_IDENTIFIER C_N_MAX_MTC_LIH_THD_MON2 FORMAT "%4.0" /end CHARACTERISTIC
/begin CHARACTERISTIC c_tqi_sp_dec_max_mon2 "" VALUE 0xffe4098d _REC_VAL_20_u1 31.875 _CNV_A_R_LINEAR_____531_CM 0. 31.875 DISPLAY_IDENTIFIER C_TQI_SP_DEC_MAX_MON2 FORMAT "%5.2" /end CHARACTERISTIC
/begin CHARACTERISTIC c_t_tqi_mon2 "" VALUE 0xffe408d2 _REC_VAL_20_u1 10.2 _CNV_A_R_LINEAR_____41_CM 0. 10.2 DISPLAY_IDENTIFIER C_T_TQI_MON2 FORMAT "%5.2" /end CHARACTERISTIC
/begin CHARACTERISTIC c_iga_ref_egr_cor_lim_mon2 "maximum permitted ignition angle correction for EGR active" VALUE 0xffe4038d _REC_VAL_20_s1 95.625 _CNV_A_R_LINEAR_____82_CM -48. 47.625 DISPLAY_IDENTIFIER C_IGA_REF_EGR_COR_LIM_MON2 FORMAT "%5.1" /end CHARACTERISTIC
/begin CHARACTERISTIC lc_val_mo2_ans "" VALUE 0xffe41004 _REC_VAL_20_u1 1. _CNV_A_R_LINEAR_____0_CM 0. 1. DISPLAY_IDENTIFIER LC_VAL_MO2_ANS FORMAT "%2.0" /end CHARACTERISTIC
/begin CHARACTERISTIC id_n_32_mon2__idx "Motordrehzahl" CURVE 0xffe44168 _REC_CUR_20_u1_u1 8160. _CNV_A_R_LINEAR_____15_CM 0. 8160. DISPLAY_IDENTIFIER ID_N_32_MON2__IDX FORMAT "%4.0"
 /begin AXIS_DESCR COM_AXIS val_mo3_tst_rec_idx_mo2 _CNV_A_R_LINEAR_____0_CM 12 0. 11. FORMAT "%2.0" AXIS_PTS_REF ldpm_val_mo3_tst_rec_idx_mo2 /end AXIS_DESCR
/end CHARACTERISTIC
/begin CHARACTERISTIC id_sf_2_mon2__idx "Logische Startwerte Tabelle 2" CURVE 0xffe48d40 _REC_CUR_20_u2_u1 65535. _CNV_A_R_LINEAR_____0_CM 0. 65535. DISPLAY_IDENTIFIER ID_SF_2_MON2__IDX FORMAT "%5.0"
 /begin AXIS_DESCR COM_AXIS val_mo3_tst_rec_idx_mo2 _CNV_A_R_LINEAR_____0_CM 12 0. 11. FORMAT "%2.0" AXIS_PTS_REF ldpm_val_mo3_tst_rec_idx_mo2 /end AXIS_DESCR
/end CHARACTERISTIC
/begin CHARACTERISTIC ip_tqi_dif_max_mon2 "Diagnoseschwelle Drehmomentenüberlauf (Prozesskontrolle 2)" MAP 0xffe47e8f _REC_MAP_20_u1_u1_u1 510. _CNV_A_R_LINEAR_____101_CM 0. 510. DISPLAY_IDENTIFIER IP_TQI_DIF_MAX_MON2 FORMAT "%3.0"
 /begin AXIS_DESCR COM_AXIS n_32_mon2 _CNV_A_R_LINEAR_____15_CM 4 0. 8160. FORMAT "%4.0" AXIS_PTS_REF ldp_n_32__tqi_dif_max_mon2 /end AXIS_DESCR
 /begin AXIS_DESCR COM_AXIS tqi_sp_mon2 _CNV_A_R_LINEAR_____101_CM 4 0. 510. FORMAT "%3.0" AXIS_PTS_REF ldp_tqi_sp__tqi_dif_max_mon2 /end AXIS_DESCR
/end CHARACTERISTIC
/begin CHARACTERISTIC id_tq_max_clu_mon2__idx "Monitored maximum torque at clutch" CURVE 0xffe43f9c _REC_CUR_20_s2_u1 2047.96875 _CNV_A_R_LINEAR_____55_CM -1024. 1023.96875 DISPLAY_IDENTIFIER ID_TQ_MAX_CLU_MON2__IDX FORMAT "%8.2"
 /begin AXIS_DESCR COM_AXIS val_mo3_tst_rec_idx_mo2 _CNV_A_R_LINEAR_____0_CM 12 0. 11. FORMAT "%2.0" AXIS_PTS_REF ldpm_val_mo3_tst_rec_idx_mo2 /end AXIS_DESCR
/end CHARACTERISTIC
/begin CHARACTERISTIC id_state_iv_mon2__idx "Status der Einspritzventile im letzten Zyklus" CURVE 0xffe48d58 _REC_CUR_20_u2_u1 65535. _CNV_A_R_LINEAR_____0_CM 0. 65535. DISPLAY_IDENTIFIER ID_STATE_IV_MON2__IDX FORMAT "%5.0"
 /begin AXIS_DESCR COM_AXIS val_mo3_tst_rec_idx_mo2 _CNV_A_R_LINEAR_____0_CM 12 0. 11. FORMAT "%2.0" AXIS_PTS_REF ldpm_val_mo3_tst_rec_idx_mo2 /end AXIS_DESCR
/end CHARACTERISTIC
/begin CHARACTERISTIC id_iga_ref_egr_cor_mon2__idx "Ignition angle correction for EGR" CURVE 0xffe43f10 _REC_CUR_20_s1_u1 95.625 _CNV_A_R_LINEAR_____82_CM -48. 47.625 DISPLAY_IDENTIFIER ID_IGA_REF_EGR_COR_MON2__IDX FORMAT "%5.1"
 /begin AXIS_DESCR COM_AXIS val_mo3_tst_rec_idx_mo2 _CNV_A_R_LINEAR_____0_CM 12 0. 11. FORMAT "%2.0" AXIS_PTS_REF ldpm_val_mo3_tst_rec_idx_mo2 /end AXIS_DESCR
/end CHARACTERISTIC
/begin CHARACTERISTIC id_t_tqi_mon2__idx "Totzeit für Verzögerung des Sollmoments" CURVE 0xffe4435a _REC_CUR_20_u1_u1 10.2 _CNV_A_R_LINEAR_____41_CM 0. 10.2 DISPLAY_IDENTIFIER ID_T_TQI_MON2__IDX FORMAT "%5.2"
 /begin AXIS_DESCR COM_AXIS val_mo3_tst_rec_idx_mo2 _CNV_A_R_LINEAR_____0_CM 12 0. 11. FORMAT "%2.0" AXIS_PTS_REF ldpm_val_mo3_tst_rec_idx_mo2 /end AXIS_DESCR
/end CHARACTERISTIC
/begin CHARACTERISTIC id_tqi_sp_mon2__idx "Sollmoment" CURVE 0xffe4440e _REC_CUR_20_u1_u1 510. _CNV_A_R_LINEAR_____101_CM 0. 510. DISPLAY_IDENTIFIER ID_TQI_SP_MON2__IDX FORMAT "%3.0"
 /begin AXIS_DESCR COM_AXIS val_mo3_tst_rec_idx_mo2 _CNV_A_R_LINEAR_____0_CM 12 0. 11. FORMAT "%2.0" AXIS_PTS_REF ldpm_val_mo3_tst_rec_idx_mo2 /end AXIS_DESCR
/end CHARACTERISTIC
/begin CHARACTERISTIC id_abc_tqi_av_mon2__idx "Entprellzähler für Überwachung des aktuell indizierten Motormoments" CURVE 0xffe43fcc _REC_CUR_20_u1_u1 255. _CNV_A_R_LINEAR_____0_CM 0. 255. DISPLAY_IDENTIFIER ID_ABC_TQI_AV_MON2__IDX FORMAT "%3.0"
 /begin AXIS_DESCR COM_AXIS val_mo3_tst_rec_idx_mo2 _CNV_A_R_LINEAR_____0_CM 12 0. 11. FORMAT "%2.0" AXIS_PTS_REF ldpm_val_mo3_tst_rec_idx_mo2 /end AXIS_DESCR
/end CHARACTERISTIC
/begin CHARACTERISTIC ip_fac_tq_req_driv_mon2 "Scaling factor for requested torque at clutch from driver" MAP 0xffe45a5c _REC_MAP_20_u1_u1_u1 1.9921875 _CNV_A_R_LINEAR_____117_CM 0. 1.9921875 DISPLAY_IDENTIFIER IP_FAC_TQ_REQ_DRIV_MON2 FORMAT "%5.3"
 /begin AXIS_DESCR COM_AXIS n_32_mon2 _CNV_A_R_LINEAR_____15_CM 8 0. 8160. FORMAT "%4.0" AXIS_PTS_REF ldp_n_32__fac_tq_req_driv_mon2 /end AXIS_DESCR
 /begin AXIS_DESCR COM_AXIS pv_av_mon2 _CNV_A_R_LINEAR_____9_CM 8 0. 99.609375 FORMAT "%5.2" AXIS_PTS_REF ldp_pv_av__fac_tq_req_driv_mon2 /end AXIS_DESCR
/end CHARACTERISTIC
/begin CHARACTERISTIC ip_tqi_ref_mon2 "" MAP 0xffe47e9f _REC_MAP_20_u1_u1_u1 510. _CNV_A_R_LINEAR_____101_CM 0. 510. DISPLAY_IDENTIFIER IP_TQI_REF_MON2 FORMAT "%3.0"
 /begin AXIS_DESCR COM_AXIS n_32_mon2 _CNV_A_R_LINEAR_____15_CM 6 0. 8160. FORMAT "%4.0" AXIS_PTS_REF ldp_n_32__tqi_ref_mon2 /end AXIS_DESCR
 /begin AXIS_DESCR COM_AXIS maf_mon2 _CNV_A_R_LINEAR_____27_CM 8 0. 1389. FORMAT "%4.0" AXIS_PTS_REF ldp_maf__tqi_ref_mon2 /end AXIS_DESCR
/end CHARACTERISTIC
/begin CHARACTERISTIC id_abc_tqi_n_max_mon2__idx "Entprellzähler für Überwachung der Drehzahlbegrenzung" CURVE 0xffe43fd8 _REC_CUR_20_u1_u1 255. _CNV_A_R_LINEAR_____0_CM 0. 255. DISPLAY_IDENTIFIER ID_ABC_TQI_N_MAX_MON2__IDX FORMAT "%3.0"
 /begin AXIS_DESCR COM_AXIS val_mo3_tst_rec_idx_mo2 _CNV_A_R_LINEAR_____0_CM 12 0. 11. FORMAT "%2.0" AXIS_PTS_REF ldpm_val_mo3_tst_rec_idx_mo2 /end AXIS_DESCR
/end CHARACTERISTIC
/begin CHARACTERISTIC ip_eff_iga_mon2 "" CURVE 0xffe40b0f _REC_CUR_20_u1_u1 1.9921875 _CNV_A_R_LINEAR_____117_CM 0. 1.9921875 DISPLAY_IDENTIFIER IP_EFF_IGA_MON2 FORMAT "%5.3"
 /begin AXIS_DESCR COM_AXIS iga_dif_av _CNV_A_R_LINEAR_____204_CM 8 0. -95.625 FORMAT "%6.2" AXIS_PTS_REF ldp_iga_dif_av__eff_iga_mon2 /end AXIS_DESCR
/end CHARACTERISTIC
/begin CHARACTERISTIC id_tq_dif_p_d_is_mon2__idx "P- and D- controller output for idle speed control" CURVE 0xffe43f3c _REC_CUR_20_s2_u1 2047.96875 _CNV_A_R_LINEAR_____55_CM -1024. 1023.96875 DISPLAY_IDENTIFIER ID_TQ_DIF_P_D_IS_MON2__IDX FORMAT "%8.2"
 /begin AXIS_DESCR COM_AXIS val_mo3_tst_rec_idx_mo2 _CNV_A_R_LINEAR_____0_CM 12 0. 11. FORMAT "%2.0" AXIS_PTS_REF ldpm_val_mo3_tst_rec_idx_mo2 /end AXIS_DESCR
/end CHARACTERISTIC
/begin CHARACTERISTIC id_tq_egs_mon2__idx "Torque demand from EGS" CURVE 0xffe43f54 _REC_CUR_20_s2_u1 2047.96875 _CNV_A_R_LINEAR_____55_CM -1024. 1023.96875 DISPLAY_IDENTIFIER ID_TQ_EGS_MON2__IDX FORMAT "%8.2"
 /begin AXIS_DESCR COM_AXIS val_mo3_tst_rec_idx_mo2 _CNV_A_R_LINEAR_____0_CM 12 0. 11. FORMAT "%2.0" AXIS_PTS_REF ldpm_val_mo3_tst_rec_idx_mo2 /end AXIS_DESCR
/end CHARACTERISTIC
/begin CHARACTERISTIC id_iga_igc_mon2__idx "Zündwinkel" CURVE 0xffe44110 _REC_CUR_20_u1_u1 95.625 _CNV_A_R_LINEAR_____203_CM -35.625 60. DISPLAY_IDENTIFIER ID_IGA_IGC_MON2__IDX FORMAT "%5.1"
 /begin AXIS_DESCR COM_AXIS val_mo3_tst_rec_idx_mo2 _CNV_A_R_LINEAR_____0_CM 12 0. 11. FORMAT "%2.0" AXIS_PTS_REF ldpm_val_mo3_tst_rec_idx_mo2 /end AXIS_DESCR
/end CHARACTERISTIC
/begin CHARACTERISTIC id_tq_esp_mon2__idx "Torque demand from EPS" CURVE 0xffe43f6c _REC_CUR_20_s2_u1 2047.96875 _CNV_A_R_LINEAR_____55_CM -1024. 1023.96875 DISPLAY_IDENTIFIER ID_TQ_ESP_MON2__IDX FORMAT "%8.2"
 /begin AXIS_DESCR COM_AXIS val_mo3_tst_rec_idx_mo2 _CNV_A_R_LINEAR_____0_CM 12 0. 11. FORMAT "%2.0" AXIS_PTS_REF ldpm_val_mo3_tst_rec_idx_mo2 /end AXIS_DESCR
/end CHARACTERISTIC
/begin CHARACTERISTIC id_maf_mon2__idx "Luftmasse" CURVE 0xffe4415c _REC_CUR_20_u1_u1 1389. _CNV_A_R_LINEAR_____27_CM 0. 1389. DISPLAY_IDENTIFIER ID_MAF_MON2__IDX FORMAT "%4.0"
 /begin AXIS_DESCR COM_AXIS val_mo3_tst_rec_idx_mo2 _CNV_A_R_LINEAR_____0_CM 12 0. 11. FORMAT "%2.0" AXIS_PTS_REF ldpm_val_mo3_tst_rec_idx_mo2 /end AXIS_DESCR
/end CHARACTERISTIC
/begin CHARACTERISTIC id_pv_av_mon2__idx "Pedalwert" CURVE 0xffe441f9 _REC_CUR_20_u1_u1 99.609375 _CNV_A_R_LINEAR_____9_CM 0. 99.609375 DISPLAY_IDENTIFIER ID_PV_AV_MON2__IDX FORMAT "%4.1"
 /begin AXIS_DESCR COM_AXIS val_mo3_tst_rec_idx_mo2 _CNV_A_R_LINEAR_____0_CM 12 0. 11. FORMAT "%2.0" AXIS_PTS_REF ldpm_val_mo3_tst_rec_idx_mo2 /end AXIS_DESCR
/end CHARACTERISTIC
/begin CHARACTERISTIC id_tq_loss_mon2__idx "Torque losses" CURVE 0xffe43f84 _REC_CUR_20_s2_u1 2047.96875 _CNV_A_R_LINEAR_____55_CM -1024. 1023.96875 DISPLAY_IDENTIFIER ID_TQ_LOSS_MON2__IDX FORMAT "%8.2"
 /begin AXIS_DESCR COM_AXIS val_mo3_tst_rec_idx_mo2 _CNV_A_R_LINEAR_____0_CM 12 0. 11. FORMAT "%2.0" AXIS_PTS_REF ldpm_val_mo3_tst_rec_idx_mo2 /end AXIS_DESCR
/end CHARACTERISTIC
/begin CHARACTERISTIC ip_iga_ref_mon2 "Referenz-Zündwinkel (Prozesskontrolle 2)" MAP 0xffe46750 _REC_MAP_20_u1_u1_u1 95.625 _CNV_A_R_LINEAR_____203_CM -35.625 60. DISPLAY_IDENTIFIER IP_IGA_REF_MON2 FORMAT "%5.1"
 /begin AXIS_DESCR COM_AXIS n_32_mon2 _CNV_A_R_LINEAR_____15_CM 8 0. 8160. FORMAT "%4.0" AXIS_PTS_REF ldp_n_32__iga_ref_mon2 /end AXIS_DESCR
 /begin AXIS_DESCR COM_AXIS maf_mon2 _CNV_A_R_LINEAR_____27_CM 8 0. 1389. FORMAT "%4.0" AXIS_PTS_REF ldp_maf__iga_ref_mon2 /end AXIS_DESCR
/end CHARACTERISTIC
/begin CHARACTERISTIC id_sf_1_mon2__idx "Logische Startwerte Tabelle 1" CURVE 0xffe48d28 _REC_CUR_20_u2_u1 65535. _CNV_A_R_LINEAR_____0_CM 0. 65535. DISPLAY_IDENTIFIER ID_SF_1_MON2__IDX FORMAT "%5.0"
 /begin AXIS_DESCR COM_AXIS val_mo3_tst_rec_idx_mo2 _CNV_A_R_LINEAR_____0_CM 12 0. 11. FORMAT "%2.0" AXIS_PTS_REF ldpm_val_mo3_tst_rec_idx_mo2 /end AXIS_DESCR
/end CHARACTERISTIC
/begin CHARACTERISTIC id_tq_min_clu_mon2__idx "Monitored minimum torque at clutch" CURVE 0xffe43fb4 _REC_CUR_20_s2_u1 2047.96875 _CNV_A_R_LINEAR_____55_CM -1024. 1023.96875 DISPLAY_IDENTIFIER ID_TQ_MIN_CLU_MON2__IDX FORMAT "%8.2"
 /begin AXIS_DESCR COM_AXIS val_mo3_tst_rec_idx_mo2 _CNV_A_R_LINEAR_____0_CM 12 0. 11. FORMAT "%2.0" AXIS_PTS_REF ldpm_val_mo3_tst_rec_idx_mo2 /end AXIS_DESCR
/end CHARACTERISTIC
/begin CHARACTERISTIC id_fac_tq_req_cru_mon2__idx "Torque demand from cruise control" CURVE 0xffe440c7 _REC_CUR_20_u1_u1 1.99220002 _CNV_A_R_LINEAR_____39_CM 0. 1.99220002 DISPLAY_IDENTIFIER ID_FAC_TQ_REQ_CRU_MON2__IDX FORMAT "%5.3"
 /begin AXIS_DESCR COM_AXIS val_mo3_tst_rec_idx_mo2 _CNV_A_R_LINEAR_____0_CM 12 0. 11. FORMAT "%2.0" AXIS_PTS_REF ldpm_val_mo3_tst_rec_idx_mo2 /end AXIS_DESCR
/end CHARACTERISTIC
/begin CHARACTERISTIC id_inh_swi_iv_mon2__idx "shut off request for cylinder x" CURVE 0xffe48800 _REC_CUR_20_u2_u1 65535. _CNV_A_R_LINEAR_____0_CM 0. 65535. DISPLAY_IDENTIFIER ID_INH_SWI_IV_MON2__IDX FORMAT "%5.0"
 /begin AXIS_DESCR COM_AXIS val_mo3_tst_rec_idx_mo2 _CNV_A_R_LINEAR_____0_CM 12 0. 11. FORMAT "%2.0" AXIS_PTS_REF ldpm_val_mo3_tst_rec_idx_mo2 /end AXIS_DESCR
/end CHARACTERISTIC
/begin AXIS_PTS ldp_iga_dif_av__eff_iga_mon2 "" 0xffe47f84 iga_dif_av _REC_AXS_20_u1 -95.625 _CNV_A_R_LINEAR_____204_CM 8 0. -95.625 DISPLAY_IDENTIFIER LDP_IGA_DIF_AV__EFF_IGA_MON2 FORMAT "%6.2" /end AXIS_PTS
/begin AXIS_PTS ldp_maf__iga_ref_mon2 "" 0xffe47f9e maf_mon2 _REC_AXS_20_u1 1389. _CNV_A_R_LINEAR_____27_CM 8 0. 1389. DISPLAY_IDENTIFIER LDP_MAF__IGA_REF_MON2 FORMAT "%4.0" /end AXIS_PTS
/begin AXIS_PTS ldp_maf__tqi_ref_mon2 "" 0xffe47fb4 maf_mon2 _REC_AXS_20_u1 1389. _CNV_A_R_LINEAR_____27_CM 8 0. 1389. DISPLAY_IDENTIFIER LDP_MAF__TQI_REF_MON2 FORMAT "%4.0" /end AXIS_PTS
/begin AXIS_PTS ldp_n_32__iga_ref_mon2 "" 0xffe48030 n_32_mon2 _REC_AXS_20_u1 8160. _CNV_A_R_LINEAR_____15_CM 8 0. 8160. DISPLAY_IDENTIFIER LDP_N_32__IGA_REF_MON2 FORMAT "%4.0" /end AXIS_PTS
/begin AXIS_PTS ldp_n_32__tqi_dif_max_mon2 "" 0xffe410d3 n_32_mon2 _REC_AXS_20_u1 8160. _CNV_A_R_LINEAR_____15_CM 4 0. 8160. DISPLAY_IDENTIFIER LDP_N_32__TQI_DIF_MAX_MON2 FORMAT "%4.0" /end AXIS_PTS
/begin AXIS_PTS ldp_n_32__tqi_ref_mon2 "" 0xffe410d8 n_32_mon2 _REC_AXS_20_u1 8160. _CNV_A_R_LINEAR_____15_CM 6 0. 8160. DISPLAY_IDENTIFIER LDP_N_32__TQI_REF_MON2 FORMAT "%4.0" /end AXIS_PTS
/begin AXIS_PTS ldp_tqi_sp__tqi_dif_max_mon2 "" 0xffe412dd tqi_sp_mon2 _REC_AXS_20_u1 510. _CNV_A_R_LINEAR_____101_CM 4 0. 510. DISPLAY_IDENTIFIER LDP_TQI_SP__TQI_DIF_MAX_MON2 FORMAT "%3.0" /end AXIS_PTS
/begin AXIS_PTS ldp_n_32__fac_tq_req_driv_mon2 "" 0xffe4801e n_32_mon2 _REC_AXS_20_u1 8160. _CNV_A_R_LINEAR_____15_CM 8 0. 8160. DISPLAY_IDENTIFIER LDP_N_32__FAC_TQ_REQ_DRIV_MON2 FORMAT "%4.0" /end AXIS_PTS
/begin AXIS_PTS ldp_pv_av__fac_tq_req_driv_mon2 "" 0xffe48170 pv_av_mon2 _REC_AXS_20_u1 99.609375 _CNV_A_R_LINEAR_____9_CM 8 0. 99.609375 DISPLAY_IDENTIFIER LDP_PV_AV__FAC_TQ_REQ_DRIV_MON2 FORMAT "%5.2" /end AXIS_PTS
/begin MEASUREMENT val_mo2_ans_tst "" UWORD _CNV_A_R_LINEAR_____0_CM 1 100. 0. 65535. DISPLAY_IDENTIFIER VAL_MO2_ANS_TST ECU_ADDRESS 0x3fdf9a BYTE_ORDER MSB_LAST FORMAT "%5.0" /end MEASUREMENT
/begin AXIS_PTS ldpm_val_mo3_tst_rec_idx_mo2 "" 0xffe486f4 val_mo3_tst_rec_idx_mo2 _REC_AXS_20_u1 11. _CNV_A_R_LINEAR_____0_CM 12 0. 11. DISPLAY_IDENTIFIER LDPM_VAL_MO3_TST_REC_IDX_MO2 FORMAT "%2.0" /end AXIS_PTS
/begin CHARACTERISTIC id_lv_rng_l_req_mon2__idx "Switch condition of progression" CURVE 0xffe44140 _REC_CUR_20_u1_u1 1. _CNV_A_R_LINEAR_____0_CM 0. 1. DISPLAY_IDENTIFIER ID_LV_RNG_L_REQ_MON2__IDX FORMAT "%2.0"
 /begin AXIS_DESCR COM_AXIS val_mo3_tst_rec_idx_mo2 _CNV_A_R_LINEAR_____0_CM 12 0. 11. FORMAT "%2.0" AXIS_PTS_REF ldpm_val_mo3_tst_rec_idx_mo2 /end AXIS_DESCR
/end CHARACTERISTIC
/begin MEASUREMENT fac_tq_req_mon2 "Scaling factor for requested torque at clutch from driver" UBYTE _CNV_A_R_LINEAR_____39_CM 1 100. 0. 1.99220002 DISPLAY_IDENTIFIER FAC_TQ_REQ_MON2 ECU_ADDRESS 0x3fec7d FORMAT "%5.3" /end MEASUREMENT
/begin MEASUREMENT fac_tq_req_driv_mon2 "Scaling factor for requested torque at clutch from driver" UBYTE _CNV_A_R_LINEAR_____39_CM 1 100. 0. 1.99220002 DISPLAY_IDENTIFIER FAC_TQ_REQ_DRIV_MON2 ECU_ADDRESS 0x3fec7f FORMAT "%5.3" /end MEASUREMENT
/begin CHARACTERISTIC ip_fac_tq_req_driv_rng_l_mon2 "Scaling factor for requested torque at clutch from driver rng_l" MAP 0xffe45a9c _REC_MAP_20_u1_u1_u1 1.9921875 _CNV_A_R_LINEAR_____117_CM 0. 1.9921875 DISPLAY_IDENTIFIER IP_FAC_TQ_REQ_DRIV_RNG_L_MON2 FORMAT "%5.3"
 /begin AXIS_DESCR COM_AXIS n_32_mon2 _CNV_A_R_LINEAR_____15_CM 8 0. 8160. FORMAT "%4.0" AXIS_PTS_REF ldp_n_32__fac_tq_req_driv_mon2 /end AXIS_DESCR
 /begin AXIS_DESCR COM_AXIS pv_av_mon2 _CNV_A_R_LINEAR_____9_CM 8 0. 99.609375 FORMAT "%5.2" AXIS_PTS_REF ldp_pv_av__fac_tq_req_driv_mon2 /end AXIS_DESCR
/end CHARACTERISTIC
/begin MEASUREMENT tq_esp_mon2 "Torque demand from ESP" SWORD _CNV_A_R_LINEAR_____55_CM 1 100. -1024. 1023.96875 DISPLAY_IDENTIFIER TQ_ESP_MON2 ECU_ADDRESS 0x3fdfa0 BYTE_ORDER MSB_LAST FORMAT "%8.2" /end MEASUREMENT
/begin MEASUREMENT tq_loss_mon2 "Torque losses" SWORD _CNV_A_R_LINEAR_____55_CM 1 100. -1024. 1023.96875 DISPLAY_IDENTIFIER TQ_LOSS_MON2 ECU_ADDRESS 0x3fdfa2 BYTE_ORDER MSB_LAST FORMAT "%8.2" /end MEASUREMENT
/begin MEASUREMENT tqi_av_mon2 "" UBYTE _CNV_A_R_LINEAR_____101_CM 1 100. 0. 510. DISPLAY_IDENTIFIER TQI_AV_MON2 ECU_ADDRESS 0x3fec80 FORMAT "%3.0" /end MEASUREMENT
/begin MEASUREMENT pv_av_mon2 "Pedal value" UBYTE _CNV_A_R_LINEAR_____9_CM 1 100. 0. 99.609375 DISPLAY_IDENTIFIER PV_AV_MON2 ECU_ADDRESS 0x3fec76 FORMAT "%4.1" /end MEASUREMENT
/begin MEASUREMENT fac_tq_req_cru_mon2 "Torque demand from cruise control" UBYTE _CNV_A_R_LINEAR_____39_CM 1 100. 0. 1.99220002 DISPLAY_IDENTIFIER FAC_TQ_REQ_CRU_MON2 ECU_ADDRESS 0x3fec77 FORMAT "%5.3" /end MEASUREMENT
/begin MEASUREMENT tq_dif_p_d_is_mon2 "P- and D- controller output for idle speed control" SWORD _CNV_A_R_LINEAR_____55_CM 1 100. -1024. 1023.96875 DISPLAY_IDENTIFIER TQ_DIF_P_D_IS_MON2 ECU_ADDRESS 0x3fdfa8 BYTE_ORDER MSB_LAST FORMAT "%8.2" /end MEASUREMENT
/begin MEASUREMENT tq_min_clu_mon2 "Monitored minimum torque at clutch" SWORD _CNV_A_R_LINEAR_____55_CM 1 100. -1024. 1023.96875 DISPLAY_IDENTIFIER TQ_MIN_CLU_MON2 ECU_ADDRESS 0x3fdfa4 BYTE_ORDER MSB_LAST FORMAT "%8.2" /end MEASUREMENT
/begin MEASUREMENT maf_mon2 "" UBYTE _CNV_A_R_LINEAR_____27_CM 1 100. 0. 1389. DISPLAY_IDENTIFIER MAF_MON2 ECU_ADDRESS 0x3fec79 FORMAT "%4.0" /end MEASUREMENT
/begin MEASUREMENT abc_tqi_av_mon2 "" UBYTE _CNV_A_R_LINEAR_____0_CM 1 100. 0. 255. DISPLAY_IDENTIFIER ABC_TQI_AV_MON2 ECU_ADDRESS 0x3fec86 FORMAT "%3.0" /end MEASUREMENT
/begin MEASUREMENT n_32_mon2 "" UBYTE _CNV_A_R_LINEAR_____15_CM 1 100. 0. 8160. DISPLAY_IDENTIFIER N_32_MON2 ECU_ADDRESS 0x3fec78 FORMAT "%4.0" /end MEASUREMENT
/begin MEASUREMENT tq_max_clu_mon2 "Monitored maximum torque at clutch" SWORD _CNV_A_R_LINEAR_____55_CM 1 100. -1024. 1023.96875 DISPLAY_IDENTIFIER TQ_MAX_CLU_MON2 ECU_ADDRESS 0x3fdfa6 BYTE_ORDER MSB_LAST FORMAT "%8.2" /end MEASUREMENT
/begin MEASUREMENT tqi_dif_max_mon2 "" UBYTE _CNV_A_R_LINEAR_____101_CM 1 100. 0. 510. DISPLAY_IDENTIFIER TQI_DIF_MAX_MON2 ECU_ADDRESS 0x3fec88 FORMAT "%3.0" /end MEASUREMENT
/begin MEASUREMENT iga_ref_egr_cor_mon2 "Ingition angle correction for EGR" SBYTE _CNV_A_R_LINEAR_____82_CM 1 100. -48. 47.625 DISPLAY_IDENTIFIER IGA_REF_EGR_COR_MON2 ECU_ADDRESS 0x3fec8a FORMAT "%5.1" /end MEASUREMENT
/begin MEASUREMENT iga_ref_cor_mon2 "reference ignition angle for torque monitoring (corrected by EGR influence)" UBYTE _CNV_A_R_LINEAR_____203_CM 1 100. -35.625 60. DISPLAY_IDENTIFIER IGA_REF_COR_MON2 ECU_ADDRESS 0x3fec85 FORMAT "%5.1" /end MEASUREMENT
/begin MEASUREMENT tqi_dif_mon2 "" UBYTE _CNV_A_R_LINEAR_____101_CM 1 100. 0. 510. DISPLAY_IDENTIFIER TQI_DIF_MON2 ECU_ADDRESS 0x3fec87 FORMAT "%3.0" /end MEASUREMENT
/begin MEASUREMENT abc_tqi_n_max_mon2 "" UBYTE _CNV_A_R_LINEAR_____0_CM 1 100. 0. 255. DISPLAY_IDENTIFIER ABC_TQI_N_MAX_MON2 ECU_ADDRESS 0x3fec89 FORMAT "%3.0" /end MEASUREMENT
/begin MEASUREMENT tqi_req_tot_mon2 "" UBYTE _CNV_A_R_LINEAR_____101_CM 1 100. 0. 510. DISPLAY_IDENTIFIER TQI_REQ_TOT_MON2 ECU_ADDRESS 0x3fec7c FORMAT "%3.0" /end MEASUREMENT
/begin MEASUREMENT iga_igc_mon2 "" UBYTE _CNV_A_R_LINEAR_____203_CM 1 100. -35.625 60. DISPLAY_IDENTIFIER IGA_IGC_MON2 ECU_ADDRESS 0x3fec7a FORMAT "%5.1" /end MEASUREMENT
/begin MEASUREMENT tqi_sp_mon2 "" UBYTE _CNV_A_R_LINEAR_____101_CM 1 100. 0. 510. DISPLAY_IDENTIFIER TQI_SP_MON2 ECU_ADDRESS 0x3fec7b FORMAT "%3.0" /end MEASUREMENT
/begin MEASUREMENT tq_egs_mon2 "Torque demand from EGS" SWORD _CNV_A_R_LINEAR_____55_CM 1 100. -1024. 1023.96875 DISPLAY_IDENTIFIER TQ_EGS_MON2 ECU_ADDRESS 0x3fdf9e BYTE_ORDER MSB_LAST FORMAT "%8.2" /end MEASUREMENT
/begin MEASUREMENT eff_iga_av_mon2 "actual ignition efficiency for torque monitoring" UBYTE _CNV_A_R_LINEAR_____117_CM 1 100. 0. 1.9921875 DISPLAY_IDENTIFIER EFF_IGA_AV_MON2 ECU_ADDRESS 0x3fec81 FORMAT "%5.3" /end MEASUREMENT
/begin MEASUREMENT eff_scc_av_2_mon2 "actual ignition efficiency for torque monitoring" UBYTE _CNV_A_R_LINEAR_____117_CM 1 100. 0. 1.9921875 DISPLAY_IDENTIFIER EFF_SCC_AV_2_MON2 ECU_ADDRESS 0x3fec83 FORMAT "%5.3" /end MEASUREMENT
/begin MEASUREMENT eff_scc_av_mon2 "actual ignition efficiency for torque monitoring" UBYTE _CNV_A_R_LINEAR_____117_CM 1 100. 0. 1.9921875 DISPLAY_IDENTIFIER EFF_SCC_AV_MON2 ECU_ADDRESS 0x3fec84 FORMAT "%5.3" /end MEASUREMENT
/begin MEASUREMENT eff_scc_av_1_mon2 "actual ignition efficiency for torque monitoring" UBYTE _CNV_A_R_LINEAR_____117_CM 1 100. 0. 1.9921875 DISPLAY_IDENTIFIER EFF_SCC_AV_1_MON2 ECU_ADDRESS 0x3fec82 FORMAT "%5.3" /end MEASUREMENT
/begin MEASUREMENT t_tqi_mon2 "" UBYTE _CNV_A_R_LINEAR_____41_CM 1 100. 0. 10.2 DISPLAY_IDENTIFIER T_TQI_MON2 ECU_ADDRESS 0x3fec7e FORMAT "%5.2" /end MEASUREMENT
/begin MEASUREMENT inh_swi_iv_mon2 "shut of request for cylinder x" UWORD _CNV_A_R_LINEAR_____0_CM 1 100. 1. 65535. DISPLAY_IDENTIFIER INH_SWI_IV_MON2 ECU_ADDRESS 0x3fdf9c BYTE_ORDER MSB_LAST FORMAT "%5.0" /end MEASUREMENT
/begin MEASUREMENT val_mo3_av_cal_cks_high "" ULONG _CNV_A_R_LINEAR_____0_CM 1 100. 0. 4294967295. DISPLAY_IDENTIFIER VAL_MO3_AV_CAL_CKS_HIGH ECU_ADDRESS 0x3fd03c BYTE_ORDER MSB_LAST FORMAT "%11.0" /end MEASUREMENT
/begin MEASUREMENT val_mo3_av_cal_cks_low "" ULONG _CNV_A_R_LINEAR_____0_CM 1 100. 0. 4294967295. DISPLAY_IDENTIFIER VAL_MO3_AV_CAL_CKS_LOW ECU_ADDRESS 0x3fd038 BYTE_ORDER MSB_LAST FORMAT "%11.0" /end MEASUREMENT
/begin CHARACTERISTIC val_mo3_cal_cks_high "setpoint of CAL data (high) ROM test process monitoring" VALUE 0xffe414b8 _REC_VAL_20_u4 4294967295. _CNV_A_R_LINEAR_____22_CM 0. 4294967295. DISPLAY_IDENTIFIER VAL_MO3_CAL_CKS_HIGH FORMAT "%11.0" /end CHARACTERISTIC
/begin CHARACTERISTIC val_mo3_cal_cks_low "setpoint of CAL data (low) ROM test process monitoring" VALUE 0xffe414bc _REC_VAL_20_u4 4294967295. _CNV_A_R_LINEAR_____22_CM 0. 4294967295. DISPLAY_IDENTIFIER VAL_MO3_CAL_CKS_LOW FORMAT "%11.0" /end CHARACTERISTIC
/begin CHARACTERISTIC val_mo3_swi_cal_cks "switch to set the fault of the CAL data ROM test inactive (A5h means inactive)" VALUE 0xffe414a4 _REC_VAL_20_u1 255. _CNV_A_R_LINEAR_____0_CM 0. 255. DISPLAY_IDENTIFIER VAL_MO3_SWI_CAL_CKS FORMAT "%3.0" /end CHARACTERISTIC
/begin CHARACTERISTIC val_mo3_ans_cpm_tab "assignment table for answer of copy of process monitoring" CURVE 0xffe51f0e _REC_CUR_20_u2_u1 65535. _CNV_A_R_LINEAR_____0_CM 0. 65535. DISPLAY_IDENTIFIER VAL_MO3_ANS_CPM_TAB FORMAT "%5.0"
 /begin AXIS_DESCR COM_AXIS val_mo3_tst_rec_idx_mo2 _CNV_A_R_LINEAR_____0_CM 12 0. 12. FORMAT "%3.0" AXIS_PTS_REF ldpm_tst_rec /end AXIS_DESCR
/end CHARACTERISTIC
/begin MEASUREMENT val_mo2_ans "" UWORD _CNV_A_R_LINEAR_____0_CM 1 100. 0. 65535. DISPLAY_IDENTIFIER VAL_MO2_ANS ECU_ADDRESS 0x3fe02e BYTE_ORDER MSB_LAST FORMAT "%5.0" /end MEASUREMENT
/begin MEASUREMENT val_mo3_predrive_act "active flag of PREDRIVE CHECK" UBYTE _CNV_S_2_RANGE______2_CM 1 100. 0. 1. DISPLAY_IDENTIFIER VAL_MO3_PREDRIVE_ACT ECU_ADDRESS 0x3fed3d /end MEASUREMENT
/begin MEASUREMENT val_mo3_tst_rec_idx_mo2 "index for the test records of copy of Process Monitoring" UBYTE _CNV_A_R_LINEAR_____0_CM 1 100. 0. 255. DISPLAY_IDENTIFIER VAL_MO3_TST_REC_IDX_MO2 ECU_ADDRESS 0x3fed3a FORMAT "%3.0" /end MEASUREMENT
/begin AXIS_PTS ldpm_tst_rec "" 0xffe486e7 val_mo3_tst_rec_idx_mo2 _REC_AXS_20_u1 12. _CNV_A_R_LINEAR_____0_CM 12 0. 12. DISPLAY_IDENTIFIER LDPM_TST_REC FORMAT "%3.0" /end AXIS_PTS
/begin MEASUREMENT lv_err_conv_mon "Logical variable for ADC error" UBYTE _CNV_S_2_RANGE______21_CM 1 100. 0. 1. DISPLAY_IDENTIFIER LV_ERR_CONV_MON ECU_ADDRESS 0x3feb79 BIT_MASK 0x1 /end MEASUREMENT
/begin MEASUREMENT lv_err_n_32_mon "Logical variable for ratio error between N_32_MON and N_32_SUB_MON" UBYTE _CNV_S_2_RANGE______21_CM 1 100. 0. 1. DISPLAY_IDENTIFIER LV_ERR_N_32_MON ECU_ADDRESS 0x3fec13 BIT_MASK 0x1 /end MEASUREMENT
/begin MEASUREMENT lv_err_pvs_mon "Logical variable for different PVS diagnosis between L1 and L2" UBYTE _CNV_S_2_RANGE______21_CM 1 100. 0. 1. DISPLAY_IDENTIFIER LV_ERR_PVS_MON ECU_ADDRESS 0x3fec1a BIT_MASK 0x1 /end MEASUREMENT
/begin MEASUREMENT lv_err_tps_mon "Logical variable for different TPS diagnosis between L1 and L2" UBYTE _CNV_S_2_RANGE______21_CM 1 100. 0. 1. DISPLAY_IDENTIFIER LV_ERR_TPS_MON ECU_ADDRESS 0x3febe8 BIT_MASK 0x1 /end MEASUREMENT
/begin MEASUREMENT lv_err_tqi_av_mon "Fault currently present in torque generation" UBYTE _CNV_S_2_RANGE______21_CM 1 100. 0. 1. DISPLAY_IDENTIFIER LV_ERR_TQI_AV_MON ECU_ADDRESS 0x3fec42 BIT_MASK 0x1 /end MEASUREMENT
/begin MEASUREMENT lv_err_msr_inh_mon "Logical variable for fault in MSR present" UBYTE _CNV_S_2_RANGE______21_CM 1 100. 0. 1. DISPLAY_IDENTIFIER LV_ERR_MSR_INH_MON ECU_ADDRESS 0x3feb86 BIT_MASK 0x1 /end MEASUREMENT
/begin MEASUREMENT lv_err_cru_inh_mon "Logival variable for inhibition of cruise control" UBYTE _CNV_S_2_RANGE______21_CM 1 100. 0. 1. DISPLAY_IDENTIFIER LV_ERR_CRU_INH_MON ECU_ADDRESS 0x3febd6 BIT_MASK 0x1 /end MEASUREMENT
/begin MEASUREMENT lv_err_maf_mon "Logical variable for error in mass air flow signal" UBYTE _CNV_S_2_RANGE______21_CM 1 100. 0. 1. DISPLAY_IDENTIFIER LV_ERR_MAF_MON ECU_ADDRESS 0x3febe9 BIT_MASK 0x1 /end MEASUREMENT
/begin MEASUREMENT lv_err_tqi_n_max_nvmy_mon "Error location for \"monitoring of engine speed limitation\" stored in non volatile memory" UBYTE _CNV_S_2_RANGE______1_R_CM 1 100. 0. 255. DISPLAY_IDENTIFIER LV_ERR_TQI_N_MAX_NVMY_MON ECU_ADDRESS 0x3fba10 BIT_MASK 0x1 /end MEASUREMENT
/begin MEASUREMENT val_mon_err_ram "Logical variable for fault of RAM in process monitoring present" UBYTE _CNV_S_2_RANGE______21_CM 1 100. 0. 1. DISPLAY_IDENTIFIER VAL_MON_ERR_RAM ECU_ADDRESS 0x3fec22 BIT_MASK 0x1 /end MEASUREMENT
/begin AXIS_PTS ldp_maf_sub__maf_sub_thd_mon "" 0xffe52207 maf_sub_1 _REC_AXS_20_u1 1389. _CNV_A_R_LINEAR_____27_CM 2 0. 1389. DISPLAY_IDENTIFIER LDP_MAF_SUB__MAF_SUB_THD_MON FORMAT "%4.0" /end AXIS_PTS
/begin MEASUREMENT bios_test_ecu_ram "actual value of RAM test" UBYTE _CNV_A_R_LINEAR_____0_CM 1 100. 0. 255. DISPLAY_IDENTIFIER BIOS_TEST_ECU_RAM ECU_ADDRESS 0x3fb2e5 FORMAT "%3.0" /end MEASUREMENT
/begin MEASUREMENT bios_test_ecu_ram_cpl "actual complement value of RAM test" UBYTE _CNV_A_R_LINEAR_____0_CM 1 100. 0. 255. DISPLAY_IDENTIFIER BIOS_TEST_ECU_RAM_CPL ECU_ADDRESS 0x3fb2e6 FORMAT "%3.0" /end MEASUREMENT
/begin MEASUREMENT lv_off_iv_mon "Request for disable of MTC power stage by main controller" UBYTE _CNV_S_2_RANGE______21_CM 1 100. 0. 1. DISPLAY_IDENTIFIER LV_OFF_IV_MON ECU_ADDRESS 0x3febdd BIT_MASK 0x1 /end MEASUREMENT
/begin MEASUREMENT lv_off_mtc_iv_mu_mon "Request for wrong answers of the instruction set test to the monitoring unit in order to disable MTC and IV" UBYTE _CNV_S_2_RANGE______21_CM 1 100. 0. 1. DISPLAY_IDENTIFIER LV_OFF_MTC_IV_MU_MON ECU_ADDRESS 0x3febde BIT_MASK 0x1 /end MEASUREMENT
/begin MEASUREMENT lv_off_mtc_mon "Request for disable of MTC power stage by main controller" UBYTE _CNV_S_2_RANGE______21_CM 1 100. 0. 1. DISPLAY_IDENTIFIER LV_OFF_MTC_MON ECU_ADDRESS 0x3febdb BIT_MASK 0x1 /end MEASUREMENT
/begin MEASUREMENT lv_n_lim_req_mon "Request for engine speed limitation" UBYTE _CNV_S_2_RANGE______21_CM 1 100. 0. 1. DISPLAY_IDENTIFIER LV_N_LIM_REQ_MON ECU_ADDRESS 0x3febdc BIT_MASK 0x1 /end MEASUREMENT
/begin COMPU_METHOD _CNV_A_R_LINEAR_____0_CM "" RAT_FUNC "%6.3" "-" COEFFS 0 1. 0. 0 0 1 /end COMPU_METHOD
/begin COMPU_METHOD _CNV_S_2_RANGE______1_R_CM "" TAB_VERB "%6.3" "[-]" COMPU_TAB_REF _CNV_S_2_RANGE______1_R /end COMPU_METHOD
/begin COMPU_VTAB_RANGE _CNV_S_2_RANGE______1_R "" 2 0 0 "0" 1 255 "1" /end COMPU_VTAB_RANGE
/begin COMPU_METHOD _CNV_S_2_RANGE______2_CM "" TAB_VERB "%6.3" "[-]" COMPU_TAB_REF _CNV_S_2_RANGE______2 /end COMPU_METHOD
/begin COMPU_VTAB _CNV_S_2_RANGE______2 "" TAB_VERB 2 0 "0" 1 "1" /end COMPU_VTAB
/begin COMPU_METHOD _CNV_A_R_LINEAR_____3_CM "" RAT_FUNC "%6.3" "V" COEFFS 0 204.7999998974999 0. 0 0 1 /end COMPU_METHOD
/begin COMPU_METHOD _CNV_A_R_LINEAR_____4_CM "" RAT_FUNC "%6.3" "s" COEFFS 0 100. 0. 0 0 1 /end COMPU_METHOD
/begin COMPU_METHOD _CNV_A_R_LINEAR_____6_CM "" RAT_FUNC "%6.3" "°C" COEFFS 0 16. 0. 0 0 1 /end COMPU_METHOD
/begin COMPU_METHOD _CNV_A_R_LINEAR_____8_CM "" RAT_FUNC "%6.3" "%" COEFFS 0 655.3600000071681 0. 0 0 1 /end COMPU_METHOD
/begin COMPU_METHOD _CNV_A_R_LINEAR_____9_CM "" RAT_FUNC "%6.3" "%" COEFFS 0 2.56 0. 0 0 1 /end COMPU_METHOD
/begin COMPU_METHOD _CNV_A_R_LINEAR_____10_CM "" RAT_FUNC "%6.3" "rpm" COEFFS 0 1. 0. 0 0 1 /end COMPU_METHOD
/begin COMPU_METHOD _CNV_A_R_LINEAR_____11_CM "" RAT_FUNC "%6.3" "°C" COEFFS 0 1.333333333333333 64. 0 0 1 /end COMPU_METHOD
/begin COMPU_METHOD _CNV_A_R_LINEAR_____12_CM "" RAT_FUNC "%6.3" "°C" COEFFS 0 1.333333333333333 0. 0 0 1 /end COMPU_METHOD
/begin COMPU_METHOD _CNV_A_R_LINEAR_____15_CM "" RAT_FUNC "%6.3" "rpm" COEFFS 0 3.125e-002 0. 0 0 1 /end COMPU_METHOD
/begin COMPU_METHOD _CNV_A_R_LINEAR_____20_CM "" RAT_FUNC "%6.3" "-" COEFFS 0 32768.00003968061 0. 0 0 1 /end COMPU_METHOD
/begin COMPU_METHOD _CNV_S_2_RANGE______21_CM "" TAB_VERB "%6.3" "-" COMPU_TAB_REF _CNV_S_2_RANGE______21 /end COMPU_METHOD
/begin COMPU_VTAB _CNV_S_2_RANGE______21 "" TAB_VERB 2 0 "0" 1 "1" /end COMPU_VTAB
/begin COMPU_METHOD _CNV_A_R_LINEAR_____22_CM "" RAT_FUNC "%6.3" "[-]" COEFFS 0 1. 0. 0 0 1 /end COMPU_METHOD
/begin COMPU_METHOD _CNV_A_R_LINEAR_____27_CM "" RAT_FUNC "%6.3" "mg/stk" COEFFS 0 0.183585313174946 0. 0 0 1 /end COMPU_METHOD
/begin COMPU_METHOD _CNV_A_R_LINEAR_____37_CM "" RAT_FUNC "%6.3" "-" COEFFS 0 65536.00007936121 0. 0 0 1 /end COMPU_METHOD
/begin COMPU_METHOD _CNV_A_R_LINEAR_____39_CM "" RAT_FUNC "%6.3" "-" COEFFS 0 127.9991955827809 0. 0 0 1 /end COMPU_METHOD
/begin COMPU_METHOD _CNV_A_R_LINEAR_____41_CM "" RAT_FUNC "%6.3" "s" COEFFS 0 25. 0. 0 0 1 /end COMPU_METHOD
/begin COMPU_METHOD _CNV_A_R_LINEAR_____44_CM "" RAT_FUNC "%6.3" "V" COEFFS 0 51.0204081632653 0. 0 0 1 /end COMPU_METHOD
/begin COMPU_METHOD _CNV_A_R_LINEAR_____48_CM "" RAT_FUNC "%6.3" "[-]" COEFFS 0 32. 0. 0 0 1 /end COMPU_METHOD
/begin COMPU_METHOD _CNV_A_R_LINEAR_____49_CM "" RAT_FUNC "%6.3" "hPa" COEFFS 0 12.06017666543982 0. 0 0 1 /end COMPU_METHOD
/begin COMPU_METHOD _CNV_A_R_LINEAR_____50_CM "" RAT_FUNC "%6.3" "[-]" COEFFS 0 255.9999357490357 0. 0 0 1 /end COMPU_METHOD
/begin COMPU_METHOD _CNV_A_R_LINEAR_____52_CM "" RAT_FUNC "%6.3" "°TPS/s" COEFFS 0 8.535564853556485e-002 0. 0 0 1 /end COMPU_METHOD
/begin COMPU_METHOD _CNV_A_R_LINEAR_____53_CM "" RAT_FUNC "%6.3" "°TPS" COEFFS 0 137.0962343096234 0. 0 0 1 /end COMPU_METHOD
/begin COMPU_METHOD _CNV_A_R_LINEAR_____55_CM "" RAT_FUNC "%6.3" "Nm" COEFFS 0 32. 0. 0 0 1 /end COMPU_METHOD
/begin COMPU_METHOD _CNV_A_R_LINEAR_____60_CM "" RAT_FUNC "%6.3" "V" COEFFS 0 9.807692307692308 0. 0 0 1 /end COMPU_METHOD
/begin COMPU_METHOD _CNV_A_R_LINEAR_____82_CM "" RAT_FUNC "%6.3" "°CRK" COEFFS 0 2.666666666666667 0. 0 0 1 /end COMPU_METHOD
/begin COMPU_METHOD _CNV_A_R_LINEAR_____85_CM "" RAT_FUNC "%6.3" "km/h" COEFFS 0 128.0000018750286 0. 0 0 1 /end COMPU_METHOD
/begin COMPU_METHOD _CNV_A_R_LINEAR_____88_CM "" RAT_FUNC "%6.3" "km" COEFFS 0 0.1 0. 0 0 1 /end COMPU_METHOD
/begin COMPU_METHOD _CNV_A_R_LINEAR_____95_CM "" RAT_FUNC "%6.3" "Nm" COEFFS 0 1. 0. 0 0 1 /end COMPU_METHOD
/begin COMPU_METHOD _CNV_A_R_LINEAR_____101_CM "" RAT_FUNC "%6.3" "Nm" COEFFS 0 0.5 0. 0 0 1 /end COMPU_METHOD
/begin COMPU_METHOD _CNV_A_R_LINEAR_____102_CM "" RAT_FUNC "%6.3" "Nms" COEFFS 0 320.1514411333659 0. 0 0 1 /end COMPU_METHOD
/begin COMPU_METHOD _CNV_A_R_LINEAR_____103_CM "" RAT_FUNC "%6.3" "m/s²" COEFFS 0 640. 32768. 0 0 1 /end COMPU_METHOD
/begin COMPU_METHOD _CNV_A_R_LINEAR_____108_CM "" RAT_FUNC "%6.3" "mg/stk" COEFFS 0 47.18142548596112 0. 0 0 1 /end COMPU_METHOD
/begin COMPU_METHOD _CNV_A_R_LINEAR_____115_CM "" RAT_FUNC "%6.3" "kg/h" COEFFS 0 32. 0. 0 0 1 /end COMPU_METHOD
/begin COMPU_METHOD _CNV_A_R_LINEAR_____117_CM "" RAT_FUNC "%6.3" "-" COEFFS 0 128. 0. 0 0 1 /end COMPU_METHOD
/begin COMPU_METHOD _CNV_A_R_LINEAR_____158_CM "" RAT_FUNC "%6.3" "km/h" COEFFS 0 0.5 0. 0 0 1 /end COMPU_METHOD
/begin COMPU_METHOD _CNV_A_R_LINEAR_____187_CM "" RAT_FUNC "%6.3" "Nm" COEFFS 0 32. 32768. 0 0 1 /end COMPU_METHOD
/begin COMPU_METHOD _CNV_A_R_LINEAR_____191_CM "" RAT_FUNC "%6.3" "-" COEFFS 0 65535. 0. 0 0 1 /end COMPU_METHOD
/begin COMPU_METHOD _CNV_A_R_LINEAR_____203_CM "" RAT_FUNC "%6.3" "°CRK" COEFFS 0 2.666666666666667 95. 0 0 1 /end COMPU_METHOD
/begin COMPU_METHOD _CNV_A_R_LINEAR_____204_CM "" RAT_FUNC "%6.3" "°CRK" COEFFS 0 -2.666666666666667 0. 0 0 1 /end COMPU_METHOD
/begin COMPU_METHOD _CNV_A_R_LINEAR_____216_CM "" RAT_FUNC "%6.3" "rpm" COEFFS 0 3.125e-002 128. 0 0 1 /end COMPU_METHOD
/begin COMPU_METHOD _CNV_A_R_LINEAR_____400_CM "" RAT_FUNC "%6.3" "°TPS/V" COEFFS 0 7.971241012816505 0. 0 0 1 /end COMPU_METHOD
/begin COMPU_METHOD _CNV_A_R_LINEAR_____401_CM "" RAT_FUNC "%6.3" "%/°TPS" COEFFS 0 2.400225903614458 0. 0 0 1 /end COMPU_METHOD
/begin COMPU_METHOD _CNV_A_R_LINEAR_____402_CM "" RAT_FUNC "%6.3" "°TPS" COEFFS 0 2.133891213389121 0. 0 0 1 /end COMPU_METHOD
/begin COMPU_METHOD _CNV_A_R_LINEAR_____403_CM "" RAT_FUNC "%6.3" "-" COEFFS 0 255.9999357490357 0. 0 0 1 /end COMPU_METHOD
/begin COMPU_METHOD _CNV_A_R_LINEAR_____405_CM "" RAT_FUNC "%6.3" "A" COEFFS 0 1. 0. 0 0 1 /end COMPU_METHOD
/begin COMPU_METHOD _CNV_A_R_LINEAR_____427_CM "" RAT_FUNC "%6.3" "-" COEFFS 0 257. 0. 0 0 1 /end COMPU_METHOD
/begin COMPU_METHOD _CNV_A_R_LINEAR_____428_CM "" RAT_FUNC "%6.3" "µs" COEFFS 0 1. 0. 0 0 1 /end COMPU_METHOD
/begin COMPU_METHOD _CNV_A_R_LINEAR_____448_CM "" RAT_FUNC "%6.3" "%/V" COEFFS 0 3.2 0. 0 0 1 /end COMPU_METHOD
/begin COMPU_METHOD _CNV_A_R_LINEAR_____452_CM "" RAT_FUNC "%6.3" "%/V" COEFFS 0 1.6 0. 0 0 1 /end COMPU_METHOD
/begin COMPU_METHOD _CNV_A_R_LINEAR_____512_CM "" RAT_FUNC "%6.3" "Nm/rpm*rpm" COEFFS 0 134293032.7868853 0. 0 0 1 /end COMPU_METHOD
/begin COMPU_METHOD _CNV_A_R_LINEAR_____524_CM "" RAT_FUNC "%6.3" "-" COEFFS 0 8000.120001800027 0. 0 0 1 /end COMPU_METHOD
/begin COMPU_METHOD _CNV_A_R_LINEAR_____525_CM "" RAT_FUNC "%6.3" "-" COEFFS 0 8000. 0. 0 0 1 /end COMPU_METHOD
/begin COMPU_METHOD _CNV_A_R_LINEAR_____526_CM "" RAT_FUNC "%6.3" "Nm" COEFFS 0 128. 0. 0 0 1 /end COMPU_METHOD
/begin COMPU_METHOD _CNV_S_3_STATE_ERR__527_CM "" TAB_VERB "%6.3" "[-]" COMPU_TAB_REF _CNV_S_3_STATE_ERR__527 /end COMPU_METHOD
/begin COMPU_VTAB _CNV_S_3_STATE_ERR__527 "" TAB_VERB 3 0 "NO_ERROR" 1 "ERROR_PATH_1" 2 "ERROR_PATH_2" /end COMPU_VTAB
/begin COMPU_METHOD _CNV_A_R_LINEAR_____531_CM "" RAT_FUNC "%6.3" "Nm" COEFFS 0 8. 0. 0 0 1 /end COMPU_METHOD
/begin COMPU_METHOD _CNV_A_R_LINEAR_____571_CM "" RAT_FUNC "%6.3" "%" COEFFS 0 327.6800000071683 0. 0 0 1 /end COMPU_METHOD
/begin COMPU_METHOD _CNV_A_R_LINEAR_____572_CM "" RAT_FUNC "%6.3" "µs" COEFFS 0 1. 32768. 0 0 1 /end COMPU_METHOD
/begin COMPU_METHOD _CNV_A_R_LINEAR_____601_CM "" RAT_FUNC "%6.3" "%" COEFFS 0 327.8667200320192 16393.33600160096 0 0 1 /end COMPU_METHOD
/begin COMPU_METHOD _CNV_A_R_LINEAR_____602_CM "" RAT_FUNC "%6.3" "-" COEFFS 0 256.4102564102564 0. 0 0 1 /end COMPU_METHOD
/begin COMPU_METHOD _CNV_A_R_LINEAR_____603_CM "" RAT_FUNC "%6.3" "tdc" COEFFS 0 1. 0. 0 0 1 /end COMPU_METHOD
/begin COMPU_METHOD _CNV_A_R_LINEAR_____604_CM "" RAT_FUNC "%6.3" "Nm" COEFFS 0 64. 0. 0 0 1 /end COMPU_METHOD
/begin COMPU_METHOD _CNV_A_R_LINEAR_____607_CM "" RAT_FUNC "%6.3" "-" COEFFS 0 256.3333333333333 0. 0 0 1 /end COMPU_METHOD
/begin COMPU_METHOD _CNV_A_R_LINEAR_____608_CM "" RAT_FUNC "%6.3" "-" COEFFS 0 127.5 0. 0 0 1 /end COMPU_METHOD
/begin RECORD_LAYOUT _REC_VAL_20_u1 FNC_VALUES 1 UBYTE COLUMN_DIR DIRECT /end RECORD_LAYOUT
/begin RECORD_LAYOUT _REC_VAL_20_u2 FNC_VALUES 1 UWORD COLUMN_DIR DIRECT /end RECORD_LAYOUT
/begin RECORD_LAYOUT _REC_CUR_20_u2_u1 FNC_VALUES 1 UWORD COLUMN_DIR DIRECT /end RECORD_LAYOUT
/begin RECORD_LAYOUT _REC_AXS_20_u1 NO_AXIS_PTS_X 1 UBYTE AXIS_PTS_X 2 UBYTE INDEX_INCR DIRECT /end RECORD_LAYOUT
/begin RECORD_LAYOUT _REC_MAP_20_u1_u1_u1 FNC_VALUES 1 UBYTE COLUMN_DIR DIRECT /end RECORD_LAYOUT
/begin RECORD_LAYOUT _REC_CUR_20_u1_u1 FNC_VALUES 1 UBYTE COLUMN_DIR DIRECT /end RECORD_LAYOUT
/begin RECORD_LAYOUT _REC_AXS_20_u2 NO_AXIS_PTS_X 1 UWORD AXIS_PTS_X 2 UWORD INDEX_INCR DIRECT /end RECORD_LAYOUT
/begin RECORD_LAYOUT _REC_MAP_20_u1_u1_u2 FNC_VALUES 1 UBYTE COLUMN_DIR DIRECT /end RECORD_LAYOUT
/begin RECORD_LAYOUT _REC_MAP_20_u2_u2_u1 FNC_VALUES 1 UWORD COLUMN_DIR DIRECT /end RECORD_LAYOUT
/begin RECORD_LAYOUT _REC_CUR_20_u1_u2 FNC_VALUES 1 UBYTE COLUMN_DIR DIRECT /end RECORD_LAYOUT
/begin RECORD_LAYOUT _REC_MAP_20_u2_u1_u1 FNC_VALUES 1 UWORD COLUMN_DIR DIRECT /end RECORD_LAYOUT
/begin RECORD_LAYOUT _REC_CUR_20_u2_u2 FNC_VALUES 1 UWORD COLUMN_DIR DIRECT /end RECORD_LAYOUT
/begin RECORD_LAYOUT _REC_VAL_20_s1 FNC_VALUES 1 SBYTE COLUMN_DIR DIRECT /end RECORD_LAYOUT
/begin RECORD_LAYOUT _REC_VAL_20_u4 FNC_VALUES 1 ULONG COLUMN_DIR DIRECT /end RECORD_LAYOUT
/begin RECORD_LAYOUT _REC_VAL_20_s2 FNC_VALUES 1 SWORD COLUMN_DIR DIRECT /end RECORD_LAYOUT
/begin RECORD_LAYOUT _REC_MAP_20_u1_u2_u2 FNC_VALUES 1 UBYTE COLUMN_DIR DIRECT /end RECORD_LAYOUT
/begin RECORD_LAYOUT _REC_MAP_20_u2_u2_u2 FNC_VALUES 1 UWORD COLUMN_DIR DIRECT /end RECORD_LAYOUT
/begin RECORD_LAYOUT _REC_MAP_20_u1_u2_u1 FNC_VALUES 1 UBYTE COLUMN_DIR DIRECT /end RECORD_LAYOUT
/begin RECORD_LAYOUT _REC_CUR_20_s2_u1 FNC_VALUES 1 SWORD COLUMN_DIR DIRECT /end RECORD_LAYOUT
/begin RECORD_LAYOUT _REC_CUR_20_s1_u1 FNC_VALUES 1 SBYTE COLUMN_DIR DIRECT /end RECORD_LAYOUT
/begin FUNCTION MISF_Det_ENRD_Based_Appli_Inci ""
 /begin DEF_CHARACTERISTIC ip_load_min_afs_mt_mis ip_load_min_afs_at_mis ip_load_min_afl_mt_mis ip_load_min_afl_at_mis ip_load_min_s_mt_mis ip_load_min_s_at_mis ip_amp_ofs_load_afs_mis ip_amp_ofs_load_s_mis ip_amp_ofs_load_afl_mis ip_tco_ofs_load_afl_mis ip_tco_ofs_load_s_mis ip_tco_ofs_load_afs_mis ldp_n_32__fac_thd_iv_s_er ldp_n_32__fac_thd_iv_er ldp_load_mis__thd_afl_er_is ldp_load_mis__thd_afs_er_is ldp_load_mis__thd_s_er_is ldp_n__thd_afs_er_is ldp_n__thd_afl_er_is ldp_n__thd_s_er_is ldp_tco__fac_thd_er ldp_iga_ch_bas__fac_thd_er_ch ip_thd_at_afl_er ip_thd_afl_er_is ip_thd_mt_afs_er ip_thd_mt_afl_er ip_thd_afs_er_is ip_thd_at_afs_er ip_thd_at_s_er ip_thd_mt_s_er ip_thd_s_er_is ip_fac_thd_iv_er ip_fac_thd_er ip_fac_thd_er_ch c_mask_app_inh_det_zdly_mis c_nr_tdc_iga_dif_er c_nr_tdc_cmb_tra_s_mis c_nr_tdc_cmb_tra_afl_mis ip_tps_grd_max_er ip_tps_grd_max_zdly_er ip_load_grd_hom_max_mis ip_load_grd_s_max_mis ldp_map__map_dif_max_er ip_map_dif_max_er ldp_n_32__delta_iga_mis ldp_maf__delta_iga_mis ip_delta_iga_mis ip_fac_thd_iv_s_er ldpm_amp__amp_ofs_load_mis ldpm_tco__tco_ofs_load_mis lc_conf_load_mis c_tqi_av_max_mis c_maf_max_mis ldp_tps_av__tps_grd_max_er ldp_tps_av__tps_grd_max_zdly_er ldp_load_mis__load_grd_hom_max ldp_load_mis__load_grd_s_max ldp_n__load_min_s_mt_mis ldp_n__load_min_s_at_mis ldp_n__load_min_afs_mt_mis ldp_n__load_min_afs_at_mis ldp_n__load_min_afl_mt_mis ldp_n__load_min_afl_at_mis ldp_load_mis__thd_mt_afl_er ldp_load_mis__thd_at_afl_er ldp_n_32__thd_mt_afl_er ldp_n_32__thd_at_afl_er ldp_load_mis__thd_mt_afs_er ldp_load_mis__thd_at_afs_er ldp_load_mis__thd_mt_s_er ldp_load_mis__thd_at_s_er ldp_n_32__thd_mt_s_er ldp_n_32__thd_at_s_er ldp_n_32__thd_mt_afs_er ldp_n_32__thd_at_afs_er c_t_tps_grd_dly_mis c_t_tps_grd_dly_zdly_mis c_t_load_grd_hom_dly_mis c_t_load_grd_s_dly_mis c_t_accout_dly_er c_t_map_dif_dly_er c_t_amt_gs_dly_mis c_mask_app_inh_det_mis c_mask_app_inh_det_mis_is /end DEF_CHARACTERISTIC
 /begin OUT_MEASUREMENT n_mis load_mis_1 load_mis_2 load_mis_3 load_grd_mis load_min_mis load_mis mis_det_cdn_app_inh_nr mis_det_cdn_app_inh mis_det_cdn_app_inh.lv_inh_map_dif_det_mis mis_det_cdn_app_inh.lv_inh_tps_grd_det_mis mis_det_cdn_app_inh.lv_inh_load_grd_det_mis mis_det_cdn_app_inh.lv_inh_iga_dif_det_mis mis_det_cdn_app_inh.lv_inh_cmb_tra_mis mis_det_cdn_app_inh.lv_inh_acc_det_mis mis_det_cdn_app_inh.lv_inh_cdn_obd_mis mis_det_cdn_app_inh.lv_inh_indx_mis mis_det_cdn_app_inh.lv_inh_amt_gs_det_mis iga_mis_1 iga_mis_2 iga_mis lv_req_app_inh_mis ctr_tot_mis thd_er_buf[0] thd_er_buf[1] thd_er_buf[2] thd_er_buf[3] thd_er_buf[4] thd_er_buf[5] thd_er_stnd_buf[0] thd_er_stnd_buf[1] thd_er_stnd_buf[2] thd_er_stnd_buf[3] thd_er_stnd_buf[4] thd_er_stnd_buf[5] iga_dif_mis map_dif_mis thd_er_stnd thd_er_stnd_x[0] thd_er_stnd_x[1] thd_er_stnd_x[2] thd_er_stnd_x[3] thd_er_stnd_x[4] thd_er_stnd_x[5] thd_er thd_er_x[0] thd_er_x[1] thd_er_x[2] thd_er_x[3] thd_er_x[4] thd_er_x[5] /end OUT_MEASUREMENT
/end FUNCTION
/begin FUNCTION MISF_Rate_Err_Mngt_Appli_Inci ""
 /begin DEF_CHARACTERISTIC ldp_n_32__fac_er_afl_diag_mis ldp_n_32__fac_er_s_diag_mis ldp_n_32__fac_igc_diag_mis ldp_n_32__fac_er_afs_diag_mis ldp_n_32__fac_iv_diag_mis ldp_load_mis__fac_er_s_diag_mis ldp_load_mis__fac_igc_diag_mis ip_fac_er_afl_diag_mis ip_fac_er_s_diag_mis ip_fac_er_afs_diag_mis ip_fac_igc_diag_mis ip_fac_iv_diag_mis ldp_load_mis__fac_iv_diag_mis ldp_load_mis_2__mis_a_fac_afl ldp_load_mis_2__mis_a_fac_afs ldp_load_mis_2__mis_a_fac_s c_mis_nr_off_iv_igcfb c_teg_cat_up_mis_a_max lc_ftl_l_diag_mis lc_ctr_conf_diag_mis ip_mis_a_fac_afl ip_mis_a_fac_afs ip_mis_a_fac_s ldp_n__mis_a_fac_afl ldp_n__mis_a_fac_afs ldp_n__mis_a_fac_s ldp_load_mis__fac_er_afs_diag ldp_load_mis__fac_er_afl_diag /end DEF_CHARACTERISTIC
 /begin OUT_MEASUREMENT ctr_mis_det_cyl[0] ctr_mis_det_cyl[1] ctr_mis_det_cyl[2] ctr_mis_det_cyl[3] ctr_mis_det_cyl[4] ctr_mis_det_cyl[5] ctr_mis_det ctr_seg_mis_act sum_fac_diag_mis fac_igc_diag_mis fac_er_diag_mis fac_iv_diag_mis lv_ftl_l_diag_mis lv_req_app_ctr_mis_a mis_a_fac mis_a_fac_buf[0] mis_a_fac_buf[1] mis_a_fac_buf[2] mis_a_fac_buf[3] mis_a_fac_buf[4] mis_a_fac_buf[5] lv_cdn_mis_b1 lv_cdn_mis_a lv_cdn_mis_b4 lv_mis_state_b lv_det_cfm_mis lv_err_mis_mpl lv_err_mis_1 lv_err_mis_2 lv_err_mis_3 lv_err_mis_4 lv_err_mis_5 lv_err_mis_0 load_max_scdn_mis load_min_scdn_mis n_min_scdn_mis n_max_scdn_mis /end OUT_MEASUREMENT
/end FUNCTION
/begin FUNCTION MON_Monitoring "MON"
 /begin SUB_FUNCTION MON_Monitoring_of_pedal_value_si MON_Application_Incidence_and_Co MON_RAM_Test_of_process_monitori MON_Monitoring_of_analog_digital MON_TCO_Monitoring MON_Monitoring_of_torque_demand_ MON_Monitoring_of_torque_losses MON_Monitoring_of_minimum_torque MON_Monitoring_of_maximum_torque MON_Monitoring_of_engine_speed MON_Desired_indicated_engine_tor MON_Actual_indicated_engine_torq MON_Monitoring_of_actual_indicat MON_Monitoring_of_engine_speed_l MON_Fault_reaction_of_process_mo MON_Can_signals MON_Monitoring_of_cruse_control_ MON_Monitoring_of_mass_air_flow_ MON_Errors MON_Processor_Monitoring_by_copy MON_Processor_Monitoring MON_Fault_Reaction_of_Processor_ MON_Monitoring_of_sport_switch /end SUB_FUNCTION
/end FUNCTION
/begin FUNCTION MON_Monitoring_of_pedal_value_si "_Monitoring of pedal value signal"
 /begin DEF_CHARACTERISTIC c_v_pvs_is_thd_1_mon c_v_pvs_is_thd_2_mon c_v_pvs_slop_1_mon c_v_pvs_slop_2_mon c_n_min_pvs_diag_mon ip_pv_ratio_hys_mon c_pv_lih_max_mon /end DEF_CHARACTERISTIC
 /begin OUT_MEASUREMENT lv_err_pvs_ratio_mon pv_av_mon pv_av_1_mon pv_av_2_mon abc_pvs_ratio_mon lv_err_pvs_mon /end OUT_MEASUREMENT
/end FUNCTION
/begin FUNCTION MON_Application_Incidence_and_Co "_Application Incidence and Configuration of Process Monitoring"
 /begin DEF_CHARACTERISTIC c_v_tps_1_lih_mon c_v_tps_2_lih_mon c_tq_loss_pste_2_min_mon c_tq_loss_pste_1_min_mon c_tq_loss_ars_min_mon c_tq_loss_add_acc_min_mon c_fac_eff_alter_mon c_fac_n_alter_mon c_tq_loss_alter_lih_mon c_crlc_alter_mon c_v_tq_alter_mon id_eff_typ_alter_mon ldp_genawnumm__tq_loss_mon ldp_dffgen_fil_mon__loss_mon ldpm_n_alter_mon__tq_loss_mon ip_cur_alter_mon ip_eff_alter_mon ldp_cur_alter_mon__tq_loss_mon /end DEF_CHARACTERISTIC
 /begin OUT_MEASUREMENT lv_n_lim_etc_mon lv_tqi_mon_act_mon tq_esp_mon lv_brake_mon lv_im_bts_mon lv_im_bls_mon lv_igk_mon n_sp_is_mon tq_egs_mon tq_loss_acc_mon tq_loss_add_mon tq_loss_alter_mon tq_loss_alter_mdl_mon tq_loss_ars_mon tq_loss_pste_1_mon tq_loss_pste_mon tq_loss_pste_2_mon cur_alter_mon n_alter_mon dffgen_fil_mon state_n_max_mon lv_err_vcc_pvs_2_mon lv_err_vcc_pvs_1_mon lv_err_vcc_pvs_mon lv_err_tqi_n_max_nvmy_mon /end OUT_MEASUREMENT
/end FUNCTION
/begin FUNCTION MON_RAM_Test_of_process_monitori "_RAM Test of process monitoring" /begin OUT_MEASUREMENT val_mon_err_ram /end OUT_MEASUREMENT /end FUNCTION
/begin FUNCTION MON_Monitoring_of_analog_digital "_Monitoring of analog-digital-conversoin" /begin DEF_CHARACTERISTIC c_v_conv_thd_deac_mon c_v_pvs_2_conv_ratio_hys_mon /end DEF_CHARACTERISTIC /begin OUT_MEASUREMENT abc_conv_mon lv_err_conv_mon /end OUT_MEASUREMENT /end FUNCTION
/begin FUNCTION MON_TCO_Monitoring "_TCO Monitoring"
 /begin DEF_CHARACTERISTIC c_t_tco_grd_max_mon c_tco_grd_max_mon c_tco_sub_thd_max_mon c_tco_thd_min_mon /end DEF_CHARACTERISTIC
 /begin OUT_MEASUREMENT t_tco_grd_mon tco_mon /end OUT_MEASUREMENT
/end FUNCTION
/begin FUNCTION MON_Monitoring_of_torque_demand_ "_Monitoring of torque demand from idle speed controller"
 /begin DEF_CHARACTERISTIC ip_tq_dif_p_d_is_max_mon ip_fac_tq_dif_p_d_is_mon c_n_dif_min_mon c_tq_dif_i_is_max_mon c_tq_pas_i_is_mon c_fac_ramp_pos_i_is_mon c_fac_ramp_neg_i_is_mon c_tq_dif_p_d_is_add_mon c_tq_dif_i_is_add_mon c_fac_ramp_neg_p_d_is_mon ip_n_sp_is_mon_max_mon c_n_dif_fac_mon c_n_dif_crlc_high_mon c_n_dif_crlc_low_mon /end DEF_CHARACTERISTIC
 /begin OUT_MEASUREMENT lv_err_tq_dif_p_d_is_mon lv_err_tq_dif_i_is_mon n_dif_sp_is_mon tq_dif_i_is_mon tq_dif_i_is_ramp_mon tq_dif_p_d_is_dif_mon tq_dif_i_is_dif_mon abc_tq_dif_p_d_is_mon abc_tq_dif_i_is_mon tq_dif_p_d_is_mon tq_dif_p_d_is_ramp_mon tq_add_p_d_is_mon tq_add_i_is_mon state_err_tq_dif_p_d_is_mon state_err_tq_dif_i_is_mon n_dif_mmv_mon n_dif_cor_mon tq_dif_p_d_is_ramp_mon_1 /end OUT_MEASUREMENT
/end FUNCTION
/begin FUNCTION MON_Monitoring_of_torque_losses "_Monitoring of torque losses"
 /begin DEF_CHARACTERISTIC ip_tq_loss_min_mon ip_tqfr_add_mon ip_tqfr_add_km_mon c_tq_dif_is_ad_min_mon /end DEF_CHARACTERISTIC
 /begin OUT_MEASUREMENT lv_err_tq_loss_mon tq_loss_dif_mon abc_tq_loss_mon tq_loss_mon tqfr_add_mon /end OUT_MEASUREMENT
/end FUNCTION
/begin FUNCTION MON_Monitoring_of_minimum_torque "_Monitoring of minimum torque at clutch"
 /begin DEF_CHARACTERISTIC c_n_st_max_mon ip_tq_min_clu_max_mon ip_fac_conv_mon ip_tqi_min_req_pu_mon /end DEF_CHARACTERISTIC
 /begin OUT_MEASUREMENT lv_err_tq_min_clu_mon tq_min_clu_mon abc_tq_min_clu_mon tq_min_clu_dif_mon tq_min_clu_mdl_1_mon tq_min_clu_mdl_2_mon tq_min_clu_mdl_mon tq_conv_max_mon tq_st_mon /end OUT_MEASUREMENT
/end FUNCTION
/begin FUNCTION MON_Monitoring_of_maximum_torque "_Monitoring of maximum torque at clutch" /begin DEF_CHARACTERISTIC ip_tq_max_clu_max_mon /end DEF_CHARACTERISTIC
 /begin OUT_MEASUREMENT lv_err_tq_max_clu_mon tq_max_clu_mon tq_max_clu_dif_mon abc_tq_max_clu_mon /end OUT_MEASUREMENT
/end FUNCTION
/begin FUNCTION MON_Monitoring_of_engine_speed "_Monitoring of engine speed" /begin DEF_CHARACTERISTIC c_n_32_dif_rel_max_mon c_n_32_min_mon c_n_32_lim_mon /end DEF_CHARACTERISTIC
 /begin OUT_MEASUREMENT n_32_mon n_32_sub_mon abc_n_32_mon n_32_dif_rel_mon t_seg_sw_mon lv_err_n_32_mon /end OUT_MEASUREMENT
/end FUNCTION
/begin FUNCTION MON_Desired_indicated_engine_tor "_Desired indicated engine torque"
 /begin DEF_CHARACTERISTIC c_t_tqi_mon c_tqi_sp_dec_max_mon ip_fac_tq_req_driv_mon ip_fac_tq_req_driv_rng_l_mon /end DEF_CHARACTERISTIC
 /begin OUT_MEASUREMENT tqi_req_tot_mon tqi_sp_mon fac_tq_req_mon /end OUT_MEASUREMENT
/end FUNCTION
/begin FUNCTION MON_Actual_indicated_engine_torq "_Actual indicated engine torque"
 /begin DEF_CHARACTERISTIC ip_eff_iga_mon ip_iga_ref_mon ip_tqi_ref_mon c_iga_ref_egr_cor_lim_mon /end DEF_CHARACTERISTIC
 /begin OUT_MEASUREMENT tqi_av_mon eff_iga_av_mon iga_ref_cor_mon eff_scc_av_1_mon eff_scc_av_2_mon eff_scc_av_mon /end OUT_MEASUREMENT
/end FUNCTION
/begin FUNCTION MON_Monitoring_of_actual_indicat "_Monitoring of actual indicated engine torque"
 /begin DEF_CHARACTERISTIC ip_tqi_dif_max_mon c_dec_tqi_dif_max_mon c_tqi_dif_max_ofs_mon /end DEF_CHARACTERISTIC
 /begin OUT_MEASUREMENT tqi_dif_max_mon tqi_dif_mon abc_tqi_av_mon tqi_dif_max_ofs_mon lv_err_tqi_av_mon /end OUT_MEASUREMENT
/end FUNCTION
/begin FUNCTION MON_Monitoring_of_engine_speed_l "_Monitoring of engine speed limitation" /begin DEF_CHARACTERISTIC c_n_max_mtc_lih_thd_mon /end DEF_CHARACTERISTIC /begin OUT_MEASUREMENT lv_err_tqi_n_max_mon abc_tqi_n_max_mon /end OUT_MEASUREMENT /end FUNCTION
/begin FUNCTION MON_Fault_reaction_of_process_mo "_Fault reaction of process monitoring"
 /begin OUT_MEASUREMENT lv_off_iv_mon lv_off_mtc_iv_mu_mon lv_off_mtc_mon lv_n_lim_req_mon /end OUT_MEASUREMENT
/end FUNCTION
/begin FUNCTION MON_Can_signals "_Can-signals"
 /begin DEF_CHARACTERISTIC c_can_vb_min_diag_mon c_t_msr_inh_mon c_tqi_stnd_mon c_t_dcc_inh_mon c_t_max_brake_det_dcc_mon c_vs_fil_amt_mon c_t_max_state_amt_1_diag_mon c_t_max_state_amt_2_diag_mon c_tqi_amt_diag_mon c_t_max_state_amt_3_diag_mon c_t_max_tqi_amt_diag_mon c_tqi_amt_cond_diag_mon c_tqi_amt_can_es_mon c_t_max_state_clu_amt_diag_mon c_t_amt_inh_mon c_t_gs_inh_mon c_vs_min_tq_gs_inc_mon c_t_dly_min_vs_tq_gs_inc_mon c_crlc_tq_gs_inc_plaus_mon c_int_max_tq_gs_inc_mon c_int_min_tq_gs_inc_mon c_t_dly_ac_max_tq_gs_inc_mon c_t_max_tq_gs_inc_mon c_t_dly_tq_max_tq_gs_inc_mon ip_ac_max_tq_gs_inc_mon ip_tq_max_tq_gs_inc_mon c_int_tq_gs_inc_rest_mon c_t_dif_min_tq_gs_inc_mon /end DEF_CHARACTERISTIC
 /begin OUT_MEASUREMENT tqi_msr_mon t_msr_inh_mon abc_msr_inh_mon tq_msr_mon tq_dcc_mon abc_dcc_inh_mon lv_err_dcc_rev_mon t_dcc_brake_det_mon lv_err_dcc_inh_mon t_dcc_inh_mon state_err_amt_mon t_state_amt_1_diag_mon t_state_amt_2_diag_mon t_state_amt_3_diag_mon t_state_clu_amt_diag_mon t_tqi_amt_diag_mon tqi_amt_plaus_mon tqi_gs_mon lv_err_amt_inh_mon t_amt_inh_mon t_gs_inh_mon tq_gs_mon lv_err_gs_inh_mon lv_err_tq_gs_inc_plaus_mon state_gs_plaus_mon lv_int_max_tq_gs_inc_mon int_tq_gs_inc_mon lv_vs_min_tq_gs_inc_mon ctr_t_vs_tq_gs_inc_mon ctr_t_ac_tq_gs_inc_mon lv_ac_max_tq_gs_inc_mon lv_t_min_tq_gs_inc_deac_mon ctr_t_max_tq_gs_inc_mon lv_t_max_tq_gs_inc_mon lv_tq_max_tq_gs_inc_mon ctr_t_dif_min_tq_gs_inc_mon ctr_t_tq_max_tq_gs_inc_mon abc_amt_inh_mon state_amt_old_mon lv_err_dcc_irrev_mon lv_dcc_off_ecu_mon tq_amt_mon tqi_amt_mon abc_gs_inh_mon lv_err_msr_inh_mon /end OUT_MEASUREMENT
/end FUNCTION
/begin FUNCTION MON_Monitoring_of_cruse_control_ "_Monitoring of cruse control conditions" /begin DEF_CHARACTERISTIC c_vs_min_cru_mon c_t_cru_inh_mon /end DEF_CHARACTERISTIC
 /begin OUT_MEASUREMENT t_cru_inh_mon fac_tq_req_cru_mon abc_cru_inh_mon lv_err_cru_inh_mon /end OUT_MEASUREMENT
/end FUNCTION
/begin FUNCTION MON_Monitoring_of_mass_air_flow_ "_Monitoring of mass air flow signal (MAF)"
 /begin DEF_CHARACTERISTIC c_maf_sub_mmv_crlc_mon c_n_tps_min_diag_mon c_tps_slop_mon c_v_tps_ad_el_bol_1_mon c_v_tps_ad_el_bol_2_mon c_v_tps_max_mon c_v_tps_ratio_hys_mon ip_fac_tps_isa_mon ip_maf_max_isa_mon ip_fac_pq_isa_mon c_n_min_maf_diag_mon ip_pq_mon ip_fac_maf_sub_cor_mon ip_maf_sub_mon ip_maf_sub_thd_mon /end DEF_CHARACTERISTIC
 /begin OUT_MEASUREMENT abc_maf_mon abc_tps_ratio_mon maf_mon maf_sub_mon pq_turb_sys_mon tps_av_mon tps_sum_av_mon v_tps_1_mon v_tps_2_mon maf_sub_cor_mmv_mon maf_sub_tps_mon maf_sub_isa_mon lv_err_tps_mon lv_err_maf_mon /end OUT_MEASUREMENT
/end FUNCTION
/begin FUNCTION MON_Errors "_Errors"
 /begin OUT_MEASUREMENT lv_err_conv_mon_1 lv_err_tq_ext_mon_1 lv_err_cru_inh_mon_1 lv_err_maf_tps_mon_1 lv_err_tqi_n_max_mon_1 lv_err_n_32_mon_1 lv_err_pvs_mon_1 lv_err_tqi_av_mon_1 lv_err_tq_dif_isc_mon_1 lv_err_tq_req_mon_1 /end OUT_MEASUREMENT
/end FUNCTION
/begin FUNCTION MON_Processor_Monitoring_by_copy "_Processor Monitoring by copy of Process Monitoring"
 /begin DEF_CHARACTERISTIC c_n_max_mtc_lih_thd_mon2 c_tqi_sp_dec_max_mon2 c_t_tqi_mon2 c_iga_ref_egr_cor_lim_mon2 lc_val_mo2_ans id_n_32_mon2__idx id_sf_2_mon2__idx ip_tqi_dif_max_mon2 id_tq_max_clu_mon2__idx id_state_iv_mon2__idx id_iga_ref_egr_cor_mon2__idx id_t_tqi_mon2__idx id_tqi_sp_mon2__idx id_abc_tqi_av_mon2__idx ip_fac_tq_req_driv_mon2 ip_tqi_ref_mon2 id_abc_tqi_n_max_mon2__idx ip_eff_iga_mon2 id_tq_dif_p_d_is_mon2__idx id_tq_egs_mon2__idx id_iga_igc_mon2__idx id_tq_esp_mon2__idx id_maf_mon2__idx id_pv_av_mon2__idx id_tq_loss_mon2__idx ip_iga_ref_mon2 id_sf_1_mon2__idx id_tq_min_clu_mon2__idx id_fac_tq_req_cru_mon2__idx id_inh_swi_iv_mon2__idx id_lv_rng_l_req_mon2__idx ip_fac_tq_req_driv_rng_l_mon2 val_mo3_swi_cal_cks /end DEF_CHARACTERISTIC
 /begin OUT_MEASUREMENT fac_tq_req_driv_mon sf_1_mon2.bf.lv_tqi_mon_act_mon2_sf sf_1_mon2.bf.lv_n_lim_etc_mon2_sf sf_1_mon2.bf.lv_err_conv_mon2_sf sf_1_mon2.bf.lv_err_n_32_mon2_sf sf_1_mon2.bf.lv_err_tq_dif_p_d_is_mon2_sf sf_1_mon2.bf.lv_err_tq_dif_i_is_mon2_sf sf_1_mon2.bf.lv_err_tq_loss_mon2_sf sf_1_mon2.bf.lv_err_tq_min_clu_mon2_sf sf_1_mon2.bf.lv_err_tq_max_clu_mon2_sf sf_1_mon2.bf.lv_err_pvs_mon2_sf sf_1_mon2.bf.lv_err_tps_mon2_sf sf_1_mon2.bf.lv_err_maf_mon2_sf sf_1_mon2.word sf_2_mon2.bf.val_mo3_pwr_stag_dis_mc_mon2_sf sf_2_mon2.bf.lv_err_tran_ena_mon2_sf sf_2_mon2.bf.lv_n_lim_req_mon2_sf sf_2_mon2.bf.lv_off_mtc_iv_mu_mon2_sf sf_2_mon2.bf.lv_off_iv_mon2_sf sf_2_mon2.bf.lv_off_mtc_mon2_sf sf_2_mon2.bf.lv_err_tqi_av_mon2_sf sf_2_mon2.bf.lv_err_tqi_n_max_mon2_sf sf_2_mon2.word state_iv_mon2.bf.lv_prev_state_iv0_mon2_sf state_iv_mon2.bf.lv_prev_state_iv1_mon2_sf state_iv_mon2.bf.lv_prev_state_iv2_mon2_sf state_iv_mon2.bf.lv_prev_state_iv3_mon2_sf state_iv_mon2.bf.lv_prev_state_iv4_mon2_sf state_iv_mon2.bf.lv_prev_state_iv5_mon2_sf state_iv_mon2.word val_mo2_ans_tst fac_tq_req_mon2 fac_tq_req_driv_mon2 tq_esp_mon2 tq_loss_mon2 tqi_av_mon2 pv_av_mon2 fac_tq_req_cru_mon2 tq_dif_p_d_is_mon2 tq_min_clu_mon2 maf_mon2 abc_tqi_av_mon2 n_32_mon2 tq_max_clu_mon2 tqi_dif_max_mon2 iga_ref_egr_cor_mon2 iga_ref_cor_mon2 tqi_dif_mon2 abc_tqi_n_max_mon2 tqi_req_tot_mon2 iga_igc_mon2 tqi_sp_mon2 tq_egs_mon2 eff_iga_av_mon2 eff_scc_av_2_mon2 eff_scc_av_mon2 eff_scc_av_1_mon2 t_tqi_mon2 inh_swi_iv_mon2 val_mo3_av_cal_cks_high val_mo3_av_cal_cks_low val_mo2_ans /end OUT_MEASUREMENT
/end FUNCTION
/begin FUNCTION MON_Processor_Monitoring "_Processor Monitoring"
 /begin DEF_CHARACTERISTIC val_mo3_cal_cks_high val_mo3_cal_cks_low val_mo3_ans_cpm_tab /end DEF_CHARACTERISTIC
 /begin OUT_MEASUREMENT val_mo3_predrive_act val_mo3_tst_rec_idx_mo2 bios_test_ecu_ram bios_test_ecu_ram_cpl /end OUT_MEASUREMENT
/end FUNCTION
/end MODULE
/end PROJECT
