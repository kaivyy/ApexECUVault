ASAP2_VERSION 1 41
/begin PROJECT MSD85 "Spray Guided DI-System with Piezo Injectors for 8-Cylinder"
/begin HEADER "_default_HeaderComment" PROJECT_NO _91 /end HEADER
/begin MODULE _default_ModuleName "_default_ModuleLongIdentifier"
/begin MOD_COMMON "_default_ModCommonComment" DEPOSIT ABSOLUTE BYTE_ORDER MSB_LAST ALIGNMENT_BYTE 1 ALIGNMENT_WORD 2 ALIGNMENT_LONG 2 ALIGNMENT_FLOAT32_IEEE 2 ALIGNMENT_FLOAT64_IEEE 4 /end MOD_COMMON
/begin MEASUREMENT A_quer "Querbeschleunigung" SWORD _CNV_R_R_Def_a_sw_b_549_CM 1 100. -64. 63.998 DISPLAY_IDENTIFIER A_QUER ECU_ADDRESS 0xd000c7b8 FORMAT "%7.2" /end MEASUREMENT
/begin MEASUREMENT Acfzgl "Fahrzeuglängsbeschleunigung" SBYTE _CNV_R_R_Def_ac_sb__552_CM 1 100. -32. 31.75 DISPLAY_IDENTIFIER ACFZGL ECU_ADDRESS 0xd000c7ba FORMAT "%4.1" /end MEASUREMENT
/begin MEASUREMENT Acfzgq "Fahrzeugquerbeschleunigung" SBYTE _CNV_R_R_Def_ac_sb__552_CM 1 100. -32. 31.75 DISPLAY_IDENTIFIER ACFZGQ ECU_ADDRESS 0xc00005ac FORMAT "%4.1" /end MEASUREMENT
/begin MEASUREMENT Agr_rate "AGR-Rate" UWORD _CNV_R_R_Def_f_uw_b_555_CM 1 100. 0. 99.9984 DISPLAY_IDENTIFIER AGR_RATE ECU_ADDRESS 0xd000cc50 FORMAT "%8.3" /end MEASUREMENT
/begin MEASUREMENT Agr_soll "Gesamt AGR Anforderung" UWORD _CNV_R_R_Def_f_uw_b_555_CM 1 100. 0. 99.9984 DISPLAY_IDENTIFIER AGR_SOLL ECU_ADDRESS 0xd000cc44 FORMAT "%8.3" /end MEASUREMENT
/begin MEASUREMENT Agrpos "AGR-Ventile Ist-Position Mittelwert" UWORD _CNV_R_R_Def_f_uw_b_555_CM 1 100. 0. 99.9984 DISPLAY_IDENTIFIER AGRPOS ECU_ADDRESS 0xd000c7bc FORMAT "%8.3" /end MEASUREMENT
/begin MEASUREMENT Agrpos_i "AGR-Ventile Ist-Position Feldvariable" UWORD _CNV_R_R_Def_f_uw_b_555_CM 1 100. 0. 99.9984 DISPLAY_IDENTIFIER AGRPOS_I ECU_ADDRESS 0xd000c7be FORMAT "%8.3" ARRAY_SIZE 2 MATRIX_DIM 2 1 1 /end MEASUREMENT
/begin MEASUREMENT Agrpos_soll "AGR-Ventil Sollposition" UWORD _CNV_R_R_Def_f_uw_b_555_CM 1 100. 0. 99.9984 DISPLAY_IDENTIFIER AGRPOS_SOLL ECU_ADDRESS 0xd000cc42 FORMAT "%8.3" /end MEASUREMENT
/begin MEASUREMENT Agrpos_soll_i "AGR-Ventil Sollposition beider Ventile" UWORD _CNV_R_R_Def_f_uw_b_555_CM 1 100. 0. 99.9984 DISPLAY_IDENTIFIER AGRPOS_SOLL_I ECU_ADDRESS 0xd000cca0 FORMAT "%8.3" ARRAY_SIZE 2 MATRIX_DIM 2 1 1 /end MEASUREMENT
/begin MEASUREMENT Arbsp_cnt "Zaehler fuer Anzahl Arbeitsspiele" UBYTE _CNV_R_R_Def_dez_sl_551_CM 1 100. 0. 255. DISPLAY_IDENTIFIER ARBSP_CNT ECU_ADDRESS 0xc00008b4 FORMAT "%3.0" /end MEASUREMENT
/begin MEASUREMENT Ba_ist_ewp "EWAPU Betriebsart" UBYTE _CNV_S_11_Def_ba_ewp_566_CM 1 100. 0. 10. DISPLAY_IDENTIFIER BA_IST_EWP ECU_ADDRESS 0xc00005ad BIT_MASK 0xFF /end MEASUREMENT
/begin MEASUREMENT Ba_switch_uek "Schalter für Wandfilmkompensation" UBYTE _CNV_R_R_Def_dez_sl_551_CM 1 100. 0. 255. DISPLAY_IDENTIFIER BA_SWITCH_UEK ECU_ADDRESS 0xc00006df FORMAT "%3.0" /end MEASUREMENT
/begin MEASUREMENT Batt_class "Klassifizierung der in diesem Fzg. eingebauten Batterie" UBYTE _CNV_R_R_Def_dez_sl_551_CM 1 100. 0. 255. DISPLAY_IDENTIFIER BATT_CLASS ECU_ADDRESS 0xc0004000 FORMAT "%3.0" /end MEASUREMENT
/begin MEASUREMENT Batt_coort "Codierter Batterieeinbauort" UBYTE _CNV_R_R_Def_dez_sl_551_CM 1 100. 0. 255. DISPLAY_IDENTIFIER BATT_COORT ECU_ADDRESS 0xc00005ae FORMAT "%3.0" /end MEASUREMENT
/begin MEASUREMENT Baw_katman1 "Statuswort Katheizanforderung - priorisierter Wunsch" UWORD _CNV_R_R_Def_dez_sl_551_CM 1 100. 0. 65535. DISPLAY_IDENTIFIER BAW_KATMAN1 ECU_ADDRESS 0xd000c7c2 FORMAT "%5.0" /end MEASUREMENT
/begin MEASUREMENT Baw_katman2 "Statuswort Katheizanforderung - alternativ Wunsch" UWORD _CNV_R_R_Def_dez_sl_551_CM 1 100. 0. 65535. DISPLAY_IDENTIFIER BAW_KATMAN2 ECU_ADDRESS 0xd000c7c4 FORMAT "%5.0" /end MEASUREMENT
/begin MEASUREMENT Baw_tester "Testeranforderung von Zulieferer" UWORD _CNV_R_R_Def_dez_sl_551_CM 1 100. 0. 65535. DISPLAY_IDENTIFIER BAW_TESTER ECU_ADDRESS 0xd000c7c6 FORMAT "%5.0" /end MEASUREMENT
/begin MEASUREMENT Bordnetz "Ausgewähltes Bordnetz(0x01 => CAN11H, 0x02 => CAN12H(BN2000))" UBYTE _CNV_R_R_Def_dez_sl_551_CM 1 100. 0. 255. DISPLAY_IDENTIFIER BORDNETZ ECU_ADDRESS 0xd000c7c8 FORMAT "%3.0" /end MEASUREMENT
/begin MEASUREMENT Bosanfsgbd "BOS-Lesen-Anforderung vom Tester: 0 = keine Anforderung 1 = OZ soll senden, wird erst dann zurückgesetzt, wenn Bostoken = 1 8 = PM soll senden, wird erst dann zurückgsetetzt wenn Bostoken = 8" UBYTE _CNV_R_R_Def_dez_sl_551_CM 1 100. 0. 255. DISPLAY_IDENTIFIER BOSANFSGBD ECU_ADDRESS 0xd000c7c9 FORMAT "%3.0" /end MEASUREMENT
/begin MEASUREMENT Bosbtvfbkt "Verfügbarkeit über Tester" UBYTE _CNV_R_R_Def_dez_sl_551_CM 1 100. 0. 255. DISPLAY_IDENTIFIER BOSBTVFBKT ECU_ADDRESS 0xc00005af FORMAT "%3.0" /end MEASUREMENT
/begin MEASUREMENT Bosfxid2r "ID_Funktion_BOS_Rückstellung_2" UWORD _CNV_R_R_Def_dez_sl_551_CM 1 100. 0. 65535. DISPLAY_IDENTIFIER BOSFXID2R ECU_ADDRESS 0xc00005b0 FORMAT "%5.0" /end MEASUREMENT
/begin MEASUREMENT Bosid2r "ID_2_BOS_Rückstellung_2" UBYTE _CNV_R_R_Def_dez_sl_551_CM 1 100. 0. 255. DISPLAY_IDENTIFIER BOSID2R ECU_ADDRESS 0xc00005b2 FORMAT "%3.0" /end MEASUREMENT
/begin MEASUREMENT Bosjzielr "Zieltermin_Monat_BOS_Rückstellung_2" UBYTE _CNV_R_R_Def_dez_sl_551_CM 1 100. 0. 255. DISPLAY_IDENTIFIER BOSJZIELR ECU_ADDRESS 0xc00005b3 FORMAT "%3.0" /end MEASUREMENT
/begin MEASUREMENT Bosjzielt "Zieltermin_Jahr vom Tester" UBYTE _CNV_R_R_Def_dez_sl_551_CM 1 100. 0. 255. DISPLAY_IDENTIFIER BOSJZIELT ECU_ADDRESS 0xc00005b4 FORMAT "%3.0" /end MEASUREMENT
/begin MEASUREMENT Bosmzielr "Zieltermin_Jahr_BOS_Rückstellung_2" UBYTE _CNV_R_R_Def_dez_sl_551_CM 1 100. 0. 255. DISPLAY_IDENTIFIER BOSMZIELR ECU_ADDRESS 0xc00005b5 FORMAT "%3.0" /end MEASUREMENT
/begin MEASUREMENT Bosmzielt "Zieltermin_Monat vom Tester" UBYTE _CNV_R_R_Def_dez_sl_551_CM 1 100. 0. 255. DISPLAY_IDENTIFIER BOSMZIELT ECU_ADDRESS 0xc00005b6 FORMAT "%3.0" /end MEASUREMENT
/begin MEASUREMENT Bosprog2r "Prognose_Intervall_Zeit_BOS_Rückstellung_2" UBYTE _CNV_R_R_Def_dez_sl_551_CM 1 100. 0. 255. DISPLAY_IDENTIFIER BOSPROG2R ECU_ADDRESS 0xc0004001 FORMAT "%3.0" /end MEASUREMENT
/begin MEASUREMENT Bosprog2t "Prognose_Intervall_Zeit vom Tester" UBYTE _CNV_R_R_Def_dez_sl_551_CM 1 100. 0. 255. DISPLAY_IDENTIFIER BOSPROG2T ECU_ADDRESS 0xc0007450 FORMAT "%3.0" /end MEASUREMENT
/begin MEASUREMENT Bosrlsmr "Restlaufleistung vom Kombi" SWORD _CNV_R_R_Def_dez_sl_551_CM 1 100. -32768. 32767. DISPLAY_IDENTIFIER BOSRLSMR ECU_ADDRESS 0xc00005b8 FORMAT "%5.0" /end MEASUREMENT
/begin MEASUREMENT Bosrlsmt "Restlaufstrecke vom Tester" SWORD _CNV_R_R_Def_dez_sl_551_CM 1 100. -32768. 32767. DISPLAY_IDENTIFIER BOSRLSMT ECU_ADDRESS 0xc0007452 FORMAT "%5.0" /end MEASUREMENT
/begin MEASUREMENT Bosrw2r "Prognose_Intervall_Weg_BOS_Rückstellung_2" UBYTE _CNV_R_R_Def_km_ub__428_CM 1 100. 0. 255000. DISPLAY_IDENTIFIER BOSRW2R ECU_ADDRESS 0xc00005ba FORMAT "%3.0" /end MEASUREMENT
/begin MEASUREMENT Bosrw2t "Prognose_Intervall_Weg vom Tester" UBYTE _CNV_R_R_Def_km_ub__428_CM 1 100. 0. 255000. DISPLAY_IDENTIFIER BOSRW2T ECU_ADDRESS 0xc00005bb FORMAT "%3.0" /end MEASUREMENT
/begin MEASUREMENT Bosun "Einheit für Bosrlsmr" UBYTE _CNV_R_R_Def_dez_sl_551_CM 1 100. 0. 255. DISPLAY_IDENTIFIER BOSUN ECU_ADDRESS 0xc0007454 FORMAT "%3.0" /end MEASUREMENT
/begin MEASUREMENT Bosunt "Einheit für Bosrlsmt" UBYTE _CNV_R_R_Def_dez_sl_551_CM 1 100. 0. 255. DISPLAY_IDENTIFIER BOSUNT ECU_ADDRESS 0xc0007455 FORMAT "%3.0" /end MEASUREMENT
/begin MEASUREMENT Bosv "Verfügbarkeit vom Kombi" UBYTE _CNV_R_R_Def_dez_sl_551_CM 1 100. 0. 255. DISPLAY_IDENTIFIER BOSV ECU_ADDRESS 0xc00005bc FORMAT "%3.0" /end MEASUREMENT
/begin MEASUREMENT Bsdcontrol "3 Byte Schnittstelle kt_ibs" UBYTE _CNV_R_R_Def_dez_sl_551_CM 1 100. 0. 255. DISPLAY_IDENTIFIER BSDCONTROL ECU_ADDRESS 0xc00005bd FORMAT "%3.0" /end MEASUREMENT
/begin MEASUREMENT Bsddata "3 Byte Schnittstelle kt_ibs" UBYTE _CNV_R_R_Def_dez_sl_551_CM 1 100. 0. 255. DISPLAY_IDENTIFIER BSDDATA ECU_ADDRESS 0xc00005be FORMAT "%3.0" /end MEASUREMENT
/begin MEASUREMENT Bsdgencv "Chipversion Generator 1" UBYTE _CNV_R_R_Def_dez_sl_551_CM 1 100. 0. 255. DISPLAY_IDENTIFIER BSDGENCV ECU_ADDRESS 0xc0007456 FORMAT "%3.0" /end MEASUREMENT
/begin MEASUREMENT Bsdgenregv "Reglerversion Generator 1" UBYTE _CNV_R_R_Def_dez_sl_551_CM 1 100. 0. 255. DISPLAY_IDENTIFIER BSDGENREGV ECU_ADDRESS 0xc0007457 FORMAT "%3.0" /end MEASUREMENT
/begin MEASUREMENT Bsdregadr "3 Byte Schnittstelle für kt_ibs" UBYTE _CNV_R_R_Def_dez_sl_551_CM 1 100. 0. 255. DISPLAY_IDENTIFIER BSDREGADR ECU_ADDRESS 0xc00005bf FORMAT "%3.0" /end MEASUREMENT
/begin MEASUREMENT Ctrpwrentl "Prio CF aufgrund Entlastung" UWORD _CNV_R_R_Def_dez_sl_551_CM 1 100. 0. 65535. DISPLAY_IDENTIFIER CTRPWRENTL ECU_ADDRESS 0xc00006e2 FORMAT "%5.0" /end MEASUREMENT
/begin MEASUREMENT D_la_sa1 "Lambdakorrektur bei Ende Schubabschaltung Bank 1" UWORD _CNV_R_R_Def_f_uw_b_559_CM 1 100. 0. 15.9997 DISPLAY_IDENTIFIER D_LA_SA1 ECU_ADDRESS 0xd000c7ca FORMAT "%9.4" /end MEASUREMENT
/begin MEASUREMENT D_la_sa2 "Lambdakorrektur bei Ende der Schubabschaltung Bank 2" UWORD _CNV_R_R_Def_f_uw_b_559_CM 1 100. 0. 15.9997 DISPLAY_IDENTIFIER D_LA_SA2 ECU_ADDRESS 0xd000c7cc FORMAT "%9.4" /end MEASUREMENT
/begin MEASUREMENT Dfgrob "Grobwert Auslastungsgrad Generator 1" UBYTE _CNV_R_R_Def_dez_sl_551_CM 1 100. 0. 255. DISPLAY_IDENTIFIER DFGROB ECU_ADDRESS 0xc00005c0 FORMAT "%3.0" /end MEASUREMENT
/begin MEASUREMENT Dfsiggen "Auslastungsgrad Generator 1" UBYTE _CNV_R_R_Def_f_ub_b_586_CM 1 100. 0. 99.60930000000001 DISPLAY_IDENTIFIER DFSIGGEN ECU_ADDRESS 0xc00005c1 FORMAT "%5.2" /end MEASUREMENT
/begin MEASUREMENT Disa_ist "Ist Position Disa" UWORD _CNV_R_R_Def_f_uw_b_555_CM 1 100. 0. 99.9984 DISPLAY_IDENTIFIER DISA_IST ECU_ADDRESS 0xd000c7ce FORMAT "%8.3" /end MEASUREMENT
/begin MEASUREMENT Dm_ab_fws "Fahrwiderstand" SLONG _CNV_R_R_Def_m_sw_q_554_CM 1 100. -214748364.8 214748364.7 DISPLAY_IDENTIFIER DM_AB_FWS ECU_ADDRESS 0xd000c7d0 FORMAT "%9.2" /end MEASUREMENT
/begin MEASUREMENT Dpfregst "Status Dieselpartikelfilterregeneration" ULONG _CNV_R_R_Def_dez_sl_551_CM 1 100. 0. 4294967295. DISPLAY_IDENTIFIER DPFREGST ECU_ADDRESS 0xc00006be FORMAT "%7.0" /end MEASUREMENT
/begin MEASUREMENT Dpsr "Differenzdruck Saugrohr" SWORD _CNV_R_R_Def_p_sw_q_576_CM 1 100. -1280. 1279.9609 DISPLAY_IDENTIFIER DPSR ECU_ADDRESS 0xd000c7d4 FORMAT "%7.2" /end MEASUREMENT
/begin MEASUREMENT Dpsr_seg "Differenzdruck Saugrohr" SWORD _CNV_R_R_Def_p_sw_q_576_CM 1 100. -1280. 1279.9609 DISPLAY_IDENTIFIER DPSR_SEG ECU_ADDRESS 0xd000c7d6 FORMAT "%7.2" /end MEASUREMENT
/begin MEASUREMENT Drfkh_s "Luftmassendifferenz für S - KH" SWORD _CNV_R_R_Def_rf_sw__598_CM 1 100. -327.68 327.67 DISPLAY_IDENTIFIER DRFKH_S ECU_ADDRESS 0xd000c7d8 FORMAT "%9.4" /end MEASUREMENT
/begin MEASUREMENT Dwesb3_kh_s "Delta-Winkel Zündung <-> Einspritzbeginn 3. Einspritzung Schicht" SWORD _CNV_R_R_Def_kw_sw__603_CM 1 100. -768. 767.9765 DISPLAY_IDENTIFIER DWESB3_KH_S ECU_ADDRESS 0xd000c7da FORMAT "%8.3" /end MEASUREMENT
/begin MEASUREMENT Dwese2_kh_h "Delta-Winkel Zündung <-> Einspritzende 2. Einspritzung homogen" SWORD _CNV_R_R_Def_kw_sw__603_CM 1 100. -768. 767.9765 DISPLAY_IDENTIFIER DWESE2_KH_H ECU_ADDRESS 0xd000c7dc FORMAT "%8.3" /end MEASUREMENT
/begin MEASUREMENT Dzw_agr_kor "Korrektur des Grundzündwinkels aus AGR" SWORD _CNV_R_R_Def_zw_sw__604_CM 1 100. -50. 60. DISPLAY_IDENTIFIER DZW_AGR_KOR ECU_ADDRESS 0xd000c7de FORMAT "%6.1" /end MEASUREMENT
/begin MEASUREMENT Dzw_annm "Referenzwert fuer B_kftkr" SWORD _CNV_R_R_Def_zw_sw__604_CM 1 100. -50. 60. DISPLAY_IDENTIFIER DZW_ANNM ECU_ADDRESS 0xc0007a1a FORMAT "%6.1" /end MEASUREMENT
/begin MEASUREMENT Dzw_anns "Sollausgangswert ohne Beruecksichtigung Maximalwert aus Zwkr_mx" SWORD _CNV_R_R_Def_zw_sw__604_CM 1 100. -50. 60. DISPLAY_IDENTIFIER DZW_ANNS ECU_ADDRESS 0xd000d7b6 FORMAT "%6.1" /end MEASUREMENT
/begin MEASUREMENT Dzw_eps "Fehler Lernalgorithmus" FLOAT32_IEEE _CNV_R_R_Def_dez_sl_551_CM 1 100. -1000000000000. 10000000000000. DISPLAY_IDENTIFIER DZW_EPS ECU_ADDRESS 0xc00008b6 FORMAT "%14.7" /end MEASUREMENT
/begin MEASUREMENT Dzw_kh_s "Ignition angle difference Startified" SWORD _CNV_R_R_Def_zw_sw__604_CM 1 100. -50. 60. DISPLAY_IDENTIFIER DZW_KH_S ECU_ADDRESS 0xd000c7e0 FORMAT "%6.1" /end MEASUREMENT
/begin MEASUREMENT Dzw_kr "Zündwinkeleingriff durch Klopfregelung" SWORD _CNV_R_R_Def_zw_sw__604_CM 1 100. -50. 60. DISPLAY_IDENTIFIER DZW_KR ECU_ADDRESS 0xd000c7e4 FORMAT "%6.1" ARRAY_SIZE 8 MATRIX_DIM 8 1 1 /end MEASUREMENT
/begin MEASUREMENT Dzw_krann "Zuendwinkelaenderung aus Adaption Klopfregelung" SWORD _CNV_R_R_Def_zw_sw__604_CM 1 100. -50. 60. DISPLAY_IDENTIFIER DZW_KRANN ECU_ADDRESS 0xd000d7ae FORMAT "%6.1" /end MEASUREMENT
/begin MEASUREMENT Dzw_krann_hs "Zuendwinkelaenderung aus Adaption Klopfregelung fuer Homogen-Schicht-Betrieb" SWORD _CNV_R_R_Def_zw_sw__604_CM 1 100. -50. 60. DISPLAY_IDENTIFIER DZW_KRANN_HS ECU_ADDRESS 0xd000d7b0 FORMAT "%6.1" /end MEASUREMENT
/begin MEASUREMENT Dzw_krann_vl "Delta-Zuendwinkel bei Vollast" SWORD _CNV_R_R_Def_zw_sw__604_CM 1 100. -50. 60. DISPLAY_IDENTIFIER DZW_KRANN_VL ECU_ADDRESS 0xc0007a1c FORMAT "%6.1" /end MEASUREMENT
/begin MEASUREMENT Dzw_mkr "Mittlere Spätstellung Klopfregelung" SWORD _CNV_R_R_Def_zw_sw__604_CM 1 100. -50. 60. DISPLAY_IDENTIFIER DZW_MKR ECU_ADDRESS 0xd000c7f4 FORMAT "%6.1" /end MEASUREMENT
/begin MEASUREMENT Dzw_mm "Über 100ms gemittelter Wert Zw_diffmkr" SWORD _CNV_R_R_Def_zw_sw__604_CM 1 100. -50. 60. DISPLAY_IDENTIFIER DZW_MM ECU_ADDRESS 0xc00008ae FORMAT "%6.1" /end MEASUREMENT
/begin MEASUREMENT Dzw_nn "Lernsollwert fuer Lolimot-KNN" SWORD _CNV_R_R_Def_zw_sw__604_CM 1 100. -50. 60. DISPLAY_IDENTIFIER DZW_NN ECU_ADDRESS 0xc00008b2 FORMAT "%6.1" /end MEASUREMENT
/begin MEASUREMENT Eco_max_i "Max. Ruhestromschwelle" UBYTE _CNV_R_R_Def_i_ub_q_608_CM 1 100. 0. 0.3187 DISPLAY_IDENTIFIER ECO_MAX_I ECU_ADDRESS 0xc00005c2 /end MEASUREMENT
/begin MEASUREMENT Eco_msb "Ecos Messtartbedingung" UBYTE _CNV_R_R_Def_td_ub__609_CM 1 100. 0. 12.75 DISPLAY_IDENTIFIER ECO_MSB ECU_ADDRESS 0xc0004002 FORMAT "%5.2" /end MEASUREMENT
/begin MEASUREMENT Eco_mz "Dauer Mittelwertmessung" UBYTE _CNV_R_R_Def_td_ub__609_CM 1 100. 0. 12.75 DISPLAY_IDENTIFIER ECO_MZ ECU_ADDRESS 0xc00005c3 FORMAT "%5.2" /end MEASUREMENT
/begin MEASUREMENT Eco_timo "Ecos Messung Timeout" UBYTE _CNV_R_R_Def_td_ub__611_CM 1 100. 0. 255. DISPLAY_IDENTIFIER ECO_TIMO ECU_ADDRESS 0xc00005c4 FORMAT "%5.2" /end MEASUREMENT
/begin MEASUREMENT Eta_zw_ist_novbr "Aktueller Zündwinkelwirkungsgrad ohne Eingriff der Verbrennungsregelung" SWORD _CNV_R_R_Def_eta_sw_606_CM 1 100. 0. 100. DISPLAY_IDENTIFIER ETA_ZW_IST_NOVBR ECU_ADDRESS 0xd000cca4 FORMAT "%8.3" /end MEASUREMENT
/begin MEASUREMENT Eta_zw_ve "Zündwinkelwirkungsgrad vor Eingriff der Momentenstruktur" SWORD _CNV_R_R_Def_eta_sw_606_CM 1 100. 0. 100. DISPLAY_IDENTIFIER ETA_ZW_VE ECU_ADDRESS 0xd000cc90 FORMAT "%8.3" /end MEASUREMENT
/begin MEASUREMENT Eta_zyl_aus "Wirkungsgrad" SWORD _CNV_R_R_Def_eta_sw_606_CM 1 100. 0. 100. DISPLAY_IDENTIFIER ETA_ZYL_AUS ECU_ADDRESS 0xd000c7f6 FORMAT "%8.3" /end MEASUREMENT
/begin MEASUREMENT Eta_zylausbas "Wirkungsgrad bei defekte Zylinder" UWORD _CNV_R_R_Def_eta_uw_615_CM 1 100. 0. 199.9969 DISPLAY_IDENTIFIER ETA_ZYLAUSBAS ECU_ADDRESS 0xc0007458 FORMAT "%8.3" /end MEASUREMENT
/begin MEASUREMENT Exwink2_ist "Gefilterter VVT-Istwert Bank 2" UWORD _CNV_R_R_Def_exwink_585_CM 1 100. 0. 180. DISPLAY_IDENTIFIER EXWINK2_IST ECU_ADDRESS 0xd000cc6a FORMAT "%7.2" /end MEASUREMENT
/begin MEASUREMENT Exwink_ist "-" UWORD _CNV_R_R_Def_exwink_585_CM 1 100. 0. 180. DISPLAY_IDENTIFIER EXWINK_IST ECU_ADDRESS 0xd000cce0 FORMAT "%7.2" /end MEASUREMENT
/begin MEASUREMENT Exwinkkor "Korrekturwinkel Excenterwelle zur Hubkorrektur" SWORD _CNV_R_R_Def_exwink_585_CM 1 100. -720. 180. DISPLAY_IDENTIFIER EXWINKKOR ECU_ADDRESS 0xd000cce2 FORMAT "%7.2" /end MEASUREMENT
/begin MEASUREMENT Exwinkkor_ist2 "Excenterwinkel für Korrektur" UWORD _CNV_R_R_Def_exwink_585_CM 1 100. 0. 1439.978 DISPLAY_IDENTIFIER EXWINKKOR_IST2 ECU_ADDRESS 0xd000cc6c FORMAT "%7.2" /end MEASUREMENT
/begin MEASUREMENT F_grad_katalt "Nox-Kat-Alterungs- gradient" SWORD _CNV_R_R_Def_f_sw_b_620_CM 1 100. -0.1 9.99e-002 DISPLAY_IDENTIFIER F_GRAD_KATALT ECU_ADDRESS 0xd000c7f8 FORMAT "%14.5" /end MEASUREMENT
/begin MEASUREMENT F_katalt "Nox-Kat- Alterung" UWORD _CNV_R_R_Def_f_uw_b_571_CM 1 100. 0. 0.9999 DISPLAY_IDENTIFIER F_KATALT ECU_ADDRESS 0xd000c7fa FORMAT "%14.5" /end MEASUREMENT
/begin MEASUREMENT F_katalt_tabg "thermische Nox-Kat- Alterung" UWORD _CNV_R_R_Def_f_uw_b_571_CM 1 100. 0. 0.9999 DISPLAY_IDENTIFIER F_KATALT_TABG ECU_ADDRESS 0xd000c7fc FORMAT "%14.5" /end MEASUREMENT
/begin MEASUREMENT F_lakor1 "Faktor Lin-Lambdaregler" SWORD _CNV_R_R_Def_rel_sw_562_CM 1 100. -100. 99.9969 DISPLAY_IDENTIFIER F_LAKOR1 ECU_ADDRESS 0xd000c7fe FORMAT "%8.3" /end MEASUREMENT
/begin MEASUREMENT F_lakor2 "Faktor Lin-Lambdaregler" SWORD _CNV_R_R_Def_rel_sw_562_CM 1 100. -100. 99.9969 DISPLAY_IDENTIFIER F_LAKOR2 ECU_ADDRESS 0xd000c800 FORMAT "%8.3" /end MEASUREMENT
/begin MEASUREMENT F_lrad_in1 "Faktor für Lambdaadaption Bank1" SWORD _CNV_R_R_Def_f_sw_q_550_CM 1 100. -50. 49.9984 DISPLAY_IDENTIFIER F_LRAD_IN1 ECU_ADDRESS 0xc00005c6 FORMAT "%9.4" /end MEASUREMENT
/begin MEASUREMENT F_lrad_in2 "Faktor für Lambdaadaption Bank2" SWORD _CNV_R_R_Def_f_sw_q_550_CM 1 100. -50. 49.9984 DISPLAY_IDENTIFIER F_LRAD_IN2 ECU_ADDRESS 0xc00005c8 FORMAT "%9.4" /end MEASUREMENT
/begin MEASUREMENT F_sicher_rf "Überblendfaktor aus Verbrennungsregelung für Hub und Spreizungen" UBYTE _CNV_R_R_Def_f_ub_b_553_CM 1 100. 0. 0.996 DISPLAY_IDENTIFIER F_SICHER_RF ECU_ADDRESS 0xd000ccd6 /end MEASUREMENT
/begin MEASUREMENT F_sst "" UWORD _CNV_R_R_Def_f_uw_b_571_CM 1 100. 0. 0.9999 DISPLAY_IDENTIFIER F_SST ECU_ADDRESS 0xd000cc70 FORMAT "%14.5" ARRAY_SIZE 8 MATRIX_DIM 8 1 1 /end MEASUREMENT
/begin MEASUREMENT F_start "Startkorrekturen: Umgebungsdruck und Wiederholstart" SWORD _CNV_R_R_Def_rel_sw_562_CM 1 100. -100. 99.9969 DISPLAY_IDENTIFIER F_START ECU_ADDRESS 0xd000c802 FORMAT "%8.3" /end MEASUREMENT
/begin MEASUREMENT F_teblg "Beladungsgrad AKF" SWORD _CNV_R_R_Def_f_sw_b_623_CM 1 100. -64. 63.998 DISPLAY_IDENTIFIER F_TEBLG ECU_ADDRESS 0xd000cca6 FORMAT "%8.3" /end MEASUREMENT
/begin MEASUREMENT F_vst "Gemisch-anreicherungsfaktor gesamt" UWORD _CNV_R_R_Def_f_uw_b_617_CM 1 100. 0. 63.999 DISPLAY_IDENTIFIER F_VST ECU_ADDRESS 0xd000c804 FORMAT "%9.4" /end MEASUREMENT
/begin MEASUREMENT F_wnwkhk_sw "Überblendfaktor (warm/kalt) für Spreizung und Zündhaken während Katheizen von Zulieferer" UBYTE _CNV_R_R_Def_f_ub_b_553_CM 1 100. 0. 0.996 DISPLAY_IDENTIFIER F_WNWKHK_SW ECU_ADDRESS 0xd000c806 /end MEASUREMENT
/begin MEASUREMENT Fahrzeug "Fahrzeugtypbezeichnung (E60 = 60, E65 = 65, E46 = 46)" UBYTE _CNV_R_R_Def_dez_sl_551_CM 1 100. 0. 255. DISPLAY_IDENTIFIER FAHRZEUG ECU_ADDRESS 0xc00005ca FORMAT "%3.0" /end MEASUREMENT
/begin MEASUREMENT Fetrawe "Implementierung Fertigungs-, Transport- und Werkstattmodus mit Tester auslesen" UBYTE _CNV_R_R_Def_dez_sl_551_CM 1 100. 0. 255. DISPLAY_IDENTIFIER FETRAWE ECU_ADDRESS 0xc00005cb FORMAT "%3.0" /end MEASUREMENT
/begin MEASUREMENT Fho "Korrekturfaktor Höhe" UWORD _CNV_R_R_Def_f_uw_b_590_CM 1 100. 0. 1.9999 DISPLAY_IDENTIFIER FHO ECU_ADDRESS 0xc00005cc FORMAT "%14.5" /end MEASUREMENT
/begin MEASUREMENT Ftbr "Faktor Brennraumtemperatur im Brennraum" UWORD _CNV_R_R_Def_f_uw_b_590_CM 1 100. 0. 1.9999 DISPLAY_IDENTIFIER FTBR ECU_ADDRESS 0xd000c808 FORMAT "%14.5" /end MEASUREMENT
/begin MEASUREMENT Gangi "Aktueller Gang intern" UBYTE _CNV_R_R_Def_dez_sl_551_CM 1 100. 0. 255. DISPLAY_IDENTIFIER GANGI ECU_ADDRESS 0xd000c80a FORMAT "%3.0" /end MEASUREMENT
/begin MEASUREMENT Gen_manufak "Herstellercode Generator 1" UBYTE _CNV_R_R_Def_dez_sl_551_CM 1 100. 0. 255. DISPLAY_IDENTIFIER GEN_MANUFAK ECU_ADDRESS 0xc00005ce FORMAT "%3.0" /end MEASUREMENT
/begin MEASUREMENT Gen_typkenn "Kennung Generatortyp Gen 1" UBYTE _CNV_R_R_Def_dez_sl_551_CM 1 100. 0. 255. DISPLAY_IDENTIFIER GEN_TYPKENN ECU_ADDRESS 0xc00005cf FORMAT "%3.0" /end MEASUREMENT
/begin MEASUREMENT I_eff_gs "Strangverstärkung" UWORD _CNV_R_R_Def_strv_u_636_CM 1 100. 0. 511.9921 DISPLAY_IDENTIFIER I_EFF_GS ECU_ADDRESS 0xd000c80c FORMAT "%7.2" /end MEASUREMENT
/begin MEASUREMENT Id_bosrst "ID für BOS-Reset vom Kombi" UBYTE _CNV_R_R_Def_dez_sl_551_CM 1 100. 0. 255. DISPLAY_IDENTIFIER ID_BOSRST ECU_ADDRESS 0xc00005d0 FORMAT "%3.0" /end MEASUREMENT
/begin MEASUREMENT Id_bosrtt "ID f BOS_Reset vom Tester" UBYTE _CNV_R_R_Def_dez_sl_551_CM 1 100. 0. 255. DISPLAY_IDENTIFIER ID_BOSRTT ECU_ADDRESS 0xc00005d1 FORMAT "%3.0" /end MEASUREMENT
/begin MEASUREMENT Id_bosrtw "ID für Motoröl vom Kombi" UWORD _CNV_R_R_Def_dez_sl_551_CM 1 100. 0. 65535. DISPLAY_IDENTIFIER ID_BOSRTW ECU_ADDRESS 0xc00005d2 FORMAT "%5.0" /end MEASUREMENT
/begin MEASUREMENT Ierr "Erregerstrom Generator1" UBYTE _CNV_R_R_Def_i_uw_q_630_CM 1 100. 0. 31.875 DISPLAY_IDENTIFIER IERR ECU_ADDRESS 0xc00005d4 /end MEASUREMENT
/begin MEASUREMENT Ierr_grenz_ext "Grenzerregerstrom vom Tester" UBYTE _CNV_R_R_Def_i_uw_q_630_CM 1 100. 0. 31.875 DISPLAY_IDENTIFIER IERR_GRENZ_EXT ECU_ADDRESS 0xc00005d5 /end MEASUREMENT
/begin MEASUREMENT Ierrfgrenz "Kopie begrenzter Erregerstrom Generator 1" UBYTE _CNV_R_R_Def_i_uw_q_630_CM 1 100. 0. 31.875 DISPLAY_IDENTIFIER IERRFGRENZ ECU_ADDRESS 0xc000745a /end MEASUREMENT
/begin MEASUREMENT Ikurz_ogr "Obere Grenze Kurzschlussstrom vom CAS" UBYTE _CNV_R_R_Def_i_ub_q_644_CM 1 100. 0. 2550. DISPLAY_IDENTIFIER IKURZ_OGR ECU_ADDRESS 0xc0004003 FORMAT "%5.2" /end MEASUREMENT
/begin MEASUREMENT Ikurz_ugr "Untere Grenze Kurzschlussstrom vom CAS" UBYTE _CNV_R_R_Def_i_ub_q_644_CM 1 100. 0. 2550. DISPLAY_IDENTIFIER IKURZ_UGR ECU_ADDRESS 0xc0004004 FORMAT "%5.2" /end MEASUREMENT
/begin MEASUREMENT Ipm_typ_fp "iPM-Fahrertyp zur Beeinflussung der Pedalauswertung" UBYTE _CNV_R_R_Def_dez_sl_551_CM 1 100. 0. 255. DISPLAY_IDENTIFIER IPM_TYP_FP ECU_ADDRESS 0xd000c80e FORMAT "%3.0" /end MEASUREMENT
/begin MEASUREMENT Ipm_typ_mdkw "iPM-Fahrertyp zur Beeinflussung der Soll-Momentenbestimmung" UBYTE _CNV_R_R_Def_dez_sl_551_CM 1 100. 0. 255. DISPLAY_IDENTIFIER IPM_TYP_MDKW ECU_ADDRESS 0xd000c80f FORMAT "%3.0" /end MEASUREMENT
/begin MEASUREMENT Iwakeupgr "Fahrzeugspezifischer Ruhestrom" UBYTE _CNV_R_R_Def_i_sw_q_641_CM 1 100. 0. 0.255 DISPLAY_IDENTIFIER IWAKEUPGR ECU_ADDRESS 0xc0004005 /end MEASUREMENT
/begin MEASUREMENT Kh_sum "Anzahl aufgetretener Klopfereignisse" UBYTE _CNV_R_R_Def_dez_sl_551_CM 1 100. 0. 255. DISPLAY_IDENTIFIER KH_SUM ECU_ADDRESS 0xc00008b5 FORMAT "%3.0" /end MEASUREMENT
/begin MEASUREMENT Khnn "Klopfhaeufigkeit aus Lolimot-KNN" SWORD _CNV_R_R_Def_f_sw_b_570_CM 1 100. -100. 99.9969 DISPLAY_IDENTIFIER KHNN ECU_ADDRESS 0xd000d7b2 FORMAT "%8.3" /end MEASUREMENT
/begin MEASUREMENT Km_st "Kilometerstand" UWORD _CNV_R_R_Def_km_sw__68_CM 1 100. 0. 655350. DISPLAY_IDENTIFIER KM_ST ECU_ADDRESS 0xc0004006 FORMAT "%5.0" /end MEASUREMENT
/begin MEASUREMENT Km_st_1 "Wegstrecke_km auf 1km genau" ULONG _CNV_R_R_Def_dez_sl_551_CM 1 100. 0. 4294967295. DISPLAY_IDENTIFIER KM_ST_1 ECU_ADDRESS 0xc0004008 FORMAT "%7.0" /end MEASUREMENT
/begin MEASUREMENT Kr_kh "Aktuelle Klopfhaeufigkeit aus Mittelwertfilter" SWORD _CNV_R_R_Def_f_sw_b_570_CM 1 100. -100. 99.9969 DISPLAY_IDENTIFIER KR_KH ECU_ADDRESS 0xd000d7b4 FORMAT "%8.3" /end MEASUREMENT
/begin MEASUREMENT Kr_kh_eps "Fehler Lernalgorithmus KHNN" FLOAT32_IEEE _CNV_R_R_Def_dez_sl_551_CM 1 100. -1000000000000. 10000000000000. DISPLAY_IDENTIFIER KR_KH_EPS ECU_ADDRESS 0xc00008ba FORMAT "%14.7" /end MEASUREMENT
/begin MEASUREMENT Krnn_test "Zuendwinkelaenderung aus Adaption Klopfregelung fuer Testerabfrage" SWORD _CNV_R_R_Def_zw_sw__604_CM 1 100. -50. 60. DISPLAY_IDENTIFIER KRNN_TEST ECU_ADDRESS 0xc00008b0 FORMAT "%6.1" /end MEASUREMENT
/begin MEASUREMENT Kvaverbr "Kraftstoffverbrauch (Einspritzmenge in Microliter)" UWORD _CNV_R_R_Def_dez_sl_551_CM 1 100. 0. 65535. DISPLAY_IDENTIFIER KVAVERBR ECU_ADDRESS 0xc00005d6 FORMAT "%5.0" /end MEASUREMENT
/begin MEASUREMENT L_pwmout "Tastverhältnis E-Lüfter" UBYTE _CNV_R_R_Def_f_ub_b_586_CM 1 100. 0. 99.60930000000001 DISPLAY_IDENTIFIER L_PWMOUT ECU_ADDRESS 0xc00005d8 FORMAT "%5.2" /end MEASUREMENT
/begin MEASUREMENT La_ber "" UWORD _CNV_R_R_Def_f_uw_b_559_CM 1 100. 0. 15.9997 DISPLAY_IDENTIFIER LA_BER ECU_ADDRESS 0xd000cc4a FORMAT "%9.4" /end MEASUREMENT
/begin MEASUREMENT La_bszuli1 "Lambdasollwertvorgabe Bauteilschutzfunktion Zulieferer Bank 1" UWORD _CNV_R_R_Def_f_uw_b_559_CM 1 100. 0. 15.9997 DISPLAY_IDENTIFIER LA_BSZULI1 ECU_ADDRESS 0xd000c810 FORMAT "%9.4" /end MEASUREMENT
/begin MEASUREMENT La_bszuli2 "Lambdasollwertvorgabe Bauteilschutzfunktion Zulieferer Bank 2" UWORD _CNV_R_R_Def_f_uw_b_559_CM 1 100. 0. 15.9997 DISPLAY_IDENTIFIER LA_BSZULI2 ECU_ADDRESS 0xd000c812 FORMAT "%9.4" /end MEASUREMENT
/begin MEASUREMENT La_desu1 "Absolute Lambda Sollwert zur Lambda Pulsation Entschwefelung Bank1" UWORD _CNV_R_R_Def_f_uw_b_559_CM 1 100. 0. 15.9997 DISPLAY_IDENTIFIER LA_DESU1 ECU_ADDRESS 0xd000c814 FORMAT "%9.4" /end MEASUREMENT
/begin MEASUREMENT La_desu2 "Absolute Lambda Sollwert zur Lambda Pulsation Entschwefelung Bank2" UWORD _CNV_R_R_Def_f_uw_b_559_CM 1 100. 0. 15.9997 DISPLAY_IDENTIFIER LA_DESU2 ECU_ADDRESS 0xd000c816 FORMAT "%9.4" /end MEASUREMENT
/begin MEASUREMENT La_desu_kh1 "Lambda Sollwert zur Entschwefelung mit Kat Heizung Bank1 (ohne Puls Anteil)" UWORD _CNV_R_R_Def_f_uw_b_559_CM 1 100. 0. 15.9997 DISPLAY_IDENTIFIER LA_DESU_KH1 ECU_ADDRESS 0xd000c818 FORMAT "%9.4" /end MEASUREMENT
/begin MEASUREMENT La_desu_kh2 "Lambda Sollwert zur Entschwefelung mit Kat Heizung Bank2 (ohne Puls Anteil)" UWORD _CNV_R_R_Def_f_uw_b_559_CM 1 100. 0. 15.9997 DISPLAY_IDENTIFIER LA_DESU_KH2 ECU_ADDRESS 0xd000c81a FORMAT "%9.4" /end MEASUREMENT
/begin MEASUREMENT La_es "Lambda zur fetten Entschwefelung" UWORD _CNV_R_R_Def_f_uw_b_559_CM 1 100. 0. 15.9997 DISPLAY_IDENTIFIER LA_ES ECU_ADDRESS 0xd000c81c FORMAT "%9.4" /end MEASUREMENT
/begin MEASUREMENT La_kh1 "Lambda setpoint for CH" UWORD _CNV_R_R_Def_f_uw_b_559_CM 1 100. 0. 15.9997 DISPLAY_IDENTIFIER LA_KH1 ECU_ADDRESS 0xd000c81e FORMAT "%9.4" /end MEASUREMENT
/begin MEASUREMENT La_kh2 "Lambda setpoint for CH" UWORD _CNV_R_R_Def_f_uw_b_559_CM 1 100. 0. 15.9997 DISPLAY_IDENTIFIER LA_KH2 ECU_ADDRESS 0xd000c820 FORMAT "%9.4" /end MEASUREMENT
/begin MEASUREMENT La_pruef1 "Lambda zur Plausibilisierung Bank 1" UWORD _CNV_R_R_Def_f_uw_b_559_CM 1 100. 0. 15.9997 DISPLAY_IDENTIFIER LA_PRUEF1 ECU_ADDRESS 0xd000c822 FORMAT "%9.4" /end MEASUREMENT
/begin MEASUREMENT La_pruef2 "Lamba für Plausibilitätsprüfung" UWORD _CNV_R_R_Def_f_uw_b_559_CM 1 100. 0. 15.9997 DISPLAY_IDENTIFIER LA_PRUEF2 ECU_ADDRESS 0xd000c824 FORMAT "%9.4" /end MEASUREMENT
/begin MEASUREMENT La_puls1 "Anregung Lin-Lambdaregler (forced la stimulation) Bank1" SBYTE _CNV_R_R_Def_f_sb_b_647_CM 1 100. -0.125 0.124 DISPLAY_IDENTIFIER LA_PULS1 ECU_ADDRESS 0xd000c826 FORMAT "%5.2" /end MEASUREMENT
/begin MEASUREMENT La_puls2 "Anregung Lin-Lambdaregler (forced la stimulation) Bank2" SBYTE _CNV_R_R_Def_f_sb_b_647_CM 1 100. -0.125 0.124 DISPLAY_IDENTIFIER LA_PULS2 ECU_ADDRESS 0xd000c827 FORMAT "%5.2" /end MEASUREMENT
/begin MEASUREMENT La_rgn1 "Lambda zur Speicherkatregenerierung" UWORD _CNV_R_R_Def_f_uw_b_559_CM 1 100. 0. 15.9997 DISPLAY_IDENTIFIER LA_RGN1 ECU_ADDRESS 0xd000c828 FORMAT "%9.4" /end MEASUREMENT
/begin MEASUREMENT La_rgn2 "Lambda zur Speicherkatregenerierung" UWORD _CNV_R_R_Def_f_uw_b_559_CM 1 100. 0. 15.9997 DISPLAY_IDENTIFIER LA_RGN2 ECU_ADDRESS 0xd000c82a FORMAT "%9.4" /end MEASUREMENT
/begin MEASUREMENT La_rgn_rpu1 "Lambda zur Regenerierung aus RP System" UWORD _CNV_R_R_Def_f_uw_b_559_CM 1 100. 0. 15.9997 DISPLAY_IDENTIFIER LA_RGN_RPU1 ECU_ADDRESS 0xd000c82c FORMAT "%9.4" /end MEASUREMENT
/begin MEASUREMENT La_rgn_rpu2 "Lambda zur Regenerierung aus RP System" UWORD _CNV_R_R_Def_f_uw_b_559_CM 1 100. 0. 15.9997 DISPLAY_IDENTIFIER LA_RGN_RPU2 ECU_ADDRESS 0xd000c82e FORMAT "%9.4" /end MEASUREMENT
/begin MEASUREMENT La_soll_tester "Lambdaanforderung Tester" UWORD _CNV_R_R_Def_f_uw_b_559_CM 1 100. 0. 15.9997 DISPLAY_IDENTIFIER LA_SOLL_TESTER ECU_ADDRESS 0xd000c830 FORMAT "%9.4" ARRAY_SIZE 2 MATRIX_DIM 2 1 1 /end MEASUREMENT
/begin MEASUREMENT Lam_son1 "Ist-Lambda aus Sonde Bank 1" UWORD _CNV_R_R_Def_f_uw_b_559_CM 1 100. 0. 15.9997 DISPLAY_IDENTIFIER LAM_SON1 ECU_ADDRESS 0xd000c834 FORMAT "%9.4" /end MEASUREMENT
/begin MEASUREMENT Lam_son2 "Ist-Lambda aus Sonde Bank 2" UWORD _CNV_R_R_Def_f_uw_b_559_CM 1 100. 0. 15.9997 DISPLAY_IDENTIFIER LAM_SON2 ECU_ADDRESS 0xd000c836 FORMAT "%9.4" /end MEASUREMENT
/begin MEASUREMENT Lur "Laufunruhewerte zylinderselektiv" SWORD _CNV_R_R_Def_dez_sl_551_CM 1 100. -32768. 32767. DISPLAY_IDENTIFIER LUR ECU_ADDRESS 0xc000745c FORMAT "%5.0" ARRAY_SIZE 8 MATRIX_DIM 8 1 1 /end MEASUREMENT
/begin MEASUREMENT Md_anfhi "Moment Anfahrhilfe" SWORD _CNV_R_R_Def_m_sw_q_554_CM 1 100. -3276.8 3276.7 DISPLAY_IDENTIFIER MD_ANFHI ECU_ADDRESS 0xd000c838 FORMAT "%7.2" /end MEASUREMENT
/begin MEASUREMENT Md_getriebe "Eingangsmoment Getriebe" SWORD _CNV_R_R_Def_m_sw_q_554_CM 1 100. -3276.8 3276.7 DISPLAY_IDENTIFIER MD_GETRIEBE ECU_ADDRESS 0xd000c83a FORMAT "%7.2" /end MEASUREMENT
/begin MEASUREMENT Md_kupp_schalt "Kupplungsaufnahmemoment" SWORD _CNV_R_R_Def_m_sw_q_554_CM 1 100. -3276.8 3276.7 DISPLAY_IDENTIFIER MD_KUPP_SCHALT ECU_ADDRESS 0xd000c83c FORMAT "%7.2" /end MEASUREMENT
/begin MEASUREMENT Md_na_ac "Verlustmoment Klimakompressor" SWORD _CNV_R_R_Def_m_sw_q_554_CM 1 100. -3276.8 3276.7 DISPLAY_IDENTIFIER MD_NA_AC ECU_ADDRESS 0xd000c83e FORMAT "%7.2" /end MEASUREMENT
/begin MEASUREMENT Md_na_ars "Verlustmoment aktive Rollstabilisierung" SWORD _CNV_R_R_Def_m_sw_q_554_CM 1 100. -3276.8 3276.7 DISPLAY_IDENTIFIER MD_NA_ARS ECU_ADDRESS 0xd000c840 FORMAT "%7.2" /end MEASUREMENT
/begin MEASUREMENT Md_na_defrost "Verlustmoment Heckscheibenheizung" SWORD _CNV_R_R_Def_m_sw_q_554_CM 1 100. -3276.8 3276.7 DISPLAY_IDENTIFIER MD_NA_DEFROST ECU_ADDRESS 0xd000c842 FORMAT "%7.2" /end MEASUREMENT
/begin MEASUREMENT Md_na_ef "Verlustmoment EF (Lenkung und ARS)" SWORD _CNV_R_R_Def_m_sw_q_554_CM 1 100. -3276.8 3276.7 DISPLAY_IDENTIFIER MD_NA_EF ECU_ADDRESS 0xd000c844 FORMAT "%7.2" /end MEASUREMENT
/begin MEASUREMENT Md_na_efmax "Maximales Verlustmoment EF (Lenkung und ARS)" SWORD _CNV_R_R_Def_m_sw_q_554_CM 1 100. -3276.8 3276.7 DISPLAY_IDENTIFIER MD_NA_EFMAX ECU_ADDRESS 0xd000c846 FORMAT "%7.2" /end MEASUREMENT
/begin MEASUREMENT Md_na_efprae "PrädiziertesVerlustmoment EF (Lenkung und ARS)" SWORD _CNV_R_R_Def_m_sw_q_554_CM 1 100. -3276.8 3276.7 DISPLAY_IDENTIFIER MD_NA_EFPRAE ECU_ADDRESS 0xd000c848 FORMAT "%7.2" /end MEASUREMENT
/begin MEASUREMENT Md_na_efsoll "Sollmoment EF (Lenkung und ARS)" SWORD _CNV_R_R_Def_m_sw_q_554_CM 1 100. -3276.8 3276.7 DISPLAY_IDENTIFIER MD_NA_EFSOLL ECU_ADDRESS 0xd000c84a FORMAT "%7.2" /end MEASUREMENT
/begin MEASUREMENT Md_na_el "Verlustmoment elektrischer Lüfter" SWORD _CNV_R_R_Def_m_sw_q_554_CM 1 100. -3276.8 3276.7 DISPLAY_IDENTIFIER MD_NA_EL ECU_ADDRESS 0xd000c84c FORMAT "%7.2" /end MEASUREMENT
/begin MEASUREMENT Md_na_ewapu "Verlustmoment elektrische Wasserpumpe" SWORD _CNV_R_R_Def_m_sw_q_554_CM 1 100. -3276.8 3276.7 DISPLAY_IDENTIFIER MD_NA_EWAPU ECU_ADDRESS 0xd000c84e FORMAT "%7.2" /end MEASUREMENT
/begin MEASUREMENT Md_na_ext "" SWORD _CNV_R_R_Def_m_sw_q_554_CM 1 100. -3276.8 3276.7 DISPLAY_IDENTIFIER MD_NA_EXT ECU_ADDRESS 0xd000cc68 FORMAT "%7.2" /end MEASUREMENT
/begin MEASUREMENT Md_na_mlad "Verlustmoment mechanischer Lader" SWORD _CNV_R_R_Def_m_sw_q_554_CM 1 100. -3276.8 3276.7 DISPLAY_IDENTIFIER MD_NA_MLAD ECU_ADDRESS 0xd000c850 FORMAT "%7.2" /end MEASUREMENT
/begin MEASUREMENT Md_na_sl "Verlustmoment Servopumpe" SWORD _CNV_R_R_Def_m_sw_q_554_CM 1 100. -3276.8 3276.7 DISPLAY_IDENTIFIER MD_NA_SL ECU_ADDRESS 0xd000c852 FORMAT "%7.2" /end MEASUREMENT
/begin MEASUREMENT Md_na_sls "Verlustmoment Sekundärluftpumpe" SWORD _CNV_R_R_Def_m_sw_q_554_CM 1 100. -3276.8 3276.7 DISPLAY_IDENTIFIER MD_NA_SLS ECU_ADDRESS 0xd000c854 FORMAT "%7.2" /end MEASUREMENT
/begin MEASUREMENT Md_na_thermo "Verlustmoment Thermostat" SWORD _CNV_R_R_Def_m_sw_q_554_CM 1 100. -3276.8 3276.7 DISPLAY_IDENTIFIER MD_NA_THERMO ECU_ADDRESS 0xd000c856 FORMAT "%7.2" /end MEASUREMENT
/begin MEASUREMENT Md_rad_asrl "Momentenbegrenzung ASR langsamer Pfad" SLONG _CNV_R_R_Def_m_sw_q_554_CM 1 100. -214748364.8 214748364.7 DISPLAY_IDENTIFIER MD_RAD_ASRL ECU_ADDRESS 0xd000c858 FORMAT "%9.2" /end MEASUREMENT
/begin MEASUREMENT Md_rad_asrs "Momentenbegrenzung ASR schneller Pfad" SLONG _CNV_R_R_Def_m_sw_q_554_CM 1 100. -214748364.8 214748364.7 DISPLAY_IDENTIFIER MD_RAD_ASRS ECU_ADDRESS 0xd000c85c FORMAT "%9.2" /end MEASUREMENT
/begin MEASUREMENT Md_rad_msrl "Begrenzungsmoment aus Motorschleppmomentenregelung langsamer Pfad" SLONG _CNV_R_R_Def_m_sw_q_554_CM 1 100. -214748364.8 214748364.7 DISPLAY_IDENTIFIER MD_RAD_MSRL ECU_ADDRESS 0xd000c860 FORMAT "%9.2" /end MEASUREMENT
/begin MEASUREMENT Md_rad_msrs "Begrenzungsradmoment aus Motorschleppmomentenregelung schneller Pfad" SLONG _CNV_R_R_Def_m_sw_q_554_CM 1 100. -214748364.8 214748364.7 DISPLAY_IDENTIFIER MD_RAD_MSRS ECU_ADDRESS 0xd000c864 FORMAT "%9.2" /end MEASUREMENT
/begin MEASUREMENT Md_rad_soll "Soll-Radmoment" SLONG _CNV_R_R_Def_m_sw_q_554_CM 1 100. -214748364.8 214748364.7 DISPLAY_IDENTIFIER MD_RAD_SOLL ECU_ADDRESS 0xd000c868 FORMAT "%9.2" /end MEASUREMENT
/begin MEASUREMENT Md_res_anfhi "Moment Anfahrhilfe" SWORD _CNV_R_R_Def_m_sw_q_554_CM 1 100. -3276.8 3276.7 DISPLAY_IDENTIFIER MD_RES_ANFHI ECU_ADDRESS 0xd000c86c FORMAT "%7.2" /end MEASUREMENT
/begin MEASUREMENT Mdi_accl_plus "Momentenanforderung ACC langsam" SWORD _CNV_R_R_Def_m_sw_q_554_CM 1 100. -3276.8 3276.7 DISPLAY_IDENTIFIER MDI_ACCL_PLUS ECU_ADDRESS 0xd000c86e FORMAT "%7.2" /end MEASUREMENT
/begin MEASUREMENT Mdi_accs_plus "Momentenanforderung ACC schnell" SWORD _CNV_R_R_Def_m_sw_q_554_CM 1 100. -3276.8 3276.7 DISPLAY_IDENTIFIER MDI_ACCS_PLUS ECU_ADDRESS 0xd000c870 FORMAT "%7.2" /end MEASUREMENT
/begin MEASUREMENT Mdi_asr_l "Momentenbegrenzung ASR langsamer Pfad" SWORD _CNV_R_R_Def_m_sw_q_554_CM 1 100. -3276.8 3276.7 DISPLAY_IDENTIFIER MDI_ASR_L ECU_ADDRESS 0xd000c872 FORMAT "%7.2" /end MEASUREMENT
/begin MEASUREMENT Mdi_asr_s "Momentenbegrenzung ASR schneller Pfad" SWORD _CNV_R_R_Def_m_sw_q_554_CM 1 100. -3276.8 3276.7 DISPLAY_IDENTIFIER MDI_ASR_S ECU_ADDRESS 0xd000c874 FORMAT "%7.2" /end MEASUREMENT
/begin MEASUREMENT Mdi_fsb "Momentenbegrenzung bei aktivierter Feststellbremse" SWORD _CNV_R_R_Def_m_sw_q_554_CM 1 100. -3276.8 3276.7 DISPLAY_IDENTIFIER MDI_FSB ECU_ADDRESS 0xd000c876 FORMAT "%7.2" /end MEASUREMENT
/begin MEASUREMENT Mdi_gsl_minus "Langsamer Momenteneingriff EGS : Momentenerniedrigung" SWORD _CNV_R_R_Def_m_sw_q_554_CM 1 100. -3276.8 3276.7 DISPLAY_IDENTIFIER MDI_GSL_MINUS ECU_ADDRESS 0xd000c878 FORMAT "%7.2" /end MEASUREMENT
/begin MEASUREMENT Mdi_gsl_plus "Langsamer Momenteneingriff EGS : Momentenerhöhung" SWORD _CNV_R_R_Def_m_sw_q_554_CM 1 100. -3276.8 3276.7 DISPLAY_IDENTIFIER MDI_GSL_PLUS ECU_ADDRESS 0xd000c87a FORMAT "%7.2" /end MEASUREMENT
/begin MEASUREMENT Mdi_gss_minus "Schneller Momenteneingriff EGS" SWORD _CNV_R_R_Def_m_sw_q_554_CM 1 100. -3276.8 3276.7 DISPLAY_IDENTIFIER MDI_GSS_MINUS ECU_ADDRESS 0xd000c87c FORMAT "%7.2" /end MEASUREMENT
/begin MEASUREMENT Mdi_gss_plus "Momenteneingriff EGS schnell" SWORD _CNV_R_R_Def_m_sw_q_554_CM 1 100. -3276.8 3276.7 DISPLAY_IDENTIFIER MDI_GSS_PLUS ECU_ADDRESS 0xd000c87e FORMAT "%7.2" /end MEASUREMENT
/begin MEASUREMENT Mdi_ist "inneres Motormoment nach Eingriff" SWORD _CNV_R_R_Def_m_sw_q_554_CM 1 100. -3276.8 3276.7 DISPLAY_IDENTIFIER MDI_IST ECU_ADDRESS 0xd000cc80 FORMAT "%7.2" ARRAY_SIZE 8 MATRIX_DIM 8 1 1 /end MEASUREMENT
/begin MEASUREMENT Mdi_ist_m "optimales Moment" SWORD _CNV_R_R_Def_m_sw_q_554_CM 1 100. -3276.8 3276.7 DISPLAY_IDENTIFIER MDI_IST_M ECU_ADDRESS 0xd000ccd4 FORMAT "%7.2" /end MEASUREMENT
/begin MEASUREMENT Mdi_katschutz "Momentenbegrenzung Katschutz" SWORD _CNV_R_R_Def_m_sw_q_554_CM 1 100. -3276.8 3276.7 DISPLAY_IDENTIFIER MDI_KATSCHUTZ ECU_ADDRESS 0xd000c880 FORMAT "%7.2" /end MEASUREMENT
/begin MEASUREMENT Mdi_llrad "Adaption Leerlaufregler" SWORD _CNV_R_R_Def_m_sw_q_554_CM 1 100. -3276.8 3276.7 DISPLAY_IDENTIFIER MDI_LLRAD ECU_ADDRESS 0xd000c882 FORMAT "%7.2" /end MEASUREMENT
/begin MEASUREMENT Mdi_llri "I-Anteil Llr" SWORD _CNV_R_R_Def_m_sw_q_554_CM 1 100. -3276.8 3276.7 DISPLAY_IDENTIFIER MDI_LLRI ECU_ADDRESS 0xd000c884 FORMAT "%7.2" /end MEASUREMENT
/begin MEASUREMENT Mdi_llrp "P-Anteil Llr" SWORD _CNV_R_R_Def_m_sw_q_554_CM 1 100. -3276.8 3276.7 DISPLAY_IDENTIFIER MDI_LLRP ECU_ADDRESS 0xd000c886 FORMAT "%7.2" /end MEASUREMENT
/begin MEASUREMENT Mdi_llrzw "PD-Anteil Llr" SWORD _CNV_R_R_Def_m_sw_q_554_CM 1 100. -3276.8 3276.7 DISPLAY_IDENTIFIER MDI_LLRZW ECU_ADDRESS 0xd000c888 FORMAT "%7.2" /end MEASUREMENT
/begin MEASUREMENT Mdi_msr_l "Begrenzungsmoment aus Motorschleppmomentenregelung langsamer Pfad" SWORD _CNV_R_R_Def_m_sw_q_554_CM 1 100. -3276.8 3276.7 DISPLAY_IDENTIFIER MDI_MSR_L ECU_ADDRESS 0xd000c88a FORMAT "%7.2" /end MEASUREMENT
/begin MEASUREMENT Mdi_msr_s "Begrenzungsmoment aus Motorschleppmomentenregelung schneller Pfad" SWORD _CNV_R_R_Def_m_sw_q_554_CM 1 100. -3276.8 3276.7 DISPLAY_IDENTIFIER MDI_MSR_S ECU_ADDRESS 0xd000c88c FORMAT "%7.2" /end MEASUREMENT
/begin MEASUREMENT Mdi_nmax "Moment der Maximaldrehzahlabregelung." SWORD _CNV_R_R_Def_m_sw_q_554_CM 1 100. -3276.8 3276.7 DISPLAY_IDENTIFIER MDI_NMAX ECU_ADDRESS 0xd000c88e FORMAT "%7.2" /end MEASUREMENT
/begin MEASUREMENT Mdi_pmax "Leistungsbegrenzung Gas-Bremse-Plausibilisierung" SWORD _CNV_R_R_Def_m_sw_q_554_CM 1 100. -3276.8 3276.7 DISPLAY_IDENTIFIER MDI_PMAX ECU_ADDRESS 0xd000c890 FORMAT "%7.2" /end MEASUREMENT
/begin MEASUREMENT Mdi_res_ac "Momentenreserve für den Klimakompressor" SWORD _CNV_R_R_Def_m_sw_q_554_CM 1 100. -3276.8 3276.7 DISPLAY_IDENTIFIER MDI_RES_AC ECU_ADDRESS 0xd000c892 FORMAT "%7.2" /end MEASUREMENT
/begin MEASUREMENT Mdi_res_afs "für AFS-Lenkung" SWORD _CNV_R_R_Def_m_sw_q_554_CM 1 100. -3276.8 3276.7 DISPLAY_IDENTIFIER MDI_RES_AFS ECU_ADDRESS 0xd000c894 FORMAT "%7.2" /end MEASUREMENT
/begin MEASUREMENT Mdi_res_gs "für Getriebe" SWORD _CNV_R_R_Def_m_sw_q_554_CM 1 100. -3276.8 3276.7 DISPLAY_IDENTIFIER MDI_RES_GS ECU_ADDRESS 0xd000c896 FORMAT "%7.2" /end MEASUREMENT
/begin MEASUREMENT Mdi_res_heiz "für Heizung aus Klimasteuergerät" SWORD _CNV_R_R_Def_m_sw_q_554_CM 1 100. -3276.8 3276.7 DISPLAY_IDENTIFIER MDI_RES_HEIZ ECU_ADDRESS 0xd000c898 FORMAT "%7.2" /end MEASUREMENT
/begin MEASUREMENT Mdi_res_kh "Momentenreserve für Katheizen" SWORD _CNV_R_R_Def_m_sw_q_554_CM 1 100. -3276.8 3276.7 DISPLAY_IDENTIFIER MDI_RES_KH ECU_ADDRESS 0xd000c89a FORMAT "%7.2" /end MEASUREMENT
/begin MEASUREMENT Mdi_res_llmn "untere Begrenzung Momentenreserve im LL" SWORD _CNV_R_R_Def_m_sw_q_554_CM 1 100. -3276.8 3276.7 DISPLAY_IDENTIFIER MDI_RES_LLMN ECU_ADDRESS 0xd000c89c FORMAT "%7.2" /end MEASUREMENT
/begin MEASUREMENT Mdi_res_llmx "inneres Moment incl. max mögliche Momentenreserve mit Einfluss LL" SWORD _CNV_R_R_Def_m_sw_q_554_CM 1 100. -3276.8 3276.7 DISPLAY_IDENTIFIER MDI_RES_LLMX ECU_ADDRESS 0xd000c89e FORMAT "%7.2" /end MEASUREMENT
/begin MEASUREMENT Mdi_res_sl "für Servo-Lenkung" SWORD _CNV_R_R_Def_m_sw_q_554_CM 1 100. -3276.8 3276.7 DISPLAY_IDENTIFIER MDI_RES_SL ECU_ADDRESS 0xd000c8a0 FORMAT "%7.2" /end MEASUREMENT
/begin MEASUREMENT Mdi_res_st "Momentenvorhalt im Start" SWORD _CNV_R_R_Def_m_sw_q_554_CM 1 100. -3276.8 3276.7 DISPLAY_IDENTIFIER MDI_RES_ST ECU_ADDRESS 0xd000c8a2 FORMAT "%7.2" /end MEASUREMENT
/begin MEASUREMENT Mdi_res_tev "Momentenreserve für die TEV" SWORD _CNV_R_R_Def_m_sw_q_554_CM 1 100. -3276.8 3276.7 DISPLAY_IDENTIFIER MDI_RES_TEV ECU_ADDRESS 0xd000c8a4 FORMAT "%7.2" /end MEASUREMENT
/begin MEASUREMENT Mdi_siko_l "Momentenbegrenzung Sicherheitskonzept langsamer Pfad" SWORD _CNV_R_R_Def_m_sw_q_554_CM 1 100. -3276.8 3276.7 DISPLAY_IDENTIFIER MDI_SIKO_L ECU_ADDRESS 0xd000c8a6 FORMAT "%7.2" /end MEASUREMENT
/begin MEASUREMENT Mdi_siko_s "Momentenbegrenzung Sicherheitskonzept schneller Pfad" SWORD _CNV_R_R_Def_m_sw_q_554_CM 1 100. -3276.8 3276.7 DISPLAY_IDENTIFIER MDI_SIKO_S ECU_ADDRESS 0xd000c8a8 FORMAT "%7.2" /end MEASUREMENT
/begin MEASUREMENT Mdi_smgl_minus "Momentenanforderung SMG Getriebe langsam negativ" SWORD _CNV_R_R_Def_m_sw_q_554_CM 1 100. -3276.8 3276.7 DISPLAY_IDENTIFIER MDI_SMGL_MINUS ECU_ADDRESS 0xd000c8aa FORMAT "%7.2" /end MEASUREMENT
/begin MEASUREMENT Mdi_smgl_plus "Momentenanforderung SMG Getriebe langsam positiv" SWORD _CNV_R_R_Def_m_sw_q_554_CM 1 100. -3276.8 3276.7 DISPLAY_IDENTIFIER MDI_SMGL_PLUS ECU_ADDRESS 0xd000c8ac FORMAT "%7.2" /end MEASUREMENT
/begin MEASUREMENT Mdi_smgs_minus "Momentenanforderung SMG Getriebe schnell negativ" SWORD _CNV_R_R_Def_m_sw_q_554_CM 1 100. -3276.8 3276.7 DISPLAY_IDENTIFIER MDI_SMGS_MINUS ECU_ADDRESS 0xd000c8ae FORMAT "%7.2" /end MEASUREMENT
/begin MEASUREMENT Mdi_smgs_plus "Momentenanforderung SMG Getriebe schnell positiv" SWORD _CNV_R_R_Def_m_sw_q_554_CM 1 100. -3276.8 3276.7 DISPLAY_IDENTIFIER MDI_SMGS_PLUS ECU_ADDRESS 0xd000c8b0 FORMAT "%7.2" /end MEASUREMENT
/begin MEASUREMENT Mdi_soll_kdyn "" SWORD _CNV_R_R_Def_m_sw_q_554_CM 1 100. -3276.8 3276.7 DISPLAY_IDENTIFIER MDI_SOLL_KDYN ECU_ADDRESS 0xd000cc94 FORMAT "%7.2" /end MEASUREMENT
/begin MEASUREMENT Mdi_soll_kdync "" SWORD _CNV_R_R_Def_m_sw_q_554_CM 1 100. -3276.8 3276.7 DISPLAY_IDENTIFIER MDI_SOLL_KDYNC ECU_ADDRESS 0xd000cc96 FORMAT "%7.2" /end MEASUREMENT
/begin MEASUREMENT Mdi_vmax "Vmax-Begrenzung" SWORD _CNV_R_R_Def_m_sw_q_554_CM 1 100. -3276.8 3276.7 DISPLAY_IDENTIFIER MDI_VMAX ECU_ADDRESS 0xd000c8b2 FORMAT "%7.2" /end MEASUREMENT
/begin MEASUREMENT Mdk_ext_minus "" SWORD _CNV_R_R_Def_m_sw_q_554_CM 1 100. -3276.8 3276.7 DISPLAY_IDENTIFIER MDK_EXT_MINUS ECU_ADDRESS 0xd000cce6 FORMAT "%7.2" /end MEASUREMENT
/begin MEASUREMENT Mdk_ext_plus "" SWORD _CNV_R_R_Def_m_sw_q_554_CM 1 100. -3276.8 3276.7 DISPLAY_IDENTIFIER MDK_EXT_PLUS ECU_ADDRESS 0xd000cce4 FORMAT "%7.2" /end MEASUREMENT
/begin MEASUREMENT Mdk_ist "Kupplungsistmoment" SWORD _CNV_R_R_Def_m_sw_q_554_CM 1 100. -3276.8 3276.7 DISPLAY_IDENTIFIER MDK_IST ECU_ADDRESS 0xd000ccca FORMAT "%7.2" /end MEASUREMENT
/begin MEASUREMENT Mdk_ist_lm "Ist-Moment aus Luftmasse ohne externe Eingriffe" SWORD _CNV_R_R_Def_m_sw_q_554_CM 1 100. -3276.8 3276.7 DISPLAY_IDENTIFIER MDK_IST_LM ECU_ADDRESS 0xd000c8b4 FORMAT "%7.2" /end MEASUREMENT
/begin MEASUREMENT Mdk_kupp_verl "Kupplungslastmoment bei aktiver Drehzahlregelung" SWORD _CNV_R_R_Def_m_sw_q_554_CM 1 100. -3276.8 3276.7 DISPLAY_IDENTIFIER MDK_KUPP_VERL ECU_ADDRESS 0xd000c8b6 FORMAT "%7.2" /end MEASUREMENT
/begin MEASUREMENT Mdr_fgr "Relatives Wunschmoment vom Fahrgeschwindigkeitsregler" SWORD _CNV_R_R_Def_md_rel_651_CM 1 100. 0. 100. DISPLAY_IDENTIFIER MDR_FGR ECU_ADDRESS 0xd000c8b8 FORMAT "%6.1" /end MEASUREMENT
/begin MEASUREMENT Minhub "" UWORD _CNV_R_R_Def_hub_uw_589_CM 1 100. 0. 65.535 DISPLAY_IDENTIFIER MINHUB ECU_ADDRESS 0xc00006e4 FORMAT "%8.3" /end MEASUREMENT
/begin MEASUREMENT Mrnn_test_dk_i "Testerwert NN DK-Adaption" SWORD _CNV_R_R_Def_f_uw_b_590_CM 1 100. -1. 0.9999 DISPLAY_IDENTIFIER MRNN_TEST_DK_I ECU_ADDRESS 0xc00006d0 FORMAT "%14.5" ARRAY_SIZE 2 MATRIX_DIM 2 1 1 /end MEASUREMENT
/begin MEASUREMENT Mrnn_test_pr_i "Testerwert NN PR-Adaption" SWORD _CNV_R_R_Def_f_sw_b_616_CM 1 100. -2. 1.9999 DISPLAY_IDENTIFIER MRNN_TEST_PR_I ECU_ADDRESS 0xc00006cc FORMAT "%14.5" ARRAY_SIZE 2 MATRIX_DIM 2 1 1 /end MEASUREMENT
/begin MEASUREMENT Ms_sl "Massenstrom Sekundärluft [kg/h]" UWORD _CNV_R_R_Def_ms_uw__594_CM 1 100. 0. 2047.9687 DISPLAY_IDENTIFIER MS_SL ECU_ADDRESS 0xd000c8ba FORMAT "%8.3" /end MEASUREMENT
/begin MEASUREMENT Msagr "Massenstrom AGR" UWORD _CNV_R_R_Def_ms_uw__594_CM 1 100. 0. 2047.9687 DISPLAY_IDENTIFIER MSAGR ECU_ADDRESS 0xd000cc46 FORMAT "%8.3" /end MEASUREMENT
/begin MEASUREMENT Msagr_i "Massenstrom AGR" UWORD _CNV_R_R_Def_ms_uw__594_CM 1 100. 0. 2047.9687 DISPLAY_IDENTIFIER MSAGR_I ECU_ADDRESS 0xd000cc3e FORMAT "%8.3" ARRAY_SIZE 2 MATRIX_DIM 2 1 1 /end MEASUREMENT
/begin MEASUREMENT Msainfo "Infospeicher MSA" UBYTE _CNV_R_R_Def_dez_sl_551_CM 1 100. 0. 255. DISPLAY_IDENTIFIER MSAINFO ECU_ADDRESS 0xc0004048 FORMAT "%3.0" ARRAY_SIZE 50 MATRIX_DIM 50 1 1 /end MEASUREMENT
/begin MEASUREMENT Mshfm_ist "Massenstrom vom HFM gesamt" UWORD _CNV_R_R_Def_ms_uw__594_CM 1 100. 0. 2047.9687 DISPLAY_IDENTIFIER MSHFM_IST ECU_ADDRESS 0xd000c8bc FORMAT "%8.3" /end MEASUREMENT
/begin MEASUREMENT Mshfm_ist_i "Massenstrom von jedem HFM" UWORD _CNV_R_R_Def_ms_uw__594_CM 1 100. 0. 2047.9687 DISPLAY_IDENTIFIER MSHFM_IST_I ECU_ADDRESS 0xd000c8be FORMAT "%8.3" ARRAY_SIZE 2 MATRIX_DIM 2 1 1 /end MEASUREMENT
/begin MEASUREMENT Mslui "Integr. Luftmasse" UWORD _CNV_R_R_Def_lm_uw__654_CM 1 100. 0. 29.1266 DISPLAY_IDENTIFIER MSLUI ECU_ADDRESS 0xc000746c FORMAT "%9.4" /end MEASUREMENT
/begin MEASUREMENT Mste "Massenstrom durch Tankentlüftungsventil" UWORD _CNV_R_R_Def_ms_uw__656_CM 1 100. 0. 25.5996 DISPLAY_IDENTIFIER MSTE ECU_ADDRESS 0xc00005da FORMAT "%9.4" /end MEASUREMENT
/begin MEASUREMENT N_idlms "Leerlaufdrehzahlanhebung von Powermodul" UBYTE _CNV_R_R_Def_dez_sl_551_CM 1 100. 0. 255. DISPLAY_IDENTIFIER N_IDLMS ECU_ADDRESS 0xc00005dc FORMAT "%3.0" /end MEASUREMENT
/begin MEASUREMENT N_rad_hl "Raddrehzahl hnten links" SWORD _CNV_R_R_Def_n_sw_b_659_CM 1 100. -512. 511.9843 DISPLAY_IDENTIFIER N_RAD_HL ECU_ADDRESS 0xd000c8c2 FORMAT "%9.4" /end MEASUREMENT
/begin MEASUREMENT N_rad_hr "Raddrehzahl hinten rechts" SWORD _CNV_R_R_Def_n_sw_b_659_CM 1 100. -512. 511.9843 DISPLAY_IDENTIFIER N_RAD_HR ECU_ADDRESS 0xd000c8c4 FORMAT "%9.4" /end MEASUREMENT
/begin MEASUREMENT N_rad_vl "Raddrehzahl vorne links" SWORD _CNV_R_R_Def_n_sw_b_659_CM 1 100. -512. 511.9843 DISPLAY_IDENTIFIER N_RAD_VL ECU_ADDRESS 0xd000c8c6 FORMAT "%9.4" /end MEASUREMENT
/begin MEASUREMENT N_rad_vr "Raddrehzahl vorne rechts" SWORD _CNV_R_R_Def_n_sw_b_659_CM 1 100. -512. 511.9843 DISPLAY_IDENTIFIER N_RAD_VR ECU_ADDRESS 0xd000c8c8 FORMAT "%9.4" /end MEASUREMENT
/begin MEASUREMENT N_schalt_dkg "Vom DKG geforderte Motordrehzahl" SWORD _CNV_R_R_Def_n_sw_q_595_CM 1 100. -32768. 32767. DISPLAY_IDENTIFIER N_SCHALT_DKG ECU_ADDRESS 0xd000c8ca FORMAT "%5.0" /end MEASUREMENT
/begin MEASUREMENT Nelueft_klima "Anforderung E-Lüfter Drehzahl von IHKA als PWM-Signal" UBYTE _CNV_R_R_Def_f_ub_b_586_CM 1 100. 0. 99.60930000000001 DISPLAY_IDENTIFIER NELUEFT_KLIMA ECU_ADDRESS 0xc00005dd FORMAT "%5.2" /end MEASUREMENT
/begin MEASUREMENT Nelueft_lenk "E-Lüfteranforderung von derLenkhilfe" UBYTE _CNV_R_R_Def_f_ub_b_586_CM 1 100. 0. 99.60930000000001 DISPLAY_IDENTIFIER NELUEFT_LENK ECU_ADDRESS 0xc00005de FORMAT "%5.2" /end MEASUREMENT
/begin MEASUREMENT Nkw "Drehzahl" SWORD _CNV_R_R_Def_n_sw_q_595_CM 1 100. -32768. 32767. DISPLAY_IDENTIFIER NKW ECU_ADDRESS 0xd000c8cc FORMAT "%5.0" /end MEASUREMENT
/begin MEASUREMENT Nkw_grad "Drehzahlgradient" SBYTE _CNV_R_R_Def_ngrd_s_661_CM 1 100. -4096. 4064. DISPLAY_IDENTIFIER NKW_GRAD ECU_ADDRESS 0xd000c8ce FORMAT "%5.2" /end MEASUREMENT
/begin MEASUREMENT Nkw_soll "Solldrehzahl" SWORD _CNV_R_R_Def_n_sw_q_595_CM 1 100. -32768. 32767. DISPLAY_IDENTIFIER NKW_SOLL ECU_ADDRESS 0xd000c8d0 FORMAT "%5.0" /end MEASUREMENT
/begin MEASUREMENT Nkw_zahn "Drehzahl aus KW-Zähnen" SWORD _CNV_R_R_Def_n_sw_q_595_CM 1 100. -32768. 32767. DISPLAY_IDENTIFIER NKW_ZAHN ECU_ADDRESS 0xd000c8d2 FORMAT "%5.0" /end MEASUREMENT
/begin MEASUREMENT Nmax_var "roter Drehzahlbereich" SWORD _CNV_R_R_Def_n_sw_q_595_CM 1 100. -32768. 32767. DISPLAY_IDENTIFIER NMAX_VAR ECU_ADDRESS 0xd000c8d4 FORMAT "%5.0" /end MEASUREMENT
/begin MEASUREMENT Nsllm "Solldrehzahl im Leerlauf ohne Fahrstufe" SWORD _CNV_R_R_Def_n_sw_q_595_CM 1 100. -32768. 32767. DISPLAY_IDENTIFIER NSLLM ECU_ADDRESS 0xc00005e0 FORMAT "%5.0" /end MEASUREMENT
/begin MEASUREMENT Nstat "Solldrehzahl ohne Nachführung" SWORD _CNV_R_R_Def_n_sw_q_595_CM 1 100. -32768. 32767. DISPLAY_IDENTIFIER NSTAT ECU_ADDRESS 0xc00005e2 FORMAT "%5.0" /end MEASUREMENT
/begin MEASUREMENT Nturb "Drehzahl Getriebeeingang" SWORD _CNV_R_R_Def_n_sw_q_595_CM 1 100. -32768. 32767. DISPLAY_IDENTIFIER NTURB ECU_ADDRESS 0xd000c8d6 FORMAT "%5.0" /end MEASUREMENT
/begin MEASUREMENT Nwa1_pos "Auslassnockenwellenposition" UWORD _CNV_R_R_Def_spr_sw_561_CM 1 100. 0. 6553.5 DISPLAY_IDENTIFIER NWA1_POS ECU_ADDRESS 0xd000c8d8 FORMAT "%7.2" /end MEASUREMENT
/begin MEASUREMENT Nwa1_time "Zeitstempel bei el. fallender Auslassnockenwellenflanke (1 Inc. = 1 ms)" ULONG _CNV_R_R_Def_dez_sl_551_CM 1 100. 0. 4294967295. DISPLAY_IDENTIFIER NWA1_TIME ECU_ADDRESS 0xd000c8da FORMAT "%7.0" /end MEASUREMENT
/begin MEASUREMENT Nwa2_pos "Auslassnockenwellenposition (el. fallende Flanken) Bank 2" UWORD _CNV_R_R_Def_spr_sw_561_CM 1 100. 0. 6553.5 DISPLAY_IDENTIFIER NWA2_POS ECU_ADDRESS 0xd000c8de FORMAT "%7.2" /end MEASUREMENT
/begin MEASUREMENT Nwa2_time "Zeitstempel bei el. fallender Auslassnockenwellenflanke (1 Inc. = 1 ms) Bank 2" ULONG _CNV_R_R_Def_dez_sl_551_CM 1 100. 0. 4294967295. DISPLAY_IDENTIFIER NWA2_TIME ECU_ADDRESS 0xd000c8e0 FORMAT "%7.0" /end MEASUREMENT
/begin MEASUREMENT Nwe "Wiedereinsetzdrehzahl + drehzahlgradientabhängiger Offset" SWORD _CNV_R_R_Def_n_sw_q_595_CM 1 100. -32768. 32767. DISPLAY_IDENTIFIER NWE ECU_ADDRESS 0xc00005e4 FORMAT "%5.0" /end MEASUREMENT
/begin MEASUREMENT Nwe1_pos "Einlassnockenwellenposition" UWORD _CNV_R_R_Def_spr_sw_561_CM 1 100. 0. 6553.5 DISPLAY_IDENTIFIER NWE1_POS ECU_ADDRESS 0xd000c8e4 FORMAT "%7.2" /end MEASUREMENT
/begin MEASUREMENT Nwe1_time "Zeitstempel bei el. fallender Einlassnockenwellenflanke (1 Inc. = 1 ms)" ULONG _CNV_R_R_Def_dez_sl_551_CM 1 100. 0. 4294967295. DISPLAY_IDENTIFIER NWE1_TIME ECU_ADDRESS 0xd000c8e6 FORMAT "%7.0" /end MEASUREMENT
/begin MEASUREMENT Nwe2_pos "Einlassnockenwellenposition (el. fallende Flanken) Bank 2" UWORD _CNV_R_R_Def_spr_sw_561_CM 1 100. 0. 6553.5 DISPLAY_IDENTIFIER NWE2_POS ECU_ADDRESS 0xd000c8ea FORMAT "%7.2" /end MEASUREMENT
/begin MEASUREMENT Nwe2_time "Zeitstempel bei el. fallender Einlassnockenwellenflanke (1 Inc. = 1 ms) Bank 2" ULONG _CNV_R_R_Def_dez_sl_551_CM 1 100. 0. 4294967295. DISPLAY_IDENTIFIER NWE2_TIME ECU_ADDRESS 0xd000c8ec FORMAT "%7.0" /end MEASUREMENT
/begin MEASUREMENT Oz_lf1c "Länderfaktor 1 codiert" UBYTE _CNV_R_R_Def_lf_ub__670_CM 1 100. 0. 2.55 DISPLAY_IDENTIFIER OZ_LF1C ECU_ADDRESS 0xc00005e6 FORMAT "%5.2" /end MEASUREMENT
/begin MEASUREMENT Oz_lf2c "Länderfaktor 2 codiert" UBYTE _CNV_R_R_Def_lf_ub__670_CM 1 100. 0. 2.55 DISPLAY_IDENTIFIER OZ_LF2C ECU_ADDRESS 0xc00005e7 FORMAT "%5.2" /end MEASUREMENT
/begin MEASUREMENT Oz_nivr "Rohwert Ölniveau vom Sensor" UBYTE _CNV_R_R_Def_dez_sl_551_CM 1 100. 0. 255. DISPLAY_IDENTIFIER OZ_NIVR ECU_ADDRESS 0xc00005e8 FORMAT "%3.0" /end MEASUREMENT
/begin MEASUREMENT Oz_permr "Rohwert Permittivität vom Sensor" UWORD _CNV_R_R_Def_dez_sl_551_CM 1 100. 0. 65535. DISPLAY_IDENTIFIER OZ_PERMR ECU_ADDRESS 0xc00005ea FORMAT "%5.0" /end MEASUREMENT
/begin MEASUREMENT Oz_status "Statusinfo vom Sensor" UBYTE _CNV_R_R_Def_dez_sl_551_CM 1 100. 0. 255. DISPLAY_IDENTIFIER OZ_STATUS ECU_ADDRESS 0xc00005ec FORMAT "%3.0" /end MEASUREMENT
/begin MEASUREMENT Oz_tempr "Rohwert Öltemperatur vom Sensor" UBYTE _CNV_R_R_Def_dez_sl_551_CM 1 100. 0. 255. DISPLAY_IDENTIFIER OZ_TEMPR ECU_ADDRESS 0xc00005ed FORMAT "%3.0" /end MEASUREMENT
/begin MEASUREMENT P_rail_kh "Raildruck vom Katheizmanager" UWORD _CNV_R_R_Def_p_uw_q_676_CM 1 100. 0. 39.9993 DISPLAY_IDENTIFIER P_RAIL_KH ECU_ADDRESS 0xd000c8f0 FORMAT "%9.4" /end MEASUREMENT
/begin MEASUREMENT Pbrems "Bremsdruck" UBYTE _CNV_R_R_Def_p_ub_q_677_CM 1 100. 0. 99.60930000000001 DISPLAY_IDENTIFIER PBREMS ECU_ADDRESS 0xd000c8f2 FORMAT "%5.2" /end MEASUREMENT
/begin MEASUREMENT Pmrestore "Restorespeicher" UBYTE _CNV_R_R_Def_dez_sl_551_CM 1 100. 0. 255. DISPLAY_IDENTIFIER PMRESTORE ECU_ADDRESS 0xc00005ee FORMAT "%3.0" ARRAY_SIZE 7 MATRIX_DIM 7 1 1 /end MEASUREMENT
/begin MEASUREMENT Pmsv "Angemeldete Powermanagment Standverbraucher" UBYTE _CNV_R_R_Def_dez_sl_551_CM 1 100. 0. 255. DISPLAY_IDENTIFIER PMSV ECU_ADDRESS 0xc000400c FORMAT "%3.0" ARRAY_SIZE 15 MATRIX_DIM 15 1 1 /end MEASUREMENT
/begin MEASUREMENT Prail2_ist "Raildruck Bank 2" UWORD _CNV_R_R_Def_p_uw_q_676_CM 1 100. 0. 39.9993 DISPLAY_IDENTIFIER PRAIL2_IST ECU_ADDRESS 0xd000c8f4 FORMAT "%9.4" /end MEASUREMENT
/begin MEASUREMENT Prail2_soll "Raildruckvorgabe Bank 2 von BMW, gültig nur wenn B_prailsw gesetzt ist." UWORD _CNV_R_R_Def_p_uw_q_676_CM 1 100. 0. 39.9993 DISPLAY_IDENTIFIER PRAIL2_SOLL ECU_ADDRESS 0xd000ccaa FORMAT "%9.4" /end MEASUREMENT
/begin MEASUREMENT Prail_ist "Raildruck" UWORD _CNV_R_R_Def_p_uw_q_676_CM 1 100. 0. 39.9993 DISPLAY_IDENTIFIER PRAIL_IST ECU_ADDRESS 0xd000c8f6 FORMAT "%9.4" /end MEASUREMENT
/begin MEASUREMENT Prio_katman1 "Prioritätzahl des besten Wunsches des CHM" SBYTE _CNV_R_R_Def_dez_sl_551_CM 1 100. -128. 127. DISPLAY_IDENTIFIER PRIO_KATMAN1 ECU_ADDRESS 0xc00005f5 FORMAT "%3.0" /end MEASUREMENT
/begin MEASUREMENT Prio_katman2 "Prioritätzahl des zweiten Wunsches des CHM" SBYTE _CNV_R_R_Def_dez_sl_551_CM 1 100. -128. 127. DISPLAY_IDENTIFIER PRIO_KATMAN2 ECU_ADDRESS 0xc00005f6 FORMAT "%3.0" /end MEASUREMENT
/begin MEASUREMENT Ps_abs "Absolut Sammler druck vom Sensor als Mittelwert" UWORD _CNV_R_R_Def_p_sw_q_576_CM 1 100. 0. 2559.9609 DISPLAY_IDENTIFIER PS_ABS ECU_ADDRESS 0xd000c8f8 FORMAT "%7.2" /end MEASUREMENT
/begin MEASUREMENT Ps_abs_i "Absolut Sammler druck von jedem Sensor" UWORD _CNV_R_R_Def_p_sw_q_576_CM 1 100. 0. 2559.9609 DISPLAY_IDENTIFIER PS_ABS_I ECU_ADDRESS 0xd000c8fa FORMAT "%7.2" ARRAY_SIZE 2 MATRIX_DIM 2 1 1 /end MEASUREMENT
/begin MEASUREMENT Ps_abs_i_j "Absolut Sammlerdruck von jedem Sensor, Zylinder abhängig" UWORD _CNV_R_R_Def_p_sw_q_576_CM 1 100. 0. 2559.9609 DISPLAY_IDENTIFIER PS_ABS_I_J ECU_ADDRESS 0xd000c900 FORMAT "%8.3" ARRAY_SIZE 16 MATRIX_DIM 2 8 1 /end MEASUREMENT
/begin MEASUREMENT Ps_abs_t100 "Druck im Saugrohr, 100ms raster" UWORD _CNV_R_R_Def_p_sw_q_576_CM 1 100. 0. 2559.9609 DISPLAY_IDENTIFIER PS_ABS_T100 ECU_ADDRESS 0xc00006c2 FORMAT "%7.2" /end MEASUREMENT
/begin MEASUREMENT Ps_abs_t100_i "Absolutsammlerdruck von jedem Sensor mit 100ms Rate" UWORD _CNV_R_R_Def_p_sw_q_576_CM 1 100. 0. 2559.9609 DISPLAY_IDENTIFIER PS_ABS_T100_I ECU_ADDRESS 0xd000c920 FORMAT "%7.2" ARRAY_SIZE 2 MATRIX_DIM 2 1 1 /end MEASUREMENT
/begin MEASUREMENT Ptc_entl "Ptc Wert aufg. Entlastung" UBYTE _CNV_R_R_Def_f_ub_b_575_CM 1 100. 0. 127.5 DISPLAY_IDENTIFIER PTC_ENTL ECU_ADDRESS 0xc00006d5 FORMAT "%5.2" /end MEASUREMENT
/begin MEASUREMENT Pu "Umgebungsdruck" UWORD _CNV_R_R_Def_p_sw_q_576_CM 1 100. 0. 2559.9609 DISPLAY_IDENTIFIER PU ECU_ADDRESS 0xc00005f8 FORMAT "%7.2" /end MEASUREMENT
/begin MEASUREMENT Pvagr "absoluter Abgasdruck Mittelwert" UWORD _CNV_R_R_Def_p_sw_q_576_CM 1 100. 0. 2559.9609 DISPLAY_IDENTIFIER PVAGR ECU_ADDRESS 0xd000c924 FORMAT "%7.2" /end MEASUREMENT
/begin MEASUREMENT Pvagr_i "absoluter Abgasdruck jeder Bank" UWORD _CNV_R_R_Def_p_sw_q_576_CM 1 100. 0. 2559.9609 DISPLAY_IDENTIFIER PVAGR_I ECU_ADDRESS 0xd000c926 FORMAT "%7.2" ARRAY_SIZE 2 MATRIX_DIM 2 1 1 /end MEASUREMENT
/begin MEASUREMENT Pvdkds "Druck vor Drosselklappe vom Sensor als Mittelwert" UWORD _CNV_R_R_Def_p_sw_q_576_CM 1 100. 0. 2559.9609 DISPLAY_IDENTIFIER PVDKDS ECU_ADDRESS 0xd000c92a FORMAT "%7.2" /end MEASUREMENT
/begin MEASUREMENT Pvdkds_i "Druck vor Drosselklappe von jedem Sensor" UWORD _CNV_R_R_Def_p_sw_q_576_CM 1 100. 0. 2559.9609 DISPLAY_IDENTIFIER PVDKDS_I ECU_ADDRESS 0xc00005fa FORMAT "%7.2" ARRAY_SIZE 2 MATRIX_DIM 2 1 1 /end MEASUREMENT
/begin MEASUREMENT Pvdkds_i_j "Druck vor Drosselklappe von jedem Sensor, Zylinder abhängig" UWORD _CNV_R_R_Def_p_sw_q_576_CM 1 100. 0. 2559.9609 DISPLAY_IDENTIFIER PVDKDS_I_J ECU_ADDRESS 0xc0000600 FORMAT "%8.3" ARRAY_SIZE 16 MATRIX_DIM 2 8 1 /end MEASUREMENT
/begin MEASUREMENT Pvdkds_t100 "Druck vor Drosselklappe, 100ms raster" UWORD _CNV_R_R_Def_p_sw_q_576_CM 1 100. 0. 2559.9609 DISPLAY_IDENTIFIER PVDKDS_T100 ECU_ADDRESS 0xc00006c4 FORMAT "%7.2" /end MEASUREMENT
/begin MEASUREMENT Pvdkds_t100_i "Druck vor Drosselklappe beider Sensoren in 100ms Rate" UWORD _CNV_R_R_Def_p_sw_q_576_CM 1 100. 0. 2559.9609 DISPLAY_IDENTIFIER PVDKDS_T100_I ECU_ADDRESS 0xc0000620 FORMAT "%7.2" ARRAY_SIZE 2 MATRIX_DIM 2 1 1 /end MEASUREMENT
/begin MEASUREMENT Pwg_ist "Pedalwert Fahrerwunsch in %" SWORD _CNV_R_R_Def_wdk_sw_683_CM 1 100. -800. 799.9755 DISPLAY_IDENTIFIER PWG_IST ECU_ADDRESS 0xc0000624 FORMAT "%7.2" /end MEASUREMENT
/begin MEASUREMENT Qs_anf_klima "Wärmestromanforderung an DME zur Ansteuerung eWAPU" UBYTE _CNV_R_R_Def_f_ub_b_586_CM 1 100. 0. 99.60930000000001 DISPLAY_IDENTIFIER QS_ANF_KLIMA ECU_ADDRESS 0xc0000626 FORMAT "%5.2" /end MEASUREMENT
/begin MEASUREMENT Qv_cdherst_1 "Codierung Hersteller 1" UBYTE _CNV_R_R_Def_dez_sl_551_CM 1 100. 0. 255. DISPLAY_IDENTIFIER QV_CDHERST_1 ECU_ADDRESS 0xc000401b FORMAT "%3.0" /end MEASUREMENT
/begin MEASUREMENT Qv_cdherst_2 "Codierung Hersteller 2" UBYTE _CNV_R_R_Def_dez_sl_551_CM 1 100. 0. 255. DISPLAY_IDENTIFIER QV_CDHERST_2 ECU_ADDRESS 0xc000401c FORMAT "%3.0" /end MEASUREMENT
/begin MEASUREMENT Qv_cdherst_3 "Codierung Hersteller 3" UBYTE _CNV_R_R_Def_dez_sl_551_CM 1 100. 0. 255. DISPLAY_IDENTIFIER QV_CDHERST_3 ECU_ADDRESS 0xc000401d FORMAT "%3.0" /end MEASUREMENT
/begin MEASUREMENT Qv_cdherst_4 "Codierung Hersteller 4" UBYTE _CNV_R_R_Def_dez_sl_551_CM 1 100. 0. 255. DISPLAY_IDENTIFIER QV_CDHERST_4 ECU_ADDRESS 0xc000401e FORMAT "%3.0" /end MEASUREMENT
/begin MEASUREMENT Qv_cdherst_5 "Codierung Hersteller 5" UBYTE _CNV_R_R_Def_dez_sl_551_CM 1 100. 0. 255. DISPLAY_IDENTIFIER QV_CDHERST_5 ECU_ADDRESS 0xc000401f FORMAT "%3.0" /end MEASUREMENT
/begin MEASUREMENT Qv_cdherst_6 "Codierung Hersteller 6" UBYTE _CNV_R_R_Def_dez_sl_551_CM 1 100. 0. 255. DISPLAY_IDENTIFIER QV_CDHERST_6 ECU_ADDRESS 0xc0004020 FORMAT "%3.0" /end MEASUREMENT
/begin MEASUREMENT Qv_cdherst_7 "Codierung Hersteller 7" UBYTE _CNV_R_R_Def_dez_sl_551_CM 1 100. 0. 255. DISPLAY_IDENTIFIER QV_CDHERST_7 ECU_ADDRESS 0xc0004021 FORMAT "%3.0" /end MEASUREMENT
/begin MEASUREMENT Qv_cdherst_8 "Codierung Hersteller 8" UBYTE _CNV_R_R_Def_dez_sl_551_CM 1 100. 0. 255. DISPLAY_IDENTIFIER QV_CDHERST_8 ECU_ADDRESS 0xc0004022 FORMAT "%3.0" /end MEASUREMENT
/begin MEASUREMENT Rf2_ig_ist "Innertgasanteil im Brennraum" SWORD _CNV_R_R_Def_rf_sw__598_CM 1 100. -327.68 327.67 DISPLAY_IDENTIFIER RF2_IG_IST ECU_ADDRESS 0xd000cca8 FORMAT "%9.4" /end MEASUREMENT
/begin MEASUREMENT Rf_ig_ist "Relative Luftfuellung inert Gas von AGR" SWORD _CNV_R_R_Def_rf_sw__598_CM 1 100. -327.68 327.67 DISPLAY_IDENTIFIER RF_IG_IST ECU_ADDRESS 0xd000cc4c FORMAT "%9.4" /end MEASUREMENT
/begin MEASUREMENT Rf_ig_ist_i "Innertgas-Anteil im Brennraum" SWORD _CNV_R_R_Def_rf_sw__598_CM 1 100. -327.68 327.67 DISPLAY_IDENTIFIER RF_IG_IST_I ECU_ADDRESS 0xd000cc9c FORMAT "%9.4" ARRAY_SIZE 2 MATRIX_DIM 2 1 1 /end MEASUREMENT
/begin MEASUREMENT Rfv_vns_i "Relative Füllung für Vanos" SWORD _CNV_R_R_Def_rf_sw__598_CM 1 100. -327.68 327.67 DISPLAY_IDENTIFIER RFV_VNS_I ECU_ADDRESS 0xd000cc98 FORMAT "%9.4" ARRAY_SIZE 2 MATRIX_DIM 2 1 1 /end MEASUREMENT
/begin MEASUREMENT Rk2_kh_h "Fuel mass setpoint for the second pulse at homogeneous mode during CH" SWORD _CNV_R_R_Def_rel_sw_562_CM 1 100. -100. 99.9969 DISPLAY_IDENTIFIER RK2_KH_H ECU_ADDRESS 0xd000c92c FORMAT "%8.3" /end MEASUREMENT
/begin MEASUREMENT Rk3_kh_s "Mass fuel flow of the post injection during CH" SWORD _CNV_R_R_Def_rel_sw_562_CM 1 100. -100. 99.9969 DISPLAY_IDENTIFIER RK3_KH_S ECU_ADDRESS 0xd000c92e FORMAT "%8.3" /end MEASUREMENT
/begin MEASUREMENT Rk_1 "Relative Kraftstoffmasse" UWORD _CNV_R_R_Def_f_uw_b_588_CM 1 100. 0. 31.9995 DISPLAY_IDENTIFIER RK_1 ECU_ADDRESS 0xd000c930 FORMAT "%9.4" /end MEASUREMENT
/begin MEASUREMENT Rk_2 "Relative Kraftstoffmasse" UWORD _CNV_R_R_Def_f_uw_b_588_CM 1 100. 0. 31.9995 DISPLAY_IDENTIFIER RK_2 ECU_ADDRESS 0xd000c932 FORMAT "%9.4" /end MEASUREMENT
/begin MEASUREMENT Rk_add_ad1 "Lambdaadaption additiv Bank1" SWORD _CNV_R_R_Def_rk_sw__600_CM 1 100. -1600. 1599.9511 DISPLAY_IDENTIFIER RK_ADD_AD1 ECU_ADDRESS 0xc000746e FORMAT "%8.3" /end MEASUREMENT
/begin MEASUREMENT Rk_add_ad2 "Lambdaadaption additiv" SWORD _CNV_R_R_Def_rk_sw__600_CM 1 100. -1600. 1599.9511 DISPLAY_IDENTIFIER RK_ADD_AD2 ECU_ADDRESS 0xc0007470 FORMAT "%8.3" /end MEASUREMENT
/begin MEASUREMENT Rktev "Kraftstoffkorrektur durch TEV" SWORD _CNV_R_R_Def_rk_sw__702_CM 1 100. -16. 15.9995 DISPLAY_IDENTIFIER RKTEV ECU_ADDRESS 0xc0000628 FORMAT "%9.4" /end MEASUREMENT
/begin MEASUREMENT Seg5z "Segmentzeit für 5 Zähne" UWORD _CNV_R_R_Def_td_uw__663_CM 1 100. 0. 65.535 DISPLAY_IDENTIFIER SEG5Z ECU_ADDRESS 0xd000c934 FORMAT "%8.3" ARRAY_SIZE 24 MATRIX_DIM 24 1 1 /end MEASUREMENT
/begin MEASUREMENT Segakt "Aktuelles Segment aus der TPU" UBYTE _CNV_R_R_Def_dez_sl_551_CM 1 100. 0. 255. DISPLAY_IDENTIFIER SEGAKT ECU_ADDRESS 0xd000c964 FORMAT "%3.0" /end MEASUREMENT
/begin MEASUREMENT Segkorroff "Zahn, bei welchem die Hubkorrektur ausgeschaltet wird" UBYTE _CNV_R_R_Def_dez_sl_551_CM 1 100. 0. 255. DISPLAY_IDENTIFIER SEGKORROFF ECU_ADDRESS 0xd000ccd8 FORMAT "%3.0" /end MEASUREMENT
/begin MEASUREMENT Segkorron "Zahn, bei welchem die Hubkorrektur eingeschaltet wird" UBYTE _CNV_R_R_Def_dez_sl_551_CM 1 100. 0. 255. DISPLAY_IDENTIFIER SEGKORRON ECU_ADDRESS 0xd000ccd9 FORMAT "%3.0" /end MEASUREMENT
/begin MEASUREMENT Spa_art "Anzeigeart fuer Schaltpunktanzeige" UBYTE _CNV_R_R_Def_dez_sl_551_CM 1 100. 0. 255. DISPLAY_IDENTIFIER SPA_ART ECU_ADDRESS 0xd000cc55 FORMAT "%3.0" /end MEASUREMENT
/begin MEASUREMENT Spa_art_2 "Anzeigeart fuer Schaltpunktanzeige 2" UBYTE _CNV_R_R_Def_dez_sl_551_CM 1 100. 0. 255. DISPLAY_IDENTIFIER SPA_ART_2 ECU_ADDRESS 0xd000cc54 FORMAT "%3.0" /end MEASUREMENT
/begin MEASUREMENT Spa_gang "Gang fuer Schaltpunktanzeige" UBYTE _CNV_R_R_Def_dez_sl_551_CM 1 100. 0. 255. DISPLAY_IDENTIFIER SPA_GANG ECU_ADDRESS 0xd000cc53 FORMAT "%3.0" /end MEASUREMENT
/begin MEASUREMENT St_abgasklappe "Statuswort für Abgasklappe" UBYTE _CNV_R_R_Def_dez_sl_551_CM 1 100. 0. 255. DISPLAY_IDENTIFIER ST_ABGASKLAPPE ECU_ADDRESS 0xd000c965 FORMAT "%3.0" /end MEASUREMENT
/begin MEASUREMENT St_abgasklappe.B_abgasklappe "Bedingung Schaltung Abgasklappe (True = Klappe geöffnet)" UBYTE _CNV_S_2_Def_bit_ub_563_CM 1 100. 0. 1. DISPLAY_IDENTIFIER B_ABGASKLAPPE ECU_ADDRESS 0xd000c965 BIT_MASK 0x1 /end MEASUREMENT
/begin MEASUREMENT St_agr "Status Abgasrückführung" UBYTE _CNV_R_R_Def_dez_sl_551_CM 1 100. 0. 255. DISPLAY_IDENTIFIER ST_AGR ECU_ADDRESS 0xd000c966 FORMAT "%3.0" /end MEASUREMENT
/begin MEASUREMENT St_agr.B_agr_ktrl "AGR Kontrol aktiv" UBYTE _CNV_S_2_Def_bit_ub_563_CM 1 100. 0. 1. DISPLAY_IDENTIFIER B_AGR_KTRL ECU_ADDRESS 0xd000c966 BIT_MASK 0x1 /end MEASUREMENT
/begin MEASUREMENT St_anf_prail "Statuswort Anforderung Diagnose für Raildruck" UBYTE _CNV_R_R_Def_dez_sl_551_CM 1 100. 0. 255. DISPLAY_IDENTIFIER ST_ANF_PRAIL ECU_ADDRESS 0xc0007472 FORMAT "%3.0" /end MEASUREMENT
/begin MEASUREMENT St_anf_prail.B_aprail_hom "Anforderung Diagnose-Raildruck Homogen" UBYTE _CNV_S_2_Def_bit_ub_563_CM 1 100. 0. 1. DISPLAY_IDENTIFIER B_APRAIL_HOM ECU_ADDRESS 0xc0007472 BIT_MASK 0x1 /end MEASUREMENT
/begin MEASUREMENT St_anf_prail.B_aprail_ndnotl "Anforderung Diagnose-Raildruck Niederdrucknotlauf" UBYTE _CNV_S_2_Def_bit_ub_563_CM 1 100. 0. 1. DISPLAY_IDENTIFIER B_APRAIL_NDNOTL ECU_ADDRESS 0xc0007472 BIT_MASK 0x2 /end MEASUREMENT
/begin MEASUREMENT St_anf_prail.B_prail_h "Anforderung des Homogenbetriebs" UBYTE _CNV_S_2_Def_bit_ub_563_CM 1 100. 0. 1. DISPLAY_IDENTIFIER B_PRAIL_H ECU_ADDRESS 0xc0007472 BIT_MASK 0x4 /end MEASUREMENT
/begin MEASUREMENT St_anf_prail.B_prailvcv_h "Anforderung des Homogenbetriebes bei offenstehendem VCV" UBYTE _CNV_S_2_Def_bit_ub_563_CM 1 100. 0. 1. DISPLAY_IDENTIFIER B_PRAILVCV_H ECU_ADDRESS 0xc0007472 BIT_MASK 0x8 /end MEASUREMENT
/begin MEASUREMENT St_anf_prail.B_prailvfd_h "Anforderung des Limphomes mit Vorförderdruck." UBYTE _CNV_S_2_Def_bit_ub_563_CM 1 100. 0. 1. DISPLAY_IDENTIFIER B_PRAILVFD_H ECU_ADDRESS 0xc0007472 BIT_MASK 0x10 /end MEASUREMENT
/begin MEASUREMENT St_anman1 "Status Anman" UBYTE _CNV_R_R_Def_dez_sl_551_CM 1 100. 0. 255. DISPLAY_IDENTIFIER ST_ANMAN1 ECU_ADDRESS 0xd000c967 FORMAT "%3.0" /end MEASUREMENT
/begin MEASUREMENT St_anman1.B_ldm_ena "Enable Momentenwunsch aus LDM" UBYTE _CNV_S_2_Def_bit_ub_563_CM 1 100. 0. 1. DISPLAY_IDENTIFIER B_LDM_ENA ECU_ADDRESS 0xd000c967 BIT_MASK 0x4 /end MEASUREMENT
/begin MEASUREMENT St_anman1.B_ldm_nofil "Bedingung schnelle Momenteneinstellung von LDM" UBYTE _CNV_S_2_Def_bit_ub_563_CM 1 100. 0. 1. DISPLAY_IDENTIFIER B_LDM_NOFIL ECU_ADDRESS 0xd000c967 BIT_MASK 0x1 /end MEASUREMENT
/begin MEASUREMENT St_anman1.B_nosa "Bedingung SA verboten von LDM" UBYTE _CNV_S_2_Def_bit_ub_563_CM 1 100. 0. 1. DISPLAY_IDENTIFIER B_NOSA ECU_ADDRESS 0xd000c967 BIT_MASK 0x2 /end MEASUREMENT
/begin MEASUREMENT St_auss "Statuswort" UBYTE _CNV_R_R_Def_dez_sl_551_CM 1 100. 0. 255. DISPLAY_IDENTIFIER ST_AUSS ECU_ADDRESS 0xd000cc58 FORMAT "%3.0" /end MEASUREMENT
/begin MEASUREMENT St_auss.B_auss_b1 "Bedingung 1. 1000er Intervall" UBYTE _CNV_S_2_Def_bit_ub_563_CM 1 100. 0. 1. DISPLAY_IDENTIFIER B_AUSS_B1 ECU_ADDRESS 0xd000cc58 BIT_MASK 0x1 /end MEASUREMENT
/begin MEASUREMENT St_ba "Status Betriebsarten" UBYTE _CNV_R_R_Def_dez_sl_551_CM 1 100. 0. 255. DISPLAY_IDENTIFIER ST_BA ECU_ADDRESS 0xd000c968 FORMAT "%3.0" /end MEASUREMENT
/begin MEASUREMENT St_ba.B_ase_abgas "Bedingung Abgasrelevant Aussetzer erkannt" UBYTE _CNV_S_2_Def_bit_ub_563_CM 1 100. 0. 1. DISPLAY_IDENTIFIER B_ASE_ABGAS ECU_ADDRESS 0xd000c968 BIT_MASK 0x8 /end MEASUREMENT
/begin MEASUREMENT St_ba.B_ase_kat "Bedingung katalysator beschädigend Aussetzer erkannt." UBYTE _CNV_S_2_Def_bit_ub_563_CM 1 100. 0. 1. DISPLAY_IDENTIFIER B_ASE_KAT ECU_ADDRESS 0xd000c968 BIT_MASK 0x4 /end MEASUREMENT
/begin MEASUREMENT St_ba.B_vb_hmm "Homogenmagerbetrieb verboten" UBYTE _CNV_S_2_Def_bit_ub_563_CM 1 100. 0. 1. DISPLAY_IDENTIFIER B_VB_HMM ECU_ADDRESS 0xd000c968 BIT_MASK 0x1 /end MEASUREMENT
/begin MEASUREMENT St_ba.B_vb_sch "Schichtbetrieb verboten" UBYTE _CNV_S_2_Def_bit_ub_563_CM 1 100. 0. 1. DISPLAY_IDENTIFIER B_VB_SCH ECU_ADDRESS 0xd000c968 BIT_MASK 0x2 /end MEASUREMENT
/begin MEASUREMENT St_bls "" UBYTE _CNV_R_R_Def_dez_sl_551_CM 1 100. 0. 255. DISPLAY_IDENTIFIER ST_BLS ECU_ADDRESS 0xd000c969 FORMAT "%3.0" /end MEASUREMENT
/begin MEASUREMENT St_bls.B_bls "Bedingung Bremslichtschalter" UBYTE _CNV_S_2_Def_bit_ub_563_CM 1 100. 0. 1. DISPLAY_IDENTIFIER B_BLS ECU_ADDRESS 0xd000c969 BIT_MASK 0x1 /end MEASUREMENT
/begin MEASUREMENT St_blsdisa1 "Statuswort BLSDISA Eingang" UBYTE _CNV_R_R_Def_dez_sl_551_CM 1 100. 0. 255. DISPLAY_IDENTIFIER ST_BLSDISA1 ECU_ADDRESS 0xd000c96a FORMAT "%3.0" /end MEASUREMENT
/begin MEASUREMENT St_blsdisa1.B_disa_akt "Disa-Ansteuerung freigegeben" UBYTE _CNV_S_2_Def_bit_ub_563_CM 1 100. 0. 1. DISPLAY_IDENTIFIER B_DISA_AKT ECU_ADDRESS 0xd000c96a BIT_MASK 0x1 /end MEASUREMENT
/begin MEASUREMENT St_blsdisa2 "Statuswort BLSDISA" UBYTE _CNV_R_R_Def_dez_sl_551_CM 1 100. 0. 255. DISPLAY_IDENTIFIER ST_BLSDISA2 ECU_ADDRESS 0xd000cc4e FORMAT "%3.0" /end MEASUREMENT
/begin MEASUREMENT St_blsdisa2.B_disa1_auf "Anforderung Disa 1 öffnen aus BMW-Modul" UBYTE _CNV_S_2_Def_bit_ub_563_CM 1 100. 0. 1. DISPLAY_IDENTIFIER B_DISA1_AUF ECU_ADDRESS 0xd000cc4e BIT_MASK 0x1 /end MEASUREMENT
/begin MEASUREMENT St_blsdisa2.B_disa2_auf "Anforderung Disa 2 öffnen aus BMW-Modul" UBYTE _CNV_S_2_Def_bit_ub_563_CM 1 100. 0. 1. DISPLAY_IDENTIFIER B_DISA2_AUF ECU_ADDRESS 0xd000cc4e BIT_MASK 0x2 /end MEASUREMENT
/begin MEASUREMENT St_blsdisa2.B_disa_hys "Statuswort BLSDISA" UBYTE _CNV_S_2_Def_bit_ub_563_CM 1 100. 0. 1. DISPLAY_IDENTIFIER B_DISA_HYS ECU_ADDRESS 0xd000cc4e BIT_MASK 0x4 /end MEASUREMENT
/begin MEASUREMENT St_btvns "" UBYTE _CNV_R_R_Def_dez_sl_551_CM 1 100. 0. 255. DISPLAY_IDENTIFIER ST_BTVNS ECU_ADDRESS 0xd000c96b FORMAT "%3.0" /end MEASUREMENT
/begin MEASUREMENT St_btvns.B_btvsa "Bedingung Testeransteuerung AVANOS" UBYTE _CNV_S_2_Def_bit_ub_563_CM 1 100. 0. 1. DISPLAY_IDENTIFIER B_BTVSA ECU_ADDRESS 0xd000c96b BIT_MASK 0x1 /end MEASUREMENT
/begin MEASUREMENT St_btvns.B_btvsa2 "Bedingung Testeransteuerung AVANOS Bank 2" UBYTE _CNV_S_2_Def_bit_ub_563_CM 1 100. 0. 1. DISPLAY_IDENTIFIER B_BTVSA2 ECU_ADDRESS 0xd000c96b BIT_MASK 0x4 /end MEASUREMENT
/begin MEASUREMENT St_btvns.B_btvse "Bedingung Testeransteuerung EVANOS" UBYTE _CNV_S_2_Def_bit_ub_563_CM 1 100. 0. 1. DISPLAY_IDENTIFIER B_BTVSE ECU_ADDRESS 0xd000c96b BIT_MASK 0x2 /end MEASUREMENT
/begin MEASUREMENT St_btvns.B_btvse2 "Bedingung Testeransteuerung EVANOS Bank 2" UBYTE _CNV_S_2_Def_bit_ub_563_CM 1 100. 0. 1. DISPLAY_IDENTIFIER B_BTVSE2 ECU_ADDRESS 0xd000c96b BIT_MASK 0x8 /end MEASUREMENT
/begin MEASUREMENT St_bv_kath "Statuswort" UBYTE _CNV_R_R_Def_dez_sl_551_CM 1 100. 0. 255. DISPLAY_IDENTIFIER ST_BV_KATH ECU_ADDRESS 0xd000ccde FORMAT "%3.0" /end MEASUREMENT
/begin MEASUREMENT St_bv_kath.B_hsplit_akt "Statuswort" UBYTE _CNV_S_2_Def_bit_ub_563_CM 1 100. 0. 1. DISPLAY_IDENTIFIER B_HSPLIT_AKT ECU_ADDRESS 0xd000ccde BIT_MASK 0x8 /end MEASUREMENT
/begin MEASUREMENT St_bv_kath.B_nesps_akt "Statuswort" UBYTE _CNV_S_2_Def_bit_ub_563_CM 1 100. 0. 1. DISPLAY_IDENTIFIER B_NESPS_AKT ECU_ADDRESS 0xd000ccde BIT_MASK 0x2 /end MEASUREMENT
/begin MEASUREMENT St_ckl15 "Klemmensignale vom CAN" UBYTE _CNV_R_R_Def_dez_sl_551_CM 1 100. 0. 255. DISPLAY_IDENTIFIER ST_CKL15 ECU_ADDRESS 0xc000062a FORMAT "%3.0" /end MEASUREMENT
/begin MEASUREMENT St_ckl15.B_ckl30 "Bedingung Klemme R (über CAN)" UBYTE _CNV_S_2_Def_bit_ub_563_CM 1 100. 0. 1. DISPLAY_IDENTIFIER B_CKL30 ECU_ADDRESS 0xc000062a BIT_MASK 0x2 /end MEASUREMENT
/begin MEASUREMENT St_ckl15.B_ckl50 "Bedingung Klemme 50 (vom CAN)" UBYTE _CNV_S_2_Def_bit_ub_563_CM 1 100. 0. 1. DISPLAY_IDENTIFIER B_CKL50 ECU_ADDRESS 0xc000062a BIT_MASK 0x1 /end MEASUREMENT
/begin MEASUREMENT St_clc "Status Clc" UBYTE _CNV_R_R_Def_dez_sl_551_CM 1 100. 0. 255. DISPLAY_IDENTIFIER ST_CLC ECU_ADDRESS 0xd000c96c FORMAT "%3.0" /end MEASUREMENT
/begin MEASUREMENT St_clc.B_hmm_clc "Berechnung für homogen mager aktiv" UBYTE _CNV_S_2_Def_bit_ub_563_CM 1 100. 0. 1. DISPLAY_IDENTIFIER B_HMM_CLC ECU_ADDRESS 0xd000c96c BIT_MASK 0x1 /end MEASUREMENT
/begin MEASUREMENT St_clc.B_sch_clc "Berechnung für schicht aktiv" UBYTE _CNV_S_2_Def_bit_ub_563_CM 1 100. 0. 1. DISPLAY_IDENTIFIER B_SCH_CLC ECU_ADDRESS 0xd000c96c BIT_MASK 0x2 /end MEASUREMENT
/begin MEASUREMENT St_cybl "Statuswort Gleichstellung" UWORD _CNV_R_R_Def_dez_sl_551_CM 1 100. 0. 65535. DISPLAY_IDENTIFIER ST_CYBL ECU_ADDRESS 0xd000c96e FORMAT "%5.0" /end MEASUREMENT
/begin MEASUREMENT St_cybl.B_gl_ad "Lambdaadaption am Bandende hat fertig gelernt." UWORD _CNV_S_2_Def_bit_ub_563_CM 1 100. 0. 1. DISPLAY_IDENTIFIER B_GL_AD ECU_ADDRESS 0xd000c96e BIT_MASK 0x1 /end MEASUREMENT
/begin MEASUREMENT St_cybl.B_gl_adder "ER_Balancing am Bandende hat additiv adaptiert" UWORD _CNV_S_2_Def_bit_ub_563_CM 1 100. 0. 1. DISPLAY_IDENTIFIER B_GL_ADDER ECU_ADDRESS 0xd000c96e BIT_MASK 0x10 /end MEASUREMENT
/begin MEASUREMENT St_cybl.B_gl_adz "Lambdaadaption ist nötig. Zyklisch während Motorbetrieb zu 1 gesetzt" UWORD _CNV_S_2_Def_bit_ub_563_CM 1 100. 0. 1. DISPLAY_IDENTIFIER B_GL_ADZ ECU_ADDRESS 0xd000c96e BIT_MASK 0x20 /end MEASUREMENT
/begin MEASUREMENT St_cybl.B_gl_faker "ER_Balancing am Bandende hat den Faktor adaptiert" UWORD _CNV_S_2_Def_bit_ub_563_CM 1 100. 0. 1. DISPLAY_IDENTIFIER B_GL_FAKER ECU_ADDRESS 0xd000c96e BIT_MASK 0x8 /end MEASUREMENT
/begin MEASUREMENT St_cybl.B_gl_hz "Zylindersel. Lambdaregelung fordert homogen an. Zyklisch während dem Motorbetrieb zu 1 gesetzt." UWORD _CNV_S_2_Def_bit_ub_563_CM 1 100. 0. 1. DISPLAY_IDENTIFIER B_GL_HZ ECU_ADDRESS 0xd000c96e BIT_MASK 0x80 /end MEASUREMENT
/begin MEASUREMENT St_cybl.B_gl_wg1 "Bedingung Gleichstellung zur Öffnung des Waste Gate 1" UWORD _CNV_S_2_Def_bit_ub_563_CM 1 100. 0. 1. DISPLAY_IDENTIFIER B_GL_WG1 ECU_ADDRESS 0xd000c96e BIT_MASK 0x100 /end MEASUREMENT
/begin MEASUREMENT St_cybl.B_gl_wg2 "Bedingung Gleichstellung zur Öffnung des Waste Gate 2" UWORD _CNV_S_2_Def_bit_ub_563_CM 1 100. 0. 1. DISPLAY_IDENTIFIER B_GL_WG2 ECU_ADDRESS 0xd000c96e BIT_MASK 0x200 /end MEASUREMENT
/begin MEASUREMENT St_cybl.B_gl_zsk "Zylindersel. Lambdaregelung kalt am Bandende hat fertig adaptiert" UWORD _CNV_S_2_Def_bit_ub_563_CM 1 100. 0. 1. DISPLAY_IDENTIFIER B_GL_ZSK ECU_ADDRESS 0xd000c96e BIT_MASK 0x2 /end MEASUREMENT
/begin MEASUREMENT St_cybl.B_gl_zsw "Zylindersel. Lambdaregelung warm am Bandende hat fertig adaptiert." UWORD _CNV_S_2_Def_bit_ub_563_CM 1 100. 0. 1. DISPLAY_IDENTIFIER B_GL_ZSW ECU_ADDRESS 0xd000c96e BIT_MASK 0x4 /end MEASUREMENT
/begin MEASUREMENT St_cybl.B_gl_zswz "Zylindersel. Lambdaregelung warm ist nötig. Zyklisch während Motorbetrieb zu 1 gesetzt" UWORD _CNV_S_2_Def_bit_ub_563_CM 1 100. 0. 1. DISPLAY_IDENTIFIER B_GL_ZSWZ ECU_ADDRESS 0xd000c96e BIT_MASK 0x40 /end MEASUREMENT
/begin MEASUREMENT St_desul "Status Entschwefelung" UBYTE _CNV_R_R_Def_dez_sl_551_CM 1 100. 0. 255. DISPLAY_IDENTIFIER ST_DESUL ECU_ADDRESS 0xc000062b FORMAT "%3.0" /end MEASUREMENT
/begin MEASUREMENT St_desul.B_desu_fett "eine fette Entschwefelung ist angefordert" UBYTE _CNV_S_2_Def_bit_ub_563_CM 1 100. 0. 1. DISPLAY_IDENTIFIER B_DESU_FETT ECU_ADDRESS 0xc000062b BIT_MASK 0x8 /end MEASUREMENT
/begin MEASUREMENT St_desul.B_desu_puls "langsame Desulfatisierung (lambda pulsation) angefordert." UBYTE _CNV_S_2_Def_bit_ub_563_CM 1 100. 0. 1. DISPLAY_IDENTIFIER B_DESU_PULS ECU_ADDRESS 0xc000062b BIT_MASK 0x1 /end MEASUREMENT
/begin MEASUREMENT St_desul.B_desul_akt "Desulfatisierung aktiv" UBYTE _CNV_S_2_Def_bit_ub_563_CM 1 100. 0. 1. DISPLAY_IDENTIFIER B_DESUL_AKT ECU_ADDRESS 0xc000062b BIT_MASK 0x4 /end MEASUREMENT
/begin MEASUREMENT St_devxdetec "Ergebnis BSD-Lernfunktion" UBYTE _CNV_R_R_Def_dez_sl_551_CM 1 100. 0. 255. DISPLAY_IDENTIFIER ST_DEVXDETEC ECU_ADDRESS 0xc0004023 FORMAT "%3.0" /end MEASUREMENT
/begin MEASUREMENT St_devxdetec.B_dev0detec "BSD Dev. 0 gelernt" UBYTE _CNV_S_2_Def_bit_ub_563_CM 1 100. 0. 1. DISPLAY_IDENTIFIER B_DEV0DETEC ECU_ADDRESS 0xc0004023 BIT_MASK 0x1 /end MEASUREMENT
/begin MEASUREMENT St_devxdetec.B_dev1detec "BSD Dev. 1 gelernt" UBYTE _CNV_S_2_Def_bit_ub_563_CM 1 100. 0. 1. DISPLAY_IDENTIFIER B_DEV1DETEC ECU_ADDRESS 0xc0004023 BIT_MASK 0x2 /end MEASUREMENT
/begin MEASUREMENT St_devxdetec.B_dev2detec "BSD Dev. 2 gelernt" UBYTE _CNV_S_2_Def_bit_ub_563_CM 1 100. 0. 1. DISPLAY_IDENTIFIER B_DEV2DETEC ECU_ADDRESS 0xc0004023 BIT_MASK 0x4 /end MEASUREMENT
/begin MEASUREMENT St_devxdetec.B_dev3detec "BSD Dev. 3 gelernt" UBYTE _CNV_S_2_Def_bit_ub_563_CM 1 100. 0. 1. DISPLAY_IDENTIFIER B_DEV3DETEC ECU_ADDRESS 0xc0004023 BIT_MASK 0x8 /end MEASUREMENT
/begin MEASUREMENT St_devxdetec.B_dev4detec "BSD Dev. 4 gelernt" UBYTE _CNV_S_2_Def_bit_ub_563_CM 1 100. 0. 1. DISPLAY_IDENTIFIER B_DEV4DETEC ECU_ADDRESS 0xc0004023 BIT_MASK 0x10 /end MEASUREMENT
/begin MEASUREMENT St_devxdetec.B_dev5detec "BSD Dev. 5 gelernt" UBYTE _CNV_S_2_Def_bit_ub_563_CM 1 100. 0. 1. DISPLAY_IDENTIFIER B_DEV5DETEC ECU_ADDRESS 0xc0004023 BIT_MASK 0x20 /end MEASUREMENT
/begin MEASUREMENT St_devxdetec.B_dev6detec "BSD Dev. 6 gelernt" UBYTE _CNV_S_2_Def_bit_ub_563_CM 1 100. 0. 1. DISPLAY_IDENTIFIER B_DEV6DETEC ECU_ADDRESS 0xc0004023 BIT_MASK 0x40 /end MEASUREMENT
/begin MEASUREMENT St_devxdetec.B_dev7detec "BSD Dev. 7 gelernt" UBYTE _CNV_S_2_Def_bit_ub_563_CM 1 100. 0. 1. DISPLAY_IDENTIFIER B_DEV7DETEC ECU_ADDRESS 0xc0004023 BIT_MASK 0x80 /end MEASUREMENT
/begin MEASUREMENT St_dk_diag "Status TPS Diagnose" UBYTE _CNV_R_R_Def_dez_sl_551_CM 1 100. 0. 255. DISPLAY_IDENTIFIER ST_DK_DIAG ECU_ADDRESS 0xd000c970 FORMAT "%3.0" /end MEASUREMENT
/begin MEASUREMENT St_dk_diag.B_dk2err_2pot "Bedingung beide DK-Potis defekt" UBYTE _CNV_S_2_Def_bit_ub_563_CM 1 100. 0. 1. DISPLAY_IDENTIFIER B_DK2ERR_2POT ECU_ADDRESS 0xd000c970 BIT_MASK 0x20 /end MEASUREMENT
/begin MEASUREMENT St_dk_diag.B_dkerr_2pot "Bedingung beide DK-Potis defekt" UBYTE _CNV_S_2_Def_bit_ub_563_CM 1 100. 0. 1. DISPLAY_IDENTIFIER B_DKERR_2POT ECU_ADDRESS 0xd000c970 BIT_MASK 0x4 /end MEASUREMENT
/begin MEASUREMENT St_dk_diag.B_nlf "Notluftfahren aktiv" UBYTE _CNV_S_2_Def_bit_ub_563_CM 1 100. 0. 1. DISPLAY_IDENTIFIER B_NLF ECU_ADDRESS 0xd000c970 BIT_MASK 0x8 /end MEASUREMENT
/begin MEASUREMENT St_dk_diag.B_ska "SKA aktiv, ausgelöst über Ebene 1, 2 oder 3" UBYTE _CNV_S_2_Def_bit_ub_563_CM 1 100. 0. 1. DISPLAY_IDENTIFIER B_SKA ECU_ADDRESS 0xd000c970 BIT_MASK 0x10 /end MEASUREMENT
/begin MEASUREMENT St_dkg "Anforderungsmodus" UBYTE _CNV_R_R_Def_dez_sl_551_CM 1 100. 0. 255. DISPLAY_IDENTIFIER ST_DKG ECU_ADDRESS 0xd000c971 FORMAT "%3.0" /end MEASUREMENT
/begin MEASUREMENT St_dkg.B_schalt_dkg "Drehzahlregelung aktiv" UBYTE _CNV_S_2_Def_bit_ub_563_CM 1 100. 0. 1. DISPLAY_IDENTIFIER B_SCHALT_DKG ECU_ADDRESS 0xd000c971 BIT_MASK 0x1 /end MEASUREMENT
/begin MEASUREMENT St_dkheiz "Statuswort für Drosselklappenheizung" UBYTE _CNV_R_R_Def_dez_sl_551_CM 1 100. 0. 255. DISPLAY_IDENTIFIER ST_DKHEIZ ECU_ADDRESS 0xd000c972 FORMAT "%3.0" /end MEASUREMENT
/begin MEASUREMENT St_dkratio "Status DK Ratiocheck" UBYTE _CNV_R_R_Def_dez_sl_551_CM 1 100. 0. 255. DISPLAY_IDENTIFIER ST_DKRATIO ECU_ADDRESS 0xc000062c FORMAT "%3.0" /end MEASUREMENT
/begin MEASUREMENT St_dkratio.B_dkratio_h "Homogener Betrieb angefordert" UBYTE _CNV_S_2_Def_bit_ub_563_CM 1 100. 0. 1. DISPLAY_IDENTIFIER B_DKRATIO_H ECU_ADDRESS 0xc000062c BIT_MASK 0x2 /end MEASUREMENT
/begin MEASUREMENT St_dsc_mradist "Statuswort Ist-Radmoment" UBYTE _CNV_R_R_Def_dez_sl_551_CM 1 100. 0. 255. DISPLAY_IDENTIFIER ST_DSC_MRADIST ECU_ADDRESS 0xd000cc29 FORMAT "%3.0" /end MEASUREMENT
/begin MEASUREMENT St_dsc_mradsoll "Sollwert Qualifier zum Signal Soll_Radmoment_Antriebsstrang_Summe_Stabilisierung" UBYTE _CNV_R_R_Def_dez_sl_551_CM 1 100. 0. 255. DISPLAY_IDENTIFIER ST_DSC_MRADSOLL ECU_ADDRESS 0xd000c973 FORMAT "%3.0" /end MEASUREMENT
/begin MEASUREMENT St_dtev "Status TEV-Diagnose" UBYTE _CNV_R_R_Def_dez_sl_551_CM 1 100. 0. 255. DISPLAY_IDENTIFIER ST_DTEV ECU_ADDRESS 0xc000062d FORMAT "%3.0" /end MEASUREMENT
/begin MEASUREMENT St_dtev.B_dtev_aktiv "Bedingung sperrt DPS-Regler durch TEV-Diagnose" UBYTE _CNV_S_2_Def_bit_ub_563_CM 1 100. 0. 1. DISPLAY_IDENTIFIER B_DTEV_AKTIV ECU_ADDRESS 0xc000062d BIT_MASK 0x1 /end MEASUREMENT
/begin MEASUREMENT St_dvvt0 "Statuswort dvvt 0" UBYTE _CNV_R_R_Def_dez_sl_551_CM 1 100. 0. 255. DISPLAY_IDENTIFIER ST_DVVT0 ECU_ADDRESS 0xc00006dd FORMAT "%3.0" /end MEASUREMENT
/begin MEASUREMENT St_dvvt0.B_btvvta_ena "Statuswort dvvt 0" UBYTE _CNV_S_2_Def_bit_ub_563_CM 1 100. 0. 1. DISPLAY_IDENTIFIER B_BTVVTA_ENA ECU_ADDRESS 0xc00006dd BIT_MASK 0x1 /end MEASUREMENT
/begin MEASUREMENT St_dvvt1 "Statuswort" UBYTE _CNV_R_R_Def_dez_sl_551_CM 1 100. 0. 255. DISPLAY_IDENTIFIER ST_DVVT1 ECU_ADDRESS 0xc00006de FORMAT "%3.0" /end MEASUREMENT
/begin MEASUREMENT St_dvvt1.B_vvtnotl "Bedingung VVT Notlauf" UBYTE _CNV_S_2_Def_bit_ub_563_CM 1 100. 0. 1. DISPLAY_IDENTIFIER B_VVTNOTL ECU_ADDRESS 0xc00006de BIT_MASK 0x20 /end MEASUREMENT
/begin MEASUREMENT St_ecostat1 "Ecos Statusbyte 1" UBYTE _CNV_R_R_Def_dez_sl_551_CM 1 100. 0. 255. DISPLAY_IDENTIFIER ST_ECOSTAT1 ECU_ADDRESS 0xc000062e FORMAT "%3.0" /end MEASUREMENT
/begin MEASUREMENT St_ecostat1.B_ecojob1 "Ecos Job1 aktiv" UBYTE _CNV_S_2_Def_bit_ub_563_CM 1 100. 0. 1. DISPLAY_IDENTIFIER B_ECOJOB1 ECU_ADDRESS 0xc000062e BIT_MASK 0x1 /end MEASUREMENT
/begin MEASUREMENT St_ecostat1.B_ecojob2 "Ecos Job 2 aktiv" UBYTE _CNV_S_2_Def_bit_ub_563_CM 1 100. 0. 1. DISPLAY_IDENTIFIER B_ECOJOB2 ECU_ADDRESS 0xc000062e BIT_MASK 0x2 /end MEASUREMENT
/begin MEASUREMENT St_egs "Statusbyte Automatikgetriebe" UBYTE _CNV_R_R_Def_dez_sl_551_CM 1 100. 0. 255. DISPLAY_IDENTIFIER ST_EGS ECU_ADDRESS 0xc000062f FORMAT "%3.0" /end MEASUREMENT
/begin MEASUREMENT St_egs.B_egs_khl1 "Bedingung Anforderung Kühlstufe 1 von Getriebesteuerung" UBYTE _CNV_S_2_Def_bit_ub_563_CM 1 100. 0. 1. DISPLAY_IDENTIFIER B_EGS_KHL1 ECU_ADDRESS 0xc000062f BIT_MASK 0x2 /end MEASUREMENT
/begin MEASUREMENT St_egs.B_egs_khl2 "Bedingung Anforderung Kühlstufe 2 von Getriebesteuerung" UBYTE _CNV_S_2_Def_bit_ub_563_CM 1 100. 0. 1. DISPLAY_IDENTIFIER B_EGS_KHL2 ECU_ADDRESS 0xc000062f BIT_MASK 0x4 /end MEASUREMENT
/begin MEASUREMENT St_egs.B_fs "Bedingung Fahrstufe" UBYTE _CNV_S_2_Def_bit_ub_563_CM 1 100. 0. 1. DISPLAY_IDENTIFIER B_FS ECU_ADDRESS 0xc000062f BIT_MASK 0x1 /end MEASUREMENT
/begin MEASUREMENT St_eisy_agrreg "Statuswort" UBYTE _CNV_R_R_Def_dez_sl_551_CM 1 100. 0. 255. DISPLAY_IDENTIFIER ST_EISY_AGRREG ECU_ADDRESS 0xd000cc48 FORMAT "%3.0" /end MEASUREMENT
/begin MEASUREMENT St_eisy_agrreg.B_agrreg_akt "Statuswort" UBYTE _CNV_S_2_Def_bit_ub_563_CM 1 100. 0. 1. DISPLAY_IDENTIFIER B_AGRREG_AKT ECU_ADDRESS 0xd000cc48 BIT_MASK 0x1 /end MEASUREMENT
/begin MEASUREMENT St_ekp "Statusbyte fuer EKP" UBYTE _CNV_R_R_Def_dez_sl_551_CM 1 100. 0. 255. DISPLAY_IDENTIFIER ST_EKP ECU_ADDRESS 0xd000c974 FORMAT "%3.0" /end MEASUREMENT
/begin MEASUREMENT St_ekp.B_dkpu "Bedingung Sicherheitskraftstoffabschaltung" UBYTE _CNV_S_2_Def_bit_ub_563_CM 1 100. 0. 1. DISPLAY_IDENTIFIER B_DKPU ECU_ADDRESS 0xd000c974 BIT_MASK 0x8 /end MEASUREMENT
/begin MEASUREMENT St_elu "Statuswort für Bits für Elüfter(True meint 600W Lüfter verbaut)" UBYTE _CNV_R_R_Def_dez_sl_551_CM 1 100. 0. 255. DISPLAY_IDENTIFIER ST_ELU ECU_ADDRESS 0xc0000630 FORMAT "%3.0" /end MEASUREMENT
/begin MEASUREMENT St_elu.B_elu600 "Bedingung Elüftertyp" UBYTE _CNV_S_2_Def_bit_ub_563_CM 1 100. 0. 1. DISPLAY_IDENTIFIER B_ELU600 ECU_ADDRESS 0xc0000630 BIT_MASK 0x1 /end MEASUREMENT
/begin MEASUREMENT St_fas_mradist "Status Radmoment Ist" UBYTE _CNV_R_R_Def_dez_sl_551_CM 1 100. 0. 255. DISPLAY_IDENTIFIER ST_FAS_MRADIST ECU_ADDRESS 0xd000cc28 FORMAT "%3.0" /end MEASUREMENT
/begin MEASUREMENT St_fas_mradsoll "Sollwert Qualifier zum Signal Soll_Radmoment_Antriebsstrang_Summe_FAS." UBYTE _CNV_R_R_Def_dez_sl_551_CM 1 100. 0. 255. DISPLAY_IDENTIFIER ST_FAS_MRADSOLL ECU_ADDRESS 0xd000c975 FORMAT "%3.0" /end MEASUREMENT
/begin MEASUREMENT St_fdc "Statuswort FDC" UBYTE _CNV_R_R_Def_dez_sl_551_CM 1 100. 0. 255. DISPLAY_IDENTIFIER ST_FDC ECU_ADDRESS 0xd000c976 FORMAT "%3.0" /end MEASUREMENT
/begin MEASUREMENT St_fdc.B_sport "Bedingung Sport" UBYTE _CNV_S_2_Def_bit_ub_563_CM 1 100. 0. 1. DISPLAY_IDENTIFIER B_SPORT ECU_ADDRESS 0xd000c976 BIT_MASK 0x1 /end MEASUREMENT
/begin MEASUREMENT St_fzg_1 "Variante Fzg" ULONG _CNV_R_R_Def_dez_sl_551_CM 1 100. 0. 4294967295. DISPLAY_IDENTIFIER ST_FZG_1 ECU_ADDRESS 0xc0000632 FORMAT "%7.0" /end MEASUREMENT
/begin MEASUREMENT St_fzg_2 "Variante Fzg" ULONG _CNV_R_R_Def_dez_sl_551_CM 1 100. 0. 4294967295. DISPLAY_IDENTIFIER ST_FZG_2 ECU_ADDRESS 0xc0000636 FORMAT "%7.0" /end MEASUREMENT
/begin MEASUREMENT St_fzg_ass "Status Fahrerassistenzsystem Antrieb" UBYTE _CNV_R_R_Def_dez_sl_551_CM 1 100. 0. 255. DISPLAY_IDENTIFIER ST_FZG_ASS ECU_ADDRESS 0xd000c977 FORMAT "%3.0" /end MEASUREMENT
/begin MEASUREMENT St_gen_ext "Statusbyte Testerzugriff Generator" UBYTE _CNV_R_R_Def_dez_sl_551_CM 1 100. 0. 255. DISPLAY_IDENTIFIER ST_GEN_EXT ECU_ADDRESS 0xc000063a FORMAT "%3.0" /end MEASUREMENT
/begin MEASUREMENT St_gen_ext.B_gen_ext "Bedingung Testeransteuerung Generator" UBYTE _CNV_S_2_Def_bit_ub_563_CM 1 100. 0. 1. DISPLAY_IDENTIFIER B_GEN_EXT ECU_ADDRESS 0xc000063a BIT_MASK 0x1 /end MEASUREMENT
/begin MEASUREMENT St_gen_ext.B_ierr_ext "Anforderung Grenzerregerstrom vom Tester" UBYTE _CNV_S_2_Def_bit_ub_563_CM 1 100. 0. 1. DISPLAY_IDENTIFIER B_IERR_EXT ECU_ADDRESS 0xc000063a BIT_MASK 0x4 /end MEASUREMENT
/begin MEASUREMENT St_gen_ext.B_loadre_ext "Anforderung Loadresponse vom Tester" UBYTE _CNV_S_2_Def_bit_ub_563_CM 1 100. 0. 1. DISPLAY_IDENTIFIER B_LOADRE_EXT ECU_ADDRESS 0xc000063a BIT_MASK 0x2 /end MEASUREMENT
/begin MEASUREMENT St_genallg "Allgemeine Eingangsbits" UBYTE _CNV_R_R_Def_dez_sl_551_CM 1 100. 0. 255. DISPLAY_IDENTIFIER ST_GENALLG ECU_ADDRESS 0xc000063b FORMAT "%3.0" /end MEASUREMENT
/begin MEASUREMENT St_genallg.B_abliactiv "Bedingung Abblendlicht aktiv" UBYTE _CNV_S_2_Def_bit_ub_563_CM 1 100. 0. 1. DISPLAY_IDENTIFIER B_ABLIACTIV ECU_ADDRESS 0xc000063b BIT_MASK 0x2 /end MEASUREMENT
/begin MEASUREMENT St_genallg.B_bsdprot1 "Bedingung BSD Protokollinhalt für BSD1 Regler" UBYTE _CNV_S_2_Def_bit_ub_563_CM 1 100. 0. 1. DISPLAY_IDENTIFIER B_BSDPROT1 ECU_ADDRESS 0xc000063b BIT_MASK 0x8 /end MEASUREMENT
/begin MEASUREMENT St_genallg.B_bsdprot2 "Bedingung BSD Protokollinhalt für BSD 2 Regler" UBYTE _CNV_S_2_Def_bit_ub_563_CM 1 100. 0. 1. DISPLAY_IDENTIFIER B_BSDPROT2 ECU_ADDRESS 0xc000063b BIT_MASK 0x10 /end MEASUREMENT
/begin MEASUREMENT St_genallg.B_iliactiv "Bedingung Innenlicht aktiv" UBYTE _CNV_S_2_Def_bit_ub_563_CM 1 100. 0. 1. DISPLAY_IDENTIFIER B_ILIACTIV ECU_ADDRESS 0xc000063b BIT_MASK 0x1 /end MEASUREMENT
/begin MEASUREMENT St_genallg.B_rd_gentyp "Bedingung Schalter APK zum Auslesen Hersteller und Generatortyp" UBYTE _CNV_S_2_Def_bit_ub_563_CM 1 100. 0. 1. DISPLAY_IDENTIFIER B_RD_GENTYP ECU_ADDRESS 0xc000063b BIT_MASK 0x20 /end MEASUREMENT
/begin MEASUREMENT St_generator "Statusbyte Generator" UBYTE _CNV_R_R_Def_dez_sl_551_CM 1 100. 0. 255. DISPLAY_IDENTIFIER ST_GENERATOR ECU_ADDRESS 0xc000063c FORMAT "%3.0" /end MEASUREMENT
/begin MEASUREMENT St_generator.B_crashgen "Bedingung Generator abschalten bei Crash" UBYTE _CNV_S_2_Def_bit_ub_563_CM 1 100. 0. 1. DISPLAY_IDENTIFIER B_CRASHGEN ECU_ADDRESS 0xc000063c BIT_MASK 0x40 /end MEASUREMENT
/begin MEASUREMENT St_generator.B_genactiv "Bedingung Generatorinterface aktiv" UBYTE _CNV_S_2_Def_bit_ub_563_CM 1 100. 0. 1. DISPLAY_IDENTIFIER B_GENACTIV ECU_ADDRESS 0xc000063c BIT_MASK 0x1 /end MEASUREMENT
/begin MEASUREMENT St_generator.B_genfbsd "Bedingung Kommunikationsverlust BSD Generator" UBYTE _CNV_S_2_Def_bit_ub_563_CM 1 100. 0. 1. DISPLAY_IDENTIFIER B_GENFBSD ECU_ADDRESS 0xc000063c BIT_MASK 0x4 /end MEASUREMENT
/begin MEASUREMENT St_generator.B_genfel "Bedingung Generatorfehler elektrisch" UBYTE _CNV_S_2_Def_bit_ub_563_CM 1 100. 0. 1. DISPLAY_IDENTIFIER B_GENFEL ECU_ADDRESS 0xc000063c BIT_MASK 0x8 /end MEASUREMENT
/begin MEASUREMENT St_generator.B_genfht "Bedingung Generatorzustand hohe Temparatur" UBYTE _CNV_S_2_Def_bit_ub_563_CM 1 100. 0. 1. DISPLAY_IDENTIFIER B_GENFHT ECU_ADDRESS 0xc000063c BIT_MASK 0x10 /end MEASUREMENT
/begin MEASUREMENT St_generator.B_genfme "Bedingung Generatorfehler mechanisch" UBYTE _CNV_S_2_Def_bit_ub_563_CM 1 100. 0. 1. DISPLAY_IDENTIFIER B_GENFME ECU_ADDRESS 0xc000063c BIT_MASK 0x20 /end MEASUREMENT
/begin MEASUREMENT St_genll "LR Eingänge" UBYTE _CNV_R_R_Def_dez_sl_551_CM 1 100. 0. 255. DISPLAY_IDENTIFIER ST_GENLL ECU_ADDRESS 0xc0007473 FORMAT "%3.0" /end MEASUREMENT
/begin MEASUREMENT St_genll.B_lrfoff "Kopie Drehzahlschwelle für LR-Funktion Generator 1 aktiv" UBYTE _CNV_S_2_Def_bit_ub_563_CM 1 100. 0. 1. DISPLAY_IDENTIFIER B_LRFOFF ECU_ADDRESS 0xc0007473 BIT_MASK 0x1 /end MEASUREMENT
/begin MEASUREMENT St_genll.B_lrreg1ak "LR-Register 1 aktiv Generator 1" UBYTE _CNV_S_2_Def_bit_ub_563_CM 1 100. 0. 1. DISPLAY_IDENTIFIER B_LRREG1AK ECU_ADDRESS 0xc0007473 BIT_MASK 0x4 /end MEASUREMENT
/begin MEASUREMENT St_gentester "Statuswort für Bits" UBYTE _CNV_R_R_Def_dez_sl_551_CM 1 100. 0. 255. DISPLAY_IDENTIFIER ST_GENTESTER ECU_ADDRESS 0xc000063d FORMAT "%3.0" /end MEASUREMENT
/begin MEASUREMENT St_gentester.B_gentestanf "Anforderung Generatortest" UBYTE _CNV_S_2_Def_bit_ub_563_CM 1 100. 0. 1. DISPLAY_IDENTIFIER B_GENTESTANF ECU_ADDRESS 0xc000063d BIT_MASK 0x1 /end MEASUREMENT
/begin MEASUREMENT St_getrdaten "Status Getriebedaten" UBYTE _CNV_R_R_Def_dez_sl_551_CM 1 100. 0. 255. DISPLAY_IDENTIFIER ST_GETRDATEN ECU_ADDRESS 0xd000c978 FORMAT "%3.0" /end MEASUREMENT
/begin MEASUREMENT St_getrdaten.B_gangwechsel_gs "Gangwechsel aktiv" UBYTE _CNV_S_2_Def_bit_ub_563_CM 1 100. 0. 1. DISPLAY_IDENTIFIER B_GANGWECHSEL_GS ECU_ADDRESS 0xd000c978 BIT_MASK 0x2 /end MEASUREMENT
/begin MEASUREMENT St_getrdaten.B_keinhs_gs "Wenn=0 wird die Maxdrehzahl mit Prädiktion abgeregelt" UBYTE _CNV_S_2_Def_bit_ub_563_CM 1 100. 0. 1. DISPLAY_IDENTIFIER B_KEINHS_GS ECU_ADDRESS 0xd000c978 BIT_MASK 0x1 /end MEASUREMENT
/begin MEASUREMENT St_getriebe "Statuswort Getriebe" UBYTE _CNV_R_R_Def_dez_sl_551_CM 1 100. 0. 255. DISPLAY_IDENTIFIER ST_GETRIEBE ECU_ADDRESS 0xc000063e FORMAT "%3.0" /end MEASUREMENT
/begin MEASUREMENT St_getriebe.B_autget "Bedingung Automatikgetriebe verbaut" UBYTE _CNV_S_2_Def_bit_ub_563_CM 1 100. 0. 1. DISPLAY_IDENTIFIER B_AUTGET ECU_ADDRESS 0xc000063e BIT_MASK 0x1 /end MEASUREMENT
/begin MEASUREMENT St_gglsu2 "Bedingung LSU betriebsbereit vor Kat" UBYTE _CNV_R_R_Def_dez_sl_551_CM 1 100. 0. 255. DISPLAY_IDENTIFIER ST_GGLSU2 ECU_ADDRESS 0xd000c979 FORMAT "%3.0" /end MEASUREMENT
/begin MEASUREMENT St_gglsu2.B_sbblsu "Bedingung LSU betriebsbereit vor Kat" UBYTE _CNV_S_2_Def_bit_ub_563_CM 1 100. 0. 1. DISPLAY_IDENTIFIER B_SBBLSU ECU_ADDRESS 0xd000c979 BIT_MASK 0x1 /end MEASUREMENT
/begin MEASUREMENT St_gglsu2.B_sbblsu2 "Bedingung LSU2 betriebsbereit vor Kat" UBYTE _CNV_S_2_Def_bit_ub_563_CM 1 100. 0. 1. DISPLAY_IDENTIFIER B_SBBLSU2 ECU_ADDRESS 0xd000c979 BIT_MASK 0x2 /end MEASUREMENT
/begin MEASUREMENT St_gl_adapt "" UBYTE _CNV_R_R_Def_dez_sl_551_CM 1 100. 0. 255. DISPLAY_IDENTIFIER ST_GL_ADAPT ECU_ADDRESS 0xc0007489 FORMAT "%3.0" /end MEASUREMENT
/begin MEASUREMENT St_hubkor "Statuswort für Bitgroessen HUBKOR" UBYTE _CNV_R_R_Def_dez_sl_551_CM 1 100. 0. 255. DISPLAY_IDENTIFIER ST_HUBKOR ECU_ADDRESS 0xd000ccdc FORMAT "%3.0" /end MEASUREMENT
/begin MEASUREMENT St_hubkor.B_hubkor "Bedingung Hubkorrektur aktiv" UBYTE _CNV_S_2_Def_bit_ub_563_CM 1 100. 0. 1. DISPLAY_IDENTIFIER B_HUBKOR ECU_ADDRESS 0xd000ccdc BIT_MASK 0x2 /end MEASUREMENT
/begin MEASUREMENT St_hubkor_5ms "Statuswort" UBYTE _CNV_R_R_Def_dez_sl_551_CM 1 100. 0. 255. DISPLAY_IDENTIFIER ST_HUBKOR_5MS ECU_ADDRESS 0xd000ccdb FORMAT "%3.0" /end MEASUREMENT
/begin MEASUREMENT St_hubkor_5ms.B_hubistkor "Bedingung Hub wird gerade korrigiert" UBYTE _CNV_S_2_Def_bit_ub_563_CM 1 100. 0. 1. DISPLAY_IDENTIFIER B_HUBISTKOR ECU_ADDRESS 0xd000ccdb BIT_MASK 0x1 /end MEASUREMENT
/begin MEASUREMENT St_igrin "Statuswort St_igrin" UBYTE _CNV_R_R_Def_dez_sl_551_CM 1 100. 0. 255. DISPLAY_IDENTIFIER ST_IGRIN ECU_ADDRESS 0xc000063f FORMAT "%3.0" /end MEASUREMENT
/begin MEASUREMENT St_igrin.B_fe "Implementierung Fertigungsmodus aktivieren" UBYTE _CNV_S_2_Def_bit_ub_563_CM 1 100. 0. 1. DISPLAY_IDENTIFIER B_FE ECU_ADDRESS 0xc000063f BIT_MASK 0x2 /end MEASUREMENT
/begin MEASUREMENT St_igrin.B_fetrawedeak "Implementierung Fertigungs-, Transport- und Werkstattmodus deaktivieren" UBYTE _CNV_S_2_Def_bit_ub_563_CM 1 100. 0. 1. DISPLAY_IDENTIFIER B_FETRAWEDEAK ECU_ADDRESS 0xc000063f BIT_MASK 0x10 /end MEASUREMENT
/begin MEASUREMENT St_igrin.B_tra "Implementierung Transportmodus aktivieren" UBYTE _CNV_S_2_Def_bit_ub_563_CM 1 100. 0. 1. DISPLAY_IDENTIFIER B_TRA ECU_ADDRESS 0xc000063f BIT_MASK 0x4 /end MEASUREMENT
/begin MEASUREMENT St_igrin.B_we "Implementierung Werkstattmodus aktivieren" UBYTE _CNV_S_2_Def_bit_ub_563_CM 1 100. 0. 1. DISPLAY_IDENTIFIER B_WE ECU_ADDRESS 0xc000063f BIT_MASK 0x8 /end MEASUREMENT
/begin MEASUREMENT St_igrinnv "Statuswort St_igrinnv" UBYTE _CNV_R_R_Def_dez_sl_551_CM 1 100. 0. 255. DISPLAY_IDENTIFIER ST_IGRINNV ECU_ADDRESS 0xc0004024 FORMAT "%3.0" /end MEASUREMENT
/begin MEASUREMENT St_igrinnv.B_cdigronw "IGR-Codierdaten schreiben bzw. einlesen in die DDE/DME" UBYTE _CNV_S_2_Def_bit_ub_563_CM 1 100. 0. 1. DISPLAY_IDENTIFIER B_CDIGRONW ECU_ADDRESS 0xc0004024 BIT_MASK 0x1 /end MEASUREMENT
/begin MEASUREMENT St_igrinnv.B_cdxenonw "Xenonverbau-Codierdaten schreiben" UBYTE _CNV_S_2_Def_bit_ub_563_CM 1 100. 0. 1. DISPLAY_IDENTIFIER B_CDXENONW ECU_ADDRESS 0xc0004024 BIT_MASK 0x2 /end MEASUREMENT
/begin MEASUREMENT St_igrinnv.B_diagigr "Aktivierung/Deaktivierung iGR (Bit = true -> Diagnosejob gesetzt -> Igr deaktiviert)" UBYTE _CNV_S_2_Def_bit_ub_563_CM 1 100. 0. 1. DISPLAY_IDENTIFIER B_DIAGIGR ECU_ADDRESS 0xc0004024 BIT_MASK 0x40 /end MEASUREMENT
/begin MEASUREMENT St_kath_anf1 "Statuswort Katheizanforderung - Beste Wunsch" UBYTE _CNV_R_R_Def_dez_sl_551_CM 1 100. 0. 255. DISPLAY_IDENTIFIER ST_KATH_ANF1 ECU_ADDRESS 0xd000cccc FORMAT "%3.0" /end MEASUREMENT
/begin MEASUREMENT St_katueb "Status Katüberwachung" UBYTE _CNV_R_R_Def_dez_sl_551_CM 1 100. 0. 255. DISPLAY_IDENTIFIER ST_KATUEB ECU_ADDRESS 0xd000c97a FORMAT "%3.0" /end MEASUREMENT
/begin MEASUREMENT St_katueb.B_kathom "Homogen stöch wg. Kat-Regenerierungsbedarf angefordert" UBYTE _CNV_S_2_Def_bit_ub_563_CM 1 100. 0. 1. DISPLAY_IDENTIFIER B_KATHOM ECU_ADDRESS 0xd000c97a BIT_MASK 0x20 /end MEASUREMENT
/begin MEASUREMENT St_katueb.B_nk_hom "Homogen stöch wg. Nox Kat-Regenerierungsbedarf angefordert" UBYTE _CNV_S_2_Def_bit_ub_563_CM 1 100. 0. 1. DISPLAY_IDENTIFIER B_NK_HOM ECU_ADDRESS 0xd000c97a BIT_MASK 0x10 /end MEASUREMENT
/begin MEASUREMENT St_katueb.B_rgnkat "Regenerierung Kat angefordert" UBYTE _CNV_S_2_Def_bit_ub_563_CM 1 100. 0. 1. DISPLAY_IDENTIFIER B_RGNKAT ECU_ADDRESS 0xd000c97a BIT_MASK 0x1 /end MEASUREMENT
/begin MEASUREMENT St_katueb.B_rgnkat_hla1 "Umschaltung über Homogen RGN, wegen Kat Regenerierungsbedarfs" UBYTE _CNV_S_2_Def_bit_ub_563_CM 1 100. 0. 1. DISPLAY_IDENTIFIER B_RGNKAT_HLA1 ECU_ADDRESS 0xd000c97a BIT_MASK 0x2 /end MEASUREMENT
/begin MEASUREMENT St_khm "Statuswort KHM" UBYTE _CNV_R_R_Def_dez_sl_551_CM 1 100. 0. 255. DISPLAY_IDENTIFIER ST_KHM ECU_ADDRESS 0xd000ccd7 FORMAT "%3.0" /end MEASUREMENT
/begin MEASUREMENT St_khm.B_khm_h "Statuswort KHM" UBYTE _CNV_S_2_Def_bit_ub_563_CM 1 100. 0. 1. DISPLAY_IDENTIFIER B_KHM_H ECU_ADDRESS 0xd000ccd7 BIT_MASK 0x1 /end MEASUREMENT
/begin MEASUREMENT St_khm.B_khm_hs "Statuswort KHM" UBYTE _CNV_S_2_Def_bit_ub_563_CM 1 100. 0. 1. DISPLAY_IDENTIFIER B_KHM_HS ECU_ADDRESS 0xd000ccd7 BIT_MASK 0x2 /end MEASUREMENT
/begin MEASUREMENT St_khm.B_khm_s "Statuswort KHM" UBYTE _CNV_S_2_Def_bit_ub_563_CM 1 100. 0. 1. DISPLAY_IDENTIFIER B_KHM_S ECU_ADDRESS 0xd000ccd7 BIT_MASK 0x4 /end MEASUREMENT
/begin MEASUREMENT St_kl15 "Statusbyte Klemme 15" UBYTE _CNV_R_R_Def_dez_sl_551_CM 1 100. 0. 255. DISPLAY_IDENTIFIER ST_KL15 ECU_ADDRESS 0xc0000640 FORMAT "%3.0" /end MEASUREMENT
/begin MEASUREMENT St_kl15.B_kl15_ep "Bitgröße, Bedingung KL15 gesetzt" UBYTE _CNV_S_2_Def_bit_ub_563_CM 1 100. 0. 1. DISPLAY_IDENTIFIER B_KL15_EP ECU_ADDRESS 0xc0000640 BIT_MASK 0x1 /end MEASUREMENT
/begin MEASUREMENT St_kl15.B_kl15_vorab "Bedingung KL15 gedrückt" UBYTE _CNV_S_2_Def_bit_ub_563_CM 1 100. 0. 1. DISPLAY_IDENTIFIER B_KL15_VORAB ECU_ADDRESS 0xc0000640 BIT_MASK 0x80 /end MEASUREMENT
/begin MEASUREMENT St_klopfen "Statuswort Klopfen" UBYTE _CNV_R_R_Def_dez_sl_551_CM 1 100. 0. 255. DISPLAY_IDENTIFIER ST_KLOPFEN ECU_ADDRESS 0xd000c97b FORMAT "%3.0" /end MEASUREMENT
/begin MEASUREMENT St_klopfen.B_klopfen "Klopfen erkannt" UBYTE _CNV_S_2_Def_bit_ub_563_CM 1 100. 0. 1. DISPLAY_IDENTIFIER B_KLOPFEN ECU_ADDRESS 0xd000c97b BIT_MASK 0x1 /end MEASUREMENT
/begin MEASUREMENT St_kr "Bedingung Klopfregelung" UBYTE _CNV_R_R_Def_dez_sl_551_CM 1 100. 0. 255. DISPLAY_IDENTIFIER ST_KR ECU_ADDRESS 0xd000c97c FORMAT "%3.0" /end MEASUREMENT
/begin MEASUREMENT St_kr.B_clradkr "Bedingung Adaptionswerte Klopfregelung selektiv löschen (Testeranforderung)" UBYTE _CNV_S_2_Def_bit_ub_563_CM 1 100. 0. 1. DISPLAY_IDENTIFIER B_CLRADKR ECU_ADDRESS 0xd000c97c BIT_MASK 0x1 /end MEASUREMENT
/begin MEASUREMENT St_kr.B_krdws "Bedingung Klopfregelung Sicherheitsspätverstellung" UBYTE _CNV_S_2_Def_bit_ub_563_CM 1 100. 0. 1. DISPLAY_IDENTIFIER B_KRDWS ECU_ADDRESS 0xd000c97c BIT_MASK 0x4 /end MEASUREMENT
/begin MEASUREMENT St_kr.B_krndy "Bedingung Drehzahldynamik für Klopfregelung aktiv" UBYTE _CNV_S_2_Def_bit_ub_563_CM 1 100. 0. 1. DISPLAY_IDENTIFIER B_KRNDY ECU_ADDRESS 0xd000c97c BIT_MASK 0x2 /end MEASUREMENT
/begin MEASUREMENT St_kr.B_zwkraa "Bedingung Zündwinkel der Klopfregelung wird ausgegeben" UBYTE _CNV_S_2_Def_bit_ub_563_CM 1 100. 0. 1. DISPLAY_IDENTIFIER B_ZWKRAA ECU_ADDRESS 0xd000c97c BIT_MASK 0x10 /end MEASUREMENT
/begin MEASUREMENT St_kr1 "Statusbyte Klopfregelung" UBYTE _CNV_R_R_Def_dez_sl_551_CM 1 100. 0. 255. DISPLAY_IDENTIFIER ST_KR1 ECU_ADDRESS 0xd000c97d FORMAT "%3.0" /end MEASUREMENT
/begin MEASUREMENT St_kr1.B_krakt "Bedingung Klopfregelung aktiv" UBYTE _CNV_S_2_Def_bit_ub_563_CM 1 100. 0. 1. DISPLAY_IDENTIFIER B_KRAKT ECU_ADDRESS 0xd000c97d BIT_MASK 0x80 /end MEASUREMENT
/begin MEASUREMENT St_krann "Statuswort KRANN" UBYTE _CNV_R_R_Def_dez_sl_551_CM 1 100. 0. 255. DISPLAY_IDENTIFIER ST_KRANN ECU_ADDRESS 0xc00008ac FORMAT "%3.0" /end MEASUREMENT
/begin MEASUREMENT St_krann.B_khnnlern "Bedingung Adaption KHNN freigegeben" UBYTE _CNV_S_2_Def_bit_ub_563_CM 1 100. 0. 1. DISPLAY_IDENTIFIER B_KHNNLERN ECU_ADDRESS 0xc00008ac BIT_MASK 0x10 /end MEASUREMENT
/begin MEASUREMENT St_krann.B_nnlern "Bedingung Adaption KRANN freigegeben" UBYTE _CNV_S_2_Def_bit_ub_563_CM 1 100. 0. 1. DISPLAY_IDENTIFIER B_NNLERN ECU_ADDRESS 0xc00008ac BIT_MASK 0x1 /end MEASUREMENT
/begin MEASUREMENT St_krann_1000ms "Statuswort KRANN, Bitgroessen im 1000ms-Raster" UBYTE _CNV_R_R_Def_dez_sl_551_CM 1 100. 0. 255. DISPLAY_IDENTIFIER ST_KRANN_1000MS ECU_ADDRESS 0xc0007a18 FORMAT "%3.0" /end MEASUREMENT
/begin MEASUREMENT St_krann_1000ms.B_kftkr "Bedingung fuer Kennfeldthermostat" UBYTE _CNV_S_2_Def_bit_ub_563_CM 1 100. 0. 1. DISPLAY_IDENTIFIER B_KFTKR ECU_ADDRESS 0xc0007a18 BIT_MASK 0x2 /end MEASUREMENT
/begin MEASUREMENT St_krann_seg "Statuswort KRANN, Bitgroessen im Segment-Raster" UBYTE _CNV_R_R_Def_dez_sl_551_CM 1 100. 0. 255. DISPLAY_IDENTIFIER ST_KRANN_SEG ECU_ADDRESS 0xd000d7ac FORMAT "%3.0" /end MEASUREMENT
/begin MEASUREMENT St_krann_seg.B_krakt_hs "Bedingung Klopfregelung Umschaltung in Homogen-Schicht" UBYTE _CNV_S_2_Def_bit_ub_563_CM 1 100. 0. 1. DISPLAY_IDENTIFIER B_KRAKT_HS ECU_ADDRESS 0xd000d7ac BIT_MASK 0x2 /end MEASUREMENT
/begin MEASUREMENT St_krann_seg.B_krein "Bedingung Klopfregelung" UBYTE _CNV_S_2_Def_bit_ub_563_CM 1 100. 0. 1. DISPLAY_IDENTIFIER B_KREIN ECU_ADDRESS 0xd000d7ac BIT_MASK 0x4 /end MEASUREMENT
/begin MEASUREMENT St_krann_seg.B_krzykl_verz "Bedingung Klopfregelung Zyklenverzoegerung bei Umschaltung der Betriebsart" UBYTE _CNV_S_2_Def_bit_ub_563_CM 1 100. 0. 1. DISPLAY_IDENTIFIER B_KRZYKL_VERZ ECU_ADDRESS 0xd000d7ac BIT_MASK 0x1 /end MEASUREMENT
/begin MEASUREMENT St_ksdiag "Status Kraftstoffsystem diagnose" UBYTE _CNV_R_R_Def_dez_sl_551_CM 1 100. 0. 255. DISPLAY_IDENTIFIER ST_KSDIAG ECU_ADDRESS 0xd000c97e FORMAT "%3.0" /end MEASUREMENT
/begin MEASUREMENT St_ksdiag.B_tstkvs "Bedingung Funktionsanforderung Kraftstoffsystemdiagnose" UBYTE _CNV_S_2_Def_bit_ub_563_CM 1 100. 0. 1. DISPLAY_IDENTIFIER B_TSTKVS ECU_ADDRESS 0xd000c97e BIT_MASK 0x1 /end MEASUREMENT
/begin MEASUREMENT St_kupp_dkg "Zustand der Anfahrkupplung" UBYTE _CNV_R_R_Def_dez_sl_551_CM 1 100. 0. 255. DISPLAY_IDENTIFIER ST_KUPP_DKG ECU_ADDRESS 0xd000c97f FORMAT "%3.0" /end MEASUREMENT
/begin MEASUREMENT St_kupp_smg "Status Kupplung SMG" UBYTE _CNV_R_R_Def_dez_sl_551_CM 1 100. 0. 255. DISPLAY_IDENTIFIER ST_KUPP_SMG ECU_ADDRESS 0xd000c980 FORMAT "%3.0" /end MEASUREMENT
/begin MEASUREMENT St_la_rpu "Statuswort für Bits aus NOX RP System" UBYTE _CNV_R_R_Def_dez_sl_551_CM 1 100. 0. 255. DISPLAY_IDENTIFIER ST_LA_RPU ECU_ADDRESS 0xd000c981 FORMAT "%3.0" /end MEASUREMENT
/begin MEASUREMENT St_la_rpu.B_largnrpu1 "Bedingung aus RP System zu Kat Regenerierung" UBYTE _CNV_S_2_Def_bit_ub_563_CM 1 100. 0. 1. DISPLAY_IDENTIFIER B_LARGNRPU1 ECU_ADDRESS 0xd000c981 BIT_MASK 0x1 /end MEASUREMENT
/begin MEASUREMENT St_la_rpu.B_largnrpu2 "Bedingung aus RP System zu Kat Regenerierung" UBYTE _CNV_S_2_Def_bit_ub_563_CM 1 100. 0. 1. DISPLAY_IDENTIFIER B_LARGNRPU2 ECU_ADDRESS 0xd000c981 BIT_MASK 0x2 /end MEASUREMENT
/begin MEASUREMENT St_la_rpu.B_noxrpu "Bedingung aus RP System zu Kat Regenerierung" UBYTE _CNV_S_2_Def_bit_ub_563_CM 1 100. 0. 1. DISPLAY_IDENTIFIER B_NOXRPU ECU_ADDRESS 0xd000c981 BIT_MASK 0x4 /end MEASUREMENT
/begin MEASUREMENT St_lam_ad_1 "Status Lambdaadaption Bank1" UBYTE _CNV_R_R_Def_dez_sl_551_CM 1 100. 0. 255. DISPLAY_IDENTIFIER ST_LAM_AD_1 ECU_ADDRESS 0xd000c982 FORMAT "%3.0" /end MEASUREMENT
/begin MEASUREMENT St_lam_ad_1.B_lrad_akt1 "Bedingung Lambdaadaption Bank1 aktiv" UBYTE _CNV_S_2_Def_bit_ub_563_CM 1 100. 0. 1. DISPLAY_IDENTIFIER B_LRAD_AKT1 ECU_ADDRESS 0xd000c982 BIT_MASK 0x20 /end MEASUREMENT
/begin MEASUREMENT St_lam_ad_2 "Status Lambdaadaption Bank2" UBYTE _CNV_R_R_Def_dez_sl_551_CM 1 100. 0. 255. DISPLAY_IDENTIFIER ST_LAM_AD_2 ECU_ADDRESS 0xd000c983 FORMAT "%3.0" /end MEASUREMENT
/begin MEASUREMENT St_lam_ad_2.B_lrad_akt2 "Bedingung Lambdaadaption Bank2 aktiv" UBYTE _CNV_S_2_Def_bit_ub_563_CM 1 100. 0. 1. DISPLAY_IDENTIFIER B_LRAD_AKT2 ECU_ADDRESS 0xd000c983 BIT_MASK 0x20 /end MEASUREMENT
/begin MEASUREMENT St_lamson "Statuswort Lambdasonden" UBYTE _CNV_R_R_Def_dez_sl_551_CM 1 100. 0. 255. DISPLAY_IDENTIFIER ST_LAMSON ECU_ADDRESS 0xc0000641 FORMAT "%3.0" /end MEASUREMENT
/begin MEASUREMENT St_lamson.B_lamson_ok1 "Lambdasonde VK Bank 1 bereit" UBYTE _CNV_S_2_Def_bit_ub_563_CM 1 100. 0. 1. DISPLAY_IDENTIFIER B_LAMSON_OK1 ECU_ADDRESS 0xc0000641 BIT_MASK 0x1 /end MEASUREMENT
/begin MEASUREMENT St_lamson.B_lamson_ok2 "Lambdasonde VK Bank 2 bereit" UBYTE _CNV_S_2_Def_bit_ub_563_CM 1 100. 0. 1. DISPLAY_IDENTIFIER B_LAMSON_OK2 ECU_ADDRESS 0xc0000641 BIT_MASK 0x2 /end MEASUREMENT
/begin MEASUREMENT St_lklps "Statusbyte Luftklappensteuerung" UBYTE _CNV_R_R_Def_dez_sl_551_CM 1 100. 0. 255. DISPLAY_IDENTIFIER ST_LKLPS ECU_ADDRESS 0xc0007474 FORMAT "%3.0" /end MEASUREMENT
/begin MEASUREMENT St_lklps.B_lklps_ln "Luftklappe gerlenrt" UBYTE _CNV_S_2_Def_bit_ub_563_CM 1 100. 0. 1. DISPLAY_IDENTIFIER B_LKLPS_LN ECU_ADDRESS 0xc0007474 BIT_MASK 0x2 /end MEASUREMENT
/begin MEASUREMENT St_lklps.B_lklps_ln1 "Luftklappe1 gerlernt" UBYTE _CNV_S_2_Def_bit_ub_563_CM 1 100. 0. 1. DISPLAY_IDENTIFIER B_LKLPS_LN1 ECU_ADDRESS 0xc0007474 BIT_MASK 0x4 /end MEASUREMENT
/begin MEASUREMENT St_ll "Status Leerlauf" UBYTE _CNV_R_R_Def_dez_sl_551_CM 1 100. 0. 255. DISPLAY_IDENTIFIER ST_LL ECU_ADDRESS 0xd000c984 FORMAT "%3.0" /end MEASUREMENT
/begin MEASUREMENT St_ll.B_llr_on "Llr darf aktiv werden" UBYTE _CNV_S_2_Def_bit_ub_563_CM 1 100. 0. 1. DISPLAY_IDENTIFIER B_LLR_ON ECU_ADDRESS 0xd000c984 BIT_MASK 0x1 /end MEASUREMENT
/begin MEASUREMENT St_mdaddon "vorübergehende additive Momenterhöhung des Bergrenzungsmomentes" UBYTE _CNV_R_R_Def_dez_sl_551_CM 1 100. 0. 255. DISPLAY_IDENTIFIER ST_MDADDON ECU_ADDRESS 0xd000cccd FORMAT "%3.0" /end MEASUREMENT
/begin MEASUREMENT St_mdaddon.B_mdao_all "Bedingung B_mdao_all == true, dann Erhöhung möglich (Bits 0-4 gesetzt)" UBYTE _CNV_S_2_Def_bit_ub_563_CM 1 100. 0. 1. DISPLAY_IDENTIFIER B_MDAO_ALL ECU_ADDRESS 0xd000cccd BIT_MASK 0x40 /end MEASUREMENT
/begin MEASUREMENT St_mdpruef "Status Momentenplausibilisierung" UBYTE _CNV_R_R_Def_dez_sl_551_CM 1 100. 0. 255. DISPLAY_IDENTIFIER ST_MDPRUEF ECU_ADDRESS 0xd000c985 FORMAT "%3.0" /end MEASUREMENT
/begin MEASUREMENT St_mdpruef.B_mdpruef "Momentenplausibilitätsprüfung forder hom" UBYTE _CNV_S_2_Def_bit_ub_563_CM 1 100. 0. 1. DISPLAY_IDENTIFIER B_MDPRUEF ECU_ADDRESS 0xd000c985 BIT_MASK 0x1 /end MEASUREMENT
/begin MEASUREMENT St_mdpruef.B_mdpruef_akt "Momentenplausibilitätsprüfung hom aktiv" UBYTE _CNV_S_2_Def_bit_ub_563_CM 1 100. 0. 1. DISPLAY_IDENTIFIER B_MDPRUEF_AKT ECU_ADDRESS 0xd000c985 BIT_MASK 0x2 /end MEASUREMENT
/begin MEASUREMENT St_mdssm "Statuswort mdssm" UBYTE _CNV_R_R_Def_dez_sl_551_CM 1 100. 0. 255. DISPLAY_IDENTIFIER ST_MDSSM ECU_ADDRESS 0xd000cc4f FORMAT "%3.0" /end MEASUREMENT
/begin MEASUREMENT St_mdssm.B_schalt_ldm "Anforderung Schalthinweis über CC-Meldung vom LDM" UBYTE _CNV_S_2_Def_bit_ub_563_CM 1 100. 0. 1. DISPLAY_IDENTIFIER B_SCHALT_LDM ECU_ADDRESS 0xd000cc4f BIT_MASK 0x1 /end MEASUREMENT
/begin MEASUREMENT St_minhubad "Statuswort MINHUBAD" UWORD _CNV_R_R_Def_dez_sl_551_CM 1 100. 0. 65535. DISPLAY_IDENTIFIER ST_MINHUBAD ECU_ADDRESS 0xc00006d6 FORMAT "%5.0" /end MEASUREMENT
/begin MEASUREMENT St_minhubad.B_minhubvs "Bedingung Minhubvorgabe durch Verstellsystem (Testereingriff)" UWORD _CNV_S_2_Def_bit_ub_563_CM 1 100. 0. 1. DISPLAY_IDENTIFIER B_MINHUBVS ECU_ADDRESS 0xc00006d6 BIT_MASK 0x2000 /end MEASUREMENT
/begin MEASUREMENT St_minhubad0 "" UBYTE _CNV_R_R_Def_dez_sl_551_CM 1 100. 0. 255. DISPLAY_IDENTIFIER ST_MINHUBAD0 ECU_ADDRESS 0xc00006d4 FORMAT "%3.0" /end MEASUREMENT
/begin MEASUREMENT St_minhubad0.B_dtes "Bedingung Diagnose TE aktiv" UBYTE _CNV_S_2_Def_bit_ub_563_CM 1 100. 0. 1. DISPLAY_IDENTIFIER B_DTES ECU_ADDRESS 0xc00006d4 BIT_MASK 0x1 /end MEASUREMENT
/begin MEASUREMENT St_minhubad0.B_mdarv "" UBYTE _CNV_S_2_Def_bit_ub_563_CM 1 100. 0. 1. DISPLAY_IDENTIFIER B_MDARV ECU_ADDRESS 0xc00006d4 BIT_MASK 0x20 /end MEASUREMENT
/begin MEASUREMENT St_minhubad2 "Statuswort MINHUBAD" UBYTE _CNV_R_R_Def_dez_sl_551_CM 1 100. 0. 255. DISPLAY_IDENTIFIER ST_MINHUBAD2 ECU_ADDRESS 0xc00006d8 FORMAT "%3.0" /end MEASUREMENT
/begin MEASUREMENT St_minhubad2.B_tdfba2 "Schalter zur Freigabe Minhubadaption in Abhängigkeit vom Bankabgleich" UBYTE _CNV_S_2_Def_bit_ub_563_CM 1 100. 0. 1. DISPLAY_IDENTIFIER B_TDFBA2 ECU_ADDRESS 0xc00006d8 BIT_MASK 0x8 /end MEASUREMENT
/begin MEASUREMENT St_mkwchn "Statuswort Masterkurbelwelle" UBYTE _CNV_R_R_Def_dez_sl_551_CM 1 100. 0. 255. DISPLAY_IDENTIFIER ST_MKWCHN ECU_ADDRESS 0xd000c986 FORMAT "%3.0" /end MEASUREMENT
/begin MEASUREMENT St_mkwchn.B_kwdreht "Bedingung drehende Kurbelwelle erkannt" UBYTE _CNV_S_2_Def_bit_ub_563_CM 1 100. 0. 1. DISPLAY_IDENTIFIER B_KWDREHT ECU_ADDRESS 0xd000c986 BIT_MASK 0x20 /end MEASUREMENT
/begin MEASUREMENT St_motzustd "Statusword fuer Motorzustand" UWORD _CNV_R_R_Def_dez_sl_551_CM 1 100. 0. 65535. DISPLAY_IDENTIFIER ST_MOTZUSTD ECU_ADDRESS 0xd000c988 FORMAT "%5.0" /end MEASUREMENT
/begin MEASUREMENT St_motzustd.B_ll_roh "Bedingung Leerlauf Rohwert" UWORD _CNV_S_2_Def_bit_ub_563_CM 1 100. 0. 1. DISPLAY_IDENTIFIER B_LL_ROH ECU_ADDRESS 0xd000c988 BIT_MASK 0x100 /end MEASUREMENT
/begin MEASUREMENT St_motzustd.B_vl "Bedingung Vollast" UWORD _CNV_S_2_Def_bit_ub_563_CM 1 100. 0. 1. DISPLAY_IDENTIFIER B_VL ECU_ADDRESS 0xd000c988 BIT_MASK 0x20 /end MEASUREMENT
/begin MEASUREMENT St_msaa "Statuswort" UBYTE _CNV_R_R_Def_dez_sl_551_CM 1 100. 0. 255. DISPLAY_IDENTIFIER ST_MSAA ECU_ADDRESS 0xd000cc52 FORMAT "%3.0" /end MEASUREMENT
/begin MEASUREMENT St_msaanz "Statuswort" UWORD _CNV_R_R_Def_dez_sl_551_CM 1 100. 0. 65535. DISPLAY_IDENTIFIER ST_MSAANZ ECU_ADDRESS 0xd000cc92 FORMAT "%5.0" /end MEASUREMENT
/begin MEASUREMENT St_msaanz.B_msanakt "Bedingung MSA nicht aktiv" UWORD _CNV_S_2_Def_bit_ub_563_CM 1 100. 0. 1. DISPLAY_IDENTIFIER B_MSANAKT ECU_ADDRESS 0xd000cc92 BIT_MASK 0x4 /end MEASUREMENT
/begin MEASUREMENT St_msabs "Statuswort" UBYTE _CNV_R_R_Def_dez_sl_551_CM 1 100. 0. 255. DISPLAY_IDENTIFIER ST_MSABS ECU_ADDRESS 0xd000cce8 FORMAT "%3.0" /end MEASUREMENT
/begin MEASUREMENT St_msabs.B_msastarts "Statuswort" UBYTE _CNV_S_2_Def_bit_ub_563_CM 1 100. 0. 1. DISPLAY_IDENTIFIER B_MSASTARTS ECU_ADDRESS 0xd000cce8 BIT_MASK 0x2 /end MEASUREMENT
/begin MEASUREMENT St_msabs.B_msastops "Statuswort" UBYTE _CNV_S_2_Def_bit_ub_563_CM 1 100. 0. 1. DISPLAY_IDENTIFIER B_MSASTOPS ECU_ADDRESS 0xd000cce8 BIT_MASK 0x4 /end MEASUREMENT
/begin MEASUREMENT St_msae "Statusword msae" UWORD _CNV_R_R_Def_dez_sl_551_CM 1 100. 0. 65535. DISPLAY_IDENTIFIER ST_MSAE ECU_ADDRESS 0xd000cc56 FORMAT "%5.0" /end MEASUREMENT
/begin MEASUREMENT St_msae.B_mhauf1 "Bedingung Motorhaube 1 offen" UWORD _CNV_S_2_Def_bit_ub_563_CM 1 100. 0. 1. DISPLAY_IDENTIFIER B_MHAUF1 ECU_ADDRESS 0xd000cc56 BIT_MASK 0x20 /end MEASUREMENT
/begin MEASUREMENT St_msae.B_msastopt "Statusword msae" UWORD _CNV_S_2_Def_bit_ub_563_CM 1 100. 0. 1. DISPLAY_IDENTIFIER B_MSASTOPT ECU_ADDRESS 0xd000cc56 BIT_MASK 0x10 /end MEASUREMENT
/begin MEASUREMENT St_nmax_ba "Statuswort CC Meldung durch Drehzahlbegrenzung aus MDBA" UBYTE _CNV_R_R_Def_dez_sl_551_CM 1 100. 0. 255. DISPLAY_IDENTIFIER ST_NMAX_BA ECU_ADDRESS 0xc00006bc FORMAT "%3.0" /end MEASUREMENT
/begin MEASUREMENT St_nmax_ba.B_nmax_ba_cc "Bedingung CC Meldung durch Drehzahlbegrenzung aus MDBA" UBYTE _CNV_S_2_Def_bit_ub_563_CM 1 100. 0. 1. DISPLAY_IDENTIFIER B_NMAX_BA_CC ECU_ADDRESS 0xc00006bc BIT_MASK 0x1 /end MEASUREMENT
/begin MEASUREMENT St_oz "Statuswort Eingangsgrößen Ölzustandssensor" UBYTE _CNV_R_R_Def_dez_sl_551_CM 1 100. 0. 255. DISPLAY_IDENTIFIER ST_OZ ECU_ADDRESS 0xc0000642 FORMAT "%3.0" /end MEASUREMENT
/begin MEASUREMENT St_oz.B_anhang "Bedingung Anhänger erkannt" UBYTE _CNV_S_2_Def_bit_ub_563_CM 1 100. 0. 1. DISPLAY_IDENTIFIER B_ANHANG ECU_ADDRESS 0xc0000642 BIT_MASK 0x1 /end MEASUREMENT
/begin MEASUREMENT St_oz.B_ozfbsd "Bedingung Fehler BSD-Kommunikation" UBYTE _CNV_S_2_Def_bit_ub_563_CM 1 100. 0. 1. DISPLAY_IDENTIFIER B_OZFBSD ECU_ADDRESS 0xc0000642 BIT_MASK 0x2 /end MEASUREMENT
/begin MEASUREMENT St_oz_i "Statusbyte für Eingang OZ" UBYTE _CNV_R_R_Def_dez_sl_551_CM 1 100. 0. 255. DISPLAY_IDENTIFIER ST_OZ_I ECU_ADDRESS 0xc0000643 FORMAT "%3.0" /end MEASUREMENT
/begin MEASUREMENT St_oz_i.B_td_og "Bedingung Abkühlzeit gültig" UBYTE _CNV_S_2_Def_bit_ub_563_CM 1 100. 0. 1. DISPLAY_IDENTIFIER B_TD_OG ECU_ADDRESS 0xc0000643 BIT_MASK 0x1 /end MEASUREMENT
/begin MEASUREMENT St_oz_i.B_td_ogok "Bedingung State-Machine 1x gültig gerechnet" UBYTE _CNV_S_2_Def_bit_ub_563_CM 1 100. 0. 1. DISPLAY_IDENTIFIER B_TD_OGOK ECU_ADDRESS 0xc0000643 BIT_MASK 0x10 /end MEASUREMENT
/begin MEASUREMENT St_oz_i.B_toel "Bedingung tr und tv gültig" UBYTE _CNV_S_2_Def_bit_ub_563_CM 1 100. 0. 1. DISPLAY_IDENTIFIER B_TOEL ECU_ADDRESS 0xc0000643 BIT_MASK 0x2 /end MEASUREMENT
/begin MEASUREMENT St_pmentl0 "Statuswort" UBYTE _CNV_R_R_Def_dez_sl_551_CM 1 100. 0. 255. DISPLAY_IDENTIFIER ST_PMENTL0 ECU_ADDRESS 0xd000ccd3 FORMAT "%3.0" /end MEASUREMENT
/begin MEASUREMENT St_pmentl0.B_ent4frei "--" UBYTE _CNV_S_2_Def_bit_ub_563_CM 1 100. 0. 1. DISPLAY_IDENTIFIER B_ENT4FREI ECU_ADDRESS 0xd000ccd3 BIT_MASK 0x1 /end MEASUREMENT
/begin MEASUREMENT St_pmentl0.B_pwrentl "Entlastung auf Prio aktiv" UBYTE _CNV_S_2_Def_bit_ub_563_CM 1 100. 0. 1. DISPLAY_IDENTIFIER B_PWRENTL ECU_ADDRESS 0xd000ccd3 BIT_MASK 0x2 /end MEASUREMENT
/begin MEASUREMENT St_pmi "Statuswort Eingänge LCP" UBYTE _CNV_R_R_Def_dez_sl_551_CM 1 100. 0. 255. DISPLAY_IDENTIFIER ST_PMI ECU_ADDRESS 0xc0004025 FORMAT "%3.0" /end MEASUREMENT
/begin MEASUREMENT St_pmi.B_fabttreg "Bedingung Batterietausch registrieren" UBYTE _CNV_S_2_Def_bit_ub_563_CM 1 100. 0. 1. DISPLAY_IDENTIFIER B_FABTTREG ECU_ADDRESS 0xc0004025 BIT_MASK 0x2 /end MEASUREMENT
/begin MEASUREMENT St_pmi.B_fahisrst "Bedingung Histogramm Reset" UBYTE _CNV_S_2_Def_bit_ub_563_CM 1 100. 0. 1. DISPLAY_IDENTIFIER B_FAHISRST ECU_ADDRESS 0xc0004025 BIT_MASK 0x4 /end MEASUREMENT
/begin MEASUREMENT St_pmi.B_pmrestore "Bedingung Daten zurückgeschrieben" UBYTE _CNV_S_2_Def_bit_ub_563_CM 1 100. 0. 1. DISPLAY_IDENTIFIER B_PMRESTORE ECU_ADDRESS 0xc0004025 BIT_MASK 0x8 /end MEASUREMENT
/begin MEASUREMENT St_pmi_nv "Statuswort Eingänge LCP non volatile" UBYTE _CNV_R_R_Def_dez_sl_551_CM 1 100. 0. 255. DISPLAY_IDENTIFIER ST_PMI_NV ECU_ADDRESS 0xc0004026 FORMAT "%3.0" /end MEASUREMENT
/begin MEASUREMENT St_pmi_nv.B_fapmmess "Bedingung Messmethode PM" UBYTE _CNV_S_2_Def_bit_ub_563_CM 1 100. 0. 1. DISPLAY_IDENTIFIER B_FAPMMESS ECU_ADDRESS 0xc0004026 BIT_MASK 0x1 /end MEASUREMENT
/begin MEASUREMENT St_pmi_nv.B_ulcp "ULCP Aktiv" UBYTE _CNV_S_2_Def_bit_ub_563_CM 1 100. 0. 1. DISPLAY_IDENTIFIER B_ULCP ECU_ADDRESS 0xc0004026 BIT_MASK 0x2 /end MEASUREMENT
/begin MEASUREMENT St_poel "Statusbyte" UBYTE _CNV_R_R_Def_dez_sl_551_CM 1 100. 0. 255. DISPLAY_IDENTIFIER ST_POEL ECU_ADDRESS 0xc0000644 FORMAT "%3.0" /end MEASUREMENT
/begin MEASUREMENT St_poel.B_poel "Bedingung Öldrucksschalter (ohne Unterdrückung)" UBYTE _CNV_S_2_Def_bit_ub_563_CM 1 100. 0. 1. DISPLAY_IDENTIFIER B_POEL ECU_ADDRESS 0xc0000644 BIT_MASK 0x1 /end MEASUREMENT
/begin MEASUREMENT St_pr "Statuswort für Bitgroessen Raildruck" UBYTE _CNV_R_R_Def_dez_sl_551_CM 1 100. 0. 255. DISPLAY_IDENTIFIER ST_PR ECU_ADDRESS 0xc00006e1 FORMAT "%3.0" /end MEASUREMENT
/begin MEASUREMENT St_pr.B_prsoll_h "Bedingung Raildruckkennfeld" UBYTE _CNV_S_2_Def_bit_ub_563_CM 1 100. 0. 1. DISPLAY_IDENTIFIER B_PRSOLL_H ECU_ADDRESS 0xc00006e1 BIT_MASK 0x1 /end MEASUREMENT
/begin MEASUREMENT St_pruef "Status Plausibilitätsprüfung" UBYTE _CNV_R_R_Def_dez_sl_551_CM 1 100. 0. 255. DISPLAY_IDENTIFIER ST_PRUEF ECU_ADDRESS 0xd000c98a FORMAT "%3.0" /end MEASUREMENT
/begin MEASUREMENT St_pruef.B_pruef1 "Lambdaanforderung for plausibility test bank1" UBYTE _CNV_S_2_Def_bit_ub_563_CM 1 100. 0. 1. DISPLAY_IDENTIFIER B_PRUEF1 ECU_ADDRESS 0xd000c98a BIT_MASK 0x1 /end MEASUREMENT
/begin MEASUREMENT St_pruef.B_pruef2 "Lambdaanforderung for plausibility test bank2" UBYTE _CNV_S_2_Def_bit_ub_563_CM 1 100. 0. 1. DISPLAY_IDENTIFIER B_PRUEF2 ECU_ADDRESS 0xd000c98a BIT_MASK 0x2 /end MEASUREMENT
/begin MEASUREMENT St_pwf "Statuswert fuer Power-fail" UBYTE _CNV_R_R_Def_dez_sl_551_CM 1 100. 0. 255. DISPLAY_IDENTIFIER ST_PWF ECU_ADDRESS 0xc0000645 FORMAT "%3.0" /end MEASUREMENT
/begin MEASUREMENT St_pwf.B_pwf "Bedingung Powerfail" UBYTE _CNV_S_2_Def_bit_ub_563_CM 1 100. 0. 1. DISPLAY_IDENTIFIER B_PWF ECU_ADDRESS 0xc0000645 BIT_MASK 0x1 /end MEASUREMENT
/begin MEASUREMENT St_sa "Status" UBYTE _CNV_R_R_Def_dez_sl_551_CM 1 100. 0. 255. DISPLAY_IDENTIFIER ST_SA ECU_ADDRESS 0xd000ccdd FORMAT "%3.0" /end MEASUREMENT
/begin MEASUREMENT St_sa.B_ums_vbsa "Bed. " UBYTE _CNV_S_2_Def_bit_ub_563_CM 1 100. 0. 1. DISPLAY_IDENTIFIER B_UMS_VBSA ECU_ADDRESS 0xd000ccdd BIT_MASK 0x1 /end MEASUREMENT
/begin MEASUREMENT St_sawe "Statusbyte Schubabschaltung/Wiedereinsetzen" UBYTE _CNV_R_R_Def_dez_sl_551_CM 1 100. 0. 255. DISPLAY_IDENTIFIER ST_SAWE ECU_ADDRESS 0xc0000646 FORMAT "%3.0" /end MEASUREMENT
/begin MEASUREMENT St_sawe.B_sa "Bedingung Schubabschaltung" UBYTE _CNV_S_2_Def_bit_ub_563_CM 1 100. 0. 1. DISPLAY_IDENTIFIER B_SA ECU_ADDRESS 0xc0000646 BIT_MASK 0x8 /end MEASUREMENT
/begin MEASUREMENT St_sawe.B_sae "Schubabschalten Bereitschaft" UBYTE _CNV_S_2_Def_bit_ub_563_CM 1 100. 0. 1. DISPLAY_IDENTIFIER B_SAE ECU_ADDRESS 0xc0000646 BIT_MASK 0x1 /end MEASUREMENT
/begin MEASUREMENT St_sawe.B_safast "Bedingung schnelles Schubabschalten" UBYTE _CNV_S_2_Def_bit_ub_563_CM 1 100. 0. 1. DISPLAY_IDENTIFIER B_SAFAST ECU_ADDRESS 0xc0000646 BIT_MASK 0x20 /end MEASUREMENT
/begin MEASUREMENT St_sk "Statuswort" UBYTE _CNV_R_R_Def_dez_sl_551_CM 1 100. 0. 255. DISPLAY_IDENTIFIER ST_SK ECU_ADDRESS 0xd000c98b FORMAT "%3.0" /end MEASUREMENT
/begin MEASUREMENT St_sk.B_sk_homla1 "Anforderung nach Homogen Lambda 1 aus Sicherheitskonzept" UBYTE _CNV_S_2_Def_bit_ub_563_CM 1 100. 0. 1. DISPLAY_IDENTIFIER B_SK_HOMLA1 ECU_ADDRESS 0xd000c98b BIT_MASK 0x1 /end MEASUREMENT
/begin MEASUREMENT St_slp "Statusbyte Sekundärluftpumpe" UBYTE _CNV_R_R_Def_dez_sl_551_CM 1 100. 0. 255. DISPLAY_IDENTIFIER ST_SLP ECU_ADDRESS 0xd000c98c FORMAT "%3.0" /end MEASUREMENT
/begin MEASUREMENT St_slp.B_fasls "Bed. Funktionsanf Sekundärluftsystem" UBYTE _CNV_S_2_Def_bit_ub_563_CM 1 100. 0. 1. DISPLAY_IDENTIFIER B_FASLS ECU_ADDRESS 0xd000c98c BIT_MASK 0x1 /end MEASUREMENT
/begin MEASUREMENT St_slp.B_genslp "Bedingung Spannungsanforderung Sekundärluftpumpe" UBYTE _CNV_S_2_Def_bit_ub_563_CM 1 100. 0. 1. DISPLAY_IDENTIFIER B_GENSLP ECU_ADDRESS 0xd000c98c BIT_MASK 0x4 /end MEASUREMENT
/begin MEASUREMENT St_sls "Statuswort Sekundärluftsystem" UBYTE _CNV_R_R_Def_dez_sl_551_CM 1 100. 0. 255. DISPLAY_IDENTIFIER ST_SLS ECU_ADDRESS 0xc0000647 FORMAT "%3.0" /end MEASUREMENT
/begin MEASUREMENT St_sls.B_sls "Bedingung Sekundärluftsystem aktiv" UBYTE _CNV_S_2_Def_bit_ub_563_CM 1 100. 0. 1. DISPLAY_IDENTIFIER B_SLS ECU_ADDRESS 0xc0000647 BIT_MASK 0x1 /end MEASUREMENT
/begin MEASUREMENT St_spa2 "Status SPA" UBYTE _CNV_R_R_Def_dez_sl_551_CM 1 100. 0. 255. DISPLAY_IDENTIFIER ST_SPA2 ECU_ADDRESS 0xc0004044 FORMAT "%3.0" /end MEASUREMENT
/begin MEASUREMENT St_spa2.B_gang_rueck "Status Rückwärtsgang" UBYTE _CNV_S_2_Def_bit_ub_563_CM 1 100. 0. 1. DISPLAY_IDENTIFIER B_GANG_RUECK ECU_ADDRESS 0xc0004044 BIT_MASK 0x4 /end MEASUREMENT
/begin MEASUREMENT St_spa2.B_spa_cist "Zurückgemeltdete Codierung SPA" UBYTE _CNV_S_2_Def_bit_ub_563_CM 1 100. 0. 1. DISPLAY_IDENTIFIER B_SPA_CIST ECU_ADDRESS 0xc0004044 BIT_MASK 0x2 /end MEASUREMENT
/begin MEASUREMENT St_spa2.B_spa_csoll "Codierung SPA aus Tester" UBYTE _CNV_S_2_Def_bit_ub_563_CM 1 100. 0. 1. DISPLAY_IDENTIFIER B_SPA_CSOLL ECU_ADDRESS 0xc0004044 BIT_MASK 0x1 /end MEASUREMENT
/begin MEASUREMENT St_start "Status Start" UBYTE _CNV_R_R_Def_dez_sl_551_CM 1 100. 0. 255. DISPLAY_IDENTIFIER ST_START ECU_ADDRESS 0xd000c98d FORMAT "%3.0" /end MEASUREMENT
/begin MEASUREMENT St_start.B_jumpstart "Bedingung Jumpstart" UBYTE _CNV_S_2_Def_bit_ub_563_CM 1 100. 0. 1. DISPLAY_IDENTIFIER B_JUMPSTART ECU_ADDRESS 0xd000c98d BIT_MASK 0x20 /end MEASUREMENT
/begin MEASUREMENT St_start.B_sta "Bedingung Automatikstart" UBYTE _CNV_S_2_Def_bit_ub_563_CM 1 100. 0. 1. DISPLAY_IDENTIFIER B_STA ECU_ADDRESS 0xd000c98d BIT_MASK 0x80 /end MEASUREMENT
/begin MEASUREMENT St_start.B_start "Bedingung Start" UBYTE _CNV_S_2_Def_bit_ub_563_CM 1 100. 0. 1. DISPLAY_IDENTIFIER B_START ECU_ADDRESS 0xd000c98d BIT_MASK 0x1 /end MEASUREMENT
/begin MEASUREMENT St_start.B_startende "Bedingung Startende" UBYTE _CNV_S_2_Def_bit_ub_563_CM 1 100. 0. 1. DISPLAY_IDENTIFIER B_STARTENDE ECU_ADDRESS 0xd000c98d BIT_MASK 0x8 /end MEASUREMENT
/begin MEASUREMENT St_start.B_wst "Bedingung Wiederholstart" UBYTE _CNV_S_2_Def_bit_ub_563_CM 1 100. 0. 1. DISPLAY_IDENTIFIER B_WST ECU_ADDRESS 0xd000c98d BIT_MASK 0x2 /end MEASUREMENT
/begin MEASUREMENT St_szboost "Eingang" UBYTE _CNV_R_R_Def_dez_sl_551_CM 1 100. 0. 255. DISPLAY_IDENTIFIER ST_SZBOOST ECU_ADDRESS 0xd000c98e FORMAT "%3.0" /end MEASUREMENT
/begin MEASUREMENT St_szboost.B_kath "Bedingung Katheizen aktiv" UBYTE _CNV_S_2_Def_bit_ub_563_CM 1 100. 0. 1. DISPLAY_IDENTIFIER B_KATH ECU_ADDRESS 0xd000c98e BIT_MASK 0x2 /end MEASUREMENT
/begin MEASUREMENT St_tan "Statuswort" UBYTE _CNV_R_R_Def_dez_sl_551_CM 1 100. 0. 255. DISPLAY_IDENTIFIER ST_TAN ECU_ADDRESS 0xd000ccd2 FORMAT "%3.0" /end MEASUREMENT
/begin MEASUREMENT St_tan.B_taners "Statuswort" UBYTE _CNV_S_2_Def_bit_ub_563_CM 1 100. 0. 1. DISPLAY_IDENTIFIER B_TANERS ECU_ADDRESS 0xd000ccd2 BIT_MASK 0x1 /end MEASUREMENT
/begin MEASUREMENT St_tank "Tank-Status" UBYTE _CNV_R_R_Def_dez_sl_551_CM 1 100. 0. 255. DISPLAY_IDENTIFIER ST_TANK ECU_ADDRESS 0xd000c98f FORMAT "%3.0" /end MEASUREMENT
/begin MEASUREMENT St_tank.B_taleer "Bedingung Tank leer" UBYTE _CNV_S_2_Def_bit_ub_563_CM 1 100. 0. 1. DISPLAY_IDENTIFIER B_TALEER ECU_ADDRESS 0xd000c98f BIT_MASK 0x1 /end MEASUREMENT
/begin MEASUREMENT St_tevanst "Status Tev" UBYTE _CNV_R_R_Def_dez_sl_551_CM 1 100. 0. 255. DISPLAY_IDENTIFIER ST_TEVANST ECU_ADDRESS 0xc0000648 FORMAT "%3.0" /end MEASUREMENT
/begin MEASUREMENT St_tevanst.B_tev_zu "Bedingung Tankentlüftungsventil geschlossen" UBYTE _CNV_S_2_Def_bit_ub_563_CM 1 100. 0. 1. DISPLAY_IDENTIFIER B_TEV_ZU ECU_ADDRESS 0xc0000648 BIT_MASK 0x2 /end MEASUREMENT
/begin MEASUREMENT St_tevein "Status Tev" UBYTE _CNV_R_R_Def_dez_sl_551_CM 1 100. 0. 255. DISPLAY_IDENTIFIER ST_TEVEIN ECU_ADDRESS 0xd000c990 FORMAT "%3.0" /end MEASUREMENT
/begin MEASUREMENT St_tevein.B_te "Bedingung Tankentlüftung freigegeben" UBYTE _CNV_S_2_Def_bit_ub_563_CM 1 100. 0. 1. DISPLAY_IDENTIFIER B_TE ECU_ADDRESS 0xd000c990 BIT_MASK 0x2 /end MEASUREMENT
/begin MEASUREMENT St_tevein.B_te_la1 "TEV fordert Lambda 1 an" UBYTE _CNV_S_2_Def_bit_ub_563_CM 1 100. 0. 1. DISPLAY_IDENTIFIER B_TE_LA1 ECU_ADDRESS 0xd000c990 BIT_MASK 0x1 /end MEASUREMENT
/begin MEASUREMENT St_tevein.B_teblg "Bedingung Beladungsgrad wird gelernt" UBYTE _CNV_S_2_Def_bit_ub_563_CM 1 100. 0. 1. DISPLAY_IDENTIFIER B_TEBLG ECU_ADDRESS 0xd000c990 BIT_MASK 0x80 /end MEASUREMENT
/begin MEASUREMENT St_tevein.B_tev_erf "Tankentlüftung angefordert" UBYTE _CNV_S_2_Def_bit_ub_563_CM 1 100. 0. 1. DISPLAY_IDENTIFIER B_TEV_ERF ECU_ADDRESS 0xd000c990 BIT_MASK 0x40 /end MEASUREMENT
/begin MEASUREMENT St_ti "Status Einspritzung" UBYTE _CNV_R_R_Def_dez_sl_551_CM 1 100. 0. 255. DISPLAY_IDENTIFIER ST_TI ECU_ADDRESS 0xd000c991 FORMAT "%3.0" /end MEASUREMENT
/begin MEASUREMENT St_ti.B_dosp_akt "Bedingung Doppeleinspritzung aktiv" UBYTE _CNV_S_2_Def_bit_ub_563_CM 1 100. 0. 1. DISPLAY_IDENTIFIER B_DOSP_AKT ECU_ADDRESS 0xd000c991 BIT_MASK 0x1 /end MEASUREMENT
/begin MEASUREMENT St_tp "Bedingung Taupunktende erreicht Lambdasonde vor Kat" UBYTE _CNV_R_R_Def_dez_sl_551_CM 1 100. 0. 255. DISPLAY_IDENTIFIER ST_TP ECU_ADDRESS 0xc0000649 FORMAT "%3.0" /end MEASUREMENT
/begin MEASUREMENT St_tp.B_atm_tpvk "Bedingung Taupunktende erreicht Lambdasonde vor Kat" UBYTE _CNV_S_2_Def_bit_ub_563_CM 1 100. 0. 1. DISPLAY_IDENTIFIER B_ATM_TPVK ECU_ADDRESS 0xc0000649 BIT_MASK 0x1 /end MEASUREMENT
/begin MEASUREMENT St_tp.B_atm_tpvk1 "Bedingung Taupunktende erreicht Lambdasonde vor Kat1" UBYTE _CNV_S_2_Def_bit_ub_563_CM 1 100. 0. 1. DISPLAY_IDENTIFIER B_ATM_TPVK1 ECU_ADDRESS 0xc0000649 BIT_MASK 0x2 /end MEASUREMENT
/begin MEASUREMENT St_tp.B_atm_tpvk2 "Bedingung Taupunktende erreicht Lambdasonde vor Kat2" UBYTE _CNV_S_2_Def_bit_ub_563_CM 1 100. 0. 1. DISPLAY_IDENTIFIER B_ATM_TPVK2 ECU_ADDRESS 0xc0000649 BIT_MASK 0x4 /end MEASUREMENT
/begin MEASUREMENT St_ttfuelcut "Statuswort für Bist" UBYTE _CNV_R_R_Def_dez_sl_551_CM 1 100. 0. 255. DISPLAY_IDENTIFIER ST_TTFUELCUT ECU_ADDRESS 0xd000ccac FORMAT "%3.0" /end MEASUREMENT
/begin MEASUREMENT St_ttfuelcut.B_ttfuelcut_akt "Sollmoment kleiner als minimales inneres Moment" UBYTE _CNV_S_2_Def_bit_ub_563_CM 1 100. 0. 1. DISPLAY_IDENTIFIER B_TTFUELCUT_AKT ECU_ADDRESS 0xd000ccac BIT_MASK 0x1 /end MEASUREMENT
/begin MEASUREMENT St_tum "Statusbyte tum" UBYTE _CNV_R_R_Def_dez_sl_551_CM 1 100. 0. 255. DISPLAY_IDENTIFIER ST_TUM ECU_ADDRESS 0xc000064a FORMAT "%3.0" /end MEASUREMENT
/begin MEASUREMENT St_tum.B_tumers "Bedingung Umgebungstemperaturersatzwert" UBYTE _CNV_S_2_Def_bit_ub_563_CM 1 100. 0. 1. DISPLAY_IDENTIFIER B_TUMERS ECU_ADDRESS 0xc000064a BIT_MASK 0x1 /end MEASUREMENT
/begin MEASUREMENT St_ubw "Statuswort" UBYTE _CNV_R_R_Def_dez_sl_551_CM 1 100. 0. 255. DISPLAY_IDENTIFIER ST_UBW ECU_ADDRESS 0xd000ccd0 FORMAT "%3.0" /end MEASUREMENT
/begin MEASUREMENT St_ubw.B_ubw_ulow "Bedingung Spannungswächter aktiv" UBYTE _CNV_S_2_Def_bit_ub_563_CM 1 100. 0. 1. DISPLAY_IDENTIFIER B_UBW_ULOW ECU_ADDRESS 0xd000ccd0 BIT_MASK 0x1 /end MEASUREMENT
/begin MEASUREMENT St_ugenkor0 "Statuswort" UBYTE _CNV_R_R_Def_dez_sl_551_CM 1 100. 0. 255. DISPLAY_IDENTIFIER ST_UGENKOR0 ECU_ADDRESS 0xd000ccd1 FORMAT "%3.0" /end MEASUREMENT
/begin MEASUREMENT St_ugenkor0.B_genoff "Bedingung Generator ausgeschaltet" UBYTE _CNV_S_2_Def_bit_ub_563_CM 1 100. 0. 1. DISPLAY_IDENTIFIER B_GENOFF ECU_ADDRESS 0xd000ccd1 BIT_MASK 0x8 /end MEASUREMENT
/begin MEASUREMENT St_ugenkor0.B_verb_off "Bedingung elektrische Verbraucher aus" UBYTE _CNV_S_2_Def_bit_ub_563_CM 1 100. 0. 1. DISPLAY_IDENTIFIER B_VERB_OFF ECU_ADDRESS 0xd000ccd1 BIT_MASK 0x80 /end MEASUREMENT
/begin MEASUREMENT St_ugenkor1 "Statuswort" UBYTE _CNV_R_R_Def_dez_sl_551_CM 1 100. 0. 255. DISPLAY_IDENTIFIER ST_UGENKOR1 ECU_ADDRESS 0xc00006b8 FORMAT "%3.0" /end MEASUREMENT
/begin MEASUREMENT St_ugenkor1.B_gentoggl "Statuswort" UBYTE _CNV_S_2_Def_bit_ub_563_CM 1 100. 0. 1. DISPLAY_IDENTIFIER B_GENTOGGL ECU_ADDRESS 0xc00006b8 BIT_MASK 0x1 /end MEASUREMENT
/begin MEASUREMENT St_varkat "Status Variante Abgasanlage (mono/stereo)" UBYTE _CNV_R_R_Def_dez_sl_551_CM 1 100. 0. 255. DISPLAY_IDENTIFIER ST_VARKAT ECU_ADDRESS 0xc00006dc FORMAT "%3.0" /end MEASUREMENT
/begin MEASUREMENT St_varkat.B_varkat "Bedingung Variante Abgasanlage (mono/stereo)" UBYTE _CNV_S_2_Def_bit_ub_563_CM 1 100. 0. 1. DISPLAY_IDENTIFIER B_VARKAT ECU_ADDRESS 0xc00006dc BIT_MASK 0x1 /end MEASUREMENT
/begin MEASUREMENT St_vbrzyl_aus "Statuswort Zylindergleichstellung" UWORD _CNV_R_R_Def_dez_sl_551_CM 1 100. 0. 65535. DISPLAY_IDENTIFIER ST_VBRZYL_AUS ECU_ADDRESS 0xc00006ba FORMAT "%5.0" /end MEASUREMENT
/begin MEASUREMENT St_vbrzyl_aus.B_ext_zylstop "Bedingung CILC und CYBL stoppen" UWORD _CNV_S_2_Def_bit_ub_563_CM 1 100. 0. 1. DISPLAY_IDENTIFIER B_EXT_ZYLSTOP ECU_ADDRESS 0xc00006ba BIT_MASK 0x2 /end MEASUREMENT
/begin MEASUREMENT St_vbrzyl_ein "Status Zylindergleichstellung" UWORD _CNV_R_R_Def_dez_sl_551_CM 1 100. 0. 65535. DISPLAY_IDENTIFIER ST_VBRZYL_EIN ECU_ADDRESS 0xd000c992 FORMAT "%5.0" /end MEASUREMENT
/begin MEASUREMENT St_vbrzyl_ein.B_lamzylact_1 "Bedingung CILC aktiv (Bank 1)" UWORD _CNV_S_2_Def_bit_ub_563_CM 1 100. 0. 1. DISPLAY_IDENTIFIER B_LAMZYLACT_1 ECU_ADDRESS 0xd000c992 BIT_MASK 0x2 /end MEASUREMENT
/begin MEASUREMENT St_vbrzyl_ein.B_lamzylact_2 "Bedingung CILC aktiv (Bank 2)" UWORD _CNV_S_2_Def_bit_ub_563_CM 1 100. 0. 1. DISPLAY_IDENTIFIER B_LAMZYLACT_2 ECU_ADDRESS 0xd000c992 BIT_MASK 0x4 /end MEASUREMENT
/begin MEASUREMENT St_vbrzyl_ein.B_lurzylact "Bedingung CYBL aktiv" UWORD _CNV_S_2_Def_bit_ub_563_CM 1 100. 0. 1. DISPLAY_IDENTIFIER B_LURZYLACT ECU_ADDRESS 0xd000c992 BIT_MASK 0x8 /end MEASUREMENT
/begin MEASUREMENT St_vrkoor_seg "Statuswort Vrkoor Segment" UBYTE _CNV_R_R_Def_dez_sl_551_CM 1 100. 0. 255. DISPLAY_IDENTIFIER ST_VRKOOR_SEG ECU_ADDRESS 0xd000cc3c FORMAT "%3.0" /end MEASUREMENT
/begin MEASUREMENT St_vrkoor_seg.B_vraus "Bedingung Verbrennungsregelung aus" UBYTE _CNV_S_2_Def_bit_ub_563_CM 1 100. 0. 1. DISPLAY_IDENTIFIER B_VRAUS ECU_ADDRESS 0xd000cc3c BIT_MASK 0x4 /end MEASUREMENT
/begin MEASUREMENT St_vrkoor_seg.B_vrkor "Bedingung Stochastikkorrektur erforderlich" UBYTE _CNV_S_2_Def_bit_ub_563_CM 1 100. 0. 1. DISPLAY_IDENTIFIER B_VRKOR ECU_ADDRESS 0xd000cc3c BIT_MASK 0x8 /end MEASUREMENT
/begin MEASUREMENT St_vsa3 "Status Anschlagadaption Auslass" UBYTE _CNV_R_R_Def_dez_sl_551_CM 1 100. 0. 255. DISPLAY_IDENTIFIER ST_VSA3 ECU_ADDRESS 0xc000064b FORMAT "%3.0" /end MEASUREMENT
/begin MEASUREMENT St_vvtlr "Statuswort VVTLR" UBYTE _CNV_R_R_Def_dez_sl_551_CM 1 100. 0. 255. DISPLAY_IDENTIFIER ST_VVTLR ECU_ADDRESS 0xd000ccad FORMAT "%3.0" /end MEASUREMENT
/begin MEASUREMENT St_vvtlr.B_vvtad "Bedingung VVT-Lageregler Anschlag lernen aktiv" UBYTE _CNV_S_2_Def_bit_ub_563_CM 1 100. 0. 1. DISPLAY_IDENTIFIER B_VVTAD ECU_ADDRESS 0xd000ccad BIT_MASK 0x10 /end MEASUREMENT
/begin MEASUREMENT St_wk "Status WK" UBYTE _CNV_R_R_Def_dez_sl_551_CM 1 100. 0. 255. DISPLAY_IDENTIFIER ST_WK ECU_ADDRESS 0xd000c994 FORMAT "%3.0" /end MEASUREMENT
/begin MEASUREMENT St_wm "Statusbyte fuer Eingang WM-Koordinator" UBYTE _CNV_R_R_Def_dez_sl_551_CM 1 100. 0. 255. DISPLAY_IDENTIFIER ST_WM ECU_ADDRESS 0xc000064c FORMAT "%3.0" /end MEASUREMENT
/begin MEASUREMENT St_wm.B_hz "Heizungsanforderung" UBYTE _CNV_S_2_Def_bit_ub_563_CM 1 100. 0. 1. DISPLAY_IDENTIFIER B_HZ ECU_ADDRESS 0xc000064c BIT_MASK 0x40 /end MEASUREMENT
/begin MEASUREMENT St_wm.B_korel "Bedingung Klimakompressor" UBYTE _CNV_S_2_Def_bit_ub_563_CM 1 100. 0. 1. DISPLAY_IDENTIFIER B_KOREL ECU_ADDRESS 0xc000064c BIT_MASK 0x8 /end MEASUREMENT
/begin MEASUREMENT St_wm.B_lklps_kl1 "Anforderung LKLPS auf von IHKA" UBYTE _CNV_S_2_Def_bit_ub_563_CM 1 100. 0. 1. DISPLAY_IDENTIFIER B_LKLPS_KL1 ECU_ADDRESS 0xc000064c BIT_MASK 0x4 /end MEASUREMENT
/begin MEASUREMENT St_wm.B_lklps_kl2 "Anforderung LKLPS ganz auf von IHKA" UBYTE _CNV_S_2_Def_bit_ub_563_CM 1 100. 0. 1. DISPLAY_IDENTIFIER B_LKLPS_KL2 ECU_ADDRESS 0xc000064c BIT_MASK 0x2 /end MEASUREMENT
/begin MEASUREMENT St_wm.B_nkmtemp "Bedingung niedrige Kühlmitteltemperatur (von IHKA)" UBYTE _CNV_S_2_Def_bit_ub_563_CM 1 100. 0. 1. DISPLAY_IDENTIFIER B_NKMTEMP ECU_ADDRESS 0xc000064c BIT_MASK 0x20 /end MEASUREMENT
/begin MEASUREMENT St_zwbts "Statuswort" UBYTE _CNV_R_R_Def_dez_sl_551_CM 1 100. 0. 255. DISPLAY_IDENTIFIER ST_ZWBTS ECU_ADDRESS 0xc000064d FORMAT "%3.0" /end MEASUREMENT
/begin MEASUREMENT St_zwbts.B_atm_tpnk1 "Bedingung Taupunktende erreicht Lambdasonde nach Kat1" UBYTE _CNV_S_2_Def_bit_ub_563_CM 1 100. 0. 1. DISPLAY_IDENTIFIER B_ATM_TPNK1 ECU_ADDRESS 0xc000064d BIT_MASK 0x8 /end MEASUREMENT
/begin MEASUREMENT St_zwbts.B_atm_tpnk2 "Bedingung Taupunktende erreicht Lambdasonde nach Kat2" UBYTE _CNV_S_2_Def_bit_ub_563_CM 1 100. 0. 1. DISPLAY_IDENTIFIER B_ATM_TPNK2 ECU_ADDRESS 0xc000064d BIT_MASK 0x20 /end MEASUREMENT
/begin MEASUREMENT St_zwbts.B_bsakt_zuli1 "Bedingung Bauteilschutz aktiv Zulieferer Bank 1" UBYTE _CNV_S_2_Def_bit_ub_563_CM 1 100. 0. 1. DISPLAY_IDENTIFIER B_BSAKT_ZULI1 ECU_ADDRESS 0xc000064d BIT_MASK 0x1 /end MEASUREMENT
/begin MEASUREMENT St_zwbts.B_bsakt_zuli2 "Bedingung Bauteilschutz aktiv Zulieferer Bank 2" UBYTE _CNV_S_2_Def_bit_ub_563_CM 1 100. 0. 1. DISPLAY_IDENTIFIER B_BSAKT_ZULI2 ECU_ADDRESS 0xc000064d BIT_MASK 0x2 /end MEASUREMENT
/begin MEASUREMENT St_zwgemad "Statuswort für Bits" UBYTE _CNV_R_R_Def_dez_sl_551_CM 1 100. 0. 255. DISPLAY_IDENTIFIER ST_ZWGEMAD ECU_ADDRESS 0xc000064e FORMAT "%3.0" /end MEASUREMENT
/begin MEASUREMENT St_zwgemad.B_zwgemad_1 "Zwangsgemischadaption Bank 1" UBYTE _CNV_S_2_Def_bit_ub_563_CM 1 100. 0. 1. DISPLAY_IDENTIFIER B_ZWGEMAD_1 ECU_ADDRESS 0xc000064e BIT_MASK 0x1 /end MEASUREMENT
/begin MEASUREMENT St_zwgemad.B_zwgemad_2 "Zwangsgemischadaption Bank 2" UBYTE _CNV_S_2_Def_bit_ub_563_CM 1 100. 0. 1. DISPLAY_IDENTIFIER B_ZWGEMAD_2 ECU_ADDRESS 0xc000064e BIT_MASK 0x2 /end MEASUREMENT
/begin MEASUREMENT St_zwktibs "Statusbyte zwktibs" UBYTE _CNV_R_R_Def_dez_sl_551_CM 1 100. 0. 255. DISPLAY_IDENTIFIER ST_ZWKTIBS ECU_ADDRESS 0xc0007475 FORMAT "%3.0" /end MEASUREMENT
/begin MEASUREMENT St_zwktibs.B_ibsactiv "Bedingung Kommunikation IBS vorhanden" UBYTE _CNV_S_2_Def_bit_ub_563_CM 1 100. 0. 1. DISPLAY_IDENTIFIER B_IBSACTIV ECU_ADDRESS 0xc0007475 BIT_MASK 0x1 /end MEASUREMENT
/begin MEASUREMENT St_zylab "Bedingung Einzelzylinderabschaltung Bank i" UBYTE _CNV_R_R_Def_dez_sl_551_CM 1 100. 0. 255. DISPLAY_IDENTIFIER ST_ZYLAB ECU_ADDRESS 0xd000c995 FORMAT "%3.0" /end MEASUREMENT
/begin MEASUREMENT St_zylab.B_zylab1 "Bedingung Einzelzylinderabschaltung Bank 1" UBYTE _CNV_S_2_Def_bit_ub_563_CM 1 100. 0. 1. DISPLAY_IDENTIFIER B_ZYLAB1 ECU_ADDRESS 0xd000c995 BIT_MASK 0x1 /end MEASUREMENT
/begin MEASUREMENT St_zylab.B_zylab2 "Bedingung Einzelzylinderabschaltung Bank 2" UBYTE _CNV_S_2_Def_bit_ub_563_CM 1 100. 0. 1. DISPLAY_IDENTIFIER B_ZYLAB2 ECU_ADDRESS 0xd000c995 BIT_MASK 0x2 /end MEASUREMENT
/begin MEASUREMENT Status_kwnot "Status KW Notlauf" UBYTE _CNV_R_R_Def_dez_sl_551_CM 1 100. 0. 255. DISPLAY_IDENTIFIER STATUS_KWNOT ECU_ADDRESS 0xd000c996 FORMAT "%3.0" /end MEASUREMENT
/begin MEASUREMENT Status_kwnot.B_kwnotl "Bedingung Drehzahlgebernotlauf" UBYTE _CNV_S_2_Def_bit_ub_563_CM 1 100. 0. 1. DISPLAY_IDENTIFIER B_KWNOTL ECU_ADDRESS 0xd000c996 BIT_MASK 0x80 /end MEASUREMENT
/begin MEASUREMENT Status_tev "Status der Tankentlüftungsfunktion von Zulieferer" UBYTE _CNV_R_R_Def_dez_sl_551_CM 1 100. 0. 255. DISPLAY_IDENTIFIER STATUS_TEV ECU_ADDRESS 0xd000c997 FORMAT "%3.0" /end MEASUREMENT
/begin MEASUREMENT T_jahr "Borddatum" UWORD _CNV_R_R_Def_dez_sl_551_CM 1 100. 0. 65535. DISPLAY_IDENTIFIER T_JAHR ECU_ADDRESS 0xc0000650 FORMAT "%5.0" /end MEASUREMENT
/begin MEASUREMENT T_monate "Borddatum" UBYTE _CNV_R_R_Def_dez_sl_551_CM 1 100. 0. 255. DISPLAY_IDENTIFIER T_MONATE ECU_ADDRESS 0xc0000652 FORMAT "%3.0" /end MEASUREMENT
/begin MEASUREMENT T_tag "Borddatum" UBYTE _CNV_R_R_Def_dez_sl_551_CM 1 100. 0. 255. DISPLAY_IDENTIFIER T_TAG ECU_ADDRESS 0xc0007476 FORMAT "%3.0" /end MEASUREMENT
/begin MEASUREMENT Tabg_sens1 "Signal Temperatursensor" SWORD _CNV_R_R_Def_t_sw_q_578_CM 1 100. -3276.8 3276.7 DISPLAY_IDENTIFIER TABG_SENS1 ECU_ADDRESS 0xc0000654 FORMAT "%6.1" /end MEASUREMENT
/begin MEASUREMENT Tabg_sens2 "Signal Temperatursensor" SWORD _CNV_R_R_Def_t_sw_q_578_CM 1 100. -3276.8 3276.7 DISPLAY_IDENTIFIER TABG_SENS2 ECU_ADDRESS 0xc0000656 FORMAT "%6.1" /end MEASUREMENT
/begin MEASUREMENT Tabg_sensturb1 "Abgastemperatursensor Bank1" SWORD _CNV_R_R_Def_t_sw_q_578_CM 1 100. -3276.8 3276.7 DISPLAY_IDENTIFIER TABG_SENSTURB1 ECU_ADDRESS 0xc0007478 FORMAT "%6.1" /end MEASUREMENT
/begin MEASUREMENT Tabg_sensturb2 "Abgastemperatursensor Bank2" SWORD _CNV_R_R_Def_t_sw_q_578_CM 1 100. -3276.8 3276.7 DISPLAY_IDENTIFIER TABG_SENSTURB2 ECU_ADDRESS 0xc000747a FORMAT "%6.1" /end MEASUREMENT
/begin MEASUREMENT Tans "Ansauglufttemperatur Mittelwert" SWORD _CNV_R_R_Def_t_sw_q_578_CM 1 100. -3276.8 3276.7 DISPLAY_IDENTIFIER TANS ECU_ADDRESS 0xd000c998 FORMAT "%6.1" /end MEASUREMENT
/begin MEASUREMENT Tans_i "Ansauglufttemperatur beider Sensoren" SWORD _CNV_R_R_Def_t_sw_q_578_CM 1 100. -3276.8 3276.7 DISPLAY_IDENTIFIER TANS_I ECU_ADDRESS 0xc0000658 FORMAT "%6.1" ARRAY_SIZE 2 MATRIX_DIM 2 1 1 /end MEASUREMENT
/begin MEASUREMENT Tchip "Chiptemperatur Generator1" SWORD _CNV_R_R_Def_t_sw_q_578_CM 1 100. -3276.8 3276.7 DISPLAY_IDENTIFIER TCHIP ECU_ADDRESS 0xc000065c FORMAT "%6.1" /end MEASUREMENT
/begin MEASUREMENT Td_f_ierr "Filterzeit Erregerstrom aus BSD-Timingkoordinator" UBYTE _CNV_R_R_Def_td_uw__673_CM 1 100. 0. 2.55 DISPLAY_IDENTIFIER TD_F_IERR ECU_ADDRESS 0xc000747c FORMAT "%5.2" /end MEASUREMENT
/begin MEASUREMENT Td_og_cnt "Zähler für fallende Flanken im Töns Signal" UBYTE _CNV_R_R_Def_dez_sl_551_CM 1 100. 0. 255. DISPLAY_IDENTIFIER TD_OG_CNT ECU_ADDRESS 0xc000065e FORMAT "%3.0" /end MEASUREMENT
/begin MEASUREMENT Td_og_icnt "Zeit zwischen 2 fallenden Flanken" UWORD _CNV_R_R_Def_td_uw__673_CM 1 100. 0. 655.35 DISPLAY_IDENTIFIER TD_OG_ICNT ECU_ADDRESS 0xc0000660 FORMAT "%7.2" /end MEASUREMENT
/begin MEASUREMENT Td_og_tk "Abkühlzeit vom TÖNS" UWORD _CNV_R_R_Def_td_ub__574_CM 1 100. 0. 6553.5 DISPLAY_IDENTIFIER TD_OG_TK ECU_ADDRESS 0xc0000662 FORMAT "%6.1" /end MEASUREMENT
/begin MEASUREMENT Td_og_tr "Referntzeit" UWORD _CNV_R_R_Def_td_ub__574_CM 1 100. 0. 6553.5 DISPLAY_IDENTIFIER TD_OG_TR ECU_ADDRESS 0xc0000664 FORMAT "%6.1" /end MEASUREMENT
/begin MEASUREMENT Td_og_tv "Abkühlzeit Vom TÖNS" UWORD _CNV_R_R_Def_td_ub__574_CM 1 100. 0. 6553.5 DISPLAY_IDENTIFIER TD_OG_TV ECU_ADDRESS 0xc0000666 FORMAT "%6.1" /end MEASUREMENT
/begin MEASUREMENT Td_og_uplcnt "Zähler für unplausible Signale" UBYTE _CNV_R_R_Def_dez_sl_551_CM 1 100. 0. 255. DISPLAY_IDENTIFIER TD_OG_UPLCNT ECU_ADDRESS 0xc0000668 FORMAT "%3.0" /end MEASUREMENT
/begin MEASUREMENT Td_rdgenreg2 "Auslesezeit für DF-Signal und Diagnose" UBYTE _CNV_R_R_Def_td_ub__574_CM 1 100. 0. 25.5 DISPLAY_IDENTIFIER TD_RDGENREG2 ECU_ADDRESS 0xc000747d FORMAT "%4.1" /end MEASUREMENT
/begin MEASUREMENT Tget "Getriebetemperatur" SWORD _CNV_R_R_Def_t_sw_q_579_CM 1 100. -327.68 327.67 DISPLAY_IDENTIFIER TGET ECU_ADDRESS 0xc000066a FORMAT "%7.2" /end MEASUREMENT
/begin MEASUREMENT Ti_1_homext "effektive Einspritzzeit Bank 1" UWORD _CNV_R_R_Def_ti_uw__714_CM 1 100. 0. 838.848 DISPLAY_IDENTIFIER TI_1_HOMEXT ECU_ADDRESS 0xd000c99a FORMAT "%8.3" /end MEASUREMENT
/begin MEASUREMENT Ti_2_homext "effektive Einspritzzeit Bank 2" UWORD _CNV_R_R_Def_ti_uw__714_CM 1 100. 0. 838.848 DISPLAY_IDENTIFIER TI_2_HOMEXT ECU_ADDRESS 0xd000c99c FORMAT "%8.3" /end MEASUREMENT
/begin MEASUREMENT Tka "Temperatur Kühlwasser Kühleraustritt" SWORD _CNV_R_R_Def_t_sw_q_579_CM 1 100. -327.68 327.67 DISPLAY_IDENTIFIER TKA ECU_ADDRESS 0xc000066c FORMAT "%7.2" /end MEASUREMENT
/begin MEASUREMENT Tkat_mod "Modellierte Katalysatortemperatur" SWORD _CNV_R_R_Def_t_sw_q_578_CM 1 100. -3276.8 3276.7 DISPLAY_IDENTIFIER TKAT_MOD ECU_ADDRESS 0xc000066e FORMAT "%6.1" /end MEASUREMENT
/begin MEASUREMENT Tlrfgen "Kopier Generator1 LR Vorgabe auf Bus gelegt" UBYTE _CNV_R_R_Def_td_ub__574_CM 1 100. 0. 25.5 DISPLAY_IDENTIFIER TLRFGEN ECU_ADDRESS 0xc0000670 FORMAT "%4.1" /end MEASUREMENT
/begin MEASUREMENT Tlrgen_ext "Loadresponse vom Tester" UBYTE _CNV_R_R_Def_td_ub__574_CM 1 100. 0. 25.5 DISPLAY_IDENTIFIER TLRGEN_EXT ECU_ADDRESS 0xc0000671 FORMAT "%4.1" /end MEASUREMENT
/begin MEASUREMENT Tmot "Kühlwassertemperatur" SWORD _CNV_R_R_Def_t_sw_q_579_CM 1 100. -327.68 327.67 DISPLAY_IDENTIFIER TMOT ECU_ADDRESS 0xd000c99e FORMAT "%7.2" /end MEASUREMENT
/begin MEASUREMENT Tmot_abstell "Motorabstelltemperatur" SWORD _CNV_R_R_Def_t_sw_q_579_CM 1 100. -327.68 327.67 DISPLAY_IDENTIFIER TMOT_ABSTELL ECU_ADDRESS 0xc0004028 FORMAT "%7.2" /end MEASUREMENT
/begin MEASUREMENT Tmot_start "Motorstarttemperatur" SWORD _CNV_R_R_Def_t_sw_q_579_CM 1 100. -327.68 327.67 DISPLAY_IDENTIFIER TMOT_START ECU_ADDRESS 0xd000c9a0 FORMAT "%7.2" /end MEASUREMENT
/begin MEASUREMENT Tn_abstell "Abstellzeit" UWORD _CNV_R_R_Def_dez_sl_551_CM 1 100. 0. 65535. DISPLAY_IDENTIFIER TN_ABSTELL ECU_ADDRESS 0xd000c9a2 FORMAT "%5.0" /end MEASUREMENT
/begin MEASUREMENT Tn_abstellm "Abstellzeit in Minuten" UWORD _CNV_R_R_Def_tn_uw__664_CM 1 100. 0. 65535. DISPLAY_IDENTIFIER TN_ABSTELLM ECU_ADDRESS 0xc000402a FORMAT "%7.2" /end MEASUREMENT
/begin MEASUREMENT Tn_start_10 "Zeit nach Startende in 10ms aufgelöst" UWORD _CNV_R_R_Def_td_uw__673_CM 1 100. 0. 655.35 DISPLAY_IDENTIFIER TN_START_10 ECU_ADDRESS 0xd000c9a4 FORMAT "%7.2" /end MEASUREMENT
/begin MEASUREMENT Toel_getr "Getriebeöltemperatur" SWORD _CNV_R_R_Def_t_sw_q_579_CM 1 100. -327.68 327.67 DISPLAY_IDENTIFIER TOEL_GETR ECU_ADDRESS 0xc000747e FORMAT "%7.2" /end MEASUREMENT
/begin MEASUREMENT Toel_mdl "Modelltemperatur Motoröl" SWORD _CNV_R_R_Def_t_sw_q_578_CM 1 100. -3276.8 3276.7 DISPLAY_IDENTIFIER TOEL_MDL ECU_ADDRESS 0xc0000672 FORMAT "%6.1" /end MEASUREMENT
/begin MEASUREMENT Tsg "Temperatur Steuergerät" SWORD _CNV_R_R_Def_t_sw_q_579_CM 1 100. -327.68 327.67 DISPLAY_IDENTIFIER TSG ECU_ADDRESS 0xc0000674 FORMAT "%7.2" /end MEASUREMENT
/begin MEASUREMENT Tumg "Umgebungstemperatur" SWORD _CNV_R_R_Def_t_sw_q_578_CM 1 100. -3276.8 3276.7 DISPLAY_IDENTIFIER TUMG ECU_ADDRESS 0xc0000676 FORMAT "%6.1" /end MEASUREMENT
/begin MEASUREMENT Tumg_can "Umgebungstemperatur" SWORD _CNV_R_R_Def_t_sw_q_578_CM 1 100. -3276.8 3276.7 DISPLAY_IDENTIFIER TUMG_CAN ECU_ADDRESS 0xc0000678 FORMAT "%6.1" /end MEASUREMENT
/begin MEASUREMENT Tvld "Temperatur vor Verdichter Mittelwert" SWORD _CNV_R_R_Def_t_sw_q_578_CM 1 100. -3276.8 3276.7 DISPLAY_IDENTIFIER TVLD ECU_ADDRESS 0xd000c9a6 FORMAT "%6.1" /end MEASUREMENT
/begin MEASUREMENT Tvld_i "Temperatur vor Verdichter" SWORD _CNV_R_R_Def_t_sw_q_578_CM 1 100. -3276.8 3276.7 DISPLAY_IDENTIFIER TVLD_I ECU_ADDRESS 0xc000067a FORMAT "%6.1" ARRAY_SIZE 2 MATRIX_DIM 2 1 1 /end MEASUREMENT
/begin MEASUREMENT Tvulv2 "Tastverhaeltnis - Umluftventilansteuerung Bank 2" UWORD _CNV_R_R_Def_f_uw_b_555_CM 1 100. 0. 99.9984 DISPLAY_IDENTIFIER TVULV2 ECU_ADDRESS 0xd000ccce FORMAT "%8.3" /end MEASUREMENT
/begin MEASUREMENT U_fgen "Kopierter Wert von zum Generator gesendete Sollspannung Generator 1" UWORD _CNV_R_R_Def_u_ub_q_631_CM 1 100. 0. 6553.5 DISPLAY_IDENTIFIER U_FGEN ECU_ADDRESS 0xc000067e FORMAT "%8.3" /end MEASUREMENT
/begin MEASUREMENT U_gen2 "Physikalischer Wert Generatorsollspannung für Generator" UWORD _CNV_R_R_Def_u_ub_q_631_CM 1 100. 0. 6553.5 DISPLAY_IDENTIFIER U_GEN2 ECU_ADDRESS 0xc00006da FORMAT "%8.3" /end MEASUREMENT
/begin MEASUREMENT U_gen_ext "Physikalischer Wert Generatorsollspannung für Generator vom Tester" UWORD _CNV_R_R_Def_u_ub_q_631_CM 1 100. 0. 6553.5 DISPLAY_IDENTIFIER U_GEN_EXT ECU_ADDRESS 0xc0000680 FORMAT "%8.3" /end MEASUREMENT
/begin MEASUREMENT U_gensollpm "Sollwert Spannung vom Powermodul" SWORD _CNV_R_R_Def_u_sw_b_581_CM 1 100. -128. 127.996 DISPLAY_IDENTIFIER U_GENSOLLPM ECU_ADDRESS 0xc0000682 FORMAT "%8.3" /end MEASUREMENT
/begin MEASUREMENT Ub "Bordnetzspannung" UWORD _CNV_R_R_Def_u_sb_q_583_CM 1 100. 0. 6173.397 DISPLAY_IDENTIFIER UB ECU_ADDRESS 0xd000c9a8 FORMAT "%6.1" /end MEASUREMENT
/begin MEASUREMENT Ulams_1 "Lambda-Spannungsistwert mit Offsetkorrektur (kontinuierlich)" UWORD _CNV_R_R_Def_u_sw_q_580_CM 1 100. 0. 9.995100000000001 DISPLAY_IDENTIFIER ULAMS_1 ECU_ADDRESS 0xd000c9aa FORMAT "%8.3" /end MEASUREMENT
/begin MEASUREMENT Ulams_2 "Lambda-Spannungsistwert mit Offsetkorrektur (kontinuierlich)" UWORD _CNV_R_R_Def_u_sw_q_580_CM 1 100. 0. 9.995100000000001 DISPLAY_IDENTIFIER ULAMS_2 ECU_ADDRESS 0xd000c9ac FORMAT "%8.3" /end MEASUREMENT
/begin MEASUREMENT Uregnom "Nominalspannung Regler Generator 1" UWORD _CNV_R_R_Def_u_ub_q_631_CM 1 100. 0. 6553.5 DISPLAY_IDENTIFIER UREGNOM ECU_ADDRESS 0xc0007480 FORMAT "%8.3" /end MEASUREMENT
/begin MEASUREMENT V "Fahrzeuggeschwindigkeit" UWORD _CNV_R_R_Def_v_uw_q_726_CM 1 100. 0. 360. ECU_ADDRESS 0xd000c9ae FORMAT "%5.0" /end MEASUREMENT
/begin MEASUREMENT V_can "Fahrzeuggeschwindigkeit vom DSC" UWORD _CNV_R_R_Def_v_uw_q_727_CM 1 100. 0. 6553.5 DISPLAY_IDENTIFIER V_CAN ECU_ADDRESS 0xd000c9b0 FORMAT "%7.2" /end MEASUREMENT
/begin MEASUREMENT V_krapu "Gewünschte Fördermeng e der Kraftstoffpu mpe in l/h" UBYTE _CNV_R_R_Def_dez_sl_551_CM 1 100. 0. 255. DISPLAY_IDENTIFIER V_KRAPU ECU_ADDRESS 0xd000c9b2 FORMAT "%3.0" /end MEASUREMENT
/begin MEASUREMENT Var_atm "ATMPH-Konfigurationsvariable" UBYTE _CNV_R_R_Def_dez_sl_551_CM 1 100. 0. 255. DISPLAY_IDENTIFIER VAR_ATM ECU_ADDRESS 0xc0007488 FORMAT "%3.0" /end MEASUREMENT
/begin MEASUREMENT Verbstatus "Verbraucherstatus" UBYTE _CNV_R_R_Def_dez_sl_551_CM 1 100. 0. 255. DISPLAY_IDENTIFIER VERBSTATUS ECU_ADDRESS 0xc0000684 FORMAT "%3.0" ARRAY_SIZE 10 MATRIX_DIM 10 1 1 /end MEASUREMENT
/begin MEASUREMENT Vsa2_adp_ext "Adaptionswert Anschlag Auslassspreizung variable NWS von extern Bank 2" UWORD _CNV_R_R_Def_spr_sw_561_CM 1 100. 0. 6553.5 DISPLAY_IDENTIFIER VSA2_ADP_EXT ECU_ADDRESS 0xd000c9b4 FORMAT "%7.2" /end MEASUREMENT
/begin MEASUREMENT Vsa_adp_ext "Adaptionswert Anschlag Auslassspreizung variable NWS von extern" UWORD _CNV_R_R_Def_spr_sw_561_CM 1 100. 0. 6553.5 DISPLAY_IDENTIFIER VSA_ADP_EXT ECU_ADDRESS 0xd000c9b6 FORMAT "%7.2" /end MEASUREMENT
/begin MEASUREMENT Vsa_btsoll "Spreizungsvorgabe Tester für AVANOS" UWORD _CNV_R_R_Def_kw_uw__734_CM 1 100. -128. 52300. DISPLAY_IDENTIFIER VSA_BTSOLL ECU_ADDRESS 0xd000c9b8 FORMAT "%5.0" /end MEASUREMENT
/begin MEASUREMENT Vsa_sprs_kh "Exhaust camshaft setpoint (outlet)" UWORD _CNV_R_R_Def_spr_sw_561_CM 1 100. 0. 6553.5 DISPLAY_IDENTIFIER VSA_SPRS_KH ECU_ADDRESS 0xd000c9ba FORMAT "%7.2" /end MEASUREMENT
/begin MEASUREMENT Vse2_adp_ext "Adaptionswert Anschlag Einlassspreizung variable NWS von extern Bank 2" UWORD _CNV_R_R_Def_spr_sw_561_CM 1 100. 0. 6553.5 DISPLAY_IDENTIFIER VSE2_ADP_EXT ECU_ADDRESS 0xd000c9bc FORMAT "%7.2" /end MEASUREMENT
/begin MEASUREMENT Vse_adp_ext "Adaptionswert Anschlag Einlassspreizung variable NWS von extern" UWORD _CNV_R_R_Def_spr_sw_561_CM 1 100. 0. 6553.5 DISPLAY_IDENTIFIER VSE_ADP_EXT ECU_ADDRESS 0xd000c9be FORMAT "%7.2" /end MEASUREMENT
/begin MEASUREMENT Vse_btsoll "Spreizungsvorgabe Tester für EVANOS" UWORD _CNV_R_R_Def_kw_uw__734_CM 1 100. -128. 52300. DISPLAY_IDENTIFIER VSE_BTSOLL ECU_ADDRESS 0xd000c9c0 FORMAT "%5.0" /end MEASUREMENT
/begin MEASUREMENT Vse_sprs_kh "Intake camshaft setpoint (inlet)" UWORD _CNV_R_R_Def_spr_sw_561_CM 1 100. 0. 6553.5 DISPLAY_IDENTIFIER VSE_SPRS_KH ECU_ADDRESS 0xd000c9c2 FORMAT "%7.2" /end MEASUREMENT
/begin MEASUREMENT Vvtaet "Exzenterwinkelvorgabe vom Tester" UBYTE _CNV_R_R_Def_exwink_736_CM 1 100. 0. 179.2968 DISPLAY_IDENTIFIER VVTAET ECU_ADDRESS 0xd000ccda FORMAT "%5.2" /end MEASUREMENT
/begin MEASUREMENT W_afs "Lenkradwinkel" SWORD _CNV_R_R_Def_f_sw_q_560_CM 1 100. -3276.8 3276.7 DISPLAY_IDENTIFIER W_AFS ECU_ADDRESS 0xc0007482 FORMAT "%7.2" /end MEASUREMENT
/begin MEASUREMENT W_dafs "Lenkwinkelgradient" SWORD _CNV_R_R_Def_f_sw_q_560_CM 1 100. -3276.8 3276.7 DISPLAY_IDENTIFIER W_DAFS ECU_ADDRESS 0xc0007484 FORMAT "%7.2" /end MEASUREMENT
/begin MEASUREMENT W_ub "Ungefilterte Bordnetzspannung [0 .. 24,021 V]" UBYTE _CNV_R_R_Def_u_sb_q_583_CM 1 100. 0. 24.021 DISPLAY_IDENTIFIER W_UB ECU_ADDRESS 0xc000068e FORMAT "%7.4" /end MEASUREMENT
/begin MEASUREMENT Wdk2_diag "Berechneter Winkel der Drosselklappe 2 aus Hauptfüllungsignal" UWORD _CNV_R_R_Def_wdk_sw_683_CM 1 100. 0. 1599.9755 DISPLAY_IDENTIFIER WDK2_DIAG ECU_ADDRESS 0xc00006c6 FORMAT "%7.2" /end MEASUREMENT
/begin MEASUREMENT Wdk_diag_i "Berechneter Winkel der Drosselklappe aus Hauptfüllungsignal" UWORD _CNV_R_R_Def_wdk_sw_683_CM 1 100. 0. 1599.9755 DISPLAY_IDENTIFIER WDK_DIAG_I ECU_ADDRESS 0xc00006c8 FORMAT "%7.2" ARRAY_SIZE 2 MATRIX_DIM 2 1 1 /end MEASUREMENT
/begin MEASUREMENT Wdk_ist "Aktueller Drosselklappenwinkel Mittelwert" SWORD _CNV_R_R_Def_wdk_sw_683_CM 1 100. -800. 799.9755 DISPLAY_IDENTIFIER WDK_IST ECU_ADDRESS 0xd000c9c4 FORMAT "%7.2" /end MEASUREMENT
/begin MEASUREMENT Wdk_ist_i "Aktueller Drosselklappenwinkel beider Klappen" SWORD _CNV_R_R_Def_wdk_sw_683_CM 1 100. -800. 799.9755 DISPLAY_IDENTIFIER WDK_IST_I ECU_ADDRESS 0xd000c9c6 FORMAT "%7.2" ARRAY_SIZE 2 MATRIX_DIM 2 1 1 /end MEASUREMENT
/begin MEASUREMENT Wesb1kh_h "start of injection of the first injection for homogeneous combustion mode relatet to EOI_LIM" SWORD _CNV_R_R_Def_kw_sw__603_CM 1 100. -768. 767.9765 DISPLAY_IDENTIFIER WESB1KH_H ECU_ADDRESS 0xd000c9cc FORMAT "%8.3" ARRAY_SIZE 8 MATRIX_DIM 8 1 1 /end MEASUREMENT
/begin MEASUREMENT Wese "Winkel Einspritzende bezogen auf Einlaßventil schließt" UWORD _CNV_R_R_Def_kw_sw__603_CM 1 100. 0. 1535.9765 DISPLAY_IDENTIFIER WESE ECU_ADDRESS 0xd000c9dc FORMAT "%8.3" /end MEASUREMENT
/begin MEASUREMENT Wkrm "-" UBYTE _CNV_R_R_Def_zw_ub__738_CM 1 100. -191.25 0. DISPLAY_IDENTIFIER WKRM ECU_ADDRESS 0xc00006e0 FORMAT "%5.2" /end MEASUREMENT
/begin MEASUREMENT Zr_auss_b "Aussetzer CARB B" UWORD _CNV_R_R_Def_dez_sl_551_CM 1 100. 0. 65535. DISPLAY_IDENTIFIER ZR_AUSS_B ECU_ADDRESS 0xd000c9e0 FORMAT "%5.0" ARRAY_SIZE 8 MATRIX_DIM 8 1 1 /end MEASUREMENT
/begin MEASUREMENT Zr_auss_suma "Aussetzer summeCARB A" UWORD _CNV_R_R_Def_dez_sl_551_CM 1 100. 0. 65535. DISPLAY_IDENTIFIER ZR_AUSS_SUMA ECU_ADDRESS 0xd000c9f0 FORMAT "%5.0" /end MEASUREMENT
/begin MEASUREMENT Zr_auss_sumb "Aussetzersumme CARB B" UWORD _CNV_R_R_Def_dez_sl_551_CM 1 100. 0. 65535. DISPLAY_IDENTIFIER ZR_AUSS_SUMB ECU_ADDRESS 0xd000c9f2 FORMAT "%5.0" /end MEASUREMENT
/begin MEASUREMENT Zr_ausszyk_b4 "CARB B4 Zyklen mit Aussetzern" UBYTE _CNV_R_R_Def_dez_sl_551_CM 1 100. 0. 255. DISPLAY_IDENTIFIER ZR_AUSSZYK_B4 ECU_ADDRESS 0xd000cc59 FORMAT "%3.0" /end MEASUREMENT
/begin MEASUREMENT Zr_seg_nstart "Segmentzähler: Wird nach Startende neu gestartet" UWORD _CNV_R_R_Def_dez_sl_551_CM 1 100. 0. 65535. DISPLAY_IDENTIFIER ZR_SEG_NSTART ECU_ADDRESS 0xd000c9f4 FORMAT "%5.0" /end MEASUREMENT
/begin MEASUREMENT Zrbk_auss_a "Aussetzer CARB A, bankweise" UWORD _CNV_R_R_Def_dez_sl_551_CM 1 100. 0. 65535. DISPLAY_IDENTIFIER ZRBK_AUSS_A ECU_ADDRESS 0xd000cc5a FORMAT "%5.0" ARRAY_SIZE 2 MATRIX_DIM 2 1 1 /end MEASUREMENT
/begin MEASUREMENT Zrbkmx_auss_a "Schwelle Aussetzer CARB A, bankweise" UWORD _CNV_R_R_Def_dez_sl_551_CM 1 100. 0. 65535. DISPLAY_IDENTIFIER ZRBKMX_AUSS_A ECU_ADDRESS 0xd000cc5e FORMAT "%5.0" ARRAY_SIZE 2 MATRIX_DIM 2 1 1 /end MEASUREMENT
/begin MEASUREMENT Zrbosr "Servicezähler vom Kombi" UBYTE _CNV_R_R_Def_dez_sl_551_CM 1 100. 0. 255. DISPLAY_IDENTIFIER ZRBOSR ECU_ADDRESS 0xc000068f FORMAT "%3.0" /end MEASUREMENT
/begin MEASUREMENT Zrbosrt "Servicezählerstand vom Tester" UBYTE _CNV_R_R_Def_dez_sl_551_CM 1 100. 0. 255. DISPLAY_IDENTIFIER ZRBOSRT ECU_ADDRESS 0xc0000690 FORMAT "%3.0" /end MEASUREMENT
/begin MEASUREMENT Zrmx_auss_a "Schwelle Aussetzer CARB A" UWORD _CNV_R_R_Def_dez_sl_551_CM 1 100. 0. 65535. DISPLAY_IDENTIFIER ZRMX_AUSS_A ECU_ADDRESS 0xd000cc62 FORMAT "%5.0" /end MEASUREMENT
/begin MEASUREMENT Zrmx_auss_b1 "Schwelle Aussetzer CARB B1" UWORD _CNV_R_R_Def_dez_sl_551_CM 1 100. 0. 65535. DISPLAY_IDENTIFIER ZRMX_AUSS_B1 ECU_ADDRESS 0xd000cc64 FORMAT "%5.0" /end MEASUREMENT
/begin MEASUREMENT Zrmx_auss_b4 "Schwelle Aussetzer CARB B4" UWORD _CNV_R_R_Def_dez_sl_551_CM 1 100. 0. 65535. DISPLAY_IDENTIFIER ZRMX_AUSS_B4 ECU_ADDRESS 0xd000cc66 FORMAT "%5.0" /end MEASUREMENT
/begin MEASUREMENT Ztageabs "Tagezähler vom Kombi" UWORD _CNV_R_R_Def_dez_sl_551_CM 1 100. 0. 65535. DISPLAY_IDENTIFIER ZTAGEABS ECU_ADDRESS 0xc0000692 FORMAT "%5.0" /end MEASUREMENT
/begin MEASUREMENT Zw_md "Zündwinkel nach Momenteneingriff" SWORD _CNV_R_R_Def_zw_sw__604_CM 1 100. -50. 60. DISPLAY_IDENTIFIER ZW_MD ECU_ADDRESS 0xd000c9f8 FORMAT "%6.1" ARRAY_SIZE 8 MATRIX_DIM 8 1 1 /end MEASUREMENT
/begin MEASUREMENT Zw_nokr "Ausgegebener Zündwinkel ohne Klopfregeleingriff" SWORD _CNV_R_R_Def_zw_sw__604_CM 1 100. -50. 60. DISPLAY_IDENTIFIER ZW_NOKR ECU_ADDRESS 0xd000ccb0 FORMAT "%6.1" ARRAY_SIZE 8 MATRIX_DIM 8 1 1 /end MEASUREMENT
/begin MEASUREMENT Zw_offkorrvr "Zündwinkeloffset für Verbrennungsregelung" SWORD _CNV_R_R_Def_zw_sw__604_CM 1 100. -50. 60. DISPLAY_IDENTIFIER ZW_OFFKORRVR ECU_ADDRESS 0xd000cc2c FORMAT "%6.1" ARRAY_SIZE 8 MATRIX_DIM 8 1 1 /end MEASUREMENT
/begin MEASUREMENT Zw_out_mw "Zündwinkel gemittelt" SWORD _CNV_R_R_Def_zw_sw__604_CM 1 100. -50. 60. DISPLAY_IDENTIFIER ZW_OUT_MW ECU_ADDRESS 0xd000ccc0 FORMAT "%6.1" /end MEASUREMENT
/begin MEASUREMENT Zw_out_mw_novbr "Mittelwert des ausgegebenen Zündwinkels ohne Eingriff der Verbrennungsregelung" SWORD _CNV_R_R_Def_zw_sw__604_CM 1 100. -50. 60. DISPLAY_IDENTIFIER ZW_OUT_MW_NOVBR ECU_ADDRESS 0xd000ccc2 FORMAT "%6.1" /end MEASUREMENT
/begin MEASUREMENT Zw_out_mwbk "Mittelwert bankindividuell des ausgegebenen Zündwinkels" SWORD _CNV_R_R_Def_zw_sw__604_CM 1 100. -50. 60. DISPLAY_IDENTIFIER ZW_OUT_MWBK ECU_ADDRESS 0xd000ccc4 FORMAT "%6.1" ARRAY_SIZE 2 MATRIX_DIM 2 1 1 /end MEASUREMENT
/begin MEASUREMENT Zw_soll_can "Sollzündwinkel durch Momenteneingriff aus Sollmoment über CAN" SWORD _CNV_R_R_Def_zw_sw__604_CM 1 100. -50. 60. DISPLAY_IDENTIFIER ZW_SOLL_CAN ECU_ADDRESS 0xd000ccc8 FORMAT "%6.1" /end MEASUREMENT
/begin MEASUREMENT Zyl_akt "Aktueller Zylinder" UBYTE _CNV_R_R_Def_dez_sl_551_CM 1 100. 0. 255. DISPLAY_IDENTIFIER ZYL_AKT ECU_ADDRESS 0xc0007486 FORMAT "%3.0" /end MEASUREMENT
/begin MEASUREMENT w_ba_ist "Gewichte KRANN, Eingang Ba_ist" FLOAT32_IEEE _CNV_R_R_Def_dez_sl_551_CM 1 100. -1000000000000. 10000000000000. DISPLAY_IDENTIFIER W_BA_IST ECU_ADDRESS 0xc00044a8 FORMAT "%14.7" ARRAY_SIZE 15 MATRIX_DIM 15 1 1 /end MEASUREMENT
/begin MEASUREMENT w_bias "Gewichte KRANN, Biasterm" FLOAT32_IEEE _CNV_R_R_Def_dez_sl_551_CM 1 100. -1000000000000. 10000000000000. DISPLAY_IDENTIFIER W_BIAS ECU_ADDRESS 0xc000437c FORMAT "%14.7" ARRAY_SIZE 15 MATRIX_DIM 15 1 1 /end MEASUREMENT
/begin MEASUREMENT w_kh_bias "Gewichte KHNN, Biasterm" FLOAT32_IEEE _CNV_R_R_Def_dez_sl_551_CM 1 100. -1000000000000. 10000000000000. DISPLAY_IDENTIFIER W_KH_BIAS ECU_ADDRESS 0xc00044e4 FORMAT "%14.7" ARRAY_SIZE 6 MATRIX_DIM 6 1 1 /end MEASUREMENT
/begin MEASUREMENT w_kh_nkw "Gewichte KHNN, Eingang Nkw" FLOAT32_IEEE _CNV_R_R_Def_dez_sl_551_CM 1 100. -1000000000000. 10000000000000. DISPLAY_IDENTIFIER W_KH_NKW ECU_ADDRESS 0xc00044fc FORMAT "%14.7" ARRAY_SIZE 6 MATRIX_DIM 6 1 1 /end MEASUREMENT
/begin MEASUREMENT w_kh_rk "Gewichte KHNN, Eingang Rk_soll_s" FLOAT32_IEEE _CNV_R_R_Def_dez_sl_551_CM 1 100. -1000000000000. 10000000000000. DISPLAY_IDENTIFIER W_KH_RK ECU_ADDRESS 0xc0004514 FORMAT "%14.7" ARRAY_SIZE 6 MATRIX_DIM 6 1 1 /end MEASUREMENT
/begin MEASUREMENT w_kh_tans "Gewichte KHNN, Eingang Tans" FLOAT32_IEEE _CNV_R_R_Def_dez_sl_551_CM 1 100. -1000000000000. 10000000000000. DISPLAY_IDENTIFIER W_KH_TANS ECU_ADDRESS 0xc000452c FORMAT "%14.7" ARRAY_SIZE 6 MATRIX_DIM 6 1 1 /end MEASUREMENT
/begin MEASUREMENT w_nkw "Gewichte KRANN, Eingang Nkw" FLOAT32_IEEE _CNV_R_R_Def_dez_sl_551_CM 1 100. -1000000000000. 10000000000000. DISPLAY_IDENTIFIER W_NKW ECU_ADDRESS 0xc00043b8 FORMAT "%14.7" ARRAY_SIZE 15 MATRIX_DIM 15 1 1 /end MEASUREMENT
/begin MEASUREMENT w_rk "Gewichte KRANN, Eingang Rk_soll_kr" FLOAT32_IEEE _CNV_R_R_Def_dez_sl_551_CM 1 100. -1000000000000. 10000000000000. DISPLAY_IDENTIFIER W_RK ECU_ADDRESS 0xc00043f4 FORMAT "%14.7" ARRAY_SIZE 15 MATRIX_DIM 15 1 1 /end MEASUREMENT
/begin MEASUREMENT w_tans "Gewichte KRANN, Eingang Tans" FLOAT32_IEEE _CNV_R_R_Def_dez_sl_551_CM 1 100. -1000000000000. 10000000000000. DISPLAY_IDENTIFIER W_TANS ECU_ADDRESS 0xc0004430 FORMAT "%14.7" ARRAY_SIZE 15 MATRIX_DIM 15 1 1 /end MEASUREMENT
/begin MEASUREMENT w_tmot "Gewichte KRANN, Eingang Tmot" FLOAT32_IEEE _CNV_R_R_Def_dez_sl_551_CM 1 100. -1000000000000. 10000000000000. DISPLAY_IDENTIFIER W_TMOT ECU_ADDRESS 0xc000446c FORMAT "%14.7" ARRAY_SIZE 15 MATRIX_DIM 15 1 1 /end MEASUREMENT
/begin AXIS_PTS GAX_KHMOD "Modelle der LOLIMOT-KNN (Zaehler fuer KHNN)" 0xa0821f48 NO_INPUT_QUANTITY _REC_AXS_20_u1 255. _CNV_R_R_Def_dez_sl_551_CM 6 0. 255. FORMAT "%3.0" /end AXIS_PTS
/begin AXIS_PTS GAX_KRMOD "Modelle der LOLIMOT-KNN (Zaehler fuer KRANN)" 0xa0821f34 NO_INPUT_QUANTITY _REC_AXS_20_u1 255. _CNV_R_R_Def_dez_sl_551_CM 15 0. 255. FORMAT "%3.0" /end AXIS_PTS
/begin CHARACTERISTIC KL_CKH_NKW "Zentren Lolimot-Modelle Eingang Nkw, KHNN" CURVE 0xa0822090 _REC_CUR_20_s2_u1 65535. _CNV_R_R_Def_n_sw_q_595_CM -32768. 32767. FORMAT "%5.0"
 /begin AXIS_DESCR COM_AXIS NO_INPUT_QUANTITY _CNV_R_R_Def_dez_sl_551_CM 6 0. 255. FORMAT "%3.0" AXIS_PTS_REF GAX_KHMOD /end AXIS_DESCR
/end CHARACTERISTIC
/begin CHARACTERISTIC KL_CKH_RK "Zentren Lolimot-Modelle Eingang Rk_soll_s, KHNN" CURVE 0xa082209c _REC_CUR_20_s2_u1 3199.951100000001 _CNV_R_R_Def_rk_sw__600_CM -1600. 1599.9511
 /begin AXIS_DESCR COM_AXIS NO_INPUT_QUANTITY _CNV_R_R_Def_dez_sl_551_CM 6 0. 255. FORMAT "%3.0" AXIS_PTS_REF GAX_KHMOD /end AXIS_DESCR
/end CHARACTERISTIC
/begin CHARACTERISTIC KL_CKH_TANS "Zentren Lolimot-Modelle Eingang Tans, KHNN" CURVE 0xa08220a8 _REC_CUR_20_s2_u1 6553.5 _CNV_R_R_Def_t_sw_q_578_CM -3276.8 3276.7 FORMAT "%4.1"
 /begin AXIS_DESCR COM_AXIS NO_INPUT_QUANTITY _CNV_R_R_Def_dez_sl_551_CM 6 0. 255. FORMAT "%3.0" AXIS_PTS_REF GAX_KHMOD /end AXIS_DESCR
/end CHARACTERISTIC
/begin CHARACTERISTIC KL_CKR_BA_IST "Zentren Lolimot-Modelle Eingang Ba_ist, KRANN" CURVE 0xa0821fd0 _REC_CUR_20_s2_u1 655.35 _CNV_R_R_Def_lf_ub__670_CM -327.68 327.67 FORMAT "%5.2"
 /begin AXIS_DESCR COM_AXIS NO_INPUT_QUANTITY _CNV_R_R_Def_dez_sl_551_CM 15 0. 255. FORMAT "%3.0" AXIS_PTS_REF GAX_KRMOD /end AXIS_DESCR
/end CHARACTERISTIC
/begin CHARACTERISTIC KL_CKR_NKW "Zentren Lolimot-Modelle Eingang Nkw, KRANN" CURVE 0xa0821f50 _REC_CUR_20_s2_u1 65535. _CNV_R_R_Def_n_sw_q_595_CM -32768. 32767. FORMAT "%5.0"
 /begin AXIS_DESCR COM_AXIS NO_INPUT_QUANTITY _CNV_R_R_Def_dez_sl_551_CM 15 0. 255. FORMAT "%3.0" AXIS_PTS_REF GAX_KRMOD /end AXIS_DESCR
/end CHARACTERISTIC
/begin CHARACTERISTIC KL_CKR_RK "Zentren Lolimot-Modelle Eingang Rk_soll_kr, KRANN" CURVE 0xa0821f70 _REC_CUR_20_s2_u1 3199.951100000001 _CNV_R_R_Def_rk_sw__600_CM -1600. 1599.9511
 /begin AXIS_DESCR COM_AXIS NO_INPUT_QUANTITY _CNV_R_R_Def_dez_sl_551_CM 15 0. 255. FORMAT "%3.0" AXIS_PTS_REF GAX_KRMOD /end AXIS_DESCR
/end CHARACTERISTIC
/begin CHARACTERISTIC KL_CKR_TANS "Zentren Lolimot-Modelle Eingang Tans, KRANN" CURVE 0xa0821f90 _REC_CUR_20_s2_u1 6553.5 _CNV_R_R_Def_t_sw_q_578_CM -3276.8 3276.7 FORMAT "%4.1"
 /begin AXIS_DESCR COM_AXIS NO_INPUT_QUANTITY _CNV_R_R_Def_dez_sl_551_CM 15 0. 255. FORMAT "%3.0" AXIS_PTS_REF GAX_KRMOD /end AXIS_DESCR
/end CHARACTERISTIC
/begin CHARACTERISTIC KL_CKR_TMOT "Zentren Lolimot-Modelle Eingang Tmot, KRANN" CURVE 0xa0821fb0 _REC_CUR_20_s2_u1 655.35 _CNV_R_R_Def_t_sw_q_579_CM -327.68 327.67 FORMAT "%5.2"
 /begin AXIS_DESCR COM_AXIS NO_INPUT_QUANTITY _CNV_R_R_Def_dez_sl_551_CM 15 0. 255. FORMAT "%3.0" AXIS_PTS_REF GAX_KRMOD /end AXIS_DESCR
/end CHARACTERISTIC
/begin CHARACTERISTIC KL_ETAKRFR "Lernfaktor fuer Fruehverstellung" CURVE 0xa0821f00 _REC_CUR_TKL_UW_VV__S4_S4 0. _CNV_R_R_Def_dez_sl_551_CM -1000000000000. 10000000000000. FORMAT "%14.7"
 /begin AXIS_DESCR STD_AXIS NO_INPUT_QUANTITY _CNV_R_R_Def_dez_sl_551_CM 6 -1000000000000. 10000000000000. FORMAT "%14.7" /end AXIS_DESCR
/end CHARACTERISTIC
/begin CHARACTERISTIC KL_ETAKRSP "Lernfaktor fuer Spaetverstellung" CURVE 0xa0821ecc _REC_CUR_TKL_UW_VV__S4_S4 0. _CNV_R_R_Def_dez_sl_551_CM -1000000000000. 10000000000000. FORMAT "%14.7"
 /begin AXIS_DESCR STD_AXIS NO_INPUT_QUANTITY _CNV_R_R_Def_dez_sl_551_CM 6 -1000000000000. 10000000000000. FORMAT "%14.7" /end AXIS_DESCR
/end CHARACTERISTIC
/begin CHARACTERISTIC KL_KFTKRMN "Kennlinie Zeitverzoegerung Mszyl ueber Drehzahl (untere Schwelle)" CURVE 0xa0821e78 _REC_CUR_TKL_UW_VV__s2_s2 100.1 _CNV_R_R_Def_zw_sw__604_CM -50. 60. FORMAT "%4.1"
 /begin AXIS_DESCR STD_AXIS Nkw _CNV_R_R_Def_n_sw_q_595_CM 6 -32768. 32767. FORMAT "%5.0" /end AXIS_DESCR
/end CHARACTERISTIC
/begin CHARACTERISTIC KL_KFTKRMX "Kennlinie Zeitverzoegerung Mszyl ueber Drehzahl (obere Schwelle)" CURVE 0xa0821e5c _REC_CUR_TKL_UW_VV__s2_s2 100.1 _CNV_R_R_Def_zw_sw__604_CM -50. 60. FORMAT "%4.1"
 /begin AXIS_DESCR STD_AXIS Nkw _CNV_R_R_Def_n_sw_q_595_CM 6 -32768. 32767. FORMAT "%5.0" /end AXIS_DESCR
/end CHARACTERISTIC
/begin CHARACTERISTIC KL_RKMIN_KH "Kennlinie Rk_soll_kr-Schwelle fuer KHNN" CURVE 0xa0821eb0 _REC_CUR_TKL_UW_VV__s2_s2 95.99853300000001 _CNV_R_R_Def_rk_sw__600_CM -1600. 1599.9511
 /begin AXIS_DESCR STD_AXIS Nkw _CNV_R_R_Def_n_sw_q_595_CM 6 -32768. 32767. FORMAT "%5.0" /end AXIS_DESCR
/end CHARACTERISTIC
/begin CHARACTERISTIC KL_RKMIN_KR "Kennlinie Rk_soll_kr-Schwelle" CURVE 0xa0821e94 _REC_CUR_TKL_UW_VV__s2_s2 95.99853300000001 _CNV_R_R_Def_rk_sw__600_CM -1600. 1599.9511
 /begin AXIS_DESCR STD_AXIS Nkw _CNV_R_R_Def_n_sw_q_595_CM 6 -32768. 32767. FORMAT "%5.0" /end AXIS_DESCR
/end CHARACTERISTIC
/begin CHARACTERISTIC KL_SKH_NKW "Breiten Lolimot-Modelle Eingang Nkw, KHNN" CURVE 0xa08220b4 _REC_CUR_20_s2_u1 65535. _CNV_R_R_Def_n_sw_q_595_CM -32768. 32767. FORMAT "%5.0"
 /begin AXIS_DESCR COM_AXIS NO_INPUT_QUANTITY _CNV_R_R_Def_dez_sl_551_CM 6 0. 255. FORMAT "%3.0" AXIS_PTS_REF GAX_KHMOD /end AXIS_DESCR
/end CHARACTERISTIC
/begin CHARACTERISTIC KL_SKH_RK "Breiten Lolimot-Modelle Eingang Rk_soll_s, KHNN" CURVE 0xa08220c0 _REC_CUR_20_s2_u1 3199.951100000001 _CNV_R_R_Def_rk_sw__600_CM -1600. 1599.9511
 /begin AXIS_DESCR COM_AXIS NO_INPUT_QUANTITY _CNV_R_R_Def_dez_sl_551_CM 6 0. 255. FORMAT "%3.0" AXIS_PTS_REF GAX_KHMOD /end AXIS_DESCR
/end CHARACTERISTIC
/begin CHARACTERISTIC KL_SKH_TANS "Breiten Lolimot-Modelle Eingang Tans, KHNN" CURVE 0xa08220cc _REC_CUR_20_s2_u1 6553.5 _CNV_R_R_Def_t_sw_q_578_CM -3276.8 3276.7 FORMAT "%4.1"
 /begin AXIS_DESCR COM_AXIS NO_INPUT_QUANTITY _CNV_R_R_Def_dez_sl_551_CM 6 0. 255. FORMAT "%3.0" AXIS_PTS_REF GAX_KHMOD /end AXIS_DESCR
/end CHARACTERISTIC
/begin CHARACTERISTIC KL_SKR_BA_IST "Breiten Lolimot-Modelle Eingang Ba_ist, KRANN" CURVE 0xa0822070 _REC_CUR_20_s2_u1 655.35 _CNV_R_R_Def_lf_ub__670_CM -327.68 327.67 FORMAT "%5.2"
 /begin AXIS_DESCR COM_AXIS NO_INPUT_QUANTITY _CNV_R_R_Def_dez_sl_551_CM 15 0. 255. FORMAT "%3.0" AXIS_PTS_REF GAX_KRMOD /end AXIS_DESCR
/end CHARACTERISTIC
/begin CHARACTERISTIC KL_SKR_NKW "Breiten Lolimot-Modelle Eingang Nkw, KRANN" CURVE 0xa0821ff0 _REC_CUR_20_s2_u1 65535. _CNV_R_R_Def_n_sw_q_595_CM -32768. 32767. FORMAT "%5.0"
 /begin AXIS_DESCR COM_AXIS NO_INPUT_QUANTITY _CNV_R_R_Def_dez_sl_551_CM 15 0. 255. FORMAT "%3.0" AXIS_PTS_REF GAX_KRMOD /end AXIS_DESCR
/end CHARACTERISTIC
/begin CHARACTERISTIC KL_SKR_RK "Breiten Lolimot-Modelle Eingang Rk_soll_kr, KRANN" CURVE 0xa0822010 _REC_CUR_20_s2_u1 3199.951100000001 _CNV_R_R_Def_rk_sw__600_CM -1600. 1599.9511
 /begin AXIS_DESCR COM_AXIS NO_INPUT_QUANTITY _CNV_R_R_Def_dez_sl_551_CM 15 0. 255. FORMAT "%3.0" AXIS_PTS_REF GAX_KRMOD /end AXIS_DESCR
/end CHARACTERISTIC
/begin CHARACTERISTIC KL_SKR_TANS "Breiten Lolimot-Modelle Eingang Tans, KRANN" CURVE 0xa0822030 _REC_CUR_20_s2_u1 6553.5 _CNV_R_R_Def_t_sw_q_578_CM -3276.8 3276.7 FORMAT "%4.1"
 /begin AXIS_DESCR COM_AXIS NO_INPUT_QUANTITY _CNV_R_R_Def_dez_sl_551_CM 15 0. 255. FORMAT "%3.0" AXIS_PTS_REF GAX_KRMOD /end AXIS_DESCR
/end CHARACTERISTIC
/begin CHARACTERISTIC KL_SKR_TMOT "Breiten Lolimot-Modelle Eingang Tmot, KRANN" CURVE 0xa0822050 _REC_CUR_20_s2_u1 655.35 _CNV_R_R_Def_t_sw_q_579_CM -327.68 327.67 FORMAT "%5.2"
 /begin AXIS_DESCR COM_AXIS NO_INPUT_QUANTITY _CNV_R_R_Def_dez_sl_551_CM 15 0. 255. FORMAT "%3.0" AXIS_PTS_REF GAX_KRMOD /end AXIS_DESCR
/end CHARACTERISTIC
/begin CHARACTERISTIC K_ANZ_ARBSP "Anzahl der zu mittelnden Arbeitsspiele" VALUE 0xa0821e24 _REC_VAL_20_u1 20. _CNV_R_R_Def_dez_sl_551_CM 0. 20. FORMAT "%3.0" /end CHARACTERISTIC
/begin CHARACTERISTIC K_DWKRMNN "Erlaubtes Delta zwischen KR-Winkel und erlerntem Winkel" VALUE 0xa0821e3c _REC_VAL_20_s2 50.1 _CNV_R_R_Def_zw_sw__604_CM -50. 0.1 FORMAT "%4.1" /end CHARACTERISTIC
/begin CHARACTERISTIC K_EIN_KHNN "Anzahl Eingaenge fuer KHNN" VALUE 0xa0821e21 _REC_VAL_20_u1 3. _CNV_R_R_Def_dez_sl_551_CM 0. 3. FORMAT "%3.0" /end CHARACTERISTIC
/begin CHARACTERISTIC K_EIN_KRANN "Anzahl Eingaenge fuer KRANN" VALUE 0xa0821e20 _REC_VAL_20_u1 5. _CNV_R_R_Def_dez_sl_551_CM 0. 5. FORMAT "%3.0" /end CHARACTERISTIC
/begin CHARACTERISTIC K_ETAKHNEG "Lernfaktor KHNN in negative Richtung" VALUE 0xa0821e4e _REC_VAL_20_S4 0. _CNV_R_R_Def_dez_sl_551_CM -1000000000000. 10000000000000. FORMAT "%14.7" /end CHARACTERISTIC
/begin CHARACTERISTIC K_ETAKHNEGHS "Lernfaktor KHNN in negative Richtung fuer Homogen-Schicht" VALUE 0xa0821e52 _REC_VAL_20_S4 0. _CNV_R_R_Def_dez_sl_551_CM -1000000000000. 10000000000000. FORMAT "%14.7" /end CHARACTERISTIC
/begin CHARACTERISTIC K_ETAKHPOS "Lernfaktor KHNN in positive Richtung" VALUE 0xa0821e46 _REC_VAL_20_S4 0. _CNV_R_R_Def_dez_sl_551_CM -1000000000000. 10000000000000. FORMAT "%14.7" /end CHARACTERISTIC
/begin CHARACTERISTIC K_ETAKHPOSHS "Lernfaktor KHNN in positive Richtung fuer Homogen-Schicht" VALUE 0xa0821e4a _REC_VAL_20_S4 0. _CNV_R_R_Def_dez_sl_551_CM -1000000000000. 10000000000000. FORMAT "%14.7" /end CHARACTERISTIC
/begin CHARACTERISTIC K_ETA_MIN "minimales ETA zur Absicherung Momentenberechnung" VALUE 0xa0818e7c _REC_VAL_20_s2 100. _CNV_R_R_Def_eta_sw_606_CM 0. 100. /end CHARACTERISTIC
/begin CHARACTERISTIC K_KHNNMX "Maximalwert fuer Gewichte KHNN" VALUE 0xa0821e42 _REC_VAL_20_S4 0. _CNV_R_R_Def_dez_sl_551_CM -1000000000000. 10000000000000. FORMAT "%14.7" /end CHARACTERISTIC
/begin CHARACTERISTIC K_KHNN_F "Faktor fuer manuelle Gewichtsverstellung per Applikation" VALUE 0xa0821e56 _REC_VAL_20_S4 0. _CNV_R_R_Def_dez_sl_551_CM -1000000000000. 10000000000000. FORMAT "%14.7" /end CHARACTERISTIC
/begin CHARACTERISTIC K_KRANNMX "Maximalwert fuer Gewichte KRANN" VALUE 0xa0821e3e _REC_VAL_20_S4 0. _CNV_R_R_Def_dez_sl_551_CM -1000000000000. 10000000000000. FORMAT "%14.7" /end CHARACTERISTIC
/begin CHARACTERISTIC K_KRZYKL_AUS "Anzahl der auszublendenden Arbeitsspiele bei BA-Umschaltung" VALUE 0xa0821e25 _REC_VAL_20_u1 20. _CNV_R_R_Def_dez_sl_551_CM 0. 20. FORMAT "%3.0" /end CHARACTERISTIC
/begin CHARACTERISTIC K_MDK_EXT_MINUS "" VALUE 0xa0818e7a _REC_VAL_20_s2 131.07 _CNV_R_R_Def_m_sw_q_554_CM -3276.8 3276.7 FORMAT "%5.2" /end CHARACTERISTIC
/begin CHARACTERISTIC K_MDK_EXT_PLUS "" VALUE 0xa0818e78 _REC_VAL_20_s2 131.07 _CNV_R_R_Def_m_sw_q_554_CM -3276.8 3276.7 FORMAT "%5.2" /end CHARACTERISTIC
/begin CHARACTERISTIC K_MOD_KHNN "Anzahl Modelle fuer KHNN" VALUE 0xa0821e23 _REC_VAL_20_u1 6. _CNV_R_R_Def_dez_sl_551_CM 0. 6. FORMAT "%3.0" /end CHARACTERISTIC
/begin CHARACTERISTIC K_MOD_KRANN "Anzahl Modelle fuer KRANN" VALUE 0xa0821e22 _REC_VAL_20_u1 15. _CNV_R_R_Def_dez_sl_551_CM 0. 15. FORMAT "%3.0" /end CHARACTERISTIC
/begin CHARACTERISTIC K_NKRF "Nkw-Schwelle" VALUE 0xa0821e3a _REC_VAL_20_s2 0. _CNV_R_R_Def_n_sw_q_595_CM -32768. 32767. FORMAT "%5.0" /end CHARACTERISTIC
/begin CHARACTERISTIC K_TDSTEND "Verzoegerungszeit fuer B_startende" VALUE 0xa0821e26 _REC_VAL_20_u1 25.4997 _CNV_R_R_Def_zk100m_772_CM 0.1003 25.6 FORMAT "%4.1" /end CHARACTERISTIC
/begin CHARACTERISTIC K_TDSTEND_KH "Verzoegerungszeit fuer B_startende KHNN" VALUE 0xa0821e27 _REC_VAL_20_u1 25.4997 _CNV_R_R_Def_zk100m_772_CM 0.1003 25.6 FORMAT "%4.1" /end CHARACTERISTIC
/begin CHARACTERISTIC K_TMKHNN "Tmot-Schwelle KHNN" VALUE 0xa0821e34 _REC_VAL_20_s2 98.30250000000001 _CNV_R_R_Def_t_sw_q_579_CM -327.68 327.67 FORMAT "%5.2" /end CHARACTERISTIC
/begin CHARACTERISTIC K_TMKHNNLRN "Tmot-Schwelle KHNN lernen" VALUE 0xa0821e38 _REC_VAL_20_s2 98.30250000000001 _CNV_R_R_Def_t_sw_q_579_CM -327.68 327.67 FORMAT "%5.2" /end CHARACTERISTIC
/begin CHARACTERISTIC K_TMKRANN "Tmot-Schwelle KRANN" VALUE 0xa0821e30 _REC_VAL_20_s2 98.30250000000001 _CNV_R_R_Def_t_sw_q_579_CM -327.68 327.67 FORMAT "%5.2" /end CHARACTERISTIC
/begin CHARACTERISTIC K_TMKRANNLRN "Tmot-Schwelle KRANN lernen" VALUE 0xa0821e36 _REC_VAL_20_s2 98.30250000000001 _CNV_R_R_Def_t_sw_q_579_CM -327.68 327.67 FORMAT "%5.2" /end CHARACTERISTIC
/begin CHARACTERISTIC K_TUMG_OFF "Offset auf Tumg fuer Vollast-Delta-Berechnung" VALUE 0xa0821e32 _REC_VAL_20_s2 131.07 _CNV_R_R_Def_t_sw_q_578_CM -3276.8 3276.7 FORMAT "%4.1" /end CHARACTERISTIC
/begin CHARACTERISTIC S_KHNNLERN "Applikationsschalter zum erzwungenen Lernen KHNN" VALUE 0xa0821e2f _REC_VAL_20_u1 1. _CNV_R_R_Def_dez_sl_551_CM 0. 1. FORMAT "%3.0" /end CHARACTERISTIC
/begin CHARACTERISTIC S_KHNN_EIN "Einschalter KHNN" VALUE 0xa0821e2c _REC_VAL_20_u1 1. _CNV_R_R_Def_dez_sl_551_CM 0. 1. FORMAT "%3.0" /end CHARACTERISTIC
/begin CHARACTERISTIC S_KHNN_F "Einschalter manuelle Gewichtsverstellung" VALUE 0xa0821e2b _REC_VAL_20_u1 1. _CNV_R_R_Def_dez_sl_551_CM 0. 1. FORMAT "%3.0" /end CHARACTERISTIC
/begin CHARACTERISTIC S_KRANN "Einschalter Adaption" VALUE 0xa0821e29 _REC_VAL_20_u1 1. _CNV_R_R_Def_dez_sl_551_CM 0. 1. FORMAT "%3.0" /end CHARACTERISTIC
/begin CHARACTERISTIC S_KRANNLERN "Applikationsschalter zum erzwungenen Lernen KRANN" VALUE 0xa0821e2d _REC_VAL_20_u1 1. _CNV_R_R_Def_dez_sl_551_CM 0. 1. FORMAT "%3.0" /end CHARACTERISTIC
/begin CHARACTERISTIC S_KRANNLL "Einschalter Auslesen KRANN im Leerlauf" VALUE 0xa0821e2a _REC_VAL_20_u1 1. _CNV_R_R_Def_dez_sl_551_CM 0. 1. FORMAT "%3.0" /end CHARACTERISTIC
/begin CHARACTERISTIC S_KRANN_KFTV "Wahlschalter V statt Nkw als Eingang von KL_KFTKRMX /MN" VALUE 0xa0821e28 _REC_VAL_20_u1 1. _CNV_R_R_Def_dez_sl_551_CM 0. 1. FORMAT "%3.0" /end CHARACTERISTIC
/begin CHARACTERISTIC S_KRVBADAP_HS "Applikationsschalter Verbot Adaption bei HS und B_zwmin_hs" VALUE 0xa0821e2e _REC_VAL_20_u1 1. _CNV_R_R_Def_dez_sl_551_CM 0. 1. FORMAT "%3.0" /end CHARACTERISTIC
/begin COMPU_METHOD _CNV_R_R_Def_km_sw__68_CM "Def_km_sw_q10" RAT_FUNC "%6.3" "km" COEFFS 0. 1. 0. 0. 0. 10. /end COMPU_METHOD
/begin COMPU_METHOD _CNV_R_R_Def_km_ub__428_CM "Def_km_ub_q1000" RAT_FUNC "%6.3" "km" COEFFS 0. 1. 0. 0. 0. 1000. /end COMPU_METHOD
/begin COMPU_METHOD _CNV_R_R_Def_a_sw_b_549_CM "Def_a_sw_b64" RAT_FUNC "%6.3" "m/s²" COEFFS 0. 32768. 0. 0. 0. 64. /end COMPU_METHOD
/begin COMPU_METHOD _CNV_R_R_Def_f_sw_q_550_CM "Def_f_sw_q0p00153" RAT_FUNC "%6.3" "-" COEFFS 0. 32768. 0. 0. 0. 50. /end COMPU_METHOD
/begin COMPU_METHOD _CNV_R_R_Def_dez_sl_551_CM "Def_dez_sl_q1" RAT_FUNC "%6.3" "-" COEFFS 0. 1. 0. 0. 0. 1. /end COMPU_METHOD
/begin COMPU_METHOD _CNV_R_R_Def_ac_sb__552_CM "Def_ac_sb_q0p25" RAT_FUNC "%6.3" "-" COEFFS 0. 4. 0. 0. 0. 1. /end COMPU_METHOD
/begin COMPU_METHOD _CNV_R_R_Def_f_ub_b_553_CM "Def_f_ub_b1" RAT_FUNC "%6.3" "-" COEFFS 0. 256. 0. 0. 0. 1. /end COMPU_METHOD
/begin COMPU_METHOD _CNV_R_R_Def_m_sw_q_554_CM "Def_m_sw_q0p1" RAT_FUNC "%6.3" "Nm" COEFFS 0. 10. 0. 0. 0. 1. /end COMPU_METHOD
/begin COMPU_METHOD _CNV_R_R_Def_f_uw_b_555_CM "Def_f_uw_b100" RAT_FUNC "%6.3" "%" COEFFS 0. 65536. 0. 0. 0. 100. /end COMPU_METHOD
/begin COMPU_METHOD _CNV_R_R_Def_f_uw_b_559_CM "Def_f_uw_b16" RAT_FUNC "%6.3" "-" COEFFS 0. 65536. 0. 0. 0. 16. /end COMPU_METHOD
/begin COMPU_METHOD _CNV_R_R_Def_f_sw_q_560_CM "Def_f_sw_q0p1" RAT_FUNC "%6.3" "-" COEFFS 0. 10. 0. 0. 0. 1. /end COMPU_METHOD
/begin COMPU_METHOD _CNV_R_R_Def_spr_sw_561_CM "Def_spr_sw_q0p1" RAT_FUNC "%6.3" "° KW" COEFFS 0. 10. 0. 0. 0. 1. /end COMPU_METHOD
/begin COMPU_METHOD _CNV_R_R_Def_rel_sw_562_CM "Def_rel_sw_b100" RAT_FUNC "%6.3" "%" COEFFS 0. 32768. 0. 0. 0. 100. /end COMPU_METHOD
/begin COMPU_METHOD _CNV_S_2_Def_bit_ub_563_CM "Def_bit_ub_0" TAB_VERB "%6.3" "-" COMPU_TAB_REF _CNV_S_2_Def_bit_ub_563 /end COMPU_METHOD
/begin COMPU_VTAB _CNV_S_2_Def_bit_ub_563 "Def_bit_ub_0" TAB_VERB 2 0 "FALSE" 1 "TRUE" /end COMPU_VTAB
/begin COMPU_METHOD _CNV_S_11_Def_ba_ewp_566_CM "Def_ba_ewp" TAB_VERB "%6.3" "-" COMPU_TAB_REF _CNV_S_11_Def_ba_ewp_566 /end COMPU_METHOD
/begin COMPU_VTAB _CNV_S_11_Def_ba_ewp_566 "Def_ba_ewp" TAB_VERB 11 0 "INIT" 1 "NORMAL_GESTEUERT" 2 "NORMAL_GEREGELT" 3 "REDUZIERT_USP" 4 "REDUZIERT_UEBT1" 5 "REDUZIERT_UEBT2" 6 "REDUZIERT_TROCKENLAUF" 7 "ABSCHALTUNG_TEMP" 8 "ABSCHALTUNG_DEBLOCK" 9 "ABSCHALTUNG_PERM" 10 "NPLAUS" /end COMPU_VTAB
/begin COMPU_METHOD _CNV_R_R_Def_f_sw_b_570_CM "Def_f_sw_b100" RAT_FUNC "%6.3" "-" COEFFS 0. 32768. 0. 0. 0. 100. /end COMPU_METHOD
/begin COMPU_METHOD _CNV_R_R_Def_f_uw_b_571_CM "Def_f_uw_b1" RAT_FUNC "%6.3" "-" COEFFS 0. 65536. 0. 0. 0. 1. /end COMPU_METHOD
/begin COMPU_METHOD _CNV_R_R_Def_td_ub__574_CM "Def_td_ub_q0p1" RAT_FUNC "%6.3" "s" COEFFS 0. 10. 0. 0. 0. 1. /end COMPU_METHOD
/begin COMPU_METHOD _CNV_R_R_Def_f_ub_b_575_CM "Def_f_ub_b127p5" RAT_FUNC "%6.3" "%" COEFFS 0. 2. 0. 0. 0. 1. /end COMPU_METHOD
/begin COMPU_METHOD _CNV_R_R_Def_p_sw_q_576_CM "Def_p_sw_q0p039" RAT_FUNC "%6.3" "hPa" COEFFS 0. 256. 0. 0. 0. 10. /end COMPU_METHOD
/begin COMPU_METHOD _CNV_R_R_Def_t_sw_q_578_CM "Def_t_sw_q0p1" RAT_FUNC "%6.3" "°C" COEFFS 0. 10. 0. 0. 0. 1. /end COMPU_METHOD
/begin COMPU_METHOD _CNV_R_R_Def_t_sw_q_579_CM "Def_t_sw_q0p01" RAT_FUNC "%6.3" "°C" COEFFS 0. 100. 0. 0. 0. 1. /end COMPU_METHOD
/begin COMPU_METHOD _CNV_R_R_Def_u_sw_q_580_CM "Def_u_sw_q0p00488" RAT_FUNC "%6.3" "V" COEFFS 0. 1024. 0. 0. 0. 5. /end COMPU_METHOD
/begin COMPU_METHOD _CNV_R_R_Def_u_sw_b_581_CM "Def_u_sw_b128" RAT_FUNC "%6.3" "V" COEFFS 0. 256. 0. 0. 0. 1. /end COMPU_METHOD
/begin COMPU_METHOD _CNV_R_R_Def_u_sb_q_583_CM "Def_u_sb_q0p0942" RAT_FUNC "%6.3" "V" COEFFS 0. 1. 0. 0. 0. 9.420000000000001e-002 /end COMPU_METHOD
/begin COMPU_METHOD _CNV_R_R_Def_exwink_585_CM "Def_exwink_uw_q0p022" RAT_FUNC "%6.3" "°" COEFFS 0. 8192. 0. 0. 0. 180. /end COMPU_METHOD
/begin COMPU_METHOD _CNV_R_R_Def_f_ub_b_586_CM "Def_f_ub_b100" RAT_FUNC "%6.3" "%" COEFFS 0. 256. 0. 0. 0. 100. /end COMPU_METHOD
/begin COMPU_METHOD _CNV_R_R_Def_f_uw_b_588_CM "Def_f_uw_b32" RAT_FUNC "%6.3" "-" COEFFS 0. 65536. 0. 0. 0. 32. /end COMPU_METHOD
/begin COMPU_METHOD _CNV_R_R_Def_hub_uw_589_CM "Def_hub_uw_q0p001" RAT_FUNC "%6.3" "mm" COEFFS 0. 1000. 0. 0. 0. 1. /end COMPU_METHOD
/begin COMPU_METHOD _CNV_R_R_Def_f_uw_b_590_CM "Def_f_uw_b2" RAT_FUNC "%6.3" "-" COEFFS 0. 65536. 0. 0. 0. 2. /end COMPU_METHOD
/begin COMPU_METHOD _CNV_R_R_Def_ms_uw__594_CM "Def_ms_uw_q0p03125" RAT_FUNC "%6.3" "kg/h" COEFFS 0. 32. 0. 0. 0. 1. /end COMPU_METHOD
/begin COMPU_METHOD _CNV_R_R_Def_n_sw_q_595_CM "Def_n_sw_q1p0" RAT_FUNC "%6.3" "Upm" COEFFS 0. 1. 0. 0. 0. 1. /end COMPU_METHOD
/begin COMPU_METHOD _CNV_R_R_Def_rf_sw__598_CM "Def_rf_sw_q0p01" RAT_FUNC "%6.3" "%" COEFFS 0. 100. 0. 0. 0. 1. /end COMPU_METHOD
/begin COMPU_METHOD _CNV_R_R_Def_rk_sw__600_CM "Def_rk_sw_b1600" RAT_FUNC "%6.3" "%" COEFFS 0. 2048. 0. 0. 0. 100. /end COMPU_METHOD
/begin COMPU_METHOD _CNV_R_R_Def_kw_sw__603_CM "Def_kw_sw_q0p0234" RAT_FUNC "%6.3" "°KW" COEFFS 0. 256. 0. 0. 0. 6. /end COMPU_METHOD
/begin COMPU_METHOD _CNV_R_R_Def_zw_sw__604_CM "Def_zw_sw_q0p1" RAT_FUNC "%6.3" "°" COEFFS 0. 10. 0. 0. 0. 1. /end COMPU_METHOD
/begin COMPU_METHOD _CNV_R_R_Def_eta_sw_606_CM "Def_eta_sw_q0p00305" RAT_FUNC "%6.3" "%" COEFFS 0. 32767. 0. 0. 0. 100. /end COMPU_METHOD
/begin COMPU_METHOD _CNV_R_R_Def_i_ub_q_608_CM "Def_i_ub_q0p00125" RAT_FUNC "%6.3" "" COEFFS 0. 800. 0. 0. 0. 1. /end COMPU_METHOD
/begin COMPU_METHOD _CNV_R_R_Def_td_ub__609_CM "Def_td_ub_q0p05" RAT_FUNC "%6.3" "s" COEFFS 0. 20. 0. 0. 0. 1. /end COMPU_METHOD
/begin COMPU_METHOD _CNV_R_R_Def_td_ub__611_CM "Def_td_ub_q1" RAT_FUNC "%6.3" "s" COEFFS 0. 1. 0. 0. 0. 1. /end COMPU_METHOD
/begin COMPU_METHOD _CNV_R_R_Def_eta_uw_615_CM "Def_eta_uw_b200" RAT_FUNC "%6.3" "%" COEFFS 0. 65536. 0. 0. 0. 200. /end COMPU_METHOD
/begin COMPU_METHOD _CNV_R_R_Def_f_sw_b_616_CM "Def_f_sw_b2" RAT_FUNC "%6.3" "-" COEFFS 0. 65536. 0. 0. 0. 4. /end COMPU_METHOD
/begin COMPU_METHOD _CNV_R_R_Def_f_uw_b_617_CM "Def_f_uw_b64" RAT_FUNC "%6.3" "-" COEFFS 0. 65536. 0. 0. 0. 64. /end COMPU_METHOD
/begin COMPU_METHOD _CNV_R_R_Def_f_sw_b_620_CM "Def_f_sw_b0p1" RAT_FUNC "%6.3" "-" COEFFS 0. 655360. 0. 0. 0. 2. /end COMPU_METHOD
/begin COMPU_METHOD _CNV_R_R_Def_f_sw_b_623_CM "Def_f_sw_b64" RAT_FUNC "%6.3" "-" COEFFS 0. 32768. 0. 0. 0. 64. /end COMPU_METHOD
/begin COMPU_METHOD _CNV_R_R_Def_i_uw_q_630_CM "Def_i_uw_q0p125" RAT_FUNC "%6.3" "A" COEFFS 0. 8. 0. 0. 0. 1. /end COMPU_METHOD
/begin COMPU_METHOD _CNV_R_R_Def_u_ub_q_631_CM "Def_u_ub_q0p1" RAT_FUNC "%6.3" "V" COEFFS 0. 10. 0. 0. 0. 1. /end COMPU_METHOD
/begin COMPU_METHOD _CNV_R_R_Def_strv_u_636_CM "Def_strv_uw_b512" RAT_FUNC "%6.3" "1/m" COEFFS 0. 65536. 0. 0. 0. 512. /end COMPU_METHOD
/begin COMPU_METHOD _CNV_R_R_Def_i_sw_q_641_CM "Def_i_sw_q0p001" RAT_FUNC "%6.3" "A" COEFFS 0. 1000. 0. 0. 0. 1. /end COMPU_METHOD
/begin COMPU_METHOD _CNV_R_R_Def_i_ub_q_644_CM "Def_i_ub_q10" RAT_FUNC "%6.3" "A" COEFFS 0. 1. 0. 0. 0. 10. /end COMPU_METHOD
/begin COMPU_METHOD _CNV_R_R_Def_f_sb_b_647_CM "Def_f_sb_b0p125" RAT_FUNC "%6.3" "-" COEFFS 0. 1024. 0. 0. 0. 1. /end COMPU_METHOD
/begin COMPU_METHOD _CNV_R_R_Def_md_rel_651_CM "Def_md_rel_q0p1" RAT_FUNC "%6.3" "%" COEFFS 0. 10. 0. 0. 0. 1. /end COMPU_METHOD
/begin COMPU_METHOD _CNV_R_R_Def_lm_uw__654_CM "Def_lm_uw_q0p000444" RAT_FUNC "%6.3" "kg" COEFFS 0. 2250. 0. 0. 0. 1. /end COMPU_METHOD
/begin COMPU_METHOD _CNV_R_R_Def_ms_uw__656_CM "Def_ms_uw_q0p00039" RAT_FUNC "%6.3" "kg/h" COEFFS 0. 65536. 0. 0. 0. 25.6 /end COMPU_METHOD
/begin COMPU_METHOD _CNV_R_R_Def_n_sw_b_659_CM "Def_n_sw_b512" RAT_FUNC "%6.3" "rad/s" COEFFS 0. 32768. 0. 0. 0. 512. /end COMPU_METHOD
/begin COMPU_METHOD _CNV_R_R_Def_ngrd_s_661_CM "Def_ngrd_sb_q32p0" RAT_FUNC "%6.3" "Upm/s" COEFFS 0. 1. 0. 0. 0. 32. /end COMPU_METHOD
/begin COMPU_METHOD _CNV_R_R_Def_td_uw__663_CM "Def_td_uw_q0p001" RAT_FUNC "%6.3" "ms" COEFFS 0. 1000. 0. 0. 0. 1. /end COMPU_METHOD
/begin COMPU_METHOD _CNV_R_R_Def_tn_uw__664_CM "Def_tn_uw_q1" RAT_FUNC "%6.3" "min" COEFFS 0. 1. 0. 0. 0. 1. /end COMPU_METHOD
/begin COMPU_METHOD _CNV_R_R_Def_lf_ub__670_CM "Def_lf_ub_q0p01" RAT_FUNC "%6.3" "-" COEFFS 0. 100. 0. 0. 0. 1. /end COMPU_METHOD
/begin COMPU_METHOD _CNV_R_R_Def_td_uw__673_CM "Def_td_uw_q0p01" RAT_FUNC "%6.3" "s" COEFFS 0. 100. 0. 0. 0. 1. /end COMPU_METHOD
/begin COMPU_METHOD _CNV_R_R_Def_p_uw_q_676_CM "Def_p_uw_q0p0061" RAT_FUNC "%6.3" "MPa" COEFFS 0. 65536. 0. 0. 0. 40. /end COMPU_METHOD
/begin COMPU_METHOD _CNV_R_R_Def_p_ub_q_677_CM "Def_p_ub_q0p39" RAT_FUNC "%6.3" "Bar" COEFFS 0. 256. 0. 0. 0. 100. /end COMPU_METHOD
/begin COMPU_METHOD _CNV_R_R_Def_wdk_sw_683_CM "Def_wdk_sw_q0p0244" RAT_FUNC "%6.3" "%" COEFFS 0. 4096. 0. 0. 0. 100. /end COMPU_METHOD
/begin COMPU_METHOD _CNV_R_R_Def_rk_sw__702_CM "Def_rk_sw_b16" RAT_FUNC "%6.3" "-" COEFFS 0. 32768. 0. 0. 0. 16. /end COMPU_METHOD
/begin COMPU_METHOD _CNV_R_R_Def_ti_uw__714_CM "Def_ti_uw_q0p0128" RAT_FUNC "%6.3" "ms" COEFFS 0. 78.125 0. 0. 0. 1. /end COMPU_METHOD
/begin COMPU_METHOD _CNV_R_R_Def_v_uw_q_726_CM "Def_v_uw_q1p0" RAT_FUNC "%6.3" "km/h" COEFFS 0. 1. 0. 0. 0. 1. /end COMPU_METHOD
/begin COMPU_METHOD _CNV_R_R_Def_v_uw_q_727_CM "Def_v_uw_q0p1" RAT_FUNC "%6.3" "km/h" COEFFS 0. 10. 0. 0. 0. 1. /end COMPU_METHOD
/begin COMPU_METHOD _CNV_R_R_Def_kw_uw__734_CM "Def_kw_uw_q0p8_o128" RAT_FUNC "%6.3" "°KW" COEFFS 0. 1. 128. 0. 0. 0.8 /end COMPU_METHOD
/begin COMPU_METHOD _CNV_R_R_Def_exwink_736_CM "Def_exwink_ub_q0p703" RAT_FUNC "%6.3" "°" COEFFS 0. 256. 0. 0. 0. 180. /end COMPU_METHOD
/begin COMPU_METHOD _CNV_R_R_Def_zw_ub__738_CM "Def_zw_ub_q0p75" RAT_FUNC "%6.3" "°" COEFFS 0. -1. 0. 0. 0. 0.75 /end COMPU_METHOD
/begin COMPU_METHOD _CNV_R_R_Def_zk100m_772_CM "Def_zk100ms_ub_b25p6" RAT_FUNC "%6.3" "s" COEFFS 0. 0. 25.6 0. 1. 0. /end COMPU_METHOD
/begin RECORD_LAYOUT _REC_VAL_20_u1 FNC_VALUES 1 UBYTE COLUMN_DIR DIRECT /end RECORD_LAYOUT
/begin RECORD_LAYOUT _REC_AXS_20_u1 NO_AXIS_PTS_X 1 UBYTE AXIS_PTS_X 2 UBYTE INDEX_INCR DIRECT /end RECORD_LAYOUT
/begin RECORD_LAYOUT _REC_VAL_20_s2 FNC_VALUES 1 SWORD COLUMN_DIR DIRECT /end RECORD_LAYOUT
/begin RECORD_LAYOUT _REC_CUR_20_s2_u1 FNC_VALUES 1 SWORD COLUMN_DIR DIRECT /end RECORD_LAYOUT
/begin RECORD_LAYOUT _REC_CUR_TKL_UW_VV__s2_s2 NO_AXIS_PTS_X 1 UBYTE RESERVED 2 BYTE AXIS_PTS_X 3 SWORD INDEX_INCR DIRECT FNC_VALUES 4 SWORD COLUMN_DIR DIRECT /end RECORD_LAYOUT
/begin RECORD_LAYOUT _REC_CUR_TKL_UW_VV__S4_S4 NO_AXIS_PTS_X 1 UBYTE RESERVED 2 BYTE AXIS_PTS_X 3 FLOAT32_IEEE INDEX_INCR DIRECT FNC_VALUES 4 FLOAT32_IEEE COLUMN_DIR DIRECT /end RECORD_LAYOUT
/begin RECORD_LAYOUT _REC_VAL_20_S4 FNC_VALUES 1 FLOAT32_IEEE COLUMN_DIR DIRECT /end RECORD_LAYOUT
/begin FUNCTION KRANN ""
 /begin DEF_CHARACTERISTIC GAX_KHMOD GAX_KRMOD KL_CKH_NKW KL_CKH_RK KL_CKH_TANS KL_CKR_BA_IST KL_CKR_NKW KL_CKR_RK KL_CKR_TANS KL_CKR_TMOT KL_ETAKRFR KL_ETAKRSP KL_KFTKRMN KL_KFTKRMX KL_RKMIN_KH KL_RKMIN_KR KL_SKH_NKW KL_SKH_RK KL_SKH_TANS KL_SKR_BA_IST KL_SKR_NKW KL_SKR_RK KL_SKR_TANS KL_SKR_TMOT K_ANZ_ARBSP K_DWKRMNN K_EIN_KHNN K_EIN_KRANN K_ETAKHNEG K_ETAKHNEGHS K_ETAKHPOS K_ETAKHPOSHS K_KHNNMX K_KHNN_F K_KRANNMX K_KRZYKL_AUS K_MOD_KHNN K_MOD_KRANN K_NKRF K_TDSTEND K_TDSTEND_KH K_TMKHNN K_TMKHNNLRN K_TMKRANN K_TMKRANNLRN K_TUMG_OFF S_KHNNLERN S_KHNN_EIN S_KHNN_F S_KRANN S_KRANNLERN S_KRANNLL S_KRANN_KFTV S_KRVBADAP_HS /end DEF_CHARACTERISTIC
 /begin REF_CHARACTERISTIC CW_ZWDYN /end REF_CHARACTERISTIC
 /begin OUT_MEASUREMENT Arbsp_cnt Dzw_annm Dzw_anns Dzw_eps Dzw_krann Dzw_krann_hs Dzw_krann_vl Dzw_mm Dzw_nn Kh_sum Khnn Kr_kh Kr_kh_eps Krnn_test St_krann St_krann.B_khnnlern St_krann.B_nnlern St_krann_1000ms St_krann_1000ms.B_kftkr St_krann_seg St_krann_seg.B_krakt_hs St_krann_seg.B_krein St_krann_seg.B_krzykl_verz w_ba_ist w_bias w_kh_bias w_kh_nkw w_kh_rk w_kh_tans w_nkw w_rk w_tans w_tmot /end OUT_MEASUREMENT
 /begin IN_MEASUREMENT Ba_ist Nkw Rf_vl Rk_soll_kr Rk_soll_s Segakt St_bgkuppl1 St_bgkuppl1.B_ll St_kr St_kr.B_clradkr St_kr.B_krdws St_kr.B_krndy St_kr.B_zwkraa St_ll St_ll.B_llr_on St_mdbafak St_mdbafak.B_hmm_akt St_mdbafak.B_hom_akt St_mdbafak.B_hschicht St_mdbafak.B_la_stopp St_mdbafak.B_la_stopp1 St_mdbafak.B_la_stopp2 St_mdbafak.B_sch_akt St_mdbafak.B_schicht St_pwf St_pwf.B_pwf St_start St_start.B_jumpstart St_start.B_sta St_start.B_start St_start.B_startende St_start.B_wst St_zwaus St_zwaus.B_zwmin_hs Tans Tmot Tumg V /end IN_MEASUREMENT
/end FUNCTION
/begin FUNCTION UNKNOWN "" /begin SUB_FUNCTION LAYER SS_EXP /end SUB_FUNCTION /end FUNCTION
/begin FUNCTION LAYER ""
 /begin OUT_MEASUREMENT A_quer Acfzgl Acfzgq Agrpos Agrpos_i Ba_ist_ewp Batt_class Batt_coort Baw_katman1 Baw_katman2 Baw_tester Bordnetz Bosanfsgbd Bosbtvfbkt Bosfxid2r Bosid2r Bosjzielr Bosjzielt Bosmzielr Bosmzielt Bosprog2r Bosprog2t Bosrlsmr Bosrlsmt Bosrw2r Bosrw2t Bosun Bosunt Bosv Bsdcontrol Bsddata Bsdgencv Bsdgenregv Bsdregadr D_la_sa1 D_la_sa2 Dfgrob Dfsiggen Disa_ist Dm_ab_fws Dpsr Dpsr_seg Drfkh_s Dwesb3_kh_s Dwese2_kh_h Dzw_agr_kor Dzw_kh_s Dzw_kr Dzw_mkr Eco_max_i Eco_msb Eco_mz Eco_timo Eta_zyl_aus Eta_zylausbas F_grad_katalt F_katalt F_katalt_tabg F_lakor1 F_lakor2 F_lrad_in1 F_lrad_in2 F_start F_vst F_wnwkhk_sw Fahrzeug Fetrawe Fho Ftbr Gangi Gen_manufak Gen_typkenn I_eff_gs Id_bosrst Id_bosrtt Id_bosrtw Ierr Ierr_grenz_ext Ierrfgrenz Ikurz_ogr Ikurz_ugr Ipm_typ_fp Ipm_typ_mdkw Iwakeupgr Km_st Km_st_1 Kvaverbr L_pwmout La_bszuli1 La_bszuli2 La_desu1 La_desu2 La_desu_kh1 La_desu_kh2 La_es La_kh1 La_kh2 La_pruef1 La_pruef2 La_puls1 La_puls2 La_rgn1 La_rgn2 La_rgn_rpu1 La_rgn_rpu2 La_soll_tester Lam_son1 Lam_son2 Lur Md_anfhi Md_getriebe Md_kupp_schalt Md_na_ac Md_na_ars Md_na_defrost Md_na_ef Md_na_efmax Md_na_efprae Md_na_efsoll Md_na_el Md_na_ewapu Md_na_mlad Md_na_sl Md_na_sls Md_na_thermo Md_rad_asrl Md_rad_asrs Md_rad_msrl Md_rad_msrs Md_rad_soll Md_res_anfhi Mdi_accl_plus Mdi_accs_plus Mdi_asr_l Mdi_asr_s Mdi_fsb Mdi_gsl_minus Mdi_gsl_plus Mdi_gss_minus Mdi_gss_plus Mdi_katschutz Mdi_llrad Mdi_llri Mdi_llrp Mdi_llrzw Mdi_msr_l Mdi_msr_s Mdi_nmax Mdi_pmax Mdi_res_ac Mdi_res_afs Mdi_res_gs Mdi_res_heiz Mdi_res_kh Mdi_res_llmn Mdi_res_llmx Mdi_res_sl Mdi_res_st Mdi_res_tev Mdi_siko_l Mdi_siko_s Mdi_smgl_minus Mdi_smgl_plus Mdi_smgs_minus Mdi_smgs_plus Mdi_vmax Mdk_ist_lm Mdk_kupp_verl Mdr_fgr Ms_sl Mshfm_ist Mshfm_ist_i Mslui Mste N_idlms N_rad_hl N_rad_hr N_rad_vl N_rad_vr N_schalt_dkg Nelueft_klima Nelueft_lenk Nkw Nkw_grad Nkw_soll Nkw_zahn Nmax_var Nsllm Nstat Nturb Nwa1_pos Nwa1_time Nwa2_pos Nwa2_time Nwe Nwe1_pos Nwe1_time Nwe2_pos Nwe2_time Oz_lf1c Oz_lf2c Oz_nivr Oz_permr Oz_status Oz_tempr P_rail_kh Pbrems Pmrestore Pmsv Prail2_ist Prail_ist Prio_katman1 Prio_katman2 Ps_abs Ps_abs_i Ps_abs_i_j Ps_abs_t100_i Pu Pvagr Pvagr_i Pvdkds Pvdkds_i Pvdkds_i_j Pvdkds_t100_i Pwg_ist Qs_anf_klima Qv_cdherst_1 Qv_cdherst_2 Qv_cdherst_3 Qv_cdherst_4 Qv_cdherst_5 Qv_cdherst_6 Qv_cdherst_7 Qv_cdherst_8 Rk2_kh_h Rk3_kh_s Rk_1 Rk_2 Rk_add_ad1 Rk_add_ad2 Rktev Seg5z Segakt St_abgasklappe St_abgasklappe.B_abgasklappe St_agr St_agr.B_agr_ktrl St_anf_prail St_anf_prail.B_aprail_hom St_anf_prail.B_aprail_ndnotl St_anf_prail.B_prail_h St_anf_prail.B_prailvcv_h St_anf_prail.B_prailvfd_h St_anman1 St_anman1.B_ldm_ena St_anman1.B_ldm_nofil St_anman1.B_nosa St_ba St_ba.B_ase_abgas St_ba.B_ase_kat St_ba.B_vb_hmm St_ba.B_vb_sch St_bls St_bls.B_bls St_blsdisa1 St_blsdisa1.B_disa_akt St_btvns St_btvns.B_btvsa St_btvns.B_btvsa2 St_btvns.B_btvse St_btvns.B_btvse2 St_ckl15 St_ckl15.B_ckl30 St_ckl15.B_ckl50 St_clc St_clc.B_hmm_clc St_clc.B_sch_clc St_cybl St_cybl.B_gl_ad St_cybl.B_gl_adder St_cybl.B_gl_adz St_cybl.B_gl_faker St_cybl.B_gl_hz St_cybl.B_gl_wg1 St_cybl.B_gl_wg2 St_cybl.B_gl_zsk St_cybl.B_gl_zsw St_cybl.B_gl_zswz St_desul St_desul.B_desu_fett St_desul.B_desu_puls St_desul.B_desul_akt St_devxdetec St_devxdetec.B_dev0detec St_devxdetec.B_dev1detec St_devxdetec.B_dev2detec St_devxdetec.B_dev3detec St_devxdetec.B_dev4detec St_devxdetec.B_dev5detec St_devxdetec.B_dev6detec St_devxdetec.B_dev7detec St_dk_diag St_dk_diag.B_dk2err_2pot St_dk_diag.B_dkerr_2pot St_dk_diag.B_nlf St_dk_diag.B_ska St_dkg St_dkg.B_schalt_dkg St_dkheiz St_dkratio St_dkratio.B_dkratio_h St_dsc_mradsoll St_dtev St_dtev.B_dtev_aktiv St_ecostat1 St_ecostat1.B_ecojob1 St_ecostat1.B_ecojob2 St_egs St_egs.B_egs_khl1 St_egs.B_egs_khl2 St_egs.B_fs St_ekp St_ekp.B_dkpu St_elu St_elu.B_elu600 St_fas_mradsoll St_fdc St_fdc.B_sport St_fzg_1 St_fzg_2 St_fzg_ass St_gen_ext St_gen_ext.B_gen_ext St_gen_ext.B_ierr_ext St_gen_ext.B_loadre_ext St_genallg St_genallg.B_abliactiv St_genallg.B_bsdprot1 St_genallg.B_bsdprot2 St_genallg.B_iliactiv St_genallg.B_rd_gentyp St_generator St_generator.B_crashgen St_generator.B_genactiv St_generator.B_genfbsd St_generator.B_genfel St_generator.B_genfht St_generator.B_genfme St_genll St_genll.B_lrfoff St_genll.B_lrreg1ak St_gentester St_gentester.B_gentestanf St_getrdaten St_getrdaten.B_gangwechsel_gs St_getrdaten.B_keinhs_gs St_getriebe St_getriebe.B_autget St_gglsu2 St_gglsu2.B_sbblsu St_gglsu2.B_sbblsu2 St_igrin St_igrin.B_fe St_igrin.B_fetrawedeak St_igrin.B_tra St_igrin.B_we St_igrinnv St_igrinnv.B_cdigronw St_igrinnv.B_cdxenonw St_igrinnv.B_diagigr St_katueb St_katueb.B_kathom St_katueb.B_nk_hom St_katueb.B_rgnkat St_katueb.B_rgnkat_hla1 St_kl15 St_kl15.B_kl15_ep St_kl15.B_kl15_vorab St_klopfen St_klopfen.B_klopfen St_kr St_kr.B_clradkr St_kr.B_krdws St_kr.B_krndy St_kr.B_zwkraa St_kr1 St_kr1.B_krakt St_ksdiag St_ksdiag.B_tstkvs St_kupp_dkg St_kupp_smg St_la_rpu St_la_rpu.B_largnrpu1 St_la_rpu.B_largnrpu2 St_la_rpu.B_noxrpu St_lam_ad_1 St_lam_ad_1.B_lrad_akt1 St_lam_ad_2 St_lam_ad_2.B_lrad_akt2 St_lamson St_lamson.B_lamson_ok1 St_lamson.B_lamson_ok2 St_lklps St_lklps.B_lklps_ln St_lklps.B_lklps_ln1 St_ll St_ll.B_llr_on St_mdpruef St_mdpruef.B_mdpruef St_mdpruef.B_mdpruef_akt St_mkwchn St_mkwchn.B_kwdreht St_motzustd St_motzustd.B_ll_roh St_motzustd.B_vl St_oz St_oz.B_anhang St_oz.B_ozfbsd St_oz_i St_oz_i.B_td_og St_oz_i.B_td_ogok St_oz_i.B_toel St_pmi St_pmi.B_fabttreg St_pmi.B_fahisrst St_pmi.B_pmrestore St_pmi_nv St_pmi_nv.B_fapmmess St_pmi_nv.B_ulcp St_poel St_poel.B_poel St_pruef St_pruef.B_pruef1 St_pruef.B_pruef2 St_pwf St_pwf.B_pwf St_sawe St_sawe.B_sa St_sawe.B_sae St_sawe.B_safast St_sk St_sk.B_sk_homla1 St_slp St_slp.B_fasls St_slp.B_genslp St_sls St_sls.B_sls St_start St_start.B_jumpstart St_start.B_sta St_start.B_start St_start.B_startende St_start.B_wst St_szboost St_szboost.B_kath St_tank St_tank.B_taleer St_tevanst St_tevanst.B_tev_zu St_tevein St_tevein.B_te St_tevein.B_te_la1 St_tevein.B_teblg St_tevein.B_tev_erf St_ti St_ti.B_dosp_akt St_tp St_tp.B_atm_tpvk St_tp.B_atm_tpvk1 St_tp.B_atm_tpvk2 St_tum St_tum.B_tumers St_vbrzyl_ein St_vbrzyl_ein.B_lamzylact_1 St_vbrzyl_ein.B_lamzylact_2 St_vbrzyl_ein.B_lurzylact St_vsa3 St_wk St_wm St_wm.B_hz St_wm.B_korel St_wm.B_lklps_kl1 St_wm.B_lklps_kl2 St_wm.B_nkmtemp St_zwbts St_zwbts.B_atm_tpnk1 St_zwbts.B_atm_tpnk2 St_zwbts.B_bsakt_zuli1 St_zwbts.B_bsakt_zuli2 St_zwgemad St_zwgemad.B_zwgemad_1 St_zwgemad.B_zwgemad_2 St_zwktibs St_zwktibs.B_ibsactiv St_zylab St_zylab.B_zylab1 St_zylab.B_zylab2 Status_kwnot Status_kwnot.B_kwnotl Status_tev T_jahr T_monate T_tag Tabg_sens1 Tabg_sens2 Tabg_sensturb1 Tabg_sensturb2 Tans Tans_i Tchip Td_f_ierr Td_og_cnt Td_og_icnt Td_og_tk Td_og_tr Td_og_tv Td_og_uplcnt Td_rdgenreg2 Tget Ti_1_homext Ti_2_homext Tka Tkat_mod Tlrfgen Tlrgen_ext Tmot Tmot_abstell Tmot_start Tn_abstell Tn_abstellm Tn_start_10 Toel_getr Toel_mdl Tsg Tumg Tumg_can Tvld Tvld_i U_fgen U_gen_ext U_gensollpm Ub Ulams_1 Ulams_2 Uregnom V V_can V_krapu Verbstatus Vsa2_adp_ext Vsa_adp_ext Vsa_btsoll Vsa_sprs_kh Vse2_adp_ext Vse_adp_ext Vse_btsoll Vse_sprs_kh W_afs W_dafs W_ub Wdk_ist Wdk_ist_i Wesb1kh_h Wese Zr_auss_b Zr_auss_suma Zr_auss_sumb Zr_seg_nstart Zrbosr Zrbosrt Ztageabs Zw_md Zyl_akt /end OUT_MEASUREMENT
/end FUNCTION
/begin FUNCTION SS_EXP "" /begin DEF_CHARACTERISTIC K_ETA_MIN K_MDK_EXT_MINUS K_MDK_EXT_PLUS /end DEF_CHARACTERISTIC
 /begin OUT_MEASUREMENT Agr_rate Agr_soll Agrpos_soll Agrpos_soll_i Ba_switch_uek Ctrpwrentl Dpfregst Eta_zw_ist_novbr Eta_zw_ve Exwink2_ist Exwink_ist Exwinkkor Exwinkkor_ist2 F_sicher_rf F_sst F_teblg La_ber Md_na_ext Mdi_ist Mdi_ist_m Mdi_soll_kdyn Mdi_soll_kdync Mdk_ext_minus Mdk_ext_plus Mdk_ist Minhub Mrnn_test_dk_i Mrnn_test_pr_i Msagr Msagr_i Msainfo Prail2_soll Ps_abs_t100 Ptc_entl Pvdkds_t100 Rf2_ig_ist Rf_ig_ist Rf_ig_ist_i Rfv_vns_i Segkorroff Segkorron Spa_art Spa_art_2 Spa_gang St_auss St_auss.B_auss_b1 St_blsdisa2 St_blsdisa2.B_disa1_auf St_blsdisa2.B_disa2_auf St_blsdisa2.B_disa_hys St_bv_kath St_bv_kath.B_hsplit_akt St_bv_kath.B_nesps_akt St_dsc_mradist St_dvvt0 St_dvvt0.B_btvvta_ena St_dvvt1 St_dvvt1.B_vvtnotl St_eisy_agrreg St_eisy_agrreg.B_agrreg_akt St_fas_mradist St_gl_adapt St_hubkor St_hubkor.B_hubkor St_hubkor_5ms St_hubkor_5ms.B_hubistkor St_kath_anf1 St_khm St_khm.B_khm_h St_khm.B_khm_hs St_khm.B_khm_s St_mdaddon St_mdaddon.B_mdao_all St_mdssm St_mdssm.B_schalt_ldm St_minhubad St_minhubad.B_minhubvs St_minhubad0 St_minhubad0.B_dtes St_minhubad0.B_mdarv St_minhubad2 St_minhubad2.B_tdfba2 St_msaa St_msaanz St_msaanz.B_msanakt St_msabs St_msabs.B_msastarts St_msabs.B_msastops St_msae St_msae.B_mhauf1 St_msae.B_msastopt St_nmax_ba St_nmax_ba.B_nmax_ba_cc St_pmentl0 St_pmentl0.B_ent4frei St_pmentl0.B_pwrentl St_pr St_pr.B_prsoll_h St_sa St_sa.B_ums_vbsa St_spa2 St_spa2.B_gang_rueck St_spa2.B_spa_cist St_spa2.B_spa_csoll St_tan St_tan.B_taners St_ttfuelcut St_ttfuelcut.B_ttfuelcut_akt St_ubw St_ubw.B_ubw_ulow St_ugenkor0 St_ugenkor0.B_genoff St_ugenkor0.B_verb_off St_ugenkor1 St_ugenkor1.B_gentoggl St_varkat St_varkat.B_varkat St_vbrzyl_aus St_vbrzyl_aus.B_ext_zylstop St_vrkoor_seg St_vrkoor_seg.B_vraus St_vrkoor_seg.B_vrkor St_vvtlr St_vvtlr.B_vvtad Tvulv2 U_gen2 Var_atm Vvtaet Wdk2_diag Wdk_diag_i Wkrm Zr_ausszyk_b4 Zrbk_auss_a Zrbkmx_auss_a Zrmx_auss_a Zrmx_auss_b1 Zrmx_auss_b4 Zw_nokr Zw_offkorrvr Zw_out_mw Zw_out_mw_novbr Zw_out_mwbk Zw_soll_can /end OUT_MEASUREMENT
 /begin IN_MEASUREMENT Mrnn_test_dk Mrnn_test_pr Prail_soll Ps_abs_i Ps_abs_i_j Ps_abs_t100_i Pvdkds_i Pvdkds_i_j Pvdkds_t100_i Pwg_ist Pwg_ist_kor Pwg_max Rfv_vns Tvulv /end IN_MEASUREMENT
/end FUNCTION
/begin FUNCTION mdba_38_42_ "" /begin SUB_FUNCTION MDBAFAK MDBANL MDBAPRIO /end SUB_FUNCTION /end FUNCTION
/end MODULE
/end PROJECT
