ASAP2_VERSION 1 41
/begin PROJECT MSD85 "Spray Guided DI-System with Piezo Injectors for 8-Cylinder"
/begin HEADER "_default_HeaderComment" PROJECT_NO _91 /end HEADER
/begin MODULE _default_ModuleName "_default_ModuleLongIdentifier"
/begin MOD_COMMON "_default_ModCommonComment" DEPOSIT ABSOLUTE BYTE_ORDER MSB_LAST ALIGNMENT_BYTE 1 ALIGNMENT_WORD 2 ALIGNMENT_LONG 2 ALIGNMENT_FLOAT32_IEEE 2 ALIGNMENT_FLOAT64_IEEE 4 /end MOD_COMMON
/begin AXIS_PTS ldpm_mff_post_inj_1_extc "" 0xa0805958 online_dummy _REC_AXS_20_u2 1389. _CNV_A_R_LINEAR_____111_CM 6 0. 1389. FORMAT "%7.2" /end AXIS_PTS
/begin AXIS_PTS ldpm_temp_cat_dif_ch_l_1_extc "" 0xa0805aac temp_cat_dif_ch_l _REC_AXS_20_u2 2047.96875 _CNV_A_R_LINEAR_____781_CM 6 -1024. 1023.96875 FORMAT "%11.5" /end AXIS_PTS
/begin AXIS_PTS ldpm_temp_cat_dif_ch_l_2_extc "" 0xa0805abc temp_cat_dif_ch_l _REC_AXS_20_u2 2047.96875 _CNV_A_R_LINEAR_____781_CM 4 -1024. 1023.96875 FORMAT "%11.5" /end AXIS_PTS
/begin AXIS_PTS ldpm_tnt_dif_ch_l_1_extc "" 0xa0805ac8 tnt_dif_ch_l _REC_AXS_20_u2 2047.96875 _CNV_A_R_LINEAR_____781_CM 6 -1024. 1023.96875 FORMAT "%11.5" /end AXIS_PTS
/begin AXIS_PTS ldpm_tnt_dif_ch_l_2_extc "" 0xa0805ad8 tnt_dif_ch_l _REC_AXS_20_u2 2047.96875 _CNV_A_R_LINEAR_____781_CM 4 -1024. 1023.96875 FORMAT "%11.5" /end AXIS_PTS
/begin AXIS_PTS ldpm_fac_maf_rel_egr_cor_1_extc "" 0xa08058d4 fac_maf_rel_egr_cor _REC_AXS_20_u2 300. _CNV_A_R_LINEAR_____226_CM 10 0. 300. FORMAT "%5.1" /end AXIS_PTS
/begin AXIS_PTS ldpm_n_1_extc "" 0xa0805988 n _REC_AXS_20_u2 8160. _CNV_A_R_LINEAR_____14_CM 16 0. 8160. FORMAT "%4.0" /end AXIS_PTS
/begin AXIS_PTS ldpm_t_ast_1_extc "IVVT   strategy request for after start catalyst heating with single injection" 0xa0805a34 t_ast _REC_AXS_20_u2 6553.5 _CNV_A_R_LINEAR_____4_CM 8 0. 6553.5 FORMAT "%6.1" /end AXIS_PTS
/begin AXIS_PTS ldpm_mff_sp_mv_1_extc "" 0xa0805968 mff_sp_mv _REC_AXS_20_u2 1389. _CNV_A_R_LINEAR_____111_CM 6 0. 1389. FORMAT "%7.2" /end AXIS_PTS
/begin AXIS_PTS ldpm_mff_sp_mv_2_extc "" 0xa0805978 mff_sp_mv _REC_AXS_20_u2 1389. _CNV_A_R_LINEAR_____111_CM 6 0. 1389. FORMAT "%7.2" /end AXIS_PTS
/begin AXIS_PTS ldpm_n_32_6_extc "" 0xa08059e2 n_32 _REC_AXS_20_u1 8160. _CNV_A_R_LINEAR_____10_CM 6 0. 8160. FORMAT "%4.0" /end AXIS_PTS
/begin AXIS_PTS ldpm_n_32_2_extc "" 0xa08059ca n_32 _REC_AXS_20_u1 8160. _CNV_A_R_LINEAR_____10_CM 6 0. 8160. FORMAT "%4.0" /end AXIS_PTS
/begin AXIS_PTS ldpm_ctr_km_can_1_extc "Threshold of time after start for catalyst heating after start" 0xa08058c8 ctr_km_can _REC_AXS_20_u2 655350. _CNV_A_R_LINEAR_____58_CM 4 0. 655350. FORMAT "%6.0" /end AXIS_PTS
/begin AXIS_PTS ldpm_tco_st_5_extc "" 0xa0805aa2 tco_st _REC_AXS_20_u1 190.5 _CNV_A_R_LINEAR_____17_CM 6 -48. 142.5 FORMAT "%6.2" /end AXIS_PTS
/begin AXIS_PTS ldpm_n_2_extc "" 0xa08059ac n _REC_AXS_20_u2 8160. _CNV_A_R_LINEAR_____14_CM 10 0. 8160. FORMAT "%4.0" /end AXIS_PTS
/begin AXIS_PTS ldpm_fac_maf_rel_egr_cor_4_extc "" 0xa080591c fac_maf_rel_egr_cor _REC_AXS_20_u2 300. _CNV_A_R_LINEAR_____226_CM 10 0. 300. FORMAT "%5.1" /end AXIS_PTS
/begin AXIS_PTS ldpm_n_4_extc "" 0xa0805a18 n _REC_AXS_20_u2 8160. _CNV_A_R_LINEAR_____14_CM 8 0. 8160. FORMAT "%4.0" /end AXIS_PTS
/begin AXIS_PTS ldpm_n_3_extc "" 0xa0805a04 n _REC_AXS_20_u2 8160. _CNV_A_R_LINEAR_____14_CM 8 0. 8160. FORMAT "%4.0" /end AXIS_PTS
/begin AXIS_PTS ldpm_fac_maf_rel_egr_cor_2_extc "" 0xa08058ec fac_maf_rel_egr_cor _REC_AXS_20_u2 300. _CNV_A_R_LINEAR_____226_CM 10 0. 300. FORMAT "%5.1" /end AXIS_PTS
/begin AXIS_PTS ldpm_fac_maf_rel_egr_cor_3_extc "" 0xa0805904 fac_maf_rel_egr_cor _REC_AXS_20_u2 300. _CNV_A_R_LINEAR_____226_CM 10 0. 300. FORMAT "%5.1" /end AXIS_PTS
/begin AXIS_PTS ldpm_tco_6_extc "IVVT   strategy request for after start catalyst heating with single injection" 0xa0805a90 tco _REC_AXS_20_u1 190.5 _CNV_A_R_LINEAR_____17_CM 8 -48. 142.5 FORMAT "%6.2" /end AXIS_PTS
/begin AXIS_PTS ldpm_t_ast_6_extc "IVVT   strategy request for after start catalyst heating with single injection" 0xa0805a70 t_ast _REC_AXS_20_u2 6553.5 _CNV_A_R_LINEAR_____4_CM 8 0. 6553.5 FORMAT "%6.1" /end AXIS_PTS
/begin MEASUREMENT state_ch_mod_ast "Catlyst heating strategy" UBYTE _CNV_S_5_EXTC_RANGE_782_CM 1 100. 0. 4. DISPLAY_IDENTIFIER STATE_CH_MOD_AST ECU_ADDRESS 0xd00075eb /end MEASUREMENT
/begin CHARACTERISTIC c_n_max_mplh_ch_ast "Maximum engine speed for catalyst heating in homogeneous mode with dual injection" VALUE 0xa0805f5c _REC_VAL_20_u1 8160. _CNV_A_R_LINEAR_____10_CM 0. 8160. DISPLAY_IDENTIFIER C_N_MAX_MPLH_CH_AST FORMAT "%4.0" /end CHARACTERISTIC
/begin CHARACTERISTIC c_n_min_mplh_ch_ast "Minimum engine speed for catalyst heating in homogeneous mode with dual injection" VALUE 0xa0805f5e _REC_VAL_20_u1 8160. _CNV_A_R_LINEAR_____10_CM 0. 8160. DISPLAY_IDENTIFIER C_N_MIN_MPLH_CH_AST FORMAT "%4.0" /end CHARACTERISTIC
/begin CHARACTERISTIC c_tqi_min_mplp_ch_ast "Minimum of indicated torque request for catalyst heating with post injection" VALUE 0xa0805fac _REC_VAL_20_s2 2047.96875 _CNV_A_R_LINEAR_____31_CM -1024. 1023.96875 DISPLAY_IDENTIFIER C_TQI_MIN_MPLP_CH_AST FORMAT "%11.5" /end CHARACTERISTIC
/begin CHARACTERISTIC c_n_min_mplp_ch_ast "Minimum engine speed for catalyst heating in stratified mode with post injection" VALUE 0xa0805f5f _REC_VAL_20_u1 8160. _CNV_A_R_LINEAR_____10_CM 0. 8160. DISPLAY_IDENTIFIER C_N_MIN_MPLP_CH_AST FORMAT "%4.0" /end CHARACTERISTIC
/begin CHARACTERISTIC c_n_max_mplp_ch_ast "Maximum engine speed for catalyst heating in stratified mode with post injection" VALUE 0xa0805f5d _REC_VAL_20_u1 8160. _CNV_A_R_LINEAR_____10_CM 0. 8160. DISPLAY_IDENTIFIER C_N_MAX_MPLP_CH_AST FORMAT "%4.0" /end CHARACTERISTIC
/begin CHARACTERISTIC c_tqi_max_mplp_ch_ast "Maximum of indicated torque request for catalyst heating with post injection" VALUE 0xa0805faa _REC_VAL_20_s2 2047.96875 _CNV_A_R_LINEAR_____31_CM -1024. 1023.96875 DISPLAY_IDENTIFIER C_TQI_MAX_MPLP_CH_AST FORMAT "%11.5" /end CHARACTERISTIC
/begin AXIS_PTS ldp_t_ast_id_ch_mod_bas "" 0xa0805800 t_ast _REC_AXS_20_u2 6553.5 _CNV_A_R_LINEAR_____4_CM 8 0. 6553.5 FORMAT "%6.1" /end AXIS_PTS
/begin AXIS_PTS ldp_tco_st_id_ch_mod_bas "" 0xa0805838 tco_st _REC_AXS_20_u1 190.5 _CNV_A_R_LINEAR_____17_CM 8 -48. 142.5 FORMAT "%6.2" /end AXIS_PTS
/begin CHARACTERISTIC id_ch_mod_bas "Basic catalyst heating strategy" MAP 0xa0805b20 _REC_MAP_20_u1_u2_u1 3. _CNV_A_R_LINEAR_____0_CM 0. 3. DISPLAY_IDENTIFIER ID_CH_MOD_BAS FORMAT "%1.0"
 /begin AXIS_DESCR COM_AXIS t_ast _CNV_A_R_LINEAR_____4_CM 8 0. 6553.5 FORMAT "%6.1" AXIS_PTS_REF ldp_t_ast_id_ch_mod_bas /end AXIS_DESCR
 /begin AXIS_DESCR COM_AXIS tco_st _CNV_A_R_LINEAR_____17_CM 8 -48. 142.5 FORMAT "%6.2" AXIS_PTS_REF ldp_tco_st_id_ch_mod_bas /end AXIS_DESCR
/end CHARACTERISTIC
/begin MEASUREMENT state_ch_mod_req_ast "State of requested after start catalyst heating strategy, 1st priority" UBYTE _CNV_S_5_EXTC_RANGE_782_CM 1 100. 0. 4. DISPLAY_IDENTIFIER STATE_CH_MOD_REQ_AST ECU_ADDRESS 0xd00075f0 /end MEASUREMENT
/begin CHARACTERISTIC c_vs_max_mplp_ch_ast "Threshold of vehicle speed for catalyst heating with post injection" VALUE 0xa0805fb5 _REC_VAL_20_u1 255. _CNV_A_R_LINEAR_____6_CM 0. 255. DISPLAY_IDENTIFIER C_VS_MAX_MPLP_CH_AST FORMAT "%3.0" /end CHARACTERISTIC
/begin MEASUREMENT lv_ch_ast_mplp_cdn "Indicates if conditions for after start catalyst heating with post injection in stratified are fulfilled" UBYTE _CNV_S_2_RANGE__0___1_CM 1 100. 0. 1. DISPLAY_IDENTIFIER LV_CH_AST_MPLP_CDN ECU_ADDRESS 0xd00075e0 /end MEASUREMENT
/begin MEASUREMENT lv_ch_ast_mplh_cdn "Indicates if conditions for after start catalyst heating with multiple injection in homogenous are fulfilled" UBYTE _CNV_S_2_RANGE__0___1_CM 1 100. 0. 1. DISPLAY_IDENTIFIER LV_CH_AST_MPLH_CDN ECU_ADDRESS 0xd00075df /end MEASUREMENT
/begin CHARACTERISTIC c_ch_mod_man "Manual setting of catalyst heating strategy" VALUE 0xa0805f3c _REC_VAL_20_u1 4. _CNV_S_5_EXTC_RANGE_783_CM 0. 4. DISPLAY_IDENTIFIER C_CH_MOD_MAN /end CHARACTERISTIC
/begin CHARACTERISTIC lc_ch_mod_man_act "Activation of manual setting of catalyst heating strategy" VALUE 0xa0805fb7 _REC_VAL_20_u1 1. _CNV_S_2_RANGE__0___1_CM 0. 1. DISPLAY_IDENTIFIER LC_CH_MOD_MAN_ACT /end CHARACTERISTIC
/begin CHARACTERISTIC c_t_min_pv_thd_mplh_ch_deac "Minimum time to deactivate MPLH_CH after exceeded pedal value" VALUE 0xa0805f6e _REC_VAL_20_u2 6553.5 _CNV_A_R_LINEAR_____4_CM 0. 6553.5 DISPLAY_IDENTIFIER C_T_MIN_PV_THD_MPLH_CH_DEAC FORMAT "%6.1" /end CHARACTERISTIC
/begin AXIS_PTS ldp_tco_st_ip_pv_thd_mplh_ch "" 0xa0805854 tco_st _REC_AXS_20_u1 190.5 _CNV_A_R_LINEAR_____17_CM 8 -48. 142.5 FORMAT "%6.2" /end AXIS_PTS
/begin CHARACTERISTIC ip_pv_thd_mplh_ch_ast "Pedal value threshold for multiple injection in homogeneous for after start catalyst heating" CURVE 0xa0805ec4 _REC_CUR_20_u2_u1 99.99825000000001 _CNV_A_R_LINEAR_____784_CM 0. 99.99825 DISPLAY_IDENTIFIER IP_PV_THD_MPLH_CH_AST FORMAT "%6.2"
 /begin AXIS_DESCR COM_AXIS tco_st _CNV_A_R_LINEAR_____17_CM 8 -48. 142.5 FORMAT "%6.2" AXIS_PTS_REF ldp_tco_st_ip_pv_thd_mplh_ch /end AXIS_DESCR
/end CHARACTERISTIC
/begin MEASUREMENT lv_ch_ast_cdn "Indicator for conditions of catalyst heating after start" UBYTE _CNV_S_2_RANGE__0___1_CM 1 100. 0. 1. DISPLAY_IDENTIFIER LV_CH_AST_CDN ECU_ADDRESS 0xd00075de /end MEASUREMENT
/begin AXIS_PTS ldp_tco_st_ip_t_es_thd_ch_ast "" 0xa080586c tco_st _REC_AXS_20_u1 190.5 _CNV_A_R_LINEAR_____17_CM 8 -48. 142.5 FORMAT "%6.2" /end AXIS_PTS
/begin AXIS_PTS ldp_tco_st_ip_t_ast_thd_ch_ast "" 0xa0805860 tco_st _REC_AXS_20_u1 190.5 _CNV_A_R_LINEAR_____17_CM 8 -48. 142.5 FORMAT "%6.2" /end AXIS_PTS
/begin CHARACTERISTIC ip_t_es_thd_ch_ast "Threshold of engine off duration time which stops catalyst heating after start" CURVE 0xa0805f2c _REC_CUR_20_u2_u1 65535. _CNV_A_R_LINEAR_____84_CM 0. 65535. DISPLAY_IDENTIFIER IP_T_ES_THD_CH_AST FORMAT "%5.0"
 /begin AXIS_DESCR COM_AXIS tco_st _CNV_A_R_LINEAR_____17_CM 8 -48. 142.5 FORMAT "%6.2" AXIS_PTS_REF ldp_tco_st_ip_t_es_thd_ch_ast /end AXIS_DESCR
/end CHARACTERISTIC
/begin CHARACTERISTIC ip_t_ast_thd_ch_ast "Threshold of time after start for catalyst heating after start" MAP 0xa0805eec _REC_MAP_20_u2_u1_u2 6553.5 _CNV_A_R_LINEAR_____4_CM 0. 6553.5 DISPLAY_IDENTIFIER IP_T_AST_THD_CH_AST FORMAT "%6.1"
 /begin AXIS_DESCR COM_AXIS tco_st _CNV_A_R_LINEAR_____17_CM 8 -48. 142.5 FORMAT "%6.2" AXIS_PTS_REF ldp_tco_st_ip_t_ast_thd_ch_ast /end AXIS_DESCR
 /begin AXIS_DESCR COM_AXIS ctr_km_can _CNV_A_R_LINEAR_____58_CM 4 0. 655350. FORMAT "%6.0" AXIS_PTS_REF ldpm_ctr_km_can_1_extc /end AXIS_DESCR
/end CHARACTERISTIC
/begin MEASUREMENT state_ch "state of catalyst heating" UBYTE _CNV_S_4_STATE_CH_785_CM 1 100. 0. 3. DISPLAY_IDENTIFIER STATE_CH ECU_ADDRESS 0xd00075e9 /end MEASUREMENT
/begin MEASUREMENT tnt_dif_ch_l "difference between maximum and actual value of TNT" SWORD _CNV_A_R_LINEAR_____523_CM 1 100. -1024. 1023.96875 DISPLAY_IDENTIFIER TNT_DIF_CH_L ECU_ADDRESS 0xd00068d4 FORMAT "%11.5" /end MEASUREMENT
/begin MEASUREMENT temp_cat_dif_ch_l "Difference between target and actual value of cat. temperature" SWORD _CNV_A_R_LINEAR_____523_CM 1 100. -1024. 1023.96875 DISPLAY_IDENTIFIER TEMP_CAT_DIF_CH_L ECU_ADDRESS 0xd00068c0 FORMAT "%11.5" /end MEASUREMENT
/begin CHARACTERISTIC c_n_32_thd_ch_l_off "Threshold of engine speed that disables CH_L" VALUE 0xa0805f5a _REC_VAL_20_u1 8160. _CNV_A_R_LINEAR_____10_CM 0. 8160. DISPLAY_IDENTIFIER C_N_32_THD_CH_L_OFF FORMAT "%4.0" /end CHARACTERISTIC
/begin CHARACTERISTIC c_n_32_thd_ch_l_on "Threshold of engine speed that disables CH_L" VALUE 0xa0805f5b _REC_VAL_20_u1 8160. _CNV_A_R_LINEAR_____10_CM 0. 8160. DISPLAY_IDENTIFIER C_N_32_THD_CH_L_ON FORMAT "%4.0" /end CHARACTERISTIC
/begin CHARACTERISTIC c_state_ch_man "Manual setting of state of cat. heating" VALUE 0xa0805f6c _REC_VAL_20_u1 3. _CNV_A_R_LINEAR_____0_CM 0. 3. DISPLAY_IDENTIFIER C_STATE_CH_MAN FORMAT "%3.0" /end CHARACTERISTIC
/begin CHARACTERISTIC c_temp_cat_thd_ch_l_off "Threshold of catalyst temperature for CH_L (switching off)" VALUE 0xa0805f78 _REC_VAL_20_u2 1023.984375 _CNV_A_R_LINEAR_____780_CM -33. 990.984375 DISPLAY_IDENTIFIER C_TEMP_CAT_THD_CH_L_OFF FORMAT "%10.6" /end CHARACTERISTIC
/begin CHARACTERISTIC c_temp_cat_thd_ch_l_hom_on "Threshold of catalyst temperature for homogeneous CH_L" VALUE 0xa0805f76 _REC_VAL_20_u2 1023.984375 _CNV_A_R_LINEAR_____780_CM -33. 990.984375 DISPLAY_IDENTIFIER C_TEMP_CAT_THD_CH_L_HOM_ON FORMAT "%10.6" /end CHARACTERISTIC
/begin CHARACTERISTIC c_temp_cat_thd_ch_l_s_on "Threshold of catalyst temperature for stratified CH_L" VALUE 0xa0805f7a _REC_VAL_20_u2 1023.984375 _CNV_A_R_LINEAR_____780_CM -33. 990.984375 DISPLAY_IDENTIFIER C_TEMP_CAT_THD_CH_L_S_ON FORMAT "%10.6" /end CHARACTERISTIC
/begin CHARACTERISTIC c_tnt_thd_ch_l_off "Threshold NOx trap temperature that deactivates CH in stratified and homogeneous" VALUE 0xa0805f90 _REC_VAL_20_u2 1023.984375 _CNV_A_R_LINEAR_____209_CM 0. 1023.984375 DISPLAY_IDENTIFIER C_TNT_THD_CH_L_OFF FORMAT "%11.6" /end CHARACTERISTIC
/begin CHARACTERISTIC c_tnt_thd_ch_l_hom_on "Threshold NOx trap temperature that activates CH in homogeneous" VALUE 0xa0805f8e _REC_VAL_20_u2 1023.984375 _CNV_A_R_LINEAR_____209_CM 0. 1023.984375 DISPLAY_IDENTIFIER C_TNT_THD_CH_L_HOM_ON FORMAT "%11.6" /end CHARACTERISTIC
/begin CHARACTERISTIC c_tnt_thd_ch_l_s_on "Threshold NOx trap temperature that activates CH in stratified" VALUE 0xa0805f92 _REC_VAL_20_u2 1023.984375 _CNV_A_R_LINEAR_____209_CM 0. 1023.984375 DISPLAY_IDENTIFIER C_TNT_THD_CH_L_S_ON FORMAT "%11.6" /end CHARACTERISTIC
/begin CHARACTERISTIC c_tqi_req_fast_thd_ch_l_off "Threshold of TQI_REQ_FAST that disables CH_L" VALUE 0xa0805fae _REC_VAL_20_s2 2047.96875 _CNV_A_R_LINEAR_____31_CM -1024. 1023.96875 DISPLAY_IDENTIFIER C_TQI_REQ_FAST_THD_CH_L_OFF FORMAT "%11.5" /end CHARACTERISTIC
/begin CHARACTERISTIC c_tqi_req_fast_thd_ch_l_on "Threshold of TQI_REQ_FAST that enables CH_L" VALUE 0xa0805fb0 _REC_VAL_20_s2 2047.96875 _CNV_A_R_LINEAR_____31_CM -1024. 1023.96875 DISPLAY_IDENTIFIER C_TQI_REQ_FAST_THD_CH_L_ON FORMAT "%11.5" /end CHARACTERISTIC
/begin CHARACTERISTIC lc_state_ch_man_act "Activation of manual setting of state of cat. heating" VALUE 0xa0805fc5 _REC_VAL_20_u1 1. _CNV_A_R_LINEAR_____0_CM 0. 1. DISPLAY_IDENTIFIER LC_STATE_CH_MAN_ACT FORMAT "%1.0" /end CHARACTERISTIC
/begin MEASUREMENT tqi_req_fast_fil_ch_so2p "Filtered torque request (fast path) for desulfation catalyst heating activation" SWORD _CNV_A_R_LINEAR_____31_CM 1 100. -1024. 1023.96875 DISPLAY_IDENTIFIER TQI_REQ_FAST_FIL_CH_SO2P ECU_ADDRESS 0xd00068e2 FORMAT "%8.2" /end MEASUREMENT
/begin MEASUREMENT vs_fil_ch_so2p "Filtered vehicle speed" UBYTE _CNV_A_R_LINEAR_____6_CM 1 100. 0. 255. DISPLAY_IDENTIFIER VS_FIL_CH_SO2P ECU_ADDRESS 0xd00075f5 FORMAT "%3.0" /end MEASUREMENT
/begin MEASUREMENT lv_ch_so2p_cdn "Indicator for conditions of desulfation catalyst heating" UBYTE _CNV_S_2_RANGE__0___1_CM 1 100. 0. 1. DISPLAY_IDENTIFIER LV_CH_SO2P_CDN ECU_ADDRESS 0xd00075e2 /end MEASUREMENT
/begin MEASUREMENT lv_ch_l_cdn "Indicator for conditions of low load catalyst heating" UBYTE _CNV_S_2_RANGE__0___1_CM 1 100. 0. 1. DISPLAY_IDENTIFIER LV_CH_L_CDN ECU_ADDRESS 0xd00075e1 /end MEASUREMENT
/begin CHARACTERISTIC c_fac_tqi_fil_ch_so2p "Correlation factor to filter the requested torque" VALUE 0xa0805f44 _REC_VAL_20_u2 1. _CNV_A_R_LINEAR_____229_CM 0. 1. DISPLAY_IDENTIFIER C_FAC_TQI_FIL_CH_SO2P FORMAT "%6.4" /end CHARACTERISTIC
/begin CHARACTERISTIC c_fac_vs_fil_ch_so2p "Correlation factor to filter the vehicle speed" VALUE 0xa0805f46 _REC_VAL_20_u2 1. _CNV_A_R_LINEAR_____229_CM 0. 1. DISPLAY_IDENTIFIER C_FAC_VS_FIL_CH_SO2P FORMAT "%6.4" /end CHARACTERISTIC
/begin CHARACTERISTIC c_temp_cat_thd_ch_so2p "Threshold of catalyst temperature for desulfation catalyst heating" VALUE 0xa0805f7c _REC_VAL_20_u2 1023.984375 _CNV_A_R_LINEAR_____780_CM -33. 990.984375 DISPLAY_IDENTIFIER C_TEMP_CAT_THD_CH_SO2P FORMAT "%10.6" /end CHARACTERISTIC
/begin CHARACTERISTIC c_tnt_max_ch_so2p "Maximum temperature of TNT for desulfation catalyst heating" VALUE 0xa0805f84 _REC_VAL_20_u2 1023.984375 _CNV_A_R_LINEAR_____209_CM 0. 1023.984375 DISPLAY_IDENTIFIER C_TNT_MAX_CH_SO2P FORMAT "%11.6" /end CHARACTERISTIC
/begin CHARACTERISTIC c_tnt_min_ch_so2p "Minimum temperature of TNT for desulfation catalyst heating" VALUE 0xa0805f86 _REC_VAL_20_u2 1023.984375 _CNV_A_R_LINEAR_____209_CM 0. 1023.984375 DISPLAY_IDENTIFIER C_TNT_MIN_CH_SO2P FORMAT "%11.6" /end CHARACTERISTIC
/begin CHARACTERISTIC c_tqi_thd_ch_so2p "Threshold of requested torque to activate desulfation catalyst heating" VALUE 0xa0805fb2 _REC_VAL_20_s2 2047.96875 _CNV_A_R_LINEAR_____31_CM -1024. 1023.96875 DISPLAY_IDENTIFIER C_TQI_THD_CH_SO2P FORMAT "%8.2" /end CHARACTERISTIC
/begin CHARACTERISTIC c_temp_cat_max_ch_ast "Threshold of catalyst temperature for catalyst heating after start" VALUE 0xa0805f70 _REC_VAL_20_u2 1023.984375 _CNV_A_R_LINEAR_____780_CM -33. 990.984375 DISPLAY_IDENTIFIER C_TEMP_CAT_MAX_CH_AST FORMAT "%10.6" /end CHARACTERISTIC
/begin CHARACTERISTIC c_tnt_max_ch_ast "Maximum nox trap temperature for catalyst heating after start" VALUE 0xa0805f82 _REC_VAL_20_u2 1023.984375 _CNV_A_R_LINEAR_____209_CM 0. 1023.984375 DISPLAY_IDENTIFIER C_TNT_MAX_CH_AST FORMAT "%11.6" /end CHARACTERISTIC
/begin CHARACTERISTIC c_vs_thd_ch_so2p "threshold of vehicle speed to activate desulfation catalyst heating" VALUE 0xa0805fb6 _REC_VAL_20_u1 255. _CNV_A_R_LINEAR_____6_CM 0. 255. DISPLAY_IDENTIFIER C_VS_THD_CH_SO2P FORMAT "%3.0" /end CHARACTERISTIC
/begin CHARACTERISTIC c_vs_max_ch_ast "Vehicle speed threshold for after start catalyst heating" VALUE 0xa0805fb4 _REC_VAL_20_u1 255. _CNV_A_R_LINEAR_____6_CM 0. 255. DISPLAY_IDENTIFIER C_VS_MAX_CH_AST FORMAT "%3.0" /end CHARACTERISTIC
/begin MEASUREMENT cam_sp_ch_in "Intake camshaft target spread for catalyst heating" SWORD _CNV_A_R_LINEAR_____786_CM 1 100. -768. 767.9765625 DISPLAY_IDENTIFIER CAM_SP_CH_IN ECU_ADDRESS 0xd0006862 FORMAT "%7.2" /end MEASUREMENT
/begin MEASUREMENT cam_sp_ch_ex "Outtake camshaft target spread for catalyst heating" SWORD _CNV_A_R_LINEAR_____786_CM 1 100. -768. 767.9765625 DISPLAY_IDENTIFIER CAM_SP_CH_EX ECU_ADDRESS 0xd0006860 FORMAT "%7.2" /end MEASUREMENT
/begin CHARACTERISTIC id_state_opm_ivvt_ch_hom_so2p "" MAP 0xa0805bc4 _REC_MAP_20_u1_u2_u2 2. _CNV_A_R_LINEAR_____0_CM 0. 2. DISPLAY_IDENTIFIER ID_STATE_OPM_IVVT_CH_HOM_SO2P FORMAT "%1.0"
 /begin AXIS_DESCR COM_AXIS n _CNV_A_R_LINEAR_____14_CM 6 0. 8160. FORMAT "%4.0" AXIS_PTS_REF ldp_n_id_opm_ivvt_ch_hom_so2p /end AXIS_DESCR
 /begin AXIS_DESCR COM_AXIS NO_INPUT_QUANTITY _CNV_A_R_LINEAR_____226_CM 6 0. 300. FORMAT "%5.1" AXIS_PTS_REF ldp_fac_maf_egr_id_ch_hom_so2p /end AXIS_DESCR
/end CHARACTERISTIC
/begin AXIS_PTS ldp_n_id_opm_ivvt_ch_l "" 0xa08057e0 n _REC_AXS_20_u2 8160. _CNV_A_R_LINEAR_____14_CM 6 0. 8160. FORMAT "%4.0" /end AXIS_PTS
/begin AXIS_PTS ldp_fac_maf_egr_cor_id_opm_ch_l "IVVT   strategy request for catalyst heating for desulfation" 0xa0805704 NO_INPUT_QUANTITY _REC_AXS_20_u2 300. _CNV_A_R_LINEAR_____226_CM 6 0. 300. FORMAT "%5.1" /end AXIS_PTS
/begin AXIS_PTS ldp_n_id_opm_ivvt_ch_mplh_so2p "" 0xa08057f0 n _REC_AXS_20_u2 8160. _CNV_A_R_LINEAR_____14_CM 6 0. 8160. FORMAT "%4.0" /end AXIS_PTS
/begin AXIS_PTS ldp_fac_maf_egr_id_ch_hom_so2p "IVVT   strategy request for catalyst heating for desulfation" 0xa0805714 NO_INPUT_QUANTITY _REC_AXS_20_u2 300. _CNV_A_R_LINEAR_____226_CM 6 0. 300. FORMAT "%5.1" /end AXIS_PTS
/begin CHARACTERISTIC id_state_opm_ivvt_ch_l "" MAP 0xa0805be8 _REC_MAP_20_u1_u2_u2 2. _CNV_A_R_LINEAR_____0_CM 0. 2. DISPLAY_IDENTIFIER ID_STATE_OPM_IVVT_CH_L FORMAT "%1.0"
 /begin AXIS_DESCR COM_AXIS n _CNV_A_R_LINEAR_____14_CM 6 0. 8160. FORMAT "%4.0" AXIS_PTS_REF ldp_n_id_opm_ivvt_ch_l /end AXIS_DESCR
 /begin AXIS_DESCR COM_AXIS NO_INPUT_QUANTITY _CNV_A_R_LINEAR_____226_CM 6 0. 300. FORMAT "%5.1" AXIS_PTS_REF ldp_fac_maf_egr_cor_id_opm_ch_l /end AXIS_DESCR
/end CHARACTERISTIC
/begin CHARACTERISTIC id_state_opm_ivvt_ch_mplh_so2p "IVVT   strategy request for catalyst heating for desulfation, multiple injection" MAP 0xa0805c0c _REC_MAP_20_u1_u2_u2 1. _CNV_A_R_LINEAR_____0_CM 1. 2. DISPLAY_IDENTIFIER ID_STATE_OPM_IVVT_CH_MPLH_SO2P FORMAT "%2.0"
 /begin AXIS_DESCR COM_AXIS n _CNV_A_R_LINEAR_____14_CM 6 0. 8160. FORMAT "%4.0" AXIS_PTS_REF ldp_n_id_opm_ivvt_ch_mplh_so2p /end AXIS_DESCR
 /begin AXIS_DESCR COM_AXIS NO_INPUT_QUANTITY _CNV_A_R_LINEAR_____226_CM 6 0. 300. FORMAT "%5.1" AXIS_PTS_REF ldp_fac_maf_egr_id_ch_mplh_so2p /end AXIS_DESCR
/end CHARACTERISTIC
/begin AXIS_PTS ldp_n_id_opm_ivvt_ch_hom_so2p "" 0xa08057d0 n _REC_AXS_20_u2 8160. _CNV_A_R_LINEAR_____14_CM 6 0. 8160. FORMAT "%4.0" /end AXIS_PTS
/begin AXIS_PTS ldp_fac_maf_egr_id_ch_mplh_so2p "IVVT   strategy request for catalyst heating for desulfation" 0xa0805724 NO_INPUT_QUANTITY _REC_AXS_20_u2 300. _CNV_A_R_LINEAR_____226_CM 6 0. 300. FORMAT "%5.1" /end AXIS_PTS
/begin MEASUREMENT state_opm_ivvt_ch "IVVT   strategy request; 0 = no request ; 1 = engine roughness optimal ; 2 = emission optimal" UBYTE _CNV_A_R_LINEAR_____0_CM 1 100. 0. 2. DISPLAY_IDENTIFIER STATE_OPM_IVVT_CH ECU_ADDRESS 0xd00075f4 FORMAT "%1.0" /end MEASUREMENT
/begin MEASUREMENT fac_eff_iga_ch_sp "Setpoint of factor for fading ignition angle efficiency in case of catalyst heating" UBYTE _CNV_A_R_LINEAR_____28_CM 1 100. 0. 0.99609375 DISPLAY_IDENTIFIER FAC_EFF_IGA_CH_SP ECU_ADDRESS 0xd00075dc FORMAT "%5.3" /end MEASUREMENT
/begin CHARACTERISTIC ip_cam_ch_cold_ex "Outlet camshaft setpoint for catalyst heating" MAP 0xa0810190 _REC_MAP_20_u1_u2_u2 -95.625 _CNV_A_R_LINEAR_____544_CM -40. -135.625 DISPLAY_IDENTIFIER IP_CAM_CH_COLD_EX FORMAT "%8.3"
 /begin AXIS_DESCR COM_AXIS n _CNV_A_R_LINEAR_____14_CM 10 0. 8160. FORMAT "%4.0" AXIS_PTS_REF ldpm_n_2_extc /end AXIS_DESCR
 /begin AXIS_DESCR COM_AXIS fac_maf_rel_egr_cor _CNV_A_R_LINEAR_____226_CM 10 0. 300. FORMAT "%5.1" AXIS_PTS_REF ldpm_fac_maf_rel_egr_cor_2_extc /end AXIS_DESCR
/end CHARACTERISTIC
/begin CHARACTERISTIC ip_cam_ch_cold_ex_is "Outlet camshaft setpoint for catalyst heating in idle" MAP 0xa08101f4 _REC_MAP_20_u1_u2_u2 -95.625 _CNV_A_R_LINEAR_____544_CM -40. -135.625 DISPLAY_IDENTIFIER IP_CAM_CH_COLD_EX_IS FORMAT "%8.3"
 /begin AXIS_DESCR COM_AXIS n _CNV_A_R_LINEAR_____14_CM 8 0. 8160. FORMAT "%4.0" AXIS_PTS_REF ldpm_n_4_extc /end AXIS_DESCR
 /begin AXIS_DESCR COM_AXIS fac_maf_rel_egr_cor _CNV_A_R_LINEAR_____226_CM 10 0. 300. FORMAT "%5.1" AXIS_PTS_REF ldpm_fac_maf_rel_egr_cor_4_extc /end AXIS_DESCR
/end CHARACTERISTIC
/begin CHARACTERISTIC ip_cam_ch_cold_in "Inlet camshaft setpoint for catalyst heating" MAP 0xa0810244 _REC_MAP_20_u1_u2_u2 95.625 _CNV_A_R_LINEAR_____545_CM 60. 155.625 DISPLAY_IDENTIFIER IP_CAM_CH_COLD_IN FORMAT "%7.3"
 /begin AXIS_DESCR COM_AXIS n _CNV_A_R_LINEAR_____14_CM 10 0. 8160. FORMAT "%4.0" AXIS_PTS_REF ldpm_n_2_extc /end AXIS_DESCR
 /begin AXIS_DESCR COM_AXIS fac_maf_rel_egr_cor _CNV_A_R_LINEAR_____226_CM 10 0. 300. FORMAT "%5.1" AXIS_PTS_REF ldpm_fac_maf_rel_egr_cor_2_extc /end AXIS_DESCR
/end CHARACTERISTIC
/begin CHARACTERISTIC ip_cam_ch_cold_in_is "Inlet camshaft setpoint for catalyst heating in idle" MAP 0xa08102a8 _REC_MAP_20_u1_u2_u2 95.625 _CNV_A_R_LINEAR_____545_CM 60. 155.625 DISPLAY_IDENTIFIER IP_CAM_CH_COLD_IN_IS FORMAT "%7.3"
 /begin AXIS_DESCR COM_AXIS n _CNV_A_R_LINEAR_____14_CM 8 0. 8160. FORMAT "%4.0" AXIS_PTS_REF ldpm_n_4_extc /end AXIS_DESCR
 /begin AXIS_DESCR COM_AXIS fac_maf_rel_egr_cor _CNV_A_R_LINEAR_____226_CM 10 0. 300. FORMAT "%5.1" AXIS_PTS_REF ldpm_fac_maf_rel_egr_cor_4_extc /end AXIS_DESCR
/end CHARACTERISTIC
/begin CHARACTERISTIC ip_cam_ch_hom_hot_ex "Inlet camshaft setpoint for catalyst heating" MAP 0xa08102f8 _REC_MAP_20_u1_u2_u2 -95.625 _CNV_A_R_LINEAR_____544_CM -40. -135.625 DISPLAY_IDENTIFIER IP_CAM_CH_HOM_HOT_EX FORMAT "%8.3"
 /begin AXIS_DESCR COM_AXIS n _CNV_A_R_LINEAR_____14_CM 16 0. 8160. FORMAT "%4.0" AXIS_PTS_REF ldpm_n_1_extc /end AXIS_DESCR
 /begin AXIS_DESCR COM_AXIS fac_maf_rel_egr_cor _CNV_A_R_LINEAR_____226_CM 10 0. 300. FORMAT "%5.1" AXIS_PTS_REF ldpm_fac_maf_rel_egr_cor_1_extc /end AXIS_DESCR
/end CHARACTERISTIC
/begin CHARACTERISTIC ip_cam_ch_hom_hot_ex_is "Inlet camshaft setpoint for catalyst heating in idle" MAP 0xa0810398 _REC_MAP_20_u1_u2_u2 -95.625 _CNV_A_R_LINEAR_____544_CM -40. -135.625 DISPLAY_IDENTIFIER IP_CAM_CH_HOM_HOT_EX_IS FORMAT "%8.3"
 /begin AXIS_DESCR COM_AXIS n _CNV_A_R_LINEAR_____14_CM 8 0. 8160. FORMAT "%4.0" AXIS_PTS_REF ldpm_n_3_extc /end AXIS_DESCR
 /begin AXIS_DESCR COM_AXIS fac_maf_rel_egr_cor _CNV_A_R_LINEAR_____226_CM 10 0. 300. FORMAT "%5.1" AXIS_PTS_REF ldpm_fac_maf_rel_egr_cor_3_extc /end AXIS_DESCR
/end CHARACTERISTIC
/begin CHARACTERISTIC ip_cam_ch_hom_hot_in "Inlet camshaft setpoint for catalyst heating with single injection" MAP 0xa08103e8 _REC_MAP_20_u1_u2_u2 95.625 _CNV_A_R_LINEAR_____545_CM 60. 155.625 DISPLAY_IDENTIFIER IP_CAM_CH_HOM_HOT_IN FORMAT "%7.3"
 /begin AXIS_DESCR COM_AXIS n _CNV_A_R_LINEAR_____14_CM 16 0. 8160. FORMAT "%4.0" AXIS_PTS_REF ldpm_n_1_extc /end AXIS_DESCR
 /begin AXIS_DESCR COM_AXIS fac_maf_rel_egr_cor _CNV_A_R_LINEAR_____226_CM 10 0. 300. FORMAT "%5.1" AXIS_PTS_REF ldpm_fac_maf_rel_egr_cor_1_extc /end AXIS_DESCR
/end CHARACTERISTIC
/begin CHARACTERISTIC ip_cam_ch_hom_hot_in_is "Inlet camshaft setpoint for catalyst heating with single injection in idle" MAP 0xa0810488 _REC_MAP_20_u1_u2_u2 95.625 _CNV_A_R_LINEAR_____545_CM 60. 155.625 DISPLAY_IDENTIFIER IP_CAM_CH_HOM_HOT_IN_IS FORMAT "%7.3"
 /begin AXIS_DESCR COM_AXIS n _CNV_A_R_LINEAR_____14_CM 8 0. 8160. FORMAT "%4.0" AXIS_PTS_REF ldpm_n_3_extc /end AXIS_DESCR
 /begin AXIS_DESCR COM_AXIS fac_maf_rel_egr_cor _CNV_A_R_LINEAR_____226_CM 10 0. 300. FORMAT "%5.1" AXIS_PTS_REF ldpm_fac_maf_rel_egr_cor_3_extc /end AXIS_DESCR
/end CHARACTERISTIC
/begin CHARACTERISTIC ip_cam_ch_mplh_hot_ex "Outlet camshaft setpoint for catalyst heating with multiple injection" MAP 0xa08104d8 _REC_MAP_20_u1_u2_u2 -95.625 _CNV_A_R_LINEAR_____544_CM -40. -135.625 DISPLAY_IDENTIFIER IP_CAM_CH_MPLH_HOT_EX FORMAT "%8.3"
 /begin AXIS_DESCR COM_AXIS n _CNV_A_R_LINEAR_____14_CM 16 0. 8160. FORMAT "%4.0" AXIS_PTS_REF ldpm_n_1_extc /end AXIS_DESCR
 /begin AXIS_DESCR COM_AXIS fac_maf_rel_egr_cor _CNV_A_R_LINEAR_____226_CM 10 0. 300. FORMAT "%5.1" AXIS_PTS_REF ldpm_fac_maf_rel_egr_cor_1_extc /end AXIS_DESCR
/end CHARACTERISTIC
/begin CHARACTERISTIC ip_cam_ch_mplh_hot_ex_is "Outlet camshaft setpoint for catalyst heating with multiple injection in idle" MAP 0xa0810578 _REC_MAP_20_u1_u2_u2 -95.625 _CNV_A_R_LINEAR_____544_CM -40. -135.625 DISPLAY_IDENTIFIER IP_CAM_CH_MPLH_HOT_EX_IS FORMAT "%8.3"
 /begin AXIS_DESCR COM_AXIS n _CNV_A_R_LINEAR_____14_CM 8 0. 8160. FORMAT "%4.0" AXIS_PTS_REF ldpm_n_3_extc /end AXIS_DESCR
 /begin AXIS_DESCR COM_AXIS fac_maf_rel_egr_cor _CNV_A_R_LINEAR_____226_CM 10 0. 300. FORMAT "%5.1" AXIS_PTS_REF ldpm_fac_maf_rel_egr_cor_3_extc /end AXIS_DESCR
/end CHARACTERISTIC
/begin CHARACTERISTIC ip_cam_ch_mplh_hot_in "Inlet camshaft setpoint for catalyst heating with multiple injection" MAP 0xa08105c8 _REC_MAP_20_u1_u2_u2 95.625 _CNV_A_R_LINEAR_____545_CM 60. 155.625 DISPLAY_IDENTIFIER IP_CAM_CH_MPLH_HOT_IN FORMAT "%7.3"
 /begin AXIS_DESCR COM_AXIS n _CNV_A_R_LINEAR_____14_CM 16 0. 8160. FORMAT "%4.0" AXIS_PTS_REF ldpm_n_1_extc /end AXIS_DESCR
 /begin AXIS_DESCR COM_AXIS fac_maf_rel_egr_cor _CNV_A_R_LINEAR_____226_CM 10 0. 300. FORMAT "%5.1" AXIS_PTS_REF ldpm_fac_maf_rel_egr_cor_1_extc /end AXIS_DESCR
/end CHARACTERISTIC
/begin CHARACTERISTIC ip_cam_ch_mplh_hot_in_is "Inlet camshaft setpoint for catalyst heating with multiple injection in idle" MAP 0xa0810668 _REC_MAP_20_u1_u2_u2 95.625 _CNV_A_R_LINEAR_____545_CM 60. 155.625 DISPLAY_IDENTIFIER IP_CAM_CH_MPLH_HOT_IN_IS FORMAT "%7.3"
 /begin AXIS_DESCR COM_AXIS n _CNV_A_R_LINEAR_____14_CM 8 0. 8160. FORMAT "%4.0" AXIS_PTS_REF ldpm_n_3_extc /end AXIS_DESCR
 /begin AXIS_DESCR COM_AXIS fac_maf_rel_egr_cor _CNV_A_R_LINEAR_____226_CM 10 0. 300. FORMAT "%5.1" AXIS_PTS_REF ldpm_fac_maf_rel_egr_cor_3_extc /end AXIS_DESCR
/end CHARACTERISTIC
/begin CHARACTERISTIC ip_fac_eff_iga_ch_sp "Setpoint of factor for fading ignition angle efficiency in case of catalyst heating" MAP 0xa0805c48 _REC_MAP_20_u1_u2_u1 0.99609375 _CNV_A_R_LINEAR_____185_CM 0. 0.99609375 DISPLAY_IDENTIFIER IP_FAC_EFF_IGA_CH_SP FORMAT "%5.3"
 /begin AXIS_DESCR COM_AXIS t_ast _CNV_A_R_LINEAR_____4_CM 8 0. 6553.5 FORMAT "%6.1" AXIS_PTS_REF ldpm_t_ast_6_extc /end AXIS_DESCR
 /begin AXIS_DESCR COM_AXIS tco _CNV_A_R_LINEAR_____17_CM 8 -48. 142.5 FORMAT "%6.2" AXIS_PTS_REF ldpm_tco_6_extc /end AXIS_DESCR
/end CHARACTERISTIC
/begin CHARACTERISTIC ip_fac_eff_iga_ch_sp_mplh "Setpoint of factor for fading ignition angle efficiency in case of catalyst heating with multiple injection" MAP 0xa0805c88 _REC_MAP_20_u1_u2_u1 0.99609375 _CNV_A_R_LINEAR_____185_CM 0. 0.99609375 DISPLAY_IDENTIFIER IP_FAC_EFF_IGA_CH_SP_MPLH FORMAT "%5.3"
 /begin AXIS_DESCR COM_AXIS t_ast _CNV_A_R_LINEAR_____4_CM 8 0. 6553.5 FORMAT "%6.1" AXIS_PTS_REF ldpm_t_ast_6_extc /end AXIS_DESCR
 /begin AXIS_DESCR COM_AXIS tco _CNV_A_R_LINEAR_____17_CM 8 -48. 142.5 FORMAT "%6.2" AXIS_PTS_REF ldpm_tco_6_extc /end AXIS_DESCR
/end CHARACTERISTIC
/begin AXIS_PTS ldpm_t_ast_5_extc "" 0xa0805a5c t_ast _REC_AXS_20_u2 6553.5 _CNV_A_R_LINEAR_____4_CM 8 0. 6553.5 FORMAT "%6.1" /end AXIS_PTS
/begin CHARACTERISTIC ip_n_sp_is_ch_ast_mplh "Idle speed setpoint for homogeneous catalyst heating with dual injection" MAP 0xa0810d88 _REC_MAP_20_u2_u2_u1 8160. _CNV_A_R_LINEAR_____14_CM 0. 8160. DISPLAY_IDENTIFIER IP_N_SP_IS_CH_AST_MPLH FORMAT "%4.0"
 /begin AXIS_DESCR COM_AXIS t_ast _CNV_A_R_LINEAR_____4_CM 8 0. 6553.5 FORMAT "%6.1" AXIS_PTS_REF ldpm_t_ast_5_extc /end AXIS_DESCR
 /begin AXIS_DESCR COM_AXIS tco_st _CNV_A_R_LINEAR_____17_CM 6 -48. 142.5 FORMAT "%6.2" AXIS_PTS_REF ldpm_tco_st_5_extc /end AXIS_DESCR
/end CHARACTERISTIC
/begin CHARACTERISTIC ip_n_sp_is_ch_ast_mplp "Idle speed setpoint for stratified catalyst heating with post injection" MAP 0xa0810e48 _REC_MAP_20_u2_u2_u1 8160. _CNV_A_R_LINEAR_____14_CM 0. 8160. DISPLAY_IDENTIFIER IP_N_SP_IS_CH_AST_MPLP FORMAT "%4.0"
 /begin AXIS_DESCR COM_AXIS t_ast _CNV_A_R_LINEAR_____4_CM 8 0. 6553.5 FORMAT "%6.1" AXIS_PTS_REF ldpm_t_ast_5_extc /end AXIS_DESCR
 /begin AXIS_DESCR COM_AXIS tco_st _CNV_A_R_LINEAR_____17_CM 6 -48. 142.5 FORMAT "%6.2" AXIS_PTS_REF ldpm_tco_st_5_extc /end AXIS_DESCR
/end CHARACTERISTIC
/begin MEASUREMENT n_sp_is_ch "Idle speed setpoint for catalyst heating" UWORD _CNV_A_R_LINEAR_____14_CM 1 100. 0. 8160. DISPLAY_IDENTIFIER N_SP_IS_CH ECU_ADDRESS 0xd000689a FORMAT "%4.0" /end MEASUREMENT
/begin CHARACTERISTIC ip_n_sp_is_ch_ast_hom "Idle speed setpoint for homogeneous catalyst heating" MAP 0xa0810cc8 _REC_MAP_20_u2_u2_u1 8160. _CNV_A_R_LINEAR_____14_CM 0. 8160. DISPLAY_IDENTIFIER IP_N_SP_IS_CH_AST_HOM FORMAT "%4.0"
 /begin AXIS_DESCR COM_AXIS t_ast _CNV_A_R_LINEAR_____4_CM 8 0. 6553.5 FORMAT "%6.1" AXIS_PTS_REF ldpm_t_ast_5_extc /end AXIS_DESCR
 /begin AXIS_DESCR COM_AXIS tco_st _CNV_A_R_LINEAR_____17_CM 6 -48. 142.5 FORMAT "%6.2" AXIS_PTS_REF ldpm_tco_st_5_extc /end AXIS_DESCR
/end CHARACTERISTIC
/begin CHARACTERISTIC ip_n_sp_is_ch_l_hom "Idle speed setpoint for homogeneous low load CH" MAP 0xa0805e84 _REC_MAP_20_u2_u2_u2 8160. _CNV_A_R_LINEAR_____14_CM 0. 8160. DISPLAY_IDENTIFIER IP_N_SP_IS_CH_L_HOM FORMAT "%4.0"
 /begin AXIS_DESCR COM_AXIS temp_cat_dif_ch_l _CNV_A_R_LINEAR_____781_CM 4 -1024. 1023.96875 FORMAT "%11.5" AXIS_PTS_REF ldpm_temp_cat_dif_ch_l_2_extc /end AXIS_DESCR
 /begin AXIS_DESCR COM_AXIS tnt_dif_ch_l _CNV_A_R_LINEAR_____781_CM 4 -1024. 1023.96875 FORMAT "%11.5" AXIS_PTS_REF ldpm_tnt_dif_ch_l_2_extc /end AXIS_DESCR
/end CHARACTERISTIC
/begin CHARACTERISTIC ip_n_sp_is_ch_l_s "Idle speed setpoint for stratified low load CH" MAP 0xa0805ea4 _REC_MAP_20_u2_u2_u2 8160. _CNV_A_R_LINEAR_____14_CM 0. 8160. DISPLAY_IDENTIFIER IP_N_SP_IS_CH_L_S FORMAT "%4.0"
 /begin AXIS_DESCR COM_AXIS temp_cat_dif_ch_l _CNV_A_R_LINEAR_____781_CM 4 -1024. 1023.96875 FORMAT "%11.5" AXIS_PTS_REF ldpm_temp_cat_dif_ch_l_2_extc /end AXIS_DESCR
 /begin AXIS_DESCR COM_AXIS tnt_dif_ch_l _CNV_A_R_LINEAR_____781_CM 4 -1024. 1023.96875 FORMAT "%11.5" AXIS_PTS_REF ldpm_tnt_dif_ch_l_2_extc /end AXIS_DESCR
/end CHARACTERISTIC
/begin CHARACTERISTIC ip_n_sp_is_ch_ast_hom_dri "Idle speed setpoint for homogeneous catalyst heating, engaged gear" MAP 0xa0810d28 _REC_MAP_20_u2_u2_u1 8160. _CNV_A_R_LINEAR_____14_CM 0. 8160. DISPLAY_IDENTIFIER IP_N_SP_IS_CH_AST_HOM_DRI FORMAT "%4.0"
 /begin AXIS_DESCR COM_AXIS t_ast _CNV_A_R_LINEAR_____4_CM 8 0. 6553.5 FORMAT "%6.1" AXIS_PTS_REF ldpm_t_ast_5_extc /end AXIS_DESCR
 /begin AXIS_DESCR COM_AXIS tco_st _CNV_A_R_LINEAR_____17_CM 6 -48. 142.5 FORMAT "%6.2" AXIS_PTS_REF ldpm_tco_st_5_extc /end AXIS_DESCR
/end CHARACTERISTIC
/begin CHARACTERISTIC ip_n_sp_is_ch_ast_mplh_dri "Idle speed setpoint for homogeneous catalyst heating with multiple injection, engaged gear" MAP 0xa0810de8 _REC_MAP_20_u2_u2_u1 8160. _CNV_A_R_LINEAR_____14_CM 0. 8160. DISPLAY_IDENTIFIER IP_N_SP_IS_CH_AST_MPLH_DRI FORMAT "%4.0"
 /begin AXIS_DESCR COM_AXIS t_ast _CNV_A_R_LINEAR_____4_CM 8 0. 6553.5 FORMAT "%6.1" AXIS_PTS_REF ldpm_t_ast_5_extc /end AXIS_DESCR
 /begin AXIS_DESCR COM_AXIS tco_st _CNV_A_R_LINEAR_____17_CM 6 -48. 142.5 FORMAT "%6.2" AXIS_PTS_REF ldpm_tco_st_5_extc /end AXIS_DESCR
/end CHARACTERISTIC
/begin CHARACTERISTIC ip_n_sp_is_ch_ast_mplp_dri "Idle speed setpoint for stratified catalyst heating with post injection, engaged gear" MAP 0xa0810ea8 _REC_MAP_20_u2_u2_u1 8160. _CNV_A_R_LINEAR_____14_CM 0. 8160. DISPLAY_IDENTIFIER IP_N_SP_IS_CH_AST_MPLP_DRI FORMAT "%4.0"
 /begin AXIS_DESCR COM_AXIS t_ast _CNV_A_R_LINEAR_____4_CM 8 0. 6553.5 FORMAT "%6.1" AXIS_PTS_REF ldpm_t_ast_5_extc /end AXIS_DESCR
 /begin AXIS_DESCR COM_AXIS tco_st _CNV_A_R_LINEAR_____17_CM 6 -48. 142.5 FORMAT "%6.2" AXIS_PTS_REF ldpm_tco_st_5_extc /end AXIS_DESCR
/end CHARACTERISTIC
/begin CHARACTERISTIC lc_dri_act_mt "Usage of gear dependency of N_SP_IS_CH maps for manual transmision" VALUE 0xa0805fb8 _REC_VAL_20_u1 1. _CNV_S_2_RANGE__0___1_CM 0. 1. DISPLAY_IDENTIFIER LC_DRI_ACT_MT /end CHARACTERISTIC
/begin MEASUREMENT lv_n_sp_is_ch_dri "Logical variable for driving position engaged (switch for N_SP_IS_CH maps)" UBYTE _CNV_S_2_RANGE__0___1_CM 1 100. 0. 1. DISPLAY_IDENTIFIER LV_N_SP_IS_CH_DRI ECU_ADDRESS 0xd00075e4 BIT_MASK 0x1 /end MEASUREMENT
/begin MEASUREMENT mff_mplp_ch "Fuel mass for post injection" UWORD _CNV_A_R_LINEAR_____111_CM 1 100. 0. 1389. DISPLAY_IDENTIFIER MFF_MPLP_CH ECU_ADDRESS 0xd0006886 FORMAT "%7.2" /end MEASUREMENT
/begin MEASUREMENT lamb_cmb_s "" UWORD _CNV_A_R_LINEAR_____241_CM 1 100. 0. 31.99951171875 DISPLAY_IDENTIFIER LAMB_CMB_S ECU_ADDRESS 0xd000687a FORMAT "%9.6" /end MEASUREMENT
/begin MEASUREMENT ti_post_inj[0] "Injection time of the post injection" UWORD _CNV_A_R_LINEAR_____228_CM 1 100. 0. 65.535 DISPLAY_IDENTIFIER TI_POST_INJ[0] ECU_ADDRESS 0xd00068c4 /end MEASUREMENT
/begin MEASUREMENT ti_post_inj[1] "Injection time of the post injection" UWORD _CNV_A_R_LINEAR_____228_CM 1 100. 0. 65.535 DISPLAY_IDENTIFIER TI_POST_INJ[1] ECU_ADDRESS 0xd00068c6 /end MEASUREMENT
/begin MEASUREMENT ti_post_inj[2] "Injection time of the post injection" UWORD _CNV_A_R_LINEAR_____228_CM 1 100. 0. 65.535 DISPLAY_IDENTIFIER TI_POST_INJ[2] ECU_ADDRESS 0xd00068c8 /end MEASUREMENT
/begin MEASUREMENT ti_post_inj[3] "Injection time of the post injection" UWORD _CNV_A_R_LINEAR_____228_CM 1 100. 0. 65.535 DISPLAY_IDENTIFIER TI_POST_INJ[3] ECU_ADDRESS 0xd00068ca /end MEASUREMENT
/begin MEASUREMENT ti_post_inj[4] "Injection time of the post injection" UWORD _CNV_A_R_LINEAR_____228_CM 1 100. 0. 65.535 DISPLAY_IDENTIFIER TI_POST_INJ[4] ECU_ADDRESS 0xd00068cc /end MEASUREMENT
/begin MEASUREMENT ti_post_inj[5] "Injection time of the post injection" UWORD _CNV_A_R_LINEAR_____228_CM 1 100. 0. 65.535 DISPLAY_IDENTIFIER TI_POST_INJ[5] ECU_ADDRESS 0xd00068ce /end MEASUREMENT
/begin MEASUREMENT ti_post_inj[6] "Injection time of the post injection" UWORD _CNV_A_R_LINEAR_____228_CM 1 100. 0. 65.535 DISPLAY_IDENTIFIER TI_POST_INJ[6] ECU_ADDRESS 0xd00068d0 /end MEASUREMENT
/begin MEASUREMENT ti_post_inj[7] "Injection time of the post injection" UWORD _CNV_A_R_LINEAR_____228_CM 1 100. 0. 65.535 DISPLAY_IDENTIFIER TI_POST_INJ[7] ECU_ADDRESS 0xd00068d2 /end MEASUREMENT
/begin MEASUREMENT mff_post_inj[0] "Mass fuel flow of the post injection" UWORD _CNV_A_R_LINEAR_____111_CM 1 100. 0. 1389. DISPLAY_IDENTIFIER MFF_POST_INJ[0] ECU_ADDRESS 0xd0006888 FORMAT "%7.2" /end MEASUREMENT
/begin MEASUREMENT mff_post_inj[1] "Mass fuel flow of the post injection" UWORD _CNV_A_R_LINEAR_____111_CM 1 100. 0. 1389. DISPLAY_IDENTIFIER MFF_POST_INJ[1] ECU_ADDRESS 0xd000688a FORMAT "%7.2" /end MEASUREMENT
/begin MEASUREMENT mff_post_inj[2] "Mass fuel flow of the post injection" UWORD _CNV_A_R_LINEAR_____111_CM 1 100. 0. 1389. DISPLAY_IDENTIFIER MFF_POST_INJ[2] ECU_ADDRESS 0xd000688c FORMAT "%7.2" /end MEASUREMENT
/begin MEASUREMENT mff_post_inj[3] "Mass fuel flow of the post injection" UWORD _CNV_A_R_LINEAR_____111_CM 1 100. 0. 1389. DISPLAY_IDENTIFIER MFF_POST_INJ[3] ECU_ADDRESS 0xd000688e FORMAT "%7.2" /end MEASUREMENT
/begin MEASUREMENT mff_post_inj[4] "Mass fuel flow of the post injection" UWORD _CNV_A_R_LINEAR_____111_CM 1 100. 0. 1389. DISPLAY_IDENTIFIER MFF_POST_INJ[4] ECU_ADDRESS 0xd0006890 FORMAT "%7.2" /end MEASUREMENT
/begin MEASUREMENT mff_post_inj[5] "Mass fuel flow of the post injection" UWORD _CNV_A_R_LINEAR_____111_CM 1 100. 0. 1389. DISPLAY_IDENTIFIER MFF_POST_INJ[5] ECU_ADDRESS 0xd0006892 FORMAT "%7.2" /end MEASUREMENT
/begin MEASUREMENT mff_post_inj[6] "Mass fuel flow of the post injection" UWORD _CNV_A_R_LINEAR_____111_CM 1 100. 0. 1389. DISPLAY_IDENTIFIER MFF_POST_INJ[6] ECU_ADDRESS 0xd0006894 FORMAT "%7.2" /end MEASUREMENT
/begin MEASUREMENT mff_post_inj[7] "Mass fuel flow of the post injection" UWORD _CNV_A_R_LINEAR_____111_CM 1 100. 0. 1389. DISPLAY_IDENTIFIER MFF_POST_INJ[7] ECU_ADDRESS 0xd0006896 FORMAT "%7.2" /end MEASUREMENT
/begin MEASUREMENT lv_post_inj_act "Boolean variable indicating the post injection is active" UBYTE _CNV_S_2_RANGE__0___1_CM 1 100. 0. 1. DISPLAY_IDENTIFIER LV_POST_INJ_ACT ECU_ADDRESS 0xd00075e5 BIT_MASK 0x1 /end MEASUREMENT
/begin MEASUREMENT lv_iv_post_egy_rng "Boolean variable indicating used energy range" UBYTE _CNV_S_2_RANGE__0___1_CM 1 100. 0. 1. DISPLAY_IDENTIFIER LV_IV_POST_EGY_RNG ECU_ADDRESS 0xd00075e3 BIT_MASK 0x1 /end MEASUREMENT
/begin CHARACTERISTIC c_fup_cor_post_inj "Manula additive correction factor for injector pressure difference at post injection" VALUE 0xa0805f48 _REC_VAL_20_u2 347776. _CNV_A_R_LINEAR_____171_CM 0. 347776. DISPLAY_IDENTIFIER C_FUP_COR_POST_INJ FORMAT "%8.1" /end CHARACTERISTIC
/begin AXIS_PTS ldp_n_32_ip_fac_mff_mplp_ch_ast "" 0xa080579e n_32 _REC_AXS_20_u1 8160. _CNV_A_R_LINEAR_____10_CM 6 0. 8160. FORMAT "%4.0" /end AXIS_PTS
/begin CHARACTERISTIC ip_fac_mff_mplp_ch_ast "Correction factor for TCO and CYC_CAST for the mass fuel flow of the post injection" MAP 0xa0810780 _REC_MAP_20_u2_u1_u2 1.99996948242188 _CNV_A_R_LINEAR_____9_CM 0. 1.99996948242188 DISPLAY_IDENTIFIER IP_FAC_MFF_MPLP_CH_AST FORMAT "%7.5"
 /begin AXIS_DESCR COM_AXIS tco _CNV_A_R_LINEAR_____17_CM 8 -48. 142.5 FORMAT "%5.1" AXIS_PTS_REF ldp_tco_ip_fac_mff_mplp_ch_ast /end AXIS_DESCR
 /begin AXIS_DESCR COM_AXIS cyc_cast _CNV_A_R_LINEAR_____0_CM 8 0. 65535. FORMAT "%5.0" AXIS_PTS_REF ldp_cyc_cast_ip_fac_mff_mplp_ch /end AXIS_DESCR
/end CHARACTERISTIC
/begin AXIS_PTS ldp_tco_ip_fac_mff_mplp_ch_ast "" 0xa0805824 tco _REC_AXS_20_u1 190.5 _CNV_A_R_LINEAR_____17_CM 8 -48. 142.5 FORMAT "%5.1" /end AXIS_PTS
/begin AXIS_PTS ldp_cyc_cast_ip_fac_mff_mplp_ch "" 0xa08056f0 cyc_cast _REC_AXS_20_u2 65535. _CNV_A_R_LINEAR_____0_CM 8 0. 65535. FORMAT "%5.0" /end AXIS_PTS
/begin CHARACTERISTIC c_maf_fac_post_inj "Constant for stoichiometric air/ fuel ratio (=14.7)" VALUE 0xa0805f54 _REC_VAL_20_u2 31.99951171875 _CNV_A_R_LINEAR_____241_CM 0. 31.99951171875 DISPLAY_IDENTIFIER C_MAF_FAC_POST_INJ FORMAT "%9.6" /end CHARACTERISTIC
/begin CHARACTERISTIC lc_iv_post_egy_rng "Switch to select energy range" VALUE 0xa0805fbb _REC_VAL_20_u1 1. _CNV_A_R_LINEAR_____0_CM 0. 1. DISPLAY_IDENTIFIER LC_IV_POST_EGY_RNG FORMAT "%2.0" /end CHARACTERISTIC
/begin CHARACTERISTIC ip_fac_cor_post_inj "Engine speed correction factor for the mass fuel flow of the post injection" CURVE 0xa0805c3c _REC_CUR_20_u2_u1 1.99996948242188 _CNV_A_R_LINEAR_____9_CM 0. 1.99996948242188 DISPLAY_IDENTIFIER IP_FAC_COR_POST_INJ FORMAT "%7.5"
 /begin AXIS_DESCR COM_AXIS n_32 _CNV_A_R_LINEAR_____10_CM 6 0. 8160. FORMAT "%4.0" AXIS_PTS_REF ldp_n_32_ip_fac_mff_mplp_ch_ast /end AXIS_DESCR
/end CHARACTERISTIC
/begin CHARACTERISTIC ip_fac_mff_mplp_ch_ast_n_32 "Engine speed correction factor for the mass fuel flow of the post injection" CURVE 0xa0805ce0 _REC_CUR_20_u2_u1 1.99996948242188 _CNV_A_R_LINEAR_____9_CM 0. 1.99996948242188 DISPLAY_IDENTIFIER IP_FAC_MFF_MPLP_CH_AST_N_32 FORMAT "%7.5"
 /begin AXIS_DESCR COM_AXIS n_32 _CNV_A_R_LINEAR_____10_CM 6 0. 8160. FORMAT "%4.0" AXIS_PTS_REF ldp_n_32_ip_fac_mff_mplp_ch_ast /end AXIS_DESCR
/end CHARACTERISTIC
/begin CHARACTERISTIC ip_fac_mff_mplp_ch_l "Difference between cat. temperatures and target temp. depending correction for TQ_ADD_CH_L" MAP 0xa0810800 _REC_MAP_20_u2_u2_u2 1.99996948242188 _CNV_A_R_LINEAR_____9_CM 0. 1.99996948242188 DISPLAY_IDENTIFIER IP_FAC_MFF_MPLP_CH_L FORMAT "%7.5"
 /begin AXIS_DESCR COM_AXIS temp_cat_dif_ch_l _CNV_A_R_LINEAR_____781_CM 6 -1024. 1023.96875 FORMAT "%11.5" AXIS_PTS_REF ldpm_temp_cat_dif_ch_l_1_extc /end AXIS_DESCR
 /begin AXIS_DESCR COM_AXIS tnt_dif_ch_l _CNV_A_R_LINEAR_____781_CM 6 -1024. 1023.96875 FORMAT "%11.5" AXIS_PTS_REF ldpm_tnt_dif_ch_l_1_extc /end AXIS_DESCR
/end CHARACTERISTIC
/begin AXIS_PTS ldp_lamb_cmb_s_ip_mplp_ch_ast "" 0xa0805754 lamb_cmb_s _REC_AXS_20_u2 31.99951171875 _CNV_A_R_LINEAR_____241_CM 8 0. 31.99951171875 FORMAT "%9.6" /end AXIS_PTS
/begin AXIS_PTS ldp_lamb_cmb_s_ip_mff_mplp_ch_l "" 0xa0805740 lamb_cmb_s _REC_AXS_20_u2 31.99951171875 _CNV_A_R_LINEAR_____241_CM 8 0. 31.99951171875 FORMAT "%9.6" /end AXIS_PTS
/begin CHARACTERISTIC ip_mff_mplp_ch_ast "Basis map for the mass fuel flow of the post injection" MAP 0xa0810b40 _REC_MAP_20_u2_u2_u2 1389. _CNV_A_R_LINEAR_____111_CM 0. 1389. DISPLAY_IDENTIFIER IP_MFF_MPLP_CH_AST FORMAT "%7.2"
 /begin AXIS_DESCR COM_AXIS mff_sp_mv _CNV_A_R_LINEAR_____111_CM 6 0. 1389. FORMAT "%7.2" AXIS_PTS_REF ldpm_mff_sp_mv_1_extc /end AXIS_DESCR
 /begin AXIS_DESCR COM_AXIS lamb_cmb_s _CNV_A_R_LINEAR_____241_CM 8 0. 31.99951171875 FORMAT "%9.6" AXIS_PTS_REF ldp_lamb_cmb_s_ip_mplp_ch_ast /end AXIS_DESCR
/end CHARACTERISTIC
/begin CHARACTERISTIC ip_mff_mplp_ch_l "Basic map for the mass fuel flow of the post injection for low load CH" MAP 0xa0810ba0 _REC_MAP_20_u2_u2_u2 1389. _CNV_A_R_LINEAR_____111_CM 0. 1389. DISPLAY_IDENTIFIER IP_MFF_MPLP_CH_L FORMAT "%7.2"
 /begin AXIS_DESCR COM_AXIS mff_sp_mv _CNV_A_R_LINEAR_____111_CM 6 0. 1389. FORMAT "%7.2" AXIS_PTS_REF ldpm_mff_sp_mv_2_extc /end AXIS_DESCR
 /begin AXIS_DESCR COM_AXIS lamb_cmb_s _CNV_A_R_LINEAR_____241_CM 8 0. 31.99951171875 FORMAT "%9.6" AXIS_PTS_REF ldp_lamb_cmb_s_ip_mff_mplp_ch_l /end AXIS_DESCR
/end CHARACTERISTIC
/begin CHARACTERISTIC lc_mff_mplp_ch_man_act "Switch for manual mass fuel flow for the post injection for catalyst heating" VALUE 0xa0805fc0 _REC_VAL_20_u1 1. _CNV_S_2_RANGE__0___1_CM 0. 1. DISPLAY_IDENTIFIER LC_MFF_MPLP_CH_MAN_ACT /end CHARACTERISTIC
/begin CHARACTERISTIC c_mff_mplp_ch_man "Manual mass fuel flow for the post injection for catalyst heating" VALUE 0xa0805f56 _REC_VAL_20_u2 1389. _CNV_A_R_LINEAR_____111_CM 0. 1389. DISPLAY_IDENTIFIER C_MFF_MPLP_CH_MAN FORMAT "%7.2" /end CHARACTERISTIC
/begin CHARACTERISTIC lc_soi_post_inj_man_act "Switch for manual start of injection for the post injection" VALUE 0xa0805fc4 _REC_VAL_20_u1 1. _CNV_S_2_RANGE__0___1_CM 0. 1. DISPLAY_IDENTIFIER LC_SOI_POST_INJ_MAN_ACT /end CHARACTERISTIC
/begin MEASUREMENT eoi_lim_post "latest possible EOI" UWORD _CNV_A_R_LINEAR_____200_CM 1 100. 0. 720. DISPLAY_IDENTIFIER EOI_LIM_POST ECU_ADDRESS 0xd0006866 FORMAT "%6.2" /end MEASUREMENT
/begin MEASUREMENT soi_lim_post "earliest possible SOI" UWORD _CNV_A_R_LINEAR_____200_CM 1 100. 0. 720. DISPLAY_IDENTIFIER SOI_LIM_POST ECU_ADDRESS 0xd00068ac FORMAT "%6.2" /end MEASUREMENT
/begin MEASUREMENT soi_post_inj[0] "Start of the post injection" UWORD _CNV_A_R_LINEAR_____200_CM 1 100. 0. 720. DISPLAY_IDENTIFIER SOI_POST_INJ[0] ECU_ADDRESS 0xd00068b0 FORMAT "%6.2" /end MEASUREMENT
/begin MEASUREMENT soi_post_inj[1] "Start of the post injection" UWORD _CNV_A_R_LINEAR_____200_CM 1 100. 0. 720. DISPLAY_IDENTIFIER SOI_POST_INJ[1] ECU_ADDRESS 0xd00068b2 FORMAT "%6.2" /end MEASUREMENT
/begin MEASUREMENT soi_post_inj[2] "Start of the post injection" UWORD _CNV_A_R_LINEAR_____200_CM 1 100. 0. 720. DISPLAY_IDENTIFIER SOI_POST_INJ[2] ECU_ADDRESS 0xd00068b4 FORMAT "%6.2" /end MEASUREMENT
/begin MEASUREMENT soi_post_inj[3] "Start of the post injection" UWORD _CNV_A_R_LINEAR_____200_CM 1 100. 0. 720. DISPLAY_IDENTIFIER SOI_POST_INJ[3] ECU_ADDRESS 0xd00068b6 FORMAT "%6.2" /end MEASUREMENT
/begin MEASUREMENT soi_post_inj[4] "Start of the post injection" UWORD _CNV_A_R_LINEAR_____200_CM 1 100. 0. 720. DISPLAY_IDENTIFIER SOI_POST_INJ[4] ECU_ADDRESS 0xd00068b8 FORMAT "%6.2" /end MEASUREMENT
/begin MEASUREMENT soi_post_inj[5] "Start of the post injection" UWORD _CNV_A_R_LINEAR_____200_CM 1 100. 0. 720. DISPLAY_IDENTIFIER SOI_POST_INJ[5] ECU_ADDRESS 0xd00068ba FORMAT "%6.2" /end MEASUREMENT
/begin MEASUREMENT soi_post_inj[6] "Start of the post injection" UWORD _CNV_A_R_LINEAR_____200_CM 1 100. 0. 720. DISPLAY_IDENTIFIER SOI_POST_INJ[6] ECU_ADDRESS 0xd00068bc FORMAT "%6.2" /end MEASUREMENT
/begin MEASUREMENT soi_post_inj[7] "Start of the post injection" UWORD _CNV_A_R_LINEAR_____200_CM 1 100. 0. 720. DISPLAY_IDENTIFIER SOI_POST_INJ[7] ECU_ADDRESS 0xd00068be FORMAT "%6.2" /end MEASUREMENT
/begin MEASUREMENT eoi_post_inj[0] "End of the post injection" UWORD _CNV_A_R_LINEAR_____200_CM 1 100. 0. 720. DISPLAY_IDENTIFIER EOI_POST_INJ[0] ECU_ADDRESS 0xd0006868 FORMAT "%6.2" /end MEASUREMENT
/begin MEASUREMENT eoi_post_inj[1] "End of the post injection" UWORD _CNV_A_R_LINEAR_____200_CM 1 100. 0. 720. DISPLAY_IDENTIFIER EOI_POST_INJ[1] ECU_ADDRESS 0xd000686a FORMAT "%6.2" /end MEASUREMENT
/begin MEASUREMENT eoi_post_inj[2] "End of the post injection" UWORD _CNV_A_R_LINEAR_____200_CM 1 100. 0. 720. DISPLAY_IDENTIFIER EOI_POST_INJ[2] ECU_ADDRESS 0xd000686c FORMAT "%6.2" /end MEASUREMENT
/begin MEASUREMENT eoi_post_inj[3] "End of the post injection" UWORD _CNV_A_R_LINEAR_____200_CM 1 100. 0. 720. DISPLAY_IDENTIFIER EOI_POST_INJ[3] ECU_ADDRESS 0xd000686e FORMAT "%6.2" /end MEASUREMENT
/begin MEASUREMENT eoi_post_inj[4] "End of the post injection" UWORD _CNV_A_R_LINEAR_____200_CM 1 100. 0. 720. DISPLAY_IDENTIFIER EOI_POST_INJ[4] ECU_ADDRESS 0xd0006870 FORMAT "%6.2" /end MEASUREMENT
/begin MEASUREMENT eoi_post_inj[5] "End of the post injection" UWORD _CNV_A_R_LINEAR_____200_CM 1 100. 0. 720. DISPLAY_IDENTIFIER EOI_POST_INJ[5] ECU_ADDRESS 0xd0006872 FORMAT "%6.2" /end MEASUREMENT
/begin MEASUREMENT eoi_post_inj[6] "End of the post injection" UWORD _CNV_A_R_LINEAR_____200_CM 1 100. 0. 720. DISPLAY_IDENTIFIER EOI_POST_INJ[6] ECU_ADDRESS 0xd0006874 FORMAT "%6.2" /end MEASUREMENT
/begin MEASUREMENT eoi_post_inj[7] "End of the post injection" UWORD _CNV_A_R_LINEAR_____200_CM 1 100. 0. 720. DISPLAY_IDENTIFIER EOI_POST_INJ[7] ECU_ADDRESS 0xd0006876 FORMAT "%6.2" /end MEASUREMENT
/begin CHARACTERISTIC c_eoi_lim_post "Latest possible EOI" VALUE 0xa0805f40 _REC_VAL_20_u2 720. _CNV_A_R_LINEAR_____200_CM 0. 720. DISPLAY_IDENTIFIER C_EOI_LIM_POST FORMAT "%6.2" /end CHARACTERISTIC
/begin CHARACTERISTIC c_soi_lim_post "Earliest possible SOI" VALUE 0xa0805f66 _REC_VAL_20_u2 720. _CNV_A_R_LINEAR_____200_CM 0. 720. DISPLAY_IDENTIFIER C_SOI_LIM_POST FORMAT "%6.2" /end CHARACTERISTIC
/begin MEASUREMENT soi_mplp_dif_ch "Start of injection of the second injection for catalyst heating" UWORD _CNV_A_R_LINEAR_____200_CM 1 100. 0. 720. DISPLAY_IDENTIFIER SOI_MPLP_DIF_CH ECU_ADDRESS 0xd00068ae FORMAT "%6.2" /end MEASUREMENT
/begin CHARACTERISTIC c_soi_post_inj_man "Manual start of injection for the post injection" VALUE 0xa0805f6a _REC_VAL_20_u2 720. _CNV_A_R_LINEAR_____200_CM 0. 720. DISPLAY_IDENTIFIER C_SOI_POST_INJ_MAN FORMAT "%6.2" /end CHARACTERISTIC
/begin CHARACTERISTIC c_soi_mplp_man "Manual start of injection for the post injection" VALUE 0xa0805f68 _REC_VAL_20_u2 720. _CNV_A_R_LINEAR_____200_CM 0. 720. DISPLAY_IDENTIFIER C_SOI_MPLP_MAN FORMAT "%6.2" /end CHARACTERISTIC
/begin CHARACTERISTIC lc_soi_mplp_man_act "Switch for manual start of injection for the post injection" VALUE 0xa0805fc3 _REC_VAL_20_u1 1. _CNV_S_2_RANGE__0___1_CM 0. 1. DISPLAY_IDENTIFIER LC_SOI_MPLP_MAN_ACT /end CHARACTERISTIC
/begin CHARACTERISTIC ip_soi_mplp_add_mff_post_ch_l "Mass of post injection depending correction of start of injection of post injection for low load strat. CH" CURVE 0xa0805ee0 _REC_CUR_20_u2_u2 720. _CNV_A_R_LINEAR_____200_CM 0. 720. DISPLAY_IDENTIFIER IP_SOI_MPLP_ADD_MFF_POST_CH_L FORMAT "%7.3"
 /begin AXIS_DESCR COM_AXIS online_dummy _CNV_A_R_LINEAR_____111_CM 6 0. 1389. FORMAT "%7.2" AXIS_PTS_REF ldpm_mff_post_inj_1_extc /end AXIS_DESCR
/end CHARACTERISTIC
/begin CHARACTERISTIC ip_soi_mplp_dif_ch_ast "start of injection of the second injection for catalyst heating" MAP 0xa0810fd0 _REC_MAP_20_u2_u1_u2 720. _CNV_A_R_LINEAR_____200_CM 0. 720. DISPLAY_IDENTIFIER IP_SOI_MPLP_DIF_CH_AST FORMAT "%7.3"
 /begin AXIS_DESCR COM_AXIS n_32 _CNV_A_R_LINEAR_____10_CM 6 0. 8160. FORMAT "%4.0" AXIS_PTS_REF ldpm_n_32_2_extc /end AXIS_DESCR
 /begin AXIS_DESCR COM_AXIS mff_sp_mv _CNV_A_R_LINEAR_____111_CM 6 0. 1389. FORMAT "%7.2" AXIS_PTS_REF ldpm_mff_sp_mv_1_extc /end AXIS_DESCR
/end CHARACTERISTIC
/begin CHARACTERISTIC ip_soi_mplp_dif_ch_l "Start of injection of post injection for low load stratified catalyst heating" MAP 0xa0811018 _REC_MAP_20_u2_u1_u2 720. _CNV_A_R_LINEAR_____200_CM 0. 720. DISPLAY_IDENTIFIER IP_SOI_MPLP_DIF_CH_L FORMAT "%7.3"
 /begin AXIS_DESCR COM_AXIS n_32 _CNV_A_R_LINEAR_____10_CM 6 0. 8160. FORMAT "%4.0" AXIS_PTS_REF ldpm_n_32_6_extc /end AXIS_DESCR
 /begin AXIS_DESCR COM_AXIS mff_sp_mv _CNV_A_R_LINEAR_____111_CM 6 0. 1389. FORMAT "%7.2" AXIS_PTS_REF ldpm_mff_sp_mv_2_extc /end AXIS_DESCR
/end CHARACTERISTIC
/begin MEASUREMENT state_ch_mod "Catalyst heading strategy" UBYTE _CNV_S_5_EXTC_RANGE_782_CM 1 100. 0. 4. DISPLAY_IDENTIFIER STATE_CH_MOD ECU_ADDRESS 0xd00075ea /end MEASUREMENT
/begin MEASUREMENT state_ch_mod_req "State of requested catalyst heating strategy, 1st priority" UBYTE _CNV_S_5_EXTC_RANGE_782_CM 1 100. 0. 4. DISPLAY_IDENTIFIER STATE_CH_MOD_REQ ECU_ADDRESS 0xd00075ef /end MEASUREMENT
/begin CHARACTERISTIC c_nr_pri_ch_mod "Priority of catalyst heating strategy" VALUE 0xa0805f60 _REC_VAL_20_s1 255. _CNV_A_R_LINEAR_____0_CM -128. 127. DISPLAY_IDENTIFIER C_NR_PRI_CH_MOD FORMAT "%4.0" /end CHARACTERISTIC
/begin CHARACTERISTIC c_nr_pri_ch_mod_req "Priority of requested catalyst heating strategy" VALUE 0xa0805f61 _REC_VAL_20_s1 255. _CNV_A_R_LINEAR_____0_CM -128. 127. DISPLAY_IDENTIFIER C_NR_PRI_CH_MOD_REQ FORMAT "%4.0" /end CHARACTERISTIC
/begin MEASUREMENT nr_pri_ch_mod "Priority of catalyst heating strategy" SBYTE _CNV_A_R_LINEAR_____0_CM 1 100. -128. 127. DISPLAY_IDENTIFIER NR_PRI_CH_MOD ECU_ADDRESS 0xd00075e6 FORMAT "%4.0" /end MEASUREMENT
/begin MEASUREMENT nr_pri_ch_mod_req "Priority of requested catalyst heating strategy" SBYTE _CNV_A_R_LINEAR_____0_CM 1 100. -128. 127. DISPLAY_IDENTIFIER NR_PRI_CH_MOD_REQ ECU_ADDRESS 0xd00075e7 FORMAT "%4.0" /end MEASUREMENT
/begin MEASUREMENT state_ch_mod_l "Catlyst heating strategy for low load heating" UBYTE _CNV_S_5_EXTC_RANGE_782_CM 1 100. 0. 4. DISPLAY_IDENTIFIER STATE_CH_MOD_L ECU_ADDRESS 0xd00075ee /end MEASUREMENT
/begin MEASUREMENT state_ch_mod_req_l "State of requested low load catalyst heating strategy, 1st priority" UBYTE _CNV_S_5_EXTC_RANGE_782_CM 1 100. 0. 4. DISPLAY_IDENTIFIER STATE_CH_MOD_REQ_L ECU_ADDRESS 0xd00075f1 /end MEASUREMENT
/begin MEASUREMENT nr_pri_ch_mod_req_l "Priority of requested catalyst heating strategy for low load catalyst heating" SBYTE _CNV_A_R_LINEAR_____0_CM 1 100. -128. 127. DISPLAY_IDENTIFIER NR_PRI_CH_MOD_REQ_L ECU_ADDRESS 0xd00075e8 FORMAT "%4.0" /end MEASUREMENT
/begin CHARACTERISTIC c_nr_pri_ch_mod_req_l_act "Priority of requested catalyst heating strategy for switching to homogeneous mode" VALUE 0xa0805f62 _REC_VAL_20_s1 255. _CNV_A_R_LINEAR_____0_CM -128. 127. DISPLAY_IDENTIFIER C_NR_PRI_CH_MOD_REQ_L_ACT FORMAT "%4.0" /end CHARACTERISTIC
/begin CHARACTERISTIC c_nr_pri_ch_mod_req_l_pas "Priority of passive requested catalyst heating strategy in low load catalyst heating" VALUE 0xa0805f63 _REC_VAL_20_s1 255. _CNV_A_R_LINEAR_____0_CM -128. 127. DISPLAY_IDENTIFIER C_NR_PRI_CH_MOD_REQ_L_PAS FORMAT "%4.0" /end CHARACTERISTIC
/begin CHARACTERISTIC c_temp_cat_min_swi_hom_ch_l "Threshold of catalyst temperature for switching from stratified to homogeneous in low load CH" VALUE 0xa0805f72 _REC_VAL_20_u2 1023.984375 _CNV_A_R_LINEAR_____780_CM -33. 990.984375 DISPLAY_IDENTIFIER C_TEMP_CAT_MIN_SWI_HOM_CH_L FORMAT "%10.6" /end CHARACTERISTIC
/begin CHARACTERISTIC c_temp_cat_min_swi_homs_ch_l "Threshold of catalyst temperature for switching from stratified to homogeneous in low load CH" VALUE 0xa0805f74 _REC_VAL_20_u2 1023.984375 _CNV_A_R_LINEAR_____780_CM -33. 990.984375 DISPLAY_IDENTIFIER C_TEMP_CAT_MIN_SWI_HOMS_CH_L FORMAT "%10.6" /end CHARACTERISTIC
/begin CHARACTERISTIC c_tnt_min_swi_hom_ch_l "Threshold of NOx trap temperature for switching from stratified to homogeneous in low load CH" VALUE 0xa0805f88 _REC_VAL_20_u2 1023.984375 _CNV_A_R_LINEAR_____209_CM 0. 1023.984375 DISPLAY_IDENTIFIER C_TNT_MIN_SWI_HOM_CH_L FORMAT "%11.6" /end CHARACTERISTIC
/begin CHARACTERISTIC c_tnt_min_swi_homs_ch_l "Threshold of NOx trap temperature for switching from stratified to homogeneous in low load CH" VALUE 0xa0805f8a _REC_VAL_20_u2 1023.984375 _CNV_A_R_LINEAR_____209_CM 0. 1023.984375 DISPLAY_IDENTIFIER C_TNT_MIN_SWI_HOMS_CH_L FORMAT "%11.6" /end CHARACTERISTIC
/begin CHARACTERISTIC c_temp_hys_swi_homs_ch_l "Hysteresis of temperature threshold for switching in homogenous stratified mode in low load catalyst heating" VALUE 0xa0805f80 _REC_VAL_20_u2 1023.984375 _CNV_A_R_LINEAR_____209_CM 0. 1023.984375 DISPLAY_IDENTIFIER C_TEMP_HYS_SWI_HOMS_CH_L FORMAT "%11.6" /end CHARACTERISTIC
/begin CHARACTERISTIC c_temp_hys_swi_hom_ch_l "Hysteresis of temperature threshold for switching in homogenous mode in low load catalyst heating" VALUE 0xa0805f7e _REC_VAL_20_u2 1023.984375 _CNV_A_R_LINEAR_____209_CM 0. 1023.984375 DISPLAY_IDENTIFIER C_TEMP_HYS_SWI_HOM_CH_L FORMAT "%11.6" /end CHARACTERISTIC
/begin CHARACTERISTIC ip_maf_dif_add_mff_post_ch_l "Mass of post injection depending correction for MAF_DIF" CURVE 0xa0805e70 _REC_CUR_20_u2_u2 1389. _CNV_A_R_LINEAR_____111_CM 0. 1389. DISPLAY_IDENTIFIER IP_MAF_DIF_ADD_MFF_POST_CH_L FORMAT "%7.2"
 /begin AXIS_DESCR COM_AXIS online_dummy _CNV_A_R_LINEAR_____111_CM 6 0. 1389. FORMAT "%7.2" AXIS_PTS_REF ldpm_mff_post_inj_1_extc /end AXIS_DESCR
/end CHARACTERISTIC
/begin CHARACTERISTIC ip_maf_dif_s_ch_l_bas "basic difference of mass of air flow for low load stratified catalyst heating" MAP 0xa0810af8 _REC_MAP_20_u2_u1_u2 1389. _CNV_A_R_LINEAR_____111_CM 0. 1389. DISPLAY_IDENTIFIER IP_MAF_DIF_S_CH_L_BAS FORMAT "%7.2"
 /begin AXIS_DESCR COM_AXIS n_32 _CNV_A_R_LINEAR_____10_CM 6 0. 8160. FORMAT "%4.0" AXIS_PTS_REF ldpm_n_32_6_extc /end AXIS_DESCR
 /begin AXIS_DESCR COM_AXIS mff_sp_mv _CNV_A_R_LINEAR_____111_CM 6 0. 1389. FORMAT "%7.2" AXIS_PTS_REF ldpm_mff_sp_mv_2_extc /end AXIS_DESCR
/end CHARACTERISTIC
/begin CHARACTERISTIC c_maf_dif_s_ch_man "Manual setting of MAF difference for stratified catalyst heating" VALUE 0xa0805f52 _REC_VAL_20_u2 1389. _CNV_A_R_LINEAR_____111_CM 0. 1389. DISPLAY_IDENTIFIER C_MAF_DIF_S_CH_MAN FORMAT "%7.2" /end CHARACTERISTIC
/begin CHARACTERISTIC lc_maf_dif_s_ch_man_act "Activation of manual setting of MAF difference for stratified catalyst heating" VALUE 0xa0805fbf _REC_VAL_20_u1 1. _CNV_A_R_LINEAR_____0_CM 0. 1. DISPLAY_IDENTIFIER LC_MAF_DIF_S_CH_MAN_ACT FORMAT "%1.0" /end CHARACTERISTIC
/begin MEASUREMENT maf_dif_s_ch "Mass air flow difference for cat. heating in stratified mode (possibly with post injection)" UWORD _CNV_A_R_LINEAR_____111_CM 1 100. 0. 1389. DISPLAY_IDENTIFIER MAF_DIF_S_CH ECU_ADDRESS 0xd0006884 FORMAT "%7.2" /end MEASUREMENT
/begin MEASUREMENT tnt_dif_ch_so2p "Difference between desulfation setpoint and actual value of TNT" SWORD _CNV_A_R_LINEAR_____523_CM 1 100. -1024. 1023.96875 DISPLAY_IDENTIFIER TNT_DIF_CH_SO2P ECU_ADDRESS 0xd00068d6 FORMAT "%11.5" /end MEASUREMENT
/begin MEASUREMENT state_ch_mod_so2p "Catalyst heating strategy for desulfation catalyst heating" UBYTE _CNV_S_5_EXTC_RANGE_783_CM 1 100. 0. 4. DISPLAY_IDENTIFIER STATE_CH_MOD_SO2P ECU_ADDRESS 0xd00075f3 /end MEASUREMENT
/begin MEASUREMENT state_ch_mod_req_so2p "Requested CH strategy (combustion mode) for desulfation catalyst heating" UBYTE _CNV_S_5_EXTC_RANGE_783_CM 1 100. 0. 4. DISPLAY_IDENTIFIER STATE_CH_MOD_REQ_SO2P ECU_ADDRESS 0xd00075f2 /end MEASUREMENT
/begin CHARACTERISTIC c_tnt_sp_ch_so2p "Setpoint of TNT for desulfation catalyst heating" VALUE 0xa0805f8c _REC_VAL_20_u2 1023.984375 _CNV_A_R_LINEAR_____209_CM 0. 1023.984375 DISPLAY_IDENTIFIER C_TNT_SP_CH_SO2P FORMAT "%11.6" /end CHARACTERISTIC
/begin AXIS_PTS ldp_n_32_id_ch_mod_req_so2p "" 0xa0805796 n_32 _REC_AXS_20_u1 8160. _CNV_A_R_LINEAR_____10_CM 6 0. 8160. FORMAT "%4.0" /end AXIS_PTS
/begin AXIS_PTS ldp_maf_id_ch_mod_req_so2p "" 0xa0805768 maf _REC_AXS_20_u2 1389. _CNV_A_R_LINEAR_____111_CM 6 0. 1389. FORMAT "%7.2" /end AXIS_PTS
/begin CHARACTERISTIC id_state_ch_mod_req_so2p "Requested CH (combustion mode) for desulfation catalyst heating" MAP 0xa0805ba0 _REC_MAP_20_u1_u1_u2 2. _CNV_A_R_LINEAR_____0_CM 0. 2. DISPLAY_IDENTIFIER ID_STATE_CH_MOD_REQ_SO2P FORMAT "%1.0"
 /begin AXIS_DESCR COM_AXIS n_32 _CNV_A_R_LINEAR_____10_CM 6 0. 8160. FORMAT "%4.0" AXIS_PTS_REF ldp_n_32_id_ch_mod_req_so2p /end AXIS_DESCR
 /begin AXIS_DESCR COM_AXIS maf _CNV_A_R_LINEAR_____111_CM 6 0. 1389. FORMAT "%7.2" AXIS_PTS_REF ldp_maf_id_ch_mod_req_so2p /end AXIS_DESCR
/end CHARACTERISTIC
/begin CHARACTERISTIC c_state_ch_mod_so2p_man "Manual setting of catalyst heating strategy" VALUE 0xa0805f6d _REC_VAL_20_u1 2. _CNV_S_3_EXTC_RANGE_796_CM 0. 2. DISPLAY_IDENTIFIER C_STATE_CH_MOD_SO2P_MAN /end CHARACTERISTIC
/begin CHARACTERISTIC lc_state_ch_mod_so2p_man_act "Activation of manual setting of catalyst heating strategy" VALUE 0xa0805fc6 _REC_VAL_20_u1 1. _CNV_S_2_RANGE__0___1_CM 0. 1. DISPLAY_IDENTIFIER LC_STATE_CH_MOD_SO2P_MAN_ACT /end CHARACTERISTIC
/begin MEASUREMENT fup_sp_ch "Fuel pressure setpoint for catalyst heading - used for MPLH-mode" UWORD _CNV_A_R_LINEAR_____171_CM 1 100. 0. 347776. DISPLAY_IDENTIFIER FUP_SP_CH ECU_ADDRESS 0xd0006878 FORMAT "%6.0" /end MEASUREMENT
/begin CHARACTERISTIC c_fup_sp_ch_pas "Passive value for fuel pressure setpoint for catalyst heating" VALUE 0xa0805f4a _REC_VAL_20_u2 347776. _CNV_A_R_LINEAR_____171_CM 0. 347776. DISPLAY_IDENTIFIER C_FUP_SP_CH_PAS FORMAT "%6.0" /end CHARACTERISTIC
/begin AXIS_PTS ldp_tco_st_ip_fac_fup_sp_ch "Factor for fuel pressure setpoint during (MPLH)   catalyst heating" 0xa0805842 tco_st _REC_AXS_20_u1 190.5 _CNV_A_R_LINEAR_____17_CM 4 -48. 142.5 FORMAT "%5.1" /end AXIS_PTS
/begin AXIS_PTS ldp_t_ast_ip_fac_fup_sp_ch "Factor for fuel pressure setpoint during (MPLH)   catalyst heating" 0xa0805814 t_ast _REC_AXS_20_u2 6553.5 _CNV_A_R_LINEAR_____4_CM 6 0. 6553.5 FORMAT "%6.1" /end AXIS_PTS
/begin AXIS_PTS ldp_n_32_ip_fup_sp_ch "Fuel pressure setpoint for catalyst heating   used for MPLH mode" 0xa08057a6 n_32 _REC_AXS_20_u1 8160. _CNV_A_R_LINEAR_____10_CM 6 0. 8160. FORMAT "%4.0" /end AXIS_PTS
/begin AXIS_PTS ldp_tqi_req_tra_ip_fup_sp_ch "Fuel pressure setpoint for catalyst heating   used for MPLH mode" 0xa0805898 tqi_req_tra _REC_AXS_20_u2 1023.96875 _CNV_A_R_LINEAR_____31_CM 6 0. 1023.96875 FORMAT "%7.2" /end AXIS_PTS
/begin MEASUREMENT pwm_acr "Finally duty cycle of idgital actuator control" SWORD _CNV_A_R_LINEAR_____212_CM 1 100. -100. 99.9969482421875 DISPLAY_IDENTIFIER PWM_ACR ECU_ADDRESS 0xd0006500 FORMAT "%8.3" /end MEASUREMENT
/begin MEASUREMENT opg_dif_acr "Control deviation of the digital actuator conrol" SWORD _CNV_A_R_ACRC_LINEA_431_CM 1 100. -100. 99.9755859375 DISPLAY_IDENTIFIER OPG_DIF_ACR ECU_ADDRESS 0xd00064ec FORMAT "%7.2" /end MEASUREMENT
/begin MEASUREMENT fac_vb_pwm_acr "Factor for battery voltage correction" UWORD _CNV_A_R_LINEAR_____129_CM 1 100. 0. 2. DISPLAY_IDENTIFIER FAC_VB_PWM_ACR ECU_ADDRESS 0xd00064e8 FORMAT "%4.3" /end MEASUREMENT
/begin MEASUREMENT opg_sp_ctl_acr "setpoint for digital actuator control" UWORD _CNV_A_R_ACRC_LINEA_431_CM 1 100. 0. 99.9755859375 DISPLAY_IDENTIFIER OPG_SP_CTL_ACR ECU_ADDRESS 0xd00064f2 FORMAT "%5.2" /end MEASUREMENT
/begin CHARACTERISTIC c_fac_c_1_acr_ctl "Filter parameter c1 of the ACR position controller" VALUE 0xa0800748 _REC_VAL_20_s2 7.999878 _CNV_A_R_ACRC_LINEA_802_CM -4. 3.999878 DISPLAY_IDENTIFIER C_FAC_C_1_ACR_CTL FORMAT "%10.9" /end CHARACTERISTIC
/begin CHARACTERISTIC c_fac_c_2_acr_ctl "Filter parameter c2 of the ACR position controller" VALUE 0xa080074a _REC_VAL_20_s2 7.999878 _CNV_A_R_ACRC_LINEA_802_CM -4. 3.999878 DISPLAY_IDENTIFIER C_FAC_C_2_ACR_CTL FORMAT "%10.9" /end CHARACTERISTIC
/begin CHARACTERISTIC c_fac_c_3_acr_ctl "Filter parameter c3 of the ACR position controller" VALUE 0xa080074c _REC_VAL_20_s2 7.999878 _CNV_A_R_ACRC_LINEA_802_CM -4. 3.999878 DISPLAY_IDENTIFIER C_FAC_C_3_ACR_CTL FORMAT "%10.9" /end CHARACTERISTIC
/begin CHARACTERISTIC c_fac_f_1_acr_ctl "Filter parameter f1of the ACR position controller" VALUE 0xa080074e _REC_VAL_20_s2 7.999878 _CNV_A_R_ACRC_LINEA_802_CM -4. 3.999878 DISPLAY_IDENTIFIER C_FAC_F_1_ACR_CTL FORMAT "%10.9" /end CHARACTERISTIC
/begin CHARACTERISTIC c_fac_f_2_acr_ctl "Filter parameter f2 of the ACR position controller" VALUE 0xa0800750 _REC_VAL_20_s2 7.999878 _CNV_A_R_ACRC_LINEA_802_CM -4. 3.999878 DISPLAY_IDENTIFIER C_FAC_F_2_ACR_CTL FORMAT "%10.9" /end CHARACTERISTIC
/begin CHARACTERISTIC c_fac_f_3_acr_ctl "Filter parameter f3 of the ACR position controller" VALUE 0xa0800752 _REC_VAL_20_s2 7.999878 _CNV_A_R_ACRC_LINEA_802_CM -4. 3.999878 DISPLAY_IDENTIFIER C_FAC_F_3_ACR_CTL FORMAT "%10.9" /end CHARACTERISTIC
/begin CHARACTERISTIC c_frq_pwm_acr "Frequency of the PWM signal used for closed-loop actuaor control" VALUE 0xa0800758 _REC_VAL_20_u2 6553.5 _CNV_A_R_ACRC_LINEA_804_CM 0. 6553.5 DISPLAY_IDENTIFIER C_FRQ_PWM_ACR FORMAT "%4.1" /end CHARACTERISTIC
/begin CHARACTERISTIC c_kp_acr_ctl "Amplification factor of the ACR position controller" VALUE 0xa080075a _REC_VAL_20_u2 64. _CNV_A_R_EVAC_LINEA_298_CM 0. 64. DISPLAY_IDENTIFIER C_KP_ACR_CTL FORMAT "%4.3" /end CHARACTERISTIC
/begin CHARACTERISTIC c_pwm_acr_close "Static PWM duty cycle for the closing of the actuator" VALUE 0xa080076c _REC_VAL_20_s2 199.9969482421875 _CNV_A_R_LINEAR_____212_CM -100. 99.9969482421875 DISPLAY_IDENTIFIER C_PWM_ACR_CLOSE FORMAT "%8.3" /end CHARACTERISTIC
/begin CHARACTERISTIC c_pwm_max_acr_ctl "Upper limitation threshold of the ACR position controller" VALUE 0xa0800770 _REC_VAL_20_s2 199.9969482421875 _CNV_A_R_LINEAR_____212_CM -100. 99.9969482421875 DISPLAY_IDENTIFIER C_PWM_MAX_ACR_CTL FORMAT "%8.3" /end CHARACTERISTIC
/begin CHARACTERISTIC c_pwm_min_acr_ctl "Lower limitation threshold of the ACR position controller" VALUE 0xa0800772 _REC_VAL_20_s2 199.9969482421875 _CNV_A_R_LINEAR_____212_CM -100. 99.9969482421875 DISPLAY_IDENTIFIER C_PWM_MIN_ACR_CTL FORMAT "%8.3" /end CHARACTERISTIC
/begin CHARACTERISTIC c_rate_opg_sp_acr "Setpoint rate limitation threshold of the ACR position controller" VALUE 0xa0800774 _REC_VAL_20_u2 99.9755859375 _CNV_A_R_ACRC_LINEA_431_CM 0. 99.9755859375 DISPLAY_IDENTIFIER C_RATE_OPG_SP_ACR FORMAT "%5.2" /end CHARACTERISTIC
/begin AXIS_PTS ldp_vb_mmv_ip_fac_vb_pwm_acr "" 0xa0800716 vb_mmv _REC_AXS_20_u1 25.8984 _CNV_A_R_LINEAR_____22_CM 4 0. 25.8984 FORMAT "%3.1" /end AXIS_PTS
/begin CHARACTERISTIC ip_fac_vb_pwm_acr "Factor for battery voltage correction" CURVE 0xa080071c _REC_CUR_20_u2_u1 2. _CNV_A_R_LINEAR_____129_CM 0. 2. DISPLAY_IDENTIFIER IP_FAC_VB_PWM_ACR FORMAT "%4.3"
 /begin AXIS_DESCR COM_AXIS vb_mmv _CNV_A_R_LINEAR_____22_CM 4 0. 25.8984 FORMAT "%3.1" AXIS_PTS_REF ldp_vb_mmv_ip_fac_vb_pwm_acr /end AXIS_DESCR
/end CHARACTERISTIC
/begin AXIS_PTS ldp_opg_sp_acr_ip_pwm_acr_stat "" 0xa080070c opg_sp_acr _REC_AXS_20_u2 99.9755859375 _CNV_A_R_ACRC_LINEA_431_CM 4 0. 99.9755859375 FORMAT "%5.2" /end AXIS_PTS
/begin CHARACTERISTIC ip_pwm_acr_stat "Feedforward control of the ACR position controller" CURVE 0xa080072c _REC_CUR_20_u2_u2 199.99694824 _CNV_A_R_LINEAR_____263_CM -100. 99.99694824 DISPLAY_IDENTIFIER IP_PWM_ACR_STAT FORMAT "%8.3"
 /begin AXIS_DESCR COM_AXIS opg_sp_acr _CNV_A_R_ACRC_LINEA_431_CM 4 0. 99.9755859375 FORMAT "%5.2" AXIS_PTS_REF ldp_opg_sp_acr_ip_pwm_acr_stat /end AXIS_DESCR
/end CHARACTERISTIC
/begin MEASUREMENT state_acr_ctl "The state variable indicates the state of the ACR position contotrol" UBYTE _CNV_S_3_ACRC_RANGE_805_CM 1 100. 0. 2. DISPLAY_IDENTIFIER STATE_ACR_CTL ECU_ADDRESS 0xd0007389 /end MEASUREMENT
/begin MEASUREMENT lv_err_acr_ctl "Present failure for the actuator diagnosis after the error debounce" UBYTE _CNV_S_2_RANGE__0___1_CM 1 100. 0. 1. DISPLAY_IDENTIFIER LV_ERR_ACR_CTL ECU_ADDRESS 0xd0008029 BIT_MASK 0x1 /end MEASUREMENT
/begin MEASUREMENT ctr_diag_acr_ctl "Anti bounce counter for the actuator diagnosis" UBYTE _CNV_A_R_LINEAR_____0_CM 1 100. 0. 255. DISPLAY_IDENTIFIER CTR_DIAG_ACR_CTL ECU_ADDRESS 0xd000737d FORMAT "%3.0" /end MEASUREMENT
/begin MEASUREMENT pwm_acr_mmv "Moving mean value of the actuator position controller output" UWORD _CNV_A_R_LINEAR_____212_CM 1 100. 0. 99.9969482421875 DISPLAY_IDENTIFIER PWM_ACR_MMV ECU_ADDRESS 0xd00004ea FORMAT "%7.3" /end MEASUREMENT
/begin MEASUREMENT opg_sp_acr_fil "Actuator valve position setpoint after filtering by low pass first order" UWORD _CNV_A_R_ACRC_LINEA_431_CM 1 100. 0. 99.9755859375 DISPLAY_IDENTIFIER OPG_SP_ACR_FIL ECU_ADDRESS 0xd00004e6 FORMAT "%5.2" /end MEASUREMENT
/begin MEASUREMENT opg_dif_acr_err_max "Maximum admissible control deviation of the closed loop position control system" UWORD _CNV_A_R_ACRC_LINEA_431_CM 1 100. 0. 99.9755859375 DISPLAY_IDENTIFIER OPG_DIF_ACR_ERR_MAX ECU_ADDRESS 0xd00004e4 FORMAT "%5.2" /end MEASUREMENT
/begin MEASUREMENT opg_sp_acr_grd "Gradient of the actuator valve position setpoint determined by low pass first order" SWORD _CNV_A_R_ACRC_LINEA_431_CM 1 100. -100. 99.9755859375 DISPLAY_IDENTIFIER OPG_SP_ACR_GRD ECU_ADDRESS 0xd00004e8 FORMAT "%7.2" /end MEASUREMENT
/begin CHARACTERISTIC c_abc_dec_acr_ctl "Anti bounce counter decrement for the actuator diagnosis" VALUE 0xa0800734 _REC_VAL_20_u1 255. _CNV_A_R_LINEAR_____0_CM 0. 255. DISPLAY_IDENTIFIER C_ABC_DEC_ACR_CTL FORMAT "%3.0" /end CHARACTERISTIC
/begin CHARACTERISTIC c_abc_inc_acr_ctl "Anti bounce counter increment for the actuator diagnosis" VALUE 0xa0800735 _REC_VAL_20_u1 255. _CNV_A_R_LINEAR_____0_CM 0. 255. DISPLAY_IDENTIFIER C_ABC_INC_ACR_CTL FORMAT "%3.0" /end CHARACTERISTIC
/begin CHARACTERISTIC c_abc_max_acr_ctl "Maximum value for anti bounce counter for the actuator diagnosis" VALUE 0xa0800738 _REC_VAL_20_u1 254. _CNV_A_R_LINEAR_____0_CM 1. 255. DISPLAY_IDENTIFIER C_ABC_MAX_ACR_CTL FORMAT "%3.0" /end CHARACTERISTIC
/begin CHARACTERISTIC c_crlc_opg_sp_acr "Correlation constant for filtering of OPG_SP_ACR" VALUE 0xa080073c _REC_VAL_20_u2 0.9999847412109381 _CNV_A_R_LINEAR_____89_CM 0. 0.9999847412109381 DISPLAY_IDENTIFIER C_CRLC_OPG_SP_ACR FORMAT "%7.5" /end CHARACTERISTIC
/begin CHARACTERISTIC c_crlc_pwm_acr "Correlation constant for filtering of PWM_ACR" VALUE 0xa080073e _REC_VAL_20_u2 0.9999847412109381 _CNV_A_R_LINEAR_____89_CM 0. 0.9999847412109381 DISPLAY_IDENTIFIER C_CRLC_PWM_ACR FORMAT "%7.5" /end CHARACTERISTIC
/begin CHARACTERISTIC c_pwm_acr_max_diag "Maximum permitted PWM output of the ACR position controller" VALUE 0xa080076e _REC_VAL_20_u2 99.9969482421875 _CNV_A_R_LINEAR_____212_CM 0. 99.9969482421875 DISPLAY_IDENTIFIER C_PWM_ACR_MAX_DIAG FORMAT "%7.3" /end CHARACTERISTIC
/begin CHARACTERISTIC c_vb_min_pwm_acr_diag "Threshold depend on battery voltage for the activation of the PWM_ACR monitoring" VALUE 0xa0800789 _REC_VAL_20_u1 25.8984375 _CNV_A_R_LINEAR_____272_CM 0. 25.8984375 DISPLAY_IDENTIFIER C_VB_MIN_PWM_ACR_DIAG FORMAT "%9.6" /end CHARACTERISTIC
/begin CHARACTERISTIC ip_opg_dif_acr_err_max "Maximum admissible control deviation dependent on the actuator valve setpoint gradient" CURVE 0xa0800724 _REC_CUR_20_u2_u2 99.9755859375 _CNV_A_R_ACRC_LINEA_431_CM 0. 99.9755859375 DISPLAY_IDENTIFIER IP_OPG_DIF_ACR_ERR_MAX FORMAT "%5.2"
 /begin AXIS_DESCR COM_AXIS opg_sp_acr_grd _CNV_A_R_ACRC_LINEA_431_CM 4 0. 99.9755859375 FORMAT "%5.2" AXIS_PTS_REF ldp_opg_sp_acr_grd_absv_ip_opg /end AXIS_DESCR
/end CHARACTERISTIC
/begin AXIS_PTS ldp_opg_sp_acr_grd_absv_ip_opg "" 0xa0800700 opg_sp_acr_grd _REC_AXS_20_u2 99.9755859375 _CNV_A_R_ACRC_LINEA_431_CM 4 0. 99.9755859375 FORMAT "%5.2" /end AXIS_PTS
/begin MEASUREMENT lv_inh_diag_acr_ctl "Inhibition condition for the actuator diagnosis" UBYTE _CNV_S_2_RANGE__0___1_CM 1 100. 0. 1. DISPLAY_IDENTIFIER LV_INH_DIAG_ACR_CTL ECU_ADDRESS 0xd0007390 BIT_MASK 0x1 /end MEASUREMENT
/begin MEASUREMENT lv_pwm_acr_off_req "ACR position control deactivation requested from monitoring level 1" UBYTE _CNV_S_2_RANGE__0___1_CM 1 100. 0. 1. DISPLAY_IDENTIFIER LV_PWM_ACR_OFF_REQ ECU_ADDRESS 0xd0007394 BIT_MASK 0x1 /end MEASUREMENT
/begin MEASUREMENT lv_err_sens_acr "Present failure for sensor signal range check after error debounce" UBYTE _CNV_S_2_RANGE__0___1_CM 1 100. 0. 1. DISPLAY_IDENTIFIER LV_ERR_SENS_ACR ECU_ADDRESS 0xd0008028 BIT_MASK 0x1 /end MEASUREMENT
/begin CHARACTERISTIC c_abc_inc_sens_acr "Anti bounce counter increment for signal range check" VALUE 0xa0800737 _REC_VAL_20_u1 255. _CNV_A_R_LINEAR_____0_CM 0. 255. DISPLAY_IDENTIFIER C_ABC_INC_SENS_ACR FORMAT "%3.0" /end CHARACTERISTIC
/begin CHARACTERISTIC c_abc_max_sens_acr "Maximum value for anti bounce counter for signal range check" VALUE 0xa080073a _REC_VAL_20_u1 254. _CNV_A_R_LINEAR_____0_CM 1. 255. DISPLAY_IDENTIFIER C_ABC_MAX_SENS_ACR FORMAT "%3.0" /end CHARACTERISTIC
/begin CHARACTERISTIC c_v_max_sens_acr "Upper diagnostic threshold for the signal range check" VALUE 0xa0800784 _REC_VAL_20_u2 4.9951171875 _CNV_A_R_LINEAR_____2_CM 0. 4.9951171875 DISPLAY_IDENTIFIER C_V_MAX_SENS_ACR FORMAT "%5.3" /end CHARACTERISTIC
/begin CHARACTERISTIC c_v_min_sens_acr "Lower diagnostic threshold for the signal range check" VALUE 0xa0800786 _REC_VAL_20_u2 4.9951171875 _CNV_A_R_LINEAR_____2_CM 0. 4.9951171875 DISPLAY_IDENTIFIER C_V_MIN_SENS_ACR FORMAT "%5.3" /end CHARACTERISTIC
/begin MEASUREMENT lv_inh_diag_sens_acr "Inhibition condition for the position sensor range check" UBYTE _CNV_S_2_RANGE__0___1_CM 1 100. 0. 1. DISPLAY_IDENTIFIER LV_INH_DIAG_SENS_ACR ECU_ADDRESS 0xd0007392 BIT_MASK 0x1 /end MEASUREMENT
/begin MEASUREMENT lv_err_vcc_acr "Actuator sensor supply voltage error, variable is not supported by ERRM" UBYTE _CNV_S_2_RANGE__0___1_CM 1 100. 0. 1. DISPLAY_IDENTIFIER LV_ERR_VCC_ACR ECU_ADDRESS 0xd000738e BIT_MASK 0x1 /end MEASUREMENT
/begin MEASUREMENT lv_err_acr_dr "Present failure for power stage diagnosis after error debounce " UBYTE _CNV_S_2_RANGE__0___1_CM 1 100. 0. 1. DISPLAY_IDENTIFIER LV_ERR_ACR_DR ECU_ADDRESS 0xd000802a BIT_MASK 0x1 /end MEASUREMENT
/begin CHARACTERISTIC c_abc_inc_acr_dr "Anti bounce counter increment for the power stage diagnosis" VALUE 0xa0800736 _REC_VAL_20_u1 255. _CNV_A_R_LINEAR_____0_CM 0. 255. DISPLAY_IDENTIFIER C_ABC_INC_ACR_DR FORMAT "%3.0" /end CHARACTERISTIC
/begin CHARACTERISTIC c_abc_max_acr_dr "Maximum value for anti bounce counter for the power stage diagnosis" VALUE 0xa0800739 _REC_VAL_20_u1 254. _CNV_A_R_LINEAR_____0_CM 1. 255. DISPLAY_IDENTIFIER C_ABC_MAX_ACR_DR FORMAT "%3.0" /end CHARACTERISTIC
/begin MEASUREMENT lv_inh_diag_acr_dr "Inhibition condition for the power stage diagnosis" UBYTE _CNV_S_2_RANGE__0___1_CM 1 100. 0. 1. DISPLAY_IDENTIFIER LV_INH_DIAG_ACR_DR ECU_ADDRESS 0xd0007391 BIT_MASK 0x1 /end MEASUREMENT
/begin CHARACTERISTIC c_vb_min_acr_dr_diag "Minimum threshold for the activation/deactivation of the power stage diagnosis" VALUE 0xa0800788 _REC_VAL_20_u1 25.8984375 _CNV_A_R_LINEAR_____272_CM 0. 25.8984375 DISPLAY_IDENTIFIER C_VB_MIN_ACR_DR_DIAG FORMAT "%9.6" /end CHARACTERISTIC
/begin MEASUREMENT opg_acr "Measured opening of the actuator valve" UWORD _CNV_A_R_ACRC_LINEA_431_CM 1 100. 0. 99.9755859375 DISPLAY_IDENTIFIER OPG_ACR ECU_ADDRESS 0xd00064ea FORMAT "%5.2" /end MEASUREMENT
/begin MEASUREMENT v_acr "Voltage value for actuator position control delivered from the measuring system" UWORD _CNV_A_R_LINEAR_____224_CM 1 100. 0. 4.995 DISPLAY_IDENTIFIER V_ACR ECU_ADDRESS 0xd0006502 FORMAT "%5.3" /end MEASUREMENT
/begin MEASUREMENT v_acr_mv "Voltage value for actuator position control delivered from the measuring system with higher resolution" UWORD _CNV_A_R_ACRC_LINEA_806_CM 1 100. 0. 4.9951 DISPLAY_IDENTIFIER V_ACR_MV ECU_ADDRESS 0xd000650c FORMAT "%3.2" /end MEASUREMENT
/begin MEASUREMENT v_acr_bas "Raw value of the measuring system for sctuator position control" UWORD _CNV_A_R_LINEAR_____224_CM 1 100. 0. 4.995 DISPLAY_IDENTIFIER V_ACR_BAS ECU_ADDRESS 0xd000650a FORMAT "%5.3" /end MEASUREMENT
/begin MEASUREMENT opg_sp_acr "Setpoint request after limitation for actuator position control" UWORD _CNV_A_R_ACRC_LINEA_431_CM 1 100. 0. 99.9755859375 DISPLAY_IDENTIFIER OPG_SP_ACR ECU_ADDRESS 0xd00064ee FORMAT "%5.2" /end MEASUREMENT
/begin CHARACTERISTIC c_opg_sp_max_acr "Upper limitation theshold of the actuator position setpoint" VALUE 0xa0800762 _REC_VAL_20_u2 99.9755859375 _CNV_A_R_ACRC_LINEA_431_CM 0. 99.9755859375 DISPLAY_IDENTIFIER C_OPG_SP_MAX_ACR FORMAT "%5.2" /end CHARACTERISTIC
/begin CHARACTERISTIC c_opg_sp_min_acr "Lower limitation threshold of the actuator position setpoint" VALUE 0xa0800766 _REC_VAL_20_u2 99.9755859375 _CNV_A_R_ACRC_LINEA_431_CM 0. 99.9755859375 DISPLAY_IDENTIFIER C_OPG_SP_MIN_ACR FORMAT "%5.2" /end CHARACTERISTIC
/begin MEASUREMENT opg_sp_sel_acr "Setpoint request after setpoint selection for actuator position control" UWORD _CNV_A_R_ACRC_LINEA_431_CM 1 100. 0. 99.9755859375 DISPLAY_IDENTIFIER OPG_SP_SEL_ACR ECU_ADDRESS 0xd00064fe FORMAT "%5.2" /end MEASUREMENT
/begin MEASUREMENT lv_opg_sp_lih_acr "Logical variable indicates a LIH setpoint request for actuator position control" UBYTE _CNV_S_2_RANGE__0___1_CM 1 100. 0. 1. DISPLAY_IDENTIFIER LV_OPG_SP_LIH_ACR ECU_ADDRESS 0xd0007386 BIT_MASK 0x1 /end MEASUREMENT
/begin MEASUREMENT opg_sp_lih_acr "Limp-home position setpoint for actuator position control" UWORD _CNV_A_R_ACRC_LINEA_431_CM 1 100. 0. 99.9755859375 DISPLAY_IDENTIFIER OPG_SP_LIH_ACR ECU_ADDRESS 0xd00064f6 FORMAT "%5.2" /end MEASUREMENT
/begin MEASUREMENT lv_opg_sp_ext_acr "Logical variable indicates a external setpoint request for actuator position control" UBYTE _CNV_S_2_RANGE__0___1_CM 1 100. 0. 1. DISPLAY_IDENTIFIER LV_OPG_SP_EXT_ACR ECU_ADDRESS 0xd0007385 BIT_MASK 0x1 /end MEASUREMENT
/begin MEASUREMENT opg_sp_ext_acr "External position setpoint for actuator position control" UWORD _CNV_A_R_ACRC_LINEA_431_CM 1 100. 0. 99.9755859375 DISPLAY_IDENTIFIER OPG_SP_EXT_ACR ECU_ADDRESS 0xd00064f4 FORMAT "%5.2" /end MEASUREMENT
/begin MEASUREMENT lv_opg_sp_pop_acr "Lagical variable indicates a setpoint request during the post operating phase for actuator position control" UBYTE _CNV_S_2_RANGE__0___1_CM 1 100. 0. 1. DISPLAY_IDENTIFIER LV_OPG_SP_POP_ACR ECU_ADDRESS 0xd0007387 BIT_MASK 0x1 /end MEASUREMENT
/begin MEASUREMENT opg_sp_pop_acr "Position setpoint during post operating phase for actuator position control" UWORD _CNV_A_R_ACRC_LINEA_431_CM 1 100. 0. 99.9755859375 DISPLAY_IDENTIFIER OPG_SP_POP_ACR ECU_ADDRESS 0xd00064f8 FORMAT "%5.2" /end MEASUREMENT
/begin MEASUREMENT state_acr_ctl_req "The state variable indicates the request for digital actuator control" UBYTE _CNV_S_3_ACRC_RANGE_807_CM 1 100. 0. 2. DISPLAY_IDENTIFIER STATE_ACR_CTL_REQ ECU_ADDRESS 0xd000738a /end MEASUREMENT
/begin CHARACTERISTIC c_ctr_dly_acr_ctl "Time delay for the deactivation of the actuator position control" VALUE 0xa0800743 _REC_VAL_20_u1 255. _CNV_A_R_LINEAR_____0_CM 0. 255. DISPLAY_IDENTIFIER C_CTR_DLY_ACR_CTL FORMAT "%3.0" /end CHARACTERISTIC
/begin CHARACTERISTIC c_ctr_opg_sp_pop_acr "Delay counter for the deactivation of the position controller in the post-operating phase" VALUE 0xa0800745 _REC_VAL_20_u1 255. _CNV_A_R_LINEAR_____0_CM 0. 255. DISPLAY_IDENTIFIER C_CTR_OPG_SP_POP_ACR FORMAT "%3.0" /end CHARACTERISTIC
/begin CHARACTERISTIC c_opg_sp_ext_acr "External position setpoint requested from the calibration system" VALUE 0xa080075e _REC_VAL_20_u2 99.9755859375 _CNV_A_R_ACRC_LINEA_431_CM 0. 99.9755859375 DISPLAY_IDENTIFIER C_OPG_SP_EXT_ACR FORMAT "%5.2" /end CHARACTERISTIC
/begin CHARACTERISTIC c_opg_sp_lih_acr "Position setpoint requestedduring limp-home mode has been activated" VALUE 0xa0800760 _REC_VAL_20_u2 99.9755859375 _CNV_A_R_ACRC_LINEA_431_CM 0. 99.9755859375 DISPLAY_IDENTIFIER C_OPG_SP_LIH_ACR FORMAT "%5.2" /end CHARACTERISTIC
/begin CHARACTERISTIC c_opg_sp_min_acr_ctl "Deactivation threshold for actuator position control in normal operation" VALUE 0xa0800768 _REC_VAL_20_u2 99.9755859375 _CNV_A_R_ACRC_LINEA_431_CM 0. 99.9755859375 DISPLAY_IDENTIFIER C_OPG_SP_MIN_ACR_CTL FORMAT "%5.2" /end CHARACTERISTIC
/begin CHARACTERISTIC c_opg_sp_pop_acr "Position setpoint request in the post-operating phase" VALUE 0xa080076a _REC_VAL_20_u2 99.9755859375 _CNV_A_R_ACRC_LINEA_431_CM 0. 99.9755859375 DISPLAY_IDENTIFIER C_OPG_SP_POP_ACR FORMAT "%5.2" /end CHARACTERISTIC
/begin CHARACTERISTIC lc_opg_sp_ext_acr "Activation of hte external setpoint adjustment made with the calibration system" VALUE 0xa080078c _REC_VAL_20_u1 1. _CNV_S_2_RANGE__0___1_CM 0. 1. DISPLAY_IDENTIFIER LC_OPG_SP_EXT_ACR /end CHARACTERISTIC
/begin CHARACTERISTIC lc_pwm_acr_off_ena "Logical canstant distinguishs between power stage deactivation and static PWM duty-cycle for actuator closing" VALUE 0xa080078d _REC_VAL_20_u1 1. _CNV_S_2_RANGE__0___1_CM 0. 1. DISPLAY_IDENTIFIER LC_PWM_ACR_OFF_ENA /end CHARACTERISTIC
/begin MEASUREMENT lv_inh_acr_ctl_ad "Logical variable to inhibit actuator position control" UBYTE _CNV_S_2_RANGE__0___1_CM 1 100. 0. 1. DISPLAY_IDENTIFIER LV_INH_ACR_CTL_AD ECU_ADDRESS 0xd0007384 BIT_MASK 0x1 /end MEASUREMENT
/begin MEASUREMENT fac_acr_slop "Signal slop of the actuator measuring system" UWORD _CNV_A_R_ACRC_LINEA_808_CM 1 100. 0. 99.99850000000001 DISPLAY_IDENTIFIER FAC_ACR_SLOP ECU_ADDRESS 0xd00064e6 FORMAT "%3.2" /end MEASUREMENT
/begin MEASUREMENT ctr_dly_acr_ad "Delay counter for the activation of the actuator adaption" UBYTE _CNV_A_R_LINEAR_____0_CM 1 100. 0. 255. DISPLAY_IDENTIFIER CTR_DLY_ACR_AD ECU_ADDRESS 0xd000737e FORMAT "%3.0" /end MEASUREMENT
/begin MEASUREMENT ctr_inh_acr_ad "Counter variable to inhibit actuator position control for valid adaption value" UBYTE _CNV_A_R_LINEAR_____0_CM 1 100. 0. 255. DISPLAY_IDENTIFIER CTR_INH_ACR_AD ECU_ADDRESS 0xd000737f FORMAT "%3.0" /end MEASUREMENT
/begin CHARACTERISTIC c_crlc_acr_ad "Correlation constant for the determination of the actuator adaption value" VALUE 0xa080073b _REC_VAL_20_u1 0.99609375 _CNV_A_R_LINEAR_____28_CM 0. 0.99609375 DISPLAY_IDENTIFIER C_CRLC_ACR_AD FORMAT "%5.3" /end CHARACTERISTIC
/begin CHARACTERISTIC c_ctr_dly_acr_ad_max "Delay counter for the activation of the actuator adaption" VALUE 0xa0800742 _REC_VAL_20_u1 255. _CNV_A_R_LINEAR_____0_CM 0. 255. DISPLAY_IDENTIFIER C_CTR_DLY_ACR_AD_MAX FORMAT "%3.0" /end CHARACTERISTIC
/begin CHARACTERISTIC c_ctr_inh_acr_ad_max "Maximum counter to inhibit actuator position control for valid adaption value" VALUE 0xa0800744 _REC_VAL_20_u1 255. _CNV_A_R_LINEAR_____0_CM 0. 255. DISPLAY_IDENTIFIER C_CTR_INH_ACR_AD_MAX FORMAT "%3.0" /end CHARACTERISTIC
/begin CHARACTERISTIC c_fac_acr_slop "Signal slop of the actuator measuring system" VALUE 0xa0800746 _REC_VAL_20_u2 99.99850000000001 _CNV_A_R_ACRC_LINEA_808_CM 0. 99.99850000000001 DISPLAY_IDENTIFIER C_FAC_ACR_SLOP FORMAT "%3.2" /end CHARACTERISTIC
/begin CHARACTERISTIC c_v_acr_ad_bol_ini "Initialisation value for the adapption value of the lower mechanical stop" VALUE 0xa0800776 _REC_VAL_20_u2 4.9951171875 _CNV_A_R_LINEAR_____2_CM 0. 4.9951171875 DISPLAY_IDENTIFIER C_V_ACR_AD_BOL_INI FORMAT "%5.3" /end CHARACTERISTIC
/begin CHARACTERISTIC c_v_acr_ad_bol_max "Upper limit for the plausibility check of the adaption value for the lower mechanical stop" VALUE 0xa0800778 _REC_VAL_20_u2 4.9951171875 _CNV_A_R_LINEAR_____2_CM 0. 4.9951171875 DISPLAY_IDENTIFIER C_V_ACR_AD_BOL_MAX FORMAT "%5.3" /end CHARACTERISTIC
/begin CHARACTERISTIC c_v_acr_ad_bol_min "Lower limit for the plausibility check of the adaption value for the lower mechanical stop" VALUE 0xa080077a _REC_VAL_20_u2 4.9951171875 _CNV_A_R_LINEAR_____2_CM 0. 4.9951171875 DISPLAY_IDENTIFIER C_V_ACR_AD_BOL_MIN FORMAT "%5.3" /end CHARACTERISTIC
/begin MEASUREMENT lv_err_acr_ad "Logical variable is set, if an adaption error occurs" UBYTE _CNV_S_2_RANGE__0___1_CM 1 100. 0. 1. DISPLAY_IDENTIFIER LV_ERR_ACR_AD ECU_ADDRESS 0xd0008027 BIT_MASK 0x1 /end MEASUREMENT
/begin MEASUREMENT state_acr_ad "Variable indicate the state of the key on actuator adaption" UBYTE _CNV_S_5_ACRC_RANGE_809_CM 1 100. 0. 4. DISPLAY_IDENTIFIER STATE_ACR_AD ECU_ADDRESS 0xd0007388 /end MEASUREMENT
/begin MEASUREMENT lv_opg_sp_ad_acr "Lagical variable indicates a setpoint request for the actuator adaption" UBYTE _CNV_S_2_RANGE__0___1_CM 1 100. 0. 1. DISPLAY_IDENTIFIER LV_OPG_SP_AD_ACR ECU_ADDRESS 0xd0007393 BIT_MASK 0x1 /end MEASUREMENT
/begin MEASUREMENT opg_sp_ad_acr "Actuator adaption setpoint request for actuator position control" UWORD _CNV_A_R_ACRC_LINEA_431_CM 1 100. 0. 99.9755859375 DISPLAY_IDENTIFIER OPG_SP_AD_ACR ECU_ADDRESS 0xd00064f0 FORMAT "%5.2" /end MEASUREMENT
/begin CHARACTERISTIC c_ctr_acr_ad "Maximum time for the adaption of the lower and upper mechanical stop" VALUE 0xa0800740 _REC_VAL_20_u1 255. _CNV_A_R_LINEAR_____0_CM 0. 255. DISPLAY_IDENTIFIER C_CTR_ACR_AD FORMAT "%3.0" /end CHARACTERISTIC
/begin CHARACTERISTIC c_ctr_dly_acr_ad "Delay time befor adaption of the lower and upper mechanical stop will be started" VALUE 0xa0800741 _REC_VAL_20_u1 255. _CNV_A_R_LINEAR_____0_CM 0. 255. DISPLAY_IDENTIFIER C_CTR_DLY_ACR_AD FORMAT "%3.0" /end CHARACTERISTIC
/begin CHARACTERISTIC c_opg_sp_ad_lgrd "Change limitation for the adaption of the upper mechanical stop" VALUE 0xa080075c _REC_VAL_20_u2 99.9755859375 _CNV_A_R_ACRC_LINEA_431_CM 0. 99.9755859375 DISPLAY_IDENTIFIER C_OPG_SP_AD_LGRD FORMAT "%5.2" /end CHARACTERISTIC
/begin CHARACTERISTIC c_opg_sp_max_ad_acr "Start setpoint for the adaption of the upper mechanical stop" VALUE 0xa0800764 _REC_VAL_20_u2 99.9755859375 _CNV_A_R_ACRC_LINEA_431_CM 0. 99.9755859375 DISPLAY_IDENTIFIER C_OPG_SP_MAX_AD_ACR FORMAT "%5.2" /end CHARACTERISTIC
/begin CHARACTERISTIC c_v_acr_ad_chk_ctl "Threshold for the actuator function check during the upper mechanical stop adaption" VALUE 0xa080077c _REC_VAL_20_u2 4.9951171875 _CNV_A_R_LINEAR_____2_CM 0. 4.9951171875 DISPLAY_IDENTIFIER C_V_ACR_AD_CHK_CTL FORMAT "%5.3" /end CHARACTERISTIC
/begin CHARACTERISTIC c_v_acr_ad_tol_ini "Initialisation value of the upper mechanical stop" VALUE 0xa080077e _REC_VAL_20_u2 4.995 _CNV_A_R_LINEAR_____224_CM 0. 4.995 DISPLAY_IDENTIFIER C_V_ACR_AD_TOL_INI FORMAT "%5.3" /end CHARACTERISTIC
/begin CHARACTERISTIC c_v_acr_ad_tol_max "Upper limit for the plausibility check of the adaption value for the upper mechanical stop" VALUE 0xa0800780 _REC_VAL_20_u2 4.995 _CNV_A_R_LINEAR_____224_CM 0. 4.995 DISPLAY_IDENTIFIER C_V_ACR_AD_TOL_MAX FORMAT "%5.3" /end CHARACTERISTIC
/begin CHARACTERISTIC lc_fac_acr_slop_ad_ena "Logical constant to enable the adaption of the upper mechanical stop" VALUE 0xa080078b _REC_VAL_20_u1 1. _CNV_S_2_RANGE__0___1_CM 0. 1. DISPLAY_IDENTIFIER LC_FAC_ACR_SLOP_AD_ENA /end CHARACTERISTIC
/begin CHARACTERISTIC c_v_acr_ad_tol_min "Lower limit for the plausibility check of the adaption value for the upper mechanical stop" VALUE 0xa0800782 _REC_VAL_20_u2 4.995 _CNV_A_R_LINEAR_____224_CM 0. 4.995 DISPLAY_IDENTIFIER C_V_ACR_AD_TOL_MIN FORMAT "%5.3" /end CHARACTERISTIC
/begin MEASUREMENT v_acr_ad_tol "Adaption value for the upper mechanical stop" UWORD _CNV_A_R_LINEAR_____2_CM 1 100. 0. 4.9951171875 DISPLAY_IDENTIFIER V_ACR_AD_TOL ECU_ADDRESS 0xd0006508 FORMAT "%5.3" /end MEASUREMENT
/begin MEASUREMENT v_acr_ad_bol "Adaption value for the lower mechanical stop of the actuator valve" UWORD _CNV_A_R_LINEAR_____2_CM 1 100. 0. 4.9951171875 DISPLAY_IDENTIFIER V_ACR_AD_BOL ECU_ADDRESS 0xd0006504 FORMAT "%5.3" /end MEASUREMENT
/begin MEASUREMENT v_acr_ad_bol_0 "Adaptation value for the lower mechanical stop after first adaptation" UWORD _CNV_A_R_LINEAR_____2_CM 1 100. 0. 4.9951171875 DISPLAY_IDENTIFIER V_ACR_AD_BOL_0 ECU_ADDRESS 0xd0006506 FORMAT "%5.3" /end MEASUREMENT
/begin MEASUREMENT lv_inh_acr_ad "Inhibition condition for the actuator adapion and diagnosis" UBYTE _CNV_S_2_RANGE__0___1_CM 1 100. 0. 1. DISPLAY_IDENTIFIER LV_INH_ACR_AD ECU_ADDRESS 0xd0007383 BIT_MASK 0x1 /end MEASUREMENT
/begin MEASUREMENT lv_acr_ad_act "Logical variable to indicate an active actuator adaption" UBYTE _CNV_S_2_RANGE__0___1_CM 1 100. 0. 1. DISPLAY_IDENTIFIER LV_ACR_AD_ACT ECU_ADDRESS 0xd000738c BIT_MASK 0x1 /end MEASUREMENT
/begin MEASUREMENT lv_acr_ad_req "Logical variable to indicate an actuator adaption request" UBYTE _CNV_S_2_RANGE__0___1_CM 1 100. 0. 1. DISPLAY_IDENTIFIER LV_ACR_AD_REQ ECU_ADDRESS 0xd000738d BIT_MASK 0x1 /end MEASUREMENT
/begin MEASUREMENT lv_inh_acr_ad_bol "Inhibition condition for the continuous actuator adaption and diagnosis" UBYTE _CNV_S_2_RANGE__0___1_CM 1 100. 0. 1. DISPLAY_IDENTIFIER LV_INH_ACR_AD_BOL ECU_ADDRESS 0xd000738f BIT_MASK 0x1 /end MEASUREMENT
/begin CHARACTERISTIC lc_acr_ad_req "Logigal variable to set a new adaption request" VALUE 0xa080078a _REC_VAL_20_u1 1. _CNV_S_2_RANGE__0___1_CM 0. 1. DISPLAY_IDENTIFIER LC_ACR_AD_REQ /end CHARACTERISTIC
/begin MEASUREMENT av_open_egr "actual opening value of the EGR valve after adaptation" UBYTE _CNV_A_R_LINEAR_____5_CM 1 100. 0. 99.609375 DISPLAY_IDENTIFIER AV_OPEN_EGR ECU_ADDRESS 0xd000737c FORMAT "%4.1" /end MEASUREMENT
/begin MEASUREMENT lv_err_egr_2 "stucked valve or potentiometer failed" UBYTE _CNV_S_2_RANGE__0___1_CM 1 100. 0. 1. DISPLAY_IDENTIFIER LV_ERR_EGR_2 ECU_ADDRESS 0xd0007382 BIT_MASK 0x1 /end MEASUREMENT
/begin MEASUREMENT stk_av_egr "actual value of the stroke of EGR value" UBYTE _CNV_A_R_LINEAR_____5_CM 1 100. 0. 99.609375 DISPLAY_IDENTIFIER STK_AV_EGR ECU_ADDRESS 0xd000738b /end MEASUREMENT
/begin MEASUREMENT lv_er_fdout "" UBYTE _CNV_S_2_RANGE__0___1_CM 1 100. 0. 1. DISPLAY_IDENTIFIER LV_ER_FDOUT ECU_ADDRESS 0xd0007381 /end MEASUREMENT
/begin MEASUREMENT lv_egr_act "Logical value for EGR-control active" UBYTE _CNV_S_2_RANGE__0___1_CM 1 100. 0. 1. DISPLAY_IDENTIFIER LV_EGR_ACT ECU_ADDRESS 0xd0007380 /end MEASUREMENT
/begin MEASUREMENT opg_sp_req_acr "Actuator valve position setpoint request in normal operation" UWORD _CNV_A_R_ACRC_LINEA_431_CM 1 100. 0. 99.9755859375 DISPLAY_IDENTIFIER OPG_SP_REQ_ACR ECU_ADDRESS 0xd00064fa FORMAT "%5.2" /end MEASUREMENT
/begin MEASUREMENT egr_ratio_sp "EGR-Ratio Setpoint" UWORD _CNV_A_R_LINEAR_____8_CM 1 100. 0. 99.99847412109381 DISPLAY_IDENTIFIER EGR_RATIO_SP ECU_ADDRESS 0xd00064e4 /end MEASUREMENT
/begin MEASUREMENT opg_sp_req_acr_1 "Actuator valve position setpoint request in normal operation" UWORD _CNV_A_R_ACRC_LINEA_431_CM 1 100. 0. 99.9755859375 DISPLAY_IDENTIFIER OPG_SP_REQ_ACR_1 ECU_ADDRESS 0xd00064fc FORMAT "%5.2" /end MEASUREMENT
/begin CHARACTERISTIC c_vb_td_max_lim_h "High battery voltage threshold above which we apply NC_TD_LIM_MAX_H for maximum dwell time" VALUE 0xa08008df _REC_VAL_20_u1 25.8984375 _CNV_A_R_LINEAR_____272_CM 0. 25.8984375 DISPLAY_IDENTIFIER C_VB_TD_MAX_LIM_H FORMAT "%9.6" /end CHARACTERISTIC
/begin CHARACTERISTIC c_vb_td_max_lim_l "Low battery voltage threshold below which we apply NC_TD_LIM_MAX_L for maximum dwell time" VALUE 0xa08008e0 _REC_VAL_20_u1 25.8984375 _CNV_A_R_LINEAR_____272_CM 0. 25.8984375 DISPLAY_IDENTIFIER C_VB_TD_MAX_LIM_L FORMAT "%9.6" /end CHARACTERISTIC
/begin MEASUREMENT td_lim_max "maximum dwell time allowed" UWORD _CNV_A_R_LINEAR_____456_CM 1 100. 0. 262.14 DISPLAY_IDENTIFIER TD_LIM_MAX ECU_ADDRESS 0xd000658c FORMAT "%7.3" /end MEASUREMENT
/begin MEASUREMENT td_igc_tmp[0] "dwell time duration" UWORD _CNV_A_R_LINEAR_____456_CM 1 100. 0. 262.14 DISPLAY_IDENTIFIER TD_IGC_TMP[0] ECU_ADDRESS 0xd000657c FORMAT "%7.3" /end MEASUREMENT
/begin MEASUREMENT td_igc_tmp[1] "dwell time duration" UWORD _CNV_A_R_LINEAR_____456_CM 1 100. 0. 262.14 DISPLAY_IDENTIFIER TD_IGC_TMP[1] ECU_ADDRESS 0xd000657e FORMAT "%7.3" /end MEASUREMENT
/begin MEASUREMENT td_igc_tmp[2] "dwell time duration" UWORD _CNV_A_R_LINEAR_____456_CM 1 100. 0. 262.14 DISPLAY_IDENTIFIER TD_IGC_TMP[2] ECU_ADDRESS 0xd0006580 FORMAT "%7.3" /end MEASUREMENT
/begin MEASUREMENT td_igc_tmp[3] "dwell time duration" UWORD _CNV_A_R_LINEAR_____456_CM 1 100. 0. 262.14 DISPLAY_IDENTIFIER TD_IGC_TMP[3] ECU_ADDRESS 0xd0006582 FORMAT "%7.3" /end MEASUREMENT
/begin MEASUREMENT td_igc_tmp[4] "dwell time duration" UWORD _CNV_A_R_LINEAR_____456_CM 1 100. 0. 262.14 DISPLAY_IDENTIFIER TD_IGC_TMP[4] ECU_ADDRESS 0xd0006584 FORMAT "%7.3" /end MEASUREMENT
/begin MEASUREMENT td_igc_tmp[5] "dwell time duration" UWORD _CNV_A_R_LINEAR_____456_CM 1 100. 0. 262.14 DISPLAY_IDENTIFIER TD_IGC_TMP[5] ECU_ADDRESS 0xd0006586 FORMAT "%7.3" /end MEASUREMENT
/begin MEASUREMENT td_igc_tmp[6] "dwell time duration" UWORD _CNV_A_R_LINEAR_____456_CM 1 100. 0. 262.14 DISPLAY_IDENTIFIER TD_IGC_TMP[6] ECU_ADDRESS 0xd0006588 FORMAT "%7.3" /end MEASUREMENT
/begin MEASUREMENT td_igc_tmp[7] "dwell time duration" UWORD _CNV_A_R_LINEAR_____456_CM 1 100. 0. 262.14 DISPLAY_IDENTIFIER TD_IGC_TMP[7] ECU_ADDRESS 0xd000658a FORMAT "%7.3" /end MEASUREMENT
/begin MEASUREMENT iga_igc_h_rng_tmp[0] "Ignition angle (high range) of cylinder x" SWORD _CNV_A_R_LINEAR_____188_CM 1 100. -90. 90. DISPLAY_IDENTIFIER IGA_IGC_H_RNG_TMP[0] ECU_ADDRESS 0xd0006520 FORMAT "%8.4" /end MEASUREMENT
/begin MEASUREMENT iga_igc_h_rng_tmp[1] "Ignition angle (high range) of cylinder x" SWORD _CNV_A_R_LINEAR_____188_CM 1 100. -90. 90. DISPLAY_IDENTIFIER IGA_IGC_H_RNG_TMP[1] ECU_ADDRESS 0xd0006522 FORMAT "%8.4" /end MEASUREMENT
/begin MEASUREMENT iga_igc_h_rng_tmp[2] "Ignition angle (high range) of cylinder x" SWORD _CNV_A_R_LINEAR_____188_CM 1 100. -90. 90. DISPLAY_IDENTIFIER IGA_IGC_H_RNG_TMP[2] ECU_ADDRESS 0xd0006524 FORMAT "%8.4" /end MEASUREMENT
/begin MEASUREMENT iga_igc_h_rng_tmp[3] "Ignition angle (high range) of cylinder x" SWORD _CNV_A_R_LINEAR_____188_CM 1 100. -90. 90. DISPLAY_IDENTIFIER IGA_IGC_H_RNG_TMP[3] ECU_ADDRESS 0xd0006526 FORMAT "%8.4" /end MEASUREMENT
/begin MEASUREMENT iga_igc_h_rng_tmp[4] "Ignition angle (high range) of cylinder x" SWORD _CNV_A_R_LINEAR_____188_CM 1 100. -90. 90. DISPLAY_IDENTIFIER IGA_IGC_H_RNG_TMP[4] ECU_ADDRESS 0xd0006528 FORMAT "%8.4" /end MEASUREMENT
/begin MEASUREMENT iga_igc_h_rng_tmp[5] "Ignition angle (high range) of cylinder x" SWORD _CNV_A_R_LINEAR_____188_CM 1 100. -90. 90. DISPLAY_IDENTIFIER IGA_IGC_H_RNG_TMP[5] ECU_ADDRESS 0xd000652a FORMAT "%8.4" /end MEASUREMENT
/begin MEASUREMENT iga_igc_h_rng_tmp[6] "Ignition angle (high range) of cylinder x" SWORD _CNV_A_R_LINEAR_____188_CM 1 100. -90. 90. DISPLAY_IDENTIFIER IGA_IGC_H_RNG_TMP[6] ECU_ADDRESS 0xd000652c FORMAT "%8.4" /end MEASUREMENT
/begin MEASUREMENT iga_igc_h_rng_tmp[7] "Ignition angle (high range) of cylinder x" SWORD _CNV_A_R_LINEAR_____188_CM 1 100. -90. 90. DISPLAY_IDENTIFIER IGA_IGC_H_RNG_TMP[7] ECU_ADDRESS 0xd000652e FORMAT "%8.4" /end MEASUREMENT
/begin MEASUREMENT inh_igc "Inhibition of selected cylinder" UBYTE _CNV_A_R_LINEAR_____0_CM 1 100. 0. 255. DISPLAY_IDENTIFIER INH_IGC ECU_ADDRESS 0xd000739a FORMAT "%3.0" /end MEASUREMENT
/begin MEASUREMENT ctr_cycnr_iga_es "Counter for number of cycles for which ignition is maintained after detection of LV_IGK= 0 or LV_STST_STOP_REQ= 1" UBYTE _CNV_A_R_LINEAR_____0_CM 1 100. 0. 15. DISPLAY_IDENTIFIER CTR_CYCNR_IGA_ES ECU_ADDRESS 0xd0003278 FORMAT "%2.0" /end MEASUREMENT
/begin CHARACTERISTIC c_cycnr_iga_es "Number of cycles for which ignition is maintained after detection of LV_IGK = 0" VALUE 0xa080bc28 _REC_VAL_20_u1 15. _CNV_A_R_LINEAR_____0_CM 0. 15. DISPLAY_IDENTIFIER C_CYCNR_IGA_ES FORMAT "%2.0" /end CHARACTERISTIC
/begin MEASUREMENT lv_scp_igc[0] "Diagnostic of primary short circuit to battery ( cylinder selected )" UBYTE _CNV_S_2_RANGE__0___1_CM 1 100. 0. 1. DISPLAY_IDENTIFIER LV_SCP_IGC_0 ECU_ADDRESS 0xd00073c4 BIT_MASK 0x1 /end MEASUREMENT
/begin MEASUREMENT lv_scp_igc[1] "Diagnostic of primary short circuit to battery ( cylinder selected )" UBYTE _CNV_S_2_RANGE__0___1_CM 1 100. 0. 1. DISPLAY_IDENTIFIER LV_SCP_IGC_1 ECU_ADDRESS 0xd00073c5 BIT_MASK 0x1 /end MEASUREMENT
/begin MEASUREMENT lv_scp_igc[2] "Diagnostic of primary short circuit to battery ( cylinder selected )" UBYTE _CNV_S_2_RANGE__0___1_CM 1 100. 0. 1. DISPLAY_IDENTIFIER LV_SCP_IGC_2 ECU_ADDRESS 0xd00073c6 BIT_MASK 0x1 /end MEASUREMENT
/begin MEASUREMENT lv_scp_igc[3] "Diagnostic of primary short circuit to battery ( cylinder selected )" UBYTE _CNV_S_2_RANGE__0___1_CM 1 100. 0. 1. DISPLAY_IDENTIFIER LV_SCP_IGC_3 ECU_ADDRESS 0xd00073c7 BIT_MASK 0x1 /end MEASUREMENT
/begin MEASUREMENT lv_scp_igc[4] "Diagnostic of primary short circuit to battery ( cylinder selected )" UBYTE _CNV_S_2_RANGE__0___1_CM 1 100. 0. 1. DISPLAY_IDENTIFIER LV_SCP_IGC_4 ECU_ADDRESS 0xd00073c8 BIT_MASK 0x1 /end MEASUREMENT
/begin MEASUREMENT lv_scp_igc[5] "Diagnostic of primary short circuit to battery ( cylinder selected )" UBYTE _CNV_S_2_RANGE__0___1_CM 1 100. 0. 1. DISPLAY_IDENTIFIER LV_SCP_IGC_5 ECU_ADDRESS 0xd00073c9 BIT_MASK 0x1 /end MEASUREMENT
/begin MEASUREMENT lv_scp_igc[6] "Diagnostic of primary short circuit to battery ( cylinder selected )" UBYTE _CNV_S_2_RANGE__0___1_CM 1 100. 0. 1. DISPLAY_IDENTIFIER LV_SCP_IGC_6 ECU_ADDRESS 0xd00073ca BIT_MASK 0x1 /end MEASUREMENT
/begin MEASUREMENT lv_scp_igc[7] "Diagnostic of primary short circuit to battery ( cylinder selected )" UBYTE _CNV_S_2_RANGE__0___1_CM 1 100. 0. 1. DISPLAY_IDENTIFIER LV_SCP_IGC_7 ECU_ADDRESS 0xd00073cb BIT_MASK 0x1 /end MEASUREMENT
/begin MEASUREMENT lv_ol_igc[0] "Diagnostic of primary open load ( cylinder selected )" UBYTE _CNV_S_2_RANGE__0___1_CM 1 100. 0. 1. DISPLAY_IDENTIFIER LV_OL_IGC_0 ECU_ADDRESS 0xd00073b4 BIT_MASK 0x1 /end MEASUREMENT
/begin MEASUREMENT lv_ol_igc[1] "Diagnostic of primary open load ( cylinder selected )" UBYTE _CNV_S_2_RANGE__0___1_CM 1 100. 0. 1. DISPLAY_IDENTIFIER LV_OL_IGC_1 ECU_ADDRESS 0xd00073b5 BIT_MASK 0x1 /end MEASUREMENT
/begin MEASUREMENT lv_ol_igc[2] "Diagnostic of primary open load ( cylinder selected )" UBYTE _CNV_S_2_RANGE__0___1_CM 1 100. 0. 1. DISPLAY_IDENTIFIER LV_OL_IGC_2 ECU_ADDRESS 0xd00073b6 BIT_MASK 0x1 /end MEASUREMENT
/begin MEASUREMENT lv_ol_igc[3] "Diagnostic of primary open load ( cylinder selected )" UBYTE _CNV_S_2_RANGE__0___1_CM 1 100. 0. 1. DISPLAY_IDENTIFIER LV_OL_IGC_3 ECU_ADDRESS 0xd00073b7 BIT_MASK 0x1 /end MEASUREMENT
/begin MEASUREMENT lv_ol_igc[4] "Diagnostic of primary open load ( cylinder selected )" UBYTE _CNV_S_2_RANGE__0___1_CM 1 100. 0. 1. DISPLAY_IDENTIFIER LV_OL_IGC_4 ECU_ADDRESS 0xd00073b8 BIT_MASK 0x1 /end MEASUREMENT
/begin MEASUREMENT lv_ol_igc[5] "Diagnostic of primary open load ( cylinder selected )" UBYTE _CNV_S_2_RANGE__0___1_CM 1 100. 0. 1. DISPLAY_IDENTIFIER LV_OL_IGC_5 ECU_ADDRESS 0xd00073b9 BIT_MASK 0x1 /end MEASUREMENT
/begin MEASUREMENT lv_ol_igc[6] "Diagnostic of primary open load ( cylinder selected )" UBYTE _CNV_S_2_RANGE__0___1_CM 1 100. 0. 1. DISPLAY_IDENTIFIER LV_OL_IGC_6 ECU_ADDRESS 0xd00073ba BIT_MASK 0x1 /end MEASUREMENT
/begin MEASUREMENT lv_ol_igc[7] "Diagnostic of primary open load ( cylinder selected )" UBYTE _CNV_S_2_RANGE__0___1_CM 1 100. 0. 1. DISPLAY_IDENTIFIER LV_OL_IGC_7 ECU_ADDRESS 0xd00073bb BIT_MASK 0x1 /end MEASUREMENT
/begin MEASUREMENT lv_scg_igc[0] "Diagnostic of primary short circuit to ground ( cylinder selected )" UBYTE _CNV_S_2_RANGE__0___1_CM 1 100. 0. 1. DISPLAY_IDENTIFIER LV_SCG_IGC_0 ECU_ADDRESS 0xd00073bc BIT_MASK 0x1 /end MEASUREMENT
/begin MEASUREMENT lv_scg_igc[1] "Diagnostic of primary short circuit to ground ( cylinder selected )" UBYTE _CNV_S_2_RANGE__0___1_CM 1 100. 0. 1. DISPLAY_IDENTIFIER LV_SCG_IGC_1 ECU_ADDRESS 0xd00073bd BIT_MASK 0x1 /end MEASUREMENT
/begin MEASUREMENT lv_scg_igc[2] "Diagnostic of primary short circuit to ground ( cylinder selected )" UBYTE _CNV_S_2_RANGE__0___1_CM 1 100. 0. 1. DISPLAY_IDENTIFIER LV_SCG_IGC_2 ECU_ADDRESS 0xd00073be BIT_MASK 0x1 /end MEASUREMENT
/begin MEASUREMENT lv_scg_igc[3] "Diagnostic of primary short circuit to ground ( cylinder selected )" UBYTE _CNV_S_2_RANGE__0___1_CM 1 100. 0. 1. DISPLAY_IDENTIFIER LV_SCG_IGC_3 ECU_ADDRESS 0xd00073bf BIT_MASK 0x1 /end MEASUREMENT
/begin MEASUREMENT lv_scg_igc[4] "Diagnostic of primary short circuit to ground ( cylinder selected )" UBYTE _CNV_S_2_RANGE__0___1_CM 1 100. 0. 1. DISPLAY_IDENTIFIER LV_SCG_IGC_4 ECU_ADDRESS 0xd00073c0 BIT_MASK 0x1 /end MEASUREMENT
/begin MEASUREMENT lv_scg_igc[5] "Diagnostic of primary short circuit to ground ( cylinder selected )" UBYTE _CNV_S_2_RANGE__0___1_CM 1 100. 0. 1. DISPLAY_IDENTIFIER LV_SCG_IGC_5 ECU_ADDRESS 0xd00073c1 BIT_MASK 0x1 /end MEASUREMENT
/begin MEASUREMENT lv_scg_igc[6] "Diagnostic of primary short circuit to ground ( cylinder selected )" UBYTE _CNV_S_2_RANGE__0___1_CM 1 100. 0. 1. DISPLAY_IDENTIFIER LV_SCG_IGC_6 ECU_ADDRESS 0xd00073c2 BIT_MASK 0x1 /end MEASUREMENT
/begin MEASUREMENT lv_scg_igc[7] "Diagnostic of primary short circuit to ground ( cylinder selected )" UBYTE _CNV_S_2_RANGE__0___1_CM 1 100. 0. 1. DISPLAY_IDENTIFIER LV_SCG_IGC_7 ECU_ADDRESS 0xd00073c3 BIT_MASK 0x1 /end MEASUREMENT
/begin CHARACTERISTIC id_v_dur_igc_min "Minimum duration of the burntime to detect ignition errors" MAP 0xa080d1ec _REC_MAP_20_u2_u1_u2 262.14 _CNV_A_R_LINEAR_____456_CM 0. 262.14 DISPLAY_IDENTIFIER ID_V_DUR_IGC_MIN FORMAT "%7.3"
 /begin AXIS_DESCR COM_AXIS n_32 _CNV_A_R_LINEAR_____10_CM 8 0. 8160. FORMAT "%4.0" AXIS_PTS_REF ldp_n_32_id_v_dur_igc_min /end AXIS_DESCR
 /begin AXIS_DESCR COM_AXIS mff_sp_mv _CNV_A_R_LINEAR_____111_CM 6 0. 1389. FORMAT "%7.2" AXIS_PTS_REF ldp_mff_sp_mv_id_v_dur_igc_min /end AXIS_DESCR
/end CHARACTERISTIC
/begin AXIS_PTS ldp_n_32_id_v_dur_igc_min "" 0xa08007d4 n_32 _REC_AXS_20_u1 8160. _CNV_A_R_LINEAR_____10_CM 8 0. 8160. FORMAT "%4.0" /end AXIS_PTS
/begin MEASUREMENT v_dur_igc[0] "burn time duration for diag validation" UWORD _CNV_A_R_LINEAR_____456_CM 1 100. 0. 262.14 DISPLAY_IDENTIFIER V_DUR_IGC_0 ECU_ADDRESS 0xd0006598 FORMAT "%7.3" /end MEASUREMENT
/begin MEASUREMENT v_dur_igc[1] "burn time duration for diag validation" UWORD _CNV_A_R_LINEAR_____456_CM 1 100. 0. 262.14 DISPLAY_IDENTIFIER V_DUR_IGC_1 ECU_ADDRESS 0xd000659a FORMAT "%7.3" /end MEASUREMENT
/begin MEASUREMENT v_dur_igc[2] "burn time duration for diag validation" UWORD _CNV_A_R_LINEAR_____456_CM 1 100. 0. 262.14 DISPLAY_IDENTIFIER V_DUR_IGC_2 ECU_ADDRESS 0xd000659c FORMAT "%7.3" /end MEASUREMENT
/begin MEASUREMENT v_dur_igc[3] "burn time duration for diag validation" UWORD _CNV_A_R_LINEAR_____456_CM 1 100. 0. 262.14 DISPLAY_IDENTIFIER V_DUR_IGC_3 ECU_ADDRESS 0xd000659e FORMAT "%7.3" /end MEASUREMENT
/begin MEASUREMENT v_dur_igc[4] "burn time duration for diag validation" UWORD _CNV_A_R_LINEAR_____456_CM 1 100. 0. 262.14 DISPLAY_IDENTIFIER V_DUR_IGC_4 ECU_ADDRESS 0xd00065a0 FORMAT "%7.3" /end MEASUREMENT
/begin MEASUREMENT v_dur_igc[5] "burn time duration for diag validation" UWORD _CNV_A_R_LINEAR_____456_CM 1 100. 0. 262.14 DISPLAY_IDENTIFIER V_DUR_IGC_5 ECU_ADDRESS 0xd00065a2 FORMAT "%7.3" /end MEASUREMENT
/begin MEASUREMENT v_dur_igc[6] "burn time duration for diag validation" UWORD _CNV_A_R_LINEAR_____456_CM 1 100. 0. 262.14 DISPLAY_IDENTIFIER V_DUR_IGC_6 ECU_ADDRESS 0xd00065a4 FORMAT "%7.3" /end MEASUREMENT
/begin MEASUREMENT v_dur_igc[7] "burn time duration for diag validation" UWORD _CNV_A_R_LINEAR_____456_CM 1 100. 0. 262.14 DISPLAY_IDENTIFIER V_DUR_IGC_7 ECU_ADDRESS 0xd00065a6 FORMAT "%7.3" /end MEASUREMENT
/begin AXIS_PTS ldp_mff_sp_mv_id_v_dur_igc_min "" 0xa08007c4 mff_sp_mv _REC_AXS_20_u2 1389. _CNV_A_R_LINEAR_____111_CM 6 0. 1389. FORMAT "%7.2" /end AXIS_PTS
/begin CHARACTERISTIC c_td_fac_st_min "Factor for minimum dwell time" VALUE 0xa08008d5 _REC_VAL_20_u1 1.984375 _CNV_A_R_LINEAR_____103_CM 7.8125e-003 1.9921875 DISPLAY_IDENTIFIER C_TD_FAC_ST_MIN FORMAT "%8.6" /end CHARACTERISTIC
/begin CHARACTERISTIC c_td_fac_st_max "Factor for maximum dwell time" VALUE 0xa08008d4 _REC_VAL_20_u1 1.984375 _CNV_A_R_LINEAR_____103_CM 7.8125e-003 1.9921875 DISPLAY_IDENTIFIER C_TD_FAC_ST_MAX FORMAT "%8.6" /end CHARACTERISTIC
/begin CHARACTERISTIC c_td_vb_max "Maximum battery voltage to activate MPL ( typ value : 16V )" VALUE 0xa08008d9 _REC_VAL_20_u1 25.8984375 _CNV_A_R_LINEAR_____272_CM 0. 25.8984375 DISPLAY_IDENTIFIER C_TD_VB_MAX FORMAT "%9.6" /end CHARACTERISTIC
/begin CHARACTERISTIC ip_td_fac_max "Max Dwell time factor" CURVE 0xa0800860 _REC_CUR_20_u1_u1 1.984375 _CNV_A_R_LINEAR_____103_CM 7.8125e-003 1.9921875 DISPLAY_IDENTIFIER IP_TD_FAC_MAX FORMAT "%8.6"
 /begin AXIS_DESCR COM_AXIS n_32 _CNV_A_R_LINEAR_____10_CM 8 0. 8160. FORMAT "%4.0" AXIS_PTS_REF ldpm_n_32_1_igre /end AXIS_DESCR
/end CHARACTERISTIC
/begin CHARACTERISTIC ip_td_fac_min "Min Dwell time factor" CURVE 0xa0800868 _REC_CUR_20_u1_u1 1.984375 _CNV_A_R_LINEAR_____103_CM 7.8125e-003 1.9921875 DISPLAY_IDENTIFIER IP_TD_FAC_MIN FORMAT "%8.6"
 /begin AXIS_DESCR COM_AXIS n_32 _CNV_A_R_LINEAR_____10_CM 8 0. 8160. FORMAT "%4.0" AXIS_PTS_REF ldpm_n_32_1_igre /end AXIS_DESCR
/end CHARACTERISTIC
/begin MEASUREMENT td_fac_max "Maximum dwell time control" UBYTE _CNV_A_R_LINEAR_____103_CM 1 100. 7.8125e-003 1.9921875 DISPLAY_IDENTIFIER TD_FAC_MAX ECU_ADDRESS 0xd000739e FORMAT "%8.6" /end MEASUREMENT
/begin MEASUREMENT td_fac_min "Minimum dwell time control" UBYTE _CNV_A_R_LINEAR_____103_CM 1 100. 7.8125e-003 1.9921875 DISPLAY_IDENTIFIER TD_FAC_MIN ECU_ADDRESS 0xd000739f FORMAT "%8.6" /end MEASUREMENT
/begin CHARACTERISTIC lc_igc_lih_conf "Configuration Choice for Half static Mode in case of CAM limp home: 0 = no Limp Home - 1 = Half Static" VALUE 0xa08008e2 _REC_VAL_20_u1 1. _CNV_A_R_LINEAR_____0_CM 0. 1. DISPLAY_IDENTIFIER LC_IGC_LIH_CONF FORMAT "%1.0" /end CHARACTERISTIC
/begin AXIS_PTS ldpm_n_32_1_igre "" 0xa08007f0 n_32 _REC_AXS_20_u1 8160. _CNV_A_R_LINEAR_____10_CM 8 0. 8160. FORMAT "%4.0" /end AXIS_PTS
/begin AXIS_PTS ldpm_vb_1_igre "Battery Voltage" 0xa0800814 vb _REC_AXS_20_u1 25.8984375 _CNV_A_R_LINEAR_____272_CM 8 0. 25.8984375 FORMAT "%9.6" /end AXIS_PTS
/begin MEASUREMENT td_fac "General dwell time control factor" UBYTE _CNV_A_R_LINEAR_____103_CM 1 100. 7.8125e-003 1.9921875 DISPLAY_IDENTIFIER TD_FAC ECU_ADDRESS 0xd000739d FORMAT "%8.6" /end MEASUREMENT
/begin CHARACTERISTIC ip_td_st_fac "Factor for dwell time boost at start" CURVE 0xa0800878 _REC_CUR_20_u1_u1 1.984375 _CNV_A_R_LINEAR_____103_CM 7.8125e-003 1.9921875 DISPLAY_IDENTIFIER IP_TD_ST_FAC FORMAT "%8.6"
 /begin AXIS_DESCR COM_AXIS vb _CNV_A_R_LINEAR_____272_CM 8 0. 25.8984375 FORMAT "%9.6" AXIS_PTS_REF ldpm_vb_1_igre /end AXIS_DESCR
/end CHARACTERISTIC
/begin CHARACTERISTIC ip_td_fac_tco "Adjustement factor for dwell time" CURVE 0xa0800870 _REC_CUR_20_u1_u1 1.984375 _CNV_A_R_LINEAR_____103_CM 7.8125e-003 1.9921875 DISPLAY_IDENTIFIER IP_TD_FAC_TCO FORMAT "%8.6"
 /begin AXIS_DESCR COM_AXIS tco _CNV_A_R_LINEAR_____17_CM 8 -48. 142.5 FORMAT "%6.2" AXIS_PTS_REF ldpm_tco_td_fac /end AXIS_DESCR
/end CHARACTERISTIC
/begin AXIS_PTS ldpm_tco_td_fac "" 0xa0800808 tco _REC_AXS_20_u1 190.5 _CNV_A_R_LINEAR_____17_CM 8 -48. 142.5 FORMAT "%6.2" /end AXIS_PTS
/begin MEASUREMENT td_st_fac "Boost factor for start face" UBYTE _CNV_A_R_LINEAR_____103_CM 1 100. 7.8125e-003 1.9921875 DISPLAY_IDENTIFIER TD_ST_FAC ECU_ADDRESS 0xd000323d FORMAT "%8.6" /end MEASUREMENT
/begin MEASUREMENT td_fac_tco "Adjustment factor with TCO dependence" UBYTE _CNV_A_R_LINEAR_____103_CM 1 100. 7.8125e-003 1.9921875 DISPLAY_IDENTIFIER TD_FAC_TCO ECU_ADDRESS 0xd000323c FORMAT "%8.6" /end MEASUREMENT
/begin MEASUREMENT td_mpl_dly "Dwell time interruption between MPL sparks (except between main and 1st MPL spark)" UWORD _CNV_A_R_LINEAR_____456_CM 1 100. 0. 262.14 DISPLAY_IDENTIFIER TD_MPL_DLY ECU_ADDRESS 0xd0006594 FORMAT "%7.3" /end MEASUREMENT
/begin MEASUREMENT ign_mpl_nr "Number of ignition sparks" UBYTE _CNV_A_R_LINEAR_____0_CM 1 100. 0. 255. DISPLAY_IDENTIFIER IGN_MPL_NR ECU_ADDRESS 0xd0007399 FORMAT "%3.0" /end MEASUREMENT
/begin CHARACTERISTIC c_tco_max_mpl_st "Max. Coolant Temp. to have multiple spark at start" VALUE 0xa08008c7 _REC_VAL_20_u1 190.5 _CNV_A_R_LINEAR_____17_CM -48. 142.5 DISPLAY_IDENTIFIER C_TCO_MAX_MPL_ST FORMAT "%6.2" /end CHARACTERISTIC
/begin CHARACTERISTIC c_tco_max_mpl_is "Max. Coolant Temp. to have multiple spark at idle speed" VALUE 0xa08008c4 _REC_VAL_20_u1 190.5 _CNV_A_R_LINEAR_____17_CM -48. 142.5 DISPLAY_IDENTIFIER C_TCO_MAX_MPL_IS FORMAT "%6.2" /end CHARACTERISTIC
/begin CHARACTERISTIC c_tco_max_mpl_pl_pu_fl "Max. Coolant Temp. to have multiple spark at Run" VALUE 0xa08008c5 _REC_VAL_20_u1 190.5 _CNV_A_R_LINEAR_____17_CM -48. 142.5 DISPLAY_IDENTIFIER C_TCO_MAX_MPL_PL_PU_FL FORMAT "%6.2" /end CHARACTERISTIC
/begin CHARACTERISTIC c_tco_max_mpl_puc "Max. Coolant Temp. to have multiple spark at fuel cut off" VALUE 0xa08008c6 _REC_VAL_20_u1 190.5 _CNV_A_R_LINEAR_____17_CM -48. 142.5 DISPLAY_IDENTIFIER C_TCO_MAX_MPL_PUC FORMAT "%6.2" /end CHARACTERISTIC
/begin CHARACTERISTIC c_vb_max_mpl_is "Max. Battery Voltage  to have multiple spark ( requested value 16 ) at idle speed" VALUE 0xa08008db _REC_VAL_20_u1 25.8984375 _CNV_A_R_LINEAR_____272_CM 0. 25.8984375 DISPLAY_IDENTIFIER C_VB_MAX_MPL_IS FORMAT "%9.6" /end CHARACTERISTIC
/begin CHARACTERISTIC c_vb_max_mpl_pl_pu_fl "Max. Battery Voltage  to have multiple spark ( requested value 16 ) at Run" VALUE 0xa08008dc _REC_VAL_20_u1 25.8984375 _CNV_A_R_LINEAR_____272_CM 0. 25.8984375 DISPLAY_IDENTIFIER C_VB_MAX_MPL_PL_PU_FL FORMAT "%9.6" /end CHARACTERISTIC
/begin CHARACTERISTIC c_vb_max_mpl_st "Max. Battery Voltage  to have multiple spark ( requested value 16 ) at start" VALUE 0xa08008de _REC_VAL_20_u1 25.8984375 _CNV_A_R_LINEAR_____272_CM 0. 25.8984375 DISPLAY_IDENTIFIER C_VB_MAX_MPL_ST FORMAT "%9.6" /end CHARACTERISTIC
/begin CHARACTERISTIC c_n_min_mpl_st "Engine speed min for ignition with multiple spark at start" VALUE 0xa08008b7 _REC_VAL_20_u1 8160. _CNV_A_R_LINEAR_____10_CM 0. 8160. DISPLAY_IDENTIFIER C_N_MIN_MPL_ST FORMAT "%4.0" /end CHARACTERISTIC
/begin CHARACTERISTIC c_n_max_mpl_st "Engine speed max for ignition with multiple spark at start" VALUE 0xa08008b3 _REC_VAL_20_u1 8160. _CNV_A_R_LINEAR_____10_CM 0. 8160. DISPLAY_IDENTIFIER C_N_MAX_MPL_ST FORMAT "%4.0" /end CHARACTERISTIC
/begin CHARACTERISTIC c_n_max_mpl_is "Engine speed max for ignition with multiple spark at idle speed" VALUE 0xa08008af _REC_VAL_20_u1 8160. _CNV_A_R_LINEAR_____10_CM 0. 8160. DISPLAY_IDENTIFIER C_N_MAX_MPL_IS FORMAT "%4.0" /end CHARACTERISTIC
/begin CHARACTERISTIC c_n_min_mpl_is "Engine speed min for ignition with multiple spark at idle speed" VALUE 0xa08008b4 _REC_VAL_20_u1 8160. _CNV_A_R_LINEAR_____10_CM 0. 8160. DISPLAY_IDENTIFIER C_N_MIN_MPL_IS FORMAT "%4.0" /end CHARACTERISTIC
/begin CHARACTERISTIC c_n_min_mpl_pl_pu_fl "Engine speed min for ignition with multiple spark at Run" VALUE 0xa08008b5 _REC_VAL_20_u1 8160. _CNV_A_R_LINEAR_____10_CM 0. 8160. DISPLAY_IDENTIFIER C_N_MIN_MPL_PL_PU_FL FORMAT "%4.0" /end CHARACTERISTIC
/begin CHARACTERISTIC c_n_max_mpl_pl_pu_fl "Engine speed max for ignition with multiple spark at Run" VALUE 0xa08008b0 _REC_VAL_20_u1 8160. _CNV_A_R_LINEAR_____10_CM 0. 8160. DISPLAY_IDENTIFIER C_N_MAX_MPL_PL_PU_FL FORMAT "%4.0" /end CHARACTERISTIC
/begin CHARACTERISTIC c_n_max_mpl_puc "Engine speed max for ignition with multiple spark at Fuel cut off" VALUE 0xa08008b1 _REC_VAL_20_u1 8160. _CNV_A_R_LINEAR_____10_CM 0. 8160. DISPLAY_IDENTIFIER C_N_MAX_MPL_PUC FORMAT "%4.0" /end CHARACTERISTIC
/begin CHARACTERISTIC c_n_min_mpl_puc "Engine speed min for ignition with multiple spark at Fuel cut off" VALUE 0xa08008b6 _REC_VAL_20_u1 8160. _CNV_A_R_LINEAR_____10_CM 0. 8160. DISPLAY_IDENTIFIER C_N_MIN_MPL_PUC FORMAT "%4.0" /end CHARACTERISTIC
/begin CHARACTERISTIC c_td_mpl_man "Manual activation of the MPL" VALUE 0xa08008d8 _REC_VAL_20_u1 1. _CNV_S_2_RANGE__0___1_CM 0. 1. DISPLAY_IDENTIFIER C_TD_MPL_MAN /end CHARACTERISTIC
/begin CHARACTERISTIC c_vb_max_mpl_puc "Max. Battery Voltage  to have multiple spark ( requested value 16 ) at fuel cut off" VALUE 0xa08008dd _REC_VAL_20_u1 25.8984375 _CNV_A_R_LINEAR_____272_CM 0. 25.8984375 DISPLAY_IDENTIFIER C_VB_MAX_MPL_PUC FORMAT "%9.6" /end CHARACTERISTIC
/begin CHARACTERISTIC ip_td_mpl_s "dwell time for multiple spark in stratified mode confirmed" MAP 0xa080d06c _REC_MAP_20_u2_u1_u1 262.14 _CNV_A_R_LINEAR_____456_CM 0. 262.14 DISPLAY_IDENTIFIER IP_TD_MPL_S FORMAT "%7.3"
 /begin AXIS_DESCR COM_AXIS vb _CNV_A_R_LINEAR_____272_CM 8 0. 25.8984375 FORMAT "%9.6" AXIS_PTS_REF ldpm_vb_1_igre /end AXIS_DESCR
 /begin AXIS_DESCR COM_AXIS n_32 _CNV_A_R_LINEAR_____10_CM 8 0. 8160. FORMAT "%4.0" AXIS_PTS_REF ldpm_n_32_1_igre /end AXIS_DESCR
/end CHARACTERISTIC
/begin CHARACTERISTIC ip_nr_mpl_s "Number of successives ignition sparks depending on engine speed and TCO in stratified mode" MAP 0xa0800790 _REC_MAP_20_u1_u1_u2 255. _CNV_A_R_LINEAR_____0_CM 0. 255. DISPLAY_IDENTIFIER IP_NR_MPL_S FORMAT "%3.0"
 /begin AXIS_DESCR COM_AXIS n_32 _CNV_A_R_LINEAR_____10_CM 8 0. 8160. FORMAT "%4.0" AXIS_PTS_REF ldpm_n_32_1_igre /end AXIS_DESCR
 /begin AXIS_DESCR COM_AXIS mff_sp_mv _CNV_A_R_LINEAR_____111_CM 6 0. 1389. FORMAT "%7.2" AXIS_PTS_REF ldpm_mff_sp_mv_1_igre /end AXIS_DESCR
/end CHARACTERISTIC
/begin CHARACTERISTIC c_t_ctr_td_mpl_ast "maintenance time of Multiple spark activation before out case and for the after start phase" VALUE 0xa08008bc _REC_VAL_20_u2 655.34 _CNV_A_R_LINEAR_____3_CM 0. 655.34 DISPLAY_IDENTIFIER C_T_CTR_TD_MPL_AST FORMAT "%6.2" /end CHARACTERISTIC
/begin CHARACTERISTIC c_t_ctr_td_mpl "maintenance time of Multiple spark activation before out case" VALUE 0xa08008ba _REC_VAL_20_u2 655.34 _CNV_A_R_LINEAR_____3_CM 0. 655.34 DISPLAY_IDENTIFIER C_T_CTR_TD_MPL FORMAT "%6.2" /end CHARACTERISTIC
/begin MEASUREMENT t_ctr_td_mpl "Maintenance time of multiple spark activation before out case" UWORD _CNV_A_R_LINEAR_____3_CM 1 100. 0. 655.35 DISPLAY_IDENTIFIER T_CTR_TD_MPL ECU_ADDRESS 0xd0006530 FORMAT "%6.2" /end MEASUREMENT
/begin CHARACTERISTIC ip_td_t_mpl_1 "Time delay between mains spark and start of ign coil drive for 1st MPL spark (homogeneous mode confirmed)" MAP 0xa080d3cc _REC_MAP_20_u2_u1_u1 262.14 _CNV_A_R_LINEAR_____456_CM 0. 262.14 DISPLAY_IDENTIFIER IP_TD_T_MPL_1 FORMAT "%7.3"
 /begin AXIS_DESCR COM_AXIS vb _CNV_A_R_LINEAR_____272_CM 8 0. 25.8984375 FORMAT "%9.6" AXIS_PTS_REF ldpm_vb_1_igre /end AXIS_DESCR
 /begin AXIS_DESCR COM_AXIS n_32 _CNV_A_R_LINEAR_____10_CM 8 0. 8160. FORMAT "%4.0" AXIS_PTS_REF ldpm_n_32_1_igre /end AXIS_DESCR
/end CHARACTERISTIC
/begin CHARACTERISTIC ip_td_mpl_1 "Dwell time for 1st multiple spark in homogeneous mode confirmed" MAP 0xa080d34c _REC_MAP_20_u2_u1_u1 262.14 _CNV_A_R_LINEAR_____456_CM 0. 262.14 DISPLAY_IDENTIFIER IP_TD_MPL_1 FORMAT "%7.3"
 /begin AXIS_DESCR COM_AXIS vb _CNV_A_R_LINEAR_____272_CM 8 0. 25.8984375 FORMAT "%9.6" AXIS_PTS_REF ldpm_vb_1_igre /end AXIS_DESCR
 /begin AXIS_DESCR COM_AXIS n_32 _CNV_A_R_LINEAR_____10_CM 8 0. 8160. FORMAT "%4.0" AXIS_PTS_REF ldpm_n_32_1_igre /end AXIS_DESCR
/end CHARACTERISTIC
/begin CHARACTERISTIC ip_td_mpl_1_s "Dwell time for 1st multiple spark in stratified  mode confirmed" MAP 0xa080cfec _REC_MAP_20_u2_u1_u1 262.14 _CNV_A_R_LINEAR_____456_CM 0. 262.14 DISPLAY_IDENTIFIER IP_TD_MPL_1_S FORMAT "%7.3"
 /begin AXIS_DESCR COM_AXIS vb _CNV_A_R_LINEAR_____272_CM 8 0. 25.8984375 FORMAT "%9.6" AXIS_PTS_REF ldpm_vb_1_igre /end AXIS_DESCR
 /begin AXIS_DESCR COM_AXIS n_32 _CNV_A_R_LINEAR_____10_CM 8 0. 8160. FORMAT "%4.0" AXIS_PTS_REF ldpm_n_32_1_igre /end AXIS_DESCR
/end CHARACTERISTIC
/begin CHARACTERISTIC ip_td_t_mpl_1_s "Time delay between main spark and start of ign coil drive for 1st MPL spark (stratified  mode confirmed)" MAP 0xa080d16c _REC_MAP_20_u2_u1_u1 262.14 _CNV_A_R_LINEAR_____456_CM 0. 262.14 DISPLAY_IDENTIFIER IP_TD_T_MPL_1_S FORMAT "%7.3"
 /begin AXIS_DESCR COM_AXIS vb _CNV_A_R_LINEAR_____272_CM 8 0. 25.8984375 FORMAT "%9.6" AXIS_PTS_REF ldpm_vb_1_igre /end AXIS_DESCR
 /begin AXIS_DESCR COM_AXIS n_32 _CNV_A_R_LINEAR_____10_CM 8 0. 8160. FORMAT "%4.0" AXIS_PTS_REF ldpm_n_32_1_igre /end AXIS_DESCR
/end CHARACTERISTIC
/begin MEASUREMENT td_mpl "Dwell time for multiple spark (for 2nd and others MPL sparks)" UWORD _CNV_A_R_LINEAR_____456_CM 1 100. 0. 262.14 DISPLAY_IDENTIFIER TD_MPL ECU_ADDRESS 0xd000658e FORMAT "%7.3" /end MEASUREMENT
/begin MEASUREMENT td_mpl_1 "Dwell time for 1st  multiple spark (e.g. 1st spark after main spark)" UWORD _CNV_A_R_LINEAR_____456_CM 1 100. 0. 262.14 DISPLAY_IDENTIFIER TD_MPL_1 ECU_ADDRESS 0xd0006590 FORMAT "%7.3" /end MEASUREMENT
/begin MEASUREMENT td_mpl_1_dly "Dwell time interruption between main spark and 1st MPL spark" UWORD _CNV_A_R_LINEAR_____456_CM 1 100. 0. 262.14 DISPLAY_IDENTIFIER TD_MPL_1_DLY ECU_ADDRESS 0xd0006592 FORMAT "%7.3" /end MEASUREMENT
/begin CHARACTERISTIC ip_td_mpl "dwell time for multiple spark" MAP 0xa080d2cc _REC_MAP_20_u2_u1_u1 262.14 _CNV_A_R_LINEAR_____456_CM 0. 262.14 DISPLAY_IDENTIFIER IP_TD_MPL FORMAT "%7.3"
 /begin AXIS_DESCR COM_AXIS vb _CNV_A_R_LINEAR_____272_CM 8 0. 25.8984375 FORMAT "%9.6" AXIS_PTS_REF ldpm_vb_1_igre /end AXIS_DESCR
 /begin AXIS_DESCR COM_AXIS n_32 _CNV_A_R_LINEAR_____10_CM 8 0. 8160. FORMAT "%4.0" AXIS_PTS_REF ldpm_n_32_1_igre /end AXIS_DESCR
/end CHARACTERISTIC
/begin CHARACTERISTIC ip_td_t_mpl "dwell time for multiple spark" CURVE 0xa0800880 _REC_CUR_20_u2_u1 262.14 _CNV_A_R_LINEAR_____456_CM 0. 262.14 DISPLAY_IDENTIFIER IP_TD_T_MPL FORMAT "%7.3"
 /begin AXIS_DESCR COM_AXIS n_32 _CNV_A_R_LINEAR_____10_CM 8 0. 8160. FORMAT "%4.0" AXIS_PTS_REF ldpm_n_32_1_igre /end AXIS_DESCR
/end CHARACTERISTIC
/begin CHARACTERISTIC ip_td_t_mpl_s "dwell time for multiple spark" CURVE 0xa0800890 _REC_CUR_20_u2_u1 262.14 _CNV_A_R_LINEAR_____456_CM 0. 262.14 DISPLAY_IDENTIFIER IP_TD_T_MPL_S FORMAT "%7.3"
 /begin AXIS_DESCR COM_AXIS n_32 _CNV_A_R_LINEAR_____10_CM 8 0. 8160. FORMAT "%4.0" AXIS_PTS_REF ldpm_n_32_1_igre /end AXIS_DESCR
/end CHARACTERISTIC
/begin AXIS_PTS ldpm_mff_sp_mv_1_igre "" 0xa08007e0 mff_sp_mv _REC_AXS_20_u2 1389. _CNV_A_R_LINEAR_____111_CM 6 0. 1389. FORMAT "%7.2" /end AXIS_PTS
/begin AXIS_PTS ldpm_tco_1_igre "" 0xa08007fc tco _REC_AXS_20_u1 190.5 _CNV_A_R_LINEAR_____17_CM 8 -48. 142.5 FORMAT "%6.2" /end AXIS_PTS
/begin CHARACTERISTIC ip_nr_mpl "Number of successives ignition sparks depending on engine speed and TCO" MAP 0xa0800830 _REC_MAP_20_u1_u1_u2 255. _CNV_A_R_LINEAR_____0_CM 0. 255. DISPLAY_IDENTIFIER IP_NR_MPL FORMAT "%3.0"
 /begin AXIS_DESCR COM_AXIS n_32 _CNV_A_R_LINEAR_____10_CM 8 0. 8160. FORMAT "%4.0" AXIS_PTS_REF ldpm_n_32_1_igre /end AXIS_DESCR
 /begin AXIS_DESCR COM_AXIS mff_sp_mv _CNV_A_R_LINEAR_____111_CM 6 0. 1389. FORMAT "%7.2" AXIS_PTS_REF ldpm_mff_sp_mv_1_igre /end AXIS_DESCR
/end CHARACTERISTIC
/begin CHARACTERISTIC ip_fac_tco_nr_mpl "Number of successives ignition sparks depending on engine speed and TCO" CURVE 0xa0800820 _REC_CUR_20_u1_u1 8. _CNV_A_R_MISF_LINEA_417_CM 0. 8. DISPLAY_IDENTIFIER IP_FAC_TCO_NR_MPL FORMAT "%3.1"
 /begin AXIS_DESCR COM_AXIS tco _CNV_A_R_LINEAR_____17_CM 8 -48. 142.5 FORMAT "%6.2" AXIS_PTS_REF ldpm_tco_1_igre /end AXIS_DESCR
/end CHARACTERISTIC
/begin CHARACTERISTIC ip_fac_tco_nr_mpl_s "Number of successives ignition sparks depending on engine speed and TCO" CURVE 0xa0800828 _REC_CUR_20_u1_u1 8. _CNV_A_R_MISF_LINEA_417_CM 0. 8. DISPLAY_IDENTIFIER IP_FAC_TCO_NR_MPL_S FORMAT "%3.1"
 /begin AXIS_DESCR COM_AXIS tco _CNV_A_R_LINEAR_____17_CM 8 -48. 142.5 FORMAT "%6.2" AXIS_PTS_REF ldpm_tco_1_igre /end AXIS_DESCR
/end CHARACTERISTIC
/begin MEASUREMENT lv_td_mpl_spc_ign_act "Activation of the 2° ignition event using modified extended MPL" UBYTE _CNV_S_2_RANGE__0___1_CM 1 100. 0. 1. DISPLAY_IDENTIFIER LV_TD_MPL_SPC_IGN_ACT ECU_ADDRESS 0xd00073cd BIT_MASK 0x1 /end MEASUREMENT
/begin CHARACTERISTIC lc_td_mpl_spc_ign_act "Calibration for activation control of 2° ignition event using modified extended MPL to switch off" VALUE 0xa08008e5 _REC_VAL_20_u1 1. _CNV_S_2_RANGE__0___1_CM 0. 1. DISPLAY_IDENTIFIER LC_TD_MPL_SPC_IGN_ACT /end CHARACTERISTIC
/begin CHARACTERISTIC c_n_max_mpl_spc_ign_act "Maximum engine speed for 2° ignition event activation" VALUE 0xa08008b2 _REC_VAL_20_u1 8160. _CNV_A_R_LINEAR_____10_CM 0. 8160. DISPLAY_IDENTIFIER C_N_MAX_MPL_SPC_IGN_ACT FORMAT "%4.0" /end CHARACTERISTIC
/begin MEASUREMENT lv_inh_td_mpl "Inhibition for multiple spark" UBYTE _CNV_S_2_RANGE__0___1_CM 1 100. 0. 1. DISPLAY_IDENTIFIER LV_INH_TD_MPL ECU_ADDRESS 0xd000773f /end MEASUREMENT
/begin CHARACTERISTIC c_tecu_max_ign_mpl "TECU threshold to disable multiple spark activation" VALUE 0xa08008da _REC_VAL_20_u1 190.5 _CNV_A_R_LINEAR_____17_CM -48. 142.5 DISPLAY_IDENTIFIER C_TECU_MAX_IGN_MPL FORMAT "%5.1" /end CHARACTERISTIC
/begin CHARACTERISTIC c_td_as "Dwell time offset usual value : 0 ms" VALUE 0xa08008d2 _REC_VAL_20_s2 16.32 _CNV_A_R_LINEAR_____456_CM -8.192 8.128 DISPLAY_IDENTIFIER C_TD_AS /end CHARACTERISTIC
/begin CHARACTERISTIC ip_td "Dwell time correction versus battery voltage and engine speed" MAP 0xa080d24c _REC_MAP_20_u2_u1_u1 262.14 _CNV_A_R_LINEAR_____456_CM 0. 262.14 DISPLAY_IDENTIFIER IP_TD FORMAT "%7.3"
 /begin AXIS_DESCR COM_AXIS vb _CNV_A_R_LINEAR_____272_CM 8 0. 25.8984375 FORMAT "%9.6" AXIS_PTS_REF ldpm_vb_1_igre /end AXIS_DESCR
 /begin AXIS_DESCR COM_AXIS n_32 _CNV_A_R_LINEAR_____10_CM 8 0. 8160. FORMAT "%4.0" AXIS_PTS_REF ldpm_n_32_1_igre /end AXIS_DESCR
/end CHARACTERISTIC
/begin MEASUREMENT td "Dwell time" UWORD _CNV_A_R_LINEAR_____456_CM 1 100. 0. 262.14 DISPLAY_IDENTIFIER TD ECU_ADDRESS 0xd0006534 FORMAT "%7.3" /end MEASUREMENT
/begin CHARACTERISTIC c_td_ini "Initial value for dwell time control ( typ. Value 3ms for standart coils and <2ms for pencils coils) " VALUE 0xa08008d6 _REC_VAL_20_u2 262.14 _CNV_A_R_LINEAR_____456_CM 0. 262.14 DISPLAY_IDENTIFIER C_TD_INI FORMAT "%7.3" /end CHARACTERISTIC
/begin CHARACTERISTIC c_td_s_as "Application intervention for stratified mode (typ. value : 0 ms)" VALUE 0xa08007c0 _REC_VAL_20_s2 16.32 _CNV_A_R_LINEAR_____456_CM -8.192 8.128 DISPLAY_IDENTIFIER C_TD_S_AS /end CHARACTERISTIC
/begin CHARACTERISTIC ip_td_s "Dwell time correction versus battery voltage and engine speed for stratified mode" MAP 0xa080d0ec _REC_MAP_20_u2_u1_u1 262.14 _CNV_A_R_LINEAR_____456_CM 0. 262.14 DISPLAY_IDENTIFIER IP_TD_S FORMAT "%7.3"
 /begin AXIS_DESCR COM_AXIS vb _CNV_A_R_LINEAR_____272_CM 8 0. 25.8984375 FORMAT "%9.6" AXIS_PTS_REF ldpm_vb_1_igre /end AXIS_DESCR
 /begin AXIS_DESCR COM_AXIS n_32 _CNV_A_R_LINEAR_____10_CM 8 0. 8160. FORMAT "%4.0" AXIS_PTS_REF ldpm_n_32_1_igre /end AXIS_DESCR
/end CHARACTERISTIC
/begin MEASUREMENT td_s "Dwell time for stratified mode" UWORD _CNV_A_R_LINEAR_____456_CM 1 100. 0. 262.14 DISPLAY_IDENTIFIER TD_S ECU_ADDRESS 0xd0006596 FORMAT "%7.3" /end MEASUREMENT
/begin CHARACTERISTIC c_td_s_ini "Initial value for dwell time control ( same for homogeneous and stratified mode ))" VALUE 0xa08007c2 _REC_VAL_20_u2 262.14 _CNV_A_R_LINEAR_____456_CM 0. 262.14 DISPLAY_IDENTIFIER C_TD_S_INI FORMAT "%7.3" /end CHARACTERISTIC
/begin MEASUREMENT td_sum_td_ad[0] "sum of agged time on TD_AD without reaching current threshold" UWORD _CNV_A_R_LINEAR_____456_CM 1 100. 0. 262.14 DISPLAY_IDENTIFIER TD_SUM_TD_AD[0] ECU_ADDRESS 0xd0003208 FORMAT "%7.3" /end MEASUREMENT
/begin MEASUREMENT td_sum_td_ad[1] "sum of agged time on TD_AD without reaching current threshold" UWORD _CNV_A_R_LINEAR_____456_CM 1 100. 0. 262.14 DISPLAY_IDENTIFIER TD_SUM_TD_AD[1] ECU_ADDRESS 0xd000320a FORMAT "%7.3" /end MEASUREMENT
/begin MEASUREMENT td_sum_td_ad[2] "sum of agged time on TD_AD without reaching current threshold" UWORD _CNV_A_R_LINEAR_____456_CM 1 100. 0. 262.14 DISPLAY_IDENTIFIER TD_SUM_TD_AD[2] ECU_ADDRESS 0xd000320c FORMAT "%7.3" /end MEASUREMENT
/begin MEASUREMENT td_sum_td_ad[3] "sum of agged time on TD_AD without reaching current threshold" UWORD _CNV_A_R_LINEAR_____456_CM 1 100. 0. 262.14 DISPLAY_IDENTIFIER TD_SUM_TD_AD[3] ECU_ADDRESS 0xd000320e FORMAT "%7.3" /end MEASUREMENT
/begin MEASUREMENT td_sum_td_ad[4] "sum of agged time on TD_AD without reaching current threshold" UWORD _CNV_A_R_LINEAR_____456_CM 1 100. 0. 262.14 DISPLAY_IDENTIFIER TD_SUM_TD_AD[4] ECU_ADDRESS 0xd0003210 FORMAT "%7.3" /end MEASUREMENT
/begin MEASUREMENT td_sum_td_ad[5] "sum of agged time on TD_AD without reaching current threshold" UWORD _CNV_A_R_LINEAR_____456_CM 1 100. 0. 262.14 DISPLAY_IDENTIFIER TD_SUM_TD_AD[5] ECU_ADDRESS 0xd0003212 FORMAT "%7.3" /end MEASUREMENT
/begin MEASUREMENT td_sum_td_ad[6] "sum of agged time on TD_AD without reaching current threshold" UWORD _CNV_A_R_LINEAR_____456_CM 1 100. 0. 262.14 DISPLAY_IDENTIFIER TD_SUM_TD_AD[6] ECU_ADDRESS 0xd0003214 FORMAT "%7.3" /end MEASUREMENT
/begin MEASUREMENT td_sum_td_ad[7] "sum of agged time on TD_AD without reaching current threshold" UWORD _CNV_A_R_LINEAR_____456_CM 1 100. 0. 262.14 DISPLAY_IDENTIFIER TD_SUM_TD_AD[7] ECU_ADDRESS 0xd0003216 FORMAT "%7.3" /end MEASUREMENT
/begin CHARACTERISTIC c_td_ad_min "Minimum value for dwell time adaptative" VALUE 0xa08008ce _REC_VAL_20_s2 262.14 _CNV_A_R_LINEAR_____456_CM -131.072 131.068 DISPLAY_IDENTIFIER C_TD_AD_MIN FORMAT "%8.3" /end CHARACTERISTIC
/begin CHARACTERISTIC c_t_thd_igcfb_max "Maximum measured time for valid sample" VALUE 0xa08008c2 _REC_VAL_20_u2 262.14 _CNV_A_R_LINEAR_____456_CM 0. 262.14 DISPLAY_IDENTIFIER C_T_THD_IGCFB_MAX FORMAT "%7.3" /end CHARACTERISTIC
/begin CHARACTERISTIC c_t_sum_td_ad_max "Maximum time allowed to be added in TD_AD without reaching target threshold" VALUE 0xa08008c0 _REC_VAL_20_u2 262.14 _CNV_A_R_LINEAR_____456_CM 0. 262.14 DISPLAY_IDENTIFIER C_T_SUM_TD_AD_MAX FORMAT "%7.3" /end CHARACTERISTIC
/begin CHARACTERISTIC c_td_ad_max "Maximum value for dwell time adaptative" VALUE 0xa08008cc _REC_VAL_20_s2 262.14 _CNV_A_R_LINEAR_____456_CM -131.072 131.068 DISPLAY_IDENTIFIER C_TD_AD_MAX FORMAT "%8.3" /end CHARACTERISTIC
/begin CHARACTERISTIC c_td_ad_thd "Definition of threshold to enable dwell adaptation" VALUE 0xa08008d0 _REC_VAL_20_u2 262.14 _CNV_A_R_LINEAR_____456_CM 0. 262.14 DISPLAY_IDENTIFIER C_TD_AD_THD FORMAT "%7.3" /end CHARACTERISTIC
/begin CHARACTERISTIC c_fac_dec_td_ad "Maximum measured time for valid sample" VALUE 0xa08008ab _REC_VAL_20_u1 0.99609375 _CNV_A_R_LINEAR_____28_CM 0. 0.99609375 DISPLAY_IDENTIFIER C_FAC_DEC_TD_AD FORMAT "%5.3" /end CHARACTERISTIC
/begin CHARACTERISTIC c_td_ad_inc "Increment on dwell time in case current threshold is not reached" VALUE 0xa08008ca _REC_VAL_20_u1 1.02 _CNV_A_R_LINEAR_____456_CM 0. 1.02 DISPLAY_IDENTIFIER C_TD_AD_INC FORMAT "%5.3" /end CHARACTERISTIC
/begin CHARACTERISTIC lc_td_ad_clr "Logical value enabling reset of variables TD_AD[x]" VALUE 0xa08008e4 _REC_VAL_20_u1 1. _CNV_A_R_LINEAR_____0_CM 0. 1. DISPLAY_IDENTIFIER LC_TD_AD_CLR FORMAT "%1.0" /end CHARACTERISTIC
/begin MEASUREMENT td_ad[0] "Dwell time adaptative" SWORD _CNV_A_R_LINEAR_____456_CM 1 100. -131.072 131.068 DISPLAY_IDENTIFIER TD_AD[0] ECU_ADDRESS 0xd0006538 FORMAT "%8.3" /end MEASUREMENT
/begin MEASUREMENT td_ad[1] "Dwell time adaptative" SWORD _CNV_A_R_LINEAR_____456_CM 1 100. -131.072 131.068 DISPLAY_IDENTIFIER TD_AD[1] ECU_ADDRESS 0xd000653a FORMAT "%8.3" /end MEASUREMENT
/begin MEASUREMENT td_ad[2] "Dwell time adaptative" SWORD _CNV_A_R_LINEAR_____456_CM 1 100. -131.072 131.068 DISPLAY_IDENTIFIER TD_AD[2] ECU_ADDRESS 0xd000653c FORMAT "%8.3" /end MEASUREMENT
/begin MEASUREMENT td_ad[3] "Dwell time adaptative" SWORD _CNV_A_R_LINEAR_____456_CM 1 100. -131.072 131.068 DISPLAY_IDENTIFIER TD_AD[3] ECU_ADDRESS 0xd000653e FORMAT "%8.3" /end MEASUREMENT
/begin MEASUREMENT td_ad[4] "Dwell time adaptative" SWORD _CNV_A_R_LINEAR_____456_CM 1 100. -131.072 131.068 DISPLAY_IDENTIFIER TD_AD[4] ECU_ADDRESS 0xd0006540 FORMAT "%8.3" /end MEASUREMENT
/begin MEASUREMENT td_ad[5] "Dwell time adaptative" SWORD _CNV_A_R_LINEAR_____456_CM 1 100. -131.072 131.068 DISPLAY_IDENTIFIER TD_AD[5] ECU_ADDRESS 0xd0006542 FORMAT "%8.3" /end MEASUREMENT
/begin MEASUREMENT td_ad[6] "Dwell time adaptative" SWORD _CNV_A_R_LINEAR_____456_CM 1 100. -131.072 131.068 DISPLAY_IDENTIFIER TD_AD[6] ECU_ADDRESS 0xd0006544 FORMAT "%8.3" /end MEASUREMENT
/begin MEASUREMENT td_ad[7] "Dwell time adaptative" SWORD _CNV_A_R_LINEAR_____456_CM 1 100. -131.072 131.068 DISPLAY_IDENTIFIER TD_AD[7] ECU_ADDRESS 0xd0006546 FORMAT "%8.3" /end MEASUREMENT
/begin MEASUREMENT t_sum_td_ad[0] "Sum of added time on td_ad without reaching current threshold" UWORD _CNV_A_R_LINEAR_____456_CM 1 100. 0. 262.14 DISPLAY_IDENTIFIER T_SUM_TD_AD[0] ECU_ADDRESS 0xd00031e4 FORMAT "%7.3" /end MEASUREMENT
/begin MEASUREMENT t_sum_td_ad[1] "Sum of added time on td_ad without reaching current threshold" UWORD _CNV_A_R_LINEAR_____456_CM 1 100. 0. 262.14 DISPLAY_IDENTIFIER T_SUM_TD_AD[1] ECU_ADDRESS 0xd00031e6 FORMAT "%7.3" /end MEASUREMENT
/begin MEASUREMENT t_sum_td_ad[2] "Sum of added time on td_ad without reaching current threshold" UWORD _CNV_A_R_LINEAR_____456_CM 1 100. 0. 262.14 DISPLAY_IDENTIFIER T_SUM_TD_AD[2] ECU_ADDRESS 0xd00031e8 FORMAT "%7.3" /end MEASUREMENT
/begin MEASUREMENT t_sum_td_ad[3] "Sum of added time on td_ad without reaching current threshold" UWORD _CNV_A_R_LINEAR_____456_CM 1 100. 0. 262.14 DISPLAY_IDENTIFIER T_SUM_TD_AD[3] ECU_ADDRESS 0xd00031ea FORMAT "%7.3" /end MEASUREMENT
/begin MEASUREMENT t_sum_td_ad[4] "Sum of added time on td_ad without reaching current threshold" UWORD _CNV_A_R_LINEAR_____456_CM 1 100. 0. 262.14 DISPLAY_IDENTIFIER T_SUM_TD_AD[4] ECU_ADDRESS 0xd00031ec FORMAT "%7.3" /end MEASUREMENT
/begin MEASUREMENT t_sum_td_ad[5] "Sum of added time on td_ad without reaching current threshold" UWORD _CNV_A_R_LINEAR_____456_CM 1 100. 0. 262.14 DISPLAY_IDENTIFIER T_SUM_TD_AD[5] ECU_ADDRESS 0xd00031ee FORMAT "%7.3" /end MEASUREMENT
/begin MEASUREMENT t_sum_td_ad[6] "Sum of added time on td_ad without reaching current threshold" UWORD _CNV_A_R_LINEAR_____456_CM 1 100. 0. 262.14 DISPLAY_IDENTIFIER T_SUM_TD_AD[6] ECU_ADDRESS 0xd00031f0 FORMAT "%7.3" /end MEASUREMENT
/begin MEASUREMENT t_sum_td_ad[7] "Sum of added time on td_ad without reaching current threshold" UWORD _CNV_A_R_LINEAR_____456_CM 1 100. 0. 262.14 DISPLAY_IDENTIFIER T_SUM_TD_AD[7] ECU_ADDRESS 0xd00031f2 FORMAT "%7.3" /end MEASUREMENT
/begin MEASUREMENT td_ad_h[0] "Dwell time adaptative during start phase" SWORD _CNV_A_R_LINEAR_____456_CM 1 100. -131.072 131.068 DISPLAY_IDENTIFIER TD_AD_H[0] ECU_ADDRESS 0xd0006548 FORMAT "%8.3" /end MEASUREMENT
/begin MEASUREMENT td_ad_h[1] "Dwell time adaptative during start phase" SWORD _CNV_A_R_LINEAR_____456_CM 1 100. -131.072 131.068 DISPLAY_IDENTIFIER TD_AD_H[1] ECU_ADDRESS 0xd000654a FORMAT "%8.3" /end MEASUREMENT
/begin MEASUREMENT td_ad_h[2] "Dwell time adaptative during start phase" SWORD _CNV_A_R_LINEAR_____456_CM 1 100. -131.072 131.068 DISPLAY_IDENTIFIER TD_AD_H[2] ECU_ADDRESS 0xd000654c FORMAT "%8.3" /end MEASUREMENT
/begin MEASUREMENT td_ad_h[3] "Dwell time adaptative during start phase" SWORD _CNV_A_R_LINEAR_____456_CM 1 100. -131.072 131.068 DISPLAY_IDENTIFIER TD_AD_H[3] ECU_ADDRESS 0xd000654e FORMAT "%8.3" /end MEASUREMENT
/begin MEASUREMENT td_ad_h[4] "Dwell time adaptative during start phase" SWORD _CNV_A_R_LINEAR_____456_CM 1 100. -131.072 131.068 DISPLAY_IDENTIFIER TD_AD_H[4] ECU_ADDRESS 0xd0006550 FORMAT "%8.3" /end MEASUREMENT
/begin MEASUREMENT td_ad_h[5] "Dwell time adaptative during start phase" SWORD _CNV_A_R_LINEAR_____456_CM 1 100. -131.072 131.068 DISPLAY_IDENTIFIER TD_AD_H[5] ECU_ADDRESS 0xd0006552 FORMAT "%8.3" /end MEASUREMENT
/begin MEASUREMENT td_ad_h[6] "Dwell time adaptative during start phase" SWORD _CNV_A_R_LINEAR_____456_CM 1 100. -131.072 131.068 DISPLAY_IDENTIFIER TD_AD_H[6] ECU_ADDRESS 0xd0006554 FORMAT "%8.3" /end MEASUREMENT
/begin MEASUREMENT td_ad_h[7] "Dwell time adaptative during start phase" SWORD _CNV_A_R_LINEAR_____456_CM 1 100. -131.072 131.068 DISPLAY_IDENTIFIER TD_AD_H[7] ECU_ADDRESS 0xd0006556 FORMAT "%8.3" /end MEASUREMENT
/begin MEASUREMENT td_ad_l[0] "Dwell time adaptative in nominal mode (outside start phase)" SWORD _CNV_A_R_LINEAR_____456_CM 1 100. -131.072 131.068 DISPLAY_IDENTIFIER TD_AD_L[0] ECU_ADDRESS 0xd0006558 FORMAT "%8.3" /end MEASUREMENT
/begin MEASUREMENT td_ad_l[1] "Dwell time adaptative in nominal mode (outside start phase)" SWORD _CNV_A_R_LINEAR_____456_CM 1 100. -131.072 131.068 DISPLAY_IDENTIFIER TD_AD_L[1] ECU_ADDRESS 0xd000655a FORMAT "%8.3" /end MEASUREMENT
/begin MEASUREMENT td_ad_l[2] "Dwell time adaptative in nominal mode (outside start phase)" SWORD _CNV_A_R_LINEAR_____456_CM 1 100. -131.072 131.068 DISPLAY_IDENTIFIER TD_AD_L[2] ECU_ADDRESS 0xd000655c FORMAT "%8.3" /end MEASUREMENT
/begin MEASUREMENT td_ad_l[3] "Dwell time adaptative in nominal mode (outside start phase)" SWORD _CNV_A_R_LINEAR_____456_CM 1 100. -131.072 131.068 DISPLAY_IDENTIFIER TD_AD_L[3] ECU_ADDRESS 0xd000655e FORMAT "%8.3" /end MEASUREMENT
/begin MEASUREMENT td_ad_l[4] "Dwell time adaptative in nominal mode (outside start phase)" SWORD _CNV_A_R_LINEAR_____456_CM 1 100. -131.072 131.068 DISPLAY_IDENTIFIER TD_AD_L[4] ECU_ADDRESS 0xd0006560 FORMAT "%8.3" /end MEASUREMENT
/begin MEASUREMENT td_ad_l[5] "Dwell time adaptative in nominal mode (outside start phase)" SWORD _CNV_A_R_LINEAR_____456_CM 1 100. -131.072 131.068 DISPLAY_IDENTIFIER TD_AD_L[5] ECU_ADDRESS 0xd0006562 FORMAT "%8.3" /end MEASUREMENT
/begin MEASUREMENT td_ad_l[6] "Dwell time adaptative in nominal mode (outside start phase)" SWORD _CNV_A_R_LINEAR_____456_CM 1 100. -131.072 131.068 DISPLAY_IDENTIFIER TD_AD_L[6] ECU_ADDRESS 0xd0006564 FORMAT "%8.3" /end MEASUREMENT
/begin MEASUREMENT td_ad_l[7] "Dwell time adaptative in nominal mode (outside start phase)" SWORD _CNV_A_R_LINEAR_____456_CM 1 100. -131.072 131.068 DISPLAY_IDENTIFIER TD_AD_L[7] ECU_ADDRESS 0xd0006566 FORMAT "%8.3" /end MEASUREMENT
/begin MEASUREMENT t_thd_igcfb "Time measurement between current threshold and end of dwell" UWORD _CNV_A_R_LINEAR_____456_CM 1 100. 0. 262.14 DISPLAY_IDENTIFIER T_THD_IGCFB ECU_ADDRESS 0xd0006532 FORMAT "%7.3" /end MEASUREMENT
/begin MEASUREMENT td_clc "Dwell time calculated by BSW" UWORD _CNV_A_R_LINEAR_____456_CM 1 100. 0. 262.14 DISPLAY_IDENTIFIER TD_CLC ECU_ADDRESS 0xd0006568 FORMAT "%7.3" /end MEASUREMENT
/begin MEASUREMENT lv_inh_td_ad "flag indicating that dwell time adaptative function is inhibited" UBYTE _CNV_S_2_RANGE__0___1_CM 1 100. 0. 1. DISPLAY_IDENTIFIER LV_INH_TD_AD ECU_ADDRESS 0xd00073b1 BIT_MASK 0x1 /end MEASUREMENT
/begin MEASUREMENT lv_td_ad_h "flag indicating dwell time adaptation is done in start" UBYTE _CNV_S_2_RANGE__0___1_CM 1 100. 0. 1. DISPLAY_IDENTIFIER LV_TD_AD_H ECU_ADDRESS 0xd00073cc BIT_MASK 0x1 /end MEASUREMENT
/begin MEASUREMENT state_ch_mod_ivvt "Bit-coded mask, containing combustion-mode-request for catalyst heating and the desulfation strategy; 2. Prio" UBYTE _CNV_A_R_LINEAR_____0_CM 1 100. 0. 255. DISPLAY_IDENTIFIER STATE_CH_MOD_IVVT ECU_ADDRESS 0xd00075ec FORMAT "%3.0" /end MEASUREMENT
/begin MEASUREMENT state_ch_mod_ivvt_req "Bit-coded mask, containing combustion-mode-request for catalyst heating and the desulfation strategy; 1. Prio" UBYTE _CNV_A_R_LINEAR_____0_CM 1 100. 0. 255. DISPLAY_IDENTIFIER STATE_CH_MOD_IVVT_REQ ECU_ADDRESS 0xd00075ed FORMAT "%3.0" /end MEASUREMENT
/begin AXIS_PTS ldpm_state_ch_mod_req "" 0xa0805a2a state_ch_mod_req _REC_AXS_20_u1 4. _CNV_A_R_LINEAR_____0_CM 5 0. 4. FORMAT "%2.0" /end AXIS_PTS
/begin AXIS_PTS ldpm_state_opm_ivvt_ch "" 0xa0805a30 state_opm_ivvt_ch _REC_AXS_20_u1 2. _CNV_A_R_LINEAR_____0_CM 3 0. 2. FORMAT "%1.0" /end AXIS_PTS
/begin CHARACTERISTIC id_state_ch_mod_req_ivvt "Matrix of Bit-mask for 1.Prio-Request" MAP 0xa0805b80 _REC_MAP_20_u1_u1_u1 255. _CNV_A_R_LINEAR_____0_CM 0. 255. DISPLAY_IDENTIFIER ID_STATE_CH_MOD_REQ_IVVT FORMAT "%3.0"
 /begin AXIS_DESCR COM_AXIS state_ch_mod_req _CNV_A_R_LINEAR_____0_CM 5 0. 4. FORMAT "%2.0" AXIS_PTS_REF ldpm_state_ch_mod_req /end AXIS_DESCR
 /begin AXIS_DESCR COM_AXIS state_opm_ivvt_ch _CNV_A_R_LINEAR_____0_CM 3 0. 2. FORMAT "%1.0" AXIS_PTS_REF ldpm_state_opm_ivvt_ch /end AXIS_DESCR
/end CHARACTERISTIC
/begin CHARACTERISTIC id_state_ch_mod_req_ivvt_so2p "Matrix of Bit-mask in case of desulfation for 1.Prio-Request" MAP 0xa0805b90 _REC_MAP_20_u1_u1_u1 255. _CNV_A_R_LINEAR_____0_CM 0. 255. DISPLAY_IDENTIFIER ID_STATE_CH_MOD_REQ_IVVT_SO2P FORMAT "%3.0"
 /begin AXIS_DESCR COM_AXIS state_ch_mod_req _CNV_A_R_LINEAR_____0_CM 5 0. 4. FORMAT "%2.0" AXIS_PTS_REF ldpm_state_ch_mod_req /end AXIS_DESCR
 /begin AXIS_DESCR COM_AXIS state_opm_ivvt_ch _CNV_A_R_LINEAR_____0_CM 3 0. 2. FORMAT "%1.0" AXIS_PTS_REF ldpm_state_opm_ivvt_ch /end AXIS_DESCR
/end CHARACTERISTIC
/begin CHARACTERISTIC id_state_ch_mod_ivvt_so2p "Matrix of Bit-mask in case of desulfation for 2.Prio-Request" MAP 0xa0805b70 _REC_MAP_20_u1_u1_u1 255. _CNV_A_R_LINEAR_____0_CM 0. 255. DISPLAY_IDENTIFIER ID_STATE_CH_MOD_IVVT_SO2P FORMAT "%3.0"
 /begin AXIS_DESCR COM_AXIS state_ch_mod_req _CNV_A_R_LINEAR_____0_CM 5 0. 4. FORMAT "%2.0" AXIS_PTS_REF ldpm_state_ch_mod_req /end AXIS_DESCR
 /begin AXIS_DESCR COM_AXIS state_opm_ivvt_ch _CNV_A_R_LINEAR_____0_CM 3 0. 2. FORMAT "%1.0" AXIS_PTS_REF ldpm_state_opm_ivvt_ch /end AXIS_DESCR
/end CHARACTERISTIC
/begin CHARACTERISTIC id_state_ch_mod_ivvt "Matrix of Bit-mask for 2.Prio-Request" MAP 0xa0805b60 _REC_MAP_20_u1_u1_u1 255. _CNV_A_R_LINEAR_____0_CM 0. 255. DISPLAY_IDENTIFIER ID_STATE_CH_MOD_IVVT FORMAT "%3.0"
 /begin AXIS_DESCR COM_AXIS state_ch_mod_req _CNV_A_R_LINEAR_____0_CM 5 0. 4. FORMAT "%2.0" AXIS_PTS_REF ldpm_state_ch_mod_req /end AXIS_DESCR
 /begin AXIS_DESCR COM_AXIS state_opm_ivvt_ch _CNV_A_R_LINEAR_____0_CM 3 0. 2. FORMAT "%1.0" AXIS_PTS_REF ldpm_state_opm_ivvt_ch /end AXIS_DESCR
/end CHARACTERISTIC
/begin CHARACTERISTIC c_t_ofs_upd_ign_inj_syn "Task run time offset for a synchronized update of ignition and injectino parameters to IO software." VALUE 0xa08008be _REC_VAL_20_u2 65.535 _CNV_A_R_LINEAR_____228_CM 0. 65.535 DISPLAY_IDENTIFIER C_T_OFS_UPD_IGN_INJ_SYN /end CHARACTERISTIC
/begin CHARACTERISTIC lc_ign_inj_syn_ena "Logical constant to enable synchronization functionality between IGRE and INJR (=1 synchronization enabled)." VALUE 0xa08008e3 _REC_VAL_20_u1 1. _CNV_S_2_RANGE__0___1_CM 0. 1. DISPLAY_IDENTIFIER LC_IGN_INJ_SYN_ENA /end CHARACTERISTIC
/begin MEASUREMENT state_inj_upd_trm "State, which indicates that at least one data set per cylinder was sent to IO-SW (bit x of assigned cylinder)." UBYTE _CNV_A_R_LINEAR_____0_CM 1 100. 0. 255. DISPLAY_IDENTIFIER STATE_INJ_UPD_TRM ECU_ADDRESS 0xd000739c FORMAT "%3.0" /end MEASUREMENT
/begin MEASUREMENT state_ign_inj_upd_ack "Feedback from IO-software of successful data fransfer for cylinder x, if bit x = 1." UBYTE _CNV_A_R_LINEAR_____0_CM 1 100. 0. 255. DISPLAY_IDENTIFIER STATE_IGN_INJ_UPD_ACK ECU_ADDRESS 0xd0003239 FORMAT "%3.0" /end MEASUREMENT
/begin MEASUREMENT td_fac_min_tmp "Factor to calculate minimum dwell time." UBYTE _CNV_A_R_LINEAR_____103_CM 1 100. 0. 1.9921875 DISPLAY_IDENTIFIER TD_FAC_MIN_TMP ECU_ADDRESS 0xd000323b FORMAT "%8.6" /end MEASUREMENT
/begin MEASUREMENT td_fac_max_tmp "Factor to calculate maximum dwell time." UBYTE _CNV_A_R_LINEAR_____103_CM 1 100. 0. 1.9921875 DISPLAY_IDENTIFIER TD_FAC_MAX_TMP ECU_ADDRESS 0xd000323a FORMAT "%8.6" /end MEASUREMENT
/begin MEASUREMENT td_igc_act[0] "Dwell time currently applied by IO-SW, cylinder individual." UWORD _CNV_A_R_LINEAR_____456_CM 1 100. 0. 262.14 DISPLAY_IDENTIFIER TD_IGC_ACT[0] ECU_ADDRESS 0xd00031f4 FORMAT "%7.3" /end MEASUREMENT
/begin MEASUREMENT td_igc_act[1] "Dwell time currently applied by IO-SW, cylinder individual." UWORD _CNV_A_R_LINEAR_____456_CM 1 100. 0. 262.14 DISPLAY_IDENTIFIER TD_IGC_ACT[1] ECU_ADDRESS 0xd00031f6 FORMAT "%7.3" /end MEASUREMENT
/begin MEASUREMENT td_igc_act[2] "Dwell time currently applied by IO-SW, cylinder individual." UWORD _CNV_A_R_LINEAR_____456_CM 1 100. 0. 262.14 DISPLAY_IDENTIFIER TD_IGC_ACT[2] ECU_ADDRESS 0xd00031f8 FORMAT "%7.3" /end MEASUREMENT
/begin MEASUREMENT td_igc_act[3] "Dwell time currently applied by IO-SW, cylinder individual." UWORD _CNV_A_R_LINEAR_____456_CM 1 100. 0. 262.14 DISPLAY_IDENTIFIER TD_IGC_ACT[3] ECU_ADDRESS 0xd00031fa FORMAT "%7.3" /end MEASUREMENT
/begin MEASUREMENT td_igc_act[4] "Dwell time currently applied by IO-SW, cylinder individual." UWORD _CNV_A_R_LINEAR_____456_CM 1 100. 0. 262.14 DISPLAY_IDENTIFIER TD_IGC_ACT[4] ECU_ADDRESS 0xd00031fc FORMAT "%7.3" /end MEASUREMENT
/begin MEASUREMENT td_igc_act[5] "Dwell time currently applied by IO-SW, cylinder individual." UWORD _CNV_A_R_LINEAR_____456_CM 1 100. 0. 262.14 DISPLAY_IDENTIFIER TD_IGC_ACT[5] ECU_ADDRESS 0xd00031fe FORMAT "%7.3" /end MEASUREMENT
/begin MEASUREMENT td_igc_act[6] "Dwell time currently applied by IO-SW, cylinder individual." UWORD _CNV_A_R_LINEAR_____456_CM 1 100. 0. 262.14 DISPLAY_IDENTIFIER TD_IGC_ACT[6] ECU_ADDRESS 0xd0003200 FORMAT "%7.3" /end MEASUREMENT
/begin MEASUREMENT td_igc_act[7] "Dwell time currently applied by IO-SW, cylinder individual." UWORD _CNV_A_R_LINEAR_____456_CM 1 100. 0. 262.14 DISPLAY_IDENTIFIER TD_IGC_ACT[7] ECU_ADDRESS 0xd0003202 FORMAT "%7.3" /end MEASUREMENT
/begin MEASUREMENT td_igc_act_max "Maximum dwell time of all cylinders currently applied by I/O-SW" UWORD _CNV_A_R_LINEAR_____456_CM 1 100. 0. 262.14 DISPLAY_IDENTIFIER TD_IGC_ACT_MAX ECU_ADDRESS 0xd0003204 FORMAT "%7.3" /end MEASUREMENT
/begin MEASUREMENT td_igc_act_min "Minimum dwell time of all cylinders currently applied by I/O-SW" UWORD _CNV_A_R_LINEAR_____456_CM 1 100. 0. 262.14 DISPLAY_IDENTIFIER TD_IGC_ACT_MIN ECU_ADDRESS 0xd0003206 FORMAT "%7.3" /end MEASUREMENT
/begin MEASUREMENT iga_igc_h_rng_act[0] "Ignition angle (high range) currently applied by IO-SW, cylinder individual." SWORD _CNV_A_R_LINEAR_____188_CM 1 100. -90. 90. DISPLAY_IDENTIFIER IGA_IGC_H_RNG_ACT[0] ECU_ADDRESS 0xd00031b4 FORMAT "%8.4" /end MEASUREMENT
/begin MEASUREMENT iga_igc_h_rng_act[1] "Ignition angle (high range) currently applied by IO-SW, cylinder individual." SWORD _CNV_A_R_LINEAR_____188_CM 1 100. -90. 90. DISPLAY_IDENTIFIER IGA_IGC_H_RNG_ACT[1] ECU_ADDRESS 0xd00031b6 FORMAT "%8.4" /end MEASUREMENT
/begin MEASUREMENT iga_igc_h_rng_act[2] "Ignition angle (high range) currently applied by IO-SW, cylinder individual." SWORD _CNV_A_R_LINEAR_____188_CM 1 100. -90. 90. DISPLAY_IDENTIFIER IGA_IGC_H_RNG_ACT[2] ECU_ADDRESS 0xd00031b8 FORMAT "%8.4" /end MEASUREMENT
/begin MEASUREMENT iga_igc_h_rng_act[3] "Ignition angle (high range) currently applied by IO-SW, cylinder individual." SWORD _CNV_A_R_LINEAR_____188_CM 1 100. -90. 90. DISPLAY_IDENTIFIER IGA_IGC_H_RNG_ACT[3] ECU_ADDRESS 0xd00031ba FORMAT "%8.4" /end MEASUREMENT
/begin MEASUREMENT iga_igc_h_rng_act[4] "Ignition angle (high range) currently applied by IO-SW, cylinder individual." SWORD _CNV_A_R_LINEAR_____188_CM 1 100. -90. 90. DISPLAY_IDENTIFIER IGA_IGC_H_RNG_ACT[4] ECU_ADDRESS 0xd00031bc FORMAT "%8.4" /end MEASUREMENT
/begin MEASUREMENT iga_igc_h_rng_act[5] "Ignition angle (high range) currently applied by IO-SW, cylinder individual." SWORD _CNV_A_R_LINEAR_____188_CM 1 100. -90. 90. DISPLAY_IDENTIFIER IGA_IGC_H_RNG_ACT[5] ECU_ADDRESS 0xd00031be FORMAT "%8.4" /end MEASUREMENT
/begin MEASUREMENT iga_igc_h_rng_act[6] "Ignition angle (high range) currently applied by IO-SW, cylinder individual." SWORD _CNV_A_R_LINEAR_____188_CM 1 100. -90. 90. DISPLAY_IDENTIFIER IGA_IGC_H_RNG_ACT[6] ECU_ADDRESS 0xd00031c0 FORMAT "%8.4" /end MEASUREMENT
/begin MEASUREMENT iga_igc_h_rng_act[7] "Ignition angle (high range) currently applied by IO-SW, cylinder individual." SWORD _CNV_A_R_LINEAR_____188_CM 1 100. -90. 90. DISPLAY_IDENTIFIER IGA_IGC_H_RNG_ACT[7] ECU_ADDRESS 0xd00031c2 FORMAT "%8.4" /end MEASUREMENT
/begin MEASUREMENT ti_act[0] "Actual applied injection time for parameter update decision calculation, cylinder individual." UWORD _CNV_A_R_LINEAR_____228_CM 1 100. 0. 65.535 DISPLAY_IDENTIFIER TI_ACT[0] ECU_ADDRESS 0xd0003218 /end MEASUREMENT
/begin MEASUREMENT ti_act[1] "Actual applied injection time for parameter update decision calculation, cylinder individual." UWORD _CNV_A_R_LINEAR_____228_CM 1 100. 0. 65.535 DISPLAY_IDENTIFIER TI_ACT[1] ECU_ADDRESS 0xd000321a /end MEASUREMENT
/begin MEASUREMENT ti_act[2] "Actual applied injection time for parameter update decision calculation, cylinder individual." UWORD _CNV_A_R_LINEAR_____228_CM 1 100. 0. 65.535 DISPLAY_IDENTIFIER TI_ACT[2] ECU_ADDRESS 0xd000321c /end MEASUREMENT
/begin MEASUREMENT ti_act[3] "Actual applied injection time for parameter update decision calculation, cylinder individual." UWORD _CNV_A_R_LINEAR_____228_CM 1 100. 0. 65.535 DISPLAY_IDENTIFIER TI_ACT[3] ECU_ADDRESS 0xd000321e /end MEASUREMENT
/begin MEASUREMENT ti_act[4] "Actual applied injection time for parameter update decision calculation, cylinder individual." UWORD _CNV_A_R_LINEAR_____228_CM 1 100. 0. 65.535 DISPLAY_IDENTIFIER TI_ACT[4] ECU_ADDRESS 0xd0003220 /end MEASUREMENT
/begin MEASUREMENT ti_act[5] "Actual applied injection time for parameter update decision calculation, cylinder individual." UWORD _CNV_A_R_LINEAR_____228_CM 1 100. 0. 65.535 DISPLAY_IDENTIFIER TI_ACT[5] ECU_ADDRESS 0xd0003222 /end MEASUREMENT
/begin MEASUREMENT ti_act[6] "Actual applied injection time for parameter update decision calculation, cylinder individual." UWORD _CNV_A_R_LINEAR_____228_CM 1 100. 0. 65.535 DISPLAY_IDENTIFIER TI_ACT[6] ECU_ADDRESS 0xd0003224 /end MEASUREMENT
/begin MEASUREMENT ti_act[7] "Actual applied injection time for parameter update decision calculation, cylinder individual." UWORD _CNV_A_R_LINEAR_____228_CM 1 100. 0. 65.535 DISPLAY_IDENTIFIER TI_ACT[7] ECU_ADDRESS 0xd0003226 /end MEASUREMENT
/begin MEASUREMENT ti_mod_swi_act[0] "Actual applied injection time for combustion mode switch decision calculation, cylinder individual." UWORD _CNV_A_R_LINEAR_____228_CM 1 100. 0. 65.535 DISPLAY_IDENTIFIER TI_MOD_SWI_ACT[0] ECU_ADDRESS 0xd0003228 /end MEASUREMENT
/begin MEASUREMENT ti_mod_swi_act[1] "Actual applied injection time for combustion mode switch decision calculation, cylinder individual." UWORD _CNV_A_R_LINEAR_____228_CM 1 100. 0. 65.535 DISPLAY_IDENTIFIER TI_MOD_SWI_ACT[1] ECU_ADDRESS 0xd000322a /end MEASUREMENT
/begin MEASUREMENT ti_mod_swi_act[2] "Actual applied injection time for combustion mode switch decision calculation, cylinder individual." UWORD _CNV_A_R_LINEAR_____228_CM 1 100. 0. 65.535 DISPLAY_IDENTIFIER TI_MOD_SWI_ACT[2] ECU_ADDRESS 0xd000322c /end MEASUREMENT
/begin MEASUREMENT ti_mod_swi_act[3] "Actual applied injection time for combustion mode switch decision calculation, cylinder individual." UWORD _CNV_A_R_LINEAR_____228_CM 1 100. 0. 65.535 DISPLAY_IDENTIFIER TI_MOD_SWI_ACT[3] ECU_ADDRESS 0xd000322e /end MEASUREMENT
/begin MEASUREMENT ti_mod_swi_act[4] "Actual applied injection time for combustion mode switch decision calculation, cylinder individual." UWORD _CNV_A_R_LINEAR_____228_CM 1 100. 0. 65.535 DISPLAY_IDENTIFIER TI_MOD_SWI_ACT[4] ECU_ADDRESS 0xd0003230 /end MEASUREMENT
/begin MEASUREMENT ti_mod_swi_act[5] "Actual applied injection time for combustion mode switch decision calculation, cylinder individual." UWORD _CNV_A_R_LINEAR_____228_CM 1 100. 0. 65.535 DISPLAY_IDENTIFIER TI_MOD_SWI_ACT[5] ECU_ADDRESS 0xd0003232 /end MEASUREMENT
/begin MEASUREMENT ti_mod_swi_act[6] "Actual applied injection time for combustion mode switch decision calculation, cylinder individual." UWORD _CNV_A_R_LINEAR_____228_CM 1 100. 0. 65.535 DISPLAY_IDENTIFIER TI_MOD_SWI_ACT[6] ECU_ADDRESS 0xd0003234 /end MEASUREMENT
/begin MEASUREMENT ti_mod_swi_act[7] "Actual applied injection time for combustion mode switch decision calculation, cylinder individual." UWORD _CNV_A_R_LINEAR_____228_CM 1 100. 0. 65.535 DISPLAY_IDENTIFIER TI_MOD_SWI_ACT[7] ECU_ADDRESS 0xd0003236 /end MEASUREMENT
/begin MEASUREMENT lv_ign_inj_upd_trm[0] "Cylinder flag, which indicates if a parameter update was transmitted to IO-SW or not during last function call." UBYTE _CNV_S_2_RANGE__0___1_CM 1 100. 0. 1. DISPLAY_IDENTIFIER LV_IGN_INJ_UPD_TRM[0] ECU_ADDRESS 0xd0003248 BIT_MASK 0x1 /end MEASUREMENT
/begin MEASUREMENT lv_ign_inj_upd_trm[1] "Cylinder flag, which indicates if a parameter update was transmitted to IO-SW or not during last function call." UBYTE _CNV_S_2_RANGE__0___1_CM 1 100. 0. 1. DISPLAY_IDENTIFIER LV_IGN_INJ_UPD_TRM[1] ECU_ADDRESS 0xd0003249 BIT_MASK 0x1 /end MEASUREMENT
/begin MEASUREMENT lv_ign_inj_upd_trm[2] "Cylinder flag, which indicates if a parameter update was transmitted to IO-SW or not during last function call." UBYTE _CNV_S_2_RANGE__0___1_CM 1 100. 0. 1. DISPLAY_IDENTIFIER LV_IGN_INJ_UPD_TRM[2] ECU_ADDRESS 0xd000324a BIT_MASK 0x1 /end MEASUREMENT
/begin MEASUREMENT lv_ign_inj_upd_trm[3] "Cylinder flag, which indicates if a parameter update was transmitted to IO-SW or not during last function call." UBYTE _CNV_S_2_RANGE__0___1_CM 1 100. 0. 1. DISPLAY_IDENTIFIER LV_IGN_INJ_UPD_TRM[3] ECU_ADDRESS 0xd000324b BIT_MASK 0x1 /end MEASUREMENT
/begin MEASUREMENT lv_ign_inj_upd_trm[4] "Cylinder flag, which indicates if a parameter update was transmitted to IO-SW or not during last function call." UBYTE _CNV_S_2_RANGE__0___1_CM 1 100. 0. 1. DISPLAY_IDENTIFIER LV_IGN_INJ_UPD_TRM[4] ECU_ADDRESS 0xd000324c BIT_MASK 0x1 /end MEASUREMENT
/begin MEASUREMENT lv_ign_inj_upd_trm[5] "Cylinder flag, which indicates if a parameter update was transmitted to IO-SW or not during last function call." UBYTE _CNV_S_2_RANGE__0___1_CM 1 100. 0. 1. DISPLAY_IDENTIFIER LV_IGN_INJ_UPD_TRM[5] ECU_ADDRESS 0xd000324d BIT_MASK 0x1 /end MEASUREMENT
/begin MEASUREMENT lv_ign_inj_upd_trm[6] "Cylinder flag, which indicates if a parameter update was transmitted to IO-SW or not during last function call." UBYTE _CNV_S_2_RANGE__0___1_CM 1 100. 0. 1. DISPLAY_IDENTIFIER LV_IGN_INJ_UPD_TRM[6] ECU_ADDRESS 0xd000324e BIT_MASK 0x1 /end MEASUREMENT
/begin MEASUREMENT lv_ign_inj_upd_trm[7] "Cylinder flag, which indicates if a parameter update was transmitted to IO-SW or not during last function call." UBYTE _CNV_S_2_RANGE__0___1_CM 1 100. 0. 1. DISPLAY_IDENTIFIER LV_IGN_INJ_UPD_TRM[7] ECU_ADDRESS 0xd000324f BIT_MASK 0x1 /end MEASUREMENT
/begin MEASUREMENT soi_act[0] "Actual applied start of injection angle for parameter update decision calculation, cylinder individual." UWORD _CNV_A_R_LINEAR_____200_CM 1 100. 0. 720. DISPLAY_IDENTIFIER SOI_ACT[0] ECU_ADDRESS 0xd00031c4 FORMAT "%7.3" /end MEASUREMENT
/begin MEASUREMENT soi_act[1] "Actual applied start of injection angle for parameter update decision calculation, cylinder individual." UWORD _CNV_A_R_LINEAR_____200_CM 1 100. 0. 720. DISPLAY_IDENTIFIER SOI_ACT[1] ECU_ADDRESS 0xd00031c6 FORMAT "%7.3" /end MEASUREMENT
/begin MEASUREMENT soi_act[2] "Actual applied start of injection angle for parameter update decision calculation, cylinder individual." UWORD _CNV_A_R_LINEAR_____200_CM 1 100. 0. 720. DISPLAY_IDENTIFIER SOI_ACT[2] ECU_ADDRESS 0xd00031c8 FORMAT "%7.3" /end MEASUREMENT
/begin MEASUREMENT soi_act[3] "Actual applied start of injection angle for parameter update decision calculation, cylinder individual." UWORD _CNV_A_R_LINEAR_____200_CM 1 100. 0. 720. DISPLAY_IDENTIFIER SOI_ACT[3] ECU_ADDRESS 0xd00031ca FORMAT "%7.3" /end MEASUREMENT
/begin MEASUREMENT soi_act[4] "Actual applied start of injection angle for parameter update decision calculation, cylinder individual." UWORD _CNV_A_R_LINEAR_____200_CM 1 100. 0. 720. DISPLAY_IDENTIFIER SOI_ACT[4] ECU_ADDRESS 0xd00031cc FORMAT "%7.3" /end MEASUREMENT
/begin MEASUREMENT soi_act[5] "Actual applied start of injection angle for parameter update decision calculation, cylinder individual." UWORD _CNV_A_R_LINEAR_____200_CM 1 100. 0. 720. DISPLAY_IDENTIFIER SOI_ACT[5] ECU_ADDRESS 0xd00031ce FORMAT "%7.3" /end MEASUREMENT
/begin MEASUREMENT soi_act[6] "Actual applied start of injection angle for parameter update decision calculation, cylinder individual." UWORD _CNV_A_R_LINEAR_____200_CM 1 100. 0. 720. DISPLAY_IDENTIFIER SOI_ACT[6] ECU_ADDRESS 0xd00031d0 FORMAT "%7.3" /end MEASUREMENT
/begin MEASUREMENT soi_act[7] "Actual applied start of injection angle for parameter update decision calculation, cylinder individual." UWORD _CNV_A_R_LINEAR_____200_CM 1 100. 0. 720. DISPLAY_IDENTIFIER SOI_ACT[7] ECU_ADDRESS 0xd00031d2 FORMAT "%7.3" /end MEASUREMENT
/begin MEASUREMENT eoi_act[0] "Actual applied end of injection angle for parameter update decision calculation, cylinder individual." UWORD _CNV_A_R_LINEAR_____200_CM 1 100. 0. 720. DISPLAY_IDENTIFIER EOI_ACT[0] ECU_ADDRESS 0xd0003194 FORMAT "%7.3" /end MEASUREMENT
/begin MEASUREMENT eoi_act[1] "Actual applied end of injection angle for parameter update decision calculation, cylinder individual." UWORD _CNV_A_R_LINEAR_____200_CM 1 100. 0. 720. DISPLAY_IDENTIFIER EOI_ACT[1] ECU_ADDRESS 0xd0003196 FORMAT "%7.3" /end MEASUREMENT
/begin MEASUREMENT eoi_act[2] "Actual applied end of injection angle for parameter update decision calculation, cylinder individual." UWORD _CNV_A_R_LINEAR_____200_CM 1 100. 0. 720. DISPLAY_IDENTIFIER EOI_ACT[2] ECU_ADDRESS 0xd0003198 FORMAT "%7.3" /end MEASUREMENT
/begin MEASUREMENT eoi_act[3] "Actual applied end of injection angle for parameter update decision calculation, cylinder individual." UWORD _CNV_A_R_LINEAR_____200_CM 1 100. 0. 720. DISPLAY_IDENTIFIER EOI_ACT[3] ECU_ADDRESS 0xd000319a FORMAT "%7.3" /end MEASUREMENT
/begin MEASUREMENT eoi_act[4] "Actual applied end of injection angle for parameter update decision calculation, cylinder individual." UWORD _CNV_A_R_LINEAR_____200_CM 1 100. 0. 720. DISPLAY_IDENTIFIER EOI_ACT[4] ECU_ADDRESS 0xd000319c FORMAT "%7.3" /end MEASUREMENT
/begin MEASUREMENT eoi_act[5] "Actual applied end of injection angle for parameter update decision calculation, cylinder individual." UWORD _CNV_A_R_LINEAR_____200_CM 1 100. 0. 720. DISPLAY_IDENTIFIER EOI_ACT[5] ECU_ADDRESS 0xd000319e FORMAT "%7.3" /end MEASUREMENT
/begin MEASUREMENT eoi_act[6] "Actual applied end of injection angle for parameter update decision calculation, cylinder individual." UWORD _CNV_A_R_LINEAR_____200_CM 1 100. 0. 720. DISPLAY_IDENTIFIER EOI_ACT[6] ECU_ADDRESS 0xd00031a0 FORMAT "%7.3" /end MEASUREMENT
/begin MEASUREMENT eoi_act[7] "Actual applied end of injection angle for parameter update decision calculation, cylinder individual." UWORD _CNV_A_R_LINEAR_____200_CM 1 100. 0. 720. DISPLAY_IDENTIFIER EOI_ACT[7] ECU_ADDRESS 0xd00031a2 FORMAT "%7.3" /end MEASUREMENT
/begin MEASUREMENT soi_mod_swi_act[0] "Actual applied start of injectino angle for combustion mode switch decision calculation, cylinder individual." UWORD _CNV_A_R_LINEAR_____200_CM 1 100. 0. 720. DISPLAY_IDENTIFIER SOI_MOD_SWI_ACT[0] ECU_ADDRESS 0xd00031d4 FORMAT "%7.3" /end MEASUREMENT
/begin MEASUREMENT soi_mod_swi_act[1] "Actual applied start of injectino angle for combustion mode switch decision calculation, cylinder individual." UWORD _CNV_A_R_LINEAR_____200_CM 1 100. 0. 720. DISPLAY_IDENTIFIER SOI_MOD_SWI_ACT[1] ECU_ADDRESS 0xd00031d6 FORMAT "%7.3" /end MEASUREMENT
/begin MEASUREMENT soi_mod_swi_act[2] "Actual applied start of injectino angle for combustion mode switch decision calculation, cylinder individual." UWORD _CNV_A_R_LINEAR_____200_CM 1 100. 0. 720. DISPLAY_IDENTIFIER SOI_MOD_SWI_ACT[2] ECU_ADDRESS 0xd00031d8 FORMAT "%7.3" /end MEASUREMENT
/begin MEASUREMENT soi_mod_swi_act[3] "Actual applied start of injectino angle for combustion mode switch decision calculation, cylinder individual." UWORD _CNV_A_R_LINEAR_____200_CM 1 100. 0. 720. DISPLAY_IDENTIFIER SOI_MOD_SWI_ACT[3] ECU_ADDRESS 0xd00031da FORMAT "%7.3" /end MEASUREMENT
/begin MEASUREMENT soi_mod_swi_act[4] "Actual applied start of injectino angle for combustion mode switch decision calculation, cylinder individual." UWORD _CNV_A_R_LINEAR_____200_CM 1 100. 0. 720. DISPLAY_IDENTIFIER SOI_MOD_SWI_ACT[4] ECU_ADDRESS 0xd00031dc FORMAT "%7.3" /end MEASUREMENT
/begin MEASUREMENT soi_mod_swi_act[5] "Actual applied start of injectino angle for combustion mode switch decision calculation, cylinder individual." UWORD _CNV_A_R_LINEAR_____200_CM 1 100. 0. 720. DISPLAY_IDENTIFIER SOI_MOD_SWI_ACT[5] ECU_ADDRESS 0xd00031de FORMAT "%7.3" /end MEASUREMENT
/begin MEASUREMENT soi_mod_swi_act[6] "Actual applied start of injectino angle for combustion mode switch decision calculation, cylinder individual." UWORD _CNV_A_R_LINEAR_____200_CM 1 100. 0. 720. DISPLAY_IDENTIFIER SOI_MOD_SWI_ACT[6] ECU_ADDRESS 0xd00031e0 FORMAT "%7.3" /end MEASUREMENT
/begin MEASUREMENT soi_mod_swi_act[7] "Actual applied start of injectino angle for combustion mode switch decision calculation, cylinder individual." UWORD _CNV_A_R_LINEAR_____200_CM 1 100. 0. 720. DISPLAY_IDENTIFIER SOI_MOD_SWI_ACT[7] ECU_ADDRESS 0xd00031e2 FORMAT "%7.3" /end MEASUREMENT
/begin MEASUREMENT eoi_mod_swi_act[0] "Actual applied end of injectino angle for combustion mode switch decision calculation, cylinder individual." UWORD _CNV_A_R_LINEAR_____200_CM 1 100. 0. 720. DISPLAY_IDENTIFIER EOI_MOD_SWI_ACT[0] ECU_ADDRESS 0xd00031a4 FORMAT "%7.3" /end MEASUREMENT
/begin MEASUREMENT eoi_mod_swi_act[1] "Actual applied end of injectino angle for combustion mode switch decision calculation, cylinder individual." UWORD _CNV_A_R_LINEAR_____200_CM 1 100. 0. 720. DISPLAY_IDENTIFIER EOI_MOD_SWI_ACT[1] ECU_ADDRESS 0xd00031a6 FORMAT "%7.3" /end MEASUREMENT
/begin MEASUREMENT eoi_mod_swi_act[2] "Actual applied end of injectino angle for combustion mode switch decision calculation, cylinder individual." UWORD _CNV_A_R_LINEAR_____200_CM 1 100. 0. 720. DISPLAY_IDENTIFIER EOI_MOD_SWI_ACT[2] ECU_ADDRESS 0xd00031a8 FORMAT "%7.3" /end MEASUREMENT
/begin MEASUREMENT eoi_mod_swi_act[3] "Actual applied end of injectino angle for combustion mode switch decision calculation, cylinder individual." UWORD _CNV_A_R_LINEAR_____200_CM 1 100. 0. 720. DISPLAY_IDENTIFIER EOI_MOD_SWI_ACT[3] ECU_ADDRESS 0xd00031aa FORMAT "%7.3" /end MEASUREMENT
/begin MEASUREMENT eoi_mod_swi_act[4] "Actual applied end of injectino angle for combustion mode switch decision calculation, cylinder individual." UWORD _CNV_A_R_LINEAR_____200_CM 1 100. 0. 720. DISPLAY_IDENTIFIER EOI_MOD_SWI_ACT[4] ECU_ADDRESS 0xd00031ac FORMAT "%7.3" /end MEASUREMENT
/begin MEASUREMENT eoi_mod_swi_act[5] "Actual applied end of injectino angle for combustion mode switch decision calculation, cylinder individual." UWORD _CNV_A_R_LINEAR_____200_CM 1 100. 0. 720. DISPLAY_IDENTIFIER EOI_MOD_SWI_ACT[5] ECU_ADDRESS 0xd00031ae FORMAT "%7.3" /end MEASUREMENT
/begin MEASUREMENT eoi_mod_swi_act[6] "Actual applied end of injectino angle for combustion mode switch decision calculation, cylinder individual." UWORD _CNV_A_R_LINEAR_____200_CM 1 100. 0. 720. DISPLAY_IDENTIFIER EOI_MOD_SWI_ACT[6] ECU_ADDRESS 0xd00031b0 FORMAT "%7.3" /end MEASUREMENT
/begin MEASUREMENT eoi_mod_swi_act[7] "Actual applied end of injectino angle for combustion mode switch decision calculation, cylinder individual." UWORD _CNV_A_R_LINEAR_____200_CM 1 100. 0. 720. DISPLAY_IDENTIFIER EOI_MOD_SWI_ACT[7] ECU_ADDRESS 0xd00031b2 FORMAT "%7.3" /end MEASUREMENT
/begin MEASUREMENT crk_psn_eng_ign_inj_upd[0] "Expected engine update position at start of transmitting ignition and injection parameter to IO-SW." UWORD _CNV_A_R_LINEAR_____200_CM 1 100. 0. 720. DISPLAY_IDENTIFIER CRK_PSN_ENG_IGN_INJ_UPD[0] ECU_ADDRESS 0xd0003184 FORMAT "%7.3" /end MEASUREMENT
/begin MEASUREMENT crk_psn_eng_ign_inj_upd[1] "Expected engine update position at start of transmitting ignition and injection parameter to IO-SW." UWORD _CNV_A_R_LINEAR_____200_CM 1 100. 0. 720. DISPLAY_IDENTIFIER CRK_PSN_ENG_IGN_INJ_UPD[1] ECU_ADDRESS 0xd0003186 FORMAT "%7.3" /end MEASUREMENT
/begin MEASUREMENT crk_psn_eng_ign_inj_upd[2] "Expected engine update position at start of transmitting ignition and injection parameter to IO-SW." UWORD _CNV_A_R_LINEAR_____200_CM 1 100. 0. 720. DISPLAY_IDENTIFIER CRK_PSN_ENG_IGN_INJ_UPD[2] ECU_ADDRESS 0xd0003188 FORMAT "%7.3" /end MEASUREMENT
/begin MEASUREMENT crk_psn_eng_ign_inj_upd[3] "Expected engine update position at start of transmitting ignition and injection parameter to IO-SW." UWORD _CNV_A_R_LINEAR_____200_CM 1 100. 0. 720. DISPLAY_IDENTIFIER CRK_PSN_ENG_IGN_INJ_UPD[3] ECU_ADDRESS 0xd000318a FORMAT "%7.3" /end MEASUREMENT
/begin MEASUREMENT crk_psn_eng_ign_inj_upd[4] "Expected engine update position at start of transmitting ignition and injection parameter to IO-SW." UWORD _CNV_A_R_LINEAR_____200_CM 1 100. 0. 720. DISPLAY_IDENTIFIER CRK_PSN_ENG_IGN_INJ_UPD[4] ECU_ADDRESS 0xd000318c FORMAT "%7.3" /end MEASUREMENT
/begin MEASUREMENT crk_psn_eng_ign_inj_upd[5] "Expected engine update position at start of transmitting ignition and injection parameter to IO-SW." UWORD _CNV_A_R_LINEAR_____200_CM 1 100. 0. 720. DISPLAY_IDENTIFIER CRK_PSN_ENG_IGN_INJ_UPD[5] ECU_ADDRESS 0xd000318e FORMAT "%7.3" /end MEASUREMENT
/begin MEASUREMENT crk_psn_eng_ign_inj_upd[6] "Expected engine update position at start of transmitting ignition and injection parameter to IO-SW." UWORD _CNV_A_R_LINEAR_____200_CM 1 100. 0. 720. DISPLAY_IDENTIFIER CRK_PSN_ENG_IGN_INJ_UPD[6] ECU_ADDRESS 0xd0003190 FORMAT "%7.3" /end MEASUREMENT
/begin MEASUREMENT crk_psn_eng_ign_inj_upd[7] "Expected engine update position at start of transmitting ignition and injection parameter to IO-SW." UWORD _CNV_A_R_LINEAR_____200_CM 1 100. 0. 720. DISPLAY_IDENTIFIER CRK_PSN_ENG_IGN_INJ_UPD[7] ECU_ADDRESS 0xd0003192 FORMAT "%7.3" /end MEASUREMENT
/begin MEASUREMENT td_igc[0] "dwell time duration" UWORD _CNV_A_R_LINEAR_____456_CM 1 100. 0. 262.14 DISPLAY_IDENTIFIER TD_IGC[0] ECU_ADDRESS 0xd000656c FORMAT "%7.3" /end MEASUREMENT
/begin MEASUREMENT td_igc[1] "dwell time duration" UWORD _CNV_A_R_LINEAR_____456_CM 1 100. 0. 262.14 DISPLAY_IDENTIFIER TD_IGC[1] ECU_ADDRESS 0xd000656e FORMAT "%7.3" /end MEASUREMENT
/begin MEASUREMENT td_igc[2] "dwell time duration" UWORD _CNV_A_R_LINEAR_____456_CM 1 100. 0. 262.14 DISPLAY_IDENTIFIER TD_IGC[2] ECU_ADDRESS 0xd0006570 FORMAT "%7.3" /end MEASUREMENT
/begin MEASUREMENT td_igc[3] "dwell time duration" UWORD _CNV_A_R_LINEAR_____456_CM 1 100. 0. 262.14 DISPLAY_IDENTIFIER TD_IGC[3] ECU_ADDRESS 0xd0006572 FORMAT "%7.3" /end MEASUREMENT
/begin MEASUREMENT td_igc[4] "dwell time duration" UWORD _CNV_A_R_LINEAR_____456_CM 1 100. 0. 262.14 DISPLAY_IDENTIFIER TD_IGC[4] ECU_ADDRESS 0xd0006574 FORMAT "%7.3" /end MEASUREMENT
/begin MEASUREMENT td_igc[5] "dwell time duration" UWORD _CNV_A_R_LINEAR_____456_CM 1 100. 0. 262.14 DISPLAY_IDENTIFIER TD_IGC[5] ECU_ADDRESS 0xd0006576 FORMAT "%7.3" /end MEASUREMENT
/begin MEASUREMENT td_igc[6] "dwell time duration" UWORD _CNV_A_R_LINEAR_____456_CM 1 100. 0. 262.14 DISPLAY_IDENTIFIER TD_IGC[6] ECU_ADDRESS 0xd0006578 FORMAT "%7.3" /end MEASUREMENT
/begin MEASUREMENT td_igc[7] "dwell time duration" UWORD _CNV_A_R_LINEAR_____456_CM 1 100. 0. 262.14 DISPLAY_IDENTIFIER TD_IGC[7] ECU_ADDRESS 0xd000657a FORMAT "%7.3" /end MEASUREMENT
/begin MEASUREMENT iga_igc_h_rng[0] "Ignition angle (high range) of cylinder x" SWORD _CNV_A_R_LINEAR_____188_CM 1 100. -90. 90. DISPLAY_IDENTIFIER IGA_IGC_H_RNG[0] ECU_ADDRESS 0xd0006510 FORMAT "%8.4" /end MEASUREMENT
/begin MEASUREMENT iga_igc_h_rng[1] "Ignition angle (high range) of cylinder x" SWORD _CNV_A_R_LINEAR_____188_CM 1 100. -90. 90. DISPLAY_IDENTIFIER IGA_IGC_H_RNG[1] ECU_ADDRESS 0xd0006512 FORMAT "%8.4" /end MEASUREMENT
/begin MEASUREMENT iga_igc_h_rng[2] "Ignition angle (high range) of cylinder x" SWORD _CNV_A_R_LINEAR_____188_CM 1 100. -90. 90. DISPLAY_IDENTIFIER IGA_IGC_H_RNG[2] ECU_ADDRESS 0xd0006514 FORMAT "%8.4" /end MEASUREMENT
/begin MEASUREMENT iga_igc_h_rng[3] "Ignition angle (high range) of cylinder x" SWORD _CNV_A_R_LINEAR_____188_CM 1 100. -90. 90. DISPLAY_IDENTIFIER IGA_IGC_H_RNG[3] ECU_ADDRESS 0xd0006516 FORMAT "%8.4" /end MEASUREMENT
/begin MEASUREMENT iga_igc_h_rng[4] "Ignition angle (high range) of cylinder x" SWORD _CNV_A_R_LINEAR_____188_CM 1 100. -90. 90. DISPLAY_IDENTIFIER IGA_IGC_H_RNG[4] ECU_ADDRESS 0xd0006518 FORMAT "%8.4" /end MEASUREMENT
/begin MEASUREMENT iga_igc_h_rng[5] "Ignition angle (high range) of cylinder x" SWORD _CNV_A_R_LINEAR_____188_CM 1 100. -90. 90. DISPLAY_IDENTIFIER IGA_IGC_H_RNG[5] ECU_ADDRESS 0xd000651a FORMAT "%8.4" /end MEASUREMENT
/begin MEASUREMENT iga_igc_h_rng[6] "Ignition angle (high range) of cylinder x" SWORD _CNV_A_R_LINEAR_____188_CM 1 100. -90. 90. DISPLAY_IDENTIFIER IGA_IGC_H_RNG[6] ECU_ADDRESS 0xd000651c FORMAT "%8.4" /end MEASUREMENT
/begin MEASUREMENT iga_igc_h_rng[7] "Ignition angle (high range) of cylinder x" SWORD _CNV_A_R_LINEAR_____188_CM 1 100. -90. 90. DISPLAY_IDENTIFIER IGA_IGC_H_RNG[7] ECU_ADDRESS 0xd000651e FORMAT "%8.4" /end MEASUREMENT
/begin COMPU_METHOD _CNV_A_R_LINEAR_____0_CM "" RAT_FUNC "%6.3" "-" COEFFS 0 1. 0. 0 0 1 /end COMPU_METHOD
/begin COMPU_METHOD _CNV_S_2_RANGE__0___1_CM "" TAB_VERB "%6.3" "-" COMPU_TAB_REF _CNV_S_2_RANGE__0___1 /end COMPU_METHOD
/begin COMPU_VTAB _CNV_S_2_RANGE__0___1 "" TAB_VERB 2 0 "0" 1 "1" /end COMPU_VTAB
/begin COMPU_METHOD _CNV_A_R_LINEAR_____2_CM "" RAT_FUNC "%6.3" "V" COEFFS 0 204.8 0. 0 0 1 /end COMPU_METHOD
/begin COMPU_METHOD _CNV_A_R_LINEAR_____3_CM "" RAT_FUNC "%6.3" "s" COEFFS 0 100. 0. 0 0 1 /end COMPU_METHOD
/begin COMPU_METHOD _CNV_A_R_LINEAR_____4_CM "" RAT_FUNC "%6.3" "s" COEFFS 0 10. 0. 0 0 1 /end COMPU_METHOD
/begin COMPU_METHOD _CNV_A_R_LINEAR_____5_CM "" RAT_FUNC "%6.3" "%" COEFFS 0 2.56 0. 0 0 1 /end COMPU_METHOD
/begin COMPU_METHOD _CNV_A_R_LINEAR_____6_CM "" RAT_FUNC "%6.3" "km/h" COEFFS 0 1. 0. 0 0 1 /end COMPU_METHOD
/begin COMPU_METHOD _CNV_A_R_LINEAR_____8_CM "" RAT_FUNC "%6.3" "%" COEFFS 0 655.3599999999997 0. 0 0 1 /end COMPU_METHOD
/begin COMPU_METHOD _CNV_A_R_LINEAR_____9_CM "" RAT_FUNC "%6.3" "-" COEFFS 0 32767.99999999992 0. 0 0 1 /end COMPU_METHOD
/begin COMPU_METHOD _CNV_A_R_LINEAR_____10_CM "" RAT_FUNC "%6.3" "rpm" COEFFS 0 3.125e-002 0. 0 0 1 /end COMPU_METHOD
/begin COMPU_METHOD _CNV_A_R_LINEAR_____14_CM "" RAT_FUNC "%6.3" "rpm" COEFFS 0 1. 0. 0 0 1 /end COMPU_METHOD
/begin COMPU_METHOD _CNV_A_R_LINEAR_____17_CM "" RAT_FUNC "%6.3" "°C" COEFFS 0 1.333333333333333 64. 0 0 1 /end COMPU_METHOD
/begin COMPU_METHOD _CNV_A_R_LINEAR_____22_CM "" RAT_FUNC "%6.3" "V" COEFFS 0 9.846168103048838 0. 0 0 1 /end COMPU_METHOD
/begin COMPU_METHOD _CNV_A_R_LINEAR_____28_CM "" RAT_FUNC "%6.3" "-" COEFFS 0 256. 0. 0 0 1 /end COMPU_METHOD
/begin COMPU_METHOD _CNV_A_R_LINEAR_____31_CM "" RAT_FUNC "%6.3" "Nm" COEFFS 0 32. 0. 0 0 1 /end COMPU_METHOD
/begin COMPU_METHOD _CNV_A_R_LINEAR_____58_CM "" RAT_FUNC "%6.3" "km" COEFFS 0 0.1 0. 0 0 1 /end COMPU_METHOD
/begin COMPU_METHOD _CNV_A_R_LINEAR_____84_CM "" RAT_FUNC "%6.3" "min" COEFFS 0 1. 0. 0 0 1 /end COMPU_METHOD
/begin COMPU_METHOD _CNV_A_R_LINEAR_____89_CM "" RAT_FUNC "%6.3" "-" COEFFS 0 65535.99999999996 0. 0 0 1 /end COMPU_METHOD
/begin COMPU_METHOD _CNV_A_R_LINEAR_____103_CM "" RAT_FUNC "%6.3" "-" COEFFS 0 128. 0. 0 0 1 /end COMPU_METHOD
/begin COMPU_METHOD _CNV_A_R_LINEAR_____111_CM "" RAT_FUNC "%6.3" "mg/stk" COEFFS 0 47.18142548596112 0. 0 0 1 /end COMPU_METHOD
/begin COMPU_METHOD _CNV_A_R_LINEAR_____129_CM "" RAT_FUNC "%6.3" "-" COEFFS 0 1024. 0. 0 0 1 /end COMPU_METHOD
/begin COMPU_METHOD _CNV_A_R_LINEAR_____171_CM "" RAT_FUNC "%6.3" "hPa" COEFFS 0 0.1884402603974972 0. 0 0 1 /end COMPU_METHOD
/begin COMPU_METHOD _CNV_A_R_LINEAR_____185_CM "" RAT_FUNC "%6.3" "" COEFFS 0 256. 0. 0 0 1 /end COMPU_METHOD
/begin COMPU_METHOD _CNV_A_R_LINEAR_____188_CM "" RAT_FUNC "%6.3" "°CRK" COEFFS 0 16. 0. 0 0 1 /end COMPU_METHOD
/begin COMPU_METHOD _CNV_A_R_LINEAR_____200_CM "" RAT_FUNC "%6.3" "°CRK" COEFFS 0 2.666666666666667 0. 0 0 1 /end COMPU_METHOD
/begin COMPU_METHOD _CNV_A_R_LINEAR_____209_CM "" RAT_FUNC "%6.3" "°C" COEFFS 0 64. 0. 0 0 1 /end COMPU_METHOD
/begin COMPU_METHOD _CNV_A_R_LINEAR_____212_CM "" RAT_FUNC "%6.3" "%" COEFFS 0 327.68 0. 0 0 1 /end COMPU_METHOD
/begin COMPU_METHOD _CNV_A_R_LINEAR_____224_CM "" RAT_FUNC "%6.3" "V" COEFFS 0 204.8048048048048 0. 0 0 1 /end COMPU_METHOD
/begin COMPU_METHOD _CNV_A_R_LINEAR_____226_CM "" RAT_FUNC "%6.3" "%" COEFFS 0 10. 0. 0 0 1 /end COMPU_METHOD
/begin COMPU_METHOD _CNV_A_R_LINEAR_____228_CM "" RAT_FUNC "%6.3" "ms" COEFFS 0 1000. 0. 0 0 1 /end COMPU_METHOD
/begin COMPU_METHOD _CNV_A_R_LINEAR_____229_CM "" RAT_FUNC "%6.3" "" COEFFS 0 65535. 0. 0 0 1 /end COMPU_METHOD
/begin COMPU_METHOD _CNV_A_R_LINEAR_____241_CM "" RAT_FUNC "%6.3" "-" COEFFS 0 2048. 0. 0 0 1 /end COMPU_METHOD
/begin COMPU_METHOD _CNV_A_R_LINEAR_____263_CM "" RAT_FUNC "%6.3" "%" COEFFS 0 327.680000003584 32768.00000035841 0 0 1 /end COMPU_METHOD
/begin COMPU_METHOD _CNV_A_R_LINEAR_____272_CM "Battery voltage" RAT_FUNC "%6.3" "V" COEFFS 0 9.846153846153847 0. 0 0 1 /end COMPU_METHOD
/begin COMPU_METHOD _CNV_A_R_EVAC_LINEA_298_CM "" RAT_FUNC "%6.3" "-" COEFFS 0 16. 0. 0 0 1 /end COMPU_METHOD
/begin COMPU_METHOD _CNV_A_R_MISF_LINEA_417_CM "" RAT_FUNC "%6.3" "-" COEFFS 0 10. 0. 0 0 1 /end COMPU_METHOD
/begin COMPU_METHOD _CNV_A_R_ACRC_LINEA_431_CM "" RAT_FUNC "%6.3" "%" COEFFS 0 40.96 0. 0 0 1 /end COMPU_METHOD
/begin COMPU_METHOD _CNV_A_R_LINEAR_____456_CM "" RAT_FUNC "%6.3" "ms" COEFFS 0 250. 0. 0 0 1 /end COMPU_METHOD
/begin COMPU_METHOD _CNV_A_R_LINEAR_____523_CM "" RAT_FUNC "%6.3" "K" COEFFS 0 32. 0. 0 0 1 /end COMPU_METHOD
/begin COMPU_METHOD _CNV_A_R_LINEAR_____544_CM "" RAT_FUNC "%6.3" "°CRK" COEFFS 0 -2.666666666666667 -106.6666666666667 0 0 1 /end COMPU_METHOD
/begin COMPU_METHOD _CNV_A_R_LINEAR_____545_CM "" RAT_FUNC "%6.3" "°CRK" COEFFS 0 2.666666666666667 -160. 0 0 1 /end COMPU_METHOD
/begin COMPU_METHOD _CNV_A_R_LINEAR_____780_CM "" RAT_FUNC "%6.3" "°C" COEFFS 0 64. 2112. 0 0 1 /end COMPU_METHOD
/begin COMPU_METHOD _CNV_A_R_LINEAR_____781_CM "" RAT_FUNC "%6.3" "K" COEFFS 0 32. 32768. 0 0 1 /end COMPU_METHOD
/begin COMPU_METHOD _CNV_S_5_EXTC_RANGE_782_CM "" TAB_VERB "%6.3" "-" COMPU_TAB_REF _CNV_S_5_EXTC_RANGE_782 /end COMPU_METHOD
/begin COMPU_VTAB _CNV_S_5_EXTC_RANGE_782 "" TAB_VERB 5 0 "CH_MOD_OFF" 1 "CH_MOD_HOM" 2 "CH_MOD_MPLH" 3 "CH_MOD_MPLP" 4 "CH_MOD_HOMS" /end COMPU_VTAB
/begin COMPU_METHOD _CNV_S_5_EXTC_RANGE_783_CM "" TAB_VERB "%6.3" "" COMPU_TAB_REF _CNV_S_5_EXTC_RANGE_783 /end COMPU_METHOD
/begin COMPU_VTAB _CNV_S_5_EXTC_RANGE_783 "" TAB_VERB 5 0 "CH_MOD_OFF" 1 "CH_MOD_HOM" 2 "CH_MOD_MPLH" 3 "CH_MOD_MPLP" 4 "CH_MOD_HOMS" /end COMPU_VTAB
/begin COMPU_METHOD _CNV_A_R_LINEAR_____784_CM "" RAT_FUNC "%6.3" "%" COEFFS 0 10.23017902813299 0. 0 0 1 /end COMPU_METHOD
/begin COMPU_METHOD _CNV_S_4_STATE_CH_785_CM "" TAB_VERB "%6.3" "" COMPU_TAB_REF _CNV_S_4_STATE_CH_785 /end COMPU_METHOD
/begin COMPU_VTAB _CNV_S_4_STATE_CH_785 "" TAB_VERB 4 0 "CH_OFF" 1 "CH_AST" 2 "CH_LOW_LOAD" 3 "CH_SO2P" /end COMPU_VTAB
/begin COMPU_METHOD _CNV_A_R_LINEAR_____786_CM "" RAT_FUNC "%6.3" "°CRK" COEFFS 0 42.66666666666666 0. 0 0 1 /end COMPU_METHOD
/begin COMPU_METHOD _CNV_S_3_EXTC_RANGE_796_CM "" TAB_VERB "%6.3" "" COMPU_TAB_REF _CNV_S_3_EXTC_RANGE_796 /end COMPU_METHOD
/begin COMPU_VTAB _CNV_S_3_EXTC_RANGE_796 "" TAB_VERB 3 0 "CH_MOD_OFF" 1 "CH_MOD_HOM" 2 "CH_MOD_MPLH" /end COMPU_VTAB
/begin COMPU_METHOD _CNV_A_R_ACRC_LINEA_802_CM "" RAT_FUNC "%6.3" "-" COEFFS 0 8191.999927998902 -2.880043903132901e-004 0 0 1 /end COMPU_METHOD
/begin COMPU_METHOD _CNV_A_R_ACRC_LINEA_804_CM "" RAT_FUNC "%6.3" "Hz" COEFFS 0 10. 0. 0 0 1 /end COMPU_METHOD
/begin COMPU_METHOD _CNV_S_3_ACRC_RANGE_805_CM "" TAB_VERB "%6.3" "" COMPU_TAB_REF _CNV_S_3_ACRC_RANGE_805 /end COMPU_METHOD
/begin COMPU_VTAB _CNV_S_3_ACRC_RANGE_805 "" TAB_VERB 3 0 "PWM_OFF" 1 "PWM_STAT" 2 "PWM_CTL" /end COMPU_VTAB
/begin COMPU_METHOD _CNV_A_R_ACRC_LINEA_806_CM "" RAT_FUNC "%6.3" "V" COEFFS 0 409.801605573462 0. 0 0 1 /end COMPU_METHOD
/begin COMPU_METHOD _CNV_S_3_ACRC_RANGE_807_CM "" TAB_VERB "%6.3" "-" COMPU_TAB_REF _CNV_S_3_ACRC_RANGE_807 /end COMPU_METHOD
/begin COMPU_VTAB _CNV_S_3_ACRC_RANGE_807 "" TAB_VERB 3 0 "PWM_OFF" 1 "PWM_STAT" 2 "PWM_CTL" /end COMPU_VTAB
/begin COMPU_METHOD _CNV_A_R_ACRC_LINEA_808_CM "" RAT_FUNC "%6.3" "%/V" COEFFS 0 655.3598303974559 0. 0 0 1 /end COMPU_METHOD
/begin COMPU_METHOD _CNV_S_5_ACRC_RANGE_809_CM "" TAB_VERB "%6.3" "" COMPU_TAB_REF _CNV_S_5_ACRC_RANGE_809 /end COMPU_METHOD
/begin COMPU_VTAB _CNV_S_5_ACRC_RANGE_809 "" TAB_VERB 5 0 "ACR_AD_INIT" 1 "ACR_AD_BOL" 2 "ACR_GO_TOL" 3 "ACR_AD_TOL" 4 "ACR_AD_END" /end COMPU_VTAB
/begin RECORD_LAYOUT _REC_VAL_20_u1 FNC_VALUES 1 UBYTE COLUMN_DIR DIRECT /end RECORD_LAYOUT
/begin RECORD_LAYOUT _REC_VAL_20_u2 FNC_VALUES 1 UWORD COLUMN_DIR DIRECT /end RECORD_LAYOUT
/begin RECORD_LAYOUT _REC_AXS_20_u1 NO_AXIS_PTS_X 1 UBYTE AXIS_PTS_X 2 UBYTE INDEX_INCR DIRECT /end RECORD_LAYOUT
/begin RECORD_LAYOUT _REC_MAP_20_u2_u1_u1 FNC_VALUES 1 UWORD COLUMN_DIR DIRECT /end RECORD_LAYOUT
/begin RECORD_LAYOUT _REC_CUR_20_u1_u1 FNC_VALUES 1 UBYTE COLUMN_DIR DIRECT /end RECORD_LAYOUT
/begin RECORD_LAYOUT _REC_VAL_20_s2 FNC_VALUES 1 SWORD COLUMN_DIR DIRECT /end RECORD_LAYOUT
/begin RECORD_LAYOUT _REC_MAP_20_u2_u2_u1 FNC_VALUES 1 UWORD COLUMN_DIR DIRECT /end RECORD_LAYOUT
/begin RECORD_LAYOUT _REC_AXS_20_u2 NO_AXIS_PTS_X 1 UWORD AXIS_PTS_X 2 UWORD INDEX_INCR DIRECT /end RECORD_LAYOUT
/begin RECORD_LAYOUT _REC_CUR_20_u2_u1 FNC_VALUES 1 UWORD COLUMN_DIR DIRECT /end RECORD_LAYOUT
/begin RECORD_LAYOUT _REC_CUR_20_u2_u2 FNC_VALUES 1 UWORD COLUMN_DIR DIRECT /end RECORD_LAYOUT
/begin RECORD_LAYOUT _REC_VAL_20_s1 FNC_VALUES 1 SBYTE COLUMN_DIR DIRECT /end RECORD_LAYOUT
/begin RECORD_LAYOUT _REC_MAP_20_u2_u2_u2 FNC_VALUES 1 UWORD COLUMN_DIR DIRECT /end RECORD_LAYOUT
/begin RECORD_LAYOUT _REC_MAP_20_u2_u1_u2 FNC_VALUES 1 UWORD COLUMN_DIR DIRECT /end RECORD_LAYOUT
/begin RECORD_LAYOUT _REC_MAP_20_u1_u2_u2 FNC_VALUES 1 UBYTE COLUMN_DIR DIRECT /end RECORD_LAYOUT
/begin RECORD_LAYOUT _REC_MAP_20_u1_u1_u1 FNC_VALUES 1 UBYTE COLUMN_DIR DIRECT /end RECORD_LAYOUT
/begin RECORD_LAYOUT _REC_MAP_20_u1_u2_u1 FNC_VALUES 1 UBYTE COLUMN_DIR DIRECT /end RECORD_LAYOUT
/begin RECORD_LAYOUT _REC_MAP_20_u1_u1_u2 FNC_VALUES 1 UBYTE COLUMN_DIR DIRECT /end RECORD_LAYOUT
/begin FUNCTION EXTC_mff_sp_post_inj_hom_cat_heading ""
 /begin DEF_CHARACTERISTIC c_fup_cor_post_inj ldp_n_32_ip_fac_mff_mplp_ch_ast ip_fac_mff_mplp_ch_ast ldp_tco_ip_fac_mff_mplp_ch_ast ldp_cyc_cast_ip_fac_mff_mplp_ch c_maf_fac_post_inj lc_iv_post_egy_rng ip_fac_cor_post_inj ip_fac_mff_mplp_ch_ast_n_32 ip_fac_mff_mplp_ch_l ldp_lamb_cmb_s_ip_mplp_ch_ast ldp_lamb_cmb_s_ip_mff_mplp_ch_l ip_mff_mplp_ch_ast ip_mff_mplp_ch_l lc_mff_mplp_ch_man_act c_mff_mplp_ch_man /end DEF_CHARACTERISTIC
 /begin OUT_MEASUREMENT mff_mplp_ch lamb_cmb_s ti_post_inj[0] ti_post_inj[1] ti_post_inj[2] ti_post_inj[3] ti_post_inj[4] ti_post_inj[5] ti_post_inj[6] ti_post_inj[7] mff_post_inj[0] mff_post_inj[1] mff_post_inj[2] mff_post_inj[3] mff_post_inj[4] mff_post_inj[5] mff_post_inj[6] mff_post_inj[7] lv_post_inj_act lv_iv_post_egy_rng /end OUT_MEASUREMENT
/end FUNCTION
/begin FUNCTION EXTC_inj_phase_post_inj_cat_heading ""
 /begin DEF_CHARACTERISTIC lc_soi_post_inj_man_act c_eoi_lim_post c_soi_lim_post c_soi_post_inj_man c_soi_mplp_man lc_soi_mplp_man_act ip_soi_mplp_add_mff_post_ch_l ip_soi_mplp_dif_ch_ast ip_soi_mplp_dif_ch_l /end DEF_CHARACTERISTIC
 /begin OUT_MEASUREMENT eoi_lim_post soi_lim_post soi_post_inj[0] soi_post_inj[1] soi_post_inj[2] soi_post_inj[3] soi_post_inj[4] soi_post_inj[5] soi_post_inj[6] soi_post_inj[7] eoi_post_inj[0] eoi_post_inj[1] eoi_post_inj[2] eoi_post_inj[3] eoi_post_inj[4] eoi_post_inj[5] eoi_post_inj[6] eoi_post_inj[7] soi_mplp_dif_ch /end OUT_MEASUREMENT
/end FUNCTION
/begin FUNCTION C_8_EXTC "C_8_EXTC"
 /begin DEF_CHARACTERISTIC ldpm_temp_cat_dif_ch_l_1_extc ldpm_temp_cat_dif_ch_l_2_extc ldpm_tnt_dif_ch_l_1_extc ldpm_tnt_dif_ch_l_2_extc /end DEF_CHARACTERISTIC
 /begin SUB_FUNCTION EXTC_Idle_Speed_SP_Cat_Heat /end SUB_FUNCTION
/end FUNCTION
/begin FUNCTION EXTC_Idle_Speed_SP_Cat_Heat "_Idle_Speed_SP_Cat_Heat"
 /begin DEF_CHARACTERISTIC ldpm_t_ast_5_extc ip_n_sp_is_ch_ast_mplh ip_n_sp_is_ch_ast_mplp ip_n_sp_is_ch_ast_hom ip_n_sp_is_ch_l_hom ip_n_sp_is_ch_l_s ip_n_sp_is_ch_ast_hom_dri ip_n_sp_is_ch_ast_mplh_dri ip_n_sp_is_ch_ast_mplp_dri lc_dri_act_mt /end DEF_CHARACTERISTIC
 /begin OUT_MEASUREMENT n_sp_is_ch lv_n_sp_is_ch_dri /end OUT_MEASUREMENT
/end FUNCTION
/begin FUNCTION C_9_EXTC "C_9_EXTC"
 /begin DEF_CHARACTERISTIC ldpm_n_1_extc ldpm_t_ast_1_extc ldpm_n_2_extc ldpm_n_4_extc ldpm_n_3_extc /end DEF_CHARACTERISTIC
 /begin SUB_FUNCTION EXTC_Camshaft_SP_Cat_Heat EXTC_Fuel_pressure_for_catalyst_heading /end SUB_FUNCTION
/end FUNCTION
/begin FUNCTION EXTC_Camshaft_SP_Cat_Heat "_Camshaft_SP_Cat_Heat"
 /begin DEF_CHARACTERISTIC id_state_opm_ivvt_ch_hom_so2p ldp_n_id_opm_ivvt_ch_l ldp_fac_maf_egr_cor_id_opm_ch_l ldp_n_id_opm_ivvt_ch_mplh_so2p ldp_fac_maf_egr_id_ch_hom_so2p id_state_opm_ivvt_ch_l id_state_opm_ivvt_ch_mplh_so2p ldp_n_id_opm_ivvt_ch_hom_so2p ldp_fac_maf_egr_id_ch_mplh_so2p ip_cam_ch_cold_ex ip_cam_ch_cold_ex_is ip_cam_ch_cold_in ip_cam_ch_cold_in_is ip_cam_ch_hom_hot_ex ip_cam_ch_hom_hot_ex_is ip_cam_ch_hom_hot_in ip_cam_ch_hom_hot_in_is ip_cam_ch_mplh_hot_ex ip_cam_ch_mplh_hot_ex_is ip_cam_ch_mplh_hot_in ip_cam_ch_mplh_hot_in_is ip_fac_eff_iga_ch_sp ip_fac_eff_iga_ch_sp_mplh /end DEF_CHARACTERISTIC
 /begin OUT_MEASUREMENT cam_sp_ch_in cam_sp_ch_ex state_opm_ivvt_ch fac_eff_iga_ch_sp /end OUT_MEASUREMENT
/end FUNCTION
/begin FUNCTION EXTC_Fuel_pressure_for_catalyst_heading ""
 /begin DEF_CHARACTERISTIC c_fup_sp_ch_pas ldp_tco_st_ip_fac_fup_sp_ch ldp_t_ast_ip_fac_fup_sp_ch ldp_n_32_ip_fup_sp_ch ldp_tqi_req_tra_ip_fup_sp_ch /end DEF_CHARACTERISTIC
 /begin OUT_MEASUREMENT fup_sp_ch /end OUT_MEASUREMENT
/end FUNCTION
/begin FUNCTION C_5_EXTC ""
 /begin SUB_FUNCTION EXTC_Catalyst_heading_coordination EXTC_Catalyst_heating_after_start_strategy EXTC_Catalyst_heating_strategy EXTC_Cat_heating_low_load_stgy EXTC_Catalyst_heading_desulfation_strategy /end SUB_FUNCTION
/end FUNCTION
/begin FUNCTION EXTC_Catalyst_heading_coordination ""
 /begin DEF_CHARACTERISTIC ldpm_ctr_km_can_1_extc ldp_tco_st_ip_t_es_thd_ch_ast ldp_tco_st_ip_t_ast_thd_ch_ast ip_t_es_thd_ch_ast ip_t_ast_thd_ch_ast c_n_32_thd_ch_l_off c_n_32_thd_ch_l_on c_state_ch_man c_temp_cat_thd_ch_l_off c_temp_cat_thd_ch_l_hom_on c_temp_cat_thd_ch_l_s_on c_tnt_thd_ch_l_off c_tnt_thd_ch_l_hom_on c_tnt_thd_ch_l_s_on c_tqi_req_fast_thd_ch_l_off c_tqi_req_fast_thd_ch_l_on lc_state_ch_man_act c_fac_tqi_fil_ch_so2p c_fac_vs_fil_ch_so2p c_temp_cat_thd_ch_so2p c_tnt_max_ch_so2p c_tnt_min_ch_so2p c_tqi_thd_ch_so2p c_temp_cat_max_ch_ast c_tnt_max_ch_ast c_vs_thd_ch_so2p c_vs_max_ch_ast /end DEF_CHARACTERISTIC
 /begin OUT_MEASUREMENT lv_ch_ast_cdn state_ch tnt_dif_ch_l temp_cat_dif_ch_l tqi_req_fast_fil_ch_so2p vs_fil_ch_so2p lv_ch_so2p_cdn lv_ch_l_cdn /end OUT_MEASUREMENT
/end FUNCTION
/begin FUNCTION EXTC_Catalyst_heating_after_start_strategy ""
 /begin DEF_CHARACTERISTIC c_n_max_mplh_ch_ast c_n_min_mplh_ch_ast c_tqi_min_mplp_ch_ast c_n_min_mplp_ch_ast c_n_max_mplp_ch_ast c_tqi_max_mplp_ch_ast ldp_t_ast_id_ch_mod_bas ldp_tco_st_id_ch_mod_bas id_ch_mod_bas c_vs_max_mplp_ch_ast c_ch_mod_man lc_ch_mod_man_act c_t_min_pv_thd_mplh_ch_deac ldp_tco_st_ip_pv_thd_mplh_ch ip_pv_thd_mplh_ch_ast c_state_ch_mod_so2p_man lc_state_ch_mod_so2p_man_act /end DEF_CHARACTERISTIC
 /begin OUT_MEASUREMENT state_ch_mod_ast state_ch_mod_req_ast lv_ch_ast_mplp_cdn lv_ch_ast_mplh_cdn /end OUT_MEASUREMENT
/end FUNCTION
/begin FUNCTION EXTC_Catalyst_heating_strategy "" /begin DEF_CHARACTERISTIC c_nr_pri_ch_mod c_nr_pri_ch_mod_req /end DEF_CHARACTERISTIC
 /begin OUT_MEASUREMENT state_ch_mod state_ch_mod_req nr_pri_ch_mod nr_pri_ch_mod_req /end OUT_MEASUREMENT
/end FUNCTION
/begin FUNCTION EXTC_Cat_heating_low_load_stgy "Cat_heating_low_load_stgy"
 /begin DEF_CHARACTERISTIC c_nr_pri_ch_mod_req_l_act c_nr_pri_ch_mod_req_l_pas c_temp_cat_min_swi_hom_ch_l c_temp_cat_min_swi_homs_ch_l c_tnt_min_swi_hom_ch_l c_tnt_min_swi_homs_ch_l c_temp_hys_swi_homs_ch_l c_temp_hys_swi_hom_ch_l /end DEF_CHARACTERISTIC
 /begin OUT_MEASUREMENT state_ch_mod_l state_ch_mod_req_l nr_pri_ch_mod_req_l /end OUT_MEASUREMENT
/end FUNCTION
/begin FUNCTION EXTC_Catalyst_heading_desulfation_strategy ""
 /begin DEF_CHARACTERISTIC c_tnt_sp_ch_so2p ldp_n_32_id_ch_mod_req_so2p ldp_maf_id_ch_mod_req_so2p id_state_ch_mod_req_so2p /end DEF_CHARACTERISTIC
 /begin OUT_MEASUREMENT tnt_dif_ch_so2p state_ch_mod_so2p state_ch_mod_req_so2p /end OUT_MEASUREMENT
/end FUNCTION
/begin FUNCTION C_C_EXTC "" /begin SUB_FUNCTION EXTC_Maf_cor_cat_ht_strat_mode /end SUB_FUNCTION /end FUNCTION
/begin FUNCTION EXTC_Maf_cor_cat_ht_strat_mode "Maf_cor_cat_ht_strat_mode"
 /begin DEF_CHARACTERISTIC ip_maf_dif_add_mff_post_ch_l ip_maf_dif_s_ch_l_bas c_maf_dif_s_ch_man lc_maf_dif_s_ch_man_act /end DEF_CHARACTERISTIC
 /begin OUT_MEASUREMENT maf_dif_s_ch /end OUT_MEASUREMENT
/end FUNCTION
/begin FUNCTION AGGR_EXTC_adaptation ""
 /begin DEF_CHARACTERISTIC ldpm_state_ch_mod_req ldpm_state_opm_ivvt_ch id_state_ch_mod_req_ivvt id_state_ch_mod_req_ivvt_so2p id_state_ch_mod_ivvt_so2p id_state_ch_mod_ivvt /end DEF_CHARACTERISTIC
 /begin OUT_MEASUREMENT state_ch_mod_ivvt state_ch_mod_ivvt_req /end OUT_MEASUREMENT
/end FUNCTION
/begin FUNCTION C_9_ACRC ""
 /begin SUB_FUNCTION ACRC_setpoint_selction ACRC_setpoint_selection_appl_inc ACRC_pos_controller ACRC_pos_controller_appl_inc /end SUB_FUNCTION
/end FUNCTION
/begin FUNCTION ACRC_setpoint_selction "" /end FUNCTION
/begin FUNCTION ACRC_setpoint_selection_appl_inc ""
 /begin DEF_CHARACTERISTIC c_opg_sp_max_acr c_opg_sp_min_acr c_ctr_dly_acr_ctl c_ctr_opg_sp_pop_acr c_opg_sp_ext_acr c_opg_sp_lih_acr c_opg_sp_min_acr_ctl c_opg_sp_pop_acr lc_opg_sp_ext_acr lc_pwm_acr_off_ena /end DEF_CHARACTERISTIC
 /begin OUT_MEASUREMENT opg_sp_acr opg_sp_sel_acr lv_opg_sp_lih_acr opg_sp_lih_acr lv_opg_sp_ext_acr opg_sp_ext_acr lv_opg_sp_pop_acr opg_sp_pop_acr state_acr_ctl_req /end OUT_MEASUREMENT
/end FUNCTION
/begin FUNCTION ACRC_pos_controller ""
 /begin DEF_CHARACTERISTIC c_fac_c_1_acr_ctl c_fac_c_2_acr_ctl c_fac_c_3_acr_ctl c_fac_f_1_acr_ctl c_fac_f_2_acr_ctl c_fac_f_3_acr_ctl c_frq_pwm_acr c_kp_acr_ctl c_pwm_acr_close c_pwm_max_acr_ctl c_pwm_min_acr_ctl c_rate_opg_sp_acr ldp_vb_mmv_ip_fac_vb_pwm_acr ip_fac_vb_pwm_acr ldp_opg_sp_acr_ip_pwm_acr_stat ip_pwm_acr_stat /end DEF_CHARACTERISTIC
 /begin OUT_MEASUREMENT pwm_acr opg_dif_acr fac_vb_pwm_acr opg_sp_ctl_acr /end OUT_MEASUREMENT
/end FUNCTION
/begin FUNCTION ACRC_pos_controller_appl_inc "" /begin OUT_MEASUREMENT state_acr_ctl /end OUT_MEASUREMENT /end FUNCTION
/begin FUNCTION C_4_ACRC "" /begin SUB_FUNCTION ACRC_position_determination /end SUB_FUNCTION /end FUNCTION
/begin FUNCTION ACRC_position_determination "" /begin OUT_MEASUREMENT opg_acr v_acr v_acr_mv v_acr_bas /end OUT_MEASUREMENT /end FUNCTION
/begin FUNCTION C_A_ACRC ""
 /begin SUB_FUNCTION ACRC_adaption_and_diagnosis ACRC_adaption_and_diagnosis_appl_inc ACRC_actuator_diagnosis ACRC_actuator_diagnosis_AI ACRC_limp_home_management ACRC_position_sensor_diagnosis ACRC_position_sensor_diagnosis_AI ACRC_power_stage_diagnosis ACRC_power_stage_diagnosis_AI /end SUB_FUNCTION
/end FUNCTION
/begin FUNCTION ACRC_adaption_and_diagnosis ""
 /begin DEF_CHARACTERISTIC c_crlc_acr_ad c_ctr_dly_acr_ad_max c_ctr_inh_acr_ad_max c_fac_acr_slop c_v_acr_ad_bol_ini c_v_acr_ad_bol_max c_v_acr_ad_bol_min c_ctr_acr_ad c_ctr_dly_acr_ad c_opg_sp_ad_lgrd c_opg_sp_max_ad_acr c_v_acr_ad_chk_ctl c_v_acr_ad_tol_ini c_v_acr_ad_tol_max lc_fac_acr_slop_ad_ena c_v_acr_ad_tol_min /end DEF_CHARACTERISTIC
 /begin OUT_MEASUREMENT lv_inh_acr_ctl_ad fac_acr_slop ctr_dly_acr_ad ctr_inh_acr_ad lv_err_acr_ad state_acr_ad lv_opg_sp_ad_acr opg_sp_ad_acr v_acr_ad_tol v_acr_ad_bol v_acr_ad_bol_0 /end OUT_MEASUREMENT
/end FUNCTION
/begin FUNCTION ACRC_adaption_and_diagnosis_appl_inc "" /begin DEF_CHARACTERISTIC lc_acr_ad_req /end DEF_CHARACTERISTIC
 /begin OUT_MEASUREMENT lv_inh_acr_ad lv_acr_ad_act lv_acr_ad_req lv_inh_acr_ad_bol /end OUT_MEASUREMENT
/end FUNCTION
/begin FUNCTION ACRC_actuator_diagnosis ""
 /begin DEF_CHARACTERISTIC c_abc_dec_acr_ctl c_abc_inc_acr_ctl c_abc_max_acr_ctl c_crlc_opg_sp_acr c_crlc_pwm_acr c_pwm_acr_max_diag c_vb_min_pwm_acr_diag ip_opg_dif_acr_err_max ldp_opg_sp_acr_grd_absv_ip_opg /end DEF_CHARACTERISTIC
 /begin OUT_MEASUREMENT lv_err_acr_ctl ctr_diag_acr_ctl pwm_acr_mmv opg_sp_acr_fil opg_dif_acr_err_max opg_sp_acr_grd /end OUT_MEASUREMENT
/end FUNCTION
/begin FUNCTION ACRC_actuator_diagnosis_AI "" /begin OUT_MEASUREMENT lv_inh_diag_acr_ctl /end OUT_MEASUREMENT /end FUNCTION
/begin FUNCTION ACRC_limp_home_management "" /begin OUT_MEASUREMENT lv_pwm_acr_off_req /end OUT_MEASUREMENT /end FUNCTION
/begin FUNCTION ACRC_position_sensor_diagnosis ""
 /begin DEF_CHARACTERISTIC c_abc_inc_sens_acr c_abc_max_sens_acr c_v_max_sens_acr c_v_min_sens_acr /end DEF_CHARACTERISTIC
 /begin OUT_MEASUREMENT lv_err_sens_acr /end OUT_MEASUREMENT
/end FUNCTION
/begin FUNCTION ACRC_position_sensor_diagnosis_AI "" /begin OUT_MEASUREMENT lv_inh_diag_sens_acr lv_err_vcc_acr /end OUT_MEASUREMENT /end FUNCTION
/begin FUNCTION ACRC_power_stage_diagnosis "" /begin DEF_CHARACTERISTIC c_abc_inc_acr_dr c_abc_max_acr_dr /end DEF_CHARACTERISTIC /begin OUT_MEASUREMENT lv_err_acr_dr /end OUT_MEASUREMENT /end FUNCTION
/begin FUNCTION ACRC_power_stage_diagnosis_AI "" /begin DEF_CHARACTERISTIC c_vb_min_acr_dr_diag /end DEF_CHARACTERISTIC /begin OUT_MEASUREMENT lv_inh_diag_acr_dr /end OUT_MEASUREMENT /end FUNCTION
/begin FUNCTION C_3_ACRC "" /begin SUB_FUNCTION ACRC_AGGR_adaptation_EGRC /end SUB_FUNCTION /end FUNCTION
/begin FUNCTION ACRC_AGGR_adaptation_EGRC "" /begin OUT_MEASUREMENT av_open_egr lv_err_egr_2 stk_av_egr lv_er_fdout lv_egr_act /end OUT_MEASUREMENT /end FUNCTION
/begin FUNCTION C_R_ACRC "" /begin SUB_FUNCTION ACRC_customer_adap_module_EGRC /end SUB_FUNCTION /end FUNCTION
/begin FUNCTION ACRC_customer_adap_module_EGRC "" /begin OUT_MEASUREMENT opg_sp_req_acr egr_ratio_sp opg_sp_req_acr_1 /end OUT_MEASUREMENT /end FUNCTION
/begin FUNCTION C_6_IGRE "C_6_IGRE" /begin DEF_CHARACTERISTIC ldpm_n_32_1_igre ldpm_vb_1_igre ldpm_tco_td_fac /end DEF_CHARACTERISTIC
 /begin OUT_MEASUREMENT td_igc[0] td_igc[1] td_igc[2] td_igc[3] td_igc[4] td_igc[5] td_igc[6] td_igc[7] iga_igc_h_rng[0] iga_igc_h_rng[1] iga_igc_h_rng[2] iga_igc_h_rng[3] iga_igc_h_rng[4] iga_igc_h_rng[5] iga_igc_h_rng[6] iga_igc_h_rng[7] /end OUT_MEASUREMENT
 /begin SUB_FUNCTION IGRE_Dwell_time_control IGRE_Ignition_activation_control IGRE_Ignition_multiple_spark IGRE_Dwell_time_period_strat_mod IGRE_TD_and_IGA_switches IGRE_Dwell_time_factor_calc IGRE_Ignition_Injection_synchronization /end SUB_FUNCTION
/end FUNCTION
/begin FUNCTION IGRE_Dwell_time_control "Dwell_time_control" /begin DEF_CHARACTERISTIC c_td_as ip_td c_td_ini /end DEF_CHARACTERISTIC /begin OUT_MEASUREMENT td /end OUT_MEASUREMENT /end FUNCTION
/begin FUNCTION IGRE_Ignition_activation_control "Ignition_activation_control"
 /begin DEF_CHARACTERISTIC c_cycnr_iga_es lc_td_mpl_spc_ign_act c_n_max_mpl_spc_ign_act /end DEF_CHARACTERISTIC
 /begin OUT_MEASUREMENT inh_igc ctr_cycnr_iga_es /end OUT_MEASUREMENT
/end FUNCTION
/begin FUNCTION IGRE_Ignition_multiple_spark "Ignition_multiple_spark"
 /begin DEF_CHARACTERISTIC c_tco_max_mpl_st c_tco_max_mpl_is c_tco_max_mpl_pl_pu_fl c_tco_max_mpl_puc c_vb_max_mpl_is c_vb_max_mpl_pl_pu_fl c_vb_max_mpl_st c_n_min_mpl_st c_n_max_mpl_st c_n_max_mpl_is c_n_min_mpl_is c_n_min_mpl_pl_pu_fl c_n_max_mpl_pl_pu_fl c_n_max_mpl_puc c_n_min_mpl_puc c_td_mpl_man c_vb_max_mpl_puc ip_td_mpl_s ip_nr_mpl_s c_t_ctr_td_mpl_ast c_t_ctr_td_mpl ip_td_t_mpl_1 ip_td_mpl_1 ip_td_mpl_1_s ip_td_t_mpl_1_s ip_td_mpl ip_td_t_mpl ip_td_t_mpl_s ldpm_mff_sp_mv_1_igre ldpm_tco_1_igre ip_nr_mpl ip_fac_tco_nr_mpl ip_fac_tco_nr_mpl_s c_tecu_max_ign_mpl /end DEF_CHARACTERISTIC
 /begin OUT_MEASUREMENT td_mpl_dly ign_mpl_nr t_ctr_td_mpl td_mpl td_mpl_1 td_mpl_1_dly lv_td_mpl_spc_ign_act lv_inh_td_mpl /end OUT_MEASUREMENT
/end FUNCTION
/begin FUNCTION IGRE_Dwell_time_period_strat_mod "Dwell_time_period_strat_mod" /begin DEF_CHARACTERISTIC c_td_s_as ip_td_s c_td_s_ini /end DEF_CHARACTERISTIC /begin OUT_MEASUREMENT td_s /end OUT_MEASUREMENT /end FUNCTION
/begin FUNCTION IGRE_TD_and_IGA_switches "TD_and_IGA_switches" /begin DEF_CHARACTERISTIC c_vb_td_max_lim_h c_vb_td_max_lim_l /end DEF_CHARACTERISTIC
 /begin OUT_MEASUREMENT td_lim_max td_igc_tmp[0] td_igc_tmp[1] td_igc_tmp[2] td_igc_tmp[3] td_igc_tmp[4] td_igc_tmp[5] td_igc_tmp[6] td_igc_tmp[7] iga_igc_h_rng_tmp[0] iga_igc_h_rng_tmp[1] iga_igc_h_rng_tmp[2] iga_igc_h_rng_tmp[3] iga_igc_h_rng_tmp[4] iga_igc_h_rng_tmp[5] iga_igc_h_rng_tmp[6] iga_igc_h_rng_tmp[7] /end OUT_MEASUREMENT
/end FUNCTION
/begin FUNCTION IGRE_Dwell_time_factor_calc "Dwell_time_factor_calc" /begin DEF_CHARACTERISTIC ip_td_st_fac ip_td_fac_tco /end DEF_CHARACTERISTIC /begin OUT_MEASUREMENT td_fac td_st_fac td_fac_tco /end OUT_MEASUREMENT /end FUNCTION
/begin FUNCTION IGRE_Ignition_Injection_synchronization "" /begin DEF_CHARACTERISTIC c_t_ofs_upd_ign_inj_syn lc_ign_inj_syn_ena /end DEF_CHARACTERISTIC
 /begin OUT_MEASUREMENT state_inj_upd_trm state_ign_inj_upd_ack td_fac_min_tmp td_fac_max_tmp td_igc_act[0] td_igc_act[1] td_igc_act[2] td_igc_act[3] td_igc_act[4] td_igc_act[5] td_igc_act[6] td_igc_act[7] td_igc_act_max td_igc_act_min iga_igc_h_rng_act[0] iga_igc_h_rng_act[1] iga_igc_h_rng_act[2] iga_igc_h_rng_act[3] iga_igc_h_rng_act[4] iga_igc_h_rng_act[5] iga_igc_h_rng_act[6] iga_igc_h_rng_act[7] ti_act[0] ti_act[1] ti_act[2] ti_act[3] ti_act[4] ti_act[5] ti_act[6] ti_act[7] ti_mod_swi_act[0] ti_mod_swi_act[1] ti_mod_swi_act[2] ti_mod_swi_act[3] ti_mod_swi_act[4] ti_mod_swi_act[5] ti_mod_swi_act[6] ti_mod_swi_act[7] lv_ign_inj_upd_trm[0] lv_ign_inj_upd_trm[1] lv_ign_inj_upd_trm[2] lv_ign_inj_upd_trm[3] lv_ign_inj_upd_trm[4] lv_ign_inj_upd_trm[5] lv_ign_inj_upd_trm[6] lv_ign_inj_upd_trm[7] soi_act[0] soi_act[1] soi_act[2] soi_act[3] soi_act[4] soi_act[5] soi_act[6] soi_act[7] eoi_act[0] eoi_act[1] eoi_act[2] eoi_act[3] eoi_act[4] eoi_act[5] eoi_act[6] eoi_act[7] soi_mod_swi_act[0] soi_mod_swi_act[1] soi_mod_swi_act[2] soi_mod_swi_act[3] soi_mod_swi_act[4] soi_mod_swi_act[5] soi_mod_swi_act[6] soi_mod_swi_act[7] eoi_mod_swi_act[0] eoi_mod_swi_act[1] eoi_mod_swi_act[2] eoi_mod_swi_act[3] eoi_mod_swi_act[4] eoi_mod_swi_act[5] eoi_mod_swi_act[6] eoi_mod_swi_act[7] crk_psn_eng_ign_inj_upd[0] crk_psn_eng_ign_inj_upd[1] crk_psn_eng_ign_inj_upd[2] crk_psn_eng_ign_inj_upd[3] crk_psn_eng_ign_inj_upd[4] crk_psn_eng_ign_inj_upd[5] crk_psn_eng_ign_inj_upd[6] crk_psn_eng_ign_inj_upd[7] /end OUT_MEASUREMENT
/end FUNCTION
/begin FUNCTION C_2_IGRE "C_2_IGRE"
 /begin SUB_FUNCTION IGRE_Ignition_output_diagnosis IGRE_Spark_Adv_and_Dwell_Output IGRE_Dwell_time_ad_appl_inci IGRE_Dwell_time_adaptation /end SUB_FUNCTION
/end FUNCTION
/begin FUNCTION IGRE_Ignition_output_diagnosis "Ignition_output_diagnosis"
 /begin DEF_CHARACTERISTIC id_v_dur_igc_min ldp_n_32_id_v_dur_igc_min ldp_mff_sp_mv_id_v_dur_igc_min /end DEF_CHARACTERISTIC
 /begin OUT_MEASUREMENT lv_scp_igc[0] lv_scp_igc[1] lv_scp_igc[2] lv_scp_igc[3] lv_scp_igc[4] lv_scp_igc[5] lv_scp_igc[6] lv_scp_igc[7] lv_ol_igc[0] lv_ol_igc[1] lv_ol_igc[2] lv_ol_igc[3] lv_ol_igc[4] lv_ol_igc[5] lv_ol_igc[6] lv_ol_igc[7] lv_scg_igc[0] lv_scg_igc[1] lv_scg_igc[2] lv_scg_igc[3] lv_scg_igc[4] lv_scg_igc[5] lv_scg_igc[6] lv_scg_igc[7] v_dur_igc[0] v_dur_igc[1] v_dur_igc[2] v_dur_igc[3] v_dur_igc[4] v_dur_igc[5] v_dur_igc[6] v_dur_igc[7] /end OUT_MEASUREMENT
/end FUNCTION
/begin FUNCTION IGRE_Spark_Adv_and_Dwell_Output "Spark_Advance_and_Dwell_Output"
 /begin DEF_CHARACTERISTIC c_td_fac_st_min c_td_fac_st_max c_td_vb_max ip_td_fac_max ip_td_fac_min lc_igc_lih_conf /end DEF_CHARACTERISTIC
 /begin OUT_MEASUREMENT td_fac_max td_fac_min /end OUT_MEASUREMENT
/end FUNCTION
/begin FUNCTION IGRE_Dwell_time_ad_appl_inci "" /begin OUT_MEASUREMENT t_thd_igcfb td_clc lv_inh_td_ad lv_td_ad_h /end OUT_MEASUREMENT /end FUNCTION
/begin FUNCTION IGRE_Dwell_time_adaptation ""
 /begin DEF_CHARACTERISTIC c_td_ad_min c_t_thd_igcfb_max c_t_sum_td_ad_max c_td_ad_max c_td_ad_thd c_fac_dec_td_ad c_td_ad_inc lc_td_ad_clr /end DEF_CHARACTERISTIC
 /begin OUT_MEASUREMENT td_sum_td_ad[0] td_sum_td_ad[1] td_sum_td_ad[2] td_sum_td_ad[3] td_sum_td_ad[4] td_sum_td_ad[5] td_sum_td_ad[6] td_sum_td_ad[7] td_ad[0] td_ad[1] td_ad[2] td_ad[3] td_ad[4] td_ad[5] td_ad[6] td_ad[7] t_sum_td_ad[0] t_sum_td_ad[1] t_sum_td_ad[2] t_sum_td_ad[3] t_sum_td_ad[4] t_sum_td_ad[5] t_sum_td_ad[6] t_sum_td_ad[7] td_ad_h[0] td_ad_h[1] td_ad_h[2] td_ad_h[3] td_ad_h[4] td_ad_h[5] td_ad_h[6] td_ad_h[7] td_ad_l[0] td_ad_l[1] td_ad_l[2] td_ad_l[3] td_ad_l[4] td_ad_l[5] td_ad_l[6] td_ad_l[7] /end OUT_MEASUREMENT
/end FUNCTION
/begin FUNCTION C_A_IGRE "C_A_IGRE" /begin SUB_FUNCTION IGRE_Ignition_diagnosis IGRE_Appli_inci_ignition_diag /end SUB_FUNCTION /end FUNCTION
/end MODULE
/end PROJECT
