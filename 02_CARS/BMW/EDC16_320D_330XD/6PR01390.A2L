ASAP2_VERSION 1 3
/begin PROJECT P390 "BMW DDE6.2 6-Zylinder VR0.1 15.03.2004 CAN11/12H"
/begin HEADER "" VERSION "VR0.1_6Z_CAN11/12H" PROJECT_NO P390 /end HEADER
/begin MODULE DIM ""
/begin MOD_COMMON "" BYTE_ORDER MSB_FIRST ALIGNMENT_BYTE 1 ALIGNMENT_WORD 2 ALIGNMENT_LONG 4 ALIGNMENT_FLOAT32_IEEE 4 /end MOD_COMMON
/begin CHARACTERISTIC InjCrv_dtiPiI1RgnRmpUp_C "positive Rampensteigung bei Umschaltung auf Regenerationswert PiI1" VALUE 0xE152C Kw_Wu32 65535999.9847 Rmp 0.00 65535999.9847 FORMAT "%13.4" /end CHARACTERISTIC
/begin CHARACTERISTIC InjCrv_dtiPiI1RgnRmpDwn_C "negative Rampensteigung bei Umschaltung auf Regenerationswert PiI1" VALUE 0xE1530 Kw_Wu32 65535999.9847 Rmp 0.00 65535999.9847 FORMAT "%13.4" /end CHARACTERISTIC
/begin CHARACTERISTIC InjCrv_dtiPoI1RgnRmpUp_C "positive Rampensteigung bei Umschaltung auf Regenerationswerte PoI1" VALUE 0xE1BB8 Kw_Wu32 65535999.9847 Rmp 0.00 65535999.9847 FORMAT "%13.4" /end CHARACTERISTIC
/begin CHARACTERISTIC InjCrv_dtiPoI1RgnRmpDwn_C "negative Rampensteigung bei Umschaltung auf Regenerationswerte PoI1" VALUE 0xE1BBC Kw_Wu32 65535999.9847 Rmp 0.00 65535999.9847 FORMAT "%13.4" /end CHARACTERISTIC
/begin CHARACTERISTIC InjCrv_dtiPoI1RgnTypeRmpUp_C "positive gradient for activation of regeneration ramp" VALUE 0xE1BC0 Kw_Wu32 65535999.9847 Rmp 0.00 65535999.9847 FORMAT "%13.4" /end CHARACTERISTIC
/begin CHARACTERISTIC InjCrv_dtiPoI1RgnTypeRmpDwn_C "negative gradient for activation of regeneration ramp" VALUE 0xE1BC4 Kw_Wu32 65535999.9847 Rmp 0.00 65535999.9847 FORMAT "%13.4" /end CHARACTERISTIC
/begin CHARACTERISTIC InjCrv_dtiPoI2RgnEffRmpUp_C "positive gradient of regeneration ramp" VALUE 0xE2FD4 Kw_Wu32 65535999.9847 Rmp 0.00 65535999.9847 FORMAT "%13.4" /end CHARACTERISTIC
/begin CHARACTERISTIC InjCrv_dtiPoI2RgnEffRmpDwn_C "negative gradient of regeneration ramp" VALUE 0xE2FD8 Kw_Wu32 65535999.9847 Rmp 0.00 65535999.9847 FORMAT "%13.4" /end CHARACTERISTIC
/begin CHARACTERISTIC InjCrv_dtiPoI2RgnRmpUp_C "positive Rampensteigung bei Umschaltung auf Regenerationswerte PoI2" VALUE 0xE2FDC Kw_Wu32 65535999.9847 Rmp 0.00 65535999.9847 FORMAT "%13.4" /end CHARACTERISTIC
/begin CHARACTERISTIC InjCrv_dtiPoI2RgnRmpDwn_C "negative Rampensteigung bei Umschaltung auf Regenerationswerte PoI2" VALUE 0xE2FE0 Kw_Wu32 65535999.9847 Rmp 0.00 65535999.9847 FORMAT "%13.4" /end CHARACTERISTIC
/begin CHARACTERISTIC InjCrv_dtiPoI2RgnTypeRmpUp_C "positive gradient of regeneration ramp" VALUE 0xE2FE4 Kw_Wu32 65535999.9847 Rmp 0.00 65535999.9847 FORMAT "%13.4" /end CHARACTERISTIC
/begin CHARACTERISTIC InjCrv_dtiPoI2RgnTypeRmpDwn_C "negative gradient of regeneration ramp" VALUE 0xE2FE8 Kw_Wu32 65535999.9847 Rmp 0.00 65535999.9847 FORMAT "%13.4" /end CHARACTERISTIC
/begin CHARACTERISTIC InjCrv_facPhPoI2RgnAPCor_CUR "atmosphere pressure part of PoI2 regeneration setpoint correction" CURVE 0xE1F82 Kl_Xs16_Ws16 2.000000 Fact 0.00 2.000000 FORMAT "%8.6" EXTENDED_LIMITS -4.000000 3.999878
 /begin AXIS_DESCR STD_AXIS APSCD_pLinVal Pres_hPa 1 0.00 3500.000 FORMAT "%8.3" EXTENDED_LIMITS -32768.00 32767.00 DEPOSIT ABSOLUTE /end AXIS_DESCR
/end CHARACTERISTIC
/begin CHARACTERISTIC InjCrv_facPhPoI2RgnETCor_CUR "engine temperature part of PoI2 regeneration setpoint correction" CURVE 0xE1F88 Kl_Xs16_Ws16 2.000000 Fact 0.00 2.000000 FORMAT "%8.6" EXTENDED_LIMITS -4.000000 3.999878
 /begin AXIS_DESCR STD_AXIS InjCrv_tEng Temp_Cels 1 -50.14000 199.8600 FORMAT "%8.4" EXTENDED_LIMITS -3549.940 3003.560 DEPOSIT ABSOLUTE /end AXIS_DESCR
/end CHARACTERISTIC
/begin CHARACTERISTIC InjCrv_facPiI1APSQCor2Strt_CUR "weighting factor of atmospheric pressure for quantity correction of PiI1 when PiI2 or PiI3 is active" CURVE 0xE0420 Kl_Xs16_Ws16 1.000000 Fact 0.00 1.000000 FORMAT "%8.6" EXTENDED_LIMITS -4.000000 3.999878
 /begin AXIS_DESCR STD_AXIS APSCD_pVal Pres_hPa 8 0.00 3500.000 FORMAT "%8.3" EXTENDED_LIMITS -32768.00 32767.00 DEPOSIT ABSOLUTE /end AXIS_DESCR
/end CHARACTERISTIC
/begin CHARACTERISTIC InjCrv_facPiI1APSQCor2_CUR "atmosphärendruckabhängige Mengenkorrekturkennlinie für Voreinspritzung 1 wenn PiI2 oder PiI3 aktiv ist" CURVE 0xE0442 Gkl_Ws16 1.000000 Fact 0.00 1.000000 FORMAT "%8.6" EXTENDED_LIMITS -4.000000 3.999878
 /begin AXIS_DESCR COM_AXIS APSCD_pVal Pres_hPa 10 0.00 3500.000 FORMAT "%8.3" EXTENDED_LIMITS -32768.00 32767.00 AXIS_PTS_REF InjCrv_facPiI1APSQCor_AXIS /end AXIS_DESCR
/end CHARACTERISTIC
/begin CHARACTERISTIC InjCrv_facPiI1APSQCorStrt_CUR "weighting factor of atmospheric pressure for pilot injections quantity correction" CURVE 0xE0456 Kl_Xs16_Ws16 1.000000 Fact 0.00 1.000000 FORMAT "%8.6" EXTENDED_LIMITS -4.000000 3.999878
 /begin AXIS_DESCR STD_AXIS APSCD_pVal Pres_hPa 10 0.00 3500.000 FORMAT "%8.3" EXTENDED_LIMITS -32768.00 32767.00 DEPOSIT ABSOLUTE /end AXIS_DESCR
/end CHARACTERISTIC
/begin AXIS_PTS InjCrv_facPiI1APSQCor_AXIS "gemeinsame Stützstellen für atmosphärendruckabhängige Mengenkorrekturkennlinien für PiI1" 0xE0480 APSCD_pVal GSst_Xs16 3500.000 Pres_hPa 10 0.00 3500.000 FORMAT "%8.3" EXTENDED_LIMITS -32768.00 32767.00 DEPOSIT ABSOLUTE /end AXIS_PTS
/begin CHARACTERISTIC InjCrv_facPiI1APSQCor_CUR "atmosphärendruckabhängige Mengenkorrekturkennlinie für Voreinspritzung 1" CURVE 0xE0496 Gkl_Ws16 1.000000 Fact 0.00 1.000000 FORMAT "%8.6" EXTENDED_LIMITS -4.000000 3.999878
 /begin AXIS_DESCR COM_AXIS APSCD_pVal Pres_hPa 10 0.00 3500.000 FORMAT "%8.3" EXTENDED_LIMITS -32768.00 32767.00 AXIS_PTS_REF InjCrv_facPiI1APSQCor_AXIS /end AXIS_DESCR
/end CHARACTERISTIC
/begin CHARACTERISTIC InjCrv_facPiI1ATSQCor2Strt_CUR "weighting factor of intake air temperature for quantity correction of PiI1 when PiI2 or PiI3 is active" CURVE 0xE04AA Kl_Xs16_Ws16 1.000000 Fact 0.00 1.000000 FORMAT "%8.6" EXTENDED_LIMITS -4.000000 3.999878
 /begin AXIS_DESCR STD_AXIS IATSCD_tAir Temp_Cels 8 -50.14000 199.8600 FORMAT "%8.4" EXTENDED_LIMITS -3549.940 3003.560 DEPOSIT ABSOLUTE /end AXIS_DESCR
/end CHARACTERISTIC
/begin CHARACTERISTIC InjCrv_facPiI1ATSQCor2_CUR "ansauglufttemperaturabhängige Mengenkorrekturkennlinie für Voreinspritzung 1 wenn PiI2 oder PiI3 aktiv ist" CURVE 0xE04CC Gkl_Ws16 1.000000 Fact 0.00 1.000000 FORMAT "%8.6" EXTENDED_LIMITS -4.000000 3.999878
 /begin AXIS_DESCR COM_AXIS IATSCD_tAir Temp_Cels 10 -50.14000 199.8600 FORMAT "%8.4" EXTENDED_LIMITS -3549.940 3003.560 AXIS_PTS_REF InjCrv_facPiI1ATSQCor_AXIS /end AXIS_DESCR
/end CHARACTERISTIC
/begin CHARACTERISTIC InjCrv_facPiI1ATSQCorStrt_CUR "weighting factor of intake air temperature for pilot injections quantity correction" CURVE 0xE04E0 Kl_Xs16_Ws16 1.000000 Fact 0.00 1.000000 FORMAT "%8.6" EXTENDED_LIMITS -4.000000 3.999878
 /begin AXIS_DESCR STD_AXIS IATSCD_tAir Temp_Cels 10 -50.14000 199.8600 FORMAT "%8.4" EXTENDED_LIMITS -3549.940 3003.560 DEPOSIT ABSOLUTE /end AXIS_DESCR
/end CHARACTERISTIC
/begin AXIS_PTS InjCrv_facPiI1ATSQCor_AXIS "gemeinsame Stützstellen für ansauglufttemperaturabhängige Mengenkorrekturkennlinien für PiI1" 0xE050A IATSCD_tAir GSst_Xs16 250.0000 Temp_Cels 10 -50.14000 199.8600 FORMAT "%8.4" EXTENDED_LIMITS -3549.940 3003.560 DEPOSIT ABSOLUTE /end AXIS_PTS
/begin CHARACTERISTIC InjCrv_facPiI1ATSQCor_CUR "ansauglufttemperaturabhängige Mengenkorrekturkennlinie für Voreinspritzung 1" CURVE 0xE0520 Gkl_Ws16 1.000000 Fact 0.00 1.000000 FORMAT "%8.6" EXTENDED_LIMITS -4.000000 3.999878
 /begin AXIS_DESCR COM_AXIS IATSCD_tAir Temp_Cels 10 -50.14000 199.8600 FORMAT "%8.4" EXTENDED_LIMITS -3549.940 3003.560 AXIS_PTS_REF InjCrv_facPiI1ATSQCor_AXIS /end AXIS_DESCR
/end CHARACTERISTIC
/begin CHARACTERISTIC InjCrv_facPiI1ETSQCor12_CUR "motortemperaturabhängige Mengenkorrekturkennlinie für Voreinspritzung 1 bei inaktiver Voreinspritzung 2" CURVE 0xE0534 Gkl_Ws16 1.000000 Fact 0.00 1.000000 FORMAT "%8.6" EXTENDED_LIMITS -4.000000 3.999878
 /begin AXIS_DESCR COM_AXIS InjCrv_tEng Temp_Cels 8 -50.14000 199.8600 FORMAT "%8.4" EXTENDED_LIMITS -3549.940 3003.560 AXIS_PTS_REF InjCrv_facPiI1ETSQCor1_AXIS /end AXIS_DESCR
/end CHARACTERISTIC
/begin AXIS_PTS InjCrv_facPiI1ETSQCor1_AXIS "Motortemperatur zur Mengenkorrektur der Voreinspritzung" 0xE0544 InjCrv_tEng GSst_Xs16 250.0000 Temp_Cels 8 -50.14000 199.8600 FORMAT "%8.4" EXTENDED_LIMITS -3549.940 3003.560 DEPOSIT ABSOLUTE /end AXIS_PTS
/begin CHARACTERISTIC InjCrv_facPiI1ETSQCor1_CUR "motortemperaturabhängige Mengenkorrekturkennlinie -1 für Voreinspritzung 1" CURVE 0xE0556 Gkl_Ws16 1.000000 Fact 0.00 1.000000 FORMAT "%8.6" EXTENDED_LIMITS -4.000000 3.999878
 /begin AXIS_DESCR COM_AXIS InjCrv_tEng Temp_Cels 8 -50.14000 199.8600 FORMAT "%8.4" EXTENDED_LIMITS -3549.940 3003.560 AXIS_PTS_REF InjCrv_facPiI1ETSQCor1_AXIS /end AXIS_DESCR
/end CHARACTERISTIC
/begin CHARACTERISTIC InjCrv_facPiI1ETSQCor2Strt_CUR "weighting factor of engine temperature for quantity correction of PiI1 when PiI2 or PiI3 is active" CURVE 0xE0566 Kl_Xs16_Ws16 1.000000 Fact 0.00 1.000000 FORMAT "%8.6" EXTENDED_LIMITS -4.000000 3.999878
 /begin AXIS_DESCR STD_AXIS InjCrv_tEng Temp_Cels 8 -50.14000 199.8600 FORMAT "%8.4" EXTENDED_LIMITS -3549.940 3003.560 DEPOSIT ABSOLUTE /end AXIS_DESCR
/end CHARACTERISTIC
/begin CHARACTERISTIC InjCrv_facPiI1ETSQCor2_CUR "motortemperaturabhängige Mengenkorrekturkennlinie für Voreinspritzung 1 wenn PiI2 oder PiI3 aktiv ist" CURVE 0xE0588 Gkl_Ws16 1.000000 Fact 0.00 1.000000 FORMAT "%8.6" EXTENDED_LIMITS -4.000000 3.999878
 /begin AXIS_DESCR COM_AXIS InjCrv_tEng Temp_Cels 10 -50.14000 199.8600 FORMAT "%8.4" EXTENDED_LIMITS -3549.940 3003.560 AXIS_PTS_REF InjCrv_facPiI1ETSQCor_AXIS /end AXIS_DESCR
/end CHARACTERISTIC
/begin CHARACTERISTIC InjCrv_facPiI1ETSQCorStrt_CUR "weighting factor of engine temperature for pilot injection quantity correction" CURVE 0xE059C Kl_Xs16_Ws16 1.000000 Fact 0.00 1.000000 FORMAT "%8.6" EXTENDED_LIMITS -4.000000 3.999878
 /begin AXIS_DESCR STD_AXIS InjCrv_tEng Temp_Cels 10 -50.14000 199.8600 FORMAT "%8.4" EXTENDED_LIMITS -3549.940 3003.560 DEPOSIT ABSOLUTE /end AXIS_DESCR
/end CHARACTERISTIC
/begin AXIS_PTS InjCrv_facPiI1ETSQCor_AXIS "gemeinsame Stützstellen für motortemperaturabhängige Mengenkorrekturkennlinien für PiI1" 0xE05C6 InjCrv_tEng GSst_Xs16 250.0000 Temp_Cels 10 -50.14000 199.8600 FORMAT "%8.4" EXTENDED_LIMITS -3549.940 3003.560 DEPOSIT ABSOLUTE /end AXIS_PTS
/begin CHARACTERISTIC InjCrv_facPiI1ETSQCor_CUR "motortemperaturabhängige Mengenkorrekturkennlinie für Voreinspritzung 1" CURVE 0xE05DC Gkl_Ws16 1.000000 Fact 0.00 1.000000 FORMAT "%8.6" EXTENDED_LIMITS -4.000000 3.999878
 /begin AXIS_DESCR COM_AXIS InjCrv_tEng Temp_Cels 10 -50.14000 199.8600 FORMAT "%8.4" EXTENDED_LIMITS -3549.940 3003.560 AXIS_PTS_REF InjCrv_facPiI1ETSQCor_AXIS /end AXIS_DESCR
/end CHARACTERISTIC
/begin CHARACTERISTIC InjCrv_facPiI1ETSSOECor12_CUR "motortemperaturabhängige Ansteuerbeginnkorrekturkennlinie für Voreinspritzung 1 bei aktiver Voreinspritzung 2" CURVE 0xE05F0 Gkl_Ws16 1.000000 Fact 0.00 1.000000 FORMAT "%8.6" EXTENDED_LIMITS -4.000000 3.999878
 /begin AXIS_DESCR COM_AXIS InjCrv_tEng Temp_Cels 8 -50.14000 199.8600 FORMAT "%8.4" EXTENDED_LIMITS -3549.940 3003.560 AXIS_PTS_REF InjCrv_facPiI1ETSSOECor1_AXIS /end AXIS_DESCR
/end CHARACTERISTIC
/begin AXIS_PTS InjCrv_facPiI1ETSSOECor1_AXIS "Motortemperatur zur Startmengenkorrektur der Voreinspritzung" 0xE0600 InjCrv_tEng GSst_Xs16 250.0000 Temp_Cels 8 -50.14000 199.8600 FORMAT "%8.4" EXTENDED_LIMITS -3549.940 3003.560 DEPOSIT ABSOLUTE /end AXIS_PTS
/begin CHARACTERISTIC InjCrv_facPiI1ETSSOECor1_CUR "motortemperaturabhängige Ansteuerbeginnkorrekturkennlinie -1 für Voreinspritzung 1" CURVE 0xE0612 Gkl_Ws16 1.000000 Fact 0.00 1.000000 FORMAT "%8.6" EXTENDED_LIMITS -4.000000 3.999878
 /begin AXIS_DESCR COM_AXIS InjCrv_tEng Temp_Cels 8 -50.14000 199.8600 FORMAT "%8.4" EXTENDED_LIMITS -3549.940 3003.560 AXIS_PTS_REF InjCrv_facPiI1ETSSOECor1_AXIS /end AXIS_DESCR
/end CHARACTERISTIC
/begin CHARACTERISTIC InjCrv_facPiI1ETSSOECor2_CUR "motortemperaturabhängige Ansteuerbeginnkorrekturkennlinie -2 für Voreinspritzung 1" CURVE 0xE0622 Gkl_Ws16 1.000000 Fact 0.00 1.000000 FORMAT "%8.6" EXTENDED_LIMITS -4.000000 3.999878
 /begin AXIS_DESCR COM_AXIS InjCrv_tEng Temp_Cels 10 -50.14000 199.8600 FORMAT "%8.4" EXTENDED_LIMITS -3549.940 3003.560 AXIS_PTS_REF InjCrv_facPiI1ETSSOECor_AXIS /end AXIS_DESCR
/end CHARACTERISTIC
/begin CHARACTERISTIC InjCrv_facPiI1ETSSOECorStrt_CUR "motortemperaturabhängige Ansteuerbeginnkorrekturkennlinie für Voreinspritzung 1 im Startfall" CURVE 0xE0636 Kl_Xs16_Ws16 1.000000 Fact 0.00 1.000000 FORMAT "%8.6" EXTENDED_LIMITS -4.000000 3.999878
 /begin AXIS_DESCR STD_AXIS InjCrv_tEng Temp_Cels 10 -50.14000 199.8600 FORMAT "%8.4" EXTENDED_LIMITS -3549.940 3003.560 DEPOSIT ABSOLUTE /end AXIS_DESCR
/end CHARACTERISTIC
/begin AXIS_PTS InjCrv_facPiI1ETSSOECor_AXIS "gemeinsame Stützstellen für motortemperaturabhängige Ansteuerbeginnkorrekturkennlinien für PiI1" 0xE0660 InjCrv_tEng GSst_Xs16 250.0000 Temp_Cels 10 -50.14000 199.8600 FORMAT "%8.4" EXTENDED_LIMITS -3549.940 3003.560 DEPOSIT ABSOLUTE /end AXIS_PTS
/begin CHARACTERISTIC InjCrv_facPiI1ETSSOECor_CUR "motortemperaturabhängige Ansteuerbeginnkorrekturkennlinie für Voreinspritzung 1" CURVE 0xE0676 Gkl_Ws16 1.000000 Fact 0.00 1.000000 FORMAT "%8.6" EXTENDED_LIMITS -4.000000 3.999878
 /begin AXIS_DESCR COM_AXIS InjCrv_tEng Temp_Cels 10 -50.14000 199.8600 FORMAT "%8.4" EXTENDED_LIMITS -3549.940 3003.560 AXIS_PTS_REF InjCrv_facPiI1ETSSOECor_AXIS /end AXIS_DESCR
/end CHARACTERISTIC
/begin CHARACTERISTIC InjCrv_facPoI1APSQCor_CUR "atmospärendruckabhängige Mengenkorrekturkennlinie für PoI1" CURVE 0xE163A Kl_Xs16_Ws16 1.000000 Fact 0.00 1.000000 FORMAT "%8.6" EXTENDED_LIMITS -4.000000 3.999878
 /begin AXIS_DESCR STD_AXIS APSCD_pVal Pres_hPa 6 0.00 3500.000 FORMAT "%8.3" EXTENDED_LIMITS -32768.00 32767.00 DEPOSIT ABSOLUTE /end AXIS_DESCR
/end CHARACTERISTIC
/begin CHARACTERISTIC InjCrv_facPoI1ETSPhiCor_CUR "motortemperaturabhängige Winkelkorrekturkennlinie für PoI1" CURVE 0xE1654 Kl_Xs16_Ws16 1.000000 Fact 0.00 1.000000 FORMAT "%8.6" EXTENDED_LIMITS -4.000000 3.999878
 /begin AXIS_DESCR STD_AXIS InjCrv_tEng Temp_Cels 1 -50.14000 199.8600 FORMAT "%8.4" EXTENDED_LIMITS -3549.940 3003.560 DEPOSIT ABSOLUTE /end AXIS_DESCR
/end CHARACTERISTIC
/begin CHARACTERISTIC InjCrv_facPoI1ETSQCor_CUR "motortemperaturabhängige Mengenkorrekturkennlinie für PoI1" CURVE 0xE165A Kl_Xs16_Ws16 1.000000 Fact 0.00 1.000000 FORMAT "%8.6" EXTENDED_LIMITS -4.000000 3.999878
 /begin AXIS_DESCR STD_AXIS InjCrv_tEng Temp_Cels 1 -50.14000 199.8600 FORMAT "%8.4" EXTENDED_LIMITS -3549.940 3003.560 DEPOSIT ABSOLUTE /end AXIS_DESCR
/end CHARACTERISTIC
/begin CHARACTERISTIC InjCrv_facPoI2ATSQCor_CUR "ansauglufttemperaturabhängige Mengenkorrekturkennlinie für Nacheinspritzung 2" CURVE 0xE1FE2 Kl_Xs16_Ws16 1.000000 Fact 0.00 1.000000 FORMAT "%8.6" EXTENDED_LIMITS -4.000000 3.999878
 /begin AXIS_DESCR STD_AXIS IATSCD_tAir Temp_Cels 8 -50.14000 199.8600 FORMAT "%8.4" EXTENDED_LIMITS -3549.940 3003.560 DEPOSIT ABSOLUTE /end AXIS_DESCR
/end CHARACTERISTIC
/begin CHARACTERISTIC InjCrv_facPoI2ATSSOECor_CUR "ansauglufttemperaturabhängige Ansteuerbeginnkorrekturkennlinie für Nacheinspritzung 2" CURVE 0xE2004 Kl_Xs16_Ws16 1.000000 Fact 0.00 1.000000 FORMAT "%8.6" EXTENDED_LIMITS -4.000000 3.999878
 /begin AXIS_DESCR STD_AXIS IATSCD_tAir Temp_Cels 8 -50.14000 199.8600 FORMAT "%8.4" EXTENDED_LIMITS -3549.940 3003.560 DEPOSIT ABSOLUTE /end AXIS_DESCR
/end CHARACTERISTIC
/begin CHARACTERISTIC InjCrv_facPoI2Eff1_MAP "map of PoI2 for the torque forming part of injection quantity" MAP 0xE2554 Kf_Xs16_Ys16_Ws16 1.000000 Fact 0.00 1.000000 FORMAT "%8.6" EXTENDED_LIMITS -4.000000 3.999878
 /begin AXIS_DESCR STD_AXIS Eng_nAvrg EngN 8 0.00 6000.000 FORMAT "%8.3" EXTENDED_LIMITS -32768.00 32767.00 DEPOSIT ABSOLUTE /end AXIS_DESCR
 /begin AXIS_DESCR STD_AXIS InjCtl_qSetUnBal InjMassCyc 8 0.00 327.6700 FORMAT "%8.4" EXTENDED_LIMITS -327.6800 327.6700 DEPOSIT ABSOLUTE /end AXIS_DESCR
/end CHARACTERISTIC
/begin CHARACTERISTIC InjCrv_facPoI2Eff2_MAP "map of PoI2 for the torque forming part of injection quantity" MAP 0xE25F8 Kf_Xs16_Ys16_Ws16 1.000000 Fact 0.00 1.000000 FORMAT "%8.6" EXTENDED_LIMITS -4.000000 3.999878
 /begin AXIS_DESCR STD_AXIS Eng_nAvrg EngN 8 0.00 6000.000 FORMAT "%8.3" EXTENDED_LIMITS -32768.00 32767.00 DEPOSIT ABSOLUTE /end AXIS_DESCR
 /begin AXIS_DESCR STD_AXIS InjCtl_qSetUnBal InjMassCyc 8 0.00 327.6700 FORMAT "%8.4" EXTENDED_LIMITS -327.6800 327.6700 DEPOSIT ABSOLUTE /end AXIS_DESCR
/end CHARACTERISTIC
/begin CHARACTERISTIC InjCrv_facPoI2EffRgnAdd_Vector "Konfigurationslabel für Bypass Freischnitt" VALUE 0xC310A Kw_Wu8 255.0 OneToOne 0.00 255.0 FORMAT "%5.1" /end CHARACTERISTIC
/begin CHARACTERISTIC InjCrv_facPoI2EffRgnAdd_Channel "Konfigurationslabel für Bypass Freischnitt" VALUE 0xC310B Kw_Wu8 255.0 OneToOne 0.00 255.0 FORMAT "%5.1" /end CHARACTERISTIC
/begin CHARACTERISTIC InjCrv_facPoI2EffRgn_Vector "Konfigurationslabel für Bypass Freischnitt" VALUE 0xC310C Kw_Wu8 255.0 OneToOne 0.00 255.0 FORMAT "%5.1" /end CHARACTERISTIC
/begin CHARACTERISTIC InjCrv_facPoI2EffRgn_Channel "Konfigurationslabel für Bypass Freischnitt" VALUE 0xC310D Kw_Wu8 255.0 OneToOne 0.00 255.0 FORMAT "%5.1" /end CHARACTERISTIC
/begin CHARACTERISTIC InjCrv_facPoI2Eff_MAP "Faktor für Drehmoment bildenden Anteil der Einspritzmenge PoI2" MAP 0xE2264 Kf_Xs16_Ys16_Ws16 1.000000 Fact 0.00 1.000000 FORMAT "%8.6" EXTENDED_LIMITS -4.000000 3.999878
 /begin AXIS_DESCR STD_AXIS Eng_nAvrg EngN 8 0.00 6000.000 FORMAT "%8.3" EXTENDED_LIMITS -32768.00 32767.00 DEPOSIT ABSOLUTE /end AXIS_DESCR
 /begin AXIS_DESCR STD_AXIS InjCtl_qSetUnBal InjMassCyc 8 0.00 327.6700 FORMAT "%8.4" EXTENDED_LIMITS -327.6800 327.6700 DEPOSIT ABSOLUTE /end AXIS_DESCR
/end CHARACTERISTIC
/begin CHARACTERISTIC InjCrv_facPoI2ETSQCor_CUR "motortemperaturabhängige Mengenkorrekturkennlinie für Nacheinspritzung 2" CURVE 0xE2026 Kl_Xs16_Ws16 1.000000 Fact 0.00 1.000000 FORMAT "%8.6" EXTENDED_LIMITS -4.000000 3.999878
 /begin AXIS_DESCR STD_AXIS InjCrv_tEng Temp_Cels 8 -50.14000 199.8600 FORMAT "%8.4" EXTENDED_LIMITS -3549.940 3003.560 DEPOSIT ABSOLUTE /end AXIS_DESCR
/end CHARACTERISTIC
/begin CHARACTERISTIC InjCrv_facPoI2ETSSOECor_CUR "motortemperaturabhängige Ansteuerbeginnkorrekturkennlinie für PoI2" CURVE 0xE2048 Kl_Xs16_Ws16 1.000000 Fact 0.00 1.000000 FORMAT "%8.6" EXTENDED_LIMITS -4.000000 3.999878
 /begin AXIS_DESCR STD_AXIS InjCrv_tEng Temp_Cels 8 -50.14000 199.8600 FORMAT "%8.4" EXTENDED_LIMITS -3549.940 3003.560 DEPOSIT ABSOLUTE /end AXIS_DESCR
/end CHARACTERISTIC
/begin CHARACTERISTIC InjCrv_facPoI2QntMin_C "Faktor zur applikativen Abschaltung der PoI2 bei Unterschreitung der Mindestmenge" VALUE 0xE2308 Kw_Ws16 1.000000 Fact1 0.00 1.000000 FORMAT "%8.6" EXTENDED_LIMITS -256.0000 255.9922 /end CHARACTERISTIC
/begin CHARACTERISTIC InjCrv_facPOpPoI2ETSCor_CUR "motortemperaturabhängige Freigabekorrekturkennlinie für PoI2" CURVE 0xE206A Kl_Xs16_Ws16 1.000000 Fact 0.00 1.000000 FORMAT "%8.6" EXTENDED_LIMITS -4.000000 3.999878
 /begin AXIS_DESCR STD_AXIS InjCrv_tEng Temp_Cels 8 -50.14000 199.8600 FORMAT "%8.4" EXTENDED_LIMITS -3549.940 3003.560 DEPOSIT ABSOLUTE /end AXIS_DESCR
/end CHARACTERISTIC
/begin CHARACTERISTIC InjCrv_facQPoI2RgnAPCor_CUR "atmosphere pressure part of PoI2 regeneration quantity correction" CURVE 0xE1F8E Kl_Xs16_Ws16 2.000000 Fact 0.00 2.000000 FORMAT "%8.6" EXTENDED_LIMITS -4.000000 3.999878
 /begin AXIS_DESCR STD_AXIS APSCD_pLinVal Pres_hPa 1 0.00 3500.000 FORMAT "%8.3" EXTENDED_LIMITS -32768.00 32767.00 DEPOSIT ABSOLUTE /end AXIS_DESCR
/end CHARACTERISTIC
/begin CHARACTERISTIC InjCrv_facQPoI2RgnETCor_CUR "engine temperature part of PoI2 regeneration quantity correction" CURVE 0xE1F94 Kl_Xs16_Ws16 2.000000 Fact 0.00 2.000000 FORMAT "%8.6" EXTENDED_LIMITS -4.000000 3.999878
 /begin AXIS_DESCR STD_AXIS InjCrv_tEng Temp_Cels 1 -50.14000 199.8600 FORMAT "%8.4" EXTENDED_LIMITS -3549.940 3003.560 DEPOSIT ABSOLUTE /end AXIS_DESCR
/end CHARACTERISTIC
/begin CHARACTERISTIC InjCrv_facTiPoI2RgnAPCor_CUR " atmosphere pressure part of PoI2 regeneration time correction" CURVE 0xE1F9A Kl_Xs16_Ws16 2.000000 Fact 0.00 2.000000 FORMAT "%8.6" EXTENDED_LIMITS -4.000000 3.999878
 /begin AXIS_DESCR STD_AXIS APSCD_pLinVal Pres_hPa 1 0.00 3500.000 FORMAT "%8.3" EXTENDED_LIMITS -32768.00 32767.00 DEPOSIT ABSOLUTE /end AXIS_DESCR
/end CHARACTERISTIC
/begin CHARACTERISTIC InjCrv_facTiPoI2RgnETCor_CUR "engine temperature part of PoI2 regeneration time correction" CURVE 0xE1FA0 Kl_Xs16_Ws16 2.000000 Fact 0.00 2.000000 FORMAT "%8.6" EXTENDED_LIMITS -4.000000 3.999878
 /begin AXIS_DESCR STD_AXIS InjCrv_tEng Temp_Cels 1 -50.14000 199.8600 FORMAT "%8.4" EXTENDED_LIMITS -3549.940 3003.560 DEPOSIT ABSOLUTE /end AXIS_DESCR
/end CHARACTERISTIC
/begin CHARACTERISTIC InjCrv_numTDCPoI1Clsn_C "Nummer des kollidierenden Zylinders" VALUE 0xE1538 Kw_Wu8 255.0 OneToOne 0.00 255.0 FORMAT "%5.1" /end CHARACTERISTIC
/begin CHARACTERISTIC InjCrv_phiDynOfs_CUR "Winkelvorhalt für schnelle dynamische Vorgänge" CURVE 0xE153A Kl_Xs16_Ws16 767.9766 AngleCrS 0.00 767.9766 FORMAT "%8.4" EXTENDED_LIMITS -768.0000 767.9766
 /begin AXIS_DESCR STD_AXIS Eng_nAvrg EngN 12 0.00 6000.000 FORMAT "%8.3" EXTENDED_LIMITS -32768.00 32767.00 DEPOSIT ABSOLUTE /end AXIS_DESCR
/end CHARACTERISTIC
/begin CHARACTERISTIC InjCrv_phiPiI1DesAdd_Vector "#SSD Bypass-Label für additiven Bypass von InjCrv_phiPiI1Des (Nicht verstellen!)" VALUE 0xC30CC Kw_Wu8 255.0 OneToOne 0.00 255.0 FORMAT "%5.1" /end CHARACTERISTIC
/begin CHARACTERISTIC InjCrv_phiPiI1DesAdd_Channel "#SSD Bypass-Label für additiven Bypass von InjCrv_phiPiI1Des (Nicht verstellen!)" VALUE 0xC30CD Kw_Wu8 255.0 OneToOne 0.00 255.0 FORMAT "%5.1" /end CHARACTERISTIC
/begin CHARACTERISTIC InjCrv_phiPiI1Des_Vector "#SSD Bypass-Label für InjCrv_phiPiI1Des (Nicht verstellen!)" VALUE 0xC30CE Kw_Wu8 255.0 OneToOne 0.00 255.0 FORMAT "%5.1" /end CHARACTERISTIC
/begin CHARACTERISTIC InjCrv_phiPiI1Des_Channel "#SSD Bypass-Label für InjCrv_phiPiI1Des (Nicht verstellen!)" VALUE 0xC30CF Kw_Wu8 255.0 OneToOne 0.00 255.0 FORMAT "%5.1" /end CHARACTERISTIC
/begin CHARACTERISTIC InjCrv_phiPiI1RgnAdd_Vector "Bypass-Label für InjCrv_phiPiI1RgnAdd_Vector (Nicht verstellen!)" VALUE 0xC30EE Kw_Wu8 255.0 OneToOne 0.00 255.0 FORMAT "%5.1" /end CHARACTERISTIC
/begin CHARACTERISTIC InjCrv_phiPiI1RgnAdd_Channel "Bypass-Label für InjCrv_phiPiI1RgnAdd_Channel (Nicht verstellen!)" VALUE 0xC30EF Kw_Wu8 255.0 OneToOne 0.00 255.0 FORMAT "%5.1" /end CHARACTERISTIC
/begin CHARACTERISTIC InjCrv_phiPiI1Rgn_MAP "Kennfeld für Winkelkomponente Ansteuerbeginn PiI1 im Regenerationsbetrieb" MAP 0xE108E Kf_Xs16_Ys16_Ws16 90.00000 AngleCrS 0.00 90.00000 FORMAT "%8.5" EXTENDED_LIMITS -768.0000 767.9766
 /begin AXIS_DESCR STD_AXIS Eng_nAvrg EngN 2 0.00 6000.000 FORMAT "%8.3" EXTENDED_LIMITS -32768.00 32767.00 DEPOSIT ABSOLUTE /end AXIS_DESCR
 /begin AXIS_DESCR STD_AXIS InjCtl_qSetUnBal InjMassCyc 2 0.00 327.6700 FORMAT "%8.4" EXTENDED_LIMITS -327.6800 327.6700 DEPOSIT ABSOLUTE /end AXIS_DESCR
/end CHARACTERISTIC
/begin CHARACTERISTIC InjCrv_phiPiI1Rgn_Vector "#SSD Bypass-Label, nicht editieren !" VALUE 0xC30F0 Kw_Wu8 255.0 OneToOne 0.00 255.0 FORMAT "%5.1" /end CHARACTERISTIC
/begin CHARACTERISTIC InjCrv_phiPiI1Rgn_Channel "#SSD Bypass-Label, nicht editieren !" VALUE 0xC30F1 Kw_Wu8 255.0 OneToOne 0.00 255.0 FORMAT "%5.1" /end CHARACTERISTIC
/begin CHARACTERISTIC InjCrv_phiPiI2DesAdd_Vector "#SSD Bypass-Label für additiven Bypass von InjCrv_phiPiI2Des (Nicht verstellen!)" VALUE 0xC30D0 Kw_Wu8 255.0 OneToOne 0.00 255.0 FORMAT "%5.1" /end CHARACTERISTIC
/begin CHARACTERISTIC InjCrv_phiPiI2DesAdd_Channel "#SSD Bypass-Label für additiven Bypass von InjCrv_phiPiI2Des (Nicht verstellen!)" VALUE 0xC30D1 Kw_Wu8 255.0 OneToOne 0.00 255.0 FORMAT "%5.1" /end CHARACTERISTIC
/begin CHARACTERISTIC InjCrv_phiPiI2Des_Vector "#SSD Bypass-Label für InjCrv_phiPiI2Des (Nicht verstellen!)" VALUE 0xC30D2 Kw_Wu8 255.0 OneToOne 0.00 255.0 FORMAT "%5.1" /end CHARACTERISTIC
/begin CHARACTERISTIC InjCrv_phiPiI2Des_Channel "#SSD Bypass-Label für InjCrv_phiPiI2Des (Nicht verstellen!)" VALUE 0xC30D3 Kw_Wu8 255.0 OneToOne 0.00 255.0 FORMAT "%5.1" /end CHARACTERISTIC
/begin CHARACTERISTIC InjCrv_phiPiI3DesAdd_Vector "#SSD Bypass-Label für additiven Bypass von InjCrv_phiPiI3Des (Nicht verstellen!)" VALUE 0xC30D4 Kw_Wu8 255.0 OneToOne 0.00 255.0 FORMAT "%5.1" /end CHARACTERISTIC
/begin CHARACTERISTIC InjCrv_phiPiI3DesAdd_Channel "#SSD Bypass-Label für additiven Bypass von InjCrv_phiPiI3Des (Nicht verstellen!)" VALUE 0xC30D5 Kw_Wu8 255.0 OneToOne 0.00 255.0 FORMAT "%5.1" /end CHARACTERISTIC
/begin CHARACTERISTIC InjCrv_phiPiI3Des_Vector "#SSD Bypass-Label für InjCrv_phiPiI3Des (Nicht verstellen!)" VALUE 0xC30D6 Kw_Wu8 255.0 OneToOne 0.00 255.0 FORMAT "%5.1" /end CHARACTERISTIC
/begin CHARACTERISTIC InjCrv_phiPiI3Des_Channel "#SSD Bypass-Label für InjCrv_phiPiI3Des (Nicht verstellen!)" VALUE 0xC30D7 Kw_Wu8 255.0 OneToOne 0.00 255.0 FORMAT "%5.1" /end CHARACTERISTIC
/begin CHARACTERISTIC InjCrv_phiPoI1Bas_MAP "Grundwert des Ansteuerbeginnwinkels PoI1" MAP 0xE156C Kf_Xs16_Ys16_Ws16 60.00000 AngleCrS -100.0078 -40.00781 FORMAT "%8.4" EXTENDED_LIMITS -768.0000 767.9766
 /begin AXIS_DESCR STD_AXIS Eng_nAvrg EngN 2 0.00 6000.000 FORMAT "%8.3" EXTENDED_LIMITS -32768.00 32767.00 DEPOSIT ABSOLUTE /end AXIS_DESCR
 /begin AXIS_DESCR STD_AXIS InjCtl_qSetUnBal InjMassCyc 2 0.00 327.6700 FORMAT "%8.4" EXTENDED_LIMITS -327.6800 327.6700 DEPOSIT ABSOLUTE /end AXIS_DESCR
/end CHARACTERISTIC
/begin CHARACTERISTIC InjCrv_phiPoI1DesAdd_Vector "#SSD Bypass-Label für additiven Bypass von InjCrv_phiPoI1Des (Nicht verstellen!)" VALUE 0xC30FA Kw_Wu8 255.0 OneToOne 0.00 255.0 FORMAT "%5.1" /end CHARACTERISTIC
/begin CHARACTERISTIC InjCrv_phiPoI1DesAdd_Channel "#SSD Bypass-Label für additiven Bypass von InjCrv_phiPoI1Des (Nicht verstellen!)" VALUE 0xC30FB Kw_Wu8 255.0 OneToOne 0.00 255.0 FORMAT "%5.1" /end CHARACTERISTIC
/begin CHARACTERISTIC InjCrv_phiPoI1Des_Vector "#SSD Bypass-Label für InjCrv_phiPoI1Des (Nicht verstellen!)" VALUE 0xC30FC Kw_Wu8 255.0 OneToOne 0.00 255.0 FORMAT "%5.1" /end CHARACTERISTIC
/begin CHARACTERISTIC InjCrv_phiPoI1Des_Channel "#SSD Bypass-Label für InjCrv_phiPoI1Des (Nicht verstellen!)" VALUE 0xC30FD Kw_Wu8 255.0 OneToOne 0.00 255.0 FORMAT "%5.1" /end CHARACTERISTIC
/begin CHARACTERISTIC InjCrv_phiPoI1ETSCor_MAP "motortemperaturabhängiges Winkelkorrekturkennfeld für PoI1" MAP 0xE15FE Kf_Xs16_Ys16_Ws16 200.0156 AngleCrS -100.0078 100.0078 FORMAT "%8.4" EXTENDED_LIMITS -768.0000 767.9766
 /begin AXIS_DESCR STD_AXIS Eng_nAvrg EngN 2 0.00 6000.000 FORMAT "%8.3" EXTENDED_LIMITS -32768.00 32767.00 DEPOSIT ABSOLUTE /end AXIS_DESCR
 /begin AXIS_DESCR STD_AXIS InjCtl_qSetUnBal InjMassCyc 2 0.00 327.6700 FORMAT "%8.4" EXTENDED_LIMITS -327.6800 327.6700 DEPOSIT ABSOLUTE /end AXIS_DESCR
/end CHARACTERISTIC
/begin CHARACTERISTIC InjCrv_phiPoI1Max_C "#SSD Maximaler Ansteuerbeginnwinkel PoI1" VALUE 0xE1580 Kw_Ws16 60.00000 AngleCrS -100.0078 -40.00781 FORMAT "%8.4" EXTENDED_LIMITS -768.0000 767.9766 /end CHARACTERISTIC
/begin CHARACTERISTIC InjCrv_phiPoI1Rgn1_MAP "map for value for regeneration of angle comp. SOE PoI1" MAP 0xE1666 Kf_Xs16_Ys16_Ws16 60.00000 AngleCrS -100.0078 -40.00781 FORMAT "%8.4" EXTENDED_LIMITS -768.0000 767.9766
 /begin AXIS_DESCR STD_AXIS Eng_nAvrg EngN 12 0.00 6000.000 FORMAT "%8.3" EXTENDED_LIMITS -32768.00 32767.00 DEPOSIT ABSOLUTE /end AXIS_DESCR
 /begin AXIS_DESCR STD_AXIS InjCtl_qSetUnBal InjMassCyc 12 0.00 327.6700 FORMAT "%8.4" EXTENDED_LIMITS -327.6800 327.6700 DEPOSIT ABSOLUTE /end AXIS_DESCR
/end CHARACTERISTIC
/begin CHARACTERISTIC InjCrv_phiPoI1Rgn2_MAP "map for value for regeneration of angle comp. SOE PoI1" MAP 0xE17BA Kf_Xs16_Ys16_Ws16 60.00000 AngleCrS -100.0078 -40.00781 FORMAT "%8.4" EXTENDED_LIMITS -768.0000 767.9766
 /begin AXIS_DESCR STD_AXIS Eng_nAvrg EngN 12 0.00 6000.000 FORMAT "%8.3" EXTENDED_LIMITS -32768.00 32767.00 DEPOSIT ABSOLUTE /end AXIS_DESCR
 /begin AXIS_DESCR STD_AXIS InjCtl_qSetUnBal InjMassCyc 12 0.00 327.6700 FORMAT "%8.4" EXTENDED_LIMITS -327.6800 327.6700 DEPOSIT ABSOLUTE /end AXIS_DESCR
/end CHARACTERISTIC
/begin CHARACTERISTIC InjCrv_phiPoI1RgnAdd_Vector "Bypass-Label für InjCrv_phiPoI1RgnAdd_Vector (Nicht verstellen!)" VALUE 0xC3102 Kw_Wu8 255.0 OneToOne 0.00 255.0 FORMAT "%5.1" /end CHARACTERISTIC
/begin CHARACTERISTIC InjCrv_phiPoI1RgnAdd_Channel "Bypass-Label für InjCrv_phiPoI1RgnAdd_Channel (Nicht verstellen!)" VALUE 0xC3103 Kw_Wu8 255.0 OneToOne 0.00 255.0 FORMAT "%5.1" /end CHARACTERISTIC
/begin CHARACTERISTIC InjCrv_phiPoI1Rgn_Vector "#SSD Bypass-Label, nicht editieren !" VALUE 0xC3104 Kw_Wu8 255.0 OneToOne 0.00 255.0 FORMAT "%5.1" /end CHARACTERISTIC
/begin CHARACTERISTIC InjCrv_phiPoI1Rgn_Channel "#SSD Bypass-Label, nicht editieren !" VALUE 0xC3105 Kw_Wu8 255.0 OneToOne 0.00 255.0 FORMAT "%5.1" /end CHARACTERISTIC
/begin CHARACTERISTIC InjCrv_phiPoI2Add_Vector "Bypass-label für additiven Bypass von InjCrv_phiPoI2 ( Nicht verstellen !)" VALUE 0xC311A Kw_Wu8 255.0 OneToOne 0.00 255.0 FORMAT "%5.1" /end CHARACTERISTIC
/begin CHARACTERISTIC InjCrv_phiPoI2Add_Channel "Label für additvien Bypass von InjCrv_phiPoI2 (Nicht verstellen!)" VALUE 0xC311B Kw_Wu8 255.0 OneToOne 0.00 255.0 FORMAT "%5.1" /end CHARACTERISTIC
/begin CHARACTERISTIC InjCrv_phiPoI2ATSCor_MAP "kundenspez. ansauglufttemperaturabhängiger Korrekturgrundwert für die Winkelkomponente des Ansteuerbeginns der PoI2" MAP 0xE1D62 Kf_Xs16_Ys16_Ws16 40.00781 AngleCrS -40.00781 0.00 FORMAT "%8.5" EXTENDED_LIMITS -768.0000 767.9766
 /begin AXIS_DESCR STD_AXIS Eng_nAvrg EngN 16 0.00 6000.000 FORMAT "%8.3" EXTENDED_LIMITS -32768.00 32767.00 DEPOSIT ABSOLUTE /end AXIS_DESCR
 /begin AXIS_DESCR STD_AXIS InjCtl_qSetUnBal InjMassCyc 8 0.00 327.6700 FORMAT "%8.4" EXTENDED_LIMITS -327.6800 327.6700 DEPOSIT ABSOLUTE /end AXIS_DESCR
/end CHARACTERISTIC
/begin CHARACTERISTIC InjCrv_phiPoI2Bas_MAP "Winkelkomponente Ansteuerbeginn Grundwert PoI2" MAP 0xE3198 Kf_Xs16_Ys16_Ws16 40.00781 AngleCrS -40.00781 0.00 FORMAT "%8.5" EXTENDED_LIMITS -768.0000 767.9766
 /begin AXIS_DESCR STD_AXIS Eng_nAvrg EngN 2 0.00 6000.000 FORMAT "%8.3" EXTENDED_LIMITS -32768.00 32767.00 DEPOSIT ABSOLUTE /end AXIS_DESCR
 /begin AXIS_DESCR STD_AXIS InjCtl_qSetUnBal InjMassCyc 2 0.00 327.6700 FORMAT "%8.4" EXTENDED_LIMITS -327.6800 327.6700 DEPOSIT ABSOLUTE /end AXIS_DESCR
/end CHARACTERISTIC
/begin CHARACTERISTIC InjCrv_phiPoI2ETSCor_MAP "motortemperaturabhängiger Korrekturgrundwertekennfeld für die Winkelkomponente des Ansteuerbeginns der PoI2" MAP 0xE1E96 Kf_Xs16_Ys16_Ws16 40.00781 AngleCrS -40.00781 0.00 FORMAT "%8.5" EXTENDED_LIMITS -768.0000 767.9766
 /begin AXIS_DESCR STD_AXIS Eng_nAvrg EngN 12 0.00 6000.000 FORMAT "%8.3" EXTENDED_LIMITS -32768.00 32767.00 DEPOSIT ABSOLUTE /end AXIS_DESCR
 /begin AXIS_DESCR STD_AXIS InjCtl_qSetUnBal InjMassCyc 8 0.00 327.6700 FORMAT "%8.4" EXTENDED_LIMITS -327.6800 327.6700 DEPOSIT ABSOLUTE /end AXIS_DESCR
/end CHARACTERISTIC
/begin CHARACTERISTIC InjCrv_phiPoI2Min_C "#SSD minimaler Ansteuerbeginn PoI2 relativ zum oberen Totpunkt" VALUE 0xE3060 Kw_Ws16 40.00781 AngleCrS -40.00781 0.00 FORMAT "%8.5" EXTENDED_LIMITS -768.0000 767.9766 /end CHARACTERISTIC
/begin CHARACTERISTIC InjCrv_phiPoI2Rgn1_MAP "Kennfeld Regenerationswert 1 Förderbeginn Nacheinspritzung" MAP 0xE269C Kf_Xs16_Ys16_Ws16 40.00781 AngleCrS -40.00781 0.00 FORMAT "%8.5" EXTENDED_LIMITS -768.0000 767.9766
 /begin AXIS_DESCR STD_AXIS Eng_nAvrg EngN 2 0.00 6000.000 FORMAT "%8.3" EXTENDED_LIMITS -32768.00 32767.00 DEPOSIT ABSOLUTE /end AXIS_DESCR
 /begin AXIS_DESCR STD_AXIS InjCtl_qSetUnBal InjMassCyc 2 0.00 327.6700 FORMAT "%8.4" EXTENDED_LIMITS -327.6800 327.6700 DEPOSIT ABSOLUTE /end AXIS_DESCR
/end CHARACTERISTIC
/begin CHARACTERISTIC InjCrv_phiPoI2Rgn2_MAP "Kennfeld Regenerationswert 2 Förderbeginn Nacheinspritzung" MAP 0xE26B0 Kf_Xs16_Ys16_Ws16 40.00781 AngleCrS -40.00781 0.00 FORMAT "%8.5" EXTENDED_LIMITS -768.0000 767.9766
 /begin AXIS_DESCR STD_AXIS Eng_nAvrg EngN 2 0.00 6000.000 FORMAT "%8.3" EXTENDED_LIMITS -32768.00 32767.00 DEPOSIT ABSOLUTE /end AXIS_DESCR
 /begin AXIS_DESCR STD_AXIS InjCtl_qSetUnBal InjMassCyc 2 0.00 327.6700 FORMAT "%8.4" EXTENDED_LIMITS -327.6800 327.6700 DEPOSIT ABSOLUTE /end AXIS_DESCR
/end CHARACTERISTIC
/begin CHARACTERISTIC InjCrv_phiPoI2RgnAdd_Vector "Bypass-Label für InjCrv_phiPoI2RgnAdd_Vector (Nicht verstellen!)" VALUE 0xC310E Kw_Wu8 255.0 OneToOne 0.00 255.0 FORMAT "%5.1" /end CHARACTERISTIC
/begin CHARACTERISTIC InjCrv_phiPoI2RgnAdd_Channel "Bypass-Label für InjCrv_phiPoI2RgnAdd_Channel (Nicht verstellen!)" VALUE 0xC310F Kw_Wu8 255.0 OneToOne 0.00 255.0 FORMAT "%5.1" /end CHARACTERISTIC
/begin CHARACTERISTIC InjCrv_phiPoI2RgnCor_MAP "regeneration map of PoI2 setpoint correction" MAP 0xE1FA6 Kf_Xs16_Ys16_Ws16 40.00781 AngleCrS -40.00781 0.00 FORMAT "%8.5" EXTENDED_LIMITS -768.0000 767.9766
 /begin AXIS_DESCR STD_AXIS Eng_nAvrg EngN 2 0.00 6000.000 FORMAT "%8.3" EXTENDED_LIMITS -32768.00 32767.00 DEPOSIT ABSOLUTE /end AXIS_DESCR
 /begin AXIS_DESCR STD_AXIS InjCtl_qSetUnBal InjMassCyc 2 0.00 327.6700 FORMAT "%8.4" EXTENDED_LIMITS -327.6800 327.6700 DEPOSIT ABSOLUTE /end AXIS_DESCR
/end CHARACTERISTIC
/begin CHARACTERISTIC InjCrv_phiPoI2Rgn_Vector "#SSD Bypass-Label, nicht editieren !" VALUE 0xC3110 Kw_Wu8 255.0 OneToOne 0.00 255.0 FORMAT "%5.1" /end CHARACTERISTIC
/begin CHARACTERISTIC InjCrv_phiPoI2Rgn_Channel "#SSD Bypass-Label, nicht editieren !" VALUE 0xC3111 Kw_Wu8 255.0 OneToOne 0.00 255.0 FORMAT "%5.1" /end CHARACTERISTIC
/begin CHARACTERISTIC InjCrv_phiPoI2_Vector "#SSD Bypass-Label, nicht editieren !" VALUE 0xC311C Kw_Wu8 255.0 OneToOne 0.00 255.0 FORMAT "%5.1" /end CHARACTERISTIC
/begin CHARACTERISTIC InjCrv_phiPoI2_Channel "#SSD Bypass-Label, nicht editieren !" VALUE 0xC311D Kw_Wu8 255.0 OneToOne 0.00 255.0 FORMAT "%5.1" /end CHARACTERISTIC
/begin CHARACTERISTIC InjCrv_POpPoI1Bas_MAP "Grundwert Freigabe PoI1" MAP 0xE1BD0 Kf_Xs16_Ys16_Ws16 100.0000 OneToOne 0.00 100.0000 FORMAT "%8.4" EXTENDED_LIMITS -32768.00 32767.00
 /begin AXIS_DESCR STD_AXIS Eng_nAvrg EngN 2 0.00 6000.000 FORMAT "%8.3" EXTENDED_LIMITS -32768.00 32767.00 DEPOSIT ABSOLUTE /end AXIS_DESCR
 /begin AXIS_DESCR STD_AXIS InjCtl_qSetUnBal InjMassCyc 2 0.00 327.6700 FORMAT "%8.4" EXTENDED_LIMITS -327.6800 327.6700 DEPOSIT ABSOLUTE /end AXIS_DESCR
/end CHARACTERISTIC
/begin CHARACTERISTIC InjCrv_POpPoI1ETSCor_CUR "motortemperaturabhängige Freigabekorrekturkennlinie für PoI1" CURVE 0xE1660 Kl_Xs16_Ws16 100.0000 OneToOne 0.00 100.0000 FORMAT "%8.4" EXTENDED_LIMITS -32768.00 32767.00
 /begin AXIS_DESCR STD_AXIS InjCrv_tEng Temp_Cels 1 -50.14000 199.8600 FORMAT "%8.4" EXTENDED_LIMITS -3549.940 3003.560 DEPOSIT ABSOLUTE /end AXIS_DESCR
/end CHARACTERISTIC
/begin CHARACTERISTIC InjCrv_POpPoI1High_C "obere Hystereseschwelle des Grundwertes Freigabe PoI1" VALUE 0xE1BE4 Kw_Ws16 100.0000 OneToOne 0.00 100.0000 FORMAT "%8.4" EXTENDED_LIMITS -32768.00 32767.00 /end CHARACTERISTIC
/begin CHARACTERISTIC InjCrv_POpPoI1Low_C "Untere Hystereseschwelle des Grundwertes Freigabe PoI1" VALUE 0xE1BE6 Kw_Ws16 100.0000 OneToOne 0.00 100.0000 FORMAT "%8.4" EXTENDED_LIMITS -32768.00 32767.00 /end CHARACTERISTIC
/begin CHARACTERISTIC InjCrv_POpPoI2Bas_MAP "grundwert Freigabe PoI2" MAP 0xE2FF8 Kf_Xs16_Ys16_Ws16 100.0000 OneToOne 0.00 100.0000 FORMAT "%8.4" EXTENDED_LIMITS -32768.00 32767.00
 /begin AXIS_DESCR STD_AXIS Eng_nAvrg EngN 6 0.00 6000.000 FORMAT "%8.3" EXTENDED_LIMITS -32768.00 32767.00 DEPOSIT ABSOLUTE /end AXIS_DESCR
 /begin AXIS_DESCR STD_AXIS InjCtl_qSetUnBal InjMassCyc 6 0.00 327.6700 FORMAT "%8.4" EXTENDED_LIMITS -327.6800 327.6700 DEPOSIT ABSOLUTE /end AXIS_DESCR
/end CHARACTERISTIC
/begin CHARACTERISTIC InjCrv_POpPoI2ETSCor_MAP "Motortemperaturabhängiges Freigabekorrekturkennfeld für PoI2" MAP 0xE1BE8 Kf_Xs16_Ys16_Ws16 100.0000 OneToOne 0.00 100.0000 FORMAT "%8.4" EXTENDED_LIMITS -32768.00 32767.00
 /begin AXIS_DESCR STD_AXIS Eng_nAvrg EngN 8 0.00 6000.000 FORMAT "%8.3" EXTENDED_LIMITS -32768.00 32767.00 DEPOSIT ABSOLUTE /end AXIS_DESCR
 /begin AXIS_DESCR STD_AXIS InjCtl_qSetUnBal InjMassCyc 8 0.00 327.6700 FORMAT "%8.4" EXTENDED_LIMITS -327.6800 327.6700 DEPOSIT ABSOLUTE /end AXIS_DESCR
/end CHARACTERISTIC
/begin CHARACTERISTIC InjCrv_POpPoI2High_C "Feigabe PoI2 über Betriebspunkt, obere Hystereseschwelle" VALUE 0xE305C Kw_Ws16 100.0000 OneToOne 0.00 100.0000 FORMAT "%8.4" EXTENDED_LIMITS -32768.00 32767.00 /end CHARACTERISTIC
/begin CHARACTERISTIC InjCrv_POpPoI2Low_C "Freigabe PoI2 über Betriebspunkt, untere Hystereseschwelle" VALUE 0xE305E Kw_Ws16 100.0000 OneToOne 0.00 100.0000 FORMAT "%8.4" EXTENDED_LIMITS -32768.00 32767.00 /end CHARACTERISTIC
/begin CHARACTERISTIC InjCrv_qMin_CUR "Kennlinie für die Berechnung der Minimalmenge einer Einspritzung" CURVE 0xE33F0 Kl_Xs16_Ws16 327.6700 InjMassInj 0.00 327.6700 FORMAT "%8.4" EXTENDED_LIMITS -327.6800 327.6700
 /begin AXIS_DESCR STD_AXIS RailCD_pPeak Pres_Rail 16 0.00 2000.000 FORMAT "%5.3" EXTENDED_LIMITS -3276.800 3276.700 DEPOSIT ABSOLUTE /end AXIS_DESCR
/end CHARACTERISTIC
/begin CHARACTERISTIC InjCrv_qPiI1DesAdd_Vector "#SSD Bypass-Label für additiven Bypass von InjCrv_qPiI1Des (Nicht verstellen!)" VALUE 0xC30D8 Kw_Wu8 255.0 OneToOne 0.00 255.0 FORMAT "%5.1" /end CHARACTERISTIC
/begin CHARACTERISTIC InjCrv_qPiI1DesAdd_Channel "#SSD Bypass-Label für additiven Bypass von InjCrv_qPiI1Des (Nicht verstellen!)" VALUE 0xC30D9 Kw_Wu8 255.0 OneToOne 0.00 255.0 FORMAT "%5.1" /end CHARACTERISTIC
/begin CHARACTERISTIC InjCrv_qPiI1Des_Vector "#SSD Bypass-Label für InjCrv_qPiI1Des (Nicht verstellen!)" VALUE 0xC30DA Kw_Wu8 255.0 OneToOne 0.00 255.0 FORMAT "%5.1" /end CHARACTERISTIC
/begin CHARACTERISTIC InjCrv_qPiI1Des_Channel "#SSD Bypass-Label für InjCrv_qPiI1Des (Nicht verstellen!)" VALUE 0xC30DB Kw_Wu8 255.0 OneToOne 0.00 255.0 FORMAT "%5.1" /end CHARACTERISTIC
/begin CHARACTERISTIC InjCrv_qPiI1RgnAdd_Vector "Bypass-Label für InjCrv_qPiI1RgnAdd_Vector (Nicht verstellen!)" VALUE 0xC30F2 Kw_Wu8 255.0 OneToOne 0.00 255.0 FORMAT "%5.1" /end CHARACTERISTIC
/begin CHARACTERISTIC InjCrv_qPiI1RgnAdd_Channel "Bypass-Label für InjCrv_qPiI1RgnAdd_Channel (Nicht verstellen!)" VALUE 0xC30F3 Kw_Wu8 255.0 OneToOne 0.00 255.0 FORMAT "%5.1" /end CHARACTERISTIC
/begin CHARACTERISTIC InjCrv_qPiI1Rgn_MAP "Kennfeld für Einspritzmenge PiI1 im Regenerationsbetrieb" MAP 0xE10A2 Kf_Xs16_Ys16_Ws16 10.00000 InjMassInj 0.00 10.00000 FORMAT "%8.5" EXTENDED_LIMITS -327.6800 327.6700
 /begin AXIS_DESCR STD_AXIS Eng_nAvrg EngN 16 0.00 6000.000 FORMAT "%8.3" EXTENDED_LIMITS -32768.00 32767.00 DEPOSIT ABSOLUTE /end AXIS_DESCR
 /begin AXIS_DESCR STD_AXIS InjCtl_qSetUnBal InjMassCyc 16 0.00 327.6700 FORMAT "%8.4" EXTENDED_LIMITS -327.6800 327.6700 DEPOSIT ABSOLUTE /end AXIS_DESCR
/end CHARACTERISTIC
/begin CHARACTERISTIC InjCrv_qPiI1Rgn_Vector "#SSD Bypass-Label, nicht editieren !" VALUE 0xC30F4 Kw_Wu8 255.0 OneToOne 0.00 255.0 FORMAT "%5.1" /end CHARACTERISTIC
/begin CHARACTERISTIC InjCrv_qPiI1Rgn_Channel "#SSD Bypass-Label, nicht editieren !" VALUE 0xC30F5 Kw_Wu8 255.0 OneToOne 0.00 255.0 FORMAT "%5.1" /end CHARACTERISTIC
/begin CHARACTERISTIC InjCrv_qPiI1SetByp_Vector "#SSD Bypass Label, NICHT AENDERN" VALUE 0xC30DC Kw_Wu8 255.0 OneToOne 0.00 255.0 FORMAT "%5.1" /end CHARACTERISTIC
/begin CHARACTERISTIC InjCrv_qPiI1SetByp_Channel "#SSD Bypass Label, NICHT AENDERN" VALUE 0xC30DD Kw_Wu8 255.0 OneToOne 0.00 255.0 FORMAT "%5.1" /end CHARACTERISTIC
/begin CHARACTERISTIC InjCrv_qPiI2DesAdd_Vector "#SSD Bypass-Label für additiven Bypass von InjCrv_qPiI2Des (Nicht verstellen!)" VALUE 0xC30DE Kw_Wu8 255.0 OneToOne 0.00 255.0 FORMAT "%5.1" /end CHARACTERISTIC
/begin CHARACTERISTIC InjCrv_qPiI2DesAdd_Channel "#SSD Bypass-Label für additiven Bypass von InjCrv_qPiI2Des (Nicht verstellen!)" VALUE 0xC30DF Kw_Wu8 255.0 OneToOne 0.00 255.0 FORMAT "%5.1" /end CHARACTERISTIC
/begin CHARACTERISTIC InjCrv_qPiI2Des_Vector "#SSD Bypass-Label für InjCrv_qPiI2Des (Nicht verstellen!)" VALUE 0xC30E0 Kw_Wu8 255.0 OneToOne 0.00 255.0 FORMAT "%5.1" /end CHARACTERISTIC
/begin CHARACTERISTIC InjCrv_qPiI2Des_Channel "#SSD Bypass-Label für InjCrv_qPiI2Des (Nicht verstellen!)" VALUE 0xC30E1 Kw_Wu8 255.0 OneToOne 0.00 255.0 FORMAT "%5.1" /end CHARACTERISTIC
/begin CHARACTERISTIC InjCrv_qPiI3DesAdd_Vector "#SSD Bypass-Label für additiven Bypass von InjCrv_qPiI3Des (Nicht verstellen!)" VALUE 0xC30E2 Kw_Wu8 255.0 OneToOne 0.00 255.0 FORMAT "%5.1" /end CHARACTERISTIC
/begin CHARACTERISTIC InjCrv_qPiI3DesAdd_Channel "#SSD Bypass-Label für additiven Bypass von InjCrv_qPiI3Des (Nicht verstellen!)" VALUE 0xC30E3 Kw_Wu8 255.0 OneToOne 0.00 255.0 FORMAT "%5.1" /end CHARACTERISTIC
/begin CHARACTERISTIC InjCrv_qPiI3Des_Vector "#SSD Bypass-Label für InjCrv_qPiI3Des (Nicht verstellen!)" VALUE 0xC30E4 Kw_Wu8 255.0 OneToOne 0.00 255.0 FORMAT "%5.1" /end CHARACTERISTIC
/begin CHARACTERISTIC InjCrv_qPiI3Des_Channel "#SSD Bypass-Label für InjCrv_qPiI3Des (Nicht verstellen!)" VALUE 0xC30E5 Kw_Wu8 255.0 OneToOne 0.00 255.0 FORMAT "%5.1" /end CHARACTERISTIC
/begin CHARACTERISTIC InjCrv_qPoI1APSCor_MAP "atmospärendruckabhängiges Mengenkorrekturkennfeld für PoI1" MAP 0xE1612 Kf_Xs16_Ys16_Ws16 10.00000 InjMassInj 0.00 10.00000 FORMAT "%8.5" EXTENDED_LIMITS -327.6800 327.6700
 /begin AXIS_DESCR STD_AXIS Eng_nAvrg EngN 2 0.00 6000.000 FORMAT "%8.3" EXTENDED_LIMITS -32768.00 32767.00 DEPOSIT ABSOLUTE /end AXIS_DESCR
 /begin AXIS_DESCR STD_AXIS InjCtl_qSetUnBal InjMassCyc 2 0.00 327.6700 FORMAT "%8.4" EXTENDED_LIMITS -327.6800 327.6700 DEPOSIT ABSOLUTE /end AXIS_DESCR
/end CHARACTERISTIC
/begin CHARACTERISTIC InjCrv_qPoI1Bas_MAP "Grundwert der Einspritzmenge PoI1" MAP 0xE1582 Kf_Xs16_Ys16_Ws16 10.00000 InjMassInj 0.00 10.00000 FORMAT "%8.5" EXTENDED_LIMITS -327.6800 327.6700
 /begin AXIS_DESCR STD_AXIS Eng_nAvrg EngN 2 0.00 6000.000 FORMAT "%8.3" EXTENDED_LIMITS -32768.00 32767.00 DEPOSIT ABSOLUTE /end AXIS_DESCR
 /begin AXIS_DESCR STD_AXIS InjCtl_qSetUnBal InjMassCyc 2 0.00 327.6700 FORMAT "%8.4" EXTENDED_LIMITS -327.6800 327.6700 DEPOSIT ABSOLUTE /end AXIS_DESCR
/end CHARACTERISTIC
/begin CHARACTERISTIC InjCrv_qPoI1DesAdd_Vector "#SSD Bypass-Label für additiven Bypass von InjCrv_qPoI1Des (Nicht verstellen!)" VALUE 0xC30FE Kw_Wu8 255.0 OneToOne 0.00 255.0 FORMAT "%5.1" /end CHARACTERISTIC
/begin CHARACTERISTIC InjCrv_qPoI1DesAdd_Channel "#SSD Bypass-Label für additiven Bypass von InjCrv_qPoI1Des (Nicht verstellen!)" VALUE 0xC30FF Kw_Wu8 255.0 OneToOne 0.00 255.0 FORMAT "%5.1" /end CHARACTERISTIC
/begin CHARACTERISTIC InjCrv_qPoI1Des_Vector "#SSD Bypass-Label für InjCrv_qPoI1Des (Nicht verstellen!)" VALUE 0xC3100 Kw_Wu8 255.0 OneToOne 0.00 255.0 FORMAT "%5.1" /end CHARACTERISTIC
/begin CHARACTERISTIC InjCrv_qPoI1Des_Channel "#SSD Bypass-Label für InjCrv_qPoI1Des (Nicht verstellen!)" VALUE 0xC3101 Kw_Wu8 255.0 OneToOne 0.00 255.0 FORMAT "%5.1" /end CHARACTERISTIC
/begin CHARACTERISTIC InjCrv_qPoI1ETSCor_MAP "motortemperaturabhängiges Mengenkorrekturkennfeld für PoI1" MAP 0xE1626 Kf_Xs16_Ys16_Ws16 10.00000 InjMassInj 0.00 10.00000 FORMAT "%8.5" EXTENDED_LIMITS -327.6800 327.6700
 /begin AXIS_DESCR STD_AXIS Eng_nAvrg EngN 2 0.00 6000.000 FORMAT "%8.3" EXTENDED_LIMITS -32768.00 32767.00 DEPOSIT ABSOLUTE /end AXIS_DESCR
 /begin AXIS_DESCR STD_AXIS InjCtl_qSetUnBal InjMassCyc 2 0.00 327.6700 FORMAT "%8.4" EXTENDED_LIMITS -327.6800 327.6700 DEPOSIT ABSOLUTE /end AXIS_DESCR
/end CHARACTERISTIC
/begin CHARACTERISTIC InjCrv_qPoI1Max_MAP "Maximalwert der Einspritzmenge PoI1" MAP 0xE1596 Kf_Xs16_Ys16_Ws16 10.00000 InjMassInj 0.00 10.00000 FORMAT "%8.5" EXTENDED_LIMITS -327.6800 327.6700
 /begin AXIS_DESCR STD_AXIS Eng_nAvrg EngN 6 0.00 6000.000 FORMAT "%8.3" EXTENDED_LIMITS -32768.00 32767.00 DEPOSIT ABSOLUTE /end AXIS_DESCR
 /begin AXIS_DESCR STD_AXIS InjCtl_qSetUnBal InjMassCyc 6 0.00 327.6700 FORMAT "%8.4" EXTENDED_LIMITS -327.6800 327.6700 DEPOSIT ABSOLUTE /end AXIS_DESCR
/end CHARACTERISTIC
/begin CHARACTERISTIC InjCrv_qPoI1Rgn1_MAP "map for value for regeneration of quantity PoI1" MAP 0xE190E Kf_Xs16_Ys16_Ws16 10.00000 InjMassInj 0.00 10.00000 FORMAT "%8.5" EXTENDED_LIMITS -327.6800 327.6700
 /begin AXIS_DESCR STD_AXIS Eng_nAvrg EngN 12 0.00 6000.000 FORMAT "%8.3" EXTENDED_LIMITS -32768.00 32767.00 DEPOSIT ABSOLUTE /end AXIS_DESCR
 /begin AXIS_DESCR STD_AXIS InjCtl_qSetUnBal InjMassCyc 12 0.00 327.6700 FORMAT "%8.4" EXTENDED_LIMITS -327.6800 327.6700 DEPOSIT ABSOLUTE /end AXIS_DESCR
/end CHARACTERISTIC
/begin CHARACTERISTIC InjCrv_qPoI1Rgn2_MAP "map for value for regeneration of quantity PoI1" MAP 0xE1A62 Kf_Xs16_Ys16_Ws16 10.00000 InjMassInj 0.00 10.00000 FORMAT "%8.5" EXTENDED_LIMITS -327.6800 327.6700
 /begin AXIS_DESCR STD_AXIS Eng_nAvrg EngN 12 0.00 6000.000 FORMAT "%8.3" EXTENDED_LIMITS -32768.00 32767.00 DEPOSIT ABSOLUTE /end AXIS_DESCR
 /begin AXIS_DESCR STD_AXIS InjCtl_qSetUnBal InjMassCyc 12 0.00 327.6700 FORMAT "%8.4" EXTENDED_LIMITS -327.6800 327.6700 DEPOSIT ABSOLUTE /end AXIS_DESCR
/end CHARACTERISTIC
/begin CHARACTERISTIC InjCrv_qPoI1RgnAdd_Vector "Konfigurationslabel für Bypass Freischnitt" VALUE 0xC3106 Kw_Wu8 255.0 OneToOne 0.00 255.0 FORMAT "%5.1" /end CHARACTERISTIC
/begin CHARACTERISTIC InjCrv_qPoI1RgnAdd_Channel "Konfigurationslabel für Bypass Freischnitt" VALUE 0xC3107 Kw_Wu8 255.0 OneToOne 0.00 255.0 FORMAT "%5.1" /end CHARACTERISTIC
/begin CHARACTERISTIC InjCrv_qPoI1Rgn_Vector "#SSD Bypass-Label, nicht editieren !" VALUE 0xC3108 Kw_Wu8 255.0 OneToOne 0.00 255.0 FORMAT "%5.1" /end CHARACTERISTIC
/begin CHARACTERISTIC InjCrv_qPoI1Rgn_Channel "#SSD Bypass-Label, nicht editieren !" VALUE 0xC3109 Kw_Wu8 255.0 OneToOne 0.00 255.0 FORMAT "%5.1" /end CHARACTERISTIC
/begin CHARACTERISTIC InjCrv_qPoI1SetLim_C "Minimum fuel quantity to enable PoI1" VALUE 0xE15FA Kw_Ws16 327.6700 InjMassInj 0.00 327.6700 FORMAT "%8.4" EXTENDED_LIMITS -327.6800 327.6700 /end CHARACTERISTIC
/begin CHARACTERISTIC InjCrv_qPoI2ATSCor_MAP "ansauglufttemperaturabhängiges Mengenkorrekturkennfeld für PoI2" MAP 0xE1C8C Kf_Xs16_Ys16_Ws16 10.00000 InjMassInj 0.00 10.00000 FORMAT "%8.5" EXTENDED_LIMITS -327.6800 327.6700
 /begin AXIS_DESCR STD_AXIS Eng_nAvrg EngN 6 0.00 6000.000 FORMAT "%8.3" EXTENDED_LIMITS -32768.00 32767.00 DEPOSIT ABSOLUTE /end AXIS_DESCR
 /begin AXIS_DESCR STD_AXIS InjCtl_qSetUnBal InjMassCyc 6 0.00 327.6700 FORMAT "%8.4" EXTENDED_LIMITS -327.6800 327.6700 DEPOSIT ABSOLUTE /end AXIS_DESCR
/end CHARACTERISTIC
/begin CHARACTERISTIC InjCrv_qPoI2Bas_MAP "Einspritzmenge PoI2 Grundwert" MAP 0xE230A Kf_Xs16_Ys16_Ws16 10.00000 InjMassInj 0.00 10.00000 FORMAT "%8.5" EXTENDED_LIMITS -327.6800 327.6700
 /begin AXIS_DESCR STD_AXIS Eng_nAvrg EngN 16 0.00 6000.000 FORMAT "%8.3" EXTENDED_LIMITS -32768.00 32767.00 DEPOSIT ABSOLUTE /end AXIS_DESCR
 /begin AXIS_DESCR STD_AXIS InjCtl_qSetUnBal InjMassCyc 16 0.00 327.6700 FORMAT "%8.4" EXTENDED_LIMITS -327.6800 327.6700 DEPOSIT ABSOLUTE /end AXIS_DESCR
/end CHARACTERISTIC
/begin CHARACTERISTIC InjCrv_qPoI2DesAdd_Vector "Bypass-Label für additiven Bypass von InjCrv_qPoI2Des (Nicht verstellen!)" VALUE 0xC311E Kw_Wu8 255.0 OneToOne 0.00 255.0 FORMAT "%5.1" /end CHARACTERISTIC
/begin CHARACTERISTIC InjCrv_qPoI2DesAdd_Channel "Konfigurationslabel für additive Bypass message" VALUE 0xC311F Kw_Wu8 255.0 OneToOne 0.00 255.0 FORMAT "%5.1" /end CHARACTERISTIC
/begin CHARACTERISTIC InjCrv_qPoI2EffAdd_Vector "Bypass-label für additiven Bypass InjCrv_qPoI2Eff (nicht verstellen!)" VALUE 0xC3120 Kw_Wu8 255.0 OneToOne 0.00 255.0 FORMAT "%5.1" /end CHARACTERISTIC
/begin CHARACTERISTIC InjCrv_qPoI2EffAdd_Channel "Bypass-label für additiven Bypass  InjCrv_qPoI2Eff (nicht verstellen!)" VALUE 0xC3121 Kw_Wu8 255.0 OneToOne 0.00 255.0 FORMAT "%5.1" /end CHARACTERISTIC
/begin CHARACTERISTIC InjCrv_qPoI2Eff_Vector "#SSD Bypass-Label, nicht editieren !" VALUE 0xC3122 Kw_Wu8 255.0 OneToOne 0.00 255.0 FORMAT "%5.1" /end CHARACTERISTIC
/begin CHARACTERISTIC InjCrv_qPoI2Eff_Channel "#SSD Bypass-Label, nicht editieren !" VALUE 0xC3123 Kw_Wu8 255.0 OneToOne 0.00 255.0 FORMAT "%5.1" /end CHARACTERISTIC
/begin CHARACTERISTIC InjCrv_qPoI2ETSCor_MAP "motortemperaturabhängiges Mengenkorrekturkennfeld für PoI2" MAP 0xE1CF0 Kf_Xs16_Ys16_Ws16 10.00000 InjMassInj 0.00 10.00000 FORMAT "%8.5" EXTENDED_LIMITS -327.6800 327.6700
 /begin AXIS_DESCR STD_AXIS Eng_nAvrg EngN 7 0.00 6000.000 FORMAT "%8.3" EXTENDED_LIMITS -32768.00 32767.00 DEPOSIT ABSOLUTE /end AXIS_DESCR
 /begin AXIS_DESCR STD_AXIS InjCtl_qSetUnBal InjMassCyc 6 0.00 327.6700 FORMAT "%8.4" EXTENDED_LIMITS -327.6800 327.6700 DEPOSIT ABSOLUTE /end AXIS_DESCR
/end CHARACTERISTIC
/begin CHARACTERISTIC InjCrv_qPoI2Rgn1_MAP "regeneration1 map of PoI2 injection quantity" MAP 0xE26C4 Kf_Xs16_Ys16_Ws16 10.00000 InjMassInj 0.00 10.00000 FORMAT "%8.5" EXTENDED_LIMITS -327.6800 327.6700
 /begin AXIS_DESCR STD_AXIS Eng_nAvrg EngN 16 0.00 6000.000 FORMAT "%8.3" EXTENDED_LIMITS -32768.00 32767.00 DEPOSIT ABSOLUTE /end AXIS_DESCR
 /begin AXIS_DESCR STD_AXIS InjCtl_qSetUnBal InjMassCyc 16 0.00 327.6700 FORMAT "%8.4" EXTENDED_LIMITS -327.6800 327.6700 DEPOSIT ABSOLUTE /end AXIS_DESCR
/end CHARACTERISTIC
/begin CHARACTERISTIC InjCrv_qPoI2Rgn2_MAP "regeneration2 map of PoI2 injection quantity" MAP 0xE2908 Kf_Xs16_Ys16_Ws16 10.00000 InjMassInj 0.00 10.00000 FORMAT "%8.5" EXTENDED_LIMITS -327.6800 327.6700
 /begin AXIS_DESCR STD_AXIS Eng_nAvrg EngN 16 0.00 6000.000 FORMAT "%8.3" EXTENDED_LIMITS -32768.00 32767.00 DEPOSIT ABSOLUTE /end AXIS_DESCR
 /begin AXIS_DESCR STD_AXIS InjCtl_qSetUnBal InjMassCyc 16 0.00 327.6700 FORMAT "%8.4" EXTENDED_LIMITS -327.6800 327.6700 DEPOSIT ABSOLUTE /end AXIS_DESCR
/end CHARACTERISTIC
/begin CHARACTERISTIC InjCrv_qPoI2RgnAdd_Vector "Konfigurationslabel für Bypass Freischnitt" VALUE 0xC3112 Kw_Wu8 255.0 OneToOne 0.00 255.0 FORMAT "%5.1" /end CHARACTERISTIC
/begin CHARACTERISTIC InjCrv_qPoI2RgnAdd_Channel "Konfigurationslabel für Bypass Freischnitt" VALUE 0xC3113 Kw_Wu8 255.0 OneToOne 0.00 255.0 FORMAT "%5.1" /end CHARACTERISTIC
/begin CHARACTERISTIC InjCrv_qPoI2RgnCor_MAP "regeneration map of PoI2 injection quantity correction" MAP 0xE1FBA Kf_Xs16_Ys16_Ws16 10.00000 InjMassInj 0.00 10.00000 FORMAT "%8.5" EXTENDED_LIMITS -327.6800 327.6700
 /begin AXIS_DESCR STD_AXIS Eng_nAvrg EngN 2 0.00 6000.000 FORMAT "%8.3" EXTENDED_LIMITS -32768.00 32767.00 DEPOSIT ABSOLUTE /end AXIS_DESCR
 /begin AXIS_DESCR STD_AXIS InjCtl_qSetUnBal InjMassCyc 2 0.00 327.6700 FORMAT "%8.4" EXTENDED_LIMITS -327.6800 327.6700 DEPOSIT ABSOLUTE /end AXIS_DESCR
/end CHARACTERISTIC
/begin CHARACTERISTIC InjCrv_qPoI2Rgn_Vector "#SSD Bypass-Label, nicht editieren !" VALUE 0xC3114 Kw_Wu8 255.0 OneToOne 0.00 255.0 FORMAT "%5.1" /end CHARACTERISTIC
/begin CHARACTERISTIC InjCrv_qPoI2Rgn_Channel "#SSD Bypass-Label, nicht editieren !" VALUE 0xC3115 Kw_Wu8 255.0 OneToOne 0.00 255.0 FORMAT "%5.1" /end CHARACTERISTIC
/begin CHARACTERISTIC InjCrv_qPoI2SetLim_C "Threshold injection quantity" VALUE 0xE254E Kw_Ws16 327.6700 InjMassInj 0.00 327.6700 FORMAT "%8.4" EXTENDED_LIMITS -327.6800 327.6700 /end CHARACTERISTIC
/begin CHARACTERISTIC InjCrv_qPoI2Des_Vector "#SSD Bypass-Label für InjCrv_qPoI2Des (Nicht verstellen!)" VALUE 0xC3124 Kw_Wu8 255.0 OneToOne 0.00 255.0 FORMAT "%5.1" /end CHARACTERISTIC
/begin CHARACTERISTIC InjCrv_qPoI2Des_Channel "#SSD Bypass-Label für InjCrv_qPoI2Des (Nicht verstellen!)" VALUE 0xC3125 Kw_Wu8 255.0 OneToOne 0.00 255.0 FORMAT "%5.1" /end CHARACTERISTIC
/begin CHARACTERISTIC InjCrv_stPiI1RgnMsk_C "Maske zur Aktivierung  der Regeneration über PiI1" VALUE 0xE1534 Kw_Wu32 4294967295.00 OneToOne 0.00 4294967295.00 FORMAT "%13.2" /end CHARACTERISTIC
/begin CHARACTERISTIC InjCrv_stPoI1RgnMsk_C "Bitmaske für Aktivierung  des Regenerationsmodes PoI1" VALUE 0xE1BC8 Kw_Wu32 4294967295.00 OneToOne 0.00 4294967295.00 FORMAT "%13.2" /end CHARACTERISTIC
/begin CHARACTERISTIC InjCrv_stPoI1RgnTypeMsk_C "Bitmask to activate switching to regeneration mode" VALUE 0xE1BCC Kw_Wu32 4294967295.00 OneToOne 0.00 4294967295.00 FORMAT "%13.2" /end CHARACTERISTIC
/begin CHARACTERISTIC InjCrv_stPoI2RgnDelMsk_C "Maske für die Deaktivierung der PoI2 Grundwerteberechnung im Regenerationsbetrieb" VALUE 0xE2550 Kw_Wu32 4294967295.00 OneToOne 0.00 4294967295.00 FORMAT "%13.2" /end CHARACTERISTIC
/begin CHARACTERISTIC InjCrv_stPoI2RgnEffMsk_C "Bitmask for activate PoI2 in regeneration mode" VALUE 0xE2FEC Kw_Wu32 4294967295.00 OneToOne 0.00 4294967295.00 FORMAT "%13.2" /end CHARACTERISTIC
/begin CHARACTERISTIC InjCrv_stPoI2RgnMsk_C "Maske zur Aktivierung der Regeneration über PoI2" VALUE 0xE2FF0 Kw_Wu32 4294967295.00 OneToOne 0.00 4294967295.00 FORMAT "%13.2" /end CHARACTERISTIC
/begin CHARACTERISTIC InjCrv_stPoI2RgnTypeMsk_C "Bitmask for activate PoI2 in regeneration mode" VALUE 0xE2FF4 Kw_Wu32 4294967295.00 OneToOne 0.00 4294967295.00 FORMAT "%13.2" /end CHARACTERISTIC
/begin CHARACTERISTIC InjCrv_swtPoI1Clsn_C "Bit0: 1=Kollisionserkennung ein, 0=aus; Bit1:1=PoI1 aus, 0=aus bei Kollision; Bit2:1=Verteile fehlende mänge auf zylinder, 0=aus" VALUE 0xE15FC Kw_Wu8 255.0 OneToOne 0.00 255.0 FORMAT "%5.1" /end CHARACTERISTIC
/begin CHARACTERISTIC InjCrv_tiPiI1DesAdd_Vector "#SSD Bypass-Label für additiven Bypass von InjCrv_tiPiI1Des (Nicht verstellen!)" VALUE 0xC30E6 Kw_Wu8 255.0 OneToOne 0.00 255.0 FORMAT "%5.1" /end CHARACTERISTIC
/begin CHARACTERISTIC InjCrv_tiPiI1DesAdd_Channel "#SSD Bypass-Label für additiven Bypass von InjCrv_tiPiI1Des (Nicht verstellen!)" VALUE 0xC30E7 Kw_Wu8 255.0 OneToOne 0.00 255.0 FORMAT "%5.1" /end CHARACTERISTIC
/begin CHARACTERISTIC InjCrv_tiPiI1Des_Vector "#SSD Bypass-Label für InjCrv_tiPiI1Des (Nicht verstellen!)" VALUE 0xC30E8 Kw_Wu8 255.0 OneToOne 0.00 255.0 FORMAT "%5.1" /end CHARACTERISTIC
/begin CHARACTERISTIC InjCrv_tiPiI1Des_Channel "#SSD Bypass-Label für InjCrv_tiPiI1Des (Nicht verstellen!)" VALUE 0xC30E9 Kw_Wu8 255.0 OneToOne 0.00 255.0 FORMAT "%5.1" /end CHARACTERISTIC
/begin CHARACTERISTIC InjCrv_tiPiI1ETSCor12_MAP "motortemperaturabhängiges Korrekturgrundwertekennfeld für die Zeitkomponente des Ansteuerbeginns der PiI1bei aktiver PiI2" MAP 0xE068A Kf_Xs16_Ys16_Ws16 26000.00 InjTime_us -13000.00 13000.00 FORMAT "%8.2" EXTENDED_LIMITS -32768.00 32767.00
 /begin AXIS_DESCR STD_AXIS Eng_nAvrg EngN 10 0.00 6000.000 FORMAT "%8.3" EXTENDED_LIMITS -32768.00 32767.00 DEPOSIT ABSOLUTE /end AXIS_DESCR
 /begin AXIS_DESCR STD_AXIS InjCtl_qSetUnBal InjMassCyc 10 0.00 327.6700 FORMAT "%8.4" EXTENDED_LIMITS -327.6800 327.6700 DEPOSIT ABSOLUTE /end AXIS_DESCR
/end CHARACTERISTIC
/begin CHARACTERISTIC InjCrv_tiPiI1ETSCor1_MAP "motortemperaturabhängiges Korrekturgrundwertekennfeld -1 für die Zeitkomponente Ansteuerbeginn PiI1" MAP 0xE077E Kf_Xs16_Ys16_Ws16 26000.00 InjTime_us -13000.00 13000.00 FORMAT "%8.2" EXTENDED_LIMITS -32768.00 32767.00
 /begin AXIS_DESCR STD_AXIS Eng_nAvrg EngN 16 0.00 6000.000 FORMAT "%8.3" EXTENDED_LIMITS -32768.00 32767.00 DEPOSIT ABSOLUTE /end AXIS_DESCR
 /begin AXIS_DESCR STD_AXIS InjCtl_qSetUnBal InjMassCyc 16 0.00 327.6700 FORMAT "%8.4" EXTENDED_LIMITS -327.6800 327.6700 DEPOSIT ABSOLUTE /end AXIS_DESCR
/end CHARACTERISTIC
/begin CHARACTERISTIC InjCrv_tiPiI1ETSCor2_MAP "motortemperaturabhängiges Korrekturgrundwertekennfeld -2 für die Zeitkomponente Ansteuerbeginn PiI1" MAP 0xE09C2 Kf_Xs16_Ys16_Ws16 26000.00 InjTime_us -13000.00 13000.00 FORMAT "%8.2" EXTENDED_LIMITS -32768.00 32767.00
 /begin AXIS_DESCR STD_AXIS Eng_nAvrg EngN 16 0.00 6000.000 FORMAT "%8.3" EXTENDED_LIMITS -32768.00 32767.00 DEPOSIT ABSOLUTE /end AXIS_DESCR
 /begin AXIS_DESCR STD_AXIS InjCtl_qSetUnBal InjMassCyc 16 0.00 327.6700 FORMAT "%8.4" EXTENDED_LIMITS -327.6800 327.6700 DEPOSIT ABSOLUTE /end AXIS_DESCR
/end CHARACTERISTIC
/begin CHARACTERISTIC InjCrv_tiPiI1ETSCorStrt_MAP "base correction map for time-component of SOE of PiI1" MAP 0xE0C06 Kf_Xs16_Ys16_Ws16 26000.00 InjTime_us -13000.00 13000.00 FORMAT "%8.2" EXTENDED_LIMITS -32768.00 32767.00
 /begin AXIS_DESCR STD_AXIS Eng_nAvrg EngN 16 0.00 6000.000 FORMAT "%8.3" EXTENDED_LIMITS -32768.00 32767.00 DEPOSIT ABSOLUTE /end AXIS_DESCR
 /begin AXIS_DESCR STD_AXIS InjCtl_qSetUnBal InjMassCyc 16 0.00 327.6700 FORMAT "%8.4" EXTENDED_LIMITS -327.6800 327.6700 DEPOSIT ABSOLUTE /end AXIS_DESCR
/end CHARACTERISTIC
/begin CHARACTERISTIC InjCrv_tiPiI1ETSCor_MAP "motortemperaturabhängiger Korrekturgrundwertekennfeld für die Zeitkomponente des Ansteuerbeginns der PiI1" MAP 0xE0E4A Kf_Xs16_Ys16_Ws16 26000.00 InjTime_us -13000.00 13000.00 FORMAT "%8.2" EXTENDED_LIMITS -32768.00 32767.00
 /begin AXIS_DESCR STD_AXIS Eng_nAvrg EngN 16 0.00 6000.000 FORMAT "%8.3" EXTENDED_LIMITS -32768.00 32767.00 DEPOSIT ABSOLUTE /end AXIS_DESCR
 /begin AXIS_DESCR STD_AXIS InjCtl_qSetUnBal InjMassCyc 16 0.00 327.6700 FORMAT "%8.4" EXTENDED_LIMITS -327.6800 327.6700 DEPOSIT ABSOLUTE /end AXIS_DESCR
/end CHARACTERISTIC
/begin CHARACTERISTIC InjCrv_tiPiI1RgnAdd_Vector "Bypass-Label für InjCrv_tiPiI1RgnAdd_Vector (Nicht verstellen!)" VALUE 0xC30F6 Kw_Wu8 255.0 OneToOne 0.00 255.0 FORMAT "%5.1" /end CHARACTERISTIC
/begin CHARACTERISTIC InjCrv_tiPiI1RgnAdd_Channel "Bypass-Label für InjCrv_tiPiI1RgnAdd_Channel (Nicht verstellen!)" VALUE 0xC30F7 Kw_Wu8 255.0 OneToOne 0.00 255.0 FORMAT "%5.1" /end CHARACTERISTIC
/begin CHARACTERISTIC InjCrv_tiPiI1Rgn_MAP "base map of PiI1 SOE time-component calculation" MAP 0xE12E6 Kf_Xs16_Ys16_Ws16 13000.00 InjTime_us 0.00 13000.00 FORMAT "%8.2" EXTENDED_LIMITS -32768.00 32767.00
 /begin AXIS_DESCR STD_AXIS Eng_nAvrg EngN 16 0.00 6000.000 FORMAT "%8.3" EXTENDED_LIMITS -32768.00 32767.00 DEPOSIT ABSOLUTE /end AXIS_DESCR
 /begin AXIS_DESCR STD_AXIS InjCtl_qSetUnBal InjMassCyc 16 0.00 327.6700 FORMAT "%8.4" EXTENDED_LIMITS -327.6800 327.6700 DEPOSIT ABSOLUTE /end AXIS_DESCR
/end CHARACTERISTIC
/begin CHARACTERISTIC InjCrv_tiPiI1Rgn_Vector "#SSD Bypass-Label, nicht editieren !" VALUE 0xC30F8 Kw_Wu8 255.0 OneToOne 0.00 255.0 FORMAT "%5.1" /end CHARACTERISTIC
/begin CHARACTERISTIC InjCrv_tiPiI1Rgn_Channel "#SSD Bypass-Label, nicht editieren !" VALUE 0xC30F9 Kw_Wu8 255.0 OneToOne 0.00 255.0 FORMAT "%5.1" /end CHARACTERISTIC
/begin CHARACTERISTIC InjCrv_tiPiI2DesAdd_Vector "#SSD Bypass-Label für additiven Bypass von InjCrv_tiPiI2Des (Nicht verstellen!)" VALUE 0xC30EA Kw_Wu8 255.0 OneToOne 0.00 255.0 FORMAT "%5.1" /end CHARACTERISTIC
/begin CHARACTERISTIC InjCrv_tiPiI2DesAdd_Channel "#SSD Bypass-Label für additiven Bypass von InjCrv_tiPiI2Des (Nicht verstellen!)" VALUE 0xC30EB Kw_Wu8 255.0 OneToOne 0.00 255.0 FORMAT "%5.1" /end CHARACTERISTIC
/begin CHARACTERISTIC InjCrv_tiPiI2Des_Vector "#SSD Bypass-Label für InjCrv_tiPiI2Des (Nicht verstellen!)" VALUE 0xC30EC Kw_Wu8 255.0 OneToOne 0.00 255.0 FORMAT "%5.1" /end CHARACTERISTIC
/begin CHARACTERISTIC InjCrv_tiPiI2Des_Channel "#SSD Bypass-Label für InjCrv_tiPiI2Des (Nicht verstellen!)" VALUE 0xC30ED Kw_Wu8 255.0 OneToOne 0.00 255.0 FORMAT "%5.1" /end CHARACTERISTIC
/begin CHARACTERISTIC InjCrv_tiPoI2Add_Vector "Bypass-label für additiven Bypass InjCrv_tiPoI2 (nicht verstellen !)" VALUE 0xC3126 Kw_Wu8 255.0 OneToOne 0.00 255.0 FORMAT "%5.1" /end CHARACTERISTIC
/begin CHARACTERISTIC InjCrv_tiPoI2Add_Channel "Bypass-label für additiven Bypass InjCrv_tiPoI2 (nicht verstellen !)" VALUE 0xC3127 Kw_Wu8 255.0 OneToOne 0.00 255.0 FORMAT "%5.1" /end CHARACTERISTIC
/begin CHARACTERISTIC InjCrv_tiPoI2ATSCor_MAP "kundenspez. ansauglufttemperaturabhängiger Korrekturgrundwert für die Zeitkomponente des Ansteuerbeginns der PoI2" MAP 0xE208C Kf_Xs16_Ys16_Ws16 26000.00 InjTime_us -13000.00 13000.00 FORMAT "%8.2" EXTENDED_LIMITS -32768.00 32767.00
 /begin AXIS_DESCR STD_AXIS Eng_nAvrg EngN 12 0.00 6000.000 FORMAT "%8.3" EXTENDED_LIMITS -32768.00 32767.00 DEPOSIT ABSOLUTE /end AXIS_DESCR
 /begin AXIS_DESCR STD_AXIS InjCtl_qSetUnBal InjMassCyc 8 0.00 327.6700 FORMAT "%8.4" EXTENDED_LIMITS -327.6800 327.6700 DEPOSIT ABSOLUTE /end AXIS_DESCR
/end CHARACTERISTIC
/begin CHARACTERISTIC InjCrv_tiPoI2Bas_MAP "Zeitkomponente Ansteuerbeginn Grundwert PoI2" MAP 0xE31AC Kf_Xs16_Ys16_Ws16 18000.00 InjTime_us -13000.00 5000.00 FORMAT "%8.2" EXTENDED_LIMITS -32768.00 32767.00
 /begin AXIS_DESCR STD_AXIS Eng_nAvrg EngN 16 0.00 6000.000 FORMAT "%8.3" EXTENDED_LIMITS -32768.00 32767.00 DEPOSIT ABSOLUTE /end AXIS_DESCR
 /begin AXIS_DESCR STD_AXIS InjCtl_qSetUnBal InjMassCyc 16 0.00 327.6700 FORMAT "%8.4" EXTENDED_LIMITS -327.6800 327.6700 DEPOSIT ABSOLUTE /end AXIS_DESCR
/end CHARACTERISTIC
/begin CHARACTERISTIC InjCrv_tiPoI2ETSCor_MAP "motortemperaturabhängiger Korrekturgrundwertekennfeld für die Zeitkomponente des Ansteuerbeginns der PoI2" MAP 0xE2178 Kf_Xs16_Ys16_Ws16 26000.00 InjTime_us -13000.00 13000.00 FORMAT "%8.2" EXTENDED_LIMITS -32768.00 32767.00
 /begin AXIS_DESCR STD_AXIS Eng_nAvrg EngN 12 0.00 6000.000 FORMAT "%8.3" EXTENDED_LIMITS -32768.00 32767.00 DEPOSIT ABSOLUTE /end AXIS_DESCR
 /begin AXIS_DESCR STD_AXIS InjCtl_qSetUnBal InjMassCyc 8 0.00 327.6700 FORMAT "%8.4" EXTENDED_LIMITS -327.6800 327.6700 DEPOSIT ABSOLUTE /end AXIS_DESCR
/end CHARACTERISTIC
/begin CHARACTERISTIC InjCrv_tiPoI2Max_MAP "#SSD maximaler Ansteuerbeginn PoI2 relativ zur Haupteinspritzung" MAP 0xE3062 Kf_Xs16_Ys16_Ws16 18000.00 InjTime_us -13000.00 5000.00 FORMAT "%8.2" EXTENDED_LIMITS -32768.00 32767.00
 /begin AXIS_DESCR STD_AXIS RailCD_pPeak Pres_Rail 8 0.00 2000.000 FORMAT "%5.3" EXTENDED_LIMITS -3276.800 3276.700 DEPOSIT ABSOLUTE /end AXIS_DESCR
 /begin AXIS_DESCR STD_AXIS InjCrv_qMI1Des InjMassInj 16 0.00 327.6700 FORMAT "%8.4" EXTENDED_LIMITS -327.6800 327.6700 DEPOSIT ABSOLUTE /end AXIS_DESCR
/end CHARACTERISTIC
/begin CHARACTERISTIC InjCrv_tiPoI2Min_C "#SSD physikalisch bedingter minimaler Ansteuerbeginn PoI2" VALUE 0xE3196 Kw_Ws16 18000.00 InjTime_us -13000.00 5000.00 FORMAT "%8.2" EXTENDED_LIMITS -32768.00 32767.00 /end CHARACTERISTIC
/begin CHARACTERISTIC InjCrv_tiPoI2Rgn1_MAP "regeneration1 map of PoI2 SOE time component" MAP 0xE2B4C Kf_Xs16_Ys16_Ws16 18000.00 InjTime_us -13000.00 5000.00 FORMAT "%8.2" EXTENDED_LIMITS -32768.00 32767.00
 /begin AXIS_DESCR STD_AXIS Eng_nAvrg EngN 16 0.00 6000.000 FORMAT "%8.3" EXTENDED_LIMITS -32768.00 32767.00 DEPOSIT ABSOLUTE /end AXIS_DESCR
 /begin AXIS_DESCR STD_AXIS InjCtl_qSetUnBal InjMassCyc 16 0.00 327.6700 FORMAT "%8.4" EXTENDED_LIMITS -327.6800 327.6700 DEPOSIT ABSOLUTE /end AXIS_DESCR
/end CHARACTERISTIC
/begin CHARACTERISTIC InjCrv_tiPoI2Rgn2_MAP "regeneration2 map of PoI2 SOE time component" MAP 0xE2D90 Kf_Xs16_Ys16_Ws16 18000.00 InjTime_us -13000.00 5000.00 FORMAT "%8.2" EXTENDED_LIMITS -32768.00 32767.00
 /begin AXIS_DESCR STD_AXIS Eng_nAvrg EngN 16 0.00 6000.000 FORMAT "%8.3" EXTENDED_LIMITS -32768.00 32767.00 DEPOSIT ABSOLUTE /end AXIS_DESCR
 /begin AXIS_DESCR STD_AXIS InjCtl_qSetUnBal InjMassCyc 16 0.00 327.6700 FORMAT "%8.4" EXTENDED_LIMITS -327.6800 327.6700 DEPOSIT ABSOLUTE /end AXIS_DESCR
/end CHARACTERISTIC
/begin CHARACTERISTIC InjCrv_tiPoI2RgnAdd_Vector "Bypass-Label für  (Nicht verstellen!)" VALUE 0xC3116 Kw_Wu8 255.0 OneToOne 0.00 255.0 FORMAT "%5.1" /end CHARACTERISTIC
/begin CHARACTERISTIC InjCrv_tiPoI2RgnAdd_Channel "Bypass-Label für InjCrv_tiPoI2RgnAdd_Channel (Nicht verstellen!)" VALUE 0xC3117 Kw_Wu8 255.0 OneToOne 0.00 255.0 FORMAT "%5.1" /end CHARACTERISTIC
/begin CHARACTERISTIC InjCrv_tiPoI2RgnCor_MAP "base map of PoI2 SOE time-component calculation" MAP 0xE1FCE Kf_Xs16_Ys16_Ws16 13000.00 InjTime_us 0.00 13000.00 FORMAT "%8.2" EXTENDED_LIMITS -32768.00 32767.00
 /begin AXIS_DESCR STD_AXIS Eng_nAvrg EngN 2 0.00 6000.000 FORMAT "%8.3" EXTENDED_LIMITS -32768.00 32767.00 DEPOSIT ABSOLUTE /end AXIS_DESCR
 /begin AXIS_DESCR STD_AXIS InjCtl_qSetUnBal InjMassCyc 2 0.00 327.6700 FORMAT "%8.4" EXTENDED_LIMITS -327.6800 327.6700 DEPOSIT ABSOLUTE /end AXIS_DESCR
/end CHARACTERISTIC
/begin CHARACTERISTIC InjCrv_tiPoI2Rgn_Vector "#SSD Bypass-Label, nicht editieren !" VALUE 0xC3118 Kw_Wu8 255.0 OneToOne 0.00 255.0 FORMAT "%5.1" /end CHARACTERISTIC
/begin CHARACTERISTIC InjCrv_tiPoI2Rgn_Channel "#SSD Bypass-Label, nicht editieren !" VALUE 0xC3119 Kw_Wu8 255.0 OneToOne 0.00 255.0 FORMAT "%5.1" /end CHARACTERISTIC
/begin CHARACTERISTIC InjCrv_tiPoI2_Vector "#SSD Bypass-Label, nicht editieren !" VALUE 0xC3128 Kw_Wu8 255.0 OneToOne 0.00 255.0 FORMAT "%5.1" /end CHARACTERISTIC
/begin CHARACTERISTIC InjCrv_tiPoI2_Channel "#SSD Bypass-Label, nicht editieren !" VALUE 0xC3129 Kw_Wu8 255.0 OneToOne 0.00 255.0 FORMAT "%5.1" /end CHARACTERISTIC
/begin CHARACTERISTIC InjCtl_dqLimUp_C "Rampensteigung bei Wegfall des Systemfehlers" VALUE 0xE352C Kw_Wu32 655359.999847 RmpInjMass 0.00 655359.999847 FORMAT "%13.6" /end CHARACTERISTIC
/begin CHARACTERISTIC InjCtl_dqLimDwn_C "Rampensteigung bei Auftreten eines Systemfehlers" VALUE 0xE3530 Kw_Wu32 655359.999847 RmpInjMass 0.00 655359.999847 FORMAT "%13.6" /end CHARACTERISTIC
/begin CHARACTERISTIC InjCtl_facAdjSrvMax_C "Maximalwert für Serviceabgleichfaktor" VALUE 0xE3434 Kw_Ws16 3.000000 Fact 0.00 3.000000 FORMAT "%8.6" EXTENDED_LIMITS -4.000000 3.999878 /end CHARACTERISTIC
/begin CHARACTERISTIC InjCtl_facAdjSrvMin_C "Minimalwert für Serviceabgleichfaktor" VALUE 0xE3436 Kw_Ws16 3.000000 Fact 0.00 3.000000 FORMAT "%8.6" EXTENDED_LIMITS -4.000000 3.999878 /end CHARACTERISTIC
/begin CHARACTERISTIC InjCtl_facAdjSrvUnlimDfl_C "Vorgabewert für Serviceabgleichfaktor" VALUE 0xE3438 Kw_Ws16 3.000000 Fact 0.00 3.000000 FORMAT "%8.6" EXTENDED_LIMITS -4.000000 3.999878 /end CHARACTERISTIC
/begin CHARACTERISTIC InjCtl_qAdjQntMax_C "Maximalwert für Mengenabgleich" VALUE 0xE343A Kw_Ws16 327.6700 InjMassCyc 0.00 327.6700 FORMAT "%8.4" EXTENDED_LIMITS -327.6800 327.6700 /end CHARACTERISTIC
/begin CHARACTERISTIC InjCtl_qAdjQntMin_C "Minimalwert für Mengenabgleich" VALUE 0xE343C Kw_Ws16 327.6700 InjMassCyc 0.00 327.6700 FORMAT "%8.4" EXTENDED_LIMITS -327.6800 327.6700 /end CHARACTERISTIC
/begin CHARACTERISTIC InjCtl_qAdjQnt_MAP "Neutralkennfeld für Mengenabgleich" MAP 0xE343E Kf_Xs16_Ys16_Ws16 327.6700 InjMassCyc 0.00 327.6700 FORMAT "%8.4" EXTENDED_LIMITS -327.6800 327.6700
 /begin AXIS_DESCR STD_AXIS Eng_nAvrg EngN 8 0.00 6000.000 FORMAT "%8.3" EXTENDED_LIMITS -32768.00 32767.00 DEPOSIT ABSOLUTE /end AXIS_DESCR
 /begin AXIS_DESCR STD_AXIS InjCtl_qSetUnCor_mp InjMassCyc 6 0.00 327.6700 FORMAT "%8.4" EXTENDED_LIMITS -327.6800 327.6700 DEPOSIT ABSOLUTE /end AXIS_DESCR
/end CHARACTERISTIC
/begin CHARACTERISTIC InjCtl_t1DT1SetUnBal_C "Totzeit für Kraftstoffmasse DT1 filter" VALUE 0xE34C0 Kw_Wu32 4294.9673 TimeDelay_s 0.0000010000000 4294.9673 FORMAT "%9.4" /end CHARACTERISTIC
/begin CHARACTERISTIC InjCtl_kdDT1SetUnBal_C "Verstärkungskonstante des DT1 filters für Kraftstoffmasse ohne FBC" VALUE 0xE34C4 Kw_Ws32 32767.9999847 Kd 0.00 32767.9999847 FORMAT "%13.7" EXTENDED_LIMITS -32768.0000000 32767.9999847 /end CHARACTERISTIC
/begin CHARACTERISTIC InjCtl_qCurr_Vector "#SSD Bypass-Label für InjCtl_qCurr (Nicht verstellen!)" VALUE 0xC312A Kw_Wu8 255.0 OneToOne 0.00 255.0 FORMAT "%5.1" /end CHARACTERISTIC
/begin CHARACTERISTIC InjCtl_qCurr_Channel "#SSD Bypass Label, nicht ändern!" VALUE 0xC312B Kw_Wu8 255.0 OneToOne 0.00 255.0 FORMAT "%5.1" /end CHARACTERISTIC
/begin CHARACTERISTIC InjCtl_qDriftComp_MAP "Kennfeld für Mengendriftkompensation" MAP 0xE34C8 Kf_Xs16_Ys16_Ws16 327.6700 InjMassCyc 0.00 327.6700 FORMAT "%8.4" EXTENDED_LIMITS -327.6800 327.6700
 /begin AXIS_DESCR STD_AXIS InjCtl_qSetUnBal InjMassCyc 8 0.00 327.6700 FORMAT "%8.4" EXTENDED_LIMITS -327.6800 327.6700 DEPOSIT ABSOLUTE /end AXIS_DESCR
 /begin AXIS_DESCR STD_AXIS InjCtl_tiEngOn_mp TimeEngOnHrs 4 0.00 596497.0 FORMAT "%8.1" EXTENDED_LIMITS -596515.2 596497.0 DEPOSIT ABSOLUTE /end AXIS_DESCR
/end CHARACTERISTIC
/begin CHARACTERISTIC InjCtl_qDriftMax2_C "Mengendriftkompensationsbegrenzung (Datensatz)" VALUE 0xE3524 Kw_Ws16 327.6700 InjMassCyc 0.00 327.6700 FORMAT "%8.4" EXTENDED_LIMITS -327.6800 327.6700 /end CHARACTERISTIC
/begin CHARACTERISTIC InjCtl_qDriftMin2_C "Mengendriftkompensationsbegrenzung (Datensatz)" VALUE 0xE3526 Kw_Ws16 327.6700 InjMassCyc 0.00 327.6700 FORMAT "%8.4" EXTENDED_LIMITS -327.6800 327.6700 /end CHARACTERISTIC
/begin CHARACTERISTIC InjCtl_qLimErr_CUR "#SSD Begrenzungsmeneg bei Systemfehler" CURVE 0xE3534 Kl_Xs16_Ws16 327.6700 InjMass 0.00 327.6700 FORMAT "%8.4" EXTENDED_LIMITS -327.6800 327.6700
 /begin AXIS_DESCR STD_AXIS Eng_nAvrg EngN 21 0.00 6000.000 FORMAT "%8.3" EXTENDED_LIMITS -32768.00 32767.00 DEPOSIT ABSOLUTE /end AXIS_DESCR
/end CHARACTERISTIC
/begin CHARACTERISTIC InjCtl_qLimErr_MAP "#SSD Limitierungsmoment bei Systemfehler" MAP 0xE358A Kf_Xs16_Ys16_Ws16 327.6700 InjMass 0.00 327.6700 FORMAT "%8.4" EXTENDED_LIMITS -327.6800 327.6700
 /begin AXIS_DESCR STD_AXIS Eng_nAvrg EngN 12 0.00 6000.000 FORMAT "%8.3" EXTENDED_LIMITS -32768.00 32767.00 DEPOSIT ABSOLUTE /end AXIS_DESCR
 /begin AXIS_DESCR STD_AXIS FTSCD_tFuel Temp_Cels 5 -50.14000 199.8600 FORMAT "%8.4" EXTENDED_LIMITS -3549.940 3003.560 DEPOSIT ABSOLUTE /end AXIS_DESCR
/end CHARACTERISTIC
/begin CHARACTERISTIC InjCtl_qLimSoftShOff_CUR "limitation value in case of soft shutoff" CURVE 0xE3628 Kl_Xs16_Ws16 327.6700 InjMass 0.00 327.6700 FORMAT "%8.4" EXTENDED_LIMITS -327.6800 327.6700
 /begin AXIS_DESCR STD_AXIS Eng_nAvrg EngN 16 0.00 6000.000 FORMAT "%8.3" EXTENDED_LIMITS -32768.00 32767.00 DEPOSIT ABSOLUTE /end AXIS_DESCR
/end CHARACTERISTIC
/begin CHARACTERISTIC InjCtl_qRaw_Vector "#SSD Bypass-Label für InjCtl_qRaw (Nicht verstellen!)" VALUE 0xC312C Kw_Wu8 255.0 OneToOne 0.00 255.0 FORMAT "%5.1" /end CHARACTERISTIC
/begin CHARACTERISTIC InjCtl_qRaw_Channel "#SSD Bypass-Label für InjCtl_qRaw, nicht editieren!" VALUE 0xC312D Kw_Wu8 255.0 OneToOne 0.00 255.0 FORMAT "%5.1" /end CHARACTERISTIC
/begin CHARACTERISTIC InjCtl_qSet_Vector "#SSD Bypass-Label für InjCtl_qSet (Nicht verstellen!)" VALUE 0xC312E Kw_Wu8 255.0 OneToOne 0.00 255.0 FORMAT "%5.1" /end CHARACTERISTIC
/begin CHARACTERISTIC InjCtl_qSet_Channel "#SSD Bypass-Label für InjCtl_qSet, nicht editieren !" VALUE 0xC312F Kw_Wu8 255.0 OneToOne 0.00 255.0 FORMAT "%5.1" /end CHARACTERISTIC
/begin CHARACTERISTIC InjCtl_swtFMACor_C "Schalter für FMA Korrektur (1: indirekte Korrektion ist aktiev, 0: inaktiev)" VALUE 0xE3528 Kw_Wu8 1.000 OneToOne 0.00 1.000 FORMAT "%5.3" EXTENDED_LIMITS 0.00 255.0 /end CHARACTERISTIC
/begin CHARACTERISTIC InjUn_nInjLock_C "#SSD Kein Berechnung der Einspritzungen solange Überprüfung der Synchronisation nicht abgeschlossen" VALUE 0xC061C Kw_Ws16 8000.000 EngN 0.00 8000.000 FORMAT "%8.3" EXTENDED_LIMITS -32768.00 32767.00 /end CHARACTERISTIC
/begin CHARACTERISTIC InjUn_phiTstShOffPathSet_C "#SSD Winkel zwischen Programmierung und Beginn der Einspritzung bei Abschaltpfadtest" VALUE 0xE366C Kw_Wu16 100.0078 AngleCrS 0.00 100.0078 FORMAT "%8.4" EXTENDED_LIMITS 0.00 1535.977 /end CHARACTERISTIC
/begin CHARACTERISTIC InjUn_tiTstShOffPathET_C "#SSD Ansteuerdauer bei Abschaltpfadtest" VALUE 0xE366E Kw_Wu16 65415.00 InjTime_us 120.0000 65535.00 FORMAT "%8.2" EXTENDED_LIMITS 0.00 65535.00 /end CHARACTERISTIC
/begin CHARACTERISTIC InjVCD_uChrgThrSRCLo_C "#SSD Untere Schwelle für die Plausibilisierung der CY370-Integrator-Ausgangsspannung" VALUE 0xE3674 Kw_Ws16 5000.000 Volt 0.00 5000.000 FORMAT "%8.3" EXTENDED_LIMITS -160156.4 160151.5 /end CHARACTERISTIC
/begin CHARACTERISTIC InjVCD_uChrgThrSRCHi_C "#SSD Obere Schwelle für die Plausibilisierung der CY370-Integrator-Ausgangsspannung" VALUE 0xE3676 Kw_Ws16 5000.000 Volt 0.00 5000.000 FORMAT "%8.3" EXTENDED_LIMITS -160156.4 160151.5 /end CHARACTERISTIC
/begin CHARACTERISTIC InjVCD_uChrgLin_CUR "#SSD Linearisierungskurve für die Ausgangsspannung des CY370-Integrators" CURVE 0xE3678 Kl_Xs16_Ws16 320307.9 Volt -160156.4 160151.5 FORMAT "%8.1"
 /begin AXIS_DESCR STD_AXIS InjVCD_uRawChgUp_mp Volt 2 0.00 5200.391 FORMAT "%8.3" EXTENDED_LIMITS -160156.4 160151.5 DEPOSIT ABSOLUTE /end AXIS_DESCR
/end CHARACTERISTIC
/begin CHARACTERISTIC InjVCD_uActrThrSRCLo_C "#SSD untere Spannungsschwelle SRC - nicht verwendet" VALUE 0xE3682 Kw_Ws16 5000.000 Volt 0.00 5000.000 FORMAT "%8.3" EXTENDED_LIMITS -160156.4 160151.5 /end CHARACTERISTIC
/begin CHARACTERISTIC InjVCD_uActrThrSRCHi_C "#SSD obere Spannungsschwelle SRC - nicht verwendet" VALUE 0xE3684 Kw_Ws16 5000.000 Volt 0.00 5000.000 FORMAT "%8.3" EXTENDED_LIMITS -160156.4 160151.5 /end CHARACTERISTIC
/begin CHARACTERISTIC InjVCD_uActrLin_CUR "#SSD Linearisierungkurve ADC-Rohwert -> Aktorspannung" CURVE 0xE3686 Kl_Xs16_Ws16 655.3500 Volt_PA -327.6800 327.6700 FORMAT "%8.4"
 /begin AXIS_DESCR STD_AXIS InjVCD_uRawUp_mp Volt 2 0.00 5200.391 FORMAT "%8.3" EXTENDED_LIMITS -160156.4 160151.5 DEPOSIT ABSOLUTE /end AXIS_DESCR
/end CHARACTERISTIC
/begin CHARACTERISTIC InjVCD_chgMaxPlaus_C "Maximale Ladung" VALUE 0xE3690 Kw_Ws16 65535.00 Charge_PA -32768.00 32767.00 FORMAT "%8.2" /end CHARACTERISTIC
/begin CHARACTERISTIC InjVCD_chgMinPlaus_C "minimale Ladung" VALUE 0xE3692 Kw_Ws16 65535.00 Charge_PA -32768.00 32767.00 FORMAT "%8.2" /end CHARACTERISTIC
/begin CHARACTERISTIC InjVCD_DebActrEnrgDef_C "#SSD Zähler für endgültig defekt" VALUE 0xE369C Kw_Wu16 65535.00 OneToOne 0.00 65535.00 FORMAT "%8.2" /end CHARACTERISTIC
/begin CHARACTERISTIC InjVCD_DebActrEnrgOK_C "#SSD Zähler bis endgültig geheilt" VALUE 0xE369E Kw_Wu16 65535.00 OneToOne 0.00 65535.00 FORMAT "%8.2" /end CHARACTERISTIC
/begin CHARACTERISTIC InjVCD_duInt_C "#SSD Gradient zur Kompensation des Abfalls der Integrator-Ausgangsspannung" VALUE 0xE36F6 Kw_Ws16 30.00000 Delta_Volt_INT 0.00 30.00000 FORMAT "%8.5" EXTENDED_LIMITS -32768.00 32767.00 /end CHARACTERISTIC
/begin CHARACTERISTIC InjVCD_facWActrChrgCorr_C "#SSD Korrekturfaktor für Energieberechnung aus Spannungsdifferenz und Ladung beim Laden" VALUE 0xE36A0 Kw_Ws16 10.00000 Fact1 0.00 10.00000 FORMAT "%8.5" EXTENDED_LIMITS -256.0000 255.9922 /end CHARACTERISTIC
/begin CHARACTERISTIC InjVCD_facWActrCorr_C "#SSD Verstärkungsfaktor für das Verhältnis von nominalem zu korrigiertem Energieverbrauch einer Piezo-Aktor-Ansteuerung" VALUE 0xE36A2 Kw_Ws16 10.00000 Fact1 0.00 10.00000 FORMAT "%8.5" EXTENDED_LIMITS -256.0000 255.9922 /end CHARACTERISTIC
/begin CHARACTERISTIC InjVCD_facWActrDisChCorr_C "#SSD Korrekturfaktor für die Energieberechnung aus Spannungsdifferenz und Ladung beim Entladen" VALUE 0xE36A4 Kw_Ws16 10.00000 Fact1 0.00 10.00000 FORMAT "%8.5" EXTENDED_LIMITS -256.0000 255.9922 /end CHARACTERISTIC
/begin CHARACTERISTIC InjVCD_facWActrDvtMax_C "#SSD Maximalwertbegrenzung für das Verhrhältnis von nominalem zu korrigiertem Aktor-Energieverbrauch" VALUE 0xE36A6 Kw_Ws16 9.000000 Fact1 1.000000 10.00000 FORMAT "%8.5" EXTENDED_LIMITS -256.0000 255.9922 /end CHARACTERISTIC
/begin CHARACTERISTIC InjVCD_facWActrDvtMin_C "#SSD Minimalwertbegrenzung für das Verhrhältnis von nominalem zu korrigiertem Aktor-Energieverbrauch" VALUE 0xE36A8 Kw_Ws16 1.000000 Fact1 0.00 1.000000 FORMAT "%8.6" EXTENDED_LIMITS -256.0000 255.9922 /end CHARACTERISTIC
/begin CHARACTERISTIC InjVCD_nClsEng_C "#SSD Virtuelle Motordrehzahl während der Piezoaktor Klassifizierung im Steuergerätenachlauf" VALUE 0xE36FC Kw_Ws16 5000.000 EngN 0.00 5000.000 FORMAT "%8.3" EXTENDED_LIMITS -32768.00 32767.00 /end CHARACTERISTIC
/begin CHARACTERISTIC InjVCD_nETMaxLim_C "#SSD Schwelle für max. Drehzahl Begrenzung Ansteuerdauer" VALUE 0xE36F4 Kw_Ws16 65535.00 EngN -32768.00 32767.00 FORMAT "%8.2" /end CHARACTERISTIC
/begin CHARACTERISTIC InjVCD_numCylTestBench_C "#SSD Aktornummer für den Testbankbetrieb" VALUE 0xE3694 Kw_Wu8 255.0 OneToOne 0.00 255.0 FORMAT "%5.1" /end CHARACTERISTIC
/begin CHARACTERISTIC InjVCD_numFacWValidMin_C "#SSD Minimale Anzahl gültiger Werte von InjVCD_facWActrDvt_mp für die Freigabe des gemittelten Wertes InjVCD_facWActrDvt" VALUE 0xE36AA Kw_Ws16 100.0000 OneToOne 0.00 100.0000 FORMAT "%8.4" EXTENDED_LIMITS -32768.00 32767.00 /end CHARACTERISTIC
/begin CHARACTERISTIC InjVCD_numWValidMin_C "#SSD Minimum gültiger Messwerte bevor die Mittelwertbildung der Aktorenergieen freigegeben wird" VALUE 0xE36AC Kw_Ws16 100.0000 OneToOne 0.00 100.0000 FORMAT "%8.4" EXTENDED_LIMITS -32768.00 32767.00 /end CHARACTERISTIC
/begin CHARACTERISTIC InjVCD_pClsRailMax_C "#SSD Maximal zulässiger Wert des Raildrucks während der Piezoaktor Klassifizierung im Steuergerätenachlauf" VALUE 0xE36FE Kw_Ws16 2000.000 Pres_Rail 0.00 2000.000 FORMAT "%5.3" EXTENDED_LIMITS -3276.800 3276.700 /end CHARACTERISTIC
/begin CHARACTERISTIC InjVCD_rClsVoltMin_C "#SSD Min. erlaubtes Verhältniss von (Aktorspannung-Beginn)/(Aktorspannung-Ende)" VALUE 0xE3700 Kw_Wu16 1.000000 Milli 1.000000 2.000000 FORMAT "%8.6" EXTENDED_LIMITS 0.00 65.53500 /end CHARACTERISTIC
/begin CHARACTERISTIC InjVCD_resCalcChrgShunt_C "#SSD Wert des Shunt-Widerstands zur Ladungsberechnung" VALUE 0xE36F8 Kw_Ws16 0.00 Resist_mOhm 20.00000 20.00000 FORMAT "%8.5" EXTENDED_LIMITS -3276.800 3276.700 /end CHARACTERISTIC
/begin CHARACTERISTIC InjVCD_stInjMode_C "Verhalten der Umschaltung von Anzugsphase auf Haltephase" VALUE 0xC0620 Kw_Wu8 3.000 OneToOne 0.00 3.000 FORMAT "%5.3" EXTENDED_LIMITS 0.00 255.0 /end CHARACTERISTIC
/begin CHARACTERISTIC InjVCD_swtEnaAgDiff_C "#SSD Ein-/Ausschalter zur Berechnung des Differenzwinkels (1: ein, 0: aus)" VALUE 0xE3670 Kw_Wu8 1.000 OneToOne 0.00 1.000 FORMAT "%5.3" EXTENDED_LIMITS 0.00 255.0 /end CHARACTERISTIC
/begin CHARACTERISTIC InjVCD_swtEnaWActrCorr_C "#SSD Schalter für die Berücksichtigung des gemssenen aktorspezifischen Energieverbrauchs bei der Abschaltung von Einspritzungen" VALUE 0xE36AE Kw_Wu8 1.000 OneToOne 0.00 1.000 FORMAT "%5.3" EXTENDED_LIMITS 0.00 255.0 /end CHARACTERISTIC
/begin CHARACTERISTIC InjVCD_swtSelTempVal_C "#SSD Schalterstellung zur Auswahl der Aktortemperatur" VALUE 0xE36DE Kw_Wu8 1.000 OneToOne 0.00 1.000 FORMAT "%5.3" EXTENDED_LIMITS 0.00 255.0 /end CHARACTERISTIC
/begin CHARACTERISTIC InjVCD_swtSelTempType_C "#SSD Schaltertyp für Aktortemperaturauswahl" VALUE 0xE36DF Kw_Wu8 1.000 OneToOne 1.000 2.000 FORMAT "%5.3" EXTENDED_LIMITS 0.00 255.0 /end CHARACTERISTIC
/begin CHARACTERISTIC InjVCD_tActrDfl_C "#SSD Vorgabetemperatur der Piezo-Aktoren" VALUE 0xE36E0 Kw_Ws16 950.000 Temp_Cels -50.140 899.860 FORMAT "%8.3" EXTENDED_LIMITS -3549.940 3003.560 /end CHARACTERISTIC
/begin CHARACTERISTIC InjVCD_tActr_CUR "#SSD Bestimmung der Aktortemperatur aus der Kühlwassertemperatur" CURVE 0xE36E2 Kl_Xs16_Ws16 250.0000 Temp_Cels -50.1400 199.8600 FORMAT "%8.4" EXTENDED_LIMITS -3549.940 3003.560
 /begin AXIS_DESCR STD_AXIS InjVCD_tActr_mp Temp_Cels 4 -50.140 899.860 FORMAT "%8.3" EXTENDED_LIMITS -3549.940 3003.560 DEPOSIT ABSOLUTE /end AXIS_DESCR
/end CHARACTERISTIC
/begin CHARACTERISTIC InjVCD_tiClsLead_C "#SSD Vorhaltezeit für die Ansteuerung des Piezoaktors während der Klassifizierung im Steuergerätenachlauf" VALUE 0xE3702 Kw_Wu16 5000.000 InjTime_us 0.00 5000.000 FORMAT "%8.3" EXTENDED_LIMITS 0.00 65535.00 /end CHARACTERISTIC
/begin CHARACTERISTIC InjVCD_tiClsMeasBeg_C "#SSD Aktorspannung am Beginn der Ansteuerung" VALUE 0xE3704 Kw_Wu16 5000.000 InjTime_us 0.00 5000.000 FORMAT "%8.3" EXTENDED_LIMITS 0.00 65535.00 /end CHARACTERISTIC
/begin CHARACTERISTIC InjVCD_tiClsMeasEnd_C "#SSD Aktorspannung am Ende der Ansteuerung" VALUE 0xE3706 Kw_Wu16 5000.000 InjTime_us 0.00 5000.000 FORMAT "%8.3" EXTENDED_LIMITS 0.00 65535.00 /end CHARACTERISTIC
/begin CHARACTERISTIC InjVCD_tiClsMeasure_C "#SSD Messzeit zwischen Begin- und Endspannung des Piezoaktors während der Klassifizierung im Steuergerätenachlauf" VALUE 0xE3708 Kw_Wu32 95000.0000000 InjTime_us 0.00 95000.0000000 FORMAT "%13.7" EXTENDED_LIMITS 0.00 4294967295.00 /end CHARACTERISTIC
/begin CHARACTERISTIC InjVCD_tiETMax_C "#SSD Schwelle für maximal zulässige Ansteuerdauer bei Drehzahl >  InjVCD_nETMaxLim_C" VALUE 0xC061E Kw_Ws16 65535.00 InjTime_us -32768.00 32767.00 FORMAT "%8.2" /end CHARACTERISTIC
/begin CHARACTERISTIC InjVCD_tiETMinHigh_C "#SSD Obere Schwelle: minimale AD" VALUE 0xE3672 Kw_Ws16 65535.00 InjTime_us -32768.00 32767.00 FORMAT "%8.2" /end CHARACTERISTIC
/begin CHARACTERISTIC InjVCD_tiETMinLow_C "#SSD Minimale Ansteuerdauer" VALUE 0xC0622 Kw_Ws16 65535.00 InjTime_us -32768.00 32767.00 FORMAT "%8.2" /end CHARACTERISTIC
/begin CHARACTERISTIC InjVCD_tiHoldMin_C "#SSD kleinste Dauer der Haltestromphase bei einer Einspritzung" VALUE 0xC0624 Kw_Ws16 5000.000 InjTime_us 0.00 5000.000 FORMAT "%8.3" EXTENDED_LIMITS -32768.00 32767.00 /end CHARACTERISTIC
/begin CHARACTERISTIC InjVCD_tiIntValid_C "Gültigkeitsdauer der Ladungswerte nach Integratorabgleich auf dem Endstufenbaustein" VALUE 0xE3698 Kw_Wu32 1800000.00000 Time_ms 0.00 1800000.00000 FORMAT "%13.5" EXTENDED_LIMITS 0.00 42949672950.0 /end CHARACTERISTIC
/begin CHARACTERISTIC InjVCD_tiMI1ET_Vector "#SSD Bypass-Label, nicht editieren !" VALUE 0xC3130 Kw_Wu8 255.0 OneToOne 0.00 255.0 FORMAT "%5.1" /end CHARACTERISTIC
/begin CHARACTERISTIC InjVCD_tiMI1ET_Channel "#SSD Bypass-Label, nicht editieren !" VALUE 0xC3131 Kw_Wu8 255.0 OneToOne 0.00 255.0 FORMAT "%5.1" /end CHARACTERISTIC
/begin CHARACTERISTIC InjVCD_tiPiI1ET_Vector "#SSD Bypass-Label, nicht editieren !" VALUE 0xC3132 Kw_Wu8 255.0 OneToOne 0.00 255.0 FORMAT "%5.1" /end CHARACTERISTIC
/begin CHARACTERISTIC InjVCD_tiPiI1ET_Channel "#SSD Bypass-Label, nicht editieren !" VALUE 0xC3133 Kw_Wu8 255.0 OneToOne 0.00 255.0 FORMAT "%5.1" /end CHARACTERISTIC
/begin CHARACTERISTIC InjVCD_tiPiI2ET_Vector "#SSD Bypass-Label, nicht editieren !" VALUE 0xC3134 Kw_Wu8 255.0 OneToOne 0.00 255.0 FORMAT "%5.1" /end CHARACTERISTIC
/begin CHARACTERISTIC InjVCD_tiPiI2ET_Channel "#SSD Bypass-Label, nicht editieren !" VALUE 0xC3135 Kw_Wu8 255.0 OneToOne 0.00 255.0 FORMAT "%5.1" /end CHARACTERISTIC
/begin CHARACTERISTIC InjVCD_tiPoI1ET_Vector "#SSD Bypass-Label, nicht editieren !" VALUE 0xC3136 Kw_Wu8 255.0 OneToOne 0.00 255.0 FORMAT "%5.1" /end CHARACTERISTIC
/begin CHARACTERISTIC InjVCD_tiPoI1ET_Channel "#SSD Bypass-Label, nicht editieren !" VALUE 0xC3137 Kw_Wu8 255.0 OneToOne 0.00 255.0 FORMAT "%5.1" /end CHARACTERISTIC
/begin CHARACTERISTIC InjVCD_tiPoI2ET_Vector "#SSD Bypass-Label, nicht editieren !" VALUE 0xC3138 Kw_Wu8 255.0 OneToOne 0.00 255.0 FORMAT "%5.1" /end CHARACTERISTIC
/begin CHARACTERISTIC InjVCD_tiPoI2ET_Channel "#SSD Bypass-Label, nicht editieren !" VALUE 0xC3139 Kw_Wu8 255.0 OneToOne 0.00 255.0 FORMAT "%5.1" /end CHARACTERISTIC
/begin CHARACTERISTIC InjVCD_wActrChrgDfl_C "#SSD Defaultwert für die Ladeenergie" VALUE 0xE36B0 Kw_Ws16 100.0000 W_PA 0.00 100.0000 FORMAT "%8.4" EXTENDED_LIMITS -32768.00 32767.00 /end CHARACTERISTIC
/begin CHARACTERISTIC InjVCD_wActrDiffPlausMax_C "#SSD Grenzwert über dem die Differenz aus Lade- und Entladeenergie als unplausibel betrachtet wird" VALUE 0xE36B2 Kw_Ws16 100.0000 W_PA 0.00 100.0000 FORMAT "%8.4" EXTENDED_LIMITS -32768.00 32767.00 /end CHARACTERISTIC
/begin CHARACTERISTIC InjVCD_wActrDiffPlausMin_C "#SSD Grenzwert unter dem die Differenz aus Lade- und Entladeenergie als unplausibel betrachtet wird" VALUE 0xE36B4 Kw_Ws16 100.0000 W_PA 0.00 100.0000 FORMAT "%8.4" EXTENDED_LIMITS -32768.00 32767.00 /end CHARACTERISTIC
/begin CHARACTERISTIC InjVCD_wActrDisChDfl_C "#SSD Defaultwert für die Entladeenergie des Piezo-Aktors" VALUE 0xE36B6 Kw_Ws16 100.0000 W_PA 0.00 100.0000 FORMAT "%8.4" EXTENDED_LIMITS -32768.00 32767.00 /end CHARACTERISTIC
/begin CHARACTERISTIC InjVCD_wActrNom_CUR "#SSD Kennlinie für den injektorseitigen Energieverbrauch einer Piezo-Aktor-Ansteuerung" CURVE 0xE36B8 Kl_Xs16_Ws16 100.0000 W_PA 0.00 100.0000 FORMAT "%8.4" EXTENDED_LIMITS -32768.00 32767.00
 /begin AXIS_DESCR STD_AXIS InjVCD_uSetThresActr_mp Volt_PA 8 -327.6800 327.6700 FORMAT "%8.4" DEPOSIT ABSOLUTE /end AXIS_DESCR
/end CHARACTERISTIC
/begin CHARACTERISTIC InjVCD_wActrPlausMax_C "#SSD Grenzwert über dem die bestimmten Energiewerte des Piezo-Aktors als unplausibel betrachtet werden." VALUE 0xE36DA Kw_Ws16 320.0000 W_PA 0.00 320.0000 FORMAT "%8.4" EXTENDED_LIMITS -32768.00 32767.00 /end CHARACTERISTIC
/begin CHARACTERISTIC InjVCD_wActrPlausMin_C "#SSD Grenzwert unter dem die bestimmten Energiewerte des Piezo-Aktors als unplausibel betrachtet werden." VALUE 0xE36DC Kw_Ws16 100.0000 W_PA 0.00 100.0000 FORMAT "%8.4" EXTENDED_LIMITS -32768.00 32767.00 /end CHARACTERISTIC
/begin MEASUREMENT InjCrv_facPhPoI2RgnAPCor_mp "atmosphere pressure correction value for PoI2 setpoint" SWORD Fact 1 100 -4.000000 3.999878 FORMAT "%8.6" ECU_ADDRESS 0x8FF4F4 /end MEASUREMENT
/begin MEASUREMENT InjCrv_facPhPoI2RgnETCor_mp "engine temperature correction value for PoI2 setpoint" SWORD Fact 1 100 -4.000000 3.999878 FORMAT "%8.6" ECU_ADDRESS 0x8FF4F6 /end MEASUREMENT
/begin MEASUREMENT InjCrv_facPiI1APSQCor "atmosphärendruckabhängiger Mengenkorrekturfaktor für Voreinspritzung 1" SWORD Fact 1 100 -4.000000 3.999878 FORMAT "%8.6" ECU_ADDRESS 0x7F8E2E /end MEASUREMENT
/begin MEASUREMENT InjCrv_facPiI1APSQCor2 "atmosphärendruckabhängiger Mengenkorrekturfaktor -2 für Voreinspritzung 1" SWORD Fact 1 100 -4.000000 3.999878 FORMAT "%8.6" ECU_ADDRESS 0x7F8E30 /end MEASUREMENT
/begin MEASUREMENT InjCrv_facPiI1APSQCorStrt "atmosphärendruckabhängiger Mengenkorrekturfaktor für Voreinspritzung 1 bei inaktiver Voreinspritzung 2 im Startzustand" SWORD Fact 1 100 -4.000000 3.999878 FORMAT "%8.6" ECU_ADDRESS 0x7F8E32 /end MEASUREMENT
/begin MEASUREMENT InjCrv_facPiI1ATSQCor "ansauglufttemperaturabhängiger Mengenkorrekturfaktor für Voreinspritzung 1" SWORD Fact 1 100 -4.000000 3.999878 FORMAT "%8.6" ECU_ADDRESS 0x7F8E34 /end MEASUREMENT
/begin MEASUREMENT InjCrv_facPiI1ATSQCor2 "ansauglufttemperaturabhängiger Mengenkorrekturfaktor -2 für Voreinspritzung 1" SWORD Fact 1 100 -4.000000 3.999878 FORMAT "%8.6" ECU_ADDRESS 0x7F8E36 /end MEASUREMENT
/begin MEASUREMENT InjCrv_facPiI1ATSQCorStrt "motortemperaturabhängiger Mengenkorrekturfaktor für Voreinspritzung 1 bei inaktiver Voreinspritzung 2 im Startzustand" SWORD Fact 1 100 -4.000000 3.999878 FORMAT "%8.6" ECU_ADDRESS 0x7F8E38 /end MEASUREMENT
/begin MEASUREMENT InjCrv_facPiI1ETSQCor "motortemperaturabhängiger Mengenkorrekturfaktor für Voreinspritzung 1" SWORD Fact 1 100 -4.000000 3.999878 FORMAT "%8.6" ECU_ADDRESS 0x7F8E40 /end MEASUREMENT
/begin MEASUREMENT InjCrv_facPiI1ETSQCor1 "motortemperaturabhängiger Mengenkorrekturfaktor -1 für Voreinspritzung 1" SWORD Fact 1 100 -4.000000 3.999878 FORMAT "%8.6" ECU_ADDRESS 0x7F8E42 /end MEASUREMENT
/begin MEASUREMENT InjCrv_facPiI1ETSQCor12 "motortemperaturabhängiger Mengenkorrekturfaktor für Voreinspritzung 1 bei inaktiver Voreinspritzung 2" SWORD Fact 1 100 -4.000000 3.999878 FORMAT "%8.6" ECU_ADDRESS 0x7F8E44 /end MEASUREMENT
/begin MEASUREMENT InjCrv_facPiI1ETSQCor2 "motortemperaturabhängiger Mengenkorrekturfaktor -2 für Voreinspritzung 1" SWORD Fact 1 100 -4.000000 3.999878 FORMAT "%8.6" ECU_ADDRESS 0x7F8E46 /end MEASUREMENT
/begin MEASUREMENT InjCrv_facPiI1ETSQCorStrt "motortemperaturabhängiger Mengenkorrekturfaktor für Voreinspritzung 1 bei inaktiver Voreinspritzung 2 im Startzustand" SWORD Fact 1 100 -4.000000 3.999878 FORMAT "%8.6" ECU_ADDRESS 0x7F8E48 /end MEASUREMENT
/begin MEASUREMENT InjCrv_facPiI1ETSSOECor "motortemperaturabhängiger Ansteuerbeginnkorrekturfaktor für Voreinspritzung 1" SWORD Fact 1 100 -4.000000 3.999878 FORMAT "%8.6" ECU_ADDRESS 0x7F8E4A /end MEASUREMENT
/begin MEASUREMENT InjCrv_facPiI1ETSSOECor1 "motortemperaturabhängiger Ansteuerbeginnkorrekturfaktor -1 für Voreinspritzung 1" SWORD Fact 1 100 -4.000000 3.999878 FORMAT "%8.6" ECU_ADDRESS 0x7F8E4C /end MEASUREMENT
/begin MEASUREMENT InjCrv_facPiI1ETSSOECor12 """motortemperaturabhängiger Ansteuerbeginnkorrekturfaktor für Voreinspritzung 1 bei inaktiver Voreinspritzung 2""" SWORD Fact 1 100 -4.000000 3.999878 FORMAT "%8.6" ECU_ADDRESS 0x7F8E4E /end MEASUREMENT
/begin MEASUREMENT InjCrv_facPiI1ETSSOECor2 "motortemperaturabhängiger Ansteuerbeginnkorrekturfaktor -2 für Voreinspritzung 1" SWORD Fact 1 100 -4.000000 3.999878 FORMAT "%8.6" ECU_ADDRESS 0x7F8E50 /end MEASUREMENT
/begin MEASUREMENT InjCrv_facPiI1ETSSOECorStrt """motortemperaturabhängiger Ansteuerbeginnkorrekturfaktor für Voreinspritzung 1 bei inaktiver Voreinspritzung 2 im Startzustand """ SWORD Fact 1 100 -4.000000 3.999878 FORMAT "%8.6" ECU_ADDRESS 0x7F8E52 /end MEASUREMENT
/begin MEASUREMENT InjCrv_facPiI1QntMin_mp "Wichtungsfaktor zum Abschalten der Berechnung Voreinspritzung 1" SWORD Fact1 1 100 -256.0000 255.9922 FORMAT "%8.4" ECU_ADDRESS 0x8FF434 /end MEASUREMENT
/begin MEASUREMENT InjCrv_facPoI1APSQCor "atmospärendruckabhängiger Mengenkorrekturfaktor für PoI1" SWORD Fact 1 100 -4.000000 3.999878 FORMAT "%8.6" ECU_ADDRESS 0x7F8E64 /end MEASUREMENT
/begin MEASUREMENT InjCrv_facPoI1ETSPhiCor "motortemperaturabhängiger Winkelkorrekturfaktor für PoI1" SWORD Fact 1 100 -4.000000 3.999878 FORMAT "%8.6" ECU_ADDRESS 0x7F8E66 /end MEASUREMENT
/begin MEASUREMENT InjCrv_facPoI1ETSQCor "motortemperaturabhängiger Mengenkorrekturfaktor für PoI1" SWORD Fact 1 100 -4.000000 3.999878 FORMAT "%8.6" ECU_ADDRESS 0x7F8E68 /end MEASUREMENT
/begin MEASUREMENT InjCrv_facPoI2ATSQCor "ansauglufttemperaturabhängiger Mengenkorrekturfaktor für PoI2" SWORD Fact 1 100 -4.000000 3.999878 FORMAT "%8.6" ECU_ADDRESS 0x7F8E6A /end MEASUREMENT
/begin MEASUREMENT InjCrv_facPoI2ATSSOECor "ansauglufttemperaturabhängiger Ansteuerbeginnkorrekturfaktor für PoI2" SWORD Fact 1 100 -4.000000 3.999878 FORMAT "%8.6" ECU_ADDRESS 0x7F8E6C /end MEASUREMENT
/begin MEASUREMENT InjCrv_facPoI2EffRgn "Faktor für den drehmomentbildenden Anteil der Einspritzmenge PoI2 im Regenerationsmodus" SWORD Fact 1 100 -4.000000 3.999878 FORMAT "%8.6" ECU_ADDRESS 0x7F8E72 /end MEASUREMENT
/begin MEASUREMENT InjCrv_facPoI2EffRgn1_mp "corrected factor component for PoI2" SWORD Fact 1 100 -4.000000 3.999878 FORMAT "%8.6" ECU_ADDRESS 0x8FF51E /end MEASUREMENT
/begin MEASUREMENT InjCrv_facPoI2EffRgn2_mp "corrected factor component for PoI2" SWORD Fact 1 100 -4.000000 3.999878 FORMAT "%8.6" ECU_ADDRESS 0x8FF520 /end MEASUREMENT
/begin MEASUREMENT InjCrv_facPoI2EffRgnByp_mp "Effektivwert Nacheinspritzung Regeneration" SWORD Fact 1 100 -4.000000 3.999878 FORMAT "%8.6" ECU_ADDRESS 0x8FF522 /end MEASUREMENT
/begin MEASUREMENT InjCrv_facPoI2EffSet_mp "Faktor für den drehmomentbildenden Anteil der Einspritzmenge PoI2 (Sollwert)" SWORD Fact 1 100 -4.000000 3.999878 FORMAT "%8.6" ECU_ADDRESS 0x8FF504 /end MEASUREMENT
/begin MEASUREMENT InjCrv_facPoI2Eff_mp "Faktor für Drehmoment bildenden Anteil der Einspritzmenge PoI2" SWORD Fact 1 100 -4.000000 3.999878 FORMAT "%8.6" ECU_ADDRESS 0x8FF506 /end MEASUREMENT
/begin MEASUREMENT InjCrv_facPoI2ETSQCor "motortemperaturabhängiger Mengenkorrekturfaktor für PoI2" SWORD Fact 1 100 -4.000000 3.999878 FORMAT "%8.6" ECU_ADDRESS 0x7F8E6E /end MEASUREMENT
/begin MEASUREMENT InjCrv_facPoI2ETSSOECor "motortemperaturabhängiger Ansteuerbeginnkorrekturfaktor für PoI2" SWORD Fact 1 100 -4.000000 3.999878 FORMAT "%8.6" ECU_ADDRESS 0x7F8E70 /end MEASUREMENT
/begin MEASUREMENT InjCrv_facPOpPoI2ETSCor "Motortemperaturabhängiger Freigabekorrekturfaktor für  PoI2" SWORD Fact 1 100 -4.000000 3.999878 FORMAT "%8.6" ECU_ADDRESS 0x7F8E2C /end MEASUREMENT
/begin MEASUREMENT InjCrv_facQPoI2RgnAPCor_mp "atmosphere pressure correction value for PoI2 quantity" SWORD Fact 1 100 -4.000000 3.999878 FORMAT "%8.6" ECU_ADDRESS 0x8FF4F8 /end MEASUREMENT
/begin MEASUREMENT InjCrv_facQPoI2RgnETCor_mp "engine temperature correction value for PoI2 quantity" SWORD Fact 1 100 -4.000000 3.999878 FORMAT "%8.6" ECU_ADDRESS 0x8FF4FA /end MEASUREMENT
/begin MEASUREMENT InjCrv_facTiPoI2RgnAPCor_mp "atmosphere pressure correction value for PoI2 time" SWORD Fact 1 100 -4.000000 3.999878 FORMAT "%8.6" ECU_ADDRESS 0x8FF4FC /end MEASUREMENT
/begin MEASUREMENT InjCrv_facTiPoI2RgnETCor_mp "engine temperature correction value for PoI2 time" SWORD Fact 1 100 -4.000000 3.999878 FORMAT "%8.6" ECU_ADDRESS 0x8FF4FE /end MEASUREMENT
/begin MEASUREMENT InjCrv_phiDynOfs_mp "Winkelvorhalt für schnelle dynamische Vorgänge" SWORD AngleCrS 1 100 -768.0000 767.9766 FORMAT "%8.4" ECU_ADDRESS 0x8FF4B0 /end MEASUREMENT
/begin MEASUREMENT InjCrv_phiNxtCyl_mp "Winkel zwischen aktuellem OT und der frühesten Einspritzung des nächsten Zylinders auf derselben Bank" SWORD AngleCrS 1 100 -768.0000 767.9766 FORMAT "%8.4" ECU_ADDRESS 0x8FF4B2 /end MEASUREMENT
/begin MEASUREMENT InjCrv_phiNxtTDCoB_mp "Winkel zw. aktuellem OT und OT des nächsten Zylinders auf derselben Bank" SWORD AngleCrS 1 100 -768.0000 767.9766 FORMAT "%8.4" ECU_ADDRESS 0x8FF4B4 /end MEASUREMENT
/begin MEASUREMENT InjCrv_phiPiI1AbsTot_mp "absoluter Ansteuerbeginn PiI1 aus Winkel- und Zeitkomponente" SWORD AngleCrS 1 100 -768.0000 767.9766 FORMAT "%8.4" ECU_ADDRESS 0x8FF436 /end MEASUREMENT
/begin MEASUREMENT InjCrv_phiPiI1Abs_mp "absolute Winkelkomponente Anteuerbeginn PiI1" SWORD AngleCrS 1 100 -768.0000 767.9766 FORMAT "%8.4" ECU_ADDRESS 0x8FF438 /end MEASUREMENT
/begin MEASUREMENT InjCrv_phiPiI1Cor_mp "korrigierter Grundwert Winkelkomponente Ansteuerbeginn PiI1" SWORD AngleCrS 1 100 -768.0000 767.9766 FORMAT "%8.4" ECU_ADDRESS 0x8FF43A /end MEASUREMENT
/begin MEASUREMENT InjCrv_phiPiI1Des "gewünschter Winkelkomponente Ansteuerbeginn PiI1" SWORD AngleCrS 1 100 -768.0000 767.9766 FORMAT "%8.4" ECU_ADDRESS 0x7F8E86 /end MEASUREMENT
/begin MEASUREMENT InjCrv_phiPiI1DesByp_mp "Bypass-Label, Kopie von InjCrv_phiPiI1Des" SWORD AngleCrS 1 100 -768.0000 767.9766 FORMAT "%8.4" ECU_ADDRESS 0x8FF43C /end MEASUREMENT
/begin MEASUREMENT InjCrv_phiPiI1EnvCor "Korrekturwinkel für Voreinspritzung 1" SWORD AngleCrS 1 100 -768.0000 767.9766 FORMAT "%8.4" ECU_ADDRESS 0x7F8E88 /end MEASUREMENT
/begin MEASUREMENT InjCrv_phiPiI1EnvCor2 "Korrekturwinkel für PiI1 wenn PiI2 aktiv" SWORD AngleCrS 1 100 -768.0000 767.9766 FORMAT "%8.4" ECU_ADDRESS 0x7F8E8A /end MEASUREMENT
/begin MEASUREMENT InjCrv_phiPiI1Rel_mp "Winkelkomponente Ansteuerbeginn PiI1 relaitv zur MI" SWORD AngleCrS 1 100 -768.0000 767.9766 FORMAT "%8.4" ECU_ADDRESS 0x8FF43E /end MEASUREMENT
/begin MEASUREMENT InjCrv_phiPiI1Rgn "Regenerationswert für die  Winkelkomponente des Ansteuerbeginns der PiI1" SWORD AngleCrS 1 100 -768.0000 767.9766 FORMAT "%8.4" ECU_ADDRESS 0x7F8E8C /end MEASUREMENT
/begin MEASUREMENT InjCrv_phiPiI1RgnByp_mp "Measure point for Bypass" SWORD AngleCrS 1 100 -768.0000 767.9766 FORMAT "%8.4" ECU_ADDRESS 0x8FF4A6 /end MEASUREMENT
/begin MEASUREMENT InjCrv_phiPiI2Des "gewünschte Winkelkomponente Ansteuerbeginn PiI2" SWORD AngleCrS 1 100 -768.0000 767.9766 FORMAT "%8.4" ECU_ADDRESS 0x7F8E90 /end MEASUREMENT
/begin MEASUREMENT InjCrv_phiPiI2DesByp_mp "Bypass-Label, Kopie von InjCrv_phiPiI2Des" SWORD AngleCrS 1 100 -768.0000 767.9766 FORMAT "%8.4" ECU_ADDRESS 0x8FF440 /end MEASUREMENT
/begin MEASUREMENT InjCrv_phiPiI3Des "gewünschte Winkelkomponente Ansteuerbeginn PiI3" SWORD AngleCrS 1 100 -768.0000 767.9766 FORMAT "%8.4" ECU_ADDRESS 0x7F8E96 /end MEASUREMENT
/begin MEASUREMENT InjCrv_phiPiI3DesByp_mp "Bypass-Label, Kopie von InjCrv_phiPiI3Des" SWORD AngleCrS 1 100 -768.0000 767.9766 FORMAT "%8.4" ECU_ADDRESS 0x8FF442 /end MEASUREMENT
/begin MEASUREMENT InjCrv_phiPoI1AddCor "kundenspezifischer Korrekturwinkel für PoI1" SWORD AngleCrS 1 100 -768.0000 767.9766 FORMAT "%8.4" ECU_ADDRESS 0x7F8E98 /end MEASUREMENT
/begin MEASUREMENT InjCrv_phiPoI1Bas_mp "Grundwert des Ansteuerbeginnwinkels PoI1" SWORD AngleCrS 1 100 -768.0000 767.9766 FORMAT "%8.4" ECU_ADDRESS 0x8FF4B6 /end MEASUREMENT
/begin MEASUREMENT InjCrv_phiPoI1Des "gewünschter Bezugswinkel für Beginn der PoI1" SWORD AngleCrS 1 100 -768.0000 767.9766 FORMAT "%8.4" ECU_ADDRESS 0x7F8E9A /end MEASUREMENT
/begin MEASUREMENT InjCrv_phiPoI1DesByp_mp "Bypass-Label, Kopie von InjCrv_phiPoI1Des" SWORD AngleCrS 1 100 -768.0000 767.9766 FORMAT "%8.4" ECU_ADDRESS 0x8FF4B8 /end MEASUREMENT
/begin MEASUREMENT InjCrv_phiPoI1Dur_mp "Gesamtzeti PoI1 in Winkelgraden" SWORD AngleCrS 1 100 -768.0000 767.9766 FORMAT "%8.4" ECU_ADDRESS 0x8FF4BA /end MEASUREMENT
/begin MEASUREMENT InjCrv_phiPoI1EnvCor "umgebungsbedingungsabhängiger Korrekturwinkel für PoI1" SWORD AngleCrS 1 100 -768.0000 767.9766 FORMAT "%8.4" ECU_ADDRESS 0x7F8E9C /end MEASUREMENT
/begin MEASUREMENT InjCrv_phiPoI1Lim_mp "begrenzeter Ansteuerbeginnwinkel PoI1" SWORD AngleCrS 1 100 -768.0000 767.9766 FORMAT "%8.4" ECU_ADDRESS 0x8FF4BC /end MEASUREMENT
/begin MEASUREMENT InjCrv_phiPoI1Min_mp "spätester Ansteuerbeginnwinkel PoI1" SWORD AngleCrS 1 100 -768.0000 767.9766 FORMAT "%8.4" ECU_ADDRESS 0x8FF4BE /end MEASUREMENT
/begin MEASUREMENT InjCrv_phiPoI1Rgn "Grundwert der Winkelkomponente Ansteuerbeginn PoI1 im Regenerationsbetrieb" SWORD AngleCrS 1 100 -768.0000 767.9766 FORMAT "%8.4" ECU_ADDRESS 0x7F8E9E /end MEASUREMENT
/begin MEASUREMENT InjCrv_phiPoI1Rgn1_mp "Regeneration value 1 for the PoI1 start of energising angle component" SWORD AngleCrS 1 100 -768.0000 767.9766 FORMAT "%8.4" ECU_ADDRESS 0x8FF4DC /end MEASUREMENT
/begin MEASUREMENT InjCrv_phiPoI1Rgn2_mp "Regeneration value 2 for the PoI1 start of energising angle component" SWORD AngleCrS 1 100 -768.0000 767.9766 FORMAT "%8.4" ECU_ADDRESS 0x8FF4DE /end MEASUREMENT
/begin MEASUREMENT InjCrv_phiPoI1RgnByp_mp "Measure point for Bypass" SWORD AngleCrS 1 100 -768.0000 767.9766 FORMAT "%8.4" ECU_ADDRESS 0x8FF4E0 /end MEASUREMENT
/begin MEASUREMENT InjCrv_phiPoI1Set_mp "Sollwert des Ansteuerbeginnwinkels PoI1" SWORD AngleCrS 1 100 -768.0000 767.9766 FORMAT "%8.4" ECU_ADDRESS 0x8FF4C0 /end MEASUREMENT
/begin MEASUREMENT InjCrv_phiPoI2AbsTot_mp "absoluter Ansteuerbeginn PoI2 aus Winkel- und Zeitkomponente" SWORD AngleCrS 1 100 -768.0000 767.9766 FORMAT "%8.4" ECU_ADDRESS 0x8FF53A /end MEASUREMENT
/begin MEASUREMENT InjCrv_phiPoI2Abs_mp "Sollwert, Winkelkomponente Ansteuerbeginn PoI2 relativ zum oberen Totpunkt" SWORD AngleCrS 1 100 -768.0000 767.9766 FORMAT "%8.4" ECU_ADDRESS 0x8FF53C /end MEASUREMENT
/begin MEASUREMENT InjCrv_phiPoI2AddCor "kundenspezifischer Korrekturwinkel für PoI2" SWORD AngleCrS 1 100 -768.0000 767.9766 FORMAT "%8.4" ECU_ADDRESS 0x7F8EA0 /end MEASUREMENT
/begin MEASUREMENT InjCrv_phiPoI2ATSCor_mp "ansauglufttemperaturabhängiger Korrekturgrundwert für die Winkelkomponente des Ansteuerbeginns der PoI2" SWORD AngleCrS 1 100 -768.0000 767.9766 FORMAT "%8.4" ECU_ADDRESS 0x8FF4F0 /end MEASUREMENT
/begin MEASUREMENT InjCrv_phiPoI2Bas_mp "Winkelkomponente Ansteuerbeginn PoI2 Grundwert" SWORD AngleCrS 1 100 -768.0000 767.9766 FORMAT "%8.4" ECU_ADDRESS 0x8FF554 /end MEASUREMENT
/begin MEASUREMENT InjCrv_phiPoI2Byp_mp "Messpunkt für Bypass" SWORD AngleCrS 1 100 -768.0000 767.9766 FORMAT "%8.4" ECU_ADDRESS 0x8FF53E /end MEASUREMENT
/begin MEASUREMENT InjCrv_phiPoI2Cor_mp "korrigierter Grundwert der Winkelkomponente Ansteuerbeginn PoI2" SWORD AngleCrS 1 100 -768.0000 767.9766 FORMAT "%8.4" ECU_ADDRESS 0x8FF540 /end MEASUREMENT
/begin MEASUREMENT InjCrv_phiPoI2Des "gewünschter Bezugswinkel für Beginn der PoI2" SWORD AngleCrS 1 100 -768.0000 767.9766 FORMAT "%8.4" ECU_ADDRESS 0x7F8EA2 /end MEASUREMENT
/begin MEASUREMENT InjCrv_phiPoI2EnvCor "Korrekturwinkel für PoI2" SWORD AngleCrS 1 100 -768.0000 767.9766 FORMAT "%8.4" ECU_ADDRESS 0x7F8EA4 /end MEASUREMENT
/begin MEASUREMENT InjCrv_phiPoI2ETSCor_mp "motortemperaturabhängiger Korrekturgrundwert für die Winkelkomponente des Ansteuerbeginns der PoI2" SWORD AngleCrS 1 100 -768.0000 767.9766 FORMAT "%8.4" ECU_ADDRESS 0x8FF4F2 /end MEASUREMENT
/begin MEASUREMENT InjCrv_phiPoI2Rel_mp "Winkelkomponente Ansteuerbeginn PoI2 relativ zur Haupteinspritzung" SWORD AngleCrS 1 100 -768.0000 767.9766 FORMAT "%8.4" ECU_ADDRESS 0x8FF542 /end MEASUREMENT
/begin MEASUREMENT InjCrv_phiPoI2Rgn "Grundwert der Winkelkomponente Ansteuerbeginn PoI2 im Regenerationsbetrieb" SWORD AngleCrS 1 100 -768.0000 767.9766 FORMAT "%8.4" ECU_ADDRESS 0x7F8EA6 /end MEASUREMENT
/begin MEASUREMENT InjCrv_phiPoI2Rgn1_mp "Regenerationswert 1 für Förderbeginn Nacheinspritzung" SWORD AngleCrS 1 100 -768.0000 767.9766 FORMAT "%8.4" ECU_ADDRESS 0x8FF524 /end MEASUREMENT
/begin MEASUREMENT InjCrv_phiPoI2Rgn2_mp "Regenerationswert 2 für Förderbeginn Nacheinspritzung" SWORD AngleCrS 1 100 -768.0000 767.9766 FORMAT "%8.4" ECU_ADDRESS 0x8FF526 /end MEASUREMENT
/begin MEASUREMENT InjCrv_phiPoI2RgnByp_mp "Measure point for Bypass" SWORD AngleCrS 1 100 -768.0000 767.9766 FORMAT "%8.4" ECU_ADDRESS 0x8FF528 /end MEASUREMENT
/begin MEASUREMENT InjCrv_phiPoI2RgnCor "correction value for PoI2 setpoint" SWORD AngleCrS 1 100 -768.0000 767.9766 FORMAT "%8.4" ECU_ADDRESS 0x7F8EA8 /end MEASUREMENT
/begin MEASUREMENT InjCrv_PoI1RgnTypeVal "activation value for PoI1 demanded by EGT-System" ULONG EGTSwt 1 100 0.00 262.143999939 FORMAT "%13.9" ECU_ADDRESS 0x7F9204 /end MEASUREMENT
/begin MEASUREMENT InjCrv_PoI1RgnVal_mp "Aktivierungswert für die Freigabe der PoI1 über das Abgasnachbehandlungssystem" ULONG EGTSwt 1 100 0.00 262.143999939 FORMAT "%13.9" ECU_ADDRESS 0x8FF4AC /end MEASUREMENT
/begin MEASUREMENT InjCrv_PoI2EffVal "activation value for PoI2 demanded by EGT-System" ULONG EGTSwt 1 100 0.00 262.143999939 FORMAT "%13.9" ECU_ADDRESS 0x7F9208 /end MEASUREMENT
/begin MEASUREMENT InjCrv_PoI2RgnTypeVal "activation value for PoI2 demanded by EGT-System" ULONG EGTSwt 1 100 0.00 262.143999939 FORMAT "%13.9" ECU_ADDRESS 0x7F920C /end MEASUREMENT
/begin MEASUREMENT InjCrv_POpPoI1AddCor "kundespezifischer Korrekturwert für Freigabe PoI1" SWORD OneToOne 1 100 -32768.00 32767.00 FORMAT "%8.2" ECU_ADDRESS 0x7F8E02 /end MEASUREMENT
/begin MEASUREMENT InjCrv_POpPoI1Bas_mp "grundwert Freigabe PoI1" SWORD OneToOne 1 100 -32768.00 32767.00 FORMAT "%8.2" ECU_ADDRESS 0x8FF4E8 /end MEASUREMENT
/begin MEASUREMENT InjCrv_POpPoI1EnvCor "Freigabekorrekturwert für PoI1" SWORD OneToOne 1 100 -32768.00 32767.00 FORMAT "%8.2" ECU_ADDRESS 0x7F8E04 /end MEASUREMENT
/begin MEASUREMENT InjCrv_POpPoI1_mp "korrigierter grundwert Freigabe PoI1" SWORD OneToOne 1 100 -32768.00 32767.00 FORMAT "%8.2" ECU_ADDRESS 0x8FF4EA /end MEASUREMENT
/begin MEASUREMENT InjCrv_POpPoI2AddCor "kundenspezifischer Korrekturwert für Freigabe PoI2" SWORD OneToOne 1 100 -32768.00 32767.00 FORMAT "%8.2" ECU_ADDRESS 0x7F8E06 /end MEASUREMENT
/begin MEASUREMENT InjCrv_POpPoI2Bas_mp "grundwert Freigabe PoI2" SWORD OneToOne 1 100 -32768.00 32767.00 FORMAT "%8.2" ECU_ADDRESS 0x8FF536 /end MEASUREMENT
/begin MEASUREMENT InjCrv_POpPoI2EnvCor "Korrekturwert für Freigabe PoI2" SWORD OneToOne 1 100 -32768.00 32767.00 FORMAT "%8.2" ECU_ADDRESS 0x7F8E08 /end MEASUREMENT
/begin MEASUREMENT InjCrv_POpPoI2_mp "reigabe PoI2, korrigierter Grundwert" SWORD OneToOne 1 100 -32768.00 32767.00 FORMAT "%8.2" ECU_ADDRESS 0x8FF538 /end MEASUREMENT
/begin MEASUREMENT InjCrv_qMI1MinPiI1_mp "Minimalmenge der MI1 wenn nur PiI1 abgesetzt wird" SWORD InjMassInj 1 100 -327.6800 327.6700 FORMAT "%8.4" ECU_ADDRESS 0x8FF444 /end MEASUREMENT
/begin MEASUREMENT InjCrv_qMI1MinPoI2_mp "Minimale Einspritzmenge der MI1 bei der PoI2 Berechnung" SWORD InjMassInj 1 100 -327.6800 327.6700 FORMAT "%8.4" ECU_ADDRESS 0x8FF508 /end MEASUREMENT
/begin MEASUREMENT InjCrv_qPiI1APSCor2_mp "atmosphärendruckabhängige Korrekturmenge -2 für PiI1 und PiI2" SWORD InjMassInj 1 100 -327.6800 327.6700 FORMAT "%8.4" ECU_ADDRESS 0x8FF486 /end MEASUREMENT
/begin MEASUREMENT InjCrv_qPiI1APSCorStrt_mp "quantity correction value dependent on atmospheric pressure" SWORD InjMassInj 1 100 -327.6800 327.6700 FORMAT "%8.4" ECU_ADDRESS 0x8FF488 /end MEASUREMENT
/begin MEASUREMENT InjCrv_qPiI1APSCor_mp "atmosphärendruckabhängige Korrekturmenge für Voreinspritzung 1" SWORD InjMassInj 1 100 -327.6800 327.6700 FORMAT "%8.4" ECU_ADDRESS 0x8FF48A /end MEASUREMENT
/begin MEASUREMENT InjCrv_qPiI1ATSCor2_mp "ansauglufttemperaturabhängige Korrekturmenge -2 für PiI1 und PiI2" SWORD InjMassInj 1 100 -327.6800 327.6700 FORMAT "%8.4" ECU_ADDRESS 0x8FF48C /end MEASUREMENT
/begin MEASUREMENT InjCrv_qPiI1ATSCorStrt_mp "quantity correction value dependent on intake air temperature" SWORD InjMassInj 1 100 -327.6800 327.6700 FORMAT "%8.4" ECU_ADDRESS 0x8FF48E /end MEASUREMENT
/begin MEASUREMENT InjCrv_qPiI1ATSCor_mp "ansauglufttemperaturabhängige Korrekturmenge für Voreinspritzung 1" SWORD InjMassInj 1 100 -327.6800 327.6700 FORMAT "%8.4" ECU_ADDRESS 0x8FF490 /end MEASUREMENT
/begin MEASUREMENT InjCrv_qPiI1Bas_mp "Einspritzmenge PiI1 Grundwert" SWORD InjMassInj 1 100 -327.6800 327.6700 FORMAT "%8.4" ECU_ADDRESS 0x6F8178 /end MEASUREMENT
/begin MEASUREMENT InjCrv_qPiI1Des "gewünschte Einspritzmenge PiI 1" SWORD InjMassInj 1 100 -327.6800 327.6700 FORMAT "%8.4" ECU_ADDRESS 0x7F8EB6 /end MEASUREMENT
/begin MEASUREMENT InjCrv_qPiI1DesByp_mp "Bypass-Label, Kopie von InjCrv_qPiI1Des" SWORD InjMassInj 1 100 -327.6800 327.6700 FORMAT "%8.4" ECU_ADDRESS 0x8FF446 /end MEASUREMENT
/begin MEASUREMENT InjCrv_qPiI1EnvCor "Korrekturmenge für Voreinspritzung 1" SWORD InjMassInj 1 100 -327.6800 327.6700 FORMAT "%8.4" ECU_ADDRESS 0x7F8EB8 /end MEASUREMENT
/begin MEASUREMENT InjCrv_qPiI1EnvCor2 "Korrekturmenge für Voreinspritzung 1 bei freigegebener PiI2" SWORD InjMassInj 1 100 -327.6800 327.6700 FORMAT "%8.4" ECU_ADDRESS 0x7F8EBA /end MEASUREMENT
/begin MEASUREMENT InjCrv_qPiI1EnvCorStrt "Korrekturmenge für Voreinspritzung 1 Start" SWORD InjMassInj 1 100 -327.6800 327.6700 FORMAT "%8.4" ECU_ADDRESS 0x7F8EBC /end MEASUREMENT
/begin MEASUREMENT InjCrv_qPiI1ETSCor12_mp """motortemperaturabhängige Korrekturmenge für PiI1 bei inaktiver PiI2""" SWORD InjMassInj 1 100 -327.6800 327.6700 FORMAT "%8.4" ECU_ADDRESS 0x8FF492 /end MEASUREMENT
/begin MEASUREMENT InjCrv_qPiI1ETSCor1_mp "motortemperaturabhängige Korrekturmenge -1 für PiI1 und PiI2" SWORD InjMassInj 1 100 -327.6800 327.6700 FORMAT "%8.4" ECU_ADDRESS 0x8FF494 /end MEASUREMENT
/begin MEASUREMENT InjCrv_qPiI1ETSCor2_mp "motortemperaturabhängige Korrekturmenge -2 für PiI1 und PiI2" SWORD InjMassInj 1 100 -327.6800 327.6700 FORMAT "%8.4" ECU_ADDRESS 0x8FF496 /end MEASUREMENT
/begin MEASUREMENT InjCrv_qPiI1ETSCorStrt_mp "quantity correction value dependent on engine temperature" SWORD InjMassInj 1 100 -327.6800 327.6700 FORMAT "%8.4" ECU_ADDRESS 0x8FF498 /end MEASUREMENT
/begin MEASUREMENT InjCrv_qPiI1ETSCor_mp "motortemperaturabhängige Korrekturmenge für Voreinspritzung 1" SWORD InjMassInj 1 100 -327.6800 327.6700 FORMAT "%8.4" ECU_ADDRESS 0x8FF49A /end MEASUREMENT
/begin MEASUREMENT InjCrv_qPiI1Max_mp "maximale Einspritzmenge der PiI1" SWORD InjMassInj 1 100 -327.6800 327.6700 FORMAT "%8.4" ECU_ADDRESS 0x8FF448 /end MEASUREMENT
/begin MEASUREMENT InjCrv_qPiI1MinWv_mp "Minimalmenge der PiI1 mit Wellenlorrektur" SWORD InjMassInj 1 100 -327.6800 327.6700 FORMAT "%8.4" ECU_ADDRESS 0x8FF558 /end MEASUREMENT
/begin MEASUREMENT InjCrv_qPiI1Rgn "Regenerationswert für die Einspritmenge der PiI1" SWORD InjMassInj 1 100 -327.6800 327.6700 FORMAT "%8.4" ECU_ADDRESS 0x7F8EBE /end MEASUREMENT
/begin MEASUREMENT InjCrv_qPiI1RgnByp_mp "Measure point for Bypass" SWORD InjMassInj 1 100 -327.6800 327.6700 FORMAT "%8.4" ECU_ADDRESS 0x8FF4A8 /end MEASUREMENT
/begin MEASUREMENT InjCrv_qPiI1SetLimMax_mp "begrenzte maximale Solleinspritzmenge PiI1" SWORD InjMassInj 1 100 -327.6800 327.6700 FORMAT "%8.4" ECU_ADDRESS 0x8FF44A /end MEASUREMENT
/begin MEASUREMENT InjCrv_qPiI1SetLim_mp "begrenzte Solleinspritzmenge PiI1" SWORD InjMassInj 1 100 -327.6800 327.6700 FORMAT "%8.4" ECU_ADDRESS 0x8FF44C /end MEASUREMENT
/begin MEASUREMENT InjCrv_qPiI1SetRaw_mp "Rohwert der Einspritzmenge PiI1" SWORD InjMassInj 1 100 -327.6800 327.6700 FORMAT "%8.4" ECU_ADDRESS 0x8FF44E /end MEASUREMENT
/begin MEASUREMENT InjCrv_qPiI1Set_mp "Sollwert der Einspritzmenge PiI1" SWORD InjMassInj 1 100 -327.6800 327.6700 FORMAT "%8.4" ECU_ADDRESS 0x8FF450 /end MEASUREMENT
/begin MEASUREMENT InjCrv_qPiI2Des "gewünschte Einspritzmenge PiI 2" SWORD InjMassInj 1 100 -327.6800 327.6700 FORMAT "%8.4" ECU_ADDRESS 0x7F8EC2 /end MEASUREMENT
/begin MEASUREMENT InjCrv_qPiI2DesByp_mp "Bypass-Label, Kopie von InjCrv_qPiI2Des" SWORD InjMassInj 1 100 -327.6800 327.6700 FORMAT "%8.4" ECU_ADDRESS 0x8FF452 /end MEASUREMENT
/begin MEASUREMENT InjCrv_qPiI3Des "gewünschte Einspritzmenge PiI 3" SWORD InjMassInj 1 100 -327.6800 327.6700 FORMAT "%8.4" ECU_ADDRESS 0x7F8ECA /end MEASUREMENT
/begin MEASUREMENT InjCrv_qPiI3DesByp_mp "Bypass-Label, Kopie von InjCrv_qPiI3Des" SWORD InjMassInj 1 100 -327.6800 327.6700 FORMAT "%8.4" ECU_ADDRESS 0x8FF454 /end MEASUREMENT
/begin MEASUREMENT InjCrv_qPiIMin_mp "minimale Einspritzmenge einer Voreinspritzung, ohne Wellenkorrektur" SWORD InjMassInj 1 100 -327.6800 327.6700 FORMAT "%8.4" ECU_ADDRESS 0x8FF456 /end MEASUREMENT
/begin MEASUREMENT InjCrv_qPoI1AddCor "kundenspezifische Korrekturmenge für PoI1" SWORD InjMassInj 1 100 -327.6800 327.6700 FORMAT "%8.4" ECU_ADDRESS 0x7F8ECC /end MEASUREMENT
/begin MEASUREMENT InjCrv_qPoI1APSCor_mp "atmospärendruckabhängige Korrekturmenge für PoI1" SWORD InjMassInj 1 100 -327.6800 327.6700 FORMAT "%8.4" ECU_ADDRESS 0x8FF4D8 /end MEASUREMENT
/begin MEASUREMENT InjCrv_qPoI1Bas_mp "Grundwert der Einspritzmenge PoI1" SWORD InjMassInj 1 100 -327.6800 327.6700 FORMAT "%8.4" ECU_ADDRESS 0x8FF4C2 /end MEASUREMENT
/begin MEASUREMENT InjCrv_qPoI1Clsn "zylinderselektiver Mengenanteil PoI1 bei Kollision" SWORD InjMassInj 1 100 -327.6800 327.6700 FORMAT "%8.4" ECU_ADDRESS 0x7F8ECE /end MEASUREMENT
/begin MEASUREMENT InjCrv_qPoI1Des "gewünschte Einspritzmenge PoI1" SWORD InjMassInj 1 100 -327.6800 327.6700 FORMAT "%8.4" ARRAY_SIZE 6 ECU_ADDRESS 0x7F9330 /end MEASUREMENT
/begin MEASUREMENT InjCrv_qPoI1DesByp_mp "Bypass-Label, Kopie von InjCrv_qPoI1Des" SWORD InjMassInj 1 100 -327.6800 327.6700 FORMAT "%8.4" ECU_ADDRESS 0x8FF4C4 /end MEASUREMENT
/begin MEASUREMENT InjCrv_qPoI1Des_mp "Sollmenge Nacheinspritzung 1" SWORD InjMassInj 1 100 -327.6800 327.6700 FORMAT "%8.4" ECU_ADDRESS 0x8FF4C6 /end MEASUREMENT
/begin MEASUREMENT InjCrv_qPoI1EnvCor "umgebungsbedingungsabhängige Korrekturmenge für PoI1" SWORD InjMassInj 1 100 -327.6800 327.6700 FORMAT "%8.4" ECU_ADDRESS 0x7F8ED0 /end MEASUREMENT
/begin MEASUREMENT InjCrv_qPoI1ETSCor_mp "motortemperaturabhängige Korrekturmenge für PoI1" SWORD InjMassInj 1 100 -327.6800 327.6700 FORMAT "%8.4" ECU_ADDRESS 0x8FF4DA /end MEASUREMENT
/begin MEASUREMENT InjCrv_qPoI1Lim_mp "begrenzte Einspritzmenge PoI1" SWORD InjMassInj 1 100 -327.6800 327.6700 FORMAT "%8.4" ECU_ADDRESS 0x8FF4C8 /end MEASUREMENT
/begin MEASUREMENT InjCrv_qPoI1Max_mp "Maximalwert der Einspritzmenge PoI1" SWORD InjMassInj 1 100 -327.6800 327.6700 FORMAT "%8.4" ECU_ADDRESS 0x8FF4CA /end MEASUREMENT
/begin MEASUREMENT InjCrv_qPoI1Min_mp "Minimalwert der Einspritzmenge PoI1" SWORD InjMassInj 1 100 -327.6800 327.6700 FORMAT "%8.4" ECU_ADDRESS 0x8FF4CC /end MEASUREMENT
/begin MEASUREMENT InjCrv_qPoI1Rgn "Grundwert Einspritzmenge PoI1 im Regenerationsbetrieb" SWORD InjMassInj 1 100 -327.6800 327.6700 FORMAT "%8.4" ECU_ADDRESS 0x7F8ED2 /end MEASUREMENT
/begin MEASUREMENT InjCrv_qPoI1Rgn1_mp "Regeneration value 1 for the PoI1 injectin quantity" SWORD InjMassInj 1 100 -327.6800 327.6700 FORMAT "%8.4" ECU_ADDRESS 0x8FF4E2 /end MEASUREMENT
/begin MEASUREMENT InjCrv_qPoI1Rgn2_mp "Regeneration value 2 for the PoI1 injectin quantity" SWORD InjMassInj 1 100 -327.6800 327.6700 FORMAT "%8.4" ECU_ADDRESS 0x8FF4E4 /end MEASUREMENT
/begin MEASUREMENT InjCrv_qPoI1RgnByp_mp "Measure point for Bypass" SWORD InjMassInj 1 100 -327.6800 327.6700 FORMAT "%8.4" ECU_ADDRESS 0x8FF4E6 /end MEASUREMENT
/begin MEASUREMENT InjCrv_qPoI1SetLim_mp "PoI1 total quantity before limitations" SWORD InjMassInj 1 100 -327.6800 327.6700 FORMAT "%8.4" ECU_ADDRESS 0x8FF4CE /end MEASUREMENT
/begin MEASUREMENT InjCrv_qPoI1Set_mp "Sollwert der Einspritzmenge PoI1" SWORD InjMassInj 1 100 -327.6800 327.6700 FORMAT "%8.4" ECU_ADDRESS 0x8FF4D0 /end MEASUREMENT
/begin MEASUREMENT InjCrv_qPoI2AddCor "kundenspezifische Korrekturmenge für PoI2" SWORD InjMassInj 1 100 -327.6800 327.6700 FORMAT "%8.4" ECU_ADDRESS 0x7F8ED4 /end MEASUREMENT
/begin MEASUREMENT InjCrv_qPoI2ATSCor_mp "ansauglufttemperaturabhängige Korrekturmenge für PoI2" SWORD InjMassInj 1 100 -327.6800 327.6700 FORMAT "%8.4" ECU_ADDRESS 0x8FF4EC /end MEASUREMENT
/begin MEASUREMENT InjCrv_qPoI2Bas_mp "Einspritzmenge PoI2 Grundwert" SWORD InjMassInj 1 100 -327.6800 327.6700 FORMAT "%8.4" ECU_ADDRESS 0x8FF50A /end MEASUREMENT
/begin MEASUREMENT InjCrv_qPoI2Cor_mp "korrigierter Grundwert der Einspritzmenge PoI2" SWORD InjMassInj 1 100 -327.6800 327.6700 FORMAT "%8.4" ECU_ADDRESS 0x8FF50C /end MEASUREMENT
/begin MEASUREMENT InjCrv_qPoI2Des "Sollmenge Nacheinspritzung 2" SWORD InjMassInj 1 100 -327.6800 327.6700 FORMAT "%8.4" ARRAY_SIZE 6 ECU_ADDRESS 0x7F933C /end MEASUREMENT
/begin MEASUREMENT InjCrv_qPoI2DesByp_mp "Messpunkt für den Bypass" SWORD InjMassInj 1 100 -327.6800 327.6700 FORMAT "%8.4" ECU_ADDRESS 0x8FF544 /end MEASUREMENT
/begin MEASUREMENT InjCrv_qPoI2Des_mp "Sollmenge Nacheinspritzung 2" SWORD InjMassInj 1 100 -327.6800 327.6700 FORMAT "%8.4" ECU_ADDRESS 0x8FF50E /end MEASUREMENT
/begin MEASUREMENT InjCrv_qPoI2Eff "wirksame Einspritzmenge PoI2" SWORD InjMassInj 1 100 -327.6800 327.6700 FORMAT "%8.4" ARRAY_SIZE 6 ECU_ADDRESS 0x7F9348 /end MEASUREMENT
/begin MEASUREMENT InjCrv_qPoI2EffByp_mp "Messpunkt für den Bypass" SWORD InjMassInj 1 100 -327.6800 327.6700 FORMAT "%8.4" ECU_ADDRESS 0x8FF546 /end MEASUREMENT
/begin MEASUREMENT InjCrv_qPoI2Eff_mp "Wirksame Menge der PoI2" SWORD InjMassInj 1 100 -327.6800 327.6700 FORMAT "%8.4" ECU_ADDRESS 0x8FF510 /end MEASUREMENT
/begin MEASUREMENT InjCrv_qPoI2EnvCor "Korrekturmenge für PoI2" SWORD InjMassInj 1 100 -327.6800 327.6700 FORMAT "%8.4" ECU_ADDRESS 0x7F8ED6 /end MEASUREMENT
/begin MEASUREMENT InjCrv_qPoI2ETSCor_mp "motortemperaturabhängige Korrekturmenge für PoI2" SWORD InjMassInj 1 100 -327.6800 327.6700 FORMAT "%8.4" ECU_ADDRESS 0x8FF4EE /end MEASUREMENT
/begin MEASUREMENT InjCrv_qPoI2Lim_mp "begrenzter Sollwert, Einspritzmenge PoI2" SWORD InjMassInj 1 100 -327.6800 327.6700 FORMAT "%8.4" ECU_ADDRESS 0x8FF512 /end MEASUREMENT
/begin MEASUREMENT InjCrv_qPoI2Max_mp "maximale Einspritzmenge PoI2" SWORD InjMassInj 1 100 -327.6800 327.6700 FORMAT "%8.4" ECU_ADDRESS 0x8FF514 /end MEASUREMENT
/begin MEASUREMENT InjCrv_qPoI2Min_mp "minimale Einspritzmenge PoI2" SWORD InjMassInj 1 100 -327.6800 327.6700 FORMAT "%8.4" ECU_ADDRESS 0x8FF516 /end MEASUREMENT
/begin MEASUREMENT InjCrv_qPoI2Rgn "Grundwert Einspritzmenge PoI2 im Regenerationsbetrieb" SWORD InjMassInj 1 100 -327.6800 327.6700 FORMAT "%8.4" ECU_ADDRESS 0x7F8ED8 /end MEASUREMENT
/begin MEASUREMENT InjCrv_qPoI2Rgn1_mp "Grundwert 1 für Regenerationsmenge Nacheinspritzung" SWORD InjMassInj 1 100 -327.6800 327.6700 FORMAT "%8.4" ECU_ADDRESS 0x8FF52A /end MEASUREMENT
/begin MEASUREMENT InjCrv_qPoI2Rgn2_mp "Regenerationswert 2  für Menge Nacheinspritzung" SWORD InjMassInj 1 100 -327.6800 327.6700 FORMAT "%8.4" ECU_ADDRESS 0x8FF52C /end MEASUREMENT
/begin MEASUREMENT InjCrv_qPoI2RgnByp_mp "Measure point for Bypass" SWORD InjMassInj 1 100 -327.6800 327.6700 FORMAT "%8.4" ECU_ADDRESS 0x8FF52E /end MEASUREMENT
/begin MEASUREMENT InjCrv_qPoI2RgnCor "correction value for PoI2 quantity" SWORD InjMassInj 1 100 -327.6800 327.6700 FORMAT "%8.4" ECU_ADDRESS 0x7F8EDA /end MEASUREMENT
/begin MEASUREMENT InjCrv_qPoI2Set_mp "Sollwert Einspritzmenge PoI2" SWORD InjMassInj 1 100 -327.6800 327.6700 FORMAT "%8.4" ECU_ADDRESS 0x8FF518 /end MEASUREMENT
/begin MEASUREMENT InjCrv_stPiI1_mp "Freigabestatus PiI1" UBYTE OneToOne 1 100 0.00 255.0 FORMAT "%5.1" ECU_ADDRESS 0x6F817A /end MEASUREMENT
/begin MEASUREMENT InjCrv_stPoI1_mp "Freigabestatus PoI1" UBYTE OneToOne 1 100 0.00 255.0 FORMAT "%5.1" ECU_ADDRESS 0x8FF4D2 /end MEASUREMENT
/begin MEASUREMENT InjCrv_stPoI2 "Freigabestatus PoI2" UBYTE OneToOne 1 100 0.00 255.0 FORMAT "%5.1" ECU_ADDRESS 0x7F890D /end MEASUREMENT
/begin MEASUREMENT InjCrv_swtPoI2AgAbsTDC_mp "Status des Betriebsmodus Ansteuerbeginn PoI2 (entweder Winkel absolut zum TDC oder Winkel bzw. Zeit relativ zur MI)" UBYTE OneToOne 1 100 0.00 255.0 FORMAT "%5.1" ECU_ADDRESS 0x8FF548 /end MEASUREMENT
/begin MEASUREMENT InjCrv_tiPiI1CorRaw_mp "korrigierter Grundwert Zeitkomponente" SWORD InjTime_us 1 100 -32768.00 32767.00 FORMAT "%8.2" ECU_ADDRESS 0x8FF458 /end MEASUREMENT
/begin MEASUREMENT InjCrv_tiPiI1Cor_mp "korrigierter Grundwert der Zeitkomponente Ansteuerbeginn PiI" SWORD InjTime_us 1 100 -32768.00 32767.00 FORMAT "%8.2" ECU_ADDRESS 0x8FF45A /end MEASUREMENT
/begin MEASUREMENT InjCrv_tiPiI1Des "gewünschte Zeitkomponente Ansteuerbeginn PiI1" SWORD InjTime_us 1 100 -32768.00 32767.00 FORMAT "%8.2" ECU_ADDRESS 0x7F8EE8 /end MEASUREMENT
/begin MEASUREMENT InjCrv_tiPiI1DesByp_mp "Bypass-Label, Kopie von InjCrv_tiPiI1Des" SWORD InjTime_us 1 100 -32768.00 32767.00 FORMAT "%8.2" ECU_ADDRESS 0x8FF45C /end MEASUREMENT
/begin MEASUREMENT InjCrv_tiPiI1EnvCor "Korrekturzeit für PiI1" SWORD InjTime_us 1 100 -32768.00 32767.00 FORMAT "%8.2" ECU_ADDRESS 0x7F8EEA /end MEASUREMENT
/begin MEASUREMENT InjCrv_tiPiI1EnvCor2 "umgebungsabhängige Korrekturzeit -2 für PiI1 (n sync)" SWORD InjTime_us 1 100 -32768.00 32767.00 FORMAT "%8.2" ECU_ADDRESS 0x7F8EEC /end MEASUREMENT
/begin MEASUREMENT InjCrv_tiPiI1EnvCorStrt "Korrekturzeit für PiI1für inaktive PiI2" SWORD InjTime_us 1 100 -32768.00 32767.00 FORMAT "%8.2" ECU_ADDRESS 0x7F8EEE /end MEASUREMENT
/begin MEASUREMENT InjCrv_tiPiI1ETNoCor_mp "geschätzte Ansteuerdauer der PiI1 ohne Korrekturen" SWORD InjTime_us 1 100 -32768.00 32767.00 FORMAT "%8.2" ECU_ADDRESS 0x8FF45E /end MEASUREMENT
/begin MEASUREMENT InjCrv_tiPiI1ETSCor12_mp "motortemperaturabhängiger Korrekturgrundwert für die Zeitkomponente des Ansteuerbeginns der PiI1 bei inaktiver PiI2" SWORD InjTime_us 1 100 -32768.00 32767.00 FORMAT "%8.2" ECU_ADDRESS 0x8FF49C /end MEASUREMENT
/begin MEASUREMENT InjCrv_tiPiI1ETSCor1_mp "motortemperaturabhängiger Korrekturgrundwert -1 für die Zeitkomponente Ansteuerbeginn PiI1" SWORD InjTime_us 1 100 -32768.00 32767.00 FORMAT "%8.2" ECU_ADDRESS 0x8FF49E /end MEASUREMENT
/begin MEASUREMENT InjCrv_tiPiI1ETSCor2_mp "motortemperaturabhängiger Korrekturgrundwert -2 für die Zeitkomponente Ansteuerbeginn PiI1" SWORD InjTime_us 1 100 -32768.00 32767.00 FORMAT "%8.2" ECU_ADDRESS 0x8FF4A0 /end MEASUREMENT
/begin MEASUREMENT InjCrv_tiPiI1ETSCorStrt_mp "motortemperaturabhängiger Korrekturgrundwert für die Zeitkomponente des Ansteuerbeginns der PiI1 bei inaktiver PiI2 im Startzust" SWORD InjTime_us 1 100 -32768.00 32767.00 FORMAT "%8.2" ECU_ADDRESS 0x8FF4A2 /end MEASUREMENT
/begin MEASUREMENT InjCrv_tiPiI1ETSCor_mp "motortemperaturabhängiger Korrekturgrundwert für die Zeitkomponente des Ansteuerbeginns der PiI1" SWORD InjTime_us 1 100 -32768.00 32767.00 FORMAT "%8.2" ECU_ADDRESS 0x8FF4A4 /end MEASUREMENT
/begin MEASUREMENT InjCrv_tiPiI1ET_mp "geschätzte Ansteuerdauer der PiI1" SWORD InjTime_us 1 100 -32768.00 32767.00 FORMAT "%8.2" ECU_ADDRESS 0x8FF460 /end MEASUREMENT
/begin MEASUREMENT InjCrv_tiPiI1Hyd_mp "Zeitkomponente Ansteuerbeginn PiI1 für die Berechnung des Ansteuerbeginns der PiI2" SWORD InjTime_us 1 100 -32768.00 32767.00 FORMAT "%8.2" ECU_ADDRESS 0x8FF462 /end MEASUREMENT
/begin MEASUREMENT InjCrv_tiPiI1Min_mp "Minimaler Zeitanteil für PiI1 relativ zur MI" SWORD InjTime_us 1 100 -32768.00 32767.00 FORMAT "%8.2" ECU_ADDRESS 0x8FF464 /end MEASUREMENT
/begin MEASUREMENT InjCrv_tiPiI1RelMI1_mp "Zeitkomponente Ansteuerbeginn PiI1 relativ zur MI1" SWORD InjTime_us 1 100 -32768.00 32767.00 FORMAT "%8.2" ECU_ADDRESS 0x8FF466 /end MEASUREMENT
/begin MEASUREMENT InjCrv_tiPiI1RelTot_mp "Ansteuerbeginnabstand PiI1 aus Winkel- und Zeitkomponente" SWORD InjTime_us 1 100 -32768.00 32767.00 FORMAT "%8.2" ECU_ADDRESS 0x8FF468 /end MEASUREMENT
/begin MEASUREMENT InjCrv_tiPiI1Rel_mp "Zeitkomponente Ansteuerbeginn PiI1 relativ zur MI" SWORD InjTime_us 1 100 -32768.00 32767.00 FORMAT "%8.2" ECU_ADDRESS 0x8FF46A /end MEASUREMENT
/begin MEASUREMENT InjCrv_tiPiI1Rgn "Regenerationswert für die  Zeitkomponente des Ansteuerbeginns der PiI1" SWORD InjTime_us 1 100 -32768.00 32767.00 FORMAT "%8.2" ECU_ADDRESS 0x7F8EF0 /end MEASUREMENT
/begin MEASUREMENT InjCrv_tiPiI1RgnByp_mp "Measure point for Bypass" SWORD InjTime_us 1 100 -32768.00 32767.00 FORMAT "%8.2" ECU_ADDRESS 0x8FF4AA /end MEASUREMENT
/begin MEASUREMENT InjCrv_tiPiI1Tot_mp "gesamte Ansteuerdauer der Pil1" SWORD InjTime_us 1 100 -32768.00 32767.00 FORMAT "%8.2" ECU_ADDRESS 0x8FF46C /end MEASUREMENT
/begin MEASUREMENT InjCrv_tiPiI2Des "gewünschte Zeitkomponente für Ansteuerbeginn PiI2" SWORD InjTime_us 1 100 -32768.00 32767.00 FORMAT "%8.2" ECU_ADDRESS 0x7F8EF4 /end MEASUREMENT
/begin MEASUREMENT InjCrv_tiPiI2DesByp_mp "Bypass-Label, Kopie von InjCrv_tiPiI2Des" SWORD InjTime_us 1 100 -32768.00 32767.00 FORMAT "%8.2" ECU_ADDRESS 0x8FF46E /end MEASUREMENT
/begin MEASUREMENT InjCrv_tiPoI1ET_mp "geschätzte Ansteuerdauer PoI1" SWORD InjTime_us 1 100 -32768.00 32767.00 FORMAT "%8.2" ECU_ADDRESS 0x8FF4D4 /end MEASUREMENT
/begin MEASUREMENT InjCrv_tiPoI2AddCor "kundenspezifische Korrekturzeit für PoI2" SWORD InjTime_us 1 100 -32768.00 32767.00 FORMAT "%8.2" ECU_ADDRESS 0x7F8EFC /end MEASUREMENT
/begin MEASUREMENT InjCrv_tiPoI2ATSCor_mp "ansauglufttemperaturabhängiger Korrekturgrundwert für die Zeitkomponente des Ansteuerbeginns der PoI2" SWORD InjTime_us 1 100 -32768.00 32767.00 FORMAT "%8.2" ECU_ADDRESS 0x8FF500 /end MEASUREMENT
/begin MEASUREMENT InjCrv_tiPoI2Bas_mp "Zeitkomponente Ansteuerbeginn PoI2 Grundwert" SWORD InjTime_us 1 100 -32768.00 32767.00 FORMAT "%8.2" ECU_ADDRESS 0x8FF556 /end MEASUREMENT
/begin MEASUREMENT InjCrv_tiPoI2Byp_mp "Messpunkt für den Bypass" SWORD InjTime_us 1 100 -32768.00 32767.00 FORMAT "%8.2" ECU_ADDRESS 0x8FF54A /end MEASUREMENT
/begin MEASUREMENT InjCrv_tiPoI2Cor_mp "korrigierter Grundwert der Zeitkomponente Ansteuerbeginn PoI2" SWORD InjTime_us 1 100 -32768.00 32767.00 FORMAT "%8.2" ECU_ADDRESS 0x8FF54C /end MEASUREMENT
/begin MEASUREMENT InjCrv_tiPoI2Des "gewünschte Bezugszeitkomponente für Beginn PoI2" SWORD InjTime_us 1 100 -32768.00 32767.00 FORMAT "%8.2" ECU_ADDRESS 0x7F8EFE /end MEASUREMENT
/begin MEASUREMENT InjCrv_tiPoI2EnvCor "Korrekturzeit für PoI2" SWORD InjTime_us 1 100 -32768.00 32767.00 FORMAT "%8.2" ECU_ADDRESS 0x7F8F00 /end MEASUREMENT
/begin MEASUREMENT InjCrv_tiPoI2ETSCor_mp "motortemperaturabhängiger Korrekturgrundwert für die Zeitkomponente des Ansteuerbeginns der PoI2" SWORD InjTime_us 1 100 -32768.00 32767.00 FORMAT "%8.2" ECU_ADDRESS 0x8FF502 /end MEASUREMENT
/begin MEASUREMENT InjCrv_tiPoI2ET_mp "geschätzte Ansteuerdauer PoI2" SWORD InjTime_us 1 100 -32768.00 32767.00 FORMAT "%8.2" ECU_ADDRESS 0x8FF51A /end MEASUREMENT
/begin MEASUREMENT InjCrv_tiPoI2Max_mp "maximaler Ansteuerbeginn PoI2 relativ zur Haupteinspritzung" SWORD InjTime_us 1 100 -32768.00 32767.00 FORMAT "%8.2" ECU_ADDRESS 0x8FF54E /end MEASUREMENT
/begin MEASUREMENT InjCrv_tiPoI2RelTot_mp "Ansteuerbeginnabstand PoI2 aus Winkel- und Zeitkomponente" SWORD InjTime_us 1 100 -32768.00 32767.00 FORMAT "%8.2" ECU_ADDRESS 0x8FF550 /end MEASUREMENT
/begin MEASUREMENT InjCrv_tiPoI2Rel_mp "Zeitkomponente Ansteuerbeginn PoI2 relativ zur Haupteinspritzung" SWORD InjTime_us 1 100 -32768.00 32767.00 FORMAT "%8.2" ECU_ADDRESS 0x8FF552 /end MEASUREMENT
/begin MEASUREMENT InjCrv_tiPoI2Rgn "Grundwert der Zeitkomponente Ansteuerbeginn PoI2 im Regenerationsbetrieb" SWORD InjTime_us 1 100 -32768.00 32767.00 FORMAT "%8.2" ECU_ADDRESS 0x7F8F02 /end MEASUREMENT
/begin MEASUREMENT InjCrv_tiPoI2Rgn1_mp "corrected time component for PoI2 Regeneration 1" SWORD InjTime_us 1 100 -32768.00 32767.00 FORMAT "%8.2" ECU_ADDRESS 0x8FF530 /end MEASUREMENT
/begin MEASUREMENT InjCrv_tiPoI2Rgn2_mp "Corrected time component for PoI2 Regeneration 2" SWORD InjTime_us 1 100 -32768.00 32767.00 FORMAT "%8.2" ECU_ADDRESS 0x8FF532 /end MEASUREMENT
/begin MEASUREMENT InjCrv_tiPoI2RgnByp_mp "Measure point for Bypass" SWORD InjTime_us 1 100 -32768.00 32767.00 FORMAT "%8.2" ECU_ADDRESS 0x8FF534 /end MEASUREMENT
/begin MEASUREMENT InjCrv_tiPoI2RgnCor "correction value for PoI2 time" SWORD InjTime_us 1 100 -32768.00 32767.00 FORMAT "%8.2" ECU_ADDRESS 0x7F8F04 /end MEASUREMENT
/begin MEASUREMENT InjCrv_tiPse "feste oder gemessene Mindestzeit zwischen 2 Einspritzungen" SWORD InjTime_us 1 100 -32768.00 32767.00 FORMAT "%8.2" ECU_ADDRESS 0x7F8F06 /end MEASUREMENT
/begin MEASUREMENT InjCrv_volPiI1Cor_mp "korrigiertes Einspritzvolumen zur Ansteuerdauerabschätzung der PiI1" SWORD InjQntInj 1 100 -327.6800 327.6700 FORMAT "%8.4" ECU_ADDRESS 0x8FF470 /end MEASUREMENT
/begin MEASUREMENT InjCrv_volPiI1NoCor_mp "Einspritzvolumen ohne Korrekturen zur Ansteuerdauerabschätzung der PiI1" SWORD InjQntInj 1 100 -327.6800 327.6700 FORMAT "%8.4" ECU_ADDRESS 0x8FF472 /end MEASUREMENT
/begin MEASUREMENT InjCrv_volPiI1_mp "begrenztes Einspritzvolumen PiI1" SWORD InjQntInj 1 100 -327.6800 327.6700 FORMAT "%8.4" ECU_ADDRESS 0x8FF474 /end MEASUREMENT
/begin MEASUREMENT InjCrv_volPoI1_mp "begrenztes Einspritzvolumen PoI1" SWORD InjQntInj 1 100 -327.6800 327.6700 FORMAT "%8.4" ECU_ADDRESS 0x8FF4D6 /end MEASUREMENT
/begin MEASUREMENT InjCrv_volPoI2_mp "begrenztes Einspritzvolumen PoI2" SWORD InjQntInj 1 100 -327.6800 327.6700 FORMAT "%8.4" ECU_ADDRESS 0x8FF51C /end MEASUREMENT
/begin MEASUREMENT InjCtl_dAdjQntCS_mp "Checksumme der Mengenabgleichkennfeldwerte (im EEPROM abgelegt)" UBYTE OneToOne 1 100 0.00 255.0 FORMAT "%5.1" ECU_ADDRESS 0x8FF55A /end MEASUREMENT
/begin MEASUREMENT InjCtl_dDriftCS_mp "Checksumme der Mengendriftkompensationswerte (im EEPROM abgelegt)" UBYTE OneToOne 1 100 0.00 255.0 FORMAT "%5.1" ECU_ADDRESS 0x8FF55B /end MEASUREMENT
/begin MEASUREMENT InjCtl_dqSetUnBal "Kraftstoffmassengradient ohne FBC" SWORD InjMassPerSec_20ms 1 100 -16384.00 16383.50 FORMAT "%8.2" ECU_ADDRESS 0x7F8F08 /end MEASUREMENT
/begin MEASUREMENT InjCtl_facAdjSrvUnlim_mp "Serviceabgleich Faktor (im EEPROM abgelegt)" SWORD Fact 1 100 -4.000000 3.999878 FORMAT "%8.6" ECU_ADDRESS 0x8FF55C /end MEASUREMENT
/begin MEASUREMENT InjCtl_facAdjSrv_mp "Serviceabgleichfaktor (nach Limitierung)" SWORD Fact 1 100 -4.000000 3.999878 FORMAT "%8.6" ECU_ADDRESS 0x8FF55E /end MEASUREMENT
/begin MEASUREMENT InjCtl_qAdjQntUnlim_mp "Mengenabgleichwert vor Begrenzung" SWORD InjMassCyc 1 100 -327.6800 327.6700 FORMAT "%8.4" ECU_ADDRESS 0x8FF560 /end MEASUREMENT
/begin MEASUREMENT InjCtl_qAdjQnt_mp "Mengenabgleichwert" SWORD InjMassCyc 1 100 -327.6800 327.6700 FORMAT "%8.4" ECU_ADDRESS 0x8FF562 /end MEASUREMENT
/begin MEASUREMENT InjCtl_qCurr "Einspritzmenge aktueller Wert" SWORD InjMassCyc 1 100 -327.6800 327.6700 FORMAT "%8.4" ECU_ADDRESS 0x7F8F0A /end MEASUREMENT
/begin MEASUREMENT InjCtl_qCurrCor "fuel mass current value with FMA correction" SWORD InjMassCyc 1 100 -327.6800 327.6700 FORMAT "%8.4" ECU_ADDRESS 0x7F8F0C /end MEASUREMENT
/begin MEASUREMENT InjCtl_qCurrUnCor "aktuelle Menge ohne Korrektur durch Mengenmittelwertadaption (FMA)" SWORD InjMassCyc 1 100 -327.6800 327.6700 FORMAT "%8.4" ECU_ADDRESS 0x7F8F0E /end MEASUREMENT
/begin MEASUREMENT InjCtl_qDes "Einspritzmenge Wunschwert" SWORD InjMassCyc 1 100 -327.6800 327.6700 FORMAT "%8.4" ECU_ADDRESS 0x7F8F10 /end MEASUREMENT
/begin MEASUREMENT InjCtl_qDesCor " fuel mass desired value with FMA correction" SWORD InjMassCyc 1 100 -327.6800 327.6700 FORMAT "%8.4" ECU_ADDRESS 0x7F8F12 /end MEASUREMENT
/begin MEASUREMENT InjCtl_qDriftComp_mp "Mengendriftkompensationswert" SWORD InjMassCyc 1 100 -327.6800 327.6700 FORMAT "%8.4" ECU_ADDRESS 0x8FF564 /end MEASUREMENT
/begin MEASUREMENT InjCtl_qDriftLim1_mp "Mengendriftkompensationwert nach Begrenzung durch EEPROM-Werte" SWORD InjMassCyc 1 100 -327.6800 327.6700 FORMAT "%8.4" ECU_ADDRESS 0x8FF566 /end MEASUREMENT
/begin MEASUREMENT InjCtl_qDriftLim2_mp "Mengendriftkompensationswert nach Begrenzung durch Datensatz" SWORD InjMassCyc 1 100 -327.6800 327.6700 FORMAT "%8.4" ECU_ADDRESS 0x8FF568 /end MEASUREMENT
/begin MEASUREMENT InjCtl_qDriftMax1_mp "Mengendriftkompensationsbegrenzung (im EEPROM abgelegt)" SWORD InjMassCyc 1 100 -327.6800 327.6700 FORMAT "%8.4" ECU_ADDRESS 0x8FF56A /end MEASUREMENT
/begin MEASUREMENT InjCtl_qDriftMin1_mp "Mengendriftkompensationsbegrenzung (im EEPROM abgelegt)" SWORD InjMassCyc 1 100 -327.6800 327.6700 FORMAT "%8.4" ECU_ADDRESS 0x8FF56C /end MEASUREMENT
/begin MEASUREMENT InjCtl_qDriftUnlim_mp "Mengendriftkompensation unbegrenzt" SWORD InjMassCyc 1 100 -327.6800 327.6700 FORMAT "%8.4" ECU_ADDRESS 0x8FF56E /end MEASUREMENT
/begin MEASUREMENT InjCtl_qLim "Begrenzungsmenge" SWORD InjMassCyc 1 100 -327.6800 327.6700 FORMAT "%8.4" ECU_ADDRESS 0x7F8F14 /end MEASUREMENT
/begin MEASUREMENT InjCtl_qLimErr "Begrenzungsmenge im Falle eines Systemfehlers" SWORD InjMass 1 100 -327.6800 327.6700 FORMAT "%8.4" ECU_ADDRESS 0x7F8F16 /end MEASUREMENT
/begin MEASUREMENT InjCtl_qLimSoftShOff_mp "soft shutoff limit" SWORD InjMassCyc 1 100 -327.6800 327.6700 FORMAT "%8.4" ECU_ADDRESS 0x8FF576 /end MEASUREMENT
/begin MEASUREMENT InjCtl_qLimSwt "Ausgang RampSwitch-Block für Begrenzungsmenge im Systemfehlerfall" SWORD InjMassCyc 1 100 -327.6800 327.6700 FORMAT "%8.4" ECU_ADDRESS 0x7F8F18 /end MEASUREMENT
/begin MEASUREMENT InjCtl_qLim_mp "fuel mass limitation in normal case" SWORD InjMassCyc 1 100 -327.6800 327.6700 FORMAT "%8.4" ECU_ADDRESS 0x8FF578 /end MEASUREMENT
/begin MEASUREMENT InjCtl_qRaw "Einspritzmenge Rohwert" SWORD InjMassCyc 1 100 -327.6800 327.6700 FORMAT "%8.4" ECU_ADDRESS 0x7F8F1A /end MEASUREMENT
/begin MEASUREMENT InjCtl_qRawCor " fuel mass raw value with FMA correction" SWORD InjMassCyc 1 100 -327.6800 327.6700 FORMAT "%8.4" ECU_ADDRESS 0x7F8F1C /end MEASUREMENT
/begin MEASUREMENT InjCtl_qSet "Einspritzmenge Sollwert" SWORD InjMassCyc 1 100 -327.6800 327.6700 FORMAT "%8.4" ECU_ADDRESS 0x7F8F1E /end MEASUREMENT
/begin MEASUREMENT InjCtl_qSetUnBal "Einspritzmenge Sollwert ohne Mengenausgleichsregelung" SWORD InjMassCyc 1 100 -327.6800 327.6700 FORMAT "%8.4" ECU_ADDRESS 0x7F8F20 /end MEASUREMENT
/begin MEASUREMENT InjCtl_qSetUnCor_mp "Menge vor Eingriff von Mengenabgleich, Serviceabgleich, Mengendriftkompensation" SWORD InjMassCyc 1 100 -327.6800 327.6700 FORMAT "%8.4" ECU_ADDRESS 0x8FF570 /end MEASUREMENT
/begin MEASUREMENT InjCtl_stAdjQnt_mp "Status vom Mengenabgleich" UBYTE OneToOne 1 100 0.00 255.0 FORMAT "%5.1" ECU_ADDRESS 0x8FF572 /end MEASUREMENT
/begin MEASUREMENT InjCtl_stNoInj "Status für keine Einspritzung (0 -> Einspritzung, 1 -> InjCtl_qSetUnBal == 0)" UBYTE OneToOne 1 100 0.00 255.0 FORMAT "%5.1" ECU_ADDRESS 0x7F890F /end MEASUREMENT
/begin MEASUREMENT InjCtl_stQLimErr "Status Begrenzungsmenge im Falle eines Systemfehlers (soll verwendet werden)" UBYTE OneToOne 1 100 0.00 255.0 FORMAT "%5.1" ECU_ADDRESS 0x7F8910 /end MEASUREMENT
/begin MEASUREMENT InjCtl_tiEngOn_mp "Betriebsstundenzähler" SWORD TimeEngOnHrs 1 100 -596515.2 596497.0 FORMAT "%8.1" ECU_ADDRESS 0x8FF574 /end MEASUREMENT
/begin MEASUREMENT InjCtl_trqInrLim "Begrenzungsmoment (als inneres Moment) resultierend aus der Begrenzungsmenge InjCtl_qLim" SWORD Trq 1 100 -3276.800 3276.700 FORMAT "%8.3" ECU_ADDRESS 0x7F8F22 /end MEASUREMENT
/begin MEASUREMENT InjUn_numCylMI1_mp "Zylinder aktuell benutzt für 1. Haupteinspritzung" UBYTE OneToOne 1 100 0.00 255.0 FORMAT "%5.1" ECU_ADDRESS 0x6F817B /end MEASUREMENT
/begin MEASUREMENT InjUn_numCylMI2_mp "Zylinder aktuell benutzt für 2. Haupteinspritzung" UBYTE OneToOne 1 100 0.00 255.0 FORMAT "%5.1" ECU_ADDRESS 0x6F817C /end MEASUREMENT
/begin MEASUREMENT InjUn_numCylPiI1_mp "Zylindernummer zugehörend zur  Voreinspritzung 1" UBYTE OneToOne 1 100 0.00 255.0 FORMAT "%5.1" ECU_ADDRESS 0x6F817D /end MEASUREMENT
/begin MEASUREMENT InjUn_numCylPiI2_mp "Zylindernummer zugehörend zur Voreinspritzung 2" UBYTE OneToOne 1 100 0.00 255.0 FORMAT "%5.1" ECU_ADDRESS 0x6F817E /end MEASUREMENT
/begin MEASUREMENT InjUn_numCylPoI1_mp "Zylindernummer zugehörend zur Nacheinspritzung 1" UBYTE OneToOne 1 100 0.00 255.0 FORMAT "%5.1" ECU_ADDRESS 0x6F817F /end MEASUREMENT
/begin MEASUREMENT InjUn_numCylPoI2_mp "Zylindernummer zugehörend zur Nacheinspritzung 2" UBYTE OneToOne 1 100 0.00 255.0 FORMAT "%5.1" ECU_ADDRESS 0x6F8180 /end MEASUREMENT
/begin MEASUREMENT InjUn_pAct_mp "aktueller Raildruck ermittelt in InjUn_Sched" SWORD Pres_Rail 1 100 -3276.800 3276.700 FORMAT "%5.3" ECU_ADDRESS 0x8FF598 /end MEASUREMENT
/begin MEASUREMENT InjUn_qMI1Cor_mp "Korrigierte Menge der Haupteinspritzung 1" SWORD InjMassInj 1 100 -327.6800 327.6700 FORMAT "%8.4" ECU_ADDRESS 0x8FF57A /end MEASUREMENT
/begin MEASUREMENT InjUn_qPiI1Cor_mp "Korrigierte Menge der Voreinspritzung 1" SWORD InjMassInj 1 100 -327.6800 327.6700 FORMAT "%8.4" ECU_ADDRESS 0x8FF580 /end MEASUREMENT
/begin MEASUREMENT InjUn_qPiI2Cor_mp "Korrigierte Menge der Voreinspritzung 2" SWORD InjMassInj 1 100 -327.6800 327.6700 FORMAT "%8.4" ECU_ADDRESS 0x8FF586 /end MEASUREMENT
/begin MEASUREMENT InjUn_qPoI1Cor_mp "Korrigierte Menge der Nacheinspritzung 1" SWORD InjMassInj 1 100 -327.6800 327.6700 FORMAT "%8.4" ECU_ADDRESS 0x8FF58C /end MEASUREMENT
/begin MEASUREMENT InjUn_qPoI2Cor_mp "Korrigierte Menge der Nacheinspritzung 2" SWORD InjMassInj 1 100 -327.6800 327.6700 FORMAT "%8.4" ECU_ADDRESS 0x8FF592 /end MEASUREMENT
/begin MEASUREMENT InjUn_stInjValve "Abschaltanforderungen für Injektor" UBYTE OneToOne 1 100 0.00 255.0 FORMAT "%5.1" ECU_ADDRESS 0x7F8911 /end MEASUREMENT
/begin MEASUREMENT InjUn_stMIOffs_mp "gewählter Spannungsoffset für MI" UBYTE OneToOne 1 100 0.00 255.0 FORMAT "%5.1" ECU_ADDRESS 0x8FF59A /end MEASUREMENT
/begin MEASUREMENT InjUn_stPiI1Offs_mp "gewählter Spannungsoffset für PI1" UBYTE OneToOne 1 100 0.00 255.0 FORMAT "%5.1" ECU_ADDRESS 0x8FF59B /end MEASUREMENT
/begin MEASUREMENT InjUn_stPiI2Offs_mp "gewählter Spannungsoffset für PI2" UBYTE OneToOne 1 100 0.00 255.0 FORMAT "%5.1" ECU_ADDRESS 0x8FF59C /end MEASUREMENT
/begin MEASUREMENT InjUn_stPiI3Offs_mp "gewählter Spannungsoffset für PI3" UBYTE OneToOne 1 100 0.00 255.0 FORMAT "%5.1" ECU_ADDRESS 0x8FF59D /end MEASUREMENT
/begin MEASUREMENT InjUn_stShutOffReq "Abschaltanforderungen aus dem Einspritzsystem" UBYTE OneToOne 1 100 0.00 255.0 FORMAT "%5.1" ECU_ADDRESS 0x7F8912 /end MEASUREMENT
/begin MEASUREMENT InjUn_stSOPTstInjBeg_mp "Status Einspritzbeginn (0 = kein Fehler)" UBYTE OneToOne 1 100 0.00 255.0 FORMAT "%5.1" ECU_ADDRESS 0x8FF59E /end MEASUREMENT
/begin MEASUREMENT InjUn_stSOPTstInjDur_mp "Status Ansteuerdauer (0 = kein Fehler)" UBYTE OneToOne 1 100 0.00 255.0 FORMAT "%5.1" ECU_ADDRESS 0x8FF59F /end MEASUREMENT
/begin MEASUREMENT InjUn_stTst "allgemeiner Status der Tests, die im Einspritzsystem durchgeführt werden" UWORD OneToOne 1 100 0.00 65535.00 FORMAT "%8.2" ECU_ADDRESS 0x7F8F24 /end MEASUREMENT
/begin MEASUREMENT InjUn_volMI1CorCyc "zylinderspezifisches Korrekturvolumen aus Mengenausgleichsregelung und Injektor-Abgleichmenge für MI1" SWORD InjQntInj 1 100 -327.6800 327.6700 FORMAT "%8.4" ARRAY_SIZE 6 ECU_ADDRESS 0x7F9354 /end MEASUREMENT
/begin MEASUREMENT InjUn_volMI1Cor_mp "Korrigiertes Volumen der Haupteinspritzung 1" SWORD InjQntInj 1 100 -327.6800 327.6700 FORMAT "%8.4" ECU_ADDRESS 0x8FF57C /end MEASUREMENT
/begin MEASUREMENT InjUn_volMI1_mp "Einspritzvolumen der Haupteinspritzung 1 nach Mengenabgleich" SWORD InjQntInj 1 100 -327.6800 327.6700 FORMAT "%8.4" ECU_ADDRESS 0x8FF57E /end MEASUREMENT
/begin MEASUREMENT InjUn_volPiI1CorCyc "zylinderspezifisches Korrekturvolumen aus Mengenausgleichsregelung und Injektor-Abgleichmenge für PiI1" SWORD InjQntInj 1 100 -327.6800 327.6700 FORMAT "%8.4" ARRAY_SIZE 6 ECU_ADDRESS 0x7F9360 /end MEASUREMENT
/begin MEASUREMENT InjUn_volPiI1Cor_mp "Korrigiertes Volumen der Voreinspritzung 1" SWORD InjQntInj 1 100 -327.6800 327.6700 FORMAT "%8.4" ECU_ADDRESS 0x8FF582 /end MEASUREMENT
/begin MEASUREMENT InjUn_volPiI1_mp "Einspritzvolumen der Voreinspritzung 1 nach Mengenabgleich" SWORD InjQntInj 1 100 -327.6800 327.6700 FORMAT "%8.4" ECU_ADDRESS 0x8FF584 /end MEASUREMENT
/begin MEASUREMENT InjUn_volPiI2CorCyc "zylinderspezifisches Korrekturvolumen aus Mengenausgleichsregelung und Injektor-Abgleichmenge für PiI2" SWORD InjQntInj 1 100 -327.6800 327.6700 FORMAT "%8.4" ARRAY_SIZE 6 ECU_ADDRESS 0x7F936C /end MEASUREMENT
/begin MEASUREMENT InjUn_volPiI2Cor_mp "Korrigiertes Volumen der Voreinspritzung 2" SWORD InjQntInj 1 100 -327.6800 327.6700 FORMAT "%8.4" ECU_ADDRESS 0x8FF588 /end MEASUREMENT
/begin MEASUREMENT InjUn_volPiI2_mp "Einspritzvolumen der Voreinspritzung 2 nach Mengenabgleich" SWORD InjQntInj 1 100 -327.6800 327.6700 FORMAT "%8.4" ECU_ADDRESS 0x8FF58A /end MEASUREMENT
/begin MEASUREMENT InjUn_volPoI1Cor_mp "Korrigiertes Volumen der Nacheinspritzung 1" SWORD InjQntInj 1 100 -327.6800 327.6700 FORMAT "%8.4" ECU_ADDRESS 0x8FF58E /end MEASUREMENT
/begin MEASUREMENT InjUn_volPoI1_mp "Einspritzvolumen der Nacheinspritzung 1 nach Mengenabgleich" SWORD InjQntInj 1 100 -327.6800 327.6700 FORMAT "%8.4" ECU_ADDRESS 0x8FF590 /end MEASUREMENT
/begin MEASUREMENT InjUn_volPoI2Cor_mp "Korrigiertes Volumen der Nacheinspritzung 2" SWORD InjQntInj 1 100 -327.6800 327.6700 FORMAT "%8.4" ECU_ADDRESS 0x8FF594 /end MEASUREMENT
/begin MEASUREMENT InjUn_volPoI2_mp "Einspritzvolumen der Nacheinspritzung 2 nach Mengenabgleich" SWORD InjQntInj 1 100 -327.6800 327.6700 FORMAT "%8.4" ECU_ADDRESS 0x8FF596 /end MEASUREMENT
/begin MEASUREMENT InjVCD_chgUpActrCurr "geflossene Ladung beim Laden des Aktors von Bottom- auf Up-Niveau" SWORD Charge_PA 1 100 -32768.00 32767.00 FORMAT "%8.2" ARRAY_SIZE 6 ECU_ADDRESS 0x7F939C /end MEASUREMENT
/begin MEASUREMENT InjVCD_cUpActrCurr "aktuelle Aktorkapazität (Laden)" SWORD Capacity_PA 1 100 -32.76800 32.76700 FORMAT "%8.5" ARRAY_SIZE 6 ECU_ADDRESS 0x7F9384 /end MEASUREMENT
/begin MEASUREMENT InjVCD_cUpActrOld "Vorletzte Aktorkapazitaet nach Laden von Bottom nach Up Niveau" SWORD Capacity_PA 1 100 -32.76800 32.76700 FORMAT "%8.5" ARRAY_SIZE 6 ECU_ADDRESS 0x7F9390 /end MEASUREMENT
/begin MEASUREMENT InjVCD_facAmp_mp "Stromverstärkungsfaktor des CY370-Integrators" SWORD Fact_IntAmp 1 100 -32.76800 32.76700 FORMAT "%8.5" ECU_ADDRESS 0x8FF5A0 /end MEASUREMENT
/begin MEASUREMENT InjVCD_facWActrDvt "Abweichungsfaktor des gemessenen Aktorenergieverbrauchs vom nominalen" SWORD Fact1 1 100 -256.0000 255.9922 FORMAT "%8.4" ECU_ADDRESS 0x7F8F26 /end MEASUREMENT
/begin MEASUREMENT InjVCD_facWActrDvt_mp "Korrigiertes und begrenztes Verhältnis von tatsächlichem zu normiertem Aktor-Energieverbrauch" SWORD Fact1 1 100 -256.0000 255.9922 FORMAT "%8.4" ECU_ADDRESS 0x8FF5AC /end MEASUREMENT
/begin MEASUREMENT InjVCD_facWActrRaw_mp "Verhältnis von tatsächlichem zu normiertem Aktor-Energieverbrauch" SWORD Fact1 1 100 -256.0000 255.9922 FORMAT "%8.4" ECU_ADDRESS 0x8FF5AE /end MEASUREMENT
/begin MEASUREMENT InjVCD_numFacWValid_mp "Anzahl gültiger Werte von InjVCD_facWActrDvt_mp" ULONG OneToOne 1 100 0.00 4294967295.00 FORMAT "%13.2" ECU_ADDRESS 0x6F81B4 /end MEASUREMENT
/begin MEASUREMENT InjVCD_numHandle "Handle of the TPU channel which holds the injection to be measured" UBYTE OneToOne 1 100 0.00 255.0 FORMAT "%5.1" ECU_ADDRESS 0x7F8913 /end MEASUREMENT
/begin MEASUREMENT InjVCD_numMeas "Nummer des Aktors der gerade vermessen wird" UBYTE OneToOne 1 100 0.00 255.0 FORMAT "%5.1" ECU_ADDRESS 0x7F8914 /end MEASUREMENT
/begin MEASUREMENT InjVCD_numOfsSelect_mp "zuletzt verwendeter Spannungsoffset" UBYTE OneToOne 1 100 0.00 255.0 FORMAT "%5.1" ECU_ADDRESS 0x8FF5A2 /end MEASUREMENT
/begin MEASUREMENT InjVCD_numWValid_mp "Anzahl der gültigen, gepaarten Lade- und Entladeenergiene (aktorspezifisch)" ULONG OneToOne 1 100 0.00 4294967295.00 FORMAT "%13.2" ARRAY_SIZE 6 ECU_ADDRESS 0x6F81B8 /end MEASUREMENT
/begin MEASUREMENT InjVCD_pActInj "verwendeter Raildruck der bei letzter Aktormessung gültig war" SWORD Pres_Rail 1 100 -3276.800 3276.700 FORMAT "%5.3" ECU_ADDRESS 0x7F8F2A /end MEASUREMENT
/begin MEASUREMENT InjVCD_rClsVolt_mp "Quotient aus Beginn- und Ende-Spannung" SLONG Milli 1 100 -2147483.64800 2147483.64700 FORMAT "%13.5" ARRAY_SIZE 6 ECU_ADDRESS 0x8FF5C4 /end MEASUREMENT
/begin MEASUREMENT InjVCD_stActrEnrg "Status der Aktorenergiemessung (aktorspezifisch)" UBYTE OneToOne 1 100 0.00 255.0 FORMAT "%5.1" ARRAY_SIZE 6 ECU_ADDRESS 0x7F92BE /end MEASUREMENT
/begin MEASUREMENT InjVCD_stAvrgEna "freigegebene Zylinder zur Mittelwertsberechnung" UBYTE OneToOne 1 100 0.00 255.0 FORMAT "%5.1" ECU_ADDRESS 0x7F8919 /end MEASUREMENT
/begin MEASUREMENT InjVCD_stAvrgEnaTiWarn "Warnung für geringe Zeitdifferenz" UBYTE OneToOne 1 100 0.00 255.0 FORMAT "%5.1" ECU_ADDRESS 0x7F891A /end MEASUREMENT
/begin MEASUREMENT InjVCD_stCalcChrgActr "Zustand der Ladungsberechnung" UBYTE OneToOne 1 100 0.00 255.0 FORMAT "%5.1" ECU_ADDRESS 0x7F891D /end MEASUREMENT
/begin MEASUREMENT InjVCD_stMeas "Zustand des Messkoordinators" UBYTE OneToOne 1 100 0.00 255.0 FORMAT "%5.1" ECU_ADDRESS 0x7F891F /end MEASUREMENT
/begin MEASUREMENT InjVCD_stMeasLvl "Status des aufgetretenen Spannungsniveaus des Piezoaktors" UBYTE OneToOne 1 100 0.00 255.0 FORMAT "%5.1" ECU_ADDRESS 0x7F8921 /end MEASUREMENT
/begin MEASUREMENT InjVCD_stMeasLvlFirst "Status des aufgetretenen ersten Spannungsniveaus des Piezoaktors" UBYTE OneToOne 1 100 0.00 255.0 FORMAT "%5.1" ECU_ADDRESS 0x7F8922 /end MEASUREMENT
/begin MEASUREMENT InjVCD_stMonChgActr "Status der Ladungsmessung (aktorspezifisch)" UBYTE OneToOne 1 100 0.00 255.0 FORMAT "%5.1" ARRAY_SIZE 6 ECU_ADDRESS 0x7F92C4 /end MEASUREMENT
/begin MEASUREMENT InjVCD_stMonTiPlaus "Status der einspritzspezifisch gemessenen Ladezeit" UBYTE OneToOne 1 100 0.00 255.0 FORMAT "%5.1" ARRAY_SIZE 2 ECU_ADDRESS 0x7F8F2C /end MEASUREMENT
/begin MEASUREMENT InjVCD_stMonUBnkPlaus "Status der gemessenen Aktorspannung des Ansteuerverlaufs (Bank-spezifisch)" UBYTE OneToOne 1 100 0.00 255.0 FORMAT "%5.1" ARRAY_SIZE 2 ECU_ADDRESS 0x7F8F2E /end MEASUREMENT
/begin MEASUREMENT InjVCD_stMonUCylPlaus "Status der gemessenen Aktorspannung des Ansteuerverlaufs (zylinder-spezifisch)" UBYTE OneToOne 1 100 0.00 255.0 FORMAT "%5.1" ARRAY_SIZE 6 ECU_ADDRESS 0x7F92CA /end MEASUREMENT
/begin MEASUREMENT InjVCD_stShCirSelSwtCab "Status ""Cylinder-Select Schalter Kurzschluss"" und ""Kurzschluss zweier Injektorleitungen (lowside)""" UBYTE OneToOne 1 100 0.00 255.0 FORMAT "%5.1" ECU_ADDRESS 0x7F8926 /end MEASUREMENT
/begin MEASUREMENT InjVCD_stWaitPRailLow_mp "Status Raildruck" UBYTE OneToOne 1 100 0.00 255.0 FORMAT "%5.1" ECU_ADDRESS 0x8FF5DC /end MEASUREMENT
/begin MEASUREMENT InjVCD_stWValid_mp "Aktuelle Lade- und Entladeenergie ist gültig (aktorspezifisch)" UBYTE OneToOne 1 100 0.00 255.0 FORMAT "%5.1" ARRAY_SIZE 6 ECU_ADDRESS 0x6F81D0 /end MEASUREMENT
/begin MEASUREMENT InjVCD_swtSelTemp "Message zum Zeigen der aktuellen Schalterstellung" UBYTE Actr_Temp_Sel 1 100 0.00 1.00000000000 FORMAT "%13.11" ECU_ADDRESS 0x7F892A /end MEASUREMENT
/begin MEASUREMENT InjVCD_swtWActrNumValLo_mp "Schalter ""Anzahl gültiger Messwerte zu gering für Freigabe der Aktorenergiewerte"" (aktorspezifisch)" UBYTE OneToOne 1 100 0.00 255.0 FORMAT "%5.1" ARRAY_SIZE 6 ECU_ADDRESS 0x6F81D6 /end MEASUREMENT
/begin MEASUREMENT InjVCD_tActr "Aktortemperatur" SWORD Temp_Cels 1 100 -50.140 899.860 FORMAT "%8.3" ECU_ADDRESS 0x7F8F30 /end MEASUREMENT
/begin MEASUREMENT InjVCD_tActr_mp "Basistemperatur zur Berechnung der Piezo-Aktortemperatur" SWORD Temp_Cels 1 100 -50.140 899.860 FORMAT "%8.3" ECU_ADDRESS 0x8FF5BE /end MEASUREMENT
/begin MEASUREMENT InjVCD_tiChrgUpActr "Ladezeit vom Bottom zum Up Level" SWORD Time_Busy 1 100 -3276.800 3276.700 FORMAT "%8.3" ARRAY_SIZE 6 ECU_ADDRESS 0x7F93A8 /end MEASUREMENT
/begin MEASUREMENT InjVCD_tiChrgUpActrOld "Vorletzte Aktorladezeit nach Laden von bottom nach up Niveau" SWORD Time_Busy 1 100 -3276.800 3276.700 FORMAT "%8.3" ARRAY_SIZE 6 ECU_ADDRESS 0x7F93B4 /end MEASUREMENT
/begin MEASUREMENT InjVCD_tiDisChBottActr "Entladezeit vom Up zum Bottom Level" SWORD Time_Busy 1 100 -3276.800 3276.700 FORMAT "%8.3" ARRAY_SIZE 6 ECU_ADDRESS 0x7F93C0 /end MEASUREMENT
/begin MEASUREMENT InjVCD_tiInjDurMi_mp "Ansteuerdauer der Haupteinspritzung" SLONG InjTime_us 1 100 -2147483648.00 2147483647.00 FORMAT "%13.2" ECU_ADDRESS 0x6F8184 /end MEASUREMENT
/begin MEASUREMENT InjVCD_tiInjDur_mp "Einspritztyp spezifische Ansteuerdauern" SLONG InjTime_us 1 100 -2147483648.00 2147483647.00 FORMAT "%13.2" ARRAY_SIZE 8 ECU_ADDRESS 0x6F8188 /end MEASUREMENT
/begin MEASUREMENT InjVCD_tiMeasCycl "Abtastzeit der Aktormeßwerte" ULONG TimeDT 1 100 0.00 4294967295.00 FORMAT "%13.2" ECU_ADDRESS 0x7F9224 /end MEASUREMENT
/begin MEASUREMENT InjVCD_tiMeasCyclCyl "Periodendauer der Messung aktorspezifischer Werte" ULONG TimeDT 1 100 0.00 4294967295.00 FORMAT "%13.2" ARRAY_SIZE 6 ECU_ADDRESS 0x7F94B8 /end MEASUREMENT
/begin MEASUREMENT InjVCD_tiMI1ETUnLim_mp "energising time of Main Injection1" SWORD InjTime_us 1 100 -32768.00 32767.00 FORMAT "%8.2" ECU_ADDRESS 0x6F8200 /end MEASUREMENT
/begin MEASUREMENT InjVCD_tiMI1ET_mp "Ansteuerdauer der Haupteinspritzung 1" SWORD InjTime_us 1 100 -32768.00 32767.00 FORMAT "%8.2" ECU_ADDRESS 0x6F8202 /end MEASUREMENT
/begin MEASUREMENT InjVCD_tiPiI1ET_mp "Ansteuerdauer der Voreinspritzung 1" SWORD InjTime_us 1 100 -32768.00 32767.00 FORMAT "%8.2" ECU_ADDRESS 0x6F8204 /end MEASUREMENT
/begin MEASUREMENT InjVCD_tiPiI2ET_mp "Ansteuerdauer der Voreinspritzung 2" SWORD InjTime_us 1 100 -32768.00 32767.00 FORMAT "%8.2" ECU_ADDRESS 0x6F8208 /end MEASUREMENT
/begin MEASUREMENT InjVCD_tiPoI1ET_mp "Ansteuerdauer Nacheinspritzung 1" SWORD InjTime_us 1 100 -32768.00 32767.00 FORMAT "%8.2" ECU_ADDRESS 0x6F820C /end MEASUREMENT
/begin MEASUREMENT InjVCD_tiPoI2ET_mp "Ansteuerdauer der Nacheinspritzung 2" SWORD InjTime_us 1 100 -32768.00 32767.00 FORMAT "%8.2" ECU_ADDRESS 0x6F820E /end MEASUREMENT
/begin MEASUREMENT InjVCD_tiUpOri_mp "Busy-Zeit des CY370 - Einspritzbeginn-Typ  0:VE2, 1:VE1, 2:HE, 3:NE" SWORD Time_Busy 1 100 -3276.800 3276.700 FORMAT "%8.3" ARRAY_SIZE 6 ECU_ADDRESS 0x6F81A8 /end MEASUREMENT
/begin MEASUREMENT InjVCD_tiZFCPiI1ETCor_mp "ZFC Ansteuerdauerkorrektur fuer Voreinspritzung 1" SWORD InjTime_us 1 100 -32768.00 32767.00 FORMAT "%8.2" ECU_ADDRESS 0x6F8206 /end MEASUREMENT
/begin MEASUREMENT InjVCD_tiZFCPiI2ETCor_mp "ZFC Ansteuerdauerkorrektur fuer Voreinspritzung 2" SWORD InjTime_us 1 100 -32768.00 32767.00 FORMAT "%8.2" ECU_ADDRESS 0x6F820A /end MEASUREMENT
/begin MEASUREMENT InjVCD_uBottActr "Spannung - Bottom Position - Ventil geschlossen" SWORD Volt_PA 1 100 -327.6800 327.6700 FORMAT "%8.4" ARRAY_SIZE 6 ECU_ADDRESS 0x7F93CC /end MEASUREMENT
/begin MEASUREMENT InjVCD_uChgUp_mp "Spannung vom Integrator für die Injektor Ladung zum UP NIveau" SWORD Volt 1 100 -160156.4 160151.5 FORMAT "%8.1" ECU_ADDRESS 0x8FF5A4 /end MEASUREMENT
/begin MEASUREMENT InjVCD_uClsBegin_mp "Aktorspezifisch gemessene Beginnspannung während der Piezoaktor Klassifizierung" SWORD Volt_PA 1 100 -327.6800 327.6700 FORMAT "%8.4" ARRAY_SIZE 6 ECU_ADDRESS 0x8FF5DE /end MEASUREMENT
/begin MEASUREMENT InjVCD_uClsEnd_mp "Aktorspezifisch gemessene Endspannung während der Piezoaktor Klassifizierung" SWORD Volt_PA 1 100 -327.6800 327.6700 FORMAT "%8.4" ARRAY_SIZE 6 ECU_ADDRESS 0x8FF5EA /end MEASUREMENT
/begin MEASUREMENT InjVCD_uIntComp_mp "Kompensationsspannung für Abfall der Integrator-Ausgangsspannung" SWORD Volt 1 100 -160156.4 160151.5 FORMAT "%8.1" ECU_ADDRESS 0x8FF5C0 /end MEASUREMENT
/begin MEASUREMENT InjVCD_uRawBott_mp "Aktor - Rohspannung (ADC)  - Ansteuerende (Messreihe)" SWORD Volt 1 100 -160156.4 160151.5 FORMAT "%8.1" ECU_ADDRESS 0x8FF5A6 /end MEASUREMENT
/begin MEASUREMENT InjVCD_uRawChgUp_mp "Rohspannung vom Integrator für die Injektorladung zum UP Niveau" SWORD Volt 1 100 -160156.4 160151.5 FORMAT "%8.1" ECU_ADDRESS 0x8FF5A8 /end MEASUREMENT
/begin MEASUREMENT InjVCD_uRawUp_mp "Aktor - Rohspannung (ADC)  - Ansteuerbeginn (Messreihe)" SWORD Volt 1 100 -160156.4 160151.5 FORMAT "%8.1" ECU_ADDRESS 0x8FF5AA /end MEASUREMENT
/begin MEASUREMENT InjVCD_uSetThresActr "verwendete Spannungsschwelle die bei letzter Aktormessung gültig war" SWORD Volt_PA 1 100 -327.6800 327.6700 FORMAT "%8.4" ARRAY_SIZE 6 ECU_ADDRESS 0x7F93D8 /end MEASUREMENT
/begin MEASUREMENT InjVCD_uSetThresActr_mp "Eingabewert für InjVCD_wActrNom_CUR" SWORD Volt_PA 1 100 -327.6800 327.6700 FORMAT "%8.4" ECU_ADDRESS 0x8FF5B0 /end MEASUREMENT
/begin MEASUREMENT InjVCD_uSetUpActr "Spannungssollwert für Regler" SWORD Volt_PA 1 100 -327.6800 327.6700 FORMAT "%8.4" ARRAY_SIZE 6 ECU_ADDRESS 0x7F93E4 /end MEASUREMENT
/begin MEASUREMENT InjVCD_uUpActr "Spannung - Up Position - Ventil geöffnet" SWORD Volt_PA 1 100 -327.6800 327.6700 FORMAT "%8.4" ARRAY_SIZE 6 ECU_ADDRESS 0x7F93F0 /end MEASUREMENT
/begin MEASUREMENT InjVCD_wActrDiff_mp "Differenz von Lade- und Entladeenergie des Piezo-Aktors (aktorspezifisch)" SWORD W_PA 1 100 -32768.00 32767.00 FORMAT "%8.2" ARRAY_SIZE 6 ECU_ADDRESS 0x6F81DC /end MEASUREMENT
/begin MEASUREMENT InjVCD_wActrNom_mp "Nominaler, injektorseitiger Energieverbrauch einer Piezo-Aktor-Ansteuerung" SWORD W_PA 1 100 -32768.00 32767.00 FORMAT "%8.2" ARRAY_SIZE 6 ECU_ADDRESS 0x8FF5B2 /end MEASUREMENT
/begin MEASUREMENT InjVCD_wChrgActr "Gemittelter Energieverbrauch beim Laden des Aktors (aktorspezifisch)" SWORD W_PA 1 100 -32768.00 32767.00 FORMAT "%8.2" ARRAY_SIZE 6 ECU_ADDRESS 0x7F93FC /end MEASUREMENT
/begin MEASUREMENT InjVCD_wChrgActrRaw_mp "Aktueller Energieverbrauch beim Laden des Aktors (aktorspezifisch)" SWORD W_PA 1 100 -32768.00 32767.00 FORMAT "%8.2" ARRAY_SIZE 6 ECU_ADDRESS 0x6F81E8 /end MEASUREMENT
/begin MEASUREMENT InjVCD_wDisChActr "Gemittelte Energierückspeisung beim Entladen des Aktors (aktorspezifisch)" SWORD W_PA 1 100 -32768.00 32767.00 FORMAT "%8.2" ARRAY_SIZE 6 ECU_ADDRESS 0x7F9408 /end MEASUREMENT
/begin MEASUREMENT InjVCD_wDisChActrRaw_mp "Aktuelle Energierückspeisung beim Entladen des Aktors (aktorspezifisch)" SWORD W_PA 1 100 -32768.00 32767.00 FORMAT "%8.2" ARRAY_SIZE 6 ECU_ADDRESS 0x6F81F4 /end MEASUREMENT
/begin FUNCTION injcrv_piienvcorslow "Berechnung der Gewichtungsfunktionen für die Voreinspritzung"
 /begin DEF_CHARACTERISTIC InjCrv_facPiI1APSQCor2Strt_CUR InjCrv_facPiI1APSQCor2_CUR InjCrv_facPiI1APSQCorStrt_CUR InjCrv_facPiI1APSQCor_AXIS InjCrv_facPiI1APSQCor_CUR InjCrv_facPiI1ATSQCor2Strt_CUR InjCrv_facPiI1ATSQCor2_CUR InjCrv_facPiI1ATSQCorStrt_CUR InjCrv_facPiI1ATSQCor_AXIS InjCrv_facPiI1ATSQCor_CUR InjCrv_facPiI1ETSQCor12_CUR InjCrv_facPiI1ETSQCor1_AXIS InjCrv_facPiI1ETSQCor1_CUR InjCrv_facPiI1ETSQCor2Strt_CUR InjCrv_facPiI1ETSQCor2_CUR InjCrv_facPiI1ETSQCorStrt_CUR InjCrv_facPiI1ETSQCor_AXIS InjCrv_facPiI1ETSQCor_CUR InjCrv_facPiI1ETSSOECor12_CUR InjCrv_facPiI1ETSSOECor1_AXIS InjCrv_facPiI1ETSSOECor1_CUR InjCrv_facPiI1ETSSOECor2_CUR InjCrv_facPiI1ETSSOECorStrt_CUR InjCrv_facPiI1ETSSOECor_AXIS InjCrv_facPiI1ETSSOECor_CUR /end DEF_CHARACTERISTIC
 /begin IN_MEASUREMENT APSCD_pVal IATSCD_tAir InjCrv_tEng /end IN_MEASUREMENT
/end FUNCTION
/begin FUNCTION injcrv_piienvcorslowrgn "Voreinspritzung - Umwelt - Gewichtungsfaktoren für den Regenerationsbetrieb" /end FUNCTION
/begin FUNCTION injcrv_piienvcorslowrgn_msg "" /end FUNCTION
/begin FUNCTION injcrv_piienvcorslowrgn_uic "" /end FUNCTION
/begin FUNCTION injcrv_piienvcorslow_msg ""
 /begin OUT_MEASUREMENT InjCrv_facPiI1APSQCor InjCrv_facPiI1APSQCor2 InjCrv_facPiI1APSQCorStrt InjCrv_facPiI1ATSQCor InjCrv_facPiI1ATSQCor2 InjCrv_facPiI1ATSQCorStrt InjCrv_facPiI1ETSQCor InjCrv_facPiI1ETSQCor1 InjCrv_facPiI1ETSQCor12 InjCrv_facPiI1ETSQCor2 InjCrv_facPiI1ETSQCorStrt InjCrv_facPiI1ETSSOECor InjCrv_facPiI1ETSSOECor1 InjCrv_facPiI1ETSSOECor12 InjCrv_facPiI1ETSSOECor2 InjCrv_facPiI1ETSSOECorStrt /end OUT_MEASUREMENT
/end FUNCTION
/begin FUNCTION injcrv_piienvcorslow_uic "" /end FUNCTION
/begin FUNCTION injcrv_piienvcorti ""
 /begin DEF_CHARACTERISTIC InjCrv_tiPiI1ETSCor12_MAP InjCrv_tiPiI1ETSCor1_MAP InjCrv_tiPiI1ETSCor2_MAP InjCrv_tiPiI1ETSCorStrt_MAP InjCrv_tiPiI1ETSCor_MAP /end DEF_CHARACTERISTIC
 /begin IN_MEASUREMENT Eng_nAvrg InjCtl_qSetUnBal /end IN_MEASUREMENT
/end FUNCTION
/begin FUNCTION injcrv_piienvcorti_uic ""
 /begin OUT_MEASUREMENT InjCrv_tiPiI1ETSCor12_mp InjCrv_tiPiI1ETSCor1_mp InjCrv_tiPiI1ETSCor2_mp InjCrv_tiPiI1ETSCorStrt_mp InjCrv_tiPiI1ETSCor_mp /end OUT_MEASUREMENT
/end FUNCTION
/begin FUNCTION injcrv_piienvcor_msg ""
 /begin OUT_MEASUREMENT InjCrv_phiPiI1EnvCor InjCrv_phiPiI1EnvCor2 InjCrv_qPiI1EnvCor InjCrv_qPiI1EnvCor2 InjCrv_qPiI1EnvCorStrt InjCrv_tiPiI1EnvCor InjCrv_tiPiI1EnvCor2 InjCrv_tiPiI1EnvCorStrt /end OUT_MEASUREMENT
/end FUNCTION
/begin FUNCTION injcrv_piienvcor_uic ""
 /begin OUT_MEASUREMENT InjCrv_qPiI1APSCor2_mp InjCrv_qPiI1APSCorStrt_mp InjCrv_qPiI1APSCor_mp InjCrv_qPiI1ATSCor2_mp InjCrv_qPiI1ATSCorStrt_mp InjCrv_qPiI1ATSCor_mp InjCrv_qPiI1ETSCor12_mp InjCrv_qPiI1ETSCor1_mp InjCrv_qPiI1ETSCor2_mp InjCrv_qPiI1ETSCorStrt_mp InjCrv_qPiI1ETSCor_mp /end OUT_MEASUREMENT
/end FUNCTION
/begin FUNCTION injcrv_piirgn "Voreinspritzung 1, Regenerationswertberechnung"
 /begin DEF_CHARACTERISTIC InjCrv_phiPiI1Rgn_MAP InjCrv_qPiI1Rgn_MAP InjCrv_tiPiI1Rgn_MAP /end DEF_CHARACTERISTIC
 /begin IN_MEASUREMENT Eng_nAvrg InjCtl_qSetUnBal /end IN_MEASUREMENT
/end FUNCTION
/begin FUNCTION injcrv_piirgnlib "Funktionsbibliothek für die Regenerationsumschaltung der Voreinspritzung 1"
 /begin DEF_CHARACTERISTIC InjCrv_dtiPiI1RgnRmpUp_C InjCrv_dtiPiI1RgnRmpDwn_C InjCrv_stPiI1RgnMsk_C /end DEF_CHARACTERISTIC
/end FUNCTION
/begin FUNCTION injcrv_piirgn_msg "" /begin OUT_MEASUREMENT InjCrv_phiPiI1Rgn InjCrv_qPiI1Rgn InjCrv_tiPiI1Rgn /end OUT_MEASUREMENT /end FUNCTION
/begin FUNCTION injcrv_piirgn_uic ""
 /begin DEF_CHARACTERISTIC InjCrv_phiPiI1RgnAdd_Vector InjCrv_phiPiI1RgnAdd_Channel InjCrv_phiPiI1Rgn_Vector InjCrv_phiPiI1Rgn_Channel InjCrv_qPiI1RgnAdd_Vector InjCrv_qPiI1RgnAdd_Channel InjCrv_qPiI1Rgn_Vector InjCrv_qPiI1Rgn_Channel InjCrv_tiPiI1RgnAdd_Vector InjCrv_tiPiI1RgnAdd_Channel InjCrv_tiPiI1Rgn_Vector InjCrv_tiPiI1Rgn_Channel /end DEF_CHARACTERISTIC
 /begin OUT_MEASUREMENT InjCrv_phiPiI1RgnByp_mp InjCrv_qPiI1RgnByp_mp InjCrv_tiPiI1RgnByp_mp /end OUT_MEASUREMENT
/end FUNCTION
/begin FUNCTION injcrv_piirmtctl_uic "" /end FUNCTION
/begin FUNCTION injcrv_pii_msg ""
 /begin OUT_MEASUREMENT InjCrv_phiPiI1Des InjCrv_phiPiI2Des InjCrv_phiPiI3Des InjCrv_qPiI1Des InjCrv_qPiI2Des InjCrv_qPiI3Des InjCrv_tiPiI1Des InjCrv_tiPiI2Des /end OUT_MEASUREMENT
/end FUNCTION
/begin FUNCTION injcrv_pii_uic ""
 /begin DEF_CHARACTERISTIC InjCrv_phiPiI1DesAdd_Vector InjCrv_phiPiI1DesAdd_Channel InjCrv_phiPiI1Des_Vector InjCrv_phiPiI1Des_Channel InjCrv_phiPiI2DesAdd_Vector InjCrv_phiPiI2DesAdd_Channel InjCrv_phiPiI2Des_Vector InjCrv_phiPiI2Des_Channel InjCrv_phiPiI3DesAdd_Vector InjCrv_phiPiI3DesAdd_Channel InjCrv_phiPiI3Des_Vector InjCrv_phiPiI3Des_Channel InjCrv_qPiI1DesAdd_Vector InjCrv_qPiI1DesAdd_Channel InjCrv_qPiI1Des_Vector InjCrv_qPiI1Des_Channel InjCrv_qPiI1SetByp_Vector InjCrv_qPiI1SetByp_Channel InjCrv_qPiI2DesAdd_Vector InjCrv_qPiI2DesAdd_Channel InjCrv_qPiI2Des_Vector InjCrv_qPiI2Des_Channel InjCrv_qPiI3DesAdd_Vector InjCrv_qPiI3DesAdd_Channel InjCrv_qPiI3Des_Vector InjCrv_qPiI3Des_Channel InjCrv_tiPiI1DesAdd_Vector InjCrv_tiPiI1DesAdd_Channel InjCrv_tiPiI1Des_Vector InjCrv_tiPiI1Des_Channel InjCrv_tiPiI2DesAdd_Vector InjCrv_tiPiI2DesAdd_Channel InjCrv_tiPiI2Des_Vector InjCrv_tiPiI2Des_Channel /end DEF_CHARACTERISTIC
 /begin OUT_MEASUREMENT InjCrv_facPiI1QntMin_mp InjCrv_phiPiI1AbsTot_mp InjCrv_phiPiI1Abs_mp InjCrv_phiPiI1Cor_mp InjCrv_phiPiI1DesByp_mp InjCrv_phiPiI1Rel_mp InjCrv_phiPiI2DesByp_mp InjCrv_phiPiI3DesByp_mp InjCrv_qMI1MinPiI1_mp InjCrv_qPiI1Bas_mp InjCrv_qPiI1DesByp_mp InjCrv_qPiI1Max_mp InjCrv_qPiI1SetLimMax_mp InjCrv_qPiI1SetLim_mp InjCrv_qPiI1SetRaw_mp InjCrv_qPiI1Set_mp InjCrv_qPiI2DesByp_mp InjCrv_qPiI3DesByp_mp InjCrv_qPiIMin_mp InjCrv_stPiI1_mp InjCrv_tiPiI1CorRaw_mp InjCrv_tiPiI1Cor_mp InjCrv_tiPiI1DesByp_mp InjCrv_tiPiI1ETNoCor_mp InjCrv_tiPiI1ET_mp InjCrv_tiPiI1Hyd_mp InjCrv_tiPiI1Min_mp InjCrv_tiPiI1RelMI1_mp InjCrv_tiPiI1RelTot_mp InjCrv_tiPiI1Rel_mp InjCrv_tiPiI1Tot_mp InjCrv_tiPiI2DesByp_mp InjCrv_volPiI1Cor_mp InjCrv_volPiI1NoCor_mp InjCrv_volPiI1_mp /end OUT_MEASUREMENT
/end FUNCTION
/begin FUNCTION injcrv_poi1 "Einspritzverlauf - Nacheinspritzung 1"
 /begin DEF_CHARACTERISTIC InjCrv_numTDCPoI1Clsn_C InjCrv_phiDynOfs_CUR InjCrv_phiPoI1Bas_MAP InjCrv_phiPoI1Max_C InjCrv_qPoI1Bas_MAP InjCrv_qPoI1Max_MAP InjCrv_qPoI1SetLim_C InjCrv_swtPoI1Clsn_C /end DEF_CHARACTERISTIC
 /begin IN_MEASUREMENT Eng_nAvrg InjCtl_qSetUnBal /end IN_MEASUREMENT
 /begin OUT_MEASUREMENT InjCrv_PoI1RgnVal_mp /end OUT_MEASUREMENT
/end FUNCTION
/begin FUNCTION injcrv_poi1addcor "Nacheinspritzung 1 - projektspezifische Korrekturen" /end FUNCTION
/begin FUNCTION injcrv_poi1addcor_msg ""
 /begin OUT_MEASUREMENT InjCrv_phiPoI1AddCor InjCrv_POpPoI1AddCor InjCrv_qPoI1AddCor /end OUT_MEASUREMENT
/end FUNCTION
/begin FUNCTION injcrv_poi1addcor_uic "" /end FUNCTION
/begin FUNCTION injcrv_poi1envcor "Nacheinspritzung 1 - Umwelt- Korrekturen (20 ms task)"
 /begin DEF_CHARACTERISTIC InjCrv_phiPoI1ETSCor_MAP InjCrv_qPoI1APSCor_MAP InjCrv_qPoI1ETSCor_MAP /end DEF_CHARACTERISTIC
 /begin IN_MEASUREMENT Eng_nAvrg InjCtl_qSetUnBal /end IN_MEASUREMENT
/end FUNCTION
/begin FUNCTION injcrv_poi1envcorslow "Nacheinspritzung 1 - Umwelt- Korrekturen (100ms task)"
 /begin DEF_CHARACTERISTIC InjCrv_facPoI1APSQCor_CUR InjCrv_facPoI1ETSPhiCor_CUR InjCrv_facPoI1ETSQCor_CUR InjCrv_POpPoI1ETSCor_CUR /end DEF_CHARACTERISTIC
 /begin IN_MEASUREMENT APSCD_pVal InjCrv_tEng /end IN_MEASUREMENT
/end FUNCTION
/begin FUNCTION injcrv_poi1envcorslow_msg ""
 /begin OUT_MEASUREMENT InjCrv_facPoI1APSQCor InjCrv_facPoI1ETSPhiCor InjCrv_facPoI1ETSQCor InjCrv_POpPoI1EnvCor /end OUT_MEASUREMENT
/end FUNCTION
/begin FUNCTION injcrv_poi1envcorslow_uic "" /end FUNCTION
/begin FUNCTION injcrv_poi1envcor_msg "" /begin OUT_MEASUREMENT InjCrv_phiPoI1EnvCor InjCrv_qPoI1EnvCor /end OUT_MEASUREMENT /end FUNCTION
/begin FUNCTION injcrv_poi1envcor_uic "" /begin OUT_MEASUREMENT InjCrv_qPoI1APSCor_mp InjCrv_qPoI1ETSCor_mp /end OUT_MEASUREMENT /end FUNCTION
/begin FUNCTION injcrv_poi1rgn "Regenerationswertberechnung der PoI1"
 /begin DEF_CHARACTERISTIC InjCrv_phiPoI1Rgn1_MAP InjCrv_phiPoI1Rgn2_MAP InjCrv_qPoI1Rgn1_MAP InjCrv_qPoI1Rgn2_MAP /end DEF_CHARACTERISTIC
 /begin IN_MEASUREMENT Eng_nAvrg InjCtl_qSetUnBal /end IN_MEASUREMENT
/end FUNCTION
/begin FUNCTION injcrv_poi1rgnlib "Funktionbibliothek der Regenerationswetberechnung für PoI1"
 /begin DEF_CHARACTERISTIC InjCrv_dtiPoI1RgnRmpUp_C InjCrv_dtiPoI1RgnRmpDwn_C InjCrv_dtiPoI1RgnTypeRmpUp_C InjCrv_dtiPoI1RgnTypeRmpDwn_C InjCrv_stPoI1RgnMsk_C InjCrv_stPoI1RgnTypeMsk_C /end DEF_CHARACTERISTIC
/end FUNCTION
/begin FUNCTION injcrv_poi1rgn_msg "" /begin OUT_MEASUREMENT InjCrv_phiPoI1Rgn InjCrv_PoI1RgnTypeVal InjCrv_qPoI1Rgn /end OUT_MEASUREMENT /end FUNCTION
/begin FUNCTION injcrv_poi1rgn_uic ""
 /begin DEF_CHARACTERISTIC InjCrv_phiPoI1RgnAdd_Vector InjCrv_phiPoI1RgnAdd_Channel InjCrv_phiPoI1Rgn_Vector InjCrv_phiPoI1Rgn_Channel InjCrv_qPoI1RgnAdd_Vector InjCrv_qPoI1RgnAdd_Channel InjCrv_qPoI1Rgn_Vector InjCrv_qPoI1Rgn_Channel /end DEF_CHARACTERISTIC
 /begin OUT_MEASUREMENT InjCrv_phiPoI1Rgn1_mp InjCrv_phiPoI1Rgn2_mp InjCrv_phiPoI1RgnByp_mp InjCrv_qPoI1Rgn1_mp InjCrv_qPoI1Rgn2_mp InjCrv_qPoI1RgnByp_mp /end OUT_MEASUREMENT
/end FUNCTION
/begin FUNCTION injcrv_poi1rls "Freigabe der PoI1"
 /begin DEF_CHARACTERISTIC InjCrv_POpPoI1Bas_MAP InjCrv_POpPoI1High_C InjCrv_POpPoI1Low_C /end DEF_CHARACTERISTIC
 /begin IN_MEASUREMENT Eng_nAvrg InjCtl_qSetUnBal /end IN_MEASUREMENT
/end FUNCTION
/begin FUNCTION injcrv_poi1rls_uic "" /begin OUT_MEASUREMENT InjCrv_POpPoI1Bas_mp InjCrv_POpPoI1_mp /end OUT_MEASUREMENT /end FUNCTION
/begin FUNCTION injcrv_poi1rmtctl_uic "" /end FUNCTION
/begin FUNCTION injcrv_poi1_msg "" /begin OUT_MEASUREMENT InjCrv_phiPoI1Des InjCrv_qPoI1Clsn InjCrv_qPoI1Des /end OUT_MEASUREMENT /end FUNCTION
/begin FUNCTION injcrv_poi1_uic ""
 /begin DEF_CHARACTERISTIC InjCrv_phiPoI1DesAdd_Vector InjCrv_phiPoI1DesAdd_Channel InjCrv_phiPoI1Des_Vector InjCrv_phiPoI1Des_Channel InjCrv_qPoI1DesAdd_Vector InjCrv_qPoI1DesAdd_Channel InjCrv_qPoI1Des_Vector InjCrv_qPoI1Des_Channel /end DEF_CHARACTERISTIC
 /begin OUT_MEASUREMENT InjCrv_phiDynOfs_mp InjCrv_phiNxtCyl_mp InjCrv_phiNxtTDCoB_mp InjCrv_phiPoI1Bas_mp InjCrv_phiPoI1DesByp_mp InjCrv_phiPoI1Dur_mp InjCrv_phiPoI1Lim_mp InjCrv_phiPoI1Min_mp InjCrv_phiPoI1Set_mp InjCrv_qPoI1Bas_mp InjCrv_qPoI1DesByp_mp InjCrv_qPoI1Des_mp InjCrv_qPoI1Lim_mp InjCrv_qPoI1Max_mp InjCrv_qPoI1Min_mp InjCrv_qPoI1SetLim_mp InjCrv_qPoI1Set_mp InjCrv_stPoI1_mp InjCrv_tiPoI1ET_mp InjCrv_volPoI1_mp /end OUT_MEASUREMENT
/end FUNCTION
/begin FUNCTION injcrv_poi2addcor "Nacheinspritzung 2 - projektspezifische Korrekturen" /end FUNCTION
/begin FUNCTION injcrv_poi2addcor_msg ""
 /begin OUT_MEASUREMENT InjCrv_phiPoI2AddCor InjCrv_POpPoI2AddCor InjCrv_qPoI2AddCor InjCrv_tiPoI2AddCor /end OUT_MEASUREMENT
/end FUNCTION
/begin FUNCTION injcrv_poi2addcor_uic "" /end FUNCTION
/begin FUNCTION injcrv_poi2agabstdc "Umschaltung des Ansteuerbeginns PoI2 in Winkel absolut zum TDC" /end FUNCTION
/begin FUNCTION injcrv_poi2agabstdc_uic "" /end FUNCTION
/begin FUNCTION injcrv_poi2envcor "Nacheinspritzung 2 - Umwelt- Korrekturen"
 /begin DEF_CHARACTERISTIC InjCrv_POpPoI2ETSCor_MAP InjCrv_qPoI2ATSCor_MAP InjCrv_qPoI2ETSCor_MAP /end DEF_CHARACTERISTIC
 /begin IN_MEASUREMENT Eng_nAvrg InjCtl_qSetUnBal /end IN_MEASUREMENT
/end FUNCTION
/begin FUNCTION injcrv_poi2envcorphi "" /begin DEF_CHARACTERISTIC InjCrv_phiPoI2ATSCor_MAP InjCrv_phiPoI2ETSCor_MAP /end DEF_CHARACTERISTIC /begin IN_MEASUREMENT Eng_nAvrg InjCtl_qSetUnBal /end IN_MEASUREMENT /end FUNCTION
/begin FUNCTION injcrv_poi2envcorphi_uic "" /begin OUT_MEASUREMENT InjCrv_phiPoI2ATSCor_mp InjCrv_phiPoI2ETSCor_mp /end OUT_MEASUREMENT /end FUNCTION
/begin FUNCTION injcrv_poi2envcorrgn "Injection Curve Post Injection Regeneration Correction"
 /begin DEF_CHARACTERISTIC InjCrv_facPhPoI2RgnAPCor_CUR InjCrv_facPhPoI2RgnETCor_CUR InjCrv_facQPoI2RgnAPCor_CUR InjCrv_facQPoI2RgnETCor_CUR InjCrv_facTiPoI2RgnAPCor_CUR InjCrv_facTiPoI2RgnETCor_CUR InjCrv_phiPoI2RgnCor_MAP InjCrv_qPoI2RgnCor_MAP InjCrv_tiPoI2RgnCor_MAP /end DEF_CHARACTERISTIC
 /begin IN_MEASUREMENT APSCD_pLinVal Eng_nAvrg InjCrv_tEng InjCtl_qSetUnBal /end IN_MEASUREMENT
/end FUNCTION
/begin FUNCTION injcrv_poi2envcorrgn_msg ""
 /begin OUT_MEASUREMENT InjCrv_phiPoI2RgnCor InjCrv_qPoI2RgnCor InjCrv_tiPoI2RgnCor /end OUT_MEASUREMENT
/end FUNCTION
/begin FUNCTION injcrv_poi2envcorrgn_uic ""
 /begin OUT_MEASUREMENT InjCrv_facPhPoI2RgnAPCor_mp InjCrv_facPhPoI2RgnETCor_mp InjCrv_facQPoI2RgnAPCor_mp InjCrv_facQPoI2RgnETCor_mp InjCrv_facTiPoI2RgnAPCor_mp InjCrv_facTiPoI2RgnETCor_mp /end OUT_MEASUREMENT
/end FUNCTION
/begin FUNCTION injcrv_poi2envcorslow ""
 /begin DEF_CHARACTERISTIC InjCrv_facPoI2ATSQCor_CUR InjCrv_facPoI2ATSSOECor_CUR InjCrv_facPoI2ETSQCor_CUR InjCrv_facPoI2ETSSOECor_CUR InjCrv_facPOpPoI2ETSCor_CUR /end DEF_CHARACTERISTIC
 /begin IN_MEASUREMENT IATSCD_tAir InjCrv_tEng /end IN_MEASUREMENT
/end FUNCTION
/begin FUNCTION injcrv_poi2envcorslowrgn "PoI2 Korrekturwerte für Umweltbedingungen im Regenerationsmodus" /end FUNCTION
/begin FUNCTION injcrv_poi2envcorslowrgn_msg "" /end FUNCTION
/begin FUNCTION injcrv_poi2envcorslowrgn_uic "" /end FUNCTION
/begin FUNCTION injcrv_poi2envcorslow_msg ""
 /begin OUT_MEASUREMENT InjCrv_facPoI2ATSQCor InjCrv_facPoI2ATSSOECor InjCrv_facPoI2ETSQCor InjCrv_facPoI2ETSSOECor InjCrv_facPOpPoI2ETSCor /end OUT_MEASUREMENT
/end FUNCTION
/begin FUNCTION injcrv_poi2envcorslow_uic "" /end FUNCTION
/begin FUNCTION injcrv_poi2envcorti "" /begin DEF_CHARACTERISTIC InjCrv_tiPoI2ATSCor_MAP InjCrv_tiPoI2ETSCor_MAP /end DEF_CHARACTERISTIC /begin IN_MEASUREMENT Eng_nAvrg InjCtl_qSetUnBal /end IN_MEASUREMENT /end FUNCTION
/begin FUNCTION injcrv_poi2envcorti_uic "" /begin OUT_MEASUREMENT InjCrv_tiPoI2ATSCor_mp InjCrv_tiPoI2ETSCor_mp /end OUT_MEASUREMENT /end FUNCTION
/begin FUNCTION injcrv_poi2envcor_msg ""
 /begin OUT_MEASUREMENT InjCrv_phiPoI2EnvCor InjCrv_POpPoI2EnvCor InjCrv_qPoI2EnvCor InjCrv_tiPoI2EnvCor /end OUT_MEASUREMENT
/end FUNCTION
/begin FUNCTION injcrv_poi2envcor_uic "" /begin OUT_MEASUREMENT InjCrv_qPoI2ATSCor_mp InjCrv_qPoI2ETSCor_mp /end OUT_MEASUREMENT /end FUNCTION
/begin FUNCTION injcrv_poi2q "Nacheinspritzung 2, Mengenberechnung"
 /begin DEF_CHARACTERISTIC InjCrv_facPoI2Eff_MAP InjCrv_facPoI2QntMin_C InjCrv_qPoI2Bas_MAP InjCrv_qPoI2SetLim_C InjCrv_stPoI2RgnDelMsk_C /end DEF_CHARACTERISTIC
 /begin IN_MEASUREMENT Eng_nAvrg InjCtl_qSetUnBal /end IN_MEASUREMENT
/end FUNCTION
/begin FUNCTION injcrv_poi2qrmtctl_uic "" /end FUNCTION
/begin FUNCTION injcrv_poi2q_msg ""
 /begin OUT_MEASUREMENT InjCrv_PoI2EffVal InjCrv_qPoI2Des InjCrv_qPoI2Eff InjCrv_stPoI2 /end OUT_MEASUREMENT
/end FUNCTION
/begin FUNCTION injcrv_poi2q_uic ""
 /begin OUT_MEASUREMENT InjCrv_facPoI2EffSet_mp InjCrv_facPoI2Eff_mp InjCrv_qMI1MinPoI2_mp InjCrv_qPoI2Bas_mp InjCrv_qPoI2Cor_mp InjCrv_qPoI2Des_mp InjCrv_qPoI2Eff_mp InjCrv_qPoI2Lim_mp InjCrv_qPoI2Max_mp InjCrv_qPoI2Min_mp InjCrv_qPoI2Set_mp InjCrv_tiPoI2ET_mp InjCrv_volPoI2_mp /end OUT_MEASUREMENT
/end FUNCTION
/begin FUNCTION injcrv_poi2rgn "Nacheinspritzung 2, Regenerationswertberechnung"
 /begin DEF_CHARACTERISTIC InjCrv_facPoI2Eff1_MAP InjCrv_facPoI2Eff2_MAP InjCrv_phiPoI2Rgn1_MAP InjCrv_phiPoI2Rgn2_MAP InjCrv_qPoI2Rgn1_MAP InjCrv_qPoI2Rgn2_MAP InjCrv_tiPoI2Rgn1_MAP InjCrv_tiPoI2Rgn2_MAP /end DEF_CHARACTERISTIC
 /begin IN_MEASUREMENT Eng_nAvrg InjCtl_qSetUnBal /end IN_MEASUREMENT
/end FUNCTION
/begin FUNCTION injcrv_poi2rgnlib "Library function  of exhaust gas regeneration for Post Injection 2"
 /begin DEF_CHARACTERISTIC InjCrv_dtiPoI2RgnEffRmpUp_C InjCrv_dtiPoI2RgnEffRmpDwn_C InjCrv_dtiPoI2RgnRmpUp_C InjCrv_dtiPoI2RgnRmpDwn_C InjCrv_dtiPoI2RgnTypeRmpUp_C InjCrv_dtiPoI2RgnTypeRmpDwn_C InjCrv_stPoI2RgnEffMsk_C InjCrv_stPoI2RgnMsk_C InjCrv_stPoI2RgnTypeMsk_C /end DEF_CHARACTERISTIC
/end FUNCTION
/begin FUNCTION injcrv_poi2rgn_msg ""
 /begin OUT_MEASUREMENT InjCrv_facPoI2EffRgn InjCrv_phiPoI2Rgn InjCrv_PoI2RgnTypeVal InjCrv_qPoI2Rgn InjCrv_tiPoI2Rgn /end OUT_MEASUREMENT
/end FUNCTION
/begin FUNCTION injcrv_poi2rgn_uic ""
 /begin DEF_CHARACTERISTIC InjCrv_facPoI2EffRgnAdd_Vector InjCrv_facPoI2EffRgnAdd_Channel InjCrv_facPoI2EffRgn_Vector InjCrv_facPoI2EffRgn_Channel InjCrv_phiPoI2RgnAdd_Vector InjCrv_phiPoI2RgnAdd_Channel InjCrv_phiPoI2Rgn_Vector InjCrv_phiPoI2Rgn_Channel InjCrv_qPoI2RgnAdd_Vector InjCrv_qPoI2RgnAdd_Channel InjCrv_qPoI2Rgn_Vector InjCrv_qPoI2Rgn_Channel InjCrv_tiPoI2RgnAdd_Vector InjCrv_tiPoI2RgnAdd_Channel InjCrv_tiPoI2Rgn_Vector InjCrv_tiPoI2Rgn_Channel /end DEF_CHARACTERISTIC
 /begin OUT_MEASUREMENT InjCrv_facPoI2EffRgn1_mp InjCrv_facPoI2EffRgn2_mp InjCrv_facPoI2EffRgnByp_mp InjCrv_phiPoI2Rgn1_mp InjCrv_phiPoI2Rgn2_mp InjCrv_phiPoI2RgnByp_mp InjCrv_qPoI2Rgn1_mp InjCrv_qPoI2Rgn2_mp InjCrv_qPoI2RgnByp_mp InjCrv_tiPoI2Rgn1_mp InjCrv_tiPoI2Rgn2_mp InjCrv_tiPoI2RgnByp_mp /end OUT_MEASUREMENT
/end FUNCTION
/begin FUNCTION injcrv_poi2rls ""
 /begin DEF_CHARACTERISTIC InjCrv_POpPoI2Bas_MAP InjCrv_POpPoI2High_C InjCrv_POpPoI2Low_C /end DEF_CHARACTERISTIC
 /begin IN_MEASUREMENT Eng_nAvrg InjCtl_qSetUnBal /end IN_MEASUREMENT
/end FUNCTION
/begin FUNCTION injcrv_poi2rls_uic "" /begin OUT_MEASUREMENT InjCrv_POpPoI2Bas_mp InjCrv_POpPoI2_mp /end OUT_MEASUREMENT /end FUNCTION
/begin FUNCTION injcrv_poi2soe "Nacheinspritzung 2, Ansteuerdauerberechnung"
 /begin DEF_CHARACTERISTIC InjCrv_phiPoI2Min_C InjCrv_tiPoI2Max_MAP InjCrv_tiPoI2Min_C /end DEF_CHARACTERISTIC
 /begin IN_MEASUREMENT InjCrv_qMI1Des RailCD_pPeak /end IN_MEASUREMENT
/end FUNCTION
/begin FUNCTION injcrv_poi2soephibas "" /begin DEF_CHARACTERISTIC InjCrv_phiPoI2Bas_MAP /end DEF_CHARACTERISTIC /begin IN_MEASUREMENT Eng_nAvrg InjCtl_qSetUnBal /end IN_MEASUREMENT /end FUNCTION
/begin FUNCTION injcrv_poi2soephibas_uic "" /begin OUT_MEASUREMENT InjCrv_phiPoI2Bas_mp /end OUT_MEASUREMENT /end FUNCTION
/begin FUNCTION injcrv_poi2soermtctl_uic "" /end FUNCTION
/begin FUNCTION injcrv_poi2soetibas "" /begin DEF_CHARACTERISTIC InjCrv_tiPoI2Bas_MAP /end DEF_CHARACTERISTIC /begin IN_MEASUREMENT Eng_nAvrg InjCtl_qSetUnBal /end IN_MEASUREMENT /end FUNCTION
/begin FUNCTION injcrv_poi2soetibas_uic "" /begin OUT_MEASUREMENT InjCrv_tiPoI2Bas_mp /end OUT_MEASUREMENT /end FUNCTION
/begin FUNCTION injcrv_poi2soe_msg "" /begin OUT_MEASUREMENT InjCrv_phiPoI2Des InjCrv_tiPoI2Des /end OUT_MEASUREMENT /end FUNCTION
/begin FUNCTION injcrv_poi2soe_uic ""
 /begin DEF_CHARACTERISTIC InjCrv_phiPoI2Add_Vector InjCrv_phiPoI2Add_Channel InjCrv_phiPoI2_Vector InjCrv_phiPoI2_Channel InjCrv_qPoI2DesAdd_Vector InjCrv_qPoI2DesAdd_Channel InjCrv_qPoI2EffAdd_Vector InjCrv_qPoI2EffAdd_Channel InjCrv_qPoI2Eff_Vector InjCrv_qPoI2Eff_Channel InjCrv_qPoI2Des_Vector InjCrv_qPoI2Des_Channel InjCrv_tiPoI2Add_Vector InjCrv_tiPoI2Add_Channel InjCrv_tiPoI2_Vector InjCrv_tiPoI2_Channel /end DEF_CHARACTERISTIC
 /begin OUT_MEASUREMENT InjCrv_phiPoI2AbsTot_mp InjCrv_phiPoI2Abs_mp InjCrv_phiPoI2Byp_mp InjCrv_phiPoI2Cor_mp InjCrv_phiPoI2Rel_mp InjCrv_qPoI2DesByp_mp InjCrv_qPoI2EffByp_mp InjCrv_swtPoI2AgAbsTDC_mp InjCrv_tiPoI2Byp_mp InjCrv_tiPoI2Cor_mp InjCrv_tiPoI2Max_mp InjCrv_tiPoI2RelTot_mp InjCrv_tiPoI2Rel_mp /end OUT_MEASUREMENT
/end FUNCTION
/begin FUNCTION injcrv_qntminlib "Berechnung minimale Einspritzmenge" /begin DEF_CHARACTERISTIC InjCrv_qMin_CUR /end DEF_CHARACTERISTIC /begin IN_MEASUREMENT RailCD_pPeak /end IN_MEASUREMENT /end FUNCTION
/begin FUNCTION injcrv_qntminlib_uic "" /begin OUT_MEASUREMENT InjCrv_qPiI1MinWv_mp /end OUT_MEASUREMENT /end FUNCTION
/begin FUNCTION injcrv_rmtctl_uic "" /end FUNCTION
/begin FUNCTION injcrv_settipse "Minimumzeitberechnung  zwischen 2 Einspritzungen" /end FUNCTION
/begin FUNCTION injcrv_settipse_msg "" /begin OUT_MEASUREMENT InjCrv_tiPse /end OUT_MEASUREMENT /end FUNCTION
/begin FUNCTION injcrv_settipse_uic "" /end FUNCTION
/begin FUNCTION injctl_msg ""
 /begin OUT_MEASUREMENT InjCtl_dqSetUnBal InjCtl_qCurr InjCtl_qCurrCor InjCtl_qCurrUnCor InjCtl_qDes InjCtl_qDesCor InjCtl_qRaw InjCtl_qRawCor InjCtl_qSet InjCtl_qSetUnBal InjCtl_stNoInj /end OUT_MEASUREMENT
/end FUNCTION
/begin FUNCTION injctl_qco "Mengenkoordination"
 /begin DEF_CHARACTERISTIC InjCtl_facAdjSrvMax_C InjCtl_facAdjSrvMin_C InjCtl_facAdjSrvUnlimDfl_C InjCtl_qAdjQntMax_C InjCtl_qAdjQntMin_C InjCtl_qAdjQnt_MAP InjCtl_t1DT1SetUnBal_C InjCtl_kdDT1SetUnBal_C InjCtl_qDriftComp_MAP InjCtl_qDriftMax2_C InjCtl_qDriftMin2_C InjCtl_swtFMACor_C /end DEF_CHARACTERISTIC
 /begin IN_MEASUREMENT Eng_nAvrg InjCtl_qSetUnBal InjCtl_qSetUnCor_mp InjCtl_tiEngOn_mp /end IN_MEASUREMENT
/end FUNCTION
/begin FUNCTION injctl_qco_msg "" /begin OUT_MEASUREMENT InjCtl_trqInrLim /end OUT_MEASUREMENT /end FUNCTION
/begin FUNCTION injctl_qco_uic ""
 /begin DEF_CHARACTERISTIC InjCtl_qCurr_Vector InjCtl_qCurr_Channel InjCtl_qRaw_Vector InjCtl_qRaw_Channel InjCtl_qSet_Vector InjCtl_qSet_Channel /end DEF_CHARACTERISTIC
 /begin OUT_MEASUREMENT InjCtl_dAdjQntCS_mp InjCtl_dDriftCS_mp InjCtl_facAdjSrvUnlim_mp InjCtl_facAdjSrv_mp InjCtl_qAdjQntUnlim_mp InjCtl_qAdjQnt_mp InjCtl_qDriftComp_mp InjCtl_qDriftLim1_mp InjCtl_qDriftLim2_mp InjCtl_qDriftMax1_mp InjCtl_qDriftMin1_mp InjCtl_qDriftUnlim_mp InjCtl_qSetUnCor_mp InjCtl_stAdjQnt_mp InjCtl_tiEngOn_mp /end OUT_MEASUREMENT
/end FUNCTION
/begin FUNCTION injctl_qlim "Begrenzungsmenge"
 /begin DEF_CHARACTERISTIC InjCtl_dqLimUp_C InjCtl_dqLimDwn_C InjCtl_qLimErr_CUR InjCtl_qLimErr_MAP InjCtl_qLimSoftShOff_CUR /end DEF_CHARACTERISTIC
 /begin IN_MEASUREMENT Eng_nAvrg FTSCD_tFuel /end IN_MEASUREMENT
/end FUNCTION
/begin FUNCTION injctl_qlim_msg "" /begin OUT_MEASUREMENT InjCtl_qLim InjCtl_qLimErr InjCtl_qLimSwt InjCtl_stQLimErr /end OUT_MEASUREMENT /end FUNCTION
/begin FUNCTION injctl_qlim_uic "" /begin OUT_MEASUREMENT InjCtl_qLimSoftShOff_mp InjCtl_qLim_mp /end OUT_MEASUREMENT /end FUNCTION
/begin FUNCTION injctl_uic "" /end FUNCTION
/begin FUNCTION injun "Einspritzsystem" /end FUNCTION
/begin FUNCTION injun_co "Koordinator für das Einspritzsystem" /end FUNCTION
/begin FUNCTION injun_co_msg "" /begin OUT_MEASUREMENT InjUn_stInjValve /end OUT_MEASUREMENT /end FUNCTION
/begin FUNCTION injun_co_uic "" /end FUNCTION
/begin FUNCTION injun_masscnv "Umrechnung von Kraftstoffmenge nach Kraftstoffvolumen" /end FUNCTION
/begin FUNCTION injun_masscnv_uic "" /end FUNCTION
/begin FUNCTION injun_mi1dynqntcor_uic ""
 /begin OUT_MEASUREMENT InjUn_numCylMI1_mp InjUn_qMI1Cor_mp InjUn_volMI1Cor_mp InjUn_volMI1_mp /end OUT_MEASUREMENT
/end FUNCTION
/begin FUNCTION injun_mi2dynqntcor_uic "" /begin OUT_MEASUREMENT InjUn_numCylMI2_mp /end OUT_MEASUREMENT /end FUNCTION
/begin FUNCTION injun_pii1dynqntcor_uic ""
 /begin OUT_MEASUREMENT InjUn_numCylPiI1_mp InjUn_qPiI1Cor_mp InjUn_volPiI1Cor_mp InjUn_volPiI1_mp /end OUT_MEASUREMENT
/end FUNCTION
/begin FUNCTION injun_pii2dynqntcor_uic ""
 /begin OUT_MEASUREMENT InjUn_numCylPiI2_mp InjUn_qPiI2Cor_mp InjUn_volPiI2Cor_mp InjUn_volPiI2_mp /end OUT_MEASUREMENT
/end FUNCTION
/begin FUNCTION injun_pii3dynqntcor_uic "" /end FUNCTION
/begin FUNCTION injun_poi1dynqntcor_uic ""
 /begin OUT_MEASUREMENT InjUn_numCylPoI1_mp InjUn_qPoI1Cor_mp InjUn_volPoI1Cor_mp InjUn_volPoI1_mp /end OUT_MEASUREMENT
/end FUNCTION
/begin FUNCTION injun_poi2dynqntcor_uic ""
 /begin OUT_MEASUREMENT InjUn_numCylPoI2_mp InjUn_qPoI2Cor_mp InjUn_volPoI2Cor_mp InjUn_volPoI2_mp /end OUT_MEASUREMENT
/end FUNCTION
/begin FUNCTION injun_sched "" /begin DEF_CHARACTERISTIC InjUn_nInjLock_C /end DEF_CHARACTERISTIC /end FUNCTION
/begin FUNCTION injun_sched_msg "" /begin OUT_MEASUREMENT InjUn_volMI1CorCyc InjUn_volPiI1CorCyc InjUn_volPiI2CorCyc /end OUT_MEASUREMENT /end FUNCTION
/begin FUNCTION injun_sched_uic "" /end FUNCTION
/begin FUNCTION injun_sched_var ""
 /begin OUT_MEASUREMENT InjUn_pAct_mp InjUn_stMIOffs_mp InjUn_stPiI1Offs_mp InjUn_stPiI2Offs_mp InjUn_stPiI3Offs_mp /end OUT_MEASUREMENT
/end FUNCTION
/begin FUNCTION injun_soptst "" /begin DEF_CHARACTERISTIC InjUn_phiTstShOffPathSet_C InjUn_tiTstShOffPathET_C /end DEF_CHARACTERISTIC /begin OUT_MEASUREMENT InjUn_stSOPTstInjBeg_mp InjUn_stSOPTstInjDur_mp /end OUT_MEASUREMENT /end FUNCTION
/begin FUNCTION injun_soptst_msg "" /begin OUT_MEASUREMENT InjUn_stShutOffReq /end OUT_MEASUREMENT /end FUNCTION
/begin FUNCTION injun_soptst_uic "" /end FUNCTION
/begin FUNCTION injun_tst "" /end FUNCTION
/begin FUNCTION injun_tst_msg "" /begin OUT_MEASUREMENT InjUn_stTst /end OUT_MEASUREMENT /end FUNCTION
/begin FUNCTION injun_tst_uic "" /end FUNCTION
/begin FUNCTION injvcd "injection valve component driver"
 /begin DEF_CHARACTERISTIC InjVCD_stInjMode_C InjVCD_swtEnaAgDiff_C InjVCD_tiETMinHigh_C InjVCD_tiETMinLow_C InjVCD_tiHoldMin_C /end DEF_CHARACTERISTIC
/end FUNCTION
/begin FUNCTION injvcd_actr "Erfassung der Piezo-Aktordaten"
 /begin DEF_CHARACTERISTIC InjVCD_uChrgThrSRCLo_C InjVCD_uChrgThrSRCHi_C InjVCD_uChrgLin_CUR InjVCD_uActrThrSRCLo_C InjVCD_uActrThrSRCHi_C InjVCD_uActrLin_CUR InjVCD_chgMaxPlaus_C InjVCD_chgMinPlaus_C InjVCD_numCylTestBench_C InjVCD_tiIntValid_C /end DEF_CHARACTERISTIC
 /begin OUT_MEASUREMENT InjVCD_facAmp_mp InjVCD_numOfsSelect_mp InjVCD_tiInjDurMi_mp InjVCD_tiInjDur_mp InjVCD_tiUpOri_mp InjVCD_uChgUp_mp InjVCD_uRawBott_mp InjVCD_uRawChgUp_mp InjVCD_uRawUp_mp /end OUT_MEASUREMENT
/end FUNCTION
/begin FUNCTION injvcd_actrenrg "Berechnung des aktorspezifischen Energiebedarfs"
 /begin DEF_CHARACTERISTIC InjVCD_DebActrEnrgDef_C InjVCD_DebActrEnrgOK_C InjVCD_facWActrChrgCorr_C InjVCD_facWActrCorr_C InjVCD_facWActrDisChCorr_C InjVCD_facWActrDvtMax_C InjVCD_facWActrDvtMin_C InjVCD_numFacWValidMin_C InjVCD_numWValidMin_C InjVCD_swtEnaWActrCorr_C InjVCD_wActrChrgDfl_C InjVCD_wActrDiffPlausMax_C InjVCD_wActrDiffPlausMin_C InjVCD_wActrDisChDfl_C InjVCD_wActrNom_CUR InjVCD_wActrPlausMax_C InjVCD_wActrPlausMin_C /end DEF_CHARACTERISTIC
 /begin OUT_MEASUREMENT InjVCD_facWActrDvt_mp InjVCD_facWActrRaw_mp InjVCD_numFacWValid_mp InjVCD_numWValid_mp InjVCD_stWValid_mp InjVCD_swtWActrNumValLo_mp InjVCD_uSetThresActr_mp InjVCD_wActrDiff_mp InjVCD_wActrNom_mp InjVCD_wChrgActrRaw_mp InjVCD_wDisChActrRaw_mp /end OUT_MEASUREMENT
/end FUNCTION
/begin FUNCTION injvcd_actrenrg_msg ""
 /begin OUT_MEASUREMENT InjVCD_facWActrDvt InjVCD_stActrEnrg InjVCD_wChrgActr InjVCD_wDisChActr /end OUT_MEASUREMENT
/end FUNCTION
/begin FUNCTION injvcd_actrtemp "Berechnung der Piezoaktortemperatur"
 /begin DEF_CHARACTERISTIC InjVCD_swtSelTempVal_C InjVCD_swtSelTempType_C InjVCD_tActrDfl_C InjVCD_tActr_CUR /end DEF_CHARACTERISTIC
 /begin OUT_MEASUREMENT InjVCD_tActr_mp /end OUT_MEASUREMENT
/end FUNCTION
/begin FUNCTION injvcd_actrtemp_msg "" /begin OUT_MEASUREMENT InjVCD_swtSelTemp InjVCD_tActr /end OUT_MEASUREMENT /end FUNCTION
/begin FUNCTION injvcd_actr_msg ""
 /begin OUT_MEASUREMENT InjVCD_chgUpActrCurr InjVCD_cUpActrCurr InjVCD_cUpActrOld InjVCD_numHandle InjVCD_numMeas InjVCD_pActInj InjVCD_stAvrgEna InjVCD_stAvrgEnaTiWarn InjVCD_stCalcChrgActr InjVCD_stMeas InjVCD_stMeasLvl InjVCD_stMeasLvlFirst InjVCD_stMonChgActr InjVCD_stMonTiPlaus InjVCD_stMonUBnkPlaus InjVCD_stMonUCylPlaus InjVCD_stShCirSelSwtCab InjVCD_tiChrgUpActr InjVCD_tiChrgUpActrOld InjVCD_tiDisChBottActr InjVCD_tiMeasCycl InjVCD_tiMeasCyclCyl InjVCD_uBottActr InjVCD_uSetThresActr InjVCD_uSetUpActr InjVCD_uUpActr /end OUT_MEASUREMENT
/end FUNCTION
/begin FUNCTION injvcd_calcmi1et "Einspritzsspezifische Berechnung der Injektoransteuerdauer der ersten Haupteinspritzung" /begin DEF_CHARACTERISTIC InjVCD_nETMaxLim_C InjVCD_tiETMax_C /end DEF_CHARACTERISTIC /end FUNCTION
/begin FUNCTION injvcd_calcmi1et_uic "" /begin DEF_CHARACTERISTIC InjVCD_tiMI1ET_Vector InjVCD_tiMI1ET_Channel /end DEF_CHARACTERISTIC /begin OUT_MEASUREMENT InjVCD_tiMI1ETUnLim_mp InjVCD_tiMI1ET_mp /end OUT_MEASUREMENT /end FUNCTION
/begin FUNCTION injvcd_calcpii1et "" /end FUNCTION
/begin FUNCTION injvcd_calcpii1et_uic "" /begin DEF_CHARACTERISTIC InjVCD_tiPiI1ET_Vector InjVCD_tiPiI1ET_Channel /end DEF_CHARACTERISTIC /begin OUT_MEASUREMENT InjVCD_tiPiI1ET_mp InjVCD_tiZFCPiI1ETCor_mp /end OUT_MEASUREMENT /end FUNCTION
/begin FUNCTION injvcd_calcpii2et "" /end FUNCTION
/begin FUNCTION injvcd_calcpii2et_uic "" /begin DEF_CHARACTERISTIC InjVCD_tiPiI2ET_Vector InjVCD_tiPiI2ET_Channel /end DEF_CHARACTERISTIC /begin OUT_MEASUREMENT InjVCD_tiPiI2ET_mp InjVCD_tiZFCPiI2ETCor_mp /end OUT_MEASUREMENT /end FUNCTION
/begin FUNCTION injvcd_calcpii3et "" /end FUNCTION
/begin FUNCTION injvcd_calcpii3et_uic "" /end FUNCTION
/begin FUNCTION injvcd_calcpoi1et "" /end FUNCTION
/begin FUNCTION injvcd_calcpoi1et_uic "" /begin DEF_CHARACTERISTIC InjVCD_tiPoI1ET_Vector InjVCD_tiPoI1ET_Channel /end DEF_CHARACTERISTIC /begin OUT_MEASUREMENT InjVCD_tiPoI1ET_mp /end OUT_MEASUREMENT /end FUNCTION
/begin FUNCTION injvcd_calcpoi2et "" /end FUNCTION
/begin FUNCTION injvcd_calcpoi2et_uic "" /begin DEF_CHARACTERISTIC InjVCD_tiPoI2ET_Vector InjVCD_tiPoI2ET_Channel /end DEF_CHARACTERISTIC /begin OUT_MEASUREMENT InjVCD_tiPoI2ET_mp /end OUT_MEASUREMENT /end FUNCTION
/begin FUNCTION injvcd_chrg "Berechnung der Aktor-Ladung" /begin DEF_CHARACTERISTIC InjVCD_duInt_C InjVCD_resCalcChrgShunt_C /end DEF_CHARACTERISTIC /begin OUT_MEASUREMENT InjVCD_uIntComp_mp /end OUT_MEASUREMENT /end FUNCTION
/begin FUNCTION injvcd_cls "Klassifizierung des Piezoaktuators"
 /begin DEF_CHARACTERISTIC InjVCD_nClsEng_C InjVCD_pClsRailMax_C InjVCD_rClsVoltMin_C InjVCD_tiClsLead_C InjVCD_tiClsMeasBeg_C InjVCD_tiClsMeasEnd_C InjVCD_tiClsMeasure_C /end DEF_CHARACTERISTIC
 /begin OUT_MEASUREMENT InjVCD_rClsVolt_mp InjVCD_stWaitPRailLow_mp InjVCD_uClsBegin_mp InjVCD_uClsEnd_mp /end OUT_MEASUREMENT
/end FUNCTION
/begin COMPU_METHOD Actr_Temp_Sel "Position des Schalters der die Basis für die Piezo-Aktortempartur auswählt" TAB_VERB "%6.3" "-" COMPU_TAB_REF Actr_Temp_Sel /end COMPU_METHOD
/begin COMPU_VTAB Actr_Temp_Sel "Position des Schalters der die Basis für die Piezo-Aktortempartur auswählt" TAB_VERB 2 0 "coolant water temperature" 1 "fuel temperature" /end COMPU_VTAB
/begin COMPU_METHOD AngleCrS "Winkel Kurbelwelle" RAT_FUNC "%6.4" "deg CrS" COEFFS 0 42.6666666666667 0 0 0 1 /end COMPU_METHOD
/begin COMPU_METHOD Capacity_PA "Kapazität der Piezo-Aktoren" RAT_FUNC "%6.5" "uF" COEFFS 0 1000 0 0 0 1 /end COMPU_METHOD
/begin COMPU_METHOD Charge_PA "Ladung der Piezo-Aktoren" RAT_FUNC "%6.2" "uC" COEFFS 0 1 0 0 0 1 /end COMPU_METHOD
/begin COMPU_METHOD Delta_Volt_INT "ADC Spannungsgradient" RAT_FUNC "%6.2" "mV/ms" COEFFS 0 1 0 0 0 1 /end COMPU_METHOD
/begin COMPU_METHOD EGTSwt "Umrechnung für EGT Rampenschalter (1 / 1000*2^14 )" RAT_FUNC "%10.9" "-" COEFFS 0 16384000 0 0 0 1 /end COMPU_METHOD
/begin COMPU_METHOD EngN "Motordrehzahl" RAT_FUNC "%6.2" "rpm" COEFFS 0 1 0 0 0 1 /end COMPU_METHOD
/begin COMPU_METHOD Fact "Faktor mit Auflösung 1 / 8192, hauptsächlich für einen Faktorenbereich 0...1 verwendet" RAT_FUNC "%6.5" "-" COEFFS 0 8192 0 0 0 1 /end COMPU_METHOD
/begin COMPU_METHOD Fact1 "Faktor mit Auflösung 0,01 (100 mal höherer Bereich als Fact)" RAT_FUNC "%6.4" "-" COEFFS 0 128 0 0 0 1 /end COMPU_METHOD
/begin COMPU_METHOD Fact_IntAmp "Auflösungsfaktor für Stromverstärkungsfaktor des CY370-Integrators - Auflösung 0.001" RAT_FUNC "%6.5" "-" COEFFS 0 1000 0 0 0 1 /end COMPU_METHOD
/begin COMPU_METHOD InjMass "Einspritzmenge" RAT_FUNC "%6.4" "mg/hub" COEFFS 0 100 0 0 0 1 /end COMPU_METHOD
/begin COMPU_METHOD InjMassCyc "Einspritzmenge pro Zyklus (mg/Zyklus)" RAT_FUNC "%6.4" "mg/cyc" COEFFS 0 100 0 0 0 1 /end COMPU_METHOD
/begin COMPU_METHOD InjMassInj "Einspritzmenge pro Einspritzung (mg/Einspritzung)" RAT_FUNC "%6.4" "mg/inj" COEFFS 0 100 0 0 0 1 /end COMPU_METHOD
/begin COMPU_METHOD InjMassPerSec_20ms "Einspritzmengenänderung pro Sekunde für 20ms-Tasks" RAT_FUNC "%6.3" "mg/hub/s" COEFFS 0 2 0 0 0 1 /end COMPU_METHOD
/begin COMPU_METHOD InjQntInj "Einspritzmenge der einzelnen Einspritzung" RAT_FUNC "%6.4" "mm^3/inj" COEFFS 0 100 0 0 0 1 /end COMPU_METHOD
/begin COMPU_METHOD InjTime_us "Zeit in Microsekunden für das Einspritztiming" RAT_FUNC "%6.2" "us" COEFFS 0 1 0 0 0 1 /end COMPU_METHOD
/begin COMPU_METHOD Kd "Differentialverstärkung Kd (gleiche Einheit/Umrechnungsformel an Ein- und Ausgang)" RAT_FUNC "%7.6" "1/1" COEFFS 0 65536 0 0 0 1 /end COMPU_METHOD
/begin COMPU_METHOD Ki_Trq2TrqT2 "Integrale Verstärkung Ki (Kupplungsmoment über die Zeit aufintegriert)" RAT_FUNC "%6.4" "Nms" COEFFS 0 429.4967296 0 0 0 1 /end COMPU_METHOD
/begin COMPU_METHOD Kp_LmbdRec2InjMass_2 "Proportionale Verstärkung Kp (reziprokes Lambda zu Einspritzmenge)" RAT_FUNC "%6.4" "mg/stroke" COEFFS 0 81.92 0 0 0 1 /end COMPU_METHOD
/begin COMPU_METHOD Kp_rpm2Nm_1 "Proportional Verstärkung (Umdrehungen nach Moment), Umrechnung für sint16 Werte" RAT_FUNC "%6.4" "Nm/rpm" COEFFS 0 320 0 0 0 1 /end COMPU_METHOD
/begin COMPU_METHOD Milli "Milli Auflösung" RAT_FUNC "%6.5" "-" COEFFS 0 1000 0 0 0 1 /end COMPU_METHOD
/begin COMPU_METHOD OneToOne "eins zu eins (physikalischer Wert ist gleich dem internen Wert)" RAT_FUNC "%6.2" "-" COEFFS 0 1 0 0 0 1 /end COMPU_METHOD
/begin COMPU_METHOD Pres_hPa "Druck (angezeigt in [hPa])" RAT_FUNC "%6.2" "hPa" COEFFS 0 1 0 0 0 1 /end COMPU_METHOD
/begin COMPU_METHOD Pres_Rail "Raildruck in hPa" RAT_FUNC "%4.3" "bar" COEFFS 0 10.000000 0 0 0 1 /end COMPU_METHOD
/begin COMPU_METHOD Resist_mOhm "Widerstand mit 1/10 mOhm Auflösung" RAT_FUNC "%6.3" "mOhm" COEFFS 0 10 0 0 0 1 /end COMPU_METHOD
/begin COMPU_METHOD Rmp "einheitenloser Rampengradient (für Library Ramp, etc.)" RAT_FUNC "%6.4" "1/s" COEFFS 0 65.536 0 0 0 1 /end COMPU_METHOD
/begin COMPU_METHOD RmpInjMass "Rampengradient für Einspritzmenge" RAT_FUNC "%6.5" "(mg/stroke)/s" COEFFS 0 6553.6 0 0 0 1 /end COMPU_METHOD
/begin COMPU_METHOD Temp_Cels "Temperatur dargestellt in °C (gleiche interne Darstellung wie Temp_Kelv)" RAT_FUNC "%6.1" "deg C" COEFFS 0 10 2731.4 0 0 1 /end COMPU_METHOD
/begin COMPU_METHOD TimeDelay_s "Zeitkonstante T1 (in s) für PT1, DT1, etc." RAT_FUNC "%9.3" "s" COEFFS 0 0 1 0 0.00023283064365387 0 /end COMPU_METHOD
/begin COMPU_METHOD TimeDT "Abtastzeit (in us) für Library Regler, Filter, etc." RAT_FUNC "%6.2" "us" COEFFS 0 1 0 0 0 1 /end COMPU_METHOD
/begin COMPU_METHOD TimeEngOnHrs "Umrechnung für Betriebsstundenzähler" RAT_FUNC "%6.1" "h" COEFFS 0 0.0549323782423836 0 0 0 1 /end COMPU_METHOD
/begin COMPU_METHOD Time_Busy "Lade-/Entladezeit der Piezosteller (us)" RAT_FUNC "%6.3" "us" COEFFS 0 10 0 0 0 1 /end COMPU_METHOD
/begin COMPU_METHOD Time_ms "Zeit in ms für Fehlerentprellung (DSM) und SW-Timer" RAT_FUNC "%6.1" "ms" COEFFS 0 0.1 0 0 0 1 /end COMPU_METHOD
/begin COMPU_METHOD Trq "Motormoment" RAT_FUNC "%6.3" "Nm" COEFFS 0 10 0 0 0 1 /end COMPU_METHOD
/begin COMPU_METHOD Volt "Spannung in V (von ADC)" RAT_FUNC "%6.2" "mV" COEFFS 0 0.2046 0 0 0 1 /end COMPU_METHOD
/begin COMPU_METHOD Volt_PA "Spannung des Piezo-Aktors" RAT_FUNC "%6.4" "V" COEFFS 0 100 0 0 0 1 /end COMPU_METHOD
/begin COMPU_METHOD W_PA "Energieverbrauch des Piezo-Aktors" RAT_FUNC "%6.2" "mWs" COEFFS 0 1 0 0 0 1 /end COMPU_METHOD
/begin RECORD_LAYOUT Gkl_Ws16 FNC_VALUES 1 SWORD COLUMN_DIR DIRECT /end RECORD_LAYOUT
/begin RECORD_LAYOUT GSst_Xs16 NO_AXIS_PTS_X 1 SWORD AXIS_PTS_X 2 SWORD INDEX_INCR DIRECT /end RECORD_LAYOUT
/begin RECORD_LAYOUT Kf_Xs16_Ys16_Ws16 NO_AXIS_PTS_X 1 SWORD NO_AXIS_PTS_Y 2 SWORD AXIS_PTS_X 3 SWORD INDEX_INCR DIRECT AXIS_PTS_Y 4 SWORD INDEX_INCR DIRECT FNC_VALUES 5 SWORD COLUMN_DIR DIRECT /end RECORD_LAYOUT
/begin RECORD_LAYOUT Kl_Xs16_Ws16 NO_AXIS_PTS_X 1 SWORD AXIS_PTS_X 2 SWORD INDEX_INCR DIRECT FNC_VALUES 3 SWORD COLUMN_DIR DIRECT /end RECORD_LAYOUT
/begin RECORD_LAYOUT Kw_Ws16 FNC_VALUES 1 SWORD COLUMN_DIR DIRECT /end RECORD_LAYOUT
/begin RECORD_LAYOUT Kw_Ws32 FNC_VALUES 1 SLONG COLUMN_DIR DIRECT /end RECORD_LAYOUT
/begin RECORD_LAYOUT Kw_Wu16 FNC_VALUES 1 UWORD COLUMN_DIR DIRECT /end RECORD_LAYOUT
/begin RECORD_LAYOUT Kw_Wu32 FNC_VALUES 1 ULONG COLUMN_DIR DIRECT /end RECORD_LAYOUT
/begin RECORD_LAYOUT Kw_Wu8 FNC_VALUES 1 UBYTE COLUMN_DIR DIRECT /end RECORD_LAYOUT
/end MODULE
/end PROJECT
