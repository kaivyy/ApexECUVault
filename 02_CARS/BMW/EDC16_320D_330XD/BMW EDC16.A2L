ASAP2_VERSION 1 3
/begin PROJECT P383 "BMW DDE6.3 8-Zylinder V9E.3 11.10.2004 CAN12H"
/begin HEADER "" VERSION "V9E.3_8Z_CAN12H" PROJECT_NO P383 /end HEADER
/begin MODULE DIM ""
/begin MOD_COMMON "" BYTE_ORDER MSB_FIRST ALIGNMENT_BYTE 1 ALIGNMENT_WORD 2 ALIGNMENT_LONG 4 ALIGNMENT_FLOAT32_IEEE 4 /end MOD_COMMON
/begin CHARACTERISTIC AFSCD_facSwtOnCor_C "MLB Anfangswert der HFM-Einschaltkorrektur" VALUE 0xC41A0 Kw_Ws16 3.000000 Fact 0.00 3.000000 FORMAT "%8.6" EXTENDED_LIMITS -4.000000 3.999878 /end CHARACTERISTIC
/begin CHARACTERISTIC AFSCD_tiDlySwtOnCor_C "MLB Zeitkonstante für die HFM-Einschaltkorrektur" VALUE 0xC41A2 Kw_Wu16 655140.0 Time_ms 0.00 655140.0 FORMAT "%8.1" EXTENDED_LIMITS 0.00 655350.0 /end CHARACTERISTIC
/begin CHARACTERISTIC AFSCD_stDcycInv_C "Schalter zur Invertierung des Tastverhältnisses der digitalen Lufttemperatur T1" VALUE 0xC4730 Kw_Wu8 255.0 OneToOne 0.00 255.0 FORMAT "%5.1" /end CHARACTERISTIC
/begin CHARACTERISTIC AFSCD_tiRefSigPerMin_C "lower threshold for the SRC of the reference signal time period provided by the HFM6 sensor" VALUE 0xC4732 Kw_Ws16 262.1400 Time_4us -131.0720 131.0680 FORMAT "%8.4" /end CHARACTERISTIC
/begin CHARACTERISTIC AFSCD_tiRefSigPerMax_C "upper threshold for the SRC of the reference signal time period for the HFM6 sensor" VALUE 0xC4734 Kw_Ws16 262.1400 Time_4us -131.0720 131.0680 FORMAT "%8.4" /end CHARACTERISTIC
/begin CHARACTERISTIC AFSCD_dcycAirTempSigMin_C "minimum threshold for the SRC of the duty cycle of the air temperature signal from the HFM6 sensor" VALUE 0xC4736 Kw_Ws16 655.3500 DtyCyc -327.6800 327.6700 FORMAT "%8.4" /end CHARACTERISTIC
/begin CHARACTERISTIC AFSCD_dcycAirTempSigMax_C "upper threshold for the SRC check of the duty cycle of the air temperature signal from the HFM6 sensor" VALUE 0xC4738 Kw_Ws16 655.3500 DtyCyc -327.6800 327.6700 FORMAT "%8.4" /end CHARACTERISTIC
/begin CHARACTERISTIC AFSCD_DebPlHiOffsDrftDef_C "Fehlerentprellzeit fuer Plausibilitaetscheck des Offsetdrifts High" VALUE 0xC41A4 Kw_Wu16 655350.0 Time_ms 0.00 655350.0 FORMAT "%8.1" /end CHARACTERISTIC
/begin CHARACTERISTIC AFSCD_DebPlHiOffsDrftOk_C "Heilungsentprellzeit fuer Plausibilitaetscheck des Offsetdrifts High" VALUE 0xC41A6 Kw_Wu16 655350.0 Time_ms 0.00 655350.0 FORMAT "%8.1" /end CHARACTERISTIC
/begin CHARACTERISTIC AFSCD_DebPlHiSetyDrftDef_C "Defektentprellzeit für Plausibilisierung der oberen Luftmassnesensor-Empfindlichkeitsdriftgrenze" VALUE 0xC485C Kw_Wu16 655350.0 Time_ms 0.00 655350.0 FORMAT "%8.1" /end CHARACTERISTIC
/begin CHARACTERISTIC AFSCD_DebPlHiSetyDrftOk_C "Heilungsentprellzeit für Plausibilisierung der oberen Luftmassensensor-Empfindlichkeitsdriftgrenze" VALUE 0xC485E Kw_Wu16 655350.0 Time_ms 0.00 655350.0 FORMAT "%8.1" /end CHARACTERISTIC
/begin CHARACTERISTIC AFSCD_DebPlLoOffsDrftDef_C "LMM Plausibilitaet Offsetdrift HFM5 1ms Defekterkennungs-Zeit" VALUE 0xC41A8 Kw_Wu16 655350.0 Time_ms 0.00 655350.0 FORMAT "%8.1" /end CHARACTERISTIC
/begin CHARACTERISTIC AFSCD_DebPlLoOffsDrftOk_C "LMM Plausibilitaet Offsetdrift HFM5 1ms Intakterkennungs-Zeit" VALUE 0xC41AA Kw_Wu16 655350.0 Time_ms 0.00 655350.0 FORMAT "%8.1" /end CHARACTERISTIC
/begin CHARACTERISTIC AFSCD_DebPlLoSetyDrftDef_C "Defektentprellzeit für Plausibilisierung der unteren Luftmassensensor-Empfindlichkeitsdriftgrenze" VALUE 0xC4860 Kw_Wu16 655350.0 Time_ms 0.00 655350.0 FORMAT "%8.1" /end CHARACTERISTIC
/begin CHARACTERISTIC AFSCD_DebPlLoSetyDrftOk_C "Heilungsentprellzeit für Plausibilisierung der unteren Luftmassensensor-Empfindlichkeitsdriftgrenze" VALUE 0xC4862 Kw_Wu16 655350.0 Time_ms 0.00 655350.0 FORMAT "%8.1" /end CHARACTERISTIC
/begin CHARACTERISTIC AFSCD_DebRawAirmSigDef_C "defect debounce time for short circuit to battery, ground or signal cut-off error of the air mass signal" VALUE 0xC41AC Kw_Wu16 655350.0 Time_ms 0.00 655350.0 FORMAT "%8.1" /end CHARACTERISTIC
/begin CHARACTERISTIC AFSCD_DebRawAirmSigOk_C "defect healing time for short circuit to battery, ground or signal cut-off error of the air mass signal" VALUE 0xC41AE Kw_Wu16 655350.0 Time_ms 0.00 655350.0 FORMAT "%8.1" /end CHARACTERISTIC
/begin CHARACTERISTIC AFSCD_DebRefSigDef_C "defect debounce time for short circuit to battery, ground or signal cut-off error of the air temperature signal" VALUE 0xC473A Kw_Wu16 655350.0 Time_ms 0.00 655350.0 FORMAT "%8.1" /end CHARACTERISTIC
/begin CHARACTERISTIC AFSCD_DebRefSigOk_C "defect healing time for short circuit to battery, ground or signal cut-off error of the air temperature signal" VALUE 0xC473C Kw_Wu16 655350.0 Time_ms 0.00 655350.0 FORMAT "%8.1" /end CHARACTERISTIC
/begin CHARACTERISTIC AFSCD_DebSRCHiAirTempDef_C "defect debouncing time for the SRC high error for air temperature" VALUE 0xC473E Kw_Wu16 655350.0 Time_ms 0.00 655350.0 FORMAT "%8.1" /end CHARACTERISTIC
/begin CHARACTERISTIC AFSCD_DebSRCHiAirTempOk_C "healing time for the SRC high error for the air temperature" VALUE 0xC4740 Kw_Wu16 655350.0 Time_ms 0.00 655350.0 FORMAT "%8.1" /end CHARACTERISTIC
/begin CHARACTERISTIC AFSCD_DebSRCHiBattDef_C "defect debouncing time for the SRC high error for the battery voltage" VALUE 0xC41B0 Kw_Wu16 655350.0 Time_ms 0.00 655350.0 FORMAT "%8.1" /end CHARACTERISTIC
/begin CHARACTERISTIC AFSCD_DebSRCHiBattOk_C "healing time for the SRC high error for the battery voltage" VALUE 0xC41B2 Kw_Wu16 655350.0 Time_ms 0.00 655350.0 FORMAT "%8.1" /end CHARACTERISTIC
/begin CHARACTERISTIC AFSCD_DebSRCCorrAirmHiDef_C "defect debounce time for SRC high error of the corrected air mass signal" VALUE 0xC41B4 Kw_Wu16 655350.0 Time_ms 0.00 655350.0 FORMAT "%8.1" /end CHARACTERISTIC
/begin CHARACTERISTIC AFSCD_DebSRCCorrAirmHiOk_C "defect healing time for SRC high error of the corrected air mass signal" VALUE 0xC41B6 Kw_Wu16 655350.0 Time_ms 0.00 655350.0 FORMAT "%8.1" /end CHARACTERISTIC
/begin CHARACTERISTIC AFSCD_DebSRCRawAirmHiDef_C "defect debounce time for SRC high error of the raw air mass signal" VALUE 0xC41B8 Kw_Wu16 655350.0 Time_ms 0.00 655350.0 FORMAT "%8.1" /end CHARACTERISTIC
/begin CHARACTERISTIC AFSCD_DebSRCRawAirmHiOk_C "defect healing time for SRC high error of the raw air mass signal" VALUE 0xC41BA Kw_Wu16 655350.0 Time_ms 0.00 655350.0 FORMAT "%8.1" /end CHARACTERISTIC
/begin CHARACTERISTIC AFSCD_DebSRCRefSigHiDef_C "defect debounce time for SRC high error of the time period of the air temperature signal" VALUE 0xC4742 Kw_Wu16 655350.0 Time_ms 0.00 655350.0 FORMAT "%8.1" /end CHARACTERISTIC
/begin CHARACTERISTIC AFSCD_DebSRCRefSigHiOk_C "defect healing time for SRC high error of the time period of the air temperature signal" VALUE 0xC4744 Kw_Wu16 655350.0 Time_ms 0.00 655350.0 FORMAT "%8.1" /end CHARACTERISTIC
/begin CHARACTERISTIC AFSCD_DebSRCLoAirTempDef_C "defect debouncing time for the SRC low error for air temperature" VALUE 0xC4746 Kw_Wu16 655350.0 Time_ms 0.00 655350.0 FORMAT "%8.1" /end CHARACTERISTIC
/begin CHARACTERISTIC AFSCD_DebSRCLoAirTempOk_C "healing time for the SRC low error for air temperature" VALUE 0xC4748 Kw_Wu16 655350.0 Time_ms 0.00 655350.0 FORMAT "%8.1" /end CHARACTERISTIC
/begin CHARACTERISTIC AFSCD_DebSRCLoBattDef_C "defect debouncing time for the SRC low error for the battery voltage" VALUE 0xC41BC Kw_Wu16 655350.0 Time_ms 0.00 655350.0 FORMAT "%8.1" /end CHARACTERISTIC
/begin CHARACTERISTIC AFSCD_DebSRCLoBattOk_C "healing time for the SRC low error for the battery voltage" VALUE 0xC41BE Kw_Wu16 655350.0 Time_ms 0.00 655350.0 FORMAT "%8.1" /end CHARACTERISTIC
/begin CHARACTERISTIC AFSCD_DebSRCCorrAirmLoDef_C "defect debounce time for SRC low error of the corrected air mass signal" VALUE 0xC41C0 Kw_Wu16 655350.0 Time_ms 0.00 655350.0 FORMAT "%8.1" /end CHARACTERISTIC
/begin CHARACTERISTIC AFSCD_DebSRCCorrAirmLoOk_C "defect healing time for the SRC low error of the corrected air mass signal" VALUE 0xC41C2 Kw_Wu16 655350.0 Time_ms 0.00 655350.0 FORMAT "%8.1" /end CHARACTERISTIC
/begin CHARACTERISTIC AFSCD_DebSRCRawAirmLoDef_C "defect debounce time for the SRC low error of the raw air mass signal" VALUE 0xC41C4 Kw_Wu16 655350.0 Time_ms 0.00 655350.0 FORMAT "%8.1" /end CHARACTERISTIC
/begin CHARACTERISTIC AFSCD_DebSRCRawAirmLoOk_C "defect healing time for the SRC low error of the raw air mass signal" VALUE 0xC41C6 Kw_Wu16 655350.0 Time_ms 0.00 655350.0 FORMAT "%8.1" /end CHARACTERISTIC
/begin CHARACTERISTIC AFSCD_DebSRCRefSigLoDef_C "defect debounce time for SRC low error for the reference period time of air temperature signal" VALUE 0xC474A Kw_Wu16 655350.0 Time_ms 0.00 655350.0 FORMAT "%8.1" /end CHARACTERISTIC
/begin CHARACTERISTIC AFSCD_DebSRCRefSigLoOk_C "defect healing time for the SRC low error of the reference signal time period of the air temperature signal" VALUE 0xC474C Kw_Wu16 655350.0 Time_ms 0.00 655350.0 FORMAT "%8.1" /end CHARACTERISTIC
/begin CHARACTERISTIC AFSCD_DebSRCAirTempDcycMaxDef_C "defect debounce time for the SRC max error of the duty cycle of the air temperature signal" VALUE 0xC474E Kw_Wu16 655350.0 Time_ms 0.00 655350.0 FORMAT "%8.1" /end CHARACTERISTIC
/begin CHARACTERISTIC AFSCD_DebSRCAirTempDcycMaxOk_C "defect healing time for the SRC max error of the duty cycle of air temperature signal" VALUE 0xC4750 Kw_Wu16 655350.0 Time_ms 0.00 655350.0 FORMAT "%8.1" /end CHARACTERISTIC
/begin CHARACTERISTIC AFSCD_DebSRCAirTempDcycMinDef_C "defect debounce time for the SRC min error of the duty cycle of the air temperature signal" VALUE 0xC4752 Kw_Wu16 655350.0 Time_ms 0.00 655350.0 FORMAT "%8.1" /end CHARACTERISTIC
/begin CHARACTERISTIC AFSCD_DebSRCAirTempDcycMinOk_C "defect healing time for SRC min error of the duty cycle of the air temperature signal" VALUE 0xC4754 Kw_Wu16 655350.0 Time_ms 0.00 655350.0 FORMAT "%8.1" /end CHARACTERISTIC
/begin CHARACTERISTIC AFSCD_dmAirPerTimeDfl_CUR "Kennlinie zur Bestimmung der Ersatzluftmasse pro Zeit als f(Drehzahl)" CURVE 0xC41C8 Kl_Xs16_Ws16 1500.000 AirMassPerTime 0.00 1500.000 FORMAT "%8.3" EXTENDED_LIMITS -3276.800 3276.700
 /begin AXIS_DESCR STD_AXIS Eng_nAvrg EngN 16 0.00 6000.000 FORMAT "%8.3" EXTENDED_LIMITS -32768.00 32767.00 DEPOSIT ABSOLUTE /end AXIS_DESCR
/end CHARACTERISTIC
/begin CHARACTERISTIC AFSCD_tiAirPerTimeDT1_C "Totzeit für  Luftmassenstrom DT1 filter" VALUE 0xC47C8 Kw_Wu32 4294.9673 TimeDelay_s 0.0000010000000 4294.9673 FORMAT "%9.4" /end CHARACTERISTIC
/begin CHARACTERISTIC AFSCD_dDT1KdAirPerTime_C "Verstärkungskonstante des DT1 filters für  Luftmassenstrom" VALUE 0xC47CC Kw_Ws32 32767.9999847 Kd 0.00 32767.9999847 FORMAT "%13.7" EXTENDED_LIMITS -32768.0000000 32767.9999847 /end CHARACTERISTIC
/begin CHARACTERISTIC AFSCD_dmAirPerTimeMax_C "maximum measurable air mass by the HFM6 sensor." VALUE 0xC420C Kw_Ws32 429496729.500 AirMassPerTime -214748364.800 214748364.700 FORMAT "%13.3" /end CHARACTERISTIC
/begin CHARACTERISTIC AFSCD_dmAirPerTimeSclFac_C "Skalierungsfaktor für den Luftmassenstrom" VALUE 0xC4210 Kw_Wu16 6553.500 AirMassPerTime 0.00 6553.500 FORMAT "%8.3" /end CHARACTERISTIC
/begin CHARACTERISTIC AFSCD_dmLin_CUR "Linearisierungkennline Sensorspannung in Luftmasse pro Zeit" CURVE 0xC4212 Kl_Xs16_Ws16 1500.000 AirMassPerTime 0.00 1500.000 FORMAT "%8.3" EXTENDED_LIMITS -3276.800 3276.700
 /begin AXIS_DESCR STD_AXIS AFSCD_tiRaw Time_PwmHigh 57 40.00000 2000.000 FORMAT "%8.3" EXTENDED_LIMITS -3276.800 3276.700 DEPOSIT ABSOLUTE /end AXIS_DESCR
/end CHARACTERISTIC
/begin CHARACTERISTIC AFSCD_facChLvl_MAP "Kennfeld zur Bestimmung des Luftaufwands des Motors" MAP 0xC42F8 Kf_Xs16_Ys16_Ws16 1.000000 Fact 0.00 1.000000 FORMAT "%8.6" EXTENDED_LIMITS -4.000000 3.999878
 /begin AXIS_DESCR STD_AXIS Eng_nAvrg EngN 10 40.00000 6000.000 FORMAT "%8.3" EXTENDED_LIMITS -32768.00 32767.00 DEPOSIT ABSOLUTE /end AXIS_DESCR
 /begin AXIS_DESCR STD_AXIS InjCtl_qCurr InjMassCyc 10 0.00 327.6700 FORMAT "%8.4" EXTENDED_LIMITS -327.6800 327.6700 DEPOSIT ABSOLUTE /end AXIS_DESCR
/end CHARACTERISTIC
/begin CHARACTERISTIC AFSCD_facPerCor_C "rated correction factor for the raw air mass" VALUE 0xC43EC Kw_Wu32 262143.999939 Fact_HFM6 0.00 262143.999939 FORMAT "%13.6" /end CHARACTERISTIC
/begin CHARACTERISTIC AFSCD_facPlsCor_MAP "Kennfeld für die Pulsationskorrektur" MAP 0xC43F0 Kf_Xs16_Ys16_Ws16 1.000000 Fact 0.00 1.000000 FORMAT "%8.6" EXTENDED_LIMITS -4.000000 3.999878
 /begin AXIS_DESCR STD_AXIS Eng_nAvrg EngN 16 40.00000 6000.000 FORMAT "%8.3" EXTENDED_LIMITS -32768.00 32767.00 DEPOSIT ABSOLUTE /end AXIS_DESCR
 /begin AXIS_DESCR STD_AXIS InjCtl_qRaw InjMassCyc 16 0.00 327.6700 FORMAT "%8.4" EXTENDED_LIMITS -327.6800 327.6700 DEPOSIT ABSOLUTE /end AXIS_DESCR
/end CHARACTERISTIC
/begin CHARACTERISTIC AFSCD_tiLPFiltPT1_C "Zeitkonstante fuer HFM Tiefpass-Filter" VALUE 0xC4634 Kw_Wu32 0.00 TimeDelay_ms 99.999239 99.999239 FORMAT "%9.5" EXTENDED_LIMITS 0.0010000000 4294967.3 /end CHARACTERISTIC
/begin CHARACTERISTIC AFSCD_mAirPerCylDfl_MAP "Vorgabewert für die Luftmasse pro Zylinder im Fehlerfall" MAP 0xC4638 Kf_Xs16_Ys16_Ws16 1500.000 AirMassPerCyl 0.00 1500.000 FORMAT "%8.3" EXTENDED_LIMITS -3276.800 3276.700
 /begin AXIS_DESCR STD_AXIS Eng_nAvrg EngN 6 0.00 6000.000 FORMAT "%8.3" EXTENDED_LIMITS -32768.00 32767.00 DEPOSIT ABSOLUTE /end AXIS_DESCR
 /begin AXIS_DESCR STD_AXIS AFSCD_pCurr_mp Pres_hPa 6 0.00 3500.000 FORMAT "%8.3" EXTENDED_LIMITS -32768.00 32767.00 DEPOSIT ABSOLUTE /end AXIS_DESCR
/end CHARACTERISTIC
/begin CHARACTERISTIC AFSCD_mDiffDef_MAP "Kennfeld fuer high Schwellwert der Hysterese zur Ueberwachung der Differenzen in zwei Luftmassen" MAP 0xC47D0 Kf_Xs16_Ys16_Ws16 1000.000 AirMassPerCyl 0.00 1000.000 FORMAT "%8.3" EXTENDED_LIMITS -3276.800 3276.700
 /begin AXIS_DESCR STD_AXIS Eng_nAvrg EngN 8 0.00 6000.000 FORMAT "%8.3" EXTENDED_LIMITS -32768.00 32767.00 DEPOSIT ABSOLUTE /end AXIS_DESCR
 /begin AXIS_DESCR STD_AXIS InjCtl_qCurr InjMassCyc 4 0.00 327.6700 FORMAT "%8.4" EXTENDED_LIMITS -327.6800 327.6700 DEPOSIT ABSOLUTE /end AXIS_DESCR
/end CHARACTERISTIC
/begin CHARACTERISTIC AFSCD_mDiffHyst_CUR "Kennlinie fuer den low Schwellwert der Hysterese zur Ueberwachung der Differenz in den Luftmassen" CURVE 0xC482C Kl_Xs16_Ws16 1000.000 AirMassPerCyl 0.00 1000.000 FORMAT "%8.3" EXTENDED_LIMITS -3276.800 3276.700
 /begin AXIS_DESCR STD_AXIS Eng_nAvrg EngN 6 0.00 6000.000 FORMAT "%8.3" EXTENDED_LIMITS -32768.00 32767.00 DEPOSIT ABSOLUTE /end AXIS_DESCR
/end CHARACTERISTIC
/begin CHARACTERISTIC AFSCD_tiThrHiPlOffsDrft_C "obere Schwelle der Plausibiltätsprüfung der Offsetdrift für HFM6" VALUE 0xC469C Kw_Ws16 2000.000 Time_PwmHigh 0.00 2000.000 FORMAT "%8.3" EXTENDED_LIMITS -3276.800 3276.700 /end CHARACTERISTIC
/begin CHARACTERISTIC AFSCD_tiThrLoPlOffsDrft_C "untere Schwelle der Plausibiltätsprüfung der Offsetdrift für HFM6" VALUE 0xC469E Kw_Ws16 2000.000 Time_PwmHigh 0.00 2000.000 FORMAT "%8.3" EXTENDED_LIMITS -3276.800 3276.700 /end CHARACTERISTIC
/begin CHARACTERISTIC AFSCD_tClntThrLo_C "Untere Kühlwassertemperaturschwelle für die Plausibilitätsprüfung der Driftempfindlichkeit des Luftmassenmessers" VALUE 0xC4864 Kw_Ws16 250.0000 Temp_Cels -50.14000 199.8600 FORMAT "%8.4" EXTENDED_LIMITS -3549.940 3003.560 /end CHARACTERISTIC
/begin CHARACTERISTIC AFSCD_tClntThrHi_C "Obere Kühlmitteltemperaturschwelle für Plausibilisierungsfreigabe der Luftmassensensor-Empfindlichkeitsdrift" VALUE 0xC4866 Kw_Ws16 250.0000 Temp_Cels -50.14000 199.8600 FORMAT "%8.4" EXTENDED_LIMITS -3549.940 3003.560 /end CHARACTERISTIC
/begin CHARACTERISTIC AFSCD_rSwirlThrLo_C "Minimale Sollposition der Einlasskanalabschaltung für Plausibilisierungsfreigabe der Luftmassensensor-Empfindlichkeitsdrift" VALUE 0xC4868 Kw_Ws16 100.0000 DtyCyc 0.00 100.0000 FORMAT "%8.4" EXTENDED_LIMITS -327.6800 327.6700 /end CHARACTERISTIC
/begin CHARACTERISTIC AFSCD_rSwirlThrHi_C "Maximale Sollpossition der Einlasskanalabschaltung für Plausibilisierungsfreigabe der  Luftmassensensor-Empfindlichkeitsdrift" VALUE 0xC486A Kw_Ws16 100.0000 DtyCyc 0.00 100.0000 FORMAT "%8.4" EXTENDED_LIMITS -327.6800 327.6700 /end CHARACTERISTIC
/begin CHARACTERISTIC AFSCD_rTVAThrLo_C "Minimale Sollposition des Drosselklappenstellers für Plausibilisierungsfreigabe der Luftmassensensor-Empfindlichkeitsdrift" VALUE 0xC486C Kw_Ws16 100.0000 Prc 0.00 100.0000 FORMAT "%8.4" EXTENDED_LIMITS -400.0000 399.9878 /end CHARACTERISTIC
/begin CHARACTERISTIC AFSCD_rTVAThrHi_C "Maximale Sollposition des Drosselklappenstellers für Plausibilisierungsfreigabe der Luftmassensensor-Empfindlichkeitsdrift" VALUE 0xC486E Kw_Ws16 100.0000 Prc 0.00 100.0000 FORMAT "%8.4" EXTENDED_LIMITS -400.0000 399.9878 /end CHARACTERISTIC
/begin CHARACTERISTIC AFSCD_pAirThrLo_C "untere Atmosphärendruckschwelle für die Plausibilitätsprüfung der Luftmassensensor-Empfindlichkeit" VALUE 0xC4870 Kw_Ws16 3000.000 Pres_hPa 500.0000 3500.000 FORMAT "%8.3" EXTENDED_LIMITS -32768.00 32767.00 /end CHARACTERISTIC
/begin CHARACTERISTIC AFSCD_qRawThrHi_C "Maximale Einspritzmenge für Plausibilisierungsfreigabe der Luftmassensensor-Empfindlichkeitsdrift" VALUE 0xC4872 Kw_Ws16 327.6700 RmpInjMass 0.00 327.6700 FORMAT "%8.4" EXTENDED_LIMITS -5.000000 4.999847 /end CHARACTERISTIC
/begin CHARACTERISTIC AFSCD_nAvrgThrLoPlHi_C "Untere Drehzahlschwelle für Plausibilisierung der oberen Luftmassensensor-Driftgrenze" VALUE 0xC4874 Kw_Ws16 6000.000 EngN 0.00 6000.000 FORMAT "%8.3" EXTENDED_LIMITS -32768.00 32767.00 /end CHARACTERISTIC
/begin CHARACTERISTIC AFSCD_nAvrgThrHiPlHi_C "Obere Drehzahlschwelle für Plausibilisierung der oberen Luftmassensensor-Driftgrenze" VALUE 0xC4876 Kw_Ws16 6000.000 EngN 0.00 6000.000 FORMAT "%8.3" EXTENDED_LIMITS -32768.00 32767.00 /end CHARACTERISTIC
/begin CHARACTERISTIC AFSCD_pBstThrHiPlHi_C "Obere Ladedruckschwelle für Plausibilisierung der oberen Luftmassensensor-Driftgrenze" VALUE 0xC4878 Kw_Ws16 3500.000 RmpPres_hPa 0.00 3500.000 FORMAT "%8.3" EXTENDED_LIMITS -500.0000 499.9847 /end CHARACTERISTIC
/begin CHARACTERISTIC AFSCD_rAirThrHiPlHi_C "Obere Normverhältnisschwelle für Plausibilisierung der oberen Luftmassensensor-Driftgrenze" VALUE 0xC487A Kw_Ws16 7.999878 Fact -4.000000 3.999878 FORMAT "%8.6" /end CHARACTERISTIC
/begin CHARACTERISTIC AFSCD_rAirWgtMin_C "" VALUE 0xC487C Kw_Ws16 7.999878 Fact -4.000000 3.999878 FORMAT "%8.6" /end CHARACTERISTIC
/begin CHARACTERISTIC AFSCD_rAirWgtMax_C "" VALUE 0xC487E Kw_Ws16 7.999878 Fact -4.000000 3.999878 FORMAT "%8.6" /end CHARACTERISTIC
/begin CHARACTERISTIC AFSCD_nAvrgThrLoPlLo_C "Untere Drehzahlschwelle für Plausibilisierung der unteren Luftmassensensor-Driftgrenze" VALUE 0xC4880 Kw_Ws16 6000.000 EngN 0.00 6000.000 FORMAT "%8.3" EXTENDED_LIMITS -32768.00 32767.00 /end CHARACTERISTIC
/begin CHARACTERISTIC AFSCD_nAvrgThrHiPlLo_C "Obere Drehzahlschwelle für Plausibilisierung der unteren Luftmassensensor-Driftgrenze" VALUE 0xC4882 Kw_Ws16 6000.000 EngN 0.00 6000.000 FORMAT "%8.3" EXTENDED_LIMITS -32768.00 32767.00 /end CHARACTERISTIC
/begin CHARACTERISTIC AFSCD_pBstThrLoPlLo_C "Untere Ladedruckschwelle für Plausibilisierung der unteren Luftmassensensor-Driftgrenze" VALUE 0xC4884 Kw_Ws16 3500.000 Pres_hPa 0.00 3500.000 FORMAT "%8.3" EXTENDED_LIMITS -32768.00 32767.00 /end CHARACTERISTIC
/begin CHARACTERISTIC AFSCD_rAirThrLoPlLo_C "Untere Normverhältnisschwelle für Plausibilisierung der unteren Luftmassensensor-Driftgrenze" VALUE 0xC4886 Kw_Ws16 7.999878 Fact -4.000000 3.999878 FORMAT "%8.6" /end CHARACTERISTIC
/begin CHARACTERISTIC AFSCD_rEGRPThrHi_C "Obere Schwelle der Stellgröße des AGR-Ventils für Plausibilisierungsfreigabe der Luftmassensensor-Empfindlichkeitsdrift" VALUE 0xC4888 Kw_Ws16 400.0000 Prc -200.0000 200.0000 FORMAT "%8.4" EXTENDED_LIMITS -400.0000 399.9878 /end CHARACTERISTIC
/begin CHARACTERISTIC AFSCD_swtAirNormSel_C "" VALUE 0xC488A Kw_Wu8 1.000 OneToOne 0.00 1.000 FORMAT "%5.3" EXTENDED_LIMITS 0.00 255.0 /end CHARACTERISTIC
/begin CHARACTERISTIC AFSCD_tiDlyEGRPPlSetyDrft_C "Verzögerungszeit nach Veränderung der Abgasrückführung für Plausibilisierungsfreigabe der Luftmassensensor-Empfindlichkeitsdrift" VALUE 0xC488C Kw_Wu16 65540.00 Time_ms 0.00 65540.00 FORMAT "%8.2" EXTENDED_LIMITS 0.00 655350.0 /end CHARACTERISTIC
/begin CHARACTERISTIC AFSCD_tiDlyStrPlSetyDrft_C "Verzögerungszeit nach Motorstart für Plausibilisierungsfreigabe der Luftmassensensor-Empfindlichkeitsdrift" VALUE 0xC488E Kw_Wu16 65540.00 Time_ms 0.00 65540.00 FORMAT "%8.2" EXTENDED_LIMITS 0.00 655350.0 /end CHARACTERISTIC
/begin CHARACTERISTIC AFSCD_dtAirThres_C "Schwelle für Änderungsrate der Ladelufttemperatur" VALUE 0xC4890 Kw_Ws16 65535.00 TempCels_100ms -32768.00 32767.00 FORMAT "%8.2" /end CHARACTERISTIC
/begin CHARACTERISTIC AFSCD_stInhRls_C "Bitmaske zur Unterdrückung der Plausibilisierung der Luftmassensensor-Empfindlichkeitsdrift bei Stellertest" VALUE 0xC4892 Kw_Wu16 65535.00 OneToOne 0.00 65535.00 FORMAT "%8.2" /end CHARACTERISTIC
/begin CHARACTERISTIC AFSCD_tiBstPresPT1_C "Zeitkonstante zur Filterung des Ladedruckgradientens" VALUE 0xC4854 Kw_Wu32 4294967.3 TimeDelay_ms 0.0010000000 4294967.3 FORMAT "%9.1" /end CHARACTERISTIC
/begin CHARACTERISTIC AFSCD_tiQntCurrPT1_C "Zeitkonstante zur Filterung des Mengengradientens" VALUE 0xC4858 Kw_Wu32 4294967.3 TimeDelay_ms 0.0010000000 4294967.3 FORMAT "%9.1" /end CHARACTERISTIC
/begin CHARACTERISTIC AFSCD_tiMAirDiffPT1_C "Zeitkonstante des PT1 Filters fuer die Luftmassen-Differenz" VALUE 0xC4848 Kw_Wu32 4294.9673 TimeDelay_s 0.0000010000000 4294.9673 FORMAT "%9.4" /end CHARACTERISTIC
/begin CHARACTERISTIC AFSCD_qAirmThrSRCHiActv_CUR "Mengenschwelle fuer SRC High der Luftmasse" CURVE 0xC46A0 Kl_Xs16_Ws16 327.6700 InjMassCyc 0.00 327.6700 FORMAT "%8.4" EXTENDED_LIMITS -327.6800 327.6700
 /begin AXIS_DESCR STD_AXIS Eng_nAvrg EngN 25 0.00 6000.000 FORMAT "%8.3" EXTENDED_LIMITS -32768.00 32767.00 DEPOSIT ABSOLUTE /end AXIS_DESCR
/end CHARACTERISTIC
/begin CHARACTERISTIC AFSCD_dtRmpSlpUp_C "Ansauglufttemperatur (HFM): Rampensteigung bei Heilung/Vorgabewert für Lufttemperatur" VALUE 0xC4758 Kw_Wu32 6553589.99786 RmpTemp 10.0006103516 6553599.99847 FORMAT "%13.5" EXTENDED_LIMITS 0.00 6553599.99847 /end CHARACTERISTIC
/begin CHARACTERISTIC AFSCD_dtRmpSlpDwn_C "Ansauglufttemperatur (HFM): Rampensteigung bei Heilung/Vorgabewert für Lufttemperatur" VALUE 0xC475C Kw_Wu32 6553589.99786 RmpTemp 10.0006103516 6553599.99847 FORMAT "%13.5" EXTENDED_LIMITS 0.00 6553599.99847 /end CHARACTERISTIC
/begin CHARACTERISTIC AFSCD_nAvrgThrLoSRCLo_C "unterer Drehzahlschwellwert fuer den SRC Low der Luftmasse" VALUE 0xC4706 Kw_Ws16 6000.000 EngN 0.00 6000.000 FORMAT "%8.3" EXTENDED_LIMITS -32768.00 32767.00 /end CHARACTERISTIC
/begin CHARACTERISTIC AFSCD_nAvrgThrHiSRCLo_C "oberer Drehzahlschwellwert fuer den SRC Low der Luftmasse" VALUE 0xC4708 Kw_Ws16 6000.000 EngN 0.00 6000.000 FORMAT "%8.3" EXTENDED_LIMITS -32768.00 32767.00 /end CHARACTERISTIC
/begin CHARACTERISTIC AFSCD_tiDlyActvSRCHiAirm_C "Zeitkonstante fuer die Fehlererkennung des SRC High des Luftmassenmessers" VALUE 0xC470A Kw_Wu16 65540.00 Time_ms 0.00 65540.00 FORMAT "%8.2" EXTENDED_LIMITS 0.00 655350.0 /end CHARACTERISTIC
/begin CHARACTERISTIC AFSCD_swtAirSysVal_C "Schalter zur Auswahl ein einzelnes/doppeltes Luftsystem" VALUE 0xC484C Kw_Wu8 1.000 OneToOne 1.000 2.000 FORMAT "%5.3" EXTENDED_LIMITS 0.00 255.0 /end CHARACTERISTIC
/begin CHARACTERISTIC AFSCD_swtAirSysType_C "SW-Schaltertyp zur Auswahl eine Luftsystemsart (0=Datensatzwert, nicht applizierbar/1=EEPROM-Wert/2=Datensatzwert)" VALUE 0xC484D Kw_Wu8 0.00 OneToOne 0.00 0.00 FORMAT "%5.2" EXTENDED_LIMITS 0.00 255.0 /end CHARACTERISTIC
/begin CHARACTERISTIC AFSCD_swtOscSel_C "Schalter, legt fest, ob der HFM6 Sensor mit einem RC oder einem Quarz Oszillator betrieben wird. (0: Quarz, 1: RC Oszillator)" VALUE 0xC470C Kw_Wu16 65535.00 OneToOne 0.00 65535.00 FORMAT "%8.2" /end CHARACTERISTIC
/begin CHARACTERISTIC AFSCD_swtSensInstVal_C "Schalter zur Bestimmung, ob der Luftmassensensor vorhanden ist oder nicht (0: nicht vorhanden, 1: vorhanden)" VALUE 0xC470E Kw_Wu8 1.000 OneToOne 0.00 1.000 FORMAT "%5.3" EXTENDED_LIMITS 0.00 255.0 /end CHARACTERISTIC
/begin CHARACTERISTIC AFSCD_swtSensInstType_C "Definition des SW-Schaltertyps (0=Datensatzwert, nicht applizierbar/1=EEPROM-Wert/2=Datensatzwert)" VALUE 0xC470F Kw_Wu8 1.000 OneToOne 1.000 2.000 FORMAT "%5.3" EXTENDED_LIMITS 0.00 255.0 /end CHARACTERISTIC
/begin CHARACTERISTIC AFSCD_tAirThrSRCHi_C "upper threshold for SRC of physical air temperature value" VALUE 0xC4760 Kw_Ws16 250.0000 Temp_Cels -50.14000 199.8600 FORMAT "%8.4" EXTENDED_LIMITS -3549.940 3003.560 /end CHARACTERISTIC
/begin CHARACTERISTIC AFSCD_tAirThrSRCLo_C "lower threshold for the SRC of the physical air temperature" VALUE 0xC4762 Kw_Ws16 250.0000 Temp_Cels -50.14000 199.8600 FORMAT "%8.4" EXTENDED_LIMITS -3549.940 3003.560 /end CHARACTERISTIC
/begin CHARACTERISTIC AFSCD_tiCorrSRCHi_C "upper threshold for the SRC of the corrected air mass signal for the HFM6 sensor." VALUE 0xC4710 Kw_Ws32 2000.00000000 Time_PwmHigh 0.00 2000.00000000 FORMAT "%13.8" EXTENDED_LIMITS -214748364.800 214748364.700 /end CHARACTERISTIC
/begin CHARACTERISTIC AFSCD_tiCorrSRCLo_C "lower threshold for the SRC of the corrected air mass for the HFM6 sensor" VALUE 0xC4714 Kw_Ws32 2000.00000000 Time_PwmHigh 0.00 2000.00000000 FORMAT "%13.8" EXTENDED_LIMITS -214748364.800 214748364.700 /end CHARACTERISTIC
/begin CHARACTERISTIC AFSCD_tiOffsDrftTstDel_C "Verzögerungszeit im Nachlauf vor der Plausibilitätsprüfung der Offsetdrift" VALUE 0xC4718 Kw_Wu16 655140.0 Time_ms 0.00 655140.0 FORMAT "%8.1" EXTENDED_LIMITS 0.00 655350.0 /end CHARACTERISTIC
/begin CHARACTERISTIC AFSCD_tiOffsDrftTstLim_C "Zeitdauer für die Plausibilitätsprüfung der Offsetdrift im Nachlauf" VALUE 0xC471A Kw_Wu16 655350.0 Time_ms 0.00 655350.0 FORMAT "%8.1" /end CHARACTERISTIC
/begin CHARACTERISTIC AFSCD_tiPerHFM6_C "time constant of the HFM6 sensor electronics" VALUE 0xC471C Kw_Wu32 1048.57599976 Time_Period_HFM6 0.00 1048.57599976 FORMAT "%13.8" /end CHARACTERISTIC
/begin CHARACTERISTIC AFSCD_DebPlAirPerCylDiffDef_C "Fehlerentprellzeit für Differenz zwischen zwei Luftmassen" VALUE 0xC484E Kw_Wu16 655350.0 Time_ms 0.00 655350.0 FORMAT "%8.1" /end CHARACTERISTIC
/begin CHARACTERISTIC AFSCD_DebPlAirPerCylDiffOk_C "Heilzeit für Differenz zwischen zwei Luftmassen" VALUE 0xC4850 Kw_Wu16 655350.0 Time_ms 0.00 655350.0 FORMAT "%8.1" /end CHARACTERISTIC
/begin CHARACTERISTIC AFSCD_tiRawSRCHi_C "upper threshold for the SRC of the raw air mass signal for HFM6 sensor" VALUE 0xC4720 Kw_Ws32 2000.00000000 Time_PwmHigh 0.00 2000.00000000 FORMAT "%13.8" EXTENDED_LIMITS -214748364.800 214748364.700 /end CHARACTERISTIC
/begin CHARACTERISTIC AFSCD_tiRawSRCLo_C "lower threshold for the SRC of the raw air mass signal for HFM6 sensor" VALUE 0xC4724 Kw_Ws32 2000.00000000 Time_PwmHigh 0.00 2000.00000000 FORMAT "%13.8" EXTENDED_LIMITS -214748364.800 214748364.700 /end CHARACTERISTIC
/begin CHARACTERISTIC AFSCD_tLin2_CUR "Kennlinie zur Linearisierung der Lufttemperaturmessung für Sensor 2" CURVE 0xC4798 Kl_Xs16_Ws16 250.0000 Temp_Cels -50.14000 199.8600 FORMAT "%8.4" EXTENDED_LIMITS -3549.940 3003.560
 /begin AXIS_DESCR STD_AXIS AFSCD_rAir2 DtyCyc 11 0.00 100.0000 FORMAT "%8.4" EXTENDED_LIMITS -327.6800 327.6700 DEPOSIT ABSOLUTE /end AXIS_DESCR
/end CHARACTERISTIC
/begin CHARACTERISTIC AFSCD_tLin_CUR "Ansauglufttemperatur T1: Linearisierungskennlinie Spannung nach Luftmassenrohwert" CURVE 0xC4764 Kl_Xs16_Ws16 250.0000 Temp_Cels -50.14000 199.8600 FORMAT "%8.4" EXTENDED_LIMITS -3549.940 3003.560
 /begin AXIS_DESCR STD_AXIS AFSCD_rAir DtyCyc 11 0.00 100.0000 FORMAT "%8.4" EXTENDED_LIMITS -327.6800 327.6700 DEPOSIT ABSOLUTE /end AXIS_DESCR
/end CHARACTERISTIC
/begin CHARACTERISTIC AFSCD_stSensIDWordAirTemp_C "Einstellung für das Übergangsverhalten der Lufttemperatur im Fehlerfall" VALUE 0xC4792 Kw_Wu16 65535.00 OneToOne 0.00 65535.00 FORMAT "%8.2" /end CHARACTERISTIC
/begin CHARACTERISTIC AFSCD_tDfl_C "Ansauglufttemperatur (HFM): Vorgabewert der HFM-Lufttemperatur" VALUE 0xC4794 Kw_Ws16 950.000 Temp_Cels -50.140 899.860 FORMAT "%8.3" EXTENDED_LIMITS -3549.940 3003.560 /end CHARACTERISTIC
/begin CHARACTERISTIC AFSCD_uBattSRCMax_C "obere Schwelle für Prüfung der optimalen Batteriespannung" VALUE 0xC4728 Kw_Wu16 27996.09 Volt_Batt 0.00 27996.09 FORMAT "%8.2" EXTENDED_LIMITS 0.00 1281232. /end CHARACTERISTIC
/begin CHARACTERISTIC AFSCD_uBattSRCMin_C "untere Schwelle für Prüfung der optimalen Batteriespannung" VALUE 0xC472A Kw_Ws16 27996.09 Volt_Batt 0.00 27996.09 FORMAT "%8.2" EXTENDED_LIMITS -640625.6 640606.1 /end CHARACTERISTIC
/begin CHARACTERISTIC AFSCD_volCyl_C "Hubvolumen der Zylinder" VALUE 0xC472C Kw_Ws16 65535.00 VolCyl -32768.00 32767.00 FORMAT "%8.2" /end CHARACTERISTIC
/begin CHARACTERISTIC AirCtl_APCorRgn_CUR "Kennlinie für Atmosphärendruckkorrekturwert Regenerations-betrieb" CURVE 0xC4D20 Kl_Xs16_Ws16 5.000000 Fact 0.00 5.000000 FORMAT "%8.6" EXTENDED_LIMITS -4.000000 3.999878
 /begin AXIS_DESCR STD_AXIS APSCD_pVal Pres_hPa 8 0.00 4000.000 FORMAT "%8.3" EXTENDED_LIMITS -32768.00 32767.00 DEPOSIT ABSOLUTE /end AXIS_DESCR
/end CHARACTERISTIC
/begin CHARACTERISTIC AirCtl_APSCor_CUR "Kennlinie für Atmosphärendruckkorrektur" CURVE 0xC4D42 Kl_Xs16_Ws16 3000.000 AirMassPerCyl -1500.000 1500.000 FORMAT "%8.3" EXTENDED_LIMITS -3276.800 3276.700
 /begin AXIS_DESCR STD_AXIS APSCD_pVal Pres_hPa 8 0.00 4000.000 FORMAT "%8.3" EXTENDED_LIMITS -32768.00 32767.00 DEPOSIT ABSOLUTE /end AXIS_DESCR
/end CHARACTERISTIC
/begin CHARACTERISTIC AirCtl_ATCorRgn_CUR "Kennlinie für Lufttemperaturkorrekturwert Regenerations betrieb" CURVE 0xC4D64 Kl_Xs16_Ws16 5.000000 Fact 0.00 5.000000 FORMAT "%8.6" EXTENDED_LIMITS -4.000000 3.999878
 /begin AXIS_DESCR STD_AXIS IATSCD_tAir Temp_Cels 8 -50.1400 199.8600 FORMAT "%8.4" EXTENDED_LIMITS -3549.940 3003.560 DEPOSIT ABSOLUTE /end AXIS_DESCR
/end CHARACTERISTIC
/begin CHARACTERISTIC AirCtl_drBelCtlUpRmp_C "positive Rampensteigung des AirCtl_rBelCtl_mp zur Umschaltung auf AirCtl_rBelCtl_C%" VALUE 0xC6B34 Kw_Wu32 799999.999814 RmpPrc 0.00 799999.999814 FORMAT "%13.6" /end CHARACTERISTIC
/begin CHARACTERISTIC AirCtl_drBelCtlDwnRmp_C "negative Rampensteigung des AirCtl_rBelCtl_mp zur Umschaltung auf 0%" VALUE 0xC6B38 Kw_Wu32 799999.999814 RmpPrc 0.00 799999.999814 FORMAT "%13.6" /end CHARACTERISTIC
/begin CHARACTERISTIC AirCtl_DKdAGR_C "Grundwert der Verstärkung des DT1- Glieds bei Kleinsignalen abhängig von Luftmassensollwert" VALUE 0xC6B3C Kw_Ws32 39999.9999814 Kd_InjMass2Prc 0.00 39999.9999814 FORMAT "%13.7" EXTENDED_LIMITS -40000.0000000 39999.9999814 /end CHARACTERISTIC
/begin CHARACTERISTIC AirCtl_DKdNegAGR_MAP "Grundwert der Verstärkung des DT1-Glieds bei negativen Großsignalen" MAP 0xC6B40 Kf_Xs16_Ys16_Ws16 624.9809 Kd_InjMass2PrcRedRes 0.00 624.9809 FORMAT "%8.4" EXTENDED_LIMITS -625.0000 624.9809
 /begin AXIS_DESCR STD_AXIS AirCtl_dmDesCor AirMassPerCyl 8 -5000.000 5000.000 FORMAT "%8.3" EXTENDED_LIMITS -3276.800 3276.700 DEPOSIT ABSOLUTE /end AXIS_DESCR
 /begin AXIS_DESCR STD_AXIS AirCtl_mGvnrDvtFlt AirMassPerCyl 8 -5000.000 5000.000 FORMAT "%8.3" EXTENDED_LIMITS -3276.800 3276.700 DEPOSIT ABSOLUTE /end AXIS_DESCR
/end CHARACTERISTIC
/begin CHARACTERISTIC AirCtl_DKdNegqDes_MAP "negative Großsignalverstärkung der dyn. Sollwertbildung abhängig von Einspritzmenge" MAP 0xC4D86 Kf_Xs16_Ys16_Ws16 639.9805 Kd_InjMass2AmpcRedRes 0.00 639.9805 FORMAT "%8.4" EXTENDED_LIMITS -640.0000 639.9805
 /begin AXIS_DESCR STD_AXIS AirCtl_dmDesCor AirMassPerCyl 8 -5000.000 5000.000 FORMAT "%8.3" EXTENDED_LIMITS -3276.800 3276.700 DEPOSIT ABSOLUTE /end AXIS_DESCR
 /begin AXIS_DESCR STD_AXIS AirCtl_mGvnrDvtFlt AirMassPerCyl 8 -5000.000 5000.000 FORMAT "%8.3" EXTENDED_LIMITS -3276.800 3276.700 DEPOSIT ABSOLUTE /end AXIS_DESCR
/end CHARACTERISTIC
/begin CHARACTERISTIC AirCtl_DKdNegRgn_MAP "Grundwert der Verstärkung des DT1-Glieds im Regenerationsbetrieb bei negativen Großsignalen" MAP 0xC7744 Kf_Xs16_Ys16_Ws16 624.9809 Kd_InjMass2PrcRedRes 0.00 624.9809 FORMAT "%8.4" EXTENDED_LIMITS -625.0000 624.9809
 /begin AXIS_DESCR STD_AXIS AirCtl_dmDesCor AirMassPerCyl 8 -5000.000 5000.000 FORMAT "%8.3" EXTENDED_LIMITS -3276.800 3276.700 DEPOSIT ABSOLUTE /end AXIS_DESCR
 /begin AXIS_DESCR STD_AXIS AirCtl_mGvnrDvtFlt AirMassPerCyl 8 -5000.000 5000.000 FORMAT "%8.3" EXTENDED_LIMITS -3276.800 3276.700 DEPOSIT ABSOLUTE /end AXIS_DESCR
/end CHARACTERISTIC
/begin CHARACTERISTIC AirCtl_DKdPosAGR_MAP "Grundwert der Verstärkung des DT1-Glieds bei positiven Großsignalen" MAP 0xC6BE4 Kf_Xs16_Ys16_Ws16 624.9809 Kd_InjMass2PrcRedRes 0.00 624.9809 FORMAT "%8.4" EXTENDED_LIMITS -625.0000 624.9809
 /begin AXIS_DESCR STD_AXIS AirCtl_dmDesCor AirMassPerCyl 8 -5000.000 5000.000 FORMAT "%8.3" EXTENDED_LIMITS -3276.800 3276.700 DEPOSIT ABSOLUTE /end AXIS_DESCR
 /begin AXIS_DESCR STD_AXIS AirCtl_mGvnrDvtFlt AirMassPerCyl 8 -5000.000 5000.000 FORMAT "%8.3" EXTENDED_LIMITS -3276.800 3276.700 DEPOSIT ABSOLUTE /end AXIS_DESCR
/end CHARACTERISTIC
/begin CHARACTERISTIC AirCtl_DKdPosqDes_MAP "positive Großsignalverstärkung der dyn. Sollwertbildung abhängig von Einspritzmenge" MAP 0xC4E2A Kf_Xs16_Ys16_Ws16 639.9805 Kd_InjMass2AmpcRedRes 0.00 639.9805 FORMAT "%8.4" EXTENDED_LIMITS -640.0000 639.9805
 /begin AXIS_DESCR STD_AXIS AirCtl_dmDesCor AirMassPerCyl 8 -5000.000 5000.000 FORMAT "%8.3" EXTENDED_LIMITS -3276.800 3276.700 DEPOSIT ABSOLUTE /end AXIS_DESCR
 /begin AXIS_DESCR STD_AXIS AirCtl_mGvnrDvtFlt AirMassPerCyl 8 -5000.000 5000.000 FORMAT "%8.3" EXTENDED_LIMITS -3276.800 3276.700 DEPOSIT ABSOLUTE /end AXIS_DESCR
/end CHARACTERISTIC
/begin CHARACTERISTIC AirCtl_DKdPosRgn_MAP "Grundwert der Verstärkung des DT1-Glieds im Regenerationsbetrieb bei positiven Großsignalen" MAP 0xC77E8 Kf_Xs16_Ys16_Ws16 624.9809 Kd_InjMass2PrcRedRes 0.00 624.9809 FORMAT "%8.4" EXTENDED_LIMITS -625.0000 624.9809
 /begin AXIS_DESCR STD_AXIS AirCtl_dmDesCor AirMassPerCyl 8 -5000.000 5000.000 FORMAT "%8.3" EXTENDED_LIMITS -3276.800 3276.700 DEPOSIT ABSOLUTE /end AXIS_DESCR
 /begin AXIS_DESCR STD_AXIS AirCtl_mGvnrDvtFlt AirMassPerCyl 8 -5000.000 5000.000 FORMAT "%8.3" EXTENDED_LIMITS -3276.800 3276.700 DEPOSIT ABSOLUTE /end AXIS_DESCR
/end CHARACTERISTIC
/begin CHARACTERISTIC AirCtl_DKdqDes_C "Kleinsignalverstärkung der dyn. Sollwertbildung abhängig von Einspritzmenge" VALUE 0xC4ED0 Kw_Ws32 327679.999847 Kd_InjMass2Ampc 0.00 327679.999847 FORMAT "%13.6" EXTENDED_LIMITS -327680.000000 327679.999847 /end CHARACTERISTIC
/begin CHARACTERISTIC AirCtl_DKdRgn_C "Basic value of DT1 element gain for small signals in regeneration operation" VALUE 0xC788C Kw_Ws32 39999.9999814 Kd_InjMass2Prc 0.00 39999.9999814 FORMAT "%13.7" EXTENDED_LIMITS -40000.0000000 39999.9999814 /end CHARACTERISTIC
/begin CHARACTERISTIC AirCtl_dmDesBasUp_C "positie rampensteigung für den luftmassensollgrundwert" VALUE 0xC4ED4 Kw_Wu32 6553599.99847 RmpAirMassPerCyl 0.00 6553599.99847 FORMAT "%13.5" /end CHARACTERISTIC
/begin CHARACTERISTIC AirCtl_dmDesBasDwn_C "Negative Rampensteigung für den Luftmassensollgrundwert" VALUE 0xC4ED8 Kw_Wu32 6553599.99847 RmpAirMassPerCyl 0.00 6553599.99847 FORMAT "%13.5" /end CHARACTERISTIC
/begin CHARACTERISTIC AirCtl_dnSurgeHigh_CUR "Obergenze für Drehzahlgradienten Hysterese gegen Laderpumpen" CURVE 0xC823C Kl_Xs16_Ws16 3000.000 dn_dZ20 0.00 3000.000 FORMAT "%8.3" EXTENDED_LIMITS -327680.0 327670.0
 /begin AXIS_DESCR STD_AXIS Eng_nAvrg EngN 5 0.00 6000.000 FORMAT "%8.3" EXTENDED_LIMITS -32768.00 32767.00 DEPOSIT ABSOLUTE /end AXIS_DESCR
/end CHARACTERISTIC
/begin CHARACTERISTIC AirCtl_dnSurgeLow_CUR "Untergrenze für Drehzahlgradienten Hysterese gegen Laderpumpen" CURVE 0xC8252 Kl_Xs16_Ws16 3000.000 dn_dZ20 0.00 3000.000 FORMAT "%8.3" EXTENDED_LIMITS -327680.0 327670.0
 /begin AXIS_DESCR STD_AXIS Eng_nAvrg EngN 5 0.00 6000.000 FORMAT "%8.3" EXTENDED_LIMITS -32768.00 32767.00 DEPOSIT ABSOLUTE /end AXIS_DESCR
/end CHARACTERISTIC
/begin CHARACTERISTIC AirCtl_dqCurrRmpUp_C "Rampensteigung für ungefilterte Einspritzmenge" VALUE 0xC8268 Kw_Wu32 655359.999847 RmpInjMass 0.00 655359.999847 FORMAT "%13.6" /end CHARACTERISTIC
/begin CHARACTERISTIC AirCtl_dqCurrRmpDwn_C "Rampensenkung für ungefilterte Einspritzmenge" VALUE 0xC826C Kw_Wu32 655359.999847 RmpInjMass 0.00 655359.999847 FORMAT "%13.6" /end CHARACTERISTIC
/begin CHARACTERISTIC AirCtl_dqDWinNegAGR_C "untere Kleinsignalgrenze für das DT1- Glied abhängig von Einspritzmenge" VALUE 0xC6C88 Kw_Ws16 327.6800 InjMassCyc -327.6800 0.00 FORMAT "%8.4" EXTENDED_LIMITS -327.6800 327.6700 /end CHARACTERISTIC
/begin CHARACTERISTIC AirCtl_dqDWinNegDes_C "untere Kleinsignalgrenze für das DT1- Glied abhängig von Einspritzmenge" VALUE 0xC4EDC Kw_Ws16 327.6800 InjMassCyc -327.6800 0.00 FORMAT "%8.4" EXTENDED_LIMITS -327.6800 327.6700 /end CHARACTERISTIC
/begin CHARACTERISTIC AirCtl_dqDWinNegRgn_C "Lower small-signal limit for the DT1-element in regeneration operation" VALUE 0xC7890 Kw_Ws16 327.6800 InjMassCyc -327.6800 0.00 FORMAT "%8.4" EXTENDED_LIMITS -327.6800 327.6700 /end CHARACTERISTIC
/begin CHARACTERISTIC AirCtl_dqDWinPosAGR_C "obere Kleinsignalgrenze für das DT1- Glied abhängig von Einspritzmenge" VALUE 0xC6C8A Kw_Ws16 327.6700 InjMassCyc 0.00 327.6700 FORMAT "%8.4" EXTENDED_LIMITS -327.6800 327.6700 /end CHARACTERISTIC
/begin CHARACTERISTIC AirCtl_dqDWinPosDes_C "obere Kleinsignalgrenze für das DT1- Glied abhängig von Einspritzmenge" VALUE 0xC4EDE Kw_Ws16 327.6700 InjMassCyc 0.00 327.6700 FORMAT "%8.4" EXTENDED_LIMITS -327.6800 327.6700 /end CHARACTERISTIC
/begin CHARACTERISTIC AirCtl_dqDWinPosRgn_C "Upper small-signal limit for the DT1-element in regeneration operation" VALUE 0xC7892 Kw_Ws16 327.6700 InjMassCyc 0.00 327.6700 FORMAT "%8.4" EXTENDED_LIMITS -327.6800 327.6700 /end CHARACTERISTIC
/begin CHARACTERISTIC AirCtl_dqRawInjMass_C "threshold for injection mass" VALUE 0xC8270 Kw_Ws16 16384.00 InjMassPerSec_20ms -16384.00 0.00 FORMAT "%8.2" EXTENDED_LIMITS -16384.00 16383.50 /end CHARACTERISTIC
/begin CHARACTERISTIC AirCtl_drBrkRmpUp_C "Positive Rampensteigung  für Bremssignal Auswertung" VALUE 0xC8274 Kw_Wu32 799999.999814 RmpPrc 0.00 799999.999814 FORMAT "%13.6" /end CHARACTERISTIC
/begin CHARACTERISTIC AirCtl_drBrkRmpDwn_C "Negative Rampensteigung  für Bremssignal Auswertung" VALUE 0xC8278 Kw_Wu32 799999.999814 RmpPrc 0.00 799999.999814 FORMAT "%13.6" /end CHARACTERISTIC
/begin CHARACTERISTIC AirCtl_drDynMinUp_C "Rampe dynamische Begrenzung 1 -" VALUE 0xC6C8C Kw_Wu32 3999.99991059 RmpPrc 0.00 3999.99991059 FORMAT "%13.8" EXTENDED_LIMITS 0.00 799999.999814 /end CHARACTERISTIC
/begin CHARACTERISTIC AirCtl_drDynMinDwn_C "Rampe dynamische Begrenzung 1 -" VALUE 0xC6C90 Kw_Wu32 3999.99991059 RmpPrc 0.00 3999.99991059 FORMAT "%13.8" EXTENDED_LIMITS 0.00 799999.999814 /end CHARACTERISTIC
/begin CHARACTERISTIC AirCtl_drDynOut1Up_C "Rampe Up dynamische Begrenzung 1" VALUE 0xC6C94 Kw_Wu32 3999.99991059 RmpPrc 0.00 3999.99991059 FORMAT "%13.8" EXTENDED_LIMITS 0.00 799999.999814 /end CHARACTERISTIC
/begin CHARACTERISTIC AirCtl_drDynOut1Dwn_C "Rampe Down dynamische Begrenzung 1" VALUE 0xC6C98 Kw_Wu32 3999.99991059 RmpPrc 0.00 3999.99991059 FORMAT "%13.8" EXTENDED_LIMITS 0.00 799999.999814 /end CHARACTERISTIC
/begin CHARACTERISTIC AirCtl_drDynOut2Up_C "Rampe dynamische Begrenzung 2 -" VALUE 0xC6C9C Kw_Wu32 3999.99991059 RmpPrc 0.00 3999.99991059 FORMAT "%13.8" EXTENDED_LIMITS 0.00 799999.999814 /end CHARACTERISTIC
/begin CHARACTERISTIC AirCtl_drDynOut2Dwn_C "Rampe dynamische Begrenzung 2 -" VALUE 0xC6CA0 Kw_Wu32 3999.99991059 RmpPrc 0.00 3999.99991059 FORMAT "%13.8" EXTENDED_LIMITS 0.00 799999.999814 /end CHARACTERISTIC
/begin CHARACTERISTIC AirCtl_drGvnrDynMinUp_C "Rampe dynamische Begrenzung 1 -Umschaltung Nrm - Rgn" VALUE 0xC6CA4 Kw_Wu32 3999.99991059 RmpPrc 0.00 3999.99991059 FORMAT "%13.8" EXTENDED_LIMITS 0.00 799999.999814 /end CHARACTERISTIC
/begin CHARACTERISTIC AirCtl_drGvnrDynMinDwn_C "Rampe dynamische Begrenzung 1 -" VALUE 0xC6CA8 Kw_Wu32 3999.99991059 RmpPrc 0.00 3999.99991059 FORMAT "%13.8" EXTENDED_LIMITS 0.00 799999.999814 /end CHARACTERISTIC
/begin CHARACTERISTIC AirCtl_tiDT1qDesCor_C "Zeitkonstante des DT1-Gliedes für AirCtl_mDesStat/AirCtl_qCurrCor" VALUE 0xC4EE0 Kw_Wu32 4294.9663 TimeDelay_s 0.0010000001 4294.9673 FORMAT "%9.4" EXTENDED_LIMITS 0.0000010000000 4294.9673 /end CHARACTERISTIC
/begin CHARACTERISTIC AirCtl_kdDT1qDesCor_C "Kleinsignalverstärkung der dyn. Sollwertbildung abhängig von Einspritzmenge" VALUE 0xC4EE4 Kw_Ws32 327679.999847 Kd_InjMass2Ampc 0.00 327679.999847 FORMAT "%13.6" EXTENDED_LIMITS -327680.000000 327679.999847 /end CHARACTERISTIC
/begin CHARACTERISTIC AirCtl_tiqRawDT1_C "Reciprocal of time delay" VALUE 0xC827C Kw_Wu32 4294.9663 TimeDelay_s 0.0010000001 4294.9673 FORMAT "%9.4" EXTENDED_LIMITS 0.0000010000000 4294.9673 /end CHARACTERISTIC
/begin CHARACTERISTIC AirCtl_kdDT1qRaw_C "Differential factor" VALUE 0xC8280 Kw_Ws32 32767.9999847 Kd 0.00 32767.9999847 FORMAT "%13.7" EXTENDED_LIMITS -32768.0000000 32767.9999847 /end CHARACTERISTIC
/begin CHARACTERISTIC AirCtl_tiDT1qSetUnBal_C "Zeitkonstante des DT1-Gliedes für InjCtl_qSetUnBal" VALUE 0xC4EE8 Kw_Wu32 4294.9663 TimeDelay_s 0.0010000001 4294.9673 FORMAT "%9.4" EXTENDED_LIMITS 0.0000010000000 4294.9673 /end CHARACTERISTIC
/begin CHARACTERISTIC AirCtl_kdDT1qSetUnBal_C "Verstärkungskonstante des DT1 filters für Kraftstoffmasse ohne FBC" VALUE 0xC4EEC Kw_Ws32 32767.9999847 Kd 0.00 32767.9999847 FORMAT "%13.7" EXTENDED_LIMITS -32768.0000000 32767.9999847 /end CHARACTERISTIC
/begin CHARACTERISTIC AirCtl_facActDesVal_C "Sicherheitsfaktor für zu realisierenden Luftmassenstrom" VALUE 0xC8284 Kw_Wu16 0.1999512 Fact 0.8000488 1.000000 FORMAT "%8.6" EXTENDED_LIMITS 0.00 7.999878 /end CHARACTERISTIC
/begin CHARACTERISTIC AirCtl_facAPSmAirDynCor1_CUR "Gewichtungsfaktor - abh. von Atmospaerendruck" CURVE 0xC4EF0 Kl_Xs16_Ws16 4.000000 Fact 0.00 4.000000 FORMAT "%8.6" EXTENDED_LIMITS -4.000000 3.999878
 /begin AXIS_DESCR STD_AXIS APSCD_pVal Pres_hPa 6 0.00 4000.000 FORMAT "%8.3" EXTENDED_LIMITS -32768.00 32767.00 DEPOSIT ABSOLUTE /end AXIS_DESCR
/end CHARACTERISTIC
/begin CHARACTERISTIC AirCtl_facATParAdDKd_CUR "Parameter adaption of D governor based on air temperature" CURVE 0xC6CAC Kl_Xs16_Ws16 5.000000 Fact1 0.00 5.000000 FORMAT "%8.6" EXTENDED_LIMITS -256.0000 255.9922
 /begin AXIS_DESCR STD_AXIS IATSCD_tAir Temp_Cels 8 -50.14000 199.86000 FORMAT "%8.5" EXTENDED_LIMITS -3549.940 3003.560 DEPOSIT ABSOLUTE /end AXIS_DESCR
/end CHARACTERISTIC
/begin CHARACTERISTIC AirCtl_facATParAdIKi_CUR "Parameter adaption  of I governor based on air temperature" CURVE 0xC6CCE Kl_Xs16_Ws16 5.000000 Fact1 0.00 5.000000 FORMAT "%8.6" EXTENDED_LIMITS -256.0000 255.9922
 /begin AXIS_DESCR STD_AXIS IATSCD_tAir Temp_Cels 8 -50.14000 199.86000 FORMAT "%8.5" EXTENDED_LIMITS -3549.940 3003.560 DEPOSIT ABSOLUTE /end AXIS_DESCR
/end CHARACTERISTIC
/begin CHARACTERISTIC AirCtl_facATParAdPKp_CUR "Parameter adaption  of P governor based on air temperature" CURVE 0xC6CF0 Kl_Xs16_Ws16 5.000000 Fact1 0.00 5.000000 FORMAT "%8.6" EXTENDED_LIMITS -256.0000 255.9922
 /begin AXIS_DESCR STD_AXIS IATSCD_tAir Temp_Cels 8 -50.14000 199.86000 FORMAT "%8.5" EXTENDED_LIMITS -3549.940 3003.560 DEPOSIT ABSOLUTE /end AXIS_DESCR
/end CHARACTERISTIC
/begin CHARACTERISTIC AirCtl_facCTSCor1_CUR "Kennlinie für Kühlmitteltemperaturkorrekturwert" CURVE 0xC4F0A Kl_Xs16_Ws16 4.000000 Fact 0.00 4.000000 FORMAT "%8.6" EXTENDED_LIMITS -4.000000 3.999878
 /begin AXIS_DESCR STD_AXIS CTSCD_tClnt Temp_Cels 10 -50.1400 199.8600 FORMAT "%8.4" EXTENDED_LIMITS -3549.940 3003.560 DEPOSIT ABSOLUTE /end AXIS_DESCR
/end CHARACTERISTIC
/begin CHARACTERISTIC AirCtl_facCTSCor2_CUR "Kennlinie für Kühlmitteltemperaturkorrekturwert" CURVE 0xC4F34 Kl_Xs16_Ws16 4.000000 Fact 0.00 4.000000 FORMAT "%8.6" EXTENDED_LIMITS -4.000000 3.999878
 /begin AXIS_DESCR STD_AXIS CTSCD_tClnt Temp_Cels 8 -50.1400 199.8600 FORMAT "%8.4" EXTENDED_LIMITS -3549.940 3003.560 DEPOSIT ABSOLUTE /end AXIS_DESCR
/end CHARACTERISTIC
/begin CHARACTERISTIC AirCtl_facDQmAirDynCor1_CUR "Gewichtungsfaktor - abh. von Mengengradienten" CURVE 0xC4F56 Kl_Xs16_Ws16 4.000000 Fact 0.00 4.000000 FORMAT "%8.6" EXTENDED_LIMITS -4.000000 3.999878
 /begin AXIS_DESCR STD_AXIS AirCtl_dqSetUnBal_mp InjMassPerSec_20ms 6 0.00 327.5000 FORMAT "%8.4" EXTENDED_LIMITS -16384.00 16383.50 DEPOSIT ABSOLUTE /end AXIS_DESCR
/end CHARACTERISTIC
/begin CHARACTERISTIC AirCtl_facEGRCtlATCor_CUR "Ansauglufttemperatur-Korrekturfaktor des Tastverhältnisses für EGR" CURVE 0xC6D12 Kl_Xs16_Ws16 5.000000 Fact1 0.00 5.000000 FORMAT "%8.6" EXTENDED_LIMITS -256.0000 255.9922
 /begin AXIS_DESCR STD_AXIS IATSCD_tAir Temp_Cels 6 -50.14000 199.86000 FORMAT "%8.5" EXTENDED_LIMITS -3549.940 3003.560 DEPOSIT ABSOLUTE /end AXIS_DESCR
/end CHARACTERISTIC
/begin CHARACTERISTIC AirCtl_facEGRCtlCTCor_CUR "Kühlmitteltemperatur-Korrekturfaktor des Tastverhältnisses   für EGR" CURVE 0xC6D2C Kl_Xs16_Ws16 5.000000 Fact1 0.00 5.000000 FORMAT "%8.6" EXTENDED_LIMITS -256.0000 255.9922
 /begin AXIS_DESCR STD_AXIS CTSCD_tClnt Temp_Cels 6 -50.14000 199.86000 FORMAT "%8.5" EXTENDED_LIMITS -3549.940 3003.560 DEPOSIT ABSOLUTE /end AXIS_DESCR
/end CHARACTERISTIC
/begin CHARACTERISTIC AirCtl_facEGRRgnCorr_CUR "EGR Regenerationskorrektur Eigenschaften an den großen Höhen" CURVE 0xC7894 Kl_Xs16_Ws16 5.000000 Fact1 0.00 5.000000 FORMAT "%8.6" EXTENDED_LIMITS -256.0000 255.9922
 /begin AXIS_DESCR STD_AXIS APSCD_pVal Pres_hPa 8 0.00 3500.000 FORMAT "%8.3" EXTENDED_LIMITS -32768.00 32767.00 DEPOSIT ABSOLUTE /end AXIS_DESCR
/end CHARACTERISTIC
/begin CHARACTERISTIC AirCtl_facETmAirDynCor1_CUR "Gewichtungsfaktor - abh. von Motortemperatur" CURVE 0xC4F70 Kl_Xs16_Ws16 4.000000 Fact 0.00 4.000000 FORMAT "%8.6" EXTENDED_LIMITS -4.000000 3.999878
 /begin AXIS_DESCR STD_AXIS CTSCD_tClnt Temp_Cels 6 -50.1400 199.8600 FORMAT "%8.4" EXTENDED_LIMITS -3549.940 3003.560 DEPOSIT ABSOLUTE /end AXIS_DESCR
/end CHARACTERISTIC
/begin CHARACTERISTIC AirCtl_facIATSCor_CUR "Kennlinie für Lufttemperaturkorrekturfaktor für ARF" CURVE 0xC4F8A Kl_Xs16_Ws16 4.000000 Fact 0.00 4.000000 FORMAT "%8.6" EXTENDED_LIMITS -4.000000 3.999878
 /begin AXIS_DESCR STD_AXIS IATSCD_tAir Temp_Cels 10 -50.1400 199.8600 FORMAT "%8.4" EXTENDED_LIMITS -3549.940 3003.560 DEPOSIT ABSOLUTE /end AXIS_DESCR
/end CHARACTERISTIC
/begin CHARACTERISTIC AirCtl_facIATSmAirDynCor1_CUR "Gewichtungsfaktor - abh. von Ansauglufttemperatur" CURVE 0xC4FB4 Kl_Xs16_Ws16 4.000000 Fact 0.00 4.000000 FORMAT "%8.6" EXTENDED_LIMITS -4.000000 3.999878
 /begin AXIS_DESCR STD_AXIS IATSCD_tAir Temp_Cels 6 -50.1400 199.8600 FORMAT "%8.4" EXTENDED_LIMITS -3549.940 3003.560 DEPOSIT ABSOLUTE /end AXIS_DESCR
/end CHARACTERISTIC
/begin CHARACTERISTIC AirCtl_facMaxTrmValRgn_C "maximum correction value in the regeneration operation" VALUE 0xC4FCE Kw_Ws16 7.999878 Fact -4.000000 3.999878 FORMAT "%8.6" /end CHARACTERISTIC
/begin CHARACTERISTIC AirCtl_facMinTrmValRgn_C "Minimum correction value in the regeneration operation" VALUE 0xC4FD0 Kw_Ws16 7.999878 Fact -4.000000 3.999878 FORMAT "%8.6" /end CHARACTERISTIC
/begin CHARACTERISTIC AirCtl_facNQParAdDKd_MAP "Parameter adaption of D governor based on engine speed and injection quantity" MAP 0xC6D46 Kf_Xs16_Ys16_Ws16 5.000000 Fact1 0.00 5.000000 FORMAT "%8.6" EXTENDED_LIMITS -256.0000 255.9922
 /begin AXIS_DESCR STD_AXIS Eng_nAvrg EngN 8 0.00 6000.000 FORMAT "%8.3" EXTENDED_LIMITS -32768.00 32767.00 DEPOSIT ABSOLUTE /end AXIS_DESCR
 /begin AXIS_DESCR STD_AXIS InjCtl_qCurrCor InjMassCyc 8 0.00 327.6700 FORMAT "%8.4" EXTENDED_LIMITS -327.6800 327.6700 DEPOSIT ABSOLUTE /end AXIS_DESCR
/end CHARACTERISTIC
/begin CHARACTERISTIC AirCtl_facNQParAdIKi_MAP "Parameter adaption  of I governor based on engine speed and injection quantity" MAP 0xC6DEA Kf_Xs16_Ys16_Ws16 5.000000 Fact1 0.00 5.000000 FORMAT "%8.6" EXTENDED_LIMITS -256.0000 255.9922
 /begin AXIS_DESCR STD_AXIS Eng_nAvrg EngN 8 0.00 6000.000 FORMAT "%8.3" EXTENDED_LIMITS -32768.00 32767.00 DEPOSIT ABSOLUTE /end AXIS_DESCR
 /begin AXIS_DESCR STD_AXIS InjCtl_qCurrCor InjMassCyc 8 0.00 327.6700 FORMAT "%8.4" EXTENDED_LIMITS -327.6800 327.6700 DEPOSIT ABSOLUTE /end AXIS_DESCR
/end CHARACTERISTIC
/begin CHARACTERISTIC AirCtl_facNQParAdPKp_MAP "Parameter adaption of P governor based on engine speed and injection quantity" MAP 0xC6E8E Kf_Xs16_Ys16_Ws16 5.000000 Fact1 0.00 5.000000 FORMAT "%8.6" EXTENDED_LIMITS -256.0000 255.9922
 /begin AXIS_DESCR STD_AXIS Eng_nAvrg EngN 8 0.00 6000.000 FORMAT "%8.3" EXTENDED_LIMITS -32768.00 32767.00 DEPOSIT ABSOLUTE /end AXIS_DESCR
 /begin AXIS_DESCR STD_AXIS InjCtl_qCurrCor InjMassCyc 8 0.00 327.6700 FORMAT "%8.4" EXTENDED_LIMITS -327.6800 327.6700 DEPOSIT ABSOLUTE /end AXIS_DESCR
/end CHARACTERISTIC
/begin CHARACTERISTIC AirCtl_facNQParRgnAdDKd_MAP "Auf Parameteranpassung des d-Reglers, im Regenerationsmodus, basiert Motordrehzahl und Einspritzungquantität" MAP 0xC6F32 Kf_Xs16_Ys16_Ws16 5.000000 Fact1 0.00 5.000000 FORMAT "%8.6" EXTENDED_LIMITS -256.0000 255.9922
 /begin AXIS_DESCR STD_AXIS Eng_nAvrg EngN 8 0.00 8000.000 FORMAT "%8.3" EXTENDED_LIMITS -32768.00 32767.00 DEPOSIT ABSOLUTE /end AXIS_DESCR
 /begin AXIS_DESCR STD_AXIS InjCtl_qCurrCor InjMassCyc 8 0.00 100.0000 FORMAT "%8.4" EXTENDED_LIMITS -327.6800 327.6700 DEPOSIT ABSOLUTE /end AXIS_DESCR
/end CHARACTERISTIC
/begin CHARACTERISTIC AirCtl_facNQParRgnAdIKi_MAP "Kennfeld für Parameteradaption in Abhängigkeit von Drehzahl und Einspritzmoment, im Regenerationsmodus" MAP 0xC6FD6 Kf_Xs16_Ys16_Ws16 5.000000 Fact1 0.00 5.000000 FORMAT "%8.6" EXTENDED_LIMITS -256.0000 255.9922
 /begin AXIS_DESCR STD_AXIS Eng_nAvrg EngN 8 0.00 8000.000 FORMAT "%8.3" EXTENDED_LIMITS -32768.00 32767.00 DEPOSIT ABSOLUTE /end AXIS_DESCR
 /begin AXIS_DESCR STD_AXIS InjCtl_qCurrCor InjMassCyc 8 0.00 100.0000 FORMAT "%8.4" EXTENDED_LIMITS -327.6800 327.6700 DEPOSIT ABSOLUTE /end AXIS_DESCR
/end CHARACTERISTIC
/begin CHARACTERISTIC AirCtl_facNQParRgnAdPKp_MAP "Kennfeld für Parameteradaption in Abhängigkeit von Drehzahl und Einspritzmenge, im Regenerationsmodus" MAP 0xC707A Kf_Xs16_Ys16_Ws16 5.000000 Fact1 0.00 5.000000 FORMAT "%8.6" EXTENDED_LIMITS -256.0000 255.9922
 /begin AXIS_DESCR STD_AXIS Eng_nAvrg EngN 8 0.00 8000.000 FORMAT "%8.3" EXTENDED_LIMITS -32768.00 32767.00 DEPOSIT ABSOLUTE /end AXIS_DESCR
 /begin AXIS_DESCR STD_AXIS InjCtl_qCurrCor InjMassCyc 8 0.00 100.0000 FORMAT "%8.4" EXTENDED_LIMITS -327.6800 327.6700 DEPOSIT ABSOLUTE /end AXIS_DESCR
/end CHARACTERISTIC
/begin CHARACTERISTIC AirCtl_facNQParRgn_MAP "Kennfeld für Paramteradaption im Regenerationsmodus" MAP 0xC78B6 Kf_Xs16_Ys16_Ws16 20.00000 Fact1 0.00 20.00000 FORMAT "%8.5" EXTENDED_LIMITS -256.0000 255.9922
 /begin AXIS_DESCR STD_AXIS Eng_nAvrg EngN 16 0.00 6000.000 FORMAT "%8.3" EXTENDED_LIMITS -32768.00 32767.00 DEPOSIT ABSOLUTE /end AXIS_DESCR
 /begin AXIS_DESCR STD_AXIS InjCtl_qCurr InjMassCyc 16 0.00 100.0000 FORMAT "%8.4" EXTENDED_LIMITS -327.6800 327.6700 DEPOSIT ABSOLUTE /end AXIS_DESCR
/end CHARACTERISTIC
/begin CHARACTERISTIC AirCtl_facPresDiffCor_CUR "Kennlinie für Parameteradaption in Abhängigkeit vom Differenzdruck im Partikelfilter" CURVE 0xC7AFA Kl_Xs16_Ws16 3.000000 Fact1 0.00 3.000000 FORMAT "%8.6" EXTENDED_LIMITS -256.0000 255.9922
 /begin AXIS_DESCR STD_AXIS PFlt_pDiff Pres_hPa 8 0.00 3500.000 FORMAT "%8.3" EXTENDED_LIMITS -32768.00 32767.00 DEPOSIT ABSOLUTE /end AXIS_DESCR
/end CHARACTERISTIC
/begin CHARACTERISTIC AirCtl_facRmpEGRCls_C "Rampensteigung beim Schließen des ARF-Ventils im Übergang von Regenerations- nach Normalbetrieb" VALUE 0xC7B1C Kw_Ws16 4998.932 PrcEGRRmp 1.068115 5000.000 FORMAT "%8.3" EXTENDED_LIMITS -5000.000 4999.847 /end CHARACTERISTIC
/begin CHARACTERISTIC AirCtl_facRmpEGROpn_C "Rampensteigung beim Öffnen des ARF-Ventils im Übergang von Regenerations- zum Normalbetrieb" VALUE 0xC7B1E Kw_Ws16 4998.932 PrcEGRRmp -5000.000 -1.068115 FORMAT "%8.3" EXTENDED_LIMITS -5000.000 4999.847 /end CHARACTERISTIC
/begin CHARACTERISTIC AirCtl_facTVACtlATCor_CUR "Ansauglufttemperatur-Korrekturfaktor des Tastverhältnisses für TVA" CURVE 0xC7B20 Kl_Xs16_Ws16 5.000000 Fact1 0.00 5.000000 FORMAT "%8.6" EXTENDED_LIMITS -256.0000 255.9922
 /begin AXIS_DESCR STD_AXIS IATSCD_tAir Temp_Cels 6 -50.14000 199.86000 FORMAT "%8.5" EXTENDED_LIMITS -3549.940 3003.560 DEPOSIT ABSOLUTE /end AXIS_DESCR
/end CHARACTERISTIC
/begin CHARACTERISTIC AirCtl_facTVACtlCTCor_CUR "Kühlmitteltemperatur-Korrekturfaktor des Tastverhältnisses für TVA" CURVE 0xC7B3A Kl_Xs16_Ws16 5.000000 Fact1 0.00 5.000000 FORMAT "%8.6" EXTENDED_LIMITS -256.0000 255.9922
 /begin AXIS_DESCR STD_AXIS CTSCD_tClnt Temp_Cels 6 -50.14000 199.86000 FORMAT "%8.5" EXTENDED_LIMITS -3549.940 3003.560 DEPOSIT ABSOLUTE /end AXIS_DESCR
/end CHARACTERISTIC
/begin CHARACTERISTIC AirCtl_IKi2_C "Grundwert 2 der I-Verstärkung des PI-Reglers bei Kleinsignalen" VALUE 0xC7120 Kw_Wu32 5.00000396642 Ki_Ampc2Prc 0.00 5.00000396642 FORMAT "%13.11" EXTENDED_LIMITS 0.00 122070.312472 /end CHARACTERISTIC
/begin CHARACTERISTIC AirCtl_IKiPos2_C "Grundwert 2 der I-Verstärkung des PI-Reglers bei positiven Großsignalen" VALUE 0xC7124 Kw_Wu32 5.00000396642 Ki_Ampc2Prc 0.00 5.00000396642 FORMAT "%13.11" EXTENDED_LIMITS 0.00 122070.312472 /end CHARACTERISTIC
/begin CHARACTERISTIC AirCtl_IKiNeg2_C "Grundwert 2 der I-Verstärkung des PI-Reglers bei negativen Großsignalen" VALUE 0xC7128 Kw_Wu32 5.00000396642 Ki_Ampc2Prc 0.00 5.00000396642 FORMAT "%13.11" EXTENDED_LIMITS 0.00 122070.312472 /end CHARACTERISTIC
/begin CHARACTERISTIC AirCtl_mIWinPos2_C "obere Kleinsignalgrenze für den I-Kanal des PI-Reglers 2" VALUE 0xC712C Kw_Ws16 1500.000 AirMassPerCyl 0.00 1500.000 FORMAT "%8.3" EXTENDED_LIMITS -3276.800 3276.700 /end CHARACTERISTIC
/begin CHARACTERISTIC AirCtl_mIWinNeg2_C "untere Kleinsignalgrenze für den I-Kanal des PI-Reglers 2" VALUE 0xC712E Kw_Ws16 1500.000 AirMassPerCyl -1500.000 0.00 FORMAT "%8.3" EXTENDED_LIMITS -3276.800 3276.700 /end CHARACTERISTIC
/begin CHARACTERISTIC AirCtl_IKiRgn2_C "I2-governor gain, deviation is within small signal bounds" VALUE 0xC7130 Kw_Wu32 5.00000396642 Ki_Ampc2Prc 0.00 5.00000396642 FORMAT "%13.11" EXTENDED_LIMITS 0.00 122070.312472 /end CHARACTERISTIC
/begin CHARACTERISTIC AirCtl_IKiPosRgn2_C "I2-governor gain, deviation is greater than small signal bound" VALUE 0xC7134 Kw_Wu32 5.00000396642 Ki_Ampc2Prc 0.00 5.00000396642 FORMAT "%13.11" EXTENDED_LIMITS 0.00 122070.312472 /end CHARACTERISTIC
/begin CHARACTERISTIC AirCtl_IKiNegRgn2_C "I2-governor gain, deviation is less than small signal bound" VALUE 0xC7138 Kw_Wu32 5.00000396642 Ki_Ampc2Prc 0.00 5.00000396642 FORMAT "%13.11" EXTENDED_LIMITS 0.00 122070.312472 /end CHARACTERISTIC
/begin CHARACTERISTIC AirCtl_mIWinPosRgn2_C "I2-governor positive window border" VALUE 0xC713C Kw_Ws16 1500.000 AirMassPerCyl 0.00 1500.000 FORMAT "%8.3" EXTENDED_LIMITS -3276.800 3276.700 /end CHARACTERISTIC
/begin CHARACTERISTIC AirCtl_mIWinNegRgn2_C "I2-governor negative window border" VALUE 0xC713E Kw_Ws16 1500.000 AirMassPerCyl -1500.000 0.00 FORMAT "%8.3" EXTENDED_LIMITS -3276.800 3276.700 /end CHARACTERISTIC
/begin CHARACTERISTIC AirCtl_IKi_C "Grundwert der I-Verstärkung des PI-Reglers bei Kleinsignalen" VALUE 0xC7140 Kw_Wu32 5.00000396642 Ki_Ampc2Prc 0.00 5.00000396642 FORMAT "%13.11" EXTENDED_LIMITS 0.00 122070.312472 /end CHARACTERISTIC
/begin CHARACTERISTIC AirCtl_IKiPos_C "Grundwert der I-Verstärkung des PI-Reglers bei positiven Großsignalen" VALUE 0xC7144 Kw_Wu32 5.00000396642 Ki_Ampc2Prc 0.00 5.00000396642 FORMAT "%13.11" EXTENDED_LIMITS 0.00 122070.312472 /end CHARACTERISTIC
/begin CHARACTERISTIC AirCtl_IKiNeg_C "Grundwert der I-Verstärkung des PI-Reglers bei negativen Großsignalen" VALUE 0xC7148 Kw_Wu32 5.00000396642 Ki_Ampc2Prc 0.00 5.00000396642 FORMAT "%13.11" EXTENDED_LIMITS 0.00 122070.312472 /end CHARACTERISTIC
/begin CHARACTERISTIC AirCtl_mIWinPos_C "obere Kleinsignalgrenze für den I-Kanal des PI-Reglers" VALUE 0xC714C Kw_Ws16 1500.000 AirMassPerCyl 0.00 1500.000 FORMAT "%8.3" EXTENDED_LIMITS -3276.800 3276.700 /end CHARACTERISTIC
/begin CHARACTERISTIC AirCtl_mIWinNeg_C "untere Kleinsignalgrenze für den I-Kanal des PI-Reglers" VALUE 0xC714E Kw_Ws16 1500.000 AirMassPerCyl -1500.000 0.00 FORMAT "%8.3" EXTENDED_LIMITS -3276.800 3276.700 /end CHARACTERISTIC
/begin CHARACTERISTIC AirCtl_IKiRgn_C "Basic value of the PI-controller I-gain for small signals in regeneration operation" VALUE 0xC7B54 Kw_Wu32 5.00000396642 Ki_Ampc2Prc 0.00 5.00000396642 FORMAT "%13.11" EXTENDED_LIMITS 0.00 122070.312472 /end CHARACTERISTIC
/begin CHARACTERISTIC AirCtl_IKiPosRgn_C "Basic value of the PI-controller I-gain for positive large signals in regeneration operation" VALUE 0xC7B58 Kw_Wu32 5.00000396642 Ki_Ampc2Prc 0.00 5.00000396642 FORMAT "%13.11" EXTENDED_LIMITS 0.00 122070.312472 /end CHARACTERISTIC
/begin CHARACTERISTIC AirCtl_IKiNegRgn_C "Basic value of the PI-controller I-gain for negative large signals in regeneration operation" VALUE 0xC7B5C Kw_Wu32 5.00000396642 Ki_Ampc2Prc 0.00 5.00000396642 FORMAT "%13.11" EXTENDED_LIMITS 0.00 122070.312472 /end CHARACTERISTIC
/begin CHARACTERISTIC AirCtl_mIWinPosRgn_C "Upper small-signal limit for the PI-controller I-channel in regeneration operation" VALUE 0xC7B60 Kw_Ws16 1500.000 AirMassPerCyl 0.00 1500.000 FORMAT "%8.3" EXTENDED_LIMITS -3276.800 3276.700 /end CHARACTERISTIC
/begin CHARACTERISTIC AirCtl_mIWinNegRgn_C "Lower small-signal limit for the PI-controller I-channel in regeneration operation" VALUE 0xC7B62 Kw_Ws16 1500.000 AirMassPerCyl -1500.000 0.00 FORMAT "%8.3" EXTENDED_LIMITS -3276.800 3276.700 /end CHARACTERISTIC
/begin CHARACTERISTIC AirCtl_mAirDynCor1_MAP "Basiswert der dynamische Soll- LuftmassenKorrectur" MAP 0xC4FD2 Kf_Xs16_Ys16_Ws16 3000.000 AirMassPerCyl -1500.000 1500.000 FORMAT "%8.3" EXTENDED_LIMITS -3276.800 3276.700
 /begin AXIS_DESCR STD_AXIS Eng_nAvrg EngN 12 0.00 8000.000 FORMAT "%8.3" EXTENDED_LIMITS -32768.00 32767.00 DEPOSIT ABSOLUTE /end AXIS_DESCR
 /begin AXIS_DESCR STD_AXIS InjCtl_qSetUnBal InjMassCyc 8 0.00 327.6700 FORMAT "%8.4" EXTENDED_LIMITS -327.6800 327.6700 DEPOSIT ABSOLUTE /end AXIS_DESCR
/end CHARACTERISTIC
/begin CHARACTERISTIC AirCtl_MaxTrmVal_C "maximaler ARF-Abgleichwert" VALUE 0xC50BE Kw_Ws16 3000.000 AirMassPerCyl -1500.000 1500.000 FORMAT "%8.3" EXTENDED_LIMITS -3276.800 3276.700 /end CHARACTERISTIC
/begin CHARACTERISTIC AirCtl_mDesBasDef_MAP "Kennfeld zur fehler Ermittlung des stationären Basissollwerts" MAP 0xC50C0 Kf_Xs16_Ys16_Ws16 3000.000 AirMassPerCyl -1500.000 1500.000 FORMAT "%8.3" EXTENDED_LIMITS -3276.800 3276.700
 /begin AXIS_DESCR STD_AXIS Eng_nAvrg EngN 16 0.00 8000.000 FORMAT "%8.3" EXTENDED_LIMITS -32768.00 32767.00 DEPOSIT ABSOLUTE /end AXIS_DESCR
 /begin AXIS_DESCR STD_AXIS InjCtl_qRawCor InjMassCyc 16 0.00 100.0000 FORMAT "%8.4" EXTENDED_LIMITS -327.6800 327.6700 DEPOSIT ABSOLUTE /end AXIS_DESCR
/end CHARACTERISTIC
/begin CHARACTERISTIC AirCtl_mDesBasFDC_MAP " Base value of desired air mass for sport mode" MAP 0xC5304 Kf_Xs16_Ys16_Ws16 3000.000 AirMassPerCyl -1500.000 1500.000 FORMAT "%8.3" EXTENDED_LIMITS -3276.800 3276.700
 /begin AXIS_DESCR STD_AXIS Eng_nAvrg EngN 16 0.00 8000.000 FORMAT "%8.3" EXTENDED_LIMITS -32768.00 32767.00 DEPOSIT ABSOLUTE /end AXIS_DESCR
 /begin AXIS_DESCR STD_AXIS InjCtl_qRaw InjMassCyc 16 0.00 100.0000 FORMAT "%8.4" EXTENDED_LIMITS -327.6800 327.6700 DEPOSIT ABSOLUTE /end AXIS_DESCR
/end CHARACTERISTIC
/begin CHARACTERISTIC AirCtl_mDesBas_MAP "Kennfeld zur Ermittlung des stationären Basissollwerts für ARF ohne VE" MAP 0xC5548 Kf_Xs16_Ys16_Ws16 3000.000 AirMassPerCyl -1500.000 1500.000 FORMAT "%8.3" EXTENDED_LIMITS -3276.800 3276.700
 /begin AXIS_DESCR STD_AXIS Eng_nAvrg EngN 16 0.00 8000.000 FORMAT "%8.3" EXTENDED_LIMITS -32768.00 32767.00 DEPOSIT ABSOLUTE /end AXIS_DESCR
 /begin AXIS_DESCR STD_AXIS InjCtl_qRawCor InjMassCyc 16 0.00 100.0000 FORMAT "%8.4" EXTENDED_LIMITS -327.6800 327.6700 DEPOSIT ABSOLUTE /end AXIS_DESCR
/end CHARACTERISTIC
/begin CHARACTERISTIC AirCtl_mDesConv_C "Kupplung Korrekturwert" VALUE 0xC578C Kw_Ws16 1500.000 AirMassPerCyl 0.00 1500.000 FORMAT "%8.3" EXTENDED_LIMITS -3276.800 3276.700 /end CHARACTERISTIC
/begin CHARACTERISTIC AirCtl_mDesCorBypass_Vector "Konfigurationslabel für Bypass Freischnitt" VALUE 0xC38C6 Kw_Wu8 255.0 OneToOne 0.00 255.0 FORMAT "%5.1" /end CHARACTERISTIC
/begin CHARACTERISTIC AirCtl_mDesCorBypass_Channel "Konfigurationslabel für Bypass Freischnitt" VALUE 0xC38C7 Kw_Wu8 255.0 OneToOne 0.00 255.0 FORMAT "%5.1" /end CHARACTERISTIC
/begin CHARACTERISTIC AirCtl_mDesGearCorr_MAP "Kennfeld für Korrektur über Lenkwinkel zu AGR-Sollwert Ueber Gang" MAP 0xC578E Kf_Xs16_Ys16_Ws16 3000.000 AirMassPerCyl -1500.000 1500.000 FORMAT "%8.3" EXTENDED_LIMITS -3276.800 3276.700
 /begin AXIS_DESCR STD_AXIS FrmMng_phiStrg AngleGrad 4 -180.0192 180.0192 FORMAT "%8.4" EXTENDED_LIMITS -1440.154 1440.110 DEPOSIT ABSOLUTE /end AXIS_DESCR
 /begin AXIS_DESCR STD_AXIS FrmMng_dphiStrg AngleGradPerSec 4 -1439.934 1439.934 FORMAT "%8.3" EXTENDED_LIMITS -1440.154 1440.110 DEPOSIT ABSOLUTE /end AXIS_DESCR
/end CHARACTERISTIC
/begin CHARACTERISTIC AirCtl_mDesGear_MAP "Sollwert für additiver AGR-Sollwert aus Gang" MAP 0xC57C2 Kf_Xs16_Ys16_Ws16 3000.000 AirMassPerCyl -1500.000 1500.000 FORMAT "%8.3" EXTENDED_LIMITS -3276.800 3276.700
 /begin AXIS_DESCR STD_AXIS Eng_nAvrg EngN 4 0.00 6000.000 FORMAT "%8.3" EXTENDED_LIMITS -32768.00 32767.00 DEPOSIT ABSOLUTE /end AXIS_DESCR
 /begin AXIS_DESCR STD_AXIS InjCtl_qRawCor InjMassCyc 4 0.00 100.0000 FORMAT "%8.4" EXTENDED_LIMITS -327.6800 327.6700 DEPOSIT ABSOLUTE /end AXIS_DESCR
/end CHARACTERISTIC
/begin CHARACTERISTIC AirCtl_mDesLim_MAP "Kennfeld für die Begrenzung von AirCtl_mDesStat_mp" MAP 0xC57F6 Kf_Xs16_Ys16_Ws16 3000.000 AirMassPerCyl -1500.000 1500.000 FORMAT "%8.3" EXTENDED_LIMITS -3276.800 3276.700
 /begin AXIS_DESCR STD_AXIS Eng_nAvrg EngN 16 0.00 6000.000 FORMAT "%8.3" EXTENDED_LIMITS -32768.00 32767.00 DEPOSIT ABSOLUTE /end AXIS_DESCR
 /begin AXIS_DESCR STD_AXIS AirCtl_qDesLim_mp InjMassCyc 16 0.00 100.0000 FORMAT "%8.4" EXTENDED_LIMITS -327.6800 327.6700 DEPOSIT ABSOLUTE /end AXIS_DESCR
/end CHARACTERISTIC
/begin CHARACTERISTIC AirCtl_mDesMax_C "Maximaler Luftmassensollwert" VALUE 0xC5A3A Kw_Ws16 10000.00 AirMassPerCyl -5000.000 5000.000 FORMAT "%8.3" EXTENDED_LIMITS -3276.800 3276.700 /end CHARACTERISTIC
/begin CHARACTERISTIC AirCtl_mDesMin_C "Minimaler Luftmassensollwert" VALUE 0xC5A3C Kw_Ws16 10000.00 AirMassPerCyl -5000.000 5000.000 FORMAT "%8.3" EXTENDED_LIMITS -3276.800 3276.700 /end CHARACTERISTIC
/begin CHARACTERISTIC AirCtl_mDesRgn1_MAP "Erstes Regenerationskennfeld fuer den stationaeren Basissollwert" MAP 0xC5A3E Kf_Xs16_Ys16_Ws16 3000.000 AirMassPerCyl -1500.000 1500.000 FORMAT "%8.3" EXTENDED_LIMITS -3276.800 3276.700
 /begin AXIS_DESCR STD_AXIS Eng_nAvrg EngN 16 0.00 8000.000 FORMAT "%8.3" EXTENDED_LIMITS -32768.00 32767.00 DEPOSIT ABSOLUTE /end AXIS_DESCR
 /begin AXIS_DESCR STD_AXIS InjCtl_qRawCor InjMassCyc 16 0.00 100.0000 FORMAT "%8.4" EXTENDED_LIMITS -327.6800 327.6700 DEPOSIT ABSOLUTE /end AXIS_DESCR
/end CHARACTERISTIC
/begin CHARACTERISTIC AirCtl_mDesRgn2_MAP "Zweites Regeneratiomnskennfeld fuer den sationaeren Basissollwert" MAP 0xC5C82 Kf_Xs16_Ys16_Ws16 3000.000 AirMassPerCyl -1500.000 1500.000 FORMAT "%8.3" EXTENDED_LIMITS -3276.800 3276.700
 /begin AXIS_DESCR STD_AXIS Eng_nAvrg EngN 16 0.00 8000.000 FORMAT "%8.3" EXTENDED_LIMITS -32768.00 32767.00 DEPOSIT ABSOLUTE /end AXIS_DESCR
 /begin AXIS_DESCR STD_AXIS InjCtl_qRawCor InjMassCyc 16 0.00 100.0000 FORMAT "%8.4" EXTENDED_LIMITS -327.6800 327.6700 DEPOSIT ABSOLUTE /end AXIS_DESCR
/end CHARACTERISTIC
/begin CHARACTERISTIC AirCtl_mDesRgn3_MAP "Map for determining airmass setpoint during regeneration" MAP 0xC5EC6 Kf_Xs16_Ys16_Ws16 3000.000 AirMassPerCyl -1500.000 1500.000 FORMAT "%8.3" EXTENDED_LIMITS -3276.800 3276.700
 /begin AXIS_DESCR STD_AXIS Eng_nAvrg EngN 16 0.00 8000.000 FORMAT "%8.3" EXTENDED_LIMITS -32768.00 32767.00 DEPOSIT ABSOLUTE /end AXIS_DESCR
 /begin AXIS_DESCR STD_AXIS InjCtl_qRawCor InjMassCyc 16 0.00 100.0000 FORMAT "%8.4" EXTENDED_LIMITS -327.6800 327.6700 DEPOSIT ABSOLUTE /end AXIS_DESCR
/end CHARACTERISTIC
/begin CHARACTERISTIC AirCtl_mDesRmp_CUR "Kurve für das Ramping statische Luftmasse" CURVE 0xC610A Kl_Xs16_Ws16 10000.00 AirMassPerCyl -5000.000 5000.000 FORMAT "%8.3" EXTENDED_LIMITS -3276.800 3276.700
 /begin AXIS_DESCR STD_AXIS AirCtl_mDesRmpRaw_mp AirMassPerCyl 8 -5000.000 5000.000 FORMAT "%8.3" EXTENDED_LIMITS -3276.800 3276.700 DEPOSIT ABSOLUTE /end AXIS_DESCR
/end CHARACTERISTIC
/begin CHARACTERISTIC AirCtl_mDesValAdd_Vector "Bypass-Label für additiven Bypass von AirCtl_mDesVal (Nicht verstellen!)" VALUE 0xC38C8 Kw_Wu8 255.0 OneToOne 0.00 255.0 FORMAT "%5.1" /end CHARACTERISTIC
/begin CHARACTERISTIC AirCtl_mDesValAdd_Channel "Bypass-Label für additiven Bypass von AirCtl_mDesVal (Nicht verstellen!)" VALUE 0xC38C9 Kw_Wu8 255.0 OneToOne 0.00 255.0 FORMAT "%5.1" /end CHARACTERISTIC
/begin CHARACTERISTIC AirCtl_mDesVal_Vector "Bypass-Label für AirCtl_mDesVal (Nicht verstellen!)" VALUE 0xC38CA Kw_Wu8 255.0 OneToOne 0.00 255.0 FORMAT "%5.1" /end CHARACTERISTIC
/begin CHARACTERISTIC AirCtl_mDesVal_Channel "Bypass-Label für AirCtl_mDesVal (Nicht verstellen!)" VALUE 0xC38CB Kw_Wu8 255.0 OneToOne 0.00 255.0 FORMAT "%5.1" /end CHARACTERISTIC
/begin CHARACTERISTIC AirCtl_mDiff_C "Air mass threshold" VALUE 0xC8286 Kw_Ws16 100.0000 AirMassPerCyl 0.00 100.0000 FORMAT "%8.4" EXTENDED_LIMITS -3276.800 3276.700 /end CHARACTERISTIC
/begin CHARACTERISTIC AirCtl_mGvnrDvtLim_C "Maximale Schwelle für Reglerabweichung" VALUE 0xC7150 Kw_Ws16 3000.000 AirMassPerCyl -1500.000 1500.000 FORMAT "%8.3" EXTENDED_LIMITS -3276.800 3276.700 /end CHARACTERISTIC
/begin CHARACTERISTIC AirCtl_MinTrmVal_C "minimaler ARF-Abgleichwert" VALUE 0xC612C Kw_Ws16 3000.000 AirMassPerCyl -1500.000 1500.000 FORMAT "%8.3" EXTENDED_LIMITS -3276.800 3276.700 /end CHARACTERISTIC
/begin CHARACTERISTIC AirCtl_mLiCor_C "Menge für Drehzahlkorrektur" VALUE 0xC612E Kw_Ws16 6000.000 AirMassPerCyl 0.00 6000.000 FORMAT "%8.3" EXTENDED_LIMITS -3276.800 3276.700 /end CHARACTERISTIC
/begin CHARACTERISTIC AirCtl_mMaxDesVal_C "maximaler Luftmassensollwert" VALUE 0xC6130 Kw_Ws16 1500.000 AirMassPerCyl 0.00 1500.000 FORMAT "%8.3" EXTENDED_LIMITS -3276.800 3276.700 /end CHARACTERISTIC
/begin CHARACTERISTIC AirCtl_mMaxDvt_MAP "Kennfeld der oberen Grenzen für Erkennung bleibender Regelabweichung" MAP 0xC8288 Kf_Xs16_Ys16_Ws16 200.0000 AirMassPerCyl 0.00 200.0000 FORMAT "%8.4" EXTENDED_LIMITS -3276.800 3276.700
 /begin AXIS_DESCR STD_AXIS Eng_nAvrg EngN 16 0.00 6000.000 FORMAT "%8.3" EXTENDED_LIMITS -32768.00 32767.00 DEPOSIT ABSOLUTE /end AXIS_DESCR
 /begin AXIS_DESCR STD_AXIS InjCtl_qCurrCor InjMassCyc 16 0.00 100.0000 FORMAT "%8.4" EXTENDED_LIMITS -327.6800 327.6700 DEPOSIT ABSOLUTE /end AXIS_DESCR
/end CHARACTERISTIC
/begin CHARACTERISTIC AirCtl_mMinDesVal_C "minimaler Luftmassensollwert" VALUE 0xC6132 Kw_Ws16 1500.000 AirMassPerCyl 0.00 1500.000 FORMAT "%8.3" EXTENDED_LIMITS -3276.800 3276.700 /end CHARACTERISTIC
/begin CHARACTERISTIC AirCtl_mMinDvt_MAP "Kennfeld der unteren Grenzen für Erkennung bleibender Regelabweichung" MAP 0xC84CC Kf_Xs16_Ys16_Ws16 200.0000 AirMassPerCyl -200.0000 0.00 FORMAT "%8.4" EXTENDED_LIMITS -3276.800 3276.700
 /begin AXIS_DESCR STD_AXIS Eng_nAvrg EngN 16 0.00 6000.000 FORMAT "%8.3" EXTENDED_LIMITS -32768.00 32767.00 DEPOSIT ABSOLUTE /end AXIS_DESCR
 /begin AXIS_DESCR STD_AXIS InjCtl_qCurrCor InjMassCyc 16 0.00 100.0000 FORMAT "%8.4" EXTENDED_LIMITS -327.6800 327.6700 DEPOSIT ABSOLUTE /end AXIS_DESCR
/end CHARACTERISTIC
/begin CHARACTERISTIC AirCtl_mNQCTSCor1_MAP "Kennfeld für drehzahl- und mengenabhängige Kühlmitteltemperaturkorrektur" MAP 0xC6134 Kf_Xs16_Ys16_Ws16 3000.000 AirMassPerCyl -1500.000 1500.000 FORMAT "%8.3" EXTENDED_LIMITS -3276.800 3276.700
 /begin AXIS_DESCR STD_AXIS Eng_nAvrg EngN 16 0.00 8000.000 FORMAT "%8.3" EXTENDED_LIMITS -32768.00 32767.00 DEPOSIT ABSOLUTE /end AXIS_DESCR
 /begin AXIS_DESCR STD_AXIS InjCtl_qRawCor InjMassCyc 16 0.00 200.0000 FORMAT "%8.4" EXTENDED_LIMITS -327.6800 327.6700 DEPOSIT ABSOLUTE /end AXIS_DESCR
/end CHARACTERISTIC
/begin CHARACTERISTIC AirCtl_mNQCTSCor2_MAP "Kennfeld für drehzahl- und mengenabhängige Kühlmitteltemperaturkorrektur" MAP 0xC6378 Kf_Xs16_Ys16_Ws16 3000.000 AirMassPerCyl -1500.000 1500.000 FORMAT "%8.3" EXTENDED_LIMITS -3276.800 3276.700
 /begin AXIS_DESCR STD_AXIS Eng_nAvrg EngN 12 0.00 8000.000 FORMAT "%8.3" EXTENDED_LIMITS -32768.00 32767.00 DEPOSIT ABSOLUTE /end AXIS_DESCR
 /begin AXIS_DESCR STD_AXIS InjCtl_qRawCor InjMassCyc 16 0.00 200.0000 FORMAT "%8.4" EXTENDED_LIMITS -327.6800 327.6700 DEPOSIT ABSOLUTE /end AXIS_DESCR
/end CHARACTERISTIC
/begin CHARACTERISTIC AirCtl_mPiI2Cor_C "Correction value for airmass for PiI2 injection" VALUE 0xC6534 Kw_Ws16 3000.000 AirMassPerCyl -1500.000 1500.000 FORMAT "%8.3" EXTENDED_LIMITS -3276.800 3276.700 /end CHARACTERISTIC
/begin CHARACTERISTIC AirCtl_mskGear_C "Maske für Gangselektion additiver AGR-Sollwert" VALUE 0xC6536 Kw_Wu8 255.0 OneToOne 0.00 255.0 FORMAT "%5.1" /end CHARACTERISTIC
/begin CHARACTERISTIC AirCtl_mskGvnrMin_C "Status des EGR-Ventil Frostes im Regenerationsbetrieb" VALUE 0xC7152 Kw_Wu8 255.0 OneToOne 0.00 255.0 FORMAT "%5.1" /end CHARACTERISTIC
/begin CHARACTERISTIC AirCtl_mskStGvnrDyn1_C "Maske Regeneration dynamische  begrenzung 1" VALUE 0xC7153 Kw_Wu8 255.0 OneToOne 0.00 255.0 FORMAT "%5.1" /end CHARACTERISTIC
/begin CHARACTERISTIC AirCtl_mskStGvnrDyn2_C "Maske Regeneration dynamische Begrenzung 2" VALUE 0xC7154 Kw_Wu8 255.0 OneToOne 0.00 255.0 FORMAT "%5.1" /end CHARACTERISTIC
/begin CHARACTERISTIC AirCtl_nAvrgHHi_C "obere Hysteresegrenze für Überwachung hoher Motordrehzahl" VALUE 0xC8710 Kw_Ws16 5960.000 EngN 40.00000 6000.000 FORMAT "%8.3" EXTENDED_LIMITS -32768.00 32767.00 /end CHARACTERISTIC
/begin CHARACTERISTIC AirCtl_nAvrgHLo_C "untere Hysteresegrenze für Überwachung hoher Motordrehzahl" VALUE 0xC8712 Kw_Ws16 5960.000 EngN 40.00000 6000.000 FORMAT "%8.3" EXTENDED_LIMITS -32768.00 32767.00 /end CHARACTERISTIC
/begin CHARACTERISTIC AirCtl_nAvrgLHi_C "obere Hysteresegrenze für Überwachung niedriger Motordrehzahl" VALUE 0xC8714 Kw_Ws16 5960.000 EngN 40.00000 6000.000 FORMAT "%8.3" EXTENDED_LIMITS -32768.00 32767.00 /end CHARACTERISTIC
/begin CHARACTERISTIC AirCtl_nAvrgLLo_C "untere Hysteresegrenze für Überwachung niedriger Motordrehzahl" VALUE 0xC8716 Kw_Ws16 5960.000 EngN 40.00000 6000.000 FORMAT "%8.3" EXTENDED_LIMITS -32768.00 32767.00 /end CHARACTERISTIC
/begin CHARACTERISTIC AirCtl_nHealHi_C "obere Drehzahlgrenze des Heilungsbereichs" VALUE 0xC8718 Kw_Ws16 6000.000 EngN 0.00 6000.000 FORMAT "%8.3" EXTENDED_LIMITS -32768.00 32767.00 /end CHARACTERISTIC
/begin CHARACTERISTIC AirCtl_nHealLo_C "untere Drehzahlgrenze des Heilungsbereichs" VALUE 0xC871A Kw_Ws16 6000.000 EngN 0.00 6000.000 FORMAT "%8.3" EXTENDED_LIMITS -32768.00 32767.00 /end CHARACTERISTIC
/begin CHARACTERISTIC AirCtl_nLiEGR_C "Drehzahlschwelle für Drehzahlkorrektur" VALUE 0xC6538 Kw_Ws16 6000.000 EngN 0.00 6000.000 FORMAT "%8.3" EXTENDED_LIMITS -32768.00 32767.00 /end CHARACTERISTIC
/begin CHARACTERISTIC AirCtl_nLim_C "Eng speed threshold" VALUE 0xC871C Kw_Ws16 8000.000 EngN 0.00 8000.000 FORMAT "%8.3" EXTENDED_LIMITS -32768.00 32767.00 /end CHARACTERISTIC
/begin CHARACTERISTIC AirCtl_nLoIdl_C "Drehzahlgrenze für Leerlauferkennung" VALUE 0xC871E Kw_Ws16 6000.000 EngN 0.00 6000.000 FORMAT "%8.3" EXTENDED_LIMITS -32768.00 32767.00 /end CHARACTERISTIC
/begin CHARACTERISTIC AirCtl_nOvrRun_C "untere Drehzahlgrenze für Schubabschaltung" VALUE 0xC8720 Kw_Ws16 6000.000 EngN 0.00 6000.000 FORMAT "%8.3" EXTENDED_LIMITS -32768.00 32767.00 /end CHARACTERISTIC
/begin CHARACTERISTIC AirCtl_NQAPCorRgn_MAP "Kennfeld für drehzahl und mengenabhängige Atmosphärendruckkorrektur im Regenerationsbetrieb" MAP 0xC653A Kf_Xs16_Ys16_Ws16 3000.000 AirMassPerCyl -1500.000 1500.000 FORMAT "%8.3" EXTENDED_LIMITS -3276.800 3276.700
 /begin AXIS_DESCR STD_AXIS Eng_nAvrg EngN 16 0.00 8000.000 FORMAT "%8.3" EXTENDED_LIMITS -32768.00 32767.00 DEPOSIT ABSOLUTE /end AXIS_DESCR
 /begin AXIS_DESCR STD_AXIS InjCtl_qRawCor InjMassCyc 16 0.00 200.0000 FORMAT "%8.4" EXTENDED_LIMITS -327.6800 327.6700 DEPOSIT ABSOLUTE /end AXIS_DESCR
/end CHARACTERISTIC
/begin CHARACTERISTIC AirCtl_NQATCorRgn_MAP "Kennfeld für drehzahl und megenabhaengige Lufttemperaturkorrektur" MAP 0xC677E Kf_Xs16_Ys16_Ws16 3000.000 AirMassPerCyl -1500.000 1500.000 FORMAT "%8.3" EXTENDED_LIMITS -3276.800 3276.700
 /begin AXIS_DESCR STD_AXIS Eng_nAvrg EngN 8 0.00 8000.000 FORMAT "%8.3" EXTENDED_LIMITS -32768.00 32767.00 DEPOSIT ABSOLUTE /end AXIS_DESCR
 /begin AXIS_DESCR STD_AXIS InjCtl_qRawCor InjMassCyc 8 0.00 200.0000 FORMAT "%8.4" EXTENDED_LIMITS -327.6800 327.6700 DEPOSIT ABSOLUTE /end AXIS_DESCR
/end CHARACTERISTIC
/begin CHARACTERISTIC AirCtl_NQIATSCor_MAP "Kennfeld für drehzahl- und mengenabhängige Lufttemperaturkorrektur" MAP 0xC6822 Kf_Xs16_Ys16_Ws16 3000.000 AirMassPerCyl -1500.000 1500.000 FORMAT "%8.3" EXTENDED_LIMITS -3276.800 3276.700
 /begin AXIS_DESCR STD_AXIS Eng_nAvrg EngN 16 0.00 8000.000 FORMAT "%8.3" EXTENDED_LIMITS -32768.00 32767.00 DEPOSIT ABSOLUTE /end AXIS_DESCR
 /begin AXIS_DESCR STD_AXIS InjCtl_qRawCor InjMassCyc 16 0.00 200.0000 FORMAT "%8.4" EXTENDED_LIMITS -327.6800 327.6700 DEPOSIT ABSOLUTE /end AXIS_DESCR
/end CHARACTERISTIC
/begin CHARACTERISTIC AirCtl_numAirCtlMon_C "Index für eine Telperatur aus dem Motortemperatur-Feld" VALUE 0xC8722 Kw_Wu8 2.00000000000 EngTempFldSel 0.00 2.00000000000 FORMAT "%13.11" /end CHARACTERISTIC
/begin CHARACTERISTIC AirCtl_numGvnrAirTemp_C "Index für eine Temperatur aus dem Lufttemperatur-Feld" VALUE 0xC7155 Kw_Wu8 2.00000000000 IndSysTempFldSel 0.00 2.00000000000 FORMAT "%13.11" /end CHARACTERISTIC
/begin CHARACTERISTIC AirCtl_PKp2_C "Grundwert 2 der P-Verstärkung des PI-Reglers bei Kleinsignalen" VALUE 0xC7158 Kw_Wu32 9.99999977648 Kp_Ampc2Prc 0.00 9.99999977648 FORMAT "%13.10" EXTENDED_LIMITS 0.00 7999.99999814 /end CHARACTERISTIC
/begin CHARACTERISTIC AirCtl_PKpPos2_C "Grundwert 2 der P-Verstärkung des PI-Reglers bei positiven Großsignalen" VALUE 0xC715C Kw_Wu32 9.99999977648 Kp_Ampc2Prc 0.00 9.99999977648 FORMAT "%13.10" EXTENDED_LIMITS 0.00 7999.99999814 /end CHARACTERISTIC
/begin CHARACTERISTIC AirCtl_PKpNeg2_C "Grundwert 2 der P-Verstärkung des PI-Reglers bei negativen Großsignalen" VALUE 0xC7160 Kw_Wu32 9.99999977648 Kp_Ampc2Prc 0.00 9.99999977648 FORMAT "%13.10" EXTENDED_LIMITS 0.00 7999.99999814 /end CHARACTERISTIC
/begin CHARACTERISTIC AirCtl_mPWinPos2_C "obere Kleinsignalgrenze für den P-Kanal des PI-Reglers 2" VALUE 0xC7164 Kw_Ws16 1500.000 AirMassPerCyl 0.00 1500.000 FORMAT "%8.3" EXTENDED_LIMITS -3276.800 3276.700 /end CHARACTERISTIC
/begin CHARACTERISTIC AirCtl_mPWinNeg2_C "untere Kleinsignalgrenze für den P-Kanal des PI-Reglers 2" VALUE 0xC7166 Kw_Ws16 1500.000 AirMassPerCyl -1500.000 0.00 FORMAT "%8.3" EXTENDED_LIMITS -3276.800 3276.700 /end CHARACTERISTIC
/begin CHARACTERISTIC AirCtl_PKpRgn2_C "P2-governor gain, deviation is within small signal bounds" VALUE 0xC7168 Kw_Wu32 9.99999977648 Kp_Ampc2Prc 0.00 9.99999977648 FORMAT "%13.10" EXTENDED_LIMITS 0.00 7999.99999814 /end CHARACTERISTIC
/begin CHARACTERISTIC AirCtl_PKpPosRgn2_C "P2-governor gain, deviation is greater than small signal bound" VALUE 0xC716C Kw_Wu32 9.99999977648 Kp_Ampc2Prc 0.00 9.99999977648 FORMAT "%13.10" EXTENDED_LIMITS 0.00 7999.99999814 /end CHARACTERISTIC
/begin CHARACTERISTIC AirCtl_PKpNegRgn2_C "P2-governor gain, deviation is less than small signal bound" VALUE 0xC7170 Kw_Wu32 9.99999977648 Kp_Ampc2Prc 0.00 9.99999977648 FORMAT "%13.10" EXTENDED_LIMITS 0.00 7999.99999814 /end CHARACTERISTIC
/begin CHARACTERISTIC AirCtl_mPWinPosRgn2_C "I2-governor positive window border" VALUE 0xC7174 Kw_Ws16 1500.000 AirMassPerCyl 0.00 1500.000 FORMAT "%8.3" EXTENDED_LIMITS -3276.800 3276.700 /end CHARACTERISTIC
/begin CHARACTERISTIC AirCtl_mPWinNegRgn2_C "I2-governor negative window border" VALUE 0xC7176 Kw_Ws16 1500.000 AirMassPerCyl -1500.000 0.00 FORMAT "%8.3" EXTENDED_LIMITS -3276.800 3276.700 /end CHARACTERISTIC
/begin CHARACTERISTIC AirCtl_pAirHi_C "obere Hysteresegrenze für Atmosphärendrucküberwachung" VALUE 0xC8724 Kw_Ws16 2800.000 Pres_hPa 700.0000 3500.000 FORMAT "%8.3" EXTENDED_LIMITS -32768.00 32767.00 /end CHARACTERISTIC
/begin CHARACTERISTIC AirCtl_pAirLo_C "untere Hysteresegrenze für Atmosphärendrucküberwachung" VALUE 0xC8726 Kw_Ws16 2800.000 Pres_hPa 700.0000 3500.000 FORMAT "%8.3" EXTENDED_LIMITS -32768.00 32767.00 /end CHARACTERISTIC
/begin CHARACTERISTIC AirCtl_PKp_C "Grundwert der P-Verstärkung des PI-Reglers bei Kleinsignalen" VALUE 0xC7178 Kw_Wu32 9.99999977648 Kp_Ampc2Prc 0.00 9.99999977648 FORMAT "%13.10" EXTENDED_LIMITS 0.00 7999.99999814 /end CHARACTERISTIC
/begin CHARACTERISTIC AirCtl_PKpPos_C "Grundwert der P-Verstärkung des PI-Reglers bei positiven Großsignalen" VALUE 0xC717C Kw_Wu32 9.99999977648 Kp_Ampc2Prc 0.00 9.99999977648 FORMAT "%13.10" EXTENDED_LIMITS 0.00 7999.99999814 /end CHARACTERISTIC
/begin CHARACTERISTIC AirCtl_PKpNeg_C "Grundwert der P-Verstärkung des PI-Reglers bei negativen Großsignalen" VALUE 0xC7180 Kw_Wu32 9.99999977648 Kp_Ampc2Prc 0.00 9.99999977648 FORMAT "%13.10" EXTENDED_LIMITS 0.00 7999.99999814 /end CHARACTERISTIC
/begin CHARACTERISTIC AirCtl_mPWinPos_C "obere Kleinsignalgrenze für den P-Kanal des PI-Reglers" VALUE 0xC7184 Kw_Ws16 1500.000 AirMassPerCyl 0.00 1500.000 FORMAT "%8.3" EXTENDED_LIMITS -3276.800 3276.700 /end CHARACTERISTIC
/begin CHARACTERISTIC AirCtl_mPWinNeg_C "untere Kleinsignalgrenze für den P-Kanal des PI-Reglers" VALUE 0xC7186 Kw_Ws16 1500.000 AirMassPerCyl -1500.000 0.00 FORMAT "%8.3" EXTENDED_LIMITS -3276.800 3276.700 /end CHARACTERISTIC
/begin CHARACTERISTIC AirCtl_PKpRgn_C "Basic value of the PI-controller P-gain for small signals in regeneration operation" VALUE 0xC7B64 Kw_Wu32 9.99999977648 Kp_Ampc2Prc 0.00 9.99999977648 FORMAT "%13.10" EXTENDED_LIMITS 0.00 7999.99999814 /end CHARACTERISTIC
/begin CHARACTERISTIC AirCtl_PKpPosRgn_C "Basic value of the PI-controller P-gain for positive large signals in regeneration operation" VALUE 0xC7B68 Kw_Wu32 9.99999977648 Kp_Ampc2Prc 0.00 9.99999977648 FORMAT "%13.10" EXTENDED_LIMITS 0.00 7999.99999814 /end CHARACTERISTIC
/begin CHARACTERISTIC AirCtl_PKpNegRgn_C "Basic value of the PI-controller P-gain for negative large signals in regeneration operation" VALUE 0xC7B6C Kw_Wu32 9.99999977648 Kp_Ampc2Prc 0.00 9.99999977648 FORMAT "%13.10" EXTENDED_LIMITS 0.00 7999.99999814 /end CHARACTERISTIC
/begin CHARACTERISTIC AirCtl_mPWinPosRgn_C "Upper small-signal limit for the PI-controller P-channel in regeneration operation" VALUE 0xC7B70 Kw_Ws16 1500.000 AirMassPerCyl 0.00 1500.000 FORMAT "%8.3" EXTENDED_LIMITS -3276.800 3276.700 /end CHARACTERISTIC
/begin CHARACTERISTIC AirCtl_mPWinNegRgn_C "Lower small-signal limit for the PI-controller P-channel in regeneration operation" VALUE 0xC7B72 Kw_Ws16 1500.000 AirMassPerCyl -1500.000 0.00 FORMAT "%8.3" EXTENDED_LIMITS -3276.800 3276.700 /end CHARACTERISTIC
/begin CHARACTERISTIC AirCtl_qDiff_C "Injection mass threshold" VALUE 0xC8728 Kw_Ws16 100.0000 InjMassCyc 0.00 100.0000 FORMAT "%8.4" EXTENDED_LIMITS -327.6800 327.6700 /end CHARACTERISTIC
/begin CHARACTERISTIC AirCtl_qGear_C "Threshold value of the current injection quantity for the current gear" VALUE 0xC872A Kw_Ws16 1000.000 InjMass 0.00 1000.000 FORMAT "%8.3" EXTENDED_LIMITS -327.6800 327.6700 /end CHARACTERISTIC
/begin CHARACTERISTIC AirCtl_qHealHi_C "obere Mengengrenze des Heilungsbereichs" VALUE 0xC872C Kw_Ws16 100.0000 InjMass 0.00 100.0000 FORMAT "%8.4" EXTENDED_LIMITS -327.6800 327.6700 /end CHARACTERISTIC
/begin CHARACTERISTIC AirCtl_qHealLo_C "untere Mengengrenze des Heilungsbereichs" VALUE 0xC872E Kw_Ws16 100.0000 InjMass 0.00 100.0000 FORMAT "%8.4" EXTENDED_LIMITS -327.6800 327.6700 /end CHARACTERISTIC
/begin CHARACTERISTIC AirCtl_qHi_CUR "Kennlinie fuer obere Hysteresegrenze fuer Abschaltung bei grosser Einspritzmenge" CURVE 0xC8730 Kl_Xs16_Ws16 100.0000 InjMass 0.00 100.0000 FORMAT "%8.4" EXTENDED_LIMITS -327.6800 327.6700
 /begin AXIS_DESCR STD_AXIS Eng_nAvrg EngN 25 0.00 6000.000 FORMAT "%8.3" EXTENDED_LIMITS -32768.00 32767.00 DEPOSIT ABSOLUTE /end AXIS_DESCR
/end CHARACTERISTIC
/begin CHARACTERISTIC AirCtl_qLo_CUR "Kennlinie fuer Hysteresegrenze fuer Abschaltung bei grosser Einspritzmenge" CURVE 0xC8796 Kl_Xs16_Ws16 100.0000 InjMass 0.00 100.0000 FORMAT "%8.4" EXTENDED_LIMITS -327.6800 327.6700
 /begin AXIS_DESCR STD_AXIS Eng_nAvrg EngN 25 0.00 6000.000 FORMAT "%8.3" EXTENDED_LIMITS -32768.00 32767.00 DEPOSIT ABSOLUTE /end AXIS_DESCR
/end CHARACTERISTIC
/begin CHARACTERISTIC AirCtl_qOvrRun_C "untere Mengengrenze für Schubabschaltung" VALUE 0xC87FC Kw_Ws16 100.0000 InjMass 0.00 100.0000 FORMAT "%8.4" EXTENDED_LIMITS -327.6800 327.6700 /end CHARACTERISTIC
/begin CHARACTERISTIC AirCtl_qSurgeHigh_CUR "Obergrenze für Mengenhysterese gegen Laderpumpen" CURVE 0xC87FE Kl_Xs16_Ws16 100.0000 InjMass 0.00 100.0000 FORMAT "%8.4" EXTENDED_LIMITS -327.6800 327.6700
 /begin AXIS_DESCR STD_AXIS Eng_nAvrg EngN 5 0.00 6000.000 FORMAT "%8.3" EXTENDED_LIMITS -32768.00 32767.00 DEPOSIT ABSOLUTE /end AXIS_DESCR
/end CHARACTERISTIC
/begin CHARACTERISTIC AirCtl_qSurgeLow_CUR "Untergrenze für Mengenhysterese gegen Laderpumpen" CURVE 0xC8814 Kl_Xs16_Ws16 100.0000 InjMass 0.00 100.0000 FORMAT "%8.4" EXTENDED_LIMITS -327.6800 327.6700
 /begin AXIS_DESCR STD_AXIS Eng_nAvrg EngN 5 0.00 6000.000 FORMAT "%8.3" EXTENDED_LIMITS -32768.00 32767.00 DEPOSIT ABSOLUTE /end AXIS_DESCR
/end CHARACTERISTIC
/begin CHARACTERISTIC AirCtl_qUnBalLim_C "injection mass threshold" VALUE 0xC882A Kw_Ws16 200.0000 InjMassCyc 0.00 200.0000 FORMAT "%8.4" EXTENDED_LIMITS -327.6800 327.6700 /end CHARACTERISTIC
/begin CHARACTERISTIC AirCtl_rBelCtl_C "Hinzufügung Faktor für den Vorsteuerung Wert" VALUE 0xC7188 Kw_Ws16 100.0000 Prc 0.00 100.0000 FORMAT "%8.4" EXTENDED_LIMITS -400.0000 399.9878 /end CHARACTERISTIC
/begin CHARACTERISTIC AirCtl_rbrkDelta_C "Sprunghöhe bei Bremssignal Auswertung" VALUE 0xC882C Kw_Ws16 100.0000 Prc 0.00 100.0000 FORMAT "%8.4" EXTENDED_LIMITS -400.0000 399.9878 /end CHARACTERISTIC
/begin CHARACTERISTIC AirCtl_rBrkXHigh_C "Obere Hystereseschwelle bei Bremssignal Auswertung" VALUE 0xC882E Kw_Ws16 100.0000 Prc 0.00 100.0000 FORMAT "%8.4" EXTENDED_LIMITS -400.0000 399.9878 /end CHARACTERISTIC
/begin CHARACTERISTIC AirCtl_rBrkXLow_C "Untere Hystereseschwelle bei Bremssignal Auswertung" VALUE 0xC8830 Kw_Ws16 100.0000 Prc 0.00 100.0000 FORMAT "%8.4" EXTENDED_LIMITS -400.0000 399.9878 /end CHARACTERISTIC
/begin CHARACTERISTIC AirCtl_rCtlValRgn_MAP "Vorsteuerkennfeld Luftmassenregelung im Regenerationsbetrieb über Drosselklappe" MAP 0xC4894 Kf_Xs16_Ys16_Ws16 100.0000 Prc 0.00 100.0000 FORMAT "%8.4" EXTENDED_LIMITS -400.0000 399.9878
 /begin AXIS_DESCR STD_AXIS Eng_nAvrg EngN 16 0.00 8000.000 FORMAT "%8.3" EXTENDED_LIMITS -32768.00 32767.00 DEPOSIT ABSOLUTE /end AXIS_DESCR
 /begin AXIS_DESCR STD_AXIS InjCtl_qCurrCor InjMassCyc 16 0.00 327.6700 FORMAT "%8.4" EXTENDED_LIMITS -327.6800 327.6700 DEPOSIT ABSOLUTE /end AXIS_DESCR
/end CHARACTERISTIC
/begin CHARACTERISTIC AirCtl_rCtlVal_MAP "Kennfeld zur Steuerungswertberechnung" MAP 0xC4AD8 Kf_Xs16_Ys16_Ws16 100.0000 Prc 0.00 100.0000 FORMAT "%8.4" EXTENDED_LIMITS -400.0000 399.9878
 /begin AXIS_DESCR STD_AXIS Eng_nAvrg EngN 16 0.00 8000.000 FORMAT "%8.3" EXTENDED_LIMITS -32768.00 32767.00 DEPOSIT ABSOLUTE /end AXIS_DESCR
 /begin AXIS_DESCR STD_AXIS InjCtl_qCurrCor InjMassCyc 16 0.00 327.6700 FORMAT "%8.4" EXTENDED_LIMITS -327.6800 327.6700 DEPOSIT ABSOLUTE /end AXIS_DESCR
/end CHARACTERISTIC
/begin CHARACTERISTIC AirCtl_rDiffDynMin_CUR "Schwelle Aktivierung dynamische Begrenzung 1 - AirCtl" CURVE 0xC718A Kl_Xs16_Ws16 100.0000 Prc 0.00 100.0000 FORMAT "%8.4" EXTENDED_LIMITS -400.0000 399.9878
 /begin AXIS_DESCR STD_AXIS Eng_nAvrg EngN 6 0.00 6000.000 FORMAT "%8.3" EXTENDED_LIMITS -32768.00 32767.00 DEPOSIT ABSOLUTE /end AXIS_DESCR
/end CHARACTERISTIC
/begin CHARACTERISTIC AirCtl_rDynEnd_C "EndWert Rampe dynamische Begrenzung 2" VALUE 0xC71A4 Kw_Ws16 200.0000 Prc -100.0000 100.0000 FORMAT "%8.4" EXTENDED_LIMITS -400.0000 399.9878 /end CHARACTERISTIC
/begin CHARACTERISTIC AirCtl_rDynMinRgn_MAP "Dynamische Begrenzung 2 bei Regeneration" MAP 0xC71A6 Kf_Xs16_Ys16_Ws16 300.0000 Prc -100.0000 200.0000 FORMAT "%8.4" EXTENDED_LIMITS -400.0000 399.9878
 /begin AXIS_DESCR STD_AXIS Eng_nAvrg EngN 8 0.00 6000.000 FORMAT "%8.3" EXTENDED_LIMITS -32768.00 32767.00 DEPOSIT ABSOLUTE /end AXIS_DESCR
 /begin AXIS_DESCR STD_AXIS PCR_rSurgeLIGov Prc 6 -400.0000 399.9878 FORMAT "%8.4" DEPOSIT ABSOLUTE /end AXIS_DESCR
/end CHARACTERISTIC
/begin CHARACTERISTIC AirCtl_rDynMin_MAP "Dynamische Begrenzung 2 bei Normalbetrieb" MAP 0xC7226 Kf_Xs16_Ys16_Ws16 300.0000 Prc -100.0000 200.0000 FORMAT "%8.4" EXTENDED_LIMITS -400.0000 399.9878
 /begin AXIS_DESCR STD_AXIS Eng_nAvrg EngN 8 0.00 6000.000 FORMAT "%8.3" EXTENDED_LIMITS -32768.00 32767.00 DEPOSIT ABSOLUTE /end AXIS_DESCR
 /begin AXIS_DESCR STD_AXIS PCR_rSurgeLIGov Prc 6 -400.0000 399.9878 FORMAT "%8.4" DEPOSIT ABSOLUTE /end AXIS_DESCR
/end CHARACTERISTIC
/begin CHARACTERISTIC AirCtl_rDynStart_C "StartWert Rampe dynamische Begrenzung 2" VALUE 0xC72A6 Kw_Ws16 200.0000 Prc -100.0000 100.0000 FORMAT "%8.4" EXTENDED_LIMITS -400.0000 399.9878 /end CHARACTERISTIC
/begin CHARACTERISTIC AirCtl_rEGRBas_MAP "Kennfeld fuer Abgasrueckfuehrstellgroesse" MAP 0xC72A8 Kf_Xs16_Ys16_Ws16 300.0000 Prc -100.0000 200.0000 FORMAT "%8.4" EXTENDED_LIMITS -400.0000 399.9878
 /begin AXIS_DESCR STD_AXIS Eng_nAvrg EngN 8 0.00 6000.000 FORMAT "%8.3" EXTENDED_LIMITS -32768.00 32767.00 DEPOSIT ABSOLUTE /end AXIS_DESCR
 /begin AXIS_DESCR STD_AXIS AirCtl_rOutGvnr_mp Prc 8 -400.0000 399.9878 FORMAT "%8.4" DEPOSIT ABSOLUTE /end AXIS_DESCR
/end CHARACTERISTIC
/begin CHARACTERISTIC AirCtl_rEGRCtlAPSCor_CUR "Atmosphärendruck-Korrekturfaktor des Tastverhältnisses für EGR" CURVE 0xC734C Kl_Xs16_Ws16 400.0000 Prc 0.00 400.0000 FORMAT "%8.4" EXTENDED_LIMITS -400.0000 399.9878
 /begin AXIS_DESCR STD_AXIS APSCD_pVal Pres_hPa 6 0.00 3500.000 FORMAT "%8.3" EXTENDED_LIMITS -32768.00 32767.00 DEPOSIT ABSOLUTE /end AXIS_DESCR
/end CHARACTERISTIC
/begin CHARACTERISTIC AirCtl_rEGRCtlATCor_MAP "Ansauglufttemperatur-Korrekturwert des Tastverhältnisses für EGR" MAP 0xC7366 Kf_Xs16_Ys16_Ws16 200.0000 Prc 0.00 200.0000 FORMAT "%8.4" EXTENDED_LIMITS -400.0000 399.9878
 /begin AXIS_DESCR STD_AXIS Eng_nAvrg EngN 8 0.00 6000.000 FORMAT "%8.3" EXTENDED_LIMITS -32768.00 32767.00 DEPOSIT ABSOLUTE /end AXIS_DESCR
 /begin AXIS_DESCR STD_AXIS InjCtl_qRaw InjMassCyc 8 -327.6800 327.6700 FORMAT "%8.4" DEPOSIT ABSOLUTE /end AXIS_DESCR
/end CHARACTERISTIC
/begin CHARACTERISTIC AirCtl_rEGRCtlBas_MAP "Grundwert des Tastverhältnisses für EGR" MAP 0xC740A Kf_Xs16_Ys16_Ws16 200.0000 Prc 0.00 200.0000 FORMAT "%8.4" EXTENDED_LIMITS -400.0000 399.9878
 /begin AXIS_DESCR STD_AXIS Eng_nAvrg EngN 10 0.00 6000.000 FORMAT "%8.3" EXTENDED_LIMITS -32768.00 32767.00 DEPOSIT ABSOLUTE /end AXIS_DESCR
 /begin AXIS_DESCR STD_AXIS InjCtl_qRaw InjMassCyc 10 -327.6800 327.6700 FORMAT "%8.4" DEPOSIT ABSOLUTE /end AXIS_DESCR
/end CHARACTERISTIC
/begin CHARACTERISTIC AirCtl_rEGRCtlCTCor_MAP "Kühlmitteltemperatur-Korrekturwert des Tastverhältnisses für EGR" MAP 0xC74FE Kf_Xs16_Ys16_Ws16 200.0000 Prc 0.00 200.0000 FORMAT "%8.4" EXTENDED_LIMITS -400.0000 399.9878
 /begin AXIS_DESCR STD_AXIS Eng_nAvrg EngN 8 0.00 6000.000 FORMAT "%8.3" EXTENDED_LIMITS -32768.00 32767.00 DEPOSIT ABSOLUTE /end AXIS_DESCR
 /begin AXIS_DESCR STD_AXIS InjCtl_qRaw InjMassCyc 8 -327.6800 327.6700 FORMAT "%8.4" DEPOSIT ABSOLUTE /end AXIS_DESCR
/end CHARACTERISTIC
/begin CHARACTERISTIC AirCtl_rEGRDflVal12_C "Vorgabewert 12 für Stellgröße des ARF-Ventils" VALUE 0xC8832 Kw_Ws16 300.0000 Prc -100.0000 200.0000 FORMAT "%8.4" EXTENDED_LIMITS -400.0000 399.9878 /end CHARACTERISTIC
/begin CHARACTERISTIC AirCtl_rEGRDflVal1_C "Vorgabewert für Tastverhältnis des EGR m Fall zu niedriger Lufttemperatur" VALUE 0xC8834 Kw_Ws16 300.0000 Prc -100.0000 200.0000 FORMAT "%8.4" EXTENDED_LIMITS -400.0000 399.9878 /end CHARACTERISTIC
/begin CHARACTERISTIC AirCtl_rEGRDflVal4_C "Vorgabewert 4 für Stellgröße des ARF-Ventils" VALUE 0xC8836 Kw_Ws16 300.0000 Prc -100.0000 200.0000 FORMAT "%8.4" EXTENDED_LIMITS -400.0000 399.9878 /end CHARACTERISTIC
/begin CHARACTERISTIC AirCtl_rEGRDflVal5_C "Vorgabewert 5 für Stellgröße des ARF-Ventils" VALUE 0xC8838 Kw_Ws16 300.0000 Prc -100.0000 200.0000 FORMAT "%8.4" EXTENDED_LIMITS -400.0000 399.9878 /end CHARACTERISTIC
/begin CHARACTERISTIC AirCtl_rEGRDflVal7_C "Vorgabewert 7 fuer Stellgroesse des ARF-Ventils (Regeneration)" VALUE 0xC883A Kw_Ws16 300.0000 Prc -100.0000 200.0000 FORMAT "%8.4" EXTENDED_LIMITS -400.0000 399.9878 /end CHARACTERISTIC
/begin CHARACTERISTIC AirCtl_rEGRDflVal8_C "Vorgabewert 8 für Stellgröße des ARF-Ventils" VALUE 0xC883C Kw_Ws16 300.0000 Prc -100.0000 200.0000 FORMAT "%8.4" EXTENDED_LIMITS -400.0000 399.9878 /end CHARACTERISTIC
/begin CHARACTERISTIC AirCtl_rEGRInv_MAP "Kennfeld zum Rückrechnen von der Stellgröße des ARF-Ventils auf den Reglerausgang" MAP 0xC7B74 Kf_Xs16_Ys16_Ws16 300.0000 Prc -100.0000 200.0000 FORMAT "%8.4" EXTENDED_LIMITS -400.0000 399.9878
 /begin AXIS_DESCR STD_AXIS Eng_nAvrg EngN 8 0.00 6000.000 FORMAT "%8.3" EXTENDED_LIMITS -32768.00 32767.00 DEPOSIT ABSOLUTE /end AXIS_DESCR
 /begin AXIS_DESCR STD_AXIS AirCtl_rGvnrEGR Prc 4 -100.0000 200.0000 FORMAT "%8.4" EXTENDED_LIMITS -400.0000 399.9878 DEPOSIT ABSOLUTE /end AXIS_DESCR
/end CHARACTERISTIC
/begin CHARACTERISTIC AirCtl_rEGRRgnCorrErr_C "KORREKTURKURVE der Rückstellung EGR Regenerationsan den großen Höhen" VALUE 0xC7BD0 Kw_Ws16 100.0000 Prc 0.00 100.0000 FORMAT "%8.4" EXTENDED_LIMITS -400.0000 399.9878 /end CHARACTERISTIC
/begin CHARACTERISTIC AirCtl_rEGRRgnCorr_MAP "EGR-RegenerationskorrekturDIAGRAMM an den großen Höhen" MAP 0xC7BD2 Kf_Xs16_Ys16_Ws16 300.0000 Prc -100.0000 200.0000 FORMAT "%8.4" EXTENDED_LIMITS -400.0000 399.9878
 /begin AXIS_DESCR STD_AXIS Eng_nAvrg EngN 16 0.00 6000.000 FORMAT "%8.3" EXTENDED_LIMITS -32768.00 32767.00 DEPOSIT ABSOLUTE /end AXIS_DESCR
 /begin AXIS_DESCR STD_AXIS InjCtl_qCurr InjMassCyc 16 0.00 100.0000 FORMAT "%8.4" EXTENDED_LIMITS -327.6800 327.6700 DEPOSIT ABSOLUTE /end AXIS_DESCR
/end CHARACTERISTIC
/begin CHARACTERISTIC AirCtl_rEGRRgn_MAP "Kennfeld fuer Abgasrueckfuehrstellgroesse Regeneration" MAP 0xC7E16 Kf_Xs16_Ys16_Ws16 300.0000 Prc -100.0000 200.0000 FORMAT "%8.4" EXTENDED_LIMITS -400.0000 399.9878
 /begin AXIS_DESCR STD_AXIS Eng_nAvrg EngN 12 0.00 6000.000 FORMAT "%8.3" EXTENDED_LIMITS -32768.00 32767.00 DEPOSIT ABSOLUTE /end AXIS_DESCR
 /begin AXIS_DESCR STD_AXIS InjCtl_qCurr InjMassCyc 12 0.00 100.0000 FORMAT "%8.4" EXTENDED_LIMITS -327.6800 327.6700 DEPOSIT ABSOLUTE /end AXIS_DESCR
/end CHARACTERISTIC
/begin CHARACTERISTIC AirCtl_rEGRRmpMax_C "maximal erlaubte Stellgröße für das ARF- Ventil" VALUE 0xC7F6A Kw_Ws16 100.0000 Prc 0.00 100.0000 FORMAT "%8.4" EXTENDED_LIMITS -400.0000 399.9878 /end CHARACTERISTIC
/begin CHARACTERISTIC AirCtl_rEGRRmpMin_C "minimal erlaubte Stellgröße für das ARF- Ventil" VALUE 0xC7F6C Kw_Ws16 100.0000 Prc 0.00 100.0000 FORMAT "%8.4" EXTENDED_LIMITS -400.0000 399.9878 /end CHARACTERISTIC
/begin CHARACTERISTIC AirCtl_rGovEGRMax_C "maximal zulässige Abgasrückführventilstellgröße" VALUE 0xC75A2 Kw_Ws16 300.0000 Prc -100.0000 200.0000 FORMAT "%8.4" EXTENDED_LIMITS -400.0000 399.9878 /end CHARACTERISTIC
/begin CHARACTERISTIC AirCtl_rGovEGRMin_C "minimal zulässige Abgasrückführventilstellgröße" VALUE 0xC75A4 Kw_Ws16 300.0000 Prc -100.0000 200.0000 FORMAT "%8.4" EXTENDED_LIMITS -400.0000 399.9878 /end CHARACTERISTIC
/begin CHARACTERISTIC AirCtl_rGvnrBgnNrmRgn_C "Reglerausgang bei Beginn der Übergangsphase Normalbetrieb - Regeneration" VALUE 0xC7F6E Kw_Ws16 100.0000 Prc 0.00 100.0000 FORMAT "%8.4" EXTENDED_LIMITS -400.0000 399.9878 /end CHARACTERISTIC
/begin CHARACTERISTIC AirCtl_rGvnrDynMinRgn_CUR "Dynamische Begrenzung 1 bei Regeneration" CURVE 0xC75A6 Kl_Xs16_Ws16 100.0000 Prc 0.00 100.0000 FORMAT "%8.4" EXTENDED_LIMITS -400.0000 399.9878
 /begin AXIS_DESCR STD_AXIS AirCtl_rPCRCtl_mp Prc 6 0.00 100.0000 FORMAT "%8.4" EXTENDED_LIMITS -400.0000 399.9878 DEPOSIT ABSOLUTE /end AXIS_DESCR
/end CHARACTERISTIC
/begin CHARACTERISTIC AirCtl_rGvnrDynMin_CUR "Dynamische Begrenzung 1 bei Normalbetrieb" CURVE 0xC75C0 Kl_Xs16_Ws16 100.0000 Prc 0.00 100.0000 FORMAT "%8.4" EXTENDED_LIMITS -400.0000 399.9878
 /begin AXIS_DESCR STD_AXIS AirCtl_rPCRCtl_mp Prc 6 0.00 100.0000 FORMAT "%8.4" EXTENDED_LIMITS -400.0000 399.9878 DEPOSIT ABSOLUTE /end AXIS_DESCR
/end CHARACTERISTIC
/begin CHARACTERISTIC AirCtl_rGvnrMax_C "maximal zulässige Reglerstellgröße" VALUE 0xC75DA Kw_Ws16 300.0000 Prc -100.0000 200.0000 FORMAT "%8.4" EXTENDED_LIMITS -400.0000 399.9878 /end CHARACTERISTIC
/begin CHARACTERISTIC AirCtl_rGvnrMin_C "minimal zulässige Reglerstellgröße" VALUE 0xC75DC Kw_Ws16 300.0000 Prc -100.0000 200.0000 FORMAT "%8.4" EXTENDED_LIMITS -400.0000 399.9878 /end CHARACTERISTIC
/begin CHARACTERISTIC AirCtl_rGvnrPreMax_C "maximal zulässiger automatischer Vorsteuerpult Stellgröße" VALUE 0xC75DE Kw_Ws16 100.0000 Prc 0.00 100.0000 FORMAT "%8.4" EXTENDED_LIMITS -400.0000 399.9878 /end CHARACTERISTIC
/begin CHARACTERISTIC AirCtl_rGvnrPreMin_C "minimal zulässiger automatischer Vorsteuerpult Stellgröße" VALUE 0xC75E0 Kw_Ws16 100.0000 Prc 0.00 100.0000 FORMAT "%8.4" EXTENDED_LIMITS -400.0000 399.9878 /end CHARACTERISTIC
/begin CHARACTERISTIC AirCtl_rGvnrThresBgnNrm_C "Reglerausgang bei Rückkehr in den Normalbetrieb" VALUE 0xC7F70 Kw_Ws16 100.0000 Prc 0.00 100.0000 FORMAT "%8.4" EXTENDED_LIMITS -400.0000 399.9878 /end CHARACTERISTIC
/begin CHARACTERISTIC AirCtl_rGvnrTVAMax_C "maximal zulässiger Reglerkorrekturwert für Drosselklappe" VALUE 0xC7F72 Kw_Ws16 300.0000 Prc -100.0000 200.0000 FORMAT "%8.4" EXTENDED_LIMITS -400.0000 399.9878 /end CHARACTERISTIC
/begin CHARACTERISTIC AirCtl_rGvnrTVAMin_C "minimal zulässiger Reglerkorrekturwert für Drosselklappe" VALUE 0xC7F74 Kw_Ws16 300.0000 Prc -100.0000 200.0000 FORMAT "%8.4" EXTENDED_LIMITS -400.0000 399.9878 /end CHARACTERISTIC
/begin CHARACTERISTIC AirCtl_rIDflVal12_C "Initialisierungswert für Regler-I-Kanal bei Abschaltfall 12" VALUE 0xC75E2 Kw_Ws16 300.0000 Prc -100.0000 200.0000 FORMAT "%8.4" EXTENDED_LIMITS -400.0000 399.9878 /end CHARACTERISTIC
/begin CHARACTERISTIC AirCtl_rIDflVal1_C "Initialisierungswert des PI-Reglers im Abschaltfall AirCtl_stMonitor=1; AFSCD_stDrftComp" VALUE 0xC75E4 Kw_Ws16 300.0000 Prc -100.0000 200.0000 FORMAT "%8.4" EXTENDED_LIMITS -400.0000 399.9878 /end CHARACTERISTIC
/begin CHARACTERISTIC AirCtl_rIDflVal4_C "PI-Element-Initialisierungswert im Abschaltfall AirCtl_stMonitor=4: Schubbetrieb" VALUE 0xC75E6 Kw_Ws16 300.0000 Prc -100.0000 200.0000 FORMAT "%8.4" EXTENDED_LIMITS -400.0000 399.9878 /end CHARACTERISTIC
/begin CHARACTERISTIC AirCtl_rIDflVal5_C "PI-Element-Initialisierungswert im Abschaltfall AirCtl_stMonitor=5: Gangwechsel" VALUE 0xC75E8 Kw_Ws16 300.0000 Prc -100.0000 200.0000 FORMAT "%8.4" EXTENDED_LIMITS -400.0000 399.9878 /end CHARACTERISTIC
/begin CHARACTERISTIC AirCtl_rIDflVal7_C "Vorgabewert 7 fuer Stellgroesse der Drosselklappe (Regeneration)" VALUE 0xC7F76 Kw_Ws16 300.0000 Prc -100.0000 200.0000 FORMAT "%8.4" EXTENDED_LIMITS -400.0000 399.9878 /end CHARACTERISTIC
/begin CHARACTERISTIC AirCtl_rIDflVal8SurgeRgn_C "Initwert 8 des PI Reglers während Regeneration aktiv" VALUE 0xC75EA Kw_Ws16 300.0000 Prc -100.0000 200.0000 FORMAT "%8.4" EXTENDED_LIMITS -400.0000 399.9878 /end CHARACTERISTIC
/begin CHARACTERISTIC AirCtl_rIDflVal8Surge_C "PI Initialisierungswert im Falle von Laderpumpenerkennung" VALUE 0xC75EC Kw_Ws16 300.0000 Prc -100.0000 200.0000 FORMAT "%8.4" EXTENDED_LIMITS -400.0000 399.9878 /end CHARACTERISTIC
/begin CHARACTERISTIC AirCtl_rIDflVal8_C "PI-Element-Initialisierungswert im Abschaltfall AirCtl_stMonitor=8: positive  Diagnose d. Systüberwach. od. bleibende Regelabw." VALUE 0xC75EE Kw_Ws16 300.0000 Prc -100.0000 200.0000 FORMAT "%8.4" EXTENDED_LIMITS -400.0000 399.9878 /end CHARACTERISTIC
/begin CHARACTERISTIC AirCtl_rIDflValCtl_C "Initialisierungswert für Regler-I-Kanal bei Umschaltung vom gesteuerten auf geregelten Betrieb bei Regeneration" VALUE 0xC75F0 Kw_Ws16 300.0000 Prc -100.0000 200.0000 FORMAT "%8.4" EXTENDED_LIMITS -400.0000 399.9878 /end CHARACTERISTIC
/begin CHARACTERISTIC AirCtl_rTVABas_MAP "Kennfeld fuer Drosselklappenstellgroesse" MAP 0xC75F2 Kf_Xs16_Ys16_Ws16 300.0000 Prc -100.0000 200.0000 FORMAT "%8.4" EXTENDED_LIMITS -400.0000 399.9878
 /begin AXIS_DESCR STD_AXIS Eng_nAvrg EngN 8 0.00 6000.000 FORMAT "%8.3" EXTENDED_LIMITS -32768.00 32767.00 DEPOSIT ABSOLUTE /end AXIS_DESCR
 /begin AXIS_DESCR STD_AXIS AirCtl_rOutGvnr_mp Prc 16 -400.0000 399.9878 FORMAT "%8.4" DEPOSIT ABSOLUTE /end AXIS_DESCR
/end CHARACTERISTIC
/begin CHARACTERISTIC AirCtl_rTVACtlAPSCor_CUR "Atmosphärendruck-Korrekturfaktor des Tastverhältnisses für TVA" CURVE 0xC7F78 Kl_Xs16_Ws16 200.0000 Prc 0.00 200.0000 FORMAT "%8.4" EXTENDED_LIMITS -400.0000 399.9878
 /begin AXIS_DESCR STD_AXIS APSCD_pVal Pres_hPa 6 0.00 3500.000 FORMAT "%8.3" EXTENDED_LIMITS -32768.00 32767.00 DEPOSIT ABSOLUTE /end AXIS_DESCR
/end CHARACTERISTIC
/begin CHARACTERISTIC AirCtl_rTVACtlATCor_MAP "Ansauglufttemperatur-Korrekturwert des Tastverhältnisses für TVA" MAP 0xC7F92 Kf_Xs16_Ys16_Ws16 200.0000 Prc 0.00 200.0000 FORMAT "%8.4" EXTENDED_LIMITS -400.0000 399.9878
 /begin AXIS_DESCR STD_AXIS Eng_nAvrg EngN 8 0.00 6000.000 FORMAT "%8.3" EXTENDED_LIMITS -32768.00 32767.00 DEPOSIT ABSOLUTE /end AXIS_DESCR
 /begin AXIS_DESCR STD_AXIS InjCtl_qRaw InjMassCyc 8 -327.6800 327.6700 FORMAT "%8.4" DEPOSIT ABSOLUTE /end AXIS_DESCR
/end CHARACTERISTIC
/begin CHARACTERISTIC AirCtl_rTVACtlBas_MAP "Grundwert des Tastverhältnisses für TVA" MAP 0xC8036 Kf_Xs16_Ys16_Ws16 200.0000 Prc 0.00 200.0000 FORMAT "%8.4" EXTENDED_LIMITS -400.0000 399.9878
 /begin AXIS_DESCR STD_AXIS Eng_nAvrg EngN 10 0.00 6000.000 FORMAT "%8.3" EXTENDED_LIMITS -32768.00 32767.00 DEPOSIT ABSOLUTE /end AXIS_DESCR
 /begin AXIS_DESCR STD_AXIS InjCtl_qRaw InjMassCyc 10 -327.6800 327.6700 FORMAT "%8.4" DEPOSIT ABSOLUTE /end AXIS_DESCR
/end CHARACTERISTIC
/begin CHARACTERISTIC AirCtl_rTVACtlCTCor_MAP "Kühlmitteltemperatur-Korrekturwert des Tastverhältnisses für TVA" MAP 0xC812A Kf_Xs16_Ys16_Ws16 200.0000 Prc 0.00 200.0000 FORMAT "%8.4" EXTENDED_LIMITS -400.0000 399.9878
 /begin AXIS_DESCR STD_AXIS Eng_nAvrg EngN 8 0.00 6000.000 FORMAT "%8.3" EXTENDED_LIMITS -32768.00 32767.00 DEPOSIT ABSOLUTE /end AXIS_DESCR
 /begin AXIS_DESCR STD_AXIS InjCtl_qRaw InjMassCyc 8 -327.6800 327.6700 FORMAT "%8.4" DEPOSIT ABSOLUTE /end AXIS_DESCR
/end CHARACTERISTIC
/begin CHARACTERISTIC AirCtl_rTVADflVal12_C "Vorgabewert 12 für Stellgröße der Drosselklappe" VALUE 0xC883E Kw_Ws16 300.0000 Prc -100.0000 200.0000 FORMAT "%8.4" EXTENDED_LIMITS -400.0000 399.9878 /end CHARACTERISTIC
/begin CHARACTERISTIC AirCtl_rTVADflVal1_C "Default value for throttle valve ratio when shut off due to Drift Compensation occurs." VALUE 0xC8840 Kw_Ws16 300.0000 Prc -100.0000 200.0000 FORMAT "%8.4" EXTENDED_LIMITS -400.0000 399.9878 /end CHARACTERISTIC
/begin CHARACTERISTIC AirCtl_rTVADflVal4_C "Vorgabewert 4 für Stellgröße der Drosselklappe" VALUE 0xC8842 Kw_Ws16 300.0000 Prc -100.0000 200.0000 FORMAT "%8.4" EXTENDED_LIMITS -400.0000 399.9878 /end CHARACTERISTIC
/begin CHARACTERISTIC AirCtl_rTVADflVal5_C "Vorgabewert 5 für Stellgröße der Drosselklappe" VALUE 0xC8844 Kw_Ws16 300.0000 Prc -100.0000 200.0000 FORMAT "%8.4" EXTENDED_LIMITS -400.0000 399.9878 /end CHARACTERISTIC
/begin CHARACTERISTIC AirCtl_rTVADflVal8_C "Vorgabewert 8 für Stellgröße der Drosselklappe" VALUE 0xC8846 Kw_Ws16 300.0000 Prc -100.0000 200.0000 FORMAT "%8.4" EXTENDED_LIMITS -400.0000 399.9878 /end CHARACTERISTIC
/begin CHARACTERISTIC AirCtl_rTVARgn_MAP "Kennfeld fuer Drosselklappenstellgroesse Regeneration" MAP 0xC81CE Kf_Xs16_Ys16_Ws16 300.0000 Prc -100.0000 200.0000 FORMAT "%8.4" EXTENDED_LIMITS -400.0000 399.9878
 /begin AXIS_DESCR STD_AXIS Eng_nAvrg EngN 4 0.00 8000.000 FORMAT "%8.3" EXTENDED_LIMITS -32768.00 32767.00 DEPOSIT ABSOLUTE /end AXIS_DESCR
 /begin AXIS_DESCR STD_AXIS AirCtl_rOutGvnr_mp Prc 8 -400.0000 399.9878 FORMAT "%8.4" DEPOSIT ABSOLUTE /end AXIS_DESCR
/end CHARACTERISTIC
/begin CHARACTERISTIC AirCtl_stCmpntActv_C "Deaktivierung der Überwachung auf bleibende Regelabweichung bei Stellertest im Diagnoseeingriff" VALUE 0xC8848 Kw_Wu16 65535.00 OneToOne 0.00 65535.00 FORMAT "%8.2" /end CHARACTERISTIC
/begin CHARACTERISTIC AirCtl_stEGRDel_C "TV des AGR-Ventils beim Wechsel in Regenerationsbetrieb einfrieren" VALUE 0xC7726 Kw_Wu8 255.0 OneToOne 0.00 255.0 FORMAT "%5.1" /end CHARACTERISTIC
/begin CHARACTERISTIC AirCtl_stInhGvnrDvt_C "status word to inhibit the monitoring of the governor deviation in case of actuator tests" VALUE 0xC884A Kw_Wu16 65535.00 OneToOne 0.00 65535.00 FORMAT "%8.2" /end CHARACTERISTIC
/begin CHARACTERISTIC AirCtl_stMskCtlValRgn_C "Maskierung zur Umschaltung des Vorsteuerwertes im Regenerationsbetrieb" VALUE 0xC4D1C Kw_Wu32 2147483647.00 OneToOne 0.00 2147483647.00 FORMAT "%13.2" EXTENDED_LIMITS 0.00 4294967295.00 /end CHARACTERISTIC
/begin CHARACTERISTIC AirCtl_stMskGvnrRgn_C "Maske zur Umschaltung der Stellerkennfelder bei Regeneration" VALUE 0xC822C Kw_Wu32 4294967295.00 OneToOne 0.00 4294967295.00 FORMAT "%13.2" /end CHARACTERISTIC
/begin CHARACTERISTIC AirCtl_stRgnAirCtlshOff_C "Mask for EGT status word for AGR shut off in case of regeneration" VALUE 0xC884C Kw_Wu32 4294967295.00 OneToOne 0.00 4294967295.00 FORMAT "%13.2" /end CHARACTERISTIC
/begin CHARACTERISTIC AirCtl_stRgnCur_C "Maske fuer EGT_st zur Umschaltung auf zweite Mengenkurve" VALUE 0xC8850 Kw_Wu32 4294967295.00 OneToOne 0.00 4294967295.00 FORMAT "%13.2" /end CHARACTERISTIC
/begin CHARACTERISTIC AirCtl_stRgnMsk1_C "applizierbare Bitmaske für erstes Regenerationskennfeld" VALUE 0xC6A68 Kw_Wu32 2147483647.00 OneToOne 0.00 2147483647.00 FORMAT "%13.2" EXTENDED_LIMITS 0.00 4294967295.00 /end CHARACTERISTIC
/begin CHARACTERISTIC AirCtl_stRgnMsk2_C "applizierbare Bitmaske für zweites Regenerationskennfeld" VALUE 0xC6A6C Kw_Wu32 2147483647.00 OneToOne 0.00 2147483647.00 FORMAT "%13.2" EXTENDED_LIMITS 0.00 4294967295.00 /end CHARACTERISTIC
/begin CHARACTERISTIC AirCtl_stRgnMsk3_C "applizierbare Bitmaske für drittes Regenerationskennfeld" VALUE 0xC6A70 Kw_Wu32 4294967295.00 OneToOne 0.00 4294967295.00 FORMAT "%13.2" /end CHARACTERISTIC
/begin CHARACTERISTIC AirCtl_stRgnMsk4_C "applizierbare Bitmaske für viertes Regenerationskennfeld" VALUE 0xC6A74 Kw_Wu32 2147483647.00 OneToOne 0.00 2147483647.00 FORMAT "%13.2" EXTENDED_LIMITS 0.00 4294967295.00 /end CHARACTERISTIC
/begin CHARACTERISTIC AirCtl_stRgnMskGov_C "Maske zur Umschaltung der aufteilung der Stellgroessen" VALUE 0xC7728 Kw_Wu32 4294967295.00 OneToOne 0.00 4294967295.00 FORMAT "%13.2" /end CHARACTERISTIC
/begin CHARACTERISTIC AirCtl_stRgnShOff_C "Maske fuer EGT_st zur Reglerabschaltung" VALUE 0xC8854 Kw_Wu32 4294967295.00 OneToOne 0.00 4294967295.00 FORMAT "%13.2" /end CHARACTERISTIC
/begin CHARACTERISTIC AirCtl_tiSurgePT1_C "Filterzeit für Drehzahlgradienten aus Drehzahlbeschleunigung" VALUE 0xC8858 Kw_Wu32 4294.8273 TimeDelay_s 0.14000154 4294.9673 FORMAT "%9.4" EXTENDED_LIMITS 0.0000010000000 4294.9673 /end CHARACTERISTIC
/begin CHARACTERISTIC AirCtl_swtAPSCorVal_C "Schalter für add. / mult. Atmosphärendruckkorrektur (0: additiev, 1: multiplikatiev)" VALUE 0xC6A78 Kw_Wu8 0.00 OneToOne 0.00 0.00 FORMAT "%5.2" EXTENDED_LIMITS 0.00 255.0 /end CHARACTERISTIC
/begin CHARACTERISTIC AirCtl_swtAPSCorType_C "EEPROM-Wert des Schalters der Luftdruckkorrektur" VALUE 0xC6A79 Kw_Wu8 0.00 OneToOne 0.00 0.00 FORMAT "%5.2" EXTENDED_LIMITS 0.00 255.0 /end CHARACTERISTIC
/begin CHARACTERISTIC AirCtl_swtEGRCtl_C "Umschalten zwischen geregelten und gesteuerten Betrieb  EGR (0: geregelt, 1: gesteuert)" VALUE 0xC772C Kw_Wu8 1.000 OneToOne 0.00 1.000 FORMAT "%5.3" EXTENDED_LIMITS 0.00 255.0 /end CHARACTERISTIC
/begin CHARACTERISTIC AirCtl_swtGvnrVal_C "Schalter für Reglerabschaltung (0: Regler aus - nur Steuerung, 1: Regler ein)" VALUE 0xC772D Kw_Wu8 1.000 OneToOne 0.00 1.000 FORMAT "%5.3" EXTENDED_LIMITS 0.00 255.0 /end CHARACTERISTIC
/begin CHARACTERISTIC AirCtl_swtGvnrType_C "EEPROM-Wert des Schalters für Reglerabschaltung" VALUE 0xC772E Kw_Wu8 1.000 OneToOne 1.000 2.000 FORMAT "%5.3" EXTENDED_LIMITS 0.00 255.0 /end CHARACTERISTIC
/begin CHARACTERISTIC AirCtl_swtHighLoadCond_C "Switch to change in highload condition (1: ein, 0: aus)" VALUE 0xC885C Kw_Wu8 255.0 OneToOne 0.00 255.0 FORMAT "%5.1" /end CHARACTERISTIC
/begin CHARACTERISTIC AirCtl_swtHighOvrRunCond_C "Schalter für High OverRun Bedingung (1: Änderung in der Bedingung festgestellt, 0: keine Änderung festgestellt)" VALUE 0xC885D Kw_Wu8 255.0 OneToOne 0.00 255.0 FORMAT "%5.1" /end CHARACTERISTIC
/begin CHARACTERISTIC AirCtl_swtIATSCorVal_C "Schalter für add. / mult. Lufttemperaturkorrektur (0: additiev, 1: multiplikatiev)" VALUE 0xC6A7A Kw_Wu8 0.00 OneToOne 0.00 0.00 FORMAT "%5.2" EXTENDED_LIMITS 0.00 255.0 /end CHARACTERISTIC
/begin CHARACTERISTIC AirCtl_swtIATSCorType_C "EEPROM-Wert des Schalters der Lufttemperaturkorrektur" VALUE 0xC6A7B Kw_Wu8 0.00 OneToOne 0.00 0.00 FORMAT "%5.2" EXTENDED_LIMITS 0.00 255.0 /end CHARACTERISTIC
/begin CHARACTERISTIC AirCtl_swtIn1DT1_C "Schalter für AirCtl_qCurrCor/AirCtl_mDesStat vorzuwählen" VALUE 0xC772F Kw_Wu8 1.000 OneToOne 0.00 1.000 FORMAT "%5.3" EXTENDED_LIMITS 0.00 255.0 /end CHARACTERISTIC
/begin CHARACTERISTIC AirCtl_swtInDT1_C "Schalter für AirCtl_qCurrCor/AirCtl_mDesStat vorzuwählen" VALUE 0xC6A7C Kw_Wu8 1.000 OneToOne 0.00 1.000 FORMAT "%5.3" EXTENDED_LIMITS 0.00 255.0 /end CHARACTERISTIC
/begin CHARACTERISTIC AirCtl_swtSelDT1_C "" VALUE 0xC6A7D Kw_Wu8 1.000 OneToOne 0.00 1.000 FORMAT "%5.3" EXTENDED_LIMITS 0.00 255.0 /end CHARACTERISTIC
/begin CHARACTERISTIC AirCtl_swtTrmVal_C "Schalterwert für add./mult. Abgleichkorrektur" VALUE 0xC6A7E Kw_Wu8 0.00 OneToOne 0.00 0.00 FORMAT "%5.2" EXTENDED_LIMITS 0.00 255.0 /end CHARACTERISTIC
/begin CHARACTERISTIC AirCtl_swtTrmType_C "Schaltertyp für add./mult. Abgleichkorrektur" VALUE 0xC6A7F Kw_Wu8 0.00 OneToOne 0.00 0.00 FORMAT "%5.2" EXTENDED_LIMITS 0.00 255.0 /end CHARACTERISTIC
/begin CHARACTERISTIC AirCtl_swtTVACtl_C "Umschalten zwischen geregelten und gesteuerten Betrieb TVA (1: gesteuert, 0: geregelt)" VALUE 0xC8230 Kw_Wu8 1.000 OneToOne 0.00 1.000 FORMAT "%5.3" EXTENDED_LIMITS 0.00 255.0 /end CHARACTERISTIC
/begin CHARACTERISTIC AirCtl_tAirHHi_C "obere Hysteresegrenze für Überwachung hoher Lufttemperatur" VALUE 0xC885E Kw_Ws16 250.0000 Temp_Cels -50.1400 199.8600 FORMAT "%8.4" EXTENDED_LIMITS -3549.940 3003.560 /end CHARACTERISTIC
/begin CHARACTERISTIC AirCtl_tAirHLo_C "untere Hysteresegrenze für Überwachung hoher Lufttemperatur" VALUE 0xC8860 Kw_Ws16 250.0000 Temp_Cels -50.1400 199.8600 FORMAT "%8.4" EXTENDED_LIMITS -3549.940 3003.560 /end CHARACTERISTIC
/begin CHARACTERISTIC AirCtl_tAirLHi_C "obere Hysteresegrenze für Überwachung niedriger Lufttemperatur" VALUE 0xC8862 Kw_Ws16 250.0000 Temp_Cels -50.1400 199.8600 FORMAT "%8.4" EXTENDED_LIMITS -3549.940 3003.560 /end CHARACTERISTIC
/begin CHARACTERISTIC AirCtl_tAirLLo_C "untere Hysteresegrenze für Überwachung niedriger Lufttemperatur" VALUE 0xC8864 Kw_Ws16 250.0000 Temp_Cels -50.1400 199.8600 FORMAT "%8.4" EXTENDED_LIMITS -3549.940 3003.560 /end CHARACTERISTIC
/begin CHARACTERISTIC AirCtl_tClntCldHi_C "obere Hysteresegrenze für Überwachung niedriger Kühlwassertemperatur" VALUE 0xC8866 Kw_Ws16 250.0000 Temp_Cels -50.1400 199.8600 FORMAT "%8.4" EXTENDED_LIMITS -3549.940 3003.560 /end CHARACTERISTIC
/begin CHARACTERISTIC AirCtl_tClntCldLo_C "untere Hysteresegrenze für Überwachung niedriger Kühlwassertemperatur" VALUE 0xC8868 Kw_Ws16 250.0000 Temp_Cels -50.1400 199.8600 FORMAT "%8.4" EXTENDED_LIMITS -3549.940 3003.560 /end CHARACTERISTIC
/begin CHARACTERISTIC AirCtl_tClntWrmHi_C "obere Hysteresegrenze für Überwachung hoher Kühlwassertemperatur" VALUE 0xC886A Kw_Ws16 250.0000 Temp_Cels -50.1400 199.8600 FORMAT "%8.4" EXTENDED_LIMITS -3549.940 3003.560 /end CHARACTERISTIC
/begin CHARACTERISTIC AirCtl_tClntWrmLo_C "untere Hysteresegrenze für Überwachung hoher Kühlwassertemperatur" VALUE 0xC886C Kw_Ws16 250.0000 Temp_Cels -50.1400 199.8600 FORMAT "%8.4" EXTENDED_LIMITS -3549.940 3003.560 /end CHARACTERISTIC
/begin CHARACTERISTIC AirCtl_tiCldStrt_CUR "Kennlinie für Zeit, in der die Regelung nach Startabwurf abgeschaltet bleibt" CURVE 0xC886E Kl_Xs16_Ws16 33000.00 Time_ms 0.00 33000.00 FORMAT "%8.2" EXTENDED_LIMITS -327680.0 327670.0
 /begin AXIS_DESCR STD_AXIS CTSCD_tClnt Temp_Cels 8 -50.14000 199.8600 FORMAT "%8.4" EXTENDED_LIMITS -3549.940 3003.560 DEPOSIT ABSOLUTE /end AXIS_DESCR
/end CHARACTERISTIC
/begin CHARACTERISTIC AirCtl_tiClth_C "maximale Zeit für Schaltvorgangerkennung" VALUE 0xC8890 Kw_Wu16 655350.0 TimeDeb 0.00 655350.0 FORMAT "%8.1" /end CHARACTERISTIC
/begin CHARACTERISTIC AirCtl_tiMaxDef2_C "Fehlerentprellzeit 2" VALUE 0xC8892 Kw_Wu16 65540.00 Time_ms 0.00 65540.00 FORMAT "%8.2" EXTENDED_LIMITS 0.00 655350.0 /end CHARACTERISTIC
/begin CHARACTERISTIC AirCtl_tiMaxOk2_C "Fehlerheilungszeit 2" VALUE 0xC8894 Kw_Wu16 65540.00 Time_ms 0.00 65540.00 FORMAT "%8.2" EXTENDED_LIMITS 0.00 655350.0 /end CHARACTERISTIC
/begin CHARACTERISTIC AirCtl_DebGvnrDvtMaxDef_C "Vorentprellzeit für Erkennung positiver bleibender Regelabweichung" VALUE 0xC8896 Kw_Wu16 65540.00 TimeDeb 0.00 65540.00 FORMAT "%8.2" EXTENDED_LIMITS 0.00 655350.0 /end CHARACTERISTIC
/begin CHARACTERISTIC AirCtl_DebGvnrDvtMaxOk_C "Vorentprellzeit für Heilung positiver bleibender Regelabweichung" VALUE 0xC8898 Kw_Wu16 65540.00 TimeDeb 0.00 65540.00 FORMAT "%8.2" EXTENDED_LIMITS 0.00 655350.0 /end CHARACTERISTIC
/begin CHARACTERISTIC AirCtl_tiMinDef2_C "Fehlerentprellzeit 2" VALUE 0xC889A Kw_Wu16 65540.00 Time_ms 0.00 65540.00 FORMAT "%8.2" EXTENDED_LIMITS 0.00 655350.0 /end CHARACTERISTIC
/begin CHARACTERISTIC AirCtl_tiMinOk2_C "Fehlerheilungszeit 2" VALUE 0xC889C Kw_Wu16 65540.00 Time_ms 0.00 65540.00 FORMAT "%8.2" EXTENDED_LIMITS 0.00 655350.0 /end CHARACTERISTIC
/begin CHARACTERISTIC AirCtl_DebGvnrDvtMinDef_C "Vorentprellzeit für Erkennung negativer bleibender Regelabweichung" VALUE 0xC889E Kw_Wu16 65540.00 TimeDeb 0.00 65540.00 FORMAT "%8.2" EXTENDED_LIMITS 0.00 655350.0 /end CHARACTERISTIC
/begin CHARACTERISTIC AirCtl_DebGvnrDvtMinOk_C "Vorentprellzeit für Heilung negativer bleibender Regelabweichung" VALUE 0xC88A0 Kw_Wu16 65540.00 TimeDeb 0.00 65540.00 FORMAT "%8.2" EXTENDED_LIMITS 0.00 655350.0 /end CHARACTERISTIC
/begin CHARACTERISTIC AirCtl_tiDebPlateBrkDef_C "Heilzeit für Bremse defekt" VALUE 0xC88A2 Kw_Ws16 65540.00 Time_ms 0.00 65540.00 FORMAT "%8.2" EXTENDED_LIMITS -327680.0 327670.0 /end CHARACTERISTIC
/begin CHARACTERISTIC AirCtl_tiDebPlateBrkOk_C "Heilzeit für Bremse ok" VALUE 0xC88A4 Kw_Ws16 65540.00 Time_ms 0.00 65540.00 FORMAT "%8.2" EXTENDED_LIMITS -327680.0 327670.0 /end CHARACTERISTIC
/begin CHARACTERISTIC AirCtl_tidqRawOn_C "Timer für Einspritzungquantitat wechsel" VALUE 0xC88A8 Kw_Wu32 655140.000000 Time_s 0.00 655140.000000 FORMAT "%13.6" EXTENDED_LIMITS 0.00 42949672.9500 /end CHARACTERISTIC
/begin CHARACTERISTIC AirCtl_tiDT1AGR_C "Zeitkonstante des DT1-Gliedes für AirCtl_mDesStat/AirCtl_qCurrCor" VALUE 0xC7730 Kw_Wu32 4294.9663 TimeDelay_s 0.0010000001 4294.9673 FORMAT "%9.4" EXTENDED_LIMITS 0.0000010000000 4294.9673 /end CHARACTERISTIC
/begin CHARACTERISTIC AirCtl_tiDT1qDes_C "Zeitkonstante des DT1-Gliedes für AirCtl_mDesStat/AirCtl_qCurrCor" VALUE 0xC6A80 Kw_Wu32 4294.9663 TimeDelay_s 0.0010000001 4294.9673 FORMAT "%9.4" EXTENDED_LIMITS 0.0000010000000 4294.9673 /end CHARACTERISTIC
/begin CHARACTERISTIC AirCtl_tiDT1Rgn_C "DT1-element time constant in regeneration operation" VALUE 0xC8234 Kw_Wu32 4294.9663 TimeDelay_s 0.0010000001 4294.9673 FORMAT "%9.4" EXTENDED_LIMITS 0.0000010000000 4294.9673 /end CHARACTERISTIC
/begin CHARACTERISTIC AirCtl_tiDynAirCtl_C "Timer dynamische Begrenzung 1 - AirCtl" VALUE 0xC7734 Kw_Wu16 4000.000 Time_ms 0.00 4000.000 FORMAT "%8.3" EXTENDED_LIMITS 0.00 655350.0 /end CHARACTERISTIC
/begin CHARACTERISTIC AirCtl_tiFltGvnrDvt_C "Zeitkonstante des PT1-Gliedsabhängig von Luftmassendifferenz" VALUE 0xC7738 Kw_Wu32 4294.8273 TimeDelay_s 0.14000154 4294.9673 FORMAT "%9.4" EXTENDED_LIMITS 0.0000010000000 4294.9673 /end CHARACTERISTIC
/begin CHARACTERISTIC AirCtl_tiLiEGR_C "SW-Timer Zeit für Drehzahlkorrektur" VALUE 0xC6A84 Kw_Wu32 21474836.4700 Time_s 0.00 21474836.4700 FORMAT "%13.4" EXTENDED_LIMITS 0.00 42949672.9500 /end CHARACTERISTIC
/begin CHARACTERISTIC AirCtl_tiLoIdl_C "Grenzzeit für Leerlaufabschaltung" VALUE 0xC88AC Kw_Wu32 42949672.9500 Time_s 0.00 42949672.9500 FORMAT "%13.4" /end CHARACTERISTIC
/begin CHARACTERISTIC AirCtl_tiOvrRun_C "Debounce time for OverRun Condition" VALUE 0xC88B0 Kw_Wu16 600000.0 TimeDeb 0.00 600000.0 FORMAT "%8.1" EXTENDED_LIMITS 0.00 655350.0 /end CHARACTERISTIC
/begin CHARACTERISTIC AirCtl_tiPCRCtlHiLo_C "Entprellzeit dynam. Begrenzung 2 HiLo" VALUE 0xC773C Kw_Wu16 655350.0 TimeDeb 0.00 655350.0 FORMAT "%8.1" /end CHARACTERISTIC
/begin CHARACTERISTIC AirCtl_tiPCRCtlLoHi_C "Entprellzeit dynam. Begrenzung 2 LoHi" VALUE 0xC773E Kw_Wu16 655350.0 TimeDeb 0.00 655350.0 FORMAT "%8.1" /end CHARACTERISTIC
/begin CHARACTERISTIC AirCtl_tiRgnNrmMax_C "maximal erlaubte Zeitdauer der Übergangsphase von Regenerations- nach Normalbetrieb" VALUE 0xC8238 Kw_Wu16 655.3500 Time_s 0.00 655.3500 FORMAT "%8.4" /end CHARACTERISTIC
/begin CHARACTERISTIC AirCtl_tiRmpSlpDes_C "Ramplaufzeit fuer Mehrfachumschaltung" VALUE 0xC6A88 Kw_Wu32 40.0000000000 Time_s 0.00 40.0000000000 FORMAT "%13.10" EXTENDED_LIMITS 0.00 42949672.9500 /end CHARACTERISTIC
/begin CHARACTERISTIC AirCtl_tiRmpSlpGov_C "Rampzeit zur Umschaltung zwischen Standard- und Regenerationswert" VALUE 0xC7740 Kw_Wu32 40.0000000000 Time_s 0.00 40.0000000000 FORMAT "%13.10" EXTENDED_LIMITS 0.00 42949672.9500 /end CHARACTERISTIC
/begin CHARACTERISTIC AirCtl_tiTVADel_C "Zeit die die Drosselklappe beim Wechsel aus dem Regenerationsbetrieb eingefroren wird" VALUE 0xC823A Kw_Wu16 655.3500 Time_s 0.00 655.3500 FORMAT "%8.4" /end CHARACTERISTIC
/begin CHARACTERISTIC AirCtl_TrmRgn_MAP "MAP for the adjusted value with regeneration" MAP 0xC6A8C Kf_Xs16_Ys16_Ws16 200.0000 AirMassPerCyl -100.0000 100.0000 FORMAT "%8.4" EXTENDED_LIMITS -3276.800 3276.700
 /begin AXIS_DESCR STD_AXIS Eng_nAvrg EngN 8 0.00 6000.000 FORMAT "%8.3" EXTENDED_LIMITS -32768.00 32767.00 DEPOSIT ABSOLUTE /end AXIS_DESCR
 /begin AXIS_DESCR STD_AXIS InjCtl_qRawCor InjMassCyc 8 0.00 200.0000 FORMAT "%8.4" EXTENDED_LIMITS -327.6800 327.6700 DEPOSIT ABSOLUTE /end AXIS_DESCR
/end CHARACTERISTIC
/begin CHARACTERISTIC AirCtl_TrmVal_C "ARF-Abgleichwert" VALUE 0xC6B30 Kw_Ws16 3000.000 AirMassPerCyl -1500.000 1500.000 FORMAT "%8.3" EXTENDED_LIMITS -3276.800 3276.700 /end CHARACTERISTIC
/begin CHARACTERISTIC AirCtl_drTVA2SlpLimUp_C "Slope limitation for increase of the throttle valve controller  2 variable" VALUE 0xC88B4 Kw_Wu32 799999.999814 RmpPrc 0.00 799999.999814 FORMAT "%13.6" /end CHARACTERISTIC
/begin CHARACTERISTIC AirCtl_drTVA2SlpLimDown_C "Slope limitation for decrease of the throttle valve controller  2 variable" VALUE 0xC88B8 Kw_Wu32 799999.999814 RmpPrc 0.00 799999.999814 FORMAT "%13.6" /end CHARACTERISTIC
/begin CHARACTERISTIC AirCtl_drTVASlpLimUp_C "Steigungsbegrenzung Anstieg für Stellergröße Drosselklappe" VALUE 0xC88BC Kw_Wu32 799999.999814 RmpPrc 0.00 799999.999814 FORMAT "%13.6" /end CHARACTERISTIC
/begin CHARACTERISTIC AirCtl_drTVASlpLimDown_C "Steigungsbegrenzung Abfall für Stellergröße Drosselklappe" VALUE 0xC88C0 Kw_Wu32 799999.999814 RmpPrc 0.00 799999.999814 FORMAT "%13.6" /end CHARACTERISTIC
/begin CHARACTERISTIC AirCtl_uBattThres_C "Grenze für Batteriespannungsüberwachung" VALUE 0xC88C4 Kw_Ws16 1281232. Volt_Batt -640625.6 640606.1 FORMAT "%8.1" /end CHARACTERISTIC
/begin CHARACTERISTIC AirCtl_vLim_C "threshold for vehicle speed" VALUE 0xC88C6 Kw_Ws16 20.00000 Vel 0.00 20.00000 FORMAT "%8.5" EXTENDED_LIMITS -327.6800 327.6700 /end CHARACTERISTIC
/begin MEASUREMENT AFSCD_ddmAirPerTime "Luftmassenstromgradient" SWORD dm_dZ20 1 100 -32768.00 32767.00 FORMAT "%8.2" ECU_ADDRESS 0x7F8A54 /end MEASUREMENT
/begin MEASUREMENT AFSCD_dmAirNorm "Normalisierte Luftmasse" SWORD AirMassPerTime 1 100 -3276.800 3276.700 FORMAT "%8.3" ECU_ADDRESS 0x7F8A58 /end MEASUREMENT
/begin MEASUREMENT AFSCD_dmAirNorm2 "Normalisierte Luftmasse 2" SWORD AirMassPerTime 1 100 -3276.800 3276.700 FORMAT "%8.3" ECU_ADDRESS 0x7F8A5A /end MEASUREMENT
/begin MEASUREMENT AFSCD_dmAirNorm2_mp "value of air mass per unit time before error correction" SWORD AirMassPerTime 1 100 -3276.800 3276.700 FORMAT "%8.3" ECU_ADDRESS 0x8FD280 /end MEASUREMENT
/begin MEASUREMENT AFSCD_dmAirNormDfl2_mp "value of air mass per unit time before error correction" SWORD AirMassPerTime 1 100 -3276.800 3276.700 FORMAT "%8.3" ECU_ADDRESS 0x8FD282 /end MEASUREMENT
/begin MEASUREMENT AFSCD_dmAirNormDfl_mp "Ersatzluftmasse als f(Drehzahl) im Fall eines Fehlers des Ladedruck- oder Lufttemperatursensors" SWORD AirMassPerTime 1 100 -3276.800 3276.700 FORMAT "%8.3" ECU_ADDRESS 0x8FD298 /end MEASUREMENT
/begin MEASUREMENT AFSCD_dmAirNorm_mp "Ersatzluftmasse berechnet aus der Gasgleichung" SWORD AirMassPerTime 1 100 -3276.800 3276.700 FORMAT "%8.3" ECU_ADDRESS 0x8FD29A /end MEASUREMENT
/begin MEASUREMENT AFSCD_dmAirPerTime "HFM Luftmassenstrom" SWORD AirMassPerTime 1 100 -3276.800 3276.700 FORMAT "%8.3" ECU_ADDRESS 0x7F8A5C /end MEASUREMENT
/begin MEASUREMENT AFSCD_dmAirPerTime1 "MLt Luftmassenstrom 2 n. Liniarisierung + Mittelung" SWORD AirMassPerTime 1 100 -3276.800 3276.700 FORMAT "%8.3" ECU_ADDRESS 0x7F8A5E /end MEASUREMENT
/begin MEASUREMENT AFSCD_dmAirPerTime2 "MLt Luftmassenstrom 2 n. Liniarisierung + Mittelung" SWORD AirMassPerTime 1 100 -3276.800 3276.700 FORMAT "%8.3" ECU_ADDRESS 0x7F8A60 /end MEASUREMENT
/begin MEASUREMENT AFSCD_dmAirPerTime2_mp "MLt Luftmassenstrom 2 n. Liniarisierung + Mittelung" SWORD AirMassPerTime 1 100 -3276.800 3276.700 FORMAT "%8.3" ECU_ADDRESS 0x8FD284 /end MEASUREMENT
/begin MEASUREMENT AFSCD_dmAirPerTimeHold "letzter gueltiger Wert der Luftmasse pro Zeiteinheit" SWORD AirMassPerTime 1 100 -3276.800 3276.700 FORMAT "%8.3" ECU_ADDRESS 0x7F8A62 /end MEASUREMENT
/begin MEASUREMENT AFSCD_dmAirPerTimeHold2 "letzter gueltiger Wert der Luftmasse 2 pro Zeiteinheit" SWORD AirMassPerTime 1 100 -3276.800 3276.700 FORMAT "%8.3" ECU_ADDRESS 0x7F8A64 /end MEASUREMENT
/begin MEASUREMENT AFSCD_dmAirPerTimePlsCorr2_mp "air mass per time" SWORD AirMassPerTime 1 100 -3276.800 3276.700 FORMAT "%8.3" ECU_ADDRESS 0x8FD286 /end MEASUREMENT
/begin MEASUREMENT AFSCD_dmAirPerTimePlsCorr_mp "Luftmasse nach Pulsationskorrektur" SWORD AirMassPerTime 1 100 -3276.800 3276.700 FORMAT "%8.3" ECU_ADDRESS 0x8FD29C /end MEASUREMENT
/begin MEASUREMENT AFSCD_dmAirPerTime_mp "MLt Luftmassenstrom n. Linearisierung + Mittelung" SWORD AirMassPerTime 1 100 -3276.800 3276.700 FORMAT "%8.3" ECU_ADDRESS 0x8FD29E /end MEASUREMENT
/begin MEASUREMENT AFSCD_dmAirRawPerTime "Rohwert der Luftmasse vom HFM" SWORD AirMassPerTime 1 100 -3276.800 3276.700 FORMAT "%8.3" ECU_ADDRESS 0x7F8A66 /end MEASUREMENT
/begin MEASUREMENT AFSCD_dmAirRawPerTime2 "LMM Rohwert Luftmassenmesser HFM2" SWORD AirMassPerTime 1 100 -3276.800 3276.700 FORMAT "%8.3" ECU_ADDRESS 0x7F8A68 /end MEASUREMENT
/begin MEASUREMENT AFSCD_dmAirSens "Luftmassenstrom des Luftmassensensors" SWORD AirMassPerTime 1 100 -3276.800 3276.700 FORMAT "%8.3" ECU_ADDRESS 0x7F8A6A /end MEASUREMENT
/begin MEASUREMENT AFSCD_dmAirSensCorr_mp "Korrigierte angesaugte Luftmasse pro Zeit" SWORD AirMassPerTime 1 100 -3276.800 3276.700 FORMAT "%8.3" ECU_ADDRESS 0x8FD26A /end MEASUREMENT
/begin MEASUREMENT AFSCD_dpIntValAbsFlt "Gradient zum ladedruck" SWORD RmpPres_hPa 1 100 -500.0000 499.9847 FORMAT "%8.4" ECU_ADDRESS 0x7F8A6C /end MEASUREMENT
/begin MEASUREMENT AFSCD_dpIntValAbs_mp "Zeitlicher Änderungsbetrag des Ladedrucks" SWORD RmpPres_hPa 1 100 -500.0000 499.9847 FORMAT "%8.4" ECU_ADDRESS 0x8FD268 /end MEASUREMENT
/begin MEASUREMENT AFSCD_dqCurrAbsFlt "Gradient der Einspritzmenge" SWORD RmpInjMass 1 100 -5.000000 4.999847 FORMAT "%8.6" ECU_ADDRESS 0x7F8A6E /end MEASUREMENT
/begin MEASUREMENT AFSCD_facPlsCor2_mp "Pulsationskorrekturfaktor für den 2. HFM" SWORD Fact 1 100 -4.000000 3.999878 FORMAT "%8.6" ECU_ADDRESS 0x8FD288 /end MEASUREMENT
/begin MEASUREMENT AFSCD_facPlsCor_mp "Pulsationskorrekturfaktor" SWORD Fact 1 100 -4.000000 3.999878 FORMAT "%8.6" ECU_ADDRESS 0x8FD2A0 /end MEASUREMENT
/begin MEASUREMENT AFSCD_facSwtOnCor2_mp "Einschaltkorrekturfaktor(sensor 2)" SWORD Fact 1 100 -4.000000 3.999878 FORMAT "%8.6" ECU_ADDRESS 0x8FD28A /end MEASUREMENT
/begin MEASUREMENT AFSCD_facSwtOnCor_mp "Faktor der Einschaltkorrektur" SWORD Fact 1 100 -4.000000 3.999878 FORMAT "%8.6" ECU_ADDRESS 0x8FD2A2 /end MEASUREMENT
/begin MEASUREMENT AFSCD_mAirDiffHigh_mp "high Schwellwert der Hysterese zur Ueberwachung der Differenzen in zwei Luftmassen" SWORD AirMassPerCyl 1 100 -3276.800 3276.700 FORMAT "%8.3" ECU_ADDRESS 0x8FD262 /end MEASUREMENT
/begin MEASUREMENT AFSCD_mAirDiffLow_mp "low Schwellwert der Hysterese zur Ueberwachung der Differenzen in zwei Luftmassen" SWORD AirMassPerCyl 1 100 -3276.800 3276.700 FORMAT "%8.3" ECU_ADDRESS 0x8FD264 /end MEASUREMENT
/begin MEASUREMENT AFSCD_mAirPerCyl "angesaugte Luftmasse pro Zylinder" SWORD AirMassPerCyl 1 100 -3276.800 3276.700 FORMAT "%8.3" ECU_ADDRESS 0x7F8A70 /end MEASUREMENT
/begin MEASUREMENT AFSCD_mAirPerCyl1 "angesaugte Luftmasse pro Zylinder 1" SWORD AirMassPerCyl 1 100 -3276.800 3276.700 FORMAT "%8.3" ECU_ADDRESS 0x7F8A72 /end MEASUREMENT
/begin MEASUREMENT AFSCD_mAirPerCyl2 "angesaugte Luftmasse pro Zylinder 2" SWORD AirMassPerCyl 1 100 -3276.800 3276.700 FORMAT "%8.3" ECU_ADDRESS 0x7F8A74 /end MEASUREMENT
/begin MEASUREMENT AFSCD_mAirPerCylDiff "PT1 gefilterte Differenz der beiden Luftmassen" SWORD AirMassPerCyl 1 100 -3276.800 3276.700 FORMAT "%8.3" ECU_ADDRESS 0x7F8A76 /end MEASUREMENT
/begin MEASUREMENT AFSCD_mAirPerCylDiffAbs "Absolutwert der PT1 gefilterten Differenz der beiden Luftmassen" SWORD AirMassPerCyl 1 100 -3276.800 3276.700 FORMAT "%8.3" ECU_ADDRESS 0x7F8A78 /end MEASUREMENT
/begin MEASUREMENT AFSCD_mAirPerCylDiffUnFlt_mp "Ungefilterte Differenz der beiden Luftmassen" SWORD AirMassPerCyl 1 100 -3276.800 3276.700 FORMAT "%8.3" ECU_ADDRESS 0x8FD266 /end MEASUREMENT
/begin MEASUREMENT AFSCD_mAirPerCylFlt "PT1 gefilterte Luftmasse pro Zylinder" SWORD AirMassPerCyl 1 100 -3276.800 3276.700 FORMAT "%8.3" ECU_ADDRESS 0x7F8A7A /end MEASUREMENT
/begin MEASUREMENT AFSCD_pCurr2_mp "aktueller Druck für Ersatzwertbildung" SWORD Pres_hPa 1 100 -32768.00 32767.00 FORMAT "%8.2" ECU_ADDRESS 0x8FD28C /end MEASUREMENT
/begin MEASUREMENT AFSCD_pCurr_mp "aktueller Druck für Ersatzwertbildung" SWORD Pres_hPa 1 100 -32768.00 32767.00 FORMAT "%8.2" ECU_ADDRESS 0x8FD2A4 /end MEASUREMENT
/begin MEASUREMENT AFSCD_qAirmThrSRCHiActv2_mp "Mengenschwelle 2 zur Unterdrueckung SRC HIGH(HFM5 1ms) Schwelle = f(Eng_nAvrg)" SWORD InjMass 1 100 -327.6800 327.6700 FORMAT "%8.4" ECU_ADDRESS 0x8FD28E /end MEASUREMENT
/begin MEASUREMENT AFSCD_qAirmThrSRCHiActv_mp "Mengenschwelle zur Unterdrueckung SRC HIGH(HFM5 1ms) Schwelle = f(n)" SWORD InjMass 1 100 -327.6800 327.6700 FORMAT "%8.4" ECU_ADDRESS 0x8FD2A6 /end MEASUREMENT
/begin MEASUREMENT AFSCD_rAir "duty cycle of the air temparature signal" SWORD DtyCyc 1 100 -327.6800 327.6700 FORMAT "%8.4" ECU_ADDRESS 0x7F8A7C /end MEASUREMENT
/begin MEASUREMENT AFSCD_rAir2 "Lufttemperatur-Rohwert vom zweiten HFM6 Sensor" SWORD DtyCyc 1 100 -327.6800 327.6700 FORMAT "%8.4" ECU_ADDRESS 0x7F8A7E /end MEASUREMENT
/begin MEASUREMENT AFSCD_rAirNorm "Verhältnis von normalisiertem Luftmassenstrom zu Sensorluftmassenstrom" SWORD Fact 1 100 -4.000000 3.999878 FORMAT "%8.6" ECU_ADDRESS 0x7F8A80 /end MEASUREMENT
/begin MEASUREMENT AFSCD_rAirNorm1 "Verhältnis zwischen Normalised Luftmasse pro Zeit 1 und aktuelle Luftmasse pro Zeit 1" SWORD Fact 1 100 -4.000000 3.999878 FORMAT "%8.6" ECU_ADDRESS 0x7F8A82 /end MEASUREMENT
/begin MEASUREMENT AFSCD_rAirNorm2 "Verhältnis zwischen Normalised Luftmasse pro Zeit 2 und aktuelle Luftmasse pro Zeit 2." SWORD Fact 1 100 -4.000000 3.999878 FORMAT "%8.6" ECU_ADDRESS 0x7F8A84 /end MEASUREMENT
/begin MEASUREMENT AFSCD_rAirNormWgt1_mp "" SWORD Fact 1 100 -4.000000 3.999878 FORMAT "%8.6" ECU_ADDRESS 0x8FD26C /end MEASUREMENT
/begin MEASUREMENT AFSCD_rAirNormWgt2_mp "" SWORD Fact 1 100 -4.000000 3.999878 FORMAT "%8.6" ECU_ADDRESS 0x8FD26E /end MEASUREMENT
/begin MEASUREMENT AFSCD_rAirNormWgt_mp "" SWORD Fact 1 100 -4.000000 3.999878 FORMAT "%8.6" ECU_ADDRESS 0x8FD270 /end MEASUREMENT
/begin MEASUREMENT AFSCD_rAirNorm_mp "Verhaeltnis der modellbasierten und der gemessenen Luftmassenflussrate fuer Bank1 der Gesamtluftmasse" SWORD Fact 1 100 -4.000000 3.999878 FORMAT "%8.6" ECU_ADDRESS 0x8FD272 /end MEASUREMENT
/begin MEASUREMENT AFSCD_rAirWgt1_mp "" SWORD Fact 1 100 -4.000000 3.999878 FORMAT "%8.6" ECU_ADDRESS 0x8FD274 /end MEASUREMENT
/begin MEASUREMENT AFSCD_rAirWgt2_mp "" SWORD Fact 1 100 -4.000000 3.999878 FORMAT "%8.6" ECU_ADDRESS 0x8FD276 /end MEASUREMENT
/begin MEASUREMENT AFSCD_rAirWgtLim1_mp "" SWORD Fact 1 100 -4.000000 3.999878 FORMAT "%8.6" ECU_ADDRESS 0x8FD278 /end MEASUREMENT
/begin MEASUREMENT AFSCD_rAirWgtLim2_mp "" SWORD Fact 1 100 -4.000000 3.999878 FORMAT "%8.6" ECU_ADDRESS 0x8FD27A /end MEASUREMENT
/begin MEASUREMENT AFSCD_stDebSRCAirm2_mp "Meßpunkt um den Wert des SRC vom Luftmassemesser 2 sichtbar zu machen" UBYTE OneToOne 1 100 0.00 255.0 FORMAT "%5.1" ECU_ADDRESS 0x8FD290 /end MEASUREMENT
/begin MEASUREMENT AFSCD_stDebSRCAirm_mp "Meßpunkt um den Wert des SRC vom Luftmassemesser sichtbar zu machen" UBYTE OneToOne 1 100 0.00 255.0 FORMAT "%5.1" ECU_ADDRESS 0x8FD2A8 /end MEASUREMENT
/begin MEASUREMENT AFSCD_stDrftComp "Statuswort der Driftkompensation" UBYTE OneToOne 1 100 0.00 255.0 FORMAT "%5.1" ECU_ADDRESS 0x7F87B6 /end MEASUREMENT
/begin MEASUREMENT AFSCD_stDrftMonRls "Teilfreigabe der Empfindlichkeitsdriftüberwachung" UBYTE OneToOne 1 100 0.00 255.0 FORMAT "%5.1" ECU_ADDRESS 0x7F87B7 /end MEASUREMENT
/begin MEASUREMENT AFSCD_stDrftMonRls_mp "Freigabestatus der Empfindlichkeitsdriftüberwachung" UBYTE OneToOne 1 100 0.00 255.0 FORMAT "%5.1" ECU_ADDRESS 0x8FD27C /end MEASUREMENT
/begin MEASUREMENT AFSCD_stErrAirm "Fehlerstatus des Sensorsignals (HFM6)" UWORD OneToOne 1 100 0.00 65535.00 FORMAT "%8.2" ECU_ADDRESS 0x7F8A8A /end MEASUREMENT
/begin MEASUREMENT AFSCD_stErrAirm2 "test" UWORD OneToOne 1 100 0.00 65535.00 FORMAT "%8.2" ECU_ADDRESS 0x7F8A8C /end MEASUREMENT
/begin MEASUREMENT AFSCD_stErrAirTemp "Fehlerstatus des Lufttemperatursignals" UWORD OneToOne 1 100 0.00 65535.00 FORMAT "%8.2" ECU_ADDRESS 0x7F8A86 /end MEASUREMENT
/begin MEASUREMENT AFSCD_stErrAirTemp2 "Errorstatus vom Lufttemperatur-Signal 2" UWORD OneToOne 1 100 0.00 65535.00 FORMAT "%8.2" ECU_ADDRESS 0x7F8A88 /end MEASUREMENT
/begin MEASUREMENT AFSCD_stOffsTst "Status 'Test beendet' der Plausibilitätsprüfung der Offsetdrift" UBYTE OneToOne 1 100 0.00 255.0 FORMAT "%5.1" ECU_ADDRESS 0x7F87B8 /end MEASUREMENT
/begin MEASUREMENT AFSCD_stOffsTst1 "Plausibilitaetstestabschlußstatus des Offsetdrifts (HFM1)" UBYTE OneToOne 1 100 0.00 255.0 FORMAT "%5.1" ECU_ADDRESS 0x7F87B9 /end MEASUREMENT
/begin MEASUREMENT AFSCD_stOffsTst2 "Status Offsetdrift Plausibilität (HFM 2)" UBYTE OneToOne 1 100 0.00 255.0 FORMAT "%5.1" ECU_ADDRESS 0x7F87BA /end MEASUREMENT
/begin MEASUREMENT AFSCD_stPlSetyDrft2_mp "Meßpunkt um den Statuswert der Plausibilitaetspruefung der Driftempfindlichkeit sichtbar zu machen" UBYTE OneToOne 1 100 0.00 255.0 FORMAT "%5.1" ECU_ADDRESS 0x8FD291 /end MEASUREMENT
/begin MEASUREMENT AFSCD_stPlSetyDrftRls_mp "Freigabestatus der Plausibilitätsprüfung der Empfindlichkeitsdrift" UBYTE OneToOne 1 100 0.00 255.0 FORMAT "%5.1" ECU_ADDRESS 0x8FD27D /end MEASUREMENT
/begin MEASUREMENT AFSCD_stPlSetyDrft_mp "Freigabestatus der Plausibilitätsprüfung der Empfindlichkeitsdrift" UBYTE OneToOne 1 100 0.00 255.0 FORMAT "%5.1" ECU_ADDRESS 0x8FD27E /end MEASUREMENT
/begin MEASUREMENT AFSCD_stSRCHiTstRls2_mp "Delay time after start for hfm sensor 2" UBYTE OneToOne 1 100 0.00 255.0 FORMAT "%5.1" ECU_ADDRESS 0x8FD292 /end MEASUREMENT
/begin MEASUREMENT AFSCD_stSRCHiTstRls_mp "Freigabestatus des SRC High des Sensorsignals" UBYTE OneToOne 1 100 0.00 255.0 FORMAT "%5.1" ECU_ADDRESS 0x8FD2A9 /end MEASUREMENT
/begin MEASUREMENT AFSCD_stSRCLoTstRls2_mp "state for SRC Low check release" UBYTE OneToOne 1 100 0.00 255.0 FORMAT "%5.1" ECU_ADDRESS 0x8FD293 /end MEASUREMENT
/begin MEASUREMENT AFSCD_stSRCLoTstRls_mp "Freigabestatus des SRC Low des Sensorsignals" UBYTE OneToOne 1 100 0.00 255.0 FORMAT "%5.1" ECU_ADDRESS 0x8FD2AA /end MEASUREMENT
/begin MEASUREMENT AFSCD_swtAirSys "Schalter fuer einzelnes/doppeltes Luftsystem" UBYTE OneToOne 1 100 0.00 255.0 FORMAT "%5.1" ECU_ADDRESS 0x7F87BB /end MEASUREMENT
/begin MEASUREMENT AFSCD_swtSensInst "Schalter zur Anzeige, ob der Luftmassensensor vorhanden ist oder nicht" UBYTE OneToOne 1 100 0.00 255.0 FORMAT "%5.1" ECU_ADDRESS 0x7F87BC /end MEASUREMENT
/begin MEASUREMENT AFSCD_swtSensInst2 "second switch to indicate whether the HFM sensor is installed or not in the system" UBYTE OneToOne 1 100 0.00 255.0 FORMAT "%5.1" ECU_ADDRESS 0x7F87BD /end MEASUREMENT
/begin MEASUREMENT AFSCD_tAir "Ansauglufttemperatur T1 am HFM" SWORD Temp_Cels 1 100 -50.140 899.860 FORMAT "%8.3" ECU_ADDRESS 0x7F8A8E /end MEASUREMENT
/begin MEASUREMENT AFSCD_tAir1 "Lufttemperatur vom HFM Sensor" SWORD Temp_Cels 1 100 -50.140 899.860 FORMAT "%8.3" ECU_ADDRESS 0x7F8A90 /end MEASUREMENT
/begin MEASUREMENT AFSCD_tAir2 "Lufttemperatur von HFM Sensor 2" SWORD Temp_Cels 1 100 -50.140 899.860 FORMAT "%8.3" ECU_ADDRESS 0x7F8A92 /end MEASUREMENT
/begin MEASUREMENT AFSCD_tAir2_mp "Meßpunkt der Lufttemperatur vom HFM Sensor 2" SWORD Temp_Cels 1 100 -50.140 899.860 FORMAT "%8.3" ECU_ADDRESS 0x8FD260 /end MEASUREMENT
/begin MEASUREMENT AFSCD_tAir_mp "linearisierte Ansauglufttemperatur T1 vor Fehlerbehandlung" SWORD Temp_Cels 1 100 -50.140 899.860 FORMAT "%8.3" ECU_ADDRESS 0x6F8000 /end MEASUREMENT
/begin MEASUREMENT AFSCD_tiRaw "Periodendauerrohwert des Luftmassensensors" SWORD Time_PwmHigh 1 100 -3276.800 3276.700 FORMAT "%8.3" ECU_ADDRESS 0x7F8A94 /end MEASUREMENT
/begin MEASUREMENT AFSCD_tiRaw2 "gemessene Luftmasse durch den zweiten HFM6 Sensor" SWORD Time_PwmHigh 1 100 -3276.800 3276.700 FORMAT "%8.3" ECU_ADDRESS 0x7F8A96 /end MEASUREMENT
/begin MEASUREMENT AFSCD_tiRawAvrgVal2_mp "Mittelwert vom aktuellne und vom letzten Wert des  Luftmassenrohsignals (sensor 2)" SWORD Time_PwmHigh 1 100 -3276.800 3276.700 FORMAT "%8.3" ECU_ADDRESS 0x8FD294 /end MEASUREMENT
/begin MEASUREMENT AFSCD_tiRawAvrgVal_mp "Mittelwert des aktuellen und letzten Periodendauerrohwerts des Luftmassensensors" SWORD Time_PwmHigh 1 100 -3276.800 3276.700 FORMAT "%8.3" ECU_ADDRESS 0x8FD2AC /end MEASUREMENT
/begin MEASUREMENT AFSCD_tiRawLast "last value of the raw air mass signal" SWORD Time_PwmHigh 1 100 -3276.800 3276.700 FORMAT "%8.3" ECU_ADDRESS 0x7F8A98 /end MEASUREMENT
/begin MEASUREMENT AFSCD_tiRawLast2 "Letzter Luftmassenrohwert von sensor2" SWORD Time_PwmHigh 1 100 -3276.800 3276.700 FORMAT "%8.3" ECU_ADDRESS 0x7F8A9A /end MEASUREMENT
/begin MEASUREMENT AFSCD_tiSwtOnCor2_mp "Timerwert der ""Einschaltkorrektur"" 2" UWORD Time_ms 1 100 0.00 655350.0 FORMAT "%8.1" ECU_ADDRESS 0x8FD296 /end MEASUREMENT
/begin MEASUREMENT AFSCD_tiSwtOnCor_mp "Timerwert der ""Einschaltkorrektur""" UWORD Time_ms 1 100 0.00 655350.0 FORMAT "%8.1" ECU_ADDRESS 0x8FD2AE /end MEASUREMENT
/begin MEASUREMENT AirbCD_st "Abschaltanforderungen für Airbag/Überrollbügel" UBYTE OneToOne 1 100 0.00 255.0 FORMAT "%5.1" ECU_ADDRESS 0x7F87D9 /end MEASUREMENT
/begin MEASUREMENT AirCtl_DKdAGR_mp "Grundwert der Verstärkung des DT1- Glieds bei Kleinsignalen abhängig von Luftmassensollwert mit AirStl_swtIn1DT1_C=1" SLONG Kd_Ampc2Prc 1 100 -4000.00000000 3999.99999814 FORMAT "%13.8" ECU_ADDRESS 0x8FD320 /end MEASUREMENT
/begin MEASUREMENT AirCtl_DKdNegAGR_mp "Grundwert der Verstärkung des DT1- Glieds bei negativen Großsignalen abhängig von Einspritzmenge mit AirCtl_swtIn1DT1_C=1" SWORD Kd_InjMass2PrcRedRes 1 100 -625.0000 624.9809 FORMAT "%8.4" ECU_ADDRESS 0x8FD324 /end MEASUREMENT
/begin MEASUREMENT AirCtl_DKdNegqDes_mp "negative Großsignalverstärkung der dyn. Sollwertbildung abhängig von Einspritzmenge mit AirCtl_swtInDT1_C=1" SWORD Kd_InjMass2AmpcRedRes 1 100 -640.0000 639.9805 FORMAT "%8.4" ECU_ADDRESS 0x8FD2B8 /end MEASUREMENT
/begin MEASUREMENT AirCtl_DKdNegRgn_mp "Grundwert der Verstärkung des DT1- Glieds bei negativen Großsignalen im Rgnbetreib mit AirCtl_swtIn1DT1_C=1" SWORD Kd_InjMass2PrcRedRes 1 100 -625.0000 624.9809 FORMAT "%8.4" ECU_ADDRESS 0x8FD39A /end MEASUREMENT
/begin MEASUREMENT AirCtl_DKdPosAGR_mp "Grundwert der Verstärkung des DT1- Glieds bei positiven Großsignalen abhängig von Einspritzmenge mit AirCtl_swtIn1DT1_C=1" SWORD Kd_InjMass2PrcRedRes 1 100 -625.0000 624.9809 FORMAT "%8.4" ECU_ADDRESS 0x8FD326 /end MEASUREMENT
/begin MEASUREMENT AirCtl_DKdPosqDes_mp "positive Großsignalverstärkung der dyn. Sollwertbildung abhängig von Einspritzmenge mit AirCtl_swtInDT1_C=1" SWORD Kd_InjMass2AmpcRedRes 1 100 -640.0000 639.9805 FORMAT "%8.4" ECU_ADDRESS 0x8FD2BA /end MEASUREMENT
/begin MEASUREMENT AirCtl_DKdPosRgn_mp "Grundwert der Verstärkung des DT1- Glieds im Regenerationsbetreib bei positiven Großsignalen mit AirCtl_swtIn1DT1_C=1" SWORD Kd_InjMass2PrcRedRes 1 100 -625.0000 624.9809 FORMAT "%8.4" ECU_ADDRESS 0x8FD39C /end MEASUREMENT
/begin MEASUREMENT AirCtl_DKdqDesCor_mp "Kleinsignalverstärkung der dyn. Sollwertbildung abhängig von Einspritzmenge mit AirCtl_swtInDT1_C=1" SLONG Kd 1 100 -32768.0000000 32767.9999847 FORMAT "%13.7" ECU_ADDRESS 0x8FD2BC /end MEASUREMENT
/begin MEASUREMENT AirCtl_DKdqDes_mp "Kleinsignalverstärkung der dyn. Sollwertbildung abhängig von Einspritzmenge mit AirCtl_swtInDT1_C=1" SLONG Kd 1 100 -32768.0000000 32767.9999847 FORMAT "%13.7" ECU_ADDRESS 0x8FD2C0 /end MEASUREMENT
/begin MEASUREMENT AirCtl_DKdRgn_mp "Grundwert der Verstärkung des DT1- Glieds bei Kleinsignalen abhängig von Luftmassensollwert in Rgn mit AirStl_swtIn1DT1_C=1" SLONG Kd_Ampc2Prc 1 100 -4000.00000000 3999.99999814 FORMAT "%13.8" ECU_ADDRESS 0x8FD3A0 /end MEASUREMENT
/begin MEASUREMENT AirCtl_dmDesCor "Einspritzmengegradient nach DT1 Glied" SWORD AirMassPerCyl 1 100 -3276.800 3276.700 FORMAT "%8.3" ECU_ADDRESS 0x7F8AFE /end MEASUREMENT
/begin MEASUREMENT AirCtl_dmDWinNegAGR_mp "untere Kleinsignalgrenze für das DT1- Glied abhängig von Einspritzmenge mit AirCtl_swtIn1DT1_C=1" SWORD AirMassPerCyl 1 100 -3276.800 3276.700 FORMAT "%8.3" ECU_ADDRESS 0x8FD328 /end MEASUREMENT
/begin MEASUREMENT AirCtl_dmDWinNegqDes_mp "untere Kleinsignalgrenze für das DT1- Glied abhängig von Luftmasse" SWORD AirMassPerCyl 1 100 -3276.800 3276.700 FORMAT "%8.3" ECU_ADDRESS 0x8FD2C4 /end MEASUREMENT
/begin MEASUREMENT AirCtl_dmDWinNegRgn_mp "untere Kleinsignalgrenze für das DT1- Glied abhängig von Einspritzmenge im regeneration mit AirCtl_swtIn1DT1_C=1" SWORD AirMassPerCyl 1 100 -3276.800 3276.700 FORMAT "%8.3" ECU_ADDRESS 0x8FD3A4 /end MEASUREMENT
/begin MEASUREMENT AirCtl_dmDWinPosAGR_mp "obere Kleinsignalgrenze für das DT1- Glied abhängig von Einspritzmenge mit AirCtl_swtIn1DT1_C=1" SWORD AirMassPerCyl 1 100 -3276.800 3276.700 FORMAT "%8.3" ECU_ADDRESS 0x8FD32A /end MEASUREMENT
/begin MEASUREMENT AirCtl_dmDWinPosqDes_mp "obere Kleinsignalgrenze für das DT1- Glied abhängig von Luftmasse" SWORD AirMassPerCyl 1 100 -3276.800 3276.700 FORMAT "%8.3" ECU_ADDRESS 0x8FD2C6 /end MEASUREMENT
/begin MEASUREMENT AirCtl_dmDWinPosRgn_mp "obere Kleinsignalgrenze für das DT1- Glied abhängig von Einspritzmenge im regeneration mit AirCtl_swtIn1DT1_C=1" SWORD AirMassPerCyl 1 100 -3276.800 3276.700 FORMAT "%8.3" ECU_ADDRESS 0x8FD3A6 /end MEASUREMENT
/begin MEASUREMENT AirCtl_dqSetUnBal_mp "Kraftstoffmassengradient ohne FBC" SWORD InjMassPerSec_20ms 1 100 -16384.00 16383.50 FORMAT "%8.2" ECU_ADDRESS 0x8FD2C8 /end MEASUREMENT
/begin MEASUREMENT AirCtl_facAPSmAirDynCor1_mp "Gewichtungsfaktor - abh. von Atmospaerendruck" SWORD Fact 1 100 -4.000000 3.999878 FORMAT "%8.6" ECU_ADDRESS 0x8FD2CA /end MEASUREMENT
/begin MEASUREMENT AirCtl_facATParAdDKd_mp "Air temperature correction factor for DT1 governor" SWORD Fact1 1 100 -256.0000 255.9922 FORMAT "%8.4" ECU_ADDRESS 0x8FD32C /end MEASUREMENT
/begin MEASUREMENT AirCtl_facATParAdIKi_mp "Air temperature correction factor for I" SWORD Fact1 1 100 -256.0000 255.9922 FORMAT "%8.4" ECU_ADDRESS 0x8FD32E /end MEASUREMENT
/begin MEASUREMENT AirCtl_facATParAdPKp_mp "Air temperature correction factor for P governor" SWORD Fact1 1 100 -256.0000 255.9922 FORMAT "%8.4" ECU_ADDRESS 0x8FD330 /end MEASUREMENT
/begin MEASUREMENT AirCtl_facDQmAirDynCor1_mp "Gewichtungsfaktor - abh. von Mengengradienten" SWORD Fact 1 100 -4.000000 3.999878 FORMAT "%8.6" ECU_ADDRESS 0x8FD2CC /end MEASUREMENT
/begin MEASUREMENT AirCtl_facEGRRgnCorr_mp "EGR-Regenerationskorrekturwert an den großen Höhen (multiplikativer Eingang 1)" SWORD Fact1 1 100 -256.0000 255.9922 FORMAT "%8.4" ECU_ADDRESS 0x8FD3A8 /end MEASUREMENT
/begin MEASUREMENT AirCtl_facETmAirDynCor1_mp "Gewichtungsfaktor - abh. von Motortemperatur" SWORD Fact 1 100 -4.000000 3.999878 FORMAT "%8.6" ECU_ADDRESS 0x8FD2CE /end MEASUREMENT
/begin MEASUREMENT AirCtl_facIATSmAirDynCor1_mp "Gewichtungsfaktor - abh. von Ansauglufttemperatur" SWORD Fact 1 100 -4.000000 3.999878 FORMAT "%8.6" ECU_ADDRESS 0x8FD2D0 /end MEASUREMENT
/begin MEASUREMENT AirCtl_facInjMass2Ampc_mp "Factor to convert from Kd_InjMass2Ampc to Kd resolution" SLONG OneToOne 1 100 -2147483648.00 2147483647.00 FORMAT "%13.2" ECU_ADDRESS 0x8FD2D4 /end MEASUREMENT
/begin MEASUREMENT AirCtl_facNQParAdDKd_mp "Base factor for parameter adaptation of DT1 governor" SWORD Fact1 1 100 -256.0000 255.9922 FORMAT "%8.4" ECU_ADDRESS 0x8FD332 /end MEASUREMENT
/begin MEASUREMENT AirCtl_facNQParAdIKi_mp "Base factor for parameter adaptation of I governor" SWORD Fact1 1 100 -256.0000 255.9922 FORMAT "%8.4" ECU_ADDRESS 0x8FD334 /end MEASUREMENT
/begin MEASUREMENT AirCtl_facNQParAdPKp_mp "Base factor for parameter adaptation of P governor" SWORD Fact1 1 100 -256.0000 255.9922 FORMAT "%8.4" ECU_ADDRESS 0x8FD336 /end MEASUREMENT
/begin MEASUREMENT AirCtl_facNQParRgnAdDKd_mp "Faktor für Parameteradaption in Abhängigkeit von Drehzahl und Einspritzmenge (D-Teil), im regeneartion modus" SWORD Fact1 1 100 -256.0000 255.9922 FORMAT "%8.4" ECU_ADDRESS 0x8FD338 /end MEASUREMENT
/begin MEASUREMENT AirCtl_facNQParRgnAdIKi_mp "Faktor für Parameteradaption in Abhängigkeit von Drehzahl und Einspritsmenge ( I-Teil ), im Regenerationmodus" SWORD Fact1 1 100 -256.0000 255.9922 FORMAT "%8.4" ECU_ADDRESS 0x8FD33A /end MEASUREMENT
/begin MEASUREMENT AirCtl_facNQParRgnAdPKp_mp "Faktor für Parameteradaption in Abhängigkeit von Drehzahl und Einspritzmenge ( P-Teil )" SWORD Fact1 1 100 -256.0000 255.9922 FORMAT "%8.4" ECU_ADDRESS 0x8FD33C /end MEASUREMENT
/begin MEASUREMENT AirCtl_facNQParRgn_mp "Faktor für Parameteradaptation in Regenerationsbetrieb" SWORD Fact1 1 100 -256.0000 255.9922 FORMAT "%8.4" ECU_ADDRESS 0x8FD3AA /end MEASUREMENT
/begin MEASUREMENT AirCtl_facParAdDKd_mp "Factor for parameter adaptation of DT1 governor" SWORD Fact1 1 100 -256.0000 255.9922 FORMAT "%8.4" ECU_ADDRESS 0x8FD33E /end MEASUREMENT
/begin MEASUREMENT AirCtl_facParAdIKi_mp "Factor for parameter adaptation of I governor" SWORD Fact1 1 100 -256.0000 255.9922 FORMAT "%8.4" ECU_ADDRESS 0x8FD340 /end MEASUREMENT
/begin MEASUREMENT AirCtl_facParAdPKp_mp "Factor for parameter adaptation of P governor" SWORD Fact1 1 100 -256.0000 255.9922 FORMAT "%8.4" ECU_ADDRESS 0x8FD342 /end MEASUREMENT
/begin MEASUREMENT AirCtl_facPresDiffCor_mp "Faktor für Parameteradaption über Differenzdruck Partikelfilter im Normalbetrieb" SWORD Fact1 1 100 -256.0000 255.9922 FORMAT "%8.4" ECU_ADDRESS 0x8FD3AC /end MEASUREMENT
/begin MEASUREMENT AirCtl_facTrmRgn_mp "Correction value in the regeneration operation from the EEPROM" SWORD Fact 1 100 -4.000000 3.999878 FORMAT "%8.6" ECU_ADDRESS 0x8FD2D8 /end MEASUREMENT
/begin MEASUREMENT AirCtl_mAirDynCor1_mp "Basiswert der dynamische Soll- LuftmassenKorrectur" SWORD AirMassPerCyl 1 100 -3276.800 3276.700 FORMAT "%8.3" ECU_ADDRESS 0x8FD2DA /end MEASUREMENT
/begin MEASUREMENT AirCtl_mAirDynCor_mp "Dynamische Korrektur für gewünschte Luftmasse" SWORD AirMassPerCyl 1 100 -3276.800 3276.700 FORMAT "%8.3" ECU_ADDRESS 0x8FD2DC /end MEASUREMENT
/begin MEASUREMENT AirCtl_mDesAdd1_mp "Messenpunkt für additiver AGR-Sollwert aus Gang" SWORD AirMassPerCyl 1 100 -3276.800 3276.700 FORMAT "%8.3" ECU_ADDRESS 0x8FD2DE /end MEASUREMENT
/begin MEASUREMENT AirCtl_mDesBas "ststionärer Basissollwert für ARF" SWORD AirMassPerCyl 1 100 -3276.800 3276.700 FORMAT "%8.3" ECU_ADDRESS 0x7F8B00 /end MEASUREMENT
/begin MEASUREMENT AirCtl_mDesBasCor_mp "stationaerer Sollwert mit Kuehlwassertemperaturkorrektur Basiskennfeld" SWORD AirMassPerCyl 1 100 -3276.800 3276.700 FORMAT "%8.3" ECU_ADDRESS 0x8FD2E0 /end MEASUREMENT
/begin MEASUREMENT AirCtl_mDesBasC_mp "stationärer Sollwert mit Kühlwassertemperaturkorrektur und Drehzahlkorrektur" SWORD AirMassPerCyl 1 100 -3276.800 3276.700 FORMAT "%8.3" ECU_ADDRESS 0x8FD2E2 /end MEASUREMENT
/begin MEASUREMENT AirCtl_mDesBasDef_mp "stationärer Sollwert fehlerBasiskennfeld" SWORD AirMassPerCyl 1 100 -3276.800 3276.700 FORMAT "%8.3" ECU_ADDRESS 0x8FD2E4 /end MEASUREMENT
/begin MEASUREMENT AirCtl_mDesBasP_mp "stationaerer Sollwert mit Atmosphaerendruckkompensation" SWORD AirMassPerCyl 1 100 -3276.800 3276.700 FORMAT "%8.3" ECU_ADDRESS 0x8FD2E6 /end MEASUREMENT
/begin MEASUREMENT AirCtl_mDesBasT_mp "stationaerer Sollwert mit Lufttemperaturkorectur Basiskennfeld" SWORD AirMassPerCyl 1 100 -3276.800 3276.700 FORMAT "%8.3" ECU_ADDRESS 0x8FD2E8 /end MEASUREMENT
/begin MEASUREMENT AirCtl_mDesBas_mp "gewählter stationärer Basissollwert für ARF" SWORD AirMassPerCyl 1 100 -3276.800 3276.700 FORMAT "%8.3" ECU_ADDRESS 0x8FD2EA /end MEASUREMENT
/begin MEASUREMENT AirCtl_mDesConv_mp "Kupplungs Korrekturwert" SWORD AirMassPerCyl 1 100 -3276.800 3276.700 FORMAT "%8.3" ECU_ADDRESS 0x8FD2EC /end MEASUREMENT
/begin MEASUREMENT AirCtl_mDesCor "korrigierter Luftmassensollwert nach Rampenschalter" SWORD AirMassPerCyl 1 100 -3276.800 3276.700 FORMAT "%8.3" ECU_ADDRESS 0x7F8B02 /end MEASUREMENT
/begin MEASUREMENT AirCtl_mDesDyn_mp "dynamischer Anteil des Luftmassensollwerts für Abgasrückführung" SWORD AirMassPerCyl 1 100 -3276.800 3276.700 FORMAT "%8.3" ECU_ADDRESS 0x8FD2EE /end MEASUREMENT
/begin MEASUREMENT AirCtl_mDesGearBas_mp " Ausgang von AirCtl_mDesGearBas_MAP" SWORD AirMassPerCyl 1 100 -3276.800 3276.700 FORMAT "%8.3" ECU_ADDRESS 0x8FD2F0 /end MEASUREMENT
/begin MEASUREMENT AirCtl_mDesGearCorr_mp "Korrektur AirCtl-Soll über Lenkwinkel" SWORD AirMassPerCyl 1 100 -3276.800 3276.700 FORMAT "%8.3" ECU_ADDRESS 0x8FD2F2 /end MEASUREMENT
/begin MEASUREMENT AirCtl_mDesGear_mp "Messpunkt für additiver AGR-Sollwert aus Gang" SWORD AirMassPerCyl 1 100 -3276.800 3276.700 FORMAT "%8.3" ECU_ADDRESS 0x8FD2F4 /end MEASUREMENT
/begin MEASUREMENT AirCtl_mDesLim_mp "Messpunkt für den Ausgangswert des Kennfeldes AirCtl_mDesLim_MAP" SWORD AirMassPerCyl 1 100 -3276.800 3276.700 FORMAT "%8.3" ECU_ADDRESS 0x8FD2F6 /end MEASUREMENT
/begin MEASUREMENT AirCtl_mDesRgn1Cor "stationärer Sollwert mit Lufttemperaturkorrektur Regenerationskennfeld 1" SWORD AirMassPerCyl 1 100 -3276.800 3276.700 FORMAT "%8.3" ECU_ADDRESS 0x7F8B04 /end MEASUREMENT
/begin MEASUREMENT AirCtl_mDesRgn1Cor_mp "stationaerer Sollwert mit Lufttemperaturkorrectur Regenerationskennfeld-1" SWORD AirMassPerCyl 1 100 -3276.800 3276.700 FORMAT "%8.3" ECU_ADDRESS 0x8FD2F8 /end MEASUREMENT
/begin MEASUREMENT AirCtl_mDesRgn1P_mp "stationaerer Sollwert mit Atmosphaerendruckkorrectur Regenerationskennfeld-1" SWORD AirMassPerCyl 1 100 -3276.800 3276.700 FORMAT "%8.3" ECU_ADDRESS 0x8FD2FA /end MEASUREMENT
/begin MEASUREMENT AirCtl_mDesRgn1_mp "stationaerer Sollwert aus Regenerationskennfeld-1" SWORD AirMassPerCyl 1 100 -3276.800 3276.700 FORMAT "%8.3" ECU_ADDRESS 0x8FD2FC /end MEASUREMENT
/begin MEASUREMENT AirCtl_mDesRgn2Cor "stationrer Sollwert mit Lufttemperaturkorrektur Regenerationskennfeld2" SWORD AirMassPerCyl 1 100 -3276.800 3276.700 FORMAT "%8.3" ECU_ADDRESS 0x7F8B06 /end MEASUREMENT
/begin MEASUREMENT AirCtl_mDesRgn2Cor_mp "stationaerer Solwert mit Lufttemperaturkorrectur Regenerationskennfeld-2" SWORD AirMassPerCyl 1 100 -3276.800 3276.700 FORMAT "%8.3" ECU_ADDRESS 0x8FD2FE /end MEASUREMENT
/begin MEASUREMENT AirCtl_mDesRgn2P_mp "stationaerer sollwert mit Atmosphaendruckkorrektur regenerationskennfeld-2" SWORD AirMassPerCyl 1 100 -3276.800 3276.700 FORMAT "%8.3" ECU_ADDRESS 0x8FD300 /end MEASUREMENT
/begin MEASUREMENT AirCtl_mDesRgn2_mp "stationaerer Sollwert aus Regenerationskennfeld-2" SWORD AirMassPerCyl 1 100 -3276.800 3276.700 FORMAT "%8.3" ECU_ADDRESS 0x8FD302 /end MEASUREMENT
/begin MEASUREMENT AirCtl_mDesRgn3Cor "" SWORD AirMassPerCyl 1 100 -3276.800 3276.700 FORMAT "%8.3" ECU_ADDRESS 0x7F8B08 /end MEASUREMENT
/begin MEASUREMENT AirCtl_mDesRgn3Cor_mp "Regeneration-3 value after airmass setpoint corection" SWORD AirMassPerCyl 1 100 -3276.800 3276.700 FORMAT "%8.3" ECU_ADDRESS 0x8FD304 /end MEASUREMENT
/begin MEASUREMENT AirCtl_mDesRgn3P_mp "" SWORD AirMassPerCyl 1 100 -3276.800 3276.700 FORMAT "%8.3" ECU_ADDRESS 0x8FD306 /end MEASUREMENT
/begin MEASUREMENT AirCtl_mDesRgn3_mp "Luftmassensollwert im Regenerationsbetrieb 3" SWORD AirMassPerCyl 1 100 -3276.800 3276.700 FORMAT "%8.3" ECU_ADDRESS 0x8FD308 /end MEASUREMENT
/begin MEASUREMENT AirCtl_mDesRmpRaw_mp "Eingang der kennlinie AirCtl_mDesRmp_CUR" SWORD AirMassPerCyl 1 100 -3276.800 3276.700 FORMAT "%8.3" ECU_ADDRESS 0x8FD30A /end MEASUREMENT
/begin MEASUREMENT AirCtl_mDesRmp_mp "Ausgang der kennlinie AirCtl_mDesRmp_CUR" SWORD AirMassPerCyl 1 100 -3276.800 3276.700 FORMAT "%8.3" ECU_ADDRESS 0x8FD30C /end MEASUREMENT
/begin MEASUREMENT AirCtl_mDesStat "Stationärer Luftmasse Setpointwert" SWORD AirMassPerCyl 1 100 -3276.800 3276.700 FORMAT "%8.3" ECU_ADDRESS 0x7F8B0A /end MEASUREMENT
/begin MEASUREMENT AirCtl_mDesStatRmp_mp "Ramped Stationärer Luftmasse Setpointwert" SWORD AirMassPerCyl 1 100 -3276.800 3276.700 FORMAT "%8.3" ECU_ADDRESS 0x8FD30E /end MEASUREMENT
/begin MEASUREMENT AirCtl_mDesTrm_mp "stationaerer Sollwert mit Abgleich" SWORD AirMassPerCyl 1 100 -3276.800 3276.700 FORMAT "%8.3" ECU_ADDRESS 0x8FD310 /end MEASUREMENT
/begin MEASUREMENT AirCtl_mDesVal "Luftmassensollwert" SWORD AirMassPerCyl 1 100 -3276.800 3276.700 FORMAT "%8.3" ECU_ADDRESS 0x7F8B0C /end MEASUREMENT
/begin MEASUREMENT AirCtl_mDesValByp_mp "Bypass-Label, Kopie von AirCtl_mDesVal" SWORD AirMassPerCyl 1 100 -3276.800 3276.700 FORMAT "%8.3" ECU_ADDRESS 0x8FD312 /end MEASUREMENT
/begin MEASUREMENT AirCtl_mDesValUnLim_mp "" SWORD AirMassPerCyl 1 100 -3276.800 3276.700 FORMAT "%8.3" ECU_ADDRESS 0x8FD314 /end MEASUREMENT
/begin MEASUREMENT AirCtl_mDesVal_mp "Ausgang Rampenschalter" SWORD AirMassPerCyl 1 100 -3276.800 3276.700 FORMAT "%8.3" ECU_ADDRESS 0x8FD316 /end MEASUREMENT
/begin MEASUREMENT AirCtl_mGvnrDvt "Regelabweichung" SWORD AirMassPerCyl 1 100 -3276.800 3276.700 FORMAT "%8.3" ECU_ADDRESS 0x7F8B0E /end MEASUREMENT
/begin MEASUREMENT AirCtl_mGvnrDvt1_mp "Meßpunkt von der Regelabweichung" SWORD AirMassPerCyl 1 100 -3276.800 3276.700 FORMAT "%8.3" ECU_ADDRESS 0x8FD344 /end MEASUREMENT
/begin MEASUREMENT AirCtl_mGvnrDvt2 "Regelabweichung 2" SWORD AirMassPerCyl 1 100 -3276.800 3276.700 FORMAT "%8.3" ECU_ADDRESS 0x7F8B10 /end MEASUREMENT
/begin MEASUREMENT AirCtl_mGvnrDvtBase_mp "Governer deviation base" SWORD AirMassPerCyl 1 100 -3276.800 3276.700 FORMAT "%8.3" ECU_ADDRESS 0x8FD346 /end MEASUREMENT
/begin MEASUREMENT AirCtl_mGvnrDvtFlt "gefiltert Luftmassendifferenz" SWORD AirMassPerCyl 1 100 -3276.800 3276.700 FORMAT "%8.3" ECU_ADDRESS 0x7F8B12 /end MEASUREMENT
/begin MEASUREMENT AirCtl_mGvnrDvtFlt1_mp "gefiltert Luftmassendifferenz im zwei Luftsystemenfalle" SWORD AirMassPerCyl 1 100 -3276.800 3276.700 FORMAT "%8.3" ECU_ADDRESS 0x8FD348 /end MEASUREMENT
/begin MEASUREMENT AirCtl_mGvnrDvtFlt2_mp "gefiltert Luftmassendifferenz im zwei Luftsystemenfalle" SWORD AirMassPerCyl 1 100 -3276.800 3276.700 FORMAT "%8.3" ECU_ADDRESS 0x8FD34A /end MEASUREMENT
/begin MEASUREMENT AirCtl_mLi_mp "Meßpunkt nach Timer" SWORD AirMassPerCyl 1 100 -3276.800 3276.700 FORMAT "%8.3" ECU_ADDRESS 0x8FD318 /end MEASUREMENT
/begin MEASUREMENT AirCtl_mMaxDvt "Obergrenze für Erkennung einer bleibenden Regelabweichung" SWORD AirMassPerCyl 1 100 -3276.800 3276.700 FORMAT "%8.3" ECU_ADDRESS 0x7F8B14 /end MEASUREMENT
/begin MEASUREMENT AirCtl_mMinDvt "Untergrenze für Erkennung einer bleibenden Regelabweichung" SWORD AirMassPerCyl 1 100 -3276.800 3276.700 FORMAT "%8.3" ECU_ADDRESS 0x7F8B16 /end MEASUREMENT
/begin MEASUREMENT AirCtl_qCurrCor "Aktuelle Einspritzmenge" SWORD InjMassCyc 1 100 -327.6800 327.6700 FORMAT "%8.4" ECU_ADDRESS 0x7F8B18 /end MEASUREMENT
/begin MEASUREMENT AirCtl_qDesLim_mp "Eingang des Luftmassenbegrenzungskennfeldes" SWORD InjMassCyc 1 100 -327.6800 327.6700 FORMAT "%8.4" ECU_ADDRESS 0x8FD31A /end MEASUREMENT
/begin MEASUREMENT AirCtl_rBelCtl2_mp "Hinzufügung Faktor für den Vorsteuerung Wert fuer PI-Regler 2" SWORD Prc 1 100 -400.0000 399.9878 FORMAT "%8.4" ECU_ADDRESS 0x8FD34C /end MEASUREMENT
/begin MEASUREMENT AirCtl_rBelCtl_mp "Hinzufügung Faktor für den Vorsteuerung Wert fuer PI-Regler 1" SWORD Prc 1 100 -400.0000 399.9878 FORMAT "%8.4" ECU_ADDRESS 0x8FD34E /end MEASUREMENT
/begin MEASUREMENT AirCtl_rCtlVal "stationärer Steueranteil der Stellgröße" SWORD Prc 1 100 -400.0000 399.9878 FORMAT "%8.4" ECU_ADDRESS 0x7F8B1A /end MEASUREMENT
/begin MEASUREMENT AirCtl_rCtlValRgn_mp "Vorsteuerwert Luftmassenregler im Regenerationsbetrieb Drosselklappe" SWORD Prc 1 100 -400.0000 399.9878 FORMAT "%8.4" ECU_ADDRESS 0x8FD2B0 /end MEASUREMENT
/begin MEASUREMENT AirCtl_rCtlVal_mp "Ausgang Rampenschalter" SWORD Prc 1 100 -400.0000 399.9878 FORMAT "%8.4" ECU_ADDRESS 0x8FD2B2 /end MEASUREMENT
/begin MEASUREMENT AirCtl_rDiffDynMin_mp "Schwelle Aktivierung dynamische" SWORD Prc 1 100 -400.0000 399.9878 FORMAT "%8.4" ECU_ADDRESS 0x8FD350 /end MEASUREMENT
/begin MEASUREMENT AirCtl_rDynMinNrm_mp "Dynamische Begrenzung 2 bei Normalbetrieb - AirCtl" SWORD Prc 1 100 -400.0000 399.9878 FORMAT "%8.4" ECU_ADDRESS 0x8FD352 /end MEASUREMENT
/begin MEASUREMENT AirCtl_rDynMinRgn_mp "Dynamische Begrenzung 2 bei Regeneration - AirCtl" SWORD Prc 1 100 -400.0000 399.9878 FORMAT "%8.4" ECU_ADDRESS 0x8FD354 /end MEASUREMENT
/begin MEASUREMENT AirCtl_rDynMin_mp "Dynamische Begrenzung 2 - AirCtl" SWORD Prc 1 100 -400.0000 399.9878 FORMAT "%8.4" ECU_ADDRESS 0x8FD356 /end MEASUREMENT
/begin MEASUREMENT AirCtl_rDynRmp1_mp "additive Rampe 1 dynam. Begrenzung 2" SWORD Prc 1 100 -400.0000 399.9878 FORMAT "%8.4" ECU_ADDRESS 0x8FD358 /end MEASUREMENT
/begin MEASUREMENT AirCtl_rDynRmp2_mp "additive Rampe 2 dynam. Begrenzung 2" SWORD Prc 1 100 -400.0000 399.9878 FORMAT "%8.4" ECU_ADDRESS 0x8FD35A /end MEASUREMENT
/begin MEASUREMENT AirCtl_rDynRmp_mp "additive Rampe gesamt - dynam. Begrenzung 2" SWORD Prc 1 100 -400.0000 399.9878 FORMAT "%8.4" ECU_ADDRESS 0x8FD35C /end MEASUREMENT
/begin MEASUREMENT AirCtl_rEGR "Stellgröße für das ARF-Ventil" SWORD Prc 1 100 -400.0000 399.9878 FORMAT "%8.4" ECU_ADDRESS 0x7F8B1C /end MEASUREMENT
/begin MEASUREMENT AirCtl_rEGR2 "Stellwert 2 für Abgasregelung" SWORD Prc 1 100 -400.0000 399.9878 FORMAT "%8.4" ECU_ADDRESS 0x7F8B1E /end MEASUREMENT
/begin MEASUREMENT AirCtl_rEGRCtlAPSCor_mp "Atmosphärendruck-Korrekturwert des Tastverhältnisses für EGR" SWORD Prc 1 100 -400.0000 399.9878 FORMAT "%8.4" ECU_ADDRESS 0x8FD35E /end MEASUREMENT
/begin MEASUREMENT AirCtl_rEGRCtlATCor_mp "Ansauglufttemperatur-Korrekturwert des Tastverhältnisses für EGR" SWORD Prc 1 100 -400.0000 399.9878 FORMAT "%8.4" ECU_ADDRESS 0x8FD360 /end MEASUREMENT
/begin MEASUREMENT AirCtl_rEGRCtlBas_mp "Grundwert des Tastverhältnisses für EGR" SWORD Prc 1 100 -400.0000 399.9878 FORMAT "%8.4" ECU_ADDRESS 0x8FD362 /end MEASUREMENT
/begin MEASUREMENT AirCtl_rEGRCtlCTCor_mp "Kühlmitteltemperatur-Korrekturwert des Tastverhältnisses für EGR" SWORD Prc 1 100 -400.0000 399.9878 FORMAT "%8.4" ECU_ADDRESS 0x8FD364 /end MEASUREMENT
/begin MEASUREMENT AirCtl_rEGRCtl_mp "Tastverhältnis EGR im gesteuerten Betrieb" SWORD Prc 1 100 -400.0000 399.9878 FORMAT "%8.4" ECU_ADDRESS 0x8FD366 /end MEASUREMENT
/begin MEASUREMENT AirCtl_rEGRNrmRgn2_mp "Stellgröße für das ARF-Ventil im Übergang von Normal- nach Regenerationsbetrieb" SWORD Prc 1 100 -400.0000 399.9878 FORMAT "%8.4" ECU_ADDRESS 0x8FD3AE /end MEASUREMENT
/begin MEASUREMENT AirCtl_rEGRNrmRgn_mp "Stellgröße für das ARF-Ventil im Übergang von Normal- nach Regenerationsbetrieb" SWORD Prc 1 100 -400.0000 399.9878 FORMAT "%8.4" ECU_ADDRESS 0x8FD3B0 /end MEASUREMENT
/begin MEASUREMENT AirCtl_rEGRRgn2_mp "EGR-RegenerationskorrekturDIAGRAMM an den großen Höhen für zwei Luftdurchflußsysteme" SWORD Prc 1 100 -400.0000 399.9878 FORMAT "%8.4" ECU_ADDRESS 0x8FD3B2 /end MEASUREMENT
/begin MEASUREMENT AirCtl_rEGRRgnCorrM_mp "EGR-Regenerationskorrekturwert an den großen Höhen (multiplikativer Eingang 2)" SWORD Prc 1 100 -400.0000 399.9878 FORMAT "%8.4" ECU_ADDRESS 0x8FD3B4 /end MEASUREMENT
/begin MEASUREMENT AirCtl_rEGRRgnCorr_mp "Abschließender EGR-Regenerationskorrekturwert an den großen Höhen" SWORD Prc 1 100 -400.0000 399.9878 FORMAT "%8.4" ECU_ADDRESS 0x8FD3B6 /end MEASUREMENT
/begin MEASUREMENT AirCtl_rEGRRgnNrm2_mp "Stellgröße für ARF-Ventil im Übergang von Regenerations- zum Normalbetrieb" SWORD Prc 1 100 -400.0000 399.9878 FORMAT "%8.4" ECU_ADDRESS 0x8FD3B8 /end MEASUREMENT
/begin MEASUREMENT AirCtl_rEGRRgnNrm_mp "Stellgröße für ARF-Ventil im Übergang von Regenerations- zum Normalbetrieb" SWORD Prc 1 100 -400.0000 399.9878 FORMAT "%8.4" ECU_ADDRESS 0x8FD3BA /end MEASUREMENT
/begin MEASUREMENT AirCtl_rEGRRgnVal2_mp "Stellgröße für ARF- Ventil im Regenerationsbetrieb" SWORD Prc 1 100 -400.0000 399.9878 FORMAT "%8.4" ECU_ADDRESS 0x8FD3BC /end MEASUREMENT
/begin MEASUREMENT AirCtl_rEGRRgnVal_mp "Stellgröße für ARF- Ventil im Regenerationsbetrieb" SWORD Prc 1 100 -400.0000 399.9878 FORMAT "%8.4" ECU_ADDRESS 0x8FD3BE /end MEASUREMENT
/begin MEASUREMENT AirCtl_rEGRRgn_mp "% opening of the EGR valve for regeneration operation" SWORD Prc 1 100 -400.0000 399.9878 FORMAT "%8.4" ECU_ADDRESS 0x8FD3C0 /end MEASUREMENT
/begin MEASUREMENT AirCtl_rGvnr2_mp "Unbegrenzt Steueranteil der Stellgröße fuer PI-Regler 2" SWORD Prc 1 100 -400.0000 399.9878 FORMAT "%8.4" ECU_ADDRESS 0x8FD368 /end MEASUREMENT
/begin MEASUREMENT AirCtl_rGvnrCalc2_mp "aus der Stellgröße für das ARF-Ventil rückgerechneter Reglerausgang" SWORD Prc 1 100 -400.0000 399.9878 FORMAT "%8.4" ECU_ADDRESS 0x8FD3C2 /end MEASUREMENT
/begin MEASUREMENT AirCtl_rGvnrCalc_mp "aus der Stellgröße für das ARF-Ventil rückgerechneter Reglerausgang" SWORD Prc 1 100 -400.0000 399.9878 FORMAT "%8.4" ECU_ADDRESS 0x8FD3C4 /end MEASUREMENT
/begin MEASUREMENT AirCtl_rGvnrDvtNrm "normierte Regelabweichung" SWORD Prc 1 100 -400.0000 399.9878 FORMAT "%8.4" ECU_ADDRESS 0x7F8B20 /end MEASUREMENT
/begin MEASUREMENT AirCtl_rGvnrDynMin2_mp "Dynamische Begrenzung 2 gerampt - AirCtl" SWORD Prc 1 100 -400.0000 399.9878 FORMAT "%8.4" ECU_ADDRESS 0x8FD36A /end MEASUREMENT
/begin MEASUREMENT AirCtl_rGvnrDynMinNrm_mp "minimal zulässige Reglerstellgröße dynam. Begrenzung 2 während Normalbetrieb" SWORD Prc 1 100 -400.0000 399.9878 FORMAT "%8.4" ECU_ADDRESS 0x8FD36C /end MEASUREMENT
/begin MEASUREMENT AirCtl_rGvnrDynMinRgn_mp "minimal zulässige Reglerstellgröße dynam. Begrenzung 2 während Regeneration" SWORD Prc 1 100 -400.0000 399.9878 FORMAT "%8.4" ECU_ADDRESS 0x8FD36E /end MEASUREMENT
/begin MEASUREMENT AirCtl_rGvnrDynMin_mp "minimal zulässige Reglerstellgröße dynam." SWORD Prc 1 100 -400.0000 399.9878 FORMAT "%8.4" ECU_ADDRESS 0x8FD370 /end MEASUREMENT
/begin MEASUREMENT AirCtl_rGvnrEGR "Reglerstellgröße für Abgasrückführventil (Positionssollwert)" SWORD Prc 1 100 -400.0000 399.9878 FORMAT "%8.4" ECU_ADDRESS 0x7F8B22 /end MEASUREMENT
/begin MEASUREMENT AirCtl_rGvnrEGR2 "Governor output2 of EGR ratio" SWORD Prc 1 100 -400.0000 399.9878 FORMAT "%8.4" ECU_ADDRESS 0x7F8B24 /end MEASUREMENT
/begin MEASUREMENT AirCtl_rGvnrMinDyn1_mp "minimal zulässige Reglerstellgröße dynam." SWORD Prc 1 100 -400.0000 399.9878 FORMAT "%8.4" ECU_ADDRESS 0x8FD372 /end MEASUREMENT
/begin MEASUREMENT AirCtl_rGvnrMin_mp "minimal zulässige Reglerstellgröße AirCtl-Gov" SWORD Prc 1 100 -400.0000 399.9878 FORMAT "%8.4" ECU_ADDRESS 0x8FD374 /end MEASUREMENT
/begin MEASUREMENT AirCtl_rGvnrTVA "Reglerstellgröße für Drosselklappe (Positionssollwert)" SWORD Prc 1 100 -400.0000 399.9878 FORMAT "%8.4" ECU_ADDRESS 0x7F8B26 /end MEASUREMENT
/begin MEASUREMENT AirCtl_rGvnrTVA2 "Governor output2 of TVA ratio" SWORD Prc 1 100 -400.0000 399.9878 FORMAT "%8.4" ECU_ADDRESS 0x7F8B28 /end MEASUREMENT
/begin MEASUREMENT AirCtl_rGvnr_mp "Unbegrenzt Steueranteil der Stellgröße fuer PI-Regler 1" SWORD Prc 1 100 -400.0000 399.9878 FORMAT "%8.4" ECU_ADDRESS 0x8FD376 /end MEASUREMENT
/begin MEASUREMENT AirCtl_rOutD_mp "dynamisches Steuersignal - Ausgang DT1-Glied" SWORD Prc 1 100 -400.0000 399.9878 FORMAT "%8.4" ECU_ADDRESS 0x8FD378 /end MEASUREMENT
/begin MEASUREMENT AirCtl_rOutGvnr2_mp "zweiter Reglerausgang (Regler Korrektur Variable)" SWORD Prc 1 100 -400.0000 399.9878 FORMAT "%8.4" ECU_ADDRESS 0x8FD37A /end MEASUREMENT
/begin MEASUREMENT AirCtl_rOutGvnr_mp "Reglerausgang (Regler Korrektur Variable)" SWORD Prc 1 100 -400.0000 399.9878 FORMAT "%8.4" ECU_ADDRESS 0x8FD37C /end MEASUREMENT
/begin MEASUREMENT AirCtl_rOutI2_mp "Ausgang I-Regler2" SWORD Prc 1 100 -400.0000 399.9878 FORMAT "%8.4" ECU_ADDRESS 0x8FD37E /end MEASUREMENT
/begin MEASUREMENT AirCtl_rOutI_mp "Ausgang des Regler-I-Kanals bei der ARF" SWORD Prc 1 100 -400.0000 399.9878 FORMAT "%8.4" ECU_ADDRESS 0x8FD380 /end MEASUREMENT
/begin MEASUREMENT AirCtl_rOutP2_mp "Ausgang P-Regler 2" SWORD Prc 1 100 -400.0000 399.9878 FORMAT "%8.4" ECU_ADDRESS 0x8FD382 /end MEASUREMENT
/begin MEASUREMENT AirCtl_rOutPI2_mp "unbegrenzter Ausgang PI-Regler Luftstrang 2" SWORD Prc 1 100 -400.0000 399.9878 FORMAT "%8.4" ECU_ADDRESS 0x8FD384 /end MEASUREMENT
/begin MEASUREMENT AirCtl_rOutPI_mp "PI Ausgang des Luftreglers" SWORD Prc 1 100 -400.0000 399.9878 FORMAT "%8.4" ECU_ADDRESS 0x8FD386 /end MEASUREMENT
/begin MEASUREMENT AirCtl_rOutP_mp "Ausgang des Regler-P-Kanals bei der ARF" SWORD Prc 1 100 -400.0000 399.9878 FORMAT "%8.4" ECU_ADDRESS 0x8FD388 /end MEASUREMENT
/begin MEASUREMENT AirCtl_rOut_mp "Reglerausgang" SWORD Prc 1 100 -400.0000 399.9878 FORMAT "%8.4" ECU_ADDRESS 0x8FD38A /end MEASUREMENT
/begin MEASUREMENT AirCtl_rPCRCtl_mp "Differenz PCR-Reglerausgang zu PCRSteuerwert" SWORD Prc 1 100 -400.0000 399.9878 FORMAT "%8.4" ECU_ADDRESS 0x8FD38C /end MEASUREMENT
/begin MEASUREMENT AirCtl_rPICtl2_mp "Ausgang PI-Regler+Steuerwert Luftstrang 2" SWORD Prc 1 100 -400.0000 399.9878 FORMAT "%8.4" ECU_ADDRESS 0x8FD38E /end MEASUREMENT
/begin MEASUREMENT AirCtl_rPICtl_mp "Ausgang PI-Regler+Steuerwert Luftstrang 1" SWORD Prc 1 100 -400.0000 399.9878 FORMAT "%8.4" ECU_ADDRESS 0x8FD390 /end MEASUREMENT
/begin MEASUREMENT AirCtl_rPreCtlVal2_mp "Begrenzt Steueranteil der Stellgröße fuer PI-Regler 2" SWORD Prc 1 100 -400.0000 399.9878 FORMAT "%8.4" ECU_ADDRESS 0x8FD392 /end MEASUREMENT
/begin MEASUREMENT AirCtl_rPreCtlVal_mp "Begrenzt Steueranteil der Stellgröße fuer PI-Regler 1" SWORD Prc 1 100 -400.0000 399.9878 FORMAT "%8.4" ECU_ADDRESS 0x8FD394 /end MEASUREMENT
/begin MEASUREMENT AirCtl_rRgnBgnInit2_mp "Initialisierungswert für Regler-I-Anteil bei Regenerationsbeginn" SWORD Prc 1 100 -400.0000 399.9878 FORMAT "%8.4" ECU_ADDRESS 0x8FD3C6 /end MEASUREMENT
/begin MEASUREMENT AirCtl_rRgnBgnInit_mp "Initialisierungswert für Regler-I-Anteil bei Regenerationsbeginn" SWORD Prc 1 100 -400.0000 399.9878 FORMAT "%8.4" ECU_ADDRESS 0x8FD3C8 /end MEASUREMENT
/begin MEASUREMENT AirCtl_rRgnEndInit2_mp "Initialisierungswert für Regler-I-Anteil bei Regenerationsende" SWORD Prc 1 100 -400.0000 399.9878 FORMAT "%8.4" ECU_ADDRESS 0x8FD3CA /end MEASUREMENT
/begin MEASUREMENT AirCtl_rRgnEndInit_mp "Initialisierungswert für Regler-I-Anteil bei Regenerationsende" SWORD Prc 1 100 -400.0000 399.9878 FORMAT "%8.4" ECU_ADDRESS 0x8FD3CC /end MEASUREMENT
/begin MEASUREMENT AirCtl_rTVA "Sollposition des Regelklappen-Stellers" SWORD Prc 1 100 -400.0000 399.9878 FORMAT "%8.4" ECU_ADDRESS 0x7F8B2A /end MEASUREMENT
/begin MEASUREMENT AirCtl_rTVA2 "Verhältnis von TVA2" SWORD Prc 1 100 -400.0000 399.9878 FORMAT "%8.4" ECU_ADDRESS 0x7F8B2C /end MEASUREMENT
/begin MEASUREMENT AirCtl_rTVACtlAPSCor_mp "Atmosphärendruck-Korrekturwert des Tastverhältnisses für TVA" SWORD Prc 1 100 -400.0000 399.9878 FORMAT "%8.4" ECU_ADDRESS 0x8FD3CE /end MEASUREMENT
/begin MEASUREMENT AirCtl_rTVACtlATCor_mp "Ansauglufttemperatur-Korrekturwert des Tastverhältnisses für TVA" SWORD Prc 1 100 -400.0000 399.9878 FORMAT "%8.4" ECU_ADDRESS 0x8FD3D0 /end MEASUREMENT
/begin MEASUREMENT AirCtl_rTVACtlBas_mp "Grundwert des Tastverhältnisses für TVA" SWORD Prc 1 100 -400.0000 399.9878 FORMAT "%8.4" ECU_ADDRESS 0x8FD3D2 /end MEASUREMENT
/begin MEASUREMENT AirCtl_rTVACtlCTCor_mp "Kühlmitteltemperatur-Korrekturwert des Tastverhältnisses für TVA" SWORD Prc 1 100 -400.0000 399.9878 FORMAT "%8.4" ECU_ADDRESS 0x8FD3D4 /end MEASUREMENT
/begin MEASUREMENT AirCtl_rTVACtl_mp "Tastverhältnis TVA im gesteuerten Betrieb" SWORD Prc 1 100 -400.0000 399.9878 FORMAT "%8.4" ECU_ADDRESS 0x8FD3D6 /end MEASUREMENT
/begin MEASUREMENT AirCtl_rTVARgnVal2_mp "Stellgröße für die Drosselklappe im Regenerationsbetrieb" SWORD Prc 1 100 -400.0000 399.9878 FORMAT "%8.4" ECU_ADDRESS 0x8FD3D8 /end MEASUREMENT
/begin MEASUREMENT AirCtl_rTVARgnVal_mp "Stellgröße für die Drosselklappe im Regenerationsbetrieb" SWORD Prc 1 100 -400.0000 399.9878 FORMAT "%8.4" ECU_ADDRESS 0x8FD3DA /end MEASUREMENT
/begin MEASUREMENT AirCtl_stAirCtl "Anzeige der Abschaltursache in der ARF-Überwachung" UBYTE OneToOne 1 100 0.00 255.0 FORMAT "%5.1" ECU_ADDRESS 0x7F87CF /end MEASUREMENT
/begin MEASUREMENT AirCtl_stAirCtlBits "Bitorientierte Anzeige aller Abschaltursachen" ULONG OneToOne 1 100 0.00 4294967295.00 FORMAT "%13.2" ECU_ADDRESS 0x7F9338 /end MEASUREMENT
/begin MEASUREMENT AirCtl_stAirCtlDfl8Sel_mp "Messpunkt für die Auswahl des Initialisierungswertes im Abschaltfall (2 = Regenerationswert, 1 = Pumpwert, 0 = Normalwert)" UBYTE OneToOne 1 100 0.00 255.0 FORMAT "%5.1" ECU_ADDRESS 0x8FD396 /end MEASUREMENT
/begin MEASUREMENT AirCtl_stAirDyn "Aktivierung dynamische Begrenzung 1" UBYTE OneToOne 1 100 0.00 255.0 FORMAT "%5.1" ECU_ADDRESS 0x7F87D0 /end MEASUREMENT
/begin MEASUREMENT AirCtl_stDyn_mp "Status dynamische Begrenzung 2" UBYTE OneToOne 1 100 0.00 255.0 FORMAT "%5.1" ECU_ADDRESS 0x8FD397 /end MEASUREMENT
/begin MEASUREMENT AirCtl_stEGT "Statusbyte des Regenerationseingriffes" UBYTE OneToOne 1 100 0.00 255.0 FORMAT "%5.1" ECU_ADDRESS 0x7F87D1 /end MEASUREMENT
/begin MEASUREMENT AirCtl_stEGT_mp "Statusbyte des Regenerationseingriffs" UBYTE OneToOne 1 100 0.00 255.0 FORMAT "%5.1" ECU_ADDRESS 0x8FD31C /end MEASUREMENT
/begin MEASUREMENT AirCtl_stGvnr "Statusbitleiste für Zustand des Luftmassenreglers" UBYTE OneToOne 1 100 0.00 255.0 FORMAT "%5.1" ECU_ADDRESS 0x7F87D2 /end MEASUREMENT
/begin MEASUREMENT AirCtl_stGvnrMin_mp "Umschaltung dynamische Begrenzung" UBYTE OneToOne 1 100 0.00 255.0 FORMAT "%5.1" ECU_ADDRESS 0x8FD398 /end MEASUREMENT
/begin MEASUREMENT AirCtl_stMonitor "Status: Abschaltfall der Regelung" UBYTE OneToOne 1 100 0.00 255.0 FORMAT "%5.1" ECU_ADDRESS 0x7F87D3 /end MEASUREMENT
/begin MEASUREMENT AirCtl_stRgnDes_mp "Statusbit für Regenerationswunsch" UBYTE OneToOne 1 100 0.00 255.0 FORMAT "%5.1" ECU_ADDRESS 0x8FD3DC /end MEASUREMENT
/begin MEASUREMENT AirCtl_swtAPSCor "Schalter für add./mult. Atmosphärendruckkorrektur" UBYTE OneToOne 1 100 0.00 255.0 FORMAT "%5.1" ECU_ADDRESS 0x7F87D4 /end MEASUREMENT
/begin MEASUREMENT AirCtl_swtGvnr "Schalter für Reglerabschaltung" UBYTE OneToOne 1 100 0.00 255.0 FORMAT "%5.1" ECU_ADDRESS 0x7F87D5 /end MEASUREMENT
/begin MEASUREMENT AirCtl_swtIATSCor "Schalter für add. / mult. Lufttemperaturkorrektur" UBYTE OneToOne 1 100 0.00 255.0 FORMAT "%5.1" ECU_ADDRESS 0x7F87D6 /end MEASUREMENT
/begin MEASUREMENT AirCtl_swtTrm "Schalter für add./mult. Abgleichkorrektur" UBYTE OneToOne 1 100 0.00 255.0 FORMAT "%5.1" ECU_ADDRESS 0x7F87D7 /end MEASUREMENT
/begin MEASUREMENT AirCtl_TrmBas_mp "ARF adjusted value in the basic control mode from the EEPROM" SWORD AirMassPerCyl 1 100 -3276.800 3276.700 FORMAT "%8.3" ECU_ADDRESS 0x8FD2B4 /end MEASUREMENT
/begin MEASUREMENT AirCtl_TrmVal_mp "Abgleichwert für ARF" SWORD AirMassPerCyl 1 100 -3276.800 3276.700 FORMAT "%8.3" ECU_ADDRESS 0x8FD2B6 /end MEASUREMENT
/begin FUNCTION afscd "Luftmassenmesser"
 /begin DEF_CHARACTERISTIC AFSCD_facSwtOnCor_C AFSCD_tiDlySwtOnCor_C AFSCD_DebPlHiOffsDrftDef_C AFSCD_DebPlHiOffsDrftOk_C AFSCD_DebPlLoOffsDrftDef_C AFSCD_DebPlLoOffsDrftOk_C AFSCD_DebRawAirmSigDef_C AFSCD_DebRawAirmSigOk_C AFSCD_DebSRCHiBattDef_C AFSCD_DebSRCHiBattOk_C AFSCD_DebSRCCorrAirmHiDef_C AFSCD_DebSRCCorrAirmHiOk_C AFSCD_DebSRCRawAirmHiDef_C AFSCD_DebSRCRawAirmHiOk_C AFSCD_DebSRCLoBattDef_C AFSCD_DebSRCLoBattOk_C AFSCD_DebSRCCorrAirmLoDef_C AFSCD_DebSRCCorrAirmLoOk_C AFSCD_DebSRCRawAirmLoDef_C AFSCD_DebSRCRawAirmLoOk_C AFSCD_dmAirPerTimeDfl_CUR AFSCD_dmAirPerTimeMax_C AFSCD_dmAirPerTimeSclFac_C AFSCD_dmLin_CUR AFSCD_facChLvl_MAP AFSCD_facPerCor_C AFSCD_facPlsCor_MAP AFSCD_tiLPFiltPT1_C AFSCD_mAirPerCylDfl_MAP AFSCD_tiThrHiPlOffsDrft_C AFSCD_tiThrLoPlOffsDrft_C AFSCD_qAirmThrSRCHiActv_CUR AFSCD_nAvrgThrLoSRCLo_C AFSCD_nAvrgThrHiSRCLo_C AFSCD_tiDlyActvSRCHiAirm_C AFSCD_swtOscSel_C AFSCD_swtSensInstVal_C AFSCD_swtSensInstType_C AFSCD_tiCorrSRCHi_C AFSCD_tiCorrSRCLo_C AFSCD_tiOffsDrftTstDel_C AFSCD_tiOffsDrftTstLim_C AFSCD_tiPerHFM6_C AFSCD_tiRawSRCHi_C AFSCD_tiRawSRCLo_C AFSCD_uBattSRCMax_C AFSCD_uBattSRCMin_C AFSCD_volCyl_C /end DEF_CHARACTERISTIC
 /begin IN_MEASUREMENT AFSCD_pCurr_mp AFSCD_tiRaw Eng_nAvrg InjCtl_qCurr InjCtl_qRaw /end IN_MEASUREMENT
/end FUNCTION
/begin FUNCTION afscd_coord ""
 /begin DEF_CHARACTERISTIC AFSCD_tiAirPerTimeDT1_C AFSCD_dDT1KdAirPerTime_C AFSCD_mDiffDef_MAP AFSCD_mDiffHyst_CUR AFSCD_tiMAirDiffPT1_C AFSCD_swtAirSysVal_C AFSCD_swtAirSysType_C AFSCD_DebPlAirPerCylDiffDef_C AFSCD_DebPlAirPerCylDiffOk_C /end DEF_CHARACTERISTIC
 /begin IN_MEASUREMENT Eng_nAvrg InjCtl_qCurr /end IN_MEASUREMENT
/end FUNCTION
/begin FUNCTION afscd_coord_msg ""
 /begin OUT_MEASUREMENT AFSCD_ddmAirPerTime AFSCD_dmAirPerTime AFSCD_mAirPerCyl AFSCD_mAirPerCylDiff AFSCD_mAirPerCylDiffAbs AFSCD_stOffsTst AFSCD_swtAirSys AFSCD_tAir /end OUT_MEASUREMENT
/end FUNCTION
/begin FUNCTION afscd_coord_uic ""
 /begin OUT_MEASUREMENT AFSCD_mAirDiffHigh_mp AFSCD_mAirDiffLow_mp AFSCD_mAirPerCylDiffUnFlt_mp /end OUT_MEASUREMENT
/end FUNCTION
/begin FUNCTION afscd_co_t1 "Air Temperature component driver for T1 Sensor (on HFM)"
 /begin DEF_CHARACTERISTIC AFSCD_stDcycInv_C AFSCD_tiRefSigPerMin_C AFSCD_tiRefSigPerMax_C AFSCD_dcycAirTempSigMin_C AFSCD_dcycAirTempSigMax_C AFSCD_DebRefSigDef_C AFSCD_DebRefSigOk_C AFSCD_DebSRCHiAirTempDef_C AFSCD_DebSRCHiAirTempOk_C AFSCD_DebSRCRefSigHiDef_C AFSCD_DebSRCRefSigHiOk_C AFSCD_DebSRCLoAirTempDef_C AFSCD_DebSRCLoAirTempOk_C AFSCD_DebSRCRefSigLoDef_C AFSCD_DebSRCRefSigLoOk_C AFSCD_DebSRCAirTempDcycMaxDef_C AFSCD_DebSRCAirTempDcycMaxOk_C AFSCD_DebSRCAirTempDcycMinDef_C AFSCD_DebSRCAirTempDcycMinOk_C AFSCD_dtRmpSlpUp_C AFSCD_dtRmpSlpDwn_C AFSCD_tAirThrSRCHi_C AFSCD_tAirThrSRCLo_C AFSCD_tLin_CUR AFSCD_stSensIDWordAirTemp_C AFSCD_tDfl_C /end DEF_CHARACTERISTIC
 /begin IN_MEASUREMENT AFSCD_rAir /end IN_MEASUREMENT
/end FUNCTION
/begin FUNCTION afscd_co_t1_msg "" /begin OUT_MEASUREMENT AFSCD_rAir AFSCD_stErrAirTemp AFSCD_tAir1 /end OUT_MEASUREMENT /end FUNCTION
/begin FUNCTION afscd_co_t1_uic "" /begin OUT_MEASUREMENT AFSCD_tAir_mp /end OUT_MEASUREMENT /end FUNCTION
/begin FUNCTION afscd_co_t2 "" /begin DEF_CHARACTERISTIC AFSCD_tLin2_CUR /end DEF_CHARACTERISTIC /begin IN_MEASUREMENT AFSCD_rAir2 /end IN_MEASUREMENT /end FUNCTION
/begin FUNCTION afscd_co_t2_msg "" /begin OUT_MEASUREMENT AFSCD_rAir2 AFSCD_stErrAirTemp2 AFSCD_tAir2 /end OUT_MEASUREMENT /end FUNCTION
/begin FUNCTION afscd_co_t2_uic "" /begin OUT_MEASUREMENT AFSCD_tAir2_mp /end OUT_MEASUREMENT /end FUNCTION
/begin FUNCTION afscd_drftcomp "Driftkompensation" /begin DEF_CHARACTERISTIC AFSCD_tiBstPresPT1_C AFSCD_tiQntCurrPT1_C /end DEF_CHARACTERISTIC /end FUNCTION
/begin FUNCTION afscd_drftcomp_msg "" /begin OUT_MEASUREMENT AFSCD_dpIntValAbsFlt AFSCD_dqCurrAbsFlt AFSCD_stDrftComp /end OUT_MEASUREMENT /end FUNCTION
/begin FUNCTION afscd_drftcomp_uic "" /begin OUT_MEASUREMENT AFSCD_dpIntValAbs_mp /end OUT_MEASUREMENT /end FUNCTION
/begin FUNCTION afscd_flt "Luftmassenfilterung" /end FUNCTION
/begin FUNCTION afscd_flt_msg "" /begin OUT_MEASUREMENT AFSCD_mAirPerCylFlt /end OUT_MEASUREMENT /end FUNCTION
/begin FUNCTION afscd_flt_uic "" /end FUNCTION
/begin FUNCTION afscd_mon "AFSCD Monitoring fucntion"
 /begin DEF_CHARACTERISTIC AFSCD_DebPlHiSetyDrftDef_C AFSCD_DebPlHiSetyDrftOk_C AFSCD_DebPlLoSetyDrftDef_C AFSCD_DebPlLoSetyDrftOk_C AFSCD_tClntThrLo_C AFSCD_tClntThrHi_C AFSCD_rSwirlThrLo_C AFSCD_rSwirlThrHi_C AFSCD_rTVAThrLo_C AFSCD_rTVAThrHi_C AFSCD_pAirThrLo_C AFSCD_qRawThrHi_C AFSCD_nAvrgThrLoPlHi_C AFSCD_nAvrgThrHiPlHi_C AFSCD_pBstThrHiPlHi_C AFSCD_rAirThrHiPlHi_C AFSCD_rAirWgtMin_C AFSCD_rAirWgtMax_C AFSCD_nAvrgThrLoPlLo_C AFSCD_nAvrgThrHiPlLo_C AFSCD_pBstThrLoPlLo_C AFSCD_rAirThrLoPlLo_C AFSCD_rEGRPThrHi_C AFSCD_swtAirNormSel_C AFSCD_tiDlyEGRPPlSetyDrft_C AFSCD_tiDlyStrPlSetyDrft_C AFSCD_dtAirThres_C AFSCD_stInhRls_C /end DEF_CHARACTERISTIC
/end FUNCTION
/begin FUNCTION afscd_mon_msg "" /begin OUT_MEASUREMENT AFSCD_rAirNorm AFSCD_stDrftMonRls /end OUT_MEASUREMENT /end FUNCTION
/begin FUNCTION afscd_mon_uic ""
 /begin OUT_MEASUREMENT AFSCD_dmAirSensCorr_mp AFSCD_rAirNormWgt1_mp AFSCD_rAirNormWgt2_mp AFSCD_rAirNormWgt_mp AFSCD_rAirNorm_mp AFSCD_rAirWgt1_mp AFSCD_rAirWgt2_mp AFSCD_rAirWgtLim1_mp AFSCD_rAirWgtLim2_mp AFSCD_stDrftMonRls_mp AFSCD_stPlSetyDrftRls_mp AFSCD_stPlSetyDrft_mp /end OUT_MEASUREMENT
/end FUNCTION
/begin FUNCTION afscd_msg ""
 /begin OUT_MEASUREMENT AFSCD_dmAirNorm AFSCD_dmAirPerTime1 AFSCD_dmAirPerTimeHold AFSCD_dmAirRawPerTime AFSCD_dmAirSens AFSCD_mAirPerCyl1 AFSCD_rAirNorm1 AFSCD_stErrAirm AFSCD_stOffsTst1 AFSCD_swtSensInst AFSCD_tiRaw AFSCD_tiRawLast /end OUT_MEASUREMENT
/end FUNCTION
/begin FUNCTION afscd_sec_msg ""
 /begin OUT_MEASUREMENT AFSCD_dmAirNorm2 AFSCD_dmAirPerTime2 AFSCD_dmAirPerTimeHold2 AFSCD_dmAirRawPerTime2 AFSCD_mAirPerCyl2 AFSCD_rAirNorm2 AFSCD_stErrAirm2 AFSCD_stOffsTst2 AFSCD_swtSensInst2 AFSCD_tiRaw2 AFSCD_tiRawLast2 /end OUT_MEASUREMENT
/end FUNCTION
/begin FUNCTION afscd_sec_uic ""
 /begin OUT_MEASUREMENT AFSCD_dmAirNorm2_mp AFSCD_dmAirNormDfl2_mp AFSCD_dmAirPerTime2_mp AFSCD_dmAirPerTimePlsCorr2_mp AFSCD_facPlsCor2_mp AFSCD_facSwtOnCor2_mp AFSCD_pCurr2_mp AFSCD_qAirmThrSRCHiActv2_mp AFSCD_stDebSRCAirm2_mp AFSCD_stPlSetyDrft2_mp AFSCD_stSRCHiTstRls2_mp AFSCD_stSRCLoTstRls2_mp AFSCD_tiRawAvrgVal2_mp AFSCD_tiSwtOnCor2_mp /end OUT_MEASUREMENT
/end FUNCTION
/begin FUNCTION afscd_uic ""
 /begin OUT_MEASUREMENT AFSCD_dmAirNormDfl_mp AFSCD_dmAirNorm_mp AFSCD_dmAirPerTimePlsCorr_mp AFSCD_dmAirPerTime_mp AFSCD_facPlsCor_mp AFSCD_facSwtOnCor_mp AFSCD_pCurr_mp AFSCD_qAirmThrSRCHiActv_mp AFSCD_stDebSRCAirm_mp AFSCD_stSRCHiTstRls_mp AFSCD_stSRCLoTstRls_mp AFSCD_tiRawAvrgVal_mp AFSCD_tiSwtOnCor_mp /end OUT_MEASUREMENT
/end FUNCTION
/begin FUNCTION airbcd "Komponententreiber Airbagsignalerfassung" /end FUNCTION
/begin FUNCTION airbcd_msg "" /begin OUT_MEASUREMENT AirbCD_st /end OUT_MEASUREMENT /end FUNCTION
/begin FUNCTION airbcd_uic "" /end FUNCTION
/begin FUNCTION airctl_ctlvalcalc "Abgasrückführung - Steuerung"
 /begin DEF_CHARACTERISTIC AirCtl_rCtlValRgn_MAP AirCtl_rCtlVal_MAP AirCtl_stMskCtlValRgn_C /end DEF_CHARACTERISTIC
 /begin IN_MEASUREMENT Eng_nAvrg InjCtl_qCurrCor /end IN_MEASUREMENT
/end FUNCTION
/begin FUNCTION airctl_ctlvalcalc_msg "" /begin OUT_MEASUREMENT AirCtl_rCtlVal /end OUT_MEASUREMENT /end FUNCTION
/begin FUNCTION airctl_ctlvalcalc_uic "" /begin OUT_MEASUREMENT AirCtl_rCtlValRgn_mp AirCtl_rCtlVal_mp /end OUT_MEASUREMENT /end FUNCTION
/begin FUNCTION airctl_desvalcalc "Abgasrückführung - Sollwertbildung"
 /begin DEF_CHARACTERISTIC AirCtl_APCorRgn_CUR AirCtl_APSCor_CUR AirCtl_ATCorRgn_CUR AirCtl_DKdNegqDes_MAP AirCtl_DKdPosqDes_MAP AirCtl_DKdqDes_C AirCtl_dmDesBasUp_C AirCtl_dmDesBasDwn_C AirCtl_dqDWinNegDes_C AirCtl_dqDWinPosDes_C AirCtl_tiDT1qDesCor_C AirCtl_kdDT1qDesCor_C AirCtl_tiDT1qSetUnBal_C AirCtl_kdDT1qSetUnBal_C AirCtl_facAPSmAirDynCor1_CUR AirCtl_facCTSCor1_CUR AirCtl_facCTSCor2_CUR AirCtl_facDQmAirDynCor1_CUR AirCtl_facETmAirDynCor1_CUR AirCtl_facIATSCor_CUR AirCtl_facIATSmAirDynCor1_CUR AirCtl_facMaxTrmValRgn_C AirCtl_facMinTrmValRgn_C AirCtl_mAirDynCor1_MAP AirCtl_MaxTrmVal_C AirCtl_mDesBasDef_MAP AirCtl_mDesBasFDC_MAP AirCtl_mDesBas_MAP AirCtl_mDesConv_C AirCtl_mDesGearCorr_MAP AirCtl_mDesGear_MAP AirCtl_mDesLim_MAP AirCtl_mDesMax_C AirCtl_mDesMin_C AirCtl_mDesRgn1_MAP AirCtl_mDesRgn2_MAP AirCtl_mDesRgn3_MAP AirCtl_mDesRmp_CUR AirCtl_MinTrmVal_C AirCtl_mLiCor_C AirCtl_mMaxDesVal_C AirCtl_mMinDesVal_C AirCtl_mNQCTSCor1_MAP AirCtl_mNQCTSCor2_MAP AirCtl_mPiI2Cor_C AirCtl_mskGear_C AirCtl_nLiEGR_C AirCtl_NQAPCorRgn_MAP AirCtl_NQATCorRgn_MAP AirCtl_NQIATSCor_MAP AirCtl_stRgnMsk1_C AirCtl_stRgnMsk2_C AirCtl_stRgnMsk3_C AirCtl_stRgnMsk4_C AirCtl_swtAPSCorVal_C AirCtl_swtAPSCorType_C AirCtl_swtIATSCorVal_C AirCtl_swtIATSCorType_C AirCtl_swtInDT1_C AirCtl_swtSelDT1_C AirCtl_swtTrmVal_C AirCtl_swtTrmType_C AirCtl_tiDT1qDes_C AirCtl_tiLiEGR_C AirCtl_tiRmpSlpDes_C AirCtl_TrmRgn_MAP AirCtl_TrmVal_C /end DEF_CHARACTERISTIC
 /begin IN_MEASUREMENT AirCtl_dmDesCor AirCtl_dqSetUnBal_mp AirCtl_mDesRmpRaw_mp AirCtl_mGvnrDvtFlt AirCtl_qDesLim_mp APSCD_pVal CTSCD_tClnt Eng_nAvrg FrmMng_dphiStrg FrmMng_phiStrg IATSCD_tAir InjCtl_qRaw InjCtl_qRawCor InjCtl_qSetUnBal /end IN_MEASUREMENT
 /begin OUT_MEASUREMENT AirCtl_TrmBas_mp AirCtl_TrmVal_mp /end OUT_MEASUREMENT
/end FUNCTION
/begin FUNCTION airctl_desvalcalc_msg ""
 /begin OUT_MEASUREMENT AirCtl_dmDesCor AirCtl_mDesBas AirCtl_mDesCor AirCtl_mDesRgn1Cor AirCtl_mDesRgn2Cor AirCtl_mDesRgn3Cor AirCtl_mDesStat AirCtl_mDesVal AirCtl_qCurrCor AirCtl_swtAPSCor AirCtl_swtIATSCor AirCtl_swtTrm /end OUT_MEASUREMENT
/end FUNCTION
/begin FUNCTION airctl_desvalcalc_uic ""
 /begin DEF_CHARACTERISTIC AirCtl_mDesCorBypass_Vector AirCtl_mDesCorBypass_Channel AirCtl_mDesValAdd_Vector AirCtl_mDesValAdd_Channel AirCtl_mDesVal_Vector AirCtl_mDesVal_Channel /end DEF_CHARACTERISTIC
 /begin OUT_MEASUREMENT AirCtl_DKdNegqDes_mp AirCtl_DKdPosqDes_mp AirCtl_DKdqDesCor_mp AirCtl_DKdqDes_mp AirCtl_dmDWinNegqDes_mp AirCtl_dmDWinPosqDes_mp AirCtl_dqSetUnBal_mp AirCtl_facAPSmAirDynCor1_mp AirCtl_facDQmAirDynCor1_mp AirCtl_facETmAirDynCor1_mp AirCtl_facIATSmAirDynCor1_mp AirCtl_facInjMass2Ampc_mp AirCtl_facTrmRgn_mp AirCtl_mAirDynCor1_mp AirCtl_mAirDynCor_mp AirCtl_mDesAdd1_mp AirCtl_mDesBasCor_mp AirCtl_mDesBasC_mp AirCtl_mDesBasDef_mp AirCtl_mDesBasP_mp AirCtl_mDesBasT_mp AirCtl_mDesBas_mp AirCtl_mDesConv_mp AirCtl_mDesDyn_mp AirCtl_mDesGearBas_mp AirCtl_mDesGearCorr_mp AirCtl_mDesGear_mp AirCtl_mDesLim_mp AirCtl_mDesRgn1Cor_mp AirCtl_mDesRgn1P_mp AirCtl_mDesRgn1_mp AirCtl_mDesRgn2Cor_mp AirCtl_mDesRgn2P_mp AirCtl_mDesRgn2_mp AirCtl_mDesRgn3Cor_mp AirCtl_mDesRgn3P_mp AirCtl_mDesRgn3_mp AirCtl_mDesRmpRaw_mp AirCtl_mDesRmp_mp AirCtl_mDesStatRmp_mp AirCtl_mDesTrm_mp AirCtl_mDesValByp_mp AirCtl_mDesValUnLim_mp AirCtl_mDesVal_mp AirCtl_mLi_mp AirCtl_qDesLim_mp AirCtl_stEGT_mp /end OUT_MEASUREMENT
/end FUNCTION
/begin FUNCTION airctl_desvalcalc_var "" /end FUNCTION
/begin FUNCTION airctl_desvalcalc_var_msg "" /end FUNCTION
/begin FUNCTION airctl_desvalcalc_var_uic "" /end FUNCTION
/begin FUNCTION airctl_governor "Adaptiver Abgasrückführregler"
 /begin DEF_CHARACTERISTIC AirCtl_drBelCtlUpRmp_C AirCtl_drBelCtlDwnRmp_C AirCtl_DKdAGR_C AirCtl_DKdNegAGR_MAP AirCtl_DKdPosAGR_MAP AirCtl_dqDWinNegAGR_C AirCtl_dqDWinPosAGR_C AirCtl_drDynMinUp_C AirCtl_drDynMinDwn_C AirCtl_drDynOut1Up_C AirCtl_drDynOut1Dwn_C AirCtl_drDynOut2Up_C AirCtl_drDynOut2Dwn_C AirCtl_drGvnrDynMinUp_C AirCtl_drGvnrDynMinDwn_C AirCtl_facATParAdDKd_CUR AirCtl_facATParAdIKi_CUR AirCtl_facATParAdPKp_CUR AirCtl_facEGRCtlATCor_CUR AirCtl_facEGRCtlCTCor_CUR AirCtl_facNQParAdDKd_MAP AirCtl_facNQParAdIKi_MAP AirCtl_facNQParAdPKp_MAP AirCtl_facNQParRgnAdDKd_MAP AirCtl_facNQParRgnAdIKi_MAP AirCtl_facNQParRgnAdPKp_MAP AirCtl_IKi2_C AirCtl_IKiPos2_C AirCtl_IKiNeg2_C AirCtl_mIWinPos2_C AirCtl_mIWinNeg2_C AirCtl_IKiRgn2_C AirCtl_IKiPosRgn2_C AirCtl_IKiNegRgn2_C AirCtl_mIWinPosRgn2_C AirCtl_mIWinNegRgn2_C AirCtl_IKi_C AirCtl_IKiPos_C AirCtl_IKiNeg_C AirCtl_mIWinPos_C AirCtl_mIWinNeg_C AirCtl_mGvnrDvtLim_C AirCtl_mskGvnrMin_C AirCtl_mskStGvnrDyn1_C AirCtl_mskStGvnrDyn2_C AirCtl_numGvnrAirTemp_C AirCtl_PKp2_C AirCtl_PKpPos2_C AirCtl_PKpNeg2_C AirCtl_mPWinPos2_C AirCtl_mPWinNeg2_C AirCtl_PKpRgn2_C AirCtl_PKpPosRgn2_C AirCtl_PKpNegRgn2_C AirCtl_mPWinPosRgn2_C AirCtl_mPWinNegRgn2_C AirCtl_PKp_C AirCtl_PKpPos_C AirCtl_PKpNeg_C AirCtl_mPWinPos_C AirCtl_mPWinNeg_C AirCtl_rBelCtl_C AirCtl_rDiffDynMin_CUR AirCtl_rDynEnd_C AirCtl_rDynMinRgn_MAP AirCtl_rDynMin_MAP AirCtl_rDynStart_C AirCtl_rEGRBas_MAP AirCtl_rEGRCtlAPSCor_CUR AirCtl_rEGRCtlATCor_MAP AirCtl_rEGRCtlBas_MAP AirCtl_rEGRCtlCTCor_MAP AirCtl_rGovEGRMax_C AirCtl_rGovEGRMin_C AirCtl_rGvnrDynMinRgn_CUR AirCtl_rGvnrDynMin_CUR AirCtl_rGvnrMax_C AirCtl_rGvnrMin_C AirCtl_rGvnrPreMax_C AirCtl_rGvnrPreMin_C AirCtl_rIDflVal12_C AirCtl_rIDflVal1_C AirCtl_rIDflVal4_C AirCtl_rIDflVal5_C AirCtl_rIDflVal8SurgeRgn_C AirCtl_rIDflVal8Surge_C AirCtl_rIDflVal8_C AirCtl_rIDflValCtl_C AirCtl_rTVABas_MAP AirCtl_stEGRDel_C AirCtl_stRgnMskGov_C AirCtl_swtEGRCtl_C AirCtl_swtGvnrVal_C AirCtl_swtGvnrType_C AirCtl_swtIn1DT1_C AirCtl_tiDT1AGR_C AirCtl_tiDynAirCtl_C AirCtl_tiFltGvnrDvt_C AirCtl_tiPCRCtlHiLo_C AirCtl_tiPCRCtlLoHi_C AirCtl_tiRmpSlpGov_C /end DEF_CHARACTERISTIC
 /begin IN_MEASUREMENT AirCtl_dmDesCor AirCtl_mGvnrDvtFlt AirCtl_rOutGvnr_mp AirCtl_rPCRCtl_mp APSCD_pVal CTSCD_tClnt Eng_nAvrg IATSCD_tAir InjCtl_qCurrCor InjCtl_qRaw PCR_rSurgeLIGov /end IN_MEASUREMENT
/end FUNCTION
/begin FUNCTION airctl_governor_msg ""
 /begin OUT_MEASUREMENT AirCtl_mGvnrDvt AirCtl_mGvnrDvt2 AirCtl_mGvnrDvtFlt AirCtl_rGvnrEGR AirCtl_rGvnrEGR2 AirCtl_rGvnrTVA AirCtl_rGvnrTVA2 AirCtl_stAirDyn AirCtl_swtGvnr /end OUT_MEASUREMENT
/end FUNCTION
/begin FUNCTION airctl_governor_uic ""
 /begin OUT_MEASUREMENT AirCtl_DKdAGR_mp AirCtl_DKdNegAGR_mp AirCtl_DKdPosAGR_mp AirCtl_dmDWinNegAGR_mp AirCtl_dmDWinPosAGR_mp AirCtl_facATParAdDKd_mp AirCtl_facATParAdIKi_mp AirCtl_facATParAdPKp_mp AirCtl_facNQParAdDKd_mp AirCtl_facNQParAdIKi_mp AirCtl_facNQParAdPKp_mp AirCtl_facNQParRgnAdDKd_mp AirCtl_facNQParRgnAdIKi_mp AirCtl_facNQParRgnAdPKp_mp AirCtl_facParAdDKd_mp AirCtl_facParAdIKi_mp AirCtl_facParAdPKp_mp AirCtl_mGvnrDvt1_mp AirCtl_mGvnrDvtBase_mp AirCtl_mGvnrDvtFlt1_mp AirCtl_mGvnrDvtFlt2_mp AirCtl_rBelCtl2_mp AirCtl_rBelCtl_mp AirCtl_rDiffDynMin_mp AirCtl_rDynMinNrm_mp AirCtl_rDynMinRgn_mp AirCtl_rDynMin_mp AirCtl_rDynRmp1_mp AirCtl_rDynRmp2_mp AirCtl_rDynRmp_mp AirCtl_rEGRCtlAPSCor_mp AirCtl_rEGRCtlATCor_mp AirCtl_rEGRCtlBas_mp AirCtl_rEGRCtlCTCor_mp AirCtl_rEGRCtl_mp AirCtl_rGvnr2_mp AirCtl_rGvnrDynMin2_mp AirCtl_rGvnrDynMinNrm_mp AirCtl_rGvnrDynMinRgn_mp AirCtl_rGvnrDynMin_mp AirCtl_rGvnrMinDyn1_mp AirCtl_rGvnrMin_mp AirCtl_rGvnr_mp AirCtl_rOutD_mp AirCtl_rOutGvnr2_mp AirCtl_rOutGvnr_mp AirCtl_rOutI2_mp AirCtl_rOutI_mp AirCtl_rOutP2_mp AirCtl_rOutPI2_mp AirCtl_rOutPI_mp AirCtl_rOutP_mp AirCtl_rOut_mp AirCtl_rPCRCtl_mp AirCtl_rPICtl2_mp AirCtl_rPICtl_mp AirCtl_rPreCtlVal2_mp AirCtl_rPreCtlVal_mp AirCtl_stAirCtlDfl8Sel_mp AirCtl_stDyn_mp AirCtl_stGvnrMin_mp /end OUT_MEASUREMENT
/end FUNCTION
/begin FUNCTION airctl_governor_var ""
 /begin DEF_CHARACTERISTIC AirCtl_DKdNegRgn_MAP AirCtl_DKdPosRgn_MAP AirCtl_DKdRgn_C AirCtl_dqDWinNegRgn_C AirCtl_dqDWinPosRgn_C AirCtl_facEGRRgnCorr_CUR AirCtl_facNQParRgn_MAP AirCtl_facPresDiffCor_CUR AirCtl_facRmpEGRCls_C AirCtl_facRmpEGROpn_C AirCtl_facTVACtlATCor_CUR AirCtl_facTVACtlCTCor_CUR AirCtl_IKiRgn_C AirCtl_IKiPosRgn_C AirCtl_IKiNegRgn_C AirCtl_mIWinPosRgn_C AirCtl_mIWinNegRgn_C AirCtl_PKpRgn_C AirCtl_PKpPosRgn_C AirCtl_PKpNegRgn_C AirCtl_mPWinPosRgn_C AirCtl_mPWinNegRgn_C AirCtl_rEGRInv_MAP AirCtl_rEGRRgnCorrErr_C AirCtl_rEGRRgnCorr_MAP AirCtl_rEGRRgn_MAP AirCtl_rEGRRmpMax_C AirCtl_rEGRRmpMin_C AirCtl_rGvnrBgnNrmRgn_C AirCtl_rGvnrThresBgnNrm_C AirCtl_rGvnrTVAMax_C AirCtl_rGvnrTVAMin_C AirCtl_rIDflVal7_C AirCtl_rTVACtlAPSCor_CUR AirCtl_rTVACtlATCor_MAP AirCtl_rTVACtlBas_MAP AirCtl_rTVACtlCTCor_MAP AirCtl_rTVARgn_MAP AirCtl_stMskGvnrRgn_C AirCtl_swtTVACtl_C AirCtl_tiDT1Rgn_C AirCtl_tiRgnNrmMax_C AirCtl_tiTVADel_C /end DEF_CHARACTERISTIC
 /begin IN_MEASUREMENT AirCtl_dmDesCor AirCtl_mGvnrDvtFlt AirCtl_rGvnrEGR AirCtl_rOutGvnr_mp APSCD_pVal CTSCD_tClnt Eng_nAvrg IATSCD_tAir InjCtl_qCurr InjCtl_qRaw PFlt_pDiff /end IN_MEASUREMENT
/end FUNCTION
/begin FUNCTION airctl_governor_var_msg "" /begin OUT_MEASUREMENT AirCtl_stEGT AirCtl_stGvnr /end OUT_MEASUREMENT /end FUNCTION
/begin FUNCTION airctl_governor_var_uic ""
 /begin OUT_MEASUREMENT AirCtl_DKdNegRgn_mp AirCtl_DKdPosRgn_mp AirCtl_DKdRgn_mp AirCtl_dmDWinNegRgn_mp AirCtl_dmDWinPosRgn_mp AirCtl_facEGRRgnCorr_mp AirCtl_facNQParRgn_mp AirCtl_facPresDiffCor_mp AirCtl_rEGRNrmRgn2_mp AirCtl_rEGRNrmRgn_mp AirCtl_rEGRRgn2_mp AirCtl_rEGRRgnCorrM_mp AirCtl_rEGRRgnCorr_mp AirCtl_rEGRRgnNrm2_mp AirCtl_rEGRRgnNrm_mp AirCtl_rEGRRgnVal2_mp AirCtl_rEGRRgnVal_mp AirCtl_rEGRRgn_mp AirCtl_rGvnrCalc2_mp AirCtl_rGvnrCalc_mp AirCtl_rRgnBgnInit2_mp AirCtl_rRgnBgnInit_mp AirCtl_rRgnEndInit2_mp AirCtl_rRgnEndInit_mp AirCtl_rTVACtlAPSCor_mp AirCtl_rTVACtlATCor_mp AirCtl_rTVACtlBas_mp AirCtl_rTVACtlCTCor_mp AirCtl_rTVACtl_mp AirCtl_rTVARgnVal2_mp AirCtl_rTVARgnVal_mp AirCtl_stRgnDes_mp /end OUT_MEASUREMENT
/end FUNCTION
/begin FUNCTION airctl_monitor "Abgasrückführregelung - Überwachung und Abschaltung"
 /begin DEF_CHARACTERISTIC AirCtl_dnSurgeHigh_CUR AirCtl_dnSurgeLow_CUR AirCtl_dqCurrRmpUp_C AirCtl_dqCurrRmpDwn_C AirCtl_dqRawInjMass_C AirCtl_drBrkRmpUp_C AirCtl_drBrkRmpDwn_C AirCtl_tiqRawDT1_C AirCtl_kdDT1qRaw_C AirCtl_facActDesVal_C AirCtl_mDiff_C AirCtl_mMaxDvt_MAP AirCtl_mMinDvt_MAP AirCtl_nAvrgHHi_C AirCtl_nAvrgHLo_C AirCtl_nAvrgLHi_C AirCtl_nAvrgLLo_C AirCtl_nHealHi_C AirCtl_nHealLo_C AirCtl_nLim_C AirCtl_nLoIdl_C AirCtl_nOvrRun_C AirCtl_numAirCtlMon_C AirCtl_pAirHi_C AirCtl_pAirLo_C AirCtl_qDiff_C AirCtl_qGear_C AirCtl_qHealHi_C AirCtl_qHealLo_C AirCtl_qHi_CUR AirCtl_qLo_CUR AirCtl_qOvrRun_C AirCtl_qSurgeHigh_CUR AirCtl_qSurgeLow_CUR AirCtl_qUnBalLim_C AirCtl_rbrkDelta_C AirCtl_rBrkXHigh_C AirCtl_rBrkXLow_C AirCtl_rEGRDflVal12_C AirCtl_rEGRDflVal1_C AirCtl_rEGRDflVal4_C AirCtl_rEGRDflVal5_C AirCtl_rEGRDflVal7_C AirCtl_rEGRDflVal8_C AirCtl_rTVADflVal12_C AirCtl_rTVADflVal1_C AirCtl_rTVADflVal4_C AirCtl_rTVADflVal5_C AirCtl_rTVADflVal8_C AirCtl_stCmpntActv_C AirCtl_stInhGvnrDvt_C AirCtl_stRgnAirCtlshOff_C AirCtl_stRgnCur_C AirCtl_stRgnShOff_C AirCtl_tiSurgePT1_C AirCtl_swtHighLoadCond_C AirCtl_swtHighOvrRunCond_C AirCtl_tAirHHi_C AirCtl_tAirHLo_C AirCtl_tAirLHi_C AirCtl_tAirLLo_C AirCtl_tClntCldHi_C AirCtl_tClntCldLo_C AirCtl_tClntWrmHi_C AirCtl_tClntWrmLo_C AirCtl_tiCldStrt_CUR AirCtl_tiClth_C AirCtl_tiMaxDef2_C AirCtl_tiMaxOk2_C AirCtl_DebGvnrDvtMaxDef_C AirCtl_DebGvnrDvtMaxOk_C AirCtl_tiMinDef2_C AirCtl_tiMinOk2_C AirCtl_DebGvnrDvtMinDef_C AirCtl_DebGvnrDvtMinOk_C AirCtl_tiDebPlateBrkDef_C AirCtl_tiDebPlateBrkOk_C AirCtl_tidqRawOn_C AirCtl_tiLoIdl_C AirCtl_tiOvrRun_C AirCtl_drTVA2SlpLimUp_C AirCtl_drTVA2SlpLimDown_C AirCtl_drTVASlpLimUp_C AirCtl_drTVASlpLimDown_C AirCtl_uBattThres_C AirCtl_vLim_C /end DEF_CHARACTERISTIC
 /begin IN_MEASUREMENT CTSCD_tClnt Eng_nAvrg InjCtl_qCurrCor /end IN_MEASUREMENT
/end FUNCTION
/begin FUNCTION airctl_monitor_msg ""
 /begin OUT_MEASUREMENT AirCtl_mMaxDvt AirCtl_mMinDvt AirCtl_rEGR AirCtl_rEGR2 AirCtl_rGvnrDvtNrm AirCtl_rTVA AirCtl_rTVA2 AirCtl_stAirCtl AirCtl_stAirCtlBits AirCtl_stMonitor /end OUT_MEASUREMENT
/end FUNCTION
/begin COMPU_METHOD DEFAULT_FORMULA "DEFAULT_FORMULA" RAT_FUNC "%7.0" "" COEFFS 0 1 0 0 0 1 /end COMPU_METHOD
/begin COMPU_METHOD AirMassPerCyl "Luftmasse pro Zylinder" RAT_FUNC "%6.3" "mg/Hub" COEFFS 0 10 0 0 0 1 /end COMPU_METHOD
/begin COMPU_METHOD AirMassPerTime "Luftmasse pro Zeit" RAT_FUNC "%6.3" "Kg/h" COEFFS 0 10 0 0 0 1 /end COMPU_METHOD
/begin COMPU_METHOD AngleGrad "Winkelanzeige in Grad" RAT_FUNC "%6.4" "Grad" COEFFS 0 22.7531285551763 0 0 0 1 /end COMPU_METHOD
/begin COMPU_METHOD AngleGradPerSec "Winkelanzeige in Grad pro Sekunde" RAT_FUNC "%6.4" "Grad/s" COEFFS 0 22.7531285551763 0 0 0 1 /end COMPU_METHOD
/begin COMPU_METHOD dm_dZ20 "air mass per time (dm/dt) every 20ms" RAT_FUNC "%6.2" "(Kg/h)/s" COEFFS 0 1 0 0 0 1 /end COMPU_METHOD
/begin COMPU_METHOD dn_dZ20 "Motorbeschleunigung pro Zeit (dn/dt) (im 20 ms Raster)" RAT_FUNC "%6.1" "rpm/s" COEFFS 0 0.1 0 0 0 1 /end COMPU_METHOD
/begin COMPU_METHOD DtyCyc "Tastverhaeltnis" RAT_FUNC "%6.4" "%" COEFFS 0 100 0 0 0 1 /end COMPU_METHOD
/begin COMPU_METHOD EngN "Motordrehzahl" RAT_FUNC "%6.2" "rpm" COEFFS 0 1 0 0 0 1 /end COMPU_METHOD
/begin COMPU_METHOD EngTempFldSel "Verbale Umrechnung für Auswahl aus dem Motortemperatur-Feld Eng_tFld" TAB_VERB "%6.3" "-" COMPU_TAB_REF EngTempFldSel /end COMPU_METHOD
/begin COMPU_VTAB EngTempFldSel "Verbale Umrechnung für Auswahl aus dem Motortemperatur-Feld Eng_tFld" TAB_VERB 3 0 "Coolant_Temperature" 1 "Oil_Temperature" 2 "Eng_tEng" /end COMPU_VTAB
/begin COMPU_METHOD Fact "Faktor mit Auflösung 1 / 8192, hauptsächlich für einen Faktorenbereich 0...1 verwendet" RAT_FUNC "%6.5" "-" COEFFS 0 8192 0 0 0 1 /end COMPU_METHOD
/begin COMPU_METHOD Fact1 "Faktor mit Auflösung 0,01 (100 mal höherer Bereich als Fact)" RAT_FUNC "%6.4" "-" COEFFS 0 128 0 0 0 1 /end COMPU_METHOD
/begin COMPU_METHOD Fact_HFM6 "Umrechnung für einen Faktor mit 14 Bit Auflösung" RAT_FUNC "%7.6" "-" COEFFS 0 16384 0 0 0 1 /end COMPU_METHOD
/begin COMPU_METHOD IndSysTempFldSel "Auswahl für Lufttemperaturfeld" TAB_VERB "%6.3" "-" COMPU_TAB_REF IndSysTempFldSel /end COMPU_METHOD
/begin COMPU_VTAB IndSysTempFldSel "Auswahl für Lufttemperaturfeld" TAB_VERB 3 0 "IATSCD_tAir" 1 "AFSCD_tAir" 2 "EATSCD_tAir" /end COMPU_VTAB
/begin COMPU_METHOD InjMass "Einspritzmenge" RAT_FUNC "%6.4" "mg/hub" COEFFS 0 100 0 0 0 1 /end COMPU_METHOD
/begin COMPU_METHOD InjMassCyc "Einspritzmenge pro Zyklus (mg/Zyklus)" RAT_FUNC "%6.4" "mg/cyc" COEFFS 0 100 0 0 0 1 /end COMPU_METHOD
/begin COMPU_METHOD InjMassPerSec_20ms "Einspritzmengenänderung pro Sekunde für 20ms-Tasks" RAT_FUNC "%6.3" "mg/hub/s" COEFFS 0 2 0 0 0 1 /end COMPU_METHOD
/begin COMPU_METHOD Kd "Differentialverstärkung Kd (gleiche Einheit/Umrechnungsformel an Ein- und Ausgang)" RAT_FUNC "%7.6" "1/1" COEFFS 0 65536 0 0 0 1 /end COMPU_METHOD
/begin COMPU_METHOD Kd_Ampc2Prc "Differentialverstärkung Kd (Luftmasse pro Zyl. AirMassPerCyl zu Prozent Prc)" RAT_FUNC "%8.7" "%/(mg/Hub Luft)" COEFFS 0 536870.912 0 0 0 1 /end COMPU_METHOD
/begin COMPU_METHOD Kd_InjMass2Ampc "Differentialverstärkung Kd (Einspritzmenge InjMass zu Luftmasse pro Zyl. AirMassPerCyl)" RAT_FUNC "%6.5" "(mg/Hub Luft)/(mg/Hub)" COEFFS 0 6553.6 0 0 0 1 /end COMPU_METHOD
/begin COMPU_METHOD Kd_InjMass2AmpcRedRes "" RAT_FUNC "%6.4" "(mg/Hub Luft)/(mg/Hub)" COEFFS 0 51.2 0 0 0 1 /end COMPU_METHOD
/begin COMPU_METHOD Kd_InjMass2Prc "Differentialverstärkung (Einspritzmasse zu Prozent)" RAT_FUNC "%7.6" "%/(mg/Hub)" COEFFS 0 53687.0912 0 0 0 1 /end COMPU_METHOD
/begin COMPU_METHOD Kd_InjMass2PrcRedRes "" RAT_FUNC "%6.4" "%/(mg/Hub)" COEFFS 0 52.4288 0 0 0 1 /end COMPU_METHOD
/begin COMPU_METHOD Ki_Ampc2Prc "Integralverstärkung (Luftmasse pro Zyl. AirMassPerCyl zu Prozent Prc)" RAT_FUNC "%7.6" "%/(mg/Hub Luft)/s" COEFFS 0 35184.372088832 0 0 0 1 /end COMPU_METHOD
/begin COMPU_METHOD Kp_Ampc2Prc "Proportionalverstärkung (Luftmasse zu Prozent)" RAT_FUNC "%8.7" "%/(mg/Hub Luft)" COEFFS 0 536870.912 0 0 0 1 /end COMPU_METHOD
/begin COMPU_METHOD OneToOne "eins zu eins (physikalischer Wert ist gleich dem internen Wert)" RAT_FUNC "%6.2" "-" COEFFS 0 1 0 0 0 1 /end COMPU_METHOD
/begin COMPU_METHOD Prc "Prozent, gleiche interne Auflösung wie Fact, aber Darstellung in Prozent (0...100%)" RAT_FUNC "%6.4" "%" COEFFS 0 81.92 0 0 0 1 /end COMPU_METHOD
/begin COMPU_METHOD PrcEGRRmp "Prozent (%) Normierungsfaktor für EGR-Rampe" RAT_FUNC "%6.3" "%" COEFFS 0 6.5536 0 0 0 1 /end COMPU_METHOD
/begin COMPU_METHOD Pres_hPa "Druck (angezeigt in [hPa])" RAT_FUNC "%6.2" "hPa" COEFFS 0 1 0 0 0 1 /end COMPU_METHOD
/begin COMPU_METHOD RmpAirMassPerCyl "Rampengradient für Luftmasse pro Zylinder" RAT_FUNC "%6.4" "(mg/Hub)/s" COEFFS 0 655.36 0 0 0 1 /end COMPU_METHOD
/begin COMPU_METHOD RmpInjMass "Rampengradient für Einspritzmenge" RAT_FUNC "%6.5" "(mg/stroke)/s" COEFFS 0 6553.6 0 0 0 1 /end COMPU_METHOD
/begin COMPU_METHOD RmpPrc "Prozent Rampengradient" RAT_FUNC "%6.5" "%/s" COEFFS 0 5368.70912 0 0 0 1 /end COMPU_METHOD
/begin COMPU_METHOD RmpPres_hPa "Rampengradient für Druck angezeigt in [hPa/s]" RAT_FUNC "%6.4" "hPa/s" COEFFS 0 65.536 0 0 0 1 /end COMPU_METHOD
/begin COMPU_METHOD RmpTemp "Rampengradient für Temperatur" RAT_FUNC "%6.4" "deg C/s" COEFFS 0 655.36 0 0 0 1 /end COMPU_METHOD
/begin COMPU_METHOD TempCels_100ms "Temperatur Differenz in Grad C/sec (bezgl. 100ms task)" RAT_FUNC "%6.2" "deg C/s" COEFFS 0 1 0 0 0 1 /end COMPU_METHOD
/begin COMPU_METHOD Temp_Cels "Temperatur dargestellt in °C (gleiche interne Darstellung wie Temp_Kelv)" RAT_FUNC "%6.1" "deg C" COEFFS 0 10 2731.4 0 0 1 /end COMPU_METHOD
/begin COMPU_METHOD TimeDeb "Entprellzeit in Millisekunden für Libraryfunktion Debounce" RAT_FUNC "%6.1" "ms" COEFFS 0 0.1 0 0 0 1 /end COMPU_METHOD
/begin COMPU_METHOD TimeDelay_ms "Zeitkonstante T1 fuer die Bibliotheksfunktionen PT1, DT1, etc.,  in ms angegeben" RAT_FUNC "%9.0" "ms" COEFFS 0 0 1 0 2.3283064365387e-07 0 /end COMPU_METHOD
/begin COMPU_METHOD TimeDelay_s "Zeitkonstante T1 (in s) für PT1, DT1, etc." RAT_FUNC "%9.3" "s" COEFFS 0 0 1 0 0.00023283064365387 0 /end COMPU_METHOD
/begin COMPU_METHOD Time_4us "Umrechnung mit einer Auflösung von 4 micro Sekunden" RAT_FUNC "%6.4" "ms" COEFFS 0 250 0 0 0 1 /end COMPU_METHOD
/begin COMPU_METHOD Time_ms "Zeit in ms für Fehlerentprellung (DSM) und SW-Timer" RAT_FUNC "%6.1" "ms" COEFFS 0 0.1 0 0 0 1 /end COMPU_METHOD
/begin COMPU_METHOD Time_Period_HFM6 "Spezielle Umrechnung für die Periodendauer des HFM6" RAT_FUNC "%9.8" "ms" COEFFS 0 4096000 0 0 0 1 /end COMPU_METHOD
/begin COMPU_METHOD Time_PwmHigh "Periodenzeit von der HWE (Tio_PwmGetAvrg)" RAT_FUNC "%6.3" "us" COEFFS 0 10 0 0 0 1 /end COMPU_METHOD
/begin COMPU_METHOD Time_s "Zeit in s für Fehlerentprellung (DSM) und SW-Timer" RAT_FUNC "%6.4" "s" COEFFS 0 100 0 0 0 1 /end COMPU_METHOD
/begin COMPU_METHOD Vel "Fahrzeuggeschwindigkeit, gleiche interne Auflösung wie Vel_SI" RAT_FUNC "%6.4" "km/h" COEFFS 0 100 0 0 0 1 /end COMPU_METHOD
/begin COMPU_METHOD VolCyl "conversion formula for cylinder volume" RAT_FUNC "%6.2" "cm^3" COEFFS 0 1 0 0 0 1 /end COMPU_METHOD
/begin COMPU_METHOD Volt_Batt "Batteriespannung" RAT_FUNC "%6.1" "mV" COEFFS 0 0.05115 0 0 0 1 /end COMPU_METHOD
/begin RECORD_LAYOUT Kf_Xs16_Ys16_Ws16 NO_AXIS_PTS_X 1 SWORD NO_AXIS_PTS_Y 2 SWORD AXIS_PTS_X 3 SWORD INDEX_INCR DIRECT AXIS_PTS_Y 4 SWORD INDEX_INCR DIRECT FNC_VALUES 5 SWORD COLUMN_DIR DIRECT /end RECORD_LAYOUT
/begin RECORD_LAYOUT Kl_Xs16_Ws16 NO_AXIS_PTS_X 1 SWORD AXIS_PTS_X 2 SWORD INDEX_INCR DIRECT FNC_VALUES 3 SWORD COLUMN_DIR DIRECT /end RECORD_LAYOUT
/begin RECORD_LAYOUT Kw_Ws16 FNC_VALUES 1 SWORD COLUMN_DIR DIRECT /end RECORD_LAYOUT
/begin RECORD_LAYOUT Kw_Ws32 FNC_VALUES 1 SLONG COLUMN_DIR DIRECT /end RECORD_LAYOUT
/begin RECORD_LAYOUT Kw_Wu16 FNC_VALUES 1 UWORD COLUMN_DIR DIRECT /end RECORD_LAYOUT
/begin RECORD_LAYOUT Kw_Wu32 FNC_VALUES 1 ULONG COLUMN_DIR DIRECT /end RECORD_LAYOUT
/begin RECORD_LAYOUT Kw_Wu8 FNC_VALUES 1 UBYTE COLUMN_DIR DIRECT /end RECORD_LAYOUT
/end MODULE
/end PROJECT
