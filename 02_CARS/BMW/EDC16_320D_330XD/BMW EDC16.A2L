ASAP2_VERSION 1 3
/begin PROJECT P383 "BMW DDE6.3 8-Zylinder V9E.3 11.10.2004 CAN12H"
/begin HEADER "" VERSION "V9E.3_8Z_CAN12H" PROJECT_NO P383 /end HEADER
/begin MODULE DIM ""
/begin MOD_COMMON "" BYTE_ORDER MSB_FIRST ALIGNMENT_BYTE 1 ALIGNMENT_WORD 2 ALIGNMENT_LONG 4 ALIGNMENT_FLOAT32_IEEE 4 /end MOD_COMMON
/begin CHARACTERISTIC DSM_SdwDfp_Layer_TANS_C "Enprellzeit Shadow Zustand für Fehlerpfad Dfp_Layer_TANS" VALUE 0xD19D6 Kw_Wu16 655350.0 Time_ms 0.00 655350.0 FORMAT "%8.1" /end CHARACTERISTIC
/begin CHARACTERISTIC DSM_SdwDfp_ACCDSwtin_C "Enprellzeit Shadow Zustand für Fehlerpfad Dfp_ACCDSwtin" VALUE 0xD19D8 Kw_Wu16 655350.0 Time_ms 0.00 655350.0 FORMAT "%8.1" /end CHARACTERISTIC
/begin CHARACTERISTIC DSM_SdwDfp_ACC_PlausTrqDes_C "Enprellzeit Shadow Zustand für Fehlerpfad Dfp_ACC_PlausTrqDes" VALUE 0xD19DA Kw_Wu16 655350.0 Time_ms 0.00 655350.0 FORMAT "%8.1" /end CHARACTERISTIC
/begin CHARACTERISTIC DSM_SdwDfp_ACC_trqInr_C "Enprellzeit Shadow Zustand für Fehlerpfad Dfp_ACC_trqInr" VALUE 0xD19DC Kw_Wu16 655350.0 Time_ms 0.00 655350.0 FORMAT "%8.1" /end CHARACTERISTIC
/begin CHARACTERISTIC DSM_SdwDfp_ACTrq_C "Enprellzeit Shadow Zustand für Fehlerpfad Dfp_ACTrq" VALUE 0xD19DE Kw_Wu16 655350.0 Time_ms 0.00 655350.0 FORMAT "%8.1" /end CHARACTERISTIC
/begin CHARACTERISTIC DSM_SdwDfp_ADCMon_C "Enprellzeit Shadow Zustand für Fehlerpfad Dfp_ADCMon" VALUE 0xD19E0 Kw_Wu16 655350.0 Time_ms 0.00 655350.0 FORMAT "%8.1" /end CHARACTERISTIC
/begin CHARACTERISTIC DSM_SdwDfp_AFSCDIdlAdjVal_C "Enprellzeit Shadow Zustand für Fehlerpfad Dfp_AFSCDIdlAdjVal" VALUE 0xD19E2 Kw_Wu16 655350.0 Time_ms 0.00 655350.0 FORMAT "%8.1" /end CHARACTERISTIC
/begin CHARACTERISTIC DSM_SdwDfp_AFSCDLdAdjVal_C "Enprellzeit Shadow Zustand für Fehlerpfad Dfp_AFSCDLdAdjVal" VALUE 0xD19E4 Kw_Wu16 655350.0 Time_ms 0.00 655350.0 FORMAT "%8.1" /end CHARACTERISTIC
/begin CHARACTERISTIC DSM_SdwDfp_AFSCDPlAirPerCylDif_C "Enprellzeit Shadow Zustand für Fehlerpfad Dfp_AFSCDPlAirPerCylDif" VALUE 0xD19E6 Kw_Wu16 655350.0 Time_ms 0.00 655350.0 FORMAT "%8.1" /end CHARACTERISTIC
/begin CHARACTERISTIC DSM_SdwDfp_AFSCD_AirTempDcyc_C "Enprellzeit Shadow Zustand für Fehlerpfad Dfp_AFSCD_AirTempDcyc" VALUE 0xD19E8 Kw_Wu16 655350.0 Time_ms 0.00 655350.0 FORMAT "%8.1" /end CHARACTERISTIC
/begin CHARACTERISTIC DSM_SdwDfp_AFSCD_AirTempDcyc2_C "Enprellzeit Shadow Zustand für Fehlerpfad Dfp_AFSCD_AirTempDcyc2" VALUE 0xD19EA Kw_Wu16 655350.0 Time_ms 0.00 655350.0 FORMAT "%8.1" /end CHARACTERISTIC
/begin CHARACTERISTIC DSM_SdwDfp_AFSCD_PlOffsDrft_C "Enprellzeit Shadow Zustand für Fehlerpfad Dfp_AFSCD_PlOffsDrft" VALUE 0xD19EC Kw_Wu16 655350.0 Time_ms 0.00 655350.0 FORMAT "%8.1" /end CHARACTERISTIC
/begin CHARACTERISTIC DSM_SdwDfp_AFSCD_PlOffsDrft2_C "Enprellzeit Shadow Zustand für Fehlerpfad Dfp_AFSCD_PlOffsDrft2" VALUE 0xD19EE Kw_Wu16 655350.0 Time_ms 0.00 655350.0 FORMAT "%8.1" /end CHARACTERISTIC
/begin CHARACTERISTIC DSM_SdwDfp_AFSCD_PlSetyDrft_C "Enprellzeit Shadow Zustand für Fehlerpfad Dfp_AFSCD_PlSetyDrft" VALUE 0xD19F0 Kw_Wu16 655350.0 Time_ms 0.00 655350.0 FORMAT "%8.1" /end CHARACTERISTIC
/begin CHARACTERISTIC DSM_SdwDfp_AFSCD_SRCAirTemp_C "Enprellzeit Shadow Zustand für Fehlerpfad Dfp_AFSCD_SRCAirTemp" VALUE 0xD19F2 Kw_Wu16 655350.0 Time_ms 0.00 655350.0 FORMAT "%8.1" /end CHARACTERISTIC
/begin CHARACTERISTIC DSM_SdwDfp_AFSCD_SRCAirTemp2_C "Enprellzeit Shadow Zustand für Fehlerpfad Dfp_AFSCD_SRCAirTemp2" VALUE 0xD19F4 Kw_Wu16 655350.0 Time_ms 0.00 655350.0 FORMAT "%8.1" /end CHARACTERISTIC
/begin CHARACTERISTIC DSM_SdwDfp_AFSCD_SRCBatt_C "Enprellzeit Shadow Zustand für Fehlerpfad Dfp_AFSCD_SRCBatt" VALUE 0xD19F6 Kw_Wu16 655350.0 Time_ms 0.00 655350.0 FORMAT "%8.1" /end CHARACTERISTIC
/begin CHARACTERISTIC DSM_SdwDfp_AFSCD_SRCBatt2_C "Enprellzeit Shadow Zustand für Fehlerpfad Dfp_AFSCD_SRCBatt2" VALUE 0xD19F8 Kw_Wu16 655350.0 Time_ms 0.00 655350.0 FORMAT "%8.1" /end CHARACTERISTIC
/begin CHARACTERISTIC DSM_SdwDfp_AFSCD_SRCCorrAirm_C "Enprellzeit Shadow Zustand für Fehlerpfad Dfp_AFSCD_SRCCorrAirm" VALUE 0xD19FA Kw_Wu16 655350.0 Time_ms 0.00 655350.0 FORMAT "%8.1" /end CHARACTERISTIC
/begin CHARACTERISTIC DSM_SdwDfp_Layer_TUMG_C "Enprellzeit Shadow Zustand für Fehlerpfad Dfp_Layer_TUMG" VALUE 0xD19FC Kw_Wu16 655350.0 Time_ms 0.00 655350.0 FORMAT "%8.1" /end CHARACTERISTIC
/begin CHARACTERISTIC DSM_SdwDfp_AFSCD_SRCCorrAirm2_C "Enprellzeit Shadow Zustand für Fehlerpfad Dfp_AFSCD_SRCCorrAirm2" VALUE 0xD19FE Kw_Wu16 655350.0 Time_ms 0.00 655350.0 FORMAT "%8.1" /end CHARACTERISTIC
/begin CHARACTERISTIC DSM_SdwDfp_AFSCD_SRCRawAirm_C "Enprellzeit Shadow Zustand für Fehlerpfad Dfp_AFSCD_SRCRawAirm" VALUE 0xD1A00 Kw_Wu16 655350.0 Time_ms 0.00 655350.0 FORMAT "%8.1" /end CHARACTERISTIC
/begin CHARACTERISTIC DSM_SdwDfp_Layer_GEN_C "Enprellzeit Shadow Zustand für Fehlerpfad Dfp_Layer_GEN" VALUE 0xD1A02 Kw_Wu16 655350.0 Time_ms 0.00 655350.0 FORMAT "%8.1" /end CHARACTERISTIC
/begin CHARACTERISTIC DSM_SdwDfp_Layer_BSD_C "Enprellzeit Shadow Zustand für Fehlerpfad Dfp_Layer_BSD" VALUE 0xD1A04 Kw_Wu16 655350.0 Time_ms 0.00 655350.0 FORMAT "%8.1" /end CHARACTERISTIC
/begin CHARACTERISTIC DSM_SdwDfp_AFSCD_SRCRawAirm2_C "Enprellzeit Shadow Zustand für Fehlerpfad Dfp_AFSCD_SRCRawAirm2" VALUE 0xD1A06 Kw_Wu16 655350.0 Time_ms 0.00 655350.0 FORMAT "%8.1" /end CHARACTERISTIC
/begin CHARACTERISTIC DSM_SdwDfp_AFSCD_SRCRefSigPer_C "Enprellzeit Shadow Zustand für Fehlerpfad Dfp_AFSCD_SRCRefSigPer" VALUE 0xD1A08 Kw_Wu16 655350.0 Time_ms 0.00 655350.0 FORMAT "%8.1" /end CHARACTERISTIC
/begin CHARACTERISTIC DSM_SdwDfp_AFSCD_SRCRefSigPer2_C "Enprellzeit Shadow Zustand für Fehlerpfad Dfp_AFSCD_SRCRefSigPer2" VALUE 0xD1A0A Kw_Wu16 655350.0 Time_ms 0.00 655350.0 FORMAT "%8.1" /end CHARACTERISTIC
/begin CHARACTERISTIC DSM_SdwDfp_AOHtCD_C "Enprellzeit Shadow Zustand für Fehlerpfad Dfp_AOHtCD" VALUE 0xD1A0C Kw_Wu16 655350.0 Time_ms 0.00 655350.0 FORMAT "%8.1" /end CHARACTERISTIC
/begin CHARACTERISTIC DSM_SdwDfp_AOHtCD_AOHtDia1_C "Enprellzeit Shadow Zustand für Fehlerpfad Dfp_AOHtCD_AOHtDia1" VALUE 0xD1A0E Kw_Wu16 655350.0 Time_ms 0.00 655350.0 FORMAT "%8.1" /end CHARACTERISTIC
/begin CHARACTERISTIC DSM_SdwDfp_AOHtCD_AOHtDia2_C "Enprellzeit Shadow Zustand für Fehlerpfad Dfp_AOHtCD_AOHtDia2" VALUE 0xD1A10 Kw_Wu16 655350.0 Time_ms 0.00 655350.0 FORMAT "%8.1" /end CHARACTERISTIC
/begin CHARACTERISTIC DSM_SdwDfp_AOHtCD_AOHtDia3_C "Enprellzeit Shadow Zustand für Fehlerpfad Dfp_AOHtCD_AOHtDia3" VALUE 0xD1A12 Kw_Wu16 655350.0 Time_ms 0.00 655350.0 FORMAT "%8.1" /end CHARACTERISTIC
/begin CHARACTERISTIC DSM_SdwDfp_APP1_C "Enprellzeit Shadow Zustand für Fehlerpfad Dfp_APP1" VALUE 0xD1A14 Kw_Wu16 655350.0 Time_ms 0.00 655350.0 FORMAT "%8.1" /end CHARACTERISTIC
/begin CHARACTERISTIC DSM_SdwDfp_APP2_C "Enprellzeit Shadow Zustand für Fehlerpfad Dfp_APP2" VALUE 0xD1A16 Kw_Wu16 655350.0 Time_ms 0.00 655350.0 FORMAT "%8.1" /end CHARACTERISTIC
/begin CHARACTERISTIC DSM_SdwDfp_APPCDCmpd_C "Enprellzeit Shadow Zustand für Fehlerpfad Dfp_APPCDCmpd" VALUE 0xD1A18 Kw_Wu16 655350.0 Time_ms 0.00 655350.0 FORMAT "%8.1" /end CHARACTERISTIC
/begin CHARACTERISTIC DSM_SdwDfp_Layer_QLT_C "Enprellzeit Shadow Zustand für Fehlerpfad Dfp_Layer_QLT" VALUE 0xD1A1A Kw_Wu16 655350.0 Time_ms 0.00 655350.0 FORMAT "%8.1" /end CHARACTERISTIC
/begin CHARACTERISTIC DSM_SdwDfp_APPSync_C "Enprellzeit Shadow Zustand für Fehlerpfad Dfp_APPSync" VALUE 0xD1A1C Kw_Wu16 655350.0 Time_ms 0.00 655350.0 FORMAT "%8.1" /end CHARACTERISTIC
/begin CHARACTERISTIC DSM_SdwDfp_Layer_IBS1_C "Enprellzeit Shadow Zustand für Fehlerpfad Dfp_Layer_IBS1" VALUE 0xD1A1E Kw_Wu16 655350.0 Time_ms 0.00 655350.0 FORMAT "%8.1" /end CHARACTERISTIC
/begin CHARACTERISTIC DSM_SdwDfp_Layer_IBS2_C "Enprellzeit Shadow Zustand für Fehlerpfad Dfp_Layer_IBS2" VALUE 0xD1A20 Kw_Wu16 655350.0 Time_ms 0.00 655350.0 FORMAT "%8.1" /end CHARACTERISTIC
/begin CHARACTERISTIC DSM_SdwDfp_Layer_IBS3_C "Enprellzeit Shadow Zustand für Fehlerpfad Dfp_Layer_IBS3" VALUE 0xD1A22 Kw_Wu16 655350.0 Time_ms 0.00 655350.0 FORMAT "%8.1" /end CHARACTERISTIC
/begin CHARACTERISTIC DSM_SdwDfp_Layer_PMBN_C "Enprellzeit Shadow Zustand für Fehlerpfad Dfp_Layer_PMBN" VALUE 0xD1A24 Kw_Wu16 655350.0 Time_ms 0.00 655350.0 FORMAT "%8.1" /end CHARACTERISTIC
/begin CHARACTERISTIC DSM_SdwDfp_Layer_PMBATT_C "Enprellzeit Shadow Zustand für Fehlerpfad Dfp_Layer_PMBATT" VALUE 0xD1A26 Kw_Wu16 655350.0 Time_ms 0.00 655350.0 FORMAT "%8.1" /end CHARACTERISTIC
/begin CHARACTERISTIC DSM_SdwDfp_APSCD_C "Enprellzeit Shadow Zustand für Fehlerpfad Dfp_APSCD" VALUE 0xD1A28 Kw_Wu16 655350.0 Time_ms 0.00 655350.0 FORMAT "%8.1" /end CHARACTERISTIC
/begin CHARACTERISTIC DSM_SdwDfp_ARS_C "Enprellzeit Shadow Zustand für Fehlerpfad Dfp_ARS" VALUE 0xD1A2A Kw_Wu16 655350.0 Time_ms 0.00 655350.0 FORMAT "%8.1" /end CHARACTERISTIC
/begin CHARACTERISTIC DSM_SdwDfp_AccPedPlausBrk_C "Enprellzeit Shadow Zustand für Fehlerpfad Dfp_AccPedPlausBrk" VALUE 0xD1A2C Kw_Wu16 655350.0 Time_ms 0.00 655350.0 FORMAT "%8.1" /end CHARACTERISTIC
/begin CHARACTERISTIC DSM_SdwDfp_AddPCDTnkLvl_C "Enprellzeit Shadow Zustand für Fehlerpfad Dfp_AddPCDTnkLvl" VALUE 0xD1A2E Kw_Wu16 655350.0 Time_ms 0.00 655350.0 FORMAT "%8.1" /end CHARACTERISTIC
/begin CHARACTERISTIC DSM_SdwDfp_AirCtlGvnrDvtRgnMax_C "Enprellzeit Shadow Zustand für Fehlerpfad Dfp_AirCtlGvnrDvtRgnMax" VALUE 0xD1A30 Kw_Wu16 655350.0 Time_ms 0.00 655350.0 FORMAT "%8.1" /end CHARACTERISTIC
/begin CHARACTERISTIC DSM_SdwDfp_AirCtlGvnrDvtRgnMin_C "Enprellzeit Shadow Zustand für Fehlerpfad Dfp_AirCtlGvnrDvtRgnMin" VALUE 0xD1A32 Kw_Wu16 655350.0 Time_ms 0.00 655350.0 FORMAT "%8.1" /end CHARACTERISTIC
/begin CHARACTERISTIC DSM_SdwDfp_AirCtlGvnrDvtRgnMn2_C "Enprellzeit Shadow Zustand für Fehlerpfad Dfp_AirCtlGvnrDvtRgnMn2" VALUE 0xD1A34 Kw_Wu16 655350.0 Time_ms 0.00 655350.0 FORMAT "%8.1" /end CHARACTERISTIC
/begin CHARACTERISTIC DSM_SdwDfp_AirCtlGvnrDvtRgnMx2_C "Enprellzeit Shadow Zustand für Fehlerpfad Dfp_AirCtlGvnrDvtRgnMx2" VALUE 0xD1A36 Kw_Wu16 655350.0 Time_ms 0.00 655350.0 FORMAT "%8.1" /end CHARACTERISTIC
/begin CHARACTERISTIC DSM_SdwDfp_AirCtlPlateBreak_C "DSM variable for Dfp_AirCtlPlateBreak_mp" VALUE 0xD1A38 Kw_Wu16 655350.0 Time_ms 0.00 655350.0 FORMAT "%8.1" /end CHARACTERISTIC
/begin CHARACTERISTIC DSM_SdwDfp_AirCtlRmpTO_C "Enprellzeit Shadow Zustand für Fehlerpfad Dfp_AirCtlRmpTO" VALUE 0xD1A3A Kw_Wu16 655350.0 Time_ms 0.00 655350.0 FORMAT "%8.1" /end CHARACTERISTIC
/begin CHARACTERISTIC DSM_SdwDfp_AirCtl_GovNegDev_C "Enprellzeit Shadow Zustand für Fehlerpfad Dfp_AirCtl_GovNegDev" VALUE 0xD1A3C Kw_Wu16 655350.0 Time_ms 0.00 655350.0 FORMAT "%8.1" /end CHARACTERISTIC
/begin CHARACTERISTIC DSM_SdwDfp_AirCtl_GovNegDev2_C "Enprellzeit Shadow Zustand für Fehlerpfad Dfp_AirCtl_GovNegDev2" VALUE 0xD1A3E Kw_Wu16 655350.0 Time_ms 0.00 655350.0 FORMAT "%8.1" /end CHARACTERISTIC
/begin CHARACTERISTIC DSM_SdwDfp_AirCtl_GovPosDev_C "Enprellzeit Shadow Zustand für Fehlerpfad Dfp_AirCtl_GovPosDev" VALUE 0xD1A40 Kw_Wu16 655350.0 Time_ms 0.00 655350.0 FORMAT "%8.1" /end CHARACTERISTIC
/begin CHARACTERISTIC DSM_SdwDfp_AirCtl_GovPosDev2_C "Enprellzeit Shadow Zustand für Fehlerpfad Dfp_AirCtl_GovPosDev2" VALUE 0xD1A42 Kw_Wu16 655350.0 Time_ms 0.00 655350.0 FORMAT "%8.1" /end CHARACTERISTIC
/begin CHARACTERISTIC DSM_SdwDfp_AltCD_C "Enprellzeit Shadow Zustand für Fehlerpfad Dfp_AltCD" VALUE 0xD1A44 Kw_Wu16 655350.0 Time_ms 0.00 655350.0 FORMAT "%8.1" /end CHARACTERISTIC
/begin CHARACTERISTIC DSM_SdwDfp_BPACD_BPADia1_C "Enprellzeit Shadow Zustand für Fehlerpfad Dfp_BPACD_BPADia1" VALUE 0xD1A46 Kw_Wu16 655350.0 Time_ms 0.00 655350.0 FORMAT "%8.1" /end CHARACTERISTIC
/begin CHARACTERISTIC DSM_SdwDfp_BPACD_BPADia1v2_C "Enprellzeit Shadow Zustand für Fehlerpfad Dfp_BPACD_BPADia1v2" VALUE 0xD1A48 Kw_Wu16 655350.0 Time_ms 0.00 655350.0 FORMAT "%8.1" /end CHARACTERISTIC
/begin CHARACTERISTIC DSM_SdwDfp_BPACD_BPADia2_C "Enprellzeit Shadow Zustand für Fehlerpfad Dfp_BPACD_BPADia2" VALUE 0xD1A4A Kw_Wu16 655350.0 Time_ms 0.00 655350.0 FORMAT "%8.1" /end CHARACTERISTIC
/begin CHARACTERISTIC DSM_SdwDfp_BPACD_BPADia2v2_C "Enprellzeit Shadow Zustand für Fehlerpfad Dfp_BPACD_BPADia2v2" VALUE 0xD1A4C Kw_Wu16 655350.0 Time_ms 0.00 655350.0 FORMAT "%8.1" /end CHARACTERISTIC
/begin CHARACTERISTIC DSM_SdwDfp_BPACD_BPADia3_C "Enprellzeit Shadow Zustand für Fehlerpfad Dfp_BPACD_BPADia3" VALUE 0xD1A4E Kw_Wu16 655350.0 Time_ms 0.00 655350.0 FORMAT "%8.1" /end CHARACTERISTIC
/begin CHARACTERISTIC DSM_SdwDfp_BPACD_BPADia3v2_C "Enprellzeit Shadow Zustand für Fehlerpfad Dfp_BPACD_BPADia3v2" VALUE 0xD1A50 Kw_Wu16 655350.0 Time_ms 0.00 655350.0 FORMAT "%8.1" /end CHARACTERISTIC
/begin CHARACTERISTIC DSM_SdwDfp_BPACD_BPADia4_C "Enprellzeit Shadow Zustand für Fehlerpfad Dfp_BPACD_BPADia4" VALUE 0xD1A52 Kw_Wu16 655350.0 Time_ms 0.00 655350.0 FORMAT "%8.1" /end CHARACTERISTIC
/begin CHARACTERISTIC DSM_SdwDfp_BPACD_BPADia4v2_C "Enprellzeit Shadow Zustand für Fehlerpfad Dfp_BPACD_BPADia4v2" VALUE 0xD1A54 Kw_Wu16 655350.0 Time_ms 0.00 655350.0 FORMAT "%8.1" /end CHARACTERISTIC
/begin CHARACTERISTIC DSM_SdwDfp_BPACD_Max_C "Enprellzeit Shadow Zustand für Fehlerpfad Dfp_BPACD_Max" VALUE 0xD1A56 Kw_Wu16 655350.0 Time_ms 0.00 655350.0 FORMAT "%8.1" /end CHARACTERISTIC
/begin CHARACTERISTIC DSM_SdwDfp_BPACD_Max2_C "Enprellzeit Shadow Zustand für Fehlerpfad Dfp_BPACD_Max2" VALUE 0xD1A58 Kw_Wu16 655350.0 Time_ms 0.00 655350.0 FORMAT "%8.1" /end CHARACTERISTIC
/begin CHARACTERISTIC DSM_SdwDfp_BPACD_Min_C "Enprellzeit Shadow Zustand für Fehlerpfad Dfp_BPACD_Min" VALUE 0xD1A5A Kw_Wu16 655350.0 Time_ms 0.00 655350.0 FORMAT "%8.1" /end CHARACTERISTIC
/begin CHARACTERISTIC DSM_SdwDfp_BPACD_Min2_C "Enprellzeit Shadow Zustand für Fehlerpfad Dfp_BPACD_Min2" VALUE 0xD1A5C Kw_Wu16 655350.0 Time_ms 0.00 655350.0 FORMAT "%8.1" /end CHARACTERISTIC
/begin CHARACTERISTIC DSM_SdwDfp_BPACD_SigNpl_C "Enprellzeit Shadow Zustand für Fehlerpfad Dfp_BPACD_SigNpl" VALUE 0xD1A5E Kw_Wu16 655350.0 Time_ms 0.00 655350.0 FORMAT "%8.1" /end CHARACTERISTIC
/begin CHARACTERISTIC DSM_SdwDfp_BPACD_SigNpl2_C "Enprellzeit Shadow Zustand für Fehlerpfad Dfp_BPACD_SigNpl2" VALUE 0xD1A60 Kw_Wu16 655350.0 Time_ms 0.00 655350.0 FORMAT "%8.1" /end CHARACTERISTIC
/begin CHARACTERISTIC DSM_SdwDfp_BPSCD_C "Enprellzeit Shadow Zustand für Fehlerpfad Dfp_BPSCD" VALUE 0xD1A62 Kw_Wu16 655350.0 Time_ms 0.00 655350.0 FORMAT "%8.1" /end CHARACTERISTIC
/begin CHARACTERISTIC DSM_SdwDfp_BattCD_C "Enprellzeit Shadow Zustand für Fehlerpfad Dfp_BattCD" VALUE 0xD1A64 Kw_Wu16 655350.0 Time_ms 0.00 655350.0 FORMAT "%8.1" /end CHARACTERISTIC
/begin CHARACTERISTIC DSM_SdwDfp_BrkCD_C "Enprellzeit Shadow Zustand für Fehlerpfad Dfp_BrkCD" VALUE 0xD1A66 Kw_Wu16 655350.0 Time_ms 0.00 655350.0 FORMAT "%8.1" /end CHARACTERISTIC
/begin CHARACTERISTIC DSM_SdwDfp_Layer_PMRUHVERL_C "Enprellzeit Shadow Zustand für Fehlerpfad Dfp_Layer_PMRUHVERL" VALUE 0xD1A68 Kw_Wu16 655350.0 Time_ms 0.00 655350.0 FORMAT "%8.1" /end CHARACTERISTIC
/begin CHARACTERISTIC DSM_SdwDfp_Bss_C "Enprellzeit Shadow Zustand für Fehlerpfad Dfp_Bss" VALUE 0xD1A6A Kw_Wu16 655350.0 Time_ms 0.00 655350.0 FORMAT "%8.1" /end CHARACTERISTIC
/begin CHARACTERISTIC DSM_SdwDfp_CBACD_C "Enprellzeit Shadow Zustand für Fehlerpfad Dfp_CBACD" VALUE 0xD1A6C Kw_Wu16 655350.0 Time_ms 0.00 655350.0 FORMAT "%8.1" /end CHARACTERISTIC
/begin CHARACTERISTIC DSM_SdwDfp_CTSCD_C "Enprellzeit Shadow Zustand für Fehlerpfad Dfp_CTSCD" VALUE 0xD1A6E Kw_Wu16 655350.0 Time_ms 0.00 655350.0 FORMAT "%8.1" /end CHARACTERISTIC
/begin CHARACTERISTIC DSM_SdwDfp_Clg_DynTst_C "Enprellzeit Shadow Zustand für Fehlerpfad Dfp_Clg_DynTst" VALUE 0xD1A70 Kw_Wu16 655350.0 Time_ms 0.00 655350.0 FORMAT "%8.1" /end CHARACTERISTIC
/begin CHARACTERISTIC DSM_SdwDfp_Layer_TOENS_C "Enprellzeit Shadow Zustand für Fehlerpfad Dfp_Layer_TOENS" VALUE 0xD1A72 Kw_Wu16 655350.0 Time_ms 0.00 655350.0 FORMAT "%8.1" /end CHARACTERISTIC
/begin CHARACTERISTIC DSM_SdwDfp_Layer_MANHYDR_C "Enprellzeit Shadow Zustand für Fehlerpfad Dfp_Layer_MANHYDR" VALUE 0xD1A74 Kw_Wu16 655350.0 Time_ms 0.00 655350.0 FORMAT "%8.1" /end CHARACTERISTIC
/begin CHARACTERISTIC DSM_SdwDfp_Layer_MANLUFT_C "Enprellzeit Shadow Zustand für Fehlerpfad Dfp_Layer_MANLUFT" VALUE 0xD1A76 Kw_Wu16 655350.0 Time_ms 0.00 655350.0 FORMAT "%8.1" /end CHARACTERISTIC
/begin CHARACTERISTIC DSM_SdwDfp_CmbChbMisfire1_C "Enprellzeit Shadow Zustand für Fehlerpfad Dfp_CmbChbMisfire1" VALUE 0xD1A78 Kw_Wu16 655350.0 Time_ms 0.00 655350.0 FORMAT "%8.1" /end CHARACTERISTIC
/begin CHARACTERISTIC DSM_SdwDfp_CmbChbMisfire2_C "Enprellzeit Shadow Zustand für Fehlerpfad Dfp_CmbChbMisfire2" VALUE 0xD1A7A Kw_Wu16 655350.0 Time_ms 0.00 655350.0 FORMAT "%8.1" /end CHARACTERISTIC
/begin CHARACTERISTIC DSM_SdwDfp_CmbChbMisfire3_C "Enprellzeit Shadow Zustand für Fehlerpfad Dfp_CmbChbMisfire3" VALUE 0xD1A7C Kw_Wu16 655350.0 Time_ms 0.00 655350.0 FORMAT "%8.1" /end CHARACTERISTIC
/begin CHARACTERISTIC DSM_SdwDfp_CmbChbMisfire4_C "Enprellzeit Shadow Zustand für Fehlerpfad Dfp_CmbChbMisfire4" VALUE 0xD1A7E Kw_Wu16 655350.0 Time_ms 0.00 655350.0 FORMAT "%8.1" /end CHARACTERISTIC
/begin CHARACTERISTIC DSM_SdwDfp_CmbChbMisfire5_C "Enprellzeit Shadow Zustand für Fehlerpfad Dfp_CmbChbMisfire5" VALUE 0xD1A80 Kw_Wu16 655350.0 Time_ms 0.00 655350.0 FORMAT "%8.1" /end CHARACTERISTIC
/begin CHARACTERISTIC DSM_SdwDfp_CmbChbMisfire6_C "Enprellzeit Shadow Zustand für Fehlerpfad Dfp_CmbChbMisfire6" VALUE 0xD1A82 Kw_Wu16 655350.0 Time_ms 0.00 655350.0 FORMAT "%8.1" /end CHARACTERISTIC
/begin CHARACTERISTIC DSM_SdwDfp_CmbChbMisfire7_C "Enprellzeit Shadow Zustand für Fehlerpfad Dfp_CmbChbMisfire7" VALUE 0xD1A84 Kw_Wu16 655350.0 Time_ms 0.00 655350.0 FORMAT "%8.1" /end CHARACTERISTIC
/begin CHARACTERISTIC DSM_SdwDfp_CmbChbMisfire8_C "Enprellzeit Shadow Zustand für Fehlerpfad Dfp_CmbChbMisfire8" VALUE 0xD1A86 Kw_Wu16 655350.0 Time_ms 0.00 655350.0 FORMAT "%8.1" /end CHARACTERISTIC
/begin CHARACTERISTIC DSM_SdwDfp_CmbChbMisfireMul_C "Enprellzeit Shadow Zustand für Fehlerpfad Dfp_CmbChbMisfireMul" VALUE 0xD1A88 Kw_Wu16 655350.0 Time_ms 0.00 655350.0 FORMAT "%8.1" /end CHARACTERISTIC
/begin CHARACTERISTIC DSM_SdwDfp_CoDT_TRQ_Des_C "Enprellzeit Shadow Zustand für Fehlerpfad Dfp_CoDT_TRQ_Des" VALUE 0xD1A8A Kw_Wu16 655350.0 Time_ms 0.00 655350.0 FORMAT "%8.1" /end CHARACTERISTIC
/begin CHARACTERISTIC DSM_SdwDfp_CoDT_TRQ_Lead_C "Enprellzeit Shadow Zustand für Fehlerpfad Dfp_CoDT_TRQ_Lead" VALUE 0xD1A8C Kw_Wu16 655350.0 Time_ms 0.00 655350.0 FORMAT "%8.1" /end CHARACTERISTIC
/begin CHARACTERISTIC DSM_SdwDfp_CoEng_GbxRpmRduc_C "Enprellzeit Shadow Zustand für Fehlerpfad Dfp_CoEng_GbxRpmRduc" VALUE 0xD1A8E Kw_Wu16 655350.0 Time_ms 0.00 655350.0 FORMAT "%8.1" /end CHARACTERISTIC
/begin CHARACTERISTIC DSM_SdwDfp_CoVMDCSh_C "Enprellzeit Shadow Zustand für Fehlerpfad Dfp_CoVMDCSh" VALUE 0xD1A90 Kw_Wu16 655350.0 Time_ms 0.00 655350.0 FORMAT "%8.1" /end CHARACTERISTIC
/begin CHARACTERISTIC DSM_SdwDfp_ConvCD_C "Enprellzeit Shadow Zustand für Fehlerpfad Dfp_ConvCD" VALUE 0xD1A92 Kw_Wu16 655350.0 Time_ms 0.00 655350.0 FORMAT "%8.1" /end CHARACTERISTIC
/begin CHARACTERISTIC DSM_SdwDfp_CrCCDMFL_C "Enprellzeit Shadow Zustand für Fehlerpfad Dfp_CrCCDMFL" VALUE 0xD1A94 Kw_Wu16 655350.0 Time_ms 0.00 655350.0 FORMAT "%8.1" /end CHARACTERISTIC
/begin CHARACTERISTIC DSM_SdwDfp_CrCtl_vCrCtl_C "Enprellzeit Shadow Zustand für Fehlerpfad Dfp_CrCtl_vCrCtl" VALUE 0xD1A96 Kw_Wu16 655350.0 Time_ms 0.00 655350.0 FORMAT "%8.1" /end CHARACTERISTIC
/begin CHARACTERISTIC DSM_SdwDfp_EATSCD_C "Enprellzeit Shadow Zustand für Fehlerpfad Dfp_EATSCD" VALUE 0xD1A98 Kw_Wu16 655350.0 Time_ms 0.00 655350.0 FORMAT "%8.1" /end CHARACTERISTIC
/begin CHARACTERISTIC DSM_SdwDfp_EBAFCD_C "Enprellzeit Shadow Zustand für Fehlerpfad Dfp_EBAFCD" VALUE 0xD1A9A Kw_Wu16 655350.0 Time_ms 0.00 655350.0 FORMAT "%8.1" /end CHARACTERISTIC
/begin CHARACTERISTIC DSM_SdwDfp_EBFCD_C "Enprellzeit Shadow Zustand für Fehlerpfad Dfp_EBFCD" VALUE 0xD1A9C Kw_Wu16 655350.0 Time_ms 0.00 655350.0 FORMAT "%8.1" /end CHARACTERISTIC
/begin CHARACTERISTIC DSM_SdwDfp_EBTSCD_C "Enprellzeit Shadow Zustand für Fehlerpfad Dfp_EBTSCD" VALUE 0xD1A9E Kw_Wu16 655350.0 Time_ms 0.00 655350.0 FORMAT "%8.1" /end CHARACTERISTIC
/begin CHARACTERISTIC DSM_SdwDfp_EBTSCD_OvrTemp_C "Enprellzeit Shadow Zustand für Fehlerpfad Dfp_EBTSCD_OvrTemp" VALUE 0xD1AA0 Kw_Wu16 655350.0 Time_ms 0.00 655350.0 FORMAT "%8.1" /end CHARACTERISTIC
/begin CHARACTERISTIC DSM_SdwDfp_EEPCDVarMng_C "Enprellzeit Shadow Zustand für Fehlerpfad Dfp_EEPCDVarMng" VALUE 0xD1AA2 Kw_Wu16 655350.0 Time_ms 0.00 655350.0 FORMAT "%8.1" /end CHARACTERISTIC
/begin CHARACTERISTIC DSM_SdwDfp_EGPpCD_C "Enprellzeit Shadow Zustand für Fehlerpfad Dfp_EGPpCD" VALUE 0xD1AA4 Kw_Wu16 655350.0 Time_ms 0.00 655350.0 FORMAT "%8.1" /end CHARACTERISTIC
/begin CHARACTERISTIC DSM_SdwDfp_EGRCD_Max_C "Enprellzeit Shadow Zustand für Fehlerpfad Dfp_EGRCD_Max" VALUE 0xD1AA6 Kw_Wu16 655350.0 Time_ms 0.00 655350.0 FORMAT "%8.1" /end CHARACTERISTIC
/begin CHARACTERISTIC DSM_SdwDfp_EGRCD_Max2_C "Enprellzeit Shadow Zustand für Fehlerpfad Dfp_EGRCD_Max2" VALUE 0xD1AA8 Kw_Wu16 655350.0 Time_ms 0.00 655350.0 FORMAT "%8.1" /end CHARACTERISTIC
/begin CHARACTERISTIC DSM_SdwDfp_EGRCD_Min_C "Enprellzeit Shadow Zustand für Fehlerpfad Dfp_EGRCD_Min" VALUE 0xD1AAA Kw_Wu16 655350.0 Time_ms 0.00 655350.0 FORMAT "%8.1" /end CHARACTERISTIC
/begin CHARACTERISTIC DSM_SdwDfp_EGRCD_Min2_C "Enprellzeit Shadow Zustand für Fehlerpfad Dfp_EGRCD_Min2" VALUE 0xD1AAC Kw_Wu16 655350.0 Time_ms 0.00 655350.0 FORMAT "%8.1" /end CHARACTERISTIC
/begin CHARACTERISTIC DSM_SdwDfp_EGRCD_PWMInDia1_C "Enprellzeit Shadow Zustand für Fehlerpfad Dfp_EGRCD_PWMInDia1" VALUE 0xD1AAE Kw_Wu16 655350.0 Time_ms 0.00 655350.0 FORMAT "%8.1" /end CHARACTERISTIC
/begin CHARACTERISTIC DSM_SdwDfp_EGRCD_PWMInDia2_C "Enprellzeit Shadow Zustand für Fehlerpfad Dfp_EGRCD_PWMInDia2" VALUE 0xD1AB0 Kw_Wu16 655350.0 Time_ms 0.00 655350.0 FORMAT "%8.1" /end CHARACTERISTIC
/begin CHARACTERISTIC DSM_SdwDfp_EGRCD_PWMInDia21_C "Enprellzeit Shadow Zustand für Fehlerpfad Dfp_EGRCD_PWMInDia21" VALUE 0xD1AB2 Kw_Wu16 655350.0 Time_ms 0.00 655350.0 FORMAT "%8.1" /end CHARACTERISTIC
/begin CHARACTERISTIC DSM_SdwDfp_EGRCD_PWMInDia22_C "Enprellzeit Shadow Zustand für Fehlerpfad Dfp_EGRCD_PWMInDia22" VALUE 0xD1AB4 Kw_Wu16 655350.0 Time_ms 0.00 655350.0 FORMAT "%8.1" /end CHARACTERISTIC
/begin CHARACTERISTIC DSM_SdwDfp_EGRCD_PWMInDia23_C "Enprellzeit Shadow Zustand für Fehlerpfad Dfp_EGRCD_PWMInDia23" VALUE 0xD1AB6 Kw_Wu16 655350.0 Time_ms 0.00 655350.0 FORMAT "%8.1" /end CHARACTERISTIC
/begin CHARACTERISTIC DSM_SdwDfp_EGRCD_PWMInDia24_C "Enprellzeit Shadow Zustand für Fehlerpfad Dfp_EGRCD_PWMInDia24" VALUE 0xD1AB8 Kw_Wu16 655350.0 Time_ms 0.00 655350.0 FORMAT "%8.1" /end CHARACTERISTIC
/begin CHARACTERISTIC DSM_SdwDfp_EGRCD_PWMInDia3_C "Enprellzeit Shadow Zustand für Fehlerpfad Dfp_EGRCD_PWMInDia3" VALUE 0xD1ABA Kw_Wu16 655350.0 Time_ms 0.00 655350.0 FORMAT "%8.1" /end CHARACTERISTIC
/begin CHARACTERISTIC DSM_SdwDfp_EGRCD_PWMInDia4_C "Enprellzeit Shadow Zustand für Fehlerpfad Dfp_EGRCD_PWMInDia4" VALUE 0xD1ABC Kw_Wu16 655350.0 Time_ms 0.00 655350.0 FORMAT "%8.1" /end CHARACTERISTIC
/begin CHARACTERISTIC DSM_SdwDfp_EGRCD_SigDia_C "Enprellzeit Shadow Zustand für Fehlerpfad Dfp_EGRCD_SigDia" VALUE 0xD1ABE Kw_Wu16 655350.0 Time_ms 0.00 655350.0 FORMAT "%8.1" /end CHARACTERISTIC
/begin CHARACTERISTIC DSM_SdwDfp_EGRCD_SigDia2_C "Enprellzeit Shadow Zustand für Fehlerpfad Dfp_EGRCD_SigDia2" VALUE 0xD1AC0 Kw_Wu16 655350.0 Time_ms 0.00 655350.0 FORMAT "%8.1" /end CHARACTERISTIC
/begin CHARACTERISTIC DSM_SdwDfp_EGRCD_SigNpl_C "Enprellzeit Shadow Zustand für Fehlerpfad Dfp_EGRCD_SigNpl" VALUE 0xD1AC2 Kw_Wu16 655350.0 Time_ms 0.00 655350.0 FORMAT "%8.1" /end CHARACTERISTIC
/begin CHARACTERISTIC DSM_SdwDfp_EGRCD_SigNpl2_C "Enprellzeit Shadow Zustand für Fehlerpfad Dfp_EGRCD_SigNpl2" VALUE 0xD1AC4 Kw_Wu16 655350.0 Time_ms 0.00 655350.0 FORMAT "%8.1" /end CHARACTERISTIC
/begin CHARACTERISTIC DSM_SdwDfp_EGTOilLvlCrit_C "Enprellzeit Shadow Zustand für Fehlerpfad Dfp_EGTOilLvlCrit" VALUE 0xD1AC6 Kw_Wu16 655350.0 Time_ms 0.00 655350.0 FORMAT "%8.1" /end CHARACTERISTIC
/begin CHARACTERISTIC DSM_SdwDfp_EGTOilVscCrit_C "Enprellzeit Shadow Zustand für Fehlerpfad Dfp_EGTOilVscCrit" VALUE 0xD1AC8 Kw_Wu16 655350.0 Time_ms 0.00 655350.0 FORMAT "%8.1" /end CHARACTERISTIC
/begin CHARACTERISTIC DSM_SdwDfp_EGTRgnOilDil_C "Enprellzeit Shadow Zustand für Fehlerpfad Dfp_EGTRgnOilDil" VALUE 0xD1ACA Kw_Wu16 655350.0 Time_ms 0.00 655350.0 FORMAT "%8.1" /end CHARACTERISTIC
/begin CHARACTERISTIC DSM_SdwDfp_EGTTempGvnrInrB1_C "Enprellzeit Shadow Zustand für Fehlerpfad Dfp_EGTTempGvnrInrB1" VALUE 0xD1ACC Kw_Wu16 655350.0 Time_ms 0.00 655350.0 FORMAT "%8.1" /end CHARACTERISTIC
/begin CHARACTERISTIC DSM_SdwDfp_EGTTempGvnrInrB2_C "Enprellzeit Shadow Zustand für Fehlerpfad Dfp_EGTTempGvnrInrB2" VALUE 0xD1ACE Kw_Wu16 655350.0 Time_ms 0.00 655350.0 FORMAT "%8.1" /end CHARACTERISTIC
/begin CHARACTERISTIC DSM_SdwDfp_EGTTempGvnrOutrB1_C "Enprellzeit Shadow Zustand für Fehlerpfad Dfp_EGTTempGvnrOutrB1" VALUE 0xD1AD0 Kw_Wu16 655350.0 Time_ms 0.00 655350.0 FORMAT "%8.1" /end CHARACTERISTIC
/begin CHARACTERISTIC DSM_SdwDfp_EGTTempGvnrOutrB2_C "Enprellzeit Shadow Zustand für Fehlerpfad Dfp_EGTTempGvnrOutrB2" VALUE 0xD1AD2 Kw_Wu16 655350.0 Time_ms 0.00 655350.0 FORMAT "%8.1" /end CHARACTERISTIC
/begin CHARACTERISTIC DSM_SdwDfp_ETClbETFltInj1_C "Enprellzeit Shadow Zustand für Fehlerpfad Dfp_ETClbETFltInj1" VALUE 0xD1AD4 Kw_Wu16 655350.0 Time_ms 0.00 655350.0 FORMAT "%8.1" /end CHARACTERISTIC
/begin CHARACTERISTIC DSM_SdwDfp_ETClbETFltInj2_C "Enprellzeit Shadow Zustand für Fehlerpfad Dfp_ETClbETFltInj2" VALUE 0xD1AD6 Kw_Wu16 655350.0 Time_ms 0.00 655350.0 FORMAT "%8.1" /end CHARACTERISTIC
/begin CHARACTERISTIC DSM_SdwDfp_ETClbETFltInj3_C "Enprellzeit Shadow Zustand für Fehlerpfad Dfp_ETClbETFltInj3" VALUE 0xD1AD8 Kw_Wu16 655350.0 Time_ms 0.00 655350.0 FORMAT "%8.1" /end CHARACTERISTIC
/begin CHARACTERISTIC DSM_SdwDfp_ETClbETFltInj4_C "Enprellzeit Shadow Zustand für Fehlerpfad Dfp_ETClbETFltInj4" VALUE 0xD1ADA Kw_Wu16 655350.0 Time_ms 0.00 655350.0 FORMAT "%8.1" /end CHARACTERISTIC
/begin CHARACTERISTIC DSM_SdwDfp_ETClbETFltInj5_C "Enprellzeit Shadow Zustand für Fehlerpfad Dfp_ETClbETFltInj5" VALUE 0xD1ADC Kw_Wu16 655350.0 Time_ms 0.00 655350.0 FORMAT "%8.1" /end CHARACTERISTIC
/begin CHARACTERISTIC DSM_SdwDfp_ETClbETFltInj6_C "Enprellzeit Shadow Zustand für Fehlerpfad Dfp_ETClbETFltInj6" VALUE 0xD1ADE Kw_Wu16 655350.0 Time_ms 0.00 655350.0 FORMAT "%8.1" /end CHARACTERISTIC
/begin CHARACTERISTIC DSM_SdwDfp_ETClbETFltInj7_C "Enprellzeit Shadow Zustand für Fehlerpfad Dfp_ETClbETFltInj7" VALUE 0xD1AE0 Kw_Wu16 655350.0 Time_ms 0.00 655350.0 FORMAT "%8.1" /end CHARACTERISTIC
/begin CHARACTERISTIC DSM_SdwDfp_ETClbETFltInj8_C "Enprellzeit Shadow Zustand für Fehlerpfad Dfp_ETClbETFltInj8" VALUE 0xD1AE2 Kw_Wu16 655350.0 Time_ms 0.00 655350.0 FORMAT "%8.1" /end CHARACTERISTIC
/begin CHARACTERISTIC DSM_SdwDfp_ETClbInj1_C "Enprellzeit Shadow Zustand für Fehlerpfad Dfp_ETClbInj1" VALUE 0xD1AE4 Kw_Wu16 655350.0 Time_ms 0.00 655350.0 FORMAT "%8.1" /end CHARACTERISTIC
/begin CHARACTERISTIC DSM_SdwDfp_ETClbInj2_C "Enprellzeit Shadow Zustand für Fehlerpfad Dfp_ETClbInj2" VALUE 0xD1AE6 Kw_Wu16 655350.0 Time_ms 0.00 655350.0 FORMAT "%8.1" /end CHARACTERISTIC
/begin CHARACTERISTIC DSM_SdwDfp_ETClbInj3_C "Enprellzeit Shadow Zustand für Fehlerpfad Dfp_ETClbInj3" VALUE 0xD1AE8 Kw_Wu16 655350.0 Time_ms 0.00 655350.0 FORMAT "%8.1" /end CHARACTERISTIC
/begin CHARACTERISTIC DSM_SdwDfp_ETClbInj4_C "Enprellzeit Shadow Zustand für Fehlerpfad Dfp_ETClbInj4" VALUE 0xD1AEA Kw_Wu16 655350.0 Time_ms 0.00 655350.0 FORMAT "%8.1" /end CHARACTERISTIC
/begin CHARACTERISTIC DSM_SdwDfp_ETClbInj5_C "Enprellzeit Shadow Zustand für Fehlerpfad Dfp_ETClbInj5" VALUE 0xD1AEC Kw_Wu16 655350.0 Time_ms 0.00 655350.0 FORMAT "%8.1" /end CHARACTERISTIC
/begin CHARACTERISTIC DSM_SdwDfp_ETClbInj6_C "Enprellzeit Shadow Zustand für Fehlerpfad Dfp_ETClbInj6" VALUE 0xD1AEE Kw_Wu16 655350.0 Time_ms 0.00 655350.0 FORMAT "%8.1" /end CHARACTERISTIC
/begin CHARACTERISTIC DSM_SdwDfp_ETClbInj7_C "Enprellzeit Shadow Zustand für Fehlerpfad Dfp_ETClbInj7" VALUE 0xD1AF0 Kw_Wu16 655350.0 Time_ms 0.00 655350.0 FORMAT "%8.1" /end CHARACTERISTIC
/begin CHARACTERISTIC DSM_SdwDfp_ETClbInj8_C "Enprellzeit Shadow Zustand für Fehlerpfad Dfp_ETClbInj8" VALUE 0xD1AF2 Kw_Wu16 655350.0 Time_ms 0.00 655350.0 FORMAT "%8.1" /end CHARACTERISTIC
/begin CHARACTERISTIC DSM_SdwDfp_EngMCaS1_C "Enprellzeit Shadow Zustand für Fehlerpfad Dfp_EngMCaS1" VALUE 0xD1AF4 Kw_Wu16 655350.0 Time_ms 0.00 655350.0 FORMAT "%8.1" /end CHARACTERISTIC
/begin CHARACTERISTIC DSM_SdwDfp_EngMCrS1_C "Enprellzeit Shadow Zustand für Fehlerpfad Dfp_EngMCrS1" VALUE 0xD1AF6 Kw_Wu16 655350.0 Time_ms 0.00 655350.0 FORMAT "%8.1" /end CHARACTERISTIC
/begin CHARACTERISTIC DSM_SdwDfp_EngMOfsCaSCrS_C "Enprellzeit Shadow Zustand für Fehlerpfad Dfp_EngMOfsCaSCrS" VALUE 0xD1AF8 Kw_Wu16 655350.0 Time_ms 0.00 655350.0 FORMAT "%8.1" /end CHARACTERISTIC
/begin CHARACTERISTIC DSM_SdwDfp_EngMntCtlCD_C "Enprellzeit Shadow Zustand für Fehlerpfad Dfp_EngMntCtlCD" VALUE 0xD1AFA Kw_Wu16 655350.0 Time_ms 0.00 655350.0 FORMAT "%8.1" /end CHARACTERISTIC
/begin CHARACTERISTIC DSM_SdwDfp_FBCqDvt_C "Enprellzeit Shadow Zustand für Fehlerpfad Dfp_FBCqDvt" VALUE 0xD1AFC Kw_Wu16 655350.0 Time_ms 0.00 655350.0 FORMAT "%8.1" /end CHARACTERISTIC
/begin CHARACTERISTIC DSM_SdwDfp_FMAErrMod_C "Enprellzeit Shadow Zustand für Fehlerpfad Dfp_FMAErrMod" VALUE 0xD1AFE Kw_Wu16 655350.0 Time_ms 0.00 655350.0 FORMAT "%8.1" /end CHARACTERISTIC
/begin CHARACTERISTIC DSM_SdwDfp_FMTC_NonMonotonMap_C "Enprellzeit Shadow Zustand für Fehlerpfad Dfp_FMTC_NonMonotonMap" VALUE 0xD1B00 Kw_Wu16 655350.0 Time_ms 0.00 655350.0 FORMAT "%8.1" /end CHARACTERISTIC
/begin CHARACTERISTIC DSM_SdwDfp_FTSCD_C "Enprellzeit Shadow Zustand für Fehlerpfad Dfp_FTSCD" VALUE 0xD1B02 Kw_Wu16 655350.0 Time_ms 0.00 655350.0 FORMAT "%8.1" /end CHARACTERISTIC
/begin CHARACTERISTIC DSM_SdwDfp_FanCD_C "Enprellzeit Shadow Zustand für Fehlerpfad Dfp_FanCD" VALUE 0xD1B04 Kw_Wu16 655350.0 Time_ms 0.00 655350.0 FORMAT "%8.1" /end CHARACTERISTIC
/begin CHARACTERISTIC DSM_SdwDfp_FanCD_FanCtlr1_C "Enprellzeit Shadow Zustand für Fehlerpfad Dfp_FanCD_FanCtlr1" VALUE 0xD1B06 Kw_Wu16 655350.0 Time_ms 0.00 655350.0 FORMAT "%8.1" /end CHARACTERISTIC
/begin CHARACTERISTIC DSM_SdwDfp_FanCD_FanCtlr2_C "Enprellzeit Shadow Zustand für Fehlerpfad Dfp_FanCD_FanCtlr2" VALUE 0xD1B08 Kw_Wu16 655350.0 Time_ms 0.00 655350.0 FORMAT "%8.1" /end CHARACTERISTIC
/begin CHARACTERISTIC DSM_SdwDfp_FanCD_FanCtlr3_C "Enprellzeit Shadow Zustand für Fehlerpfad Dfp_FanCD_FanCtlr3" VALUE 0xD1B0A Kw_Wu16 655350.0 Time_ms 0.00 655350.0 FORMAT "%8.1" /end CHARACTERISTIC
/begin CHARACTERISTIC DSM_SdwDfp_FlFCD_C "Enprellzeit Shadow Zustand für Fehlerpfad Dfp_FlFCD" VALUE 0xD1B0C Kw_Wu16 655350.0 Time_ms 0.00 655350.0 FORMAT "%8.1" /end CHARACTERISTIC
/begin CHARACTERISTIC DSM_SdwDfp_FlMngSmkDefect_C "Enprellzeit Shadow Zustand für Fehlerpfad Dfp_FlMngSmkDefect" VALUE 0xD1B0E Kw_Wu16 655350.0 Time_ms 0.00 655350.0 FORMAT "%8.1" /end CHARACTERISTIC
/begin CHARACTERISTIC DSM_SdwDfp_FlSCDT1_C "Enprellzeit Shadow Zustand für Fehlerpfad Dfp_FlSCDT1" VALUE 0xD1B10 Kw_Wu16 655350.0 Time_ms 0.00 655350.0 FORMAT "%8.1" /end CHARACTERISTIC
/begin CHARACTERISTIC DSM_SdwDfp_FrmMngANFRADMOMPT_C "Enprellzeit Shadow Zustand für Fehlerpfad Dfp_FrmMngANFRADMOMPT" VALUE 0xD1B12 Kw_Wu16 655350.0 Time_ms 0.00 655350.0 FORMAT "%8.1" /end CHARACTERISTIC
/begin CHARACTERISTIC DSM_SdwDfp_FrmMngASC1_C "Enprellzeit Shadow Zustand für Fehlerpfad Dfp_FrmMngASC1" VALUE 0xD1B14 Kw_Wu16 655350.0 Time_ms 0.00 655350.0 FORMAT "%8.1" /end CHARACTERISTIC
/begin CHARACTERISTIC DSM_SdwDfp_FrmMngASC2_C "Enprellzeit Shadow Zustand für Fehlerpfad Dfp_FrmMngASC2" VALUE 0xD1B16 Kw_Wu16 655350.0 Time_ms 0.00 655350.0 FORMAT "%8.1" /end CHARACTERISTIC
/begin CHARACTERISTIC DSM_SdwDfp_FrmMngASC3_C "Enprellzeit Shadow Zustand für Fehlerpfad Dfp_FrmMngASC3" VALUE 0xD1B18 Kw_Wu16 655350.0 Time_ms 0.00 655350.0 FORMAT "%8.1" /end CHARACTERISTIC
/begin CHARACTERISTIC DSM_SdwDfp_FrmMngASC4_C "Enprellzeit Shadow Zustand für Fehlerpfad Dfp_FrmMngASC4" VALUE 0xD1B1A Kw_Wu16 655350.0 Time_ms 0.00 655350.0 FORMAT "%8.1" /end CHARACTERISTIC
/begin CHARACTERISTIC DSM_SdwDfp_FrmMngBOS_RESET_C "Enprellzeit Shadow Zustand für Fehlerpfad Dfp_FrmMngBOS_RESET" VALUE 0xD1B1C Kw_Wu16 655350.0 Time_ms 0.00 655350.0 FORMAT "%8.1" /end CHARACTERISTIC
/begin CHARACTERISTIC DSM_SdwDfp_FrmMngBOS_RESET2_C "Enprellzeit Shadow Zustand für Fehlerpfad Dfp_FrmMngBOS_RESET2" VALUE 0xD1B1E Kw_Wu16 655350.0 Time_ms 0.00 655350.0 FORMAT "%8.1" /end CHARACTERISTIC
/begin CHARACTERISTIC DSM_SdwDfp_FrmMngDMANFAFS_C "Enprellzeit Shadow Zustand für Fehlerpfad Dfp_FrmMngDMANFAFS" VALUE 0xD1B20 Kw_Wu16 655350.0 Time_ms 0.00 655350.0 FORMAT "%8.1" /end CHARACTERISTIC
/begin CHARACTERISTIC DSM_SdwDfp_FrmMngDRMANFSSG_C "Enprellzeit Shadow Zustand für Fehlerpfad Dfp_FrmMngDRMANFSSG" VALUE 0xD1B22 Kw_Wu16 655350.0 Time_ms 0.00 655350.0 FORMAT "%8.1" /end CHARACTERISTIC
/begin CHARACTERISTIC DSM_SdwDfp_FrmMngEGS1_C "Enprellzeit Shadow Zustand für Fehlerpfad Dfp_FrmMngEGS1" VALUE 0xD1B24 Kw_Wu16 655350.0 Time_ms 0.00 655350.0 FORMAT "%8.1" /end CHARACTERISTIC
/begin CHARACTERISTIC DSM_SdwDfp_FrmMngEGS2_C "Enprellzeit Shadow Zustand für Fehlerpfad Dfp_FrmMngEGS2" VALUE 0xD1B26 Kw_Wu16 655350.0 Time_ms 0.00 655350.0 FORMAT "%8.1" /end CHARACTERISTIC
/begin CHARACTERISTIC DSM_SdwDfp_FrmMngGEARBX_DATA_C "Enprellzeit Shadow Zustand für Fehlerpfad Dfp_FrmMngGEARBX_DATA" VALUE 0xD1B28 Kw_Wu16 655350.0 Time_ms 0.00 655350.0 FORMAT "%8.1" /end CHARACTERISTIC
/begin CHARACTERISTIC DSM_SdwDfp_FrmMngGEARBX_DATA2_C "Enprellzeit Shadow Zustand für Fehlerpfad Dfp_FrmMngGEARBX_DATA2" VALUE 0xD1B2A Kw_Wu16 655350.0 Time_ms 0.00 655350.0 FORMAT "%8.1" /end CHARACTERISTIC
/begin CHARACTERISTIC DSM_SdwDfp_FrmMngHEAT_AC_C "Enprellzeit Shadow Zustand für Fehlerpfad Dfp_FrmMngHEAT_AC" VALUE 0xD1B2C Kw_Wu16 655350.0 Time_ms 0.00 655350.0 FORMAT "%8.1" /end CHARACTERISTIC
/begin CHARACTERISTIC DSM_SdwDfp_FrmMngINSTR2_C "Enprellzeit Shadow Zustand für Fehlerpfad Dfp_FrmMngINSTR2" VALUE 0xD1B2E Kw_Wu16 655350.0 Time_ms 0.00 655350.0 FORMAT "%8.1" /end CHARACTERISTIC
/begin CHARACTERISTIC DSM_SdwDfp_FrmMngINSTR3_C "Enprellzeit Shadow Zustand für Fehlerpfad Dfp_FrmMngINSTR3" VALUE 0xD1B30 Kw_Wu16 655350.0 Time_ms 0.00 655350.0 FORMAT "%8.1" /end CHARACTERISTIC
/begin CHARACTERISTIC DSM_SdwDfp_FrmMngLENKRADWINKEL_C "Enprellzeit Shadow Zustand für Fehlerpfad Dfp_FrmMngLENKRADWINKEL" VALUE 0xD1B32 Kw_Wu16 655350.0 Time_ms 0.00 655350.0 FORMAT "%8.1" /end CHARACTERISTIC
/begin CHARACTERISTIC DSM_SdwDfp_FrmMngMILEAGE_RANGE_C "Enprellzeit Shadow Zustand für Fehlerpfad Dfp_FrmMngMILEAGE_RANGE" VALUE 0xD1B34 Kw_Wu16 655350.0 Time_ms 0.00 655350.0 FORMAT "%8.1" /end CHARACTERISTIC
/begin CHARACTERISTIC DSM_SdwDfp_FrmMngMSPHISYNC_C "Enprellzeit Shadow Zustand für Fehlerpfad Dfp_FrmMngMSPHISYNC" VALUE 0xD1B36 Kw_Wu16 655350.0 Time_ms 0.00 655350.0 FORMAT "%8.1" /end CHARACTERISTIC
/begin CHARACTERISTIC DSM_SdwDfp_FrmMngMST4_C "Enprellzeit Shadow Zustand für Fehlerpfad Dfp_FrmMngMST4" VALUE 0xD1B38 Kw_Wu16 655350.0 Time_ms 0.00 655350.0 FORMAT "%8.1" /end CHARACTERISTIC
/begin CHARACTERISTIC DSM_SdwDfp_FrmMngMST5_C "Enprellzeit Shadow Zustand für Fehlerpfad Dfp_FrmMngMST5" VALUE 0xD1B3A Kw_Wu16 655350.0 Time_ms 0.00 655350.0 FORMAT "%8.1" /end CHARACTERISTIC
/begin CHARACTERISTIC DSM_SdwDfp_FrmMngOPCRCTLACC_C "Enprellzeit Shadow Zustand für Fehlerpfad Dfp_FrmMngOPCRCTLACC" VALUE 0xD1B3C Kw_Wu16 655350.0 Time_ms 0.00 655350.0 FORMAT "%8.1" /end CHARACTERISTIC
/begin CHARACTERISTIC DSM_SdwDfp_FrmMngPRGG_CCTR_C "Enprellzeit Shadow Zustand für Fehlerpfad Dfp_FrmMngPRGG_CCTR" VALUE 0xD1B3E Kw_Wu16 655350.0 Time_ms 0.00 655350.0 FORMAT "%8.1" /end CHARACTERISTIC
/begin CHARACTERISTIC DSM_SdwDfp_FrmMngPWRMNG_LOADV_C "Enprellzeit Shadow Zustand für Fehlerpfad Dfp_FrmMngPWRMNG_LOADV" VALUE 0xD1B40 Kw_Wu16 655350.0 Time_ms 0.00 655350.0 FORMAT "%8.1" /end CHARACTERISTIC
/begin CHARACTERISTIC DSM_SdwDfp_FrmMngParkConsumer_C "Entprellzeit Shadow Zusand für Fehlerpfad Dfp_FrmMngParkConsumer" VALUE 0xD1B42 Kw_Wu16 655350.0 Time_ms 0.00 655350.0 FORMAT "%8.1" /end CHARACTERISTIC
/begin CHARACTERISTIC DSM_SdwDfp_FrmMngRQSTGEFAN_C "Fehlerpfad spezifische Umweltbedingungen fuer Fehlerpfad Dfp_FrmMngRQSTGEFAN_C" VALUE 0xD1B44 Kw_Wu16 655350.0 Time_ms 0.00 655350.0 FORMAT "%8.1" /end CHARACTERISTIC
/begin CHARACTERISTIC DSM_SdwDfp_FrmMngSLV4_C "Enprellzeit Shadow Zustand für Fehlerpfad Dfp_FrmMngSLV4" VALUE 0xD1B46 Kw_Wu16 655350.0 Time_ms 0.00 655350.0 FORMAT "%8.1" /end CHARACTERISTIC
/begin CHARACTERISTIC DSM_SdwDfp_FrmMngSLV5_C "Enprellzeit Shadow Zustand für Fehlerpfad Dfp_FrmMngSLV5" VALUE 0xD1B48 Kw_Wu16 655350.0 Time_ms 0.00 655350.0 FORMAT "%8.1" /end CHARACTERISTIC
/begin CHARACTERISTIC DSM_SdwDfp_FrmMngSSGErr_C "Enprellzeit Shadow Zustand für Fehlerpfad Dfp_FrmMngSSGErr" VALUE 0xD1B4A Kw_Wu16 655350.0 Time_ms 0.00 655350.0 FORMAT "%8.1" /end CHARACTERISTIC
/begin CHARACTERISTIC DSM_SdwDfp_FrmMngSSGShOff_C "Enprellzeit Shadow Zustand für Fehlerpfad Dfp_FrmMngSSGShOff" VALUE 0xD1B4C Kw_Wu16 655350.0 Time_ms 0.00 655350.0 FORMAT "%8.1" /end CHARACTERISTIC
/begin CHARACTERISTIC DSM_SdwDfp_FrmMngSTAT_ANH_C "Enprellzeit Shadow Zustand für Fehlerpfad Dfp_FrmMngSTAT_ANH" VALUE 0xD1B4E Kw_Wu16 655350.0 Time_ms 0.00 655350.0 FORMAT "%8.1" /end CHARACTERISTIC
/begin CHARACTERISTIC DSM_SdwDfp_FrmMngSTAT_ARS_C "Enprellzeit Shadow Zustand für Fehlerpfad Dfp_FrmMngSTAT_ARS" VALUE 0xD1B50 Kw_Wu16 655350.0 Time_ms 0.00 655350.0 FORMAT "%8.1" /end CHARACTERISTIC
/begin CHARACTERISTIC DSM_SdwDfp_FrmMngSTAT_DSC_C "Enprellzeit Shadow Zustand für Fehlerpfad Dfp_FrmMngSTAT_DSC" VALUE 0xD1B52 Kw_Wu16 655350.0 Time_ms 0.00 655350.0 FORMAT "%8.1" /end CHARACTERISTIC
/begin CHARACTERISTIC DSM_SdwDfp_FrmMngSTAT_EKP_C "Enprellzeit Shadow Zustand für Fehlerpfad Dfp_FrmMngSTAT_EKP" VALUE 0xD1B54 Kw_Wu16 655350.0 Time_ms 0.00 655350.0 FORMAT "%8.1" /end CHARACTERISTIC
/begin CHARACTERISTIC DSM_SdwDfp_FrmMngSTAT_KOMBI_C "Enprellzeit Shadow Zustand für Fehlerpfad Dfp_FrmMngSTAT_KOMBI" VALUE 0xD1B56 Kw_Wu16 655350.0 Time_ms 0.00 655350.0 FORMAT "%8.1" /end CHARACTERISTIC
/begin CHARACTERISTIC DSM_SdwDfp_FrmMngSTAT_SITZ_C "Enprellzeit Shadow Zustand für Fehlerpfad Dfp_FrmMngSTAT_SITZ" VALUE 0xD1B58 Kw_Wu16 655350.0 Time_ms 0.00 655350.0 FORMAT "%8.1" /end CHARACTERISTIC
/begin CHARACTERISTIC DSM_SdwDfp_FrmMngStOBDGbxMilOf_C "Enprellzeit Shadow Zustand für Fehlerpfad Dfp_FrmMngStOBDGbxMilOf" VALUE 0xD1B5A Kw_Wu16 655350.0 Time_ms 0.00 655350.0 FORMAT "%8.1" /end CHARACTERISTIC
/begin CHARACTERISTIC DSM_SdwDfp_FrmMngStOBDGbxMilOn_C "Enprellzeit Shadow Zustand für Fehlerpfad Dfp_FrmMngStOBDGbxMilOn" VALUE 0xD1B5C Kw_Wu16 655350.0 Time_ms 0.00 655350.0 FORMAT "%8.1" /end CHARACTERISTIC
/begin CHARACTERISTIC DSM_SdwDfp_FrmMngTEMPRELTIME_C "Enprellzeit Shadow Zustand für Fehlerpfad Dfp_FrmMngTEMPRELTIME" VALUE 0xD1B5E Kw_Wu16 655350.0 Time_ms 0.00 655350.0 FORMAT "%8.1" /end CHARACTERISTIC
/begin CHARACTERISTIC DSM_SdwDfp_FrmMngTERMINAL_C "Enprellzeit Shadow Zustand für Fehlerpfad Dfp_FrmMngTERMINAL" VALUE 0xD1B60 Kw_Wu16 655350.0 Time_ms 0.00 655350.0 FORMAT "%8.1" /end CHARACTERISTIC
/begin CHARACTERISTIC DSM_SdwDfp_FrmMngTIME_DATE_C "Enprellzeit Shadow Zustand für Fehlerpfad Dfp_FrmMngTIME_DATE" VALUE 0xD1B62 Kw_Wu16 655350.0 Time_ms 0.00 655350.0 FORMAT "%8.1" /end CHARACTERISTIC
/begin CHARACTERISTIC DSM_SdwDfp_FrmMngTORQUE_DSC_C "Enprellzeit Shadow Zustand für Fehlerpfad Dfp_FrmMngTORQUE_DSC" VALUE 0xD1B64 Kw_Wu16 655350.0 Time_ms 0.00 655350.0 FORMAT "%8.1" /end CHARACTERISTIC
/begin CHARACTERISTIC DSM_SdwDfp_FrmMngTORQUE_GEARBX_C "Enprellzeit Shadow Zustand für Fehlerpfad Dfp_FrmMngTORQUE_GEARBX" VALUE 0xD1B66 Kw_Wu16 655350.0 Time_ms 0.00 655350.0 FORMAT "%8.1" /end CHARACTERISTIC
/begin CHARACTERISTIC DSM_SdwDfp_FrmMngTrq_ReqACC_C "Enprellzeit Shadow Zustand für Fehlerpfad Dfp_FrmMngTrq_ReqACC" VALUE 0xD1B68 Kw_Wu16 655350.0 Time_ms 0.00 655350.0 FORMAT "%8.1" /end CHARACTERISTIC
/begin CHARACTERISTIC DSM_SdwDfp_FrmMngVEH_MOD_C "Durch Fehlerpfad Dfp_FrmMngVEH_MOD_C verriegelte Funktionsidentifier" VALUE 0xD1B6A Kw_Wu16 655350.0 Time_ms 0.00 655350.0 FORMAT "%8.1" /end CHARACTERISTIC
/begin CHARACTERISTIC DSM_SdwDfp_FrmMngVELOCITY_C "Enprellzeit Shadow Zustand für Fehlerpfad Dfp_FrmMngVELOCITY" VALUE 0xD1B6C Kw_Wu16 655350.0 Time_ms 0.00 655350.0 FORMAT "%8.1" /end CHARACTERISTIC
/begin CHARACTERISTIC DSM_SdwDfp_FrmMngWHEEL_SPEED_C "Enprellzeit Shadow Zustand für Fehlerpfad Dfp_FrmMngWHEEL_SPEED" VALUE 0xD1B6E Kw_Wu16 655350.0 Time_ms 0.00 655350.0 FORMAT "%8.1" /end CHARACTERISTIC
/begin CHARACTERISTIC DSM_SdwDfp_FrmMngstCurr_C "Entprellzeit für Dfp_FrmMngstCurr" VALUE 0xD1B70 Kw_Wu16 655350.0 Time_ms 0.00 655350.0 FORMAT "%8.1" /end CHARACTERISTIC
/begin CHARACTERISTIC DSM_SdwDfp_FrmMngswtPSPOff_C "Entprellzeit für Dfp_FrmMngswtPSPOff" VALUE 0xD1B72 Kw_Wu16 655350.0 Time_ms 0.00 655350.0 FORMAT "%8.1" /end CHARACTERISTIC
/begin CHARACTERISTIC DSM_SdwDfp_GearbxIncMax_C "Enprellzeit Shadow Zustand für Fehlerpfad Dfp_GearbxIncMax" VALUE 0xD1B74 Kw_Wu16 655350.0 Time_ms 0.00 655350.0 FORMAT "%8.1" /end CHARACTERISTIC
/begin CHARACTERISTIC DSM_SdwDfp_GlwCD_C "Enprellzeit Shadow Zustand für Fehlerpfad Dfp_GlwCD" VALUE 0xD1B76 Kw_Wu16 655350.0 Time_ms 0.00 655350.0 FORMAT "%8.1" /end CHARACTERISTIC
/begin CHARACTERISTIC DSM_SdwDfp_GlwCDGlwCirc1_C "Enprellzeit Shadow Zustand für Fehlerpfad Dfp_GlwCDGlwCirc1" VALUE 0xD1B78 Kw_Wu16 655350.0 Time_ms 0.00 655350.0 FORMAT "%8.1" /end CHARACTERISTIC
/begin CHARACTERISTIC DSM_SdwDfp_GlwCDGlwCirc2_C "Enprellzeit Shadow Zustand für Fehlerpfad Dfp_GlwCDGlwCirc2" VALUE 0xD1B7A Kw_Wu16 655350.0 Time_ms 0.00 655350.0 FORMAT "%8.1" /end CHARACTERISTIC
/begin CHARACTERISTIC DSM_SdwDfp_GlwCDGlwCirc3_C "Enprellzeit Shadow Zustand für Fehlerpfad Dfp_GlwCDGlwCirc3" VALUE 0xD1B7C Kw_Wu16 655350.0 Time_ms 0.00 655350.0 FORMAT "%8.1" /end CHARACTERISTIC
/begin CHARACTERISTIC DSM_SdwDfp_GlwCDGlwCirc4_C "Enprellzeit Shadow Zustand für Fehlerpfad Dfp_GlwCDGlwCirc4" VALUE 0xD1B7E Kw_Wu16 655350.0 Time_ms 0.00 655350.0 FORMAT "%8.1" /end CHARACTERISTIC
/begin CHARACTERISTIC DSM_SdwDfp_GlwCDGlwCirc5_C "Enprellzeit Shadow Zustand für Fehlerpfad Dfp_GlwCDGlwCirc5" VALUE 0xD1B80 Kw_Wu16 655350.0 Time_ms 0.00 655350.0 FORMAT "%8.1" /end CHARACTERISTIC
/begin CHARACTERISTIC DSM_SdwDfp_GlwCDGlwCirc6_C "Enprellzeit Shadow Zustand für Fehlerpfad Dfp_GlwCDGlwCirc6" VALUE 0xD1B82 Kw_Wu16 655350.0 Time_ms 0.00 655350.0 FORMAT "%8.1" /end CHARACTERISTIC
/begin CHARACTERISTIC DSM_SdwDfp_GlwCDGlwCirc7_C "Enprellzeit Shadow Zustand für Fehlerpfad Dfp_GlwCDGlwCirc7" VALUE 0xD1B84 Kw_Wu16 655350.0 Time_ms 0.00 655350.0 FORMAT "%8.1" /end CHARACTERISTIC
/begin CHARACTERISTIC DSM_SdwDfp_GlwCDGlwCirc8_C "Enprellzeit Shadow Zustand für Fehlerpfad Dfp_GlwCDGlwCirc8" VALUE 0xD1B86 Kw_Wu16 655350.0 Time_ms 0.00 655350.0 FORMAT "%8.1" /end CHARACTERISTIC
/begin CHARACTERISTIC DSM_SdwDfp_GlwCtl_C "Enprellzeit Shadow Zustand für Fehlerpfad Dfp_GlwCtl" VALUE 0xD1B88 Kw_Wu16 655350.0 Time_ms 0.00 655350.0 FORMAT "%8.1" /end CHARACTERISTIC
/begin CHARACTERISTIC DSM_SdwDfp_HWEMonCom_C "Enprellzeit Shadow Zustand für Fehlerpfad Dfp_HWEMonCom" VALUE 0xD1B8A Kw_Wu16 655350.0 Time_ms 0.00 655350.0 FORMAT "%8.1" /end CHARACTERISTIC
/begin CHARACTERISTIC DSM_SdwDfp_HWEMonEEPROM_C "Enprellzeit Shadow Zustand für Fehlerpfad Dfp_HWEMonEEPROM" VALUE 0xD1B8C Kw_Wu16 655350.0 Time_ms 0.00 655350.0 FORMAT "%8.1" /end CHARACTERISTIC
/begin CHARACTERISTIC DSM_SdwDfp_HWEMonRcyLocked_C "Enprellzeit Shadow Zustand für Fehlerpfad Dfp_HWEMonRcyLocked" VALUE 0xD1B8E Kw_Wu16 655350.0 Time_ms 0.00 655350.0 FORMAT "%8.1" /end CHARACTERISTIC
/begin CHARACTERISTIC DSM_SdwDfp_HWEMonRcySuppressed_C "Enprellzeit Shadow Zustand für Fehlerpfad Dfp_HWEMonRcySuppressed" VALUE 0xD1B90 Kw_Wu16 655350.0 Time_ms 0.00 655350.0 FORMAT "%8.1" /end CHARACTERISTIC
/begin CHARACTERISTIC DSM_SdwDfp_HWEMonRcyVisible_C "Enprellzeit Shadow Zustand für Fehlerpfad Dfp_HWEMonRcyVisible" VALUE 0xD1B92 Kw_Wu16 655350.0 Time_ms 0.00 655350.0 FORMAT "%8.1" /end CHARACTERISTIC
/begin CHARACTERISTIC DSM_SdwDfp_HWEMonUMaxSupply_C "Enprellzeit Shadow Zustand für Fehlerpfad Dfp_HWEMonUMaxSupply" VALUE 0xD1B94 Kw_Wu16 655350.0 Time_ms 0.00 655350.0 FORMAT "%8.1" /end CHARACTERISTIC
/begin CHARACTERISTIC DSM_SdwDfp_HWEMonUMinSupply_C "Enprellzeit Shadow Zustand für Fehlerpfad Dfp_HWEMonUMinSupply" VALUE 0xD1B96 Kw_Wu16 655350.0 Time_ms 0.00 655350.0 FORMAT "%8.1" /end CHARACTERISTIC
/begin CHARACTERISTIC DSM_SdwDfp_IATSCD_C "Enprellzeit Shadow Zustand für Fehlerpfad Dfp_IATSCD" VALUE 0xD1B98 Kw_Wu16 655350.0 Time_ms 0.00 655350.0 FORMAT "%8.1" /end CHARACTERISTIC
/begin CHARACTERISTIC DSM_SdwDfp_IATSCD_CATS_C "Enprellzeit Shadow Zustand für Fehlerpfad Dfp_IATSCD_CATS" VALUE 0xD1B9A Kw_Wu16 655350.0 Time_ms 0.00 655350.0 FORMAT "%8.1" /end CHARACTERISTIC
/begin CHARACTERISTIC DSM_SdwDfp_IATSCD_CATSSec_C "Enprellzeit Shadow Zustand für Fehlerpfad Dfp_IATSCD_CATSSec" VALUE 0xD1B9C Kw_Wu16 655350.0 Time_ms 0.00 655350.0 FORMAT "%8.1" /end CHARACTERISTIC
/begin CHARACTERISTIC DSM_SdwDfp_ImmCtlImmCD_C "Enprellzeit Shadow Zustand für Fehlerpfad Dfp_ImmCtlImmCD" VALUE 0xD1B9E Kw_Wu16 655350.0 Time_ms 0.00 655350.0 FORMAT "%8.1" /end CHARACTERISTIC
/begin CHARACTERISTIC DSM_SdwDfp_ImmCtlImmEep_C "Enprellzeit Shadow Zustand für Fehlerpfad Dfp_ImmCtlImmEep" VALUE 0xD1BA0 Kw_Wu16 655350.0 Time_ms 0.00 655350.0 FORMAT "%8.1" /end CHARACTERISTIC
/begin CHARACTERISTIC DSM_SdwDfp_ImmCtlMpl_C "Enprellzeit Shadow Zustand für Fehlerpfad Dfp_ImmCtlMpl" VALUE 0xD1BA2 Kw_Wu16 655350.0 Time_ms 0.00 655350.0 FORMAT "%8.1" /end CHARACTERISTIC
/begin CHARACTERISTIC DSM_SdwDfp_IndSys1_C "Enprellzeit Shadow Zustand für Fehlerpfad Dfp_IndSys1" VALUE 0xD1BA4 Kw_Wu16 655350.0 Time_ms 0.00 655350.0 FORMAT "%8.1" /end CHARACTERISTIC
/begin CHARACTERISTIC DSM_SdwDfp_IndSys2_C "Enprellzeit Shadow Zustand für Fehlerpfad Dfp_IndSys2" VALUE 0xD1BA6 Kw_Wu16 655350.0 Time_ms 0.00 655350.0 FORMAT "%8.1" /end CHARACTERISTIC
/begin CHARACTERISTIC DSM_SdwDfp_InjCrv_InjLim_C "Enprellzeit Shadow Zustand für Fehlerpfad Dfp_InjCrv_InjLim" VALUE 0xD1BA8 Kw_Wu16 655350.0 Time_ms 0.00 655350.0 FORMAT "%8.1" /end CHARACTERISTIC
/begin CHARACTERISTIC DSM_SdwDfp_InjCtlAdjQnt_C "Enprellzeit Shadow Zustand für Fehlerpfad Dfp_InjCtlAdjQnt" VALUE 0xD1BAA Kw_Wu16 655350.0 Time_ms 0.00 655350.0 FORMAT "%8.1" /end CHARACTERISTIC
/begin CHARACTERISTIC DSM_SdwDfp_InjCtlDrift_C "Enprellzeit Shadow Zustand für Fehlerpfad Dfp_InjCtlDrift" VALUE 0xD1BAC Kw_Wu16 655350.0 Time_ms 0.00 655350.0 FORMAT "%8.1" /end CHARACTERISTIC
/begin CHARACTERISTIC DSM_SdwDfp_InjVCDActrChrg_C "Enprellzeit Shadow Zustand für Fehlerpfad Dfp_InjVCDActrChrg" VALUE 0xD1BAE Kw_Wu16 655350.0 Time_ms 0.00 655350.0 FORMAT "%8.1" /end CHARACTERISTIC
/begin CHARACTERISTIC DSM_SdwDfp_InjVCDActrEnrg1_C "Enprellzeit Shadow Zustand für Fehlerpfad Dfp_InjVCDActrEnrg1" VALUE 0xD1BB0 Kw_Wu16 655350.0 Time_ms 0.00 655350.0 FORMAT "%8.1" /end CHARACTERISTIC
/begin CHARACTERISTIC DSM_SdwDfp_InjVCDActrEnrg2_C "Enprellzeit Shadow Zustand für Fehlerpfad Dfp_InjVCDActrEnrg2" VALUE 0xD1BB2 Kw_Wu16 655350.0 Time_ms 0.00 655350.0 FORMAT "%8.1" /end CHARACTERISTIC
/begin CHARACTERISTIC DSM_SdwDfp_InjVCDActrEnrg3_C "Enprellzeit Shadow Zustand für Fehlerpfad Dfp_InjVCDActrEnrg3" VALUE 0xD1BB4 Kw_Wu16 655350.0 Time_ms 0.00 655350.0 FORMAT "%8.1" /end CHARACTERISTIC
/begin CHARACTERISTIC DSM_SdwDfp_InjVCDActrEnrg4_C "Enprellzeit Shadow Zustand für Fehlerpfad Dfp_InjVCDActrEnrg4" VALUE 0xD1BB6 Kw_Wu16 655350.0 Time_ms 0.00 655350.0 FORMAT "%8.1" /end CHARACTERISTIC
/begin CHARACTERISTIC DSM_SdwDfp_InjVCDActrEnrg5_C "Enprellzeit Shadow Zustand für Fehlerpfad Dfp_InjVCDActrEnrg5" VALUE 0xD1BB8 Kw_Wu16 655350.0 Time_ms 0.00 655350.0 FORMAT "%8.1" /end CHARACTERISTIC
/begin CHARACTERISTIC DSM_SdwDfp_InjVCDActrEnrg6_C "Enprellzeit Shadow Zustand für Fehlerpfad Dfp_InjVCDActrEnrg6" VALUE 0xD1BBA Kw_Wu16 655350.0 Time_ms 0.00 655350.0 FORMAT "%8.1" /end CHARACTERISTIC
/begin CHARACTERISTIC DSM_SdwDfp_InjVCDActrEnrg7_C "Enprellzeit Shadow Zustand für Fehlerpfad Dfp_InjVCDActrEnrg7" VALUE 0xD1BBC Kw_Wu16 655350.0 Time_ms 0.00 655350.0 FORMAT "%8.1" /end CHARACTERISTIC
/begin CHARACTERISTIC DSM_SdwDfp_InjVCDActrEnrg8_C "Enprellzeit Shadow Zustand für Fehlerpfad Dfp_InjVCDActrEnrg8" VALUE 0xD1BBE Kw_Wu16 655350.0 Time_ms 0.00 655350.0 FORMAT "%8.1" /end CHARACTERISTIC
/begin CHARACTERISTIC DSM_SdwDfp_InjVCDActrVolt_C "Enprellzeit Shadow Zustand für Fehlerpfad Dfp_InjVCDActrVolt" VALUE 0xD1BC0 Kw_Wu16 655350.0 Time_ms 0.00 655350.0 FORMAT "%8.1" /end CHARACTERISTIC
/begin CHARACTERISTIC DSM_SdwDfp_InjVCDClsBank1_C "Enprellzeit Shadow Zustand für Fehlerpfad Dfp_InjVCDClsBank1" VALUE 0xD1BC2 Kw_Wu16 655350.0 Time_ms 0.00 655350.0 FORMAT "%8.1" /end CHARACTERISTIC
/begin CHARACTERISTIC DSM_SdwDfp_InjVCDClsBank2_C "Enprellzeit Shadow Zustand für Fehlerpfad Dfp_InjVCDClsBank2" VALUE 0xD1BC4 Kw_Wu16 655350.0 Time_ms 0.00 655350.0 FORMAT "%8.1" /end CHARACTERISTIC
/begin CHARACTERISTIC DSM_SdwDfp_InjVCDMonCab_C "Enprellzeit Shadow Zustand für Fehlerpfad Dfp_InjVCDMonCab" VALUE 0xD1BC6 Kw_Wu16 655350.0 Time_ms 0.00 655350.0 FORMAT "%8.1" /end CHARACTERISTIC
/begin CHARACTERISTIC DSM_SdwDfp_InjVCDMonSwt_C "Enprellzeit Shadow Zustand für Fehlerpfad Dfp_InjVCDMonSwt" VALUE 0xD1BC8 Kw_Wu16 655350.0 Time_ms 0.00 655350.0 FORMAT "%8.1" /end CHARACTERISTIC
/begin CHARACTERISTIC DSM_SdwDfp_InjVCDShOffDCDC_C "Enprellzeit Shadow Zustand für Fehlerpfad Dfp_InjVCDShOffDCDC" VALUE 0xD1BCA Kw_Wu16 655350.0 Time_ms 0.00 655350.0 FORMAT "%8.1" /end CHARACTERISTIC
/begin CHARACTERISTIC DSM_SdwDfp_InjVCDUBuf1_C "Enprellzeit Shadow Zustand für Fehlerpfad Dfp_InjVCDUBuf1" VALUE 0xD1BCC Kw_Wu16 655350.0 Time_ms 0.00 655350.0 FORMAT "%8.1" /end CHARACTERISTIC
/begin CHARACTERISTIC DSM_SdwDfp_InjVCDUBuf2_C "Enprellzeit Shadow Zustand für Fehlerpfad Dfp_InjVCDUBuf2" VALUE 0xD1BCE Kw_Wu16 655350.0 Time_ms 0.00 655350.0 FORMAT "%8.1" /end CHARACTERISTIC
/begin CHARACTERISTIC DSM_SdwDfp_InjVCD_CY370Ampl_C "Enprellzeit Shadow Zustand für Fehlerpfad Dfp_InjVCD_CY370Ampl" VALUE 0xD1BD0 Kw_Wu16 655350.0 Time_ms 0.00 655350.0 FORMAT "%8.1" /end CHARACTERISTIC
/begin CHARACTERISTIC DSM_SdwDfp_InjVCD_DrvTime_C "Enprellzeit Shadow Zustand für Fehlerpfad Dfp_InjVCD_DrvTime" VALUE 0xD1BD2 Kw_Wu16 655350.0 Time_ms 0.00 655350.0 FORMAT "%8.1" /end CHARACTERISTIC
/begin CHARACTERISTIC DSM_SdwDfp_InjVCD_DrvTimeRcy_C "Enprellzeit Shadow Zustand für Fehlerpfad Dfp_InjVCD_DrvTimeRcy" VALUE 0xD1BD4 Kw_Wu16 655350.0 Time_ms 0.00 655350.0 FORMAT "%8.1" /end CHARACTERISTIC
/begin CHARACTERISTIC DSM_SdwDfp_InjVCD_TPUErr_C "Enprellzeit Shadow Zustand für Fehlerpfad Dfp_InjVCD_TPUErr" VALUE 0xD1BD6 Kw_Wu16 655350.0 Time_ms 0.00 655350.0 FORMAT "%8.1" /end CHARACTERISTIC
/begin CHARACTERISTIC DSM_SdwDfp_InjVlvBnk1A_C "Enprellzeit Shadow Zustand für Fehlerpfad Dfp_InjVlvBnk1A" VALUE 0xD1BD8 Kw_Wu16 655350.0 Time_ms 0.00 655350.0 FORMAT "%8.1" /end CHARACTERISTIC
/begin CHARACTERISTIC DSM_SdwDfp_InjVlvBnk1B_C "Enprellzeit Shadow Zustand für Fehlerpfad Dfp_InjVlvBnk1B" VALUE 0xD1BDA Kw_Wu16 655350.0 Time_ms 0.00 655350.0 FORMAT "%8.1" /end CHARACTERISTIC
/begin CHARACTERISTIC DSM_SdwDfp_InjVlvBnk2A_C "Enprellzeit Shadow Zustand für Fehlerpfad Dfp_InjVlvBnk2A" VALUE 0xD1BDC Kw_Wu16 655350.0 Time_ms 0.00 655350.0 FORMAT "%8.1" /end CHARACTERISTIC
/begin CHARACTERISTIC DSM_SdwDfp_InjVlvBnk2B_C "Enprellzeit Shadow Zustand für Fehlerpfad Dfp_InjVlvBnk2B" VALUE 0xD1BDE Kw_Wu16 655350.0 Time_ms 0.00 655350.0 FORMAT "%8.1" /end CHARACTERISTIC
/begin CHARACTERISTIC DSM_SdwDfp_InjVlvChipA_C "Enprellzeit Shadow Zustand für Fehlerpfad Dfp_InjVlvChipA" VALUE 0xD1BE0 Kw_Wu16 655350.0 Time_ms 0.00 655350.0 FORMAT "%8.1" /end CHARACTERISTIC
/begin CHARACTERISTIC DSM_SdwDfp_InjVlvChipB_C "Enprellzeit Shadow Zustand für Fehlerpfad Dfp_InjVlvChipB" VALUE 0xD1BE2 Kw_Wu16 655350.0 Time_ms 0.00 655350.0 FORMAT "%8.1" /end CHARACTERISTIC
/begin CHARACTERISTIC DSM_SdwDfp_InjVlvCyl1A_C "Enprellzeit Shadow Zustand für Fehlerpfad Dfp_InjVlvCyl1A" VALUE 0xD1BE4 Kw_Wu16 655350.0 Time_ms 0.00 655350.0 FORMAT "%8.1" /end CHARACTERISTIC
/begin CHARACTERISTIC DSM_SdwDfp_InjVlvCyl1B_C "Enprellzeit Shadow Zustand für Fehlerpfad Dfp_InjVlvCyl1B" VALUE 0xD1BE6 Kw_Wu16 655350.0 Time_ms 0.00 655350.0 FORMAT "%8.1" /end CHARACTERISTIC
/begin CHARACTERISTIC DSM_SdwDfp_InjVlvCyl1C_C "Enprellzeit Shadow Zustand für Fehlerpfad Dfp_InjVlvCyl1C" VALUE 0xD1BE8 Kw_Wu16 655350.0 Time_ms 0.00 655350.0 FORMAT "%8.1" /end CHARACTERISTIC
/begin CHARACTERISTIC DSM_SdwDfp_InjVlvCyl2A_C "Enprellzeit Shadow Zustand für Fehlerpfad Dfp_InjVlvCyl2A" VALUE 0xD1BEA Kw_Wu16 655350.0 Time_ms 0.00 655350.0 FORMAT "%8.1" /end CHARACTERISTIC
/begin CHARACTERISTIC DSM_SdwDfp_InjVlvCyl2B_C "Enprellzeit Shadow Zustand für Fehlerpfad Dfp_InjVlvCyl2B" VALUE 0xD1BEC Kw_Wu16 655350.0 Time_ms 0.00 655350.0 FORMAT "%8.1" /end CHARACTERISTIC
/begin CHARACTERISTIC DSM_SdwDfp_InjVlvCyl2C_C "Enprellzeit Shadow Zustand für Fehlerpfad Dfp_InjVlvCyl2C" VALUE 0xD1BEE Kw_Wu16 655350.0 Time_ms 0.00 655350.0 FORMAT "%8.1" /end CHARACTERISTIC
/begin CHARACTERISTIC DSM_SdwDfp_InjVlvCyl3A_C "Enprellzeit Shadow Zustand für Fehlerpfad Dfp_InjVlvCyl3A" VALUE 0xD1BF0 Kw_Wu16 655350.0 Time_ms 0.00 655350.0 FORMAT "%8.1" /end CHARACTERISTIC
/begin CHARACTERISTIC DSM_SdwDfp_InjVlvCyl3B_C "Enprellzeit Shadow Zustand für Fehlerpfad Dfp_InjVlvCyl3B" VALUE 0xD1BF2 Kw_Wu16 655350.0 Time_ms 0.00 655350.0 FORMAT "%8.1" /end CHARACTERISTIC
/begin CHARACTERISTIC DSM_SdwDfp_InjVlvCyl3C_C "Enprellzeit Shadow Zustand für Fehlerpfad Dfp_InjVlvCyl3C" VALUE 0xD1BF4 Kw_Wu16 655350.0 Time_ms 0.00 655350.0 FORMAT "%8.1" /end CHARACTERISTIC
/begin CHARACTERISTIC DSM_SdwDfp_InjVlvCyl4A_C "Enprellzeit Shadow Zustand für Fehlerpfad Dfp_InjVlvCyl4A" VALUE 0xD1BF6 Kw_Wu16 655350.0 Time_ms 0.00 655350.0 FORMAT "%8.1" /end CHARACTERISTIC
/begin CHARACTERISTIC DSM_SdwDfp_InjVlvCyl4B_C "Enprellzeit Shadow Zustand für Fehlerpfad Dfp_InjVlvCyl4B" VALUE 0xD1BF8 Kw_Wu16 655350.0 Time_ms 0.00 655350.0 FORMAT "%8.1" /end CHARACTERISTIC
/begin CHARACTERISTIC DSM_SdwDfp_InjVlvCyl4C_C "Enprellzeit Shadow Zustand für Fehlerpfad Dfp_InjVlvCyl4C" VALUE 0xD1BFA Kw_Wu16 655350.0 Time_ms 0.00 655350.0 FORMAT "%8.1" /end CHARACTERISTIC
/begin CHARACTERISTIC DSM_SdwDfp_InjVlvCyl5A_C "Enprellzeit Shadow Zustand für Fehlerpfad Dfp_InjVlvCyl5A" VALUE 0xD1BFC Kw_Wu16 655350.0 Time_ms 0.00 655350.0 FORMAT "%8.1" /end CHARACTERISTIC
/begin CHARACTERISTIC DSM_SdwDfp_InjVlvCyl5B_C "Enprellzeit Shadow Zustand für Fehlerpfad Dfp_InjVlvCyl5B" VALUE 0xD1BFE Kw_Wu16 655350.0 Time_ms 0.00 655350.0 FORMAT "%8.1" /end CHARACTERISTIC
/begin CHARACTERISTIC DSM_SdwDfp_InjVlvCyl5C_C "Enprellzeit Shadow Zustand für Fehlerpfad Dfp_InjVlvCyl5C" VALUE 0xD1C00 Kw_Wu16 655350.0 Time_ms 0.00 655350.0 FORMAT "%8.1" /end CHARACTERISTIC
/begin CHARACTERISTIC DSM_SdwDfp_InjVlvCyl6A_C "Enprellzeit Shadow Zustand für Fehlerpfad Dfp_InjVlvCyl6A" VALUE 0xD1C02 Kw_Wu16 655350.0 Time_ms 0.00 655350.0 FORMAT "%8.1" /end CHARACTERISTIC
/begin CHARACTERISTIC DSM_SdwDfp_InjVlvCyl6B_C "Enprellzeit Shadow Zustand für Fehlerpfad Dfp_InjVlvCyl6B" VALUE 0xD1C04 Kw_Wu16 655350.0 Time_ms 0.00 655350.0 FORMAT "%8.1" /end CHARACTERISTIC
/begin CHARACTERISTIC DSM_SdwDfp_InjVlvCyl6C_C "Enprellzeit Shadow Zustand für Fehlerpfad Dfp_InjVlvCyl6C" VALUE 0xD1C06 Kw_Wu16 655350.0 Time_ms 0.00 655350.0 FORMAT "%8.1" /end CHARACTERISTIC
/begin CHARACTERISTIC DSM_SdwDfp_InjVlvCyl7A_C "Enprellzeit Shadow Zustand für Fehlerpfad Dfp_InjVlvCyl7A" VALUE 0xD1C08 Kw_Wu16 655350.0 Time_ms 0.00 655350.0 FORMAT "%8.1" /end CHARACTERISTIC
/begin CHARACTERISTIC DSM_SdwDfp_InjVlvCyl7B_C "Enprellzeit Shadow Zustand für Fehlerpfad Dfp_InjVlvCyl7B" VALUE 0xD1C0A Kw_Wu16 655350.0 Time_ms 0.00 655350.0 FORMAT "%8.1" /end CHARACTERISTIC
/begin CHARACTERISTIC DSM_SdwDfp_InjVlvCyl7C_C "Enprellzeit Shadow Zustand für Fehlerpfad Dfp_InjVlvCyl7C" VALUE 0xD1C0C Kw_Wu16 655350.0 Time_ms 0.00 655350.0 FORMAT "%8.1" /end CHARACTERISTIC
/begin CHARACTERISTIC DSM_SdwDfp_InjVlvCyl8A_C "Enprellzeit Shadow Zustand für Fehlerpfad Dfp_InjVlvCyl8A" VALUE 0xD1C0E Kw_Wu16 655350.0 Time_ms 0.00 655350.0 FORMAT "%8.1" /end CHARACTERISTIC
/begin CHARACTERISTIC DSM_SdwDfp_InjVlvCyl8B_C "Enprellzeit Shadow Zustand für Fehlerpfad Dfp_InjVlvCyl8B" VALUE 0xD1C10 Kw_Wu16 655350.0 Time_ms 0.00 655350.0 FORMAT "%8.1" /end CHARACTERISTIC
/begin CHARACTERISTIC DSM_SdwDfp_InjVlvCyl8C_C "Enprellzeit Shadow Zustand für Fehlerpfad Dfp_InjVlvCyl8C" VALUE 0xD1C12 Kw_Wu16 655350.0 Time_ms 0.00 655350.0 FORMAT "%8.1" /end CHARACTERISTIC
/begin CHARACTERISTIC DSM_SdwDfp_InjVlvNVC1_C "Enprellzeit Shadow Zustand für Fehlerpfad Dfp_InjVlvNVC1" VALUE 0xD1C14 Kw_Wu16 655350.0 Time_ms 0.00 655350.0 FORMAT "%8.1" /end CHARACTERISTIC
/begin CHARACTERISTIC DSM_SdwDfp_InjVlvNVC2_C "Enprellzeit Shadow Zustand für Fehlerpfad Dfp_InjVlvNVC2" VALUE 0xD1C16 Kw_Wu16 655350.0 Time_ms 0.00 655350.0 FORMAT "%8.1" /end CHARACTERISTIC
/begin CHARACTERISTIC DSM_SdwDfp_InjVlvNVC3_C "Enprellzeit Shadow Zustand für Fehlerpfad Dfp_InjVlvNVC3" VALUE 0xD1C18 Kw_Wu16 655350.0 Time_ms 0.00 655350.0 FORMAT "%8.1" /end CHARACTERISTIC
/begin CHARACTERISTIC DSM_SdwDfp_InjVlvNVC4_C "Enprellzeit Shadow Zustand für Fehlerpfad Dfp_InjVlvNVC4" VALUE 0xD1C1A Kw_Wu16 655350.0 Time_ms 0.00 655350.0 FORMAT "%8.1" /end CHARACTERISTIC
/begin CHARACTERISTIC DSM_SdwDfp_InjVlvNVC5_C "Enprellzeit Shadow Zustand für Fehlerpfad Dfp_InjVlvNVC5" VALUE 0xD1C1C Kw_Wu16 655350.0 Time_ms 0.00 655350.0 FORMAT "%8.1" /end CHARACTERISTIC
/begin CHARACTERISTIC DSM_SdwDfp_InjVlvNVC6_C "Enprellzeit Shadow Zustand für Fehlerpfad Dfp_InjVlvNVC6" VALUE 0xD1C1E Kw_Wu16 655350.0 Time_ms 0.00 655350.0 FORMAT "%8.1" /end CHARACTERISTIC
/begin CHARACTERISTIC DSM_SdwDfp_InjVlvNVC7_C "Enprellzeit Shadow Zustand für Fehlerpfad Dfp_InjVlvNVC7" VALUE 0xD1C20 Kw_Wu16 655350.0 Time_ms 0.00 655350.0 FORMAT "%8.1" /end CHARACTERISTIC
/begin CHARACTERISTIC DSM_SdwDfp_InjVlvNVC8_C "Enprellzeit Shadow Zustand für Fehlerpfad Dfp_InjVlvNVC8" VALUE 0xD1C22 Kw_Wu16 655350.0 Time_ms 0.00 655350.0 FORMAT "%8.1" /end CHARACTERISTIC
/begin CHARACTERISTIC DSM_SdwDfp_KeyCheck_C "Enprellzeit Shadow Zustand für Fehlerpfad Dfp_KeyCheck" VALUE 0xD1C24 Kw_Wu16 655350.0 Time_ms 0.00 655350.0 FORMAT "%8.1" /end CHARACTERISTIC
/begin CHARACTERISTIC DSM_SdwDfp_LIGovECUTransMode_C "Enprellzeit Shadow Zustand für Fehlerpfad Dfp_LIGovECUTransMode" VALUE 0xD1C26 Kw_Wu16 655350.0 Time_ms 0.00 655350.0 FORMAT "%8.1" /end CHARACTERISTIC
/begin CHARACTERISTIC DSM_SdwDfp_LPACD_Max_C "Enprellzeit Shadow Zustand für Fehlerpfad Dfp_LPACD_Max" VALUE 0xD1C28 Kw_Wu16 655350.0 Time_ms 0.00 655350.0 FORMAT "%8.1" /end CHARACTERISTIC
/begin CHARACTERISTIC DSM_SdwDfp_LPACD_Min_C "Enprellzeit Shadow Zustand für Fehlerpfad Dfp_LPACD_Min" VALUE 0xD1C2A Kw_Wu16 655350.0 Time_ms 0.00 655350.0 FORMAT "%8.1" /end CHARACTERISTIC
/begin CHARACTERISTIC DSM_SdwDfp_LPACD_SigNpl_C "Enprellzeit Shadow Zustand für Fehlerpfad Dfp_LPACD_SigNpl" VALUE 0xD1C2C Kw_Wu16 655350.0 Time_ms 0.00 655350.0 FORMAT "%8.1" /end CHARACTERISTIC
/begin CHARACTERISTIC DSM_SdwDfp_LSUCDCircNernst0B1_C "Enprellzeit Shadow Zustand für Fehlerpfad Dfp_LSUCDCircNernst0B1" VALUE 0xD1C2E Kw_Wu16 655350.0 Time_ms 0.00 655350.0 FORMAT "%8.1" /end CHARACTERISTIC
/begin CHARACTERISTIC DSM_SdwDfp_LSUCDCircNernst0B2_C "Enprellzeit Shadow Zustand für Fehlerpfad Dfp_LSUCDCircNernst0B2" VALUE 0xD1C30 Kw_Wu16 655350.0 Time_ms 0.00 655350.0 FORMAT "%8.1" /end CHARACTERISTIC
/begin CHARACTERISTIC DSM_SdwDfp_LSUCDCircPumpCur0B1_C "Enprellzeit Shadow Zustand für Fehlerpfad Dfp_LSUCDCircPumpCur0B1" VALUE 0xD1C32 Kw_Wu16 655350.0 Time_ms 0.00 655350.0 FORMAT "%8.1" /end CHARACTERISTIC
/begin CHARACTERISTIC DSM_SdwDfp_LSUCDCircPumpCur0B2_C "Enprellzeit Shadow Zustand für Fehlerpfad Dfp_LSUCDCircPumpCur0B2" VALUE 0xD1C34 Kw_Wu16 655350.0 Time_ms 0.00 655350.0 FORMAT "%8.1" /end CHARACTERISTIC
/begin CHARACTERISTIC DSM_SdwDfp_LSUCDCircVirtGnd0B1_C "Enprellzeit Shadow Zustand für Fehlerpfad Dfp_LSUCDCircVirtGnd0B1" VALUE 0xD1C36 Kw_Wu16 655350.0 Time_ms 0.00 655350.0 FORMAT "%8.1" /end CHARACTERISTIC
/begin CHARACTERISTIC DSM_SdwDfp_LSUCDCircVirtGnd0B2_C "Enprellzeit Shadow Zustand für Fehlerpfad Dfp_LSUCDCircVirtGnd0B2" VALUE 0xD1C38 Kw_Wu16 655350.0 Time_ms 0.00 655350.0 FORMAT "%8.1" /end CHARACTERISTIC
/begin CHARACTERISTIC DSM_SdwDfp_LSUCDHeater0B1_C "Enprellzeit Shadow Zustand für Fehlerpfad Dfp_LSUCDHeater0B1" VALUE 0xD1C3A Kw_Wu16 655350.0 Time_ms 0.00 655350.0 FORMAT "%8.1" /end CHARACTERISTIC
/begin CHARACTERISTIC DSM_SdwDfp_LSUCDHeater0B2_C "Enprellzeit Shadow Zustand für Fehlerpfad Dfp_LSUCDHeater0B2" VALUE 0xD1C3C Kw_Wu16 655350.0 Time_ms 0.00 655350.0 FORMAT "%8.1" /end CHARACTERISTIC
/begin CHARACTERISTIC DSM_SdwDfp_LSUCDHtCoup0B1_C "Enprellzeit Shadow Zustand für Fehlerpfad Dfp_LSUCDHtCoup0B1" VALUE 0xD1C3E Kw_Wu16 655350.0 Time_ms 0.00 655350.0 FORMAT "%8.1" /end CHARACTERISTIC
/begin CHARACTERISTIC DSM_SdwDfp_LSUCDHtCoup0B2_C "Enprellzeit Shadow Zustand für Fehlerpfad Dfp_LSUCDHtCoup0B2" VALUE 0xD1C40 Kw_Wu16 655350.0 Time_ms 0.00 655350.0 FORMAT "%8.1" /end CHARACTERISTIC
/begin CHARACTERISTIC DSM_SdwDfp_LSUCDO20B1_C "Enprellzeit Shadow Zustand für Fehlerpfad Dfp_LSUCDO20B1" VALUE 0xD1C42 Kw_Wu16 655350.0 Time_ms 0.00 655350.0 FORMAT "%8.1" /end CHARACTERISTIC
/begin CHARACTERISTIC DSM_SdwDfp_LSUCDO20B2_C "Enprellzeit Shadow Zustand für Fehlerpfad Dfp_LSUCDO20B2" VALUE 0xD1C44 Kw_Wu16 655350.0 Time_ms 0.00 655350.0 FORMAT "%8.1" /end CHARACTERISTIC
/begin CHARACTERISTIC DSM_SdwDfp_LSUCDO2Clb0B1_C "Enprellzeit Shadow Zustand für Fehlerpfad Dfp_LSUCDO2Clb0B1" VALUE 0xD1C46 Kw_Wu16 655350.0 Time_ms 0.00 655350.0 FORMAT "%8.1" /end CHARACTERISTIC
/begin CHARACTERISTIC DSM_SdwDfp_LSUCDO2Clb0B2_C "Enprellzeit Shadow Zustand für Fehlerpfad Dfp_LSUCDO2Clb0B2" VALUE 0xD1C48 Kw_Wu16 655350.0 Time_ms 0.00 655350.0 FORMAT "%8.1" /end CHARACTERISTIC
/begin CHARACTERISTIC DSM_SdwDfp_LSUCDRiClb0B1_C "Enprellzeit Shadow Zustand für Fehlerpfad Dfp_LSUCDRiClb0B1" VALUE 0xD1C4A Kw_Wu16 655350.0 Time_ms 0.00 655350.0 FORMAT "%8.1" /end CHARACTERISTIC
/begin CHARACTERISTIC DSM_SdwDfp_LSUCDRiClb0B2_C "Enprellzeit Shadow Zustand für Fehlerpfad Dfp_LSUCDRiClb0B2" VALUE 0xD1C4C Kw_Wu16 655350.0 Time_ms 0.00 655350.0 FORMAT "%8.1" /end CHARACTERISTIC
/begin CHARACTERISTIC DSM_SdwDfp_LSUCDSPI0B1_C "Enprellzeit Shadow Zustand für Fehlerpfad Dfp_LSUCDSPI0B1" VALUE 0xD1C4E Kw_Wu16 655350.0 Time_ms 0.00 655350.0 FORMAT "%8.1" /end CHARACTERISTIC
/begin CHARACTERISTIC DSM_SdwDfp_LSUCDSPI0B2_C "Enprellzeit Shadow Zustand für Fehlerpfad Dfp_LSUCDSPI0B2" VALUE 0xD1C50 Kw_Wu16 655350.0 Time_ms 0.00 655350.0 FORMAT "%8.1" /end CHARACTERISTIC
/begin CHARACTERISTIC DSM_SdwDfp_LSUCDSPIBattLow0B1_C "Enprellzeit Shadow Zustand für Fehlerpfad Dfp_LSUCDSPIBattLow0B1" VALUE 0xD1C52 Kw_Wu16 655350.0 Time_ms 0.00 655350.0 FORMAT "%8.1" /end CHARACTERISTIC
/begin CHARACTERISTIC DSM_SdwDfp_LSUCDSPIBattLow0B2_C "Enprellzeit Shadow Zustand für Fehlerpfad Dfp_LSUCDSPIBattLow0B2" VALUE 0xD1C54 Kw_Wu16 655350.0 Time_ms 0.00 655350.0 FORMAT "%8.1" /end CHARACTERISTIC
/begin CHARACTERISTIC DSM_SdwDfp_LSUCDWireIP0B1_C "Enprellzeit Shadow Zustand für Fehlerpfad Dfp_LSUCDWireIP0B1" VALUE 0xD1C56 Kw_Wu16 655350.0 Time_ms 0.00 655350.0 FORMAT "%8.1" /end CHARACTERISTIC
/begin CHARACTERISTIC DSM_SdwDfp_LSUCDWireIP0B2_C "Enprellzeit Shadow Zustand für Fehlerpfad Dfp_LSUCDWireIP0B2" VALUE 0xD1C58 Kw_Wu16 655350.0 Time_ms 0.00 655350.0 FORMAT "%8.1" /end CHARACTERISTIC
/begin CHARACTERISTIC DSM_SdwDfp_LSUCtlRiExc0B1_C "Enprellzeit Shadow Zustand für Fehlerpfad Dfp_LSUCtlRiExc0B1" VALUE 0xD1C5A Kw_Wu16 655350.0 Time_ms 0.00 655350.0 FORMAT "%8.1" /end CHARACTERISTIC
/begin CHARACTERISTIC DSM_SdwDfp_LSUCtlRiExc0B2_C "Enprellzeit Shadow Zustand für Fehlerpfad Dfp_LSUCtlRiExc0B2" VALUE 0xD1C5C Kw_Wu16 655350.0 Time_ms 0.00 655350.0 FORMAT "%8.1" /end CHARACTERISTIC
/begin CHARACTERISTIC DSM_SdwDfp_LSUMon1SensB1_C "Enprellzeit Shadow Zustand für Fehlerpfad Dfp_LSUMon1SensB1" VALUE 0xD1C5E Kw_Wu16 655350.0 Time_ms 0.00 655350.0 FORMAT "%8.1" /end CHARACTERISTIC
/begin CHARACTERISTIC DSM_SdwDfp_LSUMon1SensB2_C "Enprellzeit Shadow Zustand für Fehlerpfad Dfp_LSUMon1SensB2" VALUE 0xD1C60 Kw_Wu16 655350.0 Time_ms 0.00 655350.0 FORMAT "%8.1" /end CHARACTERISTIC
/begin CHARACTERISTIC DSM_SdwDfp_LSUMon2SensB1_C "Enprellzeit Shadow Zustand für Fehlerpfad Dfp_LSUMon2SensB1" VALUE 0xD1C62 Kw_Wu16 655350.0 Time_ms 0.00 655350.0 FORMAT "%8.1" /end CHARACTERISTIC
/begin CHARACTERISTIC DSM_SdwDfp_LSUMon2SensB2_C "Enprellzeit Shadow Zustand für Fehlerpfad Dfp_LSUMon2SensB2" VALUE 0xD1C64 Kw_Wu16 655350.0 Time_ms 0.00 655350.0 FORMAT "%8.1" /end CHARACTERISTIC
/begin CHARACTERISTIC DSM_SdwDfp_MIL_C "Enprellzeit Shadow Zustand für Fehlerpfad Dfp_MIL" VALUE 0xD1C66 Kw_Wu16 655350.0 Time_ms 0.00 655350.0 FORMAT "%8.1" /end CHARACTERISTIC
/begin CHARACTERISTIC DSM_SdwDfp_MRlyCD_C "Enprellzeit Shadow Zustand für Fehlerpfad Dfp_MRlyCD" VALUE 0xD1C68 Kw_Wu16 655350.0 Time_ms 0.00 655350.0 FORMAT "%8.1" /end CHARACTERISTIC
/begin CHARACTERISTIC DSM_SdwDfp_MSMon_C "Enprellzeit Shadow Zustand für Fehlerpfad Dfp_MSMon" VALUE 0xD1C6A Kw_Wu16 655350.0 Time_ms 0.00 655350.0 FORMAT "%8.1" /end CHARACTERISTIC
/begin CHARACTERISTIC DSM_SdwDfp_MSMonConsist_C "Enprellzeit Shadow Zustand für Fehlerpfad Dfp_MSMonConsist" VALUE 0xD1C6C Kw_Wu16 655350.0 Time_ms 0.00 655350.0 FORMAT "%8.1" /end CHARACTERISTIC
/begin CHARACTERISTIC DSM_SdwDfp_MSMonPFlt1_C "Enprellzeit Shadow Zustand für Fehlerpfad Dfp_MSMonPFlt1" VALUE 0xD1C6E Kw_Wu16 655350.0 Time_ms 0.00 655350.0 FORMAT "%8.1" /end CHARACTERISTIC
/begin CHARACTERISTIC DSM_SdwDfp_MSMonPFlt2_C "Enprellzeit Shadow Zustand für Fehlerpfad Dfp_MSMonPFlt2" VALUE 0xD1C70 Kw_Wu16 655350.0 Time_ms 0.00 655350.0 FORMAT "%8.1" /end CHARACTERISTIC
/begin CHARACTERISTIC DSM_SdwDfp_MSMonPFlt3_C "Enprellzeit Shadow Zustand für Fehlerpfad Dfp_MSMonPFlt3" VALUE 0xD1C72 Kw_Wu16 655350.0 Time_ms 0.00 655350.0 FORMAT "%8.1" /end CHARACTERISTIC
/begin CHARACTERISTIC DSM_SdwDfp_MSMonPFlt4_C "Enprellzeit Shadow Zustand für Fehlerpfad Dfp_MSMonPFlt4" VALUE 0xD1C74 Kw_Wu16 655350.0 Time_ms 0.00 655350.0 FORMAT "%8.1" /end CHARACTERISTIC
/begin CHARACTERISTIC DSM_SdwDfp_MSMon_ARS_TO_C "Enprellzeit Shadow Zustand für Fehlerpfad Dfp_MSMon_ARS_TO" VALUE 0xD1C76 Kw_Wu16 655350.0 Time_ms 0.00 655350.0 FORMAT "%8.1" /end CHARACTERISTIC
/begin CHARACTERISTIC DSM_SdwDfp_MSMon_AirCtl_C "Enprellzeit Shadow Zustand für Fehlerpfad Dfp_MSMon_AirCtl" VALUE 0xD1C78 Kw_Wu16 655350.0 Time_ms 0.00 655350.0 FORMAT "%8.1" /end CHARACTERISTIC
/begin CHARACTERISTIC DSM_SdwDfp_MSMon_AirSys0_C "Enprellzeit Shadow Zustand für Fehlerpfad Dfp_MSMon_AirSys0" VALUE 0xD1C7A Kw_Wu16 655350.0 Time_ms 0.00 655350.0 FORMAT "%8.1" /end CHARACTERISTIC
/begin CHARACTERISTIC DSM_SdwDfp_MSMon_AirSys1_C "Enprellzeit Shadow Zustand für Fehlerpfad Dfp_MSMon_AirSys1" VALUE 0xD1C7C Kw_Wu16 655350.0 Time_ms 0.00 655350.0 FORMAT "%8.1" /end CHARACTERISTIC
/begin CHARACTERISTIC DSM_SdwDfp_MSMon_AirSys2_C "Enprellzeit Shadow Zustand für Fehlerpfad Dfp_MSMon_AirSys2" VALUE 0xD1C7E Kw_Wu16 655350.0 Time_ms 0.00 655350.0 FORMAT "%8.1" /end CHARACTERISTIC
/begin CHARACTERISTIC DSM_SdwDfp_MSMon_AirSys3_C "Enprellzeit Shadow Zustand für Fehlerpfad Dfp_MSMon_AirSys3" VALUE 0xD1C80 Kw_Wu16 655350.0 Time_ms 0.00 655350.0 FORMAT "%8.1" /end CHARACTERISTIC
/begin CHARACTERISTIC DSM_SdwDfp_MSMon_AirSys4_C "Enprellzeit Shadow Zustand für Fehlerpfad Dfp_MSMon_AirSys4" VALUE 0xD1C82 Kw_Wu16 655350.0 Time_ms 0.00 655350.0 FORMAT "%8.1" /end CHARACTERISTIC
/begin CHARACTERISTIC DSM_SdwDfp_MSMon_AirSys7_C "Enprellzeit Shadow Zustand für Fehlerpfad Dfp_MSMon_AirSys7" VALUE 0xD1C84 Kw_Wu16 655350.0 Time_ms 0.00 655350.0 FORMAT "%8.1" /end CHARACTERISTIC
/begin CHARACTERISTIC DSM_SdwDfp_MSMon_CanDef_C "Enprellzeit Shadow Zustand für Fehlerpfad Dfp_MSMon_CanDef" VALUE 0xD1C86 Kw_Wu16 655350.0 Time_ms 0.00 655350.0 FORMAT "%8.1" /end CHARACTERISTIC
/begin CHARACTERISTIC DSM_SdwDfp_MSMon_CoEng_OffVeh_C "Enprellzeit Shadow Zustand für Fehlerpfad Dfp_MSMon_CoEng_OffVeh_C" VALUE 0xD1C88 Kw_Wu16 655350.0 Time_ms 0.00 655350.0 FORMAT "%8.1" /end CHARACTERISTIC
/begin CHARACTERISTIC DSM_SdwDfp_MSMon_CoEng_Rev1_C "Enprellzeit Shadow Zustand für Fehlerpfad Dfp_MSMon_CoEng_Rev1_C" VALUE 0xD1C8A Kw_Wu16 655350.0 Time_ms 0.00 655350.0 FORMAT "%8.1" /end CHARACTERISTIC
/begin CHARACTERISTIC DSM_SdwDfp_MSMon_CoEng_Rev2_C "Enprellzeit Shadow Zustand für Fehlerpfad Dfp_MSMon_CoEng_Rev2_C" VALUE 0xD1C8C Kw_Wu16 655350.0 Time_ms 0.00 655350.0 FORMAT "%8.1" /end CHARACTERISTIC
/begin CHARACTERISTIC DSM_SdwDfp_MSMon_CoEng_RevMS_C "Enprellzeit Shadow Zustand für Fehlerpfad Dfp_MSMon_CoEng_RevMS_C" VALUE 0xD1C8E Kw_Wu16 655350.0 Time_ms 0.00 655350.0 FORMAT "%8.1" /end CHARACTERISTIC
/begin CHARACTERISTIC DSM_SdwDfp_MSMon_DSC_TO_C "Enprellzeit Shadow Zustand für Fehlerpfad Dfp_MSMon_DSC_TO" VALUE 0xD1C90 Kw_Wu16 655350.0 Time_ms 0.00 655350.0 FORMAT "%8.1" /end CHARACTERISTIC
/begin CHARACTERISTIC DSM_SdwDfp_MSMon_EGS_TO_C "Enprellzeit Shadow Zustand für Fehlerpfad Dfp_MSMon_EGS_TO" VALUE 0xD1C92 Kw_Wu16 655350.0 Time_ms 0.00 655350.0 FORMAT "%8.1" /end CHARACTERISTIC
/begin CHARACTERISTIC DSM_SdwDfp_MSMon_FrmMngCoEng_C "Enprellzeit Shadow Zustand für Fehlerpfad Dfp_MSMon_FrmMngCoEng" VALUE 0xD1C94 Kw_Wu16 655350.0 Time_ms 0.00 655350.0 FORMAT "%8.1" /end CHARACTERISTIC
/begin CHARACTERISTIC DSM_SdwDfp_MSMon_FrmMngPT_C "Enprellzeit Shadow Zustand für Fehlerpfad Dfp_MSMon_FrmMngPT_C" VALUE 0xD1C96 Kw_Wu16 655350.0 Time_ms 0.00 655350.0 FORMAT "%8.1" /end CHARACTERISTIC
/begin CHARACTERISTIC DSM_SdwDfp_MSMon_FrmMngPT2_C "Enprellzeit Shadow Zustand für Fehlerpfad Dfp_MSMon_FrmMngPT2" VALUE 0xD1C98 Kw_Wu16 655350.0 Time_ms 0.00 655350.0 FORMAT "%8.1" /end CHARACTERISTIC
/begin CHARACTERISTIC DSM_SdwDfp_MSMon_Mil_C "Enprellzeit Shadow Zustand für Fehlerpfad Dfp_MSMon_Mil_C" VALUE 0xD1C9A Kw_Wu16 655350.0 Time_ms 0.00 655350.0 FORMAT "%8.1" /end CHARACTERISTIC
/begin CHARACTERISTIC DSM_SdwDfp_MSMon_NetMngPtCan_C "Enprellzeit Shadow Zustand für Fehlerpfad Dfp_MSMon_NetMngPtCan" VALUE 0xD1C9C Kw_Wu16 655350.0 Time_ms 0.00 655350.0 FORMAT "%8.1" /end CHARACTERISTIC
/begin CHARACTERISTIC DSM_SdwDfp_MSMon_RailCDPMon_C "Enprellzeit Shadow Zustand für Fehlerpfad Dfp_MSMon_RailCDPMon" VALUE 0xD1C9E Kw_Wu16 655350.0 Time_ms 0.00 655350.0 FORMAT "%8.1" /end CHARACTERISTIC
/begin CHARACTERISTIC DSM_SdwDfp_MSMon_StEGS_C "Enprellzeit Shadow Zustand für Fehlerpfad Dfp_MSMon_StEGS" VALUE 0xD1CA0 Kw_Wu16 655350.0 Time_ms 0.00 655350.0 FORMAT "%8.1" /end CHARACTERISTIC
/begin CHARACTERISTIC DSM_SdwDfp_MSMon_SysLamp_C "Enprellzeit Shadow Zustand für Fehlerpfad Dfp_MSMon_SysLamp_C" VALUE 0xD1CA2 Kw_Wu16 655350.0 Time_ms 0.00 655350.0 FORMAT "%8.1" /end CHARACTERISTIC
/begin CHARACTERISTIC DSM_SdwDfp_MSMon_ZFCClbActv_C "Enprellzeit Shadow Zustand für Fehlerpfad Dfp_MSMon_ZFCClbActv" VALUE 0xD1CA4 Kw_Wu16 655350.0 Time_ms 0.00 655350.0 FORMAT "%8.1" /end CHARACTERISTIC
/begin CHARACTERISTIC DSM_SdwDfp_MSMon_qLimErr_C "Enprellzeit Shadow Zustand für Fehlerpfad Dfp_MSMon_qLimErr_C" VALUE 0xD1CA6 Kw_Wu16 655350.0 Time_ms 0.00 655350.0 FORMAT "%8.1" /end CHARACTERISTIC
/begin CHARACTERISTIC DSM_SdwDfp_MSMon_trqCoDT_C "Enprellzeit Shadow Zustand für Fehlerpfad Dfp_MSMon_trqCoDT_C" VALUE 0xD1CA8 Kw_Wu16 655350.0 Time_ms 0.00 655350.0 FORMAT "%8.1" /end CHARACTERISTIC
/begin CHARACTERISTIC DSM_SdwDfp_MSMon_trqCoVeh_C "Enprellzeit Shadow Zustand für Fehlerpfad Dfp_MSMon_trqCoVeh_C" VALUE 0xD1CAA Kw_Wu16 655350.0 Time_ms 0.00 655350.0 FORMAT "%8.1" /end CHARACTERISTIC
/begin CHARACTERISTIC DSM_SdwDfp_MSMon_trqCoVehLim_C "Enprellzeit Shadow Zustand für Fehlerpfad Dfp_MSMon_trqCoVehLim_C" VALUE 0xD1CAC Kw_Wu16 655350.0 Time_ms 0.00 655350.0 FORMAT "%8.1" /end CHARACTERISTIC
/begin CHARACTERISTIC DSM_SdwDfp_MSMon_trqDesExt_C "Enprellzeit Shadow Zustand für Fehlerpfad Dfp_MSMon_trqDesExt_C" VALUE 0xD1CAE Kw_Wu16 655350.0 Time_ms 0.00 655350.0 FORMAT "%8.1" /end CHARACTERISTIC
/begin CHARACTERISTIC DSM_SdwDfp_MSMon_trqDesExtRev_C "Enprellzeit Shadow Zustand für Fehlerpfad Dfp_MSMon_trqDesExtRev_C" VALUE 0xD1CB0 Kw_Wu16 655350.0 Time_ms 0.00 655350.0 FORMAT "%8.1" /end CHARACTERISTIC
/begin CHARACTERISTIC DSM_SdwDfp_MSMon_trqLimErr_C "Enprellzeit Shadow Zustand für Fehlerpfad Dfp_MSMon_trqLimErr_C" VALUE 0xD1CB2 Kw_Wu16 655350.0 Time_ms 0.00 655350.0 FORMAT "%8.1" /end CHARACTERISTIC
/begin CHARACTERISTIC DSM_SdwDfp_MSMon_trqLimErr1_C "Enprellzeit Shadow Zustand für Fehlerpfad Dfp_MSMon_trqLimErr1_C" VALUE 0xD1CB4 Kw_Wu16 655350.0 Time_ms 0.00 655350.0 FORMAT "%8.1" /end CHARACTERISTIC
/begin CHARACTERISTIC DSM_SdwDfp_MSMon_trqLimErr2_C "Enprellzeit Shadow Zustand für Fehlerpfad Dfp_MSMon_trqLimErr2_C" VALUE 0xD1CB6 Kw_Wu16 655350.0 Time_ms 0.00 655350.0 FORMAT "%8.1" /end CHARACTERISTIC
/begin CHARACTERISTIC DSM_SdwDfp_MSMon_trqLimErr3_C "Enprellzeit Shadow Zustand für Fehlerpfad Dfp_MSMon_trqLimErr3" VALUE 0xD1CB8 Kw_Wu16 655350.0 Time_ms 0.00 655350.0 FORMAT "%8.1" /end CHARACTERISTIC
/begin CHARACTERISTIC DSM_SdwDfp_MSMon_trqLimErr4_C "Enprellzeit Shadow Zustand für Fehlerpfad Dfp_MSMon_trqLimErr4" VALUE 0xD1CBA Kw_Wu16 655350.0 Time_ms 0.00 655350.0 FORMAT "%8.1" /end CHARACTERISTIC
/begin CHARACTERISTIC DSM_SdwDfp_MSidCD_Comm_C "Enprellzeit Shadow Zustand für Fehlerpfad Dfp_MSidCD_Comm" VALUE 0xD1CBC Kw_Wu16 655350.0 Time_ms 0.00 655350.0 FORMAT "%8.1" /end CHARACTERISTIC
/begin CHARACTERISTIC DSM_SdwDfp_MSidCD_EcuMixed_C "Enprellzeit Shadow Zustand für Fehlerpfad Dfp_MSidCD_EcuMixed" VALUE 0xD1CBE Kw_Wu16 655350.0 Time_ms 0.00 655350.0 FORMAT "%8.1" /end CHARACTERISTIC
/begin CHARACTERISTIC DSM_SdwDfp_MSidCD_Pin_C "Enprellzeit Shadow Zustand für Fehlerpfad Dfp_MSidCD_Pin" VALUE 0xD1CC0 Kw_Wu16 655350.0 Time_ms 0.00 655350.0 FORMAT "%8.1" /end CHARACTERISTIC
/begin CHARACTERISTIC DSM_SdwDfp_MSidCD_Sel_INI_C "Enprellzeit Shadow Zustand für Fehlerpfad Dfp_MSidCD_Sel_INI" VALUE 0xD1CC2 Kw_Wu16 655350.0 Time_ms 0.00 655350.0 FORMAT "%8.1" /end CHARACTERISTIC
/begin CHARACTERISTIC DSM_SdwDfp_MSidCD_Select_C "Enprellzeit Shadow Zustand für Fehlerpfad Dfp_MSidCD_Select" VALUE 0xD1CC4 Kw_Wu16 655350.0 Time_ms 0.00 655350.0 FORMAT "%8.1" /end CHARACTERISTIC
/begin CHARACTERISTIC DSM_SdwDfp_MSid_SwCmp_C "Enprellzeit Shadow Zustand für Fehlerpfad Dfp_MSid_SwCmp" VALUE 0xD1CC6 Kw_Wu16 655350.0 Time_ms 0.00 655350.0 FORMAT "%8.1" /end CHARACTERISTIC
/begin CHARACTERISTIC DSM_SdwDfp_MSid_regEEPDiff_C "Enprellzeit Shadow Zustand für Fehlerpfad Dfp_MSid_regEEPDiff" VALUE 0xD1CC8 Kw_Wu16 655350.0 Time_ms 0.00 655350.0 FORMAT "%8.1" /end CHARACTERISTIC
/begin CHARACTERISTIC DSM_SdwDfp_MeUnCDNoLoad_C "Enprellzeit Shadow Zustand für Fehlerpfad Dfp_MeUnCDNoLoad" VALUE 0xD1CCA Kw_Wu16 655350.0 Time_ms 0.00 655350.0 FORMAT "%8.1" /end CHARACTERISTIC
/begin CHARACTERISTIC DSM_SdwDfp_MeUnCDSCBat_C "Enprellzeit Shadow Zustand für Fehlerpfad Dfp_MeUnCDSCBat" VALUE 0xD1CCC Kw_Wu16 655350.0 Time_ms 0.00 655350.0 FORMAT "%8.1" /end CHARACTERISTIC
/begin CHARACTERISTIC DSM_SdwDfp_MeUnCDSCGnd_C "Enprellzeit Shadow Zustand für Fehlerpfad Dfp_MeUnCDSCGnd" VALUE 0xD1CCE Kw_Wu16 655350.0 Time_ms 0.00 655350.0 FORMAT "%8.1" /end CHARACTERISTIC
/begin CHARACTERISTIC DSM_SdwDfp_MeUnCD_ADC_C "Enprellzeit Shadow Zustand für Fehlerpfad Dfp_MeUnCD_ADC" VALUE 0xD1CD0 Kw_Wu16 655350.0 Time_ms 0.00 655350.0 FORMAT "%8.1" /end CHARACTERISTIC
/begin CHARACTERISTIC DSM_SdwDfp_MeUnCD_SigTst_C "Enprellzeit Shadow Zustand für Fehlerpfad Dfp_MeUnCD_SigTst" VALUE 0xD1CD2 Kw_Wu16 655350.0 Time_ms 0.00 655350.0 FORMAT "%8.1" /end CHARACTERISTIC
/begin CHARACTERISTIC DSM_SdwDfp_Montr_C "Enprellzeit Shadow Zustand für Fehlerpfad Dfp_Montr" VALUE 0xD1CD4 Kw_Wu16 655350.0 Time_ms 0.00 655350.0 FORMAT "%8.1" /end CHARACTERISTIC
/begin CHARACTERISTIC DSM_SdwDfp_NetMngDeviceA_C "Enprellzeit Shadow Zustand für Fehlerpfad Dfp_NetMngDeviceA" VALUE 0xD1CD6 Kw_Wu16 655350.0 Time_ms 0.00 655350.0 FORMAT "%8.1" /end CHARACTERISTIC
/begin CHARACTERISTIC DSM_SdwDfp_NetMngDeviceB_C "Enprellzeit Shadow Zustand für Fehlerpfad Dfp_NetMngDeviceB" VALUE 0xD1CD8 Kw_Wu16 655350.0 Time_ms 0.00 655350.0 FORMAT "%8.1" /end CHARACTERISTIC
/begin CHARACTERISTIC DSM_SdwDfp_NetMngDeviceC_C "Enprellzeit Shadow Zustand für Fehlerpfad Dfp_NetMngDeviceC" VALUE 0xD1CDA Kw_Wu16 655350.0 Time_ms 0.00 655350.0 FORMAT "%8.1" /end CHARACTERISTIC
/begin CHARACTERISTIC DSM_SdwDfp_NetMngPrvCan_C "Enprellzeit Shadow Zustand für Fehlerpfad Dfp_NetMngPrvCan" VALUE 0xD1CDC Kw_Wu16 655350.0 Time_ms 0.00 655350.0 FORMAT "%8.1" /end CHARACTERISTIC
/begin CHARACTERISTIC DSM_SdwDfp_NetMngPrvCanSlave_C "Enprellzeit Shadow Zustand für Fehlerpfad Dfp_NetMngPrvCanSlave" VALUE 0xD1CDE Kw_Wu16 655350.0 Time_ms 0.00 655350.0 FORMAT "%8.1" /end CHARACTERISTIC
/begin CHARACTERISTIC DSM_SdwDfp_NetMngPtCan_C "Enprellzeit Shadow Zustand für Fehlerpfad Dfp_NetMngPtCan" VALUE 0xD1CE0 Kw_Wu16 655350.0 Time_ms 0.00 655350.0 FORMAT "%8.1" /end CHARACTERISTIC
/begin CHARACTERISTIC DSM_SdwDfp_NetMngPtCanSlave_C "Enprellzeit Shadow Zustand für Fehlerpfad Dfp_NetMngPtCanSlave" VALUE 0xD1CE2 Kw_Wu16 655350.0 Time_ms 0.00 655350.0 FORMAT "%8.1" /end CHARACTERISTIC
/begin CHARACTERISTIC DSM_SdwDfp_OPSCD_Lamp_C "Enprellzeit Shadow Zustand für Fehlerpfad Dfp_OPSCD_Lamp" VALUE 0xD1CE4 Kw_Wu16 655350.0 Time_ms 0.00 655350.0 FORMAT "%8.1" /end CHARACTERISTIC
/begin CHARACTERISTIC DSM_SdwDfp_OPSCD_anain_C "Enprellzeit Shadow Zustand für Fehlerpfad Dfp_OPSCD_anain" VALUE 0xD1CE6 Kw_Wu16 655350.0 Time_ms 0.00 655350.0 FORMAT "%8.1" /end CHARACTERISTIC
/begin CHARACTERISTIC DSM_SdwDfp_OTSCD_C "Enprellzeit Shadow Zustand für Fehlerpfad Dfp_OTSCD" VALUE 0xD1CE8 Kw_Wu16 655350.0 Time_ms 0.00 655350.0 FORMAT "%8.1" /end CHARACTERISTIC
/begin CHARACTERISTIC DSM_SdwDfp_OvRMon_C "Enprellzeit Shadow Zustand für Fehlerpfad Dfp_OvRMon" VALUE 0xD1CEA Kw_Wu16 655350.0 Time_ms 0.00 655350.0 FORMAT "%8.1" /end CHARACTERISTIC
/begin CHARACTERISTIC DSM_SdwDfp_OvRMonSigA_C "Enprellzeit Shadow Zustand für Fehlerpfad Dfp_OvRMonSigA" VALUE 0xD1CEC Kw_Wu16 655350.0 Time_ms 0.00 655350.0 FORMAT "%8.1" /end CHARACTERISTIC
/begin CHARACTERISTIC DSM_SdwDfp_OxiCCDTPreB1_C "Enprellzeit Shadow Zustand für Fehlerpfad Dfp_OxiCCDTPreB1" VALUE 0xD1CEE Kw_Wu16 655350.0 Time_ms 0.00 655350.0 FORMAT "%8.1" /end CHARACTERISTIC
/begin CHARACTERISTIC DSM_SdwDfp_OxiCCDTPreB2_C "Enprellzeit Shadow Zustand für Fehlerpfad Dfp_OxiCCDTPreB2" VALUE 0xD1CF0 Kw_Wu16 655350.0 Time_ms 0.00 655350.0 FORMAT "%8.1" /end CHARACTERISTIC
/begin CHARACTERISTIC DSM_SdwDfp_PCBS_C "Enprellzeit Shadow Zustand für Fehlerpfad Dfp_PCBS" VALUE 0xD1CF2 Kw_Wu16 655350.0 Time_ms 0.00 655350.0 FORMAT "%8.1" /end CHARACTERISTIC
/begin CHARACTERISTIC DSM_SdwDfp_PCR_BalGvnr_C "Enprellzeit Shadow Zustand für Fehlerpfad Dfp_PCR_BalGvnr" VALUE 0xD1CF4 Kw_Wu16 655350.0 Time_ms 0.00 655350.0 FORMAT "%8.1" /end CHARACTERISTIC
/begin CHARACTERISTIC DSM_SdwDfp_PCR_GovDevNeg_C "Enprellzeit Shadow Zustand für Fehlerpfad Dfp_PCR_GovDevNeg" VALUE 0xD1CF6 Kw_Wu16 655350.0 Time_ms 0.00 655350.0 FORMAT "%8.1" /end CHARACTERISTIC
/begin CHARACTERISTIC DSM_SdwDfp_PCR_GovDevPos_C "Enprellzeit Shadow Zustand für Fehlerpfad Dfp_PCR_GovDevPos" VALUE 0xD1CF8 Kw_Wu16 655350.0 Time_ms 0.00 655350.0 FORMAT "%8.1" /end CHARACTERISTIC
/begin CHARACTERISTIC DSM_SdwDfp_PCR_LPGvnrDvtNeg_C "Enprellzeit Shadow Zustand für Fehlerpfad Dfp_PCR_LPGvnrDvtNeg" VALUE 0xD1CFA Kw_Wu16 655350.0 Time_ms 0.00 655350.0 FORMAT "%8.1" /end CHARACTERISTIC
/begin CHARACTERISTIC DSM_SdwDfp_PCR_LPGvnrDvtPos_C "Enprellzeit Shadow Zustand für Fehlerpfad Dfp_PCR_LPGvnrDvtPos" VALUE 0xD1CFC Kw_Wu16 655350.0 Time_ms 0.00 655350.0 FORMAT "%8.1" /end CHARACTERISTIC
/begin CHARACTERISTIC DSM_SdwDfp_PCVCDNoLoad_C "Enprellzeit Shadow Zustand für Fehlerpfad Dfp_PCVCDNoLoad" VALUE 0xD1CFE Kw_Wu16 655350.0 Time_ms 0.00 655350.0 FORMAT "%8.1" /end CHARACTERISTIC
/begin CHARACTERISTIC DSM_SdwDfp_PCVCDSCBat_C "Enprellzeit Shadow Zustand für Fehlerpfad Dfp_PCVCDSCBat" VALUE 0xD1D00 Kw_Wu16 655350.0 Time_ms 0.00 655350.0 FORMAT "%8.1" /end CHARACTERISTIC
/begin CHARACTERISTIC DSM_SdwDfp_PCVCDSCGnd_C "Enprellzeit Shadow Zustand für Fehlerpfad Dfp_PCVCDSCGnd" VALUE 0xD1D02 Kw_Wu16 655350.0 Time_ms 0.00 655350.0 FORMAT "%8.1" /end CHARACTERISTIC
/begin CHARACTERISTIC DSM_SdwDfp_PCVCD_ADC_C "Enprellzeit Shadow Zustand für Fehlerpfad Dfp_PCVCD_ADC" VALUE 0xD1D04 Kw_Wu16 655350.0 Time_ms 0.00 655350.0 FORMAT "%8.1" /end CHARACTERISTIC
/begin CHARACTERISTIC DSM_SdwDfp_PCVCD_SigTst_C "Enprellzeit Shadow Zustand für Fehlerpfad Dfp_PCVCD_SigTst" VALUE 0xD1D06 Kw_Wu16 655350.0 Time_ms 0.00 655350.0 FORMAT "%8.1" /end CHARACTERISTIC
/begin CHARACTERISTIC DSM_SdwDfp_PFltAPSPlaus_C "Enprellzeit Shadow Zustand für Fehlerpfad Dfp_PFltAPSPlaus" VALUE 0xD1D08 Kw_Wu16 655350.0 Time_ms 0.00 655350.0 FORMAT "%8.1" /end CHARACTERISTIC
/begin CHARACTERISTIC DSM_SdwDfp_PFltAPSensB1_C "Enprellzeit Shadow Zustand für Fehlerpfad Dfp_PFltAPSensB1" VALUE 0xD1D0A Kw_Wu16 655350.0 Time_ms 0.00 655350.0 FORMAT "%8.1" /end CHARACTERISTIC
/begin CHARACTERISTIC DSM_SdwDfp_PFltAPSensB2_C "Enprellzeit Shadow Zustand für Fehlerpfad Dfp_PFltAPSensB2" VALUE 0xD1D0C Kw_Wu16 655350.0 Time_ms 0.00 655350.0 FORMAT "%8.1" /end CHARACTERISTIC
/begin CHARACTERISTIC DSM_SdwDfp_PFltBPSPlaus_C "Enprellzeit Shadow Zustand für Fehlerpfad Dfp_PFltBPSPlaus" VALUE 0xD1D0E Kw_Wu16 655350.0 Time_ms 0.00 655350.0 FORMAT "%8.1" /end CHARACTERISTIC
/begin CHARACTERISTIC DSM_SdwDfp_PFltCDPPreB1_C "Enprellzeit Shadow Zustand für Fehlerpfad Dfp_PFltCDPPreB1" VALUE 0xD1D10 Kw_Wu16 655350.0 Time_ms 0.00 655350.0 FORMAT "%8.1" /end CHARACTERISTIC
/begin CHARACTERISTIC DSM_SdwDfp_PFltCDPPreB2_C "Enprellzeit Shadow Zustand für Fehlerpfad Dfp_PFltCDPPreB2" VALUE 0xD1D12 Kw_Wu16 655350.0 Time_ms 0.00 655350.0 FORMAT "%8.1" /end CHARACTERISTIC
/begin CHARACTERISTIC DSM_SdwDfp_PFltCDTPreB1_C "Enprellzeit Shadow Zustand für Fehlerpfad Dfp_PFltCDTPreB1" VALUE 0xD1D14 Kw_Wu16 655350.0 Time_ms 0.00 655350.0 FORMAT "%8.1" /end CHARACTERISTIC
/begin CHARACTERISTIC DSM_SdwDfp_PFltCDTPreB2_C "Enprellzeit Shadow Zustand für Fehlerpfad Dfp_PFltCDTPreB2" VALUE 0xD1D16 Kw_Wu16 655350.0 Time_ms 0.00 655350.0 FORMAT "%8.1" /end CHARACTERISTIC
/begin CHARACTERISTIC DSM_SdwDfp_PFltCharB1_C "Enprellzeit Shadow Zustand für Fehlerpfad Dfp_PFltCharB1" VALUE 0xD1D18 Kw_Wu16 655350.0 Time_ms 0.00 655350.0 FORMAT "%8.1" /end CHARACTERISTIC
/begin CHARACTERISTIC DSM_SdwDfp_PFltCharB2_C "Enprellzeit Shadow Zustand für Fehlerpfad Dfp_PFltCharB2" VALUE 0xD1D1A Kw_Wu16 655350.0 Time_ms 0.00 655350.0 FORMAT "%8.1" /end CHARACTERISTIC
/begin CHARACTERISTIC DSM_SdwDfp_PFltDltOxiPreTwFlw_C "Enprellzeit Shadow Zustand für Fehlerpfad Dfp_PFltDltOxiPreTwFlw" VALUE 0xD1D1C Kw_Wu16 655350.0 Time_ms 0.00 655350.0 FORMAT "%8.1" /end CHARACTERISTIC
/begin CHARACTERISTIC DSM_SdwDfp_PFltDltPreTwFlw_C "Enprellzeit Shadow Zustand für Fehlerpfad Dfp_PFltDltPreTwFlw" VALUE 0xD1D1E Kw_Wu16 655350.0 Time_ms 0.00 655350.0 FORMAT "%8.1" /end CHARACTERISTIC
/begin CHARACTERISTIC DSM_SdwDfp_PFltEngPrtB1_C "Enprellzeit Shadow Zustand für Fehlerpfad Dfp_PFltEngPrtB1" VALUE 0xD1D20 Kw_Wu16 655350.0 Time_ms 0.00 655350.0 FORMAT "%8.1" /end CHARACTERISTIC
/begin CHARACTERISTIC DSM_SdwDfp_PFltEngPrtB2_C "Enprellzeit Shadow Zustand für Fehlerpfad Dfp_PFltEngPrtB2" VALUE 0xD1D22 Kw_Wu16 655350.0 Time_ms 0.00 655350.0 FORMAT "%8.1" /end CHARACTERISTIC
/begin CHARACTERISTIC DSM_SdwDfp_PFltOvldInhRgnB1_C "Enprellzeit Shadow Zustand für Fehlerpfad Dfp_PFltOvldInhRgnB1" VALUE 0xD1D24 Kw_Wu16 655350.0 Time_ms 0.00 655350.0 FORMAT "%8.1" /end CHARACTERISTIC
/begin CHARACTERISTIC DSM_SdwDfp_PFltOvldInhRgnB2_C "Enprellzeit Shadow Zustand für Fehlerpfad Dfp_PFltOvldInhRgnB2" VALUE 0xD1D26 Kw_Wu16 655350.0 Time_ms 0.00 655350.0 FORMAT "%8.1" /end CHARACTERISTIC
/begin CHARACTERISTIC DSM_SdwDfp_PFltOvldTrqLimB1_C "Enprellzeit Shadow Zustand für Fehlerpfad Dfp_PFltOvldTrqLimB1" VALUE 0xD1D28 Kw_Wu16 655350.0 Time_ms 0.00 655350.0 FORMAT "%8.1" /end CHARACTERISTIC
/begin CHARACTERISTIC DSM_SdwDfp_PFltOvldTrqLimB2_C "Enprellzeit Shadow Zustand für Fehlerpfad Dfp_PFltOvldTrqLimB2" VALUE 0xD1D2A Kw_Wu16 655350.0 Time_ms 0.00 655350.0 FORMAT "%8.1" /end CHARACTERISTIC
/begin CHARACTERISTIC DSM_SdwDfp_PFltPresDynPlausB1_C "Enprellzeit Shadow Zustand für Fehlerpfad Dfp_PFltPresDynPlausB1" VALUE 0xD1D2C Kw_Wu16 655350.0 Time_ms 0.00 655350.0 FORMAT "%8.1" /end CHARACTERISTIC
/begin CHARACTERISTIC DSM_SdwDfp_PFltPresDynPlausB2_C "Enprellzeit Shadow Zustand für Fehlerpfad Dfp_PFltPresDynPlausB2" VALUE 0xD1D2E Kw_Wu16 655350.0 Time_ms 0.00 655350.0 FORMAT "%8.1" /end CHARACTERISTIC
/begin CHARACTERISTIC DSM_SdwDfp_PFltPresPlausB1_C "Enprellzeit Shadow Zustand für Fehlerpfad Dfp_PFltPresPlausB1" VALUE 0xD1D30 Kw_Wu16 655350.0 Time_ms 0.00 655350.0 FORMAT "%8.1" /end CHARACTERISTIC
/begin CHARACTERISTIC DSM_SdwDfp_PFltPresPlausB2_C "Enprellzeit Shadow Zustand für Fehlerpfad Dfp_PFltPresPlausB2" VALUE 0xD1D32 Kw_Wu16 655350.0 Time_ms 0.00 655350.0 FORMAT "%8.1" /end CHARACTERISTIC
/begin CHARACTERISTIC DSM_SdwDfp_PFltPresSensB1_C "Enprellzeit Shadow Zustand für Fehlerpfad Dfp_PFltPresSensB1" VALUE 0xD1D34 Kw_Wu16 655350.0 Time_ms 0.00 655350.0 FORMAT "%8.1" /end CHARACTERISTIC
/begin CHARACTERISTIC DSM_SdwDfp_PFltPresSensB2_C "Enprellzeit Shadow Zustand für Fehlerpfad Dfp_PFltPresSensB2" VALUE 0xD1D36 Kw_Wu16 655350.0 Time_ms 0.00 655350.0 FORMAT "%8.1" /end CHARACTERISTIC
/begin CHARACTERISTIC DSM_SdwDfp_PFltPresSensFrz_C "Enprellzeit Shadow Zustand für Fehlerpfad Dfp_PFltPresSensFrz" VALUE 0xD1D38 Kw_Wu16 655350.0 Time_ms 0.00 655350.0 FORMAT "%8.1" /end CHARACTERISTIC
/begin CHARACTERISTIC DSM_SdwDfp_PFltPresSensHsLnB1_C "Enprellzeit Shadow Zustand für Fehlerpfad Dfp_PFltPresSensHsLnB1" VALUE 0xD1D3A Kw_Wu16 655350.0 Time_ms 0.00 655350.0 FORMAT "%8.1" /end CHARACTERISTIC
/begin CHARACTERISTIC DSM_SdwDfp_PFltPresSensHsLnB2_C "Enprellzeit Shadow Zustand für Fehlerpfad Dfp_PFltPresSensHsLnB2" VALUE 0xD1D3C Kw_Wu16 655350.0 Time_ms 0.00 655350.0 FORMAT "%8.1" /end CHARACTERISTIC
/begin CHARACTERISTIC DSM_SdwDfp_PFltPresSensSotB1_C "Enprellzeit Shadow Zustand für Fehlerpfad Dfp_PFltPresSensSotB1" VALUE 0xD1D3E Kw_Wu16 655350.0 Time_ms 0.00 655350.0 FORMAT "%8.1" /end CHARACTERISTIC
/begin CHARACTERISTIC DSM_SdwDfp_PFltPresSensSotB2_C "Enprellzeit Shadow Zustand für Fehlerpfad Dfp_PFltPresSensSotB2" VALUE 0xD1D40 Kw_Wu16 655350.0 Time_ms 0.00 655350.0 FORMAT "%8.1" /end CHARACTERISTIC
/begin CHARACTERISTIC DSM_SdwDfp_PFltRgnPerm_C "Enprellzeit Shadow Zustand für Fehlerpfad Dfp_PFltRgnPerm" VALUE 0xD1D42 Kw_Wu16 655350.0 Time_ms 0.00 655350.0 FORMAT "%8.1" /end CHARACTERISTIC
/begin CHARACTERISTIC DSM_SdwDfp_PFltTempDwnStrmB1_C "Enprellzeit Shadow Zustand für Fehlerpfad Dfp_PFltTempDwnStrmB1" VALUE 0xD1D44 Kw_Wu16 655350.0 Time_ms 0.00 655350.0 FORMAT "%8.1" /end CHARACTERISTIC
/begin CHARACTERISTIC DSM_SdwDfp_PFltTempDwnStrmB2_C "Enprellzeit Shadow Zustand für Fehlerpfad Dfp_PFltTempDwnStrmB2" VALUE 0xD1D46 Kw_Wu16 655350.0 Time_ms 0.00 655350.0 FORMAT "%8.1" /end CHARACTERISTIC
/begin CHARACTERISTIC DSM_SdwDfp_PFltTempSensB1_C "Enprellzeit Shadow Zustand für Fehlerpfad Dfp_PFltTempSensB1" VALUE 0xD1D48 Kw_Wu16 655350.0 Time_ms 0.00 655350.0 FORMAT "%8.1" /end CHARACTERISTIC
/begin CHARACTERISTIC DSM_SdwDfp_PFltTempSensB2_C "Enprellzeit Shadow Zustand für Fehlerpfad Dfp_PFltTempSensB2" VALUE 0xD1D4A Kw_Wu16 655350.0 Time_ms 0.00 655350.0 FORMAT "%8.1" /end CHARACTERISTIC
/begin CHARACTERISTIC DSM_SdwDfp_PFltTempUpStrmB1_C "Enprellzeit Shadow Zustand für Fehlerpfad Dfp_PFltTempUpStrmB1" VALUE 0xD1D4C Kw_Wu16 655350.0 Time_ms 0.00 655350.0 FORMAT "%8.1" /end CHARACTERISTIC
/begin CHARACTERISTIC DSM_SdwDfp_PFltTempUpStrmB2_C "Enprellzeit Shadow Zustand für Fehlerpfad Dfp_PFltTempUpStrmB2" VALUE 0xD1D4E Kw_Wu16 655350.0 Time_ms 0.00 655350.0 FORMAT "%8.1" /end CHARACTERISTIC
/begin CHARACTERISTIC DSM_SdwDfp_PFlt_tOxiPreMaxB1_C "Enprellzeit Shadow Zustand für Fehlerpfad Dfp_PFlt_tOxiPreMaxB1" VALUE 0xD1D50 Kw_Wu16 655350.0 Time_ms 0.00 655350.0 FORMAT "%8.1" /end CHARACTERISTIC
/begin CHARACTERISTIC DSM_SdwDfp_PFlt_tOxiPreMaxB2_C "Enprellzeit Shadow Zustand für Fehlerpfad Dfp_PFlt_tOxiPreMaxB2" VALUE 0xD1D52 Kw_Wu16 655350.0 Time_ms 0.00 655350.0 FORMAT "%8.1" /end CHARACTERISTIC
/begin CHARACTERISTIC DSM_SdwDfp_PFlt_tOxiPreMxRgnB1_C "Enprellzeit Shadow Zustand für Fehlerpfad Dfp_PFlt_tOxiPreMxRgnB1" VALUE 0xD1D54 Kw_Wu16 655350.0 Time_ms 0.00 655350.0 FORMAT "%8.1" /end CHARACTERISTIC
/begin CHARACTERISTIC DSM_SdwDfp_PFlt_tOxiPreMxRgnB2_C "Enprellzeit Shadow Zustand für Fehlerpfad Dfp_PFlt_tOxiPreMxRgnB2" VALUE 0xD1D56 Kw_Wu16 655350.0 Time_ms 0.00 655350.0 FORMAT "%8.1" /end CHARACTERISTIC
/begin CHARACTERISTIC DSM_SdwDfp_PFlt_tPreMaxB1_C "Enprellzeit Shadow Zustand für Fehlerpfad Dfp_PFlt_tPreMaxB1" VALUE 0xD1D58 Kw_Wu16 655350.0 Time_ms 0.00 655350.0 FORMAT "%8.1" /end CHARACTERISTIC
/begin CHARACTERISTIC DSM_SdwDfp_PFlt_tPreMaxB2_C "Enprellzeit Shadow Zustand für Fehlerpfad Dfp_PFlt_tPreMaxB2" VALUE 0xD1D5A Kw_Wu16 655350.0 Time_ms 0.00 655350.0 FORMAT "%8.1" /end CHARACTERISTIC
/begin CHARACTERISTIC DSM_SdwDfp_PFlt_tPreMaxRgnB1_C "Enprellzeit Shadow Zustand für Fehlerpfad Dfp_PFlt_tPreMaxRgnB1" VALUE 0xD1D5C Kw_Wu16 655350.0 Time_ms 0.00 655350.0 FORMAT "%8.1" /end CHARACTERISTIC
/begin CHARACTERISTIC DSM_SdwDfp_PFlt_tPreMaxRgnB2_C "Enprellzeit Shadow Zustand für Fehlerpfad Dfp_PFlt_tPreMaxRgnB2" VALUE 0xD1D5E Kw_Wu16 655350.0 Time_ms 0.00 655350.0 FORMAT "%8.1" /end CHARACTERISTIC
/begin CHARACTERISTIC DSM_SdwDfp_PFltmSotDiffMaxB1_C "Enprellzeit Shadow Zustand für Fehlerpfad Dfp_PFltmSotDiffMaxB1" VALUE 0xD1D60 Kw_Wu16 655350.0 Time_ms 0.00 655350.0 FORMAT "%8.1" /end CHARACTERISTIC
/begin CHARACTERISTIC DSM_SdwDfp_PFltmSotDiffMaxB2_C "Enprellzeit Shadow Zustand für Fehlerpfad Dfp_PFltmSotDiffMaxB2" VALUE 0xD1D62 Kw_Wu16 655350.0 Time_ms 0.00 655350.0 FORMAT "%8.1" /end CHARACTERISTIC
/begin CHARACTERISTIC DSM_SdwDfp_PresPlausDblDef_C "Enprellzeit Shadow Zustand für Fehlerpfad Dfp_PresPlausDblDef" VALUE 0xD1D64 Kw_Wu16 655350.0 Time_ms 0.00 655350.0 FORMAT "%8.1" /end CHARACTERISTIC
/begin CHARACTERISTIC DSM_SdwDfp_QLTCD_C "Enprellzeit Shadow Zustand für Fehlerpfad Dfp_QLTCD" VALUE 0xD1D66 Kw_Wu16 655350.0 Time_ms 0.00 655350.0 FORMAT "%8.1" /end CHARACTERISTIC
/begin CHARACTERISTIC DSM_SdwDfp_RailCD_C "Enprellzeit Shadow Zustand für Fehlerpfad Dfp_RailCD" VALUE 0xD1D68 Kw_Wu16 655350.0 Time_ms 0.00 655350.0 FORMAT "%8.1" /end CHARACTERISTIC
/begin CHARACTERISTIC DSM_SdwDfp_RailCDOfsTst_C "Enprellzeit Shadow Zustand für Fehlerpfad Dfp_RailCDOfsTst" VALUE 0xD1D6A Kw_Wu16 655350.0 Time_ms 0.00 655350.0 FORMAT "%8.1" /end CHARACTERISTIC
/begin CHARACTERISTIC DSM_SdwDfp_RailCD_PMonStrt_C "Enprellzeit Shadow Zustand für Fehlerpfad Dfp_RailCD_PMonStrt" VALUE 0xD1D6C Kw_Wu16 655350.0 Time_ms 0.00 655350.0 FORMAT "%8.1" /end CHARACTERISTIC
/begin CHARACTERISTIC DSM_SdwDfp_RailCPC1_C "Enprellzeit Shadow Zustand für Fehlerpfad Dfp_RailCPC1" VALUE 0xD1D6E Kw_Wu16 655350.0 Time_ms 0.00 655350.0 FORMAT "%8.1" /end CHARACTERISTIC
/begin CHARACTERISTIC DSM_SdwDfp_RailCPC3_C "Enprellzeit Shadow Zustand für Fehlerpfad Dfp_RailCPC3" VALUE 0xD1D70 Kw_Wu16 655350.0 Time_ms 0.00 655350.0 FORMAT "%8.1" /end CHARACTERISTIC
/begin CHARACTERISTIC DSM_SdwDfp_RailCPC4_C "Enprellzeit Shadow Zustand für Fehlerpfad Dfp_RailCPC4" VALUE 0xD1D72 Kw_Wu16 655350.0 Time_ms 0.00 655350.0 FORMAT "%8.1" /end CHARACTERISTIC
/begin CHARACTERISTIC DSM_SdwDfp_RailCtlModeMeUnDiag_C "Enprellzeit Shadow Zustand für Fehlerpfad Dfp_RailCtlModeMeUnDiag" VALUE 0xD1D74 Kw_Wu16 655350.0 Time_ms 0.00 655350.0 FORMAT "%8.1" /end CHARACTERISTIC
/begin CHARACTERISTIC DSM_SdwDfp_RailCtlModePCVDiag_C "Enprellzeit Shadow Zustand für Fehlerpfad Dfp_RailCtlModePCVDiag" VALUE 0xD1D76 Kw_Wu16 655350.0 Time_ms 0.00 655350.0 FORMAT "%8.1" /end CHARACTERISTIC
/begin CHARACTERISTIC DSM_SdwDfp_RailMeUn0_C "Enprellzeit Shadow Zustand für Fehlerpfad Dfp_RailMeUn0" VALUE 0xD1D78 Kw_Wu16 655350.0 Time_ms 0.00 655350.0 FORMAT "%8.1" /end CHARACTERISTIC
/begin CHARACTERISTIC DSM_SdwDfp_RailMeUn1_C "Enprellzeit Shadow Zustand für Fehlerpfad Dfp_RailMeUn1" VALUE 0xD1D7A Kw_Wu16 655350.0 Time_ms 0.00 655350.0 FORMAT "%8.1" /end CHARACTERISTIC
/begin CHARACTERISTIC DSM_SdwDfp_RailMeUn2_C "Enprellzeit Shadow Zustand für Fehlerpfad Dfp_RailMeUn2" VALUE 0xD1D7C Kw_Wu16 655350.0 Time_ms 0.00 655350.0 FORMAT "%8.1" /end CHARACTERISTIC
/begin CHARACTERISTIC DSM_SdwDfp_RailMeUn3_C "Enprellzeit Shadow Zustand für Fehlerpfad Dfp_RailMeUn3" VALUE 0xD1D7E Kw_Wu16 655350.0 Time_ms 0.00 655350.0 FORMAT "%8.1" /end CHARACTERISTIC
/begin CHARACTERISTIC DSM_SdwDfp_RailMeUn4_C "Enprellzeit Shadow Zustand für Fehlerpfad Dfp_RailMeUn4" VALUE 0xD1D80 Kw_Wu16 655350.0 Time_ms 0.00 655350.0 FORMAT "%8.1" /end CHARACTERISTIC
/begin CHARACTERISTIC DSM_SdwDfp_RailPCV0_C "Enprellzeit Shadow Zustand für Fehlerpfad Dfp_RailPCV0" VALUE 0xD1D82 Kw_Wu16 655350.0 Time_ms 0.00 655350.0 FORMAT "%8.1" /end CHARACTERISTIC
/begin CHARACTERISTIC DSM_SdwDfp_RailPCV1_C "Enprellzeit Shadow Zustand für Fehlerpfad Dfp_RailPCV1" VALUE 0xD1D84 Kw_Wu16 655350.0 Time_ms 0.00 655350.0 FORMAT "%8.1" /end CHARACTERISTIC
/begin CHARACTERISTIC DSM_SdwDfp_RailPCV2_C "Enprellzeit Shadow Zustand für Fehlerpfad Dfp_RailPCV2" VALUE 0xD1D86 Kw_Wu16 655350.0 Time_ms 0.00 655350.0 FORMAT "%8.1" /end CHARACTERISTIC
/begin CHARACTERISTIC DSM_SdwDfp_RailPCV3_C "Enprellzeit Shadow Zustand für Fehlerpfad Dfp_RailPCV3" VALUE 0xD1D88 Kw_Wu16 655350.0 Time_ms 0.00 655350.0 FORMAT "%8.1" /end CHARACTERISTIC
/begin CHARACTERISTIC DSM_SdwDfp_RailPCV4_C "Enprellzeit Shadow Zustand für Fehlerpfad Dfp_RailPCV4" VALUE 0xD1D8A Kw_Wu16 655350.0 Time_ms 0.00 655350.0 FORMAT "%8.1" /end CHARACTERISTIC
/begin CHARACTERISTIC DSM_SdwDfp_RailPCV5_C "Enprellzeit Shadow Zustand für Fehlerpfad Dfp_RailPCV5" VALUE 0xD1D8C Kw_Wu16 655350.0 Time_ms 0.00 655350.0 FORMAT "%8.1" /end CHARACTERISTIC
/begin CHARACTERISTIC DSM_SdwDfp_SOPTst_C "Enprellzeit Shadow Zustand für Fehlerpfad Dfp_SOPTst" VALUE 0xD1D8E Kw_Wu16 655350.0 Time_ms 0.00 655350.0 FORMAT "%8.1" /end CHARACTERISTIC
/begin CHARACTERISTIC DSM_SdwDfp_SSpMon1_C "Enprellzeit Shadow Zustand für Fehlerpfad Dfp_SSpMon1" VALUE 0xD1D90 Kw_Wu16 655350.0 Time_ms 0.00 655350.0 FORMAT "%8.1" /end CHARACTERISTIC
/begin CHARACTERISTIC DSM_SdwDfp_SSpMon2_C "Enprellzeit Shadow Zustand für Fehlerpfad Dfp_SSpMon2" VALUE 0xD1D92 Kw_Wu16 655350.0 Time_ms 0.00 655350.0 FORMAT "%8.1" /end CHARACTERISTIC
/begin CHARACTERISTIC DSM_SdwDfp_SSpMon3_C "Enprellzeit Shadow Zustand für Fehlerpfad Dfp_SSpMon3" VALUE 0xD1D94 Kw_Wu16 655350.0 Time_ms 0.00 655350.0 FORMAT "%8.1" /end CHARACTERISTIC
/begin CHARACTERISTIC DSM_SdwDfp_SSpMon4_C "Enprellzeit Shadow Zustand für Fehlerpfad Dfp_SSpMon4" VALUE 0xD1D96 Kw_Wu16 655350.0 Time_ms 0.00 655350.0 FORMAT "%8.1" /end CHARACTERISTIC
/begin CHARACTERISTIC DSM_SdwDfp_SSpMon5_C "Enprellzeit Shadow Zustand für Fehlerpfad Dfp_SSpMon5" VALUE 0xD1D98 Kw_Wu16 655350.0 Time_ms 0.00 655350.0 FORMAT "%8.1" /end CHARACTERISTIC
/begin CHARACTERISTIC DSM_SdwDfp_SSpMon6_C "Enprellzeit Shadow Zustand für Fehlerpfad Dfp_SSpMon6" VALUE 0xD1D9A Kw_Wu16 655350.0 Time_ms 0.00 655350.0 FORMAT "%8.1" /end CHARACTERISTIC
/begin CHARACTERISTIC DSM_SdwDfp_SWChk_CycSigChkDat_C "Enprellzeit Shadow Zustand für Fehlerpfad Dfp_SWChk_CycSigChkDat" VALUE 0xD1D9C Kw_Wu16 655350.0 Time_ms 0.00 655350.0 FORMAT "%8.1" /end CHARACTERISTIC
/begin CHARACTERISTIC DSM_SdwDfp_SWChk_CycSigChkPrg_C "Enprellzeit Shadow Zustand für Fehlerpfad Dfp_SWChk_CycSigChkPrg" VALUE 0xD1D9E Kw_Wu16 655350.0 Time_ms 0.00 655350.0 FORMAT "%8.1" /end CHARACTERISTIC
/begin CHARACTERISTIC DSM_SdwDfp_StSysTrqShutOff_C "Enprellzeit Shadow Zustand für Fehlerpfad Dfp_StSysTrqShutOff" VALUE 0xD1DA0 Kw_Wu16 655350.0 Time_ms 0.00 655350.0 FORMAT "%8.1" /end CHARACTERISTIC
/begin CHARACTERISTIC DSM_SdwDfp_StrtCD_Actr_C "Enprellzeit Shadow Zustand für Fehlerpfad Dfp_StrtCD_Actr" VALUE 0xD1DA2 Kw_Wu16 655350.0 Time_ms 0.00 655350.0 FORMAT "%8.1" /end CHARACTERISTIC
/begin CHARACTERISTIC DSM_SdwDfp_SysLamp_C "Enprellzeit Shadow Zustand für Fehlerpfad Dfp_SysLamp" VALUE 0xD1DA4 Kw_Wu16 655350.0 Time_ms 0.00 655350.0 FORMAT "%8.1" /end CHARACTERISTIC
/begin CHARACTERISTIC DSM_SdwDfp_T15CD_C "Enprellzeit Shadow Zustand für Fehlerpfad Dfp_T15CD" VALUE 0xD1DA6 Kw_Wu16 655350.0 Time_ms 0.00 655350.0 FORMAT "%8.1" /end CHARACTERISTIC
/begin CHARACTERISTIC DSM_SdwDfp_TGearbx_C "Enprellzeit Shadow Zustand für Fehlerpfad Dfp_TGearbx" VALUE 0xD1DA8 Kw_Wu16 655350.0 Time_ms 0.00 655350.0 FORMAT "%8.1" /end CHARACTERISTIC
/begin CHARACTERISTIC DSM_SdwDfp_TPUMon_C "Enprellzeit Shadow Zustand für Fehlerpfad Dfp_TPUMon" VALUE 0xD1DAA Kw_Wu16 655350.0 Time_ms 0.00 655350.0 FORMAT "%8.1" /end CHARACTERISTIC
/begin CHARACTERISTIC DSM_SdwDfp_TVACD_AirMon1_C "Enprellzeit Shadow Zustand für Fehlerpfad Dfp_TVACD_AirMon1" VALUE 0xD1DAC Kw_Wu16 655350.0 Time_ms 0.00 655350.0 FORMAT "%8.1" /end CHARACTERISTIC
/begin CHARACTERISTIC DSM_SdwDfp_TVACD_AirMon2_C "Enprellzeit Shadow Zustand für Fehlerpfad Dfp_TVACD_AirMon2" VALUE 0xD1DAE Kw_Wu16 655350.0 Time_ms 0.00 655350.0 FORMAT "%8.1" /end CHARACTERISTIC
/begin CHARACTERISTIC DSM_SdwDfp_TVACD_Max_C "Enprellzeit Shadow Zustand für Fehlerpfad Dfp_TVACD_Max" VALUE 0xD1DB0 Kw_Wu16 655350.0 Time_ms 0.00 655350.0 FORMAT "%8.1" /end CHARACTERISTIC
/begin CHARACTERISTIC DSM_SdwDfp_TVACD_Max2_C "Enprellzeit Shadow Zustand für Fehlerpfad Dfp_TVACD_Max2" VALUE 0xD1DB2 Kw_Wu16 655350.0 Time_ms 0.00 655350.0 FORMAT "%8.1" /end CHARACTERISTIC
/begin CHARACTERISTIC DSM_SdwDfp_TVACD_Min_C "Enprellzeit Shadow Zustand für Fehlerpfad Dfp_TVACD_Min" VALUE 0xD1DB4 Kw_Wu16 655350.0 Time_ms 0.00 655350.0 FORMAT "%8.1" /end CHARACTERISTIC
/begin CHARACTERISTIC DSM_SdwDfp_TVACD_Min2_C "Enprellzeit Shadow Zustand für Fehlerpfad Dfp_TVACD_Min2" VALUE 0xD1DB6 Kw_Wu16 655350.0 Time_ms 0.00 655350.0 FORMAT "%8.1" /end CHARACTERISTIC
/begin CHARACTERISTIC DSM_SdwDfp_TVACD_SigNpl_C "Enprellzeit Shadow Zustand für Fehlerpfad Dfp_TVACD_SigNpl" VALUE 0xD1DB8 Kw_Wu16 655350.0 Time_ms 0.00 655350.0 FORMAT "%8.1" /end CHARACTERISTIC
/begin CHARACTERISTIC DSM_SdwDfp_TVACD_SigNpl2_C "Enprellzeit Shadow Zustand für Fehlerpfad Dfp_TVACD_SigNpl2" VALUE 0xD1DBA Kw_Wu16 655350.0 Time_ms 0.00 655350.0 FORMAT "%8.1" /end CHARACTERISTIC
/begin CHARACTERISTIC DSM_SdwDfp_TVACD_TVADia1_C "Enprellzeit Shadow Zustand für Fehlerpfad Dfp_TVACD_TVADia1" VALUE 0xD1DBC Kw_Wu16 655350.0 Time_ms 0.00 655350.0 FORMAT "%8.1" /end CHARACTERISTIC
/begin CHARACTERISTIC DSM_SdwDfp_TVACD_TVADia2_C "Enprellzeit Shadow Zustand für Fehlerpfad Dfp_TVACD_TVADia2" VALUE 0xD1DBE Kw_Wu16 655350.0 Time_ms 0.00 655350.0 FORMAT "%8.1" /end CHARACTERISTIC
/begin CHARACTERISTIC DSM_SdwDfp_TVACD_TVADia21_C "Enprellzeit Shadow Zustand für Fehlerpfad Dfp_TVACD_TVADia21" VALUE 0xD1DC0 Kw_Wu16 655350.0 Time_ms 0.00 655350.0 FORMAT "%8.1" /end CHARACTERISTIC
/begin CHARACTERISTIC DSM_SdwDfp_TVACD_TVADia22_C "Enprellzeit Shadow Zustand für Fehlerpfad Dfp_TVACD_TVADia22" VALUE 0xD1DC2 Kw_Wu16 655350.0 Time_ms 0.00 655350.0 FORMAT "%8.1" /end CHARACTERISTIC
/begin CHARACTERISTIC DSM_SdwDfp_TVACD_TVADia23_C "Enprellzeit Shadow Zustand für Fehlerpfad Dfp_TVACD_TVADia23" VALUE 0xD1DC4 Kw_Wu16 655350.0 Time_ms 0.00 655350.0 FORMAT "%8.1" /end CHARACTERISTIC
/begin CHARACTERISTIC DSM_SdwDfp_TVACD_TVADia24_C "Enprellzeit Shadow Zustand für Fehlerpfad Dfp_TVACD_TVADia24" VALUE 0xD1DC6 Kw_Wu16 655350.0 Time_ms 0.00 655350.0 FORMAT "%8.1" /end CHARACTERISTIC
/begin CHARACTERISTIC DSM_SdwDfp_TVACD_TVADia3_C "Enprellzeit Shadow Zustand für Fehlerpfad Dfp_TVACD_TVADia3" VALUE 0xD1DC8 Kw_Wu16 655350.0 Time_ms 0.00 655350.0 FORMAT "%8.1" /end CHARACTERISTIC
/begin CHARACTERISTIC DSM_SdwDfp_TVACD_TVADia4_C "Enprellzeit Shadow Zustand für Fehlerpfad Dfp_TVACD_TVADia4" VALUE 0xD1DCA Kw_Wu16 655350.0 Time_ms 0.00 655350.0 FORMAT "%8.1" /end CHARACTERISTIC
/begin CHARACTERISTIC DSM_SdwDfp_ThrVlvMon_C "Shadow State Debounce Time for path Dfp_ThrVlvMon" VALUE 0xD1DCC Kw_Wu16 655350.0 Time_ms 0.00 655350.0 FORMAT "%8.1" /end CHARACTERISTIC
/begin CHARACTERISTIC DSM_SdwDfp_VSACD_DiaDet_C "Enprellzeit Shadow Zustand für Fehlerpfad Dfp_VSACD_DiaDet" VALUE 0xD1DCE Kw_Wu16 655350.0 Time_ms 0.00 655350.0 FORMAT "%8.1" /end CHARACTERISTIC
/begin CHARACTERISTIC DSM_SdwDfp_VSACD_DioInDia1_C "Enprellzeit Shadow Zustand für Fehlerpfad Dfp_VSACD_DioInDia1" VALUE 0xD1DD0 Kw_Wu16 655350.0 Time_ms 0.00 655350.0 FORMAT "%8.1" /end CHARACTERISTIC
/begin CHARACTERISTIC DSM_SdwDfp_VSACD_DioInDia2_C "Enprellzeit Shadow Zustand für Fehlerpfad Dfp_VSACD_DioInDia2" VALUE 0xD1DD2 Kw_Wu16 655350.0 Time_ms 0.00 655350.0 FORMAT "%8.1" /end CHARACTERISTIC
/begin CHARACTERISTIC DSM_SdwDfp_VSACD_DioInDia3_C "Enprellzeit Shadow Zustand für Fehlerpfad Dfp_VSACD_DioInDia3" VALUE 0xD1DD4 Kw_Wu16 655350.0 Time_ms 0.00 655350.0 FORMAT "%8.1" /end CHARACTERISTIC
/begin CHARACTERISTIC DSM_SdwDfp_VSACD_DioInDia4_C "Enprellzeit Shadow Zustand für Fehlerpfad Dfp_VSACD_DioInDia4" VALUE 0xD1DD6 Kw_Wu16 655350.0 Time_ms 0.00 655350.0 FORMAT "%8.1" /end CHARACTERISTIC
/begin CHARACTERISTIC DSM_SdwDfp_VSACD_DioInMin_C "Enprellzeit Shadow Zustand für Fehlerpfad Dfp_VSACD_DioInMin" VALUE 0xD1DD8 Kw_Wu16 655350.0 Time_ms 0.00 655350.0 FORMAT "%8.1" /end CHARACTERISTIC
/begin CHARACTERISTIC DSM_SdwDfp_VSACD_Max_C "Enprellzeit Shadow Zustand für Fehlerpfad Dfp_VSACD_Max" VALUE 0xD1DDA Kw_Wu16 655350.0 Time_ms 0.00 655350.0 FORMAT "%8.1" /end CHARACTERISTIC
/begin CHARACTERISTIC DSM_SdwDfp_VSACD_Min_C "Enprellzeit Shadow Zustand für Fehlerpfad Dfp_VSACD_Min" VALUE 0xD1DDC Kw_Wu16 655350.0 Time_ms 0.00 655350.0 FORMAT "%8.1" /end CHARACTERISTIC
/begin CHARACTERISTIC DSM_SdwDfp_VSACD_SigNpl_C "Enprellzeit Shadow Zustand für Fehlerpfad Dfp_VSACD_SigNpl" VALUE 0xD1DDE Kw_Wu16 655350.0 Time_ms 0.00 655350.0 FORMAT "%8.1" /end CHARACTERISTIC
/begin CHARACTERISTIC DSM_SdwDfp_VSACD_VSADia1_C "Enprellzeit Shadow Zustand für Fehlerpfad Dfp_VSACD_VSADia1" VALUE 0xD1DE0 Kw_Wu16 655350.0 Time_ms 0.00 655350.0 FORMAT "%8.1" /end CHARACTERISTIC
/begin CHARACTERISTIC DSM_SdwDfp_VSACD_VSADia2_C "Enprellzeit Shadow Zustand für Fehlerpfad Dfp_VSACD_VSADia2" VALUE 0xD1DE2 Kw_Wu16 655350.0 Time_ms 0.00 655350.0 FORMAT "%8.1" /end CHARACTERISTIC
/begin CHARACTERISTIC DSM_SdwDfp_VSACD_VSADia3_C "Enprellzeit Shadow Zustand für Fehlerpfad Dfp_VSACD_VSADia3" VALUE 0xD1DE4 Kw_Wu16 655350.0 Time_ms 0.00 655350.0 FORMAT "%8.1" /end CHARACTERISTIC
/begin CHARACTERISTIC DSM_SdwDfp_VSACD_VSADia4_C "Enprellzeit Shadow Zustand für Fehlerpfad Dfp_VSACD_VSADia4" VALUE 0xD1DE6 Kw_Wu16 655350.0 Time_ms 0.00 655350.0 FORMAT "%8.1" /end CHARACTERISTIC
/begin CHARACTERISTIC DSM_SdwDfp_VSSCD1_C "Enprellzeit Shadow Zustand für Fehlerpfad Dfp_VSSCD1" VALUE 0xD1DE8 Kw_Wu16 655350.0 Time_ms 0.00 655350.0 FORMAT "%8.1" /end CHARACTERISTIC
/begin CHARACTERISTIC DSM_SdwDfp_VSSCD2_C "Enprellzeit Shadow Zustand für Fehlerpfad Dfp_VSSCD2" VALUE 0xD1DEA Kw_Wu16 655350.0 Time_ms 0.00 655350.0 FORMAT "%8.1" /end CHARACTERISTIC
/begin CHARACTERISTIC DSM_SdwDfp_WdCom_C "Enprellzeit Shadow Zustand für Fehlerpfad Dfp_WdCom" VALUE 0xD1DEC Kw_Wu16 655350.0 Time_ms 0.00 655350.0 FORMAT "%8.1" /end CHARACTERISTIC
/begin FUNCTION dsm_auto_sdw ""
 /begin DEF_CHARACTERISTIC DSM_SdwDfp_Layer_TANS_C DSM_SdwDfp_ACCDSwtin_C DSM_SdwDfp_ACC_PlausTrqDes_C DSM_SdwDfp_ACC_trqInr_C DSM_SdwDfp_ACTrq_C DSM_SdwDfp_ADCMon_C DSM_SdwDfp_AFSCDIdlAdjVal_C DSM_SdwDfp_AFSCDLdAdjVal_C DSM_SdwDfp_AFSCDPlAirPerCylDif_C DSM_SdwDfp_AFSCD_AirTempDcyc_C DSM_SdwDfp_AFSCD_AirTempDcyc2_C DSM_SdwDfp_AFSCD_PlOffsDrft_C DSM_SdwDfp_AFSCD_PlOffsDrft2_C DSM_SdwDfp_AFSCD_PlSetyDrft_C DSM_SdwDfp_AFSCD_SRCAirTemp_C DSM_SdwDfp_AFSCD_SRCAirTemp2_C DSM_SdwDfp_AFSCD_SRCBatt_C DSM_SdwDfp_AFSCD_SRCBatt2_C DSM_SdwDfp_AFSCD_SRCCorrAirm_C DSM_SdwDfp_Layer_TUMG_C DSM_SdwDfp_AFSCD_SRCCorrAirm2_C DSM_SdwDfp_AFSCD_SRCRawAirm_C DSM_SdwDfp_Layer_GEN_C DSM_SdwDfp_Layer_BSD_C DSM_SdwDfp_AFSCD_SRCRawAirm2_C DSM_SdwDfp_AFSCD_SRCRefSigPer_C DSM_SdwDfp_AFSCD_SRCRefSigPer2_C DSM_SdwDfp_AOHtCD_C DSM_SdwDfp_AOHtCD_AOHtDia1_C DSM_SdwDfp_AOHtCD_AOHtDia2_C DSM_SdwDfp_AOHtCD_AOHtDia3_C DSM_SdwDfp_APP1_C DSM_SdwDfp_APP2_C DSM_SdwDfp_APPCDCmpd_C DSM_SdwDfp_Layer_QLT_C DSM_SdwDfp_APPSync_C DSM_SdwDfp_Layer_IBS1_C DSM_SdwDfp_Layer_IBS2_C DSM_SdwDfp_Layer_IBS3_C DSM_SdwDfp_Layer_PMBN_C DSM_SdwDfp_Layer_PMBATT_C DSM_SdwDfp_APSCD_C DSM_SdwDfp_ARS_C DSM_SdwDfp_AccPedPlausBrk_C DSM_SdwDfp_AddPCDTnkLvl_C DSM_SdwDfp_AirCtlGvnrDvtRgnMax_C DSM_SdwDfp_AirCtlGvnrDvtRgnMin_C DSM_SdwDfp_AirCtlGvnrDvtRgnMn2_C DSM_SdwDfp_AirCtlGvnrDvtRgnMx2_C DSM_SdwDfp_AirCtlPlateBreak_C DSM_SdwDfp_AirCtlRmpTO_C DSM_SdwDfp_AirCtl_GovNegDev_C DSM_SdwDfp_AirCtl_GovNegDev2_C DSM_SdwDfp_AirCtl_GovPosDev_C DSM_SdwDfp_AirCtl_GovPosDev2_C DSM_SdwDfp_AltCD_C DSM_SdwDfp_BPACD_BPADia1_C DSM_SdwDfp_BPACD_BPADia1v2_C DSM_SdwDfp_BPACD_BPADia2_C DSM_SdwDfp_BPACD_BPADia2v2_C DSM_SdwDfp_BPACD_BPADia3_C DSM_SdwDfp_BPACD_BPADia3v2_C DSM_SdwDfp_BPACD_BPADia4_C DSM_SdwDfp_BPACD_BPADia4v2_C DSM_SdwDfp_BPACD_Max_C DSM_SdwDfp_BPACD_Max2_C DSM_SdwDfp_BPACD_Min_C DSM_SdwDfp_BPACD_Min2_C DSM_SdwDfp_BPACD_SigNpl_C DSM_SdwDfp_BPACD_SigNpl2_C DSM_SdwDfp_BPSCD_C DSM_SdwDfp_BattCD_C DSM_SdwDfp_BrkCD_C DSM_SdwDfp_Layer_PMRUHVERL_C DSM_SdwDfp_Bss_C DSM_SdwDfp_CBACD_C DSM_SdwDfp_CTSCD_C DSM_SdwDfp_Clg_DynTst_C DSM_SdwDfp_Layer_TOENS_C DSM_SdwDfp_Layer_MANHYDR_C DSM_SdwDfp_Layer_MANLUFT_C DSM_SdwDfp_CmbChbMisfire1_C DSM_SdwDfp_CmbChbMisfire2_C DSM_SdwDfp_CmbChbMisfire3_C DSM_SdwDfp_CmbChbMisfire4_C DSM_SdwDfp_CmbChbMisfire5_C DSM_SdwDfp_CmbChbMisfire6_C DSM_SdwDfp_CmbChbMisfire7_C DSM_SdwDfp_CmbChbMisfire8_C DSM_SdwDfp_CmbChbMisfireMul_C DSM_SdwDfp_CoDT_TRQ_Des_C DSM_SdwDfp_CoDT_TRQ_Lead_C DSM_SdwDfp_CoEng_GbxRpmRduc_C DSM_SdwDfp_CoVMDCSh_C DSM_SdwDfp_ConvCD_C DSM_SdwDfp_CrCCDMFL_C DSM_SdwDfp_CrCtl_vCrCtl_C DSM_SdwDfp_EATSCD_C DSM_SdwDfp_EBAFCD_C DSM_SdwDfp_EBFCD_C DSM_SdwDfp_EBTSCD_C DSM_SdwDfp_EBTSCD_OvrTemp_C DSM_SdwDfp_EEPCDVarMng_C DSM_SdwDfp_EGPpCD_C DSM_SdwDfp_EGRCD_Max_C DSM_SdwDfp_EGRCD_Max2_C DSM_SdwDfp_EGRCD_Min_C DSM_SdwDfp_EGRCD_Min2_C DSM_SdwDfp_EGRCD_PWMInDia1_C DSM_SdwDfp_EGRCD_PWMInDia2_C DSM_SdwDfp_EGRCD_PWMInDia21_C DSM_SdwDfp_EGRCD_PWMInDia22_C DSM_SdwDfp_EGRCD_PWMInDia23_C DSM_SdwDfp_EGRCD_PWMInDia24_C DSM_SdwDfp_EGRCD_PWMInDia3_C DSM_SdwDfp_EGRCD_PWMInDia4_C DSM_SdwDfp_EGRCD_SigDia_C DSM_SdwDfp_EGRCD_SigDia2_C DSM_SdwDfp_EGRCD_SigNpl_C DSM_SdwDfp_EGRCD_SigNpl2_C DSM_SdwDfp_EGTOilLvlCrit_C DSM_SdwDfp_EGTOilVscCrit_C DSM_SdwDfp_EGTRgnOilDil_C DSM_SdwDfp_EGTTempGvnrInrB1_C DSM_SdwDfp_EGTTempGvnrInrB2_C DSM_SdwDfp_EGTTempGvnrOutrB1_C DSM_SdwDfp_EGTTempGvnrOutrB2_C DSM_SdwDfp_ETClbETFltInj1_C DSM_SdwDfp_ETClbETFltInj2_C DSM_SdwDfp_ETClbETFltInj3_C DSM_SdwDfp_ETClbETFltInj4_C DSM_SdwDfp_ETClbETFltInj5_C DSM_SdwDfp_ETClbETFltInj6_C DSM_SdwDfp_ETClbETFltInj7_C DSM_SdwDfp_ETClbETFltInj8_C DSM_SdwDfp_ETClbInj1_C DSM_SdwDfp_ETClbInj2_C DSM_SdwDfp_ETClbInj3_C DSM_SdwDfp_ETClbInj4_C DSM_SdwDfp_ETClbInj5_C DSM_SdwDfp_ETClbInj6_C DSM_SdwDfp_ETClbInj7_C DSM_SdwDfp_ETClbInj8_C DSM_SdwDfp_EngMCaS1_C DSM_SdwDfp_EngMCrS1_C DSM_SdwDfp_EngMOfsCaSCrS_C DSM_SdwDfp_EngMntCtlCD_C DSM_SdwDfp_FBCqDvt_C DSM_SdwDfp_FMAErrMod_C DSM_SdwDfp_FMTC_NonMonotonMap_C DSM_SdwDfp_FTSCD_C DSM_SdwDfp_FanCD_C DSM_SdwDfp_FanCD_FanCtlr1_C DSM_SdwDfp_FanCD_FanCtlr2_C DSM_SdwDfp_FanCD_FanCtlr3_C DSM_SdwDfp_FlFCD_C DSM_SdwDfp_FlMngSmkDefect_C DSM_SdwDfp_FlSCDT1_C DSM_SdwDfp_FrmMngANFRADMOMPT_C DSM_SdwDfp_FrmMngASC1_C DSM_SdwDfp_FrmMngASC2_C DSM_SdwDfp_FrmMngASC3_C DSM_SdwDfp_FrmMngASC4_C DSM_SdwDfp_FrmMngBOS_RESET_C DSM_SdwDfp_FrmMngBOS_RESET2_C DSM_SdwDfp_FrmMngDMANFAFS_C DSM_SdwDfp_FrmMngDRMANFSSG_C DSM_SdwDfp_FrmMngEGS1_C DSM_SdwDfp_FrmMngEGS2_C DSM_SdwDfp_FrmMngGEARBX_DATA_C DSM_SdwDfp_FrmMngGEARBX_DATA2_C DSM_SdwDfp_FrmMngHEAT_AC_C DSM_SdwDfp_FrmMngINSTR2_C DSM_SdwDfp_FrmMngINSTR3_C DSM_SdwDfp_FrmMngLENKRADWINKEL_C DSM_SdwDfp_FrmMngMILEAGE_RANGE_C DSM_SdwDfp_FrmMngMSPHISYNC_C DSM_SdwDfp_FrmMngMST4_C DSM_SdwDfp_FrmMngMST5_C DSM_SdwDfp_FrmMngOPCRCTLACC_C DSM_SdwDfp_FrmMngPRGG_CCTR_C DSM_SdwDfp_FrmMngPWRMNG_LOADV_C DSM_SdwDfp_FrmMngParkConsumer_C DSM_SdwDfp_FrmMngRQSTGEFAN_C DSM_SdwDfp_FrmMngSLV4_C DSM_SdwDfp_FrmMngSLV5_C DSM_SdwDfp_FrmMngSSGErr_C DSM_SdwDfp_FrmMngSSGShOff_C DSM_SdwDfp_FrmMngSTAT_ANH_C DSM_SdwDfp_FrmMngSTAT_ARS_C DSM_SdwDfp_FrmMngSTAT_DSC_C DSM_SdwDfp_FrmMngSTAT_EKP_C DSM_SdwDfp_FrmMngSTAT_KOMBI_C DSM_SdwDfp_FrmMngSTAT_SITZ_C DSM_SdwDfp_FrmMngStOBDGbxMilOf_C DSM_SdwDfp_FrmMngStOBDGbxMilOn_C DSM_SdwDfp_FrmMngTEMPRELTIME_C DSM_SdwDfp_FrmMngTERMINAL_C DSM_SdwDfp_FrmMngTIME_DATE_C DSM_SdwDfp_FrmMngTORQUE_DSC_C DSM_SdwDfp_FrmMngTORQUE_GEARBX_C DSM_SdwDfp_FrmMngTrq_ReqACC_C DSM_SdwDfp_FrmMngVEH_MOD_C DSM_SdwDfp_FrmMngVELOCITY_C DSM_SdwDfp_FrmMngWHEEL_SPEED_C DSM_SdwDfp_FrmMngstCurr_C DSM_SdwDfp_FrmMngswtPSPOff_C DSM_SdwDfp_GearbxIncMax_C DSM_SdwDfp_GlwCD_C DSM_SdwDfp_GlwCDGlwCirc1_C DSM_SdwDfp_GlwCDGlwCirc2_C DSM_SdwDfp_GlwCDGlwCirc3_C DSM_SdwDfp_GlwCDGlwCirc4_C DSM_SdwDfp_GlwCDGlwCirc5_C DSM_SdwDfp_GlwCDGlwCirc6_C DSM_SdwDfp_GlwCDGlwCirc7_C DSM_SdwDfp_GlwCDGlwCirc8_C DSM_SdwDfp_GlwCtl_C DSM_SdwDfp_HWEMonCom_C DSM_SdwDfp_HWEMonEEPROM_C DSM_SdwDfp_HWEMonRcyLocked_C DSM_SdwDfp_HWEMonRcySuppressed_C DSM_SdwDfp_HWEMonRcyVisible_C DSM_SdwDfp_HWEMonUMaxSupply_C DSM_SdwDfp_HWEMonUMinSupply_C DSM_SdwDfp_IATSCD_C DSM_SdwDfp_IATSCD_CATS_C DSM_SdwDfp_IATSCD_CATSSec_C DSM_SdwDfp_ImmCtlImmCD_C DSM_SdwDfp_ImmCtlImmEep_C DSM_SdwDfp_ImmCtlMpl_C DSM_SdwDfp_IndSys1_C DSM_SdwDfp_IndSys2_C DSM_SdwDfp_InjCrv_InjLim_C DSM_SdwDfp_InjCtlAdjQnt_C DSM_SdwDfp_InjCtlDrift_C DSM_SdwDfp_InjVCDActrChrg_C DSM_SdwDfp_InjVCDActrEnrg1_C DSM_SdwDfp_InjVCDActrEnrg2_C DSM_SdwDfp_InjVCDActrEnrg3_C DSM_SdwDfp_InjVCDActrEnrg4_C DSM_SdwDfp_InjVCDActrEnrg5_C DSM_SdwDfp_InjVCDActrEnrg6_C DSM_SdwDfp_InjVCDActrEnrg7_C DSM_SdwDfp_InjVCDActrEnrg8_C DSM_SdwDfp_InjVCDActrVolt_C DSM_SdwDfp_InjVCDClsBank1_C DSM_SdwDfp_InjVCDClsBank2_C DSM_SdwDfp_InjVCDMonCab_C DSM_SdwDfp_InjVCDMonSwt_C DSM_SdwDfp_InjVCDShOffDCDC_C DSM_SdwDfp_InjVCDUBuf1_C DSM_SdwDfp_InjVCDUBuf2_C DSM_SdwDfp_InjVCD_CY370Ampl_C DSM_SdwDfp_InjVCD_DrvTime_C DSM_SdwDfp_InjVCD_DrvTimeRcy_C DSM_SdwDfp_InjVCD_TPUErr_C DSM_SdwDfp_InjVlvBnk1A_C DSM_SdwDfp_InjVlvBnk1B_C DSM_SdwDfp_InjVlvBnk2A_C DSM_SdwDfp_InjVlvBnk2B_C DSM_SdwDfp_InjVlvChipA_C DSM_SdwDfp_InjVlvChipB_C DSM_SdwDfp_InjVlvCyl1A_C DSM_SdwDfp_InjVlvCyl1B_C DSM_SdwDfp_InjVlvCyl1C_C DSM_SdwDfp_InjVlvCyl2A_C DSM_SdwDfp_InjVlvCyl2B_C DSM_SdwDfp_InjVlvCyl2C_C DSM_SdwDfp_InjVlvCyl3A_C DSM_SdwDfp_InjVlvCyl3B_C DSM_SdwDfp_InjVlvCyl3C_C DSM_SdwDfp_InjVlvCyl4A_C DSM_SdwDfp_InjVlvCyl4B_C DSM_SdwDfp_InjVlvCyl4C_C DSM_SdwDfp_InjVlvCyl5A_C DSM_SdwDfp_InjVlvCyl5B_C DSM_SdwDfp_InjVlvCyl5C_C DSM_SdwDfp_InjVlvCyl6A_C DSM_SdwDfp_InjVlvCyl6B_C DSM_SdwDfp_InjVlvCyl6C_C DSM_SdwDfp_InjVlvCyl7A_C DSM_SdwDfp_InjVlvCyl7B_C DSM_SdwDfp_InjVlvCyl7C_C DSM_SdwDfp_InjVlvCyl8A_C DSM_SdwDfp_InjVlvCyl8B_C DSM_SdwDfp_InjVlvCyl8C_C DSM_SdwDfp_InjVlvNVC1_C DSM_SdwDfp_InjVlvNVC2_C DSM_SdwDfp_InjVlvNVC3_C DSM_SdwDfp_InjVlvNVC4_C DSM_SdwDfp_InjVlvNVC5_C DSM_SdwDfp_InjVlvNVC6_C DSM_SdwDfp_InjVlvNVC7_C DSM_SdwDfp_InjVlvNVC8_C DSM_SdwDfp_KeyCheck_C DSM_SdwDfp_LIGovECUTransMode_C DSM_SdwDfp_LPACD_Max_C DSM_SdwDfp_LPACD_Min_C DSM_SdwDfp_LPACD_SigNpl_C DSM_SdwDfp_LSUCDCircNernst0B1_C DSM_SdwDfp_LSUCDCircNernst0B2_C DSM_SdwDfp_LSUCDCircPumpCur0B1_C DSM_SdwDfp_LSUCDCircPumpCur0B2_C DSM_SdwDfp_LSUCDCircVirtGnd0B1_C DSM_SdwDfp_LSUCDCircVirtGnd0B2_C DSM_SdwDfp_LSUCDHeater0B1_C DSM_SdwDfp_LSUCDHeater0B2_C DSM_SdwDfp_LSUCDHtCoup0B1_C DSM_SdwDfp_LSUCDHtCoup0B2_C DSM_SdwDfp_LSUCDO20B1_C DSM_SdwDfp_LSUCDO20B2_C DSM_SdwDfp_LSUCDO2Clb0B1_C DSM_SdwDfp_LSUCDO2Clb0B2_C DSM_SdwDfp_LSUCDRiClb0B1_C DSM_SdwDfp_LSUCDRiClb0B2_C DSM_SdwDfp_LSUCDSPI0B1_C DSM_SdwDfp_LSUCDSPI0B2_C DSM_SdwDfp_LSUCDSPIBattLow0B1_C DSM_SdwDfp_LSUCDSPIBattLow0B2_C DSM_SdwDfp_LSUCDWireIP0B1_C DSM_SdwDfp_LSUCDWireIP0B2_C DSM_SdwDfp_LSUCtlRiExc0B1_C DSM_SdwDfp_LSUCtlRiExc0B2_C DSM_SdwDfp_LSUMon1SensB1_C DSM_SdwDfp_LSUMon1SensB2_C DSM_SdwDfp_LSUMon2SensB1_C DSM_SdwDfp_LSUMon2SensB2_C DSM_SdwDfp_MIL_C DSM_SdwDfp_MRlyCD_C DSM_SdwDfp_MSMon_C DSM_SdwDfp_MSMonConsist_C DSM_SdwDfp_MSMonPFlt1_C DSM_SdwDfp_MSMonPFlt2_C DSM_SdwDfp_MSMonPFlt3_C DSM_SdwDfp_MSMonPFlt4_C DSM_SdwDfp_MSMon_ARS_TO_C DSM_SdwDfp_MSMon_AirCtl_C DSM_SdwDfp_MSMon_AirSys0_C DSM_SdwDfp_MSMon_AirSys1_C DSM_SdwDfp_MSMon_AirSys2_C DSM_SdwDfp_MSMon_AirSys3_C DSM_SdwDfp_MSMon_AirSys4_C DSM_SdwDfp_MSMon_AirSys7_C DSM_SdwDfp_MSMon_CanDef_C DSM_SdwDfp_MSMon_CoEng_OffVeh_C DSM_SdwDfp_MSMon_CoEng_Rev1_C DSM_SdwDfp_MSMon_CoEng_Rev2_C DSM_SdwDfp_MSMon_CoEng_RevMS_C DSM_SdwDfp_MSMon_DSC_TO_C DSM_SdwDfp_MSMon_EGS_TO_C DSM_SdwDfp_MSMon_FrmMngCoEng_C DSM_SdwDfp_MSMon_FrmMngPT_C DSM_SdwDfp_MSMon_FrmMngPT2_C DSM_SdwDfp_MSMon_Mil_C DSM_SdwDfp_MSMon_NetMngPtCan_C DSM_SdwDfp_MSMon_RailCDPMon_C DSM_SdwDfp_MSMon_StEGS_C DSM_SdwDfp_MSMon_SysLamp_C DSM_SdwDfp_MSMon_ZFCClbActv_C DSM_SdwDfp_MSMon_qLimErr_C DSM_SdwDfp_MSMon_trqCoDT_C DSM_SdwDfp_MSMon_trqCoVeh_C DSM_SdwDfp_MSMon_trqCoVehLim_C DSM_SdwDfp_MSMon_trqDesExt_C DSM_SdwDfp_MSMon_trqDesExtRev_C DSM_SdwDfp_MSMon_trqLimErr_C DSM_SdwDfp_MSMon_trqLimErr1_C DSM_SdwDfp_MSMon_trqLimErr2_C DSM_SdwDfp_MSMon_trqLimErr3_C DSM_SdwDfp_MSMon_trqLimErr4_C DSM_SdwDfp_MSidCD_Comm_C DSM_SdwDfp_MSidCD_EcuMixed_C DSM_SdwDfp_MSidCD_Pin_C DSM_SdwDfp_MSidCD_Sel_INI_C DSM_SdwDfp_MSidCD_Select_C DSM_SdwDfp_MSid_SwCmp_C DSM_SdwDfp_MSid_regEEPDiff_C DSM_SdwDfp_MeUnCDNoLoad_C DSM_SdwDfp_MeUnCDSCBat_C DSM_SdwDfp_MeUnCDSCGnd_C DSM_SdwDfp_MeUnCD_ADC_C DSM_SdwDfp_MeUnCD_SigTst_C DSM_SdwDfp_Montr_C DSM_SdwDfp_NetMngDeviceA_C DSM_SdwDfp_NetMngDeviceB_C DSM_SdwDfp_NetMngDeviceC_C DSM_SdwDfp_NetMngPrvCan_C DSM_SdwDfp_NetMngPrvCanSlave_C DSM_SdwDfp_NetMngPtCan_C DSM_SdwDfp_NetMngPtCanSlave_C DSM_SdwDfp_OPSCD_Lamp_C DSM_SdwDfp_OPSCD_anain_C DSM_SdwDfp_OTSCD_C DSM_SdwDfp_OvRMon_C DSM_SdwDfp_OvRMonSigA_C DSM_SdwDfp_OxiCCDTPreB1_C DSM_SdwDfp_OxiCCDTPreB2_C DSM_SdwDfp_PCBS_C DSM_SdwDfp_PCR_BalGvnr_C DSM_SdwDfp_PCR_GovDevNeg_C DSM_SdwDfp_PCR_GovDevPos_C DSM_SdwDfp_PCR_LPGvnrDvtNeg_C DSM_SdwDfp_PCR_LPGvnrDvtPos_C DSM_SdwDfp_PCVCDNoLoad_C DSM_SdwDfp_PCVCDSCBat_C DSM_SdwDfp_PCVCDSCGnd_C DSM_SdwDfp_PCVCD_ADC_C DSM_SdwDfp_PCVCD_SigTst_C DSM_SdwDfp_PFltAPSPlaus_C DSM_SdwDfp_PFltAPSensB1_C DSM_SdwDfp_PFltAPSensB2_C DSM_SdwDfp_PFltBPSPlaus_C DSM_SdwDfp_PFltCDPPreB1_C DSM_SdwDfp_PFltCDPPreB2_C DSM_SdwDfp_PFltCDTPreB1_C DSM_SdwDfp_PFltCDTPreB2_C DSM_SdwDfp_PFltCharB1_C DSM_SdwDfp_PFltCharB2_C DSM_SdwDfp_PFltDltOxiPreTwFlw_C DSM_SdwDfp_PFltDltPreTwFlw_C DSM_SdwDfp_PFltEngPrtB1_C DSM_SdwDfp_PFltEngPrtB2_C DSM_SdwDfp_PFltOvldInhRgnB1_C DSM_SdwDfp_PFltOvldInhRgnB2_C DSM_SdwDfp_PFltOvldTrqLimB1_C DSM_SdwDfp_PFltOvldTrqLimB2_C DSM_SdwDfp_PFltPresDynPlausB1_C DSM_SdwDfp_PFltPresDynPlausB2_C DSM_SdwDfp_PFltPresPlausB1_C DSM_SdwDfp_PFltPresPlausB2_C DSM_SdwDfp_PFltPresSensB1_C DSM_SdwDfp_PFltPresSensB2_C DSM_SdwDfp_PFltPresSensFrz_C DSM_SdwDfp_PFltPresSensHsLnB1_C DSM_SdwDfp_PFltPresSensHsLnB2_C DSM_SdwDfp_PFltPresSensSotB1_C DSM_SdwDfp_PFltPresSensSotB2_C DSM_SdwDfp_PFltRgnPerm_C DSM_SdwDfp_PFltTempDwnStrmB1_C DSM_SdwDfp_PFltTempDwnStrmB2_C DSM_SdwDfp_PFltTempSensB1_C DSM_SdwDfp_PFltTempSensB2_C DSM_SdwDfp_PFltTempUpStrmB1_C DSM_SdwDfp_PFltTempUpStrmB2_C DSM_SdwDfp_PFlt_tOxiPreMaxB1_C DSM_SdwDfp_PFlt_tOxiPreMaxB2_C DSM_SdwDfp_PFlt_tOxiPreMxRgnB1_C DSM_SdwDfp_PFlt_tOxiPreMxRgnB2_C DSM_SdwDfp_PFlt_tPreMaxB1_C DSM_SdwDfp_PFlt_tPreMaxB2_C DSM_SdwDfp_PFlt_tPreMaxRgnB1_C DSM_SdwDfp_PFlt_tPreMaxRgnB2_C DSM_SdwDfp_PFltmSotDiffMaxB1_C DSM_SdwDfp_PFltmSotDiffMaxB2_C DSM_SdwDfp_PresPlausDblDef_C DSM_SdwDfp_QLTCD_C DSM_SdwDfp_RailCD_C DSM_SdwDfp_RailCDOfsTst_C DSM_SdwDfp_RailCD_PMonStrt_C DSM_SdwDfp_RailCPC1_C DSM_SdwDfp_RailCPC3_C DSM_SdwDfp_RailCPC4_C DSM_SdwDfp_RailCtlModeMeUnDiag_C DSM_SdwDfp_RailCtlModePCVDiag_C DSM_SdwDfp_RailMeUn0_C DSM_SdwDfp_RailMeUn1_C DSM_SdwDfp_RailMeUn2_C DSM_SdwDfp_RailMeUn3_C DSM_SdwDfp_RailMeUn4_C DSM_SdwDfp_RailPCV0_C DSM_SdwDfp_RailPCV1_C DSM_SdwDfp_RailPCV2_C DSM_SdwDfp_RailPCV3_C DSM_SdwDfp_RailPCV4_C DSM_SdwDfp_RailPCV5_C DSM_SdwDfp_SOPTst_C DSM_SdwDfp_SSpMon1_C DSM_SdwDfp_SSpMon2_C DSM_SdwDfp_SSpMon3_C DSM_SdwDfp_SSpMon4_C DSM_SdwDfp_SSpMon5_C DSM_SdwDfp_SSpMon6_C DSM_SdwDfp_SWChk_CycSigChkDat_C DSM_SdwDfp_SWChk_CycSigChkPrg_C DSM_SdwDfp_StSysTrqShutOff_C DSM_SdwDfp_StrtCD_Actr_C DSM_SdwDfp_SysLamp_C DSM_SdwDfp_T15CD_C DSM_SdwDfp_TGearbx_C DSM_SdwDfp_TPUMon_C DSM_SdwDfp_TVACD_AirMon1_C DSM_SdwDfp_TVACD_AirMon2_C DSM_SdwDfp_TVACD_Max_C DSM_SdwDfp_TVACD_Max2_C DSM_SdwDfp_TVACD_Min_C DSM_SdwDfp_TVACD_Min2_C DSM_SdwDfp_TVACD_SigNpl_C DSM_SdwDfp_TVACD_SigNpl2_C DSM_SdwDfp_TVACD_TVADia1_C DSM_SdwDfp_TVACD_TVADia2_C DSM_SdwDfp_TVACD_TVADia21_C DSM_SdwDfp_TVACD_TVADia22_C DSM_SdwDfp_TVACD_TVADia23_C DSM_SdwDfp_TVACD_TVADia24_C DSM_SdwDfp_TVACD_TVADia3_C DSM_SdwDfp_TVACD_TVADia4_C DSM_SdwDfp_ThrVlvMon_C DSM_SdwDfp_VSACD_DiaDet_C DSM_SdwDfp_VSACD_DioInDia1_C DSM_SdwDfp_VSACD_DioInDia2_C DSM_SdwDfp_VSACD_DioInDia3_C DSM_SdwDfp_VSACD_DioInDia4_C DSM_SdwDfp_VSACD_DioInMin_C DSM_SdwDfp_VSACD_Max_C DSM_SdwDfp_VSACD_Min_C DSM_SdwDfp_VSACD_SigNpl_C DSM_SdwDfp_VSACD_VSADia1_C DSM_SdwDfp_VSACD_VSADia2_C DSM_SdwDfp_VSACD_VSADia3_C DSM_SdwDfp_VSACD_VSADia4_C DSM_SdwDfp_VSSCD1_C DSM_SdwDfp_VSSCD2_C DSM_SdwDfp_WdCom_C /end DEF_CHARACTERISTIC
/end FUNCTION
/begin COMPU_METHOD Time_ms "Zeit in ms für Fehlerentprellung (DSM) und SW-Timer" RAT_FUNC "%6.1" "ms" COEFFS 0 0.1 0 0 0 1 /end COMPU_METHOD
/begin RECORD_LAYOUT Kw_Wu16 FNC_VALUES 1 UWORD COLUMN_DIR DIRECT /end RECORD_LAYOUT
/end MODULE
/end PROJECT
