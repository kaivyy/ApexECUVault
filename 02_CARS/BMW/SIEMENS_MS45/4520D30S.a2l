ASAP2_VERSION 1 31
/begin PROJECT MS45 "BMW Motorsteuerung R6"
/begin HEADER "_default_HeaderComment" PROJECT_NO _52 /end HEADER
/begin MODULE _default_ModuleName "_default_ModuleLongIdentifier"
/begin MOD_COMMON "_default_ModCommonComment" DEPOSIT ABSOLUTE BYTE_ORDER MSB_FIRST ALIGNMENT_BYTE 1 ALIGNMENT_WORD 2 ALIGNMENT_LONG 4 ALIGNMENT_FLOAT32_IEEE 4 ALIGNMENT_FLOAT64_IEEE 8 /end MOD_COMMON
/begin CHARACTERISTIC ID_ERR_DTC_IMOB_1 "" CURVE 0x40ffa _REC_CUR_20_u2_u2 65535. _CNV_A_R_LINEAR_____10_CM 0. 65535. FORMAT "%5.0"
 /begin AXIS_DESCR COM_AXIS ONLINE_DUMMY _CNV_A_R_LINEAR_____12_CM 6 0. 5. FORMAT "%2.0" AXIS_PTS_REF ldp_fmy_dtc /end AXIS_DESCR
/end CHARACTERISTIC
/begin CHARACTERISTIC C_ERR_CLAS_IMOB_1 "" VALUE 0x4100a _REC_VAL_20_u1 255. _CNV_A_R_LINEAR_____10_CM 0. 255. FORMAT "%3.0" /end CHARACTERISTIC
/begin CHARACTERISTIC ID_ERR_DTC_IMOB_2 "" CURVE 0x4100c _REC_CUR_20_u2_u2 65535. _CNV_A_R_LINEAR_____10_CM 0. 65535. FORMAT "%5.0"
 /begin AXIS_DESCR COM_AXIS ONLINE_DUMMY _CNV_A_R_LINEAR_____12_CM 6 0. 5. FORMAT "%2.0" AXIS_PTS_REF ldp_fmy_dtc /end AXIS_DESCR
/end CHARACTERISTIC
/begin CHARACTERISTIC C_ERR_CLAS_IMOB_2 "" VALUE 0x4101c _REC_VAL_20_u1 255. _CNV_A_R_LINEAR_____10_CM 0. 255. FORMAT "%3.0" /end CHARACTERISTIC
/begin CHARACTERISTIC ID_ERR_DTC_IMOB_3 "" CURVE 0x4101e _REC_CUR_20_u2_u2 65535. _CNV_A_R_LINEAR_____10_CM 0. 65535. FORMAT "%5.0"
 /begin AXIS_DESCR COM_AXIS ONLINE_DUMMY _CNV_A_R_LINEAR_____12_CM 6 0. 5. FORMAT "%2.0" AXIS_PTS_REF ldp_fmy_dtc /end AXIS_DESCR
/end CHARACTERISTIC
/begin CHARACTERISTIC C_ERR_CLAS_IMOB_3 "" VALUE 0x4102e _REC_VAL_20_u1 255. _CNV_A_R_LINEAR_____10_CM 0. 255. FORMAT "%3.0" /end CHARACTERISTIC
/begin CHARACTERISTIC LC_INH_CAT_DIAG_MAN_DEAC "Manual deactivation of cat diagnosis inhibition condition" VALUE 0x42b88 _REC_VAL_20_u1 1. _CNV_S_2_RANGE______28_CM 0. 1. /end CHARACTERISTIC
/begin MEASUREMENT LV_INH_DIAGCPS "activation condition for Functional check CPS, irreversible" UBYTE _CNV_S_2_RANGE______28_CM 1 100. 0. 1. ECU_ADDRESS 0x3fc53d BIT_MASK 0x1 /end MEASUREMENT
/begin MEASUREMENT LV_DI_DIAGCPS "activation condition for Functional check CPS, reversible" UBYTE _CNV_S_2_RANGE______28_CM 1 100. 0. 1. ECU_ADDRESS 0x3fc53e BIT_MASK 0x1 /end MEASUREMENT
/begin MEASUREMENT FLOW_SP_CP_DIAGCPS "Flow setpoint through the CPS during Functional check CPS" UWORD _CNV_A_R_LINEAR_____99_CM 1 100. 0. 7.99987793 ECU_ADDRESS 0x3fc540 FORMAT "%7.4" /end MEASUREMENT
/begin MEASUREMENT STATE_DIAGCPS "State - Functional check CPS" UBYTE _CNV_S_6_STATE_DIAG_180_CM 1 100. 0. 5. ECU_ADDRESS 0x3fc544 /end MEASUREMENT
/begin MEASUREMENT LV_ACT_DIAGCPS "Indication for Functional check cps (step 2 or 3) being activated" UBYTE _CNV_S_2_RANGE______28_CM 1 100. 0. 1. ECU_ADDRESS 0x3fc54f BIT_MASK 0x1 /end MEASUREMENT
/begin MEASUREMENT LV_MAF_DIAGCPS_0 "Auxiliary bit for step 3 - Functional check CPS" UBYTE _CNV_S_2_RANGE______28_CM 1 100. 0. 1. ECU_ADDRESS 0x3fc54d BIT_MASK 0x1 /end MEASUREMENT
/begin MEASUREMENT LV_MAF_DIAGCPS_1 "Auxiliary bit for step 3 - Functional check CPS" UBYTE _CNV_S_2_RANGE______28_CM 1 100. 0. 1. ECU_ADDRESS 0x3fc54e BIT_MASK 0x1 /end MEASUREMENT
/begin MEASUREMENT LV_N_DIF_DIAGCPS "Auxiliary bit for step 2 - Functional check CPS" UBYTE _CNV_S_2_RANGE______28_CM 1 100. 0. 1. ECU_ADDRESS 0x3fc550 BIT_MASK 0x1 /end MEASUREMENT
/begin MEASUREMENT LV_SUPP_ACCIN_DIAGCPS "Bit to suppress the air conditioning compressor request signal - Functional check CPS" UBYTE _CNV_S_2_RANGE______28_CM 1 100. 0. 1. ECU_ADDRESS 0x3fc551 BIT_MASK 0x1 /end MEASUREMENT
/begin MEASUREMENT MAF_DIAGCPS "MAF value on start of step 3 - Functional check CPS" UWORD _CNV_A_R_LINEAR_____95_CM 1 100. 0. 1389. ECU_ADDRESS 0x3fda26 FORMAT "%7.2" /end MEASUREMENT
/begin MEASUREMENT N_DIAGCPS "N value on starting the time C_T_DIAGCPS_N_2" UWORD _CNV_A_R_LINEAR_____17_CM 1 100. 0. 8160. ECU_ADDRESS 0x3fda28 FORMAT "%4.0" /end MEASUREMENT
/begin MEASUREMENT SUM_FLOW_SP_DIAGCPS_EOL "Number of step 2 loops which have been passed if EOL-Test is active - fuctional check CPS" UBYTE _CNV_A_R_LINEAR_____181_CM 1 100. 0. 255. ECU_ADDRESS 0x3fc545 FORMAT "%3.0" /end MEASUREMENT
/begin MEASUREMENT SUM_FLOW_SP_DIAGCPS "Number of step 2 loops which have been passed - Functional check CPS" UBYTE _CNV_A_R_LINEAR_____181_CM 1 100. 0. 255. ECU_ADDRESS 0x3fc546 FORMAT "%3.0" /end MEASUREMENT
/begin MEASUREMENT SUM_DIAG_DIAGCPS_EOL "Number of diagnoses if EOL-Test is active - Functional check CPS" UBYTE _CNV_A_R_LINEAR_____181_CM 1 100. 0. 255. ECU_ADDRESS 0x3fc547 FORMAT "%3.0" /end MEASUREMENT
/begin MEASUREMENT SUM_DIAG_DIAGCPS "Number of diagnoses - Functional check CPS" UBYTE _CNV_A_R_LINEAR_____181_CM 1 100. 0. 255. ECU_ADDRESS 0x3fc548 FORMAT "%3.0" /end MEASUREMENT
/begin MEASUREMENT T_DIAGCPS_DLY "Delay time - Functional check CPS" UBYTE _CNV_A_R_LINEAR_____14_CM 1 100. 0.1 25.5 ECU_ADDRESS 0x3fc549 FORMAT "%4.1" /end MEASUREMENT
/begin MEASUREMENT T_DIAGCPS_MAF "Time for active FLOW_SP offset - Functional check CPS" UBYTE _CNV_A_R_LINEAR_____14_CM 1 100. 0.1 25.5 ECU_ADDRESS 0x3fda2c FORMAT "%4.1" /end MEASUREMENT
/begin MEASUREMENT T_DIAGCPS_N_1 "1st time interval for N-DIF-Diagnosis - Functional check CPS" UBYTE _CNV_A_R_LINEAR_____14_CM 1 100. 0.1 25.5 ECU_ADDRESS 0x3fc54a FORMAT "%4.1" /end MEASUREMENT
/begin MEASUREMENT T_DIAGCPS_N_2 "2nd time interval for N-DIF-Diagnosis - Functional check CPS" UBYTE _CNV_A_R_LINEAR_____14_CM 1 100. 0.1 25.5 ECU_ADDRESS 0x3fc54b FORMAT "%4.1" /end MEASUREMENT
/begin MEASUREMENT T_DIAGCPS_N_3 "3rd time interval for N-DIF-Diagnosis - Functional check CPS" UBYTE _CNV_A_R_LINEAR_____14_CM 1 100. 0.1 25.5 ECU_ADDRESS 0x3fc54c FORMAT "%4.1" /end MEASUREMENT
/begin MEASUREMENT ISAPWM_MMV_DIAGCPS "Moving mean value of ISAPWM (RAM cell) - Functional check CPS" UWORD _CNV_A_R_LINEAR_____94_CM 1 100. 0. 99.99847412 ECU_ADDRESS 0x3fc542 /end MEASUREMENT
/begin MEASUREMENT LV_ISAPWM_DYW_DIAGCPS "Indication for limited dynamic condition - Functional check CPS" UBYTE _CNV_S_2_RANGE______28_CM 1 100. 0. 1. ECU_ADDRESS 0x3fc552 BIT_MASK 0x1 /end MEASUREMENT
/begin CHARACTERISTIC C_CL_MMV_DIAGCPS "Moving mean value of canister load for Functional check CPS" VALUE 0x42c50 _REC_VAL_20_u2 1.99996948 _CNV_A_R_LINEAR_____45_CM 0. 1.99996948 FORMAT "%7.5" /end CHARACTERISTIC
/begin CHARACTERISTIC C_FLOW_SP_DIAGCPS_MAF "Flow setpoint offset in step 3 - Functional check CPS " VALUE 0x42d64 _REC_VAL_20_u2 7.99987793 _CNV_A_R_LINEAR_____99_CM 0. 7.99987793 FORMAT "%7.4" /end CHARACTERISTIC
/begin CHARACTERISTIC C_FLOW_SP_DIAGCPS_N "Flow setpoint offset in step 2 - Functional check CPS " VALUE 0x42d66 _REC_VAL_20_u2 7.99987793 _CNV_A_R_LINEAR_____99_CM 0. 7.99987793 FORMAT "%7.4" /end CHARACTERISTIC
/begin CHARACTERISTIC C_LGRD_FLOW_SP_NEG_DIAGCPS "Limitation gradient for closing the CPS- funtional check CPS" VALUE 0x42de4 _REC_VAL_20_u2 7.99987793 _CNV_A_R_LINEAR_____99_CM 0. 7.99987793 FORMAT "%7.4" /end CHARACTERISTIC
/begin CHARACTERISTIC C_LGRD_FLOW_SP_POS_DIAGCPS "Limitation gradient for opening the CPS- funtional check CPS" VALUE 0x42de6 _REC_VAL_20_u2 7.99987793 _CNV_A_R_LINEAR_____99_CM 0. 7.99987793 FORMAT "%7.4" /end CHARACTERISTIC
/begin CHARACTERISTIC C_MAF_DIAGCPS "Delta MAF for MAF decrease - Functional check CPS" VALUE 0x42e0a _REC_VAL_20_u2 1389. _CNV_A_R_LINEAR_____95_CM 0. 1389. FORMAT "%7.2" /end CHARACTERISTIC
/begin CHARACTERISTIC C_N_DIAGCPS "Threshold for engine speed increase in step 2 - Functional check CPS" VALUE 0x42e9e _REC_VAL_20_u2 8159. _CNV_A_R_LINEAR_____17_CM 1. 8160. FORMAT "%4.0" /end CHARACTERISTIC
/begin CHARACTERISTIC C_N_DIF_DIAGCPS "Condition for IS engine speed difference - Functional check CPS" VALUE 0x42ea0 _REC_VAL_20_u2 8159. _CNV_A_R_LINEAR_____17_CM 1. 8160. FORMAT "%4.0" /end CHARACTERISTIC
/begin CHARACTERISTIC C_SUM_FLOW_SP_DIAGCPS_MAX "Max. number of step 2 loops which have been passed - Functional check CPS" VALUE 0x429af _REC_VAL_20_u1 255. _CNV_A_R_LINEAR_____181_CM 0. 255. FORMAT "%3.0" /end CHARACTERISTIC
/begin CHARACTERISTIC C_SUM_DIAGCPS_MAX "Counter limit of C_SUM_DIAGCPS - funtional check CPS" VALUE 0x429ab _REC_VAL_20_u1 255. _CNV_A_R_LINEAR_____181_CM 0. 255. FORMAT "%3.0" /end CHARACTERISTIC
/begin CHARACTERISTIC C_T_DIAGCPS_MAF "Time for active FLOW_SP offset C_FLOW_SP_DIAGCPS_MAF - Functional check CPS" VALUE 0x429ce _REC_VAL_20_u1 25.4 _CNV_A_R_LINEAR_____14_CM 0.1 25.5 FORMAT "%4.1" /end CHARACTERISTIC
/begin CHARACTERISTIC C_T_DIAGCPS_N_1 "Time interval after expiry of which the cycle of step 2 is repeated - Functional check CPS" VALUE 0x429cf _REC_VAL_20_u1 25.4 _CNV_A_R_LINEAR_____14_CM 0.1 25.5 FORMAT "%4.1" /end CHARACTERISTIC
/begin CHARACTERISTIC C_T_DIAGCPS_N_2 "Time as from setting C_FLOW_SP_DIAGCPS_N - Functional check CPS" VALUE 0x429d0 _REC_VAL_20_u1 25.4 _CNV_A_R_LINEAR_____14_CM 0.1 25.5 FORMAT "%4.1" /end CHARACTERISTIC
/begin CHARACTERISTIC C_T_DIAGCPS_N_3 "Time for increasing FLOW_SP - Functional check CPS" VALUE 0x429d1 _REC_VAL_20_u1 25.4 _CNV_A_R_LINEAR_____14_CM 0.1 25.5 FORMAT "%4.1" /end CHARACTERISTIC
/begin CHARACTERISTIC C_T_DIAGCPS_DLY "Delay time - Functional check CPS" VALUE 0x429cd _REC_VAL_20_u1 25.4 _CNV_A_R_LINEAR_____14_CM 0.1 25.5 FORMAT "%3.1" /end CHARACTERISTIC
/begin CHARACTERISTIC C_CRLC_ISAPWM_DIAGCPS "Correlation constant for calculation of ISAPWM_MMV_DIAGCPS" VALUE 0x42c74 _REC_VAL_20_u2 1. _CNV_A_R_LINEAR_____182_CM 0. 1. FORMAT "%7.5" /end CHARACTERISTIC
/begin CHARACTERISTIC C_ISAPWM_DYW_DIAGCPS "Dynamic window around ISAPWM_MMV_DIAGCPS" VALUE 0x42da8 _REC_VAL_20_u2 99.99847412 _CNV_A_R_LINEAR_____94_CM 0. 99.99847412 FORMAT "%5.2" /end CHARACTERISTIC
/begin CHARACTERISTIC ID_CLAS_B_FMT "" MAP 0x4cbe8 _REC_MAP_20_u1_u2_u2 255. _CNV_A_R_LINEAR_____10_CM 0. 255. FORMAT "%3.0"
 /begin AXIS_DESCR COM_AXIS ONLINE_DUMMY _CNV_A_R_LINEAR_____10_CM 16 0. 65535. FORMAT "%5.0" AXIS_PTS_REF ldpm_clas_a_id_clas_fmy /end AXIS_DESCR
 /begin AXIS_DESCR COM_AXIS ONLINE_DUMMY _CNV_A_R_LINEAR_____10_CM 4 0. 65535. FORMAT "%5.0" AXIS_PTS_REF ldp_clas_b_id_clas_fmy /end AXIS_DESCR
/end CHARACTERISTIC
/begin CHARACTERISTIC ID_CLAS_A_FMT "" CURVE 0x4cbd8 _REC_CUR_20_u1_u2 255. _CNV_A_R_LINEAR_____10_CM 0. 255. FORMAT "%3.0"
 /begin AXIS_DESCR COM_AXIS ONLINE_DUMMY _CNV_A_R_LINEAR_____10_CM 16 0. 65535. FORMAT "%5.0" AXIS_PTS_REF ldpm_clas_a_id_clas_fmy /end AXIS_DESCR
/end CHARACTERISTIC
/begin CHARACTERISTIC ID_ERR_DTC_BSD "" CURVE 0x411f2 _REC_CUR_20_u2_u2 65535. _CNV_A_R_LINEAR_____10_CM 0. 65535. FORMAT "%5.0"
 /begin AXIS_DESCR COM_AXIS ONLINE_DUMMY _CNV_A_R_LINEAR_____12_CM 6 0. 5. FORMAT "%2.0" AXIS_PTS_REF ldp_fmy_dtc /end AXIS_DESCR
/end CHARACTERISTIC
/begin CHARACTERISTIC C_ERR_CLAS_BSD "" VALUE 0x41202 _REC_VAL_20_u1 255. _CNV_A_R_LINEAR_____10_CM 0. 255. FORMAT "%3.0" /end CHARACTERISTIC
/begin CHARACTERISTIC ID_ERR_DTC_CPS "" CURVE 0x407ae _REC_CUR_20_u2_u2 65535. _CNV_A_R_LINEAR_____10_CM 0. 65535. FORMAT "%5.0"
 /begin AXIS_DESCR COM_AXIS ONLINE_DUMMY _CNV_A_R_LINEAR_____12_CM 6 0. 5. FORMAT "%2.0" AXIS_PTS_REF ldp_fmy_dtc /end AXIS_DESCR
/end CHARACTERISTIC
/begin CHARACTERISTIC C_ERR_CLAS_CPS "" VALUE 0x407be _REC_VAL_20_u1 255. _CNV_A_R_LINEAR_____10_CM 0. 255. FORMAT "%3.0" /end CHARACTERISTIC
/begin CHARACTERISTIC ID_ERR_DTC_CAT_DIAG_1 "" CURVE 0x41054 _REC_CUR_20_u2_u2 65535. _CNV_A_R_LINEAR_____10_CM 0. 65535. FORMAT "%5.0"
 /begin AXIS_DESCR COM_AXIS ONLINE_DUMMY _CNV_A_R_LINEAR_____12_CM 6 0. 5. FORMAT "%2.0" AXIS_PTS_REF ldp_fmy_dtc /end AXIS_DESCR
/end CHARACTERISTIC
/begin CHARACTERISTIC C_ERR_CLAS_CAT_DIAG_1 "" VALUE 0x41064 _REC_VAL_20_u1 255. _CNV_A_R_LINEAR_____10_CM 0. 255. FORMAT "%3.0" /end CHARACTERISTIC
/begin CHARACTERISTIC ID_ERR_DTC_CAT_DIAG_2 "" CURVE 0x41066 _REC_CUR_20_u2_u2 65535. _CNV_A_R_LINEAR_____10_CM 0. 65535. FORMAT "%5.0"
 /begin AXIS_DESCR COM_AXIS ONLINE_DUMMY _CNV_A_R_LINEAR_____12_CM 6 0. 5. FORMAT "%2.0" AXIS_PTS_REF ldp_fmy_dtc /end AXIS_DESCR
/end CHARACTERISTIC
/begin CHARACTERISTIC C_ERR_CLAS_CAT_DIAG_2 "" VALUE 0x41076 _REC_VAL_20_u1 255. _CNV_A_R_LINEAR_____10_CM 0. 255. FORMAT "%3.0" /end CHARACTERISTIC
/begin CHARACTERISTIC ID_ERR_DTC_GEN "" CURVE 0x40b9e _REC_CUR_20_u2_u2 65535. _CNV_A_R_LINEAR_____10_CM 0. 65535. FORMAT "%5.0"
 /begin AXIS_DESCR COM_AXIS ONLINE_DUMMY _CNV_A_R_LINEAR_____12_CM 6 0. 5. FORMAT "%2.0" AXIS_PTS_REF ldp_fmy_dtc /end AXIS_DESCR
/end CHARACTERISTIC
/begin CHARACTERISTIC C_ERR_CLAS_GEN "" VALUE 0x40bae _REC_VAL_20_u1 255. _CNV_A_R_LINEAR_____10_CM 0. 255. FORMAT "%3.0" /end CHARACTERISTIC
/begin CHARACTERISTIC ID_ERR_DTC_CAM_0_NOT_PLAUS "" CURVE 0x40c1c _REC_CUR_20_u2_u2 65535. _CNV_A_R_LINEAR_____10_CM 0. 65535. FORMAT "%5.0"
 /begin AXIS_DESCR COM_AXIS ONLINE_DUMMY _CNV_A_R_LINEAR_____12_CM 6 0. 5. FORMAT "%2.0" AXIS_PTS_REF ldp_fmy_dtc /end AXIS_DESCR
/end CHARACTERISTIC
/begin CHARACTERISTIC C_ERR_CLAS_CAM_0_NOT_PLAUS "" VALUE 0x40c2c _REC_VAL_20_u1 255. _CNV_A_R_LINEAR_____10_CM 0. 255. FORMAT "%3.0" /end CHARACTERISTIC
/begin CHARACTERISTIC ID_ERR_DTC_BN_ARS "" CURVE 0x412a6 _REC_CUR_20_u2_u2 65535. _CNV_A_R_LINEAR_____10_CM 0. 65535. FORMAT "%5.0"
 /begin AXIS_DESCR COM_AXIS ONLINE_DUMMY _CNV_A_R_LINEAR_____12_CM 6 0. 5. FORMAT "%2.0" AXIS_PTS_REF ldp_fmy_dtc /end AXIS_DESCR
/end CHARACTERISTIC
/begin CHARACTERISTIC C_ERR_CLAS_BN_ARS "" VALUE 0x412b6 _REC_VAL_20_u1 255. _CNV_A_R_LINEAR_____10_CM 0. 255. FORMAT "%3.0" /end CHARACTERISTIC
/begin CHARACTERISTIC ID_ERR_DTC_TQ_DIF_I_IS_MON_1 "" CURVE 0x40f34 _REC_CUR_20_u2_u2 65535. _CNV_A_R_LINEAR_____10_CM 0. 65535. FORMAT "%5.0"
 /begin AXIS_DESCR COM_AXIS ONLINE_DUMMY _CNV_A_R_LINEAR_____12_CM 6 0. 5. FORMAT "%2.0" AXIS_PTS_REF ldp_fmy_dtc /end AXIS_DESCR
/end CHARACTERISTIC
/begin CHARACTERISTIC C_ERR_CLAS_TQ_DIF_I_IS_MON_1 "" VALUE 0x40f44 _REC_VAL_20_u1 255. _CNV_A_R_LINEAR_____10_CM 0. 255. FORMAT "%3.0" /end CHARACTERISTIC
/begin CHARACTERISTIC ID_ERR_DTC_PVS_BLS_NOT_PLAUS "" CURVE 0x4111a _REC_CUR_20_u2_u2 65535. _CNV_A_R_LINEAR_____10_CM 0. 65535. FORMAT "%5.0"
 /begin AXIS_DESCR COM_AXIS ONLINE_DUMMY _CNV_A_R_LINEAR_____12_CM 6 0. 5. FORMAT "%2.0" AXIS_PTS_REF ldp_fmy_dtc /end AXIS_DESCR
/end CHARACTERISTIC
/begin CHARACTERISTIC C_ERR_CLAS_PVS_BLS_NOT_PLAUS "" VALUE 0x4112a _REC_VAL_20_u1 255. _CNV_A_R_LINEAR_____10_CM 0. 255. FORMAT "%3.0" /end CHARACTERISTIC
/begin CHARACTERISTIC ID_ERR_DTC_SAP "" CURVE 0x40ce2 _REC_CUR_20_u2_u2 65535. _CNV_A_R_LINEAR_____10_CM 0. 65535. FORMAT "%5.0"
 /begin AXIS_DESCR COM_AXIS ONLINE_DUMMY _CNV_A_R_LINEAR_____12_CM 6 0. 5. FORMAT "%2.0" AXIS_PTS_REF ldp_fmy_dtc /end AXIS_DESCR
/end CHARACTERISTIC
/begin CHARACTERISTIC C_ERR_CLAS_SAP "" VALUE 0x40cf2 _REC_VAL_20_u1 255. _CNV_A_R_LINEAR_____10_CM 0. 255. FORMAT "%3.0" /end CHARACTERISTIC
/begin CHARACTERISTIC ID_ERR_DTC_POIL_SWI "" CURVE 0x41204 _REC_CUR_20_u2_u2 65535. _CNV_A_R_LINEAR_____10_CM 0. 65535. FORMAT "%5.0"
 /begin AXIS_DESCR COM_AXIS ONLINE_DUMMY _CNV_A_R_LINEAR_____12_CM 6 0. 5. FORMAT "%2.0" AXIS_PTS_REF ldp_fmy_dtc /end AXIS_DESCR
/end CHARACTERISTIC
/begin CHARACTERISTIC C_ERR_CLAS_POIL_SWI "" VALUE 0x41214 _REC_VAL_20_u1 255. _CNV_A_R_LINEAR_____10_CM 0. 255. FORMAT "%3.0" /end CHARACTERISTIC
/begin CHARACTERISTIC ID_ERR_DTC_BN_ETCU "" CURVE 0x41312 _REC_CUR_20_u2_u2 65535. _CNV_A_R_LINEAR_____10_CM 0. 65535. FORMAT "%5.0"
 /begin AXIS_DESCR COM_AXIS ONLINE_DUMMY _CNV_A_R_LINEAR_____12_CM 6 0. 5. FORMAT "%2.0" AXIS_PTS_REF ldp_fmy_dtc /end AXIS_DESCR
/end CHARACTERISTIC
/begin CHARACTERISTIC C_ERR_CLAS_BN_ETCU "" VALUE 0x41322 _REC_VAL_20_u1 255. _CNV_A_R_LINEAR_____10_CM 0. 255. FORMAT "%3.0" /end CHARACTERISTIC
/begin CHARACTERISTIC ID_ERR_DTC_SAV "" CURVE 0x40cf4 _REC_CUR_20_u2_u2 65535. _CNV_A_R_LINEAR_____10_CM 0. 65535. FORMAT "%5.0"
 /begin AXIS_DESCR COM_AXIS ONLINE_DUMMY _CNV_A_R_LINEAR_____12_CM 6 0. 5. FORMAT "%2.0" AXIS_PTS_REF ldp_fmy_dtc /end AXIS_DESCR
/end CHARACTERISTIC
/begin CHARACTERISTIC C_ERR_CLAS_SAV "" VALUE 0x40d04 _REC_VAL_20_u1 255. _CNV_A_R_LINEAR_____10_CM 0. 255. FORMAT "%3.0" /end CHARACTERISTIC
/begin CHARACTERISTIC ID_ERR_DTC_PVS_DOUBLE "" CURVE 0x40afc _REC_CUR_20_u2_u2 65535. _CNV_A_R_LINEAR_____10_CM 0. 65535. FORMAT "%5.0"
 /begin AXIS_DESCR COM_AXIS ONLINE_DUMMY _CNV_A_R_LINEAR_____12_CM 6 0. 5. FORMAT "%2.0" AXIS_PTS_REF ldp_fmy_dtc /end AXIS_DESCR
/end CHARACTERISTIC
/begin CHARACTERISTIC C_ERR_CLAS_PVS_DOUBLE "" VALUE 0x40b0c _REC_VAL_20_u1 255. _CNV_A_R_LINEAR_____10_CM 0. 255. FORMAT "%3.0" /end CHARACTERISTIC
/begin CHARACTERISTIC ID_ERR_DTC_CONV_MON_1 "" CURVE 0x40ea4 _REC_CUR_20_u2_u2 65535. _CNV_A_R_LINEAR_____10_CM 0. 65535. FORMAT "%5.0"
 /begin AXIS_DESCR COM_AXIS ONLINE_DUMMY _CNV_A_R_LINEAR_____12_CM 6 0. 5. FORMAT "%2.0" AXIS_PTS_REF ldp_fmy_dtc /end AXIS_DESCR
/end CHARACTERISTIC
/begin CHARACTERISTIC C_ERR_CLAS_CONV_MON_1 "" VALUE 0x40eb4 _REC_VAL_20_u1 255. _CNV_A_R_LINEAR_____10_CM 0. 255. FORMAT "%3.0" /end CHARACTERISTIC
/begin CHARACTERISTIC ID_ERR_DTC_BN_TQ_TCS "" CURVE 0x412ca _REC_CUR_20_u2_u2 65535. _CNV_A_R_LINEAR_____10_CM 0. 65535. FORMAT "%5.0"
 /begin AXIS_DESCR COM_AXIS ONLINE_DUMMY _CNV_A_R_LINEAR_____12_CM 6 0. 5. FORMAT "%2.0" AXIS_PTS_REF ldp_fmy_dtc /end AXIS_DESCR
/end CHARACTERISTIC
/begin CHARACTERISTIC C_ERR_CLAS_BN_TQ_TCS "" VALUE 0x412da _REC_VAL_20_u1 255. _CNV_A_R_LINEAR_____10_CM 0. 255. FORMAT "%3.0" /end CHARACTERISTIC
/begin CHARACTERISTIC ID_ERR_DTC_SA_SAFM "" CURVE 0x40fc4 _REC_CUR_20_u2_u2 65535. _CNV_A_R_LINEAR_____10_CM 0. 65535. FORMAT "%5.0"
 /begin AXIS_DESCR COM_AXIS ONLINE_DUMMY _CNV_A_R_LINEAR_____12_CM 6 0. 5. FORMAT "%2.0" AXIS_PTS_REF ldp_fmy_dtc /end AXIS_DESCR
/end CHARACTERISTIC
/begin CHARACTERISTIC C_ERR_CLAS_SA_SAFM "" VALUE 0x40fd4 _REC_VAL_20_u1 255. _CNV_A_R_LINEAR_____10_CM 0. 255. FORMAT "%3.0" /end CHARACTERISTIC
/begin CHARACTERISTIC ID_ERR_DTC_N_EFP_HIGH "" CURVE 0x41432 _REC_CUR_20_u2_u2 65535. _CNV_A_R_LINEAR_____10_CM 0. 65535. FORMAT "%5.0"
 /begin AXIS_DESCR COM_AXIS ONLINE_DUMMY _CNV_A_R_LINEAR_____12_CM 6 0. 5. FORMAT "%2.0" AXIS_PTS_REF ldp_fmy_dtc /end AXIS_DESCR
/end CHARACTERISTIC
/begin CHARACTERISTIC C_ERR_CLAS_N_EFP_HIGH "" VALUE 0x41442 _REC_VAL_20_u1 255. _CNV_A_R_LINEAR_____10_CM 0. 255. FORMAT "%3.0" /end CHARACTERISTIC
/begin CHARACTERISTIC ID_ERR_DTC_VLS_UP_PUC_1 "" CURVE 0x41564 _REC_CUR_20_u2_u2 65535. _CNV_A_R_LINEAR_____10_CM 0. 65535. FORMAT "%5.0"
 /begin AXIS_DESCR COM_AXIS ONLINE_DUMMY _CNV_A_R_LINEAR_____12_CM 6 0. 5. FORMAT "%2.0" AXIS_PTS_REF ldp_fmy_dtc /end AXIS_DESCR
/end CHARACTERISTIC
/begin CHARACTERISTIC C_ERR_CLAS_VLS_UP_PUC_1 "" VALUE 0x41574 _REC_VAL_20_u1 255. _CNV_A_R_LINEAR_____10_CM 0. 255. FORMAT "%3.0" /end CHARACTERISTIC
/begin CHARACTERISTIC ID_ERR_DTC_VLS_UP_PUC_2 "" CURVE 0x41576 _REC_CUR_20_u2_u2 65535. _CNV_A_R_LINEAR_____10_CM 0. 65535. FORMAT "%5.0"
 /begin AXIS_DESCR COM_AXIS ONLINE_DUMMY _CNV_A_R_LINEAR_____12_CM 6 0. 5. FORMAT "%2.0" AXIS_PTS_REF ldp_fmy_dtc /end AXIS_DESCR
/end CHARACTERISTIC
/begin CHARACTERISTIC C_ERR_CLAS_VLS_UP_PUC_2 "" VALUE 0x41586 _REC_VAL_20_u1 255. _CNV_A_R_LINEAR_____10_CM 0. 255. FORMAT "%3.0" /end CHARACTERISTIC
/begin CHARACTERISTIC ID_ERR_DTC_N_EFP_LOW "" CURVE 0x41420 _REC_CUR_20_u2_u2 65535. _CNV_A_R_LINEAR_____10_CM 0. 65535. FORMAT "%5.0"
 /begin AXIS_DESCR COM_AXIS ONLINE_DUMMY _CNV_A_R_LINEAR_____12_CM 6 0. 5. FORMAT "%2.0" AXIS_PTS_REF ldp_fmy_dtc /end AXIS_DESCR
/end CHARACTERISTIC
/begin CHARACTERISTIC C_ERR_CLAS_N_EFP_LOW "" VALUE 0x41430 _REC_VAL_20_u1 255. _CNV_A_R_LINEAR_____10_CM 0. 255. FORMAT "%3.0" /end CHARACTERISTIC
/begin CHARACTERISTIC ID_ERR_DTC_LS_UP_SWT_1 "" CURVE 0x415d0 _REC_CUR_20_u2_u2 65535. _CNV_A_R_LINEAR_____10_CM 0. 65535. FORMAT "%5.0"
 /begin AXIS_DESCR COM_AXIS ONLINE_DUMMY _CNV_A_R_LINEAR_____12_CM 6 0. 5. FORMAT "%2.0" AXIS_PTS_REF ldp_fmy_dtc /end AXIS_DESCR
/end CHARACTERISTIC
/begin CHARACTERISTIC C_ERR_CLAS_LS_UP_SWT_1 "" VALUE 0x415e0 _REC_VAL_20_u1 255. _CNV_A_R_LINEAR_____10_CM 0. 255. FORMAT "%3.0" /end CHARACTERISTIC
/begin CHARACTERISTIC ID_ERR_DTC_LS_UP_SWT_2 "" CURVE 0x415e2 _REC_CUR_20_u2_u2 65535. _CNV_A_R_LINEAR_____10_CM 0. 65535. FORMAT "%5.0"
 /begin AXIS_DESCR COM_AXIS ONLINE_DUMMY _CNV_A_R_LINEAR_____12_CM 6 0. 5. FORMAT "%2.0" AXIS_PTS_REF ldp_fmy_dtc /end AXIS_DESCR
/end CHARACTERISTIC
/begin CHARACTERISTIC C_ERR_CLAS_LS_UP_SWT_2 "" VALUE 0x415f2 _REC_VAL_20_u1 255. _CNV_A_R_LINEAR_____10_CM 0. 255. FORMAT "%3.0" /end CHARACTERISTIC
/begin CHARACTERISTIC ID_ERR_DTC_TOUT_PSTE_1 "" CURVE 0x40928 _REC_CUR_20_u2_u2 65535. _CNV_A_R_LINEAR_____10_CM 0. 65535. FORMAT "%5.0"
 /begin AXIS_DESCR COM_AXIS ONLINE_DUMMY _CNV_A_R_LINEAR_____12_CM 6 0. 5. FORMAT "%2.0" AXIS_PTS_REF ldp_fmy_dtc /end AXIS_DESCR
/end CHARACTERISTIC
/begin CHARACTERISTIC C_ERR_CLAS_TOUT_PSTE_1 "" VALUE 0x40938 _REC_VAL_20_u1 255. _CNV_A_R_LINEAR_____10_CM 0. 255. FORMAT "%3.0" /end CHARACTERISTIC
/begin CHARACTERISTIC ID_ERR_TQ_GS_INC_PLAUS "" CURVE 0x4123a _REC_CUR_20_u2_u2 65535. _CNV_A_R_LINEAR_____10_CM 0. 65535. FORMAT "%5.0"
 /begin AXIS_DESCR COM_AXIS ONLINE_DUMMY _CNV_A_R_LINEAR_____12_CM 6 0. 5. FORMAT "%2.0" AXIS_PTS_REF ldp_fmy_dtc /end AXIS_DESCR
/end CHARACTERISTIC
/begin CHARACTERISTIC C_ERR_CLAS_TQ_GS_INC_PLAUS "" VALUE 0x4124a _REC_VAL_20_u1 255. _CNV_A_R_LINEAR_____10_CM 0. 255. FORMAT "%3.0" /end CHARACTERISTIC
/begin CHARACTERISTIC ID_ERR_DTC_TPS_MAF_1 "" CURVE 0x40a7e _REC_CUR_20_u2_u2 65535. _CNV_A_R_LINEAR_____10_CM 0. 65535. FORMAT "%5.0"
 /begin AXIS_DESCR COM_AXIS ONLINE_DUMMY _CNV_A_R_LINEAR_____12_CM 6 0. 5. FORMAT "%2.0" AXIS_PTS_REF ldp_fmy_dtc /end AXIS_DESCR
/end CHARACTERISTIC
/begin CHARACTERISTIC C_ERR_CLAS_TPS_MAF_1 "" VALUE 0x40a8e _REC_VAL_20_u1 255. _CNV_A_R_LINEAR_____10_CM 0. 255. FORMAT "%3.0" /end CHARACTERISTIC
/begin CHARACTERISTIC ID_ERR_DTC_TPS_MAF_2 "" CURVE 0x40a90 _REC_CUR_20_u2_u2 65535. _CNV_A_R_LINEAR_____10_CM 0. 65535. FORMAT "%5.0"
 /begin AXIS_DESCR COM_AXIS ONLINE_DUMMY _CNV_A_R_LINEAR_____12_CM 6 0. 5. FORMAT "%2.0" AXIS_PTS_REF ldp_fmy_dtc /end AXIS_DESCR
/end CHARACTERISTIC
/begin CHARACTERISTIC C_ERR_CLAS_TPS_MAF_2 "" VALUE 0x40aa0 _REC_VAL_20_u1 255. _CNV_A_R_LINEAR_____10_CM 0. 255. FORMAT "%3.0" /end CHARACTERISTIC
/begin CHARACTERISTIC ID_ERR_DTC_REF_IVVT_EX_1 "" CURVE 0x4082c _REC_CUR_20_u2_u2 65535. _CNV_A_R_LINEAR_____10_CM 0. 65535. FORMAT "%5.0"
 /begin AXIS_DESCR COM_AXIS ONLINE_DUMMY _CNV_A_R_LINEAR_____12_CM 6 0. 5. FORMAT "%2.0" AXIS_PTS_REF ldp_fmy_dtc /end AXIS_DESCR
/end CHARACTERISTIC
/begin CHARACTERISTIC C_ERR_CLAS_REF_IVVT_EX_1 "" VALUE 0x4083c _REC_VAL_20_u1 255. _CNV_A_R_LINEAR_____10_CM 0. 255. FORMAT "%3.0" /end CHARACTERISTIC
/begin CHARACTERISTIC ID_ERR_DTC_REF_IVVT_EX_2 "" CURVE 0x4083e _REC_CUR_20_u2_u2 65535. _CNV_A_R_LINEAR_____10_CM 0. 65535. FORMAT "%5.0"
 /begin AXIS_DESCR COM_AXIS ONLINE_DUMMY _CNV_A_R_LINEAR_____12_CM 6 0. 5. FORMAT "%2.0" AXIS_PTS_REF ldp_fmy_dtc /end AXIS_DESCR
/end CHARACTERISTIC
/begin CHARACTERISTIC C_ERR_CLAS_REF_IVVT_EX_2 "" VALUE 0x4084e _REC_VAL_20_u1 255. _CNV_A_R_LINEAR_____10_CM 0. 255. FORMAT "%3.0" /end CHARACTERISTIC
/begin CHARACTERISTIC ID_ERR_DTC_SA_SAP "" CURVE 0x40fd6 _REC_CUR_20_u2_u2 65535. _CNV_A_R_LINEAR_____10_CM 0. 65535. FORMAT "%5.0"
 /begin AXIS_DESCR COM_AXIS ONLINE_DUMMY _CNV_A_R_LINEAR_____12_CM 6 0. 5. FORMAT "%2.0" AXIS_PTS_REF ldp_fmy_dtc /end AXIS_DESCR
/end CHARACTERISTIC
/begin CHARACTERISTIC C_ERR_CLAS_SA_SAP "" VALUE 0x40fe6 _REC_VAL_20_u1 255. _CNV_A_R_LINEAR_____10_CM 0. 255. FORMAT "%3.0" /end CHARACTERISTIC
/begin CHARACTERISTIC ID_ERR_DTC_MTC_CTL_1 "" CURVE 0x40b20 _REC_CUR_20_u2_u2 65535. _CNV_A_R_LINEAR_____10_CM 0. 65535. FORMAT "%5.0"
 /begin AXIS_DESCR COM_AXIS ONLINE_DUMMY _CNV_A_R_LINEAR_____12_CM 6 0. 5. FORMAT "%2.0" AXIS_PTS_REF ldp_fmy_dtc /end AXIS_DESCR
/end CHARACTERISTIC
/begin CHARACTERISTIC C_ERR_CLAS_MTC_CTL_1 "" VALUE 0x40b30 _REC_VAL_20_u1 255. _CNV_A_R_LINEAR_____10_CM 0. 255. FORMAT "%3.0" /end CHARACTERISTIC
/begin CHARACTERISTIC ID_ERR_DTC_SA_SAV "" CURVE 0x40fe8 _REC_CUR_20_u2_u2 65535. _CNV_A_R_LINEAR_____10_CM 0. 65535. FORMAT "%5.0"
 /begin AXIS_DESCR COM_AXIS ONLINE_DUMMY _CNV_A_R_LINEAR_____12_CM 6 0. 5. FORMAT "%2.0" AXIS_PTS_REF ldp_fmy_dtc /end AXIS_DESCR
/end CHARACTERISTIC
/begin CHARACTERISTIC C_ERR_CLAS_SA_SAV "" VALUE 0x40ff8 _REC_VAL_20_u1 255. _CNV_A_R_LINEAR_____10_CM 0. 255. FORMAT "%3.0" /end CHARACTERISTIC
/begin CHARACTERISTIC ID_ERR_DTC_MTC_CTL_2 "" CURVE 0x40b32 _REC_CUR_20_u2_u2 65535. _CNV_A_R_LINEAR_____10_CM 0. 65535. FORMAT "%5.0"
 /begin AXIS_DESCR COM_AXIS ONLINE_DUMMY _CNV_A_R_LINEAR_____12_CM 6 0. 5. FORMAT "%2.0" AXIS_PTS_REF ldp_fmy_dtc /end AXIS_DESCR
/end CHARACTERISTIC
/begin CHARACTERISTIC C_ERR_CLAS_MTC_CTL_2 "" VALUE 0x40b42 _REC_VAL_20_u1 255. _CNV_A_R_LINEAR_____10_CM 0. 255. FORMAT "%3.0" /end CHARACTERISTIC
/begin CHARACTERISTIC ID_ERR_DTC_MTC_CTL_3 "" CURVE 0x40b44 _REC_CUR_20_u2_u2 65535. _CNV_A_R_LINEAR_____10_CM 0. 65535. FORMAT "%5.0"
 /begin AXIS_DESCR COM_AXIS ONLINE_DUMMY _CNV_A_R_LINEAR_____12_CM 6 0. 5. FORMAT "%2.0" AXIS_PTS_REF ldp_fmy_dtc /end AXIS_DESCR
/end CHARACTERISTIC
/begin CHARACTERISTIC C_ERR_CLAS_MTC_CTL_3 "" VALUE 0x40b54 _REC_VAL_20_u1 255. _CNV_A_R_LINEAR_____10_CM 0. 255. FORMAT "%3.0" /end CHARACTERISTIC
/begin CHARACTERISTIC ID_ERR_DTC_DCC_REV "" CURVE 0x4124c _REC_CUR_20_u2_u2 65535. _CNV_A_R_LINEAR_____10_CM 0. 65535. FORMAT "%5.0"
 /begin AXIS_DESCR COM_AXIS ONLINE_DUMMY _CNV_A_R_LINEAR_____12_CM 6 0. 5. FORMAT "%2.0" AXIS_PTS_REF ldp_fmy_dtc /end AXIS_DESCR
/end CHARACTERISTIC
/begin CHARACTERISTIC C_ERR_CLAS_DCC_REV "" VALUE 0x4125c _REC_VAL_20_u1 255. _CNV_A_R_LINEAR_____10_CM 0. 255. FORMAT "%3.0" /end CHARACTERISTIC
/begin CHARACTERISTIC ID_ERR_DTC_CAN_BOFF "" CURVE 0x40c9a _REC_CUR_20_u2_u2 65535. _CNV_A_R_LINEAR_____10_CM 0. 65535. FORMAT "%5.0"
 /begin AXIS_DESCR COM_AXIS ONLINE_DUMMY _CNV_A_R_LINEAR_____12_CM 6 0. 5. FORMAT "%2.0" AXIS_PTS_REF ldp_fmy_dtc /end AXIS_DESCR
/end CHARACTERISTIC
/begin CHARACTERISTIC C_ERR_CLAS_CAN_BOFF "" VALUE 0x40caa _REC_VAL_20_u1 255. _CNV_A_R_LINEAR_____10_CM 0. 255. FORMAT "%3.0" /end CHARACTERISTIC
/begin CHARACTERISTIC ID_ERR_DTC_ISA_1 "" CURVE 0x40df0 _REC_CUR_20_u2_u2 65535. _CNV_A_R_LINEAR_____10_CM 0. 65535. FORMAT "%5.0"
 /begin AXIS_DESCR COM_AXIS ONLINE_DUMMY _CNV_A_R_LINEAR_____12_CM 6 0. 5. FORMAT "%2.0" AXIS_PTS_REF ldp_fmy_dtc /end AXIS_DESCR
/end CHARACTERISTIC
/begin CHARACTERISTIC C_ERR_CLAS_ISA_1 "" VALUE 0x40e00 _REC_VAL_20_u1 255. _CNV_A_R_LINEAR_____10_CM 0. 255. FORMAT "%3.0" /end CHARACTERISTIC
/begin CHARACTERISTIC ID_ERR_DTC_ISA_2 "" CURVE 0x40e02 _REC_CUR_20_u2_u2 65535. _CNV_A_R_LINEAR_____10_CM 0. 65535. FORMAT "%5.0"
 /begin AXIS_DESCR COM_AXIS ONLINE_DUMMY _CNV_A_R_LINEAR_____12_CM 6 0. 5. FORMAT "%2.0" AXIS_PTS_REF ldp_fmy_dtc /end AXIS_DESCR
/end CHARACTERISTIC
/begin CHARACTERISTIC C_ERR_CLAS_ISA_2 "" VALUE 0x40e12 _REC_VAL_20_u1 255. _CNV_A_R_LINEAR_____10_CM 0. 255. FORMAT "%3.0" /end CHARACTERISTIC
/begin CHARACTERISTIC ID_ERR_DTC_TCO_STUCK "" CURVE 0x40d2a _REC_CUR_20_u2_u2 65535. _CNV_A_R_LINEAR_____10_CM 0. 65535. FORMAT "%5.0"
 /begin AXIS_DESCR COM_AXIS ONLINE_DUMMY _CNV_A_R_LINEAR_____12_CM 6 0. 5. FORMAT "%2.0" AXIS_PTS_REF ldp_fmy_dtc /end AXIS_DESCR
/end CHARACTERISTIC
/begin CHARACTERISTIC C_ERR_CLAS_TCO_STUCK "" VALUE 0x40d3a _REC_VAL_20_u1 255. _CNV_A_R_LINEAR_____10_CM 0. 255. FORMAT "%3.0" /end CHARACTERISTIC
/begin CHARACTERISTIC ID_ERR_DTC_BN_T_ICL "" CURVE 0x41348 _REC_CUR_20_u2_u2 65535. _CNV_A_R_LINEAR_____10_CM 0. 65535. FORMAT "%5.0"
 /begin AXIS_DESCR COM_AXIS ONLINE_DUMMY _CNV_A_R_LINEAR_____12_CM 6 0. 5. FORMAT "%2.0" AXIS_PTS_REF ldp_fmy_dtc /end AXIS_DESCR
/end CHARACTERISTIC
/begin CHARACTERISTIC C_ERR_CLAS_BN_T_ICL "" VALUE 0x41358 _REC_VAL_20_u1 255. _CNV_A_R_LINEAR_____10_CM 0. 255. FORMAT "%3.0" /end CHARACTERISTIC
/begin CHARACTERISTIC ID_ERR_DTC_PVS_RATIO "" CURVE 0x40aea _REC_CUR_20_u2_u2 65535. _CNV_A_R_LINEAR_____10_CM 0. 65535. FORMAT "%5.0"
 /begin AXIS_DESCR COM_AXIS ONLINE_DUMMY _CNV_A_R_LINEAR_____12_CM 6 0. 5. FORMAT "%2.0" AXIS_PTS_REF ldp_fmy_dtc /end AXIS_DESCR
/end CHARACTERISTIC
/begin CHARACTERISTIC C_ERR_CLAS_PVS_RATIO "" VALUE 0x40afa _REC_VAL_20_u1 255. _CNV_A_R_LINEAR_____10_CM 0. 255. FORMAT "%3.0" /end CHARACTERISTIC
/begin CHARACTERISTIC ID_ERR_DTC_BN_MSW "" CURVE 0x413b4 _REC_CUR_20_u2_u2 65535. _CNV_A_R_LINEAR_____10_CM 0. 65535. FORMAT "%5.0"
 /begin AXIS_DESCR COM_AXIS ONLINE_DUMMY _CNV_A_R_LINEAR_____12_CM 6 0. 5. FORMAT "%2.0" AXIS_PTS_REF ldp_fmy_dtc /end AXIS_DESCR
/end CHARACTERISTIC
/begin CHARACTERISTIC C_ERR_CLAS_BN_MSW "" VALUE 0x413c4 _REC_VAL_20_u1 255. _CNV_A_R_LINEAR_____10_CM 0. 255. FORMAT "%3.0" /end CHARACTERISTIC
/begin CHARACTERISTIC ID_ERR_DTC_EBOX_CFA "" CURVE 0x410e4 _REC_CUR_20_u2_u2 65535. _CNV_A_R_LINEAR_____10_CM 0. 65535. FORMAT "%5.0"
 /begin AXIS_DESCR COM_AXIS ONLINE_DUMMY _CNV_A_R_LINEAR_____12_CM 6 0. 5. FORMAT "%2.0" AXIS_PTS_REF ldp_fmy_dtc /end AXIS_DESCR
/end CHARACTERISTIC
/begin CHARACTERISTIC C_ERR_CLAS_EBOX_CFA "" VALUE 0x410f4 _REC_VAL_20_u1 255. _CNV_A_R_LINEAR_____10_CM 0. 255. FORMAT "%3.0" /end CHARACTERISTIC
/begin CHARACTERISTIC ID_ERR_DTC_TOUT_ICL_2 "" CURVE 0x408e0 _REC_CUR_20_u2_u2 65535. _CNV_A_R_LINEAR_____10_CM 0. 65535. FORMAT "%5.0"
 /begin AXIS_DESCR COM_AXIS ONLINE_DUMMY _CNV_A_R_LINEAR_____12_CM 6 0. 5. FORMAT "%2.0" AXIS_PTS_REF ldp_fmy_dtc /end AXIS_DESCR
/end CHARACTERISTIC
/begin CHARACTERISTIC C_ERR_CLAS_TOUT_ICL_2 "" VALUE 0x408f0 _REC_VAL_20_u1 255. _CNV_A_R_LINEAR_____10_CM 0. 255. FORMAT "%3.0" /end CHARACTERISTIC
/begin CHARACTERISTIC ID_ERR_DTC_TOUT_ICL_3 "" CURVE 0x408f2 _REC_CUR_20_u2_u2 65535. _CNV_A_R_LINEAR_____10_CM 0. 65535. FORMAT "%5.0"
 /begin AXIS_DESCR COM_AXIS ONLINE_DUMMY _CNV_A_R_LINEAR_____12_CM 6 0. 5. FORMAT "%2.0" AXIS_PTS_REF ldp_fmy_dtc /end AXIS_DESCR
/end CHARACTERISTIC
/begin CHARACTERISTIC C_ERR_CLAS_TOUT_ICL_3 "" VALUE 0x40902 _REC_VAL_20_u1 255. _CNV_A_R_LINEAR_____10_CM 0. 255. FORMAT "%3.0" /end CHARACTERISTIC
/begin CHARACTERISTIC ID_ERR_DTC_MTC_DR "" CURVE 0x40b0e _REC_CUR_20_u2_u2 65535. _CNV_A_R_LINEAR_____10_CM 0. 65535. FORMAT "%5.0"
 /begin AXIS_DESCR COM_AXIS ONLINE_DUMMY _CNV_A_R_LINEAR_____12_CM 6 0. 5. FORMAT "%2.0" AXIS_PTS_REF ldp_fmy_dtc /end AXIS_DESCR
/end CHARACTERISTIC
/begin CHARACTERISTIC C_ERR_CLAS_MTC_DR "" VALUE 0x40b1e _REC_VAL_20_u1 255. _CNV_A_R_LINEAR_____10_CM 0. 255. FORMAT "%3.0" /end CHARACTERISTIC
/begin CHARACTERISTIC ID_ERR_DTC_LS_DOWN_SWT_1 "" CURVE 0x41078 _REC_CUR_20_u2_u2 65535. _CNV_A_R_LINEAR_____10_CM 0. 65535. FORMAT "%5.0"
 /begin AXIS_DESCR COM_AXIS ONLINE_DUMMY _CNV_A_R_LINEAR_____12_CM 6 0. 5. FORMAT "%2.0" AXIS_PTS_REF ldp_fmy_dtc /end AXIS_DESCR
/end CHARACTERISTIC
/begin CHARACTERISTIC C_ERR_CLAS_LS_DOWN_SWT_1 "" VALUE 0x41088 _REC_VAL_20_u1 255. _CNV_A_R_LINEAR_____10_CM 0. 255. FORMAT "%3.0" /end CHARACTERISTIC
/begin CHARACTERISTIC ID_ERR_DTC_LS_DOWN_SWT_2 "" CURVE 0x4108a _REC_CUR_20_u2_u2 65535. _CNV_A_R_LINEAR_____10_CM 0. 65535. FORMAT "%5.0"
 /begin AXIS_DESCR COM_AXIS ONLINE_DUMMY _CNV_A_R_LINEAR_____12_CM 6 0. 5. FORMAT "%2.0" AXIS_PTS_REF ldp_fmy_dtc /end AXIS_DESCR
/end CHARACTERISTIC
/begin CHARACTERISTIC C_ERR_CLAS_LS_DOWN_SWT_2 "" VALUE 0x4109a _REC_VAL_20_u1 255. _CNV_A_R_LINEAR_____10_CM 0. 255. FORMAT "%3.0" /end CHARACTERISTIC
/begin CHARACTERISTIC ID_ERR_DTC_TPS_AD "" CURVE 0x40b56 _REC_CUR_20_u2_u2 65535. _CNV_A_R_LINEAR_____10_CM 0. 65535. FORMAT "%5.0"
 /begin AXIS_DESCR COM_AXIS ONLINE_DUMMY _CNV_A_R_LINEAR_____12_CM 6 0. 5. FORMAT "%2.0" AXIS_PTS_REF ldp_fmy_dtc /end AXIS_DESCR
/end CHARACTERISTIC
/begin CHARACTERISTIC C_ERR_CLAS_TPS_AD "" VALUE 0x40b66 _REC_VAL_20_u1 255. _CNV_A_R_LINEAR_____10_CM 0. 255. FORMAT "%3.0" /end CHARACTERISTIC
/begin CHARACTERISTIC ID_ERR_DTC_ECU_CKS "" CURVE 0x40898 _REC_CUR_20_u2_u2 65535. _CNV_A_R_LINEAR_____10_CM 0. 65535. FORMAT "%5.0"
 /begin AXIS_DESCR COM_AXIS ONLINE_DUMMY _CNV_A_R_LINEAR_____12_CM 6 0. 5. FORMAT "%2.0" AXIS_PTS_REF ldp_fmy_dtc /end AXIS_DESCR
/end CHARACTERISTIC
/begin CHARACTERISTIC C_ERR_CLAS_ECU_CKS "" VALUE 0x408a8 _REC_VAL_20_u1 255. _CNV_A_R_LINEAR_____10_CM 0. 255. FORMAT "%3.0" /end CHARACTERISTIC
/begin CHARACTERISTIC ID_ERR_DTC_BN_ICL "" CURVE 0x4137e _REC_CUR_20_u2_u2 65535. _CNV_A_R_LINEAR_____10_CM 0. 65535. FORMAT "%5.0"
 /begin AXIS_DESCR COM_AXIS ONLINE_DUMMY _CNV_A_R_LINEAR_____12_CM 6 0. 5. FORMAT "%2.0" AXIS_PTS_REF ldp_fmy_dtc /end AXIS_DESCR
/end CHARACTERISTIC
/begin CHARACTERISTIC C_ERR_CLAS_BN_ICL "" VALUE 0x4138e _REC_VAL_20_u1 255. _CNV_A_R_LINEAR_____10_CM 0. 255. FORMAT "%3.0" /end CHARACTERISTIC
/begin CHARACTERISTIC ID_ERR_DTC_VLS_DOWN_PUE_1 "" CURVE 0x4109c _REC_CUR_20_u2_u2 65535. _CNV_A_R_LINEAR_____10_CM 0. 65535. FORMAT "%5.0"
 /begin AXIS_DESCR COM_AXIS ONLINE_DUMMY _CNV_A_R_LINEAR_____12_CM 6 0. 5. FORMAT "%2.0" AXIS_PTS_REF ldp_fmy_dtc /end AXIS_DESCR
/end CHARACTERISTIC
/begin CHARACTERISTIC C_ERR_CLAS_VLS_DOWN_PUE_1 "" VALUE 0x410ac _REC_VAL_20_u1 255. _CNV_A_R_LINEAR_____10_CM 0. 255. FORMAT "%3.0" /end CHARACTERISTIC
/begin CHARACTERISTIC ID_ERR_DTC_VLS_DOWN_PUE_2 "" CURVE 0x410ae _REC_CUR_20_u2_u2 65535. _CNV_A_R_LINEAR_____10_CM 0. 65535. FORMAT "%5.0"
 /begin AXIS_DESCR COM_AXIS ONLINE_DUMMY _CNV_A_R_LINEAR_____12_CM 6 0. 5. FORMAT "%2.0" AXIS_PTS_REF ldp_fmy_dtc /end AXIS_DESCR
/end CHARACTERISTIC
/begin CHARACTERISTIC C_ERR_CLAS_VLS_DOWN_PUE_2 "" VALUE 0x410be _REC_VAL_20_u1 255. _CNV_A_R_LINEAR_____10_CM 0. 255. FORMAT "%3.0" /end CHARACTERISTIC
/begin CHARACTERISTIC ID_ERR_DTC_DCC_IRREV "" CURVE 0x4125e _REC_CUR_20_u2_u2 65535. _CNV_A_R_LINEAR_____10_CM 0. 65535. FORMAT "%5.0"
 /begin AXIS_DESCR COM_AXIS ONLINE_DUMMY _CNV_A_R_LINEAR_____12_CM 6 0. 5. FORMAT "%2.0" AXIS_PTS_REF ldp_fmy_dtc /end AXIS_DESCR
/end CHARACTERISTIC
/begin CHARACTERISTIC C_ERR_CLAS_DCC_IRREV "" VALUE 0x4126e _REC_VAL_20_u1 255. _CNV_A_R_LINEAR_____10_CM 0. 255. FORMAT "%3.0" /end CHARACTERISTIC
/begin CHARACTERISTIC ID_ERR_DTC_DUR_IGC_0 "" CURVE 0x409ee _REC_CUR_20_u2_u2 65535. _CNV_A_R_LINEAR_____10_CM 0. 65535. FORMAT "%5.0"
 /begin AXIS_DESCR COM_AXIS ONLINE_DUMMY _CNV_A_R_LINEAR_____12_CM 6 0. 5. FORMAT "%2.0" AXIS_PTS_REF ldp_fmy_dtc /end AXIS_DESCR
/end CHARACTERISTIC
/begin CHARACTERISTIC C_ERR_CLAS_DUR_IGC_0 "" VALUE 0x409fe _REC_VAL_20_u1 255. _CNV_A_R_LINEAR_____10_CM 0. 255. FORMAT "%3.0" /end CHARACTERISTIC
/begin CHARACTERISTIC ID_ERR_DTC_DUR_IGC_1 "" CURVE 0x40a00 _REC_CUR_20_u2_u2 65535. _CNV_A_R_LINEAR_____10_CM 0. 65535. FORMAT "%5.0"
 /begin AXIS_DESCR COM_AXIS ONLINE_DUMMY _CNV_A_R_LINEAR_____12_CM 6 0. 5. FORMAT "%2.0" AXIS_PTS_REF ldp_fmy_dtc /end AXIS_DESCR
/end CHARACTERISTIC
/begin CHARACTERISTIC C_ERR_CLAS_DUR_IGC_1 "" VALUE 0x40a10 _REC_VAL_20_u1 255. _CNV_A_R_LINEAR_____10_CM 0. 255. FORMAT "%3.0" /end CHARACTERISTIC
/begin CHARACTERISTIC ID_ERR_DTC_DUR_IGC_2 "" CURVE 0x40a12 _REC_CUR_20_u2_u2 65535. _CNV_A_R_LINEAR_____10_CM 0. 65535. FORMAT "%5.0"
 /begin AXIS_DESCR COM_AXIS ONLINE_DUMMY _CNV_A_R_LINEAR_____12_CM 6 0. 5. FORMAT "%2.0" AXIS_PTS_REF ldp_fmy_dtc /end AXIS_DESCR
/end CHARACTERISTIC
/begin CHARACTERISTIC C_ERR_CLAS_DUR_IGC_2 "" VALUE 0x40a22 _REC_VAL_20_u1 255. _CNV_A_R_LINEAR_____10_CM 0. 255. FORMAT "%3.0" /end CHARACTERISTIC
/begin CHARACTERISTIC ID_ERR_DTC_DUR_IGC_3 "" CURVE 0x40a24 _REC_CUR_20_u2_u2 65535. _CNV_A_R_LINEAR_____10_CM 0. 65535. FORMAT "%5.0"
 /begin AXIS_DESCR COM_AXIS ONLINE_DUMMY _CNV_A_R_LINEAR_____12_CM 6 0. 5. FORMAT "%2.0" AXIS_PTS_REF ldp_fmy_dtc /end AXIS_DESCR
/end CHARACTERISTIC
/begin CHARACTERISTIC C_ERR_CLAS_DUR_IGC_3 "" VALUE 0x40a34 _REC_VAL_20_u1 255. _CNV_A_R_LINEAR_____10_CM 0. 255. FORMAT "%3.0" /end CHARACTERISTIC
/begin CHARACTERISTIC ID_ERR_DTC_DUR_IGC_4 "" CURVE 0x40a36 _REC_CUR_20_u2_u2 65535. _CNV_A_R_LINEAR_____10_CM 0. 65535. FORMAT "%5.0"
 /begin AXIS_DESCR COM_AXIS ONLINE_DUMMY _CNV_A_R_LINEAR_____12_CM 6 0. 5. FORMAT "%2.0" AXIS_PTS_REF ldp_fmy_dtc /end AXIS_DESCR
/end CHARACTERISTIC
/begin CHARACTERISTIC C_ERR_CLAS_DUR_IGC_4 "" VALUE 0x40a46 _REC_VAL_20_u1 255. _CNV_A_R_LINEAR_____10_CM 0. 255. FORMAT "%3.0" /end CHARACTERISTIC
/begin CHARACTERISTIC ID_ERR_DTC_DUR_IGC_5 "" CURVE 0x40a48 _REC_CUR_20_u2_u2 65535. _CNV_A_R_LINEAR_____10_CM 0. 65535. FORMAT "%5.0"
 /begin AXIS_DESCR COM_AXIS ONLINE_DUMMY _CNV_A_R_LINEAR_____12_CM 6 0. 5. FORMAT "%2.0" AXIS_PTS_REF ldp_fmy_dtc /end AXIS_DESCR
/end CHARACTERISTIC
/begin CHARACTERISTIC C_ERR_CLAS_DUR_IGC_5 "" VALUE 0x40a58 _REC_VAL_20_u1 255. _CNV_A_R_LINEAR_____10_CM 0. 255. FORMAT "%3.0" /end CHARACTERISTIC
/begin CHARACTERISTIC ID_ERR_DTC_PVS_MON_1 "" CURVE 0x40ec8 _REC_CUR_20_u2_u2 65535. _CNV_A_R_LINEAR_____10_CM 0. 65535. FORMAT "%5.0"
 /begin AXIS_DESCR COM_AXIS ONLINE_DUMMY _CNV_A_R_LINEAR_____12_CM 6 0. 5. FORMAT "%2.0" AXIS_PTS_REF ldp_fmy_dtc /end AXIS_DESCR
/end CHARACTERISTIC
/begin CHARACTERISTIC C_ERR_CLAS_PVS_MON_1 "" VALUE 0x40ed8 _REC_VAL_20_u1 255. _CNV_A_R_LINEAR_____10_CM 0. 255. FORMAT "%3.0" /end CHARACTERISTIC
/begin CHARACTERISTIC ID_ERR_DTC_LOAD_PLAUS "" CURVE 0x413fc _REC_CUR_20_u2_u2 65535. _CNV_A_R_LINEAR_____10_CM 0. 65535. FORMAT "%5.0"
 /begin AXIS_DESCR COM_AXIS ONLINE_DUMMY _CNV_A_R_LINEAR_____12_CM 6 0. 5. FORMAT "%2.0" AXIS_PTS_REF ldp_fmy_dtc /end AXIS_DESCR
/end CHARACTERISTIC
/begin CHARACTERISTIC C_ERR_CLAS_LOAD_PLAUS "" VALUE 0x4140c _REC_VAL_20_u1 255. _CNV_A_R_LINEAR_____10_CM 0. 255. FORMAT "%3.0" /end CHARACTERISTIC
/begin CHARACTERISTIC ID_ERR_DTC_VLS_UP_MAX_1 "" CURVE 0x4151c _REC_CUR_20_u2_u2 65535. _CNV_A_R_LINEAR_____10_CM 0. 65535. FORMAT "%5.0"
 /begin AXIS_DESCR COM_AXIS ONLINE_DUMMY _CNV_A_R_LINEAR_____12_CM 6 0. 5. FORMAT "%2.0" AXIS_PTS_REF ldp_fmy_dtc /end AXIS_DESCR
/end CHARACTERISTIC
/begin CHARACTERISTIC C_ERR_CLAS_VLS_UP_MAX_1 "" VALUE 0x4152c _REC_VAL_20_u1 255. _CNV_A_R_LINEAR_____10_CM 0. 255. FORMAT "%3.0" /end CHARACTERISTIC
/begin CHARACTERISTIC ID_ERR_DTC_VLS_UP_MAX_2 "" CURVE 0x4152e _REC_CUR_20_u2_u2 65535. _CNV_A_R_LINEAR_____10_CM 0. 65535. FORMAT "%5.0"
 /begin AXIS_DESCR COM_AXIS ONLINE_DUMMY _CNV_A_R_LINEAR_____12_CM 6 0. 5. FORMAT "%2.0" AXIS_PTS_REF ldp_fmy_dtc /end AXIS_DESCR
/end CHARACTERISTIC
/begin CHARACTERISTIC C_ERR_CLAS_VLS_UP_MAX_2 "" VALUE 0x4153e _REC_VAL_20_u1 255. _CNV_A_R_LINEAR_____10_CM 0. 255. FORMAT "%3.0" /end CHARACTERISTIC
/begin CHARACTERISTIC ID_ERR_DTC_N_32_MON_1 "" CURVE 0x40eb6 _REC_CUR_20_u2_u2 65535. _CNV_A_R_LINEAR_____10_CM 0. 65535. FORMAT "%5.0"
 /begin AXIS_DESCR COM_AXIS ONLINE_DUMMY _CNV_A_R_LINEAR_____12_CM 6 0. 5. FORMAT "%2.0" AXIS_PTS_REF ldp_fmy_dtc /end AXIS_DESCR
/end CHARACTERISTIC
/begin CHARACTERISTIC C_ERR_CLAS_N_32_MON_1 "" VALUE 0x40ec6 _REC_VAL_20_u1 255. _CNV_A_R_LINEAR_____10_CM 0. 255. FORMAT "%3.0" /end CHARACTERISTIC
/begin CHARACTERISTIC ID_ERR_DTC_ECT_EL "" CURVE 0x40d4e _REC_CUR_20_u2_u2 65535. _CNV_A_R_LINEAR_____10_CM 0. 65535. FORMAT "%5.0"
 /begin AXIS_DESCR COM_AXIS ONLINE_DUMMY _CNV_A_R_LINEAR_____12_CM 6 0. 5. FORMAT "%2.0" AXIS_PTS_REF ldp_fmy_dtc /end AXIS_DESCR
/end CHARACTERISTIC
/begin CHARACTERISTIC C_ERR_CLAS_ECT_EL "" VALUE 0x40d5e _REC_VAL_20_u1 255. _CNV_A_R_LINEAR_____10_CM 0. 255. FORMAT "%3.0" /end CHARACTERISTIC
/begin CHARACTERISTIC ID_ERR_DTC_VLS_DOWN_MAX_1 "" CURVE 0x40634 _REC_CUR_20_u2_u2 65535. _CNV_A_R_LINEAR_____10_CM 0. 65535. FORMAT "%5.0"
 /begin AXIS_DESCR COM_AXIS ONLINE_DUMMY _CNV_A_R_LINEAR_____12_CM 6 0. 5. FORMAT "%2.0" AXIS_PTS_REF ldp_fmy_dtc /end AXIS_DESCR
/end CHARACTERISTIC
/begin CHARACTERISTIC C_ERR_CLAS_VLS_DOWN_MAX_1 "" VALUE 0x40644 _REC_VAL_20_u1 255. _CNV_A_R_LINEAR_____10_CM 0. 255. FORMAT "%3.0" /end CHARACTERISTIC
/begin CHARACTERISTIC ID_ERR_DTC_VLS_DOWN_MAX_2 "" CURVE 0x40646 _REC_CUR_20_u2_u2 65535. _CNV_A_R_LINEAR_____10_CM 0. 65535. FORMAT "%5.0"
 /begin AXIS_DESCR COM_AXIS ONLINE_DUMMY _CNV_A_R_LINEAR_____12_CM 6 0. 5. FORMAT "%2.0" AXIS_PTS_REF ldp_fmy_dtc /end AXIS_DESCR
/end CHARACTERISTIC
/begin CHARACTERISTIC C_ERR_CLAS_VLS_DOWN_MAX_2 "" VALUE 0x40656 _REC_VAL_20_u1 255. _CNV_A_R_LINEAR_____10_CM 0. 255. FORMAT "%3.0" /end CHARACTERISTIC
/begin CHARACTERISTIC ID_ERR_DTC_CRU_INH_MON_1 "" CURVE 0x40f7c _REC_CUR_20_u2_u2 65535. _CNV_A_R_LINEAR_____10_CM 0. 65535. FORMAT "%5.0"
 /begin AXIS_DESCR COM_AXIS ONLINE_DUMMY _CNV_A_R_LINEAR_____12_CM 6 0. 5. FORMAT "%2.0" AXIS_PTS_REF ldp_fmy_dtc /end AXIS_DESCR
/end CHARACTERISTIC
/begin CHARACTERISTIC C_ERR_CLAS_CRU_INH_MON_1 "" VALUE 0x40f8c _REC_VAL_20_u1 255. _CNV_A_R_LINEAR_____10_CM 0. 255. FORMAT "%3.0" /end CHARACTERISTIC
/begin CHARACTERISTIC ID_ERR_DTC_TOUT_ASR_1 "" CURVE 0x40904 _REC_CUR_20_u2_u2 65535. _CNV_A_R_LINEAR_____10_CM 0. 65535. FORMAT "%5.0"
 /begin AXIS_DESCR COM_AXIS ONLINE_DUMMY _CNV_A_R_LINEAR_____12_CM 6 0. 5. FORMAT "%2.0" AXIS_PTS_REF ldp_fmy_dtc /end AXIS_DESCR
/end CHARACTERISTIC
/begin CHARACTERISTIC C_ERR_CLAS_TOUT_ASR_1 "" VALUE 0x40914 _REC_VAL_20_u1 255. _CNV_A_R_LINEAR_____10_CM 0. 255. FORMAT "%3.0" /end CHARACTERISTIC
/begin CHARACTERISTIC ID_ERR_DTC_LSH_DOWN_1 "" CURVE 0x40778 _REC_CUR_20_u2_u2 65535. _CNV_A_R_LINEAR_____10_CM 0. 65535. FORMAT "%5.0"
 /begin AXIS_DESCR COM_AXIS ONLINE_DUMMY _CNV_A_R_LINEAR_____12_CM 6 0. 5. FORMAT "%2.0" AXIS_PTS_REF ldp_fmy_dtc /end AXIS_DESCR
/end CHARACTERISTIC
/begin CHARACTERISTIC C_ERR_CLAS_LSH_DOWN_1 "" VALUE 0x40788 _REC_VAL_20_u1 255. _CNV_A_R_LINEAR_____10_CM 0. 255. FORMAT "%3.0" /end CHARACTERISTIC
/begin CHARACTERISTIC ID_ERR_DTC_LSH_DOWN_2 "" CURVE 0x4078a _REC_CUR_20_u2_u2 65535. _CNV_A_R_LINEAR_____10_CM 0. 65535. FORMAT "%5.0"
 /begin AXIS_DESCR COM_AXIS ONLINE_DUMMY _CNV_A_R_LINEAR_____12_CM 6 0. 5. FORMAT "%2.0" AXIS_PTS_REF ldp_fmy_dtc /end AXIS_DESCR
/end CHARACTERISTIC
/begin CHARACTERISTIC C_ERR_CLAS_LSH_DOWN_2 "" VALUE 0x4079a _REC_VAL_20_u1 255. _CNV_A_R_LINEAR_____10_CM 0. 255. FORMAT "%3.0" /end CHARACTERISTIC
/begin CHARACTERISTIC ID_ERR_DTC_TOUT_ASR_3 "" CURVE 0x40916 _REC_CUR_20_u2_u2 65535. _CNV_A_R_LINEAR_____10_CM 0. 65535. FORMAT "%5.0"
 /begin AXIS_DESCR COM_AXIS ONLINE_DUMMY _CNV_A_R_LINEAR_____12_CM 6 0. 5. FORMAT "%2.0" AXIS_PTS_REF ldp_fmy_dtc /end AXIS_DESCR
/end CHARACTERISTIC
/begin CHARACTERISTIC C_ERR_CLAS_TOUT_ASR_3 "" VALUE 0x40926 _REC_VAL_20_u1 255. _CNV_A_R_LINEAR_____10_CM 0. 255. FORMAT "%3.0" /end CHARACTERISTIC
/begin CHARACTERISTIC ID_ERR_DTC_TCO_PLAUS "" CURVE 0x40d72 _REC_CUR_20_u2_u2 65535. _CNV_A_R_LINEAR_____10_CM 0. 65535. FORMAT "%5.0"
 /begin AXIS_DESCR COM_AXIS ONLINE_DUMMY _CNV_A_R_LINEAR_____12_CM 6 0. 5. FORMAT "%2.0" AXIS_PTS_REF ldp_fmy_dtc /end AXIS_DESCR
/end CHARACTERISTIC
/begin CHARACTERISTIC C_ERR_CLAS_TCO_PLAUS "" VALUE 0x40d82 _REC_VAL_20_u1 255. _CNV_A_R_LINEAR_____10_CM 0. 255. FORMAT "%3.0" /end CHARACTERISTIC
/begin CHARACTERISTIC ID_ERR_DTC_BN_TCS "" CURVE 0x412ee _REC_CUR_20_u2_u2 65535. _CNV_A_R_LINEAR_____10_CM 0. 65535. FORMAT "%5.0"
 /begin AXIS_DESCR COM_AXIS ONLINE_DUMMY _CNV_A_R_LINEAR_____12_CM 6 0. 5. FORMAT "%2.0" AXIS_PTS_REF ldp_fmy_dtc /end AXIS_DESCR
/end CHARACTERISTIC
/begin CHARACTERISTIC C_ERR_CLAS_BN_TCS "" VALUE 0x412fe _REC_VAL_20_u1 255. _CNV_A_R_LINEAR_____10_CM 0. 255. FORMAT "%3.0" /end CHARACTERISTIC
/begin CHARACTERISTIC ID_ERR_DTC_TQ_DIF_P_D_IS_MON_1 "" CURVE 0x40f22 _REC_CUR_20_u2_u2 65535. _CNV_A_R_LINEAR_____10_CM 0. 65535. FORMAT "%5.0"
 /begin AXIS_DESCR COM_AXIS ONLINE_DUMMY _CNV_A_R_LINEAR_____12_CM 6 0. 5. FORMAT "%2.0" AXIS_PTS_REF ldp_fmy_dtc /end AXIS_DESCR
/end CHARACTERISTIC
/begin CHARACTERISTIC C_ERR_CLAS_TQ_DIF_P_D_IS_MON_1 "" VALUE 0x40f32 _REC_VAL_20_u1 255. _CNV_A_R_LINEAR_____10_CM 0. 255. FORMAT "%3.0" /end CHARACTERISTIC
/begin CHARACTERISTIC ID_ERR_DTC_ECU_RAM "" CURVE 0x410f6 _REC_CUR_20_u2_u2 65535. _CNV_A_R_LINEAR_____10_CM 0. 65535. FORMAT "%5.0"
 /begin AXIS_DESCR COM_AXIS ONLINE_DUMMY _CNV_A_R_LINEAR_____12_CM 6 0. 5. FORMAT "%2.0" AXIS_PTS_REF ldp_fmy_dtc /end AXIS_DESCR
/end CHARACTERISTIC
/begin CHARACTERISTIC C_ERR_CLAS_ECU_RAM "" VALUE 0x41106 _REC_VAL_20_u1 255. _CNV_A_R_LINEAR_____10_CM 0. 255. FORMAT "%3.0" /end CHARACTERISTIC
/begin CHARACTERISTIC ID_ERR_DTC_TIA "" CURVE 0x405fe _REC_CUR_20_u2_u2 65535. _CNV_A_R_LINEAR_____10_CM 0. 65535. FORMAT "%5.0"
 /begin AXIS_DESCR COM_AXIS ONLINE_DUMMY _CNV_A_R_LINEAR_____12_CM 6 0. 5. FORMAT "%2.0" AXIS_PTS_REF ldp_fmy_dtc /end AXIS_DESCR
/end CHARACTERISTIC
/begin CHARACTERISTIC C_ERR_CLAS_TIA "" VALUE 0x4060e _REC_VAL_20_u1 255. _CNV_A_R_LINEAR_____10_CM 0. 255. FORMAT "%3.0" /end CHARACTERISTIC
/begin CHARACTERISTIC ID_ERR_DTC_CRASH_EFP "" CURVE 0x4140e _REC_CUR_20_u2_u2 65535. _CNV_A_R_LINEAR_____10_CM 0. 65535. FORMAT "%5.0"
 /begin AXIS_DESCR COM_AXIS ONLINE_DUMMY _CNV_A_R_LINEAR_____12_CM 6 0. 5. FORMAT "%2.0" AXIS_PTS_REF ldp_fmy_dtc /end AXIS_DESCR
/end CHARACTERISTIC
/begin CHARACTERISTIC C_ERR_CLAS_CRASH_EFP "" VALUE 0x4141e _REC_VAL_20_u1 255. _CNV_A_R_LINEAR_____10_CM 0. 255. FORMAT "%3.0" /end CHARACTERISTIC
/begin CHARACTERISTIC ID_ERR_DTC_TPU_SYN "" CURVE 0x40c64 _REC_CUR_20_u2_u2 65535. _CNV_A_R_LINEAR_____10_CM 0. 65535. FORMAT "%5.0"
 /begin AXIS_DESCR COM_AXIS ONLINE_DUMMY _CNV_A_R_LINEAR_____12_CM 6 0. 5. FORMAT "%2.0" AXIS_PTS_REF ldp_fmy_dtc /end AXIS_DESCR
/end CHARACTERISTIC
/begin CHARACTERISTIC C_ERR_CLAS_TPU_SYN "" VALUE 0x40c74 _REC_VAL_20_u1 255. _CNV_A_R_LINEAR_____10_CM 0. 255. FORMAT "%3.0" /end CHARACTERISTIC
/begin CHARACTERISTIC ID_ERR_DTC_TOUT_AMT_1 "" CURVE 0x4093a _REC_CUR_20_u2_u2 65535. _CNV_A_R_LINEAR_____10_CM 0. 65535. FORMAT "%5.0"
 /begin AXIS_DESCR COM_AXIS ONLINE_DUMMY _CNV_A_R_LINEAR_____12_CM 6 0. 5. FORMAT "%2.0" AXIS_PTS_REF ldp_fmy_dtc /end AXIS_DESCR
/end CHARACTERISTIC
/begin CHARACTERISTIC C_ERR_CLAS_TOUT_AMT_1 "" VALUE 0x4094a _REC_VAL_20_u1 255. _CNV_A_R_LINEAR_____10_CM 0. 255. FORMAT "%3.0" /end CHARACTERISTIC
/begin CHARACTERISTIC ID_ERR_DTC_TECU "" CURVE 0x410d2 _REC_CUR_20_u2_u2 65535. _CNV_A_R_LINEAR_____10_CM 0. 65535. FORMAT "%5.0"
 /begin AXIS_DESCR COM_AXIS ONLINE_DUMMY _CNV_A_R_LINEAR_____12_CM 6 0. 5. FORMAT "%2.0" AXIS_PTS_REF ldp_fmy_dtc /end AXIS_DESCR
/end CHARACTERISTIC
/begin CHARACTERISTIC C_ERR_CLAS_TECU "" VALUE 0x410e2 _REC_VAL_20_u1 255. _CNV_A_R_LINEAR_____10_CM 0. 255. FORMAT "%3.0" /end CHARACTERISTIC
/begin CHARACTERISTIC ID_ERR_DTC_TQI_N_MAX_MON_1 "" CURVE 0x40f58 _REC_CUR_20_u2_u2 65535. _CNV_A_R_LINEAR_____10_CM 0. 65535. FORMAT "%5.0"
 /begin AXIS_DESCR COM_AXIS ONLINE_DUMMY _CNV_A_R_LINEAR_____12_CM 6 0. 5. FORMAT "%2.0" AXIS_PTS_REF ldp_fmy_dtc /end AXIS_DESCR
/end CHARACTERISTIC
/begin CHARACTERISTIC C_ERR_CLAS_TQI_N_MAX_MON_1 "" VALUE 0x40f68 _REC_VAL_20_u1 255. _CNV_A_R_LINEAR_____10_CM 0. 255. FORMAT "%3.0" /end CHARACTERISTIC
/begin CHARACTERISTIC ID_ERR_DTC_MAF "" CURVE 0x40622 _REC_CUR_20_u2_u2 65535. _CNV_A_R_LINEAR_____10_CM 0. 65535. FORMAT "%5.0"
 /begin AXIS_DESCR COM_AXIS ONLINE_DUMMY _CNV_A_R_LINEAR_____12_CM 6 0. 5. FORMAT "%2.0" AXIS_PTS_REF ldp_fmy_dtc /end AXIS_DESCR
/end CHARACTERISTIC
/begin CHARACTERISTIC C_ERR_CLAS_MAF "" VALUE 0x40632 _REC_VAL_20_u1 255. _CNV_A_R_LINEAR_____10_CM 0. 255. FORMAT "%3.0" /end CHARACTERISTIC
/begin CHARACTERISTIC ID_ERR_DTC_RLY_EFP "" CURVE 0x4079c _REC_CUR_20_u2_u2 65535. _CNV_A_R_LINEAR_____10_CM 0. 65535. FORMAT "%5.0"
 /begin AXIS_DESCR COM_AXIS ONLINE_DUMMY _CNV_A_R_LINEAR_____12_CM 6 0. 5. FORMAT "%2.0" AXIS_PTS_REF ldp_fmy_dtc /end AXIS_DESCR
/end CHARACTERISTIC
/begin CHARACTERISTIC C_ERR_CLAS_RLY_EFP "" VALUE 0x407ac _REC_VAL_20_u1 255. _CNV_A_R_LINEAR_____10_CM 0. 255. FORMAT "%3.0" /end CHARACTERISTIC
/begin CHARACTERISTIC ID_ERR_DTC_BN_KM_ICL "" CURVE 0x4136c _REC_CUR_20_u2_u2 65535. _CNV_A_R_LINEAR_____10_CM 0. 65535. FORMAT "%5.0"
 /begin AXIS_DESCR COM_AXIS ONLINE_DUMMY _CNV_A_R_LINEAR_____12_CM 6 0. 5. FORMAT "%2.0" AXIS_PTS_REF ldp_fmy_dtc /end AXIS_DESCR
/end CHARACTERISTIC
/begin CHARACTERISTIC C_ERR_CLAS_BN_KM_ICL "" VALUE 0x4137c _REC_VAL_20_u1 255. _CNV_A_R_LINEAR_____10_CM 0. 255. FORMAT "%3.0" /end CHARACTERISTIC
/begin CHARACTERISTIC ID_ERR_DTC_MEC_IVVT_IN_1 "" CURVE 0x407c0 _REC_CUR_20_u2_u2 65535. _CNV_A_R_LINEAR_____10_CM 0. 65535. FORMAT "%5.0"
 /begin AXIS_DESCR COM_AXIS ONLINE_DUMMY _CNV_A_R_LINEAR_____12_CM 6 0. 5. FORMAT "%2.0" AXIS_PTS_REF ldp_fmy_dtc /end AXIS_DESCR
/end CHARACTERISTIC
/begin CHARACTERISTIC C_ERR_CLAS_MEC_IVVT_IN_1 "" VALUE 0x407d0 _REC_VAL_20_u1 255. _CNV_A_R_LINEAR_____10_CM 0. 255. FORMAT "%3.0" /end CHARACTERISTIC
/begin CHARACTERISTIC ID_ERR_DTC_MEC_IVVT_IN_2 "" CURVE 0x407d2 _REC_CUR_20_u2_u2 65535. _CNV_A_R_LINEAR_____10_CM 0. 65535. FORMAT "%5.0"
 /begin AXIS_DESCR COM_AXIS ONLINE_DUMMY _CNV_A_R_LINEAR_____12_CM 6 0. 5. FORMAT "%2.0" AXIS_PTS_REF ldp_fmy_dtc /end AXIS_DESCR
/end CHARACTERISTIC
/begin CHARACTERISTIC C_ERR_CLAS_MEC_IVVT_IN_2 "" VALUE 0x407e2 _REC_VAL_20_u1 255. _CNV_A_R_LINEAR_____10_CM 0. 255. FORMAT "%3.0" /end CHARACTERISTIC
/begin CHARACTERISTIC ID_ERR_DTC_CRK_NOT_PLAUS "" CURVE 0x40c76 _REC_CUR_20_u2_u2 65535. _CNV_A_R_LINEAR_____10_CM 0. 65535. FORMAT "%5.0"
 /begin AXIS_DESCR COM_AXIS ONLINE_DUMMY _CNV_A_R_LINEAR_____12_CM 6 0. 5. FORMAT "%2.0" AXIS_PTS_REF ldp_fmy_dtc /end AXIS_DESCR
/end CHARACTERISTIC
/begin CHARACTERISTIC C_ERR_CLAS_CRK_NOT_PLAUS "" VALUE 0x40c86 _REC_VAL_20_u1 255. _CNV_A_R_LINEAR_____10_CM 0. 255. FORMAT "%3.0" /end CHARACTERISTIC
/begin CHARACTERISTIC ID_ERR_DTC_TPS_PLAUS "" CURVE 0x413ea _REC_CUR_20_u2_u2 65535. _CNV_A_R_LINEAR_____10_CM 0. 65535. FORMAT "%5.0"
 /begin AXIS_DESCR COM_AXIS ONLINE_DUMMY _CNV_A_R_LINEAR_____12_CM 6 0. 5. FORMAT "%2.0" AXIS_PTS_REF ldp_fmy_dtc /end AXIS_DESCR
/end CHARACTERISTIC
/begin CHARACTERISTIC C_ERR_CLAS_TPS_PLAUS "" VALUE 0x413fa _REC_VAL_20_u1 255. _CNV_A_R_LINEAR_____10_CM 0. 255. FORMAT "%3.0" /end CHARACTERISTIC
/begin CHARACTERISTIC ID_ERR_DTC_TOUT_ETCU_1 "" CURVE 0x408bc _REC_CUR_20_u2_u2 65535. _CNV_A_R_LINEAR_____10_CM 0. 65535. FORMAT "%5.0"
 /begin AXIS_DESCR COM_AXIS ONLINE_DUMMY _CNV_A_R_LINEAR_____12_CM 6 0. 5. FORMAT "%2.0" AXIS_PTS_REF ldp_fmy_dtc /end AXIS_DESCR
/end CHARACTERISTIC
/begin CHARACTERISTIC C_ERR_CLAS_TOUT_ETCU_1 "" VALUE 0x408cc _REC_VAL_20_u1 255. _CNV_A_R_LINEAR_____10_CM 0. 255. FORMAT "%3.0" /end CHARACTERISTIC
/begin CHARACTERISTIC ID_ERR_DTC_TOUT_ETCU_2 "" CURVE 0x408ce _REC_CUR_20_u2_u2 65535. _CNV_A_R_LINEAR_____10_CM 0. 65535. FORMAT "%5.0"
 /begin AXIS_DESCR COM_AXIS ONLINE_DUMMY _CNV_A_R_LINEAR_____12_CM 6 0. 5. FORMAT "%2.0" AXIS_PTS_REF ldp_fmy_dtc /end AXIS_DESCR
/end CHARACTERISTIC
/begin CHARACTERISTIC C_ERR_CLAS_TOUT_ETCU_2 "" VALUE 0x408de _REC_VAL_20_u1 255. _CNV_A_R_LINEAR_____10_CM 0. 255. FORMAT "%3.0" /end CHARACTERISTIC
/begin CHARACTERISTIC ID_ERR_DTC_FSD_1 "" CURVE 0x41030 _REC_CUR_20_u2_u2 65535. _CNV_A_R_LINEAR_____10_CM 0. 65535. FORMAT "%5.0"
 /begin AXIS_DESCR COM_AXIS ONLINE_DUMMY _CNV_A_R_LINEAR_____12_CM 6 0. 5. FORMAT "%2.0" AXIS_PTS_REF ldp_fmy_dtc /end AXIS_DESCR
/end CHARACTERISTIC
/begin CHARACTERISTIC C_ERR_CLAS_FSD_1 "" VALUE 0x41040 _REC_VAL_20_u1 255. _CNV_A_R_LINEAR_____10_CM 0. 255. FORMAT "%3.0" /end CHARACTERISTIC
/begin CHARACTERISTIC ID_ERR_DTC_FSD_2 "" CURVE 0x41042 _REC_CUR_20_u2_u2 65535. _CNV_A_R_LINEAR_____10_CM 0. 65535. FORMAT "%5.0"
 /begin AXIS_DESCR COM_AXIS ONLINE_DUMMY _CNV_A_R_LINEAR_____12_CM 6 0. 5. FORMAT "%2.0" AXIS_PTS_REF ldp_fmy_dtc /end AXIS_DESCR
/end CHARACTERISTIC
/begin CHARACTERISTIC C_ERR_CLAS_FSD_2 "" VALUE 0x41052 _REC_VAL_20_u1 255. _CNV_A_R_LINEAR_____10_CM 0. 255. FORMAT "%3.0" /end CHARACTERISTIC
/begin CHARACTERISTIC ID_ERR_DTC_CAM_PER_0 "" CURVE 0x40bd4 _REC_CUR_20_u2_u2 65535. _CNV_A_R_LINEAR_____10_CM 0. 65535. FORMAT "%5.0"
 /begin AXIS_DESCR COM_AXIS ONLINE_DUMMY _CNV_A_R_LINEAR_____12_CM 6 0. 5. FORMAT "%2.0" AXIS_PTS_REF ldp_fmy_dtc /end AXIS_DESCR
/end CHARACTERISTIC
/begin CHARACTERISTIC C_ERR_CLAS_CAM_PER_0 "" VALUE 0x40be4 _REC_VAL_20_u1 255. _CNV_A_R_LINEAR_____10_CM 0. 255. FORMAT "%3.0" /end CHARACTERISTIC
/begin CHARACTERISTIC ID_ERR_DTC_CAM_PER_1 "" CURVE 0x40be6 _REC_CUR_20_u2_u2 65535. _CNV_A_R_LINEAR_____10_CM 0. 65535. FORMAT "%5.0"
 /begin AXIS_DESCR COM_AXIS ONLINE_DUMMY _CNV_A_R_LINEAR_____12_CM 6 0. 5. FORMAT "%2.0" AXIS_PTS_REF ldp_fmy_dtc /end AXIS_DESCR
/end CHARACTERISTIC
/begin CHARACTERISTIC C_ERR_CLAS_CAM_PER_1 "" VALUE 0x40bf6 _REC_VAL_20_u1 255. _CNV_A_R_LINEAR_____10_CM 0. 255. FORMAT "%3.0" /end CHARACTERISTIC
/begin CHARACTERISTIC ID_ERR_DTC_SOF "" CURVE 0x411bc _REC_CUR_20_u2_u2 65535. _CNV_A_R_LINEAR_____10_CM 0. 65535. FORMAT "%5.0"
 /begin AXIS_DESCR COM_AXIS ONLINE_DUMMY _CNV_A_R_LINEAR_____12_CM 6 0. 5. FORMAT "%2.0" AXIS_PTS_REF ldp_fmy_dtc /end AXIS_DESCR
/end CHARACTERISTIC
/begin CHARACTERISTIC C_ERR_CLAS_SOF "" VALUE 0x411cc _REC_VAL_20_u1 255. _CNV_A_R_LINEAR_____10_CM 0. 255. FORMAT "%3.0" /end CHARACTERISTIC
/begin CHARACTERISTIC ID_ERR_DTC_BN_ANG_PSTE "" CURVE 0x413c6 _REC_CUR_20_u2_u2 65535. _CNV_A_R_LINEAR_____10_CM 0. 65535. FORMAT "%5.0"
 /begin AXIS_DESCR COM_AXIS ONLINE_DUMMY _CNV_A_R_LINEAR_____12_CM 6 0. 5. FORMAT "%2.0" AXIS_PTS_REF ldp_fmy_dtc /end AXIS_DESCR
/end CHARACTERISTIC
/begin CHARACTERISTIC C_ERR_CLAS_BN_ANG_PSTE "" VALUE 0x413d6 _REC_VAL_20_u1 255. _CNV_A_R_LINEAR_____10_CM 0. 255. FORMAT "%3.0" /end CHARACTERISTIC
/begin CHARACTERISTIC ID_ERR_DTC_TEG_PCAT_DOWN_1 "" CURVE 0x405b6 _REC_CUR_20_u2_u2 65535. _CNV_A_R_LINEAR_____10_CM 0. 65535. FORMAT "%5.0"
 /begin AXIS_DESCR COM_AXIS ONLINE_DUMMY _CNV_A_R_LINEAR_____12_CM 6 0. 5. FORMAT "%2.0" AXIS_PTS_REF ldp_fmy_dtc /end AXIS_DESCR
/end CHARACTERISTIC
/begin CHARACTERISTIC C_ERR_CLAS_TEG_PCAT_DOWN_1 "" VALUE 0x405c6 _REC_VAL_20_u1 255. _CNV_A_R_LINEAR_____10_CM 0. 255. FORMAT "%3.0" /end CHARACTERISTIC
/begin CHARACTERISTIC ID_ERR_DTC_TEG_PCAT_DOWN_2 "" CURVE 0x405c8 _REC_CUR_20_u2_u2 65535. _CNV_A_R_LINEAR_____10_CM 0. 65535. FORMAT "%5.0"
 /begin AXIS_DESCR COM_AXIS ONLINE_DUMMY _CNV_A_R_LINEAR_____12_CM 6 0. 5. FORMAT "%2.0" AXIS_PTS_REF ldp_fmy_dtc /end AXIS_DESCR
/end CHARACTERISTIC
/begin CHARACTERISTIC C_ERR_CLAS_TEG_PCAT_DOWN_2 "" VALUE 0x405d8 _REC_VAL_20_u1 255. _CNV_A_R_LINEAR_____10_CM 0. 255. FORMAT "%3.0" /end CHARACTERISTIC
/begin CHARACTERISTIC ID_ERR_DTC_CHK_LS_DOWN_1 "" CURVE 0x414b0 _REC_CUR_20_u2_u2 65535. _CNV_A_R_LINEAR_____10_CM 0. 65535. FORMAT "%5.0"
 /begin AXIS_DESCR COM_AXIS ONLINE_DUMMY _CNV_A_R_LINEAR_____12_CM 6 0. 5. FORMAT "%2.0" AXIS_PTS_REF ldp_fmy_dtc /end AXIS_DESCR
/end CHARACTERISTIC
/begin CHARACTERISTIC C_ERR_CLAS_CHK_LS_DOWN_1 "" VALUE 0x414c0 _REC_VAL_20_u1 255. _CNV_A_R_LINEAR_____10_CM 0. 255. FORMAT "%3.0" /end CHARACTERISTIC
/begin CHARACTERISTIC ID_ERR_DTC_CHK_LS_DOWN_2 "" CURVE 0x414c2 _REC_CUR_20_u2_u2 65535. _CNV_A_R_LINEAR_____10_CM 0. 65535. FORMAT "%5.0"
 /begin AXIS_DESCR COM_AXIS ONLINE_DUMMY _CNV_A_R_LINEAR_____12_CM 6 0. 5. FORMAT "%2.0" AXIS_PTS_REF ldp_fmy_dtc /end AXIS_DESCR
/end CHARACTERISTIC
/begin CHARACTERISTIC C_ERR_CLAS_CHK_LS_DOWN_2 "" VALUE 0x414d2 _REC_VAL_20_u1 255. _CNV_A_R_LINEAR_____10_CM 0. 255. FORMAT "%3.0" /end CHARACTERISTIC
/begin CHARACTERISTIC ID_ERR_DTC_TCO_EL "" CURVE 0x40d18 _REC_CUR_20_u2_u2 65535. _CNV_A_R_LINEAR_____10_CM 0. 65535. FORMAT "%5.0"
 /begin AXIS_DESCR COM_AXIS ONLINE_DUMMY _CNV_A_R_LINEAR_____12_CM 6 0. 5. FORMAT "%2.0" AXIS_PTS_REF ldp_fmy_dtc /end AXIS_DESCR
/end CHARACTERISTIC
/begin CHARACTERISTIC C_ERR_CLAS_TCO_EL "" VALUE 0x40d28 _REC_VAL_20_u1 255. _CNV_A_R_LINEAR_____10_CM 0. 255. FORMAT "%3.0" /end CHARACTERISTIC
/begin CHARACTERISTIC ID_ERR_DTC_BN_ACC "" CURVE 0x41336 _REC_CUR_20_u2_u2 65535. _CNV_A_R_LINEAR_____10_CM 0. 65535. FORMAT "%5.0"
 /begin AXIS_DESCR COM_AXIS ONLINE_DUMMY _CNV_A_R_LINEAR_____12_CM 6 0. 5. FORMAT "%2.0" AXIS_PTS_REF ldp_fmy_dtc /end AXIS_DESCR
/end CHARACTERISTIC
/begin CHARACTERISTIC C_ERR_CLAS_BN_ACC "" VALUE 0x41346 _REC_VAL_20_u1 255. _CNV_A_R_LINEAR_____10_CM 0. 255. FORMAT "%3.0" /end CHARACTERISTIC
/begin CHARACTERISTIC ID_ERR_DTC_TCO_EX "" CURVE 0x405ec _REC_CUR_20_u2_u2 65535. _CNV_A_R_LINEAR_____10_CM 0. 65535. FORMAT "%5.0"
 /begin AXIS_DESCR COM_AXIS ONLINE_DUMMY _CNV_A_R_LINEAR_____12_CM 6 0. 5. FORMAT "%2.0" AXIS_PTS_REF ldp_fmy_dtc /end AXIS_DESCR
/end CHARACTERISTIC
/begin CHARACTERISTIC C_ERR_CLAS_TCO_EX "" VALUE 0x405fc _REC_VAL_20_u1 255. _CNV_A_R_LINEAR_____10_CM 0. 255. FORMAT "%3.0" /end CHARACTERISTIC
/begin CHARACTERISTIC ID_ERR_DTC_BN_TQ_DCC "" CURVE 0x41294 _REC_CUR_20_u2_u2 65535. _CNV_A_R_LINEAR_____10_CM 0. 65535. FORMAT "%5.0"
 /begin AXIS_DESCR COM_AXIS ONLINE_DUMMY _CNV_A_R_LINEAR_____12_CM 6 0. 5. FORMAT "%2.0" AXIS_PTS_REF ldp_fmy_dtc /end AXIS_DESCR
/end CHARACTERISTIC
/begin CHARACTERISTIC C_ERR_CLAS_BN_TQ_DCC "" VALUE 0x412a4 _REC_VAL_20_u1 255. _CNV_A_R_LINEAR_____10_CM 0. 255. FORMAT "%3.0" /end CHARACTERISTIC
/begin CHARACTERISTIC ID_ERR_DTC_MSW_2 "" CURVE 0x40dcc _REC_CUR_20_u2_u2 65535. _CNV_A_R_LINEAR_____10_CM 0. 65535. FORMAT "%5.0"
 /begin AXIS_DESCR COM_AXIS ONLINE_DUMMY _CNV_A_R_LINEAR_____12_CM 6 0. 5. FORMAT "%2.0" AXIS_PTS_REF ldp_fmy_dtc /end AXIS_DESCR
/end CHARACTERISTIC
/begin CHARACTERISTIC C_ERR_CLAS_MSW_2 "" VALUE 0x40ddc _REC_VAL_20_u1 255. _CNV_A_R_LINEAR_____10_CM 0. 255. FORMAT "%3.0" /end CHARACTERISTIC
/begin CHARACTERISTIC ID_ERR_DTC_MSW_3 "" CURVE 0x40dde _REC_CUR_20_u2_u2 65535. _CNV_A_R_LINEAR_____10_CM 0. 65535. FORMAT "%5.0"
 /begin AXIS_DESCR COM_AXIS ONLINE_DUMMY _CNV_A_R_LINEAR_____12_CM 6 0. 5. FORMAT "%2.0" AXIS_PTS_REF ldp_fmy_dtc /end AXIS_DESCR
/end CHARACTERISTIC
/begin CHARACTERISTIC C_ERR_CLAS_MSW_3 "" VALUE 0x40dee _REC_VAL_20_u1 255. _CNV_A_R_LINEAR_____10_CM 0. 255. FORMAT "%3.0" /end CHARACTERISTIC
/begin CHARACTERISTIC ID_ERR_DTC_SLV_IVVT_IN_1 "" CURVE 0x40850 _REC_CUR_20_u2_u2 65535. _CNV_A_R_LINEAR_____10_CM 0. 65535. FORMAT "%5.0"
 /begin AXIS_DESCR COM_AXIS ONLINE_DUMMY _CNV_A_R_LINEAR_____12_CM 6 0. 5. FORMAT "%2.0" AXIS_PTS_REF ldp_fmy_dtc /end AXIS_DESCR
/end CHARACTERISTIC
/begin CHARACTERISTIC C_ERR_CLAS_SLV_IVVT_IN_1 "" VALUE 0x40860 _REC_VAL_20_u1 255. _CNV_A_R_LINEAR_____10_CM 0. 255. FORMAT "%3.0" /end CHARACTERISTIC
/begin CHARACTERISTIC ID_ERR_DTC_SLV_IVVT_IN_2 "" CURVE 0x40862 _REC_CUR_20_u2_u2 65535. _CNV_A_R_LINEAR_____10_CM 0. 65535. FORMAT "%5.0"
 /begin AXIS_DESCR COM_AXIS ONLINE_DUMMY _CNV_A_R_LINEAR_____12_CM 6 0. 5. FORMAT "%2.0" AXIS_PTS_REF ldp_fmy_dtc /end AXIS_DESCR
/end CHARACTERISTIC
/begin CHARACTERISTIC C_ERR_CLAS_SLV_IVVT_IN_2 "" VALUE 0x40872 _REC_VAL_20_u1 255. _CNV_A_R_LINEAR_____10_CM 0. 255. FORMAT "%3.0" /end CHARACTERISTIC
/begin CHARACTERISTIC ID_ERR_DTC_DMTL_PUMP "" CURVE 0x41186 _REC_CUR_20_u2_u2 65535. _CNV_A_R_LINEAR_____10_CM 0. 65535. FORMAT "%5.0"
 /begin AXIS_DESCR COM_AXIS ONLINE_DUMMY _CNV_A_R_LINEAR_____12_CM 6 0. 5. FORMAT "%2.0" AXIS_PTS_REF ldp_fmy_dtc /end AXIS_DESCR
/end CHARACTERISTIC
/begin CHARACTERISTIC C_ERR_CLAS_DMTL_PUMP "" VALUE 0x41196 _REC_VAL_20_u1 255. _CNV_A_R_LINEAR_____10_CM 0. 255. FORMAT "%3.0" /end CHARACTERISTIC
/begin CHARACTERISTIC ID_ERR_DTC_ENG_PSN "" CURVE 0x40c40 _REC_CUR_20_u2_u2 65535. _CNV_A_R_LINEAR_____10_CM 0. 65535. FORMAT "%5.0"
 /begin AXIS_DESCR COM_AXIS ONLINE_DUMMY _CNV_A_R_LINEAR_____12_CM 6 0. 5. FORMAT "%2.0" AXIS_PTS_REF ldp_fmy_dtc /end AXIS_DESCR
/end CHARACTERISTIC
/begin CHARACTERISTIC C_ERR_CLAS_ENG_PSN "" VALUE 0x40c50 _REC_VAL_20_u1 255. _CNV_A_R_LINEAR_____10_CM 0. 255. FORMAT "%3.0" /end CHARACTERISTIC
/begin CHARACTERISTIC ID_ERR_DTC_TPS_MON_1 "" CURVE 0x40eda _REC_CUR_20_u2_u2 65535. _CNV_A_R_LINEAR_____10_CM 0. 65535. FORMAT "%5.0"
 /begin AXIS_DESCR COM_AXIS ONLINE_DUMMY _CNV_A_R_LINEAR_____12_CM 6 0. 5. FORMAT "%2.0" AXIS_PTS_REF ldp_fmy_dtc /end AXIS_DESCR
/end CHARACTERISTIC
/begin CHARACTERISTIC C_ERR_CLAS_TPS_MON_1 "" VALUE 0x40eea _REC_VAL_20_u1 255. _CNV_A_R_LINEAR_____10_CM 0. 255. FORMAT "%3.0" /end CHARACTERISTIC
/begin CHARACTERISTIC ID_ERR_DTC_MSW_TOG "" CURVE 0x40dba _REC_CUR_20_u2_u2 65535. _CNV_A_R_LINEAR_____10_CM 0. 65535. FORMAT "%5.0"
 /begin AXIS_DESCR COM_AXIS ONLINE_DUMMY _CNV_A_R_LINEAR_____12_CM 6 0. 5. FORMAT "%2.0" AXIS_PTS_REF ldp_fmy_dtc /end AXIS_DESCR
/end CHARACTERISTIC
/begin CHARACTERISTIC C_ERR_CLAS_MSW_TOG "" VALUE 0x40dca _REC_VAL_20_u1 255. _CNV_A_R_LINEAR_____10_CM 0. 255. FORMAT "%3.0" /end CHARACTERISTIC
/begin CHARACTERISTIC ID_ERR_DTC_BN_TQ_AMT "" CURVE 0x41324 _REC_CUR_20_u2_u2 65535. _CNV_A_R_LINEAR_____10_CM 0. 65535. FORMAT "%5.0"
 /begin AXIS_DESCR COM_AXIS ONLINE_DUMMY _CNV_A_R_LINEAR_____12_CM 6 0. 5. FORMAT "%2.0" AXIS_PTS_REF ldp_fmy_dtc /end AXIS_DESCR
/end CHARACTERISTIC
/begin CHARACTERISTIC C_ERR_CLAS_BN_TQ_AMT "" VALUE 0x41334 _REC_VAL_20_u1 255. _CNV_A_R_LINEAR_____10_CM 0. 255. FORMAT "%3.0" /end CHARACTERISTIC
/begin CHARACTERISTIC ID_ERR_DTC_TOIL "" CURVE 0x405da _REC_CUR_20_u2_u2 65535. _CNV_A_R_LINEAR_____10_CM 0. 65535. FORMAT "%5.0"
 /begin AXIS_DESCR COM_AXIS ONLINE_DUMMY _CNV_A_R_LINEAR_____12_CM 6 0. 5. FORMAT "%2.0" AXIS_PTS_REF ldp_fmy_dtc /end AXIS_DESCR
/end CHARACTERISTIC
/begin CHARACTERISTIC C_ERR_CLAS_TOIL "" VALUE 0x405ea _REC_VAL_20_u1 255. _CNV_A_R_LINEAR_____10_CM 0. 255. FORMAT "%3.0" /end CHARACTERISTIC
/begin CHARACTERISTIC ID_ERR_DTC_VLS_UP_OC_1 "" CURVE 0x41540 _REC_CUR_20_u2_u2 65535. _CNV_A_R_LINEAR_____10_CM 0. 65535. FORMAT "%5.0"
 /begin AXIS_DESCR COM_AXIS ONLINE_DUMMY _CNV_A_R_LINEAR_____12_CM 6 0. 5. FORMAT "%2.0" AXIS_PTS_REF ldp_fmy_dtc /end AXIS_DESCR
/end CHARACTERISTIC
/begin CHARACTERISTIC C_ERR_CLAS_VLS_UP_OC_1 "" VALUE 0x41550 _REC_VAL_20_u1 255. _CNV_A_R_LINEAR_____10_CM 0. 255. FORMAT "%3.0" /end CHARACTERISTIC
/begin CHARACTERISTIC ID_ERR_DTC_VLS_UP_OC_2 "" CURVE 0x41552 _REC_CUR_20_u2_u2 65535. _CNV_A_R_LINEAR_____10_CM 0. 65535. FORMAT "%5.0"
 /begin AXIS_DESCR COM_AXIS ONLINE_DUMMY _CNV_A_R_LINEAR_____12_CM 6 0. 5. FORMAT "%2.0" AXIS_PTS_REF ldp_fmy_dtc /end AXIS_DESCR
/end CHARACTERISTIC
/begin CHARACTERISTIC C_ERR_CLAS_VLS_UP_OC_2 "" VALUE 0x41562 _REC_VAL_20_u1 255. _CNV_A_R_LINEAR_____10_CM 0. 255. FORMAT "%3.0" /end CHARACTERISTIC
/begin CHARACTERISTIC ID_ERR_DTC_VIM "" CURVE 0x40bc2 _REC_CUR_20_u2_u2 65535. _CNV_A_R_LINEAR_____10_CM 0. 65535. FORMAT "%5.0"
 /begin AXIS_DESCR COM_AXIS ONLINE_DUMMY _CNV_A_R_LINEAR_____12_CM 6 0. 5. FORMAT "%2.0" AXIS_PTS_REF ldp_fmy_dtc /end AXIS_DESCR
/end CHARACTERISTIC
/begin CHARACTERISTIC C_ERR_CLAS_VIM "" VALUE 0x40bd2 _REC_VAL_20_u1 255. _CNV_A_R_LINEAR_____10_CM 0. 255. FORMAT "%3.0" /end CHARACTERISTIC
/begin CHARACTERISTIC ID_ERR_DTC_BN_POW_GEN "" CURVE 0x413a2 _REC_CUR_20_u2_u2 65535. _CNV_A_R_LINEAR_____10_CM 0. 65535. FORMAT "%5.0"
 /begin AXIS_DESCR COM_AXIS ONLINE_DUMMY _CNV_A_R_LINEAR_____12_CM 6 0. 5. FORMAT "%2.0" AXIS_PTS_REF ldp_fmy_dtc /end AXIS_DESCR
/end CHARACTERISTIC
/begin CHARACTERISTIC C_ERR_CLAS_BN_POW_GEN "" VALUE 0x413b2 _REC_VAL_20_u1 255. _CNV_A_R_LINEAR_____10_CM 0. 255. FORMAT "%3.0" /end CHARACTERISTIC
/begin CHARACTERISTIC ID_ERR_DTC_VLS_UP_STK_1 "" CURVE 0x41588 _REC_CUR_20_u2_u2 65535. _CNV_A_R_LINEAR_____10_CM 0. 65535. FORMAT "%5.0"
 /begin AXIS_DESCR COM_AXIS ONLINE_DUMMY _CNV_A_R_LINEAR_____12_CM 6 0. 5. FORMAT "%2.0" AXIS_PTS_REF ldp_fmy_dtc /end AXIS_DESCR
/end CHARACTERISTIC
/begin CHARACTERISTIC C_ERR_CLAS_VLS_UP_STK_1 "" VALUE 0x41598 _REC_VAL_20_u1 255. _CNV_A_R_LINEAR_____10_CM 0. 255. FORMAT "%3.0" /end CHARACTERISTIC
/begin CHARACTERISTIC ID_ERR_DTC_VLS_UP_STK_2 "" CURVE 0x4159a _REC_CUR_20_u2_u2 65535. _CNV_A_R_LINEAR_____10_CM 0. 65535. FORMAT "%5.0"
 /begin AXIS_DESCR COM_AXIS ONLINE_DUMMY _CNV_A_R_LINEAR_____12_CM 6 0. 5. FORMAT "%2.0" AXIS_PTS_REF ldp_fmy_dtc /end AXIS_DESCR
/end CHARACTERISTIC
/begin CHARACTERISTIC C_ERR_CLAS_VLS_UP_STK_2 "" VALUE 0x415aa _REC_VAL_20_u1 255. _CNV_A_R_LINEAR_____10_CM 0. 255. FORMAT "%3.0" /end CHARACTERISTIC
/begin CHARACTERISTIC ID_ERR_DTC_LSH_UP_1 "" CURVE 0x40754 _REC_CUR_20_u2_u2 65535. _CNV_A_R_LINEAR_____10_CM 0. 65535. FORMAT "%5.0"
 /begin AXIS_DESCR COM_AXIS ONLINE_DUMMY _CNV_A_R_LINEAR_____12_CM 6 0. 5. FORMAT "%2.0" AXIS_PTS_REF ldp_fmy_dtc /end AXIS_DESCR
/end CHARACTERISTIC
/begin CHARACTERISTIC C_ERR_CLAS_LSH_UP_1 "" VALUE 0x40764 _REC_VAL_20_u1 255. _CNV_A_R_LINEAR_____10_CM 0. 255. FORMAT "%3.0" /end CHARACTERISTIC
/begin CHARACTERISTIC ID_ERR_DTC_LSH_UP_2 "" CURVE 0x40766 _REC_CUR_20_u2_u2 65535. _CNV_A_R_LINEAR_____10_CM 0. 65535. FORMAT "%5.0"
 /begin AXIS_DESCR COM_AXIS ONLINE_DUMMY _CNV_A_R_LINEAR_____12_CM 6 0. 5. FORMAT "%2.0" AXIS_PTS_REF ldp_fmy_dtc /end AXIS_DESCR
/end CHARACTERISTIC
/begin CHARACTERISTIC C_ERR_CLAS_LSH_UP_2 "" VALUE 0x40776 _REC_VAL_20_u1 255. _CNV_A_R_LINEAR_____10_CM 0. 255. FORMAT "%3.0" /end CHARACTERISTIC
/begin CHARACTERISTIC ID_ERR_DTC_TOUT_TXU_1 "" CURVE 0x40c88 _REC_CUR_20_u2_u2 65535. _CNV_A_R_LINEAR_____10_CM 0. 65535. FORMAT "%5.0"
 /begin AXIS_DESCR COM_AXIS ONLINE_DUMMY _CNV_A_R_LINEAR_____12_CM 6 0. 5. FORMAT "%2.0" AXIS_PTS_REF ldp_fmy_dtc /end AXIS_DESCR
/end CHARACTERISTIC
/begin CHARACTERISTIC C_ERR_CLAS_TOUT_TXU_1 "" VALUE 0x40c98 _REC_VAL_20_u1 255. _CNV_A_R_LINEAR_____10_CM 0. 255. FORMAT "%3.0" /end CHARACTERISTIC
/begin CHARACTERISTIC ID_ERR_DTC_KNKS_1 "" CURVE 0x4095e _REC_CUR_20_u2_u2 65535. _CNV_A_R_LINEAR_____10_CM 0. 65535. FORMAT "%5.0"
 /begin AXIS_DESCR COM_AXIS ONLINE_DUMMY _CNV_A_R_LINEAR_____12_CM 6 0. 5. FORMAT "%2.0" AXIS_PTS_REF ldp_fmy_dtc /end AXIS_DESCR
/end CHARACTERISTIC
/begin CHARACTERISTIC C_ERR_CLAS_KNKS_1 "" VALUE 0x4096e _REC_VAL_20_u1 255. _CNV_A_R_LINEAR_____10_CM 0. 255. FORMAT "%3.0" /end CHARACTERISTIC
/begin CHARACTERISTIC ID_ERR_DTC_KNKS_2 "" CURVE 0x40970 _REC_CUR_20_u2_u2 65535. _CNV_A_R_LINEAR_____10_CM 0. 65535. FORMAT "%5.0"
 /begin AXIS_DESCR COM_AXIS ONLINE_DUMMY _CNV_A_R_LINEAR_____12_CM 6 0. 5. FORMAT "%2.0" AXIS_PTS_REF ldp_fmy_dtc /end AXIS_DESCR
/end CHARACTERISTIC
/begin CHARACTERISTIC C_ERR_CLAS_KNKS_2 "" VALUE 0x40980 _REC_VAL_20_u1 255. _CNV_A_R_LINEAR_____10_CM 0. 255. FORMAT "%3.0" /end CHARACTERISTIC
/begin CHARACTERISTIC ID_ERR_DTC_MEC_ISA "" CURVE 0x40e14 _REC_CUR_20_u2_u2 65535. _CNV_A_R_LINEAR_____10_CM 0. 65535. FORMAT "%5.0"
 /begin AXIS_DESCR COM_AXIS ONLINE_DUMMY _CNV_A_R_LINEAR_____12_CM 6 0. 5. FORMAT "%2.0" AXIS_PTS_REF ldp_fmy_dtc /end AXIS_DESCR
/end CHARACTERISTIC
/begin CHARACTERISTIC C_ERR_CLAS_MEC_ISA "" VALUE 0x40e24 _REC_VAL_20_u1 255. _CNV_A_R_LINEAR_____10_CM 0. 255. FORMAT "%3.0" /end CHARACTERISTIC
/begin CHARACTERISTIC ID_ERR_DTC_TQ_MAX_CLU_MON_1 "" CURVE 0x40f10 _REC_CUR_20_u2_u2 65535. _CNV_A_R_LINEAR_____10_CM 0. 65535. FORMAT "%5.0"
 /begin AXIS_DESCR COM_AXIS ONLINE_DUMMY _CNV_A_R_LINEAR_____12_CM 6 0. 5. FORMAT "%2.0" AXIS_PTS_REF ldp_fmy_dtc /end AXIS_DESCR
/end CHARACTERISTIC
/begin CHARACTERISTIC C_ERR_CLAS_TQ_MAX_CLU_MON_1 "" VALUE 0x40f20 _REC_VAL_20_u1 255. _CNV_A_R_LINEAR_____10_CM 0. 255. FORMAT "%3.0" /end CHARACTERISTIC
/begin CHARACTERISTIC ID_ERR_DTC_BN_CAS "" CURVE 0x412b8 _REC_CUR_20_u2_u2 65535. _CNV_A_R_LINEAR_____10_CM 0. 65535. FORMAT "%5.0"
 /begin AXIS_DESCR COM_AXIS ONLINE_DUMMY _CNV_A_R_LINEAR_____12_CM 6 0. 5. FORMAT "%2.0" AXIS_PTS_REF ldp_fmy_dtc /end AXIS_DESCR
/end CHARACTERISTIC
/begin CHARACTERISTIC C_ERR_CLAS_BN_CAS "" VALUE 0x412c8 _REC_VAL_20_u1 255. _CNV_A_R_LINEAR_____10_CM 0. 255. FORMAT "%3.0" /end CHARACTERISTIC
/begin CHARACTERISTIC ID_ERR_DTC_VLS_UP_MIN_COLD_1 "" CURVE 0x414d4 _REC_CUR_20_u2_u2 65535. _CNV_A_R_LINEAR_____10_CM 0. 65535. FORMAT "%5.0"
 /begin AXIS_DESCR COM_AXIS ONLINE_DUMMY _CNV_A_R_LINEAR_____12_CM 6 0. 5. FORMAT "%2.0" AXIS_PTS_REF ldp_fmy_dtc /end AXIS_DESCR
/end CHARACTERISTIC
/begin CHARACTERISTIC C_ERR_CLAS_VLS_UP_MIN_COLD_1 "" VALUE 0x414e4 _REC_VAL_20_u1 255. _CNV_A_R_LINEAR_____10_CM 0. 255. FORMAT "%3.0" /end CHARACTERISTIC
/begin CHARACTERISTIC ID_ERR_DTC_VLS_UP_MIN_COLD_2 "" CURVE 0x414e6 _REC_CUR_20_u2_u2 65535. _CNV_A_R_LINEAR_____10_CM 0. 65535. FORMAT "%5.0"
 /begin AXIS_DESCR COM_AXIS ONLINE_DUMMY _CNV_A_R_LINEAR_____12_CM 6 0. 5. FORMAT "%2.0" AXIS_PTS_REF ldp_fmy_dtc /end AXIS_DESCR
/end CHARACTERISTIC
/begin CHARACTERISTIC C_ERR_CLAS_VLS_UP_MIN_COLD_2 "" VALUE 0x414f6 _REC_VAL_20_u1 255. _CNV_A_R_LINEAR_____10_CM 0. 255. FORMAT "%3.0" /end CHARACTERISTIC
/begin CHARACTERISTIC ID_ERR_DTC_TD_IGC_CUT_0 "" CURVE 0x40982 _REC_CUR_20_u2_u2 65535. _CNV_A_R_LINEAR_____10_CM 0. 65535. FORMAT "%5.0"
 /begin AXIS_DESCR COM_AXIS ONLINE_DUMMY _CNV_A_R_LINEAR_____12_CM 6 0. 5. FORMAT "%2.0" AXIS_PTS_REF ldp_fmy_dtc /end AXIS_DESCR
/end CHARACTERISTIC
/begin CHARACTERISTIC C_ERR_CLAS_TD_IGC_CUT_0 "" VALUE 0x40992 _REC_VAL_20_u1 255. _CNV_A_R_LINEAR_____10_CM 0. 255. FORMAT "%3.0" /end CHARACTERISTIC
/begin CHARACTERISTIC ID_ERR_DTC_TD_IGC_CUT_1 "" CURVE 0x40994 _REC_CUR_20_u2_u2 65535. _CNV_A_R_LINEAR_____10_CM 0. 65535. FORMAT "%5.0"
 /begin AXIS_DESCR COM_AXIS ONLINE_DUMMY _CNV_A_R_LINEAR_____12_CM 6 0. 5. FORMAT "%2.0" AXIS_PTS_REF ldp_fmy_dtc /end AXIS_DESCR
/end CHARACTERISTIC
/begin CHARACTERISTIC C_ERR_CLAS_TD_IGC_CUT_1 "" VALUE 0x409a4 _REC_VAL_20_u1 255. _CNV_A_R_LINEAR_____10_CM 0. 255. FORMAT "%3.0" /end CHARACTERISTIC
/begin CHARACTERISTIC ID_ERR_DTC_TD_IGC_CUT_2 "" CURVE 0x409a6 _REC_CUR_20_u2_u2 65535. _CNV_A_R_LINEAR_____10_CM 0. 65535. FORMAT "%5.0"
 /begin AXIS_DESCR COM_AXIS ONLINE_DUMMY _CNV_A_R_LINEAR_____12_CM 6 0. 5. FORMAT "%2.0" AXIS_PTS_REF ldp_fmy_dtc /end AXIS_DESCR
/end CHARACTERISTIC
/begin CHARACTERISTIC C_ERR_CLAS_TD_IGC_CUT_2 "" VALUE 0x409b6 _REC_VAL_20_u1 255. _CNV_A_R_LINEAR_____10_CM 0. 255. FORMAT "%3.0" /end CHARACTERISTIC
/begin CHARACTERISTIC ID_ERR_DTC_TD_IGC_CUT_3 "" CURVE 0x409b8 _REC_CUR_20_u2_u2 65535. _CNV_A_R_LINEAR_____10_CM 0. 65535. FORMAT "%5.0"
 /begin AXIS_DESCR COM_AXIS ONLINE_DUMMY _CNV_A_R_LINEAR_____12_CM 6 0. 5. FORMAT "%2.0" AXIS_PTS_REF ldp_fmy_dtc /end AXIS_DESCR
/end CHARACTERISTIC
/begin CHARACTERISTIC C_ERR_CLAS_TD_IGC_CUT_3 "" VALUE 0x409c8 _REC_VAL_20_u1 255. _CNV_A_R_LINEAR_____10_CM 0. 255. FORMAT "%3.0" /end CHARACTERISTIC
/begin CHARACTERISTIC ID_ERR_DTC_TD_IGC_CUT_4 "" CURVE 0x409ca _REC_CUR_20_u2_u2 65535. _CNV_A_R_LINEAR_____10_CM 0. 65535. FORMAT "%5.0"
 /begin AXIS_DESCR COM_AXIS ONLINE_DUMMY _CNV_A_R_LINEAR_____12_CM 6 0. 5. FORMAT "%2.0" AXIS_PTS_REF ldp_fmy_dtc /end AXIS_DESCR
/end CHARACTERISTIC
/begin CHARACTERISTIC C_ERR_CLAS_TD_IGC_CUT_4 "" VALUE 0x409da _REC_VAL_20_u1 255. _CNV_A_R_LINEAR_____10_CM 0. 255. FORMAT "%3.0" /end CHARACTERISTIC
/begin CHARACTERISTIC ID_ERR_DTC_TD_IGC_CUT_5 "" CURVE 0x409dc _REC_CUR_20_u2_u2 65535. _CNV_A_R_LINEAR_____10_CM 0. 65535. FORMAT "%5.0"
 /begin AXIS_DESCR COM_AXIS ONLINE_DUMMY _CNV_A_R_LINEAR_____12_CM 6 0. 5. FORMAT "%2.0" AXIS_PTS_REF ldp_fmy_dtc /end AXIS_DESCR
/end CHARACTERISTIC
/begin CHARACTERISTIC C_ERR_CLAS_TD_IGC_CUT_5 "" VALUE 0x409ec _REC_VAL_20_u1 255. _CNV_A_R_LINEAR_____10_CM 0. 255. FORMAT "%3.0" /end CHARACTERISTIC
/begin CHARACTERISTIC ID_ERR_DTC_V_REF_1 "" CURVE 0x40aa2 _REC_CUR_20_u2_u2 65535. _CNV_A_R_LINEAR_____10_CM 0. 65535. FORMAT "%5.0"
 /begin AXIS_DESCR COM_AXIS ONLINE_DUMMY _CNV_A_R_LINEAR_____12_CM 6 0. 5. FORMAT "%2.0" AXIS_PTS_REF ldp_fmy_dtc /end AXIS_DESCR
/end CHARACTERISTIC
/begin CHARACTERISTIC C_ERR_CLAS_V_REF_1 "" VALUE 0x40ab2 _REC_VAL_20_u1 255. _CNV_A_R_LINEAR_____10_CM 0. 255. FORMAT "%3.0" /end CHARACTERISTIC
/begin CHARACTERISTIC ID_ERR_DTC_V_REF_2 "" CURVE 0x40ab4 _REC_CUR_20_u2_u2 65535. _CNV_A_R_LINEAR_____10_CM 0. 65535. FORMAT "%5.0"
 /begin AXIS_DESCR COM_AXIS ONLINE_DUMMY _CNV_A_R_LINEAR_____12_CM 6 0. 5. FORMAT "%2.0" AXIS_PTS_REF ldp_fmy_dtc /end AXIS_DESCR
/end CHARACTERISTIC
/begin CHARACTERISTIC C_ERR_CLAS_V_REF_2 "" VALUE 0x40ac4 _REC_VAL_20_u1 255. _CNV_A_R_LINEAR_____10_CM 0. 255. FORMAT "%3.0" /end CHARACTERISTIC
/begin CHARACTERISTIC ID_ERR_DTC_BN_VS_TCS "" CURVE 0x412dc _REC_CUR_20_u2_u2 65535. _CNV_A_R_LINEAR_____10_CM 0. 65535. FORMAT "%5.0"
 /begin AXIS_DESCR COM_AXIS ONLINE_DUMMY _CNV_A_R_LINEAR_____12_CM 6 0. 5. FORMAT "%2.0" AXIS_PTS_REF ldp_fmy_dtc /end AXIS_DESCR
/end CHARACTERISTIC
/begin CHARACTERISTIC C_ERR_CLAS_BN_VS_TCS "" VALUE 0x412ec _REC_VAL_20_u1 255. _CNV_A_R_LINEAR_____10_CM 0. 255. FORMAT "%3.0" /end CHARACTERISTIC
/begin CHARACTERISTIC ID_ERR_DTC_MEC_IVVT_EX_1 "" CURVE 0x407e4 _REC_CUR_20_u2_u2 65535. _CNV_A_R_LINEAR_____10_CM 0. 65535. FORMAT "%5.0"
 /begin AXIS_DESCR COM_AXIS ONLINE_DUMMY _CNV_A_R_LINEAR_____12_CM 6 0. 5. FORMAT "%2.0" AXIS_PTS_REF ldp_fmy_dtc /end AXIS_DESCR
/end CHARACTERISTIC
/begin CHARACTERISTIC C_ERR_CLAS_MEC_IVVT_EX_1 "" VALUE 0x407f4 _REC_VAL_20_u1 255. _CNV_A_R_LINEAR_____10_CM 0. 255. FORMAT "%3.0" /end CHARACTERISTIC
/begin CHARACTERISTIC ID_ERR_DTC_MEC_IVVT_EX_2 "" CURVE 0x407f6 _REC_CUR_20_u2_u2 65535. _CNV_A_R_LINEAR_____10_CM 0. 65535. FORMAT "%5.0"
 /begin AXIS_DESCR COM_AXIS ONLINE_DUMMY _CNV_A_R_LINEAR_____12_CM 6 0. 5. FORMAT "%2.0" AXIS_PTS_REF ldp_fmy_dtc /end AXIS_DESCR
/end CHARACTERISTIC
/begin CHARACTERISTIC C_ERR_CLAS_MEC_IVVT_EX_2 "" VALUE 0x40806 _REC_VAL_20_u1 255. _CNV_A_R_LINEAR_____10_CM 0. 255. FORMAT "%3.0" /end CHARACTERISTIC
/begin CHARACTERISTIC ID_ERR_DTC_PVS_1 "" CURVE 0x40ac6 _REC_CUR_20_u2_u2 65535. _CNV_A_R_LINEAR_____10_CM 0. 65535. FORMAT "%5.0"
 /begin AXIS_DESCR COM_AXIS ONLINE_DUMMY _CNV_A_R_LINEAR_____12_CM 6 0. 5. FORMAT "%2.0" AXIS_PTS_REF ldp_fmy_dtc /end AXIS_DESCR
/end CHARACTERISTIC
/begin CHARACTERISTIC C_ERR_CLAS_PVS_1 "" VALUE 0x40ad6 _REC_VAL_20_u1 255. _CNV_A_R_LINEAR_____10_CM 0. 255. FORMAT "%3.0" /end CHARACTERISTIC
/begin CHARACTERISTIC ID_ERR_DTC_PVS_2 "" CURVE 0x40ad8 _REC_CUR_20_u2_u2 65535. _CNV_A_R_LINEAR_____10_CM 0. 65535. FORMAT "%5.0"
 /begin AXIS_DESCR COM_AXIS ONLINE_DUMMY _CNV_A_R_LINEAR_____12_CM 6 0. 5. FORMAT "%2.0" AXIS_PTS_REF ldp_fmy_dtc /end AXIS_DESCR
/end CHARACTERISTIC
/begin CHARACTERISTIC C_ERR_CLAS_PVS_2 "" VALUE 0x40ae8 _REC_VAL_20_u1 255. _CNV_A_R_LINEAR_____10_CM 0. 255. FORMAT "%3.0" /end CHARACTERISTIC
/begin CHARACTERISTIC ID_ERR_DTC_ECT_MEC "" CURVE 0x40d60 _REC_CUR_20_u2_u2 65535. _CNV_A_R_LINEAR_____10_CM 0. 65535. FORMAT "%5.0"
 /begin AXIS_DESCR COM_AXIS ONLINE_DUMMY _CNV_A_R_LINEAR_____12_CM 6 0. 5. FORMAT "%2.0" AXIS_PTS_REF ldp_fmy_dtc /end AXIS_DESCR
/end CHARACTERISTIC
/begin CHARACTERISTIC C_ERR_CLAS_ECT_MEC "" VALUE 0x40d70 _REC_VAL_20_u1 255. _CNV_A_R_LINEAR_____10_CM 0. 255. FORMAT "%3.0" /end CHARACTERISTIC
/begin CHARACTERISTIC ID_ERR_DTC_TQI_AV_MON_1 "" CURVE 0x40f46 _REC_CUR_20_u2_u2 65535. _CNV_A_R_LINEAR_____10_CM 0. 65535. FORMAT "%5.0"
 /begin AXIS_DESCR COM_AXIS ONLINE_DUMMY _CNV_A_R_LINEAR_____12_CM 6 0. 5. FORMAT "%2.0" AXIS_PTS_REF ldp_fmy_dtc /end AXIS_DESCR
/end CHARACTERISTIC
/begin CHARACTERISTIC C_ERR_CLAS_TQI_AV_MON_1 "" VALUE 0x40f56 _REC_VAL_20_u1 255. _CNV_A_R_LINEAR_____10_CM 0. 255. FORMAT "%3.0" /end CHARACTERISTIC
/begin CHARACTERISTIC ID_ERR_DTC_LS_UP_FRQ_1 "" CURVE 0x415f4 _REC_CUR_20_u2_u2 65535. _CNV_A_R_LINEAR_____10_CM 0. 65535. FORMAT "%5.0"
 /begin AXIS_DESCR COM_AXIS ONLINE_DUMMY _CNV_A_R_LINEAR_____12_CM 6 0. 5. FORMAT "%2.0" AXIS_PTS_REF ldp_fmy_dtc /end AXIS_DESCR
/end CHARACTERISTIC
/begin CHARACTERISTIC C_ERR_CLAS_LS_UP_FRQ_1 "" VALUE 0x41604 _REC_VAL_20_u1 255. _CNV_A_R_LINEAR_____10_CM 0. 255. FORMAT "%3.0" /end CHARACTERISTIC
/begin CHARACTERISTIC ID_ERR_DTC_LS_UP_FRQ_2 "" CURVE 0x41606 _REC_CUR_20_u2_u2 65535. _CNV_A_R_LINEAR_____10_CM 0. 65535. FORMAT "%5.0"
 /begin AXIS_DESCR COM_AXIS ONLINE_DUMMY _CNV_A_R_LINEAR_____12_CM 6 0. 5. FORMAT "%2.0" AXIS_PTS_REF ldp_fmy_dtc /end AXIS_DESCR
/end CHARACTERISTIC
/begin CHARACTERISTIC C_ERR_CLAS_LS_UP_FRQ_2 "" VALUE 0x41616 _REC_VAL_20_u1 255. _CNV_A_R_LINEAR_____10_CM 0. 255. FORMAT "%3.0" /end CHARACTERISTIC
/begin CHARACTERISTIC ID_ERR_DTC_VLS_DOWN_MIN_COLD_1 "" CURVE 0x40658 _REC_CUR_20_u2_u2 65535. _CNV_A_R_LINEAR_____10_CM 0. 65535. FORMAT "%5.0"
 /begin AXIS_DESCR COM_AXIS ONLINE_DUMMY _CNV_A_R_LINEAR_____12_CM 6 0. 5. FORMAT "%2.0" AXIS_PTS_REF ldp_fmy_dtc /end AXIS_DESCR
/end CHARACTERISTIC
/begin CHARACTERISTIC C_ERR_CLAS_VLS_DOWN_MIN_COLD_1 "" VALUE 0x40668 _REC_VAL_20_u1 255. _CNV_A_R_LINEAR_____10_CM 0. 255. FORMAT "%3.0" /end CHARACTERISTIC
/begin CHARACTERISTIC ID_ERR_DTC_VLS_DOWN_MIN_COLD_2 "" CURVE 0x4066a _REC_CUR_20_u2_u2 65535. _CNV_A_R_LINEAR_____10_CM 0. 65535. FORMAT "%5.0"
 /begin AXIS_DESCR COM_AXIS ONLINE_DUMMY _CNV_A_R_LINEAR_____12_CM 6 0. 5. FORMAT "%2.0" AXIS_PTS_REF ldp_fmy_dtc /end AXIS_DESCR
/end CHARACTERISTIC
/begin CHARACTERISTIC C_ERR_CLAS_VLS_DOWN_MIN_COLD_2 "" VALUE 0x4067a _REC_VAL_20_u1 255. _CNV_A_R_LINEAR_____10_CM 0. 255. FORMAT "%3.0" /end CHARACTERISTIC
/begin CHARACTERISTIC ID_ERR_DTC_BN_POW_VB "" CURVE 0x41390 _REC_CUR_20_u2_u2 65535. _CNV_A_R_LINEAR_____10_CM 0. 65535. FORMAT "%5.0"
 /begin AXIS_DESCR COM_AXIS ONLINE_DUMMY _CNV_A_R_LINEAR_____12_CM 6 0. 5. FORMAT "%2.0" AXIS_PTS_REF ldp_fmy_dtc /end AXIS_DESCR
/end CHARACTERISTIC
/begin CHARACTERISTIC C_ERR_CLAS_BN_POW_VB "" VALUE 0x413a0 _REC_VAL_20_u1 255. _CNV_A_R_LINEAR_____10_CM 0. 255. FORMAT "%3.0" /end CHARACTERISTIC
/begin CHARACTERISTIC ID_ERR_DTC_SOF_REQ "" CURVE 0x411ce _REC_CUR_20_u2_u2 65535. _CNV_A_R_LINEAR_____10_CM 0. 65535. FORMAT "%5.0"
 /begin AXIS_DESCR COM_AXIS ONLINE_DUMMY _CNV_A_R_LINEAR_____12_CM 6 0. 5. FORMAT "%2.0" AXIS_PTS_REF ldp_fmy_dtc /end AXIS_DESCR
/end CHARACTERISTIC
/begin CHARACTERISTIC C_ERR_CLAS_SOF_REQ "" VALUE 0x411de _REC_VAL_20_u1 255. _CNV_A_R_LINEAR_____10_CM 0. 255. FORMAT "%3.0" /end CHARACTERISTIC
/begin CHARACTERISTIC ID_ERR_DTC_MSR_INH_MON_1 "" CURVE 0x40f6a _REC_CUR_20_u2_u2 65535. _CNV_A_R_LINEAR_____10_CM 0. 65535. FORMAT "%5.0"
 /begin AXIS_DESCR COM_AXIS ONLINE_DUMMY _CNV_A_R_LINEAR_____12_CM 6 0. 5. FORMAT "%2.0" AXIS_PTS_REF ldp_fmy_dtc /end AXIS_DESCR
/end CHARACTERISTIC
/begin CHARACTERISTIC C_ERR_CLAS_MSR_INH_MON_1 "" VALUE 0x40f7a _REC_VAL_20_u1 255. _CNV_A_R_LINEAR_____10_CM 0. 255. FORMAT "%3.0" /end CHARACTERISTIC
/begin CHARACTERISTIC ID_ERR_DTC_ECF "" CURVE 0x40d06 _REC_CUR_20_u2_u2 65535. _CNV_A_R_LINEAR_____10_CM 0. 65535. FORMAT "%5.0"
 /begin AXIS_DESCR COM_AXIS ONLINE_DUMMY _CNV_A_R_LINEAR_____12_CM 6 0. 5. FORMAT "%2.0" AXIS_PTS_REF ldp_fmy_dtc /end AXIS_DESCR
/end CHARACTERISTIC
/begin CHARACTERISTIC C_ERR_CLAS_ECF "" VALUE 0x40d16 _REC_VAL_20_u1 255. _CNV_A_R_LINEAR_____10_CM 0. 255. FORMAT "%3.0" /end CHARACTERISTIC
/begin CHARACTERISTIC ID_ERR_DTC_MIS_LOW_FUEL "" CURVE 0x40e80 _REC_CUR_20_u2_u2 65535. _CNV_A_R_LINEAR_____10_CM 0. 65535. FORMAT "%5.0"
 /begin AXIS_DESCR COM_AXIS ONLINE_DUMMY _CNV_A_R_LINEAR_____12_CM 6 0. 5. FORMAT "%2.0" AXIS_PTS_REF ldp_fmy_dtc /end AXIS_DESCR
/end CHARACTERISTIC
/begin CHARACTERISTIC C_ERR_CLAS_MIS_LOW_FUEL "" VALUE 0x40e90 _REC_VAL_20_u1 255. _CNV_A_R_LINEAR_____10_CM 0. 255. FORMAT "%3.0" /end CHARACTERISTIC
/begin CHARACTERISTIC ID_ERR_DTC_DMTLM "" CURVE 0x41198 _REC_CUR_20_u2_u2 65535. _CNV_A_R_LINEAR_____10_CM 0. 65535. FORMAT "%5.0"
 /begin AXIS_DESCR COM_AXIS ONLINE_DUMMY _CNV_A_R_LINEAR_____12_CM 6 0. 5. FORMAT "%2.0" AXIS_PTS_REF ldp_fmy_dtc /end AXIS_DESCR
/end CHARACTERISTIC
/begin CHARACTERISTIC C_ERR_CLAS_DMTLM "" VALUE 0x411a8 _REC_VAL_20_u1 255. _CNV_A_R_LINEAR_____10_CM 0. 255. FORMAT "%3.0" /end CHARACTERISTIC
/begin CHARACTERISTIC ID_ERR_DTC_CAM_1_NOT_PLAUS "" CURVE 0x40c2e _REC_CUR_20_u2_u2 65535. _CNV_A_R_LINEAR_____10_CM 0. 65535. FORMAT "%5.0"
 /begin AXIS_DESCR COM_AXIS ONLINE_DUMMY _CNV_A_R_LINEAR_____12_CM 6 0. 5. FORMAT "%2.0" AXIS_PTS_REF ldp_fmy_dtc /end AXIS_DESCR
/end CHARACTERISTIC
/begin CHARACTERISTIC C_ERR_CLAS_CAM_1_NOT_PLAUS "" VALUE 0x40c3e _REC_VAL_20_u1 255. _CNV_A_R_LINEAR_____10_CM 0. 255. FORMAT "%3.0" /end CHARACTERISTIC
/begin CHARACTERISTIC ID_ERR_DTC_DMTLS "" CURVE 0x41174 _REC_CUR_20_u2_u2 65535. _CNV_A_R_LINEAR_____10_CM 0. 65535. FORMAT "%5.0"
 /begin AXIS_DESCR COM_AXIS ONLINE_DUMMY _CNV_A_R_LINEAR_____12_CM 6 0. 5. FORMAT "%2.0" AXIS_PTS_REF ldp_fmy_dtc /end AXIS_DESCR
/end CHARACTERISTIC
/begin CHARACTERISTIC C_ERR_CLAS_DMTLS "" VALUE 0x41184 _REC_VAL_20_u1 255. _CNV_A_R_LINEAR_____10_CM 0. 255. FORMAT "%3.0" /end CHARACTERISTIC
/begin CHARACTERISTIC ID_ERR_DTC_RLY_ACCOUT "" CURVE 0x40cd0 _REC_CUR_20_u2_u2 65535. _CNV_A_R_LINEAR_____10_CM 0. 65535. FORMAT "%5.0"
 /begin AXIS_DESCR COM_AXIS ONLINE_DUMMY _CNV_A_R_LINEAR_____12_CM 6 0. 5. FORMAT "%2.0" AXIS_PTS_REF ldp_fmy_dtc /end AXIS_DESCR
/end CHARACTERISTIC
/begin CHARACTERISTIC C_ERR_CLAS_RLY_ACCOUT "" VALUE 0x40ce0 _REC_VAL_20_u1 255. _CNV_A_R_LINEAR_____10_CM 0. 255. FORMAT "%3.0" /end CHARACTERISTIC
/begin CHARACTERISTIC ID_ERR_DTC_LOCAN_BOFF "" CURVE 0x41468 _REC_CUR_20_u2_u2 65535. _CNV_A_R_LINEAR_____10_CM 0. 65535. FORMAT "%5.0"
 /begin AXIS_DESCR COM_AXIS ONLINE_DUMMY _CNV_A_R_LINEAR_____12_CM 6 0. 5. FORMAT "%2.0" AXIS_PTS_REF ldp_fmy_dtc /end AXIS_DESCR
/end CHARACTERISTIC
/begin CHARACTERISTIC C_ERR_CLAS_LOCAN_BOFF "" VALUE 0x41478 _REC_VAL_20_u1 255. _CNV_A_R_LINEAR_____10_CM 0. 255. FORMAT "%3.0" /end CHARACTERISTIC
/begin CHARACTERISTIC ID_ERR_DTC_IV_0 "" CURVE 0x406e8 _REC_CUR_20_u2_u2 65535. _CNV_A_R_LINEAR_____10_CM 0. 65535. FORMAT "%5.0"
 /begin AXIS_DESCR COM_AXIS ONLINE_DUMMY _CNV_A_R_LINEAR_____12_CM 6 0. 5. FORMAT "%2.0" AXIS_PTS_REF ldp_fmy_dtc /end AXIS_DESCR
/end CHARACTERISTIC
/begin CHARACTERISTIC C_ERR_CLAS_IV_0 "" VALUE 0x406f8 _REC_VAL_20_u1 255. _CNV_A_R_LINEAR_____10_CM 0. 255. FORMAT "%3.0" /end CHARACTERISTIC
/begin CHARACTERISTIC ID_ERR_DTC_IV_1 "" CURVE 0x406fa _REC_CUR_20_u2_u2 65535. _CNV_A_R_LINEAR_____10_CM 0. 65535. FORMAT "%5.0"
 /begin AXIS_DESCR COM_AXIS ONLINE_DUMMY _CNV_A_R_LINEAR_____12_CM 6 0. 5. FORMAT "%2.0" AXIS_PTS_REF ldp_fmy_dtc /end AXIS_DESCR
/end CHARACTERISTIC
/begin CHARACTERISTIC C_ERR_CLAS_IV_1 "" VALUE 0x4070a _REC_VAL_20_u1 255. _CNV_A_R_LINEAR_____10_CM 0. 255. FORMAT "%3.0" /end CHARACTERISTIC
/begin CHARACTERISTIC ID_ERR_DTC_IV_2 "" CURVE 0x4070c _REC_CUR_20_u2_u2 65535. _CNV_A_R_LINEAR_____10_CM 0. 65535. FORMAT "%5.0"
 /begin AXIS_DESCR COM_AXIS ONLINE_DUMMY _CNV_A_R_LINEAR_____12_CM 6 0. 5. FORMAT "%2.0" AXIS_PTS_REF ldp_fmy_dtc /end AXIS_DESCR
/end CHARACTERISTIC
/begin CHARACTERISTIC C_ERR_CLAS_IV_2 "" VALUE 0x4071c _REC_VAL_20_u1 255. _CNV_A_R_LINEAR_____10_CM 0. 255. FORMAT "%3.0" /end CHARACTERISTIC
/begin CHARACTERISTIC ID_ERR_DTC_SLV_IVVT_EX_1 "" CURVE 0x40874 _REC_CUR_20_u2_u2 65535. _CNV_A_R_LINEAR_____10_CM 0. 65535. FORMAT "%5.0"
 /begin AXIS_DESCR COM_AXIS ONLINE_DUMMY _CNV_A_R_LINEAR_____12_CM 6 0. 5. FORMAT "%2.0" AXIS_PTS_REF ldp_fmy_dtc /end AXIS_DESCR
/end CHARACTERISTIC
/begin CHARACTERISTIC C_ERR_CLAS_SLV_IVVT_EX_1 "" VALUE 0x40884 _REC_VAL_20_u1 255. _CNV_A_R_LINEAR_____10_CM 0. 255. FORMAT "%3.0" /end CHARACTERISTIC
/begin CHARACTERISTIC ID_ERR_DTC_RLY_MAIN "" CURVE 0x40cac _REC_CUR_20_u2_u2 65535. _CNV_A_R_LINEAR_____10_CM 0. 65535. FORMAT "%5.0"
 /begin AXIS_DESCR COM_AXIS ONLINE_DUMMY _CNV_A_R_LINEAR_____12_CM 6 0. 5. FORMAT "%2.0" AXIS_PTS_REF ldp_fmy_dtc /end AXIS_DESCR
/end CHARACTERISTIC
/begin CHARACTERISTIC C_ERR_CLAS_RLY_MAIN "" VALUE 0x40cbc _REC_VAL_20_u1 255. _CNV_A_R_LINEAR_____10_CM 0. 255. FORMAT "%3.0" /end CHARACTERISTIC
/begin CHARACTERISTIC ID_ERR_DTC_IV_3 "" CURVE 0x4071e _REC_CUR_20_u2_u2 65535. _CNV_A_R_LINEAR_____10_CM 0. 65535. FORMAT "%5.0"
 /begin AXIS_DESCR COM_AXIS ONLINE_DUMMY _CNV_A_R_LINEAR_____12_CM 6 0. 5. FORMAT "%2.0" AXIS_PTS_REF ldp_fmy_dtc /end AXIS_DESCR
/end CHARACTERISTIC
/begin CHARACTERISTIC C_ERR_CLAS_IV_3 "" VALUE 0x4072e _REC_VAL_20_u1 255. _CNV_A_R_LINEAR_____10_CM 0. 255. FORMAT "%3.0" /end CHARACTERISTIC
/begin CHARACTERISTIC ID_ERR_DTC_SLV_IVVT_EX_2 "" CURVE 0x40886 _REC_CUR_20_u2_u2 65535. _CNV_A_R_LINEAR_____10_CM 0. 65535. FORMAT "%5.0"
 /begin AXIS_DESCR COM_AXIS ONLINE_DUMMY _CNV_A_R_LINEAR_____12_CM 6 0. 5. FORMAT "%2.0" AXIS_PTS_REF ldp_fmy_dtc /end AXIS_DESCR
/end CHARACTERISTIC
/begin CHARACTERISTIC C_ERR_CLAS_SLV_IVVT_EX_2 "" VALUE 0x40896 _REC_VAL_20_u1 255. _CNV_A_R_LINEAR_____10_CM 0. 255. FORMAT "%3.0" /end CHARACTERISTIC
/begin CHARACTERISTIC ID_ERR_DTC_IV_4 "" CURVE 0x40730 _REC_CUR_20_u2_u2 65535. _CNV_A_R_LINEAR_____10_CM 0. 65535. FORMAT "%5.0"
 /begin AXIS_DESCR COM_AXIS ONLINE_DUMMY _CNV_A_R_LINEAR_____12_CM 6 0. 5. FORMAT "%2.0" AXIS_PTS_REF ldp_fmy_dtc /end AXIS_DESCR
/end CHARACTERISTIC
/begin CHARACTERISTIC C_ERR_CLAS_IV_4 "" VALUE 0x40740 _REC_VAL_20_u1 255. _CNV_A_R_LINEAR_____10_CM 0. 255. FORMAT "%3.0" /end CHARACTERISTIC
/begin CHARACTERISTIC ID_ERR_DTC_IV_5 "" CURVE 0x40742 _REC_CUR_20_u2_u2 65535. _CNV_A_R_LINEAR_____10_CM 0. 65535. FORMAT "%5.0"
 /begin AXIS_DESCR COM_AXIS ONLINE_DUMMY _CNV_A_R_LINEAR_____12_CM 6 0. 5. FORMAT "%2.0" AXIS_PTS_REF ldp_fmy_dtc /end AXIS_DESCR
/end CHARACTERISTIC
/begin CHARACTERISTIC C_ERR_CLAS_IV_5 "" VALUE 0x40752 _REC_VAL_20_u1 255. _CNV_A_R_LINEAR_____10_CM 0. 255. FORMAT "%3.0" /end CHARACTERISTIC
/begin CHARACTERISTIC ID_ERR_DTC_MAF_MON_1 "" CURVE 0x40f8e _REC_CUR_20_u2_u2 65535. _CNV_A_R_LINEAR_____10_CM 0. 65535. FORMAT "%5.0"
 /begin AXIS_DESCR COM_AXIS ONLINE_DUMMY _CNV_A_R_LINEAR_____12_CM 6 0. 5. FORMAT "%2.0" AXIS_PTS_REF ldp_fmy_dtc /end AXIS_DESCR
/end CHARACTERISTIC
/begin CHARACTERISTIC C_ERR_CLAS_MAF_MON_1 "" VALUE 0x40f9e _REC_VAL_20_u1 255. _CNV_A_R_LINEAR_____10_CM 0. 255. FORMAT "%3.0" /end CHARACTERISTIC
/begin CHARACTERISTIC ID_ERR_DTC_VLS_DOWN_OC_1 "" CURVE 0x406a0 _REC_CUR_20_u2_u2 65535. _CNV_A_R_LINEAR_____10_CM 0. 65535. FORMAT "%5.0"
 /begin AXIS_DESCR COM_AXIS ONLINE_DUMMY _CNV_A_R_LINEAR_____12_CM 6 0. 5. FORMAT "%2.0" AXIS_PTS_REF ldp_fmy_dtc /end AXIS_DESCR
/end CHARACTERISTIC
/begin CHARACTERISTIC C_ERR_CLAS_VLS_DOWN_OC_1 "" VALUE 0x406b0 _REC_VAL_20_u1 255. _CNV_A_R_LINEAR_____10_CM 0. 255. FORMAT "%3.0" /end CHARACTERISTIC
/begin CHARACTERISTIC ID_ERR_DTC_VLS_DOWN_OC_2 "" CURVE 0x406b2 _REC_CUR_20_u2_u2 65535. _CNV_A_R_LINEAR_____10_CM 0. 65535. FORMAT "%5.0"
 /begin AXIS_DESCR COM_AXIS ONLINE_DUMMY _CNV_A_R_LINEAR_____12_CM 6 0. 5. FORMAT "%2.0" AXIS_PTS_REF ldp_fmy_dtc /end AXIS_DESCR
/end CHARACTERISTIC
/begin CHARACTERISTIC C_ERR_CLAS_VLS_DOWN_OC_2 "" VALUE 0x406c2 _REC_VAL_20_u1 255. _CNV_A_R_LINEAR_____10_CM 0. 255. FORMAT "%3.0" /end CHARACTERISTIC
/begin CHARACTERISTIC ID_ERR_DTC_CAM_PSN_0 "" CURVE 0x40bf8 _REC_CUR_20_u2_u2 65535. _CNV_A_R_LINEAR_____10_CM 0. 65535. FORMAT "%5.0"
 /begin AXIS_DESCR COM_AXIS ONLINE_DUMMY _CNV_A_R_LINEAR_____12_CM 6 0. 5. FORMAT "%2.0" AXIS_PTS_REF ldp_fmy_dtc /end AXIS_DESCR
/end CHARACTERISTIC
/begin CHARACTERISTIC C_ERR_CLAS_CAM_PSN_0 "" VALUE 0x40c08 _REC_VAL_20_u1 255. _CNV_A_R_LINEAR_____10_CM 0. 255. FORMAT "%3.0" /end CHARACTERISTIC
/begin CHARACTERISTIC ID_ERR_DTC_CAM_PSN_1 "" CURVE 0x40c0a _REC_CUR_20_u2_u2 65535. _CNV_A_R_LINEAR_____10_CM 0. 65535. FORMAT "%5.0"
 /begin AXIS_DESCR COM_AXIS ONLINE_DUMMY _CNV_A_R_LINEAR_____12_CM 6 0. 5. FORMAT "%2.0" AXIS_PTS_REF ldp_fmy_dtc /end AXIS_DESCR
/end CHARACTERISTIC
/begin CHARACTERISTIC C_ERR_CLAS_CAM_PSN_1 "" VALUE 0x40c1a _REC_VAL_20_u1 255. _CNV_A_R_LINEAR_____10_CM 0. 255. FORMAT "%3.0" /end CHARACTERISTIC
/begin CHARACTERISTIC ID_ERR_DTC_LOAD_TPS_PLAUS "" CURVE 0x413d8 _REC_CUR_20_u2_u2 65535. _CNV_A_R_LINEAR_____10_CM 0. 65535. FORMAT "%5.0"
 /begin AXIS_DESCR COM_AXIS ONLINE_DUMMY _CNV_A_R_LINEAR_____12_CM 6 0. 5. FORMAT "%2.0" AXIS_PTS_REF ldp_fmy_dtc /end AXIS_DESCR
/end CHARACTERISTIC
/begin CHARACTERISTIC C_ERR_CLAS_LOAD_TPS_PLAUS "" VALUE 0x413e8 _REC_VAL_20_u1 255. _CNV_A_R_LINEAR_____10_CM 0. 255. FORMAT "%3.0" /end CHARACTERISTIC
/begin CHARACTERISTIC ID_ERR_DTC_RLY_ST "" CURVE 0x411e0 _REC_CUR_20_u2_u2 65535. _CNV_A_R_LINEAR_____10_CM 0. 65535. FORMAT "%5.0"
 /begin AXIS_DESCR COM_AXIS ONLINE_DUMMY _CNV_A_R_LINEAR_____12_CM 6 0. 5. FORMAT "%2.0" AXIS_PTS_REF ldp_fmy_dtc /end AXIS_DESCR
/end CHARACTERISTIC
/begin CHARACTERISTIC C_ERR_CLAS_RLY_ST "" VALUE 0x411f0 _REC_VAL_20_u1 255. _CNV_A_R_LINEAR_____10_CM 0. 255. FORMAT "%3.0" /end CHARACTERISTIC
/begin CHARACTERISTIC ID_ERR_DTC_TQ_LOSS_MON_1 "" CURVE 0x40eec _REC_CUR_20_u2_u2 65535. _CNV_A_R_LINEAR_____10_CM 0. 65535. FORMAT "%5.0"
 /begin AXIS_DESCR COM_AXIS ONLINE_DUMMY _CNV_A_R_LINEAR_____12_CM 6 0. 5. FORMAT "%2.0" AXIS_PTS_REF ldp_fmy_dtc /end AXIS_DESCR
/end CHARACTERISTIC
/begin CHARACTERISTIC C_ERR_CLAS_TQ_LOSS_MON_1 "" VALUE 0x40efc _REC_VAL_20_u1 255. _CNV_A_R_LINEAR_____10_CM 0. 255. FORMAT "%3.0" /end CHARACTERISTIC
/begin CHARACTERISTIC ID_ERR_DTC_OBD2_LSH_UP_1 "" CURVE 0x4112c _REC_CUR_20_u2_u2 65535. _CNV_A_R_LINEAR_____10_CM 0. 65535. FORMAT "%5.0"
 /begin AXIS_DESCR COM_AXIS ONLINE_DUMMY _CNV_A_R_LINEAR_____12_CM 6 0. 5. FORMAT "%2.0" AXIS_PTS_REF ldp_fmy_dtc /end AXIS_DESCR
/end CHARACTERISTIC
/begin CHARACTERISTIC C_ERR_CLAS_OBD2_LSH_UP_1 "" VALUE 0x4113c _REC_VAL_20_u1 255. _CNV_A_R_LINEAR_____10_CM 0. 255. FORMAT "%3.0" /end CHARACTERISTIC
/begin CHARACTERISTIC ID_ERR_DTC_DIAGCPS "" CURVE 0x41228 _REC_CUR_20_u2_u2 65535. _CNV_A_R_LINEAR_____10_CM 0. 65535. FORMAT "%5.0"
 /begin AXIS_DESCR COM_AXIS ONLINE_DUMMY _CNV_A_R_LINEAR_____12_CM 6 0. 5. FORMAT "%2.0" AXIS_PTS_REF ldp_fmy_dtc /end AXIS_DESCR
/end CHARACTERISTIC
/begin CHARACTERISTIC C_ERR_CLAS_DIAGCPS "" VALUE 0x41238 _REC_VAL_20_u1 255. _CNV_A_R_LINEAR_____10_CM 0. 255. FORMAT "%3.0" /end CHARACTERISTIC
/begin CHARACTERISTIC ID_ERR_DTC_OBD2_LSH_UP_2 "" CURVE 0x4113e _REC_CUR_20_u2_u2 65535. _CNV_A_R_LINEAR_____10_CM 0. 65535. FORMAT "%5.0"
 /begin AXIS_DESCR COM_AXIS ONLINE_DUMMY _CNV_A_R_LINEAR_____12_CM 6 0. 5. FORMAT "%2.0" AXIS_PTS_REF ldp_fmy_dtc /end AXIS_DESCR
/end CHARACTERISTIC
/begin CHARACTERISTIC C_ERR_CLAS_OBD2_LSH_UP_2 "" VALUE 0x4114e _REC_VAL_20_u1 255. _CNV_A_R_LINEAR_____10_CM 0. 255. FORMAT "%3.0" /end CHARACTERISTIC
/begin CHARACTERISTIC ID_ERR_DTC_TOOTH_PER "" CURVE 0x40c52 _REC_CUR_20_u2_u2 65535. _CNV_A_R_LINEAR_____10_CM 0. 65535. FORMAT "%5.0"
 /begin AXIS_DESCR COM_AXIS ONLINE_DUMMY _CNV_A_R_LINEAR_____12_CM 6 0. 5. FORMAT "%2.0" AXIS_PTS_REF ldp_fmy_dtc /end AXIS_DESCR
/end CHARACTERISTIC
/begin CHARACTERISTIC C_ERR_CLAS_TOOTH_PER "" VALUE 0x40c62 _REC_VAL_20_u1 255. _CNV_A_R_LINEAR_____10_CM 0. 255. FORMAT "%3.0" /end CHARACTERISTIC
/begin CHARACTERISTIC ID_ERR_DTC_TPS_1 "" CURVE 0x40a5a _REC_CUR_20_u2_u2 65535. _CNV_A_R_LINEAR_____10_CM 0. 65535. FORMAT "%5.0"
 /begin AXIS_DESCR COM_AXIS ONLINE_DUMMY _CNV_A_R_LINEAR_____12_CM 6 0. 5. FORMAT "%2.0" AXIS_PTS_REF ldp_fmy_dtc /end AXIS_DESCR
/end CHARACTERISTIC
/begin CHARACTERISTIC C_ERR_CLAS_TPS_1 "" VALUE 0x40a6a _REC_VAL_20_u1 255. _CNV_A_R_LINEAR_____10_CM 0. 255. FORMAT "%3.0" /end CHARACTERISTIC
/begin CHARACTERISTIC ID_ERR_DTC_TPS_2 "" CURVE 0x40a6c _REC_CUR_20_u2_u2 65535. _CNV_A_R_LINEAR_____10_CM 0. 65535. FORMAT "%5.0"
 /begin AXIS_DESCR COM_AXIS ONLINE_DUMMY _CNV_A_R_LINEAR_____12_CM 6 0. 5. FORMAT "%2.0" AXIS_PTS_REF ldp_fmy_dtc /end AXIS_DESCR
/end CHARACTERISTIC
/begin CHARACTERISTIC C_ERR_CLAS_TPS_2 "" VALUE 0x40a7c _REC_VAL_20_u1 255. _CNV_A_R_LINEAR_____10_CM 0. 255. FORMAT "%3.0" /end CHARACTERISTIC
/begin CHARACTERISTIC ID_ERR_DTC_DMTL_LEAK "" CURVE 0x411aa _REC_CUR_20_u2_u2 65535. _CNV_A_R_LINEAR_____10_CM 0. 65535. FORMAT "%5.0"
 /begin AXIS_DESCR COM_AXIS ONLINE_DUMMY _CNV_A_R_LINEAR_____12_CM 6 0. 5. FORMAT "%2.0" AXIS_PTS_REF ldp_fmy_dtc /end AXIS_DESCR
/end CHARACTERISTIC
/begin CHARACTERISTIC C_ERR_CLAS_DMTL_LEAK "" VALUE 0x411ba _REC_VAL_20_u1 255. _CNV_A_R_LINEAR_____10_CM 0. 255. FORMAT "%3.0" /end CHARACTERISTIC
/begin CHARACTERISTIC ID_ERR_DTC_TQI_LIM "" CURVE 0x41108 _REC_CUR_20_u2_u2 65535. _CNV_A_R_LINEAR_____10_CM 0. 65535. FORMAT "%5.0"
 /begin AXIS_DESCR COM_AXIS ONLINE_DUMMY _CNV_A_R_LINEAR_____12_CM 6 0. 5. FORMAT "%2.0" AXIS_PTS_REF ldp_fmy_dtc /end AXIS_DESCR
/end CHARACTERISTIC
/begin CHARACTERISTIC C_ERR_CLAS_TQI_LIM "" VALUE 0x41118 _REC_VAL_20_u1 255. _CNV_A_R_LINEAR_____10_CM 0. 255. FORMAT "%3.0" /end CHARACTERISTIC
/begin CHARACTERISTIC ID_ERR_DTC_IM_BLS_PLAUS "" CURVE 0x40d96 _REC_CUR_20_u2_u2 65535. _CNV_A_R_LINEAR_____10_CM 0. 65535. FORMAT "%5.0"
 /begin AXIS_DESCR COM_AXIS ONLINE_DUMMY _CNV_A_R_LINEAR_____12_CM 6 0. 5. FORMAT "%2.0" AXIS_PTS_REF ldp_fmy_dtc /end AXIS_DESCR
/end CHARACTERISTIC
/begin CHARACTERISTIC C_ERR_CLAS_IM_BLS_PLAUS "" VALUE 0x40da6 _REC_VAL_20_u1 255. _CNV_A_R_LINEAR_____10_CM 0. 255. FORMAT "%3.0" /end CHARACTERISTIC
/begin CHARACTERISTIC ID_ERR_DTC_TQI_N_MAX_NVMY_MON "" CURVE 0x40fb2 _REC_CUR_20_u2_u2 65535. _CNV_A_R_LINEAR_____10_CM 0. 65535. FORMAT "%5.0"
 /begin AXIS_DESCR COM_AXIS ONLINE_DUMMY _CNV_A_R_LINEAR_____12_CM 6 0. 5. FORMAT "%2.0" AXIS_PTS_REF ldp_fmy_dtc /end AXIS_DESCR
/end CHARACTERISTIC
/begin CHARACTERISTIC C_ERR_CLAS_TQI_N_MAX_NVMY_MON "" VALUE 0x40fc2 _REC_VAL_20_u1 255. _CNV_A_R_LINEAR_____10_CM 0. 255. FORMAT "%3.0" /end CHARACTERISTIC
/begin CHARACTERISTIC ID_ERR_DTC_VS "" CURVE 0x4094c _REC_CUR_20_u2_u2 65535. _CNV_A_R_LINEAR_____10_CM 0. 65535. FORMAT "%5.0"
 /begin AXIS_DESCR COM_AXIS ONLINE_DUMMY _CNV_A_R_LINEAR_____12_CM 6 0. 5. FORMAT "%2.0" AXIS_PTS_REF ldp_fmy_dtc /end AXIS_DESCR
/end CHARACTERISTIC
/begin CHARACTERISTIC C_ERR_CLAS_VS "" VALUE 0x4095c _REC_VAL_20_u1 255. _CNV_A_R_LINEAR_____10_CM 0. 255. FORMAT "%3.0" /end CHARACTERISTIC
/begin CHARACTERISTIC ID_ERR_DTC_TOUT_EFP "" CURVE 0x41216 _REC_CUR_20_u2_u2 65535. _CNV_A_R_LINEAR_____10_CM 0. 65535. FORMAT "%5.0"
 /begin AXIS_DESCR COM_AXIS ONLINE_DUMMY _CNV_A_R_LINEAR_____12_CM 6 0. 5. FORMAT "%2.0" AXIS_PTS_REF ldp_fmy_dtc /end AXIS_DESCR
/end CHARACTERISTIC
/begin CHARACTERISTIC C_ERR_CLAS_TOUT_EFP "" VALUE 0x41226 _REC_VAL_20_u1 255. _CNV_A_R_LINEAR_____10_CM 0. 255. FORMAT "%3.0" /end CHARACTERISTIC
/begin CHARACTERISTIC ID_ERR_DTC_EFP_TEMP "" CURVE 0x41444 _REC_CUR_20_u2_u2 65535. _CNV_A_R_LINEAR_____10_CM 0. 65535. FORMAT "%5.0"
 /begin AXIS_DESCR COM_AXIS ONLINE_DUMMY _CNV_A_R_LINEAR_____12_CM 6 0. 5. FORMAT "%2.0" AXIS_PTS_REF ldp_fmy_dtc /end AXIS_DESCR
/end CHARACTERISTIC
/begin CHARACTERISTIC C_ERR_CLAS_EFP_TEMP "" VALUE 0x41454 _REC_VAL_20_u1 255. _CNV_A_R_LINEAR_____10_CM 0. 255. FORMAT "%3.0" /end CHARACTERISTIC
/begin CHARACTERISTIC ID_ERR_DTC_EFP_LIH "" CURVE 0x41456 _REC_CUR_20_u2_u2 65535. _CNV_A_R_LINEAR_____10_CM 0. 65535. FORMAT "%5.0"
 /begin AXIS_DESCR COM_AXIS ONLINE_DUMMY _CNV_A_R_LINEAR_____12_CM 6 0. 5. FORMAT "%2.0" AXIS_PTS_REF ldp_fmy_dtc /end AXIS_DESCR
/end CHARACTERISTIC
/begin CHARACTERISTIC C_ERR_CLAS_EFP_LIH "" VALUE 0x41466 _REC_VAL_20_u1 255. _CNV_A_R_LINEAR_____10_CM 0. 255. FORMAT "%3.0" /end CHARACTERISTIC
/begin CHARACTERISTIC ID_ERR_DTC_TPS_ST_CHK_1 "" CURVE 0x40b7a _REC_CUR_20_u2_u2 65535. _CNV_A_R_LINEAR_____10_CM 0. 65535. FORMAT "%5.0"
 /begin AXIS_DESCR COM_AXIS ONLINE_DUMMY _CNV_A_R_LINEAR_____12_CM 6 0. 5. FORMAT "%2.0" AXIS_PTS_REF ldp_fmy_dtc /end AXIS_DESCR
/end CHARACTERISTIC
/begin CHARACTERISTIC C_ERR_CLAS_TPS_ST_CHK_1 "" VALUE 0x40b8a _REC_VAL_20_u1 255. _CNV_A_R_LINEAR_____10_CM 0. 255. FORMAT "%3.0" /end CHARACTERISTIC
/begin CHARACTERISTIC ID_ERR_DTC_VLS_UP_MIN_1 "" CURVE 0x414f8 _REC_CUR_20_u2_u2 65535. _CNV_A_R_LINEAR_____10_CM 0. 65535. FORMAT "%5.0"
 /begin AXIS_DESCR COM_AXIS ONLINE_DUMMY _CNV_A_R_LINEAR_____12_CM 6 0. 5. FORMAT "%2.0" AXIS_PTS_REF ldp_fmy_dtc /end AXIS_DESCR
/end CHARACTERISTIC
/begin CHARACTERISTIC C_ERR_CLAS_VLS_UP_MIN_1 "" VALUE 0x41508 _REC_VAL_20_u1 255. _CNV_A_R_LINEAR_____10_CM 0. 255. FORMAT "%3.0" /end CHARACTERISTIC
/begin CHARACTERISTIC ID_ERR_DTC_TPS_ST_CHK_2 "" CURVE 0x40b8c _REC_CUR_20_u2_u2 65535. _CNV_A_R_LINEAR_____10_CM 0. 65535. FORMAT "%5.0"
 /begin AXIS_DESCR COM_AXIS ONLINE_DUMMY _CNV_A_R_LINEAR_____12_CM 6 0. 5. FORMAT "%2.0" AXIS_PTS_REF ldp_fmy_dtc /end AXIS_DESCR
/end CHARACTERISTIC
/begin CHARACTERISTIC C_ERR_CLAS_TPS_ST_CHK_2 "" VALUE 0x40b9c _REC_VAL_20_u1 255. _CNV_A_R_LINEAR_____10_CM 0. 255. FORMAT "%3.0" /end CHARACTERISTIC
/begin CHARACTERISTIC ID_ERR_DTC_VLS_UP_MIN_2 "" CURVE 0x4150a _REC_CUR_20_u2_u2 65535. _CNV_A_R_LINEAR_____10_CM 0. 65535. FORMAT "%5.0"
 /begin AXIS_DESCR COM_AXIS ONLINE_DUMMY _CNV_A_R_LINEAR_____12_CM 6 0. 5. FORMAT "%2.0" AXIS_PTS_REF ldp_fmy_dtc /end AXIS_DESCR
/end CHARACTERISTIC
/begin CHARACTERISTIC C_ERR_CLAS_VLS_UP_MIN_2 "" VALUE 0x4151a _REC_VAL_20_u1 255. _CNV_A_R_LINEAR_____10_CM 0. 255. FORMAT "%3.0" /end CHARACTERISTIC
/begin CHARACTERISTIC ID_ERR_DTC_GEN_IF "" CURVE 0x40bb0 _REC_CUR_20_u2_u2 65535. _CNV_A_R_LINEAR_____10_CM 0. 65535. FORMAT "%5.0"
 /begin AXIS_DESCR COM_AXIS ONLINE_DUMMY _CNV_A_R_LINEAR_____12_CM 6 0. 5. FORMAT "%2.0" AXIS_PTS_REF ldp_fmy_dtc /end AXIS_DESCR
/end CHARACTERISTIC
/begin CHARACTERISTIC C_ERR_CLAS_GEN_IF "" VALUE 0x40bc0 _REC_VAL_20_u1 255. _CNV_A_R_LINEAR_____10_CM 0. 255. FORMAT "%3.0" /end CHARACTERISTIC
/begin CHARACTERISTIC ID_ERR_DTC_TPS_AD_BOL "" CURVE 0x40b68 _REC_CUR_20_u2_u2 65535. _CNV_A_R_LINEAR_____10_CM 0. 65535. FORMAT "%5.0"
 /begin AXIS_DESCR COM_AXIS ONLINE_DUMMY _CNV_A_R_LINEAR_____12_CM 6 0. 5. FORMAT "%2.0" AXIS_PTS_REF ldp_fmy_dtc /end AXIS_DESCR
/end CHARACTERISTIC
/begin CHARACTERISTIC C_ERR_CLAS_TPS_AD_BOL "" VALUE 0x40b78 _REC_VAL_20_u1 255. _CNV_A_R_LINEAR_____10_CM 0. 255. FORMAT "%3.0" /end CHARACTERISTIC
/begin CHARACTERISTIC ID_ERR_DTC_OBD2_LSH_DOWN_1 "" CURVE 0x41150 _REC_CUR_20_u2_u2 65535. _CNV_A_R_LINEAR_____10_CM 0. 65535. FORMAT "%5.0"
 /begin AXIS_DESCR COM_AXIS ONLINE_DUMMY _CNV_A_R_LINEAR_____12_CM 6 0. 5. FORMAT "%2.0" AXIS_PTS_REF ldp_fmy_dtc /end AXIS_DESCR
/end CHARACTERISTIC
/begin CHARACTERISTIC C_ERR_CLAS_OBD2_LSH_DOWN_1 "" VALUE 0x41160 _REC_VAL_20_u1 255. _CNV_A_R_LINEAR_____10_CM 0. 255. FORMAT "%3.0" /end CHARACTERISTIC
/begin CHARACTERISTIC ID_ERR_DTC_VLS_DOWN_MIN_1 "" CURVE 0x4067c _REC_CUR_20_u2_u2 65535. _CNV_A_R_LINEAR_____10_CM 0. 65535. FORMAT "%5.0"
 /begin AXIS_DESCR COM_AXIS ONLINE_DUMMY _CNV_A_R_LINEAR_____12_CM 6 0. 5. FORMAT "%2.0" AXIS_PTS_REF ldp_fmy_dtc /end AXIS_DESCR
/end CHARACTERISTIC
/begin CHARACTERISTIC C_ERR_CLAS_VLS_DOWN_MIN_1 "" VALUE 0x4068c _REC_VAL_20_u1 255. _CNV_A_R_LINEAR_____10_CM 0. 255. FORMAT "%3.0" /end CHARACTERISTIC
/begin CHARACTERISTIC ID_ERR_DTC_TCO_GRD "" CURVE 0x40d3c _REC_CUR_20_u2_u2 65535. _CNV_A_R_LINEAR_____10_CM 0. 65535. FORMAT "%5.0"
 /begin AXIS_DESCR COM_AXIS ONLINE_DUMMY _CNV_A_R_LINEAR_____12_CM 6 0. 5. FORMAT "%2.0" AXIS_PTS_REF ldp_fmy_dtc /end AXIS_DESCR
/end CHARACTERISTIC
/begin CHARACTERISTIC C_ERR_CLAS_TCO_GRD "" VALUE 0x40d4c _REC_VAL_20_u1 255. _CNV_A_R_LINEAR_____10_CM 0. 255. FORMAT "%3.0" /end CHARACTERISTIC
/begin CHARACTERISTIC ID_ERR_DTC_OBD2_LSH_DOWN_2 "" CURVE 0x41162 _REC_CUR_20_u2_u2 65535. _CNV_A_R_LINEAR_____10_CM 0. 65535. FORMAT "%5.0"
 /begin AXIS_DESCR COM_AXIS ONLINE_DUMMY _CNV_A_R_LINEAR_____12_CM 6 0. 5. FORMAT "%2.0" AXIS_PTS_REF ldp_fmy_dtc /end AXIS_DESCR
/end CHARACTERISTIC
/begin CHARACTERISTIC C_ERR_CLAS_OBD2_LSH_DOWN_2 "" VALUE 0x41172 _REC_VAL_20_u1 255. _CNV_A_R_LINEAR_____10_CM 0. 255. FORMAT "%3.0" /end CHARACTERISTIC
/begin CHARACTERISTIC ID_ERR_DTC_VLS_DOWN_MIN_2 "" CURVE 0x4068e _REC_CUR_20_u2_u2 65535. _CNV_A_R_LINEAR_____10_CM 0. 65535. FORMAT "%5.0"
 /begin AXIS_DESCR COM_AXIS ONLINE_DUMMY _CNV_A_R_LINEAR_____12_CM 6 0. 5. FORMAT "%2.0" AXIS_PTS_REF ldp_fmy_dtc /end AXIS_DESCR
/end CHARACTERISTIC
/begin CHARACTERISTIC C_ERR_CLAS_VLS_DOWN_MIN_2 "" VALUE 0x4069e _REC_VAL_20_u1 255. _CNV_A_R_LINEAR_____10_CM 0. 255. FORMAT "%3.0" /end CHARACTERISTIC
/begin CHARACTERISTIC ID_ERR_DTC_IM_BTS_PLAUS "" CURVE 0x40da8 _REC_CUR_20_u2_u2 65535. _CNV_A_R_LINEAR_____10_CM 0. 65535. FORMAT "%5.0"
 /begin AXIS_DESCR COM_AXIS ONLINE_DUMMY _CNV_A_R_LINEAR_____12_CM 6 0. 5. FORMAT "%2.0" AXIS_PTS_REF ldp_fmy_dtc /end AXIS_DESCR
/end CHARACTERISTIC
/begin CHARACTERISTIC C_ERR_CLAS_IM_BTS_PLAUS "" VALUE 0x40db8 _REC_VAL_20_u1 255. _CNV_A_R_LINEAR_____10_CM 0. 255. FORMAT "%3.0" /end CHARACTERISTIC
/begin CHARACTERISTIC ID_ERR_DTC_REF_IVVT_IN_1 "" CURVE 0x40808 _REC_CUR_20_u2_u2 65535. _CNV_A_R_LINEAR_____10_CM 0. 65535. FORMAT "%5.0"
 /begin AXIS_DESCR COM_AXIS ONLINE_DUMMY _CNV_A_R_LINEAR_____12_CM 6 0. 5. FORMAT "%2.0" AXIS_PTS_REF ldp_fmy_dtc /end AXIS_DESCR
/end CHARACTERISTIC
/begin CHARACTERISTIC C_ERR_CLAS_REF_IVVT_IN_1 "" VALUE 0x40818 _REC_VAL_20_u1 255. _CNV_A_R_LINEAR_____10_CM 0. 255. FORMAT "%3.0" /end CHARACTERISTIC
/begin CHARACTERISTIC ID_ERR_DTC_REF_IVVT_IN_2 "" CURVE 0x4081a _REC_CUR_20_u2_u2 65535. _CNV_A_R_LINEAR_____10_CM 0. 65535. FORMAT "%5.0"
 /begin AXIS_DESCR COM_AXIS ONLINE_DUMMY _CNV_A_R_LINEAR_____12_CM 6 0. 5. FORMAT "%2.0" AXIS_PTS_REF ldp_fmy_dtc /end AXIS_DESCR
/end CHARACTERISTIC
/begin CHARACTERISTIC C_ERR_CLAS_REF_IVVT_IN_2 "" VALUE 0x4082a _REC_VAL_20_u1 255. _CNV_A_R_LINEAR_____10_CM 0. 255. FORMAT "%3.0" /end CHARACTERISTIC
/begin CHARACTERISTIC ID_ERR_DTC_BN_TQ_ETCU "" CURVE 0x41300 _REC_CUR_20_u2_u2 65535. _CNV_A_R_LINEAR_____10_CM 0. 65535. FORMAT "%5.0"
 /begin AXIS_DESCR COM_AXIS ONLINE_DUMMY _CNV_A_R_LINEAR_____12_CM 6 0. 5. FORMAT "%2.0" AXIS_PTS_REF ldp_fmy_dtc /end AXIS_DESCR
/end CHARACTERISTIC
/begin CHARACTERISTIC C_ERR_CLAS_BN_TQ_ETCU "" VALUE 0x41310 _REC_VAL_20_u1 255. _CNV_A_R_LINEAR_____10_CM 0. 255. FORMAT "%3.0" /end CHARACTERISTIC
/begin CHARACTERISTIC ID_ERR_DTC_TQ_MIN_CLU_MON_1 "" CURVE 0x40efe _REC_CUR_20_u2_u2 65535. _CNV_A_R_LINEAR_____10_CM 0. 65535. FORMAT "%5.0"
 /begin AXIS_DESCR COM_AXIS ONLINE_DUMMY _CNV_A_R_LINEAR_____12_CM 6 0. 5. FORMAT "%2.0" AXIS_PTS_REF ldp_fmy_dtc /end AXIS_DESCR
/end CHARACTERISTIC
/begin CHARACTERISTIC C_ERR_CLAS_TQ_MIN_CLU_MON_1 "" VALUE 0x40f0e _REC_VAL_20_u1 255. _CNV_A_R_LINEAR_____10_CM 0. 255. FORMAT "%3.0" /end CHARACTERISTIC
/begin MEASUREMENT LV_ERR_SA_SAFM "Present failure: Component Secondary air flow meter failure" UBYTE _CNV_S_2_RANGE______21_R_CM 1 100. 0. 255. ECU_ADDRESS 0x3fd587 /end MEASUREMENT
/begin CHARACTERISTIC ID_ERR_DTC_BN_VEH_MOD "" CURVE 0x4135a _REC_CUR_20_u2_u2 65535. _CNV_A_R_LINEAR_____10_CM 0. 65535. FORMAT "%5.0"
 /begin AXIS_DESCR COM_AXIS ONLINE_DUMMY _CNV_A_R_LINEAR_____12_CM 6 0. 5. FORMAT "%2.0" AXIS_PTS_REF ldp_fmy_dtc /end AXIS_DESCR
/end CHARACTERISTIC
/begin CHARACTERISTIC C_ERR_CLAS_BN_VEH_MOD "" VALUE 0x4136a _REC_VAL_20_u1 255. _CNV_A_R_LINEAR_____10_CM 0. 255. FORMAT "%3.0" /end CHARACTERISTIC
/begin CHARACTERISTIC ID_ERR_DTC_QOIL_SENS "" CURVE 0x4149e _REC_CUR_20_u2_u2 65535. _CNV_A_R_LINEAR_____10_CM 0. 65535. FORMAT "%5.0"
 /begin AXIS_DESCR COM_AXIS ONLINE_DUMMY _CNV_A_R_LINEAR_____12_CM 6 0. 5. FORMAT "%2.0" AXIS_PTS_REF ldp_fmy_dtc /end AXIS_DESCR
/end CHARACTERISTIC
/begin CHARACTERISTIC C_ERR_CLAS_QOIL_SENS "" VALUE 0x414ae _REC_VAL_20_u1 255. _CNV_A_R_LINEAR_____10_CM 0. 255. FORMAT "%3.0" /end CHARACTERISTIC
/begin CHARACTERISTIC ID_ERR_DTC_EF "" CURVE 0x410c0 _REC_CUR_20_u2_u2 65535. _CNV_A_R_LINEAR_____10_CM 0. 65535. FORMAT "%5.0"
 /begin AXIS_DESCR COM_AXIS ONLINE_DUMMY _CNV_A_R_LINEAR_____12_CM 6 0. 5. FORMAT "%2.0" AXIS_PTS_REF ldp_fmy_dtc /end AXIS_DESCR
/end CHARACTERISTIC
/begin CHARACTERISTIC C_ERR_CLAS_EF "" VALUE 0x410d0 _REC_VAL_20_u1 255. _CNV_A_R_LINEAR_____10_CM 0. 255. FORMAT "%3.0" /end CHARACTERISTIC
/begin CHARACTERISTIC ID_ERR_DTC_TOIL_LEVEL "" CURVE 0x408aa _REC_CUR_20_u2_u2 65535. _CNV_A_R_LINEAR_____10_CM 0. 65535. FORMAT "%5.0"
 /begin AXIS_DESCR COM_AXIS ONLINE_DUMMY _CNV_A_R_LINEAR_____12_CM 6 0. 5. FORMAT "%2.0" AXIS_PTS_REF ldp_fmy_dtc /end AXIS_DESCR
/end CHARACTERISTIC
/begin CHARACTERISTIC C_ERR_CLAS_TOIL_LEVEL "" VALUE 0x408ba _REC_VAL_20_u1 255. _CNV_A_R_LINEAR_____10_CM 0. 255. FORMAT "%3.0" /end CHARACTERISTIC
/begin CHARACTERISTIC ID_ERR_DTC_AMP "" CURVE 0x40610 _REC_CUR_20_u2_u2 65535. _CNV_A_R_LINEAR_____10_CM 0. 65535. FORMAT "%5.0"
 /begin AXIS_DESCR COM_AXIS ONLINE_DUMMY _CNV_A_R_LINEAR_____12_CM 6 0. 5. FORMAT "%2.0" AXIS_PTS_REF ldp_fmy_dtc /end AXIS_DESCR
/end CHARACTERISTIC
/begin CHARACTERISTIC C_ERR_CLAS_AMP "" VALUE 0x40620 _REC_VAL_20_u1 255. _CNV_A_R_LINEAR_____10_CM 0. 255. FORMAT "%3.0" /end CHARACTERISTIC
/begin CHARACTERISTIC ID_ERR_DTC_RLY_MAIN_DLY "" CURVE 0x40cbe _REC_CUR_20_u2_u2 65535. _CNV_A_R_LINEAR_____10_CM 0. 65535. FORMAT "%5.0"
 /begin AXIS_DESCR COM_AXIS ONLINE_DUMMY _CNV_A_R_LINEAR_____12_CM 6 0. 5. FORMAT "%2.0" AXIS_PTS_REF ldp_fmy_dtc /end AXIS_DESCR
/end CHARACTERISTIC
/begin CHARACTERISTIC C_ERR_CLAS_RLY_MAIN_DLY "" VALUE 0x40cce _REC_VAL_20_u1 255. _CNV_A_R_LINEAR_____10_CM 0. 255. FORMAT "%3.0" /end CHARACTERISTIC
/begin MEASUREMENT SYM_CYL_MEM_MIS_A "" UWORD _CNV_A_R_LINEAR_____10_CM 1 100. 0. 65535. ECU_ADDRESS 0x3fd6ec FORMAT "%5.0" /end MEASUREMENT
/begin MEASUREMENT SYM_CYL_MEM_MIS_B4 "" UWORD _CNV_A_R_LINEAR_____10_CM 1 100. 0. 65535. ECU_ADDRESS 0x3fd6f0 FORMAT "%5.0" /end MEASUREMENT
/begin MEASUREMENT SYM_CYL_MEM_MIS_B1 "" UWORD _CNV_A_R_LINEAR_____10_CM 1 100. 0. 65535. ECU_ADDRESS 0x3fd6ee FORMAT "%5.0" /end MEASUREMENT
/begin MEASUREMENT LOAD_CLC "Calculated load" UBYTE _CNV_A_R_LINEAR_____4_CM 1 100. 0. 99.609375 ECU_ADDRESS 0x3fe8ab FORMAT "%4.1" /end MEASUREMENT
/begin MEASUREMENT STATE_LS_1 "Fuel system status bank i" UBYTE _CNV_S_4_STATE_LS_188_CM 1 100. 1. 8. ECU_ADDRESS 0x3fe8ac /end MEASUREMENT
/begin MEASUREMENT STATE_LS_2 "Fuel system status bank i" UBYTE _CNV_S_4_STATE_LS_188_CM 1 100. 1. 8. ECU_ADDRESS 0x3fe8ad /end MEASUREMENT
/begin AXIS_PTS ldp_amp_ip_load_clc_amp "" 0x4413e AMP _REC_AXS_20_u2 5434. _CNV_A_R_LINEAR_____43_CM 6 0. 5434. FORMAT "%7.2" /end AXIS_PTS
/begin AXIS_PTS ldp_n_32_ip_load_clc "" 0x436ad N_32 _REC_AXS_20_u1 8160. _CNV_A_R_LINEAR_____5_CM 8 0. 8160. FORMAT "%4.0" /end AXIS_PTS
/begin AXIS_PTS ldp_maf_ip_load_clc "" 0x445c6 MAF _REC_AXS_20_u2 1389. _CNV_A_R_LINEAR_____95_CM 8 0. 1389. FORMAT "%7.2" /end AXIS_PTS
/begin CHARACTERISTIC IP_LOAD_CLC_AMP__AMP "Atmospheric pressure ratio" CURVE 0x4fab3 _REC_CUR_20_u1_u2 1.99220002 _CNV_A_R_LINEAR_____34_CM 0. 1.99220002 FORMAT "%5.3"
 /begin AXIS_DESCR COM_AXIS AMP _CNV_A_R_LINEAR_____43_CM 6 0. 5434. FORMAT "%7.2" AXIS_PTS_REF ldp_amp_ip_load_clc_amp /end AXIS_DESCR
/end CHARACTERISTIC
/begin CHARACTERISTIC IP_LOAD_CLC__N_32__MAF "Airflow ratio" MAP 0x4fa73 _REC_MAP_20_u1_u1_u2 0.9960940000000002 _CNV_A_R_LINEAR_____44_CM 0. 0.996094 FORMAT "%5.3"
 /begin AXIS_DESCR COM_AXIS N_32 _CNV_A_R_LINEAR_____5_CM 8 0. 8160. FORMAT "%4.0" AXIS_PTS_REF ldp_n_32_ip_load_clc /end AXIS_DESCR
 /begin AXIS_DESCR COM_AXIS MAF _CNV_A_R_LINEAR_____95_CM 8 0. 1389. FORMAT "%7.2" AXIS_PTS_REF ldp_maf_ip_load_clc /end AXIS_DESCR
/end CHARACTERISTIC
/begin MEASUREMENT LV_INH_DIAG_FSD_CP "Deactivation bit for fuel system diagnosis due to internal states of the CP-function" UBYTE _CNV_S_2_RANGE______28_CM 1 100. 0. 1. ECU_ADDRESS 0x3fd030 BIT_MASK 0x1 /end MEASUREMENT
/begin CHARACTERISTIC C_CL_MMV_MAX_FSD "Maximum value for CL_MMV to permit FSD" VALUE 0x42c54 _REC_VAL_20_u2 1.99996948 _CNV_A_R_LINEAR_____45_CM 0. 1.99996948 FORMAT "%7.5" /end CHARACTERISTIC
/begin CHARACTERISTIC LC_INH_FSD_MAN_DEAC "Manual deactivation of FSD inhibitation" VALUE 0x42b93 _REC_VAL_20_u1 1. _CNV_A_R_LINEAR_____12_CM 0. 1. FORMAT "%2.0" /end CHARACTERISTIC
/begin MEASUREMENT LV_ERR_DET_FSD_1 "Error detection flag FSD diagnosis" UBYTE _CNV_S_2_RANGE______28_CM 1 100. 0. 1. ECU_ADDRESS 0x3fd02d BIT_MASK 0x1 /end MEASUREMENT
/begin MEASUREMENT LV_ERR_DET_FSD_2 "Error detection flag FSD diagnosis" UBYTE _CNV_S_2_RANGE______28_CM 1 100. 0. 1. ECU_ADDRESS 0x3fd02e BIT_MASK 0x1 /end MEASUREMENT
/begin MEASUREMENT LV_INH_DIAG_FSD "Deactivation bit for fuel system diagnosis due to errors" UBYTE _CNV_S_2_RANGE______28_CM 1 100. 0. 1. ECU_ADDRESS 0x3fd02f BIT_MASK 0x1 /end MEASUREMENT
/begin CHARACTERISTIC ID_ERR_DTC_ISC "" CURVE 0x40d84 _REC_CUR_20_u2_u2 65535. _CNV_A_R_LINEAR_____10_CM 0. 65535. FORMAT "%5.0"
 /begin AXIS_DESCR COM_AXIS ONLINE_DUMMY _CNV_A_R_LINEAR_____12_CM 6 0. 5. FORMAT "%2.0" AXIS_PTS_REF ldp_fmy_dtc /end AXIS_DESCR
/end CHARACTERISTIC
/begin CHARACTERISTIC C_ERR_CLAS_ISC "" VALUE 0x40d94 _REC_VAL_20_u1 255. _CNV_A_R_LINEAR_____10_CM 0. 255. FORMAT "%3.0" /end CHARACTERISTIC
/begin MEASUREMENT LV_INH_DIAG_OBD2_LSH_DOWN_1 "" ULONG _CNV_S_2_RANGE______28_CM 1 100. 0. 1. ECU_ADDRESS 0x3fa804 BIT_MASK 0x80000000 /end MEASUREMENT
/begin MEASUREMENT POW_INT_OBD2_LSH_DOWN_1 "Integral indicates measure of cooling energy of exhaust gas at sensor location" UWORD _CNV_A_R_LINEAR_____294_CM 1 100. 0. 65535. ECU_ADDRESS 0x3fa80a FORMAT "%5.0" /end MEASUREMENT
/begin MEASUREMENT STATE_OBD2_LSH_DOWN_1 "Indicates current phase of oxygen sensor heater OBDII diagnosis" UBYTE _CNV_S_9_STATE_OBD2_295_CM 1 100. 0. 8. ECU_ADDRESS 0x3fa808 /end MEASUREMENT
/begin MEASUREMENT TCC_OBD2_LSH_DOWN_1 "Number of completed valid diagnosis cycles" UWORD _CNV_A_R_LINEAR_____12_CM 1 100. 0. 1023. ECU_ADDRESS 0x3fa80c FORMAT "%4.0" /end MEASUREMENT
/begin MEASUREMENT FRC_OBD2_LSH_DOWN_1 "Number of faults detected during valid diagnosis cycles" UWORD _CNV_A_R_LINEAR_____12_CM 1 100. 0. 1023. ECU_ADDRESS 0x3fa80e FORMAT "%4.0" /end MEASUREMENT
/begin MEASUREMENT CTR_CYCNR_R_OBD2_LSH_DOWN_1 "Value of handshake counter for last valid resistance value used for diagnosis" UWORD _CNV_A_R_LINEAR_____10_CM 1 100. 0. 65535. ECU_ADDRESS 0x3fa810 FORMAT "%5.0" /end MEASUREMENT
/begin MEASUREMENT R_DOWN_LS_OBD2_LSH_DOWN_1 "Most current upstream oxygen sensor internal resistance used for diagnosis cycle, Mode 6 information" UWORD _CNV_A_R_LINEAR_____10_CM 1 100. 0. 65535. ECU_ADDRESS 0x3fa812 FORMAT "%5.0" /end MEASUREMENT
/begin MEASUREMENT TEMP_DIF_OBD2_LSH_DOWN_1 "Indicates difference in temperature between set operating temperature & exhaust gas at sensor location" UWORD _CNV_A_R_LINEAR_____2_CM 1 100. 0. 2047. ECU_ADDRESS 0x3fa814 FORMAT "%4.0" /end MEASUREMENT
/begin MEASUREMENT LV_INH_DIAG_OBD2_LSH_DOWN_2 "" ULONG _CNV_S_2_RANGE______28_CM 1 100. 0. 1. ECU_ADDRESS 0x3fab1c BIT_MASK 0x80000000 /end MEASUREMENT
/begin MEASUREMENT POW_INT_OBD2_LSH_DOWN_2 "Integral indicates measure of cooling energy of exhaust gas at sensor location" UWORD _CNV_A_R_LINEAR_____294_CM 1 100. 0. 65535. ECU_ADDRESS 0x3fab22 FORMAT "%5.0" /end MEASUREMENT
/begin MEASUREMENT STATE_OBD2_LSH_DOWN_2 "Indicates current phase of oxygen sensor heater OBDII diagnosis" UBYTE _CNV_S_9_STATE_OBD2_295_CM 1 100. 0. 8. ECU_ADDRESS 0x3fab20 /end MEASUREMENT
/begin MEASUREMENT TCC_OBD2_LSH_DOWN_2 "Number of completed valid diagnosis cycles" UWORD _CNV_A_R_LINEAR_____12_CM 1 100. 0. 1023. ECU_ADDRESS 0x3fab24 FORMAT "%4.0" /end MEASUREMENT
/begin MEASUREMENT FRC_OBD2_LSH_DOWN_2 "Number of faults detected during valid diagnosis cycles" UWORD _CNV_A_R_LINEAR_____12_CM 1 100. 0. 1023. ECU_ADDRESS 0x3fab26 FORMAT "%4.0" /end MEASUREMENT
/begin MEASUREMENT CTR_CYCNR_R_OBD2_LSH_DOWN_2 "Value of handshake counter for last valid resistance value used for diagnosis" UWORD _CNV_A_R_LINEAR_____10_CM 1 100. 0. 65535. ECU_ADDRESS 0x3fab28 FORMAT "%5.0" /end MEASUREMENT
/begin MEASUREMENT R_DOWN_LS_OBD2_LSH_DOWN_2 "Most current upstream oxygen sensor internal resistance used for diagnosis cycle, Mode 6 information" UWORD _CNV_A_R_LINEAR_____10_CM 1 100. 0. 65535. ECU_ADDRESS 0x3fab2a FORMAT "%5.0" /end MEASUREMENT
/begin MEASUREMENT TEMP_DIF_OBD2_LSH_DOWN_2 "Indicates difference in temperature between set operating temperature & exhaust gas at sensor location" UWORD _CNV_A_R_LINEAR_____2_CM 1 100. 0. 2047. ECU_ADDRESS 0x3fab2c FORMAT "%4.0" /end MEASUREMENT
/begin MEASUREMENT LV_ERR_CHG_LS_DOWN "Debounced error: downstream sensor of bank 1 and 2 interchanged" UBYTE _CNV_S_2_RANGE______21_R_CM 1 100. 0. 255. ECU_ADDRESS 0x3fd697 /end MEASUREMENT
/begin CHARACTERISTIC C_MIN_LAM_MV_DIAG_CHG_LS_UP "Min. Threshold to detect a interchanged sensor" VALUE 0x43292 _REC_VAL_20_s2 99.99847412 _CNV_A_R_LINEAR_____98_CM -50. 49.99847412 FORMAT "%7.3" /end CHARACTERISTIC
/begin CHARACTERISTIC C_MAX_LAM_MV_DIAG_CHG_LS_UP "Max. Threshold to detect a interchanged sensor" VALUE 0x43286 _REC_VAL_20_s2 99.99847412 _CNV_A_R_LINEAR_____98_CM -50. 49.99847412 FORMAT "%7.3" /end CHARACTERISTIC
/begin CHARACTERISTIC C_T_END_DIAG_CHG_LS_UP "Max. time to set LV_END_... = 1" VALUE 0x42fcc _REC_VAL_20_u2 6553.5 _CNV_A_R_LINEAR_____14_CM 0. 6553.5 FORMAT "%6.1" /end CHARACTERISTIC
/begin CHARACTERISTIC C_T_END_DIAG_CHG_LS_DOWN "Max. time to set LV_END_... = 1" VALUE 0x42fca _REC_VAL_20_u2 6553.5 _CNV_A_R_LINEAR_____14_CM 0. 6553.5 FORMAT "%6.1" /end CHARACTERISTIC
/begin CHARACTERISTIC C_MAF_INT_DIAG_CHG_LS_UP "Max. MAF integral value when ERR_SYM_... ne \"NO_SYM\"" VALUE 0x42e2a _REC_VAL_20_u2 1820.398 _CNV_A_R_LINEAR_____277_CM 0. 1820.398 FORMAT "%7.2" /end CHARACTERISTIC
/begin CHARACTERISTIC C_MAF_INT_DIAG_CHG_LS_DOWN "Max. MAF integral value when ERR_SYM_... ne \"NO_SYM\"" VALUE 0x42e28 _REC_VAL_20_u2 1820.398 _CNV_A_R_LINEAR_____277_CM 0. 1820.398 FORMAT "%7.2" /end CHARACTERISTIC
/begin CHARACTERISTIC ID_ERR_DTC_CHG_LS_DOWN "" CURVE 0x4148c _REC_CUR_20_u2_u2 65535. _CNV_A_R_LINEAR_____10_CM 0. 65535. FORMAT "%5.0"
 /begin AXIS_DESCR COM_AXIS ONLINE_DUMMY _CNV_A_R_LINEAR_____12_CM 6 0. 5. FORMAT "%2.0" AXIS_PTS_REF ldp_fmy_dtc /end AXIS_DESCR
/end CHARACTERISTIC
/begin CHARACTERISTIC C_ERR_CLAS_CHG_LS_DOWN "" VALUE 0x4149c _REC_VAL_20_u1 255. _CNV_A_R_LINEAR_____10_CM 0. 255. FORMAT "%3.0" /end CHARACTERISTIC
/begin CHARACTERISTIC ID_ERR_DTC_CHG_LS_UP "" CURVE 0x4147a _REC_CUR_20_u2_u2 65535. _CNV_A_R_LINEAR_____10_CM 0. 65535. FORMAT "%5.0"
 /begin AXIS_DESCR COM_AXIS ONLINE_DUMMY _CNV_A_R_LINEAR_____12_CM 6 0. 5. FORMAT "%2.0" AXIS_PTS_REF ldp_fmy_dtc /end AXIS_DESCR
/end CHARACTERISTIC
/begin CHARACTERISTIC C_ERR_CLAS_CHG_LS_UP "" VALUE 0x4148a _REC_VAL_20_u1 255. _CNV_A_R_LINEAR_____10_CM 0. 255. FORMAT "%3.0" /end CHARACTERISTIC
/begin MEASUREMENT LV_ERR_CHG_LS_UP "Debounced error: upstream sensor of bank 1 and 2 interchanged" UBYTE _CNV_S_2_RANGE______21_R_CM 1 100. 0. 255. ECU_ADDRESS 0x3fd693 /end MEASUREMENT
/begin MEASUREMENT T_END_DIAG_CHG_LS_UP "Timer to set LV_END_...= 1" UWORD _CNV_A_R_LINEAR_____14_CM 1 100. 0. 6553.5 ECU_ADDRESS 0x3fe67a FORMAT "%6.1" /end MEASUREMENT
/begin MEASUREMENT T_END_DIAG_CHG_LS_DOWN "Timer to set LV_END_...= 1" UWORD _CNV_A_R_LINEAR_____14_CM 1 100. 0. 6553.5 ECU_ADDRESS 0x3fe67e FORMAT "%6.1" /end MEASUREMENT
/begin MEASUREMENT MAF_INT_DIAG_CHG_LS_UP "MAF integral value when ERR_SYM_...ne \"NO_SYM\"" UWORD _CNV_A_R_LINEAR_____277_CM 1 100. 0. 1820.398 ECU_ADDRESS 0x3fe678 FORMAT "%7.2" /end MEASUREMENT
/begin MEASUREMENT MAF_INT_DIAG_CHG_LS_DOWN "MAF integral value when ERR_SYM_...ne \"NO_SYM\"" UWORD _CNV_A_R_LINEAR_____277_CM 1 100. 0. 1820.398 ECU_ADDRESS 0x3fe67c FORMAT "%7.2" /end MEASUREMENT
/begin CHARACTERISTIC C_MIN_VLS_DIF_DLY_CHG_LS_DOWN "Min. Threshold to detect a interchanged sensor" VALUE 0x43294 _REC_VAL_20_s2 9.99023438 _CNV_A_R_LINEAR_____33_CM -4.99511719 4.99511719 FORMAT "%5.2" /end CHARACTERISTIC
/begin CHARACTERISTIC C_MAX_VLS_DIF_DLY_CHG_LS_DOWN "Max. Threshold to detect a interchanged sensor" VALUE 0x43288 _REC_VAL_20_s2 9.99023438 _CNV_A_R_LINEAR_____33_CM -4.99511719 4.99511719 FORMAT "%5.2" /end CHARACTERISTIC
/begin MEASUREMENT LV_INH_DIAG_CHG_LS_UP "inhibit diagnosis swapped upstream sensors" UBYTE _CNV_S_2_RANGE______28_CM 1 100. 0. 1. ECU_ADDRESS 0x3faf9f /end MEASUREMENT
/begin MEASUREMENT LV_INH_DIAG_CHG_LS_DOWN "inhibit diagnosis swapped downstream sensors" UBYTE _CNV_S_2_RANGE______28_CM 1 100. 0. 1. ECU_ADDRESS 0x3fafa0 /end MEASUREMENT
/begin MEASUREMENT LV_INH_LOAD_TPS_PLAUS "boolean flag to stop the load/TPS rationality check" UBYTE _CNV_S_2_RANGE______28_CM 1 100. 0. 1. ECU_ADDRESS 0x3fc6cc BIT_MASK 0x1 /end MEASUREMENT
/begin MEASUREMENT LV_BAS_THD_LOAD_TPS_PLAUS "Boolean flag to distinguish between 2 thresholds" UBYTE _CNV_S_2_RANGE______28_CM 1 100. 0. 1. ECU_ADDRESS 0x3fc6cd BIT_MASK 0x1 /end MEASUREMENT
/begin CHARACTERISTIC C_N_DIF_CRLC "Correlation factor for N_DIF_MMV calculation" VALUE 0x42936 _REC_VAL_20_u1 0.9960940000000002 _CNV_A_R_LINEAR_____44_CM 0. 0.996094 FORMAT "%5.3" /end CHARACTERISTIC
/begin CHARACTERISTIC C_N_DIF_MIN_MMV "Minimum filtering constant" VALUE 0x432ac _REC_VAL_20_s2 408. _CNV_A_R_LINEAR_____17_CM -4080. 0. FORMAT "%6.0" /end CHARACTERISTIC
/begin MEASUREMENT N_DIF_COR "Idle speed control value" SWORD _CNV_A_R_LINEAR_____17_CM 1 100. -4096. 4064. ECU_ADDRESS 0x3fcc2e FORMAT "%4.0" /end MEASUREMENT
/begin MEASUREMENT N_DIF_MMV "N_DIF moving mean value" SWORD _CNV_A_R_LINEAR_____17_CM 1 100. -8160. 8160. ECU_ADDRESS 0x3fdd46 FORMAT "%4.0" /end MEASUREMENT
/begin MEASUREMENT N_MAX_TOL_ST "Top level end of start engine speed" UBYTE _CNV_A_R_LINEAR_____5_CM 1 100. 0. 8160. ECU_ADDRESS 0x3fcc34 FORMAT "%4.0" /end MEASUREMENT
/begin CHARACTERISTIC C_N_DIF_FAC "Weighting factor for the idle speed variable controller" VALUE 0x42937 _REC_VAL_20_u1 0.9960940000000002 _CNV_A_R_LINEAR_____44_CM 0. 0.996094 FORMAT "%5.3" /end CHARACTERISTIC
/begin CHARACTERISTIC IP_DRI_ACIN_N_SP_IS "Nominal idle speed with DRIVE (A/T) engaged and air conditioner switched on" CURVE 0x46530 _REC_CUR_20_u2_u1 8160. _CNV_A_R_LINEAR_____17_CM 0. 8160. FORMAT "%4.0"
 /begin AXIS_DESCR COM_AXIS TCO _CNV_A_R_LINEAR_____0_CM 8 -48. 142.5 FORMAT "%5.1" AXIS_PTS_REF ldpm_tco_n_sp_1 /end AXIS_DESCR
/end CHARACTERISTIC
/begin MEASUREMENT N_DIF_ST "Engine speed deviation N_MAX_TOL_ST - N" SWORD _CNV_A_R_LINEAR_____17_CM 1 100. -32768. 32767. ECU_ADDRESS 0x3fcc30 FORMAT "%6.0" /end MEASUREMENT
/begin MEASUREMENT N_SP_IS_RATIO "Ratio actual engine speed versus engine speed setpoint at idle" UWORD _CNV_A_R_LINEAR_____348_CM 1 100. 0. 7.99987793 ECU_ADDRESS 0x3fcc32 FORMAT "%6.4" /end MEASUREMENT
/begin CHARACTERISTIC IP_DRI_N_SP_IS "Nominal idle speed with DRIVE  (A/T) engaged" CURVE 0x465c0 _REC_CUR_20_u2_u1 8160. _CNV_A_R_LINEAR_____17_CM 0. 8160. FORMAT "%4.0"
 /begin AXIS_DESCR COM_AXIS TCO _CNV_A_R_LINEAR_____0_CM 8 -48. 142.5 FORMAT "%5.1" AXIS_PTS_REF ldpm_tco_n_sp_1 /end AXIS_DESCR
/end CHARACTERISTIC
/begin CHARACTERISTIC C_DRI_VS_MIN_VB "Minimum vehicle speed for activating battery charging in case LV_DRI = 1" VALUE 0x42882 _REC_VAL_20_u1 255. _CNV_A_R_LINEAR_____13_CM 0. 255. FORMAT "%3.0" /end CHARACTERISTIC
/begin CHARACTERISTIC IP_N_SP_IS_LIH "Idle speed setpoint in case of limp home" CURVE 0x498ea _REC_CUR_20_u2_u1 8160. _CNV_A_R_LINEAR_____17_CM 0. 8160. FORMAT "%4.0"
 /begin AXIS_DESCR COM_AXIS TCO _CNV_A_R_LINEAR_____0_CM 8 -48. 142.5 FORMAT "%5.1" AXIS_PTS_REF ldpm_tco_n_sp_1 /end AXIS_DESCR
/end CHARACTERISTIC
/begin CHARACTERISTIC IP_DRI_N_SP_IS_LIH "Idle speed setpoint in case of limp home and engaged drivetrain" CURVE 0x465d0 _REC_CUR_20_u2_u1 8160. _CNV_A_R_LINEAR_____17_CM 0. 8160. FORMAT "%4.0"
 /begin AXIS_DESCR COM_AXIS TCO _CNV_A_R_LINEAR_____0_CM 8 -48. 142.5 FORMAT "%5.1" AXIS_PTS_REF ldpm_tco_n_sp_1 /end AXIS_DESCR
/end CHARACTERISTIC
/begin CHARACTERISTIC IP_N_SP_IS "Nominal idle speed without additional load on the engine" CURVE 0x498ca _REC_CUR_20_u2_u1 8160. _CNV_A_R_LINEAR_____17_CM 0. 8160. FORMAT "%4.0"
 /begin AXIS_DESCR COM_AXIS TCO _CNV_A_R_LINEAR_____0_CM 8 -48. 142.5 FORMAT "%5.1" AXIS_PTS_REF ldpm_tco_n_sp_1 /end AXIS_DESCR
/end CHARACTERISTIC
/begin MEASUREMENT N_DIF "Engine speed deviation N_SP_IS_N" SWORD _CNV_A_R_LINEAR_____17_CM 1 100. -4096. 4064. ECU_ADDRESS 0x3fcc2c FORMAT "%4.0" /end MEASUREMENT
/begin MEASUREMENT N_SP_IS_POW "Active nominal idle speed setpoint by power management active" UWORD _CNV_A_R_LINEAR_____17_CM 1 100. 0. 8160. ECU_ADDRESS 0x3fdd42 FORMAT "%4.0" /end MEASUREMENT
/begin MEASUREMENT N_SP_IS "resulting idle speed setpoint" UWORD _CNV_A_R_LINEAR_____17_CM 1 100. 0. 8160. ECU_ADDRESS 0x3fcc28 FORMAT "%4.0" /end MEASUREMENT
/begin MEASUREMENT N_SP_IS_CH "idle speed setpoint for CAT heating" UWORD _CNV_A_R_LINEAR_____17_CM 1 100. 0. 8160. ECU_ADDRESS 0x3fdd40 FORMAT "%4.0" /end MEASUREMENT
/begin MEASUREMENT N_SP_IS_2 "basis idle speed setpoint" UWORD _CNV_A_R_LINEAR_____17_CM 1 100. 0. 8160. ECU_ADDRESS 0x3fcc2a FORMAT "%4.0" /end MEASUREMENT
/begin MEASUREMENT N_SP_IS_3 "greatest of all idle speed setpoints" UWORD _CNV_A_R_LINEAR_____17_CM 1 100. 0. 8160. ECU_ADDRESS 0x3fdd44 FORMAT "%4.0" /end MEASUREMENT
/begin MEASUREMENT LV_REQ_HEAT_N_SP_IS "LV Idle Speed setpoint required from heating control unit" UBYTE _CNV_S_2_RANGE______28_CM 1 100. 0. 1. ECU_ADDRESS 0x3fdd4e /end MEASUREMENT
/begin CHARACTERISTIC IP_ACIN_N_SP_IS "Nominal idle speed with air conditioner switched on" CURVE 0x45f8c _REC_CUR_20_u2_u1 8160. _CNV_A_R_LINEAR_____17_CM 0. 8160. FORMAT "%4.0"
 /begin AXIS_DESCR COM_AXIS TCO _CNV_A_R_LINEAR_____0_CM 8 -48. 142.5 FORMAT "%5.1" AXIS_PTS_REF ldpm_tco_n_sp_1 /end AXIS_DESCR
/end CHARACTERISTIC
/begin CHARACTERISTIC IP_FAC_N_SP_OFS_KWP "TCO factor for N_SP_OFS_KWP" CURVE 0x4e29b _REC_CUR_20_u1_u1 0.99610001 _CNV_A_R_LINEAR_____20_CM 0. 0.99610001 FORMAT "%5.3"
 /begin AXIS_DESCR COM_AXIS TCO _CNV_A_R_LINEAR_____0_CM 8 -48. 142.5 FORMAT "%5.1" AXIS_PTS_REF ldpm_tco_n_sp_1 /end AXIS_DESCR
/end CHARACTERISTIC
/begin CHARACTERISTIC IP_DRI_N_SP_CH "Max. idle speed during CAT heating with drive engaged" MAP 0x46540 _REC_MAP_20_u2_u1_u2 8160. _CNV_A_R_LINEAR_____17_CM 0. 8160. FORMAT "%4.0"
 /begin AXIS_DESCR COM_AXIS TCO _CNV_A_R_LINEAR_____0_CM 8 -48. 142.5 FORMAT "%5.1" AXIS_PTS_REF ldpm_tco_n_sp_2 /end AXIS_DESCR
 /begin AXIS_DESCR COM_AXIS T_AST _CNV_A_R_LINEAR_____14_CM 8 0. 6553.5 FORMAT "%6.1" AXIS_PTS_REF ldpm_t_ast_n_sp_1 /end AXIS_DESCR
/end CHARACTERISTIC
/begin CHARACTERISTIC IP_N_SP_CH "Max. idle speed during CAT heating with no drive engaged" MAP 0x4984a _REC_MAP_20_u2_u1_u2 8160. _CNV_A_R_LINEAR_____17_CM 0. 8160. FORMAT "%4.0"
 /begin AXIS_DESCR COM_AXIS TCO _CNV_A_R_LINEAR_____0_CM 8 -48. 142.5 FORMAT "%5.1" AXIS_PTS_REF ldpm_tco_n_sp_2 /end AXIS_DESCR
 /begin AXIS_DESCR COM_AXIS T_AST _CNV_A_R_LINEAR_____14_CM 8 0. 6553.5 FORMAT "%6.1" AXIS_PTS_REF ldpm_t_ast_n_sp_1 /end AXIS_DESCR
/end CHARACTERISTIC
/begin CHARACTERISTIC IP_FAC_DRI_N_SP_CH "Interpolation factor idle speed during CAT heating with drive engaged" MAP 0x4df4c _REC_MAP_20_u1_u1_u2 0.99610001 _CNV_A_R_LINEAR_____20_CM 0. 0.99610001 FORMAT "%5.3"
 /begin AXIS_DESCR COM_AXIS TCO _CNV_A_R_LINEAR_____0_CM 8 -48. 142.5 FORMAT "%5.1" AXIS_PTS_REF ldpm_tco_n_sp_2 /end AXIS_DESCR
 /begin AXIS_DESCR COM_AXIS CTR_KM_CAN _CNV_A_R_LINEAR_____80_CM 4 0. 655350. FORMAT "%7.0" AXIS_PTS_REF ldpm_ctr_km_can_n_sp_1 /end AXIS_DESCR
/end CHARACTERISTIC
/begin CHARACTERISTIC IP_FAC_N_SP_CH "Interpolation factor idle speed during CAT heating with no drive engaged" MAP 0x4e27b _REC_MAP_20_u1_u1_u2 0.99610001 _CNV_A_R_LINEAR_____20_CM 0. 0.99610001 FORMAT "%5.3"
 /begin AXIS_DESCR COM_AXIS TCO _CNV_A_R_LINEAR_____0_CM 8 -48. 142.5 FORMAT "%5.1" AXIS_PTS_REF ldpm_tco_n_sp_2 /end AXIS_DESCR
 /begin AXIS_DESCR COM_AXIS CTR_KM_CAN _CNV_A_R_LINEAR_____80_CM 4 0. 655350. FORMAT "%7.0" AXIS_PTS_REF ldpm_ctr_km_can_n_sp_1 /end AXIS_DESCR
/end CHARACTERISTIC
/begin CHARACTERISTIC IP_N_SP_DEC_CH "Gradient limitation idle speed after catalyst heating" CURVE 0x4fcf7 _REC_CUR_20_u1_u1 0.4980468800000001 _CNV_A_R_LINEAR_____370_CM 0. 0.49804688 FORMAT "%5.3"
 /begin AXIS_DESCR COM_AXIS TCO _CNV_A_R_LINEAR_____0_CM 8 -48. 142.5 FORMAT "%5.1" AXIS_PTS_REF ldpm_tco_n_sp_2 /end AXIS_DESCR
/end CHARACTERISTIC
/begin CHARACTERISTIC IP_T_AST_MIN_N_SP_IS_CS "Minimum delay time after start for drive-off-support idle speed" CURVE 0x4a4d4 _REC_CUR_20_u2_u1 6553.5 _CNV_A_R_LINEAR_____14_CM 0. 6553.5 FORMAT "%6.1"
 /begin AXIS_DESCR COM_AXIS TCO _CNV_A_R_LINEAR_____0_CM 8 -48. 142.5 FORMAT "%5.1" AXIS_PTS_REF ldpm_tco_n_sp_1 /end AXIS_DESCR
/end CHARACTERISTIC
/begin CHARACTERISTIC IP_N_SP_IS_CS "Idle speed setpoint for drive-off-support" CURVE 0x498da _REC_CUR_20_u2_u1 8160. _CNV_A_R_LINEAR_____17_CM 0. 8160. FORMAT "%4.0"
 /begin AXIS_DESCR COM_AXIS TOIL _CNV_A_R_LINEAR_____3_CM 8 -40. 160. FORMAT "%3.0" AXIS_PTS_REF ldp_toil_ip_n_sp_is_cs /end AXIS_DESCR
/end CHARACTERISTIC
/begin CHARACTERISTIC C_N_SP_OFS_KWP_MAX "Upper threshold for tester offset" VALUE 0x42ec6 _REC_VAL_20_u2 32767. _CNV_A_R_LINEAR_____17_CM 0. 32767. FORMAT "%5.0" /end CHARACTERISTIC
/begin CHARACTERISTIC C_N_SP_OFS_KWP_MIN "Lower threshold for tester offset" VALUE 0x42ec8 _REC_VAL_20_u2 32767. _CNV_A_R_LINEAR_____371_CM -32768. -1. FORMAT "%6.0" /end CHARACTERISTIC
/begin CHARACTERISTIC C_TAM_N_SP_HEAT "Ambient temperature threshold idle speed at heater request" VALUE 0x42a3a _REC_VAL_20_u1 190.5 _CNV_A_R_LINEAR_____0_CM -48. 142.5 FORMAT "%5.1" /end CHARACTERISTIC
/begin CHARACTERISTIC C_TAM_HYS "Ambient temperature threshold idle speed at heater request" VALUE 0x42a36 _REC_VAL_20_u1 48. _CNV_A_R_LINEAR_____1_CM 0. 48. FORMAT "%4.1" /end CHARACTERISTIC
/begin CHARACTERISTIC C_N_SP_HEAT_MT "Idle speed at heater request, manual transmission vehicle" VALUE 0x42ec2 _REC_VAL_20_u2 8160. _CNV_A_R_LINEAR_____17_CM 0. 8160. FORMAT "%4.0" /end CHARACTERISTIC
/begin CHARACTERISTIC C_N_SP_HEAT_AT "Idle speed at heater request, automatic transmission vehicle" VALUE 0x42ec0 _REC_VAL_20_u2 8160. _CNV_A_R_LINEAR_____17_CM 0. 8160. FORMAT "%4.0" /end CHARACTERISTIC
/begin CHARACTERISTIC C_N_SP_INC_CS "Increment engine speed setpoint for drive-off-support" VALUE 0x4296c _REC_VAL_20_u1 7.93775 _CNV_A_R_LINEAR_____372_CM 3.125e-002 7.969 FORMAT "%4.2" /end CHARACTERISTIC
/begin CHARACTERISTIC C_N_SP_DEC_CS "Decrement engine speed setpoint for drive-off-support" VALUE 0x4296b _REC_VAL_20_u1 7.93775 _CNV_A_R_LINEAR_____372_CM 3.125e-002 7.969 FORMAT "%4.2" /end CHARACTERISTIC
/begin CHARACTERISTIC C_TOIL_MIN_N_SP_AT "Oil temperature value switch to C_N_SP_TOIL_AT" VALUE 0x42acb _REC_VAL_20_u1 200. _CNV_A_R_LINEAR_____3_CM -40. 160. FORMAT "%3.0" /end CHARACTERISTIC
/begin CHARACTERISTIC C_TOIL_HYS_N_SP_AT "Hysteresis for oil temperature value switch" VALUE 0x42ac4 _REC_VAL_20_u1 128. _CNV_A_R_LINEAR_____2_CM 0. 128. FORMAT "%3.0" /end CHARACTERISTIC
/begin CHARACTERISTIC C_N_SP_TOIL_AT "Minimum idle speed when TOIL is above C_TOIL_MIN_N_SP_AT" VALUE 0x42eca _REC_VAL_20_u2 8160. _CNV_A_R_LINEAR_____17_CM 0. 8160. FORMAT "%4.0" /end CHARACTERISTIC
/begin AXIS_PTS ldpm_tco_n_sp_2 "" 0x43ff9 TCO _REC_AXS_20_u1 190.5 _CNV_A_R_LINEAR_____0_CM 8 -48. 142.5 FORMAT "%5.1" /end AXIS_PTS
/begin AXIS_PTS ldpm_tco_n_sp_1 "" 0x43ff0 TCO _REC_AXS_20_u1 190.5 _CNV_A_R_LINEAR_____0_CM 8 -48. 142.5 FORMAT "%5.1" /end AXIS_PTS
/begin AXIS_PTS ldpm_t_ast_n_sp_1 "" 0x4543a T_AST _REC_AXS_20_u2 6553.5 _CNV_A_R_LINEAR_____14_CM 8 0. 6553.5 FORMAT "%6.1" /end AXIS_PTS
/begin AXIS_PTS ldpm_ctr_km_can_n_sp_1 "" 0x44ee6 CTR_KM_CAN _REC_AXS_20_u2 655350. _CNV_A_R_LINEAR_____80_CM 4 0. 655350. FORMAT "%7.0" /end AXIS_PTS
/begin AXIS_PTS ldp_toil_ip_n_sp_is_cs "" 0x43a25 TOIL _REC_AXS_20_u1 200. _CNV_A_R_LINEAR_____3_CM 8 -40. 160. FORMAT "%3.0" /end AXIS_PTS
/begin CHARACTERISTIC C_N_SP_LGRD_IS "Nominal idle speed change limitation" VALUE 0x4296d _REC_VAL_20_u1 12.7 _CNV_A_R_LINEAR_____373_CM 0.25 63.75 FORMAT "%5.2" /end CHARACTERISTIC
/begin CHARACTERISTIC C_N_SP_LGRD_IS_LIH "Nominal idle speed change limitation with active limp home" VALUE 0x4296e _REC_VAL_20_u1 12.7 _CNV_A_R_LINEAR_____373_CM 0.25 63.75 FORMAT "%5.2" /end CHARACTERISTIC
/begin MEASUREMENT N_MAX_THD "Actual engine speed limit" UWORD _CNV_A_R_LINEAR_____17_CM 1 100. 0. 8160. ECU_ADDRESS 0x3fcc3a FORMAT "%4.0" /end MEASUREMENT
/begin MEASUREMENT N_MAX_THD_1 "Actual engine speed limit depending on TOIL-orange area (BN2000)" UWORD _CNV_A_R_LINEAR_____17_CM 1 100. 0. 8160. ECU_ADDRESS 0x3fcc3c FORMAT "%4.0" /end MEASUREMENT
/begin MEASUREMENT N_MAX_THD_2 "Actual engine speed limit depending on TOIL-red area (BN2000)" UWORD _CNV_A_R_LINEAR_____17_CM 1 100. 0. 8160. ECU_ADDRESS 0x3fcc3e FORMAT "%4.0" /end MEASUREMENT
/begin MEASUREMENT LV_N_MAX_MT "Boolean for engine speed limitation for stopped MT-vehicle active" UBYTE _CNV_S_2_RANGE______11_CM 1 100. 0. 1. ECU_ADDRESS 0x3fdd92 BIT_MASK 0x1 /end MEASUREMENT
/begin MEASUREMENT LV_N_MAX_AT "Boolean for engine speed limitation for AT-vehicle at high gear ratio active" UBYTE _CNV_S_2_RANGE______11_CM 1 100. 0. 1. ECU_ADDRESS 0x3fdd93 BIT_MASK 0x1 /end MEASUREMENT
/begin MEASUREMENT LV_N_MAX_GR "Boolean for engine speed limitation for MT-vehicle at high gear ratio active" UBYTE _CNV_S_2_RANGE______11_CM 1 100. 0. 1. ECU_ADDRESS 0x3fdd94 BIT_MASK 0x1 /end MEASUREMENT
/begin MEASUREMENT LV_VS_MAX "Boolean for vehicle speed limitation active" UBYTE _CNV_S_2_RANGE______28_CM 1 100. 0. 1. ECU_ADDRESS 0x3fcc40 /end MEASUREMENT
/begin MEASUREMENT VS_RATIO "Ratio between vehicle speed limit and actual vehicle speed" UWORD _CNV_A_R_LINEAR_____379_CM 1 100. 0. 31.99951171875 ECU_ADDRESS 0x3fdd90 FORMAT "%7.4" /end MEASUREMENT
/begin CHARACTERISTIC IP_N_MAX_MTC_CUR_OFF__PV_AV "Engine speed limit for limp home modus due MTC error" CURVE 0x4fc48 _REC_CUR_20_u1_u1 8160. _CNV_A_R_LINEAR_____5_CM 0. 8160. FORMAT "%4.0"
 /begin AXIS_DESCR COM_AXIS PV_AV _CNV_A_R_LINEAR_____4_CM 4 0. 99.609375 FORMAT "%5.2" AXIS_PTS_REF ldp_pv_av__n_max_mtc_cur_off /end AXIS_DESCR
/end CHARACTERISTIC
/begin CHARACTERISTIC C_VS_MIN_MT "Minimum vehicle speed threshold for engine speed limitation of stopped MT-vehicle " VALUE 0x42b3b _REC_VAL_20_u1 255. _CNV_A_R_LINEAR_____13_CM 0. 255. FORMAT "%3.0" /end CHARACTERISTIC
/begin CHARACTERISTIC C_N_MAX_MT "Engine speed limit for engine speed limitation of stopped MT-vehicle" VALUE 0x42956 _REC_VAL_20_u1 979.2000000000001 _CNV_A_R_LINEAR_____5_CM 0. 8160. FORMAT "%4.0" /end CHARACTERISTIC
/begin CHARACTERISTIC C_GR_MT "Gear ratio threshold for MT-vehicle engine speed limitation" VALUE 0x428ce _REC_VAL_20_u1 30.6 _CNV_A_R_LINEAR_____10_CM 0. 255. FORMAT "%3.0" /end CHARACTERISTIC
/begin CHARACTERISTIC C_N_MAX_GR "Engine speed limit for engine speed limitation for MT-vehicle at high gear ratio" VALUE 0x42952 _REC_VAL_20_u1 979.2000000000001 _CNV_A_R_LINEAR_____5_CM 0. 8160. FORMAT "%4.0" /end CHARACTERISTIC
/begin CHARACTERISTIC C_VS_MIN_AT_1 "Minimum vehicle speed threshold for engine speed limitation of AT-vehicle with GR_AT = 0" VALUE 0x42b31 _REC_VAL_20_u1 255. _CNV_A_R_LINEAR_____13_CM 0. 255. FORMAT "%3.0" /end CHARACTERISTIC
/begin CHARACTERISTIC C_VS_MIN_AT_2 "Minimum vehicle speed threshold for engine speed limitation of AT-vehicle with GR_AT > 0" VALUE 0x42b32 _REC_VAL_20_u1 255. _CNV_A_R_LINEAR_____13_CM 0. 255. FORMAT "%3.0" /end CHARACTERISTIC
/begin CHARACTERISTIC C_N_MAX_AT "Engine speed limit for engine speed limitation of AT-vehicle" VALUE 0x4294d _REC_VAL_20_u1 979.2000000000001 _CNV_A_R_LINEAR_____5_CM 0. 8160. FORMAT "%4.0" /end CHARACTERISTIC
/begin CHARACTERISTIC C_N_MAX_MTC_LIH "Engine speed limitation in case of fault detected by throttle monitoring or ETC safety concept" VALUE 0x42957 _REC_VAL_20_u1 8160. _CNV_A_R_LINEAR_____5_CM 0. 8160. FORMAT "%4.0" /end CHARACTERISTIC
/begin CHARACTERISTIC C_VS_MAX "Vehicle speed limitation threshold" VALUE 0x42b25 _REC_VAL_20_u1 255. _CNV_A_R_LINEAR_____13_CM 0. 255. FORMAT "%3.0" /end CHARACTERISTIC
/begin CHARACTERISTIC C_N_MAX_THD_MIN "Minimum allowed engine speed threshold" VALUE 0x4295b _REC_VAL_20_u1 8160. _CNV_A_R_LINEAR_____5_CM 0. 8160. FORMAT "%4.0" /end CHARACTERISTIC
/begin MEASUREMENT N_MAX_VS_MAX "Engine speed limit in case of vehicle speed limitation" UWORD _CNV_A_R_LINEAR_____17_CM 1 100. 0. 8160. ECU_ADDRESS 0x3fdd8e FORMAT "%4.0" /end MEASUREMENT
/begin CHARACTERISTIC C_VS_MAX_AMT "Vehicle speed limitation threshold - SSG" VALUE 0x42b27 _REC_VAL_20_u1 255. _CNV_A_R_LINEAR_____13_CM 0. 255. FORMAT "%3.0" /end CHARACTERISTIC
/begin CHARACTERISTIC IP_N_MAX_2__TOIL "engine speed limit (red area) depending on TOIL - BN2000" CURVE 0x49842 _REC_CUR_20_u2_u1 8160. _CNV_A_R_LINEAR_____17_CM 0. 8160. FORMAT "%4.0"
 /begin AXIS_DESCR COM_AXIS TOIL _CNV_A_R_LINEAR_____3_CM 4 -40. 160. FORMAT "%3.0" AXIS_PTS_REF ldp_toil__n_max_2 /end AXIS_DESCR
/end CHARACTERISTIC
/begin CHARACTERISTIC IP_N_MAX_1__TOIL "engine speed limit (orange area) depending on TOIL - BN2000" CURVE 0x4983a _REC_CUR_20_u2_u1 8160. _CNV_A_R_LINEAR_____17_CM 0. 8160. FORMAT "%4.0"
 /begin AXIS_DESCR COM_AXIS TOIL _CNV_A_R_LINEAR_____3_CM 4 -40. 160. FORMAT "%3.0" AXIS_PTS_REF ldp_toil__n_max_1 /end AXIS_DESCR
/end CHARACTERISTIC
/begin CHARACTERISTIC C_N_MAX "General engine speed threshold for engine speed limitation" VALUE 0x42949 _REC_VAL_20_u1 979.2000000000001 _CNV_A_R_LINEAR_____5_CM 0. 8160. FORMAT "%4.0" /end CHARACTERISTIC
/begin CHARACTERISTIC C_N_MAX_AMT_ADD "offset for engine speed limit during gear shift phase 1 and 2" VALUE 0x4294a _REC_VAL_20_u1 979.2000000000001 _CNV_A_R_LINEAR_____5_CM 0. 8160. FORMAT "%4.0" /end CHARACTERISTIC
/begin CHARACTERISTIC C_N_MAX_AMT_GP "engine speed limit in case of SSG-error (gear protection active, LV_GP=1)" VALUE 0x4294b _REC_VAL_20_u1 979.2000000000001 _CNV_A_R_LINEAR_____5_CM 0. 8160. FORMAT "%4.0" /end CHARACTERISTIC
/begin AXIS_PTS ldp_pv_av__n_max_mtc_cur_off "" 0x437a4 PV_AV _REC_AXS_20_u1 99.609375 _CNV_A_R_LINEAR_____4_CM 4 0. 99.609375 FORMAT "%5.2" /end AXIS_PTS
/begin AXIS_PTS ldp_toil__n_max_2 "" 0x43a17 TOIL _REC_AXS_20_u1 200. _CNV_A_R_LINEAR_____3_CM 4 -40. 160. FORMAT "%3.0" /end AXIS_PTS
/begin AXIS_PTS ldp_toil__n_max_1 "" 0x43a12 TOIL _REC_AXS_20_u1 200. _CNV_A_R_LINEAR_____3_CM 4 -40. 160. FORMAT "%3.0" /end AXIS_PTS
/begin MEASUREMENT DTC_COD_0 "" UWORD _CNV_A_R_LINEAR_____12_CM 1 100. 0. 65535. ECU_ADDRESS 0x3fd2de FORMAT "%6.0" /end MEASUREMENT
/begin MEASUREMENT ERR_SYM_MEM_0 "" UWORD _CNV_S_6_RANGE_ERR__22_CM 1 100. 0. 15. ECU_ADDRESS 0x3fd2e2 BIT_MASK 0xF /end MEASUREMENT
/begin MEASUREMENT DTC_COD_1 "" UWORD _CNV_A_R_LINEAR_____12_CM 1 100. 0. 65535. ECU_ADDRESS 0x3fd2e8 FORMAT "%6.0" /end MEASUREMENT
/begin MEASUREMENT ERR_SYM_MEM_1 "" UWORD _CNV_S_6_RANGE_ERR__22_CM 1 100. 0. 15. ECU_ADDRESS 0x3fd2ec BIT_MASK 0xF /end MEASUREMENT
/begin MEASUREMENT DTC_COD_2 "" UWORD _CNV_A_R_LINEAR_____12_CM 1 100. 0. 65535. ECU_ADDRESS 0x3fd2f2 FORMAT "%6.0" /end MEASUREMENT
/begin MEASUREMENT ERR_SYM_MEM_2 "" UWORD _CNV_S_6_RANGE_ERR__22_CM 1 100. 0. 15. ECU_ADDRESS 0x3fd2f6 BIT_MASK 0xF /end MEASUREMENT
/begin MEASUREMENT DTC_COD_3 "" UWORD _CNV_A_R_LINEAR_____12_CM 1 100. 0. 65535. ECU_ADDRESS 0x3fd2fc FORMAT "%6.0" /end MEASUREMENT
/begin MEASUREMENT ERR_SYM_MEM_3 "" UWORD _CNV_S_6_RANGE_ERR__22_CM 1 100. 0. 15. ECU_ADDRESS 0x3fd300 BIT_MASK 0xF /end MEASUREMENT
/begin MEASUREMENT DTC_COD_4 "" UWORD _CNV_A_R_LINEAR_____12_CM 1 100. 0. 65535. ECU_ADDRESS 0x3fd306 FORMAT "%6.0" /end MEASUREMENT
/begin MEASUREMENT ERR_SYM_MEM_4 "" UWORD _CNV_S_6_RANGE_ERR__22_CM 1 100. 0. 15. ECU_ADDRESS 0x3fd30a BIT_MASK 0xF /end MEASUREMENT
/begin MEASUREMENT DTC_COD_5 "" UWORD _CNV_A_R_LINEAR_____12_CM 1 100. 0. 65535. ECU_ADDRESS 0x3fd310 FORMAT "%6.0" /end MEASUREMENT
/begin MEASUREMENT ERR_SYM_MEM_5 "" UWORD _CNV_S_6_RANGE_ERR__22_CM 1 100. 0. 15. ECU_ADDRESS 0x3fd314 BIT_MASK 0xF /end MEASUREMENT
/begin MEASUREMENT DTC_COD_6 "" UWORD _CNV_A_R_LINEAR_____12_CM 1 100. 0. 65535. ECU_ADDRESS 0x3fd31a FORMAT "%6.0" /end MEASUREMENT
/begin MEASUREMENT ERR_SYM_MEM_6 "" UWORD _CNV_S_6_RANGE_ERR__22_CM 1 100. 0. 15. ECU_ADDRESS 0x3fd31e BIT_MASK 0xF /end MEASUREMENT
/begin MEASUREMENT DTC_COD_7 "" UWORD _CNV_A_R_LINEAR_____12_CM 1 100. 0. 65535. ECU_ADDRESS 0x3fd324 FORMAT "%6.0" /end MEASUREMENT
/begin MEASUREMENT ERR_SYM_MEM_7 "" UWORD _CNV_S_6_RANGE_ERR__22_CM 1 100. 0. 15. ECU_ADDRESS 0x3fd328 BIT_MASK 0xF /end MEASUREMENT
/begin MEASUREMENT DTC_COD_8 "" UWORD _CNV_A_R_LINEAR_____12_CM 1 100. 0. 65535. ECU_ADDRESS 0x3fd32e FORMAT "%6.0" /end MEASUREMENT
/begin MEASUREMENT ERR_SYM_MEM_8 "" UWORD _CNV_S_6_RANGE_ERR__22_CM 1 100. 0. 15. ECU_ADDRESS 0x3fd332 BIT_MASK 0xF /end MEASUREMENT
/begin MEASUREMENT DTC_COD_9 "" UWORD _CNV_A_R_LINEAR_____12_CM 1 100. 0. 65535. ECU_ADDRESS 0x3fd338 FORMAT "%6.0" /end MEASUREMENT
/begin MEASUREMENT ERR_SYM_MEM_9 "" UWORD _CNV_S_6_RANGE_ERR__22_CM 1 100. 0. 15. ECU_ADDRESS 0x3fd33c BIT_MASK 0xF /end MEASUREMENT
/begin CHARACTERISTIC ID_ERR_DTC_LAM_DLY_1 "" CURVE 0x415ac _REC_CUR_20_u2_u2 65535. _CNV_A_R_LINEAR_____10_CM 0. 65535. FORMAT "%5.0"
 /begin AXIS_DESCR COM_AXIS ONLINE_DUMMY _CNV_A_R_LINEAR_____12_CM 6 0. 5. FORMAT "%2.0" AXIS_PTS_REF ldp_fmy_dtc /end AXIS_DESCR
/end CHARACTERISTIC
/begin CHARACTERISTIC C_ERR_CLAS_LAM_DLY_1 "" VALUE 0x415bc _REC_VAL_20_u1 255. _CNV_A_R_LINEAR_____10_CM 0. 255. FORMAT "%3.0" /end CHARACTERISTIC
/begin CHARACTERISTIC ID_ERR_DTC_LAM_DLY_2 "" CURVE 0x415be _REC_CUR_20_u2_u2 65535. _CNV_A_R_LINEAR_____10_CM 0. 65535. FORMAT "%5.0"
 /begin AXIS_DESCR COM_AXIS ONLINE_DUMMY _CNV_A_R_LINEAR_____12_CM 6 0. 5. FORMAT "%2.0" AXIS_PTS_REF ldp_fmy_dtc /end AXIS_DESCR
/end CHARACTERISTIC
/begin CHARACTERISTIC C_ERR_CLAS_LAM_DLY_2 "" VALUE 0x415ce _REC_VAL_20_u1 255. _CNV_A_R_LINEAR_____10_CM 0. 255. FORMAT "%3.0" /end CHARACTERISTIC
/begin MEASUREMENT LV_ERR_LAM_DLY_1 "Status diagnostic result of lambda trim control" UBYTE _CNV_S_2_RANGE______21_R_CM 1 100. 0. 255. ECU_ADDRESS 0x3fd6d7 /end MEASUREMENT
/begin CHARACTERISTIC C_T_LAM_DLY_AD_MAX "???" VALUE 0x432c6 _REC_VAL_20_s2 1279.9804688 _CNV_A_R_LINEAR_____278_CM -640. 639.9804688 FORMAT "%7.2" /end CHARACTERISTIC
/begin CHARACTERISTIC C_T_LAM_DLY_AD_MIN "???" VALUE 0x432c8 _REC_VAL_20_s2 1279.9804688 _CNV_A_R_LINEAR_____278_CM -640. 639.9804688 FORMAT "%7.2" /end CHARACTERISTIC
/begin MEASUREMENT LV_ERR_LAM_DLY_2 "Status diagnostic result of lambda trim control" UBYTE _CNV_S_2_RANGE______21_R_CM 1 100. 0. 255. ECU_ADDRESS 0x3fd6db /end MEASUREMENT
/begin MEASUREMENT LV_INH_DIAG_LAM_DLY_1 "Inhibition condition for the dynamic fuel trim diagnosis" UBYTE _CNV_S_2_RANGE______28_CM 1 100. 0. 1. ECU_ADDRESS 0x3faf9d /end MEASUREMENT
/begin MEASUREMENT LV_INH_DIAG_LAM_DLY_2 "Inhibition condition for the dynamic fuel trim diagnosis" UBYTE _CNV_S_2_RANGE______28_CM 1 100. 0. 1. ECU_ADDRESS 0x3faf9e /end MEASUREMENT
/begin CHARACTERISTIC IP_FAC_MAF_LSH_DOWN "Factor reflecting forced convection influence of cooling area, gas velocity and heat transfer coefficient" CURVE 0x4e22b _REC_CUR_20_u1_u2 15.9375 _CNV_A_R_LINEAR_____40_CM 0. 15.9375 FORMAT "%5.2"
 /begin AXIS_DESCR COM_AXIS MAF_KGH _CNV_A_R_LINEAR_____101_CM 6 0. 2047.96875 FORMAT "%7.2" AXIS_PTS_REF ldp_maf_kgh__fac_maf_lsh_down /end AXIS_DESCR
/end CHARACTERISTIC
/begin CHARACTERISTIC C_PWM_MIN_OBD2_LSH_DOWN "Minimum permitted heater effective voltage PWM for upstream LSH OBDII diagnosis " VALUE 0x42999 _REC_VAL_20_u1 99.609375 _CNV_A_R_LINEAR_____4_CM 0. 99.609375 FORMAT "%4.1" /end CHARACTERISTIC
/begin CHARACTERISTIC C_PWM_MAX_OBD2_LSH_DOWN "Maximum permitted heater effective voltage PWM for upstream LSH OBDII diagnosis " VALUE 0x42997 _REC_VAL_20_u1 99.609375 _CNV_A_R_LINEAR_____4_CM 0. 99.609375 FORMAT "%4.1" /end CHARACTERISTIC
/begin CHARACTERISTIC C_T_DLY_OBD2_LSH_DOWN "Minimum delay prior to checking status of OBDI heater / signal faults" VALUE 0x429f0 _REC_VAL_20_u1 255. _CNV_A_R_LINEAR_____47_CM 0. 255. FORMAT "%3.0" /end CHARACTERISTIC
/begin CHARACTERISTIC C_TEMP_MIN_OBD2_LSH_DOWN "Temperature threshold under which downstream LSH OBDII diagnosis activated" VALUE 0x43088 _REC_VAL_20_u2 2047. _CNV_A_R_LINEAR_____211_CM 0. 2047. FORMAT "%7.2" /end CHARACTERISTIC
/begin CHARACTERISTIC C_TEMP_SET_OBD2_LSH_DOWN "Set temperature fordownstream LSH operation used to generate power integral" VALUE 0x4308c _REC_VAL_20_u2 2047. _CNV_A_R_LINEAR_____211_CM 0. 2047. FORMAT "%7.2" /end CHARACTERISTIC
/begin CHARACTERISTIC C_EGY_MIN_OBD2_LSH_DOWN "Measure of minimum required cooling energy required atdownstream sensor prior to checking Ri threshold" VALUE 0x42ce4 _REC_VAL_20_u2 65535. _CNV_A_R_LINEAR_____294_CM 0. 65535. FORMAT "%5.0" /end CHARACTERISTIC
/begin CHARACTERISTIC C_R_THD_OBD2_LSH_DOWN "Internal resistance threshold, when exceeded, heater is determined to be defective for current diagnosis cycle" VALUE 0x42f14 _REC_VAL_20_u2 65535. _CNV_A_R_LINEAR_____285_CM 0. 65535. FORMAT "%5.0" /end CHARACTERISTIC
/begin CHARACTERISTIC C_TCC_OBD2_LSH_DOWN "Number of valid downstream LSH OBDII diagnosis cycles over which statistic evaluation to be carried out" VALUE 0x4304e _REC_VAL_20_u2 1023. _CNV_A_R_LINEAR_____12_CM 0. 1023. FORMAT "%4.0" /end CHARACTERISTIC
/begin CHARACTERISTIC C_FRC_OBD2_LSH_DOWN "Fault detection threshold, when exceeded, heater is determined to be defective during driving cycle" VALUE 0x42d7c _REC_VAL_20_u2 1023. _CNV_A_R_LINEAR_____12_CM 0. 1023. FORMAT "%4.0" /end CHARACTERISTIC
/begin AXIS_PTS ldp_maf_kgh__fac_maf_lsh_down "" 0x445f8 MAF_KGH _REC_AXS_20_u2 2047.96875 _CNV_A_R_LINEAR_____101_CM 6 0. 2047.96875 FORMAT "%7.2" /end AXIS_PTS
/begin CHARACTERISTIC C_AMP_MDL_DIF_REL_PLAUS_MAX_1 "" VALUE 0x431ea _REC_VAL_20_s2 99.99847412 _CNV_A_R_LINEAR_____98_CM -50. 49.99847412 FORMAT "%6.2" /end CHARACTERISTIC
/begin CHARACTERISTIC C_AMP_MDL_DIF_REL_PLAUS_MAX_2 "" VALUE 0x431ec _REC_VAL_20_s2 99.99847412 _CNV_A_R_LINEAR_____98_CM -50. 49.99847412 FORMAT "%6.2" /end CHARACTERISTIC
/begin CHARACTERISTIC C_AMP_MDL_DIF_REL_PLAUS_MIN_1 "" VALUE 0x431ee _REC_VAL_20_s2 99.99847412 _CNV_A_R_LINEAR_____98_CM -50. 49.99847412 FORMAT "%6.2" /end CHARACTERISTIC
/begin CHARACTERISTIC C_AMP_MDL_DIF_REL_PLAUS_MIN_2 "" VALUE 0x431f0 _REC_VAL_20_s2 99.99847412 _CNV_A_R_LINEAR_____98_CM -50. 49.99847412 FORMAT "%6.2" /end CHARACTERISTIC
/begin CHARACTERISTIC C_AR_RED_AD_FAC_PLAUS_MAX "" VALUE 0x431fe _REC_VAL_20_s2 99.99847412 _CNV_A_R_LINEAR_____98_CM -50. 49.99847412 FORMAT "%6.2" /end CHARACTERISTIC
/begin CHARACTERISTIC C_AR_RED_AD_FAC_PLAUS_MIN "" VALUE 0x43200 _REC_VAL_20_s2 99.99847412 _CNV_A_R_LINEAR_____98_CM -50. 49.99847412 FORMAT "%6.2" /end CHARACTERISTIC
/begin CHARACTERISTIC C_AR_RED_AD_ADD_PLAUS_MAX "" VALUE 0x431f6 _REC_VAL_20_s2 58.59285547 _CNV_A_R_LINEAR_____342_CM -29.296875 29.29598047 FORMAT "%8.4" /end CHARACTERISTIC
/begin CHARACTERISTIC C_AR_RED_AD_ADD_PLAUS_MIN "" VALUE 0x431f8 _REC_VAL_20_s2 58.59285547 _CNV_A_R_LINEAR_____342_CM -29.296875 29.29598047 FORMAT "%8.4" /end CHARACTERISTIC
/begin CHARACTERISTIC C_AR_RED_DIF_REL_PLAUS_MAX_1 "" VALUE 0x4320e _REC_VAL_20_s2 99.99847412 _CNV_A_R_LINEAR_____98_CM -50. 49.99847412 FORMAT "%6.2" /end CHARACTERISTIC
/begin CHARACTERISTIC C_AR_RED_DIF_REL_PLAUS_MAX_2 "" VALUE 0x43210 _REC_VAL_20_s2 99.99847412 _CNV_A_R_LINEAR_____98_CM -50. 49.99847412 FORMAT "%6.2" /end CHARACTERISTIC
/begin CHARACTERISTIC C_AR_RED_DIF_REL_PLAUS_MIN_1 "" VALUE 0x43212 _REC_VAL_20_s2 99.99847412 _CNV_A_R_LINEAR_____98_CM -50. 49.99847412 FORMAT "%6.2" /end CHARACTERISTIC
/begin CHARACTERISTIC C_AR_RED_DIF_REL_PLAUS_MIN_2 "" VALUE 0x43214 _REC_VAL_20_s2 99.99847412 _CNV_A_R_LINEAR_____98_CM -50. 49.99847412 FORMAT "%6.2" /end CHARACTERISTIC
/begin CHARACTERISTIC C_CRLC_AMP_MDL_DIF "" VALUE 0x42825 _REC_VAL_20_u1 0.9960940000000002 _CNV_A_R_LINEAR_____44_CM 0. 0.996094 FORMAT "%5.3" /end CHARACTERISTIC
/begin CHARACTERISTIC C_CRLC_AR_RED_DIF_REL "" VALUE 0x4282b _REC_VAL_20_u1 0.9960940000000002 _CNV_A_R_LINEAR_____44_CM 0. 0.996094 FORMAT "%5.3" /end CHARACTERISTIC
/begin CHARACTERISTIC C_MAP_DRV1_MAX_LOAD_TPS_PLAUS "" VALUE 0x43282 _REC_VAL_20_s2 165.8 _CNV_A_R_LINEAR_____265_CM -82.90000000000001 82.90000000000001 FORMAT "%7.3" /end CHARACTERISTIC
/begin CHARACTERISTIC C_MAP_DRV1_MIN_LOAD_TPS_PLAUS "" VALUE 0x43284 _REC_VAL_20_s2 165.8 _CNV_A_R_LINEAR_____265_CM -82.90000000000001 82.90000000000001 FORMAT "%7.3" /end CHARACTERISTIC
/begin CHARACTERISTIC C_N_MAX_LOAD_TPS_PLAUS "" VALUE 0x42955 _REC_VAL_20_u1 8160. _CNV_A_R_LINEAR_____5_CM 0. 8160. FORMAT "%4.0" /end CHARACTERISTIC
/begin CHARACTERISTIC C_N_MIN_LOAD_TPS_PLAUS "" VALUE 0x42966 _REC_VAL_20_u1 8160. _CNV_A_R_LINEAR_____5_CM 0. 8160. FORMAT "%4.0" /end CHARACTERISTIC
/begin CHARACTERISTIC C_PQ_MAX_LOAD_TPS_PLAUS "" VALUE 0x42ef0 _REC_VAL_20_u2 0.999755 _CNV_A_R_LINEAR_____112_CM 0. 0.999755 FORMAT "%7.5" /end CHARACTERISTIC
/begin CHARACTERISTIC C_PQ_MIN_LOAD_TPS_PLAUS "" VALUE 0x42ef2 _REC_VAL_20_u2 0.999755 _CNV_A_R_LINEAR_____112_CM 0. 0.999755 FORMAT "%7.5" /end CHARACTERISTIC
/begin CHARACTERISTIC LC_USE_FSD "Flag for usage of FSD error to distinguish between load or TPS error" VALUE 0x42bf2 _REC_VAL_20_u1 1. _CNV_S_2_RANGE______11_CM 0. 1. /end CHARACTERISTIC
/begin MEASUREMENT LV_AMP_CTL_RST "Control bit for resetting of pressure controller" UBYTE _CNV_S_2_RANGE______28_CM 1 100. 0. 1. ECU_ADDRESS 0x3fd040 BIT_MASK 0x1 /end MEASUREMENT
/begin MEASUREMENT LV_AR_RED_CTL_RST "Control bit for resetting of reduced area controller" UBYTE _CNV_S_2_RANGE______28_CM 1 100. 0. 1. ECU_ADDRESS 0x3fd041 BIT_MASK 0x1 /end MEASUREMENT
/begin MEASUREMENT LV_RATIO_CHK_ERR "Boolean for actual value MAF or TPS ratio check is present" UBYTE _CNV_S_2_RANGE______28_CM 1 100. 0. 1. ECU_ADDRESS 0x3fd042 BIT_MASK 0x1 /end MEASUREMENT
/begin MEASUREMENT AMP_MDL_DIF_MMV_REL "Filtered pressure controller excitation divided by ambient pressure" SWORD _CNV_A_R_LINEAR_____98_CM 1 100. -50. 49.99847412 ECU_ADDRESS 0x3fe66e FORMAT "%6.2" /end MEASUREMENT
/begin MEASUREMENT AR_RED_DIF_REL_MMV "Filtered reduced area controller excitation(without adapation values)" SWORD _CNV_A_R_LINEAR_____98_CM 1 100. -50. 49.99847412 ECU_ADDRESS 0x3fe670 FORMAT "%6.2" /end MEASUREMENT
/begin MEASUREMENT AMP_MDL_DIF_MMV "Filtered pressure controller excitation" SWORD _CNV_A_R_LINEAR_____97_CM 1 100. -2717.04 2716.96 ECU_ADDRESS 0x3fe66c FORMAT "%8.2" /end MEASUREMENT
/begin MEASUREMENT LV_ERR_TPS_PLAUS "Boolean that indicates that TPS sensor is faulty" UBYTE _CNV_S_2_RANGE______21_R_CM 1 100. 0. 255. ECU_ADDRESS 0x3fd673 /end MEASUREMENT
/begin MEASUREMENT LV_ERR_LOAD_PLAUS "Boolean that indicates that load sensor is faulty" UBYTE _CNV_S_2_RANGE______21_R_CM 1 100. 0. 255. ECU_ADDRESS 0x3fd677 /end MEASUREMENT
/begin MEASUREMENT LV_SA_MIN_FLOW_DIAG "State Minimum secondary air flow rate diagnosis condition" UBYTE _CNV_S_2_RANGE______183_CM 1 100. 0. 1. ECU_ADDRESS 0x3fcc86 BIT_MASK 0x1 /end MEASUREMENT
/begin MEASUREMENT LV_SAP_CNL "SAP break-off in case of  mechanically jammed SAV before plausibility check" UBYTE _CNV_S_2_RANGE______28_CM 1 100. 0. 1. ECU_ADDRESS 0x3fcc85 /end MEASUREMENT
/begin MEASUREMENT STATE_DIAG_SA_LS "State_SA diagnosis" UBYTE _CNV_S_9_STATE_DIAG_401_CM 1 100. 0. 8. ECU_ADDRESS 0x3fcc84 /end MEASUREMENT
/begin MEASUREMENT LV_INH_DIAG_SA "Secondary air system diagnosis: application incidence to inhibit the diagnosis" UBYTE _CNV_S_2_RANGE______28_CM 1 100. 0. 1. ECU_ADDRESS 0x3fcc87 /end MEASUREMENT
/begin MEASUREMENT LV_ERR_OBD2_LSH_DOWN_1 "Boolean flag indicating that fault is present and has been debounced" UBYTE _CNV_S_2_RANGE______21_R_CM 1 100. 0. 255. ECU_ADDRESS 0x3fd5df /end MEASUREMENT
/begin MEASUREMENT LV_ERR_OBD2_LSH_DOWN_2 "Boolean flag indicating that fault is present and has been debounced" UBYTE _CNV_S_2_RANGE______21_R_CM 1 100. 0. 255. ECU_ADDRESS 0x3fd5e3 /end MEASUREMENT
/begin MEASUREMENT STATE_DIAG_SA_SAFM "States of secondary air system diagnosis" UBYTE _CNV_S_7_STATE_DIAG_404_CM 1 100. 0. 6. ECU_ADDRESS 0x3fde31 /end MEASUREMENT
/begin MEASUREMENT STATE_DIAG_SA_ERR "Error states of secondary air system diagnosis" UBYTE _CNV_S_7_STATE_DIAG_405_CM 1 100. 0. 6. ECU_ADDRESS 0x3fde30 /end MEASUREMENT
/begin MEASUREMENT LV_SAFM_MONIT_DIAG_END "Control flag signals the end of SAFM diagnosis(1.1)" UBYTE _CNV_S_2_RANGE______28_CM 1 100. 0. 1. ECU_ADDRESS 0x3fde34 /end MEASUREMENT
/begin MEASUREMENT LV_SA_MIN_DIAG_END "Control flag signals the end of minimum or maximum deviation diagnosis(1.2)" UBYTE _CNV_S_2_RANGE______28_CM 1 100. 0. 1. ECU_ADDRESS 0x3fde35 /end MEASUREMENT
/begin MEASUREMENT LV_SAV_DIAG_END "Control flag signals the end of SAV diagnosis(1.3)" UBYTE _CNV_S_2_RANGE______28_CM 1 100. 0. 1. ECU_ADDRESS 0x3fde36 /end MEASUREMENT
/begin MEASUREMENT LV_SA_T_DIAG_START "Control flag signals the start of the diagnose timer" UBYTE _CNV_S_2_RANGE______28_CM 1 100. 0. 1. ECU_ADDRESS 0x3fde37 /end MEASUREMENT
/begin MEASUREMENT CTR_SAFM_DIAG "Counter for Min/Max of SAF_KGH during SAFM diagnosis active" UWORD _CNV_A_R_LINEAR_____10_CM 1 100. 0. 65534. ECU_ADDRESS 0x3fde18 FORMAT "%5.0" /end MEASUREMENT
/begin MEASUREMENT SAF_KGH_MAX_DIAG "Maximum value of SAF_KGH during the time ctr_safm_diag or ctr_sav_thd" UWORD _CNV_A_R_LINEAR_____41_CM 1 100. 0. 1023.984375 ECU_ADDRESS 0x3fde1a FORMAT "%7.2" /end MEASUREMENT
/begin MEASUREMENT SAF_KGH_MIN_DIAG "Minimum value of SAF_KGH during the time ctr_safm_diag or ctr_sav_thd" UWORD _CNV_A_R_LINEAR_____41_CM 1 100. 0. 1023.984375 ECU_ADDRESS 0x3fde1c FORMAT "%7.2" /end MEASUREMENT
/begin MEASUREMENT SAF_KGH_DIF "Difference of minimum and maximum value of SAF_KGH_xxx_DIAG " UWORD _CNV_A_R_LINEAR_____41_CM 1 100. 0. 1023.984375 ECU_ADDRESS 0x3fde1e FORMAT "%7.2" /end MEASUREMENT
/begin MEASUREMENT SUM_SAF_DIAG_MAX "Number of  maximum air flow diagnosis steps" UWORD _CNV_A_R_LINEAR_____10_CM 1 100. 0. 65534. ECU_ADDRESS 0x3fde20 FORMAT "%5.0" /end MEASUREMENT
/begin MEASUREMENT SUM_SAF_DIAG_QUO_MAX "Sum of diagnosis value maximum air flow" ULONG _CNV_A_R_LINEAR_____406_CM 1 100. 0. 16711170. ECU_ADDRESS 0x3fde10 FORMAT "%12.3" /end MEASUREMENT
/begin MEASUREMENT SAF_DIAG_QUO_MAX "Diagnosis value of maximum air flow (weighted)" UWORD _CNV_A_R_LINEAR_____406_CM 1 100. 0. 255. ECU_ADDRESS 0x3fde22 FORMAT "%7.3" /end MEASUREMENT
/begin MEASUREMENT SUM_SAF_DIAG_MIN "Number of  minimum air flow diagnosis steps" UWORD _CNV_A_R_LINEAR_____10_CM 1 100. 0. 65534. ECU_ADDRESS 0x3fde26 FORMAT "%5.0" /end MEASUREMENT
/begin MEASUREMENT SUM_SAF_DIAG_QUO_MIN "Sum of diagnosis value minimum air flow" ULONG _CNV_A_R_LINEAR_____406_CM 1 100. 0. 16711170. ECU_ADDRESS 0x3fde14 FORMAT "%12.3" /end MEASUREMENT
/begin MEASUREMENT SAF_DIAG_MAX "Mean diagnosis value of maximum air flow " UWORD _CNV_A_R_LINEAR_____406_CM 1 100. 0. 255. ECU_ADDRESS 0x3fde24 FORMAT "%7.3" /end MEASUREMENT
/begin MEASUREMENT SAF_DIAG_QUO_MIN "Diagnosis value of minimum air flow (weighted)" UWORD _CNV_A_R_LINEAR_____406_CM 1 100. 0. 255. ECU_ADDRESS 0x3fde28 FORMAT "%7.3" /end MEASUREMENT
/begin MEASUREMENT SAF_DIAG_MIN "Mean diagnosis value of minimum air flow" UWORD _CNV_A_R_LINEAR_____406_CM 1 100. 0. 255. ECU_ADDRESS 0x3fde2a FORMAT "%7.3" /end MEASUREMENT
/begin MEASUREMENT SAF_KGH_DIAG "Difference of model and actual value of SAF" SWORD _CNV_A_R_LINEAR_____407_CM 1 100. -512. 511.98 ECU_ADDRESS 0x3fde2c FORMAT "%7.3" /end MEASUREMENT
/begin MEASUREMENT SAF_KGH_DIF_SAV_DIAG "Difference of minimum and maximum value of SAF_KGH_xxx_DIAG during the SAV-diagnosis" UWORD _CNV_A_R_LINEAR_____41_CM 1 100. 0. 1023.984375 ECU_ADDRESS 0x3fde2e FORMAT "%7.2" /end MEASUREMENT
/begin MEASUREMENT LV_SAP_SAV_CNL "End of Secondary air injection in reason of SA error" UBYTE _CNV_S_2_RANGE______28_CM 1 100. 0. 1. ECU_ADDRESS 0x3fcc8b /end MEASUREMENT
/begin CHARACTERISTIC ID_SAF_KGH_DIAG_MIN "minimum deviation of air mass flow without emissions-deterioration" MAP 0x4ce91 _REC_MAP_20_u1_u1_u1 63.75 _CNV_A_R_LINEAR_____408_CM 0. 63.75
 /begin AXIS_DESCR COM_AXIS N_32 _CNV_A_R_LINEAR_____5_CM 8 0. 8160. FORMAT "%4.0" AXIS_PTS_REF ldpm_n_32_id_saf_kgh_diag_min /end AXIS_DESCR
 /begin AXIS_DESCR COM_AXIS MAF _CNV_A_R_LINEAR_____18_CM 8 0. 1389. FORMAT "%4.0" AXIS_PTS_REF ldpm_maf_id_saf_kgh_diag_min /end AXIS_DESCR
/end CHARACTERISTIC
/begin CHARACTERISTIC ID_SAF_KGH_DIAG_MAX "Detection of leaky in the secondary air system" MAP 0x4ce51 _REC_MAP_20_u1_u1_u1 63.75 _CNV_A_R_LINEAR_____408_CM 0. 63.75
 /begin AXIS_DESCR COM_AXIS N_32 _CNV_A_R_LINEAR_____5_CM 8 0. 8160. FORMAT "%4.0" AXIS_PTS_REF ldpm_n_32_id_saf_kgh_diag_max /end AXIS_DESCR
 /begin AXIS_DESCR COM_AXIS MAF _CNV_A_R_LINEAR_____18_CM 8 0. 1389. FORMAT "%4.0" AXIS_PTS_REF ldpm_maf_id_saf_kgh_diag_max /end AXIS_DESCR
/end CHARACTERISTIC
/begin CHARACTERISTIC C_SUM_SAF_DIAG_MIN "Counter for minimum air flow deviation" VALUE 0x42f46 _REC_VAL_20_u2 65534. _CNV_A_R_LINEAR_____10_CM 0. 65534. FORMAT "%5.0" /end CHARACTERISTIC
/begin CHARACTERISTIC C_SUM_SAF_DIAG_MAX "Counter for maximum air flow deviation" VALUE 0x42f44 _REC_VAL_20_u2 65534. _CNV_A_R_LINEAR_____10_CM 0. 65534. FORMAT "%5.0" /end CHARACTERISTIC
/begin CHARACTERISTIC C_SAF_DIAG_MIN "Error detection threshold for minimum deviation" VALUE 0x42f2a _REC_VAL_20_u2 255. _CNV_A_R_LINEAR_____406_CM 0. 255. FORMAT "%7.3" /end CHARACTERISTIC
/begin CHARACTERISTIC C_SAF_DIAG_MAX "Error detection threshold for maximum deviation" VALUE 0x42f28 _REC_VAL_20_u2 255. _CNV_A_R_LINEAR_____406_CM 0. 255. FORMAT "%7.3" /end CHARACTERISTIC
/begin CHARACTERISTIC C_SUM_SAFM_DIAG "Number of measurements for diagnosis" VALUE 0x42f48 _REC_VAL_20_u2 65534. _CNV_A_R_LINEAR_____10_CM 0. 65534. FORMAT "%5.0" /end CHARACTERISTIC
/begin CHARACTERISTIC C_T_DLY_DIAG_SAFM "Time delay of SAFM-diagnosis" VALUE 0x42f84 _REC_VAL_20_u2 6553.5 _CNV_A_R_LINEAR_____14_CM 0. 6553.5 FORMAT "%6.1" /end CHARACTERISTIC
/begin CHARACTERISTIC C_SAF_KGH_DIF "Difference threshold for error detection \"SA-tube blocked\"" VALUE 0x42f2c _REC_VAL_20_u2 1023.984375 _CNV_A_R_LINEAR_____41_CM 0. 1023.984375 FORMAT "%7.2" /end CHARACTERISTIC
/begin CHARACTERISTIC C_SAF_MES_THD "Absolute threshold for detection SAP is started" VALUE 0x42f30 _REC_VAL_20_u2 1023.984375 _CNV_A_R_LINEAR_____41_CM 0. 1023.984375 FORMAT "%7.2" /end CHARACTERISTIC
/begin CHARACTERISTIC C_T_MAX_DIAG_SAV "Maximum operating life of SAV-diagnosis" VALUE 0x42fec _REC_VAL_20_u2 6553.5 _CNV_A_R_LINEAR_____14_CM 0. 6553.5 FORMAT "%6.1" /end CHARACTERISTIC
/begin CHARACTERISTIC C_SUM_SAV_THD "Number of check-up" VALUE 0x429b1 _REC_VAL_20_u1 255. _CNV_A_R_LINEAR_____10_CM 0. 255. FORMAT "%3.0" /end CHARACTERISTIC
/begin CHARACTERISTIC C_SAF_KGH_DIF_SAV_DIAG "Difference threshold for error detection \"SAV_ERR\"" VALUE 0x42f2e _REC_VAL_20_u2 1023.984375 _CNV_A_R_LINEAR_____41_CM 0. 1023.984375 FORMAT "%7.2" /end CHARACTERISTIC
/begin CHARACTERISTIC C_MAF_KGH_MIN_SAF "MAF-threshold for start of SAV-diagnosis" VALUE 0x42e5a _REC_VAL_20_u2 16383.75 _CNV_A_R_LINEAR_____408_CM 0. 16383.75 FORMAT "%7.1" /end CHARACTERISTIC
/begin CHARACTERISTIC C_T_DLY_DIAG_SAV "Delelaytime after end of secondary air function for start of SAV-diagnosis" VALUE 0x42f86 _REC_VAL_20_u2 6553.5 _CNV_A_R_LINEAR_____14_CM 0. 6553.5 FORMAT "%6.1" /end CHARACTERISTIC
/begin AXIS_PTS ldpm_n_32_id_saf_kgh_diag_min "" 0x43e40 N_32 _REC_AXS_20_u1 8160. _CNV_A_R_LINEAR_____5_CM 8 0. 8160. FORMAT "%4.0" /end AXIS_PTS
/begin AXIS_PTS ldpm_n_32_id_saf_kgh_diag_max "" 0x43e37 N_32 _REC_AXS_20_u1 8160. _CNV_A_R_LINEAR_____5_CM 8 0. 8160. FORMAT "%4.0" /end AXIS_PTS
/begin AXIS_PTS ldpm_maf_id_saf_kgh_diag_min "" 0x43c73 MAF _REC_AXS_20_u1 1389. _CNV_A_R_LINEAR_____18_CM 8 0. 1389. FORMAT "%4.0" /end AXIS_PTS
/begin AXIS_PTS ldpm_maf_id_saf_kgh_diag_max "" 0x43c6a MAF _REC_AXS_20_u1 1389. _CNV_A_R_LINEAR_____18_CM 8 0. 1389. FORMAT "%4.0" /end AXIS_PTS
/begin MEASUREMENT SUM_SAV_THD "Counter for Min/Max of SAF_KGH during SAV diagnosis active" UBYTE _CNV_A_R_LINEAR_____10_CM 1 100. 0. 255. ECU_ADDRESS 0x3fde33 FORMAT "%3.0" /end MEASUREMENT
/begin MEASUREMENT T_DLY_INTR_DIAG_SAFM "Time delay after secair interrupt to continue the SA monitoring" UBYTE _CNV_A_R_LINEAR_____402_CM 1 100. 0. 25.5 ECU_ADDRESS 0x3fde32 FORMAT "%4.1" /end MEASUREMENT
/begin CHARACTERISTIC C_T_DLY_INTR_DIAG_SAFM "Time delay after leaving the STATE_SA = INTERRUPT to continue the SA monitoring" VALUE 0x429e3 _REC_VAL_20_u1 25.5 _CNV_A_R_LINEAR_____402_CM 0. 25.5 FORMAT "%4.1" /end CHARACTERISTIC
/begin CHARACTERISTIC LC_INH_SAFM_MAN_DEAC "Constant to switch of the inhibition (=1)" VALUE 0x42b9e _REC_VAL_20_u1 1. _CNV_A_R_LINEAR_____12_CM 0. 1. FORMAT "%1.0" /end CHARACTERISTIC
/begin MEASUREMENT LV_ERR_LOAD_TPS_PLAUS "Boolean that indicates inconsistencies between actual load and throttle position (if set)" UBYTE _CNV_S_2_RANGE______21_R_CM 1 100. 0. 255. ECU_ADDRESS 0x3fd66f /end MEASUREMENT
/begin CHARACTERISTIC C_MAF_KGH_MAX_DIAG_SA "Maximum load [kg/h] for interrupt the SA diagnosis" VALUE 0x42e54 _REC_VAL_20_u2 2047.96875 _CNV_A_R_LINEAR_____101_CM 0. 2047.96875 FORMAT "%7.2" /end CHARACTERISTIC
/begin CHARACTERISTIC ID_ERR_DTC_SEG_T_AD "" CURVE 0x40e26 _REC_CUR_20_u2_u2 65535. _CNV_A_R_LINEAR_____10_CM 0. 65535. FORMAT "%5.0"
 /begin AXIS_DESCR COM_AXIS ONLINE_DUMMY _CNV_A_R_LINEAR_____12_CM 6 0. 5. FORMAT "%2.0" AXIS_PTS_REF ldp_fmy_dtc /end AXIS_DESCR
/end CHARACTERISTIC
/begin CHARACTERISTIC C_ERR_CLAS_SEG_T_AD "" VALUE 0x40e36 _REC_VAL_20_u1 255. _CNV_A_R_LINEAR_____10_CM 0. 255. FORMAT "%3.0" /end CHARACTERISTIC
/begin CHARACTERISTIC ID_ERR_DTC_SEG_T "" CURVE 0x40e38 _REC_CUR_20_u2_u2 65535. _CNV_A_R_LINEAR_____10_CM 0. 65535. FORMAT "%5.0"
 /begin AXIS_DESCR COM_AXIS ONLINE_DUMMY _CNV_A_R_LINEAR_____12_CM 6 0. 5. FORMAT "%2.0" AXIS_PTS_REF ldp_fmy_dtc /end AXIS_DESCR
/end CHARACTERISTIC
/begin CHARACTERISTIC C_ERR_CLAS_SEG_T "" VALUE 0x40e48 _REC_VAL_20_u1 255. _CNV_A_R_LINEAR_____10_CM 0. 255. FORMAT "%3.0" /end CHARACTERISTIC
/begin CHARACTERISTIC C_ERR_CLAS_MIS_B1 "" VALUE 0x40e6c _REC_VAL_20_u1 255. _CNV_A_R_LINEAR_____10_CM 0. 255. FORMAT "%3.0" /end CHARACTERISTIC
/begin CHARACTERISTIC C_ERR_CLAS_MIS_B4 "" VALUE 0x40e7e _REC_VAL_20_u1 255. _CNV_A_R_LINEAR_____10_CM 0. 255. FORMAT "%3.0" /end CHARACTERISTIC
/begin CHARACTERISTIC C_ERR_CLAS_MIS_A "" VALUE 0x40e5a _REC_VAL_20_u1 255. _CNV_A_R_LINEAR_____10_CM 0. 255. FORMAT "%3.0" /end CHARACTERISTIC
/begin CHARACTERISTIC ID_ERR_DTC_ECRAS "" CURVE 0x41270 _REC_CUR_20_u2_u2 65535. _CNV_A_R_LINEAR_____10_CM 0. 65535. FORMAT "%5.0"
 /begin AXIS_DESCR COM_AXIS ONLINE_DUMMY _CNV_A_R_LINEAR_____12_CM 6 0. 5. FORMAT "%2.0" AXIS_PTS_REF ldp_fmy_dtc /end AXIS_DESCR
/end CHARACTERISTIC
/begin CHARACTERISTIC C_ERR_CLAS_ECRAS "" VALUE 0x41280 _REC_VAL_20_u1 255. _CNV_A_R_LINEAR_____10_CM 0. 255. FORMAT "%3.0" /end CHARACTERISTIC
/begin CHARACTERISTIC ID_ERR_DTC_DMTLH "" CURVE 0x41282 _REC_CUR_20_u2_u2 65535. _CNV_A_R_LINEAR_____10_CM 0. 65535. FORMAT "%5.0"
 /begin AXIS_DESCR COM_AXIS ONLINE_DUMMY _CNV_A_R_LINEAR_____12_CM 6 0. 5. FORMAT "%2.0" AXIS_PTS_REF ldp_fmy_dtc /end AXIS_DESCR
/end CHARACTERISTIC
/begin CHARACTERISTIC C_ERR_CLAS_DMTLH "" VALUE 0x41292 _REC_VAL_20_u1 255. _CNV_A_R_LINEAR_____10_CM 0. 255. FORMAT "%3.0" /end CHARACTERISTIC
/begin CHARACTERISTIC ID_ERR_DTC_MIS "DTC table declaration for diagnosis misfiring" MAP 0x456da _REC_MAP_20_u2_u2_u2 65535. _CNV_A_R_LINEAR_____10_CM 0. 65535. FORMAT "%5.0"
 /begin AXIS_DESCR COM_AXIS ONLINE_DUMMY _CNV_A_R_LINEAR_____10_CM 2 0. 65535. FORMAT "%5.0" AXIS_PTS_REF ldp_1_id_err_dtc_mis /end AXIS_DESCR
 /begin AXIS_DESCR COM_AXIS ONLINE_DUMMY _CNV_A_R_LINEAR_____10_CM 8 0. 65535. FORMAT "%5.0" AXIS_PTS_REF ldp_2_id_err_dtc_mis /end AXIS_DESCR
/end CHARACTERISTIC
/begin CHARACTERISTIC C_TCO_MIN_DIAGCPS "min. temperature for Functional check CPS" VALUE 0x42a67 _REC_VAL_20_u1 190.5 _CNV_A_R_LINEAR_____0_CM -48. 142.5 FORMAT "%5.1" /end CHARACTERISTIC
/begin AXIS_PTS ldp_2_id_err_dtc_mis "" 0x440f0 ID_ERR_DTC_MIS _REC_AXS_20_u2 65535. _CNV_A_R_LINEAR_____10_CM 8 0. 65535. FORMAT "%5.0" /end AXIS_PTS
/begin AXIS_PTS ldp_1_id_err_dtc_mis "" 0x440ea ID_ERR_DTC_MIS _REC_AXS_20_u2 65535. _CNV_A_R_LINEAR_____10_CM 2 0. 65535. FORMAT "%5.0" /end AXIS_PTS
/begin AXIS_PTS ldpm_clas_a_id_clas_fmy "" 0x44eb0 CLAS_ID_CLAS_A_FMY _REC_AXS_20_u2 65535. _CNV_A_R_LINEAR_____10_CM 16 0. 65535. FORMAT "%5.0" /end AXIS_PTS
/begin AXIS_PTS ldp_clas_b_id_clas_fmy "" 0x4422c CLAS_ID_CLAS_B_FMY _REC_AXS_20_u2 65535. _CNV_A_R_LINEAR_____10_CM 4 0. 65535. FORMAT "%5.0" /end AXIS_PTS
/begin AXIS_PTS ldp_fmy_dtc "" 0x443b4 DTC _REC_AXS_20_u2 5. _CNV_A_R_LINEAR_____12_CM 6 0. 5. FORMAT "%2.0" /end AXIS_PTS
/begin COMPU_METHOD _CNV_A_R_LINEAR_____0_CM "" RAT_FUNC "%6.3" "°C" COEFFS 0 1.333333333333333 64. 0 0 1 /end COMPU_METHOD
/begin COMPU_METHOD _CNV_A_R_LINEAR_____1_CM "" RAT_FUNC "%6.3" "°C" COEFFS 0 1.333333333333333 0. 0 0 1 /end COMPU_METHOD
/begin COMPU_METHOD _CNV_A_R_LINEAR_____2_CM "" RAT_FUNC "%6.3" "°C" COEFFS 0 1. 0. 0 0 1 /end COMPU_METHOD
/begin COMPU_METHOD _CNV_A_R_LINEAR_____3_CM "" RAT_FUNC "%6.3" "°C" COEFFS 0 1. 40. 0 0 1 /end COMPU_METHOD
/begin COMPU_METHOD _CNV_A_R_LINEAR_____4_CM "" RAT_FUNC "%6.3" "%" COEFFS 0 2.56 0. 0 0 1 /end COMPU_METHOD
/begin COMPU_METHOD _CNV_A_R_LINEAR_____5_CM "" RAT_FUNC "%6.3" "rpm" COEFFS 0 3.125e-002 0. 0 0 1 /end COMPU_METHOD
/begin COMPU_METHOD _CNV_A_R_LINEAR_____10_CM "" RAT_FUNC "%6.3" "-" COEFFS 0 1. 0. 0 0 1 /end COMPU_METHOD
/begin COMPU_METHOD _CNV_S_2_RANGE______11_CM "" TAB_VERB "%6.3" "-" COMPU_TAB_REF _CNV_S_2_RANGE______11 /end COMPU_METHOD
/begin COMPU_VTAB _CNV_S_2_RANGE______11 "" TAB_VERB 2 0 "0" 1 "1" /end COMPU_VTAB
/begin COMPU_METHOD _CNV_A_R_LINEAR_____12_CM "" RAT_FUNC "%6.3" "[-]" COEFFS 0 1. 0. 0 0 1 /end COMPU_METHOD
/begin COMPU_METHOD _CNV_A_R_LINEAR_____13_CM "" RAT_FUNC "%6.3" "km/h" COEFFS 0 1. 0. 0 0 1 /end COMPU_METHOD
/begin COMPU_METHOD _CNV_A_R_LINEAR_____14_CM "" RAT_FUNC "%6.3" "s" COEFFS 0 10. 0. 0 0 1 /end COMPU_METHOD
/begin COMPU_METHOD _CNV_A_R_LINEAR_____17_CM "" RAT_FUNC "%6.3" "rpm" COEFFS 0 1. 0. 0 0 1 /end COMPU_METHOD
/begin COMPU_METHOD _CNV_A_R_LINEAR_____18_CM "" RAT_FUNC "%6.3" "mg/stk" COEFFS 0 0.183585313174946 0. 0 0 1 /end COMPU_METHOD
/begin COMPU_METHOD _CNV_A_R_LINEAR_____20_CM "" RAT_FUNC "%6.3" "-" COEFFS 0 255.9983911655618 0. 0 0 1 /end COMPU_METHOD
/begin COMPU_METHOD _CNV_S_2_RANGE______21_R_CM "" TAB_VERB "%6.3" "[-]" COMPU_TAB_REF _CNV_S_2_RANGE______21_R /end COMPU_METHOD
/begin COMPU_VTAB_RANGE _CNV_S_2_RANGE______21_R "" 2 0 0 "0" 1 255 "1" /end COMPU_VTAB_RANGE
/begin COMPU_METHOD _CNV_S_6_RANGE_ERR__22_CM "" TAB_VERB "%6.3" "[-]" COMPU_TAB_REF _CNV_S_6_RANGE_ERR__22 /end COMPU_METHOD
/begin COMPU_VTAB _CNV_S_6_RANGE_ERR__22 "" TAB_VERB 6 0 "NO_SYM" 1 "SYM_0" 2 "SYM_1" 4 "SYM_2" 8 "SYM_3" 15 "BENCH_MODE" /end COMPU_VTAB
/begin COMPU_METHOD _CNV_S_2_RANGE______28_CM "" TAB_VERB "%6.3" "[-]" COMPU_TAB_REF _CNV_S_2_RANGE______28 /end COMPU_METHOD
/begin COMPU_VTAB _CNV_S_2_RANGE______28 "" TAB_VERB 2 0 "0" 1 "1" /end COMPU_VTAB
/begin COMPU_METHOD _CNV_A_R_LINEAR_____33_CM "" RAT_FUNC "%6.3" "V" COEFFS 0 204.7999998974999 0. 0 0 1 /end COMPU_METHOD
/begin COMPU_METHOD _CNV_A_R_LINEAR_____34_CM "" RAT_FUNC "%6.3" "-" COEFFS 0 127.9991955827809 0. 0 0 1 /end COMPU_METHOD
/begin COMPU_METHOD _CNV_A_R_LINEAR_____40_CM "" RAT_FUNC "%6.3" "-" COEFFS 0 16. 0. 0 0 1 /end COMPU_METHOD
/begin COMPU_METHOD _CNV_A_R_LINEAR_____41_CM "" RAT_FUNC "%6.3" "kg/h" COEFFS 0 64. 0. 0 0 1 /end COMPU_METHOD
/begin COMPU_METHOD _CNV_A_R_LINEAR_____43_CM "" RAT_FUNC "%6.3" "hPa" COEFFS 0 12.06017666543982 0. 0 0 1 /end COMPU_METHOD
/begin COMPU_METHOD _CNV_A_R_LINEAR_____44_CM "" RAT_FUNC "%6.3" "[-]" COEFFS 0 255.9999357490357 0. 0 0 1 /end COMPU_METHOD
/begin COMPU_METHOD _CNV_A_R_LINEAR_____45_CM "" RAT_FUNC "%6.3" "-" COEFFS 0 32768.00003968061 0. 0 0 1 /end COMPU_METHOD
/begin COMPU_METHOD _CNV_A_R_LINEAR_____47_CM "" RAT_FUNC "%6.3" "s" COEFFS 0 1. 0. 0 0 1 /end COMPU_METHOD
/begin COMPU_METHOD _CNV_A_R_LINEAR_____80_CM "" RAT_FUNC "%6.3" "km" COEFFS 0 0.1 0. 0 0 1 /end COMPU_METHOD
/begin COMPU_METHOD _CNV_A_R_LINEAR_____94_CM "" RAT_FUNC "%6.3" "%" COEFFS 0 655.3600000071681 0. 0 0 1 /end COMPU_METHOD
/begin COMPU_METHOD _CNV_A_R_LINEAR_____95_CM "" RAT_FUNC "%6.3" "mg/stk" COEFFS 0 47.18142548596112 0. 0 0 1 /end COMPU_METHOD
/begin COMPU_METHOD _CNV_A_R_LINEAR_____97_CM "" RAT_FUNC "%6.3" "hPa" COEFFS 0 12.06017666543982 -1.759293338545831e-002 0 0 1 /end COMPU_METHOD
/begin COMPU_METHOD _CNV_A_R_LINEAR_____98_CM "" RAT_FUNC "%6.3" "%" COEFFS 0 655.3600000071681 3.584063961170614e-007 0 0 1 /end COMPU_METHOD
/begin COMPU_METHOD _CNV_A_R_LINEAR_____99_CM "" RAT_FUNC "%6.3" "kg/h" COEFFS 0 8191.999999679995 0. 0 0 1 /end COMPU_METHOD
/begin COMPU_METHOD _CNV_A_R_LINEAR_____101_CM "" RAT_FUNC "%6.3" "kg/h" COEFFS 0 32. 0. 0 0 1 /end COMPU_METHOD
/begin COMPU_METHOD _CNV_A_R_LINEAR_____112_CM "" RAT_FUNC "%6.3" "-" COEFFS 0 65551.06000970239 0. 0 0 1 /end COMPU_METHOD
/begin COMPU_METHOD _CNV_S_6_STATE_DIAG_180_CM "" TAB_VERB "%6.3" "-" COMPU_TAB_REF _CNV_S_6_STATE_DIAG_180 /end COMPU_METHOD
/begin COMPU_VTAB _CNV_S_6_STATE_DIAG_180 "" TAB_VERB 6 0 "STEP_INIT" 1 "STEP_1" 2 "STEP_2" 3 "STEP_3" 4 "CPS_RAMP" 5 "LOCK_STEP" /end COMPU_VTAB
/begin COMPU_METHOD _CNV_A_R_LINEAR_____181_CM "" RAT_FUNC "%6.3" "cyc" COEFFS 0 1. 0. 0 0 1 /end COMPU_METHOD
/begin COMPU_METHOD _CNV_A_R_LINEAR_____182_CM "" RAT_FUNC "%6.3" "-" COEFFS 0 65535. 0. 0 0 1 /end COMPU_METHOD
/begin COMPU_METHOD _CNV_S_2_RANGE______183_CM "" TAB_VERB "%6.3" "[-]" COMPU_TAB_REF _CNV_S_2_RANGE______183 /end COMPU_METHOD
/begin COMPU_VTAB _CNV_S_2_RANGE______183 "" TAB_VERB 2 0 "PASSIVE" 1 "ACTIVE" /end COMPU_VTAB
/begin COMPU_METHOD _CNV_S_4_STATE_LS_188_CM "" TAB_VERB "%6.3" "[-]" COMPU_TAB_REF _CNV_S_4_STATE_LS_188 /end COMPU_METHOD
/begin COMPU_VTAB _CNV_S_4_STATE_LS_188 "" TAB_VERB 4 1 "OL_CDN" 2 "CL" 4 "OL_INTR" 8 "OL_ERR" /end COMPU_VTAB
/begin COMPU_METHOD _CNV_A_R_LINEAR_____211_CM "" RAT_FUNC "%6.3" "°C" COEFFS 0 16. 0. 0 0 1 /end COMPU_METHOD
/begin COMPU_METHOD _CNV_A_R_LINEAR_____265_CM "" RAT_FUNC "%6.3" "hPa/ms" COEFFS 0 395.2653799758745 -0.5 0 0 1 /end COMPU_METHOD
/begin COMPU_METHOD _CNV_A_R_LINEAR_____277_CM "" RAT_FUNC "%6.3" "g" COEFFS 0 36.00036915004301 0. 0 0 1 /end COMPU_METHOD
/begin COMPU_METHOD _CNV_A_R_LINEAR_____278_CM "" RAT_FUNC "%6.3" "ms" COEFFS 0 51.19999999799997 -1.280015567317605e-006 0 0 1 /end COMPU_METHOD
/begin COMPU_METHOD _CNV_A_R_LINEAR_____285_CM "" RAT_FUNC "%6.3" "ohm" COEFFS 0 1. 0. 0 0 1 /end COMPU_METHOD
/begin COMPU_METHOD _CNV_A_R_LINEAR_____294_CM "" RAT_FUNC "%6.3" "J" COEFFS 0 1. 0. 0 0 1 /end COMPU_METHOD
/begin COMPU_METHOD _CNV_S_9_STATE_OBD2_295_CM "" TAB_VERB "%6.3" "[-]" COMPU_TAB_REF _CNV_S_9_STATE_OBD2_295 /end COMPU_METHOD
/begin COMPU_VTAB _CNV_S_9_STATE_OBD2_295 "" TAB_VERB 9 0 "DIAG_OFF" 1 "DIAG_INIT" 2 "LS_READY" 3 "OBD1_DLY" 4 "OBD1_CHK" 5 "TEG_THD" 6 "POW_INT" 7 "DIAG_ACT" 8 "DIAG_END" /end COMPU_VTAB
/begin COMPU_METHOD _CNV_A_R_LINEAR_____342_CM "" RAT_FUNC "%6.3" "cm²" COEFFS 0 1118.481075453891 2.574382087914273e-004 0 0 1 /end COMPU_METHOD
/begin COMPU_METHOD _CNV_A_R_LINEAR_____348_CM "" RAT_FUNC "%6.3" "-" COEFFS 0 8191.999999679995 0. 0 0 1 /end COMPU_METHOD
/begin COMPU_METHOD _CNV_A_R_LINEAR_____370_CM "" RAT_FUNC "%6.3" "rpm" COEFFS 0 511.9999948599216 0. 0 0 1 /end COMPU_METHOD
/begin COMPU_METHOD _CNV_A_R_LINEAR_____371_CM "" RAT_FUNC "%6.3" "rpm" COEFFS 0 1. 65536. 0 0 1 /end COMPU_METHOD
/begin COMPU_METHOD _CNV_A_R_LINEAR_____372_CM "" RAT_FUNC "%6.3" "rpm" COEFFS 0 31.99899215772732 3.149507102140348e-005 0 0 1 /end COMPU_METHOD
/begin COMPU_METHOD _CNV_A_R_LINEAR_____373_CM "" RAT_FUNC "%6.3" "rpm/10ms" COEFFS 0 4. 0. 0 0 1 /end COMPU_METHOD
/begin COMPU_METHOD _CNV_A_R_LINEAR_____379_CM "" RAT_FUNC "%6.3" "-" COEFFS 0 2048. 0. 0 0 1 /end COMPU_METHOD
/begin COMPU_METHOD _CNV_S_9_STATE_DIAG_401_CM "" TAB_VERB "%6.3" "[-]" COMPU_TAB_REF _CNV_S_9_STATE_DIAG_401 /end COMPU_METHOD
/begin COMPU_VTAB _CNV_S_9_STATE_DIAG_401 "" TAB_VERB 9 0 "SA_DIAG_INACT" 1 "SA_DIAG_DLY" 2 "SA_MIN_DIAG" 3 "SA_DIAG_INTR" 4 "SAV_DIAG_DLY" 5 "SA_DIAG_SAV" 6 "SA_DIAG_CHK" 7 "SA_DIAG_END" 8 "SA_DIAG_CNL" /end COMPU_VTAB
/begin COMPU_METHOD _CNV_A_R_LINEAR_____402_CM "" RAT_FUNC "%6.3" "0.1s" COEFFS 0 10. 0. 0 0 1 /end COMPU_METHOD
/begin COMPU_METHOD _CNV_S_7_STATE_DIAG_404_CM "" TAB_VERB "%6.3" "[-]" COMPU_TAB_REF _CNV_S_7_STATE_DIAG_404 /end COMPU_METHOD
/begin COMPU_VTAB _CNV_S_7_STATE_DIAG_404 "" TAB_VERB 7 0 "SAFM_DIAG_OFF" 1 "SAFM_SAFM_MONIT" 2 "SAFM_MIN_DIAG" 3 "SAFM_WAIT_SAV_DIAG" 4 "SAFM_SAV_DIAG" 5 "SAFM_DIAG_END" 6 "SAFM_DIAG_CNL" /end COMPU_VTAB
/begin COMPU_METHOD _CNV_S_7_STATE_DIAG_405_CM "" TAB_VERB "%6.3" "[-]" COMPU_TAB_REF _CNV_S_7_STATE_DIAG_405 /end COMPU_METHOD
/begin COMPU_VTAB _CNV_S_7_STATE_DIAG_405 "" TAB_VERB 7 0 "NO_ERR" 1 "SAFM_ERR" 2 "SAP_ERR" 3 "SAV_ERR" 4 "MIN_SAF_ERR" 5 "SA_CONF_ERR" 6 "SAV_1_ERR" /end COMPU_VTAB
/begin COMPU_METHOD _CNV_A_R_LINEAR_____406_CM "" RAT_FUNC "%6.3" "kg/h" COEFFS 0 256. 0. 0 0 1 /end COMPU_METHOD
/begin COMPU_METHOD _CNV_A_R_LINEAR_____407_CM "" RAT_FUNC "%6.3" "kg/h" COEFFS 0 64.00027344284068 0.1400027344279806 0 0 1 /end COMPU_METHOD
/begin COMPU_METHOD _CNV_A_R_LINEAR_____408_CM "" RAT_FUNC "%6.3" "kg/h" COEFFS 0 4. 0. 0 0 1 /end COMPU_METHOD
/begin RECORD_LAYOUT _REC_VAL_20_u1 FNC_VALUES 1 UBYTE COLUMN_DIR DIRECT /end RECORD_LAYOUT
/begin RECORD_LAYOUT _REC_MAP_20_u1_u1_u1 FNC_VALUES 1 UBYTE COLUMN_DIR DIRECT /end RECORD_LAYOUT
/begin RECORD_LAYOUT _REC_AXS_20_u1 NO_AXIS_PTS_X 1 UBYTE AXIS_PTS_X 2 UBYTE INDEX_INCR DIRECT /end RECORD_LAYOUT
/begin RECORD_LAYOUT _REC_CUR_20_u1_u1 FNC_VALUES 1 UBYTE COLUMN_DIR DIRECT /end RECORD_LAYOUT
/begin RECORD_LAYOUT _REC_AXS_20_u2 NO_AXIS_PTS_X 1 UWORD AXIS_PTS_X 2 UWORD INDEX_INCR DIRECT /end RECORD_LAYOUT
/begin RECORD_LAYOUT _REC_CUR_20_u2_u2 FNC_VALUES 1 UWORD COLUMN_DIR DIRECT /end RECORD_LAYOUT
/begin RECORD_LAYOUT _REC_VAL_20_u2 FNC_VALUES 1 UWORD COLUMN_DIR DIRECT /end RECORD_LAYOUT
/begin RECORD_LAYOUT _REC_CUR_20_u2_u1 FNC_VALUES 1 UWORD COLUMN_DIR DIRECT /end RECORD_LAYOUT
/begin RECORD_LAYOUT _REC_MAP_20_u1_u1_u2 FNC_VALUES 1 UBYTE COLUMN_DIR DIRECT /end RECORD_LAYOUT
/begin RECORD_LAYOUT _REC_CUR_20_u1_u2 FNC_VALUES 1 UBYTE COLUMN_DIR DIRECT /end RECORD_LAYOUT
/begin RECORD_LAYOUT _REC_MAP_20_u2_u1_u2 FNC_VALUES 1 UWORD COLUMN_DIR DIRECT /end RECORD_LAYOUT
/begin RECORD_LAYOUT _REC_VAL_20_s2 FNC_VALUES 1 SWORD COLUMN_DIR DIRECT /end RECORD_LAYOUT
/begin RECORD_LAYOUT _REC_MAP_20_u1_u2_u2 FNC_VALUES 1 UBYTE COLUMN_DIR DIRECT /end RECORD_LAYOUT
/begin RECORD_LAYOUT _REC_MAP_20_u2_u2_u2 FNC_VALUES 1 UWORD COLUMN_DIR DIRECT /end RECORD_LAYOUT
/begin FUNCTION OBD_Diagnostic_Trouble_Code "_Diagnostic Trouble Code"
 /begin DEF_CHARACTERISTIC ID_ERR_DTC_IMOB_1 ID_ERR_DTC_IMOB_2 ID_ERR_DTC_IMOB_3 ID_ERR_DTC_BSD ID_ERR_DTC_CPS ID_ERR_DTC_CAT_DIAG_1 ID_ERR_DTC_CAT_DIAG_2 ID_ERR_DTC_GEN ID_ERR_DTC_CAM_0_NOT_PLAUS ID_ERR_DTC_BN_ARS ID_ERR_DTC_TQ_DIF_I_IS_MON_1 ID_ERR_DTC_PVS_BLS_NOT_PLAUS ID_ERR_DTC_SAP ID_ERR_DTC_POIL_SWI ID_ERR_DTC_BN_ETCU ID_ERR_DTC_SAV ID_ERR_DTC_PVS_DOUBLE ID_ERR_DTC_CONV_MON_1 ID_ERR_DTC_BN_TQ_TCS ID_ERR_DTC_SA_SAFM ID_ERR_DTC_N_EFP_HIGH ID_ERR_DTC_VLS_UP_PUC_1 ID_ERR_DTC_VLS_UP_PUC_2 ID_ERR_DTC_N_EFP_LOW ID_ERR_DTC_LS_UP_SWT_1 ID_ERR_DTC_LS_UP_SWT_2 ID_ERR_DTC_TOUT_PSTE_1 ID_ERR_TQ_GS_INC_PLAUS ID_ERR_DTC_TPS_MAF_1 ID_ERR_DTC_TPS_MAF_2 ID_ERR_DTC_REF_IVVT_EX_1 ID_ERR_DTC_REF_IVVT_EX_2 ID_ERR_DTC_SA_SAP ID_ERR_DTC_MTC_CTL_1 ID_ERR_DTC_SA_SAV ID_ERR_DTC_MTC_CTL_2 ID_ERR_DTC_MTC_CTL_3 ID_ERR_DTC_DCC_REV ID_ERR_DTC_CAN_BOFF ID_ERR_DTC_ISA_1 ID_ERR_DTC_ISA_2 ID_ERR_DTC_TCO_STUCK ID_ERR_DTC_BN_T_ICL ID_ERR_DTC_PVS_RATIO ID_ERR_DTC_BN_MSW ID_ERR_DTC_EBOX_CFA ID_ERR_DTC_TOUT_ICL_2 ID_ERR_DTC_TOUT_ICL_3 ID_ERR_DTC_MTC_DR ID_ERR_DTC_LS_DOWN_SWT_1 ID_ERR_DTC_LS_DOWN_SWT_2 ID_ERR_DTC_TPS_AD ID_ERR_DTC_ECU_CKS ID_ERR_DTC_BN_ICL ID_ERR_DTC_VLS_DOWN_PUE_1 ID_ERR_DTC_VLS_DOWN_PUE_2 ID_ERR_DTC_DCC_IRREV ID_ERR_DTC_DUR_IGC_0 ID_ERR_DTC_DUR_IGC_1 ID_ERR_DTC_DUR_IGC_2 ID_ERR_DTC_DUR_IGC_3 ID_ERR_DTC_DUR_IGC_4 ID_ERR_DTC_DUR_IGC_5 ID_ERR_DTC_PVS_MON_1 ID_ERR_DTC_LOAD_PLAUS ID_ERR_DTC_VLS_UP_MAX_1 ID_ERR_DTC_VLS_UP_MAX_2 ID_ERR_DTC_N_32_MON_1 ID_ERR_DTC_ECT_EL ID_ERR_DTC_VLS_DOWN_MAX_1 ID_ERR_DTC_VLS_DOWN_MAX_2 ID_ERR_DTC_CRU_INH_MON_1 ID_ERR_DTC_TOUT_ASR_1 ID_ERR_DTC_LSH_DOWN_1 ID_ERR_DTC_LSH_DOWN_2 ID_ERR_DTC_TOUT_ASR_3 ID_ERR_DTC_TCO_PLAUS ID_ERR_DTC_BN_TCS ID_ERR_DTC_TQ_DIF_P_D_IS_MON_1 ID_ERR_DTC_ECU_RAM ID_ERR_DTC_TIA ID_ERR_DTC_CRASH_EFP ID_ERR_DTC_TPU_SYN ID_ERR_DTC_TOUT_AMT_1 ID_ERR_DTC_TECU ID_ERR_DTC_TQI_N_MAX_MON_1 ID_ERR_DTC_MAF ID_ERR_DTC_RLY_EFP ID_ERR_DTC_BN_KM_ICL ID_ERR_DTC_MEC_IVVT_IN_1 ID_ERR_DTC_MEC_IVVT_IN_2 ID_ERR_DTC_CRK_NOT_PLAUS ID_ERR_DTC_TPS_PLAUS ID_ERR_DTC_TOUT_ETCU_1 ID_ERR_DTC_TOUT_ETCU_2 ID_ERR_DTC_FSD_1 ID_ERR_DTC_FSD_2 ID_ERR_DTC_CAM_PER_0 ID_ERR_DTC_CAM_PER_1 ID_ERR_DTC_SOF ID_ERR_DTC_BN_ANG_PSTE ID_ERR_DTC_TEG_PCAT_DOWN_1 ID_ERR_DTC_TEG_PCAT_DOWN_2 ID_ERR_DTC_CHK_LS_DOWN_1 ID_ERR_DTC_CHK_LS_DOWN_2 ID_ERR_DTC_TCO_EL ID_ERR_DTC_BN_ACC ID_ERR_DTC_TCO_EX ID_ERR_DTC_BN_TQ_DCC ID_ERR_DTC_MSW_2 ID_ERR_DTC_MSW_3 ID_ERR_DTC_SLV_IVVT_IN_1 ID_ERR_DTC_SLV_IVVT_IN_2 ID_ERR_DTC_DMTL_PUMP ID_ERR_DTC_ENG_PSN ID_ERR_DTC_TPS_MON_1 ID_ERR_DTC_MSW_TOG ID_ERR_DTC_BN_TQ_AMT ID_ERR_DTC_TOIL ID_ERR_DTC_VLS_UP_OC_1 ID_ERR_DTC_VLS_UP_OC_2 ID_ERR_DTC_VIM ID_ERR_DTC_BN_POW_GEN ID_ERR_DTC_VLS_UP_STK_1 ID_ERR_DTC_VLS_UP_STK_2 ID_ERR_DTC_LSH_UP_1 ID_ERR_DTC_LSH_UP_2 ID_ERR_DTC_TOUT_TXU_1 ID_ERR_DTC_KNKS_1 ID_ERR_DTC_KNKS_2 ID_ERR_DTC_MEC_ISA ID_ERR_DTC_TQ_MAX_CLU_MON_1 ID_ERR_DTC_BN_CAS ID_ERR_DTC_VLS_UP_MIN_COLD_1 ID_ERR_DTC_VLS_UP_MIN_COLD_2 ID_ERR_DTC_TD_IGC_CUT_0 ID_ERR_DTC_TD_IGC_CUT_1 ID_ERR_DTC_TD_IGC_CUT_2 ID_ERR_DTC_TD_IGC_CUT_3 ID_ERR_DTC_TD_IGC_CUT_4 ID_ERR_DTC_TD_IGC_CUT_5 ID_ERR_DTC_V_REF_1 ID_ERR_DTC_V_REF_2 ID_ERR_DTC_BN_VS_TCS ID_ERR_DTC_MEC_IVVT_EX_1 ID_ERR_DTC_MEC_IVVT_EX_2 ID_ERR_DTC_PVS_1 ID_ERR_DTC_PVS_2 ID_ERR_DTC_ECT_MEC ID_ERR_DTC_TQI_AV_MON_1 ID_ERR_DTC_LS_UP_FRQ_1 ID_ERR_DTC_LS_UP_FRQ_2 ID_ERR_DTC_VLS_DOWN_MIN_COLD_1 ID_ERR_DTC_VLS_DOWN_MIN_COLD_2 ID_ERR_DTC_BN_POW_VB ID_ERR_DTC_SOF_REQ ID_ERR_DTC_MSR_INH_MON_1 ID_ERR_DTC_ECF ID_ERR_DTC_MIS_LOW_FUEL ID_ERR_DTC_DMTLM ID_ERR_DTC_CAM_1_NOT_PLAUS ID_ERR_DTC_DMTLS ID_ERR_DTC_RLY_ACCOUT ID_ERR_DTC_LOCAN_BOFF ID_ERR_DTC_IV_0 ID_ERR_DTC_IV_1 ID_ERR_DTC_IV_2 ID_ERR_DTC_SLV_IVVT_EX_1 ID_ERR_DTC_RLY_MAIN ID_ERR_DTC_IV_3 ID_ERR_DTC_SLV_IVVT_EX_2 ID_ERR_DTC_IV_4 ID_ERR_DTC_IV_5 ID_ERR_DTC_MAF_MON_1 ID_ERR_DTC_VLS_DOWN_OC_1 ID_ERR_DTC_VLS_DOWN_OC_2 ID_ERR_DTC_CAM_PSN_0 ID_ERR_DTC_CAM_PSN_1 ID_ERR_DTC_LOAD_TPS_PLAUS ID_ERR_DTC_RLY_ST ID_ERR_DTC_TQ_LOSS_MON_1 ID_ERR_DTC_OBD2_LSH_UP_1 ID_ERR_DTC_DIAGCPS ID_ERR_DTC_OBD2_LSH_UP_2 ID_ERR_DTC_TOOTH_PER ID_ERR_DTC_TPS_1 ID_ERR_DTC_TPS_2 ID_ERR_DTC_DMTL_LEAK ID_ERR_DTC_TQI_LIM ID_ERR_DTC_IM_BLS_PLAUS ID_ERR_DTC_TQI_N_MAX_NVMY_MON ID_ERR_DTC_VS ID_ERR_DTC_TOUT_EFP ID_ERR_DTC_EFP_TEMP ID_ERR_DTC_EFP_LIH ID_ERR_DTC_TPS_ST_CHK_1 ID_ERR_DTC_VLS_UP_MIN_1 ID_ERR_DTC_TPS_ST_CHK_2 ID_ERR_DTC_VLS_UP_MIN_2 ID_ERR_DTC_GEN_IF ID_ERR_DTC_TPS_AD_BOL ID_ERR_DTC_OBD2_LSH_DOWN_1 ID_ERR_DTC_VLS_DOWN_MIN_1 ID_ERR_DTC_TCO_GRD ID_ERR_DTC_OBD2_LSH_DOWN_2 ID_ERR_DTC_VLS_DOWN_MIN_2 ID_ERR_DTC_IM_BTS_PLAUS ID_ERR_DTC_REF_IVVT_IN_1 ID_ERR_DTC_REF_IVVT_IN_2 ID_ERR_DTC_BN_TQ_ETCU ID_ERR_DTC_TQ_MIN_CLU_MON_1 ID_ERR_DTC_BN_VEH_MOD ID_ERR_DTC_QOIL_SENS ID_ERR_DTC_EF ID_ERR_DTC_TOIL_LEVEL ID_ERR_DTC_AMP ID_ERR_DTC_RLY_MAIN_DLY ID_ERR_DTC_ISC ID_ERR_DTC_CHG_LS_DOWN ID_ERR_DTC_CHG_LS_UP ID_ERR_DTC_LAM_DLY_1 ID_ERR_DTC_LAM_DLY_2 ID_ERR_DTC_SEG_T_AD ID_ERR_DTC_SEG_T ID_ERR_DTC_ECRAS ID_ERR_DTC_DMTLH ID_ERR_DTC_MIS /end DEF_CHARACTERISTIC
 /begin OUT_MEASUREMENT SYM_CYL_MEM_MIS_A SYM_CYL_MEM_MIS_B4 SYM_CYL_MEM_MIS_B1 DTC_COD_0 ERR_SYM_MEM_0 DTC_COD_1 ERR_SYM_MEM_1 DTC_COD_2 ERR_SYM_MEM_2 DTC_COD_3 ERR_SYM_MEM_3 DTC_COD_4 ERR_SYM_MEM_4 DTC_COD_5 ERR_SYM_MEM_5 DTC_COD_6 ERR_SYM_MEM_6 DTC_COD_7 ERR_SYM_MEM_7 DTC_COD_8 ERR_SYM_MEM_8 DTC_COD_9 ERR_SYM_MEM_9 /end OUT_MEASUREMENT
/end FUNCTION
/begin FUNCTION OBD_Failure_class "_Failure class"
 /begin DEF_CHARACTERISTIC C_ERR_CLAS_IMOB_1 C_ERR_CLAS_IMOB_2 C_ERR_CLAS_IMOB_3 ID_CLAS_B_FMT ID_CLAS_A_FMT C_ERR_CLAS_BSD C_ERR_CLAS_CPS C_ERR_CLAS_CAT_DIAG_1 C_ERR_CLAS_CAT_DIAG_2 C_ERR_CLAS_GEN C_ERR_CLAS_CAM_0_NOT_PLAUS C_ERR_CLAS_BN_ARS C_ERR_CLAS_TQ_DIF_I_IS_MON_1 C_ERR_CLAS_PVS_BLS_NOT_PLAUS C_ERR_CLAS_SAP C_ERR_CLAS_POIL_SWI C_ERR_CLAS_BN_ETCU C_ERR_CLAS_SAV C_ERR_CLAS_PVS_DOUBLE C_ERR_CLAS_CONV_MON_1 C_ERR_CLAS_BN_TQ_TCS C_ERR_CLAS_SA_SAFM C_ERR_CLAS_N_EFP_HIGH C_ERR_CLAS_VLS_UP_PUC_1 C_ERR_CLAS_VLS_UP_PUC_2 C_ERR_CLAS_N_EFP_LOW C_ERR_CLAS_LS_UP_SWT_1 C_ERR_CLAS_LS_UP_SWT_2 C_ERR_CLAS_TOUT_PSTE_1 C_ERR_CLAS_TQ_GS_INC_PLAUS C_ERR_CLAS_TPS_MAF_1 C_ERR_CLAS_TPS_MAF_2 C_ERR_CLAS_REF_IVVT_EX_1 C_ERR_CLAS_REF_IVVT_EX_2 C_ERR_CLAS_SA_SAP C_ERR_CLAS_MTC_CTL_1 C_ERR_CLAS_SA_SAV C_ERR_CLAS_MTC_CTL_2 C_ERR_CLAS_MTC_CTL_3 C_ERR_CLAS_DCC_REV C_ERR_CLAS_CAN_BOFF C_ERR_CLAS_ISA_1 C_ERR_CLAS_ISA_2 C_ERR_CLAS_TCO_STUCK C_ERR_CLAS_BN_T_ICL C_ERR_CLAS_PVS_RATIO C_ERR_CLAS_BN_MSW C_ERR_CLAS_EBOX_CFA C_ERR_CLAS_TOUT_ICL_2 C_ERR_CLAS_TOUT_ICL_3 C_ERR_CLAS_MTC_DR C_ERR_CLAS_LS_DOWN_SWT_1 C_ERR_CLAS_LS_DOWN_SWT_2 C_ERR_CLAS_TPS_AD C_ERR_CLAS_ECU_CKS C_ERR_CLAS_BN_ICL C_ERR_CLAS_VLS_DOWN_PUE_1 C_ERR_CLAS_VLS_DOWN_PUE_2 C_ERR_CLAS_DCC_IRREV C_ERR_CLAS_DUR_IGC_0 C_ERR_CLAS_DUR_IGC_1 C_ERR_CLAS_DUR_IGC_2 C_ERR_CLAS_DUR_IGC_3 C_ERR_CLAS_DUR_IGC_4 C_ERR_CLAS_DUR_IGC_5 C_ERR_CLAS_PVS_MON_1 C_ERR_CLAS_LOAD_PLAUS C_ERR_CLAS_VLS_UP_MAX_1 C_ERR_CLAS_VLS_UP_MAX_2 C_ERR_CLAS_N_32_MON_1 C_ERR_CLAS_ECT_EL C_ERR_CLAS_VLS_DOWN_MAX_1 C_ERR_CLAS_VLS_DOWN_MAX_2 C_ERR_CLAS_CRU_INH_MON_1 C_ERR_CLAS_TOUT_ASR_1 C_ERR_CLAS_LSH_DOWN_1 C_ERR_CLAS_LSH_DOWN_2 C_ERR_CLAS_TOUT_ASR_3 C_ERR_CLAS_TCO_PLAUS C_ERR_CLAS_BN_TCS C_ERR_CLAS_TQ_DIF_P_D_IS_MON_1 C_ERR_CLAS_ECU_RAM C_ERR_CLAS_TIA C_ERR_CLAS_CRASH_EFP C_ERR_CLAS_TPU_SYN C_ERR_CLAS_TOUT_AMT_1 C_ERR_CLAS_TECU C_ERR_CLAS_TQI_N_MAX_MON_1 C_ERR_CLAS_MAF C_ERR_CLAS_RLY_EFP C_ERR_CLAS_BN_KM_ICL C_ERR_CLAS_MEC_IVVT_IN_1 C_ERR_CLAS_MEC_IVVT_IN_2 C_ERR_CLAS_CRK_NOT_PLAUS C_ERR_CLAS_TPS_PLAUS C_ERR_CLAS_TOUT_ETCU_1 C_ERR_CLAS_TOUT_ETCU_2 C_ERR_CLAS_FSD_1 C_ERR_CLAS_FSD_2 C_ERR_CLAS_CAM_PER_0 C_ERR_CLAS_CAM_PER_1 C_ERR_CLAS_SOF C_ERR_CLAS_BN_ANG_PSTE C_ERR_CLAS_TEG_PCAT_DOWN_1 C_ERR_CLAS_TEG_PCAT_DOWN_2 C_ERR_CLAS_CHK_LS_DOWN_1 C_ERR_CLAS_CHK_LS_DOWN_2 C_ERR_CLAS_TCO_EL C_ERR_CLAS_BN_ACC C_ERR_CLAS_TCO_EX C_ERR_CLAS_BN_TQ_DCC C_ERR_CLAS_MSW_2 C_ERR_CLAS_MSW_3 C_ERR_CLAS_SLV_IVVT_IN_1 C_ERR_CLAS_SLV_IVVT_IN_2 C_ERR_CLAS_DMTL_PUMP C_ERR_CLAS_ENG_PSN C_ERR_CLAS_TPS_MON_1 C_ERR_CLAS_MSW_TOG C_ERR_CLAS_BN_TQ_AMT C_ERR_CLAS_TOIL C_ERR_CLAS_VLS_UP_OC_1 C_ERR_CLAS_VLS_UP_OC_2 C_ERR_CLAS_VIM C_ERR_CLAS_BN_POW_GEN C_ERR_CLAS_VLS_UP_STK_1 C_ERR_CLAS_VLS_UP_STK_2 C_ERR_CLAS_LSH_UP_1 C_ERR_CLAS_LSH_UP_2 C_ERR_CLAS_TOUT_TXU_1 C_ERR_CLAS_KNKS_1 C_ERR_CLAS_KNKS_2 C_ERR_CLAS_MEC_ISA C_ERR_CLAS_TQ_MAX_CLU_MON_1 C_ERR_CLAS_BN_CAS C_ERR_CLAS_VLS_UP_MIN_COLD_1 C_ERR_CLAS_VLS_UP_MIN_COLD_2 C_ERR_CLAS_TD_IGC_CUT_0 C_ERR_CLAS_TD_IGC_CUT_1 C_ERR_CLAS_TD_IGC_CUT_2 C_ERR_CLAS_TD_IGC_CUT_3 C_ERR_CLAS_TD_IGC_CUT_4 C_ERR_CLAS_TD_IGC_CUT_5 C_ERR_CLAS_V_REF_1 C_ERR_CLAS_V_REF_2 C_ERR_CLAS_BN_VS_TCS C_ERR_CLAS_MEC_IVVT_EX_1 C_ERR_CLAS_MEC_IVVT_EX_2 C_ERR_CLAS_PVS_1 C_ERR_CLAS_PVS_2 C_ERR_CLAS_ECT_MEC C_ERR_CLAS_TQI_AV_MON_1 C_ERR_CLAS_LS_UP_FRQ_1 C_ERR_CLAS_LS_UP_FRQ_2 C_ERR_CLAS_VLS_DOWN_MIN_COLD_1 C_ERR_CLAS_VLS_DOWN_MIN_COLD_2 C_ERR_CLAS_BN_POW_VB C_ERR_CLAS_SOF_REQ C_ERR_CLAS_MSR_INH_MON_1 C_ERR_CLAS_ECF C_ERR_CLAS_MIS_LOW_FUEL C_ERR_CLAS_DMTLM C_ERR_CLAS_CAM_1_NOT_PLAUS C_ERR_CLAS_DMTLS C_ERR_CLAS_RLY_ACCOUT C_ERR_CLAS_LOCAN_BOFF C_ERR_CLAS_IV_0 C_ERR_CLAS_IV_1 C_ERR_CLAS_IV_2 C_ERR_CLAS_SLV_IVVT_EX_1 C_ERR_CLAS_RLY_MAIN C_ERR_CLAS_IV_3 C_ERR_CLAS_SLV_IVVT_EX_2 C_ERR_CLAS_IV_4 C_ERR_CLAS_IV_5 C_ERR_CLAS_MAF_MON_1 C_ERR_CLAS_VLS_DOWN_OC_1 C_ERR_CLAS_VLS_DOWN_OC_2 C_ERR_CLAS_CAM_PSN_0 C_ERR_CLAS_CAM_PSN_1 C_ERR_CLAS_LOAD_TPS_PLAUS C_ERR_CLAS_RLY_ST C_ERR_CLAS_TQ_LOSS_MON_1 C_ERR_CLAS_OBD2_LSH_UP_1 C_ERR_CLAS_DIAGCPS C_ERR_CLAS_OBD2_LSH_UP_2 C_ERR_CLAS_TOOTH_PER C_ERR_CLAS_TPS_1 C_ERR_CLAS_TPS_2 C_ERR_CLAS_DMTL_LEAK C_ERR_CLAS_TQI_LIM C_ERR_CLAS_IM_BLS_PLAUS C_ERR_CLAS_TQI_N_MAX_NVMY_MON C_ERR_CLAS_VS C_ERR_CLAS_TOUT_EFP C_ERR_CLAS_EFP_TEMP C_ERR_CLAS_EFP_LIH C_ERR_CLAS_TPS_ST_CHK_1 C_ERR_CLAS_VLS_UP_MIN_1 C_ERR_CLAS_TPS_ST_CHK_2 C_ERR_CLAS_VLS_UP_MIN_2 C_ERR_CLAS_GEN_IF C_ERR_CLAS_TPS_AD_BOL C_ERR_CLAS_OBD2_LSH_DOWN_1 C_ERR_CLAS_VLS_DOWN_MIN_1 C_ERR_CLAS_TCO_GRD C_ERR_CLAS_OBD2_LSH_DOWN_2 C_ERR_CLAS_VLS_DOWN_MIN_2 C_ERR_CLAS_IM_BTS_PLAUS C_ERR_CLAS_REF_IVVT_IN_1 C_ERR_CLAS_REF_IVVT_IN_2 C_ERR_CLAS_BN_TQ_ETCU C_ERR_CLAS_TQ_MIN_CLU_MON_1 C_ERR_CLAS_BN_VEH_MOD C_ERR_CLAS_QOIL_SENS C_ERR_CLAS_EF C_ERR_CLAS_TOIL_LEVEL C_ERR_CLAS_AMP C_ERR_CLAS_RLY_MAIN_DLY C_ERR_CLAS_ISC C_ERR_CLAS_CHG_LS_DOWN C_ERR_CLAS_CHG_LS_UP C_ERR_CLAS_LAM_DLY_1 C_ERR_CLAS_LAM_DLY_2 C_ERR_CLAS_SEG_T_AD C_ERR_CLAS_SEG_T C_ERR_CLAS_MIS_B1 C_ERR_CLAS_MIS_B4 C_ERR_CLAS_MIS_A C_ERR_CLAS_ECRAS C_ERR_CLAS_DMTLH /end DEF_CHARACTERISTIC
/end FUNCTION
/begin FUNCTION OBD_Application_incidences_for_f "_Application incidences for fuel system diagnosis" /begin DEF_CHARACTERISTIC C_CL_MMV_MAX_FSD LC_INH_FSD_MAN_DEAC /end DEF_CHARACTERISTIC
 /begin OUT_MEASUREMENT LV_INH_DIAG_FSD_CP LV_ERR_DET_FSD_1 LV_ERR_DET_FSD_2 LV_INH_DIAG_FSD /end OUT_MEASUREMENT
/end FUNCTION
/begin FUNCTION OBD_Application_incidence_cataly "_Application incidence catalyst efficiency diagnosis (OSC Method)" /begin DEF_CHARACTERISTIC LC_INH_CAT_DIAG_MAN_DEAC /end DEF_CHARACTERISTIC /end FUNCTION
/begin FUNCTION OBD_Downstream_oxygen_sensor_hea "_Downstream oxygen sensor heater OBDII monitoring"
 /begin DEF_CHARACTERISTIC IP_FAC_MAF_LSH_DOWN C_PWM_MIN_OBD2_LSH_DOWN C_PWM_MAX_OBD2_LSH_DOWN C_T_DLY_OBD2_LSH_DOWN C_TEMP_MIN_OBD2_LSH_DOWN C_TEMP_SET_OBD2_LSH_DOWN C_EGY_MIN_OBD2_LSH_DOWN C_R_THD_OBD2_LSH_DOWN C_TCC_OBD2_LSH_DOWN C_FRC_OBD2_LSH_DOWN /end DEF_CHARACTERISTIC
 /begin OUT_MEASUREMENT LV_INH_DIAG_OBD2_LSH_DOWN_1 POW_INT_OBD2_LSH_DOWN_1 STATE_OBD2_LSH_DOWN_1 TCC_OBD2_LSH_DOWN_1 FRC_OBD2_LSH_DOWN_1 CTR_CYCNR_R_OBD2_LSH_DOWN_1 R_DOWN_LS_OBD2_LSH_DOWN_1 TEMP_DIF_OBD2_LSH_DOWN_1 LV_INH_DIAG_OBD2_LSH_DOWN_2 POW_INT_OBD2_LSH_DOWN_2 STATE_OBD2_LSH_DOWN_2 TCC_OBD2_LSH_DOWN_2 FRC_OBD2_LSH_DOWN_2 CTR_CYCNR_R_OBD2_LSH_DOWN_2 R_DOWN_LS_OBD2_LSH_DOWN_2 TEMP_DIF_OBD2_LSH_DOWN_2 LV_ERR_OBD2_LSH_DOWN_1 LV_ERR_OBD2_LSH_DOWN_2 /end OUT_MEASUREMENT
/end FUNCTION
/begin FUNCTION OBD_SA_system_diagnosis_through_ "_SA system diagnosis through SAF - determination"
 /begin DEF_CHARACTERISTIC ID_SAF_KGH_DIAG_MIN ID_SAF_KGH_DIAG_MAX C_SUM_SAF_DIAG_MIN C_SUM_SAF_DIAG_MAX C_SAF_DIAG_MIN C_SAF_DIAG_MAX C_SUM_SAFM_DIAG C_T_DLY_DIAG_SAFM C_SAF_KGH_DIF C_SAF_MES_THD C_T_MAX_DIAG_SAV C_SUM_SAV_THD C_SAF_KGH_DIF_SAV_DIAG C_MAF_KGH_MIN_SAF C_T_DLY_DIAG_SAV C_T_DLY_INTR_DIAG_SAFM /end DEF_CHARACTERISTIC
 /begin OUT_MEASUREMENT LV_ERR_SA_SAFM STATE_DIAG_SA_SAFM STATE_DIAG_SA_ERR LV_SAFM_MONIT_DIAG_END LV_SA_MIN_DIAG_END LV_SAV_DIAG_END LV_SA_T_DIAG_START CTR_SAFM_DIAG SAF_KGH_MAX_DIAG SAF_KGH_MIN_DIAG SAF_KGH_DIF SUM_SAF_DIAG_MAX SUM_SAF_DIAG_QUO_MAX SAF_DIAG_QUO_MAX SUM_SAF_DIAG_MIN SUM_SAF_DIAG_QUO_MIN SAF_DIAG_MAX SAF_DIAG_QUO_MIN SAF_DIAG_MIN SAF_KGH_DIAG SAF_KGH_DIF_SAV_DIAG LV_SAP_SAV_CNL SUM_SAV_THD T_DLY_INTR_DIAG_SAFM /end OUT_MEASUREMENT
/end FUNCTION
/begin FUNCTION OBD_Application_incidences_for_S "_Application incidences for SA system monitoring through SAFM" /begin DEF_CHARACTERISTIC LC_INH_SAFM_MAN_DEAC C_MAF_KGH_MAX_DIAG_SA /end DEF_CHARACTERISTIC
 /begin OUT_MEASUREMENT LV_SA_MIN_FLOW_DIAG LV_SAP_CNL STATE_DIAG_SA_LS LV_INH_DIAG_SA /end OUT_MEASUREMENT
/end FUNCTION
/begin FUNCTION OBD_Functional_Check_CPS "_Functional Check CPS"
 /begin DEF_CHARACTERISTIC C_CL_MMV_DIAGCPS C_FLOW_SP_DIAGCPS_MAF C_FLOW_SP_DIAGCPS_N C_LGRD_FLOW_SP_NEG_DIAGCPS C_LGRD_FLOW_SP_POS_DIAGCPS C_MAF_DIAGCPS C_N_DIAGCPS C_N_DIF_DIAGCPS C_SUM_FLOW_SP_DIAGCPS_MAX C_SUM_DIAGCPS_MAX C_T_DIAGCPS_MAF C_T_DIAGCPS_N_1 C_T_DIAGCPS_N_2 C_T_DIAGCPS_N_3 C_T_DIAGCPS_DLY C_CRLC_ISAPWM_DIAGCPS C_ISAPWM_DYW_DIAGCPS C_TCO_MIN_DIAGCPS /end DEF_CHARACTERISTIC
 /begin OUT_MEASUREMENT LV_INH_DIAGCPS LV_DI_DIAGCPS FLOW_SP_CP_DIAGCPS STATE_DIAGCPS LV_ACT_DIAGCPS LV_MAF_DIAGCPS_0 LV_MAF_DIAGCPS_1 LV_N_DIF_DIAGCPS LV_SUPP_ACCIN_DIAGCPS MAF_DIAGCPS N_DIAGCPS SUM_FLOW_SP_DIAGCPS_EOL SUM_FLOW_SP_DIAGCPS SUM_DIAG_DIAGCPS_EOL SUM_DIAG_DIAGCPS T_DIAGCPS_DLY T_DIAGCPS_MAF T_DIAGCPS_N_1 T_DIAGCPS_N_2 T_DIAGCPS_N_3 ISAPWM_MMV_DIAGCPS LV_ISAPWM_DYW_DIAGCPS /end OUT_MEASUREMENT
/end FUNCTION
/begin FUNCTION OBD_Load_Throttle_position_ratio "_Load-Throttle position rationality check"
 /begin DEF_CHARACTERISTIC C_AMP_MDL_DIF_REL_PLAUS_MAX_1 C_AMP_MDL_DIF_REL_PLAUS_MAX_2 C_AMP_MDL_DIF_REL_PLAUS_MIN_1 C_AMP_MDL_DIF_REL_PLAUS_MIN_2 C_AR_RED_AD_FAC_PLAUS_MAX C_AR_RED_AD_FAC_PLAUS_MIN C_AR_RED_AD_ADD_PLAUS_MAX C_AR_RED_AD_ADD_PLAUS_MIN C_AR_RED_DIF_REL_PLAUS_MAX_1 C_AR_RED_DIF_REL_PLAUS_MAX_2 C_AR_RED_DIF_REL_PLAUS_MIN_1 C_AR_RED_DIF_REL_PLAUS_MIN_2 C_CRLC_AMP_MDL_DIF C_CRLC_AR_RED_DIF_REL C_MAP_DRV1_MAX_LOAD_TPS_PLAUS C_MAP_DRV1_MIN_LOAD_TPS_PLAUS C_N_MAX_LOAD_TPS_PLAUS C_N_MIN_LOAD_TPS_PLAUS C_PQ_MAX_LOAD_TPS_PLAUS C_PQ_MIN_LOAD_TPS_PLAUS LC_USE_FSD /end DEF_CHARACTERISTIC
 /begin OUT_MEASUREMENT LV_AMP_CTL_RST LV_AR_RED_CTL_RST LV_RATIO_CHK_ERR AMP_MDL_DIF_MMV_REL AR_RED_DIF_REL_MMV AMP_MDL_DIF_MMV LV_ERR_TPS_PLAUS LV_ERR_LOAD_PLAUS LV_ERR_LOAD_TPS_PLAUS /end OUT_MEASUREMENT
/end FUNCTION
/begin FUNCTION OBD_Application_incidences_Load_ "_Application incidences Load-Throttle position rationality check" /begin OUT_MEASUREMENT LV_INH_LOAD_TPS_PLAUS LV_BAS_THD_LOAD_TPS_PLAUS /end OUT_MEASUREMENT /end FUNCTION
/begin FUNCTION OBD_Application_incidence_Oxygen "_Application incidence Oxygen Sensor Swapped Signal Diagnosis for binary lambda control" /begin OUT_MEASUREMENT LV_INH_DIAG_CHG_LS_UP LV_INH_DIAG_CHG_LS_DOWN /end OUT_MEASUREMENT /end FUNCTION
/begin FUNCTION OBD_Oxygen_Sensor_Interchanged_S "_Oxygen Sensor Interchanged Signal Diagnosis"
 /begin DEF_CHARACTERISTIC C_MIN_LAM_MV_DIAG_CHG_LS_UP C_MAX_LAM_MV_DIAG_CHG_LS_UP C_T_END_DIAG_CHG_LS_UP C_T_END_DIAG_CHG_LS_DOWN C_MAF_INT_DIAG_CHG_LS_UP C_MAF_INT_DIAG_CHG_LS_DOWN C_MIN_VLS_DIF_DLY_CHG_LS_DOWN C_MAX_VLS_DIF_DLY_CHG_LS_DOWN /end DEF_CHARACTERISTIC
 /begin OUT_MEASUREMENT LV_ERR_CHG_LS_DOWN LV_ERR_CHG_LS_UP T_END_DIAG_CHG_LS_UP T_END_DIAG_CHG_LS_DOWN MAF_INT_DIAG_CHG_LS_UP MAF_INT_DIAG_CHG_LS_DOWN /end OUT_MEASUREMENT
/end FUNCTION
/begin FUNCTION OBD_OBD_II_diagnosis_of_the_lamb "_OBD II diagnosis of the lambda trim control" /begin DEF_CHARACTERISTIC C_T_LAM_DLY_AD_MAX C_T_LAM_DLY_AD_MIN /end DEF_CHARACTERISTIC /begin OUT_MEASUREMENT LV_ERR_LAM_DLY_1 LV_ERR_LAM_DLY_2 /end OUT_MEASUREMENT /end FUNCTION
/begin FUNCTION OBD_Application_incidences_of_Dy "_Application incidences of Dynamic fuel trim diagnosis" /begin OUT_MEASUREMENT LV_INH_DIAG_LAM_DLY_1 LV_INH_DIAG_LAM_DLY_2 /end OUT_MEASUREMENT /end FUNCTION
/begin FUNCTION OBD_Application_incidence_enviro "_Application incidence environmental data" /begin DEF_CHARACTERISTIC IP_LOAD_CLC_AMP__AMP IP_LOAD_CLC__N_32__MAF /end DEF_CHARACTERISTIC /begin OUT_MEASUREMENT LOAD_CLC STATE_LS_1 STATE_LS_2 /end OUT_MEASUREMENT /end FUNCTION
/begin FUNCTION OBD_Application_incidences_of_th "_Application incidences of the function Oxygen sensor downstream active plausibility check" /end FUNCTION
/begin FUNCTION SYS_System_Variables "SYS"
 /begin SUB_FUNCTION SYS_Engine_speed_setpoint_calcul SYS_Engine_speed_limit_coordinat SYS_Mass_airflow_variables SYS_Intake_manifold_model SYS_Pressure_decrease_in_the_air SYS_Volumetric_efficiency SYS_Vehicle_speed_variables SYS_Battery_voltage SYS_Coolant_temperature SYS_Air_temperature SYS_Exhaust_temperature_variable SYS_Determination_of_accelerator SYS_IVVT_Variables SYS_Gear_ratio_detection SYS_Drive_train_engaged SYS_Clutch_switch_detection SYS_Input_messages SYS_Oil_temperature SYS_Ambient_pressure_variables SYS_System_variables_in_the_exha SYS_Reduced_area_controller SYS_Ambient_Pressure_Control SYS_Engine_speed_calculation SYS_Fuel_pressure_acquisition SYS_Detection_of_Driver_Passive SYS_System_variables_for_and_fro SYS_ECU_state SYS_Pressure_Variables SYS_Engine_off_duration SYS_Calculation_of_the_basic_red SYS_Total_running_time SYS_Determination_of_Throttle_Po _Intake_manifold_model SYS_Vol_Eff_Cor_due_to_VIM_Influ SYS_ECU_Temperature SYS_Vol_Eff_Cor_due_to_Port_Flap SYS_Output_signals_of_the_DME_to SYS_Check_Sum_Calculation SYS_Multiplexed_segment_synchron SYS_Oil_temperature_and_level_se SYS_Evaporative_Emission_Control SYS_BN2000_interface_torque_dist SYS_Application_incidences_for_o /end SUB_FUNCTION
/end FUNCTION
/begin FUNCTION SYS_Engine_speed_setpoint_calcul "_Engine speed setpoint calculation"
 /begin DEF_CHARACTERISTIC C_N_DIF_CRLC C_N_DIF_MIN_MMV C_N_DIF_FAC IP_DRI_ACIN_N_SP_IS IP_DRI_N_SP_IS C_DRI_VS_MIN_VB IP_N_SP_IS_LIH IP_DRI_N_SP_IS_LIH IP_N_SP_IS IP_ACIN_N_SP_IS IP_FAC_N_SP_OFS_KWP IP_DRI_N_SP_CH IP_N_SP_CH IP_FAC_DRI_N_SP_CH IP_FAC_N_SP_CH IP_N_SP_DEC_CH IP_T_AST_MIN_N_SP_IS_CS IP_N_SP_IS_CS C_N_SP_OFS_KWP_MAX C_N_SP_OFS_KWP_MIN C_TAM_N_SP_HEAT C_TAM_HYS C_N_SP_HEAT_MT C_N_SP_HEAT_AT C_N_SP_INC_CS C_N_SP_DEC_CS C_TOIL_MIN_N_SP_AT C_TOIL_HYS_N_SP_AT C_N_SP_TOIL_AT C_N_SP_LGRD_IS C_N_SP_LGRD_IS_LIH /end DEF_CHARACTERISTIC
 /begin OUT_MEASUREMENT N_DIF_COR N_DIF_MMV N_MAX_TOL_ST N_DIF_ST N_SP_IS_RATIO N_DIF N_SP_IS_POW N_SP_IS N_SP_IS_CH N_SP_IS_2 N_SP_IS_3 LV_REQ_HEAT_N_SP_IS /end OUT_MEASUREMENT
/end FUNCTION
/begin FUNCTION SYS_Engine_speed_limit_coordinat "_Engine speed limit coordination"
 /begin DEF_CHARACTERISTIC IP_N_MAX_MTC_CUR_OFF__PV_AV C_VS_MIN_MT C_N_MAX_MT C_GR_MT C_N_MAX_GR C_VS_MIN_AT_1 C_VS_MIN_AT_2 C_N_MAX_AT C_N_MAX_MTC_LIH C_VS_MAX C_N_MAX_THD_MIN C_VS_MAX_AMT IP_N_MAX_2__TOIL IP_N_MAX_1__TOIL C_N_MAX C_N_MAX_AMT_ADD C_N_MAX_AMT_GP /end DEF_CHARACTERISTIC
 /begin OUT_MEASUREMENT N_MAX_THD N_MAX_THD_1 N_MAX_THD_2 LV_N_MAX_MT LV_N_MAX_AT LV_N_MAX_GR LV_VS_MAX VS_RATIO N_MAX_VS_MAX /end OUT_MEASUREMENT
/end FUNCTION
/end MODULE
/end PROJECT
