ASAP2_VERSION 1 3
/begin PROJECT P383 "BMW DDE6.3 8-Zylinder V9E.3 11.10.2004 CAN12H"
/begin HEADER "" VERSION "V9E.3_8Z_CAN12H" PROJECT_NO P383 /end HEADER
/begin MODULE DIM ""
/begin MOD_COMMON "" BYTE_ORDER MSB_FIRST ALIGNMENT_BYTE 1 ALIGNMENT_WORD 2 ALIGNMENT_LONG 4 ALIGNMENT_FLOAT32_IEEE 4 /end MOD_COMMON
/begin CHARACTERISTIC DSM_RdyABForceMsk_C "Maske zur Erzwingung von Readiness durch bitweises AND mit Message DSM_stRdyAB" VALUE 0xD282A Kw_Wu16 65535.00 OneToOne 0.00 65535.00 FORMAT "%8.2" /end CHARACTERISTIC
/begin CHARACTERISTIC DSM_RdyCDForceMsk_C "Maske zur Erzwingung von Readiness durch bitweises AND mit Message DSM_stRdyCD" VALUE 0xD282C Kw_Wu16 65535.00 OneToOne 0.00 65535.00 FORMAT "%8.2" /end CHARACTERISTIC
/begin CHARACTERISTIC DSM_RdyOnMilEnable_C "Verhalten Readiness bei angesteuerter MIL" VALUE 0xD282E Kw_Wu8 1.00000000000 RdyOnMilEnable 0.00 1.00000000000 FORMAT "%13.11" /end CHARACTERISTIC
/begin CHARACTERISTIC DSM_TsfDfp_Layer_TANS_C "Schwerezaehlergrenze fuer Fehlerpfad Dfp_Layer_TANS" VALUE 0xD261E Kw_Wu8 51000. TimeDsmTsf 0.00 51000. FORMAT "%5.0" /end CHARACTERISTIC
/begin CHARACTERISTIC DSM_TsfDfp_ACCDSwtin_C "Schwerezaehlergrenze fuer Fehlerpfad Dfp_ACCDSwtin" VALUE 0xD261F Kw_Wu8 51000. TimeDsmTsf 0.00 51000. FORMAT "%5.0" /end CHARACTERISTIC
/begin CHARACTERISTIC DSM_TsfDfp_ACC_PlausTrqDes_C "Schwerezaehlergrenze fuer Fehlerpfad Dfp_ACC_PlausTrqDes" VALUE 0xD2620 Kw_Wu8 51000. TimeDsmTsf 0.00 51000. FORMAT "%5.0" /end CHARACTERISTIC
/begin CHARACTERISTIC DSM_TsfDfp_ACC_trqInr_C "Schwerezaehlergrenze fuer Fehlerpfad Dfp_ACC_trqInr" VALUE 0xD2621 Kw_Wu8 51000. TimeDsmTsf 0.00 51000. FORMAT "%5.0" /end CHARACTERISTIC
/begin CHARACTERISTIC DSM_TsfDfp_ACTrq_C "Schwerezaehlergrenze fuer Fehlerpfad Dfp_ACTrq" VALUE 0xD2622 Kw_Wu8 51000. TimeDsmTsf 0.00 51000. FORMAT "%5.0" /end CHARACTERISTIC
/begin CHARACTERISTIC DSM_TsfDfp_ADCMon_C "Schwerezaehlergrenze fuer Fehlerpfad Dfp_ADCMon" VALUE 0xD2623 Kw_Wu8 51000. TimeDsmTsf 0.00 51000. FORMAT "%5.0" /end CHARACTERISTIC
/begin CHARACTERISTIC DSM_TsfDfp_AFSCDIdlAdjVal_C "Schwerezaehlergrenze fuer Fehlerpfad Dfp_AFSCDIdlAdjVal" VALUE 0xD2624 Kw_Wu8 51000. TimeDsmTsf 0.00 51000. FORMAT "%5.0" /end CHARACTERISTIC
/begin CHARACTERISTIC DSM_TsfDfp_AFSCDLdAdjVal_C "Schwerezaehlergrenze fuer Fehlerpfad Dfp_AFSCDLdAdjVal" VALUE 0xD2625 Kw_Wu8 51000. TimeDsmTsf 0.00 51000. FORMAT "%5.0" /end CHARACTERISTIC
/begin CHARACTERISTIC DSM_TsfDfp_AFSCDPlAirPerCylDif_C "Schwerezaehlergrenze fuer Fehlerpfad Dfp_AFSCDPlAirPerCylDif" VALUE 0xD2626 Kw_Wu8 51000. TimeDsmTsf 0.00 51000. FORMAT "%5.0" /end CHARACTERISTIC
/begin CHARACTERISTIC DSM_TsfDfp_AFSCD_AirTempDcyc_C "Schwerezaehlergrenze fuer Fehlerpfad Dfp_AFSCD_AirTempDcyc" VALUE 0xD2627 Kw_Wu8 51000. TimeDsmTsf 0.00 51000. FORMAT "%5.0" /end CHARACTERISTIC
/begin CHARACTERISTIC DSM_TsfDfp_AFSCD_AirTempDcyc2_C "Schwerezaehlergrenze fuer Fehlerpfad Dfp_AFSCD_AirTempDcyc2" VALUE 0xD2628 Kw_Wu8 51000. TimeDsmTsf 0.00 51000. FORMAT "%5.0" /end CHARACTERISTIC
/begin CHARACTERISTIC DSM_TsfDfp_AFSCD_PlOffsDrft_C "Schwerezaehlergrenze fuer Fehlerpfad Dfp_AFSCD_PlOffsDrft" VALUE 0xD2629 Kw_Wu8 51000. TimeDsmTsf 0.00 51000. FORMAT "%5.0" /end CHARACTERISTIC
/begin CHARACTERISTIC DSM_TsfDfp_AFSCD_PlOffsDrft2_C "Schwerezaehlergrenze fuer Fehlerpfad Dfp_AFSCD_PlOffsDrft2" VALUE 0xD262A Kw_Wu8 51000. TimeDsmTsf 0.00 51000. FORMAT "%5.0" /end CHARACTERISTIC
/begin CHARACTERISTIC DSM_TsfDfp_AFSCD_PlSetyDrft_C "Schwerezaehlergrenze fuer Fehlerpfad Dfp_AFSCD_PlSetyDrft" VALUE 0xD262B Kw_Wu8 51000. TimeDsmTsf 0.00 51000. FORMAT "%5.0" /end CHARACTERISTIC
/begin CHARACTERISTIC DSM_TsfDfp_AFSCD_SRCAirTemp_C "Schwerezaehlergrenze fuer Fehlerpfad Dfp_AFSCD_SRCAirTemp" VALUE 0xD262C Kw_Wu8 51000. TimeDsmTsf 0.00 51000. FORMAT "%5.0" /end CHARACTERISTIC
/begin CHARACTERISTIC DSM_TsfDfp_AFSCD_SRCAirTemp2_C "Schwerezaehlergrenze fuer Fehlerpfad Dfp_AFSCD_SRCAirTemp2" VALUE 0xD262D Kw_Wu8 51000. TimeDsmTsf 0.00 51000. FORMAT "%5.0" /end CHARACTERISTIC
/begin CHARACTERISTIC DSM_TsfDfp_AFSCD_SRCBatt_C "Schwerezaehlergrenze fuer Fehlerpfad Dfp_AFSCD_SRCBatt" VALUE 0xD262E Kw_Wu8 51000. TimeDsmTsf 0.00 51000. FORMAT "%5.0" /end CHARACTERISTIC
/begin CHARACTERISTIC DSM_TsfDfp_AFSCD_SRCBatt2_C "Schwerezaehlergrenze fuer Fehlerpfad Dfp_AFSCD_SRCBatt2" VALUE 0xD262F Kw_Wu8 51000. TimeDsmTsf 0.00 51000. FORMAT "%5.0" /end CHARACTERISTIC
/begin CHARACTERISTIC DSM_TsfDfp_AFSCD_SRCCorrAirm_C "Schwerezaehlergrenze fuer Fehlerpfad Dfp_AFSCD_SRCCorrAirm" VALUE 0xD2630 Kw_Wu8 51000. TimeDsmTsf 0.00 51000. FORMAT "%5.0" /end CHARACTERISTIC
/begin CHARACTERISTIC DSM_TsfDfp_Layer_TUMG_C "Schwerezaehlergrenze fuer Fehlerpfad Dfp_Layer_TUMG" VALUE 0xD2631 Kw_Wu8 51000. TimeDsmTsf 0.00 51000. FORMAT "%5.0" /end CHARACTERISTIC
/begin CHARACTERISTIC DSM_TsfDfp_AFSCD_SRCCorrAirm2_C "Schwerezaehlergrenze fuer Fehlerpfad Dfp_AFSCD_SRCCorrAirm2" VALUE 0xD2632 Kw_Wu8 51000. TimeDsmTsf 0.00 51000. FORMAT "%5.0" /end CHARACTERISTIC
/begin CHARACTERISTIC DSM_TsfDfp_AFSCD_SRCRawAirm_C "Schwerezaehlergrenze fuer Fehlerpfad Dfp_AFSCD_SRCRawAirm" VALUE 0xD2633 Kw_Wu8 51000. TimeDsmTsf 0.00 51000. FORMAT "%5.0" /end CHARACTERISTIC
/begin CHARACTERISTIC DSM_TsfDfp_Layer_GEN_C "Schwerezaehlergrenze fuer Fehlerpfad Dfp_Layer_GEN" VALUE 0xD2634 Kw_Wu8 51000. TimeDsmTsf 0.00 51000. FORMAT "%5.0" /end CHARACTERISTIC
/begin CHARACTERISTIC DSM_TsfDfp_Layer_BSD_C "Schwerezaehlergrenze fuer Fehlerpfad Dfp_Layer_BSD" VALUE 0xD2635 Kw_Wu8 51000. TimeDsmTsf 0.00 51000. FORMAT "%5.0" /end CHARACTERISTIC
/begin CHARACTERISTIC DSM_TsfDfp_AFSCD_SRCRawAirm2_C "Schwerezaehlergrenze fuer Fehlerpfad Dfp_AFSCD_SRCRawAirm2" VALUE 0xD2636 Kw_Wu8 51000. TimeDsmTsf 0.00 51000. FORMAT "%5.0" /end CHARACTERISTIC
/begin CHARACTERISTIC DSM_TsfDfp_AFSCD_SRCRefSigPer_C "Schwerezaehlergrenze fuer Fehlerpfad Dfp_AFSCD_SRCRefSigPer" VALUE 0xD2637 Kw_Wu8 51000. TimeDsmTsf 0.00 51000. FORMAT "%5.0" /end CHARACTERISTIC
/begin CHARACTERISTIC DSM_TsfDfp_AFSCD_SRCRefSigPer2_C "Schwerezaehlergrenze fuer Fehlerpfad Dfp_AFSCD_SRCRefSigPer2" VALUE 0xD2638 Kw_Wu8 51000. TimeDsmTsf 0.00 51000. FORMAT "%5.0" /end CHARACTERISTIC
/begin CHARACTERISTIC DSM_TsfDfp_AOHtCD_C "Schwerezaehlergrenze fuer Fehlerpfad Dfp_AOHtCD" VALUE 0xD2639 Kw_Wu8 51000. TimeDsmTsf 0.00 51000. FORMAT "%5.0" /end CHARACTERISTIC
/begin CHARACTERISTIC DSM_TsfDfp_AOHtCD_AOHtDia1_C "Schwerezaehlergrenze fuer Fehlerpfad Dfp_AOHtCD_AOHtDia1" VALUE 0xD263A Kw_Wu8 51000. TimeDsmTsf 0.00 51000. FORMAT "%5.0" /end CHARACTERISTIC
/begin CHARACTERISTIC DSM_TsfDfp_AOHtCD_AOHtDia2_C "Schwerezaehlergrenze fuer Fehlerpfad Dfp_AOHtCD_AOHtDia2" VALUE 0xD263B Kw_Wu8 51000. TimeDsmTsf 0.00 51000. FORMAT "%5.0" /end CHARACTERISTIC
/begin CHARACTERISTIC DSM_TsfDfp_AOHtCD_AOHtDia3_C "Schwerezaehlergrenze fuer Fehlerpfad Dfp_AOHtCD_AOHtDia3" VALUE 0xD263C Kw_Wu8 51000. TimeDsmTsf 0.00 51000. FORMAT "%5.0" /end CHARACTERISTIC
/begin CHARACTERISTIC DSM_TsfDfp_APP1_C "Schwerezaehlergrenze fuer Fehlerpfad Dfp_APP1" VALUE 0xD263D Kw_Wu8 51000. TimeDsmTsf 0.00 51000. FORMAT "%5.0" /end CHARACTERISTIC
/begin CHARACTERISTIC DSM_TsfDfp_APP2_C "Schwerezaehlergrenze fuer Fehlerpfad Dfp_APP2" VALUE 0xD263E Kw_Wu8 51000. TimeDsmTsf 0.00 51000. FORMAT "%5.0" /end CHARACTERISTIC
/begin CHARACTERISTIC DSM_TsfDfp_APPCDCmpd_C "Schwerezaehlergrenze fuer Fehlerpfad Dfp_APPCDCmpd" VALUE 0xD263F Kw_Wu8 51000. TimeDsmTsf 0.00 51000. FORMAT "%5.0" /end CHARACTERISTIC
/begin CHARACTERISTIC DSM_TsfDfp_Layer_QLT_C "Schwerezaehlergrenze fuer Fehlerpfad Dfp_Layer_QLT" VALUE 0xD2640 Kw_Wu8 51000. TimeDsmTsf 0.00 51000. FORMAT "%5.0" /end CHARACTERISTIC
/begin CHARACTERISTIC DSM_TsfDfp_APPSync_C "Schwerezaehlergrenze fuer Fehlerpfad Dfp_APPSync" VALUE 0xD2641 Kw_Wu8 51000. TimeDsmTsf 0.00 51000. FORMAT "%5.0" /end CHARACTERISTIC
/begin CHARACTERISTIC DSM_TsfDfp_Layer_IBS1_C "Schwerezaehlergrenze fuer Fehlerpfad Dfp_Layer_IBS1" VALUE 0xD2642 Kw_Wu8 51000. TimeDsmTsf 0.00 51000. FORMAT "%5.0" /end CHARACTERISTIC
/begin CHARACTERISTIC DSM_TsfDfp_Layer_IBS2_C "Schwerezaehlergrenze fuer Fehlerpfad Dfp_Layer_IBS2" VALUE 0xD2643 Kw_Wu8 51000. TimeDsmTsf 0.00 51000. FORMAT "%5.0" /end CHARACTERISTIC
/begin CHARACTERISTIC DSM_TsfDfp_Layer_IBS3_C "Schwerezaehlergrenze fuer Fehlerpfad Dfp_Layer_IBS3" VALUE 0xD2644 Kw_Wu8 51000. TimeDsmTsf 0.00 51000. FORMAT "%5.0" /end CHARACTERISTIC
/begin CHARACTERISTIC DSM_TsfDfp_Layer_PMBN_C "Schwerezaehlergrenze fuer Fehlerpfad Dfp_Layer_PMBN" VALUE 0xD2645 Kw_Wu8 51000. TimeDsmTsf 0.00 51000. FORMAT "%5.0" /end CHARACTERISTIC
/begin CHARACTERISTIC DSM_TsfDfp_Layer_PMBATT_C "Schwerezaehlergrenze fuer Fehlerpfad Dfp_Layer_PMBATT" VALUE 0xD2646 Kw_Wu8 51000. TimeDsmTsf 0.00 51000. FORMAT "%5.0" /end CHARACTERISTIC
/begin CHARACTERISTIC DSM_TsfDfp_APSCD_C "Schwerezaehlergrenze fuer Fehlerpfad Dfp_APSCD" VALUE 0xD2647 Kw_Wu8 51000. TimeDsmTsf 0.00 51000. FORMAT "%5.0" /end CHARACTERISTIC
/begin CHARACTERISTIC DSM_TsfDfp_ARS_C "Schwerezaehlergrenze fuer Fehlerpfad Dfp_ARS" VALUE 0xD2648 Kw_Wu8 51000. TimeDsmTsf 0.00 51000. FORMAT "%5.0" /end CHARACTERISTIC
/begin CHARACTERISTIC DSM_TsfDfp_AccPedPlausBrk_C "Schwerezaehlergrenze fuer Fehlerpfad Dfp_AccPedPlausBrk" VALUE 0xD2649 Kw_Wu8 51000. TimeDsmTsf 0.00 51000. FORMAT "%5.0" /end CHARACTERISTIC
/begin CHARACTERISTIC DSM_TsfDfp_AddPCDTnkLvl_C "Schwerezaehlergrenze fuer Fehlerpfad Dfp_AddPCDTnkLvl" VALUE 0xD264A Kw_Wu8 51000. TimeDsmTsf 0.00 51000. FORMAT "%5.0" /end CHARACTERISTIC
/begin CHARACTERISTIC DSM_TsfDfp_AirCtlGvnrDvtRgnMax_C "Schwerezaehlergrenze fuer Fehlerpfad Dfp_AirCtlGvnrDvtRgnMax" VALUE 0xD264B Kw_Wu8 51000. TimeDsmTsf 0.00 51000. FORMAT "%5.0" /end CHARACTERISTIC
/begin CHARACTERISTIC DSM_TsfDfp_AirCtlGvnrDvtRgnMin_C "Schwerezaehlergrenze fuer Fehlerpfad Dfp_AirCtlGvnrDvtRgnMin" VALUE 0xD264C Kw_Wu8 51000. TimeDsmTsf 0.00 51000. FORMAT "%5.0" /end CHARACTERISTIC
/begin CHARACTERISTIC DSM_TsfDfp_AirCtlGvnrDvtRgnMn2_C "Schwerezaehlergrenze fuer Fehlerpfad Dfp_AirCtlGvnrDvtRgnMn2" VALUE 0xD264D Kw_Wu8 51000. TimeDsmTsf 0.00 51000. FORMAT "%5.0" /end CHARACTERISTIC
/begin CHARACTERISTIC DSM_TsfDfp_AirCtlGvnrDvtRgnMx2_C "Schwerezaehlergrenze fuer Fehlerpfad Dfp_AirCtlGvnrDvtRgnMx2" VALUE 0xD264E Kw_Wu8 51000. TimeDsmTsf 0.00 51000. FORMAT "%5.0" /end CHARACTERISTIC
/begin CHARACTERISTIC DSM_TsfDfp_AirCtlPlateBreak_C "DSM variable for Dfp_AirCtlPlateBreak_mp" VALUE 0xD264F Kw_Wu8 51000. TimeDsmTsf 0.00 51000. FORMAT "%5.0" /end CHARACTERISTIC
/begin CHARACTERISTIC DSM_TsfDfp_AirCtlRmpTO_C "Schwerezaehlergrenze fuer Fehlerpfad Dfp_AirCtlRmpTO" VALUE 0xD2650 Kw_Wu8 51000. TimeDsmTsf 0.00 51000. FORMAT "%5.0" /end CHARACTERISTIC
/begin CHARACTERISTIC DSM_TsfDfp_AirCtl_GovNegDev_C "Schwerezaehlergrenze fuer Fehlerpfad Dfp_AirCtl_GovNegDev" VALUE 0xD2651 Kw_Wu8 51000. TimeDsmTsf 0.00 51000. FORMAT "%5.0" /end CHARACTERISTIC
/begin CHARACTERISTIC DSM_TsfDfp_AirCtl_GovNegDev2_C "Schwerezaehlergrenze fuer Fehlerpfad Dfp_AirCtl_GovNegDev2" VALUE 0xD2652 Kw_Wu8 51000. TimeDsmTsf 0.00 51000. FORMAT "%5.0" /end CHARACTERISTIC
/begin CHARACTERISTIC DSM_TsfDfp_AirCtl_GovPosDev_C "Schwerezaehlergrenze fuer Fehlerpfad Dfp_AirCtl_GovPosDev" VALUE 0xD2653 Kw_Wu8 51000. TimeDsmTsf 0.00 51000. FORMAT "%5.0" /end CHARACTERISTIC
/begin CHARACTERISTIC DSM_TsfDfp_AirCtl_GovPosDev2_C "Schwerezaehlergrenze fuer Fehlerpfad Dfp_AirCtl_GovPosDev2" VALUE 0xD2654 Kw_Wu8 51000. TimeDsmTsf 0.00 51000. FORMAT "%5.0" /end CHARACTERISTIC
/begin CHARACTERISTIC DSM_TsfDfp_AltCD_C "Schwerezaehlergrenze fuer Fehlerpfad Dfp_AltCD" VALUE 0xD2655 Kw_Wu8 51000. TimeDsmTsf 0.00 51000. FORMAT "%5.0" /end CHARACTERISTIC
/begin CHARACTERISTIC DSM_TsfDfp_BPACD_BPADia1_C "Schwerezaehlergrenze fuer Fehlerpfad Dfp_BPACD_BPADia1" VALUE 0xD2656 Kw_Wu8 51000. TimeDsmTsf 0.00 51000. FORMAT "%5.0" /end CHARACTERISTIC
/begin CHARACTERISTIC DSM_TsfDfp_BPACD_BPADia1v2_C "Schwerezaehlergrenze fuer Fehlerpfad Dfp_BPACD_BPADia1v2" VALUE 0xD2657 Kw_Wu8 51000. TimeDsmTsf 0.00 51000. FORMAT "%5.0" /end CHARACTERISTIC
/begin CHARACTERISTIC DSM_TsfDfp_BPACD_BPADia2_C "Schwerezaehlergrenze fuer Fehlerpfad Dfp_BPACD_BPADia2" VALUE 0xD2658 Kw_Wu8 51000. TimeDsmTsf 0.00 51000. FORMAT "%5.0" /end CHARACTERISTIC
/begin CHARACTERISTIC DSM_TsfDfp_BPACD_BPADia2v2_C "Schwerezaehlergrenze fuer Fehlerpfad Dfp_BPACD_BPADia2v2" VALUE 0xD2659 Kw_Wu8 51000. TimeDsmTsf 0.00 51000. FORMAT "%5.0" /end CHARACTERISTIC
/begin CHARACTERISTIC DSM_TsfDfp_BPACD_BPADia3_C "Schwerezaehlergrenze fuer Fehlerpfad Dfp_BPACD_BPADia3" VALUE 0xD265A Kw_Wu8 51000. TimeDsmTsf 0.00 51000. FORMAT "%5.0" /end CHARACTERISTIC
/begin CHARACTERISTIC DSM_TsfDfp_BPACD_BPADia3v2_C "Schwerezaehlergrenze fuer Fehlerpfad Dfp_BPACD_BPADia3v2" VALUE 0xD265B Kw_Wu8 51000. TimeDsmTsf 0.00 51000. FORMAT "%5.0" /end CHARACTERISTIC
/begin CHARACTERISTIC DSM_TsfDfp_BPACD_BPADia4_C "Schwerezaehlergrenze fuer Fehlerpfad Dfp_BPACD_BPADia4" VALUE 0xD265C Kw_Wu8 51000. TimeDsmTsf 0.00 51000. FORMAT "%5.0" /end CHARACTERISTIC
/begin CHARACTERISTIC DSM_TsfDfp_BPACD_BPADia4v2_C "Schwerezaehlergrenze fuer Fehlerpfad Dfp_BPACD_BPADia4v2" VALUE 0xD265D Kw_Wu8 51000. TimeDsmTsf 0.00 51000. FORMAT "%5.0" /end CHARACTERISTIC
/begin CHARACTERISTIC DSM_TsfDfp_BPACD_Max_C "Schwerezaehlergrenze fuer Fehlerpfad Dfp_BPACD_Max" VALUE 0xD265E Kw_Wu8 51000. TimeDsmTsf 0.00 51000. FORMAT "%5.0" /end CHARACTERISTIC
/begin CHARACTERISTIC DSM_TsfDfp_BPACD_Max2_C "Schwerezaehlergrenze fuer Fehlerpfad Dfp_BPACD_Max2" VALUE 0xD265F Kw_Wu8 51000. TimeDsmTsf 0.00 51000. FORMAT "%5.0" /end CHARACTERISTIC
/begin CHARACTERISTIC DSM_TsfDfp_BPACD_Min_C "Schwerezaehlergrenze fuer Fehlerpfad Dfp_BPACD_Min" VALUE 0xD2660 Kw_Wu8 51000. TimeDsmTsf 0.00 51000. FORMAT "%5.0" /end CHARACTERISTIC
/begin CHARACTERISTIC DSM_TsfDfp_BPACD_Min2_C "Schwerezaehlergrenze fuer Fehlerpfad Dfp_BPACD_Min2" VALUE 0xD2661 Kw_Wu8 51000. TimeDsmTsf 0.00 51000. FORMAT "%5.0" /end CHARACTERISTIC
/begin CHARACTERISTIC DSM_TsfDfp_BPACD_SigNpl_C "Schwerezaehlergrenze fuer Fehlerpfad Dfp_BPACD_SigNpl" VALUE 0xD2662 Kw_Wu8 51000. TimeDsmTsf 0.00 51000. FORMAT "%5.0" /end CHARACTERISTIC
/begin CHARACTERISTIC DSM_TsfDfp_BPACD_SigNpl2_C "Schwerezaehlergrenze fuer Fehlerpfad Dfp_BPACD_SigNpl2" VALUE 0xD2663 Kw_Wu8 51000. TimeDsmTsf 0.00 51000. FORMAT "%5.0" /end CHARACTERISTIC
/begin CHARACTERISTIC DSM_TsfDfp_BPSCD_C "Schwerezaehlergrenze fuer Fehlerpfad Dfp_BPSCD" VALUE 0xD2664 Kw_Wu8 51000. TimeDsmTsf 0.00 51000. FORMAT "%5.0" /end CHARACTERISTIC
/begin CHARACTERISTIC DSM_TsfDfp_BattCD_C "Schwerezaehlergrenze fuer Fehlerpfad Dfp_BattCD" VALUE 0xD2665 Kw_Wu8 51000. TimeDsmTsf 0.00 51000. FORMAT "%5.0" /end CHARACTERISTIC
/begin CHARACTERISTIC DSM_TsfDfp_BrkCD_C "Schwerezaehlergrenze fuer Fehlerpfad Dfp_BrkCD" VALUE 0xD2666 Kw_Wu8 51000. TimeDsmTsf 0.00 51000. FORMAT "%5.0" /end CHARACTERISTIC
/begin CHARACTERISTIC DSM_TsfDfp_Layer_PMRUHVERL_C "Schwerezaehlergrenze fuer Fehlerpfad Dfp_Layer_PMRUHVERL" VALUE 0xD2667 Kw_Wu8 51000. TimeDsmTsf 0.00 51000. FORMAT "%5.0" /end CHARACTERISTIC
/begin CHARACTERISTIC DSM_TsfDfp_Bss_C "Schwerezaehlergrenze fuer Fehlerpfad Dfp_Bss" VALUE 0xD2668 Kw_Wu8 51000. TimeDsmTsf 0.00 51000. FORMAT "%5.0" /end CHARACTERISTIC
/begin CHARACTERISTIC DSM_TsfDfp_CBACD_C "Schwerezaehlergrenze fuer Fehlerpfad Dfp_CBACD" VALUE 0xD2669 Kw_Wu8 51000. TimeDsmTsf 0.00 51000. FORMAT "%5.0" /end CHARACTERISTIC
/begin CHARACTERISTIC DSM_TsfDfp_CTSCD_C "Schwerezaehlergrenze fuer Fehlerpfad Dfp_CTSCD" VALUE 0xD266A Kw_Wu8 51000. TimeDsmTsf 0.00 51000. FORMAT "%5.0" /end CHARACTERISTIC
/begin CHARACTERISTIC DSM_TsfDfp_Clg_DynTst_C "Schwerezaehlergrenze fuer Fehlerpfad Dfp_Clg_DynTst" VALUE 0xD266B Kw_Wu8 51000. TimeDsmTsf 0.00 51000. FORMAT "%5.0" /end CHARACTERISTIC
/begin CHARACTERISTIC DSM_TsfDfp_Layer_TOENS_C "Schwerezaehlergrenze fuer Fehlerpfad Dfp_Layer_TOENS" VALUE 0xD266C Kw_Wu8 51000. TimeDsmTsf 0.00 51000. FORMAT "%5.0" /end CHARACTERISTIC
/begin CHARACTERISTIC DSM_TsfDfp_Layer_MANHYDR_C "Schwerezaehlergrenze fuer Fehlerpfad Dfp_Layer_MANHYDR" VALUE 0xD266D Kw_Wu8 51000. TimeDsmTsf 0.00 51000. FORMAT "%5.0" /end CHARACTERISTIC
/begin CHARACTERISTIC DSM_TsfDfp_Layer_MANLUFT_C "Schwerezaehlergrenze fuer Fehlerpfad Dfp_Layer_MANLUFT" VALUE 0xD266E Kw_Wu8 51000. TimeDsmTsf 0.00 51000. FORMAT "%5.0" /end CHARACTERISTIC
/begin CHARACTERISTIC DSM_TsfDfp_CmbChbMisfire1_C "Schwerezaehlergrenze fuer Fehlerpfad Dfp_CmbChbMisfire1" VALUE 0xD266F Kw_Wu8 51000. TimeDsmTsf 0.00 51000. FORMAT "%5.0" /end CHARACTERISTIC
/begin CHARACTERISTIC DSM_TsfDfp_CmbChbMisfire2_C "Schwerezaehlergrenze fuer Fehlerpfad Dfp_CmbChbMisfire2" VALUE 0xD2670 Kw_Wu8 51000. TimeDsmTsf 0.00 51000. FORMAT "%5.0" /end CHARACTERISTIC
/begin CHARACTERISTIC DSM_TsfDfp_CmbChbMisfire3_C "Schwerezaehlergrenze fuer Fehlerpfad Dfp_CmbChbMisfire3" VALUE 0xD2671 Kw_Wu8 51000. TimeDsmTsf 0.00 51000. FORMAT "%5.0" /end CHARACTERISTIC
/begin CHARACTERISTIC DSM_TsfDfp_CmbChbMisfire4_C "Schwerezaehlergrenze fuer Fehlerpfad Dfp_CmbChbMisfire4" VALUE 0xD2672 Kw_Wu8 51000. TimeDsmTsf 0.00 51000. FORMAT "%5.0" /end CHARACTERISTIC
/begin CHARACTERISTIC DSM_TsfDfp_CmbChbMisfire5_C "Schwerezaehlergrenze fuer Fehlerpfad Dfp_CmbChbMisfire5" VALUE 0xD2673 Kw_Wu8 51000. TimeDsmTsf 0.00 51000. FORMAT "%5.0" /end CHARACTERISTIC
/begin CHARACTERISTIC DSM_TsfDfp_CmbChbMisfire6_C "Schwerezaehlergrenze fuer Fehlerpfad Dfp_CmbChbMisfire6" VALUE 0xD2674 Kw_Wu8 51000. TimeDsmTsf 0.00 51000. FORMAT "%5.0" /end CHARACTERISTIC
/begin CHARACTERISTIC DSM_TsfDfp_CmbChbMisfire7_C "Schwerezaehlergrenze fuer Fehlerpfad Dfp_CmbChbMisfire7" VALUE 0xD2675 Kw_Wu8 51000. TimeDsmTsf 0.00 51000. FORMAT "%5.0" /end CHARACTERISTIC
/begin CHARACTERISTIC DSM_TsfDfp_CmbChbMisfire8_C "Schwerezaehlergrenze fuer Fehlerpfad Dfp_CmbChbMisfire8" VALUE 0xD2676 Kw_Wu8 51000. TimeDsmTsf 0.00 51000. FORMAT "%5.0" /end CHARACTERISTIC
/begin CHARACTERISTIC DSM_TsfDfp_CmbChbMisfireMul_C "Schwerezaehlergrenze fuer Fehlerpfad Dfp_CmbChbMisfireMul" VALUE 0xD2677 Kw_Wu8 51000. TimeDsmTsf 0.00 51000. FORMAT "%5.0" /end CHARACTERISTIC
/begin CHARACTERISTIC DSM_TsfDfp_CoDT_TRQ_Des_C "Schwerezaehlergrenze fuer Fehlerpfad Dfp_CoDT_TRQ_Des" VALUE 0xD2678 Kw_Wu8 51000. TimeDsmTsf 0.00 51000. FORMAT "%5.0" /end CHARACTERISTIC
/begin CHARACTERISTIC DSM_TsfDfp_CoDT_TRQ_Lead_C "Schwerezaehlergrenze fuer Fehlerpfad Dfp_CoDT_TRQ_Lead" VALUE 0xD2679 Kw_Wu8 51000. TimeDsmTsf 0.00 51000. FORMAT "%5.0" /end CHARACTERISTIC
/begin CHARACTERISTIC DSM_TsfDfp_CoEng_GbxRpmRduc_C "Schwerezaehlergrenze fuer Fehlerpfad Dfp_CoEng_GbxRpmRduc" VALUE 0xD267A Kw_Wu8 51000. TimeDsmTsf 0.00 51000. FORMAT "%5.0" /end CHARACTERISTIC
/begin CHARACTERISTIC DSM_TsfDfp_CoVMDCSh_C "Schwerezaehlergrenze fuer Fehlerpfad Dfp_CoVMDCSh" VALUE 0xD267B Kw_Wu8 51000. TimeDsmTsf 0.00 51000. FORMAT "%5.0" /end CHARACTERISTIC
/begin CHARACTERISTIC DSM_TsfDfp_ConvCD_C "Schwerezaehlergrenze fuer Fehlerpfad Dfp_ConvCD" VALUE 0xD267C Kw_Wu8 51000. TimeDsmTsf 0.00 51000. FORMAT "%5.0" /end CHARACTERISTIC
/begin CHARACTERISTIC DSM_TsfDfp_CrCCDMFL_C "Schwerezaehlergrenze fuer Fehlerpfad Dfp_CrCCDMFL" VALUE 0xD267D Kw_Wu8 51000. TimeDsmTsf 0.00 51000. FORMAT "%5.0" /end CHARACTERISTIC
/begin CHARACTERISTIC DSM_TsfDfp_CrCtl_vCrCtl_C "Schwerezaehlergrenze fuer Fehlerpfad Dfp_CrCtl_vCrCtl" VALUE 0xD267E Kw_Wu8 51000. TimeDsmTsf 0.00 51000. FORMAT "%5.0" /end CHARACTERISTIC
/begin CHARACTERISTIC DSM_TsfDfp_EATSCD_C "Schwerezaehlergrenze fuer Fehlerpfad Dfp_EATSCD" VALUE 0xD267F Kw_Wu8 51000. TimeDsmTsf 0.00 51000. FORMAT "%5.0" /end CHARACTERISTIC
/begin CHARACTERISTIC DSM_TsfDfp_EBAFCD_C "Schwerezaehlergrenze fuer Fehlerpfad Dfp_EBAFCD" VALUE 0xD2680 Kw_Wu8 51000. TimeDsmTsf 0.00 51000. FORMAT "%5.0" /end CHARACTERISTIC
/begin CHARACTERISTIC DSM_TsfDfp_EBFCD_C "Schwerezaehlergrenze fuer Fehlerpfad Dfp_EBFCD" VALUE 0xD2681 Kw_Wu8 51000. TimeDsmTsf 0.00 51000. FORMAT "%5.0" /end CHARACTERISTIC
/begin CHARACTERISTIC DSM_TsfDfp_EBTSCD_C "Schwerezaehlergrenze fuer Fehlerpfad Dfp_EBTSCD" VALUE 0xD2682 Kw_Wu8 51000. TimeDsmTsf 0.00 51000. FORMAT "%5.0" /end CHARACTERISTIC
/begin CHARACTERISTIC DSM_TsfDfp_EBTSCD_OvrTemp_C "Schwerezaehlergrenze fuer Fehlerpfad Dfp_EBTSCD_OvrTemp" VALUE 0xD2683 Kw_Wu8 51000. TimeDsmTsf 0.00 51000. FORMAT "%5.0" /end CHARACTERISTIC
/begin CHARACTERISTIC DSM_TsfDfp_EEPCDVarMng_C "Schwerezaehlergrenze fuer Fehlerpfad Dfp_EEPCDVarMng" VALUE 0xD2684 Kw_Wu8 51000. TimeDsmTsf 0.00 51000. FORMAT "%5.0" /end CHARACTERISTIC
/begin CHARACTERISTIC DSM_TsfDfp_EGPpCD_C "Schwerezaehlergrenze fuer Fehlerpfad Dfp_EGPpCD" VALUE 0xD2685 Kw_Wu8 51000. TimeDsmTsf 0.00 51000. FORMAT "%5.0" /end CHARACTERISTIC
/begin CHARACTERISTIC DSM_TsfDfp_EGRCD_Max_C "Schwerezaehlergrenze fuer Fehlerpfad Dfp_EGRCD_Max" VALUE 0xD2686 Kw_Wu8 51000. TimeDsmTsf 0.00 51000. FORMAT "%5.0" /end CHARACTERISTIC
/begin CHARACTERISTIC DSM_TsfDfp_EGRCD_Max2_C "Schwerezaehlergrenze fuer Fehlerpfad Dfp_EGRCD_Max2" VALUE 0xD2687 Kw_Wu8 51000. TimeDsmTsf 0.00 51000. FORMAT "%5.0" /end CHARACTERISTIC
/begin CHARACTERISTIC DSM_TsfDfp_EGRCD_Min_C "Schwerezaehlergrenze fuer Fehlerpfad Dfp_EGRCD_Min" VALUE 0xD2688 Kw_Wu8 51000. TimeDsmTsf 0.00 51000. FORMAT "%5.0" /end CHARACTERISTIC
/begin CHARACTERISTIC DSM_TsfDfp_EGRCD_Min2_C "Schwerezaehlergrenze fuer Fehlerpfad Dfp_EGRCD_Min2" VALUE 0xD2689 Kw_Wu8 51000. TimeDsmTsf 0.00 51000. FORMAT "%5.0" /end CHARACTERISTIC
/begin CHARACTERISTIC DSM_TsfDfp_EGRCD_PWMInDia1_C "Schwerezaehlergrenze fuer Fehlerpfad Dfp_EGRCD_PWMInDia1" VALUE 0xD268A Kw_Wu8 51000. TimeDsmTsf 0.00 51000. FORMAT "%5.0" /end CHARACTERISTIC
/begin CHARACTERISTIC DSM_TsfDfp_EGRCD_PWMInDia2_C "Schwerezaehlergrenze fuer Fehlerpfad Dfp_EGRCD_PWMInDia2" VALUE 0xD268B Kw_Wu8 51000. TimeDsmTsf 0.00 51000. FORMAT "%5.0" /end CHARACTERISTIC
/begin CHARACTERISTIC DSM_TsfDfp_EGRCD_PWMInDia21_C "Schwerezaehlergrenze fuer Fehlerpfad Dfp_EGRCD_PWMInDia21" VALUE 0xD268C Kw_Wu8 51000. TimeDsmTsf 0.00 51000. FORMAT "%5.0" /end CHARACTERISTIC
/begin CHARACTERISTIC DSM_TsfDfp_EGRCD_PWMInDia22_C "Schwerezaehlergrenze fuer Fehlerpfad Dfp_EGRCD_PWMInDia22" VALUE 0xD268D Kw_Wu8 51000. TimeDsmTsf 0.00 51000. FORMAT "%5.0" /end CHARACTERISTIC
/begin CHARACTERISTIC DSM_TsfDfp_EGRCD_PWMInDia23_C "Schwerezaehlergrenze fuer Fehlerpfad Dfp_EGRCD_PWMInDia23" VALUE 0xD268E Kw_Wu8 51000. TimeDsmTsf 0.00 51000. FORMAT "%5.0" /end CHARACTERISTIC
/begin CHARACTERISTIC DSM_TsfDfp_EGRCD_PWMInDia24_C "Schwerezaehlergrenze fuer Fehlerpfad Dfp_EGRCD_PWMInDia24" VALUE 0xD268F Kw_Wu8 51000. TimeDsmTsf 0.00 51000. FORMAT "%5.0" /end CHARACTERISTIC
/begin CHARACTERISTIC DSM_TsfDfp_EGRCD_PWMInDia3_C "Schwerezaehlergrenze fuer Fehlerpfad Dfp_EGRCD_PWMInDia3" VALUE 0xD2690 Kw_Wu8 51000. TimeDsmTsf 0.00 51000. FORMAT "%5.0" /end CHARACTERISTIC
/begin CHARACTERISTIC DSM_TsfDfp_EGRCD_PWMInDia4_C "Schwerezaehlergrenze fuer Fehlerpfad Dfp_EGRCD_PWMInDia4" VALUE 0xD2691 Kw_Wu8 51000. TimeDsmTsf 0.00 51000. FORMAT "%5.0" /end CHARACTERISTIC
/begin CHARACTERISTIC DSM_TsfDfp_EGRCD_SigDia_C "Schwerezaehlergrenze fuer Fehlerpfad Dfp_EGRCD_SigDia" VALUE 0xD2692 Kw_Wu8 51000. TimeDsmTsf 0.00 51000. FORMAT "%5.0" /end CHARACTERISTIC
/begin CHARACTERISTIC DSM_TsfDfp_EGRCD_SigDia2_C "Schwerezaehlergrenze fuer Fehlerpfad Dfp_EGRCD_SigDia2" VALUE 0xD2693 Kw_Wu8 51000. TimeDsmTsf 0.00 51000. FORMAT "%5.0" /end CHARACTERISTIC
/begin CHARACTERISTIC DSM_TsfDfp_EGRCD_SigNpl_C "Schwerezaehlergrenze fuer Fehlerpfad Dfp_EGRCD_SigNpl" VALUE 0xD2694 Kw_Wu8 51000. TimeDsmTsf 0.00 51000. FORMAT "%5.0" /end CHARACTERISTIC
/begin CHARACTERISTIC DSM_TsfDfp_EGRCD_SigNpl2_C "Schwerezaehlergrenze fuer Fehlerpfad Dfp_EGRCD_SigNpl2" VALUE 0xD2695 Kw_Wu8 51000. TimeDsmTsf 0.00 51000. FORMAT "%5.0" /end CHARACTERISTIC
/begin CHARACTERISTIC DSM_TsfDfp_EGTOilLvlCrit_C "Schwerezaehlergrenze fuer Fehlerpfad Dfp_EGTOilLvlCrit" VALUE 0xD2696 Kw_Wu8 51000. TimeDsmTsf 0.00 51000. FORMAT "%5.0" /end CHARACTERISTIC
/begin CHARACTERISTIC DSM_TsfDfp_EGTOilVscCrit_C "Schwerezaehlergrenze fuer Fehlerpfad Dfp_EGTOilVscCrit" VALUE 0xD2697 Kw_Wu8 51000. TimeDsmTsf 0.00 51000. FORMAT "%5.0" /end CHARACTERISTIC
/begin CHARACTERISTIC DSM_TsfDfp_EGTRgnOilDil_C "Schwerezaehlergrenze fuer Fehlerpfad Dfp_EGTRgnOilDil" VALUE 0xD2698 Kw_Wu8 51000. TimeDsmTsf 0.00 51000. FORMAT "%5.0" /end CHARACTERISTIC
/begin CHARACTERISTIC DSM_TsfDfp_EGTTempGvnrInrB1_C "Schwerezaehlergrenze fuer Fehlerpfad Dfp_EGTTempGvnrInrB1" VALUE 0xD2699 Kw_Wu8 51000. TimeDsmTsf 0.00 51000. FORMAT "%5.0" /end CHARACTERISTIC
/begin CHARACTERISTIC DSM_TsfDfp_EGTTempGvnrInrB2_C "Schwerezaehlergrenze fuer Fehlerpfad Dfp_EGTTempGvnrInrB2" VALUE 0xD269A Kw_Wu8 51000. TimeDsmTsf 0.00 51000. FORMAT "%5.0" /end CHARACTERISTIC
/begin CHARACTERISTIC DSM_TsfDfp_EGTTempGvnrOutrB1_C "Schwerezaehlergrenze fuer Fehlerpfad Dfp_EGTTempGvnrOutrB1" VALUE 0xD269B Kw_Wu8 51000. TimeDsmTsf 0.00 51000. FORMAT "%5.0" /end CHARACTERISTIC
/begin CHARACTERISTIC DSM_TsfDfp_EGTTempGvnrOutrB2_C "Schwerezaehlergrenze fuer Fehlerpfad Dfp_EGTTempGvnrOutrB2" VALUE 0xD269C Kw_Wu8 51000. TimeDsmTsf 0.00 51000. FORMAT "%5.0" /end CHARACTERISTIC
/begin CHARACTERISTIC DSM_TsfDfp_ETClbETFltInj1_C "Schwerezaehlergrenze fuer Fehlerpfad Dfp_ETClbETFltInj1" VALUE 0xD269D Kw_Wu8 51000. TimeDsmTsf 0.00 51000. FORMAT "%5.0" /end CHARACTERISTIC
/begin CHARACTERISTIC DSM_TsfDfp_ETClbETFltInj2_C "Schwerezaehlergrenze fuer Fehlerpfad Dfp_ETClbETFltInj2" VALUE 0xD269E Kw_Wu8 51000. TimeDsmTsf 0.00 51000. FORMAT "%5.0" /end CHARACTERISTIC
/begin CHARACTERISTIC DSM_TsfDfp_ETClbETFltInj3_C "Schwerezaehlergrenze fuer Fehlerpfad Dfp_ETClbETFltInj3" VALUE 0xD269F Kw_Wu8 51000. TimeDsmTsf 0.00 51000. FORMAT "%5.0" /end CHARACTERISTIC
/begin CHARACTERISTIC DSM_TsfDfp_ETClbETFltInj4_C "Schwerezaehlergrenze fuer Fehlerpfad Dfp_ETClbETFltInj4" VALUE 0xD26A0 Kw_Wu8 51000. TimeDsmTsf 0.00 51000. FORMAT "%5.0" /end CHARACTERISTIC
/begin CHARACTERISTIC DSM_TsfDfp_ETClbETFltInj5_C "Schwerezaehlergrenze fuer Fehlerpfad Dfp_ETClbETFltInj5" VALUE 0xD26A1 Kw_Wu8 51000. TimeDsmTsf 0.00 51000. FORMAT "%5.0" /end CHARACTERISTIC
/begin CHARACTERISTIC DSM_TsfDfp_ETClbETFltInj6_C "Schwerezaehlergrenze fuer Fehlerpfad Dfp_ETClbETFltInj6" VALUE 0xD26A2 Kw_Wu8 51000. TimeDsmTsf 0.00 51000. FORMAT "%5.0" /end CHARACTERISTIC
/begin CHARACTERISTIC DSM_TsfDfp_ETClbETFltInj7_C "Schwerezaehlergrenze fuer Fehlerpfad Dfp_ETClbETFltInj7" VALUE 0xD26A3 Kw_Wu8 51000. TimeDsmTsf 0.00 51000. FORMAT "%5.0" /end CHARACTERISTIC
/begin CHARACTERISTIC DSM_TsfDfp_ETClbETFltInj8_C "Schwerezaehlergrenze fuer Fehlerpfad Dfp_ETClbETFltInj8" VALUE 0xD26A4 Kw_Wu8 51000. TimeDsmTsf 0.00 51000. FORMAT "%5.0" /end CHARACTERISTIC
/begin CHARACTERISTIC DSM_TsfDfp_ETClbInj1_C "Schwerezaehlergrenze fuer Fehlerpfad Dfp_ETClbInj1" VALUE 0xD26A5 Kw_Wu8 51000. TimeDsmTsf 0.00 51000. FORMAT "%5.0" /end CHARACTERISTIC
/begin CHARACTERISTIC DSM_TsfDfp_ETClbInj2_C "Schwerezaehlergrenze fuer Fehlerpfad Dfp_ETClbInj2" VALUE 0xD26A6 Kw_Wu8 51000. TimeDsmTsf 0.00 51000. FORMAT "%5.0" /end CHARACTERISTIC
/begin CHARACTERISTIC DSM_TsfDfp_ETClbInj3_C "Schwerezaehlergrenze fuer Fehlerpfad Dfp_ETClbInj3" VALUE 0xD26A7 Kw_Wu8 51000. TimeDsmTsf 0.00 51000. FORMAT "%5.0" /end CHARACTERISTIC
/begin CHARACTERISTIC DSM_TsfDfp_ETClbInj4_C "Schwerezaehlergrenze fuer Fehlerpfad Dfp_ETClbInj4" VALUE 0xD26A8 Kw_Wu8 51000. TimeDsmTsf 0.00 51000. FORMAT "%5.0" /end CHARACTERISTIC
/begin CHARACTERISTIC DSM_TsfDfp_ETClbInj5_C "Schwerezaehlergrenze fuer Fehlerpfad Dfp_ETClbInj5" VALUE 0xD26A9 Kw_Wu8 51000. TimeDsmTsf 0.00 51000. FORMAT "%5.0" /end CHARACTERISTIC
/begin CHARACTERISTIC DSM_TsfDfp_ETClbInj6_C "Schwerezaehlergrenze fuer Fehlerpfad Dfp_ETClbInj6" VALUE 0xD26AA Kw_Wu8 51000. TimeDsmTsf 0.00 51000. FORMAT "%5.0" /end CHARACTERISTIC
/begin CHARACTERISTIC DSM_TsfDfp_ETClbInj7_C "Schwerezaehlergrenze fuer Fehlerpfad Dfp_ETClbInj7" VALUE 0xD26AB Kw_Wu8 51000. TimeDsmTsf 0.00 51000. FORMAT "%5.0" /end CHARACTERISTIC
/begin CHARACTERISTIC DSM_TsfDfp_ETClbInj8_C "Schwerezaehlergrenze fuer Fehlerpfad Dfp_ETClbInj8" VALUE 0xD26AC Kw_Wu8 51000. TimeDsmTsf 0.00 51000. FORMAT "%5.0" /end CHARACTERISTIC
/begin CHARACTERISTIC DSM_TsfDfp_EngMCaS1_C "Schwerezaehlergrenze fuer Fehlerpfad Dfp_EngMCaS1" VALUE 0xD26AD Kw_Wu8 51000. TimeDsmTsf 0.00 51000. FORMAT "%5.0" /end CHARACTERISTIC
/begin CHARACTERISTIC DSM_TsfDfp_EngMCrS1_C "Schwerezaehlergrenze fuer Fehlerpfad Dfp_EngMCrS1" VALUE 0xD26AE Kw_Wu8 51000. TimeDsmTsf 0.00 51000. FORMAT "%5.0" /end CHARACTERISTIC
/begin CHARACTERISTIC DSM_TsfDfp_EngMOfsCaSCrS_C "Schwerezaehlergrenze fuer Fehlerpfad Dfp_EngMOfsCaSCrS" VALUE 0xD26AF Kw_Wu8 51000. TimeDsmTsf 0.00 51000. FORMAT "%5.0" /end CHARACTERISTIC
/begin CHARACTERISTIC DSM_TsfDfp_EngMntCtlCD_C "Schwerezaehlergrenze fuer Fehlerpfad Dfp_EngMntCtlCD" VALUE 0xD26B0 Kw_Wu8 51000. TimeDsmTsf 0.00 51000. FORMAT "%5.0" /end CHARACTERISTIC
/begin CHARACTERISTIC DSM_TsfDfp_FBCqDvt_C "Schwerezaehlergrenze fuer Fehlerpfad Dfp_FBCqDvt" VALUE 0xD26B1 Kw_Wu8 51000. TimeDsmTsf 0.00 51000. FORMAT "%5.0" /end CHARACTERISTIC
/begin CHARACTERISTIC DSM_TsfDfp_FMAErrMod_C "Schwerezaehlergrenze fuer Fehlerpfad Dfp_FMAErrMod" VALUE 0xD26B2 Kw_Wu8 51000. TimeDsmTsf 0.00 51000. FORMAT "%5.0" /end CHARACTERISTIC
/begin CHARACTERISTIC DSM_TsfDfp_FMTC_NonMonotonMap_C "Schwerezaehlergrenze fuer Fehlerpfad Dfp_FMTC_NonMonotonMap" VALUE 0xD26B3 Kw_Wu8 51000. TimeDsmTsf 0.00 51000. FORMAT "%5.0" /end CHARACTERISTIC
/begin CHARACTERISTIC DSM_TsfDfp_FTSCD_C "Schwerezaehlergrenze fuer Fehlerpfad Dfp_FTSCD" VALUE 0xD26B4 Kw_Wu8 51000. TimeDsmTsf 0.00 51000. FORMAT "%5.0" /end CHARACTERISTIC
/begin CHARACTERISTIC DSM_TsfDfp_FanCD_C "Schwerezaehlergrenze fuer Fehlerpfad Dfp_FanCD" VALUE 0xD26B5 Kw_Wu8 51000. TimeDsmTsf 0.00 51000. FORMAT "%5.0" /end CHARACTERISTIC
/begin CHARACTERISTIC DSM_TsfDfp_FanCD_FanCtlr1_C "Schwerezaehlergrenze fuer Fehlerpfad Dfp_FanCD_FanCtlr1" VALUE 0xD26B6 Kw_Wu8 51000. TimeDsmTsf 0.00 51000. FORMAT "%5.0" /end CHARACTERISTIC
/begin CHARACTERISTIC DSM_TsfDfp_FanCD_FanCtlr2_C "Schwerezaehlergrenze fuer Fehlerpfad Dfp_FanCD_FanCtlr2" VALUE 0xD26B7 Kw_Wu8 51000. TimeDsmTsf 0.00 51000. FORMAT "%5.0" /end CHARACTERISTIC
/begin CHARACTERISTIC DSM_TsfDfp_FanCD_FanCtlr3_C "Schwerezaehlergrenze fuer Fehlerpfad Dfp_FanCD_FanCtlr3" VALUE 0xD26B8 Kw_Wu8 51000. TimeDsmTsf 0.00 51000. FORMAT "%5.0" /end CHARACTERISTIC
/begin CHARACTERISTIC DSM_TsfDfp_FlFCD_C "Schwerezaehlergrenze fuer Fehlerpfad Dfp_FlFCD" VALUE 0xD26B9 Kw_Wu8 51000. TimeDsmTsf 0.00 51000. FORMAT "%5.0" /end CHARACTERISTIC
/begin CHARACTERISTIC DSM_TsfDfp_FlMngSmkDefect_C "Schwerezaehlergrenze fuer Fehlerpfad Dfp_FlMngSmkDefect" VALUE 0xD26BA Kw_Wu8 51000. TimeDsmTsf 0.00 51000. FORMAT "%5.0" /end CHARACTERISTIC
/begin CHARACTERISTIC DSM_TsfDfp_FlSCDT1_C "Schwerezaehlergrenze fuer Fehlerpfad Dfp_FlSCDT1" VALUE 0xD26BB Kw_Wu8 51000. TimeDsmTsf 0.00 51000. FORMAT "%5.0" /end CHARACTERISTIC
/begin CHARACTERISTIC DSM_TsfDfp_FrmMngANFRADMOMPT_C "Schwerezaehlergrenze fuer Fehlerpfad Dfp_FrmMngANFRADMOMPT" VALUE 0xD26BC Kw_Wu8 51000. TimeDsmTsf 0.00 51000. FORMAT "%5.0" /end CHARACTERISTIC
/begin CHARACTERISTIC DSM_TsfDfp_FrmMngASC1_C "Schwerezaehlergrenze fuer Fehlerpfad Dfp_FrmMngASC1" VALUE 0xD26BD Kw_Wu8 51000. TimeDsmTsf 0.00 51000. FORMAT "%5.0" /end CHARACTERISTIC
/begin CHARACTERISTIC DSM_TsfDfp_FrmMngASC2_C "Schwerezaehlergrenze fuer Fehlerpfad Dfp_FrmMngASC2" VALUE 0xD26BE Kw_Wu8 51000. TimeDsmTsf 0.00 51000. FORMAT "%5.0" /end CHARACTERISTIC
/begin CHARACTERISTIC DSM_TsfDfp_FrmMngASC3_C "Schwerezaehlergrenze fuer Fehlerpfad Dfp_FrmMngASC3" VALUE 0xD26BF Kw_Wu8 51000. TimeDsmTsf 0.00 51000. FORMAT "%5.0" /end CHARACTERISTIC
/begin CHARACTERISTIC DSM_TsfDfp_FrmMngASC4_C "Schwerezaehlergrenze fuer Fehlerpfad Dfp_FrmMngASC4" VALUE 0xD26C0 Kw_Wu8 51000. TimeDsmTsf 0.00 51000. FORMAT "%5.0" /end CHARACTERISTIC
/begin CHARACTERISTIC DSM_TsfDfp_FrmMngBOS_RESET_C "Schwerezaehlergrenze fuer Fehlerpfad Dfp_FrmMngBOS_RESET" VALUE 0xD26C1 Kw_Wu8 51000. TimeDsmTsf 0.00 51000. FORMAT "%5.0" /end CHARACTERISTIC
/begin CHARACTERISTIC DSM_TsfDfp_FrmMngBOS_RESET2_C "Schwerezaehlergrenze fuer Fehlerpfad Dfp_FrmMngBOS_RESET2" VALUE 0xD26C2 Kw_Wu8 51000. TimeDsmTsf 0.00 51000. FORMAT "%5.0" /end CHARACTERISTIC
/begin CHARACTERISTIC DSM_TsfDfp_FrmMngDMANFAFS_C "Schwerezaehlergrenze fuer Fehlerpfad Dfp_FrmMngDMANFAFS" VALUE 0xD26C3 Kw_Wu8 51000. TimeDsmTsf 0.00 51000. FORMAT "%5.0" /end CHARACTERISTIC
/begin CHARACTERISTIC DSM_TsfDfp_FrmMngDRMANFSSG_C "Schwerezaehlergrenze fuer Fehlerpfad Dfp_FrmMngDRMANFSSG" VALUE 0xD26C4 Kw_Wu8 51000. TimeDsmTsf 0.00 51000. FORMAT "%5.0" /end CHARACTERISTIC
/begin CHARACTERISTIC DSM_TsfDfp_FrmMngEGS1_C "Schwerezaehlergrenze fuer Fehlerpfad Dfp_FrmMngEGS1" VALUE 0xD26C5 Kw_Wu8 51000. TimeDsmTsf 0.00 51000. FORMAT "%5.0" /end CHARACTERISTIC
/begin CHARACTERISTIC DSM_TsfDfp_FrmMngEGS2_C "Schwerezaehlergrenze fuer Fehlerpfad Dfp_FrmMngEGS2" VALUE 0xD26C6 Kw_Wu8 51000. TimeDsmTsf 0.00 51000. FORMAT "%5.0" /end CHARACTERISTIC
/begin CHARACTERISTIC DSM_TsfDfp_FrmMngGEARBX_DATA_C "severity-counter for path" VALUE 0xD26C7 Kw_Wu8 51000. TimeDsmTsf 0.00 51000. FORMAT "%5.0" /end CHARACTERISTIC
/begin CHARACTERISTIC DSM_TsfDfp_FrmMngGEARBX_DATA2_C "Schwerezaehlergrenze fuer Fehlerpfad Dfp_FrmMngGEARBX_DATA2" VALUE 0xD26C8 Kw_Wu8 51000. TimeDsmTsf 0.00 51000. FORMAT "%5.0" /end CHARACTERISTIC
/begin CHARACTERISTIC DSM_TsfDfp_FrmMngHEAT_AC_C "severity-counter for path" VALUE 0xD26C9 Kw_Wu8 51000. TimeDsmTsf 0.00 51000. FORMAT "%5.0" /end CHARACTERISTIC
/begin CHARACTERISTIC DSM_TsfDfp_FrmMngINSTR2_C "Schwerezaehlergrenze fuer Fehlerpfad Dfp_FrmMngINSTR2" VALUE 0xD26CA Kw_Wu8 51000. TimeDsmTsf 0.00 51000. FORMAT "%5.0" /end CHARACTERISTIC
/begin CHARACTERISTIC DSM_TsfDfp_FrmMngINSTR3_C "Schwerezaehlergrenze fuer Fehlerpfad Dfp_FrmMngINSTR3" VALUE 0xD26CB Kw_Wu8 51000. TimeDsmTsf 0.00 51000. FORMAT "%5.0" /end CHARACTERISTIC
/begin CHARACTERISTIC DSM_TsfDfp_FrmMngLENKRADWINKEL_C "Schwerezaehlergrenze fuer Fehlerpfad Dfp_FrmMngLENKRADWINKEL" VALUE 0xD26CC Kw_Wu8 51000. TimeDsmTsf 0.00 51000. FORMAT "%5.0" /end CHARACTERISTIC
/begin CHARACTERISTIC DSM_TsfDfp_FrmMngMILEAGE_RANGE_C "Schwerezaehlergrenze fuer Fehlerpfad Dfp_FrmMngMILEAGE_RANGE" VALUE 0xD26CD Kw_Wu8 51000. TimeDsmTsf 0.00 51000. FORMAT "%5.0" /end CHARACTERISTIC
/begin CHARACTERISTIC DSM_TsfDfp_FrmMngMSPHISYNC_C "Schwerezaehlergrenze fuer Fehlerpfad Dfp_FrmMngMSPHISYNC" VALUE 0xD26CE Kw_Wu8 51000. TimeDsmTsf 0.00 51000. FORMAT "%5.0" /end CHARACTERISTIC
/begin CHARACTERISTIC DSM_TsfDfp_FrmMngMST4_C "Schwerezaehlergrenze fuer Fehlerpfad Dfp_FrmMngMST4" VALUE 0xD26CF Kw_Wu8 51000. TimeDsmTsf 0.00 51000. FORMAT "%5.0" /end CHARACTERISTIC
/begin CHARACTERISTIC DSM_TsfDfp_FrmMngMST5_C "Schwerezaehlergrenze fuer Fehlerpfad Dfp_FrmMngMST5" VALUE 0xD26D0 Kw_Wu8 51000. TimeDsmTsf 0.00 51000. FORMAT "%5.0" /end CHARACTERISTIC
/begin CHARACTERISTIC DSM_TsfDfp_FrmMngOPCRCTLACC_C "Schwerezaehlergrenze fuer Fehlerpfad Dfp_FrmMngOPCRCTLACC" VALUE 0xD26D1 Kw_Wu8 51000. TimeDsmTsf 0.00 51000. FORMAT "%5.0" /end CHARACTERISTIC
/begin CHARACTERISTIC DSM_TsfDfp_FrmMngPRGG_CCTR_C "Schwerezaehlergrenze fuer Fehlerpfad Dfp_FrmMngPRGG_CCTR" VALUE 0xD26D2 Kw_Wu8 51000. TimeDsmTsf 0.00 51000. FORMAT "%5.0" /end CHARACTERISTIC
/begin CHARACTERISTIC DSM_TsfDfp_FrmMngPWRMNG_LOADV_C "Schwerezaehlergrenze fuer Fehlerpfad Dfp_FrmMngPWRMNG_LOADV" VALUE 0xD26D3 Kw_Wu8 51000. TimeDsmTsf 0.00 51000. FORMAT "%5.0" /end CHARACTERISTIC
/begin CHARACTERISTIC DSM_TsfDfp_FrmMngParkConsumer_C "Schwerezaehlgrenze fuer Fehlerpfad Dfp_FrmMngParkConsumer" VALUE 0xD26D4 Kw_Wu8 51000. TimeDsmTsf 0.00 51000. FORMAT "%5.0" /end CHARACTERISTIC
/begin CHARACTERISTIC DSM_TsfDfp_FrmMngRQSTGEFAN_C "Schwerezaehlergrenze fuer Fehlerpfad Dfp_FrmMngRQSTGEFAN_C" VALUE 0xD26D5 Kw_Wu8 51000. TimeDsmTsf 0.00 51000. FORMAT "%5.0" /end CHARACTERISTIC
/begin CHARACTERISTIC DSM_TsfDfp_FrmMngSLV4_C "Schwerezaehlergrenze fuer Fehlerpfad Dfp_FrmMngSLV4" VALUE 0xD26D6 Kw_Wu8 51000. TimeDsmTsf 0.00 51000. FORMAT "%5.0" /end CHARACTERISTIC
/begin CHARACTERISTIC DSM_TsfDfp_FrmMngSLV5_C "Schwerezaehlergrenze fuer Fehlerpfad Dfp_FrmMngSLV5" VALUE 0xD26D7 Kw_Wu8 51000. TimeDsmTsf 0.00 51000. FORMAT "%5.0" /end CHARACTERISTIC
/begin CHARACTERISTIC DSM_TsfDfp_FrmMngSSGErr_C "Schwerezaehlergrenze fuer Fehlerpfad Dfp_FrmMngSSGErr" VALUE 0xD26D8 Kw_Wu8 51000. TimeDsmTsf 0.00 51000. FORMAT "%5.0" /end CHARACTERISTIC
/begin CHARACTERISTIC DSM_TsfDfp_FrmMngSSGShOff_C "Schwerezaehlergrenze fuer Fehlerpfad Dfp_FrmMngSSGShOff" VALUE 0xD26D9 Kw_Wu8 51000. TimeDsmTsf 0.00 51000. FORMAT "%5.0" /end CHARACTERISTIC
/begin CHARACTERISTIC DSM_TsfDfp_FrmMngSTAT_ANH_C "Schwerezaehlergrenze fuer Fehlerpfad Dfp_FrmMngSTAT_ANH" VALUE 0xD26DA Kw_Wu8 51000. TimeDsmTsf 0.00 51000. FORMAT "%5.0" /end CHARACTERISTIC
/begin CHARACTERISTIC DSM_TsfDfp_FrmMngSTAT_ARS_C "severity-counter for path" VALUE 0xD26DB Kw_Wu8 51000. TimeDsmTsf 0.00 51000. FORMAT "%5.0" /end CHARACTERISTIC
/begin CHARACTERISTIC DSM_TsfDfp_FrmMngSTAT_DSC_C "severity-counter for path" VALUE 0xD26DC Kw_Wu8 51000. TimeDsmTsf 0.00 51000. FORMAT "%5.0" /end CHARACTERISTIC
/begin CHARACTERISTIC DSM_TsfDfp_FrmMngSTAT_EKP_C "Schwerezaehlergrenze fuer Fehlerpfad Dfp_FrmMngSTAT_EKP" VALUE 0xD26DD Kw_Wu8 51000. TimeDsmTsf 0.00 51000. FORMAT "%5.0" /end CHARACTERISTIC
/begin CHARACTERISTIC DSM_TsfDfp_FrmMngSTAT_KOMBI_C "Schwerezaehlergrenze fuer Fehlerpfad Dfp_FrmMngSTAT_KOMBI" VALUE 0xD26DE Kw_Wu8 51000. TimeDsmTsf 0.00 51000. FORMAT "%5.0" /end CHARACTERISTIC
/begin CHARACTERISTIC DSM_TsfDfp_FrmMngSTAT_SITZ_C "Schwerezaehlergrenze fuer Fehlerpfad Dfp_FrmMngSTAT_SITZ" VALUE 0xD26DF Kw_Wu8 51000. TimeDsmTsf 0.00 51000. FORMAT "%5.0" /end CHARACTERISTIC
/begin CHARACTERISTIC DSM_TsfDfp_FrmMngStOBDGbxMilOf_C "Schwerezaehlergrenze fuer Fehlerpfad Dfp_FrmMngStOBDGbxMilOf" VALUE 0xD26E0 Kw_Wu8 51000. TimeDsmTsf 0.00 51000. FORMAT "%5.0" /end CHARACTERISTIC
/begin CHARACTERISTIC DSM_TsfDfp_FrmMngStOBDGbxMilOn_C "Schwerezaehlergrenze fuer Fehlerpfad Dfp_FrmMngStOBDGbxMilOn" VALUE 0xD26E1 Kw_Wu8 51000. TimeDsmTsf 0.00 51000. FORMAT "%5.0" /end CHARACTERISTIC
/begin CHARACTERISTIC DSM_TsfDfp_FrmMngTEMPRELTIME_C "Schwerezaehlergrenze fuer Fehlerpfad Dfp_FrmMngTEMPRELTIME" VALUE 0xD26E2 Kw_Wu8 51000. TimeDsmTsf 0.00 51000. FORMAT "%5.0" /end CHARACTERISTIC
/begin CHARACTERISTIC DSM_TsfDfp_FrmMngTERMINAL_C "severity-counter for path" VALUE 0xD26E3 Kw_Wu8 51000. TimeDsmTsf 0.00 51000. FORMAT "%5.0" /end CHARACTERISTIC
/begin CHARACTERISTIC DSM_TsfDfp_FrmMngTIME_DATE_C "Schwerezaehlergrenze fuer Fehlerpfad Dfp_FrmMngTIME_DATE" VALUE 0xD26E4 Kw_Wu8 51000. TimeDsmTsf 0.00 51000. FORMAT "%5.0" /end CHARACTERISTIC
/begin CHARACTERISTIC DSM_TsfDfp_FrmMngTORQUE_DSC_C "severity-counter for path" VALUE 0xD26E5 Kw_Wu8 51000. TimeDsmTsf 0.00 51000. FORMAT "%5.0" /end CHARACTERISTIC
/begin CHARACTERISTIC DSM_TsfDfp_FrmMngTORQUE_GEARBX_C "severity-counter for path" VALUE 0xD26E6 Kw_Wu8 51000. TimeDsmTsf 0.00 51000. FORMAT "%5.0" /end CHARACTERISTIC
/begin CHARACTERISTIC DSM_TsfDfp_FrmMngTrq_ReqACC_C "Schwerezaehlergrenze fuer Fehlerpfad Dfp_FrmMngTrq_ReqACC" VALUE 0xD26E7 Kw_Wu8 51000. TimeDsmTsf 0.00 51000. FORMAT "%5.0" /end CHARACTERISTIC
/begin CHARACTERISTIC DSM_TsfDfp_FrmMngVEH_MOD_C "Schwerezaehlergrenze fuer Fehlerpfad Dfp_FrmMngVEH_MOD_C" VALUE 0xD26E8 Kw_Wu8 51000. TimeDsmTsf 0.00 51000. FORMAT "%5.0" /end CHARACTERISTIC
/begin CHARACTERISTIC DSM_TsfDfp_FrmMngVELOCITY_C "severity-counter for path" VALUE 0xD26E9 Kw_Wu8 51000. TimeDsmTsf 0.00 51000. FORMAT "%5.0" /end CHARACTERISTIC
/begin CHARACTERISTIC DSM_TsfDfp_FrmMngWHEEL_SPEED_C "Schwerezaehlergrenze fuer Fehlerpfad Dfp_FrmMngWHEEL_SPEED" VALUE 0xD26EA Kw_Wu8 51000. TimeDsmTsf 0.00 51000. FORMAT "%5.0" /end CHARACTERISTIC
/begin CHARACTERISTIC DSM_TsfDfp_FrmMngstCurr_C "Schwerezählergrenze für Dfp_FrmMngstCurr" VALUE 0xD26EB Kw_Wu8 51000. TimeDsmTsf 0.00 51000. FORMAT "%5.0" /end CHARACTERISTIC
/begin CHARACTERISTIC DSM_TsfDfp_FrmMngswtPSPOff_C "Schwerezählergrenze für Dfp_FrmMngswtPSPOff" VALUE 0xD26EC Kw_Wu8 51000. TimeDsmTsf 0.00 51000. FORMAT "%5.0" /end CHARACTERISTIC
/begin CHARACTERISTIC DSM_TsfDfp_GearbxIncMax_C "Schwerezaehlergrenze fuer Fehlerpfad Dfp_GearbxIncMax" VALUE 0xD26ED Kw_Wu8 51000. TimeDsmTsf 0.00 51000. FORMAT "%5.0" /end CHARACTERISTIC
/begin CHARACTERISTIC DSM_TsfDfp_GlwCD_C "Schwerezaehlergrenze fuer Fehlerpfad Dfp_GlwCD" VALUE 0xD26EE Kw_Wu8 51000. TimeDsmTsf 0.00 51000. FORMAT "%5.0" /end CHARACTERISTIC
/begin CHARACTERISTIC DSM_TsfDfp_GlwCDGlwCirc1_C "Schwerezaehlergrenze fuer Fehlerpfad Dfp_GlwCDGlwCirc1" VALUE 0xD26EF Kw_Wu8 51000. TimeDsmTsf 0.00 51000. FORMAT "%5.0" /end CHARACTERISTIC
/begin CHARACTERISTIC DSM_TsfDfp_GlwCDGlwCirc2_C "Schwerezaehlergrenze fuer Fehlerpfad Dfp_GlwCDGlwCirc2" VALUE 0xD26F0 Kw_Wu8 51000. TimeDsmTsf 0.00 51000. FORMAT "%5.0" /end CHARACTERISTIC
/begin CHARACTERISTIC DSM_TsfDfp_GlwCDGlwCirc3_C "Schwerezaehlergrenze fuer Fehlerpfad Dfp_GlwCDGlwCirc3" VALUE 0xD26F1 Kw_Wu8 51000. TimeDsmTsf 0.00 51000. FORMAT "%5.0" /end CHARACTERISTIC
/begin CHARACTERISTIC DSM_TsfDfp_GlwCDGlwCirc4_C "Schwerezaehlergrenze fuer Fehlerpfad Dfp_GlwCDGlwCirc4" VALUE 0xD26F2 Kw_Wu8 51000. TimeDsmTsf 0.00 51000. FORMAT "%5.0" /end CHARACTERISTIC
/begin CHARACTERISTIC DSM_TsfDfp_GlwCDGlwCirc5_C "Schwerezaehlergrenze fuer Fehlerpfad Dfp_GlwCDGlwCirc5" VALUE 0xD26F3 Kw_Wu8 51000. TimeDsmTsf 0.00 51000. FORMAT "%5.0" /end CHARACTERISTIC
/begin CHARACTERISTIC DSM_TsfDfp_GlwCDGlwCirc6_C "Schwerezaehlergrenze fuer Fehlerpfad Dfp_GlwCDGlwCirc6" VALUE 0xD26F4 Kw_Wu8 51000. TimeDsmTsf 0.00 51000. FORMAT "%5.0" /end CHARACTERISTIC
/begin CHARACTERISTIC DSM_TsfDfp_GlwCDGlwCirc7_C "Schwerezaehlergrenze fuer Fehlerpfad Dfp_GlwCDGlwCirc7" VALUE 0xD26F5 Kw_Wu8 51000. TimeDsmTsf 0.00 51000. FORMAT "%5.0" /end CHARACTERISTIC
/begin CHARACTERISTIC DSM_TsfDfp_GlwCDGlwCirc8_C "Schwerezaehlergrenze fuer Fehlerpfad Dfp_GlwCDGlwCirc8" VALUE 0xD26F6 Kw_Wu8 51000. TimeDsmTsf 0.00 51000. FORMAT "%5.0" /end CHARACTERISTIC
/begin CHARACTERISTIC DSM_TsfDfp_GlwCtl_C "Schwerezaehlergrenze fuer Fehlerpfad Dfp_GlwCtl" VALUE 0xD26F7 Kw_Wu8 51000. TimeDsmTsf 0.00 51000. FORMAT "%5.0" /end CHARACTERISTIC
/begin CHARACTERISTIC DSM_TsfDfp_HWEMonCom_C "Schwerezaehlergrenze fuer Fehlerpfad Dfp_HWEMonCom" VALUE 0xD26F8 Kw_Wu8 51000. TimeDsmTsf 0.00 51000. FORMAT "%5.0" /end CHARACTERISTIC
/begin CHARACTERISTIC DSM_TsfDfp_HWEMonEEPROM_C "Schwerezaehlergrenze fuer Fehlerpfad Dfp_HWEMonEEPROM" VALUE 0xD26F9 Kw_Wu8 51000. TimeDsmTsf 0.00 51000. FORMAT "%5.0" /end CHARACTERISTIC
/begin CHARACTERISTIC DSM_TsfDfp_HWEMonRcyLocked_C "Schwerezaehlergrenze fuer Fehlerpfad Dfp_HWEMonRcyLocked" VALUE 0xD26FA Kw_Wu8 51000. TimeDsmTsf 0.00 51000. FORMAT "%5.0" /end CHARACTERISTIC
/begin CHARACTERISTIC DSM_TsfDfp_HWEMonRcySuppressed_C "Schwerezaehlergrenze fuer Fehlerpfad Dfp_HWEMonRcySuppressed" VALUE 0xD26FB Kw_Wu8 51000. TimeDsmTsf 0.00 51000. FORMAT "%5.0" /end CHARACTERISTIC
/begin CHARACTERISTIC DSM_TsfDfp_HWEMonRcyVisible_C "Schwerezaehlergrenze fuer Fehlerpfad Dfp_HWEMonRcyVisible" VALUE 0xD26FC Kw_Wu8 51000. TimeDsmTsf 0.00 51000. FORMAT "%5.0" /end CHARACTERISTIC
/begin CHARACTERISTIC DSM_TsfDfp_HWEMonUMaxSupply_C "Schwerezaehlergrenze fuer Fehlerpfad Dfp_HWEMonUMaxSupply" VALUE 0xD26FD Kw_Wu8 51000. TimeDsmTsf 0.00 51000. FORMAT "%5.0" /end CHARACTERISTIC
/begin CHARACTERISTIC DSM_TsfDfp_HWEMonUMinSupply_C "Schwerezaehlergrenze fuer Fehlerpfad Dfp_HWEMonUMinSupply" VALUE 0xD26FE Kw_Wu8 51000. TimeDsmTsf 0.00 51000. FORMAT "%5.0" /end CHARACTERISTIC
/begin CHARACTERISTIC DSM_TsfDfp_IATSCD_C "Schwerezaehlergrenze fuer Fehlerpfad Dfp_IATSCD" VALUE 0xD26FF Kw_Wu8 51000. TimeDsmTsf 0.00 51000. FORMAT "%5.0" /end CHARACTERISTIC
/begin CHARACTERISTIC DSM_TsfDfp_IATSCD_CATS_C "Schwerezaehlergrenze fuer Fehlerpfad Dfp_IATSCD_CATS" VALUE 0xD2700 Kw_Wu8 51000. TimeDsmTsf 0.00 51000. FORMAT "%5.0" /end CHARACTERISTIC
/begin CHARACTERISTIC DSM_TsfDfp_IATSCD_CATSSec_C "Schwerezaehlergrenze fuer Fehlerpfad Dfp_IATSCD_CATSSec" VALUE 0xD2701 Kw_Wu8 51000. TimeDsmTsf 0.00 51000. FORMAT "%5.0" /end CHARACTERISTIC
/begin CHARACTERISTIC DSM_TsfDfp_ImmCtlImmCD_C "Schwerezaehlergrenze fuer Fehlerpfad Dfp_ImmCtlImmCD" VALUE 0xD2702 Kw_Wu8 51000. TimeDsmTsf 0.00 51000. FORMAT "%5.0" /end CHARACTERISTIC
/begin CHARACTERISTIC DSM_TsfDfp_ImmCtlImmEep_C "Schwerezaehlergrenze fuer Fehlerpfad Dfp_ImmCtlImmEep" VALUE 0xD2703 Kw_Wu8 51000. TimeDsmTsf 0.00 51000. FORMAT "%5.0" /end CHARACTERISTIC
/begin CHARACTERISTIC DSM_TsfDfp_ImmCtlMpl_C "Schwerezaehlergrenze fuer Fehlerpfad Dfp_ImmCtlMpl" VALUE 0xD2704 Kw_Wu8 51000. TimeDsmTsf 0.00 51000. FORMAT "%5.0" /end CHARACTERISTIC
/begin CHARACTERISTIC DSM_TsfDfp_IndSys1_C "Schwerezaehlergrenze fuer Fehlerpfad Dfp_IndSys1" VALUE 0xD2705 Kw_Wu8 51000. TimeDsmTsf 0.00 51000. FORMAT "%5.0" /end CHARACTERISTIC
/begin CHARACTERISTIC DSM_TsfDfp_IndSys2_C "Schwerezaehlergrenze fuer Fehlerpfad Dfp_IndSys2" VALUE 0xD2706 Kw_Wu8 51000. TimeDsmTsf 0.00 51000. FORMAT "%5.0" /end CHARACTERISTIC
/begin CHARACTERISTIC DSM_TsfDfp_InjCrv_InjLim_C "Schwerezaehlergrenze fuer Fehlerpfad Dfp_InjCrv_InjLim" VALUE 0xD2707 Kw_Wu8 51000. TimeDsmTsf 0.00 51000. FORMAT "%5.0" /end CHARACTERISTIC
/begin CHARACTERISTIC DSM_TsfDfp_InjCtlAdjQnt_C "Schwerezaehlergrenze fuer Fehlerpfad Dfp_InjCtlAdjQnt" VALUE 0xD2708 Kw_Wu8 51000. TimeDsmTsf 0.00 51000. FORMAT "%5.0" /end CHARACTERISTIC
/begin CHARACTERISTIC DSM_TsfDfp_InjCtlDrift_C "Schwerezaehlergrenze fuer Fehlerpfad Dfp_InjCtlDrift" VALUE 0xD2709 Kw_Wu8 51000. TimeDsmTsf 0.00 51000. FORMAT "%5.0" /end CHARACTERISTIC
/begin CHARACTERISTIC DSM_TsfDfp_InjVCDActrChrg_C "Schwerezaehlergrenze fuer Fehlerpfad Dfp_InjVCDActrChrg" VALUE 0xD270A Kw_Wu8 51000. TimeDsmTsf 0.00 51000. FORMAT "%5.0" /end CHARACTERISTIC
/begin CHARACTERISTIC DSM_TsfDfp_InjVCDActrEnrg1_C "Schwerezaehlergrenze fuer Fehlerpfad Dfp_InjVCDActrEnrg1" VALUE 0xD270B Kw_Wu8 51000. TimeDsmTsf 0.00 51000. FORMAT "%5.0" /end CHARACTERISTIC
/begin CHARACTERISTIC DSM_TsfDfp_InjVCDActrEnrg2_C "Schwerezaehlergrenze fuer Fehlerpfad Dfp_InjVCDActrEnrg2" VALUE 0xD270C Kw_Wu8 51000. TimeDsmTsf 0.00 51000. FORMAT "%5.0" /end CHARACTERISTIC
/begin CHARACTERISTIC DSM_TsfDfp_InjVCDActrEnrg3_C "Schwerezaehlergrenze fuer Fehlerpfad Dfp_InjVCDActrEnrg3" VALUE 0xD270D Kw_Wu8 51000. TimeDsmTsf 0.00 51000. FORMAT "%5.0" /end CHARACTERISTIC
/begin CHARACTERISTIC DSM_TsfDfp_InjVCDActrEnrg4_C "Schwerezaehlergrenze fuer Fehlerpfad Dfp_InjVCDActrEnrg4" VALUE 0xD270E Kw_Wu8 51000. TimeDsmTsf 0.00 51000. FORMAT "%5.0" /end CHARACTERISTIC
/begin CHARACTERISTIC DSM_TsfDfp_InjVCDActrEnrg5_C "Schwerezaehlergrenze fuer Fehlerpfad Dfp_InjVCDActrEnrg5" VALUE 0xD270F Kw_Wu8 51000. TimeDsmTsf 0.00 51000. FORMAT "%5.0" /end CHARACTERISTIC
/begin CHARACTERISTIC DSM_TsfDfp_InjVCDActrEnrg6_C "Schwerezaehlergrenze fuer Fehlerpfad Dfp_InjVCDActrEnrg6" VALUE 0xD2710 Kw_Wu8 51000. TimeDsmTsf 0.00 51000. FORMAT "%5.0" /end CHARACTERISTIC
/begin CHARACTERISTIC DSM_TsfDfp_InjVCDActrEnrg7_C "Schwerezaehlergrenze fuer Fehlerpfad Dfp_InjVCDActrEnrg7" VALUE 0xD2711 Kw_Wu8 51000. TimeDsmTsf 0.00 51000. FORMAT "%5.0" /end CHARACTERISTIC
/begin CHARACTERISTIC DSM_TsfDfp_InjVCDActrEnrg8_C "Schwerezaehlergrenze fuer Fehlerpfad Dfp_InjVCDActrEnrg8" VALUE 0xD2712 Kw_Wu8 51000. TimeDsmTsf 0.00 51000. FORMAT "%5.0" /end CHARACTERISTIC
/begin CHARACTERISTIC DSM_TsfDfp_InjVCDActrVolt_C "Schwerezaehlergrenze fuer Fehlerpfad Dfp_InjVCDActrVolt" VALUE 0xD2713 Kw_Wu8 51000. TimeDsmTsf 0.00 51000. FORMAT "%5.0" /end CHARACTERISTIC
/begin CHARACTERISTIC DSM_TsfDfp_InjVCDClsBank1_C "Schwerezaehlergrenze fuer Fehlerpfad Dfp_InjVCDClsBank1" VALUE 0xD2714 Kw_Wu8 51000. TimeDsmTsf 0.00 51000. FORMAT "%5.0" /end CHARACTERISTIC
/begin CHARACTERISTIC DSM_TsfDfp_InjVCDClsBank2_C "Schwerezaehlergrenze fuer Fehlerpfad Dfp_InjVCDClsBank2" VALUE 0xD2715 Kw_Wu8 51000. TimeDsmTsf 0.00 51000. FORMAT "%5.0" /end CHARACTERISTIC
/begin CHARACTERISTIC DSM_TsfDfp_InjVCDMonCab_C "Schwerezaehlergrenze fuer Fehlerpfad Dfp_InjVCDMonCab" VALUE 0xD2716 Kw_Wu8 51000. TimeDsmTsf 0.00 51000. FORMAT "%5.0" /end CHARACTERISTIC
/begin CHARACTERISTIC DSM_TsfDfp_InjVCDMonSwt_C "Schwerezaehlergrenze fuer Fehlerpfad Dfp_InjVCDMonSwt" VALUE 0xD2717 Kw_Wu8 51000. TimeDsmTsf 0.00 51000. FORMAT "%5.0" /end CHARACTERISTIC
/begin CHARACTERISTIC DSM_TsfDfp_InjVCDShOffDCDC_C "Schwerezaehlergrenze fuer Fehlerpfad Dfp_InjVCDShOffDCDC" VALUE 0xD2718 Kw_Wu8 51000. TimeDsmTsf 0.00 51000. FORMAT "%5.0" /end CHARACTERISTIC
/begin CHARACTERISTIC DSM_TsfDfp_InjVCDUBuf1_C "Schwerezaehlergrenze fuer Fehlerpfad Dfp_InjVCDUBuf1" VALUE 0xD2719 Kw_Wu8 51000. TimeDsmTsf 0.00 51000. FORMAT "%5.0" /end CHARACTERISTIC
/begin CHARACTERISTIC DSM_TsfDfp_InjVCDUBuf2_C "Schwerezaehlergrenze fuer Fehlerpfad Dfp_InjVCDUBuf2" VALUE 0xD271A Kw_Wu8 51000. TimeDsmTsf 0.00 51000. FORMAT "%5.0" /end CHARACTERISTIC
/begin CHARACTERISTIC DSM_TsfDfp_InjVCD_CY370Ampl_C "Schwerezaehlergrenze fuer Fehlerpfad Dfp_InjVCD_CY370Ampl" VALUE 0xD271B Kw_Wu8 51000. TimeDsmTsf 0.00 51000. FORMAT "%5.0" /end CHARACTERISTIC
/begin CHARACTERISTIC DSM_TsfDfp_InjVCD_DrvTime_C "Schwerezaehlergrenze fuer Fehlerpfad Dfp_InjVCD_DrvTime" VALUE 0xD271C Kw_Wu8 51000. TimeDsmTsf 0.00 51000. FORMAT "%5.0" /end CHARACTERISTIC
/begin CHARACTERISTIC DSM_TsfDfp_InjVCD_DrvTimeRcy_C "Schwerezaehlergrenze fuer Fehlerpfad Dfp_InjVCD_DrvTimeRcy" VALUE 0xD271D Kw_Wu8 51000. TimeDsmTsf 0.00 51000. FORMAT "%5.0" /end CHARACTERISTIC
/begin CHARACTERISTIC DSM_TsfDfp_InjVCD_TPUErr_C "schwerezaehlergrenze fuer Fehlerpfad Dfp_InjVCD_TPUErr" VALUE 0xD271E Kw_Wu8 51000. TimeDsmTsf 0.00 51000. FORMAT "%5.0" /end CHARACTERISTIC
/begin CHARACTERISTIC DSM_TsfDfp_InjVlvBnk1A_C "Schwerezaehlergrenze fuer Fehlerpfad Dfp_InjVlvBnk1A" VALUE 0xD271F Kw_Wu8 51000. TimeDsmTsf 0.00 51000. FORMAT "%5.0" /end CHARACTERISTIC
/begin CHARACTERISTIC DSM_TsfDfp_InjVlvBnk1B_C "Schwerezaehlergrenze fuer Fehlerpfad Dfp_InjVlvBnk1B" VALUE 0xD2720 Kw_Wu8 51000. TimeDsmTsf 0.00 51000. FORMAT "%5.0" /end CHARACTERISTIC
/begin CHARACTERISTIC DSM_TsfDfp_InjVlvBnk2A_C "Schwerezaehlergrenze fuer Fehlerpfad Dfp_InjVlvBnk2A" VALUE 0xD2721 Kw_Wu8 51000. TimeDsmTsf 0.00 51000. FORMAT "%5.0" /end CHARACTERISTIC
/begin CHARACTERISTIC DSM_TsfDfp_InjVlvBnk2B_C "Schwerezaehlergrenze fuer Fehlerpfad Dfp_InjVlvBnk2B" VALUE 0xD2722 Kw_Wu8 51000. TimeDsmTsf 0.00 51000. FORMAT "%5.0" /end CHARACTERISTIC
/begin CHARACTERISTIC DSM_TsfDfp_InjVlvChipA_C "Schwerezaehlergrenze fuer Fehlerpfad Dfp_InjVlvChipA" VALUE 0xD2723 Kw_Wu8 51000. TimeDsmTsf 0.00 51000. FORMAT "%5.0" /end CHARACTERISTIC
/begin CHARACTERISTIC DSM_TsfDfp_InjVlvChipB_C "Schwerezaehlergrenze fuer Fehlerpfad Dfp_InjVlvChipB" VALUE 0xD2724 Kw_Wu8 51000. TimeDsmTsf 0.00 51000. FORMAT "%5.0" /end CHARACTERISTIC
/begin CHARACTERISTIC DSM_TsfDfp_InjVlvCyl1A_C "Schwerezaehlergrenze fuer Fehlerpfad Dfp_InjVlvCyl1A" VALUE 0xD2725 Kw_Wu8 51000. TimeDsmTsf 0.00 51000. FORMAT "%5.0" /end CHARACTERISTIC
/begin CHARACTERISTIC DSM_TsfDfp_InjVlvCyl1B_C "Schwerezaehlergrenze fuer Fehlerpfad Dfp_InjVlvCyl1B" VALUE 0xD2726 Kw_Wu8 51000. TimeDsmTsf 0.00 51000. FORMAT "%5.0" /end CHARACTERISTIC
/begin CHARACTERISTIC DSM_TsfDfp_InjVlvCyl1C_C "Schwerezaehlergrenze fuer Fehlerpfad Dfp_InjVlvCyl1C" VALUE 0xD2727 Kw_Wu8 51000. TimeDsmTsf 0.00 51000. FORMAT "%5.0" /end CHARACTERISTIC
/begin CHARACTERISTIC DSM_TsfDfp_InjVlvCyl2A_C "Schwerezaehlergrenze fuer Fehlerpfad Dfp_InjVlvCyl2A" VALUE 0xD2728 Kw_Wu8 51000. TimeDsmTsf 0.00 51000. FORMAT "%5.0" /end CHARACTERISTIC
/begin CHARACTERISTIC DSM_TsfDfp_InjVlvCyl2B_C "Schwerezaehlergrenze fuer Fehlerpfad Dfp_InjVlvCyl2B" VALUE 0xD2729 Kw_Wu8 51000. TimeDsmTsf 0.00 51000. FORMAT "%5.0" /end CHARACTERISTIC
/begin CHARACTERISTIC DSM_TsfDfp_InjVlvCyl2C_C "Schwerezaehlergrenze fuer Fehlerpfad Dfp_InjVlvCyl2C" VALUE 0xD272A Kw_Wu8 51000. TimeDsmTsf 0.00 51000. FORMAT "%5.0" /end CHARACTERISTIC
/begin CHARACTERISTIC DSM_TsfDfp_InjVlvCyl3A_C "Schwerezaehlergrenze fuer Fehlerpfad Dfp_InjVlvCyl3A" VALUE 0xD272B Kw_Wu8 51000. TimeDsmTsf 0.00 51000. FORMAT "%5.0" /end CHARACTERISTIC
/begin CHARACTERISTIC DSM_TsfDfp_InjVlvCyl3B_C "Schwerezaehlergrenze fuer Fehlerpfad Dfp_InjVlvCyl3B" VALUE 0xD272C Kw_Wu8 51000. TimeDsmTsf 0.00 51000. FORMAT "%5.0" /end CHARACTERISTIC
/begin CHARACTERISTIC DSM_TsfDfp_InjVlvCyl3C_C "Schwerezaehlergrenze fuer Fehlerpfad Dfp_InjVlvCyl3C" VALUE 0xD272D Kw_Wu8 51000. TimeDsmTsf 0.00 51000. FORMAT "%5.0" /end CHARACTERISTIC
/begin CHARACTERISTIC DSM_TsfDfp_InjVlvCyl4A_C "Schwerezaehlergrenze fuer Fehlerpfad Dfp_InjVlvCyl4A" VALUE 0xD272E Kw_Wu8 51000. TimeDsmTsf 0.00 51000. FORMAT "%5.0" /end CHARACTERISTIC
/begin CHARACTERISTIC DSM_TsfDfp_InjVlvCyl4B_C "Schwerezaehlergrenze fuer Fehlerpfad Dfp_InjVlvCyl4B" VALUE 0xD272F Kw_Wu8 51000. TimeDsmTsf 0.00 51000. FORMAT "%5.0" /end CHARACTERISTIC
/begin CHARACTERISTIC DSM_TsfDfp_InjVlvCyl4C_C "Schwerezaehlergrenze fuer Fehlerpfad Dfp_InjVlvCyl4C" VALUE 0xD2730 Kw_Wu8 51000. TimeDsmTsf 0.00 51000. FORMAT "%5.0" /end CHARACTERISTIC
/begin CHARACTERISTIC DSM_TsfDfp_InjVlvCyl5A_C "Schwerezaehlergrenze fuer Fehlerpfad Dfp_InjVlvCyl5A" VALUE 0xD2731 Kw_Wu8 51000. TimeDsmTsf 0.00 51000. FORMAT "%5.0" /end CHARACTERISTIC
/begin CHARACTERISTIC DSM_TsfDfp_InjVlvCyl5B_C "Schwerezaehlergrenze fuer Fehlerpfad Dfp_InjVlvCyl5B" VALUE 0xD2732 Kw_Wu8 51000. TimeDsmTsf 0.00 51000. FORMAT "%5.0" /end CHARACTERISTIC
/begin CHARACTERISTIC DSM_TsfDfp_InjVlvCyl5C_C "Schwerezaehlergrenze fuer Fehlerpfad Dfp_InjVlvCyl5C" VALUE 0xD2733 Kw_Wu8 51000. TimeDsmTsf 0.00 51000. FORMAT "%5.0" /end CHARACTERISTIC
/begin CHARACTERISTIC DSM_TsfDfp_InjVlvCyl6A_C "Schwerezaehlergrenze fuer Fehlerpfad Dfp_InjVlvCyl6A" VALUE 0xD2734 Kw_Wu8 51000. TimeDsmTsf 0.00 51000. FORMAT "%5.0" /end CHARACTERISTIC
/begin CHARACTERISTIC DSM_TsfDfp_InjVlvCyl6B_C "Schwerezaehlergrenze fuer Fehlerpfad Dfp_InjVlvCyl6B" VALUE 0xD2735 Kw_Wu8 51000. TimeDsmTsf 0.00 51000. FORMAT "%5.0" /end CHARACTERISTIC
/begin CHARACTERISTIC DSM_TsfDfp_InjVlvCyl6C_C "Schwerezaehlergrenze fuer Fehlerpfad Dfp_InjVlvCyl6C" VALUE 0xD2736 Kw_Wu8 51000. TimeDsmTsf 0.00 51000. FORMAT "%5.0" /end CHARACTERISTIC
/begin CHARACTERISTIC DSM_TsfDfp_InjVlvCyl7A_C "Schwerezaehlergrenze fuer Fehlerpfad Dfp_InjVlvCyl7A" VALUE 0xD2737 Kw_Wu8 51000. TimeDsmTsf 0.00 51000. FORMAT "%5.0" /end CHARACTERISTIC
/begin CHARACTERISTIC DSM_TsfDfp_InjVlvCyl7B_C "Schwerezaehlergrenze fuer Fehlerpfad Dfp_InjVlvCyl7B" VALUE 0xD2738 Kw_Wu8 51000. TimeDsmTsf 0.00 51000. FORMAT "%5.0" /end CHARACTERISTIC
/begin CHARACTERISTIC DSM_TsfDfp_InjVlvCyl7C_C "Schwerezaehlergrenze fuer Fehlerpfad Dfp_InjVlvCyl7C" VALUE 0xD2739 Kw_Wu8 51000. TimeDsmTsf 0.00 51000. FORMAT "%5.0" /end CHARACTERISTIC
/begin CHARACTERISTIC DSM_TsfDfp_InjVlvCyl8A_C "Schwerezaehlergrenze fuer Fehlerpfad Dfp_InjVlvCyl8A" VALUE 0xD273A Kw_Wu8 51000. TimeDsmTsf 0.00 51000. FORMAT "%5.0" /end CHARACTERISTIC
/begin CHARACTERISTIC DSM_TsfDfp_InjVlvCyl8B_C "Schwerezaehlergrenze fuer Fehlerpfad Dfp_InjVlvCyl8B" VALUE 0xD273B Kw_Wu8 51000. TimeDsmTsf 0.00 51000. FORMAT "%5.0" /end CHARACTERISTIC
/begin CHARACTERISTIC DSM_TsfDfp_InjVlvCyl8C_C "Schwerezaehlergrenze fuer Fehlerpfad Dfp_InjVlvCyl8C" VALUE 0xD273C Kw_Wu8 51000. TimeDsmTsf 0.00 51000. FORMAT "%5.0" /end CHARACTERISTIC
/begin CHARACTERISTIC DSM_TsfDfp_InjVlvNVC1_C "Schwerezaehlergrenze fuer Fehlerpfad Dfp_InjVlvNVC1" VALUE 0xD273D Kw_Wu8 51000. TimeDsmTsf 0.00 51000. FORMAT "%5.0" /end CHARACTERISTIC
/begin CHARACTERISTIC DSM_TsfDfp_InjVlvNVC2_C "Schwerezaehlergrenze fuer Fehlerpfad Dfp_InjVlvNVC2" VALUE 0xD273E Kw_Wu8 51000. TimeDsmTsf 0.00 51000. FORMAT "%5.0" /end CHARACTERISTIC
/begin CHARACTERISTIC DSM_TsfDfp_InjVlvNVC3_C "Schwerezaehlergrenze fuer Fehlerpfad Dfp_InjVlvNVC3" VALUE 0xD273F Kw_Wu8 51000. TimeDsmTsf 0.00 51000. FORMAT "%5.0" /end CHARACTERISTIC
/begin CHARACTERISTIC DSM_TsfDfp_InjVlvNVC4_C "Schwerezaehlergrenze fuer Fehlerpfad Dfp_InjVlvNVC4" VALUE 0xD2740 Kw_Wu8 51000. TimeDsmTsf 0.00 51000. FORMAT "%5.0" /end CHARACTERISTIC
/begin CHARACTERISTIC DSM_TsfDfp_InjVlvNVC5_C "Schwerezaehlergrenze fuer Fehlerpfad Dfp_InjVlvNVC5" VALUE 0xD2741 Kw_Wu8 51000. TimeDsmTsf 0.00 51000. FORMAT "%5.0" /end CHARACTERISTIC
/begin CHARACTERISTIC DSM_TsfDfp_InjVlvNVC6_C "Schwerezaehlergrenze fuer Fehlerpfad Dfp_InjVlvNVC6" VALUE 0xD2742 Kw_Wu8 51000. TimeDsmTsf 0.00 51000. FORMAT "%5.0" /end CHARACTERISTIC
/begin CHARACTERISTIC DSM_TsfDfp_InjVlvNVC7_C "Schwerezaehlergrenze fuer Fehlerpfad Dfp_InjVlvNVC7" VALUE 0xD2743 Kw_Wu8 51000. TimeDsmTsf 0.00 51000. FORMAT "%5.0" /end CHARACTERISTIC
/begin CHARACTERISTIC DSM_TsfDfp_InjVlvNVC8_C "Schwerezaehlergrenze fuer Fehlerpfad Dfp_InjVlvNVC8" VALUE 0xD2744 Kw_Wu8 51000. TimeDsmTsf 0.00 51000. FORMAT "%5.0" /end CHARACTERISTIC
/begin CHARACTERISTIC DSM_TsfDfp_KeyCheck_C "Schwerezaehlergrenze fuer Fehlerpfad Dfp_KeyCheck" VALUE 0xD2745 Kw_Wu8 51000. TimeDsmTsf 0.00 51000. FORMAT "%5.0" /end CHARACTERISTIC
/begin CHARACTERISTIC DSM_TsfDfp_LIGovECUTransMode_C "Schwerezaehlergrenze fuer Fehlerpfad Dfp_LIGovECUTransMode" VALUE 0xD2746 Kw_Wu8 51000. TimeDsmTsf 0.00 51000. FORMAT "%5.0" /end CHARACTERISTIC
/begin CHARACTERISTIC DSM_TsfDfp_LPACD_Max_C "Schwerezaehlergrenze fuer Fehlerpfad Dfp_LPACD_Max" VALUE 0xD2747 Kw_Wu8 51000. TimeDsmTsf 0.00 51000. FORMAT "%5.0" /end CHARACTERISTIC
/begin CHARACTERISTIC DSM_TsfDfp_LPACD_Min_C "Schwerezaehlergrenze fuer Fehlerpfad Dfp_LPACD_Min" VALUE 0xD2748 Kw_Wu8 51000. TimeDsmTsf 0.00 51000. FORMAT "%5.0" /end CHARACTERISTIC
/begin CHARACTERISTIC DSM_TsfDfp_LPACD_SigNpl_C "Schwerezaehlergrenze fuer Fehlerpfad Dfp_LPACD_SigNpl" VALUE 0xD2749 Kw_Wu8 51000. TimeDsmTsf 0.00 51000. FORMAT "%5.0" /end CHARACTERISTIC
/begin CHARACTERISTIC DSM_TsfDfp_LSUCDCircNernst0B1_C "Schwerezaehlergrenze fuer Fehlerpfad Dfp_LSUCDCircNernst0B1" VALUE 0xD274A Kw_Wu8 51000. TimeDsmTsf 0.00 51000. FORMAT "%5.0" /end CHARACTERISTIC
/begin CHARACTERISTIC DSM_TsfDfp_LSUCDCircNernst0B2_C "Schwerezaehlergrenze fuer Fehlerpfad Dfp_LSUCDCircNernst0B2" VALUE 0xD274B Kw_Wu8 51000. TimeDsmTsf 0.00 51000. FORMAT "%5.0" /end CHARACTERISTIC
/begin CHARACTERISTIC DSM_TsfDfp_LSUCDCircPumpCur0B1_C "Schwerezaehlergrenze fuer Fehlerpfad Dfp_LSUCDCircPumpCur0B1" VALUE 0xD274C Kw_Wu8 51000. TimeDsmTsf 0.00 51000. FORMAT "%5.0" /end CHARACTERISTIC
/begin CHARACTERISTIC DSM_TsfDfp_LSUCDCircPumpCur0B2_C "Schwerezaehlergrenze fuer Fehlerpfad Dfp_LSUCDCircPumpCur0B2" VALUE 0xD274D Kw_Wu8 51000. TimeDsmTsf 0.00 51000. FORMAT "%5.0" /end CHARACTERISTIC
/begin CHARACTERISTIC DSM_TsfDfp_LSUCDCircVirtGnd0B1_C "Schwerezaehlergrenze fuer Fehlerpfad Dfp_LSUCDCircVirtGnd0B1" VALUE 0xD274E Kw_Wu8 51000. TimeDsmTsf 0.00 51000. FORMAT "%5.0" /end CHARACTERISTIC
/begin CHARACTERISTIC DSM_TsfDfp_LSUCDCircVirtGnd0B2_C "Schwerezaehlergrenze fuer Fehlerpfad Dfp_LSUCDCircVirtGnd0B2" VALUE 0xD274F Kw_Wu8 51000. TimeDsmTsf 0.00 51000. FORMAT "%5.0" /end CHARACTERISTIC
/begin CHARACTERISTIC DSM_TsfDfp_LSUCDHeater0B1_C "Schwerezaehlergrenze fuer Fehlerpfad Dfp_LSUCDHeater0B1" VALUE 0xD2750 Kw_Wu8 51000. TimeDsmTsf 0.00 51000. FORMAT "%5.0" /end CHARACTERISTIC
/begin CHARACTERISTIC DSM_TsfDfp_LSUCDHeater0B2_C "Schwerezaehlergrenze fuer Fehlerpfad Dfp_LSUCDHeater0B2" VALUE 0xD2751 Kw_Wu8 51000. TimeDsmTsf 0.00 51000. FORMAT "%5.0" /end CHARACTERISTIC
/begin CHARACTERISTIC DSM_TsfDfp_LSUCDHtCoup0B1_C "Schwerezaehlergrenze fuer Fehlerpfad Dfp_LSUCDHtCoup0B1" VALUE 0xD2752 Kw_Wu8 51000. TimeDsmTsf 0.00 51000. FORMAT "%5.0" /end CHARACTERISTIC
/begin CHARACTERISTIC DSM_TsfDfp_LSUCDHtCoup0B2_C "Schwerezaehlergrenze fuer Fehlerpfad Dfp_LSUCDHtCoup0B2" VALUE 0xD2753 Kw_Wu8 51000. TimeDsmTsf 0.00 51000. FORMAT "%5.0" /end CHARACTERISTIC
/begin CHARACTERISTIC DSM_TsfDfp_LSUCDO20B1_C "Schwerezaehlergrenze fuer Fehlerpfad Dfp_LSUCDO20B1" VALUE 0xD2754 Kw_Wu8 51000. TimeDsmTsf 0.00 51000. FORMAT "%5.0" /end CHARACTERISTIC
/begin CHARACTERISTIC DSM_TsfDfp_LSUCDO20B2_C "Schwerezaehlergrenze fuer Fehlerpfad Dfp_LSUCDO20B2" VALUE 0xD2755 Kw_Wu8 51000. TimeDsmTsf 0.00 51000. FORMAT "%5.0" /end CHARACTERISTIC
/begin CHARACTERISTIC DSM_TsfDfp_LSUCDO2Clb0B1_C "Schwerezaehlergrenze fuer Fehlerpfad Dfp_LSUCDO2Clb0B1" VALUE 0xD2756 Kw_Wu8 51000. TimeDsmTsf 0.00 51000. FORMAT "%5.0" /end CHARACTERISTIC
/begin CHARACTERISTIC DSM_TsfDfp_LSUCDO2Clb0B2_C "Schwerezaehlergrenze fuer Fehlerpfad Dfp_LSUCDO2Clb0B2" VALUE 0xD2757 Kw_Wu8 51000. TimeDsmTsf 0.00 51000. FORMAT "%5.0" /end CHARACTERISTIC
/begin CHARACTERISTIC DSM_TsfDfp_LSUCDRiClb0B1_C "Schwerezaehlergrenze fuer Fehlerpfad Dfp_LSUCDRiClb0B1" VALUE 0xD2758 Kw_Wu8 51000. TimeDsmTsf 0.00 51000. FORMAT "%5.0" /end CHARACTERISTIC
/begin CHARACTERISTIC DSM_TsfDfp_LSUCDRiClb0B2_C "Schwerezaehlergrenze fuer Fehlerpfad Dfp_LSUCDRiClb0B2" VALUE 0xD2759 Kw_Wu8 51000. TimeDsmTsf 0.00 51000. FORMAT "%5.0" /end CHARACTERISTIC
/begin CHARACTERISTIC DSM_TsfDfp_LSUCDSPI0B1_C "Schwerezaehlergrenze fuer Fehlerpfad Dfp_LSUCDSPI0B1" VALUE 0xD275A Kw_Wu8 51000. TimeDsmTsf 0.00 51000. FORMAT "%5.0" /end CHARACTERISTIC
/begin CHARACTERISTIC DSM_TsfDfp_LSUCDSPI0B2_C "Schwerezaehlergrenze fuer Fehlerpfad Dfp_LSUCDSPI0B2" VALUE 0xD275B Kw_Wu8 51000. TimeDsmTsf 0.00 51000. FORMAT "%5.0" /end CHARACTERISTIC
/begin CHARACTERISTIC DSM_TsfDfp_LSUCDSPIBattLow0B1_C "Schwerezaehlergrenze fuer Fehlerpfad Dfp_LSUCDSPIBattLow0B1" VALUE 0xD275C Kw_Wu8 51000. TimeDsmTsf 0.00 51000. FORMAT "%5.0" /end CHARACTERISTIC
/begin CHARACTERISTIC DSM_TsfDfp_LSUCDSPIBattLow0B2_C "Schwerezaehlergrenze fuer Fehlerpfad Dfp_LSUCDSPIBattLow0B2" VALUE 0xD275D Kw_Wu8 51000. TimeDsmTsf 0.00 51000. FORMAT "%5.0" /end CHARACTERISTIC
/begin CHARACTERISTIC DSM_TsfDfp_LSUCDWireIP0B1_C "Schwerezaehlergrenze fuer Fehlerpfad Dfp_LSUCDWireIP0B1" VALUE 0xD275E Kw_Wu8 51000. TimeDsmTsf 0.00 51000. FORMAT "%5.0" /end CHARACTERISTIC
/begin CHARACTERISTIC DSM_TsfDfp_LSUCDWireIP0B2_C "Schwerezaehlergrenze fuer Fehlerpfad Dfp_LSUCDWireIP0B2" VALUE 0xD275F Kw_Wu8 51000. TimeDsmTsf 0.00 51000. FORMAT "%5.0" /end CHARACTERISTIC
/begin CHARACTERISTIC DSM_TsfDfp_LSUCtlRiExc0B1_C "Schwerezaehlergrenze fuer Fehlerpfad Dfp_LSUCtlRiExc0B1" VALUE 0xD2760 Kw_Wu8 51000. TimeDsmTsf 0.00 51000. FORMAT "%5.0" /end CHARACTERISTIC
/begin CHARACTERISTIC DSM_TsfDfp_LSUCtlRiExc0B2_C "Schwerezaehlergrenze fuer Fehlerpfad Dfp_LSUCtlRiExc0B2" VALUE 0xD2761 Kw_Wu8 51000. TimeDsmTsf 0.00 51000. FORMAT "%5.0" /end CHARACTERISTIC
/begin CHARACTERISTIC DSM_TsfDfp_LSUMon1SensB1_C "Schwerezaehlergrenze fuer Fehlerpfad Dfp_LSUMon1SensB1" VALUE 0xD2762 Kw_Wu8 51000. TimeDsmTsf 0.00 51000. FORMAT "%5.0" /end CHARACTERISTIC
/begin CHARACTERISTIC DSM_TsfDfp_LSUMon1SensB2_C "Schwerezaehlergrenze fuer Fehlerpfad Dfp_LSUMon1SensB2" VALUE 0xD2763 Kw_Wu8 51000. TimeDsmTsf 0.00 51000. FORMAT "%5.0" /end CHARACTERISTIC
/begin CHARACTERISTIC DSM_TsfDfp_LSUMon2SensB1_C "Schwerezaehlergrenze fuer Fehlerpfad Dfp_LSUMon2SensB1" VALUE 0xD2764 Kw_Wu8 51000. TimeDsmTsf 0.00 51000. FORMAT "%5.0" /end CHARACTERISTIC
/begin CHARACTERISTIC DSM_TsfDfp_LSUMon2SensB2_C "Schwerezaehlergrenze fuer Fehlerpfad Dfp_LSUMon2SensB2" VALUE 0xD2765 Kw_Wu8 51000. TimeDsmTsf 0.00 51000. FORMAT "%5.0" /end CHARACTERISTIC
/begin CHARACTERISTIC DSM_TsfDfp_MIL_C "Schwerezaehlergrenze fuer Fehlerpfad Dfp_MIL" VALUE 0xD2766 Kw_Wu8 51000. TimeDsmTsf 0.00 51000. FORMAT "%5.0" /end CHARACTERISTIC
/begin CHARACTERISTIC DSM_TsfDfp_MRlyCD_C "Schwerezaehlergrenze fuer Fehlerpfad Dfp_MRlyCD" VALUE 0xD2767 Kw_Wu8 51000. TimeDsmTsf 0.00 51000. FORMAT "%5.0" /end CHARACTERISTIC
/begin CHARACTERISTIC DSM_TsfDfp_MSMon_C "Schwerezaehlergrenze fuer Fehlerpfad Dfp_MSMon" VALUE 0xD2768 Kw_Wu8 51000. TimeDsmTsf 0.00 51000. FORMAT "%5.0" /end CHARACTERISTIC
/begin CHARACTERISTIC DSM_TsfDfp_MSMonConsist_C "Schwerezaehlergrenze fuer Fehlerpfad Dfp_MSMonConsist" VALUE 0xD2769 Kw_Wu8 51000. TimeDsmTsf 0.00 51000. FORMAT "%5.0" /end CHARACTERISTIC
/begin CHARACTERISTIC DSM_TsfDfp_MSMonPFlt1_C "Schwerezaehlergrenze fuer Fehlerpfad Dfp_MSMonPFlt1" VALUE 0xD276A Kw_Wu8 51000. TimeDsmTsf 0.00 51000. FORMAT "%5.0" /end CHARACTERISTIC
/begin CHARACTERISTIC DSM_TsfDfp_MSMonPFlt2_C "Schwerezaehlergrenze fuer Fehlerpfad Dfp_MSMonPFlt2" VALUE 0xD276B Kw_Wu8 51000. TimeDsmTsf 0.00 51000. FORMAT "%5.0" /end CHARACTERISTIC
/begin CHARACTERISTIC DSM_TsfDfp_MSMonPFlt3_C "Schwerezaehlergrenze fuer Fehlerpfad Dfp_MSMonPFlt3" VALUE 0xD276C Kw_Wu8 51000. TimeDsmTsf 0.00 51000. FORMAT "%5.0" /end CHARACTERISTIC
/begin CHARACTERISTIC DSM_TsfDfp_MSMonPFlt4_C "Schwerezaehlergrenze fuer Fehlerpfad Dfp_MSMonPFlt4" VALUE 0xD276D Kw_Wu8 51000. TimeDsmTsf 0.00 51000. FORMAT "%5.0" /end CHARACTERISTIC
/begin CHARACTERISTIC DSM_TsfDfp_MSMon_ARS_TO_C "Schwerezaehlergrenze fuer Fehlerpfad Dfp_MSMon_ARS_TO" VALUE 0xD276E Kw_Wu8 51000. TimeDsmTsf 0.00 51000. FORMAT "%5.0" /end CHARACTERISTIC
/begin CHARACTERISTIC DSM_TsfDfp_MSMon_AirCtl_C "Schwerezaehlergrenze fuer Fehlerpfad Dfp_MSMon_AirCtl" VALUE 0xD276F Kw_Wu8 51000. TimeDsmTsf 0.00 51000. FORMAT "%5.0" /end CHARACTERISTIC
/begin CHARACTERISTIC DSM_TsfDfp_MSMon_AirSys0_C "Schwerezaehlergrenze fuer Fehlerpfad Dfp_MSMon_AirSys0" VALUE 0xD2770 Kw_Wu8 51000. TimeDsmTsf 0.00 51000. FORMAT "%5.0" /end CHARACTERISTIC
/begin CHARACTERISTIC DSM_TsfDfp_MSMon_AirSys1_C "Schwerezaehlergrenze fuer Fehlerpfad Dfp_MSMon_AirSys1" VALUE 0xD2771 Kw_Wu8 51000. TimeDsmTsf 0.00 51000. FORMAT "%5.0" /end CHARACTERISTIC
/begin CHARACTERISTIC DSM_TsfDfp_MSMon_AirSys2_C "Schwerezaehlergrenze fuer Fehlerpfad Dfp_MSMon_AirSys2" VALUE 0xD2772 Kw_Wu8 51000. TimeDsmTsf 0.00 51000. FORMAT "%5.0" /end CHARACTERISTIC
/begin CHARACTERISTIC DSM_TsfDfp_MSMon_AirSys3_C "Schwerezaehlergrenze fuer Fehlerpfad Dfp_MSMon_AirSys3" VALUE 0xD2773 Kw_Wu8 51000. TimeDsmTsf 0.00 51000. FORMAT "%5.0" /end CHARACTERISTIC
/begin CHARACTERISTIC DSM_TsfDfp_MSMon_AirSys4_C "Schwerezaehlergrenze fuer Fehlerpfad Dfp_MSMon_AirSys4" VALUE 0xD2774 Kw_Wu8 51000. TimeDsmTsf 0.00 51000. FORMAT "%5.0" /end CHARACTERISTIC
/begin CHARACTERISTIC DSM_TsfDfp_MSMon_AirSys7_C "Schwerezaehlergrenze fuer Fehlerpfad Dfp_MSMon_AirSys7" VALUE 0xD2775 Kw_Wu8 51000. TimeDsmTsf 0.00 51000. FORMAT "%5.0" /end CHARACTERISTIC
/begin CHARACTERISTIC DSM_TsfDfp_MSMon_CanDef_C "Schwerezaehlergrenze fuer Fehlerpfad Dfp_MSMon_CanDef" VALUE 0xD2776 Kw_Wu8 51000. TimeDsmTsf 0.00 51000. FORMAT "%5.0" /end CHARACTERISTIC
/begin CHARACTERISTIC DSM_TsfDfp_MSMon_CoEng_OffVeh_C "Schwerezaehlergrenze fuer Fehlerpfad Dfp_MSMon_CoEng_OffVeh_C" VALUE 0xD2777 Kw_Wu8 51000. TimeDsmTsf 0.00 51000. FORMAT "%5.0" /end CHARACTERISTIC
/begin CHARACTERISTIC DSM_TsfDfp_MSMon_CoEng_Rev1_C "Schwerezaehlergrenze fuer Fehlerpfad Dfp_MSMon_CoEng_Rev1_C" VALUE 0xD2778 Kw_Wu8 51000. TimeDsmTsf 0.00 51000. FORMAT "%5.0" /end CHARACTERISTIC
/begin CHARACTERISTIC DSM_TsfDfp_MSMon_CoEng_Rev2_C "Schwerezaehlergrenze fuer Fehlerpfad Dfp_MSMon_CoEng_Rev2_C" VALUE 0xD2779 Kw_Wu8 51000. TimeDsmTsf 0.00 51000. FORMAT "%5.0" /end CHARACTERISTIC
/begin CHARACTERISTIC DSM_TsfDfp_MSMon_CoEng_RevMS_C "Schwerezaehlergrenze fuer Fehlerpfad Dfp_MSMon_CoEng_RevMS_C" VALUE 0xD277A Kw_Wu8 51000. TimeDsmTsf 0.00 51000. FORMAT "%5.0" /end CHARACTERISTIC
/begin CHARACTERISTIC DSM_TsfDfp_MSMon_DSC_TO_C "Schwerezaehlergrenze fuer Fehlerpfad Dfp_MSMon_DSC_TO" VALUE 0xD277B Kw_Wu8 51000. TimeDsmTsf 0.00 51000. FORMAT "%5.0" /end CHARACTERISTIC
/begin CHARACTERISTIC DSM_TsfDfp_MSMon_EGS_TO_C "Schwerezaehlergrenze fuer Fehlerpfad Dfp_MSMon_EGS_TO" VALUE 0xD277C Kw_Wu8 51000. TimeDsmTsf 0.00 51000. FORMAT "%5.0" /end CHARACTERISTIC
/begin CHARACTERISTIC DSM_TsfDfp_MSMon_FrmMngCoEng_C "Schwerezaehlergrenze fuer Fehlerpfad Dfp_MSMon_FrmMngCoEng" VALUE 0xD277D Kw_Wu8 51000. TimeDsmTsf 0.00 51000. FORMAT "%5.0" /end CHARACTERISTIC
/begin CHARACTERISTIC DSM_TsfDfp_MSMon_FrmMngPT_C "Schwerezaehlergrenze fuer Fehlerpfad Dfp_MSMon_FrmMngPT_C" VALUE 0xD277E Kw_Wu8 51000. TimeDsmTsf 0.00 51000. FORMAT "%5.0" /end CHARACTERISTIC
/begin CHARACTERISTIC DSM_TsfDfp_MSMon_FrmMngPT2_C "Schwerezaehlergrenze fuer Fehlerpfad Dfp_MSMon_FrmMngPT2" VALUE 0xD277F Kw_Wu8 51000. TimeDsmTsf 0.00 51000. FORMAT "%5.0" /end CHARACTERISTIC
/begin CHARACTERISTIC DSM_TsfDfp_MSMon_Mil_C "Schwerezaehlergrenze fuer Fehlerpfad Dfp_MSMon_Mil_C" VALUE 0xD2780 Kw_Wu8 51000. TimeDsmTsf 0.00 51000. FORMAT "%5.0" /end CHARACTERISTIC
/begin CHARACTERISTIC DSM_TsfDfp_MSMon_NetMngPtCan_C "Schwerezaehlergrenze fuer Fehlerpfad Dfp_MSMon_NetMngPtCan" VALUE 0xD2781 Kw_Wu8 51000. TimeDsmTsf 0.00 51000. FORMAT "%5.0" /end CHARACTERISTIC
/begin CHARACTERISTIC DSM_TsfDfp_MSMon_RailCDPMon_C "Schwerezaehlergrenze fuer Fehlerpfad Dfp_MSMon_RailCDPMon" VALUE 0xD2782 Kw_Wu8 51000. TimeDsmTsf 0.00 51000. FORMAT "%5.0" /end CHARACTERISTIC
/begin CHARACTERISTIC DSM_TsfDfp_MSMon_StEGS_C "Schwerezaehlergrenze fuer Fehlerpfad Dfp_MSMon_StEGS" VALUE 0xD2783 Kw_Wu8 51000. TimeDsmTsf 0.00 51000. FORMAT "%5.0" /end CHARACTERISTIC
/begin CHARACTERISTIC DSM_TsfDfp_MSMon_SysLamp_C "Schwerezaehlergrenze fuer Fehlerpfad Dfp_MSMon_SysLamp_C" VALUE 0xD2784 Kw_Wu8 51000. TimeDsmTsf 0.00 51000. FORMAT "%5.0" /end CHARACTERISTIC
/begin CHARACTERISTIC DSM_TsfDfp_MSMon_ZFCClbActv_C "Schwerezaehlergrenze fuer Fehlerpfad Dfp_MSMon_ZFCClbActv" VALUE 0xD2785 Kw_Wu8 51000. TimeDsmTsf 0.00 51000. FORMAT "%5.0" /end CHARACTERISTIC
/begin CHARACTERISTIC DSM_TsfDfp_MSMon_qLimErr_C "Schwerezaehlergrenze fuer Fehlerpfad Dfp_MSMon_qLimErr_C" VALUE 0xD2786 Kw_Wu8 51000. TimeDsmTsf 0.00 51000. FORMAT "%5.0" /end CHARACTERISTIC
/begin CHARACTERISTIC DSM_TsfDfp_MSMon_trqCoDT_C "Schwerezaehlergrenze fuer Fehlerpfad Dfp_MSMon_trqCoDT_C" VALUE 0xD2787 Kw_Wu8 51000. TimeDsmTsf 0.00 51000. FORMAT "%5.0" /end CHARACTERISTIC
/begin CHARACTERISTIC DSM_TsfDfp_MSMon_trqCoVeh_C "Schwerezaehlergrenze fuer Fehlerpfad Dfp_MSMon_trqCoVeh_C" VALUE 0xD2788 Kw_Wu8 51000. TimeDsmTsf 0.00 51000. FORMAT "%5.0" /end CHARACTERISTIC
/begin CHARACTERISTIC DSM_TsfDfp_MSMon_trqCoVehLim_C "Schwerezaehlergrenze fuer Fehlerpfad Dfp_MSMon_trqCoVehLim_C" VALUE 0xD2789 Kw_Wu8 51000. TimeDsmTsf 0.00 51000. FORMAT "%5.0" /end CHARACTERISTIC
/begin CHARACTERISTIC DSM_TsfDfp_MSMon_trqDesExt_C "Schwerezaehlergrenze fuer Fehlerpfad Dfp_MSMon_trqDesExt_C" VALUE 0xD278A Kw_Wu8 51000. TimeDsmTsf 0.00 51000. FORMAT "%5.0" /end CHARACTERISTIC
/begin CHARACTERISTIC DSM_TsfDfp_MSMon_trqDesExtRev_C "Schwerezaehlergrenze fuer Fehlerpfad Dfp_MSMon_trqDesExtRev_C" VALUE 0xD278B Kw_Wu8 51000. TimeDsmTsf 0.00 51000. FORMAT "%5.0" /end CHARACTERISTIC
/begin CHARACTERISTIC DSM_TsfDfp_MSMon_trqLimErr_C "Schwerezaehlergrenze fuer Fehlerpfad Dfp_MSMon_trqLimErr_C" VALUE 0xD278C Kw_Wu8 51000. TimeDsmTsf 0.00 51000. FORMAT "%5.0" /end CHARACTERISTIC
/begin CHARACTERISTIC DSM_TsfDfp_MSMon_trqLimErr1_C "Schwerezaehlergrenze fuer Fehlerpfad Dfp_MSMon_trqLimErr1_C" VALUE 0xD278D Kw_Wu8 51000. TimeDsmTsf 0.00 51000. FORMAT "%5.0" /end CHARACTERISTIC
/begin CHARACTERISTIC DSM_TsfDfp_MSMon_trqLimErr2_C "Schwerezaehlergrenze fuer Fehlerpfad Dfp_MSMon_trqLimErr2_C" VALUE 0xD278E Kw_Wu8 51000. TimeDsmTsf 0.00 51000. FORMAT "%5.0" /end CHARACTERISTIC
/begin CHARACTERISTIC DSM_TsfDfp_MSMon_trqLimErr3_C "Schwerezaehlergrenze fuer Fehlerpfad Dfp_MSMon_trqLimErr3" VALUE 0xD278F Kw_Wu8 51000. TimeDsmTsf 0.00 51000. FORMAT "%5.0" /end CHARACTERISTIC
/begin CHARACTERISTIC DSM_TsfDfp_MSMon_trqLimErr4_C "Schwerezaehlergrenze fuer Fehlerpfad Dfp_MSMon_trqLimErr4" VALUE 0xD2790 Kw_Wu8 51000. TimeDsmTsf 0.00 51000. FORMAT "%5.0" /end CHARACTERISTIC
/begin CHARACTERISTIC DSM_TsfDfp_MSidCD_Comm_C "Schwerezaehlergrenze fuer Fehlerpfad Dfp_MSidCD_Comm" VALUE 0xD2791 Kw_Wu8 51000. TimeDsmTsf 0.00 51000. FORMAT "%5.0" /end CHARACTERISTIC
/begin CHARACTERISTIC DSM_TsfDfp_MSidCD_EcuMixed_C "Schwerezaehlergrenze fuer Fehlerpfad Dfp_MSidCD_EcuMixed" VALUE 0xD2792 Kw_Wu8 51000. TimeDsmTsf 0.00 51000. FORMAT "%5.0" /end CHARACTERISTIC
/begin CHARACTERISTIC DSM_TsfDfp_MSidCD_Pin_C "Schwerezaehlergrenze fuer Fehlerpfad Dfp_MSidCD_Pin" VALUE 0xD2793 Kw_Wu8 51000. TimeDsmTsf 0.00 51000. FORMAT "%5.0" /end CHARACTERISTIC
/begin CHARACTERISTIC DSM_TsfDfp_MSidCD_Sel_INI_C "Schwerezaehlergrenze fuer Fehlerpfad Dfp_MSidCD_Sel_INI" VALUE 0xD2794 Kw_Wu8 51000. TimeDsmTsf 0.00 51000. FORMAT "%5.0" /end CHARACTERISTIC
/begin CHARACTERISTIC DSM_TsfDfp_MSidCD_Select_C "Schwerezaehlergrenze fuer Fehlerpfad Dfp_MSidCD_Select" VALUE 0xD2795 Kw_Wu8 51000. TimeDsmTsf 0.00 51000. FORMAT "%5.0" /end CHARACTERISTIC
/begin CHARACTERISTIC DSM_TsfDfp_MSid_SwCmp_C "Schwerezaehlergrenze fuer Fehlerpfad Dfp_MSid_SwCmp" VALUE 0xD2796 Kw_Wu8 51000. TimeDsmTsf 0.00 51000. FORMAT "%5.0" /end CHARACTERISTIC
/begin CHARACTERISTIC DSM_TsfDfp_MSid_regEEPDiff_C "Schwerezaehlergrenze fuer Fehlerpfad Dfp_MSid_regEEPDiff" VALUE 0xD2797 Kw_Wu8 51000. TimeDsmTsf 0.00 51000. FORMAT "%5.0" /end CHARACTERISTIC
/begin CHARACTERISTIC DSM_TsfDfp_MeUnCDNoLoad_C "Schwerezaehlergrenze fuer Fehlerpfad Dfp_MeUnCDNoLoad" VALUE 0xD2798 Kw_Wu8 51000. TimeDsmTsf 0.00 51000. FORMAT "%5.0" /end CHARACTERISTIC
/begin CHARACTERISTIC DSM_TsfDfp_MeUnCDSCBat_C "Schwerezaehlergrenze fuer Fehlerpfad Dfp_MeUnCDSCBat" VALUE 0xD2799 Kw_Wu8 51000. TimeDsmTsf 0.00 51000. FORMAT "%5.0" /end CHARACTERISTIC
/begin CHARACTERISTIC DSM_TsfDfp_MeUnCDSCGnd_C "Schwerezaehlergrenze fuer Fehlerpfad Dfp_MeUnCDSCGnd" VALUE 0xD279A Kw_Wu8 51000. TimeDsmTsf 0.00 51000. FORMAT "%5.0" /end CHARACTERISTIC
/begin CHARACTERISTIC DSM_TsfDfp_MeUnCD_ADC_C "Schwerezaehlergrenze fuer Fehlerpfad Dfp_MeUnCD_ADC" VALUE 0xD279B Kw_Wu8 51000. TimeDsmTsf 0.00 51000. FORMAT "%5.0" /end CHARACTERISTIC
/begin CHARACTERISTIC DSM_TsfDfp_MeUnCD_SigTst_C "Schwerezaehlergrenze fuer Fehlerpfad Dfp_MeUnCD_SigTst" VALUE 0xD279C Kw_Wu8 51000. TimeDsmTsf 0.00 51000. FORMAT "%5.0" /end CHARACTERISTIC
/begin CHARACTERISTIC DSM_TsfDfp_Montr_C "Schwerezaehlergrenze fuer Fehlerpfad Dfp_Montr" VALUE 0xD279D Kw_Wu8 51000. TimeDsmTsf 0.00 51000. FORMAT "%5.0" /end CHARACTERISTIC
/begin CHARACTERISTIC DSM_TsfDfp_NetMngDeviceA_C "Schwerezaehlergrenze fuer Fehlerpfad Dfp_NetMngDeviceA" VALUE 0xD279E Kw_Wu8 51000. TimeDsmTsf 0.00 51000. FORMAT "%5.0" /end CHARACTERISTIC
/begin CHARACTERISTIC DSM_TsfDfp_NetMngDeviceB_C "Schwerezaehlergrenze fuer Fehlerpfad Dfp_NetMngDeviceB" VALUE 0xD279F Kw_Wu8 51000. TimeDsmTsf 0.00 51000. FORMAT "%5.0" /end CHARACTERISTIC
/begin CHARACTERISTIC DSM_TsfDfp_NetMngDeviceC_C "Schwerezaehlergrenze fuer Fehlerpfad Dfp_NetMngDeviceC" VALUE 0xD27A0 Kw_Wu8 51000. TimeDsmTsf 0.00 51000. FORMAT "%5.0" /end CHARACTERISTIC
/begin CHARACTERISTIC DSM_TsfDfp_NetMngPrvCan_C "Schwerezaehlergrenze fuer Fehlerpfad Dfp_NetMngPrvCan" VALUE 0xD27A1 Kw_Wu8 51000. TimeDsmTsf 0.00 51000. FORMAT "%5.0" /end CHARACTERISTIC
/begin CHARACTERISTIC DSM_TsfDfp_NetMngPrvCanSlave_C "Schwerezaehlergrenze fuer Fehlerpfad Dfp_NetMngPrvCanSlave" VALUE 0xD27A2 Kw_Wu8 51000. TimeDsmTsf 0.00 51000. FORMAT "%5.0" /end CHARACTERISTIC
/begin CHARACTERISTIC DSM_TsfDfp_NetMngPtCan_C "Schwerezaehlergrenze fuer Fehlerpfad Dfp_NetMngPtCan" VALUE 0xD27A3 Kw_Wu8 51000. TimeDsmTsf 0.00 51000. FORMAT "%5.0" /end CHARACTERISTIC
/begin CHARACTERISTIC DSM_TsfDfp_NetMngPtCanSlave_C "Schwerezaehlergrenze fuer Fehlerpfad Dfp_NetMngPtCanSlave" VALUE 0xD27A4 Kw_Wu8 51000. TimeDsmTsf 0.00 51000. FORMAT "%5.0" /end CHARACTERISTIC
/begin CHARACTERISTIC DSM_TsfDfp_OPSCD_Lamp_C "Schwerezaehlergrenze fuer Fehlerpfad Dfp_OPSCD_Lamp" VALUE 0xD27A5 Kw_Wu8 51000. TimeDsmTsf 0.00 51000. FORMAT "%5.0" /end CHARACTERISTIC
/begin CHARACTERISTIC DSM_TsfDfp_OPSCD_anain_C "Schwerezaehlergrenze fuer Fehlerpfad Dfp_OPSCD_anain" VALUE 0xD27A6 Kw_Wu8 51000. TimeDsmTsf 0.00 51000. FORMAT "%5.0" /end CHARACTERISTIC
/begin CHARACTERISTIC DSM_TsfDfp_OTSCD_C "Schwerezaehlergrenze fuer Fehlerpfad Dfp_OTSCD" VALUE 0xD27A7 Kw_Wu8 51000. TimeDsmTsf 0.00 51000. FORMAT "%5.0" /end CHARACTERISTIC
/begin CHARACTERISTIC DSM_TsfDfp_OvRMon_C "Schwerezaehlergrenze fuer Fehlerpfad Dfp_OvRMon" VALUE 0xD27A8 Kw_Wu8 51000. TimeDsmTsf 0.00 51000. FORMAT "%5.0" /end CHARACTERISTIC
/begin CHARACTERISTIC DSM_TsfDfp_OvRMonSigA_C "Schwerezaehlergrenze fuer Fehlerpfad Dfp_OvRMonSigA" VALUE 0xD27A9 Kw_Wu8 51000. TimeDsmTsf 0.00 51000. FORMAT "%5.0" /end CHARACTERISTIC
/begin CHARACTERISTIC DSM_TsfDfp_OxiCCDTPreB1_C "Schwerezaehlergrenze fuer Fehlerpfad Dfp_OxiCCDTPreB1" VALUE 0xD27AA Kw_Wu8 51000. TimeDsmTsf 0.00 51000. FORMAT "%5.0" /end CHARACTERISTIC
/begin CHARACTERISTIC DSM_TsfDfp_OxiCCDTPreB2_C "Schwerezaehlergrenze fuer Fehlerpfad Dfp_OxiCCDTPreB2" VALUE 0xD27AB Kw_Wu8 51000. TimeDsmTsf 0.00 51000. FORMAT "%5.0" /end CHARACTERISTIC
/begin CHARACTERISTIC DSM_TsfDfp_PCBS_C "Schwerezaehlergrenze fuer Fehlerpfad Dfp_PCBS" VALUE 0xD27AC Kw_Wu8 51000. TimeDsmTsf 0.00 51000. FORMAT "%5.0" /end CHARACTERISTIC
/begin CHARACTERISTIC DSM_TsfDfp_PCR_BalGvnr_C "Schwerezaehlergrenze fuer Fehlerpfad Dfp_PCR_BalGvnr" VALUE 0xD27AD Kw_Wu8 51000. TimeDsmTsf 0.00 51000. FORMAT "%5.0" /end CHARACTERISTIC
/begin CHARACTERISTIC DSM_TsfDfp_PCR_GovDevNeg_C "Schwerezaehlergrenze fuer Fehlerpfad Dfp_PCR_GovDevNeg" VALUE 0xD27AE Kw_Wu8 51000. TimeDsmTsf 0.00 51000. FORMAT "%5.0" /end CHARACTERISTIC
/begin CHARACTERISTIC DSM_TsfDfp_PCR_GovDevPos_C "Schwerezaehlergrenze fuer Fehlerpfad Dfp_PCR_GovDevPos" VALUE 0xD27AF Kw_Wu8 51000. TimeDsmTsf 0.00 51000. FORMAT "%5.0" /end CHARACTERISTIC
/begin CHARACTERISTIC DSM_TsfDfp_PCR_LPGvnrDvtNeg_C "Schwerezaehlergrenze fuer Fehlerpfad Dfp_PCR_LPGvnrDvtNeg" VALUE 0xD27B0 Kw_Wu8 51000. TimeDsmTsf 0.00 51000. FORMAT "%5.0" /end CHARACTERISTIC
/begin CHARACTERISTIC DSM_TsfDfp_PCR_LPGvnrDvtPos_C "Schwerezaehlergrenze fuer Fehlerpfad Dfp_PCR_LPGvnrDvtPos" VALUE 0xD27B1 Kw_Wu8 51000. TimeDsmTsf 0.00 51000. FORMAT "%5.0" /end CHARACTERISTIC
/begin CHARACTERISTIC DSM_TsfDfp_PCVCDNoLoad_C "Schwerezaehlergrenze fuer Fehlerpfad Dfp_PCVCDNoLoad" VALUE 0xD27B2 Kw_Wu8 51000. TimeDsmTsf 0.00 51000. FORMAT "%5.0" /end CHARACTERISTIC
/begin CHARACTERISTIC DSM_TsfDfp_PCVCDSCBat_C "Schwerezaehlergrenze fuer Fehlerpfad Dfp_PCVCDSCBat" VALUE 0xD27B3 Kw_Wu8 51000. TimeDsmTsf 0.00 51000. FORMAT "%5.0" /end CHARACTERISTIC
/begin CHARACTERISTIC DSM_TsfDfp_PCVCDSCGnd_C "Schwerezaehlergrenze fuer Fehlerpfad Dfp_PCVCDSCGnd" VALUE 0xD27B4 Kw_Wu8 51000. TimeDsmTsf 0.00 51000. FORMAT "%5.0" /end CHARACTERISTIC
/begin CHARACTERISTIC DSM_TsfDfp_PCVCD_ADC_C "Schwerezaehlergrenze fuer Fehlerpfad Dfp_PCVCD_ADC" VALUE 0xD27B5 Kw_Wu8 51000. TimeDsmTsf 0.00 51000. FORMAT "%5.0" /end CHARACTERISTIC
/begin CHARACTERISTIC DSM_TsfDfp_PCVCD_SigTst_C "Schwerezaehlergrenze fuer Fehlerpfad Dfp_PCVCD_SigTst" VALUE 0xD27B6 Kw_Wu8 51000. TimeDsmTsf 0.00 51000. FORMAT "%5.0" /end CHARACTERISTIC
/begin CHARACTERISTIC DSM_TsfDfp_PFltAPSPlaus_C "Schwerezaehlergrenze fuer Fehlerpfad Dfp_PFltAPSPlaus" VALUE 0xD27B7 Kw_Wu8 51000. TimeDsmTsf 0.00 51000. FORMAT "%5.0" /end CHARACTERISTIC
/begin CHARACTERISTIC DSM_TsfDfp_PFltAPSensB1_C "Schwerezaehlergrenze fuer Fehlerpfad Dfp_PFltAPSensB1" VALUE 0xD27B8 Kw_Wu8 51000. TimeDsmTsf 0.00 51000. FORMAT "%5.0" /end CHARACTERISTIC
/begin CHARACTERISTIC DSM_TsfDfp_PFltAPSensB2_C "Schwerezaehlergrenze fuer Fehlerpfad Dfp_PFltAPSensB2" VALUE 0xD27B9 Kw_Wu8 51000. TimeDsmTsf 0.00 51000. FORMAT "%5.0" /end CHARACTERISTIC
/begin CHARACTERISTIC DSM_TsfDfp_PFltBPSPlaus_C "Schwerezaehlergrenze fuer Fehlerpfad Dfp_PFltBPSPlaus" VALUE 0xD27BA Kw_Wu8 51000. TimeDsmTsf 0.00 51000. FORMAT "%5.0" /end CHARACTERISTIC
/begin CHARACTERISTIC DSM_TsfDfp_PFltCDPPreB1_C "Schwerezaehlergrenze fuer Fehlerpfad Dfp_PFltCDPPreB1" VALUE 0xD27BB Kw_Wu8 51000. TimeDsmTsf 0.00 51000. FORMAT "%5.0" /end CHARACTERISTIC
/begin CHARACTERISTIC DSM_TsfDfp_PFltCDPPreB2_C "Schwerezaehlergrenze fuer Fehlerpfad Dfp_PFltCDPPreB2" VALUE 0xD27BC Kw_Wu8 51000. TimeDsmTsf 0.00 51000. FORMAT "%5.0" /end CHARACTERISTIC
/begin CHARACTERISTIC DSM_TsfDfp_PFltCDTPreB1_C "Schwerezaehlergrenze fuer Fehlerpfad Dfp_PFltCDTPreB1" VALUE 0xD27BD Kw_Wu8 51000. TimeDsmTsf 0.00 51000. FORMAT "%5.0" /end CHARACTERISTIC
/begin CHARACTERISTIC DSM_TsfDfp_PFltCDTPreB2_C "Schwerezaehlergrenze fuer Fehlerpfad Dfp_PFltCDTPreB2" VALUE 0xD27BE Kw_Wu8 51000. TimeDsmTsf 0.00 51000. FORMAT "%5.0" /end CHARACTERISTIC
/begin CHARACTERISTIC DSM_TsfDfp_PFltCharB1_C "Schwerezaehlergrenze fuer Fehlerpfad Dfp_PFltCharB1" VALUE 0xD27BF Kw_Wu8 51000. TimeDsmTsf 0.00 51000. FORMAT "%5.0" /end CHARACTERISTIC
/begin CHARACTERISTIC DSM_TsfDfp_PFltCharB2_C "Schwerezaehlergrenze fuer Fehlerpfad Dfp_PFltCharB2" VALUE 0xD27C0 Kw_Wu8 51000. TimeDsmTsf 0.00 51000. FORMAT "%5.0" /end CHARACTERISTIC
/begin CHARACTERISTIC DSM_TsfDfp_PFltDltOxiPreTwFlw_C "Temperaturabweichungsfehlerpfad vor Oxi Cat Behandlung" VALUE 0xD27C1 Kw_Wu8 51000. TimeDsmTsf 0.00 51000. FORMAT "%5.0" /end CHARACTERISTIC
/begin CHARACTERISTIC DSM_TsfDfp_PFltDltPreTwFlw_C "Temperaturabweichungsfehlerpfad vor DPF - Behandlung" VALUE 0xD27C2 Kw_Wu8 51000. TimeDsmTsf 0.00 51000. FORMAT "%5.0" /end CHARACTERISTIC
/begin CHARACTERISTIC DSM_TsfDfp_PFltEngPrtB1_C "Schwerezaehlergrenze fuer Fehlerpfad Dfp_PFltEngPrtB1" VALUE 0xD27C3 Kw_Wu8 51000. TimeDsmTsf 0.00 51000. FORMAT "%5.0" /end CHARACTERISTIC
/begin CHARACTERISTIC DSM_TsfDfp_PFltEngPrtB2_C "Schwerezaehlergrenze fuer Fehlerpfad Dfp_PFltEngPrtB2" VALUE 0xD27C4 Kw_Wu8 51000. TimeDsmTsf 0.00 51000. FORMAT "%5.0" /end CHARACTERISTIC
/begin CHARACTERISTIC DSM_TsfDfp_PFltOvldInhRgnB1_C "Schwerezaehlergrenze fuer Fehlerpfad Dfp_PFltOvldInhRgnB1" VALUE 0xD27C5 Kw_Wu8 51000. TimeDsmTsf 0.00 51000. FORMAT "%5.0" /end CHARACTERISTIC
/begin CHARACTERISTIC DSM_TsfDfp_PFltOvldInhRgnB2_C "Schwerezaehlergrenze fuer Fehlerpfad Dfp_PFltOvldInhRgnB2" VALUE 0xD27C6 Kw_Wu8 51000. TimeDsmTsf 0.00 51000. FORMAT "%5.0" /end CHARACTERISTIC
/begin CHARACTERISTIC DSM_TsfDfp_PFltOvldTrqLimB1_C "Schwerezaehlergrenze fuer Fehlerpfad Dfp_PFltOvldTrqLimB1" VALUE 0xD27C7 Kw_Wu8 51000. TimeDsmTsf 0.00 51000. FORMAT "%5.0" /end CHARACTERISTIC
/begin CHARACTERISTIC DSM_TsfDfp_PFltOvldTrqLimB2_C "Schwerezaehlergrenze fuer Fehlerpfad Dfp_PFltOvldTrqLimB2" VALUE 0xD27C8 Kw_Wu8 51000. TimeDsmTsf 0.00 51000. FORMAT "%5.0" /end CHARACTERISTIC
/begin CHARACTERISTIC DSM_TsfDfp_PFltPresDynPlausB1_C "Schwerezaehlergrenze fuer Fehlerpfad Dfp_PFltPresDynPlausB1" VALUE 0xD27C9 Kw_Wu8 51000. TimeDsmTsf 0.00 51000. FORMAT "%5.0" /end CHARACTERISTIC
/begin CHARACTERISTIC DSM_TsfDfp_PFltPresDynPlausB2_C "Schwerezaehlergrenze fuer Fehlerpfad Dfp_PFltPresDynPlausB2" VALUE 0xD27CA Kw_Wu8 51000. TimeDsmTsf 0.00 51000. FORMAT "%5.0" /end CHARACTERISTIC
/begin CHARACTERISTIC DSM_TsfDfp_PFltPresPlausB1_C "Schwerezaehlergrenze fuer Fehlerpfad Dfp_PFltPresPlausB1" VALUE 0xD27CB Kw_Wu8 51000. TimeDsmTsf 0.00 51000. FORMAT "%5.0" /end CHARACTERISTIC
/begin CHARACTERISTIC DSM_TsfDfp_PFltPresPlausB2_C "Schwerezaehlergrenze fuer Fehlerpfad Dfp_PFltPresPlausB2" VALUE 0xD27CC Kw_Wu8 51000. TimeDsmTsf 0.00 51000. FORMAT "%5.0" /end CHARACTERISTIC
/begin CHARACTERISTIC DSM_TsfDfp_PFltPresSensB1_C "Schwerezaehlergrenze fuer Fehlerpfad Dfp_PFltPresSensB1" VALUE 0xD27CD Kw_Wu8 51000. TimeDsmTsf 0.00 51000. FORMAT "%5.0" /end CHARACTERISTIC
/begin CHARACTERISTIC DSM_TsfDfp_PFltPresSensB2_C "Schwerezaehlergrenze fuer Fehlerpfad Dfp_PFltPresSensB2" VALUE 0xD27CE Kw_Wu8 51000. TimeDsmTsf 0.00 51000. FORMAT "%5.0" /end CHARACTERISTIC
/begin CHARACTERISTIC DSM_TsfDfp_PFltPresSensFrz_C "Schwerezaehlergrenze fuer Fehlerpfad Dfp_PFltPresSensFrz" VALUE 0xD27CF Kw_Wu8 51000. TimeDsmTsf 0.00 51000. FORMAT "%5.0" /end CHARACTERISTIC
/begin CHARACTERISTIC DSM_TsfDfp_PFltPresSensHsLnB1_C "Schwerezaehlergrenze fuer Fehlerpfad Dfp_PFltPresSensHsLnB1" VALUE 0xD27D0 Kw_Wu8 51000. TimeDsmTsf 0.00 51000. FORMAT "%5.0" /end CHARACTERISTIC
/begin CHARACTERISTIC DSM_TsfDfp_PFltPresSensHsLnB2_C "Schwerezaehlergrenze fuer Fehlerpfad Dfp_PFltPresSensHsLnB2" VALUE 0xD27D1 Kw_Wu8 51000. TimeDsmTsf 0.00 51000. FORMAT "%5.0" /end CHARACTERISTIC
/begin CHARACTERISTIC DSM_TsfDfp_PFltPresSensSotB1_C "Schwerezaehlergrenze fuer Fehlerpfad Dfp_PFltPresSensSotB1" VALUE 0xD27D2 Kw_Wu8 51000. TimeDsmTsf 0.00 51000. FORMAT "%5.0" /end CHARACTERISTIC
/begin CHARACTERISTIC DSM_TsfDfp_PFltPresSensSotB2_C "Schwerezaehlergrenze fuer Fehlerpfad Dfp_PFltPresSensSotB2" VALUE 0xD27D3 Kw_Wu8 51000. TimeDsmTsf 0.00 51000. FORMAT "%5.0" /end CHARACTERISTIC
/begin CHARACTERISTIC DSM_TsfDfp_PFltRgnPerm_C "Schwerezaehlergrenze fuer Fehlerpfad Dfp_PFltRgnPerm" VALUE 0xD27D4 Kw_Wu8 51000. TimeDsmTsf 0.00 51000. FORMAT "%5.0" /end CHARACTERISTIC
/begin CHARACTERISTIC DSM_TsfDfp_PFltTempDwnStrmB1_C "Schwerezaehlergrenze fuer Fehlerpfad Dfp_PFltTempDwnStrmB1" VALUE 0xD27D5 Kw_Wu8 51000. TimeDsmTsf 0.00 51000. FORMAT "%5.0" /end CHARACTERISTIC
/begin CHARACTERISTIC DSM_TsfDfp_PFltTempDwnStrmB2_C "Schwerezaehlergrenze fuer Fehlerpfad Dfp_PFltTempDwnStrmB2" VALUE 0xD27D6 Kw_Wu8 51000. TimeDsmTsf 0.00 51000. FORMAT "%5.0" /end CHARACTERISTIC
/begin CHARACTERISTIC DSM_TsfDfp_PFltTempSensB1_C "Schwerezaehlergrenze fuer Fehlerpfad Dfp_PFltTempSensB1" VALUE 0xD27D7 Kw_Wu8 51000. TimeDsmTsf 0.00 51000. FORMAT "%5.0" /end CHARACTERISTIC
/begin CHARACTERISTIC DSM_TsfDfp_PFltTempSensB2_C "Schwerezaehlergrenze fuer Fehlerpfad Dfp_PFltTempSensB2" VALUE 0xD27D8 Kw_Wu8 51000. TimeDsmTsf 0.00 51000. FORMAT "%5.0" /end CHARACTERISTIC
/begin CHARACTERISTIC DSM_TsfDfp_PFltTempUpStrmB1_C "Schwerezaehlergrenze fuer Fehlerpfad Dfp_PFltTempUpStrmB1" VALUE 0xD27D9 Kw_Wu8 51000. TimeDsmTsf 0.00 51000. FORMAT "%5.0" /end CHARACTERISTIC
/begin CHARACTERISTIC DSM_TsfDfp_PFltTempUpStrmB2_C "Schwerezaehlergrenze fuer Fehlerpfad Dfp_PFltTempUpStrmB2" VALUE 0xD27DA Kw_Wu8 51000. TimeDsmTsf 0.00 51000. FORMAT "%5.0" /end CHARACTERISTIC
/begin CHARACTERISTIC DSM_TsfDfp_PFlt_tOxiPreMaxB1_C "Schwerezaehlergrenze fuer Fehlerpfad Dfp_PFlt_tOxiPreMaxB1" VALUE 0xD27DB Kw_Wu8 51000. TimeDsmTsf 0.00 51000. FORMAT "%5.0" /end CHARACTERISTIC
/begin CHARACTERISTIC DSM_TsfDfp_PFlt_tOxiPreMaxB2_C "Schwerezaehlergrenze fuer Fehlerpfad Dfp_PFlt_tOxiPreMaxB2" VALUE 0xD27DC Kw_Wu8 51000. TimeDsmTsf 0.00 51000. FORMAT "%5.0" /end CHARACTERISTIC
/begin CHARACTERISTIC DSM_TsfDfp_PFlt_tOxiPreMxRgnB1_C "Schwerezaehlergrenze fuer Fehlerpfad Dfp_PFlt_tOxiPreMxRgnB1" VALUE 0xD27DD Kw_Wu8 51000. TimeDsmTsf 0.00 51000. FORMAT "%5.0" /end CHARACTERISTIC
/begin CHARACTERISTIC DSM_TsfDfp_PFlt_tOxiPreMxRgnB2_C "Schwerezaehlergrenze fuer Fehlerpfad Dfp_PFlt_tOxiPreMxRgnB2" VALUE 0xD27DE Kw_Wu8 51000. TimeDsmTsf 0.00 51000. FORMAT "%5.0" /end CHARACTERISTIC
/begin CHARACTERISTIC DSM_TsfDfp_PFlt_tPreMaxB1_C "Schwerezaehlergrenze fuer Fehlerpfad Dfp_PFlt_tPreMaxB1" VALUE 0xD27DF Kw_Wu8 51000. TimeDsmTsf 0.00 51000. FORMAT "%5.0" /end CHARACTERISTIC
/begin CHARACTERISTIC DSM_TsfDfp_PFlt_tPreMaxB2_C "Schwerezaehlergrenze fuer Fehlerpfad Dfp_PFlt_tPreMaxB2" VALUE 0xD27E0 Kw_Wu8 51000. TimeDsmTsf 0.00 51000. FORMAT "%5.0" /end CHARACTERISTIC
/begin CHARACTERISTIC DSM_TsfDfp_PFlt_tPreMaxRgnB1_C "Schwerezaehlergrenze fuer Fehlerpfad Dfp_PFlt_tPreMaxRgnB1" VALUE 0xD27E1 Kw_Wu8 51000. TimeDsmTsf 0.00 51000. FORMAT "%5.0" /end CHARACTERISTIC
/begin CHARACTERISTIC DSM_TsfDfp_PFlt_tPreMaxRgnB2_C "Schwerezaehlergrenze fuer Fehlerpfad Dfp_PFlt_tPreMaxRgnB2" VALUE 0xD27E2 Kw_Wu8 51000. TimeDsmTsf 0.00 51000. FORMAT "%5.0" /end CHARACTERISTIC
/begin CHARACTERISTIC DSM_TsfDfp_PFltmSotDiffMaxB1_C "Schwerezaehlergrenze fuer Fehlerpfad Dfp_PFltmSotDiffMaxB1" VALUE 0xD27E3 Kw_Wu8 51000. TimeDsmTsf 0.00 51000. FORMAT "%5.0" /end CHARACTERISTIC
/begin CHARACTERISTIC DSM_TsfDfp_PFltmSotDiffMaxB2_C "Schwerezaehlergrenze fuer Fehlerpfad Dfp_PFltmSotDiffMaxB2" VALUE 0xD27E4 Kw_Wu8 51000. TimeDsmTsf 0.00 51000. FORMAT "%5.0" /end CHARACTERISTIC
/begin CHARACTERISTIC DSM_TsfDfp_PresPlausDblDef_C "Schwerezaehlergrenze fuer Fehlerpfad Dfp_PresPlausDblDef" VALUE 0xD27E5 Kw_Wu8 51000. TimeDsmTsf 0.00 51000. FORMAT "%5.0" /end CHARACTERISTIC
/begin CHARACTERISTIC DSM_TsfDfp_QLTCD_C "Schwerezaehlergrenze fuer Fehlerpfad Dfp_QLTCD" VALUE 0xD27E6 Kw_Wu8 51000. TimeDsmTsf 0.00 51000. FORMAT "%5.0" /end CHARACTERISTIC
/begin CHARACTERISTIC DSM_TsfDfp_RailCD_C "Schwerezaehlergrenze fuer Fehlerpfad Dfp_RailCD" VALUE 0xD27E7 Kw_Wu8 51000. TimeDsmTsf 0.00 51000. FORMAT "%5.0" /end CHARACTERISTIC
/begin CHARACTERISTIC DSM_TsfDfp_RailCDOfsTst_C "Schwerezaehlergrenze fuer Fehlerpfad Dfp_RailCDOfsTst" VALUE 0xD27E8 Kw_Wu8 51000. TimeDsmTsf 0.00 51000. FORMAT "%5.0" /end CHARACTERISTIC
/begin CHARACTERISTIC DSM_TsfDfp_RailCD_PMonStrt_C "Schwerezaehlergrenze fuer Fehlerpfad Dfp_RailCD_PMonStrt" VALUE 0xD27E9 Kw_Wu8 51000. TimeDsmTsf 0.00 51000. FORMAT "%5.0" /end CHARACTERISTIC
/begin CHARACTERISTIC DSM_TsfDfp_RailCPC1_C "Schwerezaehlergrenze fuer Fehlerpfad Dfp_RailCPC1" VALUE 0xD27EA Kw_Wu8 51000. TimeDsmTsf 0.00 51000. FORMAT "%5.0" /end CHARACTERISTIC
/begin CHARACTERISTIC DSM_TsfDfp_RailCPC3_C "Schwerezaehlergrenze fuer Fehlerpfad Dfp_RailCPC3" VALUE 0xD27EB Kw_Wu8 51000. TimeDsmTsf 0.00 51000. FORMAT "%5.0" /end CHARACTERISTIC
/begin CHARACTERISTIC DSM_TsfDfp_RailCPC4_C "Schwerezaehlergrenze fuer Fehlerpfad Dfp_RailCPC4" VALUE 0xD27EC Kw_Wu8 51000. TimeDsmTsf 0.00 51000. FORMAT "%5.0" /end CHARACTERISTIC
/begin CHARACTERISTIC DSM_TsfDfp_RailCtlModeMeUnDiag_C "Schwerezaehlergrenze fuer Fehlerpfad Dfp_RailCtlModeMeUnDiag" VALUE 0xD27ED Kw_Wu8 51000. TimeDsmTsf 0.00 51000. FORMAT "%5.0" /end CHARACTERISTIC
/begin CHARACTERISTIC DSM_TsfDfp_RailCtlModePCVDiag_C "Schwerezaehlergrenze fuer Fehlerpfad Dfp_RailCtlModePCVDiag" VALUE 0xD27EE Kw_Wu8 51000. TimeDsmTsf 0.00 51000. FORMAT "%5.0" /end CHARACTERISTIC
/begin CHARACTERISTIC DSM_TsfDfp_RailMeUn0_C "Schwerezaehlergrenze fuer Fehlerpfad Dfp_RailMeUn0" VALUE 0xD27EF Kw_Wu8 51000. TimeDsmTsf 0.00 51000. FORMAT "%5.0" /end CHARACTERISTIC
/begin CHARACTERISTIC DSM_TsfDfp_RailMeUn1_C "Schwerezaehlergrenze fuer Fehlerpfad Dfp_RailMeUn1" VALUE 0xD27F0 Kw_Wu8 51000. TimeDsmTsf 0.00 51000. FORMAT "%5.0" /end CHARACTERISTIC
/begin CHARACTERISTIC DSM_TsfDfp_RailMeUn2_C "Schwerezaehlergrenze fuer Fehlerpfad Dfp_RailMeUn2" VALUE 0xD27F1 Kw_Wu8 51000. TimeDsmTsf 0.00 51000. FORMAT "%5.0" /end CHARACTERISTIC
/begin CHARACTERISTIC DSM_TsfDfp_RailMeUn3_C "Schwerezaehlergrenze fuer Fehlerpfad Dfp_RailMeUn3" VALUE 0xD27F2 Kw_Wu8 51000. TimeDsmTsf 0.00 51000. FORMAT "%5.0" /end CHARACTERISTIC
/begin CHARACTERISTIC DSM_TsfDfp_RailMeUn4_C "Schwerezaehlergrenze fuer Fehlerpfad Dfp_RailMeUn4" VALUE 0xD27F3 Kw_Wu8 51000. TimeDsmTsf 0.00 51000. FORMAT "%5.0" /end CHARACTERISTIC
/begin CHARACTERISTIC DSM_TsfDfp_RailPCV0_C "Schwerezaehlergrenze fuer Fehlerpfad Dfp_RailPCV0" VALUE 0xD27F4 Kw_Wu8 51000. TimeDsmTsf 0.00 51000. FORMAT "%5.0" /end CHARACTERISTIC
/begin CHARACTERISTIC DSM_TsfDfp_RailPCV1_C "Schwerezaehlergrenze fuer Fehlerpfad Dfp_RailPCV1" VALUE 0xD27F5 Kw_Wu8 51000. TimeDsmTsf 0.00 51000. FORMAT "%5.0" /end CHARACTERISTIC
/begin CHARACTERISTIC DSM_TsfDfp_RailPCV2_C "Schwerezaehlergrenze fuer Fehlerpfad Dfp_RailPCV2" VALUE 0xD27F6 Kw_Wu8 51000. TimeDsmTsf 0.00 51000. FORMAT "%5.0" /end CHARACTERISTIC
/begin CHARACTERISTIC DSM_TsfDfp_RailPCV3_C "Schwerezaehlergrenze fuer Fehlerpfad Dfp_RailPCV3" VALUE 0xD27F7 Kw_Wu8 51000. TimeDsmTsf 0.00 51000. FORMAT "%5.0" /end CHARACTERISTIC
/begin CHARACTERISTIC DSM_TsfDfp_RailPCV4_C "Schwerezaehlergrenze fuer Fehlerpfad Dfp_RailPCV4" VALUE 0xD27F8 Kw_Wu8 51000. TimeDsmTsf 0.00 51000. FORMAT "%5.0" /end CHARACTERISTIC
/begin CHARACTERISTIC DSM_TsfDfp_RailPCV5_C "Schwerezaehlergrenze fuer Fehlerpfad Dfp_RailPCV5" VALUE 0xD27F9 Kw_Wu8 51000. TimeDsmTsf 0.00 51000. FORMAT "%5.0" /end CHARACTERISTIC
/begin CHARACTERISTIC DSM_TsfDfp_SOPTst_C "Schwerezaehlergrenze fuer Fehlerpfad Dfp_SOPTst" VALUE 0xD27FA Kw_Wu8 51000. TimeDsmTsf 0.00 51000. FORMAT "%5.0" /end CHARACTERISTIC
/begin CHARACTERISTIC DSM_TsfDfp_SSpMon1_C "Schwerezaehlergrenze fuer Fehlerpfad Dfp_SSpMon1" VALUE 0xD27FB Kw_Wu8 51000. TimeDsmTsf 0.00 51000. FORMAT "%5.0" /end CHARACTERISTIC
/begin CHARACTERISTIC DSM_TsfDfp_SSpMon2_C "Schwerezaehlergrenze fuer Fehlerpfad Dfp_SSpMon2" VALUE 0xD27FC Kw_Wu8 51000. TimeDsmTsf 0.00 51000. FORMAT "%5.0" /end CHARACTERISTIC
/begin CHARACTERISTIC DSM_TsfDfp_SSpMon3_C "Schwerezaehlergrenze fuer Fehlerpfad Dfp_SSpMon3" VALUE 0xD27FD Kw_Wu8 51000. TimeDsmTsf 0.00 51000. FORMAT "%5.0" /end CHARACTERISTIC
/begin CHARACTERISTIC DSM_TsfDfp_SSpMon4_C "Schwerezaehlergrenze fuer Fehlerpfad Dfp_SSpMon4" VALUE 0xD27FE Kw_Wu8 51000. TimeDsmTsf 0.00 51000. FORMAT "%5.0" /end CHARACTERISTIC
/begin CHARACTERISTIC DSM_TsfDfp_SSpMon5_C "Schwerezaehlergrenze fuer Fehlerpfad Dfp_SSpMon5" VALUE 0xD27FF Kw_Wu8 51000. TimeDsmTsf 0.00 51000. FORMAT "%5.0" /end CHARACTERISTIC
/begin CHARACTERISTIC DSM_TsfDfp_SSpMon6_C "Schwerezaehlergrenze fuer Fehlerpfad Dfp_SSpMon6" VALUE 0xD2800 Kw_Wu8 51000. TimeDsmTsf 0.00 51000. FORMAT "%5.0" /end CHARACTERISTIC
/begin CHARACTERISTIC DSM_TsfDfp_SWChk_CycSigChkDat_C "Schwerezaehlergrenze fuer Fehlerpfad Dfp_SWChk_CycSigChkDat" VALUE 0xD2801 Kw_Wu8 51000. TimeDsmTsf 0.00 51000. FORMAT "%5.0" /end CHARACTERISTIC
/begin CHARACTERISTIC DSM_TsfDfp_SWChk_CycSigChkPrg_C "Schwerezaehlergrenze fuer Fehlerpfad Dfp_SWChk_CycSigChkPrg" VALUE 0xD2802 Kw_Wu8 51000. TimeDsmTsf 0.00 51000. FORMAT "%5.0" /end CHARACTERISTIC
/begin CHARACTERISTIC DSM_TsfDfp_StSysTrqShutOff_C "Schwerezaehlergrenze fuer Fehlerpfad Dfp_StSysTrqShutOff" VALUE 0xD2803 Kw_Wu8 51000. TimeDsmTsf 0.00 51000. FORMAT "%5.0" /end CHARACTERISTIC
/begin CHARACTERISTIC DSM_TsfDfp_StrtCD_Actr_C "Schwerezaehlergrenze fuer Fehlerpfad Dfp_StrtCD_Actr" VALUE 0xD2804 Kw_Wu8 51000. TimeDsmTsf 0.00 51000. FORMAT "%5.0" /end CHARACTERISTIC
/begin CHARACTERISTIC DSM_TsfDfp_SysLamp_C "Schwerezaehlergrenze fuer Fehlerpfad Dfp_SysLamp" VALUE 0xD2805 Kw_Wu8 51000. TimeDsmTsf 0.00 51000. FORMAT "%5.0" /end CHARACTERISTIC
/begin CHARACTERISTIC DSM_TsfDfp_T15CD_C "Schwerezaehlergrenze fuer Fehlerpfad Dfp_T15CD" VALUE 0xD2806 Kw_Wu8 51000. TimeDsmTsf 0.00 51000. FORMAT "%5.0" /end CHARACTERISTIC
/begin CHARACTERISTIC DSM_TsfDfp_TGearbx_C "Schwerezaehlergrenze fuer Fehlerpfad Dfp_TGearbx" VALUE 0xD2807 Kw_Wu8 51000. TimeDsmTsf 0.00 51000. FORMAT "%5.0" /end CHARACTERISTIC
/begin CHARACTERISTIC DSM_TsfDfp_TPUMon_C "Schwerezaehlergrenze fuer Fehlerpfad Dfp_TPUMon" VALUE 0xD2808 Kw_Wu8 51000. TimeDsmTsf 0.00 51000. FORMAT "%5.0" /end CHARACTERISTIC
/begin CHARACTERISTIC DSM_TsfDfp_TVACD_AirMon1_C "Schwerezaehlergrenze fuer Fehlerpfad Dfp_TVACD_AirMon1" VALUE 0xD2809 Kw_Wu8 51000. TimeDsmTsf 0.00 51000. FORMAT "%5.0" /end CHARACTERISTIC
/begin CHARACTERISTIC DSM_TsfDfp_TVACD_AirMon2_C "Schwerezaehlergrenze fuer Fehlerpfad Dfp_TVACD_AirMon2" VALUE 0xD280A Kw_Wu8 51000. TimeDsmTsf 0.00 51000. FORMAT "%5.0" /end CHARACTERISTIC
/begin CHARACTERISTIC DSM_TsfDfp_TVACD_Max_C "Schwerezaehlergrenze fuer Fehlerpfad Dfp_TVACD_Max" VALUE 0xD280B Kw_Wu8 51000. TimeDsmTsf 0.00 51000. FORMAT "%5.0" /end CHARACTERISTIC
/begin CHARACTERISTIC DSM_TsfDfp_TVACD_Max2_C "Schwerezaehlergrenze fuer Fehlerpfad Dfp_TVACD_Max2" VALUE 0xD280C Kw_Wu8 51000. TimeDsmTsf 0.00 51000. FORMAT "%5.0" /end CHARACTERISTIC
/begin CHARACTERISTIC DSM_TsfDfp_TVACD_Min_C "Schwerezaehlergrenze fuer Fehlerpfad Dfp_TVACD_Min" VALUE 0xD280D Kw_Wu8 51000. TimeDsmTsf 0.00 51000. FORMAT "%5.0" /end CHARACTERISTIC
/begin CHARACTERISTIC DSM_TsfDfp_TVACD_Min2_C "Schwerezaehlergrenze fuer Fehlerpfad Dfp_TVACD_Min2" VALUE 0xD280E Kw_Wu8 51000. TimeDsmTsf 0.00 51000. FORMAT "%5.0" /end CHARACTERISTIC
/begin CHARACTERISTIC DSM_TsfDfp_TVACD_SigNpl_C "Schwerezaehlergrenze fuer Fehlerpfad Dfp_TVACD_SigNpl" VALUE 0xD280F Kw_Wu8 51000. TimeDsmTsf 0.00 51000. FORMAT "%5.0" /end CHARACTERISTIC
/begin CHARACTERISTIC DSM_TsfDfp_TVACD_SigNpl2_C "Schwerezaehlergrenze fuer Fehlerpfad Dfp_TVACD_SigNpl2" VALUE 0xD2810 Kw_Wu8 51000. TimeDsmTsf 0.00 51000. FORMAT "%5.0" /end CHARACTERISTIC
/begin CHARACTERISTIC DSM_TsfDfp_TVACD_TVADia1_C "Schwerezaehlergrenze fuer Fehlerpfad Dfp_TVACD_TVADia1" VALUE 0xD2811 Kw_Wu8 51000. TimeDsmTsf 0.00 51000. FORMAT "%5.0" /end CHARACTERISTIC
/begin CHARACTERISTIC DSM_TsfDfp_TVACD_TVADia2_C "Schwerezaehlergrenze fuer Fehlerpfad Dfp_TVACD_TVADia2" VALUE 0xD2812 Kw_Wu8 51000. TimeDsmTsf 0.00 51000. FORMAT "%5.0" /end CHARACTERISTIC
/begin CHARACTERISTIC DSM_TsfDfp_TVACD_TVADia21_C "Schwerezaehlergrenze fuer Fehlerpfad Dfp_TVACD_TVADia21" VALUE 0xD2813 Kw_Wu8 51000. TimeDsmTsf 0.00 51000. FORMAT "%5.0" /end CHARACTERISTIC
/begin CHARACTERISTIC DSM_TsfDfp_TVACD_TVADia22_C "Schwerezaehlergrenze fuer Fehlerpfad Dfp_TVACD_TVADia22" VALUE 0xD2814 Kw_Wu8 51000. TimeDsmTsf 0.00 51000. FORMAT "%5.0" /end CHARACTERISTIC
/begin CHARACTERISTIC DSM_TsfDfp_TVACD_TVADia23_C "Schwerezaehlergrenze fuer Fehlerpfad Dfp_TVACD_TVADia23" VALUE 0xD2815 Kw_Wu8 51000. TimeDsmTsf 0.00 51000. FORMAT "%5.0" /end CHARACTERISTIC
/begin CHARACTERISTIC DSM_TsfDfp_TVACD_TVADia24_C "Schwerezaehlergrenze fuer Fehlerpfad Dfp_TVACD_TVADia24" VALUE 0xD2816 Kw_Wu8 51000. TimeDsmTsf 0.00 51000. FORMAT "%5.0" /end CHARACTERISTIC
/begin CHARACTERISTIC DSM_TsfDfp_TVACD_TVADia3_C "Schwerezaehlergrenze fuer Fehlerpfad Dfp_TVACD_TVADia3" VALUE 0xD2817 Kw_Wu8 51000. TimeDsmTsf 0.00 51000. FORMAT "%5.0" /end CHARACTERISTIC
/begin CHARACTERISTIC DSM_TsfDfp_TVACD_TVADia4_C "Schwerezaehlergrenze fuer Fehlerpfad Dfp_TVACD_TVADia4" VALUE 0xD2818 Kw_Wu8 51000. TimeDsmTsf 0.00 51000. FORMAT "%5.0" /end CHARACTERISTIC
/begin CHARACTERISTIC DSM_TsfDfp_ThrVlvMon_C "Schwerezaehlergrenze fuer Fehlerpfad Dfp_ThrVlvMon" VALUE 0xD2819 Kw_Wu8 51000. TimeDsmTsf 0.00 51000. FORMAT "%5.0" /end CHARACTERISTIC
/begin CHARACTERISTIC DSM_TsfDfp_VSACD_DiaDet_C "Schwerezaehlergrenze fuer Fehlerpfad Dfp_VSACD_DiaDet" VALUE 0xD281A Kw_Wu8 51000. TimeDsmTsf 0.00 51000. FORMAT "%5.0" /end CHARACTERISTIC
/begin CHARACTERISTIC DSM_TsfDfp_VSACD_DioInDia1_C "Schwerezaehlergrenze fuer Fehlerpfad Dfp_VSACD_DioInDia1" VALUE 0xD281B Kw_Wu8 51000. TimeDsmTsf 0.00 51000. FORMAT "%5.0" /end CHARACTERISTIC
/begin CHARACTERISTIC DSM_TsfDfp_VSACD_DioInDia2_C "Schwerezaehlergrenze fuer Fehlerpfad Dfp_VSACD_DioInDia2" VALUE 0xD281C Kw_Wu8 51000. TimeDsmTsf 0.00 51000. FORMAT "%5.0" /end CHARACTERISTIC
/begin CHARACTERISTIC DSM_TsfDfp_VSACD_DioInDia3_C "Schwerezaehlergrenze fuer Fehlerpfad Dfp_VSACD_DioInDia3" VALUE 0xD281D Kw_Wu8 51000. TimeDsmTsf 0.00 51000. FORMAT "%5.0" /end CHARACTERISTIC
/begin CHARACTERISTIC DSM_TsfDfp_VSACD_DioInDia4_C "Schwerezaehlergrenze fuer Fehlerpfad Dfp_VSACD_DioInDia4" VALUE 0xD281E Kw_Wu8 51000. TimeDsmTsf 0.00 51000. FORMAT "%5.0" /end CHARACTERISTIC
/begin CHARACTERISTIC DSM_TsfDfp_VSACD_DioInMin_C "Schwerezaehlergrenze fuer Fehlerpfad Dfp_VSACD_DioInMin" VALUE 0xD281F Kw_Wu8 51000. TimeDsmTsf 0.00 51000. FORMAT "%5.0" /end CHARACTERISTIC
/begin CHARACTERISTIC DSM_TsfDfp_VSACD_Max_C "Schwerezaehlergrenze fuer Fehlerpfad Dfp_VSACD_Max" VALUE 0xD2820 Kw_Wu8 51000. TimeDsmTsf 0.00 51000. FORMAT "%5.0" /end CHARACTERISTIC
/begin CHARACTERISTIC DSM_TsfDfp_VSACD_Min_C "Schwerezaehlergrenze fuer Fehlerpfad Dfp_VSACD_Min" VALUE 0xD2821 Kw_Wu8 51000. TimeDsmTsf 0.00 51000. FORMAT "%5.0" /end CHARACTERISTIC
/begin CHARACTERISTIC DSM_TsfDfp_VSACD_SigNpl_C "Schwerezaehlergrenze fuer Fehlerpfad Dfp_VSACD_SigNpl" VALUE 0xD2822 Kw_Wu8 51000. TimeDsmTsf 0.00 51000. FORMAT "%5.0" /end CHARACTERISTIC
/begin CHARACTERISTIC DSM_TsfDfp_VSACD_VSADia1_C "Schwerezaehlergrenze fuer Fehlerpfad Dfp_VSACD_VSADia1" VALUE 0xD2823 Kw_Wu8 51000. TimeDsmTsf 0.00 51000. FORMAT "%5.0" /end CHARACTERISTIC
/begin CHARACTERISTIC DSM_TsfDfp_VSACD_VSADia2_C "Schwerezaehlergrenze fuer Fehlerpfad Dfp_VSACD_VSADia2" VALUE 0xD2824 Kw_Wu8 51000. TimeDsmTsf 0.00 51000. FORMAT "%5.0" /end CHARACTERISTIC
/begin CHARACTERISTIC DSM_TsfDfp_VSACD_VSADia3_C "Schwerezaehlergrenze fuer Fehlerpfad Dfp_VSACD_VSADia3" VALUE 0xD2825 Kw_Wu8 51000. TimeDsmTsf 0.00 51000. FORMAT "%5.0" /end CHARACTERISTIC
/begin CHARACTERISTIC DSM_TsfDfp_VSACD_VSADia4_C "Schwerezaehlergrenze fuer Fehlerpfad Dfp_VSACD_VSADia4" VALUE 0xD2826 Kw_Wu8 51000. TimeDsmTsf 0.00 51000. FORMAT "%5.0" /end CHARACTERISTIC
/begin CHARACTERISTIC DSM_TsfDfp_VSSCD1_C "Schwerezaehlergrenze fuer Fehlerpfad Dfp_VSSCD1" VALUE 0xD2827 Kw_Wu8 51000. TimeDsmTsf 0.00 51000. FORMAT "%5.0" /end CHARACTERISTIC
/begin CHARACTERISTIC DSM_TsfDfp_VSSCD2_C "Schwerezaehlergrenze fuer Fehlerpfad Dfp_VSSCD2" VALUE 0xD2828 Kw_Wu8 51000. TimeDsmTsf 0.00 51000. FORMAT "%5.0" /end CHARACTERISTIC
/begin CHARACTERISTIC DSM_TsfDfp_WdCom_C "Schwerezaehlergrenze fuer Fehlerpfad Dfp_WdCom" VALUE 0xD2829 Kw_Wu8 51000. TimeDsmTsf 0.00 51000. FORMAT "%5.0" /end CHARACTERISTIC
/begin CHARACTERISTIC EATSCD_uSRCMin_C "SRC Minimum Umgebungstemperatur" VALUE 0xD2838 Kw_Ws16 5200.391 Volt 0.00 5200.391 FORMAT "%8.3" EXTENDED_LIMITS -160156.4 160151.5 /end CHARACTERISTIC
/begin CHARACTERISTIC EATSCD_uSRCMax_C "SRC Maximum Umgebungstemperatur" VALUE 0xD283A Kw_Ws16 5200.391 Volt 0.00 5200.391 FORMAT "%8.3" EXTENDED_LIMITS -160156.4 160151.5 /end CHARACTERISTIC
/begin CHARACTERISTIC EATSCD_tLin_CUR "Linearisierungskennlinie der Umgebungstemperatur" CURVE 0xD283C Kl_Xs16_Ws16 950.0000 Temp_Cels -50.1400 899.8600 FORMAT "%8.4" EXTENDED_LIMITS -3549.940 3003.560
 /begin AXIS_DESCR STD_AXIS EATSCD_uRaw Volt 16 0.00 5200.391 FORMAT "%8.3" EXTENDED_LIMITS -160156.4 160151.5 DEPOSIT ABSOLUTE /end AXIS_DESCR
/end CHARACTERISTIC
/begin CHARACTERISTIC EATSCD_DebSigDef_C "Entprellzeit defekt CAN Signal Fehler Umgebungstemperatur" VALUE 0xD287E Kw_Wu16 655350.0 Time_ms 0.00 655350.0 FORMAT "%8.1" /end CHARACTERISTIC
/begin CHARACTERISTIC EATSCD_DebSigOk_C "Heilungsentprellzeit CAN Signalfehler Umgebungstemperatur" VALUE 0xD2880 Kw_Wu16 655350.0 Time_ms 0.00 655350.0 FORMAT "%8.1" /end CHARACTERISTIC
/begin CHARACTERISTIC EATSCD_DebSRCHighDef_C "EATS Fehlerentprellungszeit fuer SRC-High" VALUE 0xD2882 Kw_Wu16 655350.0 Time_ms 0.00 655350.0 FORMAT "%8.1" /end CHARACTERISTIC
/begin CHARACTERISTIC EATSCD_DebSRCHighOk_C "EATS Heilungsentprellzeit fuer SRC-High" VALUE 0xD2884 Kw_Wu16 655350.0 Time_ms 0.00 655350.0 FORMAT "%8.1" /end CHARACTERISTIC
/begin CHARACTERISTIC EATSCD_DebSRCLowDef_C "EATS Fehlerentprellungszeit fuer SRC-Low" VALUE 0xD2886 Kw_Wu16 655350.0 Time_ms 0.00 655350.0 FORMAT "%8.1" /end CHARACTERISTIC
/begin CHARACTERISTIC EATSCD_DebSRCLowOk_C "EATS Heilungsentprellzeit fuer SRC-Low" VALUE 0xD2888 Kw_Wu16 655350.0 Time_ms 0.00 655350.0 FORMAT "%8.1" /end CHARACTERISTIC
/begin CHARACTERISTIC EATSCD_dtRmpSubs_C "Rampensteigung für Umgebungstemperatur" VALUE 0xD288C Kw_Wu32 6553.59899750 RmpTempCels 0.00100097656250 6553.59999847 FORMAT "%13.8" EXTENDED_LIMITS 0.00 6553.59999847 /end CHARACTERISTIC
/begin CHARACTERISTIC EATSCD_dtRmpSubsUp_C "Rampensteigung für Umschaltung der Umgebungstemperatur" VALUE 0xD2890 Kw_Wu32 6553.59899750 RmpTempCels 0.00100097656250 6553.59999847 FORMAT "%13.8" EXTENDED_LIMITS 0.00 6553.59999847 /end CHARACTERISTIC
/begin CHARACTERISTIC EATSCD_dtRmpSubsDwn_C "Rampensteigung für Umschaltung der Umgebungstemperatur" VALUE 0xD2894 Kw_Wu32 6553.59899750 RmpTempCels 0.00100097656250 6553.59999847 FORMAT "%13.8" EXTENDED_LIMITS 0.00 6553.59999847 /end CHARACTERISTIC
/begin CHARACTERISTIC EATSCD_numAdc_C "Applikationsparameter fuer Umgebungslufttemperatur-Fuhehler" VALUE 0xD2898 Kw_Wu8 60.0000000000 NumPinAdc 0.00 60.0000000000 FORMAT "%13.10" /end CHARACTERISTIC
/begin CHARACTERISTIC EATSCD_dtRmpSlpUp_C "popsitive Rampensteigung" VALUE 0xD289C Kw_Wu32 6553598.99749 RmpTemp 1.00097656250 6553599.99847 FORMAT "%13.5" EXTENDED_LIMITS 0.00 6553599.99847 /end CHARACTERISTIC
/begin CHARACTERISTIC EATSCD_dtRmpSlpDwn_C "negative Rampensteigung" VALUE 0xD28A0 Kw_Wu32 6553598.99749 RmpTemp 1.00097656250 6553599.99847 FORMAT "%13.5" EXTENDED_LIMITS 0.00 6553599.99847 /end CHARACTERISTIC
/begin CHARACTERISTIC EATSCD_swtSensImpl_C "Schalter zur Auswahl der Umgebungstemperatur (0: Umgebungsluft- Sensor, 1: Ersatztemperatur, default: Ansauglufttemperatur)" VALUE 0xD28A4 Kw_Wu8 2.000 OneToOne 0.00 2.000 FORMAT "%5.3" EXTENDED_LIMITS 0.00 255.0 /end CHARACTERISTIC
/begin CHARACTERISTIC EATSCD_swtSigVal_C "Datensatzwert Signalquelle Umgebungsluftemperatur (0 = ADC, 1 = CAN)" VALUE 0xD28A5 Kw_Wu8 1.000 OneToOne 0.00 1.000 FORMAT "%5.3" EXTENDED_LIMITS 0.00 255.0 /end CHARACTERISTIC
/begin CHARACTERISTIC EATSCD_tAirSubs_C "Ersatzwert für Umgebungstemperatur" VALUE 0xD28A6 Kw_Ws16 250.0000 Temp_Cels -50.14000 199.8600 FORMAT "%8.4" EXTENDED_LIMITS -3549.940 3003.560 /end CHARACTERISTIC
/begin CHARACTERISTIC EATSCD_tiTransStValid_C "" VALUE 0xD28A8 Kw_Wu16 655.3500 Time_s 0.00 655.3500 FORMAT "%8.4" /end CHARACTERISTIC
/begin CHARACTERISTIC EATSCD_stSensIDWord_C "Geberkennwort Umgebungstemperatur" VALUE 0xD28AA Kw_Wu16 65535.00 OneToOne 0.00 65535.00 FORMAT "%8.2" /end CHARACTERISTIC
/begin CHARACTERISTIC EATSCD_tDfl_C "Vorgabewert Umgebungstemperatur" VALUE 0xD28AC Kw_Ws16 950.0000 Temp_Cels -50.1400 899.8600 FORMAT "%8.4" EXTENDED_LIMITS -3549.940 3003.560 /end CHARACTERISTIC
/begin CHARACTERISTIC EBAFCD_ctPwrStgOnMax_C "Maximaler Zähler für Powerstage On im Fehlerfall" VALUE 0xD28B0 Kw_Wu16 65535.00 OneToOne 0.00 65535.00 FORMAT "%8.2" /end CHARACTERISTIC
/begin CHARACTERISTIC EBAFCD_DebExcTempDef_C "Defect time for EXC_TEMP error" VALUE 0xD28B2 Kw_Wu16 655350.0 Time_ms 0.00 655350.0 FORMAT "%8.1" /end CHARACTERISTIC
/begin CHARACTERISTIC EBAFCD_DebExcTempOk_C "Healing time for EXC_TEMP error" VALUE 0xD28B4 Kw_Wu16 655350.0 Time_ms 0.00 655350.0 FORMAT "%8.1" /end CHARACTERISTIC
/begin CHARACTERISTIC EBAFCD_DebNoLoadDef_C "Defect time for NO_LOAD error" VALUE 0xD28B6 Kw_Wu16 655350.0 Time_ms 0.00 655350.0 FORMAT "%8.1" /end CHARACTERISTIC
/begin CHARACTERISTIC EBAFCD_DebNoLoadOk_C "Healing time for NO_LOAD error" VALUE 0xD28B8 Kw_Wu16 655350.0 Time_ms 0.00 655350.0 FORMAT "%8.1" /end CHARACTERISTIC
/begin CHARACTERISTIC EBAFCD_DebShortCircBatDef_C "Defect time for SHORT_CIRC_BAT error" VALUE 0xD28BA Kw_Wu16 655350.0 Time_ms 0.00 655350.0 FORMAT "%8.1" /end CHARACTERISTIC
/begin CHARACTERISTIC EBAFCD_DebShortCircBatOk_C "Healing time for SHORT_CIRC_BAT error" VALUE 0xD28BC Kw_Wu16 655350.0 Time_ms 0.00 655350.0 FORMAT "%8.1" /end CHARACTERISTIC
/begin CHARACTERISTIC EBAFCD_DebShortCircGndDef_C "Defect time for SHORT_CIRC_GND error" VALUE 0xD28BE Kw_Wu16 655350.0 Time_ms 0.00 655350.0 FORMAT "%8.1" /end CHARACTERISTIC
/begin CHARACTERISTIC EBAFCD_DebShortCircGndOk_C "Healing time for SHORT_CIRC_GND error" VALUE 0xD28C0 Kw_Wu16 655350.0 Time_ms 0.00 655350.0 FORMAT "%8.1" /end CHARACTERISTIC
/begin CHARACTERISTIC EBAFCD_InvSigOut_C "status word for (non)/inverting output EBAFCD_stSigOut" VALUE 0xD28C2 Kw_Wu8 255.0 OneToOne 0.00 255.0 FORMAT "%5.1" /end CHARACTERISTIC
/begin CHARACTERISTIC EBAFCD_nFan_C "minimum rpm of fan to disable outout" VALUE 0xD28C4 Kw_Ws16 6000.092 FanSpd -3000.092 3000.000 FORMAT "%8.3" /end CHARACTERISTIC
/begin CHARACTERISTIC EBAFCD_numDiaOut_C "Request of test of power stage from tester" VALUE 0xD28C6 Kw_Wu8 33.0000000000 NumPinDia 0.00 33.0000000000 FORMAT "%13.10" /end CHARACTERISTIC
/begin CHARACTERISTIC EBAFCD_numDioOut_C "Selection of power stage" VALUE 0xD28C7 Kw_Wu8 15.0000000000 NumPinDioOut 0.00 15.0000000000 FORMAT "%13.10" /end CHARACTERISTIC
/begin CHARACTERISTIC EBAFCD_stSPICtl_C "Schalter ob Endstufe SPI kontrollierbar = 1 oder nicht SPI kontrollierbar = 0" VALUE 0xD28C8 Kw_Wu8 1.000 OneToOne 0.00 1.000 FORMAT "%5.3" EXTENDED_LIMITS 0.00 255.0 /end CHARACTERISTIC
/begin CHARACTERISTIC EBAFCD_tClntTrMin_C "threshold low engine protection pressure hysteresis" VALUE 0xD28CA Kw_Ws16 950.000 Temp_Cels -50.140 899.860 FORMAT "%8.3" EXTENDED_LIMITS -3549.940 3003.560 /end CHARACTERISTIC
/begin CHARACTERISTIC EBAFCD_tClntTrMax_C "threshold high engine protection pressure hysteresis" VALUE 0xD28CC Kw_Ws16 950.000 Temp_Cels -50.140 899.860 FORMAT "%8.3" EXTENDED_LIMITS -3549.940 3003.560 /end CHARACTERISTIC
/begin CHARACTERISTIC EBAFCD_sttClntTrOff_C "engine protection off" VALUE 0xD28CE Kw_Ws16 65535.00 OneToOne -32768.00 32767.00 FORMAT "%8.2" READ_ONLY /end CHARACTERISTIC
/begin CHARACTERISTIC EBAFCD_sttClntTrOn_C "engine protection on" VALUE 0xD28D0 Kw_Ws16 65535.00 OneToOne -32768.00 32767.00 FORMAT "%8.2" READ_ONLY /end CHARACTERISTIC
/begin CHARACTERISTIC EBAFCD_tClntMin_C "threshold low engine protection pressure hysteresis" VALUE 0xD28D2 Kw_Ws16 950.000 Temp_Cels -50.140 899.860 FORMAT "%8.3" EXTENDED_LIMITS -3549.940 3003.560 /end CHARACTERISTIC
/begin CHARACTERISTIC EBAFCD_tClntMax_C "threshold high engine protection pressure hysteresis" VALUE 0xD28D4 Kw_Ws16 950.000 Temp_Cels -50.140 899.860 FORMAT "%8.3" EXTENDED_LIMITS -3549.940 3003.560 /end CHARACTERISTIC
/begin CHARACTERISTIC EBAFCD_sttClntOff_C "engine protection off" VALUE 0xD28D6 Kw_Ws16 65535.00 OneToOne -32768.00 32767.00 FORMAT "%8.2" READ_ONLY /end CHARACTERISTIC
/begin CHARACTERISTIC EBAFCD_sttClntOn_C "engine protection on" VALUE 0xD28D8 Kw_Ws16 65535.00 OneToOne -32768.00 32767.00 FORMAT "%8.2" READ_ONLY /end CHARACTERISTIC
/begin CHARACTERISTIC EBAFCD_tiBtwTst_C "Zeitabstand, in dem die Endstufe im Fehlerfall getestet wird" VALUE 0xD28DA Kw_Wu16 29980.00 Time_ms 20.00000 30000.00 FORMAT "%8.2" EXTENDED_LIMITS 0.00 655350.0 /end CHARACTERISTIC
/begin CHARACTERISTIC EBAFCD_tiPwrStgOn_C "Zeit für welche die Endstufe im Fehlerfall eingeschalten wird (nur nicht SPI kontrolliert)" VALUE 0xD28DC Kw_Wu16 655140.0 Time_ms 0.00 655140.0 FORMAT "%8.1" EXTENDED_LIMITS 0.00 655350.0 /end CHARACTERISTIC
/begin CHARACTERISTIC EBFCD_ctPwrStgOnMax_C "Maximaler Zähler für Powerstage On im Fehlerfall" VALUE 0xD28DE Kw_Wu16 65535.00 OneToOne 0.00 65535.00 FORMAT "%8.2" /end CHARACTERISTIC
/begin CHARACTERISTIC EBFCD_DebExcTempDef_C "time for final defect of excess temperature defect" VALUE 0xD28E0 Kw_Wu16 655350.0 Time_ms 0.00 655350.0 FORMAT "%8.1" /end CHARACTERISTIC
/begin CHARACTERISTIC EBFCD_DebExcTempOk_C "time for healing of excess temperature defect" VALUE 0xD28E2 Kw_Wu16 655350.0 Time_ms 0.00 655350.0 FORMAT "%8.1" /end CHARACTERISTIC
/begin CHARACTERISTIC EBFCD_DebNoLoadDef_C "time for final defect of no load" VALUE 0xD28E4 Kw_Wu16 655350.0 Time_ms 0.00 655350.0 FORMAT "%8.1" /end CHARACTERISTIC
/begin CHARACTERISTIC EBFCD_DebNoLoadOk_C "time for healing of no load defect" VALUE 0xD28E6 Kw_Wu16 655350.0 Time_ms 0.00 655350.0 FORMAT "%8.1" /end CHARACTERISTIC
/begin CHARACTERISTIC EBFCD_DebShortCircBatDef_C "time for final defect for short circuit to battery" VALUE 0xD28E8 Kw_Wu16 655350.0 Time_ms 0.00 655350.0 FORMAT "%8.1" /end CHARACTERISTIC
/begin CHARACTERISTIC EBFCD_DebShortCircBatOk_C "time for healing of short circuit to battery" VALUE 0xD28EA Kw_Wu16 655350.0 Time_ms 0.00 655350.0 FORMAT "%8.1" /end CHARACTERISTIC
/begin CHARACTERISTIC EBFCD_DebShortCircGndDef_C "time for final defect of short circuit to ground" VALUE 0xD28EC Kw_Wu16 655350.0 Time_ms 0.00 655350.0 FORMAT "%8.1" /end CHARACTERISTIC
/begin CHARACTERISTIC EBFCD_DebShortCircGndOk_C "time for final defect of short circuit to ground" VALUE 0xD28EE Kw_Wu16 655350.0 Time_ms 0.00 655350.0 FORMAT "%8.1" /end CHARACTERISTIC
/begin CHARACTERISTIC EBFCD_numDiaOut_C "application parameter for EBFCD diagnostic signal" VALUE 0xD28F0 Kw_Wu8 33.0000000000 NumPinDia 0.00 33.0000000000 FORMAT "%13.10" /end CHARACTERISTIC
/begin CHARACTERISTIC EBFCD_numDioOut_C "application parameter for fan output signal" VALUE 0xD28F1 Kw_Wu8 15.0000000000 NumPinDioOut 0.00 15.0000000000 FORMAT "%13.10" /end CHARACTERISTIC
/begin CHARACTERISTIC EBFCD_stDigInvOut_C "Digital output signal invert information" VALUE 0xD28F2 Kw_Wu8 1.000 OneToOne 0.00 1.000 FORMAT "%5.3" EXTENDED_LIMITS 0.00 255.0 /end CHARACTERISTIC
/begin CHARACTERISTIC EBFCD_stSigOutErr_C "Default value if error occurs" VALUE 0xD28F3 Kw_Wu8 1.000 OneToOne 0.00 1.000 FORMAT "%5.3" EXTENDED_LIMITS 0.00 255.0 /end CHARACTERISTIC
/begin CHARACTERISTIC EBFCD_stSPICtl_C "Schalter ob Endstufe SPI kontrollierbar = 1 oder nicht SPI kontrollierbar = 0" VALUE 0xD28F4 Kw_Wu8 1.000 OneToOne 0.00 1.000 FORMAT "%5.3" EXTENDED_LIMITS 0.00 255.0 /end CHARACTERISTIC
/begin CHARACTERISTIC EBFCD_swtOnOff_C "Switch for switching the functionality ON/OFF (1 = ON, 0 = OFF)" VALUE 0xD28F5 Kw_Wu8 1.000 OneToOne 0.00 1.000 FORMAT "%5.3" EXTENDED_LIMITS 0.00 255.0 /end CHARACTERISTIC
/begin CHARACTERISTIC EBFCD_tECUXLow_C "Minimum value for the input of the hysteresis" VALUE 0xD28F6 Kw_Ws16 250.0000 Temp_Cels -50.1400 199.8600 FORMAT "%8.4" EXTENDED_LIMITS -3549.940 3003.560 /end CHARACTERISTIC
/begin CHARACTERISTIC EBFCD_tECUXHigh_C "Maximum value for the input of the hysteresis" VALUE 0xD28F8 Kw_Ws16 250.0000 Temp_Cels -50.1400 199.8600 FORMAT "%8.4" EXTENDED_LIMITS -3549.940 3003.560 /end CHARACTERISTIC
/begin CHARACTERISTIC EBFCD_stECUYLow_C "Minimum value for the output of the hysteresis" VALUE 0xD28FA Kw_Ws16 1.000000 OneToOne 0.00 1.000000 FORMAT "%8.6" EXTENDED_LIMITS -32768.00 32767.00 /end CHARACTERISTIC
/begin CHARACTERISTIC EBFCD_stECUYHigh_C "Maximum value for the output of the hysteresis" VALUE 0xD28FC Kw_Ws16 1.000000 OneToOne 0.00 1.000000 FORMAT "%8.6" EXTENDED_LIMITS -32768.00 32767.00 /end CHARACTERISTIC
/begin CHARACTERISTIC EBFCD_tiBtwTst_C "Zeitabstand, in dem die Endstufe im Fehlerfall getestet wird" VALUE 0xD28FE Kw_Wu16 29980.00 Time_ms 20.00000 30000.00 FORMAT "%8.2" EXTENDED_LIMITS 0.00 655350.0 /end CHARACTERISTIC
/begin CHARACTERISTIC EBFCD_tiPwrStgOn_C "Zeit für welche die Endstufe im Fehlerfall eingeschalten wird (nur nicht SPI kontrolliert)" VALUE 0xD2900 Kw_Wu16 655140.0 Time_ms 0.00 655140.0 FORMAT "%8.1" EXTENDED_LIMITS 0.00 655350.0 /end CHARACTERISTIC
/begin CHARACTERISTIC EBTSCD_uSRCMin_C "min. value of SRC" VALUE 0xD2904 Kw_Ws16 5200.391 Volt 0.00 5200.391 FORMAT "%8.3" EXTENDED_LIMITS -160156.4 160151.5 /end CHARACTERISTIC
/begin CHARACTERISTIC EBTSCD_uSRCMax_C "max. value of SRC" VALUE 0xD2906 Kw_Ws16 5200.391 Volt 0.00 5200.391 FORMAT "%8.3" EXTENDED_LIMITS -160156.4 160151.5 /end CHARACTERISTIC
/begin CHARACTERISTIC EBTSCD_tLin_CUR "curve for linearisation in EBTSCD" CURVE 0xD2908 Kl_Xs16_Ws16 250.0000 Temp_Cels -50.14000 199.8600 FORMAT "%8.4" EXTENDED_LIMITS -3549.940 3003.560
 /begin AXIS_DESCR STD_AXIS EBTSCD_uRawTECU_mp Volt 16 0.00 5200.391 FORMAT "%8.3" EXTENDED_LIMITS -160156.4 160151.5 DEPOSIT ABSOLUTE /end AXIS_DESCR
/end CHARACTERISTIC
/begin CHARACTERISTIC EBTSCD_OvrDebSRCHighDef_C "Error debounce time for Over temperature error" VALUE 0xD294A Kw_Wu16 655350.0 Time_ms 0.00 655350.0 FORMAT "%8.1" /end CHARACTERISTIC
/begin CHARACTERISTIC EBTSCD_OvrDebSRCHighOk_C "Healing debounce time for over temperature  error" VALUE 0xD294C Kw_Wu16 655350.0 Time_ms 0.00 655350.0 FORMAT "%8.1" /end CHARACTERISTIC
/begin CHARACTERISTIC EBTSCD_DebSRCHighDef_C "Error debounce time for SRC-High error" VALUE 0xD294E Kw_Wu16 655350.0 Time_ms 0.00 655350.0 FORMAT "%8.1" /end CHARACTERISTIC
/begin CHARACTERISTIC EBTSCD_DebSRCHighOk_C "Healing debounce time for SRC-High error" VALUE 0xD2950 Kw_Wu16 655350.0 Time_ms 0.00 655350.0 FORMAT "%8.1" /end CHARACTERISTIC
/begin CHARACTERISTIC EBTSCD_DebSRCLowDef_C "Error debounce time for SRC-Low error" VALUE 0xD2952 Kw_Wu16 655350.0 Time_ms 0.00 655350.0 FORMAT "%8.1" /end CHARACTERISTIC
/begin CHARACTERISTIC EBTSCD_DebSRCLowOk_C "Healing debounce time for SRC-Low error" VALUE 0xD2954 Kw_Wu16 655350.0 Time_ms 0.00 655350.0 FORMAT "%8.1" /end CHARACTERISTIC
/begin CHARACTERISTIC EBTSCD_numAdc_C "application parameter for ECU temperature" VALUE 0xD2956 Kw_Wu8 60.0000000000 NumPinAdc 0.00 60.0000000000 FORMAT "%13.10" /end CHARACTERISTIC
/begin CHARACTERISTIC EBTSCD_dtRmpSlpUp_C "ramp slope up" VALUE 0xD2958 Kw_Wu32 6553598.99749 RmpTemp 1.00097656250 6553599.99847 FORMAT "%13.5" EXTENDED_LIMITS 0.00 6553599.99847 /end CHARACTERISTIC
/begin CHARACTERISTIC EBTSCD_dtRmpSlpDwn_C "ramp slope down" VALUE 0xD295C Kw_Wu32 6553598.99749 RmpTemp 1.00097656250 6553599.99847 FORMAT "%13.5" EXTENDED_LIMITS 0.00 6553599.99847 /end CHARACTERISTIC
/begin CHARACTERISTIC EBTSCD_tiTECUPT1_C "Time constant of PT1 delay element" VALUE 0xD2960 Kw_Wu32 4294.9663 TimeDelay_s 0.0010000001 4294.9673 FORMAT "%9.4" EXTENDED_LIMITS 0.0000010000000 4294.9673 /end CHARACTERISTIC
/begin CHARACTERISTIC EBTSCD_tOvrTemp_C "over temperature threshold" VALUE 0xD2964 Kw_Ws16 250.0000 Temp_Cels -50.1400 199.8600 FORMAT "%8.4" EXTENDED_LIMITS -3549.940 3003.560 /end CHARACTERISTIC
/begin CHARACTERISTIC EBTSCD_stSensIDWord_C "ID-Word for transition stage" VALUE 0xD2966 Kw_Wu16 65535.00 OneToOne 0.00 65535.00 FORMAT "%8.2" /end CHARACTERISTIC
/begin CHARACTERISTIC EBTSCD_tDfl_C "default value if error occurs" VALUE 0xD2968 Kw_Ws16 250.0000 Temp_Cels -50.14000 199.8600 FORMAT "%8.4" EXTENDED_LIMITS -3549.940 3003.560 /end CHARACTERISTIC
/begin CHARACTERISTIC ECU_vPrgThres_C "obere Geschwindigkeitsgrenze für die FLASH Programmierung" VALUE 0xD296C Kw_Ws16 327.6700 Vel 0.00 327.6700 FORMAT "%8.4" EXTENDED_LIMITS -327.6800 327.6700 /end CHARACTERISTIC
/begin CHARACTERISTIC EEPCD_stMILDfl_C "Vorgabezewert für MIL von EEPCD defekt" VALUE 0xD296E Kw_Wu8 1.000 OneToOne 0.00 1.000 FORMAT "%5.3" EXTENDED_LIMITS 0.00 255.0 /end CHARACTERISTIC
/begin CHARACTERISTIC EGPpCD_ctPwrStgOnMax_C "Maximaler Zähler für Powerstage On im Fehlerfall" VALUE 0xD2CC0 Kw_Wu16 65535.00 OneToOne 0.00 65535.00 FORMAT "%8.2" /end CHARACTERISTIC
/begin CHARACTERISTIC EGPpCD_numDia_C "Application parameter for Exhaust gas pressure pump actuator diagnostic signal" VALUE 0xD2CC2 Kw_Wu8 33.0000000000 NumPinDia 0.00 33.0000000000 FORMAT "%13.10" /end CHARACTERISTIC
/begin CHARACTERISTIC EGPpCD_numDioOut_C "Application parameter for Exhaust gas pressure pump actuator output pin" VALUE 0xD2CC3 Kw_Wu8 15.0000000000 NumPinDioOut 0.00 15.0000000000 FORMAT "%13.10" /end CHARACTERISTIC
/begin CHARACTERISTIC EGPpCD_stInvOut_C "Digital output invert information for Exhaust gas pressure pump actuator" VALUE 0xD2CC4 Kw_Wu8 1.000 OneToOne 0.00 1.000 FORMAT "%5.3" EXTENDED_LIMITS 0.00 255.0 /end CHARACTERISTIC
/begin CHARACTERISTIC EGPpCD_stPwrStgActv_C "Status word for deactivation of the powerstage diagnostics" VALUE 0xD2CC5 Kw_Wu8 255.0 OneToOne 0.00 255.0 FORMAT "%5.1" /end CHARACTERISTIC
/begin CHARACTERISTIC EGPpCD_stSPICtl_C "Schalter ob Endstufe SPI kontrollierbar = 1 oder nicht SPI kontrollierbar = 0" VALUE 0xD2CC6 Kw_Wu8 1.000 OneToOne 0.00 1.000 FORMAT "%5.3" EXTENDED_LIMITS 0.00 255.0 /end CHARACTERISTIC
/begin CHARACTERISTIC EGPpCD_tiBtwTst_C "Zeitabstand, in dem die Endstufe im Fehlerfall getestet wird" VALUE 0xD2CC8 Kw_Wu16 655140.0 Time_ms 0.00 655140.0 FORMAT "%8.1" EXTENDED_LIMITS 0.00 655350.0 /end CHARACTERISTIC
/begin CHARACTERISTIC EGPpCD_tiDebExcTempDef_C "Debounce duration for excess temperature error detection" VALUE 0xD2CCA Kw_Wu16 655350.0 Time_ms 0.00 655350.0 FORMAT "%8.1" /end CHARACTERISTIC
/begin CHARACTERISTIC EGPpCD_tiDebExcTempOk_C "Debounce duration for excess temperature error healing" VALUE 0xD2CCC Kw_Wu16 655350.0 Time_ms 0.00 655350.0 FORMAT "%8.1" /end CHARACTERISTIC
/begin CHARACTERISTIC EGPpCD_tiDebNoLoadDef_C "Debounce duration for no load error detection" VALUE 0xD2CCE Kw_Wu16 655350.0 Time_ms 0.00 655350.0 FORMAT "%8.1" /end CHARACTERISTIC
/begin CHARACTERISTIC EGPpCD_tiDebNoLoadOk_C "Debounce duration for no load error healing" VALUE 0xD2CD0 Kw_Wu16 655350.0 Time_ms 0.00 655350.0 FORMAT "%8.1" /end CHARACTERISTIC
/begin CHARACTERISTIC EGPpCD_tiDebShortCircBatDef_C "Debounce duration for short circuit to battery error detection" VALUE 0xD2CD2 Kw_Wu16 655350.0 Time_ms 0.00 655350.0 FORMAT "%8.1" /end CHARACTERISTIC
/begin CHARACTERISTIC EGPpCD_tiDebShortCircBatOk_C "Debounce duration for short circuit to battery error healing" VALUE 0xD2CD4 Kw_Wu16 655350.0 Time_ms 0.00 655350.0 FORMAT "%8.1" /end CHARACTERISTIC
/begin CHARACTERISTIC EGPpCD_tiDebShortCircGndDef_C "Debounce duration for short circuit to ground error detection" VALUE 0xD2CD6 Kw_Wu16 655350.0 Time_ms 0.00 655350.0 FORMAT "%8.1" /end CHARACTERISTIC
/begin CHARACTERISTIC EGPpCD_tiDebShortCircGndOk_C "Debounce duration for short circuit to ground error healing" VALUE 0xD2CD8 Kw_Wu16 655350.0 Time_ms 0.00 655350.0 FORMAT "%8.1" /end CHARACTERISTIC
/begin CHARACTERISTIC EGPpCD_tiPwrStgOn_C "Zeit für welche die Endstufe im Fehlerfall eingeschalten wird (nur nicht SPI kontrolliert)" VALUE 0xD2CDA Kw_Wu16 655140.0 Time_ms 0.00 655140.0 FORMAT "%8.1" EXTENDED_LIMITS 0.00 655350.0 /end CHARACTERISTIC
/begin CHARACTERISTIC EGPp_facGeoSil2_C "Geometric factor silencer" VALUE 0xD2AC8 Kw_Ws16 100.0000 Fact1 0.00 100.0000 FORMAT "%8.4" EXTENDED_LIMITS -256.0000 255.9922 /end CHARACTERISTIC
/begin CHARACTERISTIC EGPp_facGeoSil_C "geometrischer Faktor Schalldämpfer" VALUE 0xD2ACA Kw_Ws16 100.0000 Fact1 0.00 100.0000 FORMAT "%8.4" EXTENDED_LIMITS -256.0000 255.9922 /end CHARACTERISTIC
/begin CHARACTERISTIC EGPp_facPow_CUR "Potenzfunktion für Abgasvolumenstrom" CURVE 0xD2ACC Kl_Xs16_Ws16 250.0000 Fact1 0.00 250.0000 FORMAT "%8.4" EXTENDED_LIMITS -256.0000 255.9922 READ_ONLY
 /begin AXIS_DESCR STD_AXIS EGPp_dvolSilBnk_mp CubMtrPerHr 11 0.00 3200.000 FORMAT "%8.3" EXTENDED_LIMITS -3276.800 3276.700 DEPOSIT ABSOLUTE /end AXIS_DESCR
/end CHARACTERISTIC
/begin CHARACTERISTIC EGPp_facRhoEta_CUR "temperaturabhängiger Dichte- und Viskositätsfaktor" CURVE 0xD2AFA Kl_Xs16_Ws16 4.000000 Fact 0.00 4.000000 FORMAT "%8.6" EXTENDED_LIMITS -4.000000 3.999878 READ_ONLY
 /begin AXIS_DESCR STD_AXIS EGPp_tPstSimBnk_mp Temp_Cels 9 -50.140 899.860 FORMAT "%8.3" EXTENDED_LIMITS -3549.940 3003.560 DEPOSIT ABSOLUTE /end AXIS_DESCR
/end CHARACTERISTIC
/begin CHARACTERISTIC EGPp_nAvrgLim_C "Drehzahlschwelle zur Ansteuerung der NSD-Klappe" VALUE 0xD2974 Kw_Ws16 6000.000 EngN 0.00 6000.000 FORMAT "%8.3" EXTENDED_LIMITS -32768.00 32767.00 /end CHARACTERISTIC
/begin CHARACTERISTIC EGPp_pPstPFltEG_MAP "Druckabfallkennfeld" MAP 0xD2B20 Kf_Xs16_Ys16_Ws16 4000.000 Pres_hPa 0.00 4000.000 FORMAT "%8.3" EXTENDED_LIMITS -32768.00 32767.00
 /begin AXIS_DESCR STD_AXIS EGPp_dmEG_mp AirMassPerTime 10 0.00 1000.000 FORMAT "%8.3" EXTENDED_LIMITS -3276.800 3276.700 DEPOSIT ABSOLUTE /end AXIS_DESCR
 /begin AXIS_DESCR STD_AXIS EGPp_tSurf_mp Temp_Cels 10 -50.140 899.860 FORMAT "%8.3" EXTENDED_LIMITS -3549.940 3003.560 DEPOSIT ABSOLUTE /end AXIS_DESCR
/end CHARACTERISTIC
/begin CHARACTERISTIC EGPp_pPstPFlt_MAP "Druckabfallkennfeld" MAP 0xD2C14 Kf_Xs16_Ys16_Ws16 3500.0000 Pres_hPa 0.00 3500.0000 FORMAT "%8.4" EXTENDED_LIMITS -32768.00 32767.00
 /begin AXIS_DESCR STD_AXIS Eng_nAvrg EngN 8 0.00 8000.000 FORMAT "%8.3" EXTENDED_LIMITS -32768.00 32767.00 DEPOSIT ABSOLUTE /end AXIS_DESCR
 /begin AXIS_DESCR STD_AXIS InjCtl_qSetUnBal InjMassCyc 8 0.00 200.0000 FORMAT "%8.4" EXTENDED_LIMITS -327.6800 327.6700 DEPOSIT ABSOLUTE /end AXIS_DESCR
/end CHARACTERISTIC
/begin CHARACTERISTIC EGPp_tiPresFltPT1_C "PT1 Filterzeit für die Druckmodellierung im Abgasrohr" VALUE 0xD2CB8 Kw_Wu32 4294.9673 TimeDelay_s 0.0000010000000 4294.9673 FORMAT "%9.4" /end CHARACTERISTIC
/begin CHARACTERISTIC EGPp_rLogicOutNHys_C "" VALUE 0xD2976 Kw_Wu16 100.0000 Prc 0.00 100.0000 FORMAT "%8.4" EXTENDED_LIMITS 0.00 799.9878 /end CHARACTERISTIC
/begin CHARACTERISTIC EGPp_rLogicOutQHys_C "" VALUE 0xD2978 Kw_Wu16 100.0000 Prc 0.00 100.0000 FORMAT "%8.4" EXTENDED_LIMITS 0.00 799.9878 /end CHARACTERISTIC
/begin CHARACTERISTIC EGPp_stFlapRgn_MAP "Kennfeld zur Ansteuerung der NSD-Klappe wärend Regeneration" MAP 0xD297A Kf_Xs16_Ys16_Ws16 1.000000 OneToOne 0.00 1.000000 FORMAT "%8.6" EXTENDED_LIMITS -32768.00 32767.00
 /begin AXIS_DESCR STD_AXIS Eng_nAvrg EngN 8 40.00000 6000.000 FORMAT "%8.3" EXTENDED_LIMITS -32768.00 32767.00 DEPOSIT ABSOLUTE /end AXIS_DESCR
 /begin AXIS_DESCR STD_AXIS InjCtl_qCurr InjMassCyc 8 0.00 200.0000 FORMAT "%8.4" EXTENDED_LIMITS -327.6800 327.6700 DEPOSIT ABSOLUTE /end AXIS_DESCR
/end CHARACTERISTIC
/begin CHARACTERISTIC EGPp_stFlap_MAP "Exhaust Gas Pump status calculation map" MAP 0xD2A1E Kf_Xs16_Ys16_Ws16 1.000000 OneToOne 0.00 1.000000 FORMAT "%8.6" EXTENDED_LIMITS -32768.00 32767.00
 /begin AXIS_DESCR STD_AXIS Eng_nAvrg EngN 8 40.00000 6000.000 FORMAT "%8.3" EXTENDED_LIMITS -32768.00 32767.00 DEPOSIT ABSOLUTE /end AXIS_DESCR
 /begin AXIS_DESCR STD_AXIS InjCtl_qCurr InjMassCyc 8 0.00 200.0000 FORMAT "%8.4" EXTENDED_LIMITS -327.6800 327.6700 DEPOSIT ABSOLUTE /end AXIS_DESCR
/end CHARACTERISTIC
/begin CHARACTERISTIC EGPp_stMskRgn_C "Maske für Regenerationsumschaltung" VALUE 0xD2AC4 Kw_Wu32 4294967295.00 OneToOne 0.00 4294967295.00 FORMAT "%13.2" /end CHARACTERISTIC
/begin CHARACTERISTIC EGPp_swtDoubleSil_C "Schalter für System mit einem bzw. zwei Schalldämpfer" VALUE 0xD2CBC Kw_Wu8 1.000 OneToOne 0.00 1.000 FORMAT "%5.3" EXTENDED_LIMITS 0.00 255.0 /end CHARACTERISTIC
/begin CHARACTERISTIC EGPp_swtPresCalcMod_C "Schalter zur Auswahl zwischen dem Modell 1 und dem Modell 2 für die Auswertung des Abgasgegendrucks" VALUE 0xD2CBD Kw_Wu8 1.000 OneToOne 0.00 1.000 FORMAT "%5.3" EXTENDED_LIMITS 0.00 255.0 /end CHARACTERISTIC
/begin CHARACTERISTIC EGPp_swtPresCalc_C "Schalter für Druckberechnung (0-Kennfeld, 1- Simulation)" VALUE 0xD2CBE Kw_Wu8 1.000 OneToOne 0.00 1.000 FORMAT "%5.3" EXTENDED_LIMITS 0.00 255.0 /end CHARACTERISTIC
/begin MEASUREMENT AddPmp_volAddTot "eingespritzte Gesamtadditivmenge seit letzter Filterreinigung" SWORD volAdd_ml 1 100 -3276.800 3276.700 FORMAT "%8.3" ECU_ADDRESS 0x7F8AFC /end MEASUREMENT
/begin MEASUREMENT AirSys_pDesValSysTst "Ladedruck-Sollwert für Luftmassensystemtest" SWORD Pres_hPa 1 100 -32768.00 32767.00 FORMAT "%8.2" ECU_ADDRESS 0x7F8B2E /end MEASUREMENT
/begin MEASUREMENT AirSys_stPDesValSysTst "Status Anforderung für Ladedruck-Sollwertvorgabe für Luftmassensystemtest" UBYTE OneToOne 1 100 0.00 255.0 FORMAT "%5.1" ECU_ADDRESS 0x7F87D8 /end MEASUREMENT
/begin MEASUREMENT DCC_stActive "Radmoment-Anforderung aktiv" UBYTE OneToOne 1 100 0.00 255.0 FORMAT "%5.1" ECU_ADDRESS 0x7F8859 /end MEASUREMENT
/begin MEASUREMENT DfpErrCol_mp "Meßpunkt der für alle Fehlerpfade die Fehlerinformation gesammelt zur Verfügung stellt." UWORD OneToOne 1 100 0.00 65535.00 FORMAT "%8.2" ARRAY_SIZE 34 ECU_ADDRESS 0x6F8026 /end MEASUREMENT
/begin MEASUREMENT DFPM_stFCMChkCause "Message für DSM internen gebrauch (unterstützung bei DSM problemen)" UBYTE FCMChkCause 1 100 1.00000000000 15.0000000000 FORMAT "%13.10" ECU_ADDRESS 0x7FAF30 /end MEASUREMENT
/begin MEASUREMENT DfpZyfCol_mp "Meßpunkt der gesammelt für alle Fehlerpfade das Zyklus Bit (getested Info) zur Verfügung stellt." UWORD OneToOne 1 100 0.00 65535.00 FORMAT "%8.2" ARRAY_SIZE 34 ECU_ADDRESS 0x6F806A /end MEASUREMENT
/begin MEASUREMENT DSCHED_numDefDfpArray_mp "Array von defekten DFPs welche einen ausgewählten FID verriegeln" UWORD DfpName 1 100 0.00 524.000000000 FORMAT "%13.9" ARRAY_SIZE 10 ECU_ADDRESS 0x8FDEA8 /end MEASUREMENT
/begin MEASUREMENT DSCHED_numOkDfpArray_mp "Array von nicht defekten DFPs welche einen ausgewählten FID verriegeln" UWORD DfpName 1 100 0.00 524.000000000 FORMAT "%13.9" ARRAY_SIZE 20 ECU_ADDRESS 0x8FDEBC /end MEASUREMENT
/begin MEASUREMENT DSM_ctDfctPath "Anzahl der momentan defekten Fehlerpfade" UWORD OneToOne 1 100 0.00 65535.00 FORMAT "%8.2" ECU_ADDRESS 0x7F8C72 /end MEASUREMENT
/begin MEASUREMENT DSM_ctFcmEntry "Anzahl der belegten Fehlerspeichereinträge" UBYTE OneToOne 1 100 0.00 255.0 FORMAT "%5.1" ECU_ADDRESS 0x7F885C /end MEASUREMENT
/begin MEASUREMENT DSM_ctFCMEntrySize_mp "Größe eines Fehlerspeichereintrages in Bytes (Inklusive Füllbyte falls vorhanden)" UBYTE OneToOne 1 100 0.00 255.0 FORMAT "%5.1" ECU_ADDRESS 0x8FDEE4 /end MEASUREMENT
/begin MEASUREMENT DSM_ctOBDPath "Anzahl der momentanen OBD-fehler im Fehlerspeicher" UBYTE OneToOne 1 100 0.00 255.0 FORMAT "%5.1" ECU_ADDRESS 0x7F885D /end MEASUREMENT
/begin MEASUREMENT DSM_ctOBDValidPath "Anzahl bestätigter OBD relevanter Fehlerspeicher Einträge." UBYTE OneToOne 1 100 0.00 255.0 FORMAT "%5.1" ECU_ADDRESS 0x7F885E /end MEASUREMENT
/begin MEASUREMENT DSM_ctPath_mp "Anzahl der existierenden Fehlerpfade" UWORD OneToOne 1 100 0.00 65535.00 FORMAT "%8.2" ECU_ADDRESS 0x8FDEE6 /end MEASUREMENT
/begin MEASUREMENT DSM_ctRdyActCyc_mp "Status für jedes Readinessbit aus dem aktuellen driving cycle" UBYTE OneToOne 1 100 0.00 255.0 FORMAT "%5.1" ECU_ADDRESS 0x6F801C /end MEASUREMENT
/begin MEASUREMENT DSM_ctRdyCycCat_mp "Anzahl der für Readiness Bit Catalyst erreichten Zyklen." UBYTE OneToOne 1 100 0.00 255.0 FORMAT "%5.1" ECU_ADDRESS 0x8FDE8F /end MEASUREMENT
/begin MEASUREMENT DSM_ctRdyCycCompr_mp "Anzahl der für Readiness Bit Comprehensive Components erreichten Zyklen." UBYTE OneToOne 1 100 0.00 255.0 FORMAT "%5.1" ECU_ADDRESS 0x8FDE90 /end MEASUREMENT
/begin MEASUREMENT DSM_ctRdyCycEGR_mp "Anzahl der für Readiness Bit EGR erreichten Zyklen." UBYTE OneToOne 1 100 0.00 255.0 FORMAT "%5.1" ECU_ADDRESS 0x8FDE91 /end MEASUREMENT
/begin MEASUREMENT DSM_ctRdyCycFuel_mp "Anzahl der für Readiness Bit Fuel System erreichten Zyklen." UBYTE OneToOne 1 100 0.00 255.0 FORMAT "%5.1" ECU_ADDRESS 0x8FDE92 /end MEASUREMENT
/begin MEASUREMENT DSM_ctRdyCycMisf_mp "Anzahl der für Readiness Bit Misfire erreichten Zyklen." UBYTE OneToOne 1 100 0.00 255.0 FORMAT "%5.1" ECU_ADDRESS 0x8FDE93 /end MEASUREMENT
/begin MEASUREMENT DSM_ctRdyCycOxSenHt_mp "Anzahl erreichter Zyklen für Readiness Bit Oxygen Sensor Heater" UBYTE OneToOne 1 100 0.00 255.0 FORMAT "%5.1" ECU_ADDRESS 0x8FDE94 /end MEASUREMENT
/begin MEASUREMENT DSM_ctRdyCycOxSen_mp "Anzahl der erreichten Zyklen für Readiness Bit Oxygen Sensor" UBYTE OneToOne 1 100 0.00 255.0 FORMAT "%5.1" ECU_ADDRESS 0x8FDE95 /end MEASUREMENT
/begin MEASUREMENT DSM_ctRdyLimCat_mp "Notwendige Anzahl Zyklen für Readiness Bit Catalyst." UBYTE OneToOne 1 100 0.00 255.0 FORMAT "%5.1" ECU_ADDRESS 0x8FDE96 /end MEASUREMENT
/begin MEASUREMENT DSM_ctRdyLimCompr_mp "Notwendige Anzahl Zyklen für Readiness Bit Comprehensive Components." UBYTE OneToOne 1 100 0.00 255.0 FORMAT "%5.1" ECU_ADDRESS 0x8FDE97 /end MEASUREMENT
/begin MEASUREMENT DSM_ctRdyLimEGR_mp "Notwendige Anzahl Zyklen für Readiness Bit EGR." UBYTE OneToOne 1 100 0.00 255.0 FORMAT "%5.1" ECU_ADDRESS 0x8FDE98 /end MEASUREMENT
/begin MEASUREMENT DSM_ctRdyLimFuel_mp "Notwendige Anzahl Zyklen für Readiness Bit Fuel System." UBYTE OneToOne 1 100 0.00 255.0 FORMAT "%5.1" ECU_ADDRESS 0x8FDE99 /end MEASUREMENT
/begin MEASUREMENT DSM_ctRdyLimMisf_mp "Notwendige Anzahl Zyklen für Readiness Bit Misfire." UBYTE OneToOne 1 100 0.00 255.0 FORMAT "%5.1" ECU_ADDRESS 0x8FDE9A /end MEASUREMENT
/begin MEASUREMENT DSM_ctRdyLimOxSenHt_mp "Notwendige Anzahl von Zyklen für Readiness Bit Oxygen Sensor Heater" UBYTE OneToOne 1 100 0.00 255.0 FORMAT "%5.1" ECU_ADDRESS 0x8FDE9B /end MEASUREMENT
/begin MEASUREMENT DSM_ctRdyLimOxSen_mp "Notwendige Anzahl Zyklen für Readiness Bit Oxygen Sensor" UBYTE OneToOne 1 100 0.00 255.0 FORMAT "%5.1" ECU_ADDRESS 0x8FDE9C /end MEASUREMENT
/begin MEASUREMENT DSM_ctRdyPathsCat_mp "Anzahl von Fehlerpfaden die zum Readiness Bit Catalyst gehören." UBYTE OneToOne 1 100 0.00 255.0 FORMAT "%5.1" ECU_ADDRESS 0x8FDE9D /end MEASUREMENT
/begin MEASUREMENT DSM_ctRdyPathsCompr_mp "Anzahl von Fehlerpfaden die zum Readiness Bit Comprehensive Components gehören." UBYTE OneToOne 1 100 0.00 255.0 FORMAT "%5.1" ECU_ADDRESS 0x8FDE9E /end MEASUREMENT
/begin MEASUREMENT DSM_ctRdyPathsEGR_mp "Anzahl von Fehlerpfaden die zum Readiness Bit EGR gehören." UBYTE OneToOne 1 100 0.00 255.0 FORMAT "%5.1" ECU_ADDRESS 0x8FDE9F /end MEASUREMENT
/begin MEASUREMENT DSM_ctRdyPathsFuel_mp "Anzahl von Fehlerpfaden die zum Readiness Bit Fuel System gehören." UBYTE OneToOne 1 100 0.00 255.0 FORMAT "%5.1" ECU_ADDRESS 0x8FDEA0 /end MEASUREMENT
/begin MEASUREMENT DSM_ctRdyPathsMisf_mp "Anzahl von Fehlerpfaden die zum Readiness Bit Misfire gehören." UBYTE OneToOne 1 100 0.00 255.0 FORMAT "%5.1" ECU_ADDRESS 0x8FDEA1 /end MEASUREMENT
/begin MEASUREMENT DSM_ctRdyPathsOxSenHt_mp "Anzahl von Fehlerpfaden, die zum Readiness Bit Oxygen Sensor Heater gehören" UBYTE OneToOne 1 100 0.00 255.0 FORMAT "%5.1" ECU_ADDRESS 0x8FDEA2 /end MEASUREMENT
/begin MEASUREMENT DSM_ctRdyPathsOxSen_mp "Anzahl der Fehlerpfade die zum Readiness Bit Oxygen Sensor gehören" UBYTE OneToOne 1 100 0.00 255.0 FORMAT "%5.1" ECU_ADDRESS 0x8FDEA3 /end MEASUREMENT
/begin MEASUREMENT DSM_ctRdyTstCat_mp "Anzahl von in diesem Zyklus getesteten Fehlerpfaden die zum Readiness Bit Catalyst gehören." UBYTE OneToOne 1 100 0.00 255.0 FORMAT "%5.1" ECU_ADDRESS 0x8FDEA4 /end MEASUREMENT
/begin MEASUREMENT DSM_ctRdyTstCompr_mp "Anzahl von in diesem Zyklus getesteten Fehlerpfaden die zum Readiness Bit Comprehensive Components  gehören." UBYTE OneToOne 1 100 0.00 255.0 FORMAT "%5.1" ECU_ADDRESS 0x6F801E /end MEASUREMENT
/begin MEASUREMENT DSM_ctRdyTstEGR_mp "Anzahl von in diesem Zyklus getesteten Fehlerpfaden die zum Readiness Bit EGR gehören." UBYTE OneToOne 1 100 0.00 255.0 FORMAT "%5.1" ECU_ADDRESS 0x6F8020 /end MEASUREMENT
/begin MEASUREMENT DSM_ctRdyTstFuel_mp "Anzahl von in diesem Zyklus getesteten Fehlerpfaden die zum Readiness Bit Fuel System gehören." UBYTE OneToOne 1 100 0.00 255.0 FORMAT "%5.1" ECU_ADDRESS 0x6F8022 /end MEASUREMENT
/begin MEASUREMENT DSM_ctRdyTstMisf_mp "Anzahl von in diesem Zyklus getesteten Fehlerpfaden die zum Readiness Bit Misfire  gehören." UBYTE OneToOne 1 100 0.00 255.0 FORMAT "%5.1" ECU_ADDRESS 0x6F8024 /end MEASUREMENT
/begin MEASUREMENT DSM_ctRdyTstOxSenHt_mp "Anzahl von in diesem Zyklus getesteten Fehlerpfaden die zum Readiness Bit Oxygen Sensor Heater gehören." UBYTE OneToOne 1 100 0.00 255.0 FORMAT "%5.1" ECU_ADDRESS 0x8FDEA5 /end MEASUREMENT
/begin MEASUREMENT DSM_ctRdyTstOxSen_mp "Anzahl von in diesem Zyklus getesteten Fehlerpfaden die zum Readiness Bit Oxygen Sensor Heater gehören." UBYTE OneToOne 1 100 0.00 255.0 FORMAT "%5.1" ECU_ADDRESS 0x8FDEA6 /end MEASUREMENT
/begin MEASUREMENT DSM_ctTstPath "Anzahl der getesteten Fehlerpfade" UWORD OneToOne 1 100 0.00 65535.00 FORMAT "%8.2" ECU_ADDRESS 0x7F8C74 /end MEASUREMENT
/begin MEASUREMENT DSM_ctWUC "Anzahl der Warm Up Cycle seit dem letzten Fehlerspeicherlöschen  (PID $30)" UBYTE OneToOne 1 100 0.00 255.0 FORMAT "%5.1" ECU_ADDRESS 0x7FEF30 /end MEASUREMENT
/begin MEASUREMENT DSM_lDist "Anzahl der gefahrenen Strecke seitdem letzten Fehlerspeicherlöschen (PID $31)" UWORD OneToOne 1 100 0.00 65535.00 FORMAT "%8.2" ECU_ADDRESS 0x7FEF32 /end MEASUREMENT
/begin MEASUREMENT DSM_stCycles "Status der DSM Trigger Zyklen (WUC, DC, ...)" UBYTE OneToOne 1 100 0.00 255.0 FORMAT "%5.1" ECU_ADDRESS 0x7F885F /end MEASUREMENT
/begin MEASUREMENT DSM_stECUMasterSlave "Statusinformation ob das Steuergerät ein Master- oder ein Slave-Steuergerät ist" UBYTE OneToOne 1 100 0.00 255.0 FORMAT "%5.1" ECU_ADDRESS 0x7F8860 /end MEASUREMENT
/begin MEASUREMENT DSM_stInhDelay "Status Fehlerverriegelungs Verzögerung (1 wenn mindestens 1 Verzögerung aktiv)" UBYTE OneToOne 1 100 0.00 255.0 FORMAT "%5.1" ECU_ADDRESS 0x7F8861 /end MEASUREMENT
/begin MEASUREMENT DSM_stMIL "DSM Mil Anforderungsstatus (1 = kontinuierlich, 2 blinkend)" UBYTE OneToOne 1 100 0.00 255.0 FORMAT "%5.1" ECU_ADDRESS 0x7F8862 /end MEASUREMENT
/begin MEASUREMENT DSM_stPID41 "Readiness Status für Diagnoseschnittstelle gemäß ISO/DIS 15031-6.5, PID41" ULONG OneToOne 1 100 0.00 4294967295.00 FORMAT "%13.2" ECU_ADDRESS 0x7F938C /end MEASUREMENT
/begin MEASUREMENT DSM_stRdyAB "Readiness Status für Diagnoseschnittstelle gemäß SAE J1979 PID1 Byte A + B" UWORD OneToOne 1 100 0.00 65535.00 FORMAT "%8.2" ECU_ADDRESS 0x7F8C76 /end MEASUREMENT
/begin MEASUREMENT DSM_stRdyCD "Readiness Status für Diagnoseschnittstelle gemäß SAE J1979 PID1 Byte C * D" UWORD OneToOne 1 100 0.00 65535.00 FORMAT "%8.2" ECU_ADDRESS 0x7F8C78 /end MEASUREMENT
/begin MEASUREMENT DSM_stRdyCheckEnable "veroderte ready-bits der dfps, die durch die Funktion DSM_SetDfpSleep ermittelt wurden" UBYTE OneToOne 1 100 0.00 255.0 FORMAT "%5.1" ECU_ADDRESS 0x7F8863 /end MEASUREMENT
/begin MEASUREMENT DSM_stSysLamp "DSM System Lampen Anforderungsstatus (1 = kontinuierlich)" UBYTE OneToOne 1 100 0.00 255.0 FORMAT "%5.1" ECU_ADDRESS 0x7F8864 /end MEASUREMENT
/begin MEASUREMENT DSM_tiDCDelay_mp "aktuelle Zeit für Driving cycle Verzögerungszeit" UWORD OneToOne 1 100 0.00 65535.00 FORMAT "%8.2" ECU_ADDRESS 0x6F80AE /end MEASUREMENT
/begin MEASUREMENT EATSCD_stValid "" UBYTE OneToOne 1 100 0.00 255.0 FORMAT "%5.1" ECU_ADDRESS 0x7F8865 /end MEASUREMENT
/begin MEASUREMENT EATSCD_swtSig "Signalquelle Umgebungstemperatur (ADC oder CAN)" UBYTE OneToOne 1 100 0.00 255.0 FORMAT "%5.1" ECU_ADDRESS 0x7F8866 /end MEASUREMENT
/begin MEASUREMENT EATSCD_tAir "Umgebungstemperatur" SWORD Temp_Cels 1 100 -50.140 899.860 FORMAT "%8.3" ECU_ADDRESS 0x7F8C7E /end MEASUREMENT
/begin MEASUREMENT EATSCD_tAirLin "linearisierter Wert der Umgebungstemperatur" SWORD Temp_Cels 1 100 -50.140 899.860 FORMAT "%8.3" ECU_ADDRESS 0x7F8C80 /end MEASUREMENT
/begin MEASUREMENT EATSCD_uRaw "Spannungsrohwert der Umgebungstemperatur" SWORD Volt 1 100 0.00 5000.000 FORMAT "%8.3" ECU_ADDRESS 0x7F8C82 /end MEASUREMENT
/begin MEASUREMENT EBAFCD_stSigOut "source of activation for electrical power stage of EBAFCD output" UBYTE OneToOne 1 100 0.00 255.0 FORMAT "%5.1" ECU_ADDRESS 0x7F8867 /end MEASUREMENT
/begin MEASUREMENT EBAFCD_st_mp "Status of Engine Bay Air Flap" UBYTE OneToOne 1 100 0.00 255.0 FORMAT "%5.1" ECU_ADDRESS 0x8FDF1C /end MEASUREMENT
/begin MEASUREMENT EBFCD_stOut "status output of EBFCD" UBYTE OneToOne 1 100 0.00 255.0 FORMAT "%5.1" ECU_ADDRESS 0x7F8868 /end MEASUREMENT
/begin MEASUREMENT EBFCD_st_mp "Status of output of EBFCD" UBYTE OneToOne 1 100 0.00 255.0 FORMAT "%5.1" ECU_ADDRESS 0x8FDF1D /end MEASUREMENT
/begin MEASUREMENT EBTSCD_tCIntLin "ECU temperature linearized value" SWORD Temp_Cels 1 100 -50.140 899.860 FORMAT "%8.3" ECU_ADDRESS 0x7F8C84 /end MEASUREMENT
/begin MEASUREMENT EBTSCD_tECU "ECU temperature current value" SWORD Temp_Cels 1 100 -50.140 899.860 FORMAT "%8.3" ECU_ADDRESS 0x7F8C86 /end MEASUREMENT
/begin MEASUREMENT EBTSCD_uRawTECU_mp "Raw sensor voltage" SWORD Volt 1 100 -160156.4 160151.5 FORMAT "%8.1" ECU_ADDRESS 0x8FDF1E /end MEASUREMENT
/begin MEASUREMENT EEPCD_stErrSet "Allgemeiner Fehlerzustand bei der Aktivierung einer Konfiguration" UBYTE OneToOne 1 100 0.00 255.0 FORMAT "%5.1" ECU_ADDRESS 0x7F8869 /end MEASUREMENT
/begin MEASUREMENT EEPCD_stMIL "Variant manager default status of MIL lamp" UBYTE OneToOne 1 100 0.00 255.0 FORMAT "%5.1" ECU_ADDRESS 0x7F886A /end MEASUREMENT
/begin MEASUREMENT EGPpCD_stActrOut "status of exhaust gas pressure pipe actuator" UBYTE OneToOne 1 100 0.00 255.0 FORMAT "%5.1" ECU_ADDRESS 0x7F886B /end MEASUREMENT
/begin MEASUREMENT EGPpCD_stActrOut_mp "EGPpCD output value" UBYTE OneToOne 1 100 0.00 255.0 FORMAT "%5.1" ECU_ADDRESS 0x8FDF34 /end MEASUREMENT
/begin MEASUREMENT EGPpCD_tPreTrbn "Abgastemperatur vor Abgasturbolader" SWORD Temp_Cels 1 100 -50.140 899.860 FORMAT "%8.3" ECU_ADDRESS 0x7F8C88 /end MEASUREMENT
/begin MEASUREMENT EGPpCD_tPreTrbnB1 "Abgastemperatur vor Abgasturbolader für Bank1" SWORD Temp_Cels 1 100 -50.140 899.860 FORMAT "%8.3" ECU_ADDRESS 0x7F8C8A /end MEASUREMENT
/begin MEASUREMENT EGPpCD_tPreTrbnB2 "Abgastemperatur vor Abgasturbolader für Bank2" SWORD Temp_Cels 1 100 -50.140 899.860 FORMAT "%8.3" ECU_ADDRESS 0x7F8C8C /end MEASUREMENT
/begin MEASUREMENT EGPp_dmEG_mp "Abgasmassenstrom" SWORD AirMassPerTime 1 100 -3276.800 3276.700 FORMAT "%8.3" ECU_ADDRESS 0x8FDF20 /end MEASUREMENT
/begin MEASUREMENT EGPp_dvolSilB1_mp "Abgasvolumenstrom nach Partikelfilter Bank 1" SWORD CubMtrPerHr 1 100 -3276.800 3276.700 FORMAT "%8.3" ECU_ADDRESS 0x8FDF22 /end MEASUREMENT
/begin MEASUREMENT EGPp_dvolSilB2_mp "Abgasvolumenstrom nach Partikelfilter Bank 2" SWORD CubMtrPerHr 1 100 -3276.800 3276.700 FORMAT "%8.3" ECU_ADDRESS 0x8FDF24 /end MEASUREMENT
/begin MEASUREMENT EGPp_dvolSilBnk_mp "Abgasvolumenstrom nach Partikelfilter" SWORD CubMtrPerHr 1 100 -3276.800 3276.700 FORMAT "%8.3" ECU_ADDRESS 0x8FDF26 /end MEASUREMENT
/begin MEASUREMENT EGPp_pPstPFltB1 "Druckabfall des Abgassystems nach Partikelfilter fur Bank1." SWORD Pres_hPa 1 100 -32768.00 32767.00 FORMAT "%8.2" ECU_ADDRESS 0x7F8C8E /end MEASUREMENT
/begin MEASUREMENT EGPp_pPstPFltB2 "Druckabfall des Abgassystems nach Partikelfilter fur Bank2." SWORD Pres_hPa 1 100 -32768.00 32767.00 FORMAT "%8.2" ECU_ADDRESS 0x7F8C90 /end MEASUREMENT
/begin MEASUREMENT EGPp_pPstPFltMapB1_mp "Druckabfall nach Partikelfilter aus Kennfeldberechnung Bank 1" SWORD Pres_hPa 1 100 -32768.00 32767.00 FORMAT "%8.2" ECU_ADDRESS 0x8FDF28 /end MEASUREMENT
/begin MEASUREMENT EGPp_pPstPFltMapB2_mp "Druckabfall nach Partikelfilter aus Kennfeldberechnung Bank 2" SWORD Pres_hPa 1 100 -32768.00 32767.00 FORMAT "%8.2" ECU_ADDRESS 0x8FDF2A /end MEASUREMENT
/begin MEASUREMENT EGPp_pPstPFltSimB1_mp "Druckabfall nach Partikelfilter aus Simulation Bank 1" SWORD Pres_hPa 1 100 -32768.00 32767.00 FORMAT "%8.2" ECU_ADDRESS 0x8FDF2C /end MEASUREMENT
/begin MEASUREMENT EGPp_pPstPFltSimB2_mp "Druckabfall nach Partikelfilter aus Simulation Bank 2" SWORD Pres_hPa 1 100 -32768.00 32767.00 FORMAT "%8.2" ECU_ADDRESS 0x8FDF2E /end MEASUREMENT
/begin MEASUREMENT EGPp_stLogicOut "Status of Exhaust gas pressure pump" UBYTE OneToOne 1 100 0.00 255.0 FORMAT "%5.1" ECU_ADDRESS 0x7F886C /end MEASUREMENT
/begin MEASUREMENT EGPp_tPstSimBnk_mp "Simulierte Temperatur nach Partikelfilter" SWORD Temp_Cels 1 100 -50.140 899.860 FORMAT "%8.3" ECU_ADDRESS 0x8FDF30 /end MEASUREMENT
/begin MEASUREMENT EGPp_tSurf_mp "Oberflächen Temperatur vom Partikel Filter" SWORD Temp_Cels 1 100 -50.140 899.860 FORMAT "%8.3" ECU_ADDRESS 0x8FDF32 /end MEASUREMENT
/begin MEASUREMENT EGT_tOutrDesInTempGvnrB1 "Kundenspezifischer Temperaturvorgabewert des äußeren Reglers Bank 1" SWORD Temp_Cels 1 100 -50.140 899.860 FORMAT "%8.3" ECU_ADDRESS 0x7F8CFC /end MEASUREMENT
/begin MEASUREMENT EGT_tOutrDesInTempGvnrB2 "Kundenspezifischer Temperaturvorgabewert des äußeren Reglers Bank 2" SWORD Temp_Cels 1 100 -50.140 899.860 FORMAT "%8.3" ECU_ADDRESS 0x7F8CFE /end MEASUREMENT
/begin MEASUREMENT FidCol_mp "Meßpunkt der gesammelt den Zustand aller Funktionsidentifier (Fid) zur Verfügung stellt." UWORD OneToOne 1 100 0.00 65535.00 FORMAT "%8.2" ARRAY_SIZE 24 ECU_ADDRESS 0x8FDEE8 /end MEASUREMENT
/begin MEASUREMENT FlMng_qFullLdRgl "Korrekturmenge der Volllastregelung" SWORD InjMass 1 100 -327.6800 327.6700 FORMAT "%8.4" ECU_ADDRESS 0x7F8D8C /end MEASUREMENT
/begin MEASUREMENT Lub_nMin "Drehzahlforderung Minimalwert für Schmierung" SWORD EngN 1 100 -32768.00 32767.00 FORMAT "%8.2" ECU_ADDRESS 0x7F90B4 /end MEASUREMENT
/begin MEASUREMENT OxiCCD_tPstB1 "Abgastemperatur vor Oxidationskatalysator Bank1" SWORD Temp_Cels 1 100 -50.140 899.860 FORMAT "%8.3" ECU_ADDRESS 0x7F90F8 /end MEASUREMENT
/begin MEASUREMENT OxiCCD_tPstB2 "Abgastemperatur vor Oxidationskatalysator Bank2" SWORD Temp_Cels 1 100 -50.140 899.860 FORMAT "%8.3" ECU_ADDRESS 0x7F90FA /end MEASUREMENT
/begin MEASUREMENT PCR_rGvnrLP2 "Das Verhältnis 2 des Ventilhubes aus dem PCR-Ausgleichsregler" SWORD Prc 1 100 -400.0000 399.9878 FORMAT "%8.4" ECU_ADDRESS 0x7F9140 /end MEASUREMENT
/begin MEASUREMENT PFltCD_pDiffB1 "Differenzdruck über Partikelfilter für Bank1" SWORD Pres_hPa 1 100 -32768.00 32767.00 FORMAT "%8.2" ECU_ADDRESS 0x7F9154 /end MEASUREMENT
/begin MEASUREMENT PFltCD_pDiffB2 "Differenzdruck über Partikelfilter  für Bank2" SWORD Pres_hPa 1 100 -32768.00 32767.00 FORMAT "%8.2" ECU_ADDRESS 0x7F9156 /end MEASUREMENT
/begin MEASUREMENT PFltCD_tPst "Abgastemperatur hinter dem Partikelfilter" SWORD Temp_Cels 1 100 -50.140 899.860 FORMAT "%8.3" ECU_ADDRESS 0x7F916A /end MEASUREMENT
/begin MEASUREMENT PFltCD_tPstB1 "Abgastemperatur hinter dem Partikelfilter für Bank1" SWORD Temp_Cels 1 100 -50.140 899.860 FORMAT "%8.3" ECU_ADDRESS 0x7F916C /end MEASUREMENT
/begin MEASUREMENT PFltCD_tPstB2 "Abgastemperatur hinter dem Partikelfilter für Bank2" SWORD Temp_Cels 1 100 -50.140 899.860 FORMAT "%8.3" ECU_ADDRESS 0x7F916E /end MEASUREMENT
/begin MEASUREMENT Uhwe_ctAtomicLvl_mp "Interrupt Lock Level" ULONG OneToOne 1 100 0.00 4294967295.00 FORMAT "%13.2" ECU_ADDRESS 0x8FDF18 /end MEASUREMENT
/begin FUNCTION dsm_auto_tsf ""
 /begin DEF_CHARACTERISTIC DSM_TsfDfp_Layer_TANS_C DSM_TsfDfp_ACCDSwtin_C DSM_TsfDfp_ACC_PlausTrqDes_C DSM_TsfDfp_ACC_trqInr_C DSM_TsfDfp_ACTrq_C DSM_TsfDfp_ADCMon_C DSM_TsfDfp_AFSCDIdlAdjVal_C DSM_TsfDfp_AFSCDLdAdjVal_C DSM_TsfDfp_AFSCDPlAirPerCylDif_C DSM_TsfDfp_AFSCD_AirTempDcyc_C DSM_TsfDfp_AFSCD_AirTempDcyc2_C DSM_TsfDfp_AFSCD_PlOffsDrft_C DSM_TsfDfp_AFSCD_PlOffsDrft2_C DSM_TsfDfp_AFSCD_PlSetyDrft_C DSM_TsfDfp_AFSCD_SRCAirTemp_C DSM_TsfDfp_AFSCD_SRCAirTemp2_C DSM_TsfDfp_AFSCD_SRCBatt_C DSM_TsfDfp_AFSCD_SRCBatt2_C DSM_TsfDfp_AFSCD_SRCCorrAirm_C DSM_TsfDfp_Layer_TUMG_C DSM_TsfDfp_AFSCD_SRCCorrAirm2_C DSM_TsfDfp_AFSCD_SRCRawAirm_C DSM_TsfDfp_Layer_GEN_C DSM_TsfDfp_Layer_BSD_C DSM_TsfDfp_AFSCD_SRCRawAirm2_C DSM_TsfDfp_AFSCD_SRCRefSigPer_C DSM_TsfDfp_AFSCD_SRCRefSigPer2_C DSM_TsfDfp_AOHtCD_C DSM_TsfDfp_AOHtCD_AOHtDia1_C DSM_TsfDfp_AOHtCD_AOHtDia2_C DSM_TsfDfp_AOHtCD_AOHtDia3_C DSM_TsfDfp_APP1_C DSM_TsfDfp_APP2_C DSM_TsfDfp_APPCDCmpd_C DSM_TsfDfp_Layer_QLT_C DSM_TsfDfp_APPSync_C DSM_TsfDfp_Layer_IBS1_C DSM_TsfDfp_Layer_IBS2_C DSM_TsfDfp_Layer_IBS3_C DSM_TsfDfp_Layer_PMBN_C DSM_TsfDfp_Layer_PMBATT_C DSM_TsfDfp_APSCD_C DSM_TsfDfp_ARS_C DSM_TsfDfp_AccPedPlausBrk_C DSM_TsfDfp_AddPCDTnkLvl_C DSM_TsfDfp_AirCtlGvnrDvtRgnMax_C DSM_TsfDfp_AirCtlGvnrDvtRgnMin_C DSM_TsfDfp_AirCtlGvnrDvtRgnMn2_C DSM_TsfDfp_AirCtlGvnrDvtRgnMx2_C DSM_TsfDfp_AirCtlPlateBreak_C DSM_TsfDfp_AirCtlRmpTO_C DSM_TsfDfp_AirCtl_GovNegDev_C DSM_TsfDfp_AirCtl_GovNegDev2_C DSM_TsfDfp_AirCtl_GovPosDev_C DSM_TsfDfp_AirCtl_GovPosDev2_C DSM_TsfDfp_AltCD_C DSM_TsfDfp_BPACD_BPADia1_C DSM_TsfDfp_BPACD_BPADia1v2_C DSM_TsfDfp_BPACD_BPADia2_C DSM_TsfDfp_BPACD_BPADia2v2_C DSM_TsfDfp_BPACD_BPADia3_C DSM_TsfDfp_BPACD_BPADia3v2_C DSM_TsfDfp_BPACD_BPADia4_C DSM_TsfDfp_BPACD_BPADia4v2_C DSM_TsfDfp_BPACD_Max_C DSM_TsfDfp_BPACD_Max2_C DSM_TsfDfp_BPACD_Min_C DSM_TsfDfp_BPACD_Min2_C DSM_TsfDfp_BPACD_SigNpl_C DSM_TsfDfp_BPACD_SigNpl2_C DSM_TsfDfp_BPSCD_C DSM_TsfDfp_BattCD_C DSM_TsfDfp_BrkCD_C DSM_TsfDfp_Layer_PMRUHVERL_C DSM_TsfDfp_Bss_C DSM_TsfDfp_CBACD_C DSM_TsfDfp_CTSCD_C DSM_TsfDfp_Clg_DynTst_C DSM_TsfDfp_Layer_TOENS_C DSM_TsfDfp_Layer_MANHYDR_C DSM_TsfDfp_Layer_MANLUFT_C DSM_TsfDfp_CmbChbMisfire1_C DSM_TsfDfp_CmbChbMisfire2_C DSM_TsfDfp_CmbChbMisfire3_C DSM_TsfDfp_CmbChbMisfire4_C DSM_TsfDfp_CmbChbMisfire5_C DSM_TsfDfp_CmbChbMisfire6_C DSM_TsfDfp_CmbChbMisfire7_C DSM_TsfDfp_CmbChbMisfire8_C DSM_TsfDfp_CmbChbMisfireMul_C DSM_TsfDfp_CoDT_TRQ_Des_C DSM_TsfDfp_CoDT_TRQ_Lead_C DSM_TsfDfp_CoEng_GbxRpmRduc_C DSM_TsfDfp_CoVMDCSh_C DSM_TsfDfp_ConvCD_C DSM_TsfDfp_CrCCDMFL_C DSM_TsfDfp_CrCtl_vCrCtl_C DSM_TsfDfp_EATSCD_C DSM_TsfDfp_EBAFCD_C DSM_TsfDfp_EBFCD_C DSM_TsfDfp_EBTSCD_C DSM_TsfDfp_EBTSCD_OvrTemp_C DSM_TsfDfp_EEPCDVarMng_C DSM_TsfDfp_EGPpCD_C DSM_TsfDfp_EGRCD_Max_C DSM_TsfDfp_EGRCD_Max2_C DSM_TsfDfp_EGRCD_Min_C DSM_TsfDfp_EGRCD_Min2_C DSM_TsfDfp_EGRCD_PWMInDia1_C DSM_TsfDfp_EGRCD_PWMInDia2_C DSM_TsfDfp_EGRCD_PWMInDia21_C DSM_TsfDfp_EGRCD_PWMInDia22_C DSM_TsfDfp_EGRCD_PWMInDia23_C DSM_TsfDfp_EGRCD_PWMInDia24_C DSM_TsfDfp_EGRCD_PWMInDia3_C DSM_TsfDfp_EGRCD_PWMInDia4_C DSM_TsfDfp_EGRCD_SigDia_C DSM_TsfDfp_EGRCD_SigDia2_C DSM_TsfDfp_EGRCD_SigNpl_C DSM_TsfDfp_EGRCD_SigNpl2_C DSM_TsfDfp_EGTOilLvlCrit_C DSM_TsfDfp_EGTOilVscCrit_C DSM_TsfDfp_EGTRgnOilDil_C DSM_TsfDfp_EGTTempGvnrInrB1_C DSM_TsfDfp_EGTTempGvnrInrB2_C DSM_TsfDfp_EGTTempGvnrOutrB1_C DSM_TsfDfp_EGTTempGvnrOutrB2_C DSM_TsfDfp_ETClbETFltInj1_C DSM_TsfDfp_ETClbETFltInj2_C DSM_TsfDfp_ETClbETFltInj3_C DSM_TsfDfp_ETClbETFltInj4_C DSM_TsfDfp_ETClbETFltInj5_C DSM_TsfDfp_ETClbETFltInj6_C DSM_TsfDfp_ETClbETFltInj7_C DSM_TsfDfp_ETClbETFltInj8_C DSM_TsfDfp_ETClbInj1_C DSM_TsfDfp_ETClbInj2_C DSM_TsfDfp_ETClbInj3_C DSM_TsfDfp_ETClbInj4_C DSM_TsfDfp_ETClbInj5_C DSM_TsfDfp_ETClbInj6_C DSM_TsfDfp_ETClbInj7_C DSM_TsfDfp_ETClbInj8_C DSM_TsfDfp_EngMCaS1_C DSM_TsfDfp_EngMCrS1_C DSM_TsfDfp_EngMOfsCaSCrS_C DSM_TsfDfp_EngMntCtlCD_C DSM_TsfDfp_FBCqDvt_C DSM_TsfDfp_FMAErrMod_C DSM_TsfDfp_FMTC_NonMonotonMap_C DSM_TsfDfp_FTSCD_C DSM_TsfDfp_FanCD_C DSM_TsfDfp_FanCD_FanCtlr1_C DSM_TsfDfp_FanCD_FanCtlr2_C DSM_TsfDfp_FanCD_FanCtlr3_C DSM_TsfDfp_FlFCD_C DSM_TsfDfp_FlMngSmkDefect_C DSM_TsfDfp_FlSCDT1_C DSM_TsfDfp_FrmMngANFRADMOMPT_C DSM_TsfDfp_FrmMngASC1_C DSM_TsfDfp_FrmMngASC2_C DSM_TsfDfp_FrmMngASC3_C DSM_TsfDfp_FrmMngASC4_C DSM_TsfDfp_FrmMngBOS_RESET_C DSM_TsfDfp_FrmMngBOS_RESET2_C DSM_TsfDfp_FrmMngDMANFAFS_C DSM_TsfDfp_FrmMngDRMANFSSG_C DSM_TsfDfp_FrmMngEGS1_C DSM_TsfDfp_FrmMngEGS2_C DSM_TsfDfp_FrmMngGEARBX_DATA_C DSM_TsfDfp_FrmMngGEARBX_DATA2_C DSM_TsfDfp_FrmMngHEAT_AC_C DSM_TsfDfp_FrmMngINSTR2_C DSM_TsfDfp_FrmMngINSTR3_C DSM_TsfDfp_FrmMngLENKRADWINKEL_C DSM_TsfDfp_FrmMngMILEAGE_RANGE_C DSM_TsfDfp_FrmMngMSPHISYNC_C DSM_TsfDfp_FrmMngMST4_C DSM_TsfDfp_FrmMngMST5_C DSM_TsfDfp_FrmMngOPCRCTLACC_C DSM_TsfDfp_FrmMngPRGG_CCTR_C DSM_TsfDfp_FrmMngPWRMNG_LOADV_C DSM_TsfDfp_FrmMngParkConsumer_C DSM_TsfDfp_FrmMngRQSTGEFAN_C DSM_TsfDfp_FrmMngSLV4_C DSM_TsfDfp_FrmMngSLV5_C DSM_TsfDfp_FrmMngSSGErr_C DSM_TsfDfp_FrmMngSSGShOff_C DSM_TsfDfp_FrmMngSTAT_ANH_C DSM_TsfDfp_FrmMngSTAT_ARS_C DSM_TsfDfp_FrmMngSTAT_DSC_C DSM_TsfDfp_FrmMngSTAT_EKP_C DSM_TsfDfp_FrmMngSTAT_KOMBI_C DSM_TsfDfp_FrmMngSTAT_SITZ_C DSM_TsfDfp_FrmMngStOBDGbxMilOf_C DSM_TsfDfp_FrmMngStOBDGbxMilOn_C DSM_TsfDfp_FrmMngTEMPRELTIME_C DSM_TsfDfp_FrmMngTERMINAL_C DSM_TsfDfp_FrmMngTIME_DATE_C DSM_TsfDfp_FrmMngTORQUE_DSC_C DSM_TsfDfp_FrmMngTORQUE_GEARBX_C DSM_TsfDfp_FrmMngTrq_ReqACC_C DSM_TsfDfp_FrmMngVEH_MOD_C DSM_TsfDfp_FrmMngVELOCITY_C DSM_TsfDfp_FrmMngWHEEL_SPEED_C DSM_TsfDfp_FrmMngstCurr_C DSM_TsfDfp_FrmMngswtPSPOff_C DSM_TsfDfp_GearbxIncMax_C DSM_TsfDfp_GlwCD_C DSM_TsfDfp_GlwCDGlwCirc1_C DSM_TsfDfp_GlwCDGlwCirc2_C DSM_TsfDfp_GlwCDGlwCirc3_C DSM_TsfDfp_GlwCDGlwCirc4_C DSM_TsfDfp_GlwCDGlwCirc5_C DSM_TsfDfp_GlwCDGlwCirc6_C DSM_TsfDfp_GlwCDGlwCirc7_C DSM_TsfDfp_GlwCDGlwCirc8_C DSM_TsfDfp_GlwCtl_C DSM_TsfDfp_HWEMonCom_C DSM_TsfDfp_HWEMonEEPROM_C DSM_TsfDfp_HWEMonRcyLocked_C DSM_TsfDfp_HWEMonRcySuppressed_C DSM_TsfDfp_HWEMonRcyVisible_C DSM_TsfDfp_HWEMonUMaxSupply_C DSM_TsfDfp_HWEMonUMinSupply_C DSM_TsfDfp_IATSCD_C DSM_TsfDfp_IATSCD_CATS_C DSM_TsfDfp_IATSCD_CATSSec_C DSM_TsfDfp_ImmCtlImmCD_C DSM_TsfDfp_ImmCtlImmEep_C DSM_TsfDfp_ImmCtlMpl_C DSM_TsfDfp_IndSys1_C DSM_TsfDfp_IndSys2_C DSM_TsfDfp_InjCrv_InjLim_C DSM_TsfDfp_InjCtlAdjQnt_C DSM_TsfDfp_InjCtlDrift_C DSM_TsfDfp_InjVCDActrChrg_C DSM_TsfDfp_InjVCDActrEnrg1_C DSM_TsfDfp_InjVCDActrEnrg2_C DSM_TsfDfp_InjVCDActrEnrg3_C DSM_TsfDfp_InjVCDActrEnrg4_C DSM_TsfDfp_InjVCDActrEnrg5_C DSM_TsfDfp_InjVCDActrEnrg6_C DSM_TsfDfp_InjVCDActrEnrg7_C DSM_TsfDfp_InjVCDActrEnrg8_C DSM_TsfDfp_InjVCDActrVolt_C DSM_TsfDfp_InjVCDClsBank1_C DSM_TsfDfp_InjVCDClsBank2_C DSM_TsfDfp_InjVCDMonCab_C DSM_TsfDfp_InjVCDMonSwt_C DSM_TsfDfp_InjVCDShOffDCDC_C DSM_TsfDfp_InjVCDUBuf1_C DSM_TsfDfp_InjVCDUBuf2_C DSM_TsfDfp_InjVCD_CY370Ampl_C DSM_TsfDfp_InjVCD_DrvTime_C DSM_TsfDfp_InjVCD_DrvTimeRcy_C DSM_TsfDfp_InjVCD_TPUErr_C DSM_TsfDfp_InjVlvBnk1A_C DSM_TsfDfp_InjVlvBnk1B_C DSM_TsfDfp_InjVlvBnk2A_C DSM_TsfDfp_InjVlvBnk2B_C DSM_TsfDfp_InjVlvChipA_C DSM_TsfDfp_InjVlvChipB_C DSM_TsfDfp_InjVlvCyl1A_C DSM_TsfDfp_InjVlvCyl1B_C DSM_TsfDfp_InjVlvCyl1C_C DSM_TsfDfp_InjVlvCyl2A_C DSM_TsfDfp_InjVlvCyl2B_C DSM_TsfDfp_InjVlvCyl2C_C DSM_TsfDfp_InjVlvCyl3A_C DSM_TsfDfp_InjVlvCyl3B_C DSM_TsfDfp_InjVlvCyl3C_C DSM_TsfDfp_InjVlvCyl4A_C DSM_TsfDfp_InjVlvCyl4B_C DSM_TsfDfp_InjVlvCyl4C_C DSM_TsfDfp_InjVlvCyl5A_C DSM_TsfDfp_InjVlvCyl5B_C DSM_TsfDfp_InjVlvCyl5C_C DSM_TsfDfp_InjVlvCyl6A_C DSM_TsfDfp_InjVlvCyl6B_C DSM_TsfDfp_InjVlvCyl6C_C DSM_TsfDfp_InjVlvCyl7A_C DSM_TsfDfp_InjVlvCyl7B_C DSM_TsfDfp_InjVlvCyl7C_C DSM_TsfDfp_InjVlvCyl8A_C DSM_TsfDfp_InjVlvCyl8B_C DSM_TsfDfp_InjVlvCyl8C_C DSM_TsfDfp_InjVlvNVC1_C DSM_TsfDfp_InjVlvNVC2_C DSM_TsfDfp_InjVlvNVC3_C DSM_TsfDfp_InjVlvNVC4_C DSM_TsfDfp_InjVlvNVC5_C DSM_TsfDfp_InjVlvNVC6_C DSM_TsfDfp_InjVlvNVC7_C DSM_TsfDfp_InjVlvNVC8_C DSM_TsfDfp_KeyCheck_C DSM_TsfDfp_LIGovECUTransMode_C DSM_TsfDfp_LPACD_Max_C DSM_TsfDfp_LPACD_Min_C DSM_TsfDfp_LPACD_SigNpl_C DSM_TsfDfp_LSUCDCircNernst0B1_C DSM_TsfDfp_LSUCDCircNernst0B2_C DSM_TsfDfp_LSUCDCircPumpCur0B1_C DSM_TsfDfp_LSUCDCircPumpCur0B2_C DSM_TsfDfp_LSUCDCircVirtGnd0B1_C DSM_TsfDfp_LSUCDCircVirtGnd0B2_C DSM_TsfDfp_LSUCDHeater0B1_C DSM_TsfDfp_LSUCDHeater0B2_C DSM_TsfDfp_LSUCDHtCoup0B1_C DSM_TsfDfp_LSUCDHtCoup0B2_C DSM_TsfDfp_LSUCDO20B1_C DSM_TsfDfp_LSUCDO20B2_C DSM_TsfDfp_LSUCDO2Clb0B1_C DSM_TsfDfp_LSUCDO2Clb0B2_C DSM_TsfDfp_LSUCDRiClb0B1_C DSM_TsfDfp_LSUCDRiClb0B2_C DSM_TsfDfp_LSUCDSPI0B1_C DSM_TsfDfp_LSUCDSPI0B2_C DSM_TsfDfp_LSUCDSPIBattLow0B1_C DSM_TsfDfp_LSUCDSPIBattLow0B2_C DSM_TsfDfp_LSUCDWireIP0B1_C DSM_TsfDfp_LSUCDWireIP0B2_C DSM_TsfDfp_LSUCtlRiExc0B1_C DSM_TsfDfp_LSUCtlRiExc0B2_C DSM_TsfDfp_LSUMon1SensB1_C DSM_TsfDfp_LSUMon1SensB2_C DSM_TsfDfp_LSUMon2SensB1_C DSM_TsfDfp_LSUMon2SensB2_C DSM_TsfDfp_MIL_C DSM_TsfDfp_MRlyCD_C DSM_TsfDfp_MSMon_C DSM_TsfDfp_MSMonConsist_C DSM_TsfDfp_MSMonPFlt1_C DSM_TsfDfp_MSMonPFlt2_C DSM_TsfDfp_MSMonPFlt3_C DSM_TsfDfp_MSMonPFlt4_C DSM_TsfDfp_MSMon_ARS_TO_C DSM_TsfDfp_MSMon_AirCtl_C DSM_TsfDfp_MSMon_AirSys0_C DSM_TsfDfp_MSMon_AirSys1_C DSM_TsfDfp_MSMon_AirSys2_C DSM_TsfDfp_MSMon_AirSys3_C DSM_TsfDfp_MSMon_AirSys4_C DSM_TsfDfp_MSMon_AirSys7_C DSM_TsfDfp_MSMon_CanDef_C DSM_TsfDfp_MSMon_CoEng_OffVeh_C DSM_TsfDfp_MSMon_CoEng_Rev1_C DSM_TsfDfp_MSMon_CoEng_Rev2_C DSM_TsfDfp_MSMon_CoEng_RevMS_C DSM_TsfDfp_MSMon_DSC_TO_C DSM_TsfDfp_MSMon_EGS_TO_C DSM_TsfDfp_MSMon_FrmMngCoEng_C DSM_TsfDfp_MSMon_FrmMngPT_C DSM_TsfDfp_MSMon_FrmMngPT2_C DSM_TsfDfp_MSMon_Mil_C DSM_TsfDfp_MSMon_NetMngPtCan_C DSM_TsfDfp_MSMon_RailCDPMon_C DSM_TsfDfp_MSMon_StEGS_C DSM_TsfDfp_MSMon_SysLamp_C DSM_TsfDfp_MSMon_ZFCClbActv_C DSM_TsfDfp_MSMon_qLimErr_C DSM_TsfDfp_MSMon_trqCoDT_C DSM_TsfDfp_MSMon_trqCoVeh_C DSM_TsfDfp_MSMon_trqCoVehLim_C DSM_TsfDfp_MSMon_trqDesExt_C DSM_TsfDfp_MSMon_trqDesExtRev_C DSM_TsfDfp_MSMon_trqLimErr_C DSM_TsfDfp_MSMon_trqLimErr1_C DSM_TsfDfp_MSMon_trqLimErr2_C DSM_TsfDfp_MSMon_trqLimErr3_C DSM_TsfDfp_MSMon_trqLimErr4_C DSM_TsfDfp_MSidCD_Comm_C DSM_TsfDfp_MSidCD_EcuMixed_C DSM_TsfDfp_MSidCD_Pin_C DSM_TsfDfp_MSidCD_Sel_INI_C DSM_TsfDfp_MSidCD_Select_C DSM_TsfDfp_MSid_SwCmp_C DSM_TsfDfp_MSid_regEEPDiff_C DSM_TsfDfp_MeUnCDNoLoad_C DSM_TsfDfp_MeUnCDSCBat_C DSM_TsfDfp_MeUnCDSCGnd_C DSM_TsfDfp_MeUnCD_ADC_C DSM_TsfDfp_MeUnCD_SigTst_C DSM_TsfDfp_Montr_C DSM_TsfDfp_NetMngDeviceA_C DSM_TsfDfp_NetMngDeviceB_C DSM_TsfDfp_NetMngDeviceC_C DSM_TsfDfp_NetMngPrvCan_C DSM_TsfDfp_NetMngPrvCanSlave_C DSM_TsfDfp_NetMngPtCan_C DSM_TsfDfp_NetMngPtCanSlave_C DSM_TsfDfp_OPSCD_Lamp_C DSM_TsfDfp_OPSCD_anain_C DSM_TsfDfp_OTSCD_C DSM_TsfDfp_OvRMon_C DSM_TsfDfp_OvRMonSigA_C DSM_TsfDfp_OxiCCDTPreB1_C DSM_TsfDfp_OxiCCDTPreB2_C DSM_TsfDfp_PCBS_C DSM_TsfDfp_PCR_BalGvnr_C DSM_TsfDfp_PCR_GovDevNeg_C DSM_TsfDfp_PCR_GovDevPos_C DSM_TsfDfp_PCR_LPGvnrDvtNeg_C DSM_TsfDfp_PCR_LPGvnrDvtPos_C DSM_TsfDfp_PCVCDNoLoad_C DSM_TsfDfp_PCVCDSCBat_C DSM_TsfDfp_PCVCDSCGnd_C DSM_TsfDfp_PCVCD_ADC_C DSM_TsfDfp_PCVCD_SigTst_C DSM_TsfDfp_PFltAPSPlaus_C DSM_TsfDfp_PFltAPSensB1_C DSM_TsfDfp_PFltAPSensB2_C DSM_TsfDfp_PFltBPSPlaus_C DSM_TsfDfp_PFltCDPPreB1_C DSM_TsfDfp_PFltCDPPreB2_C DSM_TsfDfp_PFltCDTPreB1_C DSM_TsfDfp_PFltCDTPreB2_C DSM_TsfDfp_PFltCharB1_C DSM_TsfDfp_PFltCharB2_C DSM_TsfDfp_PFltDltOxiPreTwFlw_C DSM_TsfDfp_PFltDltPreTwFlw_C DSM_TsfDfp_PFltEngPrtB1_C DSM_TsfDfp_PFltEngPrtB2_C DSM_TsfDfp_PFltOvldInhRgnB1_C DSM_TsfDfp_PFltOvldInhRgnB2_C DSM_TsfDfp_PFltOvldTrqLimB1_C DSM_TsfDfp_PFltOvldTrqLimB2_C DSM_TsfDfp_PFltPresDynPlausB1_C DSM_TsfDfp_PFltPresDynPlausB2_C DSM_TsfDfp_PFltPresPlausB1_C DSM_TsfDfp_PFltPresPlausB2_C DSM_TsfDfp_PFltPresSensB1_C DSM_TsfDfp_PFltPresSensB2_C DSM_TsfDfp_PFltPresSensFrz_C DSM_TsfDfp_PFltPresSensHsLnB1_C DSM_TsfDfp_PFltPresSensHsLnB2_C DSM_TsfDfp_PFltPresSensSotB1_C DSM_TsfDfp_PFltPresSensSotB2_C DSM_TsfDfp_PFltRgnPerm_C DSM_TsfDfp_PFltTempDwnStrmB1_C DSM_TsfDfp_PFltTempDwnStrmB2_C DSM_TsfDfp_PFltTempSensB1_C DSM_TsfDfp_PFltTempSensB2_C DSM_TsfDfp_PFltTempUpStrmB1_C DSM_TsfDfp_PFltTempUpStrmB2_C DSM_TsfDfp_PFlt_tOxiPreMaxB1_C DSM_TsfDfp_PFlt_tOxiPreMaxB2_C DSM_TsfDfp_PFlt_tOxiPreMxRgnB1_C DSM_TsfDfp_PFlt_tOxiPreMxRgnB2_C DSM_TsfDfp_PFlt_tPreMaxB1_C DSM_TsfDfp_PFlt_tPreMaxB2_C DSM_TsfDfp_PFlt_tPreMaxRgnB1_C DSM_TsfDfp_PFlt_tPreMaxRgnB2_C DSM_TsfDfp_PFltmSotDiffMaxB1_C DSM_TsfDfp_PFltmSotDiffMaxB2_C DSM_TsfDfp_PresPlausDblDef_C DSM_TsfDfp_QLTCD_C DSM_TsfDfp_RailCD_C DSM_TsfDfp_RailCDOfsTst_C DSM_TsfDfp_RailCD_PMonStrt_C DSM_TsfDfp_RailCPC1_C DSM_TsfDfp_RailCPC3_C DSM_TsfDfp_RailCPC4_C DSM_TsfDfp_RailCtlModeMeUnDiag_C DSM_TsfDfp_RailCtlModePCVDiag_C DSM_TsfDfp_RailMeUn0_C DSM_TsfDfp_RailMeUn1_C DSM_TsfDfp_RailMeUn2_C DSM_TsfDfp_RailMeUn3_C DSM_TsfDfp_RailMeUn4_C DSM_TsfDfp_RailPCV0_C DSM_TsfDfp_RailPCV1_C DSM_TsfDfp_RailPCV2_C DSM_TsfDfp_RailPCV3_C DSM_TsfDfp_RailPCV4_C DSM_TsfDfp_RailPCV5_C DSM_TsfDfp_SOPTst_C DSM_TsfDfp_SSpMon1_C DSM_TsfDfp_SSpMon2_C DSM_TsfDfp_SSpMon3_C DSM_TsfDfp_SSpMon4_C DSM_TsfDfp_SSpMon5_C DSM_TsfDfp_SSpMon6_C DSM_TsfDfp_SWChk_CycSigChkDat_C DSM_TsfDfp_SWChk_CycSigChkPrg_C DSM_TsfDfp_StSysTrqShutOff_C DSM_TsfDfp_StrtCD_Actr_C DSM_TsfDfp_SysLamp_C DSM_TsfDfp_T15CD_C DSM_TsfDfp_TGearbx_C DSM_TsfDfp_TPUMon_C DSM_TsfDfp_TVACD_AirMon1_C DSM_TsfDfp_TVACD_AirMon2_C DSM_TsfDfp_TVACD_Max_C DSM_TsfDfp_TVACD_Max2_C DSM_TsfDfp_TVACD_Min_C DSM_TsfDfp_TVACD_Min2_C DSM_TsfDfp_TVACD_SigNpl_C DSM_TsfDfp_TVACD_SigNpl2_C DSM_TsfDfp_TVACD_TVADia1_C DSM_TsfDfp_TVACD_TVADia2_C DSM_TsfDfp_TVACD_TVADia21_C DSM_TsfDfp_TVACD_TVADia22_C DSM_TsfDfp_TVACD_TVADia23_C DSM_TsfDfp_TVACD_TVADia24_C DSM_TsfDfp_TVACD_TVADia3_C DSM_TsfDfp_TVACD_TVADia4_C DSM_TsfDfp_ThrVlvMon_C DSM_TsfDfp_VSACD_DiaDet_C DSM_TsfDfp_VSACD_DioInDia1_C DSM_TsfDfp_VSACD_DioInDia2_C DSM_TsfDfp_VSACD_DioInDia3_C DSM_TsfDfp_VSACD_DioInDia4_C DSM_TsfDfp_VSACD_DioInMin_C DSM_TsfDfp_VSACD_Max_C DSM_TsfDfp_VSACD_Min_C DSM_TsfDfp_VSACD_SigNpl_C DSM_TsfDfp_VSACD_VSADia1_C DSM_TsfDfp_VSACD_VSADia2_C DSM_TsfDfp_VSACD_VSADia3_C DSM_TsfDfp_VSACD_VSADia4_C DSM_TsfDfp_VSSCD1_C DSM_TsfDfp_VSSCD2_C DSM_TsfDfp_WdCom_C /end DEF_CHARACTERISTIC
/end FUNCTION
/begin FUNCTION dsm_msg ""
 /begin OUT_MEASUREMENT DFPM_stFCMChkCause DSM_ctDfctPath DSM_ctFcmEntry DSM_ctOBDPath DSM_ctOBDValidPath DSM_ctTstPath DSM_ctWUC DSM_lDist DSM_stCycles DSM_stECUMasterSlave DSM_stInhDelay DSM_stMIL DSM_stPID41 DSM_stRdyAB DSM_stRdyCD DSM_stRdyCheckEnable DSM_stSysLamp /end OUT_MEASUREMENT
/end FUNCTION
/begin FUNCTION dsm_rdy ""
 /begin DEF_CHARACTERISTIC DSM_RdyABForceMsk_C DSM_RdyCDForceMsk_C DSM_RdyOnMilEnable_C /end DEF_CHARACTERISTIC
/end FUNCTION
/begin FUNCTION dsm_rdy_msg "" /end FUNCTION
/begin FUNCTION dsm_rdy_uic ""
 /begin OUT_MEASUREMENT DSM_ctRdyActCyc_mp DSM_ctRdyCycCat_mp DSM_ctRdyCycCompr_mp DSM_ctRdyCycEGR_mp DSM_ctRdyCycFuel_mp DSM_ctRdyCycMisf_mp DSM_ctRdyCycOxSenHt_mp DSM_ctRdyCycOxSen_mp DSM_ctRdyLimCat_mp DSM_ctRdyLimCompr_mp DSM_ctRdyLimEGR_mp DSM_ctRdyLimFuel_mp DSM_ctRdyLimMisf_mp DSM_ctRdyLimOxSenHt_mp DSM_ctRdyLimOxSen_mp DSM_ctRdyPathsCat_mp DSM_ctRdyPathsCompr_mp DSM_ctRdyPathsEGR_mp DSM_ctRdyPathsFuel_mp DSM_ctRdyPathsMisf_mp DSM_ctRdyPathsOxSenHt_mp DSM_ctRdyPathsOxSen_mp DSM_ctRdyTstCat_mp DSM_ctRdyTstCompr_mp DSM_ctRdyTstEGR_mp DSM_ctRdyTstFuel_mp DSM_ctRdyTstMisf_mp DSM_ctRdyTstOxSenHt_mp DSM_ctRdyTstOxSen_mp /end OUT_MEASUREMENT
/end FUNCTION
/begin FUNCTION dsm_sy_conf "" /end FUNCTION
/begin FUNCTION dsm_uic ""
 /begin OUT_MEASUREMENT DfpErrCol_mp DfpZyfCol_mp DSCHED_numDefDfpArray_mp DSCHED_numOkDfpArray_mp DSM_ctFCMEntrySize_mp DSM_ctPath_mp DSM_tiDCDelay_mp FidCol_mp /end OUT_MEASUREMENT
/end FUNCTION
/begin FUNCTION dummy "" /end FUNCTION
/begin FUNCTION dummy_msg "" /begin OUT_MEASUREMENT EGPpCD_tPreTrbn PFltCD_tPst /end OUT_MEASUREMENT /end FUNCTION
/begin FUNCTION dummy_proj "" /end FUNCTION
/begin FUNCTION dummy_proj_msg ""
 /begin OUT_MEASUREMENT AddPmp_volAddTot AirSys_pDesValSysTst AirSys_stPDesValSysTst DCC_stActive EGPpCD_tPreTrbnB1 EGPpCD_tPreTrbnB2 EGT_tOutrDesInTempGvnrB1 EGT_tOutrDesInTempGvnrB2 FlMng_qFullLdRgl Lub_nMin OxiCCD_tPstB1 OxiCCD_tPstB2 PCR_rGvnrLP2 PFltCD_pDiffB1 PFltCD_pDiffB2 PFltCD_tPstB1 PFltCD_tPstB2 /end OUT_MEASUREMENT
/end FUNCTION
/begin FUNCTION dummy_uic "" /begin OUT_MEASUREMENT Uhwe_ctAtomicLvl_mp /end OUT_MEASUREMENT /end FUNCTION
/begin FUNCTION eatscd "Umgebungslufttemperaturerfassung"
 /begin DEF_CHARACTERISTIC EATSCD_uSRCMin_C EATSCD_uSRCMax_C EATSCD_tLin_CUR EATSCD_DebSigDef_C EATSCD_DebSigOk_C EATSCD_DebSRCHighDef_C EATSCD_DebSRCHighOk_C EATSCD_DebSRCLowDef_C EATSCD_DebSRCLowOk_C EATSCD_dtRmpSubs_C EATSCD_dtRmpSubsUp_C EATSCD_dtRmpSubsDwn_C EATSCD_numAdc_C EATSCD_dtRmpSlpUp_C EATSCD_dtRmpSlpDwn_C EATSCD_swtSensImpl_C EATSCD_swtSigVal_C EATSCD_tAirSubs_C EATSCD_tiTransStValid_C EATSCD_stSensIDWord_C EATSCD_tDfl_C /end DEF_CHARACTERISTIC
 /begin IN_MEASUREMENT EATSCD_uRaw /end IN_MEASUREMENT
/end FUNCTION
/begin FUNCTION eatscd_msg ""
 /begin OUT_MEASUREMENT EATSCD_stValid EATSCD_swtSig EATSCD_tAir EATSCD_tAirLin EATSCD_uRaw /end OUT_MEASUREMENT
/end FUNCTION
/begin FUNCTION eatscd_uic "" /end FUNCTION
/begin FUNCTION ebafcd "Abluftklappensteuerung Komponententreiber"
 /begin DEF_CHARACTERISTIC EBAFCD_ctPwrStgOnMax_C EBAFCD_DebExcTempDef_C EBAFCD_DebExcTempOk_C EBAFCD_DebNoLoadDef_C EBAFCD_DebNoLoadOk_C EBAFCD_DebShortCircBatDef_C EBAFCD_DebShortCircBatOk_C EBAFCD_DebShortCircGndDef_C EBAFCD_DebShortCircGndOk_C EBAFCD_InvSigOut_C EBAFCD_nFan_C EBAFCD_numDiaOut_C EBAFCD_numDioOut_C EBAFCD_stSPICtl_C EBAFCD_tClntTrMin_C EBAFCD_tClntTrMax_C EBAFCD_sttClntTrOff_C EBAFCD_sttClntTrOn_C EBAFCD_tClntMin_C EBAFCD_tClntMax_C EBAFCD_sttClntOff_C EBAFCD_sttClntOn_C EBAFCD_tiBtwTst_C EBAFCD_tiPwrStgOn_C /end DEF_CHARACTERISTIC
/end FUNCTION
/begin FUNCTION ebafcd_msg "" /begin OUT_MEASUREMENT EBAFCD_stSigOut /end OUT_MEASUREMENT /end FUNCTION
/begin FUNCTION ebafcd_uic "" /begin OUT_MEASUREMENT EBAFCD_st_mp /end OUT_MEASUREMENT /end FUNCTION
/begin FUNCTION ebfcd_actoutebox "E-Box Cooler Fan component driver"
 /begin DEF_CHARACTERISTIC EBFCD_ctPwrStgOnMax_C EBFCD_DebExcTempDef_C EBFCD_DebExcTempOk_C EBFCD_DebNoLoadDef_C EBFCD_DebNoLoadOk_C EBFCD_DebShortCircBatDef_C EBFCD_DebShortCircBatOk_C EBFCD_DebShortCircGndDef_C EBFCD_DebShortCircGndOk_C EBFCD_numDiaOut_C EBFCD_numDioOut_C EBFCD_stDigInvOut_C EBFCD_stSigOutErr_C EBFCD_stSPICtl_C EBFCD_swtOnOff_C EBFCD_tECUXLow_C EBFCD_tECUXHigh_C EBFCD_stECUYLow_C EBFCD_stECUYHigh_C EBFCD_tiBtwTst_C EBFCD_tiPwrStgOn_C /end DEF_CHARACTERISTIC
/end FUNCTION
/begin FUNCTION ebfcd_actoutebox_msg "" /begin OUT_MEASUREMENT EBFCD_stOut /end OUT_MEASUREMENT /end FUNCTION
/begin FUNCTION ebfcd_actoutebox_uic "" /begin OUT_MEASUREMENT EBFCD_st_mp /end OUT_MEASUREMENT /end FUNCTION
/begin FUNCTION ebtscd_gettempebox "ECU Temperature sensor component driver"
 /begin DEF_CHARACTERISTIC EBTSCD_uSRCMin_C EBTSCD_uSRCMax_C EBTSCD_tLin_CUR EBTSCD_OvrDebSRCHighDef_C EBTSCD_OvrDebSRCHighOk_C EBTSCD_DebSRCHighDef_C EBTSCD_DebSRCHighOk_C EBTSCD_DebSRCLowDef_C EBTSCD_DebSRCLowOk_C EBTSCD_numAdc_C EBTSCD_dtRmpSlpUp_C EBTSCD_dtRmpSlpDwn_C EBTSCD_tiTECUPT1_C EBTSCD_tOvrTemp_C EBTSCD_stSensIDWord_C EBTSCD_tDfl_C /end DEF_CHARACTERISTIC
 /begin IN_MEASUREMENT EBTSCD_uRawTECU_mp /end IN_MEASUREMENT
/end FUNCTION
/begin FUNCTION ebtscd_gettempebox_msg "" /begin OUT_MEASUREMENT EBTSCD_tCIntLin EBTSCD_tECU /end OUT_MEASUREMENT /end FUNCTION
/begin FUNCTION ebtscd_gettempebox_uic "" /begin OUT_MEASUREMENT EBTSCD_uRawTECU_mp /end OUT_MEASUREMENT /end FUNCTION
/begin FUNCTION ecu "" /begin DEF_CHARACTERISTIC ECU_vPrgThres_C /end DEF_CHARACTERISTIC /end FUNCTION
/begin FUNCTION eepcd "Komponenten Treiber für EEPROM Zugriffe" /begin DEF_CHARACTERISTIC EEPCD_stMILDfl_C /end DEF_CHARACTERISTIC /end FUNCTION
/begin FUNCTION eepcd_msg "" /begin OUT_MEASUREMENT EEPCD_stErrSet EEPCD_stMIL /end OUT_MEASUREMENT /end FUNCTION
/begin FUNCTION eepinit "EEPROM Erstinitialisierung" /end FUNCTION
/begin FUNCTION eepinit_develop "ließt Bloecke vom EEPROM und schreibt ein Byte an waelbare Positionen" /begin DEF_CHARACTERISTIC /end DEF_CHARACTERISTIC /begin OUT_MEASUREMENT /end OUT_MEASUREMENT /end FUNCTION
/begin FUNCTION egppcd_actrout "Exhaust Gas pressure Pump Component Driver"
 /begin DEF_CHARACTERISTIC EGPpCD_ctPwrStgOnMax_C EGPpCD_numDia_C EGPpCD_numDioOut_C EGPpCD_stInvOut_C EGPpCD_stPwrStgActv_C EGPpCD_stSPICtl_C EGPpCD_tiBtwTst_C EGPpCD_tiDebExcTempDef_C EGPpCD_tiDebExcTempOk_C EGPpCD_tiDebNoLoadDef_C EGPpCD_tiDebNoLoadOk_C EGPpCD_tiDebShortCircBatDef_C EGPpCD_tiDebShortCircBatOk_C EGPpCD_tiDebShortCircGndDef_C EGPpCD_tiDebShortCircGndOk_C EGPpCD_tiPwrStgOn_C /end DEF_CHARACTERISTIC
/end FUNCTION
/begin FUNCTION egppcd_actrout_msg "" /begin OUT_MEASUREMENT EGPpCD_stActrOut /end OUT_MEASUREMENT /end FUNCTION
/begin FUNCTION egppcd_actrout_uic "" /begin OUT_MEASUREMENT EGPpCD_stActrOut_mp /end OUT_MEASUREMENT /end FUNCTION
/begin FUNCTION egpp_logic "Calculates the status of the Exhaust gas pressure pump"
 /begin DEF_CHARACTERISTIC EGPp_nAvrgLim_C EGPp_rLogicOutNHys_C EGPp_rLogicOutQHys_C EGPp_stFlapRgn_MAP EGPp_stFlap_MAP EGPp_stMskRgn_C /end DEF_CHARACTERISTIC
 /begin IN_MEASUREMENT Eng_nAvrg InjCtl_qCurr /end IN_MEASUREMENT
/end FUNCTION
/begin FUNCTION egpp_logic_msg "" /begin OUT_MEASUREMENT EGPp_stLogicOut /end OUT_MEASUREMENT /end FUNCTION
/begin FUNCTION egpp_logic_uic "" /end FUNCTION
/begin FUNCTION egpp_prescalc "Berechnung des Abgasdruckes"
 /begin DEF_CHARACTERISTIC EGPp_facGeoSil2_C EGPp_facGeoSil_C EGPp_facPow_CUR EGPp_facRhoEta_CUR EGPp_pPstPFltEG_MAP EGPp_pPstPFlt_MAP EGPp_tiPresFltPT1_C EGPp_swtDoubleSil_C EGPp_swtPresCalcMod_C EGPp_swtPresCalc_C /end DEF_CHARACTERISTIC
 /begin IN_MEASUREMENT EGPp_dmEG_mp EGPp_dvolSilBnk_mp EGPp_tPstSimBnk_mp EGPp_tSurf_mp Eng_nAvrg InjCtl_qSetUnBal /end IN_MEASUREMENT
/end FUNCTION
/begin FUNCTION egpp_prescalc_msg "" /begin OUT_MEASUREMENT EGPp_pPstPFltB1 EGPp_pPstPFltB2 /end OUT_MEASUREMENT /end FUNCTION
/begin FUNCTION egpp_prescalc_uic ""
 /begin OUT_MEASUREMENT EGPp_dmEG_mp EGPp_dvolSilB1_mp EGPp_dvolSilB2_mp EGPp_dvolSilBnk_mp EGPp_pPstPFltMapB1_mp EGPp_pPstPFltMapB2_mp EGPp_pPstPFltSimB1_mp EGPp_pPstPFltSimB2_mp EGPp_tPstSimBnk_mp EGPp_tSurf_mp /end OUT_MEASUREMENT
/end FUNCTION
/begin COMPU_METHOD AirMassPerTime "Luftmasse pro Zeit" RAT_FUNC "%6.3" "Kg/h" COEFFS 0 10 0 0 0 1 /end COMPU_METHOD
/begin COMPU_METHOD CubMtrPerHr "Volumsstrom in m^3/h" RAT_FUNC "%6.3" "m^3/h" COEFFS 0 10 0 0 0 1 /end COMPU_METHOD
/begin COMPU_METHOD DfpName "Verbale Umrechnung für Fehlerpfadnamen" TAB_VERB "%6.3" "-" COMPU_TAB_REF DfpName /end COMPU_METHOD
/begin COMPU_VTAB DfpName "Verbale Umrechnung für Fehlerpfadnamen" TAB_VERB 525 0 "Dfp_unused" 1 "Dfp_Layer_TANS" 2 "Dfp_ACCDSwtin" 3 "Dfp_ACC_PlausTrqDes" 4 "Dfp_ACC_trqInr" 5 "Dfp_ACTrq" 6 "Dfp_ADCMon" 7 "Dfp_AFSCDIdlAdjVal" 8 "Dfp_AFSCDLdAdjVal" 9 "Dfp_AFSCDPlAirPerCylDif" 10 "Dfp_AFSCD_AirTempDcyc" 11 "Dfp_AFSCD_AirTempDcyc2" 12 "Dfp_AFSCD_PlOffsDrft" 13 "Dfp_AFSCD_PlOffsDrft2" 14 "Dfp_AFSCD_PlSetyDrft" 15 "Dfp_AFSCD_SRCAirTemp" 16 "Dfp_AFSCD_SRCAirTemp2" 17 "Dfp_AFSCD_SRCBatt" 18 "Dfp_AFSCD_SRCBatt2" 19 "Dfp_AFSCD_SRCCorrAirm" 20 "Dfp_Layer_TUMG" 21 "Dfp_AFSCD_SRCCorrAirm2" 22 "Dfp_AFSCD_SRCRawAirm" 23 "Dfp_Layer_GEN" 24 "Dfp_Layer_BSD" 25 "Dfp_AFSCD_SRCRawAirm2" 26 "Dfp_AFSCD_SRCRefSigPer" 27 "Dfp_AFSCD_SRCRefSigPer2" 28 "Dfp_AOHtCD" 29 "Dfp_AOHtCD_AOHtDia1" 30 "Dfp_AOHtCD_AOHtDia2" 31 "Dfp_AOHtCD_AOHtDia3" 32 "Dfp_APP1" 33 "Dfp_APP2" 34 "Dfp_APPCDCmpd" 35 "Dfp_Layer_QLT" 36 "Dfp_APPSync" 37 "Dfp_Layer_IBS1" 38 "Dfp_Layer_IBS2" 39 "Dfp_Layer_IBS3" 40 "Dfp_Layer_PMBN" 41 "Dfp_Layer_PMBATT" 42 "Dfp_APSCD" 43 "Dfp_ARS" 44 "Dfp_AccPedPlausBrk" 45 "Dfp_AddPCDTnkLvl" 46 "Dfp_AirCtlGvnrDvtRgnMax" 47 "Dfp_AirCtlGvnrDvtRgnMin" 48 "Dfp_AirCtlGvnrDvtRgnMn2" 49 "Dfp_AirCtlGvnrDvtRgnMx2" 50 "Dfp_AirCtlPlateBreak" 51 "Dfp_AirCtlRmpTO" 52 "Dfp_AirCtl_GovNegDev" 53 "Dfp_AirCtl_GovNegDev2" 54 "Dfp_AirCtl_GovPosDev" 55 "Dfp_AirCtl_GovPosDev2" 56 "Dfp_AltCD" 57 "Dfp_BPACD_BPADia1" 58 "Dfp_BPACD_BPADia1v2" 59 "Dfp_BPACD_BPADia2" 60 "Dfp_BPACD_BPADia2v2" 61 "Dfp_BPACD_BPADia3" 62 "Dfp_BPACD_BPADia3v2" 63 "Dfp_BPACD_BPADia4" 64 "Dfp_BPACD_BPADia4v2" 65 "Dfp_BPACD_Max" 66 "Dfp_BPACD_Max2" 67 "Dfp_BPACD_Min" 68 "Dfp_BPACD_Min2" 69 "Dfp_BPACD_SigNpl" 70 "Dfp_BPACD_SigNpl2" 71 "Dfp_BPSCD" 72 "Dfp_BattCD" 73 "Dfp_BrkCD" 74 "Dfp_Layer_PMRUHVERL" 75 "Dfp_Bss" 76 "Dfp_CBACD" 77 "Dfp_CTSCD" 78 "Dfp_Clg_DynTst" 79 "Dfp_Layer_TOENS" 80 "Dfp_Layer_MANHYDR" 81 "Dfp_Layer_MANLUFT" 82 "Dfp_CmbChbMisfire1" 83 "Dfp_CmbChbMisfire2" 84 "Dfp_CmbChbMisfire3" 85 "Dfp_CmbChbMisfire4" 86 "Dfp_CmbChbMisfire5" 87 "Dfp_CmbChbMisfire6" 88 "Dfp_CmbChbMisfire7" 89 "Dfp_CmbChbMisfire8" 90 "Dfp_CmbChbMisfireMul" 91 "Dfp_CoDT_TRQ_Des" 92 "Dfp_CoDT_TRQ_Lead" 93 "Dfp_CoEng_GbxRpmRduc" 94 "Dfp_CoVMDCSh" 95 "Dfp_ConvCD" 96 "Dfp_CrCCDMFL" 97 "Dfp_CrCtl_vCrCtl" 98 "Dfp_EATSCD" 99 "Dfp_EBAFCD" 100 "Dfp_EBFCD" 101 "Dfp_EBTSCD" 102 "Dfp_EBTSCD_OvrTemp" 103 "Dfp_EEPCDVarMng" 104 "Dfp_EGPpCD" 105 "Dfp_EGRCD_Max" 106 "Dfp_EGRCD_Max2" 107 "Dfp_EGRCD_Min" 108 "Dfp_EGRCD_Min2" 109 "Dfp_EGRCD_PWMInDia1" 110 "Dfp_EGRCD_PWMInDia2" 111 "Dfp_EGRCD_PWMInDia21" 112 "Dfp_EGRCD_PWMInDia22" 113 "Dfp_EGRCD_PWMInDia23" 114 "Dfp_EGRCD_PWMInDia24" 115 "Dfp_EGRCD_PWMInDia3" 116 "Dfp_EGRCD_PWMInDia4" 117 "Dfp_EGRCD_SigDia" 118 "Dfp_EGRCD_SigDia2" 119 "Dfp_EGRCD_SigNpl" 120 "Dfp_EGRCD_SigNpl2" 121 "Dfp_EGTOilLvlCrit" 122 "Dfp_EGTOilVscCrit" 123 "Dfp_EGTRgnOilDil" 124 "Dfp_EGTTempGvnrInrB1" 125 "Dfp_EGTTempGvnrInrB2" 126 "Dfp_EGTTempGvnrOutrB1" 127 "Dfp_EGTTempGvnrOutrB2" 128 "Dfp_ETClbETFltInj1" 129 "Dfp_ETClbETFltInj2" 130 "Dfp_ETClbETFltInj3" 131 "Dfp_ETClbETFltInj4" 132 "Dfp_ETClbETFltInj5" 133 "Dfp_ETClbETFltInj6" 134 "Dfp_ETClbETFltInj7" 135 "Dfp_ETClbETFltInj8" 136 "Dfp_ETClbInj1" 137 "Dfp_ETClbInj2" 138 "Dfp_ETClbInj3" 139 "Dfp_ETClbInj4" 140 "Dfp_ETClbInj5" 141 "Dfp_ETClbInj6" 142 "Dfp_ETClbInj7" 143 "Dfp_ETClbInj8" 144 "Dfp_EngMCaS1" 145 "Dfp_EngMCrS1" 146 "Dfp_EngMOfsCaSCrS" 147 "Dfp_EngMntCtlCD" 148 "Dfp_FBCqDvt" 149 "Dfp_FMAErrMod" 150 "Dfp_FMTC_NonMonotonMap" 151 "Dfp_FTSCD" 152 "Dfp_FanCD" 153 "Dfp_FanCD_FanCtlr1" 154 "Dfp_FanCD_FanCtlr2" 155 "Dfp_FanCD_FanCtlr3" 156 "Dfp_FlFCD" 157 "Dfp_FlMngSmkDefect" 158 "Dfp_FlSCDT1" 159 "Dfp_FrmMngANFRADMOMPT" 160 "Dfp_FrmMngASC1" 161 "Dfp_FrmMngASC2" 162 "Dfp_FrmMngASC3" 163 "Dfp_FrmMngASC4" 164 "Dfp_FrmMngBOS_RESET" 165 "Dfp_FrmMngBOS_RESET2" 166 "Dfp_FrmMngDMANFAFS" 167 "Dfp_FrmMngDRMANFSSG" 168 "Dfp_FrmMngEGS1" 169 "Dfp_FrmMngEGS2" 170 "Dfp_FrmMngGEARBX_DATA" 171 "Dfp_FrmMngGEARBX_DATA2" 172 "Dfp_FrmMngHEAT_AC" 173 "Dfp_FrmMngINSTR2" 174 "Dfp_FrmMngINSTR3" 175 "Dfp_FrmMngLENKRADWINKEL" 176 "Dfp_FrmMngMILEAGE_RANGE" 177 "Dfp_FrmMngMSPHISYNC" 178 "Dfp_FrmMngMST4" 179 "Dfp_FrmMngMST5" 180 "Dfp_FrmMngOPCRCTLACC" 181 "Dfp_FrmMngPRGG_CCTR" 182 "Dfp_FrmMngPWRMNG_LOADV" 183 "Dfp_FrmMngParkConsumer" 184 "Dfp_FrmMngRQSTGEFAN" 185 "Dfp_FrmMngSLV4" 186 "Dfp_FrmMngSLV5" 187 "Dfp_FrmMngSSGErr" 188 "Dfp_FrmMngSSGShOff" 189 "Dfp_FrmMngSTAT_ANH" 190 "Dfp_FrmMngSTAT_ARS" 191 "Dfp_FrmMngSTAT_DSC" 192 "Dfp_FrmMngSTAT_EKP" 193 "Dfp_FrmMngSTAT_KOMBI" 194 "Dfp_FrmMngSTAT_SITZ" 195 "Dfp_FrmMngStOBDGbxMilOf" 196 "Dfp_FrmMngStOBDGbxMilOn" 197 "Dfp_FrmMngTEMPRELTIME" 198 "Dfp_FrmMngTERMINAL" 199 "Dfp_FrmMngTIME_DATE" 200 "Dfp_FrmMngTORQUE_DSC" 201 "Dfp_FrmMngTORQUE_GEARBX" 202 "Dfp_FrmMngTrq_ReqACC" 203 "Dfp_FrmMngVEH_MOD" 204 "Dfp_FrmMngVELOCITY" 205 "Dfp_FrmMngWHEEL_SPEED" 206 "Dfp_FrmMngstCurr" 207 "Dfp_FrmMngswtPSPOff" 208 "Dfp_GearbxIncMax" 209 "Dfp_GlwCD" 210 "Dfp_GlwCDGlwCirc1" 211 "Dfp_GlwCDGlwCirc2" 212 "Dfp_GlwCDGlwCirc3" 213 "Dfp_GlwCDGlwCirc4" 214 "Dfp_GlwCDGlwCirc5" 215 "Dfp_GlwCDGlwCirc6" 216 "Dfp_GlwCDGlwCirc7" 217 "Dfp_GlwCDGlwCirc8" 218 "Dfp_GlwCtl" 219 "Dfp_HWEMonCom" 220 "Dfp_HWEMonEEPROM" 221 "Dfp_HWEMonRcyLocked" 222 "Dfp_HWEMonRcySuppressed" 223 "Dfp_HWEMonRcyVisible" 224 "Dfp_HWEMonUMaxSupply" 225 "Dfp_HWEMonUMinSupply" 226 "Dfp_IATSCD" 227 "Dfp_IATSCD_CATS" 228 "Dfp_IATSCD_CATSSec" 229 "Dfp_ImmCtlImmCD" 230 "Dfp_ImmCtlImmEep" 231 "Dfp_ImmCtlMpl" 232 "Dfp_IndSys1" 233 "Dfp_IndSys2" 234 "Dfp_InjCrv_InjLim" 235 "Dfp_InjCtlAdjQnt" 236 "Dfp_InjCtlDrift" 237 "Dfp_InjVCDActrChrg" 238 "Dfp_InjVCDActrEnrg1" 239 "Dfp_InjVCDActrEnrg2" 240 "Dfp_InjVCDActrEnrg3" 241 "Dfp_InjVCDActrEnrg4" 242 "Dfp_InjVCDActrEnrg5" 243 "Dfp_InjVCDActrEnrg6" 244 "Dfp_InjVCDActrEnrg7" 245 "Dfp_InjVCDActrEnrg8" 246 "Dfp_InjVCDActrVolt" 247 "Dfp_InjVCDClsBank1" 248 "Dfp_InjVCDClsBank2" 249 "Dfp_InjVCDMonCab" 250 "Dfp_InjVCDMonSwt" 251 "Dfp_InjVCDShOffDCDC" 252 "Dfp_InjVCDUBuf1" 253 "Dfp_InjVCDUBuf2" 254 "Dfp_InjVCD_CY370Ampl" 255 "Dfp_InjVCD_DrvTime" 256 "Dfp_InjVCD_DrvTimeRcy" 257 "Dfp_InjVCD_TPUErr" 258 "Dfp_InjVlvBnk1A" 259 "Dfp_InjVlvBnk1B" 260 "Dfp_InjVlvBnk2A" 261 "Dfp_InjVlvBnk2B" 262 "Dfp_InjVlvChipA" 263 "Dfp_InjVlvChipB" 264 "Dfp_InjVlvCyl1A" 265 "Dfp_InjVlvCyl1B" 266 "Dfp_InjVlvCyl1C" 267 "Dfp_InjVlvCyl2A" 268 "Dfp_InjVlvCyl2B" 269 "Dfp_InjVlvCyl2C" 270 "Dfp_InjVlvCyl3A" 271 "Dfp_InjVlvCyl3B" 272 "Dfp_InjVlvCyl3C" 273 "Dfp_InjVlvCyl4A" 274 "Dfp_InjVlvCyl4B" 275 "Dfp_InjVlvCyl4C" 276 "Dfp_InjVlvCyl5A" 277 "Dfp_InjVlvCyl5B" 278 "Dfp_InjVlvCyl5C" 279 "Dfp_InjVlvCyl6A" 280 "Dfp_InjVlvCyl6B" 281 "Dfp_InjVlvCyl6C" 282 "Dfp_InjVlvCyl7A" 283 "Dfp_InjVlvCyl7B" 284 "Dfp_InjVlvCyl7C" 285 "Dfp_InjVlvCyl8A" 286 "Dfp_InjVlvCyl8B" 287 "Dfp_InjVlvCyl8C" 288 "Dfp_InjVlvNVC1" 289 "Dfp_InjVlvNVC2" 290 "Dfp_InjVlvNVC3" 291 "Dfp_InjVlvNVC4" 292 "Dfp_InjVlvNVC5" 293 "Dfp_InjVlvNVC6" 294 "Dfp_InjVlvNVC7" 295 "Dfp_InjVlvNVC8" 296 "Dfp_KeyCheck" 297 "Dfp_LIGovECUTransMode" 298 "Dfp_LPACD_Max" 299 "Dfp_LPACD_Min" 300 "Dfp_LPACD_SigNpl" 301 "Dfp_LSUCDCircNernst0B1" 302 "Dfp_LSUCDCircNernst0B2" 303 "Dfp_LSUCDCircPumpCur0B1" 304 "Dfp_LSUCDCircPumpCur0B2" 305 "Dfp_LSUCDCircVirtGnd0B1" 306 "Dfp_LSUCDCircVirtGnd0B2" 307 "Dfp_LSUCDHeater0B1" 308 "Dfp_LSUCDHeater0B2" 309 "Dfp_LSUCDHtCoup0B1" 310 "Dfp_LSUCDHtCoup0B2" 311 "Dfp_LSUCDO20B1" 312 "Dfp_LSUCDO20B2" 313 "Dfp_LSUCDO2Clb0B1" 314 "Dfp_LSUCDO2Clb0B2" 315 "Dfp_LSUCDRiClb0B1" 316 "Dfp_LSUCDRiClb0B2" 317 "Dfp_LSUCDSPI0B1" 318 "Dfp_LSUCDSPI0B2" 319 "Dfp_LSUCDSPIBattLow0B1" 320 "Dfp_LSUCDSPIBattLow0B2" 321 "Dfp_LSUCDWireIP0B1" 322 "Dfp_LSUCDWireIP0B2" 323 "Dfp_LSUCtlRiExc0B1" 324 "Dfp_LSUCtlRiExc0B2" 325 "Dfp_LSUMon1SensB1" 326 "Dfp_LSUMon1SensB2" 327 "Dfp_LSUMon2SensB1" 328 "Dfp_LSUMon2SensB2" 329 "Dfp_MIL" 330 "Dfp_MRlyCD" 331 "Dfp_MSMon" 332 "Dfp_MSMonConsist" 333 "Dfp_MSMonPFlt1" 334 "Dfp_MSMonPFlt2" 335 "Dfp_MSMonPFlt3" 336 "Dfp_MSMonPFlt4" 337 "Dfp_MSMon_ARS_TO" 338 "Dfp_MSMon_AirCtl" 339 "Dfp_MSMon_AirSys0" 340 "Dfp_MSMon_AirSys1" 341 "Dfp_MSMon_AirSys2" 342 "Dfp_MSMon_AirSys3" 343 "Dfp_MSMon_AirSys4" 344 "Dfp_MSMon_AirSys7" 345 "Dfp_MSMon_CanDef" 346 "Dfp_MSMon_CoEng_OffVeh" 347 "Dfp_MSMon_CoEng_Rev1" 348 "Dfp_MSMon_CoEng_Rev2" 349 "Dfp_MSMon_CoEng_RevMS" 350 "Dfp_MSMon_DSC_TO" 351 "Dfp_MSMon_EGS_TO" 352 "Dfp_MSMon_FrmMngCoEng" 353 "Dfp_MSMon_FrmMngPT" 354 "Dfp_MSMon_FrmMngPT2" 355 "Dfp_MSMon_Mil" 356 "Dfp_MSMon_NetMngPtCan" 357 "Dfp_MSMon_RailCDPMon" 358 "Dfp_MSMon_StEGS" 359 "Dfp_MSMon_SysLamp" 360 "Dfp_MSMon_ZFCClbActv" 361 "Dfp_MSMon_qLimErr" 362 "Dfp_MSMon_trqCoDT" 363 "Dfp_MSMon_trqCoVeh" 364 "Dfp_MSMon_trqCoVehLim" 365 "Dfp_MSMon_trqDesExt" 366 "Dfp_MSMon_trqDesExtRev" 367 "Dfp_MSMon_trqLimErr" 368 "Dfp_MSMon_trqLimErr1" 369 "Dfp_MSMon_trqLimErr2" 370 "Dfp_MSMon_trqLimErr3" 371 "Dfp_MSMon_trqLimErr4" 372 "Dfp_MSidCD_Comm" 373 "Dfp_MSidCD_EcuMixed" 374 "Dfp_MSidCD_Pin" 375 "Dfp_MSidCD_Sel_INI" 376 "Dfp_MSidCD_Select" 377 "Dfp_MSid_SwCmp" 378 "Dfp_MSid_regEEPDiff" 379 "Dfp_MeUnCDNoLoad" 380 "Dfp_MeUnCDSCBat" 381 "Dfp_MeUnCDSCGnd" 382 "Dfp_MeUnCD_ADC" 383 "Dfp_MeUnCD_SigTst" 384 "Dfp_Montr" 385 "Dfp_NetMngDeviceA" 386 "Dfp_NetMngDeviceB" 387 "Dfp_NetMngDeviceC" 388 "Dfp_NetMngPrvCan" 389 "Dfp_NetMngPrvCanSlave" 390 "Dfp_NetMngPtCan" 391 "Dfp_NetMngPtCanSlave" 392 "Dfp_OPSCD_Lamp" 393 "Dfp_OPSCD_anain" 394 "Dfp_OTSCD" 395 "Dfp_OvRMon" 396 "Dfp_OvRMonSigA" 397 "Dfp_OxiCCDTPreB1" 398 "Dfp_OxiCCDTPreB2" 399 "Dfp_PCBS" 400 "Dfp_PCR_BalGvnr" 401 "Dfp_PCR_GovDevNeg" 402 "Dfp_PCR_GovDevPos" 403 "Dfp_PCR_LPGvnrDvtNeg" 404 "Dfp_PCR_LPGvnrDvtPos" 405 "Dfp_PCVCDNoLoad" 406 "Dfp_PCVCDSCBat" 407 "Dfp_PCVCDSCGnd" 408 "Dfp_PCVCD_ADC" 409 "Dfp_PCVCD_SigTst" 410 "Dfp_PFltAPSPlaus" 411 "Dfp_PFltAPSensB1" 412 "Dfp_PFltAPSensB2" 413 "Dfp_PFltBPSPlaus" 414 "Dfp_PFltCDPPreB1" 415 "Dfp_PFltCDPPreB2" 416 "Dfp_PFltCDTPreB1" 417 "Dfp_PFltCDTPreB2" 418 "Dfp_PFltCharB1" 419 "Dfp_PFltCharB2" 420 "Dfp_PFltDltOxiPreTwFlw" 421 "Dfp_PFltDltPreTwFlw" 422 "Dfp_PFltEngPrtB1" 423 "Dfp_PFltEngPrtB2" 424 "Dfp_PFltOvldInhRgnB1" 425 "Dfp_PFltOvldInhRgnB2" 426 "Dfp_PFltOvldTrqLimB1" 427 "Dfp_PFltOvldTrqLimB2" 428 "Dfp_PFltPresDynPlausB1" 429 "Dfp_PFltPresDynPlausB2" 430 "Dfp_PFltPresPlausB1" 431 "Dfp_PFltPresPlausB2" 432 "Dfp_PFltPresSensB1" 433 "Dfp_PFltPresSensB2" 434 "Dfp_PFltPresSensFrz" 435 "Dfp_PFltPresSensHsLnB1" 436 "Dfp_PFltPresSensHsLnB2" 437 "Dfp_PFltPresSensSotB1" 438 "Dfp_PFltPresSensSotB2" 439 "Dfp_PFltRgnPerm" 440 "Dfp_PFltTempDwnStrmB1" 441 "Dfp_PFltTempDwnStrmB2" 442 "Dfp_PFltTempSensB1" 443 "Dfp_PFltTempSensB2" 444 "Dfp_PFltTempUpStrmB1" 445 "Dfp_PFltTempUpStrmB2" 446 "Dfp_PFlt_tOxiPreMaxB1" 447 "Dfp_PFlt_tOxiPreMaxB2" 448 "Dfp_PFlt_tOxiPreMxRgnB1" 449 "Dfp_PFlt_tOxiPreMxRgnB2" 450 "Dfp_PFlt_tPreMaxB1" 451 "Dfp_PFlt_tPreMaxB2" 452 "Dfp_PFlt_tPreMaxRgnB1" 453 "Dfp_PFlt_tPreMaxRgnB2" 454 "Dfp_PFltmSotDiffMaxB1" 455 "Dfp_PFltmSotDiffMaxB2" 456 "Dfp_PresPlausDblDef" 457 "Dfp_QLTCD" 458 "Dfp_RailCD" 459 "Dfp_RailCDOfsTst" 460 "Dfp_RailCD_PMonStrt" 461 "Dfp_RailCPC1" 462 "Dfp_RailCPC3" 463 "Dfp_RailCPC4" 464 "Dfp_RailCtlModeMeUnDiag" 465 "Dfp_RailCtlModePCVDiag" 466 "Dfp_RailMeUn0" 467 "Dfp_RailMeUn1" 468 "Dfp_RailMeUn2" 469 "Dfp_RailMeUn3" 470 "Dfp_RailMeUn4" 471 "Dfp_RailPCV0" 472 "Dfp_RailPCV1" 473 "Dfp_RailPCV2" 474 "Dfp_RailPCV3" 475 "Dfp_RailPCV4" 476 "Dfp_RailPCV5" 477 "Dfp_SOPTst" 478 "Dfp_SSpMon1" 479 "Dfp_SSpMon2" 480 "Dfp_SSpMon3" 481 "Dfp_SSpMon4" 482 "Dfp_SSpMon5" 483 "Dfp_SSpMon6" 484 "Dfp_SWChk_CycSigChkDat" 485 "Dfp_SWChk_CycSigChkPrg" 486 "Dfp_StSysTrqShutOff" 487 "Dfp_StrtCD_Actr" 488 "Dfp_SysLamp" 489 "Dfp_T15CD" 490 "Dfp_TGearbx" 491 "Dfp_TPUMon" 492 "Dfp_TVACD_AirMon1" 493 "Dfp_TVACD_AirMon2" 494 "Dfp_TVACD_Max" 495 "Dfp_TVACD_Max2" 496 "Dfp_TVACD_Min" 497 "Dfp_TVACD_Min2" 498 "Dfp_TVACD_SigNpl" 499 "Dfp_TVACD_SigNpl2" 500 "Dfp_TVACD_TVADia1" 501 "Dfp_TVACD_TVADia2" 502 "Dfp_TVACD_TVADia21" 503 "Dfp_TVACD_TVADia22" 504 "Dfp_TVACD_TVADia23" 505 "Dfp_TVACD_TVADia24" 506 "Dfp_TVACD_TVADia3" 507 "Dfp_TVACD_TVADia4" 508 "Dfp_ThrVlvMon" 509 "Dfp_VSACD_DiaDet" 510 "Dfp_VSACD_DioInDia1" 511 "Dfp_VSACD_DioInDia2" 512 "Dfp_VSACD_DioInDia3" 513 "Dfp_VSACD_DioInDia4" 514 "Dfp_VSACD_DioInMin" 515 "Dfp_VSACD_Max" 516 "Dfp_VSACD_Min" 517 "Dfp_VSACD_SigNpl" 518 "Dfp_VSACD_VSADia1" 519 "Dfp_VSACD_VSADia2" 520 "Dfp_VSACD_VSADia3" 521 "Dfp_VSACD_VSADia4" 522 "Dfp_VSSCD1" 523 "Dfp_VSSCD2" 524 "Dfp_WdCom" /end COMPU_VTAB
/begin COMPU_METHOD EngN "Motordrehzahl" RAT_FUNC "%6.2" "rpm" COEFFS 0 1 0 0 0 1 /end COMPU_METHOD
/begin COMPU_METHOD Fact "Faktor mit Auflösung 1 / 8192, hauptsächlich für einen Faktorenbereich 0...1 verwendet" RAT_FUNC "%6.5" "-" COEFFS 0 8192 0 0 0 1 /end COMPU_METHOD
/begin COMPU_METHOD Fact1 "Faktor mit Auflösung 0,01 (100 mal höherer Bereich als Fact)" RAT_FUNC "%6.4" "-" COEFFS 0 128 0 0 0 1 /end COMPU_METHOD
/begin COMPU_METHOD FanSpd "(MAXSINT16 / FANSPD_MAX) * phys" RAT_FUNC "%6.3" "1/min" COEFFS 0 10.9223333333333 0 0 0 1 /end COMPU_METHOD
/begin COMPU_METHOD FCMChkCause "Verbale Umrechnung für Message für DSM internen gebrauch (unterstützung bei DSM problemen)" TAB_VERB "%6.3" "-" COMPU_TAB_REF FCMChkCause /end COMPU_METHOD
/begin COMPU_VTAB FCMChkCause "Verbale Umrechnung für Message für DSM internen gebrauch (unterstützung bei DSM problemen)" TAB_VERB 15 1 "fcmEnd npl: fcmEnd > FCM_TAB_SIZE" 2 "Erf and Typ npl" 3 "fcmEnd npl: line == fcmEnd" 4 "Mem set but no entry" 5 "No Mem set but entry" 6 "Mem npl class blocked" 7 "class npl" 8 "Mil npl 1" 9 "Mil npl 2" 10 "Scatt npl" 11 "Flc npl" 12 "Hlc npl" 13 "Fcm blocked" 14 "complement npl" 15 "dpfToClear are blocked" /end COMPU_VTAB
/begin COMPU_METHOD InjMass "Einspritzmenge" RAT_FUNC "%6.4" "mg/hub" COEFFS 0 100 0 0 0 1 /end COMPU_METHOD
/begin COMPU_METHOD InjMassCyc "Einspritzmenge pro Zyklus (mg/Zyklus)" RAT_FUNC "%6.4" "mg/cyc" COEFFS 0 100 0 0 0 1 /end COMPU_METHOD
/begin COMPU_METHOD NumPinAdc "verbale Umrechnung für ADC Signale" TAB_VERB "%6.3" "-" COMPU_TAB_REF NumPinAdc /end COMPU_METHOD
/begin COMPU_VTAB NumPinAdc "verbale Umrechnung für ADC Signale" TAB_VERB 61 0 "ADC_REF" 1 "Voltage_Lambda1_Ua" 2 "Voltage_Lambda1_Ri" 3 "Temperature_ECU_PCB" 4 "Voltage_Bank_1" 5 "Voltage_Bank_2" 6 "ADC_DUMMYA" 7 "1st_APP_Sensor_252" 8 "ADC_Reserve-S1" 9 "2nd_APP_Sensor_239" 10 "ADC_Reserve-S2" 11 "Water_Temperature_Sensor_182" 12 "TKS" 13 "Charge_Air_Temperature_Sensor_183_2" 14 "Exhaust_Temperature_Sensor_1_MASTER_158" 15 "Exhaust_Temperature_Sensor_1_SLAVE_158" 16 "Atmospheric_Pressure_Sensor" 17 "Charge_Air_Temperature_Sensor_183" 18 "ADC_DUMMYB_NOT_USED" 19 "Rail_Pressure_Peak_Value_156" 20 "Rail_Pressure_Peak_Value-DummySlave" 21 "Boost_Pressure_Sensor_154" 22 "Boost_Pressure_Sensor_2" 23 "Booster_Voltage_Sensor" 24 "Rail_Pressure_Sensor_156" 25 "Pressure_Upstream_Particle_Filter_MASTER_159" 26 "Pressure_Upstream_Particle_Filter_SLAVE_159" 27 "Temperature_Upstream_Particle_Filter_MASTER_134" 28 "Temperature_Upstream_Particle_Filter_SLAVE_134" 29 "Current_MeUn_Sensor" 30 "Current_PCV_Sensor" 31 "Engine_Oil_Pressure_110" 32 "Battery_Voltage_Sensor" 33 "ADC_DUMMY_SLAVE_NOT_USED" 34 "ADC_DUMMY_NOT_USED" 35 "Charge_Actuator_Event_0" 36 "Voltage_Piezo_Actuator_Bank_2_Event_0" 37 "Voltage_Piezo_Actuator_Bank_1_Event_0" 38 "Charge_Actuator_Event_1" 39 "Voltage_Piezo_Actuator_Bank_2_Event_1" 40 "Voltage_Piezo_Actuator_Bank_1_Event_1" 41 "Charge_Actuator_Event_2" 42 "Voltage_Piezo_Actuator_Bank_2_Event_2" 43 "Voltage_Piezo_Actuator_Bank_1_Event_2" 44 "Charge_Actuator_Event_3" 45 "Voltage_Piezo_Actuator_Bank_2_Event_3" 46 "Voltage_Piezo_Actuator_Bank_1_Event_3" 47 "Charge_Actuator_Event_4" 48 "Voltage_Piezo_Actuator_Bank_2_Event_4" 49 "Voltage_Piezo_Actuator_Bank_1_Event_4" 50 "Charge_Actuator_Event_5" 51 "Voltage_Piezo_Actuator_Bank_2_Event_5" 52 "Voltage_Piezo_Actuator_Bank_1_Event_5" 53 "Charge_Actuator_Event_6" 54 "Voltage_Piezo_Actuator_Bank_2_Event_6" 55 "Voltage_Piezo_Actuator_Bank_1_Event_6" 56 "Charge_Actuator_Event_7" 57 "Voltage_Piezo_Actuator_Bank_2_Event_7" 58 "Voltage_Piezo_Actuator_Bank_1_Event_7" 59 "Booster_Voltage_Piezo" 60 "Piezo_Voltage" /end COMPU_VTAB
/begin COMPU_METHOD NumPinDia "Verbale Umrechnung für Diagnose Signale" TAB_VERB "%6.3" "-" COMPU_TAB_REF NumPinDia /end COMPU_METHOD
/begin COMPU_VTAB NumPinDia "Verbale Umrechnung für Diagnose Signale" TAB_VERB 34 0 "CJ945_Diagnostic_Signal" 1 "AC_Compressor_DiaSig" 2 "Fuel_Pump_DiaSig" 3 "Starter_234" 4 "Radiator_Blind_Control_Diagnostic_Signal" 5 "Engine_Bay_Air_Flaps/Compressor_Bypass_123" 6 "Glow_Relay_Diagnostic_Signal1" 7 "EngM_Bearing_Actuator_Diagnostic_Signal_124" 8 "reserved Glow_Relay_Diagnostic_Signal2" 9 "Ebox_Fan_Actuator_Diagnostic_Signal_219" 10 "Shutter_Actuator_SW_DiaSig" 11 "Twostage_TurboLoading_SW_DiaSig" 12 "DIO_OUT_DIAGNOSTIC_DUMMY_NOT_USED" 13 "1st_Pressure_Control_Valve_Diagnostic_Signal_172" 14 "2nd_Pressure_Control_Valve_Diagnostic_Signal_172" 15 "1st_Metering_Unit_Diagnostic_Signal_171" 16 "2nd_Metering_Unit_Diagnostic_Signal_171" 17 "Boost_Pressure_Actuator_Diagnostic_Signal_193" 18 "Boost_Pressure_Actuator_Diagnostic_Signal_193_2" 19 "EGR_Actuator_Diagnostic_Signal_194" 20 "EGR_Actuator_Diagnostic_Signal2" 21 "Variable_Swirl_Actuator_Diagnostic_Signal_195" 22 "Throttle_Valve_Diagnostic_Signal_196" 23 "Throttle_Valve2_Diagnostic_Signal_196" 24 "FAN_240" 25 "Add_On_Heater_244" 26 "Low pressure stage BPA_Diagnostic_Signal_117" 27 "PWM_DIAGNOSTIC_DUMMY_NOT_USED" 28 "1st_Sensor_Supply_Voltage_DiaSig" 29 "2nd_Sensor_Supply_Voltage_DiaSig" 30 "3rd_Sensor_Supply_Voltage_DiaSig" 31 "4th_Sensor_Supply_Voltage_DiaSig" 32 "5th_Sensor_Supply_Voltage_DiaSig" 33 "6th_Sensor_Supply_Voltage_DiaSig" /end COMPU_VTAB
/begin COMPU_METHOD NumPinDioOut "Verbale Umrechnung für Digitalausgang Signale" TAB_VERB "%6.3" "-" COMPU_TAB_REF NumPinDioOut /end COMPU_METHOD
/begin COMPU_VTAB NumPinDioOut "Verbale Umrechnung für Digitalausgang Signale" TAB_VERB 16 0 "Main_Relay_220(144)" 1 "AC_Compressor" 2 "Fuel_Pump_232" 3 "Glow_Relay" 4 "Starter_234" 5 "Radiator_Blind_Control" 6 "EBAF/Compressor_Bypass_123" 7 "Glow_Relay_1" 8 "EngM_Bearing_Actuator_124" 9 "Glow_Relay_2" 10 "Ebox_Fan_Actuator_219" 11 "STATREG_PSOFF_Bit" 12 "Shutter_Actuator_216" 13 "Twostage_TurboLoading_120" 14 "TD_Signal_253" 15 "DIO_OUT_DUMMY_NOT_USED" /end COMPU_VTAB
/begin COMPU_METHOD OneToOne "eins zu eins (physikalischer Wert ist gleich dem internen Wert)" RAT_FUNC "%6.2" "-" COEFFS 0 1 0 0 0 1 /end COMPU_METHOD
/begin COMPU_METHOD Prc "Prozent, gleiche interne Auflösung wie Fact, aber Darstellung in Prozent (0...100%)" RAT_FUNC "%6.4" "%" COEFFS 0 81.92 0 0 0 1 /end COMPU_METHOD
/begin COMPU_METHOD Pres_hPa "Druck (angezeigt in [hPa])" RAT_FUNC "%6.2" "hPa" COEFFS 0 1 0 0 0 1 /end COMPU_METHOD
/begin COMPU_METHOD RdyOnMilEnable "Verbale Umrechnung für DSM_RdyOnMilEnable_C" TAB_VERB "%6.3" "-" COMPU_TAB_REF RdyOnMilEnable /end COMPU_METHOD
/begin COMPU_VTAB RdyOnMilEnable "Verbale Umrechnung für DSM_RdyOnMilEnable_C" TAB_VERB 2 0 "normal" 1 "set all Rdy bits on Mil ON" /end COMPU_VTAB
/begin COMPU_METHOD RmpTemp "Rampengradient für Temperatur" RAT_FUNC "%6.4" "deg C/s" COEFFS 0 655.36 0 0 0 1 /end COMPU_METHOD
/begin COMPU_METHOD RmpTempCels "temperature ramp gradient in Centigrade" RAT_FUNC "%8.7" "C/ms" COEFFS 0 655360 0 0 0 1 /end COMPU_METHOD
/begin COMPU_METHOD Temp_Cels "Temperatur dargestellt in °C (gleiche interne Darstellung wie Temp_Kelv)" RAT_FUNC "%6.1" "deg C" COEFFS 0 10 2731.4 0 0 1 /end COMPU_METHOD
/begin COMPU_METHOD TimeDelay_s "Zeitkonstante T1 (in s) für PT1, DT1, etc." RAT_FUNC "%9.3" "s" COEFFS 0 0 1 0 0.00023283064365387 0 /end COMPU_METHOD
/begin COMPU_METHOD TimeDsmTsf "Skalierung der DSM Schwerezähler Werte" RAT_FUNC "%6.0" "ms" COEFFS 0 0.005 0 0 0 1 /end COMPU_METHOD
/begin COMPU_METHOD Time_ms "Zeit in ms für Fehlerentprellung (DSM) und SW-Timer" RAT_FUNC "%6.1" "ms" COEFFS 0 0.1 0 0 0 1 /end COMPU_METHOD
/begin COMPU_METHOD Time_s "Zeit in s für Fehlerentprellung (DSM) und SW-Timer" RAT_FUNC "%6.4" "s" COEFFS 0 100 0 0 0 1 /end COMPU_METHOD
/begin COMPU_METHOD Vel "Fahrzeuggeschwindigkeit, gleiche interne Auflösung wie Vel_SI" RAT_FUNC "%6.4" "km/h" COEFFS 0 100 0 0 0 1 /end COMPU_METHOD
/begin COMPU_METHOD volAdd_ml "Additivvolumen [ml]" RAT_FUNC "%6.3" "ml" COEFFS 0 10 0 0 0 1 /end COMPU_METHOD
/begin COMPU_METHOD Volt "Spannung in V (von ADC)" RAT_FUNC "%6.2" "mV" COEFFS 0 0.2046 0 0 0 1 /end COMPU_METHOD
/begin RECORD_LAYOUT Kf_Xs16_Ys16_Ws16 NO_AXIS_PTS_X 1 SWORD NO_AXIS_PTS_Y 2 SWORD AXIS_PTS_X 3 SWORD INDEX_INCR DIRECT AXIS_PTS_Y 4 SWORD INDEX_INCR DIRECT FNC_VALUES 5 SWORD COLUMN_DIR DIRECT /end RECORD_LAYOUT
/begin RECORD_LAYOUT Kl_Xs16_Ws16 NO_AXIS_PTS_X 1 SWORD AXIS_PTS_X 2 SWORD INDEX_INCR DIRECT FNC_VALUES 3 SWORD COLUMN_DIR DIRECT /end RECORD_LAYOUT
/begin RECORD_LAYOUT Kw_Ws16 FNC_VALUES 1 SWORD COLUMN_DIR DIRECT /end RECORD_LAYOUT
/begin RECORD_LAYOUT Kw_Wu16 FNC_VALUES 1 UWORD COLUMN_DIR DIRECT /end RECORD_LAYOUT
/begin RECORD_LAYOUT Kw_Wu32 FNC_VALUES 1 ULONG COLUMN_DIR DIRECT /end RECORD_LAYOUT
/begin RECORD_LAYOUT Kw_Wu8 FNC_VALUES 1 UBYTE COLUMN_DIR DIRECT /end RECORD_LAYOUT
/end MODULE
/end PROJECT
