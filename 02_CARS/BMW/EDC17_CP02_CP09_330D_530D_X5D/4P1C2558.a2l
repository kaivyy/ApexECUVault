ASAP2_VERSION 1 4
/begin PROJECT P_558 "EDC17_CP02"
/begin HEADER "" VERSION "V1C1" PROJECT_NO P_558 /end HEADER
/begin MODULE DIM ""
/begin MOD_COMMON "" BYTE_ORDER MSB_LAST ALIGNMENT_BYTE 1 ALIGNMENT_WORD 2 ALIGNMENT_LONG 4 ALIGNMENT_FLOAT32_IEEE 4 /end MOD_COMMON
/begin CHARACTERISTIC Air_nThresNplPAirFltDs_C "" VALUE 0x80063C94 Val_Ws16 6000.000 EngN 0.00 6000.000 FORMAT "%8.3" EXTENDED_LIMITS -16384.00 16383.50 /end CHARACTERISTIC
/begin CHARACTERISTIC Air_pDiffLimNplPAirFltDs_C "" VALUE 0x80063C96 Val_Ws16 3500.000 Pres_hPa 0.00 3500.000 FORMAT "%8.3" EXTENDED_LIMITS -32768.00 32767.00 /end CHARACTERISTIC
/begin CHARACTERISTIC Air_pTransfPAirFltDs_CUR "" CURVE 0x80063C28 Cur_Xs16Ws16 3500.000 Pres_hPa 0.00 3500.000 FORMAT "%8.3" EXTENDED_LIMITS -32768.00 32767.00
 /begin AXIS_DESCR STD_AXIS Air_uRawPAirFltDs Volt 25 0.00 5200.000 FORMAT "%8.3" EXTENDED_LIMITS -6553.600 6553.400 DEPOSIT ABSOLUTE /end AXIS_DESCR
/end CHARACTERISTIC
/begin CHARACTERISTIC Air_RmpSlpPAirFltDs.Pos_C "/" VALUE 0x80063C98 Val_Ws32 32767999.9847 RmpPres_hPa 0.00 32767999.9847 FORMAT "%13.4" EXTENDED_LIMITS -32768000.0000 32767999.9847 /end CHARACTERISTIC
/begin CHARACTERISTIC Air_RmpSlpPAirFltDs.Neg_C "/" VALUE 0x80063C9C Val_Ws32 32767999.9847 RmpPres_hPa 0.00 32767999.9847 FORMAT "%13.4" EXTENDED_LIMITS -32768000.0000 32767999.9847 /end CHARACTERISTIC
/begin CHARACTERISTIC Air_swtSigPAirFltDs_C "" VALUE 0x80063C8E Val_Wu8 1.000 OneToOne 0.00 1.000 FORMAT "%5.3" EXTENDED_LIMITS 0.00 255.0 /end CHARACTERISTIC
/begin CHARACTERISTIC Air_tiPT1PAirFltDs_C "" VALUE 0x80063CA0 Val_Ws32 4294.9672940 TimeDelay_s 0.000002000000001 4294.9672960 FORMAT "%12.7" /end CHARACTERISTIC
/begin CHARACTERISTIC Air_TrStgParPAirFltDs.Dfl_C "/" VALUE 0x80063CA4 Val_Ws16 36268.00 Pres_hPa -32768.00 3500.00 FORMAT "%8.2" EXTENDED_LIMITS -32768.00 32767.00 /end CHARACTERISTIC
/begin CHARACTERISTIC Air_TrStgParPAirFltDs.stSensId_C "/" VALUE 0x80063CA6 Val_Wu8 255.0 OneToOne 0.00 255.0 FORMAT "%5.1" /end CHARACTERISTIC
/begin CHARACTERISTIC Air_uSRCMaxPAirFltDs_C "" VALUE 0x80063C90 Val_Ws16 5200.000 Volt 0.00 5200.000 FORMAT "%8.3" EXTENDED_LIMITS -6553.600 6553.400 /end CHARACTERISTIC
/begin CHARACTERISTIC Air_uSRCMinPAirFltDs_C "" VALUE 0x80063C92 Val_Ws16 5200.000 Volt 0.00 5200.000 FORMAT "%8.3" EXTENDED_LIMITS -6553.600 6553.400 /end CHARACTERISTIC
/begin CHARACTERISTIC Oil_RmpSlpT.Pos_C "/" VALUE 0x80063C04 Kw_Ws32 3276799.99847 RmpTemp 0.00 3276799.99847 FORMAT "%13.5" EXTENDED_LIMITS -3276800.00000 3276799.99847 /end CHARACTERISTIC
/begin CHARACTERISTIC Oil_RmpSlpT.Neg_C "/" VALUE 0x80063C08 Kw_Ws32 3276799.99847 RmpTemp 0.00 3276799.99847 FORMAT "%13.5" EXTENDED_LIMITS -3276800.00000 3276799.99847 /end CHARACTERISTIC
/begin CHARACTERISTIC Oil_SRCT.uMin_C "/" VALUE 0x80063BBA Kw_Ws16 5200.000 Volt 0.00 5200.000 FORMAT "%8.3" EXTENDED_LIMITS -6553.600 6553.400 /end CHARACTERISTIC
/begin CHARACTERISTIC Oil_SRCT.uMax_C "/" VALUE 0x80063BBC Kw_Ws16 5200.000 Volt 0.00 5200.000 FORMAT "%8.3" EXTENDED_LIMITS -6553.600 6553.400 /end CHARACTERISTIC
/begin CHARACTERISTIC Oil_swtSensPresT_C "" VALUE 0x80063C0C Val_Wu8 255.0 OneToOne 0.00 255.0 FORMAT "%5.1" /end CHARACTERISTIC
/begin CHARACTERISTIC Oil_swtSensVar_C "" VALUE 0x80063C24 Val_Wu8 255.0 OneToOne 0.00 255.0 FORMAT "%5.1" /end CHARACTERISTIC
/begin CHARACTERISTIC Oil_swtSigT_C "" VALUE 0x80063BBE Val_Wu8 255.0 OneToOne 0.00 255.0 FORMAT "%5.1" /end CHARACTERISTIC
/begin CHARACTERISTIC Oil_tDflOffsT_C "" VALUE 0x80063C0E Val_Ws16 250.0000 Temp_Cels -50.04000 199.9600 FORMAT "%8.4" EXTENDED_LIMITS -3549.940 3003.560 /end CHARACTERISTIC
/begin CHARACTERISTIC Oil_tiBtwRegRd_C "" VALUE 0x80063C26 Val_Ws16 1980.000 Time_ms 20.00000 2000.000 FORMAT "%8.3" EXTENDED_LIMITS -327680.0 327670.0 /end CHARACTERISTIC
/begin CHARACTERISTIC Oil_tiDelOilCEngPlausT_C "" VALUE 0x80063C10 Val_Ws32 42949672.9500 Time_s -21474836.4800 21474836.4700 FORMAT "%13.4" /end CHARACTERISTIC
/begin CHARACTERISTIC Oil_tiLPFiltPT1T_C "" VALUE 0x80063C14 Val_Ws32 4294.9672940 TimeDelay_s 0.000002000000001 4294.9672960 FORMAT "%12.7" /end CHARACTERISTIC
/begin CHARACTERISTIC Oil_tiStrtOilCEngPlausT_C "" VALUE 0x80063C18 Val_Ws32 42949672.9500 Time_s -21474836.4800 21474836.4700 FORMAT "%13.4" /end CHARACTERISTIC
/begin CHARACTERISTIC Oil_tLimOilCEngPlausT_C "" VALUE 0x80063C1C Val_Ws16 6553.500 Temp_Cels -3549.940 3003.560 FORMAT "%8.3" /end CHARACTERISTIC
/begin CHARACTERISTIC Oil_TransStgT.Dfl_C "/" VALUE 0x80063C1E Kw_Ws16 6553.500 Temp_Cels -3549.940 3003.560 FORMAT "%8.3" /end CHARACTERISTIC
/begin CHARACTERISTIC Oil_TransStgT.stSensId_C "/" VALUE 0x80063C20 Kw_Wu8 255.0 OneToOne 0.00 255.0 FORMAT "%5.1" /end CHARACTERISTIC
/begin CHARACTERISTIC Oil_tThresOilCEngPlausT_C "" VALUE 0x80063C22 Val_Ws16 6553.500 Temp_Cels -3549.940 3003.560 FORMAT "%8.3" /end CHARACTERISTIC
/begin CHARACTERISTIC Oil_tTransfT_CUR "" CURVE 0x80063BC0 Cur_Xs16Ws16 250.0000 Temp_Cels -50.04000 199.9600 FORMAT "%8.4" EXTENDED_LIMITS -3549.940 3003.560
 /begin AXIS_DESCR STD_AXIS Oil_uRawTSwmp Volt 16 0.00 5200.000 FORMAT "%8.3" EXTENDED_LIMITS -6553.600 6553.400 DEPOSIT ABSOLUTE /end AXIS_DESCR
/end CHARACTERISTIC
/begin CHARACTERISTIC PCR_APPDT1.T1_C "/" VALUE 0x800650B8 Kw_Ws32 4294.9672940 TimeDelay_s 0.000002000000001 4294.9672960 FORMAT "%12.7" /end CHARACTERISTIC
/begin CHARACTERISTIC PCR_APPDT1.Kd_C "/" VALUE 0x800650BC Kw_Ws32 65535.9999847 Kd -32768.0000000 32767.9999847 FORMAT "%13.7" /end CHARACTERISTIC
/begin CHARACTERISTIC PCR_CldDT1Win.T1_C "DT1-Parameter des dynamischen Sollwertanteils bei kaltem Motor/" VALUE 0x8007C6D4 Val_Ws32 4294.9662960 TimeDelay_s 0.0010000000689 4294.9672960 FORMAT "%12.7" EXTENDED_LIMITS 0.000002000000001 4294.9672960 /end CHARACTERISTIC
/begin CHARACTERISTIC PCR_CldDT1Win.Kd_C "DT1-Parameter des dynamischen Sollwertanteils bei kaltem Motor/" VALUE 0x8007C6D8 Val_Ws32 65535.9999847 Kd -32768.0000000 32767.9999847 FORMAT "%13.7" /end CHARACTERISTIC
/begin CHARACTERISTIC PCR_CldDT1Win.KdPos_C "DT1-Parameter des dynamischen Sollwertanteils bei kaltem Motor/" VALUE 0x8007C6DC Val_Ws32 65535.9999847 Kd -32768.0000000 32767.9999847 FORMAT "%13.7" /end CHARACTERISTIC
/begin CHARACTERISTIC PCR_CldDT1Win.KdNeg_C "DT1-Parameter des dynamischen Sollwertanteils bei kaltem Motor/" VALUE 0x8007C6E0 Val_Ws32 65535.9999847 Kd -32768.0000000 32767.9999847 FORMAT "%13.7" /end CHARACTERISTIC
/begin CHARACTERISTIC PCR_CldDT1Win.WinPos_C "DT1-Parameter des dynamischen Sollwertanteils bei kaltem Motor/" VALUE 0x8007C6E4 Val_Ws32 2147487148.00 Pres_hPa -2147483648.00 3500.00 FORMAT "%13.2" EXTENDED_LIMITS -2147483648.00 2147483647.00 /end CHARACTERISTIC
/begin CHARACTERISTIC PCR_CldDT1Win.WinNeg_C "DT1-Parameter des dynamischen Sollwertanteils bei kaltem Motor/" VALUE 0x8007C6E8 Val_Ws32 2147487148.00 Pres_hPa -2147483648.00 3500.00 FORMAT "%13.2" EXTENDED_LIMITS -2147483648.00 2147483647.00 /end CHARACTERISTIC
/begin CHARACTERISTIC PCR_ClthThresLP_CUR "" CURVE 0x8007DBAE Cur_Xs16Ws16 327.6700 InjMassCyc 0.00 327.6700 FORMAT "%8.4" EXTENDED_LIMITS -327.6800 327.6700
 /begin AXIS_DESCR STD_AXIS Epm_nEng EngN 6 0.00 8000.000 FORMAT "%8.3" EXTENDED_LIMITS -16384.00 16383.50 DEPOSIT ABSOLUTE /end AXIS_DESCR
/end CHARACTERISTIC
/begin CHARACTERISTIC PCR_ClthThres_C "Schwellwert für Einspritzmenge bzw. inneres Drehmoment" VALUE 0x8007D81C Val_Ws16 327.6700 InjMass 0.00 327.6700 FORMAT "%8.4" EXTENDED_LIMITS -327.6800 327.6700 /end CHARACTERISTIC
/begin CHARACTERISTIC PCR_dnOfsCalcLim_C "Threshold for derivation with respect to time of Eng_nAvrg" VALUE 0x80065B80 Val_Ws16 3000.000 dn_dZ20 0.00 3000.000 FORMAT "%8.3" EXTENDED_LIMITS -163840.0 163835.0 /end CHARACTERISTIC
/begin CHARACTERISTIC PCR_DpCorrDT1.T1_C "/" VALUE 0x800653C8 Kw_Ws32 4294.9672940 TimeDelay_s 0.000002000000001 4294.9672960 FORMAT "%12.7" /end CHARACTERISTIC
/begin CHARACTERISTIC PCR_DpCorrDT1.Kd_C "/" VALUE 0x800653CC Kw_Ws32 32767.9999924 Kd_Pres2dpdt -16384.0000000 16383.9999924 FORMAT "%13.7" /end CHARACTERISTIC
/begin CHARACTERISTIC PCR_dpMinGov_C "Untere Grenze des stationären Ladedrucksollwertgradient" VALUE 0x8007D0E0 Val_Ws16 65535.00 PreshPa_sec -32768.00 32767.00 FORMAT "%8.2" /end CHARACTERISTIC
/begin CHARACTERISTIC PCR_dpSlpLimRmp.Pos_C "/" VALUE 0x800650C0 Kw_Ws32 32767999.9847 RmpPres_hPa 0.00 32767999.9847 FORMAT "%13.4" EXTENDED_LIMITS -32768000.0000 32767999.9847 /end CHARACTERISTIC
/begin CHARACTERISTIC PCR_dpSlpLimRmp.Neg_C "/" VALUE 0x800650C4 Kw_Ws32 32767999.9847 RmpPres_hPa 0.00 32767999.9847 FORMAT "%13.4" EXTENDED_LIMITS -32768000.0000 32767999.9847 /end CHARACTERISTIC
/begin CHARACTERISTIC PCR_dqCtlOfsCalcLim_C "Threshold for derivation with respect to time of InjCtl_qCurr" VALUE 0x80065B82 Val_Ws16 8000.000 InjMassPerSec_20ms -4000.000 4000.000 FORMAT "%8.3" EXTENDED_LIMITS -16384.00 16383.50 /end CHARACTERISTIC
/begin CHARACTERISTIC PCR_drAPPUnFlt_C "" VALUE 0x800650C8 Kw_Ws16 39999.39 PrcPerSec -20000.00 19999.39 FORMAT "%8.2" /end CHARACTERISTIC
/begin CHARACTERISTIC PCR_drChrgPmpCtlRmp.Pos_C "/" VALUE 0x800653C0 Kw_Ws32 399999.999814 RmpPrc 0.00 399999.999814 FORMAT "%13.6" EXTENDED_LIMITS -400000.000000 399999.999814 /end CHARACTERISTIC
/begin CHARACTERISTIC PCR_drChrgPmpCtlRmp.Neg_C "/" VALUE 0x800653C4 Kw_Ws32 399999.999814 RmpPrc 0.00 399999.999814 FORMAT "%13.6" EXTENDED_LIMITS -400000.000000 399999.999814 /end CHARACTERISTIC
/begin CHARACTERISTIC PCR_drCtlValOfsRmp.Pos_C "/" VALUE 0x80065B84 Val_Ws32 399999.999814 RmpPrc 0.00 399999.999814 FORMAT "%13.6" EXTENDED_LIMITS -400000.000000 399999.999814 /end CHARACTERISTIC
/begin CHARACTERISTIC PCR_drCtlValOfsRmp.Neg_C "/" VALUE 0x80065B88 Val_Ws32 399999.999814 RmpPrc 0.00 399999.999814 FORMAT "%13.6" EXTENDED_LIMITS -400000.000000 399999.999814 /end CHARACTERISTIC
/begin CHARACTERISTIC PCR_drGovMaxDyn.Pos_C "/" VALUE 0x80065748 Kw_Ws32 399999.999814 RmpPrc 0.00 399999.999814 FORMAT "%13.6" EXTENDED_LIMITS -400000.000000 399999.999814 /end CHARACTERISTIC
/begin CHARACTERISTIC PCR_drGovMaxDyn.Neg_C "/" VALUE 0x8006574C Kw_Ws32 399999.999814 RmpPrc 0.00 399999.999814 FORMAT "%13.6" EXTENDED_LIMITS -400000.000000 399999.999814 /end CHARACTERISTIC
/begin CHARACTERISTIC PCR_DT1Win.T1_C "DT1-Parameter des Ladedruckreglers/" VALUE 0x800653D0 Val_Ws32 4294.9662960 TimeDelay_s 0.0010000000689 4294.9672960 FORMAT "%12.7" EXTENDED_LIMITS 0.000002000000001 4294.9672960 /end CHARACTERISTIC
/begin CHARACTERISTIC PCR_DT1Win.Kd_C "DT1-Parameter des Ladedruckreglers/" VALUE 0x800653D4 Val_Ws32 9.99999996275 Kd_Pres_hPa2Prc 0.00 9.99999996275 FORMAT "%13.10" EXTENDED_LIMITS -400.000000000 399.999999814 /end CHARACTERISTIC
/begin CHARACTERISTIC PCR_DT1Win.KdPos_C "DT1-Parameter des Ladedruckreglers/" VALUE 0x800653D8 Val_Ws32 9.99999996275 Kd_Pres_hPa2Prc 0.00 9.99999996275 FORMAT "%13.10" EXTENDED_LIMITS -400.000000000 399.999999814 /end CHARACTERISTIC
/begin CHARACTERISTIC PCR_DT1Win.KdNeg_C "DT1-Parameter des Ladedruckreglers/" VALUE 0x800653DC Val_Ws32 9.99999996275 Kd_Pres_hPa2Prc 0.00 9.99999996275 FORMAT "%13.10" EXTENDED_LIMITS -400.000000000 399.999999814 /end CHARACTERISTIC
/begin CHARACTERISTIC PCR_DT1Win.WinPos_C "DT1-Parameter des Ladedruckreglers/" VALUE 0x800653E0 Val_Ws32 8500.00000000 Pres_hPa -5000.00000000 3500.00000000 FORMAT "%13.8" EXTENDED_LIMITS -2147483648.00 2147483647.00 /end CHARACTERISTIC
/begin CHARACTERISTIC PCR_DT1Win.WinNeg_C "DT1-Parameter des Ladedruckreglers/" VALUE 0x800653E4 Val_Ws32 8500.00000000 Pres_hPa -5000.00000000 3500.00000000 FORMAT "%13.8" EXTENDED_LIMITS -2147483648.00 2147483647.00 /end CHARACTERISTIC
/begin CHARACTERISTIC PCR_DT1WinLP.T1_C "/" VALUE 0x80065248 Val_Ws32 4294.9662960 TimeDelay_s 0.0010000000689 4294.9672960 FORMAT "%12.7" EXTENDED_LIMITS 0.000002000000001 4294.9672960 /end CHARACTERISTIC
/begin CHARACTERISTIC PCR_DT1WinLP.Kd_C "/" VALUE 0x8006524C Val_Ws32 9.99999996275 Kd_Pres_hPa2Prc 0.00 9.99999996275 FORMAT "%13.10" EXTENDED_LIMITS -400.000000000 399.999999814 /end CHARACTERISTIC
/begin CHARACTERISTIC PCR_DT1WinLP.KdPos_C "/" VALUE 0x80065250 Val_Ws32 9.99999996275 Kd_Pres_hPa2Prc 0.00 9.99999996275 FORMAT "%13.10" EXTENDED_LIMITS -400.000000000 399.999999814 /end CHARACTERISTIC
/begin CHARACTERISTIC PCR_DT1WinLP.KdNeg_C "/" VALUE 0x80065254 Val_Ws32 9.99999996275 Kd_Pres_hPa2Prc 0.00 9.99999996275 FORMAT "%13.10" EXTENDED_LIMITS -400.000000000 399.999999814 /end CHARACTERISTIC
/begin CHARACTERISTIC PCR_DT1WinLP.WinPos_C "/" VALUE 0x80065258 Val_Ws32 8500.00000000 Pres_hPa -5000.00000000 3500.00000000 FORMAT "%13.8" EXTENDED_LIMITS -2147483648.00 2147483647.00 /end CHARACTERISTIC
/begin CHARACTERISTIC PCR_DT1WinLP.WinNeg_C "/" VALUE 0x8006525C Val_Ws32 8500.00000000 Pres_hPa -5000.00000000 3500.00000000 FORMAT "%13.8" EXTENDED_LIMITS -2147483648.00 2147483647.00 /end CHARACTERISTIC
/begin CHARACTERISTIC PCR_facAirTempCtlCorEOM_CUR "Faktor lufttemperaturabhängige Korrektur Vorsteuerung Betriebsart Rgn" CURVE 0x80063CA8 Cur_Xs16Ws16 3.000000 Fact 0.00 3.000000 FORMAT "%8.6" EXTENDED_LIMITS -4.000000 3.999878
 /begin AXIS_DESCR STD_AXIS PCR_tAirCtlVal_mp Temp_Cels 16 -100.1400 199.8600 FORMAT "%8.4" EXTENDED_LIMITS -3549.940 3003.560 DEPOSIT ABSOLUTE /end AXIS_DESCR
/end CHARACTERISTIC
/begin CHARACTERISTIC PCR_facAirTempCtlCor_CUR "Lufttemperaturabhängiger Korrekturfaktor für den Ladedruck- Steueranteil" CURVE 0x8007AE9E Cur_Xs16Ws16 3.000000 Fact 0.00 3.000000 FORMAT "%8.6" EXTENDED_LIMITS -4.000000 3.999878
 /begin AXIS_DESCR STD_AXIS PCR_tAirCtlVal_mp Temp_Cels 16 -100.1400 199.8600 FORMAT "%8.4" EXTENDED_LIMITS -3549.940 3003.560 DEPOSIT ABSOLUTE /end AXIS_DESCR
/end CHARACTERISTIC
/begin CHARACTERISTIC PCR_facAirTempDesCorEOMQnt1_CUR "" CURVE 0x8007C708 Cur_Xs16Ws16 3.000000 Fact 0.00 3.000000 FORMAT "%8.6" EXTENDED_LIMITS -4.000000 3.999878
 /begin AXIS_DESCR STD_AXIS PCR_tAirDesVal_mp Temp_Cels 16 -100.1400 199.8600 FORMAT "%8.4" EXTENDED_LIMITS -3549.940 3003.560 DEPOSIT ABSOLUTE /end AXIS_DESCR
/end CHARACTERISTIC
/begin CHARACTERISTIC PCR_facAirTempDesCorLPEOMQnt1_CUR "" CURVE 0x80064E44 Cur_Xs16Ws16 3.000000 Fact 0.00 3.000000 FORMAT "%8.6" EXTENDED_LIMITS -4.000000 3.999878
 /begin AXIS_DESCR STD_AXIS PCR_tAirDesValLP Temp_Cels 4 -100.1400 199.8600 FORMAT "%8.4" EXTENDED_LIMITS -3549.940 3003.560 DEPOSIT ABSOLUTE /end AXIS_DESCR
/end CHARACTERISTIC
/begin CHARACTERISTIC PCR_facAirTempDesCorLP_CUR "" CURVE 0x800650AA Cur_Xs16Ws16 3.000000 Fact 0.00 3.000000 FORMAT "%8.6" EXTENDED_LIMITS -4.000000 3.999878
 /begin AXIS_DESCR STD_AXIS PCR_tAirDesValLP Temp_Cels 3 -100.0400 199.8600 FORMAT "%8.4" EXTENDED_LIMITS -3549.940 3003.560 DEPOSIT ABSOLUTE /end AXIS_DESCR
/end CHARACTERISTIC
/begin CHARACTERISTIC PCR_facAirTempDesCor_CUR "Lufttemperaturabhängiger Korrekturfaktor für die Ladedruck Sollwertbildung" CURVE 0x8007D09C Cur_Xs16Ws16 3.000000 Fact 0.00 3.000000 FORMAT "%8.6" EXTENDED_LIMITS -4.000000 3.999878
 /begin AXIS_DESCR STD_AXIS PCR_tAirDesVal_mp Temp_Cels 16 -100.1400 199.8600 FORMAT "%8.4" EXTENDED_LIMITS -3549.940 3003.560 DEPOSIT ABSOLUTE /end AXIS_DESCR
/end CHARACTERISTIC
/begin CHARACTERISTIC PCR_facCByVlvRmp_CUR "" CURVE 0x8007A684 Cur_Xs16Ws16 3.000000 CoEOMSwt_S16 0.00 3.000000 FORMAT "%8.6" EXTENDED_LIMITS -2.000000 1.999939
 /begin AXIS_DESCR STD_AXIS CoEOM_facRmpVal CoEOMSwt_S16 8 -100.1400 199.8600 FORMAT "%8.4" EXTENDED_LIMITS -2.000000 1.999939 DEPOSIT ABSOLUTE /end AXIS_DESCR
/end CHARACTERISTIC
/begin CHARACTERISTIC PCR_facDpCorr_CUR "" CURVE 0x800653E8 Kl_Xs16_Ws16 511.9922 Fact1 -256.0000 255.9922 FORMAT "%8.4"
 /begin AXIS_DESCR STD_AXIS PCR_dpBGDev_mp dp_dZ20 10 -350000.0 350000.0 FORMAT "%8.1" EXTENDED_LIMITS -327680.0 327670.0 DEPOSIT ABSOLUTE /end AXIS_DESCR
/end CHARACTERISTIC
/begin CHARACTERISTIC PCR_facD_MAP "Adaptionsfaktor der D-Verstärkung des Ladedruckreglers" MAP 0x80065412 Map_Xs16Ys16Ws16 50.00000 Fact1 0.00 50.00000 FORMAT "%8.5" EXTENDED_LIMITS -256.0000 255.9922
 /begin AXIS_DESCR STD_AXIS Epm_nEng EngN 10 0.00 8000.000 FORMAT "%8.3" EXTENDED_LIMITS -16384.00 16383.50 DEPOSIT ABSOLUTE /end AXIS_DESCR
 /begin AXIS_DESCR STD_AXIS PCR_qGov_mp InjMass 4 0.00 327.6700 FORMAT "%8.4" EXTENDED_LIMITS -327.6800 327.6700 DEPOSIT ABSOLUTE /end AXIS_DESCR
/end CHARACTERISTIC
/begin CHARACTERISTIC PCR_facEngTempCtlCorAutLP_MAP "" MAP 0x8007B124 Kf_Xs16_Ys16_Ws16 300.0000 Fact -100.0000 200.0000 FORMAT "%8.4" EXTENDED_LIMITS -4.000000 3.999878
 /begin AXIS_DESCR STD_AXIS PCR_tEngDesValLP Temp_Cels 8 -100.0400 7999.960 FORMAT "%8.3" EXTENDED_LIMITS -3549.940 3003.560 DEPOSIT ABSOLUTE /end AXIS_DESCR
 /begin AXIS_DESCR STD_AXIS PCR_qCtlValLP_mp InjMass 8 0.00 327.6700 FORMAT "%8.4" EXTENDED_LIMITS -327.6800 327.6700 DEPOSIT ABSOLUTE /end AXIS_DESCR
/end CHARACTERISTIC
/begin CHARACTERISTIC PCR_facEngTempCtlCorLP_MAP "" MAP 0x8007B1C8 Kf_Xs16_Ys16_Ws16 300.0000 Fact -100.0000 200.0000 FORMAT "%8.4" EXTENDED_LIMITS -4.000000 3.999878
 /begin AXIS_DESCR STD_AXIS PCR_tEngDesValLP Temp_Cels 8 -100.0400 7999.960 FORMAT "%8.3" EXTENDED_LIMITS -3549.940 3003.560 DEPOSIT ABSOLUTE /end AXIS_DESCR
 /begin AXIS_DESCR STD_AXIS PCR_qCtlValLP_mp InjMass 8 0.00 327.6700 FORMAT "%8.4" EXTENDED_LIMITS -327.6800 327.6700 DEPOSIT ABSOLUTE /end AXIS_DESCR
/end CHARACTERISTIC
/begin CHARACTERISTIC PCR_facEngTempCtlCor_MAP "Motortemperaturabhängiger Korrekturfaktor für den Ladedruck-Steueranteil" MAP 0x80063CEA Kf_Xs16_Ys16_Ws16 300.0000 Fact -100.0000 200.0000 FORMAT "%8.4" EXTENDED_LIMITS -4.000000 3.999878
 /begin AXIS_DESCR STD_AXIS PCR_tEngCtlVal_mp Temp_Cels 16 -100.0400 7999.960 FORMAT "%8.3" EXTENDED_LIMITS -3549.940 3003.560 DEPOSIT ABSOLUTE /end AXIS_DESCR
 /begin AXIS_DESCR STD_AXIS PCR_qCtlVal_mp InjMass 16 0.00 327.6700 FORMAT "%8.4" EXTENDED_LIMITS -327.6800 327.6700 DEPOSIT ABSOLUTE /end AXIS_DESCR
/end CHARACTERISTIC
/begin CHARACTERISTIC PCR_facEnvPresCtlCorAutLPEOMQnt1_CUR "" CURVE 0x8007B8FA Cur_Xs16Ws16 2.000000 Fact -0.5000000 1.500000 FORMAT "%8.6" EXTENDED_LIMITS -4.000000 3.999878
 /begin AXIS_DESCR STD_AXIS EnvP_p Pres_hPa 8 0.00 3500.000 FORMAT "%8.3" EXTENDED_LIMITS -32768.00 32767.00 DEPOSIT ABSOLUTE /end AXIS_DESCR
/end CHARACTERISTIC
/begin CHARACTERISTIC PCR_facEnvPresCtlCorAutLP_CUR "" CURVE 0x8007B26C Cur_Xs16Ws16 2.000000 Fact -0.5000000 1.500000 FORMAT "%8.6" EXTENDED_LIMITS -4.000000 3.999878
 /begin AXIS_DESCR STD_AXIS EnvP_p Pres_hPa 8 0.00 3500.000 FORMAT "%8.3" EXTENDED_LIMITS -32768.00 32767.00 DEPOSIT ABSOLUTE /end AXIS_DESCR
/end CHARACTERISTIC
/begin CHARACTERISTIC PCR_facEnvPresCtlCorEOMQnt1_CUR "Kennlinie: Atmosphärendruckabhängiger Korrekturfaktor für die Ladedruck-Steuerung für die erste auf Einspritzmenge basierte Betriebsart" CURVE 0x8007A9D4 Cur_Xs16Ws16 2.000000 Fact -0.5000000 1.500000 FORMAT "%8.6" EXTENDED_LIMITS -4.000000 3.999878
 /begin AXIS_DESCR STD_AXIS EnvP_p Pres_hPa 16 0.00 3500.000 FORMAT "%8.3" EXTENDED_LIMITS -32768.00 32767.00 DEPOSIT ABSOLUTE /end AXIS_DESCR
/end CHARACTERISTIC
/begin CHARACTERISTIC PCR_facEnvPresCtlCorLPEOMQnt1_CUR "" CURVE 0x8007B720 Cur_Xs16Ws16 2.000000 Fact -0.5000000 1.500000 FORMAT "%8.6" EXTENDED_LIMITS -4.000000 3.999878
 /begin AXIS_DESCR STD_AXIS EnvP_p Pres_hPa 8 0.00 3500.000 FORMAT "%8.3" EXTENDED_LIMITS -32768.00 32767.00 DEPOSIT ABSOLUTE /end AXIS_DESCR
/end CHARACTERISTIC
/begin CHARACTERISTIC PCR_facEnvPresCtlCorLP_CUR "" CURVE 0x8007B28E Cur_Xs16Ws16 2.000000 Fact -0.5000000 1.500000 FORMAT "%8.6" EXTENDED_LIMITS -4.000000 3.999878
 /begin AXIS_DESCR STD_AXIS EnvP_p Pres_hPa 8 0.00 3500.000 FORMAT "%8.3" EXTENDED_LIMITS -32768.00 32767.00 DEPOSIT ABSOLUTE /end AXIS_DESCR
/end CHARACTERISTIC
/begin CHARACTERISTIC PCR_facEnvPresCtlCor_CUR "Atmosphärendruckabhängiger Korrekturfaktor für die Ladedrucksteuerung" CURVE 0x80063F2E Cur_Xs16Ws16 2.000000 Fact -0.5000000 1.500000 FORMAT "%8.6" EXTENDED_LIMITS -4.000000 3.999878
 /begin AXIS_DESCR STD_AXIS EnvP_p Pres_hPa 16 0.00 3500.000 FORMAT "%8.3" EXTENDED_LIMITS -32768.00 32767.00 DEPOSIT ABSOLUTE /end AXIS_DESCR
/end CHARACTERISTIC
/begin CHARACTERISTIC PCR_facEnvPresDesCorEOMQnt1_CUR "" CURVE 0x8007C74A Cur_Xs16Ws16 2.000000 Fact -0.5000000 1.500000 FORMAT "%8.6" EXTENDED_LIMITS -4.000000 3.999878
 /begin AXIS_DESCR STD_AXIS EnvP_p Pres_hPa 16 0.00 3500.000 FORMAT "%8.3" EXTENDED_LIMITS -32768.00 32767.00 DEPOSIT ABSOLUTE /end AXIS_DESCR
/end CHARACTERISTIC
/begin CHARACTERISTIC PCR_facEnvPresDesCorLPEOMQnt1_CUR "" CURVE 0x80064E56 Cur_Xs16Ws16 2.000000 Fact -0.5000000 1.500000 FORMAT "%8.6" EXTENDED_LIMITS -4.000000 3.999878
 /begin AXIS_DESCR STD_AXIS EnvP_p Pres_hPa 4 0.00 3500.000 FORMAT "%8.3" EXTENDED_LIMITS -32768.00 32767.00 DEPOSIT ABSOLUTE /end AXIS_DESCR
/end CHARACTERISTIC
/begin CHARACTERISTIC PCR_facEnvPresDesCorLP_CUR "" CURVE 0x8006490E Cur_Xs16Ws16 2.000000 Fact -0.5000000 1.500000 FORMAT "%8.6" EXTENDED_LIMITS -4.000000 3.999878
 /begin AXIS_DESCR STD_AXIS EnvP_p Pres_hPa 4 0.00 3500.000 FORMAT "%8.3" EXTENDED_LIMITS -32768.00 32767.00 DEPOSIT ABSOLUTE /end AXIS_DESCR
/end CHARACTERISTIC
/begin CHARACTERISTIC PCR_facEnvPresDesCor_CUR "Atmosphärendruckabhängiger Korrekturfaktor für Ladedruck" CURVE 0x8007BAFC Cur_Xs16Ws16 2.000000 Fact -0.5000000 1.500000 FORMAT "%8.6" EXTENDED_LIMITS -4.000000 3.999878
 /begin AXIS_DESCR STD_AXIS EnvP_p Pres_hPa 16 0.00 3500.000 FORMAT "%8.3" EXTENDED_LIMITS -32768.00 32767.00 DEPOSIT ABSOLUTE /end AXIS_DESCR
/end CHARACTERISTIC
/begin CHARACTERISTIC PCR_facGovMaxCorr_CUR "" CURVE 0x80065750 Kl_Xs16_Ws16 5.000000 Fact1 0.00 5.000000 FORMAT "%8.6" EXTENDED_LIMITS -256.0000 255.9922
 /begin AXIS_DESCR STD_AXIS PFltLd_resFlwRaw Res_hPaHrPerCM 8 -3.276800 3.276700 FORMAT "%8.6" DEPOSIT ABSOLUTE /end AXIS_DESCR
/end CHARACTERISTIC
/begin CHARACTERISTIC PCR_facI_MAP "Adaptionsfaktor der I-Verstärkung des Ladedruckreglers" MAP 0x80065482 Map_Xs16Ys16Ws16 0.3984375 Fact1 0.00 0.3984375 FORMAT "%9.7" EXTENDED_LIMITS -256.0000 255.9922
 /begin AXIS_DESCR STD_AXIS Epm_nEng EngN 10 0.00 8000.000 FORMAT "%8.3" EXTENDED_LIMITS -16384.00 16383.50 DEPOSIT ABSOLUTE /end AXIS_DESCR
 /begin AXIS_DESCR STD_AXIS PCR_qGov_mp InjMass 4 0.00 327.6700 FORMAT "%8.4" EXTENDED_LIMITS -327.6800 327.6700 DEPOSIT ABSOLUTE /end AXIS_DESCR
/end CHARACTERISTIC
/begin CHARACTERISTIC PCR_facLPD_MAP "" MAP 0x80065260 Map_Xs16Ys16Ws16 50.00000 Fact1 0.00 50.00000 FORMAT "%8.5" EXTENDED_LIMITS -256.0000 255.9922
 /begin AXIS_DESCR STD_AXIS Epm_nEng EngN 4 0.00 8000.000 FORMAT "%8.3" EXTENDED_LIMITS -16384.00 16383.50 DEPOSIT ABSOLUTE /end AXIS_DESCR
 /begin AXIS_DESCR STD_AXIS PCR_qGovLP_mp InjMass 4 0.00 327.6700 FORMAT "%8.4" EXTENDED_LIMITS -327.6800 327.6700 DEPOSIT ABSOLUTE /end AXIS_DESCR
/end CHARACTERISTIC
/begin CHARACTERISTIC PCR_facLPI_MAP "" MAP 0x80065294 Map_Xs16Ys16Ws16 1.000000 Fact1 0.00 1.000000 FORMAT "%8.6" EXTENDED_LIMITS -256.0000 255.9922
 /begin AXIS_DESCR STD_AXIS Epm_nEng EngN 4 0.00 8000.000 FORMAT "%8.3" EXTENDED_LIMITS -16384.00 16383.50 DEPOSIT ABSOLUTE /end AXIS_DESCR
 /begin AXIS_DESCR STD_AXIS PCR_qGovLP_mp InjMass 4 0.00 327.6700 FORMAT "%8.4" EXTENDED_LIMITS -327.6800 327.6700 DEPOSIT ABSOLUTE /end AXIS_DESCR
/end CHARACTERISTIC
/begin CHARACTERISTIC PCR_facLPP_MAP "" MAP 0x800652C8 Map_Xs16Ys16Ws16 50.00000 Fact1 0.00 50.00000 FORMAT "%8.5" EXTENDED_LIMITS -256.0000 255.9922
 /begin AXIS_DESCR STD_AXIS Epm_nEng EngN 4 0.00 8000.000 FORMAT "%8.3" EXTENDED_LIMITS -16384.00 16383.50 DEPOSIT ABSOLUTE /end AXIS_DESCR
 /begin AXIS_DESCR STD_AXIS PCR_qGovLP_mp InjMass 4 0.00 327.6700 FORMAT "%8.4" EXTENDED_LIMITS -327.6800 327.6700 DEPOSIT ABSOLUTE /end AXIS_DESCR
/end CHARACTERISTIC
/begin CHARACTERISTIC PCR_facmFlowRaw_MAP "" MAP 0x800654F2 Kf_Xs16_Ys16_Ws16 5.000000 Fact1 0.00 5.000000 FORMAT "%8.6" EXTENDED_LIMITS -256.0000 255.9922
 /begin AXIS_DESCR STD_AXIS Epm_nEng EngN 10 0.00 8000.000 FORMAT "%8.3" EXTENDED_LIMITS -16384.00 16383.50 DEPOSIT ABSOLUTE /end AXIS_DESCR
 /begin AXIS_DESCR STD_AXIS PFltLd_resFlwRaw Res_hPaHrPerCM 8 0.00 300.0000 FORMAT "%8.4" EXTENDED_LIMITS -3.276800 3.276700 DEPOSIT ABSOLUTE /end AXIS_DESCR
/end CHARACTERISTIC
/begin CHARACTERISTIC PCR_facPFltLdCtlVal_CUR "" CURVE 0x80063F70 Cur_Xs16Ws16 511.9922 Fact1 -256.0000 255.9922 FORMAT "%8.4"
 /begin AXIS_DESCR STD_AXIS PFltLd_resFlwRaw Res_hPaHrPerCM 16 -3.276800 3.276700 FORMAT "%8.6" DEPOSIT ABSOLUTE /end AXIS_DESCR
/end CHARACTERISTIC
/begin CHARACTERISTIC PCR_facPresPFltMax_CUR "Korrektur der Obergrenze der Ladedruckreglerstellgröße in Abhängigkeit vom Adaptierten Druck vor Partikelfilter" CURVE 0x8007D798 Cur_Xs16Ws16 7.999878 Fact -4.000000 3.999878 FORMAT "%8.6"
 /begin AXIS_DESCR STD_AXIS Exh_pAdapPPFltUs Pres_hPa 16 -32768.00 3500.00 FORMAT "%8.2" EXTENDED_LIMITS -32768.00 32767.00 DEPOSIT ABSOLUTE /end AXIS_DESCR
/end CHARACTERISTIC
/begin CHARACTERISTIC PCR_facPresPFltMin_CUR "Korrektur der Untergrenze der Ladedruckreglerstellgröße in Abhängigkeit vom Adaptierten Druck vor Partikelfilte" CURVE 0x8007D7DA Cur_Xs16Ws16 7.999878 Fact -4.000000 3.999878 FORMAT "%8.6"
 /begin AXIS_DESCR STD_AXIS Exh_pAdapPPFltUs Pres_hPa 16 -32768.00 3500.00 FORMAT "%8.2" EXTENDED_LIMITS -32768.00 32767.00 DEPOSIT ABSOLUTE /end AXIS_DESCR
/end CHARACTERISTIC
/begin CHARACTERISTIC PCR_facP_MAP "Adaptionsfaktor der P-Verstärkung des Ladedruckreglers" MAP 0x800655BA Map_Xs16Ys16Ws16 50.00000 Fact1 0.00 50.00000 FORMAT "%8.5" EXTENDED_LIMITS -256.0000 255.9922
 /begin AXIS_DESCR STD_AXIS Epm_nEng EngN 10 0.00 8000.000 FORMAT "%8.3" EXTENDED_LIMITS -16384.00 16383.50 DEPOSIT ABSOLUTE /end AXIS_DESCR
 /begin AXIS_DESCR STD_AXIS PCR_qGov_mp InjMass 4 0.00 327.6700 FORMAT "%8.4" EXTENDED_LIMITS -327.6800 327.6700 DEPOSIT ABSOLUTE /end AXIS_DESCR
/end CHARACTERISTIC
/begin CHARACTERISTIC PCR_facRmpValCtlCorAutLP_CUR "" CURVE 0x8007BAD4 Cur_Xs16Ws16 3.000000 CoEOMSwt_S16 0.00 3.000000 FORMAT "%8.6" EXTENDED_LIMITS -2.000000 1.999939
 /begin AXIS_DESCR STD_AXIS CoEOM_facRmpVal CoEOMSwt_S16 8 -100.1400 199.8600 FORMAT "%8.4" EXTENDED_LIMITS -2.000000 1.999939 DEPOSIT ABSOLUTE /end AXIS_DESCR
/end CHARACTERISTIC
/begin CHARACTERISTIC PCR_facRmpValCtlCorLP_CUR "" CURVE 0x8007B6F8 Cur_Xs16Ws16 3.000000 CoEOMSwt_S16 0.00 3.000000 FORMAT "%8.6" EXTENDED_LIMITS -2.000000 1.999939
 /begin AXIS_DESCR STD_AXIS CoEOM_facRmpVal CoEOMSwt_S16 8 -100.1400 199.8600 FORMAT "%8.4" EXTENDED_LIMITS -2.000000 1.999939 DEPOSIT ABSOLUTE /end AXIS_DESCR
/end CHARACTERISTIC
/begin CHARACTERISTIC PCR_facRmpValCtlCorQnt1_CUR "" CURVE 0x80063FB2 Cur_Xs16Ws16 3.000000 CoEOMSwt_S16 0.00 3.000000 FORMAT "%8.6" EXTENDED_LIMITS -2.000000 1.999939
 /begin AXIS_DESCR STD_AXIS PCR_facRmpCtlCor_mp CoEOMSwt_S16 13 0.00 3.000000 FORMAT "%8.6" EXTENDED_LIMITS -2.000000 1.999939 DEPOSIT ABSOLUTE /end AXIS_DESCR
/end CHARACTERISTIC
/begin CHARACTERISTIC PCR_facRmpValDesCorLP_CUR "" CURVE 0x80064DFC Cur_Xs16Ws16 3.000000 CoEOMSwt_S16 0.00 3.000000 FORMAT "%8.6" EXTENDED_LIMITS -2.000000 1.999939
 /begin AXIS_DESCR STD_AXIS CoEOM_facRmpVal CoEOMSwt_S16 16 -100.0000 199.0000 FORMAT "%8.4" EXTENDED_LIMITS -2.000000 1.999939 DEPOSIT ABSOLUTE /end AXIS_DESCR
/end CHARACTERISTIC
/begin CHARACTERISTIC PCR_facRmpValDesCor_CUR "" CURVE 0x8007C698 Cur_Xs16Ws16 3.000000 CoEOMSwt_S16 0.00 3.000000 FORMAT "%8.6" EXTENDED_LIMITS -2.000000 1.999939
 /begin AXIS_DESCR STD_AXIS CoEOM_facRmpVal CoEOMSwt_S16 13 -100.1400 199.8600 FORMAT "%8.4" EXTENDED_LIMITS -2.000000 1.999939 DEPOSIT ABSOLUTE /end AXIS_DESCR
/end CHARACTERISTIC
/begin CHARACTERISTIC PCR_facT1LP_MAP "" MAP 0x800652FC Map_Xs16Ys16Ws16 50.00000 Fact1 0.00 50.00000 FORMAT "%8.5" EXTENDED_LIMITS -256.0000 255.9922
 /begin AXIS_DESCR STD_AXIS Epm_nEng EngN 4 0.00 8000.000 FORMAT "%8.3" EXTENDED_LIMITS -16384.00 16383.50 DEPOSIT ABSOLUTE /end AXIS_DESCR
 /begin AXIS_DESCR STD_AXIS PCR_qGovLP_mp InjMass 4 0.00 327.6700 FORMAT "%8.4" EXTENDED_LIMITS -327.6800 327.6700 DEPOSIT ABSOLUTE /end AXIS_DESCR
/end CHARACTERISTIC
/begin CHARACTERISTIC PCR_facT1_MAP "Adaptionsfaktor für Verzögerungszeit des DT1-Gliedes" MAP 0x8006562A Map_Xs16Ys16Ws16 50.00000 Fact1 0.00 50.00000 FORMAT "%8.5" EXTENDED_LIMITS -256.0000 255.9922
 /begin AXIS_DESCR STD_AXIS Epm_nEng EngN 10 0.00 8000.000 FORMAT "%8.3" EXTENDED_LIMITS -16384.00 16383.50 DEPOSIT ABSOLUTE /end AXIS_DESCR
 /begin AXIS_DESCR STD_AXIS PCR_qGov_mp InjMass 10 -327.6800 327.6700 FORMAT "%8.4" DEPOSIT ABSOLUTE /end AXIS_DESCR
/end CHARACTERISTIC
/begin CHARACTERISTIC PCR_facTempDesCorEOMQnt1_MAP "" MAP 0x8007C78C Map_Xs16Ys16Ws16 4000.000 Fact 0.00 4000.000 FORMAT "%8.3" EXTENDED_LIMITS -4.000000 3.999878
 /begin AXIS_DESCR STD_AXIS PCR_tDesVal_mp Temp_Cels 16 -100.1400 199.8600 FORMAT "%8.4" EXTENDED_LIMITS -3549.940 3003.560 DEPOSIT ABSOLUTE /end AXIS_DESCR
 /begin AXIS_DESCR STD_AXIS PCR_qDesValInl_mp InjMass 16 0.00 200.0000 FORMAT "%8.4" EXTENDED_LIMITS -327.6800 327.6700 DEPOSIT ABSOLUTE /end AXIS_DESCR
/end CHARACTERISTIC
/begin CHARACTERISTIC PCR_facTempDesCorLPEOMQnt1_MAP "" MAP 0x80064E68 Map_Xs16Ys16Ws16 4000.000 Fact 0.00 4000.000 FORMAT "%8.3" EXTENDED_LIMITS -4.000000 3.999878
 /begin AXIS_DESCR STD_AXIS PCR_tDesValLP_mp Temp_Cels 4 -100.1400 199.8600 FORMAT "%8.4" EXTENDED_LIMITS -3549.940 3003.560 DEPOSIT ABSOLUTE /end AXIS_DESCR
 /begin AXIS_DESCR STD_AXIS PCR_qDesValInlLP_mp InjMass 4 0.00 200.0000 FORMAT "%8.4" EXTENDED_LIMITS -327.6800 327.6700 DEPOSIT ABSOLUTE /end AXIS_DESCR
/end CHARACTERISTIC
/begin CHARACTERISTIC PCR_facTempDesCorLP_MAP "" MAP 0x80064920 Kf_Xs16_Ys16_Ws16 7.999878 Fact -4.000000 3.999878 FORMAT "%8.6"
 /begin AXIS_DESCR STD_AXIS PCR_tDesValLP_mp Temp_Cels 4 -100.1400 199.8600 FORMAT "%8.4" EXTENDED_LIMITS -3549.940 3003.560 DEPOSIT ABSOLUTE /end AXIS_DESCR
 /begin AXIS_DESCR STD_AXIS PCR_qDesValLP_mp InjMass 4 0.00 200.0000 FORMAT "%8.4" EXTENDED_LIMITS -327.6800 327.6700 DEPOSIT ABSOLUTE /end AXIS_DESCR
/end CHARACTERISTIC
/begin CHARACTERISTIC PCR_facTempDesCor_MAP "Temperaturabhängiger Korrekturfaktor für die Sollwertberechnung" MAP 0x8007BB3E Kf_Xs16_Ys16_Ws16 7.999878 Fact -4.000000 3.999878 FORMAT "%8.6"
 /begin AXIS_DESCR STD_AXIS PCR_tDesVal_mp Temp_Cels 16 -100.1400 199.8600 FORMAT "%8.4" EXTENDED_LIMITS -3549.940 3003.560 DEPOSIT ABSOLUTE /end AXIS_DESCR
 /begin AXIS_DESCR STD_AXIS PCR_qDesVal_mp InjMass 16 0.00 200.0000 FORMAT "%8.4" EXTENDED_LIMITS -327.6800 327.6700 DEPOSIT ABSOLUTE /end AXIS_DESCR
/end CHARACTERISTIC
/begin CHARACTERISTIC PCR_GovMin_CUR "Kennlinie für minimalen Schwellwert der Einspritzmenge bzw. inneres Drehmoment" CURVE 0x8007D0E2 Cur_Xs16Ws16 200.0000 InjMass 0.00 200.0000 FORMAT "%8.4" EXTENDED_LIMITS -327.6800 327.6700
 /begin AXIS_DESCR STD_AXIS Epm_nEng EngN 25 0.00 8000.000 FORMAT "%8.3" EXTENDED_LIMITS -16384.00 16383.50 DEPOSIT ABSOLUTE /end AXIS_DESCR
/end CHARACTERISTIC
/begin CHARACTERISTIC PCR_GovOffEOMLP_CUR "" CURVE 0x800651A0 Cur_Xs16Ws16 327.6700 InjMass 0.00 327.6700 FORMAT "%8.4" EXTENDED_LIMITS -327.6800 327.6700
 /begin AXIS_DESCR STD_AXIS Epm_nEng EngN 8 0.00 8000.000 FORMAT "%8.3" EXTENDED_LIMITS -16384.00 16383.50 DEPOSIT ABSOLUTE /end AXIS_DESCR
/end CHARACTERISTIC
/begin CHARACTERISTIC PCR_GovOffEOM_CUR "Kennlinie für untere Grenze der Einspritzmenge bzw. des inneren Drehmoments im Betriebsartmodus" CURVE 0x8007D5DC Cur_Xs16Ws16 327.6700 InjMass 0.00 327.6700 FORMAT "%8.4" EXTENDED_LIMITS -327.6800 327.6700
 /begin AXIS_DESCR STD_AXIS Epm_nEng EngN 25 0.00 8000.000 FORMAT "%8.3" EXTENDED_LIMITS -16384.00 16383.50 DEPOSIT ABSOLUTE /end AXIS_DESCR
/end CHARACTERISTIC
/begin CHARACTERISTIC PCR_GovOffLP_CUR "" CURVE 0x800651C2 Cur_Xs16Ws16 327.6700 InjMass 0.00 327.6700 FORMAT "%8.4" EXTENDED_LIMITS -327.6800 327.6700
 /begin AXIS_DESCR STD_AXIS Epm_nEng EngN 8 0.00 8000.000 FORMAT "%8.3" EXTENDED_LIMITS -16384.00 16383.50 DEPOSIT ABSOLUTE /end AXIS_DESCR
/end CHARACTERISTIC
/begin CHARACTERISTIC PCR_GovOff_CUR "Kennlinie für untere Grenze der Einspritzmenge bzw. des inneren Drehmoments im Normalbetrieb" CURVE 0x8007D642 Cur_Xs16Ws16 327.6700 InjMass 0.00 327.6700 FORMAT "%8.4" EXTENDED_LIMITS -327.6800 327.6700
 /begin AXIS_DESCR STD_AXIS Epm_nEng EngN 25 0.00 8000.000 FORMAT "%8.3" EXTENDED_LIMITS -16384.00 16383.50 DEPOSIT ABSOLUTE /end AXIS_DESCR
/end CHARACTERISTIC
/begin CHARACTERISTIC PCR_GovOnEOMLP_CUR "" CURVE 0x800651E4 Cur_Xs16Ws16 327.6700 InjMass 0.00 327.6700 FORMAT "%8.4" EXTENDED_LIMITS -327.6800 327.6700
 /begin AXIS_DESCR STD_AXIS Epm_nEng EngN 8 0.00 8000.000 FORMAT "%8.3" EXTENDED_LIMITS -16384.00 16383.50 DEPOSIT ABSOLUTE /end AXIS_DESCR
/end CHARACTERISTIC
/begin CHARACTERISTIC PCR_GovOnEOM_CUR "Kennlinie für obere Grenze der Einspritzmenge bzw. des inneren Drehmoments im Betriebsartmodus" CURVE 0x8007D6A8 Cur_Xs16Ws16 327.6700 InjMass 0.00 327.6700 FORMAT "%8.4" EXTENDED_LIMITS -327.6800 327.6700
 /begin AXIS_DESCR STD_AXIS Epm_nEng EngN 25 0.00 8000.000 FORMAT "%8.3" EXTENDED_LIMITS -16384.00 16383.50 DEPOSIT ABSOLUTE /end AXIS_DESCR
/end CHARACTERISTIC
/begin CHARACTERISTIC PCR_GovOnLP_CUR "" CURVE 0x80065206 Cur_Xs16Ws16 327.6700 InjMass 0.00 327.6700 FORMAT "%8.4" EXTENDED_LIMITS -327.6800 327.6700
 /begin AXIS_DESCR STD_AXIS Epm_nEng EngN 8 0.00 8000.000 FORMAT "%8.3" EXTENDED_LIMITS -16384.00 16383.50 DEPOSIT ABSOLUTE /end AXIS_DESCR
/end CHARACTERISTIC
/begin CHARACTERISTIC PCR_GovOn_CUR "Kennlinie für obere Grenze der Einspritzmenge bzw. des inneren Drehmoments im Normalbetrieb" CURVE 0x8007D70E Cur_Xs16Ws16 327.6700 InjMass 0.00 327.6700 FORMAT "%8.4" EXTENDED_LIMITS -327.6800 327.6700
 /begin AXIS_DESCR STD_AXIS Epm_nEng EngN 25 0.00 8000.000 FORMAT "%8.3" EXTENDED_LIMITS -16384.00 16383.50 DEPOSIT ABSOLUTE /end AXIS_DESCR
/end CHARACTERISTIC
/begin CHARACTERISTIC PCR_I.Ki_C "I-Parameter des Ladedruckreglers/" VALUE 0x80065720 Kw_Ws32 1.50000118992 Ki_Pres_hPa2Prc 0.00 1.50000118992 FORMAT "%13.11" EXTENDED_LIMITS -12207.0312500 12207.0312443 /end CHARACTERISTIC
/begin CHARACTERISTIC PCR_I.KiPos_C "I-Parameter des Ladedruckreglers/" VALUE 0x80065724 Kw_Ws32 1.50000118992 Ki_Pres_hPa2Prc 0.00 1.50000118992 FORMAT "%13.11" EXTENDED_LIMITS -12207.0312500 12207.0312443 /end CHARACTERISTIC
/begin CHARACTERISTIC PCR_I.KiNeg_C "I-Parameter des Ladedruckreglers/" VALUE 0x80065728 Kw_Ws32 1.50000118992 Ki_Pres_hPa2Prc 0.00 1.50000118992 FORMAT "%13.11" EXTENDED_LIMITS -12207.0312500 12207.0312443 /end CHARACTERISTIC
/begin CHARACTERISTIC PCR_I.WinPos_C "I-Parameter des Ladedruckreglers/" VALUE 0x8006572C Kw_Ws32 2147487148.00 Pres_hPa -2147483648.00 3500.00 FORMAT "%13.2" EXTENDED_LIMITS -2147483648.00 2147483647.00 /end CHARACTERISTIC
/begin CHARACTERISTIC PCR_I.WinNeg_C "I-Parameter des Ladedruckreglers/" VALUE 0x80065730 Kw_Ws32 2147487148.00 Pres_hPa -2147483648.00 3500.00 FORMAT "%13.2" EXTENDED_LIMITS -2147483648.00 2147483647.00 /end CHARACTERISTIC
/begin CHARACTERISTIC PCR_I1OfsCalc.Ki_C "/" VALUE 0x80065B8C Val_Ws32 1999999.99953 Ki -1000000.00000 999999.999534 FORMAT "%13.5" /end CHARACTERISTIC
/begin CHARACTERISTIC PCR_I1OfsCalc.KiPos_C "/" VALUE 0x80065B90 Val_Ws32 1999999.99953 Ki -1000000.00000 999999.999534 FORMAT "%13.5" /end CHARACTERISTIC
/begin CHARACTERISTIC PCR_I1OfsCalc.KiNeg_C "/" VALUE 0x80065B94 Val_Ws32 1999999.99953 Ki -1000000.00000 999999.999534 FORMAT "%13.5" /end CHARACTERISTIC
/begin CHARACTERISTIC PCR_I1OfsCalc.WinPos_C "/" VALUE 0x80065B98 Val_Ws32 52428799.9878 Prc -26214400.0000 26214399.9878 FORMAT "%13.4" /end CHARACTERISTIC
/begin CHARACTERISTIC PCR_I1OfsCalc.WinNeg_C "/" VALUE 0x80065B9C Val_Ws32 52428799.9878 Prc -26214400.0000 26214399.9878 FORMAT "%13.4" /end CHARACTERISTIC
/begin CHARACTERISTIC PCR_I2OfsCalc.Ki_C "/" VALUE 0x80065BA0 Val_Ws32 1999999.99953 Ki -1000000.00000 999999.999534 FORMAT "%13.5" /end CHARACTERISTIC
/begin CHARACTERISTIC PCR_I2OfsCalc.KiPos_C "/" VALUE 0x80065BA4 Val_Ws32 1999999.99953 Ki -1000000.00000 999999.999534 FORMAT "%13.5" /end CHARACTERISTIC
/begin CHARACTERISTIC PCR_I2OfsCalc.KiNeg_C "/" VALUE 0x80065BA8 Val_Ws32 1999999.99953 Ki -1000000.00000 999999.999534 FORMAT "%13.5" /end CHARACTERISTIC
/begin CHARACTERISTIC PCR_I2OfsCalc.WinPos_C "/" VALUE 0x80065BAC Val_Ws32 52428799.9878 Prc -26214400.0000 26214399.9878 FORMAT "%13.4" /end CHARACTERISTIC
/begin CHARACTERISTIC PCR_I2OfsCalc.WinNeg_C "/" VALUE 0x80065BB0 Val_Ws32 52428799.9878 Prc -26214400.0000 26214399.9878 FORMAT "%13.4" /end CHARACTERISTIC
/begin CHARACTERISTIC PCR_I3OfsCalc.Ki_C "/" VALUE 0x80065BB4 Val_Ws32 1999999.99953 Ki -1000000.00000 999999.999534 FORMAT "%13.5" /end CHARACTERISTIC
/begin CHARACTERISTIC PCR_I3OfsCalc.KiPos_C "/" VALUE 0x80065BB8 Val_Ws32 1999999.99953 Ki -1000000.00000 999999.999534 FORMAT "%13.5" /end CHARACTERISTIC
/begin CHARACTERISTIC PCR_I3OfsCalc.KiNeg_C "/" VALUE 0x80065BBC Val_Ws32 1999999.99953 Ki -1000000.00000 999999.999534 FORMAT "%13.5" /end CHARACTERISTIC
/begin CHARACTERISTIC PCR_I3OfsCalc.WinPos_C "/" VALUE 0x80065BC0 Val_Ws32 52428799.9878 Prc -26214400.0000 26214399.9878 FORMAT "%13.4" /end CHARACTERISTIC
/begin CHARACTERISTIC PCR_I3OfsCalc.WinNeg_C "/" VALUE 0x80065BC4 Val_Ws32 52428799.9878 Prc -26214400.0000 26214399.9878 FORMAT "%13.4" /end CHARACTERISTIC
/begin CHARACTERISTIC PCR_I4OfsCalc.Ki_C "/" VALUE 0x80065BC8 Val_Ws32 1999999.99953 Ki -1000000.00000 999999.999534 FORMAT "%13.5" /end CHARACTERISTIC
/begin CHARACTERISTIC PCR_I4OfsCalc.KiPos_C "/" VALUE 0x80065BCC Val_Ws32 1999999.99953 Ki -1000000.00000 999999.999534 FORMAT "%13.5" /end CHARACTERISTIC
/begin CHARACTERISTIC PCR_I4OfsCalc.KiNeg_C "/" VALUE 0x80065BD0 Val_Ws32 1999999.99953 Ki -1000000.00000 999999.999534 FORMAT "%13.5" /end CHARACTERISTIC
/begin CHARACTERISTIC PCR_I4OfsCalc.WinPos_C "/" VALUE 0x80065BD4 Val_Ws32 52428799.9878 Prc -26214400.0000 26214399.9878 FORMAT "%13.4" /end CHARACTERISTIC
/begin CHARACTERISTIC PCR_I4OfsCalc.WinNeg_C "/" VALUE 0x80065BD8 Val_Ws32 52428799.9878 Prc -26214400.0000 26214399.9878 FORMAT "%13.4" /end CHARACTERISTIC
/begin CHARACTERISTIC PCR_IWinLP.Ki_C "/" VALUE 0x80065330 Kw_Ws32 24414.0624943 Ki_Pres_hPa2Prc -12207.0312500 12207.0312443 FORMAT "%13.7" /end CHARACTERISTIC
/begin CHARACTERISTIC PCR_IWinLP.KiPos_C "/" VALUE 0x80065334 Kw_Ws32 24414.0624943 Ki_Pres_hPa2Prc -12207.0312500 12207.0312443 FORMAT "%13.7" /end CHARACTERISTIC
/begin CHARACTERISTIC PCR_IWinLP.KiNeg_C "/" VALUE 0x80065338 Kw_Ws32 24414.0624943 Ki_Pres_hPa2Prc -12207.0312500 12207.0312443 FORMAT "%13.7" /end CHARACTERISTIC
/begin CHARACTERISTIC PCR_IWinLP.WinPos_C "/" VALUE 0x8006533C Kw_Ws32 2147487148.00 Pres_hPa -2147483648.00 3500.00 FORMAT "%13.2" EXTENDED_LIMITS -2147483648.00 2147483647.00 /end CHARACTERISTIC
/begin CHARACTERISTIC PCR_IWinLP.WinNeg_C "/" VALUE 0x80065340 Kw_Ws32 2147487148.00 Pres_hPa -2147483648.00 3500.00 FORMAT "%13.2" EXTENDED_LIMITS -2147483648.00 2147483647.00 /end CHARACTERISTIC
/begin CHARACTERISTIC PCR_LPWrkSph2_C "" VALUE 0x8007DBC8 Val_Ws16 327.6700 InjMass 0.00 327.6700 FORMAT "%8.4" EXTENDED_LIMITS -327.6800 327.6700 /end CHARACTERISTIC
/begin CHARACTERISTIC PCR_LPWrkSph3_C "" VALUE 0x8007DBCA Val_Ws16 327.6700 InjMass 0.00 327.6700 FORMAT "%8.4" EXTENDED_LIMITS -327.6800 327.6700 /end CHARACTERISTIC
/begin CHARACTERISTIC PCR_mskOfsCalcNoRls_C "" VALUE 0x80065BDC Val_Wu16 65535.00 OneToOne 0.00 65535.00 FORMAT "%8.2" /end CHARACTERISTIC
/begin CHARACTERISTIC PCR_mskOfsCalcResetVal_C "" VALUE 0x80065BDE Val_Wu16 65535.00 OneToOne 0.00 65535.00 FORMAT "%8.2" /end CHARACTERISTIC
/begin CHARACTERISTIC PCR_mskOfsCalcRlsPCRCond_C "Maske für Auswahl der relevanten Bits aus PCR_stPCRBits" VALUE 0x80065BE0 Val_Wu32 65535.0000000 OneToOne 0.00 65535.0000000 FORMAT "%13.7" EXTENDED_LIMITS 0.00 4294967295.00 /end CHARACTERISTIC
/begin CHARACTERISTIC PCR_mskOfsCalcStopLearn_C "" VALUE 0x80065BE4 Val_Wu16 65535.00 OneToOne 0.00 65535.00 FORMAT "%8.2" /end CHARACTERISTIC
/begin CHARACTERISTIC PCR_nCldStrt_C "untere Drehzahlgrenze für Kaltstarterkennung" VALUE 0x8007D81E Val_Ws16 32767.50 EngN1 -16384.00 16383.50 FORMAT "%8.2" /end CHARACTERISTIC
/begin CHARACTERISTIC PCR_nLimMax_C "" VALUE 0x800650CA Kw_Ws16 6000.000 EngN 0.00 6000.000 FORMAT "%8.3" EXTENDED_LIMITS -16384.00 16383.50 /end CHARACTERISTIC
/begin CHARACTERISTIC PCR_nLimMin_C "" VALUE 0x800650CC Kw_Ws16 6000.000 EngN 0.00 6000.000 FORMAT "%8.3" EXTENDED_LIMITS -16384.00 16383.50 /end CHARACTERISTIC
/begin CHARACTERISTIC PCR_nLPWrkSph2_C "obere Drehzahlgrenze des Arbeitsbereiches 2(LP)" VALUE 0x8007DBCC Val_Ws16 8000.000 EngN1 0.00 8000.000 FORMAT "%8.3" EXTENDED_LIMITS -16384.00 16383.50 /end CHARACTERISTIC
/begin CHARACTERISTIC PCR_nLPWrkSph3_C "obere Drehzahlgrenze des Arbeitsbereiches 3(LP)" VALUE 0x8007DBCE Val_Ws16 8000.000 EngN1 0.00 8000.000 FORMAT "%8.3" EXTENDED_LIMITS -16384.00 16383.50 /end CHARACTERISTIC
/begin CHARACTERISTIC PCR_nOfsCalc1_C "" VALUE 0x80065BE6 Val_Ws16 6000.000 EngN 0.00 6000.000 FORMAT "%8.3" EXTENDED_LIMITS -16384.00 16383.50 /end CHARACTERISTIC
/begin CHARACTERISTIC PCR_nOfsCalc2_C "" VALUE 0x80065BE8 Val_Ws16 6000.000 EngN 0.00 6000.000 FORMAT "%8.3" EXTENDED_LIMITS -16384.00 16383.50 /end CHARACTERISTIC
/begin CHARACTERISTIC PCR_nOfsCalcRlsMax_C "" VALUE 0x80065BEA Val_Ws16 6000.000 EngN 0.00 6000.000 FORMAT "%8.3" EXTENDED_LIMITS -16384.00 16383.50 /end CHARACTERISTIC
/begin CHARACTERISTIC PCR_nOfsCalcRlsMin_C "" VALUE 0x80065BEC Val_Ws16 6000.000 EngN 0.00 6000.000 FORMAT "%8.3" EXTENDED_LIMITS -16384.00 16383.50 /end CHARACTERISTIC
/begin CHARACTERISTIC PCR_numAirTempCtlVal_C "Index zur Auswahl der Lufttemperatur für den Ladedruck-Steuranteil" VALUE 0x80063FE8 Val_Wu8 2.00000000000 AirTempFldSel 0.00 2.00000000000 FORMAT "%13.11" /end CHARACTERISTIC
/begin CHARACTERISTIC PCR_numAirTempDesValLP_C "" VALUE 0x80064954 Val_Wu8 2.00000000000 AirTempFldSel 0.00 2.00000000000 FORMAT "%13.11" /end CHARACTERISTIC
/begin CHARACTERISTIC PCR_numAirTempDesVal_C "Index zur Auswahl der Lufttemperatur für die Ladedrucksollwertberechnung" VALUE 0x8007BD82 Val_Wu8 2.00000000000 AirTempFldSel 0.00 2.00000000000 FORMAT "%13.11" /end CHARACTERISTIC
/begin CHARACTERISTIC PCR_numAirTempOfsCalc_C "Auswahl LuftTemperaturArray PCR_OfsCalc" VALUE 0x80065BEE Val_Wu8 255.0 OneToOne 0.00 255.0 FORMAT "%5.1" /end CHARACTERISTIC
/begin CHARACTERISTIC PCR_numEngTempCtlVal_C "Index zur Auswahl der Motortemperatur für den Ladedruck-Steuranteil" VALUE 0x80063FE9 Val_Wu8 2.00000000000 EngTempFldSel 0.00 2.00000000000 FORMAT "%13.11" /end CHARACTERISTIC
/begin CHARACTERISTIC PCR_numEngTempDesValLP_C "" VALUE 0x80064955 Val_Wu8 2.00000000000 EngTempFldSel 0.00 2.00000000000 FORMAT "%13.11" /end CHARACTERISTIC
/begin CHARACTERISTIC PCR_numEngTempDesVal_C "Index zur Auswahl der Motortemperatur für die Ladedrucksollwertberechnung" VALUE 0x8007BD83 Val_Wu8 2.00000000000 EngTempFldSel 0.00 2.00000000000 FORMAT "%13.11" /end CHARACTERISTIC
/begin CHARACTERISTIC PCR_numEngTempMon_C "Index zur Auswahl der Motortemperatur für die Überwachung der Ladedruckregelung" VALUE 0x8007D820 Val_Wu8 2.00000000000 EngTempFldSel 0.00 2.00000000000 FORMAT "%13.11" /end CHARACTERISTIC
/begin CHARACTERISTIC PCR_numEngTempOfsCalc_C "Auswahl MotorTemperaturArray PCR_OfsCalc" VALUE 0x80065BEF Val_Wu8 255.0 OneToOne 0.00 255.0 FORMAT "%5.1" /end CHARACTERISTIC
/begin CHARACTERISTIC PCR_numEOMStgCtlCalc_MAP "" MAP 0x80063FEA Map_Xs16Ys16Ws16 65535.00 OneToOne -32768.00 32767.00 FORMAT "%8.2"
 /begin AXIS_DESCR STD_AXIS PCR_ActModeCtlCalc_mp OneToOne 2 0.00 255.0 FORMAT "%5.1" DEPOSIT ABSOLUTE /end AXIS_DESCR
 /begin AXIS_DESCR STD_AXIS PCR_DesModeCtlCalc_mp OneToOne 2 0.00 255.0 FORMAT "%5.1" DEPOSIT ABSOLUTE /end AXIS_DESCR
/end CHARACTERISTIC
/begin CHARACTERISTIC PCR_numGearCByVlv_C "" VALUE 0x8007A6A6 Val_Wu8 127.0 OneToOne 0.00 127.0 FORMAT "%5.1" EXTENDED_LIMITS 0.00 255.0 /end CHARACTERISTIC
/begin CHARACTERISTIC PCR_nWrkSph1_C "obere Drehzahlgrenze des Arbeitsbereiches 1" VALUE 0x8007D822 Val_Ws16 8000.000 EngN1 0.00 8000.000 FORMAT "%8.3" EXTENDED_LIMITS -16384.00 16383.50 /end CHARACTERISTIC
/begin CHARACTERISTIC PCR_nWrkSph2_C "obere Drehzahlgrenze des Arbeitsbereiches 2" VALUE 0x8007D824 Val_Ws16 8000.000 EngN1 0.00 8000.000 FORMAT "%8.3" EXTENDED_LIMITS -16384.00 16383.50 /end CHARACTERISTIC
/begin CHARACTERISTIC PCR_nWrkSph3_C "obere Drehzahlgrenze des Arbeitsbereiches 3" VALUE 0x8007D826 Val_Ws16 8000.000 EngN1 0.00 8000.000 FORMAT "%8.3" EXTENDED_LIMITS -16384.00 16383.50 /end CHARACTERISTIC
/begin CHARACTERISTIC PCR_OfsCalcQCtlDT1.T1_C "/" VALUE 0x80065BF0 Val_Ws32 4294.9672940 TimeDelay_s 0.000002000000001 4294.9672960 FORMAT "%12.7" /end CHARACTERISTIC
/begin CHARACTERISTIC PCR_OfsCalcQCtlDT1.Kd_C "/" VALUE 0x80065BF4 Val_Ws32 65535.9999847 Kd -32768.0000000 32767.9999847 FORMAT "%13.7" /end CHARACTERISTIC
/begin CHARACTERISTIC PCR_P.Kp_C "P-Parameter des Ladedruckreglers/" VALUE 0x80065734 Kw_Ws32 1599.99999963 Kp_Pres_hPa2Prc -800.000000000 799.999999627 FORMAT "%13.9" /end CHARACTERISTIC
/begin CHARACTERISTIC PCR_P.KpPos_C "P-Parameter des Ladedruckreglers/" VALUE 0x80065738 Kw_Ws32 1599.99999963 Kp_Pres_hPa2Prc -800.000000000 799.999999627 FORMAT "%13.9" /end CHARACTERISTIC
/begin CHARACTERISTIC PCR_P.KpNeg_C "P-Parameter des Ladedruckreglers/" VALUE 0x8006573C Kw_Ws32 1599.99999963 Kp_Pres_hPa2Prc -800.000000000 799.999999627 FORMAT "%13.9" /end CHARACTERISTIC
/begin CHARACTERISTIC PCR_P.WinPos_C "P-Parameter des Ladedruckreglers/" VALUE 0x80065740 Kw_Ws32 2147487148.00 Pres_hPa -2147483648.00 3500.00 FORMAT "%13.2" EXTENDED_LIMITS -2147483648.00 2147483647.00 /end CHARACTERISTIC
/begin CHARACTERISTIC PCR_P.WinNeg_C "P-Parameter des Ladedruckreglers/" VALUE 0x80065744 Kw_Ws32 2147487148.00 Pres_hPa -2147483648.00 3500.00 FORMAT "%13.2" EXTENDED_LIMITS -2147483648.00 2147483647.00 /end CHARACTERISTIC
/begin CHARACTERISTIC PCR_pBstOfsRlsLim_C "Grenze Ladedruck für Freigabe adaptiver Vorsteuerwert" VALUE 0x80065BF8 Val_Ws16 3500.000 Pres_hPa 0.00 3500.000 FORMAT "%8.3" EXTENDED_LIMITS -32768.00 32767.00 /end CHARACTERISTIC
/begin CHARACTERISTIC PCR_pDesBasEOMQnt1_MAP "" MAP 0x8007C9D0 Map_Xs16Ys16Ws16 3500.000 Pres_hPa 0.00 3500.000 FORMAT "%8.3" EXTENDED_LIMITS -32768.00 32767.00
 /begin AXIS_DESCR STD_AXIS Epm_nEng EngN 16 0.00 8000.000 FORMAT "%8.3" EXTENDED_LIMITS -16384.00 16383.50 DEPOSIT ABSOLUTE /end AXIS_DESCR
 /begin AXIS_DESCR STD_AXIS PCR_qDesValInl_mp InjMass 16 0.00 200.0000 FORMAT "%8.4" EXTENDED_LIMITS -327.6800 327.6700 DEPOSIT ABSOLUTE /end AXIS_DESCR
/end CHARACTERISTIC
/begin CHARACTERISTIC PCR_pDesBasHiAltdEOMQnt1_MAP "" MAP 0x8007CC14 Map_Xs16Ys16Ws16 3500.000 Pres_hPa 0.00 3500.000 FORMAT "%8.3" EXTENDED_LIMITS -32768.00 32767.00
 /begin AXIS_DESCR STD_AXIS Epm_nEng EngN 16 0.00 8000.000 FORMAT "%8.3" EXTENDED_LIMITS -16384.00 16383.50 DEPOSIT ABSOLUTE /end AXIS_DESCR
 /begin AXIS_DESCR STD_AXIS PCR_qDesValInl_mp InjMass 16 0.00 200.0000 FORMAT "%8.4" EXTENDED_LIMITS -327.6800 327.6700 DEPOSIT ABSOLUTE /end AXIS_DESCR
/end CHARACTERISTIC
/begin CHARACTERISTIC PCR_pDesBasHiAltd_MAP "Höhenbasiswert des Ladedruckdrucksollwerts" MAP 0x8007BD84 Kf_Xs16_Ys16_Ws16 3500.000 Pres_hPa 0.00 3500.000 FORMAT "%8.3" EXTENDED_LIMITS -32768.00 32767.00
 /begin AXIS_DESCR STD_AXIS Epm_nEng EngN 16 0.00 8000.000 FORMAT "%8.3" EXTENDED_LIMITS -16384.00 16383.50 DEPOSIT ABSOLUTE /end AXIS_DESCR
 /begin AXIS_DESCR STD_AXIS PCR_qDesVal_mp InjMass 16 0.00 200.0000 FORMAT "%8.4" EXTENDED_LIMITS -327.6800 327.6700 DEPOSIT ABSOLUTE /end AXIS_DESCR
/end CHARACTERISTIC
/begin CHARACTERISTIC PCR_pDesBasLPEOMQnt1_MAP "" MAP 0x80064E9C Map_Xs16Ys16Ws16 36268.00 Pres_hPa -32768.00 3500.00 FORMAT "%8.2" EXTENDED_LIMITS -32768.00 32767.00
 /begin AXIS_DESCR STD_AXIS Epm_nEng EngN 12 0.00 8000.000 FORMAT "%8.3" EXTENDED_LIMITS -16384.00 16383.50 DEPOSIT ABSOLUTE /end AXIS_DESCR
 /begin AXIS_DESCR STD_AXIS PCR_qDesValInlLP_mp InjMass 12 0.00 200.0000 FORMAT "%8.4" EXTENDED_LIMITS -327.6800 327.6700 DEPOSIT ABSOLUTE /end AXIS_DESCR
/end CHARACTERISTIC
/begin CHARACTERISTIC PCR_pDesBasLPHiAltdEOMQnt1_MAP "" MAP 0x80064FF0 Map_Xs16Ys16Ws16 3500.000 Pres_hPa 0.00 3500.000 FORMAT "%8.3" EXTENDED_LIMITS -32768.00 32767.00
 /begin AXIS_DESCR STD_AXIS Epm_nEng EngN 5 0.00 8000.000 FORMAT "%8.3" EXTENDED_LIMITS -16384.00 16383.50 DEPOSIT ABSOLUTE /end AXIS_DESCR
 /begin AXIS_DESCR STD_AXIS PCR_qDesValInlLP_mp InjMass 6 0.00 200.0000 FORMAT "%8.4" EXTENDED_LIMITS -327.6800 327.6700 DEPOSIT ABSOLUTE /end AXIS_DESCR
/end CHARACTERISTIC
/begin CHARACTERISTIC PCR_pDesBasLPHiAltd_MAP "" MAP 0x80064956 Kf_Xs16_Ys16_Ws16 3500.000 Pres_hPa 0.00 3500.000 FORMAT "%8.3" EXTENDED_LIMITS -32768.00 32767.00
 /begin AXIS_DESCR STD_AXIS Epm_nEng EngN 6 0.00 8000.000 FORMAT "%8.3" EXTENDED_LIMITS -16384.00 16383.50 DEPOSIT ABSOLUTE /end AXIS_DESCR
 /begin AXIS_DESCR STD_AXIS PCR_qDesValLP_mp InjMass 6 0.00 200.0000 FORMAT "%8.4" EXTENDED_LIMITS -327.6800 327.6700 DEPOSIT ABSOLUTE /end AXIS_DESCR
/end CHARACTERISTIC
/begin CHARACTERISTIC PCR_pDesBasLP_MAP "" MAP 0x800649BA Kf_Xs16_Ys16_Ws16 3500.000 Pres_hPa 0.00 3500.000 FORMAT "%8.3" EXTENDED_LIMITS -32768.00 32767.00
 /begin AXIS_DESCR STD_AXIS Epm_nEng EngN 12 0.00 8000.000 FORMAT "%8.3" EXTENDED_LIMITS -16384.00 16383.50 DEPOSIT ABSOLUTE /end AXIS_DESCR
 /begin AXIS_DESCR STD_AXIS PCR_qDesValLP_mp InjMass 12 0.00 200.0000 FORMAT "%8.4" EXTENDED_LIMITS -327.6800 327.6700 DEPOSIT ABSOLUTE /end AXIS_DESCR
/end CHARACTERISTIC
/begin CHARACTERISTIC PCR_pDesBas_MAP "Basiswert des Ladedruckdrucksollwerts" MAP 0x8007BFC8 Kf_Xs16_Ys16_Ws16 3500.000 Pres_hPa 0.00 3500.000 FORMAT "%8.3" EXTENDED_LIMITS -32768.00 32767.00
 /begin AXIS_DESCR STD_AXIS Epm_nEng EngN 16 0.00 8000.000 FORMAT "%8.3" EXTENDED_LIMITS -16384.00 16383.50 DEPOSIT ABSOLUTE /end AXIS_DESCR
 /begin AXIS_DESCR STD_AXIS PCR_qDesVal_mp InjMass 16 0.00 200.0000 FORMAT "%8.4" EXTENDED_LIMITS -327.6800 327.6700 DEPOSIT ABSOLUTE /end AXIS_DESCR
/end CHARACTERISTIC
/begin CHARACTERISTIC PCR_pEnvOfsCalcMax_C "" VALUE 0x80065BFA Val_Ws16 3500.000 Pres_hPa 0.00 3500.000 FORMAT "%8.3" EXTENDED_LIMITS -32768.00 32767.00 /end CHARACTERISTIC
/begin CHARACTERISTIC PCR_pEnvOfsCalcMin_C "" VALUE 0x80065BFC Val_Ws16 3500.000 Pres_hPa 0.00 3500.000 FORMAT "%8.3" EXTENDED_LIMITS -32768.00 32767.00 /end CHARACTERISTIC
/begin CHARACTERISTIC PCR_pGovDvtOfsRlsMin_C "Untere Regelabweichungsgrenze für die Freigabe des Offset-Lernens" VALUE 0x80065BFE Val_Ws16 3500.000 Pres_hPa 0.00 3500.000 FORMAT "%8.3" EXTENDED_LIMITS -32768.00 32767.00 /end CHARACTERISTIC
/begin CHARACTERISTIC PCR_pMaxDesValLP_MAP "" MAP 0x80064B0E Map_Xs16Ys16Ws16 3500.000 Pres_hPa 0.00 3500.000 FORMAT "%8.3" EXTENDED_LIMITS -32768.00 32767.00
 /begin AXIS_DESCR STD_AXIS Epm_nEng EngN 8 0.00 8000.000 FORMAT "%8.3" EXTENDED_LIMITS -16384.00 16383.50 DEPOSIT ABSOLUTE /end AXIS_DESCR
 /begin AXIS_DESCR STD_AXIS EnvP_p Pres_hPa 8 0.00 3500.000 FORMAT "%8.3" EXTENDED_LIMITS -32768.00 32767.00 DEPOSIT ABSOLUTE /end AXIS_DESCR
/end CHARACTERISTIC
/begin CHARACTERISTIC PCR_pMaxDesVal_MAP "Obere Grenze des Ladedrucksollwerts" MAP 0x8007C20C Map_Xs16Ys16Ws16 3500.000 Pres_hPa 0.00 3500.000 FORMAT "%8.3" EXTENDED_LIMITS -32768.00 32767.00
 /begin AXIS_DESCR STD_AXIS Epm_nEng EngN 16 0.00 8000.000 FORMAT "%8.3" EXTENDED_LIMITS -16384.00 16383.50 DEPOSIT ABSOLUTE /end AXIS_DESCR
 /begin AXIS_DESCR STD_AXIS EnvP_p Pres_hPa 16 0.00 3500.000 FORMAT "%8.3" EXTENDED_LIMITS -32768.00 32767.00 DEPOSIT ABSOLUTE /end AXIS_DESCR
/end CHARACTERISTIC
/begin CHARACTERISTIC PCR_pMaxDvtLP_MAP "" MAP 0x8007DC1E Map_Xs16Ys16Ws16 3500.0000 Pres_hPa 0.00 3500.0000 FORMAT "%8.4" EXTENDED_LIMITS -32768.00 32767.00
 /begin AXIS_DESCR STD_AXIS Epm_nEng EngN 4 0.00 6000.000 FORMAT "%8.3" EXTENDED_LIMITS -16384.00 16383.50 DEPOSIT ABSOLUTE /end AXIS_DESCR
 /begin AXIS_DESCR STD_AXIS PCR_qMonLP_mp InjMass 4 0.00 327.6700 FORMAT "%8.4" EXTENDED_LIMITS -327.6800 327.6700 DEPOSIT ABSOLUTE /end AXIS_DESCR
/end CHARACTERISTIC
/begin CHARACTERISTIC PCR_pMaxDvt_MAP "Obergrenze zur Erkennung einer bleibenden Regelabweichung" MAP 0x8007D906 Map_Xs16Ys16Ws16 3500.0000 Pres_hPa 0.00 3500.0000 FORMAT "%8.4" EXTENDED_LIMITS -32768.00 32767.00
 /begin AXIS_DESCR STD_AXIS Epm_nEng EngN 12 0.00 6000.000 FORMAT "%8.3" EXTENDED_LIMITS -16384.00 16383.50 DEPOSIT ABSOLUTE /end AXIS_DESCR
 /begin AXIS_DESCR STD_AXIS PCR_qMon_mp InjMass 12 0.00 327.6700 FORMAT "%8.4" EXTENDED_LIMITS -327.6800 327.6700 DEPOSIT ABSOLUTE /end AXIS_DESCR
/end CHARACTERISTIC
/begin CHARACTERISTIC PCR_pMinDesValLP_C "" VALUE 0x80064BB2 Val_Ws16 3500.000 Pres_hPa 0.00 3500.000 FORMAT "%8.3" EXTENDED_LIMITS -32768.00 32767.00 /end CHARACTERISTIC
/begin CHARACTERISTIC PCR_pMinDesVal_C "Untere Grenze des Ladedrucksollwerts" VALUE 0x8007C450 Val_Ws16 3500.000 Pres_hPa 0.00 3500.000 FORMAT "%8.3" EXTENDED_LIMITS -32768.00 32767.00 /end CHARACTERISTIC
/begin CHARACTERISTIC PCR_pMinDvtLP_MAP "" MAP 0x8007DC52 Map_Xs16Ys16Ws16 3630.0000 Pres_hPa -130.0000 3500.0000 FORMAT "%8.4" EXTENDED_LIMITS -32768.00 32767.00
 /begin AXIS_DESCR STD_AXIS Epm_nEng EngN 4 0.00 6000.000 FORMAT "%8.3" EXTENDED_LIMITS -16384.00 16383.50 DEPOSIT ABSOLUTE /end AXIS_DESCR
 /begin AXIS_DESCR STD_AXIS PCR_qMonLP_mp InjMass 4 0.00 327.6700 FORMAT "%8.4" EXTENDED_LIMITS -327.6800 327.6700 DEPOSIT ABSOLUTE /end AXIS_DESCR
/end CHARACTERISTIC
/begin CHARACTERISTIC PCR_pMinDvt_MAP "Untergrenze zur Erkennung einer bleibenden Regelabweichung" MAP 0x8007DA5A Map_Xs16Ys16Ws16 3630.0000 Pres_hPa -130.0000 3500.0000 FORMAT "%8.4" EXTENDED_LIMITS -32768.00 32767.00
 /begin AXIS_DESCR STD_AXIS Epm_nEng EngN 12 0.00 6000.000 FORMAT "%8.3" EXTENDED_LIMITS -16384.00 16383.50 DEPOSIT ABSOLUTE /end AXIS_DESCR
 /begin AXIS_DESCR STD_AXIS PCR_qMon_mp InjMass 12 0.00 327.6700 FORMAT "%8.4" EXTENDED_LIMITS -327.6800 327.6700 DEPOSIT ABSOLUTE /end AXIS_DESCR
/end CHARACTERISTIC
/begin CHARACTERISTIC PCR_pTempCorBasEOMQnt1_MAP "" MAP 0x8007CE58 Map_Xs16Ys16Ws16 3500.000 Pres_hPa 0.00 3500.000 FORMAT "%8.3" EXTENDED_LIMITS -32768.00 32767.00
 /begin AXIS_DESCR STD_AXIS Epm_nEng EngN 16 0.00 8000.000 FORMAT "%8.3" EXTENDED_LIMITS -16384.00 16383.50 DEPOSIT ABSOLUTE /end AXIS_DESCR
 /begin AXIS_DESCR STD_AXIS PCR_qDesValInl_mp InjMass 16 0.00 200.0000 FORMAT "%8.4" EXTENDED_LIMITS -327.6800 327.6700 DEPOSIT ABSOLUTE /end AXIS_DESCR
/end CHARACTERISTIC
/begin CHARACTERISTIC PCR_pTempCorBasLPEOMQnt1_MAP "" MAP 0x80065046 Map_Xs16Ys16Ws16 3500.000 Pres_hPa 0.00 3500.000 FORMAT "%8.3" EXTENDED_LIMITS -32768.00 32767.00
 /begin AXIS_DESCR STD_AXIS Epm_nEng EngN 6 0.00 8000.000 FORMAT "%8.3" EXTENDED_LIMITS -16384.00 16383.50 DEPOSIT ABSOLUTE /end AXIS_DESCR
 /begin AXIS_DESCR STD_AXIS PCR_qDesValInlLP_mp InjMass 6 0.00 200.0000 FORMAT "%8.4" EXTENDED_LIMITS -327.6800 327.6700 DEPOSIT ABSOLUTE /end AXIS_DESCR
/end CHARACTERISTIC
/begin CHARACTERISTIC PCR_pTempCorBasLP_MAP "" MAP 0x80064BB4 Map_Xs16Ys16Ws16 4000.000 default 0.00 4000.000 FORMAT "%8.3" EXTENDED_LIMITS -32768.00 32767.00
 /begin AXIS_DESCR STD_AXIS Epm_nEng EngN 16 0.00 8000.000 FORMAT "%8.3" EXTENDED_LIMITS -16384.00 16383.50 DEPOSIT ABSOLUTE /end AXIS_DESCR
 /begin AXIS_DESCR STD_AXIS PCR_qDesVal InjMass 16 0.00 200.0000 FORMAT "%8.4" EXTENDED_LIMITS -327.6800 327.6700 DEPOSIT ABSOLUTE /end AXIS_DESCR
/end CHARACTERISTIC
/begin CHARACTERISTIC PCR_pTempCorBas_MAP "Basiswert für Sollwertberechnung der Ladedruckregelung" MAP 0x8007C452 Kf_Xs16_Ys16_Ws16 3500.000 Pres_hPa 0.00 3500.000 FORMAT "%8.3" EXTENDED_LIMITS -32768.00 32767.00
 /begin AXIS_DESCR STD_AXIS Epm_nEng EngN 16 0.00 8000.000 FORMAT "%8.3" EXTENDED_LIMITS -16384.00 16383.50 DEPOSIT ABSOLUTE /end AXIS_DESCR
 /begin AXIS_DESCR STD_AXIS PCR_qDesVal_mp InjMass 16 0.00 200.0000 FORMAT "%8.4" EXTENDED_LIMITS -327.6800 327.6700 DEPOSIT ABSOLUTE /end AXIS_DESCR
/end CHARACTERISTIC
/begin CHARACTERISTIC PCR_pTransLPMax_C "" VALUE 0x8007DBE4 Val_Ws16 36268.00 Pres_hPa -32768.00 3500.00 FORMAT "%8.2" EXTENDED_LIMITS -32768.00 32767.00 /end CHARACTERISTIC
/begin CHARACTERISTIC PCR_pTransLPMin_C "" VALUE 0x8007DBE6 Val_Ws16 36268.00 Pres_hPa -32768.00 3500.00 FORMAT "%8.2" EXTENDED_LIMITS -32768.00 32767.00 /end CHARACTERISTIC
/begin CHARACTERISTIC PCR_pTransMax_C "Obere Schwelle der Absoluten Regelabweichung zur Transient-Erkennung" VALUE 0x8007D8CA Val_Ws16 36268.00 Pres_hPa -32768.00 3500.00 FORMAT "%8.2" EXTENDED_LIMITS -32768.00 32767.00 /end CHARACTERISTIC
/begin CHARACTERISTIC PCR_pTransMin_C "Untere Schwelle der Absoluten Regelabweichung zur Transient-Erkennung" VALUE 0x8007D8CC Val_Ws16 36268.00 Pres_hPa -32768.00 3500.00 FORMAT "%8.2" EXTENDED_LIMITS -32768.00 32767.00 /end CHARACTERISTIC
/begin CHARACTERISTIC PCR_PWinLP.Kp_C "/" VALUE 0x80065344 Kw_Ws32 1599.99999963 Kp_Pres_hPa2Prc -800.000000000 799.999999627 FORMAT "%13.9" /end CHARACTERISTIC
/begin CHARACTERISTIC PCR_PWinLP.KpPos_C "/" VALUE 0x80065348 Kw_Ws32 1599.99999963 Kp_Pres_hPa2Prc -800.000000000 799.999999627 FORMAT "%13.9" /end CHARACTERISTIC
/begin CHARACTERISTIC PCR_PWinLP.KpNeg_C "/" VALUE 0x8006534C Kw_Ws32 1599.99999963 Kp_Pres_hPa2Prc -800.000000000 799.999999627 FORMAT "%13.9" /end CHARACTERISTIC
/begin CHARACTERISTIC PCR_PWinLP.WinPos_C "/" VALUE 0x80065350 Kw_Ws32 2147487148.00 Pres_hPa -2147483648.00 3500.00 FORMAT "%13.2" EXTENDED_LIMITS -2147483648.00 2147483647.00 /end CHARACTERISTIC
/begin CHARACTERISTIC PCR_PWinLP.WinNeg_C "/" VALUE 0x80065354 Kw_Ws32 2147487148.00 Pres_hPa -2147483648.00 3500.00 FORMAT "%13.2" EXTENDED_LIMITS -2147483648.00 2147483647.00 /end CHARACTERISTIC
/begin CHARACTERISTIC PCR_qCByVlvCloseEOM1_MAP "" MAP 0x8007A6A8 Map_Xs16Ys16Ws16 327.6700 InjMass 0.00 327.6700 FORMAT "%8.4" EXTENDED_LIMITS -327.6800 327.6700
 /begin AXIS_DESCR STD_AXIS Epm_nEng EngN 12 0.00 6000.000 FORMAT "%8.3" EXTENDED_LIMITS -16384.00 16383.50 DEPOSIT ABSOLUTE /end AXIS_DESCR
 /begin AXIS_DESCR STD_AXIS EnvP_p Pres_hPa 6 0.00 3500.000 FORMAT "%8.3" EXTENDED_LIMITS -32768.00 32767.00 DEPOSIT ABSOLUTE /end AXIS_DESCR
/end CHARACTERISTIC
/begin CHARACTERISTIC PCR_qCByVlvClose_MAP "" MAP 0x8007A760 Map_Xs16Ys16Ws16 327.6700 InjMass 0.00 327.6700 FORMAT "%8.4" EXTENDED_LIMITS -327.6800 327.6700
 /begin AXIS_DESCR STD_AXIS Epm_nEng EngN 12 0.00 6000.000 FORMAT "%8.3" EXTENDED_LIMITS -16384.00 16383.50 DEPOSIT ABSOLUTE /end AXIS_DESCR
 /begin AXIS_DESCR STD_AXIS EnvP_p Pres_hPa 6 0.00 3500.000 FORMAT "%8.3" EXTENDED_LIMITS -32768.00 32767.00 DEPOSIT ABSOLUTE /end AXIS_DESCR
/end CHARACTERISTIC
/begin CHARACTERISTIC PCR_qCByVlvOpnEOM1_MAP "" MAP 0x8007A818 Map_Xs16Ys16Ws16 327.6700 InjMass 0.00 327.6700 FORMAT "%8.4" EXTENDED_LIMITS -327.6800 327.6700
 /begin AXIS_DESCR STD_AXIS Epm_nEng EngN 12 0.00 6000.000 FORMAT "%8.3" EXTENDED_LIMITS -16384.00 16383.50 DEPOSIT ABSOLUTE /end AXIS_DESCR
 /begin AXIS_DESCR STD_AXIS EnvP_p Pres_hPa 6 0.00 3500.000 FORMAT "%8.3" EXTENDED_LIMITS -32768.00 32767.00 DEPOSIT ABSOLUTE /end AXIS_DESCR
/end CHARACTERISTIC
/begin CHARACTERISTIC PCR_qCByVlvOpn_MAP "" MAP 0x8007A8D0 Map_Xs16Ys16Ws16 327.6700 InjMass 0.00 327.6700 FORMAT "%8.4" EXTENDED_LIMITS -327.6800 327.6700
 /begin AXIS_DESCR STD_AXIS Epm_nEng EngN 12 0.00 6000.000 FORMAT "%8.3" EXTENDED_LIMITS -16384.00 16383.50 DEPOSIT ABSOLUTE /end AXIS_DESCR
 /begin AXIS_DESCR STD_AXIS EnvP_p Pres_hPa 6 0.00 3500.000 FORMAT "%8.3" EXTENDED_LIMITS -32768.00 32767.00 DEPOSIT ABSOLUTE /end AXIS_DESCR
/end CHARACTERISTIC
/begin CHARACTERISTIC PCR_QntCByVlv.xVal_C "/" VALUE 0x8007A988 Kw_Wu8 1.000 OneToOne 0.00 1.000 FORMAT "%5.3" EXTENDED_LIMITS 0.00 255.0 /end CHARACTERISTIC
/begin CHARACTERISTIC PCR_QntCByVlv.xTyp_C "/" VALUE 0x8007A989 Kw_Wu8 1.000 OneToOne 1.000 2.000 FORMAT "%5.3" EXTENDED_LIMITS 0.00 255.0 /end CHARACTERISTIC
/begin CHARACTERISTIC PCR_QntCtl.xVal_C "Schalter zur Einspritzmengenauswahl für die Steuerung/" VALUE 0x8007A994 Kw_Wu8 1.000 OneToOne 0.00 1.000 FORMAT "%5.3" EXTENDED_LIMITS 0.00 255.0 /end CHARACTERISTIC
/begin CHARACTERISTIC PCR_QntCtl.xTyp_C "Schalter zur Einspritzmengenauswahl für die Steuerung/" VALUE 0x8007A995 Kw_Wu8 1.000 OneToOne 1.000 2.000 FORMAT "%5.3" EXTENDED_LIMITS 0.00 255.0 /end CHARACTERISTIC
/begin CHARACTERISTIC PCR_QntDes.xVal_C "Schalter zur Einspritzmengenauswahl für die Sollwertberechnung/" VALUE 0x8007A996 Kw_Wu8 1.000 OneToOne 0.00 1.000 FORMAT "%5.3" EXTENDED_LIMITS 0.00 255.0 /end CHARACTERISTIC
/begin CHARACTERISTIC PCR_QntDes.xTyp_C "Schalter zur Einspritzmengenauswahl für die Sollwertberechnung/" VALUE 0x8007A997 Kw_Wu8 1.000 OneToOne 1.000 2.000 FORMAT "%5.3" EXTENDED_LIMITS 0.00 255.0 /end CHARACTERISTIC
/begin CHARACTERISTIC PCR_qOfsCalc1_C "" VALUE 0x80065C00 Val_Ws16 327.6700 InjMassCyc 0.00 327.6700 FORMAT "%8.4" EXTENDED_LIMITS -327.6800 327.6700 /end CHARACTERISTIC
/begin CHARACTERISTIC PCR_qOfsCalc2_C "" VALUE 0x80065C02 Val_Ws16 327.6700 InjMassCyc 0.00 327.6700 FORMAT "%8.4" EXTENDED_LIMITS -327.6800 327.6700 /end CHARACTERISTIC
/begin CHARACTERISTIC PCR_qOfsCalcRlsMax_C "" VALUE 0x80065C04 Val_Ws16 327.6700 InjMassCyc 0.00 327.6700 FORMAT "%8.4" EXTENDED_LIMITS -327.6800 327.6700 /end CHARACTERISTIC
/begin CHARACTERISTIC PCR_qOfsCalcRlsMin_C "" VALUE 0x80065C06 Val_Ws16 327.6700 InjMassCyc 0.00 327.6700 FORMAT "%8.4" EXTENDED_LIMITS -327.6800 327.6700 /end CHARACTERISTIC
/begin CHARACTERISTIC PCR_rAirTempCtlCorBas_MAP "" MAP 0x8007AEE0 Kf_Xs16_Ys16_Ws16 799.9878 Prc -400.0000 399.9878 FORMAT "%8.4"
 /begin AXIS_DESCR STD_AXIS Epm_nEng EngN 16 0.00 6000.000 FORMAT "%8.3" EXTENDED_LIMITS -16384.00 16383.50 DEPOSIT ABSOLUTE /end AXIS_DESCR
 /begin AXIS_DESCR STD_AXIS PCR_qCtlVal InjMass 16 0.00 100.0000 FORMAT "%8.4" EXTENDED_LIMITS -327.6800 327.6700 DEPOSIT ABSOLUTE /end AXIS_DESCR
/end CHARACTERISTIC
/begin CHARACTERISTIC PCR_rAirTempCtlCorEOMBas_MAP "Kennfeld für lufttemperaturabhängige Korrektur Vorsteuerung Betriebsart Rgn" MAP 0x80063FFE Map_Xs16Ys16Ws16 300.1343 Prc -100.1343 200.0000 FORMAT "%8.4" EXTENDED_LIMITS -400.0000 399.9878
 /begin AXIS_DESCR STD_AXIS Epm_nEng EngN 16 0.00 6000.000 FORMAT "%8.3" EXTENDED_LIMITS -16384.00 16383.50 DEPOSIT ABSOLUTE /end AXIS_DESCR
 /begin AXIS_DESCR STD_AXIS PCR_qCtlVal InjMass 16 0.00 100.0000 FORMAT "%8.4" EXTENDED_LIMITS -327.6800 327.6700 DEPOSIT ABSOLUTE /end AXIS_DESCR
/end CHARACTERISTIC
/begin CHARACTERISTIC PCR_rCtlBasAutLPEOMQnt1_MAP "" MAP 0x8007B91C Map_Xs16Ys16Ws16 300.0000 Prc -100.0000 200.0000 FORMAT "%8.4" EXTENDED_LIMITS -400.0000 399.9878
 /begin AXIS_DESCR STD_AXIS Epm_nEng EngN 12 0.00 8000.000 FORMAT "%8.3" EXTENDED_LIMITS -16384.00 16383.50 DEPOSIT ABSOLUTE /end AXIS_DESCR
 /begin AXIS_DESCR STD_AXIS PCR_qCtlValInlAutLP_mp InjMass 12 0.00 200.0000 FORMAT "%8.4" EXTENDED_LIMITS -327.6800 327.6700 DEPOSIT ABSOLUTE /end AXIS_DESCR
/end CHARACTERISTIC
/begin CHARACTERISTIC PCR_rCtlBasAutLPHiAltdEOMQnt1_MAP "" MAP 0x8007BA70 Map_Xs16Ys16Ws16 300.0000 Prc -100.0000 200.0000 FORMAT "%8.4" EXTENDED_LIMITS -400.0000 399.9878
 /begin AXIS_DESCR STD_AXIS Epm_nEng EngN 6 0.00 8000.000 FORMAT "%8.3" EXTENDED_LIMITS -16384.00 16383.50 DEPOSIT ABSOLUTE /end AXIS_DESCR
 /begin AXIS_DESCR STD_AXIS PCR_qCtlValInlAutLP_mp InjMass 6 0.00 200.0000 FORMAT "%8.4" EXTENDED_LIMITS -327.6800 327.6700 DEPOSIT ABSOLUTE /end AXIS_DESCR
/end CHARACTERISTIC
/begin CHARACTERISTIC PCR_rCtlBasAutLPHiAltd_MAP "" MAP 0x8007B2B0 Kf_Xs16_Ys16_Ws16 300.0000 Prc -100.0000 200.0000 FORMAT "%8.4" EXTENDED_LIMITS -400.0000 399.9878
 /begin AXIS_DESCR STD_AXIS Epm_nEng EngN 6 0.00 8000.000 FORMAT "%8.3" EXTENDED_LIMITS -16384.00 16383.50 DEPOSIT ABSOLUTE /end AXIS_DESCR
 /begin AXIS_DESCR STD_AXIS PCR_qCtlValLP_mp InjMass 6 0.00 327.6700 FORMAT "%8.4" EXTENDED_LIMITS -327.6800 327.6700 DEPOSIT ABSOLUTE /end AXIS_DESCR
/end CHARACTERISTIC
/begin CHARACTERISTIC PCR_rCtlBasAutLP_MAP "" MAP 0x8007B314 Kf_Xs16_Ys16_Ws16 300.0000 Prc -100.0000 200.0000 FORMAT "%8.4" EXTENDED_LIMITS -400.0000 399.9878
 /begin AXIS_DESCR STD_AXIS Epm_nEng EngN 12 0.00 8000.000 FORMAT "%8.3" EXTENDED_LIMITS -16384.00 16383.50 DEPOSIT ABSOLUTE /end AXIS_DESCR
 /begin AXIS_DESCR STD_AXIS PCR_qCtlValLP_mp InjMass 12 0.00 327.6700 FORMAT "%8.4" EXTENDED_LIMITS -327.6800 327.6700 DEPOSIT ABSOLUTE /end AXIS_DESCR
/end CHARACTERISTIC
/begin CHARACTERISTIC PCR_rCtlBasEOMQnt1_MAP "Kennfeld: Basiswert für den Ladedruck-Steueranteil für die erste auf Einspritzmenge basierte Betriebsart" MAP 0x8007AA16 Map_Xs16Ys16Ws16 300.0000 Prc -100.0000 200.0000 FORMAT "%8.4" EXTENDED_LIMITS -400.0000 399.9878
 /begin AXIS_DESCR STD_AXIS Epm_nEng EngN 16 0.00 8000.000 FORMAT "%8.3" EXTENDED_LIMITS -16384.00 16383.50 DEPOSIT ABSOLUTE /end AXIS_DESCR
 /begin AXIS_DESCR STD_AXIS PCR_qCtlValInl_mp InjMass 16 0.00 200.0000 FORMAT "%8.4" EXTENDED_LIMITS -327.6800 327.6700 DEPOSIT ABSOLUTE /end AXIS_DESCR
/end CHARACTERISTIC
/begin CHARACTERISTIC PCR_rCtlBasHiAltdEOMQnt1_MAP "Kennfeld: Höhenbasiswert des Ladedruck-Steueranteils für die erste auf Einspritzmenge basierte Betriebsart" MAP 0x8007AC5A Map_Xs16Ys16Ws16 300.0000 Prc -100.0000 200.0000 FORMAT "%8.4" EXTENDED_LIMITS -400.0000 399.9878
 /begin AXIS_DESCR STD_AXIS Epm_nEng EngN 16 0.00 8000.000 FORMAT "%8.3" EXTENDED_LIMITS -16384.00 16383.50 DEPOSIT ABSOLUTE /end AXIS_DESCR
 /begin AXIS_DESCR STD_AXIS PCR_qCtlValInl_mp InjMass 16 0.00 200.0000 FORMAT "%8.4" EXTENDED_LIMITS -327.6800 327.6700 DEPOSIT ABSOLUTE /end AXIS_DESCR
/end CHARACTERISTIC
/begin CHARACTERISTIC PCR_rCtlBasHiAltd_MAP "Höhenbasiswert des Ladedruck-Steueranteils" MAP 0x80064242 Kf_Xs16_Ys16_Ws16 300.0000 Prc -100.0000 200.0000 FORMAT "%8.4" EXTENDED_LIMITS -400.0000 399.9878
 /begin AXIS_DESCR STD_AXIS Epm_nEng EngN 16 0.00 8000.000 FORMAT "%8.3" EXTENDED_LIMITS -16384.00 16383.50 DEPOSIT ABSOLUTE /end AXIS_DESCR
 /begin AXIS_DESCR STD_AXIS PCR_qCtlVal_mp InjMass 16 0.00 327.6700 FORMAT "%8.4" EXTENDED_LIMITS -327.6800 327.6700 DEPOSIT ABSOLUTE /end AXIS_DESCR
/end CHARACTERISTIC
/begin CHARACTERISTIC PCR_rCtlBasLPEOMQnt1_MAP "" MAP 0x8007B742 Map_Xs16Ys16Ws16 300.0000 Prc -100.0000 200.0000 FORMAT "%8.4" EXTENDED_LIMITS -400.0000 399.9878
 /begin AXIS_DESCR STD_AXIS Epm_nEng EngN 12 0.00 8000.000 FORMAT "%8.3" EXTENDED_LIMITS -16384.00 16383.50 DEPOSIT ABSOLUTE /end AXIS_DESCR
 /begin AXIS_DESCR STD_AXIS PCR_qCtlValInlLP_mp InjMass 12 0.00 200.0000 FORMAT "%8.4" EXTENDED_LIMITS -327.6800 327.6700 DEPOSIT ABSOLUTE /end AXIS_DESCR
/end CHARACTERISTIC
/begin CHARACTERISTIC PCR_rCtlBasLPHiAltdEOMQnt1_MAP "" MAP 0x8007B896 Map_Xs16Ys16Ws16 300.0000 Prc -100.0000 200.0000 FORMAT "%8.4" EXTENDED_LIMITS -400.0000 399.9878
 /begin AXIS_DESCR STD_AXIS Epm_nEng EngN 6 0.00 8000.000 FORMAT "%8.3" EXTENDED_LIMITS -16384.00 16383.50 DEPOSIT ABSOLUTE /end AXIS_DESCR
 /begin AXIS_DESCR STD_AXIS PCR_qCtlValInlLP_mp InjMass 6 0.00 200.0000 FORMAT "%8.4" EXTENDED_LIMITS -327.6800 327.6700 DEPOSIT ABSOLUTE /end AXIS_DESCR
/end CHARACTERISTIC
/begin CHARACTERISTIC PCR_rCtlBasLPHiAltd_MAP "" MAP 0x8007B468 Kf_Xs16_Ys16_Ws16 300.0000 Prc -100.0000 200.0000 FORMAT "%8.4" EXTENDED_LIMITS -400.0000 399.9878
 /begin AXIS_DESCR STD_AXIS Epm_nEng EngN 6 0.00 8000.000 FORMAT "%8.3" EXTENDED_LIMITS -16384.00 16383.50 DEPOSIT ABSOLUTE /end AXIS_DESCR
 /begin AXIS_DESCR STD_AXIS PCR_qCtlValLP_mp InjMass 6 0.00 327.6700 FORMAT "%8.4" EXTENDED_LIMITS -327.6800 327.6700 DEPOSIT ABSOLUTE /end AXIS_DESCR
/end CHARACTERISTIC
/begin CHARACTERISTIC PCR_rCtlBasLP_MAP "" MAP 0x8007B4CC Kf_Xs16_Ys16_Ws16 300.0000 Prc -100.0000 200.0000 FORMAT "%8.4" EXTENDED_LIMITS -400.0000 399.9878
 /begin AXIS_DESCR STD_AXIS Epm_nEng EngN 14 0.00 8000.000 FORMAT "%8.3" EXTENDED_LIMITS -16384.00 16383.50 DEPOSIT ABSOLUTE /end AXIS_DESCR
 /begin AXIS_DESCR STD_AXIS PCR_qCtlValLP_mp InjMass 14 0.00 327.6700 FORMAT "%8.4" EXTENDED_LIMITS -327.6800 327.6700 DEPOSIT ABSOLUTE /end AXIS_DESCR
/end CHARACTERISTIC
/begin CHARACTERISTIC PCR_rCtlBas_MAP "Basiswert für den Ladedruck-Steueranteil" MAP 0x80064486 Kf_Xs16_Ys16_Ws16 300.0000 Prc -100.0000 200.0000 FORMAT "%8.4" EXTENDED_LIMITS -400.0000 399.9878
 /begin AXIS_DESCR STD_AXIS Epm_nEng EngN 16 0.00 8000.000 FORMAT "%8.3" EXTENDED_LIMITS -16384.00 16383.50 DEPOSIT ABSOLUTE /end AXIS_DESCR
 /begin AXIS_DESCR STD_AXIS PCR_qCtlVal_mp InjMass 16 0.00 327.6700 FORMAT "%8.4" EXTENDED_LIMITS -327.6800 327.6700 DEPOSIT ABSOLUTE /end AXIS_DESCR
/end CHARACTERISTIC
/begin CHARACTERISTIC PCR_rCtlValPFltLd_MAP "" MAP 0x8007A99C Kf_Xs16_Ys16_Ws16 100.0000 Prc 0.00 100.0000 FORMAT "%8.4" EXTENDED_LIMITS -400.0000 399.9878
 /begin AXIS_DESCR STD_AXIS Epm_nEng EngN 4 0.00 6000.000 FORMAT "%8.3" EXTENDED_LIMITS -16384.00 16383.50 DEPOSIT ABSOLUTE /end AXIS_DESCR
 /begin AXIS_DESCR STD_AXIS PCR_qCtlVal_mp InjMass 4 -327.6800 327.6700 FORMAT "%8.4" DEPOSIT ABSOLUTE /end AXIS_DESCR
/end CHARACTERISTIC
/begin CHARACTERISTIC PCR_rDflValLP_CA "" VAL_BLK 0x8007DBFC ValA_Ws16 799.9878 Prc -400.0000 399.9878 FORMAT "%8.4" NUMBER 17 /end CHARACTERISTIC
/begin CHARACTERISTIC PCR_rDflVal_CA "Vorgabewerte für Abschaltfälle der Ladedruckregelung" VAL_BLK 0x8007D8E4 ValA_Ws16 799.9878 Prc -400.0000 399.9878 FORMAT "%8.4" NUMBER 17 /end CHARACTERISTIC
/begin CHARACTERISTIC PCR_rDistOfsCalc1_C "" VALUE 0x80065C08 Val_Ws16 100.0000 Prc 0.00 100.0000 FORMAT "%8.4" EXTENDED_LIMITS -400.0000 399.9878 /end CHARACTERISTIC
/begin CHARACTERISTIC PCR_rDistOfsCalc2_C "" VALUE 0x80065C0A Val_Ws16 100.0000 Prc 0.00 100.0000 FORMAT "%8.4" EXTENDED_LIMITS -400.0000 399.9878 /end CHARACTERISTIC
/begin CHARACTERISTIC PCR_rDistOfsCalc3_C "" VALUE 0x80065C0C Val_Ws16 100.0000 Prc 0.00 100.0000 FORMAT "%8.4" EXTENDED_LIMITS -400.0000 399.9878 /end CHARACTERISTIC
/begin CHARACTERISTIC PCR_rDistOfsCalc4_C "" VALUE 0x80065C0E Val_Ws16 100.0000 Prc 0.00 100.0000 FORMAT "%8.4" EXTENDED_LIMITS -400.0000 399.9878 /end CHARACTERISTIC
/begin CHARACTERISTIC PCR_RelAbs.xVal_C "Schalterwert zur Auswahl zwischen Absolut- und Relativdruck der Ladedruckregelung/" VALUE 0x8007D148 Kw_Wu8 1.000 OneToOne 0.00 1.000 FORMAT "%5.3" EXTENDED_LIMITS 0.00 255.0 /end CHARACTERISTIC
/begin CHARACTERISTIC PCR_RelAbs.xTyp_C "Schalterwert zur Auswahl zwischen Absolut- und Relativdruck der Ladedruckregelung/" VALUE 0x8007D149 Kw_Wu8 1.000 OneToOne 1.000 2.000 FORMAT "%5.3" EXTENDED_LIMITS 0.00 255.0 /end CHARACTERISTIC
/begin CHARACTERISTIC PCR_RelAbsLP.xVal_C "/" VALUE 0x800650D0 Kw_Wu8 1.000 OneToOne 0.00 1.000 FORMAT "%5.3" EXTENDED_LIMITS 0.00 255.0 /end CHARACTERISTIC
/begin CHARACTERISTIC PCR_RelAbsLP.xTyp_C "/" VALUE 0x800650D1 Kw_Wu8 1.000 OneToOne 1.000 2.000 FORMAT "%5.3" EXTENDED_LIMITS 0.00 255.0 /end CHARACTERISTIC
/begin CHARACTERISTIC PCR_rEngTempCorBasAutLP_MAP "" MAP 0x8007B690 Kf_Xs16_Ys16_Ws16 300.0000 Prc -100.0000 200.0000 FORMAT "%8.4" EXTENDED_LIMITS -400.0000 399.9878
 /begin AXIS_DESCR STD_AXIS Epm_nEng EngN 4 0.00 8000.000 FORMAT "%8.3" EXTENDED_LIMITS -16384.00 16383.50 DEPOSIT ABSOLUTE /end AXIS_DESCR
 /begin AXIS_DESCR STD_AXIS PCR_qCtlValLP_mp InjMass 4 0.00 327.6700 FORMAT "%8.4" EXTENDED_LIMITS -327.6800 327.6700 DEPOSIT ABSOLUTE /end AXIS_DESCR
/end CHARACTERISTIC
/begin CHARACTERISTIC PCR_rEngTempCorBasLP_MAP "" MAP 0x8007B6C4 Kf_Xs16_Ys16_Ws16 300.0000 Prc -100.0000 200.0000 FORMAT "%8.4" EXTENDED_LIMITS -400.0000 399.9878
 /begin AXIS_DESCR STD_AXIS Epm_nEng EngN 4 0.00 8000.000 FORMAT "%8.3" EXTENDED_LIMITS -16384.00 16383.50 DEPOSIT ABSOLUTE /end AXIS_DESCR
 /begin AXIS_DESCR STD_AXIS PCR_qCtlValLP_mp InjMass 4 0.00 327.6700 FORMAT "%8.4" EXTENDED_LIMITS -327.6800 327.6700 DEPOSIT ABSOLUTE /end AXIS_DESCR
/end CHARACTERISTIC
/begin CHARACTERISTIC PCR_rEngTempCorBas_MAP "Basiswert der Motortemperaturkorrektur des Ladedruck-Steueranteils" MAP 0x800646CA Kf_Xs16_Ys16_Ws16 300.0000 Prc -100.0000 200.0000 FORMAT "%8.4" EXTENDED_LIMITS -400.0000 399.9878
 /begin AXIS_DESCR STD_AXIS Epm_nEng EngN 16 0.00 8000.000 FORMAT "%8.3" EXTENDED_LIMITS -16384.00 16383.50 DEPOSIT ABSOLUTE /end AXIS_DESCR
 /begin AXIS_DESCR STD_AXIS PCR_qCtlVal_mp InjMass 16 0.00 327.6700 FORMAT "%8.4" EXTENDED_LIMITS -327.6800 327.6700 DEPOSIT ABSOLUTE /end AXIS_DESCR
/end CHARACTERISTIC
/begin CHARACTERISTIC PCR_rGovLPMax_MAP "" MAP 0x800650D2 Map_Xs16Ys16Ws16 300.0000 Prc -100.0000 200.0000 FORMAT "%8.4" EXTENDED_LIMITS -400.0000 399.9878
 /begin AXIS_DESCR STD_AXIS Epm_nEng EngN 6 0.00 8000.000 FORMAT "%8.3" EXTENDED_LIMITS -16384.00 16383.50 DEPOSIT ABSOLUTE /end AXIS_DESCR
 /begin AXIS_DESCR STD_AXIS PCR_qGovLP_mp InjMass 6 0.00 327.6700 FORMAT "%8.4" EXTENDED_LIMITS -327.6800 327.6700 DEPOSIT ABSOLUTE /end AXIS_DESCR
/end CHARACTERISTIC
/begin CHARACTERISTIC PCR_rGovLPMin_MAP "" MAP 0x80065136 Map_Xs16Ys16Ws16 300.0000 Prc -100.0000 200.0000 FORMAT "%8.4" EXTENDED_LIMITS -400.0000 399.9878
 /begin AXIS_DESCR STD_AXIS Epm_nEng EngN 6 0.00 8000.000 FORMAT "%8.3" EXTENDED_LIMITS -16384.00 16383.50 DEPOSIT ABSOLUTE /end AXIS_DESCR
 /begin AXIS_DESCR STD_AXIS PCR_qGovLP_mp InjMass 6 0.00 327.6700 FORMAT "%8.4" EXTENDED_LIMITS -327.6800 327.6700 DEPOSIT ABSOLUTE /end AXIS_DESCR
/end CHARACTERISTIC
/begin CHARACTERISTIC PCR_rGovMaxCorr_MAP "" MAP 0x80065772 Kf_Xs16_Ys16_Ws16 100.0000 Prc 0.00 100.0000 FORMAT "%8.4" EXTENDED_LIMITS -400.0000 399.9878
 /begin AXIS_DESCR STD_AXIS Epm_nEng EngN 16 0.00 8000.000 FORMAT "%8.3" EXTENDED_LIMITS -16384.00 16383.50 DEPOSIT ABSOLUTE /end AXIS_DESCR
 /begin AXIS_DESCR STD_AXIS PCR_qGov InjMass 10 0.00 100.0000 FORMAT "%8.4" EXTENDED_LIMITS -327.6800 327.6700 DEPOSIT ABSOLUTE /end AXIS_DESCR
/end CHARACTERISTIC
/begin CHARACTERISTIC PCR_rGovMaxDynCorr_MAP "" MAP 0x800658EA Kf_Xs16_Ys16_Ws16 100.0000 Prc 0.00 100.0000 FORMAT "%8.4" EXTENDED_LIMITS -400.0000 399.9878
 /begin AXIS_DESCR STD_AXIS EnvP_p Pres_hPa 8 0.00 3500.000 FORMAT "%8.3" EXTENDED_LIMITS -32768.00 32767.00 DEPOSIT ABSOLUTE /end AXIS_DESCR
 /begin AXIS_DESCR STD_AXIS Epm_nEng EngN 8 40.00000 6000.000 FORMAT "%8.3" EXTENDED_LIMITS -16384.00 16383.50 DEPOSIT ABSOLUTE /end AXIS_DESCR
/end CHARACTERISTIC
/begin CHARACTERISTIC PCR_rGovMaxDynEnd_C "" VALUE 0x8006598E Kw_Ws16 100.0000 Prc 0.00 100.0000 FORMAT "%8.4" EXTENDED_LIMITS -400.0000 399.9878 /end CHARACTERISTIC
/begin CHARACTERISTIC PCR_rGovMaxDynStrt_C "" VALUE 0x80065990 Kw_Ws16 100.0000 Prc 0.00 100.0000 FORMAT "%8.4" EXTENDED_LIMITS -400.0000 399.9878 /end CHARACTERISTIC
/begin CHARACTERISTIC PCR_rGovMaxDyn_MAP "" MAP 0x80065992 Kf_Xs16_Ys16_Ws16 100.0000 Prc 0.00 100.0000 FORMAT "%8.4" EXTENDED_LIMITS -400.0000 399.9878
 /begin AXIS_DESCR STD_AXIS Epm_nEng EngN 8 40.00000 6000.000 FORMAT "%8.3" EXTENDED_LIMITS -16384.00 16383.50 DEPOSIT ABSOLUTE /end AXIS_DESCR
 /begin AXIS_DESCR STD_AXIS PCR_qGov InjMass 8 0.00 100.0000 FORMAT "%8.4" EXTENDED_LIMITS -327.6800 327.6700 DEPOSIT ABSOLUTE /end AXIS_DESCR
/end CHARACTERISTIC
/begin CHARACTERISTIC PCR_rGovMax_MAP "Obergrenze der Reglerstellgröße des Ladedrucks" MAP 0x8007D14A Map_Xs16Ys16Ws16 300.0000 Prc -100.0000 200.0000 FORMAT "%8.4" EXTENDED_LIMITS -400.0000 399.9878
 /begin AXIS_DESCR STD_AXIS Epm_nEng EngN 16 0.00 8000.000 FORMAT "%8.3" EXTENDED_LIMITS -16384.00 16383.50 DEPOSIT ABSOLUTE /end AXIS_DESCR
 /begin AXIS_DESCR STD_AXIS PCR_qGov_mp InjMass 16 0.00 327.6700 FORMAT "%8.4" EXTENDED_LIMITS -327.6800 327.6700 DEPOSIT ABSOLUTE /end AXIS_DESCR
/end CHARACTERISTIC
/begin CHARACTERISTIC PCR_rGovMin_MAP "Untergrenze der Reglerstellgröße des Ladedrucks" MAP 0x8007D38E Map_Xs16Ys16Ws16 300.0000 Prc -100.0000 200.0000 FORMAT "%8.4" EXTENDED_LIMITS -400.0000 399.9878
 /begin AXIS_DESCR STD_AXIS Epm_nEng EngN 16 0.00 8000.000 FORMAT "%8.3" EXTENDED_LIMITS -16384.00 16383.50 DEPOSIT ABSOLUTE /end AXIS_DESCR
 /begin AXIS_DESCR STD_AXIS PCR_qGov_mp InjMass 16 0.00 327.6700 FORMAT "%8.4" EXTENDED_LIMITS -327.6800 327.6700 DEPOSIT ABSOLUTE /end AXIS_DESCR
/end CHARACTERISTIC
/begin CHARACTERISTIC PCR_rOfsRlsMax_C "Obergrenze des Tasverhältnis des Offsets für den Steueranteil" VALUE 0x80065C10 Val_Ws16 200.0000 Prc 0.00 200.0000 FORMAT "%8.4" EXTENDED_LIMITS -400.0000 399.9878 /end CHARACTERISTIC
/begin CHARACTERISTIC PCR_rOfsRlsMax_MAP "" MAP 0x80065C12 Map_Xs16Ys16Ws16 100.0000 Prc 0.00 100.0000 FORMAT "%8.4" EXTENDED_LIMITS -400.0000 399.9878
 /begin AXIS_DESCR STD_AXIS Epm_nEng EngN 6 0.00 6000.000 FORMAT "%8.3" EXTENDED_LIMITS -16384.00 16383.50 DEPOSIT ABSOLUTE /end AXIS_DESCR
 /begin AXIS_DESCR STD_AXIS PCR_qCtlVal InjMass 6 0.00 100.0000 FORMAT "%8.4" EXTENDED_LIMITS -327.6800 327.6700 DEPOSIT ABSOLUTE /end AXIS_DESCR
/end CHARACTERISTIC
/begin CHARACTERISTIC PCR_rOfsRlsMin_C "Unteregrenze des Tasverhältnis des Offsets für den Steueranteil" VALUE 0x80065C76 Val_Ws16 200.0000 Prc -100.0000 100.0000 FORMAT "%8.4" EXTENDED_LIMITS -400.0000 399.9878 /end CHARACTERISTIC
/begin CHARACTERISTIC PCR_rOfsRlsMin_MAP "" MAP 0x80065C78 Map_Xs16Ys16Ws16 100.0000 Prc 0.00 100.0000 FORMAT "%8.4" EXTENDED_LIMITS -400.0000 399.9878
 /begin AXIS_DESCR STD_AXIS Epm_nEng EngN 6 0.00 6000.000 FORMAT "%8.3" EXTENDED_LIMITS -16384.00 16383.50 DEPOSIT ABSOLUTE /end AXIS_DESCR
 /begin AXIS_DESCR STD_AXIS PCR_qCtlVal InjMass 6 0.00 100.0000 FORMAT "%8.4" EXTENDED_LIMITS -327.6800 327.6700 DEPOSIT ABSOLUTE /end AXIS_DESCR
/end CHARACTERISTIC
/begin CHARACTERISTIC PCR_rOutIMaxLP_MAP "" MAP 0x80065358 Kf_Xs16_Ys16_Ws16 100.0000 Prc 0.00 100.0000 FORMAT "%8.4" EXTENDED_LIMITS -400.0000 399.9878
 /begin AXIS_DESCR STD_AXIS Air_dpFltCACDs PreshPa_sec 4 -350000.0 350000.0 FORMAT "%8.1" EXTENDED_LIMITS -32768.00 32767.00 DEPOSIT ABSOLUTE /end AXIS_DESCR
 /begin AXIS_DESCR STD_AXIS PCR_qGov InjMass 4 0.00 200.0000 FORMAT "%8.4" EXTENDED_LIMITS -327.6800 327.6700 DEPOSIT ABSOLUTE /end AXIS_DESCR
/end CHARACTERISTIC
/begin CHARACTERISTIC PCR_rOutIMax_MAP "" MAP 0x80065A38 Kf_Xs16_Ys16_Ws16 5.004883 Prc 0.00 5.004883 FORMAT "%8.6" EXTENDED_LIMITS -400.0000 399.9878
 /begin AXIS_DESCR STD_AXIS Air_dpFltCACDs PreshPa_sec 8 -350000.0 350000.0 FORMAT "%8.1" EXTENDED_LIMITS -32768.00 32767.00 DEPOSIT ABSOLUTE /end AXIS_DESCR
 /begin AXIS_DESCR STD_AXIS PCR_qGov InjMass 8 0.00 200.0000 FORMAT "%8.4" EXTENDED_LIMITS -327.6800 327.6700 DEPOSIT ABSOLUTE /end AXIS_DESCR
/end CHARACTERISTIC
/begin CHARACTERISTIC PCR_rOutIMinLP_MAP "" MAP 0x8006538C Kf_Xs16_Ys16_Ws16 100.0000 Prc 0.00 100.0000 FORMAT "%8.4" EXTENDED_LIMITS -400.0000 399.9878
 /begin AXIS_DESCR STD_AXIS Air_dpFltCACDs PreshPa_sec 4 -350000.0 350000.0 FORMAT "%8.1" EXTENDED_LIMITS -32768.00 32767.00 DEPOSIT ABSOLUTE /end AXIS_DESCR
 /begin AXIS_DESCR STD_AXIS PCR_qGov InjMass 4 0.00 200.0000 FORMAT "%8.4" EXTENDED_LIMITS -327.6800 327.6700 DEPOSIT ABSOLUTE /end AXIS_DESCR
/end CHARACTERISTIC
/begin CHARACTERISTIC PCR_rOutIMin_MAP "" MAP 0x80065ADC Kf_Xs16_Ys16_Ws16 5.004883 Prc 0.00 5.004883 FORMAT "%8.6" EXTENDED_LIMITS -400.0000 399.9878
 /begin AXIS_DESCR STD_AXIS Air_dpFltCACDs PreshPa_sec 8 -350000.0 350000.0 FORMAT "%8.1" EXTENDED_LIMITS -32768.00 32767.00 DEPOSIT ABSOLUTE /end AXIS_DESCR
 /begin AXIS_DESCR STD_AXIS PCR_qGov InjMass 8 0.00 200.0000 FORMAT "%8.4" EXTENDED_LIMITS -327.6800 327.6700 DEPOSIT ABSOLUTE /end AXIS_DESCR
/end CHARACTERISTIC
/begin CHARACTERISTIC PCR_stBitMskEOMLP_CA "" VAL_BLK 0x8007DBE8 ValA_Wu32 4294967295.00 OneToOne 0.00 4294967295.00 FORMAT "%13.2" NUMBER 2 /end CHARACTERISTIC
/begin CHARACTERISTIC PCR_stBitMskEOM_CA "Bitmaske zur Auswahl der relevanten Abschaltfälle für die gewählte Betriebsart" VAL_BLK 0x8007D8D0 ValA_Wu32 4294967295.00 OneToOne 0.00 4294967295.00 FORMAT "%13.2" NUMBER 2 /end CHARACTERISTIC
/begin CHARACTERISTIC PCR_stCByVlvBitMsk_C "" VALUE 0x8007A98A Val_Wu8 255.0 OneToOne 0.00 255.0 FORMAT "%5.1" /end CHARACTERISTIC
/begin CHARACTERISTIC PCR_stCByVlvClose_C "" VALUE 0x8007A98B Val_Wu8 1.000 OneToOne 0.00 1.000 FORMAT "%5.3" EXTENDED_LIMITS 0.00 255.0 /end CHARACTERISTIC
/begin CHARACTERISTIC PCR_stCByVlvEOMMsk_CA "" VAL_BLK 0x8007A98C ValA_Wu32 4294967295.00 OneToOne 0.00 4294967295.00 FORMAT "%13.2" NUMBER 1 /end CHARACTERISTIC
/begin CHARACTERISTIC PCR_stCByVlvOpn_C "" VALUE 0x8007A990 Val_Wu8 1.000 OneToOne 0.00 1.000 FORMAT "%5.3" EXTENDED_LIMITS 0.00 255.0 /end CHARACTERISTIC
/begin CHARACTERISTIC PCR_stCtlValAutLPEOMMsk_CA "" VAL_BLK 0x8007BAF8 ValA_Wu32 4294967295.00 OneToOne 0.00 4294967295.00 FORMAT "%13.2" NUMBER 1 /end CHARACTERISTIC
/begin CHARACTERISTIC PCR_stCtlValEOMMsk_CA "Bitmaske zum Selektieren der relevanten Regenerationsanforderungen für die Ladedruck-Steuerung" VAL_BLK 0x8007A9D0 ValA_Wu32 4294967295.00 OneToOne 0.00 4294967295.00 FORMAT "%13.2" NUMBER 1 /end CHARACTERISTIC
/begin CHARACTERISTIC PCR_stCtlValLPEOMMsk_CA "" VAL_BLK 0x8007B71C ValA_Wu32 4294967295.00 OneToOne 0.00 4294967295.00 FORMAT "%13.2" NUMBER 1 /end CHARACTERISTIC
/begin CHARACTERISTIC PCR_stDesValEOMMsk_CA "" VAL_BLK 0x8007C6D0 ValA_Wu32 4294967295.00 OneToOne 0.00 4294967295.00 FORMAT "%13.2" NUMBER 1 /end CHARACTERISTIC
/begin CHARACTERISTIC PCR_stDesValLPEOMMsk_CA "" VAL_BLK 0x80064E40 ValA_Wu32 4294967295.00 OneToOne 0.00 4294967295.00 FORMAT "%13.2" NUMBER 1 /end CHARACTERISTIC
/begin CHARACTERISTIC PCR_stDflValCByVlv_C "" VALUE 0x8007A991 Val_Wu8 1.000 OneToOne 0.00 1.000 FORMAT "%5.3" EXTENDED_LIMITS 0.00 255.0 /end CHARACTERISTIC
/begin CHARACTERISTIC PCR_stMonEOMMsk_CA "Bitmaske zur Umschaltung zwischen normaler Maskierung und Maskierung des Regenerationsbetriebs" VAL_BLK 0x8007D8D8 ValA_Wu32 4294967295.00 OneToOne 0.00 4294967295.00 FORMAT "%13.2" NUMBER 2 /end CHARACTERISTIC
/begin CHARACTERISTIC PCR_stMonLPEOMMsk_CA "" VAL_BLK 0x8007DBF0 ValA_Wu32 4294967295.00 OneToOne 0.00 4294967295.00 FORMAT "%13.2" NUMBER 2 /end CHARACTERISTIC
/begin CHARACTERISTIC PCR_stMskGovOffEOMLP_C "" VALUE 0x80065228 Val_Wu32 4294967295.00 OneToOne 0.00 4294967295.00 FORMAT "%13.2" /end CHARACTERISTIC
/begin CHARACTERISTIC PCR_stMskGovOffEOM_C "Bitmaske zur Umschaltung zwischen Hysteriesengrenzen im normalen Betrieb und der im Regenerationsbetrieb" VALUE 0x8007D774 Val_Wu32 4294967295.00 OneToOne 0.00 4294967295.00 FORMAT "%13.2" /end CHARACTERISTIC
/begin CHARACTERISTIC PCR_stOfsCalcReset_C "" VALUE 0x80065CDC Val_Wu8 255.0 OneToOne 0.00 255.0 FORMAT "%5.1" /end CHARACTERISTIC
/begin CHARACTERISTIC PCR_stPrioMonLP_CA "" VAL_BLK 0x8007DBD0 ValA_Ws16 65535.00 OneToOne -32768.00 32767.00 FORMAT "%8.2" NUMBER 8 /end CHARACTERISTIC
/begin CHARACTERISTIC PCR_stPrioMon_CA "Prioritäten der Abschlatfälle" VAL_BLK 0x8007D828 ValA_Ws16 65535.00 OneToOne -32768.00 32767.00 FORMAT "%8.2" NUMBER 17 /end CHARACTERISTIC
/begin CHARACTERISTIC PCR_swtBstLPActv_C "" VALUE 0x8007A992 Val_Wu8 1.000 OneToOne 0.00 1.000 FORMAT "%5.3" EXTENDED_LIMITS 0.00 255.0 /end CHARACTERISTIC
/begin CHARACTERISTIC PCR_swtOfsCalcBst_C "Umschaltung für Schwelle zur Erhöhung oder Verringerung des Ladedrucks abhängig von PCR_rCtlValOfs" VALUE 0x80065CDD Val_Wu8 2.000 OneToOne 0.00 2.000 FORMAT "%5.3" EXTENDED_LIMITS 0.00 255.0 /end CHARACTERISTIC
/begin CHARACTERISTIC PCR_swtOfsCalcOn_C "Schalter zur Aktivierung des Offset-Lernens" VALUE 0x80065CDE Val_Wu8 1.000 OneToOne 0.00 1.000 FORMAT "%5.3" EXTENDED_LIMITS 0.00 255.0 /end CHARACTERISTIC
/begin CHARACTERISTIC PCR_tAirOfsCalcMax_C "" VALUE 0x80065CE0 Val_Ws16 200.0000 Temp_Cels -0.04000000 199.9600 FORMAT "%8.4" EXTENDED_LIMITS -3549.940 3003.560 /end CHARACTERISTIC
/begin CHARACTERISTIC PCR_tAirOfsCalcMin_C "" VALUE 0x80065CE2 Val_Ws16 200.0000 Temp_Cels -0.04000000 199.9600 FORMAT "%8.4" EXTENDED_LIMITS -3549.940 3003.560 /end CHARACTERISTIC
/begin CHARACTERISTIC PCR_tClntOfsCalcLim_C "" VALUE 0x80065CE4 Val_Ws16 200.0000 Temp_Cels -0.04000000 199.9600 FORMAT "%8.4" EXTENDED_LIMITS -3549.940 3003.560 /end CHARACTERISTIC
/begin CHARACTERISTIC PCR_tClntThres_C "Kühlwassertemperaturschwelle zur Parametersatzumschaltung des dynamischen Sollwertanteils" VALUE 0x8007C6EC Val_Ws16 6553.500 Temp_Cels -3549.940 3003.560 FORMAT "%8.3" /end CHARACTERISTIC
/begin CHARACTERISTIC PCR_TempCor.xVal_C "Schalter zur Auswahl zwischen Motortemperatur und Lufttemperatur für die Sollwertberechnung der Ladedruckregelung/" VALUE 0x8007C696 Kw_Wu8 1.000 OneToOne 0.00 1.000 FORMAT "%5.3" EXTENDED_LIMITS 0.00 255.0 /end CHARACTERISTIC
/begin CHARACTERISTIC PCR_TempCor.xTyp_C "Schalter zur Auswahl zwischen Motortemperatur und Lufttemperatur für die Sollwertberechnung der Ladedruckregelung/" VALUE 0x8007C697 Kw_Wu8 1.000 OneToOne 1.000 2.000 FORMAT "%5.3" EXTENDED_LIMITS 0.00 255.0 /end CHARACTERISTIC
/begin CHARACTERISTIC PCR_TempCorLP.xVal_C "/" VALUE 0x80064DF8 Kw_Wu8 1.000 OneToOne 0.00 1.000 FORMAT "%5.3" EXTENDED_LIMITS 0.00 255.0 /end CHARACTERISTIC
/begin CHARACTERISTIC PCR_TempCorLP.xTyp_C "/" VALUE 0x80064DF9 Kw_Wu8 1.000 OneToOne 1.000 2.000 FORMAT "%5.3" EXTENDED_LIMITS 0.00 255.0 /end CHARACTERISTIC
/begin CHARACTERISTIC PCR_tiCldStrt_CUR "Einschaltverzögerung der Regelung nach Starterabwurf" CURVE 0x8007D84A Cur_Xs16Ws16 33000.00 Time_ms 0.00 33000.00 FORMAT "%8.2" EXTENDED_LIMITS -327680.0 327670.0
 /begin AXIS_DESCR STD_AXIS PCR_tEngMon_mp Temp_Cels 30 -100.1400 199.8600 FORMAT "%8.4" EXTENDED_LIMITS -3549.940 3003.560 DEPOSIT ABSOLUTE /end AXIS_DESCR
/end CHARACTERISTIC
/begin CHARACTERISTIC PCR_tiClthLP_C "" VALUE 0x8007DBE0 Val_Wu16 655350.0 TimeDeb 0.00 655350.0 FORMAT "%8.1" /end CHARACTERISTIC
/begin CHARACTERISTIC PCR_tiClth_C "Aktivierungszeit für Kupplungserkennung" VALUE 0x8007D8C4 Val_Wu16 655350.0 TimeDeb 0.00 655350.0 FORMAT "%8.1" /end CHARACTERISTIC
/begin CHARACTERISTIC PCR_tiDelGov_C "Ausschaltverzögerung zur Aktivierung der dynamik Begrenzung" VALUE 0x8007D5D2 Val_Ws16 655.3500 Time_s -327.6800 327.6700 FORMAT "%8.4" /end CHARACTERISTIC
/begin CHARACTERISTIC PCR_tiDelPT1_C "PT1-Zeitkonstante der Dynamik-Begrenzung" VALUE 0x8007D5D4 Val_Ws32 4294.9662960 TimeDelay_s 0.0010000000689 4294.9672960 FORMAT "%12.7" EXTENDED_LIMITS 0.000002000000001 4294.9672960 /end CHARACTERISTIC
/begin CHARACTERISTIC PCR_tiDesSlpLim_C "" VALUE 0x800650CE Kw_Wu16 65535.00 Time_s 0.00 65535.00 FORMAT "%8.2" EXTENDED_LIMITS 0.00 655.3500 /end CHARACTERISTIC
/begin CHARACTERISTIC PCR_tiGovOffDelLP_CUR "" CURVE 0x8006522C Cur_Xs16Ws16 20.00000 Time_s 0.00 20.00000 FORMAT "%8.5" EXTENDED_LIMITS -327.6800 327.6700
 /begin AXIS_DESCR STD_AXIS Epm_nEng EngN 4 0.00 8000.000 FORMAT "%8.3" EXTENDED_LIMITS -16384.00 16383.50 DEPOSIT ABSOLUTE /end AXIS_DESCR
/end CHARACTERISTIC
/begin CHARACTERISTIC PCR_tiGovOffDel_CUR "" CURVE 0x8007D778 Cur_Xs16Ws16 20.00000 Time_s 0.00 20.00000 FORMAT "%8.5" EXTENDED_LIMITS -327.6800 327.6700
 /begin AXIS_DESCR STD_AXIS Epm_nEng EngN 6 0.00 8000.000 FORMAT "%8.3" EXTENDED_LIMITS -16384.00 16383.50 DEPOSIT ABSOLUTE /end AXIS_DESCR
/end CHARACTERISTIC
/begin CHARACTERISTIC PCR_tiMonEOM_CA "Zeitverzögerung zur Umschaltung zwischen normaler Maskierung und Maskierung des Regenerationsbetriebs" VAL_BLK 0x8007D8E0 ValA_Ws16 655350.0 TimeDeb -327680.0 327670.0 FORMAT "%8.1" NUMBER 2 /end CHARACTERISTIC
/begin CHARACTERISTIC PCR_tiMonLPEOM_CA "" VAL_BLK 0x8007DBF8 ValA_Ws16 655350.0 TimeDeb -327680.0 327670.0 FORMAT "%8.1" NUMBER 2 /end CHARACTERISTIC
/begin CHARACTERISTIC PCR_tiOfsCalcPT1_C "Filterung Drehzahlgradient" VALUE 0x80065CE8 Val_Ws32 4294.8272945 TimeDelay_s 0.14000154169 4294.9672960 FORMAT "%12.7" EXTENDED_LIMITS 0.000002000000001 4294.9672960 /end CHARACTERISTIC
/begin CHARACTERISTIC PCR_tiOfsCalcRelStatAll.tiHiLo_C "/" VALUE 0x80065CEC Kw_Ws16 655350.0 TimeDeb -327680.0 327670.0 FORMAT "%8.1" /end CHARACTERISTIC
/begin CHARACTERISTIC PCR_tiOfsCalcRelStatAll.tiLoHi_C "/" VALUE 0x80065CEE Kw_Ws16 655350.0 TimeDeb -327680.0 327670.0 FORMAT "%8.1" /end CHARACTERISTIC
/begin CHARACTERISTIC PCR_tiOfsCalcRlsStat3.tiHiLo_C "/" VALUE 0x80065CF0 Kw_Ws16 655350.0 TimeDeb -327680.0 327670.0 FORMAT "%8.1" /end CHARACTERISTIC
/begin CHARACTERISTIC PCR_tiOfsCalcRlsStat3.tiLoHi_C "/" VALUE 0x80065CF2 Kw_Ws16 655350.0 TimeDeb -327680.0 327670.0 FORMAT "%8.1" /end CHARACTERISTIC
/begin CHARACTERISTIC PCR_tiPT1LP_C "" VALUE 0x80065244 Val_Ws32 4294.9662960 TimeDelay_s 0.0010000000689 4294.9672960 FORMAT "%12.7" EXTENDED_LIMITS 0.000002000000001 4294.9672960 /end CHARACTERISTIC
/begin CHARACTERISTIC PCR_tiPT1_C "PT1-Zeitkonstante zur Sollwertfilterung für den I-Anteil" VALUE 0x8007D5D8 Val_Ws32 4294.9662960 TimeDelay_s 0.0010000000689 4294.9672960 FORMAT "%12.7" EXTENDED_LIMITS 0.000002000000001 4294.9672960 /end CHARACTERISTIC
/begin CHARACTERISTIC PCR_tiRmp2LP_C "" VALUE 0x8006519C Val_Ws32 65.535999984741210 TimeCoEOMRmp 0.000000015258789 65.536000000000001 FORMAT "%19.16" EXTENDED_LIMITS 0.000000030517578 65.536000000000001 /end CHARACTERISTIC
/begin CHARACTERISTIC PCR_tiRmpLP_C "" VALUE 0x80065240 Val_Wu32 65.535999984741210 TimeCoEOMRmp 0.000000015258789 65.536000000000001 FORMAT "%19.16" /end CHARACTERISTIC
/begin CHARACTERISTIC PCR_tiRmp_C "" VALUE 0x8007D794 Val_Wu32 65.535999984741210 TimeCoEOMRmp 0.000000015258789 65.536000000000001 FORMAT "%19.16" /end CHARACTERISTIC
/begin CHARACTERISTIC PCR_TrqCtl.xVal_C "Schalter zur Auswahl des Drehmoments für die Steuerung/" VALUE 0x8007A998 Kw_Wu8 1.000 OneToOne 0.00 1.000 FORMAT "%5.3" EXTENDED_LIMITS 0.00 255.0 /end CHARACTERISTIC
/begin CHARACTERISTIC PCR_TrqCtl.xTyp_C "Schalter zur Auswahl des Drehmoments für die Steuerung/" VALUE 0x8007A999 Kw_Wu8 1.000 OneToOne 1.000 2.000 FORMAT "%5.3" EXTENDED_LIMITS 0.00 255.0 /end CHARACTERISTIC
/begin CHARACTERISTIC PCR_TrqDes.xVal_C "Schalter zur Auswahl des Drehmoments für die Sollwertberechnung/" VALUE 0x8007A99A Kw_Wu8 1.000 OneToOne 0.00 1.000 FORMAT "%5.3" EXTENDED_LIMITS 0.00 255.0 /end CHARACTERISTIC
/begin CHARACTERISTIC PCR_TrqDes.xTyp_C "Schalter zur Auswahl des Drehmoments für die Sollwertberechnung/" VALUE 0x8007A99B Kw_Wu8 1.000 OneToOne 1.000 2.000 FORMAT "%5.3" EXTENDED_LIMITS 0.00 255.0 /end CHARACTERISTIC
/begin CHARACTERISTIC PCR_vClthLP_C "" VALUE 0x8007DBE2 Val_Ws16 300.0000 Vel 0.00 300.0000 FORMAT "%8.4" EXTENDED_LIMITS -327.6800 327.6700 /end CHARACTERISTIC
/begin CHARACTERISTIC PCR_WrkSph2_C "Obere Grenze der Einspritzmenge bzw. innerem Drehmoment des Arbeitsbereiches 2" VALUE 0x8007D8C6 Val_Ws16 327.6700 InjMass 0.00 327.6700 FORMAT "%8.4" EXTENDED_LIMITS -327.6800 327.6700 /end CHARACTERISTIC
/begin CHARACTERISTIC PCR_WrkSph3_C "Obere Grenze der Einspritzmenge bzw. innerem Drehmoment des Arbeitsbereiches 3" VALUE 0x8007D8C8 Val_Ws16 327.6700 InjMass 0.00 327.6700 FORMAT "%8.4" EXTENDED_LIMITS -327.6800 327.6700 /end CHARACTERISTIC
/begin CHARACTERISTIC PCR_WrmDT1Win.T1_C "DT1-Parameter für den warmen Motorzustand/" VALUE 0x8007C6F0 Val_Ws32 4294.9662960 TimeDelay_s 0.0010000000689 4294.9672960 FORMAT "%12.7" EXTENDED_LIMITS 0.000002000000001 4294.9672960 /end CHARACTERISTIC
/begin CHARACTERISTIC PCR_WrmDT1Win.Kd_C "DT1-Parameter für den warmen Motorzustand/" VALUE 0x8007C6F4 Val_Ws32 65535.9999847 Kd -32768.0000000 32767.9999847 FORMAT "%13.7" /end CHARACTERISTIC
/begin CHARACTERISTIC PCR_WrmDT1Win.KdPos_C "DT1-Parameter für den warmen Motorzustand/" VALUE 0x8007C6F8 Val_Ws32 65535.9999847 Kd -32768.0000000 32767.9999847 FORMAT "%13.7" /end CHARACTERISTIC
/begin CHARACTERISTIC PCR_WrmDT1Win.KdNeg_C "DT1-Parameter für den warmen Motorzustand/" VALUE 0x8007C6FC Val_Ws32 65535.9999847 Kd -32768.0000000 32767.9999847 FORMAT "%13.7" /end CHARACTERISTIC
/begin CHARACTERISTIC PCR_WrmDT1Win.WinPos_C "DT1-Parameter für den warmen Motorzustand/" VALUE 0x8007C700 Val_Ws32 2147487148.00 Pres_hPa -2147483648.00 3500.00 FORMAT "%13.2" EXTENDED_LIMITS -2147483648.00 2147483647.00 /end CHARACTERISTIC
/begin CHARACTERISTIC PCR_WrmDT1Win.WinNeg_C "DT1-Parameter für den warmen Motorzustand/" VALUE 0x8007C704 Val_Ws32 2147487148.00 Pres_hPa -2147483648.00 3500.00 FORMAT "%13.2" EXTENDED_LIMITS -2147483648.00 2147483647.00 /end CHARACTERISTIC
/begin CHARACTERISTIC PCV_dvolUpLim_CUR "Maximaler Durchfluss der Pumpe als Funktion der Drehzahl" CURVE 0x80065CF4 Cur_Xs16Ws16 655350.0 Qp_mm3_sec -327680.0 327670.0 FORMAT "%8.1"
 /begin AXIS_DESCR STD_AXIS Epm_nEng EngN 10 0.00 6000.000 FORMAT "%8.3" EXTENDED_LIMITS -16384.00 16383.50 DEPOSIT ABSOLUTE /end AXIS_DESCR
/end CHARACTERISTIC
/begin CHARACTERISTIC PCV_facAdaptDiffI_C "Faktor der maximalen Abweichung zwischen Soll- und Iststrom durch das PCV, ab dem die Adaption durchgeführt wird" VALUE 0x80065D1E Val_Ws16 1.000000 Fact 0.00 1.000000 FORMAT "%8.6" EXTENDED_LIMITS -4.000000 3.999878 /end CHARACTERISTIC
/begin CHARACTERISTIC PCV_facAdaptDiff_C "Faktor der maximalen Abweichung zwischen Railsoll- und Railistdruck, ab der die Adaption durchgeführt wird" VALUE 0x80065D20 Val_Ws16 1.000000 Fact 0.00 1.000000 FORMAT "%8.6" EXTENDED_LIMITS -4.000000 3.999878 /end CHARACTERISTIC
/begin CHARACTERISTIC PCV_facAdaptFlowMin_C "Mindestwert für den Durchflusskorrektur-Faktor des PCV" VALUE 0x80065D22 Val_Ws16 20.00000 Fact 0.00 20.00000 FORMAT "%8.5" EXTENDED_LIMITS -4.000000 3.999878 /end CHARACTERISTIC
/begin CHARACTERISTIC PCV_facAdaptFlow_MAP "Durchflusskorrektur-Faktor für die PCV-Kennlinie als Funktion vom Durchfluss durch das PCV und dem Raildruck" MAP 0x80065D24 Map_Xs16Ys16Ws16 7.999878 Fact -4.000000 3.999878 FORMAT "%8.6"
 /begin AXIS_DESCR STD_AXIS RailP_pFlt Pres_Rail 6 0.00 2000.000 FORMAT "%5.3" EXTENDED_LIMITS -3276.800 3276.700 DEPOSIT ABSOLUTE /end AXIS_DESCR
 /begin AXIS_DESCR STD_AXIS PCV_dvolFlow_mp Qp_mm3_sec 4 -10000.00 50000.00 FORMAT "%8.2" EXTENDED_LIMITS -327680.0 327670.0 DEPOSIT ABSOLUTE /end AXIS_DESCR
/end CHARACTERISTIC
/begin CHARACTERISTIC PCV_facAdaptMax_C "Maximalwert des Adaptionsfaktors des PCV" VALUE 0x80065D6C Val_Ws16 2.000000 Fact 0.00 2.000000 FORMAT "%8.6" EXTENDED_LIMITS -4.000000 3.999878 /end CHARACTERISTIC
/begin CHARACTERISTIC PCV_facAdaptMin_C "Minimalwert des Adaptionsfaktors des PCV" VALUE 0x80065D6E Val_Ws16 2.000000 Fact 0.00 2.000000 FORMAT "%8.6" EXTENDED_LIMITS -4.000000 3.999878 /end CHARACTERISTIC
/begin CHARACTERISTIC PCV_facAdaptWgh_C "Gewichtungsfaktor für die Berechnung des Adaptionsfaktors des PCV" VALUE 0x80065D70 Val_Ws16 20.00000 Fact4 0.00 20.00000 FORMAT "%8.5" EXTENDED_LIMITS -1638.400 1638.350 /end CHARACTERISTIC
/begin CHARACTERISTIC PCV_numAdaptSum_C "Anzahl der Funktionsaufrufe der PCV-Adaption im Zustand PCV_ADAPT_SUM_UP" VALUE 0x80065D72 Val_Wu16 20.00000 OneToOne 0.00 20.00000 FORMAT "%8.5" EXTENDED_LIMITS 0.00 65535.00 /end CHARACTERISTIC
/begin CHARACTERISTIC PCV_numAdaptThres_C "Anzahl der Adaptionen, die bei beliebigem Raildruck durchgeführt werden" VALUE 0x80065D74 Val_Wu16 100.0000 OneToOne 0.00 100.0000 FORMAT "%8.4" EXTENDED_LIMITS 0.00 65535.00 /end CHARACTERISTIC
/begin CHARACTERISTIC PCV_numAdapt_C "Anzahl der Funktionsaufrufe der PCV-Adaption im Zustand PCV_ADAPT_STABLE" VALUE 0x80065D76 Val_Wu16 100.0000 OneToOne 0.00 100.0000 FORMAT "%8.4" EXTENDED_LIMITS 0.00 65535.00 /end CHARACTERISTIC
/begin CHARACTERISTIC PCV_pAdaptThresDec_C "Differenzdruck, um den die Druckschwelle reduziert wird, wenn die letzte Adaption zu lange zurück liegt" VALUE 0x80065D78 Val_Ws16 5276.800 Pres_Rail -3276.800 2000.000 FORMAT "%5.3" EXTENDED_LIMITS -3276.800 3276.700 /end CHARACTERISTIC
/begin CHARACTERISTIC PCV_pAdaptThresMax_C "Maximaler Raildruck für die Adaptions-Freigabe" VALUE 0x80065D7A Val_Ws16 5276.800 Pres_Rail -3276.800 2000.000 FORMAT "%5.3" EXTENDED_LIMITS -3276.800 3276.700 /end CHARACTERISTIC
/begin CHARACTERISTIC PCV_pAdaptThresMin_C "Minimaler Raildruck für die Adaptions-Freigabe" VALUE 0x80065D7C Val_Ws16 5276.800 Pres_Rail -3276.800 2000.000 FORMAT "%5.3" EXTENDED_LIMITS -3276.800 3276.700 /end CHARACTERISTIC
/begin CHARACTERISTIC PCV_pAdaptThres_C "Maximaler Wert für die Druckschwelle, ab der die Adaption durchgeführt wird" VALUE 0x80065D7E Val_Ws16 5276.800 Pres_Rail -3276.800 2000.000 FORMAT "%5.3" EXTENDED_LIMITS -3276.800 3276.700 /end CHARACTERISTIC
/begin CHARACTERISTIC PCV_swtAdaptCPC_C "Schalter für die Freigabe der Adaption im CPC-Betrieb" VALUE 0x80065D80 Val_Wu8 255.0 OneToOne 0.00 255.0 FORMAT "%5.1" /end CHARACTERISTIC
/begin CHARACTERISTIC PCV_swtAdaptFlow_C "Schalter für die Freigabe der Durchflusswertberechnung" VALUE 0x80065D81 Val_Wu8 255.0 OneToOne 0.00 255.0 FORMAT "%5.1" /end CHARACTERISTIC
/begin CHARACTERISTIC PCV_swtAdaptRst_C "Schalter für das Zurücksetzen der Adaptionswerte" VALUE 0x80065D82 Val_Wu8 255.0 OneToOne 0.00 255.0 FORMAT "%5.1" /end CHARACTERISTIC
/begin CHARACTERISTIC PCV_swtAdapt_C "Schalter für die Freigabe der Adaptionswertberechnung" VALUE 0x80065D83 Val_Wu8 255.0 OneToOne 0.00 255.0 FORMAT "%5.1" /end CHARACTERISTIC
/begin CHARACTERISTIC PCV_tFuelAdaptMax_C "Maximale Kraftstofftemperatur, bis zu der die Adaption durchgeführt wird" VALUE 0x80065D84 Val_Ws16 140.0000 Temp_Cels -40.04000 99.96000 FORMAT "%8.4" EXTENDED_LIMITS -3549.940 3003.560 /end CHARACTERISTIC
/begin CHARACTERISTIC PCV_tFuelAdaptMin_C "Minimale Kraftstofftemperatur, ab der die Adaption durchgeführt wird" VALUE 0x80065D86 Val_Ws16 140.0000 Temp_Cels -40.04000 99.96000 FORMAT "%8.4" EXTENDED_LIMITS -3549.940 3003.560 /end CHARACTERISTIC
/begin CHARACTERISTIC PCV_tiAdaptMax_C "Maximale Zeitspanne, die zwischen zwei Adaptionsvorgängen ohne Absenkung der Raildruckschwelle vergehen darf" VALUE 0x80065D88 Val_Wu32 65000.0000000 TimeEngOn 0.00 65000.0000000 FORMAT "%13.7" EXTENDED_LIMITS 0.00 4294967295.00 /end CHARACTERISTIC
/begin CHARACTERISTIC PCV_tSwtMeUn_C "Temperaturschwelle für die Freigabe der Botschaft PCV_stAdaptMeUn" VALUE 0x80065D8C Val_Ws16 140.0000 Temp_Cels -40.04000 99.96000 FORMAT "%8.4" EXTENDED_LIMITS -3549.940 3003.560 /end CHARACTERISTIC
/begin MEASUREMENT Air_pAirFltDs "" SWORD Pres_hPa 1 100 -32768.00 3500.00 FORMAT "%8.2" ECU_ADDRESS 0xD0006BC0 /end MEASUREMENT
/begin MEASUREMENT Air_pFltPAirFltDs "" SWORD Pres_hPa 1 100 -32768.00 3500.00 FORMAT "%8.2" ECU_ADDRESS 0xD0006BC8 /end MEASUREMENT
/begin MEASUREMENT Air_pSensPAirFltDs "" SWORD Pres_hPa 1 100 -32768.00 3500.00 FORMAT "%8.2" ECU_ADDRESS 0xD0006BCA /end MEASUREMENT
/begin MEASUREMENT Air_stErrPAirFltDs "" UBYTE OneToOne 1 100 0.00 255.0 FORMAT "%5.1" ECU_ADDRESS 0xD0008F16 /end MEASUREMENT
/begin MEASUREMENT Air_stLastErrPAirFltDs "" UBYTE OneToOne 1 100 0.00 255.0 FORMAT "%5.1" ECU_ADDRESS 0xD0008F17 /end MEASUREMENT
/begin MEASUREMENT Air_swtSigPAirFltDs "" UBYTE OneToOne 1 100 0.00 255.0 FORMAT "%5.1" ECU_ADDRESS 0xD0008F18 /end MEASUREMENT
/begin MEASUREMENT Air_uRawPAirFltDs "" SWORD Volt 1 100 -6553.600 6553.400 FORMAT "%8.3" ECU_ADDRESS 0xD0006BE6 /end MEASUREMENT
/begin MEASUREMENT Oil_rRawOilLvl "" UBYTE OneToOne 1 100 0.00 255.0 FORMAT "%5.1" ECU_ADDRESS 0xD00090ED /end MEASUREMENT
/begin MEASUREMENT Oil_rRawOilQl "" UWORD OneToOne 1 100 0.00 65535.00 FORMAT "%8.2" ECU_ADDRESS 0xD000767E /end MEASUREMENT
/begin MEASUREMENT Oil_rRawOilT "" UBYTE OneToOne 1 100 0.00 255.0 FORMAT "%5.1" ECU_ADDRESS 0xD00090EE /end MEASUREMENT
/begin MEASUREMENT Oil_stRegSens "" UBYTE OneToOne 1 100 0.00 255.0 FORMAT "%5.1" ECU_ADDRESS 0xD00090F1 /end MEASUREMENT
/begin MEASUREMENT Oil_swtSensVar "" UBYTE OneToOne 1 100 0.00 255.0 FORMAT "%5.1" ECU_ADDRESS 0xD00090F2 /end MEASUREMENT
/begin MEASUREMENT Oil_tSensSwmp "" SWORD Temp_Cels 1 100 -3549.940 3003.560 FORMAT "%8.3" ECU_ADDRESS 0xD0007394 /end MEASUREMENT
/begin MEASUREMENT Oil_tSwmp "" SWORD Temp_Cels 1 100 -3549.940 3003.560 FORMAT "%8.3" ECU_ADDRESS 0xD0006958 /end MEASUREMENT
/begin MEASUREMENT Oil_uRawTSwmp "" SWORD Volt 1 100 -6553.600 6553.400 FORMAT "%8.3" ECU_ADDRESS 0xD0007396 /end MEASUREMENT
/begin MEASUREMENT OS_cnt1000msTask "" UWORD OneToOne 1 100 0.00 65535.00 FORMAT "%8.2" ECU_ADDRESS 0xD0007B00 /end MEASUREMENT
/begin MEASUREMENT OS_cnt100msTask "" UWORD OneToOne 1 100 0.00 65535.00 FORMAT "%8.2" ECU_ADDRESS 0xD0007AFC /end MEASUREMENT
/begin MEASUREMENT OS_cnt10msTask "" UWORD OneToOne 1 100 0.00 65535.00 FORMAT "%8.2" ECU_ADDRESS 0xD0007AF6 /end MEASUREMENT
/begin MEASUREMENT OS_cnt1msTask "" UWORD OneToOne 1 100 0.00 65535.00 FORMAT "%8.2" ECU_ADDRESS 0xD0007AF0 /end MEASUREMENT
/begin MEASUREMENT OS_cnt200msTask "" UWORD OneToOne 1 100 0.00 65535.00 FORMAT "%8.2" ECU_ADDRESS 0xD0007AFE /end MEASUREMENT
/begin MEASUREMENT OS_cnt20msTask "" UWORD OneToOne 1 100 0.00 65535.00 FORMAT "%8.2" ECU_ADDRESS 0xD0007AF8 /end MEASUREMENT
/begin MEASUREMENT OS_cnt2msTask "" UWORD OneToOne 1 100 0.00 65535.00 FORMAT "%8.2" ECU_ADDRESS 0xD0007AF2 /end MEASUREMENT
/begin MEASUREMENT OS_cnt50msTask "" UWORD OneToOne 1 100 0.00 65535.00 FORMAT "%8.2" ECU_ADDRESS 0xD0007AFA /end MEASUREMENT
/begin MEASUREMENT OS_cnt5msTask "" UWORD OneToOne 1 100 0.00 65535.00 FORMAT "%8.2" ECU_ADDRESS 0xD0007AF4 /end MEASUREMENT
/begin MEASUREMENT OS_cntBgTask "" UWORD OneToOne 1 100 0.00 65535.00 FORMAT "%8.2" ECU_ADDRESS 0xD0007AEE /end MEASUREMENT
/begin MEASUREMENT OS_cntDsmClearTask "" UWORD OneToOne 1 100 0.00 65535.00 FORMAT "%8.2" ECU_ADDRESS 0xD0007B02 /end MEASUREMENT
/begin MEASUREMENT OS_cntEpmNoSyncTask "" UWORD OneToOne 1 100 0.00 65535.00 FORMAT "%8.2" ECU_ADDRESS 0xD0007B10 /end MEASUREMENT
/begin MEASUREMENT OS_cntIniEndTask "" UWORD OneToOne 1 100 0.00 65535.00 FORMAT "%8.2" ECU_ADDRESS 0xD0007AEC /end MEASUREMENT
/begin MEASUREMENT OS_cntIniTask "" UWORD OneToOne 1 100 0.00 65535.00 FORMAT "%8.2" ECU_ADDRESS 0xD0007AEA /end MEASUREMENT
/begin MEASUREMENT OS_cntMoTask "" UWORD OneToOne 1 100 0.00 65535.00 FORMAT "%8.2" ECU_ADDRESS 0xD0007B12 /end MEASUREMENT
/begin MEASUREMENT OS_cntSyncDummyTask "" UWORD OneToOne 1 100 0.00 65535.00 FORMAT "%8.2" ECU_ADDRESS 0xD0007B0E /end MEASUREMENT
/begin MEASUREMENT OS_cntSyncFirstTask "" UWORD OneToOne 1 100 0.00 65535.00 FORMAT "%8.2" ECU_ADDRESS 0xD0007B06 /end MEASUREMENT
/begin MEASUREMENT OS_cntSyncIni "" UWORD OneToOne 1 100 0.00 65535.00 FORMAT "%8.2" ECU_ADDRESS 0xD0007B04 /end MEASUREMENT
/begin MEASUREMENT OS_cntSyncPostTask "" UWORD OneToOne 1 100 0.00 65535.00 FORMAT "%8.2" ECU_ADDRESS 0xD0007B0A /end MEASUREMENT
/begin MEASUREMENT OS_cntSyncPreTask "" UWORD OneToOne 1 100 0.00 65535.00 FORMAT "%8.2" ECU_ADDRESS 0xD0007B08 /end MEASUREMENT
/begin MEASUREMENT OS_cntSyncSchedTask "" UWORD OneToOne 1 100 0.00 65535.00 FORMAT "%8.2" ECU_ADDRESS 0xD0007B0C /end MEASUREMENT
/begin MEASUREMENT OS_ErrCtr_accessResource_u8 "" UBYTE OneToOne 1 100 0.00 255.0 FORMAT "%5.1" ECU_ADDRESS 0xD00092FD /end MEASUREMENT
/begin MEASUREMENT OS_ErrCtr_callevel_u8 "" UBYTE OneToOne 1 100 0.00 255.0 FORMAT "%5.1" ECU_ADDRESS 0xD00092FE /end MEASUREMENT
/begin MEASUREMENT OS_ErrCtr_deadline_u8 "" UBYTE OneToOne 1 100 0.00 255.0 FORMAT "%5.1" ECU_ADDRESS 0xD0009305 /end MEASUREMENT
/begin MEASUREMENT OS_ErrCtr_default_u8 "" UBYTE OneToOne 1 100 0.00 255.0 FORMAT "%5.1" ECU_ADDRESS 0xD0009304 /end MEASUREMENT
/begin MEASUREMENT OS_ErrCtr_generalError_u8 "" UBYTE OneToOne 1 100 0.00 255.0 FORMAT "%5.1" ECU_ADDRESS 0xD0009303 /end MEASUREMENT
/begin MEASUREMENT OS_ErrCtr_idValue_u8 "" UBYTE OneToOne 1 100 0.00 255.0 FORMAT "%5.1" ECU_ADDRESS 0xD00092FF /end MEASUREMENT
/begin MEASUREMENT OS_ErrCtr_limit_u8 "" UBYTE OneToOne 1 100 0.00 255.0 FORMAT "%5.1" ECU_ADDRESS 0xD0009300 /end MEASUREMENT
/begin MEASUREMENT OS_ErrCtr_noFuncState_u8 "" UBYTE OneToOne 1 100 0.00 255.0 FORMAT "%5.1" ECU_ADDRESS 0xD0009301 /end MEASUREMENT
/begin MEASUREMENT OS_ErrCtr_stackcnt_u8 "" UBYTE OneToOne 1 100 0.00 255.0 FORMAT "%5.1" ECU_ADDRESS 0xD0009306 /end MEASUREMENT
/begin MEASUREMENT OS_ErrCtr_stackstat_u8 "" UBYTE OneToOne 1 100 0.00 255.0 FORMAT "%5.1" ECU_ADDRESS 0xD0009307 /end MEASUREMENT
/begin MEASUREMENT OS_ErrCtr_sum_u8 "" UBYTE OneToOne 1 100 0.00 255.0 FORMAT "%5.1" ECU_ADDRESS 0xD0009308 /end MEASUREMENT
/begin MEASUREMENT OS_ErrCtr_timetable_u8 "" UBYTE OneToOne 1 100 0.00 255.0 FORMAT "%5.1" ECU_ADDRESS 0xD0009302 /end MEASUREMENT
/begin MEASUREMENT PCR_ActModeCtlCalc_mp "" UBYTE OneToOne 1 100 0.00 255.0 FORMAT "%5.1" ECU_ADDRESS 0xC0001376 /end MEASUREMENT
/begin MEASUREMENT PCR_DesModeCtlCalc_mp "" UBYTE OneToOne 1 100 0.00 255.0 FORMAT "%5.1" ECU_ADDRESS 0xC0001377 /end MEASUREMENT
/begin MEASUREMENT PCR_dnAvrg "" SWORD EngNGrd 1 100 -16384.00 16383.50 FORMAT "%8.2" ECU_ADDRESS 0xD0007398 /end MEASUREMENT
/begin MEASUREMENT PCR_dpBGDev_mp "" SWORD dp_dZ20 1 100 -327680.0 327670.0 FORMAT "%8.1" ECU_ADDRESS 0xC0001504 /end MEASUREMENT
/begin MEASUREMENT PCR_dqCtlOfsCalc "" SWORD InjMassPerSec_20ms 1 100 -16384.00 16383.50 FORMAT "%8.2" ECU_ADDRESS 0xD000739A /end MEASUREMENT
/begin MEASUREMENT PCR_drAPPUnFlt_mp "" SWORD PrcPerSec 1 100 -20000.00 19999.39 FORMAT "%8.2" ECU_ADDRESS 0xC0001482 /end MEASUREMENT
/begin MEASUREMENT PCR_facAirTempCtlCorEOM_mp "" SWORD Fact 1 100 -4.000000 3.999878 FORMAT "%8.6" ECU_ADDRESS 0xC0001378 /end MEASUREMENT
/begin MEASUREMENT PCR_facAirTempCtlCor_mp "Lufttemperaturabhängiger Korrekturfaktor für den Ladedruck-Steueranteil im Normalbetrieb" SWORD Fact 1 100 -4.000000 3.999878 FORMAT "%8.6" ECU_ADDRESS 0xC000140E /end MEASUREMENT
/begin MEASUREMENT PCR_facAirTempDesCorEOMQnt1_mp "" SWORD Fact 1 100 -4.000000 3.999878 FORMAT "%8.6" ECU_ADDRESS 0xC0001488 /end MEASUREMENT
/begin MEASUREMENT PCR_facAirTempDesCorLPEOMQnt1_mp "" SWORD Fact 1 100 -4.000000 3.999878 FORMAT "%8.6" ECU_ADDRESS 0xC0001460 /end MEASUREMENT
/begin MEASUREMENT PCR_facAirTempDesCorLP_mp "" SWORD Fact 1 100 -4.000000 3.999878 FORMAT "%8.6" ECU_ADDRESS 0xC0001476 /end MEASUREMENT
/begin MEASUREMENT PCR_facAirTempDesCor_mp "Lufttemperaturabhängiger Korrekturfaktor für die Ladedruck Sollwertberechnung" SWORD Fact 1 100 -4.000000 3.999878 FORMAT "%8.6" ECU_ADDRESS 0xC0001414 /end MEASUREMENT
/begin MEASUREMENT PCR_facD1_mp "" SWORD Fact1 1 100 -256.0000 255.9922 FORMAT "%8.4" ECU_ADDRESS 0xC0001506 /end MEASUREMENT
/begin MEASUREMENT PCR_facD2_mp "" SWORD Fact1 1 100 -256.0000 255.9922 FORMAT "%8.4" ECU_ADDRESS 0xC0001508 /end MEASUREMENT
/begin MEASUREMENT PCR_facdpCorr_mp "" SWORD Fact1 1 100 -256.0000 255.9922 FORMAT "%8.4" ECU_ADDRESS 0xC000150A /end MEASUREMENT
/begin MEASUREMENT PCR_facD_mp "Adaptionsfaktor für Regler-D-Verstärkung" SWORD Fact1 1 100 -256.0000 255.9922 FORMAT "%8.4" ECU_ADDRESS 0xC000150C /end MEASUREMENT
/begin MEASUREMENT PCR_facEngTempCtlCorAutLP_mp "" SWORD Fact 1 100 -4.000000 3.999878 FORMAT "%8.6" ECU_ADDRESS 0xC00013A2 /end MEASUREMENT
/begin MEASUREMENT PCR_facEngTempCtlCorLP_mp "" SWORD Fact 1 100 -4.000000 3.999878 FORMAT "%8.6" ECU_ADDRESS 0xC00013A4 /end MEASUREMENT
/begin MEASUREMENT PCR_facEngTempCtlCor_mp "Motortemperaturabhängiger Korrekturfaktor für den Ladedruck-Steueranteil" SWORD Fact 1 100 -4.000000 3.999878 FORMAT "%8.6" ECU_ADDRESS 0xC000137A /end MEASUREMENT
/begin MEASUREMENT PCR_facEnvPresCtlCorAutLPEOMQnt1_mp "" SWORD Fact 1 100 -4.000000 3.999878 FORMAT "%8.6" ECU_ADDRESS 0xC00013DC /end MEASUREMENT
/begin MEASUREMENT PCR_facEnvPresCtlCorAutLP_mp "" SWORD Fact 1 100 -4.000000 3.999878 FORMAT "%8.6" ECU_ADDRESS 0xC00013A6 /end MEASUREMENT
/begin MEASUREMENT PCR_facEnvPresCtlCorEOMQnt1_mp "Atmosphärendruckabhängiger Korrekturfaktor für die Ladedruck-Steuerung für die erste auf Einspritzmenge basierte Betriebsart" SWORD Fact 1 100 -4.000000 3.999878 FORMAT "%8.6" ECU_ADDRESS 0xC0001400 /end MEASUREMENT
/begin MEASUREMENT PCR_facEnvPresCtlCorLPEOMQnt1_mp "" SWORD Fact 1 100 -4.000000 3.999878 FORMAT "%8.6" ECU_ADDRESS 0xC00013D0 /end MEASUREMENT
/begin MEASUREMENT PCR_facEnvPresCtlCorLP_mp "" SWORD Fact 1 100 -4.000000 3.999878 FORMAT "%8.6" ECU_ADDRESS 0xC00013A8 /end MEASUREMENT
/begin MEASUREMENT PCR_facEnvPresCtlCor_mp "Atmosphärendruckabhängiger Korrekturfaktor für Ladedrucksteuerung" SWORD Fact 1 100 -4.000000 3.999878 FORMAT "%8.6" ECU_ADDRESS 0xC000137C /end MEASUREMENT
/begin MEASUREMENT PCR_facEnvPresDesCorEOMQnt1_mp "" SWORD Fact 1 100 -4.000000 3.999878 FORMAT "%8.6" ECU_ADDRESS 0xC000148A /end MEASUREMENT
/begin MEASUREMENT PCR_facEnvPresDesCorLPEOMQnt1_mp "" SWORD Fact 1 100 -4.000000 3.999878 FORMAT "%8.6" ECU_ADDRESS 0xC0001462 /end MEASUREMENT
/begin MEASUREMENT PCR_facEnvPresDesCorLP_mp "" SWORD Fact 1 100 -4.000000 3.999878 FORMAT "%8.6" ECU_ADDRESS 0xC000143E /end MEASUREMENT
/begin MEASUREMENT PCR_facEnvPresDesCor_mp "Atmosphärendruckabhängiger Korrekturfaktor für Ladedruck" SWORD Fact 1 100 -4.000000 3.999878 FORMAT "%8.6" ECU_ADDRESS 0xC0001416 /end MEASUREMENT
/begin MEASUREMENT PCR_facI_mp "Adaptionsfaktor für Regler-I-Verstärkung" SWORD Fact1 1 100 -256.0000 255.9922 FORMAT "%8.4" ECU_ADDRESS 0xC000150E /end MEASUREMENT
/begin MEASUREMENT PCR_facLPD_mp "" SWORD Fact1 1 100 -256.0000 255.9922 FORMAT "%8.4" ECU_ADDRESS 0xC00014EC /end MEASUREMENT
/begin MEASUREMENT PCR_facLPI_mp "" SWORD Fact1 1 100 -256.0000 255.9922 FORMAT "%8.4" ECU_ADDRESS 0xC00014EE /end MEASUREMENT
/begin MEASUREMENT PCR_facLPP_mp "" SWORD Fact1 1 100 -256.0000 255.9922 FORMAT "%8.4" ECU_ADDRESS 0xC00014F0 /end MEASUREMENT
/begin MEASUREMENT PCR_facmFlowRawCorr_mp "" SWORD Fact1 1 100 -256.0000 255.9922 FORMAT "%8.4" ECU_ADDRESS 0xC0001510 /end MEASUREMENT
/begin MEASUREMENT PCR_facOfsCalcC1_mp "" SWORD Fact 1 100 -4.000000 3.999878 FORMAT "%8.6" ECU_ADDRESS 0xC000156C /end MEASUREMENT
/begin MEASUREMENT PCR_facOfsCalcC2_mp "" SWORD Fact 1 100 -4.000000 3.999878 FORMAT "%8.6" ECU_ADDRESS 0xC000156E /end MEASUREMENT
/begin MEASUREMENT PCR_facOfsCalcC3_mp "" SWORD Fact 1 100 -4.000000 3.999878 FORMAT "%8.6" ECU_ADDRESS 0xC0001570 /end MEASUREMENT
/begin MEASUREMENT PCR_facOfsCalcC4_mp "" SWORD Fact 1 100 -4.000000 3.999878 FORMAT "%8.6" ECU_ADDRESS 0xC0001572 /end MEASUREMENT
/begin MEASUREMENT PCR_facOfsCalcRx_mp "" SWORD Fact 1 100 -4.000000 3.999878 FORMAT "%8.6" ECU_ADDRESS 0xC0001574 /end MEASUREMENT
/begin MEASUREMENT PCR_facOfsCalcRy_mp "" SWORD Fact 1 100 -4.000000 3.999878 FORMAT "%8.6" ECU_ADDRESS 0xC0001576 /end MEASUREMENT
/begin MEASUREMENT PCR_facPFltLdCtlVal_mp "" SWORD Fact1 1 100 -256.0000 255.9922 FORMAT "%8.4" ECU_ADDRESS 0xC00013F0 /end MEASUREMENT
/begin MEASUREMENT PCR_facP_mp "Adaptionsfaktor für Regler-P-Verstärkung" SWORD Fact1 1 100 -256.0000 255.9922 FORMAT "%8.4" ECU_ADDRESS 0xC0001512 /end MEASUREMENT
/begin MEASUREMENT PCR_facRmpCtlCor_mp "" SWORD CoEOMSwt_S16 1 100 -2.000000 1.999939 FORMAT "%8.6" ECU_ADDRESS 0xC000137E /end MEASUREMENT
/begin MEASUREMENT PCR_facRmpVal "EOM-Rampenwert zur Umschaltung Steuerung/Regelung" SLONG AirSysSwt 1 100 -131.072000000 131.071999939 FORMAT "%13.9" ECU_ADDRESS 0xD0004354 /end MEASUREMENT
/begin MEASUREMENT PCR_facRmpVal2LP_mp "" SLONG AirSysSwt 1 100 -131.072000000 131.071999939 FORMAT "%13.9" ECU_ADDRESS 0xC00014C0 /end MEASUREMENT
/begin MEASUREMENT PCR_facRmpValCtlCorAutLP_mp "" SWORD CoEOMSwt_S16 1 100 -2.000000 1.999939 FORMAT "%8.6" ECU_ADDRESS 0xC00013E8 /end MEASUREMENT
/begin MEASUREMENT PCR_facRmpValCtlCorLP_mp "" SWORD CoEOMSwt_S16 1 100 -2.000000 1.999939 FORMAT "%8.6" ECU_ADDRESS 0xC00013C8 /end MEASUREMENT
/begin MEASUREMENT PCR_facRmpValCtlCorQnt1_mp "" SWORD CoEOMSwt_S16 1 100 -2.000000 1.999939 FORMAT "%8.6" ECU_ADDRESS 0xC0001380 /end MEASUREMENT
/begin MEASUREMENT PCR_facRmpValCtlCor_mp "Korrigierter Zentraler EGT-Rampenwert bei Regenerationsbetrieb für Ladedrucksteuerung" SWORD CoEOMSwt_S16 1 100 -2.000000 1.999939 FORMAT "%8.6" ECU_ADDRESS 0xC00013F2 /end MEASUREMENT
/begin MEASUREMENT PCR_facRmpValDesCorLP_mp "" SWORD CoEOMSwt_S16 1 100 -2.000000 1.999939 FORMAT "%8.6" ECU_ADDRESS 0xC0001458 /end MEASUREMENT
/begin MEASUREMENT PCR_facRmpValDesCor_mp "" SWORD CoEOMSwt_S16 1 100 -2.000000 1.999939 FORMAT "%8.6" ECU_ADDRESS 0xC0001478 /end MEASUREMENT
/begin MEASUREMENT PCR_facRmpValDesLP_mp "" SWORD CoEOMSwt_S16 1 100 -2.000000 1.999939 FORMAT "%8.6" ECU_ADDRESS 0xC000145A /end MEASUREMENT
/begin MEASUREMENT PCR_facRmpValLP "" SLONG AirSysSwt 1 100 -131.072000000 131.071999939 FORMAT "%13.9" ECU_ADDRESS 0xD0004360 /end MEASUREMENT
/begin MEASUREMENT PCR_facRmpVal_mp "" SWORD CoEOMSwt_S16 1 100 -2.000000 1.999939 FORMAT "%8.6" ECU_ADDRESS 0xC0001480 /end MEASUREMENT
/begin MEASUREMENT PCR_facT1LP_mp "" SWORD Fact1 1 100 -256.0000 255.9922 FORMAT "%8.4" ECU_ADDRESS 0xC00014F2 /end MEASUREMENT
/begin MEASUREMENT PCR_facT1_mp "Adaptionsfaktor für Verzögerungszeit des DT1-Gliedes" SWORD Fact1 1 100 -256.0000 255.9922 FORMAT "%8.4" ECU_ADDRESS 0xC0001514 /end MEASUREMENT
/begin MEASUREMENT PCR_facTempDesCorEOMQnt1_mp "" SWORD Fact 1 100 -4.000000 3.999878 FORMAT "%8.6" ECU_ADDRESS 0xC000148C /end MEASUREMENT
/begin MEASUREMENT PCR_facTempDesCorLPEOMQnt1_mp "" SWORD Fact 1 100 -4.000000 3.999878 FORMAT "%8.6" ECU_ADDRESS 0xC0001464 /end MEASUREMENT
/begin MEASUREMENT PCR_facTempDesCorLP_mp "" SWORD Fact 1 100 -4.000000 3.999878 FORMAT "%8.6" ECU_ADDRESS 0xC0001440 /end MEASUREMENT
/begin MEASUREMENT PCR_facTempDesCor_mp "Temperaturabhängiger Korrekturfaktor für die Ladedrucksollwertberechnung" SWORD Fact 1 100 -4.000000 3.999878 FORMAT "%8.6" ECU_ADDRESS 0xC0001418 /end MEASUREMENT
/begin MEASUREMENT PCR_GovOffLP_mp "" SWORD InjMass 1 100 -327.6800 327.6700 FORMAT "%8.4" ECU_ADDRESS 0xC00014E4 /end MEASUREMENT
/begin MEASUREMENT PCR_GovOff_mp "untere Grenze für Einspritzmenge bzw. inneres Drehmoment" SWORD InjMass 1 100 -327.6800 327.6700 FORMAT "%8.4" ECU_ADDRESS 0xC00014FC /end MEASUREMENT
/begin MEASUREMENT PCR_GovOnLP_mp "" SWORD InjMass 1 100 -327.6800 327.6700 FORMAT "%8.4" ECU_ADDRESS 0xC00014E6 /end MEASUREMENT
/begin MEASUREMENT PCR_GovOn_mp "obere Grenze für Einspritzmenge bzw. inneres Drehmoment" SWORD InjMass 1 100 -327.6800 327.6700 FORMAT "%8.4" ECU_ADDRESS 0xC00014FE /end MEASUREMENT
/begin MEASUREMENT PCR_numEOMModeLP_mp "" UWORD OneToOne 1 100 0.00 65535.00 FORMAT "%8.2" ECU_ADDRESS 0xC000154E /end MEASUREMENT
/begin MEASUREMENT PCR_numEOMMode_mp "Index der geforderten Betriebsart" UWORD OneToOne 1 100 0.00 65535.00 FORMAT "%8.2" ECU_ADDRESS 0xC000155C /end MEASUREMENT
/begin MEASUREMENT PCR_pActValLP_mp "" SWORD Pres_hPa 1 100 -32768.00 3500.00 FORMAT "%8.2" ECU_ADDRESS 0xC00014C4 /end MEASUREMENT
/begin MEASUREMENT PCR_pActVal_mp "Ist-Wert des Ladedrucks" SWORD Pres_hPa 1 100 -32768.00 3500.00 FORMAT "%8.2" ECU_ADDRESS 0xC00014A0 /end MEASUREMENT
/begin MEASUREMENT PCR_pAdapPPFltUs_mp "" SWORD Pres_hPa 1 100 -32768.00 3500.00 FORMAT "%8.2" ECU_ADDRESS 0xC0001524 /end MEASUREMENT
/begin MEASUREMENT PCR_pDesBasEOMQnt1_mp "" SWORD Pres_hPa 1 100 -32768.00 3500.00 FORMAT "%8.2" ECU_ADDRESS 0xC000148E /end MEASUREMENT
/begin MEASUREMENT PCR_pDesBasHiAltdEOMQnt1_mp "" SWORD Pres_hPa 1 100 -32768.00 3500.00 FORMAT "%8.2" ECU_ADDRESS 0xC0001490 /end MEASUREMENT
/begin MEASUREMENT PCR_pDesBasHiAltd_mp "Höhenbasiswert des Ladedruckdrucksollwerts" SWORD Pres_hPa 1 100 -32768.00 3500.00 FORMAT "%8.2" ECU_ADDRESS 0xC000141A /end MEASUREMENT
/begin MEASUREMENT PCR_pDesBasLPEOMQnt1_mp "" SWORD Pres_hPa 1 100 -32768.00 3500.00 FORMAT "%8.2" ECU_ADDRESS 0xC0001466 /end MEASUREMENT
/begin MEASUREMENT PCR_pDesBasLPHiAltdEOMQnt1_mp "" SWORD Pres_hPa 1 100 -32768.00 3500.00 FORMAT "%8.2" ECU_ADDRESS 0xC0001468 /end MEASUREMENT
/begin MEASUREMENT PCR_pDesBasLPHiAltd_mp "" SWORD Pres_hPa 1 100 -32768.00 3500.00 FORMAT "%8.2" ECU_ADDRESS 0xC0001442 /end MEASUREMENT
/begin MEASUREMENT PCR_pDesBasLP_mp "" SWORD Pres_hPa 1 100 -32768.00 3500.00 FORMAT "%8.2" ECU_ADDRESS 0xC0001444 /end MEASUREMENT
/begin MEASUREMENT PCR_pDesBas_mp "Basiswert des Ladedruckdrucksollwerts" SWORD Pres_hPa 1 100 -32768.00 3500.00 FORMAT "%8.2" ECU_ADDRESS 0xC000141C /end MEASUREMENT
/begin MEASUREMENT PCR_pDesDyn_mp "dynamischer Anteil des Ladedrucksollwerts" SWORD Pres_hPa 1 100 -32768.00 3500.00 FORMAT "%8.2" ECU_ADDRESS 0xC000141E /end MEASUREMENT
/begin MEASUREMENT PCR_pDesLimVal2_mp "" SWORD Pres_hPa 1 100 -32768.00 3500.00 FORMAT "%8.2" ECU_ADDRESS 0xC0001484 /end MEASUREMENT
/begin MEASUREMENT PCR_pDesLim_mp "begrenzter Ladedrucksollwert" SWORD Pres_hPa 1 100 -32768.00 3500.00 FORMAT "%8.2" ECU_ADDRESS 0xC0001420 /end MEASUREMENT
/begin MEASUREMENT PCR_pDesRaw_mp "unbegrenzter Ladedrucksollwert" SWORD Pres_hPa 1 100 -32768.00 3500.00 FORMAT "%8.2" ECU_ADDRESS 0xC0001422 /end MEASUREMENT
/begin MEASUREMENT PCR_pDesStat "stationärer Ladedrucksollwert" SWORD Pres_hPa 1 100 -32768.00 3500.00 FORMAT "%8.2" ECU_ADDRESS 0xD000739C /end MEASUREMENT
/begin MEASUREMENT PCR_pDesStatLP_mp "" SWORD Pres_hPa 1 100 -32768.00 3500.00 FORMAT "%8.2" ECU_ADDRESS 0xC0001446 /end MEASUREMENT
/begin MEASUREMENT PCR_pDesStatVal1Cor_mp "korrigierter stationärer Ladedruck-Sollwert" SWORD Pres_hPa 1 100 -32768.00 3500.00 FORMAT "%8.2" ECU_ADDRESS 0xC0001424 /end MEASUREMENT
/begin MEASUREMENT PCR_pDesVal "Ladedrucksollwert" SWORD Pres_hPa 1 100 -32768.00 3500.00 FORMAT "%8.2" ECU_ADDRESS 0xD00073A2 /end MEASUREMENT
/begin MEASUREMENT PCR_pDesVal1EOMQnt1_mp "" SWORD Pres_hPa 1 100 -32768.00 3500.00 FORMAT "%8.2" ECU_ADDRESS 0xC0001492 /end MEASUREMENT
/begin MEASUREMENT PCR_pDesVal1LPEOMQnt1_mp "" SWORD Pres_hPa 1 100 -32768.00 3500.00 FORMAT "%8.2" ECU_ADDRESS 0xC000146A /end MEASUREMENT
/begin MEASUREMENT PCR_pDesVal1LP_mp "" SWORD Pres_hPa 1 100 -32768.00 3500.00 FORMAT "%8.2" ECU_ADDRESS 0xC0001448 /end MEASUREMENT
/begin MEASUREMENT PCR_pDesVal1_mp "Atmosphärendruck abhängiger Korrektur des Ladedrucksollwerts" SWORD Pres_hPa 1 100 -32768.00 3500.00 FORMAT "%8.2" ECU_ADDRESS 0xC0001426 /end MEASUREMENT
/begin MEASUREMENT PCR_pDesVal2Cor_mp "Korrigierter Stationärer Ladedrucksollwert nach Temperaturkorrektur" SWORD Pres_hPa 1 100 -32768.00 3500.00 FORMAT "%8.2" ECU_ADDRESS 0xC0001428 /end MEASUREMENT
/begin MEASUREMENT PCR_pDesVal2EOMQnt1_mp "" SWORD Pres_hPa 1 100 -32768.00 3500.00 FORMAT "%8.2" ECU_ADDRESS 0xC0001494 /end MEASUREMENT
/begin MEASUREMENT PCR_pDesVal2LPEOMQnt1_mp "" SWORD Pres_hPa 1 100 -32768.00 3500.00 FORMAT "%8.2" ECU_ADDRESS 0xC000146C /end MEASUREMENT
/begin MEASUREMENT PCR_pDesVal2LP_mp "" SWORD Pres_hPa 1 100 -32768.00 3500.00 FORMAT "%8.2" ECU_ADDRESS 0xC000144A /end MEASUREMENT
/begin MEASUREMENT PCR_pDesVal2_mp "Stationärer Ladedrucksollwert nach Temperaturkorrektur" SWORD Pres_hPa 1 100 -32768.00 3500.00 FORMAT "%8.2" ECU_ADDRESS 0xC000142A /end MEASUREMENT
/begin MEASUREMENT PCR_pDesVal3EOMQnt1_mp "" SWORD Pres_hPa 1 100 -32768.00 3500.00 FORMAT "%8.2" ECU_ADDRESS 0xC0001496 /end MEASUREMENT
/begin MEASUREMENT PCR_pDesVal3LPEOMQnt1_mp "" SWORD Pres_hPa 1 100 -32768.00 3500.00 FORMAT "%8.2" ECU_ADDRESS 0xC000146E /end MEASUREMENT
/begin MEASUREMENT PCR_pDesVal3_mp "Stationärer Ladedrucksollwert mit Lufttemperaturkorrektur" SWORD Pres_hPa 1 100 -32768.00 3500.00 FORMAT "%8.2" ECU_ADDRESS 0xC000142C /end MEASUREMENT
/begin MEASUREMENT PCR_pDesValLP "" SWORD Pres_hPa 1 100 -32768.00 3500.00 FORMAT "%8.2" ECU_ADDRESS 0xD00073A8 /end MEASUREMENT
/begin MEASUREMENT PCR_pDesValNrmLP_mp "" SWORD Pres_hPa 1 100 -32768.00 3500.00 FORMAT "%8.2" ECU_ADDRESS 0xC000144C /end MEASUREMENT
/begin MEASUREMENT PCR_pDesValNrm_mp "Stationärer Ladedrucksollwert im Normalbetreib" SWORD Pres_hPa 1 100 -32768.00 3500.00 FORMAT "%8.2" ECU_ADDRESS 0xC000142E /end MEASUREMENT
/begin MEASUREMENT PCR_pGovDvt "Regelabweichung des Ladedruckreglers" SWORD Pres_hPa 1 100 -32768.00 3500.00 FORMAT "%8.2" ECU_ADDRESS 0xD00073AE /end MEASUREMENT
/begin MEASUREMENT PCR_pGovDvtI_mp "Regelabweichung für I-Anteil des Ladedruckreglers" SWORD Pres_hPa 1 100 -32768.00 3500.00 FORMAT "%8.2" ECU_ADDRESS 0xC00014A2 /end MEASUREMENT
/begin MEASUREMENT PCR_pGovDvtLP "" SWORD Pres_hPa 1 100 -32768.00 3500.00 FORMAT "%8.2" ECU_ADDRESS 0xD00073B4 /end MEASUREMENT
/begin MEASUREMENT PCR_pGovDvtLPI_mp "" SWORD Pres_hPa 1 100 -32768.00 3500.00 FORMAT "%8.2" ECU_ADDRESS 0xC00014C6 /end MEASUREMENT
/begin MEASUREMENT PCR_pMaxDesValLP_mp "" SWORD Pres_hPa 1 100 -32768.00 3500.00 FORMAT "%8.2" ECU_ADDRESS 0xC000144E /end MEASUREMENT
/begin MEASUREMENT PCR_pMaxDesVal_mp "Obere Grenze des Ladedrucksollwerts" SWORD Pres_hPa 1 100 -32768.00 3500.00 FORMAT "%8.2" ECU_ADDRESS 0xC0001430 /end MEASUREMENT
/begin MEASUREMENT PCR_pMaxDvtLP_mp "" SWORD Pres_hPa 1 100 -32768.00 3500.00 FORMAT "%8.2" ECU_ADDRESS 0xC0001544 /end MEASUREMENT
/begin MEASUREMENT PCR_pMaxDvt_mp "Obergrenze zur Erkennung einer bleibenden Regelabweichung" SWORD Pres_hPa 1 100 -32768.00 3500.00 FORMAT "%8.2" ECU_ADDRESS 0xC0001530 /end MEASUREMENT
/begin MEASUREMENT PCR_pMinDvtLP_mp "" SWORD Pres_hPa 1 100 -32768.00 3500.00 FORMAT "%8.2" ECU_ADDRESS 0xC0001546 /end MEASUREMENT
/begin MEASUREMENT PCR_pMinDvt_mp "Untergrenze zur Erkennung einer bleibenden Regelabweichung" SWORD Pres_hPa 1 100 -32768.00 3500.00 FORMAT "%8.2" ECU_ADDRESS 0xC0001532 /end MEASUREMENT
/begin MEASUREMENT PCR_pTempCorBasEOMQnt1_mp "" SWORD Pres_hPa 1 100 -32768.00 3500.00 FORMAT "%8.2" ECU_ADDRESS 0xC0001498 /end MEASUREMENT
/begin MEASUREMENT PCR_pTempCorBasLPEOMQnt1_mp "" SWORD Pres_hPa 1 100 -32768.00 3500.00 FORMAT "%8.2" ECU_ADDRESS 0xC0001470 /end MEASUREMENT
/begin MEASUREMENT PCR_pTempCorBasLP_mp "" SWORD Pres_hPa 1 100 -32768.00 3500.00 FORMAT "%8.2" ECU_ADDRESS 0xC0001450 /end MEASUREMENT
/begin MEASUREMENT PCR_pTempCorBas_mp "Basiswert für Sollwertberechnung der Ladedruckregelung" SWORD Pres_hPa 1 100 -32768.00 3500.00 FORMAT "%8.2" ECU_ADDRESS 0xC0001432 /end MEASUREMENT
/begin MEASUREMENT PCR_pTempCorEOMQnt1_mp "" SWORD Pres_hPa 1 100 -32768.00 3500.00 FORMAT "%8.2" ECU_ADDRESS 0xC000149A /end MEASUREMENT
/begin MEASUREMENT PCR_pTempCorLPEOMQnt1_mp "" SWORD Pres_hPa 1 100 -32768.00 3500.00 FORMAT "%8.2" ECU_ADDRESS 0xC0001472 /end MEASUREMENT
/begin MEASUREMENT PCR_pTempCorLP_mp "" SWORD Pres_hPa 1 100 -32768.00 3500.00 FORMAT "%8.2" ECU_ADDRESS 0xC0001452 /end MEASUREMENT
/begin MEASUREMENT PCR_pTempCor_mp "Temperaturkorrekturwert für Sollwertberechnung der Ladedruckregelung" SWORD Pres_hPa 1 100 -32768.00 3500.00 FORMAT "%8.2" ECU_ADDRESS 0xC0001434 /end MEASUREMENT
/begin MEASUREMENT PCR_qCByVlvClose_mp "" SWORD InjMass 1 100 -327.6800 327.6700 FORMAT "%8.4" ECU_ADDRESS 0xC000136C /end MEASUREMENT
/begin MEASUREMENT PCR_qCByVlvOpn_mp "" SWORD InjMass 1 100 -327.6800 327.6700 FORMAT "%8.4" ECU_ADDRESS 0xC000136E /end MEASUREMENT
/begin MEASUREMENT PCR_qCtlVal "Einspritzmenge für die Steuerung der Ladedruckregelung" SWORD InjMass 1 100 -327.6800 327.6700 FORMAT "%8.4" ECU_ADDRESS 0xD00073BA /end MEASUREMENT
/begin MEASUREMENT PCR_qCtlValInlAutLP_mp "" SWORD InjMass 1 100 -327.6800 327.6700 FORMAT "%8.4" ECU_ADDRESS 0xC00013DE /end MEASUREMENT
/begin MEASUREMENT PCR_qCtlValInlLP_mp "" SWORD InjMass 1 100 -327.6800 327.6700 FORMAT "%8.4" ECU_ADDRESS 0xC00013D2 /end MEASUREMENT
/begin MEASUREMENT PCR_qCtlValInl_mp "Einspritzmenge für die Steuerung der Ladedruckregelung" SWORD InjMass 1 100 -327.6800 327.6700 FORMAT "%8.4" ECU_ADDRESS 0xC0001402 /end MEASUREMENT
/begin MEASUREMENT PCR_qCtlValLP_mp "" SWORD InjMass 1 100 -327.6800 327.6700 FORMAT "%8.4" ECU_ADDRESS 0xC00013AA /end MEASUREMENT
/begin MEASUREMENT PCR_qCtlVal_mp "Einspritzmenge für die Steuerung der Ladedruckregelung" SWORD InjMass 1 100 -327.6800 327.6700 FORMAT "%8.4" ECU_ADDRESS 0xC0001382 /end MEASUREMENT
/begin MEASUREMENT PCR_qDesVal "Einspritzmenge für die Sollwertbildung der Ladedruckregelung" SWORD InjMass 1 100 -327.6800 327.6700 FORMAT "%8.4" ECU_ADDRESS 0xD00073C0 /end MEASUREMENT
/begin MEASUREMENT PCR_qDesValInlLP_mp "" SWORD InjMass 1 100 -327.6800 327.6700 FORMAT "%8.4" ECU_ADDRESS 0xC0001474 /end MEASUREMENT
/begin MEASUREMENT PCR_qDesValInl_mp "" SWORD InjMass 1 100 -327.6800 327.6700 FORMAT "%8.4" ECU_ADDRESS 0xC000149C /end MEASUREMENT
/begin MEASUREMENT PCR_qDesValLP_mp "" SWORD InjMass 1 100 -327.6800 327.6700 FORMAT "%8.4" ECU_ADDRESS 0xC0001454 /end MEASUREMENT
/begin MEASUREMENT PCR_qDesVal_mp "Einspritzmenge für die Sollwertbildung der Ladedruckregelung" SWORD InjMass 1 100 -327.6800 327.6700 FORMAT "%8.4" ECU_ADDRESS 0xC0001436 /end MEASUREMENT
/begin MEASUREMENT PCR_qGov "Einspritzmenge für die Ladedruckregelung" SWORD InjMass 1 100 -327.6800 327.6700 FORMAT "%8.4" ECU_ADDRESS 0xD00073C6 /end MEASUREMENT
/begin MEASUREMENT PCR_qGovLP_mp "" SWORD InjMass 1 100 -327.6800 327.6700 FORMAT "%8.4" ECU_ADDRESS 0xC00014E2 /end MEASUREMENT
/begin MEASUREMENT PCR_qGov_mp "Einspritzmenge für die Ladedruckregelung" SWORD InjMass 1 100 -327.6800 327.6700 FORMAT "%8.4" ECU_ADDRESS 0xC00014BC /end MEASUREMENT
/begin MEASUREMENT PCR_qMon "Einspritzmenge für die Überwachung der Ladedruckregelung" SWORD InjMass 1 100 -327.6800 327.6700 FORMAT "%8.4" ECU_ADDRESS 0xD00073CC /end MEASUREMENT
/begin MEASUREMENT PCR_qMonLP_mp "" SWORD InjMass 1 100 -327.6800 327.6700 FORMAT "%8.4" ECU_ADDRESS 0xC000155A /end MEASUREMENT
/begin MEASUREMENT PCR_qMon_mp "Einspritzmenge für die Überwachung der Ladedruckregelung" SWORD InjMass 1 100 -327.6800 327.6700 FORMAT "%8.4" ECU_ADDRESS 0xC000156A /end MEASUREMENT
/begin MEASUREMENT PCR_rAirTempCtlCorBas_mp "" SWORD Prc 1 100 -400.0000 399.9878 FORMAT "%8.4" ECU_ADDRESS 0xC0001410 /end MEASUREMENT
/begin MEASUREMENT PCR_rAirTempCtlCorEOMBas_mp "mp lufttemperaturabhängige Korrektur Vorsteuerung Lastpunkt Betriebsart Rgn" SWORD Prc 1 100 -400.0000 399.9878 FORMAT "%8.4" ECU_ADDRESS 0xC0001384 /end MEASUREMENT
/begin MEASUREMENT PCR_rAirTempCtlCorEOM_mp "mp lufttemperaturabhängige Korrektur Vorsteuerung Betriebsart Rgn" SWORD Prc 1 100 -400.0000 399.9878 FORMAT "%8.4" ECU_ADDRESS 0xC0001386 /end MEASUREMENT
/begin MEASUREMENT PCR_rAirTempCtlCor_mp "" SWORD Prc 1 100 -400.0000 399.9878 FORMAT "%8.4" ECU_ADDRESS 0xC0001412 /end MEASUREMENT
/begin MEASUREMENT PCR_rCtlBasAutLPEOMQnt1_mp "" SWORD Prc 1 100 -400.0000 399.9878 FORMAT "%8.4" ECU_ADDRESS 0xC00013E0 /end MEASUREMENT
/begin MEASUREMENT PCR_rCtlBasAutLPHiAltdEOMQnt1_mp "" SWORD Prc 1 100 -400.0000 399.9878 FORMAT "%8.4" ECU_ADDRESS 0xC00013E2 /end MEASUREMENT
/begin MEASUREMENT PCR_rCtlBasAutLPHiAltd_mp "" SWORD Prc 1 100 -400.0000 399.9878 FORMAT "%8.4" ECU_ADDRESS 0xC00013AC /end MEASUREMENT
/begin MEASUREMENT PCR_rCtlBasAutLP_mp "" SWORD Prc 1 100 -400.0000 399.9878 FORMAT "%8.4" ECU_ADDRESS 0xC00013AE /end MEASUREMENT
/begin MEASUREMENT PCR_rCtlBasEOMQnt1_mp "Basiswert für den Ladedruck-Steueranteil für die erste auf Einspritzmenge basierte Betriebsart" SWORD Prc 1 100 -400.0000 399.9878 FORMAT "%8.4" ECU_ADDRESS 0xC0001404 /end MEASUREMENT
/begin MEASUREMENT PCR_rCtlBasHiAltdEOMQnt1_mp "Höhenbasiswert des Ladedruck-Steueranteils für die erste auf Einspritzmenge basierte Betriebsart" SWORD Prc 1 100 -400.0000 399.9878 FORMAT "%8.4" ECU_ADDRESS 0xC0001406 /end MEASUREMENT
/begin MEASUREMENT PCR_rCtlBasHiAltd_mp "Höhenbasiswert des Ladedruck-Steueranteils" SWORD Prc 1 100 -400.0000 399.9878 FORMAT "%8.4" ECU_ADDRESS 0xC0001388 /end MEASUREMENT
/begin MEASUREMENT PCR_rCtlBasLPEOMQnt1_mp "" SWORD Prc 1 100 -400.0000 399.9878 FORMAT "%8.4" ECU_ADDRESS 0xC00013D4 /end MEASUREMENT
/begin MEASUREMENT PCR_rCtlBasLPHiAltdEOMQnt1_mp "" SWORD Prc 1 100 -400.0000 399.9878 FORMAT "%8.4" ECU_ADDRESS 0xC00013D6 /end MEASUREMENT
/begin MEASUREMENT PCR_rCtlBasLPHiAltd_mp "" SWORD Prc 1 100 -400.0000 399.9878 FORMAT "%8.4" ECU_ADDRESS 0xC00013B0 /end MEASUREMENT
/begin MEASUREMENT PCR_rCtlBasLP_mp "" SWORD Prc 1 100 -400.0000 399.9878 FORMAT "%8.4" ECU_ADDRESS 0xC00013B2 /end MEASUREMENT
/begin MEASUREMENT PCR_rCtlBas_mp "Basiswert für den Ladedruck-Steueranteil" SWORD Prc 1 100 -400.0000 399.9878 FORMAT "%8.4" ECU_ADDRESS 0xC000138A /end MEASUREMENT
/begin MEASUREMENT PCR_rCtlCor_mp "Korrigiertes Steuertastverhältnis" SWORD Prc 1 100 -400.0000 399.9878 FORMAT "%8.4" ECU_ADDRESS 0xC000138C /end MEASUREMENT
/begin MEASUREMENT PCR_rCtlPFltLdCor_mp "" SWORD Prc 1 100 -400.0000 399.9878 FORMAT "%8.4" ECU_ADDRESS 0xC00013F4 /end MEASUREMENT
/begin MEASUREMENT PCR_rCtlVal "Ladedruck-Steueranteil" SWORD Prc 1 100 -400.0000 399.9878 FORMAT "%8.4" ECU_ADDRESS 0xD00073D2 /end MEASUREMENT
/begin MEASUREMENT PCR_rCtlVal1AutLPEOMQnt1_mp "" SWORD Prc 1 100 -400.0000 399.9878 FORMAT "%8.4" ECU_ADDRESS 0xC00013E4 /end MEASUREMENT
/begin MEASUREMENT PCR_rCtlVal1AutLP_mp "" SWORD Prc 1 100 -400.0000 399.9878 FORMAT "%8.4" ECU_ADDRESS 0xC00013B4 /end MEASUREMENT
/begin MEASUREMENT PCR_rCtlVal1Cor_mp "Korrektur nach der Atmosphärendruck abhängiger Korrektur des Ladedruck-Steueranteil" SWORD Prc 1 100 -400.0000 399.9878 FORMAT "%8.4" ECU_ADDRESS 0xC000138E /end MEASUREMENT
/begin MEASUREMENT PCR_rCtlVal1EOMQnt1_mp "Atmosphärendruck abhängige Korrektur des Ladedruck-Steueranteil für die erste auf Einspritzmenge basierte Betriebsart" SWORD Prc 1 100 -400.0000 399.9878 FORMAT "%8.4" ECU_ADDRESS 0xC0001408 /end MEASUREMENT
/begin MEASUREMENT PCR_rCtlVal1LPEOMQnt1_mp "" SWORD Prc 1 100 -400.0000 399.9878 FORMAT "%8.4" ECU_ADDRESS 0xC00013D8 /end MEASUREMENT
/begin MEASUREMENT PCR_rCtlVal1LP_mp "" SWORD Prc 1 100 -400.0000 399.9878 FORMAT "%8.4" ECU_ADDRESS 0xC00013B6 /end MEASUREMENT
/begin MEASUREMENT PCR_rCtlVal1_mp "Atmosphärendruck abhängiger Korrektur des Ladedruck-Steueranteil" SWORD Prc 1 100 -400.0000 399.9878 FORMAT "%8.4" ECU_ADDRESS 0xC0001390 /end MEASUREMENT
/begin MEASUREMENT PCR_rCtlVal2AutLP_mp "" SWORD Prc 1 100 -400.0000 399.9878 FORMAT "%8.4" ECU_ADDRESS 0xC00013B8 /end MEASUREMENT
/begin MEASUREMENT PCR_rCtlVal2EOM_mp "" SWORD Prc 1 100 -400.0000 399.9878 FORMAT "%8.4" ARRAY_SIZE 1 ECU_ADDRESS 0xC000140A /end MEASUREMENT
/begin MEASUREMENT PCR_rCtlVal2LP_mp "" SWORD Prc 1 100 -400.0000 399.9878 FORMAT "%8.4" ECU_ADDRESS 0xC00013BA /end MEASUREMENT
/begin MEASUREMENT PCR_rCtlVal2_mp "Ladedruck-Steueranteil nach der Motortemperaturkorrektur" SWORD Prc 1 100 -400.0000 399.9878 FORMAT "%8.4" ECU_ADDRESS 0xC0001392 /end MEASUREMENT
/begin MEASUREMENT PCR_rCtlVal3_mp "" SWORD Prc 1 100 -400.0000 399.9878 FORMAT "%8.4" ECU_ADDRESS 0xC00013F6 /end MEASUREMENT
/begin MEASUREMENT PCR_rCtlValAutLP "" SWORD Prc 1 100 -400.0000 399.9878 FORMAT "%8.4" ECU_ADDRESS 0xD00073D4 /end MEASUREMENT
/begin MEASUREMENT PCR_rCtlValCorrChrgPmp_mp "" SWORD Prc 1 100 -400.0000 399.9878 FORMAT "%8.4" ECU_ADDRESS 0xC00014F8 /end MEASUREMENT
/begin MEASUREMENT PCR_rCtlValCorr_mp "" SWORD Prc 1 100 -400.0000 399.9878 FORMAT "%8.4" ECU_ADDRESS 0xC00014FA /end MEASUREMENT
/begin MEASUREMENT PCR_rCtlValCor_mp "korrigierter Ladedruck-Steueranteil der Stellgrösse" SWORD Prc 1 100 -400.0000 399.9878 FORMAT "%8.4" ECU_ADDRESS 0xC00014A4 /end MEASUREMENT
/begin MEASUREMENT PCR_rCtlValLP "" SWORD Prc 1 100 -400.0000 399.9878 FORMAT "%8.4" ECU_ADDRESS 0xD00073DE /end MEASUREMENT
/begin MEASUREMENT PCR_rCtlValNrmAutLP_mp "" SWORD Prc 1 100 -400.0000 399.9878 FORMAT "%8.4" ECU_ADDRESS 0xC00013BC /end MEASUREMENT
/begin MEASUREMENT PCR_rCtlValNrmLP_mp "" SWORD Prc 1 100 -400.0000 399.9878 FORMAT "%8.4" ECU_ADDRESS 0xC00013BE /end MEASUREMENT
/begin MEASUREMENT PCR_rCtlValNrm_mp "Steuertastverhältnis im Normalbetrieb" SWORD Prc 1 100 -400.0000 399.9878 FORMAT "%8.4" ECU_ADDRESS 0xC0001394 /end MEASUREMENT
/begin MEASUREMENT PCR_rCtlValOfs "TV adaptive Vorsteuerung Ladedruck" SWORD Prc 1 100 -400.0000 399.9878 FORMAT "%8.4" ECU_ADDRESS 0xD00073E4 /end MEASUREMENT
/begin MEASUREMENT PCR_rCtlValOfsLim_mp "" SWORD Prc 1 100 -400.0000 399.9878 FORMAT "%8.4" ECU_ADDRESS 0xC0001578 /end MEASUREMENT
/begin MEASUREMENT PCR_rCtlValOfsUnLim_mp "" SWORD Prc 1 100 -400.0000 399.9878 FORMAT "%8.4" ECU_ADDRESS 0xC000157A /end MEASUREMENT
/begin MEASUREMENT PCR_rCtlValPFltLd_mp "" SWORD Prc 1 100 -400.0000 399.9878 FORMAT "%8.4" ECU_ADDRESS 0xC00013F8 /end MEASUREMENT
/begin MEASUREMENT PCR_rEngTempCorAutLP_mp "" SWORD Prc 1 100 -400.0000 399.9878 FORMAT "%8.4" ECU_ADDRESS 0xC00013C0 /end MEASUREMENT
/begin MEASUREMENT PCR_rEngTempCorBasAutLP_mp "" SWORD Prc 1 100 -400.0000 399.9878 FORMAT "%8.4" ECU_ADDRESS 0xC00013C2 /end MEASUREMENT
/begin MEASUREMENT PCR_rEngTempCorBasLP_mp "" SWORD Prc 1 100 -400.0000 399.9878 FORMAT "%8.4" ECU_ADDRESS 0xC00013C4 /end MEASUREMENT
/begin MEASUREMENT PCR_rEngTempCorBas_mp "Basiswert der Motortemperaturkorrektur des Ladedruck-Steueranteils" SWORD Prc 1 100 -400.0000 399.9878 FORMAT "%8.4" ECU_ADDRESS 0xC0001396 /end MEASUREMENT
/begin MEASUREMENT PCR_rEngTempCorLP_mp "" SWORD Prc 1 100 -400.0000 399.9878 FORMAT "%8.4" ECU_ADDRESS 0xC00013C6 /end MEASUREMENT
/begin MEASUREMENT PCR_rEngTempCor_mp "Motortemperaturabhängiger Korrekturwert für den Ladedruck-Steueranteil" SWORD Prc 1 100 -400.0000 399.9878 FORMAT "%8.4" ECU_ADDRESS 0xC0001398 /end MEASUREMENT
/begin MEASUREMENT PCR_resFlwUnCor_mp "" SWORD Res_hPaHrPerCM 1 100 -3.276800 3.276700 FORMAT "%8.6" ECU_ADDRESS 0xC000139A /end MEASUREMENT
/begin MEASUREMENT PCR_rGov "Reglerstellgröße des Ladedruckreglers" SWORD Prc 1 100 -400.0000 399.9878 FORMAT "%8.4" ECU_ADDRESS 0xD00073E6 /end MEASUREMENT
/begin MEASUREMENT PCR_rGovLP "" SWORD Prc 1 100 -400.0000 399.9878 FORMAT "%8.4" ECU_ADDRESS 0xD00073EC /end MEASUREMENT
/begin MEASUREMENT PCR_rGovLPMaxCor_mp "" SWORD Prc 1 100 -400.0000 399.9878 FORMAT "%8.4" ECU_ADDRESS 0xC00014C8 /end MEASUREMENT
/begin MEASUREMENT PCR_rGovLPMaxNrm_mp "" SWORD Prc 1 100 -400.0000 399.9878 FORMAT "%8.4" ECU_ADDRESS 0xC00014CA /end MEASUREMENT
/begin MEASUREMENT PCR_rGovLPMax_mp "" SWORD Prc 1 100 -400.0000 399.9878 FORMAT "%8.4" ECU_ADDRESS 0xC00014CC /end MEASUREMENT
/begin MEASUREMENT PCR_rGovLPMinCor_mp "" SWORD Prc 1 100 -400.0000 399.9878 FORMAT "%8.4" ECU_ADDRESS 0xC00014CE /end MEASUREMENT
/begin MEASUREMENT PCR_rGovLPMinNrm_mp "" SWORD Prc 1 100 -400.0000 399.9878 FORMAT "%8.4" ECU_ADDRESS 0xC00014D0 /end MEASUREMENT
/begin MEASUREMENT PCR_rGovLPMin_mp "" SWORD Prc 1 100 -400.0000 399.9878 FORMAT "%8.4" ECU_ADDRESS 0xC00014D2 /end MEASUREMENT
/begin MEASUREMENT PCR_rGovLPOut_mp "" SWORD Prc 1 100 -400.0000 399.9878 FORMAT "%8.4" ECU_ADDRESS 0xC00014D4 /end MEASUREMENT
/begin MEASUREMENT PCR_rGovMax1_mp "" SWORD Prc 1 100 -400.0000 399.9878 FORMAT "%8.4" ECU_ADDRESS 0xC0001516 /end MEASUREMENT
/begin MEASUREMENT PCR_rGovMax2_mp "" SWORD Prc 1 100 -400.0000 399.9878 FORMAT "%8.4" ECU_ADDRESS 0xC0001518 /end MEASUREMENT
/begin MEASUREMENT PCR_rGovMaxCor "" SWORD Prc 1 100 -400.0000 399.9878 FORMAT "%8.4" ECU_ADDRESS 0xD00073F2 /end MEASUREMENT
/begin MEASUREMENT PCR_rGovMaxDynRamp_mp "" SWORD Prc 1 100 -400.0000 399.9878 FORMAT "%8.4" ECU_ADDRESS 0xC000151A /end MEASUREMENT
/begin MEASUREMENT PCR_rGovMaxDyn_mp "" SWORD Prc 1 100 -400.0000 399.9878 FORMAT "%8.4" ECU_ADDRESS 0xC000151C /end MEASUREMENT
/begin MEASUREMENT PCR_rGovMaxNrm_mp "Maximal zulässige Reglerstellgröße für den Ladedruck im Normalbetrieb" SWORD Prc 1 100 -400.0000 399.9878 FORMAT "%8.4" ECU_ADDRESS 0xC00014A6 /end MEASUREMENT
/begin MEASUREMENT PCR_rGovMaxVal1_mp "" SWORD Prc 1 100 -400.0000 399.9878 FORMAT "%8.4" ECU_ADDRESS 0xC000151E /end MEASUREMENT
/begin MEASUREMENT PCR_rGovMaxVal2_mp "" SWORD Prc 1 100 -400.0000 399.9878 FORMAT "%8.4" ECU_ADDRESS 0xC0001520 /end MEASUREMENT
/begin MEASUREMENT PCR_rGovMax_mp "Obergrenze der Reglerstellgröße des Ladedrucks" SWORD Prc 1 100 -400.0000 399.9878 FORMAT "%8.4" ECU_ADDRESS 0xC00014A8 /end MEASUREMENT
/begin MEASUREMENT PCR_rGovMinCor "" SWORD Prc 1 100 -400.0000 399.9878 FORMAT "%8.4" ECU_ADDRESS 0xD00073F8 /end MEASUREMENT
/begin MEASUREMENT PCR_rGovMinNrm_mp "Minimal zulässige Reglerstellgröße für den Ladedruck im Normalbetrieb" SWORD Prc 1 100 -400.0000 399.9878 FORMAT "%8.4" ECU_ADDRESS 0xC00014AA /end MEASUREMENT
/begin MEASUREMENT PCR_rGovMin_mp "Korrigierte Untergrenze der Reglerstellgröße des Ladedrucks" SWORD Prc 1 100 -400.0000 399.9878 FORMAT "%8.4" ECU_ADDRESS 0xC00014AC /end MEASUREMENT
/begin MEASUREMENT PCR_rGovOutLPUnLim_mp "" SWORD Prc 1 100 -400.0000 399.9878 FORMAT "%8.4" ECU_ADDRESS 0xC00014D6 /end MEASUREMENT
/begin MEASUREMENT PCR_rGovOutUnLim "" SWORD Prc 1 100 -400.0000 399.9878 FORMAT "%8.4" ECU_ADDRESS 0xD00073FE /end MEASUREMENT
/begin MEASUREMENT PCR_rGovOut_mp "Begrenzter Regelausgang des Ladedruckreglers" SWORD Prc 1 100 -400.0000 399.9878 FORMAT "%8.4" ECU_ADDRESS 0xC00014AE /end MEASUREMENT
/begin MEASUREMENT PCR_rOfsRlsMax_mp "" SWORD Prc 1 100 -400.0000 399.9878 FORMAT "%8.4" ECU_ADDRESS 0xC000157C /end MEASUREMENT
/begin MEASUREMENT PCR_rOfsRlsMin_mp "" SWORD Prc 1 100 -400.0000 399.9878 FORMAT "%8.4" ECU_ADDRESS 0xC000157E /end MEASUREMENT
/begin MEASUREMENT PCR_rOutDT1_mp "DT1-Anteil des PIDT1 Reglers des Ladedruckreglers" SWORD Prc 1 100 -400.0000 399.9878 FORMAT "%8.4" ECU_ADDRESS 0xC00014B0 /end MEASUREMENT
/begin MEASUREMENT PCR_rOutI "I-Anteil des PIDT1 Reglers des Ladedruckreglers" SWORD Prc 1 100 -400.0000 399.9878 FORMAT "%8.4" ECU_ADDRESS 0xD0007404 /end MEASUREMENT
/begin MEASUREMENT PCR_rOutIMaxLP_mp "" SWORD Prc 1 100 -400.0000 399.9878 FORMAT "%8.4" ECU_ADDRESS 0xC00014F4 /end MEASUREMENT
/begin MEASUREMENT PCR_rOutIMax_mp "" SWORD Prc 1 100 -400.0000 399.9878 FORMAT "%8.4" ECU_ADDRESS 0xC0001526 /end MEASUREMENT
/begin MEASUREMENT PCR_rOutIMinLP_mp "" SWORD Prc 1 100 -400.0000 399.9878 FORMAT "%8.4" ECU_ADDRESS 0xC00014F6 /end MEASUREMENT
/begin MEASUREMENT PCR_rOutIMin_mp "" SWORD Prc 1 100 -400.0000 399.9878 FORMAT "%8.4" ECU_ADDRESS 0xC0001528 /end MEASUREMENT
/begin MEASUREMENT PCR_rOutLPDT1_mp "" SWORD Prc 1 100 -400.0000 399.9878 FORMAT "%8.4" ECU_ADDRESS 0xC00014D8 /end MEASUREMENT
/begin MEASUREMENT PCR_rOutLPI "" SWORD Prc 1 100 -400.0000 399.9878 FORMAT "%8.4" ECU_ADDRESS 0xD000740A /end MEASUREMENT
/begin MEASUREMENT PCR_rOutLPP_mp "" SWORD Prc 1 100 -400.0000 399.9878 FORMAT "%8.4" ECU_ADDRESS 0xC00014DA /end MEASUREMENT
/begin MEASUREMENT PCR_rOutOfsCalcI1_mp "" SWORD Prc 1 100 -400.0000 399.9878 FORMAT "%8.4" ECU_ADDRESS 0xC0001580 /end MEASUREMENT
/begin MEASUREMENT PCR_rOutOfsCalcI2_mp "" SWORD Prc 1 100 -400.0000 399.9878 FORMAT "%8.4" ECU_ADDRESS 0xC0001582 /end MEASUREMENT
/begin MEASUREMENT PCR_rOutOfsCalcI3_mp "" SWORD Prc 1 100 -400.0000 399.9878 FORMAT "%8.4" ECU_ADDRESS 0xC0001584 /end MEASUREMENT
/begin MEASUREMENT PCR_rOutOfsCalcI4_mp "" SWORD Prc 1 100 -400.0000 399.9878 FORMAT "%8.4" ECU_ADDRESS 0xC0001586 /end MEASUREMENT
/begin MEASUREMENT PCR_rOutP_mp "P-Anteil des PIDT1 Reglers des Ladedruckreglers" SWORD Prc 1 100 -400.0000 399.9878 FORMAT "%8.4" ECU_ADDRESS 0xC00014B2 /end MEASUREMENT
/begin MEASUREMENT PCR_rPIDCorLP_mp "" SWORD Prc 1 100 -400.0000 399.9878 FORMAT "%8.4" ECU_ADDRESS 0xC00014DC /end MEASUREMENT
/begin MEASUREMENT PCR_rPIDCor_mp "Korregierter Ausgang des PIDT1-Reglers" SWORD Prc 1 100 -400.0000 399.9878 FORMAT "%8.4" ECU_ADDRESS 0xC00014B4 /end MEASUREMENT
/begin MEASUREMENT PCR_rPIDCtlLP_mp "" SWORD Prc 1 100 -400.0000 399.9878 FORMAT "%8.4" ECU_ADDRESS 0xC00014DE /end MEASUREMENT
/begin MEASUREMENT PCR_rPIDCtl_mp "Summe des Regel- und Steueranteils des Ladedruckreglers" SWORD Prc 1 100 -400.0000 399.9878 FORMAT "%8.4" ECU_ADDRESS 0xC00014B6 /end MEASUREMENT
/begin MEASUREMENT PCR_rPIDLP_mp "" SWORD Prc 1 100 -400.0000 399.9878 FORMAT "%8.4" ECU_ADDRESS 0xC00014E0 /end MEASUREMENT
/begin MEASUREMENT PCR_rPID_mp "unbegrenzte Stellgröße" SWORD Prc 1 100 -400.0000 399.9878 FORMAT "%8.4" ECU_ADDRESS 0xC00014B8 /end MEASUREMENT
/begin MEASUREMENT PCR_stARW "Status des Antiresetwindups der Ladedruckregelung" UBYTE OneToOne 1 100 0.00 255.0 FORMAT "%5.1" ECU_ADDRESS 0xD00090F3 /end MEASUREMENT
/begin MEASUREMENT PCR_stARWLP "" UBYTE OneToOne 1 100 0.00 255.0 FORMAT "%5.1" ECU_ADDRESS 0xD00090F6 /end MEASUREMENT
/begin MEASUREMENT PCR_stBitMskEOMLP_mp "" ULONG OneToOne 1 100 0.00 4294967295.00 FORMAT "%13.2" ECU_ADDRESS 0xC0001550 /end MEASUREMENT
/begin MEASUREMENT PCR_stBitMskEOM_mp "Bitmaske zur Auswahl der relevanten Abschaltfälle für die gewählte Betriebsart" ULONG OneToOne 1 100 0.00 4294967295.00 FORMAT "%13.2" ECU_ADDRESS 0xC0001560 /end MEASUREMENT
/begin MEASUREMENT PCR_stCByVlvActv_mp "" UBYTE OneToOne 1 100 0.00 255.0 FORMAT "%5.1" ECU_ADDRESS 0xC0001370 /end MEASUREMENT
/begin MEASUREMENT PCR_stCByVlvBits_mp "" UBYTE OneToOne 1 100 0.00 255.0 FORMAT "%5.1" ECU_ADDRESS 0xC0001371 /end MEASUREMENT
/begin MEASUREMENT PCR_stCByVlvCtlValBits_mp "" UBYTE OneToOne 1 100 0.00 255.0 FORMAT "%5.1" ECU_ADDRESS 0xC0001372 /end MEASUREMENT
/begin MEASUREMENT PCR_stCByVlvCtlValNrm_mp "" UBYTE OneToOne 1 100 0.00 255.0 FORMAT "%5.1" ECU_ADDRESS 0xC0001373 /end MEASUREMENT
/begin MEASUREMENT PCR_stCByVlvCtlValOpn_mp "" UBYTE OneToOne 1 100 0.00 255.0 FORMAT "%5.1" ECU_ADDRESS 0xC0001374 /end MEASUREMENT
/begin MEASUREMENT PCR_stCByVlvOpn "" UBYTE OneToOne 1 100 0.00 255.0 FORMAT "%5.1" ECU_ADDRESS 0xD00090F9 /end MEASUREMENT
/begin MEASUREMENT PCR_stDebDefLP_mp "Freigabe der Überwachung auf bleibende Regelabweichung(LP)" UBYTE OneToOne 1 100 0.00 255.0 FORMAT "%5.1" ECU_ADDRESS 0xC0001548 /end MEASUREMENT
/begin MEASUREMENT PCR_stDebDef_mp "Freigabe der Überwachung auf bleibende Regelabweichung" UBYTE OneToOne 1 100 0.00 255.0 FORMAT "%5.1" ECU_ADDRESS 0xC0001534 /end MEASUREMENT
/begin MEASUREMENT PCR_stDesLogic_mp "" UBYTE OneToOne 1 100 0.00 255.0 FORMAT "%5.1" ECU_ADDRESS 0xC0001486 /end MEASUREMENT
/begin MEASUREMENT PCR_stDynLimOn_mp "Aktivierung der dynamik Begrenzung" SWORD OneToOne 1 100 -32768.00 32767.00 FORMAT "%8.2" ECU_ADDRESS 0xC00014BA /end MEASUREMENT
/begin MEASUREMENT PCR_stEepOfsCalc_mp "" UBYTE OneToOne 1 100 0.00 255.0 FORMAT "%5.1" ECU_ADDRESS 0xC0001588 /end MEASUREMENT
/begin MEASUREMENT PCR_stEOMCtlValAutLP_mp "" ULONG OneToOne 1 100 0.00 4294967295.00 FORMAT "%13.2" ECU_ADDRESS 0xC00013EC /end MEASUREMENT
/begin MEASUREMENT PCR_stEOMCtlValLP_mp "" ULONG OneToOne 1 100 0.00 4294967295.00 FORMAT "%13.2" ECU_ADDRESS 0xC00013CC /end MEASUREMENT
/begin MEASUREMENT PCR_stEOMCtlVal_mp "Status über den Wechsel in eine andere Betriebsart" ULONG OneToOne 1 100 0.00 4294967295.00 FORMAT "%13.2" ECU_ADDRESS 0xC00013FC /end MEASUREMENT
/begin MEASUREMENT PCR_stEOMDesValLP_mp "" ULONG OneToOne 1 100 0.00 4294967295.00 FORMAT "%13.2" ECU_ADDRESS 0xC000145C /end MEASUREMENT
/begin MEASUREMENT PCR_stEOMDesVal_mp "" ULONG OneToOne 1 100 0.00 4294967295.00 FORMAT "%13.2" ECU_ADDRESS 0xC000147C /end MEASUREMENT
/begin MEASUREMENT PCR_stEOMGovLP_mp "" UWORD OneToOne 1 100 0.00 65535.00 FORMAT "%8.2" ECU_ADDRESS 0xC00014E8 /end MEASUREMENT
/begin MEASUREMENT PCR_stEOMGov_mp "Status des Betriebsartmodus" UWORD OneToOne 1 100 0.00 65535.00 FORMAT "%8.2" ECU_ADDRESS 0xC0001500 /end MEASUREMENT
/begin MEASUREMENT PCR_stGovDvtMonEnaLP_mp "Externe Freigabe der Überwachung auf bleibende Regelabweichung(LP)" UBYTE OneToOne 1 100 0.00 255.0 FORMAT "%5.1" ECU_ADDRESS 0xC0001549 /end MEASUREMENT
/begin MEASUREMENT PCR_stGovDvtMonEna_mp "Externe Freigabe der Überwachung auf bleibende Regelabweichung" UBYTE OneToOne 1 100 0.00 255.0 FORMAT "%5.1" ECU_ADDRESS 0xC0001535 /end MEASUREMENT
/begin MEASUREMENT PCR_stMaxDvtLP_mp "Regelabweichung größer als Obergrenze(LP)" UBYTE OneToOne 1 100 0.00 255.0 FORMAT "%5.1" ECU_ADDRESS 0xC000154A /end MEASUREMENT
/begin MEASUREMENT PCR_stMaxDvt_mp "Regelabweichung größer als Obergrenze" UBYTE OneToOne 1 100 0.00 255.0 FORMAT "%5.1" ECU_ADDRESS 0xC0001536 /end MEASUREMENT
/begin MEASUREMENT PCR_stMinDvtLP_mp "Regelabweichung kleiner als Untergrenze(LP)" UBYTE OneToOne 1 100 0.00 255.0 FORMAT "%5.1" ECU_ADDRESS 0xC000154B /end MEASUREMENT
/begin MEASUREMENT PCR_stMinDvt_mp "Regelabweichung kleiner als Untergrenze" UBYTE OneToOne 1 100 0.00 255.0 FORMAT "%5.1" ECU_ADDRESS 0xC0001537 /end MEASUREMENT
/begin MEASUREMENT PCR_stMon "Aktiver Abschaltfall der Ladedrucküberwachung" UBYTE OneToOne 1 100 0.00 255.0 FORMAT "%5.1" ECU_ADDRESS 0xD00090FA /end MEASUREMENT
/begin MEASUREMENT PCR_stMonBitsLP_mp "Abschaltfälle der Ladedruckregelung nach Maskierung(LP)" ULONG OneToOne 1 100 0.00 4294967295.00 FORMAT "%13.2" ECU_ADDRESS 0xC0001540 /end MEASUREMENT
/begin MEASUREMENT PCR_stMonBits_mp "Abschaltfälle der Ladedruckregelung nach Maskierung" ULONG OneToOne 1 100 0.00 4294967295.00 FORMAT "%13.2" ECU_ADDRESS 0xC000152C /end MEASUREMENT
/begin MEASUREMENT PCR_stMonCByVlv_mp "" UBYTE OneToOne 1 100 0.00 255.0 FORMAT "%5.1" ECU_ADDRESS 0xC0001375 /end MEASUREMENT
/begin MEASUREMENT PCR_stMonLP "Aktiver Abschaltfall der Ladedrucküberwachung(LP)" UBYTE OneToOne 1 100 0.00 255.0 FORMAT "%5.1" ECU_ADDRESS 0xD00090FD /end MEASUREMENT
/begin MEASUREMENT PCR_stNrmOpLP_mp "Normale Betrieb der Ladedruckregelung(LP)" UBYTE OneToOne 1 100 0.00 255.0 FORMAT "%5.1" ECU_ADDRESS 0xC000154C /end MEASUREMENT
/begin MEASUREMENT PCR_stNrmOp_mp "Normale Betrieb der Ladedruckregelung" UBYTE OneToOne 1 100 0.00 255.0 FORMAT "%5.1" ECU_ADDRESS 0xC0001538 /end MEASUREMENT
/begin MEASUREMENT PCR_stOfsCalcEepAccess_mp "Status EEPROM Access für PCR_OfsCalc" UBYTE OneToOne 1 100 0.00 255.0 FORMAT "%5.1" ECU_ADDRESS 0xC0001589 /end MEASUREMENT
/begin MEASUREMENT PCR_stOfsCalcResetInit_mp "Status Reset and Init Lernen PCR_OfsCalc" UBYTE OneToOne 1 100 0.00 255.0 FORMAT "%5.1" ECU_ADDRESS 0xC000158A /end MEASUREMENT
/begin MEASUREMENT PCR_stOfsCalcRlsAdd1_mp "" UWORD OneToOne 1 100 0.00 65535.00 FORMAT "%8.2" ECU_ADDRESS 0xC000158C /end MEASUREMENT
/begin MEASUREMENT PCR_stOfsCalcRlsLearn_mp "" UBYTE OneToOne 1 100 0.00 255.0 FORMAT "%5.1" ECU_ADDRESS 0xC000158E /end MEASUREMENT
/begin MEASUREMENT PCR_stOfsCalcRlsPCRBits_mp "Freigabebedingungen aus PCR_stPCRBits (Maskiert" ULONG OneToOne 1 100 0.00 4294967295.00 FORMAT "%13.2" ECU_ADDRESS 0xC0001590 /end MEASUREMENT
/begin MEASUREMENT PCR_stOfsCalcRlsStat_mp "" UBYTE OneToOne 1 100 0.00 255.0 FORMAT "%5.1" ECU_ADDRESS 0xC0001594 /end MEASUREMENT
/begin MEASUREMENT PCR_stOfsCalcRls_mp "Freigabe des TV aus adaptiver Vorsteuerung" UBYTE OneToOne 1 100 0.00 255.0 FORMAT "%5.1" ECU_ADDRESS 0xC0001595 /end MEASUREMENT
/begin MEASUREMENT PCR_stPCRBits "Abschaltfälle der Ladedruckregelung" ULONG OneToOne 1 100 0.00 4294967295.00 FORMAT "%13.2" ECU_ADDRESS 0xD00045A8 /end MEASUREMENT
/begin MEASUREMENT PCR_stPCRBitsLP "Abschaltfälle der Ladedruckregelung(LP)" ULONG OneToOne 1 100 0.00 4294967295.00 FORMAT "%13.2" ECU_ADDRESS 0xD00045B4 /end MEASUREMENT
/begin MEASUREMENT PCR_stRmpSelCtlCor_mp "" UBYTE OneToOne 1 100 0.00 255.0 FORMAT "%5.1" ECU_ADDRESS 0xC000139C /end MEASUREMENT
/begin MEASUREMENT PCR_stSelBitMskEOMLP_mp "" ULONG OneToOne 1 100 0.00 4294967295.00 FORMAT "%13.2" ECU_ADDRESS 0xC0001554 /end MEASUREMENT
/begin MEASUREMENT PCR_stSelBitMskEOM_mp "selektierte Bitmaske der Abschaltfälle für die gewählte Betriebsart" ULONG OneToOne 1 100 0.00 4294967295.00 FORMAT "%13.2" ECU_ADDRESS 0xC0001564 /end MEASUREMENT
/begin MEASUREMENT PCR_stSwtGovMaxDyn_mp "" UBYTE OneToOne 1 100 0.00 255.0 FORMAT "%5.1" ECU_ADDRESS 0xC0001522 /end MEASUREMENT
/begin MEASUREMENT PCR_stTrans "Status der Transienten-Erkenung" UBYTE OneToOne 1 100 0.00 255.0 FORMAT "%5.1" ECU_ADDRESS 0xD0009100 /end MEASUREMENT
/begin MEASUREMENT PCR_stTransLP "Status der Transienten-Erkenung(LP)" UBYTE OneToOne 1 100 0.00 255.0 FORMAT "%5.1" ECU_ADDRESS 0xD0009103 /end MEASUREMENT
/begin MEASUREMENT PCR_stWrkSphLP_mp "" UBYTE OneToOne 1 100 0.00 255.0 FORMAT "%5.1" ECU_ADDRESS 0xC000154D /end MEASUREMENT
/begin MEASUREMENT PCR_stWrkSph_mp "Aktueller Arbeitsbereich der Ladedruckregelung" UBYTE OneToOne 1 100 0.00 255.0 FORMAT "%5.1" ECU_ADDRESS 0xC0001539 /end MEASUREMENT
/begin MEASUREMENT PCR_swtBstLPActv "" UBYTE OneToOne 1 100 0.00 255.0 FORMAT "%5.1" ECU_ADDRESS 0xD0009106 /end MEASUREMENT
/begin MEASUREMENT PCR_swtGov "Schalter: Regler ein/aus" UBYTE OneToOne 1 100 0.00 255.0 FORMAT "%5.1" ECU_ADDRESS 0xD0009107 /end MEASUREMENT
/begin MEASUREMENT PCR_swtGovLP "" UBYTE OneToOne 1 100 0.00 255.0 FORMAT "%5.1" ECU_ADDRESS 0xD000910A /end MEASUREMENT
/begin MEASUREMENT PCR_swtGovNoDebLP_mp "" UBYTE OneToOne 1 100 0.00 255.0 FORMAT "%5.1" ECU_ADDRESS 0xC00014EA /end MEASUREMENT
/begin MEASUREMENT PCR_swtGovNoDeb_mp "" UBYTE OneToOne 1 100 0.00 255.0 FORMAT "%5.1" ECU_ADDRESS 0xC0001502 /end MEASUREMENT
/begin MEASUREMENT PCR_swtQntCByVlv "" UBYTE OneToOne 1 100 0.00 255.0 FORMAT "%5.1" ECU_ADDRESS 0xD000910D /end MEASUREMENT
/begin MEASUREMENT PCR_swtQntCtl "Schalterwert zur Auswahl der Einspritzmenge für die Steuerung" UBYTE OneToOne 1 100 0.00 255.0 FORMAT "%5.1" ECU_ADDRESS 0xD000910E /end MEASUREMENT
/begin MEASUREMENT PCR_swtQntDes "Schalterwert zur Auswahl der Einspritzmenge für die Sollwertberechnung" UBYTE OneToOne 1 100 0.00 255.0 FORMAT "%5.1" ECU_ADDRESS 0xD000910F /end MEASUREMENT
/begin MEASUREMENT PCR_swtRelAbs "Schalterwert zur Auswahl zwischen Absolut- und Relativdruckregelung" UBYTE OneToOne 1 100 0.00 255.0 FORMAT "%5.1" ECU_ADDRESS 0xD0009110 /end MEASUREMENT
/begin MEASUREMENT PCR_swtRelAbsLP "" UBYTE OneToOne 1 100 0.00 255.0 FORMAT "%5.1" ECU_ADDRESS 0xD0009111 /end MEASUREMENT
/begin MEASUREMENT PCR_swtTempCor "" UBYTE OneToOne 1 100 0.00 255.0 FORMAT "%5.1" ECU_ADDRESS 0xD0009112 /end MEASUREMENT
/begin MEASUREMENT PCR_swtTempCorLP "" UBYTE OneToOne 1 100 0.00 255.0 FORMAT "%5.1" ECU_ADDRESS 0xD0009113 /end MEASUREMENT
/begin MEASUREMENT PCR_swtTrqCtl "Schalterwert zur Auswahl des Drehmoments für die Steuerung" UBYTE OneToOne 1 100 0.00 255.0 FORMAT "%5.1" ECU_ADDRESS 0xD0009114 /end MEASUREMENT
/begin MEASUREMENT PCR_swtTrqDes "Schalterwert zur Auswahl des Drehmoments für die Sollwertberechnung" UBYTE OneToOne 1 100 0.00 255.0 FORMAT "%5.1" ECU_ADDRESS 0xD0009115 /end MEASUREMENT
/begin MEASUREMENT PCR_tAirCtlVal_mp "Ausgewählte Lufttemperatur für die Steuerung der Ladedruckregelung" SWORD Temp_Cels 1 100 -3549.940 3003.560 FORMAT "%8.3" ECU_ADDRESS 0xC00013A0 /end MEASUREMENT
/begin MEASUREMENT PCR_tAirDesValLP "" SWORD Temp_Cels 1 100 -3549.940 3003.560 FORMAT "%8.3" ECU_ADDRESS 0xD0007410 /end MEASUREMENT
/begin MEASUREMENT PCR_tAirDesVal_mp "Ausgewählte Lufttemperatur für die Sollwertbildung der Ladedruckregelung" SWORD Temp_Cels 1 100 -3549.940 3003.560 FORMAT "%8.3" ECU_ADDRESS 0xC000143A /end MEASUREMENT
/begin MEASUREMENT PCR_tAirOfsCalc_mp "LuftTemperatur aus Temperaturfeld für OfsCalc" SWORD Temp_Cels 1 100 -3549.940 3003.560 FORMAT "%8.3" ECU_ADDRESS 0xC0001596 /end MEASUREMENT
/begin MEASUREMENT PCR_tDesValLP_mp "" SWORD Temp_Cels 1 100 -3549.940 3003.560 FORMAT "%8.3" ECU_ADDRESS 0xC0001456 /end MEASUREMENT
/begin MEASUREMENT PCR_tDesVal_mp "ausgewählte Temperatur für die Sollwertbildung der Ladedruckregelung" SWORD Temp_Cels 1 100 -3549.940 3003.560 FORMAT "%8.3" ECU_ADDRESS 0xC000143C /end MEASUREMENT
/begin MEASUREMENT PCR_tEngCtlVal_mp "Ausgewählte Motortemperatur für die Steuerung der Ladedruckregelung" SWORD Temp_Cels 1 100 -3549.940 3003.560 FORMAT "%8.3" ECU_ADDRESS 0xC000139E /end MEASUREMENT
/begin MEASUREMENT PCR_tEngDesValLP "" SWORD Temp_Cels 1 100 -3549.940 3003.560 FORMAT "%8.3" ECU_ADDRESS 0xD0007412 /end MEASUREMENT
/begin MEASUREMENT PCR_tEngDesVal_mp "Ausgewählte Motortemperatur für die Sollwertbildung der Ladedruckregelung" SWORD Temp_Cels 1 100 -3549.940 3003.560 FORMAT "%8.3" ECU_ADDRESS 0xC0001438 /end MEASUREMENT
/begin MEASUREMENT PCR_tEngMon_mp "Für die Überwachung ausgewählte Temperatur aus dem Motortemperaturfeld" SWORD Temp_Cels 1 100 -3549.940 3003.560 FORMAT "%8.3" ECU_ADDRESS 0xC000153A /end MEASUREMENT
/begin MEASUREMENT PCR_tEngOfsCalc_mp "Temperatur aus dem Motortemperaturfeld für OfsCalc" SWORD Temp_Cels 1 100 -3549.940 3003.560 FORMAT "%8.3" ECU_ADDRESS 0xC0001598 /end MEASUREMENT
/begin MEASUREMENT PCR_tiMonEOM_mp "Zeitverzögerung bei Auswahl der Abschaltfallmaske" SWORD TimeDeb 1 100 -327680.0 327670.0 FORMAT "%8.1" ECU_ADDRESS 0xC0001568 /end MEASUREMENT
/begin MEASUREMENT PCR_tiMonLPEOM_mp "" SWORD TimeDeb 1 100 -327680.0 327670.0 FORMAT "%8.1" ECU_ADDRESS 0xC0001558 /end MEASUREMENT
/begin MEASUREMENT PCR_tiStrtDel_mp "Einschaltverzögerung der Regelung nach Starterabwurf" UWORD Time_ms 1 100 0.00 655350.0 FORMAT "%8.1" ECU_ADDRESS 0xC000153C /end MEASUREMENT
/begin MEASUREMENT PCR_trqCtlVal "inneres Drehmoment für die Steuerung der Ladedruckregelung" SWORD Trq 1 100 -3276.800 3276.700 FORMAT "%8.3" ECU_ADDRESS 0xD0007414 /end MEASUREMENT
/begin MEASUREMENT PCR_trqCtlValInlAutLP_mp "" SWORD Trq 1 100 -3276.800 3276.700 FORMAT "%8.3" ECU_ADDRESS 0xC00013E6 /end MEASUREMENT
/begin MEASUREMENT PCR_trqCtlValInlLP_mp "" SWORD Trq 1 100 -3276.800 3276.700 FORMAT "%8.3" ECU_ADDRESS 0xC00013DA /end MEASUREMENT
/begin MEASUREMENT PCR_trqCtlValInl_mp "inneres Drehmoment für die Steuerung der Ladedruckregelung" SWORD Trq 1 100 -3276.800 3276.700 FORMAT "%8.3" ECU_ADDRESS 0xC000140C /end MEASUREMENT
/begin MEASUREMENT PCR_trqDesVal "inneres Drehmoment für die Sollwertbildung der Ladedruckregelung" SWORD Trq 1 100 -3276.800 3276.700 FORMAT "%8.3" ECU_ADDRESS 0xD0007416 /end MEASUREMENT
/begin MEASUREMENT PCR_trqDesValInl_mp "" SWORD Trq 1 100 -3276.800 3276.700 FORMAT "%8.3" ECU_ADDRESS 0xC000149E /end MEASUREMENT
/begin MEASUREMENT PCR_trqGov "inneres Drehmoment für die Ladedruckregelung" SWORD Trq 1 100 -3276.800 3276.700 FORMAT "%8.3" ECU_ADDRESS 0xD0007418 /end MEASUREMENT
/begin MEASUREMENT PCR_trqMon "inneres Drehmoment für die Überwachung der Ladedruckregelung" SWORD Trq 1 100 -3276.800 3276.700 FORMAT "%8.3" ECU_ADDRESS 0xD000741A /end MEASUREMENT
/begin MEASUREMENT PCV_ctAdapt1_mp "Zähler für die Anzahl der Funktionsaufrufe der PCV-Adaption im Zustand PCV_ADAPT_STABLE" UWORD OneToOne 1 100 0.00 65535.00 FORMAT "%8.2" ECU_ADDRESS 0xC000159A /end MEASUREMENT
/begin MEASUREMENT PCV_ctAdapt2_mp "Zähler für die Anzahl der Funktionsaufrufe der PCV-Adaption im Zustand PCV_ADAPT_SUM_UP" UWORD OneToOne 1 100 0.00 65535.00 FORMAT "%8.2" ECU_ADDRESS 0xC000159C /end MEASUREMENT
/begin MEASUREMENT PCV_ctAdapt3_mp "Zähler für die erfolgreiche Berechnung der Adaption" ULONG OneToOne 1 100 0.00 4294967295.00 FORMAT "%13.2" ECU_ADDRESS 0xC00015A0 /end MEASUREMENT
/begin MEASUREMENT PCV_dvolFlow_mp "Eingangswert für das Kennfeld PCV_facAdaptFlow_MAP" SWORD Qp_mm3_sec 1 100 -327680.0 327670.0 FORMAT "%8.1" ECU_ADDRESS 0xC00015A4 /end MEASUREMENT
/begin MEASUREMENT PCV_facAdapt "Adaptionsfaktor für die PCV-Kennlinie" SWORD Fact 1 100 -4.000000 3.999878 FORMAT "%8.6" ECU_ADDRESS 0xD000741C /end MEASUREMENT
/begin MEASUREMENT PCV_facAdaptFlow "Faktor zur Abschätzung des Durchflusses durch das PCV" SWORD Fact 1 100 -4.000000 3.999878 FORMAT "%8.6" ECU_ADDRESS 0xD000741E /end MEASUREMENT
/begin MEASUREMENT PCV_pAdaptThres_mp "Raildruckschwelle für die Berechnung des Adaptionsfaktors" SWORD Pres_Rail 1 100 -3276.800 2000.000 FORMAT "%5.3" ECU_ADDRESS 0xC00015A6 /end MEASUREMENT
/begin MEASUREMENT PCV_pFltSum_mp "Aufsummierter Raildruck für Mittelwertbildung" SLONG Pres_Rail 1 100 -214748364.800 2000.000 FORMAT "%10.3" ECU_ADDRESS 0xC00015A8 /end MEASUREMENT
/begin MEASUREMENT PCV_pSetSum_mp "Aufsummierter Steuerdruck für das PCV für Mittelwertbildung" SLONG Pres_Rail 1 100 -214748364.800 2000.000 FORMAT "%10.3" ECU_ADDRESS 0xC00015AC /end MEASUREMENT
/begin MEASUREMENT PCV_stAdapt "Status des Statusautomaten der Adaptionsfunktion" UBYTE OneToOne 1 100 0.00 255.0 FORMAT "%5.1" ECU_ADDRESS 0xD0009117 /end MEASUREMENT
/begin MEASUREMENT PCV_stAdaptMeUn "Freigabe-Botschaft für die Zumesseinheit" UBYTE OneToOne 1 100 0.00 255.0 FORMAT "%5.1" ECU_ADDRESS 0xD0009118 /end MEASUREMENT
/begin MEASUREMENT PCV_tiAdaptLst_mp "Zeitpunkt, bei dem die letzte Adaptierung stattgefunden hat" ULONG TimeEngOn 1 100 0.00 4294967295.00 FORMAT "%13.2" ECU_ADDRESS 0xC00015B0 /end MEASUREMENT
/begin FUNCTION OilT_DD ""
 /begin DEF_CHARACTERISTIC Oil_SRCT.uMin_C Oil_SRCT.uMax_C Oil_swtSigT_C Oil_tTransfT_CUR /end DEF_CHARACTERISTIC
 /begin LOC_MEASUREMENT Oil_tSensSwmp Oil_uRawTSwmp /end LOC_MEASUREMENT
/end FUNCTION
/begin FUNCTION OilT_VD ""
 /begin DEF_CHARACTERISTIC Oil_RmpSlpT.Pos_C Oil_RmpSlpT.Neg_C Oil_swtSensPresT_C Oil_tDflOffsT_C Oil_tiDelOilCEngPlausT_C Oil_tiLPFiltPT1T_C Oil_tiStrtOilCEngPlausT_C Oil_tLimOilCEngPlausT_C Oil_TransStgT.Dfl_C Oil_TransStgT.stSensId_C Oil_tThresOilCEngPlausT_C /end DEF_CHARACTERISTIC
 /begin IN_MEASUREMENT CEngDsT_t CoEng_stEng /end IN_MEASUREMENT
 /begin OUT_MEASUREMENT Oil_tSwmp /end OUT_MEASUREMENT
 /begin SUB_FUNCTION OilT_VD /end SUB_FUNCTION
/end FUNCTION
/begin FUNCTION Oil_DD "" /begin DEF_CHARACTERISTIC Oil_swtSensVar_C Oil_tiBtwRegRd_C /end DEF_CHARACTERISTIC
 /begin OUT_MEASUREMENT Oil_rRawOilLvl Oil_rRawOilQl Oil_rRawOilT Oil_stRegSens Oil_swtSensVar /end OUT_MEASUREMENT
/end FUNCTION
/begin FUNCTION OS ""
 /begin LOC_MEASUREMENT OS_cnt1000msTask OS_cnt100msTask OS_cnt10msTask OS_cnt1msTask OS_cnt200msTask OS_cnt20msTask OS_cnt2msTask OS_cnt50msTask OS_cnt5msTask OS_cntBgTask OS_cntDsmClearTask OS_cntEpmNoSyncTask OS_cntIniEndTask OS_cntIniTask OS_cntMoTask OS_cntSyncDummyTask OS_cntSyncFirstTask OS_cntSyncIni OS_cntSyncPostTask OS_cntSyncPreTask OS_cntSyncSchedTask /end LOC_MEASUREMENT
 /begin SUB_FUNCTION OS_Error /end SUB_FUNCTION
/end FUNCTION
/begin FUNCTION OS_Error ""
 /begin LOC_MEASUREMENT OS_ErrCtr_accessResource_u8 OS_ErrCtr_callevel_u8 OS_ErrCtr_deadline_u8 OS_ErrCtr_default_u8 OS_ErrCtr_generalError_u8 OS_ErrCtr_idValue_u8 OS_ErrCtr_limit_u8 OS_ErrCtr_noFuncState_u8 OS_ErrCtr_stackcnt_u8 OS_ErrCtr_stackstat_u8 OS_ErrCtr_sum_u8 OS_ErrCtr_timetable_u8 /end LOC_MEASUREMENT
/end FUNCTION
/begin FUNCTION PAirFltDs_DD ""
 /begin DEF_CHARACTERISTIC Air_pTransfPAirFltDs_CUR Air_swtSigPAirFltDs_C Air_uSRCMaxPAirFltDs_C Air_uSRCMinPAirFltDs_C /end DEF_CHARACTERISTIC
 /begin OUT_MEASUREMENT Air_pSensPAirFltDs Air_stErrPAirFltDs Air_stLastErrPAirFltDs Air_swtSigPAirFltDs /end OUT_MEASUREMENT
 /begin LOC_MEASUREMENT Air_uRawPAirFltDs /end LOC_MEASUREMENT
/end FUNCTION
/begin FUNCTION PAirFltDs_VD ""
 /begin DEF_CHARACTERISTIC Air_nThresNplPAirFltDs_C Air_pDiffLimNplPAirFltDs_C Air_RmpSlpPAirFltDs.Pos_C Air_RmpSlpPAirFltDs.Neg_C Air_tiPT1PAirFltDs_C Air_TrStgParPAirFltDs.Dfl_C Air_TrStgParPAirFltDs.stSensId_C /end DEF_CHARACTERISTIC
 /begin IN_MEASUREMENT EnvP_p Epm_nEng /end IN_MEASUREMENT
 /begin OUT_MEASUREMENT Air_pAirFltDs Air_pFltPAirFltDs /end OUT_MEASUREMENT
/end FUNCTION
/begin FUNCTION Pcp "" /end FUNCTION
/begin FUNCTION pcr "" /end FUNCTION
/begin FUNCTION pcr_cmprbypctlvalcalc ""
 /begin DEF_CHARACTERISTIC PCR_facCByVlvRmp_CUR PCR_numGearCByVlv_C PCR_qCByVlvCloseEOM1_MAP PCR_qCByVlvClose_MAP PCR_qCByVlvOpnEOM1_MAP PCR_qCByVlvOpn_MAP PCR_QntCByVlv.xVal_C PCR_QntCByVlv.xTyp_C PCR_stCByVlvBitMsk_C PCR_stCByVlvClose_C PCR_stCByVlvEOMMsk_CA PCR_stCByVlvOpn_C PCR_stDflValCByVlv_C PCR_swtBstLPActv_C /end DEF_CHARACTERISTIC
 /begin IN_MEASUREMENT CByVlv_st CoEOM_facRmpVal CoEOM_stOpModeAct EnvP_p Epm_nEng InjCtl_qCurr InjCtl_qRaw PCR_stMon PCR_stMonLP PT_numTraGearDes /end IN_MEASUREMENT
 /begin OUT_MEASUREMENT PCR_stCByVlvOpn PCR_swtBstLPActv PCR_swtQntCByVlv /end OUT_MEASUREMENT
 /begin LOC_MEASUREMENT PCR_qCByVlvClose_mp PCR_qCByVlvOpn_mp PCR_stCByVlvActv_mp PCR_stCByVlvBits_mp PCR_stCByVlvCtlValBits_mp PCR_stCByVlvCtlValNrm_mp PCR_stCByVlvCtlValOpn_mp PCR_stMonCByVlv_mp /end LOC_MEASUREMENT
/end FUNCTION
/begin FUNCTION pcr_co ""
 /begin DEF_CHARACTERISTIC PCR_QntCtl.xVal_C PCR_QntCtl.xTyp_C PCR_QntDes.xVal_C PCR_QntDes.xTyp_C PCR_TrqCtl.xVal_C PCR_TrqCtl.xTyp_C PCR_TrqDes.xVal_C PCR_TrqDes.xTyp_C /end DEF_CHARACTERISTIC
 /begin REF_CHARACTERISTIC HESrv_swtScndFlwActv_C /end REF_CHARACTERISTIC
 /begin OUT_MEASUREMENT PCR_qCtlVal PCR_qDesVal PCR_qGov PCR_qMon PCR_swtQntCtl PCR_swtQntDes PCR_swtTrqCtl PCR_swtTrqDes PCR_trqCtlVal PCR_trqDesVal PCR_trqGov PCR_trqMon /end OUT_MEASUREMENT
/end FUNCTION
/begin FUNCTION PCR_CtlValCalc ""
 /begin DEF_CHARACTERISTIC PCR_facAirTempCtlCorEOM_CUR PCR_facEngTempCtlCor_MAP PCR_facEnvPresCtlCor_CUR PCR_facPFltLdCtlVal_CUR PCR_facRmpValCtlCorQnt1_CUR PCR_numAirTempCtlVal_C PCR_numEngTempCtlVal_C PCR_numEOMStgCtlCalc_MAP PCR_rAirTempCtlCorEOMBas_MAP PCR_rCtlBasHiAltd_MAP PCR_rCtlBas_MAP PCR_rEngTempCorBas_MAP /end DEF_CHARACTERISTIC
 /begin REF_CHARACTERISTIC HESrv_swtScndFlwActv_C /end REF_CHARACTERISTIC
 /begin IN_MEASUREMENT AirSys_tFld Air_pCACDs EngDa_tFld EnvP_p Epm_nEng PCR_qCtlVal PCR_trqCtlVal PFltLd_resFlwRaw /end IN_MEASUREMENT
 /begin OUT_MEASUREMENT PCR_rCtlVal PCR_tAirCtlVal_mp /end OUT_MEASUREMENT
 /begin LOC_MEASUREMENT PCR_ActModeCtlCalc_mp PCR_DesModeCtlCalc_mp PCR_facAirTempCtlCorEOM_mp PCR_facEngTempCtlCor_mp PCR_facEnvPresCtlCor_mp PCR_facRmpCtlCor_mp PCR_facRmpValCtlCorQnt1_mp PCR_qCtlVal_mp PCR_rAirTempCtlCorEOMBas_mp PCR_rAirTempCtlCorEOM_mp PCR_rCtlBasHiAltd_mp PCR_rCtlBas_mp PCR_rCtlCor_mp PCR_rCtlVal1Cor_mp PCR_rCtlVal1_mp PCR_rCtlVal2_mp PCR_rCtlValNrm_mp PCR_rEngTempCorBas_mp PCR_rEngTempCor_mp PCR_resFlwUnCor_mp PCR_stRmpSelCtlCor_mp PCR_tEngCtlVal_mp /end LOC_MEASUREMENT
/end FUNCTION
/begin FUNCTION pcr_ctlvalcalclp ""
 /begin DEF_CHARACTERISTIC PCR_facEngTempCtlCorAutLP_MAP PCR_facEngTempCtlCorLP_MAP PCR_facEnvPresCtlCorAutLP_CUR PCR_facEnvPresCtlCorLP_CUR PCR_rCtlBasAutLPHiAltd_MAP PCR_rCtlBasAutLP_MAP PCR_rCtlBasLPHiAltd_MAP PCR_rCtlBasLP_MAP PCR_rEngTempCorBasAutLP_MAP PCR_rEngTempCorBasLP_MAP /end DEF_CHARACTERISTIC
 /begin IN_MEASUREMENT EnvP_p Epm_nEng PCR_qCtlVal PCR_swtBstLPActv PCR_tEngDesValLP PCR_trqCtlVal /end IN_MEASUREMENT
 /begin OUT_MEASUREMENT PCR_rCtlValAutLP PCR_rCtlValLP /end OUT_MEASUREMENT
 /begin LOC_MEASUREMENT PCR_facEngTempCtlCorAutLP_mp PCR_facEngTempCtlCorLP_mp PCR_facEnvPresCtlCorAutLP_mp PCR_facEnvPresCtlCorLP_mp PCR_qCtlValLP_mp PCR_rCtlBasAutLPHiAltd_mp PCR_rCtlBasAutLP_mp PCR_rCtlBasLPHiAltd_mp PCR_rCtlBasLP_mp PCR_rCtlVal1AutLP_mp PCR_rCtlVal1LP_mp PCR_rCtlVal2AutLP_mp PCR_rCtlVal2LP_mp PCR_rCtlValNrmAutLP_mp PCR_rCtlValNrmLP_mp PCR_rEngTempCorAutLP_mp PCR_rEngTempCorBasAutLP_mp PCR_rEngTempCorBasLP_mp PCR_rEngTempCorLP_mp /end LOC_MEASUREMENT
/end FUNCTION
/begin FUNCTION pcr_ctlvalcalclp_inl1 "" /begin DEF_CHARACTERISTIC PCR_facRmpValCtlCorLP_CUR PCR_stCtlValLPEOMMsk_CA /end DEF_CHARACTERISTIC /begin IN_MEASUREMENT CoEOM_facRmpVal CoEOM_stOpModeAct /end IN_MEASUREMENT /begin LOC_MEASUREMENT PCR_facRmpValCtlCorLP_mp PCR_stEOMCtlValLP_mp /end LOC_MEASUREMENT /end FUNCTION
/begin FUNCTION pcr_ctlvalcalclp_inl3 ""
 /begin DEF_CHARACTERISTIC PCR_facEnvPresCtlCorLPEOMQnt1_CUR PCR_rCtlBasLPEOMQnt1_MAP PCR_rCtlBasLPHiAltdEOMQnt1_MAP /end DEF_CHARACTERISTIC
 /begin IN_MEASUREMENT EnvP_p Epm_nEng PCR_qCtlVal PCR_trqCtlVal /end IN_MEASUREMENT
 /begin LOC_MEASUREMENT PCR_facEnvPresCtlCorLPEOMQnt1_mp PCR_qCtlValInlLP_mp PCR_rCtlBasLPEOMQnt1_mp PCR_rCtlBasLPHiAltdEOMQnt1_mp PCR_rCtlVal1LPEOMQnt1_mp PCR_trqCtlValInlLP_mp /end LOC_MEASUREMENT
/end FUNCTION
/begin FUNCTION pcr_ctlvalcalclp_inl5 ""
 /begin DEF_CHARACTERISTIC PCR_facEnvPresCtlCorAutLPEOMQnt1_CUR PCR_rCtlBasAutLPEOMQnt1_MAP PCR_rCtlBasAutLPHiAltdEOMQnt1_MAP /end DEF_CHARACTERISTIC
 /begin IN_MEASUREMENT EnvP_p Epm_nEng PCR_qCtlVal PCR_trqCtlVal /end IN_MEASUREMENT
 /begin LOC_MEASUREMENT PCR_facEnvPresCtlCorAutLPEOMQnt1_mp PCR_qCtlValInlAutLP_mp PCR_rCtlBasAutLPEOMQnt1_mp PCR_rCtlBasAutLPHiAltdEOMQnt1_mp PCR_rCtlVal1AutLPEOMQnt1_mp PCR_trqCtlValInlAutLP_mp /end LOC_MEASUREMENT
/end FUNCTION
/begin FUNCTION pcr_ctlvalcalclp_inl6 "" /begin DEF_CHARACTERISTIC PCR_facRmpValCtlCorAutLP_CUR PCR_stCtlValAutLPEOMMsk_CA /end DEF_CHARACTERISTIC /begin IN_MEASUREMENT CoEOM_facRmpVal CoEOM_stOpModeAct /end IN_MEASUREMENT /begin LOC_MEASUREMENT PCR_facRmpValCtlCorAutLP_mp PCR_stEOMCtlValAutLP_mp /end LOC_MEASUREMENT /end FUNCTION
/begin FUNCTION pcr_ctlvalcalc_inl1 "" /begin DEF_CHARACTERISTIC PCR_rCtlValPFltLd_MAP PCR_stCtlValEOMMsk_CA /end DEF_CHARACTERISTIC /begin IN_MEASUREMENT CoEOM_facRmpVal CoEOM_stOpModeAct Epm_nEng PCR_qCtlVal_mp /end IN_MEASUREMENT
 /begin LOC_MEASUREMENT PCR_facPFltLdCtlVal_mp PCR_facRmpValCtlCor_mp PCR_rCtlPFltLdCor_mp PCR_rCtlVal3_mp PCR_rCtlValPFltLd_mp PCR_stEOMCtlVal_mp /end LOC_MEASUREMENT
/end FUNCTION
/begin FUNCTION pcr_ctlvalcalc_inl3 ""
 /begin DEF_CHARACTERISTIC PCR_facEnvPresCtlCorEOMQnt1_CUR PCR_rCtlBasEOMQnt1_MAP PCR_rCtlBasHiAltdEOMQnt1_MAP /end DEF_CHARACTERISTIC
 /begin IN_MEASUREMENT EnvP_p Epm_nEng PCR_qCtlVal PCR_trqCtlVal /end IN_MEASUREMENT
 /begin LOC_MEASUREMENT PCR_facEnvPresCtlCorEOMQnt1_mp PCR_qCtlValInl_mp PCR_rCtlBasEOMQnt1_mp PCR_rCtlBasHiAltdEOMQnt1_mp PCR_rCtlVal1EOMQnt1_mp PCR_rCtlVal2EOM_mp PCR_trqCtlValInl_mp /end LOC_MEASUREMENT
/end FUNCTION
/begin FUNCTION pcr_ctlvalcalc_inl7 "" /begin DEF_CHARACTERISTIC PCR_facAirTempCtlCor_CUR PCR_rAirTempCtlCorBas_MAP /end DEF_CHARACTERISTIC /begin IN_MEASUREMENT Epm_nEng PCR_qCtlVal PCR_tAirCtlVal_mp /end IN_MEASUREMENT
 /begin LOC_MEASUREMENT PCR_facAirTempCtlCor_mp PCR_rAirTempCtlCorBas_mp PCR_rAirTempCtlCor_mp /end LOC_MEASUREMENT
/end FUNCTION
/begin FUNCTION pcr_desvalcalc ""
 /begin DEF_CHARACTERISTIC PCR_facEnvPresDesCor_CUR PCR_facTempDesCor_MAP PCR_numAirTempDesVal_C PCR_numEngTempDesVal_C PCR_pDesBasHiAltd_MAP PCR_pDesBas_MAP PCR_pMaxDesVal_MAP PCR_pMinDesVal_C PCR_pTempCorBas_MAP PCR_TempCor.xVal_C PCR_TempCor.xTyp_C /end DEF_CHARACTERISTIC
 /begin REF_CHARACTERISTIC HESrv_swtPOpVis_C HESrv_swtScndFlwActv_C /end REF_CHARACTERISTIC
 /begin IN_MEASUREMENT EngDa_tFld EnvP_p Epm_nEng PCR_qDesVal PCR_trqDesVal /end IN_MEASUREMENT
 /begin OUT_MEASUREMENT PCR_pDesStat PCR_pDesVal PCR_swtTempCor PCR_tAirDesVal_mp PCR_tDesVal_mp /end OUT_MEASUREMENT
 /begin LOC_MEASUREMENT PCR_facAirTempDesCor_mp PCR_facEnvPresDesCor_mp PCR_facTempDesCor_mp PCR_pDesBasHiAltd_mp PCR_pDesBas_mp PCR_pDesDyn_mp PCR_pDesLim_mp PCR_pDesRaw_mp PCR_pDesStatVal1Cor_mp PCR_pDesVal1_mp PCR_pDesVal2Cor_mp PCR_pDesVal2_mp PCR_pDesVal3_mp PCR_pDesValNrm_mp PCR_pMaxDesVal_mp PCR_pTempCorBas_mp PCR_pTempCor_mp PCR_qDesVal_mp PCR_tEngDesVal_mp /end LOC_MEASUREMENT
/end FUNCTION
/begin FUNCTION PCR_DesValCalcLP ""
 /begin DEF_CHARACTERISTIC PCR_facEnvPresDesCorLP_CUR PCR_facTempDesCorLP_MAP PCR_numAirTempDesValLP_C PCR_numEngTempDesValLP_C PCR_pDesBasLPHiAltd_MAP PCR_pDesBasLP_MAP PCR_pMaxDesValLP_MAP PCR_pMinDesValLP_C PCR_pTempCorBasLP_MAP PCR_TempCorLP.xVal_C PCR_TempCorLP.xTyp_C /end DEF_CHARACTERISTIC
 /begin REF_CHARACTERISTIC HESrv_swtPOpVis_C HESrv_swtScndFlwActv_C /end REF_CHARACTERISTIC
 /begin IN_MEASUREMENT EngDa_tFld EnvP_p Epm_nEng PCR_qDesVal PCR_swtBstLPActv /end IN_MEASUREMENT
 /begin OUT_MEASUREMENT PCR_pDesValLP PCR_swtTempCorLP PCR_tAirDesValLP PCR_tDesValLP_mp PCR_tEngDesValLP /end OUT_MEASUREMENT
 /begin LOC_MEASUREMENT PCR_facEnvPresDesCorLP_mp PCR_facTempDesCorLP_mp PCR_pDesBasLPHiAltd_mp PCR_pDesBasLP_mp PCR_pDesStatLP_mp PCR_pDesVal1LP_mp PCR_pDesVal2LP_mp PCR_pDesValNrmLP_mp PCR_pMaxDesValLP_mp PCR_pTempCorBasLP_mp PCR_pTempCorLP_mp PCR_qDesValLP_mp /end LOC_MEASUREMENT
/end FUNCTION
/begin FUNCTION PCR_DesValCalcLP_Inl1 "" /begin DEF_CHARACTERISTIC PCR_facRmpValDesCorLP_CUR PCR_stDesValLPEOMMsk_CA /end DEF_CHARACTERISTIC /begin IN_MEASUREMENT CoEOM_facRmpVal CoEOM_stOpModeAct /end IN_MEASUREMENT
 /begin LOC_MEASUREMENT PCR_facRmpValDesCorLP_mp PCR_facRmpValDesLP_mp PCR_stEOMDesValLP_mp /end LOC_MEASUREMENT
/end FUNCTION
/begin FUNCTION PCR_DesValCalcLP_Inl2 ""
 /begin DEF_CHARACTERISTIC PCR_facAirTempDesCorLPEOMQnt1_CUR PCR_facEnvPresDesCorLPEOMQnt1_CUR PCR_facTempDesCorLPEOMQnt1_MAP PCR_pDesBasLPEOMQnt1_MAP PCR_pDesBasLPHiAltdEOMQnt1_MAP PCR_pTempCorBasLPEOMQnt1_MAP /end DEF_CHARACTERISTIC
 /begin IN_MEASUREMENT EnvP_p Epm_nEng PCR_qDesVal PCR_swtTempCor PCR_tAirDesValLP PCR_tDesValLP_mp PCR_tDesVal_mp /end IN_MEASUREMENT
 /begin LOC_MEASUREMENT PCR_facAirTempDesCorLPEOMQnt1_mp PCR_facEnvPresDesCorLPEOMQnt1_mp PCR_facTempDesCorLPEOMQnt1_mp PCR_pDesBasLPEOMQnt1_mp PCR_pDesBasLPHiAltdEOMQnt1_mp PCR_pDesVal1LPEOMQnt1_mp PCR_pDesVal2LPEOMQnt1_mp PCR_pDesVal3LPEOMQnt1_mp PCR_pTempCorBasLPEOMQnt1_mp PCR_pTempCorLPEOMQnt1_mp PCR_qDesValInlLP_mp /end LOC_MEASUREMENT
/end FUNCTION
/begin FUNCTION PCR_DesValCalcLP_Inl3 "" /begin DEF_CHARACTERISTIC PCR_facAirTempDesCorLP_CUR /end DEF_CHARACTERISTIC /begin IN_MEASUREMENT PCR_tAirDesValLP /end IN_MEASUREMENT /begin LOC_MEASUREMENT PCR_facAirTempDesCorLP_mp /end LOC_MEASUREMENT /end FUNCTION
/begin FUNCTION pcr_desvalcalc_inl1 "" /begin DEF_CHARACTERISTIC PCR_facRmpValDesCor_CUR PCR_stDesValEOMMsk_CA /end DEF_CHARACTERISTIC /begin IN_MEASUREMENT CoEOM_facRmpVal CoEOM_stOpModeAct /end IN_MEASUREMENT /begin OUT_MEASUREMENT PCR_facRmpVal_mp /end OUT_MEASUREMENT /begin LOC_MEASUREMENT PCR_facRmpValDesCor_mp PCR_stEOMDesVal_mp /end LOC_MEASUREMENT /end FUNCTION
/begin FUNCTION pcr_desvalcalc_inl2 ""
 /begin DEF_CHARACTERISTIC PCR_CldDT1Win.T1_C PCR_CldDT1Win.Kd_C PCR_CldDT1Win.KdPos_C PCR_CldDT1Win.KdNeg_C PCR_CldDT1Win.WinPos_C PCR_CldDT1Win.WinNeg_C PCR_tClntThres_C PCR_WrmDT1Win.T1_C PCR_WrmDT1Win.Kd_C PCR_WrmDT1Win.KdPos_C PCR_WrmDT1Win.KdNeg_C PCR_WrmDT1Win.WinPos_C PCR_WrmDT1Win.WinNeg_C /end DEF_CHARACTERISTIC
/end FUNCTION
/begin FUNCTION PCR_DesValCalc_Inl3 ""
 /begin DEF_CHARACTERISTIC PCR_APPDT1.T1_C PCR_APPDT1.Kd_C PCR_dpSlpLimRmp.Pos_C PCR_dpSlpLimRmp.Neg_C PCR_drAPPUnFlt_C PCR_nLimMax_C PCR_nLimMin_C PCR_tiDesSlpLim_C /end DEF_CHARACTERISTIC
 /begin IN_MEASUREMENT APP_rUnFlt Epm_nEng /end IN_MEASUREMENT
 /begin LOC_MEASUREMENT PCR_drAPPUnFlt_mp PCR_pDesLimVal2_mp PCR_stDesLogic_mp /end LOC_MEASUREMENT
/end FUNCTION
/begin FUNCTION pcr_desvalcalc_inl6 ""
 /begin DEF_CHARACTERISTIC PCR_facAirTempDesCorEOMQnt1_CUR PCR_facEnvPresDesCorEOMQnt1_CUR PCR_facTempDesCorEOMQnt1_MAP PCR_pDesBasEOMQnt1_MAP PCR_pDesBasHiAltdEOMQnt1_MAP PCR_pTempCorBasEOMQnt1_MAP /end DEF_CHARACTERISTIC
 /begin IN_MEASUREMENT EnvP_p Epm_nEng PCR_qDesVal PCR_swtTempCor PCR_tAirDesVal_mp PCR_tDesVal_mp /end IN_MEASUREMENT
 /begin LOC_MEASUREMENT PCR_facAirTempDesCorEOMQnt1_mp PCR_facEnvPresDesCorEOMQnt1_mp PCR_facTempDesCorEOMQnt1_mp PCR_pDesBasEOMQnt1_mp PCR_pDesBasHiAltdEOMQnt1_mp PCR_pDesVal1EOMQnt1_mp PCR_pDesVal2EOMQnt1_mp PCR_pDesVal3EOMQnt1_mp PCR_pTempCorBasEOMQnt1_mp PCR_pTempCorEOMQnt1_mp PCR_qDesValInl_mp PCR_trqDesValInl_mp /end LOC_MEASUREMENT
/end FUNCTION
/begin FUNCTION pcr_desvalcalc_inl9 "" /begin DEF_CHARACTERISTIC PCR_facAirTempDesCor_CUR /end DEF_CHARACTERISTIC /begin IN_MEASUREMENT PCR_tAirDesVal_mp /end IN_MEASUREMENT /end FUNCTION
/begin FUNCTION pcr_gov ""
 /begin DEF_CHARACTERISTIC PCR_dpMinGov_C PCR_GovMin_CUR PCR_RelAbs.xVal_C PCR_RelAbs.xTyp_C PCR_rGovMax_MAP PCR_rGovMin_MAP PCR_tiDelGov_C PCR_tiDelPT1_C /end DEF_CHARACTERISTIC
 /begin IN_MEASUREMENT Air_pCACDs EnvP_p Epm_nEng PCR_pDesStat PCR_pDesVal PCR_qGov PCR_stMon PCR_stTrans PCR_trqGov /end IN_MEASUREMENT
 /begin OUT_MEASUREMENT PCR_facRmpVal PCR_pGovDvt PCR_qGov_mp PCR_rGov PCR_rGovMaxCor PCR_rGovMinCor PCR_rGovOutUnLim PCR_rOutI PCR_stARW PCR_swtGov PCR_swtRelAbs /end OUT_MEASUREMENT
 /begin LOC_MEASUREMENT PCR_pActVal_mp PCR_pGovDvtI_mp PCR_rCtlValCor_mp PCR_rGovMaxNrm_mp PCR_rGovMax_mp PCR_rGovMinNrm_mp PCR_rGovMin_mp PCR_rGovOut_mp PCR_rOutDT1_mp PCR_rOutP_mp PCR_rPIDCor_mp PCR_rPIDCtl_mp PCR_rPID_mp PCR_stDynLimOn_mp /end LOC_MEASUREMENT
/end FUNCTION
/begin FUNCTION PCR_GovLP ""
 /begin DEF_CHARACTERISTIC PCR_RelAbsLP.xVal_C PCR_RelAbsLP.xTyp_C PCR_rGovLPMax_MAP PCR_rGovLPMin_MAP PCR_tiRmp2LP_C /end DEF_CHARACTERISTIC
 /begin IN_MEASUREMENT Air_pCACDs EnvP_p Epm_nEng PCR_pDesValLP PCR_qGov PCR_rCtlValAutLP PCR_rCtlValLP PCR_stCByVlvOpn PCR_stMonLP PCR_stTransLP PCR_trqGov /end IN_MEASUREMENT
 /begin OUT_MEASUREMENT PCR_facRmpValLP PCR_pGovDvtLP PCR_qGovLP_mp PCR_rGovLP PCR_rOutLPI PCR_stARWLP PCR_swtGovLP PCR_swtRelAbsLP /end OUT_MEASUREMENT
 /begin LOC_MEASUREMENT PCR_facRmpVal2LP_mp PCR_pActValLP_mp PCR_pGovDvtLPI_mp PCR_rGovLPMaxCor_mp PCR_rGovLPMaxNrm_mp PCR_rGovLPMax_mp PCR_rGovLPMinCor_mp PCR_rGovLPMinNrm_mp PCR_rGovLPMin_mp PCR_rGovLPOut_mp PCR_rGovOutLPUnLim_mp PCR_rOutLPDT1_mp PCR_rOutLPP_mp PCR_rPIDCorLP_mp PCR_rPIDCtlLP_mp PCR_rPIDLP_mp /end LOC_MEASUREMENT
/end FUNCTION
/begin FUNCTION PCR_GovLP_inl1 "" /begin DEF_CHARACTERISTIC PCR_tiPT1LP_C /end DEF_CHARACTERISTIC /end FUNCTION
/begin FUNCTION PCR_GovLP_Inl2 ""
 /begin DEF_CHARACTERISTIC PCR_GovOffEOMLP_CUR PCR_GovOffLP_CUR PCR_GovOnEOMLP_CUR PCR_GovOnLP_CUR PCR_stMskGovOffEOMLP_C PCR_tiGovOffDelLP_CUR PCR_tiRmpLP_C /end DEF_CHARACTERISTIC
 /begin IN_MEASUREMENT CoEOM_stOpModeAct Epm_nEng PCR_qGov /end IN_MEASUREMENT
 /begin LOC_MEASUREMENT PCR_GovOffLP_mp PCR_GovOnLP_mp PCR_stEOMGovLP_mp PCR_swtGovNoDebLP_mp /end LOC_MEASUREMENT
/end FUNCTION
/begin FUNCTION PCR_GovLP_inl3 ""
 /begin DEF_CHARACTERISTIC PCR_DT1WinLP.T1_C PCR_DT1WinLP.Kd_C PCR_DT1WinLP.KdPos_C PCR_DT1WinLP.KdNeg_C PCR_DT1WinLP.WinPos_C PCR_DT1WinLP.WinNeg_C PCR_facLPD_MAP PCR_facLPI_MAP PCR_facLPP_MAP PCR_facT1LP_MAP PCR_IWinLP.Ki_C PCR_IWinLP.KiPos_C PCR_IWinLP.KiNeg_C PCR_IWinLP.WinPos_C PCR_IWinLP.WinNeg_C PCR_PWinLP.Kp_C PCR_PWinLP.KpPos_C PCR_PWinLP.KpNeg_C PCR_PWinLP.WinPos_C PCR_PWinLP.WinNeg_C /end DEF_CHARACTERISTIC
 /begin IN_MEASUREMENT Epm_nEng PCR_pGovDvtLP PCR_qGovLP_mp PCR_trqGov /end IN_MEASUREMENT
 /begin LOC_MEASUREMENT PCR_facLPD_mp PCR_facLPI_mp PCR_facLPP_mp PCR_facT1LP_mp /end LOC_MEASUREMENT
/end FUNCTION
/begin FUNCTION PCR_GovLP_inl9 "" /begin DEF_CHARACTERISTIC PCR_rOutIMaxLP_MAP PCR_rOutIMinLP_MAP /end DEF_CHARACTERISTIC /begin IN_MEASUREMENT Air_dpFltCACDs PCR_qGov /end IN_MEASUREMENT /begin LOC_MEASUREMENT PCR_rOutIMaxLP_mp PCR_rOutIMinLP_mp /end LOC_MEASUREMENT /end FUNCTION
/begin FUNCTION pcr_gov_inl1 "" /begin DEF_CHARACTERISTIC PCR_tiPT1_C /end DEF_CHARACTERISTIC /end FUNCTION
/begin FUNCTION PCR_Gov_inl11 "" /begin DEF_CHARACTERISTIC PCR_drChrgPmpCtlRmp.Pos_C PCR_drChrgPmpCtlRmp.Neg_C /end DEF_CHARACTERISTIC
 /begin IN_MEASUREMENT PCR_rCtlVal TCPrt_rChrgPmpCtlVal TCPrt_rChrgPmpGov TCPrt_stChrgPmpCtl /end IN_MEASUREMENT
 /begin LOC_MEASUREMENT PCR_rCtlValCorrChrgPmp_mp PCR_rCtlValCorr_mp /end LOC_MEASUREMENT
/end FUNCTION
/begin FUNCTION pcr_gov_inl2 ""
 /begin DEF_CHARACTERISTIC PCR_GovOffEOM_CUR PCR_GovOff_CUR PCR_GovOnEOM_CUR PCR_GovOn_CUR PCR_stMskGovOffEOM_C PCR_tiGovOffDel_CUR PCR_tiRmp_C /end DEF_CHARACTERISTIC
 /begin IN_MEASUREMENT CoEOM_stOpModeAct Epm_nEng PCR_qGov PCR_trqGov /end IN_MEASUREMENT
 /begin LOC_MEASUREMENT PCR_GovOff_mp PCR_GovOn_mp PCR_stEOMGov_mp PCR_swtGovNoDeb_mp /end LOC_MEASUREMENT
/end FUNCTION
/begin FUNCTION PCR_Gov_inl3 ""
 /begin DEF_CHARACTERISTIC PCR_DpCorrDT1.T1_C PCR_DpCorrDT1.Kd_C PCR_DT1Win.T1_C PCR_DT1Win.Kd_C PCR_DT1Win.KdPos_C PCR_DT1Win.KdNeg_C PCR_DT1Win.WinPos_C PCR_DT1Win.WinNeg_C PCR_facDpCorr_CUR PCR_facD_MAP PCR_facI_MAP PCR_facmFlowRaw_MAP PCR_facP_MAP PCR_facT1_MAP PCR_I.Ki_C PCR_I.KiPos_C PCR_I.KiNeg_C PCR_I.WinPos_C PCR_I.WinNeg_C PCR_P.Kp_C PCR_P.KpPos_C PCR_P.KpNeg_C PCR_P.WinPos_C PCR_P.WinNeg_C /end DEF_CHARACTERISTIC
 /begin IN_MEASUREMENT Epm_nEng PCR_pGovDvt PCR_qGov_mp PCR_trqGov PFltLd_resFlwRaw /end IN_MEASUREMENT
 /begin LOC_MEASUREMENT PCR_dpBGDev_mp PCR_facD1_mp PCR_facD2_mp PCR_facdpCorr_mp PCR_facD_mp PCR_facI_mp PCR_facmFlowRawCorr_mp PCR_facP_mp PCR_facT1_mp /end LOC_MEASUREMENT
/end FUNCTION
/begin FUNCTION PCR_Gov_inl7 ""
 /begin DEF_CHARACTERISTIC PCR_drGovMaxDyn.Pos_C PCR_drGovMaxDyn.Neg_C PCR_facGovMaxCorr_CUR PCR_rGovMaxCorr_MAP PCR_rGovMaxDynCorr_MAP PCR_rGovMaxDynEnd_C PCR_rGovMaxDynStrt_C PCR_rGovMaxDyn_MAP /end DEF_CHARACTERISTIC
 /begin IN_MEASUREMENT EnvP_p Epm_nEng PCR_qGov PFltLd_resFlwRaw /end IN_MEASUREMENT
 /begin LOC_MEASUREMENT PCR_rGovMax1_mp PCR_rGovMax2_mp PCR_rGovMaxDynRamp_mp PCR_rGovMaxDyn_mp PCR_rGovMaxVal1_mp PCR_rGovMaxVal2_mp PCR_stSwtGovMaxDyn_mp /end LOC_MEASUREMENT
/end FUNCTION
/begin FUNCTION pcr_gov_inl8 "" /begin DEF_CHARACTERISTIC PCR_facPresPFltMax_CUR PCR_facPresPFltMin_CUR /end DEF_CHARACTERISTIC /begin IN_MEASUREMENT Exh_pAdapPPFltUs /end IN_MEASUREMENT /begin LOC_MEASUREMENT PCR_pAdapPPFltUs_mp /end LOC_MEASUREMENT /end FUNCTION
/begin FUNCTION PCR_Gov_inl9 "" /begin DEF_CHARACTERISTIC PCR_rOutIMax_MAP PCR_rOutIMin_MAP /end DEF_CHARACTERISTIC /begin IN_MEASUREMENT Air_dpFltCACDs PCR_qGov /end IN_MEASUREMENT /begin LOC_MEASUREMENT PCR_rOutIMax_mp PCR_rOutIMin_mp /end LOC_MEASUREMENT /end FUNCTION
/begin FUNCTION pcr_mon ""
 /begin DEF_CHARACTERISTIC PCR_ClthThres_C PCR_nCldStrt_C PCR_numEngTempMon_C PCR_nWrkSph1_C PCR_nWrkSph2_C PCR_nWrkSph3_C PCR_stPrioMon_CA PCR_tiCldStrt_CUR PCR_tiClth_C PCR_WrkSph2_C PCR_WrkSph3_C /end DEF_CHARACTERISTIC
 /begin REF_CHARACTERISTIC HESrv_swtPOpVis_C HESrv_swtScndFlwActv_C /end REF_CHARACTERISTIC
 /begin IN_MEASUREMENT Clth_st CoAS_stTrbCh CoEng_st CoEng_tiNormal EngDa_tFld Epm_nEng PCR_facRmpVal PCR_pGovDvt PCR_qMon PCR_trqMon /end IN_MEASUREMENT
 /begin OUT_MEASUREMENT PCR_pMaxDvt_mp PCR_pMinDvt_mp PCR_stDebDef_mp PCR_stGovDvtMonEna_mp PCR_stMaxDvt_mp PCR_stMinDvt_mp PCR_stMon PCR_stNrmOp_mp PCR_stPCRBits PCR_stTrans PCR_stWrkSph_mp PCR_tEngMon_mp PCR_tiStrtDel_mp /end OUT_MEASUREMENT
 /begin LOC_MEASUREMENT PCR_stMonBits_mp /end LOC_MEASUREMENT
/end FUNCTION
/begin FUNCTION pcr_monlp ""
 /begin DEF_CHARACTERISTIC PCR_ClthThresLP_CUR PCR_LPWrkSph2_C PCR_LPWrkSph3_C PCR_nLPWrkSph2_C PCR_nLPWrkSph3_C PCR_stPrioMonLP_CA PCR_tiClthLP_C PCR_vClthLP_C /end DEF_CHARACTERISTIC
 /begin REF_CHARACTERISTIC HESrv_swtPOpVis_C HESrv_swtScndFlwActv_C /end REF_CHARACTERISTIC
 /begin IN_MEASUREMENT Clth_st CoAS_stTrbCh CoEng_st CoEng_tiNormal EngDa_tFld Epm_nEng PCR_facRmpVal PCR_pGovDvtLP PCR_qMon PCR_swtGovLP PCR_trqMon /end IN_MEASUREMENT
 /begin OUT_MEASUREMENT PCR_pMaxDvtLP_mp PCR_pMinDvtLP_mp PCR_stDebDefLP_mp PCR_stGovDvtMonEnaLP_mp PCR_stMaxDvtLP_mp PCR_stMinDvtLP_mp PCR_stMonLP PCR_stNrmOpLP_mp PCR_stPCRBitsLP PCR_stTransLP PCR_stWrkSphLP_mp /end OUT_MEASUREMENT
 /begin LOC_MEASUREMENT PCR_stMonBitsLP_mp /end LOC_MEASUREMENT
/end FUNCTION
/begin FUNCTION pcr_monlp_inl1 "" /begin DEF_CHARACTERISTIC PCR_pTransLPMax_C PCR_pTransLPMin_C /end DEF_CHARACTERISTIC /begin IN_MEASUREMENT PCR_pGovDvtLP /end IN_MEASUREMENT /end FUNCTION
/begin FUNCTION pcr_monlp_inl4 ""
 /begin DEF_CHARACTERISTIC PCR_stBitMskEOMLP_CA PCR_stMonLPEOMMsk_CA PCR_tiMonLPEOM_CA /end DEF_CHARACTERISTIC
 /begin IN_MEASUREMENT CoEOM_stOpModeAct /end IN_MEASUREMENT
 /begin LOC_MEASUREMENT PCR_numEOMModeLP_mp PCR_stBitMskEOMLP_mp PCR_stSelBitMskEOMLP_mp PCR_tiMonLPEOM_mp /end LOC_MEASUREMENT
/end FUNCTION
/begin FUNCTION pcr_monlp_inl5 "" /begin DEF_CHARACTERISTIC PCR_rDflValLP_CA /end DEF_CHARACTERISTIC /end FUNCTION
/begin FUNCTION pcr_monlp_inl8 "" /begin DEF_CHARACTERISTIC PCR_pMaxDvtLP_MAP PCR_pMinDvtLP_MAP /end DEF_CHARACTERISTIC /begin REF_CHARACTERISTIC HESrv_swtPOpVis_C /end REF_CHARACTERISTIC /begin IN_MEASUREMENT Epm_nEng PCR_qMon PCR_trqMon /end IN_MEASUREMENT /begin LOC_MEASUREMENT PCR_qMonLP_mp /end LOC_MEASUREMENT /end FUNCTION
/begin FUNCTION pcr_mon_inl1 "" /begin DEF_CHARACTERISTIC PCR_pTransMax_C PCR_pTransMin_C /end DEF_CHARACTERISTIC /end FUNCTION
/begin FUNCTION pcr_mon_inl4 "" /begin DEF_CHARACTERISTIC PCR_stBitMskEOM_CA PCR_stMonEOMMsk_CA PCR_tiMonEOM_CA /end DEF_CHARACTERISTIC /begin IN_MEASUREMENT CoEOM_stOpModeAct /end IN_MEASUREMENT
 /begin LOC_MEASUREMENT PCR_numEOMMode_mp PCR_stBitMskEOM_mp PCR_stSelBitMskEOM_mp PCR_tiMonEOM_mp /end LOC_MEASUREMENT
/end FUNCTION
/begin FUNCTION pcr_mon_inl5 "" /begin DEF_CHARACTERISTIC PCR_rDflVal_CA /end DEF_CHARACTERISTIC /end FUNCTION
/begin FUNCTION pcr_mon_inl8 "" /begin DEF_CHARACTERISTIC PCR_pMaxDvt_MAP PCR_pMinDvt_MAP /end DEF_CHARACTERISTIC /begin REF_CHARACTERISTIC HESrv_swtPOpVis_C /end REF_CHARACTERISTIC /begin IN_MEASUREMENT Epm_nEng PCR_qMon PCR_trqMon /end IN_MEASUREMENT /begin LOC_MEASUREMENT PCR_qMon_mp /end LOC_MEASUREMENT /end FUNCTION
/begin FUNCTION PCR_OfsCalc ""
 /begin DEF_CHARACTERISTIC PCR_dnOfsCalcLim_C PCR_dqCtlOfsCalcLim_C PCR_drCtlValOfsRmp.Pos_C PCR_drCtlValOfsRmp.Neg_C PCR_I1OfsCalc.Ki_C PCR_I1OfsCalc.KiPos_C PCR_I1OfsCalc.KiNeg_C PCR_I1OfsCalc.WinPos_C PCR_I1OfsCalc.WinNeg_C PCR_I2OfsCalc.Ki_C PCR_I2OfsCalc.KiPos_C PCR_I2OfsCalc.KiNeg_C PCR_I2OfsCalc.WinPos_C PCR_I2OfsCalc.WinNeg_C PCR_I3OfsCalc.Ki_C PCR_I3OfsCalc.KiPos_C PCR_I3OfsCalc.KiNeg_C PCR_I3OfsCalc.WinPos_C PCR_I3OfsCalc.WinNeg_C PCR_I4OfsCalc.Ki_C PCR_I4OfsCalc.KiPos_C PCR_I4OfsCalc.KiNeg_C PCR_I4OfsCalc.WinPos_C PCR_I4OfsCalc.WinNeg_C PCR_mskOfsCalcNoRls_C PCR_mskOfsCalcResetVal_C PCR_mskOfsCalcRlsPCRCond_C PCR_mskOfsCalcStopLearn_C PCR_nOfsCalc1_C PCR_nOfsCalc2_C PCR_nOfsCalcRlsMax_C PCR_nOfsCalcRlsMin_C PCR_numAirTempOfsCalc_C PCR_numEngTempOfsCalc_C PCR_OfsCalcQCtlDT1.T1_C PCR_OfsCalcQCtlDT1.Kd_C PCR_pBstOfsRlsLim_C PCR_pEnvOfsCalcMax_C PCR_pEnvOfsCalcMin_C PCR_pGovDvtOfsRlsMin_C PCR_qOfsCalc1_C PCR_qOfsCalc2_C PCR_qOfsCalcRlsMax_C PCR_qOfsCalcRlsMin_C PCR_rDistOfsCalc1_C PCR_rDistOfsCalc2_C PCR_rDistOfsCalc3_C PCR_rDistOfsCalc4_C PCR_rOfsRlsMax_C PCR_rOfsRlsMax_MAP PCR_rOfsRlsMin_C PCR_rOfsRlsMin_MAP PCR_stOfsCalcReset_C PCR_swtOfsCalcBst_C PCR_swtOfsCalcOn_C PCR_tAirOfsCalcMax_C PCR_tAirOfsCalcMin_C PCR_tClntOfsCalcLim_C PCR_tiOfsCalcPT1_C PCR_tiOfsCalcRelStatAll.tiHiLo_C PCR_tiOfsCalcRelStatAll.tiLoHi_C PCR_tiOfsCalcRlsStat3.tiHiLo_C PCR_tiOfsCalcRlsStat3.tiLoHi_C /end DEF_CHARACTERISTIC
 /begin IN_MEASUREMENT AirCtl_stMon AirSys_tFld Air_pCACDs CoEng_st CoEOM_stOpModeAct CoVeh_stIgnLckTerm15 EngDa_tFld EnvP_p Epm_dnEng Epm_nEng InjCtl_qCurr PCR_pGovDvt PCR_qCtlVal PCR_rGovOutUnLim PCR_rOutI PCR_stARW PCR_stMon PCR_stPCRBits PCR_swtGov /end IN_MEASUREMENT
 /begin OUT_MEASUREMENT PCR_dnAvrg PCR_dqCtlOfsCalc PCR_rCtlValOfs /end OUT_MEASUREMENT
 /begin LOC_MEASUREMENT PCR_facOfsCalcC1_mp PCR_facOfsCalcC2_mp PCR_facOfsCalcC3_mp PCR_facOfsCalcC4_mp PCR_facOfsCalcRx_mp PCR_facOfsCalcRy_mp PCR_rCtlValOfsLim_mp PCR_rCtlValOfsUnLim_mp PCR_rOfsRlsMax_mp PCR_rOfsRlsMin_mp PCR_rOutOfsCalcI1_mp PCR_rOutOfsCalcI2_mp PCR_rOutOfsCalcI3_mp PCR_rOutOfsCalcI4_mp PCR_stEepOfsCalc_mp PCR_stOfsCalcEepAccess_mp PCR_stOfsCalcResetInit_mp PCR_stOfsCalcRlsAdd1_mp PCR_stOfsCalcRlsLearn_mp PCR_stOfsCalcRlsPCRBits_mp PCR_stOfsCalcRlsStat_mp PCR_stOfsCalcRls_mp PCR_tAirOfsCalc_mp PCR_tEngOfsCalc_mp /end LOC_MEASUREMENT
/end FUNCTION
/begin FUNCTION PCV_Adapt ""
 /begin DEF_CHARACTERISTIC PCV_dvolUpLim_CUR PCV_facAdaptDiffI_C PCV_facAdaptDiff_C PCV_facAdaptFlowMin_C PCV_facAdaptFlow_MAP PCV_facAdaptMax_C PCV_facAdaptMin_C PCV_facAdaptWgh_C PCV_numAdaptSum_C PCV_numAdaptThres_C PCV_numAdapt_C PCV_pAdaptThresDec_C PCV_pAdaptThresMax_C PCV_pAdaptThresMin_C PCV_pAdaptThres_C PCV_swtAdaptCPC_C PCV_swtAdaptFlow_C PCV_swtAdaptRst_C PCV_swtAdapt_C PCV_tFuelAdaptMax_C PCV_tFuelAdaptMin_C PCV_tiAdaptMax_C PCV_tSwtMeUn_C /end DEF_CHARACTERISTIC
 /begin IN_MEASUREMENT CoEng_st EngDa_tiEngOn Epm_nEng FuelT_t FuelT_tFlSys MeUn_dvolSet PCV_iDvt PCV_iSet PCV_pSet RailP_pFlt Rail_dvolPreCtl Rail_pDvt Rail_pSetPoint Rail_stCtlLoop /end IN_MEASUREMENT
 /begin OUT_MEASUREMENT PCV_facAdapt PCV_facAdaptFlow PCV_stAdaptMeUn /end OUT_MEASUREMENT
 /begin LOC_MEASUREMENT PCV_ctAdapt1_mp PCV_ctAdapt2_mp PCV_ctAdapt3_mp PCV_dvolFlow_mp PCV_pAdaptThres_mp PCV_pFltSum_mp PCV_pSetSum_mp PCV_stAdapt PCV_tiAdaptLst_mp /end LOC_MEASUREMENT
/end FUNCTION
/begin COMPU_METHOD AirSysSwt "" RAT_FUNC "%10.9" "-" COEFFS 0 16384000 0 0 0 1 /end COMPU_METHOD
/begin COMPU_METHOD AirTempFldSel "" TAB_VERB "%6.3" "-" COMPU_TAB_REF AirTempFldSel /end COMPU_METHOD
/begin COMPU_VTAB AirTempFldSel "" TAB_VERB 3 0 "Air_tCACDs" 1 "Air_tAFS" 2 "EnvT_t" /end COMPU_VTAB
/begin COMPU_METHOD CoEOMSwt_S16 "" RAT_FUNC "%7.6" "-" COEFFS 0 16384 0 0 0 1 /end COMPU_METHOD
/begin COMPU_METHOD dn_dZ20 "" RAT_FUNC "%6.2" "rpm/s" COEFFS 0 0.2 0 0 0 1 /end COMPU_METHOD
/begin COMPU_METHOD dp_dZ20 "" RAT_FUNC "%6.1" "hPa/s" COEFFS 0 0.1 0 0 0 1 /end COMPU_METHOD
/begin COMPU_METHOD EngN "" RAT_FUNC "%6.3" "rpm" COEFFS 0 2 0 0 0 1 /end COMPU_METHOD
/begin COMPU_METHOD EngN1 "" RAT_FUNC "%6.3" "rpm" COEFFS 0 2 0 0 0 1 /end COMPU_METHOD
/begin COMPU_METHOD EngNGrd "" RAT_FUNC "%6.3" "rpm/s" COEFFS 0 2 0 0 0 1 /end COMPU_METHOD
/begin COMPU_METHOD EngTempFldSel "" TAB_VERB "%6.3" "-" COMPU_TAB_REF EngTempFldSel /end COMPU_METHOD
/begin COMPU_VTAB EngTempFldSel "" TAB_VERB 3 0 "Coolant_Temperature" 1 "Oil_Temperature" 2 "EngDa_tEng" /end COMPU_VTAB
/begin COMPU_METHOD Fact "" RAT_FUNC "%6.5" "-" COEFFS 0 8192 0 0 0 1 /end COMPU_METHOD
/begin COMPU_METHOD Fact1 "" RAT_FUNC "%6.4" "-" COEFFS 0 128 0 0 0 1 /end COMPU_METHOD
/begin COMPU_METHOD Fact4 "" RAT_FUNC "%6.4" "-" COEFFS 0 20 0 0 0 1 /end COMPU_METHOD
/begin COMPU_METHOD InjMass "" RAT_FUNC "%6.4" "mg/hub" COEFFS 0 100 0 0 0 1 /end COMPU_METHOD
/begin COMPU_METHOD InjMassCyc "" RAT_FUNC "%6.4" "mg/cyc" COEFFS 0 100 0 0 0 1 /end COMPU_METHOD
/begin COMPU_METHOD InjMassPerSec_20ms "" RAT_FUNC "%6.3" "mg/hub/s" COEFFS 0 2 0 0 0 1 /end COMPU_METHOD
/begin COMPU_METHOD Kd "" RAT_FUNC "%7.6" "1/1" COEFFS 0 65536 0 0 0 1 /end COMPU_METHOD
/begin COMPU_METHOD Kd_Pres2dpdt "" RAT_FUNC "%8.7" "hPa/sec/hPa" COEFFS 0 131072 0 0 0 1 /end COMPU_METHOD
/begin COMPU_METHOD Kd_Pres_hPa2Prc "" RAT_FUNC "%9.8" "%/hPa" COEFFS 0 5368709.12 0 0 0 1 /end COMPU_METHOD
/begin COMPU_METHOD Ki "" RAT_FUNC "%6.5" "1/s" COEFFS 0 2147.483648 0 0 0 1 /end COMPU_METHOD
/begin COMPU_METHOD Ki_Pres_hPa2Prc "" RAT_FUNC "%8.7" "%/(hPa*s)" COEFFS 0 175921.86044416 0 0 0 1 /end COMPU_METHOD
/begin COMPU_METHOD Kp_Pres_hPa2Prc "" RAT_FUNC "%9.8" "%/hPa" COEFFS 0 2684354.56 0 0 0 1 /end COMPU_METHOD
/begin COMPU_METHOD OneToOne "" RAT_FUNC "%6.2" "-" COEFFS 0 1 0 0 0 1 /end COMPU_METHOD
/begin COMPU_METHOD Prc "" RAT_FUNC "%6.4" "%" COEFFS 0 81.92 0 0 0 1 /end COMPU_METHOD
/begin COMPU_METHOD PrcPerSec "" RAT_FUNC "%6.3" "%/s" COEFFS 0 1.6384 0 0 0 1 /end COMPU_METHOD
/begin COMPU_METHOD Pres "" RAT_FUNC "%7.2" "hPa" COEFFS 0 1.000000 0 0 0 1 /end COMPU_METHOD
/begin COMPU_METHOD PreshPa_FnReso "" RAT_FUNC "%6.3" "hPa" COEFFS 0 10 0 0 0 1 /end COMPU_METHOD
/begin COMPU_METHOD PreshPa_sec "" RAT_FUNC "%6.2" "hPa/s" COEFFS 0 1 0 0 0 1 /end COMPU_METHOD
/begin COMPU_METHOD Pres_hPa "" RAT_FUNC "%6.2" "hPa" COEFFS 0 1 0 0 0 1 /end COMPU_METHOD
/begin COMPU_METHOD Pres_Rail "" RAT_FUNC "%4.3" "bar" COEFFS 0 10.000000 0 0 0 1 /end COMPU_METHOD
/begin COMPU_METHOD Pres_SI "" RAT_FUNC "%6.0" "Pa" COEFFS 0 0.01 0 0 0 1 /end COMPU_METHOD
/begin COMPU_METHOD PSC_Fact "" RAT_FUNC "%7.6" "-" COEFFS 0 32767 0 0 0 1 /end COMPU_METHOD
/begin COMPU_METHOD Qp_mm3_sec "" RAT_FUNC "%6.1" "mm3/s" COEFFS 0 0.1 0 0 0 1 /end COMPU_METHOD
/begin COMPU_METHOD Res_hPaHrPerCM "" RAT_FUNC "%7.6" "hPa/(m^3/h)" COEFFS 0 10000 0 0 0 1 /end COMPU_METHOD
/begin COMPU_METHOD RmpPrc "" RAT_FUNC "%6.5" "%/s" COEFFS 0 5368.70912 0 0 0 1 /end COMPU_METHOD
/begin COMPU_METHOD RmpPres_hPa "" RAT_FUNC "%6.4" "hPa/s" COEFFS 0 65.536 0 0 0 1 /end COMPU_METHOD
/begin COMPU_METHOD RmpTemp "" RAT_FUNC "%6.4" "K/s" COEFFS 0 655.36 0 0 0 1 /end COMPU_METHOD
/begin COMPU_METHOD Temp_Cels "" RAT_FUNC "%6.1" "deg C" COEFFS 0 10 2731.4 0 0 1 /end COMPU_METHOD
/begin COMPU_METHOD TimeCoEOMRmp "" RAT_FUNC "%6.3" "s" COEFFS 0 0 1 0 0.0152587890625 0 /end COMPU_METHOD
/begin COMPU_METHOD TimeDeb "" RAT_FUNC "%6.1" "ms" COEFFS 0 0.1 0 0 0 1 /end COMPU_METHOD
/begin COMPU_METHOD TimeDelay_s "" RAT_FUNC "%12.4" "s" COEFFS 0 0 1 0 0.00023283064365387 0 /end COMPU_METHOD
/begin COMPU_METHOD TimeEngOn "" RAT_FUNC "%6.2" "s" COEFFS 0 1 0 0 0 1 /end COMPU_METHOD
/begin COMPU_METHOD Time_ms "" RAT_FUNC "%6.1" "ms" COEFFS 0 0.1 0 0 0 1 /end COMPU_METHOD
/begin COMPU_METHOD Time_s "" RAT_FUNC "%6.4" "s" COEFFS 0 100 0 0 0 1 /end COMPU_METHOD
/begin COMPU_METHOD Trq "" RAT_FUNC "%6.3" "Nm" COEFFS 0 10 0 0 0 1 /end COMPU_METHOD
/begin COMPU_METHOD Vel "" RAT_FUNC "%6.4" "km/h" COEFFS 0 100 0 0 0 1 /end COMPU_METHOD
/begin COMPU_METHOD Volt "" RAT_FUNC "%6.3" "mV" COEFFS 0 5 0 0 0 1 /end COMPU_METHOD
/begin COMPU_METHOD default "" RAT_FUNC "%6.2" "-" COEFFS 0 1 0 0 0 1 /end COMPU_METHOD
/begin RECORD_LAYOUT Cur_Xs16Ws16 NO_AXIS_PTS_X 1 SWORD AXIS_PTS_X 2 SWORD INDEX_INCR DIRECT FNC_VALUES 3 SWORD COLUMN_DIR DIRECT /end RECORD_LAYOUT
/begin RECORD_LAYOUT Kf_Xs16_Ys16_Ws16 NO_AXIS_PTS_X 1 SWORD NO_AXIS_PTS_Y 2 SWORD AXIS_PTS_X 3 SWORD INDEX_INCR DIRECT AXIS_PTS_Y 4 SWORD INDEX_INCR DIRECT FNC_VALUES 5 SWORD COLUMN_DIR DIRECT /end RECORD_LAYOUT
/begin RECORD_LAYOUT Kl_Xs16_Ws16 NO_AXIS_PTS_X 1 SWORD AXIS_PTS_X 2 SWORD INDEX_INCR DIRECT FNC_VALUES 3 SWORD COLUMN_DIR DIRECT /end RECORD_LAYOUT
/begin RECORD_LAYOUT Kw_Ws16 FNC_VALUES 1 SWORD COLUMN_DIR DIRECT /end RECORD_LAYOUT
/begin RECORD_LAYOUT Kw_Ws32 FNC_VALUES 1 SLONG COLUMN_DIR DIRECT /end RECORD_LAYOUT
/begin RECORD_LAYOUT Kw_Wu16 FNC_VALUES 1 UWORD COLUMN_DIR DIRECT /end RECORD_LAYOUT
/begin RECORD_LAYOUT Kw_Wu8 FNC_VALUES 1 UBYTE COLUMN_DIR DIRECT /end RECORD_LAYOUT
/begin RECORD_LAYOUT Map_Xs16Ys16Ws16 NO_AXIS_PTS_X 1 SWORD NO_AXIS_PTS_Y 2 SWORD AXIS_PTS_X 3 SWORD INDEX_INCR DIRECT AXIS_PTS_Y 4 SWORD INDEX_INCR DIRECT FNC_VALUES 5 SWORD COLUMN_DIR DIRECT /end RECORD_LAYOUT
/begin RECORD_LAYOUT ValA_Ws16 FNC_VALUES 1 SWORD COLUMN_DIR DIRECT /end RECORD_LAYOUT
/begin RECORD_LAYOUT ValA_Wu32 FNC_VALUES 1 ULONG COLUMN_DIR DIRECT /end RECORD_LAYOUT
/begin RECORD_LAYOUT Val_Ws16 FNC_VALUES 1 SWORD COLUMN_DIR DIRECT /end RECORD_LAYOUT
/begin RECORD_LAYOUT Val_Ws32 FNC_VALUES 1 SLONG COLUMN_DIR DIRECT /end RECORD_LAYOUT
/begin RECORD_LAYOUT Val_Wu16 FNC_VALUES 1 UWORD COLUMN_DIR DIRECT /end RECORD_LAYOUT
/begin RECORD_LAYOUT Val_Wu32 FNC_VALUES 1 ULONG COLUMN_DIR DIRECT /end RECORD_LAYOUT
/begin RECORD_LAYOUT Val_Wu8 FNC_VALUES 1 UBYTE COLUMN_DIR DIRECT /end RECORD_LAYOUT
/end MODULE
/end PROJECT
