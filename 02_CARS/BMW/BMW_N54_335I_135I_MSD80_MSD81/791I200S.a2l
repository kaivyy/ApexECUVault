ASAP2_VERSION 1 41
/begin PROJECT MSD85 "Spray Guided DI-System with Piezo Injectors for 8-Cylinder"
/begin HEADER "_default_HeaderComment" PROJECT_NO _91 /end HEADER
/begin MODULE _default_ModuleName "_default_ModuleLongIdentifier"
/begin MOD_COMMON "_default_ModCommonComment" DEPOSIT ABSOLUTE BYTE_ORDER MSB_LAST ALIGNMENT_BYTE 1 ALIGNMENT_WORD 2 ALIGNMENT_LONG 2 ALIGNMENT_FLOAT32_IEEE 2 ALIGNMENT_FLOAT64_IEEE 4 /end MOD_COMMON
/begin MEASUREMENT t_sum_cyl_bal_lam_lim_min[0] "Timer for detected diagnosis limit - lower limit of CILC concerned" UWORD _CNV_A_R_LINEAR_____4_CM 1 100. 0. 6553.5 DISPLAY_IDENTIFIER T_SUM_CYL_BAL_LAM_LIM_MIN[0] ECU_ADDRESS 0xd0000898 FORMAT "%6.1" /end MEASUREMENT
/begin MEASUREMENT t_sum_cyl_bal_lam_lim_min[1] "Timer for detected diagnosis limit - lower limit of CILC concerned" UWORD _CNV_A_R_LINEAR_____4_CM 1 100. 0. 6553.5 DISPLAY_IDENTIFIER T_SUM_CYL_BAL_LAM_LIM_MIN[1] ECU_ADDRESS 0xd000089a FORMAT "%6.1" /end MEASUREMENT
/begin MEASUREMENT t_sum_cyl_bal_lam_lim_min[2] "Timer for detected diagnosis limit - lower limit of CILC concerned" UWORD _CNV_A_R_LINEAR_____4_CM 1 100. 0. 6553.5 DISPLAY_IDENTIFIER T_SUM_CYL_BAL_LAM_LIM_MIN[2] ECU_ADDRESS 0xd000089c FORMAT "%6.1" /end MEASUREMENT
/begin MEASUREMENT t_sum_cyl_bal_lam_lim_min[3] "Timer for detected diagnosis limit - lower limit of CILC concerned" UWORD _CNV_A_R_LINEAR_____4_CM 1 100. 0. 6553.5 DISPLAY_IDENTIFIER T_SUM_CYL_BAL_LAM_LIM_MIN[3] ECU_ADDRESS 0xd000089e FORMAT "%6.1" /end MEASUREMENT
/begin MEASUREMENT t_sum_cyl_bal_lam_lim_min[4] "Timer for detected diagnosis limit - lower limit of CILC concerned" UWORD _CNV_A_R_LINEAR_____4_CM 1 100. 0. 6553.5 DISPLAY_IDENTIFIER T_SUM_CYL_BAL_LAM_LIM_MIN[4] ECU_ADDRESS 0xd00008a0 FORMAT "%6.1" /end MEASUREMENT
/begin MEASUREMENT t_sum_cyl_bal_lam_lim_min[5] "Timer for detected diagnosis limit - lower limit of CILC concerned" UWORD _CNV_A_R_LINEAR_____4_CM 1 100. 0. 6553.5 DISPLAY_IDENTIFIER T_SUM_CYL_BAL_LAM_LIM_MIN[5] ECU_ADDRESS 0xd00008a2 FORMAT "%6.1" /end MEASUREMENT
/begin MEASUREMENT t_sum_cyl_bal_lam_lim_min[6] "Timer for detected diagnosis limit - lower limit of CILC concerned" UWORD _CNV_A_R_LINEAR_____4_CM 1 100. 0. 6553.5 DISPLAY_IDENTIFIER T_SUM_CYL_BAL_LAM_LIM_MIN[6] ECU_ADDRESS 0xd00008a4 FORMAT "%6.1" /end MEASUREMENT
/begin MEASUREMENT t_sum_cyl_bal_lam_lim_min[7] "Timer for detected diagnosis limit - lower limit of CILC concerned" UWORD _CNV_A_R_LINEAR_____4_CM 1 100. 0. 6553.5 DISPLAY_IDENTIFIER T_SUM_CYL_BAL_LAM_LIM_MIN[7] ECU_ADDRESS 0xd00008a6 FORMAT "%6.1" /end MEASUREMENT
/begin MEASUREMENT t_sum_cyl_bal_lam_lim_max[0] "Timer for detected diagnosis limit - upper limit of CILC concerned" UWORD _CNV_A_R_LINEAR_____4_CM 1 100. 0. 6553.5 DISPLAY_IDENTIFIER T_SUM_CYL_BAL_LAM_LIM_MAX[0] ECU_ADDRESS 0xd00008a8 FORMAT "%6.1" /end MEASUREMENT
/begin MEASUREMENT t_sum_cyl_bal_lam_lim_max[1] "Timer for detected diagnosis limit - upper limit of CILC concerned" UWORD _CNV_A_R_LINEAR_____4_CM 1 100. 0. 6553.5 DISPLAY_IDENTIFIER T_SUM_CYL_BAL_LAM_LIM_MAX[1] ECU_ADDRESS 0xd00008aa FORMAT "%6.1" /end MEASUREMENT
/begin MEASUREMENT t_sum_cyl_bal_lam_lim_max[2] "Timer for detected diagnosis limit - upper limit of CILC concerned" UWORD _CNV_A_R_LINEAR_____4_CM 1 100. 0. 6553.5 DISPLAY_IDENTIFIER T_SUM_CYL_BAL_LAM_LIM_MAX[2] ECU_ADDRESS 0xd00008ac FORMAT "%6.1" /end MEASUREMENT
/begin MEASUREMENT t_sum_cyl_bal_lam_lim_max[3] "Timer for detected diagnosis limit - upper limit of CILC concerned" UWORD _CNV_A_R_LINEAR_____4_CM 1 100. 0. 6553.5 DISPLAY_IDENTIFIER T_SUM_CYL_BAL_LAM_LIM_MAX[3] ECU_ADDRESS 0xd00008ae FORMAT "%6.1" /end MEASUREMENT
/begin MEASUREMENT t_sum_cyl_bal_lam_lim_max[4] "Timer for detected diagnosis limit - upper limit of CILC concerned" UWORD _CNV_A_R_LINEAR_____4_CM 1 100. 0. 6553.5 DISPLAY_IDENTIFIER T_SUM_CYL_BAL_LAM_LIM_MAX[4] ECU_ADDRESS 0xd00008b0 FORMAT "%6.1" /end MEASUREMENT
/begin MEASUREMENT t_sum_cyl_bal_lam_lim_max[5] "Timer for detected diagnosis limit - upper limit of CILC concerned" UWORD _CNV_A_R_LINEAR_____4_CM 1 100. 0. 6553.5 DISPLAY_IDENTIFIER T_SUM_CYL_BAL_LAM_LIM_MAX[5] ECU_ADDRESS 0xd00008b2 FORMAT "%6.1" /end MEASUREMENT
/begin MEASUREMENT t_sum_cyl_bal_lam_lim_max[6] "Timer for detected diagnosis limit - upper limit of CILC concerned" UWORD _CNV_A_R_LINEAR_____4_CM 1 100. 0. 6553.5 DISPLAY_IDENTIFIER T_SUM_CYL_BAL_LAM_LIM_MAX[6] ECU_ADDRESS 0xd00008b4 FORMAT "%6.1" /end MEASUREMENT
/begin MEASUREMENT t_sum_cyl_bal_lam_lim_max[7] "Timer for detected diagnosis limit - upper limit of CILC concerned" UWORD _CNV_A_R_LINEAR_____4_CM 1 100. 0. 6553.5 DISPLAY_IDENTIFIER T_SUM_CYL_BAL_LAM_LIM_MAX[7] ECU_ADDRESS 0xd00008b6 FORMAT "%6.1" /end MEASUREMENT
/begin MEASUREMENT t_sum_cyl_bal_er_lim_min[0] "Timer for detected diagnosis limit - lower limit of CYBL_ER concerned" UWORD _CNV_A_R_LINEAR_____4_CM 1 100. 0. 6553.5 DISPLAY_IDENTIFIER T_SUM_CYL_BAL_ER_LIM_MIN[0] ECU_ADDRESS 0xd00008b8 FORMAT "%6.1" /end MEASUREMENT
/begin MEASUREMENT t_sum_cyl_bal_er_lim_min[1] "Timer for detected diagnosis limit - lower limit of CYBL_ER concerned" UWORD _CNV_A_R_LINEAR_____4_CM 1 100. 0. 6553.5 DISPLAY_IDENTIFIER T_SUM_CYL_BAL_ER_LIM_MIN[1] ECU_ADDRESS 0xd00008ba FORMAT "%6.1" /end MEASUREMENT
/begin MEASUREMENT t_sum_cyl_bal_er_lim_min[2] "Timer for detected diagnosis limit - lower limit of CYBL_ER concerned" UWORD _CNV_A_R_LINEAR_____4_CM 1 100. 0. 6553.5 DISPLAY_IDENTIFIER T_SUM_CYL_BAL_ER_LIM_MIN[2] ECU_ADDRESS 0xd00008bc FORMAT "%6.1" /end MEASUREMENT
/begin MEASUREMENT t_sum_cyl_bal_er_lim_min[3] "Timer for detected diagnosis limit - lower limit of CYBL_ER concerned" UWORD _CNV_A_R_LINEAR_____4_CM 1 100. 0. 6553.5 DISPLAY_IDENTIFIER T_SUM_CYL_BAL_ER_LIM_MIN[3] ECU_ADDRESS 0xd00008be FORMAT "%6.1" /end MEASUREMENT
/begin MEASUREMENT t_sum_cyl_bal_er_lim_min[4] "Timer for detected diagnosis limit - lower limit of CYBL_ER concerned" UWORD _CNV_A_R_LINEAR_____4_CM 1 100. 0. 6553.5 DISPLAY_IDENTIFIER T_SUM_CYL_BAL_ER_LIM_MIN[4] ECU_ADDRESS 0xd00008c0 FORMAT "%6.1" /end MEASUREMENT
/begin MEASUREMENT t_sum_cyl_bal_er_lim_min[5] "Timer for detected diagnosis limit - lower limit of CYBL_ER concerned" UWORD _CNV_A_R_LINEAR_____4_CM 1 100. 0. 6553.5 DISPLAY_IDENTIFIER T_SUM_CYL_BAL_ER_LIM_MIN[5] ECU_ADDRESS 0xd00008c2 FORMAT "%6.1" /end MEASUREMENT
/begin MEASUREMENT t_sum_cyl_bal_er_lim_min[6] "Timer for detected diagnosis limit - lower limit of CYBL_ER concerned" UWORD _CNV_A_R_LINEAR_____4_CM 1 100. 0. 6553.5 DISPLAY_IDENTIFIER T_SUM_CYL_BAL_ER_LIM_MIN[6] ECU_ADDRESS 0xd00008c4 FORMAT "%6.1" /end MEASUREMENT
/begin MEASUREMENT t_sum_cyl_bal_er_lim_min[7] "Timer for detected diagnosis limit - lower limit of CYBL_ER concerned" UWORD _CNV_A_R_LINEAR_____4_CM 1 100. 0. 6553.5 DISPLAY_IDENTIFIER T_SUM_CYL_BAL_ER_LIM_MIN[7] ECU_ADDRESS 0xd00008c6 FORMAT "%6.1" /end MEASUREMENT
/begin MEASUREMENT t_sum_rst_cyl_bal_lam[0] "Timer to update the diagnosis window - output of CILC concerned" UWORD _CNV_A_R_LINEAR_____4_CM 1 100. 0. 6553.5 DISPLAY_IDENTIFIER T_SUM_RST_CYL_BAL_LAM[0] ECU_ADDRESS 0xd00008d8 FORMAT "%6.1" /end MEASUREMENT
/begin MEASUREMENT t_sum_rst_cyl_bal_lam[1] "Timer to update the diagnosis window - output of CILC concerned" UWORD _CNV_A_R_LINEAR_____4_CM 1 100. 0. 6553.5 DISPLAY_IDENTIFIER T_SUM_RST_CYL_BAL_LAM[1] ECU_ADDRESS 0xd00008da FORMAT "%6.1" /end MEASUREMENT
/begin MEASUREMENT t_sum_rst_cyl_bal_lam[2] "Timer to update the diagnosis window - output of CILC concerned" UWORD _CNV_A_R_LINEAR_____4_CM 1 100. 0. 6553.5 DISPLAY_IDENTIFIER T_SUM_RST_CYL_BAL_LAM[2] ECU_ADDRESS 0xd00008dc FORMAT "%6.1" /end MEASUREMENT
/begin MEASUREMENT t_sum_rst_cyl_bal_lam[3] "Timer to update the diagnosis window - output of CILC concerned" UWORD _CNV_A_R_LINEAR_____4_CM 1 100. 0. 6553.5 DISPLAY_IDENTIFIER T_SUM_RST_CYL_BAL_LAM[3] ECU_ADDRESS 0xd00008de FORMAT "%6.1" /end MEASUREMENT
/begin MEASUREMENT t_sum_rst_cyl_bal_lam[4] "Timer to update the diagnosis window - output of CILC concerned" UWORD _CNV_A_R_LINEAR_____4_CM 1 100. 0. 6553.5 DISPLAY_IDENTIFIER T_SUM_RST_CYL_BAL_LAM[4] ECU_ADDRESS 0xd00008e0 FORMAT "%6.1" /end MEASUREMENT
/begin MEASUREMENT t_sum_rst_cyl_bal_lam[5] "Timer to update the diagnosis window - output of CILC concerned" UWORD _CNV_A_R_LINEAR_____4_CM 1 100. 0. 6553.5 DISPLAY_IDENTIFIER T_SUM_RST_CYL_BAL_LAM[5] ECU_ADDRESS 0xd00008e2 FORMAT "%6.1" /end MEASUREMENT
/begin MEASUREMENT t_sum_rst_cyl_bal_lam[6] "Timer to update the diagnosis window - output of CILC concerned" UWORD _CNV_A_R_LINEAR_____4_CM 1 100. 0. 6553.5 DISPLAY_IDENTIFIER T_SUM_RST_CYL_BAL_LAM[6] ECU_ADDRESS 0xd00008e4 FORMAT "%6.1" /end MEASUREMENT
/begin MEASUREMENT t_sum_rst_cyl_bal_lam[7] "Timer to update the diagnosis window - output of CILC concerned" UWORD _CNV_A_R_LINEAR_____4_CM 1 100. 0. 6553.5 DISPLAY_IDENTIFIER T_SUM_RST_CYL_BAL_LAM[7] ECU_ADDRESS 0xd00008e6 FORMAT "%6.1" /end MEASUREMENT
/begin MEASUREMENT t_sum_end_diag_win_cyl_bal_lam[0] "Timer for the diagnosis window - output of CILC concerned" UWORD _CNV_A_R_LINEAR_____4_CM 1 100. 0. 6553.5 DISPLAY_IDENTIFIER T_SUM_END_DIAG_WIN_CYL_BAL_LAM[0] ECU_ADDRESS 0xd00008f8 FORMAT "%6.1" /end MEASUREMENT
/begin MEASUREMENT t_sum_end_diag_win_cyl_bal_lam[1] "Timer for the diagnosis window - output of CILC concerned" UWORD _CNV_A_R_LINEAR_____4_CM 1 100. 0. 6553.5 DISPLAY_IDENTIFIER T_SUM_END_DIAG_WIN_CYL_BAL_LAM[1] ECU_ADDRESS 0xd00008fa FORMAT "%6.1" /end MEASUREMENT
/begin MEASUREMENT t_sum_end_diag_win_cyl_bal_lam[2] "Timer for the diagnosis window - output of CILC concerned" UWORD _CNV_A_R_LINEAR_____4_CM 1 100. 0. 6553.5 DISPLAY_IDENTIFIER T_SUM_END_DIAG_WIN_CYL_BAL_LAM[2] ECU_ADDRESS 0xd00008fc FORMAT "%6.1" /end MEASUREMENT
/begin MEASUREMENT t_sum_end_diag_win_cyl_bal_lam[3] "Timer for the diagnosis window - output of CILC concerned" UWORD _CNV_A_R_LINEAR_____4_CM 1 100. 0. 6553.5 DISPLAY_IDENTIFIER T_SUM_END_DIAG_WIN_CYL_BAL_LAM[3] ECU_ADDRESS 0xd00008fe FORMAT "%6.1" /end MEASUREMENT
/begin MEASUREMENT t_sum_end_diag_win_cyl_bal_lam[4] "Timer for the diagnosis window - output of CILC concerned" UWORD _CNV_A_R_LINEAR_____4_CM 1 100. 0. 6553.5 DISPLAY_IDENTIFIER T_SUM_END_DIAG_WIN_CYL_BAL_LAM[4] ECU_ADDRESS 0xd0000900 FORMAT "%6.1" /end MEASUREMENT
/begin MEASUREMENT t_sum_end_diag_win_cyl_bal_lam[5] "Timer for the diagnosis window - output of CILC concerned" UWORD _CNV_A_R_LINEAR_____4_CM 1 100. 0. 6553.5 DISPLAY_IDENTIFIER T_SUM_END_DIAG_WIN_CYL_BAL_LAM[5] ECU_ADDRESS 0xd0000902 FORMAT "%6.1" /end MEASUREMENT
/begin MEASUREMENT t_sum_end_diag_win_cyl_bal_lam[6] "Timer for the diagnosis window - output of CILC concerned" UWORD _CNV_A_R_LINEAR_____4_CM 1 100. 0. 6553.5 DISPLAY_IDENTIFIER T_SUM_END_DIAG_WIN_CYL_BAL_LAM[6] ECU_ADDRESS 0xd0000904 FORMAT "%6.1" /end MEASUREMENT
/begin MEASUREMENT t_sum_end_diag_win_cyl_bal_lam[7] "Timer for the diagnosis window - output of CILC concerned" UWORD _CNV_A_R_LINEAR_____4_CM 1 100. 0. 6553.5 DISPLAY_IDENTIFIER T_SUM_END_DIAG_WIN_CYL_BAL_LAM[7] ECU_ADDRESS 0xd0000906 FORMAT "%6.1" /end MEASUREMENT
/begin MEASUREMENT t_sum_end_diag_win_cyl_bal_er[0] "Timer for the diagnosis window - output of CYBL_ER concerned" UWORD _CNV_A_R_LINEAR_____4_CM 1 100. 0. 6553.5 DISPLAY_IDENTIFIER T_SUM_END_DIAG_WIN_CYL_BAL_ER[0] ECU_ADDRESS 0xd0000908 FORMAT "%6.1" /end MEASUREMENT
/begin MEASUREMENT t_sum_end_diag_win_cyl_bal_er[1] "Timer for the diagnosis window - output of CYBL_ER concerned" UWORD _CNV_A_R_LINEAR_____4_CM 1 100. 0. 6553.5 DISPLAY_IDENTIFIER T_SUM_END_DIAG_WIN_CYL_BAL_ER[1] ECU_ADDRESS 0xd000090a FORMAT "%6.1" /end MEASUREMENT
/begin MEASUREMENT t_sum_end_diag_win_cyl_bal_er[2] "Timer for the diagnosis window - output of CYBL_ER concerned" UWORD _CNV_A_R_LINEAR_____4_CM 1 100. 0. 6553.5 DISPLAY_IDENTIFIER T_SUM_END_DIAG_WIN_CYL_BAL_ER[2] ECU_ADDRESS 0xd000090c FORMAT "%6.1" /end MEASUREMENT
/begin MEASUREMENT t_sum_end_diag_win_cyl_bal_er[3] "Timer for the diagnosis window - output of CYBL_ER concerned" UWORD _CNV_A_R_LINEAR_____4_CM 1 100. 0. 6553.5 DISPLAY_IDENTIFIER T_SUM_END_DIAG_WIN_CYL_BAL_ER[3] ECU_ADDRESS 0xd000090e FORMAT "%6.1" /end MEASUREMENT
/begin MEASUREMENT t_sum_end_diag_win_cyl_bal_er[4] "Timer for the diagnosis window - output of CYBL_ER concerned" UWORD _CNV_A_R_LINEAR_____4_CM 1 100. 0. 6553.5 DISPLAY_IDENTIFIER T_SUM_END_DIAG_WIN_CYL_BAL_ER[4] ECU_ADDRESS 0xd0000910 FORMAT "%6.1" /end MEASUREMENT
/begin MEASUREMENT t_sum_end_diag_win_cyl_bal_er[5] "Timer for the diagnosis window - output of CYBL_ER concerned" UWORD _CNV_A_R_LINEAR_____4_CM 1 100. 0. 6553.5 DISPLAY_IDENTIFIER T_SUM_END_DIAG_WIN_CYL_BAL_ER[5] ECU_ADDRESS 0xd0000912 FORMAT "%6.1" /end MEASUREMENT
/begin MEASUREMENT t_sum_end_diag_win_cyl_bal_er[6] "Timer for the diagnosis window - output of CYBL_ER concerned" UWORD _CNV_A_R_LINEAR_____4_CM 1 100. 0. 6553.5 DISPLAY_IDENTIFIER T_SUM_END_DIAG_WIN_CYL_BAL_ER[6] ECU_ADDRESS 0xd0000914 FORMAT "%6.1" /end MEASUREMENT
/begin MEASUREMENT t_sum_end_diag_win_cyl_bal_er[7] "Timer for the diagnosis window - output of CYBL_ER concerned" UWORD _CNV_A_R_LINEAR_____4_CM 1 100. 0. 6553.5 DISPLAY_IDENTIFIER T_SUM_END_DIAG_WIN_CYL_BAL_ER[7] ECU_ADDRESS 0xd0000916 FORMAT "%6.1" /end MEASUREMENT
/begin MEASUREMENT t_sum_cyl_bal_er_lim_max[0] "Timer for detected diagnosis limit - upper limit of CYBL_ER concerned" UWORD _CNV_A_R_LINEAR_____4_CM 1 100. 0. 6553.5 DISPLAY_IDENTIFIER T_SUM_CYL_BAL_ER_LIM_MAX[0] ECU_ADDRESS 0xd00008c8 FORMAT "%6.1" /end MEASUREMENT
/begin MEASUREMENT t_sum_cyl_bal_er_lim_max[1] "Timer for detected diagnosis limit - upper limit of CYBL_ER concerned" UWORD _CNV_A_R_LINEAR_____4_CM 1 100. 0. 6553.5 DISPLAY_IDENTIFIER T_SUM_CYL_BAL_ER_LIM_MAX[1] ECU_ADDRESS 0xd00008ca FORMAT "%6.1" /end MEASUREMENT
/begin MEASUREMENT t_sum_cyl_bal_er_lim_max[2] "Timer for detected diagnosis limit - upper limit of CYBL_ER concerned" UWORD _CNV_A_R_LINEAR_____4_CM 1 100. 0. 6553.5 DISPLAY_IDENTIFIER T_SUM_CYL_BAL_ER_LIM_MAX[2] ECU_ADDRESS 0xd00008cc FORMAT "%6.1" /end MEASUREMENT
/begin MEASUREMENT t_sum_cyl_bal_er_lim_max[3] "Timer for detected diagnosis limit - upper limit of CYBL_ER concerned" UWORD _CNV_A_R_LINEAR_____4_CM 1 100. 0. 6553.5 DISPLAY_IDENTIFIER T_SUM_CYL_BAL_ER_LIM_MAX[3] ECU_ADDRESS 0xd00008ce FORMAT "%6.1" /end MEASUREMENT
/begin MEASUREMENT t_sum_cyl_bal_er_lim_max[4] "Timer for detected diagnosis limit - upper limit of CYBL_ER concerned" UWORD _CNV_A_R_LINEAR_____4_CM 1 100. 0. 6553.5 DISPLAY_IDENTIFIER T_SUM_CYL_BAL_ER_LIM_MAX[4] ECU_ADDRESS 0xd00008d0 FORMAT "%6.1" /end MEASUREMENT
/begin MEASUREMENT t_sum_cyl_bal_er_lim_max[5] "Timer for detected diagnosis limit - upper limit of CYBL_ER concerned" UWORD _CNV_A_R_LINEAR_____4_CM 1 100. 0. 6553.5 DISPLAY_IDENTIFIER T_SUM_CYL_BAL_ER_LIM_MAX[5] ECU_ADDRESS 0xd00008d2 FORMAT "%6.1" /end MEASUREMENT
/begin MEASUREMENT t_sum_cyl_bal_er_lim_max[6] "Timer for detected diagnosis limit - upper limit of CYBL_ER concerned" UWORD _CNV_A_R_LINEAR_____4_CM 1 100. 0. 6553.5 DISPLAY_IDENTIFIER T_SUM_CYL_BAL_ER_LIM_MAX[6] ECU_ADDRESS 0xd00008d4 FORMAT "%6.1" /end MEASUREMENT
/begin MEASUREMENT t_sum_cyl_bal_er_lim_max[7] "Timer for detected diagnosis limit - upper limit of CYBL_ER concerned" UWORD _CNV_A_R_LINEAR_____4_CM 1 100. 0. 6553.5 DISPLAY_IDENTIFIER T_SUM_CYL_BAL_ER_LIM_MAX[7] ECU_ADDRESS 0xd00008d6 FORMAT "%6.1" /end MEASUREMENT
/begin MEASUREMENT lv_err_cyl_bal_lam[0] "Cylinder balancing error detected - output of CILC concerned" UBYTE _CNV_S_2_RANGE__0___1_CM 1 100. 0. 1. DISPLAY_IDENTIFIER LV_ERR_CYL_BAL_LAM[0] ECU_ADDRESS 0xd00089b8 BIT_MASK 0x1 /end MEASUREMENT
/begin MEASUREMENT lv_err_cyl_bal_lam[1] "Cylinder balancing error detected - output of CILC concerned" UBYTE _CNV_S_2_RANGE__0___1_CM 1 100. 0. 1. DISPLAY_IDENTIFIER LV_ERR_CYL_BAL_LAM[1] ECU_ADDRESS 0xd00089b9 BIT_MASK 0x1 /end MEASUREMENT
/begin MEASUREMENT lv_err_cyl_bal_lam[2] "Cylinder balancing error detected - output of CILC concerned" UBYTE _CNV_S_2_RANGE__0___1_CM 1 100. 0. 1. DISPLAY_IDENTIFIER LV_ERR_CYL_BAL_LAM[2] ECU_ADDRESS 0xd00089ba BIT_MASK 0x1 /end MEASUREMENT
/begin MEASUREMENT lv_err_cyl_bal_lam[3] "Cylinder balancing error detected - output of CILC concerned" UBYTE _CNV_S_2_RANGE__0___1_CM 1 100. 0. 1. DISPLAY_IDENTIFIER LV_ERR_CYL_BAL_LAM[3] ECU_ADDRESS 0xd00089bb BIT_MASK 0x1 /end MEASUREMENT
/begin MEASUREMENT lv_err_cyl_bal_lam[4] "Cylinder balancing error detected - output of CILC concerned" UBYTE _CNV_S_2_RANGE__0___1_CM 1 100. 0. 1. DISPLAY_IDENTIFIER LV_ERR_CYL_BAL_LAM[4] ECU_ADDRESS 0xd00089bc BIT_MASK 0x1 /end MEASUREMENT
/begin MEASUREMENT lv_err_cyl_bal_lam[5] "Cylinder balancing error detected - output of CILC concerned" UBYTE _CNV_S_2_RANGE__0___1_CM 1 100. 0. 1. DISPLAY_IDENTIFIER LV_ERR_CYL_BAL_LAM[5] ECU_ADDRESS 0xd00089bd BIT_MASK 0x1 /end MEASUREMENT
/begin MEASUREMENT lv_err_cyl_bal_lam[6] "Cylinder balancing error detected - output of CILC concerned" UBYTE _CNV_S_2_RANGE__0___1_CM 1 100. 0. 1. DISPLAY_IDENTIFIER LV_ERR_CYL_BAL_LAM[6] ECU_ADDRESS 0xd00089be BIT_MASK 0x1 /end MEASUREMENT
/begin MEASUREMENT lv_err_cyl_bal_lam[7] "Cylinder balancing error detected - output of CILC concerned" UBYTE _CNV_S_2_RANGE__0___1_CM 1 100. 0. 1. DISPLAY_IDENTIFIER LV_ERR_CYL_BAL_LAM[7] ECU_ADDRESS 0xd00089bf BIT_MASK 0x1 /end MEASUREMENT
/begin MEASUREMENT lv_err_cyl_bal_er[0] "Cylinder balancing error detected - output of CYBL_ER concerned" UBYTE _CNV_S_2_RANGE__0___1_CM 1 100. 0. 1. DISPLAY_IDENTIFIER LV_ERR_CYL_BAL_ER[0] ECU_ADDRESS 0xd00089c0 BIT_MASK 0x1 /end MEASUREMENT
/begin MEASUREMENT lv_err_cyl_bal_er[1] "Cylinder balancing error detected - output of CYBL_ER concerned" UBYTE _CNV_S_2_RANGE__0___1_CM 1 100. 0. 1. DISPLAY_IDENTIFIER LV_ERR_CYL_BAL_ER[1] ECU_ADDRESS 0xd00089c1 BIT_MASK 0x1 /end MEASUREMENT
/begin MEASUREMENT lv_err_cyl_bal_er[2] "Cylinder balancing error detected - output of CYBL_ER concerned" UBYTE _CNV_S_2_RANGE__0___1_CM 1 100. 0. 1. DISPLAY_IDENTIFIER LV_ERR_CYL_BAL_ER[2] ECU_ADDRESS 0xd00089c2 BIT_MASK 0x1 /end MEASUREMENT
/begin MEASUREMENT lv_err_cyl_bal_er[3] "Cylinder balancing error detected - output of CYBL_ER concerned" UBYTE _CNV_S_2_RANGE__0___1_CM 1 100. 0. 1. DISPLAY_IDENTIFIER LV_ERR_CYL_BAL_ER[3] ECU_ADDRESS 0xd00089c3 BIT_MASK 0x1 /end MEASUREMENT
/begin MEASUREMENT lv_err_cyl_bal_er[4] "Cylinder balancing error detected - output of CYBL_ER concerned" UBYTE _CNV_S_2_RANGE__0___1_CM 1 100. 0. 1. DISPLAY_IDENTIFIER LV_ERR_CYL_BAL_ER[4] ECU_ADDRESS 0xd00089c4 BIT_MASK 0x1 /end MEASUREMENT
/begin MEASUREMENT lv_err_cyl_bal_er[5] "Cylinder balancing error detected - output of CYBL_ER concerned" UBYTE _CNV_S_2_RANGE__0___1_CM 1 100. 0. 1. DISPLAY_IDENTIFIER LV_ERR_CYL_BAL_ER[5] ECU_ADDRESS 0xd00089c5 BIT_MASK 0x1 /end MEASUREMENT
/begin MEASUREMENT lv_err_cyl_bal_er[6] "Cylinder balancing error detected - output of CYBL_ER concerned" UBYTE _CNV_S_2_RANGE__0___1_CM 1 100. 0. 1. DISPLAY_IDENTIFIER LV_ERR_CYL_BAL_ER[6] ECU_ADDRESS 0xd00089c6 BIT_MASK 0x1 /end MEASUREMENT
/begin MEASUREMENT lv_err_cyl_bal_er[7] "Cylinder balancing error detected - output of CYBL_ER concerned" UBYTE _CNV_S_2_RANGE__0___1_CM 1 100. 0. 1. DISPLAY_IDENTIFIER LV_ERR_CYL_BAL_ER[7] ECU_ADDRESS 0xd00089c7 BIT_MASK 0x1 /end MEASUREMENT
/begin MEASUREMENT lv_end_diag_win_cyl_bal_lam[0] "End of diagnosis cycle for similar conditions window - output of CILC concerned" UBYTE _CNV_S_2_RANGE__0___1_CM 1 100. 0. 1. DISPLAY_IDENTIFIER LV_END_DIAG_WIN_CYL_BAL_LAM[0] ECU_ADDRESS 0xd0000920 BIT_MASK 0x1 /end MEASUREMENT
/begin MEASUREMENT lv_end_diag_win_cyl_bal_lam[1] "End of diagnosis cycle for similar conditions window - output of CILC concerned" UBYTE _CNV_S_2_RANGE__0___1_CM 1 100. 0. 1. DISPLAY_IDENTIFIER LV_END_DIAG_WIN_CYL_BAL_LAM[1] ECU_ADDRESS 0xd0000921 BIT_MASK 0x1 /end MEASUREMENT
/begin MEASUREMENT lv_end_diag_win_cyl_bal_lam[2] "End of diagnosis cycle for similar conditions window - output of CILC concerned" UBYTE _CNV_S_2_RANGE__0___1_CM 1 100. 0. 1. DISPLAY_IDENTIFIER LV_END_DIAG_WIN_CYL_BAL_LAM[2] ECU_ADDRESS 0xd0000922 BIT_MASK 0x1 /end MEASUREMENT
/begin MEASUREMENT lv_end_diag_win_cyl_bal_lam[3] "End of diagnosis cycle for similar conditions window - output of CILC concerned" UBYTE _CNV_S_2_RANGE__0___1_CM 1 100. 0. 1. DISPLAY_IDENTIFIER LV_END_DIAG_WIN_CYL_BAL_LAM[3] ECU_ADDRESS 0xd0000923 BIT_MASK 0x1 /end MEASUREMENT
/begin MEASUREMENT lv_end_diag_win_cyl_bal_lam[4] "End of diagnosis cycle for similar conditions window - output of CILC concerned" UBYTE _CNV_S_2_RANGE__0___1_CM 1 100. 0. 1. DISPLAY_IDENTIFIER LV_END_DIAG_WIN_CYL_BAL_LAM[4] ECU_ADDRESS 0xd0000924 BIT_MASK 0x1 /end MEASUREMENT
/begin MEASUREMENT lv_end_diag_win_cyl_bal_lam[5] "End of diagnosis cycle for similar conditions window - output of CILC concerned" UBYTE _CNV_S_2_RANGE__0___1_CM 1 100. 0. 1. DISPLAY_IDENTIFIER LV_END_DIAG_WIN_CYL_BAL_LAM[5] ECU_ADDRESS 0xd0000925 BIT_MASK 0x1 /end MEASUREMENT
/begin MEASUREMENT lv_end_diag_win_cyl_bal_lam[6] "End of diagnosis cycle for similar conditions window - output of CILC concerned" UBYTE _CNV_S_2_RANGE__0___1_CM 1 100. 0. 1. DISPLAY_IDENTIFIER LV_END_DIAG_WIN_CYL_BAL_LAM[6] ECU_ADDRESS 0xd0000926 BIT_MASK 0x1 /end MEASUREMENT
/begin MEASUREMENT lv_end_diag_win_cyl_bal_lam[7] "End of diagnosis cycle for similar conditions window - output of CILC concerned" UBYTE _CNV_S_2_RANGE__0___1_CM 1 100. 0. 1. DISPLAY_IDENTIFIER LV_END_DIAG_WIN_CYL_BAL_LAM[7] ECU_ADDRESS 0xd0000927 BIT_MASK 0x1 /end MEASUREMENT
/begin MEASUREMENT lv_end_diag_win_cyl_bal_er[0] "End of diagnosis cycle for similar conditions window - output of CYBL_ER concerned" UBYTE _CNV_S_2_RANGE__0___1_CM 1 100. 0. 1. DISPLAY_IDENTIFIER LV_END_DIAG_WIN_CYL_BAL_ER[0] ECU_ADDRESS 0xd0000918 BIT_MASK 0x1 /end MEASUREMENT
/begin MEASUREMENT lv_end_diag_win_cyl_bal_er[1] "End of diagnosis cycle for similar conditions window - output of CYBL_ER concerned" UBYTE _CNV_S_2_RANGE__0___1_CM 1 100. 0. 1. DISPLAY_IDENTIFIER LV_END_DIAG_WIN_CYL_BAL_ER[1] ECU_ADDRESS 0xd0000919 BIT_MASK 0x1 /end MEASUREMENT
/begin MEASUREMENT lv_end_diag_win_cyl_bal_er[2] "End of diagnosis cycle for similar conditions window - output of CYBL_ER concerned" UBYTE _CNV_S_2_RANGE__0___1_CM 1 100. 0. 1. DISPLAY_IDENTIFIER LV_END_DIAG_WIN_CYL_BAL_ER[2] ECU_ADDRESS 0xd000091a BIT_MASK 0x1 /end MEASUREMENT
/begin MEASUREMENT lv_end_diag_win_cyl_bal_er[3] "End of diagnosis cycle for similar conditions window - output of CYBL_ER concerned" UBYTE _CNV_S_2_RANGE__0___1_CM 1 100. 0. 1. DISPLAY_IDENTIFIER LV_END_DIAG_WIN_CYL_BAL_ER[3] ECU_ADDRESS 0xd000091b BIT_MASK 0x1 /end MEASUREMENT
/begin MEASUREMENT lv_end_diag_win_cyl_bal_er[4] "End of diagnosis cycle for similar conditions window - output of CYBL_ER concerned" UBYTE _CNV_S_2_RANGE__0___1_CM 1 100. 0. 1. DISPLAY_IDENTIFIER LV_END_DIAG_WIN_CYL_BAL_ER[4] ECU_ADDRESS 0xd000091c BIT_MASK 0x1 /end MEASUREMENT
/begin MEASUREMENT lv_end_diag_win_cyl_bal_er[5] "End of diagnosis cycle for similar conditions window - output of CYBL_ER concerned" UBYTE _CNV_S_2_RANGE__0___1_CM 1 100. 0. 1. DISPLAY_IDENTIFIER LV_END_DIAG_WIN_CYL_BAL_ER[5] ECU_ADDRESS 0xd000091d BIT_MASK 0x1 /end MEASUREMENT
/begin MEASUREMENT lv_end_diag_win_cyl_bal_er[6] "End of diagnosis cycle for similar conditions window - output of CYBL_ER concerned" UBYTE _CNV_S_2_RANGE__0___1_CM 1 100. 0. 1. DISPLAY_IDENTIFIER LV_END_DIAG_WIN_CYL_BAL_ER[6] ECU_ADDRESS 0xd000091e BIT_MASK 0x1 /end MEASUREMENT
/begin MEASUREMENT lv_end_diag_win_cyl_bal_er[7] "End of diagnosis cycle for similar conditions window - output of CYBL_ER concerned" UBYTE _CNV_S_2_RANGE__0___1_CM 1 100. 0. 1. DISPLAY_IDENTIFIER LV_END_DIAG_WIN_CYL_BAL_ER[7] ECU_ADDRESS 0xd000091f BIT_MASK 0x1 /end MEASUREMENT
/begin MEASUREMENT t_sum_rst_cyl_bal_er[0] "Timer to update the diagnosis window - output of CYBL_ER concerned" UWORD _CNV_A_R_LINEAR_____4_CM 1 100. 0. 6553.5 DISPLAY_IDENTIFIER T_SUM_RST_CYL_BAL_ER[0] ECU_ADDRESS 0xd00008e8 FORMAT "%6.1" /end MEASUREMENT
/begin MEASUREMENT t_sum_rst_cyl_bal_er[1] "Timer to update the diagnosis window - output of CYBL_ER concerned" UWORD _CNV_A_R_LINEAR_____4_CM 1 100. 0. 6553.5 DISPLAY_IDENTIFIER T_SUM_RST_CYL_BAL_ER[1] ECU_ADDRESS 0xd00008ea FORMAT "%6.1" /end MEASUREMENT
/begin MEASUREMENT t_sum_rst_cyl_bal_er[2] "Timer to update the diagnosis window - output of CYBL_ER concerned" UWORD _CNV_A_R_LINEAR_____4_CM 1 100. 0. 6553.5 DISPLAY_IDENTIFIER T_SUM_RST_CYL_BAL_ER[2] ECU_ADDRESS 0xd00008ec FORMAT "%6.1" /end MEASUREMENT
/begin MEASUREMENT t_sum_rst_cyl_bal_er[3] "Timer to update the diagnosis window - output of CYBL_ER concerned" UWORD _CNV_A_R_LINEAR_____4_CM 1 100. 0. 6553.5 DISPLAY_IDENTIFIER T_SUM_RST_CYL_BAL_ER[3] ECU_ADDRESS 0xd00008ee FORMAT "%6.1" /end MEASUREMENT
/begin MEASUREMENT t_sum_rst_cyl_bal_er[4] "Timer to update the diagnosis window - output of CYBL_ER concerned" UWORD _CNV_A_R_LINEAR_____4_CM 1 100. 0. 6553.5 DISPLAY_IDENTIFIER T_SUM_RST_CYL_BAL_ER[4] ECU_ADDRESS 0xd00008f0 FORMAT "%6.1" /end MEASUREMENT
/begin MEASUREMENT t_sum_rst_cyl_bal_er[5] "Timer to update the diagnosis window - output of CYBL_ER concerned" UWORD _CNV_A_R_LINEAR_____4_CM 1 100. 0. 6553.5 DISPLAY_IDENTIFIER T_SUM_RST_CYL_BAL_ER[5] ECU_ADDRESS 0xd00008f2 FORMAT "%6.1" /end MEASUREMENT
/begin MEASUREMENT t_sum_rst_cyl_bal_er[6] "Timer to update the diagnosis window - output of CYBL_ER concerned" UWORD _CNV_A_R_LINEAR_____4_CM 1 100. 0. 6553.5 DISPLAY_IDENTIFIER T_SUM_RST_CYL_BAL_ER[6] ECU_ADDRESS 0xd00008f4 FORMAT "%6.1" /end MEASUREMENT
/begin MEASUREMENT t_sum_rst_cyl_bal_er[7] "Timer to update the diagnosis window - output of CYBL_ER concerned" UWORD _CNV_A_R_LINEAR_____4_CM 1 100. 0. 6553.5 DISPLAY_IDENTIFIER T_SUM_RST_CYL_BAL_ER[7] ECU_ADDRESS 0xd00008f6 FORMAT "%6.1" /end MEASUREMENT
/begin MEASUREMENT ctr_err_obd_diag_cyl_bal_lam[0] "Anti-bounce-counter for detected error up to current driving cycle (output of CILC concerned)" UBYTE _CNV_A_R_LINEAR_____0_CM 1 100. 0. 255. DISPLAY_IDENTIFIER CTR_ERR_OBD_DIAG_CYL_BAL_LAM[1] ECU_ADDRESS 0xd00089b0 FORMAT "%3.0" /end MEASUREMENT
/begin MEASUREMENT ctr_err_obd_diag_cyl_bal_lam[1] "Anti-bounce-counter for detected error up to current driving cycle (output of CILC concerned)" UBYTE _CNV_A_R_LINEAR_____0_CM 1 100. 0. 255. DISPLAY_IDENTIFIER CTR_ERR_OBD_DIAG_CYL_BAL_LAM[2] ECU_ADDRESS 0xd00089b1 FORMAT "%3.0" /end MEASUREMENT
/begin MEASUREMENT ctr_err_obd_diag_cyl_bal_er "Anti-bounce-counter for detected error up to current driving cycle (output of CYBL_ER concerned)" UBYTE _CNV_A_R_LINEAR_____0_CM 1 100. 0. 255. DISPLAY_IDENTIFIER CTR_ERR_OBD_DIAG_CYL_BAL_ER ECU_ADDRESS 0xd00089b2 FORMAT "%3.0" /end MEASUREMENT
/begin CHARACTERISTIC c_t_sum_min_cyl_bal_lim "Minimum run-off time for error detection" VALUE 0xa080c274 _REC_VAL_20_u2 6553.400000000001 _CNV_A_R_LINEAR_____4_CM 0.1 6553.5 DISPLAY_IDENTIFIER C_T_SUM_MIN_CYL_BAL_LIM FORMAT "%6.1" /end CHARACTERISTIC
/begin CHARACTERISTIC c_t_sum_rst_max_cyl_bal "Diagnosis time interval " VALUE 0xa080c276 _REC_VAL_20_u2 6553.400000000001 _CNV_A_R_LINEAR_____4_CM 0.1 6553.5 DISPLAY_IDENTIFIER C_T_SUM_RST_MAX_CYL_BAL FORMAT "%6.1" /end CHARACTERISTIC
/begin CHARACTERISTIC c_ctr_max_cyl_bal_lam_err "Threshold of anti-bounce-counter to set the inhibit flag for cylinder individual lambda control" VALUE 0xa080bba9 _REC_VAL_20_u1 254. _CNV_A_R_LINEAR_____0_CM 1. 255. DISPLAY_IDENTIFIER C_CTR_MAX_CYL_BAL_LAM_ERR FORMAT "%3.0" /end CHARACTERISTIC
/begin CHARACTERISTIC c_ctr_inc_err_obd_diag_cyl_bal "Increment constant of anti-bounce-counter" VALUE 0xa080bb9c _REC_VAL_20_u1 255. _CNV_A_R_LINEAR_____0_CM 0. 255. DISPLAY_IDENTIFIER C_CTR_INC_ERR_OBD_DIAG_CYL_BAL FORMAT "%3.0" /end CHARACTERISTIC
/begin CHARACTERISTIC c_ctr_dec_err_obd_diag_cyl_bal "Decrement constant of anti-bounce-counter" VALUE 0xa080bb44 _REC_VAL_20_u1 255. _CNV_A_R_LINEAR_____0_CM 0. 255. DISPLAY_IDENTIFIER C_CTR_DEC_ERR_OBD_DIAG_CYL_BAL FORMAT "%3.0" /end CHARACTERISTIC
/begin CHARACTERISTIC c_ctr_max_cyl_bal_er_err "Threshold of anti-bounce-counter to set the inhibit flag for CYBL_ER" VALUE 0xa080bba8 _REC_VAL_20_u1 254. _CNV_A_R_LINEAR_____0_CM 1. 255. DISPLAY_IDENTIFIER C_CTR_MAX_CYL_BAL_ER_ERR FORMAT "%3.0" /end CHARACTERISTIC
/begin CHARACTERISTIC c_t_sum_thd_cyl_bal_lim "Time threshold to set the error flag" VALUE 0xa080c278 _REC_VAL_20_u2 6553.400000000001 _CNV_A_R_LINEAR_____4_CM 0.1 6553.5 DISPLAY_IDENTIFIER C_T_SUM_THD_CYL_BAL_LIM FORMAT "%6.1" /end CHARACTERISTIC
/begin CHARACTERISTIC lc_ctr_err_obd_diag_cyl_bal "Anti-bounce-counter reset" VALUE 0xa080c544 _REC_VAL_20_u1 1. _CNV_A_R_LINEAR_____0_CM 0. 1. DISPLAY_IDENTIFIER LC_CTR_ERR_OBD_DIAG_CYL_BAL FORMAT "%1.0" /end CHARACTERISTIC
/begin MEASUREMENT lv_inh_obd_diag_cyl_bal_lam[0] "Inhibit flag for CILC - cylinder balancing error detected over several driving cycles" UBYTE _CNV_S_2_RANGE__0___1_CM 1 100. 0. 1. DISPLAY_IDENTIFIER LV_INH_OBD_DIAG_CYL_BAL_LAM[1] ECU_ADDRESS 0xd00089b4 BIT_MASK 0x1 /end MEASUREMENT
/begin MEASUREMENT lv_inh_obd_diag_cyl_bal_lam[1] "Inhibit flag for CILC - cylinder balancing error detected over several driving cycles" UBYTE _CNV_S_2_RANGE__0___1_CM 1 100. 0. 1. DISPLAY_IDENTIFIER LV_INH_OBD_DIAG_CYL_BAL_LAM[2] ECU_ADDRESS 0xd00089b5 BIT_MASK 0x1 /end MEASUREMENT
/begin MEASUREMENT lv_err_ref_cyl_bal_lam[0] "Reference flag indicating the CILC - error was occurred at least once for the current driving cycle" UBYTE _CNV_S_2_RANGE__0___1_CM 1 100. 0. 1. DISPLAY_IDENTIFIER LV_ERR_REF_CYL_BAL_LAM[1] ECU_ADDRESS 0xd000092a BIT_MASK 0x1 /end MEASUREMENT
/begin MEASUREMENT lv_err_ref_cyl_bal_lam[1] "Reference flag indicating the CILC - error was occurred at least once for the current driving cycle" UBYTE _CNV_S_2_RANGE__0___1_CM 1 100. 0. 1. DISPLAY_IDENTIFIER LV_ERR_REF_CYL_BAL_LAM[2] ECU_ADDRESS 0xd000092b BIT_MASK 0x1 /end MEASUREMENT
/begin MEASUREMENT lv_inh_obd_diag_cyl_bal_er "Inhibit flag for CYBL_ER - cylinder balancing error detected over several driving cycles" UBYTE _CNV_S_2_RANGE__0___1_CM 1 100. 0. 1. DISPLAY_IDENTIFIER LV_INH_OBD_DIAG_CYL_BAL_ER ECU_ADDRESS 0xd00089b6 BIT_MASK 0x1 /end MEASUREMENT
/begin MEASUREMENT lv_err_ref_cyl_bal_er "Reference flag indicating the CYBL_ER - error was occurred at least once for the current driving cycle" UBYTE _CNV_S_2_RANGE__0___1_CM 1 100. 0. 1. DISPLAY_IDENTIFIER LV_ERR_REF_CYL_BAL_ER ECU_ADDRESS 0xd0000928 BIT_MASK 0x1 /end MEASUREMENT
/begin MEASUREMENT lv_cyl_bal_lam_sel_ad_hot_dc "Flag for cylinder balancing cylinder selective lambda adaptation (hot) at active driving cycle" UBYTE _CNV_S_2_RANGE__0___1_CM 1 100. 0. 1. DISPLAY_IDENTIFIER LV_CYL_BAL_LAM_SEL_AD_HOT_DC ECU_ADDRESS 0xd0008cc5 BIT_MASK 0x1 /end MEASUREMENT
/begin MEASUREMENT lv_cyl_bal_lam_ad_add_dc[0] "Flag for cylinder balancing lambda adaptation (additive) exhaust bank specific at active driving cycle" UBYTE _CNV_S_2_RANGE__0___1_CM 1 100. 0. 1. DISPLAY_IDENTIFIER LV_CYL_BAL_LAM_AD_ADD_DC[1] ECU_ADDRESS 0xd0008cd0 BIT_MASK 0x1 /end MEASUREMENT
/begin MEASUREMENT lv_cyl_bal_lam_ad_add_dc[1] "Flag for cylinder balancing lambda adaptation (additive) exhaust bank specific at active driving cycle" UBYTE _CNV_S_2_RANGE__0___1_CM 1 100. 0. 1. DISPLAY_IDENTIFIER LV_CYL_BAL_LAM_AD_ADD_DC[2] ECU_ADDRESS 0xd0008cd1 BIT_MASK 0x1 /end MEASUREMENT
/begin MEASUREMENT lv_cyl_bal_lam_ad_fac_l_dc[0] "Flag for cylinder balancing lambda adaptation (multiple low) exhaust bank specific at active driving cycle" UBYTE _CNV_S_2_RANGE__0___1_CM 1 100. 0. 1. DISPLAY_IDENTIFIER LV_CYL_BAL_LAM_AD_FAC_L_DC[1] ECU_ADDRESS 0xd0008cd2 BIT_MASK 0x1 /end MEASUREMENT
/begin MEASUREMENT lv_cyl_bal_lam_ad_fac_l_dc[1] "Flag for cylinder balancing lambda adaptation (multiple low) exhaust bank specific at active driving cycle" UBYTE _CNV_S_2_RANGE__0___1_CM 1 100. 0. 1. DISPLAY_IDENTIFIER LV_CYL_BAL_LAM_AD_FAC_L_DC[2] ECU_ADDRESS 0xd0008cd3 BIT_MASK 0x1 /end MEASUREMENT
/begin MEASUREMENT lv_cyl_bal_lam_ad_fac_h_dc[0] "Flag for cylinder balancing lambda adaptation (multiple high) exhaust bank specific at active driving cycle" UBYTE _CNV_S_2_RANGE__0___1_CM 1 100. 0. 1. DISPLAY_IDENTIFIER LV_CYL_BAL_LAM_AD_FAC_H_DC[1] ECU_ADDRESS 0xd0008cd4 BIT_MASK 0x1 /end MEASUREMENT
/begin MEASUREMENT lv_cyl_bal_lam_ad_fac_h_dc[1] "Flag for cylinder balancing lambda adaptation (multiple high) exhaust bank specific at active driving cycle" UBYTE _CNV_S_2_RANGE__0___1_CM 1 100. 0. 1. DISPLAY_IDENTIFIER LV_CYL_BAL_LAM_AD_FAC_H_DC[2] ECU_ADDRESS 0xd0008cd5 BIT_MASK 0x1 /end MEASUREMENT
/begin CHARACTERISTIC lc_cyl_bal_cord_dc_stop_man "Logical constant for manual stop (=1) of cylinder balancing coordination at driving cycle" VALUE 0xa080c547 _REC_VAL_20_u1 1. _CNV_A_R_LINEAR_____0_CM 0. 1. DISPLAY_IDENTIFIER LC_CYL_BAL_CORD_DC_STOP_MAN FORMAT "%1.0" /end CHARACTERISTIC
/begin CHARACTERISTIC lc_cyl_bal_ad_dc_rst "Manual switch for cylinder balancing adaptation reset at active driving cycle" VALUE 0xa080c545 _REC_VAL_20_u1 1. _CNV_A_R_LINEAR_____0_CM 0. 1. DISPLAY_IDENTIFIER LC_CYL_BAL_AD_DC_RST FORMAT "%1.0" /end CHARACTERISTIC
/begin MEASUREMENT lv_cyl_bal_lam_ad_stop[0] "Flag to indicate stop of lambda adaptation cycle for cylinder balancing at active driving cycle" UBYTE _CNV_S_2_RANGE__0___1_CM 1 100. 0. 1. DISPLAY_IDENTIFIER LV_CYL_BAL_LAM_AD_STOP[1] ECU_ADDRESS 0xd0008cd6 BIT_MASK 0x1 /end MEASUREMENT
/begin MEASUREMENT lv_cyl_bal_lam_ad_stop[1] "Flag to indicate stop of lambda adaptation cycle for cylinder balancing at active driving cycle" UBYTE _CNV_S_2_RANGE__0___1_CM 1 100. 0. 1. DISPLAY_IDENTIFIER LV_CYL_BAL_LAM_AD_STOP[2] ECU_ADDRESS 0xd0008cd7 BIT_MASK 0x1 /end MEASUREMENT
/begin MEASUREMENT lv_cyl_bal_ad_wg_open_req[0] "Flag for waste gate open requested for cylinder balancing adaptation " UBYTE _CNV_S_2_RANGE__0___1_CM 1 100. 0. 1. DISPLAY_IDENTIFIER LV_CYL_BAL_AD_WG_OPEN_REQ[1] ECU_ADDRESS 0xd0008cc8 BIT_MASK 0x1 /end MEASUREMENT
/begin MEASUREMENT lv_cyl_bal_ad_wg_open_req[1] "Flag for waste gate open requested for cylinder balancing adaptation " UBYTE _CNV_S_2_RANGE__0___1_CM 1 100. 0. 1. DISPLAY_IDENTIFIER LV_CYL_BAL_AD_WG_OPEN_REQ[2] ECU_ADDRESS 0xd0008cc9 BIT_MASK 0x1 /end MEASUREMENT
/begin MEASUREMENT lv_cyl_bal_ad_wg_open_req_dc[0] "Flag for waste gate open requested for cylinder balancing adaptation at active driving cycle" UBYTE _CNV_S_2_RANGE__0___1_CM 1 100. 0. 1. DISPLAY_IDENTIFIER LV_CYL_BAL_AD_WG_OPEN_REQ_DC[1] ECU_ADDRESS 0xd0000784 BIT_MASK 0x1 /end MEASUREMENT
/begin MEASUREMENT lv_cyl_bal_ad_wg_open_req_dc[1] "Flag for waste gate open requested for cylinder balancing adaptation at active driving cycle" UBYTE _CNV_S_2_RANGE__0___1_CM 1 100. 0. 1. DISPLAY_IDENTIFIER LV_CYL_BAL_AD_WG_OPEN_REQ_DC[2] ECU_ADDRESS 0xd0000785 BIT_MASK 0x1 /end MEASUREMENT
/begin CHARACTERISTIC c_fac_mff_lam_adj_cyl_bal_dc "Lambda additive threshold for cylinder balancing lambda adaptation at active driving cycle" VALUE 0xa080bce2 _REC_VAL_20_s2 99.99847412109381 _CNV_A_R_LINEAR_____113_CM -50. 49.9984741210938 DISPLAY_IDENTIFIER C_FAC_MFF_LAM_ADJ_CYL_BAL_DC FORMAT "%7.3" /end CHARACTERISTIC
/begin CHARACTERISTIC c_cyl_bal_ad_dc_rst "Reset of cylinder balancing adaptation readiness flags at active driving cycle" VALUE 0xa080bc2b _REC_VAL_20_u1 6. _CNV_S_7_RANGE_C_CY_136_CM 0. 6. DISPLAY_IDENTIFIER C_CYL_BAL_AD_DC_RST /end CHARACTERISTIC
/begin MEASUREMENT lv_cyl_bal_ad_hom_req_dc "Flag for homogenous combustion mode for cylinder balancing adaptation requested at active driving cycle" UBYTE _CNV_S_2_RANGE__0___1_CM 1 100. 0. 1. DISPLAY_IDENTIFIER LV_CYL_BAL_AD_HOM_REQ_DC ECU_ADDRESS 0xd0008cc7 BIT_MASK 0x1 /end MEASUREMENT
/begin MEASUREMENT lv_cyl_bal_lam_ad_dc "Flag for cylinder balancing lambda adaptation at active driving cycle" UBYTE _CNV_S_2_RANGE__0___1_CM 1 100. 0. 1. DISPLAY_IDENTIFIER LV_CYL_BAL_LAM_AD_DC ECU_ADDRESS 0xd0008cc4 BIT_MASK 0x1 /end MEASUREMENT
/begin MEASUREMENT lv_cyl_bal_lam_ad_hom_req_dc "Flag for HOM request for cylinder balancing lambda adaptation at active driving cycle" UBYTE _CNV_S_2_RANGE__0___1_CM 1 100. 0. 1. DISPLAY_IDENTIFIER LV_CYL_BAL_LAM_AD_HOM_REQ_DC ECU_ADDRESS 0xd000078f BIT_MASK 0x1 /end MEASUREMENT
/begin MEASUREMENT lv_cyl_bal_lam_sel_hom_req_dc "Flag for HOM request for cylinder balancing selective lambda adaptation at active driving cycle" UBYTE _CNV_S_2_RANGE__0___1_CM 1 100. 0. 1. DISPLAY_IDENTIFIER LV_CYL_BAL_LAM_SEL_HOM_REQ_DC ECU_ADDRESS 0xd000078e BIT_MASK 0x1 /end MEASUREMENT
/begin MEASUREMENT lv_state_lam_ad_dc_chg_req "Flag for stage change to \"request\" for cylinder balancing lambda adaptation at active driving cycle" UBYTE _CNV_S_2_RANGE__0___1_CM 1 100. 0. 1. DISPLAY_IDENTIFIER LV_STATE_LAM_AD_DC_CHG_REQ ECU_ADDRESS 0xd0000788 BIT_MASK 0x1 /end MEASUREMENT
/begin MEASUREMENT lv_state_lam_ad_dc_chg_wait "Flag for stage change to \"wait\" for cylinder balancing lambda adaptation at active driving cycle" UBYTE _CNV_S_2_RANGE__0___1_CM 1 100. 0. 1. DISPLAY_IDENTIFIER LV_STATE_LAM_AD_DC_CHG_WAIT ECU_ADDRESS 0xd0000789 BIT_MASK 0x1 /end MEASUREMENT
/begin MEASUREMENT lv_state_lam_sel_dc_chg_wait "Flag for stage change to \"wait\" for cylinder balancing selective lambda adaptation at active driving cycle" UBYTE _CNV_S_2_RANGE__0___1_CM 1 100. 0. 1. DISPLAY_IDENTIFIER LV_STATE_LAM_SEL_DC_CHG_WAIT ECU_ADDRESS 0xd0000787 BIT_MASK 0x1 /end MEASUREMENT
/begin MEASUREMENT lv_state_lam_sel_dc_chg_req "Flag for stage change to \"request\" for cylinder balancing selective lambda adaptation at active driving cycle" UBYTE _CNV_S_2_RANGE__0___1_CM 1 100. 0. 1. DISPLAY_IDENTIFIER LV_STATE_LAM_SEL_DC_CHG_REQ ECU_ADDRESS 0xd0000786 BIT_MASK 0x1 /end MEASUREMENT
/begin MEASUREMENT state_cyl_bal_lam_ad_dc "State of cylinder balancing lambda adaptation at active driving cycle" UBYTE _CNV_S_3_RANGE_STAT_137_CM 1 100. 0. 2. DISPLAY_IDENTIFIER STATE_CYL_BAL_LAM_AD_DC ECU_ADDRESS 0xd0000791 /end MEASUREMENT
/begin MEASUREMENT state_cyl_bal_lam_sel_ad_dc "State of cylinder balancing cylinder selective lambda adaptation at active driving cycle" UBYTE _CNV_S_3_RANGE_STAT_137_CM 1 100. 0. 2. DISPLAY_IDENTIFIER STATE_CYL_BAL_LAM_SEL_AD_DC ECU_ADDRESS 0xd0000790 /end MEASUREMENT
/begin MEASUREMENT t_cyl_bal_lam_ad_req_dc[0] "Time for cylinder balancing lambda adaptation request at active driving cycle" UWORD _CNV_A_R_LINEAR_____4_CM 1 100. 0. 6553.5 DISPLAY_IDENTIFIER T_CYL_BAL_LAM_AD_REQ_DC[1] ECU_ADDRESS 0xd0000764 FORMAT "%6.1" /end MEASUREMENT
/begin MEASUREMENT t_cyl_bal_lam_ad_req_dc[1] "Time for cylinder balancing lambda adaptation request at active driving cycle" UWORD _CNV_A_R_LINEAR_____4_CM 1 100. 0. 6553.5 DISPLAY_IDENTIFIER T_CYL_BAL_LAM_AD_REQ_DC[2] ECU_ADDRESS 0xd0000766 FORMAT "%6.1" /end MEASUREMENT
/begin MEASUREMENT t_cyl_bal_lam_sel_ad_req_dc[0] "Time for cylinder balancing selective lambda adaptation request at active driving cycle" UWORD _CNV_A_R_LINEAR_____4_CM 1 100. 0. 6553.5 DISPLAY_IDENTIFIER T_CYL_BAL_LAM_SEL_AD_REQ_DC[1] ECU_ADDRESS 0xd0000760 FORMAT "%6.1" /end MEASUREMENT
/begin MEASUREMENT t_cyl_bal_lam_sel_ad_req_dc[1] "Time for cylinder balancing selective lambda adaptation request at active driving cycle" UWORD _CNV_A_R_LINEAR_____4_CM 1 100. 0. 6553.5 DISPLAY_IDENTIFIER T_CYL_BAL_LAM_SEL_AD_REQ_DC[2] ECU_ADDRESS 0xd0000762 FORMAT "%6.1" /end MEASUREMENT
/begin MEASUREMENT t_cyl_bal_lam_ad_wait_dc "Waiting time for cylinder balancing lambda adaptation activation at active driving cycle" UWORD _CNV_A_R_LINEAR_____4_CM 1 100. 0. 6553.5 DISPLAY_IDENTIFIER T_CYL_BAL_LAM_AD_WAIT_DC ECU_ADDRESS 0xd0000776 FORMAT "%6.1" /end MEASUREMENT
/begin MEASUREMENT t_cyl_bal_lam_sel_ad_wait_dc "Waiting time for cylinder balancing selective lambda adaptation activation at active driving cycle" UWORD _CNV_A_R_LINEAR_____4_CM 1 100. 0. 6553.5 DISPLAY_IDENTIFIER T_CYL_BAL_LAM_SEL_AD_WAIT_DC ECU_ADDRESS 0xd0000774 FORMAT "%6.1" /end MEASUREMENT
/begin CHARACTERISTIC c_t_ast_max_cyl_bal_ad_dc "Maximum time after start for control of cylinder balancing selective lambda adaptation at active driving cycle" VALUE 0xa080c130 _REC_VAL_20_u2 6553.5 _CNV_A_R_LINEAR_____4_CM 0. 6553.5 DISPLAY_IDENTIFIER C_T_AST_MAX_CYL_BAL_AD_DC FORMAT "%6.1" /end CHARACTERISTIC
/begin CHARACTERISTIC id_t_cyl_bal_lam_sel_ad_dc "Time intervals for control of cylinder balancing selective lambda adaptation at active driving cycle" CURVE 0xa0809e34 _REC_CUR_20_u2_u2 6553.5 _CNV_A_R_LINEAR_____4_CM 0. 6553.5 DISPLAY_IDENTIFIER ID_T_CYL_BAL_LAM_SEL_AD_DC FORMAT "%6.1"
 /begin AXIS_DESCR COM_AXIS t_ast _CNV_A_R_LINEAR_____4_CM 8 0. 6553.5 FORMAT "%6.1" AXIS_PTS_REF ldp_t_ast_id_t_bal_lam_sel_dc /end AXIS_DESCR
/end CHARACTERISTIC
/begin CHARACTERISTIC c_t_min_cyl_bal_ad_req_dc "Minimum time for cylinder balancing adaptation conditions within limits at active driving cycle" VALUE 0xa080c210 _REC_VAL_20_u2 6553.5 _CNV_A_R_LINEAR_____4_CM 0. 6553.5 DISPLAY_IDENTIFIER C_T_MIN_CYL_BAL_AD_REQ_DC FORMAT "%6.1" /end CHARACTERISTIC
/begin CHARACTERISTIC c_t_min_cyl_bal_ad_wait_dc "Minimum waiting time at entry to state adaptation for cylinder balancing adaptation at active driving cycle" VALUE 0xa080c212 _REC_VAL_20_u2 6553.5 _CNV_A_R_LINEAR_____4_CM 0. 6553.5 DISPLAY_IDENTIFIER C_T_MIN_CYL_BAL_AD_WAIT_DC FORMAT "%6.1" /end CHARACTERISTIC
/begin CHARACTERISTIC c_tco_st_max_cyl_bal_ad_dc "Maximum TCO_ST start for control of cylinder balancing selective lambda adaptation at active driving cycle" VALUE 0xa080c2e0 _REC_VAL_20_u1 190.5 _CNV_A_R_LINEAR_____17_CM -48. 142.5 DISPLAY_IDENTIFIER C_TCO_ST_MAX_CYL_BAL_AD_DC FORMAT "%6.2" /end CHARACTERISTIC
/begin CHARACTERISTIC c_tco_st_min_cyl_bal_ad_dc "Minimum TCO_ST start for control of cylinder balancing selective lambda adaptation at active driving cycle" VALUE 0xa080c2e2 _REC_VAL_20_u1 190.5 _CNV_A_R_LINEAR_____17_CM -48. 142.5 DISPLAY_IDENTIFIER C_TCO_ST_MIN_CYL_BAL_AD_DC FORMAT "%6.2" /end CHARACTERISTIC
/begin CHARACTERISTIC c_fac_cyl_lam_absv_sum_bal_dc "Threshold for cylinder balancing cylinder selective lambda adaptation within limits at active driving cycle" VALUE 0xa080bcbe _REC_VAL_20_u2 49.99847412 _CNV_A_R_LINEAR_____125_CM 0. 49.99847412 DISPLAY_IDENTIFIER C_FAC_CYL_LAM_ABSV_SUM_BAL_DC /end CHARACTERISTIC
/begin CHARACTERISTIC c_cyl_bal_lam_ad_dc_conf "Configuration of lambda adaptation correction values for cylinder balancing at active driving cycle" VALUE 0xa080bc2d _REC_VAL_20_u1 3. _CNV_S_4_RANGE_C_CY_138_CM 0. 3. DISPLAY_IDENTIFIER C_CYL_BAL_LAM_AD_DC_CONF /end CHARACTERISTIC
/begin CHARACTERISTIC c_cyl_bal_lam_sel_hot_dc_conf "Configuration of lambda adaptation correction values for cylinder balancing at active driving cycle" VALUE 0xa080bc2f _REC_VAL_20_u1 2. _CNV_S_3_RANGE_C_CY_139_CM 0. 2. DISPLAY_IDENTIFIER C_CYL_BAL_LAM_SEL_HOT_DC_CONF /end CHARACTERISTIC
/begin MEASUREMENT lv_cyl_bal_lam_sel_ad_rng_l_dc[0] "Flag for cylinder balancing cylinder selective lambda adaptation (low range) bank specific at active driving cycle" UBYTE _CNV_S_2_RANGE__0___1_CM 1 100. 0. 1. DISPLAY_IDENTIFIER LV_CYL_BAL_LAM_SEL_AD_RNG_L_DC[0] ECU_ADDRESS 0xd0008cca BIT_MASK 0x1 /end MEASUREMENT
/begin MEASUREMENT lv_cyl_bal_lam_sel_ad_rng_l_dc[1] "Flag for cylinder balancing cylinder selective lambda adaptation (low range) bank specific at active driving cycle" UBYTE _CNV_S_2_RANGE__0___1_CM 1 100. 0. 1. DISPLAY_IDENTIFIER LV_CYL_BAL_LAM_SEL_AD_RNG_L_DC[1] ECU_ADDRESS 0xd0008ccb BIT_MASK 0x1 /end MEASUREMENT
/begin MEASUREMENT lv_cyl_bal_lam_sel_ad_rng_h_dc[0] "Flag for cylinder balancing cylinder selective lambda adaptation (high range) bank specific at active driving cycle" UBYTE _CNV_S_2_RANGE__0___1_CM 1 100. 0. 1. DISPLAY_IDENTIFIER LV_CYL_BAL_LAM_SEL_AD_RNG_H_DC[0] ECU_ADDRESS 0xd0008ccc BIT_MASK 0x1 /end MEASUREMENT
/begin MEASUREMENT lv_cyl_bal_lam_sel_ad_rng_h_dc[1] "Flag for cylinder balancing cylinder selective lambda adaptation (high range) bank specific at active driving cycle" UBYTE _CNV_S_2_RANGE__0___1_CM 1 100. 0. 1. DISPLAY_IDENTIFIER LV_CYL_BAL_LAM_SEL_AD_RNG_H_DC[1] ECU_ADDRESS 0xd0008ccd BIT_MASK 0x1 /end MEASUREMENT
/begin MEASUREMENT lv_cyl_bal_lam_sel_ad_cold_dc "Flag for cylinder balancing cylinder selective lambda adaptation (cold) at active driving cycle" UBYTE _CNV_S_2_RANGE__0___1_CM 1 100. 0. 1. DISPLAY_IDENTIFIER LV_CYL_BAL_LAM_SEL_AD_COLD_DC ECU_ADDRESS 0xd0008cc6 BIT_MASK 0x1 /end MEASUREMENT
/begin MEASUREMENT lv_cyl_bal_lam_ad_ena_dc "Flag for EVAC time controller to enable lambda adaptation area for active driving cycle" UBYTE _CNV_S_2_RANGE__0___1_CM 1 100. 0. 1. DISPLAY_IDENTIFIER LV_CYL_BAL_LAM_AD_ENA_DC ECU_ADDRESS 0xd0008cd8 BIT_MASK 0x1 /end MEASUREMENT
/begin MEASUREMENT t_cyl_bal_lam_ad_dc "Time gap between cylinder balancing lambda adaptation parts at active driving cycle" UWORD _CNV_A_R_LINEAR_____4_CM 1 100. 0. 6553.5 DISPLAY_IDENTIFIER T_CYL_BAL_LAM_AD_DC ECU_ADDRESS 0xd000a8fe FORMAT "%6.1" /end MEASUREMENT
/begin MEASUREMENT t_cyl_bal_lam_sel_dc "Time gap between cylinder balancing cylinder selective lambda adaptation parts at active ariving cycle" UWORD _CNV_A_R_LINEAR_____4_CM 1 100. 0. 6553.5 DISPLAY_IDENTIFIER T_CYL_BAL_LAM_SEL_DC ECU_ADDRESS 0xd000a8fc FORMAT "%6.1" /end MEASUREMENT
/begin MEASUREMENT t_cyl_bal_lam_sel_ad_rng_l_dc[0] "Time for cylinder balancing cylinder selective lambda adaptation (low range) bank specific at active driving cycle" UWORD _CNV_A_R_LINEAR_____4_CM 1 100. 0. 6553.5 DISPLAY_IDENTIFIER T_CYL_BAL_LAM_SEL_AD_RNG_L_DC[0] ECU_ADDRESS 0xd0000768 FORMAT "%6.1" /end MEASUREMENT
/begin MEASUREMENT t_cyl_bal_lam_sel_ad_rng_l_dc[1] "Time for cylinder balancing cylinder selective lambda adaptation (low range) bank specific at active driving cycle" UWORD _CNV_A_R_LINEAR_____4_CM 1 100. 0. 6553.5 DISPLAY_IDENTIFIER T_CYL_BAL_LAM_SEL_AD_RNG_L_DC[1] ECU_ADDRESS 0xd000076a FORMAT "%6.1" /end MEASUREMENT
/begin MEASUREMENT t_cyl_bal_lam_sel_ad_rng_h_dc[0] "Time for cylinder balancing cylinder selective lambda adaptation (high range) bank specific at active driving cycle" UWORD _CNV_A_R_LINEAR_____4_CM 1 100. 0. 6553.5 DISPLAY_IDENTIFIER T_CYL_BAL_LAM_SEL_AD_RNG_H_DC[0] ECU_ADDRESS 0xd000076c FORMAT "%6.1" /end MEASUREMENT
/begin MEASUREMENT t_cyl_bal_lam_sel_ad_rng_h_dc[1] "Time for cylinder balancing cylinder selective lambda adaptation (high range) bank specific at active driving cycle" UWORD _CNV_A_R_LINEAR_____4_CM 1 100. 0. 6553.5 DISPLAY_IDENTIFIER T_CYL_BAL_LAM_SEL_AD_RNG_H_DC[1] ECU_ADDRESS 0xd000076e FORMAT "%6.1" /end MEASUREMENT
/begin MEASUREMENT lv_cyl_bal_lam_sel_rng_cold_dc[0] "Flag for cylinder balancing cylinder selective lambda adaptation (cold range) bank specific at active driving cycle" UBYTE _CNV_S_2_RANGE__0___1_CM 1 100. 0. 1. DISPLAY_IDENTIFIER LV_CYL_BAL_LAM_SEL_RNG_COLD_DC[0] ECU_ADDRESS 0xd0008cce BIT_MASK 0x1 /end MEASUREMENT
/begin MEASUREMENT lv_cyl_bal_lam_sel_rng_cold_dc[1] "Flag for cylinder balancing cylinder selective lambda adaptation (cold range) bank specific at active driving cycle" UBYTE _CNV_S_2_RANGE__0___1_CM 1 100. 0. 1. DISPLAY_IDENTIFIER LV_CYL_BAL_LAM_SEL_RNG_COLD_DC[1] ECU_ADDRESS 0xd0008ccf BIT_MASK 0x1 /end MEASUREMENT
/begin MEASUREMENT t_cyl_bal_lam_sel_rng_cold_dc[0] "Time for cylinder balancing cylinder selective lambda adaptation (cold range) bank specific at active driving cycle" UWORD _CNV_A_R_LINEAR_____4_CM 1 100. 0. 6553.5 DISPLAY_IDENTIFIER T_CYL_BAL_LAM_SEL_RNG_COLD_DC[0] ECU_ADDRESS 0xd0000770 FORMAT "%6.1" /end MEASUREMENT
/begin MEASUREMENT t_cyl_bal_lam_sel_rng_cold_dc[1] "Time for cylinder balancing cylinder selective lambda adaptation (cold range) bank specific at active driving cycle" UWORD _CNV_A_R_LINEAR_____4_CM 1 100. 0. 6553.5 DISPLAY_IDENTIFIER T_CYL_BAL_LAM_SEL_RNG_COLD_DC[1] ECU_ADDRESS 0xd0000772 FORMAT "%6.1" /end MEASUREMENT
/begin MEASUREMENT t_cyl_bal_lam_ad_add_dc[0] "Time for cylinder balancing lambda adaptation (additive) exhaust bank specific at active driving cycle" UWORD _CNV_A_R_LINEAR_____4_CM 1 100. 0. 6553.5 DISPLAY_IDENTIFIER T_CYL_BAL_LAM_AD_ADD_DC[0] ECU_ADDRESS 0xd0000778 FORMAT "%6.1" /end MEASUREMENT
/begin MEASUREMENT t_cyl_bal_lam_ad_add_dc[1] "Time for cylinder balancing lambda adaptation (additive) exhaust bank specific at active driving cycle" UWORD _CNV_A_R_LINEAR_____4_CM 1 100. 0. 6553.5 DISPLAY_IDENTIFIER T_CYL_BAL_LAM_AD_ADD_DC[1] ECU_ADDRESS 0xd000077a FORMAT "%6.1" /end MEASUREMENT
/begin MEASUREMENT t_cyl_bal_lam_ad_fac_l_dc[0] "Time for cylinder balancing lambda adaptation (multiple low) exhaust bank specific at active driving cycle" UWORD _CNV_A_R_LINEAR_____4_CM 1 100. 0. 6553.5 DISPLAY_IDENTIFIER T_CYL_BAL_LAM_AD_FAC_L_DC[0] ECU_ADDRESS 0xd000077c FORMAT "%6.1" /end MEASUREMENT
/begin MEASUREMENT t_cyl_bal_lam_ad_fac_l_dc[1] "Time for cylinder balancing lambda adaptation (multiple low) exhaust bank specific at active driving cycle" UWORD _CNV_A_R_LINEAR_____4_CM 1 100. 0. 6553.5 DISPLAY_IDENTIFIER T_CYL_BAL_LAM_AD_FAC_L_DC[1] ECU_ADDRESS 0xd000077e FORMAT "%6.1" /end MEASUREMENT
/begin MEASUREMENT t_cyl_bal_lam_ad_fac_h_dc[0] "Time for cylinder balancing lambda adaptation (multiple high) exhaust bank specific at active driving cycle" UWORD _CNV_A_R_LINEAR_____4_CM 1 100. 0. 6553.5 DISPLAY_IDENTIFIER T_CYL_BAL_LAM_AD_FAC_H_DC[0] ECU_ADDRESS 0xd0000780 FORMAT "%6.1" /end MEASUREMENT
/begin MEASUREMENT t_cyl_bal_lam_ad_fac_h_dc[1] "Time for cylinder balancing lambda adaptation (multiple high) exhaust bank specific at active driving cycle" UWORD _CNV_A_R_LINEAR_____4_CM 1 100. 0. 6553.5 DISPLAY_IDENTIFIER T_CYL_BAL_LAM_AD_FAC_H_DC[1] ECU_ADDRESS 0xd0000782 FORMAT "%6.1" /end MEASUREMENT
/begin CHARACTERISTIC id_t_cyl_bal_lam_ad_dc "Time intervals for control of cylinder balancing lambda adaptation at active driving cycle" CURVE 0xa0809e24 _REC_CUR_20_u2_u2 6553.5 _CNV_A_R_LINEAR_____4_CM 0. 6553.5 DISPLAY_IDENTIFIER ID_T_CYL_BAL_LAM_AD_DC FORMAT "%6.1"
 /begin AXIS_DESCR COM_AXIS t_ast _CNV_A_R_LINEAR_____4_CM 8 0. 6553.5 FORMAT "%6.1" AXIS_PTS_REF ldp_t_ast_id_t_bal_lam_ad_dc /end AXIS_DESCR
/end CHARACTERISTIC
/begin CHARACTERISTIC c_tco_thd_cyl_bal_lam_sel_dc "TCO threshold for control of cylinder balancing selective lambda adaptation at active driving cycle" VALUE 0xa080c2eb _REC_VAL_20_u1 190.5 _CNV_A_R_LINEAR_____17_CM -48. 142.5 DISPLAY_IDENTIFIER C_TCO_THD_CYL_BAL_LAM_SEL_DC FORMAT "%6.2" /end CHARACTERISTIC
/begin CHARACTERISTIC c_t_min_cyl_bal_lam_sel_dc "Minimum time to enable cylinder balancing cylinder selective lambda adaptation part at active driving cycle" VALUE 0xa080c21c _REC_VAL_20_u2 6553.5 _CNV_A_R_LINEAR_____4_CM 0. 6553.5 DISPLAY_IDENTIFIER C_T_MIN_CYL_BAL_LAM_SEL_DC FORMAT "%6.1" /end CHARACTERISTIC
/begin CHARACTERISTIC c_t_max_cyl_bal_lam_sel_dc "Maximum time to enable cylinder balancing cylinder selective lambda adaptation part at active driving cycle" VALUE 0xa080c1e8 _REC_VAL_20_u2 6553.5 _CNV_A_R_LINEAR_____4_CM 0. 6553.5 DISPLAY_IDENTIFIER C_T_MAX_CYL_BAL_LAM_SEL_DC FORMAT "%6.1" /end CHARACTERISTIC
/begin CHARACTERISTIC c_t_min_cyl_bal_lam_ad_dc "Minimum time to enable cylinder balancing lambda adaptation part at active driving cycle" VALUE 0xa080c216 _REC_VAL_20_u2 6553.5 _CNV_A_R_LINEAR_____4_CM 0. 6553.5 DISPLAY_IDENTIFIER C_T_MIN_CYL_BAL_LAM_AD_DC FORMAT "%6.1" /end CHARACTERISTIC
/begin CHARACTERISTIC c_t_max_cyl_bal_lam_ad_dc "Maximum time to enable cylinder balancing lambda adaptation part at active driving cycle" VALUE 0xa080c1e2 _REC_VAL_20_u2 6553.5 _CNV_A_R_LINEAR_____4_CM 0. 6553.5 DISPLAY_IDENTIFIER C_T_MAX_CYL_BAL_LAM_AD_DC FORMAT "%6.1" /end CHARACTERISTIC
/begin AXIS_PTS ldp_t_ast_id_t_bal_lam_sel_dc "" 0xa0808cf4 t_ast _REC_AXS_20_u2 6553.5 _CNV_A_R_LINEAR_____4_CM 8 0. 6553.5 FORMAT "%6.1" /end AXIS_PTS
/begin AXIS_PTS ldp_t_ast_id_t_bal_lam_ad_dc "" 0xa0808ce0 t_ast _REC_AXS_20_u2 6553.5 _CNV_A_R_LINEAR_____4_CM 8 0. 6553.5 FORMAT "%6.1" /end AXIS_PTS
/begin AXIS_PTS ldpm_n_32_2_evac "" 0xa0805140 n_32 _REC_AXS_20_u1 8160. _CNV_A_R_LINEAR_____10_CM 12 0. 8160. FORMAT "%4.0" /end AXIS_PTS
/begin AXIS_PTS ldpm_n_32_1_evac "" 0xa0805136 n_32 _REC_AXS_20_u1 8160. _CNV_A_R_LINEAR_____10_CM 6 0. 8160. FORMAT "%4.0" /end AXIS_PTS
/begin AXIS_PTS ldpm_amp_1_evac "" 0xa080503c amp _REC_AXS_20_u2 5434. _CNV_A_R_LINEAR_____27_CM 6 0. 5434. FORMAT "%7.2" /end AXIS_PTS
/begin AXIS_PTS ldpm_n_32_3_evac "" 0xa0805150 n_32 _REC_AXS_20_u1 8160. _CNV_A_R_LINEAR_____10_CM 8 0. 8160. FORMAT "%4.0" /end AXIS_PTS
/begin AXIS_PTS ldpm_vb_1_evac "" 0xa08051f0 vb _REC_AXS_20_u1 26. _CNV_A_R_LINEAR_____37_CM 8 0. 26. FORMAT "%4.1" /end AXIS_PTS
/begin AXIS_PTS ldpm_prs_cps_1_evac "" 0xa0805178 prs_cps _REC_AXS_20_u2 5434. _CNV_A_R_EVAC_LINEA_276_CM 16 -2717.04 2716.96 FORMAT "%8.2" /end AXIS_PTS
/begin AXIS_PTS ldpm_map_1_evac "" 0xa08050cc map _REC_AXS_20_u2 5434. _CNV_A_R_LINEAR_____27_CM 6 0. 5434. FORMAT "%7.2" /end AXIS_PTS
/begin AXIS_PTS ldpm_tia_1_evac "" 0xa08051a4 tia _REC_AXS_20_u1 190.5 _CNV_A_R_LINEAR_____17_CM 3 -48. 142.5 FORMAT "%6.2" /end AXIS_PTS
/begin AXIS_PTS ldpm_tqi_sp_s_2_evac "" 0xa08051a8 tqi_sp _REC_AXS_20_u2 1023.96875 _CNV_A_R_LINEAR_____31_CM 6 0. 1023.96875 FORMAT "%7.2" /end AXIS_PTS
/begin AXIS_PTS ldpm_maf_cyl_1_evac "" 0xa0805070 maf_cyl _REC_AXS_20_u2 2047.96875 _CNV_A_R_LINEAR_____215_CM 6 0. 2047.96875 FORMAT "%10.5" /end AXIS_PTS
/begin AXIS_PTS ldpm_maf_2_evac "" 0xa0805060 maf_hb _REC_AXS_20_u1 1389. _CNV_A_R_LINEAR_____15_CM 12 0. 1389. FORMAT "%4.0" /end AXIS_PTS
/begin AXIS_PTS ldpm_mff_sp_mv_1_evac "" 0xa080510c mff_sp_mv _REC_AXS_20_u2 1389. _CNV_A_R_LINEAR_____111_CM 6 0. 1389. FORMAT "%7.2" /end AXIS_PTS
/begin AXIS_PTS ldpm_mff_sp_mv_2_evac "" 0xa080511c mff_sp_mv _REC_AXS_20_u2 1389. _CNV_A_R_LINEAR_____111_CM 12 0. 1389. FORMAT "%7.2" /end AXIS_PTS
/begin MEASUREMENT state_t_sdl_cp "state of time control function" UBYTE _CNV_S_9_STATE_T_SD_277_CM 1 100. 0. 8. DISPLAY_IDENTIFIER STATE_T_SDL_CP ECU_ADDRESS 0xd00075da /end MEASUREMENT
/begin MEASUREMENT t_cp "time of actual CP time range " UWORD _CNV_A_R_LINEAR_____4_CM 1 100. 0. 6553.5 DISPLAY_IDENTIFIER T_CP ECU_ADDRESS 0xd000290a FORMAT "%6.1" /end MEASUREMENT
/begin MEASUREMENT lv_cp_ena "logical value for enabled canister purge" UBYTE _CNV_S_2_RANGE__0___1_CM 1 100. 0. 1. DISPLAY_IDENTIFIER LV_CP_ENA ECU_ADDRESS 0xd00075ab BIT_MASK 0x1 /end MEASUREMENT
/begin CHARACTERISTIC c_cl_mmv_t_bol "time management CL bottom limit" VALUE 0xa0805566 _REC_VAL_20_u2 1.99996948242188 _CNV_A_R_LINEAR_____9_CM 0. 1.99996948242188 DISPLAY_IDENTIFIER C_CL_MMV_T_BOL FORMAT "%7.5" /end CHARACTERISTIC
/begin CHARACTERISTIC c_cl_mmv_t_tol "time management CL top limit" VALUE 0xa0805568 _REC_VAL_20_u2 1.99996948242188 _CNV_A_R_LINEAR_____9_CM 0. 1.99996948242188 DISPLAY_IDENTIFIER C_CL_MMV_T_TOL FORMAT "%7.5" /end CHARACTERISTIC
/begin AXIS_PTS ldp_cl_mmv_ip_t_max_cp "" 0xa0804f40 cl_mmv _REC_AXS_20_u2 1.99996948242188 _CNV_A_R_LINEAR_____9_CM 6 0. 1.99996948242188 FORMAT "%7.5" /end AXIS_PTS
/begin MEASUREMENT t_ad "Time out for adaption phase" UWORD _CNV_A_R_LINEAR_____4_CM 1 100. 0. 6553.5 DISPLAY_IDENTIFIER T_AD ECU_ADDRESS 0xd0002906 FORMAT "%6.1" /end MEASUREMENT
/begin MEASUREMENT t_max_ad "Maximum adaption time; used to disable CP ehwn canister is detected empty" UWORD _CNV_A_R_LINEAR_____4_CM 1 100. 0. 6553.5 DISPLAY_IDENTIFIER T_MAX_AD ECU_ADDRESS 0xd0002928 FORMAT "%6.1" /end MEASUREMENT
/begin MEASUREMENT lv_lam_ad_ena "lambda adaptation enabled" UBYTE _CNV_S_2_RANGE__0___1_CM 1 100. 0. 1. DISPLAY_IDENTIFIER LV_LAM_AD_ENA ECU_ADDRESS 0xd00075c0 BIT_MASK 0x1 /end MEASUREMENT
/begin MEASUREMENT ctr_lam_ad_sdl_cp "" UBYTE _CNV_A_R_LINEAR_____0_CM 1 100. 0. 255. DISPLAY_IDENTIFIER CTR_LAM_AD_SDL_CP ECU_ADDRESS 0xd0002938 FORMAT "%3.0" /end MEASUREMENT
/begin CHARACTERISTIC c_state_man_sdl_cp "selection of manual scheduling mode" VALUE 0xa0805631 _REC_VAL_20_u1 3. _CNV_S_4_STATE_MAN__278_CM 0. 3. DISPLAY_IDENTIFIER C_STATE_MAN_SDL_CP /end CHARACTERISTIC
/begin CHARACTERISTIC lc_mff_ad_ena_pas "switch to enable lambda adaption while cp passive" VALUE 0xa08056d6 _REC_VAL_20_u1 1. _CNV_A_R_LINEAR_____0_CM 0. 1. DISPLAY_IDENTIFIER LC_MFF_AD_ENA_PAS FORMAT "%1.0" /end CHARACTERISTIC
/begin CHARACTERISTIC lc_cp_ena_wait_lam "switch to permanently enable canister purge in WAIT_LAM" VALUE 0xa08056bd _REC_VAL_20_u1 1. _CNV_A_R_LINEAR_____0_CM 0. 1. DISPLAY_IDENTIFIER LC_CP_ENA_WAIT_LAM FORMAT "%1.0" /end CHARACTERISTIC
/begin CHARACTERISTIC lc_cl_cp_dyn_end_ena "switch to enable end of CP phase when reaching low canister load" VALUE 0xa08056b0 _REC_VAL_20_u1 1. _CNV_A_R_LINEAR_____0_CM 0. 1. DISPLAY_IDENTIFIER LC_CL_CP_DYN_END_ENA FORMAT "%1.0" /end CHARACTERISTIC
/begin CHARACTERISTIC lc_lam_lim_ad_ena "switch to enable forced lambda adaption " VALUE 0xa08056d2 _REC_VAL_20_u1 1. _CNV_A_R_LINEAR_____0_CM 0. 1. DISPLAY_IDENTIFIER LC_LAM_LIM_AD_ENA FORMAT "%1.0" /end CHARACTERISTIC
/begin CHARACTERISTIC lc_sdl_lam_ad_cdn_off "switch to ignore LV_LAM_AD_CDN" VALUE 0xa08056d9 _REC_VAL_20_u1 1. _CNV_A_R_LINEAR_____0_CM 0. 1. DISPLAY_IDENTIFIER LC_SDL_LAM_AD_CDN_OFF FORMAT "%1.0" /end CHARACTERISTIC
/begin CHARACTERISTIC c_t_2_cp "duration of purge phase" VALUE 0xa0805634 _REC_VAL_20_u2 6553.400000000001 _CNV_A_R_LINEAR_____4_CM 0.1 6553.5 DISPLAY_IDENTIFIER C_T_2_CP FORMAT "%6.1" /end CHARACTERISTIC
/begin CHARACTERISTIC c_t_di_cp "Disable time of purge phase when canister detected empty" VALUE 0xa0805646 _REC_VAL_20_u2 6553.400000000001 _CNV_A_R_LINEAR_____4_CM 0.1 6553.5 DISPLAY_IDENTIFIER C_T_DI_CP FORMAT "%6.1" /end CHARACTERISTIC
/begin CHARACTERISTIC c_t_mff_ad_max "time out for adaptation phase" VALUE 0xa0805684 _REC_VAL_20_u2 6553.400000000001 _CNV_A_R_LINEAR_____4_CM 0.1 6553.5 DISPLAY_IDENTIFIER C_T_MFF_AD_MAX FORMAT "%6.1" /end CHARACTERISTIC
/begin CHARACTERISTIC id_t_lam_ad_thd[0] "array[NC_NR_CP_LAM_AD elements] for start time of fixed lambda adaptation slices" VALUE 0xa08056a8 _REC_VAL_20_u2 6553.400000000001 _CNV_A_R_LINEAR_____4_CM 0.1 6553.5 DISPLAY_IDENTIFIER ID_T_LAM_AD_THD[0] FORMAT "%6.1" /end CHARACTERISTIC
/begin CHARACTERISTIC id_t_lam_ad_thd[1] "array[NC_NR_CP_LAM_AD elements] for start time of fixed lambda adaptation slices" VALUE 0xa08056aa _REC_VAL_20_u2 6553.400000000001 _CNV_A_R_LINEAR_____4_CM 0.1 6553.5 DISPLAY_IDENTIFIER ID_T_LAM_AD_THD[1] FORMAT "%6.1" /end CHARACTERISTIC
/begin CHARACTERISTIC id_t_lam_ad_thd[2] "array[NC_NR_CP_LAM_AD elements] for start time of fixed lambda adaptation slices" VALUE 0xa08056ac _REC_VAL_20_u2 6553.400000000001 _CNV_A_R_LINEAR_____4_CM 0.1 6553.5 DISPLAY_IDENTIFIER ID_T_LAM_AD_THD[2] FORMAT "%6.1" /end CHARACTERISTIC
/begin CHARACTERISTIC id_t_lam_ad_thd[3] "array[NC_NR_CP_LAM_AD elements] for start time of fixed lambda adaptation slices" VALUE 0xa08056ae _REC_VAL_20_u2 6553.400000000001 _CNV_A_R_LINEAR_____4_CM 0.1 6553.5 DISPLAY_IDENTIFIER ID_T_LAM_AD_THD[3] FORMAT "%6.1" /end CHARACTERISTIC
/begin CHARACTERISTIC id_dur_lam_ad[0] "array[NC_NR_CP_LAM_AD elements] for duration of fixed lambda adaptation slices" VALUE 0xa08056a0 _REC_VAL_20_u2 6553.400000000001 _CNV_A_R_LINEAR_____4_CM 0.1 6553.5 DISPLAY_IDENTIFIER ID_DUR_LAM_AD[0] FORMAT "%6.1" /end CHARACTERISTIC
/begin CHARACTERISTIC id_dur_lam_ad[1] "array[NC_NR_CP_LAM_AD elements] for duration of fixed lambda adaptation slices" VALUE 0xa08056a2 _REC_VAL_20_u2 6553.400000000001 _CNV_A_R_LINEAR_____4_CM 0.1 6553.5 DISPLAY_IDENTIFIER ID_DUR_LAM_AD[1] FORMAT "%6.1" /end CHARACTERISTIC
/begin CHARACTERISTIC id_dur_lam_ad[2] "array[NC_NR_CP_LAM_AD elements] for duration of fixed lambda adaptation slices" VALUE 0xa08056a4 _REC_VAL_20_u2 6553.400000000001 _CNV_A_R_LINEAR_____4_CM 0.1 6553.5 DISPLAY_IDENTIFIER ID_DUR_LAM_AD[2] FORMAT "%6.1" /end CHARACTERISTIC
/begin CHARACTERISTIC id_dur_lam_ad[3] "array[NC_NR_CP_LAM_AD elements] for duration of fixed lambda adaptation slices" VALUE 0xa08056a6 _REC_VAL_20_u2 6553.400000000001 _CNV_A_R_LINEAR_____4_CM 0.1 6553.5 DISPLAY_IDENTIFIER ID_DUR_LAM_AD[3] FORMAT "%6.1" /end CHARACTERISTIC
/begin CHARACTERISTIC ip_t_max_cp "duration of maximum purge versus canister load" CURVE 0xa08054fc _REC_CUR_20_u2_u2 6553.400000000001 _CNV_A_R_LINEAR_____4_CM 0.1 6553.5 DISPLAY_IDENTIFIER IP_T_MAX_CP FORMAT "%6.1"
 /begin AXIS_DESCR COM_AXIS cl_mmv _CNV_A_R_LINEAR_____9_CM 6 0. 1.99996948242188 FORMAT "%7.5" AXIS_PTS_REF ldp_cl_mmv_ip_t_max_cp /end AXIS_DESCR
/end CHARACTERISTIC
/begin CHARACTERISTIC c_t_sdl_ext_req "Time for external request" VALUE 0xa0805688 _REC_VAL_20_u2 6553.400000000001 _CNV_A_R_LINEAR_____4_CM 0.1 6553.5 DISPLAY_IDENTIFIER C_T_SDL_EXT_REQ FORMAT "%6.1" /end CHARACTERISTIC
/begin CHARACTERISTIC c_cl_mmv_t_wait_lam "CL threshold to switch off CP during WAIT_LAM" VALUE 0xa080556a _REC_VAL_20_u2 1.99996948242188 _CNV_A_R_LINEAR_____9_CM 0. 1.99996948242188 DISPLAY_IDENTIFIER C_CL_MMV_T_WAIT_LAM FORMAT "%7.5" /end CHARACTERISTIC
/begin CHARACTERISTIC c_tco_dyn_t_ctl "Minimum temperature for activation of dynamic time control between EVAP and lambda adaptation" VALUE 0xa0805690 _REC_VAL_20_u1 190.5 _CNV_A_R_LINEAR_____17_CM -48. 142.5 DISPLAY_IDENTIFIER C_TCO_DYN_T_CTL FORMAT "%6.2" /end CHARACTERISTIC
/begin MEASUREMENT lv_cp_ramp_open_act "Logical value for active RAMP_OPEN operation" UBYTE _CNV_S_2_RANGE__0___1_CM 1 100. 0. 1. DISPLAY_IDENTIFIER LV_CP_RAMP_OPEN_ACT ECU_ADDRESS 0xd00075b1 BIT_MASK 0x1 /end MEASUREMENT
/begin MEASUREMENT lv_cl_clc_vld "Actual CL value usable for intelligent MIN_PURGE" UBYTE _CNV_S_2_RANGE__0___1_CM 1 100. 0. 1. DISPLAY_IDENTIFIER LV_CL_CLC_VLD ECU_ADDRESS 0xd0007599 BIT_MASK 0x1 /end MEASUREMENT
/begin MEASUREMENT flow_ctl_cps "Flow setpoint through the CPS" UWORD _CNV_A_R_LINEAR_____162_CM 1 100. 0. 7.9998779296875 DISPLAY_IDENTIFIER FLOW_CTL_CPS ECU_ADDRESS 0xd0002822 FORMAT "%6.4" /end MEASUREMENT
/begin MEASUREMENT flow_tar_cps "Flow setpoint through the CPS, target flow setpoint to be reached after ramping" UWORD _CNV_A_R_LINEAR_____162_CM 1 100. 0. 7.9998779296875 DISPLAY_IDENTIFIER FLOW_TAR_CPS ECU_ADDRESS 0xd000282e FORMAT "%6.4" /end MEASUREMENT
/begin MEASUREMENT flow_open_cps "Setpoint value for the flow through CPS during RAMP_OPEN_FAST" UWORD _CNV_A_R_LINEAR_____162_CM 1 100. 0. 7.9998779296875 DISPLAY_IDENTIFIER FLOW_OPEN_CPS ECU_ADDRESS 0xd000282c FORMAT "%6.4" /end MEASUREMENT
/begin MEASUREMENT lv_t_dly_req_cp "Logical value for enabled lambda adaptation" UBYTE _CNV_S_2_RANGE__0___1_CM 1 100. 0. 1. DISPLAY_IDENTIFIER LV_T_DLY_REQ_CP ECU_ADDRESS 0xd0002956 BIT_MASK 0x1 /end MEASUREMENT
/begin MEASUREMENT t_dly_max_cp "Time counter between the end of a MAX_PURGE and a new RAMP_OPEN request" UWORD _CNV_A_R_LINEAR_____4_CM 1 100. 0. 6553.5 DISPLAY_IDENTIFIER T_DLY_MAX_CP ECU_ADDRESS 0xd000291e FORMAT "%6.1" /end MEASUREMENT
/begin CHARACTERISTIC lc_lam_lin_cps "Type of O2 sensor" VALUE 0xa08056d3 _REC_VAL_20_u1 1. _CNV_A_R_LINEAR_____0_CM 0. 1. DISPLAY_IDENTIFIER LC_LAM_LIN_CPS FORMAT "%1.0" /end CHARACTERISTIC
/begin AXIS_PTS ldp_n_32_id_flow_inc_nr_cp "" 0xa0804fde n_32 _REC_AXS_20_u1 8160. _CNV_A_R_LINEAR_____10_CM 4 0. 8160. FORMAT "%4.0" /end AXIS_PTS
/begin MEASUREMENT state_cll_deac_cp "Deactivation states of NORMAL_PURGE" UBYTE _CNV_S_4_STATE_CLL__282_CM 1 100. 0. 3. DISPLAY_IDENTIFIER STATE_CLL_DEAC_CP ECU_ADDRESS 0xd00075d6 /end MEASUREMENT
/begin MEASUREMENT state_lock_cp "Deactivation states of NORMAL_PURGE" UBYTE _CNV_S_3_STATE_LOCK_283_CM 1 100. 0. 2. DISPLAY_IDENTIFIER STATE_LOCK_CP ECU_ADDRESS 0xd00075d8 /end MEASUREMENT
/begin MEASUREMENT lv_cp_cdn_ramp_open "Logical value for active RAMP_OPEN operation" UBYTE _CNV_S_2_RANGE__0___1_CM 1 100. 0. 1. DISPLAY_IDENTIFIER LV_CP_CDN_RAMP_OPEN ECU_ADDRESS 0xd00075a1 BIT_MASK 0x1 /end MEASUREMENT
/begin MEASUREMENT lv_cp_cdn_ramp_open_fast "Logical value for active RAMP_OPEN operation" UBYTE _CNV_S_2_RANGE__0___1_CM 1 100. 0. 1. DISPLAY_IDENTIFIER LV_CP_CDN_RAMP_OPEN_FAST ECU_ADDRESS 0xd0002947 BIT_MASK 0x1 /end MEASUREMENT
/begin MEASUREMENT lv_cl_clc_avl "" UBYTE _CNV_S_2_RANGE__0___1_CM 1 100. 0. 1. DISPLAY_IDENTIFIER LV_CL_CLC_AVL ECU_ADDRESS 0xd0007598 BIT_MASK 0x1 /end MEASUREMENT
/begin MEASUREMENT flow_sp_cps "Flow setpoint through the CPS" UWORD _CNV_A_R_LINEAR_____162_CM 1 100. 0. 7.9998779296875 DISPLAY_IDENTIFIER FLOW_SP_CPS ECU_ADDRESS 0xd000683a FORMAT "%6.4" /end MEASUREMENT
/begin MEASUREMENT flow_cor_cps "Corrected flow setpoint through the CPS" UWORD _CNV_A_R_LINEAR_____162_CM 1 100. 0. 7.9998779296875 DISPLAY_IDENTIFIER FLOW_COR_CPS ECU_ADDRESS 0xd000682c FORMAT "%6.4" /end MEASUREMENT
/begin MEASUREMENT flow_cps "Flow through the CPS" UWORD _CNV_A_R_LINEAR_____162_CM 1 100. 0. 7.9998779296875 DISPLAY_IDENTIFIER FLOW_CPS ECU_ADDRESS 0xd000682e FORMAT "%6.4" /end MEASUREMENT
/begin MEASUREMENT flow_dly_cp "Filtered value of FLOW_CPS (Padé Filter)" UWORD _CNV_A_R_LINEAR_____162_CM 1 100. 0. 7.9998779296875 DISPLAY_IDENTIFIER FLOW_DLY_CP ECU_ADDRESS 0xd0006832 FORMAT "%6.4" /end MEASUREMENT
/begin MEASUREMENT flow_dly_mmv_cp "Moving mean value of FLOW_CPS_DLY" UWORD _CNV_A_R_LINEAR_____162_CM 1 100. 0. 7.9998779296875 DISPLAY_IDENTIFIER FLOW_DLY_MMV_CP ECU_ADDRESS 0xd0006834 FORMAT "%6.4" /end MEASUREMENT
/begin MEASUREMENT flow_dly_old_2_cp "Old value of FLOW_CPS_DLY for Padé Filter calculation for FLOW_CPS_DLY" UWORD _CNV_A_R_LINEAR_____162_CM 1 100. 0. 7.9998779296875 DISPLAY_IDENTIFIER FLOW_DLY_OLD_2_CP ECU_ADDRESS 0xd0002826 FORMAT "%6.4" /end MEASUREMENT
/begin MEASUREMENT flow_cps_old_1 "Old value of FLOW_CPS for Padé Filter calculation for FLOW_CPS_DLY" UWORD _CNV_A_R_LINEAR_____162_CM 1 100. 0. 7.9998779296875 DISPLAY_IDENTIFIER FLOW_CPS_OLD_1 ECU_ADDRESS 0xd000281e FORMAT "%6.4" /end MEASUREMENT
/begin MEASUREMENT flow_cps_old_2 "Old value of FLOW_CPS for Padé Filter calculation for FLOW_CPS_DLY" UWORD _CNV_A_R_LINEAR_____162_CM 1 100. 0. 7.9998779296875 DISPLAY_IDENTIFIER FLOW_CPS_OLD_2 ECU_ADDRESS 0xd0002820 FORMAT "%6.4" /end MEASUREMENT
/begin MEASUREMENT fac_tia_amp_cp "Flow correction versus air temperature and ambient pressure" UBYTE _CNV_A_R_LINEAR_____103_CM 1 100. 0. 1.9921875 DISPLAY_IDENTIFIER FAC_TIA_AMP_CP ECU_ADDRESS 0xd000293c FORMAT "%8.6" /end MEASUREMENT
/begin MEASUREMENT flow_fac_cp "Flow correction versus air temperature and ambient pressure" UWORD _CNV_A_R_LINEAR_____24_CM 1 100. 0. 3.99993896484375 DISPLAY_IDENTIFIER FLOW_FAC_CP ECU_ADDRESS 0xd0002828 FORMAT "%7.5" /end MEASUREMENT
/begin MEASUREMENT maf_cp "(MAF_KGH throttle) MAF_KGH_THR + (Mass air flow through the canister purge valve) MAF_CPS" UWORD _CNV_A_R_LINEAR_____215_CM 1 100. 0. 2047.96875 DISPLAY_IDENTIFIER MAF_CP ECU_ADDRESS 0xd0002840 FORMAT "%10.5" /end MEASUREMENT
/begin MEASUREMENT maf_dly_mmv_cp "Moving mean value of flow_cps_dly " UWORD _CNV_A_R_LINEAR_____215_CM 1 100. 0. 2047.96875 DISPLAY_IDENTIFIER MAF_DLY_MMV_CP ECU_ADDRESS 0xd000683e FORMAT "%10.5" /end MEASUREMENT
/begin MEASUREMENT maf_cp_old_1 "Old value of maf_tot_cp" UWORD _CNV_A_R_LINEAR_____215_CM 1 100. 0. 2047.96875 DISPLAY_IDENTIFIER MAF_CP_OLD_1 ECU_ADDRESS 0xd0002842 FORMAT "%10.5" /end MEASUREMENT
/begin MEASUREMENT maf_cp_old_2 "Old value of maf_tot_cp" UWORD _CNV_A_R_LINEAR_____215_CM 1 100. 0. 2047.96875 DISPLAY_IDENTIFIER MAF_CP_OLD_2 ECU_ADDRESS 0xd0002844 FORMAT "%10.5" /end MEASUREMENT
/begin MEASUREMENT maf_dly_old_2_cp "Old value of maf_tot_cp_dly for pade filter" UWORD _CNV_A_R_LINEAR_____215_CM 1 100. 0. 2047.96875 DISPLAY_IDENTIFIER MAF_DLY_OLD_2_CP ECU_ADDRESS 0xd0002848 FORMAT "%10.5" /end MEASUREMENT
/begin CHARACTERISTIC c_flow_cps_as "flow_sp_cps correction of application system" VALUE 0xa08055dc _REC_VAL_20_u2 7.9998779296875 _CNV_A_R_LINEAR_____162_CM 0. 7.9998779296875 DISPLAY_IDENTIFIER C_FLOW_CPS_AS FORMAT "%6.4" /end CHARACTERISTIC
/begin CHARACTERISTIC c_flow_cps_sp_purge_tube "Flow setpoint for tube purging in WAIT_RAMP_OPEN" VALUE 0xa08055e2 _REC_VAL_20_u2 7.9998779296875 _CNV_A_R_LINEAR_____162_CM 0. 7.9998779296875 DISPLAY_IDENTIFIER C_FLOW_CPS_SP_PURGE_TUBE FORMAT "%6.4" /end CHARACTERISTIC
/begin CHARACTERISTIC c_flow_cps_grd_purge_tube "Flow gradient for tube purging in WAIT_RAMP_OPEN" VALUE 0xa08055de _REC_VAL_20_u2 7.9998779296875 _CNV_A_R_LINEAR_____162_CM 0. 7.9998779296875 DISPLAY_IDENTIFIER C_FLOW_CPS_GRD_PURGE_TUBE FORMAT "%6.4" /end CHARACTERISTIC
/begin CHARACTERISTIC c_maf_dly_crlc_cp "Correlation constant for MAF_TOT_CP_DLY-filter" VALUE 0xa0805602 _REC_VAL_20_u2 0.9999847412109381 _CNV_A_R_LINEAR_____89_CM 0. 0.9999847412109381 DISPLAY_IDENTIFIER C_MAF_DLY_CRLC_CP FORMAT "%7.5" /end CHARACTERISTIC
/begin CHARACTERISTIC c_fac_dec_cor_cmu_cp "Correlation factor for closing ramp speed when combustion commutation requested" VALUE 0xa08055b6 _REC_VAL_20_u2 3.99993896484375 _CNV_A_R_LINEAR_____24_CM 0. 3.99993896484375 DISPLAY_IDENTIFIER C_FAC_DEC_COR_CMU_CP FORMAT "%7.5" /end CHARACTERISTIC
/begin CHARACTERISTIC c_fac_dec_cor_1_cp "Cor. fac. for closing ramp speed when high closing speed requested from OBD manag" VALUE 0xa08055b2 _REC_VAL_20_u2 3.99993896484375 _CNV_A_R_LINEAR_____24_CM 0. 3.99993896484375 DISPLAY_IDENTIFIER C_FAC_DEC_COR_1_CP FORMAT "%7.5" /end CHARACTERISTIC
/begin CHARACTERISTIC c_fac_dec_cor_2_cp "Cor. fac. for closing ramp speed when medium closing speed requested from OBD manag" VALUE 0xa08055b4 _REC_VAL_20_u2 3.99993896484375 _CNV_A_R_LINEAR_____24_CM 0. 3.99993896484375 DISPLAY_IDENTIFIER C_FAC_DEC_COR_2_CP FORMAT "%7.5" /end CHARACTERISTIC
/begin CHARACTERISTIC lc_pq_sp_cp_hom_afl "Use lambda setpoint for fuel_cps calculation during homogeneous lean burn combustion" VALUE 0xa08056d7 _REC_VAL_20_u1 1. _CNV_A_R_LINEAR_____0_CM 0. 1. DISPLAY_IDENTIFIER LC_PQ_SP_CP_HOM_AFL FORMAT "%1.0" /end CHARACTERISTIC
/begin CHARACTERISTIC lc_cp_tran_open_max_ena "Enable transition fron RAMP_OPEN to MAX_PURGE if flow target reached" VALUE 0xa08056c6 _REC_VAL_20_u1 1. _CNV_A_R_LINEAR_____0_CM 0. 1. DISPLAY_IDENTIFIER LC_CP_TRAN_OPEN_MAX_ENA FORMAT "%1.0" /end CHARACTERISTIC
/begin CHARACTERISTIC lc_flow_cps_as "FLOW_CPS_AS activation" VALUE 0xa08056cd _REC_VAL_20_u1 1. _CNV_A_R_LINEAR_____0_CM 0. 1. DISPLAY_IDENTIFIER LC_FLOW_CPS_AS FORMAT "%1.0" /end CHARACTERISTIC
/begin CHARACTERISTIC lc_cp_tran_deac_cll "Mode selection at end of RO with empty canister // =0: MAX_PURGE //  =1: MIN_PURGE" VALUE 0xa08056c5 _REC_VAL_20_u1 1. _CNV_A_R_LINEAR_____0_CM 0. 1. DISPLAY_IDENTIFIER LC_CP_TRAN_DEAC_CLL FORMAT "%1.0" /end CHARACTERISTIC
/begin CHARACTERISTIC lc_cp_tra_min_ramp_open_dis "Mode selection at end of RO with empty canister // =0: MAX_PURGE //  =1: MIN_PURGE" VALUE 0xa08056c2 _REC_VAL_20_u1 1. _CNV_A_R_LINEAR_____0_CM 0. 1. DISPLAY_IDENTIFIER LC_CP_TRA_MIN_RAMP_OPEN_DIS FORMAT "%1.0" /end CHARACTERISTIC
/begin CHARACTERISTIC lc_cp_tra_min_purge_dft_ena "Mode selection at end of RO with empty canister // =0: MAX_PURGE //  =1: MIN_PURGE" VALUE 0xa08056c1 _REC_VAL_20_u1 1. _CNV_A_R_LINEAR_____0_CM 0. 1. DISPLAY_IDENTIFIER LC_CP_TRA_MIN_PURGE_DFT_ENA FORMAT "%1.0" /end CHARACTERISTIC
/begin CHARACTERISTIC lc_cp_tra_opl_cdn_not "Mode selection at end of RO with empty canister // =0: MAX_PURGE //  =1: MIN_PURGE" VALUE 0xa08056c4 _REC_VAL_20_u1 1. _CNV_A_R_LINEAR_____0_CM 0. 1. DISPLAY_IDENTIFIER LC_CP_TRA_OPL_CDN_NOT FORMAT "%1.0" /end CHARACTERISTIC
/begin CHARACTERISTIC lc_cp_tra_opl_cdn_cll_not "Mode selection at end of RO with empty canister // =0: MAX_PURGE //  =1: MIN_PURGE" VALUE 0xa08056c3 _REC_VAL_20_u1 1. _CNV_A_R_LINEAR_____0_CM 0. 1. DISPLAY_IDENTIFIER LC_CP_TRA_OPL_CDN_CLL_NOT FORMAT "%1.0" /end CHARACTERISTIC
/begin CHARACTERISTIC c_state_mod_sel_cp "" VALUE 0xa0805632 _REC_VAL_20_u1 3. _CNV_S_4_STATE_MOD__284_CM 0. 3. DISPLAY_IDENTIFIER C_STATE_MOD_SEL_CP /end CHARACTERISTIC
/begin MEASUREMENT maf_dly_cp "Filtrered  value of maf_tot_cp ( pade filter)" UWORD _CNV_A_R_LINEAR_____215_CM 1 100. 0. 2047.96875 DISPLAY_IDENTIFIER MAF_DLY_CP ECU_ADDRESS 0xd0002846 FORMAT "%10.5" /end MEASUREMENT
/begin MEASUREMENT lv_cp_act_req "" UBYTE _CNV_S_2_RANGE__0___1_CM 1 100. 0. 1. DISPLAY_IDENTIFIER LV_CP_ACT_REQ ECU_ADDRESS 0xd000759e BIT_MASK 0x1 /end MEASUREMENT
/begin MEASUREMENT lv_state_mem_cp_cll "logical value for end of  MAX_PURGE operation" UBYTE _CNV_S_2_RANGE__0___1_CM 1 100. 0. 1. DISPLAY_IDENTIFIER LV_STATE_MEM_CP_CLL ECU_ADDRESS 0xd00075c5 BIT_MASK 0x1 /end MEASUREMENT
/begin MEASUREMENT t_dly_cp_open "Canister load check counter in stratified  mode  " UWORD _CNV_A_R_LINEAR_____4_CM 1 100. 0. 6553.5 DISPLAY_IDENTIFIER T_DLY_CP_OPEN ECU_ADDRESS 0xd0002916 FORMAT "%6.1" /end MEASUREMENT
/begin MEASUREMENT t_di_cp "Time counter limit to perform a CL learning during stratified " UWORD _CNV_A_R_LINEAR_____4_CM 1 100. 0. 6553.5 DISPLAY_IDENTIFIER T_DI_CP ECU_ADDRESS 0xd0002910 FORMAT "%6.1" /end MEASUREMENT
/begin CHARACTERISTIC c_crlc_pq_sp_cp "Correlation constant to calculate PQ_SP_CP" VALUE 0xa08055a0 _REC_VAL_20_u2 0.9999847412109381 _CNV_A_R_LINEAR_____89_CM 0. 0.9999847412109381 DISPLAY_IDENTIFIER C_CRLC_PQ_SP_CP FORMAT "%7.5" /end CHARACTERISTIC
/begin MEASUREMENT lv_cp_cll "" UBYTE _CNV_S_2_RANGE__0___1_CM 1 100. 0. 1. DISPLAY_IDENTIFIER LV_CP_CLL ECU_ADDRESS 0xd00075a2 BIT_MASK 0x1 /end MEASUREMENT
/begin MEASUREMENT lv_dly_gas_cp "" UBYTE _CNV_S_2_RANGE__0___1_CM 1 100. 0. 1. DISPLAY_IDENTIFIER LV_DLY_GAS_CP ECU_ADDRESS 0xd000294e BIT_MASK 0x1 /end MEASUREMENT
/begin CHARACTERISTIC lc_cp_tra_max_min_cdn_ena "Mode selection at end of RO with empty canister // =0: MAX_PURGE //  =1: MIN_PURGE" VALUE 0xa08056c0 _REC_VAL_20_u1 1. _CNV_A_R_LINEAR_____0_CM 0. 1. DISPLAY_IDENTIFIER LC_CP_TRA_MAX_MIN_CDN_ENA FORMAT "%1.0" /end CHARACTERISTIC
/begin CHARACTERISTIC lc_cp_flow_lim_open_fast "Enable old calculation of flow_open_cps" VALUE 0xa08056be _REC_VAL_20_u1 1. _CNV_A_R_LINEAR_____0_CM 0. 1. DISPLAY_IDENTIFIER LC_CP_FLOW_LIM_OPEN_FAST FORMAT "%1.0" /end CHARACTERISTIC
/begin AXIS_PTS ldp_cl_ip_flow_fac "" 0xa0804efc cl _REC_AXS_20_u2 1.99996948242188 _CNV_A_R_LINEAR_____9_CM 6 0. 1.99996948242188 FORMAT "%7.5" /end AXIS_PTS
/begin CHARACTERISTIC ip_flow_inc_cp "Increment value for ramp increase of REL_FLOW_CPS" CURVE 0xa080537c _REC_CUR_20_u2_u2 7.9998779296875 _CNV_A_R_LINEAR_____115_CM 0. 7.9998779296875 DISPLAY_IDENTIFIER IP_FLOW_INC_CP FORMAT "%6.4"
 /begin AXIS_DESCR COM_AXIS mff_sp_mv _CNV_A_R_LINEAR_____111_CM 6 0. 1389. FORMAT "%7.2" AXIS_PTS_REF ldpm_mff_sp_mv_1_evac /end AXIS_DESCR
/end CHARACTERISTIC
/begin CHARACTERISTIC ip_flow_fac_cp "Correction factor for ramp increase of REL_FLOW_CPS" CURVE 0xa0805364 _REC_CUR_20_u2_u2 3.99993896484375 _CNV_A_R_LINEAR_____24_CM 0. 3.99993896484375 DISPLAY_IDENTIFIER IP_FLOW_FAC_CP FORMAT "%7.5"
 /begin AXIS_DESCR COM_AXIS cl _CNV_A_R_LINEAR_____9_CM 6 0. 1.99996948242188 FORMAT "%7.5" AXIS_PTS_REF ldp_cl_ip_flow_fac /end AXIS_DESCR
/end CHARACTERISTIC
/begin CHARACTERISTIC ip_flow_dec_cp "Decrement value for ramp decrease of REL_FLOW_CPS" CURVE 0xa0805358 _REC_CUR_20_u2_u2 7.9998779296875 _CNV_A_R_LINEAR_____115_CM 0. 7.9998779296875 DISPLAY_IDENTIFIER IP_FLOW_DEC_CP FORMAT "%6.4"
 /begin AXIS_DESCR COM_AXIS mff_sp_mv _CNV_A_R_LINEAR_____111_CM 6 0. 1389. FORMAT "%7.2" AXIS_PTS_REF ldpm_mff_sp_mv_1_evac /end AXIS_DESCR
/end CHARACTERISTIC
/begin MEASUREMENT pq_cp_sp "CP forced PQ setpoint in stratified mode " UWORD _CNV_A_R_LINEAR_____89_CM 1 100. 0. 0.9999847412109381 DISPLAY_IDENTIFIER PQ_CP_SP ECU_ADDRESS 0xd000684e FORMAT "%7.5" /end MEASUREMENT
/begin CHARACTERISTIC id_flow_inc_nr_cp "Increment number for FLOW_CTL_CPS calculation in RO & ROF" CURVE 0xa0805206 _REC_CUR_20_u1_u1 254. _CNV_A_R_LINEAR_____0_CM 1. 255. DISPLAY_IDENTIFIER ID_FLOW_INC_NR_CP FORMAT "%3.0"
 /begin AXIS_DESCR COM_AXIS n_32 _CNV_A_R_LINEAR_____10_CM 4 0. 8160. FORMAT "%4.0" AXIS_PTS_REF ldp_n_32_id_flow_inc_nr_cp /end AXIS_DESCR
/end CHARACTERISTIC
/begin CHARACTERISTIC c_cl_mmv_pq "cl_mmv threshold to force PQ in max_purge during strat or lean burn modes" VALUE 0xa0805562 _REC_VAL_20_u2 1.99996948242188 _CNV_A_R_LINEAR_____9_CM 0. 1.99996948242188 DISPLAY_IDENTIFIER C_CL_MMV_PQ FORMAT "%7.5" /end CHARACTERISTIC
/begin MEASUREMENT flow_tot_cps "Total of FLOW_CPS during emission cycle" ULONG _CNV_A_R_EVAC_LINEA_285_CM 1 100. 0. 1456. DISPLAY_IDENTIFIER FLOW_TOT_CPS ECU_ADDRESS 0xd000292c FORMAT "%11.6" /end MEASUREMENT
/begin MEASUREMENT cl_mmv_clc_end "Canister load at the end of NORMAL_PURGE_MAX_PURGE operation" UWORD _CNV_A_R_LINEAR_____9_CM 1 100. 0. 1.99996948242188 DISPLAY_IDENTIFIER CL_MMV_CLC_END ECU_ADDRESS 0xd000681a FORMAT "%7.5" /end MEASUREMENT
/begin CHARACTERISTIC ip_fac_amp_cp "Correction factor for ambient pressure" CURVE 0xa08052e0 _REC_CUR_20_u1_u2 1.9921875 _CNV_A_R_LINEAR_____103_CM 0. 1.9921875 DISPLAY_IDENTIFIER IP_FAC_AMP_CP FORMAT "%8.6"
 /begin AXIS_DESCR COM_AXIS amp _CNV_A_R_LINEAR_____27_CM 6 0. 5434. FORMAT "%7.2" AXIS_PTS_REF ldpm_amp_1_evac /end AXIS_DESCR
/end CHARACTERISTIC
/begin CHARACTERISTIC ip_fac_tia_cp "Correction factor for intake air temperature" CURVE 0xa0805318 _REC_CUR_20_u1_u1 1.9921875 _CNV_A_R_LINEAR_____103_CM 0. 1.9921875 DISPLAY_IDENTIFIER IP_FAC_TIA_CP FORMAT "%8.6"
 /begin AXIS_DESCR COM_AXIS tia _CNV_A_R_LINEAR_____17_CM 6 -48. 142.5 FORMAT "%6.2" AXIS_PTS_REF ldp_tia_thr_ip_fac_tia_cp /end AXIS_DESCR
/end CHARACTERISTIC
/begin CHARACTERISTIC ip_flow_cps_dec "Increment value for ramp increase of REL_FLOW_CPS" CURVE 0xa0805340 _REC_CUR_20_u2_u2 7.9998779296875 _CNV_A_R_LINEAR_____115_CM 0. 7.9998779296875 DISPLAY_IDENTIFIER IP_FLOW_CPS_DEC FORMAT "%6.4"
 /begin AXIS_DESCR COM_AXIS mff_sp_mv _CNV_A_R_LINEAR_____111_CM 6 0. 1389. FORMAT "%7.2" AXIS_PTS_REF ldpm_mff_sp_mv_1_evac /end AXIS_DESCR
/end CHARACTERISTIC
/begin CHARACTERISTIC ip_flow_cps_inc "Increment value for ramp increase of REL_FLOW_CPS" CURVE 0xa080534c _REC_CUR_20_u2_u2 7.9998779296875 _CNV_A_R_LINEAR_____115_CM 0. 7.9998779296875 DISPLAY_IDENTIFIER IP_FLOW_CPS_INC FORMAT "%6.4"
 /begin AXIS_DESCR COM_AXIS mff_sp_mv _CNV_A_R_LINEAR_____111_CM 6 0. 1389. FORMAT "%7.2" AXIS_PTS_REF ldpm_mff_sp_mv_1_evac /end AXIS_DESCR
/end CHARACTERISTIC
/begin CHARACTERISTIC c_cl_mmv_req "CL_MMV limit value to give priority to purge canister" VALUE 0xa0805564 _REC_VAL_20_u2 1.99996948242188 _CNV_A_R_LINEAR_____9_CM 0. 1.99996948242188 DISPLAY_IDENTIFIER C_CL_MMV_REQ FORMAT "%7.5" /end CHARACTERISTIC
/begin CHARACTERISTIC c_cl_cat_diag "Limit on canister load CL value to go back in stratified " VALUE 0xa0805550 _REC_VAL_20_u2 1.99996948242188 _CNV_A_R_LINEAR_____9_CM 0. 1.99996948242188 DISPLAY_IDENTIFIER C_CL_CAT_DIAG FORMAT "%7.5" /end CHARACTERISTIC
/begin CHARACTERISTIC c_t_lock_cp "Delay to set lv_t_dly_req_cp" VALUE 0xa080567e _REC_VAL_20_u2 1310.68 _CNV_A_R_LINEAR_____110_CM 2.e-002 1310.7 DISPLAY_IDENTIFIER C_T_LOCK_CP FORMAT "%7.2" /end CHARACTERISTIC
/begin MEASUREMENT t_lock_cp "Time counter limit to perform a CL learning during stratified " UWORD _CNV_A_R_LINEAR_____110_CM 1 100. 0. 1310.7 DISPLAY_IDENTIFIER T_LOCK_CP ECU_ADDRESS 0xd0002924 FORMAT "%7.2" /end MEASUREMENT
/begin CHARACTERISTIC c_t_dly_req_cp "Time for CPS closing for transition MIN_PURGE --> NORMAL_PURGE_RAMP_OPEN" VALUE 0xa0805676 _REC_VAL_20_u2 65535. _CNV_A_R_LINEAR_____36_CM 0. 65535. DISPLAY_IDENTIFIER C_T_DLY_REQ_CP FORMAT "%5.0" /end CHARACTERISTIC
/begin CHARACTERISTIC ip_pq_cp_sp "Forced PQ during stratified mode for RO and MAX purge" MAP 0xa080fde8 _REC_MAP_20_u2_u1_u2 0.9999847412109381 _CNV_A_R_LINEAR_____89_CM 0. 0.9999847412109381 DISPLAY_IDENTIFIER IP_PQ_CP_SP FORMAT "%7.5"
 /begin AXIS_DESCR COM_AXIS n_32 _CNV_A_R_LINEAR_____10_CM 6 0. 8160. FORMAT "%4.0" AXIS_PTS_REF ldpm_n_32_1_evac /end AXIS_DESCR
 /begin AXIS_DESCR COM_AXIS tqi_sp _CNV_A_R_LINEAR_____31_CM 6 0. 1023.96875 FORMAT "%7.2" AXIS_PTS_REF ldpm_tqi_sp_s_2_evac /end AXIS_DESCR
/end CHARACTERISTIC
/begin AXIS_PTS ldp_tia_thr_ip_fac_tia_cp "" 0xa0805034 tia _REC_AXS_20_u1 190.5 _CNV_A_R_LINEAR_____17_CM 6 -48. 142.5 FORMAT "%6.2" /end AXIS_PTS
/begin MEASUREMENT flow_grd_cps "Flow gradient" UWORD _CNV_A_R_LINEAR_____162_CM 1 100. 0. 7.9998779296875 DISPLAY_IDENTIFIER FLOW_GRD_CPS ECU_ADDRESS 0xd000282a FORMAT "%6.4" /end MEASUREMENT
/begin MEASUREMENT flow_ctl_cps_di "Flow through the CPS for disabled NORMAL_PURGE operation" UWORD _CNV_A_R_LINEAR_____162_CM 1 100. 0. 7.9998779296875 DISPLAY_IDENTIFIER FLOW_CTL_CPS_DI ECU_ADDRESS 0xd0002824 FORMAT "%6.4" /end MEASUREMENT
/begin MEASUREMENT state_cp "State of evaporative emission control function" UBYTE _CNV_S_12_STATE_CP_R_286_CM 1 100. 0. 11. DISPLAY_IDENTIFIER STATE_CP ECU_ADDRESS 0xd00075d7 /end MEASUREMENT
/begin MEASUREMENT t_dly_cp "Canister load check counter in stratified  mode  " UWORD _CNV_A_R_LINEAR_____4_CM 1 100. 0. 6553.5 DISPLAY_IDENTIFIER T_DLY_CP ECU_ADDRESS 0xd0002912 FORMAT "%6.1" /end MEASUREMENT
/begin MEASUREMENT t_dly_cl_mdl "Canister load check counter in stratified  mode  " UWORD _CNV_A_R_LINEAR_____4_CM 1 100. 0. 6553.5 DISPLAY_IDENTIFIER T_DLY_CL_MDL ECU_ADDRESS 0xd0006856 FORMAT "%6.1" /end MEASUREMENT
/begin CHARACTERISTIC c_t_dly_cp "Time between two MAX_PURGE operations for RAMP_OPEN_FAST activation" VALUE 0xa080565e _REC_VAL_20_u2 6553.5 _CNV_A_R_LINEAR_____4_CM 0. 6553.5 DISPLAY_IDENTIFIER C_T_DLY_CP FORMAT "%6.1" /end CHARACTERISTIC
/begin CHARACTERISTIC c_t_dly_cl_mdl "Time between two MAX_PURGE operations for RAMP_OPEN_FAST activation" VALUE 0xa0805656 _REC_VAL_20_u2 6553.5 _CNV_A_R_LINEAR_____4_CM 0. 6553.5 DISPLAY_IDENTIFIER C_T_DLY_CL_MDL FORMAT "%6.1" /end CHARACTERISTIC
/begin CHARACTERISTIC c_flow_cps_grd_purge_tube_close "flow_ctl_cps initialization value " VALUE 0xa08055e0 _REC_VAL_20_u2 7.9998779296875 _CNV_A_R_LINEAR_____162_CM 0. 7.9998779296875 DISPLAY_IDENTIFIER C_FLOW_CPS_GRD_PURGE_TUBE_CLOSE FORMAT "%6.4" /end CHARACTERISTIC
/begin AXIS_PTS ldpm_maf_kgh_cor_ip_t_dly_cp "" 0xa08050bc maf_kgh_fg_pred_cor_cp _REC_AXS_20_u2 2047.96875 _CNV_A_R_LINEAR_____215_CM 6 0. 2047.96875 FORMAT "%10.5" /end AXIS_PTS
/begin CHARACTERISTIC ip_t_dly_cp "Time delay for MAF_CYL (delay time (s)/time recurrence (0.1s))" CURVE 0xa08054e4 _REC_CUR_20_u2_u2 63.99902344 _CNV_A_R_LINEAR_____116_CM 0. 63.99902344 DISPLAY_IDENTIFIER IP_T_DLY_CP FORMAT "%7.4"
 /begin AXIS_DESCR COM_AXIS maf_kgh_fg_pred_cor_cp _CNV_A_R_LINEAR_____215_CM 6 0. 2047.96875 FORMAT "%10.5" AXIS_PTS_REF ldpm_maf_kgh_cor_ip_t_dly_cp /end AXIS_DESCR
/end CHARACTERISTIC
/begin CHARACTERISTIC ip_t_dly_cp_2 "Time delay for MAF_CYL (delay time (s)/time recurrence (0.1s))" CURVE 0xa08054f0 _REC_CUR_20_u2_u2 63.99902344 _CNV_A_R_LINEAR_____116_CM 0. 63.99902344 DISPLAY_IDENTIFIER IP_T_DLY_CP_2 FORMAT "%7.4"
 /begin AXIS_DESCR COM_AXIS maf_kgh_fg_pred_cor_cp _CNV_A_R_LINEAR_____215_CM 6 0. 2047.96875 FORMAT "%10.5" AXIS_PTS_REF ldpm_maf_kgh_cor_ip_t_dly_cp /end AXIS_DESCR
/end CHARACTERISTIC
/begin CHARACTERISTIC ip_flow_max_open_cps "Maximum limit for REL_FLOW_CPS value" MAP 0xa080faa8 _REC_MAP_20_u2_u1_u1 7.9998779296875 _CNV_A_R_LINEAR_____162_CM 0. 7.9998779296875 DISPLAY_IDENTIFIER IP_FLOW_MAX_OPEN_CPS FORMAT "%6.4"
 /begin AXIS_DESCR COM_AXIS n_32 _CNV_A_R_LINEAR_____10_CM 12 0. 8160. FORMAT "%4.0" AXIS_PTS_REF ldpm_n_32_2_evac /end AXIS_DESCR
 /begin AXIS_DESCR COM_AXIS maf_hb _CNV_A_R_LINEAR_____15_CM 12 0. 1389. FORMAT "%4.0" AXIS_PTS_REF ldpm_maf_2_evac /end AXIS_DESCR
/end CHARACTERISTIC
/begin CHARACTERISTIC ip_flow_max_open_cps_2 "Maximum limit for REL_FLOW_CPS value" MAP 0xa080fbc8 _REC_MAP_20_u2_u1_u2 7.9998779296875 _CNV_A_R_LINEAR_____162_CM 0. 7.9998779296875 DISPLAY_IDENTIFIER IP_FLOW_MAX_OPEN_CPS_2 FORMAT "%6.4"
 /begin AXIS_DESCR COM_AXIS n_32 _CNV_A_R_LINEAR_____10_CM 12 0. 8160. FORMAT "%4.0" AXIS_PTS_REF ldpm_n_32_2_evac /end AXIS_DESCR
 /begin AXIS_DESCR COM_AXIS mff_sp_mv _CNV_A_R_LINEAR_____111_CM 12 0. 1389. FORMAT "%7.2" AXIS_PTS_REF ldpm_mff_sp_mv_2_evac /end AXIS_DESCR
/end CHARACTERISTIC
/begin CHARACTERISTIC c_flow_ini_cps "flow_ctl_cps initialization value " VALUE 0xa08055e6 _REC_VAL_20_u2 7.9998779296875 _CNV_A_R_LINEAR_____162_CM 0. 7.9998779296875 DISPLAY_IDENTIFIER C_FLOW_INI_CPS FORMAT "%6.4" /end CHARACTERISTIC
/begin CHARACTERISTIC c_mff_max_cps_di "" VALUE 0xa080560a _REC_VAL_20_u2 7.9998779296875 _CNV_A_R_LINEAR_____162_CM 0. 7.9998779296875 DISPLAY_IDENTIFIER C_MFF_MAX_CPS_DI FORMAT "%6.4" /end CHARACTERISTIC
/begin CHARACTERISTIC ip_flow_inc_fast_cp "Increment value for ramp increase of REL_FLOW_CPS" CURVE 0xa0805388 _REC_CUR_20_u2_u2 7.9998779296875 _CNV_A_R_LINEAR_____115_CM 0. 7.9998779296875 DISPLAY_IDENTIFIER IP_FLOW_INC_FAST_CP FORMAT "%6.4"
 /begin AXIS_DESCR COM_AXIS mff_sp_mv _CNV_A_R_LINEAR_____111_CM 6 0. 1389. FORMAT "%7.2" AXIS_PTS_REF ldpm_mff_sp_mv_1_evac /end AXIS_DESCR
/end CHARACTERISTIC
/begin CHARACTERISTIC ip_flow_inc_cor_hom_cp "" CURVE 0xa0805370 _REC_CUR_20_u2_u2 1.99996948242188 _CNV_A_R_LINEAR_____9_CM 0. 1.99996948242188 DISPLAY_IDENTIFIER IP_FLOW_INC_COR_HOM_CP FORMAT "%7.5"
 /begin AXIS_DESCR COM_AXIS maf_cyl _CNV_A_R_LINEAR_____215_CM 6 0. 2047.96875 FORMAT "%10.5" AXIS_PTS_REF ldpm_maf_cyl_1_evac /end AXIS_DESCR
/end CHARACTERISTIC
/begin CHARACTERISTIC c_t_di_ramp_open_cp_0 "Maximum time for disabling RAMP_OPEN operation (ENG_MODE = 0)" VALUE 0xa0805650 _REC_VAL_20_u2 6553.400000000001 _CNV_A_R_LINEAR_____4_CM 0.1 6553.5 DISPLAY_IDENTIFIER C_T_DI_RAMP_OPEN_CP_0 FORMAT "%6.1" /end CHARACTERISTIC
/begin CHARACTERISTIC c_t_dly_max_cp_0 "Time between two MAX_PURGE operation for RAMP_OPEN_FAST activation (ENG_MODE = 0)" VALUE 0xa080566a _REC_VAL_20_u2 6553.5 _CNV_A_R_LINEAR_____4_CM 0. 6553.5 DISPLAY_IDENTIFIER C_T_DLY_MAX_CP_0 FORMAT "%6.1" /end CHARACTERISTIC
/begin MEASUREMENT maf_cps "Air flow from the CPS to the cylinder" UWORD _CNV_A_R_LINEAR_____162_CM 1 100. 0. 7.9998779296875 DISPLAY_IDENTIFIER MAF_CPS ECU_ADDRESS 0xd000683c FORMAT "%6.4" /end MEASUREMENT
/begin MEASUREMENT maf_int_cp "MAF integal for lambda controller stabilisation in Wait Ramp Open" UWORD _CNV_A_R_LINEAR_____287_CM 1 100. 0. 1820.41666666667 DISPLAY_IDENTIFIER MAF_INT_CP ECU_ADDRESS 0xd000284c FORMAT "%7.2" /end MEASUREMENT
/begin MEASUREMENT t_maf_int_cp "Time limitation for MAF integration at state Wait Ramp Open" UWORD _CNV_A_R_LINEAR_____4_CM 1 100. 0. 6553.5 DISPLAY_IDENTIFIER T_MAF_INT_CP ECU_ADDRESS 0xd0002926 FORMAT "%6.1" /end MEASUREMENT
/begin CHARACTERISTIC c_flow_dly_crlc_cp "Correlation constant for FLOW_CPS_DLY-filter" VALUE 0xa08055e4 _REC_VAL_20_u2 0.9999847412109381 _CNV_A_R_LINEAR_____89_CM 0. 0.9999847412109381 DISPLAY_IDENTIFIER C_FLOW_DLY_CRLC_CP FORMAT "%7.5" /end CHARACTERISTIC
/begin CHARACTERISTIC c_t_dly_max_cp_1 "Time between two MAX_PURGE operation for RAMP_OPEN_FAST activation (ENG_MODE != 0)" VALUE 0xa080566c _REC_VAL_20_u2 6553.5 _CNV_A_R_LINEAR_____4_CM 0. 6553.5 DISPLAY_IDENTIFIER C_T_DLY_MAX_CP_1 FORMAT "%6.1" /end CHARACTERISTIC
/begin CHARACTERISTIC c_t_di_ramp_open_cp_1 "Maximum time for disabling RAMP_OPEN operation (ENG_MODE != 0)" VALUE 0xa0805652 _REC_VAL_20_u2 6553.400000000001 _CNV_A_R_LINEAR_____4_CM 0.1 6553.5 DISPLAY_IDENTIFIER C_T_DI_RAMP_OPEN_CP_1 FORMAT "%6.1" /end CHARACTERISTIC
/begin CHARACTERISTIC c_t_di_ramp_fast_cp_0 "Maximum time for disabling RAMP_OPEN_FAST operation (ENG_MODE = 0)" VALUE 0xa080564c _REC_VAL_20_u2 6553.400000000001 _CNV_A_R_LINEAR_____4_CM 0.1 6553.5 DISPLAY_IDENTIFIER C_T_DI_RAMP_FAST_CP_0 FORMAT "%6.1" /end CHARACTERISTIC
/begin CHARACTERISTIC c_t_di_ramp_fast_cp_1 "Maximum time for disabling RAMP_OPEN_FAST operation (ENG_MODE != 0)" VALUE 0xa080564e _REC_VAL_20_u2 6553.400000000001 _CNV_A_R_LINEAR_____4_CM 0.1 6553.5 DISPLAY_IDENTIFIER C_T_DI_RAMP_FAST_CP_1 FORMAT "%6.1" /end CHARACTERISTIC
/begin CHARACTERISTIC c_t_cp_purge_tube "Time at the start of WAIT_RAMP_OPEN wherein the purge tube may be purged itself" VALUE 0xa0805642 _REC_VAL_20_u2 6553.5 _CNV_A_R_LINEAR_____4_CM 0. 6553.5 DISPLAY_IDENTIFIER C_T_CP_PURGE_TUBE FORMAT "%6.1" /end CHARACTERISTIC
/begin CHARACTERISTIC c_t_max_maf_int_cp "Maximum runtime of MAF integration as stabilisation time for the lambda controler" VALUE 0xa0805682 _REC_VAL_20_u2 6553.5 _CNV_A_R_LINEAR_____4_CM 0. 6553.5 DISPLAY_IDENTIFIER C_T_MAX_MAF_INT_CP FORMAT "%6.1" /end CHARACTERISTIC
/begin CHARACTERISTIC c_t_min_maf_int_cp "Minimum runtime of MAF integration as stabilisation time for the lambda controler" VALUE 0xa0805686 _REC_VAL_20_u2 6553.5 _CNV_A_R_LINEAR_____4_CM 0. 6553.5 DISPLAY_IDENTIFIER C_T_MIN_MAF_INT_CP FORMAT "%6.1" /end CHARACTERISTIC
/begin CHARACTERISTIC c_fac_t_dly_purge_tube_cp "Factor for Gas delay time in Wait Ramp Open" VALUE 0xa08055d6 _REC_VAL_20_u2 3.99993896484375 _CNV_A_R_LINEAR_____24_CM 0. 3.99993896484375 DISPLAY_IDENTIFIER C_FAC_T_DLY_PURGE_TUBE_CP FORMAT "%7.5" /end CHARACTERISTIC
/begin CHARACTERISTIC c_mff_ratio_flow_ini_cp "Fuel Ratio for calculation of flow setpoint at re-entry in Max Purge" VALUE 0xa080560e _REC_VAL_20_u2 0.9999847412109381 _CNV_A_R_LINEAR_____89_CM 0. 0.9999847412109381 DISPLAY_IDENTIFIER C_MFF_RATIO_FLOW_INI_CP FORMAT "%7.5" /end CHARACTERISTIC
/begin CHARACTERISTIC c_maf_int_max_cp_0 "MAF integral threshold for lambda controller stabilisation in Wait Ramp Open (ENG_MODE = 0)" VALUE 0xa0805606 _REC_VAL_20_u2 1820.41666666667 _CNV_A_R_LINEAR_____287_CM 0. 1820.41666666667 DISPLAY_IDENTIFIER C_MAF_INT_MAX_CP_0 FORMAT "%7.2" /end CHARACTERISTIC
/begin CHARACTERISTIC c_maf_int_max_cp_1 "MAF integral threshold for lambda controller stabilisation in Wait Ramp Open (ENG_MODE != 0)" VALUE 0xa0805608 _REC_VAL_20_u2 1820.41666666667 _CNV_A_R_LINEAR_____287_CM 0. 1820.41666666667 DISPLAY_IDENTIFIER C_MAF_INT_MAX_CP_1 FORMAT "%7.2" /end CHARACTERISTIC
/begin CHARACTERISTIC c_t_di_max_cp_0 "Maximum time for disabling MAX_PURGE operation (ENG_MODE = 0)" VALUE 0xa0805648 _REC_VAL_20_u2 6553.400000000001 _CNV_A_R_LINEAR_____4_CM 0.1 6553.5 DISPLAY_IDENTIFIER C_T_DI_MAX_CP_0 FORMAT "%6.1" /end CHARACTERISTIC
/begin CHARACTERISTIC c_t_di_max_cp_1 "Maximum time for disabling MAX_PURGE operation (ENG_MODE != 0)" VALUE 0xa080564a _REC_VAL_20_u2 6553.400000000001 _CNV_A_R_LINEAR_____4_CM 0.1 6553.5 DISPLAY_IDENTIFIER C_T_DI_MAX_CP_1 FORMAT "%6.1" /end CHARACTERISTIC
/begin MEASUREMENT tqi_add_cp "CP torque gain " SWORD _CNV_A_R_LINEAR_____31_CM 1 100. -1024. 1023.96875 DISPLAY_IDENTIFIER TQI_ADD_CP ECU_ADDRESS 0xd000685c FORMAT "%11.5" /end MEASUREMENT
/begin MEASUREMENT mff_cps "" UWORD _CNV_A_R_LINEAR_____111_CM 1 100. 0. 1389. DISPLAY_IDENTIFIER MFF_CPS ECU_ADDRESS 0xd00028f2 FORMAT "%7.2" /end MEASUREMENT
/begin MEASUREMENT mff_buf_cp "fuel flow from the CPS to the cylinder" UWORD _CNV_A_R_LINEAR_____162_CM 1 100. 0. 7.9998779296875 DISPLAY_IDENTIFIER MFF_BUF_CP ECU_ADDRESS 0xd0006848 FORMAT "%6.4" /end MEASUREMENT
/begin MEASUREMENT mff_tot_cp "total of FUEL_CPS during emission cycle" ULONG _CNV_A_R_EVAC_LINEA_285_CM 1 100. 0. 1456. DISPLAY_IDENTIFIER MFF_TOT_CP ECU_ADDRESS 0xd0002930 FORMAT "%11.6" /end MEASUREMENT
/begin CHARACTERISTIC ip_crlc_mff_buf_cp "ratio for FUEL_CPS calculation" CURVE 0xa08052d4 _REC_CUR_20_u1_u2 0.99609375 _CNV_A_R_LINEAR_____28_CM 0. 0.99609375 DISPLAY_IDENTIFIER IP_CRLC_MFF_BUF_CP FORMAT "%5.3"
 /begin AXIS_DESCR COM_AXIS maf_cyl _CNV_A_R_LINEAR_____215_CM 6 0. 2047.96875 FORMAT "%10.5" AXIS_PTS_REF ldpm_maf_cyl_1_evac /end AXIS_DESCR
/end CHARACTERISTIC
/begin MEASUREMENT mff_add_buf[0] "array of FUEL_FLOW_ADD_AD_CP values(20 values) " UWORD _CNV_A_R_LINEAR_____89_CM 1 100. 0. 0.9999847412109381 DISPLAY_IDENTIFIER MFF_ADD_BUF[0] ECU_ADDRESS 0xd0002850 FORMAT "%7.5" /end MEASUREMENT
/begin MEASUREMENT mff_add_buf[1] "array of FUEL_FLOW_ADD_AD_CP values(20 values) " UWORD _CNV_A_R_LINEAR_____89_CM 1 100. 0. 0.9999847412109381 DISPLAY_IDENTIFIER MFF_ADD_BUF[1] ECU_ADDRESS 0xd0002852 FORMAT "%7.5" /end MEASUREMENT
/begin MEASUREMENT mff_add_buf[2] "array of FUEL_FLOW_ADD_AD_CP values(20 values) " UWORD _CNV_A_R_LINEAR_____89_CM 1 100. 0. 0.9999847412109381 DISPLAY_IDENTIFIER MFF_ADD_BUF[2] ECU_ADDRESS 0xd0002854 FORMAT "%7.5" /end MEASUREMENT
/begin MEASUREMENT mff_add_buf[3] "array of FUEL_FLOW_ADD_AD_CP values(20 values) " UWORD _CNV_A_R_LINEAR_____89_CM 1 100. 0. 0.9999847412109381 DISPLAY_IDENTIFIER MFF_ADD_BUF[3] ECU_ADDRESS 0xd0002856 FORMAT "%7.5" /end MEASUREMENT
/begin MEASUREMENT mff_add_buf[4] "array of FUEL_FLOW_ADD_AD_CP values(20 values) " UWORD _CNV_A_R_LINEAR_____89_CM 1 100. 0. 0.9999847412109381 DISPLAY_IDENTIFIER MFF_ADD_BUF[4] ECU_ADDRESS 0xd0002858 FORMAT "%7.5" /end MEASUREMENT
/begin MEASUREMENT mff_add_buf[5] "array of FUEL_FLOW_ADD_AD_CP values(20 values) " UWORD _CNV_A_R_LINEAR_____89_CM 1 100. 0. 0.9999847412109381 DISPLAY_IDENTIFIER MFF_ADD_BUF[5] ECU_ADDRESS 0xd000285a FORMAT "%7.5" /end MEASUREMENT
/begin MEASUREMENT mff_add_buf[6] "array of FUEL_FLOW_ADD_AD_CP values(20 values) " UWORD _CNV_A_R_LINEAR_____89_CM 1 100. 0. 0.9999847412109381 DISPLAY_IDENTIFIER MFF_ADD_BUF[6] ECU_ADDRESS 0xd000285c FORMAT "%7.5" /end MEASUREMENT
/begin MEASUREMENT mff_add_buf[7] "array of FUEL_FLOW_ADD_AD_CP values(20 values) " UWORD _CNV_A_R_LINEAR_____89_CM 1 100. 0. 0.9999847412109381 DISPLAY_IDENTIFIER MFF_ADD_BUF[7] ECU_ADDRESS 0xd000285e FORMAT "%7.5" /end MEASUREMENT
/begin MEASUREMENT mff_add_buf[8] "array of FUEL_FLOW_ADD_AD_CP values(20 values) " UWORD _CNV_A_R_LINEAR_____89_CM 1 100. 0. 0.9999847412109381 DISPLAY_IDENTIFIER MFF_ADD_BUF[8] ECU_ADDRESS 0xd0002860 FORMAT "%7.5" /end MEASUREMENT
/begin MEASUREMENT mff_add_buf[9] "array of FUEL_FLOW_ADD_AD_CP values(20 values) " UWORD _CNV_A_R_LINEAR_____89_CM 1 100. 0. 0.9999847412109381 DISPLAY_IDENTIFIER MFF_ADD_BUF[9] ECU_ADDRESS 0xd0002862 FORMAT "%7.5" /end MEASUREMENT
/begin MEASUREMENT mff_add_buf[10] "array of FUEL_FLOW_ADD_AD_CP values(20 values) " UWORD _CNV_A_R_LINEAR_____89_CM 1 100. 0. 0.9999847412109381 DISPLAY_IDENTIFIER MFF_ADD_BUF[10] ECU_ADDRESS 0xd0002864 FORMAT "%7.5" /end MEASUREMENT
/begin MEASUREMENT mff_add_buf[11] "array of FUEL_FLOW_ADD_AD_CP values(20 values) " UWORD _CNV_A_R_LINEAR_____89_CM 1 100. 0. 0.9999847412109381 DISPLAY_IDENTIFIER MFF_ADD_BUF[11] ECU_ADDRESS 0xd0002866 FORMAT "%7.5" /end MEASUREMENT
/begin MEASUREMENT mff_add_buf[12] "array of FUEL_FLOW_ADD_AD_CP values(20 values) " UWORD _CNV_A_R_LINEAR_____89_CM 1 100. 0. 0.9999847412109381 DISPLAY_IDENTIFIER MFF_ADD_BUF[12] ECU_ADDRESS 0xd0002868 FORMAT "%7.5" /end MEASUREMENT
/begin MEASUREMENT mff_add_buf[13] "array of FUEL_FLOW_ADD_AD_CP values(20 values) " UWORD _CNV_A_R_LINEAR_____89_CM 1 100. 0. 0.9999847412109381 DISPLAY_IDENTIFIER MFF_ADD_BUF[13] ECU_ADDRESS 0xd000286a FORMAT "%7.5" /end MEASUREMENT
/begin MEASUREMENT mff_add_buf[14] "array of FUEL_FLOW_ADD_AD_CP values(20 values) " UWORD _CNV_A_R_LINEAR_____89_CM 1 100. 0. 0.9999847412109381 DISPLAY_IDENTIFIER MFF_ADD_BUF[14] ECU_ADDRESS 0xd000286c FORMAT "%7.5" /end MEASUREMENT
/begin MEASUREMENT mff_add_buf[15] "array of FUEL_FLOW_ADD_AD_CP values(20 values) " UWORD _CNV_A_R_LINEAR_____89_CM 1 100. 0. 0.9999847412109381 DISPLAY_IDENTIFIER MFF_ADD_BUF[15] ECU_ADDRESS 0xd000286e FORMAT "%7.5" /end MEASUREMENT
/begin MEASUREMENT mff_add_buf[16] "array of FUEL_FLOW_ADD_AD_CP values(20 values) " UWORD _CNV_A_R_LINEAR_____89_CM 1 100. 0. 0.9999847412109381 DISPLAY_IDENTIFIER MFF_ADD_BUF[16] ECU_ADDRESS 0xd0002870 FORMAT "%7.5" /end MEASUREMENT
/begin MEASUREMENT mff_add_buf[17] "array of FUEL_FLOW_ADD_AD_CP values(20 values) " UWORD _CNV_A_R_LINEAR_____89_CM 1 100. 0. 0.9999847412109381 DISPLAY_IDENTIFIER MFF_ADD_BUF[17] ECU_ADDRESS 0xd0002872 FORMAT "%7.5" /end MEASUREMENT
/begin MEASUREMENT mff_add_buf[18] "array of FUEL_FLOW_ADD_AD_CP values(20 values) " UWORD _CNV_A_R_LINEAR_____89_CM 1 100. 0. 0.9999847412109381 DISPLAY_IDENTIFIER MFF_ADD_BUF[18] ECU_ADDRESS 0xd0002874 FORMAT "%7.5" /end MEASUREMENT
/begin MEASUREMENT mff_add_buf[19] "array of FUEL_FLOW_ADD_AD_CP values(20 values) " UWORD _CNV_A_R_LINEAR_____89_CM 1 100. 0. 0.9999847412109381 DISPLAY_IDENTIFIER MFF_ADD_BUF[19] ECU_ADDRESS 0xd0002876 FORMAT "%7.5" /end MEASUREMENT
/begin MEASUREMENT mff_add_buf[20] "array of FUEL_FLOW_ADD_AD_CP values(20 values) " UWORD _CNV_A_R_LINEAR_____89_CM 1 100. 0. 0.9999847412109381 DISPLAY_IDENTIFIER MFF_ADD_BUF[20] ECU_ADDRESS 0xd0002878 FORMAT "%7.5" /end MEASUREMENT
/begin MEASUREMENT mff_add_buf[21] "array of FUEL_FLOW_ADD_AD_CP values(20 values) " UWORD _CNV_A_R_LINEAR_____89_CM 1 100. 0. 0.9999847412109381 DISPLAY_IDENTIFIER MFF_ADD_BUF[21] ECU_ADDRESS 0xd000287a FORMAT "%7.5" /end MEASUREMENT
/begin MEASUREMENT mff_add_buf[22] "array of FUEL_FLOW_ADD_AD_CP values(20 values) " UWORD _CNV_A_R_LINEAR_____89_CM 1 100. 0. 0.9999847412109381 DISPLAY_IDENTIFIER MFF_ADD_BUF[22] ECU_ADDRESS 0xd000287c FORMAT "%7.5" /end MEASUREMENT
/begin MEASUREMENT mff_add_buf[23] "array of FUEL_FLOW_ADD_AD_CP values(20 values) " UWORD _CNV_A_R_LINEAR_____89_CM 1 100. 0. 0.9999847412109381 DISPLAY_IDENTIFIER MFF_ADD_BUF[23] ECU_ADDRESS 0xd000287e FORMAT "%7.5" /end MEASUREMENT
/begin MEASUREMENT mff_add_buf[24] "array of FUEL_FLOW_ADD_AD_CP values(20 values) " UWORD _CNV_A_R_LINEAR_____89_CM 1 100. 0. 0.9999847412109381 DISPLAY_IDENTIFIER MFF_ADD_BUF[24] ECU_ADDRESS 0xd0002880 FORMAT "%7.5" /end MEASUREMENT
/begin MEASUREMENT mff_add_buf[25] "array of FUEL_FLOW_ADD_AD_CP values(20 values) " UWORD _CNV_A_R_LINEAR_____89_CM 1 100. 0. 0.9999847412109381 DISPLAY_IDENTIFIER MFF_ADD_BUF[25] ECU_ADDRESS 0xd0002882 FORMAT "%7.5" /end MEASUREMENT
/begin MEASUREMENT mff_add_buf[26] "array of FUEL_FLOW_ADD_AD_CP values(20 values) " UWORD _CNV_A_R_LINEAR_____89_CM 1 100. 0. 0.9999847412109381 DISPLAY_IDENTIFIER MFF_ADD_BUF[26] ECU_ADDRESS 0xd0002884 FORMAT "%7.5" /end MEASUREMENT
/begin MEASUREMENT mff_add_buf[27] "array of FUEL_FLOW_ADD_AD_CP values(20 values) " UWORD _CNV_A_R_LINEAR_____89_CM 1 100. 0. 0.9999847412109381 DISPLAY_IDENTIFIER MFF_ADD_BUF[27] ECU_ADDRESS 0xd0002886 FORMAT "%7.5" /end MEASUREMENT
/begin MEASUREMENT mff_add_buf[28] "array of FUEL_FLOW_ADD_AD_CP values(20 values) " UWORD _CNV_A_R_LINEAR_____89_CM 1 100. 0. 0.9999847412109381 DISPLAY_IDENTIFIER MFF_ADD_BUF[28] ECU_ADDRESS 0xd0002888 FORMAT "%7.5" /end MEASUREMENT
/begin MEASUREMENT mff_add_buf[29] "array of FUEL_FLOW_ADD_AD_CP values(20 values) " UWORD _CNV_A_R_LINEAR_____89_CM 1 100. 0. 0.9999847412109381 DISPLAY_IDENTIFIER MFF_ADD_BUF[29] ECU_ADDRESS 0xd000288a FORMAT "%7.5" /end MEASUREMENT
/begin MEASUREMENT mff_add_buf[30] "array of FUEL_FLOW_ADD_AD_CP values(20 values) " UWORD _CNV_A_R_LINEAR_____89_CM 1 100. 0. 0.9999847412109381 DISPLAY_IDENTIFIER MFF_ADD_BUF[30] ECU_ADDRESS 0xd000288c FORMAT "%7.5" /end MEASUREMENT
/begin MEASUREMENT mff_add_buf[31] "array of FUEL_FLOW_ADD_AD_CP values(20 values) " UWORD _CNV_A_R_LINEAR_____89_CM 1 100. 0. 0.9999847412109381 DISPLAY_IDENTIFIER MFF_ADD_BUF[31] ECU_ADDRESS 0xd000288e FORMAT "%7.5" /end MEASUREMENT
/begin MEASUREMENT mff_add_buf[32] "array of FUEL_FLOW_ADD_AD_CP values(20 values) " UWORD _CNV_A_R_LINEAR_____89_CM 1 100. 0. 0.9999847412109381 DISPLAY_IDENTIFIER MFF_ADD_BUF[32] ECU_ADDRESS 0xd0002890 FORMAT "%7.5" /end MEASUREMENT
/begin MEASUREMENT mff_add_buf[33] "array of FUEL_FLOW_ADD_AD_CP values(20 values) " UWORD _CNV_A_R_LINEAR_____89_CM 1 100. 0. 0.9999847412109381 DISPLAY_IDENTIFIER MFF_ADD_BUF[33] ECU_ADDRESS 0xd0002892 FORMAT "%7.5" /end MEASUREMENT
/begin MEASUREMENT mff_add_buf[34] "array of FUEL_FLOW_ADD_AD_CP values(20 values) " UWORD _CNV_A_R_LINEAR_____89_CM 1 100. 0. 0.9999847412109381 DISPLAY_IDENTIFIER MFF_ADD_BUF[34] ECU_ADDRESS 0xd0002894 FORMAT "%7.5" /end MEASUREMENT
/begin MEASUREMENT mff_add_buf[35] "array of FUEL_FLOW_ADD_AD_CP values(20 values) " UWORD _CNV_A_R_LINEAR_____89_CM 1 100. 0. 0.9999847412109381 DISPLAY_IDENTIFIER MFF_ADD_BUF[35] ECU_ADDRESS 0xd0002896 FORMAT "%7.5" /end MEASUREMENT
/begin MEASUREMENT mff_add_buf[36] "array of FUEL_FLOW_ADD_AD_CP values(20 values) " UWORD _CNV_A_R_LINEAR_____89_CM 1 100. 0. 0.9999847412109381 DISPLAY_IDENTIFIER MFF_ADD_BUF[36] ECU_ADDRESS 0xd0002898 FORMAT "%7.5" /end MEASUREMENT
/begin MEASUREMENT mff_add_buf[37] "array of FUEL_FLOW_ADD_AD_CP values(20 values) " UWORD _CNV_A_R_LINEAR_____89_CM 1 100. 0. 0.9999847412109381 DISPLAY_IDENTIFIER MFF_ADD_BUF[37] ECU_ADDRESS 0xd000289a FORMAT "%7.5" /end MEASUREMENT
/begin MEASUREMENT mff_add_buf[38] "array of FUEL_FLOW_ADD_AD_CP values(20 values) " UWORD _CNV_A_R_LINEAR_____89_CM 1 100. 0. 0.9999847412109381 DISPLAY_IDENTIFIER MFF_ADD_BUF[38] ECU_ADDRESS 0xd000289c FORMAT "%7.5" /end MEASUREMENT
/begin MEASUREMENT mff_add_buf[39] "array of FUEL_FLOW_ADD_AD_CP values(20 values) " UWORD _CNV_A_R_LINEAR_____89_CM 1 100. 0. 0.9999847412109381 DISPLAY_IDENTIFIER MFF_ADD_BUF[39] ECU_ADDRESS 0xd000289e FORMAT "%7.5" /end MEASUREMENT
/begin MEASUREMENT mff_add_buf[40] "array of FUEL_FLOW_ADD_AD_CP values(20 values) " UWORD _CNV_A_R_LINEAR_____89_CM 1 100. 0. 0.9999847412109381 DISPLAY_IDENTIFIER MFF_ADD_BUF[40] ECU_ADDRESS 0xd00028a0 FORMAT "%7.5" /end MEASUREMENT
/begin MEASUREMENT mff_add_buf[41] "array of FUEL_FLOW_ADD_AD_CP values(20 values) " UWORD _CNV_A_R_LINEAR_____89_CM 1 100. 0. 0.9999847412109381 DISPLAY_IDENTIFIER MFF_ADD_BUF[41] ECU_ADDRESS 0xd00028a2 FORMAT "%7.5" /end MEASUREMENT
/begin MEASUREMENT mff_add_buf[42] "array of FUEL_FLOW_ADD_AD_CP values(20 values) " UWORD _CNV_A_R_LINEAR_____89_CM 1 100. 0. 0.9999847412109381 DISPLAY_IDENTIFIER MFF_ADD_BUF[42] ECU_ADDRESS 0xd00028a4 FORMAT "%7.5" /end MEASUREMENT
/begin MEASUREMENT mff_add_buf[43] "array of FUEL_FLOW_ADD_AD_CP values(20 values) " UWORD _CNV_A_R_LINEAR_____89_CM 1 100. 0. 0.9999847412109381 DISPLAY_IDENTIFIER MFF_ADD_BUF[43] ECU_ADDRESS 0xd00028a6 FORMAT "%7.5" /end MEASUREMENT
/begin MEASUREMENT mff_add_buf[44] "array of FUEL_FLOW_ADD_AD_CP values(20 values) " UWORD _CNV_A_R_LINEAR_____89_CM 1 100. 0. 0.9999847412109381 DISPLAY_IDENTIFIER MFF_ADD_BUF[44] ECU_ADDRESS 0xd00028a8 FORMAT "%7.5" /end MEASUREMENT
/begin MEASUREMENT mff_add_buf[45] "array of FUEL_FLOW_ADD_AD_CP values(20 values) " UWORD _CNV_A_R_LINEAR_____89_CM 1 100. 0. 0.9999847412109381 DISPLAY_IDENTIFIER MFF_ADD_BUF[45] ECU_ADDRESS 0xd00028aa FORMAT "%7.5" /end MEASUREMENT
/begin MEASUREMENT mff_add_buf[46] "array of FUEL_FLOW_ADD_AD_CP values(20 values) " UWORD _CNV_A_R_LINEAR_____89_CM 1 100. 0. 0.9999847412109381 DISPLAY_IDENTIFIER MFF_ADD_BUF[46] ECU_ADDRESS 0xd00028ac FORMAT "%7.5" /end MEASUREMENT
/begin MEASUREMENT mff_add_buf[47] "array of FUEL_FLOW_ADD_AD_CP values(20 values) " UWORD _CNV_A_R_LINEAR_____89_CM 1 100. 0. 0.9999847412109381 DISPLAY_IDENTIFIER MFF_ADD_BUF[47] ECU_ADDRESS 0xd00028ae FORMAT "%7.5" /end MEASUREMENT
/begin MEASUREMENT mff_add_buf[48] "array of FUEL_FLOW_ADD_AD_CP values(20 values) " UWORD _CNV_A_R_LINEAR_____89_CM 1 100. 0. 0.9999847412109381 DISPLAY_IDENTIFIER MFF_ADD_BUF[48] ECU_ADDRESS 0xd00028b0 FORMAT "%7.5" /end MEASUREMENT
/begin MEASUREMENT mff_add_buf[49] "array of FUEL_FLOW_ADD_AD_CP values(20 values) " UWORD _CNV_A_R_LINEAR_____89_CM 1 100. 0. 0.9999847412109381 DISPLAY_IDENTIFIER MFF_ADD_BUF[49] ECU_ADDRESS 0xd00028b2 FORMAT "%7.5" /end MEASUREMENT
/begin MEASUREMENT mff_add_buf[50] "array of FUEL_FLOW_ADD_AD_CP values(20 values) " UWORD _CNV_A_R_LINEAR_____89_CM 1 100. 0. 0.9999847412109381 DISPLAY_IDENTIFIER MFF_ADD_BUF[50] ECU_ADDRESS 0xd00028b4 FORMAT "%7.5" /end MEASUREMENT
/begin MEASUREMENT mff_add_buf[51] "array of FUEL_FLOW_ADD_AD_CP values(20 values) " UWORD _CNV_A_R_LINEAR_____89_CM 1 100. 0. 0.9999847412109381 DISPLAY_IDENTIFIER MFF_ADD_BUF[51] ECU_ADDRESS 0xd00028b6 FORMAT "%7.5" /end MEASUREMENT
/begin MEASUREMENT mff_add_buf[52] "array of FUEL_FLOW_ADD_AD_CP values(20 values) " UWORD _CNV_A_R_LINEAR_____89_CM 1 100. 0. 0.9999847412109381 DISPLAY_IDENTIFIER MFF_ADD_BUF[52] ECU_ADDRESS 0xd00028b8 FORMAT "%7.5" /end MEASUREMENT
/begin MEASUREMENT mff_add_buf[53] "array of FUEL_FLOW_ADD_AD_CP values(20 values) " UWORD _CNV_A_R_LINEAR_____89_CM 1 100. 0. 0.9999847412109381 DISPLAY_IDENTIFIER MFF_ADD_BUF[53] ECU_ADDRESS 0xd00028ba FORMAT "%7.5" /end MEASUREMENT
/begin MEASUREMENT mff_add_buf[54] "array of FUEL_FLOW_ADD_AD_CP values(20 values) " UWORD _CNV_A_R_LINEAR_____89_CM 1 100. 0. 0.9999847412109381 DISPLAY_IDENTIFIER MFF_ADD_BUF[54] ECU_ADDRESS 0xd00028bc FORMAT "%7.5" /end MEASUREMENT
/begin MEASUREMENT mff_add_buf[55] "array of FUEL_FLOW_ADD_AD_CP values(20 values) " UWORD _CNV_A_R_LINEAR_____89_CM 1 100. 0. 0.9999847412109381 DISPLAY_IDENTIFIER MFF_ADD_BUF[55] ECU_ADDRESS 0xd00028be FORMAT "%7.5" /end MEASUREMENT
/begin MEASUREMENT mff_add_buf[56] "array of FUEL_FLOW_ADD_AD_CP values(20 values) " UWORD _CNV_A_R_LINEAR_____89_CM 1 100. 0. 0.9999847412109381 DISPLAY_IDENTIFIER MFF_ADD_BUF[56] ECU_ADDRESS 0xd00028c0 FORMAT "%7.5" /end MEASUREMENT
/begin MEASUREMENT mff_add_buf[57] "array of FUEL_FLOW_ADD_AD_CP values(20 values) " UWORD _CNV_A_R_LINEAR_____89_CM 1 100. 0. 0.9999847412109381 DISPLAY_IDENTIFIER MFF_ADD_BUF[57] ECU_ADDRESS 0xd00028c2 FORMAT "%7.5" /end MEASUREMENT
/begin MEASUREMENT mff_add_buf[58] "array of FUEL_FLOW_ADD_AD_CP values(20 values) " UWORD _CNV_A_R_LINEAR_____89_CM 1 100. 0. 0.9999847412109381 DISPLAY_IDENTIFIER MFF_ADD_BUF[58] ECU_ADDRESS 0xd00028c4 FORMAT "%7.5" /end MEASUREMENT
/begin MEASUREMENT mff_add_buf[59] "array of FUEL_FLOW_ADD_AD_CP values(20 values) " UWORD _CNV_A_R_LINEAR_____89_CM 1 100. 0. 0.9999847412109381 DISPLAY_IDENTIFIER MFF_ADD_BUF[59] ECU_ADDRESS 0xd00028c6 FORMAT "%7.5" /end MEASUREMENT
/begin MEASUREMENT mff_add_buf[60] "array of FUEL_FLOW_ADD_AD_CP values(20 values) " UWORD _CNV_A_R_LINEAR_____89_CM 1 100. 0. 0.9999847412109381 DISPLAY_IDENTIFIER MFF_ADD_BUF[60] ECU_ADDRESS 0xd00028c8 FORMAT "%7.5" /end MEASUREMENT
/begin MEASUREMENT mff_add_buf[61] "array of FUEL_FLOW_ADD_AD_CP values(20 values) " UWORD _CNV_A_R_LINEAR_____89_CM 1 100. 0. 0.9999847412109381 DISPLAY_IDENTIFIER MFF_ADD_BUF[61] ECU_ADDRESS 0xd00028ca FORMAT "%7.5" /end MEASUREMENT
/begin MEASUREMENT mff_add_buf[62] "array of FUEL_FLOW_ADD_AD_CP values(20 values) " UWORD _CNV_A_R_LINEAR_____89_CM 1 100. 0. 0.9999847412109381 DISPLAY_IDENTIFIER MFF_ADD_BUF[62] ECU_ADDRESS 0xd00028cc FORMAT "%7.5" /end MEASUREMENT
/begin MEASUREMENT mff_add_buf[63] "array of FUEL_FLOW_ADD_AD_CP values(20 values) " UWORD _CNV_A_R_LINEAR_____89_CM 1 100. 0. 0.9999847412109381 DISPLAY_IDENTIFIER MFF_ADD_BUF[63] ECU_ADDRESS 0xd00028ce FORMAT "%7.5" /end MEASUREMENT
/begin MEASUREMENT mff_add_buf[64] "array of FUEL_FLOW_ADD_AD_CP values(20 values) " UWORD _CNV_A_R_LINEAR_____89_CM 1 100. 0. 0.9999847412109381 DISPLAY_IDENTIFIER MFF_ADD_BUF[64] ECU_ADDRESS 0xd00028d0 FORMAT "%7.5" /end MEASUREMENT
/begin MEASUREMENT mff_add_buf[65] "array of FUEL_FLOW_ADD_AD_CP values(20 values) " UWORD _CNV_A_R_LINEAR_____89_CM 1 100. 0. 0.9999847412109381 DISPLAY_IDENTIFIER MFF_ADD_BUF[65] ECU_ADDRESS 0xd00028d2 FORMAT "%7.5" /end MEASUREMENT
/begin MEASUREMENT mff_add_buf[66] "array of FUEL_FLOW_ADD_AD_CP values(20 values) " UWORD _CNV_A_R_LINEAR_____89_CM 1 100. 0. 0.9999847412109381 DISPLAY_IDENTIFIER MFF_ADD_BUF[66] ECU_ADDRESS 0xd00028d4 FORMAT "%7.5" /end MEASUREMENT
/begin MEASUREMENT mff_add_buf[67] "array of FUEL_FLOW_ADD_AD_CP values(20 values) " UWORD _CNV_A_R_LINEAR_____89_CM 1 100. 0. 0.9999847412109381 DISPLAY_IDENTIFIER MFF_ADD_BUF[67] ECU_ADDRESS 0xd00028d6 FORMAT "%7.5" /end MEASUREMENT
/begin MEASUREMENT mff_add_buf[68] "array of FUEL_FLOW_ADD_AD_CP values(20 values) " UWORD _CNV_A_R_LINEAR_____89_CM 1 100. 0. 0.9999847412109381 DISPLAY_IDENTIFIER MFF_ADD_BUF[68] ECU_ADDRESS 0xd00028d8 FORMAT "%7.5" /end MEASUREMENT
/begin MEASUREMENT mff_add_buf[69] "array of FUEL_FLOW_ADD_AD_CP values(20 values) " UWORD _CNV_A_R_LINEAR_____89_CM 1 100. 0. 0.9999847412109381 DISPLAY_IDENTIFIER MFF_ADD_BUF[69] ECU_ADDRESS 0xd00028da FORMAT "%7.5" /end MEASUREMENT
/begin MEASUREMENT mff_add_buf[70] "array of FUEL_FLOW_ADD_AD_CP values(20 values) " UWORD _CNV_A_R_LINEAR_____89_CM 1 100. 0. 0.9999847412109381 DISPLAY_IDENTIFIER MFF_ADD_BUF[70] ECU_ADDRESS 0xd00028dc FORMAT "%7.5" /end MEASUREMENT
/begin MEASUREMENT mff_add_buf[71] "array of FUEL_FLOW_ADD_AD_CP values(20 values) " UWORD _CNV_A_R_LINEAR_____89_CM 1 100. 0. 0.9999847412109381 DISPLAY_IDENTIFIER MFF_ADD_BUF[71] ECU_ADDRESS 0xd00028de FORMAT "%7.5" /end MEASUREMENT
/begin MEASUREMENT mff_add_buf[72] "array of FUEL_FLOW_ADD_AD_CP values(20 values) " UWORD _CNV_A_R_LINEAR_____89_CM 1 100. 0. 0.9999847412109381 DISPLAY_IDENTIFIER MFF_ADD_BUF[72] ECU_ADDRESS 0xd00028e0 FORMAT "%7.5" /end MEASUREMENT
/begin MEASUREMENT mff_add_buf[73] "array of FUEL_FLOW_ADD_AD_CP values(20 values) " UWORD _CNV_A_R_LINEAR_____89_CM 1 100. 0. 0.9999847412109381 DISPLAY_IDENTIFIER MFF_ADD_BUF[73] ECU_ADDRESS 0xd00028e2 FORMAT "%7.5" /end MEASUREMENT
/begin MEASUREMENT mff_add_buf[74] "array of FUEL_FLOW_ADD_AD_CP values(20 values) " UWORD _CNV_A_R_LINEAR_____89_CM 1 100. 0. 0.9999847412109381 DISPLAY_IDENTIFIER MFF_ADD_BUF[74] ECU_ADDRESS 0xd00028e4 FORMAT "%7.5" /end MEASUREMENT
/begin MEASUREMENT mff_add_buf[75] "array of FUEL_FLOW_ADD_AD_CP values(20 values) " UWORD _CNV_A_R_LINEAR_____89_CM 1 100. 0. 0.9999847412109381 DISPLAY_IDENTIFIER MFF_ADD_BUF[75] ECU_ADDRESS 0xd00028e6 FORMAT "%7.5" /end MEASUREMENT
/begin MEASUREMENT mff_add_buf[76] "array of FUEL_FLOW_ADD_AD_CP values(20 values) " UWORD _CNV_A_R_LINEAR_____89_CM 1 100. 0. 0.9999847412109381 DISPLAY_IDENTIFIER MFF_ADD_BUF[76] ECU_ADDRESS 0xd00028e8 FORMAT "%7.5" /end MEASUREMENT
/begin MEASUREMENT mff_add_buf[77] "array of FUEL_FLOW_ADD_AD_CP values(20 values) " UWORD _CNV_A_R_LINEAR_____89_CM 1 100. 0. 0.9999847412109381 DISPLAY_IDENTIFIER MFF_ADD_BUF[77] ECU_ADDRESS 0xd00028ea FORMAT "%7.5" /end MEASUREMENT
/begin MEASUREMENT mff_add_buf[78] "array of FUEL_FLOW_ADD_AD_CP values(20 values) " UWORD _CNV_A_R_LINEAR_____89_CM 1 100. 0. 0.9999847412109381 DISPLAY_IDENTIFIER MFF_ADD_BUF[78] ECU_ADDRESS 0xd00028ec FORMAT "%7.5" /end MEASUREMENT
/begin MEASUREMENT mff_add_buf[79] "array of FUEL_FLOW_ADD_AD_CP values(20 values) " UWORD _CNV_A_R_LINEAR_____89_CM 1 100. 0. 0.9999847412109381 DISPLAY_IDENTIFIER MFF_ADD_BUF[79] ECU_ADDRESS 0xd00028ee FORMAT "%7.5" /end MEASUREMENT
/begin MEASUREMENT buf_inp_cp "array of FUEL_FLOW_ADD_AD_CP values(20 values) " UWORD _CNV_A_R_LINEAR_____89_CM 1 100. 0. 0.9999847412109381 DISPLAY_IDENTIFIER BUF_INP_CP ECU_ADDRESS 0xd00027f8 FORMAT "%7.5" /end MEASUREMENT
/begin MEASUREMENT buf_out_cp "array of FUEL_FLOW_ADD_AD_CP values(20 values) " UWORD _CNV_A_R_LINEAR_____162_CM 1 100. 0. 7.9998779296875 DISPLAY_IDENTIFIER BUF_OUT_CP ECU_ADDRESS 0xd00027fa FORMAT "%6.4" /end MEASUREMENT
/begin CHARACTERISTIC ip_mff_dly_cp "delay for FUEL_CPS calculation" CURVE 0xa0805404 _REC_CUR_20_u1_u2 255. _CNV_A_R_LINEAR_____0_CM 0. 255. DISPLAY_IDENTIFIER IP_MFF_DLY_CP FORMAT "%3.0"
 /begin AXIS_DESCR COM_AXIS maf_cyl _CNV_A_R_LINEAR_____215_CM 6 0. 2047.96875 FORMAT "%10.5" AXIS_PTS_REF ldpm_maf_cyl_1_evac_mff_dly_cp /end AXIS_DESCR
/end CHARACTERISTIC
/begin CHARACTERISTIC lc_flow_cps_cal "Choice of  recurence for fuel_flow_add_ad_cp calculation" VALUE 0xa08056ce _REC_VAL_20_u1 1. _CNV_A_R_LINEAR_____0_CM 0. 1. DISPLAY_IDENTIFIER LC_FLOW_CPS_CAL FORMAT "%1.0" /end CHARACTERISTIC
/begin MEASUREMENT maf_kgh_fg_pred_cor_cp "predicted fresh gas out of manifold corrected by MAP & TIA" UWORD _CNV_A_R_LINEAR_____215_CM 1 100. 0. 2047.96875 DISPLAY_IDENTIFIER MAF_KGH_FG_PRED_COR_CP ECU_ADDRESS 0xd0006840 FORMAT "%10.5" /end MEASUREMENT
/begin CHARACTERISTIC ip_maf_kgh_pred_cor_map_tia "Correction factor for MAF_KGH_FG_PRED (MAP and TIA)" MAP 0xa08053bc _REC_MAP_20_u2_u2_u1 7.9998779296875 _CNV_A_R_LINEAR_____115_CM 0. 7.9998779296875 DISPLAY_IDENTIFIER IP_MAF_KGH_PRED_COR_MAP_TIA FORMAT "%6.4"
 /begin AXIS_DESCR COM_AXIS map _CNV_A_R_LINEAR_____27_CM 6 0. 5434. FORMAT "%7.2" AXIS_PTS_REF ldpm_map_1_evac /end AXIS_DESCR
 /begin AXIS_DESCR COM_AXIS tia _CNV_A_R_LINEAR_____17_CM 3 -48. 142.5 FORMAT "%6.2" AXIS_PTS_REF ldpm_tia_1_evac /end AXIS_DESCR
/end CHARACTERISTIC
/begin CHARACTERISTIC ip_maf_kgh_pred_cor_map_tia_2 "Correction factor for MAF_KGF_FG_PRED (MAP and TIA) with of STATE_OP_ENG_CP  = 1" MAP 0xa08053e0 _REC_MAP_20_u2_u2_u1 7.9998779296875 _CNV_A_R_LINEAR_____115_CM 0. 7.9998779296875 DISPLAY_IDENTIFIER IP_MAF_KGH_PRED_COR_MAP_TIA_2 FORMAT "%6.4"
 /begin AXIS_DESCR COM_AXIS map _CNV_A_R_LINEAR_____27_CM 6 0. 5434. FORMAT "%7.2" AXIS_PTS_REF ldpm_map_1_evac /end AXIS_DESCR
 /begin AXIS_DESCR COM_AXIS tia _CNV_A_R_LINEAR_____17_CM 3 -48. 142.5 FORMAT "%6.2" AXIS_PTS_REF ldpm_tia_1_evac /end AXIS_DESCR
/end CHARACTERISTIC
/begin CHARACTERISTIC lc_maf_cor_act_cp "Choice of  recurence for fuel_flow_add_ad_cp calculation" VALUE 0xa08056d5 _REC_VAL_20_u1 1. _CNV_A_R_LINEAR_____0_CM 0. 1. DISPLAY_IDENTIFIER LC_MAF_COR_ACT_CP FORMAT "%1.0" /end CHARACTERISTIC
/begin AXIS_PTS ldpm_maf_cyl_1_evac_mff_dly_cp "" 0xa0805080 maf_cyl _REC_AXS_20_u2 2047.96875 _CNV_A_R_LINEAR_____215_CM 6 0. 2047.96875 FORMAT "%10.5" /end AXIS_PTS
/begin AXIS_PTS ldpm_maf_kgh_clc_ip_idx_step_cp "" 0xa08050a0 maf_kgh_fg_pred_cor_cp _REC_AXS_20_u2 2047.96875 _CNV_A_R_LINEAR_____215_CM 12 0. 2047.96875 FORMAT "%10.5" /end AXIS_PTS
/begin CHARACTERISTIC ip_mff_dly_cp_2 "delay for FUEL_CPS calculation" CURVE 0xa080540a _REC_CUR_20_u1_u2 255. _CNV_A_R_LINEAR_____0_CM 0. 255. DISPLAY_IDENTIFIER IP_MFF_DLY_CP_2 FORMAT "%3.0"
 /begin AXIS_DESCR COM_AXIS maf_cyl _CNV_A_R_LINEAR_____215_CM 6 0. 2047.96875 FORMAT "%10.5" AXIS_PTS_REF ldpm_maf_cyl_1_evac_mff_dly_cp /end AXIS_DESCR
/end CHARACTERISTIC
/begin CHARACTERISTIC ip_idx_step_cp "" CURVE 0xa0805394 _REC_CUR_20_u1_u2 255. _CNV_A_R_LINEAR_____0_CM 0. 255. DISPLAY_IDENTIFIER IP_IDX_STEP_CP FORMAT "%3.0"
 /begin AXIS_DESCR COM_AXIS maf_kgh_fg_pred_cor_cp _CNV_A_R_LINEAR_____215_CM 12 0. 2047.96875 FORMAT "%10.5" AXIS_PTS_REF ldpm_maf_kgh_clc_ip_idx_step_cp /end AXIS_DESCR
/end CHARACTERISTIC
/begin CHARACTERISTIC ip_idx_step_cp_2 "" CURVE 0xa08053a0 _REC_CUR_20_u1_u2 255. _CNV_A_R_LINEAR_____0_CM 0. 255. DISPLAY_IDENTIFIER IP_IDX_STEP_CP_2 FORMAT "%3.0"
 /begin AXIS_DESCR COM_AXIS maf_kgh_fg_pred_cor_cp _CNV_A_R_LINEAR_____215_CM 12 0. 2047.96875 FORMAT "%10.5" AXIS_PTS_REF ldpm_maf_kgh_clc_ip_idx_step_cp /end AXIS_DESCR
/end CHARACTERISTIC
/begin MEASUREMENT mff_add_lam_cp "additive correction of the mass fuel flow injection with active canister purge" UWORD _CNV_A_R_LINEAR_____111_CM 1 100. 0. 1389. DISPLAY_IDENTIFIER MFF_ADD_LAM_CP ECU_ADDRESS 0xd0006846 FORMAT "%7.2" /end MEASUREMENT
/begin MEASUREMENT mff_add_cyl_cp "additive correction of the mass fuel flow injection with active canister purge" UWORD _CNV_A_R_LINEAR_____111_CM 1 100. 0. 1389. DISPLAY_IDENTIFIER MFF_ADD_CYL_CP ECU_ADDRESS 0xd0006844 FORMAT "%7.2" /end MEASUREMENT
/begin MEASUREMENT cppwm_cps "corrected PWM signal for CPS opening" UBYTE _CNV_A_R_LINEAR_____5_CM 1 100. 0. 99.609375 DISPLAY_IDENTIFIER CPPWM_CPS ECU_ADDRESS 0xd00075cc FORMAT "%9.6" /end MEASUREMENT
/begin MEASUREMENT lv_frq_1_cps "logical value for CPS PWM frequency" UBYTE _CNV_S_2_RANGE__0___1_CM 1 100. 0. 1. DISPLAY_IDENTIFIER LV_FRQ_1_CPS ECU_ADDRESS 0xd0002952 BIT_MASK 0x1 /end MEASUREMENT
/begin MEASUREMENT cppwm "PWM signal for CPS opening" UBYTE _CNV_A_R_LINEAR_____5_CM 1 100. 0. 99.609375 DISPLAY_IDENTIFIER CPPWM ECU_ADDRESS 0xd0002935 FORMAT "%9.6" /end MEASUREMENT
/begin CHARACTERISTIC c_n_frq_1_cps "threshold on engine speed to shift CPS frequency output" VALUE 0xa0805618 _REC_VAL_20_u1 8160. _CNV_A_R_LINEAR_____10_CM 0. 8160. DISPLAY_IDENTIFIER C_N_FRQ_1_CPS FORMAT "%4.0" /end CHARACTERISTIC
/begin CHARACTERISTIC c_n_frq_2_cps "second threshold on engine speed to shift CPS frequency output" VALUE 0xa0805619 _REC_VAL_20_u1 8160. _CNV_A_R_LINEAR_____10_CM 0. 8160. DISPLAY_IDENTIFIER C_N_FRQ_2_CPS FORMAT "%4.0" /end CHARACTERISTIC
/begin CHARACTERISTIC c_n_frq_hys_cps "hysteresis threshold on engine speed to shift CPS frequency output" VALUE 0xa080561a _REC_VAL_20_u1 8160. _CNV_A_R_LINEAR_____10_CM 0. 8160. DISPLAY_IDENTIFIER C_N_FRQ_HYS_CPS FORMAT "%4.0" /end CHARACTERISTIC
/begin CHARACTERISTIC c_cppwm_frq_1_cps "threshold on CPPWM to shift CPS output frequency" VALUE 0xa080557d _REC_VAL_20_u1 99.609375 _CNV_A_R_LINEAR_____5_CM 0. 99.609375 DISPLAY_IDENTIFIER C_CPPWM_FRQ_1_CPS FORMAT "%9.6" /end CHARACTERISTIC
/begin CHARACTERISTIC c_cppwm_frq_2_cps "threshold on CPPWM to shift CPS output frequency" VALUE 0xa080557f _REC_VAL_20_u1 99.609375 _CNV_A_R_LINEAR_____5_CM 0. 99.609375 DISPLAY_IDENTIFIER C_CPPWM_FRQ_2_CPS FORMAT "%9.6" /end CHARACTERISTIC
/begin CHARACTERISTIC c_cppwm_frq_hys_cps "hysteresis threshold on CPPWM to shift CPS frequency output" VALUE 0xa0805580 _REC_VAL_20_u1 99.609375 _CNV_A_R_LINEAR_____5_CM 0. 99.609375 DISPLAY_IDENTIFIER C_CPPWM_FRQ_HYS_CPS FORMAT "%9.6" /end CHARACTERISTIC
/begin CHARACTERISTIC lc_cppwm_lim_diag "selection of diagnosis limit values on CPPWM_CPS" VALUE 0xa08056c8 _REC_VAL_20_u1 1. _CNV_A_R_LINEAR_____0_CM 0. 1. DISPLAY_IDENTIFIER LC_CPPWM_LIM_DIAG FORMAT "%1.0" /end CHARACTERISTIC
/begin CHARACTERISTIC lc_cppwm_as " CPPWM_CPS_AS activation" VALUE 0xa08056c7 _REC_VAL_20_u1 1. _CNV_A_R_LINEAR_____0_CM 0. 1. DISPLAY_IDENTIFIER LC_CPPWM_AS FORMAT "%1.0" /end CHARACTERISTIC
/begin MEASUREMENT lv_cp_close_act "lagical value for CPS valve closed" UBYTE _CNV_S_2_RANGE__0___1_CM 1 100. 0. 1. DISPLAY_IDENTIFIER LV_CP_CLOSE_ACT ECU_ADDRESS 0xd00075a6 BIT_MASK 0x1 /end MEASUREMENT
/begin CHARACTERISTIC c_cppwm_max_frq_1_lim_cp "cppwm_cps maximum limit to assure diagnosis with frequency 1" VALUE 0xa0805588 _REC_VAL_20_u1 99.609375 _CNV_A_R_LINEAR_____5_CM 0. 99.609375 DISPLAY_IDENTIFIER C_CPPWM_MAX_FRQ_1_LIM_CP FORMAT "%9.6" /end CHARACTERISTIC
/begin CHARACTERISTIC c_cppwm_max_frq_2_lim_cp "cppwm_cps maximum limit to assure diagnosis with frequency 2" VALUE 0xa0805589 _REC_VAL_20_u1 99.609375 _CNV_A_R_LINEAR_____5_CM 0. 99.609375 DISPLAY_IDENTIFIER C_CPPWM_MAX_FRQ_2_LIM_CP FORMAT "%9.6" /end CHARACTERISTIC
/begin CHARACTERISTIC c_cppwm_min_frq_1_lim_cp "cppwm_cps minimum limit to assure diagnosis with frequency 1" VALUE 0xa080558d _REC_VAL_20_u1 99.609375 _CNV_A_R_LINEAR_____5_CM 0. 99.609375 DISPLAY_IDENTIFIER C_CPPWM_MIN_FRQ_1_LIM_CP FORMAT "%9.6" /end CHARACTERISTIC
/begin CHARACTERISTIC c_cppwm_min_frq_2_lim_cp "cppwm_cps minimum limit to assure diagnosis with frequency 2" VALUE 0xa080558e _REC_VAL_20_u1 99.609375 _CNV_A_R_LINEAR_____5_CM 0. 99.609375 DISPLAY_IDENTIFIER C_CPPWM_MIN_FRQ_2_LIM_CP FORMAT "%9.6" /end CHARACTERISTIC
/begin AXIS_PTS ldp_cppwm_ip_cppwm_cor_frq "" 0xa0804f5c cppwm _REC_AXS_20_u1 99.609375 _CNV_A_R_LINEAR_____5_CM 8 0. 99.609375 FORMAT "%9.6" /end AXIS_PTS
/begin CHARACTERISTIC ip_cppwm_cor_frq "PWM correction following frequency value" CURVE 0xa0805294 _REC_CUR_20_u1_u1 1.9921875 _CNV_A_R_LINEAR_____103_CM 0. 1.9921875 DISPLAY_IDENTIFIER IP_CPPWM_COR_FRQ FORMAT "%8.6"
 /begin AXIS_DESCR COM_AXIS cppwm _CNV_A_R_LINEAR_____5_CM 8 0. 99.609375 FORMAT "%9.6" AXIS_PTS_REF ldp_cppwm_ip_cppwm_cor_frq /end AXIS_DESCR
/end CHARACTERISTIC
/begin AXIS_PTS ldp_flow_cor_cps_ip_cppwm "" 0xa0804f80 flow_cor_cps _REC_AXS_20_u2 7.9998779296875 _CNV_A_R_LINEAR_____162_CM 16 0. 7.9998779296875 FORMAT "%6.4" /end AXIS_PTS
/begin CHARACTERISTIC c_cppwm_frq_1 "first CPS output frequency" VALUE 0xa080557c _REC_VAL_20_u1 255. _CNV_A_R_LINEAR_____288_CM 0. 255. DISPLAY_IDENTIFIER C_CPPWM_FRQ_1 FORMAT "%3.0" /end CHARACTERISTIC
/begin CHARACTERISTIC c_cppwm_frq_2 "second CPS output frequency" VALUE 0xa080557e _REC_VAL_20_u1 255. _CNV_A_R_LINEAR_____288_CM 0. 255. DISPLAY_IDENTIFIER C_CPPWM_FRQ_2 FORMAT "%3.0" /end CHARACTERISTIC
/begin CHARACTERISTIC c_cppwm_as "application system value for CPS opening" VALUE 0xa0805572 _REC_VAL_20_s1 199.609375 _CNV_A_R_EVAC_LINEA_289_CM -100. 99.609375 DISPLAY_IDENTIFIER C_CPPWM_AS FORMAT "%7.4" /end CHARACTERISTIC
/begin CHARACTERISTIC ip_cppwm_vb_add_1 "additive VB correction for CPPWM and frequency 1" CURVE 0xa08052a4 _REC_CUR_20_u1_u1 99.609375 _CNV_A_R_EVAC_LINEA_290_CM -50. 49.609375 DISPLAY_IDENTIFIER IP_CPPWM_VB_ADD_1 FORMAT "%5.1"
 /begin AXIS_DESCR COM_AXIS vb _CNV_A_R_LINEAR_____37_CM 8 0. 26. FORMAT "%4.1" AXIS_PTS_REF ldpm_vb_1_evac /end AXIS_DESCR
/end CHARACTERISTIC
/begin CHARACTERISTIC ip_cppwm_vb_add_2 "additive VB correction for CPPWM  and frequency 2" CURVE 0xa08052ac _REC_CUR_20_u1_u1 99.609375 _CNV_A_R_EVAC_LINEA_290_CM -50. 49.609375 DISPLAY_IDENTIFIER IP_CPPWM_VB_ADD_2 FORMAT "%5.1"
 /begin AXIS_DESCR COM_AXIS vb _CNV_A_R_LINEAR_____37_CM 8 0. 26. FORMAT "%4.1" AXIS_PTS_REF ldpm_vb_1_evac /end AXIS_DESCR
/end CHARACTERISTIC
/begin CHARACTERISTIC ip_cppwm "CPS valve characteristic" MAP 0xa080f378 _REC_MAP_20_u1_u2_u2 99.609375 _CNV_A_R_LINEAR_____5_CM 0. 99.609375 DISPLAY_IDENTIFIER IP_CPPWM FORMAT "%9.6"
 /begin AXIS_DESCR COM_AXIS flow_cor_cps _CNV_A_R_LINEAR_____162_CM 16 0. 7.9998779296875 FORMAT "%6.4" AXIS_PTS_REF ldp_flow_cor_cps_ip_cppwm /end AXIS_DESCR
 /begin AXIS_DESCR COM_AXIS prs_cps _CNV_A_R_EVAC_LINEA_276_CM 16 -2717.04 2716.96 FORMAT "%8.2" AXIS_PTS_REF ldpm_prs_cps_1_evac /end AXIS_DESCR
/end CHARACTERISTIC
/begin CHARACTERISTIC ip_cppwm_vb_fac "multiplicate VB correction for CPPWM" CURVE 0xa08052b4 _REC_CUR_20_u1_u1 1.9921875 _CNV_A_R_LINEAR_____103_CM 0. 1.9921875 DISPLAY_IDENTIFIER IP_CPPWM_VB_FAC FORMAT "%8.6"
 /begin AXIS_DESCR COM_AXIS vb _CNV_A_R_LINEAR_____37_CM 8 0. 26. FORMAT "%4.1" AXIS_PTS_REF ldpm_vb_1_evac /end AXIS_DESCR
/end CHARACTERISTIC
/begin AXIS_PTS ldp_prs_cps_ip_cppwm_vb_fac "" 0xa0804ffc prs_cps _REC_AXS_20_u2 5434. _CNV_A_R_EVAC_LINEA_276_CM 6 -2717.04 2716.96 FORMAT "%8.2" /end AXIS_PTS
/begin CHARACTERISTIC ip_cppwm_vb_fac_prs_cps "multiplicate VB correction for CPPWM" CURVE 0xa08052bc _REC_CUR_20_u1_u2 3.984375 _CNV_A_R_LINEAR_____266_CM 0. 3.984375 DISPLAY_IDENTIFIER IP_CPPWM_VB_FAC_PRS_CPS FORMAT "%8.6"
 /begin AXIS_DESCR COM_AXIS prs_cps _CNV_A_R_EVAC_LINEA_276_CM 6 -2717.04 2716.96 FORMAT "%8.2" AXIS_PTS_REF ldp_prs_cps_ip_cppwm_vb_fac /end AXIS_DESCR
/end CHARACTERISTIC
/begin MEASUREMENT frq_req_cp "CPS output frequency" UBYTE _CNV_A_R_LINEAR_____288_CM 1 100. 0. 255. DISPLAY_IDENTIFIER FRQ_REQ_CP ECU_ADDRESS 0xd00075d2 FORMAT "%3.0" /end MEASUREMENT
/begin MEASUREMENT flow_max_cps "Maximum setpoint value for the flow through the CPS" UWORD _CNV_A_R_LINEAR_____162_CM 1 100. 0. 7.9998779296875 DISPLAY_IDENTIFIER FLOW_MAX_CPS ECU_ADDRESS 0xd0006836 FORMAT "%6.4" /end MEASUREMENT
/begin MEASUREMENT mff_kgh_max_cp "fuel flow max from ACF" UWORD _CNV_A_R_LINEAR_____162_CM 1 100. 0. 7.9998779296875 DISPLAY_IDENTIFIER MFF_KGH_MAX_CP ECU_ADDRESS 0xd00028f8 FORMAT "%6.4" /end MEASUREMENT
/begin MEASUREMENT ratio_fuel_sp_max_purge "setpoint value for the relative part of fluel from CPS compared to total fuel in cylinder for normal operation" UWORD _CNV_A_R_LINEAR_____89_CM 1 100. 0. 0.9999847412109381 DISPLAY_IDENTIFIER RATIO_FUEL_SP_MAX_PURGE ECU_ADDRESS 0xd0002904 FORMAT "%7.5" /end MEASUREMENT
/begin MEASUREMENT mff_max_cp "Maximim limit on the fuel flow mass" UWORD _CNV_A_R_LINEAR_____162_CM 1 100. 0. 7.9998779296875 DISPLAY_IDENTIFIER MFF_MAX_CP ECU_ADDRESS 0xd000684c FORMAT "%6.4" /end MEASUREMENT
/begin AXIS_PTS ldp_cl_mmv_ip_fac_flow_min "" 0xa0804f30 cl_mmv _REC_AXS_20_u2 1.99996948242188 _CNV_A_R_LINEAR_____9_CM 6 0. 1.99996948242188 FORMAT "%7.5" /end AXIS_PTS
/begin CHARACTERISTIC ip_fac_flow_sp_min_purge "weighting factor for the CL deviation from the worstcase CL" CURVE 0xa0805300 _REC_CUR_20_u2_u2 0.9999847412109381 _CNV_A_R_LINEAR_____89_CM 0. 0.9999847412109381 DISPLAY_IDENTIFIER IP_FAC_FLOW_SP_MIN_PURGE FORMAT "%7.5"
 /begin AXIS_DESCR COM_AXIS cl_mmv _CNV_A_R_LINEAR_____9_CM 6 0. 1.99996948242188 FORMAT "%7.5" AXIS_PTS_REF ldp_cl_mmv_ip_fac_flow_min /end AXIS_DESCR
/end CHARACTERISTIC
/begin CHARACTERISTIC c_cl_max_min_purge "on this worst case CL is based the base calibration of MIN_PURGE flow se setpoint" VALUE 0xa080555a _REC_VAL_20_u2 1.99996948242188 _CNV_A_R_LINEAR_____9_CM 0. 1.99996948242188 DISPLAY_IDENTIFIER C_CL_MAX_MIN_PURGE FORMAT "%7.5" /end CHARACTERISTIC
/begin CHARACTERISTIC c_fac_flow_sp_min_purge_max "maximum correction of MIN_PURGE flow setpoint" VALUE 0xa08055b8 _REC_VAL_20_u2 3.99993896484375 _CNV_A_R_LINEAR_____24_CM 0. 3.99993896484375 DISPLAY_IDENTIFIER C_FAC_FLOW_SP_MIN_PURGE_MAX FORMAT "%7.5" /end CHARACTERISTIC
/begin CHARACTERISTIC c_mff_min_cp "Min limit on mass fuel flow" VALUE 0xa080560c _REC_VAL_20_u2 1389. _CNV_A_R_LINEAR_____111_CM 0. 1389. DISPLAY_IDENTIFIER C_MFF_MIN_CP FORMAT "%7.2" /end CHARACTERISTIC
/begin CHARACTERISTIC lc_fac_flow_sp_min_purge "switch to activate / deactiate \"intelligent MIN_PURGE\"" VALUE 0xa08056cb _REC_VAL_20_u1 1. _CNV_A_R_LINEAR_____0_CM 0. 1. DISPLAY_IDENTIFIER LC_FAC_FLOW_SP_MIN_PURGE FORMAT "%1.0" /end CHARACTERISTIC
/begin MEASUREMENT fac_flow_sp_min_purge "correction factor for the flow setpoint in MIN_PURGE when CL_MMV known" UWORD _CNV_A_R_LINEAR_____24_CM 1 100. 0. 3.99993896484375 DISPLAY_IDENTIFIER FAC_FLOW_SP_MIN_PURGE ECU_ADDRESS 0xd0002814 FORMAT "%7.5" /end MEASUREMENT
/begin MEASUREMENT flow_cps_sp_min_purge "setpoint value for the flow through the CPS for MIN_PURGE mode" UWORD _CNV_A_R_LINEAR_____162_CM 1 100. 0. 7.9998779296875 DISPLAY_IDENTIFIER FLOW_CPS_SP_MIN_PURGE ECU_ADDRESS 0xd0006830 FORMAT "%6.4" /end MEASUREMENT
/begin MEASUREMENT flow_max_phy_cps "Physical limit: flow at 100% opened valve" UWORD _CNV_A_R_LINEAR_____162_CM 1 100. 0. 7.9998779296875 DISPLAY_IDENTIFIER FLOW_MAX_PHY_CPS ECU_ADDRESS 0xd0006838 FORMAT "%6.4" /end MEASUREMENT
/begin CHARACTERISTIC ip_ratio_fuel_max_cp_cor "correction factor for MFF_MAX_CP" CURVE 0xa08054a2 _REC_CUR_20_u1_u1 0.99609375 _CNV_A_R_LINEAR_____28_CM 0. 0.99609375 DISPLAY_IDENTIFIER IP_RATIO_FUEL_MAX_CP_COR FORMAT "%5.3"
 /begin AXIS_DESCR COM_AXIS tco _CNV_A_R_LINEAR_____17_CM 5 -48. 142.5 FORMAT "%6.2" AXIS_PTS_REF ldp_tco_ip_ratio_fuel_max_cp /end AXIS_DESCR
/end CHARACTERISTIC
/begin CHARACTERISTIC ip_flow_cps "FLOW_CPS for fully opened CPS (CPPWM=100%)" CURVE 0xa0805320 _REC_CUR_20_u2_u2 7.9998779296875 _CNV_A_R_LINEAR_____162_CM 0. 7.9998779296875 DISPLAY_IDENTIFIER IP_FLOW_CPS FORMAT "%6.4"
 /begin AXIS_DESCR COM_AXIS prs_cps _CNV_A_R_EVAC_LINEA_276_CM 16 -2717.04 2716.96 FORMAT "%8.2" AXIS_PTS_REF ldpm_prs_cps_1_evac /end AXIS_DESCR
/end CHARACTERISTIC
/begin AXIS_PTS ldp_tco_ip_ratio_fuel_max_cp "" 0xa0805026 tco _REC_AXS_20_u1 190.5 _CNV_A_R_LINEAR_____17_CM 5 -48. 142.5 FORMAT "%6.2" /end AXIS_PTS
/begin CHARACTERISTIC ip_flow_cps_eng_mod_0 "flow setpoint for MIN_PURGE / homogeneous stoiciometric operation" MAP 0xa080f508 _REC_MAP_20_u2_u1_u1 7.9998779296875 _CNV_A_R_LINEAR_____162_CM 0. 7.9998779296875 DISPLAY_IDENTIFIER IP_FLOW_CPS_ENG_MOD_0 FORMAT "%6.4"
 /begin AXIS_DESCR COM_AXIS n_32 _CNV_A_R_LINEAR_____10_CM 12 0. 8160. FORMAT "%4.0" AXIS_PTS_REF ldpm_n_32_2_evac /end AXIS_DESCR
 /begin AXIS_DESCR COM_AXIS maf_hb _CNV_A_R_LINEAR_____15_CM 12 0. 1389. FORMAT "%4.0" AXIS_PTS_REF ldpm_maf_2_evac /end AXIS_DESCR
/end CHARACTERISTIC
/begin CHARACTERISTIC ip_flow_cps_eng_mod_1 "flow setpoint for MIN_PURGE at ENG_MOD_1" MAP 0xa080f628 _REC_MAP_20_u2_u1_u2 7.9998779296875 _CNV_A_R_LINEAR_____162_CM 0. 7.9998779296875 DISPLAY_IDENTIFIER IP_FLOW_CPS_ENG_MOD_1 FORMAT "%6.4"
 /begin AXIS_DESCR COM_AXIS n_32 _CNV_A_R_LINEAR_____10_CM 12 0. 8160. FORMAT "%4.0" AXIS_PTS_REF ldpm_n_32_2_evac /end AXIS_DESCR
 /begin AXIS_DESCR COM_AXIS tqi_sp_s _CNV_A_R_LINEAR_____31_CM 12 0. 1023.96875 FORMAT "%7.2" AXIS_PTS_REF ldpm_tqi_sp_s_3_evac /end AXIS_DESCR
/end CHARACTERISTIC
/begin CHARACTERISTIC ip_flow_cps_eng_mod_2 "flow setpoint for MIN_PURGE at ENG_MOD_2" MAP 0xa080f748 _REC_MAP_20_u2_u1_u2 7.9998779296875 _CNV_A_R_LINEAR_____162_CM 0. 7.9998779296875 DISPLAY_IDENTIFIER IP_FLOW_CPS_ENG_MOD_2 FORMAT "%6.4"
 /begin AXIS_DESCR COM_AXIS n_32 _CNV_A_R_LINEAR_____10_CM 12 0. 8160. FORMAT "%4.0" AXIS_PTS_REF ldpm_n_32_2_evac /end AXIS_DESCR
 /begin AXIS_DESCR COM_AXIS tqi_sp_s _CNV_A_R_LINEAR_____31_CM 12 0. 1023.96875 FORMAT "%7.2" AXIS_PTS_REF ldpm_tqi_sp_s_3_evac /end AXIS_DESCR
/end CHARACTERISTIC
/begin CHARACTERISTIC ip_ratio_fuel_max_cp_mod_0 "maximum fuel flow through the CPS / homogeneous stoiciometric operation" MAP 0xa080fe30 _REC_MAP_20_u2_u1_u1 0.9999847412109381 _CNV_A_R_LINEAR_____89_CM 0. 0.9999847412109381 DISPLAY_IDENTIFIER IP_RATIO_FUEL_MAX_CP_MOD_0 FORMAT "%7.5"
 /begin AXIS_DESCR COM_AXIS n_32 _CNV_A_R_LINEAR_____10_CM 12 0. 8160. FORMAT "%4.0" AXIS_PTS_REF ldpm_n_32_2_evac /end AXIS_DESCR
 /begin AXIS_DESCR COM_AXIS maf_hb _CNV_A_R_LINEAR_____15_CM 12 0. 1389. FORMAT "%4.0" AXIS_PTS_REF ldpm_maf_2_evac /end AXIS_DESCR
/end CHARACTERISTIC
/begin CHARACTERISTIC ip_ratio_fuel_max_cp_mod_1 "maximum fuel flow through the CPS / homogeneous lean operation" MAP 0xa080ff50 _REC_MAP_20_u2_u1_u2 0.9999847412109381 _CNV_A_R_LINEAR_____89_CM 0. 0.9999847412109381 DISPLAY_IDENTIFIER IP_RATIO_FUEL_MAX_CP_MOD_1 FORMAT "%7.5"
 /begin AXIS_DESCR COM_AXIS n_32 _CNV_A_R_LINEAR_____10_CM 12 0. 8160. FORMAT "%4.0" AXIS_PTS_REF ldpm_n_32_2_evac /end AXIS_DESCR
 /begin AXIS_DESCR COM_AXIS tqi_sp _CNV_A_R_LINEAR_____31_CM 12 0. 1023.96875 FORMAT "%7.2" AXIS_PTS_REF ldpm_tqi_sp_s_ip_ratio_fuel_max /end AXIS_DESCR
/end CHARACTERISTIC
/begin CHARACTERISTIC ip_ratio_fuel_max_cp_mod_2 "maximum fuel flow through the CPS / homogeneous lean operation" MAP 0xa0810070 _REC_MAP_20_u2_u1_u2 0.9999847412109381 _CNV_A_R_LINEAR_____89_CM 0. 0.9999847412109381 DISPLAY_IDENTIFIER IP_RATIO_FUEL_MAX_CP_MOD_2 FORMAT "%7.5"
 /begin AXIS_DESCR COM_AXIS n_32 _CNV_A_R_LINEAR_____10_CM 12 0. 8160. FORMAT "%4.0" AXIS_PTS_REF ldpm_n_32_2_evac /end AXIS_DESCR
 /begin AXIS_DESCR COM_AXIS tqi_sp _CNV_A_R_LINEAR_____31_CM 12 0. 1023.96875 FORMAT "%7.2" AXIS_PTS_REF ldpm_tqi_sp_s_ip_ratio_fuel_max /end AXIS_DESCR
/end CHARACTERISTIC
/begin AXIS_PTS ldpm_tqi_sp_s_ip_ratio_fuel_max "" 0xa08051d4 tqi_sp _REC_AXS_20_u2 1023.96875 _CNV_A_R_LINEAR_____31_CM 12 0. 1023.96875 FORMAT "%7.2" /end AXIS_PTS
/begin AXIS_PTS ldpm_mff_evac "" 0xa08050dc mff_sp_mv _REC_AXS_20_u2 1389. _CNV_A_R_LINEAR_____111_CM 12 0. 1389. FORMAT "%7.2" /end AXIS_PTS
/begin CHARACTERISTIC ip_flow_max_cps "flow setpoint for MAX_PURGE" MAP 0xa080f988 _REC_MAP_20_u2_u1_u1 7.9998779296875 _CNV_A_R_LINEAR_____162_CM 0. 7.9998779296875 DISPLAY_IDENTIFIER IP_FLOW_MAX_CPS FORMAT "%6.4"
 /begin AXIS_DESCR COM_AXIS n_32 _CNV_A_R_LINEAR_____10_CM 12 0. 8160. FORMAT "%4.0" AXIS_PTS_REF ldpm_n_32_2_evac /end AXIS_DESCR
 /begin AXIS_DESCR COM_AXIS maf_hb _CNV_A_R_LINEAR_____15_CM 12 0. 1389. FORMAT "%4.0" AXIS_PTS_REF ldpm_maf_2_evac /end AXIS_DESCR
/end CHARACTERISTIC
/begin CHARACTERISTIC ip_flow_max_2_cps "flow setpoint for MAX_PURGE" MAP 0xa080f868 _REC_MAP_20_u2_u1_u2 7.9998779296875 _CNV_A_R_LINEAR_____162_CM 0. 7.9998779296875 DISPLAY_IDENTIFIER IP_FLOW_MAX_2_CPS FORMAT "%6.4"
 /begin AXIS_DESCR COM_AXIS n_32 _CNV_A_R_LINEAR_____10_CM 12 0. 8160. FORMAT "%4.0" AXIS_PTS_REF ldpm_n_32_2_evac /end AXIS_DESCR
 /begin AXIS_DESCR COM_AXIS mff_sp_mv _CNV_A_R_LINEAR_____111_CM 12 0. 1389. FORMAT "%7.2" AXIS_PTS_REF ldpm_mff_evac /end AXIS_DESCR
/end CHARACTERISTIC
/begin AXIS_PTS ldpm_tqi_sp_s_3_evac "" 0xa08051b8 tqi_sp_s _REC_AXS_20_u2 1023.96875 _CNV_A_R_LINEAR_____31_CM 12 0. 1023.96875 FORMAT "%7.2" /end AXIS_PTS
/begin MEASUREMENT lv_inh_cp_cll "Logical value for NO_PURGE authorization by projectspecific conditions " UBYTE _CNV_S_2_RANGE__0___1_CM 1 100. 0. 1. DISPLAY_IDENTIFIER LV_INH_CP_CLL ECU_ADDRESS 0xd00075bb BIT_MASK 0x1 /end MEASUREMENT
/begin MEASUREMENT lv_cp_dyw_ext "Logical value for NO_PURGE authorization by projectspecific conditions " UBYTE _CNV_S_2_RANGE__0___1_CM 1 100. 0. 1. DISPLAY_IDENTIFIER LV_CP_DYW_EXT ECU_ADDRESS 0xd00075aa BIT_MASK 0x1 /end MEASUREMENT
/begin MEASUREMENT lv_inh_lam_ad_sdl "Flag collecting project specific reasons to inhibit LAM_AD via time control / permanently enable LAM_AD" UBYTE _CNV_S_2_RANGE__0___1_CM 1 100. 0. 1. DISPLAY_IDENTIFIER LV_INH_LAM_AD_SDL ECU_ADDRESS 0xd00075bf BIT_MASK 0x1 /end MEASUREMENT
/begin MEASUREMENT lv_cp_close_1 "Logical value for NO_PURGE authorization by projectspecific conditions " UBYTE _CNV_S_2_RANGE__0___1_CM 1 100. 0. 1. DISPLAY_IDENTIFIER LV_CP_CLOSE_1 ECU_ADDRESS 0xd00075a3 BIT_MASK 0x1 /end MEASUREMENT
/begin MEASUREMENT lv_cp_close_2 "Logical value for NO_PURGE authorization by projectspecific conditions " UBYTE _CNV_S_2_RANGE__0___1_CM 1 100. 0. 1. DISPLAY_IDENTIFIER LV_CP_CLOSE_2 ECU_ADDRESS 0xd00075a4 BIT_MASK 0x1 /end MEASUREMENT
/begin MEASUREMENT lv_cp_close_3 "Logical value for NO_PURGE authorization by projectspecific conditions " UBYTE _CNV_S_2_RANGE__0___1_CM 1 100. 0. 1. DISPLAY_IDENTIFIER LV_CP_CLOSE_3 ECU_ADDRESS 0xd00075a5 BIT_MASK 0x1 /end MEASUREMENT
/begin MEASUREMENT lv_inh_cp_fast "Logical value for NO_PURGE authorization by projectspecific conditions " UBYTE _CNV_S_2_RANGE__0___1_CM 1 100. 0. 1. DISPLAY_IDENTIFIER LV_INH_CP_FAST ECU_ADDRESS 0xd00075bc BIT_MASK 0x1 /end MEASUREMENT
/begin MEASUREMENT lv_inh_cp_sdl "Flag collecting project specific reasons to inhibit CP via time control / permanently enable CP" UBYTE _CNV_S_2_RANGE__0___1_CM 1 100. 0. 1. DISPLAY_IDENTIFIER LV_INH_CP_SDL ECU_ADDRESS 0xd00075bd BIT_MASK 0x1 /end MEASUREMENT
/begin MEASUREMENT lv_t_sdl_ext_req "Flag collecting project specific reasons to temporarilly disabling CP and lambda adaptation" UBYTE _CNV_S_2_RANGE__0___1_CM 1 100. 0. 1. DISPLAY_IDENTIFIER LV_T_SDL_EXT_REQ ECU_ADDRESS 0xd00075c8 BIT_MASK 0x1 /end MEASUREMENT
/begin AXIS_PTS ldpm_maf_ip_rel_flow_max_cps "" 0xa0805090 maf_hb _REC_AXS_20_u1 1389. _CNV_A_R_LINEAR_____15_CM 12 0. 1389. FORMAT "%4.0" /end AXIS_PTS
/begin AXIS_PTS ldpm_n_32_ip_rel_flow_max_cps "" 0xa0805168 n_32 _REC_AXS_20_u1 8160. _CNV_A_R_LINEAR_____10_CM 12 0. 8160. FORMAT "%4.0" /end AXIS_PTS
/begin MEASUREMENT lv_cps_ad_inh "CPS adaptation inhibited" UBYTE _CNV_S_2_RANGE__0___1_CM 1 100. 0. 1. DISPLAY_IDENTIFIER LV_CPS_AD_INH ECU_ADDRESS 0xd00075b4 /end MEASUREMENT
/begin MEASUREMENT prs_cps_ext "Pressure difference envirionment over CP line" SWORD _CNV_A_R_LINEAR_____293_CM 1 100. -2717.04 2716.96 DISPLAY_IDENTIFIER PRS_CPS_EXT ECU_ADDRESS 0xd0006852 FORMAT "%8.2" /end MEASUREMENT
/begin MEASUREMENT fac_flow_cor_cp_ext "External factor to modify absolute flow" UBYTE _CNV_A_R_LINEAR_____266_CM 1 100. 0. 3.984375 DISPLAY_IDENTIFIER FAC_FLOW_COR_CP_EXT ECU_ADDRESS 0xd00075cf FORMAT "%8.6" /end MEASUREMENT
/begin MEASUREMENT fac_flow_cor_cp_min_purge "" UBYTE _CNV_A_R_LINEAR_____266_CM 1 100. 0. 3.984375 DISPLAY_IDENTIFIER FAC_FLOW_COR_CP_MIN_PURGE ECU_ADDRESS 0xd00075d0 FORMAT "%8.6" /end MEASUREMENT
/begin MEASUREMENT state_opm_eng_cp "activation conditions for evaporative emission control function" UBYTE _CNV_S_3_STATE_OPM__294_CM 1 100. 0. 2. DISPLAY_IDENTIFIER STATE_OPM_ENG_CP ECU_ADDRESS 0xd00075d9 /end MEASUREMENT
/begin CHARACTERISTIC ip_fac_rel_flow_cps_wout_cat "Factor for CP_MIN_PURGE" MAP 0xa080f478 _REC_MAP_20_u1_u1_u1 3.984375 _CNV_A_R_LINEAR_____266_CM 0. 3.984375 DISPLAY_IDENTIFIER IP_FAC_REL_FLOW_CPS_WOUT_CAT FORMAT "%8.6"
 /begin AXIS_DESCR COM_AXIS n_32 _CNV_A_R_LINEAR_____10_CM 12 0. 8160. FORMAT "%4.0" AXIS_PTS_REF ldpm_n_32_ip_rel_flow_max_cps /end AXIS_DESCR
 /begin AXIS_DESCR COM_AXIS maf_hb _CNV_A_R_LINEAR_____15_CM 12 0. 1389. FORMAT "%4.0" AXIS_PTS_REF ldpm_maf_ip_rel_flow_max_cps /end AXIS_DESCR
/end CHARACTERISTIC
/begin CHARACTERISTIC id_state_opm_eng_cp "" CURVE 0xa080520c _REC_CUR_20_u1_u1 2. _CNV_S_3_STATE_OPM__294_CM 0. 2. DISPLAY_IDENTIFIER ID_STATE_OPM_ENG_CP
 /begin AXIS_DESCR COM_AXIS opm_av _CNV_A_R_LINEAR_____0_CM 8 0. 8. FORMAT "%1.0" AXIS_PTS_REF ldpm_opm_av /end AXIS_DESCR
/end CHARACTERISTIC
/begin CHARACTERISTIC c_t_dly_cp_lamb_ch "Delay time after LAMB_CH has finished to enable NO_PURGE" VALUE 0xa0805660 _REC_VAL_20_u2 1310.7 _CNV_A_R_LINEAR_____110_CM 0. 1310.7 DISPLAY_IDENTIFIER C_T_DLY_CP_LAMB_CH FORMAT "%7.2" /end CHARACTERISTIC
/begin CHARACTERISTIC c_t_dly_cp_opm_av "Delay time after LAMB_CH has finished to enable NO_PURGE" VALUE 0xa0805662 _REC_VAL_20_u2 1310.7 _CNV_A_R_LINEAR_____110_CM 0. 1310.7 DISPLAY_IDENTIFIER C_T_DLY_CP_OPM_AV FORMAT "%7.2" /end CHARACTERISTIC
/begin MEASUREMENT lv_inh_cp "Logical value for NO_PURGE authorization by projectspecific conditions " UBYTE _CNV_S_2_RANGE__0___1_CM 1 100. 0. 1. DISPLAY_IDENTIFIER LV_INH_CP ECU_ADDRESS 0xd00075ba BIT_MASK 0x1 /end MEASUREMENT
/begin MEASUREMENT lv_state_opm_chg_s_cp "Engine mode change ENG_MODE_1 <-> ENG_MODE_2" UBYTE _CNV_S_2_RANGE__0___1_CM 1 100. 0. 1. DISPLAY_IDENTIFIER LV_STATE_OPM_CHG_S_CP ECU_ADDRESS 0xd00075c7 BIT_MASK 0x1 /end MEASUREMENT
/begin MEASUREMENT lv_state_opm_chg_hom_cp "Engine mode change ENG_MODE_0 <-> ENG_MODE_1or2" UBYTE _CNV_S_2_RANGE__0___1_CM 1 100. 0. 1. DISPLAY_IDENTIFIER LV_STATE_OPM_CHG_HOM_CP ECU_ADDRESS 0xd00075c6 BIT_MASK 0x1 /end MEASUREMENT
/begin CHARACTERISTIC c_t_ast_max_inh_cp_sdl "Max time after start to reset LV_INH_CP_SDL" VALUE 0xa0805638 _REC_VAL_20_u2 6553.5 _CNV_A_R_LINEAR_____4_CM 0. 6553.5 DISPLAY_IDENTIFIER C_T_AST_MAX_INH_CP_SDL FORMAT "%6.1" /end CHARACTERISTIC
/begin MEASUREMENT lv_inh_cll_is_s_cp "Flag for disabled CLL at IS at unknown CL" UBYTE _CNV_S_2_RANGE__0___1_CM 1 100. 0. 1. DISPLAY_IDENTIFIER LV_INH_CLL_IS_S_CP ECU_ADDRESS 0xd00075b9 BIT_MASK 0x1 /end MEASUREMENT
/begin CHARACTERISTIC c_ctr_dly_cll_is_s_max_cp "Max value for counter to disabled CLL at IS at unknown CL" VALUE 0xa08055aa _REC_VAL_20_u2 65535. _CNV_A_R_LINEAR_____0_CM 0. 65535. DISPLAY_IDENTIFIER C_CTR_DLY_CLL_IS_S_MAX_CP FORMAT "%5.0" /end CHARACTERISTIC
/begin CHARACTERISTIC c_ctr_dly_cll_is_s_inc_cp "Increment step for counter to disabled CLL at IS at unknown CL" VALUE 0xa08055a8 _REC_VAL_20_u2 65535. _CNV_A_R_LINEAR_____0_CM 0. 65535. DISPLAY_IDENTIFIER C_CTR_DLY_CLL_IS_S_INC_CP FORMAT "%5.0" /end CHARACTERISTIC
/begin MEASUREMENT ctr_dly_cll_is_s_cp "counter to disabled CLL at IS at unknown CL" UWORD _CNV_A_R_LINEAR_____0_CM 1 100. 0. 65535. DISPLAY_IDENTIFIER CTR_DLY_CLL_IS_S_CP ECU_ADDRESS 0xd0002810 FORMAT "%5.0" /end MEASUREMENT
/begin MEASUREMENT fac_flow_tar_cor_cp "Reduction factor for the flow target at close engine mode swich" UWORD _CNV_A_R_LINEAR_____89_CM 1 100. 0. 0.9999847412109381 DISPLAY_IDENTIFIER FAC_FLOW_TAR_COR_CP ECU_ADDRESS 0xd0006822 FORMAT "%7.5" /end MEASUREMENT
/begin MEASUREMENT lv_flow_tar_cor_cp "Reduction for the flow target at close engine mode swich" UBYTE _CNV_S_2_RANGE__0___1_CM 1 100. 0. 1. DISPLAY_IDENTIFIER LV_FLOW_TAR_COR_CP ECU_ADDRESS 0xd00075b8 BIT_MASK 0x1 /end MEASUREMENT
/begin CHARACTERISTIC c_ctr_dly_cll_is_s_dec_cp "Decrement step for counter for to disabled CLL at IS at unknown CL" VALUE 0xa08055a6 _REC_VAL_20_u2 65535. _CNV_A_R_LINEAR_____0_CM 0. 65535. DISPLAY_IDENTIFIER C_CTR_DLY_CLL_IS_S_DEC_CP FORMAT "%5.0" /end CHARACTERISTIC
/begin CHARACTERISTIC c_cl_mmv_cll_is_s_max "Maximum allowed CL_MMV for closed loop operation in stratified engine operation mode at idle speed" VALUE 0xa080555e _REC_VAL_20_u2 1.99996948242188 _CNV_A_R_LINEAR_____9_CM 0. 1.99996948242188 DISPLAY_IDENTIFIER C_CL_MMV_CLL_IS_S_MAX FORMAT "%7.5" /end CHARACTERISTIC
/begin MEASUREMENT mff_red_opm_thd_cp "Area around the engine mode switch threshold to reduce the flow" UWORD _CNV_A_R_LINEAR_____111_CM 1 100. 0. 1389. DISPLAY_IDENTIFIER MFF_RED_OPM_THD_CP ECU_ADDRESS 0xd00028fc FORMAT "%7.2" /end MEASUREMENT
/begin MEASUREMENT mff_grd_cp "MFF gradient for canister purge" UWORD _CNV_A_R_LINEAR_____111_CM 1 100. 0. 1389. DISPLAY_IDENTIFIER MFF_GRD_CP ECU_ADDRESS 0xd00028f4 FORMAT "%7.2" /end MEASUREMENT
/begin MEASUREMENT mff_grd_mmv_cp "Filtered MFF gradient for canister purge" UWORD _CNV_A_R_LINEAR_____111_CM 1 100. 0. 1389. DISPLAY_IDENTIFIER MFF_GRD_MMV_CP ECU_ADDRESS 0xd00028f6 FORMAT "%7.2" /end MEASUREMENT
/begin CHARACTERISTIC ip_mff_red_opm_cp "Area around the engine mode switch threshold to reduce the flow" CURVE 0xa0805410 _REC_CUR_20_u2_u2 1389. _CNV_A_R_LINEAR_____111_CM 0. 1389. DISPLAY_IDENTIFIER IP_MFF_RED_OPM_CP FORMAT "%7.2"
 /begin AXIS_DESCR COM_AXIS mff_grd_mmv_cp _CNV_A_R_LINEAR_____111_CM 6 0. 1389. FORMAT "%7.2" AXIS_PTS_REF ldp_mff_sp_mv_ip_mff_red_cp /end AXIS_DESCR
/end CHARACTERISTIC
/begin CHARACTERISTIC c_crlc_mff_grd_cp "Correlation factor for MFF_GRD_CP calculation" VALUE 0xa080559c _REC_VAL_20_u2 0.9999847412109381 _CNV_A_R_LINEAR_____89_CM 0. 0.9999847412109381 DISPLAY_IDENTIFIER C_CRLC_MFF_GRD_CP FORMAT "%7.5" /end CHARACTERISTIC
/begin CHARACTERISTIC c_fac_flow_tar_cor_min_cp "Lower threshold for the flow correlation factor" VALUE 0xa08055ba _REC_VAL_20_u2 0.9999847412109381 _CNV_A_R_LINEAR_____89_CM 0. 0.9999847412109381 DISPLAY_IDENTIFIER C_FAC_FLOW_TAR_COR_MIN_CP FORMAT "%7.5" /end CHARACTERISTIC
/begin MEASUREMENT t_ast_cp "" UWORD _CNV_A_R_LINEAR_____4_CM 1 100. 0. 6553.5 DISPLAY_IDENTIFIER T_AST_CP ECU_ADDRESS 0xd0006854 FORMAT "%6.1" /end MEASUREMENT
/begin MEASUREMENT lv_cp_act "logical value for EVAP-Control active" UBYTE _CNV_S_2_RANGE__0___1_CM 1 100. 0. 1. DISPLAY_IDENTIFIER LV_CP_ACT ECU_ADDRESS 0xd000759d BIT_MASK 0x1 /end MEASUREMENT
/begin MEASUREMENT t_dly_cp_opm_av "" UWORD _CNV_A_R_LINEAR_____110_CM 1 100. 0. 1310.7 DISPLAY_IDENTIFIER T_DLY_CP_OPM_AV ECU_ADDRESS 0xd0002918 FORMAT "%7.2" /end MEASUREMENT
/begin MEASUREMENT t_dly_cp_lamb_ch "" UWORD _CNV_A_R_LINEAR_____110_CM 1 100. 0. 1310.7 DISPLAY_IDENTIFIER T_DLY_CP_LAMB_CH ECU_ADDRESS 0xd0002914 FORMAT "%7.2" /end MEASUREMENT
/begin CHARACTERISTIC c_tco_max_inh_cp_sdl "Max cooling water temperature to reset LV_INH_CP_SDL" VALUE 0xa0805691 _REC_VAL_20_u1 190.5 _CNV_A_R_LINEAR_____17_CM -48. 142.5 DISPLAY_IDENTIFIER C_TCO_MAX_INH_CP_SDL FORMAT "%6.2" /end CHARACTERISTIC
/begin CHARACTERISTIC lc_err_map_min_purge_cp "Enables MIN_PURGE operation at MAP error, otherwise switched to NO_PURGE" VALUE 0xa08056ca _REC_VAL_20_u1 1. _CNV_A_R_LINEAR_____0_CM 0. 1. DISPLAY_IDENTIFIER LC_ERR_MAP_MIN_PURGE_CP FORMAT "%1.0" /end CHARACTERISTIC
/begin CHARACTERISTIC lc_cp_act "central switch for activation / deactivation of canister purge functions" VALUE 0xa08056b4 _REC_VAL_20_u1 1. _CNV_A_R_LINEAR_____0_CM 0. 1. DISPLAY_IDENTIFIER LC_CP_ACT FORMAT "%1.0" /end CHARACTERISTIC
/begin CHARACTERISTIC lc_cp_ast_act "switch for lv_ast using to activate canister purge functions" VALUE 0xa08056b5 _REC_VAL_20_u1 1. _CNV_A_R_LINEAR_____0_CM 0. 1. DISPLAY_IDENTIFIER LC_CP_AST_ACT FORMAT "%1.0" /end CHARACTERISTIC
/begin CHARACTERISTIC ip_t_st_ast_tco_st_cps_min "Minimum temperature for EVAP - Control active" CURVE 0xa0805508 _REC_CUR_20_u2_u1 6553.400000000001 _CNV_A_R_LINEAR_____4_CM 0.1 6553.5 DISPLAY_IDENTIFIER IP_T_ST_AST_TCO_ST_CPS_MIN FORMAT "%6.1"
 /begin AXIS_DESCR COM_AXIS tco_st _CNV_A_R_LINEAR_____17_CM 6 -48. 142.5 FORMAT "%6.2" AXIS_PTS_REF ldp_tco_st_ip_t_st /end AXIS_DESCR
/end CHARACTERISTIC
/begin AXIS_PTS ldp_tco_st_ip_t_st "" 0xa080502c tco_st _REC_AXS_20_u1 190.5 _CNV_A_R_LINEAR_____17_CM 6 -48. 142.5 FORMAT "%6.2" /end AXIS_PTS
/begin AXIS_PTS ldp_mff_sp_mv_ip_mff_red_cp "" 0xa0804fd0 mff_grd_mmv_cp _REC_AXS_20_u2 1389. _CNV_A_R_LINEAR_____111_CM 6 0. 1389. FORMAT "%7.2" /end AXIS_PTS
/begin AXIS_PTS ldp_cl_mdl_slop_0_ip_cl_slop "" 0xa0804f0c NO_INPUT_QUANTITY _REC_AXS_20_u2 1.99996948242188 _CNV_A_R_LINEAR_____9_CM 8 0. 1.99996948242188 FORMAT "%7.5" /end AXIS_PTS
/begin AXIS_PTS ldp_cl_mdl_slop_int_ip_cl_value "" 0xa0804f20 cl_mdl_slop_int _REC_AXS_20_u2 1.99996948242188 _CNV_A_R_LINEAR_____9_CM 6 0. 1.99996948242188 FORMAT "%7.5" /end AXIS_PTS
/begin CHARACTERISTIC lc_state_test_opm_can_ena_vvl "" VALUE 0xa080c5f2 _REC_VAL_20_u1 1. _CNV_S_2_RANGE______76_CM 0. 1. DISPLAY_IDENTIFIER LC_STATE_TEST_OPM_CAN_ENA_VVL /end CHARACTERISTIC
/begin AXIS_PTS ldpm_opm_av "" 0xa0809750 opm_av _REC_AXS_20_u1 8. _CNV_A_R_LINEAR_____0_CM 8 0. 8. FORMAT "%1.0" /end AXIS_PTS
/begin MEASUREMENT nox_ns[0] "NOx concentration value, measured by NOx sensor" SWORD _CNV_A_R_NOXD_LINEA_486_CM 1 100. -100. 1500. DISPLAY_IDENTIFIER NOX_NS[1] ECU_ADDRESS 0xd000a014 FORMAT "%4.0" /end MEASUREMENT
/begin MEASUREMENT nox_ns[1] "NOx concentration value, measured by NOx sensor" SWORD _CNV_A_R_NOXD_LINEA_486_CM 1 100. -100. 1500. DISPLAY_IDENTIFIER NOX_NS[2] ECU_ADDRESS 0xd000a016 FORMAT "%4.0" /end MEASUREMENT
/begin MEASUREMENT nox_ns_diag[0] "NOx concentration value for diagnosis functions, measured by NOx sensor" SWORD _CNV_A_R_NOXD_LINEA_486_CM 1 100. -100. 1500. DISPLAY_IDENTIFIER NOX_NS_DIAG[1] ECU_ADDRESS 0xd000a018 FORMAT "%4.0" /end MEASUREMENT
/begin MEASUREMENT nox_ns_diag[1] "NOx concentration value for diagnosis functions, measured by NOx sensor" SWORD _CNV_A_R_NOXD_LINEA_486_CM 1 100. -100. 1500. DISPLAY_IDENTIFIER NOX_NS_DIAG[2] ECU_ADDRESS 0xd000a01a FORMAT "%4.0" /end MEASUREMENT
/begin MEASUREMENT lv_err_nox_sens_can_boff "CAN bus, at which the NOx-Sensor is connected, is into the state bus off" UBYTE _CNV_S_2_RANGE__0___1_CM 1 100. 0. 1. DISPLAY_IDENTIFIER LV_ERR_NOX_SENS_CAN_BOFF ECU_ADDRESS 0xd0008198 BIT_MASK 0x1 /end MEASUREMENT
/begin MEASUREMENT lv_err_nox_sens_can_msg_lost_1 "NOx-Sensor lost message failure is present" UBYTE _CNV_S_2_RANGE__0___1_CM 1 100. 0. 1. DISPLAY_IDENTIFIER LV_ERR_NOX_SENS_CAN_MSG_LOST_1 ECU_ADDRESS 0xd000819e BIT_MASK 0x1 /end MEASUREMENT
/begin MEASUREMENT lv_err_nox_sens_can_msg_lost_2 "NOx-Sensor lost message failure is present" UBYTE _CNV_S_2_RANGE__0___1_CM 1 100. 0. 1. DISPLAY_IDENTIFIER LV_ERR_NOX_SENS_CAN_MSG_LOST_2 ECU_ADDRESS 0xd00081a2 BIT_MASK 0x1 /end MEASUREMENT
/begin MEASUREMENT lv_err_ns_can_boff "CAN bus, at which the NOx-Sensor is connected, is into the state bus off" UBYTE _CNV_S_2_RANGE__0___1_CM 1 100. 0. 1. DISPLAY_IDENTIFIER LV_ERR_NS_CAN_BOFF ECU_ADDRESS 0xd0008199 BIT_MASK 0x1 /end MEASUREMENT
/begin MEASUREMENT lv_err_ns_can_msg_lost_1 "NOx-Sensor lost message failure is present" UBYTE _CNV_S_2_RANGE__0___1_CM 1 100. 0. 1. DISPLAY_IDENTIFIER LV_ERR_NS_CAN_MSG_LOST_1 ECU_ADDRESS 0xd000819f BIT_MASK 0x1 /end MEASUREMENT
/begin MEASUREMENT lv_err_ns_can_msg_lost_2 "NOx-Sensor lost message failure is present" UBYTE _CNV_S_2_RANGE__0___1_CM 1 100. 0. 1. DISPLAY_IDENTIFIER LV_ERR_NS_CAN_MSG_LOST_2 ECU_ADDRESS 0xd00081a3 BIT_MASK 0x1 /end MEASUREMENT
/begin MEASUREMENT lv_t_nox_sens_vld "NOx sensor signal valid after regeneration" UBYTE _CNV_S_2_RANGE__0___1_CM 1 100. 0. 1. DISPLAY_IDENTIFIER LV_T_NOX_SENS_VLD ECU_ADDRESS 0xd000819a BIT_MASK 0x1 /end MEASUREMENT
/begin MEASUREMENT lv_t_nox_sens_vld_1 "NOx sensor signal valid after regeneration (bank 1)" UBYTE _CNV_S_2_RANGE__0___1_CM 1 100. 0. 1. DISPLAY_IDENTIFIER LV_T_NOX_SENS_VLD_1 ECU_ADDRESS 0xd00081a1 BIT_MASK 0x1 /end MEASUREMENT
/begin MEASUREMENT lv_t_nox_sens_vld_2 "NOx sensor signal valid after regeneration (bank 2)" UBYTE _CNV_S_2_RANGE__0___1_CM 1 100. 0. 1. DISPLAY_IDENTIFIER LV_T_NOX_SENS_VLD_2 ECU_ADDRESS 0xd00081a5 BIT_MASK 0x1 /end MEASUREMENT
/begin MEASUREMENT lv_nox_ns_diag_vld_1 "Indicator that the NOx signal is valid for use into the diagnosis function" UBYTE _CNV_S_2_RANGE__0___1_CM 1 100. 0. 1. DISPLAY_IDENTIFIER LV_NOX_NS_DIAG_VLD_1 ECU_ADDRESS 0xd00081a0 BIT_MASK 0x1 /end MEASUREMENT
/begin MEASUREMENT lv_nox_ns_diag_vld_2 "Indicator that the NOx signal is valid for use into the diagnosis function" UBYTE _CNV_S_2_RANGE__0___1_CM 1 100. 0. 1. DISPLAY_IDENTIFIER LV_NOX_NS_DIAG_VLD_2 ECU_ADDRESS 0xd00081a4 BIT_MASK 0x1 /end MEASUREMENT
/begin MEASUREMENT nox_ppm[0] "NOx concentration in the exhaust gas downstream of NOx catalyst" UWORD _CNV_A_R_NOXD_LINEA_486_CM 1 100. 0. 1500. DISPLAY_IDENTIFIER NOX_PPM[1] ECU_ADDRESS 0xd000a020 FORMAT "%4.0" /end MEASUREMENT
/begin MEASUREMENT nox_ppm[1] "NOx concentration in the exhaust gas downstream of NOx catalyst" UWORD _CNV_A_R_NOXD_LINEA_486_CM 1 100. 0. 1500. DISPLAY_IDENTIFIER NOX_PPM[2] ECU_ADDRESS 0xd000a022 FORMAT "%4.0" /end MEASUREMENT
/begin MEASUREMENT t_nox_ns_mdl[0] "Timer for debounce of signal state 'valid' after re-entry into state 'valid'" UWORD _CNV_A_R_LINEAR_____3_CM 1 100. 0. 655.35 DISPLAY_IDENTIFIER T_NOX_NS_MDL[1] ECU_ADDRESS 0xd000a01c FORMAT "%6.2" /end MEASUREMENT
/begin MEASUREMENT t_nox_ns_mdl[1] "Timer for debounce of signal state 'valid' after re-entry into state 'valid'" UWORD _CNV_A_R_LINEAR_____3_CM 1 100. 0. 655.35 DISPLAY_IDENTIFIER T_NOX_NS_MDL[2] ECU_ADDRESS 0xd000a01e FORMAT "%6.2" /end MEASUREMENT
/begin MEASUREMENT lv_err_nox_sens_1 "NOx-Sensor OBD I failure is present" UBYTE _CNV_S_2_RANGE__0___1_CM 1 100. 0. 1. DISPLAY_IDENTIFIER LV_ERR_NOX_SENS_1 ECU_ADDRESS 0xd0007fd0 BIT_MASK 0x1 /end MEASUREMENT
/begin MEASUREMENT lv_err_nox_sens_2 "NOx-Sensor OBD I failure is present" UBYTE _CNV_S_2_RANGE__0___1_CM 1 100. 0. 1. DISPLAY_IDENTIFIER LV_ERR_NOX_SENS_2 ECU_ADDRESS 0xd0007fd6 BIT_MASK 0x1 /end MEASUREMENT
/begin MEASUREMENT fac_maf_max_s_pred "Predicted ratio between MAF and MAF_MAX for stratified mode" UWORD _CNV_A_R_LINEAR_____9_CM 1 100. 0. 1.99996948242188 DISPLAY_IDENTIFIER FAC_MAF_MAX_S_PRED ECU_ADDRESS 0xd000a026 FORMAT "%7.5" /end MEASUREMENT
/begin MEASUREMENT fac_maf_max_s "Ratio between MAF and MAF_MAX for stratified mode" UWORD _CNV_A_R_LINEAR_____9_CM 1 100. 0. 1.99996948242188 DISPLAY_IDENTIFIER FAC_MAF_MAX_S ECU_ADDRESS 0xd000a024 FORMAT "%7.5" /end MEASUREMENT
/begin MEASUREMENT fac_maf_max_homs "Ratio between MAF and MAF_MAX for HOMS mode" UWORD _CNV_A_R_LINEAR_____9_CM 1 100. 0. 1.99996948242188 DISPLAY_IDENTIFIER FAC_MAF_MAX_HOMS ECU_ADDRESS 0xd000a028 FORMAT "%7.5" /end MEASUREMENT
/begin MEASUREMENT fac_maf_max_homs_pred "Predicted ratio between MAF and MAF_MAX for HOMS mode" UWORD _CNV_A_R_LINEAR_____9_CM 1 100. 0. 1.99996948242188 DISPLAY_IDENTIFIER FAC_MAF_MAX_HOMS_PRED ECU_ADDRESS 0xd000a02a FORMAT "%7.5" /end MEASUREMENT
/begin MEASUREMENT lv_inh_nt_rgn_req "flag inhibiting the request of a NOx catalyst regeneration" UBYTE _CNV_S_2_RANGE__0___1_CM 1 100. 0. 1. DISPLAY_IDENTIFIER LV_INH_NT_RGN_REQ ECU_ADDRESS 0xd00081a8 /end MEASUREMENT
/begin MEASUREMENT lv_nt_mdl_afr "flag inhibiting the request of a NOx catalyst regeneration" UBYTE _CNV_S_2_RANGE__0___1_CM 1 100. 0. 1. DISPLAY_IDENTIFIER LV_NT_MDL_AFR ECU_ADDRESS 0xd00081aa /end MEASUREMENT
/begin MEASUREMENT lv_nt_rgn_stop_sens "flag inhibiting the request of a NOx catalyst regeneration" UBYTE _CNV_S_2_RANGE__0___1_CM 1 100. 0. 1. DISPLAY_IDENTIFIER LV_NT_RGN_STOP_SENS ECU_ADDRESS 0xd00081ab /end MEASUREMENT
/begin MEASUREMENT lv_nt_tout_afr "flag inhibiting the request of a NOx catalyst regeneration" UBYTE _CNV_S_2_RANGE__0___1_CM 1 100. 0. 1. DISPLAY_IDENTIFIER LV_NT_TOUT_AFR ECU_ADDRESS 0xd00081ae /end MEASUREMENT
/begin MEASUREMENT nox_ppm_rgn_st[0] "downstream NOx concentration by NOx sensor at start of regeneration" UWORD _CNV_A_R_NOXD_LINEA_486_CM 1 100. 0. 1500. DISPLAY_IDENTIFIER NOX_PPM_RGN_ST[1] ECU_ADDRESS 0xd000a02c FORMAT "%4.0" /end MEASUREMENT
/begin MEASUREMENT nox_ppm_rgn_st[1] "downstream NOx concentration by NOx sensor at start of regeneration" UWORD _CNV_A_R_NOXD_LINEA_486_CM 1 100. 0. 1500. DISPLAY_IDENTIFIER NOX_PPM_RGN_ST[2] ECU_ADDRESS 0xd000a02e FORMAT "%4.0" /end MEASUREMENT
/begin MEASUREMENT lv_nt_sens_afr_1 "downstream sensor measures rich exhaust gas (stop of regeneration)" UBYTE _CNV_S_2_RANGE__0___1_CM 1 100. 0. 1. DISPLAY_IDENTIFIER LV_NT_SENS_AFR_1 ECU_ADDRESS 0xd00081ac /end MEASUREMENT
/begin MEASUREMENT lv_nt_sens_afr_2 "downstream sensor measures rich exhaust gas (stop of regeneration)" UBYTE _CNV_S_2_RANGE__0___1_CM 1 100. 0. 1. DISPLAY_IDENTIFIER LV_NT_SENS_AFR_2 ECU_ADDRESS 0xd00081ad /end MEASUREMENT
/begin MEASUREMENT lv_nt_rgn_req_ad "flag inhibiting the request of a NOx catalyst regeneration" UBYTE _CNV_S_2_RANGE__0___1_CM 1 100. 0. 1. DISPLAY_IDENTIFIER LV_NT_RGN_REQ_AD ECU_ADDRESS 0xd00081a9 /end MEASUREMENT
/begin MEASUREMENT lv_nt_rgn_req "Logical value for regeneration phase request" UBYTE _CNV_S_2_RANGE__0___1_CM 1 100. 0. 1. DISPLAY_IDENTIFIER LV_NT_RGN_REQ ECU_ADDRESS 0xd00081af /end MEASUREMENT
/begin COMPU_METHOD _CNV_A_R_LINEAR_____0_CM "" RAT_FUNC "%6.3" "-" COEFFS 0 1. 0. 0 0 1 /end COMPU_METHOD
/begin COMPU_METHOD _CNV_S_2_RANGE__0___1_CM "" TAB_VERB "%6.3" "-" COMPU_TAB_REF _CNV_S_2_RANGE__0___1 /end COMPU_METHOD
/begin COMPU_VTAB _CNV_S_2_RANGE__0___1 "" TAB_VERB 2 0 "0" 1 "1" /end COMPU_VTAB
/begin COMPU_METHOD _CNV_A_R_LINEAR_____3_CM "" RAT_FUNC "%6.3" "s" COEFFS 0 100. 0. 0 0 1 /end COMPU_METHOD
/begin COMPU_METHOD _CNV_A_R_LINEAR_____4_CM "" RAT_FUNC "%6.3" "s" COEFFS 0 10. 0. 0 0 1 /end COMPU_METHOD
/begin COMPU_METHOD _CNV_A_R_LINEAR_____5_CM "" RAT_FUNC "%6.3" "%" COEFFS 0 2.56 0. 0 0 1 /end COMPU_METHOD
/begin COMPU_METHOD _CNV_A_R_LINEAR_____9_CM "" RAT_FUNC "%6.3" "-" COEFFS 0 32767.99999999992 0. 0 0 1 /end COMPU_METHOD
/begin COMPU_METHOD _CNV_A_R_LINEAR_____10_CM "" RAT_FUNC "%6.3" "rpm" COEFFS 0 3.125e-002 0. 0 0 1 /end COMPU_METHOD
/begin COMPU_METHOD _CNV_A_R_LINEAR_____15_CM "" RAT_FUNC "%6.3" "mg/stk" COEFFS 0 0.183585313174946 0. 0 0 1 /end COMPU_METHOD
/begin COMPU_METHOD _CNV_A_R_LINEAR_____17_CM "" RAT_FUNC "%6.3" "°C" COEFFS 0 1.333333333333333 64. 0 0 1 /end COMPU_METHOD
/begin COMPU_METHOD _CNV_A_R_LINEAR_____24_CM "" RAT_FUNC "%6.3" "-" COEFFS 0 16384. 0. 0 0 1 /end COMPU_METHOD
/begin COMPU_METHOD _CNV_A_R_LINEAR_____27_CM "" RAT_FUNC "%6.3" "hPa" COEFFS 0 12.06017666543982 0. 0 0 1 /end COMPU_METHOD
/begin COMPU_METHOD _CNV_A_R_LINEAR_____28_CM "" RAT_FUNC "%6.3" "-" COEFFS 0 256. 0. 0 0 1 /end COMPU_METHOD
/begin COMPU_METHOD _CNV_A_R_LINEAR_____31_CM "" RAT_FUNC "%6.3" "Nm" COEFFS 0 32. 0. 0 0 1 /end COMPU_METHOD
/begin COMPU_METHOD _CNV_A_R_LINEAR_____36_CM "" RAT_FUNC "%6.3" "s" COEFFS 0 1. 0. 0 0 1 /end COMPU_METHOD
/begin COMPU_METHOD _CNV_A_R_LINEAR_____37_CM "" RAT_FUNC "%6.3" "V" COEFFS 0 9.807692307692308 0. 0 0 1 /end COMPU_METHOD
/begin COMPU_METHOD _CNV_S_2_RANGE______76_CM "" TAB_VERB "%6.3" "" COMPU_TAB_REF _CNV_S_2_RANGE______76 /end COMPU_METHOD
/begin COMPU_VTAB _CNV_S_2_RANGE______76 "" TAB_VERB 2 0 "0" 1 "1" /end COMPU_VTAB
/begin COMPU_METHOD _CNV_A_R_LINEAR_____89_CM "" RAT_FUNC "%6.3" "-" COEFFS 0 65535.99999999996 0. 0 0 1 /end COMPU_METHOD
/begin COMPU_METHOD _CNV_A_R_LINEAR_____103_CM "" RAT_FUNC "%6.3" "-" COEFFS 0 128. 0. 0 0 1 /end COMPU_METHOD
/begin COMPU_METHOD _CNV_A_R_LINEAR_____110_CM "" RAT_FUNC "%6.3" "s" COEFFS 0 50. 0. 0 0 1 /end COMPU_METHOD
/begin COMPU_METHOD _CNV_A_R_LINEAR_____111_CM "" RAT_FUNC "%6.3" "mg/stk" COEFFS 0 47.18142548596112 0. 0 0 1 /end COMPU_METHOD
/begin COMPU_METHOD _CNV_A_R_LINEAR_____113_CM "" RAT_FUNC "%6.3" "%" COEFFS 0 655.3599999999997 -1.455191522836685e-011 0 0 1 /end COMPU_METHOD
/begin COMPU_METHOD _CNV_A_R_LINEAR_____115_CM "" RAT_FUNC "%6.3" "-" COEFFS 0 8192. 0. 0 0 1 /end COMPU_METHOD
/begin COMPU_METHOD _CNV_A_R_LINEAR_____116_CM "" RAT_FUNC "%6.3" "-" COEFFS 0 1023.999999959999 0. 0 0 1 /end COMPU_METHOD
/begin COMPU_METHOD _CNV_A_R_LINEAR_____125_CM "" RAT_FUNC "%6.3" "%" COEFFS 0 655.3600000143365 0. 0 0 1 /end COMPU_METHOD
/begin COMPU_METHOD _CNV_S_7_RANGE_C_CY_136_CM "" TAB_VERB "%6.3" "-" COMPU_TAB_REF _CNV_S_7_RANGE_C_CY_136 /end COMPU_METHOD
/begin COMPU_VTAB _CNV_S_7_RANGE_C_CY_136 "" TAB_VERB 7 0 "ZERO" 1 "ON" 2 "LAM_AD" 3 "SEL_HOT" 4 "WG_REQ" 5 "HOM_REQ" 6 "SEL_COLD" /end COMPU_VTAB
/begin COMPU_METHOD _CNV_S_3_RANGE_STAT_137_CM "" TAB_VERB "%6.3" "-" COMPU_TAB_REF _CNV_S_3_RANGE_STAT_137 /end COMPU_METHOD
/begin COMPU_VTAB _CNV_S_3_RANGE_STAT_137 "" TAB_VERB 3 0 "Wait" 1 "Request" 2 "Adaptation" /end COMPU_VTAB
/begin COMPU_METHOD _CNV_S_4_RANGE_C_CY_138_CM "" TAB_VERB "%6.3" "-" COMPU_TAB_REF _CNV_S_4_RANGE_C_CY_138 /end COMPU_METHOD
/begin COMPU_VTAB _CNV_S_4_RANGE_C_CY_138 "" TAB_VERB 4 0 "ADD" 1 "FAC_L" 2 "ADD_FAC_L" 3 "ADD_FAC_ALL" /end COMPU_VTAB
/begin COMPU_METHOD _CNV_S_3_RANGE_C_CY_139_CM "" TAB_VERB "%6.3" "-" COMPU_TAB_REF _CNV_S_3_RANGE_C_CY_139 /end COMPU_METHOD
/begin COMPU_VTAB _CNV_S_3_RANGE_C_CY_139 "" TAB_VERB 3 0 "LOW" 1 "HIGH" 2 "LOW_HIGH" /end COMPU_VTAB
/begin COMPU_METHOD _CNV_A_R_LINEAR_____162_CM "" RAT_FUNC "%6.3" "kg/h" COEFFS 0 8192. 0. 0 0 1 /end COMPU_METHOD
/begin COMPU_METHOD _CNV_A_R_LINEAR_____215_CM "" RAT_FUNC "%6.3" "kg/h" COEFFS 0 32. 0. 0 0 1 /end COMPU_METHOD
/begin COMPU_METHOD _CNV_A_R_LINEAR_____266_CM "" RAT_FUNC "%6.3" "-" COEFFS 0 64. 0. 0 0 1 /end COMPU_METHOD
/begin COMPU_METHOD _CNV_A_R_EVAC_LINEA_276_CM "" RAT_FUNC "%6.3" "hPa" COEFFS 0 12.06017666543982 32767.98240706662 0 0 1 /end COMPU_METHOD
/begin COMPU_METHOD _CNV_S_9_STATE_T_SD_277_CM "" TAB_VERB "%6.3" "-" COMPU_TAB_REF _CNV_S_9_STATE_T_SD_277 /end COMPU_METHOD
/begin COMPU_VTAB _CNV_S_9_STATE_T_SD_277 "" TAB_VERB 9 0 "PASSIVE" 1 "CP_FIXED" 2 "LAM_FIXED" 3 "WAIT_LAM" 4 "LAM_DYN" 5 "CP_DYN" 6 "WAIT_CP" 7 "OFF_CP" 8 "EXT_REQ" /end COMPU_VTAB
/begin COMPU_METHOD _CNV_S_4_STATE_MAN__278_CM "" TAB_VERB "%6.3" "-" COMPU_TAB_REF _CNV_S_4_STATE_MAN__278 /end COMPU_METHOD
/begin COMPU_VTAB _CNV_S_4_STATE_MAN__278 "" TAB_VERB 4 0 "AUTOMATIC" 1 "SDL_NONE" 2 "SDL_CP" 3 "LAM_AD" /end COMPU_VTAB
/begin COMPU_METHOD _CNV_S_4_STATE_CLL__282_CM "" TAB_VERB "%6.3" "-" COMPU_TAB_REF _CNV_S_4_STATE_CLL__282 /end COMPU_METHOD
/begin COMPU_VTAB _CNV_S_4_STATE_CLL__282 "" TAB_VERB 4 0 "CP_NO_DEAC" 1 "RAMP_OPEN_DEAC" 2 "MAX_PURGE_DEAC" 3 "RAMP_OPEN_FAST_DEAC" /end COMPU_VTAB
/begin COMPU_METHOD _CNV_S_3_STATE_LOCK_283_CM "" TAB_VERB "%6.3" "-" COMPU_TAB_REF _CNV_S_3_STATE_LOCK_283 /end COMPU_METHOD
/begin COMPU_VTAB _CNV_S_3_STATE_LOCK_283 "" TAB_VERB 3 0 "UNLOCKED" 1 "NO_PURGE_LOCKED" 2 "MIN_PURGE_LOCKED" /end COMPU_VTAB
/begin COMPU_METHOD _CNV_S_4_STATE_MOD__284_CM "" TAB_VERB "%6.3" "-" COMPU_TAB_REF _CNV_S_4_STATE_MOD__284 /end COMPU_METHOD
/begin COMPU_VTAB _CNV_S_4_STATE_MOD__284 "" TAB_VERB 4 0 "NO_PURGE" 1 "MIN_PURGE" 2 "MAX_PURGE" 3 "RAMP_CLOSE" /end COMPU_VTAB
/begin COMPU_METHOD _CNV_A_R_EVAC_LINEA_285_CM "" RAT_FUNC "%6.3" "g" COEFFS 0 2949840.175137362 0. 0 0 1 /end COMPU_METHOD
/begin COMPU_METHOD _CNV_S_12_STATE_CP_R_286_CM "" TAB_VERB "%6.3" "-" COMPU_TAB_REF _CNV_S_12_STATE_CP_R_286 /end COMPU_METHOD
/begin COMPU_VTAB _CNV_S_12_STATE_CP_R_286 "" TAB_VERB 12 0 "CP_NOT_ACT" 1 "NO_PURGE" 2 "RAMP_TO_NO_PURGE" 3 "WAIT_RAMP_OPEN" 4 "MIN_PURGE" 5 "UNUSED" 6 "UNUSED" 7 "UNUSED" 8 "RAMP_OPEN" 9 "RAMP_OPEN_FAST" 10 "MAX_PURGE" 11 "RAMP_CLOSE" /end COMPU_VTAB
/begin COMPU_METHOD _CNV_A_R_LINEAR_____287_CM "" RAT_FUNC "%6.3" "g" COEFFS 0 35.99999999999994 0. 0 0 1 /end COMPU_METHOD
/begin COMPU_METHOD _CNV_A_R_LINEAR_____288_CM "" RAT_FUNC "%6.3" "Hz" COEFFS 0 1. 0. 0 0 1 /end COMPU_METHOD
/begin COMPU_METHOD _CNV_A_R_EVAC_LINEA_289_CM "" RAT_FUNC "%6.3" "%" COEFFS 0 1.277495107632094 -0.2504892367905995 0 0 1 /end COMPU_METHOD
/begin COMPU_METHOD _CNV_A_R_EVAC_LINEA_290_CM "" RAT_FUNC "%6.3" "%" COEFFS 0 2.56 128. 0 0 1 /end COMPU_METHOD
/begin COMPU_METHOD _CNV_A_R_LINEAR_____293_CM "" RAT_FUNC "%6.3" "hPa" COEFFS 0 12.06017666543982 -1.759293338545831e-002 0 0 1 /end COMPU_METHOD
/begin COMPU_METHOD _CNV_S_3_STATE_OPM__294_CM "" TAB_VERB "%6.3" "-" COMPU_TAB_REF _CNV_S_3_STATE_OPM__294 /end COMPU_METHOD
/begin COMPU_VTAB _CNV_S_3_STATE_OPM__294 "" TAB_VERB 3 0 "ENG_MODE_0" 1 "ENG_MODE_1" 2 "ENG_MODE_2" /end COMPU_VTAB
/begin COMPU_METHOD _CNV_A_R_NOXD_LINEA_486_CM "" RAT_FUNC "%6.3" "ppm" COEFFS 0 1. 0. 0 0 1 /end COMPU_METHOD
/begin RECORD_LAYOUT _REC_VAL_20_u1 FNC_VALUES 1 UBYTE COLUMN_DIR DIRECT /end RECORD_LAYOUT
/begin RECORD_LAYOUT _REC_VAL_20_u2 FNC_VALUES 1 UWORD COLUMN_DIR DIRECT /end RECORD_LAYOUT
/begin RECORD_LAYOUT _REC_AXS_20_u1 NO_AXIS_PTS_X 1 UBYTE AXIS_PTS_X 2 UBYTE INDEX_INCR DIRECT /end RECORD_LAYOUT
/begin RECORD_LAYOUT _REC_MAP_20_u2_u1_u1 FNC_VALUES 1 UWORD COLUMN_DIR DIRECT /end RECORD_LAYOUT
/begin RECORD_LAYOUT _REC_CUR_20_u1_u1 FNC_VALUES 1 UBYTE COLUMN_DIR DIRECT /end RECORD_LAYOUT
/begin RECORD_LAYOUT _REC_VAL_20_s2 FNC_VALUES 1 SWORD COLUMN_DIR DIRECT /end RECORD_LAYOUT
/begin RECORD_LAYOUT _REC_MAP_20_u2_u2_u1 FNC_VALUES 1 UWORD COLUMN_DIR DIRECT /end RECORD_LAYOUT
/begin RECORD_LAYOUT _REC_AXS_20_u2 NO_AXIS_PTS_X 1 UWORD AXIS_PTS_X 2 UWORD INDEX_INCR DIRECT /end RECORD_LAYOUT
/begin RECORD_LAYOUT _REC_CUR_20_u2_u1 FNC_VALUES 1 UWORD COLUMN_DIR DIRECT /end RECORD_LAYOUT
/begin RECORD_LAYOUT _REC_CUR_20_u2_u2 FNC_VALUES 1 UWORD COLUMN_DIR DIRECT /end RECORD_LAYOUT
/begin RECORD_LAYOUT _REC_VAL_20_s1 FNC_VALUES 1 SBYTE COLUMN_DIR DIRECT /end RECORD_LAYOUT
/begin RECORD_LAYOUT _REC_CUR_20_u1_u2 FNC_VALUES 1 UBYTE COLUMN_DIR DIRECT /end RECORD_LAYOUT
/begin RECORD_LAYOUT _REC_MAP_20_u2_u1_u2 FNC_VALUES 1 UWORD COLUMN_DIR DIRECT /end RECORD_LAYOUT
/begin RECORD_LAYOUT _REC_MAP_20_u1_u2_u2 FNC_VALUES 1 UBYTE COLUMN_DIR DIRECT /end RECORD_LAYOUT
/begin RECORD_LAYOUT _REC_MAP_20_u1_u1_u1 FNC_VALUES 1 UBYTE COLUMN_DIR DIRECT /end RECORD_LAYOUT
/begin FUNCTION CYBL_Cyl_Bal_Coord_at_DC "Cyl_Bal_Coord_at_DC"
 /begin DEF_CHARACTERISTIC lc_cyl_bal_cord_dc_stop_man lc_cyl_bal_ad_dc_rst c_fac_mff_lam_adj_cyl_bal_dc c_cyl_bal_ad_dc_rst c_t_ast_max_cyl_bal_ad_dc id_t_cyl_bal_lam_sel_ad_dc c_t_min_cyl_bal_ad_req_dc c_t_min_cyl_bal_ad_wait_dc c_tco_st_max_cyl_bal_ad_dc c_tco_st_min_cyl_bal_ad_dc c_fac_cyl_lam_absv_sum_bal_dc c_cyl_bal_lam_ad_dc_conf c_cyl_bal_lam_sel_hot_dc_conf id_t_cyl_bal_lam_ad_dc c_tco_thd_cyl_bal_lam_sel_dc c_t_min_cyl_bal_lam_sel_dc c_t_max_cyl_bal_lam_sel_dc c_t_min_cyl_bal_lam_ad_dc c_t_max_cyl_bal_lam_ad_dc ldp_t_ast_id_t_bal_lam_sel_dc ldp_t_ast_id_t_bal_lam_ad_dc /end DEF_CHARACTERISTIC
 /begin OUT_MEASUREMENT lv_cyl_bal_lam_sel_ad_hot_dc lv_cyl_bal_lam_ad_add_dc[0] lv_cyl_bal_lam_ad_add_dc[1] lv_cyl_bal_lam_ad_fac_l_dc[0] lv_cyl_bal_lam_ad_fac_l_dc[1] lv_cyl_bal_lam_ad_fac_h_dc[0] lv_cyl_bal_lam_ad_fac_h_dc[1] lv_cyl_bal_lam_ad_stop[0] lv_cyl_bal_lam_ad_stop[1] lv_cyl_bal_ad_wg_open_req[0] lv_cyl_bal_ad_wg_open_req[1] lv_cyl_bal_ad_wg_open_req_dc[0] lv_cyl_bal_ad_wg_open_req_dc[1] lv_cyl_bal_ad_hom_req_dc lv_cyl_bal_lam_ad_dc lv_cyl_bal_lam_ad_hom_req_dc lv_cyl_bal_lam_sel_hom_req_dc lv_state_lam_ad_dc_chg_req lv_state_lam_ad_dc_chg_wait lv_state_lam_sel_dc_chg_wait lv_state_lam_sel_dc_chg_req state_cyl_bal_lam_ad_dc state_cyl_bal_lam_sel_ad_dc t_cyl_bal_lam_ad_req_dc[0] t_cyl_bal_lam_ad_req_dc[1] t_cyl_bal_lam_sel_ad_req_dc[0] t_cyl_bal_lam_sel_ad_req_dc[1] t_cyl_bal_lam_ad_wait_dc t_cyl_bal_lam_sel_ad_wait_dc lv_cyl_bal_lam_sel_ad_rng_l_dc[0] lv_cyl_bal_lam_sel_ad_rng_l_dc[1] lv_cyl_bal_lam_sel_ad_rng_h_dc[0] lv_cyl_bal_lam_sel_ad_rng_h_dc[1] lv_cyl_bal_lam_sel_ad_cold_dc lv_cyl_bal_lam_ad_ena_dc t_cyl_bal_lam_ad_dc t_cyl_bal_lam_sel_dc t_cyl_bal_lam_sel_ad_rng_l_dc[0] t_cyl_bal_lam_sel_ad_rng_l_dc[1] t_cyl_bal_lam_sel_ad_rng_h_dc[0] t_cyl_bal_lam_sel_ad_rng_h_dc[1] lv_cyl_bal_lam_sel_rng_cold_dc[0] lv_cyl_bal_lam_sel_rng_cold_dc[1] t_cyl_bal_lam_sel_rng_cold_dc[0] t_cyl_bal_lam_sel_rng_cold_dc[1] t_cyl_bal_lam_ad_add_dc[0] t_cyl_bal_lam_ad_add_dc[1] t_cyl_bal_lam_ad_fac_l_dc[0] t_cyl_bal_lam_ad_fac_l_dc[1] t_cyl_bal_lam_ad_fac_h_dc[0] t_cyl_bal_lam_ad_fac_h_dc[1] /end OUT_MEASUREMENT
/end FUNCTION
/begin FUNCTION C_B_CYBL "" /begin SUB_FUNCTION CYBL_Cyl_Bal_diag /end SUB_FUNCTION /end FUNCTION
/begin FUNCTION CYBL_Cyl_Bal_diag "Cyl_Bal_diag"
 /begin DEF_CHARACTERISTIC c_t_sum_min_cyl_bal_lim c_t_sum_rst_max_cyl_bal c_ctr_max_cyl_bal_lam_err c_ctr_inc_err_obd_diag_cyl_bal c_ctr_dec_err_obd_diag_cyl_bal c_ctr_max_cyl_bal_er_err c_t_sum_thd_cyl_bal_lim lc_ctr_err_obd_diag_cyl_bal /end DEF_CHARACTERISTIC
 /begin OUT_MEASUREMENT t_sum_cyl_bal_lam_lim_min[0] t_sum_cyl_bal_lam_lim_min[1] t_sum_cyl_bal_lam_lim_min[2] t_sum_cyl_bal_lam_lim_min[3] t_sum_cyl_bal_lam_lim_min[4] t_sum_cyl_bal_lam_lim_min[5] t_sum_cyl_bal_lam_lim_min[6] t_sum_cyl_bal_lam_lim_min[7] t_sum_cyl_bal_lam_lim_max[0] t_sum_cyl_bal_lam_lim_max[1] t_sum_cyl_bal_lam_lim_max[2] t_sum_cyl_bal_lam_lim_max[3] t_sum_cyl_bal_lam_lim_max[4] t_sum_cyl_bal_lam_lim_max[5] t_sum_cyl_bal_lam_lim_max[6] t_sum_cyl_bal_lam_lim_max[7] t_sum_cyl_bal_er_lim_min[0] t_sum_cyl_bal_er_lim_min[1] t_sum_cyl_bal_er_lim_min[2] t_sum_cyl_bal_er_lim_min[3] t_sum_cyl_bal_er_lim_min[4] t_sum_cyl_bal_er_lim_min[5] t_sum_cyl_bal_er_lim_min[6] t_sum_cyl_bal_er_lim_min[7] t_sum_rst_cyl_bal_lam[0] t_sum_rst_cyl_bal_lam[1] t_sum_rst_cyl_bal_lam[2] t_sum_rst_cyl_bal_lam[3] t_sum_rst_cyl_bal_lam[4] t_sum_rst_cyl_bal_lam[5] t_sum_rst_cyl_bal_lam[6] t_sum_rst_cyl_bal_lam[7] t_sum_end_diag_win_cyl_bal_lam[0] t_sum_end_diag_win_cyl_bal_lam[1] t_sum_end_diag_win_cyl_bal_lam[2] t_sum_end_diag_win_cyl_bal_lam[3] t_sum_end_diag_win_cyl_bal_lam[4] t_sum_end_diag_win_cyl_bal_lam[5] t_sum_end_diag_win_cyl_bal_lam[6] t_sum_end_diag_win_cyl_bal_lam[7] t_sum_end_diag_win_cyl_bal_er[0] t_sum_end_diag_win_cyl_bal_er[1] t_sum_end_diag_win_cyl_bal_er[2] t_sum_end_diag_win_cyl_bal_er[3] t_sum_end_diag_win_cyl_bal_er[4] t_sum_end_diag_win_cyl_bal_er[5] t_sum_end_diag_win_cyl_bal_er[6] t_sum_end_diag_win_cyl_bal_er[7] t_sum_cyl_bal_er_lim_max[0] t_sum_cyl_bal_er_lim_max[1] t_sum_cyl_bal_er_lim_max[2] t_sum_cyl_bal_er_lim_max[3] t_sum_cyl_bal_er_lim_max[4] t_sum_cyl_bal_er_lim_max[5] t_sum_cyl_bal_er_lim_max[6] t_sum_cyl_bal_er_lim_max[7] lv_err_cyl_bal_lam[0] lv_err_cyl_bal_lam[1] lv_err_cyl_bal_lam[2] lv_err_cyl_bal_lam[3] lv_err_cyl_bal_lam[4] lv_err_cyl_bal_lam[5] lv_err_cyl_bal_lam[6] lv_err_cyl_bal_lam[7] lv_err_cyl_bal_er[0] lv_err_cyl_bal_er[1] lv_err_cyl_bal_er[2] lv_err_cyl_bal_er[3] lv_err_cyl_bal_er[4] lv_err_cyl_bal_er[5] lv_err_cyl_bal_er[6] lv_err_cyl_bal_er[7] lv_end_diag_win_cyl_bal_lam[0] lv_end_diag_win_cyl_bal_lam[1] lv_end_diag_win_cyl_bal_lam[2] lv_end_diag_win_cyl_bal_lam[3] lv_end_diag_win_cyl_bal_lam[4] lv_end_diag_win_cyl_bal_lam[5] lv_end_diag_win_cyl_bal_lam[6] lv_end_diag_win_cyl_bal_lam[7] lv_end_diag_win_cyl_bal_er[0] lv_end_diag_win_cyl_bal_er[1] lv_end_diag_win_cyl_bal_er[2] lv_end_diag_win_cyl_bal_er[3] lv_end_diag_win_cyl_bal_er[4] lv_end_diag_win_cyl_bal_er[5] lv_end_diag_win_cyl_bal_er[6] lv_end_diag_win_cyl_bal_er[7] t_sum_rst_cyl_bal_er[0] t_sum_rst_cyl_bal_er[1] t_sum_rst_cyl_bal_er[2] t_sum_rst_cyl_bal_er[3] t_sum_rst_cyl_bal_er[4] t_sum_rst_cyl_bal_er[5] t_sum_rst_cyl_bal_er[6] t_sum_rst_cyl_bal_er[7] ctr_err_obd_diag_cyl_bal_lam[0] ctr_err_obd_diag_cyl_bal_lam[1] ctr_err_obd_diag_cyl_bal_er lv_inh_obd_diag_cyl_bal_lam[0] lv_inh_obd_diag_cyl_bal_lam[1] lv_err_ref_cyl_bal_lam[0] lv_err_ref_cyl_bal_lam[1] lv_inh_obd_diag_cyl_bal_er lv_err_ref_cyl_bal_er /end OUT_MEASUREMENT
/end FUNCTION
/begin FUNCTION AGGR_NOXD_adaptation ""
 /begin OUT_MEASUREMENT nox_ns[0] nox_ns[1] nox_ns_diag[0] nox_ns_diag[1] lv_err_nox_sens_can_boff lv_err_nox_sens_can_msg_lost_1 lv_err_nox_sens_can_msg_lost_2 lv_err_ns_can_boff lv_err_ns_can_msg_lost_1 lv_err_ns_can_msg_lost_2 lv_t_nox_sens_vld lv_t_nox_sens_vld_1 lv_t_nox_sens_vld_2 lv_nox_ns_diag_vld_1 lv_nox_ns_diag_vld_2 nox_ppm[0] nox_ppm[1] t_nox_ns_mdl[0] t_nox_ns_mdl[1] lv_err_nox_sens_1 lv_err_nox_sens_2 /end OUT_MEASUREMENT
/end FUNCTION
/begin FUNCTION C_9_VVLI "" /begin SUB_FUNCTION VVLI_Actuator_Diagnosis /end SUB_FUNCTION /end FUNCTION
/begin FUNCTION VVLI_Actuator_Diagnosis "_Actuator_Diagnosis" /begin DEF_CHARACTERISTIC lc_state_test_opm_can_ena_vvl /end DEF_CHARACTERISTIC /end FUNCTION
/begin FUNCTION AGGR_NOXM_adaptation ""
 /begin OUT_MEASUREMENT fac_maf_max_s_pred fac_maf_max_s fac_maf_max_homs fac_maf_max_homs_pred lv_inh_nt_rgn_req lv_nt_mdl_afr lv_nt_rgn_stop_sens lv_nt_tout_afr nox_ppm_rgn_st[0] nox_ppm_rgn_st[1] lv_nt_sens_afr_1 lv_nt_sens_afr_2 lv_nt_rgn_req_ad lv_nt_rgn_req /end OUT_MEASUREMENT
/end FUNCTION
/begin FUNCTION C_9_EVAC "C_9_EVAC"
 /begin DEF_CHARACTERISTIC ldpm_n_32_2_evac ldpm_n_32_1_evac ldpm_amp_1_evac ldpm_n_32_3_evac ldpm_vb_1_evac ldpm_prs_cps_1_evac ldpm_map_1_evac ldpm_tia_1_evac ldpm_tqi_sp_s_2_evac ldpm_maf_cyl_1_evac ldpm_maf_2_evac ldpm_mff_sp_mv_1_evac ldpm_mff_sp_mv_2_evac ldp_n_32_id_flow_inc_nr_cp ldpm_maf_kgh_cor_ip_t_dly_cp ldpm_tqi_sp_s_ip_ratio_fuel_max ldpm_mff_evac ldp_cl_mdl_slop_0_ip_cl_slop ldp_cl_mdl_slop_int_ip_cl_value /end DEF_CHARACTERISTIC
 /begin SUB_FUNCTION EVAC_Time_control_lambda_CP EVAC_emission_control EVAC_Injection_calculation EVAC_CP_valve_control EVAC_emission_control_A_I EVAC_Flow_setpoints EVAC_lambda_CL_calculation EVAC_Canister_Load_Model EVAC_CP_valve_adaptation /end SUB_FUNCTION
/end FUNCTION
/begin FUNCTION EVAC_Time_control_lambda_CP "Time_control_lambda_adaptation_CP"
 /begin DEF_CHARACTERISTIC c_cl_mmv_t_bol c_cl_mmv_t_tol ldp_cl_mmv_ip_t_max_cp c_state_man_sdl_cp lc_mff_ad_ena_pas lc_cp_ena_wait_lam lc_cl_cp_dyn_end_ena lc_lam_lim_ad_ena lc_sdl_lam_ad_cdn_off c_t_2_cp c_t_di_cp c_t_mff_ad_max id_t_lam_ad_thd[0] id_t_lam_ad_thd[1] id_t_lam_ad_thd[2] id_t_lam_ad_thd[3] id_dur_lam_ad[0] id_dur_lam_ad[1] id_dur_lam_ad[2] id_dur_lam_ad[3] ip_t_max_cp c_t_sdl_ext_req c_cl_mmv_t_wait_lam c_tco_dyn_t_ctl /end DEF_CHARACTERISTIC
 /begin OUT_MEASUREMENT state_t_sdl_cp t_cp lv_cp_ena t_ad t_max_ad lv_lam_ad_ena ctr_lam_ad_sdl_cp /end OUT_MEASUREMENT
/end FUNCTION
/begin FUNCTION EVAC_emission_control "Evaporative_emission_control"
 /begin DEF_CHARACTERISTIC lc_lam_lin_cps c_flow_cps_as c_flow_cps_sp_purge_tube c_flow_cps_grd_purge_tube c_maf_dly_crlc_cp c_fac_dec_cor_cmu_cp c_fac_dec_cor_1_cp c_fac_dec_cor_2_cp lc_pq_sp_cp_hom_afl lc_cp_tran_open_max_ena lc_flow_cps_as lc_cp_tran_deac_cll lc_cp_tra_min_ramp_open_dis lc_cp_tra_min_purge_dft_ena lc_cp_tra_opl_cdn_not lc_cp_tra_opl_cdn_cll_not c_state_mod_sel_cp c_crlc_pq_sp_cp lc_cp_tra_max_min_cdn_ena lc_cp_flow_lim_open_fast ldp_cl_ip_flow_fac ip_flow_inc_cp ip_flow_fac_cp ip_flow_dec_cp id_flow_inc_nr_cp c_cl_mmv_pq ip_fac_amp_cp ip_fac_tia_cp ip_flow_cps_dec ip_flow_cps_inc c_cl_mmv_req c_cl_cat_diag c_t_lock_cp c_t_dly_req_cp ip_pq_cp_sp ldp_tia_thr_ip_fac_tia_cp c_t_dly_cp c_t_dly_cl_mdl c_flow_cps_grd_purge_tube_close ip_t_dly_cp ip_t_dly_cp_2 ip_flow_max_open_cps ip_flow_max_open_cps_2 c_flow_ini_cps c_mff_max_cps_di ip_flow_inc_fast_cp ip_flow_inc_cor_hom_cp c_t_di_ramp_open_cp_0 c_t_dly_max_cp_0 c_flow_dly_crlc_cp c_t_dly_max_cp_1 c_t_di_ramp_open_cp_1 c_t_di_ramp_fast_cp_0 c_t_di_ramp_fast_cp_1 c_t_cp_purge_tube c_t_max_maf_int_cp c_t_min_maf_int_cp c_fac_t_dly_purge_tube_cp c_mff_ratio_flow_ini_cp c_maf_int_max_cp_0 c_maf_int_max_cp_1 c_t_di_max_cp_0 c_t_di_max_cp_1 /end DEF_CHARACTERISTIC
 /begin OUT_MEASUREMENT lv_cp_ramp_open_act lv_cl_clc_vld flow_ctl_cps flow_tar_cps flow_open_cps lv_t_dly_req_cp t_dly_max_cp state_cll_deac_cp state_lock_cp lv_cp_cdn_ramp_open lv_cp_cdn_ramp_open_fast lv_cl_clc_avl flow_sp_cps flow_cor_cps flow_cps flow_dly_cp flow_dly_mmv_cp flow_dly_old_2_cp flow_cps_old_1 flow_cps_old_2 fac_tia_amp_cp flow_fac_cp maf_cp maf_dly_mmv_cp maf_cp_old_1 maf_cp_old_2 maf_dly_old_2_cp maf_dly_cp lv_cp_act_req lv_state_mem_cp_cll t_dly_cp_open t_di_cp lv_cp_cll lv_dly_gas_cp pq_cp_sp flow_tot_cps cl_mmv_clc_end t_lock_cp flow_grd_cps flow_ctl_cps_di state_cp t_dly_cp t_dly_cl_mdl maf_cps maf_int_cp t_maf_int_cp /end OUT_MEASUREMENT
/end FUNCTION
/begin FUNCTION EVAC_Injection_calculation "Evaporative_emission_flow_calculation"
 /begin DEF_CHARACTERISTIC ip_crlc_mff_buf_cp ip_mff_dly_cp lc_flow_cps_cal ip_maf_kgh_pred_cor_map_tia ip_maf_kgh_pred_cor_map_tia_2 lc_maf_cor_act_cp ldpm_maf_cyl_1_evac_mff_dly_cp ldpm_maf_kgh_clc_ip_idx_step_cp ip_mff_dly_cp_2 ip_idx_step_cp ip_idx_step_cp_2 /end DEF_CHARACTERISTIC
 /begin OUT_MEASUREMENT tqi_add_cp mff_cps mff_buf_cp mff_tot_cp mff_add_buf[0] mff_add_buf[1] mff_add_buf[2] mff_add_buf[3] mff_add_buf[4] mff_add_buf[5] mff_add_buf[6] mff_add_buf[7] mff_add_buf[8] mff_add_buf[9] mff_add_buf[10] mff_add_buf[11] mff_add_buf[12] mff_add_buf[13] mff_add_buf[14] mff_add_buf[15] mff_add_buf[16] mff_add_buf[17] mff_add_buf[18] mff_add_buf[19] mff_add_buf[20] mff_add_buf[21] mff_add_buf[22] mff_add_buf[23] mff_add_buf[24] mff_add_buf[25] mff_add_buf[26] mff_add_buf[27] mff_add_buf[28] mff_add_buf[29] mff_add_buf[30] mff_add_buf[31] mff_add_buf[32] mff_add_buf[33] mff_add_buf[34] mff_add_buf[35] mff_add_buf[36] mff_add_buf[37] mff_add_buf[38] mff_add_buf[39] mff_add_buf[40] mff_add_buf[41] mff_add_buf[42] mff_add_buf[43] mff_add_buf[44] mff_add_buf[45] mff_add_buf[46] mff_add_buf[47] mff_add_buf[48] mff_add_buf[49] mff_add_buf[50] mff_add_buf[51] mff_add_buf[52] mff_add_buf[53] mff_add_buf[54] mff_add_buf[55] mff_add_buf[56] mff_add_buf[57] mff_add_buf[58] mff_add_buf[59] mff_add_buf[60] mff_add_buf[61] mff_add_buf[62] mff_add_buf[63] mff_add_buf[64] mff_add_buf[65] mff_add_buf[66] mff_add_buf[67] mff_add_buf[68] mff_add_buf[69] mff_add_buf[70] mff_add_buf[71] mff_add_buf[72] mff_add_buf[73] mff_add_buf[74] mff_add_buf[75] mff_add_buf[76] mff_add_buf[77] mff_add_buf[78] mff_add_buf[79] buf_inp_cp buf_out_cp maf_kgh_fg_pred_cor_cp mff_add_lam_cp mff_add_cyl_cp /end OUT_MEASUREMENT
/end FUNCTION
/begin FUNCTION EVAC_CP_valve_control "Canister_purge_valve_control"
 /begin DEF_CHARACTERISTIC c_n_frq_1_cps c_n_frq_2_cps c_n_frq_hys_cps c_cppwm_frq_1_cps c_cppwm_frq_2_cps c_cppwm_frq_hys_cps lc_cppwm_lim_diag lc_cppwm_as c_cppwm_max_frq_1_lim_cp c_cppwm_max_frq_2_lim_cp c_cppwm_min_frq_1_lim_cp c_cppwm_min_frq_2_lim_cp ldp_cppwm_ip_cppwm_cor_frq ip_cppwm_cor_frq ldp_flow_cor_cps_ip_cppwm c_cppwm_frq_1 c_cppwm_frq_2 c_cppwm_as ip_cppwm_vb_add_1 ip_cppwm_vb_add_2 ip_cppwm ip_cppwm_vb_fac ldp_prs_cps_ip_cppwm_vb_fac ip_cppwm_vb_fac_prs_cps /end DEF_CHARACTERISTIC
 /begin OUT_MEASUREMENT cppwm_cps lv_frq_1_cps cppwm lv_cp_close_act frq_req_cp /end OUT_MEASUREMENT
/end FUNCTION
/begin FUNCTION EVAC_emission_control_A_I "Evaporative_emission_control_A_I"
 /begin DEF_CHARACTERISTIC ldpm_maf_ip_rel_flow_max_cps ip_fac_rel_flow_cps_wout_cat id_state_opm_eng_cp c_t_dly_cp_lamb_ch c_t_dly_cp_opm_av c_t_ast_max_inh_cp_sdl c_ctr_dly_cll_is_s_max_cp c_ctr_dly_cll_is_s_inc_cp c_ctr_dly_cll_is_s_dec_cp c_cl_mmv_cll_is_s_max ip_mff_red_opm_cp c_crlc_mff_grd_cp c_fac_flow_tar_cor_min_cp c_tco_max_inh_cp_sdl lc_err_map_min_purge_cp lc_cp_act lc_cp_ast_act ip_t_st_ast_tco_st_cps_min ldp_tco_st_ip_t_st ldp_mff_sp_mv_ip_mff_red_cp /end DEF_CHARACTERISTIC
 /begin OUT_MEASUREMENT lv_inh_cp_cll lv_cp_dyw_ext lv_inh_lam_ad_sdl lv_cp_close_1 lv_cp_close_2 lv_cp_close_3 lv_inh_cp_fast lv_inh_cp_sdl lv_t_sdl_ext_req lv_cps_ad_inh prs_cps_ext fac_flow_cor_cp_ext fac_flow_cor_cp_min_purge state_opm_eng_cp lv_inh_cp lv_state_opm_chg_s_cp lv_state_opm_chg_hom_cp lv_inh_cll_is_s_cp ctr_dly_cll_is_s_cp fac_flow_tar_cor_cp lv_flow_tar_cor_cp mff_red_opm_thd_cp mff_grd_cp mff_grd_mmv_cp t_ast_cp lv_cp_act t_dly_cp_opm_av t_dly_cp_lamb_ch /end OUT_MEASUREMENT
/end FUNCTION
/begin FUNCTION EVAC_Flow_setpoints ""
 /begin DEF_CHARACTERISTIC ldp_cl_mmv_ip_fac_flow_min ip_fac_flow_sp_min_purge c_cl_max_min_purge c_fac_flow_sp_min_purge_max c_mff_min_cp lc_fac_flow_sp_min_purge ip_ratio_fuel_max_cp_cor ip_flow_cps ldp_tco_ip_ratio_fuel_max_cp ip_flow_cps_eng_mod_0 ip_flow_cps_eng_mod_1 ip_flow_cps_eng_mod_2 ip_ratio_fuel_max_cp_mod_0 ip_ratio_fuel_max_cp_mod_1 ip_ratio_fuel_max_cp_mod_2 ip_flow_max_cps ip_flow_max_2_cps ldpm_tqi_sp_s_3_evac /end DEF_CHARACTERISTIC
 /begin OUT_MEASUREMENT flow_max_cps mff_kgh_max_cp ratio_fuel_sp_max_purge mff_max_cp fac_flow_sp_min_purge flow_cps_sp_min_purge flow_max_phy_cps /end OUT_MEASUREMENT
/end FUNCTION
/end MODULE
/end PROJECT
