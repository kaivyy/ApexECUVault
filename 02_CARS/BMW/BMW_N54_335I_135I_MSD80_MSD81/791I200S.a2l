ASAP2_VERSION 1 41
/begin PROJECT MSD85 "Spray Guided DI-System with Piezo Injectors for 8-Cylinder"
/begin HEADER "_default_HeaderComment" PROJECT_NO _91 /end HEADER
/begin MODULE _default_ModuleName "_default_ModuleLongIdentifier"
/begin MOD_COMMON "_default_ModCommonComment" DEPOSIT ABSOLUTE BYTE_ORDER MSB_LAST ALIGNMENT_BYTE 1 ALIGNMENT_WORD 2 ALIGNMENT_LONG 2 ALIGNMENT_FLOAT32_IEEE 2 ALIGNMENT_FLOAT64_IEEE 4 /end MOD_COMMON
/begin MEASUREMENT Absch_korr "Korrekturwert Abschaltung" SWORD _CNV_R_R_Def_f_sw_q_550_CM 1 100. -39.9993 39.9993 DISPLAY_IDENTIFIER ABSCH_KORR ECU_ADDRESS 0xc0004694 FORMAT "%8.3" /end MEASUREMENT
/begin MEASUREMENT All2ptc "Gesamtgewichtung für PTC-Ansteuerung" SWORD _CNV_R_R_Def_f_sw_p_557_CM 1 100. -500. 550. DISPLAY_IDENTIFIER ALL2PTC ECU_ADDRESS 0xc0000b18 FORMAT "%7.2" /end MEASUREMENT
/begin MEASUREMENT Allptcfilt "pi-geregelte Gewichtung für PTC-Ansteuerung" UWORD _CNV_R_R_Def_f_sw_p_557_CM 1 100. 0. 550. DISPLAY_IDENTIFIER ALLPTCFILT ECU_ADDRESS 0xc0000b3e FORMAT "%8.3" /end MEASUREMENT
/begin MEASUREMENT Batt_h2m_l "high to medium" SWORD _CNV_R_R_Def_f_sw_b_570_CM 1 100. -100. 99.9969 DISPLAY_IDENTIFIER BATT_H2M_L ECU_ADDRESS 0xc0000c86 FORMAT "%8.3" /end MEASUREMENT
/begin MEASUREMENT Batt_h2m_r "high to medium Hysterese" SWORD _CNV_R_R_Def_f_sw_b_570_CM 1 100. -100. 99.9969 DISPLAY_IDENTIFIER BATT_H2M_R ECU_ADDRESS 0xc0000c88 FORMAT "%8.3" /end MEASUREMENT
/begin MEASUREMENT Batt_index "Batterie Index" UBYTE _CNV_R_R_Def_dez_sl_551_CM 1 100. 0. 255. DISPLAY_IDENTIFIER BATT_INDEX ECU_ADDRESS 0xc0000ad6 FORMAT "%3.0" /end MEASUREMENT
/begin MEASUREMENT Batt_m2l "medium to low" SWORD _CNV_R_R_Def_f_sw_b_570_CM 1 100. -100. 99.9969 DISPLAY_IDENTIFIER BATT_M2L ECU_ADDRESS 0xc0000c50 FORMAT "%8.3" /end MEASUREMENT
/begin MEASUREMENT Batt_m2l_l "medium 2 low" SWORD _CNV_R_R_Def_f_sw_b_570_CM 1 100. -100. 99.9969 DISPLAY_IDENTIFIER BATT_M2L_L ECU_ADDRESS 0xc0000c8a FORMAT "%8.3" /end MEASUREMENT
/begin MEASUREMENT Batt_m2l_r "medium to low Hysterese" SWORD _CNV_R_R_Def_f_sw_b_570_CM 1 100. -100. 99.9969 DISPLAY_IDENTIFIER BATT_M2L_R ECU_ADDRESS 0xc0000c8c FORMAT "%8.3" /end MEASUREMENT
/begin MEASUREMENT Batt_ort "Batterieeinbauort" UBYTE _CNV_R_R_Def_dez_sl_551_CM 1 100. 0. 255. DISPLAY_IDENTIFIER BATT_ORT ECU_ADDRESS 0xc0000c74 FORMAT "%3.0" /end MEASUREMENT
/begin MEASUREMENT Batt_tfil "Zeitkonstante Batterie" UWORD _CNV_R_R_Def_f_uw_b_571_CM 1 100. 0. 0.9999847412109381 DISPLAY_IDENTIFIER BATT_TFIL ECU_ADDRESS 0xc0000c70 FORMAT "%14.5" /end MEASUREMENT
/begin MEASUREMENT Battfak "" UWORD _CNV_R_R_Def_f_uw_b_572_CM 1 100. 0. 7.9998 DISPLAY_IDENTIFIER BATTFAK ECU_ADDRESS 0xc0007a3c FORMAT "%9.4" /end MEASUREMENT
/begin MEASUREMENT C_battnenn "Batteriekapazitaet" UBYTE _CNV_R_R_Def_ql_ub__573_CM 1 100. 0. 255. DISPLAY_IDENTIFIER C_BATTNENN ECU_ADDRESS 0xc0000ad7 FORMAT "%4.1" /end MEASUREMENT
/begin MEASUREMENT Cbatt_lo "Nennkapazität Batterie, lokal" UBYTE _CNV_R_R_Def_ql_ub__573_CM 1 100. 1. 255. DISPLAY_IDENTIFIER CBATT_LO ECU_ADDRESS 0xc0007a48 FORMAT "%4.1" /end MEASUREMENT
/begin MEASUREMENT Codiercnt "Internet Zaehler fuer Anfrage Codierung" UBYTE _CNV_R_R_Def_td_ub__574_CM 1 100. 0. 25.5 DISPLAY_IDENTIFIER CODIERCNT ECU_ADDRESS 0xc0000ad8 FORMAT "%4.1" /end MEASUREMENT
/begin MEASUREMENT Ctrcbr "Steuerung_Stromzweige" UBYTE _CNV_R_R_Def_dez_sl_551_CM 1 100. 0. 255. DISPLAY_IDENTIFIER CTRCBR ECU_ADDRESS 0xc0000b71 FORMAT "%3.0" /end MEASUREMENT
/begin MEASUREMENT Ctrcbr7 "lokales ctrcbr" UBYTE _CNV_R_R_Def_dez_sl_551_CM 1 100. 0. 255. DISPLAY_IDENTIFIER CTRCBR7 ECU_ADDRESS 0xc0000b72 FORMAT "%3.0" /end MEASUREMENT
/begin MEASUREMENT Ctrcbrmem "altes ctrbr" UBYTE _CNV_R_R_Def_dez_sl_551_CM 1 100. 0. 255. DISPLAY_IDENTIFIER CTRCBRMEM ECU_ADDRESS 0xc0000b73 FORMAT "%3.0" /end MEASUREMENT
/begin MEASUREMENT Ctrpcos "Steuerung_Standverbraucher" UBYTE _CNV_R_R_Def_dez_sl_551_CM 1 100. 0. 3. DISPLAY_IDENTIFIER CTRPCOS ECU_ADDRESS 0xc0000b74 FORMAT "%3.0" /end MEASUREMENT
/begin MEASUREMENT Ctrpcos7 "lokales ctrpcos" UBYTE _CNV_R_R_Def_dez_sl_551_CM 1 100. 0. 3. DISPLAY_IDENTIFIER CTRPCOS7 ECU_ADDRESS 0xc000467c FORMAT "%3.0" /end MEASUREMENT
/begin MEASUREMENT Ctrpcosmem "altes ctrpcos" UBYTE _CNV_R_R_Def_dez_sl_551_CM 1 100. 0. 3. DISPLAY_IDENTIFIER CTRPCOSMEM ECU_ADDRESS 0xc0000b75 FORMAT "%3.0" /end MEASUREMENT
/begin MEASUREMENT Ctrprio "Steuerung_Spitzenreduzierung_Priorität" UBYTE _CNV_R_R_Def_dez_sl_551_CM 1 100. 0. 7. DISPLAY_IDENTIFIER CTRPRIO ECU_ADDRESS 0xc0000b76 FORMAT "%3.0" /end MEASUREMENT
/begin MEASUREMENT Ctrprio7 "lokales ctrprio" UBYTE _CNV_R_R_Def_dez_sl_551_CM 1 100. 0. 7. DISPLAY_IDENTIFIER CTRPRIO7 ECU_ADDRESS 0xc0000b77 FORMAT "%3.0" /end MEASUREMENT
/begin MEASUREMENT Ctrpriocf "Steuerung_Spitzenreduzierung_Priorität_Komfort" UBYTE _CNV_R_R_Def_dez_sl_551_CM 1 100. 0. 7. DISPLAY_IDENTIFIER CTRPRIOCF ECU_ADDRESS 0xc0000b78 FORMAT "%3.0" /end MEASUREMENT
/begin MEASUREMENT Ctrpriocf7 "lokales ctrpriocf" UBYTE _CNV_R_R_Def_dez_sl_551_CM 1 100. 0. 7. DISPLAY_IDENTIFIER CTRPRIOCF7 ECU_ADDRESS 0xc0000b79 FORMAT "%3.0" /end MEASUREMENT
/begin MEASUREMENT Ctrpriocfm "altes ctrpriocf" UBYTE _CNV_R_R_Def_dez_sl_551_CM 1 100. 0. 7. DISPLAY_IDENTIFIER CTRPRIOCFM ECU_ADDRESS 0xc0000b7a FORMAT "%3.0" /end MEASUREMENT
/begin MEASUREMENT Ctrpriomem "altes ctrprio" UBYTE _CNV_R_R_Def_dez_sl_551_CM 1 100. 0. 7. DISPLAY_IDENTIFIER CTRPRIOMEM ECU_ADDRESS 0xc0000b7b FORMAT "%3.0" /end MEASUREMENT
/begin MEASUREMENT Ctrpwrcf "Komfort-Teil von ctrpwrcos" UWORD _CNV_R_R_Def_dez_sl_551_CM 1 100. 0. 65535. DISPLAY_IDENTIFIER CTRPWRCF ECU_ADDRESS 0xc0000b40 FORMAT "%5.0" /end MEASUREMENT
/begin MEASUREMENT Ctrpwrcos "Steuerung_Leistung_Verbraucher" UWORD _CNV_R_R_Def_dez_sl_551_CM 1 100. 0. 65535. DISPLAY_IDENTIFIER CTRPWRCOS ECU_ADDRESS 0xc0000b42 FORMAT "%5.0" /end MEASUREMENT
/begin MEASUREMENT Ctrpwrcos7 "lokales ctrpwrcos" UWORD _CNV_R_R_Def_dez_sl_551_CM 1 100. 0. 65535. DISPLAY_IDENTIFIER CTRPWRCOS7 ECU_ADDRESS 0xc0000b44 FORMAT "%5.0" /end MEASUREMENT
/begin MEASUREMENT Ctrpwrdf "df-Teil von ctrpwrcos" UWORD _CNV_R_R_Def_dez_sl_551_CM 1 100. 0. 65535. DISPLAY_IDENTIFIER CTRPWRDF ECU_ADDRESS 0xc0000b46 FORMAT "%5.0" /end MEASUREMENT
/begin MEASUREMENT Ctrpwrmem "altes ctrpwrcos" UWORD _CNV_R_R_Def_dez_sl_551_CM 1 100. 0. 65535. DISPLAY_IDENTIFIER CTRPWRMEM ECU_ADDRESS 0xc0000b48 FORMAT "%5.0" /end MEASUREMENT
/begin MEASUREMENT Ctrpwspcos "Steuerung_Leistung_Sonderverbraucher" UBYTE _CNV_R_R_Def_f_ub_b_575_CM 1 100. 0. 127.5 DISPLAY_IDENTIFIER CTRPWSPCOS ECU_ADDRESS 0xc0000b7c FORMAT "%5.2" /end MEASUREMENT
/begin MEASUREMENT D_qelad "Delta Kapazität entladen" UWORD _CNV_R_R_Def_ql_uw__577_CM 1 100. 0. 1193.0282 DISPLAY_IDENTIFIER D_QELAD ECU_ADDRESS 0xc0007a3e FORMAT "%8.3" /end MEASUREMENT
/begin MEASUREMENT D_qlad "Delta Kapazität geladen" UWORD _CNV_R_R_Def_ql_uw__577_CM 1 100. 0. 1193.0282 DISPLAY_IDENTIFIER D_QLAD ECU_ADDRESS 0xc0007a40 FORMAT "%8.3" /end MEASUREMENT
/begin MEASUREMENT D_soc "Abstand zur Startfähigkeitsgrenze" SWORD _CNV_R_R_Def_f_sw_b_570_CM 1 100. -100. 99.9969 DISPLAY_IDENTIFIER D_SOC ECU_ADDRESS 0xc0004696 FORMAT "%8.3" /end MEASUREMENT
/begin MEASUREMENT D_socw "Delta SoC" SWORD _CNV_R_R_Def_f_sw_b_570_CM 1 100. -100. 99.9969 DISPLAY_IDENTIFIER D_SOCW ECU_ADDRESS 0xc0007a56 FORMAT "%8.3" /end MEASUREMENT
/begin MEASUREMENT D_ubatt_bt "Integrationszähler erhöhte Spannung über Mittelwert" SWORD _CNV_R_R_Def_u_sw_q_580_CM 1 100. -160. 159.9951 DISPLAY_IDENTIFIER D_UBATT_BT ECU_ADDRESS 0xc0000c52 FORMAT "%8.3" /end MEASUREMENT
/begin MEASUREMENT D_udtptc "Spannungsdifferenz in 10ms" SBYTE _CNV_R_R_Def_u_sb_q_583_CM 1 100. -12.0576 11.9634 DISPLAY_IDENTIFIER D_UDTPTC ECU_ADDRESS 0xc0000b70 FORMAT "%7.4" /end MEASUREMENT
/begin MEASUREMENT Df2pi "DF-Gewichtung auf Prios" SWORD _CNV_R_R_Def_f_sw_p_557_CM 1 100. -100. 100. DISPLAY_IDENTIFIER DF2PI ECU_ADDRESS 0xc0000b1a FORMAT "%7.2" /end MEASUREMENT
/begin MEASUREMENT Dfall2pi "Gesamtgewichtung auf Prios" SWORD _CNV_R_R_Def_f_sw_p_557_CM 1 100. -500. 500. DISPLAY_IDENTIFIER DFALL2PI ECU_ADDRESS 0xc0000b1c FORMAT "%7.2" /end MEASUREMENT
/begin MEASUREMENT Dfallpi "PI-Geregelte Gesamtgewichtung auf Prios" UWORD _CNV_R_R_Def_f_sw_p_557_CM 1 100. 0. 450. DISPLAY_IDENTIFIER DFALLPI ECU_ADDRESS 0xc0000b4a FORMAT "%8.3" /end MEASUREMENT
/begin MEASUREMENT Dff_filt7 "lokales dffgenflit" UBYTE _CNV_R_R_Def_f_ub_b_586_CM 1 100. 0. 99.60930000000001 DISPLAY_IDENTIFIER DFF_FILT7 ECU_ADDRESS 0xc0000b7d FORMAT "%5.2" /end MEASUREMENT
/begin MEASUREMENT Dfgenfilt "Über PT-1 gefiltertes dffgen-Signal" UBYTE _CNV_R_R_Def_f_ub_b_586_CM 1 100. 0. 99.60930000000001 DISPLAY_IDENTIFIER DFGENFILT ECU_ADDRESS 0xc0000b7e FORMAT "%5.2" /end MEASUREMENT
/begin MEASUREMENT Dfpi2ptc "Gewichtung der Prios -> Gewichtung für PTC Ansteuerung" SWORD _CNV_R_R_Def_f_sw_p_557_CM 1 100. -100. 100. DISPLAY_IDENTIFIER DFPI2PTC ECU_ADDRESS 0xc0000b1e FORMAT "%7.2" /end MEASUREMENT
/begin MEASUREMENT Dfprio "Kein Langbezeichner vergeben" UWORD _CNV_R_R_Def_f_sw_p_557_CM 1 100. 0. 450. DISPLAY_IDENTIFIER DFPRIO ECU_ADDRESS 0xc0000b4c FORMAT "%8.3" /end MEASUREMENT
/begin MEASUREMENT Dfpt1_2ptc "gefiltertes dffgen Gewichtung auf PTC-Ansteuerung" SWORD _CNV_R_R_Def_f_sw_p_557_CM 1 100. -100. 100. DISPLAY_IDENTIFIER DFPT1_2PTC ECU_ADDRESS 0xc0000b20 FORMAT "%7.2" /end MEASUREMENT
/begin MEASUREMENT Dfpt1filt "Wert nach DF-Tiefpass Prio" UBYTE _CNV_R_R_Def_f_ub_b_586_CM 1 100. 0. 99.60930000000001 DISPLAY_IDENTIFIER DFPT1FILT ECU_ADDRESS 0xc0000b7f FORMAT "%5.2" /end MEASUREMENT
/begin MEASUREMENT Dfpt1ptc "Wert nach DFFGEN-Filter PTC" UBYTE _CNV_R_R_Def_f_ub_b_586_CM 1 100. 0. 99.60930000000001 DISPLAY_IDENTIFIER DFPT1PTC ECU_ADDRESS 0xc0000b80 FORMAT "%5.2" /end MEASUREMENT
/begin MEASUREMENT Dif_stfgk1u2 "Kein Langbezeichner vergeben" UWORD _CNV_R_R_Def_f_uw_b_555_CM 1 100. 0. 99.9984 DISPLAY_IDENTIFIER DIF_STFGK1U2 ECU_ADDRESS 0xc0000b4e FORMAT "%8.3" /end MEASUREMENT
/begin MEASUREMENT Dod_start "DoD bei Start der Regeneration" UBYTE _CNV_R_R_Def_f_ub_b_586_CM 1 100. 0. 99.60930000000001 DISPLAY_IDENTIFIER DOD_START ECU_ADDRESS 0xc000474e FORMAT "%5.2" /end MEASUREMENT
/begin MEASUREMENT Dqe_regstart "Entladene Ladungsmenge seit Regenerationsstart" UWORD _CNV_R_R_Def_ql_uw__577_CM 1 100. 0. 1192.7502 DISPLAY_IDENTIFIER DQE_REGSTART ECU_ADDRESS 0xc0004742 FORMAT "%8.3" /end MEASUREMENT
/begin MEASUREMENT Dqelad7 "diff = qelad-qeladold7" UWORD _CNV_R_R_Def_ql_uw__597_CM 1 100. 0. 19088.4522 DISPLAY_IDENTIFIER DQELAD7 ECU_ADDRESS 0xc0000abc FORMAT "%7.2" /end MEASUREMENT
/begin MEASUREMENT Dql_regstart "Geladene Ladungsmenge seit Regenerationsstart" UWORD _CNV_R_R_Def_ql_uw__597_CM 1 100. 0. 19087.864 DISPLAY_IDENTIFIER DQL_REGSTART ECU_ADDRESS 0xc0004744 FORMAT "%7.2" /end MEASUREMENT
/begin MEASUREMENT Dqlad7 "diff = qlad-qladold7" UWORD _CNV_R_R_Def_ql_uw__597_CM 1 100. 0. 19088.4522 DISPLAY_IDENTIFIER DQLAD7 ECU_ADDRESS 0xc0000abe FORMAT "%7.2" /end MEASUREMENT
/begin MEASUREMENT Dsoc2pi "Batterieladezustand-Gewichtung auf Prios" SWORD _CNV_R_R_Def_f_sw_p_557_CM 1 100. -150. 150. DISPLAY_IDENTIFIER DSOC2PI ECU_ADDRESS 0xc0000b22 FORMAT "%7.2" /end MEASUREMENT
/begin MEASUREMENT Dsoc2ptc "dsoc Gewichtung auf PTC-Ansteuerung" SWORD _CNV_R_R_Def_f_sw_p_557_CM 1 100. -150. 150. DISPLAY_IDENTIFIER DSOC2PTC ECU_ADDRESS 0xc0000b24 FORMAT "%7.2" /end MEASUREMENT
/begin MEASUREMENT Dudtmul "PTC dudt : gewichtetes Dudt" SWORD _CNV_R_R_Def_f_sw_q_602_CM 1 100. -48.2304 48.2289 DISPLAY_IDENTIFIER DUDTMUL ECU_ADDRESS 0xc0000b26 FORMAT "%9.4" /end MEASUREMENT
/begin MEASUREMENT Entladezeit "Entladezeit" UBYTE _CNV_R_R_Def_td_ub__574_CM 1 100. 0. 25.5 DISPLAY_IDENTIFIER ENTLADEZEIT ECU_ADDRESS 0xc0000c90 FORMAT "%4.1" /end MEASUREMENT
/begin MEASUREMENT F_dudtptc "Inkrement auf Ptc_pwr aufgrund du/dt" UWORD _CNV_R_R_Def_f_sw_p_557_CM 1 100. 0. 550. DISPLAY_IDENTIFIER F_DUDTPTC ECU_ADDRESS 0xc0000b50 FORMAT "%8.3" /end MEASUREMENT
/begin MEASUREMENT Fs_pm "Fehlerspeicher Powermanagement, Bitcodiert" UBYTE _CNV_R_R_Def_dez_sl_551_CM 1 100. 0. 255. DISPLAY_IDENTIFIER FS_PM ECU_ADDRESS 0xc0004654 FORMAT "%3.0" /end MEASUREMENT
/begin MEASUREMENT I_qcnt "Zwischenvar Strom für Ermittlung der mit erhöhter Spannung eingeladenen Ladungsmenge" UWORD _CNV_R_R_Def_i_uw_q_639_CM 1 100. 0. 5242.8 DISPLAY_IDENTIFIER I_QCNT ECU_ADDRESS 0xc0000ca4 FORMAT "%8.3" /end MEASUREMENT
/begin MEASUREMENT Ib_commcnt "Zähler Taskaufrufe zwischen periodischer Abfrage qlad und qelad" UBYTE _CNV_R_R_Def_dez_sl_551_CM 1 100. 0. 255. DISPLAY_IDENTIFIER IB_COMMCNT ECU_ADDRESS 0xc0007a49 FORMAT "%3.0" /end MEASUREMENT
/begin MEASUREMENT Ib_commsta "Statemaschine zeiger zur Abfrage qlad und qelad" UBYTE _CNV_R_R_Def_dez_sl_551_CM 1 100. 0. 255. DISPLAY_IDENTIFIER IB_COMMSTA ECU_ADDRESS 0xc0007a4a FORMAT "%3.0" /end MEASUREMENT
/begin MEASUREMENT Ibsbor_hb "highbyte ibsborctr" UBYTE _CNV_R_R_Def_dez_sl_551_CM 1 100. 0. 255. DISPLAY_IDENTIFIER IBSBOR_HB ECU_ADDRESS 0xc0000ad9 FORMAT "%3.0" /end MEASUREMENT
/begin MEASUREMENT Ibtdiff "Delta Ibtsoll-Ibatt" UWORD _CNV_R_R_Def_i_uw_q_634_CM 1 100. -200. 5042.8 DISPLAY_IDENTIFIER IBTDIFF ECU_ADDRESS 0xc0000b52 FORMAT "%8.3" /end MEASUREMENT
/begin MEASUREMENT Ibtdiff2pi "Batterie-soll-strom Gewichtung auf Prios" SWORD _CNV_R_R_Def_f_sw_p_557_CM 1 100. -100. 100. DISPLAY_IDENTIFIER IBTDIFF2PI ECU_ADDRESS 0xc0000b28 FORMAT "%7.2" /end MEASUREMENT
/begin MEASUREMENT Ibtsoll "Sollstrom aufgrund von tbatt und dsoc" UWORD _CNV_R_R_Def_i_uw_q_634_CM 1 100. -200. 5042.8 DISPLAY_IDENTIFIER IBTSOLL ECU_ADDRESS 0xc0000b54 FORMAT "%8.3" /end MEASUREMENT
/begin MEASUREMENT Ideltaabs "Differenz der Startströme" UWORD _CNV_R_R_Def_i_uw_q_642_CM 1 100. 2.e-002 1310.7 DISPLAY_IDENTIFIER IDELTAABS ECU_ADDRESS 0xc0000b96 FORMAT "%8.3" /end MEASUREMENT
/begin MEASUREMENT Idiff2ptc "idiff Gewichtung auf die PTC-Ansteuerung" SWORD _CNV_R_R_Def_f_sw_p_557_CM 1 100. -100. 100. DISPLAY_IDENTIFIER IDIFF2PTC ECU_ADDRESS 0xc0000b2a FORMAT "%7.2" /end MEASUREMENT
/begin MEASUREMENT Igenrest "Generatorreststrom modelliert" UBYTE _CNV_R_R_Def_ql_ub__573_CM 1 100. 0. 255. DISPLAY_IDENTIFIER IGENREST ECU_ADDRESS 0xc0000b81 /end MEASUREMENT
/begin MEASUREMENT Ikurz_ogrz "Obere Grenze Kurzschlußstrom" UBYTE _CNV_R_R_Def_i_ub_q_644_CM 1 100. 0. 2550. DISPLAY_IDENTIFIER IKURZ_OGRZ ECU_ADDRESS 0xc0000ada FORMAT "%5.2" /end MEASUREMENT
/begin MEASUREMENT Ikurz_ugrz "Untere Grenze Kurzschlußstrom" UBYTE _CNV_R_R_Def_i_ub_q_644_CM 1 100. 0. 2550. DISPLAY_IDENTIFIER IKURZ_UGRZ ECU_ADDRESS 0xc0000adb FORMAT "%5.2" /end MEASUREMENT
/begin MEASUREMENT Ipmdfprio "lokale Prioberechnungsvariable bei IPM aktiv" UWORD _CNV_R_R_Def_f_sw_p_557_CM 1 100. 0. 450. DISPLAY_IDENTIFIER IPMDFPRIO ECU_ADDRESS 0xc0000b56 FORMAT "%8.3" /end MEASUREMENT
/begin MEASUREMENT Isoc0loc "Batteriestrom zum Zeitpunkt der Ruhespannungsmessung (lokal)" SWORD _CNV_R_R_Def_i_sw_q_640_CM 1 100. -655.36 655.34 DISPLAY_IDENTIFIER ISOC0LOC ECU_ADDRESS 0xc0007a38 FORMAT "%8.3" /end MEASUREMENT
/begin MEASUREMENT Isolldiff "Differenz isoll - ibatt_w für PTC Ansteuerung" UWORD _CNV_R_R_Def_i_uw_q_634_CM 1 100. -200. 5042.8 DISPLAY_IDENTIFIER ISOLLDIFF ECU_ADDRESS 0xc0000b58 FORMAT "%8.3" /end MEASUREMENT
/begin MEASUREMENT Iwakeupgrz "Ruhestromverletzungsgrenze, ab hier weckt u.U. das IBS." UBYTE _CNV_R_R_Def_i_ub_q_608_CM 1 100. 0. 0.255 DISPLAY_IDENTIFIER IWAKEUPGRZ ECU_ADDRESS 0xc0000adc /end MEASUREMENT
/begin MEASUREMENT Kalevcnt "Anzahl der Ruhespannungsmessungen" UBYTE _CNV_R_R_Def_dez_sl_551_CM 1 100. 0. 255. DISPLAY_IDENTIFIER KALEVCNT ECU_ADDRESS 0xc0007a4b FORMAT "%3.0" /end MEASUREMENT
/begin MEASUREMENT Kapa_verlust "Zwsichenvariable Kapazitätsverlust" UBYTE _CNV_R_R_Def_f_ub_b_586_CM 1 100. 0. 99.60930000000001 DISPLAY_IDENTIFIER KAPA_VERLUST ECU_ADDRESS 0xc0000c75 FORMAT "%5.2" /end MEASUREMENT
/begin MEASUREMENT Ladezeit "Ladezeit" UWORD _CNV_R_R_Def_td_ub__574_CM 1 100. 0. 6553.5 DISPLAY_IDENTIFIER LADEZEIT ECU_ADDRESS 0xc0000c8e FORMAT "%6.1" /end MEASUREMENT
/begin MEASUREMENT Memprio1 "memory 1 PI-Regler dfall2pi E60Prio" UWORD _CNV_R_R_Def_f_uw_b_626_CM 1 100. 0. 511.9921 DISPLAY_IDENTIFIER MEMPRIO1 ECU_ADDRESS 0xc0000b5a FORMAT "%8.3" /end MEASUREMENT
/begin MEASUREMENT Memprio2 "memory 2 PI-Regler dfall2pi E60Prio" UWORD _CNV_R_R_Def_f_uw_b_626_CM 1 100. 0. 511.9921 DISPLAY_IDENTIFIER MEMPRIO2 ECU_ADDRESS 0xc0000b5c FORMAT "%8.3" /end MEASUREMENT
/begin MEASUREMENT Memptc1 "memory 1 PI-Regler all2ptc PTC" UWORD _CNV_R_R_Def_f_uw_b_626_CM 1 100. 0. 511.9921 DISPLAY_IDENTIFIER MEMPTC1 ECU_ADDRESS 0xc0000b5e FORMAT "%8.3" /end MEASUREMENT
/begin MEASUREMENT Memptc2 "memory 2 PI-Regler all2ptc PTC" UWORD _CNV_R_R_Def_f_uw_b_626_CM 1 100. 0. 511.9921 DISPLAY_IDENTIFIER MEMPTC2 ECU_ADDRESS 0xc0000b60 FORMAT "%8.3" /end MEASUREMENT
/begin MEASUREMENT N_idlibs "Leerlaufdrehzahlvorgabe von LC-Powermanagement" UBYTE _CNV_R_R_Def_dez_sl_551_CM 1 100. 0. 255. DISPLAY_IDENTIFIER N_IDLIBS ECU_ADDRESS 0xc0007a20 FORMAT "%3.0" /end MEASUREMENT
/begin MEASUREMENT Nnmstart "Motordrehzahl nach Motorstart" SWORD _CNV_R_R_Def_n_sw_q_595_CM 1 100. -32768. 32767. DISPLAY_IDENTIFIER NNMSTART ECU_ADDRESS 0xd000d8aa FORMAT "%5.0" /end MEASUREMENT
/begin MEASUREMENT Ospgcnt "fs_Oberspannungscounter" UBYTE _CNV_R_R_Def_td_ub__574_CM 1 100. 0. 25.5 DISPLAY_IDENTIFIER OSPGCNT ECU_ADDRESS 0xc0000add FORMAT "%4.1" /end MEASUREMENT
/begin MEASUREMENT Ospgprell "Anzahl der entprellten FS_Oberspannungserkennung" UBYTE _CNV_R_R_Def_dez_sl_551_CM 1 100. 0. 255. DISPLAY_IDENTIFIER OSPGPRELL ECU_ADDRESS 0xc0000ade FORMAT "%3.0" /end MEASUREMENT
/begin MEASUREMENT Ospgstat "Status Oberspannungserkennung" UBYTE _CNV_R_R_Def_dez_sl_551_CM 1 100. 0. 255. DISPLAY_IDENTIFIER OSPGSTAT ECU_ADDRESS 0xc0000adf FORMAT "%3.0" /end MEASUREMENT
/begin MEASUREMENT Pgen2ptc "Gewichtung der Generatorrestleistung für PTC-Ansteuerung" SWORD _CNV_R_R_Def_f_sw_p_557_CM 1 100. -100. 100. DISPLAY_IDENTIFIER PGEN2PTC ECU_ADDRESS 0xc0000b2c FORMAT "%7.2" /end MEASUREMENT
/begin MEASUREMENT Pgenrest "Generatorrestleistung (igenrest*ubatt_w)" UWORD _CNV_R_R_Def_f_sw_p_557_CM 1 100. 0. 6400. DISPLAY_IDENTIFIER PGENREST ECU_ADDRESS 0xc0000b62 FORMAT "%8.3" /end MEASUREMENT
/begin MEASUREMENT Picntr "Counter fuer PI-Reset" UBYTE _CNV_R_R_Def_td_ub__574_CM 1 100. 0. 25.5 DISPLAY_IDENTIFIER PICNTR ECU_ADDRESS 0xc0000b82 FORMAT "%4.1" /end MEASUREMENT
/begin MEASUREMENT Pm_klemmstat "Umweltbed. Klemmenstatus" UBYTE _CNV_R_R_Def_dez_sl_551_CM 1 100. 0. 255. DISPLAY_IDENTIFIER PM_KLEMMSTAT ECU_ADDRESS 0xc0000ae0 FORMAT "%3.0" /end MEASUREMENT
/begin MEASUREMENT Pm_tsrdy "Status Berechnung Tsaison" UBYTE _CNV_R_R_Def_dez_sl_551_CM 1 100. 0. 1. DISPLAY_IDENTIFIER PM_TSRDY ECU_ADDRESS 0xc00046a2 FORMAT "%3.0" /end MEASUREMENT
/begin MEASUREMENT Pmbackup "Array zum ständigen Sichern (alle 5 Sek) der Werte für die Individualdatenrettung beim Speichern" UBYTE _CNV_R_R_Def_dez_sl_551_CM 1 100. 0. 255. DISPLAY_IDENTIFIER PMBACKUP ECU_ADDRESS 0xc0000ae2 FORMAT "%3.0" ARRAY_SIZE 7 MATRIX_DIM 7 1 1 /end MEASUREMENT
/begin MEASUREMENT Pmbscount "zyklisches Senden entspricht 5 sek" UBYTE _CNV_R_R_Def_dez_sl_551_CM 1 100. 0. 255. DISPLAY_IDENTIFIER PMBSCOUNT ECU_ADDRESS 0xc0000b83 FORMAT "%3.0" /end MEASUREMENT
/begin MEASUREMENT Pminfo1 "Infospeicher 1 vom Powermanagement" UWORD _CNV_R_R_Def_dez_sl_551_CM 1 100. 0. 65535. DISPLAY_IDENTIFIER PMINFO1 ECU_ADDRESS 0xc0004604 FORMAT "%5.0" ARRAY_SIZE 37 MATRIX_DIM 37 1 1 /end MEASUREMENT
/begin MEASUREMENT Pminfo2 "Fehlerinfo2 vom Powermanagement" UBYTE _CNV_R_R_Def_dez_sl_551_CM 1 100. 0. 255. DISPLAY_IDENTIFIER PMINFO2 ECU_ADDRESS 0xc0004658 FORMAT "%3.0" ARRAY_SIZE 29 MATRIX_DIM 29 1 1 /end MEASUREMENT
/begin MEASUREMENT Pmstartsta "Schalter für Ablaufsteuerung" UBYTE _CNV_R_R_Def_dez_sl_551_CM 1 100. 0. 255. DISPLAY_IDENTIFIER PMSTARTSTA ECU_ADDRESS 0xc0000b9c FORMAT "%3.0" /end MEASUREMENT
/begin MEASUREMENT Pmvscount "Zähler bis zum nächsten zyklischen Senden von 3b3" UBYTE _CNV_R_R_Def_dez_sl_551_CM 1 100. 0. 255. DISPLAY_IDENTIFIER PMVSCOUNT ECU_ADDRESS 0xc0000b84 FORMAT "%3.0" /end MEASUREMENT
/begin MEASUREMENT Pr_batt_mx "Prio von Batterie MaxSpg" UBYTE _CNV_R_R_Def_dez_sl_551_CM 1 100. 0. 255. DISPLAY_IDENTIFIER PR_BATT_MX ECU_ADDRESS 0xc0000c76 FORMAT "%3.0" /end MEASUREMENT
/begin MEASUREMENT Pr_batt_soll "Prio von Batterie Sollspg" UBYTE _CNV_R_R_Def_dez_sl_551_CM 1 100. 0. 255. DISPLAY_IDENTIFIER PR_BATT_SOLL ECU_ADDRESS 0xc0000c77 FORMAT "%3.0" /end MEASUREMENT
/begin MEASUREMENT Pr_dynbatt_mn "Prio von Batterieminspg dyn" UBYTE _CNV_R_R_Def_dez_sl_551_CM 1 100. 0. 255. DISPLAY_IDENTIFIER PR_DYNBATT_MN ECU_ADDRESS 0xc0000c78 FORMAT "%3.0" /end MEASUREMENT
/begin MEASUREMENT Pr_stabatt_mn "Prio von Batterieminspg stat" UBYTE _CNV_R_R_Def_dez_sl_551_CM 1 100. 0. 255. DISPLAY_IDENTIFIER PR_STABATT_MN ECU_ADDRESS 0xc0000c79 FORMAT "%3.0" /end MEASUREMENT
/begin MEASUREMENT Priopizw1 "Pi-Regler zw1" SLONG _CNV_R_R_Def_f_sl_q_582_CM 1 100. -512. 512. DISPLAY_IDENTIFIER PRIOPIZW1 ECU_ADDRESS 0xc0000b08 FORMAT "%10.3" /end MEASUREMENT
/begin MEASUREMENT Priopizw2 "Pi-Regler zw2" SLONG _CNV_R_R_Def_f_sl_q_582_CM 1 100. -512. 512. DISPLAY_IDENTIFIER PRIOPIZW2 ECU_ADDRESS 0xc0000b0c FORMAT "%10.3" /end MEASUREMENT
/begin MEASUREMENT Ptc_pwr "Maximale Leistung, die der PTC einstellen darf." UBYTE _CNV_R_R_Def_f_ub_b_575_CM 1 100. 0. 127.5 DISPLAY_IDENTIFIER PTC_PWR ECU_ADDRESS 0xc0000b85 FORMAT "%5.2" /end MEASUREMENT
/begin MEASUREMENT Ptc_pwr7 "lokales ptc_pwr" UBYTE _CNV_R_R_Def_f_ub_b_575_CM 1 100. 0. 127.5 DISPLAY_IDENTIFIER PTC_PWR7 ECU_ADDRESS 0xc0000b86 FORMAT "%5.2" /end MEASUREMENT
/begin MEASUREMENT Ptcadd "Wg. Spgeinbruch zu addierender PTC Faktor" UWORD _CNV_R_R_Def_f_sw_p_557_CM 1 100. 0. 550. DISPLAY_IDENTIFIER PTCADD ECU_ADDRESS 0xc0000b64 FORMAT "%8.3" /end MEASUREMENT
/begin MEASUREMENT Ptcpizw1 "PTC PI Regler zw1" SLONG _CNV_R_R_Def_f_sl_q_582_CM 1 100. -512. 512. DISPLAY_IDENTIFIER PTCPIZW1 ECU_ADDRESS 0xc0000b10 FORMAT "%10.3" /end MEASUREMENT
/begin MEASUREMENT Ptcpizw2 "PTC PI zw2" SLONG _CNV_R_R_Def_f_sl_q_582_CM 1 100. -512. 512. DISPLAY_IDENTIFIER PTCPIZW2 ECU_ADDRESS 0xc0000b14 FORMAT "%10.3" /end MEASUREMENT
/begin MEASUREMENT Pwrspmem "altes ctrpwspcos" UBYTE _CNV_R_R_Def_f_ub_b_575_CM 1 100. 0. 127.5 DISPLAY_IDENTIFIER PWRSPMEM ECU_ADDRESS 0xc0000b87 FORMAT "%5.2" /end MEASUREMENT
/begin MEASUREMENT QV2Abschk "" SWORD _CNV_R_R_Def_f_sw_q_550_CM 1 100. -39.9993 39.9993 DISPLAY_IDENTIFIER QV2ABSCHK ECU_ADDRESS 0xc0007a58 FORMAT "%8.3" /end MEASUREMENT
/begin MEASUREMENT Q_bila "Kapazität Batterie (long)" ULONG _CNV_R_R_Def_ql_ul__684_CM 1 100. 0. 1193.0464 DISPLAY_IDENTIFIER Q_BILA ECU_ADDRESS 0xc0004682 FORMAT "%11.4" /end MEASUREMENT
/begin MEASUREMENT Q_k20lastreg "Differenz K20Varta seit letzter Erfüllung Regeneration" UBYTE _CNV_R_R_Def_dez_ub_685_CM 1 100. 0. 127.5 DISPLAY_IDENTIFIER Q_K20LASTREG ECU_ADDRESS 0xc000474f /end MEASUREMENT
/begin MEASUREMENT Q_regelad "Zwischenvar für Ermittlung Delta der Ladungsmenge bei passiver Regeneration" UWORD _CNV_R_R_Def_ql_uw__577_CM 1 100. 0. 1192.7502 DISPLAY_IDENTIFIER Q_REGELAD ECU_ADDRESS 0xc0007af4 FORMAT "%8.3" /end MEASUREMENT
/begin MEASUREMENT Q_regend "Durchgesetzte Ladung beim Ende der letzten Regeneration" UWORD _CNV_R_R_Def_ql_uw__597_CM 1 100. 0. 19087.864 DISPLAY_IDENTIFIER Q_REGEND ECU_ADDRESS 0xc0004746 FORMAT "%7.2" /end MEASUREMENT
/begin MEASUREMENT Q_regerh "Mit erhöhter Spannung eingeladene Ladungsmenge" UBYTE _CNV_R_R_Def_u_ub_q_631_CM 1 100. 0. 25.5 DISPLAY_IDENTIFIER Q_REGERH ECU_ADDRESS 0xc0004750 FORMAT "%5.2" /end MEASUREMENT
/begin MEASUREMENT Q_regerhbeg "Qlad bei beginn erhöhter Ladespannung" UWORD _CNV_R_R_Def_ql_uw__577_CM 1 100. 0. 1192.7502 DISPLAY_IDENTIFIER Q_REGERHBEG ECU_ADDRESS 0xc0007af6 FORMAT "%8.3" /end MEASUREMENT
/begin MEASUREMENT Q_reglad "Zwischenvar für Ermittlung Delta der Ladungsmenge bei passiver Regeneration" UWORD _CNV_R_R_Def_ql_uw__577_CM 1 100. 0. 1192.7502 DISPLAY_IDENTIFIER Q_REGLAD ECU_ADDRESS 0xc0007af8 FORMAT "%8.3" /end MEASUREMENT
/begin MEASUREMENT Q_startfgk "Abstand zur Startfähigkeitsgrenze" UWORD _CNV_R_R_Def_ql_uw__577_CM 1 100. 0. 1193.0282 DISPLAY_IDENTIFIER Q_STARTFGK ECU_ADDRESS 0xc000467a FORMAT "%8.3" /end MEASUREMENT
/begin MEASUREMENT Q_zrreguh "Zähler Regeneration mit erhöhter Ladespannung" UWORD _CNV_R_R_Def_i_uw_q_639_CM 1 100. 0. 5242.8 DISPLAY_IDENTIFIER Q_ZRREGUH ECU_ADDRESS 0xc0000ca6 FORMAT "%8.3" /end MEASUREMENT
/begin MEASUREMENT Qe_fahr "Entladene Ladungsmenge während Fahrt und SOC hoch" UWORD _CNV_R_R_Def_ql_uw__577_CM 1 100. 0. 1192.7502 DISPLAY_IDENTIFIER QE_FAHR ECU_ADDRESS 0xc0004748 FORMAT "%8.3" /end MEASUREMENT
/begin MEASUREMENT Qeladold "Kapazität Entladen vor Abstellen" UWORD _CNV_R_R_Def_ql_uw__577_CM 1 100. 0. 1193.0282 DISPLAY_IDENTIFIER QELADOLD ECU_ADDRESS 0xc0004686 FORMAT "%8.3" /end MEASUREMENT
/begin MEASUREMENT Qeladold7 "zuletzt gesp. qelad" UWORD _CNV_R_R_Def_ql_uw__577_CM 1 100. 0. 1193.0282 DISPLAY_IDENTIFIER QELADOLD7 ECU_ADDRESS 0xc000464e FORMAT "%8.3" /end MEASUREMENT
/begin MEASUREMENT Ql_fahr "Geladene Ladungsmenge während Fahrt und SOC hoch" UWORD _CNV_R_R_Def_ql_uw__577_CM 1 100. 0. 1192.7502 DISPLAY_IDENTIFIER QL_FAHR ECU_ADDRESS 0xc000474a FORMAT "%8.3" /end MEASUREMENT
/begin MEASUREMENT Qladold "Kapazität Getladen vor Abstellen" UWORD _CNV_R_R_Def_ql_uw__577_CM 1 100. 0. 1193.0282 DISPLAY_IDENTIFIER QLADOLD ECU_ADDRESS 0xc0004688 FORMAT "%8.3" /end MEASUREMENT
/begin MEASUREMENT Qladold7 "zuletzt gesp. qlad" UWORD _CNV_R_R_Def_ql_uw__577_CM 1 100. 0. 1193.0282 DISPLAY_IDENTIFIER QLADOLD7 ECU_ADDRESS 0xc0004650 FORMAT "%8.3" /end MEASUREMENT
/begin MEASUREMENT Qladzwsp7 "qlad uebertragspeicher" UWORD _CNV_R_R_Def_dez_sl_551_CM 1 100. 0. 65535. DISPLAY_IDENTIFIER QLADZWSP7 ECU_ADDRESS 0xc0000ac0 FORMAT "%5.0" /end MEASUREMENT
/begin MEASUREMENT Qvcbackup1 "Wert aus QVC Modul welcher beim Flashen gebackupt wird" UBYTE _CNV_R_R_Def_dez_sl_551_CM 1 100. 0. 255. DISPLAY_IDENTIFIER QVCBACKUP1 ECU_ADDRESS 0xc0000ae9 FORMAT "%3.0" /end MEASUREMENT
/begin MEASUREMENT Qvcbackup2 "Wert aus QVC Modul welcher beim Flashen gebackupt wird" UBYTE _CNV_R_R_Def_dez_sl_551_CM 1 100. 0. 255. DISPLAY_IDENTIFIER QVCBACKUP2 ECU_ADDRESS 0xc0000aea FORMAT "%3.0" /end MEASUREMENT
/begin MEASUREMENT Qvcbackup3 "Wert aus QVC Modul welcher beim Flashen gebackupt wird" UBYTE _CNV_R_R_Def_dez_sl_551_CM 1 100. 0. 255. DISPLAY_IDENTIFIER QVCBACKUP3 ECU_ADDRESS 0xc0000aeb FORMAT "%3.0" /end MEASUREMENT
/begin MEASUREMENT Rest_k20 "Restkapazität in Ah" UBYTE _CNV_R_R_Def_dez_ub_685_CM 1 100. 0. 127.5 DISPLAY_IDENTIFIER REST_K20 ECU_ADDRESS 0xc0007af2 /end MEASUREMENT
/begin MEASUREMENT Rin_grenzh "Batt.Innenwiderstand Grenze" UBYTE _CNV_R_R_Def_f_ub_b_612_CM 1 100. 0. 31.875 DISPLAY_IDENTIFIER RIN_GRENZH ECU_ADDRESS 0xc0000b9d FORMAT "%5.2" /end MEASUREMENT
/begin MEASUREMENT Rin_start "Innenwiderstand Batterie beim Start" UBYTE _CNV_R_R_Def_f_ub_b_612_CM 1 100. 0. 31.875 DISPLAY_IDENTIFIER RIN_START ECU_ADDRESS 0xc0000b9e FORMAT "%5.2" /end MEASUREMENT
/begin MEASUREMENT Rqpcos "Anforderung_Standverbraucher" UBYTE _CNV_R_R_Def_dez_sl_551_CM 1 100. 0. 3. DISPLAY_IDENTIFIER RQPCOS ECU_ADDRESS 0xc0000b88 FORMAT "%3.0" /end MEASUREMENT
/begin MEASUREMENT Rqpcos7 "lokales rqpcos" UBYTE _CNV_R_R_Def_dez_sl_551_CM 1 100. 0. 3. DISPLAY_IDENTIFIER RQPCOS7 ECU_ADDRESS 0xc0000b89 FORMAT "%3.0" /end MEASUREMENT
/begin MEASUREMENT Rqpcosmem "altes rqpcos" UBYTE _CNV_R_R_Def_dez_sl_551_CM 1 100. 0. 3. DISPLAY_IDENTIFIER RQPCOSMEM ECU_ADDRESS 0xc0000b8a FORMAT "%3.0" /end MEASUREMENT
/begin MEASUREMENT Selspcos "Auswahl_Sonderverbraucher" UBYTE _CNV_R_R_Def_dez_sl_551_CM 1 100. 0. 15. DISPLAY_IDENTIFIER SELSPCOS ECU_ADDRESS 0xc0000b8b FORMAT "%3.0" /end MEASUREMENT
/begin MEASUREMENT Selspcosme "altes selspcos" UBYTE _CNV_R_R_Def_dez_sl_551_CM 1 100. 0. 15. DISPLAY_IDENTIFIER SELSPCOSME ECU_ADDRESS 0xc0000b8c FORMAT "%3.0" /end MEASUREMENT
/begin MEASUREMENT Soc_b_loc "lokal soc_bila f. KFSOCLF" UWORD _CNV_R_R_Def_f_uw_b_555_CM 1 100. 0. 99.9984 DISPLAY_IDENTIFIER SOC_B_LOC ECU_ADDRESS 0xc000468a FORMAT "%8.3" /end MEASUREMENT
/begin MEASUREMENT Soc_b_loc1 "" ULONG _CNV_R_R_Def_f_ul_q_691_CM 1 100. 0. 110.0001 DISPLAY_IDENTIFIER SOC_B_LOC1 ECU_ADDRESS 0xc0007a30 FORMAT "%11.4" /end MEASUREMENT
/begin MEASUREMENT Soc_b_loc2 "" ULONG _CNV_R_R_Def_f_uw_b_571_CM 1 100. 0. 11000. DISPLAY_IDENTIFIER SOC_B_LOC2 ECU_ADDRESS 0xc0007a34 FORMAT "%11.4" /end MEASUREMENT
/begin MEASUREMENT Soc_bila "Ladezustand durch Bilanzierung und Ruhespannungsmessung ermittelt" UWORD _CNV_R_R_Def_f_uw_b_555_CM 1 100. 0. 99.9984 DISPLAY_IDENTIFIER SOC_BILA ECU_ADDRESS 0xc0007a42 FORMAT "%8.3" /end MEASUREMENT
/begin MEASUREMENT Soc_fit "SoC aus der Fitformel" UWORD _CNV_R_R_Def_f_uw_b_555_CM 1 100. 0. 99.9984 DISPLAY_IDENTIFIER SOC_FIT ECU_ADDRESS 0xc0004690 FORMAT "%8.3" /end MEASUREMENT
/begin MEASUREMENT Soc_fit_temp "" UWORD _CNV_R_R_Def_f_uw_b_555_CM 1 100. 0. 99.9984 DISPLAY_IDENTIFIER SOC_FIT_TEMP ECU_ADDRESS 0xc0007a4c FORMAT "%8.3" /end MEASUREMENT
/begin MEASUREMENT Soc_korr "Korrekturwert soc_bila" SWORD _CNV_R_R_Def_f_sw_b_570_CM 1 100. -100. 99.9969 DISPLAY_IDENTIFIER SOC_KORR ECU_ADDRESS 0xc0004698 FORMAT "%8.3" /end MEASUREMENT
/begin MEASUREMENT Soc_q_kor "Korrekturwert Genauigkeit Ladezustandsbestimmung" UWORD _CNV_R_R_Def_ql_uw__577_CM 1 100. 0. 1193.0282 DISPLAY_IDENTIFIER SOC_Q_KOR ECU_ADDRESS 0xc000469c FORMAT "%8.3" /end MEASUREMENT
/begin MEASUREMENT Soc_q_loc "lokaler Zähler Genauigkeit Ladeztustandsbestimmung" UWORD _CNV_R_R_Def_ql_uw__577_CM 1 100. 0. 1193.0282 DISPLAY_IDENTIFIER SOC_Q_LOC ECU_ADDRESS 0xc000468c FORMAT "%8.3" /end MEASUREMENT
/begin MEASUREMENT Soc_quali "Zähler Genauigkeit Ladeztustandsbestimmung" UWORD _CNV_R_R_Def_ql_uw__577_CM 1 100. 0. 1193.0282 DISPLAY_IDENTIFIER SOC_QUALI ECU_ADDRESS 0xc0007a44 FORMAT "%8.3" /end MEASUREMENT
/begin MEASUREMENT Soc_rel "Relativzähler für Ladezustand SoC" UWORD _CNV_R_R_Def_f_uw_b_555_CM 1 100. 0. 99.9984 DISPLAY_IDENTIFIER SOC_REL ECU_ADDRESS 0xc000469e FORMAT "%8.3" /end MEASUREMENT
/begin MEASUREMENT Soc_stfgk "Startfähigkeitsgrenze" UWORD _CNV_R_R_Def_f_uw_b_555_CM 1 100. 0. 99.9984 DISPLAY_IDENTIFIER SOC_STFGK ECU_ADDRESS 0xc00046a0 FORMAT "%8.3" /end MEASUREMENT
/begin MEASUREMENT Soc_stfgkw "SoC Startfähigkeit" UWORD _CNV_R_R_Def_f_uw_b_555_CM 1 100. 0. 99.9984 DISPLAY_IDENTIFIER SOC_STFGKW ECU_ADDRESS 0xc0007a5c FORMAT "%8.3" /end MEASUREMENT
/begin MEASUREMENT St_pmbattmng0 "Statuswort" UBYTE _CNV_R_R_Def_dez_sl_551_CM 1 100. 0. 255. DISPLAY_IDENTIFIER ST_PMBATTMNG0 ECU_ADDRESS 0xc0000c4c FORMAT "%3.0" /end MEASUREMENT
/begin MEASUREMENT St_pmbattmng0.B_batt_entl "Batterie entladen" UBYTE _CNV_S_2_Def_bit_ub_563_CM 1 100. 0. 1. DISPLAY_IDENTIFIER B_BATT_ENTL ECU_ADDRESS 0xc0000c4c BIT_MASK 0x1 /end MEASUREMENT
/begin MEASUREMENT St_pmbattmng0.B_bt_timer "Mittelspannung eingehalten" UBYTE _CNV_S_2_Def_bit_ub_563_CM 1 100. 0. 1. DISPLAY_IDENTIFIER B_BT_TIMER ECU_ADDRESS 0xc0000c4c BIT_MASK 0x2 /end MEASUREMENT
/begin MEASUREMENT St_pmbattmng0.B_btmaxfrei "Batteriespannungsmaximalwert freigegeben" UBYTE _CNV_S_2_Def_bit_ub_563_CM 1 100. 0. 1. DISPLAY_IDENTIFIER B_BTMAXFREI ECU_ADDRESS 0xc0000c4c BIT_MASK 0x80 /end MEASUREMENT
/begin MEASUREMENT St_pmbattmng0.B_btpau "Anforderung Pause der Anhebung auf Maximalspannung" UBYTE _CNV_S_2_Def_bit_ub_563_CM 1 100. 0. 1. DISPLAY_IDENTIFIER B_BTPAU ECU_ADDRESS 0xc0000c4c BIT_MASK 0x40 /end MEASUREMENT
/begin MEASUREMENT St_pmbattmng0.B_dly_tbi "Verzögerung" UBYTE _CNV_S_2_Def_bit_ub_563_CM 1 100. 0. 1. DISPLAY_IDENTIFIER B_DLY_TBI ECU_ADDRESS 0xc0000c4c BIT_MASK 0x20 /end MEASUREMENT
/begin MEASUREMENT St_pmbattmng0.B_ibsok "IBS Fehler vorhanden (FALSCHE LOGIK)" UBYTE _CNV_S_2_Def_bit_ub_563_CM 1 100. 0. 1. DISPLAY_IDENTIFIER B_IBSOK ECU_ADDRESS 0xc0000c4c BIT_MASK 0x4 /end MEASUREMENT
/begin MEASUREMENT St_pmbattmng0.B_inibumg "Hilfsbedingung Batterietemperaturumgebungsberechung" UBYTE _CNV_S_2_Def_bit_ub_563_CM 1 100. 0. 1. DISPLAY_IDENTIFIER B_INIBUMG ECU_ADDRESS 0xc0000c4c BIT_MASK 0x10 /end MEASUREMENT
/begin MEASUREMENT St_pmbattmng1 "Statuswort" UBYTE _CNV_R_R_Def_dez_sl_551_CM 1 100. 0. 255. DISPLAY_IDENTIFIER ST_PMBATTMNG1 ECU_ADDRESS 0xc0000c4d FORMAT "%3.0" /end MEASUREMENT
/begin MEASUREMENT St_pmbattmng1.B_batt_bad "Batterieladezustand schlecht (abh D_soc von  Batt_h2m_x)" UBYTE _CNV_S_2_Def_bit_ub_563_CM 1 100. 0. 1. DISPLAY_IDENTIFIER B_BATT_BAD ECU_ADDRESS 0xc0000c4d BIT_MASK 0x80 /end MEASUREMENT
/begin MEASUREMENT St_pmbattmng1.B_batt_good "Batterie ok (n i O bei Regeneration, AGM oder schlechter Ladezustand)" UBYTE _CNV_S_2_Def_bit_ub_563_CM 1 100. 0. 1. DISPLAY_IDENTIFIER B_BATT_GOOD ECU_ADDRESS 0xc0000c4d BIT_MASK 0x40 /end MEASUREMENT
/begin MEASUREMENT St_pmbattmng1.B_lbatteinih "Initialisierung Filter für Batterie hinten" UBYTE _CNV_S_2_Def_bit_ub_563_CM 1 100. 0. 1. DISPLAY_IDENTIFIER B_LBATTEINIH ECU_ADDRESS 0xc0000c4d BIT_MASK 0x4 /end MEASUREMENT
/begin MEASUREMENT St_pmbattmng1.B_lbatteiniv "Initialisierung Filter für Batterie vorne" UBYTE _CNV_S_2_Def_bit_ub_563_CM 1 100. 0. 1. DISPLAY_IDENTIFIER B_LBATTEINIV ECU_ADDRESS 0xc0000c4d BIT_MASK 0x10 /end MEASUREMENT
/begin MEASUREMENT St_pmbattmng1.B_lbattenh "Freigabe Berechnung für Batterie hinten" UBYTE _CNV_S_2_Def_bit_ub_563_CM 1 100. 0. 1. DISPLAY_IDENTIFIER B_LBATTENH ECU_ADDRESS 0xc0000c4d BIT_MASK 0x8 /end MEASUREMENT
/begin MEASUREMENT St_pmbattmng1.B_lbattenv "Freigabe Berechnung für Batterie vorne" UBYTE _CNV_S_2_Def_bit_ub_563_CM 1 100. 0. 1. DISPLAY_IDENTIFIER B_LBATTENV ECU_ADDRESS 0xc0000c4d BIT_MASK 0x1 /end MEASUREMENT
/begin MEASUREMENT St_pmbattmng1.B_lbattinit "Initialisierung" UBYTE _CNV_S_2_Def_bit_ub_563_CM 1 100. 0. 1. DISPLAY_IDENTIFIER B_LBATTINIT ECU_ADDRESS 0xc0000c4d BIT_MASK 0x2 /end MEASUREMENT
/begin MEASUREMENT St_pmbattmng1.B_noctrgen "kein Generator" UBYTE _CNV_S_2_Def_bit_ub_563_CM 1 100. 0. 1. DISPLAY_IDENTIFIER B_NOCTRGEN ECU_ADDRESS 0xc0000c4d BIT_MASK 0x20 /end MEASUREMENT
/begin MEASUREMENT St_pmbattmng2 "Statuswort" UBYTE _CNV_R_R_Def_dez_sl_551_CM 1 100. 0. 255. DISPLAY_IDENTIFIER ST_PMBATTMNG2 ECU_ADDRESS 0xc0000c4e FORMAT "%3.0" /end MEASUREMENT
/begin MEASUREMENT St_pmbattmng2.B_agmverbaut "Verbau AGM Batterie" UBYTE _CNV_S_2_Def_bit_ub_563_CM 1 100. 0. 1. DISPLAY_IDENTIFIER B_AGMVERBAUT ECU_ADDRESS 0xc0000c4e BIT_MASK 0x8 /end MEASUREMENT
/begin MEASUREMENT St_pmbattmng2.B_entladung "Entladungsfreigabe" UBYTE _CNV_S_2_Def_bit_ub_563_CM 1 100. 0. 1. DISPLAY_IDENTIFIER B_ENTLADUNG ECU_ADDRESS 0xc0000c4e BIT_MASK 0x2 /end MEASUREMENT
/begin MEASUREMENT St_pmbattmng2.B_entlfrei "Entladungsfreigabe" UBYTE _CNV_S_2_Def_bit_ub_563_CM 1 100. 0. 1. DISPLAY_IDENTIFIER B_ENTLFREI ECU_ADDRESS 0xc0000c4e BIT_MASK 0x4 /end MEASUREMENT
/begin MEASUREMENT St_pmbattmng2.B_taerr_1 "Fehler Ansaugluftsensor" UBYTE _CNV_S_2_Def_bit_ub_563_CM 1 100. 0. 1. DISPLAY_IDENTIFIER B_TAERR_1 ECU_ADDRESS 0xc0000c4e BIT_MASK 0x1 /end MEASUREMENT
/begin MEASUREMENT St_pmbattreg2 "Statuswort" UBYTE _CNV_R_R_Def_dez_sl_551_CM 1 100. 0. 255. DISPLAY_IDENTIFIER ST_PMBATTREG2 ECU_ADDRESS 0xc0007af0 FORMAT "%3.0" /end MEASUREMENT
/begin MEASUREMENT St_pmbattreg2.B_aktregok "Zwischenbit" UBYTE _CNV_S_2_Def_bit_ub_563_CM 1 100. 0. 1. DISPLAY_IDENTIFIER B_AKTREGOK ECU_ADDRESS 0xc0007af0 BIT_MASK 0x40 /end MEASUREMENT
/begin MEASUREMENT St_pmbattreg2.B_regokzw "Regeneration ok" UBYTE _CNV_S_2_Def_bit_ub_563_CM 1 100. 0. 1. DISPLAY_IDENTIFIER B_REGOKZW ECU_ADDRESS 0xc0007af0 BIT_MASK 0x80 /end MEASUREMENT
/begin MEASUREMENT St_pmbattreg2.B_regokzw4 "Zwischengröße" UBYTE _CNV_S_2_Def_bit_ub_563_CM 1 100. 0. 1. DISPLAY_IDENTIFIER B_REGOKZW4 ECU_ADDRESS 0xc0007af0 BIT_MASK 0x10 /end MEASUREMENT
/begin MEASUREMENT St_pmbattreg2.B_regokzw5 "Zwischengröße" UBYTE _CNV_S_2_Def_bit_ub_563_CM 1 100. 0. 1. DISPLAY_IDENTIFIER B_REGOKZW5 ECU_ADDRESS 0xc0007af0 BIT_MASK 0x20 /end MEASUREMENT
/begin MEASUREMENT St_pmbattreg2.B_regpass "passive Regeneration durchgeführt" UBYTE _CNV_S_2_Def_bit_ub_563_CM 1 100. 0. 1. DISPLAY_IDENTIFIER B_REGPASS ECU_ADDRESS 0xc0007af0 BIT_MASK 0x8 /end MEASUREMENT
/begin MEASUREMENT St_pmbattreg2.B_regstart1 "Startbedingung 1 für aktive Regeneration erfüllt" UBYTE _CNV_S_2_Def_bit_ub_563_CM 1 100. 0. 1. DISPLAY_IDENTIFIER B_REGSTART1 ECU_ADDRESS 0xc0007af0 BIT_MASK 0x1 /end MEASUREMENT
/begin MEASUREMENT St_pmbattreg2.B_regstart2 "Startbedingung 2 für aktive Regeneration erfüllt" UBYTE _CNV_S_2_Def_bit_ub_563_CM 1 100. 0. 1. DISPLAY_IDENTIFIER B_REGSTART2 ECU_ADDRESS 0xc0007af0 BIT_MASK 0x2 /end MEASUREMENT
/begin MEASUREMENT St_pmbattreg2.B_tsocbadini "Initialisierung Zeit im schlechten SoC" UBYTE _CNV_S_2_Def_bit_ub_563_CM 1 100. 0. 1. DISPLAY_IDENTIFIER B_TSOCBADINI ECU_ADDRESS 0xc0007af0 BIT_MASK 0x4 /end MEASUREMENT
/begin MEASUREMENT St_pmbattregen "Statuswort" UBYTE _CNV_R_R_Def_dez_sl_551_CM 1 100. 0. 255. DISPLAY_IDENTIFIER ST_PMBATTREGEN ECU_ADDRESS 0xc0004740 FORMAT "%3.0" /end MEASUREMENT
/begin MEASUREMENT St_pmbattregen.B_battregen "Anforderung aktive Batterieregeneration" UBYTE _CNV_S_2_Def_bit_ub_563_CM 1 100. 0. 1. DISPLAY_IDENTIFIER B_BATTREGEN ECU_ADDRESS 0xc0004740 BIT_MASK 0x1 /end MEASUREMENT
/begin MEASUREMENT St_pmbattregen.B_battregini "Erstmalige initialisierung erlofgt" UBYTE _CNV_S_2_Def_bit_ub_563_CM 1 100. 0. 1. DISPLAY_IDENTIFIER B_BATTREGINI ECU_ADDRESS 0xc0004740 BIT_MASK 0x2 /end MEASUREMENT
/begin MEASUREMENT St_pmbattregen2 "Statuswort" UBYTE _CNV_R_R_Def_dez_sl_551_CM 1 100. 0. 255. DISPLAY_IDENTIFIER ST_PMBATTREGEN2 ECU_ADDRESS 0xc0007af1 FORMAT "%3.0" /end MEASUREMENT
/begin MEASUREMENT St_pmbattregen2.B_regokzw2 "Zwischengröße" UBYTE _CNV_S_2_Def_bit_ub_563_CM 1 100. 0. 1. DISPLAY_IDENTIFIER B_REGOKZW2 ECU_ADDRESS 0xc0007af1 BIT_MASK 0x1 /end MEASUREMENT
/begin MEASUREMENT St_pmbattregen2.B_regokzw3 "Zwischengröße" UBYTE _CNV_S_2_Def_bit_ub_563_CM 1 100. 0. 1. DISPLAY_IDENTIFIER B_REGOKZW3 ECU_ADDRESS 0xc0007af1 BIT_MASK 0x2 /end MEASUREMENT
/begin MEASUREMENT St_pmbattregen2.B_uhighregok "Regeneration mit erhöhter Ladespanunng ok" UBYTE _CNV_S_2_Def_bit_ub_563_CM 1 100. 0. 1. DISPLAY_IDENTIFIER B_UHIGHREGOK ECU_ADDRESS 0xc0007af1 BIT_MASK 0x4 /end MEASUREMENT
/begin MEASUREMENT St_pmbattregen2.B_zwregok "Zwischenvariable" UBYTE _CNV_S_2_Def_bit_ub_563_CM 1 100. 0. 1. DISPLAY_IDENTIFIER B_ZWREGOK ECU_ADDRESS 0xc0007af1 BIT_MASK 0x8 /end MEASUREMENT
/begin MEASUREMENT St_pmdiag0 "Statuswort" UBYTE _CNV_R_R_Def_dez_sl_551_CM 1 100. 0. 255. DISPLAY_IDENTIFIER ST_PMDIAG0 ECU_ADDRESS 0xc0000ab8 FORMAT "%3.0" /end MEASUREMENT
/begin MEASUREMENT St_pmdiag0.B_ccbtnach "CC Meldung : Batterie Nachladen" UBYTE _CNV_S_2_Def_bit_ub_563_CM 1 100. 0. 1. DISPLAY_IDENTIFIER B_CCBTNACH ECU_ADDRESS 0xc0000ab8 BIT_MASK 0x40 /end MEASUREMENT
/begin MEASUREMENT St_pmdiag0.B_ccbttdfk "CC Meldung : Batterie verschlissen" UBYTE _CNV_S_2_Def_bit_ub_563_CM 1 100. 0. 1. DISPLAY_IDENTIFIER B_CCBTTDFK ECU_ADDRESS 0xc0000ab8 BIT_MASK 0x4 /end MEASUREMENT
/begin MEASUREMENT St_pmdiag0.B_ccbttknt "CC Meldung : Batteriekontakt pruefen" UBYTE _CNV_S_2_Def_bit_ub_563_CM 1 100. 0. 1. DISPLAY_IDENTIFIER B_CCBTTKNT ECU_ADDRESS 0xc0000ab8 BIT_MASK 0x10 /end MEASUREMENT
/begin MEASUREMENT St_pmdiag0.B_ccpmerr "CC Meldung : Powermgm ausser Betrieb" UBYTE _CNV_S_2_Def_bit_ub_563_CM 1 100. 0. 1. DISPLAY_IDENTIFIER B_CCPMERR ECU_ADDRESS 0xc0000ab8 BIT_MASK 0x8 /end MEASUREMENT
/begin MEASUREMENT St_pmdiag0.B_ccprio "CC Meldung : Komfortverbraucher eingeschraenkt" UBYTE _CNV_S_2_Def_bit_ub_563_CM 1 100. 0. 1. DISPLAY_IDENTIFIER B_CCPRIO ECU_ADDRESS 0xc0000ab8 BIT_MASK 0x2 /end MEASUREMENT
/begin MEASUREMENT St_pmdiag0.B_codierpm "Anfrage an CAS die Codierdaten erneut fuer PM zu senden." UBYTE _CNV_S_2_Def_bit_ub_563_CM 1 100. 0. 1. DISPLAY_IDENTIFIER B_CODIERPM ECU_ADDRESS 0xc0000ab8 BIT_MASK 0x1 /end MEASUREMENT
/begin MEASUREMENT St_pmdiag0.B_pcoschg "Bed. SVstatus darf geändert werden." UBYTE _CNV_S_2_Def_bit_ub_563_CM 1 100. 0. 1. DISPLAY_IDENTIFIER B_PCOSCHG ECU_ADDRESS 0xc0000ab8 BIT_MASK 0x20 /end MEASUREMENT
/begin MEASUREMENT St_pmdiag0.B_tiefrset "Tiefentladungsbit, B_tiefset, im IBS löschen." UBYTE _CNV_S_2_Def_bit_ub_563_CM 1 100. 0. 1. DISPLAY_IDENTIFIER B_TIEFRSET ECU_ADDRESS 0xc0000ab8 BIT_MASK 0x80 /end MEASUREMENT
/begin MEASUREMENT St_pmdiag1 "Statuswort" UBYTE _CNV_R_R_Def_dez_sl_551_CM 1 100. 0. 255. DISPLAY_IDENTIFIER ST_PMDIAG1 ECU_ADDRESS 0xc0000ab9 FORMAT "%3.0" /end MEASUREMENT
/begin MEASUREMENT St_pmdiag1.B_Tabstpl "Plausibilisierung Abstellzeit" UBYTE _CNV_S_2_Def_bit_ub_563_CM 1 100. 0. 1. DISPLAY_IDENTIFIER B_TABSTPL ECU_ADDRESS 0xc0000ab9 BIT_MASK 0x40 /end MEASUREMENT
/begin MEASUREMENT St_pmdiag1.B_batttrue "Tiefentladung rücksetzen" UBYTE _CNV_S_2_Def_bit_ub_563_CM 1 100. 0. 1. DISPLAY_IDENTIFIER B_BATTTRUE ECU_ADDRESS 0xc0000ab9 BIT_MASK 0x80 /end MEASUREMENT
/begin MEASUREMENT St_pmdiag1.B_ccruhver "CC Meldung : erhoehter Ruhestrom" UBYTE _CNV_S_2_Def_bit_ub_563_CM 1 100. 0. 1. DISPLAY_IDENTIFIER B_CCRUHVER ECU_ADDRESS 0xc0000ab9 BIT_MASK 0x1 /end MEASUREMENT
/begin MEASUREMENT St_pmdiag1.B_histrset "IBS Histrogramm darf gelöscht werden." UBYTE _CNV_S_2_Def_bit_ub_563_CM 1 100. 0. 1. DISPLAY_IDENTIFIER B_HISTRSET ECU_ADDRESS 0xc0000ab9 BIT_MASK 0x2 /end MEASUREMENT
/begin MEASUREMENT St_pmdiag1.B_qelad1step "Q_elad 1. Takt vorbei " UBYTE _CNV_S_2_Def_bit_ub_563_CM 1 100. 0. 1. DISPLAY_IDENTIFIER B_QELAD1STEP ECU_ADDRESS 0xc0000ab9 BIT_MASK 0x20 /end MEASUREMENT
/begin MEASUREMENT St_pmdiag1.B_ruhverl7 "Ruhestromverletzung derzeit vorhanden." UBYTE _CNV_S_2_Def_bit_ub_563_CM 1 100. 0. 1. DISPLAY_IDENTIFIER B_RUHVERL7 ECU_ADDRESS 0xc0000ab9 BIT_MASK 0x10 /end MEASUREMENT
/begin MEASUREMENT St_pmdiag1.B_sv_ihka "IHKA Standverbraucher aktiv" UBYTE _CNV_S_2_Def_bit_ub_563_CM 1 100. 0. 1. DISPLAY_IDENTIFIER B_SV_IHKA ECU_ADDRESS 0xc0000ab9 BIT_MASK 0x8 /end MEASUREMENT
/begin MEASUREMENT St_pmdiag1.B_timer_rst "Dient zum Aufziehen des internen Delay Timers" UBYTE _CNV_S_2_Def_bit_ub_563_CM 1 100. 0. 1. DISPLAY_IDENTIFIER B_TIMER_RST ECU_ADDRESS 0xc0000ab9 BIT_MASK 0x4 /end MEASUREMENT
/begin MEASUREMENT St_pmdiag2 "Statuswort" UBYTE _CNV_R_R_Def_dez_sl_551_CM 1 100. 0. 255. DISPLAY_IDENTIFIER ST_PMDIAG2 ECU_ADDRESS 0xc0000aba FORMAT "%3.0" /end MEASUREMENT
/begin MEASUREMENT St_pmdiag2.B_tiefsetok "Tiefentladung von IBS erkannt" UBYTE _CNV_S_2_Def_bit_ub_563_CM 1 100. 0. 1. DISPLAY_IDENTIFIER B_TIEFSETOK ECU_ADDRESS 0xc0000aba BIT_MASK 0x1 /end MEASUREMENT
/begin MEASUREMENT St_pmdiagnv "Statuswort" UBYTE _CNV_R_R_Def_dez_sl_551_CM 1 100. 0. 255. DISPLAY_IDENTIFIER ST_PMDIAGNV ECU_ADDRESS 0xc0004600 FORMAT "%3.0" /end MEASUREMENT
/begin MEASUREMENT St_pmdiagnv.B_ruhverl "ruhestromverletzung vorhanden" UBYTE _CNV_S_2_Def_bit_ub_563_CM 1 100. 0. 1. DISPLAY_IDENTIFIER B_RUHVERL ECU_ADDRESS 0xc0004600 BIT_MASK 0x1 /end MEASUREMENT
/begin MEASUREMENT St_pmprsv_nv "Statuswort" UBYTE _CNV_R_R_Def_dez_sl_551_CM 1 100. 0. 255. DISPLAY_IDENTIFIER ST_PMPRSV_NV ECU_ADDRESS 0xc0004678 FORMAT "%3.0" /end MEASUREMENT
/begin MEASUREMENT St_pmprsv_nv.B_enwake7 "lokales B_enwake" UBYTE _CNV_S_2_Def_bit_ub_563_CM 1 100. 0. 1. DISPLAY_IDENTIFIER B_ENWAKE7 ECU_ADDRESS 0xc0004678 BIT_MASK 0x1 /end MEASUREMENT
/begin MEASUREMENT St_pmprsvcalc "Statuswort" UBYTE _CNV_R_R_Def_dez_sl_551_CM 1 100. 0. 255. DISPLAY_IDENTIFIER ST_PMPRSVCALC ECU_ADDRESS 0xc0000b04 FORMAT "%3.0" /end MEASUREMENT
/begin MEASUREMENT St_pmprsvcalc.B_gendef "Bedingung Generator defekt während Motorbetrieb" UBYTE _CNV_S_2_Def_bit_ub_563_CM 1 100. 0. 1. DISPLAY_IDENTIFIER B_GENDEF ECU_ADDRESS 0xc0000b04 BIT_MASK 0x20 /end MEASUREMENT
/begin MEASUREMENT St_pmprsvcalc.B_ipmaktiv "IPM Massnahmen bzgl. Prios aktiviert" UBYTE _CNV_S_2_Def_bit_ub_563_CM 1 100. 0. 1. DISPLAY_IDENTIFIER B_IPMAKTIV ECU_ADDRESS 0xc0000b04 BIT_MASK 0x8 /end MEASUREMENT
/begin MEASUREMENT St_pmprsvcalc.B_ipmtimer "IPM Timer für Prios aktiv" UBYTE _CNV_S_2_Def_bit_ub_563_CM 1 100. 0. 1. DISPLAY_IDENTIFIER B_IPMTIMER ECU_ADDRESS 0xc0000b04 BIT_MASK 0x4 /end MEASUREMENT
/begin MEASUREMENT St_pmprsvcalc.B_kwdr_old "Dient zur Erkennung einer steigender Flanke B_kl15" UBYTE _CNV_S_2_Def_bit_ub_563_CM 1 100. 0. 1. DISPLAY_IDENTIFIER B_KWDR_OLD ECU_ADDRESS 0xc0000b04 BIT_MASK 0x10 /end MEASUREMENT
/begin MEASUREMENT St_pmprsvcalc.B_nkwptcio "NKW status für PTC i.o." UBYTE _CNV_S_2_Def_bit_ub_563_CM 1 100. 0. 1. DISPLAY_IDENTIFIER B_NKWPTCIO ECU_ADDRESS 0xc0000b04 BIT_MASK 0x40 /end MEASUREMENT
/begin MEASUREMENT St_pmprsvcalc.B_ptckoor "PTC Koordinator Maßnahmen Aktiv" UBYTE _CNV_S_2_Def_bit_ub_563_CM 1 100. 0. 1. DISPLAY_IDENTIFIER B_PTCKOOR ECU_ADDRESS 0xc0000b04 BIT_MASK 0x80 /end MEASUREMENT
/begin MEASUREMENT St_pmprsvcalc.B_ubtlow "Bedingung Batterie in Unterspannungszustand" UBYTE _CNV_S_2_Def_bit_ub_563_CM 1 100. 0. 1. DISPLAY_IDENTIFIER B_UBTLOW ECU_ADDRESS 0xc0000b04 BIT_MASK 0x1 /end MEASUREMENT
/begin MEASUREMENT St_pmprsvcalc.B_uloreset "Bedingung Batterie nicht mehr in Unterspannungszustand" UBYTE _CNV_S_2_Def_bit_ub_563_CM 1 100. 0. 1. DISPLAY_IDENTIFIER B_ULORESET ECU_ADDRESS 0xc0000b04 BIT_MASK 0x2 /end MEASUREMENT
/begin MEASUREMENT St_pmprsvcalc1 "Statuswort" UBYTE _CNV_R_R_Def_dez_sl_551_CM 1 100. 0. 255. DISPLAY_IDENTIFIER ST_PMPRSVCALC1 ECU_ADDRESS 0xc0000b05 FORMAT "%3.0" /end MEASUREMENT
/begin MEASUREMENT St_pmprsvcalc1.B_dubt "Bedg., ob dubt > 100mV" UBYTE _CNV_S_2_Def_bit_ub_563_CM 1 100. 0. 1. DISPLAY_IDENTIFIER B_DUBT ECU_ADDRESS 0xc0000b05 BIT_MASK 0x2 /end MEASUREMENT
/begin MEASUREMENT St_pmprsvcalc1.B_enwakeup "Bit, ob IBS Bus wecken darf oder nicht." UBYTE _CNV_S_2_Def_bit_ub_563_CM 1 100. 0. 1. DISPLAY_IDENTIFIER B_ENWAKEUP ECU_ADDRESS 0xc0000b05 BIT_MASK 0x1 /end MEASUREMENT
/begin MEASUREMENT St_pmprsvcalc1.B_limcalc "Bedg. begrenzte Berechnung" UBYTE _CNV_S_2_Def_bit_ub_563_CM 1 100. 0. 1. DISPLAY_IDENTIFIER B_LIMCALC ECU_ADDRESS 0xc0000b05 BIT_MASK 0x20 /end MEASUREMENT
/begin MEASUREMENT St_pmprsvcalc1.B_notprsv "Bed.Notlauf aufg.Batt-Unterspg, Generatorstat und B_kl15 in PMPRSVCALC" UBYTE _CNV_S_2_Def_bit_ub_563_CM 1 100. 0. 1. DISPLAY_IDENTIFIER B_NOTPRSV ECU_ADDRESS 0xc0000b05 BIT_MASK 0x40 /end MEASUREMENT
/begin MEASUREMENT St_pmprsvcalc1.B_pireset "Bedingung für PI-Reset" UBYTE _CNV_S_2_Def_bit_ub_563_CM 1 100. 0. 1. DISPLAY_IDENTIFIER B_PIRESET ECU_ADDRESS 0xc0000b05 BIT_MASK 0x80 /end MEASUREMENT
/begin MEASUREMENT St_pmprsvcalc1.B_pmbsdanf "Bedg. ob 3b4 versendet wird" UBYTE _CNV_S_2_Def_bit_ub_563_CM 1 100. 0. 1. DISPLAY_IDENTIFIER B_PMBSDANF ECU_ADDRESS 0xc0000b05 BIT_MASK 0x10 /end MEASUREMENT
/begin MEASUREMENT St_pmprsvcalc1.B_pmvsdanf "Bedg., ob 3b3 versendet wird" UBYTE _CNV_S_2_Def_bit_ub_563_CM 1 100. 0. 1. DISPLAY_IDENTIFIER B_PMVSDANF ECU_ADDRESS 0xc0000b05 BIT_MASK 0x4 /end MEASUREMENT
/begin MEASUREMENT St_pmprsvcalc2 "Statuswort" UBYTE _CNV_R_R_Def_dez_sl_551_CM 1 100. 0. 255. DISPLAY_IDENTIFIER ST_PMPRSVCALC2 ECU_ADDRESS 0xc0000b06 FORMAT "%3.0" /end MEASUREMENT
/begin MEASUREMENT St_pmprsvcalc2.B_kwdrise "Motorstart Rising" UBYTE _CNV_S_2_Def_bit_ub_563_CM 1 100. 0. 1. DISPLAY_IDENTIFIER B_KWDRISE ECU_ADDRESS 0xc0000b06 BIT_MASK 0x1 /end MEASUREMENT
/begin MEASUREMENT St_pmprsvcalc2.B_pmsulevon "PM Sulev Maßnahmen aktiv" UBYTE _CNV_S_2_Def_bit_ub_563_CM 1 100. 0. 1. DISPLAY_IDENTIFIER B_PMSULEVON ECU_ADDRESS 0xc0000b06 BIT_MASK 0x2 /end MEASUREMENT
/begin MEASUREMENT St_pmprsvcalc2.B_q_start "Bedingung Startqualität vollständig berechnet" UBYTE _CNV_S_2_Def_bit_ub_563_CM 1 100. 0. 1. DISPLAY_IDENTIFIER B_Q_START ECU_ADDRESS 0xc0000b06 BIT_MASK 0x4 /end MEASUREMENT
/begin MEASUREMENT St_pmsocalc1 "Statuswort" UBYTE _CNV_R_R_Def_dez_sl_551_CM 1 100. 0. 255. DISPLAY_IDENTIFIER ST_PMSOCALC1 ECU_ADDRESS 0xc0004680 FORMAT "%3.0" /end MEASUREMENT
/begin MEASUREMENT St_pmsocalc1.B_ibspwf_e "Bedingung Powerfail IBS erkannt" UBYTE _CNV_S_2_Def_bit_ub_563_CM 1 100. 0. 1. DISPLAY_IDENTIFIER B_IBSPWF_E ECU_ADDRESS 0xc0004680 BIT_MASK 0x1 /end MEASUREMENT
/begin MEASUREMENT St_pmsoccalc "Statuswort" UBYTE _CNV_R_R_Def_dez_sl_551_CM 1 100. 0. 255. DISPLAY_IDENTIFIER ST_PMSOCCALC ECU_ADDRESS 0xd000d8a4 FORMAT "%3.0" /end MEASUREMENT
/begin MEASUREMENT St_pmsoccalc.B_soc_pwf "Uo Kalibrierung durchgeführt" UBYTE _CNV_S_2_Def_bit_ub_563_CM 1 100. 0. 1. DISPLAY_IDENTIFIER B_SOC_PWF ECU_ADDRESS 0xd000d8a4 BIT_MASK 0x2 /end MEASUREMENT
/begin MEASUREMENT St_pmsoccalc.B_soccalc "Uo Kalibrierung durchgeführt" UBYTE _CNV_S_2_Def_bit_ub_563_CM 1 100. 0. 1. DISPLAY_IDENTIFIER B_SOCCALC ECU_ADDRESS 0xd000d8a4 BIT_MASK 0x4 /end MEASUREMENT
/begin MEASUREMENT St_pmsockor0 "Statuswort" UBYTE _CNV_R_R_Def_dez_sl_551_CM 1 100. 0. 255. DISPLAY_IDENTIFIER ST_PMSOCKOR0 ECU_ADDRESS 0xc0007a54 FORMAT "%3.0" /end MEASUREMENT
/begin MEASUREMENT St_pmsockor0.B_Tabstpla "Statuswort" UBYTE _CNV_S_2_Def_bit_ub_563_CM 1 100. 0. 1. DISPLAY_IDENTIFIER B_TABSTPLA ECU_ADDRESS 0xc0007a54 BIT_MASK 0x20 /end MEASUREMENT
/begin MEASUREMENT St_pmsockor0.B_abschfit "Bedingung Korrektur Startfähigkeitsgrenze durchgeführt" UBYTE _CNV_S_2_Def_bit_ub_563_CM 1 100. 0. 1. DISPLAY_IDENTIFIER B_ABSCHFIT ECU_ADDRESS 0xc0007a54 BIT_MASK 0x10 /end MEASUREMENT
/begin MEASUREMENT St_pmsockor0.B_pm_fit2 "Bedingung Hilfsvariable Fit 2" UBYTE _CNV_S_2_Def_bit_ub_563_CM 1 100. 0. 1. DISPLAY_IDENTIFIER B_PM_FIT2 ECU_ADDRESS 0xc0007a54 BIT_MASK 0x2 /end MEASUREMENT
/begin MEASUREMENT St_pmsockor0.B_pm_fit3 "Bedingung Hilfsvariable Fit 3" UBYTE _CNV_S_2_Def_bit_ub_563_CM 1 100. 0. 1. DISPLAY_IDENTIFIER B_PM_FIT3 ECU_ADDRESS 0xc0007a54 BIT_MASK 0x4 /end MEASUREMENT
/begin MEASUREMENT St_pmsockor0.B_pmsocini "wird beim INIT wahr um den Timer zurückzusetzen" UBYTE _CNV_S_2_Def_bit_ub_563_CM 1 100. 0. 1. DISPLAY_IDENTIFIER B_PMSOCINI ECU_ADDRESS 0xc0007a54 BIT_MASK 0x8 /end MEASUREMENT
/begin MEASUREMENT St_pmsockor0.B_soc_npl "Bedingung SoC-Wert nicht plausibel" UBYTE _CNV_S_2_Def_bit_ub_563_CM 1 100. 0. 1. DISPLAY_IDENTIFIER B_SOC_NPL ECU_ADDRESS 0xc0007a54 BIT_MASK 0x1 /end MEASUREMENT
/begin MEASUREMENT St_pmsocstart0 "Statuswort" UBYTE _CNV_R_R_Def_dez_sl_551_CM 1 100. 0. 255. DISPLAY_IDENTIFIER ST_PMSOCSTART0 ECU_ADDRESS 0xd000d8a8 FORMAT "%3.0" /end MEASUREMENT
/begin MEASUREMENT St_pmsocstart0.B_handshutn2 "Handshake Startspannungslage verarbeitet " UBYTE _CNV_S_2_Def_bit_ub_563_CM 1 100. 0. 1. DISPLAY_IDENTIFIER B_HANDSHUTN2 ECU_ADDRESS 0xd000d8a8 BIT_MASK 0x8 /end MEASUREMENT
/begin MEASUREMENT St_pmsocstart0.B_pmstart7 "Bed. Motorstart für Startauswertung PM" UBYTE _CNV_S_2_Def_bit_ub_563_CM 1 100. 0. 1. DISPLAY_IDENTIFIER B_PMSTART7 ECU_ADDRESS 0xd000d8a8 BIT_MASK 0x1 /end MEASUREMENT
/begin MEASUREMENT St_pmsocstart0.B_resetsta "Bedingung Reset Startauswertung" UBYTE _CNV_S_2_Def_bit_ub_563_CM 1 100. 0. 1. DISPLAY_IDENTIFIER B_RESETSTA ECU_ADDRESS 0xd000d8a8 BIT_MASK 0x2 /end MEASUREMENT
/begin MEASUREMENT St_pmsocstart0.B_rstdatardy "Motor aus erkannt, Startwerte im IBS bereit zum löschen." UBYTE _CNV_S_2_Def_bit_ub_563_CM 1 100. 0. 1. DISPLAY_IDENTIFIER B_RSTDATARDY ECU_ADDRESS 0xd000d8a8 BIT_MASK 0x4 /end MEASUREMENT
/begin MEASUREMENT St_pmsocstart_nv0 "Statuswort" UBYTE _CNV_R_R_Def_dez_sl_551_CM 1 100. 0. 255. DISPLAY_IDENTIFIER ST_PMSOCSTART_NV0 ECU_ADDRESS 0xc00046a4 FORMAT "%3.0" /end MEASUREMENT
/begin MEASUREMENT St_pmsocstart_nv0.B_pmsqrdy "kt_ibs.dat" UBYTE _CNV_S_2_Def_bit_ub_563_CM 1 100. 0. 1. DISPLAY_IDENTIFIER B_PMSQRDY ECU_ADDRESS 0xc00046a4 BIT_MASK 0x2 /end MEASUREMENT
/begin MEASUREMENT St_pmsocstart_nv0.B_pmstartq "Bedingung Startqualität" UBYTE _CNV_S_2_Def_bit_ub_563_CM 1 100. 0. 1. DISPLAY_IDENTIFIER B_PMSTARTQ ECU_ADDRESS 0xc00046a4 BIT_MASK 0x1 /end MEASUREMENT
/begin MEASUREMENT Stat_sv_reg "Status Standverbraucher registriert" UWORD _CNV_R_R_Def_dez_sl_551_CM 1 100. 0. 65535. DISPLAY_IDENTIFIER STAT_SV_REG ECU_ADDRESS 0xc0000ac2 FORMAT "%5.0" /end MEASUREMENT
/begin MEASUREMENT Stat_sv_reg1 "LoByte Stat_sv_reg für Umweltbedingungen" UBYTE _CNV_R_R_Def_dez_sl_551_CM 1 100. 0. 255. DISPLAY_IDENTIFIER STAT_SV_REG1 ECU_ADDRESS 0xc0000aec FORMAT "%3.0" /end MEASUREMENT
/begin MEASUREMENT Stat_sv_reg2 "HiByte Stat_sv_reg für Umweltbedinung" UBYTE _CNV_R_R_Def_dez_sl_551_CM 1 100. 0. 255. DISPLAY_IDENTIFIER STAT_SV_REG2 ECU_ADDRESS 0xc0000aed FORMAT "%3.0" /end MEASUREMENT
/begin MEASUREMENT Stfgk_state "Zustandsautomatzeiger, 0 entspricht unterhalb unterer Startfähigkeitsgrenze, 1 entspricht zwischen den Startfähigkeitsgrenzen und 2 entspricht oberhalb der oberen Startfähigkeitsgrenze" UBYTE _CNV_R_R_Def_dez_sl_551_CM 1 100. 0. 255. DISPLAY_IDENTIFIER STFGK_STATE ECU_ADDRESS 0xc000467d FORMAT "%3.0" /end MEASUREMENT
/begin MEASUREMENT Stpcos "Status_Standverbraucher" UBYTE _CNV_R_R_Def_dez_sl_551_CM 1 100. 0. 3. DISPLAY_IDENTIFIER STPCOS ECU_ADDRESS 0xc0000b8d FORMAT "%3.0" /end MEASUREMENT
/begin MEASUREMENT Stpcos7 "lokales stpcos" UBYTE _CNV_R_R_Def_dez_sl_551_CM 1 100. 0. 3. DISPLAY_IDENTIFIER STPCOS7 ECU_ADDRESS 0xc000467e FORMAT "%3.0" /end MEASUREMENT
/begin MEASUREMENT Stpcosmem "altes stpcos" UBYTE _CNV_R_R_Def_dez_sl_551_CM 1 100. 0. 3. DISPLAY_IDENTIFIER STPCOSMEM ECU_ADDRESS 0xc0000b8e FORMAT "%3.0" /end MEASUREMENT
/begin MEASUREMENT Svaus "Status Standverbraucher sind aus " UBYTE _CNV_R_R_Def_dez_sl_551_CM 1 100. 0. 1. DISPLAY_IDENTIFIER SVAUS ECU_ADDRESS 0xc0000aee FORMAT "%3.0" /end MEASUREMENT
/begin MEASUREMENT T1histshort "T1 Histogramm in 14.9333 MIn. Quantisiert" UBYTE _CNV_R_R_Def_td_ub__708_CM 1 100. 0. 3808. DISPLAY_IDENTIFIER T1HISTSHORT ECU_ADDRESS 0xc0000aef FORMAT "%5.2" /end MEASUREMENT
/begin MEASUREMENT T1pmcntr "T1PMINFO countdowncounter" UBYTE _CNV_R_R_Def_td_ub__574_CM 1 100. 0. 25.5 DISPLAY_IDENTIFIER T1PMCNTR ECU_ADDRESS 0xc0000af0 FORMAT "%4.1" /end MEASUREMENT
/begin MEASUREMENT T2hist "T2histitruh in sek." UWORD _CNV_R_R_Def_td_uw__709_CM 1 100. 0. 917490. DISPLAY_IDENTIFIER T2HIST ECU_ADDRESS 0xc0000ac4 FORMAT "%7.2" /end MEASUREMENT
/begin MEASUREMENT T2histshort "T2 Histogramm als Umweltbed. bei Ruhestromverletzung" UBYTE _CNV_R_R_Def_td_ub__708_CM 1 100. 0. 3808. DISPLAY_IDENTIFIER T2HISTSHORT ECU_ADDRESS 0xc0000af1 FORMAT "%5.2" /end MEASUREMENT
/begin MEASUREMENT T2pmcntr "T2PMINFO countdowncounter" UWORD _CNV_R_R_Def_td_ub__574_CM 1 100. 0. 6553.5 DISPLAY_IDENTIFIER T2PMCNTR ECU_ADDRESS 0xc0000ac6 FORMAT "%6.1" /end MEASUREMENT
/begin MEASUREMENT T3hist "T3histiruh in Sek" UWORD _CNV_R_R_Def_td_uw__709_CM 1 100. 0. 917490. DISPLAY_IDENTIFIER T3HIST ECU_ADDRESS 0xc0000ac8 FORMAT "%7.2" /end MEASUREMENT
/begin MEASUREMENT T3histshort "T3 Histogramm als Umweltbed. bei Ruhestromverletzung" UBYTE _CNV_R_R_Def_td_ub__708_CM 1 100. 0. 3808. DISPLAY_IDENTIFIER T3HISTSHORT ECU_ADDRESS 0xc0000af2 FORMAT "%5.2" /end MEASUREMENT
/begin MEASUREMENT T3pmcntr "T3PMINFO countdowncounter" UWORD _CNV_R_R_Def_td_ub__574_CM 1 100. 0. 6553.5 DISPLAY_IDENTIFIER T3PMCNTR ECU_ADDRESS 0xc0000aca FORMAT "%6.1" /end MEASUREMENT
/begin MEASUREMENT T4hist "T4histiruh in Sek" UWORD _CNV_R_R_Def_td_uw__709_CM 1 100. 0. 917490. DISPLAY_IDENTIFIER T4HIST ECU_ADDRESS 0xc0000acc FORMAT "%7.2" /end MEASUREMENT
/begin MEASUREMENT T4histshort "T4 Histogramm als Umweltbed. bei Ruhestromverletzung" UBYTE _CNV_R_R_Def_td_ub__708_CM 1 100. 0. 3808. DISPLAY_IDENTIFIER T4HISTSHORT ECU_ADDRESS 0xc0000af3 FORMAT "%5.2" /end MEASUREMENT
/begin MEASUREMENT T_batstiniv "Starttemperatur Batterie vorne" SWORD _CNV_R_R_Def_t_sw_q_578_CM 1 100. -3276.8 3276.7 DISPLAY_IDENTIFIER T_BATSTINIV ECU_ADDRESS 0xc0000c54 FORMAT "%6.1" /end MEASUREMENT
/begin MEASUREMENT T_batt "lbattcal.dat" SWORD _CNV_R_R_Def_t_sw_q_578_CM 1 100. -3276.8 3276.7 DISPLAY_IDENTIFIER T_BATT ECU_ADDRESS 0xc0000c56 FORMAT "%6.1" /end MEASUREMENT
/begin MEASUREMENT T_batt_ini "Startwert Batterietemperatur" SWORD _CNV_R_R_Def_t_sw_q_578_CM 1 100. -3276.8 3276.7 DISPLAY_IDENTIFIER T_BATT_INI ECU_ADDRESS 0xc0000c58 FORMAT "%6.1" /end MEASUREMENT
/begin MEASUREMENT T_batt_lb "Batterietemperatur" SWORD _CNV_R_R_Def_t_sw_q_578_CM 1 100. -3276.8 3276.7 DISPLAY_IDENTIFIER T_BATT_LB ECU_ADDRESS 0xc0000c5a FORMAT "%6.1" /end MEASUREMENT
/begin MEASUREMENT T_batt_zw "zwischenvariable" SWORD _CNV_R_R_Def_t_sw_q_578_CM 1 100. -3276.8 3276.7 DISPLAY_IDENTIFIER T_BATT_ZW ECU_ADDRESS 0xc0000c5c FORMAT "%6.1" /end MEASUREMENT
/begin MEASUREMENT T_batt_zw2 "Zwischenvar berechnungT_batt" SWORD _CNV_R_R_Def_t_sw_q_578_CM 1 100. -3276.8 3276.7 DISPLAY_IDENTIFIER T_BATT_ZW2 ECU_ADDRESS 0xc0000c5e FORMAT "%6.1" /end MEASUREMENT
/begin MEASUREMENT T_batt_zw3 "Zwischenvar Berechnung T_batt" SWORD _CNV_R_R_Def_t_sw_q_578_CM 1 100. -3276.8 3276.7 DISPLAY_IDENTIFIER T_BATT_ZW3 ECU_ADDRESS 0xc0000c60 FORMAT "%6.1" /end MEASUREMENT
/begin MEASUREMENT T_batt_zw4 "Zwischenvar Eingang KF zu Berechnung Batt_m2l und Batt_h2m" SWORD _CNV_R_R_Def_t_sw_q_578_CM 1 100. -3276.8 3276.7 DISPLAY_IDENTIFIER T_BATT_ZW4 ECU_ADDRESS 0xc0000c62 FORMAT "%6.1" /end MEASUREMENT
/begin MEASUREMENT T_battabst "Batterieabstelltemperatur" SWORD _CNV_R_R_Def_t_sw_q_578_CM 1 100. -3276.8 3276.7 DISPLAY_IDENTIFIER T_BATTABST ECU_ADDRESS 0xc000473c FORMAT "%6.1" /end MEASUREMENT
/begin MEASUREMENT T_histruhm "Summer aller Ruhestromverletzungsintervalle in Minuten" UWORD _CNV_R_R_Def_tn_uw__664_CM 1 100. 0. 65535. DISPLAY_IDENTIFIER T_HISTRUHM ECU_ADDRESS 0xc0000ace FORMAT "%7.2" /end MEASUREMENT
/begin MEASUREMENT T_histsum "Txhistiruh Summe" UWORD _CNV_R_R_Def_td_uw__711_CM 1 100. 0. 3669960. DISPLAY_IDENTIFIER T_HISTSUM ECU_ADDRESS 0xc0000ad0 FORMAT "%7.2" /end MEASUREMENT
/begin MEASUREMENT T_histsummin "Summe der Txhistiruh in Minuten" UWORD _CNV_R_R_Def_td_uw__712_CM 1 100. 0. 61166. DISPLAY_IDENTIFIER T_HISTSUMMIN ECU_ADDRESS 0xc0000ad2 FORMAT "%7.2" /end MEASUREMENT
/begin MEASUREMENT T_saismem "T Saison zw. speicher" UBYTE _CNV_R_R_Def_dez_sl_551_CM 1 100. 0. 255. DISPLAY_IDENTIFIER T_SAISMEM ECU_ADDRESS 0xc0000af4 FORMAT "%3.0" /end MEASUREMENT
/begin MEASUREMENT T_saison "Saison -Temperatur" SWORD _CNV_R_R_Def_t_sw_q_578_CM 1 100. -3276.8 3276.7 DISPLAY_IDENTIFIER T_SAISON ECU_ADDRESS 0xc000469a FORMAT "%6.1" /end MEASUREMENT
/begin MEASUREMENT T_saisonalt "letzter Wert Saisontemperatur" SWORD _CNV_R_R_Def_t_sw_q_578_CM 1 100. -3276.8 3276.7 DISPLAY_IDENTIFIER T_SAISONALT ECU_ADDRESS 0xc0007a5a FORMAT "%6.1" /end MEASUREMENT
/begin MEASUREMENT Td_regen "Zeit Regeneration bzw Pause dazwischen" UWORD _CNV_R_R_Def_td_uw__673_CM 1 100. 0. 655.35 DISPLAY_IDENTIFIER TD_REGEN ECU_ADDRESS 0xc000474c FORMAT "%7.2" /end MEASUREMENT
/begin MEASUREMENT Td_regen0 "Präzise Stopuhr" UBYTE _CNV_R_R_Def_dez_sl_551_CM 1 100. 0. 255. DISPLAY_IDENTIFIER TD_REGEN0 ECU_ADDRESS 0xc0007b0e FORMAT "%3.0" /end MEASUREMENT
/begin MEASUREMENT Td_soclow "Zähler Zeit Ladezustand unter x%" UBYTE _CNV_R_R_Def_td_ub__574_CM 1 100. 0. 25.5 DISPLAY_IDENTIFIER TD_SOCLOW ECU_ADDRESS 0xc0004751 FORMAT "%4.1" /end MEASUREMENT
/begin MEASUREMENT Tn_abstelllo2 "" UWORD _CNV_R_R_Def_tn_uw__664_CM 1 100. 0. 65535. DISPLAY_IDENTIFIER TN_ABSTELLLO2 ECU_ADDRESS 0xc0007a5e FORMAT "%7.2" /end MEASUREMENT
/begin MEASUREMENT Tn_abstellloc "Maximalwert von Tn_abstellm" UWORD _CNV_R_R_Def_tn_uw__664_CM 1 100. 0. 65535. DISPLAY_IDENTIFIER TN_ABSTELLLOC ECU_ADDRESS 0xc0000ad4 FORMAT "%7.2" /end MEASUREMENT
/begin MEASUREMENT Tsocloc "Batterietemperatur zum Zeitpunkt der Ruhespannungsmessung (lokal)" SWORD _CNV_R_R_Def_t_sw_q_578_CM 1 100. -3276.8 3276.7 DISPLAY_IDENTIFIER TSOCLOC ECU_ADDRESS 0xc0007a3a FORMAT "%6.1" /end MEASUREMENT
/begin MEASUREMENT Tumg_abst "Abstell-Aussentemperatur" SWORD _CNV_R_R_Def_t_sw_q_578_CM 1 100. -3276.8 3276.7 DISPLAY_IDENTIFIER TUMG_ABST ECU_ADDRESS 0xc0000c64 FORMAT "%6.1" /end MEASUREMENT
/begin MEASUREMENT Tumg_battab "Abstell-Umgebungstemperatur Batterie" SWORD _CNV_R_R_Def_t_sw_q_578_CM 1 100. -3276.8 3276.7 DISPLAY_IDENTIFIER TUMG_BATTAB ECU_ADDRESS 0xc000473e FORMAT "%6.1" /end MEASUREMENT
/begin MEASUREMENT Tumg_dt "Delta Umgebungstemperatur" SWORD _CNV_R_R_Def_t_sw_q_578_CM 1 100. -3276.8 3276.7 DISPLAY_IDENTIFIER TUMG_DT ECU_ADDRESS 0xc0000c66 FORMAT "%6.1" /end MEASUREMENT
/begin MEASUREMENT Tumg_ers "Aussentemperatur oder Ersatzwert" SWORD _CNV_R_R_Def_t_sw_q_578_CM 1 100. -3276.8 3276.7 DISPLAY_IDENTIFIER TUMG_ERS ECU_ADDRESS 0xc0000c68 FORMAT "%6.1" /end MEASUREMENT
/begin MEASUREMENT Tumg_tp "Umgebungstemp temp" SWORD _CNV_R_R_Def_t_sw_q_578_CM 1 100. -3276.8 3276.7 DISPLAY_IDENTIFIER TUMG_TP ECU_ADDRESS 0xc0000c6a FORMAT "%6.1" /end MEASUREMENT
/begin MEASUREMENT U_batt_ll "Batteriespannung Leerlauf" UBYTE _CNV_R_R_Def_u_ub_q_631_CM 1 100. 0. 25.5 DISPLAY_IDENTIFIER U_BATT_LL ECU_ADDRESS 0xc0000c7a FORMAT "%5.2" /end MEASUREMENT
/begin MEASUREMENT U_batt_max "dynamische Vorgabe Batteriemaximalspannungsgrenze" UBYTE _CNV_R_R_Def_u_ub_q_631_CM 1 100. 0. 25.5 DISPLAY_IDENTIFIER U_BATT_MAX ECU_ADDRESS 0xc0000c7b FORMAT "%5.2" /end MEASUREMENT
/begin MEASUREMENT U_batt_min "Batteriespannung min" UBYTE _CNV_R_R_Def_u_ub_q_631_CM 1 100. 0. 25.5 DISPLAY_IDENTIFIER U_BATT_MIN ECU_ADDRESS 0xc0000c7c FORMAT "%5.2" /end MEASUREMENT
/begin MEASUREMENT U_batt_mx "max Batteriespannung" UBYTE _CNV_R_R_Def_u_ub_q_631_CM 1 100. 0. 25.5 DISPLAY_IDENTIFIER U_BATT_MX ECU_ADDRESS 0xc0000c7d FORMAT "%5.2" /end MEASUREMENT
/begin MEASUREMENT U_batt_soll "Batteriesollspannungsvorgabe nach Ladekennlinie" UBYTE _CNV_R_R_Def_u_ub_q_631_CM 1 100. 0. 25.5 DISPLAY_IDENTIFIER U_BATT_SOLL ECU_ADDRESS 0xc0000c7e FORMAT "%5.2" /end MEASUREMENT
/begin MEASUREMENT U_battsoll "Batteriesollspannung" UBYTE _CNV_R_R_Def_u_ub_q_631_CM 1 100. 0. 25.5 DISPLAY_IDENTIFIER U_BATTSOLL ECU_ADDRESS 0xc0000c7f FORMAT "%5.2" /end MEASUREMENT
/begin MEASUREMENT U_bsoll_lcp "lokales ubattsoll" UBYTE _CNV_R_R_Def_u_ub_q_631_CM 1 100. 0. 25.5 DISPLAY_IDENTIFIER U_BSOLL_LCP ECU_ADDRESS 0xc0000c80 FORMAT "%5.2" /end MEASUREMENT
/begin MEASUREMENT U_bsoll_ulcp "Generatorsollspannung" SWORD _CNV_R_R_Def_u_sw_b_581_CM 1 100. -128. 127.996 DISPLAY_IDENTIFIER U_BSOLL_ULCP ECU_ADDRESS 0xc0000c6c FORMAT "%8.3" /end MEASUREMENT
/begin MEASUREMENT U_bt_mtl "Einzuhaltende mittlere Spannung (temperaturabhängig)" UBYTE _CNV_R_R_Def_u_ub_q_631_CM 1 100. 0. 25.5 DISPLAY_IDENTIFIER U_BT_MTL ECU_ADDRESS 0xc0000c81 FORMAT "%5.2" /end MEASUREMENT
/begin MEASUREMENT U_deltau "delta zwischen Sollspg und Ub" UBYTE _CNV_R_R_Def_u_ub_q_631_CM 1 100. 0. 25.5 DISPLAY_IDENTIFIER U_DELTAU ECU_ADDRESS 0xc0000c91 FORMAT "%5.2" /end MEASUREMENT
/begin MEASUREMENT U_dynbatt_mn "Min Batteriespannung" UBYTE _CNV_R_R_Def_u_ub_q_631_CM 1 100. 0. 25.5 DISPLAY_IDENTIFIER U_DYNBATT_MN ECU_ADDRESS 0xc0000c82 FORMAT "%5.2" /end MEASUREMENT
/begin MEASUREMENT U_grenz "Grenzwert Spannung" UWORD _CNV_R_R_Def_u_uw_q_700_CM 1 100. 6. 22.3837 DISPLAY_IDENTIFIER U_GRENZ ECU_ADDRESS 0xc0000b98 FORMAT "%9.4" /end MEASUREMENT
/begin MEASUREMENT U_lade "Batterieladespannung" SWORD _CNV_R_R_Def_u_sw_b_581_CM 1 100. -128. 127.996 DISPLAY_IDENTIFIER U_LADE ECU_ADDRESS 0xc0000c6e FORMAT "%8.3" /end MEASUREMENT
/begin MEASUREMENT U_stabatt_mn "Min Batteriespg sta" UBYTE _CNV_R_R_Def_u_ub_q_631_CM 1 100. 0. 25.5 DISPLAY_IDENTIFIER U_STABATT_MN ECU_ADDRESS 0xc0000c83 FORMAT "%5.2" /end MEASUREMENT
/begin MEASUREMENT U_startausw "U_tnstart - ugrenz" SWORD _CNV_R_R_Def_u_sw_q_722_CM 1 100. -8.192 8.191700000000001 DISPLAY_IDENTIFIER U_STARTAUSW ECU_ADDRESS 0xc0000b94 FORMAT "%9.4" /end MEASUREMENT
/begin MEASUREMENT U_tnstartmsa "Spannungslage beim Start" UWORD _CNV_R_R_Def_u_uw_q_723_CM 1 100. 0. 2097.12 DISPLAY_IDENTIFIER U_TNSTARTMSA ECU_ADDRESS 0xc0000b9a FORMAT "%8.3" /end MEASUREMENT
/begin MEASUREMENT Ub_old "letzter Wert Batteriespannung" UWORD _CNV_R_R_Def_u_sb_q_583_CM 1 100. 0. 6173.397 DISPLAY_IDENTIFIER UB_OLD ECU_ADDRESS 0xd000d8ac FORMAT "%6.1" /end MEASUREMENT
/begin MEASUREMENT Ubatt0 "Aus Wertetripel ausgewählter Ruhespannungswert" UWORD _CNV_R_R_Def_u_uw_q_700_CM 1 100. 6. 22.3837 DISPLAY_IDENTIFIER UBATT0 ECU_ADDRESS 0xc0007a46 FORMAT "%9.4" /end MEASUREMENT
/begin MEASUREMENT Ubattloc "Zwischenvariable infolge Compilerproblemen" UBYTE _CNV_R_R_Def_u_ub_q_631_CM 1 100. 0. 25.5 DISPLAY_IDENTIFIER UBATTLOC ECU_ADDRESS 0xc0000af5 FORMAT "%5.2" /end MEASUREMENT
/begin MEASUREMENT Ubattloc_1 "Zwischenvariable infolge Compilerproblemen" UBYTE _CNV_R_R_Def_u_ub_q_631_CM 1 100. 0. 25.5 DISPLAY_IDENTIFIER UBATTLOC_1 ECU_ADDRESS 0xc0000af6 FORMAT "%5.2" /end MEASUREMENT
/begin MEASUREMENT Ubattloc_2 "Zwischenvariable infolge Compilerproblemen" UBYTE _CNV_R_R_Def_u_ub_q_631_CM 1 100. 0. 25.5 DISPLAY_IDENTIFIER UBATTLOC_2 ECU_ADDRESS 0xc0000af7 FORMAT "%5.2" /end MEASUREMENT
/begin MEASUREMENT Ubatts2 "Hilfswert2 Spannung aus Fitberechnung" UWORD _CNV_R_R_Def_u_uw_q_700_CM 1 100. 6. 16. DISPLAY_IDENTIFIER UBATTS2 ECU_ADDRESS 0xc0007a4e FORMAT "%9.4" /end MEASUREMENT
/begin MEASUREMENT Ubdiff "ubattsoll - ubatt_w" SWORD _CNV_R_R_Def_f_sw_b_556_CM 1 100. -32. 31.999 DISPLAY_IDENTIFIER UBDIFF ECU_ADDRESS 0xc0000b2e FORMAT "%9.4" /end MEASUREMENT
/begin MEASUREMENT Ubdiff2pi "Ubatt-Differenz-Gewichtung auf Prios" SWORD _CNV_R_R_Def_f_sw_p_557_CM 1 100. -100. 100. DISPLAY_IDENTIFIER UBDIFF2PI ECU_ADDRESS 0xc0000b30 FORMAT "%7.2" /end MEASUREMENT
/begin MEASUREMENT Ubdiffilt "Wert nach Ubdiff-Tiefpass Prio" SWORD _CNV_R_R_Def_f_sw_b_556_CM 1 100. -32. 31.999 DISPLAY_IDENTIFIER UBDIFFILT ECU_ADDRESS 0xc0000b32 FORMAT "%9.4" /end MEASUREMENT
/begin MEASUREMENT Ubdiffptc "Delta Usoll-Ubatt PTC" SWORD _CNV_R_R_Def_f_sw_b_556_CM 1 100. -32. 31.999 DISPLAY_IDENTIFIER UBDIFFPTC ECU_ADDRESS 0xc0000b34 FORMAT "%9.4" /end MEASUREMENT
/begin MEASUREMENT Ubold7 "PTC dudt : alter Ub Wert zur Differenzbildung" UWORD _CNV_R_R_Def_u_sb_q_583_CM 1 100. 0. 6173.397 DISPLAY_IDENTIFIER UBOLD7 ECU_ADDRESS 0xc0000b66 FORMAT "%6.1" /end MEASUREMENT
/begin MEASUREMENT Ubt "Batteriespannung" UWORD _CNV_R_R_Def_u_uw_q_724_CM 1 100. 0. 983.025 DISPLAY_IDENTIFIER UBT ECU_ADDRESS 0xc0000b68 FORMAT "%8.3" /end MEASUREMENT
/begin MEASUREMENT Ubt7 "Lokale Batteriespannung" UWORD _CNV_R_R_Def_u_uw_q_724_CM 1 100. 0. 61.425 DISPLAY_IDENTIFIER UBT7 ECU_ADDRESS 0xc0000b6a FORMAT "%8.3" /end MEASUREMENT
/begin MEASUREMENT Ubt7mem "resultierendes ubt" SWORD _CNV_R_R_Def_u_sw_b_581_CM 1 100. -128. 127.996 DISPLAY_IDENTIFIER UBT7MEM ECU_ADDRESS 0xc0000b36 FORMAT "%8.3" /end MEASUREMENT
/begin MEASUREMENT Ubt7old "altes ubt" UWORD _CNV_R_R_Def_u_uw_q_724_CM 1 100. 0. 61.425 DISPLAY_IDENTIFIER UBT7OLD ECU_ADDRESS 0xc0000b6c FORMAT "%8.3" /end MEASUREMENT
/begin MEASUREMENT Ubtpt12ptc "Ubatt Gewichtung für PTC Ansteuerung" SWORD _CNV_R_R_Def_f_sw_p_557_CM 1 100. -100. 100. DISPLAY_IDENTIFIER UBTPT12PTC ECU_ADDRESS 0xc0000b38 FORMAT "%7.2" /end MEASUREMENT
/begin MEASUREMENT Ubtpt1ptc "Ubdiffptc gefiltert" SWORD _CNV_R_R_Def_f_sw_b_556_CM 1 100. -32. 31.999 DISPLAY_IDENTIFIER UBTPT1PTC ECU_ADDRESS 0xc0000b3a FORMAT "%9.4" /end MEASUREMENT
/begin MEASUREMENT Udeltaabsc "absoluter Wert von udelta" UWORD _CNV_R_R_Def_u_uw_q_724_CM 1 100. 0. 61.425 DISPLAY_IDENTIFIER UDELTAABSC ECU_ADDRESS 0xc0000b6e FORMAT "%8.3" /end MEASUREMENT
/begin MEASUREMENT Udeltac "inkrementierte Differenz zwischen altem und neuem ubt" SWORD _CNV_R_R_Def_u_sw_b_581_CM 1 100. -128. 127.996 DISPLAY_IDENTIFIER UDELTAC ECU_ADDRESS 0xc0000b3c FORMAT "%8.3" /end MEASUREMENT
/begin MEASUREMENT Ulev "Spannungsebene" UBYTE _CNV_R_R_Def_dez_sl_551_CM 1 100. 0. 15. DISPLAY_IDENTIFIER ULEV ECU_ADDRESS 0xc0000b8f FORMAT "%3.0" /end MEASUREMENT
/begin MEASUREMENT Ulevmem "altes ulev" UBYTE _CNV_R_R_Def_dez_sl_551_CM 1 100. 0. 15. DISPLAY_IDENTIFIER ULEVMEM ECU_ADDRESS 0xc0000b90 FORMAT "%3.0" /end MEASUREMENT
/begin MEASUREMENT Ulow "Unterspannungsstatus : 0=i.O, 1=in between, 2=unterspannung" UBYTE _CNV_R_R_Def_dez_sl_551_CM 1 100. 0. 255. DISPLAY_IDENTIFIER ULOW ECU_ADDRESS 0xc0000b91 FORMAT "%3.0" /end MEASUREMENT
/begin MEASUREMENT Ulowtimer "Zeit zur Unterspannungserkennung * Taskzeit (50*100ms = 5sec)" UBYTE _CNV_R_R_Def_td_ub__574_CM 1 100. 0. 25.5 DISPLAY_IDENTIFIER ULOWTIMER ECU_ADDRESS 0xc0000b92 FORMAT "%4.1" /end MEASUREMENT
/begin MEASUREMENT Uspgcnt "FS_Unterspannungscounter" UBYTE _CNV_R_R_Def_td_ub__574_CM 1 100. 0. 25.5 DISPLAY_IDENTIFIER USPGCNT ECU_ADDRESS 0xc0000af8 FORMAT "%4.1" /end MEASUREMENT
/begin MEASUREMENT Uspgprell "Anzahl der entprellten FS_Unterspannungserkennung." UBYTE _CNV_R_R_Def_dez_sl_551_CM 1 100. 0. 255. DISPLAY_IDENTIFIER USPGPRELL ECU_ADDRESS 0xc0000af9 FORMAT "%3.0" /end MEASUREMENT
/begin MEASUREMENT Uspgstat "FS_Unterspannungsstatus" UBYTE _CNV_R_R_Def_dez_sl_551_CM 1 100. 0. 255. DISPLAY_IDENTIFIER USPGSTAT ECU_ADDRESS 0xc0000afa FORMAT "%3.0" /end MEASUREMENT
/begin MEASUREMENT Zentlact "Zähler Entlastung aktiv" UBYTE _CNV_R_R_Def_td_ub__574_CM 1 100. 0. 25.5 DISPLAY_IDENTIFIER ZENTLACT ECU_ADDRESS 0xc0000c84 FORMAT "%4.1" /end MEASUREMENT
/begin MEASUREMENT Zladungact "NN" UWORD _CNV_R_R_Def_td_ub__574_CM 1 100. 0. 6553.5 DISPLAY_IDENTIFIER ZLADUNGACT ECU_ADDRESS 0xc0000c72 FORMAT "%6.1" /end MEASUREMENT
/begin MEASUREMENT Zr_regen "Zähler Regenerationen" UBYTE _CNV_R_R_Def_dez_sl_551_CM 1 100. 0. 255. DISPLAY_IDENTIFIER ZR_REGEN ECU_ADDRESS 0xc0004752 FORMAT "%3.0" /end MEASUREMENT
/begin MEASUREMENT Zr_regsoclow "Zähler SOC-Low Zustand" UWORD _CNV_R_R_Def_f_uw_b_626_CM 1 100. 0. 511.9921 DISPLAY_IDENTIFIER ZR_REGSOCLOW ECU_ADDRESS 0xc0007afa FORMAT "%8.3" /end MEASUREMENT
/begin MEASUREMENT Ztagedelta "verstrichene Tage" UBYTE _CNV_R_R_Def_dez_sl_551_CM 1 100. 0. 10. DISPLAY_IDENTIFIER ZTAGEDELTA ECU_ADDRESS 0xc0000afb FORMAT "%3.0" /end MEASUREMENT
/begin MEASUREMENT Ztageold "letzter Wert von ztageabs_w" UWORD _CNV_R_R_Def_dez_sl_551_CM 1 100. 0. 65535. DISPLAY_IDENTIFIER ZTAGEOLD ECU_ADDRESS 0xc0004652 FORMAT "%5.0" /end MEASUREMENT
/begin MEASUREMENT Ztagestate "Tageswechsel Statemachine Ctr" UBYTE _CNV_R_R_Def_dez_sl_551_CM 1 100. 0. 255. DISPLAY_IDENTIFIER ZTAGESTATE ECU_ADDRESS 0xc0000afc FORMAT "%3.0" /end MEASUREMENT
/begin MEASUREMENT Zw1 "Zwischenvariable" UBYTE _CNV_R_R_Def_dez_ub_685_CM 1 100. 0. 127.5 DISPLAY_IDENTIFIER ZW1 ECU_ADDRESS 0xc0007b0f /end MEASUREMENT
/begin MEASUREMENT Zw10 "Zwischenvariable" UWORD _CNV_R_R_Def_f_sw_p_557_CM 1 100. 0. 16383.75 DISPLAY_IDENTIFIER ZW10 ECU_ADDRESS 0xc0007afc FORMAT "%8.3" /end MEASUREMENT
/begin MEASUREMENT Zw11 "Zwischenvariable" UBYTE _CNV_R_R_Def_u_ub_q_631_CM 1 100. 0. 1.5 DISPLAY_IDENTIFIER ZW11 ECU_ADDRESS 0xc0000ca8 FORMAT "%5.2" /end MEASUREMENT
/begin MEASUREMENT Zw12 "Zwischenvariable" UWORD _CNV_R_R_Def_ql_uw__597_CM 1 100. 0. 19087.864 DISPLAY_IDENTIFIER ZW12 ECU_ADDRESS 0xc0007afe FORMAT "%7.2" /end MEASUREMENT
/begin MEASUREMENT Zw2 "Zwischenvariable" UWORD _CNV_R_R_Def_ql_uw__577_CM 1 100. 0. 1192.7502 DISPLAY_IDENTIFIER ZW2 ECU_ADDRESS 0xc0007b00 FORMAT "%8.3" /end MEASUREMENT
/begin MEASUREMENT Zw3 "Zwischenvariable" UWORD _CNV_R_R_Def_ql_uw__597_CM 1 100. 0. 19087.864 DISPLAY_IDENTIFIER ZW3 ECU_ADDRESS 0xc0007b02 FORMAT "%7.2" /end MEASUREMENT
/begin MEASUREMENT Zw4 "Zwischenvariable" UBYTE _CNV_R_R_Def_dez_sl_551_CM 1 100. 0. 255. DISPLAY_IDENTIFIER ZW4 ECU_ADDRESS 0xc0007b10 FORMAT "%3.0" /end MEASUREMENT
/begin MEASUREMENT Zw5 "Zwischenvariable" UWORD _CNV_R_R_Def_ql_uw__597_CM 1 100. 0. 19087.864 DISPLAY_IDENTIFIER ZW5 ECU_ADDRESS 0xc0007b04 FORMAT "%7.2" /end MEASUREMENT
/begin MEASUREMENT Zw6 "Zwischenvariable" UWORD _CNV_R_R_Def_ql_uw__597_CM 1 100. 0. 19087.864 DISPLAY_IDENTIFIER ZW6 ECU_ADDRESS 0xc0007b06 FORMAT "%7.2" /end MEASUREMENT
/begin MEASUREMENT Zw7 "Zwischenvariable" UWORD _CNV_R_R_Def_ql_uw__597_CM 1 100. 0. 19087.864 DISPLAY_IDENTIFIER ZW7 ECU_ADDRESS 0xc0007b08 FORMAT "%7.2" /end MEASUREMENT
/begin MEASUREMENT Zw8 "Zwischenvariable" UWORD _CNV_R_R_Def_ql_uw__597_CM 1 100. 0. 19087.864 DISPLAY_IDENTIFIER ZW8 ECU_ADDRESS 0xc0007b0a FORMAT "%7.2" /end MEASUREMENT
/begin MEASUREMENT Zw9 "Zwischenvariable" UWORD _CNV_R_R_Def_ql_uw__597_CM 1 100. 0. 19087.864 DISPLAY_IDENTIFIER ZW9 ECU_ADDRESS 0xc0007b0c FORMAT "%7.2" /end MEASUREMENT
/begin CHARACTERISTIC CBATT_DEF "Ersatzwert Batteriekapazität" VALUE 0xa0824b84 _REC_VAL_20_u1 99.06 _CNV_R_R_Def_ql_ub__573_CM 1. 255. FORMAT "%4.1" /end CHARACTERISTIC
/begin CHARACTERISTIC CW_BATTCOD "Enable Handcodierung" VALUE 0xa08251f6 _REC_VAL_20_u1 2. _CNV_R_R_Def_dez_sl_551_CM 0. 2. FORMAT "%3.0" /end CHARACTERISTIC
/begin CHARACTERISTIC CW_CCMASK "CC-Meldung Maske" VALUE 0xa082479c _REC_VAL_20_u1 99.45 _CNV_R_R_Def_dez_sl_551_CM 0. 255. FORMAT "%3.0" /end CHARACTERISTIC
/begin CHARACTERISTIC CW_PMDEFMASK "Bitcodierte Maske zum Setzen von PM Defekt" VALUE 0xa082479d _REC_VAL_20_u1 99.45 _CNV_R_R_Def_dez_sl_551_CM 0. 255. FORMAT "%3.0" /end CHARACTERISTIC
/begin CHARACTERISTIC CW_PMMASKDFP "Powermanagement Fehlerpseicher Maske" VALUE 0xa082479e _REC_VAL_20_u1 99.45 _CNV_R_R_Def_dez_sl_551_CM 0. 255. FORMAT "%3.0" /end CHARACTERISTIC
/begin CHARACTERISTIC KF_BATT1 "Kennfeld Bestimmung Batt_h2m" MAP 0xa082534c _REC_MAP_52_UBYTE_s2_s2_u1 99.99844999999999 _CNV_R_R_Def_f_sw_b_570_CM -100. 99.9969
 /begin AXIS_DESCR STD_AXIS T_batt_zw4 _CNV_R_R_Def_t_sw_q_578_CM 4 -3276.8 3276.7 FORMAT "%4.1" /end AXIS_DESCR
 /begin AXIS_DESCR STD_AXIS Kapa_verlust _CNV_R_R_Def_f_ub_b_586_CM 4 0. 99.60930000000001 FORMAT "%5.2" /end AXIS_DESCR
/end CHARACTERISTIC
/begin CHARACTERISTIC KF_BATT2 "Kennfeld Bestimmung Batt_m2l" MAP 0xa082531c _REC_MAP_52_UBYTE_s2_s2_u1 99.99844999999999 _CNV_R_R_Def_f_sw_b_570_CM -100. 99.9969
 /begin AXIS_DESCR STD_AXIS T_batt_zw4 _CNV_R_R_Def_t_sw_q_578_CM 4 -3276.8 3276.7 FORMAT "%4.1" /end AXIS_DESCR
 /begin AXIS_DESCR STD_AXIS Kapa_verlust _CNV_R_R_Def_f_ub_b_586_CM 4 0. 99.60930000000001 FORMAT "%5.2" /end AXIS_DESCR
/end CHARACTERISTIC
/begin CHARACTERISTIC KF_IBTSOLL "KFSollstrom aufgrund von Batterietemperatur und Ladezustand." MAP 0xa0824b28 _REC_MAP_52_UBYTE_u2_s2_s2 104.856 _CNV_R_R_Def_i_uw_q_634_CM -200. 5042.8
 /begin AXIS_DESCR STD_AXIS T_batt _CNV_R_R_Def_t_sw_q_578_CM 5 -3276.8 3276.7 FORMAT "%4.1" /end AXIS_DESCR
 /begin AXIS_DESCR STD_AXIS D_soc _CNV_R_R_Def_f_sw_b_570_CM 6 -100. 99.9969 /end AXIS_DESCR
/end CHARACTERISTIC
/begin CHARACTERISTIC KF_MAXENTL "Kennfeld Bestimmung Entladezeit" MAP 0xa082537c _REC_MAP_52_u1_u1_s2 25.5 _CNV_R_R_Def_td_ub__574_CM 0. 25.5 FORMAT "%4.1"
 /begin AXIS_DESCR STD_AXIS NO_INPUT_QUANTITY _CNV_R_R_Def_f_ub_b_586_CM 4 0. 99.60930000000001 FORMAT "%5.2" /end AXIS_DESCR
 /begin AXIS_DESCR STD_AXIS T_batt _CNV_R_R_Def_t_sw_q_578_CM 4 -3276.8 3276.7 FORMAT "%4.1" /end AXIS_DESCR
/end CHARACTERISTIC
/begin CHARACTERISTIC KF_PMRIBAT1 "Kennfeld Innenwiderstand Batterie" MAP 0xa0824d24 _REC_MAP_52_u1_s2_u2 0.255 _CNV_R_R_Def_f_ub_q_745_CM 0. 0.255
 /begin AXIS_DESCR STD_AXIS T_batt _CNV_R_R_Def_t_sw_q_578_CM 4 -3276.8 3276.7 FORMAT "%4.1" /end AXIS_DESCR
 /begin AXIS_DESCR STD_AXIS I_batt _CNV_R_R_Def_i_uw_q_634_CM 6 -200. 5042.8 /end AXIS_DESCR
/end CHARACTERISTIC
/begin CHARACTERISTIC KF_PMRIBAT2 "Kennfeld Innenwiderstand Batterie2" MAP 0xa0824cf4 _REC_MAP_52_u1_s2_u2 0.255 _CNV_R_R_Def_f_ub_q_745_CM 0. 0.255
 /begin AXIS_DESCR STD_AXIS T_batt _CNV_R_R_Def_t_sw_q_578_CM 4 -3276.8 3276.7 FORMAT "%4.1" /end AXIS_DESCR
 /begin AXIS_DESCR STD_AXIS I_batt _CNV_R_R_Def_i_uw_q_634_CM 6 -200. 5042.8 /end AXIS_DESCR
/end CHARACTERISTIC
/begin CHARACTERISTIC KF_PMRIBAT3 "Kennfeld Innenwiderstand Batterie3" MAP 0xa0824c94 _REC_MAP_52_u1_s2_u2 0.255 _CNV_R_R_Def_f_ub_q_745_CM 0. 0.255
 /begin AXIS_DESCR STD_AXIS T_batt _CNV_R_R_Def_t_sw_q_578_CM 4 -3276.8 3276.7 FORMAT "%4.1" /end AXIS_DESCR
 /begin AXIS_DESCR STD_AXIS I_batt _CNV_R_R_Def_i_uw_q_634_CM 6 -200. 5042.8 /end AXIS_DESCR
/end CHARACTERISTIC
/begin CHARACTERISTIC KF_PMRIBAT4 "Kennfeld Innenwiderstand Batterie4" MAP 0xa0824cc4 _REC_MAP_52_u1_s2_u2 0.255 _CNV_R_R_Def_f_ub_q_745_CM 0. 0.255
 /begin AXIS_DESCR STD_AXIS T_batt _CNV_R_R_Def_t_sw_q_578_CM 4 -3276.8 3276.7 FORMAT "%4.1" /end AXIS_DESCR
 /begin AXIS_DESCR STD_AXIS I_batt _CNV_R_R_Def_i_uw_q_634_CM 6 -200. 5042.8 /end AXIS_DESCR
/end CHARACTERISTIC
/begin CHARACTERISTIC KF_PMRIBAT5 "Kennfeld Innenwiderstand Batterie5" MAP 0xa0824c64 _REC_MAP_52_u1_s2_u2 0.255 _CNV_R_R_Def_f_ub_q_745_CM 0. 0.255
 /begin AXIS_DESCR STD_AXIS T_batt _CNV_R_R_Def_t_sw_q_578_CM 4 -3276.8 3276.7 FORMAT "%4.1" /end AXIS_DESCR
 /begin AXIS_DESCR STD_AXIS I_batt _CNV_R_R_Def_i_uw_q_634_CM 6 -200. 5042.8 /end AXIS_DESCR
/end CHARACTERISTIC
/begin CHARACTERISTIC KF_PMRIBAT6 "Kennfeld Innenwiderstand Batterie6" MAP 0xa0824c34 _REC_MAP_52_u1_s2_u2 0.255 _CNV_R_R_Def_f_ub_q_745_CM 0. 0.255
 /begin AXIS_DESCR STD_AXIS T_batt _CNV_R_R_Def_t_sw_q_578_CM 4 -3276.8 3276.7 FORMAT "%4.1" /end AXIS_DESCR
 /begin AXIS_DESCR STD_AXIS I_batt _CNV_R_R_Def_i_uw_q_634_CM 6 -200. 5042.8 /end AXIS_DESCR
/end CHARACTERISTIC
/begin CHARACTERISTIC KF_PMRIBAT7 "Kennfeld Innenwiderstand Batterie7" MAP 0xa0824d54 _REC_MAP_52_u1_s2_u2 0.255 _CNV_R_R_Def_f_ub_q_745_CM 0. 0.255
 /begin AXIS_DESCR STD_AXIS T_batt _CNV_R_R_Def_t_sw_q_578_CM 4 -3276.8 3276.7 FORMAT "%4.1" /end AXIS_DESCR
 /begin AXIS_DESCR STD_AXIS I_batt _CNV_R_R_Def_i_uw_q_634_CM 6 -200. 5042.8 /end AXIS_DESCR
/end CHARACTERISTIC
/begin CHARACTERISTIC KF_PMRIBAT8 "Kennfeld Innenwiderstand Batterie8" MAP 0xa0824c04 _REC_MAP_52_u1_s2_u2 0.255 _CNV_R_R_Def_f_ub_q_745_CM 0. 0.255
 /begin AXIS_DESCR STD_AXIS T_batt _CNV_R_R_Def_t_sw_q_578_CM 4 -3276.8 3276.7 FORMAT "%4.1" /end AXIS_DESCR
 /begin AXIS_DESCR STD_AXIS I_batt _CNV_R_R_Def_i_uw_q_634_CM 6 -200. 5042.8 /end AXIS_DESCR
/end CHARACTERISTIC
/begin CHARACTERISTIC KF_SOC0UBIB "" MAP 0xa0824bb8 _REC_MAP_52_UBYTE_u2_u2_s2 95.442256 _CNV_R_R_Def_ql_uw__577_CM 0. 1193.0282
 /begin AXIS_DESCR STD_AXIS Ubatt0 _CNV_R_R_Def_u_uw_q_700_CM 3 6. 22.3837 FORMAT "%7.4" /end AXIS_DESCR
 /begin AXIS_DESCR STD_AXIS Isoc0loc _CNV_R_R_Def_i_sw_q_640_CM 5 -655.36 655.34 /end AXIS_DESCR
/end CHARACTERISTIC
/begin CHARACTERISTIC KF_SOCLF "Ladefaktor in Abhängigkeit von Temperatur und Ladezustand" MAP 0xa0824ba0 _REC_MAP_52_u1_s2_u2 3.9686 _CNV_R_R_Def_f_ub_b_632_CM 1.57e-002 3.9843 FORMAT "%5.2"
 /begin AXIS_DESCR STD_AXIS T_batt _CNV_R_R_Def_t_sw_q_578_CM 3 -3276.8 3276.7 FORMAT "%4.1" /end AXIS_DESCR
 /begin AXIS_DESCR STD_AXIS Soc_b_loc _CNV_R_R_Def_ql_uw__577_CM 3 0. 1192.7502 /end AXIS_DESCR
/end CHARACTERISTIC
/begin CHARACTERISTIC KF_UBATT_LL "Kennfeld Bestimmung Batterieleerlaufspg" MAP 0xa08253d0 _REC_MAP_52_u1_u1_s2 25.5 _CNV_R_R_Def_u_ub_q_631_CM 0. 25.5 FORMAT "%5.2"
 /begin AXIS_DESCR STD_AXIS NO_INPUT_QUANTITY _CNV_R_R_Def_f_ub_b_586_CM 4 0. 99.60930000000001 FORMAT "%5.2" /end AXIS_DESCR
 /begin AXIS_DESCR STD_AXIS T_batt _CNV_R_R_Def_t_sw_q_578_CM 4 -3276.8 3276.7 FORMAT "%4.1" /end AXIS_DESCR
/end CHARACTERISTIC
/begin CHARACTERISTIC KF_USOLL "Batteriesollspannung aufgrund der Temperatur und soc." MAP 0xa082539c _REC_MAP_52_UBYTE_u2_s2_u2 16.3837 _CNV_R_R_Def_u_uw_q_700_CM 6. 22.3837 FORMAT "%7.4"
 /begin AXIS_DESCR STD_AXIS T_batt _CNV_R_R_Def_t_sw_q_578_CM 4 -3276.8 3276.7 FORMAT "%4.1" /end AXIS_DESCR
 /begin AXIS_DESCR STD_AXIS Soc_rel _CNV_R_R_Def_f_uw_b_555_CM 4 0. 99.9984 /end AXIS_DESCR
/end CHARACTERISTIC
/begin CHARACTERISTIC KL_BATTLSTR "Geschwindigkeitsfaktor Batterieumgebungstemperatur" CURVE 0xa08252b8 _REC_CUR_TKL_UW_VV__u2_u2 99.83844000000001 _CNV_R_R_Def_f_uw_b_621_CM 0. 255.996
 /begin AXIS_DESCR STD_AXIS NO_INPUT_QUANTITY _CNV_R_R_Def_v_uw_q_726_CM 6 0. 360. FORMAT "%5.0" /end AXIS_DESCR
/end CHARACTERISTIC
/begin CHARACTERISTIC KL_CLASS2IND "Batterieklasse -> Batterieindex" CURVE 0xa082484c _REC_CUR_TKL_UW_VV__u1_u1 99.45 _CNV_R_R_Def_dez_sl_551_CM 0. 255. FORMAT "%3.0"
 /begin AXIS_DESCR STD_AXIS Batt_class _CNV_R_R_Def_dez_sl_551_CM 8 0. 255. FORMAT "%3.0" /end AXIS_DESCR
/end CHARACTERISTIC
/begin CHARACTERISTIC KL_CLASS2NENN "Batterieklasse -> Batteriegroesse" CURVE 0xa08247e4 _REC_CUR_TKL_UW_VV__u1_u1 99.45 _CNV_R_R_Def_ql_ub__573_CM 0. 255. FORMAT "%4.1"
 /begin AXIS_DESCR STD_AXIS Batt_class _CNV_R_R_Def_dez_sl_551_CM 8 0. 255. FORMAT "%3.0" /end AXIS_DESCR
/end CHARACTERISTIC
/begin CHARACTERISTIC KL_DFPRIO "Dffgen Prio Übersetzer" CURVE 0xa0824a54 _REC_CUR_TKL_UW_VV__s2_u1 100. _CNV_R_R_Def_f_sw_p_557_CM -100. 100. FORMAT "%5.2"
 /begin AXIS_DESCR STD_AXIS Dfpt1filt _CNV_R_R_Def_f_ub_b_586_CM 6 0. 99.60930000000001 FORMAT "%5.2" /end AXIS_DESCR
/end CHARACTERISTIC
/begin CHARACTERISTIC KL_DFPTC "Gefiltertes dffgen -> Prio_Gewichtung -Übersetzer" CURVE 0xa08249e8 _REC_CUR_TKL_UW_VV__s2_u1 100. _CNV_R_R_Def_f_sw_p_557_CM -100. 100. FORMAT "%5.2"
 /begin AXIS_DESCR STD_AXIS Dfpt1ptc _CNV_R_R_Def_f_ub_b_586_CM 6 0. 99.60930000000001 FORMAT "%5.2" /end AXIS_DESCR
/end CHARACTERISTIC
/begin CHARACTERISTIC KL_DSOCPRIO "Kein Langbezeichner vergeben" CURVE 0xa0824af8 _REC_CUR_TKL_UW_VV__u2_s2 102.39842 _CNV_R_R_Def_f_uw_b_626_CM 0. 511.9921 /begin AXIS_DESCR STD_AXIS D_soc _CNV_R_R_Def_f_sw_b_570_CM 5 -100. 99.9969 /end AXIS_DESCR /end CHARACTERISTIC
/begin CHARACTERISTIC KL_DSOCPTC "Kennlinie dsoc auf PTC-Ansteuerung Übersetzer" CURVE 0xa0824ac8 _REC_CUR_TKL_UW_VV__s2_s2 99. _CNV_R_R_Def_f_sw_p_557_CM -150. 150. FORMAT "%5.2" /begin AXIS_DESCR STD_AXIS D_soc _CNV_R_R_Def_f_sw_b_570_CM 4 -100. 99.9969 /end AXIS_DESCR /end CHARACTERISTIC
/begin CHARACTERISTIC KL_DUDTPTC "Übersetzer dudtmul -> PTC Add. Gewichtung" CURVE 0xa0824ab0 _REC_CUR_TKL_UW_VV__u2_s2 99. _CNV_R_R_Def_f_sw_p_557_CM 0. 550.
 /begin AXIS_DESCR STD_AXIS Dudtmul _CNV_R_R_Def_f_sw_q_602_CM 5 -48.2304 48.2289 FORMAT "%7.4" /end AXIS_DESCR
/end CHARACTERISTIC
/begin CHARACTERISTIC KL_ENTLADEZ "KEnnfeld Bestimmung Ladezeit" CURVE 0xa0825274 _REC_CUR_TKL_UW_VV__u2_u1 131.07 _CNV_R_R_Def_td_ub__574_CM 0. 6553.5 FORMAT "%4.1"
 /begin AXIS_DESCR STD_AXIS Zentlact _CNV_R_R_Def_td_ub__574_CM 4 0. 25.5 FORMAT "%4.1" /end AXIS_DESCR
/end CHARACTERISTIC
/begin CHARACTERISTIC KL_EXPALH "Funktion EXP(-ALPHA*tabst_w) hinten" CURVE 0xa0825240 _REC_CUR_TKL_UW_VV__u2_u2 0.9999847412109381 _CNV_R_R_Def_f_uw_b_571_CM 0. 0.9999847412109381 FORMAT "%14.5"
 /begin AXIS_DESCR STD_AXIS NO_INPUT_QUANTITY _CNV_R_R_Def_dez_sl_551_CM 12 0. 65535. FORMAT "%5.0" /end AXIS_DESCR
/end CHARACTERISTIC
/begin CHARACTERISTIC KL_EXPALV "Funktion EXP(-ALPHA*tabst_w) hinten" CURVE 0xa08252d4 _REC_CUR_TKL_UW_VV__u2_u2 0.9999847412109381 _CNV_R_R_Def_f_uw_b_571_CM 0. 0.9999847412109381 FORMAT "%14.5"
 /begin AXIS_DESCR STD_AXIS Tn_abstell _CNV_R_R_Def_dez_sl_551_CM 12 0. 65535. FORMAT "%5.0" /end AXIS_DESCR
/end CHARACTERISTIC
/begin CHARACTERISTIC KL_EXPBETAV "Funktion EXP (-BETA*tabst_w)" CURVE 0xa0825284 _REC_CUR_TKL_UW_VV__u2_u2 0.9999847412109381 _CNV_R_R_Def_f_uw_b_571_CM 0. 0.9999847412109381 FORMAT "%14.5"
 /begin AXIS_DESCR STD_AXIS NO_INPUT_QUANTITY _CNV_R_R_Def_dez_sl_551_CM 12 0. 65535. FORMAT "%5.0" /end AXIS_DESCR
/end CHARACTERISTIC
/begin CHARACTERISTIC KL_FITGRZ "Grenzwert für soc_fit" CURVE 0xa0824db4 _REC_CUR_TKL_UW_VV__u2_s2 99.9984 _CNV_R_R_Def_f_uw_b_555_CM 0. 99.9984
 /begin AXIS_DESCR STD_AXIS T_saison _CNV_R_R_Def_t_sw_q_578_CM 4 -3276.8 3276.7 FORMAT "%4.1" /end AXIS_DESCR
/end CHARACTERISTIC
/begin CHARACTERISTIC KL_I2PTC "I-Delta Übersetzer zu PTC Ansteuerung" CURVE 0xa0824988 _REC_CUR_TKL_UW_VV__s2_u2 100. _CNV_R_R_Def_f_sw_p_557_CM -100. 100. FORMAT "%5.2"
 /begin AXIS_DESCR STD_AXIS Isolldiff _CNV_R_R_Def_i_uw_q_634_CM 6 -200. 5042.8 /end AXIS_DESCR
/end CHARACTERISTIC
/begin CHARACTERISTIC KL_IREST "Noch verfuegbare Restleistung vom Generator." CURVE 0xa0824a84 _REC_CUR_TKL_UW_VV__s2_u2 100. _CNV_R_R_Def_f_sw_p_557_CM -100. 100. FORMAT "%5.2"
 /begin AXIS_DESCR STD_AXIS Pgenrest _CNV_R_R_Def_f_sw_p_557_CM 10 0. 16383.75 /end AXIS_DESCR
/end CHARACTERISTIC
/begin CHARACTERISTIC KL_ISOLLPR "Delta-I -> Prio Übersetzer" CURVE 0xa0824adc _REC_CUR_TKL_UW_VV__s2_u2 100. _CNV_R_R_Def_f_sw_p_557_CM -100. 100. FORMAT "%5.2" /begin AXIS_DESCR STD_AXIS Ibtdiff _CNV_R_R_Def_i_uw_q_634_CM 6 -200. 5042.8 /end AXIS_DESCR /end CHARACTERISTIC
/begin CHARACTERISTIC KL_ITNSTART "Startspannung abh. vom Itnstart" CURVE 0xa0824e30 _REC_CUR_TKL_UW_VV__u2_u1 16.3837 _CNV_R_R_Def_u_uw_q_700_CM 6. 22.3837 FORMAT "%7.4"
 /begin AXIS_DESCR STD_AXIS NO_INPUT_QUANTITY _CNV_R_R_Def_i_ub_b_748_CM 4 0. 996.0937 /end AXIS_DESCR
/end CHARACTERISTIC
/begin CHARACTERISTIC KL_ITNSTRMSA "bei MSA-STarter: Startspannung abh. vom Itnstart" CURVE 0xa0824e14 _REC_CUR_TKL_UW_VV__u2_u1 16.3837 _CNV_R_R_Def_u_uw_q_700_CM 6. 22.3837 FORMAT "%7.4"
 /begin AXIS_DESCR STD_AXIS NO_INPUT_QUANTITY _CNV_R_R_Def_i_ub_b_748_CM 4 0. 996.0937 /end AXIS_DESCR
/end CHARACTERISTIC
/begin CHARACTERISTIC KL_LADEKENNL "Batterieladespannungskennlinie" CURVE 0xa0825224 _REC_CUR_TKL_UW_VV__s2_s2 99.83688000000001 _CNV_R_R_Def_u_sw_b_581_CM 0. 127.996
 /begin AXIS_DESCR STD_AXIS T_battabst _CNV_R_R_Def_t_sw_q_578_CM 6 -3276.8 3276.7 FORMAT "%4.1" /end AXIS_DESCR
/end CHARACTERISTIC
/begin CHARACTERISTIC KL_PMSOCVU "SoC-Wert aus der Fitberechnung" CURVE 0xa0824bf4 _REC_CUR_TKL_UW_VV__u2_u2 99.9984 _CNV_R_R_Def_f_uw_b_555_CM 0. 99.9984
 /begin AXIS_DESCR STD_AXIS Ubatts2 _CNV_R_R_Def_u_uw_q_700_CM 3 6. 22.3837 FORMAT "%7.4" /end AXIS_DESCR
/end CHARACTERISTIC
/begin CHARACTERISTIC KL_PRIO2PTC "Gewichtung der Prios auf Gewichtung fuer PTC Ansteuerung" CURVE 0xa0824a28 _REC_CUR_TKL_UW_VV__s2_u2 100. _CNV_R_R_Def_f_sw_p_557_CM -100. 100. FORMAT "%5.2" /begin AXIS_DESCR STD_AXIS Dfprio _CNV_R_R_Def_f_sw_p_557_CM 5 0. 16383.75 /end AXIS_DESCR /end CHARACTERISTIC
/begin CHARACTERISTIC KL_PRIOCF "Kein Langbezeichner vergeben" CURVE 0xa08249a4 _REC_CUR_TKL_UW_VV__u1_s2 6. _CNV_R_R_Def_dez_sl_551_CM 0. 6. FORMAT "%3.0"
 /begin AXIS_DESCR STD_AXIS Dsoc2pi _CNV_R_R_Def_f_sw_p_557_CM 7 -8192. 8191.75 FORMAT "%5.2" /end AXIS_DESCR
/end CHARACTERISTIC
/begin CHARACTERISTIC KL_PRIODF "Kein Langbezeichner vergeben" CURVE 0xa0824b10 _REC_CUR_TKL_UW_VV__u1_u2 6. _CNV_R_R_Def_dez_sl_551_CM 0. 6. FORMAT "%3.0" /begin AXIS_DESCR STD_AXIS Dfprio _CNV_R_R_Def_f_sw_p_557_CM 7 0. 16383.75 /end AXIS_DESCR /end CHARACTERISTIC
/begin CHARACTERISTIC KL_PTC "PWM-Übersetzer für PTC-Ansteuerung" CURVE 0xa0824974 _REC_CUR_TKL_UW_VV__u1_u2 99.45 _CNV_R_R_Def_f_ub_b_575_CM 0. 127.5 FORMAT "%5.2"
 /begin AXIS_DESCR STD_AXIS Allptcfilt _CNV_R_R_Def_f_sw_p_557_CM 5 0. 16383.75 /end AXIS_DESCR
/end CHARACTERISTIC
/begin CHARACTERISTIC KL_PWRCF "Kein Langbezeichner vergeben" CURVE 0xa08249bc _REC_CUR_TKL_UW_VV__u1_s2 6. _CNV_R_R_Def_dez_sl_551_CM 0. 6. FORMAT "%3.0"
 /begin AXIS_DESCR STD_AXIS Dsoc2pi _CNV_R_R_Def_f_sw_p_557_CM 7 -8192. 8191.75 FORMAT "%5.2" /end AXIS_DESCR
/end CHARACTERISTIC
/begin CHARACTERISTIC KL_PWRDF "Kein Langbezeichner vergeben" CURVE 0xa08249fc _REC_CUR_TKL_UW_VV__u1_u2 13. _CNV_R_R_Def_dez_sl_551_CM 0. 13. FORMAT "%3.0" /begin AXIS_DESCR STD_AXIS Dfprio _CNV_R_R_Def_f_sw_p_557_CM 14 0. 16383.75 /end AXIS_DESCR /end CHARACTERISTIC
/begin CHARACTERISTIC KL_SOC0TEMP "Temperaturabhängige Stromkorrektur für Ruhespannungsmessung" CURVE 0xa0824b8c _REC_CUR_TKL_UW_VV__u1_s2 1.9921 _CNV_R_R_Def_f_ub_b_613_CM 0. 1.9921
 /begin AXIS_DESCR STD_AXIS Tsocloc _CNV_R_R_Def_t_sw_q_578_CM 5 -3276.8 3276.7 FORMAT "%4.1" /end AXIS_DESCR
/end CHARACTERISTIC
/begin CHARACTERISTIC KL_SOCPRIO "dsoc -> Prio Übersetzer" CURVE 0xa0824a40 _REC_CUR_TKL_UW_VV__s2_s2 99. _CNV_R_R_Def_f_sw_p_557_CM -150. 150. FORMAT "%5.2" /begin AXIS_DESCR STD_AXIS D_soc _CNV_R_R_Def_f_sw_b_570_CM 4 -100. 99.9969 /end AXIS_DESCR /end CHARACTERISTIC
/begin CHARACTERISTIC KL_SSOC "soc_s in Abh. von tsaison" CURVE 0xa0824dc8 _REC_CUR_TKL_UW_VV__u2_s2 99.9984 _CNV_R_R_Def_f_uw_b_555_CM 0. 99.9984
 /begin AXIS_DESCR STD_AXIS T_saison _CNV_R_R_Def_t_sw_q_578_CM 4 -3276.8 3276.7 FORMAT "%4.1" /end AXIS_DESCR
/end CHARACTERISTIC
/begin CHARACTERISTIC KL_SSOC_DIF "temperaturabhängige Differenzkennlinie zwischen der oberen und unteren Startfähigkeitskennlinie" CURVE 0xa0824938 _REC_CUR_TKL_UW_VV__u2_s2 99.9984 _CNV_R_R_Def_f_uw_b_555_CM 0. 99.9984
 /begin AXIS_DESCR STD_AXIS T_saison _CNV_R_R_Def_t_sw_q_578_CM 7 -3276.8 3276.7 FORMAT "%4.1" /end AXIS_DESCR
/end CHARACTERISTIC
/begin CHARACTERISTIC KL_T2RELMAX "Max Toleranzzeit von T2" CURVE 0xa0824814 _REC_CUR_TKL_UW_VV__u2_u2 0. _CNV_R_R_Def_td_uw__709_CM 0. 917490. FORMAT "%5.2"
 /begin AXIS_DESCR STD_AXIS T_histsum _CNV_R_R_Def_td_uw__711_CM 6 0. 3669960. FORMAT "%5.2" /end AXIS_DESCR
/end CHARACTERISTIC
/begin CHARACTERISTIC KL_T2RELMXRG "Max Toleranzzeit von T2 Ringshift" CURVE 0xa08247f8 _REC_CUR_TKL_UW_VV__u2_u2 0. _CNV_R_R_Def_td_uw__709_CM 0. 917490. FORMAT "%5.2"
 /begin AXIS_DESCR STD_AXIS T_histsum _CNV_R_R_Def_td_uw__711_CM 6 0. 3669960. FORMAT "%5.2" /end AXIS_DESCR
/end CHARACTERISTIC
/begin CHARACTERISTIC KL_T3RELMAX "Max Toleranzzeit von T3" CURVE 0xa0824830 _REC_CUR_TKL_UW_VV__u2_u2 0. _CNV_R_R_Def_td_uw__709_CM 0. 917490. FORMAT "%5.2"
 /begin AXIS_DESCR STD_AXIS T_histsum _CNV_R_R_Def_td_uw__711_CM 6 0. 3669960. FORMAT "%5.2" /end AXIS_DESCR
/end CHARACTERISTIC
/begin CHARACTERISTIC KL_T3RELMXRG "Max Toleranzzeit von T3 Ringshift" CURVE 0xa0824860 _REC_CUR_TKL_UW_VV__u2_u2 0. _CNV_R_R_Def_td_uw__709_CM 0. 917490. FORMAT "%5.2"
 /begin AXIS_DESCR STD_AXIS T_histsum _CNV_R_R_Def_td_uw__711_CM 6 0. 3669960. FORMAT "%5.2" /end AXIS_DESCR
/end CHARACTERISTIC
/begin CHARACTERISTIC KL_T4RELMAX "Max Toleranzzeit von T4" CURVE 0xa082487c _REC_CUR_TKL_UW_VV__u2_u2 0. _CNV_R_R_Def_td_uw__709_CM 0. 917490. FORMAT "%5.2"
 /begin AXIS_DESCR STD_AXIS T_histsum _CNV_R_R_Def_td_uw__711_CM 6 0. 3669960. FORMAT "%5.2" /end AXIS_DESCR
/end CHARACTERISTIC
/begin CHARACTERISTIC KL_T4RELMXRG "Max Toleranzzeit von T4 Ringshift" CURVE 0xa08247c8 _REC_CUR_TKL_UW_VV__u2_u2 0. _CNV_R_R_Def_td_uw__709_CM 0. 917490. FORMAT "%5.2"
 /begin AXIS_DESCR STD_AXIS T_histsum _CNV_R_R_Def_td_uw__711_CM 6 0. 3669960. FORMAT "%5.2" /end AXIS_DESCR
/end CHARACTERISTIC
/begin CHARACTERISTIC KL_UBSOLLTR "Sollspannung bei Transportmodus aktiv" CURVE 0xa08253f8 _REC_CUR_TKL_UW_VV__u1_s2 25.5 _CNV_R_R_Def_u_ub_q_631_CM 0. 25.5 FORMAT "%5.2"
 /begin AXIS_DESCR STD_AXIS T_batt _CNV_R_R_Def_t_sw_q_578_CM 4 -3276.8 3276.7 FORMAT "%4.1" /end AXIS_DESCR
/end CHARACTERISTIC
/begin CHARACTERISTIC KL_UBTMTL "Kennlinie einzuhaltende mittlere Spannung" CURVE 0xa0825308 _REC_CUR_TKL_UW_VV__u1_s2 25.5 _CNV_R_R_Def_u_ub_q_631_CM 0. 25.5 FORMAT "%5.2"
 /begin AXIS_DESCR STD_AXIS T_batt _CNV_R_R_Def_t_sw_q_578_CM 6 -3276.8 3276.7 FORMAT "%4.1" /end AXIS_DESCR
/end CHARACTERISTIC
/begin CHARACTERISTIC KL_UBTPRIO "Delta-Spannung -> Prio Übersetzer" CURVE 0xa0824a68 _REC_CUR_TKL_UW_VV__s2_s2 100. _CNV_R_R_Def_f_sw_p_557_CM -100. 100. FORMAT "%5.2"
 /begin AXIS_DESCR STD_AXIS Ubdiffilt _CNV_R_R_Def_f_sw_b_556_CM 6 -32. 31.999 FORMAT "%7.4" /end AXIS_DESCR
/end CHARACTERISTIC
/begin CHARACTERISTIC KL_UB_PTC "UBatt-Kennlinie für Ansteuerung PTC" CURVE 0xa0824958 _REC_CUR_TKL_UW_VV__s2_s2 100. _CNV_R_R_Def_f_sw_p_557_CM -100. 100. FORMAT "%5.2"
 /begin AXIS_DESCR STD_AXIS Ubtpt1ptc _CNV_R_R_Def_f_sw_b_556_CM 6 -32. 31.999 FORMAT "%7.4" /end AXIS_DESCR
/end CHARACTERISTIC
/begin CHARACTERISTIC KL_UNSTART "Startspannung abhängig v.Motordrehzahl" CURVE 0xa0824df4 _REC_CUR_TKL_UW_VV__u2_s2 16.3837 _CNV_R_R_Def_u_uw_q_700_CM 6. 22.3837 FORMAT "%7.4"
 /begin AXIS_DESCR STD_AXIS Nnmstart _CNV_R_R_Def_n_sw_q_595_CM 2 -32768. 32767. FORMAT "%5.0" /end AXIS_DESCR
/end CHARACTERISTIC
/begin CHARACTERISTIC KL_UNSTRTMSA "für MSA-Starter: Startspannung abhängig v.Motordrehzahl" CURVE 0xa0824e24 _REC_CUR_TKL_UW_VV__u2_s2 16.3837 _CNV_R_R_Def_u_uw_q_700_CM 6. 22.3837 FORMAT "%7.4"
 /begin AXIS_DESCR STD_AXIS Nnmstart _CNV_R_R_Def_n_sw_q_595_CM 2 -32768. 32767. FORMAT "%5.0" /end AXIS_DESCR
/end CHARACTERISTIC
/begin CHARACTERISTIC KL_USOLL2 "Batteriesollspannung aufgrund von tbatt" CURVE 0xa0825408 _REC_CUR_TKL_UW_VV__u1_s2 25.5 _CNV_R_R_Def_u_ub_q_631_CM 0. 25.5 FORMAT "%5.2"
 /begin AXIS_DESCR STD_AXIS T_batt _CNV_R_R_Def_t_sw_q_578_CM 4 -3276.8 3276.7 FORMAT "%4.1" /end AXIS_DESCR
/end CHARACTERISTIC
/begin CHARACTERISTIC KL_UTSTART "Startspannung in Abhängigkeit von Temperatur Batterie" CURVE 0xa0824e40 _REC_CUR_TKL_UW_VV__s2_s2 16.3837 _CNV_R_R_Def_u_sw_q_722_CM -8.192 8.191700000000001 FORMAT "%7.4"
 /begin AXIS_DESCR STD_AXIS T_batt _CNV_R_R_Def_t_sw_q_578_CM 4 -3276.8 3276.7 FORMAT "%4.1" /end AXIS_DESCR
/end CHARACTERISTIC
/begin CHARACTERISTIC KL_UTSTRTMSA "bei MSA Starter: Startspannung in Abhängigkeit von Temperatur Batterie" CURVE 0xa0824e00 _REC_CUR_TKL_UW_VV__s2_s2 16.3837 _CNV_R_R_Def_u_sw_q_722_CM -8.192 8.191700000000001 FORMAT "%7.4"
 /begin AXIS_DESCR STD_AXIS T_batt _CNV_R_R_Def_t_sw_q_578_CM 4 -3276.8 3276.7 FORMAT "%4.1" /end AXIS_DESCR
/end CHARACTERISTIC
/begin CHARACTERISTIC KL_WSOCLOW "Wichtung SoC Low Zustand" CURVE 0xa0825434 _REC_CUR_TKL_UW_VV__u1_u2 1.9921 _CNV_R_R_Def_f_ub_b_613_CM 0. 1.9921 /begin AXIS_DESCR STD_AXIS Soc_rel _CNV_R_R_Def_f_uw_b_555_CM 4 0. 99.9984 /end AXIS_DESCR /end CHARACTERISTIC
/begin CHARACTERISTIC KL_WUBPTC "KL Multiplikationsfaktor W_ub bei SpgEinbruch" CURVE 0xa08249d4 _REC_CUR_TKL_UW_VV__u1_u2 3.9843 _CNV_R_R_Def_f_ub_b_632_CM 0. 3.9843 FORMAT "%5.2"
 /begin AXIS_DESCR STD_AXIS Ub _CNV_R_R_Def_u_sb_q_583_CM 5 0. 6173.397 FORMAT "%4.1" /end AXIS_DESCR
/end CHARACTERISTIC
/begin CHARACTERISTIC K_ABKORROVER "schlechter absch_korr Schwelle ueberschritten" VALUE 0xa082477c _REC_VAL_20_s2 99.9984 _CNV_R_R_Def_f_sw_q_550_CM -50. 49.9984 /end CHARACTERISTIC
/begin CHARACTERISTIC K_ABSCHKORA "Applikationswert für Korrektur Abschaltung" VALUE 0xa0824d84 _REC_VAL_20_s2 99.9984 _CNV_R_R_Def_f_sw_q_550_CM -50. 49.9984 /end CHARACTERISTIC
/begin CHARACTERISTIC K_APPTBATINI "Enable Applikation Initwert Batterietemperatur" VALUE 0xa08251f7 _REC_VAL_20_u1 99.45 _CNV_R_R_Def_dez_sl_551_CM 0. 255. FORMAT "%3.0" /end CHARACTERISTIC
/begin CHARACTERISTIC K_BATTCNENN1 "Parameter für Erkennung AGM durch Vergleich mit C_battnenn (Reserve)" VALUE 0xa08253ee _REC_VAL_20_u1 99.45 _CNV_R_R_Def_dez_sl_551_CM 0. 255. FORMAT "%3.0" /end CHARACTERISTIC
/begin CHARACTERISTIC K_BATTCNENN2 "Parameter für Erkennung AGM durch Vergleich mit C_battnenn (Reserve)" VALUE 0xa08253ef _REC_VAL_20_u1 99.45 _CNV_R_R_Def_dez_sl_551_CM 0. 255. FORMAT "%3.0" /end CHARACTERISTIC
/begin CHARACTERISTIC K_BATTHTAUVG "Zeitkonstante Batterie hinten bei VFZG>" VALUE 0xa08251d8 _REC_VAL_20_u2 0.9999847412109381 _CNV_R_R_Def_f_uw_b_571_CM 0. 0.9999847412109381 FORMAT "%14.5" /end CHARACTERISTIC
/begin CHARACTERISTIC K_BATTHTAUVK "Zeitkonstante Batterie hinten bei VFZG<" VALUE 0xa08251da _REC_VAL_20_u2 0.9999847412109381 _CNV_R_R_Def_f_uw_b_571_CM 0. 0.9999847412109381 FORMAT "%14.5" /end CHARACTERISTIC
/begin CHARACTERISTIC K_BATTINDAPP "batt_index appl." VALUE 0xa082479f _REC_VAL_20_u1 99.45 _CNV_R_R_Def_dez_sl_551_CM 0. 255. FORMAT "%3.0" /end CHARACTERISTIC
/begin CHARACTERISTIC K_BATTMXOFF "Deaktivierung Freigabe Batteriemaximalgrenze" VALUE 0xa08251f8 _REC_VAL_20_u1 1. _CNV_R_R_Def_dez_sl_551_CM 0. 1. FORMAT "%3.0" /end CHARACTERISTIC
/begin CHARACTERISTIC K_BATTNORM "zur Normierung des Kapazitätsverlusts" VALUE 0xa0825418 _REC_VAL_20_u1 99.45 _CNV_R_R_Def_dez_ub_685_CM 0. 127.5 /end CHARACTERISTIC
/begin CHARACTERISTIC K_BATTORT0 "Batterieeinbauort No1" VALUE 0xa08251f9 _REC_VAL_20_u1 99.45 _CNV_R_R_Def_dez_sl_551_CM 0. 255. FORMAT "%3.0" /end CHARACTERISTIC
/begin CHARACTERISTIC K_BATTORT2 "Batterieeinbauort No2" VALUE 0xa08251fa _REC_VAL_20_u1 2. _CNV_R_R_Def_dez_sl_551_CM 0. 2. FORMAT "%3.0" /end CHARACTERISTIC
/begin CHARACTERISTIC K_BATTREGAPP "Batterietauschregristrieren App" VALUE 0xa08247a0 _REC_VAL_20_u1 99.45 _CNV_R_R_Def_dez_sl_551_CM 0. 255. FORMAT "%3.0" /end CHARACTERISTIC
/begin CHARACTERISTIC K_BATTREGINI "manuelle Neuinitialisierung Regenerationsmodul" VALUE 0xa0825420 _REC_VAL_20_u1 1. _CNV_R_R_Def_dez_sl_551_CM 0. 1. FORMAT "%3.0" /end CHARACTERISTIC
/begin CHARACTERISTIC K_BATTVTAUVG "Zeitkonstante Batterie vorne bei VFZG>" VALUE 0xa08251dc _REC_VAL_20_u2 0.9999847412109381 _CNV_R_R_Def_f_uw_b_571_CM 0. 0.9999847412109381 FORMAT "%14.5" /end CHARACTERISTIC
/begin CHARACTERISTIC K_BATTVTAUVK "Zeitkonstante Batterie bei VFZG<Zeitkonstante Batterie bei VFZG>" VALUE 0xa08251de _REC_VAL_20_u2 0.9999847412109381 _CNV_R_R_Def_f_uw_b_571_CM 0. 0.9999847412109381 FORMAT "%14.5" /end CHARACTERISTIC
/begin CHARACTERISTIC K_BATT_ALFAH "Alphatau-Wert Batterie hinten" VALUE 0xa08251e0 _REC_VAL_20_u2 0.9999694824218756 _CNV_R_R_Def_f_uw_b_571_CM 1.52587890625e-005 0.9999847412109381 FORMAT "%14.5" /end CHARACTERISTIC
/begin CHARACTERISTIC K_BATT_ALFAV "Alphatau-Wert Batterie vorne" VALUE 0xa08251e2 _REC_VAL_20_u2 0.9999694824218756 _CNV_R_R_Def_f_uw_b_571_CM 1.52587890625e-005 0.9999847412109381 FORMAT "%14.5" /end CHARACTERISTIC
/begin CHARACTERISTIC K_BATT_BETAV "Beta-Wert Batterie vorne" VALUE 0xa08251e4 _REC_VAL_20_u2 0.9999694824218756 _CNV_R_R_Def_f_uw_b_571_CM 1.52587890625e-005 0.9999847412109381 FORMAT "%14.5" /end CHARACTERISTIC
/begin CHARACTERISTIC K_BATVFZGTAU "VFZG-Umschaltschwelle TAU Batterie" VALUE 0xa08251e6 _REC_VAL_20_u2 0. _CNV_R_R_Def_v_uw_q_726_CM 0. 65535. FORMAT "%5.0" /end CHARACTERISTIC
/begin CHARACTERISTIC K_BILA_OGRZ "Grenzwert oberhalb dessen eine Apassung durch soc_kor nicht zulässig ist" VALUE 0xa0824d92 _REC_VAL_20_u2 99.9984 _CNV_R_R_Def_f_uw_b_555_CM 0. 99.9984 /end CHARACTERISTIC
/begin CHARACTERISTIC K_BILA_UGRZ "" VALUE 0xa0824d94 _REC_VAL_20_u2 99.9984 _CNV_R_R_Def_f_uw_b_555_CM 0. 99.9984 /end CHARACTERISTIC
/begin CHARACTERISTIC K_BUPACTRATE "Zeitinterval nach dem die Werte im Pmbackup-Array aktualisiert werden" VALUE 0xa08247a1 _REC_VAL_20_u1 25.5 _CNV_R_R_Def_td_ub__574_CM 0. 25.5 FORMAT "%4.1" /end CHARACTERISTIC
/begin CHARACTERISTIC K_CBATTAPP "Cbattnenn appl." VALUE 0xa08247a2 _REC_VAL_20_u1 99.45 _CNV_R_R_Def_ql_ub__573_CM 0. 255. FORMAT "%4.1" /end CHARACTERISTIC
/begin CHARACTERISTIC K_CCNOT "1= CC-Meldung Ruhestromverletzung wird bei unterer STFGKGrenze versandt; 2=CC-Meldung wird bei oberer Grenze versandt" VALUE 0xa08247a3 _REC_VAL_20_u1 99.45 _CNV_R_R_Def_dez_sl_551_CM 0. 255. FORMAT "%3.0" /end CHARACTERISTIC
/begin CHARACTERISTIC K_CCPRIOSET "Schwelle von E65Prios ab dem ccmeldung aktiv ist." VALUE 0xa08247a4 _REC_VAL_20_u1 7. _CNV_R_R_Def_dez_sl_551_CM 0. 7. FORMAT "%3.0" /end CHARACTERISTIC
/begin CHARACTERISTIC K_CCPRIOTIME "Zeitverschiebung bis ccmeldung gesetzt wird." VALUE 0xa08247a5 _REC_VAL_20_u1 25.5 _CNV_R_R_Def_td_ub__574_CM 0. 25.5 FORMAT "%4.1" /end CHARACTERISTIC
/begin CHARACTERISTIC K_CCPWRSET "ctrpwrcos Schwelle ab dem CC Meldung aktiviert wird. " VALUE 0xa0824786 _REC_VAL_20_u2 0. _CNV_R_R_Def_dez_sl_551_CM 0. 65535. FORMAT "%5.0" /end CHARACTERISTIC
/begin CHARACTERISTIC K_CTRCBRA "Kein Langbezeichner vergeben" VALUE 0xa08248ce _REC_VAL_20_u1 99.45 _CNV_R_R_Def_dez_sl_551_CM 0. 255. FORMAT "%3.0" /end CHARACTERISTIC
/begin CHARACTERISTIC K_CTRCBRAPP "Steuerung Stromzweige Applikationsgroesse" VALUE 0xa08248cf _REC_VAL_20_u1 99.45 _CNV_R_R_Def_dez_sl_551_CM 0. 255. FORMAT "%3.0" /end CHARACTERISTIC
/begin CHARACTERISTIC K_CTRPCOSAPP "Steuerung Standverbraucher Applikationsgroesse" VALUE 0xa08248d0 _REC_VAL_20_u1 3. _CNV_R_R_Def_dez_sl_551_CM 0. 3. FORMAT "%3.0" /end CHARACTERISTIC
/begin CHARACTERISTIC K_CTRPRIOAPP "Steuerung Spitzenreduzierung Prioritaet Applikationsgroesse" VALUE 0xa08248d1 _REC_VAL_20_u1 7. _CNV_R_R_Def_dez_sl_551_CM 0. 7. FORMAT "%3.0" /end CHARACTERISTIC
/begin CHARACTERISTIC K_CTRPRIOCF "Kein Langbezeichner vergeben" VAL_BLK 0xa0824928 _REC_VAL_2_u1 99.45 _CNV_R_R_Def_dez_sl_551_CM 0. 255. FORMAT "%3.0" NUMBER 7 /end CHARACTERISTIC
/begin CHARACTERISTIC K_CTRPWRCF "Kein Langbezeichner vergeben" VAL_BLK 0xa08248fc _REC_VAL_2_u2 0. _CNV_R_R_Def_dez_sl_551_CM 0. 65535. FORMAT "%5.0" NUMBER 7 /end CHARACTERISTIC
/begin CHARACTERISTIC K_CTRPWRDF "Kein Langbezeichner vergeben" VAL_BLK 0xa082490c _REC_VAL_2_u2 0. _CNV_R_R_Def_dez_sl_551_CM 0. 65535. FORMAT "%5.0" NUMBER 14 /end CHARACTERISTIC
/begin CHARACTERISTIC K_DAB_KORR1 "Korrekturkonstante 1 für Abschaltung" VALUE 0xa0824d86 _REC_VAL_20_s2 99.9984 _CNV_R_R_Def_f_sw_q_550_CM -50. 49.9984 /end CHARACTERISTIC
/begin CHARACTERISTIC K_DAB_KORR2 "Korrekturkonstante 2 für Abschaltung" VALUE 0xa0824d88 _REC_VAL_20_s2 99.9984 _CNV_R_R_Def_f_sw_q_550_CM -50. 49.9984 /end CHARACTERISTIC
/begin CHARACTERISTIC K_DAB_KORR3 "Korrekturkonstante 3 für Abschaltung" VALUE 0xa0824d8a _REC_VAL_20_s2 99.9984 _CNV_R_R_Def_f_sw_q_550_CM -50. 49.9984 /end CHARACTERISTIC
/begin CHARACTERISTIC K_DELTA1 "Entladung SpannungsHysterese" VALUE 0xa08251fb _REC_VAL_20_u1 25.5 _CNV_R_R_Def_u_ub_q_631_CM 0. 25.5 FORMAT "%5.2" /end CHARACTERISTIC
/begin CHARACTERISTIC K_DELTA2 "Entladung Spannungshysterese" VALUE 0xa08251fc _REC_VAL_20_u1 25.5 _CNV_R_R_Def_u_ub_q_631_CM 0. 25.5 FORMAT "%5.2" /end CHARACTERISTIC
/begin CHARACTERISTIC K_DFFILTAPP "Schalter, um dffgenfilt auf DFFILT_APP umzustellen" VALUE 0xa08248d2 _REC_VAL_20_u1 99.60930000000001 _CNV_R_R_Def_f_ub_b_586_CM 0. 99.60930000000001 FORMAT "%5.2" /end CHARACTERISTIC
/begin CHARACTERISTIC K_DFKOMMERR "Ersatzwert Dffgen bei Gen. Komm. Fehler" VALUE 0xa08248d3 _REC_VAL_20_u1 99.60930000000001 _CNV_R_R_Def_f_ub_b_586_CM 0. 99.60930000000001 FORMAT "%5.2" /end CHARACTERISTIC
/begin CHARACTERISTIC K_DFLLMIN "DF unterhalb derer die LLDZanh. zurueckgenommen wird." VALUE 0xa082474a _REC_VAL_20_u1 99.60930000000001 _CNV_R_R_Def_f_ub_b_586_CM 0. 99.60930000000001 FORMAT "%5.2" /end CHARACTERISTIC
/begin CHARACTERISTIC K_DFMAX "Obere Schwelle DF Signal" VALUE 0xa082474b _REC_VAL_20_u1 99.60930000000001 _CNV_R_R_Def_f_ub_b_586_CM 0. 99.60930000000001 FORMAT "%5.2" /end CHARACTERISTIC
/begin CHARACTERISTIC K_DFPTC_LP "K-Faktor des df-Tiefpass Filters zur Berechnung von PTC" VALUE 0xa08248d4 _REC_VAL_20_u1 0.996 _CNV_R_R_Def_f_ub_b_553_CM 0. 0.996 /end CHARACTERISTIC
/begin CHARACTERISTIC K_DF_LP "K-Faktor des df-Tiefpass Filters zur Berechnung von ctrpwrdf" VALUE 0xa08248d5 _REC_VAL_20_u1 0.996 _CNV_R_R_Def_f_ub_b_553_CM 0. 0.996 /end CHARACTERISTIC
/begin CHARACTERISTIC K_DIFFCBN "Differenzschwelle Batterie-Nenn-Kapazität (BZE)" VALUE 0xa0825421 _REC_VAL_20_u1 0.996 _CNV_R_R_Def_f_ub_b_553_CM 0. 0.996 /end CHARACTERISTIC
/begin CHARACTERISTIC K_DIF_TIABST "Max Differenz zwischen Summe aller Zeiten Ruhestromzeiten und Abstellzeit Tn_abstllm" VALUE 0xa0824d96 _REC_VAL_20_u2 0. _CNV_R_R_Def_tn_uw__664_CM 0. 65535. FORMAT "%5.2" /end CHARACTERISTIC
/begin CHARACTERISTIC K_DQ_AUSLOES "Kapazitätsabfall für Auslösung aktive Regeneration (bez auf Cnenn)" VALUE 0xa0825422 _REC_VAL_20_u1 31.875 _CNV_R_R_Def_f_ub_b_612_CM 0. 31.875 FORMAT "%5.2" /end CHARACTERISTIC
/begin CHARACTERISTIC K_DSOCA "Applikationsgrösse für d_soc" VALUE 0xa0824d8c _REC_VAL_20_s2 99.99844999999999 _CNV_R_R_Def_f_sw_b_570_CM -100. 99.9969 /end CHARACTERISTIC
/begin CHARACTERISTIC K_DSOCABSCH "Applikationsgrösse für d_soc" VALUE 0xa0824d8e _REC_VAL_20_s2 99.99844999999999 _CNV_R_R_Def_f_sw_b_570_CM -100. 99.9969 /end CHARACTERISTIC
/begin CHARACTERISTIC K_DSOCDELTA1 "Hysterese Bestimmung B_batt_bad D_Soc abh." VALUE 0xa08251bc _REC_VAL_20_s2 99.99844999999999 _CNV_R_R_Def_f_sw_b_570_CM -100. 99.9969 /end CHARACTERISTIC
/begin CHARACTERISTIC K_DSOCDELTA2 "Hysterese Bestimmung Batt_m2l" VALUE 0xa08251be _REC_VAL_20_s2 99.99844999999999 _CNV_R_R_Def_f_sw_b_570_CM -100. 99.9969 /end CHARACTERISTIC
/begin CHARACTERISTIC K_DSOCHYST "Hystereschwelle SOC" VALUE 0xa0824744 _REC_VAL_20_s2 99.99844999999999 _CNV_R_R_Def_f_sw_b_570_CM -100. 99.9969 /end CHARACTERISTIC
/begin CHARACTERISTIC K_DSOCHYSTCC "DSOC Hyst. fuer B_ccbtnach reset " VALUE 0xa082477e _REC_VAL_20_s2 99.99844999999999 _CNV_R_R_Def_f_sw_b_570_CM -100. 99.9969 /end CHARACTERISTIC
/begin CHARACTERISTIC K_DSOCLLANH "Abstand zur Stfgrz, bei der die LLDZanh aktiviert wird." VALUE 0xa0824746 _REC_VAL_20_s2 99.99844999999999 _CNV_R_R_Def_f_sw_b_570_CM -100. 99.9969 /end CHARACTERISTIC
/begin CHARACTERISTIC K_DSOCLOW "DSOC Grenze f. CCmeld Batt Nachladen" VALUE 0xa0824780 _REC_VAL_20_s2 99.99844999999999 _CNV_R_R_Def_f_sw_b_570_CM -100. 99.9969 /end CHARACTERISTIC
/begin CHARACTERISTIC K_DTANSKOR "Ansaugluftmodelloffset Aussentemperatur" VALUE 0xa08251c0 _REC_VAL_20_s2 131.07 _CNV_R_R_Def_t_sw_q_578_CM -3276.8 3276.7 FORMAT "%4.1" /end CHARACTERISTIC
/begin CHARACTERISTIC K_DUDTPTCAUS "K-Faktor für dudt-PTC Abschaltung" VALUE 0xa08248a0 _REC_VAL_20_u2 0.9999847412109381 _CNV_R_R_Def_f_uw_b_571_CM 0. 0.9999847412109381 FORMAT "%14.5" /end CHARACTERISTIC
/begin CHARACTERISTIC K_FAKTEF_ERH "Effizienzfaktor Ladung mit erhöhter Spannung" VALUE 0xa0825423 _REC_VAL_20_u1 0.996 _CNV_R_R_Def_f_ub_b_553_CM 0. 0.996 /end CHARACTERISTIC
/begin CHARACTERISTIC K_FITDEF "" VALUE 0xa0824be8 _REC_VAL_20_u2 99.9984 _CNV_R_R_Def_f_uw_b_555_CM 0. 99.9984 /end CHARACTERISTIC
/begin CHARACTERISTIC K_GQVCC "Grenzwert Einschalten CC-Meldung" VALUE 0xa08247a6 _REC_VAL_20_u1 99.60930000000001 _CNV_R_R_Def_f_ub_b_586_CM 0. 99.60930000000001 FORMAT "%5.2" /end CHARACTERISTIC
/begin CHARACTERISTIC K_GQVH2OCC "Grenzwert Einschalten CC-Medlung" VALUE 0xa08247a7 _REC_VAL_20_u1 99.60930000000001 _CNV_R_R_Def_f_ub_b_586_CM 0. 99.60930000000001 FORMAT "%5.2" /end CHARACTERISTIC
/begin CHARACTERISTIC K_GQVH2OQCC "Grenzwert Einschalten CC-Meldung" VALUE 0xa08247a8 _REC_VAL_20_u1 99.60930000000001 _CNV_R_R_Def_f_ub_b_586_CM 0. 99.60930000000001 FORMAT "%5.2" /end CHARACTERISTIC
/begin CHARACTERISTIC K_GQVQUALICC "Grenzwert Einschalten CC-Meldung" VALUE 0xa08247a9 _REC_VAL_20_u1 99.60930000000001 _CNV_R_R_Def_f_ub_b_586_CM 0. 99.60930000000001 FORMAT "%5.2" /end CHARACTERISTIC
/begin CHARACTERISTIC K_HISTDMERST "Manueller Reset d. Histogramm in der DME" VALUE 0xa08247aa _REC_VAL_20_u1 99.45 _CNV_R_R_Def_dez_sl_551_CM 0. 255. FORMAT "%3.0" /end CHARACTERISTIC
/begin CHARACTERISTIC K_HISTIBSRST "Manueller Histogramm Reset in IBS" VALUE 0xa08247ab _REC_VAL_20_u1 99.45 _CNV_R_R_Def_dez_sl_551_CM 0. 255. FORMAT "%3.0" /end CHARACTERISTIC
/begin CHARACTERISTIC K_IBSWAKEAPP "Bit, ob IBS Bus wecken darf oder nicht. Applikationsgroesse." VALUE 0xa08248d6 _REC_VAL_20_u1 99.45 _CNV_R_R_Def_dez_sl_551_CM 0. 255. FORMAT "%3.0" /end CHARACTERISTIC
/begin CHARACTERISTIC K_IB_COMMVAL "Anzahl Taskaufrufe zwischen periodischer Abfrage qlad und qelad" VALUE 0xa0824b85 _REC_VAL_20_u1 99.45 _CNV_R_R_Def_dez_sl_551_CM 0. 255. FORMAT "%3.0" /end CHARACTERISTIC
/begin CHARACTERISTIC K_ILMINUMG "integrierte Lufmassenschwelle Aussentemperaturmodell" VALUE 0xa08251e8 _REC_VAL_20_u2 29.1266 _CNV_R_R_Def_lm_uw__654_CM 0. 29.1266 FORMAT "%7.4" /end CHARACTERISTIC
/begin CHARACTERISTIC K_IPMPMDEC "Prio-dekrementfaktor aufgrund IPM" VALUE 0xa08248a2 _REC_VAL_20_u2 99. _CNV_R_R_Def_f_sw_p_557_CM 0. 450. /end CHARACTERISTIC
/begin CHARACTERISTIC K_IPMPMINC "Prio-Inkrementfaktor aufgrund IPM" VALUE 0xa08248a4 _REC_VAL_20_u2 99. _CNV_R_R_Def_f_sw_p_557_CM 0. 450. /end CHARACTERISTIC
/begin CHARACTERISTIC K_IWAKEAPP "Wakeupgrenze Appl." VALUE 0xa08247ac _REC_VAL_20_u1 0.255 _CNV_R_R_Def_i_ub_q_608_CM 0. 0.255 /end CHARACTERISTIC
/begin CHARACTERISTIC K_I_FITAUSW "Grenzwert Fitstrom" VALUE 0xa0824bea _REC_VAL_20_u2 104.856 _CNV_R_R_Def_i_uw_q_634_CM -200. 5042.8 /end CHARACTERISTIC
/begin CHARACTERISTIC K_KAPAVERLU "Kapazitätsverlust" VALUE 0xa08251fd _REC_VAL_20_u1 99.45 _CNV_R_R_Def_dez_sl_551_CM 0. 255. FORMAT "%3.0" /end CHARACTERISTIC
/begin CHARACTERISTIC K_KSOGRZAPP "Ikurz_ogrz appl." VALUE 0xa08247ad _REC_VAL_20_u1 99.84 _CNV_R_R_Def_i_ub_q_758_CM 0. 998.4 FORMAT "%5.2" /end CHARACTERISTIC
/begin CHARACTERISTIC K_KSUGRZAPP "Ikurz_ugrz Appl." VALUE 0xa08247ae _REC_VAL_20_u1 99.84 _CNV_R_R_Def_i_ub_q_758_CM 0. 998.4 FORMAT "%5.2" /end CHARACTERISTIC
/begin CHARACTERISTIC K_LADEFAKT "Ladefaktor Batterie" VALUE 0xa0825424 _REC_VAL_20_u1 0.996 _CNV_R_R_Def_f_ub_b_553_CM 0. 0.996 /end CHARACTERISTIC
/begin CHARACTERISTIC K_LBATTMAXK "Begrenzung Spannungswert aus Ladekennlinie" VALUE 0xa08251c2 _REC_VAL_20_s2 99.83688000000001 _CNV_R_R_Def_u_sw_b_581_CM 0. 127.996 /end CHARACTERISTIC
/begin CHARACTERISTIC K_LBATTMAXM "maximale Batterieladespannung" VALUE 0xa08251c4 _REC_VAL_20_s2 99.83688000000001 _CNV_R_R_Def_u_sw_b_581_CM 0. 127.996 /end CHARACTERISTIC
/begin CHARACTERISTIC K_LBATTTUMG "Initialwert für Abstelltemp Umgebung" VALUE 0xa08251c6 _REC_VAL_20_s2 131.07 _CNV_R_R_Def_t_sw_q_578_CM -3276.8 3276.7 FORMAT "%4.1" /end CHARACTERISTIC
/begin CHARACTERISTIC K_LBATTTUMGBA "Initialwert für Abstelltemperatur Batterie" VALUE 0xa08251c8 _REC_VAL_20_s2 131.07 _CNV_R_R_Def_t_sw_q_578_CM -3276.8 3276.7 FORMAT "%4.1" /end CHARACTERISTIC
/begin CHARACTERISTIC K_LLANHAPP "LLDZanh.-level, falls Generator fehlerhaft ist." VALUE 0xa082474c _REC_VAL_20_u1 99.45 _CNV_R_R_Def_dez_sl_551_CM 0. 255. FORMAT "%3.0" /end CHARACTERISTIC
/begin CHARACTERISTIC K_LLPMAPP "Handapplikationswert für Leerlaufdrehzahlvorgabe" VALUE 0xa082474d _REC_VAL_20_u1 99.45 _CNV_R_R_Def_dez_sl_551_CM 0. 255. FORMAT "%3.0" /end CHARACTERISTIC
/begin CHARACTERISTIC K_LLPMFILTK "Filterkonstante : Tiefpassfilter DF-Signal" VALUE 0xa08248d7 _REC_VAL_20_u1 0.996 _CNV_R_R_Def_f_ub_b_553_CM 0. 0.996 /end CHARACTERISTIC
/begin CHARACTERISTIC K_MAXSTART "Maximaler Abstand Startfähigkeitsgrenze bei B_soc_npl true" VALUE 0xa08248a6 _REC_VAL_20_u2 95.442256 _CNV_R_R_Def_ql_uw__577_CM 0. 1193.0282 /end CHARACTERISTIC
/begin CHARACTERISTIC K_MCOBATTORT "Codierung Hand Batterieeinbauort" VALUE 0xa08251fe _REC_VAL_20_u1 99.45 _CNV_R_R_Def_dez_sl_551_CM 0. 255. FORMAT "%3.0" /end CHARACTERISTIC
/begin CHARACTERISTIC K_MN_PTCPI "Minimalwert des PI-Reglers PTC Ansteuerung" VALUE 0xa08248a8 _REC_VAL_20_u2 102.39842 _CNV_R_R_Def_f_uw_b_626_CM 0. 511.9921 /end CHARACTERISTIC
/begin CHARACTERISTIC K_MN_PWRDFPI "Minimaler Wert PI-Regler df Prio" VALUE 0xa08248aa _REC_VAL_20_u2 102.39842 _CNV_R_R_Def_f_uw_b_626_CM 0. 511.9921 /end CHARACTERISTIC
/begin CHARACTERISTIC K_MX_PTCPI "Maximalwert des PI-Reglers PTC Ansteuerung" VALUE 0xa08248ac _REC_VAL_20_u2 102.39842 _CNV_R_R_Def_f_uw_b_626_CM 0. 511.9921 /end CHARACTERISTIC
/begin CHARACTERISTIC K_NKW2HIPTC "Nkw i.O. PTC darf zugeschaltet werden." VALUE 0xa082489c _REC_VAL_20_s2 0. _CNV_R_R_Def_n_sw_q_595_CM -32768. 32767. FORMAT "%5.0" /end CHARACTERISTIC
/begin CHARACTERISTIC K_NKW2LOWPTC "Nkw zu niedrig, PTC wird abgeschaltet" VALUE 0xa082489e _REC_VAL_20_s2 0. _CNV_R_R_Def_n_sw_q_595_CM -32768. 32767. FORMAT "%5.0" /end CHARACTERISTIC
/begin CHARACTERISTIC K_NLLMIN "Motordrehzahl unterhalb derer die LLDZanh. zurueckgenommen wird." VALUE 0xa0824748 _REC_VAL_20_s2 0. _CNV_R_R_Def_n_sw_q_595_CM -32768. 32767. FORMAT "%5.0" /end CHARACTERISTIC
/begin CHARACTERISTIC K_NMINUMG "Drehzahlschwelle Aussentemperaturmodell" VALUE 0xa08251ca _REC_VAL_20_s2 0. _CNV_R_R_Def_n_sw_q_595_CM 0. 32767. FORMAT "%5.0" /end CHARACTERISTIC
/begin CHARACTERISTIC K_OFTUMGCAN "Offset Umgebungstemperatur CAN" VALUE 0xa08251cc _REC_VAL_20_s2 131.07 _CNV_R_R_Def_t_sw_q_578_CM -3276.8 3276.7 FORMAT "%4.1" /end CHARACTERISTIC
/begin CHARACTERISTIC K_OSPGAPP "Oberspannungsschwelle" VALUE 0xa0824788 _REC_VAL_20_u2 16.3837 _CNV_R_R_Def_u_uw_q_700_CM 6. 22.3837 FORMAT "%7.4" /end CHARACTERISTIC
/begin CHARACTERISTIC K_OSPGHYST "Unterspannungshysterese" VALUE 0xa0824782 _REC_VAL_20_s2 16.3837 _CNV_R_R_Def_u_sw_q_722_CM -8.192 8.191700000000001 FORMAT "%7.4" /end CHARACTERISTIC
/begin CHARACTERISTIC K_OSPGPRELLZ "Anzahl der Entprellungen für Oberspannungsfehlereintrag" VALUE 0xa08247af _REC_VAL_20_u1 99.45 _CNV_R_R_Def_dez_sl_551_CM 0. 255. FORMAT "%3.0" /end CHARACTERISTIC
/begin CHARACTERISTIC K_OSPRELLDEC "Dekrement auf Entprellcounter Oberspannung" VALUE 0xa08247b0 _REC_VAL_20_u1 99.45 _CNV_R_R_Def_dez_sl_551_CM 0. 255. FORMAT "%3.0" /end CHARACTERISTIC
/begin CHARACTERISTIC K_OSPRELLINC "Inkrement auf Entprellcounter Oberspannung" VALUE 0xa08247b1 _REC_VAL_20_u1 99.45 _CNV_R_R_Def_dez_sl_551_CM 0. 255. FORMAT "%3.0" /end CHARACTERISTIC
/begin CHARACTERISTIC K_PLBATTUMG "Plausibilisierung-Schwelle Batterieumgebungstemperatur" VALUE 0xa08251ce _REC_VAL_20_s2 98.30099999999999 _CNV_R_R_Def_t_sw_q_578_CM 0. 3276.7 FORMAT "%4.1" /end CHARACTERISTIC
/begin CHARACTERISTIC K_PMQ_UX "Ruhespannung Extrapolationsteiler" VALUE 0xa0824b86 _REC_VAL_20_u1 7.9374 _CNV_R_R_Def_f_ub_b_694_CM 3.13e-002 7.9687 FORMAT "%5.2" /end CHARACTERISTIC
/begin CHARACTERISTIC K_PMRDM2LMSA "Konstante um die bei MSA-FZG der batt_m2l reduziert wird" VALUE 0xa08251ff _REC_VAL_20_u1 25.5 _CNV_R_R_Def_u_ub_q_631_CM 0. 25.5 FORMAT "%5.2" /end CHARACTERISTIC
/begin CHARACTERISTIC K_PMTIMERSQ1 "Startwert Timer für soc_quali" VALUE 0xa0824d98 _REC_VAL_20_u2 0. _CNV_R_R_Def_dez_sl_551_CM 0. 65535. FORMAT "%5.0" /end CHARACTERISTIC
/begin CHARACTERISTIC K_PM_IPMON "IPM Massnahmen bzgl. PM aktiviert" VALUE 0xa08248d8 _REC_VAL_20_u1 3. _CNV_R_R_Def_dez_sl_551_CM 0. 3. FORMAT "%3.0" /end CHARACTERISTIC
/begin CHARACTERISTIC K_PM_NOUSEQ "Startwert Timer für soc_quali" VALUE 0xa0824dac _REC_VAL_20_u1 1. _CNV_R_R_Def_dez_sl_551_CM 0. 1. FORMAT "%3.0" /end CHARACTERISTIC
/begin CHARACTERISTIC K_PM_TABSMN "Applikationsgrösse für Abstellzeit tabsmn_w" VALUE 0xa0824d9a _REC_VAL_20_u2 0. _CNV_R_R_Def_td_ub__611_CM 0. 65535. FORMAT "%5.0" /end CHARACTERISTIC
/begin CHARACTERISTIC K_PRIO15 "Prios bei Kl.15, Motor aus" VALUE 0xa08248d9 _REC_VAL_20_u1 7. _CNV_R_R_Def_dez_sl_551_CM 0. 7. FORMAT "%3.0" /end CHARACTERISTIC
/begin CHARACTERISTIC K_PRIOCF15 "PrioCF bei kl.15, Motor aus" VALUE 0xa08248da _REC_VAL_20_u1 7. _CNV_R_R_Def_dez_sl_551_CM 0. 7. FORMAT "%3.0" /end CHARACTERISTIC
/begin CHARACTERISTIC K_PRIOCFAPP "Steuerung Spitzenreduzierung Prioritaet Komfort App" VALUE 0xa08248db _REC_VAL_20_u1 7. _CNV_R_R_Def_dez_sl_551_CM 0. 7. FORMAT "%3.0" /end CHARACTERISTIC
/begin CHARACTERISTIC K_PRIOCF_R "Prio Comfort Bei Kl.R" VALUE 0xa08248dc _REC_VAL_20_u1 7. _CNV_R_R_Def_dez_sl_551_CM 0. 7. FORMAT "%3.0" /end CHARACTERISTIC
/begin CHARACTERISTIC K_PRIODF "Kein Langbezeichner vergeben" VAL_BLK 0xa0824930 _REC_VAL_2_u1 99.45 _CNV_R_R_Def_dez_sl_551_CM 0. 255. FORMAT "%3.0" NUMBER 7 /end CHARACTERISTIC
/begin CHARACTERISTIC K_PRIO_R "Prio Bei Kl.R" VALUE 0xa08248dd _REC_VAL_20_u1 7. _CNV_R_R_Def_dez_sl_551_CM 0. 7. FORMAT "%3.0" /end CHARACTERISTIC
/begin CHARACTERISTIC K_PR_BAPPDMN "Applikationswert für Prio dyn Batt min" VALUE 0xa0825200 _REC_VAL_20_u1 99.45 _CNV_R_R_Def_dez_sl_551_CM 0. 255. FORMAT "%3.0" /end CHARACTERISTIC
/begin CHARACTERISTIC K_PR_BAPPMX "Applikationswert für Prio Batt max" VALUE 0xa0825201 _REC_VAL_20_u1 99.45 _CNV_R_R_Def_dez_sl_551_CM 0. 255. FORMAT "%3.0" /end CHARACTERISTIC
/begin CHARACTERISTIC K_PR_BAPPSMN "Applikationswert für Prio sta Batt max" VALUE 0xa0825202 _REC_VAL_20_u1 99.45 _CNV_R_R_Def_dez_sl_551_CM 0. 255. FORMAT "%3.0" /end CHARACTERISTIC
/begin CHARACTERISTIC K_PR_BAPPSOLL "Applikationswert für Prio Batt soll" VALUE 0xa0825203 _REC_VAL_20_u1 99.45 _CNV_R_R_Def_dez_sl_551_CM 0. 255. FORMAT "%3.0" /end CHARACTERISTIC
/begin CHARACTERISTIC K_PR_BATTMX "Prioritaet Batterie Maxspannung" VALUE 0xa0825204 _REC_VAL_20_u1 99.45 _CNV_R_R_Def_dez_sl_551_CM 0. 255. FORMAT "%3.0" /end CHARACTERISTIC
/begin CHARACTERISTIC K_PR_UBSOLL "Prio Batterie Sollspannung" VALUE 0xa0825205 _REC_VAL_20_u1 99.45 _CNV_R_R_Def_dez_sl_551_CM 0. 255. FORMAT "%3.0" /end CHARACTERISTIC
/begin CHARACTERISTIC K_PR_UBSOLLTR "Prio Batterie Sollspg TraMode" VALUE 0xa0825206 _REC_VAL_20_u1 99.45 _CNV_R_R_Def_dez_sl_551_CM 0. 255. FORMAT "%3.0" /end CHARACTERISTIC
/begin CHARACTERISTIC K_PR_UDBMN_H "Prio dyn Batterie min Obergrenze" VALUE 0xa0825207 _REC_VAL_20_u1 99.45 _CNV_R_R_Def_dez_sl_551_CM 0. 255. FORMAT "%3.0" /end CHARACTERISTIC
/begin CHARACTERISTIC K_PR_UDBMN_L "Prio dyn Batterie min Untergrenze (bei B_batt_good =true)" VALUE 0xa0825208 _REC_VAL_20_u1 99.45 _CNV_R_R_Def_dez_sl_551_CM 0. 255. FORMAT "%3.0" /end CHARACTERISTIC
/begin CHARACTERISTIC K_PR_UDBMN_M "Prio dyn Batterie Mittelwert (bei B_batt_bad =true)" VALUE 0xa0825209 _REC_VAL_20_u1 99.45 _CNV_R_R_Def_dez_sl_551_CM 0. 255. FORMAT "%3.0" /end CHARACTERISTIC
/begin CHARACTERISTIC K_PR_USBMN_H "Prio sta Batterie Obergrenze" VALUE 0xa082520a _REC_VAL_20_u1 99.45 _CNV_R_R_Def_dez_sl_551_CM 0. 255. FORMAT "%3.0" /end CHARACTERISTIC
/begin CHARACTERISTIC K_PR_USBMN_L "Prio sta Batterie Untergrenze" VALUE 0xa082520b _REC_VAL_20_u1 99.45 _CNV_R_R_Def_dez_sl_551_CM 0. 255. FORMAT "%3.0" /end CHARACTERISTIC
/begin CHARACTERISTIC K_PTCPWRAPP "Ansteuerung PWM-Ausgang für PTC-Zuheizer. Applikationsgroesse." VALUE 0xa08248de _REC_VAL_20_u1 99.45 _CNV_R_R_Def_f_ub_b_575_CM 0. 127.5 FORMAT "%5.2" /end CHARACTERISTIC
/begin CHARACTERISTIC K_PTC_PI "K-Faktor des PI-Reglers PTC-Ansteuerung" VALUE 0xa08248df _REC_VAL_20_u1 0.996 _CNV_R_R_Def_f_ub_b_553_CM 0. 0.996 /end CHARACTERISTIC
/begin CHARACTERISTIC K_PWRCOS15 "PWRCOS bei Kl.15, Motor aus" VALUE 0xa08248ae _REC_VAL_20_u2 0. _CNV_R_R_Def_dez_sl_551_CM 0. 65535. FORMAT "%5.0" /end CHARACTERISTIC
/begin CHARACTERISTIC K_PWRCOSAPP "Steuerung Leistung Verbraucher bitcodiert Applikationsgroesse" VALUE 0xa08248b0 _REC_VAL_20_u2 0. _CNV_R_R_Def_dez_sl_551_CM 0. 65535. FORMAT "%5.0" /end CHARACTERISTIC
/begin CHARACTERISTIC K_PWRCOSHT "ctrpwrcos-Wert bei Generator Hochtemperatur" VALUE 0xa08248b2 _REC_VAL_20_u2 0. _CNV_R_R_Def_dez_sl_551_CM 0. 65535. FORMAT "%5.0" /end CHARACTERISTIC
/begin CHARACTERISTIC K_PWRCOSNOTL "Kein Langbezeichner vergeben" VALUE 0xa08248b4 _REC_VAL_20_u2 0. _CNV_R_R_Def_dez_sl_551_CM 0. 65535. FORMAT "%5.0" /end CHARACTERISTIC
/begin CHARACTERISTIC K_PWRCOSULEV "Bitcodierte ctrpwrcos Zuschaltung bei Sulev" VALUE 0xa08248b6 _REC_VAL_20_u2 0. _CNV_R_R_Def_dez_sl_551_CM 0. 65535. FORMAT "%5.0" /end CHARACTERISTIC
/begin CHARACTERISTIC K_PWRCOS_R "PowerCos Bitcodiert bei Kl.R" VALUE 0xa08248b8 _REC_VAL_20_u2 0. _CNV_R_R_Def_dez_sl_551_CM 0. 65535. FORMAT "%5.0" /end CHARACTERISTIC
/begin CHARACTERISTIC K_PWRCSGNDEF "ctrpwrcos-Wert bei Gen. mechn. el. Fehler" VALUE 0xa08248ba _REC_VAL_20_u2 0. _CNV_R_R_Def_dez_sl_551_CM 0. 65535. FORMAT "%5.0" /end CHARACTERISTIC
/begin CHARACTERISTIC K_PWRDF_PI "K-Faktor des PI Reglers zur Berechnung von ctrpwrdf" VALUE 0xa08248e0 _REC_VAL_20_u1 0.996 _CNV_R_R_Def_f_ub_b_553_CM 0. 0.996 /end CHARACTERISTIC
/begin CHARACTERISTIC K_QELADGESMX "Begrenzung Maximal Wert des Enladungszählers im Infospeicher" VALUE 0xa082478a _REC_VAL_20_u2 0. _CNV_R_R_Def_dez_sl_551_CM 0. 65535. FORMAT "%5.0" /end CHARACTERISTIC
/begin CHARACTERISTIC K_QLADGESMX "Begrenzung Maximaler Wert des Ladezählers im Infospeicher" VALUE 0xa082478c _REC_VAL_20_u2 0. _CNV_R_R_Def_dez_sl_551_CM 0. 65535. FORMAT "%5.0" /end CHARACTERISTIC
/begin CHARACTERISTIC K_QSOCCL1 "Grenze zur Ladezustandsqualitätsklasse1" VALUE 0xa0824d9c _REC_VAL_20_u2 95.442256 _CNV_R_R_Def_ql_uw__577_CM 0. 1193.0282 /end CHARACTERISTIC
/begin CHARACTERISTIC K_QSOCCL2 "Grenze zur Ladezustandsqualitätsklasse2" VALUE 0xa0824d9e _REC_VAL_20_u2 95.442256 _CNV_R_R_Def_ql_uw__577_CM 0. 1193.0282 /end CHARACTERISTIC
/begin CHARACTERISTIC K_QSOCCL3 "Grenze zur Ladezustandsqualitätsklasse3" VALUE 0xa0824da0 _REC_VAL_20_u2 95.442256 _CNV_R_R_Def_ql_uw__577_CM 0. 1193.0282 /end CHARACTERISTIC
/begin CHARACTERISTIC K_QSTARTFGA "Applikationswert für q_startfgk" VALUE 0xa08248bc _REC_VAL_20_u2 95.442256 _CNV_R_R_Def_ql_uw__577_CM 0. 1193.0282 /end CHARACTERISTIC
/begin CHARACTERISTIC K_QSULMIN "Mindestladungsmenge zum Aufheben von Sulfatierung (bez. auf Cnenn)" VALUE 0xa0825425 _REC_VAL_20_u1 0.996 _CNV_R_R_Def_f_ub_b_553_CM 0. 0.996 /end CHARACTERISTIC
/begin CHARACTERISTIC K_QV_NPL "Restkappa für schlechte Qv_quali" VALUE 0xa08253f0 _REC_VAL_20_u1 99.60930000000001 _CNV_R_R_Def_f_ub_b_586_CM 0. 99.60930000000001 FORMAT "%5.2" /end CHARACTERISTIC
/begin CHARACTERISTIC K_QV_OGRZ "" VALUE 0xa0824dda _REC_VAL_20_s2 79.9986 _CNV_R_R_Def_f_sw_q_550_CM -39.9993 39.9993 /end CHARACTERISTIC
/begin CHARACTERISTIC K_QV_QGRZ "" VALUE 0xa0824dde _REC_VAL_20_u1 99.60930000000001 _CNV_R_R_Def_f_ub_b_586_CM 0. 99.60930000000001 FORMAT "%5.2" /end CHARACTERISTIC
/begin CHARACTERISTIC K_QV_QUALIMX "Schwellwert Qv_quali" VALUE 0xa08253f1 _REC_VAL_20_u1 99.60930000000001 _CNV_R_R_Def_f_ub_b_586_CM 0. 99.60930000000001 FORMAT "%5.2" /end CHARACTERISTIC
/begin CHARACTERISTIC K_QV_UGRZ "" VALUE 0xa0824ddc _REC_VAL_20_s2 79.9986 _CNV_R_R_Def_f_sw_q_550_CM -39.9993 39.9993 /end CHARACTERISTIC
/begin CHARACTERISTIC K_Q_BILAPWF "Defaultwert für q_bila nach Powerfail" VALUE 0xa0824b7c _REC_VAL_20_u2 95.442256 _CNV_R_R_Def_ql_uw__577_CM 0. 1193.0282 /end CHARACTERISTIC
/begin CHARACTERISTIC K_REGEN_ON "Aktivierung Regenerationsanforderung" VALUE 0xa0825426 _REC_VAL_20_u1 1. _CNV_R_R_Def_dez_sl_551_CM 0. 1. FORMAT "%3.0" /end CHARACTERISTIC
/begin CHARACTERISTIC K_REGPASS_ON "Passive Regeneration Enable" VALUE 0xa0825427 _REC_VAL_20_u1 1. _CNV_R_R_Def_dez_sl_551_CM 0. 1. FORMAT "%3.0" /end CHARACTERISTIC
/begin CHARACTERISTIC K_REGSTART "Aktive Regeneration auslösen" VALUE 0xa0825428 _REC_VAL_20_u1 1. _CNV_R_R_Def_dez_sl_551_CM 0. 1. FORMAT "%3.0" /end CHARACTERISTIC
/begin CHARACTERISTIC K_REGSTOP "Aktive Regeneration beenden" VALUE 0xa0825429 _REC_VAL_20_u1 1. _CNV_R_R_Def_dez_sl_551_CM 0. 1. FORMAT "%3.0" /end CHARACTERISTIC
/begin CHARACTERISTIC K_REGTUERH "Entprellzeit Erkennung Ladespannung erhöht" VALUE 0xa082542a _REC_VAL_20_u1 25.5 _CNV_R_R_Def_td_ub__574_CM 0. 25.5 FORMAT "%4.1" /end CHARACTERISTIC
/begin CHARACTERISTIC K_RESET_PI "PI-Reset-Zeit bei steigender Kl.15" VALUE 0xa08248e1 _REC_VAL_20_u1 25.5 _CNV_R_R_Def_td_ub__574_CM 0. 25.5 FORMAT "%4.1" /end CHARACTERISTIC
/begin CHARACTERISTIC K_RIN_GRENZ1 "Grenzwert Innenwiderstand Batterie1" VALUE 0xa0824de6 _REC_VAL_20_u1 31.875 _CNV_R_R_Def_f_ub_b_612_CM 0. 31.875 FORMAT "%5.2" /end CHARACTERISTIC
/begin CHARACTERISTIC K_RIN_GRENZ2 "Grenzwert Innenwiderstand Batterie2" VALUE 0xa0824de7 _REC_VAL_20_u1 31.875 _CNV_R_R_Def_f_ub_b_612_CM 0. 31.875 FORMAT "%5.2" /end CHARACTERISTIC
/begin CHARACTERISTIC K_RIN_GRENZ3 "Grenzwert Innenwiderstand Batterie3" VALUE 0xa0824de8 _REC_VAL_20_u1 31.875 _CNV_R_R_Def_f_ub_b_612_CM 0. 31.875 FORMAT "%5.2" /end CHARACTERISTIC
/begin CHARACTERISTIC K_RIN_GRENZ4 "Grenzwert Innenwiderstand Batterie4" VALUE 0xa0824de9 _REC_VAL_20_u1 31.875 _CNV_R_R_Def_f_ub_b_612_CM 0. 31.875 FORMAT "%5.2" /end CHARACTERISTIC
/begin CHARACTERISTIC K_RIN_GRENZ5 "Grenzwert Innenwiderstand Batterie5" VALUE 0xa0824dea _REC_VAL_20_u1 31.875 _CNV_R_R_Def_f_ub_b_612_CM 0. 31.875 FORMAT "%5.2" /end CHARACTERISTIC
/begin CHARACTERISTIC K_RIN_GRENZ6 "Grenzwert Innenwiderstand Batterie6" VALUE 0xa0824deb _REC_VAL_20_u1 31.875 _CNV_R_R_Def_f_ub_b_612_CM 0. 31.875 FORMAT "%5.2" /end CHARACTERISTIC
/begin CHARACTERISTIC K_RIN_GRENZ7 "Grenzwert Innenwiderstand Batterie7" VALUE 0xa0824dec _REC_VAL_20_u1 31.875 _CNV_R_R_Def_f_ub_b_612_CM 0. 31.875 FORMAT "%5.2" /end CHARACTERISTIC
/begin CHARACTERISTIC K_RIN_GRENZ8 "Grenzwert Innenwiderstand Batterie8" VALUE 0xa0824ded _REC_VAL_20_u1 31.875 _CNV_R_R_Def_f_ub_b_612_CM 0. 31.875 FORMAT "%5.2" /end CHARACTERISTIC
/begin CHARACTERISTIC K_RLTG_PWE65 "Leitungswiderstand Gegenkompensation E65" VALUE 0xa082520c _REC_VAL_20_u1 25.5 _CNV_R_R_Def_u_ub_q_631_CM 0. 25.5 FORMAT "%5.2" /end CHARACTERISTIC
/begin CHARACTERISTIC K_RQPCOSA "Parameter für SV-Anmeldung" VALUE 0xa08248e2 _REC_VAL_20_u1 3. _CNV_R_R_Def_dez_sl_551_CM 0. 3. FORMAT "%3.0" /end CHARACTERISTIC
/begin CHARACTERISTIC K_RQPCOSAPP "Anforderung Standverbraucher Applikationsgroesse" VALUE 0xa08248e3 _REC_VAL_20_u1 99.45 _CNV_R_R_Def_dez_sl_551_CM 0. 255. FORMAT "%3.0" /end CHARACTERISTIC
/begin CHARACTERISTIC K_RQULCP "RQPCOS Master umschalter" VALUE 0xa08248e4 _REC_VAL_20_u1 4. _CNV_R_R_Def_dez_sl_551_CM 0. 4. FORMAT "%3.0" /end CHARACTERISTIC
/begin CHARACTERISTIC K_RUHVERMODE "Ruhestromverletzungserkennungsmode" VALUE 0xa08247b2 _REC_VAL_20_u1 99.45 _CNV_R_R_Def_dez_sl_551_CM 0. 255. FORMAT "%3.0" /end CHARACTERISTIC
/begin CHARACTERISTIC K_SELSPCOSA "Spezialverbraucher" VALUE 0xa08248e5 _REC_VAL_20_u1 15. _CNV_R_R_Def_dez_sl_551_CM 0. 15. FORMAT "%3.0" /end CHARACTERISTIC
/begin CHARACTERISTIC K_SELSPCSAPP "Auswahl Sonderverbraucher Applikationsgroesse" VALUE 0xa08248e6 _REC_VAL_20_u1 15. _CNV_R_R_Def_dez_sl_551_CM 0. 15. FORMAT "%3.0" /end CHARACTERISTIC
/begin CHARACTERISTIC K_SOCFITAPP "Applikationwert Soc aus der Fitberechnung" VALUE 0xa0824bec _REC_VAL_20_u2 99.9984 _CNV_R_R_Def_f_uw_b_555_CM 0. 99.9984 /end CHARACTERISTIC
/begin CHARACTERISTIC K_SOCFITGRZ "Grenzwert für soc_fit" VALUE 0xa0824da2 _REC_VAL_20_u2 99.9984 _CNV_R_R_Def_f_uw_b_555_CM 0. 99.9984 /end CHARACTERISTIC
/begin CHARACTERISTIC K_SOCFITLIMH "Applikationskonstante zur Verbesserung SoC aus der Fitberechnung" VALUE 0xa0824da4 _REC_VAL_20_u2 99.9984 _CNV_R_R_Def_f_uw_b_555_CM 0. 99.9984 /end CHARACTERISTIC
/begin CHARACTERISTIC K_SOCFITLIML "Applikationskonstante zur Abwertung SoC aus der Fitberechnung" VALUE 0xa0824da6 _REC_VAL_20_u2 99.9984 _CNV_R_R_Def_f_uw_b_555_CM 0. 99.9984 /end CHARACTERISTIC
/begin CHARACTERISTIC K_SOCLOW_Q "Übertragungsfaktor Zeit im Schlechten SoC - Ladungsmenge" VALUE 0xa082542b _REC_VAL_20_u1 3.9843 _CNV_R_R_Def_f_ub_b_632_CM 0. 3.9843 FORMAT "%5.2" /end CHARACTERISTIC
/begin CHARACTERISTIC K_SOCMINPASS "Mindestschwelle Ladezustand Passive Regeneration" VALUE 0xa082541a _REC_VAL_20_u2 99.9984 _CNV_R_R_Def_f_uw_b_555_CM 0. 99.9984 /end CHARACTERISTIC
/begin CHARACTERISTIC K_SOCPASSRST "Ladezustandsschwelle Reset Passive Regeneration" VALUE 0xa082541c _REC_VAL_20_u2 99.9984 _CNV_R_R_Def_f_uw_b_555_CM 0. 99.9984 /end CHARACTERISTIC
/begin CHARACTERISTIC K_SOC_BILAWA "Applikationswert soc_bila" VALUE 0xa0824b7e _REC_VAL_20_u2 99.9984 _CNV_R_R_Def_f_uw_b_555_CM 0. 99.9984 /end CHARACTERISTIC
/begin CHARACTERISTIC K_SOC_QPWF "Ladezustandsqualität nach Powerfail" VALUE 0xa0824b80 _REC_VAL_20_u2 95.442256 _CNV_R_R_Def_ql_uw__577_CM 0. 1193.0282 /end CHARACTERISTIC
/begin CHARACTERISTIC K_SOC_QUALIA "Applikationswert soc_quali" VALUE 0xa0824b82 _REC_VAL_20_u2 95.442256 _CNV_R_R_Def_ql_uw__577_CM 0. 1193.0282 /end CHARACTERISTIC
/begin CHARACTERISTIC K_SOC_STAFGA "Applikationswert für SoC aus der Startfähigkeit" VALUE 0xa0824da8 _REC_VAL_20_u2 99.9984 _CNV_R_R_Def_f_uw_b_555_CM 0. 99.9984 /end CHARACTERISTIC
/begin CHARACTERISTIC K_STPCOSAPP "Status Standverbraucher Applikationsgroesse" VALUE 0xa08248e7 _REC_VAL_20_u1 3. _CNV_R_R_Def_dez_sl_551_CM 0. 3. FORMAT "%3.0" /end CHARACTERISTIC
/begin CHARACTERISTIC K_T1PMINFO "T1 Zykluszeit fuer PM Fehlerinfo" VALUE 0xa08247b3 _REC_VAL_20_u1 25.5 _CNV_R_R_Def_td_ub__574_CM 0. 25.5 FORMAT "%4.1" /end CHARACTERISTIC
/begin CHARACTERISTIC K_T2PMINFO "T2 Zykluszeit fuer PM Fehlerinfo" VALUE 0xa082478e _REC_VAL_20_u2 131.07 _CNV_R_R_Def_td_ub__574_CM 0. 6553.5 FORMAT "%4.1" /end CHARACTERISTIC
/begin CHARACTERISTIC K_T3PMINFO "T3 Zykluszeit fuer PM Fehlerinfo" VALUE 0xa0824790 _REC_VAL_20_u2 131.07 _CNV_R_R_Def_td_ub__574_CM 0. 6553.5 FORMAT "%4.1" /end CHARACTERISTIC
/begin CHARACTERISTIC K_TBATINIMAN "Applikation INITWERT Batterietemperatur" VALUE 0xa08251d0 _REC_VAL_20_s2 98.30099999999999 _CNV_R_R_Def_t_sw_q_578_CM 0. 3276.7 FORMAT "%4.1" /end CHARACTERISTIC
/begin CHARACTERISTIC K_TBATNACHL "B_ccbtnach wird nach dieser Zeit aktiviert" VALUE 0xa0824792 _REC_VAL_20_u2 131.07 _CNV_R_R_Def_td_ub__574_CM 0. 6553.5 FORMAT "%4.1" /end CHARACTERISTIC
/begin CHARACTERISTIC K_TBATTFTAUV "Zeitkonstante 5*Tau Batterievorne" VALUE 0xa08251ea _REC_VAL_20_u2 0. _CNV_R_R_Def_dez_sl_551_CM 0. 65535. FORMAT "%5.0" /end CHARACTERISTIC
/begin CHARACTERISTIC K_TBATTTAUFH "Zeitkonstante Batterie 5*Tau hinten" VALUE 0xa08251ec _REC_VAL_20_u2 0. _CNV_R_R_Def_dez_sl_551_CM 0. 65535. FORMAT "%5.0" /end CHARACTERISTIC
/begin CHARACTERISTIC K_TBTFREIMAX "Maximale Dauer Freigabe Maximalspannung" VALUE 0xa082520d _REC_VAL_20_u1 25.5 _CNV_R_R_Def_td_ub__574_CM 0. 25.5 FORMAT "%4.1" /end CHARACTERISTIC
/begin CHARACTERISTIC K_TBTMXIGRLO "Abschaltung iGR-Low ab T_batt" VALUE 0xa08251d2 _REC_VAL_20_s2 131.07 _CNV_R_R_Def_t_sw_q_578_CM -3276.8 3276.7 FORMAT "%4.1" /end CHARACTERISTIC
/begin CHARACTERISTIC K_TBTPAUMIN "Mindestenstpausenzeit zw Spannungsanhebungen" VALUE 0xa082520e _REC_VAL_20_u1 25.5 _CNV_R_R_Def_td_ub__574_CM 0. 25.5 FORMAT "%4.1" /end CHARACTERISTIC
/begin CHARACTERISTIC K_TCODIERPM "T1 Zyklus fuer Fehlerinfo" VALUE 0xa08247b4 _REC_VAL_20_u1 25.5 _CNV_R_R_Def_td_ub__574_CM 0. 25.5 FORMAT "%4.1" /end CHARACTERISTIC
/begin CHARACTERISTIC K_TDUB "Verzügerungszeitkonstante" VALUE 0xa082520f _REC_VAL_20_u1 25.5 _CNV_R_R_Def_td_ub__574_CM 0. 25.5 FORMAT "%4.1" /end CHARACTERISTIC
/begin CHARACTERISTIC K_TD_PWRDFPI "K-Faktor des PI Reglers zur Berechnung von ctrpwrdf" VALUE 0xa08248be _REC_VAL_20_u2 131.068 _CNV_R_R_Def_td_ub__574_CM 0.1 6553.5 FORMAT "%4.1" /end CHARACTERISTIC
/begin CHARACTERISTIC K_TIMERDLY "Delay for lbattcal" VALUE 0xa0825210 _REC_VAL_20_u1 99.45 _CNV_R_R_Def_dez_sl_551_CM 0. 255. FORMAT "%3.0" /end CHARACTERISTIC
/begin CHARACTERISTIC K_TIME_START "Zeittriggerschwelle nach Motorstart" VALUE 0xa0824de0 _REC_VAL_20_u2 98.30250000000001 _CNV_R_R_Def_td_uw__673_CM 0. 655.35 FORMAT "%5.2" /end CHARACTERISTIC
/begin CHARACTERISTIC K_TIMSET "Schalter um Quittierung der Tiefentladungserkennung durch IBS zu stimulierne" VALUE 0xa0824898 _REC_VAL_20_u1 1. _CNV_R_R_Def_dez_sl_551_CM 0. 1. FORMAT "%3.0" /end CHARACTERISTIC
/begin CHARACTERISTIC K_TQVCC "Dauer der CC-Meldung infolge QVC" VALUE 0xa0824896 _REC_VAL_20_u2 131.07 _CNV_R_R_Def_td_ub__574_CM 0. 6553.5 FORMAT "%4.1" /end CHARACTERISTIC
/begin CHARACTERISTIC K_TRINGSHIFT "Ruhezeit nachdem der Ruhestrom-Ringspeicher eingetragen wird." VALUE 0xa08247b5 _REC_VAL_20_u1 99.96000000000001 _CNV_R_R_Def_td_uw__712_CM 0. 238. FORMAT "%7.4" /end CHARACTERISTIC
/begin CHARACTERISTIC K_TSAISONFIL "Filterkonstante für t_saison" VALUE 0xa0824daa _REC_VAL_20_u2 0. _CNV_R_R_Def_dez_sl_551_CM 1. 65535. FORMAT "%5.0" /end CHARACTERISTIC
/begin CHARACTERISTIC K_TSAISPWF "Defaultwert Saison Temp bei DME Powerfail" VALUE 0xa0824d90 _REC_VAL_20_s2 131.07 _CNV_R_R_Def_t_sw_q_578_CM -3276.8 3276.7 FORMAT "%4.1" /end CHARACTERISTIC
/begin CHARACTERISTIC K_TUMGINI "Initialisierungswert Aussentemperaturmodell" VALUE 0xa08251d4 _REC_VAL_20_s2 131.07 _CNV_R_R_Def_t_sw_q_578_CM -3276.8 3276.7 FORMAT "%4.1" /end CHARACTERISTIC
/begin CHARACTERISTIC K_TUMGTAU "Zeitkonstante 5*Tau Aussentemperatur" VALUE 0xa08251ee _REC_VAL_20_u2 0. _CNV_R_R_Def_dez_sl_551_CM 0. 65535. FORMAT "%5.0" /end CHARACTERISTIC
/begin CHARACTERISTIC K_T_CCRUHVER "Dauer fuer CC-Meld. erhoehter Ruhestrom" VALUE 0xa0824794 _REC_VAL_20_u2 131.07 _CNV_R_R_Def_td_ub__574_CM 0. 6553.5 FORMAT "%4.1" /end CHARACTERISTIC
/begin CHARACTERISTIC K_T_IPMPRIO "max. Zeit, indem Prio aufgrund IPM gesteuert wird" VALUE 0xa08248e8 _REC_VAL_20_u1 25.5 _CNV_R_R_Def_td_ub__574_CM 0. 25.5 FORMAT "%4.1" /end CHARACTERISTIC
/begin CHARACTERISTIC K_T_KMSHIFT "Delayzeit für Km_st Info-shift" VALUE 0xa0824796 _REC_VAL_20_u2 131.07 _CNV_R_R_Def_td_ub__574_CM 0. 6553.5 FORMAT "%4.1" /end CHARACTERISTIC
/begin CHARACTERISTIC K_T_NKPTCAUS "Zeit PTC aus aufgrund NKW zu niedrig." VALUE 0xa08248e9 _REC_VAL_20_u1 25.5 _CNV_R_R_Def_td_ub__574_CM 0. 25.5 FORMAT "%4.1" /end CHARACTERISTIC
/begin CHARACTERISTIC K_T_OSPGRSET "Zeit für 1x Oberspannungsentprellungrücknahme" VALUE 0xa08247b6 _REC_VAL_20_u1 25.5 _CNV_R_R_Def_td_ub__574_CM 0. 25.5 FORMAT "%4.1" /end CHARACTERISTIC
/begin CHARACTERISTIC K_T_OSPGSET "Entrpellzeit FS_oberspannungserkennung" VALUE 0xa08247b7 _REC_VAL_20_u1 25.5 _CNV_R_R_Def_td_ub__574_CM 0. 25.5 FORMAT "%4.1" /end CHARACTERISTIC
/begin CHARACTERISTIC K_T_PMBS "Zeit bis zum nächsten zyklischen senden" VALUE 0xa08248ea _REC_VAL_20_u1 99.45 _CNV_R_R_Def_td_ub__611_CM 0. 255. FORMAT "%5.2" /end CHARACTERISTIC
/begin CHARACTERISTIC K_T_PMVS "Zeit zwischen zwei zyklischen Sendungen von 3b3 " VALUE 0xa08248eb _REC_VAL_20_u1 99.45 _CNV_R_R_Def_td_ub__611_CM 0. 255. FORMAT "%5.2" /end CHARACTERISTIC
/begin CHARACTERISTIC K_T_PTCKWAN "PTC-Ein Wartezeit nach Motor an." VALUE 0xa08248ec _REC_VAL_20_u1 25.5 _CNV_R_R_Def_td_ub__574_CM 0. 25.5 FORMAT "%4.1" /end CHARACTERISTIC
/begin CHARACTERISTIC K_T_PTCPI "T-Faktor des PI-Reglers für PTC-Ansteuerung" VALUE 0xa08248c0 _REC_VAL_20_u2 131.068 _CNV_R_R_Def_td_ub__574_CM 0.1 6553.5 FORMAT "%4.1" /end CHARACTERISTIC
/begin CHARACTERISTIC K_T_RUHAUSW "Minimal verstrichene Zeit für Ruheverl. Auswertung" VALUE 0xa08247b8 _REC_VAL_20_u1 99.96000000000001 _CNV_R_R_Def_td_uw__712_CM 0. 238. FORMAT "%7.4" /end CHARACTERISTIC
/begin CHARACTERISTIC K_T_SQSHIFT "Delayzeit für Soc_quali Info-shift" VALUE 0xa08247b9 _REC_VAL_20_u1 25.5 _CNV_R_R_Def_td_ub__574_CM 0. 25.5 FORMAT "%4.1" /end CHARACTERISTIC
/begin CHARACTERISTIC K_T_SULEVON "Zeit für SULEV-ctrpwrcos-prios nach Motorstart" VALUE 0xa08248c2 _REC_VAL_20_u2 131.07 _CNV_R_R_Def_td_ub__574_CM 0. 6553.5 FORMAT "%4.1" /end CHARACTERISTIC
/begin CHARACTERISTIC K_T_TIEFPRE "Entprellung Rücksetzen keine Tiefentladung mehr " VALUE 0xa0824798 _REC_VAL_20_u2 131.07 _CNV_R_R_Def_td_ub__574_CM 0. 6553.5 FORMAT "%4.1" /end CHARACTERISTIC
/begin CHARACTERISTIC K_T_USPGRSET "Uterspannung Resetzeit" VALUE 0xa08247ba _REC_VAL_20_u1 25.5 _CNV_R_R_Def_td_ub__574_CM 0. 25.5 FORMAT "%4.1" /end CHARACTERISTIC
/begin CHARACTERISTIC K_T_USPGSET "Zeit für 1x Unterspannungsentprellung" VALUE 0xa08247bb _REC_VAL_20_u1 25.5 _CNV_R_R_Def_td_ub__574_CM 0. 25.5 FORMAT "%4.1" /end CHARACTERISTIC
/begin CHARACTERISTIC K_UBAPPDMN "Spannung dyn Batterie min" VALUE 0xa0825211 _REC_VAL_20_u1 25.5 _CNV_R_R_Def_u_ub_q_631_CM 0. 25.5 FORMAT "%5.2" /end CHARACTERISTIC
/begin CHARACTERISTIC K_UBAPPMX "Applikationswert Batterie Max Spannung" VALUE 0xa0825212 _REC_VAL_20_u1 25.5 _CNV_R_R_Def_u_ub_q_631_CM 0. 25.5 FORMAT "%5.2" /end CHARACTERISTIC
/begin CHARACTERISTIC K_UBAPPSMN "Applikationswrt Batterie min Spannung stat" VALUE 0xa0825213 _REC_VAL_20_u1 25.5 _CNV_R_R_Def_u_ub_q_631_CM 0. 25.5 FORMAT "%5.2" /end CHARACTERISTIC
/begin CHARACTERISTIC K_UBAPPSOLL "Applikationswert Batteriesollspannung" VALUE 0xa0825214 _REC_VAL_20_u1 25.5 _CNV_R_R_Def_u_ub_q_631_CM 0. 25.5 FORMAT "%5.2" /end CHARACTERISTIC
/begin CHARACTERISTIC K_UBATTMN_L "Batterieminimalspannung bei Batteriezustand gut" VALUE 0xa0825215 _REC_VAL_20_u1 25.5 _CNV_R_R_Def_u_ub_q_631_CM 0. 25.5 FORMAT "%5.2" /end CHARACTERISTIC
/begin CHARACTERISTIC K_UBATTMN_M "Batterieminimalspannung bei Batteriezustand mittel" VALUE 0xa0825216 _REC_VAL_20_u1 25.5 _CNV_R_R_Def_u_ub_q_631_CM 0. 25.5 FORMAT "%5.2" /end CHARACTERISTIC
/begin CHARACTERISTIC K_UBATTNORM "Batterienormspannung" VALUE 0xa08251d6 _REC_VAL_20_s2 99.83843999999999 _CNV_R_R_Def_u_sw_b_581_CM -128. 127.996 /end CHARACTERISTIC
/begin CHARACTERISTIC K_UBATT_MX "Maximalwert zulässige Spannung aus Batteriesicht" VALUE 0xa0825217 _REC_VAL_20_u1 25.5 _CNV_R_R_Def_u_ub_q_631_CM 0. 25.5 FORMAT "%5.2" /end CHARACTERISTIC
/begin CHARACTERISTIC K_UBAT_LP "K-Faktor des ubatt-tiefpass Filters zur Berechnung von ctrpwrdf" VALUE 0xa08248c4 _REC_VAL_20_u2 0.9999847412109381 _CNV_R_R_Def_f_uw_b_571_CM 0. 0.9999847412109381 FORMAT "%14.5" /end CHARACTERISTIC
/begin CHARACTERISTIC K_UBDET_U "Störabstand Erkennung erhöhte Spannung" VALUE 0xa0825218 _REC_VAL_20_u1 25.5 _CNV_R_R_Def_u_ub_q_631_CM 0. 25.5 FORMAT "%5.2" /end CHARACTERISTIC
/begin CHARACTERISTIC K_UBNOTLAUF "Notlaufbatteriespannung für U_battsoll =0" VALUE 0xa08253f2 _REC_VAL_20_u1 25.5 _CNV_R_R_Def_u_ub_q_631_CM 0. 25.5 FORMAT "%5.2" /end CHARACTERISTIC
/begin CHARACTERISTIC K_UBPTC_LP "K-Faktor des ubatt-Tiefpass Filters zur Berechnung von PTC" VALUE 0xa08248c6 _REC_VAL_20_u2 0.9999847412109381 _CNV_R_R_Def_f_uw_b_571_CM 0. 0.9999847412109381 FORMAT "%14.5" /end CHARACTERISTIC
/begin CHARACTERISTIC K_UBSOLLREG "Batterieminspg bei Regeneration" VALUE 0xa08253f3 _REC_VAL_20_u1 25.5 _CNV_R_R_Def_u_ub_q_631_CM 0. 25.5 FORMAT "%5.2" /end CHARACTERISTIC
/begin CHARACTERISTIC K_UBTAPP "Batteriespannung Applikationsgroesse" VALUE 0xa08248c8 _REC_VAL_20_u2 61.425 _CNV_R_R_Def_u_uw_q_724_CM 0. 61.425 /end CHARACTERISTIC
/begin CHARACTERISTIC K_UBTDET_U "Entprellung für Erkennung erhöhte Spannung" VALUE 0xa0825219 _REC_VAL_20_u1 25.5 _CNV_R_R_Def_u_ub_q_631_CM 0. 25.5 FORMAT "%5.2" /end CHARACTERISTIC
/begin CHARACTERISTIC K_UBTLOWMAX "Obere Unterspannungsgrenze" VALUE 0xa08248ca _REC_VAL_20_u2 10. _CNV_R_R_Def_u_uw_q_700_CM 6. 16. FORMAT "%7.4" /end CHARACTERISTIC
/begin CHARACTERISTIC K_UBTLOWMIN "Untere Unterspannungsgrenze" VALUE 0xa08248cc _REC_VAL_20_u2 10. _CNV_R_R_Def_u_uw_q_700_CM 6. 16. FORMAT "%7.4" /end CHARACTERISTIC
/begin CHARACTERISTIC K_UB_GRENZ "Grenzwert Gradient d. Bordnetzspannung" VALUE 0xa0824de2 _REC_VAL_20_u2 123.46794 _CNV_R_R_Def_u_sb_q_583_CM 0. 6173.397 FORMAT "%4.1" /end CHARACTERISTIC
/begin CHARACTERISTIC K_UERHMIN "Schwellwert Erkennung erhöhte Ladespannung" VALUE 0xa082541e _REC_VAL_20_u2 16.3837 _CNV_R_R_Def_u_uw_q_700_CM 6. 22.3837 FORMAT "%7.4" /end CHARACTERISTIC
/begin CHARACTERISTIC K_ULADE_TAU "Batterieladespannungs Zeitkonstante" VALUE 0xa08251f0 _REC_VAL_20_u2 0.9999847412109381 _CNV_R_R_Def_f_uw_b_571_CM 0. 0.9999847412109381 FORMAT "%14.5" /end CHARACTERISTIC
/begin CHARACTERISTIC K_ULEVA "Spannungslevel" VALUE 0xa08248ed _REC_VAL_20_u1 99.45 _CNV_R_R_Def_dez_sl_551_CM 0. 255. FORMAT "%3.0" /end CHARACTERISTIC
/begin CHARACTERISTIC K_ULEVAPP "Spannungsebene Applikationsgroesse" VALUE 0xa08248ee _REC_VAL_20_u1 15. _CNV_R_R_Def_dez_sl_551_CM 0. 15. FORMAT "%3.0" /end CHARACTERISTIC
/begin CHARACTERISTIC K_ULOWSETAPP "Entrpellzeit zentrale Unterspannung" VALUE 0xa08248ef _REC_VAL_20_u1 25.5 _CNV_R_R_Def_td_ub__574_CM 0. 25.5 FORMAT "%4.1" /end CHARACTERISTIC
/begin CHARACTERISTIC K_USPGAPP "Unterspannungschwelle" VALUE 0xa082479a _REC_VAL_20_u2 16.3837 _CNV_R_R_Def_u_uw_q_700_CM 6. 22.3837 FORMAT "%7.4" /end CHARACTERISTIC
/begin CHARACTERISTIC K_USPGHYST "Unterspannungshysterese" VALUE 0xa0824784 _REC_VAL_20_s2 16.3837 _CNV_R_R_Def_u_sw_q_722_CM -8.192 8.191700000000001 FORMAT "%7.4" /end CHARACTERISTIC
/begin CHARACTERISTIC K_USPGPRELLZ "Anzahl der FS_uspg Entprellungen für Fehlereintrag" VALUE 0xa08247bc _REC_VAL_20_u1 99.45 _CNV_R_R_Def_dez_sl_551_CM 0. 255. FORMAT "%3.0" /end CHARACTERISTIC
/begin CHARACTERISTIC K_USPRELLDEC "Dekrement auf Entprellcounter Unterspannung" VALUE 0xa08247bd _REC_VAL_20_u1 99.45 _CNV_R_R_Def_dez_sl_551_CM 0. 255. FORMAT "%3.0" /end CHARACTERISTIC
/begin CHARACTERISTIC K_USPRELLINC "Inkrement auf Entprellcounter Unterspannung" VALUE 0xa08247be _REC_VAL_20_u1 99.45 _CNV_R_R_Def_dez_sl_551_CM 0. 255. FORMAT "%3.0" /end CHARACTERISTIC
/begin CHARACTERISTIC K_USTARTGRZ "Spannungsgrenzwert für Startauswertung " VALUE 0xa0824de4 _REC_VAL_20_u2 16.3837 _CNV_R_R_Def_u_uw_q_700_CM 6. 22.3837 FORMAT "%7.4" /end CHARACTERISTIC
/begin CHARACTERISTIC K_VMINUMG "Fahrzeuggeschwindigkeitsschwelle Aussentemperaturmodell" VALUE 0xa08251f2 _REC_VAL_20_u2 0. _CNV_R_R_Def_v_uw_q_726_CM 0. 65535. FORMAT "%5.0" /end CHARACTERISTIC
/begin CHARACTERISTIC K_WABSTELL "Wichtung Abstellzeit" VALUE 0xa082542c _REC_VAL_20_u1 0.996 _CNV_R_R_Def_f_ub_b_553_CM 0. 0.996 /end CHARACTERISTIC
/begin CHARACTERISTIC K_ZYK_BTMXF "Deaktivierung iGR-Low ab Zyklisierungsgrenze" VALUE 0xa08251f4 _REC_VAL_20_u2 190.87864 _CNV_R_R_Def_ql_uw__597_CM 0. 19087.864 FORMAT "%5.2" /end CHARACTERISTIC
/begin CHARACTERISTIC S_ABSCHK "Schalter für Applikationswert absch_korr" VALUE 0xa0824dad _REC_VAL_20_u1 99.45 _CNV_R_R_Def_dez_sl_551_CM 0. 255. FORMAT "%3.0" /end CHARACTERISTIC
/begin CHARACTERISTIC S_BATTAPP "Applikationsschalter1 Auswahl Ersatztemperatur" VALUE 0xa082521a _REC_VAL_20_u1 1. _CNV_R_R_Def_dez_sl_551_CM 0. 1. FORMAT "%3.0" /end CHARACTERISTIC
/begin CHARACTERISTIC S_BATTCHGINI "Schalter um Batterietausch stimulieren zu können" VALUE 0xa082542d _REC_VAL_20_u1 1. _CNV_R_R_Def_dez_sl_551_CM 0. 1. FORMAT "%3.0" /end CHARACTERISTIC
/begin CHARACTERISTIC S_BATTEMP "Auswahlschalter für T_batt bzw. T_saison" VALUE 0xa08253f4 _REC_VAL_20_u1 1. _CNV_R_R_Def_dez_sl_551_CM 0. 1. FORMAT "%3.0" /end CHARACTERISTIC
/begin CHARACTERISTIC S_BREGENU_HI "Aktivierung Hohe Spannung bei Batterieregeneration aktiv" VALUE 0xa08253f5 _REC_VAL_20_u1 1. _CNV_R_R_Def_dez_sl_551_CM 0. 1. FORMAT "%3.0" /end CHARACTERISTIC
/begin CHARACTERISTIC S_BSOCCALC "Enable Rücksetzten Ruhespannungen IBS" VALUE 0xa0824b87 _REC_VAL_20_u1 99.45 _CNV_R_R_Def_dez_sl_551_CM 0. 255. FORMAT "%3.0" /end CHARACTERISTIC
/begin CHARACTERISTIC S_BZE_EN "Schalter Aktivierung BZE" VALUE 0xa08253f6 _REC_VAL_20_u1 1. _CNV_R_R_Def_dez_sl_551_CM 0. 1. FORMAT "%3.0" /end CHARACTERISTIC
/begin CHARACTERISTIC S_DFKOMMERR "Maßnahmen bei Gen. Komm. Fehler aktiv" VALUE 0xa08248f0 _REC_VAL_20_u1 1. _CNV_R_R_Def_dez_sl_551_CM 0. 1. FORMAT "%3.0" /end CHARACTERISTIC
/begin CHARACTERISTIC S_DSOCS "Schalter für Applikationswert Delta SoC" VALUE 0xa0824dae _REC_VAL_20_u1 99.45 _CNV_R_R_Def_dez_sl_551_CM 0. 255. FORMAT "%3.0" /end CHARACTERISTIC
/begin CHARACTERISTIC S_FITINI "" VALUE 0xa0824bf0 _REC_VAL_20_u1 1. _CNV_R_R_Def_dez_sl_551_CM 0. 1. FORMAT "%3.0" /end CHARACTERISTIC
/begin CHARACTERISTIC S_FITNPL "" VALUE 0xa0824bf1 _REC_VAL_20_u1 1. _CNV_R_R_Def_dez_sl_551_CM 0. 1. FORMAT "%3.0" /end CHARACTERISTIC
/begin CHARACTERISTIC S_IBSTESTEN1 "IBS Test Enable" VALUE 0xa082521b _REC_VAL_20_u1 1. _CNV_R_R_Def_dez_sl_551_CM 0. 1. FORMAT "%3.0" /end CHARACTERISTIC
/begin CHARACTERISTIC S_IBSTESTEN2 "IBS Test Enable" VALUE 0xa082521c _REC_VAL_20_u1 1. _CNV_R_R_Def_dez_sl_551_CM 0. 1. FORMAT "%3.0" /end CHARACTERISTIC
/begin CHARACTERISTIC S_IPMPTC "PTC Einschränkung aufgrund IPM" VALUE 0xa08248f1 _REC_VAL_20_u1 1. _CNV_R_R_Def_dez_sl_551_CM 0. 1. FORMAT "%3.0" /end CHARACTERISTIC
/begin CHARACTERISTIC S_LBATT1 "Applikationsschalter1 Auswahl Ersatztemperatur" VALUE 0xa082521d _REC_VAL_20_u1 1. _CNV_R_R_Def_dez_sl_551_CM 0. 1. FORMAT "%3.0" /end CHARACTERISTIC
/begin CHARACTERISTIC S_LBATT2 "Applikationsschalter2 Auswahl Ersatztemperatur" VALUE 0xa082521e _REC_VAL_20_u1 1. _CNV_R_R_Def_dez_sl_551_CM 0. 1. FORMAT "%3.0" /end CHARACTERISTIC
/begin CHARACTERISTIC S_LBATTAPPL "Freischalten Initialisierung Abstelltemp Umgebung und Batterie" VALUE 0xa082521f _REC_VAL_20_u1 1. _CNV_R_R_Def_dez_sl_551_CM 0. 1. FORMAT "%3.0" /end CHARACTERISTIC
/begin CHARACTERISTIC S_LLABSTYP "" VALUE 0xa082474e _REC_VAL_20_u1 1. _CNV_R_R_Def_dez_sl_551_CM 0. 1. FORMAT "%3.0" /end CHARACTERISTIC
/begin CHARACTERISTIC S_MSASTARTKL "0=konventionelle KL ; 1=MSA-StarterKL" VALUE 0xa0824e52 _REC_VAL_20_u1 1. _CNV_R_R_Def_dez_sl_551_CM 0. 1. FORMAT "%3.0" /end CHARACTERISTIC
/begin CHARACTERISTIC S_NKWITNSTRT "0 = Nkw-Auswertung, 1=Itnstart Auswertung" VALUE 0xa0824dee _REC_VAL_20_u1 1. _CNV_R_R_Def_dez_sl_551_CM 0. 1. FORMAT "%3.0" /end CHARACTERISTIC
/begin CHARACTERISTIC S_NOLIMQELAD "wenn true: Entladezähler im Infospeicher kann Überlaufen" VALUE 0xa08247bf _REC_VAL_20_u1 1. _CNV_R_R_Def_dez_sl_551_CM 0. 1. FORMAT "%3.0" /end CHARACTERISTIC
/begin CHARACTERISTIC S_NOLIMQLAD "wenn true: Ladezähler im Infospeicher kann Überlaufen" VALUE 0xa08247c0 _REC_VAL_20_u1 1. _CNV_R_R_Def_dez_sl_551_CM 0. 1. FORMAT "%3.0" /end CHARACTERISTIC
/begin CHARACTERISTIC S_N_IDLIBS "Schalter zum manuellen Setzen von LL aktiv" VALUE 0xa082474f _REC_VAL_20_u1 1. _CNV_R_R_Def_dez_sl_551_CM 0. 1. FORMAT "%3.0" /end CHARACTERISTIC
/begin CHARACTERISTIC S_PMMESS "Schalter Messemode aktiv" VALUE 0xa08248f2 _REC_VAL_20_u1 1. _CNV_R_R_Def_dez_sl_551_CM 0. 1. FORMAT "%3.0" /end CHARACTERISTIC
/begin CHARACTERISTIC S_PMSOCFIT "Schalter zur Applikation SoC aus der Fitberechnung" VALUE 0xa0824bf2 _REC_VAL_20_u1 99.45 _CNV_R_R_Def_dez_sl_551_CM 0. 255. FORMAT "%3.0" /end CHARACTERISTIC
/begin CHARACTERISTIC S_PMSTARTQ "Applikationsschalter f. B_pmstartq" VALUE 0xa0824def _REC_VAL_20_u1 99.45 _CNV_R_R_Def_dez_sl_551_CM 0. 255. FORMAT "%3.0" /end CHARACTERISTIC
/begin CHARACTERISTIC S_PMSV_HEIZ "Standheizen wird für Nibble-historie ausgewertet" VALUE 0xa08247c1 _REC_VAL_20_u1 1. _CNV_R_R_Def_dez_sl_551_CM 0. 1. FORMAT "%3.0" /end CHARACTERISTIC
/begin CHARACTERISTIC S_PMSV_KLIMA "Standklimatisierung wird für Nibble-historie ausgewertet" VALUE 0xa08247c2 _REC_VAL_20_u1 1. _CNV_R_R_Def_dez_sl_551_CM 0. 1. FORMAT "%3.0" /end CHARACTERISTIC
/begin CHARACTERISTIC S_PMSV_LUFT "Standlueften wird für Nibble-historie ausgewertet" VALUE 0xa08247c3 _REC_VAL_20_u1 1. _CNV_R_R_Def_dez_sl_551_CM 0. 1. FORMAT "%3.0" /end CHARACTERISTIC
/begin CHARACTERISTIC S_PMTABSMN "Schalter für Applikation der Abstellzeit tabsmn_w" VALUE 0xa0824daf _REC_VAL_20_u1 99.45 _CNV_R_R_Def_dez_sl_551_CM 0. 255. FORMAT "%3.0" /end CHARACTERISTIC
/begin CHARACTERISTIC S_PM_TEST1 "Applikationsschalter um die Startberechnung zu erzwingen" VALUE 0xa0824df0 _REC_VAL_20_u1 99.45 _CNV_R_R_Def_dez_sl_551_CM 0. 255. FORMAT "%3.0" /end CHARACTERISTIC
/begin CHARACTERISTIC S_PRIOCFENA "Kein Langbezeichner vergeben" VALUE 0xa08248f3 _REC_VAL_20_u1 1. _CNV_R_R_Def_dez_sl_551_CM 0. 1. FORMAT "%3.0" /end CHARACTERISTIC
/begin CHARACTERISTIC S_PRIOMANUAL "Manueller Schalter fuer E60/E65-Can Botschaften" VALUE 0xa08248f4 _REC_VAL_20_u1 99.45 _CNV_R_R_Def_dez_sl_551_CM 0. 255. FORMAT "%3.0" /end CHARACTERISTIC
/begin CHARACTERISTIC S_PTCKOOR "Schalter Aktivierung PTC Koordinator im PMPRSVCALC" VALUE 0xa08248f5 _REC_VAL_20_u1 1. _CNV_R_R_Def_dez_sl_551_CM 0. 1. FORMAT "%3.0" /end CHARACTERISTIC
/begin CHARACTERISTIC S_PTCMANUAL "Schalter manueller PTC Wert aktivieren." VALUE 0xa08248f6 _REC_VAL_20_u1 1. _CNV_R_R_Def_dez_sl_551_CM 0. 1. FORMAT "%3.0" /end CHARACTERISTIC
/begin CHARACTERISTIC S_PWRCFENA "Kein Langbezeichner vergeben" VALUE 0xa08248f7 _REC_VAL_20_u1 1. _CNV_R_R_Def_dez_sl_551_CM 0. 1. FORMAT "%3.0" /end CHARACTERISTIC
/begin CHARACTERISTIC S_QSTARTFK "Schalter für Applikation q_startfgk" VALUE 0xa08248f8 _REC_VAL_20_u1 99.45 _CNV_R_R_Def_dez_sl_551_CM 0. 255. FORMAT "%3.0" /end CHARACTERISTIC
/begin CHARACTERISTIC S_QVCH2OON "Freischalten von U_Batt_max aus QVC sicht (IGR high)" VALUE 0xa0825220 _REC_VAL_20_u1 1. _CNV_R_R_Def_dez_sl_551_CM 0. 1. FORMAT "%3.0" /end CHARACTERISTIC
/begin CHARACTERISTIC S_REGK20K "Schalter Initialisierung von Q_k20lastreg mit K_BATTNORM anstatt mit C_battnenn" VALUE 0xa082542e _REC_VAL_20_u1 1. _CNV_R_R_Def_dez_sl_551_CM 0. 1. FORMAT "%3.0" /end CHARACTERISTIC
/begin CHARACTERISTIC S_REGOK_MAN "Schalter um Regeneration vorzeitig zu beenden " VALUE 0xa082542f _REC_VAL_20_u1 1. _CNV_R_R_Def_dez_sl_551_CM 0. 1. FORMAT "%3.0" /end CHARACTERISTIC
/begin CHARACTERISTIC S_REGPASS_MAN "Schalter auslösen passive Regeneration von Hand" VALUE 0xa0825430 _REC_VAL_20_u1 1. _CNV_R_R_Def_dez_sl_551_CM 0. 1. FORMAT "%3.0" /end CHARACTERISTIC
/begin CHARACTERISTIC S_REGSTART_MAN "Schalter Start Regeneration manuell" VALUE 0xa0825431 _REC_VAL_20_u1 1. _CNV_R_R_Def_dez_sl_551_CM 0. 1. FORMAT "%3.0" /end CHARACTERISTIC
/begin CHARACTERISTIC S_RESTOREAP1 "Schalter auf true, d h Werte werden aus Pmrestore übernommen" VALUE 0xa08247c4 _REC_VAL_20_u1 1. _CNV_R_R_Def_dez_sl_551_CM 0. 1. FORMAT "%3.0" /end CHARACTERISTIC
/begin CHARACTERISTIC S_RESTOREAP2 "Schalter auf true, d h Funktion der Übernahme der Individualwerte von Pmbackup nach Pmrestore kann getestet werden" VALUE 0xa08247c5 _REC_VAL_20_u1 1. _CNV_R_R_Def_dez_sl_551_CM 0. 1. FORMAT "%3.0" /end CHARACTERISTIC
/begin CHARACTERISTIC S_RIN "Schalter Applikation Innenwiderstandsprüfung" VALUE 0xa0824df1 _REC_VAL_20_u1 99.45 _CNV_R_R_Def_dez_sl_551_CM 0. 255. FORMAT "%3.0" /end CHARACTERISTIC
/begin CHARACTERISTIC S_SOCSTAFK "Schalter für Applikation SoC aus der Startfähigkeit" VALUE 0xa0824db0 _REC_VAL_20_u1 99.45 _CNV_R_R_Def_dez_sl_551_CM 0. 255. FORMAT "%3.0" /end CHARACTERISTIC
/begin CHARACTERISTIC S_SOC_BILA "Schalter für Applik. soc_bila" VALUE 0xa0824b88 _REC_VAL_20_u1 99.45 _CNV_R_R_Def_dez_sl_551_CM 0. 255. FORMAT "%3.0" /end CHARACTERISTIC
/begin CHARACTERISTIC S_SOC_QUAL "Schalter für Applik. soc_quali" VALUE 0xa0824b89 _REC_VAL_20_u1 99.45 _CNV_R_R_Def_dez_sl_551_CM 0. 255. FORMAT "%3.0" /end CHARACTERISTIC
/begin CHARACTERISTIC S_STARTAW "Startauswertung fertig" VALUE 0xa0824df2 _REC_VAL_20_u1 99.45 _CNV_R_R_Def_dez_sl_551_CM 0. 255. FORMAT "%3.0" /end CHARACTERISTIC
/begin CHARACTERISTIC S_UTNSTRTMSA "Schalter: 0: U_tnstart wird immer übernommen, 1: U_tnstart wird nur bei Spannung größer 6volt übernommen" VALUE 0xa0824df3 _REC_VAL_20_u1 1. _CNV_R_R_Def_dez_sl_551_CM 0. 1. FORMAT "%3.0" /end CHARACTERISTIC
/begin CHARACTERISTIC ZK_PMSOC "Zeitfaktor" VALUE 0xa0824bee _REC_VAL_20_u2 0.9999847412109381 _CNV_R_R_Def_f_uw_b_571_CM 0. 0.9999847412109381 FORMAT "%14.5" /end CHARACTERISTIC
/begin COMPU_METHOD _CNV_R_R_Def_f_sw_q_550_CM "Def_f_sw_q0p00153" RAT_FUNC "%6.3" "-" COEFFS 0. 32768. 0. 0. 0. 50. /end COMPU_METHOD
/begin COMPU_METHOD _CNV_R_R_Def_dez_sl_551_CM "Def_dez_sl_q1" RAT_FUNC "%6.3" "-" COEFFS 0. 1. 0. 0. 0. 1. /end COMPU_METHOD
/begin COMPU_METHOD _CNV_R_R_Def_f_ub_b_553_CM "Def_f_ub_b1" RAT_FUNC "%6.3" "-" COEFFS 0. 256. 0. 0. 0. 1. /end COMPU_METHOD
/begin COMPU_METHOD _CNV_R_R_Def_f_uw_b_555_CM "Def_f_uw_b100" RAT_FUNC "%6.3" "%" COEFFS 0. 65536. 0. 0. 0. 100. /end COMPU_METHOD
/begin COMPU_METHOD _CNV_R_R_Def_f_sw_b_556_CM "Def_f_sw_b32" RAT_FUNC "%6.3" "-" COEFFS 0. 32768. 0. 0. 0. 32. /end COMPU_METHOD
/begin COMPU_METHOD _CNV_R_R_Def_f_sw_p_557_CM "Def_f_sw_p0q25" RAT_FUNC "%6.3" "" COEFFS 0. 4. 0. 0. 0. 1. /end COMPU_METHOD
/begin COMPU_METHOD _CNV_S_2_Def_bit_ub_563_CM "Def_bit_ub_0" TAB_VERB "%6.3" "-" COMPU_TAB_REF _CNV_S_2_Def_bit_ub_563 /end COMPU_METHOD
/begin COMPU_VTAB _CNV_S_2_Def_bit_ub_563 "Def_bit_ub_0" TAB_VERB 2 0 "FALSE" 1 "TRUE" /end COMPU_VTAB
/begin COMPU_METHOD _CNV_R_R_Def_f_sw_b_570_CM "Def_f_sw_b100" RAT_FUNC "%6.3" "-" COEFFS 0. 32768. 0. 0. 0. 100. /end COMPU_METHOD
/begin COMPU_METHOD _CNV_R_R_Def_f_uw_b_571_CM "Def_f_uw_b1" RAT_FUNC "%6.3" "-" COEFFS 0. 65536. 0. 0. 0. 1. /end COMPU_METHOD
/begin COMPU_METHOD _CNV_R_R_Def_f_uw_b_572_CM "Def_f_uw_b8" RAT_FUNC "%6.3" "-" COEFFS 0. 65536. 0. 0. 0. 8. /end COMPU_METHOD
/begin COMPU_METHOD _CNV_R_R_Def_ql_ub__573_CM "Def_ql_ub_q1" RAT_FUNC "%6.3" "" COEFFS 0. 1. 0. 0. 0. 1. /end COMPU_METHOD
/begin COMPU_METHOD _CNV_R_R_Def_td_ub__574_CM "Def_td_ub_q0p1" RAT_FUNC "%6.3" "s" COEFFS 0. 10. 0. 0. 0. 1. /end COMPU_METHOD
/begin COMPU_METHOD _CNV_R_R_Def_f_ub_b_575_CM "Def_f_ub_b127p5" RAT_FUNC "%6.3" "%" COEFFS 0. 2. 0. 0. 0. 1. /end COMPU_METHOD
/begin COMPU_METHOD _CNV_R_R_Def_ql_uw__577_CM "Def_ql_uw_q0p0182" RAT_FUNC "%6.3" "Ah" COEFFS 0. 989. 0. 0. 0. 18. /end COMPU_METHOD
/begin COMPU_METHOD _CNV_R_R_Def_t_sw_q_578_CM "Def_t_sw_q0p1" RAT_FUNC "%6.3" "°C" COEFFS 0. 10. 0. 0. 0. 1. /end COMPU_METHOD
/begin COMPU_METHOD _CNV_R_R_Def_u_sw_q_580_CM "Def_u_sw_q0p00488" RAT_FUNC "%6.3" "V" COEFFS 0. 1024. 0. 0. 0. 5. /end COMPU_METHOD
/begin COMPU_METHOD _CNV_R_R_Def_u_sw_b_581_CM "Def_u_sw_b128" RAT_FUNC "%6.3" "V" COEFFS 0. 256. 0. 0. 0. 1. /end COMPU_METHOD
/begin COMPU_METHOD _CNV_R_R_Def_f_sl_q_582_CM "Def_f_sl_q0p007" RAT_FUNC "%6.3" "" COEFFS 0. 65536. 0. 0. 0. 512. /end COMPU_METHOD
/begin COMPU_METHOD _CNV_R_R_Def_u_sb_q_583_CM "Def_u_sb_q0p0942" RAT_FUNC "%6.3" "V" COEFFS 0. 1. 0. 0. 0. 9.420000000000001e-002 /end COMPU_METHOD
/begin COMPU_METHOD _CNV_R_R_Def_f_ub_b_586_CM "Def_f_ub_b100" RAT_FUNC "%6.3" "%" COEFFS 0. 256. 0. 0. 0. 100. /end COMPU_METHOD
/begin COMPU_METHOD _CNV_R_R_Def_n_sw_q_595_CM "Def_n_sw_q1p0" RAT_FUNC "%6.3" "Upm" COEFFS 0. 1. 0. 0. 0. 1. /end COMPU_METHOD
/begin COMPU_METHOD _CNV_R_R_Def_ql_uw__597_CM "Def_ql_uw_q0p29127" RAT_FUNC "%6.3" "" COEFFS 0. 103. 0. 0. 0. 30. /end COMPU_METHOD
/begin COMPU_METHOD _CNV_R_R_Def_f_sw_q_602_CM "Def_f_sw_q0p000147" RAT_FUNC "%6.3" "-" COEFFS 0. 64. 0. 0. 0. 9.420000000000001e-002 /end COMPU_METHOD
/begin COMPU_METHOD _CNV_R_R_Def_i_ub_q_608_CM "Def_i_ub_q0p00125" RAT_FUNC "%6.3" "" COEFFS 0. 800. 0. 0. 0. 1. /end COMPU_METHOD
/begin COMPU_METHOD _CNV_R_R_Def_td_ub__611_CM "Def_td_ub_q1" RAT_FUNC "%6.3" "s" COEFFS 0. 1. 0. 0. 0. 1. /end COMPU_METHOD
/begin COMPU_METHOD _CNV_R_R_Def_f_ub_b_612_CM "Def_f_ub_b32" RAT_FUNC "%6.3" "-" COEFFS 0. 256. 0. 0. 0. 32. /end COMPU_METHOD
/begin COMPU_METHOD _CNV_R_R_Def_f_ub_b_613_CM "Def_f_ub_b2" RAT_FUNC "%6.3" "-" COEFFS 0. 256. 0. 0. 0. 2. /end COMPU_METHOD
/begin COMPU_METHOD _CNV_R_R_Def_f_uw_b_621_CM "Def_f_uw_b256" RAT_FUNC "%6.3" "-" COEFFS 0. 65536. 0. 0. 0. 256. /end COMPU_METHOD
/begin COMPU_METHOD _CNV_R_R_Def_f_uw_b_626_CM "Def_f_uw_b512" RAT_FUNC "%6.3" "-" COEFFS 0. 65536. 0. 0. 0. 512. /end COMPU_METHOD
/begin COMPU_METHOD _CNV_R_R_Def_u_ub_q_631_CM "Def_u_ub_q0p1" RAT_FUNC "%6.3" "V" COEFFS 0. 10. 0. 0. 0. 1. /end COMPU_METHOD
/begin COMPU_METHOD _CNV_R_R_Def_f_ub_b_632_CM "Def_f_ub_b4" RAT_FUNC "%6.3" "-" COEFFS 0. 256. 0. 0. 0. 4. /end COMPU_METHOD
/begin COMPU_METHOD _CNV_R_R_Def_i_uw_q_634_CM "Def_i_uw_q0p08_o200" RAT_FUNC "%6.3" "" COEFFS 0. 25. 5000. 0. 0. 2. /end COMPU_METHOD
/begin COMPU_METHOD _CNV_R_R_Def_i_uw_q_639_CM "Def_i_uw_q0p08" RAT_FUNC "%6.3" "A" COEFFS 0. 25. 0. 0. 0. 2. /end COMPU_METHOD
/begin COMPU_METHOD _CNV_R_R_Def_i_sw_q_640_CM "Def_i_sw_q0p02" RAT_FUNC "%6.3" "A" COEFFS 0. 50. 0. 0. 0. 1. /end COMPU_METHOD
/begin COMPU_METHOD _CNV_R_R_Def_i_uw_q_642_CM "Def_i_uw_q0p02" RAT_FUNC "%6.3" "A" COEFFS 0. 1. 0. 0. 0. 2.e-002 /end COMPU_METHOD
/begin COMPU_METHOD _CNV_R_R_Def_i_ub_q_644_CM "Def_i_ub_q10" RAT_FUNC "%6.3" "A" COEFFS 0. 1. 0. 0. 0. 10. /end COMPU_METHOD
/begin COMPU_METHOD _CNV_R_R_Def_lm_uw__654_CM "Def_lm_uw_q0p000444" RAT_FUNC "%6.3" "kg" COEFFS 0. 2250. 0. 0. 0. 1. /end COMPU_METHOD
/begin COMPU_METHOD _CNV_R_R_Def_tn_uw__664_CM "Def_tn_uw_q1" RAT_FUNC "%6.3" "min" COEFFS 0. 1. 0. 0. 0. 1. /end COMPU_METHOD
/begin COMPU_METHOD _CNV_R_R_Def_td_uw__673_CM "Def_td_uw_q0p01" RAT_FUNC "%6.3" "s" COEFFS 0. 100. 0. 0. 0. 1. /end COMPU_METHOD
/begin COMPU_METHOD _CNV_R_R_Def_ql_ul__684_CM "Def_ql_ul_q2p7Em7" RAT_FUNC "%6.3" "Ah" COEFFS 0. 3600000. 0. 0. 0. 1. /end COMPU_METHOD
/begin COMPU_METHOD _CNV_R_R_Def_dez_ub_685_CM "Def_dez_ub_q0p5" RAT_FUNC "%6.3" "-" COEFFS 0. 2. 0. 0. 0. 1. /end COMPU_METHOD
/begin COMPU_METHOD _CNV_R_R_Def_f_ul_q_691_CM "Def_f_ul_q0p00047" RAT_FUNC "%6.3" "-" COEFFS 0. 6400. 0. 0. 0. 3. /end COMPU_METHOD
/begin COMPU_METHOD _CNV_R_R_Def_f_ub_b_694_CM "Def_f_ub_b8" RAT_FUNC "%6.3" "-" COEFFS 0. 256. 0. 0. 0. 8. /end COMPU_METHOD
/begin COMPU_METHOD _CNV_R_R_Def_u_uw_q_700_CM "Def_u_uw_q0p25em3_o6" RAT_FUNC "%6.3" "" COEFFS 0. -4000. 24000. 0. 0. -1. /end COMPU_METHOD
/begin COMPU_METHOD _CNV_R_R_Def_td_ub__708_CM "Def_td_ub_q14p9333" RAT_FUNC "%6.3" "min" COEFFS 0. 15. 0. 0. 0. 224. /end COMPU_METHOD
/begin COMPU_METHOD _CNV_R_R_Def_td_uw__709_CM "Def_td_uw_q14" RAT_FUNC "%6.3" "s" COEFFS 0. 1. 0. 0. 0. 14. /end COMPU_METHOD
/begin COMPU_METHOD _CNV_R_R_Def_td_uw__711_CM "Def_td_uw_q56" RAT_FUNC "%6.3" "s" COEFFS 0. 1. 0. 0. 0. 56. /end COMPU_METHOD
/begin COMPU_METHOD _CNV_R_R_Def_td_uw__712_CM "Def_td_uw_q0p933" RAT_FUNC "%6.3" "min" COEFFS 0. 15. 0. 0. 0. 14. /end COMPU_METHOD
/begin COMPU_METHOD _CNV_R_R_Def_u_sw_q_722_CM "Def_u_sw_q0p00025" RAT_FUNC "%6.3" "" COEFFS 0. 4000. 0. 0. 0. 1. /end COMPU_METHOD
/begin COMPU_METHOD _CNV_R_R_Def_u_uw_q_723_CM "Def_u_uw_q0p032" RAT_FUNC "%6.3" "V" COEFFS 0. 125. 0. 0. 0. 4. /end COMPU_METHOD
/begin COMPU_METHOD _CNV_R_R_Def_u_uw_q_724_CM "Def_u_uw_q0p015" RAT_FUNC "%6.3" "V" COEFFS 0. 200. 0. 0. 0. 3. /end COMPU_METHOD
/begin COMPU_METHOD _CNV_R_R_Def_v_uw_q_726_CM "Def_v_uw_q1p0" RAT_FUNC "%6.3" "km/h" COEFFS 0. 1. 0. 0. 0. 1. /end COMPU_METHOD
/begin COMPU_METHOD _CNV_R_R_Def_f_ub_q_745_CM "Def_f_ub_q0p001" RAT_FUNC "%6.3" "" COEFFS 0. 1000. 0. 0. 0. 1. /end COMPU_METHOD
/begin COMPU_METHOD _CNV_R_R_Def_i_ub_b_748_CM "Def_i_ub_b1000" RAT_FUNC "%6.3" "A" COEFFS 0. 256. 0. 0. 0. 1000. /end COMPU_METHOD
/begin COMPU_METHOD _CNV_R_R_Def_i_ub_q_758_CM "Def_i_ub_q5p12" RAT_FUNC "%6.3" "" COEFFS 0. 25. 0. 0. 0. 128. /end COMPU_METHOD
/begin RECORD_LAYOUT _REC_VAL_20_u1 FNC_VALUES 1 UBYTE COLUMN_DIR DIRECT /end RECORD_LAYOUT
/begin RECORD_LAYOUT _REC_VAL_20_u2 FNC_VALUES 1 UWORD COLUMN_DIR DIRECT /end RECORD_LAYOUT
/begin RECORD_LAYOUT _REC_VAL_20_s2 FNC_VALUES 1 SWORD COLUMN_DIR DIRECT /end RECORD_LAYOUT
/begin RECORD_LAYOUT _REC_MAP_52_UBYTE_u2_s2_u2 NO_AXIS_PTS_X 1 UBYTE NO_AXIS_PTS_Y 2 UBYTE AXIS_PTS_X 3 SWORD INDEX_INCR DIRECT AXIS_PTS_Y 4 UWORD INDEX_INCR DIRECT FNC_VALUES 5 UWORD COLUMN_DIR DIRECT /end RECORD_LAYOUT
/begin RECORD_LAYOUT _REC_MAP_52_UBYTE_u2_s2_s2 NO_AXIS_PTS_X 1 UBYTE NO_AXIS_PTS_Y 2 UBYTE AXIS_PTS_X 3 SWORD INDEX_INCR DIRECT AXIS_PTS_Y 4 SWORD INDEX_INCR DIRECT FNC_VALUES 5 UWORD COLUMN_DIR DIRECT /end RECORD_LAYOUT
/begin RECORD_LAYOUT _REC_MAP_52_UBYTE_u2_u2_s2 NO_AXIS_PTS_X 1 UBYTE NO_AXIS_PTS_Y 2 UBYTE AXIS_PTS_X 3 UWORD INDEX_INCR DIRECT AXIS_PTS_Y 4 SWORD INDEX_INCR DIRECT FNC_VALUES 5 UWORD COLUMN_DIR DIRECT /end RECORD_LAYOUT
/begin RECORD_LAYOUT _REC_MAP_52_UBYTE_s2_s2_u1 NO_AXIS_PTS_X 1 UBYTE NO_AXIS_PTS_Y 2 UBYTE AXIS_PTS_X 3 SWORD INDEX_INCR DIRECT AXIS_PTS_Y 4 UBYTE INDEX_INCR DIRECT FNC_VALUES 5 SWORD COLUMN_DIR DIRECT /end RECORD_LAYOUT
/begin RECORD_LAYOUT _REC_MAP_52_u1_s2_u2 NO_AXIS_PTS_X 1 UBYTE NO_AXIS_PTS_Y 2 UBYTE AXIS_PTS_X 3 SWORD INDEX_INCR DIRECT AXIS_PTS_Y 4 UWORD INDEX_INCR DIRECT FNC_VALUES 5 UBYTE COLUMN_DIR DIRECT /end RECORD_LAYOUT
/begin RECORD_LAYOUT _REC_MAP_52_u1_u1_s2 NO_AXIS_PTS_X 1 UBYTE NO_AXIS_PTS_Y 2 UBYTE AXIS_PTS_X 3 UBYTE INDEX_INCR DIRECT AXIS_PTS_Y 4 SWORD INDEX_INCR DIRECT FNC_VALUES 5 UBYTE COLUMN_DIR DIRECT /end RECORD_LAYOUT
/begin RECORD_LAYOUT _REC_CUR_TKL_UW_VV__u2_u2 NO_AXIS_PTS_X 1 UBYTE RESERVED 2 BYTE AXIS_PTS_X 3 UWORD INDEX_INCR DIRECT FNC_VALUES 4 UWORD COLUMN_DIR DIRECT /end RECORD_LAYOUT
/begin RECORD_LAYOUT _REC_CUR_TKL_UW_VV__u2_s2 NO_AXIS_PTS_X 1 UBYTE RESERVED 2 BYTE AXIS_PTS_X 3 SWORD INDEX_INCR DIRECT FNC_VALUES 4 UWORD COLUMN_DIR DIRECT /end RECORD_LAYOUT
/begin RECORD_LAYOUT _REC_CUR_TKL_UW_VV__u1_s2 NO_AXIS_PTS_X 1 UBYTE RESERVED 2 BYTE AXIS_PTS_X 3 SWORD INDEX_INCR DIRECT FNC_VALUES 4 UBYTE COLUMN_DIR DIRECT /end RECORD_LAYOUT
/begin RECORD_LAYOUT _REC_CUR_TKL_UW_VV__s2_s2 NO_AXIS_PTS_X 1 UBYTE RESERVED 2 BYTE AXIS_PTS_X 3 SWORD INDEX_INCR DIRECT FNC_VALUES 4 SWORD COLUMN_DIR DIRECT /end RECORD_LAYOUT
/begin RECORD_LAYOUT _REC_CUR_TKL_UW_VV__u1_u2 NO_AXIS_PTS_X 1 UBYTE RESERVED 2 BYTE AXIS_PTS_X 3 UWORD INDEX_INCR DIRECT FNC_VALUES 4 UBYTE COLUMN_DIR DIRECT /end RECORD_LAYOUT
/begin RECORD_LAYOUT _REC_CUR_TKL_UW_VV__s2_u2 NO_AXIS_PTS_X 1 UBYTE RESERVED 2 BYTE AXIS_PTS_X 3 UWORD INDEX_INCR DIRECT FNC_VALUES 4 SWORD COLUMN_DIR DIRECT /end RECORD_LAYOUT
/begin RECORD_LAYOUT _REC_CUR_TKL_UW_VV__u1_u1 NO_AXIS_PTS_X 1 UBYTE RESERVED 2 BYTE AXIS_PTS_X 3 UBYTE INDEX_INCR DIRECT FNC_VALUES 4 UBYTE COLUMN_DIR DIRECT /end RECORD_LAYOUT
/begin RECORD_LAYOUT _REC_CUR_TKL_UW_VV__s2_u1 NO_AXIS_PTS_X 1 UBYTE RESERVED 2 BYTE AXIS_PTS_X 3 UBYTE INDEX_INCR DIRECT FNC_VALUES 4 SWORD COLUMN_DIR DIRECT /end RECORD_LAYOUT
/begin RECORD_LAYOUT _REC_CUR_TKL_UW_VV__u2_u1 NO_AXIS_PTS_X 1 UBYTE RESERVED 2 BYTE AXIS_PTS_X 3 UBYTE INDEX_INCR DIRECT FNC_VALUES 4 UWORD COLUMN_DIR DIRECT /end RECORD_LAYOUT
/begin RECORD_LAYOUT _REC_VAL_2_u1 FNC_VALUES 1 UBYTE COLUMN_DIR DIRECT /end RECORD_LAYOUT
/begin RECORD_LAYOUT _REC_VAL_2_u2 FNC_VALUES 1 UWORD COLUMN_DIR DIRECT /end RECORD_LAYOUT
/begin FUNCTION LLPMCTRL ""
 /begin DEF_CHARACTERISTIC K_DFLLMIN K_DFMAX K_DSOCHYST K_DSOCLLANH K_LLANHAPP K_LLPMAPP K_NLLMIN S_LLABSTYP S_N_IDLIBS /end DEF_CHARACTERISTIC
 /begin OUT_MEASUREMENT N_idlibs /end OUT_MEASUREMENT
 /begin IN_MEASUREMENT D_soc Dfgenfilt Gen_dfvorhs Nkw St_bgkuppl1 St_bgkuppl1.B_ll St_dgen0 St_dgen0.B_1stbsder St_dgen0.B_genfprl St_dgen0.B_gfbsupak St_dgen0.B_gfelak St_dgen0.B_gfhtak St_dgen0.B_gfmeak St_dgen0.B_gfnobsak St_dgen0.B_kl61 St_dibs1 St_dibs1.B_ifbsak St_dibs1.B_ifebsak St_dibs1.B_ifuplak St_dibs2 St_dibs2.B_ifisak St_dibs2.B_ifsysak St_dibs2.B_iftempak St_dibs2.B_ifusak St_dibs2.B_ifwugdak St_dibs2.B_ifwuplak St_pmsockor0 St_pmsockor0.B_Tabstpla St_pmsockor0.B_abschfit St_pmsockor0.B_pm_fit2 St_pmsockor0.B_pm_fit3 St_pmsockor0.B_pmsocini St_pmsockor0.B_soc_npl /end IN_MEASUREMENT
/end FUNCTION
/begin FUNCTION PMBATTMNG ""
 /begin DEF_CHARACTERISTIC CW_BATTCOD KF_BATT1 KF_BATT2 KF_MAXENTL KF_UBATT_LL KF_USOLL KL_BATTLSTR KL_ENTLADEZ KL_EXPALH KL_EXPALV KL_EXPBETAV KL_LADEKENNL KL_UBSOLLTR KL_UBTMTL KL_USOLL2 K_APPTBATINI K_BATTCNENN1 K_BATTCNENN2 K_BATTHTAUVG K_BATTHTAUVK K_BATTMXOFF K_BATTORT0 K_BATTORT2 K_BATTVTAUVG K_BATTVTAUVK K_BATT_ALFAH K_BATT_ALFAV K_BATT_BETAV K_BATVFZGTAU K_DELTA1 K_DELTA2 K_DSOCDELTA1 K_DSOCDELTA2 K_DTANSKOR K_ILMINUMG K_KAPAVERLU K_LBATTMAXK K_LBATTMAXM K_LBATTTUMG K_LBATTTUMGBA K_MCOBATTORT K_NMINUMG K_OFTUMGCAN K_PLBATTUMG K_PMRDM2LMSA K_PR_BAPPDMN K_PR_BAPPMX K_PR_BAPPSMN K_PR_BAPPSOLL K_PR_BATTMX K_PR_UBSOLL K_PR_UBSOLLTR K_PR_UDBMN_H K_PR_UDBMN_L K_PR_UDBMN_M K_PR_USBMN_H K_PR_USBMN_L K_QV_NPL K_QV_QUALIMX K_RLTG_PWE65 K_TBATINIMAN K_TBATTFTAUV K_TBATTTAUFH K_TBTFREIMAX K_TBTMXIGRLO K_TBTPAUMIN K_TDUB K_TIMERDLY K_TUMGINI K_TUMGTAU K_UBAPPDMN K_UBAPPMX K_UBAPPSMN K_UBAPPSOLL K_UBATTMN_L K_UBATTMN_M K_UBATTNORM K_UBATT_MX K_UBDET_U K_UBNOTLAUF K_UBSOLLREG K_UBTDET_U K_ULADE_TAU K_VMINUMG K_ZYK_BTMXF S_BATTAPP S_BATTEMP S_BREGENU_HI S_BZE_EN S_IBSTESTEN1 S_IBSTESTEN2 S_LBATT1 S_LBATT2 S_LBATTAPPL S_QVCH2OON /end DEF_CHARACTERISTIC
 /begin OUT_MEASUREMENT Batt_h2m_l Batt_h2m_r Batt_m2l Batt_m2l_l Batt_m2l_r Batt_ort Batt_tfil D_ubatt_bt Entladezeit Kapa_verlust Ladezeit Pr_batt_mx Pr_batt_soll Pr_dynbatt_mn Pr_stabatt_mn St_pmbattmng0 St_pmbattmng0.B_batt_entl St_pmbattmng0.B_bt_timer St_pmbattmng0.B_btmaxfrei St_pmbattmng0.B_btpau St_pmbattmng0.B_dly_tbi St_pmbattmng0.B_ibsok St_pmbattmng0.B_inibumg St_pmbattmng1 St_pmbattmng1.B_batt_bad St_pmbattmng1.B_batt_good St_pmbattmng1.B_lbatteinih St_pmbattmng1.B_lbatteiniv St_pmbattmng1.B_lbattenh St_pmbattmng1.B_lbattenv St_pmbattmng1.B_lbattinit St_pmbattmng1.B_noctrgen St_pmbattmng2 St_pmbattmng2.B_agmverbaut St_pmbattmng2.B_entladung St_pmbattmng2.B_entlfrei St_pmbattmng2.B_taerr_1 T_batstiniv T_batt T_batt_ini T_batt_lb T_batt_zw T_batt_zw2 T_batt_zw3 T_batt_zw4 T_battabst Tumg_abst Tumg_battab Tumg_dt Tumg_ers Tumg_tp U_batt_ll U_batt_max U_batt_min U_batt_mx U_batt_soll U_battsoll U_bsoll_lcp U_bsoll_ulcp U_bt_mtl U_deltau U_dynbatt_mn U_lade U_stabatt_mn Zentlact Zladungact /end OUT_MEASUREMENT
 /begin IN_MEASUREMENT Batt_coort Bordnetz C_battnenn D_soc Fahrzeug I_gen Mslui Nkw Pr_bn_soll Qelad_ges Qv_out_m Qv_quali_m Soc_rel St_dibs1 St_dibs1.B_ifbsak St_dibs1.B_ifebsak St_dibs1.B_ifuplak St_dibs2 St_dibs2.B_ifisak St_dibs2.B_ifsysak St_dibs2.B_iftempak St_dibs2.B_ifusak St_dibs2.B_ifwugdak St_dibs2.B_ifwuplak St_igrin St_igrin.B_fe St_igrin.B_fetrawedeak St_igrin.B_tra St_igrin.B_we St_pmbattregen St_pmbattregen.B_battregen St_pmbattregen.B_battregini St_pmi_nv St_pmi_nv.B_fapmmess St_pmi_nv.B_ulcp St_pmsockor0 St_pmsockor0.B_Tabstpla St_pmsockor0.B_abschfit St_pmsockor0.B_pm_fit2 St_pmsockor0.B_pm_fit3 St_pmsockor0.B_pmsocini St_pmsockor0.B_soc_npl St_pwf St_pwf.B_pwf St_qvc1 St_qvc1.B_qvch2o St_tan St_tan.B_taners St_tum St_tum.B_tumers T_batt_ibs T_saison Tans Tn_abstell Tumg_can U_batt U_gensollpm Ub V /end IN_MEASUREMENT
/end FUNCTION
/begin FUNCTION PMBATTREGEN ""
 /begin DEF_CHARACTERISTIC KL_WSOCLOW K_BATTNORM K_BATTREGINI K_DIFFCBN K_DQ_AUSLOES K_FAKTEF_ERH K_LADEFAKT K_QSULMIN K_REGEN_ON K_REGPASS_ON K_REGSTART K_REGSTOP K_REGTUERH K_SOCLOW_Q K_SOCMINPASS K_SOCPASSRST K_UERHMIN K_WABSTELL S_BATTCHGINI S_REGK20K S_REGOK_MAN S_REGPASS_MAN S_REGSTART_MAN /end DEF_CHARACTERISTIC
 /begin OUT_MEASUREMENT Dod_start Dqe_regstart Dql_regstart I_qcnt Q_k20lastreg Q_regelad Q_regend Q_regerh Q_regerhbeg Q_reglad Q_zrreguh Qe_fahr Ql_fahr Rest_k20 St_pmbattreg2 St_pmbattreg2.B_aktregok St_pmbattreg2.B_regokzw St_pmbattreg2.B_regokzw4 St_pmbattreg2.B_regokzw5 St_pmbattreg2.B_regpass St_pmbattreg2.B_regstart1 St_pmbattreg2.B_regstart2 St_pmbattreg2.B_tsocbadini St_pmbattregen St_pmbattregen.B_battregen St_pmbattregen.B_battregini St_pmbattregen2 St_pmbattregen2.B_regokzw2 St_pmbattregen2.B_regokzw3 St_pmbattregen2.B_uhighregok St_pmbattregen2.B_zwregok Td_regen Td_regen0 Td_soclow Zr_regen Zr_regsoclow Zw1 Zw10 Zw11 Zw12 Zw2 Zw3 Zw4 Zw5 Zw6 Zw7 Zw8 Zw9 /end OUT_MEASUREMENT
 /begin IN_MEASUREMENT C_battnenn I_batt Kapa_verlust Pminfo1 Qelad Qlad Soc_rel St_pmi St_pmi.B_fabttreg St_pmi.B_fahisrst St_pmi.B_pmrestore St_pmsockor0 St_pmsockor0.B_Tabstpla St_pmsockor0.B_abschfit St_pmsockor0.B_pm_fit2 St_pmsockor0.B_pm_fit3 St_pmsockor0.B_pmsocini St_pmsockor0.B_soc_npl St_pwf St_pwf.B_pwf Tn_abstellm U_batt /end IN_MEASUREMENT
/end FUNCTION
/begin FUNCTION PMDIAG ""
 /begin DEF_CHARACTERISTIC CW_CCMASK CW_PMDEFMASK CW_PMMASKDFP KL_CLASS2IND KL_CLASS2NENN KL_T2RELMAX KL_T2RELMXRG KL_T3RELMAX KL_T3RELMXRG KL_T4RELMAX KL_T4RELMXRG K_ABKORROVER K_BATTINDAPP K_BATTREGAPP K_BUPACTRATE K_CBATTAPP K_CCNOT K_CCPRIOSET K_CCPRIOTIME K_CCPWRSET K_DSOCHYSTCC K_DSOCLOW K_GQVCC K_GQVH2OCC K_GQVH2OQCC K_GQVQUALICC K_HISTDMERST K_HISTIBSRST K_IWAKEAPP K_KSOGRZAPP K_KSUGRZAPP K_OSPGAPP K_OSPGHYST K_OSPGPRELLZ K_OSPRELLDEC K_OSPRELLINC K_QELADGESMX K_QLADGESMX K_RUHVERMODE K_T1PMINFO K_T2PMINFO K_T3PMINFO K_TBATNACHL K_TCODIERPM K_TIMSET K_TQVCC K_TRINGSHIFT K_T_CCRUHVER K_T_KMSHIFT K_T_OSPGRSET K_T_OSPGSET K_T_RUHAUSW K_T_SQSHIFT K_T_TIEFPRE K_T_USPGRSET K_T_USPGSET K_USPGAPP K_USPGHYST K_USPGPRELLZ K_USPRELLDEC K_USPRELLINC S_NOLIMQELAD S_NOLIMQLAD S_PMSV_HEIZ S_PMSV_KLIMA S_PMSV_LUFT S_RESTOREAP1 S_RESTOREAP2 /end DEF_CHARACTERISTIC
 /begin REF_CHARACTERISTIC K_DIF_TIABST K_UTIEFAPP /end REF_CHARACTERISTIC
 /begin OUT_MEASUREMENT Batt_index C_battnenn Codiercnt Dqelad7 Dqlad7 Fs_pm Ibsbor_hb Ikurz_ogrz Ikurz_ugrz Iwakeupgrz Ospgcnt Ospgprell Ospgstat Pm_klemmstat Pmbackup Pminfo1 Pminfo2 Qeladold7 Qladold7 Qladzwsp7 Qvcbackup1 Qvcbackup2 Qvcbackup3 St_pmdiag0 St_pmdiag0.B_ccbtnach St_pmdiag0.B_ccbttdfk St_pmdiag0.B_ccbttknt St_pmdiag0.B_ccpmerr St_pmdiag0.B_ccprio St_pmdiag0.B_codierpm St_pmdiag0.B_pcoschg St_pmdiag0.B_tiefrset St_pmdiag1 St_pmdiag1.B_Tabstpl St_pmdiag1.B_batttrue St_pmdiag1.B_ccruhver St_pmdiag1.B_histrset St_pmdiag1.B_qelad1step St_pmdiag1.B_ruhverl7 St_pmdiag1.B_sv_ihka St_pmdiag1.B_timer_rst St_pmdiag2 St_pmdiag2.B_tiefsetok St_pmdiagnv St_pmdiagnv.B_ruhverl Stat_sv_reg Stat_sv_reg1 Stat_sv_reg2 Svaus T1histshort T1pmcntr T2hist T2histshort T2pmcntr T3hist T3histshort T3pmcntr T4hist T4histshort T_histruhm T_histsum T_histsummin T_saismem Tn_abstellloc Ubattloc Ubattloc_1 Ubattloc_2 Uspgcnt Uspgprell Uspgstat Ztagedelta Ztageold Ztagestate /end OUT_MEASUREMENT
 /begin IN_MEASUREMENT Absch_korr Batt_class Ctrpcos7 Ctrprio Ctrpriocf Ctrpwrcos D_soc Ibs_msgind Ibs_msgsta Ibs_start Ibsborctr Ibsderrs1 Ibsderrs2 Ibsdncsctr Ibseromctr Ibsporctr Ibspromctr Ibsptyctr Ibsramctr Ibswdtctr Ikurz_ogr Ikurz_ugr Iwakeupgr Kalevcnt Km_st Ktupcsctr Pmrestore Pmsv Qelad Qlad Qv_h2o Qv_h2oquali Qv_out_m Qv_quali_m Soc_fit Soc_quali Soc_rel Soc_stfgk St_bns St_bns.B_bns St_ckl15 St_ckl15.B_ckl30 St_ckl15.B_ckl50 St_dibs1 St_dibs1.B_ifbsak St_dibs1.B_ifebsak St_dibs1.B_ifuplak St_dibs2 St_dibs2.B_ifisak St_dibs2.B_ifsysak St_dibs2.B_iftempak St_dibs2.B_ifusak St_dibs2.B_ifwugdak St_dibs2.B_ifwuplak St_ibebsd1 St_ibebsd1.B_eb_busy St_ibebsd1.B_eb_errdir St_ibebsd1.B_eb_txok St_ibebsd1.B_ibs_msgrdy St_ibebsd1.B_ibs_msgwri St_ibserr St_ibserr.B_ibfbsd St_ibserr.B_ibfebsd St_ibserr.B_ibunplau St_ibsreg4 St_ibsreg4.B_ibspwf St_ibsreg4.B_startfgk St_ibsreg4.B_strtaw St_ibsreg4.B_tiefset St_kl15 St_kl15.B_kl15_ep St_kl15.B_kl15_vorab St_mkwchn St_mkwchn.B_kwdreht St_pmdiag0.B_ccbtnach St_pmdiag0.B_ccbttdfk St_pmdiag0.B_ccbttknt St_pmdiag0.B_ccpmerr St_pmdiag0.B_ccprio St_pmdiag0.B_codierpm St_pmdiag0.B_pcoschg St_pmdiag0.B_tiefrset St_pmdiag1.B_Tabstpl St_pmdiag1.B_batttrue St_pmdiag1.B_ccruhver St_pmdiag1.B_histrset St_pmdiag1.B_qelad1step St_pmdiag1.B_ruhverl7 St_pmdiag1.B_sv_ihka St_pmdiag1.B_timer_rst St_pmi St_pmi.B_fabttreg St_pmi.B_fahisrst St_pmi.B_pmrestore St_pmi_nv St_pmi_nv.B_fapmmess St_pmi_nv.B_ulcp St_pmsockor0 St_pmsockor0.B_Tabstpla St_pmsockor0.B_abschfit St_pmsockor0.B_pm_fit2 St_pmsockor0.B_pm_fit3 St_pmsockor0.B_pmsocini St_pmsockor0.B_soc_npl Stfgk_state T1histiruh T2histiruh T3histiruh T4histiruh T_batt T_saison Tn_abstellm U_batt Ztageabs /end IN_MEASUREMENT
/end FUNCTION
/begin FUNCTION PMPRSVCALC ""
 /begin DEF_CHARACTERISTIC KF_IBTSOLL KL_DFPRIO KL_DFPTC KL_DSOCPRIO KL_DSOCPTC KL_DUDTPTC KL_I2PTC KL_IREST KL_ISOLLPR KL_PRIO2PTC KL_PRIOCF KL_PRIODF KL_PTC KL_PWRCF KL_PWRDF KL_SOCPRIO KL_SSOC_DIF KL_UBTPRIO KL_UB_PTC KL_WUBPTC K_CTRCBRA K_CTRCBRAPP K_CTRPCOSAPP K_CTRPRIOAPP K_CTRPRIOCF K_CTRPWRCF K_CTRPWRDF K_DFFILTAPP K_DFKOMMERR K_DFPTC_LP K_DF_LP K_DUDTPTCAUS K_IBSWAKEAPP K_IPMPMDEC K_IPMPMINC K_LLPMFILTK K_MAXSTART K_MN_PTCPI K_MN_PWRDFPI K_MX_PTCPI K_NKW2HIPTC K_NKW2LOWPTC K_PM_IPMON K_PRIO15 K_PRIOCF15 K_PRIOCFAPP K_PRIOCF_R K_PRIODF K_PRIO_R K_PTCPWRAPP K_PTC_PI K_PWRCOS15 K_PWRCOSAPP K_PWRCOSHT K_PWRCOSNOTL K_PWRCOSULEV K_PWRCOS_R K_PWRCSGNDEF K_PWRDF_PI K_QSTARTFGA K_RESET_PI K_RQPCOSA K_RQPCOSAPP K_RQULCP K_SELSPCOSA K_SELSPCSAPP K_STPCOSAPP K_TD_PWRDFPI K_T_IPMPRIO K_T_NKPTCAUS K_T_PMBS K_T_PMVS K_T_PTCKWAN K_T_PTCPI K_T_SULEVON K_UBAT_LP K_UBPTC_LP K_UBTAPP K_UBTLOWMAX K_UBTLOWMIN K_ULEVA K_ULEVAPP K_ULOWSETAPP S_DFKOMMERR S_IPMPTC S_PMMESS S_PRIOCFENA S_PRIOMANUAL S_PTCKOOR S_PTCMANUAL S_PWRCFENA S_QSTARTFK /end DEF_CHARACTERISTIC
 /begin REF_CHARACTERISTIC K_IB_COMMVAL /end REF_CHARACTERISTIC
 /begin OUT_MEASUREMENT All2ptc Allptcfilt Ctrcbr Ctrcbr7 Ctrcbrmem Ctrpcos Ctrpcos7 Ctrpcosmem Ctrprio Ctrprio7 Ctrpriocf Ctrpriocf7 Ctrpriocfm Ctrpriomem Ctrpwrcf Ctrpwrcos Ctrpwrcos7 Ctrpwrdf Ctrpwrmem Ctrpwspcos D_udtptc Df2pi Dfall2pi Dfallpi Dff_filt7 Dfgenfilt Dfpi2ptc Dfprio Dfpt1_2ptc Dfpt1filt Dfpt1ptc Dif_stfgk1u2 Dsoc2pi Dsoc2ptc Dudtmul F_dudtptc Ibtdiff Ibtdiff2pi Ibtsoll Idiff2ptc Igenrest Ipmdfprio Isolldiff Memprio1 Memprio2 Memptc1 Memptc2 Pgen2ptc Pgenrest Picntr Pmbscount Pmvscount Priopizw1 Priopizw2 Ptc_pwr Ptc_pwr7 Ptcadd Ptcpizw1 Ptcpizw2 Pwrspmem Q_startfgk Rqpcos Rqpcos7 Rqpcosmem Selspcos Selspcosme St_pmprsv_nv St_pmprsv_nv.B_enwake7 St_pmprsvcalc St_pmprsvcalc.B_gendef St_pmprsvcalc.B_ipmaktiv St_pmprsvcalc.B_ipmtimer St_pmprsvcalc.B_kwdr_old St_pmprsvcalc.B_nkwptcio St_pmprsvcalc.B_ptckoor St_pmprsvcalc.B_ubtlow St_pmprsvcalc.B_uloreset St_pmprsvcalc1 St_pmprsvcalc1.B_dubt St_pmprsvcalc1.B_enwakeup St_pmprsvcalc1.B_limcalc St_pmprsvcalc1.B_notprsv St_pmprsvcalc1.B_pireset St_pmprsvcalc1.B_pmbsdanf St_pmprsvcalc1.B_pmvsdanf St_pmprsvcalc2 St_pmprsvcalc2.B_kwdrise St_pmprsvcalc2.B_pmsulevon St_pmprsvcalc2.B_q_start Stfgk_state Stpcos Stpcos7 Stpcosmem Ubdiff Ubdiff2pi Ubdiffilt Ubdiffptc Ubold7 Ubt Ubt7 Ubt7mem Ubt7old Ubtpt12ptc Ubtpt1ptc Udeltaabsc Udeltac Ulev Ulevmem Ulow Ulowtimer /end OUT_MEASUREMENT
 /begin IN_MEASUREMENT C_battnenn Ctrpwrentl D_soc Dffgen I_batt I_gen I_genmax Ib_commcnt Ibs_msgind Ibs_msgsta Ibs_start Kalevcnt Nkw Ptc_entl St_dgen0 St_dgen0.B_1stbsder St_dgen0.B_genfprl St_dgen0.B_gfbsupak St_dgen0.B_gfelak St_dgen0.B_gfhtak St_dgen0.B_gfmeak St_dgen0.B_gfnobsak St_dgen0.B_kl61 St_dibs1 St_dibs1.B_ifbsak St_dibs1.B_ifebsak St_dibs1.B_ifuplak St_dibs2 St_dibs2.B_ifisak St_dibs2.B_ifsysak St_dibs2.B_iftempak St_dibs2.B_ifusak St_dibs2.B_ifwugdak St_dibs2.B_ifwuplak St_gen St_ibebsd1 St_ibebsd1.B_eb_busy St_ibebsd1.B_eb_errdir St_ibebsd1.B_eb_txok St_ibebsd1.B_ibs_msgrdy St_ibebsd1.B_ibs_msgwri St_ibserr St_ibserr.B_ibfbsd St_ibserr.B_ibfebsd St_ibserr.B_ibunplau St_kl15 St_kl15.B_kl15_ep St_kl15.B_kl15_vorab St_loadresp0 St_loadresp0.B_genoffmd St_loadresp0.B_genoffst St_loadresp0.B_sulevvoff St_mdna St_mdna.B_lastab St_mkwchn St_mkwchn.B_kwdreht St_pmdiag0 St_pmdiag0.B_ccbtnach St_pmdiag0.B_ccbttdfk St_pmdiag0.B_ccbttknt St_pmdiag0.B_ccpmerr St_pmdiag0.B_ccprio St_pmdiag0.B_codierpm St_pmdiag0.B_pcoschg St_pmdiag0.B_tiefrset St_pmentl0 St_pmentl0.B_ent4frei St_pmentl0.B_pwrentl St_pmi_nv St_pmi_nv.B_fapmmess St_pmi_nv.B_ulcp St_pmprsvcalc1.B_dubt St_pmprsvcalc1.B_enwakeup St_pmprsvcalc1.B_limcalc St_pmprsvcalc1.B_notprsv St_pmprsvcalc1.B_pireset St_pmprsvcalc1.B_pmbsdanf St_pmprsvcalc1.B_pmvsdanf St_pmsockor0 St_pmsockor0.B_Tabstpla St_pmsockor0.B_abschfit St_pmsockor0.B_pm_fit2 St_pmsockor0.B_pm_fit3 St_pmsockor0.B_pmsocini St_pmsockor0.B_soc_npl T_batt T_saison U_batt U_batt_soll Ub /end IN_MEASUREMENT
/end FUNCTION
/begin FUNCTION PMSOCCALC ""
 /begin DEF_CHARACTERISTIC CBATT_DEF KF_SOC0UBIB KF_SOCLF KL_SOC0TEMP K_IB_COMMVAL K_PMQ_UX K_Q_BILAPWF K_SOC_BILAWA K_SOC_QPWF K_SOC_QUALIA S_BSOCCALC S_SOC_BILA S_SOC_QUAL /end DEF_CHARACTERISTIC
 /begin REF_CHARACTERISTIC K_QSOCCL1 K_QSOCCL2 /end REF_CHARACTERISTIC
 /begin OUT_MEASUREMENT Battfak Cbatt_lo D_qelad D_qlad Ib_commcnt Ib_commsta Isoc0loc Kalevcnt Q_bila Qeladold Qladold Soc_b_loc Soc_b_loc1 Soc_b_loc2 Soc_bila Soc_q_loc Soc_quali St_pmsocalc1 St_pmsocalc1.B_ibspwf_e St_pmsoccalc St_pmsoccalc.B_soc_pwf St_pmsoccalc.B_soccalc Tsocloc Ubatt0 /end OUT_MEASUREMENT
 /begin IN_MEASUREMENT C_battnenn I_soc0 Ibs_msgind Ibs_msgsta Ibs_start Qelad Qeladsoc0 Qlad Qladsoc0 St_ibebsd1 St_ibebsd1.B_eb_busy St_ibebsd1.B_eb_errdir St_ibebsd1.B_eb_txok St_ibebsd1.B_ibs_msgrdy St_ibebsd1.B_ibs_msgwri St_ibsreg4 St_ibsreg4.B_ibspwf St_ibsreg4.B_startfgk St_ibsreg4.B_strtaw St_ibsreg4.B_tiefset St_pwf St_pwf.B_pwf T_batt T_battsoc0 U1soc0 U2soc0 U3soc0 /end IN_MEASUREMENT
/end FUNCTION
/begin FUNCTION PMSOCFIT ""
 /begin DEF_CHARACTERISTIC KF_PMRIBAT1 KF_PMRIBAT2 KF_PMRIBAT3 KF_PMRIBAT4 KF_PMRIBAT5 KF_PMRIBAT6 KF_PMRIBAT7 KF_PMRIBAT8 KL_PMSOCVU K_FITDEF K_I_FITAUSW K_SOCFITAPP S_FITINI S_FITNPL S_PMSOCFIT ZK_PMSOC /end DEF_CHARACTERISTIC
 /begin OUT_MEASUREMENT Soc_fit Soc_fit_temp Ubatts2 /end OUT_MEASUREMENT
 /begin IN_MEASUREMENT Batt_index I_batt Soc_rel St_pmsockor0 St_pmsockor0.B_Tabstpla St_pmsockor0.B_abschfit St_pmsockor0.B_pm_fit2 St_pmsockor0.B_pm_fit3 St_pmsockor0.B_pmsocini St_pmsockor0.B_soc_npl T_batt U_batt /end IN_MEASUREMENT
/end FUNCTION
/begin FUNCTION PMSOCKOR ""
 /begin DEF_CHARACTERISTIC KL_FITGRZ KL_SSOC K_ABSCHKORA K_BILA_OGRZ K_BILA_UGRZ K_DAB_KORR1 K_DAB_KORR2 K_DAB_KORR3 K_DIF_TIABST K_DSOCA K_DSOCABSCH K_PMTIMERSQ1 K_PM_NOUSEQ K_PM_TABSMN K_QSOCCL1 K_QSOCCL2 K_QSOCCL3 K_QV_OGRZ K_QV_QGRZ K_QV_UGRZ K_SOCFITGRZ K_SOCFITLIMH K_SOCFITLIML K_SOC_STAFGA K_TSAISONFIL K_TSAISPWF S_ABSCHK S_DSOCS S_PMTABSMN S_SOCSTAFK /end DEF_CHARACTERISTIC
 /begin REF_CHARACTERISTIC K_I_FITAUSW /end REF_CHARACTERISTIC
 /begin OUT_MEASUREMENT Absch_korr D_soc D_socw Pm_tsrdy QV2Abschk Soc_korr Soc_q_kor Soc_rel Soc_stfgk Soc_stfgkw St_pmsockor0 St_pmsockor0.B_Tabstpla St_pmsockor0.B_abschfit St_pmsockor0.B_pm_fit2 St_pmsockor0.B_pm_fit3 St_pmsockor0.B_pmsocini St_pmsockor0.B_soc_npl T_saison T_saisonalt Tn_abstelllo2 /end OUT_MEASUREMENT
 /begin IN_MEASUREMENT I_batt Ibs_msgind Ibs_msgsta Ibs_start Qv_out_m Qv_quali_m Soc_bila Soc_fit Soc_quali St_ibebsd1 St_ibebsd1.B_eb_busy St_ibebsd1.B_eb_errdir St_ibebsd1.B_eb_txok St_ibebsd1.B_ibs_msgrdy St_ibebsd1.B_ibs_msgwri St_mkwchn St_mkwchn.B_kwdreht St_msabs St_msabs.B_msastarts St_msabs.B_msastops St_pmsocstart_nv0 St_pmsocstart_nv0.B_pmsqrdy St_pmsocstart_nv0.B_pmstartq St_pwf St_pwf.B_pwf T1histiruh T2histiruh T3histiruh T4histiruh T_batt_max T_batt_min Tn_abstellm /end IN_MEASUREMENT
/end FUNCTION
/begin FUNCTION PMSOCSTART ""
 /begin DEF_CHARACTERISTIC KL_ITNSTART KL_ITNSTRMSA KL_UNSTART KL_UNSTRTMSA KL_UTSTART KL_UTSTRTMSA K_RIN_GRENZ1 K_RIN_GRENZ2 K_RIN_GRENZ3 K_RIN_GRENZ4 K_RIN_GRENZ5 K_RIN_GRENZ6 K_RIN_GRENZ7 K_RIN_GRENZ8 K_TIME_START K_UB_GRENZ K_USTARTGRZ S_MSASTARTKL S_NKWITNSTRT S_PMSTARTQ S_PM_TEST1 S_RIN S_STARTAW S_UTNSTRTMSA /end DEF_CHARACTERISTIC
 /begin OUT_MEASUREMENT Ideltaabs Nnmstart Pmstartsta Rin_grenzh Rin_start St_pmsocstart0 St_pmsocstart0.B_handshutn2 St_pmsocstart0.B_pmstart7 St_pmsocstart0.B_resetsta St_pmsocstart0.B_rstdatardy St_pmsocstart_nv0 St_pmsocstart_nv0.B_pmsqrdy St_pmsocstart_nv0.B_pmstartq U_grenz U_startausw U_tnstartmsa Ub_old /end OUT_MEASUREMENT
 /begin IN_MEASUREMENT Batt_index I_tnstart I_vorstart Ibs_msgind Ibs_msgsta Ibs_start Nkw St_ibebsd1 St_ibebsd1.B_eb_busy St_ibebsd1.B_eb_errdir St_ibebsd1.B_eb_txok St_ibebsd1.B_ibs_msgrdy St_ibebsd1.B_ibs_msgwri St_ibsreg4 St_ibsreg4.B_ibspwf St_ibsreg4.B_startfgk St_ibsreg4.B_strtaw St_ibsreg4.B_tiefset St_mkwchn St_mkwchn.B_kwdreht T_batt U_tnstart U_vorstart Ub /end IN_MEASUREMENT
/end FUNCTION
/end MODULE
/end PROJECT
