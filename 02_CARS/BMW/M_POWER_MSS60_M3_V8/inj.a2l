ASAP2_VERSION 1 30
/begin PROJECT MSS65-inj "Generiert am 14.10.05 um 11:34:36"
/begin HEADER "" VERSION "R341" /end HEADER
/begin MODULE _MSS65-inj "Generiert am 14.10.05 um 11:34:36"
/begin MOD_COMMON "" BYTE_ORDER MSB_FIRST ALIGNMENT_BYTE 1 ALIGNMENT_WORD 2 ALIGNMENT_LONG 4 ALIGNMENT_FLOAT32_IEEE 4 ALIGNMENT_FLOAT64_IEEE 8 /end MOD_COMMON
/begin CHARACTERISTIC GKF_TI_TU_F_ZYL1 "Tuningfaktor fuer Zylinder1" MAP 0x7858C TGF_VV_VV_UW 4.0 FORMULA_0073 0.0 4.0 FORMAT "%6.3"
 /begin AXIS_DESCR COM_AXIS n FORMULA_0006 10 0.0 10000.0 AXIS_PTS_REF AXIS_TI_TU_F_N10 MAX_GRAD 0.0 /end AXIS_DESCR
 /begin AXIS_DESCR COM_AXIS rf_m FORMULA_0007 4 0.0 2.0 AXIS_PTS_REF AXIS_TI_TU_F_RF4 MAX_GRAD 0.0 /end AXIS_DESCR
/end CHARACTERISTIC
/begin CHARACTERISTIC GKF_TI_TU_F_ZYL10 "Tuningfaktor fuer Zylinder10" MAP 0x7885C TGF_VV_VV_UW 4.0 FORMULA_0073 0.0 4.0 FORMAT "%6.3"
 /begin AXIS_DESCR COM_AXIS n FORMULA_0006 10 0.0 10000.0 AXIS_PTS_REF AXIS_TI_TU_F_N10 MAX_GRAD 0.0 /end AXIS_DESCR
 /begin AXIS_DESCR COM_AXIS rf_m FORMULA_0007 4 0.0 2.0 AXIS_PTS_REF AXIS_TI_TU_F_RF4 MAX_GRAD 0.0 /end AXIS_DESCR
/end CHARACTERISTIC
/begin CHARACTERISTIC GKF_TI_TU_F_ZYL2 "Tuningfaktor fuer Zylinder2" MAP 0x785DC TGF_VV_VV_UW 4.0 FORMULA_0073 0.0 4.0 FORMAT "%6.3"
 /begin AXIS_DESCR COM_AXIS n FORMULA_0006 10 0.0 10000.0 AXIS_PTS_REF AXIS_TI_TU_F_N10 MAX_GRAD 0.0 /end AXIS_DESCR
 /begin AXIS_DESCR COM_AXIS rf_m FORMULA_0007 4 0.0 2.0 AXIS_PTS_REF AXIS_TI_TU_F_RF4 MAX_GRAD 0.0 /end AXIS_DESCR
/end CHARACTERISTIC
/begin CHARACTERISTIC GKF_TI_TU_F_ZYL3 "Tuningfaktor fuer Zylinder3" MAP 0x7862C TGF_VV_VV_UW 4.0 FORMULA_0073 0.0 4.0 FORMAT "%6.3"
 /begin AXIS_DESCR COM_AXIS n FORMULA_0006 10 0.0 10000.0 AXIS_PTS_REF AXIS_TI_TU_F_N10 MAX_GRAD 0.0 /end AXIS_DESCR
 /begin AXIS_DESCR COM_AXIS rf_m FORMULA_0007 4 0.0 2.0 AXIS_PTS_REF AXIS_TI_TU_F_RF4 MAX_GRAD 0.0 /end AXIS_DESCR
/end CHARACTERISTIC
/begin CHARACTERISTIC GKF_TI_TU_F_ZYL4 "Tuningfaktor fuer Zylinder4" MAP 0x7867C TGF_VV_VV_UW 4.0 FORMULA_0073 0.0 4.0 FORMAT "%6.3"
 /begin AXIS_DESCR COM_AXIS n FORMULA_0006 10 0.0 10000.0 AXIS_PTS_REF AXIS_TI_TU_F_N10 MAX_GRAD 0.0 /end AXIS_DESCR
 /begin AXIS_DESCR COM_AXIS rf_m FORMULA_0007 4 0.0 2.0 AXIS_PTS_REF AXIS_TI_TU_F_RF4 MAX_GRAD 0.0 /end AXIS_DESCR
/end CHARACTERISTIC
/begin CHARACTERISTIC GKF_TI_TU_F_ZYL5 "Tuningfaktor fuer Zylinder5" MAP 0x786CC TGF_VV_VV_UW 4.0 FORMULA_0073 0.0 4.0 FORMAT "%6.3"
 /begin AXIS_DESCR COM_AXIS n FORMULA_0006 10 0.0 10000.0 AXIS_PTS_REF AXIS_TI_TU_F_N10 MAX_GRAD 0.0 /end AXIS_DESCR
 /begin AXIS_DESCR COM_AXIS rf_m FORMULA_0007 4 0.0 2.0 AXIS_PTS_REF AXIS_TI_TU_F_RF4 MAX_GRAD 0.0 /end AXIS_DESCR
/end CHARACTERISTIC
/begin CHARACTERISTIC GKF_TI_TU_F_ZYL6 "Tuningfaktor fuer Zylinder6" MAP 0x7871C TGF_VV_VV_UW 4.0 FORMULA_0073 0.0 4.0 FORMAT "%6.3"
 /begin AXIS_DESCR COM_AXIS n FORMULA_0006 10 0.0 10000.0 AXIS_PTS_REF AXIS_TI_TU_F_N10 MAX_GRAD 0.0 /end AXIS_DESCR
 /begin AXIS_DESCR COM_AXIS rf_m FORMULA_0007 4 0.0 2.0 AXIS_PTS_REF AXIS_TI_TU_F_RF4 MAX_GRAD 0.0 /end AXIS_DESCR
/end CHARACTERISTIC
/begin CHARACTERISTIC GKF_TI_TU_F_ZYL7 "Tuningfaktor fuer Zylinder7" MAP 0x7876C TGF_VV_VV_UW 4.0 FORMULA_0073 0.0 4.0 FORMAT "%6.3"
 /begin AXIS_DESCR COM_AXIS n FORMULA_0006 10 0.0 10000.0 AXIS_PTS_REF AXIS_TI_TU_F_N10 MAX_GRAD 0.0 /end AXIS_DESCR
 /begin AXIS_DESCR COM_AXIS rf_m FORMULA_0007 4 0.0 2.0 AXIS_PTS_REF AXIS_TI_TU_F_RF4 MAX_GRAD 0.0 /end AXIS_DESCR
/end CHARACTERISTIC
/begin CHARACTERISTIC GKF_TI_TU_F_ZYL8 "Tuningfaktor fuer Zylinder8" MAP 0x787BC TGF_VV_VV_UW 4.0 FORMULA_0073 0.0 4.0 FORMAT "%6.3"
 /begin AXIS_DESCR COM_AXIS n FORMULA_0006 10 0.0 10000.0 AXIS_PTS_REF AXIS_TI_TU_F_N10 MAX_GRAD 0.0 /end AXIS_DESCR
 /begin AXIS_DESCR COM_AXIS rf_m FORMULA_0007 4 0.0 2.0 AXIS_PTS_REF AXIS_TI_TU_F_RF4 MAX_GRAD 0.0 /end AXIS_DESCR
/end CHARACTERISTIC
/begin CHARACTERISTIC GKF_TI_TU_F_ZYL9 "Tuningfaktor fuer Zylinder9" MAP 0x7880C TGF_VV_VV_UW 4.0 FORMULA_0073 0.0 4.0 FORMAT "%6.3"
 /begin AXIS_DESCR COM_AXIS n FORMULA_0006 10 0.0 10000.0 AXIS_PTS_REF AXIS_TI_TU_F_N10 MAX_GRAD 0.0 /end AXIS_DESCR
 /begin AXIS_DESCR COM_AXIS rf_m FORMULA_0007 4 0.0 2.0 AXIS_PTS_REF AXIS_TI_TU_F_RF4 MAX_GRAD 0.0 /end AXIS_DESCR
/end CHARACTERISTIC
/begin CHARACTERISTIC K_DKBA_CFG "Freigabe DKBA - DK-Beschleunigungsanreicherung" VALUE 0x7798A TKW_VV_VV_UB 100.0 FORMULA_0831 0.0 1.0 /end CHARACTERISTIC
/begin CHARACTERISTIC K_DKBA_NMAX "max. Drehzahl f. Freigabe DKBA" VALUE 0x7798C TKW_VV_VV_SW 100.0 FORMULA_0006 0.0 10000.0 /end CHARACTERISTIC
/begin CHARACTERISTIC K_DKBA_NMAX_HYS "Hysterese f. Drehzahlschwelle" VALUE 0x7798E TKW_VV_VV_SW 100.0 FORMULA_0006 0.0 10000.0 /end CHARACTERISTIC
/begin CHARACTERISTIC K_ED_SL_DURCHS_HSTRANG.DEC_NACH_EINTRAG "Filterverringerung nach Fehlerspeichereintrag" VALUE 0x71953 TKW_VV_VV_UB 100.0 FORMULA_0003 0.0 255.0 /end CHARACTERISTIC
/begin CHARACTERISTIC K_ED_SL_DURCHS_HSTRANG.DEC_VOR_EINTRAG "Filterverringerung vorm Fehlerspeichereintrag" VALUE 0x71951 TKW_VV_VV_UB 100.0 FORMULA_0003 0.0 255.0 /end CHARACTERISTIC
/begin CHARACTERISTIC K_ED_SL_DURCHS_HSTRANG.FEHLERSCHWELLE "Filterschwelle fuer Fehlereintrag" VALUE 0x7194E TKW_VV_VV_UB 100.0 FORMULA_0003 0.0 255.0 /end CHARACTERISTIC
/begin CHARACTERISTIC K_ED_SL_DURCHS_HSTRANG.INC_NACH_EINTRAG "Filtererhoehung nach Fehlerspeichereintrag" VALUE 0x71952 TKW_VV_VV_UB 100.0 FORMULA_0003 0.0 255.0 /end CHARACTERISTIC
/begin CHARACTERISTIC K_ED_SL_DURCHS_HSTRANG.INC_VOR_EINTRAG "Filtererhoehung vorm Fehlerspeichereintrag" VALUE 0x71950 TKW_VV_VV_UB 100.0 FORMULA_0003 0.0 255.0 /end CHARACTERISTIC
/begin CHARACTERISTIC K_ED_SL_DURCHS_HSTRANG.KLASSENINDEX "Auswahl der Fehlerklasse" VALUE 0x71954 TKW_VV_VV_UB 100.0 FORMULA_0003 0.0 8.0 /end CHARACTERISTIC
/begin CHARACTERISTIC K_ED_SL_DURCHS_HSTRANG.OK_SCHWELLE "Filterschwelle fuer Fehleraustrag" VALUE 0x7194F TKW_VV_VV_UB 100.0 FORMULA_0003 0.0 255.0 /end CHARACTERISTIC
/begin CHARACTERISTIC K_ED_SL_DURCHS_HSTRANG.P_CODE_OPENLOAD "P-Code fuer die Art OPENLOAD" VALUE 0x7194A TKW_VV_VV_UW 100.0 FORMULA_0010 0.0 65535.0 /end CHARACTERISTIC
/begin CHARACTERISTIC K_ED_SL_DURCHS_HSTRANG.P_CODE_SH_TO_GND "P-Code fuer die Art SH_TO_GND" VALUE 0x71948 TKW_VV_VV_UW 100.0 FORMULA_0010 0.0 65535.0 /end CHARACTERISTIC
/begin CHARACTERISTIC K_ED_SL_DURCHS_HSTRANG.P_CODE_SH_TO_UB "P-Code fuer die Art SH_TO_UB" VALUE 0x71946 TKW_VV_VV_UW 100.0 FORMULA_0010 0.0 65535.0 /end CHARACTERISTIC
/begin CHARACTERISTIC K_ED_SL_DURCHS_HSTRANG.P_CODE_UNPLAUSIBEL "P-Code fuer die Art UNPLAUSIBEL" VALUE 0x7194C TKW_VV_VV_UW 100.0 FORMULA_0010 0.0 65535.0 /end CHARACTERISTIC
/begin CHARACTERISTIC K_ED_SL_ML_HFM.DEC_NACH_EINTRAG "Filterverringerung nach Fehlerspeichereintrag" VALUE 0x70D09 TKW_VV_VV_UB 100.0 FORMULA_0003 0.0 255.0 /end CHARACTERISTIC
/begin CHARACTERISTIC K_ED_SL_ML_HFM.DEC_VOR_EINTRAG "Filterverringerung vorm Fehlerspeichereintrag" VALUE 0x70D07 TKW_VV_VV_UB 100.0 FORMULA_0003 0.0 255.0 /end CHARACTERISTIC
/begin CHARACTERISTIC K_ED_SL_ML_HFM.FEHLERSCHWELLE "Filterschwelle fuer Fehlereintrag" VALUE 0x70D04 TKW_VV_VV_UB 100.0 FORMULA_0003 0.0 255.0 /end CHARACTERISTIC
/begin CHARACTERISTIC K_ED_SL_ML_HFM.INC_NACH_EINTRAG "Filtererhoehung nach Fehlerspeichereintrag" VALUE 0x70D08 TKW_VV_VV_UB 100.0 FORMULA_0003 0.0 255.0 /end CHARACTERISTIC
/begin CHARACTERISTIC K_ED_SL_ML_HFM.INC_VOR_EINTRAG "Filtererhoehung vorm Fehlerspeichereintrag" VALUE 0x70D06 TKW_VV_VV_UB 100.0 FORMULA_0003 0.0 255.0 /end CHARACTERISTIC
/begin CHARACTERISTIC K_ED_SL_ML_HFM.KLASSENINDEX "Auswahl der Fehlerklasse" VALUE 0x70D0A TKW_VV_VV_UB 100.0 FORMULA_0003 0.0 8.0 /end CHARACTERISTIC
/begin CHARACTERISTIC K_ED_SL_ML_HFM.OK_SCHWELLE "Filterschwelle fuer Fehleraustrag" VALUE 0x70D05 TKW_VV_VV_UB 100.0 FORMULA_0003 0.0 255.0 /end CHARACTERISTIC
/begin CHARACTERISTIC K_ED_SL_ML_HFM.P_CODE_OPENLOAD "P-Code fuer die Art OPENLOAD" VALUE 0x70D00 TKW_VV_VV_UW 100.0 FORMULA_0010 0.0 65535.0 /end CHARACTERISTIC
/begin CHARACTERISTIC K_ED_SL_ML_HFM.P_CODE_SH_TO_GND "P-Code fuer die Art SH_TO_GND" VALUE 0x70CFE TKW_VV_VV_UW 100.0 FORMULA_0010 0.0 65535.0 /end CHARACTERISTIC
/begin CHARACTERISTIC K_ED_SL_ML_HFM.P_CODE_SH_TO_UB "P-Code fuer die Art SH_TO_UB" VALUE 0x70CFC TKW_VV_VV_UW 100.0 FORMULA_0010 0.0 65535.0 /end CHARACTERISTIC
/begin CHARACTERISTIC K_ED_SL_ML_HFM.P_CODE_UNPLAUSIBEL "P-Code fuer die Art UNPLAUSIBEL" VALUE 0x70D02 TKW_VV_VV_UW 100.0 FORMULA_0010 0.0 65535.0 /end CHARACTERISTIC
/begin CHARACTERISTIC K_ED_SL_ML_HFM_OBD.DEC_NACH_EINTRAG "Filterverringerung nach Fehlerspeichereintrag" VALUE 0x71B41 TKW_VV_VV_UB 100.0 FORMULA_0003 0.0 255.0 /end CHARACTERISTIC
/begin CHARACTERISTIC K_ED_SL_ML_HFM_OBD.DEC_VOR_EINTRAG "Filterverringerung vorm Fehlerspeichereintrag" VALUE 0x71B3F TKW_VV_VV_UB 100.0 FORMULA_0003 0.0 255.0 /end CHARACTERISTIC
/begin CHARACTERISTIC K_ED_SL_ML_HFM_OBD.FEHLERSCHWELLE "Filterschwelle fuer Fehlereintrag" VALUE 0x71B3C TKW_VV_VV_UB 100.0 FORMULA_0003 0.0 255.0 /end CHARACTERISTIC
/begin CHARACTERISTIC K_ED_SL_ML_HFM_OBD.INC_NACH_EINTRAG "Filtererhoehung nach Fehlerspeichereintrag" VALUE 0x71B40 TKW_VV_VV_UB 100.0 FORMULA_0003 0.0 255.0 /end CHARACTERISTIC
/begin CHARACTERISTIC K_ED_SL_ML_HFM_OBD.INC_VOR_EINTRAG "Filtererhoehung vorm Fehlerspeichereintrag" VALUE 0x71B3E TKW_VV_VV_UB 100.0 FORMULA_0003 0.0 255.0 /end CHARACTERISTIC
/begin CHARACTERISTIC K_ED_SL_ML_HFM_OBD.KLASSENINDEX "Auswahl der Fehlerklasse" VALUE 0x71B42 TKW_VV_VV_UB 100.0 FORMULA_0003 0.0 8.0 /end CHARACTERISTIC
/begin CHARACTERISTIC K_ED_SL_ML_HFM_OBD.OK_SCHWELLE "Filterschwelle fuer Fehleraustrag" VALUE 0x71B3D TKW_VV_VV_UB 100.0 FORMULA_0003 0.0 255.0 /end CHARACTERISTIC
/begin CHARACTERISTIC K_ED_SL_ML_HFM_OBD.P_CODE_OPENLOAD "P-Code fuer die Art OPENLOAD" VALUE 0x71B38 TKW_VV_VV_UW 100.0 FORMULA_0010 0.0 65535.0 /end CHARACTERISTIC
/begin CHARACTERISTIC K_ED_SL_ML_HFM_OBD.P_CODE_SH_TO_GND "P-Code fuer die Art SH_TO_GND" VALUE 0x71B36 TKW_VV_VV_UW 100.0 FORMULA_0010 0.0 65535.0 /end CHARACTERISTIC
/begin CHARACTERISTIC K_ED_SL_ML_HFM_OBD.P_CODE_SH_TO_UB "P-Code fuer die Art SH_TO_UB" VALUE 0x71B34 TKW_VV_VV_UW 100.0 FORMULA_0010 0.0 65535.0 /end CHARACTERISTIC
/begin CHARACTERISTIC K_ED_SL_ML_HFM_OBD.P_CODE_UNPLAUSIBEL "P-Code fuer die Art UNPLAUSIBEL" VALUE 0x71B3A TKW_VV_VV_UW 100.0 FORMULA_0010 0.0 65535.0 /end CHARACTERISTIC
/begin CHARACTERISTIC K_ED_SLP.DEC_NACH_EINTRAG "Filterverringerung nach Fehlerspeichereintrag" VALUE 0x71905 TKW_VV_VV_UB 100.0 FORMULA_0003 0.0 255.0 /end CHARACTERISTIC
/begin CHARACTERISTIC K_ED_SLP.DEC_VOR_EINTRAG "Filterverringerung vorm Fehlerspeichereintrag" VALUE 0x71903 TKW_VV_VV_UB 100.0 FORMULA_0003 0.0 255.0 /end CHARACTERISTIC
/begin CHARACTERISTIC K_ED_SLP.FEHLERSCHWELLE "Filterschwelle fuer Fehlereintrag" VALUE 0x71900 TKW_VV_VV_UB 100.0 FORMULA_0003 0.0 255.0 /end CHARACTERISTIC
/begin CHARACTERISTIC K_ED_SLP.INC_NACH_EINTRAG "Filtererhoehung nach Fehlerspeichereintrag" VALUE 0x71904 TKW_VV_VV_UB 100.0 FORMULA_0003 0.0 255.0 /end CHARACTERISTIC
/begin CHARACTERISTIC K_ED_SLP.INC_VOR_EINTRAG "Filtererhoehung vorm Fehlerspeichereintrag" VALUE 0x71902 TKW_VV_VV_UB 100.0 FORMULA_0003 0.0 255.0 /end CHARACTERISTIC
/begin CHARACTERISTIC K_ED_SLP.KLASSENINDEX "Auswahl der Fehlerklasse" VALUE 0x71906 TKW_VV_VV_UB 100.0 FORMULA_0003 0.0 8.0 /end CHARACTERISTIC
/begin CHARACTERISTIC K_ED_SLP.OK_SCHWELLE "Filterschwelle fuer Fehleraustrag" VALUE 0x71901 TKW_VV_VV_UB 100.0 FORMULA_0003 0.0 255.0 /end CHARACTERISTIC
/begin CHARACTERISTIC K_ED_SLP.P_CODE_OPENLOAD "P-Code fuer die Art OPENLOAD" VALUE 0x718FC TKW_VV_VV_UW 100.0 FORMULA_0010 0.0 65535.0 /end CHARACTERISTIC
/begin CHARACTERISTIC K_ED_SLP.P_CODE_SH_TO_GND "P-Code fuer die Art SH_TO_GND" VALUE 0x718FA TKW_VV_VV_UW 100.0 FORMULA_0010 0.0 65535.0 /end CHARACTERISTIC
/begin CHARACTERISTIC K_ED_SLP.P_CODE_SH_TO_UB "P-Code fuer die Art SH_TO_UB" VALUE 0x718F8 TKW_VV_VV_UW 100.0 FORMULA_0010 0.0 65535.0 /end CHARACTERISTIC
/begin CHARACTERISTIC K_ED_SLP.P_CODE_UNPLAUSIBEL "P-Code fuer die Art UNPLAUSIBEL" VALUE 0x718FE TKW_VV_VV_UW 100.0 FORMULA_0010 0.0 65535.0 /end CHARACTERISTIC
/begin CHARACTERISTIC K_ED_SLV.DEC_NACH_EINTRAG "Filterverringerung nach Fehlerspeichereintrag" VALUE 0x7148D TKW_VV_VV_UB 100.0 FORMULA_0003 0.0 255.0 /end CHARACTERISTIC
/begin CHARACTERISTIC K_ED_SLV.DEC_VOR_EINTRAG "Filterverringerung vorm Fehlerspeichereintrag" VALUE 0x7148B TKW_VV_VV_UB 100.0 FORMULA_0003 0.0 255.0 /end CHARACTERISTIC
/begin CHARACTERISTIC K_ED_SLV.FEHLERSCHWELLE "Filterschwelle fuer Fehlereintrag" VALUE 0x71488 TKW_VV_VV_UB 100.0 FORMULA_0003 0.0 255.0 /end CHARACTERISTIC
/begin CHARACTERISTIC K_ED_SLV.INC_NACH_EINTRAG "Filtererhoehung nach Fehlerspeichereintrag" VALUE 0x7148C TKW_VV_VV_UB 100.0 FORMULA_0003 0.0 255.0 /end CHARACTERISTIC
/begin CHARACTERISTIC K_ED_SLV.INC_VOR_EINTRAG "Filtererhoehung vorm Fehlerspeichereintrag" VALUE 0x7148A TKW_VV_VV_UB 100.0 FORMULA_0003 0.0 255.0 /end CHARACTERISTIC
/begin CHARACTERISTIC K_ED_SLV.KLASSENINDEX "Auswahl der Fehlerklasse" VALUE 0x7148E TKW_VV_VV_UB 100.0 FORMULA_0003 0.0 8.0 /end CHARACTERISTIC
/begin CHARACTERISTIC K_ED_SLV.OK_SCHWELLE "Filterschwelle fuer Fehleraustrag" VALUE 0x71489 TKW_VV_VV_UB 100.0 FORMULA_0003 0.0 255.0 /end CHARACTERISTIC
/begin CHARACTERISTIC K_ED_SLV.P_CODE_OPENLOAD "P-Code fuer die Art OPENLOAD" VALUE 0x71484 TKW_VV_VV_UW 100.0 FORMULA_0010 0.0 65535.0 /end CHARACTERISTIC
/begin CHARACTERISTIC K_ED_SLV.P_CODE_SH_TO_GND "P-Code fuer die Art SH_TO_GND" VALUE 0x71482 TKW_VV_VV_UW 100.0 FORMULA_0010 0.0 65535.0 /end CHARACTERISTIC
/begin CHARACTERISTIC K_ED_SLV.P_CODE_SH_TO_UB "P-Code fuer die Art SH_TO_UB" VALUE 0x71480 TKW_VV_VV_UW 100.0 FORMULA_0010 0.0 65535.0 /end CHARACTERISTIC
/begin CHARACTERISTIC K_ED_SLV.P_CODE_UNPLAUSIBEL "P-Code fuer die Art UNPLAUSIBEL" VALUE 0x71486 TKW_VV_VV_UW 100.0 FORMULA_0010 0.0 65535.0 /end CHARACTERISTIC
/begin CHARACTERISTIC K_ED_TANK_LEER.DEC_NACH_EINTRAG "Filterverringerung nach Fehlerspeichereintrag" VALUE 0x71AD9 TKW_VV_VV_UB 100.0 FORMULA_0003 0.0 255.0 /end CHARACTERISTIC
/begin CHARACTERISTIC K_ED_TANK_LEER.DEC_VOR_EINTRAG "Filterverringerung vorm Fehlerspeichereintrag" VALUE 0x71AD7 TKW_VV_VV_UB 100.0 FORMULA_0003 0.0 255.0 /end CHARACTERISTIC
/begin CHARACTERISTIC K_ED_TANK_LEER.FEHLERSCHWELLE "Filterschwelle fuer Fehlereintrag" VALUE 0x71AD4 TKW_VV_VV_UB 100.0 FORMULA_0003 0.0 255.0 /end CHARACTERISTIC
/begin CHARACTERISTIC K_ED_TANK_LEER.INC_NACH_EINTRAG "Filtererhoehung nach Fehlerspeichereintrag" VALUE 0x71AD8 TKW_VV_VV_UB 100.0 FORMULA_0003 0.0 255.0 /end CHARACTERISTIC
/begin CHARACTERISTIC K_ED_TANK_LEER.INC_VOR_EINTRAG "Filtererhoehung vorm Fehlerspeichereintrag" VALUE 0x71AD6 TKW_VV_VV_UB 100.0 FORMULA_0003 0.0 255.0 /end CHARACTERISTIC
/begin CHARACTERISTIC K_ED_TANK_LEER.KLASSENINDEX "Auswahl der Fehlerklasse" VALUE 0x71ADA TKW_VV_VV_UB 100.0 FORMULA_0003 0.0 8.0 /end CHARACTERISTIC
/begin CHARACTERISTIC K_ED_TANK_LEER.OK_SCHWELLE "Filterschwelle fuer Fehleraustrag" VALUE 0x71AD5 TKW_VV_VV_UB 100.0 FORMULA_0003 0.0 255.0 /end CHARACTERISTIC
/begin CHARACTERISTIC K_ED_TANK_LEER.P_CODE_OPENLOAD "P-Code fuer die Art OPENLOAD" VALUE 0x71AD0 TKW_VV_VV_UW 100.0 FORMULA_0010 0.0 65535.0 /end CHARACTERISTIC
/begin CHARACTERISTIC K_ED_TANK_LEER.P_CODE_SH_TO_GND "P-Code fuer die Art SH_TO_GND" VALUE 0x71ACE TKW_VV_VV_UW 100.0 FORMULA_0010 0.0 65535.0 /end CHARACTERISTIC
/begin CHARACTERISTIC K_ED_TANK_LEER.P_CODE_SH_TO_UB "P-Code fuer die Art SH_TO_UB" VALUE 0x71ACC TKW_VV_VV_UW 100.0 FORMULA_0010 0.0 65535.0 /end CHARACTERISTIC
/begin CHARACTERISTIC K_ED_TANK_LEER.P_CODE_UNPLAUSIBEL "P-Code fuer die Art UNPLAUSIBEL" VALUE 0x71AD2 TKW_VV_VV_UW 100.0 FORMULA_0010 0.0 65535.0 /end CHARACTERISTIC
/begin CHARACTERISTIC K_ED_TD.DEC_NACH_EINTRAG "Filterverringerung nach Fehlerspeichereintrag" VALUE 0x71459 TKW_VV_VV_UB 100.0 FORMULA_0003 0.0 255.0 /end CHARACTERISTIC
/begin CHARACTERISTIC K_ED_TD.DEC_VOR_EINTRAG "Filterverringerung vorm Fehlerspeichereintrag" VALUE 0x71457 TKW_VV_VV_UB 100.0 FORMULA_0003 0.0 255.0 /end CHARACTERISTIC
/begin CHARACTERISTIC K_ED_TD.FEHLERSCHWELLE "Filterschwelle fuer Fehlereintrag" VALUE 0x71454 TKW_VV_VV_UB 100.0 FORMULA_0003 0.0 255.0 /end CHARACTERISTIC
/begin CHARACTERISTIC K_ED_TD.INC_NACH_EINTRAG "Filtererhoehung nach Fehlerspeichereintrag" VALUE 0x71458 TKW_VV_VV_UB 100.0 FORMULA_0003 0.0 255.0 /end CHARACTERISTIC
/begin CHARACTERISTIC K_ED_TD.INC_VOR_EINTRAG "Filtererhoehung vorm Fehlerspeichereintrag" VALUE 0x71456 TKW_VV_VV_UB 100.0 FORMULA_0003 0.0 255.0 /end CHARACTERISTIC
/begin CHARACTERISTIC K_ED_TD.KLASSENINDEX "Auswahl der Fehlerklasse" VALUE 0x7145A TKW_VV_VV_UB 100.0 FORMULA_0003 0.0 8.0 /end CHARACTERISTIC
/begin CHARACTERISTIC K_ED_TD.OK_SCHWELLE "Filterschwelle fuer Fehleraustrag" VALUE 0x71455 TKW_VV_VV_UB 100.0 FORMULA_0003 0.0 255.0 /end CHARACTERISTIC
/begin CHARACTERISTIC K_ED_TD.P_CODE_OPENLOAD "P-Code fuer die Art OPENLOAD" VALUE 0x71450 TKW_VV_VV_UW 100.0 FORMULA_0010 0.0 65535.0 /end CHARACTERISTIC
/begin CHARACTERISTIC K_ED_TD.P_CODE_SH_TO_GND "P-Code fuer die Art SH_TO_GND" VALUE 0x7144E TKW_VV_VV_UW 100.0 FORMULA_0010 0.0 65535.0 /end CHARACTERISTIC
/begin CHARACTERISTIC K_ED_TD.P_CODE_SH_TO_UB "P-Code fuer die Art SH_TO_UB" VALUE 0x7144C TKW_VV_VV_UW 100.0 FORMULA_0010 0.0 65535.0 /end CHARACTERISTIC
/begin CHARACTERISTIC K_ED_TD.P_CODE_UNPLAUSIBEL "P-Code fuer die Art UNPLAUSIBEL" VALUE 0x71452 TKW_VV_VV_UW 100.0 FORMULA_0010 0.0 65535.0 /end CHARACTERISTIC
/begin CHARACTERISTIC K_ED_TE_OBD_1.DEC_NACH_EINTRAG "Filterverringerung nach Fehlerspeichereintrag" VALUE 0x717E7 TKW_VV_VV_UB 100.0 FORMULA_0003 0.0 255.0 /end CHARACTERISTIC
/begin CHARACTERISTIC K_ED_TE_OBD_1.DEC_VOR_EINTRAG "Filterverringerung vorm Fehlerspeichereintrag" VALUE 0x717E5 TKW_VV_VV_UB 100.0 FORMULA_0003 0.0 255.0 /end CHARACTERISTIC
/begin CHARACTERISTIC K_ED_TE_OBD_1.FEHLERSCHWELLE "Filterschwelle fuer Fehlereintrag" VALUE 0x717E2 TKW_VV_VV_UB 100.0 FORMULA_0003 0.0 255.0 /end CHARACTERISTIC
/begin CHARACTERISTIC K_ED_TE_OBD_1.INC_NACH_EINTRAG "Filtererhoehung nach Fehlerspeichereintrag" VALUE 0x717E6 TKW_VV_VV_UB 100.0 FORMULA_0003 0.0 255.0 /end CHARACTERISTIC
/begin CHARACTERISTIC K_ED_TE_OBD_1.INC_VOR_EINTRAG "Filtererhoehung vorm Fehlerspeichereintrag" VALUE 0x717E4 TKW_VV_VV_UB 100.0 FORMULA_0003 0.0 255.0 /end CHARACTERISTIC
/begin CHARACTERISTIC K_ED_TE_OBD_1.KLASSENINDEX "Auswahl der Fehlerklasse" VALUE 0x717E8 TKW_VV_VV_UB 100.0 FORMULA_0003 0.0 8.0 /end CHARACTERISTIC
/begin CHARACTERISTIC K_ED_TE_OBD_1.OK_SCHWELLE "Filterschwelle fuer Fehleraustrag" VALUE 0x717E3 TKW_VV_VV_UB 100.0 FORMULA_0003 0.0 255.0 /end CHARACTERISTIC
/begin CHARACTERISTIC K_ED_TE_OBD_1.P_CODE_OPENLOAD "P-Code fuer die Art OPENLOAD" VALUE 0x717DE TKW_VV_VV_UW 100.0 FORMULA_0010 0.0 65535.0 /end CHARACTERISTIC
/begin CHARACTERISTIC K_ED_TE_OBD_1.P_CODE_SH_TO_GND "P-Code fuer die Art SH_TO_GND" VALUE 0x717DC TKW_VV_VV_UW 100.0 FORMULA_0010 0.0 65535.0 /end CHARACTERISTIC
/begin CHARACTERISTIC K_ED_TE_OBD_1.P_CODE_SH_TO_UB "P-Code fuer die Art SH_TO_UB" VALUE 0x717DA TKW_VV_VV_UW 100.0 FORMULA_0010 0.0 65535.0 /end CHARACTERISTIC
/begin CHARACTERISTIC K_ED_TE_OBD_1.P_CODE_UNPLAUSIBEL "P-Code fuer die Art UNPLAUSIBEL" VALUE 0x717E0 TKW_VV_VV_UW 100.0 FORMULA_0010 0.0 65535.0 /end CHARACTERISTIC
/begin CHARACTERISTIC K_ED_TE_OBD_2.DEC_NACH_EINTRAG "Filterverringerung nach Fehlerspeichereintrag" VALUE 0x71801 TKW_VV_VV_UB 100.0 FORMULA_0003 0.0 255.0 /end CHARACTERISTIC
/begin CHARACTERISTIC K_ED_TE_OBD_2.DEC_VOR_EINTRAG "Filterverringerung vorm Fehlerspeichereintrag" VALUE 0x717FF TKW_VV_VV_UB 100.0 FORMULA_0003 0.0 255.0 /end CHARACTERISTIC
/begin CHARACTERISTIC K_ED_TE_OBD_2.FEHLERSCHWELLE "Filterschwelle fuer Fehlereintrag" VALUE 0x717FC TKW_VV_VV_UB 100.0 FORMULA_0003 0.0 255.0 /end CHARACTERISTIC
/begin CHARACTERISTIC K_ED_TE_OBD_2.INC_NACH_EINTRAG "Filtererhoehung nach Fehlerspeichereintrag" VALUE 0x71800 TKW_VV_VV_UB 100.0 FORMULA_0003 0.0 255.0 /end CHARACTERISTIC
/begin CHARACTERISTIC K_ED_TE_OBD_2.INC_VOR_EINTRAG "Filtererhoehung vorm Fehlerspeichereintrag" VALUE 0x717FE TKW_VV_VV_UB 100.0 FORMULA_0003 0.0 255.0 /end CHARACTERISTIC
/begin CHARACTERISTIC K_ED_TE_OBD_2.KLASSENINDEX "Auswahl der Fehlerklasse" VALUE 0x71802 TKW_VV_VV_UB 100.0 FORMULA_0003 0.0 8.0 /end CHARACTERISTIC
/begin CHARACTERISTIC K_ED_TE_OBD_2.OK_SCHWELLE "Filterschwelle fuer Fehleraustrag" VALUE 0x717FD TKW_VV_VV_UB 100.0 FORMULA_0003 0.0 255.0 /end CHARACTERISTIC
/begin CHARACTERISTIC K_ED_TE_OBD_2.P_CODE_OPENLOAD "P-Code fuer die Art OPENLOAD" VALUE 0x717F8 TKW_VV_VV_UW 100.0 FORMULA_0010 0.0 65535.0 /end CHARACTERISTIC
/begin CHARACTERISTIC K_ED_TE_OBD_2.P_CODE_SH_TO_GND "P-Code fuer die Art SH_TO_GND" VALUE 0x717F6 TKW_VV_VV_UW 100.0 FORMULA_0010 0.0 65535.0 /end CHARACTERISTIC
/begin CHARACTERISTIC K_ED_TE_OBD_2.P_CODE_SH_TO_UB "P-Code fuer die Art SH_TO_UB" VALUE 0x717F4 TKW_VV_VV_UW 100.0 FORMULA_0010 0.0 65535.0 /end CHARACTERISTIC
/begin CHARACTERISTIC K_ED_TE_OBD_2.P_CODE_UNPLAUSIBEL "P-Code fuer die Art UNPLAUSIBEL" VALUE 0x717FA TKW_VV_VV_UW 100.0 FORMULA_0010 0.0 65535.0 /end CHARACTERISTIC
/begin CHARACTERISTIC K_ED_TEV1.DEC_NACH_EINTRAG "Filterverringerung nach Fehlerspeichereintrag" VALUE 0x7181B TKW_VV_VV_UB 100.0 FORMULA_0003 0.0 255.0 /end CHARACTERISTIC
/begin CHARACTERISTIC K_ED_TEV1.DEC_VOR_EINTRAG "Filterverringerung vorm Fehlerspeichereintrag" VALUE 0x71819 TKW_VV_VV_UB 100.0 FORMULA_0003 0.0 255.0 /end CHARACTERISTIC
/begin CHARACTERISTIC K_ED_TEV1.FEHLERSCHWELLE "Filterschwelle fuer Fehlereintrag" VALUE 0x71816 TKW_VV_VV_UB 100.0 FORMULA_0003 0.0 255.0 /end CHARACTERISTIC
/begin CHARACTERISTIC K_ED_TEV1.INC_NACH_EINTRAG "Filtererhoehung nach Fehlerspeichereintrag" VALUE 0x7181A TKW_VV_VV_UB 100.0 FORMULA_0003 0.0 255.0 /end CHARACTERISTIC
/begin CHARACTERISTIC K_ED_TEV1.INC_VOR_EINTRAG "Filtererhoehung vorm Fehlerspeichereintrag" VALUE 0x71818 TKW_VV_VV_UB 100.0 FORMULA_0003 0.0 255.0 /end CHARACTERISTIC
/begin CHARACTERISTIC K_ED_TEV1.KLASSENINDEX "Auswahl der Fehlerklasse" VALUE 0x7181C TKW_VV_VV_UB 100.0 FORMULA_0003 0.0 8.0 /end CHARACTERISTIC
/begin CHARACTERISTIC K_ED_TEV1.OK_SCHWELLE "Filterschwelle fuer Fehleraustrag" VALUE 0x71817 TKW_VV_VV_UB 100.0 FORMULA_0003 0.0 255.0 /end CHARACTERISTIC
/begin CHARACTERISTIC K_ED_TEV1.P_CODE_OPENLOAD "P-Code fuer die Art OPENLOAD" VALUE 0x71812 TKW_VV_VV_UW 100.0 FORMULA_0010 0.0 65535.0 /end CHARACTERISTIC
/begin CHARACTERISTIC K_ED_TEV1.P_CODE_SH_TO_GND "P-Code fuer die Art SH_TO_GND" VALUE 0x71810 TKW_VV_VV_UW 100.0 FORMULA_0010 0.0 65535.0 /end CHARACTERISTIC
/begin CHARACTERISTIC K_ED_TEV1.P_CODE_SH_TO_UB "P-Code fuer die Art SH_TO_UB" VALUE 0x7180E TKW_VV_VV_UW 100.0 FORMULA_0010 0.0 65535.0 /end CHARACTERISTIC
/begin CHARACTERISTIC K_ED_TEV1.P_CODE_UNPLAUSIBEL "P-Code fuer die Art UNPLAUSIBEL" VALUE 0x71814 TKW_VV_VV_UW 100.0 FORMULA_0010 0.0 65535.0 /end CHARACTERISTIC
/begin CHARACTERISTIC K_ED_TEV2.DEC_NACH_EINTRAG "Filterverringerung nach Fehlerspeichereintrag" VALUE 0x71835 TKW_VV_VV_UB 100.0 FORMULA_0003 0.0 255.0 /end CHARACTERISTIC
/begin CHARACTERISTIC K_ED_TEV2.DEC_VOR_EINTRAG "Filterverringerung vorm Fehlerspeichereintrag" VALUE 0x71833 TKW_VV_VV_UB 100.0 FORMULA_0003 0.0 255.0 /end CHARACTERISTIC
/begin CHARACTERISTIC K_ED_TEV2.FEHLERSCHWELLE "Filterschwelle fuer Fehlereintrag" VALUE 0x71830 TKW_VV_VV_UB 100.0 FORMULA_0003 0.0 255.0 /end CHARACTERISTIC
/begin CHARACTERISTIC K_ED_TEV2.INC_NACH_EINTRAG "Filtererhoehung nach Fehlerspeichereintrag" VALUE 0x71834 TKW_VV_VV_UB 100.0 FORMULA_0003 0.0 255.0 /end CHARACTERISTIC
/begin CHARACTERISTIC K_ED_TEV2.INC_VOR_EINTRAG "Filtererhoehung vorm Fehlerspeichereintrag" VALUE 0x71832 TKW_VV_VV_UB 100.0 FORMULA_0003 0.0 255.0 /end CHARACTERISTIC
/begin CHARACTERISTIC K_ED_TEV2.KLASSENINDEX "Auswahl der Fehlerklasse" VALUE 0x71836 TKW_VV_VV_UB 100.0 FORMULA_0003 0.0 8.0 /end CHARACTERISTIC
/begin CHARACTERISTIC K_ED_TEV2.OK_SCHWELLE "Filterschwelle fuer Fehleraustrag" VALUE 0x71831 TKW_VV_VV_UB 100.0 FORMULA_0003 0.0 255.0 /end CHARACTERISTIC
/begin CHARACTERISTIC K_ED_TEV2.P_CODE_OPENLOAD "P-Code fuer die Art OPENLOAD" VALUE 0x7182C TKW_VV_VV_UW 100.0 FORMULA_0010 0.0 65535.0 /end CHARACTERISTIC
/begin CHARACTERISTIC K_ED_TEV2.P_CODE_SH_TO_GND "P-Code fuer die Art SH_TO_GND" VALUE 0x7182A TKW_VV_VV_UW 100.0 FORMULA_0010 0.0 65535.0 /end CHARACTERISTIC
/begin CHARACTERISTIC K_ED_TEV2.P_CODE_SH_TO_UB "P-Code fuer die Art SH_TO_UB" VALUE 0x71828 TKW_VV_VV_UW 100.0 FORMULA_0010 0.0 65535.0 /end CHARACTERISTIC
/begin CHARACTERISTIC K_ED_TEV2.P_CODE_UNPLAUSIBEL "P-Code fuer die Art UNPLAUSIBEL" VALUE 0x7182E TKW_VV_VV_UW 100.0 FORMULA_0010 0.0 65535.0 /end CHARACTERISTIC
/begin CHARACTERISTIC K_ED_TGETR_HS.DEC_NACH_EINTRAG "Filterverringerung nach Fehlerspeichereintrag" VALUE 0x71C79 TKW_VV_VV_UB 100.0 FORMULA_0003 0.0 255.0 /end CHARACTERISTIC
/begin CHARACTERISTIC K_ED_TGETR_HS.DEC_VOR_EINTRAG "Filterverringerung vorm Fehlerspeichereintrag" VALUE 0x71C77 TKW_VV_VV_UB 100.0 FORMULA_0003 0.0 255.0 /end CHARACTERISTIC
/begin CHARACTERISTIC K_ED_TGETR_HS.FEHLERSCHWELLE "Filterschwelle fuer Fehlereintrag" VALUE 0x71C74 TKW_VV_VV_UB 100.0 FORMULA_0003 0.0 255.0 /end CHARACTERISTIC
/begin CHARACTERISTIC K_ED_TGETR_HS.INC_NACH_EINTRAG "Filtererhoehung nach Fehlerspeichereintrag" VALUE 0x71C78 TKW_VV_VV_UB 100.0 FORMULA_0003 0.0 255.0 /end CHARACTERISTIC
/begin CHARACTERISTIC K_ED_TGETR_HS.INC_VOR_EINTRAG "Filtererhoehung vorm Fehlerspeichereintrag" VALUE 0x71C76 TKW_VV_VV_UB 100.0 FORMULA_0003 0.0 255.0 /end CHARACTERISTIC
/begin CHARACTERISTIC K_ED_TGETR_HS.KLASSENINDEX "Auswahl der Fehlerklasse" VALUE 0x71C7A TKW_VV_VV_UB 100.0 FORMULA_0003 0.0 8.0 /end CHARACTERISTIC
/begin CHARACTERISTIC K_ED_TGETR_HS.OK_SCHWELLE "Filterschwelle fuer Fehleraustrag" VALUE 0x71C75 TKW_VV_VV_UB 100.0 FORMULA_0003 0.0 255.0 /end CHARACTERISTIC
/begin CHARACTERISTIC K_ED_TGETR_HS.P_CODE_OPENLOAD "P-Code fuer die Art OPENLOAD" VALUE 0x71C70 TKW_VV_VV_UW 100.0 FORMULA_0010 0.0 65535.0 /end CHARACTERISTIC
/begin CHARACTERISTIC K_ED_TGETR_HS.P_CODE_SH_TO_GND "P-Code fuer die Art SH_TO_GND" VALUE 0x71C6E TKW_VV_VV_UW 100.0 FORMULA_0010 0.0 65535.0 /end CHARACTERISTIC
/begin CHARACTERISTIC K_ED_TGETR_HS.P_CODE_SH_TO_UB "P-Code fuer die Art SH_TO_UB" VALUE 0x71C6C TKW_VV_VV_UW 100.0 FORMULA_0010 0.0 65535.0 /end CHARACTERISTIC
/begin CHARACTERISTIC K_ED_TGETR_HS.P_CODE_UNPLAUSIBEL "P-Code fuer die Art UNPLAUSIBEL" VALUE 0x71C72 TKW_VV_VV_UW 100.0 FORMULA_0010 0.0 65535.0 /end CHARACTERISTIC
/begin CHARACTERISTIC K_ED_TZ1.DEC_NACH_EINTRAG "Filterverringerung nach Fehlerspeichereintrag" VALUE 0x70FAD TKW_VV_VV_UB 100.0 FORMULA_0003 0.0 255.0 /end CHARACTERISTIC
/begin CHARACTERISTIC K_ED_TZ1.DEC_VOR_EINTRAG "Filterverringerung vorm Fehlerspeichereintrag" VALUE 0x70FAB TKW_VV_VV_UB 100.0 FORMULA_0003 0.0 255.0 /end CHARACTERISTIC
/begin CHARACTERISTIC K_ED_TZ1.FEHLERSCHWELLE "Filterschwelle fuer Fehlereintrag" VALUE 0x70FA8 TKW_VV_VV_UB 100.0 FORMULA_0003 0.0 255.0 /end CHARACTERISTIC
/begin CHARACTERISTIC K_ED_TZ1.INC_NACH_EINTRAG "Filtererhoehung nach Fehlerspeichereintrag" VALUE 0x70FAC TKW_VV_VV_UB 100.0 FORMULA_0003 0.0 255.0 /end CHARACTERISTIC
/begin CHARACTERISTIC K_ED_TZ1.INC_VOR_EINTRAG "Filtererhoehung vorm Fehlerspeichereintrag" VALUE 0x70FAA TKW_VV_VV_UB 100.0 FORMULA_0003 0.0 255.0 /end CHARACTERISTIC
/begin CHARACTERISTIC K_ED_TZ1.KLASSENINDEX "Auswahl der Fehlerklasse" VALUE 0x70FAE TKW_VV_VV_UB 100.0 FORMULA_0003 0.0 8.0 /end CHARACTERISTIC
/begin CHARACTERISTIC K_ED_TZ1.OK_SCHWELLE "Filterschwelle fuer Fehleraustrag" VALUE 0x70FA9 TKW_VV_VV_UB 100.0 FORMULA_0003 0.0 255.0 /end CHARACTERISTIC
/begin CHARACTERISTIC K_ED_TZ1.P_CODE_OPENLOAD "P-Code fuer die Art OPENLOAD" VALUE 0x70FA4 TKW_VV_VV_UW 100.0 FORMULA_0010 0.0 65535.0 /end CHARACTERISTIC
/begin CHARACTERISTIC K_ED_TZ1.P_CODE_SH_TO_GND "P-Code fuer die Art SH_TO_GND" VALUE 0x70FA2 TKW_VV_VV_UW 100.0 FORMULA_0010 0.0 65535.0 /end CHARACTERISTIC
/begin CHARACTERISTIC K_ED_TZ1.P_CODE_SH_TO_UB "P-Code fuer die Art SH_TO_UB" VALUE 0x70FA0 TKW_VV_VV_UW 100.0 FORMULA_0010 0.0 65535.0 /end CHARACTERISTIC
/begin CHARACTERISTIC K_ED_TZ1.P_CODE_UNPLAUSIBEL "P-Code fuer die Art UNPLAUSIBEL" VALUE 0x70FA6 TKW_VV_VV_UW 100.0 FORMULA_0010 0.0 65535.0 /end CHARACTERISTIC
/begin CHARACTERISTIC K_ED_TZ10.DEC_NACH_EINTRAG "Filterverringerung nach Fehlerspeichereintrag" VALUE 0x71097 TKW_VV_VV_UB 100.0 FORMULA_0003 0.0 255.0 /end CHARACTERISTIC
/begin CHARACTERISTIC K_ED_TZ10.DEC_VOR_EINTRAG "Filterverringerung vorm Fehlerspeichereintrag" VALUE 0x71095 TKW_VV_VV_UB 100.0 FORMULA_0003 0.0 255.0 /end CHARACTERISTIC
/begin CHARACTERISTIC K_ED_TZ10.FEHLERSCHWELLE "Filterschwelle fuer Fehlereintrag" VALUE 0x71092 TKW_VV_VV_UB 100.0 FORMULA_0003 0.0 255.0 /end CHARACTERISTIC
/begin CHARACTERISTIC K_ED_TZ10.INC_NACH_EINTRAG "Filtererhoehung nach Fehlerspeichereintrag" VALUE 0x71096 TKW_VV_VV_UB 100.0 FORMULA_0003 0.0 255.0 /end CHARACTERISTIC
/begin CHARACTERISTIC K_ED_TZ10.INC_VOR_EINTRAG "Filtererhoehung vorm Fehlerspeichereintrag" VALUE 0x71094 TKW_VV_VV_UB 100.0 FORMULA_0003 0.0 255.0 /end CHARACTERISTIC
/begin CHARACTERISTIC K_ED_TZ10.KLASSENINDEX "Auswahl der Fehlerklasse" VALUE 0x71098 TKW_VV_VV_UB 100.0 FORMULA_0003 0.0 8.0 /end CHARACTERISTIC
/begin CHARACTERISTIC K_ED_TZ10.OK_SCHWELLE "Filterschwelle fuer Fehleraustrag" VALUE 0x71093 TKW_VV_VV_UB 100.0 FORMULA_0003 0.0 255.0 /end CHARACTERISTIC
/begin CHARACTERISTIC K_ED_TZ10.P_CODE_OPENLOAD "P-Code fuer die Art OPENLOAD" VALUE 0x7108E TKW_VV_VV_UW 100.0 FORMULA_0010 0.0 65535.0 /end CHARACTERISTIC
/begin CHARACTERISTIC K_ED_TZ10.P_CODE_SH_TO_GND "P-Code fuer die Art SH_TO_GND" VALUE 0x7108C TKW_VV_VV_UW 100.0 FORMULA_0010 0.0 65535.0 /end CHARACTERISTIC
/begin CHARACTERISTIC K_ED_TZ10.P_CODE_SH_TO_UB "P-Code fuer die Art SH_TO_UB" VALUE 0x7108A TKW_VV_VV_UW 100.0 FORMULA_0010 0.0 65535.0 /end CHARACTERISTIC
/begin CHARACTERISTIC K_ED_TZ10.P_CODE_UNPLAUSIBEL "P-Code fuer die Art UNPLAUSIBEL" VALUE 0x71090 TKW_VV_VV_UW 100.0 FORMULA_0010 0.0 65535.0 /end CHARACTERISTIC
/begin CHARACTERISTIC K_ED_TZ2.DEC_NACH_EINTRAG "Filterverringerung nach Fehlerspeichereintrag" VALUE 0x70FC7 TKW_VV_VV_UB 100.0 FORMULA_0003 0.0 255.0 /end CHARACTERISTIC
/begin CHARACTERISTIC K_ED_TZ2.DEC_VOR_EINTRAG "Filterverringerung vorm Fehlerspeichereintrag" VALUE 0x70FC5 TKW_VV_VV_UB 100.0 FORMULA_0003 0.0 255.0 /end CHARACTERISTIC
/begin CHARACTERISTIC K_ED_TZ2.FEHLERSCHWELLE "Filterschwelle fuer Fehlereintrag" VALUE 0x70FC2 TKW_VV_VV_UB 100.0 FORMULA_0003 0.0 255.0 /end CHARACTERISTIC
/begin CHARACTERISTIC K_ED_TZ2.INC_NACH_EINTRAG "Filtererhoehung nach Fehlerspeichereintrag" VALUE 0x70FC6 TKW_VV_VV_UB 100.0 FORMULA_0003 0.0 255.0 /end CHARACTERISTIC
/begin CHARACTERISTIC K_ED_TZ2.INC_VOR_EINTRAG "Filtererhoehung vorm Fehlerspeichereintrag" VALUE 0x70FC4 TKW_VV_VV_UB 100.0 FORMULA_0003 0.0 255.0 /end CHARACTERISTIC
/begin CHARACTERISTIC K_ED_TZ2.KLASSENINDEX "Auswahl der Fehlerklasse" VALUE 0x70FC8 TKW_VV_VV_UB 100.0 FORMULA_0003 0.0 8.0 /end CHARACTERISTIC
/begin CHARACTERISTIC K_ED_TZ2.OK_SCHWELLE "Filterschwelle fuer Fehleraustrag" VALUE 0x70FC3 TKW_VV_VV_UB 100.0 FORMULA_0003 0.0 255.0 /end CHARACTERISTIC
/begin CHARACTERISTIC K_ED_TZ2.P_CODE_OPENLOAD "P-Code fuer die Art OPENLOAD" VALUE 0x70FBE TKW_VV_VV_UW 100.0 FORMULA_0010 0.0 65535.0 /end CHARACTERISTIC
/begin CHARACTERISTIC K_ED_TZ2.P_CODE_SH_TO_GND "P-Code fuer die Art SH_TO_GND" VALUE 0x70FBC TKW_VV_VV_UW 100.0 FORMULA_0010 0.0 65535.0 /end CHARACTERISTIC
/begin CHARACTERISTIC K_ED_TZ2.P_CODE_SH_TO_UB "P-Code fuer die Art SH_TO_UB" VALUE 0x70FBA TKW_VV_VV_UW 100.0 FORMULA_0010 0.0 65535.0 /end CHARACTERISTIC
/begin CHARACTERISTIC K_ED_TZ2.P_CODE_UNPLAUSIBEL "P-Code fuer die Art UNPLAUSIBEL" VALUE 0x70FC0 TKW_VV_VV_UW 100.0 FORMULA_0010 0.0 65535.0 /end CHARACTERISTIC
/begin CHARACTERISTIC K_ED_TZ3.DEC_NACH_EINTRAG "Filterverringerung nach Fehlerspeichereintrag" VALUE 0x70FE1 TKW_VV_VV_UB 100.0 FORMULA_0003 0.0 255.0 /end CHARACTERISTIC
/begin CHARACTERISTIC K_ED_TZ3.DEC_VOR_EINTRAG "Filterverringerung vorm Fehlerspeichereintrag" VALUE 0x70FDF TKW_VV_VV_UB 100.0 FORMULA_0003 0.0 255.0 /end CHARACTERISTIC
/begin CHARACTERISTIC K_ED_TZ3.FEHLERSCHWELLE "Filterschwelle fuer Fehlereintrag" VALUE 0x70FDC TKW_VV_VV_UB 100.0 FORMULA_0003 0.0 255.0 /end CHARACTERISTIC
/begin CHARACTERISTIC K_ED_TZ3.INC_NACH_EINTRAG "Filtererhoehung nach Fehlerspeichereintrag" VALUE 0x70FE0 TKW_VV_VV_UB 100.0 FORMULA_0003 0.0 255.0 /end CHARACTERISTIC
/begin CHARACTERISTIC K_ED_TZ3.INC_VOR_EINTRAG "Filtererhoehung vorm Fehlerspeichereintrag" VALUE 0x70FDE TKW_VV_VV_UB 100.0 FORMULA_0003 0.0 255.0 /end CHARACTERISTIC
/begin CHARACTERISTIC K_ED_TZ3.KLASSENINDEX "Auswahl der Fehlerklasse" VALUE 0x70FE2 TKW_VV_VV_UB 100.0 FORMULA_0003 0.0 8.0 /end CHARACTERISTIC
/begin CHARACTERISTIC K_ED_TZ3.OK_SCHWELLE "Filterschwelle fuer Fehleraustrag" VALUE 0x70FDD TKW_VV_VV_UB 100.0 FORMULA_0003 0.0 255.0 /end CHARACTERISTIC
/begin CHARACTERISTIC K_ED_TZ3.P_CODE_OPENLOAD "P-Code fuer die Art OPENLOAD" VALUE 0x70FD8 TKW_VV_VV_UW 100.0 FORMULA_0010 0.0 65535.0 /end CHARACTERISTIC
/begin CHARACTERISTIC K_ED_TZ3.P_CODE_SH_TO_GND "P-Code fuer die Art SH_TO_GND" VALUE 0x70FD6 TKW_VV_VV_UW 100.0 FORMULA_0010 0.0 65535.0 /end CHARACTERISTIC
/begin CHARACTERISTIC K_ED_TZ3.P_CODE_SH_TO_UB "P-Code fuer die Art SH_TO_UB" VALUE 0x70FD4 TKW_VV_VV_UW 100.0 FORMULA_0010 0.0 65535.0 /end CHARACTERISTIC
/begin CHARACTERISTIC K_ED_TZ3.P_CODE_UNPLAUSIBEL "P-Code fuer die Art UNPLAUSIBEL" VALUE 0x70FDA TKW_VV_VV_UW 100.0 FORMULA_0010 0.0 65535.0 /end CHARACTERISTIC
/begin CHARACTERISTIC K_ED_TZ4.DEC_NACH_EINTRAG "Filterverringerung nach Fehlerspeichereintrag" VALUE 0x70FFB TKW_VV_VV_UB 100.0 FORMULA_0003 0.0 255.0 /end CHARACTERISTIC
/begin CHARACTERISTIC K_ED_TZ4.DEC_VOR_EINTRAG "Filterverringerung vorm Fehlerspeichereintrag" VALUE 0x70FF9 TKW_VV_VV_UB 100.0 FORMULA_0003 0.0 255.0 /end CHARACTERISTIC
/begin CHARACTERISTIC K_ED_TZ4.FEHLERSCHWELLE "Filterschwelle fuer Fehlereintrag" VALUE 0x70FF6 TKW_VV_VV_UB 100.0 FORMULA_0003 0.0 255.0 /end CHARACTERISTIC
/begin CHARACTERISTIC K_ED_TZ4.INC_NACH_EINTRAG "Filtererhoehung nach Fehlerspeichereintrag" VALUE 0x70FFA TKW_VV_VV_UB 100.0 FORMULA_0003 0.0 255.0 /end CHARACTERISTIC
/begin CHARACTERISTIC K_ED_TZ4.INC_VOR_EINTRAG "Filtererhoehung vorm Fehlerspeichereintrag" VALUE 0x70FF8 TKW_VV_VV_UB 100.0 FORMULA_0003 0.0 255.0 /end CHARACTERISTIC
/begin CHARACTERISTIC K_ED_TZ4.KLASSENINDEX "Auswahl der Fehlerklasse" VALUE 0x70FFC TKW_VV_VV_UB 100.0 FORMULA_0003 0.0 8.0 /end CHARACTERISTIC
/begin CHARACTERISTIC K_ED_TZ4.OK_SCHWELLE "Filterschwelle fuer Fehleraustrag" VALUE 0x70FF7 TKW_VV_VV_UB 100.0 FORMULA_0003 0.0 255.0 /end CHARACTERISTIC
/begin CHARACTERISTIC K_ED_TZ4.P_CODE_OPENLOAD "P-Code fuer die Art OPENLOAD" VALUE 0x70FF2 TKW_VV_VV_UW 100.0 FORMULA_0010 0.0 65535.0 /end CHARACTERISTIC
/begin CHARACTERISTIC K_ED_TZ4.P_CODE_SH_TO_GND "P-Code fuer die Art SH_TO_GND" VALUE 0x70FF0 TKW_VV_VV_UW 100.0 FORMULA_0010 0.0 65535.0 /end CHARACTERISTIC
/begin CHARACTERISTIC K_ED_TZ4.P_CODE_SH_TO_UB "P-Code fuer die Art SH_TO_UB" VALUE 0x70FEE TKW_VV_VV_UW 100.0 FORMULA_0010 0.0 65535.0 /end CHARACTERISTIC
/begin CHARACTERISTIC K_ED_TZ4.P_CODE_UNPLAUSIBEL "P-Code fuer die Art UNPLAUSIBEL" VALUE 0x70FF4 TKW_VV_VV_UW 100.0 FORMULA_0010 0.0 65535.0 /end CHARACTERISTIC
/begin CHARACTERISTIC K_ED_TZ5.DEC_NACH_EINTRAG "Filterverringerung nach Fehlerspeichereintrag" VALUE 0x71015 TKW_VV_VV_UB 100.0 FORMULA_0003 0.0 255.0 /end CHARACTERISTIC
/begin CHARACTERISTIC K_ED_TZ5.DEC_VOR_EINTRAG "Filterverringerung vorm Fehlerspeichereintrag" VALUE 0x71013 TKW_VV_VV_UB 100.0 FORMULA_0003 0.0 255.0 /end CHARACTERISTIC
/begin CHARACTERISTIC K_ED_TZ5.FEHLERSCHWELLE "Filterschwelle fuer Fehlereintrag" VALUE 0x71010 TKW_VV_VV_UB 100.0 FORMULA_0003 0.0 255.0 /end CHARACTERISTIC
/begin CHARACTERISTIC K_ED_TZ5.INC_NACH_EINTRAG "Filtererhoehung nach Fehlerspeichereintrag" VALUE 0x71014 TKW_VV_VV_UB 100.0 FORMULA_0003 0.0 255.0 /end CHARACTERISTIC
/begin CHARACTERISTIC K_ED_TZ5.INC_VOR_EINTRAG "Filtererhoehung vorm Fehlerspeichereintrag" VALUE 0x71012 TKW_VV_VV_UB 100.0 FORMULA_0003 0.0 255.0 /end CHARACTERISTIC
/begin CHARACTERISTIC K_ED_TZ5.KLASSENINDEX "Auswahl der Fehlerklasse" VALUE 0x71016 TKW_VV_VV_UB 100.0 FORMULA_0003 0.0 8.0 /end CHARACTERISTIC
/begin CHARACTERISTIC K_ED_TZ5.OK_SCHWELLE "Filterschwelle fuer Fehleraustrag" VALUE 0x71011 TKW_VV_VV_UB 100.0 FORMULA_0003 0.0 255.0 /end CHARACTERISTIC
/begin CHARACTERISTIC K_ED_TZ5.P_CODE_OPENLOAD "P-Code fuer die Art OPENLOAD" VALUE 0x7100C TKW_VV_VV_UW 100.0 FORMULA_0010 0.0 65535.0 /end CHARACTERISTIC
/begin CHARACTERISTIC K_ED_TZ5.P_CODE_SH_TO_GND "P-Code fuer die Art SH_TO_GND" VALUE 0x7100A TKW_VV_VV_UW 100.0 FORMULA_0010 0.0 65535.0 /end CHARACTERISTIC
/begin CHARACTERISTIC K_ED_TZ5.P_CODE_SH_TO_UB "P-Code fuer die Art SH_TO_UB" VALUE 0x71008 TKW_VV_VV_UW 100.0 FORMULA_0010 0.0 65535.0 /end CHARACTERISTIC
/begin CHARACTERISTIC K_ED_TZ5.P_CODE_UNPLAUSIBEL "P-Code fuer die Art UNPLAUSIBEL" VALUE 0x7100E TKW_VV_VV_UW 100.0 FORMULA_0010 0.0 65535.0 /end CHARACTERISTIC
/begin CHARACTERISTIC K_ED_TZ6.DEC_NACH_EINTRAG "Filterverringerung nach Fehlerspeichereintrag" VALUE 0x7102F TKW_VV_VV_UB 100.0 FORMULA_0003 0.0 255.0 /end CHARACTERISTIC
/begin CHARACTERISTIC K_ED_TZ6.DEC_VOR_EINTRAG "Filterverringerung vorm Fehlerspeichereintrag" VALUE 0x7102D TKW_VV_VV_UB 100.0 FORMULA_0003 0.0 255.0 /end CHARACTERISTIC
/begin CHARACTERISTIC K_ED_TZ6.FEHLERSCHWELLE "Filterschwelle fuer Fehlereintrag" VALUE 0x7102A TKW_VV_VV_UB 100.0 FORMULA_0003 0.0 255.0 /end CHARACTERISTIC
/begin CHARACTERISTIC K_ED_TZ6.INC_NACH_EINTRAG "Filtererhoehung nach Fehlerspeichereintrag" VALUE 0x7102E TKW_VV_VV_UB 100.0 FORMULA_0003 0.0 255.0 /end CHARACTERISTIC
/begin CHARACTERISTIC K_ED_TZ6.INC_VOR_EINTRAG "Filtererhoehung vorm Fehlerspeichereintrag" VALUE 0x7102C TKW_VV_VV_UB 100.0 FORMULA_0003 0.0 255.0 /end CHARACTERISTIC
/begin CHARACTERISTIC K_ED_TZ6.KLASSENINDEX "Auswahl der Fehlerklasse" VALUE 0x71030 TKW_VV_VV_UB 100.0 FORMULA_0003 0.0 8.0 /end CHARACTERISTIC
/begin CHARACTERISTIC K_ED_TZ6.OK_SCHWELLE "Filterschwelle fuer Fehleraustrag" VALUE 0x7102B TKW_VV_VV_UB 100.0 FORMULA_0003 0.0 255.0 /end CHARACTERISTIC
/begin CHARACTERISTIC K_ED_TZ6.P_CODE_OPENLOAD "P-Code fuer die Art OPENLOAD" VALUE 0x71026 TKW_VV_VV_UW 100.0 FORMULA_0010 0.0 65535.0 /end CHARACTERISTIC
/begin CHARACTERISTIC K_ED_TZ6.P_CODE_SH_TO_GND "P-Code fuer die Art SH_TO_GND" VALUE 0x71024 TKW_VV_VV_UW 100.0 FORMULA_0010 0.0 65535.0 /end CHARACTERISTIC
/begin CHARACTERISTIC K_ED_TZ6.P_CODE_SH_TO_UB "P-Code fuer die Art SH_TO_UB" VALUE 0x71022 TKW_VV_VV_UW 100.0 FORMULA_0010 0.0 65535.0 /end CHARACTERISTIC
/begin CHARACTERISTIC K_ED_TZ6.P_CODE_UNPLAUSIBEL "P-Code fuer die Art UNPLAUSIBEL" VALUE 0x71028 TKW_VV_VV_UW 100.0 FORMULA_0010 0.0 65535.0 /end CHARACTERISTIC
/begin CHARACTERISTIC K_ED_TZ7.DEC_NACH_EINTRAG "Filterverringerung nach Fehlerspeichereintrag" VALUE 0x71049 TKW_VV_VV_UB 100.0 FORMULA_0003 0.0 255.0 /end CHARACTERISTIC
/begin CHARACTERISTIC K_ED_TZ7.DEC_VOR_EINTRAG "Filterverringerung vorm Fehlerspeichereintrag" VALUE 0x71047 TKW_VV_VV_UB 100.0 FORMULA_0003 0.0 255.0 /end CHARACTERISTIC
/begin CHARACTERISTIC K_ED_TZ7.FEHLERSCHWELLE "Filterschwelle fuer Fehlereintrag" VALUE 0x71044 TKW_VV_VV_UB 100.0 FORMULA_0003 0.0 255.0 /end CHARACTERISTIC
/begin CHARACTERISTIC K_ED_TZ7.INC_NACH_EINTRAG "Filtererhoehung nach Fehlerspeichereintrag" VALUE 0x71048 TKW_VV_VV_UB 100.0 FORMULA_0003 0.0 255.0 /end CHARACTERISTIC
/begin CHARACTERISTIC K_ED_TZ7.INC_VOR_EINTRAG "Filtererhoehung vorm Fehlerspeichereintrag" VALUE 0x71046 TKW_VV_VV_UB 100.0 FORMULA_0003 0.0 255.0 /end CHARACTERISTIC
/begin CHARACTERISTIC K_ED_TZ7.KLASSENINDEX "Auswahl der Fehlerklasse" VALUE 0x7104A TKW_VV_VV_UB 100.0 FORMULA_0003 0.0 8.0 /end CHARACTERISTIC
/begin CHARACTERISTIC K_ED_TZ7.OK_SCHWELLE "Filterschwelle fuer Fehleraustrag" VALUE 0x71045 TKW_VV_VV_UB 100.0 FORMULA_0003 0.0 255.0 /end CHARACTERISTIC
/begin CHARACTERISTIC K_ED_TZ7.P_CODE_OPENLOAD "P-Code fuer die Art OPENLOAD" VALUE 0x71040 TKW_VV_VV_UW 100.0 FORMULA_0010 0.0 65535.0 /end CHARACTERISTIC
/begin CHARACTERISTIC K_ED_TZ7.P_CODE_SH_TO_GND "P-Code fuer die Art SH_TO_GND" VALUE 0x7103E TKW_VV_VV_UW 100.0 FORMULA_0010 0.0 65535.0 /end CHARACTERISTIC
/begin CHARACTERISTIC K_ED_TZ7.P_CODE_SH_TO_UB "P-Code fuer die Art SH_TO_UB" VALUE 0x7103C TKW_VV_VV_UW 100.0 FORMULA_0010 0.0 65535.0 /end CHARACTERISTIC
/begin CHARACTERISTIC K_ED_TZ7.P_CODE_UNPLAUSIBEL "P-Code fuer die Art UNPLAUSIBEL" VALUE 0x71042 TKW_VV_VV_UW 100.0 FORMULA_0010 0.0 65535.0 /end CHARACTERISTIC
/begin CHARACTERISTIC K_ED_TZ8.DEC_NACH_EINTRAG "Filterverringerung nach Fehlerspeichereintrag" VALUE 0x71063 TKW_VV_VV_UB 100.0 FORMULA_0003 0.0 255.0 /end CHARACTERISTIC
/begin CHARACTERISTIC K_ED_TZ8.DEC_VOR_EINTRAG "Filterverringerung vorm Fehlerspeichereintrag" VALUE 0x71061 TKW_VV_VV_UB 100.0 FORMULA_0003 0.0 255.0 /end CHARACTERISTIC
/begin CHARACTERISTIC K_ED_TZ8.FEHLERSCHWELLE "Filterschwelle fuer Fehlereintrag" VALUE 0x7105E TKW_VV_VV_UB 100.0 FORMULA_0003 0.0 255.0 /end CHARACTERISTIC
/begin CHARACTERISTIC K_ED_TZ8.INC_NACH_EINTRAG "Filtererhoehung nach Fehlerspeichereintrag" VALUE 0x71062 TKW_VV_VV_UB 100.0 FORMULA_0003 0.0 255.0 /end CHARACTERISTIC
/begin CHARACTERISTIC K_ED_TZ8.INC_VOR_EINTRAG "Filtererhoehung vorm Fehlerspeichereintrag" VALUE 0x71060 TKW_VV_VV_UB 100.0 FORMULA_0003 0.0 255.0 /end CHARACTERISTIC
/begin CHARACTERISTIC K_ED_TZ8.KLASSENINDEX "Auswahl der Fehlerklasse" VALUE 0x71064 TKW_VV_VV_UB 100.0 FORMULA_0003 0.0 8.0 /end CHARACTERISTIC
/begin CHARACTERISTIC K_ED_TZ8.OK_SCHWELLE "Filterschwelle fuer Fehleraustrag" VALUE 0x7105F TKW_VV_VV_UB 100.0 FORMULA_0003 0.0 255.0 /end CHARACTERISTIC
/begin CHARACTERISTIC K_ED_TZ8.P_CODE_OPENLOAD "P-Code fuer die Art OPENLOAD" VALUE 0x7105A TKW_VV_VV_UW 100.0 FORMULA_0010 0.0 65535.0 /end CHARACTERISTIC
/begin CHARACTERISTIC K_ED_TZ8.P_CODE_SH_TO_GND "P-Code fuer die Art SH_TO_GND" VALUE 0x71058 TKW_VV_VV_UW 100.0 FORMULA_0010 0.0 65535.0 /end CHARACTERISTIC
/begin CHARACTERISTIC K_ED_TZ8.P_CODE_SH_TO_UB "P-Code fuer die Art SH_TO_UB" VALUE 0x71056 TKW_VV_VV_UW 100.0 FORMULA_0010 0.0 65535.0 /end CHARACTERISTIC
/begin CHARACTERISTIC K_ED_TZ8.P_CODE_UNPLAUSIBEL "P-Code fuer die Art UNPLAUSIBEL" VALUE 0x7105C TKW_VV_VV_UW 100.0 FORMULA_0010 0.0 65535.0 /end CHARACTERISTIC
/begin CHARACTERISTIC K_ED_TZ9.DEC_NACH_EINTRAG "Filterverringerung nach Fehlerspeichereintrag" VALUE 0x7107D TKW_VV_VV_UB 100.0 FORMULA_0003 0.0 255.0 /end CHARACTERISTIC
/begin CHARACTERISTIC K_ED_TZ9.DEC_VOR_EINTRAG "Filterverringerung vorm Fehlerspeichereintrag" VALUE 0x7107B TKW_VV_VV_UB 100.0 FORMULA_0003 0.0 255.0 /end CHARACTERISTIC
/begin CHARACTERISTIC K_ED_TZ9.FEHLERSCHWELLE "Filterschwelle fuer Fehlereintrag" VALUE 0x71078 TKW_VV_VV_UB 100.0 FORMULA_0003 0.0 255.0 /end CHARACTERISTIC
/begin CHARACTERISTIC K_ED_TZ9.INC_NACH_EINTRAG "Filtererhoehung nach Fehlerspeichereintrag" VALUE 0x7107C TKW_VV_VV_UB 100.0 FORMULA_0003 0.0 255.0 /end CHARACTERISTIC
/begin CHARACTERISTIC K_ED_TZ9.INC_VOR_EINTRAG "Filtererhoehung vorm Fehlerspeichereintrag" VALUE 0x7107A TKW_VV_VV_UB 100.0 FORMULA_0003 0.0 255.0 /end CHARACTERISTIC
/begin CHARACTERISTIC K_ED_TZ9.KLASSENINDEX "Auswahl der Fehlerklasse" VALUE 0x7107E TKW_VV_VV_UB 100.0 FORMULA_0003 0.0 8.0 /end CHARACTERISTIC
/begin CHARACTERISTIC K_ED_TZ9.OK_SCHWELLE "Filterschwelle fuer Fehleraustrag" VALUE 0x71079 TKW_VV_VV_UB 100.0 FORMULA_0003 0.0 255.0 /end CHARACTERISTIC
/begin CHARACTERISTIC K_ED_TZ9.P_CODE_OPENLOAD "P-Code fuer die Art OPENLOAD" VALUE 0x71074 TKW_VV_VV_UW 100.0 FORMULA_0010 0.0 65535.0 /end CHARACTERISTIC
/begin CHARACTERISTIC K_ED_TZ9.P_CODE_SH_TO_GND "P-Code fuer die Art SH_TO_GND" VALUE 0x71072 TKW_VV_VV_UW 100.0 FORMULA_0010 0.0 65535.0 /end CHARACTERISTIC
/begin CHARACTERISTIC K_ED_TZ9.P_CODE_SH_TO_UB "P-Code fuer die Art SH_TO_UB" VALUE 0x71070 TKW_VV_VV_UW 100.0 FORMULA_0010 0.0 65535.0 /end CHARACTERISTIC
/begin CHARACTERISTIC K_ED_TZ9.P_CODE_UNPLAUSIBEL "P-Code fuer die Art UNPLAUSIBEL" VALUE 0x71076 TKW_VV_VV_UW 100.0 FORMULA_0010 0.0 65535.0 /end CHARACTERISTIC
/begin CHARACTERISTIC K_ED_UBMIN "untere UB-Schwelle fuer elektr. Diagnosen" VALUE 0x71FB0 TKW_VV_VV_SW 100.0 FORMULA_0008 0.0 28.0 FORMAT "%4.1" /end CHARACTERISTIC
/begin CHARACTERISTIC K_ED_VAN_ANSCHL_A1.DEC_NACH_EINTRAG "Filterverringerung nach Fehlerspeichereintrag" VALUE 0x710FF TKW_VV_VV_UB 100.0 FORMULA_0003 0.0 255.0 /end CHARACTERISTIC
/begin CHARACTERISTIC K_ED_VAN_ANSCHL_A1.DEC_VOR_EINTRAG "Filterverringerung vorm Fehlerspeichereintrag" VALUE 0x710FD TKW_VV_VV_UB 100.0 FORMULA_0003 0.0 255.0 /end CHARACTERISTIC
/begin CHARACTERISTIC K_ED_VAN_ANSCHL_A1.FEHLERSCHWELLE "Filterschwelle fuer Fehlereintrag" VALUE 0x710FA TKW_VV_VV_UB 100.0 FORMULA_0003 0.0 255.0 /end CHARACTERISTIC
/begin CHARACTERISTIC K_ED_VAN_ANSCHL_A1.INC_NACH_EINTRAG "Filtererhoehung nach Fehlerspeichereintrag" VALUE 0x710FE TKW_VV_VV_UB 100.0 FORMULA_0003 0.0 255.0 /end CHARACTERISTIC
/begin CHARACTERISTIC K_ED_VAN_ANSCHL_A1.INC_VOR_EINTRAG "Filtererhoehung vorm Fehlerspeichereintrag" VALUE 0x710FC TKW_VV_VV_UB 100.0 FORMULA_0003 0.0 255.0 /end CHARACTERISTIC
/begin CHARACTERISTIC K_ED_VAN_ANSCHL_A1.KLASSENINDEX "Auswahl der Fehlerklasse" VALUE 0x71100 TKW_VV_VV_UB 100.0 FORMULA_0003 0.0 8.0 /end CHARACTERISTIC
/begin CHARACTERISTIC K_ED_VAN_ANSCHL_A1.OK_SCHWELLE "Filterschwelle fuer Fehleraustrag" VALUE 0x710FB TKW_VV_VV_UB 100.0 FORMULA_0003 0.0 255.0 /end CHARACTERISTIC
/begin CHARACTERISTIC K_ED_VAN_ANSCHL_A1.P_CODE_OPENLOAD "P-Code fuer die Art OPENLOAD" VALUE 0x710F6 TKW_VV_VV_UW 100.0 FORMULA_0010 0.0 65535.0 /end CHARACTERISTIC
/begin CHARACTERISTIC K_ED_VAN_ANSCHL_A1.P_CODE_SH_TO_GND "P-Code fuer die Art SH_TO_GND" VALUE 0x710F4 TKW_VV_VV_UW 100.0 FORMULA_0010 0.0 65535.0 /end CHARACTERISTIC
/begin CHARACTERISTIC K_ED_VAN_ANSCHL_A1.P_CODE_SH_TO_UB "P-Code fuer die Art SH_TO_UB" VALUE 0x710F2 TKW_VV_VV_UW 100.0 FORMULA_0010 0.0 65535.0 /end CHARACTERISTIC
/begin CHARACTERISTIC K_ED_VAN_ANSCHL_A1.P_CODE_UNPLAUSIBEL "P-Code fuer die Art UNPLAUSIBEL" VALUE 0x710F8 TKW_VV_VV_UW 100.0 FORMULA_0010 0.0 65535.0 /end CHARACTERISTIC
/begin CHARACTERISTIC K_ED_VAN_ANSCHL_A2.DEC_NACH_EINTRAG "Filterverringerung nach Fehlerspeichereintrag" VALUE 0x71133 TKW_VV_VV_UB 100.0 FORMULA_0003 0.0 255.0 /end CHARACTERISTIC
/begin CHARACTERISTIC K_ED_VAN_ANSCHL_A2.DEC_VOR_EINTRAG "Filterverringerung vorm Fehlerspeichereintrag" VALUE 0x71131 TKW_VV_VV_UB 100.0 FORMULA_0003 0.0 255.0 /end CHARACTERISTIC
/begin CHARACTERISTIC K_ED_VAN_ANSCHL_A2.FEHLERSCHWELLE "Filterschwelle fuer Fehlereintrag" VALUE 0x7112E TKW_VV_VV_UB 100.0 FORMULA_0003 0.0 255.0 /end CHARACTERISTIC
/begin CHARACTERISTIC K_ED_VAN_ANSCHL_A2.INC_NACH_EINTRAG "Filtererhoehung nach Fehlerspeichereintrag" VALUE 0x71132 TKW_VV_VV_UB 100.0 FORMULA_0003 0.0 255.0 /end CHARACTERISTIC
/begin CHARACTERISTIC K_ED_VAN_ANSCHL_A2.INC_VOR_EINTRAG "Filtererhoehung vorm Fehlerspeichereintrag" VALUE 0x71130 TKW_VV_VV_UB 100.0 FORMULA_0003 0.0 255.0 /end CHARACTERISTIC
/begin CHARACTERISTIC K_ED_VAN_ANSCHL_A2.KLASSENINDEX "Auswahl der Fehlerklasse" VALUE 0x71134 TKW_VV_VV_UB 100.0 FORMULA_0003 0.0 8.0 /end CHARACTERISTIC
/begin CHARACTERISTIC K_ED_VAN_ANSCHL_A2.OK_SCHWELLE "Filterschwelle fuer Fehleraustrag" VALUE 0x7112F TKW_VV_VV_UB 100.0 FORMULA_0003 0.0 255.0 /end CHARACTERISTIC
/begin CHARACTERISTIC K_ED_VAN_ANSCHL_A2.P_CODE_OPENLOAD "P-Code fuer die Art OPENLOAD" VALUE 0x7112A TKW_VV_VV_UW 100.0 FORMULA_0010 0.0 65535.0 /end CHARACTERISTIC
/begin CHARACTERISTIC K_ED_VAN_ANSCHL_A2.P_CODE_SH_TO_GND "P-Code fuer die Art SH_TO_GND" VALUE 0x71128 TKW_VV_VV_UW 100.0 FORMULA_0010 0.0 65535.0 /end CHARACTERISTIC
/begin CHARACTERISTIC K_ED_VAN_ANSCHL_A2.P_CODE_SH_TO_UB "P-Code fuer die Art SH_TO_UB" VALUE 0x71126 TKW_VV_VV_UW 100.0 FORMULA_0010 0.0 65535.0 /end CHARACTERISTIC
/begin CHARACTERISTIC K_ED_VAN_ANSCHL_A2.P_CODE_UNPLAUSIBEL "P-Code fuer die Art UNPLAUSIBEL" VALUE 0x7112C TKW_VV_VV_UW 100.0 FORMULA_0010 0.0 65535.0 /end CHARACTERISTIC
/begin CHARACTERISTIC K_ED_VAN_ANSCHL_E1.DEC_NACH_EINTRAG "Filterverringerung nach Fehlerspeichereintrag" VALUE 0x710E5 TKW_VV_VV_UB 100.0 FORMULA_0003 0.0 255.0 /end CHARACTERISTIC
/begin CHARACTERISTIC K_ED_VAN_ANSCHL_E1.DEC_VOR_EINTRAG "Filterverringerung vorm Fehlerspeichereintrag" VALUE 0x710E3 TKW_VV_VV_UB 100.0 FORMULA_0003 0.0 255.0 /end CHARACTERISTIC
/begin CHARACTERISTIC K_ED_VAN_ANSCHL_E1.FEHLERSCHWELLE "Filterschwelle fuer Fehlereintrag" VALUE 0x710E0 TKW_VV_VV_UB 100.0 FORMULA_0003 0.0 255.0 /end CHARACTERISTIC
/begin CHARACTERISTIC K_ED_VAN_ANSCHL_E1.INC_NACH_EINTRAG "Filtererhoehung nach Fehlerspeichereintrag" VALUE 0x710E4 TKW_VV_VV_UB 100.0 FORMULA_0003 0.0 255.0 /end CHARACTERISTIC
/begin CHARACTERISTIC K_ED_VAN_ANSCHL_E1.INC_VOR_EINTRAG "Filtererhoehung vorm Fehlerspeichereintrag" VALUE 0x710E2 TKW_VV_VV_UB 100.0 FORMULA_0003 0.0 255.0 /end CHARACTERISTIC
/begin CHARACTERISTIC K_ED_VAN_ANSCHL_E1.KLASSENINDEX "Auswahl der Fehlerklasse" VALUE 0x710E6 TKW_VV_VV_UB 100.0 FORMULA_0003 0.0 8.0 /end CHARACTERISTIC
/begin CHARACTERISTIC K_ED_VAN_ANSCHL_E1.OK_SCHWELLE "Filterschwelle fuer Fehleraustrag" VALUE 0x710E1 TKW_VV_VV_UB 100.0 FORMULA_0003 0.0 255.0 /end CHARACTERISTIC
/begin CHARACTERISTIC K_ED_VAN_ANSCHL_E1.P_CODE_OPENLOAD "P-Code fuer die Art OPENLOAD" VALUE 0x710DC TKW_VV_VV_UW 100.0 FORMULA_0010 0.0 65535.0 /end CHARACTERISTIC
/begin CHARACTERISTIC K_ED_VAN_ANSCHL_E1.P_CODE_SH_TO_GND "P-Code fuer die Art SH_TO_GND" VALUE 0x710DA TKW_VV_VV_UW 100.0 FORMULA_0010 0.0 65535.0 /end CHARACTERISTIC
/begin CHARACTERISTIC K_ED_VAN_ANSCHL_E1.P_CODE_SH_TO_UB "P-Code fuer die Art SH_TO_UB" VALUE 0x710D8 TKW_VV_VV_UW 100.0 FORMULA_0010 0.0 65535.0 /end CHARACTERISTIC
/begin CHARACTERISTIC K_ED_VAN_ANSCHL_E1.P_CODE_UNPLAUSIBEL "P-Code fuer die Art UNPLAUSIBEL" VALUE 0x710DE TKW_VV_VV_UW 100.0 FORMULA_0010 0.0 65535.0 /end CHARACTERISTIC
/begin CHARACTERISTIC K_ED_VAN_ANSCHL_E2.DEC_NACH_EINTRAG "Filterverringerung nach Fehlerspeichereintrag" VALUE 0x71119 TKW_VV_VV_UB 100.0 FORMULA_0003 0.0 255.0 /end CHARACTERISTIC
/begin CHARACTERISTIC K_ED_VAN_ANSCHL_E2.DEC_VOR_EINTRAG "Filterverringerung vorm Fehlerspeichereintrag" VALUE 0x71117 TKW_VV_VV_UB 100.0 FORMULA_0003 0.0 255.0 /end CHARACTERISTIC
/begin CHARACTERISTIC K_ED_VAN_ANSCHL_E2.FEHLERSCHWELLE "Filterschwelle fuer Fehlereintrag" VALUE 0x71114 TKW_VV_VV_UB 100.0 FORMULA_0003 0.0 255.0 /end CHARACTERISTIC
/begin CHARACTERISTIC K_ED_VAN_ANSCHL_E2.INC_NACH_EINTRAG "Filtererhoehung nach Fehlerspeichereintrag" VALUE 0x71118 TKW_VV_VV_UB 100.0 FORMULA_0003 0.0 255.0 /end CHARACTERISTIC
/begin CHARACTERISTIC K_ED_VAN_ANSCHL_E2.INC_VOR_EINTRAG "Filtererhoehung vorm Fehlerspeichereintrag" VALUE 0x71116 TKW_VV_VV_UB 100.0 FORMULA_0003 0.0 255.0 /end CHARACTERISTIC
/begin CHARACTERISTIC K_ED_VAN_ANSCHL_E2.KLASSENINDEX "Auswahl der Fehlerklasse" VALUE 0x7111A TKW_VV_VV_UB 100.0 FORMULA_0003 0.0 8.0 /end CHARACTERISTIC
/begin CHARACTERISTIC K_ED_VAN_ANSCHL_E2.OK_SCHWELLE "Filterschwelle fuer Fehleraustrag" VALUE 0x71115 TKW_VV_VV_UB 100.0 FORMULA_0003 0.0 255.0 /end CHARACTERISTIC
/begin CHARACTERISTIC K_ED_VAN_ANSCHL_E2.P_CODE_OPENLOAD "P-Code fuer die Art OPENLOAD" VALUE 0x71110 TKW_VV_VV_UW 100.0 FORMULA_0010 0.0 65535.0 /end CHARACTERISTIC
/begin CHARACTERISTIC K_ED_VAN_ANSCHL_E2.P_CODE_SH_TO_GND "P-Code fuer die Art SH_TO_GND" VALUE 0x7110E TKW_VV_VV_UW 100.0 FORMULA_0010 0.0 65535.0 /end CHARACTERISTIC
/begin CHARACTERISTIC K_ED_VAN_ANSCHL_E2.P_CODE_SH_TO_UB "P-Code fuer die Art SH_TO_UB" VALUE 0x7110C TKW_VV_VV_UW 100.0 FORMULA_0010 0.0 65535.0 /end CHARACTERISTIC
/begin CHARACTERISTIC K_ED_VAN_ANSCHL_E2.P_CODE_UNPLAUSIBEL "P-Code fuer die Art UNPLAUSIBEL" VALUE 0x71112 TKW_VV_VV_UW 100.0 FORMULA_0010 0.0 65535.0 /end CHARACTERISTIC
/begin CHARACTERISTIC K_ED_VAN_DRUCK.DEC_NACH_EINTRAG "Filterverringerung nach Fehlerspeichereintrag" VALUE 0x719BB TKW_VV_VV_UB 100.0 FORMULA_0003 0.0 255.0 /end CHARACTERISTIC
/begin CHARACTERISTIC K_ED_VAN_DRUCK.DEC_VOR_EINTRAG "Filterverringerung vorm Fehlerspeichereintrag" VALUE 0x719B9 TKW_VV_VV_UB 100.0 FORMULA_0003 0.0 255.0 /end CHARACTERISTIC
/begin CHARACTERISTIC K_ED_VAN_DRUCK.FEHLERSCHWELLE "Filterschwelle fuer Fehlereintrag" VALUE 0x719B6 TKW_VV_VV_UB 100.0 FORMULA_0003 0.0 255.0 /end CHARACTERISTIC
/begin CHARACTERISTIC K_ED_VAN_DRUCK.INC_NACH_EINTRAG "Filtererhoehung nach Fehlerspeichereintrag" VALUE 0x719BA TKW_VV_VV_UB 100.0 FORMULA_0003 0.0 255.0 /end CHARACTERISTIC
/begin CHARACTERISTIC K_ED_VAN_DRUCK.INC_VOR_EINTRAG "Filtererhoehung vorm Fehlerspeichereintrag" VALUE 0x719B8 TKW_VV_VV_UB 100.0 FORMULA_0003 0.0 255.0 /end CHARACTERISTIC
/begin CHARACTERISTIC K_ED_VAN_DRUCK.KLASSENINDEX "Auswahl der Fehlerklasse" VALUE 0x719BC TKW_VV_VV_UB 100.0 FORMULA_0003 0.0 8.0 /end CHARACTERISTIC
/begin CHARACTERISTIC K_ED_VAN_DRUCK.OK_SCHWELLE "Filterschwelle fuer Fehleraustrag" VALUE 0x719B7 TKW_VV_VV_UB 100.0 FORMULA_0003 0.0 255.0 /end CHARACTERISTIC
/begin CHARACTERISTIC K_ED_VAN_DRUCK.P_CODE_OPENLOAD "P-Code fuer die Art OPENLOAD" VALUE 0x719B2 TKW_VV_VV_UW 100.0 FORMULA_0010 0.0 65535.0 /end CHARACTERISTIC
/begin CHARACTERISTIC K_ED_VAN_DRUCK.P_CODE_SH_TO_GND "P-Code fuer die Art SH_TO_GND" VALUE 0x719B0 TKW_VV_VV_UW 100.0 FORMULA_0010 0.0 65535.0 /end CHARACTERISTIC
/begin CHARACTERISTIC K_ED_VAN_DRUCK.P_CODE_SH_TO_UB "P-Code fuer die Art SH_TO_UB" VALUE 0x719AE TKW_VV_VV_UW 100.0 FORMULA_0010 0.0 65535.0 /end CHARACTERISTIC
/begin CHARACTERISTIC K_ED_VAN_DRUCK.P_CODE_UNPLAUSIBEL "P-Code fuer die Art UNPLAUSIBEL" VALUE 0x719B4 TKW_VV_VV_UW 100.0 FORMULA_0010 0.0 65535.0 /end CHARACTERISTIC
/begin CHARACTERISTIC K_ED_VAN_DSV.DEC_NACH_EINTRAG "Filterverringerung nach Fehlerspeichereintrag" VALUE 0x7155D TKW_VV_VV_UB 100.0 FORMULA_0003 0.0 255.0 /end CHARACTERISTIC
/begin CHARACTERISTIC K_ED_VAN_DSV.DEC_VOR_EINTRAG "Filterverringerung vorm Fehlerspeichereintrag" VALUE 0x7155B TKW_VV_VV_UB 100.0 FORMULA_0003 0.0 255.0 /end CHARACTERISTIC
/begin CHARACTERISTIC K_ED_VAN_DSV.FEHLERSCHWELLE "Filterschwelle fuer Fehlereintrag" VALUE 0x71558 TKW_VV_VV_UB 100.0 FORMULA_0003 0.0 255.0 /end CHARACTERISTIC
/begin CHARACTERISTIC K_ED_VAN_DSV.INC_NACH_EINTRAG "Filtererhoehung nach Fehlerspeichereintrag" VALUE 0x7155C TKW_VV_VV_UB 100.0 FORMULA_0003 0.0 255.0 /end CHARACTERISTIC
/begin CHARACTERISTIC K_ED_VAN_DSV.INC_VOR_EINTRAG "Filtererhoehung vorm Fehlerspeichereintrag" VALUE 0x7155A TKW_VV_VV_UB 100.0 FORMULA_0003 0.0 255.0 /end CHARACTERISTIC
/begin CHARACTERISTIC K_ED_VAN_DSV.KLASSENINDEX "Auswahl der Fehlerklasse" VALUE 0x7155E TKW_VV_VV_UB 100.0 FORMULA_0003 0.0 8.0 /end CHARACTERISTIC
/begin CHARACTERISTIC K_ED_VAN_DSV.OK_SCHWELLE "Filterschwelle fuer Fehleraustrag" VALUE 0x71559 TKW_VV_VV_UB 100.0 FORMULA_0003 0.0 255.0 /end CHARACTERISTIC
/begin CHARACTERISTIC K_ED_VAN_DSV.P_CODE_OPENLOAD "P-Code fuer die Art OPENLOAD" VALUE 0x71554 TKW_VV_VV_UW 100.0 FORMULA_0010 0.0 65535.0 /end CHARACTERISTIC
/begin CHARACTERISTIC K_ED_VAN_DSV.P_CODE_SH_TO_GND "P-Code fuer die Art SH_TO_GND" VALUE 0x71552 TKW_VV_VV_UW 100.0 FORMULA_0010 0.0 65535.0 /end CHARACTERISTIC
/begin CHARACTERISTIC K_ED_VAN_DSV.P_CODE_SH_TO_UB "P-Code fuer die Art SH_TO_UB" VALUE 0x71550 TKW_VV_VV_UW 100.0 FORMULA_0010 0.0 65535.0 /end CHARACTERISTIC
/begin CHARACTERISTIC K_ED_VAN_DSV.P_CODE_UNPLAUSIBEL "P-Code fuer die Art UNPLAUSIBEL" VALUE 0x71556 TKW_VV_VV_UW 100.0 FORMULA_0010 0.0 65535.0 /end CHARACTERISTIC
/begin CHARACTERISTIC K_ED_VAN_HALL_A1.DEC_NACH_EINTRAG "Filterverringerung nach Fehlerspeichereintrag" VALUE 0x70995 TKW_VV_VV_UB 100.0 FORMULA_0003 0.0 255.0 /end CHARACTERISTIC
/begin CHARACTERISTIC K_ED_VAN_HALL_A1.DEC_VOR_EINTRAG "Filterverringerung vorm Fehlerspeichereintrag" VALUE 0x70993 TKW_VV_VV_UB 100.0 FORMULA_0003 0.0 255.0 /end CHARACTERISTIC
/begin CHARACTERISTIC K_ED_VAN_HALL_A1.FEHLERSCHWELLE "Filterschwelle fuer Fehlereintrag" VALUE 0x70990 TKW_VV_VV_UB 100.0 FORMULA_0003 0.0 255.0 /end CHARACTERISTIC
/begin CHARACTERISTIC K_ED_VAN_HALL_A1.INC_NACH_EINTRAG "Filtererhoehung nach Fehlerspeichereintrag" VALUE 0x70994 TKW_VV_VV_UB 100.0 FORMULA_0003 0.0 255.0 /end CHARACTERISTIC
/begin CHARACTERISTIC K_ED_VAN_HALL_A1.INC_VOR_EINTRAG "Filtererhoehung vorm Fehlerspeichereintrag" VALUE 0x70992 TKW_VV_VV_UB 100.0 FORMULA_0003 0.0 255.0 /end CHARACTERISTIC
/begin CHARACTERISTIC K_ED_VAN_HALL_A1.KLASSENINDEX "Auswahl der Fehlerklasse" VALUE 0x70996 TKW_VV_VV_UB 100.0 FORMULA_0003 0.0 8.0 /end CHARACTERISTIC
/begin CHARACTERISTIC K_ED_VAN_HALL_A1.OK_SCHWELLE "Filterschwelle fuer Fehleraustrag" VALUE 0x70991 TKW_VV_VV_UB 100.0 FORMULA_0003 0.0 255.0 /end CHARACTERISTIC
/begin CHARACTERISTIC K_ED_VAN_HALL_A1.P_CODE_OPENLOAD "P-Code fuer die Art OPENLOAD" VALUE 0x7098C TKW_VV_VV_UW 100.0 FORMULA_0010 0.0 65535.0 /end CHARACTERISTIC
/begin CHARACTERISTIC K_ED_VAN_HALL_A1.P_CODE_SH_TO_GND "P-Code fuer die Art SH_TO_GND" VALUE 0x7098A TKW_VV_VV_UW 100.0 FORMULA_0010 0.0 65535.0 /end CHARACTERISTIC
/begin CHARACTERISTIC K_ED_VAN_HALL_A1.P_CODE_SH_TO_UB "P-Code fuer die Art SH_TO_UB" VALUE 0x70988 TKW_VV_VV_UW 100.0 FORMULA_0010 0.0 65535.0 /end CHARACTERISTIC
/begin CHARACTERISTIC K_ED_VAN_HALL_A1.P_CODE_UNPLAUSIBEL "P-Code fuer die Art UNPLAUSIBEL" VALUE 0x7098E TKW_VV_VV_UW 100.0 FORMULA_0010 0.0 65535.0 /end CHARACTERISTIC
/begin CHARACTERISTIC K_ED_VAN_HALL_A2.DEC_NACH_EINTRAG "Filterverringerung nach Fehlerspeichereintrag" VALUE 0x709C9 TKW_VV_VV_UB 100.0 FORMULA_0003 0.0 255.0 /end CHARACTERISTIC
/begin CHARACTERISTIC K_ED_VAN_HALL_A2.DEC_VOR_EINTRAG "Filterverringerung vorm Fehlerspeichereintrag" VALUE 0x709C7 TKW_VV_VV_UB 100.0 FORMULA_0003 0.0 255.0 /end CHARACTERISTIC
/begin CHARACTERISTIC K_ED_VAN_HALL_A2.FEHLERSCHWELLE "Filterschwelle fuer Fehlereintrag" VALUE 0x709C4 TKW_VV_VV_UB 100.0 FORMULA_0003 0.0 255.0 /end CHARACTERISTIC
/begin CHARACTERISTIC K_ED_VAN_HALL_A2.INC_NACH_EINTRAG "Filtererhoehung nach Fehlerspeichereintrag" VALUE 0x709C8 TKW_VV_VV_UB 100.0 FORMULA_0003 0.0 255.0 /end CHARACTERISTIC
/begin CHARACTERISTIC K_ED_VAN_HALL_A2.INC_VOR_EINTRAG "Filtererhoehung vorm Fehlerspeichereintrag" VALUE 0x709C6 TKW_VV_VV_UB 100.0 FORMULA_0003 0.0 255.0 /end CHARACTERISTIC
/begin CHARACTERISTIC K_ED_VAN_HALL_A2.KLASSENINDEX "Auswahl der Fehlerklasse" VALUE 0x709CA TKW_VV_VV_UB 100.0 FORMULA_0003 0.0 8.0 /end CHARACTERISTIC
/begin CHARACTERISTIC K_ED_VAN_HALL_A2.OK_SCHWELLE "Filterschwelle fuer Fehleraustrag" VALUE 0x709C5 TKW_VV_VV_UB 100.0 FORMULA_0003 0.0 255.0 /end CHARACTERISTIC
/begin CHARACTERISTIC K_ED_VAN_HALL_A2.P_CODE_OPENLOAD "P-Code fuer die Art OPENLOAD" VALUE 0x709C0 TKW_VV_VV_UW 100.0 FORMULA_0010 0.0 65535.0 /end CHARACTERISTIC
/begin CHARACTERISTIC K_ED_VAN_HALL_A2.P_CODE_SH_TO_GND "P-Code fuer die Art SH_TO_GND" VALUE 0x709BE TKW_VV_VV_UW 100.0 FORMULA_0010 0.0 65535.0 /end CHARACTERISTIC
/begin CHARACTERISTIC K_ED_VAN_HALL_A2.P_CODE_SH_TO_UB "P-Code fuer die Art SH_TO_UB" VALUE 0x709BC TKW_VV_VV_UW 100.0 FORMULA_0010 0.0 65535.0 /end CHARACTERISTIC
/begin CHARACTERISTIC K_ED_VAN_HALL_A2.P_CODE_UNPLAUSIBEL "P-Code fuer die Art UNPLAUSIBEL" VALUE 0x709C2 TKW_VV_VV_UW 100.0 FORMULA_0010 0.0 65535.0 /end CHARACTERISTIC
/begin CHARACTERISTIC K_ED_VAN_HALL_E1.DEC_NACH_EINTRAG "Filterverringerung nach Fehlerspeichereintrag" VALUE 0x7097B TKW_VV_VV_UB 100.0 FORMULA_0003 0.0 255.0 /end CHARACTERISTIC
/begin CHARACTERISTIC K_ED_VAN_HALL_E1.DEC_VOR_EINTRAG "Filterverringerung vorm Fehlerspeichereintrag" VALUE 0x70979 TKW_VV_VV_UB 100.0 FORMULA_0003 0.0 255.0 /end CHARACTERISTIC
/begin CHARACTERISTIC K_ED_VAN_HALL_E1.FEHLERSCHWELLE "Filterschwelle fuer Fehlereintrag" VALUE 0x70976 TKW_VV_VV_UB 100.0 FORMULA_0003 0.0 255.0 /end CHARACTERISTIC
/begin CHARACTERISTIC K_ED_VAN_HALL_E1.INC_NACH_EINTRAG "Filtererhoehung nach Fehlerspeichereintrag" VALUE 0x7097A TKW_VV_VV_UB 100.0 FORMULA_0003 0.0 255.0 /end CHARACTERISTIC
/begin CHARACTERISTIC K_ED_VAN_HALL_E1.INC_VOR_EINTRAG "Filtererhoehung vorm Fehlerspeichereintrag" VALUE 0x70978 TKW_VV_VV_UB 100.0 FORMULA_0003 0.0 255.0 /end CHARACTERISTIC
/begin CHARACTERISTIC K_ED_VAN_HALL_E1.KLASSENINDEX "Auswahl der Fehlerklasse" VALUE 0x7097C TKW_VV_VV_UB 100.0 FORMULA_0003 0.0 8.0 /end CHARACTERISTIC
/begin CHARACTERISTIC K_ED_VAN_HALL_E1.OK_SCHWELLE "Filterschwelle fuer Fehleraustrag" VALUE 0x70977 TKW_VV_VV_UB 100.0 FORMULA_0003 0.0 255.0 /end CHARACTERISTIC
/begin CHARACTERISTIC K_ED_VAN_HALL_E1.P_CODE_OPENLOAD "P-Code fuer die Art OPENLOAD" VALUE 0x70972 TKW_VV_VV_UW 100.0 FORMULA_0010 0.0 65535.0 /end CHARACTERISTIC
/begin CHARACTERISTIC K_ED_VAN_HALL_E1.P_CODE_SH_TO_GND "P-Code fuer die Art SH_TO_GND" VALUE 0x70970 TKW_VV_VV_UW 100.0 FORMULA_0010 0.0 65535.0 /end CHARACTERISTIC
/begin CHARACTERISTIC K_ED_VAN_HALL_E1.P_CODE_SH_TO_UB "P-Code fuer die Art SH_TO_UB" VALUE 0x7096E TKW_VV_VV_UW 100.0 FORMULA_0010 0.0 65535.0 /end CHARACTERISTIC
/begin CHARACTERISTIC K_ED_VAN_HALL_E1.P_CODE_UNPLAUSIBEL "P-Code fuer die Art UNPLAUSIBEL" VALUE 0x70974 TKW_VV_VV_UW 100.0 FORMULA_0010 0.0 65535.0 /end CHARACTERISTIC
/begin CHARACTERISTIC K_ED_VAN_HALL_E2.DEC_NACH_EINTRAG "Filterverringerung nach Fehlerspeichereintrag" VALUE 0x709AF TKW_VV_VV_UB 100.0 FORMULA_0003 0.0 255.0 /end CHARACTERISTIC
/begin CHARACTERISTIC K_ED_VAN_HALL_E2.DEC_VOR_EINTRAG "Filterverringerung vorm Fehlerspeichereintrag" VALUE 0x709AD TKW_VV_VV_UB 100.0 FORMULA_0003 0.0 255.0 /end CHARACTERISTIC
/begin CHARACTERISTIC K_ED_VAN_HALL_E2.FEHLERSCHWELLE "Filterschwelle fuer Fehlereintrag" VALUE 0x709AA TKW_VV_VV_UB 100.0 FORMULA_0003 0.0 255.0 /end CHARACTERISTIC
/begin CHARACTERISTIC K_ED_VAN_HALL_E2.INC_NACH_EINTRAG "Filtererhoehung nach Fehlerspeichereintrag" VALUE 0x709AE TKW_VV_VV_UB 100.0 FORMULA_0003 0.0 255.0 /end CHARACTERISTIC
/begin CHARACTERISTIC K_ED_VAN_HALL_E2.INC_VOR_EINTRAG "Filtererhoehung vorm Fehlerspeichereintrag" VALUE 0x709AC TKW_VV_VV_UB 100.0 FORMULA_0003 0.0 255.0 /end CHARACTERISTIC
/begin CHARACTERISTIC K_ED_VAN_HALL_E2.KLASSENINDEX "Auswahl der Fehlerklasse" VALUE 0x709B0 TKW_VV_VV_UB 100.0 FORMULA_0003 0.0 8.0 /end CHARACTERISTIC
/begin CHARACTERISTIC K_ED_VAN_HALL_E2.OK_SCHWELLE "Filterschwelle fuer Fehleraustrag" VALUE 0x709AB TKW_VV_VV_UB 100.0 FORMULA_0003 0.0 255.0 /end CHARACTERISTIC
/begin CHARACTERISTIC K_ED_VAN_HALL_E2.P_CODE_OPENLOAD "P-Code fuer die Art OPENLOAD" VALUE 0x709A6 TKW_VV_VV_UW 100.0 FORMULA_0010 0.0 65535.0 /end CHARACTERISTIC
/begin CHARACTERISTIC K_ED_VAN_HALL_E2.P_CODE_SH_TO_GND "P-Code fuer die Art SH_TO_GND" VALUE 0x709A4 TKW_VV_VV_UW 100.0 FORMULA_0010 0.0 65535.0 /end CHARACTERISTIC
/begin CHARACTERISTIC K_ED_VAN_HALL_E2.P_CODE_SH_TO_UB "P-Code fuer die Art SH_TO_UB" VALUE 0x709A2 TKW_VV_VV_UW 100.0 FORMULA_0010 0.0 65535.0 /end CHARACTERISTIC
/begin CHARACTERISTIC K_ED_VAN_HALL_E2.P_CODE_UNPLAUSIBEL "P-Code fuer die Art UNPLAUSIBEL" VALUE 0x709A8 TKW_VV_VV_UW 100.0 FORMULA_0010 0.0 65535.0 /end CHARACTERISTIC
/begin CHARACTERISTIC K_ED_VAN_REGL_A1.DEC_NACH_EINTRAG "Filterverringerung nach Fehlerspeichereintrag" VALUE 0x709FD TKW_VV_VV_UB 100.0 FORMULA_0003 0.0 255.0 /end CHARACTERISTIC
/begin CHARACTERISTIC K_ED_VAN_REGL_A1.DEC_VOR_EINTRAG "Filterverringerung vorm Fehlerspeichereintrag" VALUE 0x709FB TKW_VV_VV_UB 100.0 FORMULA_0003 0.0 255.0 /end CHARACTERISTIC
/begin CHARACTERISTIC K_ED_VAN_REGL_A1.FEHLERSCHWELLE "Filterschwelle fuer Fehlereintrag" VALUE 0x709F8 TKW_VV_VV_UB 100.0 FORMULA_0003 0.0 255.0 /end CHARACTERISTIC
/begin CHARACTERISTIC K_ED_VAN_REGL_A1.INC_NACH_EINTRAG "Filtererhoehung nach Fehlerspeichereintrag" VALUE 0x709FC TKW_VV_VV_UB 100.0 FORMULA_0003 0.0 255.0 /end CHARACTERISTIC
/begin CHARACTERISTIC K_ED_VAN_REGL_A1.INC_VOR_EINTRAG "Filtererhoehung vorm Fehlerspeichereintrag" VALUE 0x709FA TKW_VV_VV_UB 100.0 FORMULA_0003 0.0 255.0 /end CHARACTERISTIC
/begin CHARACTERISTIC K_ED_VAN_REGL_A1.KLASSENINDEX "Auswahl der Fehlerklasse" VALUE 0x709FE TKW_VV_VV_UB 100.0 FORMULA_0003 0.0 8.0 /end CHARACTERISTIC
/begin CHARACTERISTIC K_ED_VAN_REGL_A1.OK_SCHWELLE "Filterschwelle fuer Fehleraustrag" VALUE 0x709F9 TKW_VV_VV_UB 100.0 FORMULA_0003 0.0 255.0 /end CHARACTERISTIC
/begin CHARACTERISTIC K_ED_VAN_REGL_A1.P_CODE_OPENLOAD "P-Code fuer die Art OPENLOAD" VALUE 0x709F4 TKW_VV_VV_UW 100.0 FORMULA_0010 0.0 65535.0 /end CHARACTERISTIC
/begin CHARACTERISTIC K_ED_VAN_REGL_A1.P_CODE_SH_TO_GND "P-Code fuer die Art SH_TO_GND" VALUE 0x709F2 TKW_VV_VV_UW 100.0 FORMULA_0010 0.0 65535.0 /end CHARACTERISTIC
/begin CHARACTERISTIC K_ED_VAN_REGL_A1.P_CODE_SH_TO_UB "P-Code fuer die Art SH_TO_UB" VALUE 0x709F0 TKW_VV_VV_UW 100.0 FORMULA_0010 0.0 65535.0 /end CHARACTERISTIC
/begin CHARACTERISTIC K_ED_VAN_REGL_A1.P_CODE_UNPLAUSIBEL "P-Code fuer die Art UNPLAUSIBEL" VALUE 0x709F6 TKW_VV_VV_UW 100.0 FORMULA_0010 0.0 65535.0 /end CHARACTERISTIC
/begin CHARACTERISTIC K_ED_VAN_REGL_A2.DEC_NACH_EINTRAG "Filterverringerung nach Fehlerspeichereintrag" VALUE 0x70A31 TKW_VV_VV_UB 100.0 FORMULA_0003 0.0 255.0 /end CHARACTERISTIC
/begin CHARACTERISTIC K_ED_VAN_REGL_A2.DEC_VOR_EINTRAG "Filterverringerung vorm Fehlerspeichereintrag" VALUE 0x70A2F TKW_VV_VV_UB 100.0 FORMULA_0003 0.0 255.0 /end CHARACTERISTIC
/begin CHARACTERISTIC K_ED_VAN_REGL_A2.FEHLERSCHWELLE "Filterschwelle fuer Fehlereintrag" VALUE 0x70A2C TKW_VV_VV_UB 100.0 FORMULA_0003 0.0 255.0 /end CHARACTERISTIC
/begin CHARACTERISTIC K_ED_VAN_REGL_A2.INC_NACH_EINTRAG "Filtererhoehung nach Fehlerspeichereintrag" VALUE 0x70A30 TKW_VV_VV_UB 100.0 FORMULA_0003 0.0 255.0 /end CHARACTERISTIC
/begin CHARACTERISTIC K_ED_VAN_REGL_A2.INC_VOR_EINTRAG "Filtererhoehung vorm Fehlerspeichereintrag" VALUE 0x70A2E TKW_VV_VV_UB 100.0 FORMULA_0003 0.0 255.0 /end CHARACTERISTIC
/begin CHARACTERISTIC K_ED_VAN_REGL_A2.KLASSENINDEX "Auswahl der Fehlerklasse" VALUE 0x70A32 TKW_VV_VV_UB 100.0 FORMULA_0003 0.0 8.0 /end CHARACTERISTIC
/begin CHARACTERISTIC K_ED_VAN_REGL_A2.OK_SCHWELLE "Filterschwelle fuer Fehleraustrag" VALUE 0x70A2D TKW_VV_VV_UB 100.0 FORMULA_0003 0.0 255.0 /end CHARACTERISTIC
/begin CHARACTERISTIC K_ED_VAN_REGL_A2.P_CODE_OPENLOAD "P-Code fuer die Art OPENLOAD" VALUE 0x70A28 TKW_VV_VV_UW 100.0 FORMULA_0010 0.0 65535.0 /end CHARACTERISTIC
/begin CHARACTERISTIC K_ED_VAN_REGL_A2.P_CODE_SH_TO_GND "P-Code fuer die Art SH_TO_GND" VALUE 0x70A26 TKW_VV_VV_UW 100.0 FORMULA_0010 0.0 65535.0 /end CHARACTERISTIC
/begin CHARACTERISTIC K_ED_VAN_REGL_A2.P_CODE_SH_TO_UB "P-Code fuer die Art SH_TO_UB" VALUE 0x70A24 TKW_VV_VV_UW 100.0 FORMULA_0010 0.0 65535.0 /end CHARACTERISTIC
/begin CHARACTERISTIC K_ED_VAN_REGL_A2.P_CODE_UNPLAUSIBEL "P-Code fuer die Art UNPLAUSIBEL" VALUE 0x70A2A TKW_VV_VV_UW 100.0 FORMULA_0010 0.0 65535.0 /end CHARACTERISTIC
/begin CHARACTERISTIC K_ED_VAN_REGL_E1.DEC_NACH_EINTRAG "Filterverringerung nach Fehlerspeichereintrag" VALUE 0x709E3 TKW_VV_VV_UB 100.0 FORMULA_0003 0.0 255.0 /end CHARACTERISTIC
/begin CHARACTERISTIC K_ED_VAN_REGL_E1.DEC_VOR_EINTRAG "Filterverringerung vorm Fehlerspeichereintrag" VALUE 0x709E1 TKW_VV_VV_UB 100.0 FORMULA_0003 0.0 255.0 /end CHARACTERISTIC
/begin CHARACTERISTIC K_ED_VAN_REGL_E1.FEHLERSCHWELLE "Filterschwelle fuer Fehlereintrag" VALUE 0x709DE TKW_VV_VV_UB 100.0 FORMULA_0003 0.0 255.0 /end CHARACTERISTIC
/begin CHARACTERISTIC K_ED_VAN_REGL_E1.INC_NACH_EINTRAG "Filtererhoehung nach Fehlerspeichereintrag" VALUE 0x709E2 TKW_VV_VV_UB 100.0 FORMULA_0003 0.0 255.0 /end CHARACTERISTIC
/begin CHARACTERISTIC K_ED_VAN_REGL_E1.INC_VOR_EINTRAG "Filtererhoehung vorm Fehlerspeichereintrag" VALUE 0x709E0 TKW_VV_VV_UB 100.0 FORMULA_0003 0.0 255.0 /end CHARACTERISTIC
/begin CHARACTERISTIC K_ED_VAN_REGL_E1.KLASSENINDEX "Auswahl der Fehlerklasse" VALUE 0x709E4 TKW_VV_VV_UB 100.0 FORMULA_0003 0.0 8.0 /end CHARACTERISTIC
/begin CHARACTERISTIC K_ED_VAN_REGL_E1.OK_SCHWELLE "Filterschwelle fuer Fehleraustrag" VALUE 0x709DF TKW_VV_VV_UB 100.0 FORMULA_0003 0.0 255.0 /end CHARACTERISTIC
/begin CHARACTERISTIC K_ED_VAN_REGL_E1.P_CODE_OPENLOAD "P-Code fuer die Art OPENLOAD" VALUE 0x709DA TKW_VV_VV_UW 100.0 FORMULA_0010 0.0 65535.0 /end CHARACTERISTIC
/begin CHARACTERISTIC K_ED_VAN_REGL_E1.P_CODE_SH_TO_GND "P-Code fuer die Art SH_TO_GND" VALUE 0x709D8 TKW_VV_VV_UW 100.0 FORMULA_0010 0.0 65535.0 /end CHARACTERISTIC
/begin CHARACTERISTIC K_ED_VAN_REGL_E1.P_CODE_SH_TO_UB "P-Code fuer die Art SH_TO_UB" VALUE 0x709D6 TKW_VV_VV_UW 100.0 FORMULA_0010 0.0 65535.0 /end CHARACTERISTIC
/begin CHARACTERISTIC K_ED_VAN_REGL_E1.P_CODE_UNPLAUSIBEL "P-Code fuer die Art UNPLAUSIBEL" VALUE 0x709DC TKW_VV_VV_UW 100.0 FORMULA_0010 0.0 65535.0 /end CHARACTERISTIC
/begin CHARACTERISTIC K_ED_VAN_REGL_E2.DEC_NACH_EINTRAG "Filterverringerung nach Fehlerspeichereintrag" VALUE 0x70A17 TKW_VV_VV_UB 100.0 FORMULA_0003 0.0 255.0 /end CHARACTERISTIC
/begin CHARACTERISTIC K_ED_VAN_REGL_E2.DEC_VOR_EINTRAG "Filterverringerung vorm Fehlerspeichereintrag" VALUE 0x70A15 TKW_VV_VV_UB 100.0 FORMULA_0003 0.0 255.0 /end CHARACTERISTIC
/begin CHARACTERISTIC K_ED_VAN_REGL_E2.FEHLERSCHWELLE "Filterschwelle fuer Fehlereintrag" VALUE 0x70A12 TKW_VV_VV_UB 100.0 FORMULA_0003 0.0 255.0 /end CHARACTERISTIC
/begin CHARACTERISTIC K_ED_VAN_REGL_E2.INC_NACH_EINTRAG "Filtererhoehung nach Fehlerspeichereintrag" VALUE 0x70A16 TKW_VV_VV_UB 100.0 FORMULA_0003 0.0 255.0 /end CHARACTERISTIC
/begin CHARACTERISTIC K_ED_VAN_REGL_E2.INC_VOR_EINTRAG "Filtererhoehung vorm Fehlerspeichereintrag" VALUE 0x70A14 TKW_VV_VV_UB 100.0 FORMULA_0003 0.0 255.0 /end CHARACTERISTIC
/begin CHARACTERISTIC K_ED_VAN_REGL_E2.KLASSENINDEX "Auswahl der Fehlerklasse" VALUE 0x70A18 TKW_VV_VV_UB 100.0 FORMULA_0003 0.0 8.0 /end CHARACTERISTIC
/begin CHARACTERISTIC K_ED_VAN_REGL_E2.OK_SCHWELLE "Filterschwelle fuer Fehleraustrag" VALUE 0x70A13 TKW_VV_VV_UB 100.0 FORMULA_0003 0.0 255.0 /end CHARACTERISTIC
/begin CHARACTERISTIC K_ED_VAN_REGL_E2.P_CODE_OPENLOAD "P-Code fuer die Art OPENLOAD" VALUE 0x70A0E TKW_VV_VV_UW 100.0 FORMULA_0010 0.0 65535.0 /end CHARACTERISTIC
/begin CHARACTERISTIC K_ED_VAN_REGL_E2.P_CODE_SH_TO_GND "P-Code fuer die Art SH_TO_GND" VALUE 0x70A0C TKW_VV_VV_UW 100.0 FORMULA_0010 0.0 65535.0 /end CHARACTERISTIC
/begin CHARACTERISTIC K_ED_VAN_REGL_E2.P_CODE_SH_TO_UB "P-Code fuer die Art SH_TO_UB" VALUE 0x70A0A TKW_VV_VV_UW 100.0 FORMULA_0010 0.0 65535.0 /end CHARACTERISTIC
/begin CHARACTERISTIC K_ED_VAN_REGL_E2.P_CODE_UNPLAUSIBEL "P-Code fuer die Art UNPLAUSIBEL" VALUE 0x70A10 TKW_VV_VV_UW 100.0 FORMULA_0010 0.0 65535.0 /end CHARACTERISTIC
/begin CHARACTERISTIC K_ED_VAN_VENT_A1.DEC_NACH_EINTRAG "Filterverringerung nach Fehlerspeichereintrag" VALUE 0x71167 TKW_VV_VV_UB 100.0 FORMULA_0003 0.0 255.0 /end CHARACTERISTIC
/begin CHARACTERISTIC K_ED_VAN_VENT_A1.DEC_VOR_EINTRAG "Filterverringerung vorm Fehlerspeichereintrag" VALUE 0x71165 TKW_VV_VV_UB 100.0 FORMULA_0003 0.0 255.0 /end CHARACTERISTIC
/begin CHARACTERISTIC K_ED_VAN_VENT_A1.FEHLERSCHWELLE "Filterschwelle fuer Fehlereintrag" VALUE 0x71162 TKW_VV_VV_UB 100.0 FORMULA_0003 0.0 255.0 /end CHARACTERISTIC
/begin CHARACTERISTIC K_ED_VAN_VENT_A1.INC_NACH_EINTRAG "Filtererhoehung nach Fehlerspeichereintrag" VALUE 0x71166 TKW_VV_VV_UB 100.0 FORMULA_0003 0.0 255.0 /end CHARACTERISTIC
/begin CHARACTERISTIC K_ED_VAN_VENT_A1.INC_VOR_EINTRAG "Filtererhoehung vorm Fehlerspeichereintrag" VALUE 0x71164 TKW_VV_VV_UB 100.0 FORMULA_0003 0.0 255.0 /end CHARACTERISTIC
/begin CHARACTERISTIC K_ED_VAN_VENT_A1.KLASSENINDEX "Auswahl der Fehlerklasse" VALUE 0x71168 TKW_VV_VV_UB 100.0 FORMULA_0003 0.0 8.0 /end CHARACTERISTIC
/begin CHARACTERISTIC K_ED_VAN_VENT_A1.OK_SCHWELLE "Filterschwelle fuer Fehleraustrag" VALUE 0x71163 TKW_VV_VV_UB 100.0 FORMULA_0003 0.0 255.0 /end CHARACTERISTIC
/begin CHARACTERISTIC K_ED_VAN_VENT_A1.P_CODE_OPENLOAD "P-Code fuer die Art OPENLOAD" VALUE 0x7115E TKW_VV_VV_UW 100.0 FORMULA_0010 0.0 65535.0 /end CHARACTERISTIC
/begin CHARACTERISTIC K_ED_VAN_VENT_A1.P_CODE_SH_TO_GND "P-Code fuer die Art SH_TO_GND" VALUE 0x7115C TKW_VV_VV_UW 100.0 FORMULA_0010 0.0 65535.0 /end CHARACTERISTIC
/begin CHARACTERISTIC K_ED_VAN_VENT_A1.P_CODE_SH_TO_UB "P-Code fuer die Art SH_TO_UB" VALUE 0x7115A TKW_VV_VV_UW 100.0 FORMULA_0010 0.0 65535.0 /end CHARACTERISTIC
/begin CHARACTERISTIC K_ED_VAN_VENT_A1.P_CODE_UNPLAUSIBEL "P-Code fuer die Art UNPLAUSIBEL" VALUE 0x71160 TKW_VV_VV_UW 100.0 FORMULA_0010 0.0 65535.0 /end CHARACTERISTIC
/begin CHARACTERISTIC K_ED_VAN_VENT_A2.DEC_NACH_EINTRAG "Filterverringerung nach Fehlerspeichereintrag" VALUE 0x7119B TKW_VV_VV_UB 100.0 FORMULA_0003 0.0 255.0 /end CHARACTERISTIC
/begin CHARACTERISTIC K_ED_VAN_VENT_A2.DEC_VOR_EINTRAG "Filterverringerung vorm Fehlerspeichereintrag" VALUE 0x71199 TKW_VV_VV_UB 100.0 FORMULA_0003 0.0 255.0 /end CHARACTERISTIC
/begin CHARACTERISTIC K_ED_VAN_VENT_A2.FEHLERSCHWELLE "Filterschwelle fuer Fehlereintrag" VALUE 0x71196 TKW_VV_VV_UB 100.0 FORMULA_0003 0.0 255.0 /end CHARACTERISTIC
/begin CHARACTERISTIC K_ED_VAN_VENT_A2.INC_NACH_EINTRAG "Filtererhoehung nach Fehlerspeichereintrag" VALUE 0x7119A TKW_VV_VV_UB 100.0 FORMULA_0003 0.0 255.0 /end CHARACTERISTIC
/begin CHARACTERISTIC K_ED_VAN_VENT_A2.INC_VOR_EINTRAG "Filtererhoehung vorm Fehlerspeichereintrag" VALUE 0x71198 TKW_VV_VV_UB 100.0 FORMULA_0003 0.0 255.0 /end CHARACTERISTIC
/begin CHARACTERISTIC K_ED_VAN_VENT_A2.KLASSENINDEX "Auswahl der Fehlerklasse" VALUE 0x7119C TKW_VV_VV_UB 100.0 FORMULA_0003 0.0 8.0 /end CHARACTERISTIC
/begin CHARACTERISTIC K_ED_VAN_VENT_A2.OK_SCHWELLE "Filterschwelle fuer Fehleraustrag" VALUE 0x71197 TKW_VV_VV_UB 100.0 FORMULA_0003 0.0 255.0 /end CHARACTERISTIC
/begin CHARACTERISTIC K_ED_VAN_VENT_A2.P_CODE_OPENLOAD "P-Code fuer die Art OPENLOAD" VALUE 0x71192 TKW_VV_VV_UW 100.0 FORMULA_0010 0.0 65535.0 /end CHARACTERISTIC
/begin CHARACTERISTIC K_ED_VAN_VENT_A2.P_CODE_SH_TO_GND "P-Code fuer die Art SH_TO_GND" VALUE 0x71190 TKW_VV_VV_UW 100.0 FORMULA_0010 0.0 65535.0 /end CHARACTERISTIC
/begin CHARACTERISTIC K_ED_VAN_VENT_A2.P_CODE_SH_TO_UB "P-Code fuer die Art SH_TO_UB" VALUE 0x7118E TKW_VV_VV_UW 100.0 FORMULA_0010 0.0 65535.0 /end CHARACTERISTIC
/begin CHARACTERISTIC K_ED_VAN_VENT_A2.P_CODE_UNPLAUSIBEL "P-Code fuer die Art UNPLAUSIBEL" VALUE 0x71194 TKW_VV_VV_UW 100.0 FORMULA_0010 0.0 65535.0 /end CHARACTERISTIC
/begin CHARACTERISTIC K_ED_VAN_VENT_E1.DEC_NACH_EINTRAG "Filterverringerung nach Fehlerspeichereintrag" VALUE 0x7114D TKW_VV_VV_UB 100.0 FORMULA_0003 0.0 255.0 /end CHARACTERISTIC
/begin CHARACTERISTIC K_ED_VAN_VENT_E1.DEC_VOR_EINTRAG "Filterverringerung vorm Fehlerspeichereintrag" VALUE 0x7114B TKW_VV_VV_UB 100.0 FORMULA_0003 0.0 255.0 /end CHARACTERISTIC
/begin CHARACTERISTIC K_ED_VAN_VENT_E1.FEHLERSCHWELLE "Filterschwelle fuer Fehlereintrag" VALUE 0x71148 TKW_VV_VV_UB 100.0 FORMULA_0003 0.0 255.0 /end CHARACTERISTIC
/begin CHARACTERISTIC K_ED_VAN_VENT_E1.INC_NACH_EINTRAG "Filtererhoehung nach Fehlerspeichereintrag" VALUE 0x7114C TKW_VV_VV_UB 100.0 FORMULA_0003 0.0 255.0 /end CHARACTERISTIC
/begin CHARACTERISTIC K_ED_VAN_VENT_E1.INC_VOR_EINTRAG "Filtererhoehung vorm Fehlerspeichereintrag" VALUE 0x7114A TKW_VV_VV_UB 100.0 FORMULA_0003 0.0 255.0 /end CHARACTERISTIC
/begin CHARACTERISTIC K_ED_VAN_VENT_E1.KLASSENINDEX "Auswahl der Fehlerklasse" VALUE 0x7114E TKW_VV_VV_UB 100.0 FORMULA_0003 0.0 8.0 /end CHARACTERISTIC
/begin CHARACTERISTIC K_ED_VAN_VENT_E1.OK_SCHWELLE "Filterschwelle fuer Fehleraustrag" VALUE 0x71149 TKW_VV_VV_UB 100.0 FORMULA_0003 0.0 255.0 /end CHARACTERISTIC
/begin CHARACTERISTIC K_ED_VAN_VENT_E1.P_CODE_OPENLOAD "P-Code fuer die Art OPENLOAD" VALUE 0x71144 TKW_VV_VV_UW 100.0 FORMULA_0010 0.0 65535.0 /end CHARACTERISTIC
/begin CHARACTERISTIC K_ED_VAN_VENT_E1.P_CODE_SH_TO_GND "P-Code fuer die Art SH_TO_GND" VALUE 0x71142 TKW_VV_VV_UW 100.0 FORMULA_0010 0.0 65535.0 /end CHARACTERISTIC
/begin CHARACTERISTIC K_ED_VAN_VENT_E1.P_CODE_SH_TO_UB "P-Code fuer die Art SH_TO_UB" VALUE 0x71140 TKW_VV_VV_UW 100.0 FORMULA_0010 0.0 65535.0 /end CHARACTERISTIC
/begin CHARACTERISTIC K_ED_VAN_VENT_E1.P_CODE_UNPLAUSIBEL "P-Code fuer die Art UNPLAUSIBEL" VALUE 0x71146 TKW_VV_VV_UW 100.0 FORMULA_0010 0.0 65535.0 /end CHARACTERISTIC
/begin CHARACTERISTIC K_ED_VAN_VENT_E2.DEC_NACH_EINTRAG "Filterverringerung nach Fehlerspeichereintrag" VALUE 0x71181 TKW_VV_VV_UB 100.0 FORMULA_0003 0.0 255.0 /end CHARACTERISTIC
/begin CHARACTERISTIC K_ED_VAN_VENT_E2.DEC_VOR_EINTRAG "Filterverringerung vorm Fehlerspeichereintrag" VALUE 0x7117F TKW_VV_VV_UB 100.0 FORMULA_0003 0.0 255.0 /end CHARACTERISTIC
/begin CHARACTERISTIC K_ED_VAN_VENT_E2.FEHLERSCHWELLE "Filterschwelle fuer Fehlereintrag" VALUE 0x7117C TKW_VV_VV_UB 100.0 FORMULA_0003 0.0 255.0 /end CHARACTERISTIC
/begin CHARACTERISTIC K_ED_VAN_VENT_E2.INC_NACH_EINTRAG "Filtererhoehung nach Fehlerspeichereintrag" VALUE 0x71180 TKW_VV_VV_UB 100.0 FORMULA_0003 0.0 255.0 /end CHARACTERISTIC
/begin CHARACTERISTIC K_ED_VAN_VENT_E2.INC_VOR_EINTRAG "Filtererhoehung vorm Fehlerspeichereintrag" VALUE 0x7117E TKW_VV_VV_UB 100.0 FORMULA_0003 0.0 255.0 /end CHARACTERISTIC
/begin CHARACTERISTIC K_ED_VAN_VENT_E2.KLASSENINDEX "Auswahl der Fehlerklasse" VALUE 0x71182 TKW_VV_VV_UB 100.0 FORMULA_0003 0.0 8.0 /end CHARACTERISTIC
/begin CHARACTERISTIC K_ED_VAN_VENT_E2.OK_SCHWELLE "Filterschwelle fuer Fehleraustrag" VALUE 0x7117D TKW_VV_VV_UB 100.0 FORMULA_0003 0.0 255.0 /end CHARACTERISTIC
/begin CHARACTERISTIC K_ED_VAN_VENT_E2.P_CODE_OPENLOAD "P-Code fuer die Art OPENLOAD" VALUE 0x71178 TKW_VV_VV_UW 100.0 FORMULA_0010 0.0 65535.0 /end CHARACTERISTIC
/begin CHARACTERISTIC K_ED_VAN_VENT_E2.P_CODE_SH_TO_GND "P-Code fuer die Art SH_TO_GND" VALUE 0x71176 TKW_VV_VV_UW 100.0 FORMULA_0010 0.0 65535.0 /end CHARACTERISTIC
/begin CHARACTERISTIC K_ED_VAN_VENT_E2.P_CODE_SH_TO_UB "P-Code fuer die Art SH_TO_UB" VALUE 0x71174 TKW_VV_VV_UW 100.0 FORMULA_0010 0.0 65535.0 /end CHARACTERISTIC
/begin CHARACTERISTIC K_ED_VAN_VENT_E2.P_CODE_UNPLAUSIBEL "P-Code fuer die Art UNPLAUSIBEL" VALUE 0x7117A TKW_VV_VV_UW 100.0 FORMULA_0010 0.0 65535.0 /end CHARACTERISTIC
/begin CHARACTERISTIC K_ED_WUC_DELTA_TMOT "Min. Temperaturerhoehung fuer Warmupcycle" VALUE 0x71F9C TKW_VV_VV_SW 100.0 FORMULA_0074 -1000.0 1000.0 FORMAT "%4.1" /end CHARACTERISTIC
/begin CHARACTERISTIC K_ED_WUC_TMOT_MIN "Min. Temperatur fuer Warmupcycle" VALUE 0x71F9A TKW_VV_VV_SW 100.0 FORMULA_0023 -50.0 170.0 FORMAT "%4.1" /end CHARACTERISTIC
/begin CHARACTERISTIC K_ELU_ED_BLOCKIER_ZYKLUS_TIME "Zeitdauer bis zur naechsten erwarteten ELU-Fehlermeldung" VALUE 0x72014 TKW_VV_VV_UW 100.0 FORMULA_0668 25000.0 35000.0 /end CHARACTERISTIC
/begin CHARACTERISTIC K_ELU_ED_BLOCKIERT_CNT "Counter zur zusaetzlichen Entprellung von ELU_BLOCKIERT" VALUE 0x72016 TKW_VV_VV_UB 100.0 FORMULA_0003 0.0 255.0 /end CHARACTERISTIC
/begin CHARACTERISTIC K_ELU_ED_BLOCKIERT_MAX "max. Zeitdauer fuer die Erkennung der ELU-Fehlermeldung" VALUE 0x72010 TKW_VV_VV_UW 100.0 FORMULA_0668 4700.0 7300.0 /end CHARACTERISTIC
/begin CHARACTERISTIC K_ELU_ED_BLOCKIERT_MIN "min. Zeitdauer fuer die Erkennung der ELU-Fehlermeldung" VALUE 0x72012 TKW_VV_VV_UW 100.0 FORMULA_0668 4700.0 7300.0 /end CHARACTERISTIC
/begin CHARACTERISTIC K_ELU_ED_OPENLOAD_CNT "Counter zur zusaetzlichen Entprellung von OPENLOAD" VALUE 0x72018 TKW_VV_VV_UB 100.0 FORMULA_0003 0.0 255.0 /end CHARACTERISTIC
/begin CHARACTERISTIC K_ELU_ED_SH_TO_GND_CNT "Counter zur zusaetzlichen Entprellung von SH_TO_GND" VALUE 0x72017 TKW_VV_VV_UB 100.0 FORMULA_0003 0.0 255.0 /end CHARACTERISTIC
/begin CHARACTERISTIC K_ELU_ED_SH_TO_UB_DELAY "Delay fuer Entprellung von SH_TO_UB" VALUE 0x7200C TKW_VV_VV_UW 100.0 FORMULA_0668 0.0 3000.0 /end CHARACTERISTIC
/begin CHARACTERISTIC K_ELU_ED_SH_TO_UB_OFF_TIME "Abschaltzeit der ATIC39-Endstufe bei SH_TO_UB" VALUE 0x7200E TKW_VV_VV_UW 100.0 FORMULA_0668 5000.0 20000.0 /end CHARACTERISTIC
/begin CHARACTERISTIC K_ELU_HYS_SCHLEPP "Hysterese Schleppzeiger" VALUE 0x71FEF TKW_VV_VV_UB 100.0 FORMULA_0032 0.0 100.0 /end CHARACTERISTIC
/begin CHARACTERISTIC K_ELU_IDENT_CYCLE_CNT_BEGR "Begrenzung der durchlaufenen ELU-Identifikationszyklen" VALUE 0x72002 TKW_VV_VV_UB 100.0 FORMULA_0003 0.0 255.0 /end CHARACTERISTIC
/begin CHARACTERISTIC K_ELU_IDENT_CYCLE_TIME_BEGR "Begrenzung der ELU-Identifikationszykluszeit" VALUE 0x72000 TKW_VV_VV_UW 100.0 FORMULA_0668 0.0 30000.0 /end CHARACTERISTIC
/begin CHARACTERISTIC K_ELU_IDENT_RESP_600W_MAX "obere Grenze Antwortzeit BMW-600W-ELU" VALUE 0x72006 TKW_VV_VV_UW 100.0 FORMULA_0668 1200.0 2300.0 /end CHARACTERISTIC
/begin CHARACTERISTIC K_ELU_IDENT_RESP_600W_MIN "untere Grenze Antwortzeit BMW-600W-ELU" VALUE 0x72004 TKW_VV_VV_UW 100.0 FORMULA_0668 1200.0 2300.0 /end CHARACTERISTIC
/begin CHARACTERISTIC K_ELU_IDENT_RESP_850W_MAX "obere Grenze Antwortzeit BMW-850W-ELU" VALUE 0x7200A TKW_VV_VV_UW 100.0 FORMULA_0668 2200.0 3300.0 /end CHARACTERISTIC
/begin CHARACTERISTIC K_ELU_IDENT_RESP_850W_MIN "untere Grenze Antwortzeit BMW-850W-ELU" VALUE 0x72008 TKW_VV_VV_UW 100.0 FORMULA_0668 2200.0 3300.0 /end CHARACTERISTIC
/begin CHARACTERISTIC K_ELU_PWM_AUS "Tastverhaeltnis bei ausgeschaltenem Luefter" VALUE 0x71FF5 TKW_VV_VV_UB 100.0 FORMULA_0032 5.0 9.0 /end CHARACTERISTIC
/begin CHARACTERISTIC K_ELU_PWM_GRAD_ZUL "max. zulaessiger Gradient des Tastverhaeltnisses" VALUE 0x71FF8 TKW_VV_VV_UW 100.0 FORMULA_0671 0.0 5.0 FORMAT "%5.2" /end CHARACTERISTIC
/begin CHARACTERISTIC K_ELU_PWM_IDENT "Tastverhaeltnis fuer Schnittstellendiagnose" VALUE 0x72003 TKW_VV_VV_UB 100.0 FORMULA_0032 96.0 99.0 /end CHARACTERISTIC
/begin CHARACTERISTIC K_ELU_PWM_MAX_ML "Maximal ausgegebenes Tastverhaeltnis" VALUE 0x71FF4 TKW_VV_VV_UB 100.0 FORMULA_0032 50.0 100.0 /end CHARACTERISTIC
/begin CHARACTERISTIC K_ELU_PWM_MAX_MS "Maximal ausgegebenes Tastverhaeltnis bei Nachlaufanforderung" VALUE 0x71FF7 TKW_VV_VV_UB 100.0 FORMULA_0032 50.0 100.0 /end CHARACTERISTIC
/begin CHARACTERISTIC K_ELU_PWM_MIN_ML "Minimal ausgegebenes Tastverhaeltnis bei Luefterfunktion" VALUE 0x71FF3 TKW_VV_VV_UB 100.0 FORMULA_0032 0.0 49.0 /end CHARACTERISTIC
/begin CHARACTERISTIC K_ELU_PWM_MIN_MS "minimal ausgegebenes Tastverhaeltnis bei Nachlaufanforderung" VALUE 0x71FF6 TKW_VV_VV_UB 100.0 FORMULA_0032 0.0 49.0 /end CHARACTERISTIC
/begin CHARACTERISTIC K_ELU_PWM_OFFS "Offset fuer berechnetes Tastverhaeltnis bei Luefterfunktion" VALUE 0x71FF2 TKW_VV_VV_SB 100.0 FORMULA_0032 -30.0 30.0 /end CHARACTERISTIC
/begin CHARACTERISTIC K_ELU_T_ML_MIN "Verweilzeit nach Startende" VALUE 0x71FFA TKW_VV_VV_UW 100.0 FORMULA_0672 0.0 655350.0 /end CHARACTERISTIC
/begin CHARACTERISTIC K_ELU_T_MS_MAX "zeitliche Begr. des PWM-Signals der NL-Anforderung" VALUE 0x71FFC TKW_VV_VV_UW 100.0 FORMULA_0593 0.0 15.0 /end CHARACTERISTIC
/begin CHARACTERISTIC K_ELU_TAN_DREH_ERSATZ "Ersatzluefterdrehzahl bei TAN-Fehler" VALUE 0x71FFE TKW_VV_VV_UB 100.0 FORMULA_0032 0.0 100.0 /end CHARACTERISTIC
/begin CHARACTERISTIC K_ELU_TCR2_TICS "Periodendauer" VALUE 0x71FEA TKW_VV_VV_UW 100.0 FORMULA_0666 9.600000381469727 79.80000305175781 FORMAT "%4.1" /end CHARACTERISTIC
/begin CHARACTERISTIC K_ELU_TCR2_TICS_NL "Periodendauer bei Nachlaufanforderung" VALUE 0x71FEC TKW_VV_VV_UW 100.0 FORMULA_0666 91.19999694824219 111.0 FORMAT "%4.1" /end CHARACTERISTIC
/begin CHARACTERISTIC K_ELU_TKA_TMOT_DIFF "Differenz zu tmot bei defektem Kuehleraustritt" VALUE 0x71FF0 TKW_VV_VV_SW 100.0 FORMULA_0074 -1000.0 1000.0 FORMAT "%4.1" /end CHARACTERISTIC
/begin CHARACTERISTIC K_ELU_TYP_CFG "Schalter fuer ELU-Typ" VALUE 0x71FEE TKW_VV_VV_UB 100.0 FORMULA_0670 0.0 255.0 /end CHARACTERISTIC
/begin CHARACTERISTIC K_ELUP_CFG "Software-Schalter ELUP" VALUE 0x720C2 TKW_VV_VV_UB 100.0 FORMULA_0678 0.0 255.0 /end CHARACTERISTIC
/begin CHARACTERISTIC K_ELUP_ED_ABS_DEL "Verzoegerung ELUP_ED UNPLAUSIBEL durch Einschaltschwelle" VALUE 0x720D5 TKW_VV_VV_UB 100.0 FORMULA_0461 0.0 25.5 /end CHARACTERISTIC
/begin CHARACTERISTIC K_ELUP_ED_BRPGRAD_SW "Diag-Schwelle durch Bremsdruckgradient" VALUE 0x720D2 TKW_VV_VV_SW 100.0 FORMULA_0675 -5000.0 5000.0 /end CHARACTERISTIC
/begin CHARACTERISTIC K_ELUP_ED_BRPGRAD_T "Filterkonstante fuer elup_ed_brp_grad" VALUE 0x720CD TKW_VV_VV_UB 100.0 FORMULA_0658 1.009999960660934e-002 2.559999942779541 /end CHARACTERISTIC
/begin CHARACTERISTIC K_ELUP_ED_DEL "Verzoegerung ELUP_ED UNPLAUSIBEL durch Druckgradient" VALUE 0x720D4 TKW_VV_VV_UB 100.0 FORMULA_0461 0.0 25.5 /end CHARACTERISTIC
/begin CHARACTERISTIC K_ELUP_ED_MVACP_GRAD_SW "Diag-Schwelle durch Differenzdruckgradient" VALUE 0x720D0 TKW_VV_VV_SW 100.0 FORMULA_0674 -312.5 312.5 FORMAT "%4.1" /end CHARACTERISTIC
/begin CHARACTERISTIC K_ELUP_ED_MVACP_GRAD_T "Filterkonstante fuer elup_ed_mvacp_grad" VALUE 0x720CC TKW_VV_VV_UB 100.0 FORMULA_0679 0.1004000008106232 25.60000038146973 /end CHARACTERISTIC
/begin CHARACTERISTIC K_ELUP_ED_PSAU_SW "Diag-Schwelle durch Saugrohrdruck zu pumg" VALUE 0x720CE TKW_VV_VV_SW 100.0 FORMULA_0075 0.0 2000.0 FORMAT "%4.1" /end CHARACTERISTIC
/begin CHARACTERISTIC K_ELUP_OFF_TIME_MIN "mindest ELUP-Verriegelungszeit" VALUE 0x720CA TKW_VV_VV_UW 100.0 FORMULA_0021 0.0 655.0 FORMAT "%5.2" /end CHARACTERISTIC
/begin CHARACTERISTIC K_ELUP_ON_TIME_MAX "maximale ELUP-Ansteuerzeit" VALUE 0x720C8 TKW_VV_VV_UW 100.0 FORMULA_0021 0.0 655.0 FORMAT "%5.2" /end CHARACTERISTIC
/begin CHARACTERISTIC K_ELUP_ON_TIME_MIN "mindest ELUP-Ansteuerzeit" VALUE 0x720C6 TKW_VV_VV_UW 100.0 FORMULA_0021 0.0 655.0 FORMAT "%5.2" /end CHARACTERISTIC
/begin CHARACTERISTIC K_ELUP_PL_AN_SW "ELUP-Ansteuerschwelle fuer Prueflauf" VALUE 0x720D6 TKW_VV_VV_SW 100.0 FORMULA_0075 -1100.0 200.0 FORMAT "%4.1" /end CHARACTERISTIC
/begin CHARACTERISTIC K_ELUP_PL_IO_SW "ELUP-iO-Schwelle bei Prueflauf" VALUE 0x720D8 TKW_VV_VV_SW 100.0 FORMULA_0075 -1100.0 200.0 FORMAT "%4.1" /end CHARACTERISTIC
/begin CHARACTERISTIC K_ELUP_PL_ON_TIME "ELUP-Ansteuerzeit fuer Prueflauf" VALUE 0x720DA TKW_VV_VV_UW 100.0 FORMULA_0021 0.0 655.0 FORMAT "%5.2" /end CHARACTERISTIC
/begin CHARACTERISTIC K_ELUP_UB_MIN "Mindestspannung an KL87 fuer ELUP-Ansteuerung" VALUE 0x720C4 TKW_VV_VV_SW 100.0 FORMULA_0008 0.0 28.0 FORMAT "%4.1" /end CHARACTERISTIC
/begin CHARACTERISTIC K_KVA_Q_MOT_TAU "Tau Kraftstoffverbrauch Motor." VALUE 0x72F2E TKW_VV_VV_UB 100.0 FORMULA_0645 5.100000184029341e-003 1.279999971389771 /end CHARACTERISTIC
/begin CHARACTERISTIC K_KVA_SPEC_WEIGHT "Dichte von Ottokraftstoff unverbleit." VALUE 0x72F30 TKW_VV_VV_UW 100.0 FORMULA_0747 1.99999994947575e-004 0.9998000264167786 FORMAT "%7.4" /end CHARACTERISTIC
/begin CHARACTERISTIC K_TI_GA "Grundadaptionsfaktor" VALUE 0x77956 TKW_VV_VV_UW 100.0 FORMULA_0806 0.0 10.0 FORMAT "%5.2" /end CHARACTERISTIC
/begin CHARACTERISTIC K_TI_GRUND_STOECH "stoechometrischer Faktor" VALUE 0x77958 TKW_VV_VV_UW 100.0 FORMULA_0806 0.0 511.9920959472656 FORMAT "%5.2" /end CHARACTERISTIC
/begin CHARACTERISTIC K_TI_MAX_OFFS "Offset f. max. TI" VALUE 0x7795A TKW_VV_VV_SW 100.0 FORMULA_0786 -32.76800155639648 32.76699829101563 FORMAT "%5.2" /end CHARACTERISTIC
/begin CHARACTERISTIC K_TI_MAX_RESET "Einfluss von ti_rf_max unterdruecken" VALUE 0x7794E TKW_VV_VV_UW 100.0 FORMULA_1182 0.0 1.0 FORMAT "%5.2" /end CHARACTERISTIC
/begin CHARACTERISTIC K_TI_MIN_MAX_HYS "Hysterese f. MIN/MAX-TI" VALUE 0x7795C TKW_VV_VV_UW 100.0 FORMULA_0786 0.0 65.53500366210938 FORMAT "%5.2" /end CHARACTERISTIC
/begin CHARACTERISTIC K_TI_MIN_OFF_TIME "Minimale Ventilauszeit." VALUE 0x77968 TKW_VV_VV_UW 100.0 FORMULA_0786 0.0 65.53500366210938 FORMAT "%5.2" /end CHARACTERISTIC
/begin CHARACTERISTIC K_TI_MKS_LWV_CFG "Einrechnung LWV-MKS" VALUE 0x77952 TKW_VV_VV_UB 100.0 FORMULA_1185 0.0 1.0 /end CHARACTERISTIC
/begin CHARACTERISTIC K_TI_MKS_OELV_CFG "Einrechnung OELV-MKS" VALUE 0x77951 TKW_VV_VV_UB 100.0 FORMULA_1184 0.0 1.0 /end CHARACTERISTIC
/begin CHARACTERISTIC K_TI_MKS_START_CFG "Einrechnung START-MKS" VALUE 0x77954 TKW_VV_VV_UB 100.0 FORMULA_1187 0.0 1.0 /end CHARACTERISTIC
/begin CHARACTERISTIC K_TI_MKS_TE_CFG "Einrechnung TE-MKS" VALUE 0x77950 TKW_VV_VV_UB 100.0 FORMULA_1183 0.0 1.0 /end CHARACTERISTIC
/begin CHARACTERISTIC K_TI_NMIN_KL50OFF "N-Einschaltschwelle bei !S_KL50" VALUE 0x7796A TKW_VV_VV_SW 100.0 FORMULA_0006 0.0 10000.0 /end CHARACTERISTIC
/begin CHARACTERISTIC K_TI_NS_CFG "Motor laeuft ueber..." VALUE 0x77953 TKW_VV_VV_UB 100.0 FORMULA_1186 0.0 1.0 /end CHARACTERISTIC
/begin CHARACTERISTIC K_TI_OFF_CFG "TI-Abschaltung" VALUE 0x7796C TKW_VV_VV_UW 100.0 FORMULA_0010 0.0 1023.0 /end CHARACTERISTIC
/begin CHARACTERISTIC K_TI_OFF_EXD_N_MAX "max. Drehzahl f. externe TI_OFF-Ansteuerung" VALUE 0x77988 TKW_VV_VV_SW 100.0 FORMULA_0006 0.0 10000.0 /end CHARACTERISTIC
/begin CHARACTERISTIC K_TI_PHI_ENDE_A_SAUG "mittlerer Saugrohrquerschnitt" VALUE 0x77962 TKW_VV_VV_UW 100.0 FORMULA_1189 0.0 2000.0 FORMAT "%5.2" /end CHARACTERISTIC
/begin CHARACTERISTIC K_TI_PHI_ENDE_A_ZYL "Zylinderflaeche" VALUE 0x7795E TKW_VV_VV_UW 100.0 FORMULA_1189 0.0 6553.5 FORMAT "%5.2" /end CHARACTERISTIC
/begin CHARACTERISTIC K_TI_PHI_ENDE_ROH_KST "Kraftstoffdichte" VALUE 0x77964 TKW_VV_VV_UW 100.0 FORMULA_1191 0.0 2.0 FORMAT "%5.2" /end CHARACTERISTIC
/begin CHARACTERISTIC K_TI_PHI_ENDE_S_ESV_EV "Strecke zwischen EV zu EV" VALUE 0x77966 TKW_VV_VV_UW 100.0 FORMULA_1192 0.0 0.6103000044822693 FORMAT "%7.4" /end CHARACTERISTIC
/begin CHARACTERISTIC K_TI_PHI_ENDE_S_HUB "Kolbenhub" VALUE 0x77960 TKW_VV_VV_UW 100.0 FORMULA_1190 0.0 150.0 FORMAT "%5.2" /end CHARACTERISTIC
/begin CHARACTERISTIC K_TI_RF_MAX_DLY "Verzoegerungszeit ueber Anzahl Segmente" VALUE 0x7796E TKW_VV_VV_UW 100.0 FORMULA_1175 0.0 65535.0 /end CHARACTERISTIC
/begin CHARACTERISTIC K_TI_WL_CFG "WL-Korrektur waehrend KH" VALUE 0x77955 TKW_VV_VV_UB 100.0 FORMULA_1188 0.0 1.0 /end CHARACTERISTIC
/begin CHARACTERISTIC K_ZGLA_ADAPT_CFG "Freigabe Adaption - Zylindergleichstellung" VALUE 0x77980 TKW_VV_VV_UB 100.0 FORMULA_1195 0.0 1.0 /end CHARACTERISTIC
/begin CHARACTERISTIC K_ZGLA_F_MAX "max. Adaptionsschwelle - Zylindergleichstellung" VALUE 0x77984 TKW_VV_VV_UW 100.0 FORMULA_0024 0.0 1.998999953269959 FORMAT "%7.4" /end CHARACTERISTIC
/begin CHARACTERISTIC K_ZGLA_F_MIN "min. Adaptionsschwelle - Zylindergleichstellung" VALUE 0x77986 TKW_VV_VV_UW 100.0 FORMULA_0024 0.0 1.998999953269959 FORMAT "%7.4" /end CHARACTERISTIC
/begin CHARACTERISTIC K_ZGLA_FILT_T1 "Filterzeit" VALUE 0x7797E TKW_VV_VV_UW 100.0 FORMULA_1194 0.0 2097.0 FORMAT "%6.3" /end CHARACTERISTIC
/begin CHARACTERISTIC K_ZGLA_I "Integratoranteil - Zylindergleichstellung" VALUE 0x77982 TKW_VV_VV_UW 100.0 FORMULA_0024 0.0 1.998999953269959 FORMAT "%7.4" /end CHARACTERISTIC
/begin CHARACTERISTIC K_ZGLA_INPUT_CFG "Auswahl Input - Zylindergleichstellung" VALUE 0x7797C TKW_VV_VV_UB 100.0 FORMULA_1193 0.0 1.0 /end CHARACTERISTIC
/begin CHARACTERISTIC K_ZGLA_LAM_IST_MAX "max. LAM-IST-MW-Schwelle fuer Zylindergleichstellung" VALUE 0x77978 TKW_VV_VV_UW 100.0 FORMULA_0025 0.0 3.999000072479248 FORMAT "%6.3" /end CHARACTERISTIC
/begin CHARACTERISTIC K_ZGLA_LAM_IST_MIN "min. LAM-IST-MW-Schwelle fuer Zylindergleichstellung" VALUE 0x7797A TKW_VV_VV_UW 100.0 FORMULA_0025 0.0 3.999000072479248 FORMAT "%6.3" /end CHARACTERISTIC
/begin CHARACTERISTIC K_ZGLA_N_MAX "max. N-Schwelle fuer Zylindergleichstellung" VALUE 0x77970 TKW_VV_VV_SW 100.0 FORMULA_0006 0.0 10000.0 /end CHARACTERISTIC
/begin CHARACTERISTIC K_ZGLA_RESET_CFG "RESET Adaption - Zylindergleichstellung" VALUE 0x77981 TKW_VV_VV_UB 100.0 FORMULA_1196 0.0 1.0 /end CHARACTERISTIC
/begin CHARACTERISTIC K_ZGLA_RF_MAX "max. RF-Schwelle fuer Zylindergleichstellung" VALUE 0x77972 TKW_VV_VV_SW 100.0 FORMULA_0007 0.0 2.0 FORMAT "%6.3" /end CHARACTERISTIC
/begin CHARACTERISTIC K_ZGLA_RF_MIN "min. RF-Schwelle fuer Zylindergleichstellung" VALUE 0x77974 TKW_VV_VV_SW 100.0 FORMULA_0007 0.0 2.0 FORMAT "%6.3" /end CHARACTERISTIC
/begin CHARACTERISTIC K_ZGLA_TMOT_MIN "min. TMOT-Schwelle fuer Zylindergleichstellung" VALUE 0x77976 TKW_VV_VV_SW 100.0 FORMULA_0023 -50.0 170.0 FORMAT "%4.1" /end CHARACTERISTIC
/begin CHARACTERISTIC KF_DKBA_NEG_F "Wichtungsfaktor f. harte Zwischenspritzer" MAP 0x7856C TKF_SW_SW_UW 100.0 FORMULA_0073 0.0 4.0 FORMAT "%6.3" /begin AXIS_DESCR STD_AXIS n FORMULA_0006 3 0.0 10000.0 MAX_GRAD 0.0 /end AXIS_DESCR
 /begin AXIS_DESCR STD_AXIS rf FORMULA_0007 3 0.0 2.0 MAX_GRAD 0.0 FORMAT "%6.3" /end AXIS_DESCR
/end CHARACTERISTIC
/begin CHARACTERISTIC KF_DKBA_POS_F "Wichtungsfaktor f. weiche Zwischenspritzer" MAP 0x7854C TKF_SW_SW_UW 100.0 FORMULA_0073 0.0 4.0 FORMAT "%6.3" /begin AXIS_DESCR STD_AXIS n FORMULA_0006 3 0.0 10000.0 MAX_GRAD 0.0 /end AXIS_DESCR
 /begin AXIS_DESCR STD_AXIS rf FORMULA_0007 3 0.0 2.0 MAX_GRAD 0.0 FORMAT "%6.3" /end AXIS_DESCR
/end CHARACTERISTIC
/begin CHARACTERISTIC KF_ELU_PWM_MS "Kennfeld E-Luefter-Nachlaufanforderung" MAP 0x7208C TKF_SW_SW_UB 100.0 FORMULA_0032 0.0 255.0
 /begin AXIS_DESCR STD_AXIS elu_tabg_nkat FORMULA_0023 5 400.0 1100.0 MAX_GRAD 0.0 FORMAT "%4.1" /end AXIS_DESCR
 /begin AXIS_DESCR STD_AXIS tmot FORMULA_0023 6 -50.0 170.0 MAX_GRAD 0.0 FORMAT "%4.1" /end AXIS_DESCR
/end CHARACTERISTIC
/begin CHARACTERISTIC KF_TI_GRUND_F "Wichtungsfaktor auf ti.ml_mg_zyl" MAP 0x77DAC TKF_SW_SW_UW 100.0 FORMULA_0073 0.0 4.0 FORMAT "%6.3" /begin AXIS_DESCR STD_AXIS n FORMULA_0006 10 0.0 10000.0 MAX_GRAD 0.0 /end AXIS_DESCR
 /begin AXIS_DESCR STD_AXIS rf FORMULA_0007 10 0.0 2.0 MAX_GRAD 0.0 FORMAT "%6.3" /end AXIS_DESCR
/end CHARACTERISTIC
/begin CHARACTERISTIC KF_TI_LAA_OFFS_WICHT_F "Korrekturfaktor - Lambdaadaptionsoffset" MAP 0x77D7A TKF_SW_SW_UW 100.0 FORMULA_0073 0.0 4.0 FORMAT "%6.3" /begin AXIS_DESCR STD_AXIS n FORMULA_0006 4 0.0 10000.0 MAX_GRAD 0.0 /end AXIS_DESCR
 /begin AXIS_DESCR STD_AXIS ti_ml_mg_la_f FORMULA_1171 4 -1023.968688964844 1023.968688964844 MAX_GRAD 0.0 FORMAT "%5.2" /end AXIS_DESCR
/end CHARACTERISTIC
/begin CHARACTERISTIC KF_TI_MKS_NS_GRUND "Grundeinspritzmasse Nachstart" MAP 0x77F90 TKF_SW_SW_UW 100.0 FORMULA_0533 0.0 16383.75 FORMAT "%5.2"
 /begin AXIS_DESCR STD_AXIS tsgrw FORMULA_0023 10 -50.0 170.0 MAX_GRAD 0.0 FORMAT "%4.1" /end AXIS_DESCR
 /begin AXIS_DESCR STD_AXIS pumg FORMULA_0075 5 400.0 1200.0 MAX_GRAD 0.0 FORMAT "%4.1" /end AXIS_DESCR
/end CHARACTERISTIC
/begin CHARACTERISTIC KF_TI_MKS_START "START-MKS Grundkennfeld" MAP 0x7833C TKF_SW_SW_UW 100.0 FORMULA_0111 0.0 1023.984313964844 FORMAT "%5.2"
 /begin AXIS_DESCR STD_AXIS tsgrw_m FORMULA_0023 8 -50.0 170.0 MAX_GRAD 0.0 FORMAT "%4.1" /end AXIS_DESCR
 /begin AXIS_DESCR STD_AXIS time_ms FORMULA_0597 3 0.0 546.1165771484375 MAX_GRAD 0.0 FORMAT "%5.2" /end AXIS_DESCR
/end CHARACTERISTIC
/begin CHARACTERISTIC KF_TI_NS_F "Nachstartfaktor auf Grundeinspritzmenge" MAP 0x78014 TKF_SW_SW_UW 100.0 FORMULA_0073 0.0 4.0 FORMAT "%6.3"
 /begin AXIS_DESCR STD_AXIS tsgrw FORMULA_0023 10 -50.0 170.0 MAX_GRAD 0.0 FORMAT "%4.1" /end AXIS_DESCR
 /begin AXIS_DESCR STD_AXIS ti_segm_cnt FORMULA_0010 10 0.0 32767.0 MAX_GRAD 0.0 /end AXIS_DESCR
/end CHARACTERISTIC
/begin CHARACTERISTIC KF_TI_PHI_ENDE_GRUND "Vorlagerungswinkel aus Grundkennfeld" MAP 0x77BFE TKF_SW_SW_SW 100.0 FORMULA_0102 0.0 1440.0 FORMAT "%4.1" /begin AXIS_DESCR STD_AXIS n FORMULA_0006 10 0.0 10000.0 MAX_GRAD 0.0 /end AXIS_DESCR
 /begin AXIS_DESCR STD_AXIS dr_rel FORMULA_0106 8 0.0 199.9938049316406 MAX_GRAD 0.0 FORMAT "%5.2" /end AXIS_DESCR
/end CHARACTERISTIC
/begin CHARACTERISTIC KF_TI_PHI_ENDE_OFFS "Offset Einspritzendewinkel" MAP 0x77B7E TKF_SW_SW_SW 100.0 FORMULA_0102 -720.0 720.0 FORMAT "%4.1"
 /begin AXIS_DESCR STD_AXIS tmot FORMULA_0023 7 -50.0 170.0 MAX_GRAD 0.0 FORMAT "%4.1" /end AXIS_DESCR
 /begin AXIS_DESCR STD_AXIS dr_rel FORMULA_0106 7 0.0 199.9938049316406 MAX_GRAD 0.0 FORMAT "%5.2" /end AXIS_DESCR
/end CHARACTERISTIC
/begin CHARACTERISTIC KF_TI_SEG_TIME_F "Nachstart-Manipulationsfaktor" MAP 0x78106 TKF_UW_UW_UW 100.0 FORMULA_0073 0.0 4.0 FORMAT "%6.3"
 /begin AXIS_DESCR STD_AXIS ti_mks_ns_rel FORMULA_0073 10 0.0 4.0 MAX_GRAD 0.0 FORMAT "%6.3" /end AXIS_DESCR
 /begin AXIS_DESCR STD_AXIS time_ms FORMULA_0597 10 0.0 1092.25 MAX_GRAD 0.0 FORMAT "%5.2" /end AXIS_DESCR
/end CHARACTERISTIC
/begin CHARACTERISTIC KF_TI_SOLL_MIN "minimale Einspritzzeit" MAP 0x77B42 TKF_SW_SW_UW 100.0 FORMULA_0786 0.0 65.53500366210938 FORMAT "%5.2"
 /begin AXIS_DESCR STD_AXIS ub FORMULA_0008 5 0.0 28.0 MAX_GRAD 0.0 FORMAT "%4.1" /end AXIS_DESCR
 /begin AXIS_DESCR STD_AXIS pks-psau FORMULA_0110 4 0.0 10.0 MAX_GRAD 0.0 FORMAT "%6.3" /end AXIS_DESCR
/end CHARACTERISTIC
/begin CHARACTERISTIC KF_TI_SOLL_UB_OFFS "UB-abhaengiger TI-Offset " MAP 0x77AD6 TKF_SW_SW_UW 100.0 FORMULA_0786 0.0 65.53500366210938 FORMAT "%5.2"
 /begin AXIS_DESCR STD_AXIS ub FORMULA_0008 5 0.0 28.0 MAX_GRAD 0.0 FORMAT "%4.1" /end AXIS_DESCR
 /begin AXIS_DESCR STD_AXIS pks-psau FORMULA_0110 8 0.0 10.0 MAX_GRAD 0.0 FORMAT "%6.3" /end AXIS_DESCR
/end CHARACTERISTIC
/begin CHARACTERISTIC KF_TI_START_F "Abregelfaktor im START" MAP 0x78384 TKF_SW_SW_UW 100.0 FORMULA_0073 0.0 4.0 FORMAT "%6.3"
 /begin AXIS_DESCR STD_AXIS tsgrw_m FORMULA_0023 5 -50.0 170.0 MAX_GRAD 0.0 FORMAT "%4.1" /end AXIS_DESCR
 /begin AXIS_DESCR STD_AXIS ti_segm_cnt FORMULA_0010 10 0.0 32767.0 MAX_GRAD 0.0 /end AXIS_DESCR
/end CHARACTERISTIC
/begin CHARACTERISTIC KF_TI_TU_F "Tuning-Faktor f. TI" MAP 0x77CC4 TKF_SW_SW_UW 100.0 FORMULA_0806 0.0 10.0 FORMAT "%5.2" /begin AXIS_DESCR STD_AXIS n FORMULA_0006 6 0.0 10000.0 MAX_GRAD 0.0 /end AXIS_DESCR /begin AXIS_DESCR STD_AXIS Zylinder FORMULA_1197 12 1.0 12.0 MAX_GRAD 0.0 /end AXIS_DESCR /end CHARACTERISTIC
/begin CHARACTERISTIC KF_TI_WL_KORR_F "Korrektur - TI-Warmlauffaktor" MAP 0x7829A TKF_SW_SW_UW 100.0 FORMULA_0073 0.0 4.0 FORMAT "%6.3"
 /begin AXIS_DESCR STD_AXIS zust_tmot_start FORMULA_0023 8 -50.0 170.0 MAX_GRAD 0.0 FORMAT "%4.1" /end AXIS_DESCR
 /begin AXIS_DESCR STD_AXIS time_ml FORMULA_0021 8 0.0 327.0 MAX_GRAD 0.0 FORMAT "%5.2" /end AXIS_DESCR
/end CHARACTERISTIC
/begin CHARACTERISTIC KF_TI_WL_KORR_F_KH "TI-Warmlaufkorrekturfaktor waehrend KH" MAP 0x784AA TKF_SW_SW_UW 100.0 FORMULA_0073 0.0 4.0 FORMAT "%6.3"
 /begin AXIS_DESCR STD_AXIS zust_tmot_start FORMULA_0023 8 -50.0 170.0 MAX_GRAD 0.0 FORMAT "%4.1" /end AXIS_DESCR
 /begin AXIS_DESCR STD_AXIS time_ml FORMULA_0021 8 0.0 327.0 MAX_GRAD 0.0 FORMAT "%5.2" /end AXIS_DESCR
/end CHARACTERISTIC
/begin CHARACTERISTIC KF_TI_WL_OFFS "TI-Warmlaufoffset" MAP 0x781F8 TKF_SW_SW_SW 100.0 FORMULA_0073 -1.0 1.0 FORMAT "%6.3" /begin AXIS_DESCR STD_AXIS n FORMULA_0006 8 0.0 10000.0 MAX_GRAD 0.0 /end AXIS_DESCR
 /begin AXIS_DESCR STD_AXIS rf FORMULA_0007 8 0.0 2.0 MAX_GRAD 0.0 FORMAT "%6.3" /end AXIS_DESCR
/end CHARACTERISTIC
/begin CHARACTERISTIC KF_TI_WL_OFFS_KH "TI-Warmlaufoffset waehrend KH" MAP 0x78408 TKF_SW_SW_SW 100.0 FORMULA_0073 -1.0 1.0 FORMAT "%6.3" /begin AXIS_DESCR STD_AXIS n FORMULA_0006 8 0.0 10000.0 MAX_GRAD 0.0 /end AXIS_DESCR
 /begin AXIS_DESCR STD_AXIS egas_aq_soll_roh FORMULA_0143 8 0.0 3276.699951171875 MAX_GRAD 0.0 FORMAT "%4.1" /end AXIS_DESCR
/end CHARACTERISTIC
/begin CHARACTERISTIC KF_ZGLA_ZYL_NR_OFFS "OFFSET auf aktuellen Zylinder - Zylindergleichstellung" MAP 0x77E9E TKF_SW_SW_UW 100.0 FORMULA_1198 0.0 5.0 /begin AXIS_DESCR STD_AXIS n FORMULA_0006 10 0.0 10000.0 MAX_GRAD 0.0 /end AXIS_DESCR
 /begin AXIS_DESCR STD_AXIS rf FORMULA_0007 10 0.0 2.0 MAX_GRAD 0.0 FORMAT "%6.3" /end AXIS_DESCR
/end CHARACTERISTIC
/begin CHARACTERISTIC KL_DKBA_AQ_REL "Triggerbedingung fuer die Einrechnung von dkba" CURVE 0x77A9E TKL_UW_VV_UW 100.0 FORMULA_0106 0.0 200.0 FORMAT "%5.2"
 /begin AXIS_DESCR STD_AXIS aq_rel FORMULA_0106 2 0.0 200.0 MAX_GRAD 0.0 FORMAT "%5.2" /end AXIS_DESCR
/end CHARACTERISTIC
/begin CHARACTERISTIC KL_DKBA_TMOT "DKBA Faktor - tmot abhaengig" CURVE 0x77AA8 TKL_SW_VV_UW 100.0 FORMULA_0073 0.0 4.0 FORMAT "%6.3"
 /begin AXIS_DESCR STD_AXIS tmot FORMULA_0023 3 -50.0 170.0 MAX_GRAD 0.0 FORMAT "%4.1" /end AXIS_DESCR
/end CHARACTERISTIC
/begin CHARACTERISTIC KL_DKBA_TRIGGER "Triggerbedingung fuer die Einrechnung von dkba" CURVE 0x77A90 TKL_SW_VV_SW 100.0 FORMULA_0007 0.0 2.0 FORMAT "%6.3" /begin AXIS_DESCR STD_AXIS n FORMULA_0006 3 0.0 10000.0 MAX_GRAD 0.0 /end AXIS_DESCR /end CHARACTERISTIC
/begin CHARACTERISTIC KL_ELU_KKOS "Kennlinie ELU-Drehzahl bei CAN-KKOS-Anforderung" CURVE 0x72042 TKL_UB_VV_UB 100.0 FORMULA_0032 0.0 100.0
 /begin AXIS_DESCR STD_AXIS can_kkos_elu FORMULA_0003 16 0.0 15.0 MAX_GRAD 0.0 /end AXIS_DESCR
/end CHARACTERISTIC
/begin CHARACTERISTIC KL_ELU_TAN "Kennlinie ELU-Drehzahl von TAN" CURVE 0x72064 TKL_SW_VV_UB 100.0 FORMULA_0032 0.0 100.0
 /begin AXIS_DESCR STD_AXIS elu_tan FORMULA_0023 6 -50.0 170.0 MAX_GRAD 0.0 FORMAT "%4.1" /end AXIS_DESCR
/end CHARACTERISTIC
/begin CHARACTERISTIC KL_ELU_TKA "Kennlinie ELU-Drehzahl von TKA" CURVE 0x7201A TKL_SW_VV_UB 100.0 FORMULA_0032 0.0 100.0
 /begin AXIS_DESCR STD_AXIS tka FORMULA_0023 6 -50.0 170.0 MAX_GRAD 0.0 FORMAT "%4.1" /end AXIS_DESCR
/end CHARACTERISTIC
/begin CHARACTERISTIC KL_ELU_TKAT "Kennlinie ELU-Drehzahl von TKAT" CURVE 0x7202E TKL_SW_VV_UB 100.0 FORMULA_0032 0.0 100.0
 /begin AXIS_DESCR STD_AXIS elu_tabg_nkat FORMULA_0023 6 400.0 1100.0 MAX_GRAD 0.0 FORMAT "%4.1" /end AXIS_DESCR
/end CHARACTERISTIC
/begin CHARACTERISTIC KL_ELU_V_KORR "Kennlinie ELU_V" CURVE 0x72078 TKL_SW_VV_UB 100.0 FORMULA_0673 0.0 1.0
 /begin AXIS_DESCR STD_AXIS v_vorne FORMULA_0076 6 -80.0 360.0 MAX_GRAD 0.0 FORMAT "%4.1" /end AXIS_DESCR
/end CHARACTERISTIC
/begin CHARACTERISTIC KL_ELUP_AUS "Kennlinie Ausschaltschwelle ELUP" CURVE 0x720FE TKL_SW_VV_SW 100.0 FORMULA_0075 -1100.0 200.0 FORMAT "%4.1"
 /begin AXIS_DESCR STD_AXIS pumg FORMULA_0075 8 400.0 1200.0 MAX_GRAD 0.0 FORMAT "%4.1" /end AXIS_DESCR
/end CHARACTERISTIC
/begin CHARACTERISTIC KL_ELUP_EIN "Kennlinie Einschaltschwelle ELUP" CURVE 0x720DC TKL_SW_VV_SW 100.0 FORMULA_0075 -1100.0 200.0 FORMAT "%4.1"
 /begin AXIS_DESCR STD_AXIS pumg FORMULA_0075 8 400.0 1200.0 MAX_GRAD 0.0 FORMAT "%4.1" /end AXIS_DESCR
/end CHARACTERISTIC
/begin CHARACTERISTIC KL_ELUP_EIN_V_DEL "Kennlinie Einschlatverzoegerung druch v_vorne" CURVE 0x7213A TKL_SW_VV_UW 100.0 FORMULA_0021 0.0 655.0 FORMAT "%5.2"
 /begin AXIS_DESCR STD_AXIS v_vorne FORMULA_0076 6 -80.0 360.0 MAX_GRAD 0.0 FORMAT "%4.1" /end AXIS_DESCR
/end CHARACTERISTIC
/begin CHARACTERISTIC KL_ELUP_V_OFFS "Kennlinie v-Offset auf ELUP-Schaltschwelle" CURVE 0x72120 TKL_SW_VV_SW 100.0 FORMULA_0075 -200.0 200.0 FORMAT "%4.1"
 /begin AXIS_DESCR STD_AXIS v_vorne FORMULA_0076 6 -80.0 360.0 MAX_GRAD 0.0 FORMAT "%4.1" /end AXIS_DESCR
/end CHARACTERISTIC
/begin CHARACTERISTIC KL_TI_NS_VERLUSTE "Verluste Kraftsoffmenge" CURVE 0x77A4E TKL_SW_VV_UW 100.0 FORMULA_0073 0.0 4.0 FORMAT "%6.3"
 /begin AXIS_DESCR STD_AXIS tsgrw FORMULA_0023 7 -50.0 170.0 MAX_GRAD 0.0 FORMAT "%4.1" /end AXIS_DESCR
/end CHARACTERISTIC
/begin CHARACTERISTIC KL_TI_PHI_ENDE_ES "Schliesswinkel Einlassventil" CURVE 0x77A6C TKL_SW_VV_SW 100.0 FORMULA_0102 -72.0 1440.0 FORMAT "%4.1" /begin AXIS_DESCR STD_AXIS n FORMULA_0006 3 0.0 10000.0 MAX_GRAD 0.0 /end AXIS_DESCR /end CHARACTERISTIC
/begin CHARACTERISTIC KL_TI_PHI_ENDE_GRAD "Gradient fuer Aenderungsbegr. ti_ende" CURVE 0x779FC TKL_SW_VV_SW 100.0 FORMULA_0102 0.0 1440.0 FORMAT "%4.1"
 /begin AXIS_DESCR STD_AXIS ti_phi_ende FORMULA_0102 3 -72.0 1440.0 MAX_GRAD 0.0 FORMAT "%4.1" /end AXIS_DESCR
/end CHARACTERISTIC
/begin CHARACTERISTIC KL_TI_PHI_ENDE_START "ti_ende im START" CURVE 0x779DE TKL_SW_VV_SW 100.0 FORMULA_0102 -72.0 1440.0 FORMAT "%4.1"
 /begin AXIS_DESCR STD_AXIS tmot FORMULA_0023 7 -50.0 170.0 MAX_GRAD 0.0 FORMAT "%4.1" /end AXIS_DESCR
/end CHARACTERISTIC
/begin CHARACTERISTIC KL_TI_PHI_EV_WURZEL "Darstellung Wurzel-Fluggeschwindigkeit" CURVE 0x77A0A TKL_UW_VV_SW 100.0 FORMULA_1172 0.0 220.0 FORMAT "%5.2"
 /begin AXIS_DESCR STD_AXIS ti_phi_ev_v_wurz FORMULA_1173 10 0.0 1638.375 MAX_GRAD 0.0 FORMAT "%6.3" /end AXIS_DESCR
/end CHARACTERISTIC
/begin CHARACTERISTIC KL_TI_SOLL_LIN_OFFS "Linearisierungskompensation" CURVE 0x779C4 TKL_UW_VV_SW 100.0 FORMULA_0786 -2.0 2.0 FORMAT "%5.2"
 /begin AXIS_DESCR STD_AXIS ti_soll FORMULA_0786 6 0.0 65.53500366210938 MAX_GRAD 0.0 FORMAT "%5.2" /end AXIS_DESCR
/end CHARACTERISTIC
/begin CHARACTERISTIC KL_TI_SOLL_QSTAT_F "proportionaler Ventilparameter" CURVE 0x779A2 TKL_SW_VV_UW 100.0 FORMULA_1170 0.0 6.0 FORMAT "%6.3"
 /begin AXIS_DESCR STD_AXIS pdiff FORMULA_0110 8 0.0 10.0 MAX_GRAD 0.0 FORMAT "%6.3" /end AXIS_DESCR
/end CHARACTERISTIC
/begin CHARACTERISTIC KL_TI_SOLL_RHO_F "Kompensationsfak. Kraftsoffdichte" CURVE 0x77990 TKL_SW_VV_UW 100.0 FORMULA_0806 0.0 10.0 FORMAT "%5.2"
 /begin AXIS_DESCR STD_AXIS tksm FORMULA_0023 4 -50.0 170.0 MAX_GRAD 0.0 FORMAT "%4.1" /end AXIS_DESCR
/end CHARACTERISTIC
/begin CHARACTERISTIC KL_TI_SOLL_UB_OFFS_T_KORR_F "Kraftsofftemperatur Faktor" CURVE 0x77A34 TKL_SW_VV_UW 100.0 FORMULA_0073 0.0 4.0 FORMAT "%6.3"
 /begin AXIS_DESCR STD_AXIS tksm FORMULA_0023 6 -50.0 170.0 MAX_GRAD 0.0 FORMAT "%4.1" /end AXIS_DESCR
/end CHARACTERISTIC
/begin CHARACTERISTIC KL_TI_START_PUMG_F "Umgebungsdruckwichtung im START" CURVE 0x77A7A TKL_SW_VV_UW 100.0 FORMULA_0073 0.0 4.0 FORMAT "%6.3"
 /begin AXIS_DESCR STD_AXIS pumg FORMULA_0075 5 400.0 1200.0 MAX_GRAD 0.0 FORMAT "%4.1" /end AXIS_DESCR
/end CHARACTERISTIC
/begin AXIS_PTS AXIS_TI_TU_F_N10 "Stuetzstellen ueber Drehzahl" 0x77AB6 n TAD_UB_VV_SW 10000.0 FORMULA_0006 10 0.0 10000.0 /end AXIS_PTS
/begin AXIS_PTS AXIS_TI_TU_F_RF4 "Stuetzstellen ueber rf" 0x77ACC rf_m TAD_UB_VV_SW 2.0 FORMULA_0007 4 0.0 2.0 FORMAT "%6.3" /end AXIS_PTS
/begin MEASUREMENT dkba_aq_rel_delta_b1 "DELTA von aq_rel - Ermittlung im Segment" SWORD FORMULA_0106 0 0.0 -200.0 199.9938049316406 READ_WRITE ECU_ADDRESS 0x3FD268 /end MEASUREMENT
/begin MEASUREMENT dkba_aq_rel_delta_b2 "DELTA von aq_rel - Ermittlung im Segment" SWORD FORMULA_0106 0 0.0 -200.0 199.9938049316406 READ_WRITE ECU_ADDRESS 0x3FD26A /end MEASUREMENT
/begin MEASUREMENT dkba_aq_rf_roh_delta_b1 "DELTA aq_rf_roh - Ermittlung im Segment" SWORD FORMULA_0007 0 0.0 0.0 2.0 READ_WRITE ECU_ADDRESS 0x3FD264 /end MEASUREMENT
/begin MEASUREMENT dkba_aq_rf_roh_delta_b2 "DELTA aq_rf_roh - Ermittlung im Segment" SWORD FORMULA_0007 0 0.0 0.0 2.0 READ_WRITE ECU_ADDRESS 0x3FD266 /end MEASUREMENT
/begin MEASUREMENT dkba_f_b1 "Wichtungsfaktor f. Zwischenspritzer" UWORD FORMULA_0073 0 0.0 0.0 4.0 READ_WRITE ECU_ADDRESS 0x3FD25E /end MEASUREMENT
/begin MEASUREMENT dkba_f_b2 "Wichtungsfaktor f. Zwischenspritzer" UWORD FORMULA_0073 0 0.0 0.0 4.0 READ_WRITE ECU_ADDRESS 0x3FD260 /end MEASUREMENT
/begin MEASUREMENT dkba_freigabe_bank1 "Freigabe DKBA Bank1" UWORD FORMULA_1176 0 0 0.0 255.0 READ_WRITE BIT_MASK 0x1 ECU_ADDRESS 0x3FD262 /end MEASUREMENT
/begin MEASUREMENT dkba_freigabe_bank2 "Freigabe DKBA Bank2" UWORD FORMULA_1180 0 0 0.0 255.0 READ_WRITE BIT_MASK 0x2 ECU_ADDRESS 0x3FD262 /end MEASUREMENT
/begin MEASUREMENT dkba_mks_grund_zyl1 "phy. Grundwert d. DK-Beschleunigungsanreicherung" UWORD FORMULA_0111 0 0.0 0.0 1023.984313964844 READ_WRITE ECU_ADDRESS 0x3FD220 /end MEASUREMENT
/begin MEASUREMENT dkba_mks_grund_zyl10 "phy. Grundwert d. DK-Beschleunigungsanreicherung" UWORD FORMULA_0111 0 0.0 0.0 1023.984313964844 READ_WRITE ECU_ADDRESS 0x3FD232 /end MEASUREMENT
/begin MEASUREMENT dkba_mks_grund_zyl2 "phy. Grundwert d. DK-Beschleunigungsanreicherung" UWORD FORMULA_0111 0 0.0 0.0 1023.984313964844 READ_WRITE ECU_ADDRESS 0x3FD222 /end MEASUREMENT
/begin MEASUREMENT dkba_mks_grund_zyl3 "phy. Grundwert d. DK-Beschleunigungsanreicherung" UWORD FORMULA_0111 0 0.0 0.0 1023.984313964844 READ_WRITE ECU_ADDRESS 0x3FD224 /end MEASUREMENT
/begin MEASUREMENT dkba_mks_grund_zyl4 "phy. Grundwert d. DK-Beschleunigungsanreicherung" UWORD FORMULA_0111 0 0.0 0.0 1023.984313964844 READ_WRITE ECU_ADDRESS 0x3FD226 /end MEASUREMENT
/begin MEASUREMENT dkba_mks_grund_zyl5 "phy. Grundwert d. DK-Beschleunigungsanreicherung" UWORD FORMULA_0111 0 0.0 0.0 1023.984313964844 READ_WRITE ECU_ADDRESS 0x3FD228 /end MEASUREMENT
/begin MEASUREMENT dkba_mks_grund_zyl6 "phy. Grundwert d. DK-Beschleunigungsanreicherung" UWORD FORMULA_0111 0 0.0 0.0 1023.984313964844 READ_WRITE ECU_ADDRESS 0x3FD22A /end MEASUREMENT
/begin MEASUREMENT dkba_mks_grund_zyl7 "phy. Grundwert d. DK-Beschleunigungsanreicherung" UWORD FORMULA_0111 0 0.0 0.0 1023.984313964844 READ_WRITE ECU_ADDRESS 0x3FD22C /end MEASUREMENT
/begin MEASUREMENT dkba_mks_grund_zyl8 "phy. Grundwert d. DK-Beschleunigungsanreicherung" UWORD FORMULA_0111 0 0.0 0.0 1023.984313964844 READ_WRITE ECU_ADDRESS 0x3FD22E /end MEASUREMENT
/begin MEASUREMENT dkba_mks_grund_zyl9 "phy. Grundwert d. DK-Beschleunigungsanreicherung" UWORD FORMULA_0111 0 0.0 0.0 1023.984313964844 READ_WRITE ECU_ADDRESS 0x3FD230 /end MEASUREMENT
/begin MEASUREMENT dkba_mks_roh_zyl1 "Rohwert d. DK-Beschleunigungsanreicherung" UWORD FORMULA_0111 0 0.0 0.0 1023.984313964844 READ_WRITE ECU_ADDRESS 0x3FD234 /end MEASUREMENT
/begin MEASUREMENT dkba_mks_roh_zyl10 "Rohwert d. DK-Beschleunigungsanreicherung" UWORD FORMULA_0111 0 0.0 0.0 1023.984313964844 READ_WRITE ECU_ADDRESS 0x3FD246 /end MEASUREMENT
/begin MEASUREMENT dkba_mks_roh_zyl2 "Rohwert d. DK-Beschleunigungsanreicherung" UWORD FORMULA_0111 0 0.0 0.0 1023.984313964844 READ_WRITE ECU_ADDRESS 0x3FD236 /end MEASUREMENT
/begin MEASUREMENT dkba_mks_roh_zyl3 "Rohwert d. DK-Beschleunigungsanreicherung" UWORD FORMULA_0111 0 0.0 0.0 1023.984313964844 READ_WRITE ECU_ADDRESS 0x3FD238 /end MEASUREMENT
/begin MEASUREMENT dkba_mks_roh_zyl4 "Rohwert d. DK-Beschleunigungsanreicherung" UWORD FORMULA_0111 0 0.0 0.0 1023.984313964844 READ_WRITE ECU_ADDRESS 0x3FD23A /end MEASUREMENT
/begin MEASUREMENT dkba_mks_roh_zyl5 "Rohwert d. DK-Beschleunigungsanreicherung" UWORD FORMULA_0111 0 0.0 0.0 1023.984313964844 READ_WRITE ECU_ADDRESS 0x3FD23C /end MEASUREMENT
/begin MEASUREMENT dkba_mks_roh_zyl6 "Rohwert d. DK-Beschleunigungsanreicherung" UWORD FORMULA_0111 0 0.0 0.0 1023.984313964844 READ_WRITE ECU_ADDRESS 0x3FD23E /end MEASUREMENT
/begin MEASUREMENT dkba_mks_roh_zyl7 "Rohwert d. DK-Beschleunigungsanreicherung" UWORD FORMULA_0111 0 0.0 0.0 1023.984313964844 READ_WRITE ECU_ADDRESS 0x3FD240 /end MEASUREMENT
/begin MEASUREMENT dkba_mks_roh_zyl8 "Rohwert d. DK-Beschleunigungsanreicherung" UWORD FORMULA_0111 0 0.0 0.0 1023.984313964844 READ_WRITE ECU_ADDRESS 0x3FD242 /end MEASUREMENT
/begin MEASUREMENT dkba_mks_roh_zyl9 "Rohwert d. DK-Beschleunigungsanreicherung" UWORD FORMULA_0111 0 0.0 0.0 1023.984313964844 READ_WRITE ECU_ADDRESS 0x3FD244 /end MEASUREMENT
/begin MEASUREMENT dkba_mks_zyl1 "DK-Beschleunigungsanreicherung" UWORD FORMULA_0111 0 0.0 0.0 1023.984313964844 READ_WRITE ECU_ADDRESS 0x3FD248 /end MEASUREMENT
/begin MEASUREMENT dkba_mks_zyl10 "DK-Beschleunigungsanreicherung" UWORD FORMULA_0111 0 0.0 0.0 1023.984313964844 READ_WRITE ECU_ADDRESS 0x3FD25A /end MEASUREMENT
/begin MEASUREMENT dkba_mks_zyl2 "DK-Beschleunigungsanreicherung" UWORD FORMULA_0111 0 0.0 0.0 1023.984313964844 READ_WRITE ECU_ADDRESS 0x3FD24A /end MEASUREMENT
/begin MEASUREMENT dkba_mks_zyl3 "DK-Beschleunigungsanreicherung" UWORD FORMULA_0111 0 0.0 0.0 1023.984313964844 READ_WRITE ECU_ADDRESS 0x3FD24C /end MEASUREMENT
/begin MEASUREMENT dkba_mks_zyl4 "DK-Beschleunigungsanreicherung" UWORD FORMULA_0111 0 0.0 0.0 1023.984313964844 READ_WRITE ECU_ADDRESS 0x3FD24E /end MEASUREMENT
/begin MEASUREMENT dkba_mks_zyl5 "DK-Beschleunigungsanreicherung" UWORD FORMULA_0111 0 0.0 0.0 1023.984313964844 READ_WRITE ECU_ADDRESS 0x3FD250 /end MEASUREMENT
/begin MEASUREMENT dkba_mks_zyl6 "DK-Beschleunigungsanreicherung" UWORD FORMULA_0111 0 0.0 0.0 1023.984313964844 READ_WRITE ECU_ADDRESS 0x3FD252 /end MEASUREMENT
/begin MEASUREMENT dkba_mks_zyl7 "DK-Beschleunigungsanreicherung" UWORD FORMULA_0111 0 0.0 0.0 1023.984313964844 READ_WRITE ECU_ADDRESS 0x3FD254 /end MEASUREMENT
/begin MEASUREMENT dkba_mks_zyl8 "DK-Beschleunigungsanreicherung" UWORD FORMULA_0111 0 0.0 0.0 1023.984313964844 READ_WRITE ECU_ADDRESS 0x3FD256 /end MEASUREMENT
/begin MEASUREMENT dkba_mks_zyl9 "DK-Beschleunigungsanreicherung" UWORD FORMULA_0111 0 0.0 0.0 1023.984313964844 READ_WRITE ECU_ADDRESS 0x3FD258 /end MEASUREMENT
/begin MEASUREMENT dkba_n_max "N-MAX-Schwelle fuer DKBA" UWORD FORMULA_1181 0 0 0.0 255.0 READ_WRITE BIT_MASK 0x4 ECU_ADDRESS 0x3FD262 /end MEASUREMENT
/begin MEASUREMENT dkba_st "Status DKBA" UWORD FORMULA_0080 0 0.0 0.0 65535.0 READ_WRITE ECU_ADDRESS 0x3FD262 /end MEASUREMENT
/begin MEASUREMENT dkba_tmot_f "TMOT-abhaengiger Faktor" UWORD FORMULA_0073 0 0.0 0.0 4.0 READ_WRITE ECU_ADDRESS 0x3FD25C /end MEASUREMENT
/begin MEASUREMENT elu_dreh "geforderte, v-korrigierte E-Luefterdrehzahl in %" UBYTE FORMULA_0032 0 0.0 0.0 100.0 READ_WRITE ECU_ADDRESS 0x3FBEB9 /end MEASUREMENT
/begin MEASUREMENT elu_dreh_sch "Schleppzeiger gefilterte ELU-Drehzahl" UBYTE FORMULA_0032 0 0.0 0.0 255.0 READ_WRITE ECU_ADDRESS 0x3FBEBB /end MEASUREMENT
/begin MEASUREMENT elu_ed_blockiert_cnt "Counter zur Entprellung eines ELU_BLOCKIERT-Fehlers" UBYTE FORMULA_0003 0 0.0 0.0 255.0 READ_WRITE ECU_ADDRESS 0x3FBEE8 /end MEASUREMENT
/begin MEASUREMENT elu_ed_blockiert_timer "Timer zur Entprellung der ELU-Fehlermeldung" UWORD FORMULA_0668 0 0.0 0.0 6553500.0 READ_WRITE ECU_ADDRESS 0x3FBEE0 /end MEASUREMENT
/begin MEASUREMENT elu_ed_blockiert_zyklus_delay "Delay bis zur Wiederholung der ELU-Fehlermeldung" UWORD FORMULA_0668 0 0.0 0.0 6553500.0 READ_WRITE ECU_ADDRESS 0x3FBEE4 /end MEASUREMENT
/begin MEASUREMENT elu_ed_error_cycle_time "Zeitdauer des ELU-ED-Zyklus" UWORD FORMULA_0668 0 0.0 0.0 6553500.0 READ_WRITE ECU_ADDRESS 0x3FBED0 /end MEASUREMENT
/begin MEASUREMENT elu_ed_fart_merker "ELU-Fehlerartmerker fuer nachfolgenden elu_ed-Zyklus" UBYTE FORMULA_0669 0 0.0 0.0 255.0 READ_WRITE ECU_ADDRESS 0x3FBECE /end MEASUREMENT
/begin MEASUREMENT elu_ed_openload_cnt "Counter zur Entprellung eines OPENLOAD-Fehlers" UBYTE FORMULA_0003 0 0.0 0.0 255.0 READ_WRITE ECU_ADDRESS 0x3FBEE7 /end MEASUREMENT
/begin MEASUREMENT elu_ed_sh_to_gnd_cnt "Counter zur Entprellung eines SH_TO_GND-Fehlers" UBYTE FORMULA_0003 0 0.0 0.0 255.0 READ_WRITE ECU_ADDRESS 0x3FBEE6 /end MEASUREMENT
/begin MEASUREMENT elu_ed_sh_to_ub_delay "Timer zur Entprellung von SH_TO_UB" UWORD FORMULA_0668 0 0.0 0.0 6553500.0 READ_WRITE ECU_ADDRESS 0x3FBED8 /end MEASUREMENT
/begin MEASUREMENT elu_ed_sh_to_ub_off_timer "Timer fuer Endstufe OFF bei SH_TO_UB" UWORD FORMULA_0668 0 0.0 0.0 6553500.0 READ_WRITE ECU_ADDRESS 0x3FBED4 /end MEASUREMENT
/begin MEASUREMENT elu_exd_timeout "KWP-Ansteuerzeit" UBYTE FORMULA_0461 0 0.0 0.0 25.5 READ_WRITE ECU_ADDRESS 0x3FBEC4 /end MEASUREMENT
/begin MEASUREMENT elu_fkt_st "ELU-Funktionsstatus" UBYTE FORMULA_0667 0 0.0 0.0 255.0 READ_WRITE ECU_ADDRESS 0x3FBEC5 /end MEASUREMENT
/begin MEASUREMENT elu_ident_cycle_cnt "Anzahl Identifikationszyklen der ELU-Typerkennung" UBYTE FORMULA_0003 0 0.0 0.0 255.0 READ_WRITE ECU_ADDRESS 0x3FBEC8 /end MEASUREMENT
/begin MEASUREMENT elu_ident_cycle_time "Zeitdauer des Identifikationszyklus der ELU-Typerkennung" UWORD FORMULA_0668 0 0.0 0.0 6553500.0 READ_WRITE ECU_ADDRESS 0x3FBEC6 /end MEASUREMENT
/begin MEASUREMENT elu_ident_timer "ELU-Anwortzeit nach GND waehrend der ELU-Typerkennung" UWORD FORMULA_0668 0 0.0 0.0 6553500.0 READ_WRITE ECU_ADDRESS 0x3FBECC /end MEASUREMENT
/begin MEASUREMENT elu_min_hys "minimale ELU-Hysterese" UBYTE FORMULA_0032 0 0.0 0.0 100.0 READ_WRITE ECU_ADDRESS 0x3FBEBA /end MEASUREMENT
/begin MEASUREMENT elu_pwm "ausgegebenes PWM-Signal" UBYTE FORMULA_0032 0 0.0 0.0 100.0 READ_WRITE ECU_ADDRESS 0x3FBEC1 /end MEASUREMENT
/begin MEASUREMENT elu_pwm_ml "berechnetes PWM-Signal bei ML" UBYTE FORMULA_0032 0 0.0 0.0 255.0 READ_WRITE ECU_ADDRESS 0x3FBEBC /end MEASUREMENT
/begin MEASUREMENT elu_pwm_ml_filt "gefiltertes Tastverhaeltnis des PWM-Signals" UWORD FORMULA_0665 0 0.0 0.0 127.9980010986328 READ_WRITE ECU_ADDRESS 0x3FBEBE /end MEASUREMENT
/begin MEASUREMENT elu_pwm_ms "berechnetes PWM-Signal bei MS" UBYTE FORMULA_0032 0 0.0 0.0 255.0 READ_WRITE ECU_ADDRESS 0x3FBEC0 /end MEASUREMENT
/begin MEASUREMENT elu_st "Status ELU-Ansteuerung" UBYTE FORMULA_0664 0 0.0 0.0 255.0 READ_WRITE ECU_ADDRESS 0x3FBEB8 /end MEASUREMENT
/begin MEASUREMENT elu_t_periode "ausgegebene Periodendauer" UWORD FORMULA_0666 0 0.0 0.0 39321.0 READ_WRITE ECU_ADDRESS 0x3FBEC2 /end MEASUREMENT
/begin MEASUREMENT elup_ed_abs_del "Verzoegerung ELUP_ED UNPLAUSIBEL durch Einschaltschwelle" UBYTE FORMULA_0461 0 0.0 0.0 25.5 READ_WRITE ECU_ADDRESS 0x3FBEFB /end MEASUREMENT
/begin MEASUREMENT elup_ed_aktiv "Diagnosebedingung fuer ELUP-Funktion" UBYTE FORMULA_0676 0 0.0 0.0 255.0 READ_WRITE ECU_ADDRESS 0x3FBEFE /end MEASUREMENT
/begin MEASUREMENT elup_ed_brp_grad "PT1-gefilterter Bremsdruckgradient" SWORD FORMULA_0675 0 0.0 -5000.0 5000.0 READ_WRITE ECU_ADDRESS 0x3FBEF8 /end MEASUREMENT
/begin MEASUREMENT elup_ed_del "Verzoegerung ELUP_ED UNPLAUSIBEL durch Druckgradient" UBYTE FORMULA_0461 0 0.0 0.0 25.5 READ_WRITE ECU_ADDRESS 0x3FBEFA /end MEASUREMENT
/begin MEASUREMENT elup_ed_mvacp_grad "Differenzdruckgradient" SWORD FORMULA_0674 0 0.0 -312.5 312.5 READ_WRITE ECU_ADDRESS 0x3FBEF6 /end MEASUREMENT
/begin MEASUREMENT elup_ed_mvacp_old "gemessener Differenzdruck aus vorherigem Diagnosezyklus" SWORD FORMULA_0075 0 0.0 -1100.0 200.0 READ_WRITE ECU_ADDRESS 0x3FBEF4 /end MEASUREMENT
/begin MEASUREMENT elup_ein_v_del "Einschaltverzoegerung durch v_vorne" UWORD FORMULA_0021 0 0.0 0.0 655.0 READ_WRITE ECU_ADDRESS 0x3FBEFC /end MEASUREMENT
/begin MEASUREMENT elup_exd_timeout "KWP-Ansteuerzeit" UWORD FORMULA_0021 0 0.0 0.0 655.0 READ_WRITE ECU_ADDRESS 0x3FBEEC /end MEASUREMENT
/begin MEASUREMENT elup_interlock_time "Timer Schaltverriegelung fuer AN/AUS" UWORD FORMULA_0021 0 0.0 0.0 655.0 READ_WRITE ECU_ADDRESS 0x3FBEEA /end MEASUREMENT
/begin MEASUREMENT elup_pl_mvac_p_ende "mvac_p am Ende des ELUP-Prueflaufs" SWORD FORMULA_0075 0 0.0 -1100.0 200.0 READ_WRITE ECU_ADDRESS 0x3FBF02 /end MEASUREMENT
/begin MEASUREMENT elup_pl_mvac_p_start "mvac_p zu Beginn des ELUP-Prueflaufs" SWORD FORMULA_0075 0 0.0 -1100.0 200.0 READ_WRITE ECU_ADDRESS 0x3FBF00 /end MEASUREMENT
/begin MEASUREMENT elup_pl_st "Prueflaufstatus ELUP" UBYTE FORMULA_0677 0 0.0 0.0 255.0 READ_WRITE ECU_ADDRESS 0x3FBEFF /end MEASUREMENT
/begin MEASUREMENT elup_sw_aus "ermittelte ELUP-Ausschaltschwelle" SWORD FORMULA_0075 0 0.0 -1100.0 200.0 READ_WRITE ECU_ADDRESS 0x3FBEF0 /end MEASUREMENT
/begin MEASUREMENT elup_sw_ein "ermittelte ELUP-Einschaltschwelle" SWORD FORMULA_0075 0 0.0 -1100.0 200.0 READ_WRITE ECU_ADDRESS 0x3FBEEE /end MEASUREMENT
/begin MEASUREMENT elup_v_offs "Offset auf ELUP-Schaltschwelle durch v_vorne" SWORD FORMULA_0075 0 0.0 -200.0 200.0 READ_WRITE ECU_ADDRESS 0x3FBEF2 /end MEASUREMENT
/begin MEASUREMENT kva_can_cnt "Letzter Kraftstoffverbrauch in ul." UWORD FORMULA_0144 0 0.0 0.0 65.53500366210938 READ_WRITE ECU_ADDRESS 0x3FC112 /end MEASUREMENT
/begin MEASUREMENT kva_mks_out_sum "Kraftstoffverbrauchszaehler." ULONG FORMULA_0044 0 0.0 0.0 4294967295.0 READ_WRITE ECU_ADDRESS 0x3FC10C /end MEASUREMENT
/begin MEASUREMENT kva_mks_out_sum_last "Letzter Kraftstoffverbrauchszaehler." ULONG FORMULA_0044 0 0.0 0.0 4294967295.0 READ_WRITE ECU_ADDRESS 0x3FC108 /end MEASUREMENT
/begin MEASUREMENT kva_q_mot "Kraftstoffverbrauch Motor" SWORD FORMULA_0746 0 0.0 0.0 256.0 READ_WRITE ECU_ADDRESS 0x3FC110 /end MEASUREMENT
/begin MEASUREMENT lwv_mks "MKS aus Ladungswechselmodell" SWORD FORMULA_0111 0 0.0 -512.0 511.0 READ_WRITE ECU_ADDRESS 0x3FD192 /end MEASUREMENT
/begin MEASUREMENT ti_asp_cnt_zyl1 "Arbeitsspielzaehler der Einspritzkanaele." UBYTE FORMULA_0003 0 0.0 0.0 255.0 READ_WRITE ECU_ADDRESS 0x3FD1BC /end MEASUREMENT
/begin MEASUREMENT ti_asp_cnt_zyl10 "Arbeitsspielzaehler der Einspritzkanaele." UBYTE FORMULA_0003 0 0.0 0.0 255.0 READ_WRITE ECU_ADDRESS 0x3FD1C5 /end MEASUREMENT
/begin MEASUREMENT ti_asp_cnt_zyl2 "Arbeitsspielzaehler der Einspritzkanaele." UBYTE FORMULA_0003 0 0.0 0.0 255.0 READ_WRITE ECU_ADDRESS 0x3FD1BD /end MEASUREMENT
/begin MEASUREMENT ti_asp_cnt_zyl3 "Arbeitsspielzaehler der Einspritzkanaele." UBYTE FORMULA_0003 0 0.0 0.0 255.0 READ_WRITE ECU_ADDRESS 0x3FD1BE /end MEASUREMENT
/begin MEASUREMENT ti_asp_cnt_zyl4 "Arbeitsspielzaehler der Einspritzkanaele." UBYTE FORMULA_0003 0 0.0 0.0 255.0 READ_WRITE ECU_ADDRESS 0x3FD1BF /end MEASUREMENT
/begin MEASUREMENT ti_asp_cnt_zyl5 "Arbeitsspielzaehler der Einspritzkanaele." UBYTE FORMULA_0003 0 0.0 0.0 255.0 READ_WRITE ECU_ADDRESS 0x3FD1C0 /end MEASUREMENT
/begin MEASUREMENT ti_asp_cnt_zyl6 "Arbeitsspielzaehler der Einspritzkanaele." UBYTE FORMULA_0003 0 0.0 0.0 255.0 READ_WRITE ECU_ADDRESS 0x3FD1C1 /end MEASUREMENT
/begin MEASUREMENT ti_asp_cnt_zyl7 "Arbeitsspielzaehler der Einspritzkanaele." UBYTE FORMULA_0003 0 0.0 0.0 255.0 READ_WRITE ECU_ADDRESS 0x3FD1C2 /end MEASUREMENT
/begin MEASUREMENT ti_asp_cnt_zyl8 "Arbeitsspielzaehler der Einspritzkanaele." UBYTE FORMULA_0003 0 0.0 0.0 255.0 READ_WRITE ECU_ADDRESS 0x3FD1C3 /end MEASUREMENT
/begin MEASUREMENT ti_asp_cnt_zyl9 "Arbeitsspielzaehler der Einspritzkanaele." UBYTE FORMULA_0003 0 0.0 0.0 255.0 READ_WRITE ECU_ADDRESS 0x3FD1C4 /end MEASUREMENT
/begin MEASUREMENT ti_b1.laa_offs_wicht_f "Korrekturfaktor - Lambdaadaptionsoffset" UWORD FORMULA_0073 0 0.0 0.0 4.0 READ_WRITE ECU_ADDRESS 0x3FD016 /end MEASUREMENT
/begin MEASUREMENT ti_b1.min "min. TI-Zeit" UWORD FORMULA_0786 0 0.0 0.0 65.53500366210938 READ_WRITE ECU_ADDRESS 0x3FD018 /end MEASUREMENT
/begin MEASUREMENT ti_b1.mks_grund "Grundeinspritzmasse mit WL" UWORD FORMULA_0111 0 0.0 0.0 1023.984313964844 READ_WRITE ECU_ADDRESS 0x3FD020 /end MEASUREMENT
/begin MEASUREMENT ti_b1.mks_max "max. MKS fuer TI" UWORD FORMULA_0111 0 0.0 0.0 1023.984313964844 READ_WRITE ECU_ADDRESS 0x3FD032 /end MEASUREMENT
/begin MEASUREMENT ti_b1.ml_max "max. ML aus ti_mks_max" UWORD FORMULA_0090 0 0.0 0.0 6553.5 READ_WRITE ECU_ADDRESS 0x3FD034 /end MEASUREMENT
/begin MEASUREMENT ti_b1.ml_mg_la "Luftmasse/Zyl incl. LA-Einfl." UWORD FORMULA_0111 0 0.0 0.0 1023.984313964844 READ_WRITE ECU_ADDRESS 0x3FD01C /end MEASUREMENT
/begin MEASUREMENT ti_b1.ml_mg_la_f "Luftmasse/Zyl nur mit LA-F-Einfl." SWORD FORMULA_1171 0 0.0 -1023.968688964844 1023.968688964844 READ_WRITE ECU_ADDRESS 0x3FD01E /end MEASUREMENT
/begin MEASUREMENT ti_b1.ml_mg_zyl "zyl. Luftmasse in mg/ASP" SWORD FORMULA_0090 0 0.0 -3276.699951171875 3276.699951171875 READ_WRITE ECU_ADDRESS 0x3FD01A /end MEASUREMENT
/begin MEASUREMENT ti_b1.pdiff "Differenz pks-psau" SWORD FORMULA_0110 0 0.0 0.0 10.0 READ_WRITE ECU_ADDRESS 0x3FD00C /end MEASUREMENT
/begin MEASUREMENT ti_b1.phi_ende "Einspritzendewinkel" SWORD FORMULA_0102 0 0.0 -72.0 1440.0 READ_WRITE ECU_ADDRESS 0x3FD026 /end MEASUREMENT
/begin MEASUREMENT ti_b1.phi_ende_flug "Flugwinkel Kraftstoff" SWORD FORMULA_0102 0 0.0 -72.0 1440.0 READ_WRITE ECU_ADDRESS 0x3FD02E /end MEASUREMENT
/begin MEASUREMENT ti_b1.phi_ende_grad "Gradient fuer Aenderungsbegr." SWORD FORMULA_0102 0 0.0 -72.0 1440.0 READ_WRITE ECU_ADDRESS 0x3FD022 /end MEASUREMENT
/begin MEASUREMENT ti_b1.phi_ende_grund "Vorlagerungsgrundwinkel" SWORD FORMULA_0102 0 0.0 -72.0 1440.0 READ_WRITE ECU_ADDRESS 0x3FD028 /end MEASUREMENT
/begin MEASUREMENT ti_b1.phi_ende_min "min. Einspritzendewinkel" SWORD FORMULA_0102 0 0.0 -72.0 1440.0 READ_WRITE ECU_ADDRESS 0x3FD030 /end MEASUREMENT
/begin MEASUREMENT ti_b1.phi_ende_roh "Einspritzendewinkel vor Aenderungsbegr." SWORD FORMULA_0102 0 0.0 -72.0 1440.0 READ_WRITE ECU_ADDRESS 0x3FD024 /end MEASUREMENT
/begin MEASUREMENT ti_b1.phi_ev_v "Fluggeschwindigkeit Kraftstoff" SWORD FORMULA_1172 0 0.0 0.0 220.0 READ_WRITE ECU_ADDRESS 0x3FD02A /end MEASUREMENT
/begin MEASUREMENT ti_b1.phi_ks_v "Fluggeschwindigkeit Kraftstoff" SWORD FORMULA_1172 0 0.0 0.0 220.0 READ_WRITE ECU_ADDRESS 0x3FD02C /end MEASUREMENT
/begin MEASUREMENT ti_b1.qstat_f "proportionaler Ventilparameter" UWORD FORMULA_1170 0 0.0 0.0 6.0 READ_WRITE ECU_ADDRESS 0x3FD010 /end MEASUREMENT
/begin MEASUREMENT ti_b1.rho_f "Kompensationsfak. Kraftsoffdichte" UWORD FORMULA_0806 0 0.0 0.0 511.9920959472656 READ_WRITE ECU_ADDRESS 0x3FD00E /end MEASUREMENT
/begin MEASUREMENT ti_b1.t_korr_f "saugrohrwandtemperaturabh. Faktor" UWORD FORMULA_0073 0 0.0 0.0 4.0 READ_WRITE ECU_ADDRESS 0x3FD014 /end MEASUREMENT
/begin MEASUREMENT ti_b1.ub_offs "UB-abhaengiger TI-Offset" UWORD FORMULA_0786 0 0.0 0.0 65.53500366210938 READ_WRITE ECU_ADDRESS 0x3FD012 /end MEASUREMENT
/begin MEASUREMENT ti_b2.laa_offs_wicht_f "Korrekturfaktor - Lambdaadaptionsoffset" UWORD FORMULA_0073 0 0.0 0.0 4.0 READ_WRITE ECU_ADDRESS 0x3FD042 /end MEASUREMENT
/begin MEASUREMENT ti_b2.min "min. TI-Zeit" UWORD FORMULA_0786 0 0.0 0.0 65.53500366210938 READ_WRITE ECU_ADDRESS 0x3FD044 /end MEASUREMENT
/begin MEASUREMENT ti_b2.mks_grund "Grundeinspritzmasse mit WL" UWORD FORMULA_0111 0 0.0 0.0 1023.984313964844 READ_WRITE ECU_ADDRESS 0x3FD04C /end MEASUREMENT
/begin MEASUREMENT ti_b2.mks_max "max. MKS fuer TI" UWORD FORMULA_0111 0 0.0 0.0 1023.984313964844 READ_WRITE ECU_ADDRESS 0x3FD05E /end MEASUREMENT
/begin MEASUREMENT ti_b2.ml_max "max. ML aus ti_mks_max" UWORD FORMULA_0090 0 0.0 0.0 6553.5 READ_WRITE ECU_ADDRESS 0x3FD060 /end MEASUREMENT
/begin MEASUREMENT ti_b2.ml_mg_la "Luftmasse/Zyl incl. LA-Einfl." UWORD FORMULA_0111 0 0.0 0.0 1023.984313964844 READ_WRITE ECU_ADDRESS 0x3FD048 /end MEASUREMENT
/begin MEASUREMENT ti_b2.ml_mg_la_f "Luftmasse/Zyl nur mit LA-F-Einfl." SWORD FORMULA_1171 0 0.0 -1023.968688964844 1023.968688964844 READ_WRITE ECU_ADDRESS 0x3FD04A /end MEASUREMENT
/begin MEASUREMENT ti_b2.ml_mg_zyl "zyl. Luftmasse in mg/ASP" SWORD FORMULA_0090 0 0.0 -3276.699951171875 3276.699951171875 READ_WRITE ECU_ADDRESS 0x3FD046 /end MEASUREMENT
/begin MEASUREMENT ti_b2.pdiff "Differenz pks-psau" SWORD FORMULA_0110 0 0.0 0.0 10.0 READ_WRITE ECU_ADDRESS 0x3FD038 /end MEASUREMENT
/begin MEASUREMENT ti_b2.phi_ende "Einspritzendewinkel" SWORD FORMULA_0102 0 0.0 -72.0 1440.0 READ_WRITE ECU_ADDRESS 0x3FD052 /end MEASUREMENT
/begin MEASUREMENT ti_b2.phi_ende_flug "Flugwinkel Kraftstoff" SWORD FORMULA_0102 0 0.0 -72.0 1440.0 READ_WRITE ECU_ADDRESS 0x3FD05A /end MEASUREMENT
/begin MEASUREMENT ti_b2.phi_ende_grad "Gradient fuer Aenderungsbegr." SWORD FORMULA_0102 0 0.0 -72.0 1440.0 READ_WRITE ECU_ADDRESS 0x3FD04E /end MEASUREMENT
/begin MEASUREMENT ti_b2.phi_ende_grund "Vorlagerungsgrundwinkel" SWORD FORMULA_0102 0 0.0 -72.0 1440.0 READ_WRITE ECU_ADDRESS 0x3FD054 /end MEASUREMENT
/begin MEASUREMENT ti_b2.phi_ende_min "min. Einspritzendewinkel" SWORD FORMULA_0102 0 0.0 -72.0 1440.0 READ_WRITE ECU_ADDRESS 0x3FD05C /end MEASUREMENT
/begin MEASUREMENT ti_b2.phi_ende_roh "Einspritzendewinkel vor Aenderungsbegr." SWORD FORMULA_0102 0 0.0 -72.0 1440.0 READ_WRITE ECU_ADDRESS 0x3FD050 /end MEASUREMENT
/begin MEASUREMENT ti_b2.phi_ev_v "Fluggeschwindigkeit Kraftstoff" SWORD FORMULA_1172 0 0.0 0.0 220.0 READ_WRITE ECU_ADDRESS 0x3FD056 /end MEASUREMENT
/begin MEASUREMENT ti_b2.phi_ks_v "Fluggeschwindigkeit Kraftstoff" SWORD FORMULA_1172 0 0.0 0.0 220.0 READ_WRITE ECU_ADDRESS 0x3FD058 /end MEASUREMENT
/begin MEASUREMENT ti_b2.qstat_f "proportionaler Ventilparameter" UWORD FORMULA_1170 0 0.0 0.0 6.0 READ_WRITE ECU_ADDRESS 0x3FD03C /end MEASUREMENT
/begin MEASUREMENT ti_b2.rho_f "Kompensationsfak. Kraftsoffdichte" UWORD FORMULA_0806 0 0.0 0.0 511.9920959472656 READ_WRITE ECU_ADDRESS 0x3FD03A /end MEASUREMENT
/begin MEASUREMENT ti_b2.t_korr_f "saugrohrwandtemperaturabh. Faktor" UWORD FORMULA_0073 0 0.0 0.0 4.0 READ_WRITE ECU_ADDRESS 0x3FD040 /end MEASUREMENT
/begin MEASUREMENT ti_b2.ub_offs "UB-abhaengiger TI-Offset" UWORD FORMULA_0786 0 0.0 0.0 65.53500366210938 READ_WRITE ECU_ADDRESS 0x3FD03E /end MEASUREMENT
/begin MEASUREMENT ti_berech_zyl1 "TI mit allen Korrekturen" ULONG FORMULA_0363 0 0.0 0.0 655.36 READ_WRITE ECU_ADDRESS 0x3FD124 /end MEASUREMENT
/begin MEASUREMENT ti_berech_zyl10 "TI mit allen Korrekturen" ULONG FORMULA_0363 0 0.0 0.0 655.36 READ_WRITE ECU_ADDRESS 0x3FD148 /end MEASUREMENT
/begin MEASUREMENT ti_berech_zyl2 "TI mit allen Korrekturen" ULONG FORMULA_0363 0 0.0 0.0 655.36 READ_WRITE ECU_ADDRESS 0x3FD128 /end MEASUREMENT
/begin MEASUREMENT ti_berech_zyl3 "TI mit allen Korrekturen" ULONG FORMULA_0363 0 0.0 0.0 655.36 READ_WRITE ECU_ADDRESS 0x3FD12C /end MEASUREMENT
/begin MEASUREMENT ti_berech_zyl4 "TI mit allen Korrekturen" ULONG FORMULA_0363 0 0.0 0.0 655.36 READ_WRITE ECU_ADDRESS 0x3FD130 /end MEASUREMENT
/begin MEASUREMENT ti_berech_zyl5 "TI mit allen Korrekturen" ULONG FORMULA_0363 0 0.0 0.0 655.36 READ_WRITE ECU_ADDRESS 0x3FD134 /end MEASUREMENT
/begin MEASUREMENT ti_berech_zyl6 "TI mit allen Korrekturen" ULONG FORMULA_0363 0 0.0 0.0 655.36 READ_WRITE ECU_ADDRESS 0x3FD138 /end MEASUREMENT
/begin MEASUREMENT ti_berech_zyl7 "TI mit allen Korrekturen" ULONG FORMULA_0363 0 0.0 0.0 655.36 READ_WRITE ECU_ADDRESS 0x3FD13C /end MEASUREMENT
/begin MEASUREMENT ti_berech_zyl8 "TI mit allen Korrekturen" ULONG FORMULA_0363 0 0.0 0.0 655.36 READ_WRITE ECU_ADDRESS 0x3FD140 /end MEASUREMENT
/begin MEASUREMENT ti_berech_zyl9 "TI mit allen Korrekturen" ULONG FORMULA_0363 0 0.0 0.0 655.36 READ_WRITE ECU_ADDRESS 0x3FD144 /end MEASUREMENT
/begin MEASUREMENT ti_lin_offs_zyl1 "Kompensationsoffset" SWORD FORMULA_0786 0 0.0 -32.36800003051758 32.76699829101563 READ_WRITE ECU_ADDRESS 0x3FD06C /end MEASUREMENT
/begin MEASUREMENT ti_lin_offs_zyl10 "Kompensationsoffset" SWORD FORMULA_0786 0 0.0 -32.36800003051758 32.76699829101563 READ_WRITE ECU_ADDRESS 0x3FD07E /end MEASUREMENT
/begin MEASUREMENT ti_lin_offs_zyl2 "Kompensationsoffset" SWORD FORMULA_0786 0 0.0 -32.36800003051758 32.76699829101563 READ_WRITE ECU_ADDRESS 0x3FD06E /end MEASUREMENT
/begin MEASUREMENT ti_lin_offs_zyl3 "Kompensationsoffset" SWORD FORMULA_0786 0 0.0 -32.36800003051758 32.76699829101563 READ_WRITE ECU_ADDRESS 0x3FD070 /end MEASUREMENT
/begin MEASUREMENT ti_lin_offs_zyl4 "Kompensationsoffset" SWORD FORMULA_0786 0 0.0 -32.36800003051758 32.76699829101563 READ_WRITE ECU_ADDRESS 0x3FD072 /end MEASUREMENT
/begin MEASUREMENT ti_lin_offs_zyl5 "Kompensationsoffset" SWORD FORMULA_0786 0 0.0 -32.36800003051758 32.76699829101563 READ_WRITE ECU_ADDRESS 0x3FD074 /end MEASUREMENT
/begin MEASUREMENT ti_lin_offs_zyl6 "Kompensationsoffset" SWORD FORMULA_0786 0 0.0 -32.36800003051758 32.76699829101563 READ_WRITE ECU_ADDRESS 0x3FD076 /end MEASUREMENT
/begin MEASUREMENT ti_lin_offs_zyl7 "Kompensationsoffset" SWORD FORMULA_0786 0 0.0 -32.36800003051758 32.76699829101563 READ_WRITE ECU_ADDRESS 0x3FD078 /end MEASUREMENT
/begin MEASUREMENT ti_lin_offs_zyl8 "Kompensationsoffset" SWORD FORMULA_0786 0 0.0 -32.36800003051758 32.76699829101563 READ_WRITE ECU_ADDRESS 0x3FD07A /end MEASUREMENT
/begin MEASUREMENT ti_lin_offs_zyl9 "Kompensationsoffset" SWORD FORMULA_0786 0 0.0 -32.36800003051758 32.76699829101563 READ_WRITE ECU_ADDRESS 0x3FD07C /end MEASUREMENT
/begin MEASUREMENT ti_max "max. TI" ULONG FORMULA_0363 0 0.0 0.0 655.36 READ_WRITE ECU_ADDRESS 0x3FD0F8 /end MEASUREMENT
/begin MEASUREMENT ti_max_lim "ti_max f. Ermittlung von B_TIM_MAX u. Druckerhoehung" ULONG FORMULA_0363 0 0.0 0.0 655.36 READ_WRITE ECU_ADDRESS 0x3FD064 /end MEASUREMENT
/begin MEASUREMENT ti_mks_ns_grund "Grundeinspritzmasse Nachstart" UWORD FORMULA_0533 0 0.0 0.0 16383.75 READ_WRITE ECU_ADDRESS 0x3FD09E /end MEASUREMENT
/begin MEASUREMENT ti_mks_ns_ist_init_b1 "INIT - Einspritzmasse Nachstart" UWORD FORMULA_0533 0 0.0 0.0 16383.75 READ_WRITE ECU_ADDRESS 0x3FD0C8 /end MEASUREMENT
/begin MEASUREMENT ti_mks_ns_ist_init_b2 "INIT - Einspritzmasse Nachstart" UWORD FORMULA_0533 0 0.0 0.0 16383.75 READ_WRITE ECU_ADDRESS 0x3FD0CA /end MEASUREMENT
/begin MEASUREMENT ti_mks_ns_ist_zyl1 "IST-Kraftstoffmenge im NS" UWORD FORMULA_0533 0 0.0 0.0 16383.75 READ_WRITE ECU_ADDRESS 0x3FD0B4 /end MEASUREMENT
/begin MEASUREMENT ti_mks_ns_ist_zyl10 "IST-Kraftstoffmenge im NS" UWORD FORMULA_0533 0 0.0 0.0 16383.75 READ_WRITE ECU_ADDRESS 0x3FD0C6 /end MEASUREMENT
/begin MEASUREMENT ti_mks_ns_ist_zyl2 "IST-Kraftstoffmenge im NS" UWORD FORMULA_0533 0 0.0 0.0 16383.75 READ_WRITE ECU_ADDRESS 0x3FD0B6 /end MEASUREMENT
/begin MEASUREMENT ti_mks_ns_ist_zyl3 "IST-Kraftstoffmenge im NS" UWORD FORMULA_0533 0 0.0 0.0 16383.75 READ_WRITE ECU_ADDRESS 0x3FD0B8 /end MEASUREMENT
/begin MEASUREMENT ti_mks_ns_ist_zyl4 "IST-Kraftstoffmenge im NS" UWORD FORMULA_0533 0 0.0 0.0 16383.75 READ_WRITE ECU_ADDRESS 0x3FD0BA /end MEASUREMENT
/begin MEASUREMENT ti_mks_ns_ist_zyl5 "IST-Kraftstoffmenge im NS" UWORD FORMULA_0533 0 0.0 0.0 16383.75 READ_WRITE ECU_ADDRESS 0x3FD0BC /end MEASUREMENT
/begin MEASUREMENT ti_mks_ns_ist_zyl6 "IST-Kraftstoffmenge im NS" UWORD FORMULA_0533 0 0.0 0.0 16383.75 READ_WRITE ECU_ADDRESS 0x3FD0BE /end MEASUREMENT
/begin MEASUREMENT ti_mks_ns_ist_zyl7 "IST-Kraftstoffmenge im NS" UWORD FORMULA_0533 0 0.0 0.0 16383.75 READ_WRITE ECU_ADDRESS 0x3FD0C0 /end MEASUREMENT
/begin MEASUREMENT ti_mks_ns_ist_zyl8 "IST-Kraftstoffmenge im NS" UWORD FORMULA_0533 0 0.0 0.0 16383.75 READ_WRITE ECU_ADDRESS 0x3FD0C2 /end MEASUREMENT
/begin MEASUREMENT ti_mks_ns_ist_zyl9 "IST-Kraftstoffmenge im NS" UWORD FORMULA_0533 0 0.0 0.0 16383.75 READ_WRITE ECU_ADDRESS 0x3FD0C4 /end MEASUREMENT
/begin MEASUREMENT ti_mks_ns_rel_zyl1 "rel. Kraftstoffeintrag in NS" UWORD FORMULA_0073 0 0.0 0.0 4.0 READ_WRITE ECU_ADDRESS 0x3FD0CC /end MEASUREMENT
/begin MEASUREMENT ti_mks_ns_rel_zyl10 "rel. Kraftstoffeintrag in NS" UWORD FORMULA_0073 0 0.0 0.0 4.0 READ_WRITE ECU_ADDRESS 0x3FD0DE /end MEASUREMENT
/begin MEASUREMENT ti_mks_ns_rel_zyl2 "rel. Kraftstoffeintrag in NS" UWORD FORMULA_0073 0 0.0 0.0 4.0 READ_WRITE ECU_ADDRESS 0x3FD0CE /end MEASUREMENT
/begin MEASUREMENT ti_mks_ns_rel_zyl3 "rel. Kraftstoffeintrag in NS" UWORD FORMULA_0073 0 0.0 0.0 4.0 READ_WRITE ECU_ADDRESS 0x3FD0D0 /end MEASUREMENT
/begin MEASUREMENT ti_mks_ns_rel_zyl4 "rel. Kraftstoffeintrag in NS" UWORD FORMULA_0073 0 0.0 0.0 4.0 READ_WRITE ECU_ADDRESS 0x3FD0D2 /end MEASUREMENT
/begin MEASUREMENT ti_mks_ns_rel_zyl5 "rel. Kraftstoffeintrag in NS" UWORD FORMULA_0073 0 0.0 0.0 4.0 READ_WRITE ECU_ADDRESS 0x3FD0D4 /end MEASUREMENT
/begin MEASUREMENT ti_mks_ns_rel_zyl6 "rel. Kraftstoffeintrag in NS" UWORD FORMULA_0073 0 0.0 0.0 4.0 READ_WRITE ECU_ADDRESS 0x3FD0D6 /end MEASUREMENT
/begin MEASUREMENT ti_mks_ns_rel_zyl7 "rel. Kraftstoffeintrag in NS" UWORD FORMULA_0073 0 0.0 0.0 4.0 READ_WRITE ECU_ADDRESS 0x3FD0D8 /end MEASUREMENT
/begin MEASUREMENT ti_mks_ns_rel_zyl8 "rel. Kraftstoffeintrag in NS" UWORD FORMULA_0073 0 0.0 0.0 4.0 READ_WRITE ECU_ADDRESS 0x3FD0DA /end MEASUREMENT
/begin MEASUREMENT ti_mks_ns_rel_zyl9 "rel. Kraftstoffeintrag in NS" UWORD FORMULA_0073 0 0.0 0.0 4.0 READ_WRITE ECU_ADDRESS 0x3FD0DC /end MEASUREMENT
/begin MEASUREMENT ti_mks_ns_zyl1 "Einspritzmasse Nachstart" UWORD FORMULA_0111 0 0.0 0.0 1023.984313964844 READ_WRITE ECU_ADDRESS 0x3FD0A0 /end MEASUREMENT
/begin MEASUREMENT ti_mks_ns_zyl10 "Einspritzmasse Nachstart" UWORD FORMULA_0111 0 0.0 0.0 1023.984313964844 READ_WRITE ECU_ADDRESS 0x3FD0B2 /end MEASUREMENT
/begin MEASUREMENT ti_mks_ns_zyl2 "Einspritzmasse Nachstart" UWORD FORMULA_0111 0 0.0 0.0 1023.984313964844 READ_WRITE ECU_ADDRESS 0x3FD0A2 /end MEASUREMENT
/begin MEASUREMENT ti_mks_ns_zyl3 "Einspritzmasse Nachstart" UWORD FORMULA_0111 0 0.0 0.0 1023.984313964844 READ_WRITE ECU_ADDRESS 0x3FD0A4 /end MEASUREMENT
/begin MEASUREMENT ti_mks_ns_zyl4 "Einspritzmasse Nachstart" UWORD FORMULA_0111 0 0.0 0.0 1023.984313964844 READ_WRITE ECU_ADDRESS 0x3FD0A6 /end MEASUREMENT
/begin MEASUREMENT ti_mks_ns_zyl5 "Einspritzmasse Nachstart" UWORD FORMULA_0111 0 0.0 0.0 1023.984313964844 READ_WRITE ECU_ADDRESS 0x3FD0A8 /end MEASUREMENT
/begin MEASUREMENT ti_mks_ns_zyl6 "Einspritzmasse Nachstart" UWORD FORMULA_0111 0 0.0 0.0 1023.984313964844 READ_WRITE ECU_ADDRESS 0x3FD0AA /end MEASUREMENT
/begin MEASUREMENT ti_mks_ns_zyl7 "Einspritzmasse Nachstart" UWORD FORMULA_0111 0 0.0 0.0 1023.984313964844 READ_WRITE ECU_ADDRESS 0x3FD0AC /end MEASUREMENT
/begin MEASUREMENT ti_mks_ns_zyl8 "Einspritzmasse Nachstart" UWORD FORMULA_0111 0 0.0 0.0 1023.984313964844 READ_WRITE ECU_ADDRESS 0x3FD0AE /end MEASUREMENT
/begin MEASUREMENT ti_mks_ns_zyl9 "Einspritzmasse Nachstart" UWORD FORMULA_0111 0 0.0 0.0 1023.984313964844 READ_WRITE ECU_ADDRESS 0x3FD0B0 /end MEASUREMENT
/begin MEASUREMENT ti_mks_soll_zyl1 "SOLL-Einspritzmasse" UWORD FORMULA_0111 0 0.0 0.0 1023.984313964844 READ_WRITE ECU_ADDRESS 0x3FD08A /end MEASUREMENT
/begin MEASUREMENT ti_mks_soll_zyl10 "SOLL-Einspritzmasse" UWORD FORMULA_0111 0 0.0 0.0 1023.984313964844 READ_WRITE ECU_ADDRESS 0x3FD09C /end MEASUREMENT
/begin MEASUREMENT ti_mks_soll_zyl2 "SOLL-Einspritzmasse" UWORD FORMULA_0111 0 0.0 0.0 1023.984313964844 READ_WRITE ECU_ADDRESS 0x3FD08C /end MEASUREMENT
/begin MEASUREMENT ti_mks_soll_zyl3 "SOLL-Einspritzmasse" UWORD FORMULA_0111 0 0.0 0.0 1023.984313964844 READ_WRITE ECU_ADDRESS 0x3FD08E /end MEASUREMENT
/begin MEASUREMENT ti_mks_soll_zyl4 "SOLL-Einspritzmasse" UWORD FORMULA_0111 0 0.0 0.0 1023.984313964844 READ_WRITE ECU_ADDRESS 0x3FD090 /end MEASUREMENT
/begin MEASUREMENT ti_mks_soll_zyl5 "SOLL-Einspritzmasse" UWORD FORMULA_0111 0 0.0 0.0 1023.984313964844 READ_WRITE ECU_ADDRESS 0x3FD092 /end MEASUREMENT
/begin MEASUREMENT ti_mks_soll_zyl6 "SOLL-Einspritzmasse" UWORD FORMULA_0111 0 0.0 0.0 1023.984313964844 READ_WRITE ECU_ADDRESS 0x3FD094 /end MEASUREMENT
/begin MEASUREMENT ti_mks_soll_zyl7 "SOLL-Einspritzmasse" UWORD FORMULA_0111 0 0.0 0.0 1023.984313964844 READ_WRITE ECU_ADDRESS 0x3FD096 /end MEASUREMENT
/begin MEASUREMENT ti_mks_soll_zyl8 "SOLL-Einspritzmasse" UWORD FORMULA_0111 0 0.0 0.0 1023.984313964844 READ_WRITE ECU_ADDRESS 0x3FD098 /end MEASUREMENT
/begin MEASUREMENT ti_mks_soll_zyl9 "SOLL-Einspritzmasse" UWORD FORMULA_0111 0 0.0 0.0 1023.984313964844 READ_WRITE ECU_ADDRESS 0x3FD09A /end MEASUREMENT
/begin MEASUREMENT ti_mks_start "START-Grundeinspritzmasse" UWORD FORMULA_0111 0 0.0 0.0 1023.984313964844 READ_WRITE ECU_ADDRESS 0x3FD084 /end MEASUREMENT
/begin MEASUREMENT ti_mks_start_korr "druckkorr. START-Grundkennfeldwert" UWORD FORMULA_0111 0 0.0 0.0 1023.984313964844 READ_WRITE ECU_ADDRESS 0x3FD082 /end MEASUREMENT
/begin MEASUREMENT ti_mks_start_roh "START-Grundkennfeldwert" UWORD FORMULA_0111 0 0.0 0.0 1023.984313964844 READ_WRITE ECU_ADDRESS 0x3FD080 /end MEASUREMENT
/begin MEASUREMENT ti_ns_f "Nachstartfaktor auf Grundeinspritzmenge" UWORD FORMULA_0073 0 0.0 0.0 4.0 READ_WRITE ECU_ADDRESS 0x3FD0F4 /end MEASUREMENT
/begin MEASUREMENT ti_nw_asp_cnt "720° Arbeitsspielzaehler - aktueller Motorlauf" SWORD FORMULA_0010 0 0.0 0.0 32767.0 READ_WRITE ECU_ADDRESS 0x3FD0F6 /end MEASUREMENT
/begin MEASUREMENT ti_off_exd "TI-OFF-Status - externe Anforderung" UWORD FORMULA_0010 0 0.0 0.0 65535.0 READ_WRITE ECU_ADDRESS 0x3FD1D4 /end MEASUREMENT
/begin MEASUREMENT ti_off_exd_timeout "KWP-Ansteuerzeit" UWORD FORMULA_1022 0 0.0 0.0 65.53500366210938 READ_WRITE ECU_ADDRESS 0x3FD1D6 /end MEASUREMENT
/begin MEASUREMENT ti_out_zyl1 "Ausgegebene Einspritzzeit im letzten Arbeitsspiel." ULONG FORMULA_0363 0 0.0 4194.303 0.0 READ_WRITE ECU_ADDRESS 0x3FD194 /end MEASUREMENT
/begin MEASUREMENT ti_out_zyl10 "Ausgegebene Einspritzzeit im letzten Arbeitsspiel." ULONG FORMULA_0363 0 0.0 4194.303 0.0 READ_WRITE ECU_ADDRESS 0x3FD1B8 /end MEASUREMENT
/begin MEASUREMENT ti_out_zyl2 "Ausgegebene Einspritzzeit im letzten Arbeitsspiel." ULONG FORMULA_0363 0 0.0 4194.303 0.0 READ_WRITE ECU_ADDRESS 0x3FD198 /end MEASUREMENT
/begin MEASUREMENT ti_out_zyl3 "Ausgegebene Einspritzzeit im letzten Arbeitsspiel." ULONG FORMULA_0363 0 0.0 4194.303 0.0 READ_WRITE ECU_ADDRESS 0x3FD19C /end MEASUREMENT
/begin MEASUREMENT ti_out_zyl4 "Ausgegebene Einspritzzeit im letzten Arbeitsspiel." ULONG FORMULA_0363 0 0.0 4194.303 0.0 READ_WRITE ECU_ADDRESS 0x3FD1A0 /end MEASUREMENT
/begin MEASUREMENT ti_out_zyl5 "Ausgegebene Einspritzzeit im letzten Arbeitsspiel." ULONG FORMULA_0363 0 0.0 4194.303 0.0 READ_WRITE ECU_ADDRESS 0x3FD1A4 /end MEASUREMENT
/begin MEASUREMENT ti_out_zyl6 "Ausgegebene Einspritzzeit im letzten Arbeitsspiel." ULONG FORMULA_0363 0 0.0 4194.303 0.0 READ_WRITE ECU_ADDRESS 0x3FD1A8 /end MEASUREMENT
/begin MEASUREMENT ti_out_zyl7 "Ausgegebene Einspritzzeit im letzten Arbeitsspiel." ULONG FORMULA_0363 0 0.0 4194.303 0.0 READ_WRITE ECU_ADDRESS 0x3FD1AC /end MEASUREMENT
/begin MEASUREMENT ti_out_zyl8 "Ausgegebene Einspritzzeit im letzten Arbeitsspiel." ULONG FORMULA_0363 0 0.0 4194.303 0.0 READ_WRITE ECU_ADDRESS 0x3FD1B0 /end MEASUREMENT
/begin MEASUREMENT ti_out_zyl9 "Ausgegebene Einspritzzeit im letzten Arbeitsspiel." ULONG FORMULA_0363 0 0.0 4194.303 0.0 READ_WRITE ECU_ADDRESS 0x3FD1B4 /end MEASUREMENT
/begin MEASUREMENT ti_phi_ende_offs_b1 "Offset Einspritzendewinkel" SWORD FORMULA_0102 0 0.0 -720.0 720.0 READ_WRITE ECU_ADDRESS 0x3FD18A /end MEASUREMENT
/begin MEASUREMENT ti_phi_ende_offs_b2 "Offset Einspritzendewinkel" SWORD FORMULA_0102 0 0.0 -720.0 720.0 READ_WRITE ECU_ADDRESS 0x3FD18C /end MEASUREMENT
/begin MEASUREMENT ti_phi_ende_start "ti_ende im START" SWORD FORMULA_0102 0 0.0 -72.0 1440.0 READ_WRITE ECU_ADDRESS 0x3FD188 /end MEASUREMENT
/begin MEASUREMENT ti_phi_ev_v_wurz "Beschleunigung Kraftstoff" UWORD FORMULA_1173 0 0.0 0.0 1638.375 READ_WRITE ECU_ADDRESS 0x3FD190 /end MEASUREMENT
/begin MEASUREMENT ti_phi_flug_v "Fluggeschwindigkeit Kraftstoff" SWORD FORMULA_1172 0 0.0 0.0 220.0 READ_WRITE ECU_ADDRESS 0x3FD18E /end MEASUREMENT
/begin MEASUREMENT ti_rf_max_dly "Verzoegerungszeit ueber Anzahl Segmente" UWORD FORMULA_1175 0 0.0 0.0 65535.0 READ_WRITE ECU_ADDRESS 0x3FD1D8 /end MEASUREMENT
/begin MEASUREMENT ti_seg_time_f_zyl1 "Nachstart-Manipulationsfaktor" UWORD FORMULA_0073 0 0.0 0.0 4.0 READ_WRITE ECU_ADDRESS 0x3FD0E0 /end MEASUREMENT
/begin MEASUREMENT ti_seg_time_f_zyl10 "Nachstart-Manipulationsfaktor" UWORD FORMULA_0073 0 0.0 0.0 4.0 READ_WRITE ECU_ADDRESS 0x3FD0F2 /end MEASUREMENT
/begin MEASUREMENT ti_seg_time_f_zyl2 "Nachstart-Manipulationsfaktor" UWORD FORMULA_0073 0 0.0 0.0 4.0 READ_WRITE ECU_ADDRESS 0x3FD0E2 /end MEASUREMENT
/begin MEASUREMENT ti_seg_time_f_zyl3 "Nachstart-Manipulationsfaktor" UWORD FORMULA_0073 0 0.0 0.0 4.0 READ_WRITE ECU_ADDRESS 0x3FD0E4 /end MEASUREMENT
/begin MEASUREMENT ti_seg_time_f_zyl4 "Nachstart-Manipulationsfaktor" UWORD FORMULA_0073 0 0.0 0.0 4.0 READ_WRITE ECU_ADDRESS 0x3FD0E6 /end MEASUREMENT
/begin MEASUREMENT ti_seg_time_f_zyl5 "Nachstart-Manipulationsfaktor" UWORD FORMULA_0073 0 0.0 0.0 4.0 READ_WRITE ECU_ADDRESS 0x3FD0E8 /end MEASUREMENT
/begin MEASUREMENT ti_seg_time_f_zyl6 "Nachstart-Manipulationsfaktor" UWORD FORMULA_0073 0 0.0 0.0 4.0 READ_WRITE ECU_ADDRESS 0x3FD0EA /end MEASUREMENT
/begin MEASUREMENT ti_seg_time_f_zyl7 "Nachstart-Manipulationsfaktor" UWORD FORMULA_0073 0 0.0 0.0 4.0 READ_WRITE ECU_ADDRESS 0x3FD0EC /end MEASUREMENT
/begin MEASUREMENT ti_seg_time_f_zyl8 "Nachstart-Manipulationsfaktor" UWORD FORMULA_0073 0 0.0 0.0 4.0 READ_WRITE ECU_ADDRESS 0x3FD0EE /end MEASUREMENT
/begin MEASUREMENT ti_seg_time_f_zyl9 "Nachstart-Manipulationsfaktor" UWORD FORMULA_0073 0 0.0 0.0 4.0 READ_WRITE ECU_ADDRESS 0x3FD0F0 /end MEASUREMENT
/begin MEASUREMENT ti_segm_cnt "TI Segmentzaehler" UWORD FORMULA_0010 0 0.0 0.0 65535.0 READ_WRITE ECU_ADDRESS 0x3FD06A /end MEASUREMENT
/begin MEASUREMENT ti_soll_zyl1 "SOLL-TI ohne Korrekturen" ULONG FORMULA_0363 0 0.0 0.0 655.36 READ_WRITE ECU_ADDRESS 0x3FD0FC /end MEASUREMENT
/begin MEASUREMENT ti_soll_zyl10 "SOLL-TI ohne Korrekturen" ULONG FORMULA_0363 0 0.0 0.0 655.36 READ_WRITE ECU_ADDRESS 0x3FD120 /end MEASUREMENT
/begin MEASUREMENT ti_soll_zyl2 "SOLL-TI ohne Korrekturen" ULONG FORMULA_0363 0 0.0 0.0 655.36 READ_WRITE ECU_ADDRESS 0x3FD100 /end MEASUREMENT
/begin MEASUREMENT ti_soll_zyl3 "SOLL-TI ohne Korrekturen" ULONG FORMULA_0363 0 0.0 0.0 655.36 READ_WRITE ECU_ADDRESS 0x3FD104 /end MEASUREMENT
/begin MEASUREMENT ti_soll_zyl4 "SOLL-TI ohne Korrekturen" ULONG FORMULA_0363 0 0.0 0.0 655.36 READ_WRITE ECU_ADDRESS 0x3FD108 /end MEASUREMENT
/begin MEASUREMENT ti_soll_zyl5 "SOLL-TI ohne Korrekturen" ULONG FORMULA_0363 0 0.0 0.0 655.36 READ_WRITE ECU_ADDRESS 0x3FD10C /end MEASUREMENT
/begin MEASUREMENT ti_soll_zyl6 "SOLL-TI ohne Korrekturen" ULONG FORMULA_0363 0 0.0 0.0 655.36 READ_WRITE ECU_ADDRESS 0x3FD110 /end MEASUREMENT
/begin MEASUREMENT ti_soll_zyl7 "SOLL-TI ohne Korrekturen" ULONG FORMULA_0363 0 0.0 0.0 655.36 READ_WRITE ECU_ADDRESS 0x3FD114 /end MEASUREMENT
/begin MEASUREMENT ti_soll_zyl8 "SOLL-TI ohne Korrekturen" ULONG FORMULA_0363 0 0.0 0.0 655.36 READ_WRITE ECU_ADDRESS 0x3FD118 /end MEASUREMENT
/begin MEASUREMENT ti_soll_zyl9 "SOLL-TI ohne Korrekturen" ULONG FORMULA_0363 0 0.0 0.0 655.36 READ_WRITE ECU_ADDRESS 0x3FD11C /end MEASUREMENT
/begin MEASUREMENT ti_start_f "Abregelfaktor im START" UWORD FORMULA_0073 0 0.0 0.0 4.0 READ_WRITE ECU_ADDRESS 0x3FD088 /end MEASUREMENT
/begin MEASUREMENT ti_start_pumg_f "Umgebungsdruckwichtung im START" UWORD FORMULA_0073 0 0.0 0.0 4.0 READ_WRITE ECU_ADDRESS 0x3FD086 /end MEASUREMENT
/begin MEASUREMENT ti_status "TI-Status" UWORD FORMULA_0080 0 0.0 0.0 65535.0 READ_WRITE ECU_ADDRESS 0x3FD1C6 /end MEASUREMENT
/begin MEASUREMENT ti_status_aus_auss "TI-Ausblendung - Aussetzer" UWORD FORMULA_0844 0 0 0.0 255.0 READ_WRITE BIT_MASK 0x8 ECU_ADDRESS 0x3FD1C6 /end MEASUREMENT
/begin MEASUREMENT ti_status_aus_egas "TI-Ausblendung - EGAS" UWORD FORMULA_0770 0 0 0.0 255.0 READ_WRITE BIT_MASK 0x20 ECU_ADDRESS 0x3FD1C6 /end MEASUREMENT
/begin MEASUREMENT ti_status_aus_md "TI-Ausblendung - Teilfeuerung" UWORD FORMULA_0827 0 0 0.0 255.0 READ_WRITE BIT_MASK 0x80 ECU_ADDRESS 0x3FD1C6 /end MEASUREMENT
/begin MEASUREMENT ti_status_aus_sk "TI-Ausblendung - Sicherheitsmanager" UWORD FORMULA_0769 0 0 0.0 255.0 READ_WRITE BIT_MASK 0x10 ECU_ADDRESS 0x3FD1C6 /end MEASUREMENT
/begin MEASUREMENT ti_status_aus_ti "reine TI-Komplettausblendung" UWORD FORMULA_0885 0 0 0.0 255.0 READ_WRITE BIT_MASK 0x1 ECU_ADDRESS 0x3FD1C6 /end MEASUREMENT
/begin MEASUREMENT ti_status_aus_ti_tz "TI/TZ-Komplettausblendung" UWORD FORMULA_0843 0 0 0.0 255.0 READ_WRITE BIT_MASK 0x2 ECU_ADDRESS 0x3FD1C6 /end MEASUREMENT
/begin MEASUREMENT ti_status_aus_treiber "TI-Ausblendung - Treiberdiagnose" UWORD FORMULA_0767 0 0 0.0 255.0 READ_WRITE BIT_MASK 0x4 ECU_ADDRESS 0x3FD1C6 /end MEASUREMENT
/begin MEASUREMENT ti_status_off_cfg "TI-Ausblendung - ueber CFG" UWORD FORMULA_1174 0 0 0.0 255.0 READ_WRITE BIT_MASK 0x40 ECU_ADDRESS 0x3FD1C6 /end MEASUREMENT
/begin MEASUREMENT ti_status_off_exd "TI-Ausblendung - externe Anforderung" UWORD FORMULA_0771 0 0 0.0 255.0 READ_WRITE BIT_MASK 0x100 ECU_ADDRESS 0x3FD1C6 /end MEASUREMENT
/begin MEASUREMENT ti_tpu_start "TI-TPU-Start-Status" UWORD FORMULA_0010 0 0.0 0.0 65535.0 READ_WRITE ECU_ADDRESS 0x3FD068 /end MEASUREMENT
/begin MEASUREMENT ti_tpu_zyl1 "begrenztes, ausgegebenes TI" ULONG FORMULA_0363 0 0.0 0.0 655.36 READ_WRITE ECU_ADDRESS 0x3FD14C /end MEASUREMENT
/begin MEASUREMENT ti_tpu_zyl10 "begrenztes, ausgegebenes TI" ULONG FORMULA_0363 0 0.0 0.0 655.36 READ_WRITE ECU_ADDRESS 0x3FD170 /end MEASUREMENT
/begin MEASUREMENT ti_tpu_zyl2 "begrenztes, ausgegebenes TI" ULONG FORMULA_0363 0 0.0 0.0 655.36 READ_WRITE ECU_ADDRESS 0x3FD150 /end MEASUREMENT
/begin MEASUREMENT ti_tpu_zyl3 "begrenztes, ausgegebenes TI" ULONG FORMULA_0363 0 0.0 0.0 655.36 READ_WRITE ECU_ADDRESS 0x3FD154 /end MEASUREMENT
/begin MEASUREMENT ti_tpu_zyl4 "begrenztes, ausgegebenes TI" ULONG FORMULA_0363 0 0.0 0.0 655.36 READ_WRITE ECU_ADDRESS 0x3FD158 /end MEASUREMENT
/begin MEASUREMENT ti_tpu_zyl5 "begrenztes, ausgegebenes TI" ULONG FORMULA_0363 0 0.0 0.0 655.36 READ_WRITE ECU_ADDRESS 0x3FD15C /end MEASUREMENT
/begin MEASUREMENT ti_tpu_zyl6 "begrenztes, ausgegebenes TI" ULONG FORMULA_0363 0 0.0 0.0 655.36 READ_WRITE ECU_ADDRESS 0x3FD160 /end MEASUREMENT
/begin MEASUREMENT ti_tpu_zyl7 "begrenztes, ausgegebenes TI" ULONG FORMULA_0363 0 0.0 0.0 655.36 READ_WRITE ECU_ADDRESS 0x3FD164 /end MEASUREMENT
/begin MEASUREMENT ti_tpu_zyl8 "begrenztes, ausgegebenes TI" ULONG FORMULA_0363 0 0.0 0.0 655.36 READ_WRITE ECU_ADDRESS 0x3FD168 /end MEASUREMENT
/begin MEASUREMENT ti_tpu_zyl9 "begrenztes, ausgegebenes TI" ULONG FORMULA_0363 0 0.0 0.0 655.36 READ_WRITE ECU_ADDRESS 0x3FD16C /end MEASUREMENT
/begin MEASUREMENT ti_tu_f_n_sst10 "SST" ULONG FORMULA_0000 0 0.0 0.0 4294967295.0 READ_WRITE ECU_ADDRESS 0x3FD26C /end MEASUREMENT
/begin MEASUREMENT ti_tu_f_rf_sst4_b1 "SST" ULONG FORMULA_0000 0 0.0 0.0 4294967295.0 READ_WRITE ECU_ADDRESS 0x3FD270 /end MEASUREMENT
/begin MEASUREMENT ti_tu_f_rf_sst4_b2 "SST" ULONG FORMULA_0000 0 0.0 0.0 4294967295.0 READ_WRITE ECU_ADDRESS 0x3FD274 /end MEASUREMENT
/begin MEASUREMENT ti_tu_f_zyl_zyl1 "zylinderabhaengiger Tuningfaktor" UWORD FORMULA_0073 0 0.0 0.0 4.0 READ_WRITE ECU_ADDRESS 0x3FD174 /end MEASUREMENT
/begin MEASUREMENT ti_tu_f_zyl_zyl10 "zylinderabhaengiger Tuningfaktor" UWORD FORMULA_0073 0 0.0 0.0 4.0 READ_WRITE ECU_ADDRESS 0x3FD186 /end MEASUREMENT
/begin MEASUREMENT ti_tu_f_zyl_zyl2 "zylinderabhaengiger Tuningfaktor" UWORD FORMULA_0073 0 0.0 0.0 4.0 READ_WRITE ECU_ADDRESS 0x3FD176 /end MEASUREMENT
/begin MEASUREMENT ti_tu_f_zyl_zyl3 "zylinderabhaengiger Tuningfaktor" UWORD FORMULA_0073 0 0.0 0.0 4.0 READ_WRITE ECU_ADDRESS 0x3FD178 /end MEASUREMENT
/begin MEASUREMENT ti_tu_f_zyl_zyl4 "zylinderabhaengiger Tuningfaktor" UWORD FORMULA_0073 0 0.0 0.0 4.0 READ_WRITE ECU_ADDRESS 0x3FD17A /end MEASUREMENT
/begin MEASUREMENT ti_tu_f_zyl_zyl5 "zylinderabhaengiger Tuningfaktor" UWORD FORMULA_0073 0 0.0 0.0 4.0 READ_WRITE ECU_ADDRESS 0x3FD17C /end MEASUREMENT
/begin MEASUREMENT ti_tu_f_zyl_zyl6 "zylinderabhaengiger Tuningfaktor" UWORD FORMULA_0073 0 0.0 0.0 4.0 READ_WRITE ECU_ADDRESS 0x3FD17E /end MEASUREMENT
/begin MEASUREMENT ti_tu_f_zyl_zyl7 "zylinderabhaengiger Tuningfaktor" UWORD FORMULA_0073 0 0.0 0.0 4.0 READ_WRITE ECU_ADDRESS 0x3FD180 /end MEASUREMENT
/begin MEASUREMENT ti_tu_f_zyl_zyl8 "zylinderabhaengiger Tuningfaktor" UWORD FORMULA_0073 0 0.0 0.0 4.0 READ_WRITE ECU_ADDRESS 0x3FD182 /end MEASUREMENT
/begin MEASUREMENT ti_tu_f_zyl_zyl9 "zylinderabhaengiger Tuningfaktor" UWORD FORMULA_0073 0 0.0 0.0 4.0 READ_WRITE ECU_ADDRESS 0x3FD184 /end MEASUREMENT
/begin MEASUREMENT ti_wl_f_b1 "Warmlauffaktor auf TI" UWORD FORMULA_0073 0 0.0 0.0 4.0 READ_WRITE ECU_ADDRESS 0x3FD1D0 /end MEASUREMENT
/begin MEASUREMENT ti_wl_f_b2 "Warmlauffaktor auf TI" UWORD FORMULA_0073 0 0.0 0.0 4.0 READ_WRITE ECU_ADDRESS 0x3FD1D2 /end MEASUREMENT
/begin MEASUREMENT ti_wl_f_kh_b1 "Warmlauffaktor auf TI waehrend KH" UWORD FORMULA_0073 0 0.0 0.0 4.0 READ_WRITE ECU_ADDRESS 0x3FD1CC /end MEASUREMENT
/begin MEASUREMENT ti_wl_f_kh_b2 "Warmlauffaktor auf TI waehrend KH" UWORD FORMULA_0073 0 0.0 0.0 4.0 READ_WRITE ECU_ADDRESS 0x3FD1CE /end MEASUREMENT
/begin MEASUREMENT ti_wl_f_roh_b1 "ROH-Warmlauffaktor auf TI" UWORD FORMULA_0073 0 0.0 0.0 4.0 READ_WRITE ECU_ADDRESS 0x3FD1C8 /end MEASUREMENT
/begin MEASUREMENT ti_wl_f_roh_b2 "ROH-Warmlauffaktor auf TI" UWORD FORMULA_0073 0 0.0 0.0 4.0 READ_WRITE ECU_ADDRESS 0x3FD1CA /end MEASUREMENT
/begin MEASUREMENT zgla_f_i_ant "Integratoranteil - Zylindergleichstellung" SWORD FORMULA_0024 0 0.0 -1.0 0.9998999834060669 READ_WRITE ARRAY_SIZE 10 ECU_ADDRESS 0x3FD20C MATRIX_DIM 10 1 1 /end MEASUREMENT
/begin MEASUREMENT zgla_lam_delta "Delta Einzellambda zu Lambdamittelwert" SWORD FORMULA_0025 0 0.0 -2.0 1.999899983406067 READ_WRITE ARRAY_SIZE 10 ECU_ADDRESS 0x3FD1E0 MATRIX_DIM 10 1 1 /end MEASUREMENT
/begin MEASUREMENT zgla_lam_delta_filt_b1 "gefiltertes Delta Einzellambda zu Lambdamittelwert" SWORD FORMULA_0025 0 0.0 -2.0 1.999899983406067 READ_WRITE ARRAY_SIZE 5 ECU_ADDRESS 0x3FD1F4 MATRIX_DIM 5 1 1 /end MEASUREMENT
/begin MEASUREMENT zgla_lam_delta_filt_b2 "gefiltertes Delta Einzellambda zu Lambdamittelwert" SWORD FORMULA_0025 0 0.0 -2.0 1.999899983406067 READ_WRITE ARRAY_SIZE 5 ECU_ADDRESS 0x3FD1FE MATRIX_DIM 5 1 1 /end MEASUREMENT
/begin MEASUREMENT zgla_lam_filt_konst_b1 "Filterkonstante - Zylindergleichstellung" UWORD FORMULA_0762 0 0.0 0.0 7.999800205230713 READ_WRITE ECU_ADDRESS 0x3FD208 /end MEASUREMENT
/begin MEASUREMENT zgla_lam_filt_konst_b2 "Filterkonstante - Zylindergleichstellung" UWORD FORMULA_0762 0 0.0 0.0 7.999800205230713 READ_WRITE ECU_ADDRESS 0x3FD20A /end MEASUREMENT
/begin MEASUREMENT zgla_st "Status Zylindergleichstellung" UWORD FORMULA_0080 0 0.0 0.0 65535.0 READ_WRITE ECU_ADDRESS 0x3FD1DA /end MEASUREMENT
/begin MEASUREMENT zgla_st_f_max "Zylindergleichstellung - max. Begrenzung" UWORD FORMULA_1177 0 0 0.0 255.0 READ_WRITE BIT_MASK 0x2 ECU_ADDRESS 0x3FD1DA /end MEASUREMENT
/begin MEASUREMENT zgla_st_f_min "Zylindergleichstellung - min. Begrenzung" UWORD FORMULA_1178 0 0 0.0 255.0 READ_WRITE BIT_MASK 0x4 ECU_ADDRESS 0x3FD1DA /end MEASUREMENT
/begin MEASUREMENT zgla_st_freigabe "Freigabe Zylindergleichstellung" UWORD FORMULA_1176 0 0 0.0 255.0 READ_WRITE BIT_MASK 0x1 ECU_ADDRESS 0x3FD1DA /end MEASUREMENT
/begin MEASUREMENT zgla_zyl_nr_b1 "zu aktualisierender Zylinder" UWORD FORMULA_1179 0 0.0 0.0 4.0 READ_WRITE ECU_ADDRESS 0x3FD1DC /end MEASUREMENT
/begin MEASUREMENT zgla_zyl_nr_b2 "zu aktualisierender Zylinder" UWORD FORMULA_1179 0 0.0 0.0 4.0 READ_WRITE ECU_ADDRESS 0x3FD1DE /end MEASUREMENT
/begin COMPU_METHOD FORMULA_0000 "FORMULA_0000" RAT_FUNC "%7.0" "-" COEFFS 0 1 0 0 0 1 /end COMPU_METHOD
/begin COMPU_METHOD FORMULA_0003 "FORMULA_0003" RAT_FUNC "%3.0" "-" COEFFS 0 1 0 0 0 1 /end COMPU_METHOD
/begin COMPU_METHOD FORMULA_0006 "FORMULA_0006" RAT_FUNC "%5.0" "Upm" COEFFS 0 1 0 0 0 1 /end COMPU_METHOD
/begin COMPU_METHOD FORMULA_0007 "FORMULA_0007" RAT_FUNC "%8.3" "-" COEFFS 0 10000.0 0.0 0 0.0 1.0 /end COMPU_METHOD
/begin COMPU_METHOD FORMULA_0008 "FORMULA_0008" RAT_FUNC "%6.1" "V" COEFFS 0 10.0 0.0 0 0.0 1.0 /end COMPU_METHOD
/begin COMPU_METHOD FORMULA_0010 "FORMULA_0010" RAT_FUNC "%5.0" "-" COEFFS 0 1 0 0 0 1 /end COMPU_METHOD
/begin COMPU_METHOD FORMULA_0021 "FORMULA_0021" RAT_FUNC "%7.2" "s" COEFFS 0 100.0 0.0 0 0.0 1.0 /end COMPU_METHOD
/begin COMPU_METHOD FORMULA_0023 "FORMULA_0023" RAT_FUNC "%6.1" "°C" COEFFS 0 10.0 2732.0 0 0.0 1.0 /end COMPU_METHOD
/begin COMPU_METHOD FORMULA_0024 "FORMULA_0024" RAT_FUNC "%9.4" "-" COEFFS 0 32768.0 0.0 0 0.0 1.0 /end COMPU_METHOD
/begin COMPU_METHOD FORMULA_0025 "FORMULA_0025" RAT_FUNC "%8.3" "-" COEFFS 0 16384.0 0.0 0 0.0 1.0 /end COMPU_METHOD
/begin COMPU_METHOD FORMULA_0032 "FORMULA_0032" RAT_FUNC "%3.0" "%" COEFFS 0 1 0 0 0 1 /end COMPU_METHOD
/begin COMPU_METHOD FORMULA_0044 "FORMULA_0044" RAT_FUNC "%9.2" "-" COEFFS 0 1 0 0 0 1 /end COMPU_METHOD
/begin COMPU_METHOD FORMULA_0073 "FORMULA_0073" RAT_FUNC "%8.3" "-" COEFFS 0 1024.0 0.0 0 0.0 1.0 /end COMPU_METHOD
/begin COMPU_METHOD FORMULA_0074 "FORMULA_0074" RAT_FUNC "%6.1" "Kelvin" COEFFS 0 10.0 0.0 0 0.0 1.0 /end COMPU_METHOD
/begin COMPU_METHOD FORMULA_0075 "FORMULA_0075" RAT_FUNC "%6.1" "mbar" COEFFS 0 16.0 0.0 0 0.0 1.0 /end COMPU_METHOD
/begin COMPU_METHOD FORMULA_0076 "FORMULA_0076" RAT_FUNC "%6.1" "km/h" COEFFS 0 16.0 0.0 0 0.0 1.0 /end COMPU_METHOD
/begin COMPU_METHOD FORMULA_0080 "FORMULA_0080" RAT_FUNC "%7.2" "-" COEFFS 0 1 0 0 0 1 /end COMPU_METHOD
/begin COMPU_METHOD FORMULA_0090 "FORMULA_0090" RAT_FUNC "%7.2" "mg" COEFFS 0 10.0 0.0 0 0.0 1.0 /end COMPU_METHOD
/begin COMPU_METHOD FORMULA_0102 "FORMULA_0102" RAT_FUNC "%6.1" "°KW" COEFFS 0 10.0 0.0 0 0.0 1.0 /end COMPU_METHOD
/begin COMPU_METHOD FORMULA_0106 "FORMULA_0106" RAT_FUNC "%7.2" "%" COEFFS 0 163.84 0.0 0 0.0 1.0 /end COMPU_METHOD
/begin COMPU_METHOD FORMULA_0110 "FORMULA_0110" RAT_FUNC "%8.3" "bar" COEFFS 0 1000.0 0.0 0 0.0 1.0 /end COMPU_METHOD
/begin COMPU_METHOD FORMULA_0111 "FORMULA_0111" RAT_FUNC "%7.2" "mg" COEFFS 0 64.0 0.0 0 0.0 1.0 /end COMPU_METHOD
/begin COMPU_METHOD FORMULA_0143 "FORMULA_0143" RAT_FUNC "%6.1" "qmm" COEFFS 0 10.0 0.0 0 0.0 1.0 /end COMPU_METHOD
/begin COMPU_METHOD FORMULA_0144 "FORMULA_0144" RAT_FUNC "%8.3" "ml" COEFFS 0 1000.0 0.0 0 0.0 1.0 /end COMPU_METHOD
/begin COMPU_METHOD FORMULA_0363 "FORMULA_0363" RAT_FUNC "%9.2" "ms" COEFFS 0 1000.0 0.0 0 0.0 1.0 /end COMPU_METHOD
/begin COMPU_METHOD FORMULA_0461 "FORMULA_0461" RAT_FUNC "%4.1" "s" COEFFS 0 10.0 0.0 0 0.0 1.0 /end COMPU_METHOD
/begin COMPU_METHOD FORMULA_0533 "FORMULA_0533" RAT_FUNC "%7.2" "mg" COEFFS 0 4.0 0.0 0 0.0 1.0 /end COMPU_METHOD
/begin COMPU_METHOD FORMULA_0593 "FORMULA_0593" RAT_FUNC "%5.0" "s" COEFFS 0 1 0 0 0 1 /end COMPU_METHOD
/begin COMPU_METHOD FORMULA_0597 "FORMULA_0597" RAT_FUNC "%7.2" "min" COEFFS 0 60.0 0.0 0 0.0 1.0 /end COMPU_METHOD
/begin COMPU_METHOD FORMULA_0645 "FORMULA_0645" RAT_FUNC "%6.3" "s" COEFFS 0 0 1.28 0 1 0 /end COMPU_METHOD
/begin COMPU_METHOD FORMULA_0658 "FORMULA_0658" RAT_FUNC "%5.2" "s" COEFFS 0 0 2.56 0 1 0 /end COMPU_METHOD
/begin COMPU_METHOD FORMULA_0664 "FORMULA_0664" TAB_VERB "%3.0" "-" COMPU_TAB_REF FORMULA_0664_VTAB /end COMPU_METHOD
/begin COMPU_METHOD FORMULA_0665 "FORMULA_0665" RAT_FUNC "%6.1" "%" COEFFS 0 512.0 0.0 0 0.0 1.0 /end COMPU_METHOD
/begin COMPU_METHOD FORMULA_0666 "FORMULA_0666" RAT_FUNC "%6.1" "ms" COEFFS 0 1.666666666666667 0.0 0 0.0 1.0 /end COMPU_METHOD
/begin COMPU_METHOD FORMULA_0667 "FORMULA_0667" TAB_VERB "%3.0" "-" COMPU_TAB_REF FORMULA_0667_VTAB /end COMPU_METHOD
/begin COMPU_METHOD FORMULA_0668 "FORMULA_0668" RAT_FUNC "%5.0" "ms" COEFFS 0 1.e-002 0.0 0 0.0 1.0 /end COMPU_METHOD
/begin COMPU_METHOD FORMULA_0669 "FORMULA_0669" TAB_VERB "%3.0" "-" COMPU_TAB_REF FORMULA_0669_VTAB /end COMPU_METHOD
/begin COMPU_METHOD FORMULA_0670 "FORMULA_0670" TAB_VERB "%3.0" "-" COMPU_TAB_REF FORMULA_0670_VTAB /end COMPU_METHOD
/begin COMPU_METHOD FORMULA_0671 "FORMULA_0671" RAT_FUNC "%7.2" "%/100ms" COEFFS 0 512.0 0.0 0 0.0 1.0 /end COMPU_METHOD
/begin COMPU_METHOD FORMULA_0672 "FORMULA_0672" RAT_FUNC "%5.0" "ms" COEFFS 0 0.1 0.0 0 0.0 1.0 /end COMPU_METHOD
/begin COMPU_METHOD FORMULA_0673 "FORMULA_0673" RAT_FUNC "%6.3" "-" COEFFS 0 128.0 0.0 0 0.0 1.0 /end COMPU_METHOD
/begin COMPU_METHOD FORMULA_0674 "FORMULA_0674" RAT_FUNC "%6.1" "mbar/s" COEFFS 0 16.0 0.0 0 0.0 1.0 /end COMPU_METHOD
/begin COMPU_METHOD FORMULA_0675 "FORMULA_0675" RAT_FUNC "%5.0" "bar/s" COEFFS 0 0.32 0.0 0 0.0 1.0 /end COMPU_METHOD
/begin COMPU_METHOD FORMULA_0676 "FORMULA_0676" TAB_VERB "%5.2" "-" COMPU_TAB_REF FORMULA_0676_VTAB /end COMPU_METHOD
/begin COMPU_METHOD FORMULA_0677 "FORMULA_0677" TAB_VERB "%3.0" "-" COMPU_TAB_REF FORMULA_0677_VTAB /end COMPU_METHOD
/begin COMPU_METHOD FORMULA_0678 "FORMULA_0678" TAB_VERB "%5.2" "-" COMPU_TAB_REF FORMULA_0678_VTAB /end COMPU_METHOD
/begin COMPU_METHOD FORMULA_0679 "FORMULA_0679" RAT_FUNC "%5.2" "s" COEFFS 0 0 25.6 0 1 0 /end COMPU_METHOD
/begin COMPU_METHOD FORMULA_0746 "FORMULA_0746" RAT_FUNC "%6.1" "l/h" COEFFS 0 8.0 0.0 0 0.0 1.0 /end COMPU_METHOD
/begin COMPU_METHOD FORMULA_0747 "FORMULA_0747" RAT_FUNC "%9.4" "kg/l=mg/ul" COEFFS 0 8192.0 0.0 0 0.0 1.0 /end COMPU_METHOD
/begin COMPU_METHOD FORMULA_0762 "FORMULA_0762" RAT_FUNC "%8.3" "-" COEFFS 0 8192.0 0.0 0 0.0 1.0 /end COMPU_METHOD
/begin COMPU_METHOD FORMULA_0767 "FORMULA_0767" TAB_VERB "%7.2" "-" COMPU_TAB_REF FORMULA_0767_VTAB /end COMPU_METHOD
/begin COMPU_METHOD FORMULA_0769 "FORMULA_0769" TAB_VERB "%7.2" "-" COMPU_TAB_REF FORMULA_0769_VTAB /end COMPU_METHOD
/begin COMPU_METHOD FORMULA_0770 "FORMULA_0770" TAB_VERB "%7.2" "-" COMPU_TAB_REF FORMULA_0770_VTAB /end COMPU_METHOD
/begin COMPU_METHOD FORMULA_0771 "FORMULA_0771" TAB_VERB "%7.2" "-" COMPU_TAB_REF FORMULA_0771_VTAB /end COMPU_METHOD
/begin COMPU_METHOD FORMULA_0786 "FORMULA_0786" RAT_FUNC "%7.2" "ms" COEFFS 0 1000.0 0.0 0 0.0 1.0 /end COMPU_METHOD
/begin COMPU_METHOD FORMULA_0806 "FORMULA_0806" RAT_FUNC "%7.2" "-" COEFFS 0 128.0 0.0 0 0.0 1.0 /end COMPU_METHOD
/begin COMPU_METHOD FORMULA_0827 "FORMULA_0827" TAB_VERB "%7.2" "-" COMPU_TAB_REF FORMULA_0827_VTAB /end COMPU_METHOD
/begin COMPU_METHOD FORMULA_0831 "FORMULA_0831" TAB_VERB "%5.2" "-" COMPU_TAB_REF FORMULA_0831_VTAB /end COMPU_METHOD
/begin COMPU_METHOD FORMULA_0843 "FORMULA_0843" TAB_VERB "%7.2" "-" COMPU_TAB_REF FORMULA_0843_VTAB /end COMPU_METHOD
/begin COMPU_METHOD FORMULA_0844 "FORMULA_0844" TAB_VERB "%7.2" "-" COMPU_TAB_REF FORMULA_0844_VTAB /end COMPU_METHOD
/begin COMPU_METHOD FORMULA_0885 "FORMULA_0885" TAB_VERB "%7.2" "-" COMPU_TAB_REF FORMULA_0885_VTAB /end COMPU_METHOD
/begin COMPU_METHOD FORMULA_1022 "FORMULA_1022" RAT_FUNC "%7.2" "s" COEFFS 0 1000.0 0.0 0 0.0 1.0 /end COMPU_METHOD
/begin COMPU_METHOD FORMULA_1170 "FORMULA_1170" RAT_FUNC "%8.3" "mg/ms" COEFFS 0 1024.0 0.0 0 0.0 1.0 /end COMPU_METHOD
/begin COMPU_METHOD FORMULA_1171 "FORMULA_1171" RAT_FUNC "%7.2" "mg/ASP" COEFFS 0 32.0 0.0 0 0.0 1.0 /end COMPU_METHOD
/begin COMPU_METHOD FORMULA_1172 "FORMULA_1172" RAT_FUNC "%7.2" "m/s" COEFFS 0 10.0 0.0 0 0.0 1.0 /end COMPU_METHOD
/begin COMPU_METHOD FORMULA_1173 "FORMULA_1173" RAT_FUNC "%8.3" "m2/s2" COEFFS 0 40.0 0.0 0 0.0 1.0 /end COMPU_METHOD
/begin COMPU_METHOD FORMULA_1174 "FORMULA_1174" TAB_VERB "%7.2" "-" COMPU_TAB_REF FORMULA_1174_VTAB /end COMPU_METHOD
/begin COMPU_METHOD FORMULA_1175 "FORMULA_1175" RAT_FUNC "%5.0" "Segmente" COEFFS 0 1 0 0 0 1 /end COMPU_METHOD
/begin COMPU_METHOD FORMULA_1176 "FORMULA_1176" TAB_VERB "%7.2" "-" COMPU_TAB_REF FORMULA_1176_VTAB /end COMPU_METHOD
/begin COMPU_METHOD FORMULA_1177 "FORMULA_1177" TAB_VERB "%7.2" "-" COMPU_TAB_REF FORMULA_1177_VTAB /end COMPU_METHOD
/begin COMPU_METHOD FORMULA_1178 "FORMULA_1178" TAB_VERB "%7.2" "-" COMPU_TAB_REF FORMULA_1178_VTAB /end COMPU_METHOD
/begin COMPU_METHOD FORMULA_1179 "FORMULA_1179" RAT_FUNC "%5.0" "Zylinder" COEFFS 0 1 0 0 0 1 /end COMPU_METHOD
/begin COMPU_METHOD FORMULA_1180 "FORMULA_1180" TAB_VERB "%7.2" "-" COMPU_TAB_REF FORMULA_1180_VTAB /end COMPU_METHOD
/begin COMPU_METHOD FORMULA_1181 "FORMULA_1181" TAB_VERB "%7.2" "-" COMPU_TAB_REF FORMULA_1181_VTAB /end COMPU_METHOD
/begin COMPU_METHOD FORMULA_1182 "FORMULA_1182" TAB_VERB "%7.2" "-" COMPU_TAB_REF FORMULA_1182_VTAB /end COMPU_METHOD
/begin COMPU_METHOD FORMULA_1183 "FORMULA_1183" TAB_VERB "%5.2" "-" COMPU_TAB_REF FORMULA_1183_VTAB /end COMPU_METHOD
/begin COMPU_METHOD FORMULA_1184 "FORMULA_1184" TAB_VERB "%5.2" "-" COMPU_TAB_REF FORMULA_1184_VTAB /end COMPU_METHOD
/begin COMPU_METHOD FORMULA_1185 "FORMULA_1185" TAB_VERB "%5.2" "-" COMPU_TAB_REF FORMULA_1185_VTAB /end COMPU_METHOD
/begin COMPU_METHOD FORMULA_1186 "FORMULA_1186" TAB_VERB "%5.2" "-" COMPU_TAB_REF FORMULA_1186_VTAB /end COMPU_METHOD
/begin COMPU_METHOD FORMULA_1187 "FORMULA_1187" TAB_VERB "%5.2" "-" COMPU_TAB_REF FORMULA_1187_VTAB /end COMPU_METHOD
/begin COMPU_METHOD FORMULA_1188 "FORMULA_1188" TAB_VERB "%5.2" "-" COMPU_TAB_REF FORMULA_1188_VTAB /end COMPU_METHOD
/begin COMPU_METHOD FORMULA_1189 "FORMULA_1189" RAT_FUNC "%7.2" "mm2" COEFFS 0 10.0 0.0 0 0.0 1.0 /end COMPU_METHOD
/begin COMPU_METHOD FORMULA_1190 "FORMULA_1190" RAT_FUNC "%7.2" "mm" COEFFS 0 10.0 0.0 0 0.0 1.0 /end COMPU_METHOD
/begin COMPU_METHOD FORMULA_1191 "FORMULA_1191" RAT_FUNC "%7.2" "kg/dm3" COEFFS 0 100.0 0.0 0 0.0 1.0 /end COMPU_METHOD
/begin COMPU_METHOD FORMULA_1192 "FORMULA_1192" RAT_FUNC "%9.4" "m" COEFFS 0 16384.0 0.0 0 0.0 1.0 /end COMPU_METHOD
/begin COMPU_METHOD FORMULA_1193 "FORMULA_1193" TAB_VERB "%5.2" "-" COMPU_TAB_REF FORMULA_1193_VTAB /end COMPU_METHOD
/begin COMPU_METHOD FORMULA_1194 "FORMULA_1194" RAT_FUNC "%8.3" "ms" COEFFS 0 31.25 0.0 0 0.0 1.0 /end COMPU_METHOD
/begin COMPU_METHOD FORMULA_1195 "FORMULA_1195" TAB_VERB "%5.2" "-" COMPU_TAB_REF FORMULA_1195_VTAB /end COMPU_METHOD
/begin COMPU_METHOD FORMULA_1196 "FORMULA_1196" TAB_VERB "%5.2" "-" COMPU_TAB_REF FORMULA_1196_VTAB /end COMPU_METHOD
/begin COMPU_METHOD FORMULA_1197 "FORMULA_1197" RAT_FUNC "%5.0" "-" COEFFS 0 1.0 -1.0 0 0.0 1.0 /end COMPU_METHOD
/begin COMPU_METHOD FORMULA_1198 "FORMULA_1198" RAT_FUNC "%5.0" "-" COEFFS 0 10.0 0.0 0 0.0 1.0 /end COMPU_METHOD
/begin COMPU_VTAB FORMULA_0664_VTAB "FORMULA_0664_VTAB" TAB_VERB 3 0 "Ansteuerung inaktiv" 3 "Ansteuerung bei ML" 5 "Ansteuerung bei MS" DEFAULT_VALUE "undefiniert" /end COMPU_VTAB
/begin COMPU_VTAB FORMULA_0667_VTAB "FORMULA_0667_VTAB" TAB_VERB 7 0 "Adaption fehlt" 1 "Typ-Identifikation" 2 "Funktionssperre" 4 "Weckfunktion" 8 "Luefterbetrieb" 16 "Nachlaufanforderung" 32 "aus" DEFAULT_VALUE "undefiniert" /end COMPU_VTAB
/begin COMPU_VTAB FORMULA_0669_VTAB "FORMULA_0669_VTAB" TAB_VERB 5 0 "NO_FEHLER" 1 "SH_TO_UB" 2 "SH_TO_GND" 4 "OPENLOAD" 8 "UNPLAUSIBEL" DEFAULT_VALUE "undefiniert" /end COMPU_VTAB
/begin COMPU_VTAB FORMULA_0670_VTAB "FORMULA_0670_VTAB" TAB_VERB 4 0 "aut. Typerkennung" 1 "BMW 600W" 2 "BMW 850W" 128 "TEMIC DC 850W invers" DEFAULT_VALUE "undef" /end COMPU_VTAB
/begin COMPU_VTAB FORMULA_0676_VTAB "FORMULA_0676_VTAB" TAB_VERB 2 0 "nicht erfuellt" 1 "erfuellt" DEFAULT_VALUE "undef" /end COMPU_VTAB
/begin COMPU_VTAB FORMULA_0677_VTAB "FORMULA_0677_VTAB" TAB_VERB 7 0 "inaktiv" 1 "Bedingungen nicht erfuellt" 5 "aktiv" 6 "beendet" 7 "Abbruch" 8 "beendet niO" 9 "beendet iO" DEFAULT_VALUE "undef" /end COMPU_VTAB
/begin COMPU_VTAB FORMULA_0678_VTAB "FORMULA_0678_VTAB" TAB_VERB 2 0 "Funktion AUS" 1 "Funktion AN" DEFAULT_VALUE "undef" /end COMPU_VTAB
/begin COMPU_VTAB FORMULA_0767_VTAB "FORMULA_0767_VTAB" TAB_VERB 1 0 "inaktiv" DEFAULT_VALUE "aktiv" /end COMPU_VTAB
/begin COMPU_VTAB FORMULA_0769_VTAB "FORMULA_0769_VTAB" TAB_VERB 1 0 "inaktiv" DEFAULT_VALUE "aktiv" /end COMPU_VTAB
/begin COMPU_VTAB FORMULA_0770_VTAB "FORMULA_0770_VTAB" TAB_VERB 1 0 "inaktiv" DEFAULT_VALUE "aktiv" /end COMPU_VTAB
/begin COMPU_VTAB FORMULA_0771_VTAB "FORMULA_0771_VTAB" TAB_VERB 1 0 "inaktiv" DEFAULT_VALUE "aktiv" /end COMPU_VTAB
/begin COMPU_VTAB FORMULA_0827_VTAB "FORMULA_0827_VTAB" TAB_VERB 1 0 "inaktiv" DEFAULT_VALUE "aktiv" /end COMPU_VTAB
/begin COMPU_VTAB FORMULA_0831_VTAB "FORMULA_0831_VTAB" TAB_VERB 2 0 "inaktiv" 1 "aktiv" /end COMPU_VTAB
/begin COMPU_VTAB FORMULA_0843_VTAB "FORMULA_0843_VTAB" TAB_VERB 1 0 "inaktiv" DEFAULT_VALUE "aktiv" /end COMPU_VTAB
/begin COMPU_VTAB FORMULA_0844_VTAB "FORMULA_0844_VTAB" TAB_VERB 1 0 "inaktiv" DEFAULT_VALUE "aktiv" /end COMPU_VTAB
/begin COMPU_VTAB FORMULA_0885_VTAB "FORMULA_0885_VTAB" TAB_VERB 1 0 "inaktiv" DEFAULT_VALUE "aktiv" /end COMPU_VTAB
/begin COMPU_VTAB FORMULA_1174_VTAB "FORMULA_1174_VTAB" TAB_VERB 1 0 "inaktiv" DEFAULT_VALUE "aktiv" /end COMPU_VTAB
/begin COMPU_VTAB FORMULA_1176_VTAB "FORMULA_1176_VTAB" TAB_VERB 1 0 "no" DEFAULT_VALUE "yes" /end COMPU_VTAB
/begin COMPU_VTAB FORMULA_1177_VTAB "FORMULA_1177_VTAB" TAB_VERB 1 0 "-" DEFAULT_VALUE "max" /end COMPU_VTAB
/begin COMPU_VTAB FORMULA_1178_VTAB "FORMULA_1178_VTAB" TAB_VERB 1 0 "-" DEFAULT_VALUE "min" /end COMPU_VTAB
/begin COMPU_VTAB FORMULA_1180_VTAB "FORMULA_1180_VTAB" TAB_VERB 1 0 "no" DEFAULT_VALUE "yes" /end COMPU_VTAB
/begin COMPU_VTAB FORMULA_1181_VTAB "FORMULA_1181_VTAB" TAB_VERB 1 0 "-" DEFAULT_VALUE "nmax" /end COMPU_VTAB
/begin COMPU_VTAB FORMULA_1182_VTAB "FORMULA_1182_VTAB" TAB_VERB 2 0 "Einfluss" 1 "kein Einfluss" /end COMPU_VTAB
/begin COMPU_VTAB FORMULA_1183_VTAB "FORMULA_1183_VTAB" TAB_VERB 2 0 "kein TE-Einfluss" 1 "mit TE-Einfluss" /end COMPU_VTAB
/begin COMPU_VTAB FORMULA_1184_VTAB "FORMULA_1184_VTAB" TAB_VERB 2 0 "kein OELV-Einfluss" 1 "mit OELV-Einfluss" /end COMPU_VTAB
/begin COMPU_VTAB FORMULA_1185_VTAB "FORMULA_1185_VTAB" TAB_VERB 2 0 "kein LWV-Einfluss" 1 "mit LWV-Einfluss" /end COMPU_VTAB
/begin COMPU_VTAB FORMULA_1186_VTAB "FORMULA_1186_VTAB" TAB_VERB 2 0 "mks_start" 1 "mks_grund" /end COMPU_VTAB
/begin COMPU_VTAB FORMULA_1187_VTAB "FORMULA_1187_VTAB" TAB_VERB 2 0 "kein Einfluss" 1 "mit START-Einfluss" /end COMPU_VTAB
/begin COMPU_VTAB FORMULA_1188_VTAB "FORMULA_1188_VTAB" TAB_VERB 2 0 "ohne AQ-Einfluss" 1 "mit AQ-Einfluss" /end COMPU_VTAB
/begin COMPU_VTAB FORMULA_1193_VTAB "FORMULA_1193_VTAB" TAB_VERB 2 0 "lam_ist" 1 "lam_ist_seg" /end COMPU_VTAB
/begin COMPU_VTAB FORMULA_1195_VTAB "FORMULA_1195_VTAB" TAB_VERB 2 0 "keine Adaption" 1 "Adaption" /end COMPU_VTAB
/begin COMPU_VTAB FORMULA_1196_VTAB "FORMULA_1196_VTAB" TAB_VERB 2 0 "-" 1 "RESET" /end COMPU_VTAB
/begin FUNCTION Eigendiagnose ""
 /begin DEF_CHARACTERISTIC K_ED_SL_DURCHS_HSTRANG.DEC_NACH_EINTRAG K_ED_SL_DURCHS_HSTRANG.DEC_VOR_EINTRAG K_ED_SL_DURCHS_HSTRANG.FEHLERSCHWELLE K_ED_SL_DURCHS_HSTRANG.INC_NACH_EINTRAG K_ED_SL_DURCHS_HSTRANG.INC_VOR_EINTRAG K_ED_SL_DURCHS_HSTRANG.KLASSENINDEX K_ED_SL_DURCHS_HSTRANG.OK_SCHWELLE K_ED_SL_DURCHS_HSTRANG.P_CODE_OPENLOAD K_ED_SL_DURCHS_HSTRANG.P_CODE_SH_TO_GND K_ED_SL_DURCHS_HSTRANG.P_CODE_SH_TO_UB K_ED_SL_DURCHS_HSTRANG.P_CODE_UNPLAUSIBEL K_ED_SL_ML_HFM.DEC_NACH_EINTRAG K_ED_SL_ML_HFM.DEC_VOR_EINTRAG K_ED_SL_ML_HFM.FEHLERSCHWELLE K_ED_SL_ML_HFM.INC_NACH_EINTRAG K_ED_SL_ML_HFM.INC_VOR_EINTRAG K_ED_SL_ML_HFM.KLASSENINDEX K_ED_SL_ML_HFM.OK_SCHWELLE K_ED_SL_ML_HFM.P_CODE_OPENLOAD K_ED_SL_ML_HFM.P_CODE_SH_TO_GND K_ED_SL_ML_HFM.P_CODE_SH_TO_UB K_ED_SL_ML_HFM.P_CODE_UNPLAUSIBEL K_ED_SL_ML_HFM_OBD.DEC_NACH_EINTRAG K_ED_SL_ML_HFM_OBD.DEC_VOR_EINTRAG K_ED_SL_ML_HFM_OBD.FEHLERSCHWELLE K_ED_SL_ML_HFM_OBD.INC_NACH_EINTRAG K_ED_SL_ML_HFM_OBD.INC_VOR_EINTRAG K_ED_SL_ML_HFM_OBD.KLASSENINDEX K_ED_SL_ML_HFM_OBD.OK_SCHWELLE K_ED_SL_ML_HFM_OBD.P_CODE_OPENLOAD K_ED_SL_ML_HFM_OBD.P_CODE_SH_TO_GND K_ED_SL_ML_HFM_OBD.P_CODE_SH_TO_UB K_ED_SL_ML_HFM_OBD.P_CODE_UNPLAUSIBEL K_ED_SLP.DEC_NACH_EINTRAG K_ED_SLP.DEC_VOR_EINTRAG K_ED_SLP.FEHLERSCHWELLE K_ED_SLP.INC_NACH_EINTRAG K_ED_SLP.INC_VOR_EINTRAG K_ED_SLP.KLASSENINDEX K_ED_SLP.OK_SCHWELLE K_ED_SLP.P_CODE_OPENLOAD K_ED_SLP.P_CODE_SH_TO_GND K_ED_SLP.P_CODE_SH_TO_UB K_ED_SLP.P_CODE_UNPLAUSIBEL K_ED_SLV.DEC_NACH_EINTRAG K_ED_SLV.DEC_VOR_EINTRAG K_ED_SLV.FEHLERSCHWELLE K_ED_SLV.INC_NACH_EINTRAG K_ED_SLV.INC_VOR_EINTRAG K_ED_SLV.KLASSENINDEX K_ED_SLV.OK_SCHWELLE K_ED_SLV.P_CODE_OPENLOAD K_ED_SLV.P_CODE_SH_TO_GND K_ED_SLV.P_CODE_SH_TO_UB K_ED_SLV.P_CODE_UNPLAUSIBEL K_ED_TANK_LEER.DEC_NACH_EINTRAG K_ED_TANK_LEER.DEC_VOR_EINTRAG K_ED_TANK_LEER.FEHLERSCHWELLE K_ED_TANK_LEER.INC_NACH_EINTRAG K_ED_TANK_LEER.INC_VOR_EINTRAG K_ED_TANK_LEER.KLASSENINDEX K_ED_TANK_LEER.OK_SCHWELLE K_ED_TANK_LEER.P_CODE_OPENLOAD K_ED_TANK_LEER.P_CODE_SH_TO_GND K_ED_TANK_LEER.P_CODE_SH_TO_UB K_ED_TANK_LEER.P_CODE_UNPLAUSIBEL K_ED_TD.DEC_NACH_EINTRAG K_ED_TD.DEC_VOR_EINTRAG K_ED_TD.FEHLERSCHWELLE K_ED_TD.INC_NACH_EINTRAG K_ED_TD.INC_VOR_EINTRAG K_ED_TD.KLASSENINDEX K_ED_TD.OK_SCHWELLE K_ED_TD.P_CODE_OPENLOAD K_ED_TD.P_CODE_SH_TO_GND K_ED_TD.P_CODE_SH_TO_UB K_ED_TD.P_CODE_UNPLAUSIBEL K_ED_TE_OBD_1.DEC_NACH_EINTRAG K_ED_TE_OBD_1.DEC_VOR_EINTRAG K_ED_TE_OBD_1.FEHLERSCHWELLE K_ED_TE_OBD_1.INC_NACH_EINTRAG K_ED_TE_OBD_1.INC_VOR_EINTRAG K_ED_TE_OBD_1.KLASSENINDEX K_ED_TE_OBD_1.OK_SCHWELLE K_ED_TE_OBD_1.P_CODE_OPENLOAD K_ED_TE_OBD_1.P_CODE_SH_TO_GND K_ED_TE_OBD_1.P_CODE_SH_TO_UB K_ED_TE_OBD_1.P_CODE_UNPLAUSIBEL K_ED_TE_OBD_2.DEC_NACH_EINTRAG K_ED_TE_OBD_2.DEC_VOR_EINTRAG K_ED_TE_OBD_2.FEHLERSCHWELLE K_ED_TE_OBD_2.INC_NACH_EINTRAG K_ED_TE_OBD_2.INC_VOR_EINTRAG K_ED_TE_OBD_2.KLASSENINDEX K_ED_TE_OBD_2.OK_SCHWELLE K_ED_TE_OBD_2.P_CODE_OPENLOAD K_ED_TE_OBD_2.P_CODE_SH_TO_GND K_ED_TE_OBD_2.P_CODE_SH_TO_UB K_ED_TE_OBD_2.P_CODE_UNPLAUSIBEL K_ED_TEV1.DEC_NACH_EINTRAG K_ED_TEV1.DEC_VOR_EINTRAG K_ED_TEV1.FEHLERSCHWELLE K_ED_TEV1.INC_NACH_EINTRAG K_ED_TEV1.INC_VOR_EINTRAG K_ED_TEV1.KLASSENINDEX K_ED_TEV1.OK_SCHWELLE K_ED_TEV1.P_CODE_OPENLOAD K_ED_TEV1.P_CODE_SH_TO_GND K_ED_TEV1.P_CODE_SH_TO_UB K_ED_TEV1.P_CODE_UNPLAUSIBEL K_ED_TEV2.DEC_NACH_EINTRAG K_ED_TEV2.DEC_VOR_EINTRAG K_ED_TEV2.FEHLERSCHWELLE K_ED_TEV2.INC_NACH_EINTRAG K_ED_TEV2.INC_VOR_EINTRAG K_ED_TEV2.KLASSENINDEX K_ED_TEV2.OK_SCHWELLE K_ED_TEV2.P_CODE_OPENLOAD K_ED_TEV2.P_CODE_SH_TO_GND K_ED_TEV2.P_CODE_SH_TO_UB K_ED_TEV2.P_CODE_UNPLAUSIBEL K_ED_TGETR_HS.DEC_NACH_EINTRAG K_ED_TGETR_HS.DEC_VOR_EINTRAG K_ED_TGETR_HS.FEHLERSCHWELLE K_ED_TGETR_HS.INC_NACH_EINTRAG K_ED_TGETR_HS.INC_VOR_EINTRAG K_ED_TGETR_HS.KLASSENINDEX K_ED_TGETR_HS.OK_SCHWELLE K_ED_TGETR_HS.P_CODE_OPENLOAD K_ED_TGETR_HS.P_CODE_SH_TO_GND K_ED_TGETR_HS.P_CODE_SH_TO_UB K_ED_TGETR_HS.P_CODE_UNPLAUSIBEL K_ED_TZ1.DEC_NACH_EINTRAG K_ED_TZ1.DEC_VOR_EINTRAG K_ED_TZ1.FEHLERSCHWELLE K_ED_TZ1.INC_NACH_EINTRAG K_ED_TZ1.INC_VOR_EINTRAG K_ED_TZ1.KLASSENINDEX K_ED_TZ1.OK_SCHWELLE K_ED_TZ1.P_CODE_OPENLOAD K_ED_TZ1.P_CODE_SH_TO_GND K_ED_TZ1.P_CODE_SH_TO_UB K_ED_TZ1.P_CODE_UNPLAUSIBEL K_ED_TZ10.DEC_NACH_EINTRAG K_ED_TZ10.DEC_VOR_EINTRAG K_ED_TZ10.FEHLERSCHWELLE K_ED_TZ10.INC_NACH_EINTRAG K_ED_TZ10.INC_VOR_EINTRAG K_ED_TZ10.KLASSENINDEX K_ED_TZ10.OK_SCHWELLE K_ED_TZ10.P_CODE_OPENLOAD K_ED_TZ10.P_CODE_SH_TO_GND K_ED_TZ10.P_CODE_SH_TO_UB K_ED_TZ10.P_CODE_UNPLAUSIBEL K_ED_TZ2.DEC_NACH_EINTRAG K_ED_TZ2.DEC_VOR_EINTRAG K_ED_TZ2.FEHLERSCHWELLE K_ED_TZ2.INC_NACH_EINTRAG K_ED_TZ2.INC_VOR_EINTRAG K_ED_TZ2.KLASSENINDEX K_ED_TZ2.OK_SCHWELLE K_ED_TZ2.P_CODE_OPENLOAD K_ED_TZ2.P_CODE_SH_TO_GND K_ED_TZ2.P_CODE_SH_TO_UB K_ED_TZ2.P_CODE_UNPLAUSIBEL K_ED_TZ3.DEC_NACH_EINTRAG K_ED_TZ3.DEC_VOR_EINTRAG K_ED_TZ3.FEHLERSCHWELLE K_ED_TZ3.INC_NACH_EINTRAG K_ED_TZ3.INC_VOR_EINTRAG K_ED_TZ3.KLASSENINDEX K_ED_TZ3.OK_SCHWELLE K_ED_TZ3.P_CODE_OPENLOAD K_ED_TZ3.P_CODE_SH_TO_GND K_ED_TZ3.P_CODE_SH_TO_UB K_ED_TZ3.P_CODE_UNPLAUSIBEL K_ED_TZ4.DEC_NACH_EINTRAG K_ED_TZ4.DEC_VOR_EINTRAG K_ED_TZ4.FEHLERSCHWELLE K_ED_TZ4.INC_NACH_EINTRAG K_ED_TZ4.INC_VOR_EINTRAG K_ED_TZ4.KLASSENINDEX K_ED_TZ4.OK_SCHWELLE K_ED_TZ4.P_CODE_OPENLOAD K_ED_TZ4.P_CODE_SH_TO_GND K_ED_TZ4.P_CODE_SH_TO_UB K_ED_TZ4.P_CODE_UNPLAUSIBEL K_ED_TZ5.DEC_NACH_EINTRAG K_ED_TZ5.DEC_VOR_EINTRAG K_ED_TZ5.FEHLERSCHWELLE K_ED_TZ5.INC_NACH_EINTRAG K_ED_TZ5.INC_VOR_EINTRAG K_ED_TZ5.KLASSENINDEX K_ED_TZ5.OK_SCHWELLE K_ED_TZ5.P_CODE_OPENLOAD K_ED_TZ5.P_CODE_SH_TO_GND K_ED_TZ5.P_CODE_SH_TO_UB K_ED_TZ5.P_CODE_UNPLAUSIBEL K_ED_TZ6.DEC_NACH_EINTRAG K_ED_TZ6.DEC_VOR_EINTRAG K_ED_TZ6.FEHLERSCHWELLE K_ED_TZ6.INC_NACH_EINTRAG K_ED_TZ6.INC_VOR_EINTRAG K_ED_TZ6.KLASSENINDEX K_ED_TZ6.OK_SCHWELLE K_ED_TZ6.P_CODE_OPENLOAD K_ED_TZ6.P_CODE_SH_TO_GND K_ED_TZ6.P_CODE_SH_TO_UB K_ED_TZ6.P_CODE_UNPLAUSIBEL K_ED_TZ7.DEC_NACH_EINTRAG K_ED_TZ7.DEC_VOR_EINTRAG K_ED_TZ7.FEHLERSCHWELLE K_ED_TZ7.INC_NACH_EINTRAG K_ED_TZ7.INC_VOR_EINTRAG K_ED_TZ7.KLASSENINDEX K_ED_TZ7.OK_SCHWELLE K_ED_TZ7.P_CODE_OPENLOAD K_ED_TZ7.P_CODE_SH_TO_GND K_ED_TZ7.P_CODE_SH_TO_UB K_ED_TZ7.P_CODE_UNPLAUSIBEL K_ED_TZ8.DEC_NACH_EINTRAG K_ED_TZ8.DEC_VOR_EINTRAG K_ED_TZ8.FEHLERSCHWELLE K_ED_TZ8.INC_NACH_EINTRAG K_ED_TZ8.INC_VOR_EINTRAG K_ED_TZ8.KLASSENINDEX K_ED_TZ8.OK_SCHWELLE K_ED_TZ8.P_CODE_OPENLOAD K_ED_TZ8.P_CODE_SH_TO_GND K_ED_TZ8.P_CODE_SH_TO_UB K_ED_TZ8.P_CODE_UNPLAUSIBEL K_ED_TZ9.DEC_NACH_EINTRAG K_ED_TZ9.DEC_VOR_EINTRAG K_ED_TZ9.FEHLERSCHWELLE K_ED_TZ9.INC_NACH_EINTRAG K_ED_TZ9.INC_VOR_EINTRAG K_ED_TZ9.KLASSENINDEX K_ED_TZ9.OK_SCHWELLE K_ED_TZ9.P_CODE_OPENLOAD K_ED_TZ9.P_CODE_SH_TO_GND K_ED_TZ9.P_CODE_SH_TO_UB K_ED_TZ9.P_CODE_UNPLAUSIBEL K_ED_UBMIN K_ED_VAN_ANSCHL_A1.DEC_NACH_EINTRAG K_ED_VAN_ANSCHL_A1.DEC_VOR_EINTRAG K_ED_VAN_ANSCHL_A1.FEHLERSCHWELLE K_ED_VAN_ANSCHL_A1.INC_NACH_EINTRAG K_ED_VAN_ANSCHL_A1.INC_VOR_EINTRAG K_ED_VAN_ANSCHL_A1.KLASSENINDEX K_ED_VAN_ANSCHL_A1.OK_SCHWELLE K_ED_VAN_ANSCHL_A1.P_CODE_OPENLOAD K_ED_VAN_ANSCHL_A1.P_CODE_SH_TO_GND K_ED_VAN_ANSCHL_A1.P_CODE_SH_TO_UB K_ED_VAN_ANSCHL_A1.P_CODE_UNPLAUSIBEL K_ED_VAN_ANSCHL_A2.DEC_NACH_EINTRAG K_ED_VAN_ANSCHL_A2.DEC_VOR_EINTRAG K_ED_VAN_ANSCHL_A2.FEHLERSCHWELLE K_ED_VAN_ANSCHL_A2.INC_NACH_EINTRAG K_ED_VAN_ANSCHL_A2.INC_VOR_EINTRAG K_ED_VAN_ANSCHL_A2.KLASSENINDEX K_ED_VAN_ANSCHL_A2.OK_SCHWELLE K_ED_VAN_ANSCHL_A2.P_CODE_OPENLOAD K_ED_VAN_ANSCHL_A2.P_CODE_SH_TO_GND K_ED_VAN_ANSCHL_A2.P_CODE_SH_TO_UB K_ED_VAN_ANSCHL_A2.P_CODE_UNPLAUSIBEL K_ED_VAN_ANSCHL_E1.DEC_NACH_EINTRAG K_ED_VAN_ANSCHL_E1.DEC_VOR_EINTRAG K_ED_VAN_ANSCHL_E1.FEHLERSCHWELLE K_ED_VAN_ANSCHL_E1.INC_NACH_EINTRAG K_ED_VAN_ANSCHL_E1.INC_VOR_EINTRAG K_ED_VAN_ANSCHL_E1.KLASSENINDEX K_ED_VAN_ANSCHL_E1.OK_SCHWELLE K_ED_VAN_ANSCHL_E1.P_CODE_OPENLOAD K_ED_VAN_ANSCHL_E1.P_CODE_SH_TO_GND K_ED_VAN_ANSCHL_E1.P_CODE_SH_TO_UB K_ED_VAN_ANSCHL_E1.P_CODE_UNPLAUSIBEL K_ED_VAN_ANSCHL_E2.DEC_NACH_EINTRAG K_ED_VAN_ANSCHL_E2.DEC_VOR_EINTRAG K_ED_VAN_ANSCHL_E2.FEHLERSCHWELLE K_ED_VAN_ANSCHL_E2.INC_NACH_EINTRAG K_ED_VAN_ANSCHL_E2.INC_VOR_EINTRAG K_ED_VAN_ANSCHL_E2.KLASSENINDEX K_ED_VAN_ANSCHL_E2.OK_SCHWELLE K_ED_VAN_ANSCHL_E2.P_CODE_OPENLOAD K_ED_VAN_ANSCHL_E2.P_CODE_SH_TO_GND K_ED_VAN_ANSCHL_E2.P_CODE_SH_TO_UB K_ED_VAN_ANSCHL_E2.P_CODE_UNPLAUSIBEL K_ED_VAN_DRUCK.DEC_NACH_EINTRAG K_ED_VAN_DRUCK.DEC_VOR_EINTRAG K_ED_VAN_DRUCK.FEHLERSCHWELLE K_ED_VAN_DRUCK.INC_NACH_EINTRAG K_ED_VAN_DRUCK.INC_VOR_EINTRAG K_ED_VAN_DRUCK.KLASSENINDEX K_ED_VAN_DRUCK.OK_SCHWELLE K_ED_VAN_DRUCK.P_CODE_OPENLOAD K_ED_VAN_DRUCK.P_CODE_SH_TO_GND K_ED_VAN_DRUCK.P_CODE_SH_TO_UB K_ED_VAN_DRUCK.P_CODE_UNPLAUSIBEL K_ED_VAN_DSV.DEC_NACH_EINTRAG K_ED_VAN_DSV.DEC_VOR_EINTRAG K_ED_VAN_DSV.FEHLERSCHWELLE K_ED_VAN_DSV.INC_NACH_EINTRAG K_ED_VAN_DSV.INC_VOR_EINTRAG K_ED_VAN_DSV.KLASSENINDEX K_ED_VAN_DSV.OK_SCHWELLE K_ED_VAN_DSV.P_CODE_OPENLOAD K_ED_VAN_DSV.P_CODE_SH_TO_GND K_ED_VAN_DSV.P_CODE_SH_TO_UB K_ED_VAN_DSV.P_CODE_UNPLAUSIBEL K_ED_VAN_HALL_A1.DEC_NACH_EINTRAG K_ED_VAN_HALL_A1.DEC_VOR_EINTRAG K_ED_VAN_HALL_A1.FEHLERSCHWELLE K_ED_VAN_HALL_A1.INC_NACH_EINTRAG K_ED_VAN_HALL_A1.INC_VOR_EINTRAG K_ED_VAN_HALL_A1.KLASSENINDEX K_ED_VAN_HALL_A1.OK_SCHWELLE K_ED_VAN_HALL_A1.P_CODE_OPENLOAD K_ED_VAN_HALL_A1.P_CODE_SH_TO_GND K_ED_VAN_HALL_A1.P_CODE_SH_TO_UB K_ED_VAN_HALL_A1.P_CODE_UNPLAUSIBEL K_ED_VAN_HALL_A2.DEC_NACH_EINTRAG K_ED_VAN_HALL_A2.DEC_VOR_EINTRAG K_ED_VAN_HALL_A2.FEHLERSCHWELLE K_ED_VAN_HALL_A2.INC_NACH_EINTRAG K_ED_VAN_HALL_A2.INC_VOR_EINTRAG K_ED_VAN_HALL_A2.KLASSENINDEX K_ED_VAN_HALL_A2.OK_SCHWELLE K_ED_VAN_HALL_A2.P_CODE_OPENLOAD K_ED_VAN_HALL_A2.P_CODE_SH_TO_GND K_ED_VAN_HALL_A2.P_CODE_SH_TO_UB K_ED_VAN_HALL_A2.P_CODE_UNPLAUSIBEL K_ED_VAN_HALL_E1.DEC_NACH_EINTRAG K_ED_VAN_HALL_E1.DEC_VOR_EINTRAG K_ED_VAN_HALL_E1.FEHLERSCHWELLE K_ED_VAN_HALL_E1.INC_NACH_EINTRAG K_ED_VAN_HALL_E1.INC_VOR_EINTRAG K_ED_VAN_HALL_E1.KLASSENINDEX K_ED_VAN_HALL_E1.OK_SCHWELLE K_ED_VAN_HALL_E1.P_CODE_OPENLOAD K_ED_VAN_HALL_E1.P_CODE_SH_TO_GND K_ED_VAN_HALL_E1.P_CODE_SH_TO_UB K_ED_VAN_HALL_E1.P_CODE_UNPLAUSIBEL K_ED_VAN_HALL_E2.DEC_NACH_EINTRAG K_ED_VAN_HALL_E2.DEC_VOR_EINTRAG K_ED_VAN_HALL_E2.FEHLERSCHWELLE K_ED_VAN_HALL_E2.INC_NACH_EINTRAG K_ED_VAN_HALL_E2.INC_VOR_EINTRAG K_ED_VAN_HALL_E2.KLASSENINDEX K_ED_VAN_HALL_E2.OK_SCHWELLE K_ED_VAN_HALL_E2.P_CODE_OPENLOAD K_ED_VAN_HALL_E2.P_CODE_SH_TO_GND K_ED_VAN_HALL_E2.P_CODE_SH_TO_UB K_ED_VAN_HALL_E2.P_CODE_UNPLAUSIBEL K_ED_VAN_REGL_A1.DEC_NACH_EINTRAG K_ED_VAN_REGL_A1.DEC_VOR_EINTRAG K_ED_VAN_REGL_A1.FEHLERSCHWELLE K_ED_VAN_REGL_A1.INC_NACH_EINTRAG K_ED_VAN_REGL_A1.INC_VOR_EINTRAG K_ED_VAN_REGL_A1.KLASSENINDEX K_ED_VAN_REGL_A1.OK_SCHWELLE K_ED_VAN_REGL_A1.P_CODE_OPENLOAD K_ED_VAN_REGL_A1.P_CODE_SH_TO_GND K_ED_VAN_REGL_A1.P_CODE_SH_TO_UB K_ED_VAN_REGL_A1.P_CODE_UNPLAUSIBEL K_ED_VAN_REGL_A2.DEC_NACH_EINTRAG K_ED_VAN_REGL_A2.DEC_VOR_EINTRAG K_ED_VAN_REGL_A2.FEHLERSCHWELLE K_ED_VAN_REGL_A2.INC_NACH_EINTRAG K_ED_VAN_REGL_A2.INC_VOR_EINTRAG K_ED_VAN_REGL_A2.KLASSENINDEX K_ED_VAN_REGL_A2.OK_SCHWELLE K_ED_VAN_REGL_A2.P_CODE_OPENLOAD K_ED_VAN_REGL_A2.P_CODE_SH_TO_GND K_ED_VAN_REGL_A2.P_CODE_SH_TO_UB K_ED_VAN_REGL_A2.P_CODE_UNPLAUSIBEL K_ED_VAN_REGL_E1.DEC_NACH_EINTRAG K_ED_VAN_REGL_E1.DEC_VOR_EINTRAG K_ED_VAN_REGL_E1.FEHLERSCHWELLE K_ED_VAN_REGL_E1.INC_NACH_EINTRAG K_ED_VAN_REGL_E1.INC_VOR_EINTRAG K_ED_VAN_REGL_E1.KLASSENINDEX K_ED_VAN_REGL_E1.OK_SCHWELLE K_ED_VAN_REGL_E1.P_CODE_OPENLOAD K_ED_VAN_REGL_E1.P_CODE_SH_TO_GND K_ED_VAN_REGL_E1.P_CODE_SH_TO_UB K_ED_VAN_REGL_E1.P_CODE_UNPLAUSIBEL K_ED_VAN_REGL_E2.DEC_NACH_EINTRAG K_ED_VAN_REGL_E2.DEC_VOR_EINTRAG K_ED_VAN_REGL_E2.FEHLERSCHWELLE K_ED_VAN_REGL_E2.INC_NACH_EINTRAG K_ED_VAN_REGL_E2.INC_VOR_EINTRAG K_ED_VAN_REGL_E2.KLASSENINDEX K_ED_VAN_REGL_E2.OK_SCHWELLE K_ED_VAN_REGL_E2.P_CODE_OPENLOAD K_ED_VAN_REGL_E2.P_CODE_SH_TO_GND K_ED_VAN_REGL_E2.P_CODE_SH_TO_UB K_ED_VAN_REGL_E2.P_CODE_UNPLAUSIBEL K_ED_VAN_VENT_A1.DEC_NACH_EINTRAG K_ED_VAN_VENT_A1.DEC_VOR_EINTRAG K_ED_VAN_VENT_A1.FEHLERSCHWELLE K_ED_VAN_VENT_A1.INC_NACH_EINTRAG K_ED_VAN_VENT_A1.INC_VOR_EINTRAG K_ED_VAN_VENT_A1.KLASSENINDEX K_ED_VAN_VENT_A1.OK_SCHWELLE K_ED_VAN_VENT_A1.P_CODE_OPENLOAD K_ED_VAN_VENT_A1.P_CODE_SH_TO_GND K_ED_VAN_VENT_A1.P_CODE_SH_TO_UB K_ED_VAN_VENT_A1.P_CODE_UNPLAUSIBEL K_ED_VAN_VENT_A2.DEC_NACH_EINTRAG K_ED_VAN_VENT_A2.DEC_VOR_EINTRAG K_ED_VAN_VENT_A2.FEHLERSCHWELLE K_ED_VAN_VENT_A2.INC_NACH_EINTRAG K_ED_VAN_VENT_A2.INC_VOR_EINTRAG K_ED_VAN_VENT_A2.KLASSENINDEX K_ED_VAN_VENT_A2.OK_SCHWELLE K_ED_VAN_VENT_A2.P_CODE_OPENLOAD K_ED_VAN_VENT_A2.P_CODE_SH_TO_GND K_ED_VAN_VENT_A2.P_CODE_SH_TO_UB K_ED_VAN_VENT_A2.P_CODE_UNPLAUSIBEL K_ED_VAN_VENT_E1.DEC_NACH_EINTRAG K_ED_VAN_VENT_E1.DEC_VOR_EINTRAG K_ED_VAN_VENT_E1.FEHLERSCHWELLE K_ED_VAN_VENT_E1.INC_NACH_EINTRAG K_ED_VAN_VENT_E1.INC_VOR_EINTRAG K_ED_VAN_VENT_E1.KLASSENINDEX K_ED_VAN_VENT_E1.OK_SCHWELLE K_ED_VAN_VENT_E1.P_CODE_OPENLOAD K_ED_VAN_VENT_E1.P_CODE_SH_TO_GND K_ED_VAN_VENT_E1.P_CODE_SH_TO_UB K_ED_VAN_VENT_E1.P_CODE_UNPLAUSIBEL K_ED_VAN_VENT_E2.DEC_NACH_EINTRAG K_ED_VAN_VENT_E2.DEC_VOR_EINTRAG K_ED_VAN_VENT_E2.FEHLERSCHWELLE K_ED_VAN_VENT_E2.INC_NACH_EINTRAG K_ED_VAN_VENT_E2.INC_VOR_EINTRAG K_ED_VAN_VENT_E2.KLASSENINDEX K_ED_VAN_VENT_E2.OK_SCHWELLE K_ED_VAN_VENT_E2.P_CODE_OPENLOAD K_ED_VAN_VENT_E2.P_CODE_SH_TO_GND K_ED_VAN_VENT_E2.P_CODE_SH_TO_UB K_ED_VAN_VENT_E2.P_CODE_UNPLAUSIBEL K_ED_WUC_DELTA_TMOT K_ED_WUC_TMOT_MIN /end DEF_CHARACTERISTIC
/end FUNCTION
/begin FUNCTION Einspritzung ""
 /begin DEF_CHARACTERISTIC AXIS_TI_TU_F_N10 AXIS_TI_TU_F_RF4 GKF_TI_TU_F_ZYL1 GKF_TI_TU_F_ZYL10 GKF_TI_TU_F_ZYL2 GKF_TI_TU_F_ZYL3 GKF_TI_TU_F_ZYL4 GKF_TI_TU_F_ZYL5 GKF_TI_TU_F_ZYL6 GKF_TI_TU_F_ZYL7 GKF_TI_TU_F_ZYL8 GKF_TI_TU_F_ZYL9 K_DKBA_CFG K_DKBA_NMAX K_DKBA_NMAX_HYS K_KVA_Q_MOT_TAU K_KVA_SPEC_WEIGHT K_TI_GA K_TI_GRUND_STOECH K_TI_MAX_OFFS K_TI_MAX_RESET K_TI_MIN_MAX_HYS K_TI_MIN_OFF_TIME K_TI_MKS_LWV_CFG K_TI_MKS_OELV_CFG K_TI_MKS_START_CFG K_TI_MKS_TE_CFG K_TI_NMIN_KL50OFF K_TI_NS_CFG K_TI_OFF_CFG K_TI_OFF_EXD_N_MAX K_TI_PHI_ENDE_A_SAUG K_TI_PHI_ENDE_A_ZYL K_TI_PHI_ENDE_ROH_KST K_TI_PHI_ENDE_S_ESV_EV K_TI_PHI_ENDE_S_HUB K_TI_RF_MAX_DLY K_TI_WL_CFG K_ZGLA_ADAPT_CFG K_ZGLA_F_MAX K_ZGLA_F_MIN K_ZGLA_FILT_T1 K_ZGLA_I K_ZGLA_INPUT_CFG K_ZGLA_LAM_IST_MAX K_ZGLA_LAM_IST_MIN K_ZGLA_N_MAX K_ZGLA_RESET_CFG K_ZGLA_RF_MAX K_ZGLA_RF_MIN K_ZGLA_TMOT_MIN KF_DKBA_NEG_F KF_DKBA_POS_F KF_TI_GRUND_F KF_TI_LAA_OFFS_WICHT_F KF_TI_MKS_NS_GRUND KF_TI_MKS_START KF_TI_NS_F KF_TI_PHI_ENDE_GRUND KF_TI_PHI_ENDE_OFFS KF_TI_SEG_TIME_F KF_TI_SOLL_MIN KF_TI_SOLL_UB_OFFS KF_TI_START_F KF_TI_TU_F KF_TI_WL_KORR_F KF_TI_WL_KORR_F_KH KF_TI_WL_OFFS KF_TI_WL_OFFS_KH KF_ZGLA_ZYL_NR_OFFS KL_DKBA_AQ_REL KL_DKBA_TMOT KL_DKBA_TRIGGER KL_TI_NS_VERLUSTE KL_TI_PHI_ENDE_ES KL_TI_PHI_ENDE_GRAD KL_TI_PHI_ENDE_START KL_TI_PHI_EV_WURZEL KL_TI_SOLL_LIN_OFFS KL_TI_SOLL_QSTAT_F KL_TI_SOLL_RHO_F KL_TI_SOLL_UB_OFFS_T_KORR_F KL_TI_START_PUMG_F /end DEF_CHARACTERISTIC
 /begin OUT_MEASUREMENT dkba_aq_rel_delta_b1 dkba_aq_rel_delta_b2 dkba_aq_rf_roh_delta_b1 dkba_aq_rf_roh_delta_b2 dkba_f_b1 dkba_f_b2 dkba_freigabe_bank1 dkba_freigabe_bank2 dkba_mks_grund_zyl1 dkba_mks_grund_zyl10 dkba_mks_grund_zyl2 dkba_mks_grund_zyl3 dkba_mks_grund_zyl4 dkba_mks_grund_zyl5 dkba_mks_grund_zyl6 dkba_mks_grund_zyl7 dkba_mks_grund_zyl8 dkba_mks_grund_zyl9 dkba_mks_roh_zyl1 dkba_mks_roh_zyl10 dkba_mks_roh_zyl2 dkba_mks_roh_zyl3 dkba_mks_roh_zyl4 dkba_mks_roh_zyl5 dkba_mks_roh_zyl6 dkba_mks_roh_zyl7 dkba_mks_roh_zyl8 dkba_mks_roh_zyl9 dkba_mks_zyl1 dkba_mks_zyl10 dkba_mks_zyl2 dkba_mks_zyl3 dkba_mks_zyl4 dkba_mks_zyl5 dkba_mks_zyl6 dkba_mks_zyl7 dkba_mks_zyl8 dkba_mks_zyl9 dkba_n_max dkba_st dkba_tmot_f kva_can_cnt kva_mks_out_sum kva_mks_out_sum_last kva_q_mot lwv_mks ti_asp_cnt_zyl1 ti_asp_cnt_zyl10 ti_asp_cnt_zyl2 ti_asp_cnt_zyl3 ti_asp_cnt_zyl4 ti_asp_cnt_zyl5 ti_asp_cnt_zyl6 ti_asp_cnt_zyl7 ti_asp_cnt_zyl8 ti_asp_cnt_zyl9 ti_b1.laa_offs_wicht_f ti_b1.min ti_b1.mks_grund ti_b1.mks_max ti_b1.ml_max ti_b1.ml_mg_la ti_b1.ml_mg_la_f ti_b1.ml_mg_zyl ti_b1.pdiff ti_b1.phi_ende ti_b1.phi_ende_flug ti_b1.phi_ende_grad ti_b1.phi_ende_grund ti_b1.phi_ende_min ti_b1.phi_ende_roh ti_b1.phi_ev_v ti_b1.phi_ks_v ti_b1.qstat_f ti_b1.rho_f ti_b1.t_korr_f ti_b1.ub_offs ti_b2.laa_offs_wicht_f ti_b2.min ti_b2.mks_grund ti_b2.mks_max ti_b2.ml_max ti_b2.ml_mg_la ti_b2.ml_mg_la_f ti_b2.ml_mg_zyl ti_b2.pdiff ti_b2.phi_ende ti_b2.phi_ende_flug ti_b2.phi_ende_grad ti_b2.phi_ende_grund ti_b2.phi_ende_min ti_b2.phi_ende_roh ti_b2.phi_ev_v ti_b2.phi_ks_v ti_b2.qstat_f ti_b2.rho_f ti_b2.t_korr_f ti_b2.ub_offs ti_berech_zyl1 ti_berech_zyl10 ti_berech_zyl2 ti_berech_zyl3 ti_berech_zyl4 ti_berech_zyl5 ti_berech_zyl6 ti_berech_zyl7 ti_berech_zyl8 ti_berech_zyl9 ti_lin_offs_zyl1 ti_lin_offs_zyl10 ti_lin_offs_zyl2 ti_lin_offs_zyl3 ti_lin_offs_zyl4 ti_lin_offs_zyl5 ti_lin_offs_zyl6 ti_lin_offs_zyl7 ti_lin_offs_zyl8 ti_lin_offs_zyl9 ti_max ti_max_lim ti_mks_ns_grund ti_mks_ns_ist_init_b1 ti_mks_ns_ist_init_b2 ti_mks_ns_ist_zyl1 ti_mks_ns_ist_zyl10 ti_mks_ns_ist_zyl2 ti_mks_ns_ist_zyl3 ti_mks_ns_ist_zyl4 ti_mks_ns_ist_zyl5 ti_mks_ns_ist_zyl6 ti_mks_ns_ist_zyl7 ti_mks_ns_ist_zyl8 ti_mks_ns_ist_zyl9 ti_mks_ns_rel_zyl1 ti_mks_ns_rel_zyl10 ti_mks_ns_rel_zyl2 ti_mks_ns_rel_zyl3 ti_mks_ns_rel_zyl4 ti_mks_ns_rel_zyl5 ti_mks_ns_rel_zyl6 ti_mks_ns_rel_zyl7 ti_mks_ns_rel_zyl8 ti_mks_ns_rel_zyl9 ti_mks_ns_zyl1 ti_mks_ns_zyl10 ti_mks_ns_zyl2 ti_mks_ns_zyl3 ti_mks_ns_zyl4 ti_mks_ns_zyl5 ti_mks_ns_zyl6 ti_mks_ns_zyl7 ti_mks_ns_zyl8 ti_mks_ns_zyl9 ti_mks_soll_zyl1 ti_mks_soll_zyl10 ti_mks_soll_zyl2 ti_mks_soll_zyl3 ti_mks_soll_zyl4 ti_mks_soll_zyl5 ti_mks_soll_zyl6 ti_mks_soll_zyl7 ti_mks_soll_zyl8 ti_mks_soll_zyl9 ti_mks_start ti_mks_start_korr ti_mks_start_roh ti_ns_f ti_nw_asp_cnt ti_off_exd ti_off_exd_timeout ti_out_zyl1 ti_out_zyl10 ti_out_zyl2 ti_out_zyl3 ti_out_zyl4 ti_out_zyl5 ti_out_zyl6 ti_out_zyl7 ti_out_zyl8 ti_out_zyl9 ti_phi_ende_offs_b1 ti_phi_ende_offs_b2 ti_phi_ende_start ti_phi_ev_v_wurz ti_phi_flug_v ti_rf_max_dly ti_seg_time_f_zyl1 ti_seg_time_f_zyl10 ti_seg_time_f_zyl2 ti_seg_time_f_zyl3 ti_seg_time_f_zyl4 ti_seg_time_f_zyl5 ti_seg_time_f_zyl6 ti_seg_time_f_zyl7 ti_seg_time_f_zyl8 ti_seg_time_f_zyl9 ti_segm_cnt ti_soll_zyl1 ti_soll_zyl10 ti_soll_zyl2 ti_soll_zyl3 ti_soll_zyl4 ti_soll_zyl5 ti_soll_zyl6 ti_soll_zyl7 ti_soll_zyl8 ti_soll_zyl9 ti_start_f ti_start_pumg_f ti_status ti_status_aus_auss ti_status_aus_egas ti_status_aus_md ti_status_aus_sk ti_status_aus_ti ti_status_aus_ti_tz ti_status_aus_treiber ti_status_off_cfg ti_status_off_exd ti_tpu_start ti_tpu_zyl1 ti_tpu_zyl10 ti_tpu_zyl2 ti_tpu_zyl3 ti_tpu_zyl4 ti_tpu_zyl5 ti_tpu_zyl6 ti_tpu_zyl7 ti_tpu_zyl8 ti_tpu_zyl9 ti_tu_f_n_sst10 ti_tu_f_rf_sst4_b1 ti_tu_f_rf_sst4_b2 ti_tu_f_zyl_zyl1 ti_tu_f_zyl_zyl10 ti_tu_f_zyl_zyl2 ti_tu_f_zyl_zyl3 ti_tu_f_zyl_zyl4 ti_tu_f_zyl_zyl5 ti_tu_f_zyl_zyl6 ti_tu_f_zyl_zyl7 ti_tu_f_zyl_zyl8 ti_tu_f_zyl_zyl9 ti_wl_f_b1 ti_wl_f_b2 ti_wl_f_kh_b1 ti_wl_f_kh_b2 ti_wl_f_roh_b1 ti_wl_f_roh_b2 zgla_f_i_ant zgla_lam_delta zgla_lam_delta_filt_b1 zgla_lam_delta_filt_b2 zgla_lam_filt_konst_b1 zgla_lam_filt_konst_b2 zgla_st zgla_st_f_max zgla_st_f_min zgla_st_freigabe zgla_zyl_nr_b1 zgla_zyl_nr_b2 /end OUT_MEASUREMENT
/end FUNCTION
/begin FUNCTION Elektroluefter ""
 /begin DEF_CHARACTERISTIC K_ELU_ED_BLOCKIER_ZYKLUS_TIME K_ELU_ED_BLOCKIERT_CNT K_ELU_ED_BLOCKIERT_MAX K_ELU_ED_BLOCKIERT_MIN K_ELU_ED_OPENLOAD_CNT K_ELU_ED_SH_TO_GND_CNT K_ELU_ED_SH_TO_UB_DELAY K_ELU_ED_SH_TO_UB_OFF_TIME K_ELU_HYS_SCHLEPP K_ELU_IDENT_CYCLE_CNT_BEGR K_ELU_IDENT_CYCLE_TIME_BEGR K_ELU_IDENT_RESP_600W_MAX K_ELU_IDENT_RESP_600W_MIN K_ELU_IDENT_RESP_850W_MAX K_ELU_IDENT_RESP_850W_MIN K_ELU_PWM_AUS K_ELU_PWM_GRAD_ZUL K_ELU_PWM_IDENT K_ELU_PWM_MAX_ML K_ELU_PWM_MAX_MS K_ELU_PWM_MIN_ML K_ELU_PWM_MIN_MS K_ELU_PWM_OFFS K_ELU_T_ML_MIN K_ELU_T_MS_MAX K_ELU_TAN_DREH_ERSATZ K_ELU_TCR2_TICS K_ELU_TCR2_TICS_NL K_ELU_TKA_TMOT_DIFF K_ELU_TYP_CFG KF_ELU_PWM_MS KL_ELU_KKOS KL_ELU_TAN KL_ELU_TKA KL_ELU_TKAT KL_ELU_V_KORR /end DEF_CHARACTERISTIC
 /begin OUT_MEASUREMENT elu_dreh elu_dreh_sch elu_ed_blockiert_cnt elu_ed_blockiert_timer elu_ed_blockiert_zyklus_delay elu_ed_error_cycle_time elu_ed_fart_merker elu_ed_openload_cnt elu_ed_sh_to_gnd_cnt elu_ed_sh_to_ub_delay elu_ed_sh_to_ub_off_timer elu_exd_timeout elu_fkt_st elu_ident_cycle_cnt elu_ident_cycle_time elu_ident_timer elu_min_hys elu_pwm elu_pwm_ml elu_pwm_ml_filt elu_pwm_ms elu_st elu_t_periode /end OUT_MEASUREMENT
/end FUNCTION
/begin FUNCTION ELUP ""
 /begin DEF_CHARACTERISTIC K_ELUP_CFG K_ELUP_ED_ABS_DEL K_ELUP_ED_BRPGRAD_SW K_ELUP_ED_BRPGRAD_T K_ELUP_ED_DEL K_ELUP_ED_MVACP_GRAD_SW K_ELUP_ED_MVACP_GRAD_T K_ELUP_ED_PSAU_SW K_ELUP_OFF_TIME_MIN K_ELUP_ON_TIME_MAX K_ELUP_ON_TIME_MIN K_ELUP_PL_AN_SW K_ELUP_PL_IO_SW K_ELUP_PL_ON_TIME K_ELUP_UB_MIN KL_ELUP_AUS KL_ELUP_EIN KL_ELUP_EIN_V_DEL KL_ELUP_V_OFFS /end DEF_CHARACTERISTIC
 /begin OUT_MEASUREMENT elup_ed_abs_del elup_ed_aktiv elup_ed_brp_grad elup_ed_del elup_ed_mvacp_grad elup_ed_mvacp_old elup_ein_v_del elup_exd_timeout elup_interlock_time elup_pl_mvac_p_ende elup_pl_mvac_p_start elup_pl_st elup_sw_aus elup_sw_ein elup_v_offs /end OUT_MEASUREMENT
/end FUNCTION
/begin RECORD_LAYOUT TAD_UB_VV_SW AXIS_PTS_X 3 SWORD INDEX_INCR DIRECT NO_AXIS_PTS_X 1 UBYTE RESERVED 2 BYTE /end RECORD_LAYOUT
/begin RECORD_LAYOUT TGF_VV_VV_UW FNC_VALUES 1 UWORD COLUMN_DIR DIRECT /end RECORD_LAYOUT
/begin RECORD_LAYOUT TKF_SW_SW_SW FNC_VALUES 5 SWORD COLUMN_DIR DIRECT AXIS_PTS_X 3 SWORD INDEX_INCR DIRECT AXIS_PTS_Y 4 SWORD INDEX_INCR DIRECT NO_AXIS_PTS_X 1 UBYTE NO_AXIS_PTS_Y 2 UBYTE /end RECORD_LAYOUT
/begin RECORD_LAYOUT TKF_SW_SW_UB FNC_VALUES 5 UBYTE COLUMN_DIR DIRECT AXIS_PTS_X 3 SWORD INDEX_INCR DIRECT AXIS_PTS_Y 4 SWORD INDEX_INCR DIRECT NO_AXIS_PTS_X 1 UBYTE NO_AXIS_PTS_Y 2 UBYTE /end RECORD_LAYOUT
/begin RECORD_LAYOUT TKF_SW_SW_UW FNC_VALUES 5 UWORD COLUMN_DIR DIRECT AXIS_PTS_X 3 SWORD INDEX_INCR DIRECT AXIS_PTS_Y 4 SWORD INDEX_INCR DIRECT NO_AXIS_PTS_X 1 UBYTE NO_AXIS_PTS_Y 2 UBYTE /end RECORD_LAYOUT
/begin RECORD_LAYOUT TKF_UW_UW_UW FNC_VALUES 5 UWORD COLUMN_DIR DIRECT AXIS_PTS_X 3 UWORD INDEX_INCR DIRECT AXIS_PTS_Y 4 UWORD INDEX_INCR DIRECT NO_AXIS_PTS_X 1 UBYTE NO_AXIS_PTS_Y 2 UBYTE /end RECORD_LAYOUT
/begin RECORD_LAYOUT TKL_SW_VV_SW FNC_VALUES 4 SWORD COLUMN_DIR DIRECT AXIS_PTS_X 3 SWORD INDEX_INCR DIRECT NO_AXIS_PTS_X 1 UBYTE RESERVED 2 BYTE /end RECORD_LAYOUT
/begin RECORD_LAYOUT TKL_SW_VV_UB FNC_VALUES 4 UBYTE COLUMN_DIR DIRECT AXIS_PTS_X 3 SWORD INDEX_INCR DIRECT NO_AXIS_PTS_X 1 UBYTE RESERVED 2 BYTE /end RECORD_LAYOUT
/begin RECORD_LAYOUT TKL_SW_VV_UW FNC_VALUES 4 UWORD COLUMN_DIR DIRECT AXIS_PTS_X 3 SWORD INDEX_INCR DIRECT NO_AXIS_PTS_X 1 UBYTE RESERVED 2 BYTE /end RECORD_LAYOUT
/begin RECORD_LAYOUT TKL_UB_VV_UB FNC_VALUES 4 UBYTE COLUMN_DIR DIRECT AXIS_PTS_X 3 UBYTE INDEX_INCR DIRECT NO_AXIS_PTS_X 1 UBYTE RESERVED 2 BYTE /end RECORD_LAYOUT
/begin RECORD_LAYOUT TKL_UW_VV_SW FNC_VALUES 4 SWORD COLUMN_DIR DIRECT AXIS_PTS_X 3 UWORD INDEX_INCR DIRECT NO_AXIS_PTS_X 1 UBYTE RESERVED 2 BYTE /end RECORD_LAYOUT
/begin RECORD_LAYOUT TKL_UW_VV_UW FNC_VALUES 4 UWORD COLUMN_DIR DIRECT AXIS_PTS_X 3 UWORD INDEX_INCR DIRECT NO_AXIS_PTS_X 1 UBYTE RESERVED 2 BYTE /end RECORD_LAYOUT
/begin RECORD_LAYOUT TKW_VV_VV_SB FNC_VALUES 1 SBYTE COLUMN_DIR DIRECT /end RECORD_LAYOUT
/begin RECORD_LAYOUT TKW_VV_VV_SW FNC_VALUES 1 SWORD COLUMN_DIR DIRECT /end RECORD_LAYOUT
/begin RECORD_LAYOUT TKW_VV_VV_UB FNC_VALUES 1 UBYTE COLUMN_DIR DIRECT /end RECORD_LAYOUT
/begin RECORD_LAYOUT TKW_VV_VV_UW FNC_VALUES 1 UWORD COLUMN_DIR DIRECT /end RECORD_LAYOUT
/end MODULE
/end PROJECT
