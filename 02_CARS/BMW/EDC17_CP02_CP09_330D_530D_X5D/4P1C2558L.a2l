ASAP2_VERSION 1 4
/begin PROJECT P_558 "EDC17_CP02"
/begin HEADER "" VERSION "V1C1" PROJECT_NO P_558 /end HEADER
/begin MODULE DIM ""
/begin MOD_COMMON "" BYTE_ORDER MSB_LAST ALIGNMENT_BYTE 1 ALIGNMENT_WORD 2 ALIGNMENT_LONG 4 ALIGNMENT_FLOAT32_IEEE 4 /end MOD_COMMON
/begin CHARACTERISTIC InjCrv_ctATSPoI2Sel_C "Selektionsparameter für Arrayelement Ansauglufttemperatur (EngDa_tFld) für die Nacheinspritzung 2" VALUE 0x80061082 Val_Wu8 2.00000000000 IndSysTempFldSel 0.00 2.00000000000 FORMAT "%13.11" /end CHARACTERISTIC
/begin CHARACTERISTIC InjCrv_ctCylPoI1Clsn_C "Nummer des kollidierenden Zylinders" VALUE 0x8005E2B6 Val_Wu8 255.0 OneToOne 0.00 255.0 FORMAT "%5.1" /end CHARACTERISTIC
/begin CHARACTERISTIC InjCrv_facPiI1QntMax_C "Wichtungsfaktor für die berechnete Sollmenge der Voreinspritzung 1" VALUE 0x8005A78E Val_Ws16 1.000000 Fact1 0.00 1.000000 FORMAT "%8.6" EXTENDED_LIMITS -256.0000 255.9922 /end CHARACTERISTIC
/begin CHARACTERISTIC InjCrv_facPiI2APSQCor0Rgn_GCUR "atmosphärendruckabhängige Mengenkorrekturkennlinie für PiI2 für die Regenerationsstufe 1" CURVE 0x8005C68C CurG_Ws16 1.000000 Fact 0.00 1.000000 FORMAT "%8.6" EXTENDED_LIMITS -4.000000 3.999878
 /begin AXIS_DESCR COM_AXIS EnvP_p Pres_hPa 12 -32768.00 3500.00 FORMAT "%8.2" EXTENDED_LIMITS -32768.00 32767.00 AXIS_PTS_REF InjCrv_facPiI2APSQCorRgn_AXIS /end AXIS_DESCR
/end CHARACTERISTIC
/begin CHARACTERISTIC InjCrv_facPiI2APSQCor1Rgn_GCUR "atmosphärendruckabhängige Mengenkorrekturkennlinie für PiI2 für die Regenerationsstufe 2" CURVE 0x8005C6A4 CurG_Ws16 1.000000 Fact 0.00 1.000000 FORMAT "%8.6" EXTENDED_LIMITS -4.000000 3.999878
 /begin AXIS_DESCR COM_AXIS EnvP_p Pres_hPa 12 -32768.00 3500.00 FORMAT "%8.2" EXTENDED_LIMITS -32768.00 32767.00 AXIS_PTS_REF InjCrv_facPiI2APSQCorRgn_AXIS /end AXIS_DESCR
/end CHARACTERISTIC
/begin AXIS_PTS InjCrv_facPiI2APSQCorRgn_AXIS "gemeinsame Stützstellen für atmosphärendruckabhängige Mengenkorrekturkennlinien für PiI2 für die Regeneration" 0x8005C6BC EnvP_p Axis_Xs16 65535.00 Pres_hPa 12 -32768.00 32767.00 FORMAT "%8.2" DEPOSIT ABSOLUTE /end AXIS_PTS
/begin CHARACTERISTIC InjCrv_facPiI2APSQCorStrt_CUR "weighting factor of atmospheric pressure for PiI2 quantity correction" CURVE 0x8007A484 Kl_Xs16_Ws16 1.000000 Fact 0.00 1.000000 FORMAT "%8.6" EXTENDED_LIMITS -4.000000 3.999878
 /begin AXIS_DESCR STD_AXIS EnvP_p Pres_hPa 2 0.00 3500.000 FORMAT "%8.3" EXTENDED_LIMITS -32768.00 32767.00 DEPOSIT ABSOLUTE /end AXIS_DESCR
/end CHARACTERISTIC
/begin CHARACTERISTIC InjCrv_facPiI2APSQCor_CUR "atmosphärendruckabhängige Mengenkorrekturkennlinie für PiI 2" CURVE 0x8005C5E2 Cur_Xs16Ws16 1.000000 Fact 0.00 1.000000 FORMAT "%8.6" EXTENDED_LIMITS -4.000000 3.999878
 /begin AXIS_DESCR STD_AXIS EnvP_p Pres_hPa 8 0.00 3500.000 FORMAT "%8.3" EXTENDED_LIMITS -32768.00 32767.00 DEPOSIT ABSOLUTE /end AXIS_DESCR
/end CHARACTERISTIC
/begin CHARACTERISTIC InjCrv_facPiI2ATSQCor0Rgn_GCUR "umgebungsluftabhängige Mengenkorrekturkennlinie für PiI2 für die Regenerationsstufe 1" CURVE 0x8005C6D6 CurG_Ws16 1.000000 Fact 0.00 1.000000 FORMAT "%8.6" EXTENDED_LIMITS -4.000000 3.999878
 /begin AXIS_DESCR COM_AXIS InjCrv_tAirPiI Temp_Cels 12 -3549.940 3003.560 FORMAT "%8.3" AXIS_PTS_REF InjCrv_facPiI2ATSQCorRgn_AXIS /end AXIS_DESCR
/end CHARACTERISTIC
/begin CHARACTERISTIC InjCrv_facPiI2ATSQCor1Rgn_GCUR "umgebungsluftabhängige Mengenkorrekturkennlinie für PiI2 für die Regenerationsstufe 2" CURVE 0x8005C6EE CurG_Ws16 1.000000 Fact 0.00 1.000000 FORMAT "%8.6" EXTENDED_LIMITS -4.000000 3.999878
 /begin AXIS_DESCR COM_AXIS InjCrv_tAirPiI Temp_Cels 12 -3549.940 3003.560 FORMAT "%8.3" AXIS_PTS_REF InjCrv_facPiI2ATSQCorRgn_AXIS /end AXIS_DESCR
/end CHARACTERISTIC
/begin AXIS_PTS InjCrv_facPiI2ATSQCorRgn_AXIS "gemeinsame Stützstellen für umgebungstemperaturabhängige Mengenkorrekturkennlinien für PiI2 für die Regeneration" 0x8005C706 InjCrv_tAirPiI Axis_Xs16 6553.500 Temp_Cels 12 -3549.940 3003.560 FORMAT "%8.3" DEPOSIT ABSOLUTE /end AXIS_PTS
/begin CHARACTERISTIC InjCrv_facPiI2ATSQCorStrt_CUR "weighting factor of intake air temperature for PiI2 quantity correction" CURVE 0x8007A48E Kl_Xs16_Ws16 1.000000 Fact 0.00 1.000000 FORMAT "%8.6" EXTENDED_LIMITS -4.000000 3.999878
 /begin AXIS_DESCR STD_AXIS InjCrv_tAirPiI Temp_Cels 2 -50.14000 199.8600 FORMAT "%8.4" EXTENDED_LIMITS -3549.940 3003.560 DEPOSIT ABSOLUTE /end AXIS_DESCR
/end CHARACTERISTIC
/begin CHARACTERISTIC InjCrv_facPiI2ATSQCor_CUR "ansauglufttemperaturabhängige Mengenkorrekturkennlinie für PiI2" CURVE 0x8005C604 Cur_Xs16Ws16 1.000000 Fact 0.00 1.000000 FORMAT "%8.6" EXTENDED_LIMITS -4.000000 3.999878
 /begin AXIS_DESCR STD_AXIS InjCrv_tAirPiI Temp_Cels 8 -50.14000 199.8600 FORMAT "%8.4" EXTENDED_LIMITS -3549.940 3003.560 DEPOSIT ABSOLUTE /end AXIS_DESCR
/end CHARACTERISTIC
/begin CHARACTERISTIC InjCrv_facPiI2ATSSOECor0Rgn_GCUR "umgebungstemperaturabhängige Ansteuerbeginnkorrekturkennlinie für PiI2 für die Regenerationsstufe 1" CURVE 0x8005C720 CurG_Ws16 1.000000 Fact 0.00 1.000000 FORMAT "%8.6" EXTENDED_LIMITS -4.000000 3.999878
 /begin AXIS_DESCR COM_AXIS InjCrv_tAirPiI Temp_Cels 12 -3549.940 3003.560 FORMAT "%8.3" AXIS_PTS_REF InjCrv_facPiI2ATSSOECorRgn_AXIS /end AXIS_DESCR
/end CHARACTERISTIC
/begin CHARACTERISTIC InjCrv_facPiI2ATSSOECor1Rgn_GCUR "umgebungstemperaturabhängige Ansteuerbeginnkorrekturkennlinie für PiI2 für die Regenerationsstufe 2" CURVE 0x8005C738 CurG_Ws16 1.000000 Fact 0.00 1.000000 FORMAT "%8.6" EXTENDED_LIMITS -4.000000 3.999878
 /begin AXIS_DESCR COM_AXIS InjCrv_tAirPiI Temp_Cels 12 -3549.940 3003.560 FORMAT "%8.3" AXIS_PTS_REF InjCrv_facPiI2ATSSOECorRgn_AXIS /end AXIS_DESCR
/end CHARACTERISTIC
/begin AXIS_PTS InjCrv_facPiI2ATSSOECorRgn_AXIS "gemeinsame Stützstellen für umgebungstemperaturabhängige Ansteuerbeginnkorrekturkennlinien für PiI2 für die Regeneration" 0x8005C750 InjCrv_tAirPiI Axis_Xs16 6553.500 Temp_Cels 12 -3549.940 3003.560 FORMAT "%8.3" DEPOSIT ABSOLUTE /end AXIS_PTS
/begin CHARACTERISTIC InjCrv_facPiI2ATSSOECor_CUR "Ansauglufttemperaturspezifischer Gewichtungsfaktor für PiI2" CURVE 0x8005C626 Cur_Xs16Ws16 1.000000 Fact 0.00 1.000000 FORMAT "%8.6" EXTENDED_LIMITS -4.000000 3.999878
 /begin AXIS_DESCR STD_AXIS InjCrv_tAirPiI Temp_Cels 8 -50.14000 199.8600 FORMAT "%8.4" EXTENDED_LIMITS -3549.940 3003.560 DEPOSIT ABSOLUTE /end AXIS_DESCR
/end CHARACTERISTIC
/begin CHARACTERISTIC InjCrv_facPiI2ETSQCor0Rgn_GCUR "motortemperaturabhängige Mengenkorrekturkennlinie für PiI2 für die Regenerationsstufe 1" CURVE 0x8005C76A CurG_Ws16 1.000000 Fact 0.00 1.000000 FORMAT "%8.6" EXTENDED_LIMITS -4.000000 3.999878
 /begin AXIS_DESCR COM_AXIS InjSys_tEng Temp_Cels 12 -3549.940 3003.560 FORMAT "%8.3" AXIS_PTS_REF InjCrv_facPiI2ETSQCorRgn_AXIS /end AXIS_DESCR
/end CHARACTERISTIC
/begin CHARACTERISTIC InjCrv_facPiI2ETSQCor1Rgn_GCUR "motortemperaturabhängige Mengenkorrekturkennlinie für PiI2 für die Regenerationsstufe 2" CURVE 0x8005C782 CurG_Ws16 1.000000 Fact 0.00 1.000000 FORMAT "%8.6" EXTENDED_LIMITS -4.000000 3.999878
 /begin AXIS_DESCR COM_AXIS InjSys_tEng Temp_Cels 12 -3549.940 3003.560 FORMAT "%8.3" AXIS_PTS_REF InjCrv_facPiI2ETSQCorRgn_AXIS /end AXIS_DESCR
/end CHARACTERISTIC
/begin AXIS_PTS InjCrv_facPiI2ETSQCorRgn_AXIS "gemeinsame Stützstellen für motortemperaturabhängige Mengenkorrekturkennlinien für PiI2 für die Regeneration" 0x8005C79A InjSys_tEng Axis_Xs16 6553.500 Temp_Cels 12 -3549.940 3003.560 FORMAT "%8.3" DEPOSIT ABSOLUTE /end AXIS_PTS
/begin CHARACTERISTIC InjCrv_facPiI2ETSQCorStrt_CUR "weighting factor of engine temperature for PiI2 quantity correction" CURVE 0x8007A498 Kl_Xs16_Ws16 1.000000 Fact 0.00 1.000000 FORMAT "%8.6" EXTENDED_LIMITS -4.000000 3.999878
 /begin AXIS_DESCR STD_AXIS InjSys_tEng Temp_Cels 2 -50.14000 199.8600 FORMAT "%8.4" EXTENDED_LIMITS -3549.940 3003.560 DEPOSIT ABSOLUTE /end AXIS_DESCR
/end CHARACTERISTIC
/begin CHARACTERISTIC InjCrv_facPiI2ETSQCor_CUR "motortemperaturabhängige Mengenkorrekturkennlinie für PiI2" CURVE 0x8005C648 Cur_Xs16Ws16 1.000000 Fact 0.00 1.000000 FORMAT "%8.6" EXTENDED_LIMITS -4.000000 3.999878
 /begin AXIS_DESCR STD_AXIS InjSys_tEng Temp_Cels 8 -50.14000 199.8600 FORMAT "%8.4" EXTENDED_LIMITS -3549.940 3003.560 DEPOSIT ABSOLUTE /end AXIS_DESCR
/end CHARACTERISTIC
/begin CHARACTERISTIC InjCrv_facPiI2ETSSOECor0Rgn_GCUR "motortemperaturabhängige Ansteuerbeginnkorrekturkennlinie für die PiI2 für die Regenerationsstufe 1" CURVE 0x8005C7B4 CurG_Ws16 1.000000 Fact 0.00 1.000000 FORMAT "%8.6" EXTENDED_LIMITS -4.000000 3.999878
 /begin AXIS_DESCR COM_AXIS InjSys_tEng Temp_Cels 12 -3549.940 3003.560 FORMAT "%8.3" AXIS_PTS_REF InjCrv_facPiI2ETSSOECorRgn_AXIS /end AXIS_DESCR
/end CHARACTERISTIC
/begin CHARACTERISTIC InjCrv_facPiI2ETSSOECor1Rgn_GCUR "motortemperaturabhängige Ansteuerbeginnkorrekturkennlinie für die PiI2 für die Regenerationsstufe 2" CURVE 0x8005C7CC CurG_Ws16 1.000000 Fact 0.00 1.000000 FORMAT "%8.6" EXTENDED_LIMITS -4.000000 3.999878
 /begin AXIS_DESCR COM_AXIS InjSys_tEng Temp_Cels 12 -3549.940 3003.560 FORMAT "%8.3" AXIS_PTS_REF InjCrv_facPiI2ETSSOECorRgn_AXIS /end AXIS_DESCR
/end CHARACTERISTIC
/begin AXIS_PTS InjCrv_facPiI2ETSSOECorRgn_AXIS "gemeinsame Stützstellen für motortemperaturabhängige Ansteuerbeginnkorrekturkennlinien für PiI2 für die Regeneration" 0x8005C7E4 InjSys_tEng Axis_Xs16 6553.500 Temp_Cels 12 -3549.940 3003.560 FORMAT "%8.3" DEPOSIT ABSOLUTE /end AXIS_PTS
/begin CHARACTERISTIC InjCrv_facPiI2ETSSOECorStrt_CUR "motortemperaturabhängige Ansteuerbeginnkorrekturkennlinie für Voreinspritzung 2 im Startfall" CURVE 0x8007A4A2 Kl_Xs16_Ws16 1.000000 Fact 0.00 1.000000 FORMAT "%8.6" EXTENDED_LIMITS -4.000000 3.999878
 /begin AXIS_DESCR STD_AXIS InjSys_tEng Temp_Cels 2 -50.14000 199.8600 FORMAT "%8.4" EXTENDED_LIMITS -3549.940 3003.560 DEPOSIT ABSOLUTE /end AXIS_DESCR
/end CHARACTERISTIC
/begin CHARACTERISTIC InjCrv_facPiI2ETSSOECor_CUR "motortemperaturabhängige Ansteuerbeginnkorrekturkennlinie für PiI2" CURVE 0x8005C66A Cur_Xs16Ws16 1.000000 Fact 0.00 1.000000 FORMAT "%8.6" EXTENDED_LIMITS -4.000000 3.999878
 /begin AXIS_DESCR STD_AXIS InjSys_tEng Temp_Cels 8 -50.14000 199.8600 FORMAT "%8.4" EXTENDED_LIMITS -3549.940 3003.560 DEPOSIT ABSOLUTE /end AXIS_DESCR
/end CHARACTERISTIC
/begin CHARACTERISTIC InjCrv_facPiI2QntMin_CUR "Faktor zur Berechnung der Mindestmenge für die Abschaltung der Voreinspritzung PiI2" CURVE 0x8005A790 Cur_Xs16Ws16 1.000000 Fact1 0.00 1.000000 FORMAT "%8.6" EXTENDED_LIMITS -256.0000 255.9922
 /begin AXIS_DESCR STD_AXIS RailP_pFlt Pres_Rail 8 0.00 2000.000 FORMAT "%5.3" EXTENDED_LIMITS -3276.800 3276.700 DEPOSIT ABSOLUTE /end AXIS_DESCR
/end CHARACTERISTIC
/begin CHARACTERISTIC InjCrv_facPiI2QntRmp0Val_GCUR "Faktorisierungskennlinie für die Menge der PiI2" CURVE 0x8005D642 CurG_Ws16 3.999939 CoEOMSwt_S16 -2.000000 1.999939 FORMAT "%8.6"
 /begin AXIS_DESCR COM_AXIS CoEOM_facRmpVal CoEOMSwt_S16 11 -2.000000 1.999939 FORMAT "%8.6" AXIS_PTS_REF InjCrv_facPiI2QntRmpValX_AXIS /end AXIS_DESCR
/end CHARACTERISTIC
/begin CHARACTERISTIC InjCrv_facPiI2QntRmp1Val_GCUR "Faktorisierungskennlinie für die Menge der PiI2" CURVE 0x8005D658 CurG_Ws16 3.999939 CoEOMSwt_S16 -2.000000 1.999939 FORMAT "%8.6"
 /begin AXIS_DESCR COM_AXIS CoEOM_facRmpVal CoEOMSwt_S16 11 -2.000000 1.999939 FORMAT "%8.6" AXIS_PTS_REF InjCrv_facPiI2QntRmpValX_AXIS /end AXIS_DESCR
/end CHARACTERISTIC
/begin AXIS_PTS InjCrv_facPiI2QntRmpValX_AXIS "Gruppenkennlinien-Achse für die Gewichtung des Mengen-Faktors der PiI2" 0x8005D66E CoEOM_facRmpVal Axis_Xs16 3.999939 CoEOMSwt_S16 11 -2.000000 1.999939 FORMAT "%8.6" DEPOSIT ABSOLUTE /end AXIS_PTS
/begin CHARACTERISTIC InjCrv_facPiI2SOERmp0Val_GCUR "Faktorisierungskennlinie für den Einspritzbeginn der PiI2" CURVE 0x8005D686 CurG_Ws16 3.999939 CoEOMSwt_S16 -2.000000 1.999939 FORMAT "%8.6"
 /begin AXIS_DESCR COM_AXIS CoEOM_facRmpVal CoEOMSwt_S16 11 -2.000000 1.999939 FORMAT "%8.6" AXIS_PTS_REF InjCrv_facPiI2SOERmpValX_AXIS /end AXIS_DESCR
/end CHARACTERISTIC
/begin CHARACTERISTIC InjCrv_facPiI2SOERmp1Val_GCUR "Faktorisierungskennlinie für den Einspritzbeginn der PiI2" CURVE 0x8005D69C CurG_Ws16 3.999939 CoEOMSwt_S16 -2.000000 1.999939 FORMAT "%8.6"
 /begin AXIS_DESCR COM_AXIS CoEOM_facRmpVal CoEOMSwt_S16 11 -2.000000 1.999939 FORMAT "%8.6" AXIS_PTS_REF InjCrv_facPiI2SOERmpValX_AXIS /end AXIS_DESCR
/end CHARACTERISTIC
/begin AXIS_PTS InjCrv_facPiI2SOERmpValX_AXIS "Gruppenkennlinien-Achse für die Gewichtung des Einspritzbeginn-Faktors der PiI2" 0x8005D6B2 CoEOM_facRmpVal Axis_Xs16 3.999939 CoEOMSwt_S16 11 -2.000000 1.999939 FORMAT "%8.6" DEPOSIT ABSOLUTE /end AXIS_PTS
/begin CHARACTERISTIC InjCrv_facPiI3APSQCor_CUR "atmosphärendruckabhängige Mengenkorrekturkennlinie für Voreinspritzung 3" CURVE 0x8005E22E Cur_Xs16Ws16 1.000000 Fact 0.00 1.000000 FORMAT "%8.6" EXTENDED_LIMITS -4.000000 3.999878
 /begin AXIS_DESCR STD_AXIS EnvP_p Pres_hPa 8 0.00 3500.000 FORMAT "%8.3" EXTENDED_LIMITS -32768.00 32767.00 DEPOSIT ABSOLUTE /end AXIS_DESCR
/end CHARACTERISTIC
/begin CHARACTERISTIC InjCrv_facPiI3ATSQCor_CUR "ansauglufttemperaturabhängige Mengenkorrekturkennlinie für Voreinspritzung 3" CURVE 0x8005E250 Cur_Xs16Ws16 1.000000 Fact 0.00 1.000000 FORMAT "%8.6" EXTENDED_LIMITS -4.000000 3.999878
 /begin AXIS_DESCR STD_AXIS InjCrv_tAirPiI Temp_Cels 8 -50.14000 199.8600 FORMAT "%8.4" EXTENDED_LIMITS -3549.940 3003.560 DEPOSIT ABSOLUTE /end AXIS_DESCR
/end CHARACTERISTIC
/begin CHARACTERISTIC InjCrv_facPiI3ETSQCor_CUR "motortemperaturabhängige Mengenkorrekturkennlinie für Voreinspritzung 3" CURVE 0x8005E272 Cur_Xs16Ws16 1.000000 Fact 0.00 1.000000 FORMAT "%8.6" EXTENDED_LIMITS -4.000000 3.999878
 /begin AXIS_DESCR STD_AXIS InjSys_tEng Temp_Cels 8 -50.14000 199.8600 FORMAT "%8.4" EXTENDED_LIMITS -3549.940 3003.560 DEPOSIT ABSOLUTE /end AXIS_DESCR
/end CHARACTERISTIC
/begin CHARACTERISTIC InjCrv_facPiI3ETSSOECor_CUR "motortemperaturabhängige Ansteuerbeginnkorrekturkennlinie für Voreinspritzung 3" CURVE 0x8005E294 Cur_Xs16Ws16 1.000000 Fact 0.00 1.000000 FORMAT "%8.6" EXTENDED_LIMITS -4.000000 3.999878
 /begin AXIS_DESCR STD_AXIS InjSys_tEng Temp_Cels 8 -50.14000 199.8600 FORMAT "%8.4" EXTENDED_LIMITS -3549.940 3003.560 DEPOSIT ABSOLUTE /end AXIS_DESCR
/end CHARACTERISTIC
/begin CHARACTERISTIC InjCrv_facPiI3QntMin_CUR "raildruckabhängige Kennlinie zur Ermittlung des Faktor für die Berechnung der Mindestmenge um die PiI3 abzuschalten" CURVE 0x8005D7FA Cur_Xs16Ws16 1.000000 Fact1 0.00 1.000000 FORMAT "%8.6" EXTENDED_LIMITS -256.0000 255.9922
 /begin AXIS_DESCR STD_AXIS RailP_pFlt Pres_Rail 8 0.00 2000.000 FORMAT "%5.3" EXTENDED_LIMITS -3276.800 3276.700 DEPOSIT ABSOLUTE /end AXIS_DESCR
/end CHARACTERISTIC
/begin CHARACTERISTIC InjCrv_facPoI1APSQCor_CUR "atmosphärendruckabhängige Mengenkorrekturkennlinie für PoI1" CURVE 0x8005E450 Cur_Xs16Ws16 1.000000 Fact 0.00 1.000000 FORMAT "%8.6" EXTENDED_LIMITS -4.000000 3.999878
 /begin AXIS_DESCR STD_AXIS EnvP_p Pres_hPa 6 0.00 3500.000 FORMAT "%8.3" EXTENDED_LIMITS -32768.00 32767.00 DEPOSIT ABSOLUTE /end AXIS_DESCR
/end CHARACTERISTIC
/begin CHARACTERISTIC InjCrv_facPoI1ETSPhiCor_CUR "motortemperaturabhängige Winkelkorrekturkennlinie für PoI1" CURVE 0x8005E46A Cur_Xs16Ws16 1.000000 Fact 0.00 1.000000 FORMAT "%8.6" EXTENDED_LIMITS -4.000000 3.999878
 /begin AXIS_DESCR STD_AXIS InjSys_tEng Temp_Cels 1 -50.14000 199.8600 FORMAT "%8.4" EXTENDED_LIMITS -3549.940 3003.560 DEPOSIT ABSOLUTE /end AXIS_DESCR
/end CHARACTERISTIC
/begin CHARACTERISTIC InjCrv_facPoI1ETSQCor_CUR "motortemperaturabhängige Mengenkorrekturkennlinie für PoI1" CURVE 0x8005E470 Cur_Xs16Ws16 1.000000 Fact 0.00 1.000000 FORMAT "%8.6" EXTENDED_LIMITS -4.000000 3.999878
 /begin AXIS_DESCR STD_AXIS InjSys_tEng Temp_Cels 1 -50.14000 199.8600 FORMAT "%8.4" EXTENDED_LIMITS -3549.940 3003.560 DEPOSIT ABSOLUTE /end AXIS_DESCR
/end CHARACTERISTIC
/begin CHARACTERISTIC InjCrv_facPoI1QntMin_C "Faktor zum Umrechnen der nach unten begrenzenden Menge der PoI1" VALUE 0x8005E2B8 Val_Ws16 1.000000 Fact1 0.00 1.000000 FORMAT "%8.6" EXTENDED_LIMITS -256.0000 255.9922 /end CHARACTERISTIC
/begin CHARACTERISTIC InjCrv_facPoI1QntRmp0Val_GCUR "Faktorisierungskennlinie für die Menge der PoI1" CURVE 0x8005ED04 CurG_Ws16 3.999939 CoEOMSwt_S16 -2.000000 1.999939 FORMAT "%8.6"
 /begin AXIS_DESCR COM_AXIS CoEOM_facRmpVal CoEOMSwt_S16 11 -2.000000 1.999939 FORMAT "%8.6" AXIS_PTS_REF InjCrv_facPoI1QntRmpValX_AXIS /end AXIS_DESCR
/end CHARACTERISTIC
/begin CHARACTERISTIC InjCrv_facPoI1QntRmp1Val_GCUR "Faktorisierungskennlinie für die Menge der PoI1" CURVE 0x8005ED1A CurG_Ws16 3.999939 CoEOMSwt_S16 -2.000000 1.999939 FORMAT "%8.6"
 /begin AXIS_DESCR COM_AXIS CoEOM_facRmpVal CoEOMSwt_S16 11 -2.000000 1.999939 FORMAT "%8.6" AXIS_PTS_REF InjCrv_facPoI1QntRmpValX_AXIS /end AXIS_DESCR
/end CHARACTERISTIC
/begin AXIS_PTS InjCrv_facPoI1QntRmpValX_AXIS "Gruppenkennlinien-Achse für die Gewichtung des Mengen-Faktors der PoI1" 0x8005ED30 CoEOM_facRmpVal Axis_Xs16 3.999939 CoEOMSwt_S16 11 -2.000000 1.999939 FORMAT "%8.6" DEPOSIT ABSOLUTE /end AXIS_PTS
/begin CHARACTERISTIC InjCrv_facPoI1SOERmp0Val_GCUR "Faktorisierungskennlinie für den Einspritzbeginn der PoI1" CURVE 0x8005ED48 CurG_Ws16 3.999939 CoEOMSwt_S16 -2.000000 1.999939 FORMAT "%8.6"
 /begin AXIS_DESCR COM_AXIS CoEOM_facRmpVal CoEOMSwt_S16 11 -2.000000 1.999939 FORMAT "%8.6" AXIS_PTS_REF InjCrv_facPoI1SOERmpValX_AXIS /end AXIS_DESCR
/end CHARACTERISTIC
/begin CHARACTERISTIC InjCrv_facPoI1SOERmp1Val_GCUR "Faktorisierungskennlinie für den Einspritzbeginn der PoI1" CURVE 0x8005ED5E CurG_Ws16 3.999939 CoEOMSwt_S16 -2.000000 1.999939 FORMAT "%8.6"
 /begin AXIS_DESCR COM_AXIS CoEOM_facRmpVal CoEOMSwt_S16 11 -2.000000 1.999939 FORMAT "%8.6" AXIS_PTS_REF InjCrv_facPoI1SOERmpValX_AXIS /end AXIS_DESCR
/end CHARACTERISTIC
/begin AXIS_PTS InjCrv_facPoI1SOERmpValX_AXIS "Gruppenkennlinien-Achse für die Gewichtung des Einspritzbeginn-Faktors der PoI1" 0x8005ED74 CoEOM_facRmpVal Axis_Xs16 3.999939 CoEOMSwt_S16 11 -2.000000 1.999939 FORMAT "%8.6" DEPOSIT ABSOLUTE /end AXIS_PTS
/begin CHARACTERISTIC InjCrv_facPoI2AngRmp0Val_GCUR "Faktorisierungskennlinie für den Einspritzbeginn der PoI2, Winkelkomponente" CURVE 0x8006267A CurG_Ws16 3.999939 CoEOMSwt_S16 -2.000000 1.999939 FORMAT "%8.6"
 /begin AXIS_DESCR COM_AXIS CoEOM_facRmpVal CoEOMSwt_S16 11 -2.000000 1.999939 FORMAT "%8.6" AXIS_PTS_REF InjCrv_facPoI2AngRmpValX_AXIS /end AXIS_DESCR
/end CHARACTERISTIC
/begin CHARACTERISTIC InjCrv_facPoI2AngRmp1Val_GCUR "Faktorisierungskennlinie für den Einspritzbeginn der PoI2, Winkelkomponente" CURVE 0x80062690 CurG_Ws16 3.999939 CoEOMSwt_S16 -2.000000 1.999939 FORMAT "%8.6"
 /begin AXIS_DESCR COM_AXIS CoEOM_facRmpVal CoEOMSwt_S16 11 -2.000000 1.999939 FORMAT "%8.6" AXIS_PTS_REF InjCrv_facPoI2AngRmpValX_AXIS /end AXIS_DESCR
/end CHARACTERISTIC
/begin AXIS_PTS InjCrv_facPoI2AngRmpValX_AXIS "Gruppenkennlinien-Achse für die Gewichtung des Einspritzbeginn-Faktors der PoI2, Winkelkomponente" 0x800626A6 CoEOM_facRmpVal Axis_Xs16 3.999939 CoEOMSwt_S16 11 -2.000000 1.999939 FORMAT "%8.6" DEPOSIT ABSOLUTE /end AXIS_PTS
/begin CHARACTERISTIC InjCrv_facPoI2APSQCor0Rgn_GCUR "atmosphärendruckabhängige Mengenkorrekturkennlinie der PoI2 für die Regenerationsstufe 1" CURVE 0x80061116 CurG_Ws16 1.000000 Fact 0.00 1.000000 FORMAT "%8.6" EXTENDED_LIMITS -4.000000 3.999878
 /begin AXIS_DESCR COM_AXIS EnvP_p Pres_hPa 12 0.00 3500.000 FORMAT "%8.3" EXTENDED_LIMITS -32768.00 32767.00 AXIS_PTS_REF InjCrv_facPoI2APSQCorRgn_AXIS /end AXIS_DESCR
/end CHARACTERISTIC
/begin CHARACTERISTIC InjCrv_facPoI2APSQCor1Rgn_GCUR "atmosphärendruckabhängige Mengenkorrekturkennlinie der PoI2 für die Regenerationsstufe 2" CURVE 0x8006112E CurG_Ws16 1.000000 Fact 0.00 1.000000 FORMAT "%8.6" EXTENDED_LIMITS -4.000000 3.999878
 /begin AXIS_DESCR COM_AXIS EnvP_p Pres_hPa 12 0.00 3500.000 FORMAT "%8.3" EXTENDED_LIMITS -32768.00 32767.00 AXIS_PTS_REF InjCrv_facPoI2APSQCorRgn_AXIS /end AXIS_DESCR
/end CHARACTERISTIC
/begin AXIS_PTS InjCrv_facPoI2APSQCorRgn_AXIS "gemeinsame Stützstellen für atmosphärendruckabhängige Mengenkorrekturkennlinien der PoI2 für die Regeneration" 0x80061146 EnvP_p Axis_Xs16 3500.000 Pres_hPa 12 0.00 3500.000 FORMAT "%8.3" EXTENDED_LIMITS -32768.00 32767.00 DEPOSIT ABSOLUTE /end AXIS_PTS
/begin CHARACTERISTIC InjCrv_facPoI2APSSOECor0Rgn_GCUR "atmosphärendruckabhängige Ansteuerbeginnkorrekturkennlinie für PoI2 für die Regenerationsstufe 1" CURVE 0x80061160 CurG_Ws16 1.000000 Fact 0.00 1.000000 FORMAT "%8.6" EXTENDED_LIMITS -4.000000 3.999878
 /begin AXIS_DESCR COM_AXIS EnvP_p Pres_hPa 12 0.00 3500.000 FORMAT "%8.3" EXTENDED_LIMITS -32768.00 32767.00 AXIS_PTS_REF InjCrv_facPoI2APSSOECorRgn_AXIS /end AXIS_DESCR
/end CHARACTERISTIC
/begin CHARACTERISTIC InjCrv_facPoI2APSSOECor1Rgn_GCUR "atmosphärendruckabhängige Ansteuerbeginnkorrekturkennlinie für PoI2 für die Regenerationsstufe 2" CURVE 0x80061178 CurG_Ws16 1.000000 Fact 0.00 1.000000 FORMAT "%8.6" EXTENDED_LIMITS -4.000000 3.999878
 /begin AXIS_DESCR COM_AXIS EnvP_p Pres_hPa 12 0.00 3500.000 FORMAT "%8.3" EXTENDED_LIMITS -32768.00 32767.00 AXIS_PTS_REF InjCrv_facPoI2APSSOECorRgn_AXIS /end AXIS_DESCR
/end CHARACTERISTIC
/begin AXIS_PTS InjCrv_facPoI2APSSOECorRgn_AXIS "gemeinsame Stützstellen für atmosphärendruckabhängige Ansteuerbeginnkorrekturkennlinien für die PoI2 für die Regeneration" 0x80061190 EnvP_p Axis_Xs16 3500.000 Pres_hPa 12 0.00 3500.000 FORMAT "%8.3" EXTENDED_LIMITS -32768.00 32767.00 DEPOSIT ABSOLUTE /end AXIS_PTS
/begin CHARACTERISTIC InjCrv_facPoI2APSTICor0Rgn_GCUR "atmosphärendruckabhängige Ansteuerbeginn zeit korrekturkennlinie für PoI2 für die Regenerationsstufe 1" CURVE 0x800611AA CurG_Ws16 1.000000 Fact 0.00 1.000000 FORMAT "%8.6" EXTENDED_LIMITS -4.000000 3.999878
 /begin AXIS_DESCR COM_AXIS EnvP_p Pres_hPa 12 0.00 3500.000 FORMAT "%8.3" EXTENDED_LIMITS -32768.00 32767.00 AXIS_PTS_REF InjCrv_facPoI2APSTICorRgn_AXIS /end AXIS_DESCR
/end CHARACTERISTIC
/begin CHARACTERISTIC InjCrv_facPoI2APSTICor1Rgn_GCUR "atmosphärendruckabhängige Ansteuerbeginn zeit korrekturkennlinie für PoI2 für die Regenerationsstufe 2" CURVE 0x800611C2 CurG_Ws16 1.000000 Fact 0.00 1.000000 FORMAT "%8.6" EXTENDED_LIMITS -4.000000 3.999878
 /begin AXIS_DESCR COM_AXIS EnvP_p Pres_hPa 12 0.00 3500.000 FORMAT "%8.3" EXTENDED_LIMITS -32768.00 32767.00 AXIS_PTS_REF InjCrv_facPoI2APSTICorRgn_AXIS /end AXIS_DESCR
/end CHARACTERISTIC
/begin AXIS_PTS InjCrv_facPoI2APSTICorRgn_AXIS "" 0x800611DA EnvP_p Axis_Xs16 3500.000 Pres_hPa 12 0.00 3500.000 FORMAT "%8.3" EXTENDED_LIMITS -32768.00 32767.00 DEPOSIT ABSOLUTE /end AXIS_PTS
/begin CHARACTERISTIC InjCrv_facPoI2ATSQCor0Rgn_GCUR "umgebungstemperaturabhängige Mengenkorrekturkennlinie für die PoI2 für die Regenerationsstufe 1" CURVE 0x800611F4 CurG_Ws16 1.000000 Fact 0.00 1.000000 FORMAT "%8.6" EXTENDED_LIMITS -4.000000 3.999878
 /begin AXIS_DESCR COM_AXIS InjCrv_tAirPoI2 Temp_Cels 12 -50.14000 199.8600 FORMAT "%8.4" EXTENDED_LIMITS -3549.940 3003.560 AXIS_PTS_REF InjCrv_facPoI2ATSQCorRgn_AXIS /end AXIS_DESCR
/end CHARACTERISTIC
/begin CHARACTERISTIC InjCrv_facPoI2ATSQCor1Rgn_GCUR "umgebungstemperaturabhängige Mengenkorrekturkennlinie für die PoI2 für die Regenerationsstufe 2" CURVE 0x8006120C CurG_Ws16 1.000000 Fact 0.00 1.000000 FORMAT "%8.6" EXTENDED_LIMITS -4.000000 3.999878
 /begin AXIS_DESCR COM_AXIS InjCrv_tAirPoI2 Temp_Cels 12 -50.14000 199.8600 FORMAT "%8.4" EXTENDED_LIMITS -3549.940 3003.560 AXIS_PTS_REF InjCrv_facPoI2ATSQCorRgn_AXIS /end AXIS_DESCR
/end CHARACTERISTIC
/begin AXIS_PTS InjCrv_facPoI2ATSQCorRgn_AXIS "gemeinsame Stützstellen für umgebungstemperaturabhängige Ansteuerbeginnkorrekturkennlinien für die PoI2 für die Regeneration" 0x80061224 InjCrv_tAirPoI2 Axis_Xs16 250.0000 Temp_Cels 12 -50.14000 199.8600 FORMAT "%8.4" EXTENDED_LIMITS -3549.940 3003.560 DEPOSIT ABSOLUTE /end AXIS_PTS
/begin CHARACTERISTIC InjCrv_facPoI2ATSQCor_CUR "ansauglufttemperaturabhängige Mengenkorrekturkennlinie für Nacheinspritzung 2" CURVE 0x80061084 Cur_Xs16Ws16 1.000000 Fact 0.00 1.000000 FORMAT "%8.6" EXTENDED_LIMITS -4.000000 3.999878
 /begin AXIS_DESCR STD_AXIS InjCrv_tAirPoI2 Temp_Cels 6 -50.14000 199.8600 FORMAT "%8.4" EXTENDED_LIMITS -3549.940 3003.560 DEPOSIT ABSOLUTE /end AXIS_DESCR
/end CHARACTERISTIC
/begin CHARACTERISTIC InjCrv_facPoI2ATSSOECor_CUR "ansauglufttemperaturabhängige Ansteuerbeginnkorrekturkennlinie für Nacheinspritzung 2" CURVE 0x8006109E Cur_Xs16Ws16 1.000000 Fact 0.00 1.000000 FORMAT "%8.6" EXTENDED_LIMITS -4.000000 3.999878
 /begin AXIS_DESCR STD_AXIS InjCrv_tAirPoI2 Temp_Cels 6 -50.14000 199.8600 FORMAT "%8.4" EXTENDED_LIMITS -3549.940 3003.560 DEPOSIT ABSOLUTE /end AXIS_DESCR
/end CHARACTERISTIC
/begin CHARACTERISTIC InjCrv_facPoI2EffRgn_CUR "Faktor für den drehmomentbildenden Anteil der PoI2 im Regenerationsbetrieb" CURVE 0x800614F4 Cur_Xs16Ws16 1.000000 Fact 0.00 1.000000 FORMAT "%8.6" EXTENDED_LIMITS -4.000000 3.999878
 /begin AXIS_DESCR STD_AXIS InjCrv_qPoI2Des_mp InjMass 12 0.00 10.00000 FORMAT "%8.5" EXTENDED_LIMITS -327.6800 327.6700 DEPOSIT ABSOLUTE /end AXIS_DESCR
/end CHARACTERISTIC
/begin CHARACTERISTIC InjCrv_facPoI2EffRgn_MAP "Faktor für den drehmomentbildenden Anteil der Einspritzmenge PoI2 im Regenerationsmodus" MAP 0x80061526 Map_Xs16Ys16Ws16 1.000000 Fact 0.00 1.000000 FORMAT "%8.6" EXTENDED_LIMITS -4.000000 3.999878
 /begin AXIS_DESCR STD_AXIS Epm_nEng EngN 16 0.00 6000.000 FORMAT "%8.3" EXTENDED_LIMITS -16384.00 16383.50 DEPOSIT ABSOLUTE /end AXIS_DESCR
 /begin AXIS_DESCR STD_AXIS InjCrv_phiPoI2Des AngleCrS 16 -39.99145 0.00 FORMAT "%8.5" EXTENDED_LIMITS -720.0220 720.0000 DEPOSIT ABSOLUTE /end AXIS_DESCR
/end CHARACTERISTIC
/begin CHARACTERISTIC InjCrv_facPoI2Eff_MAP "Faktor für Drehmoment bildenden Anteil der Einspritzmenge PoI2" MAP 0x8005EE38 Map_Xs16Ys16Ws16 1.000000 Fact 0.00 1.000000 FORMAT "%8.6" EXTENDED_LIMITS -4.000000 3.999878
 /begin AXIS_DESCR STD_AXIS Epm_nEng EngN 8 0.00 6000.000 FORMAT "%8.3" EXTENDED_LIMITS -16384.00 16383.50 DEPOSIT ABSOLUTE /end AXIS_DESCR
 /begin AXIS_DESCR STD_AXIS InjCtl_qSetUnBal InjMass 8 0.00 327.6700 FORMAT "%8.4" EXTENDED_LIMITS -327.6800 327.6700 DEPOSIT ABSOLUTE /end AXIS_DESCR
/end CHARACTERISTIC
/begin CHARACTERISTIC InjCrv_facPoI2ETSQCor0Rgn_GCUR "motortemperaturabhängige Mengenkorrekturkennlinie für die PoI2 für die Regenerationsstufe 1" CURVE 0x8006123E CurG_Ws16 1.000000 Fact 0.00 1.000000 FORMAT "%8.6" EXTENDED_LIMITS -4.000000 3.999878
 /begin AXIS_DESCR COM_AXIS InjSys_tEng Temp_Cels 12 -50.14000 199.8600 FORMAT "%8.4" EXTENDED_LIMITS -3549.940 3003.560 AXIS_PTS_REF InjCrv_facPoI2ETSQCorRgn_AXIS /end AXIS_DESCR
/end CHARACTERISTIC
/begin CHARACTERISTIC InjCrv_facPoI2ETSQCor1Rgn_GCUR "motortemperaturabhängige Mengenkorrekturkennlinie für die PoI2 für die Regenerationsstufe 2" CURVE 0x80061256 CurG_Ws16 1.000000 Fact 0.00 1.000000 FORMAT "%8.6" EXTENDED_LIMITS -4.000000 3.999878
 /begin AXIS_DESCR COM_AXIS InjSys_tEng Temp_Cels 12 -50.14000 199.8600 FORMAT "%8.4" EXTENDED_LIMITS -3549.940 3003.560 AXIS_PTS_REF InjCrv_facPoI2ETSQCorRgn_AXIS /end AXIS_DESCR
/end CHARACTERISTIC
/begin AXIS_PTS InjCrv_facPoI2ETSQCorRgn_AXIS "gemeinsame Stützstellen für motortemperaturabhängie Ansteuerbeginnkorrekturkennlinien für die PoI2 für die Regeneration" 0x8006126E InjSys_tEng Axis_Xs16 250.0000 Temp_Cels 12 -50.14000 199.8600 FORMAT "%8.4" EXTENDED_LIMITS -3549.940 3003.560 DEPOSIT ABSOLUTE /end AXIS_PTS
/begin CHARACTERISTIC InjCrv_facPoI2ETSQCor_CUR "motortemperaturabhängige Mengenkorrekturkennlinie für Nacheinspritzung 2" CURVE 0x800610B8 Cur_Xs16Ws16 1.000000 Fact 0.00 1.000000 FORMAT "%8.6" EXTENDED_LIMITS -4.000000 3.999878
 /begin AXIS_DESCR STD_AXIS InjSys_tEng Temp_Cels 8 -50.14000 199.8600 FORMAT "%8.4" EXTENDED_LIMITS -3549.940 3003.560 DEPOSIT ABSOLUTE /end AXIS_DESCR
/end CHARACTERISTIC
/begin CHARACTERISTIC InjCrv_facPoI2ETSSOECor0Rgn_GCUR "motortemperaturabhängige Ansteuerbeginnkorrekturkennlinie für die PoI2 für die Regenerationsstufe 1" CURVE 0x80061288 CurG_Ws16 1.000000 Fact 0.00 1.000000 FORMAT "%8.6" EXTENDED_LIMITS -4.000000 3.999878
 /begin AXIS_DESCR COM_AXIS InjSys_tEng Temp_Cels 12 -50.14000 199.8600 FORMAT "%8.4" EXTENDED_LIMITS -3549.940 3003.560 AXIS_PTS_REF InjCrv_facPoI2ETSSOECorRgn_AXIS /end AXIS_DESCR
/end CHARACTERISTIC
/begin CHARACTERISTIC InjCrv_facPoI2ETSSOECor1Rgn_GCUR "motortemperaturabhängige Ansteuerbeginnkorrekturkennlinie für die PoI2 für die Regenerationsstufe 2" CURVE 0x800612A0 CurG_Ws16 1.000000 Fact 0.00 1.000000 FORMAT "%8.6" EXTENDED_LIMITS -4.000000 3.999878
 /begin AXIS_DESCR COM_AXIS InjSys_tEng Temp_Cels 12 -50.14000 199.8600 FORMAT "%8.4" EXTENDED_LIMITS -3549.940 3003.560 AXIS_PTS_REF InjCrv_facPoI2ETSSOECorRgn_AXIS /end AXIS_DESCR
/end CHARACTERISTIC
/begin AXIS_PTS InjCrv_facPoI2ETSSOECorRgn_AXIS "gemeinsame Stützstellen für motortemperaturabhängige Ansteuerbeginnkorrekturkennlinien für die PoI2 für die Regeneration" 0x800612B8 InjSys_tEng Axis_Xs16 250.0000 Temp_Cels 12 -50.14000 199.8600 FORMAT "%8.4" EXTENDED_LIMITS -3549.940 3003.560 DEPOSIT ABSOLUTE /end AXIS_PTS
/begin CHARACTERISTIC InjCrv_facPoI2ETSSOECor_CUR "motortemperaturabhängige Ansteuerbeginnkorrekturkennlinie für PoI2" CURVE 0x800610DA Cur_Xs16Ws16 1.000000 Fact 0.00 1.000000 FORMAT "%8.6" EXTENDED_LIMITS -4.000000 3.999878
 /begin AXIS_DESCR STD_AXIS InjSys_tEng Temp_Cels 8 -50.14000 199.8600 FORMAT "%8.4" EXTENDED_LIMITS -3549.940 3003.560 DEPOSIT ABSOLUTE /end AXIS_DESCR
/end CHARACTERISTIC
/begin CHARACTERISTIC InjCrv_facPoI2ETSTICor0Rgn_GCUR "motortemperaturabhängige Ansteuerbeginn zeit korrekturkennlinie für die PoI2 für die Regenerationsstufe 1" CURVE 0x800612D2 CurG_Ws16 1.000000 Fact 0.00 1.000000 FORMAT "%8.6" EXTENDED_LIMITS -4.000000 3.999878
 /begin AXIS_DESCR COM_AXIS InjSys_tEng Temp_Cels 12 -50.14000 199.8600 FORMAT "%8.4" EXTENDED_LIMITS -3549.940 3003.560 AXIS_PTS_REF InjCrv_facPoI2ETSTICorRgn_AXIS /end AXIS_DESCR
/end CHARACTERISTIC
/begin CHARACTERISTIC InjCrv_facPoI2ETSTICor1Rgn_GCUR "motortemperaturabhängige Ansteuerbeginn zeit korrekturkennlinie für die PoI2 für die Regenerationsstufe 2" CURVE 0x800612EA CurG_Ws16 1.000000 Fact 0.00 1.000000 FORMAT "%8.6" EXTENDED_LIMITS -4.000000 3.999878
 /begin AXIS_DESCR COM_AXIS InjSys_tEng Temp_Cels 12 -50.14000 199.8600 FORMAT "%8.4" EXTENDED_LIMITS -3549.940 3003.560 AXIS_PTS_REF InjCrv_facPoI2ETSTICorRgn_AXIS /end AXIS_DESCR
/end CHARACTERISTIC
/begin AXIS_PTS InjCrv_facPoI2ETSTICorRgn_AXIS "" 0x80061302 InjSys_tEng Axis_Xs16 250.0000 Temp_Cels 12 -50.14000 199.8600 FORMAT "%8.4" EXTENDED_LIMITS -3549.940 3003.560 DEPOSIT ABSOLUTE /end AXIS_PTS
/begin CHARACTERISTIC InjCrv_facPoI2QntMin_C "Faktor zur applikativen Abschaltung der PoI2 bei Unterschreitung der Mindestmenge" VALUE 0x8005EEDC Val_Ws16 1.000000 Fact1 0.00 1.000000 FORMAT "%8.6" EXTENDED_LIMITS -256.0000 255.9922 /end CHARACTERISTIC
/begin CHARACTERISTIC InjCrv_facPoI2QntRmp0Val_GCUR "Faktorisierungskennlinie für den Menge der PoI2" CURVE 0x800626BE CurG_Ws16 3.999939 CoEOMSwt_S16 -2.000000 1.999939 FORMAT "%8.6"
 /begin AXIS_DESCR COM_AXIS CoEOM_facRmpVal CoEOMSwt_S16 11 -2.000000 1.999939 FORMAT "%8.6" AXIS_PTS_REF InjCrv_facPoI2QntRmpValX_AXIS /end AXIS_DESCR
/end CHARACTERISTIC
/begin CHARACTERISTIC InjCrv_facPoI2QntRmp1Val_GCUR "Faktorisierungskennlinie für den Menge der PoI2" CURVE 0x800626D4 CurG_Ws16 3.999939 CoEOMSwt_S16 -2.000000 1.999939 FORMAT "%8.6"
 /begin AXIS_DESCR COM_AXIS CoEOM_facRmpVal CoEOMSwt_S16 11 -2.000000 1.999939 FORMAT "%8.6" AXIS_PTS_REF InjCrv_facPoI2QntRmpValX_AXIS /end AXIS_DESCR
/end CHARACTERISTIC
/begin AXIS_PTS InjCrv_facPoI2QntRmpValX_AXIS "Gruppenkennlinien-Achse für die Gewichtung des Mengen-Faktors der PoI2" 0x800626EA CoEOM_facRmpVal Axis_Xs16 3.999939 CoEOMSwt_S16 11 -2.000000 1.999939 FORMAT "%8.6" DEPOSIT ABSOLUTE /end AXIS_PTS
/begin CHARACTERISTIC InjCrv_facPoI2SOEtiRmpVal_CUR "Kennlinie zur Anpassung der Rampensteigung von EGT_facRmpVal für den Ansteuerbeginn zeit der PoI2" CURVE 0x80062702 Cur_Xs16Ws16 3.999939 EGTSwt_S16 -2.000000 1.999939 FORMAT "%8.6"
 /begin AXIS_DESCR STD_AXIS CoEOM_facRmpVal CoEOMSwt_S16 2 -2.000000 1.999939 FORMAT "%8.6" DEPOSIT ABSOLUTE /end AXIS_DESCR
/end CHARACTERISTIC
/begin CHARACTERISTIC InjCrv_facPoI2TiRmp0Val_GCUR "Faktorisierungskennlinie für den Einspritzbeginn der PoI2, Zeitkomponente" CURVE 0x8006270C CurG_Ws16 3.999939 CoEOMSwt_S16 -2.000000 1.999939 FORMAT "%8.6"
 /begin AXIS_DESCR COM_AXIS CoEOM_facRmpVal CoEOMSwt_S16 11 -2.000000 1.999939 FORMAT "%8.6" AXIS_PTS_REF InjCrv_facPoI2TiRmpValX_AXIS /end AXIS_DESCR
/end CHARACTERISTIC
/begin CHARACTERISTIC InjCrv_facPoI2TiRmp1Val_GCUR "Faktorisierungskennlinie für den Einspritzbeginn der PoI2, Zeitkomponente" CURVE 0x80062722 CurG_Ws16 3.999939 CoEOMSwt_S16 -2.000000 1.999939 FORMAT "%8.6"
 /begin AXIS_DESCR COM_AXIS CoEOM_facRmpVal CoEOMSwt_S16 11 -2.000000 1.999939 FORMAT "%8.6" AXIS_PTS_REF InjCrv_facPoI2TiRmpValX_AXIS /end AXIS_DESCR
/end CHARACTERISTIC
/begin AXIS_PTS InjCrv_facPoI2TiRmpValX_AXIS "Gruppenkennlinien-Achse für die Gewichtung des Einspritzbeginn-Faktors der PoI2, Zeitkomponente" 0x80062738 CoEOM_facRmpVal Axis_Xs16 3.999939 CoEOMSwt_S16 11 -2.000000 1.999939 FORMAT "%8.6" DEPOSIT ABSOLUTE /end AXIS_PTS
/begin CHARACTERISTIC InjCrv_facPOpPoI2ETSCor_CUR "motortemperaturabhängige Freigabekorrekturkennlinie für PoI2" CURVE 0x800610FC Cur_Xs16Ws16 1.000000 Fact 0.00 1.000000 FORMAT "%8.6" EXTENDED_LIMITS -4.000000 3.999878
 /begin AXIS_DESCR STD_AXIS InjSys_tEng Temp_Cels 6 -50.14000 199.8600 FORMAT "%8.4" EXTENDED_LIMITS -3549.940 3003.560 DEPOSIT ABSOLUTE /end AXIS_DESCR
/end CHARACTERISTIC
/begin CHARACTERISTIC InjCrv_nDiffMin_C "Minimaler Drehzahlunterschied für die Freigabe der Voreinspritzung 2" VALUE 0x8005A7B2 Val_Ws16 6000.000 EngN 0.00 6000.000 FORMAT "%8.3" EXTENDED_LIMITS -16384.00 16383.50 /end CHARACTERISTIC
/begin CHARACTERISTIC InjCrv_phiDynOfs_CUR "Winkelvorhaltkennfeld für schnelle dynamische Vorgänge" CURVE 0x8005E2BA Cur_Xs16Ws16 720.0000 AngleCrS 0.00 720.0000 FORMAT "%8.4" EXTENDED_LIMITS -720.0220 720.0000
 /begin AXIS_DESCR STD_AXIS Epm_nEng EngN 8 0.00 6000.000 FORMAT "%8.3" EXTENDED_LIMITS -16384.00 16383.50 DEPOSIT ABSOLUTE /end AXIS_DESCR
/end CHARACTERISTIC
/begin CHARACTERISTIC InjCrv_phiPiI2BasStrt_MAP "niedriger Wert des SOE Winkels für PII2 während des Motor Start State" MAP 0x8005D7BE Kf_Xs16_Ys16_Ws16 50.01129 AngleCrS -25.00565 25.00565 FORMAT "%8.5" EXTENDED_LIMITS -720.0220 720.0000
 /begin AXIS_DESCR STD_AXIS Epm_nEng EngN 2 0.00 6000.000 FORMAT "%8.3" EXTENDED_LIMITS -16384.00 16383.50 DEPOSIT ABSOLUTE /end AXIS_DESCR
 /begin AXIS_DESCR STD_AXIS InjCtl_qSetUnBal InjMass 2 0.00 327.6700 FORMAT "%8.4" EXTENDED_LIMITS -327.6800 327.6700 DEPOSIT ABSOLUTE /end AXIS_DESCR
/end CHARACTERISTIC
/begin CHARACTERISTIC InjCrv_phiPiI2Des_C "Fernsteuerwert des Ansteuerbeginns (Winkelkomponente) der PiI2" VALUE 0x8005A7B4 Val_Ws16 720.0000 AngleCrS 0.00 720.0000 FORMAT "%8.4" EXTENDED_LIMITS -720.0220 720.0000 /end CHARACTERISTIC
/begin CHARACTERISTIC InjCrv_phiPiI2ETSCorStrt_MAP "base correction map for angle-component of SOE of PiI2" MAP 0x8005A95E Kf_Xs16_Ys16_Ws16 50.01129 AngleCrS -25.00565 25.00565 FORMAT "%8.5" EXTENDED_LIMITS -720.0220 720.0000
 /begin AXIS_DESCR STD_AXIS Epm_nEng EngN 2 0.00 6000.000 FORMAT "%8.3" EXTENDED_LIMITS -16384.00 16383.50 DEPOSIT ABSOLUTE /end AXIS_DESCR
 /begin AXIS_DESCR STD_AXIS InjCtl_qSetUnBal InjMass 2 0.00 327.6700 FORMAT "%8.4" EXTENDED_LIMITS -327.6800 327.6700 DEPOSIT ABSOLUTE /end AXIS_DESCR
/end CHARACTERISTIC
/begin CHARACTERISTIC InjCrv_phiPiI3Bas1_MAP "Winkelkomponente Ansteuerbeginn Grundwertekennfeld PiI3 mit inaktiver PiI1" MAP 0x8005D81C Map_Xs16Ys16Ws16 100.0006 AngleCrS 0.00 100.0006 FORMAT "%8.4" EXTENDED_LIMITS -720.0220 720.0000
 /begin AXIS_DESCR STD_AXIS Epm_nEng EngN 10 0.00 6000.000 FORMAT "%8.3" EXTENDED_LIMITS -16384.00 16383.50 DEPOSIT ABSOLUTE /end AXIS_DESCR
 /begin AXIS_DESCR STD_AXIS InjCtl_qSetUnBal InjMass 10 0.00 327.6700 FORMAT "%8.4" EXTENDED_LIMITS -327.6800 327.6700 DEPOSIT ABSOLUTE /end AXIS_DESCR
/end CHARACTERISTIC
/begin CHARACTERISTIC InjCrv_phiPiI3Bas2_MAP "Winkelkomponente Ansteuerbeginn Grundwertekennfeld PiI3 mit aktivierter PiI1" MAP 0x8005D910 Map_Xs16Ys16Ws16 100.0006 AngleCrS 0.00 100.0006 FORMAT "%8.4" EXTENDED_LIMITS -720.0220 720.0000
 /begin AXIS_DESCR STD_AXIS Epm_nEng EngN 10 0.00 6000.000 FORMAT "%8.3" EXTENDED_LIMITS -16384.00 16383.50 DEPOSIT ABSOLUTE /end AXIS_DESCR
 /begin AXIS_DESCR STD_AXIS InjCtl_qSetUnBal InjMass 10 0.00 327.6700 FORMAT "%8.4" EXTENDED_LIMITS -327.6800 327.6700 DEPOSIT ABSOLUTE /end AXIS_DESCR
/end CHARACTERISTIC
/begin CHARACTERISTIC InjCrv_phiPiI3Des_C "Fernsteuerwert des Ansteuerwinkels der PiI3" VALUE 0x8005DA04 Val_Ws16 100.0006 AngleCrS 0.00 100.0006 FORMAT "%8.4" EXTENDED_LIMITS -720.0220 720.0000 /end CHARACTERISTIC
/begin CHARACTERISTIC InjCrv_phiPiI3ETSCor_MAP "motortemperaturabhängiger Korrekturgrundwert für die Winkelkomponente des Ansteuerbeginns der PiI3" MAP 0x8005DDCA Map_Xs16Ys16Ws16 90.00275 AngleCrS 0.00 90.00275 FORMAT "%8.5" EXTENDED_LIMITS -720.0220 720.0000
 /begin AXIS_DESCR STD_AXIS Epm_nEng EngN 10 0.00 6000.000 FORMAT "%8.3" EXTENDED_LIMITS -16384.00 16383.50 DEPOSIT ABSOLUTE /end AXIS_DESCR
 /begin AXIS_DESCR STD_AXIS InjCtl_qSetUnBal InjMass 8 0.00 327.6700 FORMAT "%8.4" EXTENDED_LIMITS -327.6800 327.6700 DEPOSIT ABSOLUTE /end AXIS_DESCR
/end CHARACTERISTIC
/begin CHARACTERISTIC InjCrv_phiPoI1Bas0Rgn_GMAP "Gruppenkennfeld für den Basiswinkel des Ansteuerbeginns für die PoI1 für die Regenerationsstufe 1" MAP 0x8005E47C MapG_Ws16 100.0006 AngleCrS -100.0006 0.00 FORMAT "%8.4" EXTENDED_LIMITS -720.0220 720.0000
 /begin AXIS_DESCR COM_AXIS Epm_nEng EngN 16 0.00 6000.000 FORMAT "%8.3" EXTENDED_LIMITS -16384.00 16383.50 AXIS_PTS_REF InjCrv_phiPoI1BasRgnX_AXIS /end AXIS_DESCR
 /begin AXIS_DESCR COM_AXIS InjCtl_qSetUnBal InjMass 16 0.00 327.6700 FORMAT "%8.4" EXTENDED_LIMITS -327.6800 327.6700 AXIS_PTS_REF InjCrv_phiPoI1BasRgnY_AXIS /end AXIS_DESCR
/end CHARACTERISTIC
/begin CHARACTERISTIC InjCrv_phiPoI1Bas1Rgn_GMAP "Gruppenkennfeld für den Basiswinkel des Ansteuerbeginns für die PoI1 für die Regenerationsstufe 2" MAP 0x8005E67C MapG_Ws16 100.0006 AngleCrS -100.0006 0.00 FORMAT "%8.4" EXTENDED_LIMITS -720.0220 720.0000
 /begin AXIS_DESCR COM_AXIS Epm_nEng EngN 16 0.00 6000.000 FORMAT "%8.3" EXTENDED_LIMITS -16384.00 16383.50 AXIS_PTS_REF InjCrv_phiPoI1BasRgnX_AXIS /end AXIS_DESCR
 /begin AXIS_DESCR COM_AXIS InjCtl_qSetUnBal InjMass 16 0.00 327.6700 FORMAT "%8.4" EXTENDED_LIMITS -327.6800 327.6700 AXIS_PTS_REF InjCrv_phiPoI1BasRgnY_AXIS /end AXIS_DESCR
/end CHARACTERISTIC
/begin AXIS_PTS InjCrv_phiPoI1BasRgnX_AXIS "" 0x8005E87C Epm_nEng Axis_Xs16 6000.000 EngN 16 0.00 6000.000 FORMAT "%8.3" EXTENDED_LIMITS -16384.00 16383.50 DEPOSIT ABSOLUTE /end AXIS_PTS
/begin AXIS_PTS InjCrv_phiPoI1BasRgnY_AXIS "" 0x8005E89E InjCtl_qSetUnBal Axis_Xs16 327.6700 InjMass 16 0.00 327.6700 FORMAT "%8.4" EXTENDED_LIMITS -327.6800 327.6700 DEPOSIT ABSOLUTE /end AXIS_PTS
/begin CHARACTERISTIC InjCrv_phiPoI1Bas_MAP "Grundwert des Ansteuerbeginnwinkels PoI1" MAP 0x8005E2DC Map_Xs16Ys16Ws16 60.00916 AngleCrS -100.0006 -39.99145 FORMAT "%8.4" EXTENDED_LIMITS -720.0220 720.0000
 /begin AXIS_DESCR STD_AXIS Epm_nEng EngN 2 0.00 6000.000 FORMAT "%8.3" EXTENDED_LIMITS -16384.00 16383.50 DEPOSIT ABSOLUTE /end AXIS_DESCR
 /begin AXIS_DESCR STD_AXIS InjCtl_qSetUnBal InjMass 2 0.00 327.6700 FORMAT "%8.4" EXTENDED_LIMITS -327.6800 327.6700 DEPOSIT ABSOLUTE /end AXIS_DESCR
/end CHARACTERISTIC
/begin CHARACTERISTIC InjCrv_phiPoI1Des_C "Fernsteuerwert des Ansteuerwinkels der PoI1" VALUE 0x8005E2F0 Val_Ws16 100.0006 AngleCrS -100.0006 0.00 FORMAT "%8.4" EXTENDED_LIMITS -720.0220 720.0000 /end CHARACTERISTIC
/begin CHARACTERISTIC InjCrv_phiPoI1ETSCor_MAP "motortemperaturabhängiges Winkelkorrekturkennfeld für PoI1" MAP 0x8005E414 Map_Xs16Ys16Ws16 200.0012 AngleCrS -100.0006 100.0006 FORMAT "%8.4" EXTENDED_LIMITS -720.0220 720.0000
 /begin AXIS_DESCR STD_AXIS Epm_nEng EngN 2 0.00 6000.000 FORMAT "%8.3" EXTENDED_LIMITS -16384.00 16383.50 DEPOSIT ABSOLUTE /end AXIS_DESCR
 /begin AXIS_DESCR STD_AXIS InjCtl_qSetUnBal InjMass 2 0.00 327.6700 FORMAT "%8.4" EXTENDED_LIMITS -327.6800 327.6700 DEPOSIT ABSOLUTE /end AXIS_DESCR
/end CHARACTERISTIC
/begin CHARACTERISTIC InjCrv_phiPoI1Max_MAP "Maximaler Ansteuerbeginnwinkel PoI1" MAP 0x8005E2F2 Map_Xs16Ys16Ws16 60.00916 AngleCrS -100.0006 -39.99145 FORMAT "%8.4" EXTENDED_LIMITS -720.0220 720.0000
 /begin AXIS_DESCR STD_AXIS Epm_nEng EngN 8 0.00 6000.000 FORMAT "%8.3" EXTENDED_LIMITS -16384.00 16383.50 DEPOSIT ABSOLUTE /end AXIS_DESCR
 /begin AXIS_DESCR STD_AXIS InjCtl_qSetUnBal InjMass 8 0.00 327.6700 FORMAT "%8.4" EXTENDED_LIMITS -327.6800 327.6700 DEPOSIT ABSOLUTE /end AXIS_DESCR
/end CHARACTERISTIC
/begin CHARACTERISTIC InjCrv_phiPoI2APSCor0Rgn_GMAP "Basiswinkelkorrekturkennfeld abhängig von dem Umgebungsluftdruck für die PoI2 für die Regenerationsstufe 1" MAP 0x8005F2A6 MapG_Ws16 39.99145 AngleCrS -39.99145 0.00 FORMAT "%8.5" EXTENDED_LIMITS -720.0220 720.0000
 /begin AXIS_DESCR COM_AXIS Epm_nEng EngN 16 0.00 6000.000 FORMAT "%8.3" EXTENDED_LIMITS -16384.00 16383.50 AXIS_PTS_REF InjCrv_phiPoI2APSCorRgnX_AXIS /end AXIS_DESCR
 /begin AXIS_DESCR COM_AXIS InjCtl_qSetUnBal InjMass 16 0.00 327.6700 FORMAT "%8.4" EXTENDED_LIMITS -327.6800 327.6700 AXIS_PTS_REF InjCrv_phiPoI2APSCorRgnY_AXIS /end AXIS_DESCR
/end CHARACTERISTIC
/begin CHARACTERISTIC InjCrv_phiPoI2APSCor1Rgn_GMAP "Basiswinkelkorrekturkennfeld abhängig von dem Umgebungsluftdruck für die PoI2 für die Regenerationsstufe 2" MAP 0x8005F4A6 MapG_Ws16 39.99145 AngleCrS -39.99145 0.00 FORMAT "%8.5" EXTENDED_LIMITS -720.0220 720.0000
 /begin AXIS_DESCR COM_AXIS Epm_nEng EngN 16 0.00 6000.000 FORMAT "%8.3" EXTENDED_LIMITS -16384.00 16383.50 AXIS_PTS_REF InjCrv_phiPoI2APSCorRgnX_AXIS /end AXIS_DESCR
 /begin AXIS_DESCR COM_AXIS InjCtl_qSetUnBal InjMass 16 0.00 327.6700 FORMAT "%8.4" EXTENDED_LIMITS -327.6800 327.6700 AXIS_PTS_REF InjCrv_phiPoI2APSCorRgnY_AXIS /end AXIS_DESCR
/end CHARACTERISTIC
/begin AXIS_PTS InjCrv_phiPoI2APSCorRgnX_AXIS "" 0x8005F6A6 Epm_nEng Axis_Xs16 6000.000 EngN 16 0.00 6000.000 FORMAT "%8.3" EXTENDED_LIMITS -16384.00 16383.50 DEPOSIT ABSOLUTE /end AXIS_PTS
/begin AXIS_PTS InjCrv_phiPoI2APSCorRgnY_AXIS "" 0x8005F6C8 InjCtl_qSetUnBal Axis_Xs16 327.6700 InjMass 16 0.00 327.6700 FORMAT "%8.4" EXTENDED_LIMITS -327.6800 327.6700 DEPOSIT ABSOLUTE /end AXIS_PTS
/begin CHARACTERISTIC InjCrv_phiPoI2Bas0Rgn_GMAP "Gruppenkennfeld für den Basiswinkel des Ansteuerbeginns für die PoI2 für die Regenerationsstufe 1" MAP 0x8006176A MapG_Ws16 39.99145 AngleCrS -39.99145 0.00 FORMAT "%8.5" EXTENDED_LIMITS -720.0220 720.0000
 /begin AXIS_DESCR COM_AXIS Epm_nEng EngN 16 0.00 6000.000 FORMAT "%8.3" EXTENDED_LIMITS -16384.00 16383.50 AXIS_PTS_REF InjCrv_phiPoI2BasRgnX_AXIS /end AXIS_DESCR
 /begin AXIS_DESCR COM_AXIS InjCtl_qSetUnBal InjMass 16 0.00 327.6700 FORMAT "%8.4" EXTENDED_LIMITS -327.6800 327.6700 AXIS_PTS_REF InjCrv_phiPoI2BasRgnY_AXIS /end AXIS_DESCR
/end CHARACTERISTIC
/begin CHARACTERISTIC InjCrv_phiPoI2Bas1Rgn_GMAP "Gruppenkennfeld für den Basiswinkel des Ansteuerbeginns für die PoI2 für die Regenerationsstufe 2" MAP 0x8006196A MapG_Ws16 39.99145 AngleCrS -39.99145 0.00 FORMAT "%8.5" EXTENDED_LIMITS -720.0220 720.0000
 /begin AXIS_DESCR COM_AXIS Epm_nEng EngN 16 0.00 6000.000 FORMAT "%8.3" EXTENDED_LIMITS -16384.00 16383.50 AXIS_PTS_REF InjCrv_phiPoI2BasRgnX_AXIS /end AXIS_DESCR
 /begin AXIS_DESCR COM_AXIS InjCtl_qSetUnBal InjMass 16 0.00 327.6700 FORMAT "%8.4" EXTENDED_LIMITS -327.6800 327.6700 AXIS_PTS_REF InjCrv_phiPoI2BasRgnY_AXIS /end AXIS_DESCR
/end CHARACTERISTIC
/begin AXIS_PTS InjCrv_phiPoI2BasRgnX_AXIS "" 0x80061B6A Epm_nEng Axis_Xs16 6000.000 EngN 16 0.00 6000.000 FORMAT "%8.3" EXTENDED_LIMITS -16384.00 16383.50 DEPOSIT ABSOLUTE /end AXIS_PTS
/begin AXIS_PTS InjCrv_phiPoI2BasRgnY_AXIS "" 0x80061B8C InjCtl_qSetUnBal Axis_Xs16 327.6700 InjMass 16 0.00 327.6700 FORMAT "%8.4" EXTENDED_LIMITS -327.6800 327.6700 DEPOSIT ABSOLUTE /end AXIS_PTS
/begin CHARACTERISTIC InjCrv_phiPoI2Des_C "Fernsteuerwert des Ansteuerbeginns (Winkelkomponente) der PoI2" VALUE 0x8005EEDE Val_Ws16 39.99145 AngleCrS -39.99145 0.00 FORMAT "%8.5" EXTENDED_LIMITS -720.0220 720.0000 /end CHARACTERISTIC
/begin CHARACTERISTIC InjCrv_phiPoI2ETSCor0Rgn_GMAP "Basiswinkelkorrekturkennfeld abhängig von der Motortemperatur für die PoI2 für die Regenerationsstufe 1" MAP 0x8005F6EA MapG_Ws16 39.99145 AngleCrS -39.99145 0.00 FORMAT "%8.5" EXTENDED_LIMITS -720.0220 720.0000
 /begin AXIS_DESCR COM_AXIS Epm_nEng EngN 16 0.00 6000.000 FORMAT "%8.3" EXTENDED_LIMITS -16384.00 16383.50 AXIS_PTS_REF InjCrv_phiPoI2ETSCorRgnX_AXIS /end AXIS_DESCR
 /begin AXIS_DESCR COM_AXIS InjCtl_qSetUnBal InjMass 16 0.00 327.6700 FORMAT "%8.4" EXTENDED_LIMITS -327.6800 327.6700 AXIS_PTS_REF InjCrv_phiPoI2ETSCorRgnY_AXIS /end AXIS_DESCR
/end CHARACTERISTIC
/begin CHARACTERISTIC InjCrv_phiPoI2ETSCor1Rgn_GMAP "Basiswinkelkorrekturkennfeld abhängig von der Motortemperatur für die PoI2 für die Regenerationsstufe 2" MAP 0x8005F8EA MapG_Ws16 39.99145 AngleCrS -39.99145 0.00 FORMAT "%8.5" EXTENDED_LIMITS -720.0220 720.0000
 /begin AXIS_DESCR COM_AXIS Epm_nEng EngN 16 0.00 6000.000 FORMAT "%8.3" EXTENDED_LIMITS -16384.00 16383.50 AXIS_PTS_REF InjCrv_phiPoI2ETSCorRgnX_AXIS /end AXIS_DESCR
 /begin AXIS_DESCR COM_AXIS InjCtl_qSetUnBal InjMass 16 0.00 327.6700 FORMAT "%8.4" EXTENDED_LIMITS -327.6800 327.6700 AXIS_PTS_REF InjCrv_phiPoI2ETSCorRgnY_AXIS /end AXIS_DESCR
/end CHARACTERISTIC
/begin AXIS_PTS InjCrv_phiPoI2ETSCorRgnX_AXIS "" 0x8005FAEA Epm_nEng Axis_Xs16 6000.000 EngN 16 0.00 6000.000 FORMAT "%8.3" EXTENDED_LIMITS -16384.00 16383.50 DEPOSIT ABSOLUTE /end AXIS_PTS
/begin AXIS_PTS InjCrv_phiPoI2ETSCorRgnY_AXIS "" 0x8005FB0C InjCtl_qSetUnBal Axis_Xs16 327.6700 InjMass 16 0.00 327.6700 FORMAT "%8.4" EXTENDED_LIMITS -327.6800 327.6700 DEPOSIT ABSOLUTE /end AXIS_PTS
/begin CHARACTERISTIC InjCrv_phiPoI2HysOilDil_C "Hysterese des spätesten Ansteuerbeginns der PoI2 bei Vorliegen einer Abschaltanforderung aufgrund Ölverdünnung" VALUE 0x80062998 Val_Ws16 19.99573 AngleCrS 0.00 19.99573 FORMAT "%8.5" EXTENDED_LIMITS -720.0220 720.0000 /end CHARACTERISTIC
/begin CHARACTERISTIC InjCrv_phiPoI2MaxRgn_MAP "Kennlinie für Grenzwert der Winkelkomponente Ansteuerbeginn PoI2 im Regenerationsbetrieb" MAP 0x80061BAE Map_Xs16Ys16Ws16 39.99145 AngleCrS -39.99145 0.00 FORMAT "%8.5" EXTENDED_LIMITS -720.0220 720.0000
 /begin AXIS_DESCR STD_AXIS Epm_nEng EngN 16 0.00 6000.000 FORMAT "%8.3" EXTENDED_LIMITS -16384.00 16383.50 DEPOSIT ABSOLUTE /end AXIS_DESCR
 /begin AXIS_DESCR STD_AXIS InjCtl_qSetUnBal InjMass 16 0.00 327.6700 FORMAT "%8.4" EXTENDED_LIMITS -327.6800 327.6700 DEPOSIT ABSOLUTE /end AXIS_DESCR
/end CHARACTERISTIC
/begin CHARACTERISTIC InjCrv_phiPoI2MinOilDil_CUR "Kennlinie für den spätesten Ansteuerbeginn der PoI2 bei Vorliegen einer Abschaltanforderung aufgrund Ölverdünnung" CURVE 0x8006299A Cur_Xs16Ws16 759.9915 AngleCrS -39.99145 720.0000 FORMAT "%8.4" EXTENDED_LIMITS -720.0220 720.0000
 /begin AXIS_DESCR STD_AXIS InjCrv_qPoI2Des_mp InjMass 6 0.00 10.00000 FORMAT "%8.5" EXTENDED_LIMITS -327.6800 327.6700 DEPOSIT ABSOLUTE /end AXIS_DESCR
/end CHARACTERISTIC
/begin CHARACTERISTIC InjCrv_phiPoI2Min_C "minimaler Ansteuerbeginn PoI2 relativ zum oberen Totpunkt" VALUE 0x8005EEE0 Val_Ws16 39.99145 AngleCrS -39.99145 0.00 FORMAT "%8.5" EXTENDED_LIMITS -720.0220 720.0000 /end CHARACTERISTIC
/begin CHARACTERISTIC InjCrv_phiPoI2ReplNrm_MAP "" MAP 0x80062750 Map_Xs16Ys16Ws16 39.99145 AngleCrS -39.99145 0.00 FORMAT "%8.5" EXTENDED_LIMITS -720.0220 720.0000
 /begin AXIS_DESCR STD_AXIS Epm_nEng EngN 16 0.00 6000.000 FORMAT "%8.3" EXTENDED_LIMITS -16384.00 16383.50 DEPOSIT ABSOLUTE /end AXIS_DESCR
 /begin AXIS_DESCR STD_AXIS InjCtl_qSetUnBal InjMass 16 0.00 327.6700 FORMAT "%8.4" EXTENDED_LIMITS -327.6800 327.6700 DEPOSIT ABSOLUTE /end AXIS_DESCR
/end CHARACTERISTIC
/begin CHARACTERISTIC InjCrv_POpPoI1Bas_MAP "Grundwert Freigabe PoI1" MAP 0x8005ED8C Map_Xs16Ys16Ws16 100.0000 OneToOne 0.00 100.0000 FORMAT "%8.4" EXTENDED_LIMITS -32768.00 32767.00
 /begin AXIS_DESCR STD_AXIS Epm_nEng EngN 2 0.00 6000.000 FORMAT "%8.3" EXTENDED_LIMITS -16384.00 16383.50 DEPOSIT ABSOLUTE /end AXIS_DESCR
 /begin AXIS_DESCR STD_AXIS InjCtl_qSetUnBal InjMass 2 0.00 327.6700 FORMAT "%8.4" EXTENDED_LIMITS -327.6800 327.6700 DEPOSIT ABSOLUTE /end AXIS_DESCR
/end CHARACTERISTIC
/begin CHARACTERISTIC InjCrv_POpPoI1ETSCor_CUR "motortemperaturabhängige Freigabekorrekturkennlinie für PoI1" CURVE 0x8005E476 Cur_Xs16Ws16 100.0000 OneToOne 0.00 100.0000 FORMAT "%8.4" EXTENDED_LIMITS -32768.00 32767.00
 /begin AXIS_DESCR STD_AXIS InjSys_tEng Temp_Cels 1 -50.14000 199.8600 FORMAT "%8.4" EXTENDED_LIMITS -3549.940 3003.560 DEPOSIT ABSOLUTE /end AXIS_DESCR
/end CHARACTERISTIC
/begin CHARACTERISTIC InjCrv_POpPoI1High_C "obere Hystereseschwelle des Grundwertes Freigabe PoI1" VALUE 0x8005EDA0 Val_Ws16 100.0000 OneToOne 0.00 100.0000 FORMAT "%8.4" EXTENDED_LIMITS -32768.00 32767.00 /end CHARACTERISTIC
/begin CHARACTERISTIC InjCrv_POpPoI1Low_C "Untere Hystereseschwelle des Grundwertes Freigabe PoI1" VALUE 0x8005EDA2 Val_Ws16 100.0000 OneToOne 0.00 100.0000 FORMAT "%8.4" EXTENDED_LIMITS -32768.00 32767.00 /end CHARACTERISTIC
/begin CHARACTERISTIC InjCrv_POpPoI1RgnHigh_C "Obere Hystereseschwelle des Grundwertes Freigabe PoI1 im Regenerationsbetrieb" VALUE 0x8005EDA4 Val_Ws16 100.0000 OneToOne 0.00 100.0000 FORMAT "%8.4" EXTENDED_LIMITS -32768.00 32767.00 /end CHARACTERISTIC
/begin CHARACTERISTIC InjCrv_POpPoI1RgnLow_C "Untere Hystereseschwelle des Grundwertes Freigabe PoI1 im Regenerationsbetrieb" VALUE 0x8005EDA6 Val_Ws16 100.0000 OneToOne 0.00 100.0000 FORMAT "%8.4" EXTENDED_LIMITS -32768.00 32767.00 /end CHARACTERISTIC
/begin CHARACTERISTIC InjCrv_POpPoI1Rgn_MAP "Grundwert Freigabe PoI1 im Regenerationsbetrieb" MAP 0x8005EDA8 Map_Xs16Ys16Ws16 100.0000 OneToOne 0.00 100.0000 FORMAT "%8.4" EXTENDED_LIMITS -32768.00 32767.00
 /begin AXIS_DESCR STD_AXIS Epm_nEng EngN 6 0.00 6000.000 FORMAT "%8.3" EXTENDED_LIMITS -16384.00 16383.50 DEPOSIT ABSOLUTE /end AXIS_DESCR
 /begin AXIS_DESCR STD_AXIS InjCtl_qSetUnBal InjMass 6 0.00 327.6700 FORMAT "%8.4" EXTENDED_LIMITS -327.6800 327.6700 DEPOSIT ABSOLUTE /end AXIS_DESCR
/end CHARACTERISTIC
/begin CHARACTERISTIC InjCrv_POpPoI2Bas_MAP "Basiskennfeld für die betriebspunktabhängige Freigabe der PoI2" MAP 0x800629B4 Map_Xs16Ys16Ws16 100.0000 OneToOne 0.00 100.0000 FORMAT "%8.4" EXTENDED_LIMITS -32768.00 32767.00
 /begin AXIS_DESCR STD_AXIS Epm_nEng EngN 6 0.00 6000.000 FORMAT "%8.3" EXTENDED_LIMITS -16384.00 16383.50 DEPOSIT ABSOLUTE /end AXIS_DESCR
 /begin AXIS_DESCR STD_AXIS InjCtl_qSetUnBal InjMass 6 0.00 327.6700 FORMAT "%8.4" EXTENDED_LIMITS -327.6800 327.6700 DEPOSIT ABSOLUTE /end AXIS_DESCR
/end CHARACTERISTIC
/begin CHARACTERISTIC InjCrv_POpPoI2ETSCor_MAP "Motortemperaturabhängiges Freigabekorrekturkennfeld für PoI2" MAP 0x8005F16C Map_Xs16Ys16Ws16 100.0000 OneToOne 0.00 100.0000 FORMAT "%8.4" EXTENDED_LIMITS -32768.00 32767.00
 /begin AXIS_DESCR STD_AXIS Epm_nEng EngN 6 0.00 6000.000 FORMAT "%8.3" EXTENDED_LIMITS -16384.00 16383.50 DEPOSIT ABSOLUTE /end AXIS_DESCR
 /begin AXIS_DESCR STD_AXIS InjCtl_qSetUnBal InjMass 6 0.00 327.6700 FORMAT "%8.4" EXTENDED_LIMITS -327.6800 327.6700 DEPOSIT ABSOLUTE /end AXIS_DESCR
/end CHARACTERISTIC
/begin CHARACTERISTIC InjCrv_POpPoI2High_C "Freigabe PoI2 über Betriebspunkt, obere Hystereseschwelle" VALUE 0x80062A18 Val_Ws16 100.0000 OneToOne 0.00 100.0000 FORMAT "%8.4" EXTENDED_LIMITS -32768.00 32767.00 /end CHARACTERISTIC
/begin CHARACTERISTIC InjCrv_POpPoI2Low_C "Freigabe PoI2 über Betriebspunkt, untere Hystereseschwelle" VALUE 0x80062A1A Val_Ws16 100.0000 OneToOne 0.00 100.0000 FORMAT "%8.4" EXTENDED_LIMITS -32768.00 32767.00 /end CHARACTERISTIC
/begin CHARACTERISTIC InjCrv_POpPoI2RgnHigh_C "Obere Hystereseschwelle des Grundwertes Freigabe PoI2 im Regenerationsbetrieb" VALUE 0x80062A1C Val_Ws16 100.0000 OneToOne 0.00 100.0000 FORMAT "%8.4" EXTENDED_LIMITS -32768.00 32767.00 /end CHARACTERISTIC
/begin CHARACTERISTIC InjCrv_POpPoI2RgnLow_C "Untere Hystereseschwelle des Grundwertes Freigabe PoI2 im Regenerationsbetrieb" VALUE 0x80062A1E Val_Ws16 100.0000 OneToOne 0.00 100.0000 FORMAT "%8.4" EXTENDED_LIMITS -32768.00 32767.00 /end CHARACTERISTIC
/begin CHARACTERISTIC InjCrv_POpPoI2Rgn_MAP "Grundwert Freigabe PoI2 im Regenerationsbetrieb" MAP 0x80062A20 Map_Xs16Ys16Ws16 100.0000 OneToOne 0.00 100.0000 FORMAT "%8.4" EXTENDED_LIMITS -32768.00 32767.00
 /begin AXIS_DESCR STD_AXIS Epm_nEng EngN 6 0.00 6000.000 FORMAT "%8.3" EXTENDED_LIMITS -16384.00 16383.50 DEPOSIT ABSOLUTE /end AXIS_DESCR
 /begin AXIS_DESCR STD_AXIS InjCtl_qSetUnBal InjMass 6 0.00 327.6700 FORMAT "%8.4" EXTENDED_LIMITS -327.6800 327.6700 DEPOSIT ABSOLUTE /end AXIS_DESCR
/end CHARACTERISTIC
/begin CHARACTERISTIC InjCrv_qDiffMin_C "Minimale positive Mengendifferenz für Freigabe Voreinspritzung 2" VALUE 0x8005A7B6 Val_Ws16 327.6700 InjMassInj 0.00 327.6700 FORMAT "%8.4" EXTENDED_LIMITS -327.6800 327.6700 /end CHARACTERISTIC
/begin CHARACTERISTIC InjCrv_qMI1MinPiI2DiffHys_C "Differenzmenge zwischen unterer und oberer Hystereseschwelle bei PiI2 für Freigabe PiI2 wenn genügend Menge für MI und PiI2" VALUE 0x8005A7B8 Val_Ws16 10.00000 InjMass 0.00 10.00000 FORMAT "%8.5" EXTENDED_LIMITS -327.6800 327.6700 /end CHARACTERISTIC
/begin CHARACTERISTIC InjCrv_qMI1MinPiI3DiffHys_C "Differenzmenge zwischen unterer und oberer Hystereseschwelle bei PiI3 für Freigabe PiI3 wenn genügend Menge für MI und PiI3" VALUE 0x8005DA06 Val_Ws16 10.00000 InjMass 0.00 10.00000 FORMAT "%8.5" EXTENDED_LIMITS -327.6800 327.6700 /end CHARACTERISTIC
/begin CHARACTERISTIC InjCrv_qMin_CUR "Kennlinie für die Berechnung der Minimalmenge einer Einspritzung" CURVE 0x80062B9C Cur_Xs16Ws16 327.6700 InjMass 0.00 327.6700 FORMAT "%8.4" EXTENDED_LIMITS -327.6800 327.6700
 /begin AXIS_DESCR STD_AXIS RailP_pFlt Pres_Rail 16 0.00 2000.000 FORMAT "%5.3" EXTENDED_LIMITS -3276.800 3276.700 DEPOSIT ABSOLUTE /end AXIS_DESCR
/end CHARACTERISTIC
/begin CHARACTERISTIC InjCrv_qPiI1BasStrt_MAP "Grundwertkennlinie start" MAP 0x8005A646 Kf_Xs16_Ys16_Ws16 10.00000 InjMassInj 0.00 10.00000 FORMAT "%8.5" EXTENDED_LIMITS -327.6800 327.6700
 /begin AXIS_DESCR STD_AXIS Epm_nEng EngN 8 0.00 6000.000 FORMAT "%8.3" EXTENDED_LIMITS -16384.00 16383.50 DEPOSIT ABSOLUTE /end AXIS_DESCR
 /begin AXIS_DESCR STD_AXIS InjCtl_qSetUnBal InjMass 8 0.00 327.6700 FORMAT "%8.4" EXTENDED_LIMITS -327.6800 327.6700 DEPOSIT ABSOLUTE /end AXIS_DESCR
/end CHARACTERISTIC
/begin CHARACTERISTIC InjCrv_qPiI1WvCorMax_C "Schwelle zur Abschaltung der PiI2 bei Unterschreiten der Mindesteinspritzmenge durch PiI1 bei aktiver Wellenkorrektur" VALUE 0x8005A7BA Val_Ws16 3.000000 InjMass -3.000000 0.00 FORMAT "%8.6" EXTENDED_LIMITS -327.6800 327.6700 /end CHARACTERISTIC
/begin CHARACTERISTIC InjCrv_qPiI2APSCor0Rgn_GMAP "Druckabhängiger Basiswert für die Mengenkorrektur der PiI2 für die Regenerationsstufe 1" MAP 0x8005B08E MapG_Ws16 10.00000 InjMass 0.00 10.00000 FORMAT "%8.5" EXTENDED_LIMITS -327.6800 327.6700
 /begin AXIS_DESCR COM_AXIS Epm_nEng EngN 16 -16384.00 16383.50 FORMAT "%8.2" AXIS_PTS_REF InjCrv_qPiI2APSCorRgnX_AXIS /end AXIS_DESCR
 /begin AXIS_DESCR COM_AXIS InjCtl_qSetUnBal InjMass 16 -327.6800 327.6700 FORMAT "%8.4" AXIS_PTS_REF InjCrv_qPiI2APSCorRgnY_AXIS /end AXIS_DESCR
/end CHARACTERISTIC
/begin CHARACTERISTIC InjCrv_qPiI2APSCor1Rgn_GMAP "Druckabhängiger Basiswert für die Mengenkorrektur der PiI2 für die Regenerationsstufe 2" MAP 0x8005B28E MapG_Ws16 10.00000 InjMass 0.00 10.00000 FORMAT "%8.5" EXTENDED_LIMITS -327.6800 327.6700
 /begin AXIS_DESCR COM_AXIS Epm_nEng EngN 16 -16384.00 16383.50 FORMAT "%8.2" AXIS_PTS_REF InjCrv_qPiI2APSCorRgnX_AXIS /end AXIS_DESCR
 /begin AXIS_DESCR COM_AXIS InjCtl_qSetUnBal InjMass 16 -327.6800 327.6700 FORMAT "%8.4" AXIS_PTS_REF InjCrv_qPiI2APSCorRgnY_AXIS /end AXIS_DESCR
/end CHARACTERISTIC
/begin AXIS_PTS InjCrv_qPiI2APSCorRgnX_AXIS "Stützstellenverteilung für das druckabhängige Mengenkorrekturkennfeld InjCrv_qPiI2APSCor%Rgn_GMAP" 0x8005B48E Epm_nEng Axis_Xs16 32767.50 EngN 16 -16384.00 16383.50 FORMAT "%8.2" DEPOSIT ABSOLUTE /end AXIS_PTS
/begin AXIS_PTS InjCrv_qPiI2APSCorRgnY_AXIS "Stützstellenverteilung für das druckabhängige Mengenkorrekturkennfeld InjCrv_qPiI2APSCor%Rgn_GMAP" 0x8005B4B0 InjCtl_qSetUnBal Axis_Xs16 655.3500 InjMass 16 -327.6800 327.6700 FORMAT "%8.4" DEPOSIT ABSOLUTE /end AXIS_PTS
/begin CHARACTERISTIC InjCrv_qPiI2APSCorStrt_MAP "correction value for atmospheric pressure dependent PiI2 quantity correction" MAP 0x8005A972 Kf_Xs16_Ys16_Ws16 10.00000 InjMassInj 0.00 10.00000 FORMAT "%8.5" EXTENDED_LIMITS -327.6800 327.6700
 /begin AXIS_DESCR STD_AXIS Epm_nEng EngN 2 0.00 6000.000 FORMAT "%8.3" EXTENDED_LIMITS -16384.00 16383.50 DEPOSIT ABSOLUTE /end AXIS_DESCR
 /begin AXIS_DESCR STD_AXIS InjCtl_qSetUnBal InjMass 2 0.00 327.6700 FORMAT "%8.4" EXTENDED_LIMITS -327.6800 327.6700 DEPOSIT ABSOLUTE /end AXIS_DESCR
/end CHARACTERISTIC
/begin CHARACTERISTIC InjCrv_qPiI2APSCor_MAP "atmosphärendruckabhängiges Mengenkorrekturkennfeld für Voreinspritzung 2" MAP 0x8005A9C2 Map_Xs16Ys16Ws16 10.00000 InjMass 0.00 10.00000 FORMAT "%8.5" EXTENDED_LIMITS -327.6800 327.6700
 /begin AXIS_DESCR STD_AXIS Epm_nEng EngN 16 0.00 6000.000 FORMAT "%8.3" EXTENDED_LIMITS -16384.00 16383.50 DEPOSIT ABSOLUTE /end AXIS_DESCR
 /begin AXIS_DESCR STD_AXIS InjCtl_qSetUnBal InjMass 16 0.00 327.6700 FORMAT "%8.4" EXTENDED_LIMITS -327.6800 327.6700 DEPOSIT ABSOLUTE /end AXIS_DESCR
/end CHARACTERISTIC
/begin CHARACTERISTIC InjCrv_qPiI2ATSCor0Rgn_GMAP "Ansauglufttemperaturabhängiger Basiswert für die Mengenkorrektur der PiI2 für die Regenerationsstufe 1" MAP 0x8005B4D2 MapG_Ws16 10.00000 InjMass 0.00 10.00000 FORMAT "%8.5" EXTENDED_LIMITS -327.6800 327.6700
 /begin AXIS_DESCR COM_AXIS Epm_nEng EngN 16 -16384.00 16383.50 FORMAT "%8.2" AXIS_PTS_REF InjCrv_qPiI2ATSCorRgnX_AXIS /end AXIS_DESCR
 /begin AXIS_DESCR COM_AXIS InjCtl_qSetUnBal InjMass 16 -327.6800 327.6700 FORMAT "%8.4" AXIS_PTS_REF InjCrv_qPiI2ATSCorRgnY_AXIS /end AXIS_DESCR
/end CHARACTERISTIC
/begin CHARACTERISTIC InjCrv_qPiI2ATSCor1Rgn_GMAP "Ansauglufttemperaturabhängiger Basiswert für die Mengenkorrektur der PiI2 für die Regenerationsstufe 2" MAP 0x8005B6D2 MapG_Ws16 10.00000 InjMass 0.00 10.00000 FORMAT "%8.5" EXTENDED_LIMITS -327.6800 327.6700
 /begin AXIS_DESCR COM_AXIS Epm_nEng EngN 16 -16384.00 16383.50 FORMAT "%8.2" AXIS_PTS_REF InjCrv_qPiI2ATSCorRgnX_AXIS /end AXIS_DESCR
 /begin AXIS_DESCR COM_AXIS InjCtl_qSetUnBal InjMass 16 -327.6800 327.6700 FORMAT "%8.4" AXIS_PTS_REF InjCrv_qPiI2ATSCorRgnY_AXIS /end AXIS_DESCR
/end CHARACTERISTIC
/begin AXIS_PTS InjCrv_qPiI2ATSCorRgnX_AXIS "Stützstellenverteilung für das ansauglufttemperaturabhängige Mengenkorrekturkennfeld InjCrv_qPiI2ATSCor%Rgn_GMAP" 0x8005B8D2 Epm_nEng Axis_Xs16 32767.50 EngN 16 -16384.00 16383.50 FORMAT "%8.2" DEPOSIT ABSOLUTE /end AXIS_PTS
/begin AXIS_PTS InjCrv_qPiI2ATSCorRgnY_AXIS "Stützstellenverteilung für das ansauglufttemperaturabhängige Mengenkorrekturkennfeld InjCrv_qPiI2ATSCor%Rgn_GMAP" 0x8005B8F4 InjCtl_qSetUnBal Axis_Xs16 655.3500 InjMass 16 -327.6800 327.6700 FORMAT "%8.4" DEPOSIT ABSOLUTE /end AXIS_PTS
/begin CHARACTERISTIC InjCrv_qPiI2ATSCorStrt_MAP "correction value for intake air temperature dependent PiI2 quantity correction" MAP 0x8005A986 Kf_Xs16_Ys16_Ws16 10.00000 InjMassInj 0.00 10.00000 FORMAT "%8.5" EXTENDED_LIMITS -327.6800 327.6700
 /begin AXIS_DESCR STD_AXIS Epm_nEng EngN 2 0.00 6000.000 FORMAT "%8.3" EXTENDED_LIMITS -16384.00 16383.50 DEPOSIT ABSOLUTE /end AXIS_DESCR
 /begin AXIS_DESCR STD_AXIS InjCtl_qSetUnBal InjMass 2 0.00 327.6700 FORMAT "%8.4" EXTENDED_LIMITS -327.6800 327.6700 DEPOSIT ABSOLUTE /end AXIS_DESCR
/end CHARACTERISTIC
/begin CHARACTERISTIC InjCrv_qPiI2ATSCor_MAP "ansauglufttemperaturabhängiges Mengenkorrekturkennfeld für Voreinspritzung 2" MAP 0x8005AC06 Map_Xs16Ys16Ws16 10.00000 InjMass 0.00 10.00000 FORMAT "%8.5" EXTENDED_LIMITS -327.6800 327.6700
 /begin AXIS_DESCR STD_AXIS Epm_nEng EngN 16 0.00 6000.000 FORMAT "%8.3" EXTENDED_LIMITS -16384.00 16383.50 DEPOSIT ABSOLUTE /end AXIS_DESCR
 /begin AXIS_DESCR STD_AXIS InjCtl_qSetUnBal InjMass 16 0.00 327.6700 FORMAT "%8.4" EXTENDED_LIMITS -327.6800 327.6700 DEPOSIT ABSOLUTE /end AXIS_DESCR
/end CHARACTERISTIC
/begin CHARACTERISTIC InjCrv_qPiI2Bas0Rgn_GMAP "Kennfeld für Basiswert für die Mengenkorrektur der PiI2 für die Regenerationsstufe 1" MAP 0x8005CB76 MapG_Ws16 655.3500 InjMass -327.6800 327.6700 FORMAT "%8.4"
 /begin AXIS_DESCR COM_AXIS Epm_nEng EngN 16 -16384.00 16383.50 FORMAT "%8.2" AXIS_PTS_REF InjCrv_qPiI2BasRgnX_AXIS /end AXIS_DESCR
 /begin AXIS_DESCR COM_AXIS InjCtl_qSetUnBal InjMass 16 -327.6800 327.6700 FORMAT "%8.4" AXIS_PTS_REF InjCrv_qPiI2BasRgnY_AXIS /end AXIS_DESCR
/end CHARACTERISTIC
/begin CHARACTERISTIC InjCrv_qPiI2Bas1Rgn_GMAP "Kennfeld für Basiswert für die Mengenkorrektur der PiI2 für die Regenerationsstufe 2" MAP 0x8005CD76 MapG_Ws16 655.3500 InjMass -327.6800 327.6700 FORMAT "%8.4"
 /begin AXIS_DESCR COM_AXIS Epm_nEng EngN 16 -16384.00 16383.50 FORMAT "%8.2" AXIS_PTS_REF InjCrv_qPiI2BasRgnX_AXIS /end AXIS_DESCR
 /begin AXIS_DESCR COM_AXIS InjCtl_qSetUnBal InjMass 16 -327.6800 327.6700 FORMAT "%8.4" AXIS_PTS_REF InjCrv_qPiI2BasRgnY_AXIS /end AXIS_DESCR
/end CHARACTERISTIC
/begin AXIS_PTS InjCrv_qPiI2BasRgnX_AXIS "Stützstellenverteilung für das Basismengenkennfeld InjCrv_qPiI2Bas%Rgn_GMAP" 0x8005CF76 Epm_nEng Axis_Xs16 32767.50 EngN 16 -16384.00 16383.50 FORMAT "%8.2" DEPOSIT ABSOLUTE /end AXIS_PTS
/begin AXIS_PTS InjCrv_qPiI2BasRgnY_AXIS "Stützstellenverteilung für das Basismengenkennfeld InjCrv_qPiI2Bas%Rgn_GMAP" 0x8005CF98 InjCtl_qSetUnBal Axis_Xs16 655.3500 InjMass 16 -327.6800 327.6700 FORMAT "%8.4" DEPOSIT ABSOLUTE /end AXIS_PTS
/begin CHARACTERISTIC InjCrv_qPiI2BasStrt_MAP "Einspritzmenge PiI2 Grundwertekennfeld start" MAP 0x8005D7D2 Kf_Xs16_Ys16_Ws16 10.00000 InjMassInj 0.00 10.00000 FORMAT "%8.5" EXTENDED_LIMITS -327.6800 327.6700
 /begin AXIS_DESCR STD_AXIS Epm_nEng EngN 2 0.00 6000.000 FORMAT "%8.3" EXTENDED_LIMITS -16384.00 16383.50 DEPOSIT ABSOLUTE /end AXIS_DESCR
 /begin AXIS_DESCR STD_AXIS InjCtl_qSetUnBal InjMass 2 0.00 327.6700 FORMAT "%8.4" EXTENDED_LIMITS -327.6800 327.6700 DEPOSIT ABSOLUTE /end AXIS_DESCR
/end CHARACTERISTIC
/begin CHARACTERISTIC InjCrv_qPiI2Bas_MAP "Einspritzmenge PiI2 Grundwertekennfeld" MAP 0x8005A7BC Map_Xs16Ys16Ws16 10.00000 InjMass 0.00 10.00000 FORMAT "%8.5" EXTENDED_LIMITS -327.6800 327.6700
 /begin AXIS_DESCR STD_AXIS Epm_nEng EngN 10 0.00 6000.000 FORMAT "%8.3" EXTENDED_LIMITS -16384.00 16383.50 DEPOSIT ABSOLUTE /end AXIS_DESCR
 /begin AXIS_DESCR STD_AXIS InjCtl_qSetUnBal InjMass 10 0.00 327.6700 FORMAT "%8.4" EXTENDED_LIMITS -327.6800 327.6700 DEPOSIT ABSOLUTE /end AXIS_DESCR
/end CHARACTERISTIC
/begin CHARACTERISTIC InjCrv_qPiI2Des_C "Fernsteuerwert der Einspritzmenge der PiI2" VALUE 0x8005A8B0 Val_Ws16 100.0000 InjMass 0.00 100.0000 FORMAT "%8.4" EXTENDED_LIMITS -327.6800 327.6700 /end CHARACTERISTIC
/begin CHARACTERISTIC InjCrv_qPiI2ETSCor0Rgn_GMAP "Motortemperaturabhängiger Basiswert für die Mengenkorrektur der PiI2 für die Regenerationsstufe 1" MAP 0x8005B916 MapG_Ws16 10.00000 InjMass 0.00 10.00000 FORMAT "%8.5" EXTENDED_LIMITS -327.6800 327.6700
 /begin AXIS_DESCR COM_AXIS Epm_nEng EngN 16 -16384.00 16383.50 FORMAT "%8.2" AXIS_PTS_REF InjCrv_qPiI2ETSCorRgnX_AXIS /end AXIS_DESCR
 /begin AXIS_DESCR COM_AXIS InjCtl_qSetUnBal InjMass 16 -327.6800 327.6700 FORMAT "%8.4" AXIS_PTS_REF InjCrv_qPiI2ETSCorRgnY_AXIS /end AXIS_DESCR
/end CHARACTERISTIC
/begin CHARACTERISTIC InjCrv_qPiI2ETSCor1Rgn_GMAP "Motortemperaturabhängiger Basiswert für die Mengenkorrektur der PiI2 für die Regenerationsstufe 2" MAP 0x8005BB16 MapG_Ws16 10.00000 InjMass 0.00 10.00000 FORMAT "%8.5" EXTENDED_LIMITS -327.6800 327.6700
 /begin AXIS_DESCR COM_AXIS Epm_nEng EngN 16 -16384.00 16383.50 FORMAT "%8.2" AXIS_PTS_REF InjCrv_qPiI2ETSCorRgnX_AXIS /end AXIS_DESCR
 /begin AXIS_DESCR COM_AXIS InjCtl_qSetUnBal InjMass 16 -327.6800 327.6700 FORMAT "%8.4" AXIS_PTS_REF InjCrv_qPiI2ETSCorRgnY_AXIS /end AXIS_DESCR
/end CHARACTERISTIC
/begin AXIS_PTS InjCrv_qPiI2ETSCorRgnX_AXIS "Stützstellenverteilung für das motortemperaturabhängige Mengenkorrekturkennfeld InjCrv_qPiI2ETSCor%Rgn_GMAP" 0x8005BD16 Epm_nEng Axis_Xs16 32767.50 EngN 16 -16384.00 16383.50 FORMAT "%8.2" DEPOSIT ABSOLUTE /end AXIS_PTS
/begin AXIS_PTS InjCrv_qPiI2ETSCorRgnY_AXIS "Stützstellenverteilung für das ansauglufttemperaturabhängige Mengenkorrekturkennfeld InjCrv_qPiI2ETSCor%Rgn_GMAP" 0x8005BD38 InjCtl_qSetUnBal Axis_Xs16 655.3500 InjMass 16 -327.6800 327.6700 FORMAT "%8.4" DEPOSIT ABSOLUTE /end AXIS_PTS
/begin CHARACTERISTIC InjCrv_qPiI2ETSCorStrt_MAP "correction value for engine temperature dependent PiI2 quantity correction" MAP 0x8005A99A Kf_Xs16_Ys16_Ws16 10.00000 InjMassInj 0.00 10.00000 FORMAT "%8.5" EXTENDED_LIMITS -327.6800 327.6700
 /begin AXIS_DESCR STD_AXIS Epm_nEng EngN 2 0.00 6000.000 FORMAT "%8.3" EXTENDED_LIMITS -16384.00 16383.50 DEPOSIT ABSOLUTE /end AXIS_DESCR
 /begin AXIS_DESCR STD_AXIS InjCtl_qSetUnBal InjMass 2 0.00 327.6700 FORMAT "%8.4" EXTENDED_LIMITS -327.6800 327.6700 DEPOSIT ABSOLUTE /end AXIS_DESCR
/end CHARACTERISTIC
/begin CHARACTERISTIC InjCrv_qPiI2ETSCor_MAP "motortemperaturabhängiges Mengenkorrekturkennfeld für Voreinspritzung 2" MAP 0x8005AE4A Map_Xs16Ys16Ws16 10.00000 InjMass 0.00 10.00000 FORMAT "%8.5" EXTENDED_LIMITS -327.6800 327.6700
 /begin AXIS_DESCR STD_AXIS Epm_nEng EngN 16 0.00 6000.000 FORMAT "%8.3" EXTENDED_LIMITS -16384.00 16383.50 DEPOSIT ABSOLUTE /end AXIS_DESCR
 /begin AXIS_DESCR STD_AXIS InjCtl_qSetUnBal InjMass 16 0.00 327.6700 FORMAT "%8.4" EXTENDED_LIMITS -327.6800 327.6700 DEPOSIT ABSOLUTE /end AXIS_DESCR
/end CHARACTERISTIC
/begin CHARACTERISTIC InjCrv_qPiI2MaxRgn_MAP "Einspritzmenge PiI2 Maximalwertekennfeld im Regenerationsbetrieb" MAP 0x8005CFBA Map_Xs16Ys16Ws16 10.00000 InjMass 0.00 10.00000 FORMAT "%8.5" EXTENDED_LIMITS -327.6800 327.6700
 /begin AXIS_DESCR STD_AXIS Epm_nEng EngN 16 0.00 6000.000 FORMAT "%8.3" EXTENDED_LIMITS -16384.00 16383.50 DEPOSIT ABSOLUTE /end AXIS_DESCR
 /begin AXIS_DESCR STD_AXIS InjCtl_qSetUnBal InjMass 16 0.00 327.6700 FORMAT "%8.4" EXTENDED_LIMITS -327.6800 327.6700 DEPOSIT ABSOLUTE /end AXIS_DESCR
/end CHARACTERISTIC
/begin CHARACTERISTIC InjCrv_qPiI2Max_MAP "Einspritzmenge PiI2 Maximalwertekennfeld" MAP 0x8005A8B2 Map_Xs16Ys16Ws16 10.00000 InjMass 0.00 10.00000 FORMAT "%8.5" EXTENDED_LIMITS -327.6800 327.6700
 /begin AXIS_DESCR STD_AXIS Epm_nEng EngN 8 0.00 6000.000 FORMAT "%8.3" EXTENDED_LIMITS -16384.00 16383.50 DEPOSIT ABSOLUTE /end AXIS_DESCR
 /begin AXIS_DESCR STD_AXIS InjCtl_qSetUnBal InjMass 8 0.00 327.6700 FORMAT "%8.4" EXTENDED_LIMITS -327.6800 327.6700 DEPOSIT ABSOLUTE /end AXIS_DESCR
/end CHARACTERISTIC
/begin CHARACTERISTIC InjCrv_qPiI2MinDiff_C "Minimalmenge zwischen unteren und oberen Hysteresenschwelle für Voreinspritzung 2" VALUE 0x8005A956 Val_Ws16 10.00000 InjMass 0.00 10.00000 FORMAT "%8.5" EXTENDED_LIMITS -327.6800 327.6700 /end CHARACTERISTIC
/begin CHARACTERISTIC InjCrv_qPiI3APSCor_MAP "atmosphärendruckabhängiges Mengenkorrekturkennfeld für Voreinspritzung 3" MAP 0x8005DE92 Map_Xs16Ys16Ws16 10.00000 InjMass 0.00 10.00000 FORMAT "%8.5" EXTENDED_LIMITS -327.6800 327.6700
 /begin AXIS_DESCR STD_AXIS Epm_nEng EngN 16 0.00 6000.000 FORMAT "%8.3" EXTENDED_LIMITS -16384.00 16383.50 DEPOSIT ABSOLUTE /end AXIS_DESCR
 /begin AXIS_DESCR STD_AXIS InjCtl_qSetUnBal InjMass 8 0.00 327.6700 FORMAT "%8.4" EXTENDED_LIMITS -327.6800 327.6700 DEPOSIT ABSOLUTE /end AXIS_DESCR
/end CHARACTERISTIC
/begin CHARACTERISTIC InjCrv_qPiI3ATSCor_MAP "ansauglufttemperaturabhängiges Mengenkorrekturkennfeld für Voreinspritzung 3" MAP 0x8005DFC6 Map_Xs16Ys16Ws16 10.00000 InjMass 0.00 10.00000 FORMAT "%8.5" EXTENDED_LIMITS -327.6800 327.6700
 /begin AXIS_DESCR STD_AXIS Epm_nEng EngN 16 0.00 6000.000 FORMAT "%8.3" EXTENDED_LIMITS -16384.00 16383.50 DEPOSIT ABSOLUTE /end AXIS_DESCR
 /begin AXIS_DESCR STD_AXIS InjCtl_qSetUnBal InjMass 8 0.00 327.6700 FORMAT "%8.4" EXTENDED_LIMITS -327.6800 327.6700 DEPOSIT ABSOLUTE /end AXIS_DESCR
/end CHARACTERISTIC
/begin CHARACTERISTIC InjCrv_qPiI3Bas_MAP "Einspritzmenge PiI3 Grundwertekennfeld" MAP 0x8005DA08 Map_Xs16Ys16Ws16 10.00000 InjMass 0.00 10.00000 FORMAT "%8.5" EXTENDED_LIMITS -327.6800 327.6700
 /begin AXIS_DESCR STD_AXIS Epm_nEng EngN 16 0.00 6000.000 FORMAT "%8.3" EXTENDED_LIMITS -16384.00 16383.50 DEPOSIT ABSOLUTE /end AXIS_DESCR
 /begin AXIS_DESCR STD_AXIS InjCtl_qSetUnBal InjMass 16 0.00 327.6700 FORMAT "%8.4" EXTENDED_LIMITS -327.6800 327.6700 DEPOSIT ABSOLUTE /end AXIS_DESCR
/end CHARACTERISTIC
/begin CHARACTERISTIC InjCrv_qPiI3Des_C "Fernsteuerwert der Einspritzmenge der PiI3" VALUE 0x8005DC4C Val_Ws16 100.0000 InjMass 0.00 100.0000 FORMAT "%8.4" EXTENDED_LIMITS -327.6800 327.6700 /end CHARACTERISTIC
/begin CHARACTERISTIC InjCrv_qPiI3ETSCor_MAP "motortemperaturabhängiges Mengenkorrekturkennfeld für Voreinspritzung 3" MAP 0x8005E0FA Map_Xs16Ys16Ws16 10.00000 InjMass 0.00 10.00000 FORMAT "%8.5" EXTENDED_LIMITS -327.6800 327.6700
 /begin AXIS_DESCR STD_AXIS Epm_nEng EngN 16 0.00 6000.000 FORMAT "%8.3" EXTENDED_LIMITS -16384.00 16383.50 DEPOSIT ABSOLUTE /end AXIS_DESCR
 /begin AXIS_DESCR STD_AXIS InjCtl_qSetUnBal InjMass 8 0.00 327.6700 FORMAT "%8.4" EXTENDED_LIMITS -327.6800 327.6700 DEPOSIT ABSOLUTE /end AXIS_DESCR
/end CHARACTERISTIC
/begin CHARACTERISTIC InjCrv_qPiI3Max_MAP "Einspritzmenge PiI3 Maximalwertekennfeld" MAP 0x8005DC4E Map_Xs16Ys16Ws16 10.00000 InjMass 0.00 10.00000 FORMAT "%8.5" EXTENDED_LIMITS -327.6800 327.6700
 /begin AXIS_DESCR STD_AXIS Epm_nEng EngN 16 0.00 6000.000 FORMAT "%8.3" EXTENDED_LIMITS -16384.00 16383.50 DEPOSIT ABSOLUTE /end AXIS_DESCR
 /begin AXIS_DESCR STD_AXIS InjCtl_qSetUnBal InjMass 10 0.00 327.6700 FORMAT "%8.4" EXTENDED_LIMITS -327.6800 327.6700 DEPOSIT ABSOLUTE /end AXIS_DESCR
/end CHARACTERISTIC
/begin CHARACTERISTIC InjCrv_qPiI3MinDiff_C "minimale Differenzmenge zwischen unterer und oberer Hystereseschwelle bei Voreinspritzung 3" VALUE 0x8005DDC6 Val_Ws16 10.00000 InjMass 0.00 10.00000 FORMAT "%8.5" EXTENDED_LIMITS -327.6800 327.6700 /end CHARACTERISTIC
/begin CHARACTERISTIC InjCrv_qPoI1APSCor_MAP "atmosphärendruckabhängiges Mengenkorrekturkennfeld für PoI1" MAP 0x8005E428 Map_Xs16Ys16Ws16 10.00000 InjMass 0.00 10.00000 FORMAT "%8.5" EXTENDED_LIMITS -327.6800 327.6700
 /begin AXIS_DESCR STD_AXIS Epm_nEng EngN 2 0.00 6000.000 FORMAT "%8.3" EXTENDED_LIMITS -16384.00 16383.50 DEPOSIT ABSOLUTE /end AXIS_DESCR
 /begin AXIS_DESCR STD_AXIS InjCtl_qSetUnBal InjMass 2 0.00 327.6700 FORMAT "%8.4" EXTENDED_LIMITS -327.6800 327.6700 DEPOSIT ABSOLUTE /end AXIS_DESCR
/end CHARACTERISTIC
/begin CHARACTERISTIC InjCrv_qPoI1Bas0Rgn_GMAP "Kennfeld für Basiswert für die Mengenkorrektur der PoI1 für die Regenerationsstufe 1" MAP 0x8005E8C0 MapG_Ws16 10.00000 InjMass 0.00 10.00000 FORMAT "%8.5" EXTENDED_LIMITS -327.6800 327.6700
 /begin AXIS_DESCR COM_AXIS Epm_nEng EngN 16 0.00 6000.000 FORMAT "%8.3" EXTENDED_LIMITS -16384.00 16383.50 AXIS_PTS_REF InjCrv_qPoI1BasRgnX_AXIS /end AXIS_DESCR
 /begin AXIS_DESCR COM_AXIS InjCtl_qSetUnBal InjMass 16 0.00 327.6700 FORMAT "%8.4" EXTENDED_LIMITS -327.6800 327.6700 AXIS_PTS_REF InjCrv_qPoI1BasRgnY_AXIS /end AXIS_DESCR
/end CHARACTERISTIC
/begin CHARACTERISTIC InjCrv_qPoI1Bas1Rgn_GMAP "Kennfeld für Basiswert für die Mengenkorrektur der PoI1 für die Regenerationsstufe 2" MAP 0x8005EAC0 MapG_Ws16 10.00000 InjMass 0.00 10.00000 FORMAT "%8.5" EXTENDED_LIMITS -327.6800 327.6700
 /begin AXIS_DESCR COM_AXIS Epm_nEng EngN 16 0.00 6000.000 FORMAT "%8.3" EXTENDED_LIMITS -16384.00 16383.50 AXIS_PTS_REF InjCrv_qPoI1BasRgnX_AXIS /end AXIS_DESCR
 /begin AXIS_DESCR COM_AXIS InjCtl_qSetUnBal InjMass 16 0.00 327.6700 FORMAT "%8.4" EXTENDED_LIMITS -327.6800 327.6700 AXIS_PTS_REF InjCrv_qPoI1BasRgnY_AXIS /end AXIS_DESCR
/end CHARACTERISTIC
/begin AXIS_PTS InjCrv_qPoI1BasRgnX_AXIS "" 0x8005ECC0 Epm_nEng Axis_Xs16 6000.000 EngN 16 0.00 6000.000 FORMAT "%8.3" EXTENDED_LIMITS -16384.00 16383.50 DEPOSIT ABSOLUTE /end AXIS_PTS
/begin AXIS_PTS InjCrv_qPoI1BasRgnY_AXIS "" 0x8005ECE2 InjCtl_qSetUnBal Axis_Xs16 327.6700 InjMass 16 0.00 327.6700 FORMAT "%8.4" EXTENDED_LIMITS -327.6800 327.6700 DEPOSIT ABSOLUTE /end AXIS_PTS
/begin CHARACTERISTIC InjCrv_qPoI1Bas_MAP "Grundwert der Einspritzmenge PoI1" MAP 0x8005E396 Map_Xs16Ys16Ws16 10.00000 InjMass 0.00 10.00000 FORMAT "%8.5" EXTENDED_LIMITS -327.6800 327.6700
 /begin AXIS_DESCR STD_AXIS Epm_nEng EngN 2 0.00 6000.000 FORMAT "%8.3" EXTENDED_LIMITS -16384.00 16383.50 DEPOSIT ABSOLUTE /end AXIS_DESCR
 /begin AXIS_DESCR STD_AXIS InjCtl_qSetUnBal InjMass 2 0.00 327.6700 FORMAT "%8.4" EXTENDED_LIMITS -327.6800 327.6700 DEPOSIT ABSOLUTE /end AXIS_DESCR
/end CHARACTERISTIC
/begin CHARACTERISTIC InjCrv_qPoI1Des_C "Fernsteuerwert der Einspritzmenge der PoI1" VALUE 0x8005E3AA Val_Ws16 100.0000 InjMass 0.00 100.0000 FORMAT "%8.4" EXTENDED_LIMITS -327.6800 327.6700 /end CHARACTERISTIC
/begin CHARACTERISTIC InjCrv_qPoI1ETSCor_MAP "motortemperaturabhängiges Mengenkorrekturkennfeld für PoI1" MAP 0x8005E43C Map_Xs16Ys16Ws16 10.00000 InjMass 0.00 10.00000 FORMAT "%8.5" EXTENDED_LIMITS -327.6800 327.6700
 /begin AXIS_DESCR STD_AXIS Epm_nEng EngN 2 0.00 6000.000 FORMAT "%8.3" EXTENDED_LIMITS -16384.00 16383.50 DEPOSIT ABSOLUTE /end AXIS_DESCR
 /begin AXIS_DESCR STD_AXIS InjCtl_qSetUnBal InjMass 2 0.00 327.6700 FORMAT "%8.4" EXTENDED_LIMITS -327.6800 327.6700 DEPOSIT ABSOLUTE /end AXIS_DESCR
/end CHARACTERISTIC
/begin CHARACTERISTIC InjCrv_qPoI1Max_MAP "Kennfeld für den Maximalwert der Einspritzmenge PoI1" MAP 0x8005E3AC Map_Xs16Ys16Ws16 10.00000 InjMass 0.00 10.00000 FORMAT "%8.5" EXTENDED_LIMITS -327.6800 327.6700
 /begin AXIS_DESCR STD_AXIS Epm_nEng EngN 6 0.00 6000.000 FORMAT "%8.3" EXTENDED_LIMITS -16384.00 16383.50 DEPOSIT ABSOLUTE /end AXIS_DESCR
 /begin AXIS_DESCR STD_AXIS InjCtl_qSetUnBal InjMass 6 0.00 327.6700 FORMAT "%8.4" EXTENDED_LIMITS -327.6800 327.6700 DEPOSIT ABSOLUTE /end AXIS_DESCR
/end CHARACTERISTIC
/begin CHARACTERISTIC InjCrv_qPoI2APSCor0Rgn_GMAP "Basismengenkorrekturkennfelder abhängig von dem Druck für die PoI2 für die Regenerationsstufe 1" MAP 0x8005FB2E MapG_Ws16 10.00000 InjMass 0.00 10.00000 FORMAT "%8.5" EXTENDED_LIMITS -327.6800 327.6700
 /begin AXIS_DESCR COM_AXIS Epm_nEng EngN 16 0.00 6000.000 FORMAT "%8.3" EXTENDED_LIMITS -16384.00 16383.50 AXIS_PTS_REF InjCrv_qPoI2APSCorRgnX_AXIS /end AXIS_DESCR
 /begin AXIS_DESCR COM_AXIS InjCtl_qSetUnBal InjMass 16 0.00 327.6700 FORMAT "%8.4" EXTENDED_LIMITS -327.6800 327.6700 AXIS_PTS_REF InjCrv_qPoI2APSCorRgnY_AXIS /end AXIS_DESCR
/end CHARACTERISTIC
/begin CHARACTERISTIC InjCrv_qPoI2APSCor1Rgn_GMAP "Basismengenkorrekturkennfelder abhängig von dem Druck für die PoI2 für die Regenerationsstufe 2" MAP 0x8005FD2E MapG_Ws16 10.00000 InjMass 0.00 10.00000 FORMAT "%8.5" EXTENDED_LIMITS -327.6800 327.6700
 /begin AXIS_DESCR COM_AXIS Epm_nEng EngN 16 0.00 6000.000 FORMAT "%8.3" EXTENDED_LIMITS -16384.00 16383.50 AXIS_PTS_REF InjCrv_qPoI2APSCorRgnX_AXIS /end AXIS_DESCR
 /begin AXIS_DESCR COM_AXIS InjCtl_qSetUnBal InjMass 16 0.00 327.6700 FORMAT "%8.4" EXTENDED_LIMITS -327.6800 327.6700 AXIS_PTS_REF InjCrv_qPoI2APSCorRgnY_AXIS /end AXIS_DESCR
/end CHARACTERISTIC
/begin AXIS_PTS InjCrv_qPoI2APSCorRgnX_AXIS "" 0x8005FF2E Epm_nEng Axis_Xs16 6000.000 EngN 16 0.00 6000.000 FORMAT "%8.3" EXTENDED_LIMITS -16384.00 16383.50 DEPOSIT ABSOLUTE /end AXIS_PTS
/begin AXIS_PTS InjCrv_qPoI2APSCorRgnY_AXIS "" 0x8005FF50 InjCtl_qSetUnBal Axis_Xs16 327.6700 InjMass 16 0.00 327.6700 FORMAT "%8.4" EXTENDED_LIMITS -327.6800 327.6700 DEPOSIT ABSOLUTE /end AXIS_PTS
/begin CHARACTERISTIC InjCrv_qPoI2ATSCor0Rgn_GMAP "Basismengenkorrekturkennfeld abhängig von der Lufttemperatur für die PoI2 für die Regenerationsstufe 1" MAP 0x8005FF72 MapG_Ws16 10.00000 InjMass 0.00 10.00000 FORMAT "%8.5" EXTENDED_LIMITS -327.6800 327.6700
 /begin AXIS_DESCR COM_AXIS Epm_nEng EngN 16 0.00 6000.000 FORMAT "%8.3" EXTENDED_LIMITS -16384.00 16383.50 AXIS_PTS_REF InjCrv_qPoI2ATSCorRgnX_AXIS /end AXIS_DESCR
 /begin AXIS_DESCR COM_AXIS InjCtl_qSetUnBal InjMass 16 0.00 327.6700 FORMAT "%8.4" EXTENDED_LIMITS -327.6800 327.6700 AXIS_PTS_REF InjCrv_qPoI2ATSCorRgnY_AXIS /end AXIS_DESCR
/end CHARACTERISTIC
/begin CHARACTERISTIC InjCrv_qPoI2ATSCor1Rgn_GMAP "Basismengenkorrekturkennfeld abhängig von der Lufttemperatur für die PoI2 für die Regenerationsstufe 2" MAP 0x80060172 MapG_Ws16 10.00000 InjMass 0.00 10.00000 FORMAT "%8.5" EXTENDED_LIMITS -327.6800 327.6700
 /begin AXIS_DESCR COM_AXIS Epm_nEng EngN 16 0.00 6000.000 FORMAT "%8.3" EXTENDED_LIMITS -16384.00 16383.50 AXIS_PTS_REF InjCrv_qPoI2ATSCorRgnX_AXIS /end AXIS_DESCR
 /begin AXIS_DESCR COM_AXIS InjCtl_qSetUnBal InjMass 16 0.00 327.6700 FORMAT "%8.4" EXTENDED_LIMITS -327.6800 327.6700 AXIS_PTS_REF InjCrv_qPoI2ATSCorRgnY_AXIS /end AXIS_DESCR
/end CHARACTERISTIC
/begin AXIS_PTS InjCrv_qPoI2ATSCorRgnX_AXIS "" 0x80060372 Epm_nEng Axis_Xs16 6000.000 EngN 16 0.00 6000.000 FORMAT "%8.3" EXTENDED_LIMITS -16384.00 16383.50 DEPOSIT ABSOLUTE /end AXIS_PTS
/begin AXIS_PTS InjCrv_qPoI2ATSCorRgnY_AXIS "" 0x80060394 InjCtl_qSetUnBal Axis_Xs16 327.6700 InjMass 16 0.00 327.6700 FORMAT "%8.4" EXTENDED_LIMITS -327.6800 327.6700 DEPOSIT ABSOLUTE /end AXIS_PTS
/begin CHARACTERISTIC InjCrv_qPoI2ATSCor_MAP "ansauglufttemperaturabhängiges Mengenkorrekturkennfeld für PoI2" MAP 0x8005F1D0 Map_Xs16Ys16Ws16 10.00000 InjMass 0.00 10.00000 FORMAT "%8.5" EXTENDED_LIMITS -327.6800 327.6700
 /begin AXIS_DESCR STD_AXIS Epm_nEng EngN 6 0.00 6000.000 FORMAT "%8.3" EXTENDED_LIMITS -16384.00 16383.50 DEPOSIT ABSOLUTE /end AXIS_DESCR
 /begin AXIS_DESCR STD_AXIS InjCtl_qSetUnBal InjMass 6 0.00 327.6700 FORMAT "%8.4" EXTENDED_LIMITS -327.6800 327.6700 DEPOSIT ABSOLUTE /end AXIS_DESCR
/end CHARACTERISTIC
/begin CHARACTERISTIC InjCrv_qPoI2Bas0Rgn_GMAP "Kennfeld für Basiswert für die Mengenkorrektur der PoI2 für die Regenerationsstufe 1" MAP 0x80061DF2 MapG_Ws16 10.00000 InjMass 0.00 10.00000 FORMAT "%8.5" EXTENDED_LIMITS -327.6800 327.6700
 /begin AXIS_DESCR COM_AXIS Epm_nEng EngN 16 0.00 6000.000 FORMAT "%8.3" EXTENDED_LIMITS -16384.00 16383.50 AXIS_PTS_REF InjCrv_qPoI2BasRgnX_AXIS /end AXIS_DESCR
 /begin AXIS_DESCR COM_AXIS InjCtl_qSetUnBal InjMass 16 0.00 327.6700 FORMAT "%8.4" EXTENDED_LIMITS -327.6800 327.6700 AXIS_PTS_REF InjCrv_qPoI2BasRgnY_AXIS /end AXIS_DESCR
/end CHARACTERISTIC
/begin CHARACTERISTIC InjCrv_qPoI2Bas1Rgn_GMAP "Kennfeld für Basiswert für die Mengenkorrektur der PoI2 für die Regenerationsstufe 2" MAP 0x80061FF2 MapG_Ws16 10.00000 InjMass 0.00 10.00000 FORMAT "%8.5" EXTENDED_LIMITS -327.6800 327.6700
 /begin AXIS_DESCR COM_AXIS Epm_nEng EngN 16 0.00 6000.000 FORMAT "%8.3" EXTENDED_LIMITS -16384.00 16383.50 AXIS_PTS_REF InjCrv_qPoI2BasRgnX_AXIS /end AXIS_DESCR
 /begin AXIS_DESCR COM_AXIS InjCtl_qSetUnBal InjMass 16 0.00 327.6700 FORMAT "%8.4" EXTENDED_LIMITS -327.6800 327.6700 AXIS_PTS_REF InjCrv_qPoI2BasRgnY_AXIS /end AXIS_DESCR
/end CHARACTERISTIC
/begin AXIS_PTS InjCrv_qPoI2BasRgnX_AXIS "" 0x800621F2 Epm_nEng Axis_Xs16 6000.000 EngN 16 0.00 6000.000 FORMAT "%8.3" EXTENDED_LIMITS -16384.00 16383.50 DEPOSIT ABSOLUTE /end AXIS_PTS
/begin AXIS_PTS InjCrv_qPoI2BasRgnY_AXIS "" 0x80062214 InjCtl_qSetUnBal Axis_Xs16 327.6700 InjMass 16 0.00 327.6700 FORMAT "%8.4" EXTENDED_LIMITS -327.6800 327.6700 DEPOSIT ABSOLUTE /end AXIS_PTS
/begin CHARACTERISTIC InjCrv_qPoI2Bas_MAP "Einspritzmenge PoI2 Grundwert" MAP 0x8005EEE2 Map_Xs16Ys16Ws16 10.00000 InjMass 0.00 10.00000 FORMAT "%8.5" EXTENDED_LIMITS -327.6800 327.6700
 /begin AXIS_DESCR STD_AXIS Epm_nEng EngN 16 0.00 6000.000 FORMAT "%8.3" EXTENDED_LIMITS -16384.00 16383.50 DEPOSIT ABSOLUTE /end AXIS_DESCR
 /begin AXIS_DESCR STD_AXIS InjCtl_qSetUnBal InjMass 16 0.00 327.6700 FORMAT "%8.4" EXTENDED_LIMITS -327.6800 327.6700 DEPOSIT ABSOLUTE /end AXIS_DESCR
/end CHARACTERISTIC
/begin CHARACTERISTIC InjCrv_qPoI2Des_C "Fernsteuerwert der Gesamtmenge der PoI2" VALUE 0x8005F126 Val_Ws16 100.0000 InjMass 0.00 100.0000 FORMAT "%8.4" EXTENDED_LIMITS -327.6800 327.6700 /end CHARACTERISTIC
/begin CHARACTERISTIC InjCrv_qPoI2Eff_C "Fernsteuerwert der Moment bildenden Menge der PoI2" VALUE 0x8005F128 Val_Ws16 10.00000 InjMass 0.00 10.00000 FORMAT "%8.5" EXTENDED_LIMITS -327.6800 327.6700 /end CHARACTERISTIC
/begin CHARACTERISTIC InjCrv_qPoI2ETSCor0Rgn_GMAP "Basismengenkorrekturkennfeld abhängig von der Motortemperatur für die PoI2 für die Regenerationsstufe 1" MAP 0x800603B6 MapG_Ws16 10.00000 InjMass 0.00 10.00000 FORMAT "%8.5" EXTENDED_LIMITS -327.6800 327.6700
 /begin AXIS_DESCR COM_AXIS Epm_nEng EngN 16 0.00 6000.000 FORMAT "%8.3" EXTENDED_LIMITS -16384.00 16383.50 AXIS_PTS_REF InjCrv_qPoI2ETSCorRgnX_AXIS /end AXIS_DESCR
 /begin AXIS_DESCR COM_AXIS InjCtl_qSetUnBal InjMass 16 0.00 327.6700 FORMAT "%8.4" EXTENDED_LIMITS -327.6800 327.6700 AXIS_PTS_REF InjCrv_qPoI2ETSCorRgnY_AXIS /end AXIS_DESCR
/end CHARACTERISTIC
/begin CHARACTERISTIC InjCrv_qPoI2ETSCor1Rgn_GMAP "Basismengenkorrekturkennfeld abhängig von der Motortemperatur für die PoI2 für die Regenerationsstufe 2" MAP 0x800605B6 MapG_Ws16 10.00000 InjMass 0.00 10.00000 FORMAT "%8.5" EXTENDED_LIMITS -327.6800 327.6700
 /begin AXIS_DESCR COM_AXIS Epm_nEng EngN 16 0.00 6000.000 FORMAT "%8.3" EXTENDED_LIMITS -16384.00 16383.50 AXIS_PTS_REF InjCrv_qPoI2ETSCorRgnX_AXIS /end AXIS_DESCR
 /begin AXIS_DESCR COM_AXIS InjCtl_qSetUnBal InjMass 16 0.00 327.6700 FORMAT "%8.4" EXTENDED_LIMITS -327.6800 327.6700 AXIS_PTS_REF InjCrv_qPoI2ETSCorRgnY_AXIS /end AXIS_DESCR
/end CHARACTERISTIC
/begin AXIS_PTS InjCrv_qPoI2ETSCorRgnX_AXIS "" 0x800607B6 Epm_nEng Axis_Xs16 6000.000 EngN 16 0.00 6000.000 FORMAT "%8.3" EXTENDED_LIMITS -16384.00 16383.50 DEPOSIT ABSOLUTE /end AXIS_PTS
/begin AXIS_PTS InjCrv_qPoI2ETSCorRgnY_AXIS "" 0x800607D8 InjCtl_qSetUnBal Axis_Xs16 327.6700 InjMass 16 0.00 327.6700 FORMAT "%8.4" EXTENDED_LIMITS -327.6800 327.6700 DEPOSIT ABSOLUTE /end AXIS_PTS
/begin CHARACTERISTIC InjCrv_qPoI2ETSCor_MAP "motortemperaturabhängiges Mengenkorrekturkennfeld für PoI2" MAP 0x8005F234 Map_Xs16Ys16Ws16 10.00000 InjMass 0.00 10.00000 FORMAT "%8.5" EXTENDED_LIMITS -327.6800 327.6700
 /begin AXIS_DESCR STD_AXIS Epm_nEng EngN 7 0.00 6000.000 FORMAT "%8.3" EXTENDED_LIMITS -16384.00 16383.50 DEPOSIT ABSOLUTE /end AXIS_DESCR
 /begin AXIS_DESCR STD_AXIS InjCtl_qSetUnBal InjMass 6 0.00 327.6700 FORMAT "%8.4" EXTENDED_LIMITS -327.6800 327.6700 DEPOSIT ABSOLUTE /end AXIS_DESCR
/end CHARACTERISTIC
/begin CHARACTERISTIC InjCrv_qPoI2SetLim_C "Threshold injection quantity" VALUE 0x8005F12A Val_Ws16 327.6700 InjMassInj 0.00 327.6700 FORMAT "%8.4" EXTENDED_LIMITS -327.6800 327.6700 /end CHARACTERISTIC
/begin CHARACTERISTIC InjCrv_stPoI1AddRlsMsk_C "Sperrmaske für den Normalbetrieb der PoI1" VALUE 0x8005EE0C Val_Wu32 4294967295.00 OneToOne 0.00 4294967295.00 FORMAT "%13.2" /end CHARACTERISTIC
/begin CHARACTERISTIC InjCrv_stPoI1OvrRunRgnMsk_C "Maske zur Selektion der Regenerationsstufen, bei denen die PoI1 im Schub zeitlich begrenzt wird" VALUE 0x8005EE10 Val_Wu32 2147483647.00 OneToOne 0.00 2147483647.00 FORMAT "%13.2" EXTENDED_LIMITS 0.00 4294967295.00 /end CHARACTERISTIC
/begin CHARACTERISTIC InjCrv_stPoI1RgnMsk_CA "Bitmaske für die Freigabe der einzelnen Regenerationsstufen" VAL_BLK 0x8005EE14 ValA_Wu32 4294967295.00 OneToOne 0.00 4294967295.00 FORMAT "%13.2" NUMBER 2 /end CHARACTERISTIC
/begin CHARACTERISTIC InjCrv_stPoI1RgnRlsMsk_C "Freigabemaske für den Regenerationsbetrieb der PoI1" VALUE 0x8005EE1C Val_Wu32 4294967295.00 OneToOne 0.00 4294967295.00 FORMAT "%13.2" /end CHARACTERISTIC
/begin CHARACTERISTIC InjCrv_stPoI1RmpSel_CA "Matrix für die Faktorisierungskennlinien der Umschaltrampe für PoI1" MAP 0x8005EE20 Map_Xu8Yu8Wu8 255.0 OneToOne 0.00 255.0 FORMAT "%5.1"
 /begin AXIS_DESCR STD_AXIS InjCrv_stActValPoI1_mp OneToOne 3 0.00 2.000 FORMAT "%5.3" EXTENDED_LIMITS 0.00 255.0 DEPOSIT ABSOLUTE /end AXIS_DESCR
 /begin AXIS_DESCR STD_AXIS InjCrv_stDesValPoI1_mp OneToOne 3 0.00 2.000 FORMAT "%5.3" EXTENDED_LIMITS 0.00 255.0 DEPOSIT ABSOLUTE /end AXIS_DESCR
/end CHARACTERISTIC
/begin CHARACTERISTIC InjCrv_stPoI2AddRlsMsk_C "Sperrmaske für den Normalbetrieb der PoI2" VALUE 0x80062A84 Val_Wu32 4294967295.00 OneToOne 0.00 4294967295.00 FORMAT "%13.2" /end CHARACTERISTIC
/begin CHARACTERISTIC InjCrv_stPoI2AgAbsTDCMsk_C "Maske zum Vergleich mit dem Regenerationsstatus zur Umschaltung des Ansteuerbeginns absolut zum TDC" VALUE 0x8005F168 Val_Wu32 4294967295.00 OneToOne 0.00 4294967295.00 FORMAT "%13.2" /end CHARACTERISTIC
/begin CHARACTERISTIC InjCrv_stPoI2RgnMsk_CA "Bitmaske für die Freigabe der einzelnen Regenerationsstufen" VAL_BLK 0x80062A88 ValA_Wu32 4294967295.00 OneToOne 0.00 4294967295.00 FORMAT "%13.2" NUMBER 2 /end CHARACTERISTIC
/begin CHARACTERISTIC InjCrv_stPoI2RgnRlsMsk_C "Freigabemaske für den Regenerationsbetrieb der PoI2" VALUE 0x80062A90 Val_Wu32 4294967295.00 OneToOne 0.00 4294967295.00 FORMAT "%13.2" /end CHARACTERISTIC
/begin CHARACTERISTIC InjCrv_stPoI2RmpSel_CA "Matrix für die Faktorisierungskennlinien der Umschaltrampe für PoI2" MAP 0x80062A94 Map_Xu8Yu8Wu8 1.000 OneToOne 1.000 2.000 FORMAT "%5.3" EXTENDED_LIMITS 0.00 255.0
 /begin AXIS_DESCR STD_AXIS InjCrv_stActValPoI2_mp OneToOne 3 0.00 2.000 FORMAT "%5.3" EXTENDED_LIMITS 0.00 255.0 DEPOSIT ABSOLUTE /end AXIS_DESCR
 /begin AXIS_DESCR STD_AXIS InjCrv_stDesValPoI2_mp OneToOne 3 0.00 2.000 FORMAT "%5.3" EXTENDED_LIMITS 0.00 255.0 DEPOSIT ABSOLUTE /end AXIS_DESCR
/end CHARACTERISTIC
/begin CHARACTERISTIC InjCrv_swtPhiPiI2Des_C "Schalter des Fernsteuerwerts des Ansteuerbeginns (Winkelkomponente) der PiI2" VALUE 0x8005A958 Val_Wu8 1.000 OneToOne 0.00 1.000 FORMAT "%5.3" EXTENDED_LIMITS 0.00 255.0 /end CHARACTERISTIC
/begin CHARACTERISTIC InjCrv_swtPhiPiI3Des_C "Schalter des Fernsteuerwerts des Ansteuerwinkels der PiI3" VALUE 0x8005DDC8 Val_Wu8 1.000 OneToOne 0.00 1.000 FORMAT "%5.3" EXTENDED_LIMITS 0.00 255.0 /end CHARACTERISTIC
/begin CHARACTERISTIC InjCrv_swtPhiPoI1Des_C "Schalter des Fernsteuerwerts des Ansteuerwinkels der PoI1" VALUE 0x8005E410 Val_Wu8 1.000 OneToOne 0.00 1.000 FORMAT "%5.3" EXTENDED_LIMITS 0.00 255.0 /end CHARACTERISTIC
/begin CHARACTERISTIC InjCrv_swtPhiPoI2Des_C "Schalter des Fernsteuerwerts des Ansteuerbeginns (Winkelkomponente) der PoI2" VALUE 0x8005F12C Val_Wu8 1.000 OneToOne 0.00 1.000 FORMAT "%5.3" EXTENDED_LIMITS 0.00 255.0 /end CHARACTERISTIC
/begin CHARACTERISTIC InjCrv_swtPoI1Clsn_C "Auswahlschalter zur Behandlung der PoI1 im Kollisionsfall" VALUE 0x8005E411 Val_Wu8 255.0 OneToOne 0.00 255.0 FORMAT "%5.1" /end CHARACTERISTIC
/begin CHARACTERISTIC InjCrv_swtPoI2SOEReplNrm_C "" VALUE 0x80062994 Val_Wu8 255.0 OneToOne 0.00 255.0 FORMAT "%5.1" /end CHARACTERISTIC
/begin CHARACTERISTIC InjCrv_swtQntPiI2Des_C "Schalter des Fernsteuerwerts der Einspritzmenge der PiI2" VALUE 0x8005A959 Val_Wu8 1.000 OneToOne 0.00 1.000 FORMAT "%5.3" EXTENDED_LIMITS 0.00 255.0 /end CHARACTERISTIC
/begin CHARACTERISTIC InjCrv_swtQntPiI3Des_C "Schalter des Fernsteuerwerts der Einspritzmenge der PiI3" VALUE 0x8005DDC9 Val_Wu8 1.000 OneToOne 0.00 1.000 FORMAT "%5.3" EXTENDED_LIMITS 0.00 255.0 /end CHARACTERISTIC
/begin CHARACTERISTIC InjCrv_swtQntPoI1Des_C "Schalter des Fernsteuerwerts der Einspritzmenge der PoI1" VALUE 0x8005E412 Val_Wu8 1.000 OneToOne 0.00 1.000 FORMAT "%5.3" EXTENDED_LIMITS 0.00 255.0 /end CHARACTERISTIC
/begin CHARACTERISTIC InjCrv_swtQntPoI2Des_C "Schalter des Fernsteuerwerts der Gesamtmenge der PoI2" VALUE 0x8005F12D Val_Wu8 1.000 OneToOne 0.00 1.000 FORMAT "%5.3" EXTENDED_LIMITS 0.00 255.0 /end CHARACTERISTIC
/begin CHARACTERISTIC InjCrv_swtQntPoI2Eff_C "Schalter des Fernsteuerwerts der Moment bildenden Menge der PoI2" VALUE 0x8005F12E Val_Wu8 1.000 OneToOne 0.00 1.000 FORMAT "%5.3" EXTENDED_LIMITS 0.00 255.0 /end CHARACTERISTIC
/begin CHARACTERISTIC InjCrv_swtTiPiI2Des_C "Schalter des Fernsteuerwerts des Ansteuerbeginns (Zeitkomponente) der PiI2" VALUE 0x8005A95A Val_Wu8 1.000 OneToOne 0.00 1.000 FORMAT "%5.3" EXTENDED_LIMITS 0.00 255.0 /end CHARACTERISTIC
/begin CHARACTERISTIC InjCrv_swtTiPoI2Des_C "Schalter des Fernsteuerwerts des Ansteuerbeginns (Zeitkomponente) der PoI2" VALUE 0x8005F12F Val_Wu8 1.000 OneToOne 0.00 1.000 FORMAT "%5.3" EXTENDED_LIMITS 0.00 255.0 /end CHARACTERISTIC
/begin CHARACTERISTIC InjCrv_tiPiI1Bas1_MAP "Zeitkomponente Ansteuerbeginn Grundwertekennfeld PiI1 ohne Freigabe PiI2" MAP 0x8005A356 Map_Xs16Ys16Ws16 5000.00 InjTime_us 0.00 5000.00 FORMAT "%8.2" EXTENDED_LIMITS -13107.20 13106.80
 /begin AXIS_DESCR STD_AXIS Epm_nEng EngN 12 0.00 6000.000 FORMAT "%8.3" EXTENDED_LIMITS -16384.00 16383.50 DEPOSIT ABSOLUTE /end AXIS_DESCR
 /begin AXIS_DESCR STD_AXIS InjCtl_qSetUnBal InjMass 16 0.00 327.6700 FORMAT "%8.4" EXTENDED_LIMITS -327.6800 327.6700 DEPOSIT ABSOLUTE /end AXIS_DESCR
/end CHARACTERISTIC
/begin CHARACTERISTIC InjCrv_tiPiI1Bas2_MAP "Zeitkomponente Ansteuerbeginn Grundwertekennfeld PiI1 mit Freigabe PiI2" MAP 0x8005A512 Map_Xs16Ys16Ws16 5000.00 InjTime_us 0.00 5000.00 FORMAT "%8.2" EXTENDED_LIMITS -13107.20 13106.80
 /begin AXIS_DESCR STD_AXIS Epm_nEng EngN 10 0.00 6000.000 FORMAT "%8.3" EXTENDED_LIMITS -16384.00 16383.50 DEPOSIT ABSOLUTE /end AXIS_DESCR
 /begin AXIS_DESCR STD_AXIS InjCtl_qSetUnBal InjMass 12 0.00 327.6700 FORMAT "%8.4" EXTENDED_LIMITS -327.6800 327.6700 DEPOSIT ABSOLUTE /end AXIS_DESCR
/end CHARACTERISTIC
/begin CHARACTERISTIC InjCrv_tiPiI1Bas3_MAP "Zeitkomponente Ansteuerbeginn Grundwertekennfeld PiI1 mit Freigabe PiI3" MAP 0x8005A632 Map_Xs16Ys16Ws16 5000.00 InjTime_us 0.00 5000.00 FORMAT "%8.2" EXTENDED_LIMITS -13107.20 13106.80
 /begin AXIS_DESCR STD_AXIS Epm_nEng EngN 2 0.00 6000.000 FORMAT "%8.3" EXTENDED_LIMITS -16384.00 16383.50 DEPOSIT ABSOLUTE /end AXIS_DESCR
 /begin AXIS_DESCR STD_AXIS InjCtl_qSetUnBal InjMass 2 0.00 327.6700 FORMAT "%8.4" EXTENDED_LIMITS -327.6800 327.6700 DEPOSIT ABSOLUTE /end AXIS_DESCR
/end CHARACTERISTIC
/begin CHARACTERISTIC InjCrv_tiPiI1BasStrt_MAP "base map of PiI1 SOE time calculation, if PiI3 is active" MAP 0x8005A6EA Kf_Xs16_Ys16_Ws16 5000.00 InjTime_us 0.00 5000.00 FORMAT "%8.2" EXTENDED_LIMITS -13107.20 13106.80
 /begin AXIS_DESCR STD_AXIS Epm_nEng EngN 8 0.00 6000.000 FORMAT "%8.3" EXTENDED_LIMITS -16384.00 16383.50 DEPOSIT ABSOLUTE /end AXIS_DESCR
 /begin AXIS_DESCR STD_AXIS InjCtl_qSetUnBal InjMass 8 0.00 327.6700 FORMAT "%8.4" EXTENDED_LIMITS -327.6800 327.6700 DEPOSIT ABSOLUTE /end AXIS_DESCR
/end CHARACTERISTIC
/begin CHARACTERISTIC InjCrv_tiPiI2ATSCor0Rgn_GMAP "Ansauglufttemperaturabhängiger Basiswert für Ansteuerbeginnkorrekturzeit für die PiI2 für die Regenerationsstufe 1" MAP 0x8005BD5A MapG_Ws16 18000.00 InjTime_us -13000.00 5000.00 FORMAT "%8.2" EXTENDED_LIMITS -13107.20 13106.80
 /begin AXIS_DESCR COM_AXIS Epm_nEng EngN 16 -16384.00 16383.50 FORMAT "%8.2" AXIS_PTS_REF InjCrv_tiPiI2ATSCorRgnX_AXIS /end AXIS_DESCR
 /begin AXIS_DESCR COM_AXIS InjCtl_qSetUnBal InjMass 16 -327.6800 327.6700 FORMAT "%8.4" AXIS_PTS_REF InjCrv_tiPiI2ATSCorRgnY_AXIS /end AXIS_DESCR
/end CHARACTERISTIC
/begin CHARACTERISTIC InjCrv_tiPiI2ATSCor1Rgn_GMAP "Ansauglufttemperaturabhängiger Basiswert für Ansteuerbeginnkorrekturzeit für die PiI2 für die Regenerationsstufe 2" MAP 0x8005BF5A MapG_Ws16 18000.00 InjTime_us -13000.00 5000.00 FORMAT "%8.2" EXTENDED_LIMITS -13107.20 13106.80
 /begin AXIS_DESCR COM_AXIS Epm_nEng EngN 16 -16384.00 16383.50 FORMAT "%8.2" AXIS_PTS_REF InjCrv_tiPiI2ATSCorRgnX_AXIS /end AXIS_DESCR
 /begin AXIS_DESCR COM_AXIS InjCtl_qSetUnBal InjMass 16 -327.6800 327.6700 FORMAT "%8.4" AXIS_PTS_REF InjCrv_tiPiI2ATSCorRgnY_AXIS /end AXIS_DESCR
/end CHARACTERISTIC
/begin AXIS_PTS InjCrv_tiPiI2ATSCorRgnX_AXIS "Stützstellenverteilung für das Ansteuerbeginnkorrekturkennfeld InjCrv_tiPiI2ATSCor%Rgn_GMAP" 0x8005C15A Epm_nEng Axis_Xs16 32767.50 EngN 16 -16384.00 16383.50 FORMAT "%8.2" DEPOSIT ABSOLUTE /end AXIS_PTS
/begin AXIS_PTS InjCrv_tiPiI2ATSCorRgnY_AXIS "Stützstellenverteilung für das Ansteuerbeginnkorrekturkennfeld InjCrv_tiPiI2ATSCor%Rgn_GMAP" 0x8005C17C InjCtl_qSetUnBal Axis_Xs16 655.3500 InjMass 16 -327.6800 327.6700 FORMAT "%8.4" DEPOSIT ABSOLUTE /end AXIS_PTS
/begin CHARACTERISTIC InjCrv_tiPiI2ATSCor_MAP "ansauglufttemperaturabhängiges Korrekturgrundwertekennfeld für die Zeitkomponente des Ansteuerbeginns der PiI2" MAP 0x8005C7FE Map_Xs16Ys16Ws16 18000.00 InjTime_us -13000.00 5000.00 FORMAT "%8.2" EXTENDED_LIMITS -13107.20 13106.80
 /begin AXIS_DESCR STD_AXIS Epm_nEng EngN 16 0.00 6000.000 FORMAT "%8.3" EXTENDED_LIMITS -16384.00 16383.50 DEPOSIT ABSOLUTE /end AXIS_DESCR
 /begin AXIS_DESCR STD_AXIS InjCtl_qSetUnBal InjMass 8 0.00 327.6700 FORMAT "%8.4" EXTENDED_LIMITS -327.6800 327.6700 DEPOSIT ABSOLUTE /end AXIS_DESCR
/end CHARACTERISTIC
/begin CHARACTERISTIC InjCrv_tiPiI2Bas0Rgn_GMAP "Basiskennfeld für die Zeitkomponente des Ansteuerbeginns der PiI2 für die Regenerationsstufe 1" MAP 0x8005D1FE MapG_Ws16 18107.20 InjTime_us -13107.20 5000.00 FORMAT "%8.2" EXTENDED_LIMITS -13107.20 13106.80
 /begin AXIS_DESCR COM_AXIS Epm_nEng EngN 16 -16384.00 16383.50 FORMAT "%8.2" AXIS_PTS_REF InjCrv_tiPiI2BasRgnX_AXIS /end AXIS_DESCR
 /begin AXIS_DESCR COM_AXIS InjCtl_qSetUnBal InjMass 16 -327.6800 327.6700 FORMAT "%8.4" AXIS_PTS_REF InjCrv_tiPiI2BasRgnY_AXIS /end AXIS_DESCR
/end CHARACTERISTIC
/begin CHARACTERISTIC InjCrv_tiPiI2Bas1Rgn_GMAP "Basiskennfeld für die Zeitkomponente des Ansteuerbeginns der PiI2 für die Regenerationsstufe 2" MAP 0x8005D3FE MapG_Ws16 18107.20 InjTime_us -13107.20 5000.00 FORMAT "%8.2" EXTENDED_LIMITS -13107.20 13106.80
 /begin AXIS_DESCR COM_AXIS Epm_nEng EngN 16 -16384.00 16383.50 FORMAT "%8.2" AXIS_PTS_REF InjCrv_tiPiI2BasRgnX_AXIS /end AXIS_DESCR
 /begin AXIS_DESCR COM_AXIS InjCtl_qSetUnBal InjMass 16 -327.6800 327.6700 FORMAT "%8.4" AXIS_PTS_REF InjCrv_tiPiI2BasRgnY_AXIS /end AXIS_DESCR
/end CHARACTERISTIC
/begin AXIS_PTS InjCrv_tiPiI2BasRgnX_AXIS "Stützstellenverteilung für das Basisansteuerbeginnkennfeld InjCrv_tiPiI2Bas%Rgn_GMAP" 0x8005D5FE Epm_nEng Axis_Xs16 32767.50 EngN 16 -16384.00 16383.50 FORMAT "%8.2" DEPOSIT ABSOLUTE /end AXIS_PTS
/begin AXIS_PTS InjCrv_tiPiI2BasRgnY_AXIS "Stützstellenverteilung für das Basisansteuerbeginnkennfeld InjCrv_tiPiI2Bas%Rgn_GMAP" 0x8005D620 InjCtl_qSetUnBal Axis_Xs16 655.3500 InjMass 16 -327.6800 327.6700 FORMAT "%8.4" DEPOSIT ABSOLUTE /end AXIS_PTS
/begin CHARACTERISTIC InjCrv_tiPiI2BasStrt_MAP "base map of PiI2 SOE time-component calculation" MAP 0x8005D7E6 Kf_Xs16_Ys16_Ws16 5000.00 InjTime_us 0.00 5000.00 FORMAT "%8.2" EXTENDED_LIMITS -13107.20 13106.80
 /begin AXIS_DESCR STD_AXIS Epm_nEng EngN 2 0.00 6000.000 FORMAT "%8.3" EXTENDED_LIMITS -16384.00 16383.50 DEPOSIT ABSOLUTE /end AXIS_DESCR
 /begin AXIS_DESCR STD_AXIS InjCtl_qSetUnBal InjMass 2 0.00 327.6700 FORMAT "%8.4" EXTENDED_LIMITS -327.6800 327.6700 DEPOSIT ABSOLUTE /end AXIS_DESCR
/end CHARACTERISTIC
/begin CHARACTERISTIC InjCrv_tiPiI2Bas_MAP "Zeitkomponente Ansteuerbeginn Grundwertekennfeld PiI2" MAP 0x8005D6CA Map_Xs16Ys16Ws16 5000.00 InjTime_us 0.00 5000.00 FORMAT "%8.2" EXTENDED_LIMITS -13107.20 13106.80
 /begin AXIS_DESCR STD_AXIS Epm_nEng EngN 10 0.00 6000.000 FORMAT "%8.3" EXTENDED_LIMITS -16384.00 16383.50 DEPOSIT ABSOLUTE /end AXIS_DESCR
 /begin AXIS_DESCR STD_AXIS InjCtl_qSetUnBal InjMass 10 0.00 327.6700 FORMAT "%8.4" EXTENDED_LIMITS -327.6800 327.6700 DEPOSIT ABSOLUTE /end AXIS_DESCR
/end CHARACTERISTIC
/begin CHARACTERISTIC InjCrv_tiPiI2Des_C "Fernsteuerwert des Ansteuerbeginns (Zeitkomponente) der PiI2" VALUE 0x8005A95C Val_Ws16 5000.00 InjTime_us 0.00 5000.00 FORMAT "%8.2" EXTENDED_LIMITS -13107.20 13106.80 /end CHARACTERISTIC
/begin CHARACTERISTIC InjCrv_tiPiI2ETSCor0Rgn_GMAP "Motortemperaturabhängiger Basiswert für Ansteuerbeginnkorrekturzeit für die PiI2 für die Regenerationsstufe 1" MAP 0x8005C19E MapG_Ws16 18000.00 InjTime_us -13000.00 5000.00 FORMAT "%8.2" EXTENDED_LIMITS -13107.20 13106.80
 /begin AXIS_DESCR COM_AXIS Epm_nEng EngN 16 -16384.00 16383.50 FORMAT "%8.2" AXIS_PTS_REF InjCrv_tiPiI2ETSCorRgnX_AXIS /end AXIS_DESCR
 /begin AXIS_DESCR COM_AXIS InjCtl_qSetUnBal InjMass 16 -327.6800 327.6700 FORMAT "%8.4" AXIS_PTS_REF InjCrv_tiPiI2ETSCorRgnY_AXIS /end AXIS_DESCR
/end CHARACTERISTIC
/begin CHARACTERISTIC InjCrv_tiPiI2ETSCor1Rgn_GMAP "Motortemperaturabhängiger Basiswert für Ansteuerbeginnkorrekturzeit für die PiI2 für die Regenerationsstufe 2" MAP 0x8005C39E MapG_Ws16 18000.00 InjTime_us -13000.00 5000.00 FORMAT "%8.2" EXTENDED_LIMITS -13107.20 13106.80
 /begin AXIS_DESCR COM_AXIS Epm_nEng EngN 16 -16384.00 16383.50 FORMAT "%8.2" AXIS_PTS_REF InjCrv_tiPiI2ETSCorRgnX_AXIS /end AXIS_DESCR
 /begin AXIS_DESCR COM_AXIS InjCtl_qSetUnBal InjMass 16 -327.6800 327.6700 FORMAT "%8.4" AXIS_PTS_REF InjCrv_tiPiI2ETSCorRgnY_AXIS /end AXIS_DESCR
/end CHARACTERISTIC
/begin AXIS_PTS InjCrv_tiPiI2ETSCorRgnX_AXIS "Stützstellenverteilung für das Ansteuerbeginnkorrekturkennfeld InjCrv_tiPiI2ETSCor%Rgn_GMAP" 0x8005C59E Epm_nEng Axis_Xs16 32767.50 EngN 16 -16384.00 16383.50 FORMAT "%8.2" DEPOSIT ABSOLUTE /end AXIS_PTS
/begin AXIS_PTS InjCrv_tiPiI2ETSCorRgnY_AXIS "Stützstellenverteilung für das Ansteuerbeginnkorrekturkennfeld InjCrv_tiPiI2ETSCor%Rgn_GMAP" 0x8005C5C0 InjCtl_qSetUnBal Axis_Xs16 655.3500 InjMass 16 -327.6800 327.6700 FORMAT "%8.4" DEPOSIT ABSOLUTE /end AXIS_PTS
/begin CHARACTERISTIC InjCrv_tiPiI2ETSCorStrt_MAP "base correction map for time-component of SOE of PiI2" MAP 0x8005A9AE Kf_Xs16_Ys16_Ws16 18000.00 InjTime_us -13000.00 5000.00 FORMAT "%8.2" EXTENDED_LIMITS -13107.20 13106.80
 /begin AXIS_DESCR STD_AXIS Epm_nEng EngN 2 0.00 6000.000 FORMAT "%8.3" EXTENDED_LIMITS -16384.00 16383.50 DEPOSIT ABSOLUTE /end AXIS_DESCR
 /begin AXIS_DESCR STD_AXIS InjCtl_qSetUnBal InjMass 2 0.00 327.6700 FORMAT "%8.4" EXTENDED_LIMITS -327.6800 327.6700 DEPOSIT ABSOLUTE /end AXIS_DESCR
/end CHARACTERISTIC
/begin CHARACTERISTIC InjCrv_tiPiI2ETSCor_MAP "motortemperaturabhängiges Korrekturgrundwertekennfeld für die Zeitkomponente des Ansteuerbeginns der PiI2" MAP 0x8005C932 Map_Xs16Ys16Ws16 18000.00 InjTime_us -13000.00 5000.00 FORMAT "%8.2" EXTENDED_LIMITS -13107.20 13106.80
 /begin AXIS_DESCR STD_AXIS Epm_nEng EngN 16 0.00 6000.000 FORMAT "%8.3" EXTENDED_LIMITS -16384.00 16383.50 DEPOSIT ABSOLUTE /end AXIS_DESCR
 /begin AXIS_DESCR STD_AXIS InjCtl_qSetUnBal InjMass 16 0.00 327.6700 FORMAT "%8.4" EXTENDED_LIMITS -327.6800 327.6700 DEPOSIT ABSOLUTE /end AXIS_DESCR
/end CHARACTERISTIC
/begin CHARACTERISTIC InjCrv_tiPoI1OvrRunRgnDeb_C "Entprellzeit für die Reaktivierung der PoI1 bei Rückkehr aus dem Schub" VALUE 0x8005EE32 Val_Ws16 327.6700 Time_s 0.00 327.6700 FORMAT "%8.4" EXTENDED_LIMITS -327.6800 327.6700 /end CHARACTERISTIC
/begin CHARACTERISTIC InjCrv_tiPoI1OvrRunRgnMax_C "Maximalzeit der PoI1 im Schub" VALUE 0x8005EE34 Val_Ws32 21474836.4700 Time_s 0.00 21474836.4700 FORMAT "%13.4" EXTENDED_LIMITS -21474836.4800 21474836.4700 /end CHARACTERISTIC
/begin CHARACTERISTIC InjCrv_tiPoI2APSCor0Rgn_GMAP "Ansteuerbeginn zeit korrekturkennfeld abhängig von dem Umgebungsluftdruck für die PoI2 für die Regenerationsstufe 1" MAP 0x800607FA MapG_Ws16 18107.20 InjTime_us -13107.20 5000.00 FORMAT "%8.2" EXTENDED_LIMITS -13107.20 13106.80
 /begin AXIS_DESCR COM_AXIS Epm_nEng EngN 16 0.00 6000.000 FORMAT "%8.3" EXTENDED_LIMITS -16384.00 16383.50 AXIS_PTS_REF InjCrv_tiPoI2APSCorRgnX_AXIS /end AXIS_DESCR
 /begin AXIS_DESCR COM_AXIS InjCtl_qSetUnBal InjMass 16 0.00 327.6700 FORMAT "%8.4" EXTENDED_LIMITS -327.6800 327.6700 AXIS_PTS_REF InjCrv_tiPoI2APSCorRgnY_AXIS /end AXIS_DESCR
/end CHARACTERISTIC
/begin CHARACTERISTIC InjCrv_tiPoI2APSCor1Rgn_GMAP "Ansteuerbeginn zeit korrekturkennfeld abhängig von dem Umgebungsluftdruck für die PoI2 für die Regenerationsstufe 2" MAP 0x800609FA MapG_Ws16 18107.20 InjTime_us -13107.20 5000.00 FORMAT "%8.2" EXTENDED_LIMITS -13107.20 13106.80
 /begin AXIS_DESCR COM_AXIS Epm_nEng EngN 16 0.00 6000.000 FORMAT "%8.3" EXTENDED_LIMITS -16384.00 16383.50 AXIS_PTS_REF InjCrv_tiPoI2APSCorRgnX_AXIS /end AXIS_DESCR
 /begin AXIS_DESCR COM_AXIS InjCtl_qSetUnBal InjMass 16 0.00 327.6700 FORMAT "%8.4" EXTENDED_LIMITS -327.6800 327.6700 AXIS_PTS_REF InjCrv_tiPoI2APSCorRgnY_AXIS /end AXIS_DESCR
/end CHARACTERISTIC
/begin AXIS_PTS InjCrv_tiPoI2APSCorRgnX_AXIS "" 0x80060BFA Epm_nEng Axis_Xs16 6000.000 EngN 16 0.00 6000.000 FORMAT "%8.3" EXTENDED_LIMITS -16384.00 16383.50 DEPOSIT ABSOLUTE /end AXIS_PTS
/begin AXIS_PTS InjCrv_tiPoI2APSCorRgnY_AXIS "" 0x80060C1C InjCtl_qSetUnBal Axis_Xs16 327.6700 InjMass 16 0.00 327.6700 FORMAT "%8.4" EXTENDED_LIMITS -327.6800 327.6700 DEPOSIT ABSOLUTE /end AXIS_PTS
/begin CHARACTERISTIC InjCrv_tiPoI2ATSCor_MAP "Ansauglufttemperaturabhängiger Korrekturgrundwert für die Zeitkomponente des Ansteuerbeginns der PoI2" MAP 0x8006131C Map_Xs16Ys16Ws16 18000.00 InjTime_us -13000.00 5000.00 FORMAT "%8.2" EXTENDED_LIMITS -13107.20 13106.80
 /begin AXIS_DESCR STD_AXIS Epm_nEng EngN 12 0.00 6000.000 FORMAT "%8.3" EXTENDED_LIMITS -16384.00 16383.50 DEPOSIT ABSOLUTE /end AXIS_DESCR
 /begin AXIS_DESCR STD_AXIS InjCtl_qSetUnBal InjMass 8 0.00 327.6700 FORMAT "%8.4" EXTENDED_LIMITS -327.6800 327.6700 DEPOSIT ABSOLUTE /end AXIS_DESCR
/end CHARACTERISTIC
/begin CHARACTERISTIC InjCrv_tiPoI2Bas0Rgn_GMAP "Gruppenkennfeld für den Zeit des Ansteuerbeginns für die PoI2 für die Regenerationsstufe 1" MAP 0x80062236 MapG_Ws16 18000.00 InjTime_us -13000.00 5000.00 FORMAT "%8.2" EXTENDED_LIMITS -13107.20 13106.80
 /begin AXIS_DESCR COM_AXIS Epm_nEng EngN 16 0.00 6000.000 FORMAT "%8.3" EXTENDED_LIMITS -16384.00 16383.50 AXIS_PTS_REF InjCrv_tiPoI2BasRgnX_AXIS /end AXIS_DESCR
 /begin AXIS_DESCR COM_AXIS InjCtl_qSetUnBal InjMass 16 0.00 327.6700 FORMAT "%8.4" EXTENDED_LIMITS -327.6800 327.6700 AXIS_PTS_REF InjCrv_tiPoI2BasRgnY_AXIS /end AXIS_DESCR
/end CHARACTERISTIC
/begin CHARACTERISTIC InjCrv_tiPoI2Bas1Rgn_GMAP "Gruppenkennfeld für den Zeit des Ansteuerbeginns für die PoI2 für die Regenerationsstufe 2" MAP 0x80062436 MapG_Ws16 18000.00 InjTime_us -13000.00 5000.00 FORMAT "%8.2" EXTENDED_LIMITS -13107.20 13106.80
 /begin AXIS_DESCR COM_AXIS Epm_nEng EngN 16 0.00 6000.000 FORMAT "%8.3" EXTENDED_LIMITS -16384.00 16383.50 AXIS_PTS_REF InjCrv_tiPoI2BasRgnX_AXIS /end AXIS_DESCR
 /begin AXIS_DESCR COM_AXIS InjCtl_qSetUnBal InjMass 16 0.00 327.6700 FORMAT "%8.4" EXTENDED_LIMITS -327.6800 327.6700 AXIS_PTS_REF InjCrv_tiPoI2BasRgnY_AXIS /end AXIS_DESCR
/end CHARACTERISTIC
/begin AXIS_PTS InjCrv_tiPoI2BasRgnX_AXIS "" 0x80062636 Epm_nEng Axis_Xs16 6000.000 EngN 16 0.00 6000.000 FORMAT "%8.3" EXTENDED_LIMITS -16384.00 16383.50 DEPOSIT ABSOLUTE /end AXIS_PTS
/begin AXIS_PTS InjCrv_tiPoI2BasRgnY_AXIS "" 0x80062658 InjCtl_qSetUnBal Axis_Xs16 327.6700 InjMass 16 0.00 327.6700 FORMAT "%8.4" EXTENDED_LIMITS -327.6800 327.6700 DEPOSIT ABSOLUTE /end AXIS_PTS
/begin CHARACTERISTIC InjCrv_tiPoI2Bas_MAP "Zeitkomponente Ansteuerbeginn Grundwert PoI2" MAP 0x80062AA8 Map_Xs16Ys16Ws16 18000.00 InjTime_us -13000.00 5000.00 FORMAT "%8.2" EXTENDED_LIMITS -13107.20 13106.80
 /begin AXIS_DESCR STD_AXIS Epm_nEng EngN 10 0.00 6000.000 FORMAT "%8.3" EXTENDED_LIMITS -16384.00 16383.50 DEPOSIT ABSOLUTE /end AXIS_DESCR
 /begin AXIS_DESCR STD_AXIS InjCtl_qSetUnBal InjMass 10 0.00 327.6700 FORMAT "%8.4" EXTENDED_LIMITS -327.6800 327.6700 DEPOSIT ABSOLUTE /end AXIS_DESCR
/end CHARACTERISTIC
/begin CHARACTERISTIC InjCrv_tiPoI2Des_C "Fernsteuerwert des Ansteuerbeginns (Zeitkomponente) der PoI2" VALUE 0x8005F130 Val_Ws16 15000.00 InjTime_us -10000.00 5000.00 FORMAT "%8.2" EXTENDED_LIMITS -13107.20 13106.80 /end CHARACTERISTIC
/begin CHARACTERISTIC InjCrv_tiPoI2ETSCor0Rgn_GMAP "Ansteuerbeginn zeit korrekturkennfeld abhängig von der Motortemperatur für die PoI2 für die Regenerationsstufe 1" MAP 0x80060C3E MapG_Ws16 18107.20 InjTime_us -13107.20 5000.00 FORMAT "%8.2" EXTENDED_LIMITS -13107.20 13106.80
 /begin AXIS_DESCR COM_AXIS Epm_nEng EngN 16 0.00 6000.000 FORMAT "%8.3" EXTENDED_LIMITS -16384.00 16383.50 AXIS_PTS_REF InjCrv_tiPoI2ETSCorRgnX_AXIS /end AXIS_DESCR
 /begin AXIS_DESCR COM_AXIS InjCtl_qSetUnBal InjMass 16 0.00 327.6700 FORMAT "%8.4" EXTENDED_LIMITS -327.6800 327.6700 AXIS_PTS_REF InjCrv_tiPoI2ETSCorRgnY_AXIS /end AXIS_DESCR
/end CHARACTERISTIC
/begin CHARACTERISTIC InjCrv_tiPoI2ETSCor1Rgn_GMAP "Ansteuerbeginn zeit korrekturkennfeld abhängig von der Motortemperatur für die PoI2 für die Regenerationsstufe 2" MAP 0x80060E3E MapG_Ws16 18107.20 InjTime_us -13107.20 5000.00 FORMAT "%8.2" EXTENDED_LIMITS -13107.20 13106.80
 /begin AXIS_DESCR COM_AXIS Epm_nEng EngN 16 0.00 6000.000 FORMAT "%8.3" EXTENDED_LIMITS -16384.00 16383.50 AXIS_PTS_REF InjCrv_tiPoI2ETSCorRgnX_AXIS /end AXIS_DESCR
 /begin AXIS_DESCR COM_AXIS InjCtl_qSetUnBal InjMass 16 0.00 327.6700 FORMAT "%8.4" EXTENDED_LIMITS -327.6800 327.6700 AXIS_PTS_REF InjCrv_tiPoI2ETSCorRgnY_AXIS /end AXIS_DESCR
/end CHARACTERISTIC
/begin AXIS_PTS InjCrv_tiPoI2ETSCorRgnX_AXIS "" 0x8006103E Epm_nEng Axis_Xs16 6000.000 EngN 16 0.00 6000.000 FORMAT "%8.3" EXTENDED_LIMITS -16384.00 16383.50 DEPOSIT ABSOLUTE /end AXIS_PTS
/begin AXIS_PTS InjCrv_tiPoI2ETSCorRgnY_AXIS "" 0x80061060 InjCtl_qSetUnBal Axis_Xs16 327.6700 InjMass 16 0.00 327.6700 FORMAT "%8.4" EXTENDED_LIMITS -327.6800 327.6700 DEPOSIT ABSOLUTE /end AXIS_PTS
/begin CHARACTERISTIC InjCrv_tiPoI2ETSCor_MAP "motortemperaturabhängiges Korrekturgrundwertekennfeld für die Zeitkomponente des Ansteuerbeginns der PoI2" MAP 0x80061408 Map_Xs16Ys16Ws16 18000.00 InjTime_us -13000.00 5000.00 FORMAT "%8.2" EXTENDED_LIMITS -13107.20 13106.80
 /begin AXIS_DESCR STD_AXIS Epm_nEng EngN 12 0.00 6000.000 FORMAT "%8.3" EXTENDED_LIMITS -16384.00 16383.50 DEPOSIT ABSOLUTE /end AXIS_DESCR
 /begin AXIS_DESCR STD_AXIS InjCtl_qSetUnBal InjMass 8 0.00 327.6700 FORMAT "%8.4" EXTENDED_LIMITS -327.6800 327.6700 DEPOSIT ABSOLUTE /end AXIS_DESCR
/end CHARACTERISTIC
/begin CHARACTERISTIC InjCrv_tiPoI2Max_MAP "maximaler Ansteuerbeginn PoI2 relativ zur Haupteinspritzung" MAP 0x8005F132 Map_Xs16Ys16Ws16 18000.00 InjTime_us -13000.00 5000.00 FORMAT "%8.2" EXTENDED_LIMITS -13107.20 13106.80
 /begin AXIS_DESCR STD_AXIS RailP_pFlt Pres_Rail 4 0.00 2000.000 FORMAT "%5.3" EXTENDED_LIMITS -3276.800 3276.700 DEPOSIT ABSOLUTE /end AXIS_DESCR
 /begin AXIS_DESCR STD_AXIS InjCrv_qMI1Des InjMass 4 0.00 327.6700 FORMAT "%8.4" EXTENDED_LIMITS -327.6800 327.6700 DEPOSIT ABSOLUTE /end AXIS_DESCR
/end CHARACTERISTIC
/begin CHARACTERISTIC InjCrv_tiPoI2Min_C "physikalisch bedingter minimaler Ansteuerbeginn PoI2" VALUE 0x8005F166 Val_Ws16 18000.00 InjTime_us -13000.00 5000.00 FORMAT "%8.2" EXTENDED_LIMITS -13107.20 13106.80 /end CHARACTERISTIC
/begin MEASUREMENT InjCrv_facPiI2APSQCor "atmosphärendruckabhängiger Mengenkorrekturfaktor für PiI2" SWORD Fact 1 100 -4.000000 3.999878 FORMAT "%8.6" ECU_ADDRESS 0xD0007136 /end MEASUREMENT
/begin MEASUREMENT InjCrv_facPiI2APSQCorRgn "Atmosphärendruckabhängiger Mengenkorrekturfaktor für Voreinspritzung 2 im Regenerationsbetrieb" SWORD Fact 1 100 -4.000000 3.999878 FORMAT "%8.6" ARRAY_SIZE 2 ECU_ADDRESS 0xD0007138 /end MEASUREMENT
/begin MEASUREMENT InjCrv_facPiI2APSQCorStrt "atmospheric pressure dependent correction factor for quantity PiI2" SWORD Fact 1 100 -4.000000 3.999878 FORMAT "%8.6" ECU_ADDRESS 0xD000713C /end MEASUREMENT
/begin MEASUREMENT InjCrv_facPiI2ATSQCor "ansauglufttemperaturabhängiger Mengenkorrekturfaktor für PiI2" SWORD Fact 1 100 -4.000000 3.999878 FORMAT "%8.6" ECU_ADDRESS 0xD000713E /end MEASUREMENT
/begin MEASUREMENT InjCrv_facPiI2ATSQCorRgn "Ansauglufttemperaturabhängiger Mengenkorrekturfaktor für Voreinspritzung 2 im Regenerationsbetrieb" SWORD Fact 1 100 -4.000000 3.999878 FORMAT "%8.6" ARRAY_SIZE 2 ECU_ADDRESS 0xD0007140 /end MEASUREMENT
/begin MEASUREMENT InjCrv_facPiI2ATSQCorStrt "intake air temperature dependent correction factor for quantity PiI2" SWORD Fact 1 100 -4.000000 3.999878 FORMAT "%8.6" ECU_ADDRESS 0xD0007144 /end MEASUREMENT
/begin MEASUREMENT InjCrv_facPiI2ATSSOECor "Ansauglufttemperaturspezifischer Gewichtungsfaktor für PiI2" SWORD Fact 1 100 -4.000000 3.999878 FORMAT "%8.6" ECU_ADDRESS 0xD0007146 /end MEASUREMENT
/begin MEASUREMENT InjCrv_facPiI2ATSSOECorRgn "Ansauglufttemperaturabhängiger Ansteuerbeginnkorrekturfaktor für Voreinspritzung 2 im Regenerationsbetrieb" SWORD Fact 1 100 -4.000000 3.999878 FORMAT "%8.6" ARRAY_SIZE 2 ECU_ADDRESS 0xD0007148 /end MEASUREMENT
/begin MEASUREMENT InjCrv_facPiI2ETSQCor "motortemperaturabhängiger Mengenkorrekturfaktor für PiI2" SWORD Fact 1 100 -4.000000 3.999878 FORMAT "%8.6" ECU_ADDRESS 0xD000714C /end MEASUREMENT
/begin MEASUREMENT InjCrv_facPiI2ETSQCorRgn "Motortemperaturabhängiger Mengenkorrekturfaktor für Voreinspritzung 2 im Regenerationsbetrieb" SWORD Fact 1 100 -4.000000 3.999878 FORMAT "%8.6" ARRAY_SIZE 2 ECU_ADDRESS 0xD000714E /end MEASUREMENT
/begin MEASUREMENT InjCrv_facPiI2ETSQCorStrt "atmospheric pressure dependent correction factor for quantity PiI2" SWORD Fact 1 100 -4.000000 3.999878 FORMAT "%8.6" ECU_ADDRESS 0xD0007152 /end MEASUREMENT
/begin MEASUREMENT InjCrv_facPiI2ETSSOECor "motortemperaturabhängiger Ansteuerbeginnkorrekturfaktor für PiI2" SWORD Fact 1 100 -4.000000 3.999878 FORMAT "%8.6" ECU_ADDRESS 0xD0007154 /end MEASUREMENT
/begin MEASUREMENT InjCrv_facPiI2ETSSOECorRgn "motortemperaturabhängiger Ansteuerbeginnkorrekturfaktor für Voreinspritzung 2 im Regenerationsbetrieb" SWORD Fact 1 100 -4.000000 3.999878 FORMAT "%8.6" ARRAY_SIZE 2 ECU_ADDRESS 0xD0007156 /end MEASUREMENT
/begin MEASUREMENT InjCrv_facPiI2ETSSOECorStrt "engine temperature dependent correction factor for PiI2-SOE" SWORD Fact 1 100 -4.000000 3.999878 FORMAT "%8.6" ECU_ADDRESS 0xD000715A /end MEASUREMENT
/begin MEASUREMENT InjCrv_facPiI2QntMin_mp "Wichtungsfaktor zum Abschalten der Berechnung Voreinspritzung 2" SWORD Fact1 1 100 -256.0000 255.9922 FORMAT "%8.4" ECU_ADDRESS 0xC0000D92 /end MEASUREMENT
/begin MEASUREMENT InjCrv_facPiI2QntRmpVal_mp "Interpolationsfaktor für die Funktion InjCrv_PiI2RgnSwtQnt" SWORD CoEOMSwt_S16 1 100 -2.000000 1.999939 FORMAT "%8.6" ECU_ADDRESS 0xC0000DF8 /end MEASUREMENT
/begin MEASUREMENT InjCrv_facPiI2SOERmpVal_mp "Interpolationsfaktor für die Funktion InjCrv_PiI2RgnSwtSOE" SWORD CoEOMSwt_S16 1 100 -2.000000 1.999939 FORMAT "%8.6" ECU_ADDRESS 0xC0000DFA /end MEASUREMENT
/begin MEASUREMENT InjCrv_facPiI3APSQCor "atmosphärendruckabhängiger Mengenkorrekturfaktor für PiI3" SWORD Fact 1 100 -4.000000 3.999878 FORMAT "%8.6" ECU_ADDRESS 0xD000715C /end MEASUREMENT
/begin MEASUREMENT InjCrv_facPiI3ATSQCor "ansauglufttemperaturabhängiger Mengenkorrekturfaktor der PiI3" SWORD Fact 1 100 -4.000000 3.999878 FORMAT "%8.6" ECU_ADDRESS 0xD000715E /end MEASUREMENT
/begin MEASUREMENT InjCrv_facPiI3ETSQCor "motortemperaturabhängiger Mengenkorrekturfaktor der PiI3" SWORD Fact 1 100 -4.000000 3.999878 FORMAT "%8.6" ECU_ADDRESS 0xD0007160 /end MEASUREMENT
/begin MEASUREMENT InjCrv_facPiI3ETSSOECor "motortemperaturabhängiger Ansteuerbeginnkorrekturfaktor der PiI3" SWORD Fact 1 100 -4.000000 3.999878 FORMAT "%8.6" ECU_ADDRESS 0xD0007162 /end MEASUREMENT
/begin MEASUREMENT InjCrv_facPiI3QntMin_mp "Gewichtungsfaktor zum Abschalten der Berechnung Voreinspritzung 1 bei Unterschreitung der Mindestmenge" SWORD Fact1 1 100 -256.0000 255.9922 FORMAT "%8.4" ECU_ADDRESS 0xC0000E06 /end MEASUREMENT
/begin MEASUREMENT InjCrv_facPoI1APSQCor "Atmosphärendruckabhängiger Mengenkorrekturfaktor für PoI1" SWORD Fact 1 100 -4.000000 3.999878 FORMAT "%8.6" ECU_ADDRESS 0xD0007164 /end MEASUREMENT
/begin MEASUREMENT InjCrv_facPoI1ETSPhiCor "Motortemperaturabhängiger Winkelkorrekturfaktor für PoI1" SWORD Fact 1 100 -4.000000 3.999878 FORMAT "%8.6" ECU_ADDRESS 0xD0007166 /end MEASUREMENT
/begin MEASUREMENT InjCrv_facPoI1ETSQCor "Motortemperaturabhängiger Mengenkorrekturfaktor für PoI1" SWORD Fact 1 100 -4.000000 3.999878 FORMAT "%8.6" ECU_ADDRESS 0xD0007168 /end MEASUREMENT
/begin MEASUREMENT InjCrv_facPoI1QntRmpVal_mp "Interpolationsfaktor für die Funktion InjCrv_PoI1RgnSwtQ" SWORD CoEOMSwt_S16 1 100 -2.000000 1.999939 FORMAT "%8.6" ECU_ADDRESS 0xC0000E7A /end MEASUREMENT
/begin MEASUREMENT InjCrv_facPoI1SOERmpVal_mp "Interpolationsfaktor für die Funktion InjCrv_PoI1RgnSWtSOE" SWORD CoEOMSwt_S16 1 100 -2.000000 1.999939 FORMAT "%8.6" ECU_ADDRESS 0xC0000E7C /end MEASUREMENT
/begin MEASUREMENT InjCrv_facPoI2AddCorRgn "additiver Korrekturwert für den Ansteuerbeginn der PoI2 im Regenerationsbetrieb" SWORD Fact 1 100 -4.000000 3.999878 FORMAT "%8.6" ECU_ADDRESS 0xD000717E /end MEASUREMENT
/begin MEASUREMENT InjCrv_facPoI2AngRmpVal_mp "Interpolationsfaktor für die Funktion InjCrv_PoI2RgnSwtSOE (Winkelkomponent)" SWORD CoEOMSwt_S16 1 100 -2.000000 1.999939 FORMAT "%8.6" ECU_ADDRESS 0xC0000F16 /end MEASUREMENT
/begin MEASUREMENT InjCrv_facPoI2APSQCorRgn "atmosphärendruckabhängiger Korrekturfaktor für die PoI2 im Regenerationsbetrieb" SWORD Fact 1 100 -4.000000 3.999878 FORMAT "%8.6" ARRAY_SIZE 2 ECU_ADDRESS 0xD000716A /end MEASUREMENT
/begin MEASUREMENT InjCrv_facPoI2APSSOECorRgn "atmosphärendruckabhängiger Winkelkorrekturfaktoren für PoI2 im Regenerationsbetrieb" SWORD Fact 1 100 -4.000000 3.999878 FORMAT "%8.6" ARRAY_SIZE 2 ECU_ADDRESS 0xD000716E /end MEASUREMENT
/begin MEASUREMENT InjCrv_facPoI2APSTICorRgn "atmosphärendruckabhängiger Ansteuerbeginn zeit korrektur faktoren für PoI2 im Regenerationsbetrieb" SWORD Fact 1 100 -4.000000 3.999878 FORMAT "%8.6" ARRAY_SIZE 2 ECU_ADDRESS 0xD0007172 /end MEASUREMENT
/begin MEASUREMENT InjCrv_facPoI2ATSQCor "ansauglufttemperaturabhängiger Mengenkorrekturfaktor für PoI2" SWORD Fact 1 100 -4.000000 3.999878 FORMAT "%8.6" ECU_ADDRESS 0xD0007176 /end MEASUREMENT
/begin MEASUREMENT InjCrv_facPoI2ATSQCorRgn "ansauglufttemperaturabhängiger Mengenkorrekturfaktor für den Regenerationsbetrieb für die PoI2" SWORD Fact 1 100 -4.000000 3.999878 FORMAT "%8.6" ARRAY_SIZE 2 ECU_ADDRESS 0xD0007178 /end MEASUREMENT
/begin MEASUREMENT InjCrv_facPoI2ATSSOECor "ansauglufttemperaturabhängiger Ansteuerbeginnkorrekturfaktor für PoI2" SWORD Fact 1 100 -4.000000 3.999878 FORMAT "%8.6" ECU_ADDRESS 0xD000717C /end MEASUREMENT
/begin MEASUREMENT InjCrv_facPoI2EffRgn "Faktor für den drehmomentbildenden Anteil der Einspritzmenge PoI2 im Regenerationsmodus" SWORD Fact 1 100 -4.000000 3.999878 FORMAT "%8.6" ECU_ADDRESS 0xD0007190 /end MEASUREMENT
/begin MEASUREMENT InjCrv_facPoI2EffSet_mp "Faktor für den drehmomentbildenden Anteil der Einspritzmenge PoI2 (Sollwert)" SWORD Fact 1 100 -4.000000 3.999878 FORMAT "%8.6" ECU_ADDRESS 0xC0000E8C /end MEASUREMENT
/begin MEASUREMENT InjCrv_facPoI2Eff_mp "Faktor für Drehmoment bildenden Anteil der Einspritzmenge PoI2" SWORD Fact 1 100 -4.000000 3.999878 FORMAT "%8.6" ECU_ADDRESS 0xC0000E8E /end MEASUREMENT
/begin MEASUREMENT InjCrv_facPoI2ETSQCor "motortemperaturabhängiger Mengenkorrekturfaktor für PoI2" SWORD Fact 1 100 -4.000000 3.999878 FORMAT "%8.6" ECU_ADDRESS 0xD0007180 /end MEASUREMENT
/begin MEASUREMENT InjCrv_facPoI2ETSQCorRgn "motortemperaturabhängiger Mengenkorrekturfaktor für den Regenerationsbetrieb für die PoI2" SWORD Fact 1 100 -4.000000 3.999878 FORMAT "%8.6" ARRAY_SIZE 2 ECU_ADDRESS 0xD0007182 /end MEASUREMENT
/begin MEASUREMENT InjCrv_facPoI2ETSSOECor "motortemperaturabhängiger Ansteuerbeginnkorrekturfaktor für PoI2" SWORD Fact 1 100 -4.000000 3.999878 FORMAT "%8.6" ECU_ADDRESS 0xD0007186 /end MEASUREMENT
/begin MEASUREMENT InjCrv_facPoI2ETSSOECorRgn "motortemperaturabhängiger Ansteuerbeginnkorrekturfaktor für den Regenerationsbetrieb für die PoI2" SWORD Fact 1 100 -4.000000 3.999878 FORMAT "%8.6" ARRAY_SIZE 2 ECU_ADDRESS 0xD0007188 /end MEASUREMENT
/begin MEASUREMENT InjCrv_facPoI2ETSTICorRgn "motortemperaturabhängiger Ansteuerbeginn zeit korrektur faktoren für PoI2 im Regenerationsbetrieb" SWORD Fact 1 100 -4.000000 3.999878 FORMAT "%8.6" ARRAY_SIZE 2 ECU_ADDRESS 0xD000718C /end MEASUREMENT
/begin MEASUREMENT InjCrv_facPoI2QntRmpVal_mp "Interpolationsfaktor für die Funktion InjCrv_PoI2RgnSwtQ" SWORD CoEOMSwt_S16 1 100 -2.000000 1.999939 FORMAT "%8.6" ECU_ADDRESS 0xC0000F18 /end MEASUREMENT
/begin MEASUREMENT InjCrv_facPoI2SOEtiRmpVal_mp "Interpolationsfaktor für die Funktion InjCrv_PoI2RgnSwtSOE" SWORD CoEOMSwt_S16 1 100 -2.000000 1.999939 FORMAT "%8.6" ECU_ADDRESS 0xC0000F1E /end MEASUREMENT
/begin MEASUREMENT InjCrv_facPoI2TiRmpVal_mp "Interpolationsfaktor für die Funktion InjCrv_PoI2RgnSwtSOE (Zeitkomponent)" SWORD CoEOMSwt_S16 1 100 -2.000000 1.999939 FORMAT "%8.6" ECU_ADDRESS 0xC0000F1A /end MEASUREMENT
/begin MEASUREMENT InjCrv_facPOpPoI2ETSCor "Motortemperaturabhängiger Freigabekorrekturfaktor für PoI2" SWORD Fact 1 100 -4.000000 3.999878 FORMAT "%8.6" ECU_ADDRESS 0xD00070E4 /end MEASUREMENT
/begin MEASUREMENT InjCrv_phiDynOfs_mp "Winkelvorhalt für schnelle dynamische Vorgänge" SWORD AngleCrS 1 100 -720.0220 720.0000 FORMAT "%8.4" ECU_ADDRESS 0xC0000E2C /end MEASUREMENT
/begin MEASUREMENT InjCrv_phiNxtCylBnk_mp "Winkel zw. aktuellem OT und OT des nächsten Zylinders auf derselben Bank" SWORD AngleCrS 1 100 -720.0220 720.0000 FORMAT "%8.4" ECU_ADDRESS 0xC0000E2E /end MEASUREMENT
/begin MEASUREMENT InjCrv_phiNxtCyl_mp "Winkel zwischen aktuellem OT und der frühesten Einspritzung des nächsten Zylinders auf derselben Bank" SWORD AngleCrS 1 100 -720.0220 720.0000 FORMAT "%8.4" ECU_ADDRESS 0xC0000E30 /end MEASUREMENT
/begin MEASUREMENT InjCrv_phiPiI2AbsTot_mp "absoluter Ansteuerbeginn PiI2 aus Winkel- und Zeitkomponente" SWORD AngleCrS 1 100 -720.0220 720.0000 FORMAT "%8.4" ECU_ADDRESS 0xC0000D94 /end MEASUREMENT
/begin MEASUREMENT InjCrv_phiPiI2Abs_mp "absolute Winkelkomponente Ansteuerbeginn PiI2" SWORD AngleCrS 1 100 -720.0220 720.0000 FORMAT "%8.4" ECU_ADDRESS 0xC0000D96 /end MEASUREMENT
/begin MEASUREMENT InjCrv_phiPiI2AddCor "kundenspezifischer Korrekturwinkel für PiI2" SWORD AngleCrS 1 100 -720.0220 720.0000 FORMAT "%8.4" ECU_ADDRESS 0xD00071B8 /end MEASUREMENT
/begin MEASUREMENT InjCrv_phiPiI2AddCorStrt "PII2 SOE Winkelkorrektur während des Motor start state" SWORD AngleCrS 1 100 -720.0220 720.0000 FORMAT "%8.4" ECU_ADDRESS 0xD00071BA /end MEASUREMENT
/begin MEASUREMENT InjCrv_phiPiI2ATSCor_mp "ansauglufttemperaturabhängiger Korrekturgrundwert für die Winkelkomponente des Ansteuerbeginns der PiI2" SWORD AngleCrS 1 100 -720.0220 720.0000 FORMAT "%8.4" ECU_ADDRESS 0xC0000DCA /end MEASUREMENT
/begin MEASUREMENT InjCrv_phiPiI2BasStrt_mp "SOE Winkels Korrektur für PII2 während des Motor Start State" SWORD AngleCrS 1 100 -720.0220 720.0000 FORMAT "%8.4" ECU_ADDRESS 0xC0000E00 /end MEASUREMENT
/begin MEASUREMENT InjCrv_phiPiI2Bas_mp "Winkelkomponente Ansteuerbeginn PiI2 Grundwert" SWORD AngleCrS 1 100 -720.0220 720.0000 FORMAT "%8.4" ECU_ADDRESS 0xC0000DFC /end MEASUREMENT
/begin MEASUREMENT InjCrv_phiPiI2Cor_mp "korrigierter Grundwert Winkelkomponente Ansteuerbeginn PiI2" SWORD AngleCrS 1 100 -720.0220 720.0000 FORMAT "%8.4" ECU_ADDRESS 0xC0000D98 /end MEASUREMENT
/begin MEASUREMENT InjCrv_phiPiI2EnvCor "Korrekturwinkel für Voreinspritzung 2" SWORD AngleCrS 1 100 -720.0220 720.0000 FORMAT "%8.4" ECU_ADDRESS 0xD00071BE /end MEASUREMENT
/begin MEASUREMENT InjCrv_phiPiI2ETSCorStrt_mp "Motor Temperaturabhängiger PII2 SOE Winkel korrektur während des Motor start state" SWORD AngleCrS 1 100 -720.0220 720.0000 FORMAT "%8.4" ECU_ADDRESS 0xC0000DBA /end MEASUREMENT
/begin MEASUREMENT InjCrv_phiPiI2ETSCor_mp "motortemperaturabhängiger Korrekturgrundwert für die Winkelkomponente des Ansteuerbeginns der PiI2" SWORD AngleCrS 1 100 -720.0220 720.0000 FORMAT "%8.4" ECU_ADDRESS 0xC0000DCC /end MEASUREMENT
/begin MEASUREMENT InjCrv_phiPiI2Rel_mp "Winkelkomponente Ansteuerbeginn PiI2 relativ zur MI" SWORD AngleCrS 1 100 -720.0220 720.0000 FORMAT "%8.4" ECU_ADDRESS 0xC0000D9A /end MEASUREMENT
/begin MEASUREMENT InjCrv_phiPiI3AddCor "kundenspezifischer Korrekturwinkel für PiI3" SWORD AngleCrS 1 100 -720.0220 720.0000 FORMAT "%8.4" ECU_ADDRESS 0xD00071C0 /end MEASUREMENT
/begin MEASUREMENT InjCrv_phiPiI3Bas_mp "Winkelkomponente Ansteuerbeginn PiI3 Grundwert" SWORD AngleCrS 1 100 -720.0220 720.0000 FORMAT "%8.4" ECU_ADDRESS 0xC0000E08 /end MEASUREMENT
/begin MEASUREMENT InjCrv_phiPiI3Cor_mp "korrigierter Grundwert Winkelkomponente Ansteuerbeginn PiI3" SWORD AngleCrS 1 100 -720.0220 720.0000 FORMAT "%8.4" ECU_ADDRESS 0xC0000E0A /end MEASUREMENT
/begin MEASUREMENT InjCrv_phiPiI3EnvCor "Korrekturwinkel für PiI3" SWORD AngleCrS 1 100 -720.0220 720.0000 FORMAT "%8.4" ECU_ADDRESS 0xD00071C4 /end MEASUREMENT
/begin MEASUREMENT InjCrv_phiPiI3ETSCor_mp "motortemperaturabhängiger Korrekturgrundwert für die Winkelkomponente des Ansteuerbeginns der PiI3" SWORD AngleCrS 1 100 -720.0220 720.0000 FORMAT "%8.4" ECU_ADDRESS 0xC0000E24 /end MEASUREMENT
/begin MEASUREMENT InjCrv_phiPiI3SetLim_mp "begrenzter Sollwertwert Winkelkomponente Ansteuerbeginn PiI3" SWORD AngleCrS 1 100 -720.0220 720.0000 FORMAT "%8.4" ECU_ADDRESS 0xC0000E0C /end MEASUREMENT
/begin MEASUREMENT InjCrv_phiPiI3Set_mp "Sollwertwert Winkelkomponente Ansteuerbeginn PiI3" SWORD AngleCrS 1 100 -720.0220 720.0000 FORMAT "%8.4" ECU_ADDRESS 0xC0000E0E /end MEASUREMENT
/begin MEASUREMENT InjCrv_phiPiI3Tot_mp "Ansteuerdauer PiI3 (einschließlich Mindestzeit zwischen zwei Einspritzungen) in Winkel" SWORD AngleCrS 1 100 -720.0220 720.0000 FORMAT "%8.4" ECU_ADDRESS 0xC0000E10 /end MEASUREMENT
/begin MEASUREMENT InjCrv_phiPoI1AddCor "kundenspezifischer Korrekturwinkel für PoI1" SWORD AngleCrS 1 100 -720.0220 720.0000 FORMAT "%8.4" ECU_ADDRESS 0xD00071C6 /end MEASUREMENT
/begin MEASUREMENT InjCrv_phiPoI1AddCorRgn "additiver Korrekturwert für den Ansteuerbeginn der PoI1 im Regenerationsbetrieb" SWORD AngleCrS 1 100 -720.0220 720.0000 FORMAT "%8.4" ECU_ADDRESS 0xD00071C8 /end MEASUREMENT
/begin MEASUREMENT InjCrv_phiPoI1BasRgn_mp "Basiswert Ansteuerbeginn der Nacheinspritzung 1 im Regenerationsbetrieb" SWORD AngleCrS 1 100 -720.0220 720.0000 FORMAT "%8.4" ARRAY_SIZE 2 ECU_ADDRESS 0xC0000E6A /end MEASUREMENT
/begin MEASUREMENT InjCrv_phiPoI1Bas_mp "Grundwert des Ansteuerbeginnwinkels PoI1" SWORD AngleCrS 1 100 -720.0220 720.0000 FORMAT "%8.4" ECU_ADDRESS 0xC0000E32 /end MEASUREMENT
/begin MEASUREMENT InjCrv_phiPoI1Des "gewünschter Bezugswinkel für Beginn der PoI1" SWORD AngleCrS 1 100 -720.0220 720.0000 FORMAT "%8.4" ECU_ADDRESS 0xD00071CA /end MEASUREMENT
/begin MEASUREMENT InjCrv_phiPoI1DesAddByp_mp "Wert des gewünschten Winkels für die Nacheinspritzung 1 vor einem additiven Bypasseingriff" SWORD AngleCrS 1 100 -720.0220 720.0000 FORMAT "%8.4" ECU_ADDRESS 0xC0000E34 /end MEASUREMENT
/begin MEASUREMENT InjCrv_phiPoI1DesAdd_mp "Additiver Bypasseingriff für gewünschten Winkel der Nacheinspritzung 1" SWORD AngleCrS 1 100 -720.0220 720.0000 FORMAT "%8.4" ECU_ADDRESS 0xC0000E36 /end MEASUREMENT
/begin MEASUREMENT InjCrv_phiPoI1DesByp_mp "Bypass-Label, Kopie von InjCrv_phiPoI1Des" SWORD AngleCrS 1 100 -720.0220 720.0000 FORMAT "%8.4" ECU_ADDRESS 0xC0000E38 /end MEASUREMENT
/begin MEASUREMENT InjCrv_phiPoI1Dur_mp "Gesamtzeit PoI1 in Winkelgraden" SWORD AngleCrS 1 100 -720.0220 720.0000 FORMAT "%8.4" ECU_ADDRESS 0xC0000E3A /end MEASUREMENT
/begin MEASUREMENT InjCrv_phiPoI1EnvCor "umgebungsbedingungsabhängiger Korrekturwinkel für PoI1" SWORD AngleCrS 1 100 -720.0220 720.0000 FORMAT "%8.4" ECU_ADDRESS 0xD00071CC /end MEASUREMENT
/begin MEASUREMENT InjCrv_phiPoI1Lim_mp "begrenzter Ansteuerbeginnwinkel PoI1" SWORD AngleCrS 1 100 -720.0220 720.0000 FORMAT "%8.4" ECU_ADDRESS 0xC0000E3C /end MEASUREMENT
/begin MEASUREMENT InjCrv_phiPoI1Min_mp "spätester Ansteuerbeginnwinkel PoI1" SWORD AngleCrS 1 100 -720.0220 720.0000 FORMAT "%8.4" ECU_ADDRESS 0xC0000E3E /end MEASUREMENT
/begin MEASUREMENT InjCrv_phiPoI1Rgn "Grundwert der Winkelkomponente Ansteuerbeginn PoI1 im Regenerationsbetrieb" SWORD AngleCrS 1 100 -720.0220 720.0000 FORMAT "%8.4" ARRAY_SIZE 2 ECU_ADDRESS 0xD00071CE /end MEASUREMENT
/begin MEASUREMENT InjCrv_phiPoI1RgnAdd_mp "additive bypass for angle of post injection 1 in regeneration mode" SWORD AngleCrS 1 100 -720.0220 720.0000 FORMAT "%8.4" ARRAY_SIZE 2 ECU_ADDRESS 0xC0000E6E /end MEASUREMENT
/begin MEASUREMENT InjCrv_phiPoI1Set_mp "Sollwert des Ansteuerbeginnwinkels PoI1" SWORD AngleCrS 1 100 -720.0220 720.0000 FORMAT "%8.4" ECU_ADDRESS 0xC0000E40 /end MEASUREMENT
/begin MEASUREMENT InjCrv_phiPoI2AbsTot_mp "absoluter Ansteuerbeginn PoI2 aus Winkel- und Zeitkomponente" SWORD AngleCrS 1 100 -720.0220 720.0000 FORMAT "%8.4" ECU_ADDRESS 0xC0000E90 /end MEASUREMENT
/begin MEASUREMENT InjCrv_phiPoI2Abs_mp "Sollwert, Winkelkomponente Ansteuerbeginn PoI2 relativ zum oberen Totpunkt" SWORD AngleCrS 1 100 -720.0220 720.0000 FORMAT "%8.4" ECU_ADDRESS 0xC0000E92 /end MEASUREMENT
/begin MEASUREMENT InjCrv_phiPoI2AddCor "kundenspezifischer Korrekturwinkel für PoI2" SWORD AngleCrS 1 100 -720.0220 720.0000 FORMAT "%8.4" ECU_ADDRESS 0xD00071D2 /end MEASUREMENT
/begin MEASUREMENT InjCrv_phiPoI2AddCorRgn "Gesamtkorrektur SOE-Winkel für PoI2 im Regenerationsbetrieb (N-Sync)" SWORD AngleCrS 1 100 -720.0220 720.0000 FORMAT "%8.4" ECU_ADDRESS 0xD00071D4 /end MEASUREMENT
/begin MEASUREMENT InjCrv_phiPoI2APSCorRgn_mp "Gewichtete Winkelkorrekturen abhängig von dem Umgebungsluftdruck für die PoI2 im Regenerationsbetrieb" SWORD AngleCrS 1 100 -720.0220 720.0000 FORMAT "%8.4" ARRAY_SIZE 2 ECU_ADDRESS 0xC0000EE0 /end MEASUREMENT
/begin MEASUREMENT InjCrv_phiPoI2ATSCor_mp "ansauglufttemperaturabhängiger Korrekturgrundwert für die Winkelkomponente des Ansteuerbeginns der PoI2" SWORD AngleCrS 1 100 -720.0220 720.0000 FORMAT "%8.4" ECU_ADDRESS 0xC0000EDC /end MEASUREMENT
/begin MEASUREMENT InjCrv_phiPoI2BasRgn_mp "Grundwert der Winkelkomponente Ansteuerbeginn PoI2 im Regenerationsbetrieb" SWORD AngleCrS 1 100 -720.0220 720.0000 FORMAT "%8.4" ARRAY_SIZE 2 ECU_ADDRESS 0xC0000F00 /end MEASUREMENT
/begin MEASUREMENT InjCrv_phiPoI2Bas_mp "Winkelkomponente Ansteuerbeginn PoI2 Grundwert" SWORD AngleCrS 1 100 -720.0220 720.0000 FORMAT "%8.4" ECU_ADDRESS 0xC0000F2E /end MEASUREMENT
/begin MEASUREMENT InjCrv_phiPoI2Byp_mp "Messpunkt für Bypass" SWORD AngleCrS 1 100 -720.0220 720.0000 FORMAT "%8.4" ECU_ADDRESS 0xC0000E94 /end MEASUREMENT
/begin MEASUREMENT InjCrv_phiPoI2Cor_mp "korrigierter Grundwert der Winkelkomponente Ansteuerbeginn PoI2" SWORD AngleCrS 1 100 -720.0220 720.0000 FORMAT "%8.4" ECU_ADDRESS 0xC0000E96 /end MEASUREMENT
/begin MEASUREMENT InjCrv_phiPoI2Des "gewünschter Bezugswinkel für Beginn der PoI2" SWORD AngleCrS 1 100 -720.0220 720.0000 FORMAT "%8.4" ECU_ADDRESS 0xD00071D6 /end MEASUREMENT
/begin MEASUREMENT InjCrv_phiPoI2DesAdd_mp "Additiver Bypasseingriff für gewünschten Winkel der Nacheinspritzung 2" SWORD AngleCrS 1 100 -720.0220 720.0000 FORMAT "%8.4" ECU_ADDRESS 0xC0000E98 /end MEASUREMENT
/begin MEASUREMENT InjCrv_phiPoI2DesTot_mp "Gewünschter Gesamtwinkel für Beginn der PoI2 inklusive Zeitkomponente" SWORD AngleCrS 1 100 -720.0220 720.0000 FORMAT "%8.4" ECU_ADDRESS 0xC0000F20 /end MEASUREMENT
/begin MEASUREMENT InjCrv_phiPoI2EnvCor "Korrekturwinkel für PoI2" SWORD AngleCrS 1 100 -720.0220 720.0000 FORMAT "%8.4" ECU_ADDRESS 0xD00071D8 /end MEASUREMENT
/begin MEASUREMENT InjCrv_phiPoI2EnvCorRgn "Umgebungsbedingungsabhängige Korrekturwinkel für Nacheinspritzung 2 im Regenerationsbetrieb" SWORD AngleCrS 1 100 -720.0220 720.0000 FORMAT "%8.4" ARRAY_SIZE 2 ECU_ADDRESS 0xD00071DA /end MEASUREMENT
/begin MEASUREMENT InjCrv_phiPoI2ETSCorRgn_mp "Gewichtete Winkelkorrekturen abhängig von der Motortemperatur für die PoI2 im Regenerationsbetrieb" SWORD AngleCrS 1 100 -720.0220 720.0000 FORMAT "%8.4" ARRAY_SIZE 2 ECU_ADDRESS 0xC0000EE4 /end MEASUREMENT
/begin MEASUREMENT InjCrv_phiPoI2ETSCor_mp "motortemperaturabhängiger Korrekturgrundwert für die Winkelkomponente des Ansteuerbeginns der PoI2" SWORD AngleCrS 1 100 -720.0220 720.0000 FORMAT "%8.4" ECU_ADDRESS 0xC0000EDE /end MEASUREMENT
/begin MEASUREMENT InjCrv_phiPoI2MaxRgn_mp "Grundgrenzwert der Winkelkomponente Ansteuerbeginn PoI2 im Regenerationsbetrieb" SWORD AngleCrS 1 100 -720.0220 720.0000 FORMAT "%8.4" ECU_ADDRESS 0xC0000F04 /end MEASUREMENT
/begin MEASUREMENT InjCrv_phiPoI2MinOilDil_mp "Spätester Ansteuerbeginn der PoI2 bei Vorliegen einer Abschaltanforderung aufgrund Ölverdünnung" SWORD AngleCrS 1 100 -720.0220 720.0000 FORMAT "%8.4" ECU_ADDRESS 0xC0000F22 /end MEASUREMENT
/begin MEASUREMENT InjCrv_phiPoI2NrmVal_mp "Eingangswert für den Normalwerteingang in der Funktion EGT_RgnSwtSE in der Funktion InjCrv_PoI2RgnSwtSOE" SWORD AngleCrS 1 100 -720.0220 720.0000 FORMAT "%8.4" ECU_ADDRESS 0xC0000F1C /end MEASUREMENT
/begin MEASUREMENT InjCrv_phiPoI2Rel_mp "Winkelkomponente Ansteuerbeginn PoI2 relativ zur Haupteinspritzung" SWORD AngleCrS 1 100 -720.0220 720.0000 FORMAT "%8.4" ECU_ADDRESS 0xC0000E9A /end MEASUREMENT
/begin MEASUREMENT InjCrv_phiPoI2Rgn "Grundwert der Winkelkomponente Ansteuerbeginn PoI2 im Regenerationsbetrieb" SWORD AngleCrS 1 100 -720.0220 720.0000 FORMAT "%8.4" ARRAY_SIZE 2 ECU_ADDRESS 0xD00071DE /end MEASUREMENT
/begin MEASUREMENT InjCrv_phiPoI2RgnAdd_mp "Additiver Bypasseingriff für Winkel der Nacheinspritzung 2 im Regenerationsbetrieb" SWORD AngleCrS 1 100 -720.0220 720.0000 FORMAT "%8.4" ARRAY_SIZE 2 ECU_ADDRESS 0xC0000F06 /end MEASUREMENT
/begin MEASUREMENT InjCrv_POpPoI1AddCor "kundespezifischer Korrekturwert für Freigabe PoI1" SWORD OneToOne 1 100 -32768.00 32767.00 FORMAT "%8.2" ECU_ADDRESS 0xD00070B2 /end MEASUREMENT
/begin MEASUREMENT InjCrv_POpPoI1Bas_mp "Grundwert Freigabe PoI1" SWORD OneToOne 1 100 -32768.00 32767.00 FORMAT "%8.2" ECU_ADDRESS 0xC0000E7E /end MEASUREMENT
/begin MEASUREMENT InjCrv_POpPoI1EnvCor "Freigabekorrekturwert für PoI1" SWORD OneToOne 1 100 -32768.00 32767.00 FORMAT "%8.2" ECU_ADDRESS 0xD00070B4 /end MEASUREMENT
/begin MEASUREMENT InjCrv_POpPoI1Rgn_mp "Basis Regenerationswert für die Freigabe von PoI1" SWORD OneToOne 1 100 -32768.00 32767.00 FORMAT "%8.2" ECU_ADDRESS 0xC0000E80 /end MEASUREMENT
/begin MEASUREMENT InjCrv_POpPoI1_mp "korrigierter Grundwert Freigabe PoI1" SWORD OneToOne 1 100 -32768.00 32767.00 FORMAT "%8.2" ECU_ADDRESS 0xC0000E82 /end MEASUREMENT
/begin MEASUREMENT InjCrv_POpPoI2AddCor "kundenspezifischer Korrekturwert für Freigabe PoI2" SWORD OneToOne 1 100 -32768.00 32767.00 FORMAT "%8.2" ECU_ADDRESS 0xD00070B6 /end MEASUREMENT
/begin MEASUREMENT InjCrv_POpPoI2Bas_mp "Basiswert für die betriebspunktabhängige Freigabe der PoI2" SWORD OneToOne 1 100 -32768.00 32767.00 FORMAT "%8.2" ECU_ADDRESS 0xC0000F24 /end MEASUREMENT
/begin MEASUREMENT InjCrv_POpPoI2EnvCor "Korrekturwert für Freigabe PoI2" SWORD OneToOne 1 100 -32768.00 32767.00 FORMAT "%8.2" ECU_ADDRESS 0xD00070B8 /end MEASUREMENT
/begin MEASUREMENT InjCrv_POpPoI2Rgn_mp "Basis Regenerationswert für die Freigabe von PoI2" SWORD OneToOne 1 100 -32768.00 32767.00 FORMAT "%8.2" ECU_ADDRESS 0xC0000F26 /end MEASUREMENT
/begin MEASUREMENT InjCrv_POpPoI2_mp "Freigabe PoI2, korrigierter Grundwert" SWORD OneToOne 1 100 -32768.00 32767.00 FORMAT "%8.2" ECU_ADDRESS 0xC0000F28 /end MEASUREMENT
/begin MEASUREMENT InjCrv_qMI1MinPiI2_mp "Minimalmenge der MI1 wenn PiI1 und PiI2 abgesetzt werden" SWORD InjMass 1 100 -327.6800 327.6700 FORMAT "%8.4" ECU_ADDRESS 0xC0000D9C /end MEASUREMENT
/begin MEASUREMENT InjCrv_qMI1MinPiI3_mp "Minimalmenge der MI1 wenn PiI3 abgesetzt wird" SWORD InjMass 1 100 -327.6800 327.6700 FORMAT "%8.4" ECU_ADDRESS 0xC0000E12 /end MEASUREMENT
/begin MEASUREMENT InjCrv_qMI1MinPoI2_mp "Minimale Einspritzmenge der MI1 bei der PoI2 Berechnung" SWORD InjMass 1 100 -327.6800 327.6700 FORMAT "%8.4" ECU_ADDRESS 0xC0000E9C /end MEASUREMENT
/begin MEASUREMENT InjCrv_qPiI1BasStrt_mp "Einspritzmenge PiI 1 Grundwert im Startzustand" SWORD InjMassInj 1 100 -327.6800 327.6700 FORMAT "%8.4" ECU_ADDRESS 0xC0000D8E /end MEASUREMENT
/begin MEASUREMENT InjCrv_qPiI1MinWv_mp "Minimalmenge der PiI1 mit Wellenkorrektur" SWORD InjMass 1 100 -327.6800 327.6700 FORMAT "%8.4" ECU_ADDRESS 0xC0000F32 /end MEASUREMENT
/begin MEASUREMENT InjCrv_qPiI2AddCor "kundenspezifische Korrekturmenge für PiI2" SWORD InjMass 1 100 -327.6800 327.6700 FORMAT "%8.4" ECU_ADDRESS 0xD000720C /end MEASUREMENT
/begin MEASUREMENT InjCrv_qPiI2AddCorRgn "additiver Korrekturwert für die Mengenkorrektur der PiI2 im Regenerationsbetrieb" SWORD InjMassInj 1 100 -327.6800 327.6700 FORMAT "%8.4" ECU_ADDRESS 0xD000720E /end MEASUREMENT
/begin MEASUREMENT InjCrv_qPiI2AddCorStrt "PII2 menge korrektur während des Motor start state" SWORD InjMassInj 1 100 -327.6800 327.6700 FORMAT "%8.4" ECU_ADDRESS 0xD0007210 /end MEASUREMENT
/begin MEASUREMENT InjCrv_qPiI2APSCorRgn_mp "Druckabhängiger Basismengenkorrekturwert der Voreinspritzung 2 im Regenerationsbetrieb" SWORD InjMassInj 1 100 -327.6800 327.6700 FORMAT "%8.4" ARRAY_SIZE 2 ECU_ADDRESS 0xC0000DCE /end MEASUREMENT
/begin MEASUREMENT InjCrv_qPiI2APSCor_mp "atmosphärendruckabhängige Korrekturmenge für Voreinspritzung 2" SWORD InjMass 1 100 -327.6800 327.6700 FORMAT "%8.4" ECU_ADDRESS 0xC0000DC4 /end MEASUREMENT
/begin MEASUREMENT InjCrv_qPiI2APSQCorStrt_mp "Atmosphäre Druck abhängiger PII2 menge korrektur während des Motor start state" SWORD InjMassInj 1 100 -327.6800 327.6700 FORMAT "%8.4" ECU_ADDRESS 0xC0000DBC /end MEASUREMENT
/begin MEASUREMENT InjCrv_qPiI2ATSCorRgn_mp "Ansauglufttemperaturabhängiger Basismengenkorrekturwert der PiI2 im Regenerationsbetrieb" SWORD InjMassInj 1 100 -327.6800 327.6700 FORMAT "%8.4" ARRAY_SIZE 2 ECU_ADDRESS 0xC0000DD2 /end MEASUREMENT
/begin MEASUREMENT InjCrv_qPiI2ATSCor_mp "ansauglufttemperaturabhängige Korrekturmenge für Voreinspritzung 2" SWORD InjMass 1 100 -327.6800 327.6700 FORMAT "%8.4" ECU_ADDRESS 0xC0000DC6 /end MEASUREMENT
/begin MEASUREMENT InjCrv_qPiI2ATSQCorStrt_mp "Lufttemperatur abhängiger PII2 menge korrektur während des Motor start state" SWORD InjMassInj 1 100 -327.6800 327.6700 FORMAT "%8.4" ECU_ADDRESS 0xC0000DBE /end MEASUREMENT
/begin MEASUREMENT InjCrv_qPiI2BasRgn_mp "Basiswert für die Mengenkorrektur der Voreinspritzung 2 im Regenerationsbetrieb" SWORD InjMass 1 100 -327.6800 327.6700 FORMAT "%8.4" ARRAY_SIZE 2 ECU_ADDRESS 0xC0000DE6 /end MEASUREMENT
/begin MEASUREMENT InjCrv_qPiI2BasStrt_mp "Einspritzmenge PiI 2 Grundwert im Startzustand" SWORD InjMassInj 1 100 -327.6800 327.6700 FORMAT "%8.4" ECU_ADDRESS 0xC0000E02 /end MEASUREMENT
/begin MEASUREMENT InjCrv_qPiI2Bas_mp "Einspritzmenge PiI2 Grundwert" SWORD InjMass 1 100 -327.6800 327.6700 FORMAT "%8.4" ECU_ADDRESS 0xC0000D9E /end MEASUREMENT
/begin MEASUREMENT InjCrv_qPiI2EnvCor "Korrekturmenge für Voreinspritzung 2" SWORD InjMass 1 100 -327.6800 327.6700 FORMAT "%8.4" ECU_ADDRESS 0xD000721E /end MEASUREMENT
/begin MEASUREMENT InjCrv_qPiI2EnvCorRgn "Korrekturmenge für Voreinspritzung 2 im Regenerationsbetrieb" SWORD InjMassInj 1 100 -327.6800 327.6700 FORMAT "%8.4" ARRAY_SIZE 2 ECU_ADDRESS 0xD0007220 /end MEASUREMENT
/begin MEASUREMENT InjCrv_qPiI2ETSCorRgn_mp "Motortemperaturabhängiger Basismengenkorrekturwert der PiI2 im Regenerationsbetrieb" SWORD InjMassInj 1 100 -327.6800 327.6700 FORMAT "%8.4" ARRAY_SIZE 2 ECU_ADDRESS 0xC0000DD6 /end MEASUREMENT
/begin MEASUREMENT InjCrv_qPiI2ETSCor_mp "motortemperaturabhängige Korrekturmenge für Voreinspritzung 2" SWORD InjMass 1 100 -327.6800 327.6700 FORMAT "%8.4" ECU_ADDRESS 0xC0000DC8 /end MEASUREMENT
/begin MEASUREMENT InjCrv_qPiI2ETSQCorStrt_mp "Motor Temperaturabhängiger PII2 menge korrektur während des Motor start state" SWORD InjMassInj 1 100 -327.6800 327.6700 FORMAT "%8.4" ECU_ADDRESS 0xC0000DC0 /end MEASUREMENT
/begin MEASUREMENT InjCrv_qPiI2MaxRgn_mp "Maximalwert der Korrekturmenge für die Voreinspritzmenge 2 im Regenerationsbetrieb" SWORD InjMass 1 100 -327.6800 327.6700 FORMAT "%8.4" ECU_ADDRESS 0xC0000DEA /end MEASUREMENT
/begin MEASUREMENT InjCrv_qPiI2Max_mp "maximale Einspritzmenge der PiI2" SWORD InjMass 1 100 -327.6800 327.6700 FORMAT "%8.4" ECU_ADDRESS 0xC0000DA0 /end MEASUREMENT
/begin MEASUREMENT InjCrv_qPiI2Rgn "Regenerationswert für die Einspritzmenge der PiI2" SWORD InjMass 1 100 -327.6800 327.6700 FORMAT "%8.4" ARRAY_SIZE 2 ECU_ADDRESS 0xD0007224 /end MEASUREMENT
/begin MEASUREMENT InjCrv_qPiI2RgnAdd_mp "Additiver Bypasseingriff für Menge der Voreinspritzung 2 im Regenerationsbetrieb" SWORD InjMass 1 100 -327.6800 327.6700 FORMAT "%8.4" ARRAY_SIZE 2 ECU_ADDRESS 0xC0000DEC /end MEASUREMENT
/begin MEASUREMENT InjCrv_qPiI2SetLimMax_mp "begrenzte maximale Solleinspritzmenge PiI2" SWORD InjMass 1 100 -327.6800 327.6700 FORMAT "%8.4" ECU_ADDRESS 0xC0000DA2 /end MEASUREMENT
/begin MEASUREMENT InjCrv_qPiI2SetLim_mp "begrenzte Solleinspritzmenge PiI2" SWORD InjMass 1 100 -327.6800 327.6700 FORMAT "%8.4" ECU_ADDRESS 0xC0000DA4 /end MEASUREMENT
/begin MEASUREMENT InjCrv_qPiI2Set_mp "Sollwert der Einspritzmenge PiI2" SWORD InjMass 1 100 -327.6800 327.6700 FORMAT "%8.4" ECU_ADDRESS 0xC0000DA6 /end MEASUREMENT
/begin MEASUREMENT InjCrv_qPiI3AddCor "Kundenspezifische Korrekturmenge für PiI3" SWORD InjMass 1 100 -327.6800 327.6700 FORMAT "%8.4" ECU_ADDRESS 0xD0007228 /end MEASUREMENT
/begin MEASUREMENT InjCrv_qPiI3APSCor_mp "atmosphärendruckabhängige Korrekturmenge für Voreinspritzung 3" SWORD InjMass 1 100 -327.6800 327.6700 FORMAT "%8.4" ECU_ADDRESS 0xC0000E26 /end MEASUREMENT
/begin MEASUREMENT InjCrv_qPiI3ATSCor_mp "ansauglufttemperaturabhängige Korrekturmenge für Voreinspritzung 3" SWORD InjMass 1 100 -327.6800 327.6700 FORMAT "%8.4" ECU_ADDRESS 0xC0000E28 /end MEASUREMENT
/begin MEASUREMENT InjCrv_qPiI3Bas_mp "Einspritzmenge PiI3 Grundwert" SWORD InjMass 1 100 -327.6800 327.6700 FORMAT "%8.4" ECU_ADDRESS 0xC0000E14 /end MEASUREMENT
/begin MEASUREMENT InjCrv_qPiI3EnvCor "Korrekturmenge für PiI3" SWORD InjMass 1 100 -327.6800 327.6700 FORMAT "%8.4" ECU_ADDRESS 0xD0007236 /end MEASUREMENT
/begin MEASUREMENT InjCrv_qPiI3ETSCor_mp "motortemperaturabhängige Korrekturmenge für Voreinspritzung 3" SWORD InjMass 1 100 -327.6800 327.6700 FORMAT "%8.4" ECU_ADDRESS 0xC0000E2A /end MEASUREMENT
/begin MEASUREMENT InjCrv_qPiI3Max_mp "maximale Einspritzmenge der PiI3" SWORD InjMass 1 100 -327.6800 327.6700 FORMAT "%8.4" ECU_ADDRESS 0xC0000E16 /end MEASUREMENT
/begin MEASUREMENT InjCrv_qPiI3SetLimMax_mp "begrenzte maximale Solleinspritzmenge PiI3" SWORD InjMass 1 100 -327.6800 327.6700 FORMAT "%8.4" ECU_ADDRESS 0xC0000E18 /end MEASUREMENT
/begin MEASUREMENT InjCrv_qPiI3SetLim_mp "begrenzte Solleinspritzmenge PiI3" SWORD InjMass 1 100 -327.6800 327.6700 FORMAT "%8.4" ECU_ADDRESS 0xC0000E1A /end MEASUREMENT
/begin MEASUREMENT InjCrv_qPiI3Set_mp "Sollwert der Einspritzmenge PiI3" SWORD InjMass 1 100 -327.6800 327.6700 FORMAT "%8.4" ECU_ADDRESS 0xC0000E1C /end MEASUREMENT
/begin MEASUREMENT InjCrv_qPoI1AddCor "kundenspezifische Korrekturmenge für PoI1" SWORD InjMass 1 100 -327.6800 327.6700 FORMAT "%8.4" ECU_ADDRESS 0xD0007238 /end MEASUREMENT
/begin MEASUREMENT InjCrv_qPoI1AddCorRgn "Kundenspezifische Korrekturmenge für PoI1 im Regenerationsbetrieb" SWORD InjMassInj 1 100 -327.6800 327.6700 FORMAT "%8.4" ECU_ADDRESS 0xD000723A /end MEASUREMENT
/begin MEASUREMENT InjCrv_qPoI1APSCor_mp "atmosphärendruckabhängige Korrekturmenge für PoI1" SWORD InjMass 1 100 -327.6800 327.6700 FORMAT "%8.4" ECU_ADDRESS 0xC0000E66 /end MEASUREMENT
/begin MEASUREMENT InjCrv_qPoI1BasRgn_mp "Basiswert für die Mengenkorrektur der Nacheinspritzung 1 im Regenerationsbetrieb" SWORD InjMass 1 100 -327.6800 327.6700 FORMAT "%8.4" ARRAY_SIZE 2 ECU_ADDRESS 0xC0000E72 /end MEASUREMENT
/begin MEASUREMENT InjCrv_qPoI1Bas_mp "Grundwert der Einspritzmenge PoI1" SWORD InjMass 1 100 -327.6800 327.6700 FORMAT "%8.4" ECU_ADDRESS 0xC0000E42 /end MEASUREMENT
/begin MEASUREMENT InjCrv_qPoI1Clsn "zylinderselektiver Mengenanteil PoI1 bei Kollision" SWORD InjMass 1 100 -327.6800 327.6700 FORMAT "%8.4" ECU_ADDRESS 0xD000723C /end MEASUREMENT
/begin MEASUREMENT InjCrv_qPoI1Cor_mp "korrigierter Grundwert der Einspritzmenge PoI1" SWORD InjMassInj 1 100 -327.6800 327.6700 FORMAT "%8.4" ECU_ADDRESS 0xC0000E44 /end MEASUREMENT
/begin MEASUREMENT InjCrv_qPoI1Des "gewünschte Einspritzmenge PoI1" SWORD InjMass 1 100 -327.6800 327.6700 FORMAT "%8.4" ARRAY_SIZE 6 ECU_ADDRESS 0xD000723E /end MEASUREMENT
/begin MEASUREMENT InjCrv_qPoI1DesAddByp_mp "Wert der gewünschten Menge für die Nacheinspritzung 1 vor einem additiven Bypasseingriff" SWORD InjMass 1 100 -327.6800 327.6700 FORMAT "%8.4" ECU_ADDRESS 0xC0000E46 /end MEASUREMENT
/begin MEASUREMENT InjCrv_qPoI1DesAdd_mp "Additiver Bypasseingriff für gewünschte Menge der Nacheinspritzung 1" SWORD InjMass 1 100 -327.6800 327.6700 FORMAT "%8.4" ARRAY_SIZE 6 ECU_ADDRESS 0xC0000E48 /end MEASUREMENT
/begin MEASUREMENT InjCrv_qPoI1DesByp_mp "Bypass-Label, Kopie von InjCrv_qPoI1Des" SWORD InjMass 1 100 -327.6800 327.6700 FORMAT "%8.4" ECU_ADDRESS 0xC0000E54 /end MEASUREMENT
/begin MEASUREMENT InjCrv_qPoI1Des_mp "Sollmenge Nacheinspritzung 1" SWORD InjMass 1 100 -327.6800 327.6700 FORMAT "%8.4" ECU_ADDRESS 0xC0000E56 /end MEASUREMENT
/begin MEASUREMENT InjCrv_qPoI1EnvCor "umgebungsbedingungsabhängige Korrekturmenge für PoI1" SWORD InjMass 1 100 -327.6800 327.6700 FORMAT "%8.4" ECU_ADDRESS 0xD000724A /end MEASUREMENT
/begin MEASUREMENT InjCrv_qPoI1ETSCor_mp "motortemperaturabhängige Korrekturmenge für PoI1" SWORD InjMass 1 100 -327.6800 327.6700 FORMAT "%8.4" ECU_ADDRESS 0xC0000E68 /end MEASUREMENT
/begin MEASUREMENT InjCrv_qPoI1Lim_mp "begrenzte Einspritzmenge PoI1" SWORD InjMass 1 100 -327.6800 327.6700 FORMAT "%8.4" ECU_ADDRESS 0xC0000E58 /end MEASUREMENT
/begin MEASUREMENT InjCrv_qPoI1Max_mp "Maximalwert der Einspritzmenge PoI1" SWORD InjMass 1 100 -327.6800 327.6700 FORMAT "%8.4" ECU_ADDRESS 0xC0000E5A /end MEASUREMENT
/begin MEASUREMENT InjCrv_qPoI1Min_mp "Minimalwert der Einspritzmenge PoI1" SWORD InjMass 1 100 -327.6800 327.6700 FORMAT "%8.4" ECU_ADDRESS 0xC0000E5C /end MEASUREMENT
/begin MEASUREMENT InjCrv_qPoI1Rgn "Grundwert Einspritzmenge PoI1 im Regenerationsbetrieb" SWORD InjMass 1 100 -327.6800 327.6700 FORMAT "%8.4" ARRAY_SIZE 2 ECU_ADDRESS 0xD000724C /end MEASUREMENT
/begin MEASUREMENT InjCrv_qPoI1RgnAdd_mp "Additiver Bypasseingriff für Menge der Nacheinspritzung 1 im Regenerationsbetrieb" SWORD InjMass 1 100 -327.6800 327.6700 FORMAT "%8.4" ARRAY_SIZE 2 ECU_ADDRESS 0xC0000E76 /end MEASUREMENT
/begin MEASUREMENT InjCrv_qPoI1Set_mp "Sollwert der Einspritzmenge PoI1" SWORD InjMass 1 100 -327.6800 327.6700 FORMAT "%8.4" ECU_ADDRESS 0xC0000E5E /end MEASUREMENT
/begin MEASUREMENT InjCrv_qPoI2AddCor "kundenspezifische Korrekturmenge für PoI2" SWORD InjMass 1 100 -327.6800 327.6700 FORMAT "%8.4" ECU_ADDRESS 0xD0007250 /end MEASUREMENT
/begin MEASUREMENT InjCrv_qPoI2AddCorRgn "Kundenspezifische Korrekturmenge für PoI2 im Regenerationsbetrieb" SWORD InjMassInj 1 100 -327.6800 327.6700 FORMAT "%8.4" ECU_ADDRESS 0xD0007252 /end MEASUREMENT
/begin MEASUREMENT InjCrv_qPoI2APSCorRgn_mp "Luftdruckbhängiger Basismengenkorrekturwert der PoI2 im Regenerationsbetrieb" SWORD InjMass 1 100 -327.6800 327.6700 FORMAT "%8.4" ARRAY_SIZE 2 ECU_ADDRESS 0xC0000EE8 /end MEASUREMENT
/begin MEASUREMENT InjCrv_qPoI2ATSCorRgn_mp "Lufttemperaturabhängiger Basismengenkorrekturwert der PoI2 im Regenerationsbetrieb" SWORD InjMass 1 100 -327.6800 327.6700 FORMAT "%8.4" ARRAY_SIZE 2 ECU_ADDRESS 0xC0000EEC /end MEASUREMENT
/begin MEASUREMENT InjCrv_qPoI2ATSCor_mp "ansauglufttemperaturabhängige Korrekturmenge für PoI2" SWORD InjMass 1 100 -327.6800 327.6700 FORMAT "%8.4" ECU_ADDRESS 0xC0000ED8 /end MEASUREMENT
/begin MEASUREMENT InjCrv_qPoI2BasRgn_mp "Einspritzmenge PoI2 Grundwert für den Regenerationsbetrieb" SWORD InjMass 1 100 -327.6800 327.6700 FORMAT "%8.4" ARRAY_SIZE 2 ECU_ADDRESS 0xC0000F0A /end MEASUREMENT
/begin MEASUREMENT InjCrv_qPoI2Bas_mp "Einspritzmenge PoI2 Grundwert" SWORD InjMass 1 100 -327.6800 327.6700 FORMAT "%8.4" ECU_ADDRESS 0xC0000E9E /end MEASUREMENT
/begin MEASUREMENT InjCrv_qPoI2Cor_mp "korrigierter Grundwert der Einspritzmenge PoI2" SWORD InjMass 1 100 -327.6800 327.6700 FORMAT "%8.4" ECU_ADDRESS 0xC0000EA0 /end MEASUREMENT
/begin MEASUREMENT InjCrv_qPoI2Des "Sollmenge Nacheinspritzung 2" SWORD InjMass 1 100 -327.6800 327.6700 FORMAT "%8.4" ARRAY_SIZE 6 ECU_ADDRESS 0xD0007254 /end MEASUREMENT
/begin MEASUREMENT InjCrv_qPoI2DesAdd_mp "Additiver Bypasseingriff für gewünschte Menge der Nacheinspritzung 2" SWORD InjMass 1 100 -327.6800 327.6700 FORMAT "%8.4" ARRAY_SIZE 6 ECU_ADDRESS 0xC0000EA2 /end MEASUREMENT
/begin MEASUREMENT InjCrv_qPoI2DesByp_mp "Messpunkt für den Bypass" SWORD InjMass 1 100 -327.6800 327.6700 FORMAT "%8.4" ECU_ADDRESS 0xC0000EAE /end MEASUREMENT
/begin MEASUREMENT InjCrv_qPoI2Des_mp "Sollmenge Nacheinspritzung 2" SWORD InjMass 1 100 -327.6800 327.6700 FORMAT "%8.4" ECU_ADDRESS 0xC0000EB0 /end MEASUREMENT
/begin MEASUREMENT InjCrv_qPoI2Eff "wirksame Einspritzmenge PoI2" SWORD InjMass 1 100 -327.6800 327.6700 FORMAT "%8.4" ARRAY_SIZE 6 ECU_ADDRESS 0xD0007260 /end MEASUREMENT
/begin MEASUREMENT InjCrv_qPoI2EffAdd_mp "Additiver Bypasseingriff für Effektivmenge der Nacheinspritzung 2" SWORD InjMass 1 100 -327.6800 327.6700 FORMAT "%8.4" ARRAY_SIZE 6 ECU_ADDRESS 0xC0000EB2 /end MEASUREMENT
/begin MEASUREMENT InjCrv_qPoI2EffByp_mp "Messpunkt für den Bypass" SWORD InjMass 1 100 -327.6800 327.6700 FORMAT "%8.4" ECU_ADDRESS 0xC0000EBE /end MEASUREMENT
/begin MEASUREMENT InjCrv_qPoI2Eff_mp "Wirksame Menge der PoI2" SWORD InjMass 1 100 -327.6800 327.6700 FORMAT "%8.4" ECU_ADDRESS 0xC0000EC0 /end MEASUREMENT
/begin MEASUREMENT InjCrv_qPoI2EnvCor "Korrekturmenge für PoI2" SWORD InjMass 1 100 -327.6800 327.6700 FORMAT "%8.4" ECU_ADDRESS 0xD000726C /end MEASUREMENT
/begin MEASUREMENT InjCrv_qPoI2EnvCorRgn "Umgebungsbedingungsabhängige Korrekturmenge für Nacheinspritzung 2 im Regenerationsbetrieb" SWORD InjMass 1 100 -327.6800 327.6700 FORMAT "%8.4" ARRAY_SIZE 2 ECU_ADDRESS 0xD000726E /end MEASUREMENT
/begin MEASUREMENT InjCrv_qPoI2ETSCorRgn_mp "Motortemperaturabhängiger Basismengenkorrekturwert der PoI2 im Regenerationsbetrieb" SWORD InjMass 1 100 -327.6800 327.6700 FORMAT "%8.4" ARRAY_SIZE 2 ECU_ADDRESS 0xC0000EF0 /end MEASUREMENT
/begin MEASUREMENT InjCrv_qPoI2ETSCor_mp "motortemperaturabhängige Korrekturmenge für PoI2" SWORD InjMass 1 100 -327.6800 327.6700 FORMAT "%8.4" ECU_ADDRESS 0xC0000EDA /end MEASUREMENT
/begin MEASUREMENT InjCrv_qPoI2Lim_mp "begrenzter Sollwert, Einspritzmenge PoI2" SWORD InjMass 1 100 -327.6800 327.6700 FORMAT "%8.4" ECU_ADDRESS 0xC0000EC2 /end MEASUREMENT
/begin MEASUREMENT InjCrv_qPoI2Max_mp "maximale Einspritzmenge PoI2" SWORD InjMass 1 100 -327.6800 327.6700 FORMAT "%8.4" ECU_ADDRESS 0xC0000EC4 /end MEASUREMENT
/begin MEASUREMENT InjCrv_qPoI2Min_mp "minimale Einspritzmenge PoI2" SWORD InjMass 1 100 -327.6800 327.6700 FORMAT "%8.4" ECU_ADDRESS 0xC0000EC6 /end MEASUREMENT
/begin MEASUREMENT InjCrv_qPoI2Rgn "Grundwert Einspritzmenge PoI2 im Regenerationsbetrieb" SWORD InjMass 1 100 -327.6800 327.6700 FORMAT "%8.4" ARRAY_SIZE 2 ECU_ADDRESS 0xD0007272 /end MEASUREMENT
/begin MEASUREMENT InjCrv_qPoI2RgnAdd_mp "Additiver Bypasseingriff für Menge der Nacheinspritzung 2 im Regenerationsbtrieb" SWORD InjMass 1 100 -327.6800 327.6700 FORMAT "%8.4" ARRAY_SIZE 2 ECU_ADDRESS 0xC0000F0E /end MEASUREMENT
/begin MEASUREMENT InjCrv_qPoI2Set_mp "Sollwert Einspritzmenge PoI2" SWORD InjMass 1 100 -327.6800 327.6700 FORMAT "%8.4" ECU_ADDRESS 0xC0000EC8 /end MEASUREMENT
/begin MEASUREMENT InjCrv_stActValPoI1_mp "Aktueller Betriebsmodus der PoI1" UBYTE OneToOne 1 100 0.00 255.0 FORMAT "%5.1" ECU_ADDRESS 0xC0000E84 /end MEASUREMENT
/begin MEASUREMENT InjCrv_stActValPoI2_mp "Aktueller Betriebsmodus der PoI2" UBYTE OneToOne 1 100 0.00 255.0 FORMAT "%5.1" ECU_ADDRESS 0xC0000F2A /end MEASUREMENT
/begin MEASUREMENT InjCrv_stDesValPoI1_mp "Gewünschter Betriebsmodus der PoI1" UBYTE OneToOne 1 100 0.00 255.0 FORMAT "%5.1" ECU_ADDRESS 0xC0000E85 /end MEASUREMENT
/begin MEASUREMENT InjCrv_stDesValPoI2_mp "Gewünschter Betriebsmodus der PoI2" UBYTE OneToOne 1 100 0.00 255.0 FORMAT "%5.1" ECU_ADDRESS 0xC0000F2B /end MEASUREMENT
/begin MEASUREMENT InjCrv_stPiI2_mp "Freigabestatus PiI2" UBYTE OneToOne 1 100 0.00 255.0 FORMAT "%5.1" ECU_ADDRESS 0xC0000DA8 /end MEASUREMENT
/begin MEASUREMENT InjCrv_stPiI3_mp "Freigabestatus PiI3" UBYTE OneToOne 1 100 0.00 255.0 FORMAT "%5.1" ECU_ADDRESS 0xC0000E1E /end MEASUREMENT
/begin MEASUREMENT InjCrv_stPoI1RlsDes_mp "Gewünschter Freigabestatus der PoI1" UBYTE OneToOne 1 100 0.00 255.0 FORMAT "%5.1" ECU_ADDRESS 0xC0000E86 /end MEASUREMENT
/begin MEASUREMENT InjCrv_stPoI1_mp "Freigabestatus PoI1" UBYTE OneToOne 1 100 0.00 255.0 FORMAT "%5.1" ECU_ADDRESS 0xC0000E60 /end MEASUREMENT
/begin MEASUREMENT InjCrv_stPoI2 "Freigabestatus PoI2" UBYTE OneToOne 1 100 0.00 255.0 FORMAT "%5.1" ECU_ADDRESS 0xD0009098 /end MEASUREMENT
/begin MEASUREMENT InjCrv_stPoI2RlsDes_mp "Gewünschter Freigabestatus der PoI2" UBYTE OneToOne 1 100 0.00 255.0 FORMAT "%5.1" ECU_ADDRESS 0xC0000F2C /end MEASUREMENT
/begin MEASUREMENT InjCrv_swtPoI2AgAbsTDC_mp "Status des Betriebsmodus Ansteuerbeginn PoI2 (entweder Winkel absolut zum TDC oder Winkel bzw. Zeit relativ zur MI)" UBYTE OneToOne 1 100 0.00 255.0 FORMAT "%5.1" ECU_ADDRESS 0xC0000ECA /end MEASUREMENT
/begin MEASUREMENT InjCrv_tAirPoI2 "Selektierte Ansauglufttemperatur für die PoI 2" SWORD Temp_Cels 1 100 -3549.940 3003.560 FORMAT "%8.3" ECU_ADDRESS 0xD000727A /end MEASUREMENT
/begin MEASUREMENT InjCrv_tiPiI1BasStrt_mp "korrigierter Grundwert Zeitkomponente im Startzustand" SWORD InjTime_us 1 100 -13107.20 5000.00 FORMAT "%8.2" ECU_ADDRESS 0xC0000D90 /end MEASUREMENT
/begin MEASUREMENT InjCrv_tiPiI2AddCor "kundenspezifische Korrekturzeit für PiI2" SWORD InjTime_us 1 100 -13107.20 5000.00 FORMAT "%8.2" ECU_ADDRESS 0xD000729A /end MEASUREMENT
/begin MEASUREMENT InjCrv_tiPiI2AddCorRgn "kundenspezifische Korrekturzeit für PiI2 im Regenerationsbetrieb" SWORD InjTime_us 1 100 -13107.20 5000.00 FORMAT "%8.2" ECU_ADDRESS 0xD000729C /end MEASUREMENT
/begin MEASUREMENT InjCrv_tiPiI2AddCorStrt "PII2 SOE Zeit korrektur während des Motor start state" SWORD InjTime_us 1 100 -13107.20 5000.00 FORMAT "%8.2" ECU_ADDRESS 0xD000729E /end MEASUREMENT
/begin MEASUREMENT InjCrv_tiPiI2ATSCorRgn_mp "Ansauglufttemperaturabhängiger Basisansteuerungskorrekturwert der PiI2 im Regenerationsbetrieb" SWORD InjTime_us 1 100 -13107.20 5000.00 FORMAT "%8.2" ARRAY_SIZE 2 ECU_ADDRESS 0xC0000DDA /end MEASUREMENT
/begin MEASUREMENT InjCrv_tiPiI2ATSCor_mp "ansauglufttemperaturabhängiger Korrekturgrundwert für die Zeitkomponente des Ansteuerbeginns der PiI2" SWORD InjTime_us 1 100 -13107.20 5000.00 FORMAT "%8.2" ECU_ADDRESS 0xC0000DE2 /end MEASUREMENT
/begin MEASUREMENT InjCrv_tiPiI2BasRgn_mp "Basiswert Ansteuerbeginn der Voreinspritzung 2 im Regenerationsbetrieb" SWORD InjTime_us 1 100 -13107.20 5000.00 FORMAT "%8.2" ARRAY_SIZE 2 ECU_ADDRESS 0xC0000DF0 /end MEASUREMENT
/begin MEASUREMENT InjCrv_tiPiI2BasStrt_mp "korrigierter Grundwert Zeitkomponente im Startzustand" SWORD InjTime_us 1 100 -13107.20 5000.00 FORMAT "%8.2" ECU_ADDRESS 0xC0000E04 /end MEASUREMENT
/begin MEASUREMENT InjCrv_tiPiI2Bas_mp "Zeitkomponente Ansteuerbeginn PiI2 Grundwert" SWORD InjTime_us 1 100 -13107.20 5000.00 FORMAT "%8.2" ECU_ADDRESS 0xC0000DFE /end MEASUREMENT
/begin MEASUREMENT InjCrv_tiPiI2Cor_mp "korrigierter Grundwert der Zeitkomponente Ansteuerbeginn PiI2" SWORD InjTime_us 1 100 -13107.20 5000.00 FORMAT "%8.2" ECU_ADDRESS 0xC0000DAA /end MEASUREMENT
/begin MEASUREMENT InjCrv_tiPiI2EnvCor "Korrekturzeit für PiI2" SWORD InjTime_us 1 100 -13107.20 5000.00 FORMAT "%8.2" ECU_ADDRESS 0xD00072A2 /end MEASUREMENT
/begin MEASUREMENT InjCrv_tiPiI2EnvCorRgn "Ansteuerungskorrekturwert in Regenerationsbetrieb der PiI2" SWORD InjTime_us 1 100 -13107.20 5000.00 FORMAT "%8.2" ARRAY_SIZE 2 ECU_ADDRESS 0xD00072A4 /end MEASUREMENT
/begin MEASUREMENT InjCrv_tiPiI2ETSCorRgn_mp "Motortemperaturabhängiger Basisansteuerungskorrekturwert der PiI2 im Regenerationsbetrieb" SWORD InjTime_us 1 100 -13107.20 5000.00 FORMAT "%8.2" ARRAY_SIZE 2 ECU_ADDRESS 0xC0000DDE /end MEASUREMENT
/begin MEASUREMENT InjCrv_tiPiI2ETSCorStrt_mp "Motor Temperaturabhängiger PII2 SOE Zeit korrektur während des Motor start state" SWORD InjTime_us 1 100 -13107.20 5000.00 FORMAT "%8.2" ECU_ADDRESS 0xC0000DC2 /end MEASUREMENT
/begin MEASUREMENT InjCrv_tiPiI2ETSCor_mp "motortemperaturabhängiger Korrekturgrundwert für die Zeitkomponente des Ansteuerbeginns der PiI2" SWORD InjTime_us 1 100 -13107.20 5000.00 FORMAT "%8.2" ECU_ADDRESS 0xC0000DE4 /end MEASUREMENT
/begin MEASUREMENT InjCrv_tiPiI2ET_mp "geschätzte Ansteuerdauer PiI2" SWORD InjTime_us 1 100 -13107.20 5000.00 FORMAT "%8.2" ECU_ADDRESS 0xC0000DAC /end MEASUREMENT
/begin MEASUREMENT InjCrv_tiPiI2RelMI_mp "Zeitkomponente Ansteuerbeginn PiI2 relativ zur MI" SWORD InjTime_us 1 100 -13107.20 5000.00 FORMAT "%8.2" ECU_ADDRESS 0xC0000DAE /end MEASUREMENT
/begin MEASUREMENT InjCrv_tiPiI2RelPiI1_mp "Zeitkomponente Ansteuerbeginn PiI2 relativ zur PiI1" SWORD InjTime_us 1 100 -13107.20 5000.00 FORMAT "%8.2" ECU_ADDRESS 0xC0000DB0 /end MEASUREMENT
/begin MEASUREMENT InjCrv_tiPiI2RelTot_mp "Ansteuerbeginnabstand PiI2 aus Winkel- und Zeitkomponente" SWORD InjTime_us 1 100 -13107.20 5000.00 FORMAT "%8.2" ECU_ADDRESS 0xC0000DB2 /end MEASUREMENT
/begin MEASUREMENT InjCrv_tiPiI2Rgn "Regenerationswert für die Zeitkomponente des Ansteuerbeginns der PiI2" SWORD InjTime_us 1 100 -13107.20 5000.00 FORMAT "%8.2" ARRAY_SIZE 2 ECU_ADDRESS 0xD00072A8 /end MEASUREMENT
/begin MEASUREMENT InjCrv_tiPiI2RgnAdd_mp "Additiver Bypasseingriff für Zeit der Voreinspritzung 2 im Regenerationsbetrieb" SWORD InjTime_us 1 100 -13107.20 5000.00 FORMAT "%8.2" ARRAY_SIZE 2 ECU_ADDRESS 0xC0000DF4 /end MEASUREMENT
/begin MEASUREMENT InjCrv_tiPiI2Tot_mp "gesamte Ansteuerdauer der Pil2" SWORD InjTime_us 1 100 -13107.20 5000.00 FORMAT "%8.2" ECU_ADDRESS 0xC0000DB4 /end MEASUREMENT
/begin MEASUREMENT InjCrv_tiPiI3ET_mp "geschätzte Ansteuerdauer PiI3" SWORD InjTime_us 1 100 -13107.20 5000.00 FORMAT "%8.2" ECU_ADDRESS 0xC0000E20 /end MEASUREMENT
/begin MEASUREMENT InjCrv_tiPoI1ET_mp "geschätzte Ansteuerdauer PoI1" SWORD InjTime_us 1 100 -13107.20 5000.00 FORMAT "%8.2" ECU_ADDRESS 0xC0000E62 /end MEASUREMENT
/begin MEASUREMENT InjCrv_tiPoI1OvrRunRgn_mp "Entprellzähler für die Deaktivierung der PoI1 im Schub" SLONG Time_ms 1 100 -21474836480.0 21474836470.0 FORMAT "%13.1" ECU_ADDRESS 0xC0000E88 /end MEASUREMENT
/begin MEASUREMENT InjCrv_tiPoI2AddCor "kundenspezifische Korrekturzeit für PoI2" SWORD InjTime_us 1 100 -13107.20 5000.00 FORMAT "%8.2" ECU_ADDRESS 0xD00072AC /end MEASUREMENT
/begin MEASUREMENT InjCrv_tiPoI2APSCorRgn_mp "Gewichtete Zeit korrekturen abhängig von dem Umgebungsluftdruck für die PoI2 im Regenerationsbetrieb" SWORD InjTime_us 1 100 -13107.20 5000.00 FORMAT "%8.2" ARRAY_SIZE 2 ECU_ADDRESS 0xC0000EF4 /end MEASUREMENT
/begin MEASUREMENT InjCrv_tiPoI2ATSCor_mp "ansauglufttemperaturabhängiger Korrekturgrundwert für die Zeitkomponente des Ansteuerbeginns der PoI2" SWORD InjTime_us 1 100 -13107.20 5000.00 FORMAT "%8.2" ECU_ADDRESS 0xC0000EFC /end MEASUREMENT
/begin MEASUREMENT InjCrv_tiPoI2BasRgn_mp "Grundwert der Zeit komponente Ansteuerbeginn PoI2 im Regenerationsbetrieb" SWORD InjTime_us 1 100 -13107.20 5000.00 FORMAT "%8.2" ARRAY_SIZE 2 ECU_ADDRESS 0xC0000F12 /end MEASUREMENT
/begin MEASUREMENT InjCrv_tiPoI2Bas_mp "Zeitkomponente Ansteuerbeginn PoI2 Grundwert" SWORD InjTime_us 1 100 -13107.20 5000.00 FORMAT "%8.2" ECU_ADDRESS 0xC0000F30 /end MEASUREMENT
/begin MEASUREMENT InjCrv_tiPoI2Byp_mp "Messpunkt für den Bypass" SWORD InjTime_us 1 100 -13107.20 5000.00 FORMAT "%8.2" ECU_ADDRESS 0xC0000ECC /end MEASUREMENT
/begin MEASUREMENT InjCrv_tiPoI2Cor_mp "korrigierter Grundwert der Zeitkomponente Ansteuerbeginn PoI2" SWORD InjTime_us 1 100 -13107.20 5000.00 FORMAT "%8.2" ECU_ADDRESS 0xC0000ECE /end MEASUREMENT
/begin MEASUREMENT InjCrv_tiPoI2Des "gewünschte Bezugszeitkomponente für Beginn PoI2" SWORD InjTime_us 1 100 -13107.20 5000.00 FORMAT "%8.2" ECU_ADDRESS 0xD00072AE /end MEASUREMENT
/begin MEASUREMENT InjCrv_tiPoI2DesAdd_mp "Additiver Bypasseingriff für gewünschte Zeit der Nacheinspritzung 2" SWORD InjTime_us 1 100 -13107.20 5000.00 FORMAT "%8.2" ECU_ADDRESS 0xC0000ED0 /end MEASUREMENT
/begin MEASUREMENT InjCrv_tiPoI2EnvCor "Korrekturzeit für PoI2" SWORD InjTime_us 1 100 -13107.20 5000.00 FORMAT "%8.2" ECU_ADDRESS 0xD00072B0 /end MEASUREMENT
/begin MEASUREMENT InjCrv_tiPoI2EnvCorRgn "Umgebungsbedingungsabhängige Korrektur Zeit für Nacheinspritzung 2 im Regenerationsbetrieb" SWORD InjTime_us 1 100 -13107.20 5000.00 FORMAT "%8.2" ARRAY_SIZE 2 ECU_ADDRESS 0xD00072B2 /end MEASUREMENT
/begin MEASUREMENT InjCrv_tiPoI2ETSCorRgn_mp "Gewichtete Zeit korrekturen abhängig von der Motortemperatur für die PoI2 im Regenerationsbetrieb" SWORD InjTime_us 1 100 -13107.20 5000.00 FORMAT "%8.2" ARRAY_SIZE 2 ECU_ADDRESS 0xC0000EF8 /end MEASUREMENT
/begin MEASUREMENT InjCrv_tiPoI2ETSCor_mp "motortemperaturabhängiger Korrekturgrundwert für die Zeitkomponente des Ansteuerbeginns der PoI2" SWORD InjTime_us 1 100 -13107.20 5000.00 FORMAT "%8.2" ECU_ADDRESS 0xC0000EFE /end MEASUREMENT
/begin MEASUREMENT InjCrv_tiPoI2Max_mp "maximaler Ansteuerbeginn PoI2 relativ zur Haupteinspritzung" SWORD InjTime_us 1 100 -13107.20 5000.00 FORMAT "%8.2" ECU_ADDRESS 0xC0000ED2 /end MEASUREMENT
/begin MEASUREMENT InjCrv_tiPoI2RelTot_mp "Ansteuerbeginnabstand PoI2 aus Winkel- und Zeitkomponente" SWORD InjTime_us 1 100 -13107.20 5000.00 FORMAT "%8.2" ECU_ADDRESS 0xC0000ED4 /end MEASUREMENT
/begin MEASUREMENT InjCrv_tiPoI2Rel_mp "Zeitkomponente Ansteuerbeginn PoI2 relativ zur Haupteinspritzung" SWORD InjTime_us 1 100 -13107.20 5000.00 FORMAT "%8.2" ECU_ADDRESS 0xC0000ED6 /end MEASUREMENT
/begin MEASUREMENT InjCrv_tiPoI2Rgn "Grundwert der Zeit komponente Ansteuerbeginn PoI2 im Regenerationsbetrieb" SWORD InjTime_us 1 100 -13107.20 5000.00 FORMAT "%8.2" ARRAY_SIZE 2 ECU_ADDRESS 0xD00072B6 /end MEASUREMENT
/begin MEASUREMENT InjCrv_volPiI2Cor_mp "korrigiertes Einspritzvolumen zur Ansteuerdauerabschätzung der PiI2" SWORD InjQntInj 1 100 -327.6800 327.6700 FORMAT "%8.4" ECU_ADDRESS 0xC0000DB6 /end MEASUREMENT
/begin MEASUREMENT InjCrv_volPiI2_mp "begrenztes Einspritzvolumen PiI2" SWORD InjQntInj 1 100 -327.6800 327.6700 FORMAT "%8.4" ECU_ADDRESS 0xC0000DB8 /end MEASUREMENT
/begin MEASUREMENT InjCrv_volPiI3_mp "begrenztes Einspritzvolumen PiI3" SWORD InjQntInj 1 100 -327.6800 327.6700 FORMAT "%8.4" ECU_ADDRESS 0xC0000E22 /end MEASUREMENT
/begin MEASUREMENT InjCrv_volPoI1_mp "begrenztes Einspritzvolumen PoI1" SWORD InjQntInj 1 100 -327.6800 327.6700 FORMAT "%8.4" ECU_ADDRESS 0xC0000E64 /end MEASUREMENT
/begin FUNCTION InjCrv_PiI1SOETiBas ""
 /begin DEF_CHARACTERISTIC InjCrv_tiPiI1Bas1_MAP InjCrv_tiPiI1Bas2_MAP InjCrv_tiPiI1Bas3_MAP /end DEF_CHARACTERISTIC
 /begin IN_MEASUREMENT Epm_nEng InjCtl_qSetUnBal /end IN_MEASUREMENT
/end FUNCTION
/begin FUNCTION InjCrv_PiI1Strt "" /begin DEF_CHARACTERISTIC InjCrv_qPiI1BasStrt_MAP InjCrv_tiPiI1BasStrt_MAP /end DEF_CHARACTERISTIC
 /begin IN_MEASUREMENT CoEng_st Epm_nEng InjCrv_qPiI1AddCorStrt InjCrv_tiPiI1AddCorStrt InjCtl_qSetUnBal /end IN_MEASUREMENT
 /begin LOC_MEASUREMENT InjCrv_qPiI1BasStrt_mp InjCrv_tiPiI1BasStrt_mp /end LOC_MEASUREMENT
/end FUNCTION
/begin FUNCTION InjCrv_PiI2 ""
 /begin DEF_CHARACTERISTIC InjCrv_facPiI1QntMax_C InjCrv_facPiI2QntMin_CUR InjCrv_nDiffMin_C InjCrv_phiPiI2Des_C InjCrv_qDiffMin_C InjCrv_qMI1MinPiI2DiffHys_C InjCrv_qPiI1WvCorMax_C InjCrv_qPiI2Bas_MAP InjCrv_qPiI2Des_C InjCrv_qPiI2Max_MAP InjCrv_qPiI2MinDiff_C InjCrv_swtPhiPiI2Des_C InjCrv_swtQntPiI2Des_C InjCrv_swtTiPiI2Des_C InjCrv_tiPiI2Des_C /end DEF_CHARACTERISTIC
 /begin REF_CHARACTERISTIC InjCrv_phiPiIMax_C InjCrv_stInjDstSel_C InjCrv_tiPiIMax_C /end REF_CHARACTERISTIC
 /begin IN_MEASUREMENT Epm_ctCyl Epm_nEng Epm_numCyl FlSys_rhoFl InjCrv_phiPiI2AddCor InjCrv_phiPiI2Des InjCrv_phiPiI2EnvCor InjCrv_qPiI2AddCor InjCrv_qPiI2Des InjCrv_qPiI2EnvCor InjCrv_stPiI2Rgn InjCrv_tiPiI2AddCor InjCrv_tiPiI2Des InjCrv_tiPiI2EnvCor InjCtl_qSetUnBal InjVlv_tiPse InjVlv_volPiI2CorCyc QWC_st RailP_pFlt /end IN_MEASUREMENT
 /begin LOC_MEASUREMENT InjCrv_facPiI2QntMin_mp InjCrv_phiPiI2AbsTot_mp InjCrv_phiPiI2Abs_mp InjCrv_phiPiI2Cor_mp InjCrv_phiPiI2Rel_mp InjCrv_qMI1MinPiI2_mp InjCrv_qPiI2Bas_mp InjCrv_qPiI2Max_mp InjCrv_qPiI2SetLimMax_mp InjCrv_qPiI2SetLim_mp InjCrv_qPiI2Set_mp InjCrv_stPiI2_mp InjCrv_tiPiI2Cor_mp InjCrv_tiPiI2ET_mp InjCrv_tiPiI2RelMI_mp InjCrv_tiPiI2RelPiI1_mp InjCrv_tiPiI2RelTot_mp InjCrv_tiPiI2Tot_mp InjCrv_volPiI2Cor_mp InjCrv_volPiI2_mp /end LOC_MEASUREMENT
/end FUNCTION
/begin FUNCTION InjCrv_PiI2AddCor ""
 /begin DEF_CHARACTERISTIC InjCrv_phiPiI2ETSCorStrt_MAP InjCrv_qPiI2APSCorStrt_MAP InjCrv_qPiI2ATSCorStrt_MAP InjCrv_qPiI2ETSCorStrt_MAP InjCrv_tiPiI2ETSCorStrt_MAP /end DEF_CHARACTERISTIC
 /begin IN_MEASUREMENT CoEng_st Epm_nEng InjCrv_facPiI2APSQCorStrt InjCrv_facPiI2ATSQCorStrt InjCrv_facPiI2ETSQCorStrt InjCrv_facPiI2ETSSOECorStrt InjCrv_stPiI2Rgn InjCrv_stPiI2RgnTSync InjCtl_qSetUnBal /end IN_MEASUREMENT
 /begin OUT_MEASUREMENT InjCrv_phiPiI2AddCor InjCrv_phiPiI2AddCorStrt InjCrv_qPiI2AddCor InjCrv_qPiI2AddCorStrt InjCrv_tiPiI2AddCor InjCrv_tiPiI2AddCorStrt /end OUT_MEASUREMENT
 /begin LOC_MEASUREMENT InjCrv_phiPiI2ETSCorStrt_mp InjCrv_qPiI2APSQCorStrt_mp InjCrv_qPiI2ATSQCorStrt_mp InjCrv_qPiI2ETSQCorStrt_mp InjCrv_tiPiI2ETSCorStrt_mp /end LOC_MEASUREMENT
/end FUNCTION
/begin FUNCTION InjCrv_PiI2AddCorRgn "" /begin OUT_MEASUREMENT InjCrv_qPiI2AddCorRgn InjCrv_tiPiI2AddCorRgn /end OUT_MEASUREMENT /end FUNCTION
/begin FUNCTION injcrv_pii2addcorslow ""
 /begin DEF_CHARACTERISTIC InjCrv_facPiI2APSQCorStrt_CUR InjCrv_facPiI2ATSQCorStrt_CUR InjCrv_facPiI2ETSQCorStrt_CUR InjCrv_facPiI2ETSSOECorStrt_CUR /end DEF_CHARACTERISTIC
 /begin IN_MEASUREMENT CoEng_st EnvP_p InjCrv_tAirPiI InjSys_tEng /end IN_MEASUREMENT
 /begin OUT_MEASUREMENT InjCrv_facPiI2APSQCorStrt InjCrv_facPiI2ATSQCorStrt InjCrv_facPiI2ETSQCorStrt InjCrv_facPiI2ETSSOECorStrt /end OUT_MEASUREMENT
/end FUNCTION
/begin FUNCTION InjCrv_PiI2EnvCor ""
 /begin DEF_CHARACTERISTIC InjCrv_qPiI2APSCor_MAP InjCrv_qPiI2ATSCor_MAP InjCrv_qPiI2ETSCor_MAP /end DEF_CHARACTERISTIC
 /begin IN_MEASUREMENT Epm_nEng InjCrv_facPiI2APSQCor InjCrv_facPiI2ATSQCor InjCrv_facPiI2ATSSOECor InjCrv_facPiI2ETSQCor InjCrv_facPiI2ETSSOECor InjCrv_stPiI2RgnTSync InjCtl_qSetUnBal /end IN_MEASUREMENT
 /begin OUT_MEASUREMENT InjCrv_phiPiI2EnvCor InjCrv_qPiI2EnvCor InjCrv_tiPiI2EnvCor /end OUT_MEASUREMENT
 /begin LOC_MEASUREMENT InjCrv_qPiI2APSCor_mp InjCrv_qPiI2ATSCor_mp InjCrv_qPiI2ETSCor_mp /end LOC_MEASUREMENT
/end FUNCTION
/begin FUNCTION InjCrv_PiI2EnvCorPhi "" /begin LOC_MEASUREMENT InjCrv_phiPiI2ATSCor_mp InjCrv_phiPiI2ETSCor_mp /end LOC_MEASUREMENT /end FUNCTION
/begin FUNCTION InjCrv_PiI2EnvCorRgn ""
 /begin DEF_CHARACTERISTIC InjCrv_qPiI2APSCor0Rgn_GMAP InjCrv_qPiI2APSCor1Rgn_GMAP InjCrv_qPiI2APSCorRgnX_AXIS InjCrv_qPiI2APSCorRgnY_AXIS InjCrv_qPiI2ATSCor0Rgn_GMAP InjCrv_qPiI2ATSCor1Rgn_GMAP InjCrv_qPiI2ATSCorRgnX_AXIS InjCrv_qPiI2ATSCorRgnY_AXIS InjCrv_qPiI2ETSCor0Rgn_GMAP InjCrv_qPiI2ETSCor1Rgn_GMAP InjCrv_qPiI2ETSCorRgnX_AXIS InjCrv_qPiI2ETSCorRgnY_AXIS InjCrv_tiPiI2ATSCor0Rgn_GMAP InjCrv_tiPiI2ATSCor1Rgn_GMAP InjCrv_tiPiI2ATSCorRgnX_AXIS InjCrv_tiPiI2ATSCorRgnY_AXIS InjCrv_tiPiI2ETSCor0Rgn_GMAP InjCrv_tiPiI2ETSCor1Rgn_GMAP InjCrv_tiPiI2ETSCorRgnX_AXIS InjCrv_tiPiI2ETSCorRgnY_AXIS /end DEF_CHARACTERISTIC
 /begin IN_MEASUREMENT Epm_nEng InjCrv_facPiI2APSQCorRgn InjCrv_facPiI2ATSQCorRgn InjCrv_facPiI2ATSSOECorRgn InjCrv_facPiI2ETSQCorRgn InjCrv_facPiI2ETSSOECorRgn InjCrv_stPiI2RgnTSync InjCtl_qSetUnBal /end IN_MEASUREMENT
 /begin OUT_MEASUREMENT InjCrv_qPiI2EnvCorRgn InjCrv_tiPiI2EnvCorRgn /end OUT_MEASUREMENT
 /begin LOC_MEASUREMENT InjCrv_qPiI2APSCorRgn_mp InjCrv_qPiI2ATSCorRgn_mp InjCrv_qPiI2ETSCorRgn_mp InjCrv_tiPiI2ATSCorRgn_mp InjCrv_tiPiI2ETSCorRgn_mp /end LOC_MEASUREMENT
/end FUNCTION
/begin FUNCTION InjCrv_PiI2EnvCorSlow ""
 /begin DEF_CHARACTERISTIC InjCrv_facPiI2APSQCor_CUR InjCrv_facPiI2ATSQCor_CUR InjCrv_facPiI2ATSSOECor_CUR InjCrv_facPiI2ETSQCor_CUR InjCrv_facPiI2ETSSOECor_CUR /end DEF_CHARACTERISTIC
 /begin IN_MEASUREMENT EnvP_p InjCrv_tAirPiI InjSys_tEng /end IN_MEASUREMENT
 /begin OUT_MEASUREMENT InjCrv_facPiI2APSQCor InjCrv_facPiI2ATSQCor InjCrv_facPiI2ATSSOECor InjCrv_facPiI2ETSQCor InjCrv_facPiI2ETSSOECor /end OUT_MEASUREMENT
/end FUNCTION
/begin FUNCTION InjCrv_PiI2EnvCorSlowRgn ""
 /begin DEF_CHARACTERISTIC InjCrv_facPiI2APSQCor0Rgn_GCUR InjCrv_facPiI2APSQCor1Rgn_GCUR InjCrv_facPiI2APSQCorRgn_AXIS InjCrv_facPiI2ATSQCor0Rgn_GCUR InjCrv_facPiI2ATSQCor1Rgn_GCUR InjCrv_facPiI2ATSQCorRgn_AXIS InjCrv_facPiI2ATSSOECor0Rgn_GCUR InjCrv_facPiI2ATSSOECor1Rgn_GCUR InjCrv_facPiI2ATSSOECorRgn_AXIS InjCrv_facPiI2ETSQCor0Rgn_GCUR InjCrv_facPiI2ETSQCor1Rgn_GCUR InjCrv_facPiI2ETSQCorRgn_AXIS InjCrv_facPiI2ETSSOECor0Rgn_GCUR InjCrv_facPiI2ETSSOECor1Rgn_GCUR InjCrv_facPiI2ETSSOECorRgn_AXIS /end DEF_CHARACTERISTIC
 /begin IN_MEASUREMENT EnvP_p InjCrv_tAirPiI InjSys_tEng /end IN_MEASUREMENT
 /begin OUT_MEASUREMENT InjCrv_facPiI2APSQCorRgn InjCrv_facPiI2ATSQCorRgn InjCrv_facPiI2ATSSOECorRgn InjCrv_facPiI2ETSQCorRgn InjCrv_facPiI2ETSSOECorRgn /end OUT_MEASUREMENT
/end FUNCTION
/begin FUNCTION InjCrv_PiI2EnvCorTi "" /begin DEF_CHARACTERISTIC InjCrv_tiPiI2ATSCor_MAP InjCrv_tiPiI2ETSCor_MAP /end DEF_CHARACTERISTIC /begin IN_MEASUREMENT Epm_nEng InjCtl_qSetUnBal /end IN_MEASUREMENT /begin LOC_MEASUREMENT InjCrv_tiPiI2ATSCor_mp InjCrv_tiPiI2ETSCor_mp /end LOC_MEASUREMENT /end FUNCTION
/begin FUNCTION InjCrv_PiI2Rgn ""
 /begin DEF_CHARACTERISTIC InjCrv_qPiI2Bas0Rgn_GMAP InjCrv_qPiI2Bas1Rgn_GMAP InjCrv_qPiI2BasRgnX_AXIS InjCrv_qPiI2BasRgnY_AXIS InjCrv_qPiI2MaxRgn_MAP InjCrv_tiPiI2Bas0Rgn_GMAP InjCrv_tiPiI2Bas1Rgn_GMAP InjCrv_tiPiI2BasRgnX_AXIS InjCrv_tiPiI2BasRgnY_AXIS /end DEF_CHARACTERISTIC
 /begin IN_MEASUREMENT Epm_nEng InjCrv_qPiI2AddCorRgn InjCrv_qPiI2EnvCorRgn InjCrv_stPiI2Rgn InjCrv_tiPiI2AddCorRgn InjCrv_tiPiI2EnvCorRgn InjCtl_qSetUnBal /end IN_MEASUREMENT
 /begin OUT_MEASUREMENT InjCrv_qPiI2Rgn InjCrv_tiPiI2Rgn /end OUT_MEASUREMENT
 /begin LOC_MEASUREMENT InjCrv_qPiI2BasRgn_mp InjCrv_qPiI2MaxRgn_mp InjCrv_qPiI2RgnAdd_mp InjCrv_tiPiI2BasRgn_mp InjCrv_tiPiI2RgnAdd_mp /end LOC_MEASUREMENT
/end FUNCTION
/begin FUNCTION InjCrv_PiI2RgnLib ""
 /begin DEF_CHARACTERISTIC InjCrv_facPiI2QntRmp0Val_GCUR InjCrv_facPiI2QntRmp1Val_GCUR InjCrv_facPiI2QntRmpValX_AXIS InjCrv_facPiI2SOERmp0Val_GCUR InjCrv_facPiI2SOERmp1Val_GCUR InjCrv_facPiI2SOERmpValX_AXIS /end DEF_CHARACTERISTIC
 /begin IN_MEASUREMENT CoEOM_facRmpVal InjCrv_qPiI2Rgn InjCrv_stPiI2Rgn InjCrv_stPiI2RmpSel InjCrv_tiPiI2Rgn /end IN_MEASUREMENT
 /begin LOC_MEASUREMENT InjCrv_facPiI2QntRmpVal_mp InjCrv_facPiI2SOERmpVal_mp /end LOC_MEASUREMENT
/end FUNCTION
/begin FUNCTION InjCrv_PiI2SOEPhiBas "" /begin LOC_MEASUREMENT InjCrv_phiPiI2Bas_mp /end LOC_MEASUREMENT /end FUNCTION
/begin FUNCTION InjCrv_PiI2SOETiBas "" /begin DEF_CHARACTERISTIC InjCrv_tiPiI2Bas_MAP /end DEF_CHARACTERISTIC /begin IN_MEASUREMENT Epm_nEng InjCtl_qSetUnBal /end IN_MEASUREMENT /begin LOC_MEASUREMENT InjCrv_tiPiI2Bas_mp /end LOC_MEASUREMENT /end FUNCTION
/begin FUNCTION InjCrv_PiI2Strt ""
 /begin DEF_CHARACTERISTIC InjCrv_phiPiI2BasStrt_MAP InjCrv_qPiI2BasStrt_MAP InjCrv_tiPiI2BasStrt_MAP /end DEF_CHARACTERISTIC
 /begin IN_MEASUREMENT Epm_nEng InjCtl_qSetUnBal /end IN_MEASUREMENT
 /begin LOC_MEASUREMENT InjCrv_phiPiI2BasStrt_mp InjCrv_qPiI2BasStrt_mp InjCrv_tiPiI2BasStrt_mp /end LOC_MEASUREMENT
/end FUNCTION
/begin FUNCTION InjCrv_PiI3 ""
 /begin DEF_CHARACTERISTIC InjCrv_facPiI3QntMin_CUR InjCrv_phiPiI3Bas1_MAP InjCrv_phiPiI3Bas2_MAP InjCrv_phiPiI3Des_C InjCrv_qMI1MinPiI3DiffHys_C InjCrv_qPiI3Bas_MAP InjCrv_qPiI3Des_C InjCrv_qPiI3Max_MAP InjCrv_qPiI3MinDiff_C InjCrv_swtPhiPiI3Des_C InjCrv_swtQntPiI3Des_C /end DEF_CHARACTERISTIC
 /begin REF_CHARACTERISTIC InjCrv_phiPiIMax_C /end REF_CHARACTERISTIC
 /begin IN_MEASUREMENT Epm_ctCyl Epm_nEng Epm_numCyl FlSys_rhoFl InjCrv_phiMI1Des InjCrv_phiPiI3AddCor InjCrv_phiPiI3Des InjCrv_phiPiI3EnvCor InjCrv_qPiI3AddCor InjCrv_qPiI3Des InjCrv_qPiI3EnvCor InjCrv_stPiI3Rgn InjCtl_qSetUnBal InjVlv_tiPse RailP_pFlt /end IN_MEASUREMENT
 /begin LOC_MEASUREMENT InjCrv_facPiI3QntMin_mp InjCrv_phiPiI3Bas_mp InjCrv_phiPiI3Cor_mp InjCrv_phiPiI3SetLim_mp InjCrv_phiPiI3Set_mp InjCrv_phiPiI3Tot_mp InjCrv_qMI1MinPiI3_mp InjCrv_qPiI3Bas_mp InjCrv_qPiI3Max_mp InjCrv_qPiI3SetLimMax_mp InjCrv_qPiI3SetLim_mp InjCrv_qPiI3Set_mp InjCrv_stPiI3_mp InjCrv_tiPiI3ET_mp InjCrv_volPiI3_mp /end LOC_MEASUREMENT
/end FUNCTION
/begin FUNCTION InjCrv_PiI3AddCor "" /begin OUT_MEASUREMENT InjCrv_phiPiI3AddCor InjCrv_qPiI3AddCor /end OUT_MEASUREMENT /end FUNCTION
/begin FUNCTION InjCrv_PiI3EnvCor ""
 /begin DEF_CHARACTERISTIC InjCrv_phiPiI3ETSCor_MAP InjCrv_qPiI3APSCor_MAP InjCrv_qPiI3ATSCor_MAP InjCrv_qPiI3ETSCor_MAP /end DEF_CHARACTERISTIC
 /begin IN_MEASUREMENT Epm_nEng InjCrv_facPiI3APSQCor InjCrv_facPiI3ATSQCor InjCrv_facPiI3ETSQCor InjCrv_facPiI3ETSSOECor InjCrv_stPiI3RgnTSync InjCtl_qSetUnBal /end IN_MEASUREMENT
 /begin OUT_MEASUREMENT InjCrv_phiPiI3EnvCor InjCrv_qPiI3EnvCor /end OUT_MEASUREMENT
 /begin LOC_MEASUREMENT InjCrv_phiPiI3ETSCor_mp InjCrv_qPiI3APSCor_mp InjCrv_qPiI3ATSCor_mp InjCrv_qPiI3ETSCor_mp /end LOC_MEASUREMENT
/end FUNCTION
/begin FUNCTION InjCrv_PiI3EnvCorSlow ""
 /begin DEF_CHARACTERISTIC InjCrv_facPiI3APSQCor_CUR InjCrv_facPiI3ATSQCor_CUR InjCrv_facPiI3ETSQCor_CUR InjCrv_facPiI3ETSSOECor_CUR /end DEF_CHARACTERISTIC
 /begin IN_MEASUREMENT EnvP_p InjCrv_tAirPiI InjSys_tEng /end IN_MEASUREMENT
 /begin OUT_MEASUREMENT InjCrv_facPiI3APSQCor InjCrv_facPiI3ATSQCor InjCrv_facPiI3ETSQCor InjCrv_facPiI3ETSSOECor /end OUT_MEASUREMENT
/end FUNCTION
/begin FUNCTION InjCrv_PiI3RgnLib "" /end FUNCTION
/begin FUNCTION InjCrv_PiI3Strt "" /end FUNCTION
/begin FUNCTION InjCrv_PoI1 ""
 /begin DEF_CHARACTERISTIC InjCrv_ctCylPoI1Clsn_C InjCrv_facPoI1QntMin_C InjCrv_phiDynOfs_CUR InjCrv_phiPoI1Bas_MAP InjCrv_phiPoI1Des_C InjCrv_phiPoI1Max_MAP InjCrv_qPoI1Bas_MAP InjCrv_qPoI1Des_C InjCrv_qPoI1Max_MAP InjCrv_swtPhiPoI1Des_C InjCrv_swtPoI1Clsn_C InjCrv_swtQntPoI1Des_C /end DEF_CHARACTERISTIC
 /begin REF_CHARACTERISTIC InjCrv_stInjCharActVal_C InjCrv_swtStInjCharActVal_C /end REF_CHARACTERISTIC
 /begin IN_MEASUREMENT CoEng_stShutOffPath Epm_ctCyl Epm_nEng Epm_numCyl FlSys_rhoFl InjCrv_phiMI1Des InjCrv_phiPiI1Des InjCrv_phiPiI2Des InjCrv_phiPiI3Des InjCrv_phiPoI1AddCor InjCrv_phiPoI1EnvCor InjCrv_qPoI1AddCor InjCrv_qPoI1EnvCor InjCrv_stInjCharActVal InjCrv_stInjCharActValPrg InjCrv_stInjCharRlsPrgVal InjCrv_stInjCharSetVal InjCrv_stPoI1Rgn InjCrv_tiPiI1Des InjCrv_tiPiI2Des InjCtl_qSetUnBal InjVlv_tiPse RailP_pFlt /end IN_MEASUREMENT
 /begin OUT_MEASUREMENT InjCrv_phiPoI1Des InjCrv_qPoI1Des /end OUT_MEASUREMENT
 /begin LOC_MEASUREMENT InjCrv_phiDynOfs_mp InjCrv_phiNxtCylBnk_mp InjCrv_phiNxtCyl_mp InjCrv_phiPoI1Bas_mp InjCrv_phiPoI1DesAddByp_mp InjCrv_phiPoI1DesAdd_mp InjCrv_phiPoI1DesByp_mp InjCrv_phiPoI1Dur_mp InjCrv_phiPoI1Lim_mp InjCrv_phiPoI1Min_mp InjCrv_phiPoI1Set_mp InjCrv_qPoI1Bas_mp InjCrv_qPoI1Clsn InjCrv_qPoI1Cor_mp InjCrv_qPoI1DesAddByp_mp InjCrv_qPoI1DesAdd_mp InjCrv_qPoI1DesByp_mp InjCrv_qPoI1Des_mp InjCrv_qPoI1Lim_mp InjCrv_qPoI1Max_mp InjCrv_qPoI1Min_mp InjCrv_qPoI1Set_mp InjCrv_stPoI1_mp InjCrv_tiPoI1ET_mp InjCrv_volPoI1_mp /end LOC_MEASUREMENT
/end FUNCTION
/begin FUNCTION InjCrv_PoI1AddCor "" /begin OUT_MEASUREMENT InjCrv_phiPoI1AddCor InjCrv_qPoI1AddCor /end OUT_MEASUREMENT /begin LOC_MEASUREMENT InjCrv_POpPoI1AddCor /end LOC_MEASUREMENT /end FUNCTION
/begin FUNCTION InjCrv_PoI1AddCorRgn "" /begin OUT_MEASUREMENT InjCrv_phiPoI1AddCorRgn InjCrv_qPoI1AddCorRgn /end OUT_MEASUREMENT /end FUNCTION
/begin FUNCTION InjCrv_PoI1EnvCor ""
 /begin DEF_CHARACTERISTIC InjCrv_phiPoI1ETSCor_MAP InjCrv_qPoI1APSCor_MAP InjCrv_qPoI1ETSCor_MAP /end DEF_CHARACTERISTIC
 /begin IN_MEASUREMENT Epm_nEng InjCrv_facPoI1APSQCor InjCrv_facPoI1ETSPhiCor InjCrv_facPoI1ETSQCor InjCrv_stPoI1RgnTSync InjCtl_qSetUnBal /end IN_MEASUREMENT
 /begin OUT_MEASUREMENT InjCrv_phiPoI1EnvCor InjCrv_qPoI1EnvCor /end OUT_MEASUREMENT
 /begin LOC_MEASUREMENT InjCrv_qPoI1APSCor_mp InjCrv_qPoI1ETSCor_mp /end LOC_MEASUREMENT
/end FUNCTION
/begin FUNCTION InjCrv_PoI1EnvCorSlow ""
 /begin DEF_CHARACTERISTIC InjCrv_facPoI1APSQCor_CUR InjCrv_facPoI1ETSPhiCor_CUR InjCrv_facPoI1ETSQCor_CUR InjCrv_POpPoI1ETSCor_CUR /end DEF_CHARACTERISTIC
 /begin IN_MEASUREMENT EnvP_p InjSys_tEng /end IN_MEASUREMENT
 /begin OUT_MEASUREMENT InjCrv_facPoI1APSQCor InjCrv_facPoI1ETSPhiCor InjCrv_facPoI1ETSQCor /end OUT_MEASUREMENT
 /begin LOC_MEASUREMENT InjCrv_POpPoI1EnvCor /end LOC_MEASUREMENT
/end FUNCTION
/begin FUNCTION InjCrv_PoI1Rgn ""
 /begin DEF_CHARACTERISTIC InjCrv_phiPoI1Bas0Rgn_GMAP InjCrv_phiPoI1Bas1Rgn_GMAP InjCrv_phiPoI1BasRgnX_AXIS InjCrv_phiPoI1BasRgnY_AXIS InjCrv_qPoI1Bas0Rgn_GMAP InjCrv_qPoI1Bas1Rgn_GMAP InjCrv_qPoI1BasRgnX_AXIS InjCrv_qPoI1BasRgnY_AXIS /end DEF_CHARACTERISTIC
 /begin IN_MEASUREMENT Epm_nEng InjCrv_phiPoI1AddCorRgn InjCrv_qPoI1AddCorRgn InjCrv_stPoI1Rgn InjCtl_qSetUnBal /end IN_MEASUREMENT
 /begin OUT_MEASUREMENT InjCrv_phiPoI1Rgn InjCrv_qPoI1Rgn /end OUT_MEASUREMENT
 /begin LOC_MEASUREMENT InjCrv_phiPoI1BasRgn_mp InjCrv_phiPoI1RgnAdd_mp InjCrv_qPoI1BasRgn_mp InjCrv_qPoI1RgnAdd_mp /end LOC_MEASUREMENT
/end FUNCTION
/begin FUNCTION InjCrv_PoI1RgnLib ""
 /begin DEF_CHARACTERISTIC InjCrv_facPoI1QntRmp0Val_GCUR InjCrv_facPoI1QntRmp1Val_GCUR InjCrv_facPoI1QntRmpValX_AXIS InjCrv_facPoI1SOERmp0Val_GCUR InjCrv_facPoI1SOERmp1Val_GCUR InjCrv_facPoI1SOERmpValX_AXIS /end DEF_CHARACTERISTIC
 /begin IN_MEASUREMENT CoEOM_facRmpVal InjCrv_phiPoI1Rgn InjCrv_qPoI1Rgn InjCrv_stPoI1Rgn InjCrv_stPoI1RmpSel /end IN_MEASUREMENT
 /begin LOC_MEASUREMENT InjCrv_facPoI1QntRmpVal_mp InjCrv_facPoI1SOERmpVal_mp /end LOC_MEASUREMENT
/end FUNCTION
/begin FUNCTION InjCrv_PoI1Rls ""
 /begin DEF_CHARACTERISTIC InjCrv_POpPoI1Bas_MAP InjCrv_POpPoI1High_C InjCrv_POpPoI1Low_C InjCrv_POpPoI1RgnHigh_C InjCrv_POpPoI1RgnLow_C InjCrv_POpPoI1Rgn_MAP InjCrv_stPoI1AddRlsMsk_C InjCrv_stPoI1OvrRunRgnMsk_C InjCrv_stPoI1RgnMsk_CA InjCrv_stPoI1RgnRlsMsk_C InjCrv_stPoI1RmpSel_CA InjCrv_tiPoI1OvrRunRgnDeb_C InjCrv_tiPoI1OvrRunRgnMax_C /end DEF_CHARACTERISTIC
 /begin IN_MEASUREMENT CoEOM_facRmpVal Epm_nEng InjCrv_stPoI1RmpSelTSync InjCtl_qSetUnBal PthSet_stOvrRun /end IN_MEASUREMENT
 /begin LOC_MEASUREMENT InjCrv_POpPoI1Bas_mp InjCrv_POpPoI1Rgn_mp InjCrv_POpPoI1_mp InjCrv_stActValPoI1_mp InjCrv_stDesValPoI1_mp InjCrv_stPoI1RlsDes_mp InjCrv_tiPoI1OvrRunRgn_mp /end LOC_MEASUREMENT
/end FUNCTION
/begin FUNCTION InjCrv_PoI2 ""
 /begin DEF_CHARACTERISTIC InjCrv_facPoI2Eff_MAP InjCrv_facPoI2QntMin_C InjCrv_phiPoI2Des_C InjCrv_phiPoI2Min_C InjCrv_qPoI2Bas_MAP InjCrv_qPoI2Des_C InjCrv_qPoI2Eff_C InjCrv_qPoI2SetLim_C InjCrv_swtPhiPoI2Des_C InjCrv_swtQntPoI2Des_C InjCrv_swtQntPoI2Eff_C InjCrv_swtTiPoI2Des_C InjCrv_tiPoI2Des_C InjCrv_tiPoI2Max_MAP InjCrv_tiPoI2Min_C /end DEF_CHARACTERISTIC
 /begin REF_CHARACTERISTIC InjCrv_stInjCharActVal_C InjCrv_stInjDstSel_C InjCrv_swtStInjCharActVal_C /end REF_CHARACTERISTIC
 /begin IN_MEASUREMENT CoEng_stShutOffPath Epm_ctCyl Epm_nEng InjCrv_phiMI1Des InjCrv_phiPoI2AddCor InjCrv_phiPoI2EnvCor InjCrv_qMI1Des InjCrv_qPiI1Des InjCrv_qPiI2Des InjCrv_qPiI3Des InjCrv_qPoI2AddCor InjCrv_qPoI2EnvCor InjCrv_stInjCharActVal InjCrv_stInjCharActValPrg InjCrv_stInjCharRlsPrgVal InjCrv_stInjCharSetVal InjCrv_stPoI2NrmMode InjCrv_stPoI2Rgn InjCrv_tiMI1ET InjCrv_tiPoI2AddCor InjCrv_tiPoI2EnvCor InjCtl_qSetUnBal RailP_pFlt /end IN_MEASUREMENT
 /begin OUT_MEASUREMENT InjCrv_phiPoI2Des InjCrv_qPoI2Des InjCrv_qPoI2Eff InjCrv_tiPoI2Des /end OUT_MEASUREMENT
 /begin LOC_MEASUREMENT InjCrv_facPoI2EffSet_mp InjCrv_facPoI2Eff_mp InjCrv_phiPoI2AbsTot_mp InjCrv_phiPoI2Abs_mp InjCrv_phiPoI2Byp_mp InjCrv_phiPoI2Cor_mp InjCrv_phiPoI2DesAdd_mp InjCrv_phiPoI2Rel_mp InjCrv_qMI1MinPoI2_mp InjCrv_qPoI2Bas_mp InjCrv_qPoI2Cor_mp InjCrv_qPoI2DesAdd_mp InjCrv_qPoI2DesByp_mp InjCrv_qPoI2Des_mp InjCrv_qPoI2EffAdd_mp InjCrv_qPoI2EffByp_mp InjCrv_qPoI2Eff_mp InjCrv_qPoI2Lim_mp InjCrv_qPoI2Max_mp InjCrv_qPoI2Min_mp InjCrv_qPoI2Set_mp InjCrv_stPoI2 InjCrv_swtPoI2AgAbsTDC_mp InjCrv_tiPoI2Byp_mp InjCrv_tiPoI2Cor_mp InjCrv_tiPoI2DesAdd_mp InjCrv_tiPoI2Max_mp InjCrv_tiPoI2RelTot_mp InjCrv_tiPoI2Rel_mp /end LOC_MEASUREMENT
/end FUNCTION
/begin FUNCTION InjCrv_PoI2AddCor ""
 /begin OUT_MEASUREMENT InjCrv_phiPoI2AddCor InjCrv_qPoI2AddCor InjCrv_tiPoI2AddCor /end OUT_MEASUREMENT
 /begin LOC_MEASUREMENT InjCrv_POpPoI2AddCor /end LOC_MEASUREMENT
/end FUNCTION
/begin FUNCTION InjCrv_PoI2AddCorRgn ""
 /begin OUT_MEASUREMENT InjCrv_facPoI2AddCorRgn InjCrv_phiPoI2AddCorRgn InjCrv_qPoI2AddCorRgn /end OUT_MEASUREMENT
/end FUNCTION
/begin FUNCTION InjCrv_PoI2AgAbsTDC "" /begin DEF_CHARACTERISTIC InjCrv_stPoI2AgAbsTDCMsk_C /end DEF_CHARACTERISTIC /end FUNCTION
/begin FUNCTION InjCrv_PoI2EnvCor ""
 /begin DEF_CHARACTERISTIC InjCrv_POpPoI2ETSCor_MAP InjCrv_qPoI2ATSCor_MAP InjCrv_qPoI2ETSCor_MAP /end DEF_CHARACTERISTIC
 /begin IN_MEASUREMENT Epm_nEng InjCrv_facPoI2ATSQCor InjCrv_facPoI2ATSSOECor InjCrv_facPoI2ETSQCor InjCrv_facPoI2ETSSOECor InjCrv_facPOpPoI2ETSCor InjCtl_qSetUnBal /end IN_MEASUREMENT
 /begin OUT_MEASUREMENT InjCrv_phiPoI2EnvCor InjCrv_qPoI2EnvCor InjCrv_tiPoI2EnvCor /end OUT_MEASUREMENT
 /begin LOC_MEASUREMENT InjCrv_POpPoI2EnvCor InjCrv_qPoI2ATSCor_mp InjCrv_qPoI2ETSCor_mp /end LOC_MEASUREMENT
/end FUNCTION
/begin FUNCTION InjCrv_PoI2EnvCorPhi "" /begin LOC_MEASUREMENT InjCrv_phiPoI2ATSCor_mp InjCrv_phiPoI2ETSCor_mp /end LOC_MEASUREMENT /end FUNCTION
/begin FUNCTION InjCrv_PoI2EnvCorRgn ""
 /begin DEF_CHARACTERISTIC InjCrv_phiPoI2APSCor0Rgn_GMAP InjCrv_phiPoI2APSCor1Rgn_GMAP InjCrv_phiPoI2APSCorRgnX_AXIS InjCrv_phiPoI2APSCorRgnY_AXIS InjCrv_phiPoI2ETSCor0Rgn_GMAP InjCrv_phiPoI2ETSCor1Rgn_GMAP InjCrv_phiPoI2ETSCorRgnX_AXIS InjCrv_phiPoI2ETSCorRgnY_AXIS InjCrv_qPoI2APSCor0Rgn_GMAP InjCrv_qPoI2APSCor1Rgn_GMAP InjCrv_qPoI2APSCorRgnX_AXIS InjCrv_qPoI2APSCorRgnY_AXIS InjCrv_qPoI2ATSCor0Rgn_GMAP InjCrv_qPoI2ATSCor1Rgn_GMAP InjCrv_qPoI2ATSCorRgnX_AXIS InjCrv_qPoI2ATSCorRgnY_AXIS InjCrv_qPoI2ETSCor0Rgn_GMAP InjCrv_qPoI2ETSCor1Rgn_GMAP InjCrv_qPoI2ETSCorRgnX_AXIS InjCrv_qPoI2ETSCorRgnY_AXIS InjCrv_tiPoI2APSCor0Rgn_GMAP InjCrv_tiPoI2APSCor1Rgn_GMAP InjCrv_tiPoI2APSCorRgnX_AXIS InjCrv_tiPoI2APSCorRgnY_AXIS InjCrv_tiPoI2ETSCor0Rgn_GMAP InjCrv_tiPoI2ETSCor1Rgn_GMAP InjCrv_tiPoI2ETSCorRgnX_AXIS InjCrv_tiPoI2ETSCorRgnY_AXIS /end DEF_CHARACTERISTIC
 /begin IN_MEASUREMENT Epm_nEng InjCrv_facPoI2APSQCorRgn InjCrv_facPoI2APSSOECorRgn InjCrv_facPoI2ATSQCorRgn InjCrv_facPoI2ETSQCorRgn InjCrv_facPoI2ETSSOECorRgn InjCrv_stPoI2RgnTSync InjCtl_qSetUnBal /end IN_MEASUREMENT
 /begin OUT_MEASUREMENT InjCrv_phiPoI2EnvCorRgn InjCrv_qPoI2EnvCorRgn InjCrv_tiPoI2APSCorRgn_mp InjCrv_tiPoI2EnvCorRgn InjCrv_tiPoI2ETSCorRgn_mp /end OUT_MEASUREMENT
 /begin LOC_MEASUREMENT InjCrv_phiPoI2APSCorRgn_mp InjCrv_phiPoI2ETSCorRgn_mp InjCrv_qPoI2APSCorRgn_mp InjCrv_qPoI2ATSCorRgn_mp InjCrv_qPoI2ETSCorRgn_mp /end LOC_MEASUREMENT
/end FUNCTION
/begin FUNCTION InjCrv_PoI2EnvCorSlow ""
 /begin DEF_CHARACTERISTIC InjCrv_ctATSPoI2Sel_C InjCrv_facPoI2ATSQCor_CUR InjCrv_facPoI2ATSSOECor_CUR InjCrv_facPoI2ETSQCor_CUR InjCrv_facPoI2ETSSOECor_CUR InjCrv_facPOpPoI2ETSCor_CUR /end DEF_CHARACTERISTIC
 /begin IN_MEASUREMENT AirSys_tFld CACDsT_t InjSys_tEng /end IN_MEASUREMENT
 /begin OUT_MEASUREMENT InjCrv_facPoI2ATSQCor InjCrv_facPoI2ATSSOECor InjCrv_facPoI2ETSQCor InjCrv_facPoI2ETSSOECor InjCrv_facPOpPoI2ETSCor InjCrv_tAirPoI2 /end OUT_MEASUREMENT
/end FUNCTION
/begin FUNCTION InjCrv_PoI2EnvCorSlowRgn ""
 /begin DEF_CHARACTERISTIC InjCrv_facPoI2APSQCor0Rgn_GCUR InjCrv_facPoI2APSQCor1Rgn_GCUR InjCrv_facPoI2APSQCorRgn_AXIS InjCrv_facPoI2APSSOECor0Rgn_GCUR InjCrv_facPoI2APSSOECor1Rgn_GCUR InjCrv_facPoI2APSSOECorRgn_AXIS InjCrv_facPoI2APSTICor0Rgn_GCUR InjCrv_facPoI2APSTICor1Rgn_GCUR InjCrv_facPoI2APSTICorRgn_AXIS InjCrv_facPoI2ATSQCor0Rgn_GCUR InjCrv_facPoI2ATSQCor1Rgn_GCUR InjCrv_facPoI2ATSQCorRgn_AXIS InjCrv_facPoI2ETSQCor0Rgn_GCUR InjCrv_facPoI2ETSQCor1Rgn_GCUR InjCrv_facPoI2ETSQCorRgn_AXIS InjCrv_facPoI2ETSSOECor0Rgn_GCUR InjCrv_facPoI2ETSSOECor1Rgn_GCUR InjCrv_facPoI2ETSSOECorRgn_AXIS InjCrv_facPoI2ETSTICor0Rgn_GCUR InjCrv_facPoI2ETSTICor1Rgn_GCUR InjCrv_facPoI2ETSTICorRgn_AXIS /end DEF_CHARACTERISTIC
 /begin IN_MEASUREMENT EnvP_p InjCrv_tAirPoI2 InjSys_tEng /end IN_MEASUREMENT
 /begin OUT_MEASUREMENT InjCrv_facPoI2APSQCorRgn InjCrv_facPoI2APSSOECorRgn InjCrv_facPoI2APSTICorRgn InjCrv_facPoI2ATSQCorRgn InjCrv_facPoI2ETSQCorRgn InjCrv_facPoI2ETSSOECorRgn InjCrv_facPoI2ETSTICorRgn /end OUT_MEASUREMENT
/end FUNCTION
/begin FUNCTION InjCrv_PoI2EnvCorTi "" /begin DEF_CHARACTERISTIC InjCrv_tiPoI2ATSCor_MAP InjCrv_tiPoI2ETSCor_MAP /end DEF_CHARACTERISTIC /begin IN_MEASUREMENT Epm_nEng InjCtl_qSetUnBal /end IN_MEASUREMENT /begin LOC_MEASUREMENT InjCrv_tiPoI2ATSCor_mp InjCrv_tiPoI2ETSCor_mp /end LOC_MEASUREMENT /end FUNCTION
/begin FUNCTION InjCrv_PoI2Rgn ""
 /begin DEF_CHARACTERISTIC InjCrv_facPoI2EffRgn_CUR InjCrv_facPoI2EffRgn_MAP InjCrv_phiPoI2Bas0Rgn_GMAP InjCrv_phiPoI2Bas1Rgn_GMAP InjCrv_phiPoI2BasRgnX_AXIS InjCrv_phiPoI2BasRgnY_AXIS InjCrv_phiPoI2MaxRgn_MAP InjCrv_qPoI2Bas0Rgn_GMAP InjCrv_qPoI2Bas1Rgn_GMAP InjCrv_qPoI2BasRgnX_AXIS InjCrv_qPoI2BasRgnY_AXIS InjCrv_tiPoI2Bas0Rgn_GMAP InjCrv_tiPoI2Bas1Rgn_GMAP InjCrv_tiPoI2BasRgnX_AXIS InjCrv_tiPoI2BasRgnY_AXIS /end DEF_CHARACTERISTIC
 /begin IN_MEASUREMENT Epm_ctCyl Epm_nEng InjCrv_facPoI2AddCorRgn InjCrv_phiPoI2AddCorRgn InjCrv_phiPoI2Des InjCrv_phiPoI2EnvCorRgn InjCrv_qPoI2AddCorRgn InjCrv_qPoI2Des InjCrv_qPoI2Des_mp InjCrv_qPoI2EnvCorRgn InjCrv_stPoI2Rgn InjCtl_qSetUnBal /end IN_MEASUREMENT
 /begin OUT_MEASUREMENT InjCrv_facPoI2EffRgn InjCrv_phiPoI2Rgn InjCrv_qPoI2Rgn InjCrv_tiPoI2Rgn /end OUT_MEASUREMENT
 /begin LOC_MEASUREMENT InjCrv_phiPoI2BasRgn_mp InjCrv_phiPoI2MaxRgn_mp InjCrv_phiPoI2RgnAdd_mp InjCrv_qPoI2BasRgn_mp InjCrv_qPoI2RgnAdd_mp InjCrv_tiPoI2BasRgn_mp /end LOC_MEASUREMENT
/end FUNCTION
/begin FUNCTION InjCrv_PoI2RgnLib ""
 /begin DEF_CHARACTERISTIC InjCrv_facPoI2AngRmp0Val_GCUR InjCrv_facPoI2AngRmp1Val_GCUR InjCrv_facPoI2AngRmpValX_AXIS InjCrv_facPoI2QntRmp0Val_GCUR InjCrv_facPoI2QntRmp1Val_GCUR InjCrv_facPoI2QntRmpValX_AXIS InjCrv_facPoI2SOEtiRmpVal_CUR InjCrv_facPoI2TiRmp0Val_GCUR InjCrv_facPoI2TiRmp1Val_GCUR InjCrv_facPoI2TiRmpValX_AXIS InjCrv_phiPoI2ReplNrm_MAP InjCrv_swtPoI2SOEReplNrm_C /end DEF_CHARACTERISTIC
 /begin IN_MEASUREMENT CoEOM_facRmpVal Epm_nEng InjCrv_facPoI2EffRgn InjCrv_phiPoI2Rgn InjCrv_qPoI2Rgn InjCrv_stPoI2Rgn InjCrv_stPoI2RmpSel InjCrv_tiPoI2Rgn InjCtl_qSetUnBal /end IN_MEASUREMENT
 /begin OUT_MEASUREMENT InjCrv_facPoI2SOEtiRmpVal_mp /end OUT_MEASUREMENT
 /begin LOC_MEASUREMENT InjCrv_facPoI2AngRmpVal_mp InjCrv_facPoI2QntRmpVal_mp InjCrv_facPoI2TiRmpVal_mp InjCrv_phiPoI2NrmVal_mp /end LOC_MEASUREMENT
/end FUNCTION
/begin FUNCTION InjCrv_PoI2Rls ""
 /begin DEF_CHARACTERISTIC InjCrv_phiPoI2HysOilDil_C InjCrv_phiPoI2MinOilDil_CUR InjCrv_POpPoI2Bas_MAP InjCrv_POpPoI2High_C InjCrv_POpPoI2Low_C InjCrv_POpPoI2RgnHigh_C InjCrv_POpPoI2RgnLow_C InjCrv_POpPoI2Rgn_MAP InjCrv_stPoI2AddRlsMsk_C InjCrv_stPoI2RgnMsk_CA InjCrv_stPoI2RgnRlsMsk_C InjCrv_stPoI2RmpSel_CA /end DEF_CHARACTERISTIC
 /begin IN_MEASUREMENT CoEOM_facRmpVal Epm_ctCyl Epm_nEng InjCrv_phiPoI2Des InjCrv_qPoI2Des InjCrv_qPoI2Des_mp InjCrv_stPoI2RmpSelTSync InjCrv_tiPoI2Des InjCtl_qSetUnBal /end IN_MEASUREMENT
 /begin LOC_MEASUREMENT InjCrv_phiPoI2DesTot_mp InjCrv_phiPoI2MinOilDil_mp InjCrv_POpPoI2Bas_mp InjCrv_POpPoI2Rgn_mp InjCrv_POpPoI2_mp InjCrv_stActValPoI2_mp InjCrv_stDesValPoI2_mp InjCrv_stPoI2RlsDes_mp /end LOC_MEASUREMENT
/end FUNCTION
/begin FUNCTION InjCrv_PoI2SOEPhiBas "" /begin LOC_MEASUREMENT InjCrv_phiPoI2Bas_mp /end LOC_MEASUREMENT /end FUNCTION
/begin FUNCTION InjCrv_PoI2SOETiBas "" /begin DEF_CHARACTERISTIC InjCrv_tiPoI2Bas_MAP /end DEF_CHARACTERISTIC /begin IN_MEASUREMENT Epm_nEng InjCtl_qSetUnBal /end IN_MEASUREMENT /begin LOC_MEASUREMENT InjCrv_tiPoI2Bas_mp /end LOC_MEASUREMENT /end FUNCTION
/begin FUNCTION InjCrv_QntMinLib "" /begin DEF_CHARACTERISTIC InjCrv_qMin_CUR /end DEF_CHARACTERISTIC /begin IN_MEASUREMENT RailP_pFlt /end IN_MEASUREMENT /begin LOC_MEASUREMENT InjCrv_qPiI1MinWv_mp /end LOC_MEASUREMENT /end FUNCTION
/begin COMPU_METHOD DEFAULT_FORMULA "DEFAULT_FORMULA" RAT_FUNC "%7.0" "" COEFFS 0 1 0 0 0 1 /end COMPU_METHOD
/begin COMPU_METHOD AngleCrS "" RAT_FUNC "%6.4" "deg CrS" COEFFS 0 45.5097222222222 0 0 0 1 /end COMPU_METHOD
/begin COMPU_METHOD AngleIndexCpp "" RAT_FUNC "%6.2" "AgCA" COEFFS 0 -1 180 0 0 1 /end COMPU_METHOD
/begin COMPU_METHOD CoeffA "" RAT_FUNC "%6.4" "1/(s*Nm)" COEFFS 0 204.8 0 0 0 1 /end COMPU_METHOD
/begin COMPU_METHOD CoEOMSwt "" RAT_FUNC "%10.9" "-" COEFFS 0 16384000 0 0 0 1 /end COMPU_METHOD
/begin COMPU_METHOD CoEOMSwt_S16 "" RAT_FUNC "%7.6" "-" COEFFS 0 16384 0 0 0 1 /end COMPU_METHOD
/begin COMPU_METHOD COEOM_AIRCTLQNTNUMMAP_SY_Compu "" TAB_NOINTP "%6.3" "-" COMPU_TAB_REF COEOM_AIRCTLQNTNUMMAP_SY_Compu /end COMPU_METHOD
/begin COMPU_TAB COEOM_AIRCTLQNTNUMMAP_SY_Compu "" TAB_NOINTP 8 0 0 1 1 2 2 3 3 4 4 5 5 6 6 7 7 /end COMPU_TAB
/begin COMPU_METHOD COEOM_AIRCTLTRQNUMMAP_SY_Compu "" TAB_NOINTP "%6.3" "-" COMPU_TAB_REF COEOM_AIRCTLTRQNUMMAP_SY_Compu /end COMPU_METHOD
/begin COMPU_TAB COEOM_AIRCTLTRQNUMMAP_SY_Compu "" TAB_NOINTP 8 0 0 1 1 2 2 3 3 4 4 5 5 6 6 7 7 /end COMPU_TAB
/begin COMPU_METHOD EGTSwt_S16 "" RAT_FUNC "%7.6" "-" COEFFS 0 16384 0 0 0 1 /end COMPU_METHOD
/begin COMPU_METHOD EngN "" RAT_FUNC "%6.3" "rpm" COEFFS 0 2 0 0 0 1 /end COMPU_METHOD
/begin COMPU_METHOD Fact "" RAT_FUNC "%6.5" "-" COEFFS 0 8192 0 0 0 1 /end COMPU_METHOD
/begin COMPU_METHOD Fact1 "" RAT_FUNC "%6.4" "-" COEFFS 0 128 0 0 0 1 /end COMPU_METHOD
/begin COMPU_METHOD IndSysTempFldSel "" TAB_VERB "%6.3" "-" COMPU_TAB_REF IndSysTempFldSel /end COMPU_METHOD
/begin COMPU_VTAB IndSysTempFldSel "" TAB_VERB 3 0 "CACDsT_t" 1 "AFST_t" 2 "EnvT_t" /end COMPU_VTAB
/begin COMPU_METHOD InjMass "" RAT_FUNC "%6.4" "mg/hub" COEFFS 0 100 0 0 0 1 /end COMPU_METHOD
/begin COMPU_METHOD InjMassInj "" RAT_FUNC "%6.4" "mg/inj" COEFFS 0 100 0 0 0 1 /end COMPU_METHOD
/begin COMPU_METHOD InjQntInj "" RAT_FUNC "%6.4" "mm^3/inj" COEFFS 0 100 0 0 0 1 /end COMPU_METHOD
/begin COMPU_METHOD InjTime_us "" RAT_FUNC "%6.3" "us" COEFFS 0 2.5 0 0 0 1 /end COMPU_METHOD
/begin COMPU_METHOD OneToOne "" RAT_FUNC "%6.2" "-" COEFFS 0 1 0 0 0 1 /end COMPU_METHOD
/begin COMPU_METHOD Pres_hPa "" RAT_FUNC "%6.2" "hPa" COEFFS 0 1 0 0 0 1 /end COMPU_METHOD
/begin COMPU_METHOD Pres_Rail "" RAT_FUNC "%4.3" "bar" COEFFS 0 10.000000 0 0 0 1 /end COMPU_METHOD
/begin COMPU_METHOD Temp_Cels "" RAT_FUNC "%6.1" "deg C" COEFFS 0 10 2731.4 0 0 1 /end COMPU_METHOD
/begin COMPU_METHOD Time_ms "" RAT_FUNC "%6.1" "ms" COEFFS 0 0.1 0 0 0 1 /end COMPU_METHOD
/begin COMPU_METHOD Time_s "" RAT_FUNC "%6.4" "s" COEFFS 0 100 0 0 0 1 /end COMPU_METHOD
/begin RECORD_LAYOUT Axis_Xs16 NO_AXIS_PTS_X 1 SWORD AXIS_PTS_X 2 SWORD INDEX_INCR DIRECT /end RECORD_LAYOUT
/begin RECORD_LAYOUT CurG_Ws16 FNC_VALUES 1 SWORD COLUMN_DIR DIRECT /end RECORD_LAYOUT
/begin RECORD_LAYOUT Cur_Xs16Ws16 NO_AXIS_PTS_X 1 SWORD AXIS_PTS_X 2 SWORD INDEX_INCR DIRECT FNC_VALUES 3 SWORD COLUMN_DIR DIRECT /end RECORD_LAYOUT
/begin RECORD_LAYOUT Kf_Xs16_Ys16_Ws16 NO_AXIS_PTS_X 1 SWORD NO_AXIS_PTS_Y 2 SWORD AXIS_PTS_X 3 SWORD INDEX_INCR DIRECT AXIS_PTS_Y 4 SWORD INDEX_INCR DIRECT FNC_VALUES 5 SWORD COLUMN_DIR DIRECT /end RECORD_LAYOUT
/begin RECORD_LAYOUT Kl_Xs16_Ws16 NO_AXIS_PTS_X 1 SWORD AXIS_PTS_X 2 SWORD INDEX_INCR DIRECT FNC_VALUES 3 SWORD COLUMN_DIR DIRECT /end RECORD_LAYOUT
/begin RECORD_LAYOUT MapG_Ws16 FNC_VALUES 1 SWORD COLUMN_DIR DIRECT /end RECORD_LAYOUT
/begin RECORD_LAYOUT Map_Xs16Ys16Ws16 NO_AXIS_PTS_X 1 SWORD NO_AXIS_PTS_Y 2 SWORD AXIS_PTS_X 3 SWORD INDEX_INCR DIRECT AXIS_PTS_Y 4 SWORD INDEX_INCR DIRECT FNC_VALUES 5 SWORD COLUMN_DIR DIRECT /end RECORD_LAYOUT
/begin RECORD_LAYOUT Map_Xu8Yu8Wu8 NO_AXIS_PTS_X 1 UBYTE NO_AXIS_PTS_Y 2 UBYTE AXIS_PTS_X 3 UBYTE INDEX_INCR DIRECT AXIS_PTS_Y 4 UBYTE INDEX_INCR DIRECT FNC_VALUES 5 UBYTE COLUMN_DIR DIRECT /end RECORD_LAYOUT
/begin RECORD_LAYOUT ValA_Wu32 FNC_VALUES 1 ULONG COLUMN_DIR DIRECT /end RECORD_LAYOUT
/begin RECORD_LAYOUT Val_Ws16 FNC_VALUES 1 SWORD COLUMN_DIR DIRECT /end RECORD_LAYOUT
/begin RECORD_LAYOUT Val_Ws32 FNC_VALUES 1 SLONG COLUMN_DIR DIRECT /end RECORD_LAYOUT
/begin RECORD_LAYOUT Val_Wu32 FNC_VALUES 1 ULONG COLUMN_DIR DIRECT /end RECORD_LAYOUT
/begin RECORD_LAYOUT Val_Wu8 FNC_VALUES 1 UBYTE COLUMN_DIR DIRECT /end RECORD_LAYOUT
/end MODULE
/end PROJECT
