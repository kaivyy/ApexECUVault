ASAP2_VERSION 1 3
/begin PROJECT P390 "BMW DDE6.2 6-Zylinder VP0.1 11.11.2003 CAN12H"
/begin HEADER "" VERSION "VP01_6Z_CAN12H" PROJECT_NO P390 /end HEADER
/begin MODULE DIM ""
/begin MOD_COMMON "" BYTE_ORDER MSB_FIRST ALIGNMENT_BYTE 1 ALIGNMENT_WORD 2 ALIGNMENT_LONG 4 ALIGNMENT_FLOAT32_IEEE 4 /end MOD_COMMON
/begin CHARACTERISTIC InjCrv_facPoI2EffRgnAdd_Vector "Konfigurationslabel für Bypass Freischnitt" VALUE 0xC2DC6 Kw_Wu8 255.0 OneToOne 0.00 255.0 FORMAT "%5.1" /end CHARACTERISTIC
/begin CHARACTERISTIC InjCrv_facPoI2EffRgnAdd_Channel "Konfigurationslabel für Bypass Freischnitt" VALUE 0xC2DC7 Kw_Wu8 255.0 OneToOne 0.00 255.0 FORMAT "%5.1" /end CHARACTERISTIC
/begin CHARACTERISTIC InjCrv_facPoI2EffRgn_Vector "Konfigurationslabel für Bypass Freischnitt" VALUE 0xC2DC8 Kw_Wu8 255.0 OneToOne 0.00 255.0 FORMAT "%5.1" /end CHARACTERISTIC
/begin CHARACTERISTIC InjCrv_facPoI2EffRgn_Channel "Konfigurationslabel für Bypass Freischnitt" VALUE 0xC2DC9 Kw_Wu8 255.0 OneToOne 0.00 255.0 FORMAT "%5.1" /end CHARACTERISTIC
/begin CHARACTERISTIC InjCrv_phiPoI2Add_Vector "Bypass-label für additiven Bypass von InjCrv_phiPoI2 ( Nicht verstellen !)" VALUE 0xC2DD6 Kw_Wu8 255.0 OneToOne 0.00 255.0 FORMAT "%5.1" /end CHARACTERISTIC
/begin CHARACTERISTIC InjCrv_phiPoI2Add_Channel "Label für additvien Bypass von InjCrv_phiPoI2 (Nicht verstellen!)" VALUE 0xC2DD7 Kw_Wu8 255.0 OneToOne 0.00 255.0 FORMAT "%5.1" /end CHARACTERISTIC
/begin CHARACTERISTIC InjCrv_phiPoI2Bas_MAP "Winkelkomponente Ansteuerbeginn Grundwert PoI2" MAP 0xE09A4 Kf_Xs16_Ys16_Ws16 40.00781 AngleCrS -40.00781 0.00 FORMAT "%8.5" EXTENDED_LIMITS -768.0000 767.9766
 /begin AXIS_DESCR STD_AXIS Eng_nAvrg EngN 2 0.00 6000.000 FORMAT "%8.3" EXTENDED_LIMITS -32768.00 32767.00 DEPOSIT ABSOLUTE /end AXIS_DESCR
 /begin AXIS_DESCR STD_AXIS InjCtl_qSetUnBal InjMassCyc 2 0.00 327.6700 FORMAT "%8.4" EXTENDED_LIMITS -327.6800 327.6700 DEPOSIT ABSOLUTE /end AXIS_DESCR
/end CHARACTERISTIC
/begin CHARACTERISTIC InjCrv_phiPoI2Min_C "#SSD minimaler Ansteuerbeginn PoI2 relativ zum oberen Totpunkt" VALUE 0xE096C Kw_Ws16 40.00781 AngleCrS -40.00781 0.00 FORMAT "%8.5" EXTENDED_LIMITS -768.0000 767.9766 /end CHARACTERISTIC
/begin CHARACTERISTIC InjCrv_phiPoI2RgnAdd_Vector "Bypass-Label für InjCrv_phiPoI2RgnAdd_Vector (Nicht verstellen!)" VALUE 0xC2DCA Kw_Wu8 255.0 OneToOne 0.00 255.0 FORMAT "%5.1" /end CHARACTERISTIC
/begin CHARACTERISTIC InjCrv_phiPoI2RgnAdd_Channel "Bypass-Label für InjCrv_phiPoI2RgnAdd_Channel (Nicht verstellen!)" VALUE 0xC2DCB Kw_Wu8 255.0 OneToOne 0.00 255.0 FORMAT "%5.1" /end CHARACTERISTIC
/begin CHARACTERISTIC InjCrv_phiPoI2Rgn_Vector "#SSD Bypass-Label, nicht editieren !" VALUE 0xC2DCC Kw_Wu8 255.0 OneToOne 0.00 255.0 FORMAT "%5.1" /end CHARACTERISTIC
/begin CHARACTERISTIC InjCrv_phiPoI2Rgn_Channel "#SSD Bypass-Label, nicht editieren !" VALUE 0xC2DCD Kw_Wu8 255.0 OneToOne 0.00 255.0 FORMAT "%5.1" /end CHARACTERISTIC
/begin CHARACTERISTIC InjCrv_phiPoI2_Vector "#SSD Bypass-Label, nicht editieren !" VALUE 0xC2DD8 Kw_Wu8 255.0 OneToOne 0.00 255.0 FORMAT "%5.1" /end CHARACTERISTIC
/begin CHARACTERISTIC InjCrv_phiPoI2_Channel "#SSD Bypass-Label, nicht editieren !" VALUE 0xC2DD9 Kw_Wu8 255.0 OneToOne 0.00 255.0 FORMAT "%5.1" /end CHARACTERISTIC
/begin CHARACTERISTIC InjCrv_POpPoI2Bas_MAP "grundwert Freigabe PoI2" MAP 0xE0904 Kf_Xs16_Ys16_Ws16 100.0000 OneToOne 0.00 100.0000 FORMAT "%8.4" EXTENDED_LIMITS -32768.00 32767.00
 /begin AXIS_DESCR STD_AXIS Eng_nAvrg EngN 6 0.00 6000.000 FORMAT "%8.3" EXTENDED_LIMITS -32768.00 32767.00 DEPOSIT ABSOLUTE /end AXIS_DESCR
 /begin AXIS_DESCR STD_AXIS InjCtl_qSetUnBal InjMassCyc 6 0.00 327.6700 FORMAT "%8.4" EXTENDED_LIMITS -327.6800 327.6700 DEPOSIT ABSOLUTE /end AXIS_DESCR
/end CHARACTERISTIC
/begin CHARACTERISTIC InjCrv_POpPoI2High_C "Feigabe PoI2 über Betriebspunkt, obere Hystereseschwelle" VALUE 0xE0968 Kw_Ws16 100.0000 OneToOne 0.00 100.0000 FORMAT "%8.4" EXTENDED_LIMITS -32768.00 32767.00 /end CHARACTERISTIC
/begin CHARACTERISTIC InjCrv_POpPoI2Low_C "Freigabe PoI2 über Betriebspunkt, untere Hystereseschwelle" VALUE 0xE096A Kw_Ws16 100.0000 OneToOne 0.00 100.0000 FORMAT "%8.4" EXTENDED_LIMITS -32768.00 32767.00 /end CHARACTERISTIC
/begin CHARACTERISTIC InjCrv_qMin_CUR "Kennlinie für die Berechnung der Minimalmenge einer Einspritzung" CURVE 0xE0BFC Kl_Xs16_Ws16 327.6700 InjMassInj 0.00 327.6700 FORMAT "%8.4" EXTENDED_LIMITS -327.6800 327.6700
 /begin AXIS_DESCR STD_AXIS RailCD_pPeak Pres_Rail 16 0.00 2000.000 FORMAT "%5.3" EXTENDED_LIMITS -3276.800 3276.700 DEPOSIT ABSOLUTE /end AXIS_DESCR
/end CHARACTERISTIC
/begin CHARACTERISTIC InjCrv_qPoI2DesAdd_Vector "Bypass-Label für additiven Bypass von InjCrv_qPoI2Des (Nicht verstellen!)" VALUE 0xC2DDA Kw_Wu8 255.0 OneToOne 0.00 255.0 FORMAT "%5.1" /end CHARACTERISTIC
/begin CHARACTERISTIC InjCrv_qPoI2DesAdd_Channel "Konfigurationslabel für additive Bypass message" VALUE 0xC2DDB Kw_Wu8 255.0 OneToOne 0.00 255.0 FORMAT "%5.1" /end CHARACTERISTIC
/begin CHARACTERISTIC InjCrv_qPoI2EffAdd_Vector "Bypass-label für additiven Bypass InjCrv_qPoI2Eff (nicht verstellen!)" VALUE 0xC2DDC Kw_Wu8 255.0 OneToOne 0.00 255.0 FORMAT "%5.1" /end CHARACTERISTIC
/begin CHARACTERISTIC InjCrv_qPoI2EffAdd_Channel "Bypass-label für additiven Bypass  InjCrv_qPoI2Eff (nicht verstellen!)" VALUE 0xC2DDD Kw_Wu8 255.0 OneToOne 0.00 255.0 FORMAT "%5.1" /end CHARACTERISTIC
/begin CHARACTERISTIC InjCrv_qPoI2Eff_Vector "#SSD Bypass-Label, nicht editieren !" VALUE 0xC2DDE Kw_Wu8 255.0 OneToOne 0.00 255.0 FORMAT "%5.1" /end CHARACTERISTIC
/begin CHARACTERISTIC InjCrv_qPoI2Eff_Channel "#SSD Bypass-Label, nicht editieren !" VALUE 0xC2DDF Kw_Wu8 255.0 OneToOne 0.00 255.0 FORMAT "%5.1" /end CHARACTERISTIC
/begin CHARACTERISTIC InjCrv_qPoI2RgnAdd_Vector "Konfigurationslabel für Bypass Freischnitt" VALUE 0xC2DCE Kw_Wu8 255.0 OneToOne 0.00 255.0 FORMAT "%5.1" /end CHARACTERISTIC
/begin CHARACTERISTIC InjCrv_qPoI2RgnAdd_Channel "Konfigurationslabel für Bypass Freischnitt" VALUE 0xC2DCF Kw_Wu8 255.0 OneToOne 0.00 255.0 FORMAT "%5.1" /end CHARACTERISTIC
/begin CHARACTERISTIC InjCrv_qPoI2Rgn_Vector "#SSD Bypass-Label, nicht editieren !" VALUE 0xC2DD0 Kw_Wu8 255.0 OneToOne 0.00 255.0 FORMAT "%5.1" /end CHARACTERISTIC
/begin CHARACTERISTIC InjCrv_qPoI2Rgn_Channel "#SSD Bypass-Label, nicht editieren !" VALUE 0xC2DD1 Kw_Wu8 255.0 OneToOne 0.00 255.0 FORMAT "%5.1" /end CHARACTERISTIC
/begin CHARACTERISTIC InjCrv_qPoI2Des_Vector "#SSD Bypass-Label für InjCrv_qPoI2Des (Nicht verstellen!)" VALUE 0xC2DE0 Kw_Wu8 255.0 OneToOne 0.00 255.0 FORMAT "%5.1" /end CHARACTERISTIC
/begin CHARACTERISTIC InjCrv_qPoI2Des_Channel "#SSD Bypass-Label für InjCrv_qPoI2Des (Nicht verstellen!)" VALUE 0xC2DE1 Kw_Wu8 255.0 OneToOne 0.00 255.0 FORMAT "%5.1" /end CHARACTERISTIC
/begin CHARACTERISTIC InjCrv_tiPoI2Add_Vector "Bypass-label für additiven Bypass InjCrv_tiPoI2 (nicht verstellen !)" VALUE 0xC2DE2 Kw_Wu8 255.0 OneToOne 0.00 255.0 FORMAT "%5.1" /end CHARACTERISTIC
/begin CHARACTERISTIC InjCrv_tiPoI2Add_Channel "Bypass-label für additiven Bypass InjCrv_tiPoI2 (nicht verstellen !)" VALUE 0xC2DE3 Kw_Wu8 255.0 OneToOne 0.00 255.0 FORMAT "%5.1" /end CHARACTERISTIC
/begin CHARACTERISTIC InjCrv_tiPoI2Bas_MAP "Zeitkomponente Ansteuerbeginn Grundwert PoI2" MAP 0xE09B8 Kf_Xs16_Ys16_Ws16 18000.00 InjTime_us -13000.00 5000.00 FORMAT "%8.2" EXTENDED_LIMITS -32768.00 32767.00
 /begin AXIS_DESCR STD_AXIS Eng_nAvrg EngN 16 0.00 6000.000 FORMAT "%8.3" EXTENDED_LIMITS -32768.00 32767.00 DEPOSIT ABSOLUTE /end AXIS_DESCR
 /begin AXIS_DESCR STD_AXIS InjCtl_qSetUnBal InjMassCyc 16 0.00 327.6700 FORMAT "%8.4" EXTENDED_LIMITS -327.6800 327.6700 DEPOSIT ABSOLUTE /end AXIS_DESCR
/end CHARACTERISTIC
/begin CHARACTERISTIC InjCrv_tiPoI2Max_MAP "#SSD maximaler Ansteuerbeginn PoI2 relativ zur Haupteinspritzung" MAP 0xE096E Kf_Xs16_Ys16_Ws16 18000.00 InjTime_us -13000.00 5000.00 FORMAT "%8.2" EXTENDED_LIMITS -32768.00 32767.00
 /begin AXIS_DESCR STD_AXIS RailCD_pPeak Pres_Rail 4 0.00 2000.000 FORMAT "%5.3" EXTENDED_LIMITS -3276.800 3276.700 DEPOSIT ABSOLUTE /end AXIS_DESCR
 /begin AXIS_DESCR STD_AXIS InjCrv_qMI1Des InjMassInj 4 0.00 327.6700 FORMAT "%8.4" EXTENDED_LIMITS -327.6800 327.6700 DEPOSIT ABSOLUTE /end AXIS_DESCR
/end CHARACTERISTIC
/begin CHARACTERISTIC InjCrv_tiPoI2Min_C "#SSD physikalisch bedingter minimaler Ansteuerbeginn PoI2" VALUE 0xE09A2 Kw_Ws16 18000.00 InjTime_us -13000.00 5000.00 FORMAT "%8.2" EXTENDED_LIMITS -32768.00 32767.00 /end CHARACTERISTIC
/begin CHARACTERISTIC InjCrv_tiPoI2RgnAdd_Vector "Bypass-Label für  (Nicht verstellen!)" VALUE 0xC2DD2 Kw_Wu8 255.0 OneToOne 0.00 255.0 FORMAT "%5.1" /end CHARACTERISTIC
/begin CHARACTERISTIC InjCrv_tiPoI2RgnAdd_Channel "Bypass-Label für InjCrv_tiPoI2RgnAdd_Channel (Nicht verstellen!)" VALUE 0xC2DD3 Kw_Wu8 255.0 OneToOne 0.00 255.0 FORMAT "%5.1" /end CHARACTERISTIC
/begin CHARACTERISTIC InjCrv_tiPoI2Rgn_Vector "#SSD Bypass-Label, nicht editieren !" VALUE 0xC2DD4 Kw_Wu8 255.0 OneToOne 0.00 255.0 FORMAT "%5.1" /end CHARACTERISTIC
/begin CHARACTERISTIC InjCrv_tiPoI2Rgn_Channel "#SSD Bypass-Label, nicht editieren !" VALUE 0xC2DD5 Kw_Wu8 255.0 OneToOne 0.00 255.0 FORMAT "%5.1" /end CHARACTERISTIC
/begin CHARACTERISTIC InjCrv_tiPoI2_Vector "#SSD Bypass-Label, nicht editieren !" VALUE 0xC2DE4 Kw_Wu8 255.0 OneToOne 0.00 255.0 FORMAT "%5.1" /end CHARACTERISTIC
/begin CHARACTERISTIC InjCrv_tiPoI2_Channel "#SSD Bypass-Label, nicht editieren !" VALUE 0xC2DE5 Kw_Wu8 255.0 OneToOne 0.00 255.0 FORMAT "%5.1" /end CHARACTERISTIC
/begin CHARACTERISTIC InjCtl_dqLimUp_C "Rampensteigung bei Wegfall des Systemfehlers" VALUE 0xE0D38 Kw_Wu32 655359.999847 RmpInjMass 0.00 655359.999847 FORMAT "%13.6" /end CHARACTERISTIC
/begin CHARACTERISTIC InjCtl_dqLimDwn_C "Rampensteigung bei Auftreten eines Systemfehlers" VALUE 0xE0D3C Kw_Wu32 655359.999847 RmpInjMass 0.00 655359.999847 FORMAT "%13.6" /end CHARACTERISTIC
/begin CHARACTERISTIC InjCtl_facAdjSrvMax_C "Maximalwert für Serviceabgleichfaktor" VALUE 0xE0C40 Kw_Ws16 3.000000 Fact 0.00 3.000000 FORMAT "%8.6" EXTENDED_LIMITS -4.000000 3.999878 /end CHARACTERISTIC
/begin CHARACTERISTIC InjCtl_facAdjSrvMin_C "Minimalwert für Serviceabgleichfaktor" VALUE 0xE0C42 Kw_Ws16 3.000000 Fact 0.00 3.000000 FORMAT "%8.6" EXTENDED_LIMITS -4.000000 3.999878 /end CHARACTERISTIC
/begin CHARACTERISTIC InjCtl_facAdjSrvUnlimDfl_C "Vorgabewert für Serviceabgleichfaktor" VALUE 0xE0C44 Kw_Ws16 3.000000 Fact 0.00 3.000000 FORMAT "%8.6" EXTENDED_LIMITS -4.000000 3.999878 /end CHARACTERISTIC
/begin CHARACTERISTIC InjCtl_qAdjQntMax_C "Maximalwert für Mengenabgleich" VALUE 0xE0C46 Kw_Ws16 327.6700 InjMassCyc 0.00 327.6700 FORMAT "%8.4" EXTENDED_LIMITS -327.6800 327.6700 /end CHARACTERISTIC
/begin CHARACTERISTIC InjCtl_qAdjQntMin_C "Minimalwert für Mengenabgleich" VALUE 0xE0C48 Kw_Ws16 327.6700 InjMassCyc 0.00 327.6700 FORMAT "%8.4" EXTENDED_LIMITS -327.6800 327.6700 /end CHARACTERISTIC
/begin CHARACTERISTIC InjCtl_qAdjQnt_MAP "Neutralkennfeld für Mengenabgleich" MAP 0xE0C4A Kf_Xs16_Ys16_Ws16 327.6700 InjMassCyc 0.00 327.6700 FORMAT "%8.4" EXTENDED_LIMITS -327.6800 327.6700
 /begin AXIS_DESCR STD_AXIS Eng_nAvrg EngN 8 0.00 6000.000 FORMAT "%8.3" EXTENDED_LIMITS -32768.00 32767.00 DEPOSIT ABSOLUTE /end AXIS_DESCR
 /begin AXIS_DESCR STD_AXIS InjCtl_qSetUnCor_mp InjMassCyc 6 0.00 327.6700 FORMAT "%8.4" EXTENDED_LIMITS -327.6800 327.6700 DEPOSIT ABSOLUTE /end AXIS_DESCR
/end CHARACTERISTIC
/begin CHARACTERISTIC InjCtl_t1DT1SetUnBal_C "Totzeit für Kraftstoffmasse DT1 filter" VALUE 0xE0CCC Kw_Wu32 4294.9673 TimeDelay_s 0.0000010000000 4294.9673 FORMAT "%9.4" /end CHARACTERISTIC
/begin CHARACTERISTIC InjCtl_kdDT1SetUnBal_C "Verstärkungskonstante des DT1 filters für Kraftstoffmasse ohne FBC" VALUE 0xE0CD0 Kw_Ws32 32767.9999847 Kd 0.00 32767.9999847 FORMAT "%13.7" EXTENDED_LIMITS -32768.0000000 32767.9999847 /end CHARACTERISTIC
/begin CHARACTERISTIC InjCtl_qCurr_Vector "#SSD Bypass-Label für InjCtl_qCurr (Nicht verstellen!)" VALUE 0xC2DE6 Kw_Wu8 255.0 OneToOne 0.00 255.0 FORMAT "%5.1" /end CHARACTERISTIC
/begin CHARACTERISTIC InjCtl_qCurr_Channel "#SSD Bypass Label, nicht ändern!" VALUE 0xC2DE7 Kw_Wu8 255.0 OneToOne 0.00 255.0 FORMAT "%5.1" /end CHARACTERISTIC
/begin CHARACTERISTIC InjCtl_qDriftComp_MAP "Kennfeld für Mengendriftkompensation" MAP 0xE0CD4 Kf_Xs16_Ys16_Ws16 327.6700 InjMassCyc 0.00 327.6700 FORMAT "%8.4" EXTENDED_LIMITS -327.6800 327.6700
 /begin AXIS_DESCR STD_AXIS InjCtl_qSetUnBal InjMassCyc 8 0.00 327.6700 FORMAT "%8.4" EXTENDED_LIMITS -327.6800 327.6700 DEPOSIT ABSOLUTE /end AXIS_DESCR
 /begin AXIS_DESCR STD_AXIS InjCtl_tiEngOn_mp TimeEngOnHrs 4 0.00 596497.0 FORMAT "%8.1" EXTENDED_LIMITS -596515.2 596497.0 DEPOSIT ABSOLUTE /end AXIS_DESCR
/end CHARACTERISTIC
/begin CHARACTERISTIC InjCtl_qDriftMax2_C "Mengendriftkompensationsbegrenzung (Datensatz)" VALUE 0xE0D30 Kw_Ws16 327.6700 InjMassCyc 0.00 327.6700 FORMAT "%8.4" EXTENDED_LIMITS -327.6800 327.6700 /end CHARACTERISTIC
/begin CHARACTERISTIC InjCtl_qDriftMin2_C "Mengendriftkompensationsbegrenzung (Datensatz)" VALUE 0xE0D32 Kw_Ws16 327.6700 InjMassCyc 0.00 327.6700 FORMAT "%8.4" EXTENDED_LIMITS -327.6800 327.6700 /end CHARACTERISTIC
/begin CHARACTERISTIC InjCtl_qLimErr_CUR "#SSD Begrenzungsmeneg bei Systemfehler" CURVE 0xE0D40 Kl_Xs16_Ws16 327.6700 InjMass 0.00 327.6700 FORMAT "%8.4" EXTENDED_LIMITS -327.6800 327.6700
 /begin AXIS_DESCR STD_AXIS Eng_nAvrg EngN 21 0.00 6000.000 FORMAT "%8.3" EXTENDED_LIMITS -32768.00 32767.00 DEPOSIT ABSOLUTE /end AXIS_DESCR
/end CHARACTERISTIC
/begin CHARACTERISTIC InjCtl_qLimErr_MAP "#SSD Einspritzmengenbegrenzung abhängig von Kraftstofftemperatur" MAP 0xE0D96 Kf_Xs16_Ys16_Ws16 327.6700 InjMass 0.00 327.6700 FORMAT "%8.4" EXTENDED_LIMITS -327.6800 327.6700
 /begin AXIS_DESCR STD_AXIS Eng_nAvrg EngN 12 0.00 6000.000 FORMAT "%8.3" EXTENDED_LIMITS -32768.00 32767.00 DEPOSIT ABSOLUTE /end AXIS_DESCR
 /begin AXIS_DESCR STD_AXIS FTSCD_tFuel Temp_Cels 5 -50.14000 199.8600 FORMAT "%8.4" EXTENDED_LIMITS -3549.940 3003.560 DEPOSIT ABSOLUTE /end AXIS_DESCR
/end CHARACTERISTIC
/begin CHARACTERISTIC InjCtl_qLimSoftShOff_CUR "limitation value in case of soft shutoff" CURVE 0xE0E34 Kl_Xs16_Ws16 327.6700 InjMass 0.00 327.6700 FORMAT "%8.4" EXTENDED_LIMITS -327.6800 327.6700
 /begin AXIS_DESCR STD_AXIS Eng_nAvrg EngN 16 0.00 6000.000 FORMAT "%8.3" EXTENDED_LIMITS -32768.00 32767.00 DEPOSIT ABSOLUTE /end AXIS_DESCR
/end CHARACTERISTIC
/begin CHARACTERISTIC InjCtl_qRaw_Vector "#SSD Bypass-Label für InjCtl_qRaw (Nicht verstellen!)" VALUE 0xC2DE8 Kw_Wu8 255.0 OneToOne 0.00 255.0 FORMAT "%5.1" /end CHARACTERISTIC
/begin CHARACTERISTIC InjCtl_qRaw_Channel "#SSD Bypass-Label für InjCtl_qRaw, nicht editieren!" VALUE 0xC2DE9 Kw_Wu8 255.0 OneToOne 0.00 255.0 FORMAT "%5.1" /end CHARACTERISTIC
/begin CHARACTERISTIC InjCtl_qSet_Vector "#SSD Bypass-Label für InjCtl_qSet (Nicht verstellen!)" VALUE 0xC2DEA Kw_Wu8 255.0 OneToOne 0.00 255.0 FORMAT "%5.1" /end CHARACTERISTIC
/begin CHARACTERISTIC InjCtl_qSet_Channel "#SSD Bypass-Label für InjCtl_qSet, nicht editieren !" VALUE 0xC2DEB Kw_Wu8 255.0 OneToOne 0.00 255.0 FORMAT "%5.1" /end CHARACTERISTIC
/begin CHARACTERISTIC InjCtl_swtFMACor_C "Schalter für FMA Korrektur" VALUE 0xE0D34 Kw_Wu8 1.000 OneToOne 0.00 1.000 FORMAT "%5.3" EXTENDED_LIMITS 0.00 255.0 /end CHARACTERISTIC
/begin CHARACTERISTIC InjUn_nInjLock_C "#SSD Kein Berechnung der Einspritzungen solange Überprüfung der Synchronisation nicht abgeschlossen" VALUE 0xC0490 Kw_Ws16 8000.000 EngN 0.00 8000.000 FORMAT "%8.3" EXTENDED_LIMITS -32768.00 32767.00 /end CHARACTERISTIC
/begin CHARACTERISTIC InjUn_phiTstShOffPathSet_C "#SSD Winkel zwischen Programmierung und Beginn der Einspritzung bei Abschaltpfadtest" VALUE 0xE0E78 Kw_Wu16 100.0078 AngleCrS 0.00 100.0078 FORMAT "%8.4" EXTENDED_LIMITS 0.00 1535.977 /end CHARACTERISTIC
/begin CHARACTERISTIC InjUn_tiTstShOffPathET_C "#SSD Ansteuerdauer bei Abschaltpfadtest" VALUE 0xE0E7A Kw_Wu16 65415.00 InjTime_us 120.0000 65535.00 FORMAT "%8.2" EXTENDED_LIMITS 0.00 65535.00 /end CHARACTERISTIC
/begin CHARACTERISTIC InjVCD_uChrgThrSRCLo_C "#SSD Untere Schwelle für die Plausibilisierung der CY370-Integrator-Ausgangsspannung" VALUE 0xE0E80 Kw_Ws16 5000.000 Volt 0.00 5000.000 FORMAT "%8.3" EXTENDED_LIMITS -160156.4 160151.5 /end CHARACTERISTIC
/begin CHARACTERISTIC InjVCD_uChrgThrSRCHi_C "#SSD Obere Schwelle für die Plausibilisierung der CY370-Integrator-Ausgangsspannung" VALUE 0xE0E82 Kw_Ws16 5000.000 Volt 0.00 5000.000 FORMAT "%8.3" EXTENDED_LIMITS -160156.4 160151.5 /end CHARACTERISTIC
/begin CHARACTERISTIC InjVCD_uChrgLin_CUR "#SSD Linearisierungskurve für die Ausgangsspannung des CY370-Integrators" CURVE 0xE0E84 Kl_Xs16_Ws16 320307.9 Volt -160156.4 160151.5 FORMAT "%8.1"
 /begin AXIS_DESCR STD_AXIS InjVCD_uRawChgUp_mp Volt 2 0.00 5200.391 FORMAT "%8.3" EXTENDED_LIMITS -160156.4 160151.5 DEPOSIT ABSOLUTE /end AXIS_DESCR
/end CHARACTERISTIC
/begin CHARACTERISTIC InjVCD_uActrThrSRCLo_C "#SSD untere Spannungsschwelle SRC - nicht verwendet" VALUE 0xE0E8E Kw_Ws16 5000.000 Volt 0.00 5000.000 FORMAT "%8.3" EXTENDED_LIMITS -160156.4 160151.5 /end CHARACTERISTIC
/begin CHARACTERISTIC InjVCD_uActrThrSRCHi_C "#SSD obere Spannungsschwelle SRC - nicht verwendet" VALUE 0xE0E90 Kw_Ws16 5000.000 Volt 0.00 5000.000 FORMAT "%8.3" EXTENDED_LIMITS -160156.4 160151.5 /end CHARACTERISTIC
/begin CHARACTERISTIC InjVCD_uActrLin_CUR "#SSD Linearisierungkurve ADC-Rohwert -> Aktorspannung" CURVE 0xE0E92 Kl_Xs16_Ws16 655.3500 Volt_PA -327.6800 327.6700 FORMAT "%8.4"
 /begin AXIS_DESCR STD_AXIS InjVCD_uRawUp_mp Volt 2 0.00 5200.391 FORMAT "%8.3" EXTENDED_LIMITS -160156.4 160151.5 DEPOSIT ABSOLUTE /end AXIS_DESCR
/end CHARACTERISTIC
/begin CHARACTERISTIC InjVCD_chgMaxPlaus_C "Maximale Ladung" VALUE 0xE0E9C Kw_Ws16 65535.00 Charge_PA -32768.00 32767.00 FORMAT "%8.2" /end CHARACTERISTIC
/begin CHARACTERISTIC InjVCD_chgMinPlaus_C "minimale Ladung" VALUE 0xE0E9E Kw_Ws16 65535.00 Charge_PA -32768.00 32767.00 FORMAT "%8.2" /end CHARACTERISTIC
/begin CHARACTERISTIC InjVCD_ctThresShOffDCDCEv_C "#SSD Zälerschwelle zu detektieren endlose ""single-event"" -Aufrufen" VALUE 0xE1538 Kw_Wu8 255.0 OneToOne 0.00 255.0 FORMAT "%5.1" READ_ONLY /end CHARACTERISTIC
/begin CHARACTERISTIC InjVCD_ctThres_C "#SSD Zähler-Schweller zur Detektion einer Verklemmung (nicht applizierbar)" VALUE 0xE14DC Kw_Wu32 4294967295.00 OneToOne 0.00 4294967295.00 FORMAT "%13.2" READ_ONLY /end CHARACTERISTIC
/begin CHARACTERISTIC InjVCD_uCY370ThrSRCLo_C "#SSD untere Spannungsschwelle für Integratorabgleich" VALUE 0xE0F18 Kw_Ws16 5000.000 Volt 0.00 5000.000 FORMAT "%8.3" EXTENDED_LIMITS -160156.4 160151.5 /end CHARACTERISTIC
/begin CHARACTERISTIC InjVCD_uCY370ThrSRCHi_C "#SSD obere Spannungsschwelle für Integratorabgleich" VALUE 0xE0F1A Kw_Ws16 5000.000 Volt 0.00 5000.000 FORMAT "%8.3" EXTENDED_LIMITS -160156.4 160151.5 /end CHARACTERISTIC
/begin CHARACTERISTIC InjVCD_uCY370Lin_CUR "#SSD Linearisierungskurve für Spannung vom Integratorabgleich" CURVE 0xE0F1C Kl_Xs16_Ws16 320307.9 Volt -160156.4 160151.5 FORMAT "%8.1"
 /begin AXIS_DESCR STD_AXIS InjVCD_uRawCY370Int0_mp Volt 2 0.00 5200.391 FORMAT "%8.3" EXTENDED_LIMITS -160156.4 160151.5 DEPOSIT ABSOLUTE /end AXIS_DESCR
/end CHARACTERISTIC
/begin CHARACTERISTIC InjVCD_DebActrEnrgDef_C "#SSD Zähler für endgültig defekt" VALUE 0xE0EA8 Kw_Wu16 65535.00 OneToOne 0.00 65535.00 FORMAT "%8.2" /end CHARACTERISTIC
/begin CHARACTERISTIC InjVCD_DebActrEnrgOK_C "#SSD Zähler bis endgültig geheilt" VALUE 0xE0EAA Kw_Wu16 65535.00 OneToOne 0.00 65535.00 FORMAT "%8.2" /end CHARACTERISTIC
/begin CHARACTERISTIC InjVCD_DebDCDCLowDef_C "#SSD Fehlerentprellung Zustandsdauerfehler DC_LOW" VALUE 0xE0F28 Kw_Ws16 327670.0 Time_ms 0.00 327670.0 FORMAT "%8.1" EXTENDED_LIMITS -327680.0 327670.0 /end CHARACTERISTIC
/begin CHARACTERISTIC InjVCD_DebDCDCStartDef_C "#SSD Fehlerentprellung Zustandsdauerfehler DC_STARTED" VALUE 0xE0F2A Kw_Ws16 327670.0 Time_ms 0.00 327670.0 FORMAT "%8.1" EXTENDED_LIMITS -327680.0 327670.0 /end CHARACTERISTIC
/begin CHARACTERISTIC InjVCD_DebUBufSRCHighDef_C "#SSD Defektentprellung für SRC-High-Fehler" VALUE 0xE14A4 Kw_Wu16 65535.00 OneToOne 0.00 65535.00 FORMAT "%8.2" /end CHARACTERISTIC
/begin CHARACTERISTIC InjVCD_DebUBufSRCHighOk_C "#SSD Heilungsentprellung für SRC-High-Fehler" VALUE 0xE14A6 Kw_Wu16 65535.00 OneToOne 0.00 65535.00 FORMAT "%8.2" /end CHARACTERISTIC
/begin CHARACTERISTIC InjVCD_DebUBufSRCLowDef_C "#SSD Defektentprellung für SRC-Low-Fehler" VALUE 0xE14A8 Kw_Wu16 65535.00 OneToOne 0.00 65535.00 FORMAT "%8.2" /end CHARACTERISTIC
/begin CHARACTERISTIC InjVCD_DebUBufSRCLowOk_C "#SSD Heilungsentprellung für SRC-Low-Fehler" VALUE 0xE14AA Kw_Wu16 65535.00 OneToOne 0.00 65535.00 FORMAT "%8.2" /end CHARACTERISTIC
/begin CHARACTERISTIC InjVCD_duInt_C "#SSD Gradient zur Kompensation des Abfalls der Integrator-Ausgangsspannung" VALUE 0xE0F02 Kw_Ws16 30.00000 Delta_Volt_INT 0.00 30.00000 FORMAT "%8.5" EXTENDED_LIMITS -32768.00 32767.00 /end CHARACTERISTIC
/begin CHARACTERISTIC InjVCD_facMonUThresHiPl_CA "#SSD Faktor fuer Schwelle fuer Spannungsplausibilisierung, Verletzung oben (index : 0=BOTT, 1=UP)" VAL_BLK 0xE14BC Kwb_Ws16 10.00000 Fact1 0.00 10.00000 FORMAT "%8.5" EXTENDED_LIMITS -256.0000 255.9922 NUMBER 2 /end CHARACTERISTIC
/begin CHARACTERISTIC InjVCD_facMonUThresLoPl_CA "#SSD Faktor fuer Schwelle fuer Spannungsplausibilisierung, Verletzung unten (index : 0=BOTT, 1=UP)" VAL_BLK 0xE14C0 Kwb_Ws16 20.00000 Fact1 -10.00000 10.00000 FORMAT "%8.5" EXTENDED_LIMITS -256.0000 255.9922 NUMBER 2 /end CHARACTERISTIC
/begin CHARACTERISTIC InjVCD_facWActrChrgCorr_C "#SSD Korrekturfaktor für Energieberechnung aus Spannungsdifferenz und Ladung beim Laden" VALUE 0xE0EAC Kw_Ws16 10.00000 Fact1 0.00 10.00000 FORMAT "%8.5" EXTENDED_LIMITS -256.0000 255.9922 /end CHARACTERISTIC
/begin CHARACTERISTIC InjVCD_facWActrCorr_C "#SSD Verstärkungsfaktor für das Verhältnis von nominalem zu korrigiertem Energieverbrauch einer Piezo-Aktor-Ansteuerung" VALUE 0xE0EAE Kw_Ws16 10.00000 Fact1 0.00 10.00000 FORMAT "%8.5" EXTENDED_LIMITS -256.0000 255.9922 /end CHARACTERISTIC
/begin CHARACTERISTIC InjVCD_facWActrDisChCorr_C "#SSD Korrekturfaktor für die Energieberechnung aus Spannungsdifferenz und Ladung beim Entladen" VALUE 0xE0EB0 Kw_Ws16 10.00000 Fact1 0.00 10.00000 FORMAT "%8.5" EXTENDED_LIMITS -256.0000 255.9922 /end CHARACTERISTIC
/begin CHARACTERISTIC InjVCD_facWActrDvtMax_C "#SSD Maximalwertbegrenzung für das Verhrhältnis von nominalem zu korrigiertem Aktor-Energieverbrauch" VALUE 0xE0EB2 Kw_Ws16 9.000000 Fact1 1.000000 10.00000 FORMAT "%8.5" EXTENDED_LIMITS -256.0000 255.9922 /end CHARACTERISTIC
/begin CHARACTERISTIC InjVCD_facWActrDvtMin_C "#SSD Minimalwertbegrenzung für das Verhrhältnis von nominalem zu korrigiertem Aktor-Energieverbrauch" VALUE 0xE0EB4 Kw_Ws16 1.000000 Fact1 0.00 1.000000 FORMAT "%8.6" EXTENDED_LIMITS -256.0000 255.9922 /end CHARACTERISTIC
/begin CHARACTERISTIC InjVCD_iPolarUp_CUR "Kennlinie für die Ladestromgrenze des Piezo-Aktors" CURVE 0xE14E0 Kl_Xs16_Ws16 30000.00 Curr 0.00 30000.00 FORMAT "%8.2" EXTENDED_LIMITS -32768.00 32767.00
 /begin AXIS_DESCR STD_AXIS InjVCD_tPolar_mp Temp_Cels 4 -50.14000 199.8600 FORMAT "%8.4" EXTENDED_LIMITS -3549.940 3003.560 DEPOSIT ABSOLUTE /end AXIS_DESCR
/end CHARACTERISTIC
/begin CHARACTERISTIC InjVCD_rCapUpTolc_C "#SSD Toleranzband für Kapazitätsverhältnis zur Erkennung von Kurzschlüssen der select-Schalter" VALUE 0xE14C4 Kw_Ws16 7.999878 Fact -4.000000 3.999878 FORMAT "%8.6" /end CHARACTERISTIC
/begin CHARACTERISTIC InjVCD_rTiChrgUpTolc_C "#SSD Toleranzband fuer Aktorladezeitverhaeltnis zum Erkennen eines Lowside Schalter Kurzschlusses" VALUE 0xE14C6 Kw_Ws16 7.999878 Fact -4.000000 3.999878 FORMAT "%8.6" /end CHARACTERISTIC
/begin CHARACTERISTIC InjVCD_nClsEng_C "#SSD Virtuelle Motordrehzahl während der Piezoaktor Klassifizierung im Steuergerätenachlauf" VALUE 0xE0F08 Kw_Ws16 5000.000 EngN 0.00 5000.000 FORMAT "%8.3" EXTENDED_LIMITS -32768.00 32767.00 /end CHARACTERISTIC
/begin CHARACTERISTIC InjVCD_nEngMonShCir_C "#SSD Virtuelle Drehzahl für die Ansteuerung im Nachlauf für Kurzschlussunterscheidung" VALUE 0xE14D0 Kw_Ws16 5000.000 EngN 0.00 5000.000 FORMAT "%8.3" EXTENDED_LIMITS -32768.00 32767.00 /end CHARACTERISTIC
/begin CHARACTERISTIC InjVCD_nETMaxLim_C "#SSD Schwelle für max. Drehzahl Begrenzung Ansteuerdauer" VALUE 0xE0F00 Kw_Ws16 65535.00 EngN -32768.00 32767.00 FORMAT "%8.2" /end CHARACTERISTIC
/begin CHARACTERISTIC InjVCD_nPolar_C "Virtuelle Drehzahl für die Polarisierung" VALUE 0xE14F2 Kw_Ws16 5960.000 EngN 40.00000 6000.000 FORMAT "%8.3" EXTENDED_LIMITS -32768.00 32767.00 /end CHARACTERISTIC
/begin CHARACTERISTIC InjVCD_numCollTyp_C "#SSD Nummer des Kollisionstyps" VALUE 0xC049C Kw_Wu8 10.00 OneToOne 0.00 10.00 FORMAT "%5.2" EXTENDED_LIMITS 0.00 255.0 /end CHARACTERISTIC
/begin CHARACTERISTIC InjVCD_numCylTestBench_C "#SSD Aktornummer für den Testbankbetrieb" VALUE 0xE0EA0 Kw_Wu8 255.0 OneToOne 0.00 255.0 FORMAT "%5.1" /end CHARACTERISTIC
/begin CHARACTERISTIC InjVCD_numFacWValidMin_C "#SSD Minimale Anzahl gültiger Werte von InjVCD_facWActrDvt_mp für die Freigabe des gemittelten Wertes InjVCD_facWActrDvt" VALUE 0xE0EB6 Kw_Ws16 100.0000 OneToOne 0.00 100.0000 FORMAT "%8.4" EXTENDED_LIMITS -32768.00 32767.00 /end CHARACTERISTIC
/begin CHARACTERISTIC InjVCD_numPolar_C "#SSD Anzahl der Polarisierungen pro Piezo-Aktor" VALUE 0xE14F4 Kw_Wu8 10.00 OneToOne 0.00 10.00 FORMAT "%5.2" EXTENDED_LIMITS 0.00 255.0 /end CHARACTERISTIC
/begin CHARACTERISTIC InjVCD_numWValidMin_C "#SSD Minimum gültiger Messwerte bevor die Mittelwertbildung der Aktorenergieen freigegeben wird" VALUE 0xE0EB8 Kw_Ws16 100.0000 OneToOne 0.00 100.0000 FORMAT "%8.4" EXTENDED_LIMITS -32768.00 32767.00 /end CHARACTERISTIC
/begin CHARACTERISTIC InjVCD_pClsRailMax_C "#SSD Maximal zulässiger Wert des Raildrucks während der Piezoaktor Klassifizierung im Steuergerätenachlauf" VALUE 0xE0F0A Kw_Ws16 2000.000 Pres_Rail 0.00 2000.000 FORMAT "%5.3" EXTENDED_LIMITS -3276.800 3276.700 /end CHARACTERISTIC
/begin CHARACTERISTIC InjVCD_pPolarMax_C "Maximal zulässiger Raildruck für Polarisierung" VALUE 0xE14F6 Kw_Ws16 2000.000 Pres_Rail 0.00 2000.000 FORMAT "%5.3" EXTENDED_LIMITS -3276.800 3276.700 /end CHARACTERISTIC
/begin CHARACTERISTIC InjVCD_pRailMonShCirMax_C "#SSD Maximale zulässiger Raildruck für die Ansteuerung im Nachlauf für Kurzschlussunterscheidung" VALUE 0xE14D2 Kw_Ws16 2000.000 Pres_Rail 0.00 2000.000 FORMAT "%5.3" EXTENDED_LIMITS -3276.800 3276.700 /end CHARACTERISTIC
/begin AXIS_PTS InjVCD_pRailZFCETCor_AXIS "gemeinsame Raildruck-Achse fuer ZFC Ansteuerdauerkorrektur-Kennfelder" 0xE153C RailCD_pAct_mp GSst_Xs16 600000.0 Pres_Rail 6 200000.0 800000.0 FORMAT "%8.1" EXTENDED_LIMITS -3276800. 3276700. DEPOSIT ABSOLUTE /end AXIS_PTS
/begin AXIS_PTS InjVCD_qZFCETCor_AXIS "Stuetzstellen der Menge fuer Korrekturfaktor-Gruppenkennfelder der Ansteuerdauerkorrektur der Nullmengenkalibrierung" 0xE154A InjVCD_qInZFCETGMap_mp GSst_Xs16 3.000000 InjMassInj 6 0.00 3.000000 FORMAT "%8.6" EXTENDED_LIMITS -327.6800 327.6700 DEPOSIT ABSOLUTE /end AXIS_PTS
/begin CHARACTERISTIC InjVCD_rClsVoltMin_C "#SSD Min. erlaubtes Verhältniss von (Aktorspannung-Beginn)/(Aktorspannung-Ende)" VALUE 0xE0F0C Kw_Wu16 1.000000 Milli 1.000000 2.000000 FORMAT "%8.6" EXTENDED_LIMITS 0.00 65.53500 /end CHARACTERISTIC
/begin CHARACTERISTIC InjVCD_resCalcChrgShunt_C "#SSD Wert des Shunt-Widerstands zur Ladungsberechnung" VALUE 0xE0F04 Kw_Ws16 0.00 Resist_mOhm 20.00000 20.00000 FORMAT "%8.5" EXTENDED_LIMITS -3276.800 3276.700 /end CHARACTERISTIC
/begin CHARACTERISTIC InjVCD_rMonShCirTiChrgUpTolc_C "#SSD Toleranzfenster für das Ladezeitverhältnis" VALUE 0xE14D4 Kw_Ws16 7.999878 Fact -4.000000 3.999878 FORMAT "%8.6" /end CHARACTERISTIC
/begin CHARACTERISTIC InjVCD_rZFCETDif0_GMAP "Gruppenkennfeld Bewertungsfaktor fuer Ansteuerdauerkorrektur durch Nullmengenkalibrierung am Raildruck-Kalibrierpunkt 0" MAP 0xE1558 Gkf_Ws16 100.0000 Prc 0.00 100.0000 FORMAT "%8.4" EXTENDED_LIMITS -400.0000 399.9878
 /begin AXIS_DESCR COM_AXIS RailCD_pAct_mp Pres_Rail 6 200.0000 2000.0000 FORMAT "%5.4" EXTENDED_LIMITS -3276.8000 3276.7000 AXIS_PTS_REF InjVCD_pRailZFCETCor_AXIS /end AXIS_DESCR
 /begin AXIS_DESCR COM_AXIS InjVCD_qInZFCETGMap_mp InjMassInj 6 0.00 3.000000 FORMAT "%8.6" EXTENDED_LIMITS -327.6800 327.6700 AXIS_PTS_REF InjVCD_qZFCETCor_AXIS /end AXIS_DESCR
/end CHARACTERISTIC
/begin CHARACTERISTIC InjVCD_rZFCETDif1_GMAP "Gruppenkennfeld Bewertungsfaktor fuer Ansteuerdauerkorrektur durch Nullmengenkalibrierung am Raildruck-Kalibrierpunkt 1" MAP 0xE15A0 Gkf_Ws16 100.0000 Prc 0.00 100.0000 FORMAT "%8.4" EXTENDED_LIMITS -400.0000 399.9878
 /begin AXIS_DESCR COM_AXIS RailCD_pAct_mp Pres_Rail 6 200.0000 2000.0000 FORMAT "%5.4" EXTENDED_LIMITS -3276.8000 3276.7000 AXIS_PTS_REF InjVCD_pRailZFCETCor_AXIS /end AXIS_DESCR
 /begin AXIS_DESCR COM_AXIS InjVCD_qInZFCETGMap_mp InjMassInj 6 0.00 3.000000 FORMAT "%8.6" EXTENDED_LIMITS -327.6800 327.6700 AXIS_PTS_REF InjVCD_qZFCETCor_AXIS /end AXIS_DESCR
/end CHARACTERISTIC
/begin CHARACTERISTIC InjVCD_rZFCETDif2_GMAP "#SSD Gruppenkennfeld Bewertungsfaktor fuer Ansteuerdauerkorrektur durch Nullmengenkalibrierung am Raildruck-Kalibrierpunkt 2" MAP 0xE15E8 Gkf_Ws16 100.0000 Prc 0.00 100.0000 FORMAT "%8.4" EXTENDED_LIMITS -400.0000 399.9878
 /begin AXIS_DESCR COM_AXIS RailCD_pAct_mp Pres_Rail 6 200.0000 2000.0000 FORMAT "%5.4" EXTENDED_LIMITS -3276.8000 3276.7000 AXIS_PTS_REF InjVCD_pRailZFCETCor_AXIS /end AXIS_DESCR
 /begin AXIS_DESCR COM_AXIS InjVCD_qInZFCETGMap_mp InjMassInj 6 0.00 3.000000 FORMAT "%8.6" EXTENDED_LIMITS -327.6800 327.6700 AXIS_PTS_REF InjVCD_qZFCETCor_AXIS /end AXIS_DESCR
/end CHARACTERISTIC
/begin CHARACTERISTIC InjVCD_rZFCETMsk_GMAP "Gruppenkennfeld Gesamtbewertungsfaktor der Ansteuerdauerkorrektur durch Nullmengenkalibrierung" MAP 0xE1630 Gkf_Ws16 100.0000 Prc 0.00 100.0000 FORMAT "%8.4" EXTENDED_LIMITS -400.0000 399.9878
 /begin AXIS_DESCR COM_AXIS RailCD_pAct_mp Pres_Rail 6 200.0000 2000.0000 FORMAT "%5.4" EXTENDED_LIMITS -3276.8000 3276.7000 AXIS_PTS_REF InjVCD_pRailZFCETCor_AXIS /end AXIS_DESCR
 /begin AXIS_DESCR COM_AXIS InjVCD_qInZFCETGMap_mp InjMassInj 6 0.00 3.000000 FORMAT "%8.6" EXTENDED_LIMITS -327.6800 327.6700 AXIS_PTS_REF InjVCD_qZFCETCor_AXIS /end AXIS_DESCR
/end CHARACTERISTIC
/begin CHARACTERISTIC InjVCD_stCY370RcyTst_C "#SSD Testlabel zum Testen der Recoveries im InjVCD_CY370-Prozess" VALUE 0xE0F26 Kw_Wu8 255.0 OneToOne 0.00 255.0 FORMAT "%5.1" /end CHARACTERISTIC
/begin CHARACTERISTIC InjVCD_stInjMode_C "Verhalten der Umschaltung von Anzugsphase auf Haltephase" VALUE 0xC0494 Kw_Wu8 3.000 OneToOne 0.00 3.000 FORMAT "%5.3" EXTENDED_LIMITS 0.00 255.0 /end CHARACTERISTIC
/begin CHARACTERISTIC InjVCD_stInputZFCETGMap_C "Auswahl der Menge fuer Anzeige der Gruppenkennfelder InjVCD_rZFCETDif0_GMAP, ...Dif1_GMAP, ...Msk_GMAP" VALUE 0xE1678 Kw_Wu8 255.0 OneToOne 0.00 255.0 FORMAT "%5.1" /end CHARACTERISTIC
/begin CHARACTERISTIC InjVCD_stZFCETCorActv_C "Aktivierungsstatus der ZFC Ansteuerdauerkorrektur (0 = keine Korrektur)" VALUE 0xE1679 Kw_Wu8 0.00 OneToOne 0.00 0.00 FORMAT "%5.2" EXTENDED_LIMITS 0.00 255.0 /end CHARACTERISTIC
/begin CHARACTERISTIC InjVCD_swtEnaAgDiff_C "#SSD Ein-/Ausschalter zur Berechnung des Differenzwinkels" VALUE 0xE0E7C Kw_Wu8 1.000 OneToOne 0.00 1.000 FORMAT "%5.3" EXTENDED_LIMITS 0.00 255.0 /end CHARACTERISTIC
/begin CHARACTERISTIC InjVCD_swtEnaWActrCorr_C "#SSD Schalter für die Berücksichtigung des gemssenen aktorspezifischen Energieverbrauchs bei der Abschaltung von Einspritzungen" VALUE 0xE0EBA Kw_Wu8 1.000 OneToOne 0.00 1.000 FORMAT "%5.3" EXTENDED_LIMITS 0.00 255.0 /end CHARACTERISTIC
/begin CHARACTERISTIC InjVCD_swtEvMgmt_C "#SSD Freigabeschalter des Flankenmanagements" VALUE 0xC049E Kw_Ws16 1000.000 OneToOne 0.00 1000.000 FORMAT "%8.3" EXTENDED_LIMITS -32768.00 32767.00 /end CHARACTERISTIC
/begin CHARACTERISTIC InjVCD_swtInputETMAP_C "Auswahl der Eingangsgrössen zur Darstellung von InjVCD_tiET_MAP auf dem Applikationstool." VALUE 0xE0F2E Kw_Wu8 15.00 OneToOne 0.00 15.00 FORMAT "%5.2" EXTENDED_LIMITS 0.00 255.0 /end CHARACTERISTIC
/begin CHARACTERISTIC InjVCD_swtPolarOvrlap_C "Polarisierungsmodus: Ansteuerungen auf verschiedenen Bänken können einander überlappen" VALUE 0xE14F8 Kw_Wu8 1.000 OneToOne 0.00 1.000 FORMAT "%5.3" EXTENDED_LIMITS 0.00 255.0 /end CHARACTERISTIC
/begin CHARACTERISTIC InjVCD_swtSelTempVal_C "#SSD Schalterstellung zur Auswahl der Aktortemperatur" VALUE 0xE0EEA Kw_Wu8 1.000 OneToOne 0.00 1.000 FORMAT "%5.3" EXTENDED_LIMITS 0.00 255.0 /end CHARACTERISTIC
/begin CHARACTERISTIC InjVCD_swtSelTempType_C "#SSD Schaltertyp für Aktortemperaturauswahl" VALUE 0xE0EEB Kw_Wu8 1.000 OneToOne 1.000 2.000 FORMAT "%5.3" EXTENDED_LIMITS 0.00 255.0 /end CHARACTERISTIC
/begin CHARACTERISTIC InjVCD_swtShOffDCDCTst_C "#SSD Testschalter zum Test des Ladeschalterkurzschlusses" VALUE 0xE1539 Kw_Wu8 255.0 OneToOne 0.00 255.0 FORMAT "%5.1" /end CHARACTERISTIC
/begin CHARACTERISTIC InjVCD_tActrDfl_C "#SSD Vorgabetemperatur der Piezo-Aktoren" VALUE 0xE0EEC Kw_Ws16 950.000 Temp_Cels -50.140 899.860 FORMAT "%8.3" EXTENDED_LIMITS -3549.940 3003.560 /end CHARACTERISTIC
/begin CHARACTERISTIC InjVCD_tActr_CUR "#SSD Bestimmung der Aktortemperatur aus der Kühlwassertemperatur" CURVE 0xE0EEE Kl_Xs16_Ws16 250.0000 Temp_Cels -50.1400 199.8600 FORMAT "%8.4" EXTENDED_LIMITS -3549.940 3003.560
 /begin AXIS_DESCR STD_AXIS InjVCD_tActr_mp Temp_Cels 4 -50.140 899.860 FORMAT "%8.3" EXTENDED_LIMITS -3549.940 3003.560 DEPOSIT ABSOLUTE /end AXIS_DESCR
/end CHARACTERISTIC
/begin CHARACTERISTIC InjVCD_tiClsLead_C "#SSD Vorhaltezeit für die Ansteuerung des Piezoaktors während der Klassifizierung im Steuergerätenachlauf" VALUE 0xE0F0E Kw_Wu16 5000.000 InjTime_us 0.00 5000.000 FORMAT "%8.3" EXTENDED_LIMITS 0.00 65535.00 /end CHARACTERISTIC
/begin CHARACTERISTIC InjVCD_tiClsMeasBeg_C "#SSD Aktorspannung am Beginn der Ansteuerung" VALUE 0xE0F10 Kw_Wu16 5000.000 InjTime_us 0.00 5000.000 FORMAT "%8.3" EXTENDED_LIMITS 0.00 65535.00 /end CHARACTERISTIC
/begin CHARACTERISTIC InjVCD_tiClsMeasEnd_C "#SSD Aktorspannung am Ende der Ansteuerung" VALUE 0xE0F12 Kw_Wu16 5000.000 InjTime_us 0.00 5000.000 FORMAT "%8.3" EXTENDED_LIMITS 0.00 65535.00 /end CHARACTERISTIC
/begin CHARACTERISTIC InjVCD_tiClsMeasure_C "#SSD Messzeit zwischen Begin- und Endspannung des Piezoaktors während der Klassifizierung im Steuergerätenachlauf" VALUE 0xE0F14 Kw_Wu32 95000.0000000 InjTime_us 0.00 95000.0000000 FORMAT "%13.7" EXTENDED_LIMITS 0.00 4294967295.00 /end CHARACTERISTIC
/begin CHARACTERISTIC InjVCD_tiETMax_C "#SSD Schwelle für maximal zulässige Ansteuerdauer bei Drehzahl >  InjVCD_nETMaxLim_C" VALUE 0xC0492 Kw_Ws16 65535.00 InjTime_us -32768.00 32767.00 FORMAT "%8.2" /end CHARACTERISTIC
/begin CHARACTERISTIC InjVCD_tiETMinHigh_C "#SSD Obere Schwelle: minimale AD" VALUE 0xE0E7E Kw_Ws16 65535.00 InjTime_us -32768.00 32767.00 FORMAT "%8.2" /end CHARACTERISTIC
/begin CHARACTERISTIC InjVCD_tiETMinLow_C "#SSD Minimale Ansteuerdauer" VALUE 0xC0496 Kw_Ws16 65535.00 InjTime_us -32768.00 32767.00 FORMAT "%8.2" /end CHARACTERISTIC
/begin CHARACTERISTIC InjVCD_tiET_MAP "#SSD Kennfeld zur Umrechnung von Einspritzmengen in Ansteuerdauer. Gilt für alle Einspritzungen." MAP 0xE0F30 Kf_Xs16_Ys16_Ws16 5000.000 InjTime_us 0.00 5000.000 FORMAT "%8.3" EXTENDED_LIMITS -32768.00 32767.00
 /begin AXIS_DESCR STD_AXIS InjVCD_pInET_mp Pres_Rail 16 0.00 2000.000 FORMAT "%5.3" EXTENDED_LIMITS -3276.800 3276.700 DEPOSIT ABSOLUTE /end AXIS_DESCR
 /begin AXIS_DESCR STD_AXIS InjVCD_volInET_mp InjQntInj 40 0.00 327.6700 FORMAT "%8.4" EXTENDED_LIMITS -327.6800 327.6700 DEPOSIT ABSOLUTE /end AXIS_DESCR
/end CHARACTERISTIC
/begin CHARACTERISTIC InjVCD_tiHoldMin_C "#SSD kleinste Dauer der Haltestromphase bei einer Einspritzung" VALUE 0xC0498 Kw_Ws16 5000.000 InjTime_us 0.00 5000.000 FORMAT "%8.3" EXTENDED_LIMITS -32768.00 32767.00 /end CHARACTERISTIC
/begin CHARACTERISTIC InjVCD_tiIntValid_C "Gültigkeitsdauer der Ladungswerte nach Integratorabgleich auf dem Endstufenbaustein" VALUE 0xE0EA4 Kw_Wu32 1800000.00000 Time_ms 0.00 1800000.00000 FORMAT "%13.5" EXTENDED_LIMITS 0.00 42949672950.0 /end CHARACTERISTIC
/begin CHARACTERISTIC InjVCD_tiLeadJit_C "#SSD Dynamischer Vorhalt" VALUE 0xC04A0 Kw_Wu32 5000.00000000 InjTime_us 0.00 5000.00000000 FORMAT "%13.8" EXTENDED_LIMITS 0.00 4294967295.00 /end CHARACTERISTIC
/begin CHARACTERISTIC InjVCD_tiLeadPost1_C "#SSD Strategischer Vorhalt" VALUE 0xC04A4 Kw_Wu32 5000.00000000 InjTime_us 0.00 5000.00000000 FORMAT "%13.8" EXTENDED_LIMITS 0.00 4294967295.00 /end CHARACTERISTIC
/begin CHARACTERISTIC InjVCD_tiLeadPost2_C "#SSD Strategischer Vorhalt" VALUE 0xC04A8 Kw_Wu32 5000.00000000 InjTime_us 0.00 5000.00000000 FORMAT "%13.8" EXTENDED_LIMITS 0.00 4294967295.00 /end CHARACTERISTIC
/begin CHARACTERISTIC InjVCD_tiLeadPost3_C "#SSD Strategischer Vorhalt" VALUE 0xC04AC Kw_Wu32 5000.00000000 InjTime_us 0.00 5000.00000000 FORMAT "%13.8" EXTENDED_LIMITS 0.00 4294967295.00 /end CHARACTERISTIC
/begin CHARACTERISTIC InjVCD_tiLeadPost4_C "#SSD Strategischer Vorhalt" VALUE 0xC04B0 Kw_Wu32 5000.00000000 InjTime_us 0.00 5000.00000000 FORMAT "%13.8" EXTENDED_LIMITS 0.00 4294967295.00 /end CHARACTERISTIC
/begin CHARACTERISTIC InjVCD_tiLeadPre1_C "#SSD Strategischer Vorhalt" VALUE 0xC04B4 Kw_Wu32 5000.00000000 InjTime_us 0.00 5000.00000000 FORMAT "%13.8" EXTENDED_LIMITS 0.00 4294967295.00 /end CHARACTERISTIC
/begin CHARACTERISTIC InjVCD_tiLeadPre2_C "#SSD Strategischer Vorhalt" VALUE 0xC04B8 Kw_Wu32 5000.00000000 InjTime_us 0.00 5000.00000000 FORMAT "%13.8" EXTENDED_LIMITS 0.00 4294967295.00 /end CHARACTERISTIC
/begin CHARACTERISTIC InjVCD_tiLeadPre3_C "#SSD Strategischer Vorhalt" VALUE 0xC04BC Kw_Wu32 5000.00000000 InjTime_us 0.00 5000.00000000 FORMAT "%13.8" EXTENDED_LIMITS 0.00 4294967295.00 /end CHARACTERISTIC
/begin CHARACTERISTIC InjVCD_tiLeadPre4_C "#SSD Strategischer Vorhalt" VALUE 0xC04C0 Kw_Wu32 5000.00000000 InjTime_us 0.00 5000.00000000 FORMAT "%13.8" EXTENDED_LIMITS 0.00 4294967295.00 /end CHARACTERISTIC
/begin CHARACTERISTIC InjVCD_tiMI1ET_Vector "#SSD Bypass-Label, nicht editieren !" VALUE 0xC2DEC Kw_Wu8 255.0 OneToOne 0.00 255.0 FORMAT "%5.1" /end CHARACTERISTIC
/begin CHARACTERISTIC InjVCD_tiMI1ET_Channel "#SSD Bypass-Label, nicht editieren !" VALUE 0xC2DED Kw_Wu8 255.0 OneToOne 0.00 255.0 FORMAT "%5.1" /end CHARACTERISTIC
/begin CHARACTERISTIC InjVCD_tiMi1ThresLo_C "#SSD Schwelle zur Prüfung des Meßzeitpunkts der Aktorspannung" VALUE 0xE14C8 Kw_Ws32 2147483647.00 InjTime_us 0.00 2147483647.00 FORMAT "%13.2" EXTENDED_LIMITS -2147483648.00 2147483647.00 /end CHARACTERISTIC
/begin CHARACTERISTIC InjVCD_tiMonET_C "#SSD Ansteuerdauer für Kurzschlussunterscheidung" VALUE 0xE14D6 Kw_Ws16 7700.000 InjTime_us 200.0000 7900.000 FORMAT "%8.3" EXTENDED_LIMITS -32768.00 32767.00 /end CHARACTERISTIC
/begin CHARACTERISTIC InjVCD_tiMonLead_C "#SSD Abstand zwischen Entlade- Ladezeit" VALUE 0xE14D8 Kw_Ws16 4950.000 InjTime_us 50.00000 5000.000 FORMAT "%8.3" EXTENDED_LIMITS -32768.00 32767.00 /end CHARACTERISTIC
/begin CHARACTERISTIC InjVCD_tiMonThresHiPlaus_C "#SSD Maximalschwelle der Ladezeit" VALUE 0xE14CC Kw_Ws16 3276.700 Time_Busy 0.00 3276.700 FORMAT "%8.3" EXTENDED_LIMITS -3276.800 3276.700 /end CHARACTERISTIC
/begin CHARACTERISTIC InjVCD_tiMonThresLoPlaus_C "#SSD Minimalschwelle für Ladezeit" VALUE 0xE14CE Kw_Ws16 3276.700 Time_Busy 0.00 3276.700 FORMAT "%8.3" EXTENDED_LIMITS -3276.800 3276.700 /end CHARACTERISTIC
/begin CHARACTERISTIC InjVCD_tiPiI1ET_Vector "#SSD Bypass-Label, nicht editieren !" VALUE 0xC2DEE Kw_Wu8 255.0 OneToOne 0.00 255.0 FORMAT "%5.1" /end CHARACTERISTIC
/begin CHARACTERISTIC InjVCD_tiPiI1ET_Channel "#SSD Bypass-Label, nicht editieren !" VALUE 0xC2DEF Kw_Wu8 255.0 OneToOne 0.00 255.0 FORMAT "%5.1" /end CHARACTERISTIC
/begin CHARACTERISTIC InjVCD_tiPiI2ET_Vector "#SSD Bypass-Label, nicht editieren !" VALUE 0xC2DF0 Kw_Wu8 255.0 OneToOne 0.00 255.0 FORMAT "%5.1" /end CHARACTERISTIC
/begin CHARACTERISTIC InjVCD_tiPiI2ET_Channel "#SSD Bypass-Label, nicht editieren !" VALUE 0xC2DF1 Kw_Wu8 255.0 OneToOne 0.00 255.0 FORMAT "%5.1" /end CHARACTERISTIC
/begin CHARACTERISTIC InjVCD_tiPoI1ET_Vector "#SSD Bypass-Label, nicht editieren !" VALUE 0xC2DF2 Kw_Wu8 255.0 OneToOne 0.00 255.0 FORMAT "%5.1" /end CHARACTERISTIC
/begin CHARACTERISTIC InjVCD_tiPoI1ET_Channel "#SSD Bypass-Label, nicht editieren !" VALUE 0xC2DF3 Kw_Wu8 255.0 OneToOne 0.00 255.0 FORMAT "%5.1" /end CHARACTERISTIC
/begin CHARACTERISTIC InjVCD_tiPoI2ET_Vector "#SSD Bypass-Label, nicht editieren !" VALUE 0xC2DF4 Kw_Wu8 255.0 OneToOne 0.00 255.0 FORMAT "%5.1" /end CHARACTERISTIC
/begin CHARACTERISTIC InjVCD_tiPoI2ET_Channel "#SSD Bypass-Label, nicht editieren !" VALUE 0xC2DF5 Kw_Wu8 255.0 OneToOne 0.00 255.0 FORMAT "%5.1" /end CHARACTERISTIC
/begin CHARACTERISTIC InjVCD_tiPolarET_CUR "Ansteuerdauer der Polarisierung als Funktion der Kühlmitteltemperatur" CURVE 0xE14FA Kl_Xs16_Ws16 7900.000 InjTime_us 0.00 7900.000 FORMAT "%8.3" EXTENDED_LIMITS -32768.00 32767.00
 /begin AXIS_DESCR STD_AXIS InjVCD_tPolar_mp Temp_Cels 4 -50.14000 199.8600 FORMAT "%8.4" EXTENDED_LIMITS -3549.940 3003.560 DEPOSIT ABSOLUTE /end AXIS_DESCR
/end CHARACTERISTIC
/begin CHARACTERISTIC InjVCD_tiPolarLead_C "#SSD Minimaler Abstand zwischen zwei Ansteuerungen (Polarisierung)" VALUE 0xE150C Kw_Ws16 4950.000 InjTime_us 50.00000 5000.000 FORMAT "%8.3" EXTENDED_LIMITS -32768.00 32767.00 /end CHARACTERISTIC
/begin CHARACTERISTIC InjVCD_tiPolarOvrlap_C "Minimale Ansteuerdauer für die überlappende Aktoransteuerung während der Polarisierung" VALUE 0xE150E Kw_Ws16 7700.000 InjTime_us 200.0000 7900.000 FORMAT "%8.3" EXTENDED_LIMITS -32768.00 32767.00 /end CHARACTERISTIC
/begin CHARACTERISTIC InjVCD_tiPolarPse_C "Maximale Lade- / Entladezeit des Aktors" VALUE 0xE1510 Kw_Ws16 5000.000 InjTime_us 0.00 5000.000 FORMAT "%8.3" EXTENDED_LIMITS -32768.00 32767.00 /end CHARACTERISTIC
/begin CHARACTERISTIC InjVCD_tiPolarPse_CUR "Pausezeit der Polarisierung als Funktion der Ansteuerdauer" CURVE 0xE1512 Kl_Xs16_Ws16 7900.000 InjTime_us 0.00 7900.000 FORMAT "%8.3" EXTENDED_LIMITS -32768.00 32767.00
 /begin AXIS_DESCR STD_AXIS InjVCD_tiPolarET_mp InjTime_us 4 200.0000 7900.000 FORMAT "%8.3" EXTENDED_LIMITS -32768.00 32767.00 DEPOSIT ABSOLUTE /end AXIS_DESCR
/end CHARACTERISTIC
/begin CHARACTERISTIC InjVCD_tiZFCETCorMax_C "maximale ZFC Ansteuerdauerkorrektur" VALUE 0xE167A Kw_Ws16 5300.0000 InjTime_us -300.0000 5000.0000 FORMAT "%8.4" EXTENDED_LIMITS -32768.00 32767.00 /end CHARACTERISTIC
/begin CHARACTERISTIC InjVCD_tiZFCETCorMin_C "minimale ZFC Ansteuerdauerkorrektur" VALUE 0xE167C Kw_Ws16 5300.0000 InjTime_us -300.0000 5000.0000 FORMAT "%8.4" EXTENDED_LIMITS -32768.00 32767.00 /end CHARACTERISTIC
/begin CHARACTERISTIC InjVCD_tPolarMax_C "Maximal zulässige Temperatur für die Polarisierung" VALUE 0xE1524 Kw_Ws16 250.0000 Temp_Cels -50.14000 199.8600 FORMAT "%8.4" EXTENDED_LIMITS -3549.940 3003.560 /end CHARACTERISTIC
/begin CHARACTERISTIC InjVCD_uBufCLoLim_C "#SSD Untergrenze der Pufferspannung des DC/DC-Wandlers im Normalzustand" VALUE 0xE0F2C Kw_Ws16 45.00000 Volt_BUFC 215.0000 260.0000 FORMAT "%8.4" EXTENDED_LIMITS -327.6800 327.6700 /end CHARACTERISTIC
/begin CHARACTERISTIC InjVCD_uBufSRCMin_C "#SSD SRC-low-Wert der Buffer-Spannung" VALUE 0xE14AC Kw_Ws16 5200.391 Volt 0.00 5200.391 FORMAT "%8.3" EXTENDED_LIMITS -160156.4 160151.5 /end CHARACTERISTIC
/begin CHARACTERISTIC InjVCD_uBufSRCMax_C "#SSD SRC-high-Wert der Buffer-Spannung" VALUE 0xE14AE Kw_Ws16 5200.391 Volt 0.00 5200.391 FORMAT "%8.3" EXTENDED_LIMITS -160156.4 160151.5 /end CHARACTERISTIC
/begin CHARACTERISTIC InjVCD_uBufLin_CUR "#SSD Kennlinie zur Linearisierung der Bufferspannung" CURVE 0xE14B0 Kl_Xs16_Ws16 320.0000 Volt_BUFC 0.00 320.0000 FORMAT "%8.4" EXTENDED_LIMITS -327.6800 327.6700
 /begin AXIS_DESCR STD_AXIS InjVCD_uBufRaw_mp Volt 2 0.00 5200.391 FORMAT "%8.3" EXTENDED_LIMITS -160156.4 160151.5 DEPOSIT ABSOLUTE /end AXIS_DESCR
/end CHARACTERISTIC
/begin CHARACTERISTIC InjVCD_uPolarUp_CUR "Aktor Up-Niveau der Polarisierung als Funktion der Kühlmitteltemperatur" CURVE 0xE1526 Kl_Xs16_Ws16 500.0000 Volt_PA -250.0000 250.0000 FORMAT "%8.4" EXTENDED_LIMITS -327.6800 327.6700
 /begin AXIS_DESCR STD_AXIS InjVCD_tPolar_mp Temp_Cels 4 -50.14000 199.8600 FORMAT "%8.4" EXTENDED_LIMITS -3549.940 3003.560 DEPOSIT ABSOLUTE /end AXIS_DESCR
/end CHARACTERISTIC
/begin CHARACTERISTIC InjVCD_uShOffBufThres_C "#SSD Spannungsschwelle für Schutzsbschaltung des DC/DC-Wandlers bei Ladeschalterkurzschluss" VALUE 0xE153A Kw_Ws16 60.00000 Volt_PA 210.0000 270.0000 FORMAT "%8.4" EXTENDED_LIMITS -327.6800 327.6700 /end CHARACTERISTIC
/begin CHARACTERISTIC InjVCD_wActrChrgDfl_C "#SSD Defaultwert für die Ladeenergie" VALUE 0xE0EBC Kw_Ws16 100.0000 W_PA 0.00 100.0000 FORMAT "%8.4" EXTENDED_LIMITS -32768.00 32767.00 /end CHARACTERISTIC
/begin CHARACTERISTIC InjVCD_wActrDiffPlausMax_C "#SSD Grenzwert über dem die Differenz aus Lade- und Entladeenergie als unplausibel betrachtet wird" VALUE 0xE0EBE Kw_Ws16 100.0000 W_PA 0.00 100.0000 FORMAT "%8.4" EXTENDED_LIMITS -32768.00 32767.00 /end CHARACTERISTIC
/begin CHARACTERISTIC InjVCD_wActrDiffPlausMin_C "#SSD Grenzwert unter dem die Differenz aus Lade- und Entladeenergie als unplausibel betrachtet wird" VALUE 0xE0EC0 Kw_Ws16 100.0000 W_PA 0.00 100.0000 FORMAT "%8.4" EXTENDED_LIMITS -32768.00 32767.00 /end CHARACTERISTIC
/begin CHARACTERISTIC InjVCD_wActrDisChDfl_C "#SSD Defaultwert für die Entladeenergie des Piezo-Aktors" VALUE 0xE0EC2 Kw_Ws16 100.0000 W_PA 0.00 100.0000 FORMAT "%8.4" EXTENDED_LIMITS -32768.00 32767.00 /end CHARACTERISTIC
/begin CHARACTERISTIC InjVCD_wActrNom_CUR "#SSD Kennlinie für den injektorseitigen Energieverbrauch einer Piezo-Aktor-Ansteuerung" CURVE 0xE0EC4 Kl_Xs16_Ws16 100.0000 W_PA 0.00 100.0000 FORMAT "%8.4" EXTENDED_LIMITS -32768.00 32767.00
 /begin AXIS_DESCR STD_AXIS InjVCD_uSetThresActr_mp Volt_PA 8 -327.6800 327.6700 FORMAT "%8.4" DEPOSIT ABSOLUTE /end AXIS_DESCR
/end CHARACTERISTIC
/begin CHARACTERISTIC InjVCD_wActrPlausMax_C "#SSD Grenzwert über dem die bestimmten Energiewerte des Piezo-Aktors als unplausibel betrachtet werden." VALUE 0xE0EE6 Kw_Ws16 320.0000 W_PA 0.00 320.0000 FORMAT "%8.4" EXTENDED_LIMITS -32768.00 32767.00 /end CHARACTERISTIC
/begin CHARACTERISTIC InjVCD_wActrPlausMin_C "#SSD Grenzwert unter dem die bestimmten Energiewerte des Piezo-Aktors als unplausibel betrachtet werden." VALUE 0xE0EE8 Kw_Ws16 100.0000 W_PA 0.00 100.0000 FORMAT "%8.4" EXTENDED_LIMITS -32768.00 32767.00 /end CHARACTERISTIC
/begin CHARACTERISTIC InjVlv_ctMonQckThresLo_C "#SSD Zählerschwelle für Schnell-Erkennung der Kurzschlüsse nach Batterie und Masse bei niedrigen Motordrehzahlen" VALUE 0xE1BFC Kw_Wu8 255.0 OneToOne 0.00 255.0 FORMAT "%5.1" /end CHARACTERISTIC
/begin CHARACTERISTIC InjVlv_ctMonQckThres_C "#SSD Zählerschwelle für Schnell-Erkennung der Kurzschlüsse nach Batterie und Masse" VALUE 0xE1BFD Kw_Wu8 255.0 OneToOne 0.00 255.0 FORMAT "%5.1" /end CHARACTERISTIC
/begin CHARACTERISTIC InjVlv_DebBnkA0Def_C "#SSD Defektentprellung für A Bankfehlerpfade Bit 0" VALUE 0xE1BFE Kw_Wu16 65535.00 OneToOne 0.00 65535.00 FORMAT "%8.2" /end CHARACTERISTIC
/begin CHARACTERISTIC InjVlv_DebBnkA0Ok_C "#SSD Heilungsentprellung für A Bankfehlerpfade Bit 0" VALUE 0xE1C00 Kw_Wu16 65535.00 OneToOne 0.00 65535.00 FORMAT "%8.2" /end CHARACTERISTIC
/begin CHARACTERISTIC InjVlv_DebBnkA1Def_C "#SSD Defektentprellung für A Bankfehlerpfade Bit 1" VALUE 0xE1C02 Kw_Wu16 65535.00 OneToOne 0.00 65535.00 FORMAT "%8.2" /end CHARACTERISTIC
/begin CHARACTERISTIC InjVlv_DebBnkA1Ok_C "#SSD Heilungsentprellung für A Bankfehlerpfade Bit 1" VALUE 0xE1C04 Kw_Wu16 65535.00 OneToOne 0.00 65535.00 FORMAT "%8.2" /end CHARACTERISTIC
/begin CHARACTERISTIC InjVlv_DebBnkA2Def_C "#SSD Defektentprellung für A Bankfehlerpfade Bit 2" VALUE 0xE1C06 Kw_Wu16 65535.00 OneToOne 0.00 65535.00 FORMAT "%8.2" /end CHARACTERISTIC
/begin CHARACTERISTIC InjVlv_DebBnkA2Ok_C "#SSD Heilungsentprellung für A Bankfehlerpfade Bit 2" VALUE 0xE1C08 Kw_Wu16 65535.00 OneToOne 0.00 65535.00 FORMAT "%8.2" /end CHARACTERISTIC
/begin CHARACTERISTIC InjVlv_DebBnkA3Def_C "#SSD Defektentprellung für A Bankfehlerpfade Bit 3" VALUE 0xE1C0A Kw_Wu16 65535.00 OneToOne 0.00 65535.00 FORMAT "%8.2" /end CHARACTERISTIC
/begin CHARACTERISTIC InjVlv_DebBnkA3Ok_C "#SSD Heilungsentprellung für A Bankfehlerpfade Bit 3" VALUE 0xE1C0C Kw_Wu16 65535.00 OneToOne 0.00 65535.00 FORMAT "%8.2" /end CHARACTERISTIC
/begin CHARACTERISTIC InjVlv_DebBnkB0Def_C "#SSD Defektentprellung für B Bankfehlerpfade Bit 0" VALUE 0xE1C0E Kw_Wu16 65535.00 OneToOne 0.00 65535.00 FORMAT "%8.2" /end CHARACTERISTIC
/begin CHARACTERISTIC InjVlv_DebBnkB0Ok_C "#SSD Heilungsentprellung für B Bankfehlerpfade Bit 0" VALUE 0xE1C10 Kw_Wu16 65535.00 OneToOne 0.00 65535.00 FORMAT "%8.2" /end CHARACTERISTIC
/begin CHARACTERISTIC InjVlv_DebBnkB1Def_C "#SSD Defektentprellung für B Bankfehlerpfade Bit 1" VALUE 0xE1C12 Kw_Wu16 65535.00 OneToOne 0.00 65535.00 FORMAT "%8.2" /end CHARACTERISTIC
/begin CHARACTERISTIC InjVlv_DebBnkB1Ok_C "#SSD Heilungsentprellung für B Bankfehlerpfade Bit 1" VALUE 0xE1C14 Kw_Wu16 65535.00 OneToOne 0.00 65535.00 FORMAT "%8.2" /end CHARACTERISTIC
/begin CHARACTERISTIC InjVlv_DebBnkB2Def_C "#SSD Defektentprellung für B Bankfehlerpfade Bit 2" VALUE 0xE1C16 Kw_Wu16 65535.00 OneToOne 0.00 65535.00 FORMAT "%8.2" /end CHARACTERISTIC
/begin CHARACTERISTIC InjVlv_DebBnkB2Ok_C "#SSD Heilungsentprellung für B Bankfehlerpfade Bit 2" VALUE 0xE1C18 Kw_Wu16 65535.00 OneToOne 0.00 65535.00 FORMAT "%8.2" /end CHARACTERISTIC
/begin CHARACTERISTIC InjVlv_DebBnkB3Def_C "#SSD Defektentprellung für B Bankfehlerpfade Bit 3" VALUE 0xE1C1A Kw_Wu16 65535.00 OneToOne 0.00 65535.00 FORMAT "%8.2" /end CHARACTERISTIC
/begin CHARACTERISTIC InjVlv_DebBnkB3Ok_C "#SSD Heilungsentprellung für B Bankfehlerpfade Bit 3" VALUE 0xE1C1C Kw_Wu16 65535.00 OneToOne 0.00 65535.00 FORMAT "%8.2" /end CHARACTERISTIC
/begin CHARACTERISTIC InjVlv_DebChipA0Def_C "#SSD Defektentprellung für  A Bausteinfehlerpfade Bit 0" VALUE 0xE1C1E Kw_Wu16 65535.00 OneToOne 0.00 65535.00 FORMAT "%8.2" /end CHARACTERISTIC
/begin CHARACTERISTIC InjVlv_DebChipA0Ok_C "#SSD Heilungsentprellung für  A Bausteinfehlerpfade Bit 0" VALUE 0xE1C20 Kw_Wu16 65535.00 OneToOne 0.00 65535.00 FORMAT "%8.2" /end CHARACTERISTIC
/begin CHARACTERISTIC InjVlv_DebChipA1Def_C "#SSD Defektentprellung für  A Bausteinfehlerpfade Bit 1" VALUE 0xE1C22 Kw_Wu16 65535.00 OneToOne 0.00 65535.00 FORMAT "%8.2" /end CHARACTERISTIC
/begin CHARACTERISTIC InjVlv_DebChipA1Ok_C "#SSD Heilungsentprellung für  A Bausteinfehlerpfade Bit 1" VALUE 0xE1C24 Kw_Wu16 65535.00 OneToOne 0.00 65535.00 FORMAT "%8.2" /end CHARACTERISTIC
/begin CHARACTERISTIC InjVlv_DebChipA2Def_C "#SSD Defektentprellung für  A Bausteinfehlerpfade Bit 2" VALUE 0xE1C26 Kw_Wu16 65535.00 OneToOne 0.00 65535.00 FORMAT "%8.2" /end CHARACTERISTIC
/begin CHARACTERISTIC InjVlv_DebChipA2Ok_C "#SSD Heilungsentprellung für  A Bausteinfehlerpfade Bit 2" VALUE 0xE1C28 Kw_Wu16 65535.00 OneToOne 0.00 65535.00 FORMAT "%8.2" /end CHARACTERISTIC
/begin CHARACTERISTIC InjVlv_DebChipA3Def_C "#SSD Defektentprellung für  A Bausteinfehlerpfade Bit 3" VALUE 0xE1C2A Kw_Wu16 65535.00 OneToOne 0.00 65535.00 FORMAT "%8.2" /end CHARACTERISTIC
/begin CHARACTERISTIC InjVlv_DebChipA3Ok_C "#SSD Heilungsentprellung für  A Bausteinfehlerpfade Bit 3" VALUE 0xE1C2C Kw_Wu16 65535.00 OneToOne 0.00 65535.00 FORMAT "%8.2" /end CHARACTERISTIC
/begin CHARACTERISTIC InjVlv_DebChipB0Def_C "#SSD Defektentprellung für  B Bausteinfehlerpfade Bit 0" VALUE 0xE1C2E Kw_Wu16 65535.00 OneToOne 0.00 65535.00 FORMAT "%8.2" /end CHARACTERISTIC
/begin CHARACTERISTIC InjVlv_DebChipB0Ok_C "#SSD Heilungsentprellung für  B Bausteinfehlerpfade Bit 0" VALUE 0xE1C30 Kw_Wu16 65535.00 OneToOne 0.00 65535.00 FORMAT "%8.2" /end CHARACTERISTIC
/begin CHARACTERISTIC InjVlv_DebChipB1Def_C "#SSD Defektentprellung für  B Bausteinfehlerpfade Bit 1" VALUE 0xE1C32 Kw_Wu16 65535.00 OneToOne 0.00 65535.00 FORMAT "%8.2" /end CHARACTERISTIC
/begin CHARACTERISTIC InjVlv_DebChipB1Ok_C "#SSD Heilungsentprellung für  B Bausteinfehlerpfade Bit 1" VALUE 0xE1C34 Kw_Wu16 65535.00 OneToOne 0.00 65535.00 FORMAT "%8.2" /end CHARACTERISTIC
/begin CHARACTERISTIC InjVlv_DebChipB2Def_C "#SSD Defektentprellung für  B Bausteinfehlerpfade Bit 2" VALUE 0xE1C36 Kw_Wu16 65535.00 OneToOne 0.00 65535.00 FORMAT "%8.2" /end CHARACTERISTIC
/begin CHARACTERISTIC InjVlv_DebChipB2Ok_C "#SSD Heilungsentprellung für  B Bausteinfehlerpfade Bit 2" VALUE 0xE1C38 Kw_Wu16 65535.00 OneToOne 0.00 65535.00 FORMAT "%8.2" /end CHARACTERISTIC
/begin CHARACTERISTIC InjVlv_DebChipB3Def_C "#SSD Defektentprellung für  B Bausteinfehlerpfade Bit 3" VALUE 0xE1C3A Kw_Wu16 65535.00 OneToOne 0.00 65535.00 FORMAT "%8.2" /end CHARACTERISTIC
/begin CHARACTERISTIC InjVlv_DebChipB3Ok_C "#SSD Heilungsentprellung für  B Bausteinfehlerpfade Bit 3" VALUE 0xE1C3C Kw_Wu16 65535.00 OneToOne 0.00 65535.00 FORMAT "%8.2" /end CHARACTERISTIC
/begin CHARACTERISTIC InjVlv_DebCylA0Def_C "#SSD Defektentprellung für A Zylinderfehlerpfade Bit 0" VALUE 0xE1C3E Kw_Wu16 65535.00 OneToOne 0.00 65535.00 FORMAT "%8.2" /end CHARACTERISTIC
/begin CHARACTERISTIC InjVlv_DebCylA0Ok_C "#SSD Heilungsentprellung für A Zylinderfehlerpfade Bit 0" VALUE 0xE1C40 Kw_Wu16 65535.00 OneToOne 0.00 65535.00 FORMAT "%8.2" /end CHARACTERISTIC
/begin CHARACTERISTIC InjVlv_DebCylA1Def_C "#SSD Defektentprellung für A Zylinderfehlerpfade Bit 1" VALUE 0xE1C42 Kw_Wu16 65535.00 OneToOne 0.00 65535.00 FORMAT "%8.2" /end CHARACTERISTIC
/begin CHARACTERISTIC InjVlv_DebCylA1Ok_C "#SSD Heilungsentprellung für A Zylinderfehlerpfade Bit 1" VALUE 0xE1C44 Kw_Wu16 65535.00 OneToOne 0.00 65535.00 FORMAT "%8.2" /end CHARACTERISTIC
/begin CHARACTERISTIC InjVlv_DebCylA2Def_C "#SSD Defektentprellung für A Zylinderfehlerpfade Bit 2" VALUE 0xE1C46 Kw_Wu16 65535.00 OneToOne 0.00 65535.00 FORMAT "%8.2" /end CHARACTERISTIC
/begin CHARACTERISTIC InjVlv_DebCylA2Ok_C "#SSD Heilungsentprellung für A Zylinderfehlerpfade Bit 2" VALUE 0xE1C48 Kw_Wu16 65535.00 OneToOne 0.00 65535.00 FORMAT "%8.2" /end CHARACTERISTIC
/begin CHARACTERISTIC InjVlv_DebCylA3Def_C "#SSD Defektentprellung für A Zylinderfehlerpfade Bit 3" VALUE 0xE1C4A Kw_Wu16 65535.00 OneToOne 0.00 65535.00 FORMAT "%8.2" /end CHARACTERISTIC
/begin CHARACTERISTIC InjVlv_DebCylA3Ok_C "#SSD Heilungsentprellung für A Zylinderfehlerpfade Bit 3" VALUE 0xE1C4C Kw_Wu16 65535.00 OneToOne 0.00 65535.00 FORMAT "%8.2" /end CHARACTERISTIC
/begin CHARACTERISTIC InjVlv_DebCylB0Def_C "#SSD Defektentprellung für B Zylinderfehlerpfade Bit 0" VALUE 0xE1C4E Kw_Wu16 65535.00 OneToOne 0.00 65535.00 FORMAT "%8.2" /end CHARACTERISTIC
/begin CHARACTERISTIC InjVlv_DebCylB0Ok_C "#SSD Heilungsentprellung für B Zylinderfehlerpfade Bit 0" VALUE 0xE1C50 Kw_Wu16 65535.00 OneToOne 0.00 65535.00 FORMAT "%8.2" /end CHARACTERISTIC
/begin CHARACTERISTIC InjVlv_DebCylB1Def_C "#SSD Defektentprellung für B Zylinderfehlerpfade Bit 1" VALUE 0xE1C52 Kw_Wu16 65535.00 OneToOne 0.00 65535.00 FORMAT "%8.2" /end CHARACTERISTIC
/begin CHARACTERISTIC InjVlv_DebCylB1Ok_C "#SSD Heilungsentprellung für B Zylinderfehlerpfade Bit 1" VALUE 0xE1C54 Kw_Wu16 65535.00 OneToOne 0.00 65535.00 FORMAT "%8.2" /end CHARACTERISTIC
/begin CHARACTERISTIC InjVlv_DebCylB2Def_C "#SSD Defektentprellung für B Zylinderfehlerpfade Bit 2" VALUE 0xE1C56 Kw_Wu16 65535.00 OneToOne 0.00 65535.00 FORMAT "%8.2" /end CHARACTERISTIC
/begin CHARACTERISTIC InjVlv_DebCylB2Ok_C "#SSD Heilungsentprellung für B Zylinderfehlerpfade Bit 2" VALUE 0xE1C58 Kw_Wu16 65535.00 OneToOne 0.00 65535.00 FORMAT "%8.2" /end CHARACTERISTIC
/begin CHARACTERISTIC InjVlv_DebCylB3Def_C "#SSD Defektentprellung für B Zylinderfehlerpfade Bit 3" VALUE 0xE1C5A Kw_Wu16 65535.00 OneToOne 0.00 65535.00 FORMAT "%8.2" /end CHARACTERISTIC
/begin CHARACTERISTIC InjVlv_DebCylB3Ok_C "#SSD Heilungsentprellung für B Zylinderfehlerpfade Bit 3" VALUE 0xE1C5C Kw_Wu16 65535.00 OneToOne 0.00 65535.00 FORMAT "%8.2" /end CHARACTERISTIC
/begin CHARACTERISTIC InjVlv_DebCylC0Def_C "#SSD Defekt-Entprellung von Bit 0 in C-Fehlerpfade der Zylinder" VALUE 0xE1C5E Kw_Wu16 65535.00 OneToOne 0.00 65535.00 FORMAT "%8.2" /end CHARACTERISTIC
/begin CHARACTERISTIC InjVlv_DebCylC0Ok_C "#SSD Heilungs-Entprellung von Bit 0 in C-Fehlerpfade der Zylinder" VALUE 0xE1C60 Kw_Wu16 65535.00 OneToOne 0.00 65535.00 FORMAT "%8.2" /end CHARACTERISTIC
/begin CHARACTERISTIC InjVlv_DebCylC1Def_C "#SSD Defekt-Entprellung von Bit 1 in C-Fehlerpfade der Zylinder" VALUE 0xE1C62 Kw_Wu16 65535.00 OneToOne 0.00 65535.00 FORMAT "%8.2" /end CHARACTERISTIC
/begin CHARACTERISTIC InjVlv_DebCylC1Ok_C "#SSD Heilungs-Entprellung von Bit 1 in C-Fehlerpfade der Zylinder" VALUE 0xE1C64 Kw_Wu16 65535.00 OneToOne 0.00 65535.00 FORMAT "%8.2" /end CHARACTERISTIC
/begin CHARACTERISTIC InjVlv_DebCylC2Def_C "#SSD Defekt-Entprellung von Bit 2 in C-Fehlerpfade der Zylinder" VALUE 0xE1C66 Kw_Wu16 65535.00 OneToOne 0.00 65535.00 FORMAT "%8.2" /end CHARACTERISTIC
/begin CHARACTERISTIC InjVlv_DebCylC2Ok_C "#SSD Heilungs-Entprellung von Bit 2 in C-Fehlerpfade der Zylinder" VALUE 0xE1C68 Kw_Wu16 65535.00 OneToOne 0.00 65535.00 FORMAT "%8.2" /end CHARACTERISTIC
/begin CHARACTERISTIC InjVlv_DebCylC3Def_C "#SSD Defekt-Entprellung von Bit 3 in C-Fehlerpfade der Zylinder" VALUE 0xE1C6A Kw_Wu16 65535.00 OneToOne 0.00 65535.00 FORMAT "%8.2" /end CHARACTERISTIC
/begin CHARACTERISTIC InjVlv_DebCylC3Ok_C "#SSD Heilungs-Entprellung von Bit 3 in C-Fehlerpfade der Zylinder" VALUE 0xE1C6C Kw_Wu16 65535.00 OneToOne 0.00 65535.00 FORMAT "%8.2" /end CHARACTERISTIC
/begin CHARACTERISTIC InjVlv_DebNVCDef_C "Entprellparemeter für die Defekterkennung der NVC" VALUE 0xE1D78 Kw_Wu16 65535.00 OneToOne 0.00 65535.00 FORMAT "%8.2" /end CHARACTERISTIC
/begin CHARACTERISTIC InjVlv_DebNVCOK_C "Entprellparameter für Heilung der NVC" VALUE 0xE1D7A Kw_Wu16 65535.00 OneToOne 0.00 65535.00 FORMAT "%8.2" /end CHARACTERISTIC
/begin CHARACTERISTIC InjVlv_facAddBalRls_MAP "Freigabekennfeld zur Aufrechnung der Mengenkorrektur" MAP 0xE167E Kf_Xs16_Ys16_Ws16 1.000000 Fact 0.00 1.000000 FORMAT "%8.6" EXTENDED_LIMITS -4.000000 3.999878
 /begin AXIS_DESCR STD_AXIS RailCD_pPeak Pres_Rail 3 0.00 2000.000 FORMAT "%5.3" EXTENDED_LIMITS -3276.800 3276.700 DEPOSIT ABSOLUTE /end AXIS_DESCR
 /begin AXIS_DESCR STD_AXIS InjCtl_qSetUnBal InjMassCyc 2 0.00 327.6700 FORMAT "%8.4" EXTENDED_LIMITS -327.6800 327.6700 DEPOSIT ABSOLUTE /end AXIS_DESCR
/end CHARACTERISTIC
/begin CHARACTERISTIC InjVlv_facFTSWvCor_MAP "KF für die Berechnung des kraftstofftemperaturabhängigen Druckwellenkorrekturfaktors" MAP 0xE2176 Kf_Xs16_Ys16_Ws16 2.000000 Fact 0.00 2.000000 FORMAT "%8.6" EXTENDED_LIMITS -4.000000 3.999878
 /begin AXIS_DESCR STD_AXIS RailCD_pPeak Pres_Rail 16 0.00 2000.000 FORMAT "%5.3" EXTENDED_LIMITS -3276.800 3276.700 DEPOSIT ABSOLUTE /end AXIS_DESCR
 /begin AXIS_DESCR STD_AXIS InjVlv_tWvCor_mp Temp_Cels 8 -50.1400 199.8600 FORMAT "%8.4" EXTENDED_LIMITS -3549.940 3003.560 DEPOSIT ABSOLUTE /end AXIS_DESCR
/end CHARACTERISTIC
/begin CHARACTERISTIC InjVlv_facNVCDflI_C "Defaultwert des NVC-Faktors" VALUE 0xE1D7C Kw_Ws16 1.000000 Fact -0.5000000 0.5000000 FORMAT "%9.7" EXTENDED_LIMITS -4.000000 3.999878 /end CHARACTERISTIC
/begin CHARACTERISTIC InjVlv_facNVCDfpMax_C "Oberer Grenzwert von InjVlv_facNVCActr[x] ab dem der Fehlerfpad der NVC gesetzt wird" VALUE 0xE1D7E Kw_Ws16 3.900024 Fact 0.00 3.900024 FORMAT "%8.6" EXTENDED_LIMITS -4.000000 3.999878 /end CHARACTERISTIC
/begin CHARACTERISTIC InjVlv_facNVCDfpMin_C "Unterer Grenzwert von InjVlv_facNVCActr[x] ab dem der Fehlerfpad der NVC gesetzt wird" VALUE 0xE1D80 Kw_Ws16 3.900024 Fact 0.00 3.900024 FORMAT "%8.6" EXTENDED_LIMITS -4.000000 3.999878 /end CHARACTERISTIC
/begin CHARACTERISTIC InjVlv_facNVCInPI_C "#SSD Korrekturfaktor für den NVC-Reglereingang" VALUE 0xE1D82 Kw_Ws16 2.000000 Fact -1.000000 1.000000 FORMAT "%8.6" EXTENDED_LIMITS -4.000000 3.999878 /end CHARACTERISTIC
/begin CHARACTERISTIC InjVlv_facNVCMax_C "#SSD Obere Grenze für den NVC-Reglerausgang" VALUE 0xE1D84 Kw_Ws16 3.900024 Fact 0.00 3.900024 FORMAT "%8.6" EXTENDED_LIMITS -4.000000 3.999878 /end CHARACTERISTIC
/begin CHARACTERISTIC InjVlv_facNVCMin_C "#SSD Untere Grenze  für den NVC-Reglerausgang" VALUE 0xE1D86 Kw_Ws16 3.900024 Fact 0.00 3.900024 FORMAT "%8.6" EXTENDED_LIMITS -4.000000 3.999878 /end CHARACTERISTIC
/begin CHARACTERISTIC InjVlv_facPCorQ_CUR "#SSD mengenabhängige Korrekturfaktor-Kennlinie für Druckwellenkorrektur" CURVE 0xE169A Kl_Xs16_Ws16 20.00000 Fact -10.00000 10.00000 FORMAT "%8.5" EXTENDED_LIMITS -4.000000 3.999878
 /begin AXIS_DESCR STD_AXIS InjVlv_qDes_mp InjMassInj 8 -327.6800 327.6700 FORMAT "%8.4" DEPOSIT ABSOLUTE /end AXIS_DESCR
/end CHARACTERISTIC
/begin CHARACTERISTIC InjVlv_facPCorTi_CUR "#SSD einspritzabstandsabhängige Korrekturfaktor-Kennlinie für Druckwellenkorrektur" CURVE 0xE16BC Kl_Xs16_Ws16 20.00000 Fact -10.00000 10.00000 FORMAT "%8.5" EXTENDED_LIMITS -4.000000 3.999878
 /begin AXIS_DESCR STD_AXIS InjVlv_tiMI1PoI2Cor_mp InjTime_us 16 -32768.00 32767.00 FORMAT "%8.2" DEPOSIT ABSOLUTE /end AXIS_DESCR
/end CHARACTERISTIC
/begin CHARACTERISTIC InjVlv_facVoltCorUp_MAP "#SSD temperaturabhängige Hubkorrektur für up-Niveau" MAP 0xE16FE Kf_Xs16_Ys16_Ws16 7.999878 Fact -4.000000 3.999878 FORMAT "%8.6"
 /begin AXIS_DESCR STD_AXIS InjVlv_pCalcVolt Pres_Rail 16 -3276.800 3276.700 FORMAT "%5.3" DEPOSIT ABSOLUTE /end AXIS_DESCR
 /begin AXIS_DESCR STD_AXIS InjVlv_tActr_mp Temp_Cels 10 -50.140 899.860 FORMAT "%8.3" EXTENDED_LIMITS -3549.940 3003.560 DEPOSIT ABSOLUTE /end AXIS_DESCR
/end CHARACTERISTIC
/begin CHARACTERISTIC InjVlv_iDCDC_CUR "#SSD DCDC Strom-Kennlinie" CURVE 0xE1BD4 Kl_Xs16_Ws16 11800.00 Curr 200.0000 12000.00 FORMAT "%8.2" EXTENDED_LIMITS -32768.00 32767.00
 /begin AXIS_DESCR STD_AXIS BattCD_u Volt_Batt 8 0.00 30009.78 FORMAT "%8.2" EXTENDED_LIMITS -640625.6 640606.1 DEPOSIT ABSOLUTE /end AXIS_DESCR
/end CHARACTERISTIC
/begin CHARACTERISTIC InjVlv_iMonDisChDwn_C "#SSD Schwelle des Entladestroms für Überwachung des bsh_err vom CY370" VALUE 0xE1C6E Kw_Ws16 30000.00 Curr -30000.00 0.00 FORMAT "%8.2" EXTENDED_LIMITS -32768.00 32767.00 /end CHARACTERISTIC
/begin CHARACTERISTIC InjVlv_NVCIKi_C "#SSD I-Parameter des Reglers, wenn der Eingang sich innerhalb des Kleinsignalfensters befindet" VALUE 0xE1D88 Kw_Wu32 12207.0312472 Ki_VOLTPA2FACT 0.00 12207.0312472 FORMAT "%13.7" /end CHARACTERISTIC
/begin CHARACTERISTIC InjVlv_NVCIKiPos_C "#SSD I-Parameter des Reglers, wenn sich der Wert des Eingangs oberhalb der Kleinsignalfensters befindet" VALUE 0xE1D8C Kw_Wu32 12207.0312472 Ki_VOLTPA2FACT 0.00 12207.0312472 FORMAT "%13.7" /end CHARACTERISTIC
/begin CHARACTERISTIC InjVlv_NVCIKiNeg_C "#SSD I-Parameter der Reglers, wenn sich der Wert des Eingangs unterhalb des Kleinsignalfensters befindet" VALUE 0xE1D90 Kw_Wu32 12207.0312472 Ki_VOLTPA2FACT 0.00 12207.0312472 FORMAT "%13.7" /end CHARACTERISTIC
/begin CHARACTERISTIC InjVlv_uNVCIWinPos_C "#SSD obere Grenze des Kleinsignalfensters für den I-Anteil" VALUE 0xE1D94 Kw_Ws16 655.3500 Volt_PA -327.6800 327.6700 FORMAT "%8.4" /end CHARACTERISTIC
/begin CHARACTERISTIC InjVlv_uNVCIWinNeg_C "#SSD untere Grenze des Kleinsignalfensters für den I-Anteil" VALUE 0xE1D96 Kw_Ws16 655.3500 Volt_PA -327.6800 327.6700 FORMAT "%8.4" /end CHARACTERISTIC
/begin CHARACTERISTIC InjVlv_nMonQckThresLo_C "#SSD Motordrehzahl-Schwelle zur Auswahl von InjVlv_ctMonQckThres_C bzw. InjVlv_ctMonQckThresLo_C für Schnellerkennung" VALUE 0xE1C70 Kw_Ws16 65535.00 EngN -32768.00 32767.00 FORMAT "%8.2" /end CHARACTERISTIC
/begin CHARACTERISTIC InjVlv_numClsVltgAdjMax_C "#SSD Maximale Klasse für den Injektor Spannungsabgleich" VALUE 0xE1E34 Kw_Wu8 15.00 OneToOne 0.00 15.00 FORMAT "%5.2" EXTENDED_LIMITS 0.00 255.0 /end CHARACTERISTIC
/begin CHARACTERISTIC InjVlv_numClsVltgAdjMin_C "#SSD Minimale Klasse für den Injektor Spannungsabgleich" VALUE 0xE1E35 Kw_Wu8 15.00 OneToOne 0.00 15.00 FORMAT "%5.2" EXTENDED_LIMITS 0.00 255.0 /end CHARACTERISTIC
/begin CHARACTERISTIC InjVlv_numInjChrgBal_MAP "#SSD max. Anzahl an Einspritzungen aufgrund Ladungsbilanz Boosterkondensators" MAP 0xE197A Kf_Xs16_Ys16_Ws16 6.000000 OneToOne 0.00 6.000000 FORMAT "%8.6" EXTENDED_LIMITS -32768.00 32767.00
 /begin AXIS_DESCR STD_AXIS InjVlv_pwrInjAvrg_mp Pwr_PA 16 0.00 32000.00 FORMAT "%8.2" EXTENDED_LIMITS -32768.00 32767.00 DEPOSIT ABSOLUTE /end AXIS_DESCR
 /begin AXIS_DESCR STD_AXIS BattCD_u Volt_Batt 16 0.00 28602.15 FORMAT "%8.2" EXTENDED_LIMITS -640625.6 640606.1 DEPOSIT ABSOLUTE /end AXIS_DESCR
/end CHARACTERISTIC
/begin CHARACTERISTIC InjVlv_numNoLoadCylMax_C "#SSD maximale zulässige Anzahl von Zylindern mit Lastabfall" VALUE 0xE1C72 Kw_Wu8 6.000 OneToOne 0.00 6.000 FORMAT "%5.3" EXTENDED_LIMITS 0.00 255.0 /end CHARACTERISTIC
/begin CHARACTERISTIC InjVlv_numSegOfs1_C "Semgentoffset für die Bestimmung der zylinderselektiven Drehzahlen für Testmodus a" VALUE 0xE1BF6 Kw_Wu8 11.00 OneToOne 0.00 11.00 FORMAT "%5.2" EXTENDED_LIMITS 0.00 255.0 /end CHARACTERISTIC
/begin CHARACTERISTIC InjVlv_numSegOfs2_C "Semgentoffset für die Bestimmung der zylinderselektiven Drehzahlen für Testmodus b und c" VALUE 0xE1BF7 Kw_Wu8 11.00 OneToOne 0.00 11.00 FORMAT "%5.2" EXTENDED_LIMITS 0.00 255.0 /end CHARACTERISTIC
/begin CHARACTERISTIC InjVlv_pCorBase_CUR "#SSD Raildruck-Korrekturgrundwert-Kennlinie für Druckwellenkorrektur" CURVE 0xE1876 Kl_Xs16_Ws16 2000.000 Pres_Rail 0.00 2000.000 FORMAT "%5.3" EXTENDED_LIMITS -3276.800 3276.700
 /begin AXIS_DESCR STD_AXIS InjVlv_pAct_mp Pres_Rail 6 -3276.800 3276.700 FORMAT "%5.3" DEPOSIT ABSOLUTE /end AXIS_DESCR
/end CHARACTERISTIC
/begin CHARACTERISTIC InjVlv_pMin_C "#SSD Injektorabhängige Druckschwelle zur Freigabe/Sperrung der Einspritzung" VALUE 0xE1E10 Kw_Ws16 2000.000 Pres_Rail 0.00 2000.000 FORMAT "%5.3" EXTENDED_LIMITS -3276.800 3276.700 /end CHARACTERISTIC
/begin CHARACTERISTIC InjVlv_pMin_CUR "#SSD Kühlmitteltemperaturabhängige Druckschwelle zur Freigabe der Einspritzungen" CURVE 0xE1E12 Kl_Xs16_Ws16 2000.000 Pres_Rail 0.00 2000.000 FORMAT "%5.3" EXTENDED_LIMITS -3276.800 3276.700
 /begin AXIS_DESCR STD_AXIS Eng_tEng Temp_Cels 8 -50.14000 199.8600 FORMAT "%8.4" EXTENDED_LIMITS -3549.940 3003.560 DEPOSIT ABSOLUTE /end AXIS_DESCR
/end CHARACTERISTIC
/begin CHARACTERISTIC InjVlv_pNVCMax_C "#SSD Obere Grenze des Raildrucks für die Freigabe der NVC" VALUE 0xE1D98 Kw_Ws16 2000.000 Pres_Rail 0.00 2000.000 FORMAT "%5.3" EXTENDED_LIMITS -3276.800 3276.700 /end CHARACTERISTIC
/begin CHARACTERISTIC InjVlv_pNVCMin_C "#SSD untere Grenze des Raildrucks für die Freigabe der NVC" VALUE 0xE1D9A Kw_Ws16 2000.000 Pres_Rail 0.00 2000.000 FORMAT "%5.3" EXTENDED_LIMITS -3276.800 3276.700 /end CHARACTERISTIC
/begin CHARACTERISTIC InjVlv_pRailDfl_C "#SSD Raildruck-Ersatzwert für Sollspannungsberechnung" VALUE 0xE1890 Kw_Ws16 6553.500 Pres_Rail -3276.800 3276.700 FORMAT "%5.3" /end CHARACTERISTIC
/begin CHARACTERISTIC InjVlv_NVCPKp_C "#SSD P-Parameter des Reglers, wenn sich der Wert des Eingangs innerhalb der Kleinsignalfensters befindet" VALUE 0xE1D9C Kw_Wu32 799.999999814 Kp_VOLTPA2FACT 0.00 799.999999814 FORMAT "%13.9" /end CHARACTERISTIC
/begin CHARACTERISTIC InjVlv_NVCPKpPos_C "#SSD P-Parameter des Reglers, wenn sich der Wert des Eingangs oberhalb des Kleinsignalfensters befindet" VALUE 0xE1DA0 Kw_Wu32 799.999999814 Kp_VOLTPA2FACT 0.00 799.999999814 FORMAT "%13.9" /end CHARACTERISTIC
/begin CHARACTERISTIC InjVlv_NVCPKpNeg_C "#SSD P-Parameter des Reglers, wenn sich der Wert des Eingangs unterhalb der Kleinsignalfensters befindet" VALUE 0xE1DA4 Kw_Wu32 799.999999814 Kp_VOLTPA2FACT 0.00 799.999999814 FORMAT "%13.9" /end CHARACTERISTIC
/begin CHARACTERISTIC InjVlv_uNVCPWinPos_C "#SSD obere Grenze des Kleinsignalfensters für den P-Anteil" VALUE 0xE1DA8 Kw_Ws16 655.3500 Volt_PA -327.6800 327.6700 FORMAT "%8.4" /end CHARACTERISTIC
/begin CHARACTERISTIC InjVlv_uNVCPWinNeg_C "#SSD untere Grenze der Kleinsignalfensters für den P-Anteil" VALUE 0xE1DAA Kw_Ws16 655.3500 Volt_PA -327.6800 327.6700 FORMAT "%8.4" /end CHARACTERISTIC
/begin CHARACTERISTIC InjVlv_qWvCorNorm_CUR "Kennlinie für die raildruckabhängige Einspritznormierungsmenge" CURVE 0xE22AA Kl_Xs16_Ws16 327.6600 InjMassInj 0.01000000 327.6700 FORMAT "%8.4" EXTENDED_LIMITS -327.6800 327.6700
 /begin AXIS_DESCR STD_AXIS RailCD_pPeak Pres_Rail 20 0.00 2000.000 FORMAT "%5.3" EXTENDED_LIMITS -3276.800 3276.700 DEPOSIT ABSOLUTE /end AXIS_DESCR
/end CHARACTERISTIC
/begin CHARACTERISTIC InjVlv_rChrgBalPwrHys_C "#SSD Leistungs-Hystereseschwelle für max. Anzahl an Einspritzungen über Ladungsbilanz des Buffer-Kondensators" VALUE 0xE1BBE Kw_Wu16 100.0000 Prc 0.00 100.0000 FORMAT "%8.4" EXTENDED_LIMITS 0.00 799.9878 /end CHARACTERISTIC
/begin CHARACTERISTIC InjVlv_rChrgBalVltgHys_C "#SSD Batteriespannungs Hystereseschwelle für Auswahl der max. Anzahl an Einspritzungen aufgrund Ladungsbilanz Boosterkondensators" VALUE 0xE1BC0 Kw_Wu16 100.0000 Prc 0.00 100.0000 FORMAT "%8.4" EXTENDED_LIMITS 0.00 799.9878 /end CHARACTERISTIC
/begin CHARACTERISTIC InjVlv_stErrDet_C "Status der Injektorfehlererkennung" VALUE 0xE1BF8 Kw_Wu8 1.000 OneToOne 0.00 1.000 FORMAT "%5.3" EXTENDED_LIMITS 0.00 255.0 /end CHARACTERISTIC
/begin CHARACTERISTIC InjVlv_stErrMskPattern_C "#SSD Pattern-Matrix zur Mustererkennung" VAL_BLK 0xE1C74 Kwb_Wu32 4294967295.00 OneToOne 0.00 4294967295.00 FORMAT "%13.2" NUMBER 32 /end CHARACTERISTIC
/begin CHARACTERISTIC InjVlv_stErrMskSelect_C "#SSD Select-Matrix zur Mustererkennung" VAL_BLK 0xE1CF4 Kwb_Wu32 4294967295.00 OneToOne 0.00 4294967295.00 FORMAT "%13.2" NUMBER 32 /end CHARACTERISTIC
/begin CHARACTERISTIC InjVlv_stInputAddBalMap_C "y-Eingang des Kennfelds InjVCD_facAddBalRls_MAP auf dem Applikationswerkzeug" VALUE 0xE1698 Kw_Wu8 255.0 OneToOne 0.00 255.0 FORMAT "%5.1" /end CHARACTERISTIC
/begin CHARACTERISTIC InjVlv_stMonQckEna_C "#SSD Schalter zur Freigabe der Schnell-Erkennung der Kurzschlüsse nach Batterie und Masse (0: gesperrt, 1: freigegeben)" VALUE 0xE1D74 Kw_Wu8 1.000 OneToOne 0.00 1.000 FORMAT "%5.3" EXTENDED_LIMITS 0.00 255.0 /end CHARACTERISTIC
/begin CHARACTERISTIC InjVlv_stPWvCorMsk_C "#SSD Freigabemaske für Druckwellenkorrekur des Raildrucks" VALUE 0xE1892 Kw_Wu8 255.0 OneToOne 0.00 255.0 FORMAT "%5.1" /end CHARACTERISTIC
/begin CHARACTERISTIC InjVlv_stQntAdjRepl_C "Ersatzwerte für Injektormengenabgleich" VAL_BLK 0xE1EFC Kwb_Wu32 4294967295.00 OneToOne 0.00 4294967295.00 FORMAT "%13.2" NUMBER 12 /end CHARACTERISTIC
/begin CHARACTERISTIC InjVlv_stQntAdj_MAP "#SSD Statuskennfeld (Index und Gewichtungsfaktor) für den Injektor-Mengenabgleich" MAP 0xE1E36 Kf_Xs16_Ys16_Ws16 32767.00 OneToOne 0.00 32767.00 FORMAT "%8.2" EXTENDED_LIMITS -32768.00 32767.00
 /begin AXIS_DESCR STD_AXIS RailCD_pPeak Pres_Rail 7 0.00 2000.000 FORMAT "%5.3" EXTENDED_LIMITS -3276.800 3276.700 DEPOSIT ABSOLUTE /end AXIS_DESCR
 /begin AXIS_DESCR STD_AXIS InjUn_volMI1Cor_mp InjQntInj 7 0.00 100.0000 FORMAT "%8.4" EXTENDED_LIMITS -327.6800 327.6700 DEPOSIT ABSOLUTE /end AXIS_DESCR
/end CHARACTERISTIC
/begin CHARACTERISTIC InjVlv_stWvCorActv_C "Freigabe der Druckwellenkorrektur" VALUE 0xE22FC Kw_Wu8 1.000 OneToOne 0.00 1.000 FORMAT "%5.3" EXTENDED_LIMITS 0.00 255.0 /end CHARACTERISTIC
/begin CHARACTERISTIC InjVlv_swtAvrgEnaTiNVC_C "Aktivierung des Pfades InjVCD_stAvrgEnaTiWarn zur Freigabe des Lernens der NVC" VALUE 0xE1DAC Kw_Wu8 255.0 OneToOne 0.00 255.0 FORMAT "%5.1" /end CHARACTERISTIC
/begin CHARACTERISTIC InjVlv_swtDiffHydInSel_C "Auswahlparameter für die Darstellung des Betriebspunktes im Kennfeld InjVlv_tiDiffHyd_MAP" VALUE 0xE1F30 Kw_Wu8 2.000 OneToOne 0.00 2.000 FORMAT "%5.3" EXTENDED_LIMITS 0.00 255.0 /end CHARACTERISTIC
/begin CHARACTERISTIC InjVlv_swtNVCStInjChar_C "Maske für die einspritztypabhängige Freigabe des Lernen der NVC" VALUE 0xE1DAD Kw_Wu8 255.0 OneToOne 0.00 255.0 FORMAT "%5.1" /end CHARACTERISTIC
/begin CHARACTERISTIC InjVlv_swtNVCWrDflVal_C "Software-Schalter zum Setzen Defaultwerte für Testzwecke" VALUE 0xE1DAE Kw_Wu8 1.000 OneToOne 0.00 1.000 FORMAT "%5.3" EXTENDED_LIMITS 0.00 255.0 /end CHARACTERISTIC
/begin CHARACTERISTIC InjVlv_swtQntAdj_C "Schalter zum Ersetzen der Mengenabgleichwerte" VALUE 0xE1F2C Kw_Wu8 1.000 OneToOne 0.00 1.000 FORMAT "%5.3" EXTENDED_LIMITS 0.00 255.0 /end CHARACTERISTIC
/begin CHARACTERISTIC InjVlv_tActrDfl_C "#SSD Ersatzwert Aktortemperatur für Sollwertspannungsberechnung" VALUE 0xE1894 Kw_Ws16 950.000 Temp_Cels -50.140 899.860 FORMAT "%8.3" EXTENDED_LIMITS -3549.940 3003.560 /end CHARACTERISTIC
/begin CHARACTERISTIC InjVlv_tiDiffHyd_MAP "Kennfeld mit Differenzzeiten zwischen hydraulischem Nadelschliessende und elektrischem Ansteuerende" MAP 0xE1F32 Kf_Xs16_Ys16_Ws16 10000.00 InjTime_us -5000.000 5000.000 FORMAT "%8.3" EXTENDED_LIMITS -32768.00 32767.00
 /begin AXIS_DESCR STD_AXIS InjVlv_pActInDiffHyd_mp Pres_Rail 16 0.00 2000.000 FORMAT "%5.3" EXTENDED_LIMITS -3276.800 3276.700 DEPOSIT ABSOLUTE /end AXIS_DESCR
 /begin AXIS_DESCR STD_AXIS InjVlv_qDesInDiffHyd_mp InjMassInj 16 0.00 327.6700 FORMAT "%8.4" EXTENDED_LIMITS -327.6800 327.6700 DEPOSIT ABSOLUTE /end AXIS_DESCR
/end CHARACTERISTIC
/begin CHARACTERISTIC InjVlv_tiNVCDwnThres_C "#SSD Obere Grenze der Regelabweichung des Entladezeit-Reglers um die NVC freizugeben" VALUE 0xE1DB0 Kw_Ws16 50.00000 Time_Busy 0.00 50.00000 FORMAT "%8.5" EXTENDED_LIMITS -3276.800 3276.700 /end CHARACTERISTIC
/begin CHARACTERISTIC InjVlv_tiNVCUpThres_C "#SSD Obere Grenze der Regelabweichung des Ladezeitreglers, um die NVC freizugeben" VALUE 0xE1DB2 Kw_Ws16 50.00000 Time_Busy 0.00 50.00000 FORMAT "%8.5" EXTENDED_LIMITS -3276.800 3276.700 /end CHARACTERISTIC
/begin CHARACTERISTIC InjVlv_tNVCEngMax_C "#SSD Obere Grenze der Motortemperatur zur Freigebe der NVC" VALUE 0xE1DB4 Kw_Ws16 250.0000 Temp_Cels -50.14000 199.8600 FORMAT "%8.4" EXTENDED_LIMITS -3549.940 3003.560 /end CHARACTERISTIC
/begin CHARACTERISTIC InjVlv_tNVCEngMin_C "#SSD untere Grenze der Motortemperatur zur Freigabe der NVC" VALUE 0xE1DB6 Kw_Ws16 250.0000 Temp_Cels -50.14000 199.8600 FORMAT "%8.4" EXTENDED_LIMITS -3549.940 3003.560 /end CHARACTERISTIC
/begin CHARACTERISTIC InjVlv_tWvCor_MAP "KF fuer die Eingangstemperatur der Druckwellenkorrektur" MAP 0xE22FE Kf_Xs16_Ys16_Ws16 250.0000 Temp_Cels -50.1400 199.8600 FORMAT "%8.4" EXTENDED_LIMITS -3549.940 3003.560
 /begin AXIS_DESCR STD_AXIS FTSCD_tFuel Temp_Cels 16 -50.14000 199.8600 FORMAT "%8.4" EXTENDED_LIMITS -3549.940 3003.560 DEPOSIT ABSOLUTE /end AXIS_DESCR
 /begin AXIS_DESCR STD_AXIS CTSCD_tClnt Temp_Cels 16 -50.14000 199.8600 FORMAT "%8.4" EXTENDED_LIMITS -3549.940 3003.560 DEPOSIT ABSOLUTE /end AXIS_DESCR
/end CHARACTERISTIC
/begin CHARACTERISTIC InjVlv_uBufCInjLimXLow_C "#SSD Untere Hystereseschwelle für Bufferspannung" VALUE 0xE1BC2 Kw_Ws16 260.0000 Volt_BUFC 0.00 260.0000 FORMAT "%8.4" EXTENDED_LIMITS -327.6800 327.6700 /end CHARACTERISTIC
/begin CHARACTERISTIC InjVlv_uBufCInjLimXHigh_C "#SSD Obere Hystereseschwelle für Bufferspannung" VALUE 0xE1BC4 Kw_Ws16 260.0000 Volt_BUFC 0.00 260.0000 FORMAT "%8.4" EXTENDED_LIMITS -327.6800 327.6700 /end CHARACTERISTIC
/begin CHARACTERISTIC InjVlv_stBufCInjLimYLow_C "#SSD Konstante für Bufferspannung kleiner Hystereseschwelle" VALUE 0xE1BC6 Kw_Ws16 65535.00 OneToOne -32768.00 32767.00 FORMAT "%8.2" READ_ONLY /end CHARACTERISTIC
/begin CHARACTERISTIC InjVlv_stBufCInjLimYHigh_C "#SSD Konstante für Bufferspannung größer Hystereseschwelle" VALUE 0xE1BC8 Kw_Ws16 65535.00 OneToOne -32768.00 32767.00 FORMAT "%8.2" READ_ONLY /end CHARACTERISTIC
/begin CHARACTERISTIC InjVlv_uDiffNVCSet_CUR "#SSD Kennlinie für die Spannungsdifferenz" CURVE 0xE1DB8 Kl_Xs16_Ws16 250.0000 Volt_PA 0.00 250.0000 FORMAT "%8.4" EXTENDED_LIMITS -327.6800 327.6700
 /begin AXIS_DESCR STD_AXIS InjVCD_pActInj Pres_Rail 20 -3276.800 3276.700 FORMAT "%5.3" DEPOSIT ABSOLUTE /end AXIS_DESCR
/end CHARACTERISTIC
/begin CHARACTERISTIC InjVlv_uMonBattThres_C "#SSD Schwelle zur Überwachung des DC_err von CY370" VALUE 0xE1D76 Kw_Ws16 24007.82 Volt_Batt 0.00 24007.82 FORMAT "%8.2" EXTENDED_LIMITS -640625.6 640606.1 /end CHARACTERISTIC
/begin CHARACTERISTIC InjVlv_uNVCThres_C "#SSD Obere Grenze des Wertes des Spannungsreglereingangs für die Freigabe der NVC" VALUE 0xE1E0A Kw_Ws16 50.00000 Volt_PA 0.00 50.00000 FORMAT "%8.5" EXTENDED_LIMITS -327.6800 327.6700 /end CHARACTERISTIC
/begin CHARACTERISTIC InjVlv_uOfs_C "#SSD Spannungsoffset" VALUE 0xE1978 Kw_Ws16 15.00000 Volt_PA 0.00 15.00000 FORMAT "%8.5" EXTENDED_LIMITS -327.6800 327.6700 /end CHARACTERISTIC
/begin CHARACTERISTIC InjVlv_uSetBott_C "#SSD Vorgabewert für Piezo-Aktor bottom-level" VALUE 0xE1896 Kw_Ws16 250.0000 Volt_PA 0.00 250.0000 FORMAT "%8.4" EXTENDED_LIMITS -327.6800 327.6700 /end CHARACTERISTIC
/begin CHARACTERISTIC InjVlv_uSetUpNVCActrMax_C "#SSD obere Grenze der Stellspannung nach der NVC" VALUE 0xE1E0C Kw_Ws16 250.0000 Volt_PA 0.00 250.0000 FORMAT "%8.4" EXTENDED_LIMITS -327.6800 327.6700 /end CHARACTERISTIC
/begin CHARACTERISTIC InjVlv_uSetUpNVCActrMin_C "#SSD untere Grenze der Stellspannung nach der NVC" VALUE 0xE1E0E Kw_Ws16 250.0000 Volt_PA 0.00 250.0000 FORMAT "%8.4" EXTENDED_LIMITS -327.6800 327.6700 /end CHARACTERISTIC
/begin CHARACTERISTIC InjVlv_uSetUpPress0_CUR "#SSD Kennlinie zur raildruckabh. Sollspannungsbestimmung für ISA-Klasse 0" CURVE 0xE1898 Kl_Xs16_Ws16 250.0000 Volt_PA 0.00 250.0000 FORMAT "%8.4" EXTENDED_LIMITS -327.6800 327.6700
 /begin AXIS_DESCR STD_AXIS InjVlv_pCalcVolt Pres_Rail 3 -3276.800 3276.700 FORMAT "%5.3" DEPOSIT ABSOLUTE /end AXIS_DESCR
/end CHARACTERISTIC
/begin CHARACTERISTIC InjVlv_uSetUpPress10_CUR "#SSD Kennlinie zur raildruckabh. Sollspannungsbestimmung für ISA-Klasse 10" CURVE 0xE18A6 Kl_Xs16_Ws16 250.0000 Volt_PA 0.00 250.0000 FORMAT "%8.4" EXTENDED_LIMITS -327.6800 327.6700
 /begin AXIS_DESCR STD_AXIS InjVlv_pCalcVolt Pres_Rail 3 -3276.800 3276.700 FORMAT "%5.3" DEPOSIT ABSOLUTE /end AXIS_DESCR
/end CHARACTERISTIC
/begin CHARACTERISTIC InjVlv_uSetUpPress11_CUR "#SSD Kennlinie zur raildruckabh. Sollspannungsbestimmung für ISA-Klasse 11" CURVE 0xE18B4 Kl_Xs16_Ws16 250.0000 Volt_PA 0.00 250.0000 FORMAT "%8.4" EXTENDED_LIMITS -327.6800 327.6700
 /begin AXIS_DESCR STD_AXIS InjVlv_pCalcVolt Pres_Rail 3 -3276.800 3276.700 FORMAT "%5.3" DEPOSIT ABSOLUTE /end AXIS_DESCR
/end CHARACTERISTIC
/begin CHARACTERISTIC InjVlv_uSetUpPress12_CUR "#SSD Kennlinie zur raildruckabh. Sollspannungsbestimmung für ISA-Klasse 12" CURVE 0xE18C2 Kl_Xs16_Ws16 250.0000 Volt_PA 0.00 250.0000 FORMAT "%8.4" EXTENDED_LIMITS -327.6800 327.6700
 /begin AXIS_DESCR STD_AXIS InjVlv_pCalcVolt Pres_Rail 3 -3276.800 3276.700 FORMAT "%5.3" DEPOSIT ABSOLUTE /end AXIS_DESCR
/end CHARACTERISTIC
/begin CHARACTERISTIC InjVlv_uSetUpPress13_CUR "#SSD Kennlinie zur raildruckabh. Sollspannungsbestimmung für ISA-Klasse 13" CURVE 0xE18D0 Kl_Xs16_Ws16 250.0000 Volt_PA 0.00 250.0000 FORMAT "%8.4" EXTENDED_LIMITS -327.6800 327.6700
 /begin AXIS_DESCR STD_AXIS InjVlv_pCalcVolt Pres_Rail 3 -3276.800 3276.700 FORMAT "%5.3" DEPOSIT ABSOLUTE /end AXIS_DESCR
/end CHARACTERISTIC
/begin CHARACTERISTIC InjVlv_uSetUpPress14_CUR "#SSD Kennlinie zur raildruckabh. Sollspannungsbestimmung für ISA-Klasse 14" CURVE 0xE18DE Kl_Xs16_Ws16 250.0000 Volt_PA 0.00 250.0000 FORMAT "%8.4" EXTENDED_LIMITS -327.6800 327.6700
 /begin AXIS_DESCR STD_AXIS InjVlv_pCalcVolt Pres_Rail 3 -3276.800 3276.700 FORMAT "%5.3" DEPOSIT ABSOLUTE /end AXIS_DESCR
/end CHARACTERISTIC
/begin CHARACTERISTIC InjVlv_uSetUpPress15_CUR "#SSD Kennlinie zur raildruckabh. Sollspannungsbestimmung für ISA-Klasse 15" CURVE 0xE18EC Kl_Xs16_Ws16 250.0000 Volt_PA 0.00 250.0000 FORMAT "%8.4" EXTENDED_LIMITS -327.6800 327.6700
 /begin AXIS_DESCR STD_AXIS InjVlv_pCalcVolt Pres_Rail 3 -3276.800 3276.700 FORMAT "%5.3" DEPOSIT ABSOLUTE /end AXIS_DESCR
/end CHARACTERISTIC
/begin CHARACTERISTIC InjVlv_uSetUpPress1_CUR "#SSD Kennlinie zur raildruckabh. Sollspannungsbestimmung für ISA-Klasse 1" CURVE 0xE18FA Kl_Xs16_Ws16 250.0000 Volt_PA 0.00 250.0000 FORMAT "%8.4" EXTENDED_LIMITS -327.6800 327.6700
 /begin AXIS_DESCR STD_AXIS InjVlv_pCalcVolt Pres_Rail 3 -3276.800 3276.700 FORMAT "%5.3" DEPOSIT ABSOLUTE /end AXIS_DESCR
/end CHARACTERISTIC
/begin CHARACTERISTIC InjVlv_uSetUpPress2_CUR "#SSD Kennlinie zur raildruckabh. Sollspannungsbestimmung für ISA-Klasse 2" CURVE 0xE1908 Kl_Xs16_Ws16 250.0000 Volt_PA 0.00 250.0000 FORMAT "%8.4" EXTENDED_LIMITS -327.6800 327.6700
 /begin AXIS_DESCR STD_AXIS InjVlv_pCalcVolt Pres_Rail 3 -3276.800 3276.700 FORMAT "%5.3" DEPOSIT ABSOLUTE /end AXIS_DESCR
/end CHARACTERISTIC
/begin CHARACTERISTIC InjVlv_uSetUpPress3_CUR "#SSD Kennlinie zur raildruckabh. Sollspannungsbestimmung für ISA-Klasse 3" CURVE 0xE1916 Kl_Xs16_Ws16 250.0000 Volt_PA 0.00 250.0000 FORMAT "%8.4" EXTENDED_LIMITS -327.6800 327.6700
 /begin AXIS_DESCR STD_AXIS InjVlv_pCalcVolt Pres_Rail 3 -3276.800 3276.700 FORMAT "%5.3" DEPOSIT ABSOLUTE /end AXIS_DESCR
/end CHARACTERISTIC
/begin CHARACTERISTIC InjVlv_uSetUpPress4_CUR "#SSD Kennlinie zur raildruckabh. Sollspannungsbestimmung für ISA-Klasse 4" CURVE 0xE1924 Kl_Xs16_Ws16 250.0000 Volt_PA 0.00 250.0000 FORMAT "%8.4" EXTENDED_LIMITS -327.6800 327.6700
 /begin AXIS_DESCR STD_AXIS InjVlv_pCalcVolt Pres_Rail 3 -3276.800 3276.700 FORMAT "%5.3" DEPOSIT ABSOLUTE /end AXIS_DESCR
/end CHARACTERISTIC
/begin CHARACTERISTIC InjVlv_uSetUpPress5_CUR "#SSD Kennlinie zur raildruckabh. Sollspannungsbestimmung für ISA-Klasse 5" CURVE 0xE1932 Kl_Xs16_Ws16 250.0000 Volt_PA 0.00 250.0000 FORMAT "%8.4" EXTENDED_LIMITS -327.6800 327.6700
 /begin AXIS_DESCR STD_AXIS InjVlv_pCalcVolt Pres_Rail 3 -3276.800 3276.700 FORMAT "%5.3" DEPOSIT ABSOLUTE /end AXIS_DESCR
/end CHARACTERISTIC
/begin CHARACTERISTIC InjVlv_uSetUpPress6_CUR "#SSD Kennlinie zur raildruckabh. Sollspannungsbestimmung für ISA-Klasse 6" CURVE 0xE1940 Kl_Xs16_Ws16 250.0000 Volt_PA 0.00 250.0000 FORMAT "%8.4" EXTENDED_LIMITS -327.6800 327.6700
 /begin AXIS_DESCR STD_AXIS InjVlv_pCalcVolt Pres_Rail 3 -3276.800 3276.700 FORMAT "%5.3" DEPOSIT ABSOLUTE /end AXIS_DESCR
/end CHARACTERISTIC
/begin CHARACTERISTIC InjVlv_uSetUpPress7_CUR "#SSD Kennlinie zur raildruckabh. Sollspannungsbestimmung für ISA-Klasse 7" CURVE 0xE194E Kl_Xs16_Ws16 250.0000 Volt_PA 0.00 250.0000 FORMAT "%8.4" EXTENDED_LIMITS -327.6800 327.6700
 /begin AXIS_DESCR STD_AXIS InjVlv_pCalcVolt Pres_Rail 3 -3276.800 3276.700 FORMAT "%5.3" DEPOSIT ABSOLUTE /end AXIS_DESCR
/end CHARACTERISTIC
/begin CHARACTERISTIC InjVlv_uSetUpPress8_CUR "#SSD Kennlinie zur raildruckabh. Sollspannungsbestimmung für ISA-Klasse 8" CURVE 0xE195C Kl_Xs16_Ws16 250.0000 Volt_PA 0.00 250.0000 FORMAT "%8.4" EXTENDED_LIMITS -327.6800 327.6700
 /begin AXIS_DESCR STD_AXIS InjVlv_pCalcVolt Pres_Rail 3 -3276.800 3276.700 FORMAT "%5.3" DEPOSIT ABSOLUTE /end AXIS_DESCR
/end CHARACTERISTIC
/begin CHARACTERISTIC InjVlv_uSetUpPress9_CUR "#SSD Kennlinie zur raildruckabh. Sollspannungsbestimmung für ISA-Klasse 9" CURVE 0xE196A Kl_Xs16_Ws16 250.0000 Volt_PA 0.00 250.0000 FORMAT "%8.4" EXTENDED_LIMITS -327.6800 327.6700
 /begin AXIS_DESCR STD_AXIS InjVlv_pCalcVolt Pres_Rail 3 -3276.800 3276.700 FORMAT "%5.3" DEPOSIT ABSOLUTE /end AXIS_DESCR
/end CHARACTERISTIC
/begin CHARACTERISTIC InjVlv_volQntAdjLim_C "#SSD symmetrische Begrenzung des Mengen-Abgleichwertes" VALUE 0xE1EB8 Kw_Ws16 128.0000 InjQntInj 0.00 128.0000 FORMAT "%8.4" EXTENDED_LIMITS -327.6800 327.6700 /end CHARACTERISTIC
/begin CHARACTERISTIC InjVlv_volQntAdjMax0_C "obere Grenzwerte der Mengen-Abgleichwerte für die ""0""-Quantisierungsschrittweite (0d=00b)" VAL_BLK 0xE1EBA Kwb_Ws16 6.300000 InjQntInj 0.00 6.300000 FORMAT "%8.6" EXTENDED_LIMITS -327.6800 327.6700 NUMBER 4 /end CHARACTERISTIC
/begin CHARACTERISTIC InjVlv_volQntAdjMax1_C "obere Grenzwerte der Mengen-Abgleichwerte für die ""1""-Quantisierungsschrittweite (1d=01b)" VAL_BLK 0xE1EC2 Kwb_Ws16 9.450000 InjQntInj 0.00 9.450000 FORMAT "%8.6" EXTENDED_LIMITS -327.6800 327.6700 NUMBER 4 /end CHARACTERISTIC
/begin CHARACTERISTIC InjVlv_volQntAdjMax2_C "obere Grenzwerte der Mengen-Abgleichwerte für die ""2""-Quantisierungsschrittweite (2d=10b)" VAL_BLK 0xE1ECA Kwb_Ws16 15.75000 InjQntInj 0.00 15.75000 FORMAT "%8.5" EXTENDED_LIMITS -327.6800 327.6700 NUMBER 4 /end CHARACTERISTIC
/begin CHARACTERISTIC InjVlv_volQntAdjMax3_C "obere Grenzwerte der Mengen-Abgleichwerte für die ""3""-Quantisierungsschrittweite (3d=11b)" VAL_BLK 0xE1ED2 Kwb_Ws16 31.50000 InjQntInj 0.00 31.50000 FORMAT "%8.5" EXTENDED_LIMITS -327.6800 327.6700 NUMBER 4 /end CHARACTERISTIC
/begin CHARACTERISTIC InjVlv_volQntAdjMin0_C "untere Grenzwerte der Mengen-Abgleichwerte für die ""0""-Quantisierungsschrittweite (0d=00b)" VAL_BLK 0xE1EDA Kwb_Ws16 6.400000 InjQntInj -6.400000 0.00 FORMAT "%8.6" EXTENDED_LIMITS -327.6800 327.6700 NUMBER 4 /end CHARACTERISTIC
/begin CHARACTERISTIC InjVlv_volQntAdjMin1_C "untere Grenzwerte der Mengen-Abgleichwerte für die ""1""-Quantisierungsschrittweite (1d=01b)" VAL_BLK 0xE1EE2 Kwb_Ws16 9.600000 InjQntInj -9.600000 0.00 FORMAT "%8.6" EXTENDED_LIMITS -327.6800 327.6700 NUMBER 4 /end CHARACTERISTIC
/begin CHARACTERISTIC InjVlv_volQntAdjMin2_C "untere Grenzwerte der Mengen-Abgleichwerte für die ""2""-Quantisierungsschrittweite (2d=10b)" VAL_BLK 0xE1EEA Kwb_Ws16 16.00000 InjQntInj -16.00000 0.00 FORMAT "%8.5" EXTENDED_LIMITS -327.6800 327.6700 NUMBER 4 /end CHARACTERISTIC
/begin CHARACTERISTIC InjVlv_volQntAdjMin3_C "untere Grenzwerte der Mengen-Abgleichwerte für die ""3""-Quantisierungsschrittweite (3d=11b)" VAL_BLK 0xE1EF2 Kwb_Ws16 32.00000 InjQntInj -32.00000 0.00 FORMAT "%8.5" EXTENDED_LIMITS -327.6800 327.6700 NUMBER 4 /end CHARACTERISTIC
/begin CHARACTERISTIC InjVlv_wInj_CUR "#SSD Kennlinie für Energieverbrauch einer Piezo-Aktor-Ansteuerung" CURVE 0xE1BCA Kl_Xs16_Ws16 100.0000 W_PA 0.00 100.0000 FORMAT "%8.4" EXTENDED_LIMITS -32768.00 32767.00
 /begin AXIS_DESCR STD_AXIS InjVlv_uSetUpAvrg_mp Volt_PA 2 -327.6800 327.6700 FORMAT "%8.4" DEPOSIT ABSOLUTE /end AXIS_DESCR
/end CHARACTERISTIC
/begin MEASUREMENT InjCrv_facPoI2EffRgn1_mp "corrected factor component for PoI2" SWORD Fact 1 100 -4.000000 3.999878 FORMAT "%8.6" ECU_ADDRESS 0x8FF41A /end MEASUREMENT
/begin MEASUREMENT InjCrv_facPoI2EffRgn2_mp "corrected factor component for PoI2" SWORD Fact 1 100 -4.000000 3.999878 FORMAT "%8.6" ECU_ADDRESS 0x8FF41C /end MEASUREMENT
/begin MEASUREMENT InjCrv_facPoI2EffRgnByp_mp "Effektivwert Nacheinspritzung Regeneration" SWORD Fact 1 100 -4.000000 3.999878 FORMAT "%8.6" ECU_ADDRESS 0x8FF41E /end MEASUREMENT
/begin MEASUREMENT InjCrv_phiPoI2AbsTot_mp "absoluter Ansteuerbeginn PoI2 aus Winkel- und Zeitkomponente" SWORD AngleCrS 1 100 -768.0000 767.9766 FORMAT "%8.4" ECU_ADDRESS 0x8FF436 /end MEASUREMENT
/begin MEASUREMENT InjCrv_phiPoI2Abs_mp "Sollwert, Winkelkomponente Ansteuerbeginn PoI2 relativ zum oberen Totpunkt" SWORD AngleCrS 1 100 -768.0000 767.9766 FORMAT "%8.4" ECU_ADDRESS 0x8FF438 /end MEASUREMENT
/begin MEASUREMENT InjCrv_phiPoI2Bas_mp "Winkelkomponente Ansteuerbeginn PoI2 Grundwert" SWORD AngleCrS 1 100 -768.0000 767.9766 FORMAT "%8.4" ECU_ADDRESS 0x8FF450 /end MEASUREMENT
/begin MEASUREMENT InjCrv_phiPoI2Byp_mp "Messpunkt für Bypass" SWORD AngleCrS 1 100 -768.0000 767.9766 FORMAT "%8.4" ECU_ADDRESS 0x8FF43A /end MEASUREMENT
/begin MEASUREMENT InjCrv_phiPoI2Cor_mp "korrigierter Grundwert der Winkelkomponente Ansteuerbeginn PoI2" SWORD AngleCrS 1 100 -768.0000 767.9766 FORMAT "%8.4" ECU_ADDRESS 0x8FF43C /end MEASUREMENT
/begin MEASUREMENT InjCrv_phiPoI2Des "gewünschter Bezugswinkel für Beginn der PoI2" SWORD AngleCrS 1 100 -768.0000 767.9766 FORMAT "%8.4" ECU_ADDRESS 0x7F8E0A /end MEASUREMENT
/begin MEASUREMENT InjCrv_phiPoI2Rel_mp "Winkelkomponente Ansteuerbeginn PoI2 relativ zur Haupteinspritzung" SWORD AngleCrS 1 100 -768.0000 767.9766 FORMAT "%8.4" ECU_ADDRESS 0x8FF43E /end MEASUREMENT
/begin MEASUREMENT InjCrv_phiPoI2Rgn1_mp "Regenerationswert 1 für Förderbeginn Nacheinspritzung" SWORD AngleCrS 1 100 -768.0000 767.9766 FORMAT "%8.4" ECU_ADDRESS 0x8FF420 /end MEASUREMENT
/begin MEASUREMENT InjCrv_phiPoI2Rgn2_mp "Regenerationswert 2 für Förderbeginn Nacheinspritzung" SWORD AngleCrS 1 100 -768.0000 767.9766 FORMAT "%8.4" ECU_ADDRESS 0x8FF422 /end MEASUREMENT
/begin MEASUREMENT InjCrv_phiPoI2RgnByp_mp "Measure point for Bypass" SWORD AngleCrS 1 100 -768.0000 767.9766 FORMAT "%8.4" ECU_ADDRESS 0x8FF424 /end MEASUREMENT
/begin MEASUREMENT InjCrv_POpPoI2Bas_mp "grundwert Freigabe PoI2" SWORD OneToOne 1 100 -32768.00 32767.00 FORMAT "%8.2" ECU_ADDRESS 0x8FF432 /end MEASUREMENT
/begin MEASUREMENT InjCrv_POpPoI2_mp "reigabe PoI2, korrigierter Grundwert" SWORD OneToOne 1 100 -32768.00 32767.00 FORMAT "%8.2" ECU_ADDRESS 0x8FF434 /end MEASUREMENT
/begin MEASUREMENT InjCrv_qPiI1MinWv_mp "Minimalmenge der PiI1 mit Wellenlorrektur" SWORD InjMassInj 1 100 -327.6800 327.6700 FORMAT "%8.4" ECU_ADDRESS 0x8FF454 /end MEASUREMENT
/begin MEASUREMENT InjCrv_qPoI2DesByp_mp "Messpunkt für den Bypass" SWORD InjMassInj 1 100 -327.6800 327.6700 FORMAT "%8.4" ECU_ADDRESS 0x8FF440 /end MEASUREMENT
/begin MEASUREMENT InjCrv_qPoI2EffByp_mp "Messpunkt für den Bypass" SWORD InjMassInj 1 100 -327.6800 327.6700 FORMAT "%8.4" ECU_ADDRESS 0x8FF442 /end MEASUREMENT
/begin MEASUREMENT InjCrv_qPoI2Rgn1_mp "Grundwert 1 für Regenerationsmenge Nacheinspritzung" SWORD InjMassInj 1 100 -327.6800 327.6700 FORMAT "%8.4" ECU_ADDRESS 0x8FF426 /end MEASUREMENT
/begin MEASUREMENT InjCrv_qPoI2Rgn2_mp "Regenerationswert 2  für Menge Nacheinspritzung" SWORD InjMassInj 1 100 -327.6800 327.6700 FORMAT "%8.4" ECU_ADDRESS 0x8FF428 /end MEASUREMENT
/begin MEASUREMENT InjCrv_qPoI2RgnByp_mp "Measure point for Bypass" SWORD InjMassInj 1 100 -327.6800 327.6700 FORMAT "%8.4" ECU_ADDRESS 0x8FF42A /end MEASUREMENT
/begin MEASUREMENT InjCrv_swtPoI2AgAbsTDC_mp "Status des Betriebsmodus Ansteuerbeginn PoI2 (entweder Winkel absolut zum TDC oder Winkel bzw. Zeit relativ zur MI)" UBYTE OneToOne 1 100 0.00 255.0 FORMAT "%5.1" ECU_ADDRESS 0x8FF444 /end MEASUREMENT
/begin MEASUREMENT InjCrv_tiPoI2Bas_mp "Zeitkomponente Ansteuerbeginn PoI2 Grundwert" SWORD InjTime_us 1 100 -32768.00 32767.00 FORMAT "%8.2" ECU_ADDRESS 0x8FF452 /end MEASUREMENT
/begin MEASUREMENT InjCrv_tiPoI2Byp_mp "Messpunkt für den Bypass" SWORD InjTime_us 1 100 -32768.00 32767.00 FORMAT "%8.2" ECU_ADDRESS 0x8FF446 /end MEASUREMENT
/begin MEASUREMENT InjCrv_tiPoI2Cor_mp "korrigierter Grundwert der Zeitkomponente Ansteuerbeginn PoI2" SWORD InjTime_us 1 100 -32768.00 32767.00 FORMAT "%8.2" ECU_ADDRESS 0x8FF448 /end MEASUREMENT
/begin MEASUREMENT InjCrv_tiPoI2Des "gewünschte Bezugszeitkomponente für Beginn PoI2" SWORD InjTime_us 1 100 -32768.00 32767.00 FORMAT "%8.2" ECU_ADDRESS 0x7F8E66 /end MEASUREMENT
/begin MEASUREMENT InjCrv_tiPoI2Max_mp "maximaler Ansteuerbeginn PoI2 relativ zur Haupteinspritzung" SWORD InjTime_us 1 100 -32768.00 32767.00 FORMAT "%8.2" ECU_ADDRESS 0x8FF44A /end MEASUREMENT
/begin MEASUREMENT InjCrv_tiPoI2RelTot_mp "Ansteuerbeginnabstand PoI2 aus Winkel- und Zeitkomponente" SWORD InjTime_us 1 100 -32768.00 32767.00 FORMAT "%8.2" ECU_ADDRESS 0x8FF44C /end MEASUREMENT
/begin MEASUREMENT InjCrv_tiPoI2Rel_mp "Zeitkomponente Ansteuerbeginn PoI2 relativ zur Haupteinspritzung" SWORD InjTime_us 1 100 -32768.00 32767.00 FORMAT "%8.2" ECU_ADDRESS 0x8FF44E /end MEASUREMENT
/begin MEASUREMENT InjCrv_tiPoI2Rgn1_mp "corrected time component for PoI2 Regeneration 1" SWORD InjTime_us 1 100 -32768.00 32767.00 FORMAT "%8.2" ECU_ADDRESS 0x8FF42C /end MEASUREMENT
/begin MEASUREMENT InjCrv_tiPoI2Rgn2_mp "Corrected time component for PoI2 Regeneration 2" SWORD InjTime_us 1 100 -32768.00 32767.00 FORMAT "%8.2" ECU_ADDRESS 0x8FF42E /end MEASUREMENT
/begin MEASUREMENT InjCrv_tiPoI2RgnByp_mp "Measure point for Bypass" SWORD InjTime_us 1 100 -32768.00 32767.00 FORMAT "%8.2" ECU_ADDRESS 0x8FF430 /end MEASUREMENT
/begin MEASUREMENT InjCrv_tiPse "feste oder gemessene Mindestzeit zwischen 2 Einspritzungen" SWORD InjTime_us 1 100 -32768.00 32767.00 FORMAT "%8.2" ECU_ADDRESS 0x7F8E6E /end MEASUREMENT
/begin MEASUREMENT InjCtl_dAdjQntCS_mp "Checksumme der Mengenabgleichkennfeldwerte (im EEPROM abgelegt)" UBYTE OneToOne 1 100 0.00 255.0 FORMAT "%5.1" ECU_ADDRESS 0x8FF456 /end MEASUREMENT
/begin MEASUREMENT InjCtl_dDriftCS_mp "Checksumme der Mengendriftkompensationswerte (im EEPROM abgelegt)" UBYTE OneToOne 1 100 0.00 255.0 FORMAT "%5.1" ECU_ADDRESS 0x8FF457 /end MEASUREMENT
/begin MEASUREMENT InjCtl_dqSetUnBal "Kraftstoffmassengradient ohne FBC" SWORD InjMassPerSec_20ms 1 100 -16384.00 16383.50 FORMAT "%8.2" ECU_ADDRESS 0x7F8E70 /end MEASUREMENT
/begin MEASUREMENT InjCtl_facAdjSrvUnlim_mp "Serviceabgleich Faktor (im EEPROM abgelegt)" SWORD Fact 1 100 -4.000000 3.999878 FORMAT "%8.6" ECU_ADDRESS 0x8FF458 /end MEASUREMENT
/begin MEASUREMENT InjCtl_facAdjSrv_mp "Serviceabgleichfaktor (nach Limitierung)" SWORD Fact 1 100 -4.000000 3.999878 FORMAT "%8.6" ECU_ADDRESS 0x8FF45A /end MEASUREMENT
/begin MEASUREMENT InjCtl_qAdjQntUnlim_mp "Mengenabgleichwert vor Begrenzung" SWORD InjMassCyc 1 100 -327.6800 327.6700 FORMAT "%8.4" ECU_ADDRESS 0x8FF45C /end MEASUREMENT
/begin MEASUREMENT InjCtl_qAdjQnt_mp "Mengenabgleichwert" SWORD InjMassCyc 1 100 -327.6800 327.6700 FORMAT "%8.4" ECU_ADDRESS 0x8FF45E /end MEASUREMENT
/begin MEASUREMENT InjCtl_qCurr "Einspritzmenge aktueller Wert" SWORD InjMassCyc 1 100 -327.6800 327.6700 FORMAT "%8.4" ECU_ADDRESS 0x7F8E72 /end MEASUREMENT
/begin MEASUREMENT InjCtl_qCurrCor "fuel mass current value with FMA correction" SWORD InjMassCyc 1 100 -327.6800 327.6700 FORMAT "%8.4" ECU_ADDRESS 0x7F8E74 /end MEASUREMENT
/begin MEASUREMENT InjCtl_qCurrUnCor "aktuelle Menge ohne Korrektur durch Mengenmittelwertadaption (FMA)" SWORD InjMassCyc 1 100 -327.6800 327.6700 FORMAT "%8.4" ECU_ADDRESS 0x7F8E76 /end MEASUREMENT
/begin MEASUREMENT InjCtl_qDes "Einspritzmenge Wunschwert" SWORD InjMassCyc 1 100 -327.6800 327.6700 FORMAT "%8.4" ECU_ADDRESS 0x7F8E78 /end MEASUREMENT
/begin MEASUREMENT InjCtl_qDesCor " fuel mass desired value with FMA correction" SWORD InjMassCyc 1 100 -327.6800 327.6700 FORMAT "%8.4" ECU_ADDRESS 0x7F8E7A /end MEASUREMENT
/begin MEASUREMENT InjCtl_qDriftComp_mp "Mengendriftkompensationswert" SWORD InjMassCyc 1 100 -327.6800 327.6700 FORMAT "%8.4" ECU_ADDRESS 0x8FF460 /end MEASUREMENT
/begin MEASUREMENT InjCtl_qDriftLim1_mp "Mengendriftkompensationwert nach Begrenzung durch EEPROM-Werte" SWORD InjMassCyc 1 100 -327.6800 327.6700 FORMAT "%8.4" ECU_ADDRESS 0x8FF462 /end MEASUREMENT
/begin MEASUREMENT InjCtl_qDriftLim2_mp "Mengendriftkompensationswert nach Begrenzung durch Datensatz" SWORD InjMassCyc 1 100 -327.6800 327.6700 FORMAT "%8.4" ECU_ADDRESS 0x8FF464 /end MEASUREMENT
/begin MEASUREMENT InjCtl_qDriftMax1_mp "Mengendriftkompensationsbegrenzung (im EEPROM abgelegt)" SWORD InjMassCyc 1 100 -327.6800 327.6700 FORMAT "%8.4" ECU_ADDRESS 0x8FF466 /end MEASUREMENT
/begin MEASUREMENT InjCtl_qDriftMin1_mp "Mengendriftkompensationsbegrenzung (im EEPROM abgelegt)" SWORD InjMassCyc 1 100 -327.6800 327.6700 FORMAT "%8.4" ECU_ADDRESS 0x8FF468 /end MEASUREMENT
/begin MEASUREMENT InjCtl_qDriftUnlim_mp "Mengendriftkompensation unbegrenzt" SWORD InjMassCyc 1 100 -327.6800 327.6700 FORMAT "%8.4" ECU_ADDRESS 0x8FF46A /end MEASUREMENT
/begin MEASUREMENT InjCtl_qLim "Begrenzungsmenge" SWORD InjMassCyc 1 100 -327.6800 327.6700 FORMAT "%8.4" ECU_ADDRESS 0x7F8E7C /end MEASUREMENT
/begin MEASUREMENT InjCtl_qLimErr "Begrenzungsmenge im Falle eines Systemfehlers" SWORD InjMass 1 100 -327.6800 327.6700 FORMAT "%8.4" ECU_ADDRESS 0x7F8E7E /end MEASUREMENT
/begin MEASUREMENT InjCtl_qLimSoftShOff_mp "soft shutoff limit" SWORD InjMassCyc 1 100 -327.6800 327.6700 FORMAT "%8.4" ECU_ADDRESS 0x8FF472 /end MEASUREMENT
/begin MEASUREMENT InjCtl_qLimSwt "Ausgang RampSwitch-Block für Begrenzungsmenge im Systemfehlerfall" SWORD InjMassCyc 1 100 -327.6800 327.6700 FORMAT "%8.4" ECU_ADDRESS 0x7F8E80 /end MEASUREMENT
/begin MEASUREMENT InjCtl_qLim_mp "fuel mass limitation in normal case" SWORD InjMassCyc 1 100 -327.6800 327.6700 FORMAT "%8.4" ECU_ADDRESS 0x8FF474 /end MEASUREMENT
/begin MEASUREMENT InjCtl_qRaw "Einspritzmenge Rohwert" SWORD InjMassCyc 1 100 -327.6800 327.6700 FORMAT "%8.4" ECU_ADDRESS 0x7F8E82 /end MEASUREMENT
/begin MEASUREMENT InjCtl_qRawCor " fuel mass raw value with FMA correction" SWORD InjMassCyc 1 100 -327.6800 327.6700 FORMAT "%8.4" ECU_ADDRESS 0x7F8E84 /end MEASUREMENT
/begin MEASUREMENT InjCtl_qSet "Einspritzmenge Sollwert" SWORD InjMassCyc 1 100 -327.6800 327.6700 FORMAT "%8.4" ECU_ADDRESS 0x7F8E86 /end MEASUREMENT
/begin MEASUREMENT InjCtl_qSetUnBal "Einspritzmenge Sollwert ohne Mengenausgleichsregelung" SWORD InjMassCyc 1 100 -327.6800 327.6700 FORMAT "%8.4" ECU_ADDRESS 0x7F8E88 /end MEASUREMENT
/begin MEASUREMENT InjCtl_qSetUnCor_mp "Menge vor Eingriff von Mengenabgleich, Serviceabgleich, Mengendriftkompensation" SWORD InjMassCyc 1 100 -327.6800 327.6700 FORMAT "%8.4" ECU_ADDRESS 0x8FF46C /end MEASUREMENT
/begin MEASUREMENT InjCtl_stAdjQnt_mp "Status vom Mengenabgleich" UBYTE OneToOne 1 100 0.00 255.0 FORMAT "%5.1" ECU_ADDRESS 0x8FF46E /end MEASUREMENT
/begin MEASUREMENT InjCtl_stNoInj "Status für keine Einspritzung (0 -> Einspritzung, 1 -> InjCtl_qSetUnBal == 0)" UBYTE OneToOne 1 100 0.00 255.0 FORMAT "%5.1" ECU_ADDRESS 0x7F88C6 /end MEASUREMENT
/begin MEASUREMENT InjCtl_stQLimErr "Status Begrenzungsmenge im Falle eines Systemfehlers (soll verwendet werden)" UBYTE OneToOne 1 100 0.00 255.0 FORMAT "%5.1" ECU_ADDRESS 0x7F88C7 /end MEASUREMENT
/begin MEASUREMENT InjCtl_tiEngOn_mp "Betriebsstundenzähler" SWORD TimeEngOnHrs 1 100 -596515.2 596497.0 FORMAT "%8.1" ECU_ADDRESS 0x8FF470 /end MEASUREMENT
/begin MEASUREMENT InjCtl_trqInrLim "Begrenzungsmoment (als inneres Moment) resultierend aus der Begrenzungsmenge InjCtl_qLim" SWORD Trq 1 100 -3276.800 3276.700 FORMAT "%8.3" ECU_ADDRESS 0x7F8E8A /end MEASUREMENT
/begin MEASUREMENT InjUn_numCylMI1_mp "Zylinder aktuell benutzt für 1. Haupteinspritzung" UBYTE OneToOne 1 100 0.00 255.0 FORMAT "%5.1" ECU_ADDRESS 0x6F8095 /end MEASUREMENT
/begin MEASUREMENT InjUn_numCylMI2_mp "Zylinder aktuell benutzt für 2. Haupteinspritzung" UBYTE OneToOne 1 100 0.00 255.0 FORMAT "%5.1" ECU_ADDRESS 0x6F8096 /end MEASUREMENT
/begin MEASUREMENT InjUn_numCylPiI1_mp "Zylindernummer zugehörend zur  Voreinspritzung 1" UBYTE OneToOne 1 100 0.00 255.0 FORMAT "%5.1" ECU_ADDRESS 0x6F8097 /end MEASUREMENT
/begin MEASUREMENT InjUn_numCylPiI2_mp "Zylindernummer zugehörend zur Voreinspritzung 2" UBYTE OneToOne 1 100 0.00 255.0 FORMAT "%5.1" ECU_ADDRESS 0x6F8098 /end MEASUREMENT
/begin MEASUREMENT InjUn_numCylPoI1_mp "Zylindernummer zugehörend zur Nacheinspritzung 1" UBYTE OneToOne 1 100 0.00 255.0 FORMAT "%5.1" ECU_ADDRESS 0x6F8099 /end MEASUREMENT
/begin MEASUREMENT InjUn_numCylPoI2_mp "Zylindernummer zugehörend zur Nacheinspritzung 2" UBYTE OneToOne 1 100 0.00 255.0 FORMAT "%5.1" ECU_ADDRESS 0x6F809A /end MEASUREMENT
/begin MEASUREMENT InjUn_pAct_mp "aktueller Raildruck ermittelt in InjUn_Sched" SWORD Pres_Rail 1 100 -3276.800 3276.700 FORMAT "%5.3" ECU_ADDRESS 0x8FF494 /end MEASUREMENT
/begin MEASUREMENT InjUn_qMI1Cor_mp "Korrigierte Menge der Haupteinspritzung 1" SWORD InjMassInj 1 100 -327.6800 327.6700 FORMAT "%8.4" ECU_ADDRESS 0x8FF476 /end MEASUREMENT
/begin MEASUREMENT InjUn_qPiI1Cor_mp "Korrigierte Menge der Voreinspritzung 1" SWORD InjMassInj 1 100 -327.6800 327.6700 FORMAT "%8.4" ECU_ADDRESS 0x8FF47C /end MEASUREMENT
/begin MEASUREMENT InjUn_qPiI2Cor_mp "Korrigierte Menge der Voreinspritzung 2" SWORD InjMassInj 1 100 -327.6800 327.6700 FORMAT "%8.4" ECU_ADDRESS 0x8FF482 /end MEASUREMENT
/begin MEASUREMENT InjUn_qPoI1Cor_mp "Korrigierte Menge der Nacheinspritzung 1" SWORD InjMassInj 1 100 -327.6800 327.6700 FORMAT "%8.4" ECU_ADDRESS 0x8FF488 /end MEASUREMENT
/begin MEASUREMENT InjUn_qPoI2Cor_mp "Korrigierte Menge der Nacheinspritzung 2" SWORD InjMassInj 1 100 -327.6800 327.6700 FORMAT "%8.4" ECU_ADDRESS 0x8FF48E /end MEASUREMENT
/begin MEASUREMENT InjUn_stInjValve "Abschaltanforderungen für Injektor" UBYTE OneToOne 1 100 0.00 255.0 FORMAT "%5.1" ECU_ADDRESS 0x7F88C8 /end MEASUREMENT
/begin MEASUREMENT InjUn_stMIOffs_mp "gewählter Spannungsoffset für MI" UBYTE OneToOne 1 100 0.00 255.0 FORMAT "%5.1" ECU_ADDRESS 0x8FF496 /end MEASUREMENT
/begin MEASUREMENT InjUn_stPiI1Offs_mp "gewählter Spannungsoffset für PI1" UBYTE OneToOne 1 100 0.00 255.0 FORMAT "%5.1" ECU_ADDRESS 0x8FF497 /end MEASUREMENT
/begin MEASUREMENT InjUn_stPiI2Offs_mp "gewählter Spannungsoffset für PI2" UBYTE OneToOne 1 100 0.00 255.0 FORMAT "%5.1" ECU_ADDRESS 0x8FF498 /end MEASUREMENT
/begin MEASUREMENT InjUn_stPiI3Offs_mp "gewählter Spannungsoffset für PI3" UBYTE OneToOne 1 100 0.00 255.0 FORMAT "%5.1" ECU_ADDRESS 0x8FF499 /end MEASUREMENT
/begin MEASUREMENT InjUn_stShutOffReq "Abschaltanforderungen aus dem Einspritzsystem" UBYTE OneToOne 1 100 0.00 255.0 FORMAT "%5.1" ECU_ADDRESS 0x7F88C9 /end MEASUREMENT
/begin MEASUREMENT InjUn_stSOPTstInjBeg_mp "Status Einspritzbeginn (0 = kein Fehler)" UBYTE OneToOne 1 100 0.00 255.0 FORMAT "%5.1" ECU_ADDRESS 0x8FF49A /end MEASUREMENT
/begin MEASUREMENT InjUn_stSOPTstInjDur_mp "Status Ansteuerdauer (0 = kein Fehler)" UBYTE OneToOne 1 100 0.00 255.0 FORMAT "%5.1" ECU_ADDRESS 0x8FF49B /end MEASUREMENT
/begin MEASUREMENT InjUn_stTst "allgemeiner Status der Tests, die im Einspritzsystem durchgeführt werden" UWORD OneToOne 1 100 0.00 65535.00 FORMAT "%8.2" ECU_ADDRESS 0x7F8E8C /end MEASUREMENT
/begin MEASUREMENT InjUn_volMI1CorCyc "zylinderspezifisches Korrekturvolumen aus Mengenausgleichsregelung und Injektor-Abgleichmenge für MI1" SWORD InjQntInj 1 100 -327.6800 327.6700 FORMAT "%8.4" ARRAY_SIZE 6 ECU_ADDRESS 0x7F9290 /end MEASUREMENT
/begin MEASUREMENT InjUn_volMI1Cor_mp "Korrigiertes Volumen der Haupteinspritzung 1" SWORD InjQntInj 1 100 -327.6800 327.6700 FORMAT "%8.4" ECU_ADDRESS 0x8FF478 /end MEASUREMENT
/begin MEASUREMENT InjUn_volMI1_mp "Einspritzvolumen der Haupteinspritzung 1 nach Mengenabgleich" SWORD InjQntInj 1 100 -327.6800 327.6700 FORMAT "%8.4" ECU_ADDRESS 0x8FF47A /end MEASUREMENT
/begin MEASUREMENT InjUn_volPiI1CorCyc "zylinderspezifisches Korrekturvolumen aus Mengenausgleichsregelung und Injektor-Abgleichmenge für PiI1" SWORD InjQntInj 1 100 -327.6800 327.6700 FORMAT "%8.4" ARRAY_SIZE 6 ECU_ADDRESS 0x7F929C /end MEASUREMENT
/begin MEASUREMENT InjUn_volPiI1Cor_mp "Korrigiertes Volumen der Voreinspritzung 1" SWORD InjQntInj 1 100 -327.6800 327.6700 FORMAT "%8.4" ECU_ADDRESS 0x8FF47E /end MEASUREMENT
/begin MEASUREMENT InjUn_volPiI1_mp "Einspritzvolumen der Voreinspritzung 1 nach Mengenabgleich" SWORD InjQntInj 1 100 -327.6800 327.6700 FORMAT "%8.4" ECU_ADDRESS 0x8FF480 /end MEASUREMENT
/begin MEASUREMENT InjUn_volPiI2CorCyc "zylinderspezifisches Korrekturvolumen aus Mengenausgleichsregelung und Injektor-Abgleichmenge für PiI2" SWORD InjQntInj 1 100 -327.6800 327.6700 FORMAT "%8.4" ARRAY_SIZE 6 ECU_ADDRESS 0x7F92A8 /end MEASUREMENT
/begin MEASUREMENT InjUn_volPiI2Cor_mp "Korrigiertes Volumen der Voreinspritzung 2" SWORD InjQntInj 1 100 -327.6800 327.6700 FORMAT "%8.4" ECU_ADDRESS 0x8FF484 /end MEASUREMENT
/begin MEASUREMENT InjUn_volPiI2_mp "Einspritzvolumen der Voreinspritzung 2 nach Mengenabgleich" SWORD InjQntInj 1 100 -327.6800 327.6700 FORMAT "%8.4" ECU_ADDRESS 0x8FF486 /end MEASUREMENT
/begin MEASUREMENT InjUn_volPoI1Cor_mp "Korrigiertes Volumen der Nacheinspritzung 1" SWORD InjQntInj 1 100 -327.6800 327.6700 FORMAT "%8.4" ECU_ADDRESS 0x8FF48A /end MEASUREMENT
/begin MEASUREMENT InjUn_volPoI1_mp "Einspritzvolumen der Nacheinspritzung 1 nach Mengenabgleich" SWORD InjQntInj 1 100 -327.6800 327.6700 FORMAT "%8.4" ECU_ADDRESS 0x8FF48C /end MEASUREMENT
/begin MEASUREMENT InjUn_volPoI2Cor_mp "Korrigiertes Volumen der Nacheinspritzung 2" SWORD InjQntInj 1 100 -327.6800 327.6700 FORMAT "%8.4" ECU_ADDRESS 0x8FF490 /end MEASUREMENT
/begin MEASUREMENT InjUn_volPoI2_mp "Einspritzvolumen der Nacheinspritzung 2 nach Mengenabgleich" SWORD InjQntInj 1 100 -327.6800 327.6700 FORMAT "%8.4" ECU_ADDRESS 0x8FF492 /end MEASUREMENT
/begin MEASUREMENT InjVCD_chgUpActrCurr "geflossene Ladung beim Laden des Aktors von Bottom- auf Up-Niveau" SWORD Charge_PA 1 100 -32768.00 32767.00 FORMAT "%8.2" ARRAY_SIZE 6 ECU_ADDRESS 0x7F92D8 /end MEASUREMENT
/begin MEASUREMENT InjVCD_ctMI1AgDiff_mp "Zähler für Winkelverletzungen bei Programmierung des Ansteuerbeginns der MI1" UWORD OneToOne 1 100 0.00 65535.00 FORMAT "%8.2" ECU_ADDRESS 0x8FF5CA /end MEASUREMENT
/begin MEASUREMENT InjVCD_ctPiI1AgDiff_mp "Zähler für Winkelverletzungen bei Programmierung des Ansteuerbeginns der PiI1" UWORD OneToOne 1 100 0.00 65535.00 FORMAT "%8.2" ECU_ADDRESS 0x8FF5D0 /end MEASUREMENT
/begin MEASUREMENT InjVCD_ctPiI2AgDiff_mp "Zähler für Winkelverletzungen bei Programmierung des Ansteuerbeginns der PiI2" UWORD OneToOne 1 100 0.00 65535.00 FORMAT "%8.2" ECU_ADDRESS 0x8FF5D6 /end MEASUREMENT
/begin MEASUREMENT InjVCD_ctPolarOvrRun_mp "Überlaufzähler für Polarisierung" ULONG OneToOne 1 100 0.00 4294967295.00 FORMAT "%13.2" ARRAY_SIZE 6 ECU_ADDRESS 0x8FF594 /end MEASUREMENT
/begin MEASUREMENT InjVCD_ctUBufTrig_mp "Zähler für Anzahl der QADC-Trigger" UBYTE OneToOne 1 100 0.00 255.0 FORMAT "%5.1" ECU_ADDRESS 0x8FF548 /end MEASUREMENT
/begin MEASUREMENT InjVCD_cUpActrCurr "aktuelle Aktorkapazität (Laden)" SWORD Capacity_PA 1 100 -32.76800 32.76700 FORMAT "%8.5" ARRAY_SIZE 6 ECU_ADDRESS 0x7F92C0 /end MEASUREMENT
/begin MEASUREMENT InjVCD_cUpActrOld "Vorletzte Aktorkapazitaet nach Laden von Bottom nach Up Niveau" SWORD Capacity_PA 1 100 -32.76800 32.76700 FORMAT "%8.5" ARRAY_SIZE 6 ECU_ADDRESS 0x7F92CC /end MEASUREMENT
/begin MEASUREMENT InjVCD_facAmp_mp "Stromverstärkungsfaktor des CY370-Integrators" SWORD Fact_IntAmp 1 100 -32.76800 32.76700 FORMAT "%8.5" ECU_ADDRESS 0x8FF49C /end MEASUREMENT
/begin MEASUREMENT InjVCD_facWActrDvt "Abweichungsfaktor des gemessenen Aktorenergieverbrauchs vom nominalen" SWORD Fact1 1 100 -256.0000 255.9922 FORMAT "%8.4" ECU_ADDRESS 0x7F8E8E /end MEASUREMENT
/begin MEASUREMENT InjVCD_facWActrDvt_mp "Korrigiertes und begrenztes Verhältnis von tatsächlichem zu normiertem Aktor-Energieverbrauch" SWORD Fact1 1 100 -256.0000 255.9922 FORMAT "%8.4" ECU_ADDRESS 0x8FF4A8 /end MEASUREMENT
/begin MEASUREMENT InjVCD_facWActrRaw_mp "Verhältnis von tatsächlichem zu normiertem Aktor-Energieverbrauch" SWORD Fact1 1 100 -256.0000 255.9922 FORMAT "%8.4" ECU_ADDRESS 0x8FF4AA /end MEASUREMENT
/begin MEASUREMENT InjVCD_iPolarChrg_mp "Ladestrom während der Polarisierung" SWORD Curr 1 100 -32768.00 32767.00 FORMAT "%8.2" ECU_ADDRESS 0x8FF5AC /end MEASUREMENT
/begin MEASUREMENT InjVCD_iPolarDisCh_mp "Entladestrom während der Polarisierung" SWORD Curr 1 100 -32768.00 32767.00 FORMAT "%8.2" ECU_ADDRESS 0x8FF5AE /end MEASUREMENT
/begin MEASUREMENT InjVCD_numCollPrim_mp "Beschreibung der Primärkollision" UBYTE OneToOne 1 100 0.00 255.0 FORMAT "%5.1" ECU_ADDRESS 0x8FF504 /end MEASUREMENT
/begin MEASUREMENT InjVCD_numCollScnd_mp "Beschreibung der Sekundärkollision" UBYTE OneToOne 1 100 0.00 255.0 FORMAT "%5.1" ECU_ADDRESS 0x8FF505 /end MEASUREMENT
/begin MEASUREMENT InjVCD_numCollThrd_mp "Beschreibung der Tertiärkollision" UBYTE OneToOne 1 100 0.00 255.0 FORMAT "%5.1" ECU_ADDRESS 0x8FF506 /end MEASUREMENT
/begin MEASUREMENT InjVCD_numCrntLvl_mp "ausgewähltes Stromband" SBYTE OneToOne 1 100 -128.0 127.0 FORMAT "%5.1" ECU_ADDRESS 0x8FF5E0 /end MEASUREMENT
/begin MEASUREMENT InjVCD_numEvMgmtStat_mp "Statusinformation des Flankenmanagement" ULONG OneToOne 1 100 0.00 4294967295.00 FORMAT "%13.2" ARRAY_SIZE 8 ECU_ADDRESS 0x8FF508 /end MEASUREMENT
/begin MEASUREMENT InjVCD_numFacWValid_mp "Anzahl gültiger Werte von InjVCD_facWActrDvt_mp" ULONG OneToOne 1 100 0.00 4294967295.00 FORMAT "%13.2" ECU_ADDRESS 0x6F80CC /end MEASUREMENT
/begin MEASUREMENT InjVCD_numHandle "Handle of the TPU channel which holds the injection to be measured" UBYTE OneToOne 1 100 0.00 255.0 FORMAT "%5.1" ECU_ADDRESS 0x7F88CA /end MEASUREMENT
/begin MEASUREMENT InjVCD_numMeas "Nummer des Aktors der gerade vermessen wird" UBYTE OneToOne 1 100 0.00 255.0 FORMAT "%5.1" ECU_ADDRESS 0x7F88CB /end MEASUREMENT
/begin MEASUREMENT InjVCD_numOfsSelect "ausgewählter Spannungsoffset" SWORD OneToOne 1 100 -32768.00 32767.00 FORMAT "%8.2" ECU_ADDRESS 0x7F8E90 /end MEASUREMENT
/begin MEASUREMENT InjVCD_numOfsSelect_mp "zuletzt verwendeter Spannungsoffset" UBYTE OneToOne 1 100 0.00 255.0 FORMAT "%5.1" ECU_ADDRESS 0x8FF49E /end MEASUREMENT
/begin MEASUREMENT InjVCD_numReacPrim_mp "Beschreibung der Primärreaktion" UBYTE OneToOne 1 100 0.00 255.0 FORMAT "%5.1" ECU_ADDRESS 0x8FF528 /end MEASUREMENT
/begin MEASUREMENT InjVCD_numReacScnd_mp "Beschreibung der Sekundärreaktion" UBYTE OneToOne 1 100 0.00 255.0 FORMAT "%5.1" ECU_ADDRESS 0x8FF529 /end MEASUREMENT
/begin MEASUREMENT InjVCD_numWValid_mp "Anzahl der gültigen, gepaarten Lade- und Entladeenergiene (aktorspezifisch)" ULONG OneToOne 1 100 0.00 4294967295.00 FORMAT "%13.2" ARRAY_SIZE 6 ECU_ADDRESS 0x6F80D0 /end MEASUREMENT
/begin MEASUREMENT InjVCD_pActInj "verwendeter Raildruck der bei letzter Aktormessung gültig war" SWORD Pres_Rail 1 100 -3276.800 3276.700 FORMAT "%5.3" ECU_ADDRESS 0x7F8E92 /end MEASUREMENT
/begin MEASUREMENT InjVCD_phiMI1Diff_mp "Winkeldifferenz zwischen dem gewünschten Ansteuerbeginn und dem systembed. frühesten Ansteuerbeginn der MI1" SWORD AngleCrS 1 100 -768.0000 767.9766 FORMAT "%8.4" ECU_ADDRESS 0x8FF5CC /end MEASUREMENT
/begin MEASUREMENT InjVCD_phiPiI1Diff_mp "Winkeldifferenz zwischen dem gewünschten Ansteuerbeginn und dem systembed. frühesten Ansteuerbeginn der PiI1" SWORD AngleCrS 1 100 -768.0000 767.9766 FORMAT "%8.4" ECU_ADDRESS 0x8FF5D2 /end MEASUREMENT
/begin MEASUREMENT InjVCD_phiPiI2Diff_mp "Winkeldifferenz zwischen dem gewünschten Ansteuerbeginn und dem systembed. frühesten Ansteuerbeginn der PiI2" SWORD AngleCrS 1 100 -768.0000 767.9766 FORMAT "%8.4" ECU_ADDRESS 0x8FF5D8 /end MEASUREMENT
/begin MEASUREMENT InjVCD_pInET_mp "X-Eingang des Kennfeldes InjVCD_tiET_MAP auf dem Appplikationswerkzeug" SWORD Pres_Rail 1 100 -3276.800 3276.700 FORMAT "%5.3" ECU_ADDRESS 0x8FF544 /end MEASUREMENT
/begin MEASUREMENT InjVCD_pPolar_mp "Raildruck zum Zeitpunkt der Polarisierung" SWORD Pres_Rail 1 100 -3276.800 3276.700 FORMAT "%5.3" ECU_ADDRESS 0x8FF5B0 /end MEASUREMENT
/begin MEASUREMENT InjVCD_PZOSWType "SW-Identifikation" ULONG OneToOne 1 100 0.00 4294967295.00 FORMAT "%13.2" ECU_ADDRESS 0x7F9170 /end MEASUREMENT
/begin MEASUREMENT InjVCD_qInZFCETGMap_mp "Menge fuer Eingangsanzeige der Gruppenkennfelder InjVCD_rZFCETMsk_GMAP, ...Dif0_GMAP, ...Dif1_GMAP" SWORD InjMassInj 1 100 -327.6800 327.6700 FORMAT "%8.4" ECU_ADDRESS 0x8FF60E /end MEASUREMENT
/begin MEASUREMENT InjVCD_rCapThresHigh_mp "berechnetes Kapazitätsverhältnis der überwachten Aktoren (Schwelle high)" SWORD Fact 1 100 -4.000000 3.999878 FORMAT "%8.6" ECU_ADDRESS 0x8FF56C /end MEASUREMENT
/begin MEASUREMENT InjVCD_rCapThresLow_mp "berechnetes Kapazitätsverhältnis der überwachten Aktoren (Schwelle low)" SWORD Fact 1 100 -4.000000 3.999878 FORMAT "%8.6" ECU_ADDRESS 0x8FF56E /end MEASUREMENT
/begin MEASUREMENT InjVCD_rCapUpCurrToKx_mp "berechnetes Verhältnis der Aktorkapazitäten (aktuell zu alt)" SWORD Fact 1 100 -4.000000 3.999878 FORMAT "%8.6" ECU_ADDRESS 0x8FF570 /end MEASUREMENT
/begin MEASUREMENT InjVCD_rCapUpKxToCurr_mp "berechnetes Verhältnis der Aktorkapazitäten (alt zu aktuell)" SWORD Fact 1 100 -4.000000 3.999878 FORMAT "%8.6" ECU_ADDRESS 0x8FF572 /end MEASUREMENT
/begin MEASUREMENT InjVCD_rClsVolt_mp "Quotient aus Beginn- und Ende-Spannung" SLONG Milli 1 100 -2147483.64800 2147483.64700 FORMAT "%13.5" ARRAY_SIZE 6 ECU_ADDRESS 0x8FF4C0 /end MEASUREMENT
/begin MEASUREMENT InjVCD_regCY370Bank "Bank-selektives Register des CY370" UBYTE OneToOne 1 100 0.00 255.0 FORMAT "%5.1" ECU_ADDRESS 0x7F88CC /end MEASUREMENT
/begin MEASUREMENT InjVCD_regCY370CylISel "Zylinder-selektives Register des CY370 (ISel)" UBYTE OneToOne 1 100 0.00 255.0 FORMAT "%5.1" ECU_ADDRESS 0x7F88CD /end MEASUREMENT
/begin MEASUREMENT InjVCD_regCY370Global "Globales Register des CY370" UBYTE OneToOne 1 100 0.00 255.0 FORMAT "%5.1" ECU_ADDRESS 0x7F88CE /end MEASUREMENT
/begin MEASUREMENT InjVCD_regCY370ID_mp "Chip-ID des CY370" UBYTE OneToOne 1 100 0.00 255.0 FORMAT "%5.1" ECU_ADDRESS 0x8FF4F2 /end MEASUREMENT
/begin MEASUREMENT InjVCD_regCY370Status "Status-Register des CY370" UBYTE OneToOne 1 100 0.00 255.0 FORMAT "%5.1" ECU_ADDRESS 0x7F88CF /end MEASUREMENT
/begin MEASUREMENT InjVCD_rTiChrgUpCurrToKx_mp "Verhaeltnis vo aktueller Ladezeit zu vorletzter Ladezeit" SWORD Fact 1 100 -4.000000 3.999878 FORMAT "%8.6" ECU_ADDRESS 0x8FF574 /end MEASUREMENT
/begin MEASUREMENT InjVCD_rTiChrgUpKxToCurr_mp "Verhaeltnis von vorletzter Aktorladezeit zu aktueller Aktorladezeit" SWORD Fact 1 100 -4.000000 3.999878 FORMAT "%8.6" ECU_ADDRESS 0x8FF576 /end MEASUREMENT
/begin MEASUREMENT InjVCD_rTiChrgUpThresHigh_mp "Oberes Verhaeltnis der Aktorladezeit aktuell/alt zur Erkennung eines Lowside Schalter Kurzschlusses" SWORD Fact 1 100 -4.000000 3.999878 FORMAT "%8.6" ECU_ADDRESS 0x8FF578 /end MEASUREMENT
/begin MEASUREMENT InjVCD_rTiChrgUpThresLow_mp "Unteres Verhaeltnis der Aktorladezeit aktuell/alt zur Erkennung eines Lowside Schalter Kurzschlusses" SWORD Fact 1 100 -4.000000 3.999878 FORMAT "%8.6" ECU_ADDRESS 0x8FF57A /end MEASUREMENT
/begin MEASUREMENT InjVCD_rZFCETCoeffDif_mp "Bewertungsfaktoren fuer Ansteuerdauerkorrektur durch Nullmengenkalibrierung" SWORD Prc 1 100 -400.0000 399.9878 FORMAT "%8.4" ARRAY_SIZE 3 ECU_ADDRESS 0x8FF5E2 /end MEASUREMENT
/begin MEASUREMENT InjVCD_rZFCETCoeffMsk_mp "Gesamtbewertungsfaktor der Ansteuerdauerkorrektur durch Nullmengenkalibrierung" SWORD Prc 1 100 -400.0000 399.9878 FORMAT "%8.4" ECU_ADDRESS 0x8FF5E8 /end MEASUREMENT
/begin MEASUREMENT InjVCD_stActrEnrg "Status der Aktorenergiemessung (aktorspezifisch)" UBYTE OneToOne 1 100 0.00 255.0 FORMAT "%5.1" ARRAY_SIZE 6 ECU_ADDRESS 0x7F9206 /end MEASUREMENT
/begin MEASUREMENT InjVCD_stAvrgEna "freigegebene Zylinder zur Mittelwertsberechnung" UBYTE OneToOne 1 100 0.00 255.0 FORMAT "%5.1" ECU_ADDRESS 0x7F88D0 /end MEASUREMENT
/begin MEASUREMENT InjVCD_stAvrgEnaTiWarn "Warnung für geringe Zeitdifferenz" UBYTE OneToOne 1 100 0.00 255.0 FORMAT "%5.1" ECU_ADDRESS 0x7F88D1 /end MEASUREMENT
/begin MEASUREMENT InjVCD_stBufC "Status des DC/DC-Wandler Komponententreibers" UBYTE OneToOne 1 100 0.00 255.0 FORMAT "%5.1" ECU_ADDRESS 0x7F88D2 /end MEASUREMENT
/begin MEASUREMENT InjVCD_stCalcChrgActr "Zustand der Ladungsberechnung" UBYTE OneToOne 1 100 0.00 255.0 FORMAT "%5.1" ECU_ADDRESS 0x7F88D4 /end MEASUREMENT
/begin MEASUREMENT InjVCD_stClsActr "Status der Piezoaktor-Klassifizierung" UBYTE Actr_Cls_State 1 100 0.00 4.00000000000 FORMAT "%13.11" ECU_ADDRESS 0x7F88D5 /end MEASUREMENT
/begin MEASUREMENT InjVCD_stCY370Buf "Buffer(kondensator)status" UBYTE OneToOne 1 100 0.00 255.0 FORMAT "%5.1" ECU_ADDRESS 0x7F88D3 /end MEASUREMENT
/begin MEASUREMENT InjVCD_stCY370Event_mp "Rueckgabewert des single event (0 = kein Fehler)" UBYTE OneToOne 1 100 0.00 255.0 FORMAT "%5.1" ECU_ADDRESS 0x8FF4F3 /end MEASUREMENT
/begin MEASUREMENT InjVCD_stInjBegMI1_mp "Status der Beginnprogrammierung der Haupteinspritzung" UBYTE OneToOne 1 100 0.00 255.0 FORMAT "%5.1" ECU_ADDRESS 0x8FF5C8 /end MEASUREMENT
/begin MEASUREMENT InjVCD_stInjBegPiI1_mp "Status der Förderbeginnprogrammierung für die Voreinspritzung" UBYTE OneToOne 1 100 0.00 255.0 FORMAT "%5.1" ECU_ADDRESS 0x8FF5CE /end MEASUREMENT
/begin MEASUREMENT InjVCD_stInjBegPiI2_mp "Status der Einspritzbeginnprogrammierung für PiI2" UBYTE OneToOne 1 100 0.00 255.0 FORMAT "%5.1" ECU_ADDRESS 0x8FF5D4 /end MEASUREMENT
/begin MEASUREMENT InjVCD_stInjBegPiI3_mp "Status der Einspritzbeginnprogrammierung PiI3" UBYTE OneToOne 1 100 0.00 255.0 FORMAT "%5.1" ECU_ADDRESS 0x8FF5DA /end MEASUREMENT
/begin MEASUREMENT InjVCD_stInjBegPoI1_mp "Status der Einspritzbeginnprogrammierung PoI1" UBYTE OneToOne 1 100 0.00 255.0 FORMAT "%5.1" ECU_ADDRESS 0x8FF5DE /end MEASUREMENT
/begin MEASUREMENT InjVCD_stInjBegPoI2_mp "Status der Förderbeginnprogrammierung der Nacheinspritzung" UBYTE OneToOne 1 100 0.00 255.0 FORMAT "%5.1" ECU_ADDRESS 0x8FF5DF /end MEASUREMENT
/begin MEASUREMENT InjVCD_stInjMI1_mp "Status der Haupteinspritzung-1-Programmierung" UBYTE OneToOne 1 100 0.00 255.0 FORMAT "%5.1" ECU_ADDRESS 0x8FF5C0 /end MEASUREMENT
/begin MEASUREMENT InjVCD_stInjMI2_mp "Status der Haupteinspritzung-2-Programmierung" UBYTE OneToOne 1 100 0.00 255.0 FORMAT "%5.1" ECU_ADDRESS 0x8FF5C1 /end MEASUREMENT
/begin MEASUREMENT InjVCD_stInjPiI1_mp "Status der Voreinspritzung-1-Programmierung" UBYTE OneToOne 1 100 0.00 255.0 FORMAT "%5.1" ECU_ADDRESS 0x8FF5C2 /end MEASUREMENT
/begin MEASUREMENT InjVCD_stInjPiI2_mp "Status der Voreinspritzung-2-Programmierung" UBYTE OneToOne 1 100 0.00 255.0 FORMAT "%5.1" ECU_ADDRESS 0x8FF5C3 /end MEASUREMENT
/begin MEASUREMENT InjVCD_stInjPiI3_mp "Status der Voreinspritzung-3-Programmierung" UBYTE OneToOne 1 100 0.00 255.0 FORMAT "%5.1" ECU_ADDRESS 0x8FF5C4 /end MEASUREMENT
/begin MEASUREMENT InjVCD_stInjPoI1_mp "Status der Nacheinspritzung-1-Programmierung" UBYTE OneToOne 1 100 0.00 255.0 FORMAT "%5.1" ECU_ADDRESS 0x8FF5C5 /end MEASUREMENT
/begin MEASUREMENT InjVCD_stInjPoI2_mp "Status der Nacheinspritzung-2-Programmierung" UBYTE OneToOne 1 100 0.00 255.0 FORMAT "%5.1" ECU_ADDRESS 0x8FF5C6 /end MEASUREMENT
/begin MEASUREMENT InjVCD_stInjTPUCM_mp "Kollisionsmanagerstatus" UBYTE OneToOne 1 100 0.00 255.0 FORMAT "%5.1" ECU_ADDRESS 0x8FF5DB /end MEASUREMENT
/begin MEASUREMENT InjVCD_stInjTPUErr_mp "TPU Fehlerstatus" UBYTE OneToOne 1 100 0.00 255.0 FORMAT "%5.1" ECU_ADDRESS 0x8FF5DC /end MEASUREMENT
/begin MEASUREMENT InjVCD_stInjTPUShortDur_mp "Status zu kurze Ansteuerdauer programmiert" UBYTE OneToOne 1 100 0.00 255.0 FORMAT "%5.1" ECU_ADDRESS 0x8FF5DD /end MEASUREMENT
/begin MEASUREMENT InjVCD_stInjZFC_mp "Status der ZFC Programmierung" UBYTE OneToOne 1 100 0.00 255.0 FORMAT "%5.1" ECU_ADDRESS 0x8FF5C7 /end MEASUREMENT
/begin MEASUREMENT InjVCD_stMeas "Zustand des Messkoordinators" UBYTE OneToOne 1 100 0.00 255.0 FORMAT "%5.1" ECU_ADDRESS 0x7F88D6 /end MEASUREMENT
/begin MEASUREMENT InjVCD_stMeasLvl "Status des aufgetretenen Spannungsniveaus des Piezoaktors" UBYTE OneToOne 1 100 0.00 255.0 FORMAT "%5.1" ECU_ADDRESS 0x7F88D8 /end MEASUREMENT
/begin MEASUREMENT InjVCD_stMeasLvlFirst "Status des aufgetretenen ersten Spannungsniveaus des Piezoaktors" UBYTE OneToOne 1 100 0.00 255.0 FORMAT "%5.1" ECU_ADDRESS 0x7F88D9 /end MEASUREMENT
/begin MEASUREMENT InjVCD_stMon "Status Injektordiangose in der Steuergeräteinitialisierung" UBYTE OneToOne 1 100 0.00 255.0 FORMAT "%5.1" ECU_ADDRESS 0x7F88DA /end MEASUREMENT
/begin MEASUREMENT InjVCD_stMonChgActr "Status der Ladungsmessung (aktorspezifisch)" UBYTE OneToOne 1 100 0.00 255.0 FORMAT "%5.1" ARRAY_SIZE 6 ECU_ADDRESS 0x7F920C /end MEASUREMENT
/begin MEASUREMENT InjVCD_stMonShCir "Status der Kurzschlussunterscheidung im Nachlauf" UBYTE stMonShCir 1 100 0.00 4.00000000000 FORMAT "%13.11" ECU_ADDRESS 0x7F88DB /end MEASUREMENT
/begin MEASUREMENT InjVCD_stMonTiPlaus "Status der einspritzspezifisch gemessenen Ladezeit" UBYTE OneToOne 1 100 0.00 255.0 FORMAT "%5.1" ARRAY_SIZE 2 ECU_ADDRESS 0x7F8E94 /end MEASUREMENT
/begin MEASUREMENT InjVCD_stMonUBnkPlaus "Status der gemessenen Aktorspannung des Ansteuerverlaufs (Bank-spezifisch)" UBYTE OneToOne 1 100 0.00 255.0 FORMAT "%5.1" ARRAY_SIZE 2 ECU_ADDRESS 0x7F8E96 /end MEASUREMENT
/begin MEASUREMENT InjVCD_stMonUCylPlaus "Status der gemessenen Aktorspannung des Ansteuerverlaufs (zylinder-spezifisch)" UBYTE OneToOne 1 100 0.00 255.0 FORMAT "%5.1" ARRAY_SIZE 6 ECU_ADDRESS 0x7F9212 /end MEASUREMENT
/begin MEASUREMENT InjVCD_stPolar "Status der Polarisierung der Piezo-Aktoren" UBYTE OneToOne 1 100 0.00 255.0 FORMAT "%5.1" ECU_ADDRESS 0x7F88DC /end MEASUREMENT
/begin MEASUREMENT InjVCD_stPolarOvrlap_mp "Zustand: Polarisierung läuft im überlappenden Modus" SWORD OneToOne 1 100 -32768.00 32767.00 FORMAT "%8.2" ECU_ADDRESS 0x8FF5B2 /end MEASUREMENT
/begin MEASUREMENT InjVCD_stPolarPreCond_mp "Status: Vorbedingungen für Polarisierung erfüllt" UBYTE OneToOne 1 100 0.00 255.0 FORMAT "%5.1" ECU_ADDRESS 0x8FF5B4 /end MEASUREMENT
/begin MEASUREMENT InjVCD_stShCirSelSwtCab "Status ""Cylinder-Select Schalter Kurzschluss"" und ""Kurzschluss zweier Injektorleitungen (lowside)""" UBYTE OneToOne 1 100 0.00 255.0 FORMAT "%5.1" ECU_ADDRESS 0x7F88DD /end MEASUREMENT
/begin MEASUREMENT InjVCD_stShOffDCDC "Status der Schutzabschaltung des DC/DC-Wandlers" UBYTE OneToOne 1 100 0.00 255.0 FORMAT "%5.1" ECU_ADDRESS 0x7F88DE /end MEASUREMENT
/begin MEASUREMENT InjVCD_stUBuf "Status der Bufferspannungsmessung" UBYTE OneToOne 1 100 0.00 255.0 FORMAT "%5.1" ECU_ADDRESS 0x7F88DF /end MEASUREMENT
/begin MEASUREMENT InjVCD_stWaitPRailLow_mp "Status Raildruck" UBYTE OneToOne 1 100 0.00 255.0 FORMAT "%5.1" ECU_ADDRESS 0x8FF4D8 /end MEASUREMENT
/begin MEASUREMENT InjVCD_stWValid_mp "Aktuelle Lade- und Entladeenergie ist gültig (aktorspezifisch)" UBYTE OneToOne 1 100 0.00 255.0 FORMAT "%5.1" ARRAY_SIZE 6 ECU_ADDRESS 0x6F80E8 /end MEASUREMENT
/begin MEASUREMENT InjVCD_swtClsActr "Schalter zur Bestimmung der Aktorspannung für Piezoaktor-Klassifizierung" UBYTE Actr_Calc 1 100 0.00 1.00000000000 FORMAT "%13.11" ECU_ADDRESS 0x7F88E0 /end MEASUREMENT
/begin MEASUREMENT InjVCD_swtSelTemp "Message zum Zeigen der aktuellen Schalterstellung" UBYTE Actr_Temp_Sel 1 100 0.00 1.00000000000 FORMAT "%13.11" ECU_ADDRESS 0x7F88E1 /end MEASUREMENT
/begin MEASUREMENT InjVCD_swtWActrNumValLo_mp "Schalter ""Anzahl gültiger Messwerte zu gering für Freigabe der Aktorenergiewerte"" (aktorspezifisch)" UBYTE OneToOne 1 100 0.00 255.0 FORMAT "%5.1" ARRAY_SIZE 6 ECU_ADDRESS 0x6F80EE /end MEASUREMENT
/begin MEASUREMENT InjVCD_tActr "Aktortemperatur" SWORD Temp_Cels 1 100 -50.140 899.860 FORMAT "%8.3" ECU_ADDRESS 0x7F8E98 /end MEASUREMENT
/begin MEASUREMENT InjVCD_tActr_mp "Basistemperatur zur Berechnung der Piezo-Aktortemperatur" SWORD Temp_Cels 1 100 -50.140 899.860 FORMAT "%8.3" ECU_ADDRESS 0x8FF4BA /end MEASUREMENT
/begin MEASUREMENT InjVCD_tiChrgUpActr "Ladezeit vom Bottom zum Up Level" SWORD Time_Busy 1 100 -3276.800 3276.700 FORMAT "%8.3" ARRAY_SIZE 6 ECU_ADDRESS 0x7F92E4 /end MEASUREMENT
/begin MEASUREMENT InjVCD_tiChrgUpActrOld "Vorletzte Aktorladezeit nach Laden von bottom nach up Niveau" SWORD Time_Busy 1 100 -3276.800 3276.700 FORMAT "%8.3" ARRAY_SIZE 6 ECU_ADDRESS 0x7F92F0 /end MEASUREMENT
/begin MEASUREMENT InjVCD_tiCutAll_mp "Verkürzungszeit aller Kollisionen" SLONG InjTime_us 1 100 -2147483648.00 2147483647.00 FORMAT "%13.2" ECU_ADDRESS 0x8FF52C /end MEASUREMENT
/begin MEASUREMENT InjVCD_tiCutPrim_mp "Verkürzungszeit der Primärkollision" SLONG InjTime_us 1 100 -2147483648.00 2147483647.00 FORMAT "%13.2" ECU_ADDRESS 0x8FF530 /end MEASUREMENT
/begin MEASUREMENT InjVCD_tiCutScnd_mp "Verkürzungszeit der Sekundärkollision" SLONG InjTime_us 1 100 -2147483648.00 2147483647.00 FORMAT "%13.2" ECU_ADDRESS 0x8FF534 /end MEASUREMENT
/begin MEASUREMENT InjVCD_tiCY370ChrgRC "RC-Zeitkonstante vom CY370-Integrator für Ladungsberechnung" SWORD Time_Busy 1 100 -3276.800 3276.700 FORMAT "%8.3" ECU_ADDRESS 0x7F8E9A /end MEASUREMENT
/begin MEASUREMENT InjVCD_tiDisChBottActr "Entladezeit vom Up zum Bottom Level" SWORD Time_Busy 1 100 -3276.800 3276.700 FORMAT "%8.3" ARRAY_SIZE 6 ECU_ADDRESS 0x7F92FC /end MEASUREMENT
/begin MEASUREMENT InjVCD_tiInjDurMi_mp "Ansteuerdauer der Haupteinspritzung" SLONG InjTime_us 1 100 -2147483648.00 2147483647.00 FORMAT "%13.2" ECU_ADDRESS 0x6F809C /end MEASUREMENT
/begin MEASUREMENT InjVCD_tiInjDur_mp "Einspritztyp spezifische Ansteuerdauern" SLONG InjTime_us 1 100 -2147483648.00 2147483647.00 FORMAT "%13.2" ARRAY_SIZE 8 ECU_ADDRESS 0x6F80A0 /end MEASUREMENT
/begin MEASUREMENT InjVCD_tiMeasCycl "Abtastzeit der Aktormeßwerte" ULONG TimeDT 1 100 0.00 4294967295.00 FORMAT "%13.2" ECU_ADDRESS 0x7F9174 /end MEASUREMENT
/begin MEASUREMENT InjVCD_tiMeasCyclCyl "Periodendauer der Messung aktorspezifischer Werte" ULONG TimeDT 1 100 0.00 4294967295.00 FORMAT "%13.2" ARRAY_SIZE 6 ECU_ADDRESS 0x7F93F4 /end MEASUREMENT
/begin MEASUREMENT InjVCD_tiMI1ETUnLim_mp "energising time of Main Injection1" SWORD InjTime_us 1 100 -32768.00 32767.00 FORMAT "%8.2" ECU_ADDRESS 0x6F8118 /end MEASUREMENT
/begin MEASUREMENT InjVCD_tiMI1ET_mp "Ansteuerdauer der Haupteinspritzung 1" SWORD InjTime_us 1 100 -32768.00 32767.00 FORMAT "%8.2" ECU_ADDRESS 0x6F811A /end MEASUREMENT
/begin MEASUREMENT InjVCD_tiMonActrThresLo_mp "Zeitdifferenz zwischen Ladevorgang und Meßzeitpunkt" SLONG InjTime_us 1 100 -2147483648.00 2147483647.00 FORMAT "%13.2" ARRAY_SIZE 6 ECU_ADDRESS 0x8FF54C /end MEASUREMENT
/begin MEASUREMENT InjVCD_tiMonChrgUp_mp "Aktorladezeit im Nachlauf für Kurzschlussunterscheidung" SWORD Time_Busy 1 100 -3276.800 3276.700 FORMAT "%8.3" ARRAY_SIZE 6 ECU_ADDRESS 0x8FF57C /end MEASUREMENT
/begin MEASUREMENT InjVCD_tiMonShCirSort_mp "sortierte Aktorladezeiten" SWORD Time_Busy 1 100 -3276.800 3276.700 FORMAT "%8.3" ARRAY_SIZE 6 ECU_ADDRESS 0x8FF588 /end MEASUREMENT
/begin MEASUREMENT InjVCD_tiPiI1ET_mp "Ansteuerdauer der Voreinspritzung 1" SWORD InjTime_us 1 100 -32768.00 32767.00 FORMAT "%8.2" ECU_ADDRESS 0x6F811C /end MEASUREMENT
/begin MEASUREMENT InjVCD_tiPiI1ZFCETCor_mp "Ansteuerdauerkorrektur der ZFC für Voreinspritzung 1 und jeden Zylinder" SWORD InjTime_us 1 100 -32768.00 32767.00 FORMAT "%8.2" ARRAY_SIZE 6 ECU_ADDRESS 0x8FF5EA /end MEASUREMENT
/begin MEASUREMENT InjVCD_tiPiI2ET_mp "Ansteuerdauer der Voreinspritzung 2" SWORD InjTime_us 1 100 -32768.00 32767.00 FORMAT "%8.2" ECU_ADDRESS 0x6F8120 /end MEASUREMENT
/begin MEASUREMENT InjVCD_tiPiI2ZFCETCor_mp "Ansteuerdauerkorrektur der ZFC für Voreinspritzung 2 und jeden Zylinder" SWORD InjTime_us 1 100 -32768.00 32767.00 FORMAT "%8.2" ARRAY_SIZE 6 ECU_ADDRESS 0x8FF5F6 /end MEASUREMENT
/begin MEASUREMENT InjVCD_tiPiI3ZFCETCor_mp "Ansteuerdauerkorrektur der ZFC für Voreinspritzung 3 und jeden Zylinder" SWORD InjTime_us 1 100 -32768.00 32767.00 FORMAT "%8.2" ARRAY_SIZE 6 ECU_ADDRESS 0x8FF602 /end MEASUREMENT
/begin MEASUREMENT InjVCD_tiPoI1ET_mp "Ansteuerdauer Nacheinspritzung 1" SWORD InjTime_us 1 100 -32768.00 32767.00 FORMAT "%8.2" ECU_ADDRESS 0x6F8124 /end MEASUREMENT
/begin MEASUREMENT InjVCD_tiPoI2ET_mp "Ansteuerdauer der Nacheinspritzung 2" SWORD InjTime_us 1 100 -32768.00 32767.00 FORMAT "%8.2" ECU_ADDRESS 0x6F8126 /end MEASUREMENT
/begin MEASUREMENT InjVCD_tiPolarET_mp "Ansteuerdauer der Polarisierung" SWORD InjTime_us 1 100 -32768.00 32767.00 FORMAT "%8.2" ECU_ADDRESS 0x8FF5B6 /end MEASUREMENT
/begin MEASUREMENT InjVCD_tiPolarPse_mp "Maximale Lade- / Entladezeit während der Polarisierung" SWORD InjTime_us 1 100 -32768.00 32767.00 FORMAT "%8.2" ECU_ADDRESS 0x8FF5B8 /end MEASUREMENT
/begin MEASUREMENT InjVCD_tiShiftAll_mp "Verschiebezeit aller Kollisionen" SLONG InjTime_us 1 100 -2147483648.00 2147483647.00 FORMAT "%13.2" ECU_ADDRESS 0x8FF538 /end MEASUREMENT
/begin MEASUREMENT InjVCD_tiShiftPrim_mp "Verschiebezeit der Primärkollision" SLONG InjTime_us 1 100 -2147483648.00 2147483647.00 FORMAT "%13.2" ECU_ADDRESS 0x8FF53C /end MEASUREMENT
/begin MEASUREMENT InjVCD_tiShiftScnd_mp "Verschiebezeit der Sekundärkollision" SLONG InjTime_us 1 100 -2147483648.00 2147483647.00 FORMAT "%13.2" ECU_ADDRESS 0x8FF540 /end MEASUREMENT
/begin MEASUREMENT InjVCD_tiUpOri_mp "Busy-Zeit des CY370 - Einspritzbeginn-Typ  0:VE2, 1:VE1, 2:HE, 3:NE" SWORD Time_Busy 1 100 -3276.800 3276.700 FORMAT "%8.3" ARRAY_SIZE 6 ECU_ADDRESS 0x6F80C0 /end MEASUREMENT
/begin MEASUREMENT InjVCD_tiZFCPiI1ETCor_mp "ZFC Ansteuerdauerkorrektur fuer Voreinspritzung 1" SWORD InjTime_us 1 100 -32768.00 32767.00 FORMAT "%8.2" ECU_ADDRESS 0x6F811E /end MEASUREMENT
/begin MEASUREMENT InjVCD_tiZFCPiI2ETCor_mp "ZFC Ansteuerdauerkorrektur fuer Voreinspritzung 2" SWORD InjTime_us 1 100 -32768.00 32767.00 FORMAT "%8.2" ECU_ADDRESS 0x6F8122 /end MEASUREMENT
/begin MEASUREMENT InjVCD_tPolar_mp "Kühlmitteltemperatur zum Zeitpunkt der Polarisierung" SWORD Temp_Cels 1 100 -50.140 899.860 FORMAT "%8.3" ECU_ADDRESS 0x8FF5BA /end MEASUREMENT
/begin MEASUREMENT InjVCD_uBottActr "Spannung - Bottom Position - Ventil geschlossen" SWORD Volt_PA 1 100 -327.6800 327.6700 FORMAT "%8.4" ARRAY_SIZE 6 ECU_ADDRESS 0x7F9308 /end MEASUREMENT
/begin MEASUREMENT InjVCD_uBuf "Wert der Bufferspannung" SWORD Volt_BUFC 1 100 -327.6800 327.6700 FORMAT "%8.4" ECU_ADDRESS 0x7F8E9C /end MEASUREMENT
/begin MEASUREMENT InjVCD_uBufRaw_mp "Rohwert der Bufferspannung" SWORD Volt 1 100 -160156.4 160151.5 FORMAT "%8.1" ECU_ADDRESS 0x8FF54A /end MEASUREMENT
/begin MEASUREMENT InjVCD_uChgUp_mp "Spannung vom Integrator für die Injektor Ladung zum UP NIveau" SWORD Volt 1 100 -160156.4 160151.5 FORMAT "%8.1" ECU_ADDRESS 0x8FF4A0 /end MEASUREMENT
/begin MEASUREMENT InjVCD_uClsBegin_mp "Aktorspezifisch gemessene Beginnspannung während der Piezoaktor Klassifizierung" SWORD Volt_PA 1 100 -327.6800 327.6700 FORMAT "%8.4" ARRAY_SIZE 6 ECU_ADDRESS 0x8FF4DA /end MEASUREMENT
/begin MEASUREMENT InjVCD_uClsEnd_mp "Aktorspezifisch gemessene Endspannung während der Piezoaktor Klassifizierung" SWORD Volt_PA 1 100 -327.6800 327.6700 FORMAT "%8.4" ARRAY_SIZE 6 ECU_ADDRESS 0x8FF4E6 /end MEASUREMENT
/begin MEASUREMENT InjVCD_uCY370ChrgIntWp "Spannungs-Arbeitspunkt vom CY370-Integrator zur Ladungsberechnung" SWORD Volt 1 100 -160156.4 160151.5 FORMAT "%8.1" ECU_ADDRESS 0x7F8E9E /end MEASUREMENT
/begin MEASUREMENT InjVCD_uCY370ChrgOff "Spannungsoffset vom CY370-Integrator zur Ladungsberechnung" SWORD VoltInt 1 100 -160.1564 160.1515 FORMAT "%8.4" ECU_ADDRESS 0x7F8EA0 /end MEASUREMENT
/begin MEASUREMENT InjVCD_uIntComp_mp "Kompensationsspannung für Abfall der Integrator-Ausgangsspannung" SWORD Volt 1 100 -160156.4 160151.5 FORMAT "%8.1" ECU_ADDRESS 0x8FF4BC /end MEASUREMENT
/begin MEASUREMENT InjVCD_uMonThresHi_mp "Schwelle fuer Spannungsplausibilisierung, Verletzung oben (index : 0=BOTT, 1=UP)" SWORD Volt_PA 1 100 -327.6800 327.6700 FORMAT "%8.4" ARRAY_SIZE 2 ECU_ADDRESS 0x8FF564 /end MEASUREMENT
/begin MEASUREMENT InjVCD_uMonThresLo_mp "Schwelle fuer Spannungsplausibilisierung, Verletzung unten (index : 0=BOTT, 1=UP)" SWORD Volt_PA 1 100 -327.6800 327.6700 FORMAT "%8.4" ARRAY_SIZE 2 ECU_ADDRESS 0x8FF568 /end MEASUREMENT
/begin MEASUREMENT InjVCD_uPolarBott_mp "Bottom-Niveau der Aktorspannung für die Polarisierung" SWORD Volt_PA 1 100 -327.6800 327.6700 FORMAT "%8.4" ECU_ADDRESS 0x8FF5BC /end MEASUREMENT
/begin MEASUREMENT InjVCD_uPolarUp_mp "Bottom-Niveau der Aktorspannung für die Polarisierung" SWORD Volt_PA 1 100 -327.6800 327.6700 FORMAT "%8.4" ECU_ADDRESS 0x8FF5BE /end MEASUREMENT
/begin MEASUREMENT InjVCD_uRawBott_mp "Aktor - Rohspannung (ADC)  - Ansteuerende (Messreihe)" SWORD Volt 1 100 -160156.4 160151.5 FORMAT "%8.1" ECU_ADDRESS 0x8FF4A2 /end MEASUREMENT
/begin MEASUREMENT InjVCD_uRawChgUp_mp "Rohspannung vom Integrator für die Injektorladung zum UP Niveau" SWORD Volt 1 100 -160156.4 160151.5 FORMAT "%8.1" ECU_ADDRESS 0x8FF4A4 /end MEASUREMENT
/begin MEASUREMENT InjVCD_uRawCY370Int0_mp "gemessene Roh-Spannung von Integratorabgleich (für INCA)" SWORD Volt 1 100 -160156.4 160151.5 FORMAT "%8.1" ECU_ADDRESS 0x8FF4F4 /end MEASUREMENT
/begin MEASUREMENT InjVCD_uRawCY370Int_mp "gemessene Roh-Spannungen vom Integratorabgleich" SWORD Volt 1 100 -160156.4 160151.5 FORMAT "%8.1" ARRAY_SIZE 3 ECU_ADDRESS 0x8FF4F6 /end MEASUREMENT
/begin MEASUREMENT InjVCD_uRawUp_mp "Aktor - Rohspannung (ADC)  - Ansteuerbeginn (Messreihe)" SWORD Volt 1 100 -160156.4 160151.5 FORMAT "%8.1" ECU_ADDRESS 0x8FF4A6 /end MEASUREMENT
/begin MEASUREMENT InjVCD_uSetThresActr "verwendete Spannungsschwelle die bei letzter Aktormessung gültig war" SWORD Volt_PA 1 100 -327.6800 327.6700 FORMAT "%8.4" ARRAY_SIZE 6 ECU_ADDRESS 0x7F9314 /end MEASUREMENT
/begin MEASUREMENT InjVCD_uSetThresActr_mp "Eingabewert für InjVCD_wActrNom_CUR" SWORD Volt_PA 1 100 -327.6800 327.6700 FORMAT "%8.4" ECU_ADDRESS 0x8FF4AC /end MEASUREMENT
/begin MEASUREMENT InjVCD_uSetUpActr "Spannungssollwert für Regler" SWORD Volt_PA 1 100 -327.6800 327.6700 FORMAT "%8.4" ARRAY_SIZE 6 ECU_ADDRESS 0x7F9320 /end MEASUREMENT
/begin MEASUREMENT InjVCD_uUpActr "Spannung - Up Position - Ventil geöffnet" SWORD Volt_PA 1 100 -327.6800 327.6700 FORMAT "%8.4" ARRAY_SIZE 6 ECU_ADDRESS 0x7F932C /end MEASUREMENT
/begin MEASUREMENT InjVCD_uValCY370Int_mp "linearisierte Spannungen von Integratorabgleich" SWORD Volt 1 100 -160156.4 160151.5 FORMAT "%8.1" ARRAY_SIZE 3 ECU_ADDRESS 0x8FF4FC /end MEASUREMENT
/begin MEASUREMENT InjVCD_volInET_mp "Y-Eingang des Kennfeldes InjVCD_tiET_MAP auf dem Applikationswerkzeug" SWORD InjQntInj 1 100 -327.6800 327.6700 FORMAT "%8.4" ECU_ADDRESS 0x8FF546 /end MEASUREMENT
/begin MEASUREMENT InjVCD_wActrDiff_mp "Differenz von Lade- und Entladeenergie des Piezo-Aktors (aktorspezifisch)" SWORD W_PA 1 100 -32768.00 32767.00 FORMAT "%8.2" ARRAY_SIZE 6 ECU_ADDRESS 0x6F80F4 /end MEASUREMENT
/begin MEASUREMENT InjVCD_wActrNom_mp "Nominaler, injektorseitiger Energieverbrauch einer Piezo-Aktor-Ansteuerung" SWORD W_PA 1 100 -32768.00 32767.00 FORMAT "%8.2" ARRAY_SIZE 6 ECU_ADDRESS 0x8FF4AE /end MEASUREMENT
/begin MEASUREMENT InjVCD_wChrgActr "Gemittelter Energieverbrauch beim Laden des Aktors (aktorspezifisch)" SWORD W_PA 1 100 -32768.00 32767.00 FORMAT "%8.2" ARRAY_SIZE 6 ECU_ADDRESS 0x7F9338 /end MEASUREMENT
/begin MEASUREMENT InjVCD_wChrgActrRaw_mp "Aktueller Energieverbrauch beim Laden des Aktors (aktorspezifisch)" SWORD W_PA 1 100 -32768.00 32767.00 FORMAT "%8.2" ARRAY_SIZE 6 ECU_ADDRESS 0x6F8100 /end MEASUREMENT
/begin MEASUREMENT InjVCD_wDisChActr "Gemittelte Energierückspeisung beim Entladen des Aktors (aktorspezifisch)" SWORD W_PA 1 100 -32768.00 32767.00 FORMAT "%8.2" ARRAY_SIZE 6 ECU_ADDRESS 0x7F9344 /end MEASUREMENT
/begin MEASUREMENT InjVCD_wDisChActrRaw_mp "Aktuelle Energierückspeisung beim Entladen des Aktors (aktorspezifisch)" SWORD W_PA 1 100 -32768.00 32767.00 FORMAT "%8.2" ARRAY_SIZE 6 ECU_ADDRESS 0x6F810C /end MEASUREMENT
/begin MEASUREMENT InjVlv_ctMonActrMeas "Zaehler für gemessene Aktoren" UBYTE OneToOne 1 100 0.00 255.0 FORMAT "%5.1" ECU_ADDRESS 0x7F88E2 /end MEASUREMENT
/begin MEASUREMENT InjVlv_ctMonQckIDiff_mp "Anzahl der IDiff-Fehler zur Schnell-Erkennung der Kurzschlüsse nach Batterie und Masse" UBYTE OneToOne 1 100 0.00 255.0 FORMAT "%5.1" ECU_ADDRESS 0x8FF65C /end MEASUREMENT
/begin MEASUREMENT InjVlv_ctMonQckISel_mp "Anzahl der ISel-Fehler zur Schnell-Erkennung der Kurzschlüsse nach Batterie und Masse" UBYTE OneToOne 1 100 0.00 255.0 FORMAT "%5.1" ECU_ADDRESS 0x8FF65D /end MEASUREMENT
/begin MEASUREMENT InjVlv_facAddBalRls "Ergebniss aus Freigabekennfeld zur Aufrechnung der Mengenkorrektur als Array (zylinderspezifisch)" SWORD Fact 1 100 -4.000000 3.999878 FORMAT "%8.6" ARRAY_SIZE 6 ECU_ADDRESS 0x7F9350 /end MEASUREMENT
/begin MEASUREMENT InjVlv_facNVCActr "NVC-Faktor" SWORD Fact 1 100 -4.000000 3.999878 FORMAT "%8.6" ARRAY_SIZE 6 ECU_ADDRESS 0x7F935C /end MEASUREMENT
/begin MEASUREMENT InjVlv_facNVCEepWrI_mp "Die I-Anteile der NVC-Regler, die im EEPROM-Spiegel geschrieben werden" SWORD Fact 1 100 -4.000000 3.999878 FORMAT "%8.6" ARRAY_SIZE 6 ECU_ADDRESS 0x8FF684 /end MEASUREMENT
/begin MEASUREMENT InjVlv_facNVCInitI_mp "Initialisierungswerte der I-Anteilen der NVC-Regler" SWORD Fact 1 100 -4.000000 3.999878 FORMAT "%8.6" ARRAY_SIZE 6 ECU_ADDRESS 0x8FF690 /end MEASUREMENT
/begin MEASUREMENT InjVlv_facPCorQ_mp "mengenabhängiger Korrekturfaktor für Druckwellenkorrektur" SWORD Fact 1 100 -4.000000 3.999878 FORMAT "%8.6" ECU_ADDRESS 0x8FF61E /end MEASUREMENT
/begin MEASUREMENT InjVlv_facPCorTi_mp "einspritzabstandsabhängiger Korrekturfaktor für Druckwellenkorrektur" SWORD Fact 1 100 -4.000000 3.999878 FORMAT "%8.6" ECU_ADDRESS 0x8FF620 /end MEASUREMENT
/begin MEASUREMENT InjVlv_facPCor_mp "Korrekturfaktor für Druckwellenkorrektur" SWORD Fact 1 100 -4.000000 3.999878 FORMAT "%8.6" ECU_ADDRESS 0x8FF622 /end MEASUREMENT
/begin MEASUREMENT InjVlv_facVoltCorUp "temperaturabhängiger Korrekturfaktor für Spannungssollwert" SWORD Fact 1 100 -4.000000 3.999878 FORMAT "%8.6" ECU_ADDRESS 0x7F8EA4 /end MEASUREMENT
/begin MEASUREMENT InjVlv_iDCDC_mp "DCDC Strom" SWORD Curr 1 100 -32768.00 32767.00 FORMAT "%8.2" ECU_ADDRESS 0x8FF65A /end MEASUREMENT
/begin MEASUREMENT InjVlv_nCyl "Zylinderspezifische Drehzahl für alle Zylinder" SWORD EngN 1 100 -32768.00 32767.00 FORMAT "%8.2" ARRAY_SIZE 6 ECU_ADDRESS 0x7F9368 /end MEASUREMENT
/begin MEASUREMENT InjVlv_numClsVltgAdjActr "zylinderspezifische ISA-Klasse" SWORD OneToOne 1 100 -32768.00 32767.00 FORMAT "%8.2" ARRAY_SIZE 6 ECU_ADDRESS 0x7F9374 /end MEASUREMENT
/begin MEASUREMENT InjVlv_numCodeVltgAdj_mp "Injektorspannungsabgleich Codes" UBYTE ISA_Code 1 100 0.00 31.0000000000 FORMAT "%13.10" ARRAY_SIZE 6 ECU_ADDRESS 0x8FF6C4 /end MEASUREMENT
/begin MEASUREMENT InjVlv_numIdxErrCyl1_mp "Indizes erkannter Muster für Zylinder 1" ULONG OneToOne 1 100 0.00 4294967295.00 FORMAT "%13.2" ECU_ADDRESS 0x8FF660 /end MEASUREMENT
/begin MEASUREMENT InjVlv_numIdxErrCyl2_mp "Indizes erkannter Muster für Zylinder 2" ULONG OneToOne 1 100 0.00 4294967295.00 FORMAT "%13.2" ECU_ADDRESS 0x8FF664 /end MEASUREMENT
/begin MEASUREMENT InjVlv_numIdxErrCyl3_mp "Indizes erkannter Muster für Zylinder 3" ULONG OneToOne 1 100 0.00 4294967295.00 FORMAT "%13.2" ECU_ADDRESS 0x8FF668 /end MEASUREMENT
/begin MEASUREMENT InjVlv_numIdxErrCyl4_mp "Indizes erkannter Muster für Zylinder 4" ULONG OneToOne 1 100 0.00 4294967295.00 FORMAT "%13.2" ECU_ADDRESS 0x8FF66C /end MEASUREMENT
/begin MEASUREMENT InjVlv_numIdxErrCyl5_mp "Indizes erkannter Muster für Zylinder 5" ULONG OneToOne 1 100 0.00 4294967295.00 FORMAT "%13.2" ECU_ADDRESS 0x8FF670 /end MEASUREMENT
/begin MEASUREMENT InjVlv_numIdxErrCyl6_mp "Indizes erkannter Muster für Zylinder 6" ULONG OneToOne 1 100 0.00 4294967295.00 FORMAT "%13.2" ECU_ADDRESS 0x8FF674 /end MEASUREMENT
/begin MEASUREMENT InjVlv_numIdxErrCyl7_mp "Indizes erkannter Muster für Zylinder 7" ULONG OneToOne 1 100 0.00 4294967295.00 FORMAT "%13.2" ECU_ADDRESS 0x8FF678 /end MEASUREMENT
/begin MEASUREMENT InjVlv_numIdxErrCyl8_mp "Indizes erkannter Muster für Zylinder 8" ULONG OneToOne 1 100 0.00 4294967295.00 FORMAT "%13.2" ECU_ADDRESS 0x8FF67C /end MEASUREMENT
/begin MEASUREMENT InjVlv_numInjChrgBal_mp "Maximale Anzahl an Einspritzungen aufgrund der Ladungsbilanz des Boosterkondensators" UBYTE OneToOne 1 100 0.00 255.0 FORMAT "%5.1" ECU_ADDRESS 0x8FF658 /end MEASUREMENT
/begin MEASUREMENT InjVlv_pActInDiffHyd_mp "Aktueller Raildruck als Eingangswert für das Kennfeld InjVlv_tiDiffHydMAP" SWORD Pres_Rail 1 100 -3276.800 3276.700 FORMAT "%5.3" ECU_ADDRESS 0x8FF6DA /end MEASUREMENT
/begin MEASUREMENT InjVlv_pCalcVolt "für die Aktorspannungsberechnung relevanter Raildruck" SWORD Pres_Rail 1 100 -3276.800 3276.700 FORMAT "%5.3" ECU_ADDRESS 0x7F8EA6 /end MEASUREMENT
/begin MEASUREMENT InjVlv_pCorBase_mp "Raildruck-Korrekturgrundwert für Druckwellenkorrektur" SWORD Pres_Rail 1 100 -3276.800 3276.700 FORMAT "%5.3" ECU_ADDRESS 0x8FF624 /end MEASUREMENT
/begin MEASUREMENT InjVlv_pPoI2WvCorOfsActr_mp "zyl. spezifischer Raildruck-Offset für Druckwellenkorrektur von PoI2" SWORD Pres_Rail 1 100 -3276.800 3276.700 FORMAT "%5.3" ARRAY_SIZE 6 ECU_ADDRESS 0x8FF626 /end MEASUREMENT
/begin MEASUREMENT InjVlv_pRailCorPoI2Actr_mp "zyl. spezifischer druckwellenkorrigierter Raildruck für PoI2" SWORD Pres_Rail 1 100 -3276.800 3276.700 FORMAT "%5.3" ARRAY_SIZE 6 ECU_ADDRESS 0x8FF632 /end MEASUREMENT
/begin MEASUREMENT InjVlv_pwrInjAvrg_mp "durchschnittliche Ansteuer-Verlustleistung bei einer Ansteuerung pro Zylinder und Arbeitshub" SWORD Pwr_PA 1 100 -32768.00 32767.00 FORMAT "%8.2" ECU_ADDRESS 0x8FF650 /end MEASUREMENT
/begin MEASUREMENT InjVlv_qDesInDiffHyd_mp "Gewünschte Einspritzmenge als Eingangswert für das Kennfeld InjVlv_tiDiffHydMAP" SWORD InjMassInj 1 100 -327.6800 327.6700 FORMAT "%8.4" ECU_ADDRESS 0x8FF6DC /end MEASUREMENT
/begin MEASUREMENT InjVlv_qDes_mp "Einspritzmenge für Druckwellenkorrektur" SWORD InjMassInj 1 100 -327.6800 327.6700 FORMAT "%8.4" ECU_ADDRESS 0x8FF63E /end MEASUREMENT
/begin MEASUREMENT InjVlv_qFBCCyl "Zylinderselektive FBC-Mengenkorrektur für alle Zylinder" SWORD InjMass 1 100 -327.6800 327.6700 FORMAT "%8.4" ARRAY_SIZE 6 ECU_ADDRESS 0x7F9380 /end MEASUREMENT
/begin MEASUREMENT InjVlv_qMI1Bal_mp "Korrekturmenge Haupteinspritzung 1" SWORD InjMassInj 1 100 -327.6800 327.6700 FORMAT "%8.4" ECU_ADDRESS 0x8FF610 /end MEASUREMENT
/begin MEASUREMENT InjVlv_qPiI1Bal_mp "Korrekturmenge Voreinspritzung 1" SWORD InjMassInj 1 100 -327.6800 327.6700 FORMAT "%8.4" ECU_ADDRESS 0x8FF612 /end MEASUREMENT
/begin MEASUREMENT InjVlv_qPiI2Bal_mp "Korrekturmenge Voreinspritzung 2" SWORD InjMassInj 1 100 -327.6800 327.6700 FORMAT "%8.4" ECU_ADDRESS 0x8FF614 /end MEASUREMENT
/begin MEASUREMENT InjVlv_qPiI3Bal_mp "Korrekturmenge Voreinspritzung 3" SWORD InjMassInj 1 100 -327.6800 327.6700 FORMAT "%8.4" ECU_ADDRESS 0x8FF616 /end MEASUREMENT
/begin MEASUREMENT InjVlv_qPoI1Bal_mp "Korrekturmenge Nacheinspritzung 1" SWORD InjMassInj 1 100 -327.6800 327.6700 FORMAT "%8.4" ECU_ADDRESS 0x8FF618 /end MEASUREMENT
/begin MEASUREMENT InjVlv_qPoI2BalEff_mp "Korrekturmenge für Nacheinspritzung 2, Moment bildender Teil" SWORD InjMassInj 1 100 -327.6800 327.6700 FORMAT "%8.4" ECU_ADDRESS 0x8FF61A /end MEASUREMENT
/begin MEASUREMENT InjVlv_qPoI2Bal_mp "Korrekturmenge Nacheinspritzung 2" SWORD InjMassInj 1 100 -327.6800 327.6700 FORMAT "%8.4" ECU_ADDRESS 0x8FF61C /end MEASUREMENT
/begin MEASUREMENT InjVlv_stAdj_mp "Zustand der Codes für den Injektorspannungsabgleich" UBYTE VltgAdj 1 100 0.00 8.00000000000 FORMAT "%13.11" ECU_ADDRESS 0x8FF6CA /end MEASUREMENT
/begin MEASUREMENT InjVlv_stCheckSumErrVltgAdj_mp "Ckecksummenfehler der Abgleichwerte" UBYTE OneToOne 1 100 0.00 255.0 FORMAT "%5.1" ECU_ADDRESS 0x8FF6CB /end MEASUREMENT
/begin MEASUREMENT InjVlv_stErrClctCyl1 "gesammelte Fehlermeldungen für Zylinder 1" ULONG OneToOne 1 100 0.00 4294967295.00 FORMAT "%13.2" ECU_ADDRESS 0x7F9178 /end MEASUREMENT
/begin MEASUREMENT InjVlv_stErrClctCyl2 "gesammelte Fehlermeldungen für Zylinder 2" ULONG OneToOne 1 100 0.00 4294967295.00 FORMAT "%13.2" ECU_ADDRESS 0x7F917C /end MEASUREMENT
/begin MEASUREMENT InjVlv_stErrClctCyl3 "gesammelte Fehlermeldungen für Zylinder 3" ULONG OneToOne 1 100 0.00 4294967295.00 FORMAT "%13.2" ECU_ADDRESS 0x7F9180 /end MEASUREMENT
/begin MEASUREMENT InjVlv_stErrClctCyl4 "gesammelte Fehlermeldungen für Zylinder 4" ULONG OneToOne 1 100 0.00 4294967295.00 FORMAT "%13.2" ECU_ADDRESS 0x7F9184 /end MEASUREMENT
/begin MEASUREMENT InjVlv_stErrClctCyl5 "gesammelte Fehlermeldungen für Zylinder 5" ULONG OneToOne 1 100 0.00 4294967295.00 FORMAT "%13.2" ECU_ADDRESS 0x7F9188 /end MEASUREMENT
/begin MEASUREMENT InjVlv_stErrClctCyl6 "gesammelte Fehlermeldungen für Zylinder 6" ULONG OneToOne 1 100 0.00 4294967295.00 FORMAT "%13.2" ECU_ADDRESS 0x7F918C /end MEASUREMENT
/begin MEASUREMENT InjVlv_stErrClctCyl7 "gesammelte Fehlermeldungen für Zylinder 7" ULONG OneToOne 1 100 0.00 4294967295.00 FORMAT "%13.2" ECU_ADDRESS 0x7F9190 /end MEASUREMENT
/begin MEASUREMENT InjVlv_stErrClctCyl8 "gesammelte Fehlermeldungen für Zylinder 8" ULONG OneToOne 1 100 0.00 4294967295.00 FORMAT "%13.2" ECU_ADDRESS 0x7F9194 /end MEASUREMENT
/begin MEASUREMENT InjVlv_stErrUnknown_mp "Fehlermuster des letzten nicht klassifizierbaren Fehlers" ULONG OneToOne 1 100 0.00 4294967295.00 FORMAT "%13.2" ECU_ADDRESS 0x8FF680 /end MEASUREMENT
/begin MEASUREMENT InjVlv_stInjValve "Anfrage an den Abschaltkoordinator bei ""multiple No Load""." UBYTE OneToOne 1 100 0.00 255.0 FORMAT "%5.1" ECU_ADDRESS 0x7F88E3 /end MEASUREMENT
/begin MEASUREMENT InjVlv_stMaxErrVltgAdj_mp "Aktorspezifischer Maximum Fehler im Code für den Injektorspannungsabgleich" UBYTE OneToOne 1 100 0.00 255.0 FORMAT "%5.1" ECU_ADDRESS 0x8FF6CC /end MEASUREMENT
/begin MEASUREMENT InjVlv_stMonDiag "Zustand Diagnose (0 : gesperrt, 1 : freigegeben)" UBYTE OneToOne 1 100 0.00 255.0 FORMAT "%5.1" ECU_ADDRESS 0x7F88E4 /end MEASUREMENT
/begin MEASUREMENT InjVlv_stMonQckErr_mp "Status der Schnell-Erkennung der Kurzschlüsse nach Batterie und Masse" UBYTE OneToOne 1 100 0.00 255.0 FORMAT "%5.1" ECU_ADDRESS 0x8FF65E /end MEASUREMENT
/begin MEASUREMENT InjVlv_stNVCCrit_mp "Statusanzeige der Kriterien für die Freigabe der NVC" UBYTE OneToOne 1 100 0.00 255.0 FORMAT "%5.1" ECU_ADDRESS 0x8FF69C /end MEASUREMENT
/begin MEASUREMENT InjVlv_stNVCEna "zylinderspezifische Anzeige, ob die NVC aktiv ist" UBYTE OneToOne 1 100 0.00 255.0 FORMAT "%5.1" ECU_ADDRESS 0x7F88E5 /end MEASUREMENT
/begin MEASUREMENT InjVlv_stNVCPI "Statusanzeige des NVC-Reglers" UBYTE OneToOne 1 100 0.00 255.0 FORMAT "%5.1" ARRAY_SIZE 6 ECU_ADDRESS 0x7F9218 /end MEASUREMENT
/begin MEASUREMENT InjVlv_tActr_mp "Temperatur des Piezo-Aktors" SWORD Temp_Cels 1 100 -50.140 899.860 FORMAT "%8.3" ECU_ADDRESS 0x8FF640 /end MEASUREMENT
/begin MEASUREMENT InjVlv_tiMI1DiffHydCor_mp "Differenz zwischen hydraulischem Nadelschliessende und elektrischem Ansteuerende des Injektors für die MI1" SWORD InjTime_us 1 100 -32768.00 32767.00 FORMAT "%8.2" ECU_ADDRESS 0x8FF6DE /end MEASUREMENT
/begin MEASUREMENT InjVlv_tiPiI1DiffHydCor_mp "Differenz zwischen hydraulischem Nadelschliessende und elektrischem Ansteuerende des Injektors für die PiI1" SWORD InjTime_us 1 100 -32768.00 32767.00 FORMAT "%8.2" ECU_ADDRESS 0x8FF6E0 /end MEASUREMENT
/begin MEASUREMENT InjVlv_tiPiI2DiffHydCor_mp "Differenz zwischen hydraulischem Nadelschliessende und elektrischem Ansteuerende des Injektors für die PiI2" SWORD InjTime_us 1 100 -32768.00 32767.00 FORMAT "%8.2" ECU_ADDRESS 0x8FF6E2 /end MEASUREMENT
/begin MEASUREMENT InjVlv_uDiffNVCActrInPI_mp "Eingangswert der NVC-Reglers" SWORD Volt_PA 1 100 -327.6800 327.6700 FORMAT "%8.4" ARRAY_SIZE 6 ECU_ADDRESS 0x8FF69E /end MEASUREMENT
/begin MEASUREMENT InjVlv_uDiffNVCActr_mp "aktuelle Spannungsdifferenz" SWORD Volt_PA 1 100 -327.6800 327.6700 FORMAT "%8.4" ARRAY_SIZE 6 ECU_ADDRESS 0x8FF6AA /end MEASUREMENT
/begin MEASUREMENT InjVlv_uDiffNVCSet_mp "Spannungssolldifferenz" SWORD Volt_PA 1 100 -327.6800 327.6700 FORMAT "%8.4" ECU_ADDRESS 0x8FF6B6 /end MEASUREMENT
/begin MEASUREMENT InjVlv_uOfsBand "Band aus Sollspannungswerten" SWORD Volt_PA 1 100 -327.6800 327.6700 FORMAT "%8.4" ARRAY_SIZE 11 ECU_ADDRESS 0x7F93DE /end MEASUREMENT
/begin MEASUREMENT InjVlv_uSetBase_mp "Basiswert zur Ermittlung der Spannungsbänder" SWORD Volt_PA 1 100 -327.6800 327.6700 FORMAT "%8.4" ECU_ADDRESS 0x8FF64E /end MEASUREMENT
/begin MEASUREMENT InjVlv_uSetBott "Minimaler Spannungssollwert für Piezo-Aktor bottom-level" SWORD Volt_PA 1 100 -327.6800 327.6700 FORMAT "%8.4" ECU_ADDRESS 0x7F8EAA /end MEASUREMENT
/begin MEASUREMENT InjVlv_uSetUpActr "Mittlerer zylinderspezifischer Spannungssollwert für Piezo-Aktor (up-level)" SWORD Volt_PA 1 100 -327.6800 327.6700 FORMAT "%8.4" ARRAY_SIZE 6 ECU_ADDRESS 0x7F938C /end MEASUREMENT
/begin MEASUREMENT InjVlv_uSetUpActrPoI2_mp "zyl. spezifischer Piezoaktor-Spannungssollwert für PoI2 (Up-Niveau)" SWORD Volt_PA 1 100 -327.6800 327.6700 FORMAT "%8.4" ARRAY_SIZE 6 ECU_ADDRESS 0x8FF642 /end MEASUREMENT
/begin MEASUREMENT InjVlv_uSetUpAvrg_mp "Gemittelter Spannungssollwert" SWORD Volt_PA 1 100 -327.6800 327.6700 FORMAT "%8.4" ECU_ADDRESS 0x8FF652 /end MEASUREMENT
/begin MEASUREMENT InjVlv_uSetUpNVCActr "Stellspannung nach der NVC" SWORD Volt_PA 1 100 -327.6800 327.6700 FORMAT "%8.4" ARRAY_SIZE 6 ECU_ADDRESS 0x7F9398 /end MEASUREMENT
/begin MEASUREMENT InjVlv_uSetUpNVCActrUnLim_mp "unbegrenzte Stellspannung nach der NVC" SWORD Volt_PA 1 100 -327.6800 327.6700 FORMAT "%8.4" ARRAY_SIZE 6 ECU_ADDRESS 0x8FF6B8 /end MEASUREMENT
/begin MEASUREMENT InjVlv_uSetUpTiChrgActr "Spannungssollwert für Ladezeitberechnung" SWORD Volt_PA 1 100 -327.6800 327.6700 FORMAT "%8.4" ARRAY_SIZE 6 ECU_ADDRESS 0x7F93A4 /end MEASUREMENT
/begin MEASUREMENT InjVlv_volMI1QntAdj_mp "Injektor-Abgleichmenge der Haupteinspritzung 1" SWORD InjQntInj 1 100 -327.6800 327.6700 FORMAT "%8.4" ECU_ADDRESS 0x8FF6CE /end MEASUREMENT
/begin MEASUREMENT InjVlv_volPiI1QntAdj_mp "Injektor-Abgleichmenge der Voreinspritzung 1" SWORD InjQntInj 1 100 -327.6800 327.6700 FORMAT "%8.4" ECU_ADDRESS 0x8FF6D0 /end MEASUREMENT
/begin MEASUREMENT InjVlv_volPiI2QntAdj_mp "Injektor-Abgleichmenge der Voreinspritzung 2" SWORD InjQntInj 1 100 -327.6800 327.6700 FORMAT "%8.4" ECU_ADDRESS 0x8FF6D2 /end MEASUREMENT
/begin MEASUREMENT InjVlv_volPiI3QntAdj_mp "Injektor-Abgleichmenge der Voreinspritzung 3" SWORD InjQntInj 1 100 -327.6800 327.6700 FORMAT "%8.4" ECU_ADDRESS 0x8FF6D4 /end MEASUREMENT
/begin MEASUREMENT InjVlv_volPoI1QntAdj_mp "Injektor-Abgleichmenge der Nacheinspritzung 1" SWORD InjQntInj 1 100 -327.6800 327.6700 FORMAT "%8.4" ECU_ADDRESS 0x8FF6D6 /end MEASUREMENT
/begin MEASUREMENT InjVlv_volPoI2QntAdj_mp "Injektor-Abgleichmenge der Nacheinspritzung 2" SWORD InjQntInj 1 100 -327.6800 327.6700 FORMAT "%8.4" ECU_ADDRESS 0x8FF6D8 /end MEASUREMENT
/begin MEASUREMENT InjVlv_wInjCorr_mp "Korrigierter, bufferseitiger Energieverbrauch einer Piezo-Aktor-Ansteuerung" SWORD W_PA 1 100 -32768.00 32767.00 FORMAT "%8.2" ECU_ADDRESS 0x8FF654 /end MEASUREMENT
/begin MEASUREMENT InjVlv_wInjNom_mp "Nominaler, bufferseitiger Energieverbrauch einer Piezo-Aktor-Ansteuerung" SWORD W_PA 1 100 -32768.00 32767.00 FORMAT "%8.2" ECU_ADDRESS 0x8FF656 /end MEASUREMENT
/begin FUNCTION injcrv_poi2rgn_uic ""
 /begin DEF_CHARACTERISTIC InjCrv_facPoI2EffRgnAdd_Vector InjCrv_facPoI2EffRgnAdd_Channel InjCrv_facPoI2EffRgn_Vector InjCrv_facPoI2EffRgn_Channel InjCrv_phiPoI2RgnAdd_Vector InjCrv_phiPoI2RgnAdd_Channel InjCrv_phiPoI2Rgn_Vector InjCrv_phiPoI2Rgn_Channel InjCrv_qPoI2RgnAdd_Vector InjCrv_qPoI2RgnAdd_Channel InjCrv_qPoI2Rgn_Vector InjCrv_qPoI2Rgn_Channel InjCrv_tiPoI2RgnAdd_Vector InjCrv_tiPoI2RgnAdd_Channel InjCrv_tiPoI2Rgn_Vector InjCrv_tiPoI2Rgn_Channel /end DEF_CHARACTERISTIC
 /begin OUT_MEASUREMENT InjCrv_facPoI2EffRgn1_mp InjCrv_facPoI2EffRgn2_mp InjCrv_facPoI2EffRgnByp_mp InjCrv_phiPoI2Rgn1_mp InjCrv_phiPoI2Rgn2_mp InjCrv_phiPoI2RgnByp_mp InjCrv_qPoI2Rgn1_mp InjCrv_qPoI2Rgn2_mp InjCrv_qPoI2RgnByp_mp InjCrv_tiPoI2Rgn1_mp InjCrv_tiPoI2Rgn2_mp InjCrv_tiPoI2RgnByp_mp /end OUT_MEASUREMENT
/end FUNCTION
/begin FUNCTION injcrv_poi2rls ""
 /begin DEF_CHARACTERISTIC InjCrv_POpPoI2Bas_MAP InjCrv_POpPoI2High_C InjCrv_POpPoI2Low_C /end DEF_CHARACTERISTIC
 /begin IN_MEASUREMENT Eng_nAvrg InjCtl_qSetUnBal /end IN_MEASUREMENT
/end FUNCTION
/begin FUNCTION injcrv_poi2rls_uic "" /begin OUT_MEASUREMENT InjCrv_POpPoI2Bas_mp InjCrv_POpPoI2_mp /end OUT_MEASUREMENT /end FUNCTION
/begin FUNCTION injcrv_poi2soe "Nacheinspritzung 2, Ansteuerdauerberechnung"
 /begin DEF_CHARACTERISTIC InjCrv_phiPoI2Min_C InjCrv_tiPoI2Max_MAP InjCrv_tiPoI2Min_C /end DEF_CHARACTERISTIC
 /begin IN_MEASUREMENT InjCrv_qMI1Des RailCD_pPeak /end IN_MEASUREMENT
/end FUNCTION
/begin FUNCTION injcrv_poi2soephibas "" /begin DEF_CHARACTERISTIC InjCrv_phiPoI2Bas_MAP /end DEF_CHARACTERISTIC /begin IN_MEASUREMENT Eng_nAvrg InjCtl_qSetUnBal /end IN_MEASUREMENT /end FUNCTION
/begin FUNCTION injcrv_poi2soephibas_uic "" /begin OUT_MEASUREMENT InjCrv_phiPoI2Bas_mp /end OUT_MEASUREMENT /end FUNCTION
/begin FUNCTION injcrv_poi2soermtctl_uic "" /end FUNCTION
/begin FUNCTION injcrv_poi2soetibas "" /begin DEF_CHARACTERISTIC InjCrv_tiPoI2Bas_MAP /end DEF_CHARACTERISTIC /begin IN_MEASUREMENT Eng_nAvrg InjCtl_qSetUnBal /end IN_MEASUREMENT /end FUNCTION
/begin FUNCTION injcrv_poi2soetibas_uic "" /begin OUT_MEASUREMENT InjCrv_tiPoI2Bas_mp /end OUT_MEASUREMENT /end FUNCTION
/begin FUNCTION injcrv_poi2soe_msg "" /begin OUT_MEASUREMENT InjCrv_phiPoI2Des InjCrv_tiPoI2Des /end OUT_MEASUREMENT /end FUNCTION
/begin FUNCTION injcrv_poi2soe_uic ""
 /begin DEF_CHARACTERISTIC InjCrv_phiPoI2Add_Vector InjCrv_phiPoI2Add_Channel InjCrv_phiPoI2_Vector InjCrv_phiPoI2_Channel InjCrv_qPoI2DesAdd_Vector InjCrv_qPoI2DesAdd_Channel InjCrv_qPoI2EffAdd_Vector InjCrv_qPoI2EffAdd_Channel InjCrv_qPoI2Eff_Vector InjCrv_qPoI2Eff_Channel InjCrv_qPoI2Des_Vector InjCrv_qPoI2Des_Channel InjCrv_tiPoI2Add_Vector InjCrv_tiPoI2Add_Channel InjCrv_tiPoI2_Vector InjCrv_tiPoI2_Channel /end DEF_CHARACTERISTIC
 /begin OUT_MEASUREMENT InjCrv_phiPoI2AbsTot_mp InjCrv_phiPoI2Abs_mp InjCrv_phiPoI2Byp_mp InjCrv_phiPoI2Cor_mp InjCrv_phiPoI2Rel_mp InjCrv_qPoI2DesByp_mp InjCrv_qPoI2EffByp_mp InjCrv_swtPoI2AgAbsTDC_mp InjCrv_tiPoI2Byp_mp InjCrv_tiPoI2Cor_mp InjCrv_tiPoI2Max_mp InjCrv_tiPoI2RelTot_mp InjCrv_tiPoI2Rel_mp /end OUT_MEASUREMENT
/end FUNCTION
/begin FUNCTION injcrv_qntminlib "Berechnung minimale Einspritzmenge" /begin DEF_CHARACTERISTIC InjCrv_qMin_CUR /end DEF_CHARACTERISTIC /begin IN_MEASUREMENT RailCD_pPeak /end IN_MEASUREMENT /end FUNCTION
/begin FUNCTION injcrv_qntminlib_uic "" /begin OUT_MEASUREMENT InjCrv_qPiI1MinWv_mp /end OUT_MEASUREMENT /end FUNCTION
/begin FUNCTION injcrv_rmtctl_uic "" /end FUNCTION
/begin FUNCTION injcrv_settipse "" /end FUNCTION
/begin FUNCTION injcrv_settipse_msg "" /begin OUT_MEASUREMENT InjCrv_tiPse /end OUT_MEASUREMENT /end FUNCTION
/begin FUNCTION injcrv_settipse_uic "" /end FUNCTION
/begin FUNCTION injctl_msg ""
 /begin OUT_MEASUREMENT InjCtl_dqSetUnBal InjCtl_qCurr InjCtl_qCurrCor InjCtl_qCurrUnCor InjCtl_qDes InjCtl_qDesCor InjCtl_qRaw InjCtl_qRawCor InjCtl_qSet InjCtl_qSetUnBal InjCtl_stNoInj /end OUT_MEASUREMENT
/end FUNCTION
/begin FUNCTION injctl_qco "Mengenkoordination"
 /begin DEF_CHARACTERISTIC InjCtl_facAdjSrvMax_C InjCtl_facAdjSrvMin_C InjCtl_facAdjSrvUnlimDfl_C InjCtl_qAdjQntMax_C InjCtl_qAdjQntMin_C InjCtl_qAdjQnt_MAP InjCtl_t1DT1SetUnBal_C InjCtl_kdDT1SetUnBal_C InjCtl_qDriftComp_MAP InjCtl_qDriftMax2_C InjCtl_qDriftMin2_C InjCtl_swtFMACor_C /end DEF_CHARACTERISTIC
 /begin IN_MEASUREMENT Eng_nAvrg InjCtl_qSetUnBal InjCtl_qSetUnCor_mp InjCtl_tiEngOn_mp /end IN_MEASUREMENT
/end FUNCTION
/begin FUNCTION injctl_qco_msg "" /begin OUT_MEASUREMENT InjCtl_trqInrLim /end OUT_MEASUREMENT /end FUNCTION
/begin FUNCTION injctl_qco_uic ""
 /begin DEF_CHARACTERISTIC InjCtl_qCurr_Vector InjCtl_qCurr_Channel InjCtl_qRaw_Vector InjCtl_qRaw_Channel InjCtl_qSet_Vector InjCtl_qSet_Channel /end DEF_CHARACTERISTIC
 /begin OUT_MEASUREMENT InjCtl_dAdjQntCS_mp InjCtl_dDriftCS_mp InjCtl_facAdjSrvUnlim_mp InjCtl_facAdjSrv_mp InjCtl_qAdjQntUnlim_mp InjCtl_qAdjQnt_mp InjCtl_qDriftComp_mp InjCtl_qDriftLim1_mp InjCtl_qDriftLim2_mp InjCtl_qDriftMax1_mp InjCtl_qDriftMin1_mp InjCtl_qDriftUnlim_mp InjCtl_qSetUnCor_mp InjCtl_stAdjQnt_mp InjCtl_tiEngOn_mp /end OUT_MEASUREMENT
/end FUNCTION
/begin FUNCTION injctl_qlim "Begrenzungsmenge"
 /begin DEF_CHARACTERISTIC InjCtl_dqLimUp_C InjCtl_dqLimDwn_C InjCtl_qLimErr_CUR InjCtl_qLimErr_MAP InjCtl_qLimSoftShOff_CUR /end DEF_CHARACTERISTIC
 /begin IN_MEASUREMENT Eng_nAvrg FTSCD_tFuel /end IN_MEASUREMENT
/end FUNCTION
/begin FUNCTION injctl_qlim_msg "" /begin OUT_MEASUREMENT InjCtl_qLim InjCtl_qLimErr InjCtl_qLimSwt InjCtl_stQLimErr /end OUT_MEASUREMENT /end FUNCTION
/begin FUNCTION injctl_qlim_uic "" /begin OUT_MEASUREMENT InjCtl_qLimSoftShOff_mp InjCtl_qLim_mp /end OUT_MEASUREMENT /end FUNCTION
/begin FUNCTION injctl_uic "" /end FUNCTION
/begin FUNCTION injun "Einspritzsystem" /end FUNCTION
/begin FUNCTION injun_co "Koordinator für das Einspritzsystem" /end FUNCTION
/begin FUNCTION injun_co_msg "" /begin OUT_MEASUREMENT InjUn_stInjValve /end OUT_MEASUREMENT /end FUNCTION
/begin FUNCTION injun_co_uic "" /end FUNCTION
/begin FUNCTION injun_masscnv "Umrechnung von Kraftstoffmenge nach Kraftstoffvolumen" /end FUNCTION
/begin FUNCTION injun_masscnv_uic "" /end FUNCTION
/begin FUNCTION injun_mi1dynqntcor_uic ""
 /begin OUT_MEASUREMENT InjUn_numCylMI1_mp InjUn_qMI1Cor_mp InjUn_volMI1Cor_mp InjUn_volMI1_mp /end OUT_MEASUREMENT
/end FUNCTION
/begin FUNCTION injun_mi2dynqntcor_uic "" /begin OUT_MEASUREMENT InjUn_numCylMI2_mp /end OUT_MEASUREMENT /end FUNCTION
/begin FUNCTION injun_pii1dynqntcor_uic ""
 /begin OUT_MEASUREMENT InjUn_numCylPiI1_mp InjUn_qPiI1Cor_mp InjUn_volPiI1Cor_mp InjUn_volPiI1_mp /end OUT_MEASUREMENT
/end FUNCTION
/begin FUNCTION injun_pii2dynqntcor_uic ""
 /begin OUT_MEASUREMENT InjUn_numCylPiI2_mp InjUn_qPiI2Cor_mp InjUn_volPiI2Cor_mp InjUn_volPiI2_mp /end OUT_MEASUREMENT
/end FUNCTION
/begin FUNCTION injun_pii3dynqntcor_uic "" /end FUNCTION
/begin FUNCTION injun_poi1dynqntcor_uic ""
 /begin OUT_MEASUREMENT InjUn_numCylPoI1_mp InjUn_qPoI1Cor_mp InjUn_volPoI1Cor_mp InjUn_volPoI1_mp /end OUT_MEASUREMENT
/end FUNCTION
/begin FUNCTION injun_poi2dynqntcor_uic ""
 /begin OUT_MEASUREMENT InjUn_numCylPoI2_mp InjUn_qPoI2Cor_mp InjUn_volPoI2Cor_mp InjUn_volPoI2_mp /end OUT_MEASUREMENT
/end FUNCTION
/begin FUNCTION injun_sched "" /begin DEF_CHARACTERISTIC InjUn_nInjLock_C /end DEF_CHARACTERISTIC /end FUNCTION
/begin FUNCTION injun_sched_msg "" /begin OUT_MEASUREMENT InjUn_volMI1CorCyc InjUn_volPiI1CorCyc InjUn_volPiI2CorCyc /end OUT_MEASUREMENT /end FUNCTION
/begin FUNCTION injun_sched_uic "" /end FUNCTION
/begin FUNCTION injun_sched_var ""
 /begin OUT_MEASUREMENT InjUn_pAct_mp InjUn_stMIOffs_mp InjUn_stPiI1Offs_mp InjUn_stPiI2Offs_mp InjUn_stPiI3Offs_mp /end OUT_MEASUREMENT
/end FUNCTION
/begin FUNCTION injun_soptst "" /begin DEF_CHARACTERISTIC InjUn_phiTstShOffPathSet_C InjUn_tiTstShOffPathET_C /end DEF_CHARACTERISTIC /begin OUT_MEASUREMENT InjUn_stSOPTstInjBeg_mp InjUn_stSOPTstInjDur_mp /end OUT_MEASUREMENT /end FUNCTION
/begin FUNCTION injun_soptst_msg "" /begin OUT_MEASUREMENT InjUn_stShutOffReq /end OUT_MEASUREMENT /end FUNCTION
/begin FUNCTION injun_soptst_uic "" /end FUNCTION
/begin FUNCTION injun_tst "" /end FUNCTION
/begin FUNCTION injun_tst_msg "" /begin OUT_MEASUREMENT InjUn_stTst /end OUT_MEASUREMENT /end FUNCTION
/begin FUNCTION injun_tst_uic "" /end FUNCTION
/begin FUNCTION injvcd "injection valve component driver"
 /begin DEF_CHARACTERISTIC InjVCD_stInjMode_C InjVCD_swtEnaAgDiff_C InjVCD_tiETMinHigh_C InjVCD_tiETMinLow_C InjVCD_tiHoldMin_C /end DEF_CHARACTERISTIC
/end FUNCTION
/begin FUNCTION injvcd_actr "Erfassung der Piezo-Aktordaten"
 /begin DEF_CHARACTERISTIC InjVCD_uChrgThrSRCLo_C InjVCD_uChrgThrSRCHi_C InjVCD_uChrgLin_CUR InjVCD_uActrThrSRCLo_C InjVCD_uActrThrSRCHi_C InjVCD_uActrLin_CUR InjVCD_chgMaxPlaus_C InjVCD_chgMinPlaus_C InjVCD_numCylTestBench_C InjVCD_tiIntValid_C /end DEF_CHARACTERISTIC
 /begin OUT_MEASUREMENT InjVCD_facAmp_mp InjVCD_numOfsSelect_mp InjVCD_tiInjDurMi_mp InjVCD_tiInjDur_mp InjVCD_tiUpOri_mp InjVCD_uChgUp_mp InjVCD_uRawBott_mp InjVCD_uRawChgUp_mp InjVCD_uRawUp_mp /end OUT_MEASUREMENT
/end FUNCTION
/begin FUNCTION injvcd_actrenrg "Berechnung des aktorspezifischen Energiebedarfs"
 /begin DEF_CHARACTERISTIC InjVCD_DebActrEnrgDef_C InjVCD_DebActrEnrgOK_C InjVCD_facWActrChrgCorr_C InjVCD_facWActrCorr_C InjVCD_facWActrDisChCorr_C InjVCD_facWActrDvtMax_C InjVCD_facWActrDvtMin_C InjVCD_numFacWValidMin_C InjVCD_numWValidMin_C InjVCD_swtEnaWActrCorr_C InjVCD_wActrChrgDfl_C InjVCD_wActrDiffPlausMax_C InjVCD_wActrDiffPlausMin_C InjVCD_wActrDisChDfl_C InjVCD_wActrNom_CUR InjVCD_wActrPlausMax_C InjVCD_wActrPlausMin_C /end DEF_CHARACTERISTIC
 /begin OUT_MEASUREMENT InjVCD_facWActrDvt_mp InjVCD_facWActrRaw_mp InjVCD_numFacWValid_mp InjVCD_numWValid_mp InjVCD_stWValid_mp InjVCD_swtWActrNumValLo_mp InjVCD_uSetThresActr_mp InjVCD_wActrDiff_mp InjVCD_wActrNom_mp InjVCD_wChrgActrRaw_mp InjVCD_wDisChActrRaw_mp /end OUT_MEASUREMENT
/end FUNCTION
/begin FUNCTION injvcd_actrenrg_msg ""
 /begin OUT_MEASUREMENT InjVCD_facWActrDvt InjVCD_stActrEnrg InjVCD_wChrgActr InjVCD_wDisChActr /end OUT_MEASUREMENT
/end FUNCTION
/begin FUNCTION injvcd_actrtemp "Berechnung der Piezoaktortemperatur"
 /begin DEF_CHARACTERISTIC InjVCD_swtSelTempVal_C InjVCD_swtSelTempType_C InjVCD_tActrDfl_C InjVCD_tActr_CUR /end DEF_CHARACTERISTIC
 /begin OUT_MEASUREMENT InjVCD_tActr_mp /end OUT_MEASUREMENT
/end FUNCTION
/begin FUNCTION injvcd_actrtemp_msg "" /begin OUT_MEASUREMENT InjVCD_swtSelTemp InjVCD_tActr /end OUT_MEASUREMENT /end FUNCTION
/begin FUNCTION injvcd_actr_msg ""
 /begin OUT_MEASUREMENT InjVCD_chgUpActrCurr InjVCD_cUpActrCurr InjVCD_cUpActrOld InjVCD_numHandle InjVCD_numMeas InjVCD_pActInj InjVCD_stAvrgEna InjVCD_stAvrgEnaTiWarn InjVCD_stCalcChrgActr InjVCD_stMeas InjVCD_stMeasLvl InjVCD_stMeasLvlFirst InjVCD_stMonChgActr InjVCD_stMonTiPlaus InjVCD_stMonUBnkPlaus InjVCD_stMonUCylPlaus InjVCD_stShCirSelSwtCab InjVCD_tiChrgUpActr InjVCD_tiChrgUpActrOld InjVCD_tiDisChBottActr InjVCD_tiMeasCycl InjVCD_tiMeasCyclCyl InjVCD_uBottActr InjVCD_uSetThresActr InjVCD_uSetUpActr InjVCD_uUpActr /end OUT_MEASUREMENT
/end FUNCTION
/begin FUNCTION injvcd_calcmi1et "Einspritzsspezifische Berechnung der Injektoransteuerdauer der ersten Haupteinspritzung" /begin DEF_CHARACTERISTIC InjVCD_nETMaxLim_C InjVCD_tiETMax_C /end DEF_CHARACTERISTIC /end FUNCTION
/begin FUNCTION injvcd_calcmi1et_uic "" /begin DEF_CHARACTERISTIC InjVCD_tiMI1ET_Vector InjVCD_tiMI1ET_Channel /end DEF_CHARACTERISTIC /begin OUT_MEASUREMENT InjVCD_tiMI1ETUnLim_mp InjVCD_tiMI1ET_mp /end OUT_MEASUREMENT /end FUNCTION
/begin FUNCTION injvcd_calcpii1et "" /end FUNCTION
/begin FUNCTION injvcd_calcpii1et_uic "" /begin DEF_CHARACTERISTIC InjVCD_tiPiI1ET_Vector InjVCD_tiPiI1ET_Channel /end DEF_CHARACTERISTIC /begin OUT_MEASUREMENT InjVCD_tiPiI1ET_mp InjVCD_tiZFCPiI1ETCor_mp /end OUT_MEASUREMENT /end FUNCTION
/begin FUNCTION injvcd_calcpii2et "" /end FUNCTION
/begin FUNCTION injvcd_calcpii2et_uic "" /begin DEF_CHARACTERISTIC InjVCD_tiPiI2ET_Vector InjVCD_tiPiI2ET_Channel /end DEF_CHARACTERISTIC /begin OUT_MEASUREMENT InjVCD_tiPiI2ET_mp InjVCD_tiZFCPiI2ETCor_mp /end OUT_MEASUREMENT /end FUNCTION
/begin FUNCTION injvcd_calcpii3et "" /end FUNCTION
/begin FUNCTION injvcd_calcpii3et_uic "" /end FUNCTION
/begin FUNCTION injvcd_calcpoi1et "" /end FUNCTION
/begin FUNCTION injvcd_calcpoi1et_uic "" /begin DEF_CHARACTERISTIC InjVCD_tiPoI1ET_Vector InjVCD_tiPoI1ET_Channel /end DEF_CHARACTERISTIC /begin OUT_MEASUREMENT InjVCD_tiPoI1ET_mp /end OUT_MEASUREMENT /end FUNCTION
/begin FUNCTION injvcd_calcpoi2et "" /end FUNCTION
/begin FUNCTION injvcd_calcpoi2et_uic "" /begin DEF_CHARACTERISTIC InjVCD_tiPoI2ET_Vector InjVCD_tiPoI2ET_Channel /end DEF_CHARACTERISTIC /begin OUT_MEASUREMENT InjVCD_tiPoI2ET_mp /end OUT_MEASUREMENT /end FUNCTION
/begin FUNCTION injvcd_chrg "Berechnung der Aktor-Ladung" /begin DEF_CHARACTERISTIC InjVCD_duInt_C InjVCD_resCalcChrgShunt_C /end DEF_CHARACTERISTIC /begin OUT_MEASUREMENT InjVCD_uIntComp_mp /end OUT_MEASUREMENT /end FUNCTION
/begin FUNCTION injvcd_cls "Klassifizierung des Piezoaktuators"
 /begin DEF_CHARACTERISTIC InjVCD_nClsEng_C InjVCD_pClsRailMax_C InjVCD_rClsVoltMin_C InjVCD_tiClsLead_C InjVCD_tiClsMeasBeg_C InjVCD_tiClsMeasEnd_C InjVCD_tiClsMeasure_C /end DEF_CHARACTERISTIC
 /begin OUT_MEASUREMENT InjVCD_rClsVolt_mp InjVCD_stWaitPRailLow_mp InjVCD_uClsBegin_mp InjVCD_uClsEnd_mp /end OUT_MEASUREMENT
/end FUNCTION
/begin FUNCTION injvcd_cls_msg "" /begin OUT_MEASUREMENT InjVCD_stClsActr InjVCD_swtClsActr /end OUT_MEASUREMENT /end FUNCTION
/begin FUNCTION injvcd_cls_uic "" /end FUNCTION
/begin FUNCTION injvcd_cy370 "spezielle Funktionen fuer CY370"
 /begin DEF_CHARACTERISTIC InjVCD_uCY370ThrSRCLo_C InjVCD_uCY370ThrSRCHi_C InjVCD_uCY370Lin_CUR InjVCD_stCY370RcyTst_C /end DEF_CHARACTERISTIC
 /begin OUT_MEASUREMENT InjVCD_regCY370ID_mp InjVCD_stCY370Event_mp InjVCD_uRawCY370Int0_mp InjVCD_uRawCY370Int_mp InjVCD_uValCY370Int_mp /end OUT_MEASUREMENT
/end FUNCTION
/begin FUNCTION injvcd_cy370_msg ""
 /begin OUT_MEASUREMENT InjVCD_PZOSWType InjVCD_regCY370Bank InjVCD_regCY370CylISel InjVCD_regCY370Global InjVCD_regCY370Status InjVCD_stCY370Buf InjVCD_tiCY370ChrgRC InjVCD_uCY370ChrgIntWp InjVCD_uCY370ChrgOff /end OUT_MEASUREMENT
/end FUNCTION
/begin FUNCTION injvcd_cy370_uic "" /end FUNCTION
/begin FUNCTION injvcd_dcdc "Komponententreiber für DCDC-Wandler"
 /begin DEF_CHARACTERISTIC InjVCD_DebDCDCLowDef_C InjVCD_DebDCDCStartDef_C InjVCD_uBufCLoLim_C /end DEF_CHARACTERISTIC
/end FUNCTION
/begin FUNCTION injvcd_dcdc_msg "" /begin OUT_MEASUREMENT InjVCD_stBufC /end OUT_MEASUREMENT /end FUNCTION
/begin FUNCTION injvcd_dcdc_uic "" /end FUNCTION
/begin FUNCTION injvcd_estet "" /end FUNCTION
/begin FUNCTION injvcd_estet_uic "" /end FUNCTION
/begin FUNCTION injvcd_evmgmt ""
 /begin DEF_CHARACTERISTIC InjVCD_numCollTyp_C InjVCD_swtEvMgmt_C InjVCD_tiLeadJit_C InjVCD_tiLeadPost1_C InjVCD_tiLeadPost2_C InjVCD_tiLeadPost3_C InjVCD_tiLeadPost4_C InjVCD_tiLeadPre1_C InjVCD_tiLeadPre2_C InjVCD_tiLeadPre3_C InjVCD_tiLeadPre4_C /end DEF_CHARACTERISTIC
 /begin OUT_MEASUREMENT InjVCD_numCollPrim_mp InjVCD_numCollScnd_mp InjVCD_numCollThrd_mp InjVCD_numEvMgmtStat_mp InjVCD_numReacPrim_mp InjVCD_numReacScnd_mp InjVCD_tiCutAll_mp InjVCD_tiCutPrim_mp InjVCD_tiCutScnd_mp InjVCD_tiShiftAll_mp InjVCD_tiShiftPrim_mp InjVCD_tiShiftScnd_mp /end OUT_MEASUREMENT
/end FUNCTION
/begin FUNCTION injvcd_getet "Ansteuerdauerberechnung" /begin DEF_CHARACTERISTIC InjVCD_swtInputETMAP_C InjVCD_tiET_MAP /end DEF_CHARACTERISTIC /begin IN_MEASUREMENT InjVCD_pInET_mp InjVCD_volInET_mp /end IN_MEASUREMENT /end FUNCTION
/begin FUNCTION injvcd_getet_uic "" /begin OUT_MEASUREMENT InjVCD_pInET_mp InjVCD_volInET_mp /end OUT_MEASUREMENT /end FUNCTION
/begin FUNCTION injvcd_measubuf "Messung der Bufferspannung"
 /begin DEF_CHARACTERISTIC InjVCD_DebUBufSRCHighDef_C InjVCD_DebUBufSRCHighOk_C InjVCD_DebUBufSRCLowDef_C InjVCD_DebUBufSRCLowOk_C InjVCD_uBufSRCMin_C InjVCD_uBufSRCMax_C InjVCD_uBufLin_CUR /end DEF_CHARACTERISTIC
 /begin OUT_MEASUREMENT InjVCD_ctUBufTrig_mp InjVCD_uBufRaw_mp /end OUT_MEASUREMENT
/end FUNCTION
/begin FUNCTION injvcd_measubuf_msg "" /begin OUT_MEASUREMENT InjVCD_stUBuf InjVCD_uBuf /end OUT_MEASUREMENT /end FUNCTION
/begin FUNCTION injvcd_measubuf_uic "" /end FUNCTION
/begin FUNCTION injvcd_mirmtctl_uic "" /end FUNCTION
/begin FUNCTION injvcd_mon "Überwachung des Einspritzventils im Komponententreibers"
 /begin DEF_CHARACTERISTIC InjVCD_facMonUThresHiPl_CA InjVCD_facMonUThresLoPl_CA InjVCD_rCapUpTolc_C InjVCD_rTiChrgUpTolc_C InjVCD_tiMi1ThresLo_C InjVCD_tiMonThresHiPlaus_C InjVCD_tiMonThresLoPlaus_C /end DEF_CHARACTERISTIC
 /begin OUT_MEASUREMENT InjVCD_tiMonActrThresLo_mp InjVCD_uMonThresHi_mp InjVCD_uMonThresLo_mp /end OUT_MEASUREMENT
/end FUNCTION
/begin FUNCTION injvcd_monshcir "Kurzschlussunterscheidung"
 /begin DEF_CHARACTERISTIC InjVCD_nEngMonShCir_C InjVCD_pRailMonShCirMax_C InjVCD_rMonShCirTiChrgUpTolc_C InjVCD_tiMonET_C InjVCD_tiMonLead_C /end DEF_CHARACTERISTIC
 /begin OUT_MEASUREMENT InjVCD_tiMonChrgUp_mp InjVCD_tiMonShCirSort_mp /end OUT_MEASUREMENT
/end FUNCTION
/begin FUNCTION injvcd_monshcir_msg "" /begin OUT_MEASUREMENT InjVCD_stMonShCir /end OUT_MEASUREMENT /end FUNCTION
/begin FUNCTION injvcd_monshcir_uic "" /end FUNCTION
/begin FUNCTION injvcd_mon_uic ""
 /begin OUT_MEASUREMENT InjVCD_rCapThresHigh_mp InjVCD_rCapThresLow_mp InjVCD_rCapUpCurrToKx_mp InjVCD_rCapUpKxToCurr_mp InjVCD_rTiChrgUpCurrToKx_mp InjVCD_rTiChrgUpKxToCurr_mp InjVCD_rTiChrgUpThresHigh_mp InjVCD_rTiChrgUpThresLow_mp /end OUT_MEASUREMENT
/end FUNCTION
/begin FUNCTION injvcd_pii1rmtctl_uic "" /end FUNCTION
/begin FUNCTION injvcd_pii2rmtctl_uic "" /end FUNCTION
/begin FUNCTION injvcd_pii3rmtctl_uic "" /end FUNCTION
/begin FUNCTION injvcd_poi1rmtctl_uic "" /end FUNCTION
/begin FUNCTION injvcd_poi2rmtctl_uic "" /end FUNCTION
/begin FUNCTION injvcd_polar "Polarisation des Piezo-Aktors während des Systemhochlaufs"
 /begin DEF_CHARACTERISTIC InjVCD_ctThres_C InjVCD_iPolarUp_CUR InjVCD_nPolar_C InjVCD_numPolar_C InjVCD_pPolarMax_C InjVCD_swtPolarOvrlap_C InjVCD_tiPolarET_CUR InjVCD_tiPolarLead_C InjVCD_tiPolarOvrlap_C InjVCD_tiPolarPse_C InjVCD_tiPolarPse_CUR InjVCD_tPolarMax_C InjVCD_uPolarUp_CUR /end DEF_CHARACTERISTIC
 /begin OUT_MEASUREMENT InjVCD_ctPolarOvrRun_mp InjVCD_iPolarChrg_mp InjVCD_iPolarDisCh_mp InjVCD_pPolar_mp InjVCD_stPolarOvrlap_mp InjVCD_stPolarPreCond_mp InjVCD_tiPolarET_mp InjVCD_tiPolarPse_mp InjVCD_tPolar_mp InjVCD_uPolarBott_mp InjVCD_uPolarUp_mp /end OUT_MEASUREMENT
/end FUNCTION
/begin FUNCTION injvcd_polar_msg "" /begin OUT_MEASUREMENT InjVCD_stPolar /end OUT_MEASUREMENT /end FUNCTION
/begin FUNCTION injvcd_polar_uic "" /end FUNCTION
/begin FUNCTION injvcd_progetlib "" /end FUNCTION
/begin FUNCTION injvcd_progetlib_uic ""
 /begin OUT_MEASUREMENT InjVCD_stInjMI1_mp InjVCD_stInjMI2_mp InjVCD_stInjPiI1_mp InjVCD_stInjPiI2_mp InjVCD_stInjPiI3_mp InjVCD_stInjPoI1_mp InjVCD_stInjPoI2_mp /end OUT_MEASUREMENT
/end FUNCTION
/begin FUNCTION injvcd_progetzfc "" /end FUNCTION
/begin FUNCTION injvcd_progetzfc_uic "" /begin OUT_MEASUREMENT InjVCD_stInjZFC_mp /end OUT_MEASUREMENT /end FUNCTION
/begin FUNCTION injvcd_progmi "Programmierung der MI1, Initialisierung von Schnelllöschung und Haltestrom" /begin OUT_MEASUREMENT InjVCD_stInjBegMI1_mp /end OUT_MEASUREMENT /end FUNCTION
/begin FUNCTION injvcd_progmi_uic "" /begin OUT_MEASUREMENT InjVCD_ctMI1AgDiff_mp InjVCD_phiMI1Diff_mp /end OUT_MEASUREMENT /end FUNCTION
/begin FUNCTION injvcd_progpii "Programmierung der Voreinspritzung"
 /begin OUT_MEASUREMENT InjVCD_stInjTPUCM_mp InjVCD_stInjTPUErr_mp InjVCD_stInjTPUShortDur_mp /end OUT_MEASUREMENT
/end FUNCTION
/begin FUNCTION injvcd_progpii1 "" /begin OUT_MEASUREMENT InjVCD_stInjBegPiI1_mp /end OUT_MEASUREMENT /end FUNCTION
/begin FUNCTION injvcd_progpii1_uic "" /begin OUT_MEASUREMENT InjVCD_ctPiI1AgDiff_mp InjVCD_phiPiI1Diff_mp /end OUT_MEASUREMENT /end FUNCTION
/begin FUNCTION injvcd_progpii2 "" /begin OUT_MEASUREMENT InjVCD_stInjBegPiI2_mp /end OUT_MEASUREMENT /end FUNCTION
/begin FUNCTION injvcd_progpii2_uic "" /begin OUT_MEASUREMENT InjVCD_ctPiI2AgDiff_mp InjVCD_phiPiI2Diff_mp /end OUT_MEASUREMENT /end FUNCTION
/begin FUNCTION injvcd_progpii3 "" /begin OUT_MEASUREMENT InjVCD_stInjBegPiI3_mp /end OUT_MEASUREMENT /end FUNCTION
/begin FUNCTION injvcd_progpii3_uic "" /end FUNCTION
/begin FUNCTION injvcd_progpii_uic "" /end FUNCTION
/begin FUNCTION injvcd_progpoi1 "" /begin OUT_MEASUREMENT InjVCD_stInjBegPoI1_mp /end OUT_MEASUREMENT /end FUNCTION
/begin FUNCTION injvcd_progpoi1_uic "" /end FUNCTION
/begin FUNCTION injvcd_progpoi2 "" /begin OUT_MEASUREMENT InjVCD_stInjBegPoI2_mp /end OUT_MEASUREMENT /end FUNCTION
/begin FUNCTION injvcd_progpoi2_uic "" /end FUNCTION
/begin FUNCTION injvcd_progzfc "" /end FUNCTION
/begin FUNCTION injvcd_progzfc_uic "" /end FUNCTION
/begin FUNCTION injvcd_selcrnt "" /begin OUT_MEASUREMENT InjVCD_numCrntLvl_mp /end OUT_MEASUREMENT /end FUNCTION
/begin FUNCTION injvcd_selvoltoffs "" /end FUNCTION
/begin FUNCTION injvcd_selvoltoffs_msg "" /begin OUT_MEASUREMENT InjVCD_numOfsSelect /end OUT_MEASUREMENT /end FUNCTION
/begin FUNCTION injvcd_shoffdcdc "Schutzabschaltung DC/DC-Wandler bei festgestelltem Ladeschalterkurzschluss"
 /begin DEF_CHARACTERISTIC InjVCD_ctThresShOffDCDCEv_C InjVCD_swtShOffDCDCTst_C InjVCD_uShOffBufThres_C /end DEF_CHARACTERISTIC
/end FUNCTION
/begin FUNCTION injvcd_shoffdcdc_msg "" /begin OUT_MEASUREMENT InjVCD_stMon InjVCD_stShOffDCDC /end OUT_MEASUREMENT /end FUNCTION
/begin FUNCTION injvcd_shoffdcdc_uic "" /end FUNCTION
/begin FUNCTION injvcd_zfcetcor "Ansteuerdauerkorrektur durch Nullmengenkalibrierung"
 /begin DEF_CHARACTERISTIC InjVCD_pRailZFCETCor_AXIS InjVCD_qZFCETCor_AXIS InjVCD_rZFCETDif0_GMAP InjVCD_rZFCETDif1_GMAP InjVCD_rZFCETDif2_GMAP InjVCD_rZFCETMsk_GMAP InjVCD_stInputZFCETGMap_C InjVCD_stZFCETCorActv_C InjVCD_tiZFCETCorMax_C InjVCD_tiZFCETCorMin_C /end DEF_CHARACTERISTIC
 /begin IN_MEASUREMENT InjVCD_qInZFCETGMap_mp RailCD_pAct_mp /end IN_MEASUREMENT
 /begin OUT_MEASUREMENT InjVCD_rZFCETCoeffDif_mp InjVCD_rZFCETCoeffMsk_mp InjVCD_tiPiI1ZFCETCor_mp InjVCD_tiPiI2ZFCETCor_mp InjVCD_tiPiI3ZFCETCor_mp /end OUT_MEASUREMENT
/end FUNCTION
/begin FUNCTION injvcd_zfcetcor_uic "" /begin OUT_MEASUREMENT InjVCD_qInZFCETGMap_mp /end OUT_MEASUREMENT /end FUNCTION
/begin FUNCTION injvlv_addbal "Korrektur Einspritzmenge aus Laufruheregler" /begin DEF_CHARACTERISTIC InjVlv_facAddBalRls_MAP /end DEF_CHARACTERISTIC /begin IN_MEASUREMENT InjCtl_qSetUnBal RailCD_pPeak /end IN_MEASUREMENT /end FUNCTION
/begin FUNCTION injvlv_addballib "" /begin DEF_CHARACTERISTIC InjVlv_stInputAddBalMap_C /end DEF_CHARACTERISTIC /end FUNCTION
/begin FUNCTION injvlv_addballib_uic ""
 /begin OUT_MEASUREMENT InjVlv_qMI1Bal_mp InjVlv_qPiI1Bal_mp InjVlv_qPiI2Bal_mp InjVlv_qPiI3Bal_mp InjVlv_qPoI1Bal_mp InjVlv_qPoI2BalEff_mp InjVlv_qPoI2Bal_mp /end OUT_MEASUREMENT
/end FUNCTION
/begin FUNCTION injvlv_addbalzfc "" /end FUNCTION
/begin FUNCTION injvlv_addbalzfc_uic "" /end FUNCTION
/begin FUNCTION injvlv_addbal_msg "" /begin OUT_MEASUREMENT InjVlv_facAddBalRls /end OUT_MEASUREMENT /end FUNCTION
/begin FUNCTION injvlv_addbal_uic "" /end FUNCTION
/begin FUNCTION injvlv_calcvolt "Spannungsberechnung für Piezo-Aktuator"
 /begin DEF_CHARACTERISTIC InjVlv_facPCorQ_CUR InjVlv_facPCorTi_CUR InjVlv_facVoltCorUp_MAP InjVlv_pCorBase_CUR InjVlv_pRailDfl_C InjVlv_stPWvCorMsk_C InjVlv_tActrDfl_C InjVlv_uSetBott_C InjVlv_uSetUpPress0_CUR InjVlv_uSetUpPress10_CUR InjVlv_uSetUpPress11_CUR InjVlv_uSetUpPress12_CUR InjVlv_uSetUpPress13_CUR InjVlv_uSetUpPress14_CUR InjVlv_uSetUpPress15_CUR InjVlv_uSetUpPress1_CUR InjVlv_uSetUpPress2_CUR InjVlv_uSetUpPress3_CUR InjVlv_uSetUpPress4_CUR InjVlv_uSetUpPress5_CUR InjVlv_uSetUpPress6_CUR InjVlv_uSetUpPress7_CUR InjVlv_uSetUpPress8_CUR InjVlv_uSetUpPress9_CUR /end DEF_CHARACTERISTIC
 /begin IN_MEASUREMENT InjVlv_pAct_mp InjVlv_pCalcVolt InjVlv_tiMI1PoI2Cor_mp /end IN_MEASUREMENT
 /begin OUT_MEASUREMENT InjVlv_facPCorQ_mp InjVlv_facPCorTi_mp InjVlv_facPCor_mp InjVlv_pCorBase_mp InjVlv_pPoI2WvCorOfsActr_mp InjVlv_pRailCorPoI2Actr_mp InjVlv_qDes_mp InjVlv_tActr_mp InjVlv_uSetUpActrPoI2_mp /end OUT_MEASUREMENT
/end FUNCTION
/begin FUNCTION injvlv_calcvoltoffs "Berechnung des Spannungsoffsets" /begin DEF_CHARACTERISTIC InjVlv_uOfs_C /end DEF_CHARACTERISTIC /begin OUT_MEASUREMENT InjVlv_uSetBase_mp /end OUT_MEASUREMENT /end FUNCTION
/begin FUNCTION injvlv_calcvoltoffs_msg "" /begin OUT_MEASUREMENT InjVlv_uOfsBand /end OUT_MEASUREMENT /end FUNCTION
/begin FUNCTION injvlv_calcvolt_msg ""
 /begin OUT_MEASUREMENT InjVlv_facVoltCorUp InjVlv_numClsVltgAdjActr InjVlv_pCalcVolt InjVlv_uSetBott InjVlv_uSetUpActr /end OUT_MEASUREMENT
/end FUNCTION
/begin FUNCTION injvlv_calcvolt_uic "" /end FUNCTION
/begin FUNCTION injvlv_chrgbalinjlim "maximale Anzahl an Einspritzungen aufgrund der Ladungsbilanz des Boosterkondensators"
 /begin DEF_CHARACTERISTIC InjVlv_numInjChrgBal_MAP InjVlv_rChrgBalPwrHys_C InjVlv_rChrgBalVltgHys_C InjVlv_uBufCInjLimXLow_C InjVlv_uBufCInjLimXHigh_C InjVlv_stBufCInjLimYLow_C InjVlv_stBufCInjLimYHigh_C InjVlv_wInj_CUR /end DEF_CHARACTERISTIC
 /begin IN_MEASUREMENT BattCD_u /end IN_MEASUREMENT
 /begin OUT_MEASUREMENT InjVlv_pwrInjAvrg_mp InjVlv_uSetUpAvrg_mp InjVlv_wInjCorr_mp InjVlv_wInjNom_mp /end OUT_MEASUREMENT
/end FUNCTION
/begin FUNCTION injvlv_chrgbalinjlim_uic "" /begin OUT_MEASUREMENT InjVlv_numInjChrgBal_mp /end OUT_MEASUREMENT /end FUNCTION
/begin FUNCTION injvlv_currdcdc "Berechnung des aktuellen DCDC-Werts" /begin DEF_CHARACTERISTIC InjVlv_iDCDC_CUR /end DEF_CHARACTERISTIC /begin IN_MEASUREMENT BattCD_u /end IN_MEASUREMENT /begin OUT_MEASUREMENT InjVlv_iDCDC_mp /end OUT_MEASUREMENT /end FUNCTION
/begin FUNCTION injvlv_currdcdc_uic "" /end FUNCTION
/begin FUNCTION injvlv_errdet "Injektorfehlererkennung" /begin DEF_CHARACTERISTIC InjVlv_numSegOfs1_C InjVlv_numSegOfs2_C InjVlv_stErrDet_C /end DEF_CHARACTERISTIC /end FUNCTION
/begin FUNCTION injvlv_errdet_msg "" /begin OUT_MEASUREMENT InjVlv_nCyl InjVlv_qFBCCyl /end OUT_MEASUREMENT /end FUNCTION
/begin FUNCTION injvlv_errdet_uic "" /end FUNCTION
/begin FUNCTION injvlv_mon "Injektordiagnose"
 /begin DEF_CHARACTERISTIC InjVlv_ctMonQckThresLo_C InjVlv_ctMonQckThres_C InjVlv_DebBnkA0Def_C InjVlv_DebBnkA0Ok_C InjVlv_DebBnkA1Def_C InjVlv_DebBnkA1Ok_C InjVlv_DebBnkA2Def_C InjVlv_DebBnkA2Ok_C InjVlv_DebBnkA3Def_C InjVlv_DebBnkA3Ok_C InjVlv_DebBnkB0Def_C InjVlv_DebBnkB0Ok_C InjVlv_DebBnkB1Def_C InjVlv_DebBnkB1Ok_C InjVlv_DebBnkB2Def_C InjVlv_DebBnkB2Ok_C InjVlv_DebBnkB3Def_C InjVlv_DebBnkB3Ok_C InjVlv_DebChipA0Def_C InjVlv_DebChipA0Ok_C InjVlv_DebChipA1Def_C InjVlv_DebChipA1Ok_C InjVlv_DebChipA2Def_C InjVlv_DebChipA2Ok_C InjVlv_DebChipA3Def_C InjVlv_DebChipA3Ok_C InjVlv_DebChipB0Def_C InjVlv_DebChipB0Ok_C InjVlv_DebChipB1Def_C InjVlv_DebChipB1Ok_C InjVlv_DebChipB2Def_C InjVlv_DebChipB2Ok_C InjVlv_DebChipB3Def_C InjVlv_DebChipB3Ok_C InjVlv_DebCylA0Def_C InjVlv_DebCylA0Ok_C InjVlv_DebCylA1Def_C InjVlv_DebCylA1Ok_C InjVlv_DebCylA2Def_C InjVlv_DebCylA2Ok_C InjVlv_DebCylA3Def_C InjVlv_DebCylA3Ok_C InjVlv_DebCylB0Def_C InjVlv_DebCylB0Ok_C InjVlv_DebCylB1Def_C InjVlv_DebCylB1Ok_C InjVlv_DebCylB2Def_C InjVlv_DebCylB2Ok_C InjVlv_DebCylB3Def_C InjVlv_DebCylB3Ok_C InjVlv_DebCylC0Def_C InjVlv_DebCylC0Ok_C InjVlv_DebCylC1Def_C InjVlv_DebCylC1Ok_C InjVlv_DebCylC2Def_C InjVlv_DebCylC2Ok_C InjVlv_DebCylC3Def_C InjVlv_DebCylC3Ok_C InjVlv_iMonDisChDwn_C InjVlv_nMonQckThresLo_C InjVlv_numNoLoadCylMax_C InjVlv_stErrMskPattern_C InjVlv_stErrMskSelect_C InjVlv_stMonQckEna_C InjVlv_uMonBattThres_C /end DEF_CHARACTERISTIC
 /begin OUT_MEASUREMENT InjVlv_ctMonQckIDiff_mp InjVlv_ctMonQckISel_mp InjVlv_stMonQckErr_mp /end OUT_MEASUREMENT
/end FUNCTION
/begin FUNCTION injvlv_mon_msg ""
 /begin OUT_MEASUREMENT InjVlv_ctMonActrMeas InjVlv_stErrClctCyl1 InjVlv_stErrClctCyl2 InjVlv_stErrClctCyl3 InjVlv_stErrClctCyl4 InjVlv_stErrClctCyl5 InjVlv_stErrClctCyl6 InjVlv_stErrClctCyl7 InjVlv_stErrClctCyl8 InjVlv_stInjValve InjVlv_stMonDiag /end OUT_MEASUREMENT
/end FUNCTION
/begin FUNCTION injvlv_mon_uic ""
 /begin OUT_MEASUREMENT InjVlv_numIdxErrCyl1_mp InjVlv_numIdxErrCyl2_mp InjVlv_numIdxErrCyl3_mp InjVlv_numIdxErrCyl4_mp InjVlv_numIdxErrCyl5_mp InjVlv_numIdxErrCyl6_mp InjVlv_numIdxErrCyl7_mp InjVlv_numIdxErrCyl8_mp InjVlv_stErrUnknown_mp /end OUT_MEASUREMENT
/end FUNCTION
/begin FUNCTION injvlv_nvc "Nominal Voltage Calibration (Spannungsadaption)"
 /begin DEF_CHARACTERISTIC InjVlv_DebNVCDef_C InjVlv_DebNVCOK_C InjVlv_facNVCDflI_C InjVlv_facNVCDfpMax_C InjVlv_facNVCDfpMin_C InjVlv_facNVCInPI_C InjVlv_facNVCMax_C InjVlv_facNVCMin_C InjVlv_NVCIKi_C InjVlv_NVCIKiPos_C InjVlv_NVCIKiNeg_C InjVlv_uNVCIWinPos_C InjVlv_uNVCIWinNeg_C InjVlv_pNVCMax_C InjVlv_pNVCMin_C InjVlv_NVCPKp_C InjVlv_NVCPKpPos_C InjVlv_NVCPKpNeg_C InjVlv_uNVCPWinPos_C InjVlv_uNVCPWinNeg_C InjVlv_swtAvrgEnaTiNVC_C InjVlv_swtNVCStInjChar_C InjVlv_swtNVCWrDflVal_C InjVlv_tiNVCDwnThres_C InjVlv_tiNVCUpThres_C InjVlv_tNVCEngMax_C InjVlv_tNVCEngMin_C InjVlv_uDiffNVCSet_CUR InjVlv_uNVCThres_C InjVlv_uSetUpNVCActrMax_C InjVlv_uSetUpNVCActrMin_C /end DEF_CHARACTERISTIC
 /begin IN_MEASUREMENT InjVCD_pActInj /end IN_MEASUREMENT
 /begin OUT_MEASUREMENT InjVlv_facNVCEepWrI_mp InjVlv_facNVCInitI_mp InjVlv_stNVCCrit_mp InjVlv_uDiffNVCActrInPI_mp InjVlv_uDiffNVCActr_mp InjVlv_uDiffNVCSet_mp InjVlv_uSetUpNVCActrUnLim_mp /end OUT_MEASUREMENT
/end FUNCTION
/begin FUNCTION injvlv_nvc_msg ""
 /begin OUT_MEASUREMENT InjVlv_facNVCActr InjVlv_stNVCEna InjVlv_stNVCPI InjVlv_uSetUpNVCActr InjVlv_uSetUpTiChrgActr /end OUT_MEASUREMENT
/end FUNCTION
/begin FUNCTION injvlv_nvc_uic "" /end FUNCTION
/begin FUNCTION injvlv_presmin "Abschaltanforderung aufgrund Mindestdruck" /begin DEF_CHARACTERISTIC InjVlv_pMin_C InjVlv_pMin_CUR /end DEF_CHARACTERISTIC /begin IN_MEASUREMENT Eng_tEng /end IN_MEASUREMENT /end FUNCTION
/begin FUNCTION injvlv_qntadj "Injektor-Mengenabgleich"
 /begin DEF_CHARACTERISTIC InjVlv_numClsVltgAdjMax_C InjVlv_numClsVltgAdjMin_C InjVlv_stQntAdj_MAP InjVlv_volQntAdjLim_C InjVlv_volQntAdjMax0_C InjVlv_volQntAdjMax1_C InjVlv_volQntAdjMax2_C InjVlv_volQntAdjMax3_C InjVlv_volQntAdjMin0_C InjVlv_volQntAdjMin1_C InjVlv_volQntAdjMin2_C InjVlv_volQntAdjMin3_C /end DEF_CHARACTERISTIC
 /begin IN_MEASUREMENT InjUn_volMI1Cor_mp RailCD_pPeak /end IN_MEASUREMENT
 /begin OUT_MEASUREMENT InjVlv_numCodeVltgAdj_mp InjVlv_stAdj_mp InjVlv_stCheckSumErrVltgAdj_mp InjVlv_stMaxErrVltgAdj_mp /end OUT_MEASUREMENT
/end FUNCTION
/begin FUNCTION injvlv_qntadjrepl "" /begin DEF_CHARACTERISTIC InjVlv_stQntAdjRepl_C InjVlv_swtQntAdj_C /end DEF_CHARACTERISTIC /end FUNCTION
/begin FUNCTION injvlv_qntadj_uic ""
 /begin OUT_MEASUREMENT InjVlv_volMI1QntAdj_mp InjVlv_volPiI1QntAdj_mp InjVlv_volPiI2QntAdj_mp InjVlv_volPiI3QntAdj_mp InjVlv_volPoI1QntAdj_mp InjVlv_volPoI2QntAdj_mp /end OUT_MEASUREMENT
/end FUNCTION
/begin FUNCTION injvlv_tdiffhyd "" /begin DEF_CHARACTERISTIC InjVlv_swtDiffHydInSel_C InjVlv_tiDiffHyd_MAP /end DEF_CHARACTERISTIC /begin IN_MEASUREMENT InjVlv_pActInDiffHyd_mp InjVlv_qDesInDiffHyd_mp /end IN_MEASUREMENT /end FUNCTION
/begin FUNCTION injvlv_tdiffhyd_uic ""
 /begin OUT_MEASUREMENT InjVlv_pActInDiffHyd_mp InjVlv_qDesInDiffHyd_mp InjVlv_tiMI1DiffHydCor_mp InjVlv_tiPiI1DiffHydCor_mp InjVlv_tiPiI2DiffHydCor_mp /end OUT_MEASUREMENT
/end FUNCTION
/begin FUNCTION injvlv_wvcor "Druckwellenkorrektur"
 /begin DEF_CHARACTERISTIC InjVlv_facFTSWvCor_MAP InjVlv_qWvCorNorm_CUR InjVlv_stWvCorActv_C InjVlv_tWvCor_MAP /end DEF_CHARACTERISTIC
 /begin IN_MEASUREMENT CTSCD_tClnt FTSCD_tFuel InjVlv_tWvCor_mp RailCD_pPeak /end IN_MEASUREMENT
/end FUNCTION
/begin COMPU_METHOD Actr_Calc "Zustände für Aktiv und Inaktiv" TAB_VERB "%6.3" "-" COMPU_TAB_REF Actr_Calc /end COMPU_METHOD
/begin COMPU_VTAB Actr_Calc "Zustände für Aktiv und Inaktiv" TAB_VERB 2 0 "Inactive" 1 "Active" /end COMPU_VTAB
/begin COMPU_METHOD Actr_Cls_State "Zustände für die Piezoaktor Klassifizierung" TAB_VERB "%6.3" "-" COMPU_TAB_REF Actr_Cls_State /end COMPU_METHOD
/begin COMPU_VTAB Actr_Cls_State "Zustände für die Piezoaktor Klassifizierung" TAB_VERB 4 0 "Wait" 1 "Energise" 2 "Measure" 4 "Done" /end COMPU_VTAB
/begin COMPU_METHOD Actr_Temp_Sel "Position des Schalters der die Basis für die Piezo-Aktortempartur auswählt" TAB_VERB "%6.3" "-" COMPU_TAB_REF Actr_Temp_Sel /end COMPU_METHOD
/begin COMPU_VTAB Actr_Temp_Sel "Position des Schalters der die Basis für die Piezo-Aktortempartur auswählt" TAB_VERB 2 0 "coolant water temperature" 1 "fuel temperature" /end COMPU_VTAB
/begin COMPU_METHOD AngleCrS "Winkel Kurbelwelle" RAT_FUNC "%6.4" "deg CrS" COEFFS 0 42.6666666666667 0 0 0 1 /end COMPU_METHOD
/begin COMPU_METHOD Capacity_PA "Kapazität der Piezo-Aktoren" RAT_FUNC "%6.5" "uF" COEFFS 0 1000 0 0 0 1 /end COMPU_METHOD
/begin COMPU_METHOD Charge_PA "Ladung der Piezo-Aktoren" RAT_FUNC "%6.2" "uC" COEFFS 0 1 0 0 0 1 /end COMPU_METHOD
/begin COMPU_METHOD Curr "Strom" RAT_FUNC "%6.2" "mA" COEFFS 0 1 0 0 0 1 /end COMPU_METHOD
/begin COMPU_METHOD Delta_Volt_INT "ADC Spannungsgradient" RAT_FUNC "%6.2" "mV/ms" COEFFS 0 1 0 0 0 1 /end COMPU_METHOD
/begin COMPU_METHOD EngN "Motordrehzahl" RAT_FUNC "%6.2" "rpm" COEFFS 0 1 0 0 0 1 /end COMPU_METHOD
/begin COMPU_METHOD Fact "Faktor mit Auflösung 1 / 8192, hauptsächlich für einen Faktorenbereich 0...1 verwendet" RAT_FUNC "%6.5" "-" COEFFS 0 8192 0 0 0 1 /end COMPU_METHOD
/begin COMPU_METHOD Fact1 "Faktor mit Auflösung 0,01 (100 mal höherer Bereich als Fact)" RAT_FUNC "%6.4" "-" COEFFS 0 128 0 0 0 1 /end COMPU_METHOD
/begin COMPU_METHOD Fact_IntAmp "Auflösungsfaktor für Stromverstärkungsfaktor des CY370-Integrators - Auflösung 0.001" RAT_FUNC "%6.5" "-" COEFFS 0 1000 0 0 0 1 /end COMPU_METHOD
/begin COMPU_METHOD InjMass "Einspritzmenge" RAT_FUNC "%6.4" "mg/hub" COEFFS 0 100 0 0 0 1 /end COMPU_METHOD
/begin COMPU_METHOD InjMassCyc "Einspritzmenge pro Zyklus (mg/Zyklus)" RAT_FUNC "%6.4" "mg/cyc" COEFFS 0 100 0 0 0 1 /end COMPU_METHOD
/begin COMPU_METHOD InjMassInj "Einspritzmenge pro Einspritzung (mg/Einspritzung)" RAT_FUNC "%6.4" "mg/inj" COEFFS 0 100 0 0 0 1 /end COMPU_METHOD
/begin COMPU_METHOD InjMassPerSec_20ms "Einspritzmengenänderung pro Sekunde für 20ms-Tasks" RAT_FUNC "%6.3" "mg/hub/s" COEFFS 0 2 0 0 0 1 /end COMPU_METHOD
/begin COMPU_METHOD InjQntInj "Einspritzmenge der einzelnen Einspritzung" RAT_FUNC "%6.4" "mm^3/inj" COEFFS 0 100 0 0 0 1 /end COMPU_METHOD
/begin COMPU_METHOD InjTime_us "Zeit in Microsekunden für das Einspritztiming" RAT_FUNC "%6.2" "us" COEFFS 0 1 0 0 0 1 /end COMPU_METHOD
/begin COMPU_METHOD ISA_Code "ISA-Code für den Injektorspannungsabgleich" TAB_VERB "%6.3" "-" COMPU_TAB_REF ISA_Code /end COMPU_METHOD
/begin COMPU_VTAB ISA_Code "ISA-Code für den Injektorspannungsabgleich" TAB_VERB 32 0 "A" 1 "B" 2 "C" 3 "D" 4 "E" 5 "F" 6 "G" 7 "H" 8 "I" 9 "K" 10 "L" 11 "M" 12 "N" 13 "O" 14 "P" 15 "R" 16 "S" 17 "T" 18 "U" 19 "V" 20 "W" 21 "X" 22 "Y" 23 "Z" 24 "1" 25 "2" 26 "3" 27 "4" 28 "5" 29 "6" 30 "7" 31 "8" /end COMPU_VTAB
/begin COMPU_METHOD Kd "Differentialverstärkung Kd (gleiche Einheit/Umrechnungsformel an Ein- und Ausgang)" RAT_FUNC "%7.6" "1/1" COEFFS 0 65536 0 0 0 1 /end COMPU_METHOD
/begin COMPU_METHOD Ki_VOLTPA2FACT "Integrale Verstärkung (Umrechnung von der Aktorspannung auf Faktor)" RAT_FUNC "%8.7" "1/(V*s)" COEFFS 0 351843.72088832 0 0 0 1 /end COMPU_METHOD
/begin COMPU_METHOD Kp_rpm2Nm_1 "Proportional Verstärkung (Umdrehungen nach Moment), Umrechnung für sint16 Werte" RAT_FUNC "%6.4" "Nm/rpm" COEFFS 0 320 0 0 0 1 /end COMPU_METHOD
/begin COMPU_METHOD Kp_VOLTPA2FACT "Proportionale Verstärkung (Umrechnung von der Aktorspannung auf den Faktor)" RAT_FUNC "%9.8" "1/V" COEFFS 0 5368709.12 0 0 0 1 /end COMPU_METHOD
/begin COMPU_METHOD Milli "Milli Auflösung" RAT_FUNC "%6.5" "-" COEFFS 0 1000 0 0 0 1 /end COMPU_METHOD
/begin COMPU_METHOD OneToOne "eins zu eins (physikalischer Wert ist gleich dem internen Wert)" RAT_FUNC "%6.2" "-" COEFFS 0 1 0 0 0 1 /end COMPU_METHOD
/begin COMPU_METHOD Prc "Prozent, gleiche interne Auflösung wie Fact, aber Darstellung in Prozent (0...100%)" RAT_FUNC "%6.4" "%" COEFFS 0 81.92 0 0 0 1 /end COMPU_METHOD
/begin COMPU_METHOD PresAC_hPa "Druck (Klimatisierung) angezeigt in [hPa]" RAT_FUNC "%6.2" "hPa" COEFFS 0 0.5 0 0 0 1 /end COMPU_METHOD
/begin COMPU_METHOD Pres_AC "Druck (Klimatisierung)" RAT_FUNC "%7.2" "hPa" COEFFS 0 0.500000 0 0 0 1 /end COMPU_METHOD
/begin COMPU_METHOD Pres_Rail "Raildruck in hPa" RAT_FUNC "%4.3" "bar" COEFFS 0 10.000000 0 0 0 1 /end COMPU_METHOD
/begin COMPU_METHOD Pres_SI "Druck (angezeigt in [Pa])" RAT_FUNC "%6.0" "Pa" COEFFS 0 0.01 0 0 0 1 /end COMPU_METHOD
/begin COMPU_METHOD Pwr_PA "Leistung für Piezo-Aktor" RAT_FUNC "%6.2" "mW" COEFFS 0 1 0 0 0 1 /end COMPU_METHOD
/begin COMPU_METHOD Resist_mOhm "Widerstand mit 1/10 mOhm Auflösung" RAT_FUNC "%6.3" "mOhm" COEFFS 0 10 0 0 0 1 /end COMPU_METHOD
/begin COMPU_METHOD RmpInjMass "Rampengradient für Einspritzmenge" RAT_FUNC "%6.5" "(mg/stroke)/s" COEFFS 0 6553.6 0 0 0 1 /end COMPU_METHOD
/begin COMPU_METHOD stMonShCir "Status des Ansteuerung im nachlauf für Kurzschlussunterscheidung" TAB_VERB "%6.3" "-" COMPU_TAB_REF stMonShCir /end COMPU_METHOD
/begin COMPU_VTAB stMonShCir "Status des Ansteuerung im nachlauf für Kurzschlussunterscheidung" TAB_VERB 4 0 "Wait" 1 "Energise" 2 "Gettime" 4 "Done" /end COMPU_VTAB
/begin COMPU_METHOD Temp_Cels "Temperatur dargestellt in °C (gleiche interne Darstellung wie Temp_Kelv)" RAT_FUNC "%6.1" "deg C" COEFFS 0 10 2731.4 0 0 1 /end COMPU_METHOD
/begin COMPU_METHOD TimeDelay_s "Zeitkonstante T1 (in s) für PT1, DT1, etc." RAT_FUNC "%9.3" "s" COEFFS 0 0 1 0 0.00023283064365387 0 /end COMPU_METHOD
/begin COMPU_METHOD TimeDT "Abtastzeit (in us) für Library Regler, Filter, etc." RAT_FUNC "%6.2" "us" COEFFS 0 1 0 0 0 1 /end COMPU_METHOD
/begin COMPU_METHOD TimeEngOnHrs "Umrechnung für Betriebsstundenzähler" RAT_FUNC "%6.1" "h" COEFFS 0 0.0549323782423836 0 0 0 1 /end COMPU_METHOD
/begin COMPU_METHOD Time_Busy "Lade-/Entladezeit der Piezosteller (us)" RAT_FUNC "%6.3" "us" COEFFS 0 10 0 0 0 1 /end COMPU_METHOD
/begin COMPU_METHOD Time_ms "Zeit in ms für Fehlerentprellung (DSM) und SW-Timer" RAT_FUNC "%6.1" "ms" COEFFS 0 0.1 0 0 0 1 /end COMPU_METHOD
/begin COMPU_METHOD Trq "Motormoment" RAT_FUNC "%6.3" "Nm" COEFFS 0 10 0 0 0 1 /end COMPU_METHOD
/begin COMPU_METHOD VltgAdj "Zustand des Injektor Spannungsabgleichs" TAB_VERB "%6.3" "-" COMPU_TAB_REF VltgAdj /end COMPU_METHOD
/begin COMPU_VTAB VltgAdj "Zustand des Injektor Spannungsabgleichs" TAB_VERB 3 0 "EEPROM" 1 "replace values" 8 "external access" /end COMPU_VTAB
/begin COMPU_METHOD Volt "Spannung in V (von ADC)" RAT_FUNC "%6.2" "mV" COEFFS 0 0.2046 0 0 0 1 /end COMPU_METHOD
/begin COMPU_METHOD VoltInt "Spannung vom ADC zum Integratorabgleich" RAT_FUNC "%6.4" "mV" COEFFS 0 204.6 0 0 0 1 /end COMPU_METHOD
/begin COMPU_METHOD Volt_Batt "Batteriespannung" RAT_FUNC "%6.1" "mV" COEFFS 0 0.05115 0 0 0 1 /end COMPU_METHOD
/begin COMPU_METHOD Volt_BUFC "zur Berechnung der DC/DC-Wandler Pufferspannung" RAT_FUNC "%6.4" "V" COEFFS 0 100 0 0 0 1 /end COMPU_METHOD
/begin COMPU_METHOD Volt_PA "Spannung des Piezo-Aktors" RAT_FUNC "%6.4" "V" COEFFS 0 100 0 0 0 1 /end COMPU_METHOD
/begin COMPU_METHOD W_PA "Energieverbrauch des Piezo-Aktors" RAT_FUNC "%6.2" "mWs" COEFFS 0 1 0 0 0 1 /end COMPU_METHOD
/begin RECORD_LAYOUT Gkf_Ws16 FNC_VALUES 1 SWORD COLUMN_DIR DIRECT /end RECORD_LAYOUT
/begin RECORD_LAYOUT GSst_Xs16 NO_AXIS_PTS_X 1 SWORD AXIS_PTS_X 2 SWORD INDEX_INCR DIRECT /end RECORD_LAYOUT
/begin RECORD_LAYOUT Kf_Xs16_Ys16_Ws16 NO_AXIS_PTS_X 1 SWORD NO_AXIS_PTS_Y 2 SWORD AXIS_PTS_X 3 SWORD INDEX_INCR DIRECT AXIS_PTS_Y 4 SWORD INDEX_INCR DIRECT FNC_VALUES 5 SWORD COLUMN_DIR DIRECT /end RECORD_LAYOUT
/begin RECORD_LAYOUT Kl_Xs16_Ws16 NO_AXIS_PTS_X 1 SWORD AXIS_PTS_X 2 SWORD INDEX_INCR DIRECT FNC_VALUES 3 SWORD COLUMN_DIR DIRECT /end RECORD_LAYOUT
/begin RECORD_LAYOUT Kwb_Ws16 FNC_VALUES 1 SWORD COLUMN_DIR DIRECT /end RECORD_LAYOUT
/begin RECORD_LAYOUT Kwb_Wu32 FNC_VALUES 1 ULONG COLUMN_DIR DIRECT /end RECORD_LAYOUT
/begin RECORD_LAYOUT Kw_Ws16 FNC_VALUES 1 SWORD COLUMN_DIR DIRECT /end RECORD_LAYOUT
/begin RECORD_LAYOUT Kw_Ws32 FNC_VALUES 1 SLONG COLUMN_DIR DIRECT /end RECORD_LAYOUT
/begin RECORD_LAYOUT Kw_Wu16 FNC_VALUES 1 UWORD COLUMN_DIR DIRECT /end RECORD_LAYOUT
/begin RECORD_LAYOUT Kw_Wu32 FNC_VALUES 1 ULONG COLUMN_DIR DIRECT /end RECORD_LAYOUT
/begin RECORD_LAYOUT Kw_Wu8 FNC_VALUES 1 UBYTE COLUMN_DIR DIRECT /end RECORD_LAYOUT
/end MODULE
/end PROJECT
