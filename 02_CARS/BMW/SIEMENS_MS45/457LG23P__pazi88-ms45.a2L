ASAP2_VERSION 1 31
/begin PROJECT MS45 "BMW Motorsteuerung R6"
/begin HEADER "_default_HeaderComment" PROJECT_NO _57 /end HEADER
/begin MODULE _default_ModuleName "_default_ModuleLongIdentifier"
/begin MOD_COMMON "_default_ModCommonComment" DEPOSIT ABSOLUTE BYTE_ORDER MSB_FIRST ALIGNMENT_BYTE 1 ALIGNMENT_WORD 2 ALIGNMENT_LONG 4 ALIGNMENT_FLOAT32_IEEE 4 ALIGNMENT_FLOAT64_IEEE 8 /end MOD_COMMON
/begin MEASUREMENT lv_cs "Boolean for clutch switch detection" UBYTE _CNV_S_2_RANGE______2_CM 1 100. 0. 1. DISPLAY_IDENTIFIER LV_CS ECU_ADDRESS 0x3fe74e BIT_MASK 0x1 /end MEASUREMENT
/begin MEASUREMENT lv_dt "Logical variable drive train engaged" UBYTE _CNV_S_2_RANGE______2_CM 1 100. 0. 1. DISPLAY_IDENTIFIER LV_DT ECU_ADDRESS 0x3fe74f BIT_MASK 0x1 /end MEASUREMENT
/begin CHARACTERISTIC c_vs_min_dt "Threshold for vehicle running and drive-train closed detection " VALUE 0xffe409e0 _REC_VAL_20_u1 255. _CNV_A_R_LINEAR_____23_CM 0. 255. DISPLAY_IDENTIFIER C_VS_MIN_DT FORMAT "%3.0" /end CHARACTERISTIC
/begin CHARACTERISTIC c_min_vs_ratio "Minimum engine speed / vehicle speed ratio calculation" VALUE 0xffe407a0 _REC_VAL_20_u1 255. _CNV_A_R_LINEAR_____23_CM 0. 255. DISPLAY_IDENTIFIER C_MIN_VS_RATIO FORMAT "%3.0" /end CHARACTERISTIC
/begin CHARACTERISTIC id_gr_mt__n_vs_ratio "Index table for Gear Ratio detection" CURVE 0xffe440d3 _REC_CUR_20_u1_u1 255. _CNV_A_R_LINEAR_____0_CM 0. 255. DISPLAY_IDENTIFIER ID_GR_MT FORMAT "%3.0"
 /begin AXIS_DESCR COM_AXIS n_vs_ratio _CNV_A_R_LINEAR_____0_CM 13 0. 255. FORMAT "%3.0" AXIS_PTS_REF ldp_n_vs_ratio_gr_mt /end AXIS_DESCR
/end CHARACTERISTIC
/begin AXIS_PTS ldp_n_vs_ratio_gr_mt "" 0xffe48162 n_vs_ratio _REC_AXS_20_u1 255. _CNV_A_R_LINEAR_____0_CM 13 0. 255. DISPLAY_IDENTIFIER LDP_N_VS_RATIO_GR_MT FORMAT "%3.0" /end AXIS_PTS
/begin CHARACTERISTIC lc_rng_l "Manual switch for low range detection" VALUE 0xffe40fd0 _REC_VAL_20_u1 1. _CNV_A_R_LINEAR_____22_CM 0. 1. DISPLAY_IDENTIFIER LC_RNG_L FORMAT "%1.0" /end CHARACTERISTIC
/begin MEASUREMENT gr_mt "Manual transmission gear ratio" UBYTE _CNV_A_R_LINEAR_____0_CM 1 100. 0. 255. DISPLAY_IDENTIFIER GR_MT ECU_ADDRESS 0x3fe745 FORMAT "%3.0" /end MEASUREMENT
/begin MEASUREMENT gr_at "Automatic transmission gear ratio" UBYTE _CNV_A_R_LINEAR_____0_CM 1 100. 0. 255. DISPLAY_IDENTIFIER GR_AT ECU_ADDRESS 0x3fe746 FORMAT "%3.0" /end MEASUREMENT
/begin MEASUREMENT lv_rng_l "Logical variable for engaged low range" UBYTE _CNV_S_2_RANGE______2_CM 1 100. 0. 1. DISPLAY_IDENTIFIER LV_RNG_L ECU_ADDRESS 0x3fe74a /end MEASUREMENT
/begin MEASUREMENT lv_dri "Logical variable for engaged drive" UBYTE _CNV_S_2_RANGE______2_CM 1 100. 0. 1. DISPLAY_IDENTIFIER LV_DRI ECU_ADDRESS 0x3fe74b BIT_MASK 0x1 /end MEASUREMENT
/begin MEASUREMENT gear_ef "Gear ratio used for exhaust flap functionality" UBYTE _CNV_A_R_LINEAR_____0_CM 1 100. 0. 255. DISPLAY_IDENTIFIER GEAR_EF ECU_ADDRESS 0x3fe748 FORMAT "%3.0" /end MEASUREMENT
/begin MEASUREMENT state_gear_rev_at_amt "AT/AMT reverse gear (activ = 1, inactive = 0)" UBYTE _CNV_S_2_RANGE______2_CM 1 100. 0. 1. DISPLAY_IDENTIFIER STATE_GEAR_REV_AT_AMT ECU_ADDRESS 0x3fe749 /end MEASUREMENT
/begin MEASUREMENT n_vs_ratio "Engine speed / vehicle speed ratio" UBYTE _CNV_A_R_LINEAR_____200_CM 1 100. 0. 255. DISPLAY_IDENTIFIER N_VS_RATIO ECU_ADDRESS 0x3fe74c FORMAT "%3.0" /end MEASUREMENT
/begin MEASUREMENT fac_gr "Factor for setpoint/actual reduction ratio of rear axle" UWORD _CNV_A_R_LINEAR_____20_CM 1 100. 0. 1.99996948 DISPLAY_IDENTIFIER FAC_GR ECU_ADDRESS 0x3fd7aa BYTE_ORDER MSB_LAST FORMAT "%7.5" /end MEASUREMENT
/begin MEASUREMENT fac_gr_mmv_av "Rear axle ratio adaptation value" UWORD _CNV_A_R_LINEAR_____20_CM 1 100. 0. 1.99996948 DISPLAY_IDENTIFIER FAC_GR_MMV_AV ECU_ADDRESS 0x3fd7a8 BYTE_ORDER MSB_LAST FORMAT "%7.5" /end MEASUREMENT
/begin MEASUREMENT gr_rax_av "Current rear axle ratio" UWORD _CNV_A_R_LINEAR_____125_CM 1 100. 0. 255.996094 DISPLAY_IDENTIFIER GR_RAX_AV ECU_ADDRESS 0x3fd7ac BYTE_ORDER MSB_LAST FORMAT "%7.3" /end MEASUREMENT
/begin CHARACTERISTIC c_gr_rax_sp "Rear axle ratio of standard rear axle" VALUE 0xffe41670 _REC_VAL_20_u2 255.996094 _CNV_A_R_LINEAR_____125_CM 0. 255.996094 DISPLAY_IDENTIFIER C_GR_RAX_SP FORMAT "%7.3" /end CHARACTERISTIC
/begin CHARACTERISTIC c_crlc_fac_gr "Correlation constant for adaptation of the rear axle" VALUE 0xffe40680 _REC_VAL_20_u1 0.9960940000000002 _CNV_A_R_LINEAR_____50_CM 0. 0.996094 DISPLAY_IDENTIFIER C_CRLC_FAC_GR FORMAT "%5.3" /end CHARACTERISTIC
/begin CHARACTERISTIC c_n_vs_cru_gear2_puc_sp "N/VS ratio in case of PUC in 2nd gear with standard rear axle" VALUE 0xffe40804 _REC_VAL_20_u1 255. _CNV_A_R_LINEAR_____200_CM 0. 255. DISPLAY_IDENTIFIER C_N_VS_CRU_GEAR2_PUC_SP FORMAT "%3.0" /end CHARACTERISTIC
/begin CHARACTERISTIC c_n_vs_cru_grd_fac_gr_max "Gradient of N/VS ratio below which FAC_GR is adapted" VALUE 0xffe40805 _REC_VAL_20_u1 255. _CNV_A_R_LINEAR_____200_CM 0. 255. DISPLAY_IDENTIFIER C_N_VS_CRU_GRD_FAC_GR_MAX FORMAT "%3.0" /end CHARACTERISTIC
/begin CHARACTERISTIC ip_fac_ivvt__vo "relative wave overlap" CURVE 0xffe40b9a _REC_CUR_20_u1_u1 3.984375 _CNV_A_R_LINEAR_____129_CM 0. 3.984375 DISPLAY_IDENTIFIER IP_FAC_IVVT__VO FORMAT "%4.2"
 /begin AXIS_DESCR COM_AXIS vo _CNV_A_R_LINEAR_____82_CM 8 0. 95.625 FORMAT "%5.2" AXIS_PTS_REF ldp_vo_fac_ivvt /end AXIS_DESCR
/end CHARACTERISTIC
/begin MEASUREMENT vo_min "valve overlap minimum" UBYTE _CNV_A_R_LINEAR_____82_CM 1 100. 0. 95.625 DISPLAY_IDENTIFIER VO_MIN ECU_ADDRESS 0x3fe4b6 FORMAT "%5.2" /end MEASUREMENT
/begin MEASUREMENT vo_max "valve overlap maximum" UBYTE _CNV_A_R_LINEAR_____82_CM 1 100. 0. 95.625 DISPLAY_IDENTIFIER VO_MAX ECU_ADDRESS 0x3fe4b7 FORMAT "%5.2" /end MEASUREMENT
/begin MEASUREMENT cam_av_mv_in "Average value inlet-CAM position" SWORD _CNV_A_R_LINEAR_____228_CM 1 100. -768. 767.9765625 DISPLAY_IDENTIFIER CAM_AV_MV_IN ECU_ADDRESS 0x3fd350 BYTE_ORDER MSB_LAST FORMAT "%7.2" /end MEASUREMENT
/begin MEASUREMENT maf_ivvt "Feedback free engine load for IVVT setpoint calculation - filtered" UWORD _CNV_A_R_LINEAR_____108_CM 1 100. 0. 1389. DISPLAY_IDENTIFIER MAF_IVVT ECU_ADDRESS 0x3fd34e BYTE_ORDER MSB_LAST FORMAT "%7.2" /end MEASUREMENT
/begin MEASUREMENT fac_ivvt "value representing the relative valve overlap" UBYTE _CNV_A_R_LINEAR_____248_CM 1 100. 0. 3.984375 DISPLAY_IDENTIFIER FAC_IVVT ECU_ADDRESS 0x3fe4ba FORMAT "%4.2" /end MEASUREMENT
/begin MEASUREMENT vo_sp "valve overlap setpoint" UBYTE _CNV_A_R_LINEAR_____82_CM 1 100. 0. 95.625 DISPLAY_IDENTIFIER VO_SP ECU_ADDRESS 0x3fe4b8 FORMAT "%5.2" /end MEASUREMENT
/begin MEASUREMENT vo_sp_ref "valve overlap setpoint at reference conditions (warm engine)" UBYTE _CNV_A_R_LINEAR_____82_CM 1 100. 0. 95.625 DISPLAY_IDENTIFIER VO_SP_REF ECU_ADDRESS 0x3fe4b9 FORMAT "%5.2" /end MEASUREMENT
/begin AXIS_PTS ldp_vo_fac_ivvt "" 0xffe48335 vo _REC_AXS_20_u1 95.625 _CNV_A_R_LINEAR_____82_CM 8 0. 95.625 DISPLAY_IDENTIFIER LDP_VO_FAC_IVVT FORMAT "%5.2" /end AXIS_PTS
/begin AXIS_PTS ldp_n_32__crlc_maf_ivvt "" 0xffe41084 n_32 _REC_AXS_20_u1 816. _CNV_A_R_LINEAR_____15_CM 6 0. 8160. DISPLAY_IDENTIFIER LDP_N_32__CRLC_MAF_IVVT FORMAT "%4.0" /end AXIS_PTS
/begin AXIS_PTS ldp_maf_sp__crlc_maf_ivvt "" 0xffe50eac maf_sp_tqi _REC_AXS_20_u2 1389. _CNV_A_R_LINEAR_____108_CM 6 0. 1389. DISPLAY_IDENTIFIER LDP_MAF_SP__CRLC_MAF_IVVT FORMAT "%7.2" /end AXIS_PTS
/begin CHARACTERISTIC ip_crlc_maf_ivvt__n__maf_sp "Correlation constant for filtering of MAF_IVVT" MAP 0xffe44dda _REC_MAP_20_u1_u1_u2 0.9960940000000002 _CNV_A_R_LINEAR_____50_CM 0. 0.996094 DISPLAY_IDENTIFIER IP_CRLC_MAF_IVVT__N__MAF_SP FORMAT "%5.3"
 /begin AXIS_DESCR COM_AXIS n_32 _CNV_A_R_LINEAR_____15_CM 6 0. 8160. FORMAT "%4.0" AXIS_PTS_REF ldp_n_32__crlc_maf_ivvt /end AXIS_DESCR
 /begin AXIS_DESCR COM_AXIS maf_sp_tqi _CNV_A_R_LINEAR_____108_CM 6 0. 1389. FORMAT "%7.2" AXIS_PTS_REF ldp_maf_sp__crlc_maf_ivvt /end AXIS_DESCR
/end CHARACTERISTIC
/begin CHARACTERISTIC c_cam_op_ex "outlet valves total opening angle" VALUE 0xffe40646 _REC_VAL_20_u1 95.625 _CNV_A_R_LINEAR_____249_CM 175. 270.625 DISPLAY_IDENTIFIER C_CAM_OP_EX FORMAT "%5.1" /end CHARACTERISTIC
/begin CHARACTERISTIC c_cam_op_in "inlet valves total opening angle" VALUE 0xffe40647 _REC_VAL_20_u1 95.625 _CNV_A_R_LINEAR_____249_CM 175. 270.625 DISPLAY_IDENTIFIER C_CAM_OP_IN FORMAT "%5.1" /end CHARACTERISTIC
/begin CHARACTERISTIC c_cam_adj_rng_max_in "adjustment range of inlet camshaft" VALUE 0xffe40636 _REC_VAL_20_u1 60. _CNV_A_R_LINEAR_____82_CM 0. 60. DISPLAY_IDENTIFIER C_CAM_ADJ_RNG_MAX_IN FORMAT "%4.1" /end CHARACTERISTIC
/begin CHARACTERISTIC c_cam_adj_rng_max_ex "adjustment range of exhaust camshaft" VALUE 0xffe40635 _REC_VAL_20_u1 60. _CNV_A_R_LINEAR_____82_CM 0. 60. DISPLAY_IDENTIFIER C_CAM_ADJ_RNG_MAX_EX FORMAT "%4.1" /end CHARACTERISTIC
/begin MEASUREMENT vo "moving mean value of actual valve overlap" UBYTE _CNV_A_R_LINEAR_____82_CM 1 100. 0. 95.625 DISPLAY_IDENTIFIER VO ECU_ADDRESS 0x3fe4b5 FORMAT "%5.2" /end MEASUREMENT
/begin MEASUREMENT vo_bas "actual valve overlap" UBYTE _CNV_A_R_LINEAR_____82_CM 1 100. 0. 95.625 DISPLAY_IDENTIFIER VO_BAS ECU_ADDRESS 0x3fe4b4 FORMAT "%5.2" /end MEASUREMENT
/begin CHARACTERISTIC c_crlc_vo_mmv "Correlation constant for filtering VO" VALUE 0xffe406a0 _REC_VAL_20_u1 0.9960940000000002 _CNV_A_R_LINEAR_____50_CM 0. 0.996094 DISPLAY_IDENTIFIER C_CRLC_VO_MMV FORMAT "%5.3" /end CHARACTERISTIC
/begin MEASUREMENT lam_bank_1.lam_dly_obd2_inci.lv_inh_diag_delta_lamb_i "Inhibition conditions for the dynamic fuel trim diagnosis - linear lambda control" UBYTE _CNV_S_2_RANGE______2_CM 1 100. 0. 1. DISPLAY_IDENTIFIER LV_INH_DIAG_DELTA_LAMB_I_1 ECU_ADDRESS 0x3fc6b4 /end MEASUREMENT
/begin MEASUREMENT lam_bank_2.lam_dly_obd2_inci.lv_inh_diag_delta_lamb_i "Inhibition conditions for the dynamic fuel trim diagnosis - linear lambda control" UBYTE _CNV_S_2_RANGE______2_CM 1 100. 0. 1. DISPLAY_IDENTIFIER LV_INH_DIAG_DELTA_LAMB_I_2 ECU_ADDRESS 0x3fcb6c /end MEASUREMENT
/begin MEASUREMENT maf_kgh_mes_bas "Raw air-mass flow measured (without correction, to be used for diagnosis only)" UWORD _CNV_A_R_LINEAR_____115_CM 1 100. 0. 2047.96875 DISPLAY_IDENTIFIER MAF_KGH_MES_BAS ECU_ADDRESS 0x3fd238 BYTE_ORDER MSB_LAST FORMAT "%7.2" /end MEASUREMENT
/begin MEASUREMENT maf_mes "Mass air flow per segment" UWORD _CNV_A_R_LINEAR_____108_CM 1 100. 0. 1389. DISPLAY_IDENTIFIER MAF_MES ECU_ADDRESS 0x3fd23a BYTE_ORDER MSB_LAST FORMAT "%6.2" /end MEASUREMENT
/begin MEASUREMENT maf_kgh_mes "Mass air flow per segment measured" UWORD _CNV_A_R_LINEAR_____115_CM 1 100. 0. 2047.96875 DISPLAY_IDENTIFIER MAF_KGH_MES ECU_ADDRESS 0x3fd236 BYTE_ORDER MSB_LAST FORMAT "%7.2" /end MEASUREMENT
/begin AXIS_PTS ldp_n__pq_sp_puls "" 0xffe51004 n _REC_AXS_20_u2 816. _CNV_A_R_LINEAR_____10_CM 6 0. 8160. DISPLAY_IDENTIFIER LDP_N__PQ_SP_PULS FORMAT "%4.0" /end AXIS_PTS
/begin CHARACTERISTIC ip_pq_sp_puls "PQ-threshold for LV_MAF_PULS" CURVE 0xffe4ddea _REC_CUR_20_u2_u2 0.99998474 _CNV_A_R_LINEAR_____37_CM 0. 0.99998474 DISPLAY_IDENTIFIER IP_PQ_SP_PULS FORMAT "%7.5"
 /begin AXIS_DESCR COM_AXIS n _CNV_A_R_LINEAR_____10_CM 6 0. 8160. FORMAT "%4.0" AXIS_PTS_REF ldp_n__pq_sp_puls /end AXIS_DESCR
/end CHARACTERISTIC
/begin CHARACTERISTIC c_pq_sp_hys_puls "Hysteresis for PQ-threshold for LV_MAF_PULS" VALUE 0xffe41876 _REC_VAL_20_u2 0.99998474 _CNV_A_R_LINEAR_____37_CM 0. 0.99998474 DISPLAY_IDENTIFIER C_PQ_SP_HYS_PULS FORMAT "%7.5" /end CHARACTERISTIC
/begin MEASUREMENT lv_maf_puls "Boolean for wrong air flow acquisition" UBYTE _CNV_S_2_RANGE______2_CM 1 100. 0. 1. DISPLAY_IDENTIFIER LV_MAF_PULS ECU_ADDRESS 0x3fe481 /end MEASUREMENT
/begin MEASUREMENT maf_cyl_stk "Air mass flow out of the intake manifold per stroke" UWORD _CNV_A_R_LINEAR_____108_CM 1 100. 0. 1389. DISPLAY_IDENTIFIER MAF_CYL_STK ECU_ADDRESS 0x3fd248 BYTE_ORDER MSB_LAST FORMAT "%6.2" /end MEASUREMENT
/begin MEASUREMENT maf_kgh_clc "Calculated value of MAF_KGH out of manifold model" UWORD _CNV_A_R_LINEAR_____115_CM 1 100. 0. 2047.96875 DISPLAY_IDENTIFIER MAF_KGH_CLC ECU_ADDRESS 0x3fd242 BYTE_ORDER MSB_LAST FORMAT "%7.2" /end MEASUREMENT
/begin MEASUREMENT map_egr "Residual gas partial pressure in the manifold" UWORD _CNV_A_R_LINEAR_____49_CM 1 100. 0. 5434. DISPLAY_IDENTIFIER MAP_EGR ECU_ADDRESS 0x3fd258 BYTE_ORDER MSB_LAST FORMAT "%7.2" /end MEASUREMENT
/begin MEASUREMENT map_egr_pred "Predicted residual gas partial manifold air pressure" UWORD _CNV_A_R_LINEAR_____49_CM 1 100. 0. 5434. DISPLAY_IDENTIFIER MAP_EGR_PRED ECU_ADDRESS 0x3fd284 BYTE_ORDER MSB_LAST FORMAT "%7.2" /end MEASUREMENT
/begin MEASUREMENT map_fg_pred "Predicted fresh gas partial manifold air pressure" UWORD _CNV_A_R_LINEAR_____49_CM 1 100. 0. 5434. DISPLAY_IDENTIFIER MAP_FG_PRED ECU_ADDRESS 0x3fd286 BYTE_ORDER MSB_LAST FORMAT "%7.2" /end MEASUREMENT
/begin MEASUREMENT map_pred "Predicted manifold air pressure" UWORD _CNV_A_R_LINEAR_____49_CM 1 100. 0. 5434. DISPLAY_IDENTIFIER MAP_PRED ECU_ADDRESS 0x3fd282 BYTE_ORDER MSB_LAST FORMAT "%7.2" /end MEASUREMENT
/begin MEASUREMENT map_fg "Fresh gas partial pressure in the manifold" UWORD _CNV_A_R_LINEAR_____49_CM 1 100. 0. 5434. DISPLAY_IDENTIFIER MAP_FG ECU_ADDRESS 0x3fd262 BYTE_ORDER MSB_LAST FORMAT "%7.2" /end MEASUREMENT
/begin MEASUREMENT pq "Pressure quotient at the throttle" UWORD _CNV_A_R_LINEAR_____37_CM 1 100. 0. 0.99998474 DISPLAY_IDENTIFIER PQ ECU_ADDRESS 0x3fd260 BYTE_ORDER MSB_LAST FORMAT "%7.5" /end MEASUREMENT
/begin MEASUREMENT pq_egr "Pressure quotient at the EGR - valve" UWORD _CNV_A_R_LINEAR_____37_CM 1 100. 0. 0.99998474 DISPLAY_IDENTIFIER PQ_EGR ECU_ADDRESS 0x3fd25a BYTE_ORDER MSB_LAST FORMAT "%7.5" /end MEASUREMENT
/begin MEASUREMENT pq_egr_estim "Estimated pressure quotient at the EGR - valve" UWORD _CNV_A_R_LINEAR_____37_CM 1 100. 0. 0.99998474 DISPLAY_IDENTIFIER PQ_EGR_ESTIM ECU_ADDRESS 0x3fd28e BYTE_ORDER MSB_LAST FORMAT "%7.5" /end MEASUREMENT
/begin MEASUREMENT maf_thr "Air mass flow at the throttle" UWORD _CNV_A_R_LINEAR_____115_CM 1 100. 0. 2047.96875 DISPLAY_IDENTIFIER MAF_THR ECU_ADDRESS 0x3fd244 BYTE_ORDER MSB_LAST FORMAT "%7.2" /end MEASUREMENT
/begin MEASUREMENT maf_egr "Air mass flow at the EGR -valve" UWORD _CNV_A_R_LINEAR_____115_CM 1 100. 0. 2047.96875 DISPLAY_IDENTIFIER MAF_EGR ECU_ADDRESS 0x3fd256 BYTE_ORDER MSB_LAST FORMAT "%7.2" /end MEASUREMENT
/begin MEASUREMENT map_drv1 "First derivative of  intake  manifold pressure " SWORD _CNV_A_R_LINEAR_____375_CM 1 100. -82.91625999999999 82.91377 DISPLAY_IDENTIFIER MAP_DRV1 ECU_ADDRESS 0x3fd266 BYTE_ORDER MSB_LAST FORMAT "%7.3" /end MEASUREMENT
/begin MEASUREMENT map_egr_drv1 "First derivative of  intake  manifold residual gas pressure " SWORD _CNV_A_R_LINEAR_____375_CM 1 100. -82.91625999999999 82.91377 DISPLAY_IDENTIFIER MAP_EGR_DRV1 ECU_ADDRESS 0x3fd280 BYTE_ORDER MSB_LAST FORMAT "%5.3" /end MEASUREMENT
/begin MEASUREMENT maf_egr_con_1 "sqrt(2x/((x-1)*RA*TEG_EGR)) with x = kappa = 1.4" UWORD _CNV_A_R_LINEAR_____376_CM 1 100. 0. 2.06019e-002 DISPLAY_IDENTIFIER MAF_EGR_CON_1 ECU_ADDRESS 0x3fd24e BYTE_ORDER MSB_LAST FORMAT "%8.7" /end MEASUREMENT
/begin MEASUREMENT maf_fac_ofs "Offset of the air flow equation for the throttle air mass flow" UWORD _CNV_A_R_LINEAR_____377_CM 1 100. 0. 8.880330000000001 DISPLAY_IDENTIFIER MAF_FAC_OFS ECU_ADDRESS 0x3fd25c BYTE_ORDER MSB_LAST FORMAT "%6.4" /end MEASUREMENT
/begin MEASUREMENT maf_fac_ofs_egr "Offset of the air flow equation for the EGR air mass flow" UWORD _CNV_A_R_LINEAR_____377_CM 1 100. 0. 8.880330000000001 DISPLAY_IDENTIFIER MAF_FAC_OFS_EGR ECU_ADDRESS 0x3fd250 BYTE_ORDER MSB_LAST FORMAT "%6.4" /end MEASUREMENT
/begin MEASUREMENT maf_fac_slop "Slope of the air flow equation for the throttle air mass flow" UWORD _CNV_A_R_LINEAR_____377_CM 1 100. 0. 8.880330000000001 DISPLAY_IDENTIFIER MAF_FAC_SLOP ECU_ADDRESS 0x3fd25e BYTE_ORDER MSB_LAST FORMAT "%6.4" /end MEASUREMENT
/begin CHARACTERISTIC ip_maf_mdl_con_1__tia "Temperature influence air flow function at the throttle" CURVE 0xffe4ce4a _REC_CUR_20_u2_u1 2.06019e-002 _CNV_A_R_LINEAR_____376_CM 0. 2.06019e-002 DISPLAY_IDENTIFIER IP_MAF_MDL_CON_1__TIA FORMAT "%8.7"
 /begin AXIS_DESCR COM_AXIS tia _CNV_A_R_LINEAR_____11_CM 8 -48. 142.5 FORMAT "%5.1" AXIS_PTS_REF ldpm_tia_maf_mdl_con_1 /end AXIS_DESCR
/end CHARACTERISTIC
/begin CHARACTERISTIC ip_maf_egr_con_1__teg_egr "Temperature influence air flow function at the EGR-Valve" CURVE 0xffe4cdfe _REC_CUR_20_u2_u2 2.06019e-002 _CNV_A_R_LINEAR_____376_CM 0. 2.06019e-002 DISPLAY_IDENTIFIER IP_MAF_EGR_CON_1__TEG_EGR FORMAT "%8.7"
 /begin AXIS_DESCR COM_AXIS teg_egr _CNV_A_R_LINEAR_____6_CM 8 0. 2047. FORMAT "%7.2" AXIS_PTS_REF ldp_teg_egr_maf_egr_con_1 /end AXIS_DESCR
/end CHARACTERISTIC
/begin CHARACTERISTIC ip_pred_fac__n "Prediction factor" CURVE 0xffe40d97 _REC_CUR_20_u1_u1 7.96875 _CNV_A_R_LINEAR_____236_CM 0. 7.96875 DISPLAY_IDENTIFIER IP_PRED_FAC__N FORMAT "%4.2"
 /begin AXIS_DESCR COM_AXIS n_32 _CNV_A_R_LINEAR_____15_CM 6 0. 8160. FORMAT "%4.0" AXIS_PTS_REF ldpm_n_32_ar_red /end AXIS_DESCR
/end CHARACTERISTIC
/begin MEASUREMENT maf_cyl "Mass air flow out of intake manifold" UWORD _CNV_A_R_LINEAR_____115_CM 1 100. 0. 2047.96875 DISPLAY_IDENTIFIER MAF_CYL ECU_ADDRESS 0x3fd246 BYTE_ORDER MSB_LAST FORMAT "%7.2" /end MEASUREMENT
/begin MEASUREMENT maf_fg_cyl "Fresh air mass flow in the cylinder" UWORD _CNV_A_R_LINEAR_____115_CM 1 100. 0. 2047.96875 DISPLAY_IDENTIFIER MAF_FG_CYL ECU_ADDRESS 0x3fd26e BYTE_ORDER MSB_LAST FORMAT "%7.2" /end MEASUREMENT
/begin MEASUREMENT maf_fg_cyl_stk "Fresh air mass flow in the cylinder per stroke" UWORD _CNV_A_R_LINEAR_____108_CM 1 100. 0. 1389. DISPLAY_IDENTIFIER MAF_FG_CYL_STK ECU_ADDRESS 0x3fd270 BYTE_ORDER MSB_LAST FORMAT "%7.2" /end MEASUREMENT
/begin MEASUREMENT fac_maf_max "Ratio between MAF und MAX_COR" UWORD _CNV_A_R_LINEAR_____20_CM 1 100. 0. 1.99996948 DISPLAY_IDENTIFIER FAC_MAF_MAX ECU_ADDRESS 0x3fd274 BYTE_ORDER MSB_LAST FORMAT "%7.5" /end MEASUREMENT
/begin CHARACTERISTIC c_maf_mmv_dif_crlc "MAF moving mean value filtering factor" VALUE 0xffe40796 _REC_VAL_20_u1 9.960940000000002e-002 _CNV_A_R_LINEAR_____50_CM 0. 0.996094 DISPLAY_IDENTIFIER C_MAF_MMV_DIF_CRLC FORMAT "%5.3" /end CHARACTERISTIC
/begin MEASUREMENT maf_fac_slop_egr "Slope of the air flow equation for the EGR mass air flow" UWORD _CNV_A_R_LINEAR_____377_CM 1 100. 0. 8.880330000000001 DISPLAY_IDENTIFIER MAF_FAC_SLOP_EGR ECU_ADDRESS 0x3fd252 BYTE_ORDER MSB_LAST FORMAT "%6.4" /end MEASUREMENT
/begin MEASUREMENT maf_mdl_con_1 "sqrt(2x/((x-1)*RA*TIA)) with x = kappa = 1.4" UWORD _CNV_A_R_LINEAR_____376_CM 1 100. 0. 2.06019e-002 DISPLAY_IDENTIFIER MAF_MDL_CON_1 ECU_ADDRESS 0x3fd24c BYTE_ORDER MSB_LAST FORMAT "%8.7" /end MEASUREMENT
/begin MEASUREMENT maf_mdl_con_0 "sqrt(2x/((x-1)*RA*TIA)) with x = kappa = 1.4" UWORD _CNV_A_R_LINEAR_____378_CM 1 100. 0. 58352820. DISPLAY_IDENTIFIER MAF_MDL_CON_0 ECU_ADDRESS 0x3fd24a BYTE_ORDER MSB_LAST FORMAT "%9.0" /end MEASUREMENT
/begin MEASUREMENT map "Manifold air pressure" UWORD _CNV_A_R_LINEAR_____49_CM 1 100. 0. 5434. DISPLAY_IDENTIFIER MAP ECU_ADDRESS 0x3fd264 BYTE_ORDER MSB_LAST FORMAT "%7.2" /end MEASUREMENT
/begin MEASUREMENT maf_kgh "Mass air flow per segment" UWORD _CNV_A_R_LINEAR_____115_CM 1 100. 0. 2047.96875 DISPLAY_IDENTIFIER MAF_KGH ECU_ADDRESS 0x3fd26a BYTE_ORDER MSB_LAST FORMAT "%7.2" /end MEASUREMENT
/begin MEASUREMENT maf_dif "Mass air flow difference per segment" SWORD _CNV_A_R_LINEAR_____257_CM 1 100. -694.5 694.478806 DISPLAY_IDENTIFIER MAF_DIF ECU_ADDRESS 0x3fd268 BYTE_ORDER MSB_LAST FORMAT "%7.2" /end MEASUREMENT
/begin MEASUREMENT maf_isa_fac_ofs "offset of the air flow equation for the throttle air mass flow for ISA" UWORD _CNV_A_R_LINEAR_____377_CM 1 100. 0. 8.880330000000001 DISPLAY_IDENTIFIER MAF_ISA_FAC_OFS ECU_ADDRESS 0x3fd278 BYTE_ORDER MSB_LAST FORMAT "%6.4" /end MEASUREMENT
/begin MEASUREMENT maf_isa_fac_slop "slope of the air flow equation for the throttle air mass flow for ISA" UWORD _CNV_A_R_LINEAR_____377_CM 1 100. 0. 8.880330000000001 DISPLAY_IDENTIFIER MAF_ISA_FAC_SLOP ECU_ADDRESS 0x3fd27a BYTE_ORDER MSB_LAST FORMAT "%6.4" /end MEASUREMENT
/begin MEASUREMENT maf_thr_isa_tot "total air mass flow at the throttle and ISA valve" UWORD _CNV_A_R_LINEAR_____115_CM 1 100. 0. 2047.96875 DISPLAY_IDENTIFIER MAF_THR_ISA_TOT ECU_ADDRESS 0x3fd27e BYTE_ORDER MSB_LAST FORMAT "%7.2" /end MEASUREMENT
/begin MEASUREMENT maf_isa "air mass flow at the ISA valve" UWORD _CNV_A_R_LINEAR_____115_CM 1 100. 0. 2047.96875 DISPLAY_IDENTIFIER MAF_ISA ECU_ADDRESS 0x3fd27c BYTE_ORDER MSB_LAST FORMAT "%7.2" /end MEASUREMENT
/begin AXIS_PTS ldpm_tia_maf_mdl_con_1 "" 0xffe486bf tia _REC_AXS_20_u1 190.5 _CNV_A_R_LINEAR_____11_CM 8 -48. 142.5 DISPLAY_IDENTIFIER LDPM_TIA_MAF_MDL_CON_1 FORMAT "%5.1" /end AXIS_PTS
/begin AXIS_PTS ldp_teg_egr_maf_egr_con_1 "" 0xffe5131e teg_egr _REC_AXS_20_u2 2047. _CNV_A_R_LINEAR_____6_CM 8 0. 2047. DISPLAY_IDENTIFIER LDP_TEG_EGR_MAF_EGR_CON_1 FORMAT "%7.2" /end AXIS_PTS
/begin AXIS_PTS ldpm_n_32_ar_red "" 0xffe413d1 n_32 _REC_AXS_20_u1 816. _CNV_A_R_LINEAR_____15_CM 6 0. 8160. DISPLAY_IDENTIFIER LDPM_N_32_AR_RED FORMAT "%4.0" /end AXIS_PTS
/begin CHARACTERISTIC id_maf_fac_ofs__pq_estim "Offset air flow function" CURVE 0xffe48818 _REC_CUR_20_u2_u2 8.880330000000001 _CNV_A_R_LINEAR_____377_CM 0. 8.880330000000001 DISPLAY_IDENTIFIER ID_MAF_FAC_OFS__PQ_ESTIM FORMAT "%6.4"
 /begin AXIS_DESCR COM_AXIS pq_estim _CNV_A_R_LINEAR_____37_CM 16 0. 0.99998474 FORMAT "%7.5" AXIS_PTS_REF ldpm_pq_estim_id_maf_fac_ofs /end AXIS_DESCR
/end CHARACTERISTIC
/begin CHARACTERISTIC id_maf_fac_slop__pq_estim "Slope air flow function" CURVE 0xffe48838 _REC_CUR_20_u2_u2 8.880330000000001 _CNV_A_R_LINEAR_____377_CM 0. 8.880330000000001 DISPLAY_IDENTIFIER ID_MAF_FAC_SLOP__PQ_ESTIM FORMAT "%6.4"
 /begin AXIS_DESCR COM_AXIS pq_estim _CNV_A_R_LINEAR_____37_CM 16 0. 0.99998474 FORMAT "%7.5" AXIS_PTS_REF ldpm_pq_estim_id_maf_fac_ofs /end AXIS_DESCR
/end CHARACTERISTIC
/begin MEASUREMENT egr_ratio "MAF_EGR/MAF_CYL" UWORD _CNV_A_R_LINEAR_____8_CM 1 100. 0. 99.99847412 DISPLAY_IDENTIFIER EGR_RATIO ECU_ADDRESS 0x3fd254 BYTE_ORDER MSB_LAST /end MEASUREMENT
/begin MEASUREMENT lv_h_load_maf_thr "logical value for 'very high load'" UBYTE _CNV_S_2_RANGE______2_CM 1 100. 0. 1. DISPLAY_IDENTIFIER LV_H_LOAD_MAF_THR ECU_ADDRESS 0x3fe487 /end MEASUREMENT
/begin CHARACTERISTIC c_pq_thd "Calculation threshold for manifold pressure; typical value 0,9900 (FD70H)" VALUE 0xffe4187e _REC_VAL_20_u2 0.99998474 _CNV_A_R_LINEAR_____37_CM 0. 0.99998474 DISPLAY_IDENTIFIER C_PQ_THD FORMAT "%7.5" /end CHARACTERISTIC
/begin CHARACTERISTIC c_pq_thd_hys "hysteresis for calculation threshold for MAP and MAF" VALUE 0xffe41880 _REC_VAL_20_u2 0.99998474 _CNV_A_R_LINEAR_____37_CM 0. 0.99998474 DISPLAY_IDENTIFIER C_PQ_THD_HYS FORMAT "%7.5" /end CHARACTERISTIC
/begin MEASUREMENT pq_estim "" UWORD _CNV_A_R_LINEAR_____37_CM 1 100. 0. 0.99998474 DISPLAY_IDENTIFIER PQ_ESTIM ECU_ADDRESS 0x3fd28a BYTE_ORDER MSB_LAST FORMAT "%7.5" /end MEASUREMENT
/begin MEASUREMENT pq_isa_estim "estimated pressure quotient at idle speed actuator" UWORD _CNV_A_R_LINEAR_____37_CM 1 100. 0. 0.99998474 DISPLAY_IDENTIFIER PQ_ISA_ESTIM ECU_ADDRESS 0x3fd28c BYTE_ORDER MSB_LAST FORMAT "%7.5" /end MEASUREMENT
/begin MEASUREMENT map_estim "estimated manifold pressure" UWORD _CNV_A_R_LINEAR_____49_CM 1 100. 0. 5434. DISPLAY_IDENTIFIER MAP_ESTIM ECU_ADDRESS 0x3fd288 BYTE_ORDER MSB_LAST FORMAT "%7.2" /end MEASUREMENT
/begin CHARACTERISTIC c_ra "Error detection threshold for maximum deviation" VALUE 0xffe41894 _REC_VAL_20_u2 574. _CNV_A_R_LINEAR_____379_CM 0. 574. DISPLAY_IDENTIFIER C_RA FORMAT "%5.1" /end CHARACTERISTIC
/begin AXIS_PTS ldpm_maf_mes__vol_im "" 0xffe519cc maf_mes _REC_AXS_20_u2 1389. _CNV_A_R_LINEAR_____108_CM 6 0. 1389. DISPLAY_IDENTIFIER LDPM_MAF_MES__VOL_IM FORMAT "%7.2" /end AXIS_PTS
/begin CHARACTERISTIC ip_vol_im_neg "effective intake manifold volume at decreasing load in PL and ST" MAP 0xffe50896 _REC_MAP_20_u2_u2_u1 48.34583154310096 _CNV_A_R_LINEAR_____380_CM 3.68860679518273e-003 241.7328463223 DISPLAY_IDENTIFIER IP_VOL_IM_NEG FORMAT "%7.3"
 /begin AXIS_DESCR COM_AXIS maf_mes _CNV_A_R_LINEAR_____108_CM 6 0. 1389. FORMAT "%7.2" AXIS_PTS_REF ldpm_maf_mes__vol_im /end AXIS_DESCR
 /begin AXIS_DESCR COM_AXIS n_32 _CNV_A_R_LINEAR_____15_CM 8 0. 8160. FORMAT "%4.0" AXIS_PTS_REF ldpm_n_32__vol_im /end AXIS_DESCR
/end CHARACTERISTIC
/begin CHARACTERISTIC ip_vol_im_is "effective intake manifold volume at increasing load in IS, PU and PUC" MAP 0xffe50806 _REC_MAP_20_u2_u2_u1 48.34583154310096 _CNV_A_R_LINEAR_____380_CM 3.68860679518273e-003 241.7328463223 DISPLAY_IDENTIFIER IP_VOL_IM_IS FORMAT "%7.3"
 /begin AXIS_DESCR COM_AXIS maf_mes _CNV_A_R_LINEAR_____108_CM 6 0. 1389. FORMAT "%7.2" AXIS_PTS_REF ldpm_maf_mes__vol_im /end AXIS_DESCR
 /begin AXIS_DESCR COM_AXIS n_32 _CNV_A_R_LINEAR_____15_CM 6 0. 8160. FORMAT "%4.0" AXIS_PTS_REF ldpm_n_32__vol_im_is /end AXIS_DESCR
/end CHARACTERISTIC
/begin CHARACTERISTIC ip_vol_im "effective intake manifold volume at increasing load in PL and ST" MAP 0xffe507a6 _REC_MAP_20_u2_u2_u1 48.34583154310096 _CNV_A_R_LINEAR_____380_CM 3.68860679518273e-003 241.7328463223 DISPLAY_IDENTIFIER IP_VOL_IM FORMAT "%7.3"
 /begin AXIS_DESCR COM_AXIS maf_mes _CNV_A_R_LINEAR_____108_CM 6 0. 1389. FORMAT "%7.2" AXIS_PTS_REF ldpm_maf_mes__vol_im /end AXIS_DESCR
 /begin AXIS_DESCR COM_AXIS n_32 _CNV_A_R_LINEAR_____15_CM 8 0. 8160. FORMAT "%4.0" AXIS_PTS_REF ldpm_n_32__vol_im /end AXIS_DESCR
/end CHARACTERISTIC
/begin CHARACTERISTIC ip_vol_im_is_neg "effective intake manifold volume at decreasing load in IS, PU and PUC" MAP 0xffe5084e _REC_MAP_20_u2_u2_u1 48.34583154310096 _CNV_A_R_LINEAR_____380_CM 3.68860679518273e-003 241.7328463223 DISPLAY_IDENTIFIER IP_VOL_IM_IS_NEG FORMAT "%7.3"
 /begin AXIS_DESCR COM_AXIS maf_mes _CNV_A_R_LINEAR_____108_CM 6 0. 1389. FORMAT "%7.2" AXIS_PTS_REF ldpm_maf_mes__vol_im /end AXIS_DESCR
 /begin AXIS_DESCR COM_AXIS n_32 _CNV_A_R_LINEAR_____15_CM 6 0. 8160. FORMAT "%4.0" AXIS_PTS_REF ldpm_n_32__vol_im_is /end AXIS_DESCR
/end CHARACTERISTIC
/begin MEASUREMENT maf "Air mass (predicted) for calculation of basic fuel injection" UWORD _CNV_A_R_LINEAR_____108_CM 1 100. 0. 1389. DISPLAY_IDENTIFIER MAF ECU_ADDRESS 0x3fd240 BYTE_ORDER MSB_LAST FORMAT "%6.2" /end MEASUREMENT
/begin MEASUREMENT vol_im "effective intake manifold volume" UWORD _CNV_A_R_LINEAR_____380_CM 1 100. 3.68860679518273e-003 241.7328463223 DISPLAY_IDENTIFIER VOL_IM ECU_ADDRESS 0x3fd29a BYTE_ORDER MSB_LAST FORMAT "%7.3" /end MEASUREMENT
/begin AXIS_PTS ldpm_n_32__vol_im "" 0xffe48514 n_32 _REC_AXS_20_u1 8160. _CNV_A_R_LINEAR_____15_CM 8 0. 8160. DISPLAY_IDENTIFIER LDPM_N_32__VOL_IM FORMAT "%4.0" /end AXIS_PTS
/begin AXIS_PTS ldpm_n_32__vol_im_is "" 0xffe413ca n_32 _REC_AXS_20_u1 8160. _CNV_A_R_LINEAR_____15_CM 6 0. 8160. DISPLAY_IDENTIFIER LDPM_N_32__VOL_IM_IS FORMAT "%4.0" /end AXIS_PTS
/begin CHARACTERISTIC c_maf_mmv_hys "Threshold for detecting raising MAF_MMV" VALUE 0xffe417c8 _REC_VAL_20_u2 694.5 _CNV_A_R_LINEAR_____381_CM 0. 694.5 DISPLAY_IDENTIFIER C_MAF_MMV_HYS FORMAT "%6.2" /end CHARACTERISTIC
/begin MEASUREMENT maf_mmv "MAF moving mean value" UWORD _CNV_A_R_LINEAR_____108_CM 1 100. 0. 1389. DISPLAY_IDENTIFIER MAF_MMV ECU_ADDRESS 0x3fd26c BYTE_ORDER MSB_LAST FORMAT "%6.2" /end MEASUREMENT
/begin AXIS_PTS ldp_pq__ip_pq_isa "" 0xffe511c2 online_dummy _REC_AXS_20_u2 0.99998474 _CNV_A_R_LINEAR_____37_CM 16 0. 0.99998474 DISPLAY_IDENTIFIER LDP_PQ__IP_PQ_ISA FORMAT "%7.5" /end AXIS_PTS
/begin AXIS_PTS ldp_ar_red__ip_pq_isa "" 0xffe50a1e online_dummy _REC_AXS_20_u2 58.592855 _CNV_A_R_LINEAR_____382_CM 8 0. 58.592855 DISPLAY_IDENTIFIER LDP_AR_RED__IP_PQ_ISA FORMAT "%7.4" /end AXIS_PTS
/begin CHARACTERISTIC ip_pq_isa "correction map for pressure quotient at ISA" MAP 0xffe4dcea _REC_MAP_20_u2_u2_u2 0.99998474 _CNV_A_R_LINEAR_____37_CM 0. 0.99998474 DISPLAY_IDENTIFIER IP_PQ_ISA FORMAT "%7.5"
 /begin AXIS_DESCR COM_AXIS online_dummy _CNV_A_R_LINEAR_____37_CM 16 0. 0.99998474 FORMAT "%7.5" AXIS_PTS_REF ldp_pq__ip_pq_isa /end AXIS_DESCR
 /begin AXIS_DESCR COM_AXIS online_dummy _CNV_A_R_LINEAR_____382_CM 8 0. 58.592855 FORMAT "%7.4" AXIS_PTS_REF ldp_ar_red__ip_pq_isa /end AXIS_DESCR
/end CHARACTERISTIC
/begin MEASUREMENT t_seg_imm "segment-time for intake manifold model" UWORD _CNV_A_R_LINEAR_____165_CM 1 100. 0. 262.14 DISPLAY_IDENTIFIER T_SEG_IMM ECU_ADDRESS 0x3fd276 BYTE_ORDER MSB_LAST FORMAT "%7.3" /end MEASUREMENT
/begin CHARACTERISTIC ip_t_vim_eff_vol "transition time volumetric efficiency at VIM switching" CURVE 0xffe40e6c _REC_CUR_20_u1_u1 2.55 _CNV_A_R_LINEAR_____4_CM 0. 2.55 DISPLAY_IDENTIFIER IP_T_VIM_EFF_VOL FORMAT "%4.2"
 /begin AXIS_DESCR COM_AXIS n_32 _CNV_A_R_LINEAR_____15_CM 2 0. 8160. FORMAT "%4.0" AXIS_PTS_REF ldp_n_32__ip_t_vim_eff_vol /end AXIS_DESCR
/end CHARACTERISTIC
/begin AXIS_PTS ldp_n_32__ip_t_vim_eff_vol "" 0xffe4109c n_32 _REC_AXS_20_u1 8160. _CNV_A_R_LINEAR_____15_CM 2 0. 8160. DISPLAY_IDENTIFIER LDP_N_32__IP_T_VIM_EFF_VOL FORMAT "%4.0" /end AXIS_PTS
/begin CHARACTERISTIC ip_eff_vol_slop_cam_in_vim " Slope of the cylinder air-mass flow dependant on intake cam phasing, VIM_AV = 100%" MAP 0xffe4a61e _REC_MAP_20_u2_u2_u2 12.05964 _CNV_A_R_LINEAR_____395_CM -6.029912009 6.029727991 DISPLAY_IDENTIFIER IP_EFF_VOL_SLOP_CAM_IN_VIM FORMAT "%7.4"
 /begin AXIS_DESCR COM_AXIS n _CNV_A_R_LINEAR_____10_CM 18 0. 8160. FORMAT "%4.0" AXIS_PTS_REF ldpm_n__eff_vol /end AXIS_DESCR
 /begin AXIS_DESCR COM_AXIS cam_av_mv_in _CNV_A_R_LINEAR_____396_CM 12 -768. 767.9765625 FORMAT "%7.2" AXIS_PTS_REF ldpm_cam_av_mv_in__eff_vol /end AXIS_DESCR
/end CHARACTERISTIC
/begin CHARACTERISTIC ip_eff_vol_slop_cam_vo_vim "Slope of the cylinder air-mass flow dependant on valve overlap, VIM_AV = 100%" MAP 0xffe4a97e _REC_MAP_20_u2_u2_u1 12.05964 _CNV_A_R_LINEAR_____395_CM -6.029912009 6.029727991 DISPLAY_IDENTIFIER IP_EFF_VOL_SLOP_CAM_VO_VIM FORMAT "%7.4"
 /begin AXIS_DESCR COM_AXIS n _CNV_A_R_LINEAR_____10_CM 18 0. 8160. FORMAT "%4.0" AXIS_PTS_REF ldpm_n__eff_vol /end AXIS_DESCR
 /begin AXIS_DESCR COM_AXIS vo _CNV_A_R_LINEAR_____82_CM 12 0. 95.625 FORMAT "%5.2" AXIS_PTS_REF ldpm_vo__eff_vol /end AXIS_DESCR
/end CHARACTERISTIC
/begin CHARACTERISTIC ip_eff_vol_ofs_vim "Offset of the cylinder air-mass flow, VIM_AV = 100%" MAP 0xffe4a2b2 _REC_MAP_20_u2_u2_u1 2047.96875 _CNV_A_R_LINEAR_____115_CM 0. 2047.96875 DISPLAY_IDENTIFIER IP_EFF_VOL_OFS_VIM FORMAT "%6.2"
 /begin AXIS_DESCR COM_AXIS n _CNV_A_R_LINEAR_____10_CM 18 0. 8160. FORMAT "%4.0" AXIS_PTS_REF ldpm_n__eff_vol /end AXIS_DESCR
 /begin AXIS_DESCR COM_AXIS vo _CNV_A_R_LINEAR_____82_CM 12 0. 95.625 FORMAT "%5.2" AXIS_PTS_REF ldpm_vo__eff_vol /end AXIS_DESCR
/end CHARACTERISTIC
/begin MEASUREMENT eff_vol_slop "slope of the volumetric efficiency" UWORD _CNV_A_R_LINEAR_____397_CM 1 100. 0. 12.05964 DISPLAY_IDENTIFIER EFF_VOL_SLOP ECU_ADDRESS 0x3fd30a BYTE_ORDER MSB_LAST FORMAT "%7.4" /end MEASUREMENT
/begin CHARACTERISTIC ip_eff_vol_ofs "Offset of the cylinder air-mass flow, VIM_AV = 0%" MAP 0xffe4a0d2 _REC_MAP_20_u2_u2_u1 2047.96875 _CNV_A_R_LINEAR_____115_CM 0. 2047.96875 DISPLAY_IDENTIFIER IP_EFF_VOL_OFS FORMAT "%6.2"
 /begin AXIS_DESCR COM_AXIS n _CNV_A_R_LINEAR_____10_CM 18 0. 8160. FORMAT "%4.0" AXIS_PTS_REF ldpm_n__eff_vol /end AXIS_DESCR
 /begin AXIS_DESCR COM_AXIS vo _CNV_A_R_LINEAR_____82_CM 12 0. 95.625 FORMAT "%5.2" AXIS_PTS_REF ldpm_vo__eff_vol /end AXIS_DESCR
/end CHARACTERISTIC
/begin CHARACTERISTIC ip_eff_vol_ofs_amp "Ambient pressure correction of the offset cylinder mass air flow" CURVE 0xffe4a282 _REC_CUR_20_u2_u2 1.99996948 _CNV_A_R_LINEAR_____20_CM 0. 1.99996948 DISPLAY_IDENTIFIER IP_EFF_VOL_OFS_AMP FORMAT "%7.5"
 /begin AXIS_DESCR COM_AXIS amp _CNV_A_R_LINEAR_____49_CM 6 0. 5434. FORMAT "%7.2" AXIS_PTS_REF ldpm_amp__eff_vol_amp /end AXIS_DESCR
/end CHARACTERISTIC
/begin CHARACTERISTIC ip_amp_dec__maf_cyl "pressure decrease in the air cleaner ( max. Value 100 hPa)" CURVE 0xffe41c0e _REC_CUR_20_u2_u2 5434. _CNV_A_R_LINEAR_____49_CM 0. 5434. DISPLAY_IDENTIFIER IP_AMP_DEC__MAF_CYL FORMAT "%7.2"
 /begin AXIS_DESCR COM_AXIS maf_cyl _CNV_A_R_LINEAR_____115_CM 4 0. 2047.96875 FORMAT "%6.2" AXIS_PTS_REF ldp_maf_cyl_amp_dec /end AXIS_DESCR
/end CHARACTERISTIC
/begin CHARACTERISTIC lc_amp_inp_ena "Default logical variable enabled for the input of the airfilter" VALUE 0xffe40f38 _REC_VAL_20_u1 1. _CNV_S_2_RANGE______2_CM 0. 1. DISPLAY_IDENTIFIER LC_AMP_INP_ENA /end CHARACTERISTIC
/begin MEASUREMENT prs_up_thr "Pressure upstream the throttle" UWORD _CNV_A_R_LINEAR_____49_CM 1 100. 0. 5434. DISPLAY_IDENTIFIER PRS_UP_THR ECU_ADDRESS 0x3fd304 BYTE_ORDER MSB_LAST FORMAT "%7.2" /end MEASUREMENT
/begin CHARACTERISTIC c_tcyl_stnd "standard temperature in cylinder" VALUE 0xffe4093d _REC_VAL_20_u1 28.575 _CNV_A_R_LINEAR_____11_CM -48. 142.5 DISPLAY_IDENTIFIER C_TCYL_STND FORMAT "%5.1" /end CHARACTERISTIC
/begin CHARACTERISTIC c_tco_stnd "standard coolant temperature" VALUE 0xffe4092a _REC_VAL_20_u1 28.575 _CNV_A_R_LINEAR_____11_CM -48. 142.5 DISPLAY_IDENTIFIER C_TCO_STND FORMAT "%5.1" /end CHARACTERISTIC
/begin CHARACTERISTIC c_tia_im_stnd "standard intake air temperature" VALUE 0xffe4095e _REC_VAL_20_u1 28.575 _CNV_A_R_LINEAR_____11_CM -48. 142.5 DISPLAY_IDENTIFIER C_TIA_IM_STND FORMAT "%5.1" /end CHARACTERISTIC
/begin MEASUREMENT prs_up_thr_max "Maximum pressure upstream the throttle" UWORD _CNV_A_R_LINEAR_____49_CM 1 100. 0. 5434. DISPLAY_IDENTIFIER PRS_UP_THR_MAX ECU_ADDRESS 0x3fd306 BYTE_ORDER MSB_LAST FORMAT "%7.2" /end MEASUREMENT
/begin MEASUREMENT eff_vol_temp_cor "volumetric efficiency correction factor due to temperature effects" UWORD _CNV_A_R_LINEAR_____20_CM 1 100. 0. 1.99996948 DISPLAY_IDENTIFIER EFF_VOL_TEMP_COR ECU_ADDRESS 0x3fd318 BYTE_ORDER MSB_LAST FORMAT "%7.5" /end MEASUREMENT
/begin MEASUREMENT eff_vol_temp_cor_mmv "filtered volumetric efficiency correction factor due to temperature effects" UWORD _CNV_A_R_LINEAR_____20_CM 1 100. 0. 1.99996948 DISPLAY_IDENTIFIER EFF_VOL_TEMP_COR_MMV ECU_ADDRESS 0x3fd31a BYTE_ORDER MSB_LAST FORMAT "%7.5" /end MEASUREMENT
/begin CHARACTERISTIC ip_eff_vol_slop_cam_vo "Slope of the cylinder air-mass flow dependant on valve overlap, VIM_AV = 0%" MAP 0xffe4a7ce _REC_MAP_20_u2_u2_u1 12.05964 _CNV_A_R_LINEAR_____395_CM -6.029912009 6.029727991 DISPLAY_IDENTIFIER IP_EFF_VOL_SLOP_CAM_VO FORMAT "%7.4"
 /begin AXIS_DESCR COM_AXIS n _CNV_A_R_LINEAR_____10_CM 18 0. 8160. FORMAT "%4.0" AXIS_PTS_REF ldpm_n__eff_vol /end AXIS_DESCR
 /begin AXIS_DESCR COM_AXIS vo _CNV_A_R_LINEAR_____82_CM 12 0. 95.625 FORMAT "%5.2" AXIS_PTS_REF ldpm_vo__eff_vol /end AXIS_DESCR
/end CHARACTERISTIC
/begin CHARACTERISTIC ip_eff_vol_slop_cam_in "Slope of the cylinder air-mass flow dependant on intake cam phasing, VIM_AV = 0%" MAP 0xffe4a46e _REC_MAP_20_u2_u2_u2 12.05964 _CNV_A_R_LINEAR_____395_CM -6.029912009 6.029727991 DISPLAY_IDENTIFIER IP_EFF_VOL_SLOP_CAM_IN FORMAT "%7.4"
 /begin AXIS_DESCR COM_AXIS n _CNV_A_R_LINEAR_____10_CM 18 0. 8160. FORMAT "%4.0" AXIS_PTS_REF ldpm_n__eff_vol /end AXIS_DESCR
 /begin AXIS_DESCR COM_AXIS cam_av_mv_in _CNV_A_R_LINEAR_____396_CM 12 -768. 767.9765625 FORMAT "%7.2" AXIS_PTS_REF ldpm_cam_av_mv_in__eff_vol /end AXIS_DESCR
/end CHARACTERISTIC
/begin CHARACTERISTIC ip_crlc_eff_vol_temp_cor "Volumetric efficiency filtering" CURVE 0xffe40adf _REC_CUR_20_u1_u1 0.9960940000000002 _CNV_A_R_LINEAR_____50_CM 0. 0.996094 DISPLAY_IDENTIFIER IP_CRLC_EFF_VOL_TEMP_COR FORMAT "%5.3"
 /begin AXIS_DESCR COM_AXIS n_32 _CNV_A_R_LINEAR_____15_CM 6 0. 8160. FORMAT "%4.0" AXIS_PTS_REF ldp_n_32_ip_crlc_eff_vol_temp /end AXIS_DESCR
/end CHARACTERISTIC
/begin CHARACTERISTIC ip_eff_tco_fac__n_32__maf "Volumetric efficiency weighting factor versus cooling temperature" MAP 0xffe44f2e _REC_MAP_20_u1_u1_u2 0.9960940000000002 _CNV_A_R_LINEAR_____50_CM 0. 0.996094 DISPLAY_IDENTIFIER IP_EFF_TCO_FAC__N_32__MAF FORMAT "%5.3"
 /begin AXIS_DESCR COM_AXIS n_32 _CNV_A_R_LINEAR_____15_CM 8 0. 8160. FORMAT "%4.0" AXIS_PTS_REF ldpm_n_32__eff_vol_cor /end AXIS_DESCR
 /begin AXIS_DESCR COM_AXIS maf _CNV_A_R_LINEAR_____108_CM 8 0. 1389. FORMAT "%7.2" AXIS_PTS_REF ldpm_maf__eff_vol_cor /end AXIS_DESCR
/end CHARACTERISTIC
/begin CHARACTERISTIC ip_eff_tia_im_fac__n_32__maf "Volumetric effiency weighting factor versus intake manifold gas temperature" MAP 0xffe44f6e _REC_MAP_20_u1_u1_u2 0.9960940000000002 _CNV_A_R_LINEAR_____50_CM 0. 0.996094 DISPLAY_IDENTIFIER IP_EFF_TIA_IM_FAC__N_32__MAF FORMAT "%5.3"
 /begin AXIS_DESCR COM_AXIS n_32 _CNV_A_R_LINEAR_____15_CM 8 0. 8160. FORMAT "%4.0" AXIS_PTS_REF ldpm_n_32__eff_vol_cor /end AXIS_DESCR
 /begin AXIS_DESCR COM_AXIS maf _CNV_A_R_LINEAR_____108_CM 8 0. 1389. FORMAT "%7.2" AXIS_PTS_REF ldpm_maf__eff_vol_cor /end AXIS_DESCR
/end CHARACTERISTIC
/begin CHARACTERISTIC ip_eff_vol_slop_amp "Ambient pressure correction of the slope cylinder mass air flow" CURVE 0xffe4a462 _REC_CUR_20_u2_u2 1.99996948 _CNV_A_R_LINEAR_____20_CM 0. 1.99996948 DISPLAY_IDENTIFIER IP_EFF_VOL_SLOP_AMP FORMAT "%7.5"
 /begin AXIS_DESCR COM_AXIS amp _CNV_A_R_LINEAR_____49_CM 6 0. 5434. FORMAT "%7.2" AXIS_PTS_REF ldpm_amp__eff_vol_amp /end AXIS_DESCR
/end CHARACTERISTIC
/begin CHARACTERISTIC ip_eff_vol_ofs_max "Offset of gasflow into cylinder at WOT and standard conditions" CURVE 0xffe4a28e _REC_CUR_20_u2_u2 2047.96875 _CNV_A_R_LINEAR_____115_CM 0. 2047.96875 DISPLAY_IDENTIFIER IP_EFF_VOL_OFS_MAX FORMAT "%7.2"
 /begin AXIS_DESCR COM_AXIS n _CNV_A_R_LINEAR_____10_CM 18 0. 8160. FORMAT "%4.0" AXIS_PTS_REF ldpm_n__eff_vol /end AXIS_DESCR
/end CHARACTERISTIC
/begin CHARACTERISTIC ip_eff_vol_slop_max "Slope of gasflow into cylinder at WOT and standard conditions" CURVE 0xffe4ab2e _REC_CUR_20_u2_u2 12.05964 _CNV_A_R_LINEAR_____397_CM 0. 12.05964 DISPLAY_IDENTIFIER IP_EFF_VOL_SLOP_MAX FORMAT "%7.4"
 /begin AXIS_DESCR COM_AXIS n _CNV_A_R_LINEAR_____10_CM 18 0. 8160. FORMAT "%4.0" AXIS_PTS_REF ldpm_n__eff_vol /end AXIS_DESCR
/end CHARACTERISTIC
/begin MEASUREMENT eff_vol_ofs_max_cor "max possible offset of the volumetric efficiency" UWORD _CNV_A_R_LINEAR_____115_CM 1 100. 0. 2047.96875 DISPLAY_IDENTIFIER EFF_VOL_OFS_MAX_COR ECU_ADDRESS 0x3fd30c BYTE_ORDER MSB_LAST FORMAT "%7.2" /end MEASUREMENT
/begin MEASUREMENT eff_vol_ofs "offset of the volumetric efficiency" UWORD _CNV_A_R_LINEAR_____115_CM 1 100. 0. 2047.96875 DISPLAY_IDENTIFIER EFF_VOL_OFS ECU_ADDRESS 0x3fd308 BYTE_ORDER MSB_LAST FORMAT "%7.2" /end MEASUREMENT
/begin MEASUREMENT eff_vol_slop_max_cor "max possible slope of the volumetric efficiency" UWORD _CNV_A_R_LINEAR_____397_CM 1 100. 0. 12.05964 DISPLAY_IDENTIFIER EFF_VOL_SLOP_MAX_COR ECU_ADDRESS 0x3fd30e BYTE_ORDER MSB_LAST FORMAT "%7.4" /end MEASUREMENT
/begin AXIS_PTS ldp_maf_cyl_amp_dec "" 0xffe50d3c maf_cyl _REC_AXS_20_u2 2047.96875 _CNV_A_R_LINEAR_____115_CM 4 0. 2047.96875 DISPLAY_IDENTIFIER LDP_MAF_CYL_AMP_DEC FORMAT "%6.2" /end AXIS_PTS
/begin AXIS_PTS ldpm_vo__eff_vol "" 0xffe4871c vo _REC_AXS_20_u1 95.625 _CNV_A_R_LINEAR_____82_CM 12 0. 95.625 DISPLAY_IDENTIFIER LDPM_VO__EFF_VOL FORMAT "%5.2" /end AXIS_PTS
/begin AXIS_PTS ldp_n_32_ip_crlc_eff_vol_temp "" 0xffe410e6 n_32 _REC_AXS_20_u1 8160. _CNV_A_R_LINEAR_____15_CM 6 0. 8160. DISPLAY_IDENTIFIER LDP_N_32_IP_CRLC_EFF_VOL_TEMP FORMAT "%4.0" /end AXIS_PTS
/begin AXIS_PTS ldpm_amp__eff_vol_amp "" 0xffe51736 amp _REC_AXS_20_u2 5434. _CNV_A_R_LINEAR_____49_CM 6 0. 5434. DISPLAY_IDENTIFIER LDPM_AMP__EFF_VOL_AMP FORMAT "%7.2" /end AXIS_PTS
/begin AXIS_PTS ldpm_n_32__eff_vol_cor "" 0xffe484c4 n_32 _REC_AXS_20_u1 8160. _CNV_A_R_LINEAR_____15_CM 8 0. 8160. DISPLAY_IDENTIFIER LDPM_N_32__EFF_VOL_COR FORMAT "%4.0" /end AXIS_PTS
/begin AXIS_PTS ldpm_maf__eff_vol_cor "" 0xffe51916 maf _REC_AXS_20_u2 1389. _CNV_A_R_LINEAR_____108_CM 8 0. 1389. DISPLAY_IDENTIFIER LDPM_MAF__EFF_VOL_COR FORMAT "%7.2" /end AXIS_PTS
/begin AXIS_PTS ldpm_n__eff_vol "" 0xffe51afa n _REC_AXS_20_u2 8160. _CNV_A_R_LINEAR_____10_CM 18 0. 8160. DISPLAY_IDENTIFIER LDPM_N__EFF_VOL FORMAT "%4.0" /end AXIS_PTS
/begin AXIS_PTS ldpm_cam_av_mv_in__eff_vol "" 0xffe51752 cam_av_mv_in _REC_AXS_20_u2 1535.9765625 _CNV_A_R_LINEAR_____396_CM 12 -768. 767.9765625 DISPLAY_IDENTIFIER LDPM_CAM_AV_MV_IN__EFF_VOL FORMAT "%7.2" /end AXIS_PTS
/begin MEASUREMENT eff_vol_ofs_bas "Basic total value volumetric efficiency - offset" UWORD _CNV_A_R_LINEAR_____115_CM 1 100. 0. 2047.96875 DISPLAY_IDENTIFIER EFF_VOL_OFS_BAS ECU_ADDRESS 0x3fd320 BYTE_ORDER MSB_LAST FORMAT "%7.2" /end MEASUREMENT
/begin MEASUREMENT eff_vol_slop_bas "Basic total value  volumetric efficiency - slope" UWORD _CNV_A_R_LINEAR_____397_CM 1 100. 0. 12.05964 DISPLAY_IDENTIFIER EFF_VOL_SLOP_BAS ECU_ADDRESS 0x3fd322 BYTE_ORDER MSB_LAST FORMAT "%7.4" /end MEASUREMENT
/begin MEASUREMENT eff_vol_ofs_bas_goal "Basic goal value volumetric efficiency - offset" UWORD _CNV_A_R_LINEAR_____115_CM 1 100. 0. 2047.96875 DISPLAY_IDENTIFIER EFF_VOL_OFS_BAS_GOAL ECU_ADDRESS 0x3fd324 BYTE_ORDER MSB_LAST FORMAT "%7.2" /end MEASUREMENT
/begin MEASUREMENT eff_vol_slop_bas_goal "Basic goal value  volumetric efficiency - slope" UWORD _CNV_A_R_LINEAR_____397_CM 1 100. 0. 12.05964 DISPLAY_IDENTIFIER EFF_VOL_SLOP_BAS_GOAL ECU_ADDRESS 0x3fd326 BYTE_ORDER MSB_LAST FORMAT "%7.4" /end MEASUREMENT
/begin MEASUREMENT eff_vol_ofs_bas_0 "Basic value volumetric efficiency for VIM position 0 - offset" UWORD _CNV_A_R_LINEAR_____115_CM 1 100. 0. 2047.96875 DISPLAY_IDENTIFIER EFF_VOL_OFS_BAS_0 ECU_ADDRESS 0x3fd32c BYTE_ORDER MSB_LAST FORMAT "%7.2" /end MEASUREMENT
/begin MEASUREMENT eff_vol_slop_bas_0 "Basic value  volumetric efficiency for VIM position 0 - slope" UWORD _CNV_A_R_LINEAR_____397_CM 1 100. 0. 12.05964 DISPLAY_IDENTIFIER EFF_VOL_SLOP_BAS_0 ECU_ADDRESS 0x3fd32e BYTE_ORDER MSB_LAST FORMAT "%7.4" /end MEASUREMENT
/begin MEASUREMENT eff_vol_ofs_bas_1 "Basic value volumetric efficiency for VIM position 1 - offset" UWORD _CNV_A_R_LINEAR_____115_CM 1 100. 0. 2047.96875 DISPLAY_IDENTIFIER EFF_VOL_OFS_BAS_1 ECU_ADDRESS 0x3fd330 BYTE_ORDER MSB_LAST FORMAT "%7.2" /end MEASUREMENT
/begin MEASUREMENT eff_vol_slop_bas_1 "Basic value  volumetric efficiency for VIM position 1 - slope" UWORD _CNV_A_R_LINEAR_____397_CM 1 100. 0. 12.05964 DISPLAY_IDENTIFIER EFF_VOL_SLOP_BAS_1 ECU_ADDRESS 0x3fd332 BYTE_ORDER MSB_LAST FORMAT "%7.4" /end MEASUREMENT
/begin CHARACTERISTIC c_n_dif_crlc "Correlation factor for N_DIF_MMV calculation" VALUE 0xffe407d9 _REC_VAL_20_u1 0.9960940000000002 _CNV_A_R_LINEAR_____50_CM 0. 0.996094 DISPLAY_IDENTIFIER C_N_DIF_CRLC FORMAT "%5.3" /end CHARACTERISTIC
/begin CHARACTERISTIC c_n_dif_min_mmv "Minimum filtering constant" VALUE 0xffe4047e _REC_VAL_20_s2 408. _CNV_A_R_LINEAR_____10_CM -4080. 0. DISPLAY_IDENTIFIER C_N_DIF_MIN_MMV FORMAT "%6.0" /end CHARACTERISTIC
/begin MEASUREMENT n_dif_cor "Idle speed control value" SWORD _CNV_A_R_LINEAR_____10_CM 1 100. -4096. 4064. DISPLAY_IDENTIFIER N_DIF_COR ECU_ADDRESS 0x3fd5c0 BYTE_ORDER MSB_LAST FORMAT "%4.0" /end MEASUREMENT
/begin MEASUREMENT n_dif_mmv "N_DIF moving mean value" SWORD _CNV_A_R_LINEAR_____10_CM 1 100. -8160. 8160. DISPLAY_IDENTIFIER N_DIF_MMV ECU_ADDRESS 0x3fd5c4 BYTE_ORDER MSB_LAST FORMAT "%4.0" /end MEASUREMENT
/begin MEASUREMENT n_max_tol_st "Top level end of start engine speed" UBYTE _CNV_A_R_LINEAR_____15_CM 1 100. 0. 8160. DISPLAY_IDENTIFIER N_MAX_TOL_ST ECU_ADDRESS 0x3fe5c3 FORMAT "%4.0" /end MEASUREMENT
/begin CHARACTERISTIC c_n_dif_fac "Weighting factor for the idle speed variable controller" VALUE 0xffe407da _REC_VAL_20_u1 0.9960940000000002 _CNV_A_R_LINEAR_____50_CM 0. 0.996094 DISPLAY_IDENTIFIER C_N_DIF_FAC FORMAT "%5.3" /end CHARACTERISTIC
/begin CHARACTERISTIC ip_dri_acin_n_sp_is "Nominal idle speed with DRIVE (A/T) engaged and air conditioner switched on" CURVE 0xffe49f56 _REC_CUR_20_u2_u1 8160. _CNV_A_R_LINEAR_____10_CM 0. 8160. DISPLAY_IDENTIFIER IP_DRI_ACIN_N_SP_IS FORMAT "%4.0"
 /begin AXIS_DESCR COM_AXIS tco _CNV_A_R_LINEAR_____11_CM 8 -48. 142.5 FORMAT "%5.1" AXIS_PTS_REF ldpm_tco_n_sp_1 /end AXIS_DESCR
/end CHARACTERISTIC
/begin MEASUREMENT n_dif_st "Engine speed deviation N_MAX_TOL_ST - N" SWORD _CNV_A_R_LINEAR_____10_CM 1 100. -32768. 32767. DISPLAY_IDENTIFIER N_DIF_ST ECU_ADDRESS 0x3fd5c2 BYTE_ORDER MSB_LAST FORMAT "%6.0" /end MEASUREMENT
/begin MEASUREMENT n_sp_is_ratio "Ratio actual engine speed versus engine speed setpoint at idle" UWORD _CNV_A_R_LINEAR_____394_CM 1 100. 0. 7.99987793 DISPLAY_IDENTIFIER N_SP_IS_RATIO ECU_ADDRESS 0x3fd5c6 BYTE_ORDER MSB_LAST FORMAT "%6.4" /end MEASUREMENT
/begin CHARACTERISTIC ip_dri_n_sp_is "Nominal idle speed with DRIVE  (A/T) engaged" CURVE 0xffe49fe6 _REC_CUR_20_u2_u1 8160. _CNV_A_R_LINEAR_____10_CM 0. 8160. DISPLAY_IDENTIFIER IP_DRI_N_SP_IS FORMAT "%4.0"
 /begin AXIS_DESCR COM_AXIS tco _CNV_A_R_LINEAR_____11_CM 8 -48. 142.5 FORMAT "%5.1" AXIS_PTS_REF ldpm_tco_n_sp_1 /end AXIS_DESCR
/end CHARACTERISTIC
/begin CHARACTERISTIC ip_n_sp_is_lih "Idle speed setpoint in case of limp home" CURVE 0xffe4d742 _REC_CUR_20_u2_u1 8160. _CNV_A_R_LINEAR_____10_CM 0. 8160. DISPLAY_IDENTIFIER IP_N_SP_IS_LIH FORMAT "%4.0"
 /begin AXIS_DESCR COM_AXIS tco _CNV_A_R_LINEAR_____11_CM 8 -48. 142.5 FORMAT "%5.1" AXIS_PTS_REF ldpm_tco_n_sp_1 /end AXIS_DESCR
/end CHARACTERISTIC
/begin CHARACTERISTIC ip_dri_n_sp_is_lih "Idle speed setpoint in case of limp home and engaged drivetrain" CURVE 0xffe49ff6 _REC_CUR_20_u2_u1 8160. _CNV_A_R_LINEAR_____10_CM 0. 8160. DISPLAY_IDENTIFIER IP_DRI_N_SP_IS_LIH FORMAT "%4.0"
 /begin AXIS_DESCR COM_AXIS tco _CNV_A_R_LINEAR_____11_CM 8 -48. 142.5 FORMAT "%5.1" AXIS_PTS_REF ldpm_tco_n_sp_1 /end AXIS_DESCR
/end CHARACTERISTIC
/begin CHARACTERISTIC ip_n_sp_is "Nominal idle speed without additional load on the engine" CURVE 0xffe4d712 _REC_CUR_20_u2_u1 8160. _CNV_A_R_LINEAR_____10_CM 0. 8160. DISPLAY_IDENTIFIER IP_N_SP_IS FORMAT "%4.0"
 /begin AXIS_DESCR COM_AXIS tco _CNV_A_R_LINEAR_____11_CM 8 -48. 142.5 FORMAT "%5.1" AXIS_PTS_REF ldpm_tco_n_sp_1 /end AXIS_DESCR
/end CHARACTERISTIC
/begin MEASUREMENT n_dif "Engine speed deviation N_SP_IS_N" SWORD _CNV_A_R_LINEAR_____10_CM 1 100. -4096. 4064. DISPLAY_IDENTIFIER N_DIF ECU_ADDRESS 0x3fd5be BYTE_ORDER MSB_LAST FORMAT "%4.0" /end MEASUREMENT
/begin MEASUREMENT n_sp_is_pow "Active nominal idle speed setpoint by power management active" UWORD _CNV_A_R_LINEAR_____10_CM 1 100. 0. 8160. DISPLAY_IDENTIFIER N_SP_IS_POW ECU_ADDRESS 0x3fd5ca BYTE_ORDER MSB_LAST FORMAT "%4.0" /end MEASUREMENT
/begin MEASUREMENT n_sp_is_ch "idle speed setpoint for CAT heating" UWORD _CNV_A_R_LINEAR_____10_CM 1 100. 0. 8160. DISPLAY_IDENTIFIER N_SP_IS_CH ECU_ADDRESS 0x3fd5c8 BYTE_ORDER MSB_LAST FORMAT "%4.0" /end MEASUREMENT
/begin MEASUREMENT n_sp_is_2 "basis idle speed setpoint" UWORD _CNV_A_R_LINEAR_____10_CM 1 100. 0. 8160. DISPLAY_IDENTIFIER N_SP_IS_2 ECU_ADDRESS 0x3fd5bc BYTE_ORDER MSB_LAST FORMAT "%4.0" /end MEASUREMENT
/begin MEASUREMENT n_sp_is_3 "greatest of all idle speed setpoints" UWORD _CNV_A_R_LINEAR_____10_CM 1 100. 0. 8160. DISPLAY_IDENTIFIER N_SP_IS_3 ECU_ADDRESS 0x3fd5cc BYTE_ORDER MSB_LAST FORMAT "%4.0" /end MEASUREMENT
/begin MEASUREMENT lv_req_heat_n_sp_is "LV Idle Speed setpoint required from heating control unit" UBYTE _CNV_S_2_RANGE______2_CM 1 100. 0. 1. DISPLAY_IDENTIFIER LV_REQ_HEAT_N_SP_IS ECU_ADDRESS 0x3fe5c5 /end MEASUREMENT
/begin CHARACTERISTIC ip_acin_n_sp_is "Nominal idle speed with air conditioner switched on" CURVE 0xffe48ecc _REC_CUR_20_u2_u1 8160. _CNV_A_R_LINEAR_____10_CM 0. 8160. DISPLAY_IDENTIFIER IP_ACIN_N_SP_IS FORMAT "%4.0"
 /begin AXIS_DESCR COM_AXIS tco _CNV_A_R_LINEAR_____11_CM 8 -48. 142.5 FORMAT "%5.1" AXIS_PTS_REF ldpm_tco_n_sp_1 /end AXIS_DESCR
/end CHARACTERISTIC
/begin CHARACTERISTIC ip_fac_n_sp_ofs_kwp "TCO factor for N_SP_OFS_KWP" CURVE 0xffe40bb9 _REC_CUR_20_u1_u1 0.99610001 _CNV_A_R_LINEAR_____29_CM 0. 0.99610001 DISPLAY_IDENTIFIER IP_FAC_N_SP_OFS_KWP FORMAT "%5.3"
 /begin AXIS_DESCR COM_AXIS tco _CNV_A_R_LINEAR_____11_CM 8 -48. 142.5 FORMAT "%5.1" AXIS_PTS_REF ldpm_tco_n_sp_1 /end AXIS_DESCR
/end CHARACTERISTIC
/begin CHARACTERISTIC ip_dri_n_sp_ch "Max. idle speed during CAT heating with drive engaged" MAP 0xffe49f66 _REC_MAP_20_u2_u1_u2 8160. _CNV_A_R_LINEAR_____10_CM 0. 8160. DISPLAY_IDENTIFIER IP_DRI_N_SP_CH FORMAT "%4.0"
 /begin AXIS_DESCR COM_AXIS tco _CNV_A_R_LINEAR_____11_CM 8 -48. 142.5 FORMAT "%5.1" AXIS_PTS_REF ldpm_tco_n_sp_2 /end AXIS_DESCR
 /begin AXIS_DESCR COM_AXIS t_ast _CNV_A_R_LINEAR_____24_CM 8 0. 6553.5 FORMAT "%6.1" AXIS_PTS_REF ldpm_t_ast_n_sp_1 /end AXIS_DESCR
/end CHARACTERISTIC
/begin CHARACTERISTIC ip_n_sp_ch "Max. idle speed during CAT heating with no drive engaged" MAP 0xffe4d692 _REC_MAP_20_u2_u1_u2 8160. _CNV_A_R_LINEAR_____10_CM 0. 8160. DISPLAY_IDENTIFIER IP_N_SP_CH FORMAT "%4.0"
 /begin AXIS_DESCR COM_AXIS tco _CNV_A_R_LINEAR_____11_CM 8 -48. 142.5 FORMAT "%5.1" AXIS_PTS_REF ldpm_tco_n_sp_2 /end AXIS_DESCR
 /begin AXIS_DESCR COM_AXIS t_ast _CNV_A_R_LINEAR_____24_CM 8 0. 6553.5 FORMAT "%6.1" AXIS_PTS_REF ldpm_t_ast_n_sp_1 /end AXIS_DESCR
/end CHARACTERISTIC
/begin CHARACTERISTIC ip_fac_dri_n_sp_ch "Interpolation factor idle speed during CAT heating with drive engaged" MAP 0xffe451d2 _REC_MAP_20_u1_u1_u2 0.99610001 _CNV_A_R_LINEAR_____29_CM 0. 0.99610001 DISPLAY_IDENTIFIER IP_FAC_DRI_N_SP_CH FORMAT "%5.3"
 /begin AXIS_DESCR COM_AXIS tco _CNV_A_R_LINEAR_____11_CM 8 -48. 142.5 FORMAT "%5.1" AXIS_PTS_REF ldpm_tco_n_sp_2 /end AXIS_DESCR
 /begin AXIS_DESCR COM_AXIS ctr_km_can _CNV_A_R_LINEAR_____88_CM 4 0. 655350. FORMAT "%7.0" AXIS_PTS_REF ldpm_ctr_km_can_n_sp_1 /end AXIS_DESCR
/end CHARACTERISTIC
/begin CHARACTERISTIC ip_fac_n_sp_ch "Interpolation factor idle speed during CAT heating with no drive engaged" MAP 0xffe454d6 _REC_MAP_20_u1_u1_u2 0.99610001 _CNV_A_R_LINEAR_____29_CM 0. 0.99610001 DISPLAY_IDENTIFIER IP_FAC_N_SP_CH FORMAT "%5.3"
 /begin AXIS_DESCR COM_AXIS tco _CNV_A_R_LINEAR_____11_CM 8 -48. 142.5 FORMAT "%5.1" AXIS_PTS_REF ldpm_tco_n_sp_2 /end AXIS_DESCR
 /begin AXIS_DESCR COM_AXIS ctr_km_can _CNV_A_R_LINEAR_____88_CM 4 0. 655350. FORMAT "%7.0" AXIS_PTS_REF ldpm_ctr_km_can_n_sp_1 /end AXIS_DESCR
/end CHARACTERISTIC
/begin CHARACTERISTIC ip_n_sp_dec_ch "Gradient limitation idle speed after catalyst heating" CURVE 0xffe40d6f _REC_CUR_20_u1_u1 0.4980468800000001 _CNV_A_R_LINEAR_____417_CM 0. 0.49804688 DISPLAY_IDENTIFIER IP_N_SP_DEC_CH FORMAT "%5.3"
 /begin AXIS_DESCR COM_AXIS tco _CNV_A_R_LINEAR_____11_CM 8 -48. 142.5 FORMAT "%5.1" AXIS_PTS_REF ldpm_tco_n_sp_2 /end AXIS_DESCR
/end CHARACTERISTIC
/begin CHARACTERISTIC ip_t_ast_min_n_sp_is_cs "Minimum delay time after start for drive-off-support idle speed" CURVE 0xffe4e642 _REC_CUR_20_u2_u1 6553.5 _CNV_A_R_LINEAR_____24_CM 0. 6553.5 DISPLAY_IDENTIFIER IP_T_AST_MIN_N_SP_IS_CS FORMAT "%6.1"
 /begin AXIS_DESCR COM_AXIS tco _CNV_A_R_LINEAR_____11_CM 8 -48. 142.5 FORMAT "%5.1" AXIS_PTS_REF ldpm_tco_n_sp_1 /end AXIS_DESCR
/end CHARACTERISTIC
/begin CHARACTERISTIC c_n_sp_ofs_kwp_max "Upper threshold for tester offset" VALUE 0xffe4183a _REC_VAL_20_u2 32767. _CNV_A_R_LINEAR_____10_CM 0. 32767. DISPLAY_IDENTIFIER C_N_SP_OFS_KWP_MAX FORMAT "%5.0" /end CHARACTERISTIC
/begin CHARACTERISTIC c_n_sp_ofs_kwp_min "Lower threshold for tester offset" VALUE 0xffe4183c _REC_VAL_20_u2 32767. _CNV_A_R_LINEAR_____418_CM -32768. -1. DISPLAY_IDENTIFIER C_N_SP_OFS_KWP_MIN FORMAT "%6.0" /end CHARACTERISTIC
/begin CHARACTERISTIC c_tam_n_sp_heat "Ambient temperature threshold idle speed at heater request" VALUE 0xffe408df _REC_VAL_20_u1 190.5 _CNV_A_R_LINEAR_____11_CM -48. 142.5 DISPLAY_IDENTIFIER C_TAM_N_SP_HEAT FORMAT "%5.1" /end CHARACTERISTIC
/begin CHARACTERISTIC c_tam_hys "Ambient temperature threshold idle speed at heater request" VALUE 0xffe408d7 _REC_VAL_20_u1 48. _CNV_A_R_LINEAR_____12_CM 0. 48. DISPLAY_IDENTIFIER C_TAM_HYS FORMAT "%4.1" /end CHARACTERISTIC
/begin CHARACTERISTIC c_n_sp_heat_mt "Idle speed at heater request, manual transmission vehicle" VALUE 0xffe41834 _REC_VAL_20_u2 8160. _CNV_A_R_LINEAR_____10_CM 0. 8160. DISPLAY_IDENTIFIER C_N_SP_HEAT_MT FORMAT "%4.0" /end CHARACTERISTIC
/begin CHARACTERISTIC c_n_sp_heat_at "Idle speed at heater request, automatic transmission vehicle" VALUE 0xffe41832 _REC_VAL_20_u2 8160. _CNV_A_R_LINEAR_____10_CM 0. 8160. DISPLAY_IDENTIFIER C_N_SP_HEAT_AT FORMAT "%4.0" /end CHARACTERISTIC
/begin CHARACTERISTIC c_n_sp_inc_cs "Increment engine speed setpoint for drive-off-support" VALUE 0xffe40801 _REC_VAL_20_u1 7.93775 _CNV_A_R_LINEAR_____419_CM 3.125e-002 7.969 DISPLAY_IDENTIFIER C_N_SP_INC_CS FORMAT "%4.2" /end CHARACTERISTIC
/begin CHARACTERISTIC c_n_sp_dec_cs "Decrement engine speed setpoint for drive-off-support" VALUE 0xffe407ff _REC_VAL_20_u1 7.93775 _CNV_A_R_LINEAR_____419_CM 3.125e-002 7.969 DISPLAY_IDENTIFIER C_N_SP_DEC_CS FORMAT "%4.2" /end CHARACTERISTIC
/begin CHARACTERISTIC c_toil_min_n_sp_at "Oil temperature value switch to C_N_SP_TOIL_AT" VALUE 0xffe4097b _REC_VAL_20_u1 200. _CNV_A_R_LINEAR_____14_CM -40. 160. DISPLAY_IDENTIFIER C_TOIL_MIN_N_SP_AT FORMAT "%3.0" /end CHARACTERISTIC
/begin CHARACTERISTIC c_toil_hys_n_sp_at "Hysteresis for oil temperature value switch" VALUE 0xffe40972 _REC_VAL_20_u1 128. _CNV_A_R_LINEAR_____13_CM 0. 128. DISPLAY_IDENTIFIER C_TOIL_HYS_N_SP_AT FORMAT "%3.0" /end CHARACTERISTIC
/begin CHARACTERISTIC c_n_sp_toil_at "Minimum idle speed when TOIL is above C_TOIL_MIN_N_SP_AT" VALUE 0xffe4183e _REC_VAL_20_u2 8160. _CNV_A_R_LINEAR_____10_CM 0. 8160. DISPLAY_IDENTIFIER C_N_SP_TOIL_AT FORMAT "%4.0" /end CHARACTERISTIC
/begin AXIS_PTS ldpm_tco_n_sp_2 "" 0xffe48689 tco _REC_AXS_20_u1 190.5 _CNV_A_R_LINEAR_____11_CM 8 -48. 142.5 DISPLAY_IDENTIFIER LDPM_TCO_N_SP_2 FORMAT "%5.1" /end AXIS_PTS
/begin AXIS_PTS ldpm_tco_n_sp_1 "" 0xffe48680 tco _REC_AXS_20_u1 190.5 _CNV_A_R_LINEAR_____11_CM 8 -48. 142.5 DISPLAY_IDENTIFIER LDPM_TCO_N_SP_1 FORMAT "%5.1" /end AXIS_PTS
/begin AXIS_PTS ldpm_t_ast_n_sp_1 "" 0xffe51d16 t_ast _REC_AXS_20_u2 6553.5 _CNV_A_R_LINEAR_____24_CM 8 0. 6553.5 DISPLAY_IDENTIFIER LDPM_T_AST_N_SP_1 FORMAT "%6.1" /end AXIS_PTS
/begin AXIS_PTS ldpm_ctr_km_can_n_sp_1 "" 0xffe517b8 ctr_km_can _REC_AXS_20_u2 655350. _CNV_A_R_LINEAR_____88_CM 4 0. 655350. DISPLAY_IDENTIFIER LDPM_CTR_KM_CAN_N_SP_1 FORMAT "%7.0" /end AXIS_PTS
/begin CHARACTERISTIC c_n_sp_lgrd_is_lih "Nominal idle speed change limitation with active limp home" VALUE 0xffe40803 _REC_VAL_20_u1 12.7 _CNV_A_R_LINEAR_____420_CM 0.25 63.75 DISPLAY_IDENTIFIER C_N_SP_LGRD_IS_LIH FORMAT "%5.2" /end CHARACTERISTIC
/begin CHARACTERISTIC c_n_sp_is_sa_eol "Idle speed setpoint during the \"secondary air function end of line test'" VALUE 0xffe41836 _REC_VAL_20_u2 8160. _CNV_A_R_LINEAR_____10_CM 0. 8160. DISPLAY_IDENTIFIER C_N_SP_IS_SA_EOL FORMAT "%4.0" /end CHARACTERISTIC
/begin CHARACTERISTIC c_n_sp_lgrd_is "Nominal idle speed change limitation" VALUE 0xffe40802 _REC_VAL_20_u1 12.7 _CNV_A_R_LINEAR_____420_CM 0.25 63.75 DISPLAY_IDENTIFIER C_N_SP_LGRD_IS FORMAT "%5.2" /end CHARACTERISTIC
/begin CHARACTERISTIC c_n_sp_dec_is_ch_dri "Idle speed change limitation during catalyst heating and LV_DRI = 1" VALUE 0xffe40800 _REC_VAL_20_u1 3.175 _CNV_A_R_LINEAR_____421_CM 6.25e-002 15.9375 DISPLAY_IDENTIFIER C_N_SP_DEC_IS_CH_DRI FORMAT "%7.4" /end CHARACTERISTIC
/begin MEASUREMENT n_sp_is "resulting idle speed setpoint" UWORD _CNV_A_R_LINEAR_____10_CM 1 100. 0. 8160. DISPLAY_IDENTIFIER N_SP_IS ECU_ADDRESS 0x3fd5ba BYTE_ORDER MSB_LAST FORMAT "%4.0" /end MEASUREMENT
/begin MEASUREMENT lv_n_sp_is_cs "1: conditions for increased idle speed / torque reserve for drive-off-support fulfilled" UBYTE _CNV_S_2_RANGE______21_CM 1 100. 0. 1. DISPLAY_IDENTIFIER LV_N_SP_IS_CS ECU_ADDRESS 0x3fe5c4 BIT_MASK 0x1 /end MEASUREMENT
/begin AXIS_PTS ldpm_toil_ip_n_sp_is_cs "" 0xffe486de toil _REC_AXS_20_u1 200. _CNV_A_R_LINEAR_____14_CM 8 -40. 160. DISPLAY_IDENTIFIER LDPM_TOIL_IP_N_SP_IS_CS FORMAT "%3.0" /end AXIS_PTS
/begin CHARACTERISTIC ip_n_sp_is_cs "Idle speed setpoint for drive-off-support - manual transmission" CURVE 0xffe4d722 _REC_CUR_20_u2_u1 8160. _CNV_A_R_LINEAR_____10_CM 0. 8160. DISPLAY_IDENTIFIER IP_N_SP_IS_CS FORMAT "%4.0"
 /begin AXIS_DESCR COM_AXIS toil _CNV_A_R_LINEAR_____14_CM 8 -40. 160. FORMAT "%3.0" AXIS_PTS_REF ldpm_toil_ip_n_sp_is_cs /end AXIS_DESCR
/end CHARACTERISTIC
/begin CHARACTERISTIC ip_n_sp_is_cs_amt "Idle speed setpoint for drive-off-support - automated manual transmission" CURVE 0xffe4d732 _REC_CUR_20_u2_u1 8160. _CNV_A_R_LINEAR_____10_CM 0. 8160. DISPLAY_IDENTIFIER IP_N_SP_IS_CS_AMT FORMAT "%4.0"
 /begin AXIS_DESCR COM_AXIS toil _CNV_A_R_LINEAR_____14_CM 8 -40. 160. FORMAT "%3.0" AXIS_PTS_REF ldpm_toil_ip_n_sp_is_cs /end AXIS_DESCR
/end CHARACTERISTIC
/begin CHARACTERISTIC c_dri_vs_min_vb "Minimum vehicle speed for activating battery charging in case LV_DRI = 1" VALUE 0xffe40715 _REC_VAL_20_u1 255. _CNV_A_R_LINEAR_____23_CM 0. 255. DISPLAY_IDENTIFIER C_DRI_VS_MIN_VB FORMAT "%3.0" /end CHARACTERISTIC
/begin CHARACTERISTIC c_vs_max_n_sp_cs "Maximum vehicle speed for drive-off-support" VALUE 0xffe409dd _REC_VAL_20_u1 255. _CNV_A_R_LINEAR_____23_CM 0. 255. DISPLAY_IDENTIFIER C_VS_MAX_N_SP_CS FORMAT "%3.0" /end CHARACTERISTIC
/begin CHARACTERISTIC c_vs_hys_n_sp_cs "vehicle speed hysteresis for VS threshold drive off support" VALUE 0xffe409cf _REC_VAL_20_u1 255. _CNV_A_R_LINEAR_____23_CM 0. 255. DISPLAY_IDENTIFIER C_VS_HYS_N_SP_CS FORMAT "%3.0" /end CHARACTERISTIC
/begin CHARACTERISTIC lc_is_n_sp_cs_dis "LC to switch on/off LV_IS  condition for drive off support" VALUE 0xffe40f8b _REC_VAL_20_u1 1. _CNV_A_R_LINEAR_____0_CM 0. 1. DISPLAY_IDENTIFIER LC_IS_N_SP_CS_DIS FORMAT "%2.0" /end CHARACTERISTIC
/begin AXIS_PTS ldpm_gear "" 0xffe4836a gear _REC_AXS_20_u1 255. _CNV_A_R_LINEAR_____0_CM 9 0. 255. DISPLAY_IDENTIFIER LDPM_GEAR FORMAT "%3.0" /end AXIS_PTS
/begin MEASUREMENT n_max_thd "Actual engine speed limit" UWORD _CNV_A_R_LINEAR_____10_CM 1 100. 0. 8160. DISPLAY_IDENTIFIER N_MAX_THD ECU_ADDRESS 0x3fd5fe BYTE_ORDER MSB_LAST FORMAT "%4.0" /end MEASUREMENT
/begin MEASUREMENT n_max_thd_1 "Actual engine speed limit depending on TOIL-orange area (BN2000)" UWORD _CNV_A_R_LINEAR_____10_CM 1 100. 0. 8160. DISPLAY_IDENTIFIER N_MAX_THD_1 ECU_ADDRESS 0x3fd600 BYTE_ORDER MSB_LAST FORMAT "%4.0" /end MEASUREMENT
/begin MEASUREMENT n_max_thd_2 "Actual engine speed limit depending on TOIL-red area (BN2000)" UWORD _CNV_A_R_LINEAR_____10_CM 1 100. 0. 8160. DISPLAY_IDENTIFIER N_MAX_THD_2 ECU_ADDRESS 0x3fd602 BYTE_ORDER MSB_LAST FORMAT "%4.0" /end MEASUREMENT
/begin MEASUREMENT lv_vs_max "Boolean for vehicle speed limitation active" UBYTE _CNV_S_2_RANGE______2_CM 1 100. 0. 1. DISPLAY_IDENTIFIER LV_VS_MAX ECU_ADDRESS 0x3fe5d3 /end MEASUREMENT
/begin MEASUREMENT vs_ratio "Ratio between vehicle speed limit and actual vehicle speed" UWORD _CNV_A_R_LINEAR_____426_CM 1 100. 0. 31.99951171875 DISPLAY_IDENTIFIER VS_RATIO ECU_ADDRESS 0x3fd606 BYTE_ORDER MSB_LAST FORMAT "%7.4" /end MEASUREMENT
/begin CHARACTERISTIC ip_n_max_mtc_cur_off__pv_av "Engine speed limit for limp home modus due MTC error" CURVE 0xffe41c86 _REC_CUR_20_u2_u1 8160. _CNV_A_R_LINEAR_____10_CM 0. 8160. DISPLAY_IDENTIFIER IP_N_MAX_MTC_CUR_OFF__PV_AV FORMAT "%4.0"
 /begin AXIS_DESCR COM_AXIS pv_av _CNV_A_R_LINEAR_____9_CM 4 0. 99.609375 FORMAT "%5.2" AXIS_PTS_REF ldp_pv_av__n_max_mtc_cur_off /end AXIS_DESCR
/end CHARACTERISTIC
/begin CHARACTERISTIC c_n_max_mtc_lih "Engine speed limitation in case of fault detected by throttle monitoring or ETC safety concept" VALUE 0xffe41824 _REC_VAL_20_u2 8160. _CNV_A_R_LINEAR_____10_CM 0. 8160. DISPLAY_IDENTIFIER C_N_MAX_MTC_LIH FORMAT "%4.0" /end CHARACTERISTIC
/begin CHARACTERISTIC c_vs_max "Vehicle speed limitation threshold" VALUE 0xffe409d0 _REC_VAL_20_u1 255. _CNV_A_R_LINEAR_____23_CM 0. 255. DISPLAY_IDENTIFIER C_VS_MAX FORMAT "%3.0" /end CHARACTERISTIC
/begin CHARACTERISTIC c_n_max_thd_min "Minimum allowed engine speed threshold" VALUE 0xffe41826 _REC_VAL_20_u2 8160. _CNV_A_R_LINEAR_____10_CM 0. 8160. DISPLAY_IDENTIFIER C_N_MAX_THD_MIN FORMAT "%4.0" /end CHARACTERISTIC
/begin MEASUREMENT n_max_vs_max "Engine speed limit in case of vehicle speed limitation" UWORD _CNV_A_R_LINEAR_____10_CM 1 100. 0. 8160. DISPLAY_IDENTIFIER N_MAX_VS_MAX ECU_ADDRESS 0x3fd604 BYTE_ORDER MSB_LAST FORMAT "%4.0" /end MEASUREMENT
/begin CHARACTERISTIC c_vs_max_amt "Vehicle speed limitation threshold - SSG" VALUE 0xffe409d2 _REC_VAL_20_u1 255. _CNV_A_R_LINEAR_____23_CM 0. 255. DISPLAY_IDENTIFIER C_VS_MAX_AMT FORMAT "%3.0" /end CHARACTERISTIC
/begin CHARACTERISTIC ip_n_max_2__toil "engine speed limit (red area) depending on TOIL - BN2000" CURVE 0xffe41c7e _REC_CUR_20_u2_u1 8160. _CNV_A_R_LINEAR_____10_CM 0. 8160. DISPLAY_IDENTIFIER IP_N_MAX_2__TOIL FORMAT "%4.0"
 /begin AXIS_DESCR COM_AXIS toil _CNV_A_R_LINEAR_____14_CM 4 -40. 160. FORMAT "%3.0" AXIS_PTS_REF ldp_toil__n_max_2 /end AXIS_DESCR
/end CHARACTERISTIC
/begin CHARACTERISTIC ip_n_max_1__toil "engine speed limit (orange area) depending on TOIL - BN2000" CURVE 0xffe41c76 _REC_CUR_20_u2_u1 8160. _CNV_A_R_LINEAR_____10_CM 0. 8160. DISPLAY_IDENTIFIER IP_N_MAX_1__TOIL FORMAT "%4.0"
 /begin AXIS_DESCR COM_AXIS toil _CNV_A_R_LINEAR_____14_CM 4 -40. 160. FORMAT "%3.0" AXIS_PTS_REF ldp_toil__n_max_1 /end AXIS_DESCR
/end CHARACTERISTIC
/begin CHARACTERISTIC c_n_max_amt_add "offset for engine speed limit during gear shift phase 1 and 2" VALUE 0xffe4180e _REC_VAL_20_u2 979.2000000000001 _CNV_A_R_LINEAR_____10_CM 0. 8160. DISPLAY_IDENTIFIER C_N_MAX_AMT_ADD FORMAT "%4.0" /end CHARACTERISTIC
/begin CHARACTERISTIC c_n_max_amt_gp "engine speed limit in case of SSG-error (gear protection active, LV_GP=1)" VALUE 0xffe41810 _REC_VAL_20_u2 979.2000000000001 _CNV_A_R_LINEAR_____10_CM 0. 8160. DISPLAY_IDENTIFIER C_N_MAX_AMT_GP FORMAT "%4.0" /end CHARACTERISTIC
/begin AXIS_PTS ldp_pv_av__n_max_mtc_cur_off "" 0xffe41152 pv_av _REC_AXS_20_u1 99.609375 _CNV_A_R_LINEAR_____9_CM 4 0. 99.609375 DISPLAY_IDENTIFIER LDP_PV_AV__N_MAX_MTC_CUR_OFF FORMAT "%5.2" /end AXIS_PTS
/begin AXIS_PTS ldp_toil__n_max_2 "" 0xffe412b7 toil _REC_AXS_20_u1 200. _CNV_A_R_LINEAR_____14_CM 4 -40. 160. DISPLAY_IDENTIFIER LDP_TOIL__N_MAX_2 FORMAT "%3.0" /end AXIS_PTS
/begin AXIS_PTS ldp_toil__n_max_1 "" 0xffe412b2 toil _REC_AXS_20_u1 200. _CNV_A_R_LINEAR_____14_CM 4 -40. 160. DISPLAY_IDENTIFIER LDP_TOIL__N_MAX_1 FORMAT "%3.0" /end AXIS_PTS
/begin CHARACTERISTIC id_n_max_mt "Basic Engine speed limit MT-Vehicle" CURVE 0xffe48b08 _REC_CUR_20_u2_u1 8160. _CNV_A_R_LINEAR_____10_CM 0. 8160. DISPLAY_IDENTIFIER ID_N_MAX_MT FORMAT "%4.0"
 /begin AXIS_DESCR COM_AXIS gear _CNV_A_R_LINEAR_____0_CM 9 0. 255. FORMAT "%3.0" AXIS_PTS_REF ldpm_gear /end AXIS_DESCR
/end CHARACTERISTIC
/begin CHARACTERISTIC id_n_max_amt "Basic Engine speed limit AMT-Vehicle" CURVE 0xffe48aae _REC_CUR_20_u2_u1 8160. _CNV_A_R_LINEAR_____10_CM 0. 8160. DISPLAY_IDENTIFIER ID_N_MAX_AMT FORMAT "%4.0"
 /begin AXIS_DESCR COM_AXIS gear _CNV_A_R_LINEAR_____0_CM 9 0. 255. FORMAT "%3.0" AXIS_PTS_REF ldpm_gear /end AXIS_DESCR
/end CHARACTERISTIC
/begin CHARACTERISTIC id_n_max_at "Basic Engine speed limit AT-Vehicle" CURVE 0xffe48ac0 _REC_CUR_20_u2_u1 8160. _CNV_A_R_LINEAR_____10_CM 0. 8160. DISPLAY_IDENTIFIER ID_N_MAX_AT FORMAT "%4.0"
 /begin AXIS_DESCR COM_AXIS gear _CNV_A_R_LINEAR_____0_CM 9 0. 255. FORMAT "%3.0" AXIS_PTS_REF ldpm_gear /end AXIS_DESCR
/end CHARACTERISTIC
/begin CHARACTERISTIC id_n_max_h_mt "Increased engine speed limit MT-vehicle" CURVE 0xffe48af6 _REC_CUR_20_u2_u1 8160. _CNV_A_R_LINEAR_____10_CM 0. 8160. DISPLAY_IDENTIFIER ID_N_MAX_H_MT FORMAT "%4.0"
 /begin AXIS_DESCR COM_AXIS gear _CNV_A_R_LINEAR_____0_CM 9 0. 255. FORMAT "%3.0" AXIS_PTS_REF ldpm_gear /end AXIS_DESCR
/end CHARACTERISTIC
/begin CHARACTERISTIC id_n_max_h_amt "Increased engine speed limit AMT-vehicle" CURVE 0xffe48ad2 _REC_CUR_20_u2_u1 8160. _CNV_A_R_LINEAR_____10_CM 0. 8160. DISPLAY_IDENTIFIER ID_N_MAX_H_AMT FORMAT "%4.0"
 /begin AXIS_DESCR COM_AXIS gear _CNV_A_R_LINEAR_____0_CM 9 0. 255. FORMAT "%3.0" AXIS_PTS_REF ldpm_gear /end AXIS_DESCR
/end CHARACTERISTIC
/begin CHARACTERISTIC id_n_max_h_at "Increased engine speed limit AT-vehicle" CURVE 0xffe48ae4 _REC_CUR_20_u2_u1 8160. _CNV_A_R_LINEAR_____10_CM 0. 8160. DISPLAY_IDENTIFIER ID_N_MAX_H_AT FORMAT "%4.0"
 /begin AXIS_DESCR COM_AXIS gear _CNV_A_R_LINEAR_____0_CM 9 0. 255. FORMAT "%3.0" AXIS_PTS_REF ldpm_gear /end AXIS_DESCR
/end CHARACTERISTIC
/begin CHARACTERISTIC id_t_n_max_h_amt "Time for increased engine speed limit,AMT vehicle" CURVE 0xffe4432d _REC_CUR_20_u1_u1 25.5 _CNV_A_R_LINEAR_____24_CM 0. 25.5 DISPLAY_IDENTIFIER ID_T_N_MAX_H_AMT FORMAT "%4.1"
 /begin AXIS_DESCR COM_AXIS gear _CNV_A_R_LINEAR_____0_CM 9 0. 255. FORMAT "%3.0" AXIS_PTS_REF ldpm_gear /end AXIS_DESCR
/end CHARACTERISTIC
/begin CHARACTERISTIC id_t_n_max_h_mt "Time for increased engine speed limit, MT vehicle" CURVE 0xffe4433f _REC_CUR_20_u1_u1 25.5 _CNV_A_R_LINEAR_____24_CM 0. 25.5 DISPLAY_IDENTIFIER ID_T_N_MAX_H_MT FORMAT "%4.1"
 /begin AXIS_DESCR COM_AXIS gear _CNV_A_R_LINEAR_____0_CM 9 0. 255. FORMAT "%3.0" AXIS_PTS_REF ldpm_gear /end AXIS_DESCR
/end CHARACTERISTIC
/begin CHARACTERISTIC id_t_n_max_h_at "Time for increased engine speed limit, AT vehicle" CURVE 0xffe44336 _REC_CUR_20_u1_u1 25.5 _CNV_A_R_LINEAR_____24_CM 0. 25.5 DISPLAY_IDENTIFIER ID_T_N_MAX_H_AT FORMAT "%4.1"
 /begin AXIS_DESCR COM_AXIS gear _CNV_A_R_LINEAR_____0_CM 9 0. 255. FORMAT "%3.0" AXIS_PTS_REF ldpm_gear /end AXIS_DESCR
/end CHARACTERISTIC
/begin CHARACTERISTIC id_n_dec_n_max_h_mt "Stepwidth to basic engine speed limit, MT vehicle" CURVE 0xffe48a9c _REC_CUR_20_u2_u1 2048. _CNV_A_R_LINEAR_____10_CM 0. 2048. DISPLAY_IDENTIFIER ID_N_DEC_N_MAX_H_MT FORMAT "%4.0"
 /begin AXIS_DESCR COM_AXIS gear _CNV_A_R_LINEAR_____0_CM 9 0. 255. FORMAT "%3.0" AXIS_PTS_REF ldpm_gear /end AXIS_DESCR
/end CHARACTERISTIC
/begin CHARACTERISTIC id_n_dec_n_max_h_amt "Stepwidth to basic engine speed limit, AMT vehicle" CURVE 0xffe48a78 _REC_CUR_20_u2_u1 2048. _CNV_A_R_LINEAR_____10_CM 0. 2048. DISPLAY_IDENTIFIER ID_N_DEC_N_MAX_H_AMT FORMAT "%4.0"
 /begin AXIS_DESCR COM_AXIS gear _CNV_A_R_LINEAR_____0_CM 9 0. 255. FORMAT "%3.0" AXIS_PTS_REF ldpm_gear /end AXIS_DESCR
/end CHARACTERISTIC
/begin CHARACTERISTIC id_n_dec_n_max_h_at "Stepwidth to basic engine speed limit, AT vehicle" CURVE 0xffe48a8a _REC_CUR_20_u2_u1 2048. _CNV_A_R_LINEAR_____10_CM 0. 2048. DISPLAY_IDENTIFIER ID_N_DEC_N_MAX_H_AT FORMAT "%4.0"
 /begin AXIS_DESCR COM_AXIS gear _CNV_A_R_LINEAR_____0_CM 9 0. 255. FORMAT "%3.0" AXIS_PTS_REF ldpm_gear /end AXIS_DESCR
/end CHARACTERISTIC
/begin CHARACTERISTIC c_n_max_dri_rvl "Engine speed limit AT-vehicle in reverse gear" VALUE 0xffe41814 _REC_VAL_20_u2 8160. _CNV_A_R_LINEAR_____10_CM 0. 8160. DISPLAY_IDENTIFIER C_N_MAX_DRI_RVL FORMAT "%4.0" /end CHARACTERISTIC
/begin CHARACTERISTIC c_vs_thd_n_max_h_mt "VS threshold for increased engine speed limit, MT vehicle" VALUE 0xffe409ee _REC_VAL_20_u1 255. _CNV_A_R_LINEAR_____23_CM 0. 255. DISPLAY_IDENTIFIER C_VS_THD_N_MAX_H_MT FORMAT "%3.0" /end CHARACTERISTIC
/begin CHARACTERISTIC c_vs_thd_n_max_h_amt "VS threshold for increased engine speed limit, AMT vehicle" VALUE 0xffe409ec _REC_VAL_20_u1 255. _CNV_A_R_LINEAR_____23_CM 0. 255. DISPLAY_IDENTIFIER C_VS_THD_N_MAX_H_AMT FORMAT "%3.0" /end CHARACTERISTIC
/begin CHARACTERISTIC c_vs_thd_n_max_h_at "VS threshold for increased engine speed limit, AT vehicle" VALUE 0xffe409ed _REC_VAL_20_u1 255. _CNV_A_R_LINEAR_____23_CM 0. 255. DISPLAY_IDENTIFIER C_VS_THD_N_MAX_H_AT FORMAT "%3.0" /end CHARACTERISTIC
/begin CHARACTERISTIC c_t_max_n_max_h_amt "Maximum time after exceeding the VS threshold, AMT vehicle" VALUE 0xffe408a9 _REC_VAL_20_u1 25.5 _CNV_A_R_LINEAR_____24_CM 0. 25.5 DISPLAY_IDENTIFIER C_T_MAX_N_MAX_H_AMT FORMAT "%4.1" /end CHARACTERISTIC
/begin CHARACTERISTIC c_t_max_n_max_h_at "Maximum time after exceeding the VS threshold, AT vehicle" VALUE 0xffe408aa _REC_VAL_20_u1 25.5 _CNV_A_R_LINEAR_____24_CM 0. 25.5 DISPLAY_IDENTIFIER C_T_MAX_N_MAX_H_AT FORMAT "%4.1" /end CHARACTERISTIC
/begin CHARACTERISTIC c_t_max_n_max_h_mt "Maximum time after exceeding the VS threshold, MT vehicle" VALUE 0xffe408ab _REC_VAL_20_u1 25.5 _CNV_A_R_LINEAR_____24_CM 0. 25.5 DISPLAY_IDENTIFIER C_T_MAX_N_MAX_H_MT FORMAT "%4.1" /end CHARACTERISTIC
/begin MEASUREMENT lv_n_max_h "Boolean for Increased Engine speed limitation active" UBYTE _CNV_S_2_RANGE______21_CM 1 100. 0. 1. DISPLAY_IDENTIFIER LV_N_MAX_H ECU_ADDRESS 0x3fe5da BIT_MASK 0x1 /end MEASUREMENT
/begin MEASUREMENT lv_n_max_etc_lih "Engine speed limitation active" UBYTE _CNV_S_2_RANGE______21_CM 1 100. 0. 1. DISPLAY_IDENTIFIER LV_N_MAX_ETC_LIH ECU_ADDRESS 0x3fe5d4 BIT_MASK 0x1 /end MEASUREMENT
/begin CHARACTERISTIC lc_nox_sens_diag_vls_down_use "Selection of stop signal for NOx sensor" VALUE 0xffe40fb2 _REC_VAL_20_u1 1. _CNV_S_2_RANGE______21_CM 0. 1. DISPLAY_IDENTIFIER LC_NOX_SENS_DIAG_VLS_DOWN_USE /end CHARACTERISTIC
/begin CHARACTERISTIC c_t_nox_sens_nox_hld_diag "Time to start NOx signal diagnosis after the signal state has become Invalid" VALUE 0xffe419ca _REC_VAL_20_u2 327.67 _CNV_A_R_LINEAR_____4_CM 0. 327.67 DISPLAY_IDENTIFIER C_T_NOX_SENS_NOX_HLD_DIAG FORMAT "%6.2" /end CHARACTERISTIC
/begin CHARACTERISTIC c_t_nox_sens_lamb_hld_diag "Time to start Lambda signal diagnosis after the signal state has become Invalid" VALUE 0xffe419c4 _REC_VAL_20_u2 327.67 _CNV_A_R_LINEAR_____4_CM 0. 327.67 DISPLAY_IDENTIFIER C_T_NOX_SENS_LAMB_HLD_DIAG FORMAT "%6.2" /end CHARACTERISTIC
/begin CHARACTERISTIC c_t_nox_sens_vls_hld_diag "Time to start binary O2 signal diagnosis after the signal state has become Invalid" VALUE 0xffe419ce _REC_VAL_20_u2 327.67 _CNV_A_R_LINEAR_____4_CM 0. 327.67 DISPLAY_IDENTIFIER C_T_NOX_SENS_VLS_HLD_DIAG FORMAT "%6.2" /end CHARACTERISTIC
/begin CHARACTERISTIC c_nox_sens_vb_min "Minimum battery voltage for correct NOx-Sensor operation" VALUE 0xffe4080e _REC_VAL_20_u1 26. _CNV_A_R_LINEAR_____60_CM 0. 26. DISPLAY_IDENTIFIER C_NOX_SENS_VB_MIN FORMAT "%4.1" /end CHARACTERISTIC
/begin CHARACTERISTIC c_nox_sens_vb_max "Maximum battery voltage for correct NOx-Sensor operation" VALUE 0xffe4080d _REC_VAL_20_u1 26. _CNV_A_R_LINEAR_____60_CM 0. 26. DISPLAY_IDENTIFIER C_NOX_SENS_VB_MAX FORMAT "%4.1" /end CHARACTERISTIC
/begin CHARACTERISTIC c_t_nox_sens_htp_st_max "Maximum heating up time of NOx-Sensor" VALUE 0xffe408c0 _REC_VAL_20_u1 255. _CNV_A_R_LINEAR_____30_CM 0. 255. DISPLAY_IDENTIFIER C_T_NOX_SENS_HTP_ST_MAX FORMAT "%3.0" /end CHARACTERISTIC
/begin CHARACTERISTIC c_teg_cat_down_mdl_htp_min "Minimum temperature of catalyst, at which a NOx-Sensor heater diagnosis is possible" VALUE 0xffe41a3a _REC_VAL_20_u2 1507.3 _CNV_A_R_LINEAR_____280_CM -48. 1459.3 DISPLAY_IDENTIFIER C_TEG_CAT_DOWN_MDL_HTP_MIN FORMAT "%7.2" /end CHARACTERISTIC
/begin CHARACTERISTIC c_t_nox_sens_htp_max "Maximum time of invalid sensor temperature at normal operation" VALUE 0xffe408bf _REC_VAL_20_u1 255. _CNV_A_R_LINEAR_____30_CM 0. 255. DISPLAY_IDENTIFIER C_T_NOX_SENS_HTP_MAX FORMAT "%3.0" /end CHARACTERISTIC
/begin CHARACTERISTIC c_abc_inc_nox_sens_htp "Anti-bounce counter increment for NOx-Sensor heater performance diagnosis" VALUE 0xffe40583 _REC_VAL_20_u1 255. _CNV_A_R_LINEAR_____0_CM 0. 255. DISPLAY_IDENTIFIER C_ABC_INC_NOX_SENS_HTP FORMAT "%3.0" /end CHARACTERISTIC
/begin CHARACTERISTIC c_abc_max_nox_sens_htp "Maximum value of anti-bounce counter for NOx-Sensor heater performance diagnosis" VALUE 0xffe405f5 _REC_VAL_20_u1 255. _CNV_A_R_LINEAR_____0_CM 0. 255. DISPLAY_IDENTIFIER C_ABC_MAX_NOX_SENS_HTP FORMAT "%3.0" /end CHARACTERISTIC
/begin CHARACTERISTIC c_n_dyw_nox_sens "Limited dynamic threshold of engine speed" VALUE 0xffe41802 _REC_VAL_20_u2 8160. _CNV_A_R_LINEAR_____10_CM 0. 8160. DISPLAY_IDENTIFIER C_N_DYW_NOX_SENS FORMAT "%4.0" /end CHARACTERISTIC
/begin CHARACTERISTIC c_maf_dyw_nox_sens "Limited dynamic threshold of MAF" VALUE 0xffe41744 _REC_VAL_20_u2 1389. _CNV_A_R_LINEAR_____108_CM 0. 1389. DISPLAY_IDENTIFIER C_MAF_DYW_NOX_SENS FORMAT "%7.2" /end CHARACTERISTIC
/begin CHARACTERISTIC c_lam_mv_dyw_nox_sens "Limited dynamic threshold of LAM_MV_i" VALUE 0xffe416a0 _REC_VAL_20_u2 50. _CNV_A_R_LINEAR_____442_CM 0. 50. DISPLAY_IDENTIFIER C_LAM_MV_DYW_NOX_SENS /end CHARACTERISTIC
/begin CHARACTERISTIC c_maf_int_ldc_dly_nox_sens "MAF threshold after reaching limited dynamic conditions, before LV_LDC_NOX_SENS_i is set" VALUE 0xffe41756 _REC_VAL_20_u2 1820.398 _CNV_A_R_LINEAR_____287_CM 0. 1820.398 DISPLAY_IDENTIFIER C_MAF_INT_LDC_DLY_NOX_SENS FORMAT "%7.2" /end CHARACTERISTIC
/begin CHARACTERISTIC c_lamb_afr_diag_max "Maximum upstream Lambda value for start of rich diagnosis" VALUE 0xffe416a6 _REC_VAL_20_u2 31.999023 _CNV_A_R_LINEAR_____206_CM 0. 31.999023 DISPLAY_IDENTIFIER C_LAMB_AFR_DIAG_MAX /end CHARACTERISTIC
/begin CHARACTERISTIC c_lamb_puc_diag_min "Minimum upstream Lambda value for start of PUC diagnosis" VALUE 0xffe416d6 _REC_VAL_20_u2 31.999023 _CNV_A_R_LINEAR_____206_CM 0. 31.999023 DISPLAY_IDENTIFIER C_LAMB_PUC_DIAG_MIN /end CHARACTERISTIC
/begin CHARACTERISTIC c_maf_int_puc_diag_min "MAF threshold for start of PUC diagnosis" VALUE 0xffe4177e _REC_VAL_20_u2 1820.398 _CNV_A_R_LINEAR_____287_CM 0. 1820.398 DISPLAY_IDENTIFIER C_MAF_INT_PUC_DIAG_MIN FORMAT "%7.2" /end CHARACTERISTIC
/begin CHARACTERISTIC c_vls_down_puc_diag_max "Maximum VLS_DOWN signal value for start of PUC diagnosis" VALUE 0xffe41b72 _REC_VAL_20_u2 4.995117 _CNV_A_R_LINEAR_____3_CM 0. 4.995117 DISPLAY_IDENTIFIER C_VLS_DOWN_PUC_DIAG_MAX FORMAT "%5.3" /end CHARACTERISTIC
/begin CHARACTERISTIC c_tcc_nox_sens_puc_act "Number of test cycles at a PUC phase" VALUE 0xffe408e3 _REC_VAL_20_u1 255. _CNV_A_R_LINEAR_____0_CM 0. 255. DISPLAY_IDENTIFIER C_TCC_NOX_SENS_PUC_ACT FORMAT "%3.0" /end CHARACTERISTIC
/begin CHARACTERISTIC c_nox_nox_sens_puc_max "NOx signal diagnosis threshold at PUC" VALUE 0xffe4048e _REC_VAL_20_s2 1600. _CNV_A_R_LINEAR_____429_CM -100. 1500. DISPLAY_IDENTIFIER C_NOX_NOX_SENS_PUC_MAX FORMAT "%4.0" /end CHARACTERISTIC
/begin CHARACTERISTIC c_lamb_nox_sens_puc_min "Lambda signal diagnosis threshold at PUC" VALUE 0xffe416cc _REC_VAL_20_u2 31.999023 _CNV_A_R_LINEAR_____206_CM 0. 31.999023 DISPLAY_IDENTIFIER C_LAMB_NOX_SENS_PUC_MIN /end CHARACTERISTIC
/begin CHARACTERISTIC c_vls_nox_sens_puc_max "Binary O2 signal diagnosis threshold at PUC" VALUE 0xffe41b96 _REC_VAL_20_u2 1400. _CNV_A_R_LINEAR_____105_CM -200. 1200. DISPLAY_IDENTIFIER C_VLS_NOX_SENS_PUC_MAX FORMAT "%4.0" /end CHARACTERISTIC
/begin CHARACTERISTIC c_vls_down_afr_diag_min "Minimum VLS_DOWN signal value for start of rich diagnosis" VALUE 0xffe41b48 _REC_VAL_20_u2 4.995117 _CNV_A_R_LINEAR_____3_CM 0. 4.995117 DISPLAY_IDENTIFIER C_VLS_DOWN_AFR_DIAG_MIN FORMAT "%5.3" /end CHARACTERISTIC
/begin CHARACTERISTIC c_maf_int_afr_diag_min "MAF threshold for start of rich diagnosis" VALUE 0xffe41748 _REC_VAL_20_u2 1820.398 _CNV_A_R_LINEAR_____287_CM 0. 1820.398 DISPLAY_IDENTIFIER C_MAF_INT_AFR_DIAG_MIN FORMAT "%7.2" /end CHARACTERISTIC
/begin CHARACTERISTIC c_tcc_nox_sens_afr_act "Number of test cycles at rich phase" VALUE 0xffe408e2 _REC_VAL_20_u1 255. _CNV_A_R_LINEAR_____0_CM 0. 255. DISPLAY_IDENTIFIER C_TCC_NOX_SENS_AFR_ACT FORMAT "%3.0" /end CHARACTERISTIC
/begin CHARACTERISTIC c_nox_nox_sens_afr_min "NOx signal diagnosis threshold at rich conditions" VALUE 0xffe4048c _REC_VAL_20_s2 1600.000000000001 _CNV_A_R_LINEAR_____429_CM -100.000000000001 1500. DISPLAY_IDENTIFIER C_NOX_NOX_SENS_AFR_MIN FORMAT "%4.0" /end CHARACTERISTIC
/begin CHARACTERISTIC c_vls_nox_sens_afr_min "Binary O2 signal diagnosis threshold at rich conditions" VALUE 0xffe41b8e _REC_VAL_20_u2 1400. _CNV_A_R_LINEAR_____105_CM -200. 1200. DISPLAY_IDENTIFIER C_VLS_NOX_SENS_AFR_MIN FORMAT "%4.0" /end CHARACTERISTIC
/begin CHARACTERISTIC c_lamb_up_down_diag_min "Lambda threshold for activation of upstream-downstream diagnosis" VALUE 0xffe416fc _REC_VAL_20_u2 31.999023 _CNV_A_R_LINEAR_____206_CM 0. 31.999023 DISPLAY_IDENTIFIER C_LAMB_UP_DOWN_DIAG_MIN /end CHARACTERISTIC
/begin CHARACTERISTIC c_lamb_up_down_diag_max "Lambda threshold for activation of upstream-downstream diagnosis" VALUE 0xffe416fa _REC_VAL_20_u2 31.999023 _CNV_A_R_LINEAR_____206_CM 0. 31.999023 DISPLAY_IDENTIFIER C_LAMB_UP_DOWN_DIAG_MAX /end CHARACTERISTIC
/begin AXIS_PTS ldp_lamb_ip_lamb_up_down "Maximum allowed signal deviation between upstream and downstream Lambda signal; diagnosis threshold" 0xffe50c7a lam_bank_1.lam_up.lamb _REC_AXS_20_u2 31.999023 _CNV_A_R_LINEAR_____206_CM 4 0. 31.999023 DISPLAY_IDENTIFIER LDP_LAMB_IP_LAMB_UP_DOWN /end AXIS_PTS
/begin CHARACTERISTIC ip_lamb_up_down "Maximum allowed signal deviation between upstream and downstream Lambda signal; diagnosis threshold" CURVE 0xffe41c6a _REC_CUR_20_u2_u2 31.999023 _CNV_A_R_LINEAR_____206_CM 0. 31.999023 DISPLAY_IDENTIFIER IP_LAMB_UP_DOWN
 /begin AXIS_DESCR COM_AXIS lam_bank_1.lam_up.lamb _CNV_A_R_LINEAR_____206_CM 4 0. 31.999023 AXIS_PTS_REF ldp_lamb_ip_lamb_up_down /end AXIS_DESCR
/end CHARACTERISTIC
/begin CHARACTERISTIC c_abc_inc_nox_sens_plaus "Anti-bounce counter increment for NOx-Sensor plausibility diagnosis" VALUE 0xffe40584 _REC_VAL_20_u1 255. _CNV_A_R_LINEAR_____0_CM 0. 255. DISPLAY_IDENTIFIER C_ABC_INC_NOX_SENS_PLAUS FORMAT "%3.0" /end CHARACTERISTIC
/begin CHARACTERISTIC c_abc_max_nox_sens_plaus "Maximum value of anti-bounce counter for NOx-Sensor plausibility diagnosis" VALUE 0xffe405f6 _REC_VAL_20_u1 255. _CNV_A_R_LINEAR_____0_CM 0. 255. DISPLAY_IDENTIFIER C_ABC_MAX_NOX_SENS_PLAUS FORMAT "%3.0" /end CHARACTERISTIC
/begin CHARACTERISTIC c_tcc_nox_sens_avl_st_max "Maximum number of test cycles after start after which the NOx signal must be available" VALUE 0xffe41a2a _REC_VAL_20_u2 65535. _CNV_A_R_LINEAR_____0_CM 0. 65535. DISPLAY_IDENTIFIER C_TCC_NOX_SENS_AVL_ST_MAX FORMAT "%5.0" /end CHARACTERISTIC
/begin CHARACTERISTIC c_tcc_nox_sens_avl "Number of test cycles for a signal availability evaluation" VALUE 0xffe41a28 _REC_VAL_20_u2 65535. _CNV_A_R_LINEAR_____0_CM 0. 65535. DISPLAY_IDENTIFIER C_TCC_NOX_SENS_AVL FORMAT "%5.0" /end CHARACTERISTIC
/begin CHARACTERISTIC c_frc_nox_sens_nox_avl "Maximum number of cycles with an invalid NOx signal during a NOx signal availability evaluation" VALUE 0xffe41660 _REC_VAL_20_u2 65535. _CNV_A_R_LINEAR_____0_CM 0. 65535. DISPLAY_IDENTIFIER C_FRC_NOX_SENS_NOX_AVL FORMAT "%5.0" /end CHARACTERISTIC
/begin CHARACTERISTIC c_abc_inc_nox_sens_avl "Anti-bounce counter increment for NOx signal availability diagnosis" VALUE 0xffe40581 _REC_VAL_20_u1 255. _CNV_A_R_LINEAR_____0_CM 0. 255. DISPLAY_IDENTIFIER C_ABC_INC_NOX_SENS_AVL FORMAT "%3.0" /end CHARACTERISTIC
/begin CHARACTERISTIC c_abc_max_nox_sens_avl "Maximum value of anti-bounce counter for NOx signal availability diagnosis" VALUE 0xffe405f3 _REC_VAL_20_u1 255. _CNV_A_R_LINEAR_____0_CM 0. 255. DISPLAY_IDENTIFIER C_ABC_MAX_NOX_SENS_AVL FORMAT "%3.0" /end CHARACTERISTIC
/begin CHARACTERISTIC c_maf_int_puc_nox_dyn_diag_min "Minimum MAF threshold at PUC for start of NOx signal dynamic diagnosis" VALUE 0xffe4178c _REC_VAL_20_u2 1820.398 _CNV_A_R_LINEAR_____287_CM 0. 1820.398 DISPLAY_IDENTIFIER C_MAF_INT_PUC_NOX_DYN_DIAG_MIN FORMAT "%7.2" /end CHARACTERISTIC
/begin AXIS_PTS ldp_lamb_ip_nox_dyn_diag "LDP for x axis of Diagnosis threshold for NOx signal dynamic diagnosis" 0xffe50c84 lam_bank_1.lam_up.lamb _REC_AXS_20_u2 31.999023 _CNV_A_R_LINEAR_____206_CM 4 0. 31.999023 DISPLAY_IDENTIFIER LDP_LAMB_IP_NOX_DYN_DIAG /end AXIS_PTS
/begin AXIS_PTS ldpm_maf_kgh_ip_nox_dyn_diag "LDP for y axis of Diagnosis threshold for NOx signal dynamic diagnosis" 0xffe519b8 maf_kgh _REC_AXS_20_u2 2049.9687 _CNV_A_R_LINEAR_____115_CM 4 0. 2049.9687 DISPLAY_IDENTIFIER LDPM_MAF_KGH_IP_NOX_DYN_DIAG FORMAT "%7.2" /end AXIS_PTS
/begin CHARACTERISTIC ip_nox_dyn_diag "Diagnosis threshold for NOx signal dynamic diagnosis" MAP 0xffe4d786 _REC_MAP_20_u2_u2_u2 1600. _CNV_A_R_LINEAR_____443_CM -100. 1500. DISPLAY_IDENTIFIER IP_NOX_DYN_DIAG FORMAT "%4.0"
 /begin AXIS_DESCR COM_AXIS lam_bank_1.lam_up.lamb _CNV_A_R_LINEAR_____206_CM 4 0. 31.999023 AXIS_PTS_REF ldp_lamb_ip_nox_dyn_diag /end AXIS_DESCR
 /begin AXIS_DESCR COM_AXIS maf_kgh _CNV_A_R_LINEAR_____115_CM 4 0. 2049.9687 FORMAT "%7.2" AXIS_PTS_REF ldpm_maf_kgh_ip_nox_dyn_diag /end AXIS_DESCR
/end CHARACTERISTIC
/begin CHARACTERISTIC ip_t_nox_dyn_diag_end "Maximum NOx signal dynamic diagnosis duration" CURVE 0xffe41cb0 _REC_CUR_20_u2_u2 1310.7 _CNV_A_R_LINEAR_____198_CM 0. 1310.7 DISPLAY_IDENTIFIER IP_T_NOX_DYN_DIAG_END FORMAT "%7.2"
 /begin AXIS_DESCR COM_AXIS maf_kgh _CNV_A_R_LINEAR_____115_CM 4 0. 2049.9687 FORMAT "%7.2" AXIS_PTS_REF ldpm_maf_kgh_ip_nox_dyn_diag /end AXIS_DESCR
/end CHARACTERISTIC
/begin CHARACTERISTIC c_vls_down_nox_dyn_diag "VLS_DOWN threshold for stop of NOx signal dynamic diagnosis" VALUE 0xffe41b66 _REC_VAL_20_u2 4.995 _CNV_A_R_LINEAR_____3_CM 0. 4.995 DISPLAY_IDENTIFIER C_VLS_DOWN_NOX_DYN_DIAG FORMAT "%5.3" /end CHARACTERISTIC
/begin CHARACTERISTIC c_vls_nox_sens_nox_dyn_diag "Binary O2 signal threshold for NOx signal dynamic diagnosis" VALUE 0xffe41b94 _REC_VAL_20_u2 1400. _CNV_A_R_LINEAR_____105_CM -200. 1200. DISPLAY_IDENTIFIER C_VLS_NOX_SENS_NOX_DYN_DIAG FORMAT "%4.0" /end CHARACTERISTIC
/begin CHARACTERISTIC c_maf_int_puc_lamb_dyn_diag_min "Minimum MAF threshold at PUC for start of Lambda signal dynamic diagnosis" VALUE 0xffe41780 _REC_VAL_20_u2 1820.398 _CNV_A_R_LINEAR_____287_CM 0. 1820.398 DISPLAY_IDENTIFIER C_MAF_INT_PUC_LAMB_DYN_DIAG_MIN FORMAT "%7.2" /end CHARACTERISTIC
/begin CHARACTERISTIC c_nox_sens_lamb_dyn_diag_st "Diagnosis activation threshold" VALUE 0xffe41850 _REC_VAL_20_u2 31.999023 _CNV_A_R_LINEAR_____206_CM 0. 31.999023 DISPLAY_IDENTIFIER C_NOX_SENS_LAMB_DYN_DIAG_ST /end CHARACTERISTIC
/begin CHARACTERISTIC c_lamb_lamb_dyn_diag_min "Upstream Lambda signal threshold for break off the Lambda signal dynamic diagnosis" VALUE 0xffe416b8 _REC_VAL_20_u2 31.999023 _CNV_A_R_LINEAR_____206_CM 0. 31.999023 DISPLAY_IDENTIFIER C_LAMB_LAMB_DYN_DIAG_MIN /end CHARACTERISTIC
/begin CHARACTERISTIC c_nox_sens_lamb_dyn_diag_min "Lambda signal diagnosis threshold" VALUE 0xffe4184e _REC_VAL_20_u2 31.999023 _CNV_A_R_LINEAR_____206_CM 0. 31.999023 DISPLAY_IDENTIFIER C_NOX_SENS_LAMB_DYN_DIAG_MIN /end CHARACTERISTIC
/begin CHARACTERISTIC c_maf_int_puc_vls_dyn_diag_min "Minimum MAF threshold at PUC for start of binary O2 signal dynamic diagnosis" VALUE 0xffe4178e _REC_VAL_20_u2 1820.398 _CNV_A_R_LINEAR_____287_CM 0. 1820.398 DISPLAY_IDENTIFIER C_MAF_INT_PUC_VLS_DYN_DIAG_MIN FORMAT "%7.2" /end CHARACTERISTIC
/begin CHARACTERISTIC c_nox_sens_vls_dyn_diag_st "Diagnosis activation threshold" VALUE 0xffe41854 _REC_VAL_20_u2 1400. _CNV_A_R_LINEAR_____105_CM -200. 1200. DISPLAY_IDENTIFIER C_NOX_SENS_VLS_DYN_DIAG_ST FORMAT "%4.0" /end CHARACTERISTIC
/begin CHARACTERISTIC c_lamb_vls_dyn_diag_min "Upstream Lambda signal threshold for break off the binary O2 signal dynamic diagnosis" VALUE 0xffe416fe _REC_VAL_20_u2 31.999023 _CNV_A_R_LINEAR_____206_CM 0. 31.999023 DISPLAY_IDENTIFIER C_LAMB_VLS_DYN_DIAG_MIN /end CHARACTERISTIC
/begin CHARACTERISTIC c_nox_sens_vls_dyn_diag_min "Binary O2 signal diagnosis threshold" VALUE 0xffe41852 _REC_VAL_20_u2 31.99902344 _CNV_A_R_LINEAR_____206_CM 0. 31.99902344 DISPLAY_IDENTIFIER C_NOX_SENS_VLS_DYN_DIAG_MIN /end CHARACTERISTIC
/begin CHARACTERISTIC c_abc_inc_nox_sens_dyn "Anti-bounce counter increment for NOx-Sensor dynamic diagnosis" VALUE 0xffe40582 _REC_VAL_20_u1 255. _CNV_A_R_LINEAR_____0_CM 0. 255. DISPLAY_IDENTIFIER C_ABC_INC_NOX_SENS_DYN FORMAT "%3.0" /end CHARACTERISTIC
/begin CHARACTERISTIC c_abc_max_nox_sens_dyn "Maximum value of anti-bounce counter for NOx-Sensor dynamic diagnosis" VALUE 0xffe405f4 _REC_VAL_20_u1 255. _CNV_A_R_LINEAR_____0_CM 0. 255. DISPLAY_IDENTIFIER C_ABC_MAX_NOX_SENS_DYN FORMAT "%3.0" /end CHARACTERISTIC
/begin CHARACTERISTIC c_abc_inc_nox_sens_ref_air "Anti-bounce counter increment for NOx-Sensor reference air diagnosis (CSD)" VALUE 0xffe40585 _REC_VAL_20_u1 255. _CNV_A_R_LINEAR_____0_CM 0. 255. DISPLAY_IDENTIFIER C_ABC_INC_NOX_SENS_REF_AIR FORMAT "%3.0" /end CHARACTERISTIC
/begin CHARACTERISTIC c_abc_max_nox_sens_ref_air "Maximum value of anti-bounce counter for NOx-Sensor reference air diagnosis (CSD)" VALUE 0xffe405f7 _REC_VAL_20_u1 255. _CNV_A_R_LINEAR_____0_CM 0. 255. DISPLAY_IDENTIFIER C_ABC_MAX_NOX_SENS_REF_AIR FORMAT "%3.0" /end CHARACTERISTIC
/begin MEASUREMENT lv_err_nox_sens_obd_1 "Diagnosis result of NOx-Sensor OBD II diagnosis" UBYTE _CNV_S_2_RANGE______21_CM 1 100. 0. 1. DISPLAY_IDENTIFIER LV_ERR_NOX_SENS_OBD_1 ECU_ADDRESS 0x3fea22 /end MEASUREMENT
/begin MEASUREMENT lv_err_nox_sens_obd_2 "Diagnosis result of NOx-Sensor OBD II diagnosis" UBYTE _CNV_S_2_RANGE______21_CM 1 100. 0. 1. DISPLAY_IDENTIFIER LV_ERR_NOX_SENS_OBD_2 ECU_ADDRESS 0x3fea23 /end MEASUREMENT
/begin MEASUREMENT state_nox_sens_htp_diag_1 "State of heater performance diagnosis at normal operation" UBYTE _CNV_S_4_STATE_NOX__444_CM 1 100. 0. 3. DISPLAY_IDENTIFIER STATE_NOX_SENS_HTP_DIAG_1 ECU_ADDRESS 0x3fea24 /end MEASUREMENT
/begin MEASUREMENT state_nox_sens_htp_diag_2 "State of heater performance diagnosis at normal operation" UBYTE _CNV_S_4_STATE_NOX__444_CM 1 100. 0. 3. DISPLAY_IDENTIFIER STATE_NOX_SENS_HTP_DIAG_2 ECU_ADDRESS 0x3fea26 /end MEASUREMENT
/begin MEASUREMENT t_nox_sens_htp_diag_1 "Timer for NOx-Sensor heater diagnosis" UBYTE _CNV_A_R_LINEAR_____30_CM 1 100. 0. 255. DISPLAY_IDENTIFIER T_NOX_SENS_HTP_DIAG_1 ECU_ADDRESS 0x3fea25 FORMAT "%3.0" /end MEASUREMENT
/begin MEASUREMENT t_nox_sens_htp_diag_2 "Timer for NOx-Sensor heater diagnosis" UBYTE _CNV_A_R_LINEAR_____30_CM 1 100. 0. 255. DISPLAY_IDENTIFIER T_NOX_SENS_HTP_DIAG_2 ECU_ADDRESS 0x3fea27 FORMAT "%3.0" /end MEASUREMENT
/begin MEASUREMENT lv_err_nox_sens_htp_1 "NOx-Sensor heater performance failure is present" UBYTE _CNV_S_2_RANGE______21_CM 1 100. 0. 1. DISPLAY_IDENTIFIER LV_ERR_NOX_SENS_HTP_1 ECU_ADDRESS 0x3fbbd0 /end MEASUREMENT
/begin MEASUREMENT lv_err_nox_sens_htp_2 "NOx-Sensor heater performance failure is present" UBYTE _CNV_S_2_RANGE______21_CM 1 100. 0. 1. DISPLAY_IDENTIFIER LV_ERR_NOX_SENS_HTP_2 ECU_ADDRESS 0x3fbbe4 /end MEASUREMENT
/begin MEASUREMENT lv_nox_sens_htp_diag_1 "Heater performance diagnosis at normal operation shall be done" UBYTE _CNV_S_2_RANGE______21_CM 1 100. 0. 1. DISPLAY_IDENTIFIER LV_NOX_SENS_HTP_DIAG_1 ECU_ADDRESS 0x3fea28 /end MEASUREMENT
/begin MEASUREMENT lv_nox_sens_htp_diag_2 "Heater performance diagnosis at normal operation shall be done" UBYTE _CNV_S_2_RANGE______21_CM 1 100. 0. 1. DISPLAY_IDENTIFIER LV_NOX_SENS_HTP_DIAG_2 ECU_ADDRESS 0x3fea29 /end MEASUREMENT
/begin MEASUREMENT lv_ldc_nox_sens_1 "Limited dynamics for NOx-Sensor state evaluation" UBYTE _CNV_S_2_RANGE______21_CM 1 100. 0. 1. DISPLAY_IDENTIFIER LV_LDC_NOX_SENS_1 ECU_ADDRESS 0x3fea2a /end MEASUREMENT
/begin MEASUREMENT lv_ldc_nox_sens_2 "Limited dynamics for NOx-Sensor state evaluation" UBYTE _CNV_S_2_RANGE______21_CM 1 100. 0. 1. DISPLAY_IDENTIFIER LV_LDC_NOX_SENS_2 ECU_ADDRESS 0x3fea2b /end MEASUREMENT
/begin MEASUREMENT maf_int_ldc_dly_nox_sens_1 "Integral of air mass flow since limited dynamic conditions are fulfilled." UWORD _CNV_A_R_LINEAR_____287_CM 1 100. 0. 1820.398 DISPLAY_IDENTIFIER MAF_INT_LDC_DLY_NOX_SENS_1 ECU_ADDRESS 0x3fdba8 BYTE_ORDER MSB_LAST FORMAT "%7.2" /end MEASUREMENT
/begin MEASUREMENT maf_int_ldc_dly_nox_sens_2 "Integral of air mass flow since limited dynamic conditions are fulfilled." UWORD _CNV_A_R_LINEAR_____287_CM 1 100. 0. 1820.398 DISPLAY_IDENTIFIER MAF_INT_LDC_DLY_NOX_SENS_2 ECU_ADDRESS 0x3fdbaa BYTE_ORDER MSB_LAST FORMAT "%7.2" /end MEASUREMENT
/begin MEASUREMENT tcc_nox_sens_puc_act_1 "Test cycle counter for plausibility checks at actual PUC phase" UBYTE _CNV_A_R_LINEAR_____0_CM 1 100. 0. 255. DISPLAY_IDENTIFIER TCC_NOX_SENS_PUC_ACT_1 ECU_ADDRESS 0x3fea2c FORMAT "%3.0" /end MEASUREMENT
/begin MEASUREMENT tcc_nox_sens_puc_act_2 "Test cycle counter for plausibility checks at actual PUC phase" UBYTE _CNV_A_R_LINEAR_____0_CM 1 100. 0. 255. DISPLAY_IDENTIFIER TCC_NOX_SENS_PUC_ACT_2 ECU_ADDRESS 0x3fea2e FORMAT "%3.0" /end MEASUREMENT
/begin MEASUREMENT tcc_nox_sens_afr_act_1 "Test cycle counter for plausibility checks at actual rich phase" UBYTE _CNV_A_R_LINEAR_____0_CM 1 100. 0. 255. DISPLAY_IDENTIFIER TCC_NOX_SENS_AFR_ACT_1 ECU_ADDRESS 0x3fea30 FORMAT "%3.0" /end MEASUREMENT
/begin MEASUREMENT tcc_nox_sens_afr_act_2 "Test cycle counter for plausibility checks at actual rich phase" UBYTE _CNV_A_R_LINEAR_____0_CM 1 100. 0. 255. DISPLAY_IDENTIFIER TCC_NOX_SENS_AFR_ACT_2 ECU_ADDRESS 0x3fea32 FORMAT "%3.0" /end MEASUREMENT
/begin MEASUREMENT maf_int_afr_1 "Mass air flow integral for measure the rich phase duration" UWORD _CNV_A_R_LINEAR_____287_CM 1 100. 0. 1820.398 DISPLAY_IDENTIFIER MAF_INT_AFR_1 ECU_ADDRESS 0x3fdbac BYTE_ORDER MSB_LAST FORMAT "%7.2" /end MEASUREMENT
/begin MEASUREMENT maf_int_afr_2 "Mass air flow integral for measure the rich phase duration" UWORD _CNV_A_R_LINEAR_____287_CM 1 100. 0. 1820.398 DISPLAY_IDENTIFIER MAF_INT_AFR_2 ECU_ADDRESS 0x3fdbae BYTE_ORDER MSB_LAST FORMAT "%7.2" /end MEASUREMENT
/begin MEASUREMENT nox_sens_afr_1 "Byte variable for indication of AFR diagnosis state" UBYTE _CNV_A_R_LINEAR_____0_CM 1 100. 0. 15. DISPLAY_IDENTIFIER NOX_SENS_AFR_1 ECU_ADDRESS 0x3fea31 FORMAT "%2.0" /end MEASUREMENT
/begin MEASUREMENT nox_sens_afr_2 "Byte variable for indication of AFR diagnosis state" UBYTE _CNV_A_R_LINEAR_____0_CM 1 100. 0. 15. DISPLAY_IDENTIFIER NOX_SENS_AFR_2 ECU_ADDRESS 0x3fea33 FORMAT "%2.0" /end MEASUREMENT
/begin MEASUREMENT nox_sens_up_down_1 "Byte variable for indication of upstream-downstream diagnosis state" UBYTE _CNV_A_R_LINEAR_____0_CM 1 100. 0. 7. DISPLAY_IDENTIFIER NOX_SENS_UP_DOWN_1 ECU_ADDRESS 0x3fea34 FORMAT "%1.0" /end MEASUREMENT
/begin MEASUREMENT nox_sens_up_down_2 "Byte variable for indication of upstream-downstream diagnosis state" UBYTE _CNV_A_R_LINEAR_____0_CM 1 100. 0. 7. DISPLAY_IDENTIFIER NOX_SENS_UP_DOWN_2 ECU_ADDRESS 0x3fea35 FORMAT "%1.0" /end MEASUREMENT
/begin MEASUREMENT lv_err_nox_sens_plaus_1 "Signal plausibility failure is present" UBYTE _CNV_S_2_RANGE______21_CM 1 100. 0. 1. DISPLAY_IDENTIFIER LV_ERR_NOX_SENS_PLAUS_1 ECU_ADDRESS 0x3fbbd4 /end MEASUREMENT
/begin MEASUREMENT lv_err_nox_sens_plaus_2 "Signal plausibility failure is present" UBYTE _CNV_S_2_RANGE______21_CM 1 100. 0. 1. DISPLAY_IDENTIFIER LV_ERR_NOX_SENS_PLAUS_2 ECU_ADDRESS 0x3fbbe8 /end MEASUREMENT
/begin MEASUREMENT state_nox_sens_avl_diag_1 "State of NOx-Sensor signal availability diagnosis" UBYTE _CNV_S_3_STATE_NOX__445_CM 1 100. 0. 2. DISPLAY_IDENTIFIER STATE_NOX_SENS_AVL_DIAG_1 ECU_ADDRESS 0x3fea36 /end MEASUREMENT
/begin MEASUREMENT state_nox_sens_avl_diag_2 "State of NOx-Sensor signal availability diagnosis" UBYTE _CNV_S_3_STATE_NOX__445_CM 1 100. 0. 2. DISPLAY_IDENTIFIER STATE_NOX_SENS_AVL_DIAG_2 ECU_ADDRESS 0x3fea37 /end MEASUREMENT
/begin MEASUREMENT tcc_nox_sens_avl_1 "Test cycle counter for NOx-Sensor signal availability diagnosis" UWORD _CNV_A_R_LINEAR_____0_CM 1 100. 0. 65535. DISPLAY_IDENTIFIER TCC_NOX_SENS_AVL_1 ECU_ADDRESS 0x3fdbb0 BYTE_ORDER MSB_LAST FORMAT "%5.0" /end MEASUREMENT
/begin MEASUREMENT tcc_nox_sens_avl_2 "Test cycle counter for NOx-Sensor signal availability diagnosis" UWORD _CNV_A_R_LINEAR_____0_CM 1 100. 0. 65535. DISPLAY_IDENTIFIER TCC_NOX_SENS_AVL_2 ECU_ADDRESS 0x3fdbb4 BYTE_ORDER MSB_LAST FORMAT "%5.0" /end MEASUREMENT
/begin MEASUREMENT frc_nox_sens_nox_avl_1 "Frequency counter for NOx signal available" UWORD _CNV_A_R_LINEAR_____0_CM 1 100. 0. 65535. DISPLAY_IDENTIFIER FRC_NOX_SENS_NOX_AVL_1 ECU_ADDRESS 0x3fdbb2 BYTE_ORDER MSB_LAST FORMAT "%5.0" /end MEASUREMENT
/begin MEASUREMENT frc_nox_sens_nox_avl_2 "Frequency counter for NOx signal available" UWORD _CNV_A_R_LINEAR_____0_CM 1 100. 0. 65535. DISPLAY_IDENTIFIER FRC_NOX_SENS_NOX_AVL_2 ECU_ADDRESS 0x3fdbb6 BYTE_ORDER MSB_LAST FORMAT "%5.0" /end MEASUREMENT
/begin MEASUREMENT lv_err_nox_sens_avl_1 "Signal availability failure is present" UBYTE _CNV_S_2_RANGE______21_CM 1 100. 0. 1. DISPLAY_IDENTIFIER LV_ERR_NOX_SENS_AVL_1 ECU_ADDRESS 0x3fbbd8 /end MEASUREMENT
/begin MEASUREMENT lv_err_nox_sens_avl_2 "Signal availability failure is present" UBYTE _CNV_S_2_RANGE______21_CM 1 100. 0. 1. DISPLAY_IDENTIFIER LV_ERR_NOX_SENS_AVL_2 ECU_ADDRESS 0x3fbbec /end MEASUREMENT
/begin MEASUREMENT state_nox_dyn_diag_1 "State of NOx signal dynamic diagnosis" UBYTE _CNV_S_5_STATE_DYN__446_CM 1 100. 0. 8. DISPLAY_IDENTIFIER STATE_NOX_DYN_DIAG_1 ECU_ADDRESS 0x3fea38 /end MEASUREMENT
/begin MEASUREMENT state_nox_dyn_diag_2 "State of NOx signal dynamic diagnosis" UBYTE _CNV_S_5_STATE_DYN__446_CM 1 100. 0. 8. DISPLAY_IDENTIFIER STATE_NOX_DYN_DIAG_2 ECU_ADDRESS 0x3fea3a /end MEASUREMENT
/begin MEASUREMENT t_main_cat_purge_1 "Timer for measuring of main catalyst purge duration" UWORD _CNV_A_R_LINEAR_____198_CM 1 100. 0. 1310.7 DISPLAY_IDENTIFIER T_MAIN_CAT_PURGE_1 ECU_ADDRESS 0x3fdbb8 BYTE_ORDER MSB_LAST FORMAT "%7.2" /end MEASUREMENT
/begin MEASUREMENT t_main_cat_purge_2 "Timer for measuring of main catalyst purge duration" UWORD _CNV_A_R_LINEAR_____198_CM 1 100. 0. 1310.7 DISPLAY_IDENTIFIER T_MAIN_CAT_PURGE_2 ECU_ADDRESS 0x3fdbc2 BYTE_ORDER MSB_LAST FORMAT "%7.2" /end MEASUREMENT
/begin MEASUREMENT t_nox_dyn_diag_end_1 "Maximum duration of NOx signal dynamic diagnosis" UWORD _CNV_A_R_LINEAR_____198_CM 1 100. 0. 1310.7 DISPLAY_IDENTIFIER T_NOX_DYN_DIAG_END_1 ECU_ADDRESS 0x3fdbba BYTE_ORDER MSB_LAST FORMAT "%7.2" /end MEASUREMENT
/begin MEASUREMENT t_nox_dyn_diag_end_2 "Maximum duration of NOx signal dynamic diagnosis" UWORD _CNV_A_R_LINEAR_____198_CM 1 100. 0. 1310.7 DISPLAY_IDENTIFIER T_NOX_DYN_DIAG_END_2 ECU_ADDRESS 0x3fdbc4 BYTE_ORDER MSB_LAST FORMAT "%7.2" /end MEASUREMENT
/begin MEASUREMENT nox_sens_nox_dyn_diag_st_1 "NOx signal value at start of NOx signal dynamic diagnosis" SWORD _CNV_A_R_LINEAR_____429_CM 1 100. -100.000000000001 1500. DISPLAY_IDENTIFIER NOX_SENS_NOX_DYN_DIAG_ST_1 ECU_ADDRESS 0x3fdbbc BYTE_ORDER MSB_LAST FORMAT "%4.0" /end MEASUREMENT
/begin MEASUREMENT nox_sens_nox_dyn_diag_st_2 "NOx signal value at start of NOx signal dynamic diagnosis" SWORD _CNV_A_R_LINEAR_____429_CM 1 100. -100.000000000001 1500. DISPLAY_IDENTIFIER NOX_SENS_NOX_DYN_DIAG_ST_2 ECU_ADDRESS 0x3fdbc6 BYTE_ORDER MSB_LAST FORMAT "%4.0" /end MEASUREMENT
/begin MEASUREMENT nox_sens_nox_dyn_diag_max_1 "Maximum NOx signal value during dynamic diagnosis" SWORD _CNV_A_R_LINEAR_____429_CM 1 100. -100.000000000001 1500. DISPLAY_IDENTIFIER NOX_SENS_NOX_DYN_DIAG_MAX_1 ECU_ADDRESS 0x3fdbbe BYTE_ORDER MSB_LAST FORMAT "%4.0" /end MEASUREMENT
/begin MEASUREMENT nox_sens_nox_dyn_diag_max_2 "Maximum NOx signal value during dynamic diagnosis" SWORD _CNV_A_R_LINEAR_____429_CM 1 100. -100.000000000001 1500. DISPLAY_IDENTIFIER NOX_SENS_NOX_DYN_DIAG_MAX_2 ECU_ADDRESS 0x3fdbc8 BYTE_ORDER MSB_LAST FORMAT "%4.0" /end MEASUREMENT
/begin MEASUREMENT nox_sens_nox_dyn_diag_min_1 "Diagnosis threshold" SWORD _CNV_A_R_LINEAR_____429_CM 1 100. -100.000000000001 1500. DISPLAY_IDENTIFIER NOX_SENS_NOX_DYN_DIAG_MIN_1 ECU_ADDRESS 0x3fdbc0 BYTE_ORDER MSB_LAST FORMAT "%4.0" /end MEASUREMENT
/begin MEASUREMENT nox_sens_nox_dyn_diag_min_2 "Diagnosis threshold" SWORD _CNV_A_R_LINEAR_____429_CM 1 100. -100.000000000001 1500. DISPLAY_IDENTIFIER NOX_SENS_NOX_DYN_DIAG_MIN_2 ECU_ADDRESS 0x3fdbca BYTE_ORDER MSB_LAST FORMAT "%4.0" /end MEASUREMENT
/begin MEASUREMENT lv_nox_sens_nox_dyn_1 "NOx signal dynamic error is detected" UBYTE _CNV_S_2_RANGE______21_CM 1 100. 0. 1. DISPLAY_IDENTIFIER LV_NOX_SENS_NOX_DYN_1 ECU_ADDRESS 0x3fea39 /end MEASUREMENT
/begin MEASUREMENT lv_nox_sens_nox_dyn_2 "NOx signal dynamic error is detected" UBYTE _CNV_S_2_RANGE______21_CM 1 100. 0. 1. DISPLAY_IDENTIFIER LV_NOX_SENS_NOX_DYN_2 ECU_ADDRESS 0x3fea3b /end MEASUREMENT
/begin MEASUREMENT state_lamb_dyn_diag_1 "State of Lambda signal dynamic diagnosis" UBYTE _CNV_S_5_STATE_DYN__446_CM 1 100. 0. 8. DISPLAY_IDENTIFIER STATE_LAMB_DYN_DIAG_1 ECU_ADDRESS 0x3fea3c /end MEASUREMENT
/begin MEASUREMENT state_lamb_dyn_diag_2 "State of Lambda signal dynamic diagnosis" UBYTE _CNV_S_5_STATE_DYN__446_CM 1 100. 0. 8. DISPLAY_IDENTIFIER STATE_LAMB_DYN_DIAG_2 ECU_ADDRESS 0x3fea3d /end MEASUREMENT
/begin MEASUREMENT nox_sens_lamb_dyn_diag_st_1 "Lambda signal value at start of signal dynamic diagnosis" UWORD _CNV_A_R_LINEAR_____206_CM 1 100. 0. 31.99902344 DISPLAY_IDENTIFIER NOX_SENS_LAMB_DYN_DIAG_ST_1 ECU_ADDRESS 0x3fdbcc BYTE_ORDER MSB_LAST /end MEASUREMENT
/begin MEASUREMENT nox_sens_lamb_dyn_diag_st_2 "Lambda signal value at start of signal dynamic diagnosis" UWORD _CNV_A_R_LINEAR_____206_CM 1 100. 0. 31.99902344 DISPLAY_IDENTIFIER NOX_SENS_LAMB_DYN_DIAG_ST_2 ECU_ADDRESS 0x3fdbd0 BYTE_ORDER MSB_LAST /end MEASUREMENT
/begin MEASUREMENT nox_sens_lamb_dyn_diag_max_1 "Maximum Lambda signal value during dynamic diagnosis" UWORD _CNV_A_R_LINEAR_____206_CM 1 100. 0. 31.99902344 DISPLAY_IDENTIFIER NOX_SENS_LAMB_DYN_DIAG_MAX_1 ECU_ADDRESS 0x3fdbce BYTE_ORDER MSB_LAST /end MEASUREMENT
/begin MEASUREMENT nox_sens_lamb_dyn_diag_max_2 "Maximum Lambda signal value during dynamic diagnosis" UWORD _CNV_A_R_LINEAR_____206_CM 1 100. 0. 31.99902344 DISPLAY_IDENTIFIER NOX_SENS_LAMB_DYN_DIAG_MAX_2 ECU_ADDRESS 0x3fdbd2 BYTE_ORDER MSB_LAST /end MEASUREMENT
/begin MEASUREMENT state_vls_dyn_diag_1 "State of binary O2 signal dynamic diagnosis" UBYTE _CNV_S_5_STATE_DYN__446_CM 1 100. 0. 8. DISPLAY_IDENTIFIER STATE_VLS_DYN_DIAG_1 ECU_ADDRESS 0x3fea3e /end MEASUREMENT
/begin MEASUREMENT state_vls_dyn_diag_2 "State of binary O2 signal dynamic diagnosis" UBYTE _CNV_S_5_STATE_DYN__446_CM 1 100. 0. 8. DISPLAY_IDENTIFIER STATE_VLS_DYN_DIAG_2 ECU_ADDRESS 0x3fea3f /end MEASUREMENT
/begin MEASUREMENT nox_sens_vls_dyn_diag_st_1 "Binary O2 signal value at start of signal dynamic diagnosis" UWORD _CNV_A_R_LINEAR_____105_CM 1 100. -200. 1200. DISPLAY_IDENTIFIER NOX_SENS_VLS_DYN_DIAG_ST_1 ECU_ADDRESS 0x3fdbd4 BYTE_ORDER MSB_LAST FORMAT "%4.0" /end MEASUREMENT
/begin MEASUREMENT nox_sens_vls_dyn_diag_st_2 "Binary O2 signal value at start of signal dynamic diagnosis" UWORD _CNV_A_R_LINEAR_____105_CM 1 100. -200. 1200. DISPLAY_IDENTIFIER NOX_SENS_VLS_DYN_DIAG_ST_2 ECU_ADDRESS 0x3fdbd8 BYTE_ORDER MSB_LAST FORMAT "%4.0" /end MEASUREMENT
/begin MEASUREMENT nox_sens_vls_dyn_diag_end_1 "Binary O2 signal value at the end of signal dynamic diagnosis" UWORD _CNV_A_R_LINEAR_____105_CM 1 100. -200. 1200. DISPLAY_IDENTIFIER NOX_SENS_VLS_DYN_DIAG_END_1 ECU_ADDRESS 0x3fdbd6 BYTE_ORDER MSB_LAST FORMAT "%4.0" /end MEASUREMENT
/begin MEASUREMENT nox_sens_vls_dyn_diag_end_2 "Binary O2 signal value at the end of signal dynamic diagnosis" UWORD _CNV_A_R_LINEAR_____105_CM 1 100. -200. 1200. DISPLAY_IDENTIFIER NOX_SENS_VLS_DYN_DIAG_END_2 ECU_ADDRESS 0x3fdbda BYTE_ORDER MSB_LAST FORMAT "%4.0" /end MEASUREMENT
/begin MEASUREMENT nox_sens_dyn_1 "Byte variable for indication that a NOx-Sensor dynamic diagnosis result was counted" UBYTE _CNV_A_R_LINEAR_____0_CM 1 100. 0. 7. DISPLAY_IDENTIFIER NOX_SENS_DYN_1 ECU_ADDRESS 0x3fea40 FORMAT "%2.0" /end MEASUREMENT
/begin MEASUREMENT nox_sens_dyn_2 "Byte variable for indication that a NOx-Sensor dynamic diagnosis result was counted" UBYTE _CNV_A_R_LINEAR_____0_CM 1 100. 0. 7. DISPLAY_IDENTIFIER NOX_SENS_DYN_2 ECU_ADDRESS 0x3fea41 FORMAT "%2.0" /end MEASUREMENT
/begin MEASUREMENT lv_err_nox_sens_dyn_1 "NOx-Sensor dynamic failure is present" UBYTE _CNV_S_2_RANGE______21_CM 1 100. 0. 1. DISPLAY_IDENTIFIER LV_ERR_NOX_SENS_DYN_1 ECU_ADDRESS 0x3fbbdc /end MEASUREMENT
/begin MEASUREMENT lv_err_nox_sens_dyn_2 "NOx-Sensor dynamic failure is present" UBYTE _CNV_S_2_RANGE______21_CM 1 100. 0. 1. DISPLAY_IDENTIFIER LV_ERR_NOX_SENS_DYN_2 ECU_ADDRESS 0x3fbbf0 /end MEASUREMENT
/begin MEASUREMENT lv_err_nox_sens_ref_air_1 "Characteristic shift down (CSD) failure is present" UBYTE _CNV_S_2_RANGE______21_CM 1 100. 0. 1. DISPLAY_IDENTIFIER LV_ERR_NOX_SENS_REF_AIR_1 ECU_ADDRESS 0x3fbbe0 /end MEASUREMENT
/begin MEASUREMENT lv_err_nox_sens_ref_air_2 "Characteristic shift down (CSD) failure is present" UBYTE _CNV_S_2_RANGE______21_CM 1 100. 0. 1. DISPLAY_IDENTIFIER LV_ERR_NOX_SENS_REF_AIR_2 ECU_ADDRESS 0x3fbbf4 /end MEASUREMENT
/begin CHARACTERISTIC c_lamb_nox_sens_afr_max "Lambda signal diagnosis threshold at rich conditions" VALUE 0xffe416ca _REC_VAL_20_u2 31.999023 _CNV_A_R_LINEAR_____206_CM 0. 31.999023 DISPLAY_IDENTIFIER C_LAMB_NOX_SENS_AFR_MAX /end CHARACTERISTIC
/begin CHARACTERISTIC c_vls_down_lamb_dyn_diag "VLS_DOWN threshold for break off the Lambda signal dynamic diagnosis" VALUE 0xffe41b58 _REC_VAL_20_u2 4.995 _CNV_A_R_LINEAR_____3_CM 0. 4.995 DISPLAY_IDENTIFIER C_VLS_DOWN_LAMB_DYN_DIAG FORMAT "%5.3" /end CHARACTERISTIC
/begin CHARACTERISTIC c_inh_diag_nox_sens_htp "Switch for selection of inhibition mode of NOx-Sensor heater diagnosis" VALUE 0xffe4077a _REC_VAL_20_u1 2. _CNV_A_R_LINEAR_____0_CM 0. 2. DISPLAY_IDENTIFIER C_INH_DIAG_NOX_SENS_HTP FORMAT "%2.0" /end CHARACTERISTIC
/begin CHARACTERISTIC c_inh_diag_nox_sens_obd "Switch for selection of inhibition mode of NOx-Sensor signal diagnosis" VALUE 0xffe4077b _REC_VAL_20_u1 2. _CNV_A_R_LINEAR_____0_CM 0. 2. DISPLAY_IDENTIFIER C_INH_DIAG_NOX_SENS_OBD FORMAT "%2.0" /end CHARACTERISTIC
/begin MEASUREMENT lv_inh_diag_nox_sens_htp_1 "Inhibition of NOx-Sensor heater diagnosis" UBYTE _CNV_A_R_LINEAR_____22_CM 1 100. 0. 1. DISPLAY_IDENTIFIER LV_INH_DIAG_NOX_SENS_HTP_1 ECU_ADDRESS 0x3fea1e FORMAT "%1.0" BIT_MASK 0x1 /end MEASUREMENT
/begin MEASUREMENT lv_inh_diag_nox_sens_htp_2 "Inhibition of NOx-Sensor heater diagnosis" UBYTE _CNV_A_R_LINEAR_____22_CM 1 100. 0. 1. DISPLAY_IDENTIFIER LV_INH_DIAG_NOX_SENS_HTP_2 ECU_ADDRESS 0x3fea20 FORMAT "%1.0" BIT_MASK 0x1 /end MEASUREMENT
/begin MEASUREMENT lv_inh_diag_nox_sens_obd_1 "Inhibition of NOx-Sensor diagnosis" UBYTE _CNV_A_R_LINEAR_____22_CM 1 100. 0. 1. DISPLAY_IDENTIFIER LV_INH_DIAG_NOX_SENS_OBD_1 ECU_ADDRESS 0x3fea1f FORMAT "%1.0" BIT_MASK 0x1 /end MEASUREMENT
/begin MEASUREMENT lv_inh_diag_nox_sens_obd_2 "Inhibition of NOx-Sensor diagnosis" UBYTE _CNV_A_R_LINEAR_____22_CM 1 100. 0. 1. DISPLAY_IDENTIFIER LV_INH_DIAG_NOX_SENS_OBD_2 ECU_ADDRESS 0x3fea21 FORMAT "%1.0" BIT_MASK 0x1 /end MEASUREMENT
/begin CHARACTERISTIC c_pv_grd_lih_max "Max. (positive) pedal gradient in case of an error" VALUE 0xffe4188e _REC_VAL_20_u2 99.99847412 _CNV_A_R_LINEAR_____8_CM 0. 99.99847412 DISPLAY_IDENTIFIER C_PV_GRD_LIH_MAX /end CHARACTERISTIC
/begin CHARACTERISTIC c_v_pvs_hys_fil "Area of the dejitter-filters" VALUE 0xffe4099b _REC_VAL_20_u1 1.24511719 _CNV_A_R_LINEAR_____447_CM 0. 1.24511719 DISPLAY_IDENTIFIER C_V_PVS_HYS_FIL FORMAT "%4.3" /end CHARACTERISTIC
/begin MEASUREMENT v_pvs_fil_1 "Filtered PVS-voltage value for channel 1" UWORD _CNV_A_R_LINEAR_____3_CM 1 100. 0. 4.99511719 DISPLAY_IDENTIFIER V_PVS_FIL_1 ECU_ADDRESS 0x3fd63c BYTE_ORDER MSB_LAST FORMAT "%5.3" /end MEASUREMENT
/begin MEASUREMENT v_pvs_fil_2 "Filtered PVS-voltage value for channel 2" UWORD _CNV_A_R_LINEAR_____3_CM 1 100. 0. 4.99511719 DISPLAY_IDENTIFIER V_PVS_FIL_2 ECU_ADDRESS 0x3fd63e BYTE_ORDER MSB_LAST FORMAT "%5.3" /end MEASUREMENT
/begin CHARACTERISTIC c_pvs_slop_1 "Slope value of  the pedal value 1" VALUE 0xffe4082f _REC_VAL_20_u1 79.6875 _CNV_A_R_LINEAR_____448_CM 0. 79.6875 DISPLAY_IDENTIFIER C_PVS_SLOP_1 FORMAT "%4.1" /end CHARACTERISTIC
/begin CHARACTERISTIC c_pvs_slop_2 "Slope value of  the pedal value 2" VALUE 0xffe40830 _REC_VAL_20_u1 79.6875 _CNV_A_R_LINEAR_____448_CM 0. 79.6875 DISPLAY_IDENTIFIER C_PVS_SLOP_2 FORMAT "%4.1" /end CHARACTERISTIC
/begin MEASUREMENT lv_kd "Flag for Kick-Down-Recognition (internally recognized from both PVS-voltages)" UBYTE _CNV_S_2_RANGE______21_CM 1 100. 0. 1. DISPLAY_IDENTIFIER LV_KD ECU_ADDRESS 0x3fe602 BIT_MASK 0x1 /end MEASUREMENT
/begin CHARACTERISTIC c_v_pvs_ofs_1 "Offset of the pedal value 1" VALUE 0xffe4099c _REC_VAL_20_u1 1.24511719 _CNV_A_R_LINEAR_____447_CM 0. 1.24511719 DISPLAY_IDENTIFIER C_V_PVS_OFS_1 FORMAT "%5.3" /end CHARACTERISTIC
/begin CHARACTERISTIC c_v_pvs_ofs_2 "Offset of the pedal value 2" VALUE 0xffe4099d _REC_VAL_20_u1 1.24511719 _CNV_A_R_LINEAR_____447_CM 0. 1.24511719 DISPLAY_IDENTIFIER C_V_PVS_OFS_2 FORMAT "%5.3" /end CHARACTERISTIC
/begin MEASUREMENT pv_av "Global degree of activation of the accelerator pedal" UBYTE _CNV_A_R_LINEAR_____9_CM 1 100. 0. 99.609375 DISPLAY_IDENTIFIER PV_AV ECU_ADDRESS 0x3fe5fc FORMAT "%3.1" /end MEASUREMENT
/begin CHARACTERISTIC c_pv_av_bls_not_plaus_lgrd "Change limitation of pedal position in case of an PV_AV/Brake implausibility" VALUE 0xffe41882 _REC_VAL_20_u2 99.99847412 _CNV_A_R_LINEAR_____8_CM 0. 99.99847412 DISPLAY_IDENTIFIER C_PV_AV_BLS_NOT_PLAUS_LGRD /end CHARACTERISTIC
/begin CHARACTERISTIC c_pv_av_bls_not_plaus_hys "Hysteresis in case of an PV_AV/Brake implausibility" VALUE 0xffe4081e _REC_VAL_20_u1 99.609375 _CNV_A_R_LINEAR_____9_CM 0. 99.609375 DISPLAY_IDENTIFIER C_PV_AV_BLS_NOT_PLAUS_HYS FORMAT "%4.1" /end CHARACTERISTIC
/begin MEASUREMENT pv_av_2 "degree of activation of the accelerator pedal from PVS-channel 2" UBYTE _CNV_A_R_LINEAR_____9_CM 1 100. 0. 99.609375 DISPLAY_IDENTIFIER PV_AV_2 ECU_ADDRESS 0x3fe5fe FORMAT "%3.1" /end MEASUREMENT
/begin MEASUREMENT pv_max "Maximum selection of pedal value interpretation" UBYTE _CNV_A_R_LINEAR_____9_CM 1 100. 0. 99.609375 DISPLAY_IDENTIFIER PV_MAX ECU_ADDRESS 0x3fe601 FORMAT "%3.1" /end MEASUREMENT
/begin MEASUREMENT pv_av_grd "Throttle position gradient before correction" UBYTE _CNV_A_R_LINEAR_____40_CM 1 100. -1250. 1240.234 DISPLAY_IDENTIFIER PV_AV_GRD ECU_ADDRESS 0x3fe5fb FORMAT "%6.1" /end MEASUREMENT
/begin CHARACTERISTIC c_pv_av_bls_not_plaus "Pedal position in case of an PV_AV/Brake implausibility" VALUE 0xffe4081d _REC_VAL_20_u1 99.609375 _CNV_A_R_LINEAR_____9_CM 0. 99.609375 DISPLAY_IDENTIFIER C_PV_AV_BLS_NOT_PLAUS FORMAT "%4.1" /end CHARACTERISTIC
/begin MEASUREMENT pv_av_1 "degree of activation of the accelerator pedal from PVS-channel 1" UBYTE _CNV_A_R_LINEAR_____9_CM 1 100. 0. 99.609375 DISPLAY_IDENTIFIER PV_AV_1 ECU_ADDRESS 0x3fe5fd FORMAT "%3.1" /end MEASUREMENT
/begin MEASUREMENT fac_pv_cs_cor "Starting  correction" SWORD _CNV_A_R_LINEAR_____281_CM 1 100. -1. 0.99996948 DISPLAY_IDENTIFIER FAC_PV_CS_COR ECU_ADDRESS 0x3fd640 BYTE_ORDER MSB_LAST FORMAT "%8.5" /end MEASUREMENT
/begin MEASUREMENT fac_pv_gs_cor "Gear shift correction" SWORD _CNV_A_R_LINEAR_____281_CM 1 100. -1. 0.99996948 DISPLAY_IDENTIFIER FAC_PV_GS_COR ECU_ADDRESS 0x3fd642 BYTE_ORDER MSB_LAST FORMAT "%8.5" /end MEASUREMENT
/begin MEASUREMENT fac_pv_bas_cor "basic correction" SWORD _CNV_A_R_LINEAR_____281_CM 1 100. -1. 0.99996948 DISPLAY_IDENTIFIER FAC_PV_BAS_COR ECU_ADDRESS 0x3fd644 BYTE_ORDER MSB_LAST FORMAT "%8.5" /end MEASUREMENT
/begin MEASUREMENT fac_pv_cor "Summation of corrections" UWORD _CNV_A_R_LINEAR_____175_CM 1 100. 0. 0.99997 DISPLAY_IDENTIFIER FAC_PV_COR ECU_ADDRESS 0x3fd646 BYTE_ORDER MSB_LAST FORMAT "%8.6" /end MEASUREMENT
/begin MEASUREMENT pv_av_raw "Global degree of activation of the gas pedal" UBYTE _CNV_A_R_LINEAR_____9_CM 1 100. 0. 99.609375 DISPLAY_IDENTIFIER PV_AV_RAW ECU_ADDRESS 0x3fe5ff FORMAT "%3.1" /end MEASUREMENT
/begin CHARACTERISTIC ip_pv_lih_max "Max. pedal position in case of an error" CURVE 0xffe40d9d _REC_CUR_20_u1_u1 99.609375 _CNV_A_R_LINEAR_____9_CM 0. 99.609375 DISPLAY_IDENTIFIER IP_PV_LIH_MAX FORMAT "%4.1"
 /begin AXIS_DESCR COM_AXIS n_32 _CNV_A_R_LINEAR_____15_CM 6 0. 8160. FORMAT "%4.0" AXIS_PTS_REF ldp_n_32__pv_lih_max /end AXIS_DESCR
/end CHARACTERISTIC
/begin CHARACTERISTIC ip_fac_pv_bas_cor_mt "Basic correction" MAP 0xffe4b23e _REC_MAP_20_u2_u2_u1 1.99996948 _CNV_A_R_LINEAR_____449_CM -1. 0.99996948 DISPLAY_IDENTIFIER IP_FAC_PV_BAS_COR_MT FORMAT "%8.5"
 /begin AXIS_DESCR COM_AXIS n _CNV_A_R_LINEAR_____10_CM 6 1. 8160. FORMAT "%4.0" AXIS_PTS_REF ldpm_n__pv_fac_cor /end AXIS_DESCR
 /begin AXIS_DESCR COM_AXIS pv_av_raw _CNV_A_R_LINEAR_____9_CM 6 0. 99.609375 FORMAT "%4.1" AXIS_PTS_REF ldpm_pv_av_raw__pv_fac_cor /end AXIS_DESCR
/end CHARACTERISTIC
/begin CHARACTERISTIC ip_fac_pv_bas_cor_at "Basic correction" MAP 0xffe4b1f6 _REC_MAP_20_u2_u2_u1 1.99996948 _CNV_A_R_LINEAR_____449_CM -1. 0.99996948 DISPLAY_IDENTIFIER IP_FAC_PV_BAS_COR_AT FORMAT "%8.5"
 /begin AXIS_DESCR COM_AXIS n _CNV_A_R_LINEAR_____10_CM 6 1. 8160. FORMAT "%4.0" AXIS_PTS_REF ldpm_n__pv_fac_cor /end AXIS_DESCR
 /begin AXIS_DESCR COM_AXIS pv_av_raw _CNV_A_R_LINEAR_____9_CM 6 0. 99.609375 FORMAT "%4.1" AXIS_PTS_REF ldpm_pv_av_raw__pv_fac_cor /end AXIS_DESCR
/end CHARACTERISTIC
/begin CHARACTERISTIC ip_fac_pv_bas_cor_amt "Basic correction" MAP 0xffe4b1ae _REC_MAP_20_u2_u2_u1 1.99996948 _CNV_A_R_LINEAR_____449_CM -1. 0.99996948 DISPLAY_IDENTIFIER IP_FAC_PV_BAS_COR_AMT FORMAT "%8.5"
 /begin AXIS_DESCR COM_AXIS n _CNV_A_R_LINEAR_____10_CM 6 1. 8160. FORMAT "%4.0" AXIS_PTS_REF ldpm_n__pv_fac_cor /end AXIS_DESCR
 /begin AXIS_DESCR COM_AXIS pv_av_raw _CNV_A_R_LINEAR_____9_CM 6 0. 99.609375 FORMAT "%4.1" AXIS_PTS_REF ldpm_pv_av_raw__pv_fac_cor /end AXIS_DESCR
/end CHARACTERISTIC
/begin CHARACTERISTIC ip_fac_pv_cs_cor_amt "Clutch  intervention correction" MAP 0xffe4b286 _REC_MAP_20_u2_u2_u1 1.99996948 _CNV_A_R_LINEAR_____449_CM -1. 0.99996948 DISPLAY_IDENTIFIER IP_FAC_PV_CS_COR_AMT FORMAT "%8.5"
 /begin AXIS_DESCR COM_AXIS n_dif _CNV_A_R_LINEAR_____207_CM 6 -32768. 32767. FORMAT "%6.0" AXIS_PTS_REF ldpm_n_dif__pv_fac_cor /end AXIS_DESCR
 /begin AXIS_DESCR COM_AXIS pv_av_raw _CNV_A_R_LINEAR_____9_CM 6 0. 99.609375 FORMAT "%4.1" AXIS_PTS_REF ldpm_pv_av_raw__pv_fac_cor /end AXIS_DESCR
/end CHARACTERISTIC
/begin CHARACTERISTIC ip_fac_pv_cs_cor_mt "Clutch  intervention correction" MAP 0xffe4b2ce _REC_MAP_20_u2_u2_u1 1.99996948 _CNV_A_R_LINEAR_____449_CM -1. 0.99996948 DISPLAY_IDENTIFIER IP_FAC_PV_CS_COR_MT FORMAT "%8.5"
 /begin AXIS_DESCR COM_AXIS n_dif _CNV_A_R_LINEAR_____207_CM 6 -32768. 32767. FORMAT "%6.0" AXIS_PTS_REF ldpm_n_dif__pv_fac_cor /end AXIS_DESCR
 /begin AXIS_DESCR COM_AXIS pv_av_raw _CNV_A_R_LINEAR_____9_CM 6 0. 99.609375 FORMAT "%4.1" AXIS_PTS_REF ldpm_pv_av_raw__pv_fac_cor /end AXIS_DESCR
/end CHARACTERISTIC
/begin CHARACTERISTIC ip_fac_pv_gs_cor_amt "Gear shift intervention correction" MAP 0xffe4b316 _REC_MAP_20_u2_u2_u1 1.99996948 _CNV_A_R_LINEAR_____449_CM -1. 0.99996948 DISPLAY_IDENTIFIER IP_FAC_PV_GS_COR_AMT FORMAT "%8.5"
 /begin AXIS_DESCR COM_AXIS n _CNV_A_R_LINEAR_____10_CM 6 1. 8160. FORMAT "%4.0" AXIS_PTS_REF ldpm_n__pv_fac_cor /end AXIS_DESCR
 /begin AXIS_DESCR COM_AXIS pv_av_raw _CNV_A_R_LINEAR_____9_CM 6 0. 99.609375 FORMAT "%4.1" AXIS_PTS_REF ldpm_pv_av_raw__pv_fac_cor /end AXIS_DESCR
/end CHARACTERISTIC
/begin CHARACTERISTIC ip_fac_pv_gs_cor_mt "Gear shift intervention correction" MAP 0xffe4b35e _REC_MAP_20_u2_u2_u1 1.99996948 _CNV_A_R_LINEAR_____449_CM -1. 0.99996948 DISPLAY_IDENTIFIER IP_FAC_PV_GS_COR_MT FORMAT "%8.5"
 /begin AXIS_DESCR COM_AXIS n _CNV_A_R_LINEAR_____10_CM 6 1. 8160. FORMAT "%4.0" AXIS_PTS_REF ldpm_n__pv_fac_cor /end AXIS_DESCR
 /begin AXIS_DESCR COM_AXIS pv_av_raw _CNV_A_R_LINEAR_____9_CM 6 0. 99.609375 FORMAT "%4.1" AXIS_PTS_REF ldpm_pv_av_raw__pv_fac_cor /end AXIS_DESCR
/end CHARACTERISTIC
/begin CHARACTERISTIC ip_fac_vs_pv_gs_cor_amt "Vehicle speed correction" CURVE 0xffe4bb88 _REC_CUR_20_u2_u2 1.99996948 _CNV_A_R_LINEAR_____449_CM -1. 0.99996948 DISPLAY_IDENTIFIER IP_FAC_VS_PV_GS_COR_AMT FORMAT "%8.5"
 /begin AXIS_DESCR COM_AXIS vs_fil _CNV_A_R_LINEAR_____450_CM 8 0. 511.99218 FORMAT "%7.3" AXIS_PTS_REF ldpm_vs_fil__pv_fac_cor /end AXIS_DESCR
/end CHARACTERISTIC
/begin CHARACTERISTIC ip_fac_vs_pv_gs_cor_mt "Vehicle speed correction" CURVE 0xffe4bb98 _REC_CUR_20_u2_u2 1.99996948 _CNV_A_R_LINEAR_____449_CM -1. 0.99996948 DISPLAY_IDENTIFIER IP_FAC_VS_PV_GS_COR_MT FORMAT "%8.5"
 /begin AXIS_DESCR COM_AXIS vs_fil _CNV_A_R_LINEAR_____450_CM 8 0. 511.99218 FORMAT "%7.3" AXIS_PTS_REF ldpm_vs_fil__pv_fac_cor /end AXIS_DESCR
/end CHARACTERISTIC
/begin CHARACTERISTIC ip_fac_vs_pv_bas_cor_mt "Vehicle speed correction" CURVE 0xffe4bb78 _REC_CUR_20_u2_u2 1.99996948 _CNV_A_R_LINEAR_____449_CM -1. 0.99996948 DISPLAY_IDENTIFIER IP_FAC_VS_PV_BAS_COR_MT FORMAT "%8.5"
 /begin AXIS_DESCR COM_AXIS vs_fil _CNV_A_R_LINEAR_____450_CM 8 0. 511.99218 FORMAT "%7.3" AXIS_PTS_REF ldpm_vs_fil__pv_fac_cor /end AXIS_DESCR
/end CHARACTERISTIC
/begin CHARACTERISTIC ip_fac_vs_pv_bas_cor_at "Vehicle speed correction" CURVE 0xffe4bb68 _REC_CUR_20_u2_u2 1.99996948 _CNV_A_R_LINEAR_____449_CM -1. 0.99996948 DISPLAY_IDENTIFIER IP_FAC_VS_PV_BAS_COR_AT FORMAT "%8.5"
 /begin AXIS_DESCR COM_AXIS vs_fil _CNV_A_R_LINEAR_____450_CM 8 0. 511.99218 FORMAT "%7.3" AXIS_PTS_REF ldpm_vs_fil__pv_fac_cor /end AXIS_DESCR
/end CHARACTERISTIC
/begin CHARACTERISTIC ip_fac_vs_pv_bas_cor_amt "Vehicle speed correction" CURVE 0xffe4bb58 _REC_CUR_20_u2_u2 1.99996948 _CNV_A_R_LINEAR_____449_CM -1. 0.99996948 DISPLAY_IDENTIFIER IP_FAC_VS_PV_BAS_COR_AMT FORMAT "%8.5"
 /begin AXIS_DESCR COM_AXIS vs_fil _CNV_A_R_LINEAR_____450_CM 8 0. 511.99218 FORMAT "%7.3" AXIS_PTS_REF ldpm_vs_fil__pv_fac_cor /end AXIS_DESCR
/end CHARACTERISTIC
/begin CHARACTERISTIC c_add_fac_pv_bas_mt "Additve correction at reverse gear" VALUE 0xffe414e0 _REC_VAL_20_u2 1.99996948 _CNV_A_R_LINEAR_____449_CM -1. 0.99996948 DISPLAY_IDENTIFIER C_ADD_FAC_PV_BAS_MT FORMAT "%8.5" /end CHARACTERISTIC
/begin CHARACTERISTIC c_add_fac_pv_bas_at "Additve correction at reverse gear" VALUE 0xffe414de _REC_VAL_20_u2 1.99996948 _CNV_A_R_LINEAR_____449_CM -1. 0.99996948 DISPLAY_IDENTIFIER C_ADD_FAC_PV_BAS_AT FORMAT "%8.5" /end CHARACTERISTIC
/begin CHARACTERISTIC c_add_fac_pv_bas_amt "Additve correction at reverse gear" VALUE 0xffe414dc _REC_VAL_20_u2 1.99996948 _CNV_A_R_LINEAR_____449_CM -1. 0.99996948 DISPLAY_IDENTIFIER C_ADD_FAC_PV_BAS_AMT FORMAT "%8.5" /end CHARACTERISTIC
/begin CHARACTERISTIC c_t_fac_pv_gs "Timer switch off GS correction" VALUE 0xffe4197a _REC_VAL_20_u2 655.34 _CNV_A_R_LINEAR_____4_CM 1.e-002 655.35 DISPLAY_IDENTIFIER C_T_FAC_PV_GS FORMAT "%6.2" /end CHARACTERISTIC
/begin CHARACTERISTIC c_t_fac_pv_cs "Timer switch off CS correction" VALUE 0xffe41978 _REC_VAL_20_u2 655.34 _CNV_A_R_LINEAR_____4_CM 1.e-002 655.35 DISPLAY_IDENTIFIER C_T_FAC_PV_CS FORMAT "%6.2" /end CHARACTERISTIC
/begin CHARACTERISTIC c_vs_max_fac_pv_cor "Timer switch off CS correction" VALUE 0xffe409d8 _REC_VAL_20_u1 255. _CNV_A_R_LINEAR_____23_CM 0. 255. DISPLAY_IDENTIFIER C_VS_MAX_FAC_PV_COR FORMAT "%3.0" /end CHARACTERISTIC
/begin CHARACTERISTIC c_v_pvs_thd_kd_hys "Hysteresis of kick down recognition Channel 1" VALUE 0xffe4099f _REC_VAL_20_u1 4.998 _CNV_A_R_LINEAR_____44_CM 0. 4.998 DISPLAY_IDENTIFIER C_V_PVS_THD_KD_HYS FORMAT "%6.4" /end CHARACTERISTIC
/begin CHARACTERISTIC c_v_pvs_thd_kd "Difference between C_V_PVS_SP_FL_1 and kick-down-recognition (Channel 1)" VALUE 0xffe4099e _REC_VAL_20_u1 4.998 _CNV_A_R_LINEAR_____44_CM 0. 4.998 DISPLAY_IDENTIFIER C_V_PVS_THD_KD FORMAT "%6.4" /end CHARACTERISTIC
/begin MEASUREMENT pv_cru "CRU control variable" UBYTE _CNV_A_R_LINEAR_____9_CM 1 100. 0. 99.609375 DISPLAY_IDENTIFIER PV_CRU ECU_ADDRESS 0x3fe600 FORMAT "%4.1" /end MEASUREMENT
/begin CHARACTERISTIC ip_pv_cru_rng_l "Scaling factor for requested torque at clutch from driver in low range mode" MAP 0xffe46e7b _REC_MAP_20_u1_u1_u2 99.609375 _CNV_A_R_LINEAR_____9_CM 0. 99.609375 DISPLAY_IDENTIFIER IP_PV_CRU_RNG_L FORMAT "%4.1"
 /begin AXIS_DESCR COM_AXIS n_32 _CNV_A_R_LINEAR_____15_CM 8 0. 8160. FORMAT "%4.0" AXIS_PTS_REF ldpm_n_32__fac_tq_req_driv /end AXIS_DESCR
 /begin AXIS_DESCR COM_AXIS fac_tq_req_cru _CNV_A_R_LINEAR_____20_CM 8 0. 1.99996948 FORMAT "%7.5" AXIS_PTS_REF ldpm_fac_tq_cru_dcc /end AXIS_DESCR
/end CHARACTERISTIC
/begin CHARACTERISTIC ip_pv_cru "Scaling factor for requested torque at clutch from driver" MAP 0xffe46e3b _REC_MAP_20_u1_u1_u2 99.609375 _CNV_A_R_LINEAR_____9_CM 0. 99.609375 DISPLAY_IDENTIFIER IP_PV_CRU FORMAT "%4.1"
 /begin AXIS_DESCR COM_AXIS n_32 _CNV_A_R_LINEAR_____15_CM 8 0. 8160. FORMAT "%4.0" AXIS_PTS_REF ldpm_n_32__fac_tq_req_driv /end AXIS_DESCR
 /begin AXIS_DESCR COM_AXIS fac_tq_req_cru _CNV_A_R_LINEAR_____20_CM 8 0. 1.99996948 FORMAT "%7.5" AXIS_PTS_REF ldpm_fac_tq_cru_dcc /end AXIS_DESCR
/end CHARACTERISTIC
/begin AXIS_PTS ldp_n_32__pv_lih_max "" 0xffe410a4 n_32 _REC_AXS_20_u1 816. _CNV_A_R_LINEAR_____15_CM 6 0. 8160. DISPLAY_IDENTIFIER LDP_N_32__PV_LIH_MAX FORMAT "%4.0" /end AXIS_PTS
/begin AXIS_PTS ldpm_vs_fil__pv_fac_cor "" 0xffe51ed6 vs_fil _REC_AXS_20_u2 51.199218 _CNV_A_R_LINEAR_____450_CM 8 0. 511.99218 DISPLAY_IDENTIFIER LDPM_VS_FIL__PV_FAC_COR FORMAT "%7.3" /end AXIS_PTS
/begin AXIS_PTS ldpm_n_dif__pv_fac_cor "" 0xffe51b2e n_dif _REC_AXS_20_u2 6553.5 _CNV_A_R_LINEAR_____207_CM 6 -32768. 32767. DISPLAY_IDENTIFIER LDPM_N_DIF__PV_FAC_COR FORMAT "%6.0" /end AXIS_PTS
/begin AXIS_PTS ldpm_n__pv_fac_cor "" 0xffe51b20 n _REC_AXS_20_u2 815.9 _CNV_A_R_LINEAR_____10_CM 6 1. 8160. DISPLAY_IDENTIFIER LDPM_N__PV_FAC_COR FORMAT "%4.0" /end AXIS_PTS
/begin AXIS_PTS ldpm_pv_av_raw__pv_fac_cor "" 0xffe4140e pv_av_raw _REC_AXS_20_u1 9.9609375 _CNV_A_R_LINEAR_____9_CM 6 0. 99.609375 DISPLAY_IDENTIFIER LDPM_PV_AV_RAW__PV_FAC_COR FORMAT "%4.1" /end AXIS_PTS
/begin AXIS_PTS ldpm_n_32__fac_tq_req_driv "" 0xffe484cd n_32 _REC_AXS_20_u1 8160. _CNV_A_R_LINEAR_____15_CM 8 0. 8160. DISPLAY_IDENTIFIER LDPM_N_32__FAC_TQ_REQ_DRIV FORMAT "%4.0" /end AXIS_PTS
/begin AXIS_PTS ldpm_fac_tq_cru_dcc "" 0xffe5185c fac_tq_req_cru _REC_AXS_20_u2 1.99996948 _CNV_A_R_LINEAR_____20_CM 8 0. 1.99996948 DISPLAY_IDENTIFIER LDPM_FAC_TQ_CRU_DCC FORMAT "%7.5" /end AXIS_PTS
/begin CHARACTERISTIC c_t_tco_sub_is_2 "interrupt time TCO model during IS" VALUE 0xffe41a0a _REC_VAL_20_u2 65535. _CNV_A_R_LINEAR_____30_CM 0. 65535. DISPLAY_IDENTIFIER C_T_TCO_SUB_IS_2 FORMAT "%5.0" /end CHARACTERISTIC
/begin CHARACTERISTIC c_t_tco_sub_puc "interrupt time TCO model during PUC" VALUE 0xffe41a0c _REC_VAL_20_u2 65535. _CNV_A_R_LINEAR_____30_CM 0. 65535. DISPLAY_IDENTIFIER C_T_TCO_SUB_PUC FORMAT "%5.0" /end CHARACTERISTIC
/begin CHARACTERISTIC c_tco_sub_bol_2 "TCO substitute temperature 1 " VALUE 0xffe4092f _REC_VAL_20_u1 28.575 _CNV_A_R_LINEAR_____11_CM -48. 142.5 DISPLAY_IDENTIFIER C_TCO_SUB_BOL_2 FORMAT "%5.1" /end CHARACTERISTIC
/begin CHARACTERISTIC c_tco_sub_tol "upper limit TCO substitute temperature" VALUE 0xffe40930 _REC_VAL_20_u1 28.575 _CNV_A_R_LINEAR_____11_CM -48. 142.5 DISPLAY_IDENTIFIER C_TCO_SUB_TOL FORMAT "%5.1" /end CHARACTERISTIC
/begin CHARACTERISTIC c_tia_diag "TIA threshold - TCO diagnosis" VALUE 0xffe40958 _REC_VAL_20_u1 28.575 _CNV_A_R_LINEAR_____11_CM -48. 142.5 DISPLAY_IDENTIFIER C_TIA_DIAG FORMAT "%5.1" /end CHARACTERISTIC
/begin CHARACTERISTIC ip_tco_sub_inc__maf_kgh "TCO increment" CURVE 0xffe40e7a _REC_CUR_20_u1_u2 37.95 _CNV_A_R_LINEAR_____465_CM 0.75 190.5 DISPLAY_IDENTIFIER IP_TCO_SUB_INC__MAF_KGH FORMAT "%6.2"
 /begin AXIS_DESCR COM_AXIS maf_kgh _CNV_A_R_LINEAR_____115_CM 4 0. 2047.96875 FORMAT "%7.2" AXIS_PTS_REF ldp_maf_kgh__tco_sub_inc /end AXIS_DESCR
/end CHARACTERISTIC
/begin MEASUREMENT tco_sub "Substitute calculated TCO value" UBYTE _CNV_A_R_LINEAR_____11_CM 1 100. -48. 142.5 DISPLAY_IDENTIFIER TCO_SUB ECU_ADDRESS 0x3fe65b FORMAT "%5.1" /end MEASUREMENT
/begin MEASUREMENT tco_stop "Coolant temperature at transition to ES" UBYTE _CNV_A_R_LINEAR_____11_CM 1 100. -48. 142.5 DISPLAY_IDENTIFIER TCO_STOP ECU_ADDRESS 0x3fe65c FORMAT "%5.1" /end MEASUREMENT
/begin CHARACTERISTIC c_tco_sub_bol_1 "TCO substitute temperature 1 " VALUE 0xffe4092e _REC_VAL_20_u1 28.575 _CNV_A_R_LINEAR_____11_CM -48. 142.5 DISPLAY_IDENTIFIER C_TCO_SUB_BOL_1 FORMAT "%5.1" /end CHARACTERISTIC
/begin MEASUREMENT tco "coolant temperature" UBYTE _CNV_A_R_LINEAR_____11_CM 1 100. -48. 142.5 DISPLAY_IDENTIFIER TCO ECU_ADDRESS 0x3fe659 FORMAT "%5.1" /end MEASUREMENT
/begin MEASUREMENT tco_mes "measured coolant temperature" UBYTE _CNV_A_R_LINEAR_____11_CM 1 100. -48. 142.5 DISPLAY_IDENTIFIER TCO_MES ECU_ADDRESS 0x3fe65a FORMAT "%5.1" /end MEASUREMENT
/begin MEASUREMENT tco_st "coolant temperature at engine start" UBYTE _CNV_A_R_LINEAR_____11_CM 1 100. -48. 142.5 DISPLAY_IDENTIFIER TCO_ST ECU_ADDRESS 0x3fe65d FORMAT "%5.1" /end MEASUREMENT
/begin AXIS_PTS ldp_maf_kgh__tco_sub_inc "" 0xffe50e44 maf_kgh _REC_AXS_20_u2 2047.96875 _CNV_A_R_LINEAR_____115_CM 4 0. 2047.96875 DISPLAY_IDENTIFIER LDP_MAF_KGH__TCO_SUB_INC FORMAT "%7.2" /end AXIS_PTS
/begin CHARACTERISTIC c_tco_ex_dif_diag "Difference between TCO and TCO - TCO_EX diagnosis" VALUE 0xffe408f7 _REC_VAL_20_u1 190.5 _CNV_A_R_LINEAR_____11_CM -48. 142.5 DISPLAY_IDENTIFIER C_TCO_EX_DIF_DIAG FORMAT "%5.1" /end CHARACTERISTIC
/begin MEASUREMENT tco_ex_st "Radiator outlet coolant temperature at engine start" UBYTE _CNV_A_R_LINEAR_____11_CM 1 100. -48. 142.5 DISPLAY_IDENTIFIER TCO_EX_ST ECU_ADDRESS 0x3fe660 FORMAT "%5.1" /end MEASUREMENT
/begin MEASUREMENT tco_ex "Radiator outlet temperature" UBYTE _CNV_A_R_LINEAR_____11_CM 1 100. -48. 142.5 DISPLAY_IDENTIFIER TCO_EX ECU_ADDRESS 0x3fe65e FORMAT "%5.1" /end MEASUREMENT
/begin MEASUREMENT tco_ex_mes "Radiator outlet temperature" UBYTE _CNV_A_R_LINEAR_____11_CM 1 100. -48. 142.5 DISPLAY_IDENTIFIER TCO_EX_MES ECU_ADDRESS 0x3fe65f FORMAT "%5.1" /end MEASUREMENT
/begin CHARACTERISTIC ip_tco__v_tco "Conversion table for linearization of TCO value acquisition" CURVE 0xffe4797f _REC_CUR_20_u1_u2 28.575 _CNV_A_R_LINEAR_____11_CM -48. 142.5 DISPLAY_IDENTIFIER IP_TCO__V_TCO FORMAT "%5.1"
 /begin AXIS_DESCR COM_AXIS online_dummy _CNV_A_R_LINEAR_____466_CM 16 7.8125e-002 4.99511719 FORMAT "%5.3" AXIS_PTS_REF ldp_v_tco__tco /end AXIS_DESCR
/end CHARACTERISTIC
/begin AXIS_PTS ldp_v_tco__tco "" 0xffe515ca online_dummy _REC_AXS_20_u2 4.425292971 _CNV_A_R_LINEAR_____466_CM 16 7.8125e-002 4.99511719 DISPLAY_IDENTIFIER LDP_V_TCO__TCO FORMAT "%5.3" /end AXIS_PTS
/begin CHARACTERISTIC c_t_tco_sub_is_1 "max. time in IS before interrupt of TCO model" VALUE 0xffe41a08 _REC_VAL_20_u2 65535. _CNV_A_R_LINEAR_____30_CM 0. 65535. DISPLAY_IDENTIFIER C_T_TCO_SUB_IS_1 FORMAT "%5.0" /end CHARACTERISTIC
/begin CHARACTERISTIC c_t_dly_tco_sub "Delay time before TCO_SUB calculation is started" VALUE 0xffe40892 _REC_VAL_20_u1 255. _CNV_A_R_LINEAR_____30_CM 0. 255. DISPLAY_IDENTIFIER C_T_DLY_TCO_SUB FORMAT "%3.0" /end CHARACTERISTIC
/begin MEASUREMENT teg_pcat_down_1 "exhaust gas temperature of precat" UWORD _CNV_A_R_LINEAR_____467_CM 1 100. 0. 1023.984375 DISPLAY_IDENTIFIER TEG_PCAT_DOWN_1 ECU_ADDRESS 0x3fd6cc BYTE_ORDER MSB_LAST FORMAT "%6.1" /end MEASUREMENT
/begin MEASUREMENT teg_pcat_down_2 "exhaust gas temperature of precat" UWORD _CNV_A_R_LINEAR_____467_CM 1 100. 0. 1023.984375 DISPLAY_IDENTIFIER TEG_PCAT_DOWN_2 ECU_ADDRESS 0x3fd6d0 BYTE_ORDER MSB_LAST FORMAT "%6.1" /end MEASUREMENT
/begin MEASUREMENT teg_pcat_down_raw_2 "exhaust gas temperature of precat,raw value i.e. not replaced by substitde value" UWORD _CNV_A_R_LINEAR_____467_CM 1 100. 0. 1023.984375 DISPLAY_IDENTIFIER TEG_PCAT_DOWN_RAW_2 ECU_ADDRESS 0x3fd6d2 BYTE_ORDER MSB_LAST FORMAT "%6.1" /end MEASUREMENT
/begin MEASUREMENT teg_pcat_down_raw_1 "exhaust gas temperature of precat,raw value i.e. not replaced by substitde value" UWORD _CNV_A_R_LINEAR_____467_CM 1 100. 0. 1023.984375 DISPLAY_IDENTIFIER TEG_PCAT_DOWN_RAW_1 ECU_ADDRESS 0x3fd6ce BYTE_ORDER MSB_LAST FORMAT "%6.1" /end MEASUREMENT
/begin CHARACTERISTIC ip_teg__v_teg "convertion table of exhaust gas temperature" CURVE 0xffe4ebc2 _REC_CUR_20_u2_u2 1023.984375 _CNV_A_R_LINEAR_____467_CM 0. 1023.984375 DISPLAY_IDENTIFIER IP_TEG__V_TEG FORMAT "%6.1"
 /begin AXIS_DESCR COM_AXIS online_dummy _CNV_A_R_LINEAR_____3_CM 16 0. 4.99511719 FORMAT "%5.3" AXIS_PTS_REF ldp_v_teg__teg /end AXIS_DESCR
/end CHARACTERISTIC
/begin AXIS_PTS ldp_v_teg__teg "" 0xffe5160e online_dummy _REC_AXS_20_u2 4.99511719 _CNV_A_R_LINEAR_____3_CM 16 0. 4.99511719 DISPLAY_IDENTIFIER LDP_V_TEG__TEG FORMAT "%5.3" /end AXIS_PTS
/begin CHARACTERISTIC c_tia_grd_max_diag "Maximum permissible gradient for TIA" VALUE 0xffe4095b _REC_VAL_20_u1 38.1 _CNV_A_R_LINEAR_____495_CM 0. 190.5 DISPLAY_IDENTIFIER C_TIA_GRD_MAX_DIAG FORMAT "%4.1" /end CHARACTERISTIC
/begin CHARACTERISTIC ip_tia__v_tia "NTC characteristic" CURVE 0xffe47e0b _REC_CUR_20_u1_u1 28.575 _CNV_A_R_LINEAR_____11_CM -48. 142.5 DISPLAY_IDENTIFIER IP_TIA__V_TIA FORMAT "%5.1"
 /begin AXIS_DESCR COM_AXIS v_tia _CNV_A_R_LINEAR_____496_CM 16 3.90625e-002 4.98046875 FORMAT "%5.3" AXIS_PTS_REF ldp_v_tia_tia /end AXIS_DESCR
/end CHARACTERISTIC
/begin MEASUREMENT tia_sub "" UBYTE _CNV_A_R_LINEAR_____11_CM 1 100. -48. 142.5 DISPLAY_IDENTIFIER TIA_SUB ECU_ADDRESS 0x3fe672 FORMAT "%3.0" /end MEASUREMENT
/begin MEASUREMENT tia "Intake air temperature" UBYTE _CNV_A_R_LINEAR_____11_CM 1 100. -48. 142.5 DISPLAY_IDENTIFIER TIA ECU_ADDRESS 0x3fe671 FORMAT "%5.1" /end MEASUREMENT
/begin MEASUREMENT tia_mes "???" UBYTE _CNV_A_R_LINEAR_____11_CM 1 100. -48. 142.5 DISPLAY_IDENTIFIER TIA_MES ECU_ADDRESS 0x3fe673 FORMAT "%5.1" /end MEASUREMENT
/begin AXIS_PTS ldp_v_tia_tia "" 0xffe482e6 v_tia _REC_AXS_20_u1 4.447265625 _CNV_A_R_LINEAR_____496_CM 16 3.90625e-002 4.98046875 DISPLAY_IDENTIFIER LDP_V_TIA_TIA FORMAT "%5.3" /end AXIS_PTS
/begin CHARACTERISTIC c_tco_diag "TCO threshold for calculation of substitutes" VALUE 0xffe408f1 _REC_VAL_20_u1 28.575 _CNV_A_R_LINEAR_____11_CM -48. 142.5 DISPLAY_IDENTIFIER C_TCO_DIAG FORMAT "%5.1" /end CHARACTERISTIC
/begin CHARACTERISTIC c_tia_sub_tol "Intake air substitute temperature" VALUE 0xffe40969 _REC_VAL_20_u1 28.575 _CNV_A_R_LINEAR_____11_CM -48. 142.5 DISPLAY_IDENTIFIER C_TIA_SUB_TOL FORMAT "%5.1" /end CHARACTERISTIC
/begin CHARACTERISTIC c_tia_sub_bol "Intake air substitute temperature" VALUE 0xffe40968 _REC_VAL_20_u1 28.575 _CNV_A_R_LINEAR_____11_CM -48. 142.5 DISPLAY_IDENTIFIER C_TIA_SUB_BOL FORMAT "%5.1" /end CHARACTERISTIC
/begin MEASUREMENT lv_vb_jump "Boolean for  over voltage - ( Passive / Active )" UBYTE _CNV_S_2_RANGE______2_CM 1 100. 0. 1. DISPLAY_IDENTIFIER LV_VB_JUMP ECU_ADDRESS 0x3fe772 BIT_MASK 0x1 /end MEASUREMENT
/begin CHARACTERISTIC c_crlc_vb "Low pass filter constant for VB_MMV" VALUE 0xffe4069c _REC_VAL_20_u1 0.9960940000000002 _CNV_A_R_LINEAR_____50_CM 0. 0.996094 DISPLAY_IDENTIFIER C_CRLC_VB FORMAT "%5.3" /end CHARACTERISTIC
/begin MEASUREMENT vb_mmv "???" UBYTE _CNV_A_R_LINEAR_____60_CM 1 100. 0. 26. DISPLAY_IDENTIFIER VB_MMV ECU_ADDRESS 0x3fe770 FORMAT "%4.1" /end MEASUREMENT
/begin MEASUREMENT lv_cdn_vb_obd1 "Boolean for battery voltage condition fullfilled for OBD-I diagnosis" UBYTE _CNV_S_2_RANGE______2_CM 1 100. 0. 1. DISPLAY_IDENTIFIER LV_CDN_VB_OBD1 ECU_ADDRESS 0x3fe773 /end MEASUREMENT
/begin MEASUREMENT lv_cdn_vb_obd2 "Boolean for battery voltage condition fullfilled for OBD-II diagnosis" UBYTE _CNV_S_2_RANGE______2_CM 1 100. 0. 1. DISPLAY_IDENTIFIER LV_CDN_VB_OBD2 ECU_ADDRESS 0x3fe774 /end MEASUREMENT
/begin CHARACTERISTIC c_vb_min_jump "Battery voltage threshold for over voltage detection" VALUE 0xffe409bd _REC_VAL_20_u1 7.8 _CNV_A_R_LINEAR_____60_CM 0. 26. DISPLAY_IDENTIFIER C_VB_MIN_JUMP FORMAT "%4.1" /end CHARACTERISTIC
/begin CHARACTERISTIC c_vb_min_obd2 "Battery voltage threshold for low voltage detection for OBD-II Variante" VALUE 0xffe409c0 _REC_VAL_20_u1 7.8 _CNV_A_R_LINEAR_____60_CM 0. 26. DISPLAY_IDENTIFIER C_VB_MIN_OBD2 FORMAT "%4.1" /end CHARACTERISTIC
/begin CHARACTERISTIC c_vb_min_can_diag "VB time condition - diagnosis of timeout CAN messages" VALUE 0xffe409ba _REC_VAL_20_u1 26. _CNV_A_R_LINEAR_____60_CM 0. 26. DISPLAY_IDENTIFIER C_VB_MIN_CAN_DIAG FORMAT "%4.1" /end CHARACTERISTIC
/begin MEASUREMENT lv_igk "Boolean for ignition key status - ( Passive / Active )" UBYTE _CNV_S_2_RANGE______2_CM 1 100. 0. 1. DISPLAY_IDENTIFIER LV_IGK ECU_ADDRESS 0x3fe771 BIT_MASK 0x1 /end MEASUREMENT
/begin MEASUREMENT vb "battery voltage" UBYTE _CNV_A_R_LINEAR_____60_CM 1 100. 0. 26. DISPLAY_IDENTIFIER VB ECU_ADDRESS 0x3fe76e FORMAT "%4.1" /end MEASUREMENT
/begin MEASUREMENT vb_secu "battery voltage secured for dwell computation" UBYTE _CNV_A_R_LINEAR_____60_CM 1 100. 0. 26. DISPLAY_IDENTIFIER VB_SECU ECU_ADDRESS 0x3fe779 FORMAT "%4.1" /end MEASUREMENT
/begin MEASUREMENT v_igk "Key-battery voltage" UBYTE _CNV_A_R_LINEAR_____60_CM 1 100. 0. 26. DISPLAY_IDENTIFIER V_IGK ECU_ADDRESS 0x3fe76f FORMAT "%4.1" /end MEASUREMENT
/begin MEASUREMENT lv_cdn_vb_min_diag "Boolean for battery voltage condition fullfilled for remaining diagnosis" UBYTE _CNV_S_2_RANGE______2_CM 1 100. 0. 1. DISPLAY_IDENTIFIER LV_CDN_VB_MIN_DIAG ECU_ADDRESS 0x3fe777 /end MEASUREMENT
/begin CHARACTERISTIC c_vb_max_obd1 "Battery voltage threshold for maximum permissible battery voltage for OBD diagnosis" VALUE 0xffe409b6 _REC_VAL_20_u1 7.8 _CNV_A_R_LINEAR_____60_CM 0. 26. DISPLAY_IDENTIFIER C_VB_MAX_OBD1 FORMAT "%4.1" /end CHARACTERISTIC
/begin CHARACTERISTIC c_vb_min_obd1 "Battery voltage threshold for low voltage detection for OBD-I Variante" VALUE 0xffe409bf _REC_VAL_20_u1 7.8 _CNV_A_R_LINEAR_____60_CM 0. 26. DISPLAY_IDENTIFIER C_VB_MIN_OBD1 FORMAT "%4.1" /end CHARACTERISTIC
/begin CHARACTERISTIC c_vb_max_obd2 "Battery voltage threshold for maximum permissible battery voltage for OBD diagnosis" VALUE 0xffe409b7 _REC_VAL_20_u1 7.8 _CNV_A_R_LINEAR_____60_CM 0. 26. DISPLAY_IDENTIFIER C_VB_MAX_OBD2 FORMAT "%4.1" /end CHARACTERISTIC
/begin CHARACTERISTIC c_t_min_can_diag "VB time condition - diagnosis of timeout CAN messages" VALUE 0xffe408b1 _REC_VAL_20_u1 2550. _CNV_A_R_LINEAR_____31_CM 0. 2550. DISPLAY_IDENTIFIER C_T_MIN_CAN_DIAG FORMAT "%4.0" /end CHARACTERISTIC
/begin CHARACTERISTIC c_vb_min_diag "Battery voltage threshold for low voltage detection for remaining diagnosis" VALUE 0xffe409bb _REC_VAL_20_u1 7.8 _CNV_A_R_LINEAR_____60_CM 0. 26. DISPLAY_IDENTIFIER C_VB_MIN_DIAG FORMAT "%4.1" /end CHARACTERISTIC
/begin MEASUREMENT lv_cdn_vb_can_diag "Boolean for battery voltage condition fullfilled for CAN diagnosis" UBYTE _CNV_S_2_RANGE______2_CM 1 100. 0. 1. DISPLAY_IDENTIFIER LV_CDN_VB_CAN_DIAG ECU_ADDRESS 0x3fe775 /end MEASUREMENT
/begin CHARACTERISTIC c_vb_min_bn_diag "Battery voltage threshold for low voltage detection for BN2000 diagnosis" VALUE 0xffe409b8 _REC_VAL_20_u1 7.8 _CNV_A_R_LINEAR_____60_CM 0. 26. DISPLAY_IDENTIFIER C_VB_MIN_BN_DIAG FORMAT "%4.1" /end CHARACTERISTIC
/begin MEASUREMENT lv_cdn_vb_bn_diag "Boolean for battery voltage condition fullfilled for BN2000 diagnosis" UBYTE _CNV_S_2_RANGE______2_CM 1 100. 0. 1. DISPLAY_IDENTIFIER LV_CDN_VB_BN_DIAG ECU_ADDRESS 0x3fe776 /end MEASUREMENT
/begin MEASUREMENT vs_edge_av.edge_ctr "actual value of vehicle speed tooth counter" UWORD _CNV_A_R_LINEAR_____0_CM 1 100. 0. 65535. DISPLAY_IDENTIFIER VS_EDGE_CTR_AV ECU_ADDRESS 0x3fd84c BYTE_ORDER MSB_LAST FORMAT "%5.0" /end MEASUREMENT
/begin MEASUREMENT vs_edge_av.edge_t "actual timestamp of last tooth" UWORD _CNV_A_R_LINEAR_____538_CM 1 100. 0. 524.28 DISPLAY_IDENTIFIER VS_EDGE_T_AV ECU_ADDRESS 0x3fd84e BYTE_ORDER MSB_LAST FORMAT "%7.3" /end MEASUREMENT
/begin CHARACTERISTIC c_vs_min_run "minimum vehicle speed for detection of running vehicle" VALUE 0xffe409e8 _REC_VAL_20_u1 25.5 _CNV_A_R_LINEAR_____23_CM 0. 255. DISPLAY_IDENTIFIER C_VS_MIN_RUN FORMAT "%3.0" /end CHARACTERISTIC
/begin MEASUREMENT lv_vs_run "Boolean for running vehicle" UBYTE _CNV_S_2_RANGE______2_CM 1 100. 0. 1. DISPLAY_IDENTIFIER LV_VS_RUN ECU_ADDRESS 0x3fe77d BIT_MASK 0x1 /end MEASUREMENT
/begin CHARACTERISTIC c_t_vst "Time delay for detection of vehicle speed" VALUE 0xffe408d4 _REC_VAL_20_u1 19. _CNV_A_R_LINEAR_____31_CM 10. 200. DISPLAY_IDENTIFIER C_T_VST FORMAT "%3.0" /end CHARACTERISTIC
/begin CHARACTERISTIC c_vs_edge_sum_min "Minimum number of wheel segments for evaluation of vehicle speedy gonzales" VALUE 0xffe409cc _REC_VAL_20_u1 25.4 _CNV_A_R_LINEAR_____0_CM 1. 255. DISPLAY_IDENTIFIER C_VS_EDGE_SUM_MIN FORMAT "%3.0" /end CHARACTERISTIC
/begin MEASUREMENT vs_sens "vehicle speed calculated from vehicle speed sensor" UWORD _CNV_A_R_LINEAR_____85_CM 1 100. 0. 511.99218 DISPLAY_IDENTIFIER VS_SENS ECU_ADDRESS 0x3fd850 BYTE_ORDER MSB_LAST FORMAT "%7.3" /end MEASUREMENT
/begin MEASUREMENT vs_sens_grd "Vehicle speed gradient calculated from VS_SENS" SWORD _CNV_A_R_LINEAR_____539_CM 1 100. -256. 255.9921875 DISPLAY_IDENTIFIER VS_SENS_GRD ECU_ADDRESS 0x3fd85c BYTE_ORDER MSB_LAST FORMAT "%8.3" /end MEASUREMENT
/begin MEASUREMENT lv_vst "boolean for stopped vehicle" UBYTE _CNV_S_2_RANGE______2_CM 1 100. 0. 1. DISPLAY_IDENTIFIER LV_VST ECU_ADDRESS 0x3fe77e BIT_MASK 0x1 /end MEASUREMENT
/begin CHARACTERISTIC c_vs_fac "" VALUE 0xffe414b4 _REC_VAL_20_u4 0.291271 _CNV_A_R_LINEAR_____540_CM 0. 0.291271 DISPLAY_IDENTIFIER C_VS_FAC FORMAT "%10.9" /end CHARACTERISTIC
/begin MEASUREMENT vs "vehicle speed" UBYTE _CNV_A_R_LINEAR_____23_CM 1 100. 0. 255. DISPLAY_IDENTIFIER VS ECU_ADDRESS 0x3fe77c FORMAT "%3.0" /end MEASUREMENT
/begin AXIS_PTS ldpm_pq_estim_id_maf_fac_ofs "" 0xffe51c60 pq_estim _REC_AXS_20_u2 0.99998474 _CNV_A_R_LINEAR_____37_CM 16 0. 0.99998474 DISPLAY_IDENTIFIER LDPM_PQ_ESTIM_ID_MAF_FAC_OFS FORMAT "%7.5" /end AXIS_PTS
/begin MEASUREMENT fmy_ctr_diag_dc_end[0] "Number of DC with diagnosis DIAGCPS done since first power up" UWORD _CNV_A_R_LINEAR_____0_CM 1 100. 0. 65535. DISPLAY_IDENTIFIER CTR_DIAG_DC_END_DIAGCPS ECU_ADDRESS 0x3fd096 BYTE_ORDER MSB_LAST FORMAT "%5.0" /end MEASUREMENT
/begin MEASUREMENT fmy_ctr_diag_dc_end[1] "Number of DC with diagnosis CAT_DIAG_1 done since first power up" UWORD _CNV_A_R_LINEAR_____0_CM 1 100. 0. 65535. DISPLAY_IDENTIFIER CTR_DIAG_DC_END_CAT_DIAG_1 ECU_ADDRESS 0x3fd098 BYTE_ORDER MSB_LAST FORMAT "%5.0" /end MEASUREMENT
/begin MEASUREMENT fmy_ctr_diag_dc_end[2] "Number of DC with diagnosis CAT_DIAG_2 done since first power up" UWORD _CNV_A_R_LINEAR_____0_CM 1 100. 0. 65535. DISPLAY_IDENTIFIER CTR_DIAG_DC_END_CAT_DIAG_2 ECU_ADDRESS 0x3fd09a BYTE_ORDER MSB_LAST FORMAT "%5.0" /end MEASUREMENT
/begin MEASUREMENT fmy_ctr_diag_dc_end[3] "Number of DC with diagnosis SA_SAP done since first power up" UWORD _CNV_A_R_LINEAR_____0_CM 1 100. 0. 65535. DISPLAY_IDENTIFIER CTR_DIAG_DC_END_SA_SAP ECU_ADDRESS 0x3fd09c BYTE_ORDER MSB_LAST FORMAT "%5.0" /end MEASUREMENT
/begin MEASUREMENT fmy_ctr_diag_dc_end[4] "Number of DC with diagnosis SA_SAFM done since first power up" UWORD _CNV_A_R_LINEAR_____0_CM 1 100. 0. 65535. DISPLAY_IDENTIFIER CTR_DIAG_DC_END_SA_SAFM ECU_ADDRESS 0x3fd09e BYTE_ORDER MSB_LAST FORMAT "%5.0" /end MEASUREMENT
/begin MEASUREMENT fmy_ctr_diag_dc_end[5] "Number of DC with diagnosis SA_SAV done since first power up" UWORD _CNV_A_R_LINEAR_____0_CM 1 100. 0. 65535. DISPLAY_IDENTIFIER CTR_DIAG_DC_END_SA_SAV ECU_ADDRESS 0x3fd0a0 BYTE_ORDER MSB_LAST FORMAT "%5.0" /end MEASUREMENT
/begin MEASUREMENT fmy_ctr_diag_dc_end[6] "Number of DC with diagnosis SA_SYS done since first power up" UWORD _CNV_A_R_LINEAR_____0_CM 1 100. 0. 65535. DISPLAY_IDENTIFIER CTR_DIAG_DC_END_SA_SYS ECU_ADDRESS 0x3fd0a2 BYTE_ORDER MSB_LAST FORMAT "%5.0" /end MEASUREMENT
/begin MEASUREMENT fmy_ctr_diag_dc_end[7] "Number of DC with diagnosis ECT_MEC done since first power up" UWORD _CNV_A_R_LINEAR_____0_CM 1 100. 0. 65535. DISPLAY_IDENTIFIER CTR_DIAG_DC_END_ECT_MEC ECU_ADDRESS 0x3fd0a4 BYTE_ORDER MSB_LAST FORMAT "%5.0" /end MEASUREMENT
/begin MEASUREMENT fmy_ctr_diag_dc_end[8] "Number of DC with diagnosis CHK_LS_DOWN_1 done since first power up" UWORD _CNV_A_R_LINEAR_____0_CM 1 100. 0. 65535. DISPLAY_IDENTIFIER CTR_DIAG_DC_END_CHK_LS_DOWN_1 ECU_ADDRESS 0x3fd0a6 BYTE_ORDER MSB_LAST FORMAT "%5.0" /end MEASUREMENT
/begin MEASUREMENT fmy_ctr_diag_dc_end[9] "Number of DC with diagnosisCHK_LS_DOWN_2 done since first power up" UWORD _CNV_A_R_LINEAR_____0_CM 1 100. 0. 65535. DISPLAY_IDENTIFIER CTR_DIAG_DC_END_CHK_LS_DOWN_2 ECU_ADDRESS 0x3fd0a8 BYTE_ORDER MSB_LAST FORMAT "%5.0" /end MEASUREMENT
/begin MEASUREMENT fmy_ctr_diag_dc_end[10] "Number of DC with diagnosis TCO_PLAUS done since first power up" UWORD _CNV_A_R_LINEAR_____0_CM 1 100. 0. 65535. DISPLAY_IDENTIFIER CTR_DIAG_DC_END_TCO_PLAUS ECU_ADDRESS 0x3fd0aa BYTE_ORDER MSB_LAST FORMAT "%5.0" /end MEASUREMENT
/begin MEASUREMENT fmy_ctr_diag_dc_end[11] "Number of DC with diagnosis TCO_STUCK done since first power up" UWORD _CNV_A_R_LINEAR_____0_CM 1 100. 0. 65535. DISPLAY_IDENTIFIER CTR_DIAG_DC_END_TCO_STUCK ECU_ADDRESS 0x3fd0ac BYTE_ORDER MSB_LAST FORMAT "%5.0" /end MEASUREMENT
/begin MEASUREMENT fmy_ctr_diag_dc_end[12] "Number of DC with diagnosis TCO_PLAUS done since first power up" UWORD _CNV_A_R_LINEAR_____0_CM 1 100. 0. 65535. DISPLAY_IDENTIFIER CTR_DIAG_DC_END_O3_CONC ECU_ADDRESS 0x3fd0ae BYTE_ORDER MSB_LAST FORMAT "%5.0" /end MEASUREMENT
/begin MEASUREMENT ctr_cycnr_dc_end "Quantity of DC-s (ended) since first ECU power-up" UWORD _CNV_A_R_LINEAR_____0_CM 1 100. 0. 65535. DISPLAY_IDENTIFIER CTR_CYCNR_DC_END ECU_ADDRESS 0x3fd094 BYTE_ORDER MSB_LAST FORMAT "%5.0" /end MEASUREMENT
/begin COMPU_METHOD _CNV_A_R_LINEAR_____0_CM "" RAT_FUNC "%6.3" "-" COEFFS 0 1. 0. 0 0 1 /end COMPU_METHOD
/begin COMPU_METHOD _CNV_S_2_RANGE______2_CM "" TAB_VERB "%6.3" "[-]" COMPU_TAB_REF _CNV_S_2_RANGE______2 /end COMPU_METHOD
/begin COMPU_VTAB _CNV_S_2_RANGE______2 "" TAB_VERB 2 0 "0" 1 "1" /end COMPU_VTAB
/begin COMPU_METHOD _CNV_A_R_LINEAR_____3_CM "" RAT_FUNC "%6.3" "V" COEFFS 0 204.7999998974999 0. 0 0 1 /end COMPU_METHOD
/begin COMPU_METHOD _CNV_A_R_LINEAR_____4_CM "" RAT_FUNC "%6.3" "s" COEFFS 0 100. 0. 0 0 1 /end COMPU_METHOD
/begin COMPU_METHOD _CNV_A_R_LINEAR_____6_CM "" RAT_FUNC "%6.3" "°C" COEFFS 0 16. 0. 0 0 1 /end COMPU_METHOD
/begin COMPU_METHOD _CNV_A_R_LINEAR_____8_CM "" RAT_FUNC "%6.3" "%" COEFFS 0 655.3600000071681 0. 0 0 1 /end COMPU_METHOD
/begin COMPU_METHOD _CNV_A_R_LINEAR_____9_CM "" RAT_FUNC "%6.3" "%" COEFFS 0 2.56 0. 0 0 1 /end COMPU_METHOD
/begin COMPU_METHOD _CNV_A_R_LINEAR_____10_CM "" RAT_FUNC "%6.3" "rpm" COEFFS 0 1. 0. 0 0 1 /end COMPU_METHOD
/begin COMPU_METHOD _CNV_A_R_LINEAR_____11_CM "" RAT_FUNC "%6.3" "°C" COEFFS 0 1.333333333333333 64. 0 0 1 /end COMPU_METHOD
/begin COMPU_METHOD _CNV_A_R_LINEAR_____12_CM "" RAT_FUNC "%6.3" "°C" COEFFS 0 1.333333333333333 0. 0 0 1 /end COMPU_METHOD
/begin COMPU_METHOD _CNV_A_R_LINEAR_____13_CM "" RAT_FUNC "%6.3" "°C" COEFFS 0 1. 0. 0 0 1 /end COMPU_METHOD
/begin COMPU_METHOD _CNV_A_R_LINEAR_____14_CM "" RAT_FUNC "%6.3" "°C" COEFFS 0 1. 40. 0 0 1 /end COMPU_METHOD
/begin COMPU_METHOD _CNV_A_R_LINEAR_____15_CM "" RAT_FUNC "%6.3" "rpm" COEFFS 0 3.125e-002 0. 0 0 1 /end COMPU_METHOD
/begin COMPU_METHOD _CNV_A_R_LINEAR_____20_CM "" RAT_FUNC "%6.3" "-" COEFFS 0 32768.00003968061 0. 0 0 1 /end COMPU_METHOD
/begin COMPU_METHOD _CNV_S_2_RANGE______21_CM "" TAB_VERB "%6.3" "-" COMPU_TAB_REF _CNV_S_2_RANGE______21 /end COMPU_METHOD
/begin COMPU_VTAB _CNV_S_2_RANGE______21 "" TAB_VERB 2 0 "0" 1 "1" /end COMPU_VTAB
/begin COMPU_METHOD _CNV_A_R_LINEAR_____22_CM "" RAT_FUNC "%6.3" "[-]" COEFFS 0 1. 0. 0 0 1 /end COMPU_METHOD
/begin COMPU_METHOD _CNV_A_R_LINEAR_____23_CM "" RAT_FUNC "%6.3" "km/h" COEFFS 0 1. 0. 0 0 1 /end COMPU_METHOD
/begin COMPU_METHOD _CNV_A_R_LINEAR_____24_CM "" RAT_FUNC "%6.3" "s" COEFFS 0 10. 0. 0 0 1 /end COMPU_METHOD
/begin COMPU_METHOD _CNV_A_R_LINEAR_____29_CM "" RAT_FUNC "%6.3" "-" COEFFS 0 255.9983911655618 0. 0 0 1 /end COMPU_METHOD
/begin COMPU_METHOD _CNV_A_R_LINEAR_____30_CM "" RAT_FUNC "%6.3" "s" COEFFS 0 1. 0. 0 0 1 /end COMPU_METHOD
/begin COMPU_METHOD _CNV_A_R_LINEAR_____31_CM "" RAT_FUNC "%6.3" "ms" COEFFS 0 0.1 0. 0 0 1 /end COMPU_METHOD
/begin COMPU_METHOD _CNV_A_R_LINEAR_____37_CM "" RAT_FUNC "%6.3" "-" COEFFS 0 65536.00007936121 0. 0 0 1 /end COMPU_METHOD
/begin COMPU_METHOD _CNV_A_R_LINEAR_____40_CM "" RAT_FUNC "%6.3" "%/s" COEFFS 0 0.1024000154202376 128.000019275297 0 0 1 /end COMPU_METHOD
/begin COMPU_METHOD _CNV_A_R_LINEAR_____44_CM "" RAT_FUNC "%6.3" "V" COEFFS 0 51.0204081632653 0. 0 0 1 /end COMPU_METHOD
/begin COMPU_METHOD _CNV_A_R_LINEAR_____49_CM "" RAT_FUNC "%6.3" "hPa" COEFFS 0 12.06017666543982 0. 0 0 1 /end COMPU_METHOD
/begin COMPU_METHOD _CNV_A_R_LINEAR_____50_CM "" RAT_FUNC "%6.3" "[-]" COEFFS 0 255.9999357490357 0. 0 0 1 /end COMPU_METHOD
/begin COMPU_METHOD _CNV_A_R_LINEAR_____60_CM "" RAT_FUNC "%6.3" "V" COEFFS 0 9.807692307692308 0. 0 0 1 /end COMPU_METHOD
/begin COMPU_METHOD _CNV_A_R_LINEAR_____82_CM "" RAT_FUNC "%6.3" "°CRK" COEFFS 0 2.666666666666667 0. 0 0 1 /end COMPU_METHOD
/begin COMPU_METHOD _CNV_A_R_LINEAR_____85_CM "" RAT_FUNC "%6.3" "km/h" COEFFS 0 128.0000018750286 0. 0 0 1 /end COMPU_METHOD
/begin COMPU_METHOD _CNV_A_R_LINEAR_____88_CM "" RAT_FUNC "%6.3" "km" COEFFS 0 0.1 0. 0 0 1 /end COMPU_METHOD
/begin COMPU_METHOD _CNV_A_R_LINEAR_____105_CM "" RAT_FUNC "%6.3" "mV" COEFFS 0 1. 200. 0 0 1 /end COMPU_METHOD
/begin COMPU_METHOD _CNV_A_R_LINEAR_____108_CM "" RAT_FUNC "%6.3" "mg/stk" COEFFS 0 47.18142548596112 0. 0 0 1 /end COMPU_METHOD
/begin COMPU_METHOD _CNV_A_R_LINEAR_____115_CM "" RAT_FUNC "%6.3" "kg/h" COEFFS 0 32. 0. 0 0 1 /end COMPU_METHOD
/begin COMPU_METHOD _CNV_A_R_LINEAR_____125_CM "" RAT_FUNC "%6.3" "-" COEFFS 0 255.9999997499962 0. 0 0 1 /end COMPU_METHOD
/begin COMPU_METHOD _CNV_A_R_LINEAR_____129_CM "" RAT_FUNC "%6.3" "[-]" COEFFS 0 64. 0. 0 0 1 /end COMPU_METHOD
/begin COMPU_METHOD _CNV_A_R_LINEAR_____165_CM "" RAT_FUNC "%6.3" "ms" COEFFS 0 250. 0. 0 0 1 /end COMPU_METHOD
/begin COMPU_METHOD _CNV_A_R_LINEAR_____175_CM "" RAT_FUNC "%6.3" "-" COEFFS 0 32767.98303949118 0. 0 0 1 /end COMPU_METHOD
/begin COMPU_METHOD _CNV_A_R_LINEAR_____198_CM "" RAT_FUNC "%6.3" "s" COEFFS 0 50. 0. 0 0 1 /end COMPU_METHOD
/begin COMPU_METHOD _CNV_A_R_LINEAR_____200_CM "" RAT_FUNC "%6.3" "h/(km*min)" COEFFS 0 1. 0. 0 0 1 /end COMPU_METHOD
/begin COMPU_METHOD _CNV_A_R_LINEAR_____206_CM "" RAT_FUNC "%6.3" "-" COEFFS 0 1023.999999919998 0. 0 0 1 /end COMPU_METHOD
/begin COMPU_METHOD _CNV_A_R_LINEAR_____207_CM "" RAT_FUNC "%6.3" "rpm" COEFFS 0 1. 32768. 0 0 1 /end COMPU_METHOD
/begin COMPU_METHOD _CNV_A_R_LINEAR_____228_CM "" RAT_FUNC "%6.3" "°CRK" COEFFS 0 42.66666666666666 0. 0 0 1 /end COMPU_METHOD
/begin COMPU_METHOD _CNV_A_R_LINEAR_____236_CM "" RAT_FUNC "%6.3" "-" COEFFS 0 32. 0. 0 0 1 /end COMPU_METHOD
/begin COMPU_METHOD _CNV_A_R_LINEAR_____248_CM "" RAT_FUNC "%6.3" "-" COEFFS 0 64. 0. 0 0 1 /end COMPU_METHOD
/begin COMPU_METHOD _CNV_A_R_LINEAR_____249_CM "" RAT_FUNC "%6.3" "°CRK" COEFFS 0 2.666666666666667 -466.6666666666666 0 0 1 /end COMPU_METHOD
/begin COMPU_METHOD _CNV_A_R_LINEAR_____257_CM "" RAT_FUNC "%6.3" "mg/stk" COEFFS 0 47.18214541280769 -1.080506262951531e-005 0 0 1 /end COMPU_METHOD
/begin COMPU_METHOD _CNV_A_R_LINEAR_____280_CM "" RAT_FUNC "%6.3" "°C" COEFFS 0 43.47840509520334 2086.96344456976 0 0 1 /end COMPU_METHOD
/begin COMPU_METHOD _CNV_A_R_LINEAR_____281_CM "" RAT_FUNC "%6.3" "-" COEFFS 0 32768.00003968061 3.96806062781252e-005 0 0 1 /end COMPU_METHOD
/begin COMPU_METHOD _CNV_A_R_LINEAR_____287_CM "" RAT_FUNC "%6.3" "g" COEFFS 0 36.00036915004301 0. 0 0 1 /end COMPU_METHOD
/begin COMPU_METHOD _CNV_A_R_LINEAR_____375_CM "" RAT_FUNC "%6.3" "hPa/ms" COEFFS 0 395.1938017499002 -7.983716819580877e-003 0 0 1 /end COMPU_METHOD
/begin COMPU_METHOD _CNV_A_R_LINEAR_____376_CM "" RAT_FUNC "%6.3" "s/m" COEFFS 0 3181017.284813537 0. 0 0 1 /end COMPU_METHOD
/begin COMPU_METHOD _CNV_A_R_LINEAR_____377_CM "" RAT_FUNC "%6.3" "-" COEFFS 0 7379.793318491542 0. 0 0 1 /end COMPU_METHOD
/begin COMPU_METHOD _CNV_A_R_LINEAR_____378_CM "" RAT_FUNC "%6.3" "1/(s^2*m)" COEFFS 0 5.615152789530994e-004 0. 0 0 1 /end COMPU_METHOD
/begin COMPU_METHOD _CNV_A_R_LINEAR_____379_CM "" RAT_FUNC "%6.3" "J/(kg K)" COEFFS 0 0.89198606271777 0. 0 0 1 /end COMPU_METHOD
/begin COMPU_METHOD _CNV_A_R_LINEAR_____380_CM "" RAT_FUNC "%6.3" "dm^3" COEFFS 0 271.1050690753992 -1.110223024625157e-015 0 0 1 /end COMPU_METHOD
/begin COMPU_METHOD _CNV_A_R_LINEAR_____381_CM "" RAT_FUNC "%6.3" "mg/stk" COEFFS 0 47.18070554355651 0. 0 0 1 /end COMPU_METHOD
/begin COMPU_METHOD _CNV_A_R_LINEAR_____382_CM "" RAT_FUNC "%6.3" "cm²" COEFFS 0 1118.481084425738 0. 0 0 1 /end COMPU_METHOD
/begin COMPU_METHOD _CNV_A_R_LINEAR_____394_CM "" RAT_FUNC "%6.3" "-" COEFFS 0 8191.999999679995 0. 0 0 1 /end COMPU_METHOD
/begin COMPU_METHOD _CNV_A_R_LINEAR_____395_CM "" RAT_FUNC "%6.3" "kg/(h*hPa)" COEFFS 0 5434.241818163727 32767.99999915545 0 0 1 /end COMPU_METHOD
/begin COMPU_METHOD _CNV_A_R_LINEAR_____396_CM "" RAT_FUNC "%6.3" "°CRK" COEFFS 0 42.66666666666666 32768. 0 0 1 /end COMPU_METHOD
/begin COMPU_METHOD _CNV_A_R_LINEAR_____397_CM "" RAT_FUNC "%6.3" "kg/(h*hPa)" COEFFS 0 5434.241818163727 0. 0 0 1 /end COMPU_METHOD
/begin COMPU_METHOD _CNV_A_R_LINEAR_____417_CM "" RAT_FUNC "%6.3" "rpm" COEFFS 0 511.9999948599216 0. 0 0 1 /end COMPU_METHOD
/begin COMPU_METHOD _CNV_A_R_LINEAR_____418_CM "" RAT_FUNC "%6.3" "rpm" COEFFS 0 1. 65536. 0 0 1 /end COMPU_METHOD
/begin COMPU_METHOD _CNV_A_R_LINEAR_____419_CM "" RAT_FUNC "%6.3" "rpm" COEFFS 0 31.99899215772732 3.149507102140348e-005 0 0 1 /end COMPU_METHOD
/begin COMPU_METHOD _CNV_A_R_LINEAR_____420_CM "" RAT_FUNC "%6.3" "rpm/10ms" COEFFS 0 4. 0. 0 0 1 /end COMPU_METHOD
/begin COMPU_METHOD _CNV_A_R_LINEAR_____421_CM "" RAT_FUNC "%6.3" "rpm/10ms" COEFFS 0 16. 0. 0 0 1 /end COMPU_METHOD
/begin COMPU_METHOD _CNV_A_R_LINEAR_____426_CM "" RAT_FUNC "%6.3" "-" COEFFS 0 2048. 0. 0 0 1 /end COMPU_METHOD
/begin COMPU_METHOD _CNV_A_R_LINEAR_____429_CM "" RAT_FUNC "%6.3" "ppm" COEFFS 0 0.9999999999999994 9.379164112033323e-013 0 0 1 /end COMPU_METHOD
/begin COMPU_METHOD _CNV_A_R_LINEAR_____442_CM "" RAT_FUNC "%6.3" "%" COEFFS 0 655.34 0. 0 0 1 /end COMPU_METHOD
/begin COMPU_METHOD _CNV_A_R_LINEAR_____443_CM "" RAT_FUNC "%6.3" "ppm" COEFFS 0 0.9999999999999994 100.0000000000009 0 0 1 /end COMPU_METHOD
/begin COMPU_METHOD _CNV_S_4_STATE_NOX__444_CM "" TAB_VERB "%6.3" "[-]" COMPU_TAB_REF _CNV_S_4_STATE_NOX__444 /end COMPU_METHOD
/begin COMPU_VTAB _CNV_S_4_STATE_NOX__444 "" TAB_VERB 4 0 "PASSIVE" 1 "START" 2 "ACTIVE" 3 "FAILED" /end COMPU_VTAB
/begin COMPU_METHOD _CNV_S_3_STATE_NOX__445_CM "" TAB_VERB "%6.3" "[-]" COMPU_TAB_REF _CNV_S_3_STATE_NOX__445 /end COMPU_METHOD
/begin COMPU_VTAB _CNV_S_3_STATE_NOX__445 "" TAB_VERB 3 0 "PASSIVE" 1 "START" 2 "ACTIVE" /end COMPU_VTAB
/begin COMPU_METHOD _CNV_S_5_STATE_DYN__446_CM "" TAB_VERB "%6.3" "[-]" COMPU_TAB_REF _CNV_S_5_STATE_DYN__446 /end COMPU_METHOD
/begin COMPU_VTAB _CNV_S_5_STATE_DYN__446 "" TAB_VERB 5 0 "WAIT" 1 "INIT" 2 "DIAG" 4 "OK" 8 "FAILED" /end COMPU_VTAB
/begin COMPU_METHOD _CNV_A_R_LINEAR_____447_CM "" RAT_FUNC "%6.3" "V" COEFFS 0 204.7999995887937 0. 0 0 1 /end COMPU_METHOD
/begin COMPU_METHOD _CNV_A_R_LINEAR_____448_CM "" RAT_FUNC "%6.3" "%/V" COEFFS 0 3.2 0. 0 0 1 /end COMPU_METHOD
/begin COMPU_METHOD _CNV_A_R_LINEAR_____449_CM "" RAT_FUNC "%6.3" "-" COEFFS 0 32768.00003968061 32768.00003968061 0 0 1 /end COMPU_METHOD
/begin COMPU_METHOD _CNV_A_R_LINEAR_____450_CM "" RAT_FUNC "%6.3" "kg/h" COEFFS 0 128.0000018750286 0. 0 0 1 /end COMPU_METHOD
/begin COMPU_METHOD _CNV_A_R_LINEAR_____465_CM "" RAT_FUNC "%6.3" "°C/10s" COEFFS 0 1.333333333333333 0. 0 0 1 /end COMPU_METHOD
/begin COMPU_METHOD _CNV_A_R_LINEAR_____466_CM "" RAT_FUNC "%6.3" "V" COEFFS 0 204.7999998958713 8.135057072422569e-009 0 0 1 /end COMPU_METHOD
/begin COMPU_METHOD _CNV_A_R_LINEAR_____467_CM "" RAT_FUNC "%6.3" "°C" COEFFS 0 64. 0. 0 0 1 /end COMPU_METHOD
/begin COMPU_METHOD _CNV_A_R_LINEAR_____495_CM "" RAT_FUNC "%6.3" "°C/500ms" COEFFS 0 1.333333333333333 0. 0 0 1 /end COMPU_METHOD
/begin COMPU_METHOD _CNV_A_R_LINEAR_____496_CM "" RAT_FUNC "%6.3" "V" COEFFS 0 51.2 0. 0 0 1 /end COMPU_METHOD
/begin COMPU_METHOD _CNV_A_R_LINEAR_____538_CM "" RAT_FUNC "%6.3" "ms" COEFFS 0 125. 0. 0 0 1 /end COMPU_METHOD
/begin COMPU_METHOD _CNV_A_R_LINEAR_____539_CM "" RAT_FUNC "%6.3" "(km/h)/10ms" COEFFS 0 128. 0. 0 0 1 /end COMPU_METHOD
/begin COMPU_METHOD _CNV_A_R_LINEAR_____540_CM "" RAT_FUNC "%6.3" "m" COEFFS 0 57600021.97266463 0. 0 0 1 /end COMPU_METHOD
/begin RECORD_LAYOUT _REC_VAL_20_u1 FNC_VALUES 1 UBYTE COLUMN_DIR DIRECT /end RECORD_LAYOUT
/begin RECORD_LAYOUT _REC_VAL_20_u2 FNC_VALUES 1 UWORD COLUMN_DIR DIRECT /end RECORD_LAYOUT
/begin RECORD_LAYOUT _REC_CUR_20_u2_u1 FNC_VALUES 1 UWORD COLUMN_DIR DIRECT /end RECORD_LAYOUT
/begin RECORD_LAYOUT _REC_AXS_20_u1 NO_AXIS_PTS_X 1 UBYTE AXIS_PTS_X 2 UBYTE INDEX_INCR DIRECT /end RECORD_LAYOUT
/begin RECORD_LAYOUT _REC_CUR_20_u1_u1 FNC_VALUES 1 UBYTE COLUMN_DIR DIRECT /end RECORD_LAYOUT
/begin RECORD_LAYOUT _REC_AXS_20_u2 NO_AXIS_PTS_X 1 UWORD AXIS_PTS_X 2 UWORD INDEX_INCR DIRECT /end RECORD_LAYOUT
/begin RECORD_LAYOUT _REC_MAP_20_u1_u1_u2 FNC_VALUES 1 UBYTE COLUMN_DIR DIRECT /end RECORD_LAYOUT
/begin RECORD_LAYOUT _REC_MAP_20_u2_u2_u1 FNC_VALUES 1 UWORD COLUMN_DIR DIRECT /end RECORD_LAYOUT
/begin RECORD_LAYOUT _REC_CUR_20_u1_u2 FNC_VALUES 1 UBYTE COLUMN_DIR DIRECT /end RECORD_LAYOUT
/begin RECORD_LAYOUT _REC_CUR_20_u2_u2 FNC_VALUES 1 UWORD COLUMN_DIR DIRECT /end RECORD_LAYOUT
/begin RECORD_LAYOUT _REC_VAL_20_u4 FNC_VALUES 1 ULONG COLUMN_DIR DIRECT /end RECORD_LAYOUT
/begin RECORD_LAYOUT _REC_VAL_20_s2 FNC_VALUES 1 SWORD COLUMN_DIR DIRECT /end RECORD_LAYOUT
/begin RECORD_LAYOUT _REC_MAP_20_u2_u1_u2 FNC_VALUES 1 UWORD COLUMN_DIR DIRECT /end RECORD_LAYOUT
/begin RECORD_LAYOUT _REC_MAP_20_u2_u2_u2 FNC_VALUES 1 UWORD COLUMN_DIR DIRECT /end RECORD_LAYOUT
/begin FUNCTION OBD_NOx_sensor_OBDII_diagnosis "_NOx_sensor OBDII diagnosis"
 /begin DEF_CHARACTERISTIC lc_nox_sens_diag_vls_down_use c_t_nox_sens_nox_hld_diag c_t_nox_sens_lamb_hld_diag c_t_nox_sens_vls_hld_diag c_nox_sens_vb_min c_nox_sens_vb_max c_t_nox_sens_htp_st_max c_teg_cat_down_mdl_htp_min c_t_nox_sens_htp_max c_abc_inc_nox_sens_htp c_abc_max_nox_sens_htp c_n_dyw_nox_sens c_maf_dyw_nox_sens c_lam_mv_dyw_nox_sens c_maf_int_ldc_dly_nox_sens c_lamb_afr_diag_max c_lamb_puc_diag_min c_maf_int_puc_diag_min c_vls_down_puc_diag_max c_tcc_nox_sens_puc_act c_nox_nox_sens_puc_max c_lamb_nox_sens_puc_min c_vls_nox_sens_puc_max c_vls_down_afr_diag_min c_maf_int_afr_diag_min c_tcc_nox_sens_afr_act c_nox_nox_sens_afr_min c_vls_nox_sens_afr_min c_lamb_up_down_diag_min c_lamb_up_down_diag_max ldp_lamb_ip_lamb_up_down ip_lamb_up_down c_abc_inc_nox_sens_plaus c_abc_max_nox_sens_plaus c_tcc_nox_sens_avl_st_max c_tcc_nox_sens_avl c_frc_nox_sens_nox_avl c_abc_inc_nox_sens_avl c_abc_max_nox_sens_avl c_maf_int_puc_nox_dyn_diag_min ldp_lamb_ip_nox_dyn_diag ldpm_maf_kgh_ip_nox_dyn_diag ip_nox_dyn_diag ip_t_nox_dyn_diag_end c_vls_down_nox_dyn_diag c_vls_nox_sens_nox_dyn_diag c_maf_int_puc_lamb_dyn_diag_min c_nox_sens_lamb_dyn_diag_st c_lamb_lamb_dyn_diag_min c_nox_sens_lamb_dyn_diag_min c_maf_int_puc_vls_dyn_diag_min c_nox_sens_vls_dyn_diag_st c_lamb_vls_dyn_diag_min c_nox_sens_vls_dyn_diag_min c_abc_inc_nox_sens_dyn c_abc_max_nox_sens_dyn c_abc_inc_nox_sens_ref_air c_abc_max_nox_sens_ref_air c_lamb_nox_sens_afr_max c_vls_down_lamb_dyn_diag /end DEF_CHARACTERISTIC
 /begin OUT_MEASUREMENT lv_err_nox_sens_obd_1 lv_err_nox_sens_obd_2 state_nox_sens_htp_diag_1 state_nox_sens_htp_diag_2 t_nox_sens_htp_diag_1 t_nox_sens_htp_diag_2 lv_err_nox_sens_htp_1 lv_err_nox_sens_htp_2 lv_nox_sens_htp_diag_1 lv_nox_sens_htp_diag_2 lv_ldc_nox_sens_1 lv_ldc_nox_sens_2 maf_int_ldc_dly_nox_sens_1 maf_int_ldc_dly_nox_sens_2 tcc_nox_sens_puc_act_1 tcc_nox_sens_puc_act_2 tcc_nox_sens_afr_act_1 tcc_nox_sens_afr_act_2 maf_int_afr_1 maf_int_afr_2 nox_sens_afr_1 nox_sens_afr_2 nox_sens_up_down_1 nox_sens_up_down_2 lv_err_nox_sens_plaus_1 lv_err_nox_sens_plaus_2 state_nox_sens_avl_diag_1 state_nox_sens_avl_diag_2 tcc_nox_sens_avl_1 tcc_nox_sens_avl_2 frc_nox_sens_nox_avl_1 frc_nox_sens_nox_avl_2 lv_err_nox_sens_avl_1 lv_err_nox_sens_avl_2 state_nox_dyn_diag_1 state_nox_dyn_diag_2 t_main_cat_purge_1 t_main_cat_purge_2 t_nox_dyn_diag_end_1 t_nox_dyn_diag_end_2 nox_sens_nox_dyn_diag_st_1 nox_sens_nox_dyn_diag_st_2 nox_sens_nox_dyn_diag_max_1 nox_sens_nox_dyn_diag_max_2 nox_sens_nox_dyn_diag_min_1 nox_sens_nox_dyn_diag_min_2 lv_nox_sens_nox_dyn_1 lv_nox_sens_nox_dyn_2 state_lamb_dyn_diag_1 state_lamb_dyn_diag_2 nox_sens_lamb_dyn_diag_st_1 nox_sens_lamb_dyn_diag_st_2 nox_sens_lamb_dyn_diag_max_1 nox_sens_lamb_dyn_diag_max_2 state_vls_dyn_diag_1 state_vls_dyn_diag_2 nox_sens_vls_dyn_diag_st_1 nox_sens_vls_dyn_diag_st_2 nox_sens_vls_dyn_diag_end_1 nox_sens_vls_dyn_diag_end_2 nox_sens_dyn_1 nox_sens_dyn_2 lv_err_nox_sens_dyn_1 lv_err_nox_sens_dyn_2 lv_err_nox_sens_ref_air_1 lv_err_nox_sens_ref_air_2 /end OUT_MEASUREMENT
/end FUNCTION
/begin FUNCTION NOx_sensor_OBD_II_diagnosis__App "NOx sensor OBD II diagnosis (Application Incidences)" /begin DEF_CHARACTERISTIC c_inh_diag_nox_sens_htp c_inh_diag_nox_sens_obd /end DEF_CHARACTERISTIC
 /begin OUT_MEASUREMENT lv_inh_diag_nox_sens_htp_1 lv_inh_diag_nox_sens_htp_2 lv_inh_diag_nox_sens_obd_1 lv_inh_diag_nox_sens_obd_2 /end OUT_MEASUREMENT
/end FUNCTION
/begin FUNCTION OBD_Application_Incidences_of_Dy "_Application Incidences of Dynamic fuel trim diagnosis"
 /begin OUT_MEASUREMENT lam_bank_1.lam_dly_obd2_inci.lv_inh_diag_delta_lamb_i lam_bank_2.lam_dly_obd2_inci.lv_inh_diag_delta_lamb_i /end OUT_MEASUREMENT
/end FUNCTION
/begin FUNCTION OBD_Statistical_data_for_once_pe "_Statistical data for once per DC diagnosis"
 /begin OUT_MEASUREMENT fmy_ctr_diag_dc_end[0] fmy_ctr_diag_dc_end[1] fmy_ctr_diag_dc_end[2] fmy_ctr_diag_dc_end[3] fmy_ctr_diag_dc_end[4] fmy_ctr_diag_dc_end[5] fmy_ctr_diag_dc_end[6] fmy_ctr_diag_dc_end[7] fmy_ctr_diag_dc_end[8] fmy_ctr_diag_dc_end[9] fmy_ctr_diag_dc_end[10] fmy_ctr_diag_dc_end[11] fmy_ctr_diag_dc_end[12] ctr_cycnr_dc_end /end OUT_MEASUREMENT
/end FUNCTION
/begin FUNCTION SYS_System_Variables "SYS"
 /begin SUB_FUNCTION SYS_Engine_speed_setpoint_calcul SYS_Engine_speed_limit_coordinat SYS_Mass_airflow_variables SYS_Intake_manifold_model SYS_Pressure_decrease_in_the_air SYS_Volumetric_efficiency SYS_Vehicle_speed_variables SYS_Battery_voltage SYS_Coolant_temperature SYS_Air_temperature SYS_Exhaust_temperature_variable SYS_Determination_of_accelerator SYS_IVVT_Variables SYS_Gear_ratio_detection SYS_Drive_train_engaged SYS_Clutch_switch_detection SYS_Input_messages SYS_Oil_temperature SYS_Ambient_pressure_variables SYS_System_variables_in_the_exha SYS_Reduced_area_controller SYS_Ambient_Pressure_Control SYS_Engine_speed_calculation SYS_Fuel_pressure_acquisition SYS_Detection_of_Driver_Passive SYS_System_variables_for_and_fro SYS_ECU_state SYS_Pressure_Variables SYS_Engine_off_duration SYS_Calculation_of_the_basic_red SYS_Total_running_time SYS_Determination_of_Throttle_Po _Intake_manifold_model SYS_ECU_Temperature SYS_Vol_Eff_Cor_due_to_Port_Flap SYS_Output_signals_of_the_DME_to SYS__BSW__Wide_Range_Air_Fuel_se SYS__ASW__Wide_Range_Air_Fuel_se SYS_Oxygen_sensor_ceramic_temper SYS_Downstream_oxygen_sensor_int SYS_Oil_temperature_and_level_se SYS_Check_Sum_Calculation SYS_Multiplexed_segment_synchron SYS_NOx_Sensor_Interface SYS_Upstream_oxygen_sensor_inter SYS_Evaporative_Emission_Control SYS_Application_Incidences_NOx_S SYS_BN2000_interface_torque_dist SYS_Application_incidences_for_o SYS_Application_specific_conditi SYS_Driving_off_assistance /end SUB_FUNCTION
/end FUNCTION
/begin FUNCTION SYS_Engine_speed_setpoint_calcul "_Engine speed setpoint calculation"
 /begin DEF_CHARACTERISTIC c_n_dif_crlc c_n_dif_min_mmv c_n_dif_fac ip_dri_acin_n_sp_is ip_dri_n_sp_is ip_n_sp_is_lih ip_dri_n_sp_is_lih ip_n_sp_is ip_acin_n_sp_is ip_fac_n_sp_ofs_kwp ip_dri_n_sp_ch ip_n_sp_ch ip_fac_dri_n_sp_ch ip_fac_n_sp_ch ip_n_sp_dec_ch ip_t_ast_min_n_sp_is_cs c_n_sp_ofs_kwp_max c_n_sp_ofs_kwp_min c_tam_n_sp_heat c_tam_hys c_n_sp_heat_mt c_n_sp_heat_at c_n_sp_inc_cs c_n_sp_dec_cs c_toil_min_n_sp_at c_toil_hys_n_sp_at c_n_sp_toil_at c_n_sp_lgrd_is_lih c_n_sp_is_sa_eol c_n_sp_lgrd_is c_n_sp_dec_is_ch_dri ip_n_sp_is_cs ip_n_sp_is_cs_amt c_dri_vs_min_vb c_vs_max_n_sp_cs c_vs_hys_n_sp_cs lc_is_n_sp_cs_dis /end DEF_CHARACTERISTIC
 /begin OUT_MEASUREMENT n_dif_cor n_dif_mmv n_max_tol_st n_dif_st n_sp_is_ratio n_dif n_sp_is_pow n_sp_is_ch n_sp_is_2 n_sp_is_3 lv_req_heat_n_sp_is n_sp_is lv_n_sp_is_cs /end OUT_MEASUREMENT
/end FUNCTION
/begin FUNCTION SYS_Engine_speed_limit_coordinat "_Engine speed limit coordination"
 /begin DEF_CHARACTERISTIC ip_n_max_mtc_cur_off__pv_av c_n_max_mtc_lih c_vs_max c_n_max_thd_min c_vs_max_amt ip_n_max_2__toil ip_n_max_1__toil c_n_max_amt_add c_n_max_amt_gp id_n_max_mt id_n_max_amt id_n_max_at id_n_max_h_mt id_n_max_h_amt id_n_max_h_at id_t_n_max_h_amt id_t_n_max_h_mt id_t_n_max_h_at id_n_dec_n_max_h_mt id_n_dec_n_max_h_amt id_n_dec_n_max_h_at c_n_max_dri_rvl c_vs_thd_n_max_h_mt c_vs_thd_n_max_h_amt c_vs_thd_n_max_h_at c_t_max_n_max_h_amt c_t_max_n_max_h_at c_t_max_n_max_h_mt /end DEF_CHARACTERISTIC
 /begin OUT_MEASUREMENT n_max_thd n_max_thd_1 n_max_thd_2 lv_vs_max vs_ratio n_max_vs_max lv_n_max_h lv_n_max_etc_lih /end OUT_MEASUREMENT
/end FUNCTION
/begin FUNCTION SYS_Mass_airflow_variables "_Mass airflow variables"
 /begin DEF_CHARACTERISTIC ip_pq_sp_puls c_pq_sp_hys_puls c_maf_mmv_dif_crlc c_maf_mmv_hys /end DEF_CHARACTERISTIC
 /begin OUT_MEASUREMENT maf_kgh_mes_bas maf_mes maf_kgh_mes lv_maf_puls maf_kgh maf_dif maf_mmv /end OUT_MEASUREMENT
/end FUNCTION
/begin FUNCTION SYS_Intake_manifold_model "_Intake manifold model"
 /begin DEF_CHARACTERISTIC ip_maf_mdl_con_1__tia ip_maf_egr_con_1__teg_egr ip_pred_fac__n id_maf_fac_ofs__pq_estim id_maf_fac_slop__pq_estim c_pq_thd c_pq_thd_hys c_ra ip_vol_im_neg ip_vol_im_is ip_vol_im ip_vol_im_is_neg ip_pq_isa /end DEF_CHARACTERISTIC
 /begin OUT_MEASUREMENT maf_cyl_stk maf_kgh_clc map_egr map_egr_pred map_fg_pred map_pred map_fg pq pq_egr pq_egr_estim maf_thr maf_egr map_drv1 map_egr_drv1 maf_egr_con_1 maf_fac_ofs maf_fac_ofs_egr maf_fac_slop maf_cyl maf_fg_cyl maf_fg_cyl_stk fac_maf_max maf_fac_slop_egr maf_mdl_con_1 maf_mdl_con_0 map maf_isa_fac_ofs maf_isa_fac_slop maf_thr_isa_tot maf_isa egr_ratio lv_h_load_maf_thr pq_estim pq_isa_estim map_estim maf vol_im t_seg_imm /end OUT_MEASUREMENT
/end FUNCTION
/begin FUNCTION SYS_Pressure_decrease_in_the_air "_Pressure decrease in the air filter" /begin DEF_CHARACTERISTIC ip_amp_dec__maf_cyl lc_amp_inp_ena /end DEF_CHARACTERISTIC /begin OUT_MEASUREMENT prs_up_thr prs_up_thr_max /end OUT_MEASUREMENT /end FUNCTION
/begin FUNCTION SYS_Volumetric_efficiency "_Volumetric efficiency"
 /begin DEF_CHARACTERISTIC ip_t_vim_eff_vol ip_eff_vol_slop_cam_in_vim ip_eff_vol_slop_cam_vo_vim ip_eff_vol_ofs_vim ip_eff_vol_ofs ip_eff_vol_ofs_amp c_tcyl_stnd c_tco_stnd c_tia_im_stnd ip_eff_vol_slop_cam_vo ip_eff_vol_slop_cam_in ip_crlc_eff_vol_temp_cor ip_eff_tco_fac__n_32__maf ip_eff_tia_im_fac__n_32__maf ip_eff_vol_slop_amp ip_eff_vol_ofs_max ip_eff_vol_slop_max /end DEF_CHARACTERISTIC
 /begin OUT_MEASUREMENT eff_vol_slop eff_vol_temp_cor eff_vol_temp_cor_mmv eff_vol_ofs_max_cor eff_vol_ofs eff_vol_slop_max_cor eff_vol_ofs_bas eff_vol_slop_bas eff_vol_ofs_bas_goal eff_vol_slop_bas_goal eff_vol_ofs_bas_0 eff_vol_slop_bas_0 eff_vol_ofs_bas_1 eff_vol_slop_bas_1 /end OUT_MEASUREMENT
/end FUNCTION
/begin FUNCTION SYS_Vehicle_speed_variables "_Vehicle speed variables" /begin DEF_CHARACTERISTIC c_vs_min_run c_t_vst c_vs_edge_sum_min c_vs_fac /end DEF_CHARACTERISTIC
 /begin OUT_MEASUREMENT vs_edge_av.edge_ctr vs_edge_av.edge_t lv_vs_run vs_sens vs_sens_grd lv_vst vs /end OUT_MEASUREMENT
/end FUNCTION
/begin FUNCTION SYS_Battery_voltage "_Battery voltage"
 /begin DEF_CHARACTERISTIC c_crlc_vb c_vb_min_jump c_vb_min_obd2 c_vb_min_can_diag c_vb_max_obd1 c_vb_min_obd1 c_vb_max_obd2 c_t_min_can_diag c_vb_min_diag c_vb_min_bn_diag /end DEF_CHARACTERISTIC
 /begin OUT_MEASUREMENT lv_vb_jump vb_mmv lv_cdn_vb_obd1 lv_cdn_vb_obd2 lv_igk vb vb_secu v_igk lv_cdn_vb_min_diag lv_cdn_vb_can_diag lv_cdn_vb_bn_diag /end OUT_MEASUREMENT
/end FUNCTION
/begin FUNCTION SYS_Coolant_temperature "_Coolant temperature"
 /begin DEF_CHARACTERISTIC c_t_tco_sub_is_2 c_t_tco_sub_puc c_tco_sub_bol_2 c_tco_sub_tol c_tia_diag ip_tco_sub_inc__maf_kgh c_tco_sub_bol_1 c_tco_ex_dif_diag ip_tco__v_tco c_t_tco_sub_is_1 c_t_dly_tco_sub /end DEF_CHARACTERISTIC
 /begin OUT_MEASUREMENT tco_sub tco_stop tco tco_mes tco_st tco_ex_st tco_ex tco_ex_mes /end OUT_MEASUREMENT
/end FUNCTION
/begin FUNCTION SYS_Air_temperature "_Air temperature"
 /begin DEF_CHARACTERISTIC c_tia_grd_max_diag ip_tia__v_tia c_tco_diag c_tia_sub_tol c_tia_sub_bol /end DEF_CHARACTERISTIC
 /begin OUT_MEASUREMENT tia_sub tia tia_mes /end OUT_MEASUREMENT
/end FUNCTION
/begin FUNCTION SYS_Exhaust_temperature_variable "_Exhaust temperature variables" /begin DEF_CHARACTERISTIC ip_teg__v_teg /end DEF_CHARACTERISTIC
 /begin OUT_MEASUREMENT teg_pcat_down_1 teg_pcat_down_2 teg_pcat_down_raw_2 teg_pcat_down_raw_1 /end OUT_MEASUREMENT
/end FUNCTION
/begin FUNCTION SYS_Determination_of_accelerator "_Determination of accelerator pedal value"
 /begin DEF_CHARACTERISTIC c_pv_grd_lih_max c_v_pvs_hys_fil c_pvs_slop_1 c_pvs_slop_2 c_v_pvs_ofs_1 c_v_pvs_ofs_2 c_pv_av_bls_not_plaus_lgrd c_pv_av_bls_not_plaus_hys c_pv_av_bls_not_plaus ip_pv_lih_max ip_fac_pv_bas_cor_mt ip_fac_pv_bas_cor_at ip_fac_pv_bas_cor_amt ip_fac_pv_cs_cor_amt ip_fac_pv_cs_cor_mt ip_fac_pv_gs_cor_amt ip_fac_pv_gs_cor_mt ip_fac_vs_pv_gs_cor_amt ip_fac_vs_pv_gs_cor_mt ip_fac_vs_pv_bas_cor_mt ip_fac_vs_pv_bas_cor_at ip_fac_vs_pv_bas_cor_amt c_add_fac_pv_bas_mt c_add_fac_pv_bas_at c_add_fac_pv_bas_amt c_t_fac_pv_gs c_t_fac_pv_cs c_vs_max_fac_pv_cor c_v_pvs_thd_kd_hys c_v_pvs_thd_kd ip_pv_cru_rng_l ip_pv_cru /end DEF_CHARACTERISTIC
 /begin OUT_MEASUREMENT v_pvs_fil_1 v_pvs_fil_2 lv_kd pv_av pv_av_2 pv_max pv_av_grd pv_av_1 fac_pv_cs_cor fac_pv_gs_cor fac_pv_bas_cor fac_pv_cor pv_av_raw pv_cru /end OUT_MEASUREMENT
/end FUNCTION
/begin FUNCTION SYS_IVVT_Variables "_IVVT Variables"
 /begin DEF_CHARACTERISTIC ip_fac_ivvt__vo ip_crlc_maf_ivvt__n__maf_sp c_cam_op_ex c_cam_op_in c_cam_adj_rng_max_in c_cam_adj_rng_max_ex c_crlc_vo_mmv /end DEF_CHARACTERISTIC
 /begin OUT_MEASUREMENT vo_min vo_max cam_av_mv_in maf_ivvt fac_ivvt vo_sp vo_sp_ref vo vo_bas /end OUT_MEASUREMENT
/end FUNCTION
/begin FUNCTION SYS_Gear_ratio_detection "_Gear ratio detection"
 /begin DEF_CHARACTERISTIC c_min_vs_ratio id_gr_mt__n_vs_ratio lc_rng_l c_gr_rax_sp c_crlc_fac_gr c_n_vs_cru_gear2_puc_sp c_n_vs_cru_grd_fac_gr_max /end DEF_CHARACTERISTIC
 /begin OUT_MEASUREMENT gr_mt gr_at lv_rng_l lv_dri gear_ef state_gear_rev_at_amt n_vs_ratio fac_gr fac_gr_mmv_av gr_rax_av /end OUT_MEASUREMENT
/end FUNCTION
/begin FUNCTION SYS_Drive_train_engaged "_Drive train engaged" /begin DEF_CHARACTERISTIC c_vs_min_dt /end DEF_CHARACTERISTIC /begin OUT_MEASUREMENT lv_dt /end OUT_MEASUREMENT /end FUNCTION
/begin FUNCTION SYS_Clutch_switch_detection "_Clutch switch detection" /begin OUT_MEASUREMENT lv_cs /end OUT_MEASUREMENT /end FUNCTION
/end MODULE
/end PROJECT
