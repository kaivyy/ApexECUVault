ASAP2_VERSION 1 3
/begin PROJECT P390 "BMW DDE6.2 6-Zylinder VP0.1 11.11.2003 CAN12H"
/begin HEADER "" VERSION "VP01_6Z_CAN12H" PROJECT_NO P390 /end HEADER
/begin MODULE DIM ""
/begin MOD_COMMON "" BYTE_ORDER MSB_FIRST ALIGNMENT_BYTE 1 ALIGNMENT_WORD 2 ALIGNMENT_LONG 4 ALIGNMENT_FLOAT32_IEEE 4 /end MOD_COMMON
/begin CHARACTERISTIC PCR_I1AdPCVKi_C "Grundwert der I-Verstaerkung des I-Reglers bei Kleinsignalen" VALUE 0xE5FE0 Kw_Wu32 999999.999767 Ki 0.00 999999.999767 FORMAT "%13.6" /end CHARACTERISTIC
/begin CHARACTERISTIC PCR_I1AdPCVKiPos_C "Grundwert der I-Verstaerkung des I-Reglers bei positiven Grossesignalen" VALUE 0xE5FE4 Kw_Wu32 999999.999767 Ki 0.00 999999.999767 FORMAT "%13.6" /end CHARACTERISTIC
/begin CHARACTERISTIC PCR_I1AdPCVKiNeg_C "Grundwert der I-Verstaerkung des I-Reglers bei negativen Grossesignalen" VALUE 0xE5FE8 Kw_Wu32 999999.999767 Ki 0.00 999999.999767 FORMAT "%13.6" /end CHARACTERISTIC
/begin CHARACTERISTIC PCR_rI1AdPCVWinPos_C "obere Kleinsignalgrenze des I-Reglers" VALUE 0xE5FEC Kw_Ws16 799.9878 Prc -400.0000 399.9878 FORMAT "%8.4" /end CHARACTERISTIC
/begin CHARACTERISTIC PCR_rI1AdPCVWinNeg_C "untere Kleinsignalgrenze des I-Reglers" VALUE 0xE5FEE Kw_Ws16 799.9878 Prc -400.0000 399.9878 FORMAT "%8.4" /end CHARACTERISTIC
/begin CHARACTERISTIC PCR_I2AdPCVKi_C "Grundwert der I-Verstaerkung des I-Reglers bei Kleinsignalen" VALUE 0xE5FF0 Kw_Wu32 999999.999767 Ki 0.00 999999.999767 FORMAT "%13.6" /end CHARACTERISTIC
/begin CHARACTERISTIC PCR_I2AdPCVKiPos_C "Grundwert der I-Verstaerkung des I-Reglers bei positiven Grossesignalen" VALUE 0xE5FF4 Kw_Wu32 999999.999767 Ki 0.00 999999.999767 FORMAT "%13.6" /end CHARACTERISTIC
/begin CHARACTERISTIC PCR_I2AdPCVKiNeg_C "Grundwert der I-Verstaerkung des I-Reglers bei negativen Grossesignalen" VALUE 0xE5FF8 Kw_Wu32 999999.999767 Ki 0.00 999999.999767 FORMAT "%13.6" /end CHARACTERISTIC
/begin CHARACTERISTIC PCR_rI2AdPCVWinPos_C "obere Kleinsignalgrenze des I-Reglers" VALUE 0xE5FFC Kw_Ws16 799.9878 Prc -400.0000 399.9878 FORMAT "%8.4" /end CHARACTERISTIC
/begin CHARACTERISTIC PCR_rI2AdPCVWinNeg_C "untere Kleinsignalgrenze des I-Reglers" VALUE 0xE5FFE Kw_Ws16 799.9878 Prc -400.0000 399.9878 FORMAT "%8.4" /end CHARACTERISTIC
/begin CHARACTERISTIC PCR_I3AdPCVKi_C "Grundwert der I-Verstaerkung des I-Reglers bei Kleinsignalen" VALUE 0xE6000 Kw_Wu32 999999.999767 Ki 0.00 999999.999767 FORMAT "%13.6" /end CHARACTERISTIC
/begin CHARACTERISTIC PCR_I3AdPCVKiPos_C "Grundwert der I-Verstaerkung des I-Reglers bei positiven Grossesignalen" VALUE 0xE6004 Kw_Wu32 999999.999767 Ki 0.00 999999.999767 FORMAT "%13.6" /end CHARACTERISTIC
/begin CHARACTERISTIC PCR_I3AdPCVKiNeg_C "Grundwert der I-Verstaerkung des I-Reglers bei negativen Grossesignalen" VALUE 0xE6008 Kw_Wu32 999999.999767 Ki 0.00 999999.999767 FORMAT "%13.6" /end CHARACTERISTIC
/begin CHARACTERISTIC PCR_rI3AdPCVWinPos_C "obere Kleinsignalgrenze des I-Reglers" VALUE 0xE600C Kw_Ws16 799.9878 Prc -400.0000 399.9878 FORMAT "%8.4" /end CHARACTERISTIC
/begin CHARACTERISTIC PCR_rI3AdPCVWinNeg_C "untere Kleinsignalgrenze des I-Reglers" VALUE 0xE600E Kw_Ws16 799.9878 Prc -400.0000 399.9878 FORMAT "%8.4" /end CHARACTERISTIC
/begin CHARACTERISTIC PCR_I4AdPCVKi_C "Grundwert der I-Verstaerkung des I-Reglers bei Kleinsignalen" VALUE 0xE6010 Kw_Wu32 999999.999767 Ki 0.00 999999.999767 FORMAT "%13.6" /end CHARACTERISTIC
/begin CHARACTERISTIC PCR_I4AdPCVKiPos_C "Grundwert der I-Verstaerkung des I-Reglers bei positiven Grossesignalen" VALUE 0xE6014 Kw_Wu32 999999.999767 Ki 0.00 999999.999767 FORMAT "%13.6" /end CHARACTERISTIC
/begin CHARACTERISTIC PCR_I4AdPCVKiNeg_C "Grundwert der I-Verstaerkung des I-Reglers bei negativen Grossesignalen" VALUE 0xE6018 Kw_Wu32 999999.999767 Ki 0.00 999999.999767 FORMAT "%13.6" /end CHARACTERISTIC
/begin CHARACTERISTIC PCR_rI4AdPCVWinPos_C "obere Kleinsignalgrenze des I-Reglers" VALUE 0xE601C Kw_Ws16 799.9878 Prc -400.0000 399.9878 FORMAT "%8.4" /end CHARACTERISTIC
/begin CHARACTERISTIC PCR_rI4AdPCVWinNeg_C "untere Kleinsignalgrenze des I-Reglers" VALUE 0xE601E Kw_Ws16 799.9878 Prc -400.0000 399.9878 FORMAT "%8.4" /end CHARACTERISTIC
/begin CHARACTERISTIC PCR_ctAirPerTimeFrq_C "Anzahl der Abtastungen der erfassten Frischluftmasse für die diskrete Fouriertransformation" VALUE 0xE7510 Kw_Wu8 49.00 OneToOne 1.000 50.00 FORMAT "%5.2" EXTENDED_LIMITS 0.00 255.0 /end CHARACTERISTIC
/begin CHARACTERISTIC PCR_DebSRCHighDef_C "Defektzeit SRC-high" VALUE 0xE710C Kw_Wu16 655350.0 Time_ms 0.00 655350.0 FORMAT "%8.1" /end CHARACTERISTIC
/begin CHARACTERISTIC PCR_DebSRCHighOk_C "Heilungszeit SRC-high" VALUE 0xE710E Kw_Wu16 655350.0 Time_ms 0.00 655350.0 FORMAT "%8.1" /end CHARACTERISTIC
/begin CHARACTERISTIC PCR_DebSRCLowDef_C "Defektzeit SRC-low" VALUE 0xE7110 Kw_Wu16 655350.0 Time_ms 0.00 655350.0 FORMAT "%8.1" /end CHARACTERISTIC
/begin CHARACTERISTIC PCR_DebSRCLowOk_C "Heilungszeit SRC-low" VALUE 0xE7112 Kw_Wu16 655350.0 Time_ms 0.00 655350.0 FORMAT "%8.1" /end CHARACTERISTIC
/begin CHARACTERISTIC PCR_dlyPT1_C "Zeitkonstante der Sollwertverzögerung für I-Anteil" VALUE 0xE6020 Kw_Wu32 4294.9663 TimeDelay_s 0.0010000001 4294.9673 FORMAT "%9.4" EXTENDED_LIMITS 0.0000010000000 4294.9673 /end CHARACTERISTIC
/begin CHARACTERISTIC PCR_dnAvrgAdPCVLim_C "Maximale Grenze fuer Motordrehzahl Beschleunigung" VALUE 0xE6024 Kw_Ws16 655350.0 dn_dZ20 -327680.0 327670.0 FORMAT "%8.1" /end CHARACTERISTIC
/begin CHARACTERISTIC PCR_tiDnCorrDT1_C "Time delay for DT1 (engine-speed gradient calculation)" VALUE 0xE6028 Kw_Wu32 4294.9673 TimeDelay_s 0.0000010000000 4294.9673 FORMAT "%9.4" /end CHARACTERISTIC
/begin CHARACTERISTIC PCR_DnCorrDKd_C "Gain for DT1 (engine-speed gradient calculation)" VALUE 0xE602C Kw_Ws32 32767.9999924 Kd_rpm2dndt -16384.0000000 16383.9999924 FORMAT "%13.7" /end CHARACTERISTIC
/begin CHARACTERISTIC PCR_tiDpCorrDT1_C "Zeitverzögerung für die D-Parameterkorrektur aus dem Ladedruckgradienten" VALUE 0xE6030 Kw_Wu32 4294.9673 TimeDelay_s 0.0000010000000 4294.9673 FORMAT "%9.4" /end CHARACTERISTIC
/begin CHARACTERISTIC PCR_dpCorrDKd_C "Faktor für D-Parameter Korrektur generiert aus dem Ladedruckgradient" VALUE 0xE6034 Kw_Ws32 32767.9999924 Kd_Pres2dpdt -16384.0000000 16383.9999924 FORMAT "%13.7" /end CHARACTERISTIC
/begin CHARACTERISTIC PCR_dqCtlAdPCVLim_C "Maximale Grenze fuer Einspritzmenge" VALUE 0xE6038 Kw_Ws16 32767.50 InjMassPerSec_20ms -16384.00 16383.50 FORMAT "%8.2" /end CHARACTERISTIC
/begin CHARACTERISTIC PCR_tiAdPCVqCtlDT1_C "Zeitkonstante T1 des PT1-Filters im DT1-Filter" VALUE 0xE603C Kw_Wu32 4294.9663 TimeDelay_s 0.0010000001 4294.9673 FORMAT "%9.4" EXTENDED_LIMITS 0.0000010000000 4294.9673 /end CHARACTERISTIC
/begin CHARACTERISTIC PCR_DKdAdPCVqCtlDT1_C "Differentiationsfaktor Kd (fuer Kd=0.02 gilt y(k)=exp(-Ts/T1)*y(k-1)+(x(k)-x(k-1)))" VALUE 0xE6040 Kw_Ws32 10.0000000000 Kd 0.00 10.0000000000 FORMAT "%13.10" EXTENDED_LIMITS -32768.0000000 32767.9999847 /end CHARACTERISTIC
/begin CHARACTERISTIC PCR_drBPALPRmpUp_C "Positive Rampensteigung" VALUE 0xE6904 Kw_Wu32 799999.999814 RmpPrc 0.00 799999.999814 FORMAT "%13.6" /end CHARACTERISTIC
/begin CHARACTERISTIC PCR_drBPALPRmpDwn_C "Negative Rampensteigung" VALUE 0xE6908 Kw_Wu32 799999.999814 RmpPrc 0.00 799999.999814 FORMAT "%13.6" /end CHARACTERISTIC
/begin CHARACTERISTIC PCR_drBPGovMaxDynUp_C "Rate of increase of dynamic correction for maximum allowable PCR governor output" VALUE 0xE6044 Kw_Wu32 100.000016391 RmpPrc 0.00 100.000016391 FORMAT "%13.9" EXTENDED_LIMITS 0.00 799999.999814 /end CHARACTERISTIC
/begin CHARACTERISTIC PCR_drBPGovMaxDynDn_C "Rate of decrease of dynamic correction for maximum allowable PCR governor output" VALUE 0xE6048 Kw_Wu32 100.000016391 RmpPrc 0.00 100.000016391 FORMAT "%13.9" EXTENDED_LIMITS 0.00 799999.999814 /end CHARACTERISTIC
/begin CHARACTERISTIC PCR_tiDT1LP_C "Verzoegerungszeitkonstante fuer das DT1-Glied des PIDT1-Reglers" VALUE 0xE690C Kw_Wu32 4294.9663 TimeDelay_s 0.0010000001 4294.9673 FORMAT "%9.4" EXTENDED_LIMITS 0.0000010000000 4294.9673 /end CHARACTERISTIC
/begin CHARACTERISTIC PCR_DKdLP_C "Grundwert der D-Verstaerkung des PIDT1-Reglers bei Kleinsignalen" VALUE 0xE6910 Kw_Ws32 9.99999996275 Kd_Pres_hPa2Prc 0.00 9.99999996275 FORMAT "%13.10" EXTENDED_LIMITS -400.000000000 399.999999814 /end CHARACTERISTIC
/begin CHARACTERISTIC PCR_DKdPosLP_C "Grundwert der D-Verstaerkung des PIDT1-Reglers bei positiven Groszsignalen" VALUE 0xE6914 Kw_Ws32 9.99999996275 Kd_Pres_hPa2Prc 0.00 9.99999996275 FORMAT "%13.10" EXTENDED_LIMITS -400.000000000 399.999999814 /end CHARACTERISTIC
/begin CHARACTERISTIC PCR_DKdNegLP_C "Grundwert der  D-Verstaerkung des PIDT1-Reglers bei negativen Groszsignalen" VALUE 0xE6918 Kw_Ws32 9.99999996275 Kd_Pres_hPa2Prc 0.00 9.99999996275 FORMAT "%13.10" EXTENDED_LIMITS -400.000000000 399.999999814 /end CHARACTERISTIC
/begin CHARACTERISTIC PCR_pDWinPosLP_C "obere Kleinsignalgrenze fuer das I-Glied des PIDT1-Reglers" VALUE 0xE691C Kw_Ws16 10000.00 Pres_hPa -5000.000 5000.000 FORMAT "%8.3" EXTENDED_LIMITS -32768.00 32767.00 /end CHARACTERISTIC
/begin CHARACTERISTIC PCR_pDWinNegLP_C "untere Kleinsignalgrenze fuer das DT1-Glied des PIDT1-Reglers" VALUE 0xE691E Kw_Ws16 10000.00 Pres_hPa -5000.000 5000.000 FORMAT "%8.3" EXTENDED_LIMITS -32768.00 32767.00 /end CHARACTERISTIC
/begin CHARACTERISTIC PCR_DT1_C "Verzögerungszeitkonstante für das DT1-Glied des PIDT1-Reglers" VALUE 0xE604C Kw_Wu32 4294.9663 TimeDelay_s 0.0010000001 4294.9673 FORMAT "%9.4" EXTENDED_LIMITS 0.0000010000000 4294.9673 /end CHARACTERISTIC
/begin CHARACTERISTIC PCR_DKd_C "Grundwert der D-Verstärkung des PIDT1-Reglers bei Kleinsignalen" VALUE 0xE6050 Kw_Ws32 9.99999996275 Kd_Pres_hPa2Prc 0.00 9.99999996275 FORMAT "%13.10" EXTENDED_LIMITS -400.000000000 399.999999814 /end CHARACTERISTIC
/begin CHARACTERISTIC PCR_DKdPos_C "Grundwert der D-Verstärkung des PIDT1-Reglers bei positiven Großssignalen" VALUE 0xE6054 Kw_Ws32 9.99999996275 Kd_Pres_hPa2Prc 0.00 9.99999996275 FORMAT "%13.10" EXTENDED_LIMITS -400.000000000 399.999999814 /end CHARACTERISTIC
/begin CHARACTERISTIC PCR_DKdNeg_C "Grundwert der D-Verstärkung des PIDT1-Reglers bei negativen Großsignalen" VALUE 0xE6058 Kw_Ws32 9.99999996275 Kd_Pres_hPa2Prc 0.00 9.99999996275 FORMAT "%13.10" EXTENDED_LIMITS -400.000000000 399.999999814 /end CHARACTERISTIC
/begin CHARACTERISTIC PCR_pDWinPos_C "Obere Kleinsignalgrenze für das DT1-Glied des PIDT1-Reglers" VALUE 0xE605C Kw_Ws16 10000.00 Pres_hPa -5000.000 5000.000 FORMAT "%8.3" EXTENDED_LIMITS -32768.00 32767.00 /end CHARACTERISTIC
/begin CHARACTERISTIC PCR_pDWinNeg_C "Untere Kleinsignalgrenze für das DT1-Glied des PIDT1-Reglers" VALUE 0xE605E Kw_Ws16 10000.00 Pres_hPa -5000.000 5000.000 FORMAT "%8.3" EXTENDED_LIMITS -32768.00 32767.00 /end CHARACTERISTIC
/begin CHARACTERISTIC PCR_facAirPerTimeAmplMax_C "Obere Grenzwert für die Turboladerpumpgrenzerkennung" VALUE 0xE7512 Kw_Ws16 2047.938 FactM 0.00 2047.938 FORMAT "%8.3" EXTENDED_LIMITS -2048.000 2047.938 /end CHARACTERISTIC
/begin CHARACTERISTIC PCR_facAirPerTimeAmplMin_C "Untere Grenzwert für die Turboladerpumpgrenzerkennung" VALUE 0xE7514 Kw_Ws16 2047.938 FactM 0.00 2047.938 FORMAT "%8.3" EXTENDED_LIMITS -2048.000 2047.938 /end CHARACTERISTIC
/begin CHARACTERISTIC PCR_facBPGovMaxCorr_CUR "Correction factor(MAX)of D-parameter according to engine speed and particle filter soot mass" CURVE 0xE6060 Kl_Xs16_Ws16 5.000000 Fact1 0.00 5.000000 FORMAT "%8.6" EXTENDED_LIMITS -256.0000 255.9922
 /begin AXIS_DESCR STD_AXIS PFlt_mSot mSoot_g 8 0.00 300.0000 FORMAT "%8.4" EXTENDED_LIMITS -327.6800 327.6700 DEPOSIT ABSOLUTE /end AXIS_DESCR
/end CHARACTERISTIC
/begin CHARACTERISTIC PCR_facDnCorr_CUR "Curve for Correction factor based on the engine-speed gradient" CURVE 0xE6082 Kl_Xs16_Ws16 511.9922 Fact1 -256.0000 255.9922 FORMAT "%8.4"
 /begin AXIS_DESCR STD_AXIS PCR_dn_mp dn_dZ20 6 -6000.000 6000.000 FORMAT "%8.3" EXTENDED_LIMITS -327680.0 327670.0 DEPOSIT ABSOLUTE /end AXIS_DESCR
/end CHARACTERISTIC
/begin CHARACTERISTIC PCR_facDpCorr_CUR "Korrekturfaktor für D-Parameter Korrektur aus dem Ladedruckgradienten" CURVE 0xE609C Kl_Xs16_Ws16 511.9922 Fact1 -256.0000 255.9922 FORMAT "%8.4"
 /begin AXIS_DESCR STD_AXIS PCR_dpBGDev_mp dp_dZ20 10 -350000.0 350000.0 FORMAT "%8.1" EXTENDED_LIMITS -327680.0 327670.0 DEPOSIT ABSOLUTE /end AXIS_DESCR
/end CHARACTERISTIC
/begin CHARACTERISTIC PCR_facD_MAP "Kennfeld für Adaptionsfaktor der D-Verstärkung" MAP 0xE60C6 Kf_Xs16_Ys16_Ws16 50.00000 Fact1 0.00 50.00000 FORMAT "%8.5" EXTENDED_LIMITS -256.0000 255.9922
 /begin AXIS_DESCR STD_AXIS Eng_nAvrg EngN 10 0.00 8000.000 FORMAT "%8.3" EXTENDED_LIMITS -32768.00 32767.00 DEPOSIT ABSOLUTE /end AXIS_DESCR
 /begin AXIS_DESCR STD_AXIS InjCtl_qCurr InjMassCyc 4 0.00 200.0000 FORMAT "%8.4" EXTENDED_LIMITS -327.6800 327.6700 DEPOSIT ABSOLUTE /end AXIS_DESCR
/end CHARACTERISTIC
/begin CHARACTERISTIC PCR_facI_MAP "Kennfeld für Adaptionsfaktor der I-Verstärkung" MAP 0xE6136 Kf_Xs16_Ys16_Ws16 50.00000 Fact1 0.00 50.00000 FORMAT "%8.5" EXTENDED_LIMITS -256.0000 255.9922
 /begin AXIS_DESCR STD_AXIS Eng_nAvrg EngN 10 0.00 8000.000 FORMAT "%8.3" EXTENDED_LIMITS -32768.00 32767.00 DEPOSIT ABSOLUTE /end AXIS_DESCR
 /begin AXIS_DESCR STD_AXIS InjCtl_qCurr InjMassCyc 4 0.00 200.0000 FORMAT "%8.4" EXTENDED_LIMITS -327.6800 327.6700 DEPOSIT ABSOLUTE /end AXIS_DESCR
/end CHARACTERISTIC
/begin CHARACTERISTIC PCR_facmSotCorr_MAP "Correction factor of D-parameter  according to engine speed and particle filter soot mass" MAP 0xE61A6 Kf_Xs16_Ys16_Ws16 5.000000 Fact1 0.00 5.000000 FORMAT "%8.6" EXTENDED_LIMITS -256.0000 255.9922
 /begin AXIS_DESCR STD_AXIS Eng_nAvrg EngN 10 0.00 8000.000 FORMAT "%8.3" EXTENDED_LIMITS -32768.00 32767.00 DEPOSIT ABSOLUTE /end AXIS_DESCR
 /begin AXIS_DESCR STD_AXIS PFlt_mSot mSoot_g 8 0.00 300.0000 FORMAT "%8.4" EXTENDED_LIMITS -327.6800 327.6700 DEPOSIT ABSOLUTE /end AXIS_DESCR
/end CHARACTERISTIC
/begin CHARACTERISTIC PCR_facPresPFltMax_CUR "Korrekturfaktor für maximal zulässige Stellgröße in Abhängigkeit des Staudrucks vor Partikelfilter" CURVE 0xE626E Kl_Xs16_Ws16 5.000000 Fact1 0.00 5.000000 FORMAT "%8.6" EXTENDED_LIMITS -256.0000 255.9922
 /begin AXIS_DESCR STD_AXIS PFlt_pPre Pres_hPa 8 0.00 3500.0000 FORMAT "%8.4" EXTENDED_LIMITS -32768.00 32767.00 DEPOSIT ABSOLUTE /end AXIS_DESCR
/end CHARACTERISTIC
/begin CHARACTERISTIC PCR_facPresPFltMin_CUR "Korrekturfaktor für minimal zulässige Stellgröße in Abhängigkeit des Staudrucks vor Partikelfilter" CURVE 0xE6290 Kl_Xs16_Ws16 5.000000 Fact1 0.00 5.000000 FORMAT "%8.6" EXTENDED_LIMITS -256.0000 255.9922
 /begin AXIS_DESCR STD_AXIS PFlt_pPre Pres_hPa 8 0.00 3500.0000 FORMAT "%8.4" EXTENDED_LIMITS -32768.00 32767.00 DEPOSIT ABSOLUTE /end AXIS_DESCR
/end CHARACTERISTIC
/begin CHARACTERISTIC PCR_facP_MAP "Kennfeld für Adaptionsfaktor der P-Verstärkung" MAP 0xE62B2 Kf_Xs16_Ys16_Ws16 50.00000 Fact1 0.00 50.00000 FORMAT "%8.5" EXTENDED_LIMITS -256.0000 255.9922
 /begin AXIS_DESCR STD_AXIS Eng_nAvrg EngN 10 0.00 8000.000 FORMAT "%8.3" EXTENDED_LIMITS -32768.00 32767.00 DEPOSIT ABSOLUTE /end AXIS_DESCR
 /begin AXIS_DESCR STD_AXIS InjCtl_qCurr InjMassCyc 4 0.00 200.0000 FORMAT "%8.4" EXTENDED_LIMITS -327.6800 327.6700 DEPOSIT ABSOLUTE /end AXIS_DESCR
/end CHARACTERISTIC
/begin CHARACTERISTIC PCR_facSin_CUR "Sinusfunktion als Kennlinie" CURVE 0xE7516 Kl_Xs16_Ws16 1.000000 Fact 0.00 1.000000 FORMAT "%8.6" EXTENDED_LIMITS -4.000000 3.999878 READ_ONLY
 /begin AXIS_DESCR STD_AXIS PCR_facSinIn_mp Fact1 11 -256.0000 255.9922 FORMAT "%8.4" DEPOSIT ABSOLUTE /end AXIS_DESCR
/end CHARACTERISTIC
/begin CHARACTERISTIC PCR_facSqr_CUR "Quadratwurzelfunktion als Kennlinie" CURVE 0xE7544 Kl_Xs16_Ws16 2047.938 FactM 0.00 2047.938 FORMAT "%8.3" EXTENDED_LIMITS -2048.000 2047.938 READ_ONLY
 /begin AXIS_DESCR STD_AXIS PCR_facSqrIn_mp FactM 19 0.00 2047.938 FORMAT "%8.3" EXTENDED_LIMITS -2048.000 2047.938 DEPOSIT ABSOLUTE /end AXIS_DESCR
/end CHARACTERISTIC
/begin CHARACTERISTIC PCR_facSurgeDes_CUR "Kennlinie für Sollwert Luftmassenschwingung" CURVE 0xE72C0 Kl_Xs16_Ws16 4095.938 FactM -2048.000 2047.938 FORMAT "%8.3"
 /begin AXIS_DESCR STD_AXIS Eng_nAvrg EngN 6 0.00 6000.000 FORMAT "%8.3" EXTENDED_LIMITS -32768.00 32767.00 DEPOSIT ABSOLUTE /end AXIS_DESCR
/end CHARACTERISTIC
/begin CHARACTERISTIC PCR_facSurgeI_MAP "Kennfeld für Adaptionsfaktor der I-Verstärkung" MAP 0xE72DA Kf_Xs16_Ys16_Ws16 50.00000 Fact1 0.00 50.00000 FORMAT "%8.5" EXTENDED_LIMITS -256.0000 255.9922
 /begin AXIS_DESCR STD_AXIS Eng_nAvrg EngN 6 0.00 6000.000 FORMAT "%8.3" EXTENDED_LIMITS -32768.00 32767.00 DEPOSIT ABSOLUTE /end AXIS_DESCR
 /begin AXIS_DESCR STD_AXIS InjCtl_qCurr InjMassCyc 4 0.00 327.6700 FORMAT "%8.4" EXTENDED_LIMITS -327.6800 327.6700 DEPOSIT ABSOLUTE /end AXIS_DESCR
/end CHARACTERISTIC
/begin CHARACTERISTIC PCR_facSurgeP_MAP "Kennfeld für Adaptionsfaktor der P-Verstärkung" MAP 0xE7322 Kf_Xs16_Ys16_Ws16 50.00000 Fact1 0.00 50.00000 FORMAT "%8.5" EXTENDED_LIMITS -256.0000 255.9922
 /begin AXIS_DESCR STD_AXIS Eng_nAvrg EngN 6 0.00 6000.000 FORMAT "%8.3" EXTENDED_LIMITS -32768.00 32767.00 DEPOSIT ABSOLUTE /end AXIS_DESCR
 /begin AXIS_DESCR STD_AXIS InjCtl_qCurr InjMassCyc 4 0.00 327.6700 FORMAT "%8.4" EXTENDED_LIMITS -327.6800 327.6700 DEPOSIT ABSOLUTE /end AXIS_DESCR
/end CHARACTERISTIC
/begin CHARACTERISTIC PCR_IKiLP_C "Grundwert der I-Verstaerkung des PIDT1-Reglers bei Kleinsignalen" VALUE 0xE6920 Kw_Wu32 12207.0312472 Ki_Pres_hPa2Prc 0.00 12207.0312472 FORMAT "%13.7" /end CHARACTERISTIC
/begin CHARACTERISTIC PCR_IKiPosLP_C "Grundwert der I-Verstaerkung des PIDT1-Reglers bei positiven Groszsignalen" VALUE 0xE6924 Kw_Wu32 12207.0312472 Ki_Pres_hPa2Prc 0.00 12207.0312472 FORMAT "%13.7" /end CHARACTERISTIC
/begin CHARACTERISTIC PCR_IKiNegLP_C "Grundwert der I-Verstaerkung des PIDT1-Reglers bei negativen Groszsignalen" VALUE 0xE6928 Kw_Wu32 12207.0312472 Ki_Pres_hPa2Prc 0.00 12207.0312472 FORMAT "%13.7" /end CHARACTERISTIC
/begin CHARACTERISTIC PCR_pIWinPosLP_C "obere Kleinsignalgrenze fuer das I-Glied des PIDT1-Reglers" VALUE 0xE692C Kw_Ws16 65535.00 Pres_hPa -32768.00 32767.00 FORMAT "%8.2" /end CHARACTERISTIC
/begin CHARACTERISTIC PCR_pIWinNegLP_C "untere Kleinsignalgrenze fuer das I-Glied des PIDT1-Reglers" VALUE 0xE692E Kw_Ws16 65535.00 Pres_hPa -32768.00 32767.00 FORMAT "%8.2" /end CHARACTERISTIC
/begin CHARACTERISTIC PCR_ISurgeKi_C "Grundwert der I-Verstärkung des PI-Reglers bei Kleinsignalen" VALUE 0xE736C Kw_Wu32 15999999.9963 Ki_Pres_fac2hPa 0.00 15999999.9963 FORMAT "%13.4" /end CHARACTERISTIC
/begin CHARACTERISTIC PCR_ISurgeKiPos_C "Grundwert der I-Verstärkung des PI-Reglers bei pos.Großsignalen" VALUE 0xE7370 Kw_Wu32 15999999.9963 Ki_Pres_fac2hPa 0.00 15999999.9963 FORMAT "%13.4" /end CHARACTERISTIC
/begin CHARACTERISTIC PCR_ISurgeKiNeg_C "Grundwert der I-Verstärkung des PI-Reglers bei neg.Großsignalen" VALUE 0xE7374 Kw_Wu32 15999999.9963 Ki_Pres_fac2hPa 0.00 15999999.9963 FORMAT "%13.4" /end CHARACTERISTIC
/begin CHARACTERISTIC PCR_facSurgeIWinPos_C "Obere Kleinsignalgrenze für das P-Glied des AntiSurge-Reglers" VALUE 0xE7378 Kw_Ws16 4095.938 FactM -2048.000 2047.938 FORMAT "%8.3" /end CHARACTERISTIC
/begin CHARACTERISTIC PCR_facSurgeIWinNeg_C "Untere Kleinsignalgrenze für das P-Glied des AntiSurge-Reglers" VALUE 0xE737A Kw_Ws16 4095.938 FactM -2048.000 2047.938 FORMAT "%8.3" /end CHARACTERISTIC
/begin CHARACTERISTIC PCR_IKi_C "Grundwert der I-Verstärkung des PIDT1-Reglers bei Kleinsignalen" VALUE 0xE6324 Kw_Wu32 12207.0312472 Ki_Pres_hPa2Prc 0.00 12207.0312472 FORMAT "%13.7" /end CHARACTERISTIC
/begin CHARACTERISTIC PCR_IKiPos_C "Grundwert der I-Verstärkung des PIDT1-Reglers bei positiven Großsignalen" VALUE 0xE6328 Kw_Wu32 12207.0312472 Ki_Pres_hPa2Prc 0.00 12207.0312472 FORMAT "%13.7" /end CHARACTERISTIC
/begin CHARACTERISTIC PCR_IKiNeg_C "Grundwert der I-Verstärkung des PIDT1-Reglers bei negativen Großsignalen" VALUE 0xE632C Kw_Wu32 12207.0312472 Ki_Pres_hPa2Prc 0.00 12207.0312472 FORMAT "%13.7" /end CHARACTERISTIC
/begin CHARACTERISTIC PCR_pIWinPos_C "Obere Kleinsignalgrenze für das I-Glied des PIDT1-Reglers" VALUE 0xE6330 Kw_Ws16 65535.00 Pres_hPa -32768.00 32767.00 FORMAT "%8.2" /end CHARACTERISTIC
/begin CHARACTERISTIC PCR_pIWinNeg_C "Untere Kleinsignalgrenze für das I-Glied des PIDT1-Reglers" VALUE 0xE6332 Kw_Ws16 65535.00 Pres_hPa -32768.00 32767.00 FORMAT "%8.2" /end CHARACTERISTIC
/begin CHARACTERISTIC PCR_mskNoAdPCVVal_C "Maske zur Auswahl der Bedingungen, die zu einem Ignorieren der Lernwerte fuehren" VALUE 0xE6334 Kw_Wu16 65535.00 OneToOne 0.00 65535.00 FORMAT "%8.2" /end CHARACTERISTIC
/begin CHARACTERISTIC PCR_mskResetVal_C "Maske zur Auswahl der Bedingungen, die zu einem Reset der Lernwerte fuehren" VALUE 0xE6336 Kw_Wu16 65535.00 OneToOne 0.00 65535.00 FORMAT "%8.2" /end CHARACTERISTIC
/begin CHARACTERISTIC PCR_mskStopLearning_C "Maske zur Auswahl der Bedingungen, die zu einem Stop des Lernalgorithmus fuehren" VALUE 0xE6338 Kw_Wu16 65535.00 OneToOne 0.00 65535.00 FORMAT "%8.2" /end CHARACTERISTIC
/begin CHARACTERISTIC PCR_nAvrgAdPCV1_C "Wert der Drehzahl des ersten Referenz-Betriebspunktes" VALUE 0xE633A Kw_Ws16 6000.000 EngN 0.00 6000.000 FORMAT "%8.3" EXTENDED_LIMITS -32768.00 32767.00 /end CHARACTERISTIC
/begin CHARACTERISTIC PCR_nAvrgAdPCV2_C "Wert der Drehzahl des zweiten Referenz-Betriebspunktes" VALUE 0xE633C Kw_Ws16 6000.000 EngN 0.00 6000.000 FORMAT "%8.3" EXTENDED_LIMITS -32768.00 32767.00 /end CHARACTERISTIC
/begin CHARACTERISTIC PCR_nCoStart_C "#SSD untere Drehzahlgrenze für Kaltstarterkennung-Vorgabewert" VALUE 0xE7114 Kw_Ws16 65535.00 EngN -32768.00 32767.00 FORMAT "%8.2" /end CHARACTERISTIC
/begin CHARACTERISTIC PCR_nCoStrtHigh_C "#SSD obere Drehzahlgrenze für Kaltstarterkennung-Vorgabewert" VALUE 0xE7116 Kw_Ws16 5960.000 EngN 40.00000 6000.000 FORMAT "%8.3" EXTENDED_LIMITS -32768.00 32767.00 /end CHARACTERISTIC
/begin CHARACTERISTIC PCR_nWrkSph1_C "obere Drehzahlgrenze des Arbeitsbereiches 1" VALUE 0xE7118 Kw_Ws16 8000.000 EngN 0.00 8000.000 FORMAT "%8.3" EXTENDED_LIMITS -32768.00 32767.00 /end CHARACTERISTIC
/begin CHARACTERISTIC PCR_nWrkSph2_C "Drehzahlgrenze zwischen den Arbeitsbereichen 2 und 3" VALUE 0xE711A Kw_Ws16 8000.000 EngN 0.00 8000.000 FORMAT "%8.3" EXTENDED_LIMITS -32768.00 32767.00 /end CHARACTERISTIC
/begin CHARACTERISTIC PCR_nWrkSph3_C "Drehzahlgrenze zwischen den Arbeitsbereichen 3 und 4" VALUE 0xE711C Kw_Ws16 8000.000 EngN 0.00 8000.000 FORMAT "%8.3" EXTENDED_LIMITS -32768.00 32767.00 /end CHARACTERISTIC
/begin CHARACTERISTIC PCR_pBDesLP_MAP " KF Ladedruck-Sollwert bei Kompressorbypass offen" MAP 0xE6930 Kf_Xs16_Ys16_Ws16 4000.000 Pres_hPa 0.00 4000.000 FORMAT "%8.3" EXTENDED_LIMITS -32768.00 32767.00
 /begin AXIS_DESCR STD_AXIS Eng_nAvrg EngN 16 0.00 8000.000 FORMAT "%8.3" EXTENDED_LIMITS -32768.00 32767.00 DEPOSIT ABSOLUTE /end AXIS_DESCR
 /begin AXIS_DESCR STD_AXIS PCR_qDes InjMass 16 0.00 200.0000 FORMAT "%8.4" EXTENDED_LIMITS -327.6800 327.6700 DEPOSIT ABSOLUTE /end AXIS_DESCR
/end CHARACTERISTIC
/begin CHARACTERISTIC PCR_pBDesMaxAPLP_MAP "KF max Ladedruck bei Kompressorbypass offen" MAP 0xE6B74 Kf_Xs16_Ys16_Ws16 4000.000 Pres_hPa 0.00 4000.000 FORMAT "%8.3" EXTENDED_LIMITS -32768.00 32767.00
 /begin AXIS_DESCR STD_AXIS Eng_nAvrg EngN 10 0.00 8000.000 FORMAT "%8.3" EXTENDED_LIMITS -32768.00 32767.00 DEPOSIT ABSOLUTE /end AXIS_DESCR
 /begin AXIS_DESCR STD_AXIS APSCD_pVal Pres_hPa 10 0.00 4000.000 FORMAT "%8.3" EXTENDED_LIMITS -32768.00 32767.00 DEPOSIT ABSOLUTE /end AXIS_DESCR
/end CHARACTERISTIC
/begin CHARACTERISTIC PCR_pBGDevAdPCVLim_C "Maximale Grenze fuer die Regler-Abweichung" VALUE 0xE633E Kw_Ws16 65535.00 Pres_hPa -32768.00 32767.00 FORMAT "%8.2" /end CHARACTERISTIC
/begin CHARACTERISTIC PCR_pBGDevMaxOffset_C "#SSD Max. Regelabweichung PCR - Offset während DSC-Eingriff (eingefrorener Leadpfad)" VALUE 0xE711E Kw_Ws16 65535.00 Pres_hPa -32768.00 32767.00 FORMAT "%8.2" /end CHARACTERISTIC
/begin CHARACTERISTIC PCR_pBGDevMax_C "obere Grenze der erlaubten Regelabwichung" VALUE 0xE7120 Kw_Ws16 65535.00 Pres_hPa -32768.00 32767.00 FORMAT "%8.2" /end CHARACTERISTIC
/begin CHARACTERISTIC PCR_pBGDevMinOffset_C "#SSD neg. Regelabweichung PCR - Offset während DSC-Eingriff (eingefrorener Leadpfad)" VALUE 0xE7122 Kw_Ws16 65535.00 Pres_hPa -32768.00 32767.00 FORMAT "%8.2" /end CHARACTERISTIC
/begin CHARACTERISTIC PCR_pBGDevMin_C "untere Grenze der erlaubten Regelabwichung" VALUE 0xE7124 Kw_Ws16 65535.00 Pres_hPa -32768.00 32767.00 FORMAT "%8.2" /end CHARACTERISTIC
/begin CHARACTERISTIC PCR_pBSurgeDesMax_MAP "Kennfeld zur Bestimmung der max. zulässigen Stellgröße" MAP 0xE737C Kf_Xs16_Ys16_Ws16 65535.00 Pres_hPa -32768.00 32767.00 FORMAT "%8.2"
 /begin AXIS_DESCR STD_AXIS Eng_nAvrg EngN 5 0.00 6000.000 FORMAT "%8.3" EXTENDED_LIMITS -32768.00 32767.00 DEPOSIT ABSOLUTE /end AXIS_DESCR
 /begin AXIS_DESCR STD_AXIS InjCtl_qCurr InjMassCyc 5 0.00 327.6700 FORMAT "%8.4" EXTENDED_LIMITS -327.6800 327.6700 DEPOSIT ABSOLUTE /end AXIS_DESCR
/end CHARACTERISTIC
/begin CHARACTERISTIC PCR_pBSurgeDesMin_MAP "Kennfeld zur Bestimmung der min. zulässigen Stellgröße" MAP 0xE73C6 Kf_Xs16_Ys16_Ws16 65535.00 Pres_hPa -32768.00 32767.00 FORMAT "%8.2"
 /begin AXIS_DESCR STD_AXIS Eng_nAvrg EngN 5 0.00 6000.000 FORMAT "%8.3" EXTENDED_LIMITS -32768.00 32767.00 DEPOSIT ABSOLUTE /end AXIS_DESCR
 /begin AXIS_DESCR STD_AXIS InjCtl_qCurr InjMassCyc 5 0.00 327.6700 FORMAT "%8.4" EXTENDED_LIMITS -327.6800 327.6700 DEPOSIT ABSOLUTE /end AXIS_DESCR
/end CHARACTERISTIC
/begin CHARACTERISTIC PCR_pBSurgeDes_CUR "Kennlinie für Sollwert Ladedruck zur Reduktion Laderpumpen" CURVE 0xE7410 Kl_Xs16_Ws16 65535.00 Pres_hPa -32768.00 32767.00 FORMAT "%8.2"
 /begin AXIS_DESCR STD_AXIS PCR_pBSurgePICtlLim_mp Pres_hPa 2 -32768.00 32767.00 FORMAT "%8.2" DEPOSIT ABSOLUTE /end AXIS_DESCR
/end CHARACTERISTIC
/begin CHARACTERISTIC PCR_pFltValLim_C "Maximale Grenze fuer Ladedruck" VALUE 0xE6340 Kw_Ws16 65535.00 Pres_hPa -32768.00 32767.00 FORMAT "%8.2" /end CHARACTERISTIC
/begin CHARACTERISTIC PCR_PKpLP_C "Grundwert der P-Verstaerkung des PIDT1-Reglers bei Kleinsignalen" VALUE 0xE6C68 Kw_Wu32 799.999999814 Kp_Pres_hPa2Prc 0.00 799.999999814 FORMAT "%13.9" /end CHARACTERISTIC
/begin CHARACTERISTIC PCR_PKpPosLP_C "Grundwert der P-Verstaerkung des PIDT1-Reglers bei positiven Groszsignalen" VALUE 0xE6C6C Kw_Wu32 799.999999814 Kp_Pres_hPa2Prc 0.00 799.999999814 FORMAT "%13.9" /end CHARACTERISTIC
/begin CHARACTERISTIC PCR_PKpNegLP_C "Grundwert der P-Verstaerkung des PIDT1-Reglers bei negativen Groszsignalen" VALUE 0xE6C70 Kw_Wu32 799.999999814 Kp_Pres_hPa2Prc 0.00 799.999999814 FORMAT "%13.9" /end CHARACTERISTIC
/begin CHARACTERISTIC PCR_pPWinPosLP_C "obere Kleinsignalgrenze fuer das P-Glied des PIDT1-Reglers" VALUE 0xE6C74 Kw_Ws16 65535.00 Pres_hPa -32768.00 32767.00 FORMAT "%8.2" /end CHARACTERISTIC
/begin CHARACTERISTIC PCR_pPWinNegLP_C "untere Kleinsignalgrenze fuer das P-Glied des PIDT1-Reglers" VALUE 0xE6C76 Kw_Ws16 65535.00 Pres_hPa -32768.00 32767.00 FORMAT "%8.2" /end CHARACTERISTIC
/begin CHARACTERISTIC PCR_pSurgeARWIMin_C "minimal zulässige ARW ant-surge regler" VALUE 0xE741A Kw_Ws16 7000.000 Pres_hPa -3500.000 3500.000 FORMAT "%8.3" EXTENDED_LIMITS -32768.00 32767.00 /end CHARACTERISTIC
/begin CHARACTERISTIC PCR_PSurgeKp_C "Grundwert der P-Verstärkung des PI-Reglers bei Kleinsigna-len" VALUE 0xE741C Kw_Wu32 1048575.99976 Kp_Pres_fac2hPa 0.00 1048575.99976 FORMAT "%13.5" /end CHARACTERISTIC
/begin CHARACTERISTIC PCR_PSurgeKpPos_C "Grundwert der P-Verstärkung des PI-Reglers bei pos.Großsignalen" VALUE 0xE7420 Kw_Wu32 1048575.99976 Kp_Pres_fac2hPa 0.00 1048575.99976 FORMAT "%13.5" /end CHARACTERISTIC
/begin CHARACTERISTIC PCR_PSurgeKpNeg_C "Grundwert der P-Verstärkung des PI-Reglers bei neg.Großsignalen" VALUE 0xE7424 Kw_Wu32 1048575.99976 Kp_Pres_fac2hPa 0.00 1048575.99976 FORMAT "%13.5" /end CHARACTERISTIC
/begin CHARACTERISTIC PCR_facSurgePWinPos_C "Obere Kleinsignalgrenze für das P-Glied des AntiSurge-Reglers" VALUE 0xE7428 Kw_Ws16 4095.938 FactM -2048.000 2047.938 FORMAT "%8.3" /end CHARACTERISTIC
/begin CHARACTERISTIC PCR_facSurgePWinNeg_C "Untere Kleinsignalgrenze für das P-Glied des AntiSurge-Reglers" VALUE 0xE742A Kw_Ws16 4095.938 FactM -2048.000 2047.938 FORMAT "%8.3" /end CHARACTERISTIC
/begin CHARACTERISTIC PCR_pValAdPCVMax_C "Maximale Grenze fr Luftdruck" VALUE 0xE6342 Kw_Ws16 65535.00 Pres_hPa -32768.00 32767.00 FORMAT "%8.2" /end CHARACTERISTIC
/begin CHARACTERISTIC PCR_pValAdPCVMin_C "Minimale Grenze fuer Luftdruck" VALUE 0xE6344 Kw_Ws16 65535.00 Pres_hPa -32768.00 32767.00 FORMAT "%8.2" /end CHARACTERISTIC
/begin CHARACTERISTIC PCR_PKp_C "Grundwert der P-Verstärkung des PIDT1-Reglers bei Kleinsignalen" VALUE 0xE6348 Kw_Wu32 799.999999814 Kp_Pres_hPa2Prc 0.00 799.999999814 FORMAT "%13.9" /end CHARACTERISTIC
/begin CHARACTERISTIC PCR_PKpPos_C "Grundwert der P-Verstärkung des PIDT1-Reglers bei positiven Großsignalen" VALUE 0xE634C Kw_Wu32 799.999999814 Kp_Pres_hPa2Prc 0.00 799.999999814 FORMAT "%13.9" /end CHARACTERISTIC
/begin CHARACTERISTIC PCR_PKpNeg_C "Grundwert der P-Verstärkung des PIDT1-Reglers bei negativen Großsignalen" VALUE 0xE6350 Kw_Wu32 799.999999814 Kp_Pres_hPa2Prc 0.00 799.999999814 FORMAT "%13.9" /end CHARACTERISTIC
/begin CHARACTERISTIC PCR_pPWinPos_C "Obere Kleinsignalgrenze für das P-Glied des PIDT1-Reglers" VALUE 0xE6354 Kw_Ws16 65535.00 Pres_hPa -32768.00 32767.00 FORMAT "%8.2" /end CHARACTERISTIC
/begin CHARACTERISTIC PCR_pPWinNeg_C "Untere Kleinsignalgrenze für das P-Glied des PIDT1-Reglers" VALUE 0xE6356 Kw_Ws16 65535.00 Pres_hPa -32768.00 32767.00 FORMAT "%8.2" /end CHARACTERISTIC
/begin CHARACTERISTIC PCR_qClutchThres_C "Mengenschwellwert für Kupplungserkennung" VALUE 0xE7126 Kw_Ws16 200.0000 InjMass 0.00 200.0000 FORMAT "%8.4" EXTENDED_LIMITS -327.6800 327.6700 /end CHARACTERISTIC
/begin CHARACTERISTIC PCR_qClutchThres_CUR "Drehzahlabhängige Mengenschwelle zur Kupplungserkennung" CURVE 0xE7128 Kl_Xs16_Ws16 327.6700 InjMassCyc 0.00 327.6700 FORMAT "%8.4" EXTENDED_LIMITS -327.6800 327.6700
 /begin AXIS_DESCR STD_AXIS Eng_nAvrg EngN 4 40.00000 6000.000 FORMAT "%8.3" EXTENDED_LIMITS -32768.00 32767.00 DEPOSIT ABSOLUTE /end AXIS_DESCR
/end CHARACTERISTIC
/begin CHARACTERISTIC PCR_qCtlAdPCV1_C "Wert der Einspritzmenge des ersten Referenz-Betriebspunktes" VALUE 0xE6358 Kw_Ws16 327.6700 InjMassCyc 0.00 327.6700 FORMAT "%8.4" EXTENDED_LIMITS -327.6800 327.6700 /end CHARACTERISTIC
/begin CHARACTERISTIC PCR_qCtlAdPCV2_C "Wert der Einspritzmenge des zweiten Referenz-Betriebspunktes" VALUE 0xE635A Kw_Ws16 327.6700 InjMassCyc 0.00 327.6700 FORMAT "%8.4" EXTENDED_LIMITS -327.6800 327.6700 /end CHARACTERISTIC
/begin CHARACTERISTIC PCR_qRgtOffRgn_CUR "Mengenkennlinie für Reglerabschaltschwelle in Abhängigkeit von der Drehzahl für Partikelfilter Regeneration" CURVE 0xE713A Kl_Xs16_Ws16 200.0000 InjMass 0.00 200.0000 FORMAT "%8.4" EXTENDED_LIMITS -327.6800 327.6700
 /begin AXIS_DESCR STD_AXIS Eng_nAvrg EngN 8 0.00 8000.000 FORMAT "%8.3" EXTENDED_LIMITS -32768.00 32767.00 DEPOSIT ABSOLUTE /end AXIS_DESCR
/end CHARACTERISTIC
/begin CHARACTERISTIC PCR_qRgtOff_CUR "Mengenkennlinie für Reglerabschaltschwelle in Abhängigkeit von der Drehzahl" CURVE 0xE715C Kl_Xs16_Ws16 200.0000 InjMass 0.00 200.0000 FORMAT "%8.4" EXTENDED_LIMITS -327.6800 327.6700
 /begin AXIS_DESCR STD_AXIS Eng_nAvrg EngN 9 0.00 8000.000 FORMAT "%8.3" EXTENDED_LIMITS -32768.00 32767.00 DEPOSIT ABSOLUTE /end AXIS_DESCR
/end CHARACTERISTIC
/begin CHARACTERISTIC PCR_qRgtOnRgn_CUR "Mengenkennlinie für Reglereinschaltschwelle in Abhängigkeit von der Drehzahl für Partikelfilter Regeneration" CURVE 0xE7182 Kl_Xs16_Ws16 200.0000 InjMass 0.00 200.0000 FORMAT "%8.4" EXTENDED_LIMITS -327.6800 327.6700
 /begin AXIS_DESCR STD_AXIS Eng_nAvrg EngN 8 0.00 8000.000 FORMAT "%8.3" EXTENDED_LIMITS -32768.00 32767.00 DEPOSIT ABSOLUTE /end AXIS_DESCR
/end CHARACTERISTIC
/begin CHARACTERISTIC PCR_qRgtOn_CUR "Mengenkennlinie für Reglereinschaltschwelle in Abhängigkeit von der Drehzahl" CURVE 0xE71A4 Kl_Xs16_Ws16 200.0000 InjMass 0.00 200.0000 FORMAT "%8.4" EXTENDED_LIMITS -327.6800 327.6700
 /begin AXIS_DESCR STD_AXIS Eng_nAvrg EngN 9 0.00 8000.000 FORMAT "%8.3" EXTENDED_LIMITS -32768.00 32767.00 DEPOSIT ABSOLUTE /end AXIS_DESCR
/end CHARACTERISTIC
/begin CHARACTERISTIC PCR_qSurgeGvnrOff_MAP "Kennfeld zur umschaltung der Regler" MAP 0xE742C Kf_Xs16_Ys16_Ws16 327.6700 InjMass 0.00 327.6700 FORMAT "%8.4" EXTENDED_LIMITS -327.6800 327.6700
 /begin AXIS_DESCR STD_AXIS Eng_nAvrg EngN 6 0.00 6000.000 FORMAT "%8.3" EXTENDED_LIMITS -32768.00 32767.00 DEPOSIT ABSOLUTE /end AXIS_DESCR
 /begin AXIS_DESCR STD_AXIS APSCD_pLinVal Pres_hPa 4 -32768.00 32767.00 FORMAT "%8.2" DEPOSIT ABSOLUTE /end AXIS_DESCR
/end CHARACTERISTIC
/begin CHARACTERISTIC PCR_qSurgeGvnrOn_MAP "Kennfeld zur umschaltung der Regler" MAP 0xE7474 Kf_Xs16_Ys16_Ws16 327.6700 InjMass 0.00 327.6700 FORMAT "%8.4" EXTENDED_LIMITS -327.6800 327.6700
 /begin AXIS_DESCR STD_AXIS Eng_nAvrg EngN 6 0.00 6000.000 FORMAT "%8.3" EXTENDED_LIMITS -32768.00 32767.00 DEPOSIT ABSOLUTE /end AXIS_DESCR
 /begin AXIS_DESCR STD_AXIS APSCD_pLinVal Pres_hPa 4 -32768.00 32767.00 FORMAT "%8.2" DEPOSIT ABSOLUTE /end AXIS_DESCR
/end CHARACTERISTIC
/begin CHARACTERISTIC PCR_qWrkSph2_C "obere Mengengrenze des Arbeitsbereichs 2" VALUE 0xE71CA Kw_Ws16 200.0000 InjMass 0.00 200.0000 FORMAT "%8.4" EXTENDED_LIMITS -327.6800 327.6700 /end CHARACTERISTIC
/begin CHARACTERISTIC PCR_qWrkSph3_C "Einspritzmengengrenze zwischen den Arbeitsbereichen 2 und 3" VALUE 0xE71CC Kw_Ws16 200.0000 InjMass 0.00 200.0000 FORMAT "%8.4" EXTENDED_LIMITS -327.6800 327.6700 /end CHARACTERISTIC
/begin CHARACTERISTIC PCR_rAdPCVCtlValMax_C "Maximale Grenze fuer Adaptives Vorsteuerkennfeld" VALUE 0xE635C Kw_Ws16 100.0000 Prc 0.00 100.0000 FORMAT "%8.4" EXTENDED_LIMITS -400.0000 399.9878 /end CHARACTERISTIC
/begin CHARACTERISTIC PCR_rAdPCVCtlValMin_C "Minimale Grenze fuer Adaptives Vorsteuerkennfeld" VALUE 0xE635E Kw_Ws16 100.0000 Prc 0.00 100.0000 FORMAT "%8.4" EXTENDED_LIMITS -400.0000 399.9878 /end CHARACTERISTIC
/begin CHARACTERISTIC PCR_rARWIMin_C "Minimum value in case of ""Anti-Reset-Windup""" VALUE 0xE6900 Kw_Ws16 100.0000 Prc 0.00 100.0000 FORMAT "%8.4" EXTENDED_LIMITS -400.0000 399.9878 /end CHARACTERISTIC
/begin CHARACTERISTIC PCR_rBPACDAdd_Vector "#SSD Bypass-Label für additiven Bypass von PCR_rBPACD (Nicht verstellen!)" VALUE 0xC2E00 Kw_Wu8 255.0 OneToOne 0.00 255.0 FORMAT "%5.1" /end CHARACTERISTIC
/begin CHARACTERISTIC PCR_rBPACDAdd_Channel "#SSD Bypass-Label für additiven Bypass von PCR_rBPACD (Nicht verstellen!)" VALUE 0xC2E01 Kw_Wu8 255.0 OneToOne 0.00 255.0 FORMAT "%5.1" /end CHARACTERISTIC
/begin CHARACTERISTIC PCR_rBPACD_Vector "#SSD Bypass-Label für PCR_rBPACD (Nicht verstellen!)" VALUE 0xC2E02 Kw_Wu8 255.0 OneToOne 0.00 255.0 FORMAT "%5.1" /end CHARACTERISTIC
/begin CHARACTERISTIC PCR_rBPACD_Channel "#SSD Bypass-Label für PCR_rBPACD (Nicht verstellen!)" VALUE 0xC2E03 Kw_Wu8 255.0 OneToOne 0.00 255.0 FORMAT "%5.1" /end CHARACTERISTIC
/begin CHARACTERISTIC PCR_rBPBasLP_MAP "KF TV an steller(LPA) bei Kompressorbypass geschlossen" MAP 0xE6C78 Kf_Xs16_Ys16_Ws16 100.0000 Prc 0.00 100.0000 FORMAT "%8.4" EXTENDED_LIMITS -400.0000 399.9878
 /begin AXIS_DESCR STD_AXIS Eng_nAvrg EngN 16 0.00 8000.000 FORMAT "%8.3" EXTENDED_LIMITS -32768.00 32767.00 DEPOSIT ABSOLUTE /end AXIS_DESCR
 /begin AXIS_DESCR STD_AXIS PCR_qDes InjMass 16 0.00 200.0000 FORMAT "%8.4" EXTENDED_LIMITS -327.6800 327.6700 DEPOSIT ABSOLUTE /end AXIS_DESCR
/end CHARACTERISTIC
/begin CHARACTERISTIC PCR_rBPGovMaxCorr_MAP "Correction factor(MAX) of D-parameter according to engine speed and particle filter soot mass" MAP 0xE6360 Kf_Xs16_Ys16_Ws16 100.0000 Prc 0.00 100.0000 FORMAT "%8.4" EXTENDED_LIMITS -400.0000 399.9878
 /begin AXIS_DESCR STD_AXIS Eng_nAvrg EngN 16 0.00 8000.000 FORMAT "%8.3" EXTENDED_LIMITS -32768.00 32767.00 DEPOSIT ABSOLUTE /end AXIS_DESCR
 /begin AXIS_DESCR STD_AXIS PCR_qReal InjMassCyc 10 0.00 100.0000 FORMAT "%8.4" EXTENDED_LIMITS -327.6800 327.6700 DEPOSIT ABSOLUTE /end AXIS_DESCR
/end CHARACTERISTIC
/begin CHARACTERISTIC PCR_rBPGovMaxDynEnd_C "Ramp correction end value for maximum allowable PCR governor output" VALUE 0xE64D8 Kw_Ws16 100.0000 Prc 0.00 100.0000 FORMAT "%8.4" EXTENDED_LIMITS -400.0000 399.9878 /end CHARACTERISTIC
/begin CHARACTERISTIC PCR_rBPGovMaxDynStrt_C "Ramp correction start value for maximum allowable PCR governor output" VALUE 0xE64DA Kw_Ws16 100.0000 Prc 0.00 100.0000 FORMAT "%8.4" EXTENDED_LIMITS -400.0000 399.9878 /end CHARACTERISTIC
/begin CHARACTERISTIC PCR_rBPGovMaxDyn_MAP "Map for Maximum allowable PCR output for actuator" MAP 0xE64DC Kf_Xs16_Ys16_Ws16 100.0000 Prc 0.00 100.0000 FORMAT "%8.4" EXTENDED_LIMITS -400.0000 399.9878
 /begin AXIS_DESCR STD_AXIS Eng_nAvrg EngN 8 40.00000 6000.000 FORMAT "%8.3" EXTENDED_LIMITS -32768.00 32767.00 DEPOSIT ABSOLUTE /end AXIS_DESCR
 /begin AXIS_DESCR STD_AXIS PCR_qReal InjMassCyc 8 0.00 100.0000 FORMAT "%8.4" EXTENDED_LIMITS -327.6800 327.6700 DEPOSIT ABSOLUTE /end AXIS_DESCR
/end CHARACTERISTIC
/begin CHARACTERISTIC PCR_rBPRglBasLP_MAP "KF fuer Vorsteuertastverhaeltnis" MAP 0xE6EBC Kf_Xs16_Ys16_Ws16 100.0000 Prc 0.00 100.0000 FORMAT "%8.4" EXTENDED_LIMITS -400.0000 399.9878
 /begin AXIS_DESCR STD_AXIS Eng_nAvrg EngN 16 0.00 8000.000 FORMAT "%8.3" EXTENDED_LIMITS -32768.00 32767.00 DEPOSIT ABSOLUTE /end AXIS_DESCR
 /begin AXIS_DESCR STD_AXIS PCR_qDes InjMass 16 0.00 200.0000 FORMAT "%8.4" EXTENDED_LIMITS -327.6800 327.6700 DEPOSIT ABSOLUTE /end AXIS_DESCR
/end CHARACTERISTIC
/begin CHARACTERISTIC PCR_rCBOpn_C "Stellgroesze fuer den Ladedrucksteller bei geoeffnetem Verdichterbypass" VALUE 0xE71CE Kw_Ws16 799.9878 Prc -400.0000 399.9878 FORMAT "%8.4" /end CHARACTERISTIC
/begin CHARACTERISTIC PCR_rDflVal06_C "Defaultwert 6 für relative Stellung des Ladedruckstellers" VALUE 0xE71D0 Kw_Ws16 799.9878 Prc -400.0000 399.9878 FORMAT "%8.4" /end CHARACTERISTIC
/begin CHARACTERISTIC PCR_rDflVal12_C "Defaultwert 12 für relative Stellung des Ladedruckstellers" VALUE 0xE71D2 Kw_Ws16 799.9878 Prc -400.0000 399.9878 FORMAT "%8.4" /end CHARACTERISTIC
/begin CHARACTERISTIC PCR_rDflVal15_MAP "Default value map for the output of the two actuators" MAP 0xE71D4 Kf_Xs16_Ys16_Ws16 300.0000 Prc -100.0000 200.0000 FORMAT "%8.4" EXTENDED_LIMITS -400.0000 399.9878
 /begin AXIS_DESCR STD_AXIS Eng_nAvrg EngN 8 0.00 6000.000 FORMAT "%8.3" EXTENDED_LIMITS -32768.00 32767.00 DEPOSIT ABSOLUTE /end AXIS_DESCR
 /begin AXIS_DESCR STD_AXIS PCR_qReal InjMassCyc 8 0.00 327.6700 FORMAT "%8.4" EXTENDED_LIMITS -327.6800 327.6700 DEPOSIT ABSOLUTE /end AXIS_DESCR
/end CHARACTERISTIC
/begin CHARACTERISTIC PCR_rDflVal18_C "Defaultwert 18 für relative Stellung des Ladedruckstellers" VALUE 0xE7278 Kw_Ws16 799.9878 Prc -400.0000 399.9878 FORMAT "%8.4" /end CHARACTERISTIC
/begin CHARACTERISTIC PCR_rDflVal24_C "Defaultwert 24 für relative Stellung des Ladedruckstellers" VALUE 0xE727A Kw_Ws16 799.9878 Prc -400.0000 399.9878 FORMAT "%8.4" /end CHARACTERISTIC
/begin CHARACTERISTIC PCR_rDistAdPCV1_C "Verzerrung eingang des I1-Reglers" VALUE 0xE6580 Kw_Ws16 100.0000 Prc 0.00 100.0000 FORMAT "%8.4" EXTENDED_LIMITS -400.0000 399.9878 /end CHARACTERISTIC
/begin CHARACTERISTIC PCR_rDistAdPCV2_C "Verzerrung eingang des I2-Reglers" VALUE 0xE6582 Kw_Ws16 100.0000 Prc 0.00 100.0000 FORMAT "%8.4" EXTENDED_LIMITS -400.0000 399.9878 /end CHARACTERISTIC
/begin CHARACTERISTIC PCR_rDistAdPCV3_C "Verzerrung eingang des I3-Reglers" VALUE 0xE6584 Kw_Ws16 100.0000 Prc 0.00 100.0000 FORMAT "%8.4" EXTENDED_LIMITS -400.0000 399.9878 /end CHARACTERISTIC
/begin CHARACTERISTIC PCR_rDistAdPCV4_C "Verzerrung eingang des I4-Reglers" VALUE 0xE6586 Kw_Ws16 100.0000 Prc 0.00 100.0000 FORMAT "%8.4" EXTENDED_LIMITS -400.0000 399.9878 /end CHARACTERISTIC
/begin CHARACTERISTIC PCR_rDt1InitLP_C "Initialisierungs-Wert fuer DT1-Regler" VALUE 0xE7100 Kw_Ws16 200.0000 Prc -100.0000 100.0000 FORMAT "%8.4" EXTENDED_LIMITS -400.0000 399.9878 /end CHARACTERISTIC
/begin CHARACTERISTIC PCR_rGovMaxLP_C "Maximale Grenze fuer Regler Ausgang" VALUE 0xE7102 Kw_Ws16 200.0000 Prc -100.0000 100.0000 FORMAT "%8.4" EXTENDED_LIMITS -400.0000 399.9878 /end CHARACTERISTIC
/begin CHARACTERISTIC PCR_rGovMinLP_C "Minimale Grenze fuer Regler Ausgang" VALUE 0xE7104 Kw_Ws16 200.0000 Prc -100.0000 100.0000 FORMAT "%8.4" EXTENDED_LIMITS -400.0000 399.9878 /end CHARACTERISTIC
/begin CHARACTERISTIC PCR_rGvnrMax_CUR "Kennlinie zur Bestimmung der maximal zulässigen Stellgroesse aus dem Verbrauch" CURVE 0xE6588 Kl_Xs16_Ws16 300.0000 Prc -100.0000 200.0000 FORMAT "%8.4" EXTENDED_LIMITS -400.0000 399.9878
 /begin AXIS_DESCR STD_AXIS CoEng_dvolFlConsum FlConsum_l_h 16 0.00 327.6700 FORMAT "%8.4" EXTENDED_LIMITS -327.6800 327.6700 DEPOSIT ABSOLUTE /end AXIS_DESCR
/end CHARACTERISTIC
/begin CHARACTERISTIC PCR_rGvnrMax_MAP "Kennfeld/Kennlinie zur Bestimmung der maximal zulässigen Stellgröße aus Drehzahl und Einspritzmenge" MAP 0xE65CA Kf_Xs16_Ys16_Ws16 300.0000 Prc -100.0000 200.0000 FORMAT "%8.4" EXTENDED_LIMITS -400.0000 399.9878
 /begin AXIS_DESCR STD_AXIS Eng_nAvrg EngN 16 0.00 8000.000 FORMAT "%8.3" EXTENDED_LIMITS -32768.00 32767.00 DEPOSIT ABSOLUTE /end AXIS_DESCR
 /begin AXIS_DESCR STD_AXIS PCR_qReal InjMassCyc 16 0.00 200.0000 FORMAT "%8.4" EXTENDED_LIMITS -327.6800 327.6700 DEPOSIT ABSOLUTE /end AXIS_DESCR
/end CHARACTERISTIC
/begin CHARACTERISTIC PCR_rGvnrMin_CUR "Kennlinie zur Bestimmung der minimal zulässigen Stellgoesse aus dem Verbrauch" CURVE 0xE680E Kl_Xs16_Ws16 300.0000 Prc -100.0000 200.0000 FORMAT "%8.4" EXTENDED_LIMITS -400.0000 399.9878
 /begin AXIS_DESCR STD_AXIS CoEng_dvolFlConsum FlConsum_l_h 2 0.00 327.6700 FORMAT "%8.4" EXTENDED_LIMITS -327.6800 327.6700 DEPOSIT ABSOLUTE /end AXIS_DESCR
/end CHARACTERISTIC
/begin CHARACTERISTIC PCR_rGvnrMin_MAP "Kennfeld/Kennlinie zur Bestimmung der minimal zulässigen Stellgröße aus Drehzahl und Einspritzmenge" MAP 0xE6818 Kf_Xs16_Ys16_Ws16 300.0000 Prc -100.0000 200.0000 FORMAT "%8.4" EXTENDED_LIMITS -400.0000 399.9878
 /begin AXIS_DESCR STD_AXIS Eng_nAvrg EngN 4 0.00 8000.000 FORMAT "%8.3" EXTENDED_LIMITS -32768.00 32767.00 DEPOSIT ABSOLUTE /end AXIS_DESCR
 /begin AXIS_DESCR STD_AXIS PCR_qReal InjMassCyc 4 0.00 200.0000 FORMAT "%8.4" EXTENDED_LIMITS -327.6800 327.6700 DEPOSIT ABSOLUTE /end AXIS_DESCR
/end CHARACTERISTIC
/begin CHARACTERISTIC PCR_rIInitLP_C "Initialisierungs-Wert fuer PI-Regler" VALUE 0xE7106 Kw_Ws16 200.0000 Prc -100.0000 100.0000 FORMAT "%8.4" EXTENDED_LIMITS -400.0000 399.9878 /end CHARACTERISTIC
/begin CHARACTERISTIC PCR_rMaxLP_C "Maximale Grenze fuer PID + Vorsteuertastverhaeltnis Ausgang" VALUE 0xE7108 Kw_Ws16 200.0000 Prc -100.0000 100.0000 FORMAT "%8.4" EXTENDED_LIMITS -400.0000 399.9878 /end CHARACTERISTIC
/begin CHARACTERISTIC PCR_rMinLP_C "Minimale Grenze fuer PID + Vorsteuertastverhaeltnis Ausgang" VALUE 0xE710A Kw_Ws16 200.0000 Prc -100.0000 100.0000 FORMAT "%8.4" EXTENDED_LIMITS -400.0000 399.9878 /end CHARACTERISTIC
/begin CHARACTERISTIC PCR_rOutIMax_MAP "Kennfeld zur Limitierung des I-Reglers über Drehzahl und differentzierten gefilterteren Werts des Ladedrucks" MAP 0xE684C Kf_Xs16_Ys16_Ws16 5.004883 Prc 0.00 5.004883 FORMAT "%8.6" EXTENDED_LIMITS -400.0000 399.9878
 /begin AXIS_DESCR STD_AXIS BPSCD_dFltValDT1 dp_dZ10 8 -350000.0 350000.0 FORMAT "%8.1" EXTENDED_LIMITS -327680.0 327670.0 DEPOSIT ABSOLUTE /end AXIS_DESCR
 /begin AXIS_DESCR STD_AXIS Eng_nAvrg EngN 8 40.00000 6000.000 FORMAT "%8.3" EXTENDED_LIMITS -32768.00 32767.00 DEPOSIT ABSOLUTE /end AXIS_DESCR
/end CHARACTERISTIC
/begin CHARACTERISTIC PCR_rSurgeGvnr_MAP "kennlinie für Ladedrucksteuersignal aus AntiSurge-Regler Eingangsgrößen" MAP 0xE74BC Kf_Xs16_Ys16_Ws16 100.0000 Prc 0.00 100.0000 FORMAT "%8.4" EXTENDED_LIMITS -400.0000 399.9878
 /begin AXIS_DESCR STD_AXIS PCR_pBSurgePICtlLim_mp Pres_hPa 5 -32768.00 32767.00 FORMAT "%8.2" DEPOSIT ABSOLUTE /end AXIS_DESCR
 /begin AXIS_DESCR STD_AXIS Eng_nAvrg EngN 5 0.00 6000.000 FORMAT "%8.3" EXTENDED_LIMITS -32768.00 32767.00 DEPOSIT ABSOLUTE /end AXIS_DESCR
/end CHARACTERISTIC
/begin CHARACTERISTIC PCR_stAdPCVReset_C "Status fuer die eeprom Spiegel-Werte neu zu fassen" VALUE 0xE68F0 Kw_Wu8 255.0 OneToOne 0.00 255.0 FORMAT "%5.1" /end CHARACTERISTIC
/begin CHARACTERISTIC PCR_stMonCur_C "Bit Mask for EGT_st" VALUE 0xE727C Kw_Wu32 4294967295.00 OneToOne 0.00 4294967295.00 FORMAT "%13.2" /end CHARACTERISTIC
/begin CHARACTERISTIC PCR_tiDebSurge1_C "Parameter 1 für die Entprellung der Erkennung oszillierende Luftmasse mit großer Amplitude" VALUE 0xE7592 Kw_Wu16 655140.0 TimeDeb 0.00 655140.0 FORMAT "%8.1" EXTENDED_LIMITS 0.00 655350.0 /end CHARACTERISTIC
/begin CHARACTERISTIC PCR_tiDebSurge2_C "Parameter 2 für die Entprellung der Erkennung oszillierende Luftmasse mit großer Amplitude" VALUE 0xE7594 Kw_Wu16 655140.0 TimeDeb 0.00 655140.0 FORMAT "%8.1" EXTENDED_LIMITS 0.00 655350.0 /end CHARACTERISTIC
/begin CHARACTERISTIC PCR_tiSurgeGvnrPT1_C "Parameter für PT1-Glied für Tiefpassfilterung der Regelabwei-chung für I Anteil" VALUE 0xE7508 Kw_Wu32 4294.9663 TimeDelay_s 0.0010000001 4294.9673 FORMAT "%9.4" EXTENDED_LIMITS 0.0000010000000 4294.9673 /end CHARACTERISTIC
/begin CHARACTERISTIC PCR_swtAdPCVrLim_C "Schalter zur Auswahl der Wirkung (Anhebung / Absenkung des Ladedrucks) des adaptiven Vorsteuerwertes" VALUE 0xE68F1 Kw_Wu8 255.0 OneToOne 0.00 255.0 FORMAT "%5.1" /end CHARACTERISTIC
/begin CHARACTERISTIC PCR_swtARWMode_C "Switch for deciding the ""Anti-Reset-Windup"" behaviour" VALUE 0xE6902 Kw_Wu8 1.000 OneToOne 0.00 1.000 FORMAT "%5.3" EXTENDED_LIMITS 0.00 255.0 /end CHARACTERISTIC
/begin CHARACTERISTIC PCR_swtIDevType_C "Deviation I/P  Integrator selection switch" VALUE 0xE68F2 Kw_Wu8 255.0 OneToOne 0.00 255.0 FORMAT "%5.1" /end CHARACTERISTIC
/begin CHARACTERISTIC PCR_swtLimMpCrVal_C "Schalterwert zur Auswahl der Größen, aus denen der zulässige Stellgrößenbereich bestimmt wird (P263:bei Initialisierung gelesen)" VALUE 0xE68F3 Kw_Wu8 0.00 OneToOne 1.000 1.000 FORMAT "%5.3" EXTENDED_LIMITS 0.00 255.0 /end CHARACTERISTIC
/begin CHARACTERISTIC PCR_swtLimMpCrType_C "Schaltertyp zur Auswahl der Größen, aus denen der zulässige Stellgrößenbereich bestimmt wird" VALUE 0xE68F4 Kw_Wu8 0.00 OneToOne 0.00 0.00 FORMAT "%5.2" EXTENDED_LIMITS 0.00 255.0 /end CHARACTERISTIC
/begin CHARACTERISTIC PCR_swtLimSelVal_C "Schalterwert zur Auswahl der Größen, aus denen der zulässige Stellgrößenbereich bestimmt wird (P263:bei Initialisierung gelesen)" VALUE 0xE68F5 Kw_Wu8 0.00 OneToOne 1.000 1.000 FORMAT "%5.3" EXTENDED_LIMITS 0.00 255.0 /end CHARACTERISTIC
/begin CHARACTERISTIC PCR_swtLimSelType_C "Schaltertyp zur Auswahl der Größen, aus denen der zulässige Stellgrößenbereich bestimmt wird" VALUE 0xE68F6 Kw_Wu8 0.00 OneToOne 0.00 0.00 FORMAT "%5.2" EXTENDED_LIMITS 0.00 255.0 /end CHARACTERISTIC
/begin CHARACTERISTIC PCR_swtRawCur_C "Injection value selection switch - raw or current" VALUE 0xE68F7 Kw_Wu8 255.0 OneToOne 0.00 255.0 FORMAT "%5.1" /end CHARACTERISTIC
/begin CHARACTERISTIC PCR_swtRelAbsVal_C "#SSD Schalterwert zur  Auswahl zwischen Absolut- und Relativdruckregelung" VALUE 0xE68F8 Kw_Wu8 1.000 OneToOne 0.00 1.000 FORMAT "%5.3" EXTENDED_LIMITS 0.00 255.0 /end CHARACTERISTIC
/begin CHARACTERISTIC PCR_swtRelAbsType_C "#SSD Softwareschalter Typ zur  Auswahl zwischen Absolut- und Relativdruckregelung" VALUE 0xE68F9 Kw_Wu8 1.000 OneToOne 1.000 2.000 FORMAT "%5.3" EXTENDED_LIMITS 0.00 255.0 /end CHARACTERISTIC
/begin CHARACTERISTIC PCR_swtSurgeARWMode_C "Schalter zur Auswahl AntiResetWindUp-Mode(AntiSurge-Regler)" VALUE 0xE750C Kw_Wu8 1.000 OneToOne 0.00 1.000 FORMAT "%5.3" EXTENDED_LIMITS 0.00 255.0 /end CHARACTERISTIC
/begin CHARACTERISTIC PCR_swtSurgeGvnrSel_C "Shalter zum AntiSurge-Regler" VALUE 0xE750D Kw_Wu8 255.0 OneToOne 0.00 255.0 FORMAT "%5.1" /end CHARACTERISTIC
/begin CHARACTERISTIC PCR_swtV8_C "switch" VALUE 0xE7280 Kw_Wu8 255.0 OneToOne 0.00 255.0 FORMAT "%5.1" /end CHARACTERISTIC
/begin CHARACTERISTIC PCR_tAirAdPCVMax_C "Maximale Grenze fuer Kuehlmitteltemperatur" VALUE 0xE68FA Kw_Ws16 950.000 Temp_Cels -50.140 899.860 FORMAT "%8.3" EXTENDED_LIMITS -3549.940 3003.560 /end CHARACTERISTIC
/begin CHARACTERISTIC PCR_tAirAdPCVMin_C "Minimale Grenze fuer  Lufttemperatur" VALUE 0xE68FC Kw_Ws16 950.000 Temp_Cels -50.140 899.860 FORMAT "%8.3" EXTENDED_LIMITS -3549.940 3003.560 /end CHARACTERISTIC
/begin CHARACTERISTIC PCR_tClntAdPCVLim_C "Minimale Grenze fuer Kuehlmittel temperatur" VALUE 0xE68FE Kw_Ws16 950.000 Temp_Cels -50.140 899.860 FORMAT "%8.3" EXTENDED_LIMITS -3549.940 3003.560 /end CHARACTERISTIC
/begin CHARACTERISTIC PCR_tiAirPerTimeAmplFlt_C "Parameter für PT1-Glied für Tiefpassfilterung der Amplitude der oszillierenden Frischluftmasse nach der DFT" VALUE 0xE7598 Kw_Wu32 4294967.3 TimeDelay_ms 0.0010000000 4294967.3 FORMAT "%9.1" /end CHARACTERISTIC
/begin CHARACTERISTIC PCR_tiClutchDebHighLow_C "Entprellzeit für Kupplungssignalüberwachung von High/Low-Wechsel" VALUE 0xE7282 Kw_Wu16 655350.0 TimeDeb 0.00 655350.0 FORMAT "%8.1" /end CHARACTERISTIC
/begin CHARACTERISTIC PCR_tiClutchDebLowHigh_C "Entprellzeit für Kupplungssignalüberwachung von Low/High-Wechsel" VALUE 0xE7284 Kw_Wu16 655350.0 TimeDeb 0.00 655350.0 FORMAT "%8.1" /end CHARACTERISTIC
/begin CHARACTERISTIC PCR_tiCoStrt_CUR "#SSD Kennlinie für die Zeit, die die Regelung nach Startabwurf abgeschaltet bleibt" CURVE 0xE7286 Kl_Xs16_Ws16 33000.00 Time_ms 0.00 33000.00 FORMAT "%8.2" EXTENDED_LIMITS -327680.0 327670.0
 /begin AXIS_DESCR STD_AXIS CTSCD_tClnt Temp_Cels 6 -50.1400 199.8600 FORMAT "%8.4" EXTENDED_LIMITS -3549.940 3003.560 DEPOSIT ABSOLUTE /end AXIS_DESCR
/end CHARACTERISTIC
/begin CHARACTERISTIC PCR_tiDelPreSurgeDet_C "Verzögerungszeit für die Erkennung oszillierende Luftmasse mit kleiner Amplitude" VALUE 0xE759C Kw_Wu16 655350.0 Time_ms 0.00 655350.0 FORMAT "%8.1" /end CHARACTERISTIC
/begin CHARACTERISTIC PCR_tiGvnrOffDel_CUR "Abschaltungsverzögerungszeit im Normalmodus" CURVE 0xE72A0 Kl_Xs16_Ws16 20.00000 Time_s 0.00 20.00000 FORMAT "%8.5" EXTENDED_LIMITS -327.6800 327.6700
 /begin AXIS_DESCR STD_AXIS Eng_nAvrg EngN 6 0.00 8000.000 FORMAT "%8.3" EXTENDED_LIMITS -32768.00 32767.00 DEPOSIT ABSOLUTE /end AXIS_DESCR
/end CHARACTERISTIC
/begin CHARACTERISTIC PCR_tiStrtDelayInit_C "#SSD Inititalisierungswert der Zeit, die der PCR nach dem Startabfall abgeschaltet bleibt" VALUE 0xE72BA Kw_Wu16 655350.0 Time_ms 0.00 655350.0 FORMAT "%8.1" /end CHARACTERISTIC
/begin CHARACTERISTIC PCR_vClutch_C "Geschwindigkeitsgrenze für Kuplungsüberwachung" VALUE 0xE72BC Kw_Ws16 300.0000 Vel 0.00 300.0000 FORMAT "%8.4" EXTENDED_LIMITS -327.6800 327.6700 /end CHARACTERISTIC
/begin CHARACTERISTIC PCVCD_uSRCMin_C "#SSD Signal Range Check Min-Wert" VALUE 0xE75E8 Kw_Ws16 5200.391 Volt 0.00 5200.391 FORMAT "%8.3" EXTENDED_LIMITS -160156.4 160151.5 /end CHARACTERISTIC
/begin CHARACTERISTIC PCVCD_uSRCMax_C "#SSD Signal Range Check Max-Wert" VALUE 0xE75EA Kw_Ws16 5200.391 Volt 0.00 5200.391 FORMAT "%8.3" EXTENDED_LIMITS -160156.4 160151.5 /end CHARACTERISTIC
/begin CHARACTERISTIC PCVCD_iLin_CUR "#SSD Analogeingang, Linearisierungskennlinie" CURVE 0xE75EC Kl_Xs16_Ws16 5000.000 Curr 0.00 5000.000 FORMAT "%8.3" EXTENDED_LIMITS -32768.00 32767.00
 /begin AXIS_DESCR STD_AXIS PCVCD_uRawVal_mp Volt 2 0.00 5200.391 FORMAT "%8.3" EXTENDED_LIMITS -160156.4 160151.5 DEPOSIT ABSOLUTE /end AXIS_DESCR
/end CHARACTERISTIC
/begin CHARACTERISTIC PCVCD_dcycMax_C "#SSD Max-Wert, Ausgangstastverhältnis" VALUE 0xE75F6 Kw_Ws16 100.0000 DtyCyc 0.00 100.0000 FORMAT "%8.4" EXTENDED_LIMITS -327.6800 327.6700 /end CHARACTERISTIC
/begin CHARACTERISTIC PCVCD_dcycMin_C "#SSD Min-Wert, Ausgangstastverhältnis" VALUE 0xE75F8 Kw_Ws16 100.0000 DtyCyc 0.00 100.0000 FORMAT "%8.4" EXTENDED_LIMITS -327.6800 327.6700 /end CHARACTERISTIC
/begin CHARACTERISTIC PCVCD_dcycTst_C "#SSD Tastverhältnis, das im Fehlerfall zyklisch ausgegeben wird" VALUE 0xE75FA Kw_Ws16 100.0000 DtyCyc 0.00 100.0000 FORMAT "%8.4" EXTENDED_LIMITS -327.6800 327.6700 /end CHARACTERISTIC
/begin CHARACTERISTIC PCVCD_DebExcTempDef_C "#SSD Fehlerentprellzeit Uebertemperatur" VALUE 0xE75FC Kw_Wu16 655350.0 Time_ms 0.00 655350.0 FORMAT "%8.1" /end CHARACTERISTIC
/begin CHARACTERISTIC PCVCD_DebExcTempOk_C "#SSD Heilungsentprellzeit Uebertemperatur" VALUE 0xE75FE Kw_Wu16 655350.0 Time_ms 0.00 655350.0 FORMAT "%8.1" /end CHARACTERISTIC
/begin CHARACTERISTIC PCVCD_DebNoLoadDef_C "#SSD Fehlerentprellzeit Leerlauf" VALUE 0xE7600 Kw_Wu16 655350.0 Time_ms 0.00 655350.0 FORMAT "%8.1" /end CHARACTERISTIC
/begin CHARACTERISTIC PCVCD_DebNoLoadOk_C "#SSD Heilungszeit Leerlauf" VALUE 0xE7602 Kw_Wu16 655350.0 Time_ms 0.00 655350.0 FORMAT "%8.1" /end CHARACTERISTIC
/begin CHARACTERISTIC PCVCD_DebShortCircBatDef_C "#SSD Fehlerentprellzeit Kurzschluss Batterie" VALUE 0xE7604 Kw_Wu16 655350.0 Time_ms 0.00 655350.0 FORMAT "%8.1" /end CHARACTERISTIC
/begin CHARACTERISTIC PCVCD_DebShortCircBatOk_C "#SSD Heilungsentprellzeit Kurzschluss Batterie" VALUE 0xE7606 Kw_Wu16 655350.0 Time_ms 0.00 655350.0 FORMAT "%8.1" /end CHARACTERISTIC
/begin CHARACTERISTIC PCVCD_DebShortCircGndDef_C "#SSD Fehlerentprellzeit Kurzschluss Masse" VALUE 0xE7608 Kw_Wu16 655350.0 Time_ms 0.00 655350.0 FORMAT "%8.1" /end CHARACTERISTIC
/begin CHARACTERISTIC PCVCD_DebShortCircGndOk_C "#SSD Heilungsentprellzeit Kurzschluss Masse" VALUE 0xE760A Kw_Wu16 655350.0 Time_ms 0.00 655350.0 FORMAT "%8.1" /end CHARACTERISTIC
/begin CHARACTERISTIC PCVCD_DebSRCHighDef_C "#SSD Fehlerentprellzeit für Analogeingang SRC-High Fehler" VALUE 0xE760C Kw_Wu16 655350.0 Time_ms 0.00 655350.0 FORMAT "%8.1" /end CHARACTERISTIC
/begin CHARACTERISTIC PCVCD_DebSRCHighOk_C "#SSD Heilungsentprellzeit für Analogeingang SRC-High Fehler" VALUE 0xE760E Kw_Wu16 655350.0 Time_ms 0.00 655350.0 FORMAT "%8.1" /end CHARACTERISTIC
/begin CHARACTERISTIC PCVCD_DebSRCLowDef_C "#SSD Fehlerentprellzeit Analogeingang SRC-Low Fehler" VALUE 0xE7610 Kw_Wu16 655350.0 Time_ms 0.00 655350.0 FORMAT "%8.1" /end CHARACTERISTIC
/begin CHARACTERISTIC PCVCD_DebSRCLowOk_C "#SSD Heilungsentprellzeit für Analogeingang SRC-Low Fehler" VALUE 0xE7612 Kw_Wu16 655350.0 Time_ms 0.00 655350.0 FORMAT "%8.1" /end CHARACTERISTIC
/begin CHARACTERISTIC PCVCD_facIGovInit_CUR "#SSD Initialisierungsfaktor für I-Anteil des Stromreglers als Funktion der Systemtemperatur" CURVE 0xE7614 Kl_Xs16_Ws16 2.000000 Fact 0.00 2.000000 FORMAT "%8.6" EXTENDED_LIMITS -4.000000 3.999878
 /begin AXIS_DESCR STD_AXIS FlSys_t Temp_Cels 4 -50.14000 199.8600 FORMAT "%8.4" EXTENDED_LIMITS -3549.940 3003.560 DEPOSIT ABSOLUTE /end AXIS_DESCR
/end CHARACTERISTIC
/begin CHARACTERISTIC PCVCD_facIGovMax_C "#SSD maximaler I-Anteil" VALUE 0xE7626 Kw_Ws16 1.000000 Fact 1.000000 2.000000 FORMAT "%8.6" EXTENDED_LIMITS -4.000000 3.999878 /end CHARACTERISTIC
/begin CHARACTERISTIC PCVCD_facIGovMin_C "#SSD minimaler I-Anteil" VALUE 0xE7628 Kw_Ws16 0.5000000 Fact 0.5000000 1.000000 FORMAT "%8.6" EXTENDED_LIMITS -4.000000 3.999878 /end CHARACTERISTIC
/begin CHARACTERISTIC PCVCD_tiFlt1PT1_C "#SSD PT1 Filterzeitkonstante für Strom-Istwert" VALUE 0xE762C Kw_Wu32 4294.9673 TimeDelay_s 0.0000010000000 4294.9673 FORMAT "%9.4" /end CHARACTERISTIC
/begin CHARACTERISTIC PCVCD_tiFlt2PT1_C "#SSD PT1 Filterzeitkonstante für Strom-Sollwert" VALUE 0xE7630 Kw_Wu32 4294.9673 TimeDelay_s 0.0000010000000 4294.9673 FORMAT "%9.4" /end CHARACTERISTIC
/begin CHARACTERISTIC PCVCD_tiIGovDT1_C "#SSD DT1 Zeitkonstante" VALUE 0xE7634 Kw_Wu32 4294.9673 TimeDelay_s 0.0000010000000 4294.9673 FORMAT "%9.4" /end CHARACTERISTIC
/begin CHARACTERISTIC PCVCD_IGovDKd_C "#SSD DT1 Differenziationsfaktor" VALUE 0xE7638 Kw_Ws32 65535.9999847 Kd -32768.0000000 32767.9999847 FORMAT "%13.7" /end CHARACTERISTIC
/begin CHARACTERISTIC PCVCD_IGovIKi_C "#SSD I-Glied, Kleinsignalverstärkung" VALUE 0xE763C Kw_Wu32 122.070312472 Ki_curr2fact 0.00 122.070312472 FORMAT "%13.9" /end CHARACTERISTIC
/begin CHARACTERISTIC PCVCD_IGovIKiPos_C "#SSD I-Glied, Verstärkung für positive Großsignale" VALUE 0xE7640 Kw_Wu32 122.070312472 Ki_curr2fact 0.00 122.070312472 FORMAT "%13.9" /end CHARACTERISTIC
/begin CHARACTERISTIC PCVCD_IGovIKiNeg_C "#SSD I_Glied, Verstärkung für negative Großsignale" VALUE 0xE7644 Kw_Wu32 122.070312472 Ki_curr2fact 0.00 122.070312472 FORMAT "%13.9" /end CHARACTERISTIC
/begin CHARACTERISTIC PCVCD_iIGovIWinPos_C "#SSD I-Glied, Kleinsignalfenster positiv" VALUE 0xE7648 Kw_Ws16 65535.00 Curr -32768.00 32767.00 FORMAT "%8.2" /end CHARACTERISTIC
/begin CHARACTERISTIC PCVCD_iIGovIWinNeg_C "#SSD I_Glied, Kleinsignalfenster negativ" VALUE 0xE764A Kw_Ws16 65535.00 Curr -32768.00 32767.00 FORMAT "%8.2" /end CHARACTERISTIC
/begin CHARACTERISTIC PCVCD_tiFltPT1Init_C "#SSD PT1 Filterzeitkonstante während Initialisierungsphase des Stromreglers" VALUE 0xE764C Kw_Wu32 4294.9673 TimeDelay_s 0.0000010000000 4294.9673 FORMAT "%9.4" /end CHARACTERISTIC
/begin CHARACTERISTIC PCVCD_numAdc_C "#SSD Parameter für die Auswahl des Analogkanals für das Druckregelventil" VALUE 0xE7650 Kw_Wu8 44.0000000000 NumPinAdc 0.00 44.0000000000 FORMAT "%13.10" /end CHARACTERISTIC
/begin CHARACTERISTIC PCVCD_numDia1_C "#SSD Parameter für Zuordnung der Diagnose zur 1. Endstufe des Druckregelventils" VALUE 0xE7651 Kw_Wu8 34.0000000000 NumPinDia 0.00 34.0000000000 FORMAT "%13.10" /end CHARACTERISTIC
/begin CHARACTERISTIC PCVCD_numDia2_C "#SSD Parameter für Zuordnung der Diagnose zur 2. Endstufe des Druckregelventils" VALUE 0xE7652 Kw_Wu8 34.0000000000 NumPinDia 0.00 34.0000000000 FORMAT "%13.10" /end CHARACTERISTIC
/begin CHARACTERISTIC PCVCD_numPwmOut_C "#SSD Parameter für die Auswahl des Hardware-Pins für das Druckregelventil" VALUE 0xE7653 Kw_Wu8 12.0000000000 NumPinPwmOut 0.00 12.0000000000 FORMAT "%13.10" /end CHARACTERISTIC
/begin CHARACTERISTIC PCVCD_stInvOut_C "#SSD Invertierungsparameter der PWM Endstufe" VALUE 0xE7654 Kw_Wu8 1.000 OneToOne 0.00 1.000 FORMAT "%5.3" EXTENDED_LIMITS 0.00 255.0 /end CHARACTERISTIC
/begin CHARACTERISTIC PCVCD_tiPer_C "#SSD Periodendauer der PWM-Endstufe" VALUE 0xE7656 Kw_Ws16 9.900000 Period 0.1000000 10.00000 FORMAT "%8.5" EXTENDED_LIMITS -3276.800 3276.700 /end CHARACTERISTIC
/begin CHARACTERISTIC PCVCD_resCoil_C "#SSD Widerstandswert der DRV-Spule" VALUE 0xE7658 Kw_Ws16 5000.000 Resist_1 0.00 5000.000 FORMAT "%8.3" EXTENDED_LIMITS -32768.00 32767.00 /end CHARACTERISTIC
/begin CHARACTERISTIC PCVCD_stPwrStgDia_C "#SSD Statuswort zur Spezifikation des Abschaltverhaltens der Endstufenfehlerdiagnose Druckregelventil" VALUE 0xE765A Kw_Wu8 255.0 OneToOne 0.00 255.0 FORMAT "%5.1" /end CHARACTERISTIC
/begin CHARACTERISTIC PCVCD_swtCtlStateVal_C "#SSD CP1: 0: konstant Stromregelung, 1: nur wenn Raildruckregler im gesteuerten Betrieb ist" VALUE 0xE765B Kw_Wu8 0.00 OneToOne 0.00 0.00 FORMAT "%5.2" EXTENDED_LIMITS 0.00 255.0 /end CHARACTERISTIC
/begin CHARACTERISTIC PCVCD_swtCtlStateType_C "#SSD CP1: Auswahl, Schalterwert aus Datensatz oder EEPROM" VALUE 0xE765C Kw_Wu8 1.000 OneToOne 1.000 2.000 FORMAT "%5.3" EXTENDED_LIMITS 0.00 255.0 /end CHARACTERISTIC
/begin CHARACTERISTIC PCVCD_swt_C "#SSD allgemeine Schalterfunktionen der Endstufe Druckregelventil" VALUE 0xE765D Kw_Wu8 255.0 OneToOne 0.00 255.0 FORMAT "%5.1" /end CHARACTERISTIC
/begin CHARACTERISTIC PCVCD_tiBtwTst_C "#SSD Zeitabstand, in dem im Fehlerfall die Endstufe getestet wird" VALUE 0xE765E Kw_Wu16 29990.00 Time_ms 10.00000 30000.00 FORMAT "%8.2" EXTENDED_LIMITS 0.00 655350.0 /end CHARACTERISTIC
/begin CHARACTERISTIC PCVCD_tiIGovInit_C "#SSD maximale Zeitdauer der Initialisierungsphase für den Stromregler" VALUE 0xE7660 Kw_Wu16 655350.0 Time_ms 0.00 655350.0 FORMAT "%8.1" /end CHARACTERISTIC
/begin CHARACTERISTIC PCVCD_tiDebSigDefSigTst_C "Fehlerentprellzeit fuer Fehlerpfad Dfp_PCVCD_SigTst" VALUE 0xE7662 Kw_Wu16 655350.0 Time_ms 0.00 655350.0 FORMAT "%8.1" /end CHARACTERISTIC
/begin CHARACTERISTIC PCVCD_tiDebSigOkSigTst_C "Heliungsentprellzeit fuer Fehlerpfad Dfp_PCVCD_SigTst" VALUE 0xE7664 Kw_Wu16 655350.0 Time_ms 0.00 655350.0 FORMAT "%8.1" /end CHARACTERISTIC
/begin CHARACTERISTIC PCV_dvolLeak_CUR "#SSD Leckage des Druckregelventils" CURVE 0xE75A0 Kl_Xs16_Ws16 150000.0 Qp_mm3_sec 0.00 150000.0 FORMAT "%8.1" EXTENDED_LIMITS -327680.0 327670.0
 /begin AXIS_DESCR STD_AXIS Rail_pSetPoint Pres_Rail 6 0.00 2000.000 FORMAT "%5.3" EXTENDED_LIMITS -3276.800 3276.700 DEPOSIT ABSOLUTE /end AXIS_DESCR
/end CHARACTERISTIC
/begin CHARACTERISTIC PCV_iCnvPress_CUR "#SSD Kennlinie zur Umrechnung von Raildruck in elektrischen Strom" CURVE 0xE75BA Kl_Xs16_Ws16 5000.000 Curr 0.00 5000.000 FORMAT "%8.3" EXTENDED_LIMITS -32768.00 32767.00
 /begin AXIS_DESCR STD_AXIS Rail_pPCVSet Pres_Rail 10 0.00 2000.000 FORMAT "%5.3" EXTENDED_LIMITS -3276.800 3276.700 DEPOSIT ABSOLUTE /end AXIS_DESCR
/end CHARACTERISTIC
/begin CHARACTERISTIC PCV_iSetMin_C "#SSD Sollstrom bei elektrischer Abschaltung des Druckregelventils" VALUE 0xE75E4 Kw_Ws16 65535.00 Curr -32768.00 32767.00 FORMAT "%8.2" /end CHARACTERISTIC
/begin CHARACTERISTIC PCV_iSet_Vector "#SSD Bypass-Label für PCV_iSet (Nicht verstellen!)" VALUE 0xC2E04 Kw_Wu8 255.0 OneToOne 0.00 255.0 FORMAT "%5.1" /end CHARACTERISTIC
/begin CHARACTERISTIC PCV_iSet_Channel "#SSD Bypass-Label für PCV_iSet, nicht editieren!" VALUE 0xC2E05 Kw_Wu8 255.0 OneToOne 0.00 255.0 FORMAT "%5.1" /end CHARACTERISTIC
/begin CHARACTERISTIC PFltCD_uSRCMinPPre_C "Spannungsrohwert SRC-Min des Abgasdrucks vor dem Partikelfilter" VALUE 0xE8FC4 Kw_Ws16 5200.391 Volt 0.00 5200.391 FORMAT "%8.3" EXTENDED_LIMITS -160156.4 160151.5 /end CHARACTERISTIC
/begin CHARACTERISTIC PFltCD_uSRCMaxPPre_C "Spannungsrohwert SRC-Max des Abgasdrucks vor dem Partikelfilter" VALUE 0xE8FC6 Kw_Ws16 5200.391 Volt 0.00 5200.391 FORMAT "%8.3" EXTENDED_LIMITS -160156.4 160151.5 /end CHARACTERISTIC
/begin CHARACTERISTIC PFltCD_pLinPre_CUR "Linearisierungskennlinie des Abgasdrucks vor dem Partikelfilter" CURVE 0xE8FC8 Kl_Xs16_Ws16 50000.00 Pres 0.00 50000.00 FORMAT "%9.2" EXTENDED_LIMITS -32768.00 32767.00
 /begin AXIS_DESCR STD_AXIS PFltCD_uRawPresPre_mp Volt 8 0.00 5200.391 FORMAT "%8.3" EXTENDED_LIMITS -160156.4 160151.5 DEPOSIT ABSOLUTE /end AXIS_DESCR
/end CHARACTERISTIC
/begin CHARACTERISTIC PFltCD_uSRCMinTempPre_C "Spannungsrohwert SRC-Min der Abgastemperatur vor dem Partikelfilter" VALUE 0xE9008 Kw_Ws16 5200.391 Volt 0.00 5200.391 FORMAT "%8.3" EXTENDED_LIMITS -160156.4 160151.5 /end CHARACTERISTIC
/begin CHARACTERISTIC PFltCD_uSRCMaxTempPre_C "Spannungsrohwert SRC-Max der Abgastemperatur vor dem Partikelfilter" VALUE 0xE900A Kw_Ws16 5200.391 Volt 0.00 5200.391 FORMAT "%8.3" EXTENDED_LIMITS -160156.4 160151.5 /end CHARACTERISTIC
/begin CHARACTERISTIC PFltCD_tLinPre_CUR "Linearisierungskennlinie der Abgastemperatur vor dem Partikelfilter" CURVE 0xE900C Kl_Xs16_Ws16 950.0000 Temp_Cels -50.14000 899.8600 FORMAT "%8.4" EXTENDED_LIMITS -3549.940 3003.560
 /begin AXIS_DESCR STD_AXIS PFltCD_uRawTempPre Volt 16 0.00 5200.391 FORMAT "%8.3" EXTENDED_LIMITS -160156.4 160151.5 DEPOSIT ABSOLUTE /end AXIS_DESCR
/end CHARACTERISTIC
/begin CHARACTERISTIC PFltCD_DebSRCHighDefTPre_C "Fehlerentprellzeit SRC-High-Fehler für die Abgastemperatur vor dem Partikelfilter" VALUE 0xE904E Kw_Wu16 655350.0 Time_ms 0.00 655350.0 FORMAT "%8.1" /end CHARACTERISTIC
/begin CHARACTERISTIC PFltCD_DebSRCHighOkTPre_C "Heilungsentprellzeit SRC-High für die Abgastemperatur vor dem Partikelfilter" VALUE 0xE9050 Kw_Wu16 655350.0 Time_ms 0.00 655350.0 FORMAT "%8.1" /end CHARACTERISTIC
/begin CHARACTERISTIC PFltCD_DebSRCHiDefPPre_C "Entprellzeit: obere SRC Grenze überschritten" VALUE 0xE8FEA Kw_Wu16 655350.0 Time_ms 0.00 655350.0 FORMAT "%8.1" /end CHARACTERISTIC
/begin CHARACTERISTIC PFltCD_DebSRCHiOkPPre_C "Entprellzeit: obere Grenzwertverletzung geheilt" VALUE 0xE8FEC Kw_Wu16 655350.0 Time_ms 0.00 655350.0 FORMAT "%8.1" /end CHARACTERISTIC
/begin CHARACTERISTIC PFltCD_DebSRCLoDefPPre_C "Entprellzeit: untere SRC Grenze überschritten" VALUE 0xE8FEE Kw_Wu16 655350.0 Time_ms 0.00 655350.0 FORMAT "%8.1" /end CHARACTERISTIC
/begin CHARACTERISTIC PFltCD_DebSRCLoOkPPre_C "Entprellzeit: untere Grenzwertverletzung geheilt" VALUE 0xE8FF0 Kw_Wu16 655350.0 Time_ms 0.00 655350.0 FORMAT "%8.1" /end CHARACTERISTIC
/begin CHARACTERISTIC PFltCD_DebSRCLowDefTPre_C "Fehlerentprellzeit SRC-Low-Fehler für die Abgastemperatur vor dem Partikelfilter" VALUE 0xE9052 Kw_Wu16 655350.0 Time_ms 0.00 655350.0 FORMAT "%8.1" /end CHARACTERISTIC
/begin CHARACTERISTIC PFltCD_DebSRCLowOkTPre_C "Heilungsentprellzeit SRC-Low für die Abgastemperatur vor dem Partikelfilter" VALUE 0xE9054 Kw_Wu16 655350.0 Time_ms 0.00 655350.0 FORMAT "%8.1" /end CHARACTERISTIC
/begin CHARACTERISTIC PFltCD_dtRmpSlpUpPPre_C "Rampensteigung bei Heilung/Vorgabewert für Absolutdrucksensor vor dem Partikelfilter" VALUE 0xE8FF4 Kw_Wu32 65535999.9847 RmpPres 0.00 65535999.9847 FORMAT "%14.4" /end CHARACTERISTIC
/begin CHARACTERISTIC PFltCD_dtRmpSlpDwnPPre_C "Rampensteigung bei Heilung/Vorgabewert für Abolutdrucksensor vor dem Partikelfilter" VALUE 0xE8FF8 Kw_Wu32 65535999.9847 RmpPres 0.00 65535999.9847 FORMAT "%14.4" /end CHARACTERISTIC
/begin CHARACTERISTIC PFltCD_dtRmpSlpUpPre_C "Aufw.-Schritt für Rampe der Abgastemperatur vor dem Partikelfilter" VALUE 0xE9058 Kw_Wu32 6553599.99847 RmpTemp 0.00 6553599.99847 FORMAT "%13.5" /end CHARACTERISTIC
/begin CHARACTERISTIC PFltCD_dtRmpSlpDwnPre_C "Abw.-Schritt für Rampe der Abgastemperatur vor dem Partikelfilter" VALUE 0xE905C Kw_Wu32 6553599.99847 RmpTemp 0.00 6553599.99847 FORMAT "%13.5" /end CHARACTERISTIC
/begin CHARACTERISTIC PFLTCD_numAdc2_C "#SSD application parameter for Exhaust Temperature sensor 1" VALUE 0xE8FFC Kw_Wu8 44.0000000000 NumPinAdc 0.00 44.0000000000 FORMAT "%13.10" /end CHARACTERISTIC
/begin CHARACTERISTIC PFLTCD_numAdc_C "#SSD application parameter for Exhaust Temperature Sensor 1" VALUE 0xE9060 Kw_Wu8 44.0000000000 NumPinAdc 0.00 44.0000000000 FORMAT "%13.10" /end CHARACTERISTIC
/begin CHARACTERISTIC PFltCD_tiPPrePT1_C "Zeitkonstante des PT1 Filters" VALUE 0xE9000 Kw_Wu32 4294.9673 TimeDelay_s 0.0000010000000 4294.9673 FORMAT "%9.4" /end CHARACTERISTIC
/begin CHARACTERISTIC PFltCD_stSensIDWordPPre_C "Geberkennwort für Abgasdruck vor dem Partikelfilter" VALUE 0xE9004 Kw_Wu16 65535.00 OneToOne 0.00 65535.00 FORMAT "%8.2" /end CHARACTERISTIC
/begin CHARACTERISTIC PFltCD_pDflPre_C "Vorgabewert für Absolutdruck vor dem Partikelfilter" VALUE 0xE9006 Kw_Ws16 50000.00 Pres 0.00 50000.00 FORMAT "%9.2" EXTENDED_LIMITS -32768.00 32767.00 /end CHARACTERISTIC
/begin CHARACTERISTIC PFltCD_stSensIDWordTPre_C "Geberkennwort für Abgastemperatur vor dem Partikelfilter" VALUE 0xE9062 Kw_Wu16 65535.00 OneToOne 0.00 65535.00 FORMAT "%8.2" /end CHARACTERISTIC
/begin CHARACTERISTIC PFltCD_tDflPre_C "Vorgabewert für die Abgastemperatur vor dem Partikelfilter" VALUE 0xE9064 Kw_Ws16 950.0000 Temp_Cels -50.14000 899.8600 FORMAT "%8.4" EXTENDED_LIMITS -3549.940 3003.560 /end CHARACTERISTIC
/begin CHARACTERISTIC PFlt_aVehFltAshCorMax_C "maximal zulässiger Wert Fahrzeugbeschleunigung" VALUE 0xE7668 Kw_Ws16 10.00000 Acc 0.00 10.00000 FORMAT "%8.5" EXTENDED_LIMITS -32.76800 32.76700 /end CHARACTERISTIC
/begin CHARACTERISTIC PFlt_aVehFltAshCorMin_C "minimal zulässiger Wert Fahrzeugbeschleunigung" VALUE 0xE766A Kw_Ws16 20.00000 Acc -10.00000 10.00000 FORMAT "%8.5" EXTENDED_LIMITS -32.76800 32.76700 /end CHARACTERISTIC
/begin CHARACTERISTIC PFlt_ctAshCorRgnMax_C "Counteranzahl für Maximumzähler der AshCor Regeneration" VALUE 0xE766C Kw_Wu16 65535.00 OneToOne 0.00 65535.00 FORMAT "%8.2" /end CHARACTERISTIC
/begin CHARACTERISTIC PFlt_ctAshCorRgn_C "Counterzahl für gültige AshCor Regeneration" VALUE 0xE766E Kw_Wu16 65535.00 OneToOne 0.00 65535.00 FORMAT "%8.2" /end CHARACTERISTIC
/begin CHARACTERISTIC PFlt_facAshCorOld_C "Faktor für den alten Aschekorrekturwert" VALUE 0xE7670 Kw_Ws16 1.000000 Fact 0.00 1.000000 FORMAT "%8.6" EXTENDED_LIMITS -4.000000 3.999878 /end CHARACTERISTIC
/begin CHARACTERISTIC PFlt_facAshOil_C "Faktor für Aschenöl" VALUE 0xE7672 Kw_Ws16 1.000000 Fact 0.00 1.000000 FORMAT "%8.6" EXTENDED_LIMITS -4.000000 3.999878 /end CHARACTERISTIC
/begin CHARACTERISTIC PFlt_facFlTotCor_C "Gesamtmenge Kraftstoffkorrekturfaktor" VALUE 0xE7674 Kw_Ws16 1.000000 Fact 0.00 1.000000 FORMAT "%8.6" EXTENDED_LIMITS -4.000000 3.999878 /end CHARACTERISTIC
/begin CHARACTERISTIC PFlt_faclAshCor_C "Aschenkorrekturfaktor." VALUE 0xE7676 Kw_Wu16 9.989990 Fact 0.01000977 10.00000 FORMAT "%8.5" EXTENDED_LIMITS 0.00 7.999878 /end CHARACTERISTIC
/begin CHARACTERISTIC PFlt_lAshCorMax_C "Maximaler Kilometerstand" VALUE 0xE7678 Kw_Ws16 32767.00 LengthKm 0.00 32767.00 FORMAT "%8.2" EXTENDED_LIMITS -32768.00 32767.00 /end CHARACTERISTIC
/begin CHARACTERISTIC PFlt_lAshCorNextDef_C "Lesen des Wertes aus dem Eeprom nicht erfolgreich; diesen Wert verwenden" VALUE 0xE767A Kw_Ws16 32767.00 LengthKm 0.00 32767.00 FORMAT "%8.2" EXTENDED_LIMITS -32768.00 32767.00 /end CHARACTERISTIC
/begin CHARACTERISTIC PFlt_lAshCorNplAbsRel_C "Kilometerzahl, welche bei erkanntem relativen und absoluten Fehler addiert wird" VALUE 0xE767C Kw_Ws16 32767.00 LengthKm 0.00 32767.00 FORMAT "%8.2" EXTENDED_LIMITS -32768.00 32767.00 /end CHARACTERISTIC
/begin CHARACTERISTIC PFlt_lAshCorNplAbs_C "plausibler Wert für den absoluten Kilometerstand" VALUE 0xE767E Kw_Ws16 32767.00 LengthKm 0.00 32767.00 FORMAT "%8.2" EXTENDED_LIMITS -32768.00 32767.00 /end CHARACTERISTIC
/begin CHARACTERISTIC PFlt_lAshCorNplRel_C "plausibler Wert für den relativen Kilometerstand" VALUE 0xE7680 Kw_Ws16 32767.00 LengthKm 0.00 32767.00 FORMAT "%8.2" EXTENDED_LIMITS -32768.00 32767.00 /end CHARACTERISTIC
/begin CHARACTERISTIC PFlt_lAshCorRegIntr_C "Regenerationsunterbrechung Kilometerstand" VALUE 0xE7682 Kw_Ws16 32767.00 LengthKm 0.00 32767.00 FORMAT "%8.2" EXTENDED_LIMITS -32768.00 32767.00 /end CHARACTERISTIC
/begin CHARACTERISTIC PFlt_lMinSnceRgn_C "Minimaler Abstand seit letzter Regeneration." VALUE 0xE7684 Kw_Wu32 2147483647.00 LengthKm 0.00 2147483647.00 FORMAT "%13.2" EXTENDED_LIMITS 0.00 4294967295.00 /end CHARACTERISTIC
/begin CHARACTERISTIC PFlt_lSumMaxDef_C "gefahrene Strecke Schwelle für Regeneration im Fehlerfall" VALUE 0xE7784 Kw_Wu32 4294967295.00 Length 0.00 4294967295.00 FORMAT "%13.2" /end CHARACTERISTIC
/begin CHARACTERISTIC PFlt_lSumMax_C "gefahrene Strecke Schwelle für Regeneration" VALUE 0xE7788 Kw_Wu32 4294967295.00 Length 0.00 4294967295.00 FORMAT "%13.2" /end CHARACTERISTIC
/begin CHARACTERISTIC PFlt_lSumSubs_C "Ersatzwert für gefahrene Strecke im Fall eines Eeprom lese Fehlers" VALUE 0xE778C Kw_Wu32 4294967295.00 Length 0.00 4294967295.00 FORMAT "%13.2" /end CHARACTERISTIC
/begin CHARACTERISTIC PFlt_mAshCor_MAP "Map für Ascheabweichung vom Sollwert" MAP 0xE7688 Kf_Xs16_Ys16_Ws16 400.0000 mSoot_g -100.0000 300.0000 FORMAT "%8.4" EXTENDED_LIMITS -327.6800 327.6700
 /begin AXIS_DESCR STD_AXIS PFlt_dVolFltAshCor_mp CubMtrPerHr 8 0.00 3000.000 FORMAT "%8.3" EXTENDED_LIMITS -3276.800 3276.700 DEPOSIT ABSOLUTE /end AXIS_DESCR
 /begin AXIS_DESCR STD_AXIS PFlt_resFlowFltAshCor_mp Res_hPaHrPerCM 8 0.00 25.00000 FORMAT "%8.5" EXTENDED_LIMITS -32.76800 32.76700 DEPOSIT ABSOLUTE /end AXIS_DESCR
/end CHARACTERISTIC
/begin CHARACTERISTIC PFlt_mAshTolcMaxAbs_C "maximal erlaubte absolute Abweichung des neu berechneten Aschewertes" VALUE 0xE772C Kw_Ws16 300.0000 mSoot_g 0.00 300.0000 FORMAT "%8.4" EXTENDED_LIMITS -327.6800 327.6700 /end CHARACTERISTIC
/begin CHARACTERISTIC PFlt_mAshTolcMaxRel_C "maximal erlaubte relative Abweichung der neu berechneten Aschemenge" VALUE 0xE772E Kw_Ws16 300.0000 mSoot_g 0.00 300.0000 FORMAT "%8.4" EXTENDED_LIMITS -327.6800 327.6700 /end CHARACTERISTIC
/begin CHARACTERISTIC PFlt_mDiagAFSMax_C "obere Grenze des gemittelten Wertes der Luftmasse pro Zylinder" VALUE 0xE7AB0 Kw_Ws16 3200.000 AirMassPerCyl 0.00 3200.000 FORMAT "%8.3" EXTENDED_LIMITS -3276.800 3276.700 /end CHARACTERISTIC
/begin CHARACTERISTIC PFlt_mDiagAFSMin_C "untere Grenze des gemittelten Wertes der Luftmasse pro Zylinder" VALUE 0xE7AB2 Kw_Ws16 3200.000 AirMassPerCyl 0.00 3200.000 FORMAT "%8.3" EXTENDED_LIMITS -3276.800 3276.700 /end CHARACTERISTIC
/begin CHARACTERISTIC PFlt_mDiagSotMax_C "obere Grenze der Partikelmasse im Partikelfilter" VALUE 0xE7AB4 Kw_Ws16 300.0000 mSoot_g 0.00 300.0000 FORMAT "%8.4" EXTENDED_LIMITS -327.6800 327.6700 /end CHARACTERISTIC
/begin CHARACTERISTIC PFlt_mDiagSotMin_C "untere Grenze der Partikelmasse im Partikelfilter" VALUE 0xE7AB6 Kw_Ws16 300.0000 mSoot_g 0.00 300.0000 FORMAT "%8.4" EXTENDED_LIMITS -327.6800 327.6700 /end CHARACTERISTIC
/begin CHARACTERISTIC PFlt_mSotMeas_CUR "Umrechnung Strömungswiderstand Partikelmasse" CURVE 0xE7790 Kl_Xs16_Ws16 300.0000 mSoot_g 0.00 300.0000 FORMAT "%8.4" EXTENDED_LIMITS -327.6800 327.6700
 /begin AXIS_DESCR STD_AXIS PFlt_resFlowOfs Res_hPaHrPerCM 8 0.00 25.00000 FORMAT "%8.5" EXTENDED_LIMITS -32.76800 32.76700 DEPOSIT ABSOLUTE /end AXIS_DESCR
/end CHARACTERISTIC
/begin CHARACTERISTIC PFlt_mSotNewRng1_C "Schwelle Regeneriert -> Regenerationsstate 1" VALUE 0xE77B2 Kw_Ws16 300.0000 mSoot_g 0.00 300.0000 FORMAT "%8.4" EXTENDED_LIMITS -327.6800 327.6700 /end CHARACTERISTIC
/begin CHARACTERISTIC PFlt_mSotRng1New_C "Schwelle Regenerationsstate 1 -> regeneriert" VALUE 0xE77B4 Kw_Ws16 300.0000 mSoot_g 0.00 300.0000 FORMAT "%8.4" EXTENDED_LIMITS -327.6800 327.6700 /end CHARACTERISTIC
/begin CHARACTERISTIC PFlt_mSotRng1Rng2_C "Schwelle Regenerationsstate 1 -> Regenerationsstate 2" VALUE 0xE77B6 Kw_Ws16 300.0000 mSoot_g 0.00 300.0000 FORMAT "%8.4" EXTENDED_LIMITS -327.6800 327.6700 /end CHARACTERISTIC
/begin CHARACTERISTIC PFlt_mSotRng2Rng1_C "Schwelle Regenerationsstate 2 -> Regenerationsstate 1" VALUE 0xE77B8 Kw_Ws16 300.0000 mSoot_g 0.00 300.0000 FORMAT "%8.4" EXTENDED_LIMITS -327.6800 327.6700 /end CHARACTERISTIC
/begin CHARACTERISTIC PFlt_mSotRng2Rng3_C "Schwelle Regenerationstate 2 -> 3" VALUE 0xE77BA Kw_Ws16 300.0000 mSoot_g 0.00 300.0000 FORMAT "%8.4" EXTENDED_LIMITS -327.6800 327.6700 /end CHARACTERISTIC
/begin CHARACTERISTIC PFlt_mSotRng3Rng2_C "Schwelle Regenerationsstate 3 -> 2" VALUE 0xE77BC Kw_Ws16 300.0000 mSoot_g 0.00 300.0000 FORMAT "%8.4" EXTENDED_LIMITS -327.6800 327.6700 /end CHARACTERISTIC
/begin CHARACTERISTIC PFlt_mSotRng3Rng4_C "Schwelle Regeneratiosstate 3 -> 4" VALUE 0xE77BE Kw_Ws16 300.0000 mSoot_g 0.00 300.0000 FORMAT "%8.4" EXTENDED_LIMITS -327.6800 327.6700 /end CHARACTERISTIC
/begin CHARACTERISTIC PFlt_mSotRng4Rng3_C "Schwelle Regenerationsstate 4 -> 3" VALUE 0xE77C0 Kw_Ws16 300.0000 mSoot_g 0.00 300.0000 FORMAT "%8.4" EXTENDED_LIMITS -327.6800 327.6700 /end CHARACTERISTIC
/begin CHARACTERISTIC PFlt_mSotRng4Rng5_C "Schwelle Regenerationsstate 4 -> 5" VALUE 0xE77C2 Kw_Ws16 300.0000 mSoot_g 0.00 300.0000 FORMAT "%8.4" EXTENDED_LIMITS -327.6800 327.6700 /end CHARACTERISTIC
/begin CHARACTERISTIC PFlt_mSotRng5Rng4_C "Schwelle Regeneratiosstate 5 -> 4" VALUE 0xE77C4 Kw_Ws16 300.0000 mSoot_g 0.00 300.0000 FORMAT "%8.4" EXTENDED_LIMITS -327.6800 327.6700 /end CHARACTERISTIC
/begin CHARACTERISTIC PFlt_nAvrgFltAshCorMax_C "maximal zulässiger Wert Drehzahl" VALUE 0xE7730 Kw_Ws16 6000.000 EngN 0.00 6000.000 FORMAT "%8.3" EXTENDED_LIMITS -32768.00 32767.00 /end CHARACTERISTIC
/begin CHARACTERISTIC PFlt_nAvrgFltAshCorMin_C "minimal zulässiger Wert Drehzahl" VALUE 0xE7732 Kw_Ws16 6000.000 EngN 0.00 6000.000 FORMAT "%8.3" EXTENDED_LIMITS -32768.00 32767.00 /end CHARACTERISTIC
/begin CHARACTERISTIC PFlt_nDiagLowIdle1_C "Leerlaufdrehzahl im Regenerationszustand" VALUE 0xE7AB8 Kw_Ws16 5000.000 EngN 0.00 5000.000 FORMAT "%8.3" EXTENDED_LIMITS -32768.00 32767.00 /end CHARACTERISTIC
/begin CHARACTERISTIC PFlt_nDiagLowIdle2_C "Leerlaufdrehzahl in der Abkühlphase" VALUE 0xE7ABA Kw_Ws16 5000.000 EngN 0.00 5000.000 FORMAT "%8.3" EXTENDED_LIMITS -32768.00 32767.00 /end CHARACTERISTIC
/begin CHARACTERISTIC PFlt_nDiagLowIdle_C "Leerlaufdrehzahl im Heizzustand" VALUE 0xE7ABC Kw_Ws16 5000.000 EngN 0.00 5000.000 FORMAT "%8.3" EXTENDED_LIMITS -32768.00 32767.00 /end CHARACTERISTIC
/begin CHARACTERISTIC PFlt_nDiagMax_C "obere Motordrehzahlgrenze" VALUE 0xE7ABE Kw_Ws16 5000.000 EngN 0.00 5000.000 FORMAT "%8.3" EXTENDED_LIMITS -32768.00 32767.00 /end CHARACTERISTIC
/begin CHARACTERISTIC PFlt_nDiagMin_C "untere Motordrehzahlgrenze" VALUE 0xE7AC0 Kw_Ws16 5000.000 EngN 0.00 5000.000 FORMAT "%8.3" EXTENDED_LIMITS -32768.00 32767.00 /end CHARACTERISTIC
/begin CHARACTERISTIC PFlt_nDiagRgnMax_C "obere Motordrehzahlgrenze" VALUE 0xE7AC2 Kw_Ws16 5000.000 EngN 0.00 5000.000 FORMAT "%8.3" EXTENDED_LIMITS -32768.00 32767.00 /end CHARACTERISTIC
/begin CHARACTERISTIC PFlt_nDiagRgnMin_C "untere Motordrehzahlgrenze" VALUE 0xE7AC4 Kw_Ws16 5000.000 EngN 0.00 5000.000 FORMAT "%8.3" EXTENDED_LIMITS -32768.00 32767.00 /end CHARACTERISTIC
/begin CHARACTERISTIC PFlt_numAshCorMsk_C "Maske für gültige AshCor Regeneration, Eingang ist der Status PFlt_stEngPOp" VALUE 0xE7734 Kw_Wu16 65535.00 OneToOne 0.00 65535.00 FORMAT "%8.2" /end CHARACTERISTIC
/begin CHARACTERISTIC PFlt_numAshCor_C "AshCor-Schalterwert" VALUE 0xE7736 Kw_Wu8 11.00 OneToOne 0.00 11.00 FORMAT "%5.2" EXTENDED_LIMITS 0.00 255.0 /end CHARACTERISTIC
/begin CHARACTERISTIC PFlt_numEngPOpDel_CA "verzögert wirksame Matrix zur Berücksichtigung des Motorbetriebszustandes bei der Regeneration" MAP 0xE77C6 Kf_Xu8_Yu8_Wu8 6.000 OneToOne 0.00 6.000 FORMAT "%5.3" EXTENDED_LIMITS 0.00 255.0
 /begin AXIS_DESCR STD_AXIS PFlt_stEngPOp OneToOne 12 0.00 11.00 FORMAT "%5.2" EXTENDED_LIMITS 0.00 255.0 DEPOSIT ABSOLUTE /end AXIS_DESCR
 /begin AXIS_DESCR STD_AXIS PFlt_numRgn_mp OneToOne 7 0.00 6.000 FORMAT "%5.3" EXTENDED_LIMITS 0.00 255.0 DEPOSIT ABSOLUTE /end AXIS_DESCR
/end CHARACTERISTIC
/begin CHARACTERISTIC PFlt_numEngPOp_CA "Partikelfilterstatus vs. Motorstatus Matrix" MAP 0xE782F Kf_Xu8_Yu8_Wu8 6.000 OneToOne 0.00 6.000 FORMAT "%5.3" EXTENDED_LIMITS 0.00 255.0
 /begin AXIS_DESCR STD_AXIS PFlt_stEngPOp OneToOne 12 0.00 11.00 FORMAT "%5.2" EXTENDED_LIMITS 0.00 255.0 DEPOSIT ABSOLUTE /end AXIS_DESCR
 /begin AXIS_DESCR STD_AXIS PFlt_numRgn_mp OneToOne 7 0.00 6.000 FORMAT "%5.3" EXTENDED_LIMITS 0.00 255.0 DEPOSIT ABSOLUTE /end AXIS_DESCR
/end CHARACTERISTIC
/begin CHARACTERISTIC PFlt_numLst_C "Regenerationsanforderung aufgrund von gefahrener Strecke, Betriebszeit oder Verbrauch" VALUE 0xE7898 Kw_Wu8 255.0 OneToOne 0.00 255.0 FORMAT "%5.1" /end CHARACTERISTIC
/begin CHARACTERISTIC PFlt_numPrioRgnStg1_C "Priorität für Regenerationstate 1" VALUE 0xE789A Kw_Wu16 65535.00 OneToOne 0.00 65535.00 FORMAT "%8.2" /end CHARACTERISTIC
/begin CHARACTERISTIC PFlt_numPrioRgnStg2_C "Priorität für Regenerationstate 2" VALUE 0xE789C Kw_Wu16 65535.00 OneToOne 0.00 65535.00 FORMAT "%8.2" /end CHARACTERISTIC
/begin CHARACTERISTIC PFlt_numPrioRgnStg3_C "Priorität für Regenerationstate 3" VALUE 0xE789E Kw_Wu16 65535.00 OneToOne 0.00 65535.00 FORMAT "%8.2" /end CHARACTERISTIC
/begin CHARACTERISTIC PFlt_numPrioRgnStg4_C "Priorität für Regenerationstate 4" VALUE 0xE78A0 Kw_Wu16 65535.00 OneToOne 0.00 65535.00 FORMAT "%8.2" /end CHARACTERISTIC
/begin CHARACTERISTIC PFlt_numPrioRgnStg5_C "Priorität für Regenerationstate 5" VALUE 0xE78A2 Kw_Wu16 65535.00 OneToOne 0.00 65535.00 FORMAT "%8.2" /end CHARACTERISTIC
/begin CHARACTERISTIC PFlt_numPrioRgnStg6_C "Prioritätszahl für Regenerationsstufe 6" VALUE 0xE78A4 Kw_Wu16 65535.00 OneToOne 0.00 65535.00 FORMAT "%8.2" /end CHARACTERISTIC
/begin CHARACTERISTIC PFlt_numPrioRgnStgDiag_C "Regeneration priority of requested state when PFlt tester demand is active" VALUE 0xE78A6 Kw_Wu16 65535.00 OneToOne 0.00 65535.00 FORMAT "%8.2" /end CHARACTERISTIC
/begin CHARACTERISTIC PFlt_numPrt_C "Regenerationsanforderung aufgrund v. Motorschutz" VALUE 0xE78A8 Kw_Wu8 255.0 OneToOne 0.00 255.0 FORMAT "%5.1" /end CHARACTERISTIC
/begin CHARACTERISTIC PFlt_numRgnSuc_C "größte Regenerationsanforderungszahl ab der eine erfolgreiche Regeneration detektiert wird" VALUE 0xE78A9 Kw_Wu8 100.0 OneToOne 0.00 100.0 FORMAT "%5.1" EXTENDED_LIMITS 0.00 255.0 /end CHARACTERISTIC
/begin CHARACTERISTIC PFlt_pAPSDiag_C "Atmosphärendruckgrenze" VALUE 0xE7AC6 Kw_Ws16 3850.000 Pres_hPa -350.0000 3500.000 FORMAT "%8.3" EXTENDED_LIMITS -32768.00 32767.00 /end CHARACTERISTIC
/begin CHARACTERISTIC PFlt_pDiagBPSMax_C "obere Grenze des linearisierten Wertes vom Ladedruck" VALUE 0xE7AC8 Kw_Ws16 3500.000 Pres_hPa 0.00 3500.000 FORMAT "%8.3" EXTENDED_LIMITS -32768.00 32767.00 /end CHARACTERISTIC
/begin CHARACTERISTIC PFlt_pDiagBPSMin_C "untere Grenze des linearisierten Wertes vom Ladedruck" VALUE 0xE7ACA Kw_Ws16 3500.000 Pres_hPa 0.00 3500.000 FORMAT "%8.3" EXTENDED_LIMITS -32768.00 32767.00 /end CHARACTERISTIC
/begin CHARACTERISTIC PFlt_pEngPrtMaxInit_C "Inititialisierungswert des PT1-Filters für den Maximalwert im Motorschutz" VALUE 0xE78AA Kw_Ws16 32767.00 Pres_hPa 0.00 32767.00 FORMAT "%8.2" EXTENDED_LIMITS -32768.00 32767.00 /end CHARACTERISTIC
/begin CHARACTERISTIC PFlt_pEngPrtMax_MAP "Kennfeld obere Druckschwelle Motorschutz" MAP 0xE78AC Kf_Xs16_Ys16_Ws16 3500.000 Pres_hPa 0.00 3500.000 FORMAT "%8.3" EXTENDED_LIMITS -32768.00 32767.00
 /begin AXIS_DESCR STD_AXIS Eng_nAvrg EngN 8 40.00000 6000.000 FORMAT "%8.3" EXTENDED_LIMITS -32768.00 32767.00 DEPOSIT ABSOLUTE /end AXIS_DESCR
 /begin AXIS_DESCR STD_AXIS InjCtl_qSetUnBal InjMassCyc 8 0.00 327.6700 FORMAT "%8.4" EXTENDED_LIMITS -327.6800 327.6700 DEPOSIT ABSOLUTE /end AXIS_DESCR
/end CHARACTERISTIC
/begin CHARACTERISTIC PFlt_pEngPrtMin_MAP "untere Druckschwelle Motorschutz" MAP 0xE7950 Kf_Xs16_Ys16_Ws16 3500.000 Pres_hPa 0.00 3500.000 FORMAT "%8.3" EXTENDED_LIMITS -32768.00 32767.00
 /begin AXIS_DESCR STD_AXIS Eng_nAvrg EngN 8 40.00000 6000.000 FORMAT "%8.3" EXTENDED_LIMITS -32768.00 32767.00 DEPOSIT ABSOLUTE /end AXIS_DESCR
 /begin AXIS_DESCR STD_AXIS InjCtl_qSetUnBal InjMassCyc 8 0.00 327.6700 FORMAT "%8.4" EXTENDED_LIMITS -327.6800 327.6700 DEPOSIT ABSOLUTE /end AXIS_DESCR
/end CHARACTERISTIC
/begin CHARACTERISTIC PFlt_qDiagPOpMax_CUR "Kennlinie zur Überprüfung der Maximalgrenze von InjCtl_qSetUnbal" CURVE 0xE7ACC Kl_Xs16_Ws16 327.6700 InjMassCyc 0.00 327.6700 FORMAT "%8.4" EXTENDED_LIMITS -327.6800 327.6700
 /begin AXIS_DESCR STD_AXIS Eng_nAvrg EngN 8 40.00000 6000.000 FORMAT "%8.3" EXTENDED_LIMITS -32768.00 32767.00 DEPOSIT ABSOLUTE /end AXIS_DESCR
/end CHARACTERISTIC
/begin CHARACTERISTIC PFlt_qDiagPOpMin_CUR "Kennlinie zur Überprüfung der Minimalgrenze von InjCtl_qSetUnbal" CURVE 0xE7AEE Kl_Xs16_Ws16 327.6700 InjMassCyc 0.00 327.6700 FORMAT "%8.4" EXTENDED_LIMITS -327.6800 327.6700
 /begin AXIS_DESCR STD_AXIS Eng_nAvrg EngN 8 40.00000 6000.000 FORMAT "%8.3" EXTENDED_LIMITS -32768.00 32767.00 DEPOSIT ABSOLUTE /end AXIS_DESCR
/end CHARACTERISTIC
/begin CHARACTERISTIC PFlt_qFlMaxDef_C "Regenerationsschwelle für Treibstoffverbrauch im Fehlerfall" VALUE 0xE79F4 Kw_Ws16 320.0000 Fl_L 0.00 320.0000 FORMAT "%8.4" EXTENDED_LIMITS -327.6800 327.6700 /end CHARACTERISTIC
/begin CHARACTERISTIC PFlt_qFlMax_C "Regenerationsschwelle für Treibstoffverbrauch" VALUE 0xE79F6 Kw_Ws16 320.0000 Fl_L 0.00 320.0000 FORMAT "%8.4" EXTENDED_LIMITS -327.6800 327.6700 /end CHARACTERISTIC
/begin CHARACTERISTIC PFlt_qFlSubs_C "Treibstoffverbrauch Ersatzwert für den Fall eines Eeprom lese Fehlers" VALUE 0xE79F8 Kw_Ws16 320.0000 Fl_L 0.00 320.0000 FORMAT "%8.4" EXTENDED_LIMITS -327.6800 327.6700 /end CHARACTERISTIC
/begin CHARACTERISTIC PFlt_qFlTotAdjMax_C "Maximalwert des gesamten Kraftstoffverbrauchs" VALUE 0xE79FC Kw_Ws32 42949672.9500 Fl_L -21474836.4800 21474836.4700 FORMAT "%13.4" /end CHARACTERISTIC
/begin CHARACTERISTIC PFlt_qFlTotMin_C "Unterere Grenze für Gesamtmenge Kraftstoffquantität" VALUE 0xE7738 Kw_Ws16 320.0000 Fl_2 0.00 320.0000 FORMAT "%8.4" EXTENDED_LIMITS -327680.0 327670.0 /end CHARACTERISTIC
/begin CHARACTERISTIC PFlt_qSetUnBalFltAshCorMax_C "maximal zulässiger Wert aktuelle Einspritzmenge" VALUE 0xE773A Kw_Ws16 327.6700 InjMassCyc 0.00 327.6700 FORMAT "%8.4" EXTENDED_LIMITS -327.6800 327.6700 /end CHARACTERISTIC
/begin CHARACTERISTIC PFlt_qSetUnBalFltAshCorMin_C "minimal zulässiger Wert aktuelle Einspritzmenge" VALUE 0xE773C Kw_Ws16 327.6700 InjMassCyc 0.00 327.6700 FORMAT "%8.4" EXTENDED_LIMITS -327.6800 327.6700 /end CHARACTERISTIC
/begin CHARACTERISTIC PFlt_rDiagAccPedMax_C "obere Grenze Fahrpedalstellung" VALUE 0xE7B10 Kw_Ws16 100.0000 Prc 0.00 100.0000 FORMAT "%8.4" EXTENDED_LIMITS -400.0000 399.9878 /end CHARACTERISTIC
/begin CHARACTERISTIC PFlt_rDiagTVAMax_C "obere Grenze des durch die Batteriespannung korrigierten Endstufenausgangs" VALUE 0xE7B12 Kw_Ws16 100.0000 DtyCyc 0.00 100.0000 FORMAT "%8.4" EXTENDED_LIMITS -327.6800 327.6700 /end CHARACTERISTIC
/begin CHARACTERISTIC PFlt_rDiagTVAMin_C "untere Grenze des durch die Batteriespannung korrigierten Endstufenausgangs" VALUE 0xE7B14 Kw_Ws16 100.0000 DtyCyc 0.00 100.0000 FORMAT "%8.4" EXTENDED_LIMITS -327.6800 327.6700 /end CHARACTERISTIC
/begin CHARACTERISTIC PFlt_stDiagAbortMsk_C "Abbruchsmaske" VALUE 0xE7B18 Kw_Wu32 4294967295.00 OneToOne 0.00 4294967295.00 FORMAT "%13.2" /end CHARACTERISTIC
/begin CHARACTERISTIC PFlt_stDiagMskRgnAbort_C "Abbruchsmaske für Freigabebedingungen" VALUE 0xE7B1C Kw_Wu32 4294967295.00 OneToOne 0.00 4294967295.00 FORMAT "%13.2" /end CHARACTERISTIC
/begin CHARACTERISTIC PFlt_stDiagMskTst10_C "Abkühltrigger" VALUE 0xE7B20 Kw_Wu32 4294967295.00 OneToOne 0.00 4294967295.00 FORMAT "%13.2" /end CHARACTERISTIC
/begin CHARACTERISTIC PFlt_stDiagMskTst1_C "Maske zur Ermittlung der Zustandsinformation" VALUE 0xE7B24 Kw_Wu32 4294967295.00 OneToOne 0.00 4294967295.00 FORMAT "%13.2" /end CHARACTERISTIC
/begin CHARACTERISTIC PFlt_stDiagMskTst2_C "Maske zur Ermittlung der Zustandsinformation" VALUE 0xE7B28 Kw_Wu32 4294967295.00 OneToOne 0.00 4294967295.00 FORMAT "%13.2" /end CHARACTERISTIC
/begin CHARACTERISTIC PFlt_stDiagMskTst3_C "Maske zur Ermittlung der Zustandsinformation" VALUE 0xE7B2C Kw_Wu32 4294967295.00 OneToOne 0.00 4294967295.00 FORMAT "%13.2" /end CHARACTERISTIC
/begin CHARACTERISTIC PFlt_stDiagMskTst4_C "Maske zur Ermittlung der Zustandsinformation" VALUE 0xE7B30 Kw_Wu32 4294967295.00 OneToOne 0.00 4294967295.00 FORMAT "%13.2" /end CHARACTERISTIC
/begin CHARACTERISTIC PFlt_stDiagMskTst5_C "Maske zur Ermittlung der Zustandsinformation" VALUE 0xE7B34 Kw_Wu32 4294967295.00 OneToOne 0.00 4294967295.00 FORMAT "%13.2" /end CHARACTERISTIC
/begin CHARACTERISTIC PFlt_stDiagMskTst6_C "Maske zur Ermittlung der Zustandsinformation" VALUE 0xE7B38 Kw_Wu32 4294967295.00 OneToOne 0.00 4294967295.00 FORMAT "%13.2" /end CHARACTERISTIC
/begin CHARACTERISTIC PFlt_stDiagMskTst7_C "Maske zur Ermittlung der Zustandsinformation" VALUE 0xE7B3C Kw_Wu32 4294967295.00 OneToOne 0.00 4294967295.00 FORMAT "%13.2" /end CHARACTERISTIC
/begin CHARACTERISTIC PFlt_stDiagMskTst8_C "Maske zur Ermittlung der Zustandsinformation" VALUE 0xE7B40 Kw_Wu32 4294967295.00 OneToOne 0.00 4294967295.00 FORMAT "%13.2" /end CHARACTERISTIC
/begin CHARACTERISTIC PFlt_stDiagMskTst9_C "Maske zur Ermittlung der Zustandsinformation" VALUE 0xE7B44 Kw_Wu32 4294967295.00 OneToOne 0.00 4294967295.00 FORMAT "%13.2" /end CHARACTERISTIC
/begin CHARACTERISTIC PFlt_stDiagMsk_C "Maske für Freigabebedingungen" VALUE 0xE7B48 Kw_Wu32 4294967295.00 OneToOne 0.00 4294967295.00 FORMAT "%13.2" /end CHARACTERISTIC
/begin CHARACTERISTIC PFlt_stDiagOn_C "Applikation konstant Regeneration manuell beginnen" VALUE 0xE7A00 Kw_Wu8 255.0 OneToOne 0.00 255.0 FORMAT "%5.1" /end CHARACTERISTIC
/begin CHARACTERISTIC PFlt_stDiagRgnMsk_C "Regenerationsmaske zum Abschalten der Diagnose" VALUE 0xE7B4C Kw_Wu32 4294967295.00 OneToOne 0.00 4294967295.00 FORMAT "%13.2" /end CHARACTERISTIC
/begin CHARACTERISTIC PFlt_stLckFuelMsk_C "Maske Für EGT_st" VALUE 0xE7A02 Kw_Wu16 65535.00 OneToOne 0.00 65535.00 FORMAT "%8.2" /end CHARACTERISTIC
/begin CHARACTERISTIC PFlt_stLckRgnMsk_C "Maske für Blockierung und Freigabe der Regeneration" VALUE 0xE7A04 Kw_Wu32 4294967295.00 OneToOne 0.00 4294967295.00 FORMAT "%13.2" /end CHARACTERISTIC
/begin CHARACTERISTIC PFlt_stRgnActvMsk_C "Maske für DPF-Regenerationszeit-relevante Abgasnachbehandlungszustände" VALUE 0xE7A08 Kw_Wu32 4294967295.00 OneToOne 0.00 4294967295.00 FORMAT "%13.2" /end CHARACTERISTIC
/begin CHARACTERISTIC PFlt_stRgnDiagStg1_C "Aufheizzustand" VALUE 0xE7B50 Kw_Wu32 4294967295.00 OneToOne 0.00 4294967295.00 FORMAT "%13.2" /end CHARACTERISTIC
/begin CHARACTERISTIC PFlt_stRgnDiagStg2_C "Regenerationszustand" VALUE 0xE7B54 Kw_Wu32 4294967295.00 OneToOne 0.00 4294967295.00 FORMAT "%13.2" /end CHARACTERISTIC
/begin CHARACTERISTIC PFlt_stRgnDiagStg3_C "Abkühlphase" VALUE 0xE7B58 Kw_Wu32 4294967295.00 OneToOne 0.00 4294967295.00 FORMAT "%13.2" /end CHARACTERISTIC
/begin CHARACTERISTIC PFlt_stRgnStg1_C "PFlt_st im Fall Regenerationsstate 1" VALUE 0xE7A0C Kw_Wu32 4294967295.00 OneToOne 0.00 4294967295.00 FORMAT "%13.2" /end CHARACTERISTIC
/begin CHARACTERISTIC PFlt_stRgnStg2_C "PFlt_st im Fall Regenerationsstate 2" VALUE 0xE7A10 Kw_Wu32 4294967295.00 OneToOne 0.00 4294967295.00 FORMAT "%13.2" /end CHARACTERISTIC
/begin CHARACTERISTIC PFlt_stRgnStg3_C "PFlt_st im Fall Regenerationsstate 3" VALUE 0xE7A14 Kw_Wu32 4294967295.00 OneToOne 0.00 4294967295.00 FORMAT "%13.2" /end CHARACTERISTIC
/begin CHARACTERISTIC PFlt_stRgnStg4_C "PFlt_st im Fall Regenerationsstate 4" VALUE 0xE7A18 Kw_Wu32 4294967295.00 OneToOne 0.00 4294967295.00 FORMAT "%13.2" /end CHARACTERISTIC
/begin CHARACTERISTIC PFlt_stRgnStg5_C "PFlt_st im Fall Regenerationsstate 5" VALUE 0xE7A1C Kw_Wu32 4294967295.00 OneToOne 0.00 4294967295.00 FORMAT "%13.2" /end CHARACTERISTIC
/begin CHARACTERISTIC PFlt_stRgnStg6_C "Maßnahmenbitwort Regenerationsstufe 6" VALUE 0xE7A20 Kw_Wu32 4294967295.00 OneToOne 0.00 4294967295.00 FORMAT "%13.2" /end CHARACTERISTIC
/begin CHARACTERISTIC PFlt_st_Vector "#SSD Konfigurationslabel für Bypass" VALUE 0xC2E06 Kw_Wu8 255.0 OneToOne 0.00 255.0 FORMAT "%5.1" /end CHARACTERISTIC
/begin CHARACTERISTIC PFlt_st_Channel "#SSD Konfigurationslabels für Bypass" VALUE 0xC2E07 Kw_Wu8 255.0 OneToOne 0.00 255.0 FORMAT "%5.1" /end CHARACTERISTIC
/begin CHARACTERISTIC PFlt_swtAshCorActive_C "generelle Aktivierung der Ascheabgleich-Funktion (True=Funktion aktiv)" VALUE 0xE773E Kw_Wu8 1.000 OneToOne 0.00 1.000 FORMAT "%5.3" EXTENDED_LIMITS 0.00 255.0 /end CHARACTERISTIC
/begin CHARACTERISTIC PFlt_swtAshCorOn_C "Statusschwelle Aschekorrektur" VALUE 0xE773F Kw_Wu8 4.000 OneToOne 0.00 4.000 FORMAT "%5.3" EXTENDED_LIMITS 0.00 255.0 /end CHARACTERISTIC
/begin CHARACTERISTIC PFlt_swtDiagOn_C "Schalten Regeneration manuell beginnen" VALUE 0xE7A24 Kw_Wu8 255.0 OneToOne 0.00 255.0 FORMAT "%5.1" /end CHARACTERISTIC
/begin CHARACTERISTIC PFlt_swtOfsCor_C "Schalter zur Abschaltung der Offsetkorrektur im Zustandautomat" VALUE 0xE7A25 Kw_Wu8 1.000 OneToOne 0.00 1.000 FORMAT "%5.3" EXTENDED_LIMITS 0.00 255.0 /end CHARACTERISTIC
/begin CHARACTERISTIC PFlt_swtServiceVal_C "Serviceschalter zum Zurücksetzen nach Partikelfilteraustausch" VALUE 0xE7A26 Kw_Wu8 255.0 OneToOne 0.00 255.0 FORMAT "%5.1" /end CHARACTERISTIC
/begin CHARACTERISTIC PFlt_swtTmrLckRst_C "Schalter zum Rücksetzen des EEPROM Wertes der Sperrzeit" VALUE 0xE7A27 Kw_Wu8 255.0 OneToOne 0.00 255.0 FORMAT "%5.1" /end CHARACTERISTIC
/begin CHARACTERISTIC PFlt_tAirFltAshCorMax_C "maximal zulässiger Wert Lufttemperatur" VALUE 0xE7740 Kw_Ws16 250.0000 Temp_Cels -50.14000 199.8600 FORMAT "%8.4" EXTENDED_LIMITS -3549.940 3003.560 /end CHARACTERISTIC
/begin CHARACTERISTIC PFlt_tAirFltAshCorMin_C "minimal zulässiger Wert Lufttemperatur" VALUE 0xE7742 Kw_Ws16 250.0000 Temp_Cels -50.14000 199.8600 FORMAT "%8.4" EXTENDED_LIMITS -3549.940 3003.560 /end CHARACTERISTIC
/begin CHARACTERISTIC PFlt_tCIntAshCorMax_C "maximal zulässiger Wert Kühlmitteltemperatur" VALUE 0xE7744 Kw_Ws16 250.0000 Temp_Cels -50.14000 199.8600 FORMAT "%8.4" EXTENDED_LIMITS -3549.940 3003.560 /end CHARACTERISTIC
/begin CHARACTERISTIC PFlt_tCIntAshCorMin_C "minimal zulässiger Wert Kühlmitteltemperatur" VALUE 0xE7746 Kw_Ws16 250.0000 Temp_Cels -50.14000 199.8600 FORMAT "%8.4" EXTENDED_LIMITS -3549.940 3003.560 /end CHARACTERISTIC
/begin CHARACTERISTIC PFlt_tDiagDpfAbrtMax_C "Grenze PFltCD_tPre" VALUE 0xE7B5C Kw_Ws16 950.0000 Temp_Cels -50.1400 899.8600 FORMAT "%8.4" EXTENDED_LIMITS -3549.940 3003.560 /end CHARACTERISTIC
/begin CHARACTERISTIC PFlt_tDiagDpfCoolDwn_C "Grenze PFltCD_tPre" VALUE 0xE7B5E Kw_Ws16 950.0000 Temp_Cels -50.1400 899.8600 FORMAT "%8.4" EXTENDED_LIMITS -3549.940 3003.560 /end CHARACTERISTIC
/begin CHARACTERISTIC PFlt_tDiagDpfHeatup_C "Grenze PFltCD_tPre" VALUE 0xE7B60 Kw_Ws16 950.0000 Temp_Cels -50.1400 899.8600 FORMAT "%8.4" EXTENDED_LIMITS -3549.940 3003.560 /end CHARACTERISTIC
/begin CHARACTERISTIC PFlt_tDiagDpfMax_C "Grenze PFltCD_tPre" VALUE 0xE7B62 Kw_Ws16 950.0000 Temp_Cels -50.1400 899.8600 FORMAT "%8.4" EXTENDED_LIMITS -3549.940 3003.560 /end CHARACTERISTIC
/begin CHARACTERISTIC PFlt_tDiagDpfPreRgnMin_C "Grenze PFltCD_tPre" VALUE 0xE7B64 Kw_Ws16 950.0000 Temp_Cels -50.1400 899.8600 FORMAT "%8.4" EXTENDED_LIMITS -3549.940 3003.560 /end CHARACTERISTIC
/begin CHARACTERISTIC PFlt_tDiagOxiAbrtMax_C "Grenze OxiCCD_tPre" VALUE 0xE7B66 Kw_Ws16 950.0000 Temp_Cels -50.1400 899.8600 FORMAT "%8.4" EXTENDED_LIMITS -3549.940 3003.560 /end CHARACTERISTIC
/begin CHARACTERISTIC PFlt_tDiagOxiCoolDwn_C "Grenze OxiCCD_tPre" VALUE 0xE7B68 Kw_Ws16 950.0000 Temp_Cels -50.1400 899.8600 FORMAT "%8.4" EXTENDED_LIMITS -3549.940 3003.560 /end CHARACTERISTIC
/begin CHARACTERISTIC PFlt_tDiagOxiHeatup_C "Grenze OxiCCD_tPre" VALUE 0xE7B6A Kw_Ws16 950.0000 Temp_Cels -50.1400 899.8600 FORMAT "%8.4" EXTENDED_LIMITS -3549.940 3003.560 /end CHARACTERISTIC
/begin CHARACTERISTIC PFlt_tDiagOxiMax_C "obere Abgastemperaturgrenze vor dem Oxidationskatalysator) - aktueller Wert" VALUE 0xE7B6C Kw_Ws16 950.0000 Temp_Cels -50.1400 899.8600 FORMAT "%8.4" EXTENDED_LIMITS -3549.940 3003.560 /end CHARACTERISTIC
/begin CHARACTERISTIC PFlt_tDiagOxiMin_C "untere Abgastemperaturgrenze vor dem Oxidationskatalysator) - aktueller Wert" VALUE 0xE7B6E Kw_Ws16 950.0000 Temp_Cels -50.1400 899.8600 FORMAT "%8.4" EXTENDED_LIMITS -3549.940 3003.560 /end CHARACTERISTIC
/begin CHARACTERISTIC PFlt_tDiagOxiPreMax_C "Grenze OxiCCD_tPre" VALUE 0xE7B70 Kw_Ws16 950.0000 Temp_Cels -50.1400 899.8600 FORMAT "%8.4" EXTENDED_LIMITS -3549.940 3003.560 /end CHARACTERISTIC
/begin CHARACTERISTIC PFlt_tDiagOxiPreRgnMin_C "Grenze OxiCCD_tPre" VALUE 0xE7B72 Kw_Ws16 950.0000 Temp_Cels -50.1400 899.8600 FORMAT "%8.4" EXTENDED_LIMITS -3549.940 3003.560 /end CHARACTERISTIC
/begin CHARACTERISTIC PFlt_tDiagPFltMax_C "obere Grenze des aktuellen Wertes der Partikelfiltervortemperatur" VALUE 0xE7B74 Kw_Ws16 950.0000 Temp_Cels -50.1400 899.8600 FORMAT "%8.4" EXTENDED_LIMITS -3549.940 3003.560 /end CHARACTERISTIC
/begin CHARACTERISTIC PFlt_tDiagPFltMin_C "untere Grenze des aktuellen Wertes der Partikelfiltervortemperatur" VALUE 0xE7B76 Kw_Ws16 950.0000 Temp_Cels -50.1400 899.8600 FORMAT "%8.4" EXTENDED_LIMITS -3549.940 3003.560 /end CHARACTERISTIC
/begin CHARACTERISTIC PFlt_tEngDiagMinH_C "obere Motortemperaturgrenze" VALUE 0xE7B78 Kw_Ws16 950.0000 Temp_Cels -50.1400 899.8600 FORMAT "%8.4" EXTENDED_LIMITS -3549.940 3003.560 /end CHARACTERISTIC
/begin CHARACTERISTIC PFlt_tEngDiagMinL_C "untere Motortemperaturgrenze" VALUE 0xE7B7A Kw_Ws16 950.0000 Temp_Cels -50.1400 899.8600 FORMAT "%8.4" EXTENDED_LIMITS -3549.940 3003.560 /end CHARACTERISTIC
/begin CHARACTERISTIC PFlt_tFltDiagMax_C "Grenze der Kraftstoffsystemtemperatur" VALUE 0xE7B7C Kw_Ws16 250.0000 Temp_Cels -50.14000 199.8600 FORMAT "%8.4" EXTENDED_LIMITS -3549.940 3003.560 /end CHARACTERISTIC
/begin CHARACTERISTIC PFlt_tiAshCorAirTempPT1_C "Zeitkonstante Lufttemperatur" VALUE 0xE7748 Kw_Wu32 4294.8273 TimeDelay_s 0.14000154 4294.9673 FORMAT "%9.4" EXTENDED_LIMITS 0.0000010000000 4294.9673 /end CHARACTERISTIC
/begin CHARACTERISTIC PFlt_tiAshCorCIntTempPT1_C "Zeitkonstante Kühlmitteltemperatur" VALUE 0xE774C Kw_Wu32 4294.8273 TimeDelay_s 0.14000154 4294.9673 FORMAT "%9.4" EXTENDED_LIMITS 0.0000010000000 4294.9673 /end CHARACTERISTIC
/begin CHARACTERISTIC PFlt_tiAshCorDVolPT1_C "Zeitkonstante Abgasvolumenstrom vor PFlt" VALUE 0xE7750 Kw_Wu32 4294.8273 TimeDelay_s 0.14000154 4294.9673 FORMAT "%9.4" EXTENDED_LIMITS 0.0000010000000 4294.9673 /end CHARACTERISTIC
/begin CHARACTERISTIC PFlt_tiAshCorEngSpdPT1_C "Zeitkonstante Drehzahl" VALUE 0xE7754 Kw_Wu32 4294.8273 TimeDelay_s 0.14000154 4294.9673 FORMAT "%9.4" EXTENDED_LIMITS 0.0000010000000 4294.9673 /end CHARACTERISTIC
/begin CHARACTERISTIC PFlt_tiAshCorInjMsPT1_C "Zeitkonstante aktuelle Einspritzmasse" VALUE 0xE7758 Kw_Wu32 4294.8273 TimeDelay_s 0.14000154 4294.9673 FORMAT "%9.4" EXTENDED_LIMITS 0.0000010000000 4294.9673 /end CHARACTERISTIC
/begin CHARACTERISTIC PFlt_tiAshCorOxiTempPT1_C "Zeitkonstante OxiKat-Temperatur" VALUE 0xE775C Kw_Wu32 4294.8273 TimeDelay_s 0.14000154 4294.9673 FORMAT "%9.4" EXTENDED_LIMITS 0.0000010000000 4294.9673 /end CHARACTERISTIC
/begin CHARACTERISTIC PFlt_tiAshCorPreTempPT1_C "Zeitkonstante Vortemperatur Partikelfilter" VALUE 0xE7760 Kw_Wu32 4294.8273 TimeDelay_s 0.14000154 4294.9673 FORMAT "%9.4" EXTENDED_LIMITS 0.0000010000000 4294.9673 /end CHARACTERISTIC
/begin CHARACTERISTIC PFlt_tiAshCorResFlowPT1_C "Zeitkonstante gefilterter Stromwiderstand" VALUE 0xE7764 Kw_Wu32 4294.8273 TimeDelay_s 0.14000154 4294.9673 FORMAT "%9.4" EXTENDED_LIMITS 0.0000010000000 4294.9673 /end CHARACTERISTIC
/begin CHARACTERISTIC PFlt_tiAshCorRlsOn_C "Entprellzeit Simulation EIN" VALUE 0xE7768 Kw_Wu16 655140.0 Time_ms 0.00 655140.0 FORMAT "%8.1" EXTENDED_LIMITS 0.00 655350.0 /end CHARACTERISTIC
/begin CHARACTERISTIC PFlt_tiAshCorVehAccPT1_C "Zeitkonstante Fahrzeugbeschleunigung" VALUE 0xE776C Kw_Wu32 4294.8273 TimeDelay_s 0.14000154 4294.9673 FORMAT "%9.4" EXTENDED_LIMITS 0.0000010000000 4294.9673 /end CHARACTERISTIC
/begin CHARACTERISTIC PFlt_tiAshCorVehSpdPT1_C "Zeitkonstante Fahrzeuggeschwindigkeit" VALUE 0xE7770 Kw_Wu32 4294.8273 TimeDelay_s 0.14000154 4294.9673 FORMAT "%9.4" EXTENDED_LIMITS 0.0000010000000 4294.9673 /end CHARACTERISTIC
/begin CHARACTERISTIC PFlt_tiAshCorWaitMax_C "Regenerationsdauer" VALUE 0xE7774 Kw_Wu32 655140.000000 Time_s 0.00 655140.000000 FORMAT "%13.6" EXTENDED_LIMITS 0.00 42949672.9500 /end CHARACTERISTIC
/begin CHARACTERISTIC PFlt_tiDebLck_C "Entprellzeit für Timer der maximalen Regenerationszeit" VALUE 0xE7A28 Kw_Wu16 120.0000 TimeDeb 0.00 120.0000 FORMAT "%8.4" EXTENDED_LIMITS 0.00 655350.0 /end CHARACTERISTIC
/begin CHARACTERISTIC PFlt_tiDebQLimErrIntr_C "Entprellzeit für Regenerationsunterbrechung wegen Mengenbegrenzung" VALUE 0xE7A2A Kw_Wu16 655350.0 TimeDeb 0.00 655350.0 FORMAT "%8.1" /end CHARACTERISTIC
/begin CHARACTERISTIC PFlt_tiDebTrqOvhtIntr_C "Entprellzeit für Regenerationsunterbrechung wegen Überhitzungsschutz" VALUE 0xE7A2C Kw_Wu16 655350.0 TimeDeb 0.00 655350.0 FORMAT "%8.1" /end CHARACTERISTIC
/begin CHARACTERISTIC PFlt_tiDiagCoolDwnMax_C "Abkühl-Timergrenze" VALUE 0xE7B80 Kw_Wu32 655140.000000 Time_s 0.00 655140.000000 FORMAT "%13.6" EXTENDED_LIMITS 0.00 42949672.9500 /end CHARACTERISTIC
/begin CHARACTERISTIC PFlt_tiDiagDpfMax_C "Grenze PFltCD_tPre" VALUE 0xE7B84 Kw_Wu32 655140.000000 Time_s 0.00 655140.000000 FORMAT "%13.6" EXTENDED_LIMITS 0.00 42949672.9500 /end CHARACTERISTIC
/begin CHARACTERISTIC PFlt_tiDiagNormal_C "Motordauer normal" VALUE 0xE7B88 Kw_Wu32 655140.000000 Time_s 0.00 655140.000000 FORMAT "%13.6" EXTENDED_LIMITS 0.00 42949672.9500 /end CHARACTERISTIC
/begin CHARACTERISTIC PFlt_tiDiagOxiMax_C "Grenze OxiCCD_tPre" VALUE 0xE7B8C Kw_Wu32 655140.000000 Time_s 0.00 655140.000000 FORMAT "%13.6" EXTENDED_LIMITS 0.00 42949672.9500 /end CHARACTERISTIC
/begin CHARACTERISTIC PFlt_tiDiagRgnEnd_C "Regenerationsdauer" VALUE 0xE7B90 Kw_Wu32 655140.000000 Time_s 0.00 655140.000000 FORMAT "%13.6" EXTENDED_LIMITS 0.00 42949672.9500 /end CHARACTERISTIC
/begin CHARACTERISTIC PFlt_tiDiagRgnHeatup_C "Grenze des Zählers für die Abbruchbedingung" VALUE 0xE7B94 Kw_Wu32 655140.000000 Time_s 0.00 655140.000000 FORMAT "%13.6" EXTENDED_LIMITS 0.00 42949672.9500 /end CHARACTERISTIC
/begin CHARACTERISTIC PFlt_tiDiagRgnLidIMin_C "Dauer der Motordrehzahl innerhalb eines bestimmten Bereichs" VALUE 0xE7B98 Kw_Wu32 655140.000000 Time_s 0.00 655140.000000 FORMAT "%13.6" EXTENDED_LIMITS 0.00 42949672.9500 /end CHARACTERISTIC
/begin CHARACTERISTIC PFlt_tiEngOnMaxDef_C "maximale Motorbetriebszeit für Regeneration im Fehlerfall" VALUE 0xE7A30 Kw_Wu32 4294967295.00 TimeEngOn 0.00 4294967295.00 FORMAT "%13.2" /end CHARACTERISTIC
/begin CHARACTERISTIC PFlt_tiEngOnMax_C "maximale Motorbetriebszeit für Regeneration" VALUE 0xE7A34 Kw_Wu32 4294967295.00 TimeEngOn 0.00 4294967295.00 FORMAT "%13.2" /end CHARACTERISTIC
/begin CHARACTERISTIC PFlt_tiEngPrtPT1_C "Zeitkonstante des PT1-Gliedes für den Motorschutz" VALUE 0xE7A38 Kw_Wu32 4294.9673 TimeDelay_s 0.0000010000000 4294.9673 FORMAT "%9.4" /end CHARACTERISTIC
/begin CHARACTERISTIC PFlt_tiEngPrt_C "Regenerationsdauer aufgrund von Motorschutz" VALUE 0xE7A3C Kw_Wu32 21474836.4700 Time_s 0.00 21474836.4700 FORMAT "%13.4" EXTENDED_LIMITS 0.00 42949672.9500 /end CHARACTERISTIC
/begin CHARACTERISTIC PFlt_tiGetRgnSt_C "Timergrenze zur Erfassung des Regenerationszustands" VALUE 0xE7B9C Kw_Wu32 655140.000000 Time_s 0.00 655140.000000 FORMAT "%13.6" EXTENDED_LIMITS 0.00 42949672.9500 /end CHARACTERISTIC
/begin CHARACTERISTIC PFlt_tiLckRgnErr_CA "Sperrzeit  im Fehlerfall nach der maximalen Regenerationdauer erreicht wurden" VAL_BLK 0xE7A40 Kwb_Wu32 42949672.9500 Time_s 0.00 42949672.9500 FORMAT "%13.4" NUMBER 7 /end CHARACTERISTIC
/begin CHARACTERISTIC PFlt_tiLckRgn_CA "Sperrzeit  nach der maximalen Regenerationdauer erreicht wurden" VAL_BLK 0xE7A5C Kwb_Wu32 42949672.9500 Time_s 0.00 42949672.9500 FORMAT "%13.4" NUMBER 7 /end CHARACTERISTIC
/begin CHARACTERISTIC PFlt_tiLckSubs_C "Ersatzwert für Sperrzeit" VALUE 0xE7A78 Kw_Wu32 42949672.9500 Time_s 0.00 42949672.9500 FORMAT "%13.4" /end CHARACTERISTIC
/begin CHARACTERISTIC PFlt_tiLstRgn_C "Dauer der Regeneration aufgrund von gefahrener Strecke, Betriebszeit oder Treibstoffverbrauch" VALUE 0xE7A7C Kw_Wu32 21474836.4700 Time_s 0.00 21474836.4700 FORMAT "%13.4" EXTENDED_LIMITS 0.00 42949672.9500 /end CHARACTERISTIC
/begin CHARACTERISTIC PFlt_tiOpSubs_C "Ersatzwert für Motorbetriebszeit im Fall Eeprom lese Fehler" VALUE 0xE7A80 Kw_Wu32 4294967295.00 TimeEngOn 0.00 4294967295.00 FORMAT "%13.2" /end CHARACTERISTIC
/begin CHARACTERISTIC PFlt_tiRgnMax_CA "Array für Maximalwert Regenerationsdauer" VAL_BLK 0xE7A84 Kwb_Wu32 42949672.9500 Time_s 0.00 42949672.9500 FORMAT "%13.4" NUMBER 7 /end CHARACTERISTIC
/begin CHARACTERISTIC PFlt_tiRgnSpo_C "Regenerationszeit zur Detektierung einer spontanen Regeneration" VALUE 0xE7AA0 Kw_Wu16 655.3500 Time_s 0.00 655.3500 FORMAT "%8.4" /end CHARACTERISTIC
/begin CHARACTERISTIC PFlt_tiStpRgn_C "Timergrenze zur Beendigung der Regeneration" VALUE 0xE7BA0 Kw_Wu32 655140.000000 Time_s 0.00 655140.000000 FORMAT "%13.6" EXTENDED_LIMITS 0.00 42949672.9500 /end CHARACTERISTIC
/begin CHARACTERISTIC PFlt_tOilDiagMinH_C "obere Öltemperaturgrenze" VALUE 0xE7BA4 Kw_Ws16 950.0000 Temp_Cels -50.1400 899.8600 FORMAT "%8.4" EXTENDED_LIMITS -3549.940 3003.560 /end CHARACTERISTIC
/begin CHARACTERISTIC PFlt_tOilDiagMinL_C "untere Öltemperaturgrenze" VALUE 0xE7BA6 Kw_Ws16 950.0000 Temp_Cels -50.1400 899.8600 FORMAT "%8.4" EXTENDED_LIMITS -3549.940 3003.560 /end CHARACTERISTIC
/begin CHARACTERISTIC PFlt_tOxiPreFltAshCorMax_C "maximal zulässiger Wert Temperatur vor dem OxiKat" VALUE 0xE7778 Kw_Ws16 950.000 Temp_Cels -50.140 899.860 FORMAT "%8.3" EXTENDED_LIMITS -3549.940 3003.560 /end CHARACTERISTIC
/begin CHARACTERISTIC PFlt_tOxiPreFltAshCorMin_C "minimal zulässiger Wert Temperatur vor dem OxiKat" VALUE 0xE777A Kw_Ws16 950.000 Temp_Cels -50.140 899.860 FORMAT "%8.3" EXTENDED_LIMITS -3549.940 3003.560 /end CHARACTERISTIC
/begin CHARACTERISTIC PFlt_tOxiPreMaxHi_C "maximal erlaubter Wert für Temperatur vor Oxidationskatalysator (oberer Schwellenwert)" VALUE 0xE7AA2 Kw_Ws16 950.0000 Temp_Cels -50.1400 899.8600 FORMAT "%8.4" EXTENDED_LIMITS -3549.940 3003.560 /end CHARACTERISTIC
/begin CHARACTERISTIC PFlt_tOxiPreMaxLo_C "maximal erlaubter Wert für Temperatur vor Oxidationskatalysator (unterer Schwellenwert)" VALUE 0xE7AA4 Kw_Ws16 950.0000 Temp_Cels -50.1400 899.8600 FORMAT "%8.4" EXTENDED_LIMITS -3549.940 3003.560 /end CHARACTERISTIC
/begin CHARACTERISTIC PFlt_tPreFltAshCorMax_C "maximal zulässiger Wert Vortemperatur Partikelfilter" VALUE 0xE777C Kw_Ws16 950.000 Temp_Cels -50.140 899.860 FORMAT "%8.3" EXTENDED_LIMITS -3549.940 3003.560 /end CHARACTERISTIC
/begin CHARACTERISTIC PFlt_tPreFltAshCorMin_C "minimal zulässiger Wert Vortemperatur Partikelfilter" VALUE 0xE777E Kw_Ws16 950.000 Temp_Cels -50.140 899.860 FORMAT "%8.3" EXTENDED_LIMITS -3549.940 3003.560 /end CHARACTERISTIC
/begin CHARACTERISTIC PFlt_tPreMaxHi_C "maximal erlaubter Wert für Temperatur vor Partikelfilter (oberer Schwellenwert)" VALUE 0xE7AA6 Kw_Ws16 950.0000 Temp_Cels -50.1400 899.8600 FORMAT "%8.4" EXTENDED_LIMITS -3549.940 3003.560 /end CHARACTERISTIC
/begin CHARACTERISTIC PFlt_tPreMaxLo_C "maximal erlaubter Wert für Temperatur vor Partikelfilter (unterer Schwellenwert)" VALUE 0xE7AA8 Kw_Ws16 950.0000 Temp_Cels -50.1400 899.8600 FORMAT "%8.4" EXTENDED_LIMITS -3549.940 3003.560 /end CHARACTERISTIC
/begin CHARACTERISTIC PFlt_uDiagMin_C "Batteriespannungsgrenze" VALUE 0xE7BA8 Kw_Ws16 28602.15 Volt_Batt 0.00 28602.15 FORMAT "%8.2" EXTENDED_LIMITS -640625.6 640606.1 /end CHARACTERISTIC
/begin CHARACTERISTIC PFlt_volFlConsumSubs_C "Ersatzwert für insgesamt verbrauchten Kraftstoff" VALUE 0xE7AAA Kw_Wu16 65.50000 Fl_Vol 0.00 65.50000 FORMAT "%8.5" EXTENDED_LIMITS 0.00 65.53500 /end CHARACTERISTIC
/begin CHARACTERISTIC PFlt_volFuelFilMinHi_C "Obere Hystereseschwelle für Aufhebung der Sperre" VALUE 0xE7AAC Kw_Wu16 300.0000 Fl_Half_L 0.00 300.0000 FORMAT "%8.4" EXTENDED_LIMITS 0.00 3276.750 /end CHARACTERISTIC
/begin CHARACTERISTIC PFlt_volFuelFilMinLo_C "Untere Hystereseschwelle für Sperre der Regen." VALUE 0xE7AAE Kw_Wu16 300.0000 Fl_Half_L 0.00 300.0000 FORMAT "%8.4" EXTENDED_LIMITS 0.00 3276.750 /end CHARACTERISTIC
/begin CHARACTERISTIC PFlt_vVehFltAshCorMax_C "maximal zulässiger Wert Fahrzeuggeschwindigkeit" VALUE 0xE7780 Kw_Ws16 300.0000 Vel 0.00 300.0000 FORMAT "%8.4" EXTENDED_LIMITS -327.6800 327.6700 /end CHARACTERISTIC
/begin CHARACTERISTIC PFlt_vVehFltAshCorMin_C "minimal zulässiger Wert Fahrzeuggeschwindigkeit" VALUE 0xE7782 Kw_Ws16 300.0000 Vel 0.00 300.0000 FORMAT "%8.4" EXTENDED_LIMITS -327.6800 327.6700 /end CHARACTERISTIC
/begin MEASUREMENT PCR_DKd_mp "Kleinsignalverstärkung des Regler-DT1-Anteils" SLONG Kd_Pres2Prc 1 100 -400.000000000 399.999999814 FORMAT "%12.9" ECU_ADDRESS 0x8FF9C0 /end MEASUREMENT
/begin MEASUREMENT PCR_dn_mp "value of engine speed gradient" SWORD dn_dZ20 1 100 -327680.0 327670.0 FORMAT "%8.1" ECU_ADDRESS 0x8FF9C4 /end MEASUREMENT
/begin MEASUREMENT PCR_dpBGDev_mp "Ladedruckgradient" SWORD dp_dZ20 1 100 -327680.0 327670.0 FORMAT "%8.1" ECU_ADDRESS 0x8FF9C6 /end MEASUREMENT
/begin MEASUREMENT PCR_dqCtlAdPCV_mp "Ableitung der Einspritzmenge" SWORD InjMassPerSec_20ms 1 100 -16384.00 16383.50 FORMAT "%8.2" ECU_ADDRESS 0x8FF9C8 /end MEASUREMENT
/begin MEASUREMENT PCR_facAdPCVc1_mp "Faktor c1 zur Bestimmung des VorSteuerkennfeldes der Ladedruckregelung" SWORD Fact 1 100 -4.000000 3.999878 FORMAT "%8.6" ECU_ADDRESS 0x8FF9CA /end MEASUREMENT
/begin MEASUREMENT PCR_facAdPCVc2_mp "Faktor c2 zur Bestimmung des VorSteuerkennfeldes der Ladedruckregelung" SWORD Fact 1 100 -4.000000 3.999878 FORMAT "%8.6" ECU_ADDRESS 0x8FF9CC /end MEASUREMENT
/begin MEASUREMENT PCR_facAdPCVc3_mp "Faktor c3 zur Bestimmung des VorSteuerkennfeldes der Ladedruckregelung" SWORD Fact 1 100 -4.000000 3.999878 FORMAT "%8.6" ECU_ADDRESS 0x8FF9CE /end MEASUREMENT
/begin MEASUREMENT PCR_facAdPCVc4_mp "Faktor c4 zur Bestimmung des VorSteuerkennfeldes der Ladedruckregelung" SWORD Fact 1 100 -4.000000 3.999878 FORMAT "%8.6" ECU_ADDRESS 0x8FF9D0 /end MEASUREMENT
/begin MEASUREMENT PCR_facAdPCVrx_mp "Faktor rx zur Bestimmung des VorSteuerkennfeldes der Ladedruckregelung" SWORD Fact 1 100 -4.000000 3.999878 FORMAT "%8.6" ECU_ADDRESS 0x8FF9D2 /end MEASUREMENT
/begin MEASUREMENT PCR_facAdPCVry_mp "Faktor ry zur Bestimmung des VorSteuerkennfeldes der Ladedruckregelung" SWORD Fact 1 100 -4.000000 3.999878 FORMAT "%8.6" ECU_ADDRESS 0x8FF9D4 /end MEASUREMENT
/begin MEASUREMENT PCR_facAirPerTimeAmplFlt "Amplitudenhöhe der oszillierenden Frischluftmasse beim La-derpumpen tiefpassgefiltert" SWORD FactM 1 100 -2048.000 2047.938 FORMAT "%8.3" ECU_ADDRESS 0x7F8F4E /end MEASUREMENT
/begin MEASUREMENT PCR_facAirPerTimeAmpl_mp "Amplitudenhöhe der oszillierenden Frischluftmasse beim Laderpumpen nach DFT" SWORD FactM 1 100 -2048.000 2047.938 FORMAT "%8.3" ECU_ADDRESS 0x8FFA58 /end MEASUREMENT
/begin MEASUREMENT PCR_facCosCoeffDFT_mp "Kosinuskoeffizient der Fouriertransformation" SLONG FactM 1 100 -134217728.000 134217727.938 FORMAT "%13.3" ECU_ADDRESS 0x8FFA5C /end MEASUREMENT
/begin MEASUREMENT PCR_facD1_mp "Adaptionsfaktor für Regler-D-Verstärkung" SWORD Fact1 1 100 -256.0000 255.9922 FORMAT "%8.4" ECU_ADDRESS 0x8FF9D6 /end MEASUREMENT
/begin MEASUREMENT PCR_facDnCorr_mp "corrective factor based on engine speed gradient" SWORD Fact1 1 100 -256.0000 255.9922 FORMAT "%8.4" ECU_ADDRESS 0x8FF9D8 /end MEASUREMENT
/begin MEASUREMENT PCR_facDpCorr_mp "Korrekturfaktor für D-Parameter Korrektur aus dem Ladedruckgradienten" SWORD Fact1 1 100 -256.0000 255.9922 FORMAT "%8.4" ECU_ADDRESS 0x8FF9DA /end MEASUREMENT
/begin MEASUREMENT PCR_facD_mp "Adaptionsfaktor für Regler-D-Verstärkung" SWORD Fact1 1 100 -256.0000 255.9922 FORMAT "%8.4" ECU_ADDRESS 0x8FF9DC /end MEASUREMENT
/begin MEASUREMENT PCR_facI_mp "Adaptionsfaktor für Regler-I-Verstärkung" SWORD Fact1 1 100 -256.0000 255.9922 FORMAT "%8.4" ECU_ADDRESS 0x8FF9DE /end MEASUREMENT
/begin MEASUREMENT PCR_facmSotCorr_mp "Adaption factor for D-Govrnr. Parameter" SWORD Fact1 1 100 -256.0000 255.9922 FORMAT "%8.4" ECU_ADDRESS 0x8FF9E0 /end MEASUREMENT
/begin MEASUREMENT PCR_facP_mp "Adaptionsfaktor für Regler-P-Verstärkung" SWORD Fact1 1 100 -256.0000 255.9922 FORMAT "%8.4" ECU_ADDRESS 0x8FF9E2 /end MEASUREMENT
/begin MEASUREMENT PCR_facSGDevI_mp "I Regelabweichung AntiSurge-Regler" SWORD FactM 1 100 -2048.000 2047.938 FORMAT "%8.3" ECU_ADDRESS 0x8FFA3E /end MEASUREMENT
/begin MEASUREMENT PCR_facSinCoeffDFT_mp "Sinuskoeffizient der Fouriertransformation" SLONG FactM 1 100 -134217728.000 134217727.938 FORMAT "%13.3" ECU_ADDRESS 0x8FFA60 /end MEASUREMENT
/begin MEASUREMENT PCR_facSinIn_mp "Kennlinieeingangsgröße für den Ersatz der Sinusfunktion durch die Kennlinie" SWORD Fact1 1 100 -256.0000 255.9922 FORMAT "%8.4" ECU_ADDRESS 0x8FFA64 /end MEASUREMENT
/begin MEASUREMENT PCR_facSinOut_mp "Kennlinieausgangsgröße für den Ersatz der Sinusfunktion durch Kennlinie" SWORD Fact 1 100 -4.000000 3.999878 FORMAT "%8.6" ECU_ADDRESS 0x8FFA66 /end MEASUREMENT
/begin MEASUREMENT PCR_facSqrIn_mp "Kennlinieeingangsgröße für den Ersatz der Quadratwurzelfunktion durch die Kennlinie" SWORD FactM 1 100 -2048.000 2047.938 FORMAT "%8.3" ECU_ADDRESS 0x8FFA68 /end MEASUREMENT
/begin MEASUREMENT PCR_facSurgeDes_mp "Sollwert Luftmassenschwingung(AntiSurge-Regler)" SWORD FactM 1 100 -2048.000 2047.938 FORMAT "%8.3" ECU_ADDRESS 0x8FFA40 /end MEASUREMENT
/begin MEASUREMENT PCR_facSurgeGvnrDev_mp "Regelabweichung AntiSurge-Regler" SWORD FactM 1 100 -2048.000 2047.938 FORMAT "%8.3" ECU_ADDRESS 0x8FFA42 /end MEASUREMENT
/begin MEASUREMENT PCR_facSurgeI_mp "Adaptionsfaktor für I-Reglerverstärkung" SWORD Fact1 1 100 -256.0000 255.9922 FORMAT "%8.4" ECU_ADDRESS 0x8FFA44 /end MEASUREMENT
/begin MEASUREMENT PCR_facSurgeP_mp "Adaptionsfaktor für P-Reglerverstärkung" SWORD Fact1 1 100 -256.0000 255.9922 FORMAT "%8.4" ECU_ADDRESS 0x8FFA46 /end MEASUREMENT
/begin MEASUREMENT PCR_pBDesFlt_mp "Output value from PT1 Filter" SWORD Pres_hPa 1 100 -32768.00 32767.00 FORMAT "%8.2" ECU_ADDRESS 0x8FF9E4 /end MEASUREMENT
/begin MEASUREMENT PCR_pBDesLP_mp "Gewuenschter Ladedrucksollwert" SWORD Pres_hPa 1 100 -32768.00 32767.00 FORMAT "%8.2" ECU_ADDRESS 0x8FFA24 /end MEASUREMENT
/begin MEASUREMENT PCR_pBDiffLP_mp "Abweichung  zwischen Real- und Soll-Ladedrucksollwert" SWORD Pres_hPa 1 100 -32768.00 32767.00 FORMAT "%8.2" ECU_ADDRESS 0x8FFA26 /end MEASUREMENT
/begin MEASUREMENT PCR_pBGDev "Regelabweichung" SWORD Pres_hPa 1 100 -32768.00 32767.00 FORMAT "%8.2" ECU_ADDRESS 0x7F8F52 /end MEASUREMENT
/begin MEASUREMENT PCR_pBGDev2_mp "Deviation I/P for Integrator" SWORD Pres_hPa 1 100 -32768.00 32767.00 FORMAT "%8.2" ECU_ADDRESS 0x8FF9E6 /end MEASUREMENT
/begin MEASUREMENT PCR_pBGDevI_mp "Regelabweichung für I-Anteil" SWORD Pres_hPa 1 100 -32768.00 32767.00 FORMAT "%8.2" ECU_ADDRESS 0x8FF9E8 /end MEASUREMENT
/begin MEASUREMENT PCR_pBGDevMax_mp "Maximale Reglerabweichung" SWORD Pres_hPa 1 100 -32768.00 32767.00 FORMAT "%8.2" ECU_ADDRESS 0x8FFA34 /end MEASUREMENT
/begin MEASUREMENT PCR_pBGDevMin_mp "negative deviation threshold with offset" SWORD Pres_hPa 1 100 -32768.00 32767.00 FORMAT "%8.2" ECU_ADDRESS 0x8FFA36 /end MEASUREMENT
/begin MEASUREMENT PCR_pBSurgeDes "Sollwert Ladedruck zur Reduktion Laderpumpen" SWORD Pres_hPa 1 100 -32768.00 32767.00 FORMAT "%8.2" ECU_ADDRESS 0x7F8F54 /end MEASUREMENT
/begin MEASUREMENT PCR_pBSurgeDesMax_mp "maximal zulässige Reglerstellgröße AntiSurge-Regler" SWORD Pres_hPa 1 100 -32768.00 32767.00 FORMAT "%8.2" ECU_ADDRESS 0x8FFA48 /end MEASUREMENT
/begin MEASUREMENT PCR_pBSurgeDesMin_mp "minimal zulässige Reglerstellgröße AntiSurge-Regler" SWORD Pres_hPa 1 100 -32768.00 32767.00 FORMAT "%8.2" ECU_ADDRESS 0x8FFA4A /end MEASUREMENT
/begin MEASUREMENT PCR_pBSurgePICtlLim_mp "PI-Anteil des PI-Regler" SWORD Pres_hPa 1 100 -32768.00 32767.00 FORMAT "%8.2" ECU_ADDRESS 0x8FFA4C /end MEASUREMENT
/begin MEASUREMENT PCR_pBSurgePICtl_mp "PI-Anteil des PI-Regler" SWORD Pres_hPa 1 100 -32768.00 32767.00 FORMAT "%8.2" ECU_ADDRESS 0x8FFA4E /end MEASUREMENT
/begin MEASUREMENT PCR_pSOutI_mp "I-Anteil des PI-Regler" SWORD Pres_hPa 1 100 -32768.00 32767.00 FORMAT "%8.2" ECU_ADDRESS 0x8FFA50 /end MEASUREMENT
/begin MEASUREMENT PCR_pSOutP_mp "P-Anteil des PI-Regler" SWORD Pres_hPa 1 100 -32768.00 32767.00 FORMAT "%8.2" ECU_ADDRESS 0x8FFA52 /end MEASUREMENT
/begin MEASUREMENT PCR_pSurgestI_mp "I-Anteil des PI-Regler" SWORD Pres_hPa 1 100 -32768.00 32767.00 FORMAT "%8.2" ECU_ADDRESS 0x8FFA54 /end MEASUREMENT
/begin MEASUREMENT PCR_qReal "Injection quantity after switching" SWORD InjMassCyc 1 100 -327.6800 327.6700 FORMAT "%8.4" ECU_ADDRESS 0x7F8F5A /end MEASUREMENT
/begin MEASUREMENT PCR_rAdPCVCtlValLim_mp "Beschraenkter Adaption des VorSteuerkennfeldes der Ladedruckregelung" SWORD Prc 1 100 -400.0000 399.9878 FORMAT "%8.4" ECU_ADDRESS 0x8FF9EA /end MEASUREMENT
/begin MEASUREMENT PCR_rAdPCVCtlVal_mp "Adaption des VorSteuerkennfeldes der Ladedruckregelung" SWORD Prc 1 100 -400.0000 399.9878 FORMAT "%8.4" ECU_ADDRESS 0x8FF9EC /end MEASUREMENT
/begin MEASUREMENT PCR_rAdPCVI1_mp "Eingang in den I1-Regler nach Multiplizieren mit C1" SWORD Prc 1 100 -400.0000 399.9878 FORMAT "%8.4" ECU_ADDRESS 0x8FF9EE /end MEASUREMENT
/begin MEASUREMENT PCR_rAdPCVI2_mp "Eingang in den I2-Regler nach Multiplizieren mit C2" SWORD Prc 1 100 -400.0000 399.9878 FORMAT "%8.4" ECU_ADDRESS 0x8FF9F0 /end MEASUREMENT
/begin MEASUREMENT PCR_rAdPCVI3_mp "Eingang in den I3-Regler nach Multiplizieren mit C3" SWORD Prc 1 100 -400.0000 399.9878 FORMAT "%8.4" ECU_ADDRESS 0x8FF9F2 /end MEASUREMENT
/begin MEASUREMENT PCR_rAdPCVI4_mp "Eingang in den I4-Regler nach Multiplizieren mit C4" SWORD Prc 1 100 -400.0000 399.9878 FORMAT "%8.4" ECU_ADDRESS 0x8FF9F4 /end MEASUREMENT
/begin MEASUREMENT PCR_rBPA "Stellgröße für den Ladedrucksteller" SWORD Prc 1 100 -400.0000 399.9878 FORMAT "%8.4" ECU_ADDRESS 0x7F8F5C /end MEASUREMENT
/begin MEASUREMENT PCR_rBPA2 "Ratio2 of valve lift for boost pressure actuator" SWORD Prc 1 100 -400.0000 399.9878 FORMAT "%8.4" ECU_ADDRESS 0x7F8F5E /end MEASUREMENT
/begin MEASUREMENT PCR_rBPACDByp_mp "Bypass-Label, Kopie von PCR_rBPACD" SWORD Prc 1 100 -400.0000 399.9878 FORMAT "%8.4" ECU_ADDRESS 0x8FFA38 /end MEASUREMENT
/begin MEASUREMENT PCR_rBPALP "TV Rohwert an Niederdruckstufensteller" SWORD Prc 1 100 -400.0000 399.9878 FORMAT "%8.4" ECU_ADDRESS 0x7F8F60 /end MEASUREMENT
/begin MEASUREMENT PCR_rBPGovMax "Maximal zulässige Reglerstellgröße" SWORD Prc 1 100 -400.0000 399.9878 FORMAT "%8.4" ECU_ADDRESS 0x7F8F62 /end MEASUREMENT
/begin MEASUREMENT PCR_rBPGovMaxDynRamp_mp "Ramp correction to Maximum allowable PCR governer output" SWORD Prc 1 100 -400.0000 399.9878 FORMAT "%8.4" ECU_ADDRESS 0x6F8138 /end MEASUREMENT
/begin MEASUREMENT PCR_rBPGovMaxDyn_mp "Maximum allowable PCR governer output before ramp correction" SWORD Prc 1 100 -400.0000 399.9878 FORMAT "%8.4" ECU_ADDRESS 0x6F813A /end MEASUREMENT
/begin MEASUREMENT PCR_rBPGovMaxVal1_mp "Maximum allowable PCR governer output without dynamic correction" SWORD Prc 1 100 -400.0000 399.9878 FORMAT "%8.4" ECU_ADDRESS 0x6F813C /end MEASUREMENT
/begin MEASUREMENT PCR_rBPGovMaxVal2_mp "Maximum allowable PCR governer output with dynamic correction" SWORD Prc 1 100 -400.0000 399.9878 FORMAT "%8.4" ECU_ADDRESS 0x6F813E /end MEASUREMENT
/begin MEASUREMENT PCR_rBPGovMax_mp "Maximal zulässige Reglerstellgröße" SWORD Prc 1 100 -400.0000 399.9878 FORMAT "%8.4" ECU_ADDRESS 0x6F8140 /end MEASUREMENT
/begin MEASUREMENT PCR_rBPGovMin "Minimal zulässige Reglerstellgröße" SWORD Prc 1 100 -400.0000 399.9878 FORMAT "%8.4" ECU_ADDRESS 0x7F8F64 /end MEASUREMENT
/begin MEASUREMENT PCR_rBPGovMin_mp "Minimal zulässige Reglerstellgröße" SWORD Prc 1 100 -400.0000 399.9878 FORMAT "%8.4" ECU_ADDRESS 0x6F8142 /end MEASUREMENT
/begin MEASUREMENT PCR_rBPGvnrUnLim1_mp "Ladedrucksteller- Tastverhältnis 1 (unbegrenzt)" SWORD Prc 1 100 -400.0000 399.9878 FORMAT "%8.4" ECU_ADDRESS 0x8FF9F6 /end MEASUREMENT
/begin MEASUREMENT PCR_rBPGvnrUnLim2_mp "Ladedrucksteller- Tastverhältnis 2 (unbegrenzt)" SWORD Prc 1 100 -400.0000 399.9878 FORMAT "%8.4" ECU_ADDRESS 0x8FF9F8 /end MEASUREMENT
/begin MEASUREMENT PCR_rBPLim "limited boost pressure actuator value" SWORD Prc 1 100 -400.0000 399.9878 FORMAT "%8.4" ECU_ADDRESS 0x7F8F66 /end MEASUREMENT
/begin MEASUREMENT PCR_rBPLim_mp "limited value of PID output" SWORD Prc 1 100 -400.0000 399.9878 FORMAT "%8.4" ECU_ADDRESS 0x8FF9FA /end MEASUREMENT
/begin MEASUREMENT PCR_rGvnr "Reglerstellgröße für den Ladedruck" SWORD Prc 1 100 -400.0000 399.9878 FORMAT "%8.4" ECU_ADDRESS 0x7F8F6C /end MEASUREMENT
/begin MEASUREMENT PCR_rGvnr2 "Ratio 2 of valve lift from governor with PCR Balancing governor" SWORD Prc 1 100 -400.0000 399.9878 FORMAT "%8.4" ECU_ADDRESS 0x7F8F6E /end MEASUREMENT
/begin MEASUREMENT PCR_rGvnrSurge "for Anti-Surge LIGov Boost Pressure" SWORD Prc 1 100 -400.0000 399.9878 FORMAT "%8.4" ECU_ADDRESS 0x7F8F70 /end MEASUREMENT
/begin MEASUREMENT PCR_rInitI1AdPCV_mp "Initialisationswerte fuer I1-Regler" SWORD Prc 1 100 -400.0000 399.9878 FORMAT "%8.4" ECU_ADDRESS 0x8FF9FC /end MEASUREMENT
/begin MEASUREMENT PCR_rInitI2AdPCV_mp "Initialisationswerte fuer I2-Regler" SWORD Prc 1 100 -400.0000 399.9878 FORMAT "%8.4" ECU_ADDRESS 0x8FF9FE /end MEASUREMENT
/begin MEASUREMENT PCR_rInitI3AdPCV_mp "Initialisationswerte fuer I3-Regler" SWORD Prc 1 100 -400.0000 399.9878 FORMAT "%8.4" ECU_ADDRESS 0x8FFA00 /end MEASUREMENT
/begin MEASUREMENT PCR_rInitI4AdPCV_mp "Initialisationswerte fuer I4-Regler" SWORD Prc 1 100 -400.0000 399.9878 FORMAT "%8.4" ECU_ADDRESS 0x8FFA02 /end MEASUREMENT
/begin MEASUREMENT PCR_rOutAdPCVI1_mp "Ausgang Des I1-Regler" SWORD Prc 1 100 -400.0000 399.9878 FORMAT "%8.4" ECU_ADDRESS 0x8FFA04 /end MEASUREMENT
/begin MEASUREMENT PCR_rOutAdPCVI2_mp "Ausgang Des I2-Regler" SWORD Prc 1 100 -400.0000 399.9878 FORMAT "%8.4" ECU_ADDRESS 0x8FFA06 /end MEASUREMENT
/begin MEASUREMENT PCR_rOutAdPCVI3_mp "Ausgang Des I3-Regler" SWORD Prc 1 100 -400.0000 399.9878 FORMAT "%8.4" ECU_ADDRESS 0x8FFA08 /end MEASUREMENT
/begin MEASUREMENT PCR_rOutAdPCVI4_mp "Ausgang Des I4-Regler" SWORD Prc 1 100 -400.0000 399.9878 FORMAT "%8.4" ECU_ADDRESS 0x8FFA0A /end MEASUREMENT
/begin MEASUREMENT PCR_rOutDLP_mp "DTWin1-Regler Ausgang" SWORD Prc 1 100 -400.0000 399.9878 FORMAT "%8.4" ECU_ADDRESS 0x8FFA28 /end MEASUREMENT
/begin MEASUREMENT PCR_rOutDT1_mp "DT1-Anteil des PIDT1 Reglers" SWORD Prc 1 100 -400.0000 399.9878 FORMAT "%8.4" ECU_ADDRESS 0x8FFA0C /end MEASUREMENT
/begin MEASUREMENT PCR_rOutILim_mp "limited value of output" SWORD Prc 1 100 -400.0000 399.9878 FORMAT "%8.4" ECU_ADDRESS 0x8FFA0E /end MEASUREMENT
/begin MEASUREMENT PCR_rOutILP_mp "I-Regler Ausgang" SWORD Prc 1 100 -400.0000 399.9878 FORMAT "%8.4" ECU_ADDRESS 0x8FFA2A /end MEASUREMENT
/begin MEASUREMENT PCR_rOutIMax_mp "Ausgangsgröße des Kennfeldes PCR_rOutIMax_MAP" SWORD Prc 1 100 -400.0000 399.9878 FORMAT "%8.4" ECU_ADDRESS 0x8FFA10 /end MEASUREMENT
/begin MEASUREMENT PCR_rOutI_mp "I-Anteil des PIDT1 Reglers" SWORD Prc 1 100 -400.0000 399.9878 FORMAT "%8.4" ECU_ADDRESS 0x8FFA12 /end MEASUREMENT
/begin MEASUREMENT PCR_rOutLimLP_mp "Beschraenkter PID + Vorsteuertastverhaeltnis Ausgang" SWORD Prc 1 100 -400.0000 399.9878 FORMAT "%8.4" ECU_ADDRESS 0x8FFA2C /end MEASUREMENT
/begin MEASUREMENT PCR_rOutLP_mp "PID + Vorsteuertastverhaeltnis Ausgang" SWORD Prc 1 100 -400.0000 399.9878 FORMAT "%8.4" ECU_ADDRESS 0x8FFA2E /end MEASUREMENT
/begin MEASUREMENT PCR_rOutPILP_mp "PI-Regler Ausgang" SWORD Prc 1 100 -400.0000 399.9878 FORMAT "%8.4" ECU_ADDRESS 0x8FFA30 /end MEASUREMENT
/begin MEASUREMENT PCR_rOutPLP_mp "P-Regler Ausgang" SWORD Prc 1 100 -400.0000 399.9878 FORMAT "%8.4" ECU_ADDRESS 0x8FFA32 /end MEASUREMENT
/begin MEASUREMENT PCR_rOutP_mp "P-Anteil des PIDT1 Reglers" SWORD Prc 1 100 -400.0000 399.9878 FORMAT "%8.4" ECU_ADDRESS 0x8FFA14 /end MEASUREMENT
/begin MEASUREMENT PCR_rPICtl_mp "P+I+Steueranteil der Stellgröße (vor ARW)" SWORD Prc 1 100 -400.0000 399.9878 FORMAT "%8.4" ECU_ADDRESS 0x8FFA16 /end MEASUREMENT
/begin MEASUREMENT PCR_rPIDCtl_mp "Regel- und Steueranteil der Stellgrösse des Ladedruckreglers" SWORD Prc 1 100 -400.0000 399.9878 FORMAT "%8.4" ECU_ADDRESS 0x8FFA20 /end MEASUREMENT
/begin MEASUREMENT PCR_rstI_mp "Integratorzustand in Basisvariante" SWORD Prc 1 100 -400.0000 399.9878 FORMAT "%8.4" ECU_ADDRESS 0x8FFA22 /end MEASUREMENT
/begin MEASUREMENT PCR_stAdPCVLogic_mp "Status zur Freigabe verschiedener Funktionsmodi des Lernalgorithmus (aktiv, nicht aktiv, ruecksetzen, ignorieren)" UBYTE OneToOne 1 100 0.00 255.0 FORMAT "%5.1" ECU_ADDRESS 0x8FFA18 /end MEASUREMENT
/begin MEASUREMENT PCR_stAdPCVRelCond_mp "Status der Bedingungen zur Freigabe des Lernprozesses" UBYTE OneToOne 1 100 0.00 255.0 FORMAT "%5.1" ECU_ADDRESS 0x8FFA19 /end MEASUREMENT
/begin MEASUREMENT PCR_stAdPCV_mp "Bedingungen fuer verschiedene Funktionsmodi des Lernalgorithmus (aktiv, nicht aktiv ruecksetzen, ignorieren)" UWORD OneToOne 1 100 0.00 65535.00 FORMAT "%8.2" ECU_ADDRESS 0x8FFA1A /end MEASUREMENT
/begin MEASUREMENT PCR_stEepAdPCV_mp "Status von eeprom schreibt" UBYTE OneToOne 1 100 0.00 255.0 FORMAT "%5.1" ECU_ADDRESS 0x8FFA1C /end MEASUREMENT
/begin MEASUREMENT PCR_stEepBlock_mp "Status des Eeprom-Blockes" SWORD OneToOne 1 100 -32768.00 32767.00 FORMAT "%8.2" ECU_ADDRESS 0x8FFA1E /end MEASUREMENT
/begin MEASUREMENT PCR_stMonitor "Statusangabe bei Abschaltung der Regelung" UBYTE OneToOne 1 100 0.00 255.0 FORMAT "%5.1" ECU_ADDRESS 0x7F893F /end MEASUREMENT
/begin MEASUREMENT PCR_stPCR "Status der Ladedruckregelung" UWORD OneToOne 1 100 0.00 65535.00 FORMAT "%8.2" ECU_ADDRESS 0x7F8F72 /end MEASUREMENT
/begin MEASUREMENT PCR_stPCR_mp "Status der Ladedruckregelung" UWORD OneToOne 1 100 0.00 65535.00 FORMAT "%8.2" ECU_ADDRESS 0x8FFA3A /end MEASUREMENT
/begin MEASUREMENT PCR_stPreSurge "Status der Erkennung für Laderpumpen Zustand 1 (oszillierende Frischluftmasse mit kleiner Amplitude)" UBYTE OneToOne 1 100 0.00 255.0 FORMAT "%5.1" ECU_ADDRESS 0x7F8940 /end MEASUREMENT
/begin MEASUREMENT PCR_stSurge "Status der Erkennung für Laderpumpen Zustand 2 (oszillierende Frischluftmasse mit großer Amplitude)" UBYTE OneToOne 1 100 0.00 255.0 FORMAT "%5.1" ECU_ADDRESS 0x7F8941 /end MEASUREMENT
/begin MEASUREMENT PCR_stSwtBPGovMaxDyn_mp "Ramp switch position, for dynamic adjustment of maximum allowable PCR governor output" UBYTE OneToOne 1 100 0.00 255.0 FORMAT "%5.1" ECU_ADDRESS 0x6F8144 /end MEASUREMENT
/begin MEASUREMENT PCR_stWorkSph "present working sphere" UBYTE OneToOne 1 100 0.00 255.0 FORMAT "%5.1" ECU_ADDRESS 0x7F8944 /end MEASUREMENT
/begin MEASUREMENT PCR_swtGvnr "Schalter: Regler ein/aus" UBYTE OneToOne 1 100 0.00 255.0 FORMAT "%5.1" ECU_ADDRESS 0x7F8945 /end MEASUREMENT
/begin MEASUREMENT PCR_swtLimSel "Schalter zur Auswahl der Größen, aus denen der zulässige Stellgrößenbereich bestimmt wird" UBYTE OneToOne 1 100 0.00 255.0 FORMAT "%5.1" ECU_ADDRESS 0x7F8946 /end MEASUREMENT
/begin MEASUREMENT PCR_swtRelAbs "Schalter zur Auswahl zwischen Absolut- und Relativdruckregelung" UBYTE OneToOne 1 100 0.00 255.0 FORMAT "%5.1" ECU_ADDRESS 0x7F8949 /end MEASUREMENT
/begin MEASUREMENT PCR_swtSurgeGvnr "Zustand einzelnen Statis für AntiSurge-Regler" UBYTE OneToOne 1 100 0.00 255.0 FORMAT "%5.1" ECU_ADDRESS 0x7F894A /end MEASUREMENT
/begin MEASUREMENT PCR_swtSurgeGvnrSel_mp "Zustand einzelnen Statis für AntiSurge-Regler" UBYTE OneToOne 1 100 0.00 255.0 FORMAT "%5.1" ECU_ADDRESS 0x8FFA56 /end MEASUREMENT
/begin MEASUREMENT PCR_tiStrtDelay_mp "Zeit, in der die Regelung nach Startabwurf abgeschaltet bleibt" UWORD Time_ms 1 100 0.00 655350.0 FORMAT "%8.1" ECU_ADDRESS 0x8FFA3C /end MEASUREMENT
/begin MEASUREMENT PCVCD_dcycDT1_mp "Sollwert Tastverhältnis mit DT1-Anteil" SWORD DtyCyc 1 100 -327.6800 327.6700 FORMAT "%8.4" ECU_ADDRESS 0x8FFA70 /end MEASUREMENT
/begin MEASUREMENT PCVCD_dcycOut_mp "Ausgangstastverhältnis" SWORD DtyCyc 1 100 -327.6800 327.6700 FORMAT "%8.4" ECU_ADDRESS 0x6F8146 /end MEASUREMENT
/begin MEASUREMENT PCVCD_dcycSetVal_mp "Sollwert Tastverhältnis für Druckregelventil" SWORD DtyCyc 1 100 -327.6800 327.6700 FORMAT "%8.4" ECU_ADDRESS 0x8FFA72 /end MEASUREMENT
/begin MEASUREMENT PCVCD_facIGov_mp "Stromregler I-Anteil" SWORD Fact 1 100 -4.000000 3.999878 FORMAT "%8.6" ECU_ADDRESS 0x8FFA74 /end MEASUREMENT
/begin MEASUREMENT PCVCD_iActFlt_mp "PT1 gefilterter Strom Istwert" SWORD Curr 1 100 -32768.00 32767.00 FORMAT "%8.2" ECU_ADDRESS 0x8FFA76 /end MEASUREMENT
/begin MEASUREMENT PCVCD_iActVal "Analogeingang Strom-Istwert" SWORD Curr 1 100 -32768.00 32767.00 FORMAT "%8.2" ECU_ADDRESS 0x7F8F74 /end MEASUREMENT
/begin MEASUREMENT PCVCD_iDvt_mp "Stromregler Regelabweichung" SWORD Curr 1 100 -32768.00 32767.00 FORMAT "%8.2" ECU_ADDRESS 0x8FFA78 /end MEASUREMENT
/begin MEASUREMENT PCVCD_iGovActVal_mp "Isttrom nach Eingriff des Raildruckreglers" SWORD Curr 1 100 -32768.00 32767.00 FORMAT "%8.2" ECU_ADDRESS 0x8FFA7A /end MEASUREMENT
/begin MEASUREMENT PCVCD_iSetFlt_mp "PT1 gefilterter Stromistwert" SWORD Curr 1 100 -32768.00 32767.00 FORMAT "%8.2" ECU_ADDRESS 0x8FFA7C /end MEASUREMENT
/begin MEASUREMENT PCVCD_swtCtlState "geschlossener Regelkreis für Stromregler konstant oder in Abhängigkeit vom Raildruckregler" UBYTE OneToOne 1 100 0.00 255.0 FORMAT "%5.1" ECU_ADDRESS 0x7F894B /end MEASUREMENT
/begin MEASUREMENT PCVCD_uRawVal_mp "Analogeingang Spannungsrohwert" SWORD Volt 1 100 -160156.4 160151.5 FORMAT "%8.1" ECU_ADDRESS 0x8FFA7E /end MEASUREMENT
/begin MEASUREMENT PCV_dvolLeak_mp "Leckage des Druckregelventils" SWORD Qp_mm3_sec 1 100 -327680.0 327670.0 FORMAT "%8.1" ECU_ADDRESS 0x8FFA6A /end MEASUREMENT
/begin MEASUREMENT PCV_iSet_mp "Sollstrom fuer das Druckregelventil" SWORD Curr 1 100 -32768.00 32767.00 FORMAT "%8.2" ECU_ADDRESS 0x8FFA6C /end MEASUREMENT
/begin MEASUREMENT PCV_stActrCtl_mp "Zustand der Stellwertsteuerung fuer das Druckregelventil" UBYTE OneToOne 1 100 0.00 255.0 FORMAT "%5.1" ECU_ADDRESS 0x8FFA6E /end MEASUREMENT
/begin MEASUREMENT PFltCD_pLinPre "linearisierter Analogwert, Absolutdrucksensor vor dem Partikelfilter" SWORD Pres 1 100 -32768.00 32767.00 FORMAT "%9.2" ECU_ADDRESS 0x7F8F78 /end MEASUREMENT
/begin MEASUREMENT PFltCD_pPre "Abgastemp. vor Partikelfilter" SWORD Pres 1 100 -32768.00 32767.00 FORMAT "%9.2" ECU_ADDRESS 0x7F8F7A /end MEASUREMENT
/begin MEASUREMENT PFltCD_tLinPre "Linearisierter Wert der Abgastemperatur vor dem Partikelfilter" SWORD Temp_Cels 1 100 -50.140 899.860 FORMAT "%8.3" ECU_ADDRESS 0x7F8F7C /end MEASUREMENT
/begin MEASUREMENT PFltCD_tPre "Abgastemp. vor Partikelfilter erster Sensor" SWORD Temp_Cels 1 100 -50.140 899.860 FORMAT "%8.3" ECU_ADDRESS 0x7F8F7E /end MEASUREMENT
/begin MEASUREMENT PFltCD_uRawPresPre_mp "Spannungsrohwert vom Absolutdrucksensor vor dem Partikelfilter" SWORD Volt 1 100 -160156.4 160151.5 FORMAT "%8.1" ECU_ADDRESS 0x8FFB9C /end MEASUREMENT
/begin MEASUREMENT PFltCD_uRawTempPre "Spannungsrohwert der Abgastemperatur vor dem Partikelfilter" SWORD Volt 1 100 -160156.4 160151.5 FORMAT "%8.1" ECU_ADDRESS 0x7F8F82 /end MEASUREMENT
/begin MEASUREMENT PFlt_aVehFltAshCor_mp "gefilterter Wert Fahrzeugbeschleunigung" SWORD Acc 1 100 -32.76800 32.76700 FORMAT "%8.5" ECU_ADDRESS 0x8FFA80 /end MEASUREMENT
/begin MEASUREMENT PFlt_ctNumAshCorMax_mp "aktueller Zählerwert des Maximumzählers für AshCor Regeneration" UWORD OneToOne 1 100 0.00 65535.00 FORMAT "%8.2" ECU_ADDRESS 0x8FFA82 /end MEASUREMENT
/begin MEASUREMENT PFlt_ctNumAshCor_mp "aktueller Zählerwert für erfolgreiche Regeneration" UWORD OneToOne 1 100 0.00 65535.00 FORMAT "%8.2" ECU_ADDRESS 0x8FFA84 /end MEASUREMENT
/begin MEASUREMENT PFlt_dVolFltAshCorRaw_mp "dVol-Rohwert" SWORD CubMtrPerHr 1 100 -3276.800 3276.700 FORMAT "%8.3" ECU_ADDRESS 0x8FFA86 /end MEASUREMENT
/begin MEASUREMENT PFlt_dVolFltAshCor_mp "PT1-gefilterter Wert für PFlt_dvol" SWORD CubMtrPerHr 1 100 -3276.800 3276.700 FORMAT "%8.3" ECU_ADDRESS 0x8FFA88 /end MEASUREMENT
/begin MEASUREMENT PFlt_lAshCorAct_mp "Zwischenwert Kilometerstand" UWORD LengthKm 1 100 0.00 65535.00 FORMAT "%8.2" ECU_ADDRESS 0x8FFA8A /end MEASUREMENT
/begin MEASUREMENT PFlt_lAshCorNext "Kilometer für die nächste(folgende) Abgleichung" ULONG LengthKm 1 100 0.00 4294967295.00 FORMAT "%13.2" ECU_ADDRESS 0x7F91B4 /end MEASUREMENT
/begin MEASUREMENT PFlt_lAshCorNextEEProm_mp "nächster Kilometerstand für Ascheabgelichregeneration, gelesen vom EEPROM bei Motorstart" UWORD LengthKm 1 100 0.00 65535.00 FORMAT "%8.2" ECU_ADDRESS 0x8FFA8C /end MEASUREMENT
/begin MEASUREMENT PFlt_lAshCorNextMax_mp "Messender Punkt für folgende maximale Aschenkorrektur" ULONG LengthKm 1 100 0.00 4294967295.00 FORMAT "%13.2" ECU_ADDRESS 0x8FFA90 /end MEASUREMENT
/begin MEASUREMENT PFlt_lAshCorNextOilCor_mp "Messender Punkt für folgendes maximales Aschen ölen Korrektur." ULONG LengthKm 1 100 0.00 4294967295.00 FORMAT "%13.2" ECU_ADDRESS 0x8FFA94 /end MEASUREMENT
/begin MEASUREMENT PFlt_lAshCorOldCalc_mp "Messender Punkt für alten Aschenkorrekturwert." ULONG LengthKm 1 100 0.00 4294967295.00 FORMAT "%13.2" ECU_ADDRESS 0x8FFA98 /end MEASUREMENT
/begin MEASUREMENT PFlt_lAshCorStep_mp "Schrittgröße für Aschenkorrektur." UWORD LengthKm 1 100 0.00 65535.00 FORMAT "%8.2" ECU_ADDRESS 0x8FFA9C /end MEASUREMENT
/begin MEASUREMENT PFlt_lSnceRgn "driven distance after regeneration" ULONG LengthKm 1 100 0.00 4294967295.00 FORMAT "%13.2" ECU_ADDRESS 0x7F91B8 /end MEASUREMENT
/begin MEASUREMENT PFlt_lSnceRgnu16_mp "Driven distance since last successful regeneration with reduced resolution" UWORD lSnceRgnRes 1 100 0.00 8388480. FORMAT "%8.0" ECU_ADDRESS 0x6F8148 /end MEASUREMENT
/begin MEASUREMENT PFlt_lSnceRgn_mp "gefahrene Strecke seit letzter erfolgreicher Regeneration" ULONG Length 1 100 0.00 4294967295.00 FORMAT "%13.2" ECU_ADDRESS 0x8FFAC0 /end MEASUREMENT
/begin MEASUREMENT PFlt_lSumu16_mp "Total driven distance with reduced resolution" UWORD lSumRes 1 100 0.00 1073725440. ECU_ADDRESS 0x6F814A /end MEASUREMENT
/begin MEASUREMENT PFlt_lSum_mp "ges. gefahrene Strecke bei der letzten erfolgr. Regeneration" ULONG Length 1 100 0.00 4294967295.00 FORMAT "%13.2" ECU_ADDRESS 0x6F814C /end MEASUREMENT
/begin MEASUREMENT PFlt_mAshCorAct "tatsächliche Aschenmenge" SWORD mSoot_g 1 100 -327.6800 327.6700 FORMAT "%8.4" ECU_ADDRESS 0x7F8F8A /end MEASUREMENT
/begin MEASUREMENT PFlt_mAshCorActRel_mp "aktuell relative Abweichung der neu berechneten Aschemenge" SWORD mSoot_g 1 100 -327.6800 327.6700 FORMAT "%8.4" ECU_ADDRESS 0x8FFA9E /end MEASUREMENT
/begin MEASUREMENT PFlt_mAshCorDiff1_mp "Absolutbetrag von PFlt_mAshCorDiff_mp, relative Aschemengeabweichung" SWORD mSoot_g 1 100 -327.6800 327.6700 FORMAT "%8.4" ECU_ADDRESS 0x8FFAA0 /end MEASUREMENT
/begin MEASUREMENT PFlt_mAshCorDiff_mp "output of PFlt_mAshCor_MAP, Abweichung vom Aschemengesollwert" SWORD mSoot_g 1 100 -327.6800 327.6700 FORMAT "%8.4" ECU_ADDRESS 0x8FFAA2 /end MEASUREMENT
/begin MEASUREMENT PFlt_mAshCorNew "Wird nur berechnet, wenn PFlt_mAshCorAct einen plausiblen Wert besitzt" SWORD mSoot_g 1 100 -327.6800 327.6700 FORMAT "%8.4" ECU_ADDRESS 0x7F8F8C /end MEASUREMENT
/begin MEASUREMENT PFlt_mAshCorOld "Aschekorrekturwert vom vorherigen Zyklus" SWORD mSoot_g 1 100 -327.6800 327.6700 FORMAT "%8.4" ECU_ADDRESS 0x7F8F8E /end MEASUREMENT
/begin MEASUREMENT PFlt_mSotOfs_mp "Korrekturwert äquivalenter Massenoffset" SWORD mSoot_g 1 100 -327.6800 327.6700 FORMAT "%8.4" ECU_ADDRESS 0x8FFAC4 /end MEASUREMENT
/begin MEASUREMENT PFlt_nAvrgFltAshCor_mp "gefilterter Wert Drehzahl" SWORD EngN 1 100 -32768.00 32767.00 FORMAT "%8.2" ECU_ADDRESS 0x8FFAA4 /end MEASUREMENT
/begin MEASUREMENT PFlt_nDiagLowIdle "Leerlaufdrehzahl im Regenerationszustand" SWORD EngN 1 100 -32768.00 32767.00 FORMAT "%8.2" ECU_ADDRESS 0x7F8F98 /end MEASUREMENT
/begin MEASUREMENT PFlt_numAshCor "Asche-Nummer" UBYTE OneToOne 1 100 0.00 255.0 FORMAT "%5.1" ECU_ADDRESS 0x7F894C /end MEASUREMENT
/begin MEASUREMENT PFlt_numEngPOp "Regeneration number after consideration of the engine operating state" UBYTE OneToOne 1 100 0.00 255.0 FORMAT "%5.1" ECU_ADDRESS 0x7F894D /end MEASUREMENT
/begin MEASUREMENT PFlt_numLst_mp "Regenerationsanforderung aufgrund verbr. Treibstoff, Betriebszeit oder Strecke" UBYTE OneToOne 1 100 0.00 255.0 FORMAT "%5.1" ECU_ADDRESS 0x8FFAC6 /end MEASUREMENT
/begin MEASUREMENT PFlt_numPrio "Priorität für angeforderten Regenerationszustand" UWORD OneToOne 1 100 0.00 65535.00 FORMAT "%8.2" ECU_ADDRESS 0x7F8F9A /end MEASUREMENT
/begin MEASUREMENT PFlt_numPrt_mp "Regenerationsanforderung aufgrund Motorschutz" UBYTE OneToOne 1 100 0.00 255.0 FORMAT "%5.1" ECU_ADDRESS 0x8FFAC7 /end MEASUREMENT
/begin MEASUREMENT PFlt_numRgn_mp "gesamte Regenerationsanforderung" UBYTE OneToOne 1 100 0.00 255.0 FORMAT "%5.1" ECU_ADDRESS 0x6F8150 /end MEASUREMENT
/begin MEASUREMENT PFlt_numSot_mp "Beladungszustand des DPF" UBYTE OneToOne 1 100 0.00 255.0 FORMAT "%5.1" ECU_ADDRESS 0x8FFAC8 /end MEASUREMENT
/begin MEASUREMENT PFlt_numTot_mp "Regeneationsmaßnahme nach Berücksichtigung des Motorbetriebspunktes" UBYTE OneToOne 1 100 0.00 255.0 FORMAT "%5.1" ECU_ADDRESS 0x8FFAC9 /end MEASUREMENT
/begin MEASUREMENT PFlt_pEngPrtMax_mp "Maximaldruck Motorschutz" SWORD Pres_hPa 1 100 -32768.00 32767.00 FORMAT "%8.2" ECU_ADDRESS 0x6F8152 /end MEASUREMENT
/begin MEASUREMENT PFlt_pEngPrtMin_mp "Minimaldruck Motorschutz" SWORD Pres_hPa 1 100 -32768.00 32767.00 FORMAT "%8.2" ECU_ADDRESS 0x8FFACA /end MEASUREMENT
/begin MEASUREMENT PFlt_qFlTot "nach der letzten Filterreinigung verbrauchte gesamte Krafstoffmenge" SWORD Fl_2 1 100 -327680.0 327670.0 FORMAT "%8.1" ECU_ADDRESS 0x7F8FA6 /end MEASUREMENT
/begin MEASUREMENT PFlt_qFlTotCor "Gesamtmenge Kraftstoffquantitätskorrektur" SWORD Fl_2 1 100 -327680.0 327670.0 FORMAT "%8.1" ECU_ADDRESS 0x7F8FA8 /end MEASUREMENT
/begin MEASUREMENT PFlt_qFlTotEEPROM_mp "in EEPROM abgespeicherter Wert des Gesamtkraftstoffverbrauches für das DPF" SLONG Fl_L 1 100 -21474836.4800 21474836.4700 FORMAT "%13.4" ECU_ADDRESS 0x8FFACC /end MEASUREMENT
/begin MEASUREMENT PFlt_qFl_mp "verbrauchter Treibstoff seit der letzten erfolgreichen Regeneration" SWORD Fl_L 1 100 -327.6800 327.6700 FORMAT "%8.4" ECU_ADDRESS 0x6F8154 /end MEASUREMENT
/begin MEASUREMENT PFlt_qSetUnBalFltAshCor_mp "gefilterter Wert Einspritzmasse" SWORD InjMassCyc 1 100 -327.6800 327.6700 FORMAT "%8.4" ECU_ADDRESS 0x8FFAA6 /end MEASUREMENT
/begin MEASUREMENT PFlt_resFlowFltAshCorRaw_mp "Resflow-Rohwert" SWORD Res_hPaHrPerCM 1 100 -32.76800 32.76700 FORMAT "%8.5" ECU_ADDRESS 0x8FFAA8 /end MEASUREMENT
/begin MEASUREMENT PFlt_resFlowFltAshCor_mp "PT1-gefilterter Wert für for PFlt_resFlow" SWORD Res_hPaHrPerCM 1 100 -32.76800 32.76700 FORMAT "%8.5" ECU_ADDRESS 0x8FFAAA /end MEASUREMENT
/begin MEASUREMENT PFlt_resSotMeasCrv_mp "versteckter Messpunkt, nur für aus Codierungsgründen" SWORD Res_hPaHrPerCM 1 100 -32.76800 32.76700 FORMAT "%8.5" ECU_ADDRESS 0x8FFAD0 /end MEASUREMENT
/begin MEASUREMENT PFlt_st "von Partikelfilter angeforderter Regenerationsstatus" ULONG OneToOne 1 100 0.00 4294967295.00 FORMAT "%13.2" ECU_ADDRESS 0x7F91BC /end MEASUREMENT
/begin MEASUREMENT PFlt_st1_mp "Status des Partikelfilters  LowByte (->Signals)" UWORD OneToOne 1 100 0.00 65535.00 FORMAT "%8.2" ECU_ADDRESS 0x6F8156 /end MEASUREMENT
/begin MEASUREMENT PFlt_st2_mp "Status des Partikelfilters  HighByte (->Signals)" UWORD OneToOne 1 100 0.00 65535.00 FORMAT "%8.2" ECU_ADDRESS 0x6F8158 /end MEASUREMENT
/begin MEASUREMENT PFlt_stAshCorCalc_mp "Berechnungsstatus Aschekorrektur" UBYTE OneToOne 1 100 0.00 255.0 FORMAT "%5.1" ECU_ADDRESS 0x8FFAAC /end MEASUREMENT
/begin MEASUREMENT PFlt_stAshCorDist_mp "Status Ashekorrekturdistanz" UBYTE OneToOne 1 100 0.00 255.0 FORMAT "%5.1" ECU_ADDRESS 0x8FFAAD /end MEASUREMENT
/begin MEASUREMENT PFlt_stAshCorRgnMax_mp "Wenn gesetzt, dann ist die maximal erlaubte Zeit für eine Regeneration abgelaufen" UBYTE OneToOne 1 100 0.00 255.0 FORMAT "%5.1" ECU_ADDRESS 0x8FFAAE /end MEASUREMENT
/begin MEASUREMENT PFlt_stAshCorRgn_mp "bitweise Aufschlüsselung der aktuellen Regenerationsanforderung" UBYTE OneToOne 1 100 0.00 255.0 FORMAT "%5.1" ECU_ADDRESS 0x8FFAAF /end MEASUREMENT
/begin MEASUREMENT PFlt_stAshCorRlsOn_mp "Status Aschekorrektur-Freigabe am" UBYTE OneToOne 1 100 0.00 255.0 FORMAT "%5.1" ECU_ADDRESS 0x8FFAB0 /end MEASUREMENT
/begin MEASUREMENT PFlt_stAshCorRls_mp "Status Aschekorrektur-Freigabe" UBYTE OneToOne 1 100 0.00 255.0 FORMAT "%5.1" ECU_ADDRESS 0x8FFAB1 /end MEASUREMENT
/begin MEASUREMENT PFlt_stAshCor_mp "Status Aschekorrektur" UBYTE OneToOne 1 100 0.00 255.0 FORMAT "%5.1" ECU_ADDRESS 0x8FFAB2 /end MEASUREMENT
/begin MEASUREMENT PFlt_stCnt_mp "Statuswort für  Regnerationsanf. nach Kraftstoffverbrauch, Betriebsstunden oder gefahrener Strecke" UBYTE OneToOne 1 100 0.00 255.0 FORMAT "%5.1" ECU_ADDRESS 0x8FFAD2 /end MEASUREMENT
/begin MEASUREMENT PFlt_stDiag "status of particulate filter" ULONG OneToOne 1 100 0.00 4294967295.00 FORMAT "%13.2" ECU_ADDRESS 0x7F91C0 /end MEASUREMENT
/begin MEASUREMENT PFlt_stDiagAbort "Bit-Information für Abbruchbedingungen" ULONG OneToOne 1 100 0.00 4294967295.00 FORMAT "%13.2" ECU_ADDRESS 0x7F91C4 /end MEASUREMENT
/begin MEASUREMENT PFlt_stDiagAbortMsk "gewünschte Bit-Information für Abbruchbedingungen" ULONG OneToOne 1 100 0.00 4294967295.00 FORMAT "%13.2" ECU_ADDRESS 0x7F91C8 /end MEASUREMENT
/begin MEASUREMENT PFlt_stDiagAbrt1_mp "Trigger Abbruch 1" UBYTE OneToOne 1 100 0.00 255.0 FORMAT "%5.1" ECU_ADDRESS 0x8FFAE8 /end MEASUREMENT
/begin MEASUREMENT PFlt_stDiagAbrt2_mp "Trigger Abbruch 2" UBYTE OneToOne 1 100 0.00 255.0 FORMAT "%5.1" ECU_ADDRESS 0x8FFAE9 /end MEASUREMENT
/begin MEASUREMENT PFlt_stDiagCoolDwn_mp "Abkühltrigger" UBYTE OneToOne 1 100 0.00 255.0 FORMAT "%5.1" ECU_ADDRESS 0x8FFAEA /end MEASUREMENT
/begin MEASUREMENT PFlt_stDiagDemOn "Testeranforderung auf Diagnose" UBYTE OneToOne 1 100 0.00 255.0 FORMAT "%5.1" ECU_ADDRESS 0x7F894F /end MEASUREMENT
/begin MEASUREMENT PFlt_stDiagEnd_mp "Trigger Regenerationsende" UBYTE OneToOne 1 100 0.00 255.0 FORMAT "%5.1" ECU_ADDRESS 0x8FFAEB /end MEASUREMENT
/begin MEASUREMENT PFlt_stDiagMsk "gewünschter Zustand der Freigabebedingungen" ULONG OneToOne 1 100 0.00 4294967295.00 FORMAT "%13.2" ECU_ADDRESS 0x7F91CC /end MEASUREMENT
/begin MEASUREMENT PFlt_stDiagOn "Diagnosezustand EIN" UBYTE OneToOne 1 100 0.00 255.0 FORMAT "%5.1" ECU_ADDRESS 0x7F8950 /end MEASUREMENT
/begin MEASUREMENT PFlt_stDiagRgn "Zustand der Regenerationsbedingungen" ULONG OneToOne 1 100 0.00 4294967295.00 FORMAT "%13.2" ECU_ADDRESS 0x7F91D0 /end MEASUREMENT
/begin MEASUREMENT PFlt_stDiagRgnMsk "gewünschter Zustand der Regenerationsbedingungen" ULONG OneToOne 1 100 0.00 4294967295.00 FORMAT "%13.2" ECU_ADDRESS 0x7F91D4 /end MEASUREMENT
/begin MEASUREMENT PFlt_stDiagRgn_mp "Regenerationsstart-Trigger" UBYTE OneToOne 1 100 0.00 255.0 FORMAT "%5.1" ECU_ADDRESS 0x8FFAEC /end MEASUREMENT
/begin MEASUREMENT PFlt_stDiagRls "Zustand der Freigabebedingungen" ULONG OneToOne 1 100 0.00 4294967295.00 FORMAT "%13.2" ECU_ADDRESS 0x7F91D8 /end MEASUREMENT
/begin MEASUREMENT PFlt_stDiagRls_mp "Freigabe der Diagnose" UBYTE OneToOne 1 100 0.00 255.0 FORMAT "%5.1" ECU_ADDRESS 0x8FFAED /end MEASUREMENT
/begin MEASUREMENT PFlt_stDiagState "Diagnosezustand" UWORD OneToOne 1 100 0.00 65535.00 FORMAT "%8.2" ECU_ADDRESS 0x7F8FB6 /end MEASUREMENT
/begin MEASUREMENT PFlt_stDiagSuc "Zustand des Diagnoseerfolgs" UBYTE OneToOne 1 100 0.00 255.0 FORMAT "%5.1" ECU_ADDRESS 0x7F8951 /end MEASUREMENT
/begin MEASUREMENT PFlt_stEngPrtActv "Status Motorschutz aktiv" UBYTE OneToOne 1 100 0.00 255.0 FORMAT "%5.1" ECU_ADDRESS 0x7F8953 /end MEASUREMENT
/begin MEASUREMENT PFlt_stFlTotCorOn_mp "Status für Gesamtmenge Kraftstoffkorrektur ON." UBYTE OneToOne 1 100 0.00 255.0 FORMAT "%5.1" ECU_ADDRESS 0x8FFAB3 /end MEASUREMENT
/begin MEASUREMENT PFlt_stFlTotCor_mp "Status für Gesamtmenge Kraftstoffkorrektur" UBYTE OneToOne 1 100 0.00 255.0 FORMAT "%5.1" ECU_ADDRESS 0x8FFAB4 /end MEASUREMENT
/begin MEASUREMENT PFlt_stIntr_mp "Statuswort Regeneration unterbrochen" UBYTE OneToOne 1 100 0.00 255.0 FORMAT "%5.1" ECU_ADDRESS 0x6F815A /end MEASUREMENT
/begin MEASUREMENT PFlt_stLck "Statusbit Lock Partikelfilterregeneration" UBYTE OneToOne 1 100 0.00 255.0 FORMAT "%5.1" ECU_ADDRESS 0x7F8954 /end MEASUREMENT
/begin MEASUREMENT PFlt_stLckFuel_mp "Messender Punkt für Status der Kraftstoffverriegelung" UBYTE OneToOne 1 100 0.00 255.0 FORMAT "%5.1" ECU_ADDRESS 0x8FFAD3 /end MEASUREMENT
/begin MEASUREMENT PFlt_stLck_mp "Regeneration Blockierung und Freigabe" UBYTE OneToOne 1 100 0.00 255.0 FORMAT "%5.1" ECU_ADDRESS 0x6F815B /end MEASUREMENT
/begin MEASUREMENT PFlt_stLstRgnEnd_mp "Status detektiert Ende des Timers für Regeneration aus Zählerblöcken" UBYTE OneToOne 1 100 0.00 255.0 FORMAT "%5.1" ECU_ADDRESS 0x8FFAD4 /end MEASUREMENT
/begin MEASUREMENT PFlt_stLstRgn_mp "Status Timer für Regeneration aus Zählerblöcken" UBYTE OneToOne 1 100 0.00 255.0 FORMAT "%5.1" ECU_ADDRESS 0x8FFAD5 /end MEASUREMENT
/begin MEASUREMENT PFlt_stNumEngPOpDelOn_mp "Statusbit verzögert wirksame Matrix zur Berücksichtigung des Motorbetriebszustandes bei der Regeneration" UBYTE OneToOne 1 100 0.00 255.0 FORMAT "%5.1" ECU_ADDRESS 0x8FFAD6 /end MEASUREMENT
/begin MEASUREMENT PFlt_stSuc "Statuswort erfolgreiche Regeneration" UBYTE OneToOne 1 100 0.00 255.0 FORMAT "%5.1" ECU_ADDRESS 0x7F8956 /end MEASUREMENT
/begin MEASUREMENT PFlt_stSuc_mp "erfolgreiche Regeneration" UBYTE OneToOne 1 100 0.00 255.0 FORMAT "%5.1" ECU_ADDRESS 0x8FFAD7 /end MEASUREMENT
/begin MEASUREMENT PFlt_swtAshOilCor "Schaltung der Asche-Ölkorrektur" UBYTE OneToOne 1 100 0.00 255.0 FORMAT "%5.1" ECU_ADDRESS 0x7F8957 /end MEASUREMENT
/begin MEASUREMENT PFlt_tAirFltAshCor_mp "gefilterter Wert Ansauglufttemperatur" SWORD Temp_Cels 1 100 -50.140 899.860 FORMAT "%8.3" ECU_ADDRESS 0x8FFAB6 /end MEASUREMENT
/begin MEASUREMENT PFlt_tCIntFltAshCor_mp "gefilterter Wert Kühlmitteltemperatur" SWORD Temp_Cels 1 100 -50.140 899.860 FORMAT "%8.3" ECU_ADDRESS 0x8FFAB8 /end MEASUREMENT
/begin MEASUREMENT PFlt_tiLckRls_mp " In EEPROM abgespeicherte Zeit für Sperren die Regeneration" ULONG Time_s 1 100 0.00 42949672.9500 FORMAT "%13.4" ECU_ADDRESS 0x8FFAD8 /end MEASUREMENT
/begin MEASUREMENT PFlt_tiOpu16_mp "Engine operation time with reduced resolution" UWORD tiOpRes 1 100 0.00 4194240. FORMAT "%8.0" ECU_ADDRESS 0x6F815C /end MEASUREMENT
/begin MEASUREMENT PFlt_tiOp_mp "Motorbetriebszeit bei der letzten erfolgr. Regeneration" ULONG TimeEngOn 1 100 0.00 4294967295.00 FORMAT "%13.2" ECU_ADDRESS 0x8FFADC /end MEASUREMENT
/begin MEASUREMENT PFlt_tiRgnMax_mp "Wert für die maximale Regenerierungsdauer" ULONG Time_s 1 100 0.00 42949672.9500 FORMAT "%13.4" ECU_ADDRESS 0x8FFAE0 /end MEASUREMENT
/begin MEASUREMENT PFlt_tiSnceRgnu16_mp "Engine operation time since last successful regeneration with reduced resolution" UWORD tiSncergnRes 1 100 0.00 16776960. FORMAT "%8.0" ECU_ADDRESS 0x6F815E /end MEASUREMENT
/begin MEASUREMENT PFlt_tiSnceRgn_mp "Motorbetriebszeit seit der letzten erfolgreichen Regeneration" ULONG TimeEngOn 1 100 0.00 4294967295.00 FORMAT "%13.2" ECU_ADDRESS 0x8FFAE4 /end MEASUREMENT
/begin MEASUREMENT PFlt_tOxiPreFltAshCor_mp "gefilterter Wert OxiKat-Temperatur" SWORD Temp_Cels 1 100 -50.140 899.860 FORMAT "%8.3" ECU_ADDRESS 0x8FFABA /end MEASUREMENT
/begin MEASUREMENT PFlt_tPreFltAshCor_mp "gefilterter Wert Aufwärtstemperatur Partikelfilter" SWORD Temp_Cels 1 100 -50.140 899.860 FORMAT "%8.3" ECU_ADDRESS 0x8FFABC /end MEASUREMENT
/begin MEASUREMENT PFlt_vVehFltAshCor_mp "gefilterter Wert Fahrzeuggeschwindigkeit" SWORD Vel 1 100 -327.6800 327.6700 FORMAT "%8.4" ECU_ADDRESS 0x8FFABE /end MEASUREMENT
/begin FUNCTION pcr_governor "Adaptiver Ladedruckregler"
 /begin DEF_CHARACTERISTIC PCR_I1AdPCVKi_C PCR_I1AdPCVKiPos_C PCR_I1AdPCVKiNeg_C PCR_rI1AdPCVWinPos_C PCR_rI1AdPCVWinNeg_C PCR_I2AdPCVKi_C PCR_I2AdPCVKiPos_C PCR_I2AdPCVKiNeg_C PCR_rI2AdPCVWinPos_C PCR_rI2AdPCVWinNeg_C PCR_I3AdPCVKi_C PCR_I3AdPCVKiPos_C PCR_I3AdPCVKiNeg_C PCR_rI3AdPCVWinPos_C PCR_rI3AdPCVWinNeg_C PCR_I4AdPCVKi_C PCR_I4AdPCVKiPos_C PCR_I4AdPCVKiNeg_C PCR_rI4AdPCVWinPos_C PCR_rI4AdPCVWinNeg_C PCR_dlyPT1_C PCR_dnAvrgAdPCVLim_C PCR_tiDnCorrDT1_C PCR_DnCorrDKd_C PCR_tiDpCorrDT1_C PCR_dpCorrDKd_C PCR_dqCtlAdPCVLim_C PCR_tiAdPCVqCtlDT1_C PCR_DKdAdPCVqCtlDT1_C PCR_drBPGovMaxDynUp_C PCR_drBPGovMaxDynDn_C PCR_DT1_C PCR_DKd_C PCR_DKdPos_C PCR_DKdNeg_C PCR_pDWinPos_C PCR_pDWinNeg_C PCR_facBPGovMaxCorr_CUR PCR_facDnCorr_CUR PCR_facDpCorr_CUR PCR_facD_MAP PCR_facI_MAP PCR_facmSotCorr_MAP PCR_facPresPFltMax_CUR PCR_facPresPFltMin_CUR PCR_facP_MAP PCR_IKi_C PCR_IKiPos_C PCR_IKiNeg_C PCR_pIWinPos_C PCR_pIWinNeg_C PCR_mskNoAdPCVVal_C PCR_mskResetVal_C PCR_mskStopLearning_C PCR_nAvrgAdPCV1_C PCR_nAvrgAdPCV2_C PCR_pBGDevAdPCVLim_C PCR_pFltValLim_C PCR_pValAdPCVMax_C PCR_pValAdPCVMin_C PCR_PKp_C PCR_PKpPos_C PCR_PKpNeg_C PCR_pPWinPos_C PCR_pPWinNeg_C PCR_qCtlAdPCV1_C PCR_qCtlAdPCV2_C PCR_rAdPCVCtlValMax_C PCR_rAdPCVCtlValMin_C PCR_rBPGovMaxCorr_MAP PCR_rBPGovMaxDynEnd_C PCR_rBPGovMaxDynStrt_C PCR_rBPGovMaxDyn_MAP PCR_rDistAdPCV1_C PCR_rDistAdPCV2_C PCR_rDistAdPCV3_C PCR_rDistAdPCV4_C PCR_rGvnrMax_CUR PCR_rGvnrMax_MAP PCR_rGvnrMin_CUR PCR_rGvnrMin_MAP PCR_rOutIMax_MAP PCR_stAdPCVReset_C PCR_swtAdPCVrLim_C PCR_swtIDevType_C PCR_swtLimMpCrVal_C PCR_swtLimMpCrType_C PCR_swtLimSelVal_C PCR_swtLimSelType_C PCR_swtRawCur_C PCR_swtRelAbsVal_C PCR_swtRelAbsType_C PCR_tAirAdPCVMax_C PCR_tAirAdPCVMin_C PCR_tClntAdPCVLim_C /end DEF_CHARACTERISTIC
 /begin IN_MEASUREMENT BPSCD_dFltValDT1 CoEng_dvolFlConsum Eng_nAvrg InjCtl_qCurr PCR_dn_mp PCR_dpBGDev_mp PCR_qReal PFlt_mSot PFlt_pPre /end IN_MEASUREMENT
/end FUNCTION
/begin FUNCTION pcr_governor_msg ""
 /begin OUT_MEASUREMENT PCR_pBGDev PCR_qReal PCR_rBPGovMax PCR_rBPGovMin PCR_rBPLim PCR_rGvnr PCR_rGvnr2 PCR_swtLimSel PCR_swtRelAbs /end OUT_MEASUREMENT
/end FUNCTION
/begin FUNCTION pcr_governor_uic ""
 /begin OUT_MEASUREMENT PCR_DKd_mp PCR_dn_mp PCR_dpBGDev_mp PCR_dqCtlAdPCV_mp PCR_facAdPCVc1_mp PCR_facAdPCVc2_mp PCR_facAdPCVc3_mp PCR_facAdPCVc4_mp PCR_facAdPCVrx_mp PCR_facAdPCVry_mp PCR_facD1_mp PCR_facDnCorr_mp PCR_facDpCorr_mp PCR_facD_mp PCR_facI_mp PCR_facmSotCorr_mp PCR_facP_mp PCR_pBDesFlt_mp PCR_pBGDev2_mp PCR_pBGDevI_mp PCR_rAdPCVCtlValLim_mp PCR_rAdPCVCtlVal_mp PCR_rAdPCVI1_mp PCR_rAdPCVI2_mp PCR_rAdPCVI3_mp PCR_rAdPCVI4_mp PCR_rBPGovMaxDynRamp_mp PCR_rBPGovMaxDyn_mp PCR_rBPGovMaxVal1_mp PCR_rBPGovMaxVal2_mp PCR_rBPGovMax_mp PCR_rBPGovMin_mp PCR_rBPGvnrUnLim1_mp PCR_rBPGvnrUnLim2_mp PCR_rBPLim_mp PCR_rInitI1AdPCV_mp PCR_rInitI2AdPCV_mp PCR_rInitI3AdPCV_mp PCR_rInitI4AdPCV_mp PCR_rOutAdPCVI1_mp PCR_rOutAdPCVI2_mp PCR_rOutAdPCVI3_mp PCR_rOutAdPCVI4_mp PCR_rOutDT1_mp PCR_rOutILim_mp PCR_rOutIMax_mp PCR_rOutI_mp PCR_rOutP_mp PCR_rPICtl_mp PCR_stAdPCVLogic_mp PCR_stAdPCVRelCond_mp PCR_stAdPCV_mp PCR_stEepAdPCV_mp PCR_stEepBlock_mp PCR_stSwtBPGovMaxDyn_mp /end OUT_MEASUREMENT
/end FUNCTION
/begin FUNCTION pcr_governor_var "" /begin DEF_CHARACTERISTIC PCR_rARWIMin_C PCR_swtARWMode_C /end DEF_CHARACTERISTIC /end FUNCTION
/begin FUNCTION pcr_governor_var_msg "" /end FUNCTION
/begin FUNCTION pcr_governor_var_uic "" /begin OUT_MEASUREMENT PCR_rPIDCtl_mp PCR_rstI_mp /end OUT_MEASUREMENT /end FUNCTION
/begin FUNCTION pcr_lpgovernor ""
 /begin DEF_CHARACTERISTIC PCR_drBPALPRmpUp_C PCR_drBPALPRmpDwn_C PCR_tiDT1LP_C PCR_DKdLP_C PCR_DKdPosLP_C PCR_DKdNegLP_C PCR_pDWinPosLP_C PCR_pDWinNegLP_C PCR_IKiLP_C PCR_IKiPosLP_C PCR_IKiNegLP_C PCR_pIWinPosLP_C PCR_pIWinNegLP_C PCR_pBDesLP_MAP PCR_pBDesMaxAPLP_MAP PCR_PKpLP_C PCR_PKpPosLP_C PCR_PKpNegLP_C PCR_pPWinPosLP_C PCR_pPWinNegLP_C PCR_rBPBasLP_MAP PCR_rBPRglBasLP_MAP PCR_rDt1InitLP_C PCR_rGovMaxLP_C PCR_rGovMinLP_C PCR_rIInitLP_C PCR_rMaxLP_C PCR_rMinLP_C /end DEF_CHARACTERISTIC
 /begin IN_MEASUREMENT APSCD_pVal Eng_nAvrg PCR_qDes /end IN_MEASUREMENT
/end FUNCTION
/begin FUNCTION pcr_lpgovernor_msg "" /begin OUT_MEASUREMENT PCR_rBPALP /end OUT_MEASUREMENT /end FUNCTION
/begin FUNCTION pcr_lpgovernor_uic ""
 /begin OUT_MEASUREMENT PCR_pBDesLP_mp PCR_pBDiffLP_mp PCR_rOutDLP_mp PCR_rOutILP_mp PCR_rOutLimLP_mp PCR_rOutLP_mp PCR_rOutPILP_mp PCR_rOutPLP_mp /end OUT_MEASUREMENT
/end FUNCTION
/begin FUNCTION pcr_monitor "Ladedruckregelung - Überwachung und Abschaltung"
 /begin DEF_CHARACTERISTIC PCR_DebSRCHighDef_C PCR_DebSRCHighOk_C PCR_DebSRCLowDef_C PCR_DebSRCLowOk_C PCR_nCoStart_C PCR_nCoStrtHigh_C PCR_nWrkSph1_C PCR_nWrkSph2_C PCR_nWrkSph3_C PCR_pBGDevMaxOffset_C PCR_pBGDevMax_C PCR_pBGDevMinOffset_C PCR_pBGDevMin_C PCR_qClutchThres_C PCR_qClutchThres_CUR PCR_qRgtOffRgn_CUR PCR_qRgtOff_CUR PCR_qRgtOnRgn_CUR PCR_qRgtOn_CUR PCR_qWrkSph2_C PCR_qWrkSph3_C PCR_rCBOpn_C PCR_rDflVal06_C PCR_rDflVal12_C PCR_rDflVal15_MAP PCR_rDflVal18_C PCR_rDflVal24_C PCR_stMonCur_C PCR_swtV8_C PCR_tiClutchDebHighLow_C PCR_tiClutchDebLowHigh_C PCR_tiCoStrt_CUR PCR_tiGvnrOffDel_CUR PCR_tiStrtDelayInit_C PCR_vClutch_C /end DEF_CHARACTERISTIC
 /begin IN_MEASUREMENT CTSCD_tClnt Eng_nAvrg PCR_qReal /end IN_MEASUREMENT
/end FUNCTION
/begin FUNCTION pcr_monitor_msg ""
 /begin OUT_MEASUREMENT PCR_rBPA PCR_rBPA2 PCR_stMonitor PCR_stPCR PCR_stWorkSph PCR_swtGvnr /end OUT_MEASUREMENT
/end FUNCTION
/begin FUNCTION pcr_monitor_uic ""
 /begin DEF_CHARACTERISTIC PCR_rBPACDAdd_Vector PCR_rBPACDAdd_Channel PCR_rBPACD_Vector PCR_rBPACD_Channel /end DEF_CHARACTERISTIC
 /begin OUT_MEASUREMENT PCR_pBGDevMax_mp PCR_pBGDevMin_mp PCR_rBPACDByp_mp PCR_stPCR_mp PCR_tiStrtDelay_mp /end OUT_MEASUREMENT
/end FUNCTION
/begin FUNCTION pcr_monitor_var "" /end FUNCTION
/begin FUNCTION pcr_monitor_var_msg "" /end FUNCTION
/begin FUNCTION pcr_monitor_var_uic "" /end FUNCTION
/begin FUNCTION pcr_surgectl "LDR-AntiSurge Regler"
 /begin DEF_CHARACTERISTIC PCR_facSurgeDes_CUR PCR_facSurgeI_MAP PCR_facSurgeP_MAP PCR_ISurgeKi_C PCR_ISurgeKiPos_C PCR_ISurgeKiNeg_C PCR_facSurgeIWinPos_C PCR_facSurgeIWinNeg_C PCR_pBSurgeDesMax_MAP PCR_pBSurgeDesMin_MAP PCR_pBSurgeDes_CUR PCR_pSurgeARWIMin_C PCR_PSurgeKp_C PCR_PSurgeKpPos_C PCR_PSurgeKpNeg_C PCR_facSurgePWinPos_C PCR_facSurgePWinNeg_C PCR_qSurgeGvnrOff_MAP PCR_qSurgeGvnrOn_MAP PCR_rSurgeGvnr_MAP PCR_tiSurgeGvnrPT1_C PCR_swtSurgeARWMode_C PCR_swtSurgeGvnrSel_C /end DEF_CHARACTERISTIC
 /begin IN_MEASUREMENT APSCD_pLinVal Eng_nAvrg InjCtl_qCurr PCR_pBSurgePICtlLim_mp /end IN_MEASUREMENT
/end FUNCTION
/begin FUNCTION pcr_surgectl_msg "" /begin OUT_MEASUREMENT PCR_pBSurgeDes PCR_rGvnrSurge PCR_swtSurgeGvnr /end OUT_MEASUREMENT /end FUNCTION
/begin FUNCTION pcr_surgectl_uic ""
 /begin OUT_MEASUREMENT PCR_facSGDevI_mp PCR_facSurgeDes_mp PCR_facSurgeGvnrDev_mp PCR_facSurgeI_mp PCR_facSurgeP_mp PCR_pBSurgeDesMax_mp PCR_pBSurgeDesMin_mp PCR_pBSurgePICtlLim_mp PCR_pBSurgePICtl_mp PCR_pSOutI_mp PCR_pSOutP_mp PCR_pSurgestI_mp PCR_swtSurgeGvnrSel_mp /end OUT_MEASUREMENT
/end FUNCTION
/begin FUNCTION pcr_surgedet "Turboladerpumpgrenzerkennung"
 /begin DEF_CHARACTERISTIC PCR_ctAirPerTimeFrq_C PCR_facAirPerTimeAmplMax_C PCR_facAirPerTimeAmplMin_C PCR_facSin_CUR PCR_facSqr_CUR PCR_tiDebSurge1_C PCR_tiDebSurge2_C PCR_tiAirPerTimeAmplFlt_C PCR_tiDelPreSurgeDet_C /end DEF_CHARACTERISTIC
 /begin IN_MEASUREMENT PCR_facSinIn_mp PCR_facSqrIn_mp /end IN_MEASUREMENT
/end FUNCTION
/begin FUNCTION pcr_surgedet_msg "" /begin OUT_MEASUREMENT PCR_facAirPerTimeAmplFlt PCR_stPreSurge PCR_stSurge /end OUT_MEASUREMENT /end FUNCTION
/begin FUNCTION pcr_surgedet_uic ""
 /begin OUT_MEASUREMENT PCR_facAirPerTimeAmpl_mp PCR_facCosCoeffDFT_mp PCR_facSinCoeffDFT_mp PCR_facSinIn_mp PCR_facSinOut_mp PCR_facSqrIn_mp /end OUT_MEASUREMENT
/end FUNCTION
/begin FUNCTION pcvcd_co "Druckregelventil Komponententreiber"
 /begin DEF_CHARACTERISTIC PCVCD_uSRCMin_C PCVCD_uSRCMax_C PCVCD_iLin_CUR PCVCD_dcycMax_C PCVCD_dcycMin_C PCVCD_dcycTst_C PCVCD_DebExcTempDef_C PCVCD_DebExcTempOk_C PCVCD_DebNoLoadDef_C PCVCD_DebNoLoadOk_C PCVCD_DebShortCircBatDef_C PCVCD_DebShortCircBatOk_C PCVCD_DebShortCircGndDef_C PCVCD_DebShortCircGndOk_C PCVCD_DebSRCHighDef_C PCVCD_DebSRCHighOk_C PCVCD_DebSRCLowDef_C PCVCD_DebSRCLowOk_C PCVCD_facIGovInit_CUR PCVCD_facIGovMax_C PCVCD_facIGovMin_C PCVCD_tiFlt1PT1_C PCVCD_tiFlt2PT1_C PCVCD_tiIGovDT1_C PCVCD_IGovDKd_C PCVCD_IGovIKi_C PCVCD_IGovIKiPos_C PCVCD_IGovIKiNeg_C PCVCD_iIGovIWinPos_C PCVCD_iIGovIWinNeg_C PCVCD_tiFltPT1Init_C PCVCD_numAdc_C PCVCD_numDia1_C PCVCD_numDia2_C PCVCD_numPwmOut_C PCVCD_stInvOut_C PCVCD_tiPer_C PCVCD_resCoil_C PCVCD_stPwrStgDia_C PCVCD_swtCtlStateVal_C PCVCD_swtCtlStateType_C PCVCD_swt_C PCVCD_tiBtwTst_C PCVCD_tiIGovInit_C PCVCD_tiDebSigDefSigTst_C PCVCD_tiDebSigOkSigTst_C /end DEF_CHARACTERISTIC
 /begin IN_MEASUREMENT FlSys_t PCVCD_uRawVal_mp /end IN_MEASUREMENT
/end FUNCTION
/begin FUNCTION pcvcd_co_msg "" /begin OUT_MEASUREMENT PCVCD_iActVal PCVCD_swtCtlState /end OUT_MEASUREMENT /end FUNCTION
/begin FUNCTION pcvcd_co_uic ""
 /begin OUT_MEASUREMENT PCVCD_dcycDT1_mp PCVCD_dcycOut_mp PCVCD_dcycSetVal_mp PCVCD_facIGov_mp PCVCD_iActFlt_mp PCVCD_iDvt_mp PCVCD_iGovActVal_mp PCVCD_iSetFlt_mp PCVCD_uRawVal_mp /end OUT_MEASUREMENT
/end FUNCTION
/begin FUNCTION pcv_leak "Leckage des Druckregelventils" /begin DEF_CHARACTERISTIC PCV_dvolLeak_CUR /end DEF_CHARACTERISTIC /begin IN_MEASUREMENT Rail_pSetPoint /end IN_MEASUREMENT /end FUNCTION
/begin FUNCTION pcv_leak_uic "" /begin OUT_MEASUREMENT PCV_dvolLeak_mp /end OUT_MEASUREMENT /end FUNCTION
/begin FUNCTION pcv_msg "" /end FUNCTION
/begin FUNCTION pcv_setcurr "Berechnung elektrischer Sollstrom für das Druckregelventil" /begin DEF_CHARACTERISTIC PCV_iCnvPress_CUR PCV_iSetMin_C /end DEF_CHARACTERISTIC /begin IN_MEASUREMENT Rail_pPCVSet /end IN_MEASUREMENT /end FUNCTION
/begin FUNCTION pcv_setcurr_uic "" /begin DEF_CHARACTERISTIC PCV_iSet_Vector PCV_iSet_Channel /end DEF_CHARACTERISTIC /begin OUT_MEASUREMENT PCV_iSet_mp PCV_stActrCtl_mp /end OUT_MEASUREMENT /end FUNCTION
/begin FUNCTION pfltcd_getppre "Absolutdruck vor dem Partikelfilter"
 /begin DEF_CHARACTERISTIC PFltCD_uSRCMinPPre_C PFltCD_uSRCMaxPPre_C PFltCD_pLinPre_CUR PFltCD_DebSRCHiDefPPre_C PFltCD_DebSRCHiOkPPre_C PFltCD_DebSRCLoDefPPre_C PFltCD_DebSRCLoOkPPre_C PFltCD_dtRmpSlpUpPPre_C PFltCD_dtRmpSlpDwnPPre_C PFLTCD_numAdc2_C PFltCD_tiPPrePT1_C PFltCD_stSensIDWordPPre_C PFltCD_pDflPre_C /end DEF_CHARACTERISTIC
 /begin IN_MEASUREMENT PFltCD_uRawPresPre_mp /end IN_MEASUREMENT
/end FUNCTION
/begin FUNCTION pfltcd_getppre_msg "" /begin OUT_MEASUREMENT PFltCD_pLinPre PFltCD_pPre /end OUT_MEASUREMENT /end FUNCTION
/begin FUNCTION pfltcd_getppre_uic "" /begin OUT_MEASUREMENT PFltCD_uRawPresPre_mp /end OUT_MEASUREMENT /end FUNCTION
/begin FUNCTION pfltcd_gettpre "Abgastemperatur vor dem Partikelfilter"
 /begin DEF_CHARACTERISTIC PFltCD_uSRCMinTempPre_C PFltCD_uSRCMaxTempPre_C PFltCD_tLinPre_CUR PFltCD_DebSRCHighDefTPre_C PFltCD_DebSRCHighOkTPre_C PFltCD_DebSRCLowDefTPre_C PFltCD_DebSRCLowOkTPre_C PFltCD_dtRmpSlpUpPre_C PFltCD_dtRmpSlpDwnPre_C PFLTCD_numAdc_C PFltCD_stSensIDWordTPre_C PFltCD_tDflPre_C /end DEF_CHARACTERISTIC
 /begin IN_MEASUREMENT PFltCD_uRawTempPre /end IN_MEASUREMENT
/end FUNCTION
/begin FUNCTION pfltcd_gettpre_msg "" /begin OUT_MEASUREMENT PFltCD_tLinPre PFltCD_tPre PFltCD_uRawTempPre /end OUT_MEASUREMENT /end FUNCTION
/begin FUNCTION pflt_ashcor ""
 /begin DEF_CHARACTERISTIC PFlt_aVehFltAshCorMax_C PFlt_aVehFltAshCorMin_C PFlt_ctAshCorRgnMax_C PFlt_ctAshCorRgn_C PFlt_facAshCorOld_C PFlt_facAshOil_C PFlt_facFlTotCor_C PFlt_faclAshCor_C PFlt_lAshCorMax_C PFlt_lAshCorNextDef_C PFlt_lAshCorNplAbsRel_C PFlt_lAshCorNplAbs_C PFlt_lAshCorNplRel_C PFlt_lAshCorRegIntr_C PFlt_lMinSnceRgn_C PFlt_mAshCor_MAP PFlt_mAshTolcMaxAbs_C PFlt_mAshTolcMaxRel_C PFlt_nAvrgFltAshCorMax_C PFlt_nAvrgFltAshCorMin_C PFlt_numAshCorMsk_C PFlt_numAshCor_C PFlt_qFlTotMin_C PFlt_qSetUnBalFltAshCorMax_C PFlt_qSetUnBalFltAshCorMin_C PFlt_swtAshCorActive_C PFlt_swtAshCorOn_C PFlt_tAirFltAshCorMax_C PFlt_tAirFltAshCorMin_C PFlt_tCIntAshCorMax_C PFlt_tCIntAshCorMin_C PFlt_tiAshCorAirTempPT1_C PFlt_tiAshCorCIntTempPT1_C PFlt_tiAshCorDVolPT1_C PFlt_tiAshCorEngSpdPT1_C PFlt_tiAshCorInjMsPT1_C PFlt_tiAshCorOxiTempPT1_C PFlt_tiAshCorPreTempPT1_C PFlt_tiAshCorResFlowPT1_C PFlt_tiAshCorRlsOn_C PFlt_tiAshCorVehAccPT1_C PFlt_tiAshCorVehSpdPT1_C PFlt_tiAshCorWaitMax_C PFlt_tOxiPreFltAshCorMax_C PFlt_tOxiPreFltAshCorMin_C PFlt_tPreFltAshCorMax_C PFlt_tPreFltAshCorMin_C PFlt_vVehFltAshCorMax_C PFlt_vVehFltAshCorMin_C /end DEF_CHARACTERISTIC
 /begin IN_MEASUREMENT PFlt_dVolFltAshCor_mp PFlt_resFlowFltAshCor_mp /end IN_MEASUREMENT
/end FUNCTION
/begin FUNCTION pflt_ashcor_msg ""
 /begin OUT_MEASUREMENT PFlt_lAshCorNext PFlt_mAshCorAct PFlt_mAshCorNew PFlt_mAshCorOld PFlt_numAshCor PFlt_qFlTotCor PFlt_swtAshOilCor /end OUT_MEASUREMENT
/end FUNCTION
/begin FUNCTION pflt_ashcor_uic ""
 /begin OUT_MEASUREMENT PFlt_aVehFltAshCor_mp PFlt_ctNumAshCorMax_mp PFlt_ctNumAshCor_mp PFlt_dVolFltAshCorRaw_mp PFlt_dVolFltAshCor_mp PFlt_lAshCorAct_mp PFlt_lAshCorNextEEProm_mp PFlt_lAshCorNextMax_mp PFlt_lAshCorNextOilCor_mp PFlt_lAshCorOldCalc_mp PFlt_lAshCorStep_mp PFlt_mAshCorActRel_mp PFlt_mAshCorDiff1_mp PFlt_mAshCorDiff_mp PFlt_nAvrgFltAshCor_mp PFlt_qSetUnBalFltAshCor_mp PFlt_resFlowFltAshCorRaw_mp PFlt_resFlowFltAshCor_mp PFlt_stAshCorCalc_mp PFlt_stAshCorDist_mp PFlt_stAshCorRgnMax_mp PFlt_stAshCorRgn_mp PFlt_stAshCorRlsOn_mp PFlt_stAshCorRls_mp PFlt_stAshCor_mp PFlt_stFlTotCorOn_mp PFlt_stFlTotCor_mp PFlt_tAirFltAshCor_mp PFlt_tCIntFltAshCor_mp PFlt_tOxiPreFltAshCor_mp PFlt_tPreFltAshCor_mp PFlt_vVehFltAshCor_mp /end OUT_MEASUREMENT
/end FUNCTION
/begin FUNCTION pflt_corgn "Partikelfilterregenerationskoordinator"
 /begin DEF_CHARACTERISTIC PFlt_lSumMaxDef_C PFlt_lSumMax_C PFlt_lSumSubs_C PFlt_mSotMeas_CUR PFlt_mSotNewRng1_C PFlt_mSotRng1New_C PFlt_mSotRng1Rng2_C PFlt_mSotRng2Rng1_C PFlt_mSotRng2Rng3_C PFlt_mSotRng3Rng2_C PFlt_mSotRng3Rng4_C PFlt_mSotRng4Rng3_C PFlt_mSotRng4Rng5_C PFlt_mSotRng5Rng4_C PFlt_numEngPOpDel_CA PFlt_numEngPOp_CA PFlt_numLst_C PFlt_numPrioRgnStg1_C PFlt_numPrioRgnStg2_C PFlt_numPrioRgnStg3_C PFlt_numPrioRgnStg4_C PFlt_numPrioRgnStg5_C PFlt_numPrioRgnStg6_C PFlt_numPrioRgnStgDiag_C PFlt_numPrt_C PFlt_numRgnSuc_C PFlt_pEngPrtMaxInit_C PFlt_pEngPrtMax_MAP PFlt_pEngPrtMin_MAP PFlt_qFlMaxDef_C PFlt_qFlMax_C PFlt_qFlSubs_C PFlt_qFlTotAdjMax_C PFlt_stDiagOn_C PFlt_stLckFuelMsk_C PFlt_stLckRgnMsk_C PFlt_stRgnActvMsk_C PFlt_stRgnStg1_C PFlt_stRgnStg2_C PFlt_stRgnStg3_C PFlt_stRgnStg4_C PFlt_stRgnStg5_C PFlt_stRgnStg6_C PFlt_swtDiagOn_C PFlt_swtOfsCor_C PFlt_swtServiceVal_C PFlt_swtTmrLckRst_C PFlt_tiDebLck_C PFlt_tiDebQLimErrIntr_C PFlt_tiDebTrqOvhtIntr_C PFlt_tiEngOnMaxDef_C PFlt_tiEngOnMax_C PFlt_tiEngPrtPT1_C PFlt_tiEngPrt_C PFlt_tiLckRgnErr_CA PFlt_tiLckRgn_CA PFlt_tiLckSubs_C PFlt_tiLstRgn_C PFlt_tiOpSubs_C PFlt_tiRgnMax_CA PFlt_tiRgnSpo_C PFlt_tOxiPreMaxHi_C PFlt_tOxiPreMaxLo_C PFlt_tPreMaxHi_C PFlt_tPreMaxLo_C PFlt_volFlConsumSubs_C PFlt_volFuelFilMinHi_C PFlt_volFuelFilMinLo_C /end DEF_CHARACTERISTIC
 /begin IN_MEASUREMENT Eng_nAvrg InjCtl_qSetUnBal PFlt_numRgn_mp PFlt_resFlowOfs PFlt_stEngPOp /end IN_MEASUREMENT
/end FUNCTION
/begin FUNCTION pflt_corgn_msg ""
 /begin OUT_MEASUREMENT PFlt_lSnceRgn PFlt_numEngPOp PFlt_numPrio PFlt_qFlTot PFlt_st PFlt_stDiagOn PFlt_stEngPrtActv PFlt_stLck PFlt_stSuc /end OUT_MEASUREMENT
/end FUNCTION
/begin FUNCTION pflt_corgn_uic "" /begin DEF_CHARACTERISTIC PFlt_st_Vector PFlt_st_Channel /end DEF_CHARACTERISTIC
 /begin OUT_MEASUREMENT PFlt_lSnceRgnu16_mp PFlt_lSnceRgn_mp PFlt_lSumu16_mp PFlt_lSum_mp PFlt_mSotOfs_mp PFlt_numLst_mp PFlt_numPrt_mp PFlt_numRgn_mp PFlt_numSot_mp PFlt_numTot_mp PFlt_pEngPrtMax_mp PFlt_pEngPrtMin_mp PFlt_qFlTotEEPROM_mp PFlt_qFl_mp PFlt_resSotMeasCrv_mp PFlt_st1_mp PFlt_st2_mp PFlt_stCnt_mp PFlt_stIntr_mp PFlt_stLckFuel_mp PFlt_stLck_mp PFlt_stLstRgnEnd_mp PFlt_stLstRgn_mp PFlt_stNumEngPOpDelOn_mp PFlt_stSuc_mp PFlt_tiLckRls_mp PFlt_tiOpu16_mp PFlt_tiOp_mp PFlt_tiRgnMax_mp PFlt_tiSnceRgnu16_mp PFlt_tiSnceRgn_mp /end OUT_MEASUREMENT
/end FUNCTION
/begin FUNCTION pflt_diag "Diagnose für den Partikelfilter"
 /begin DEF_CHARACTERISTIC PFlt_mDiagAFSMax_C PFlt_mDiagAFSMin_C PFlt_mDiagSotMax_C PFlt_mDiagSotMin_C PFlt_nDiagLowIdle1_C PFlt_nDiagLowIdle2_C PFlt_nDiagLowIdle_C PFlt_nDiagMax_C PFlt_nDiagMin_C PFlt_nDiagRgnMax_C PFlt_nDiagRgnMin_C PFlt_pAPSDiag_C PFlt_pDiagBPSMax_C PFlt_pDiagBPSMin_C PFlt_qDiagPOpMax_CUR PFlt_qDiagPOpMin_CUR PFlt_rDiagAccPedMax_C PFlt_rDiagTVAMax_C PFlt_rDiagTVAMin_C PFlt_stDiagAbortMsk_C PFlt_stDiagMskRgnAbort_C PFlt_stDiagMskTst10_C PFlt_stDiagMskTst1_C PFlt_stDiagMskTst2_C PFlt_stDiagMskTst3_C PFlt_stDiagMskTst4_C PFlt_stDiagMskTst5_C PFlt_stDiagMskTst6_C PFlt_stDiagMskTst7_C PFlt_stDiagMskTst8_C PFlt_stDiagMskTst9_C PFlt_stDiagMsk_C PFlt_stDiagRgnMsk_C PFlt_stRgnDiagStg1_C PFlt_stRgnDiagStg2_C PFlt_stRgnDiagStg3_C PFlt_tDiagDpfAbrtMax_C PFlt_tDiagDpfCoolDwn_C PFlt_tDiagDpfHeatup_C PFlt_tDiagDpfMax_C PFlt_tDiagDpfPreRgnMin_C PFlt_tDiagOxiAbrtMax_C PFlt_tDiagOxiCoolDwn_C PFlt_tDiagOxiHeatup_C PFlt_tDiagOxiMax_C PFlt_tDiagOxiMin_C PFlt_tDiagOxiPreMax_C PFlt_tDiagOxiPreRgnMin_C PFlt_tDiagPFltMax_C PFlt_tDiagPFltMin_C PFlt_tEngDiagMinH_C PFlt_tEngDiagMinL_C PFlt_tFltDiagMax_C PFlt_tiDiagCoolDwnMax_C PFlt_tiDiagDpfMax_C PFlt_tiDiagNormal_C PFlt_tiDiagOxiMax_C PFlt_tiDiagRgnEnd_C PFlt_tiDiagRgnHeatup_C PFlt_tiDiagRgnLidIMin_C PFlt_tiGetRgnSt_C PFlt_tiStpRgn_C PFlt_tOilDiagMinH_C PFlt_tOilDiagMinL_C PFlt_uDiagMin_C /end DEF_CHARACTERISTIC
 /begin IN_MEASUREMENT Eng_nAvrg /end IN_MEASUREMENT
/end FUNCTION
/begin FUNCTION pflt_diag_msg ""
 /begin OUT_MEASUREMENT PFlt_nDiagLowIdle PFlt_stDiag PFlt_stDiagAbort PFlt_stDiagAbortMsk PFlt_stDiagDemOn PFlt_stDiagMsk PFlt_stDiagRgn PFlt_stDiagRgnMsk PFlt_stDiagRls PFlt_stDiagState PFlt_stDiagSuc /end OUT_MEASUREMENT
/end FUNCTION
/begin FUNCTION pflt_diag_uic ""
 /begin OUT_MEASUREMENT PFlt_stDiagAbrt1_mp PFlt_stDiagAbrt2_mp PFlt_stDiagCoolDwn_mp PFlt_stDiagEnd_mp PFlt_stDiagRgn_mp PFlt_stDiagRls_mp /end OUT_MEASUREMENT
/end FUNCTION
/begin COMPU_METHOD Acc "Fahrzeugbeschleunigung" RAT_FUNC "%6.5" "m/s^2" COEFFS 0 1000 0 0 0 1 /end COMPU_METHOD
/begin COMPU_METHOD AirMassPerCyl "Luftmasse pro Zylinder" RAT_FUNC "%6.3" "mg/Hub" COEFFS 0 10 0 0 0 1 /end COMPU_METHOD
/begin COMPU_METHOD CubMtrPerHr "Volumsstrom in m^3/h" RAT_FUNC "%6.3" "m^3/h" COEFFS 0 10 0 0 0 1 /end COMPU_METHOD
/begin COMPU_METHOD Curr "Strom" RAT_FUNC "%6.2" "mA" COEFFS 0 1 0 0 0 1 /end COMPU_METHOD
/begin COMPU_METHOD dn_dZ20 "Motorbeschleunigung pro Zeit (dn/dt) (im 20 ms Raster)" RAT_FUNC "%6.1" "rmp/s" COEFFS 0 0.1 0 0 0 1 /end COMPU_METHOD
/begin COMPU_METHOD dp_dZ10 "boost pressure per time (dp/dt) every 10ms" RAT_FUNC "%6.1" "hPa/s" COEFFS 0 0.1 0 0 0 1 /end COMPU_METHOD
/begin COMPU_METHOD dp_dZ20 " boost pressure per time (dp/dt) every 20ms" RAT_FUNC "%6.1" "hPa/s" COEFFS 0 0.1 0 0 0 1 /end COMPU_METHOD
/begin COMPU_METHOD DtyCyc "Tastverhaeltnis" RAT_FUNC "%6.4" "%" COEFFS 0 100 0 0 0 1 /end COMPU_METHOD
/begin COMPU_METHOD EngN "Motordrehzahl" RAT_FUNC "%6.2" "rpm" COEFFS 0 1 0 0 0 1 /end COMPU_METHOD
/begin COMPU_METHOD Fact "Faktor mit Auflösung 1 / 8192, hauptsächlich für einen Faktorenbereich 0...1 verwendet" RAT_FUNC "%6.5" "-" COEFFS 0 8192 0 0 0 1 /end COMPU_METHOD
/begin COMPU_METHOD Fact1 "Faktor mit Auflösung 0,01 (100 mal höherer Bereich als Fact)" RAT_FUNC "%6.4" "-" COEFFS 0 128 0 0 0 1 /end COMPU_METHOD
/begin COMPU_METHOD FactM "Low resolution factor for airmass" RAT_FUNC "%6.4" "-" COEFFS 0 16 0 0 0 1 /end COMPU_METHOD
/begin COMPU_METHOD FlConsum_l_h "Kraftstoffverbrauch" RAT_FUNC "%6.4" "l/h" COEFFS 0 100 0 0 0 1 /end COMPU_METHOD
/begin COMPU_METHOD Fl_2 "Umrechnung for getting 16 bit  total fuel consumption" RAT_FUNC "%6.1" "l" COEFFS 0 0.1 0 0 0 1 /end COMPU_METHOD
/begin COMPU_METHOD Fl_Half_L "Kraftstoffverbrauchsintegral" RAT_FUNC "%6.4" "l" COEFFS 0 20 0 0 0 1 /end COMPU_METHOD
/begin COMPU_METHOD Fl_L "Treibstoffmenge [l]" RAT_FUNC "%6.4" "l" COEFFS 0 100 0 0 0 1 /end COMPU_METHOD
/begin COMPU_METHOD Fl_Vol "Kraftstoffverbrauch pro 100 km" RAT_FUNC "%6.5" "l/100km" COEFFS 0 1000 0 0 0 1 /end COMPU_METHOD
/begin COMPU_METHOD InjMass "Einspritzmenge" RAT_FUNC "%6.4" "mg/hub" COEFFS 0 100 0 0 0 1 /end COMPU_METHOD
/begin COMPU_METHOD InjMassCyc "Einspritzmenge pro Zyklus (mg/Zyklus)" RAT_FUNC "%6.4" "mg/cyc" COEFFS 0 100 0 0 0 1 /end COMPU_METHOD
/begin COMPU_METHOD InjMassPerSec_20ms "Einspritzmengenänderung pro Sekunde für 20ms-Tasks" RAT_FUNC "%6.3" "mg/hub/s" COEFFS 0 2 0 0 0 1 /end COMPU_METHOD
/begin COMPU_METHOD Kd "Differentialverstärkung Kd (gleiche Einheit/Umrechnungsformel an Ein- und Ausgang)" RAT_FUNC "%7.6" "1/1" COEFFS 0 65536 0 0 0 1 /end COMPU_METHOD
/begin COMPU_METHOD Kd_Pres2dpdt "differential gain(boost pressure to rate of change of boost pressure)" RAT_FUNC "%8.7" "hPa/sec/hPa" COEFFS 0 131072 0 0 0 1 /end COMPU_METHOD
/begin COMPU_METHOD Kd_Pres2Prc "Differentialverstärkung Kd (Druck Pres zu Prozent Prc)" RAT_FUNC "%9.8" "%/hPa" COEFFS 0 5368709.120000 0 0 0 1 /end COMPU_METHOD
/begin COMPU_METHOD Kd_Pres_hPa2Prc "Differentialverstärkung Kd (Druck Pres_hPa zu Prozent Prc)" RAT_FUNC "%9.8" "%/hPa" COEFFS 0 5368709.12 0 0 0 1 /end COMPU_METHOD
/begin COMPU_METHOD Kd_rpm2dndt "differential gain(engine speed to rate of change of engine speed)" RAT_FUNC "%8.7" "rmp/sec/rpm" COEFFS 0 131072 0 0 0 1 /end COMPU_METHOD
/begin COMPU_METHOD Ki "Integrale Verstärkung Ki (gleiche Einheit/Umrechnungsregel an Ein- und Ausgang)" RAT_FUNC "%6.5" "1/s" COEFFS 0 4294.967296 0 0 0 1 /end COMPU_METHOD
/begin COMPU_METHOD Ki_curr2fact "Integralverstärkung (Strom Curr zu Faktor Fact)" RAT_FUNC "%10.9" "1/mA*s" COEFFS 0 35184372.088832 0 0 0 1 /end COMPU_METHOD
/begin COMPU_METHOD Ki_Pres_fac2hPa "Gain Conversion from Factor to Hpa" RAT_FUNC "%6.4" "hPa/s" COEFFS 0 268.435456 0 0 0 1 /end COMPU_METHOD
/begin COMPU_METHOD Ki_Pres_hPa2Prc "Integralverstärkung (Druck Pres_hPa zu Prozent Prc)" RAT_FUNC "%8.7" "%/(hPa*s)" COEFFS 0 351843.72088832 0 0 0 1 /end COMPU_METHOD
/begin COMPU_METHOD Kp_Pres_fac2hPa "Gain Conversion from Factor to Hpa" RAT_FUNC "%6.5" "hPa" COEFFS 0 4096 0 0 0 1 /end COMPU_METHOD
/begin COMPU_METHOD Kp_Pres_hPa2Prc "Proportionale Verstärkung (Druck Pres_hPa zu Prozent Prc)" RAT_FUNC "%9.8" "%/hPa" COEFFS 0 5368709.12 0 0 0 1 /end COMPU_METHOD
/begin COMPU_METHOD Length "Länge in Meter" RAT_FUNC "%6.2" "m" COEFFS 0 1 0 0 0 1 /end COMPU_METHOD
/begin COMPU_METHOD LengthKm "Länge in Kilometer" RAT_FUNC "%6.2" "km" COEFFS 0 1 0 0 0 1 /end COMPU_METHOD
/begin COMPU_METHOD lSnceRgnRes "Driven distance since last successful regeneration" RAT_FUNC "%6.0" "m" COEFFS 0 0.0078125 0 0 0 1 /end COMPU_METHOD
/begin COMPU_METHOD lSumRes "Total driven distance" RAT_FUNC "%8.0" "m" COEFFS 0 6.103515625e-05 0 0 0 1 /end COMPU_METHOD
/begin COMPU_METHOD mSoot_g "Rußmasse [g]" RAT_FUNC "%6.4" "g" COEFFS 0 100 0 0 0 1 /end COMPU_METHOD
/begin COMPU_METHOD NumPinAdc "verbale Umrechnung für ADC Signale" TAB_VERB "%6.3" "-" COMPU_TAB_REF NumPinAdc /end COMPU_METHOD
/begin COMPU_VTAB NumPinAdc "verbale Umrechnung für ADC Signale" TAB_VERB 45 0 "Water_Temperature_Sensor_182" 1 "Intake_Air_Temperature_Sensor_157" 2 "Charge_Air_Temperature_Sensor_183" 3 "Exhaust_Temperature_Sensor_2_134" 4 "Exhaust_Temperature_Sensor_1_158" 5 "1st_APP_Sensor_252" 6 "2nd_APP_Sensor_239" 7 "ADC_REF" 8 "Boost_Pressure_Sensor_154" 9 "Atmospheric_Pressure_Sensor" 10 "Battery_Voltage_Sensor" 11 "Rail_Pressure_Sensor_156" 12 "Rail_Pressure_Peak_Value_156" 13 "Booster_Voltage_Sensor" 14 "Current_MeUn_Sensor" 15 "Current_PCV_Sensor" 16 "Voltage_Bank_1" 17 "Voltage_Bank_2" 18 "Pressure_Upstream_Particle_Filter_159" 19 "Engine_Oil_Pressure_110" 20 "Temperature_ECU_PCB" 21 "Voltage_Lambda_Ua" 22 "Voltage_Lambda_Ri" 23 "ADC_DUMMY_A_NOT_USED" 24 "ADC_DUMMY_NOT_USED" 25 "Charge_Actuator_Event_0" 26 "Voltage_Piezo_Actuator_Bank_2_Event_0" 27 "Voltage_Piezo_Actuator_Bank_1_Event_0" 28 "Charge_Actuator_Event_1" 29 "Voltage_Piezo_Actuator_Bank_2_Event_1" 30 "Voltage_Piezo_Actuator_Bank_1_Event_1" 31 "Charge_Actuator_Event_2" 32 "Voltage_Piezo_Actuator_Bank_2_Event_2" 33 "Voltage_Piezo_Actuator_Bank_1_Event_2" 34 "Charge_Actuator_Event_3" 35 "Voltage_Piezo_Actuator_Bank_2_Event_3" 36 "Voltage_Piezo_Actuator_Bank_1_Event_3" 37 "Charge_Actuator_Event_4" 38 "Voltage_Piezo_Actuator_Bank_2_Event_4" 39 "Voltage_Piezo_Actuator_Bank_1_Event_4" 40 "Charge_Actuator_Event_5" 41 "Voltage_Piezo_Actuator_Bank_2_Event_5" 42 "Voltage_Piezo_Actuator_Bank_1_Event_5" 43 "Booster_Voltage_Piezo" 44 "Piezo_Voltage" /end COMPU_VTAB
/begin COMPU_METHOD NumPinDia "Verbale Umrechnung für Diagnose Signale" TAB_VERB "%6.3" "-" COMPU_TAB_REF NumPinDia /end COMPU_METHOD
/begin COMPU_VTAB NumPinDia "Verbale Umrechnung für Diagnose Signale" TAB_VERB 35 0 "CJ945_Diagnostic_Signal" 1 "AC_Compressor_DiaSig" 2 "Fuel_Pump_DiaSig" 3 "Starter_234" 4 "Oil_Pressure_Lamp_Switch_245" 5 "Engine_Bay_Air_Flaps_123" 6 "Glow_Relay_Diagnostic_Signal1" 7 "reserved Glow_Relay_Diagnostic_Signal2" 8 "Ebox_Fan_Actuator_Diagnostic_Signal_219" 9 "Shuttr_Actuator_Diagnostic_Signal_231" 10 "Twostage_TurboLoading_SW_DiaSig" 11 "DIO_OUT_DIAGNOSTIC_DUMMY_NOT_USED" 12 "1st_Pressure_Control_Valve_Diagnostic_Signal_172" 13 "2nd_Pressure_Control_Valve_Diagnostic_Signal_172" 14 "1st_Metering_Unit_Diagnostic_Signal_171" 15 "2nd_Metering_Unit_Diagnostic_Signal_171" 16 "Boost_Pressure_Actuator_Diagnostic_Signal_193" 17 "Boost_Pressure_Actuator_Diagnostic_Signal_193_2" 18 "EGR_Actuator_Diagnostic_Signal_194" 19 "EGR_Actuator_Diagnostic_Signal2" 20 "Variable_Swirl_Actuator_Diagnostic_Signal_195" 21 "Throttle_Valve_Diagnostic_Signal_196" 22 "Throttle_Valve2_Diagnostic_Signal_196" 23 "FAN_240" 24 "Add_On_Heater_244" 25 "EngM_Bearing_Actuator_Diagnostic_Signal_124" 26 "EngM_Bearing_Actuator_Diagnostic_Signal_121" 27 "Low pressure stage BPA_Diagnostic_Signal_117" 28 "PWM_DIAGNOSTIC_DUMMY_NOT_USED" 29 "1st_Sensor_Supply_Voltage_DiaSig" 30 "2nd_Sensor_Supply_Voltage_DiaSig" 31 "3rd_Sensor_Supply_Voltage_DiaSig" 32 "4th_Sensor_Supply_Voltage_DiaSig" 33 "5th_Sensor_Supply_Voltage_DiaSig" 34 "6th_Sensor_Supply_Voltage_DiaSig" /end COMPU_VTAB
/begin COMPU_METHOD NumPinPwmOut "Verbale Umrechnung für PWM-Ausgang Signale" TAB_VERB "%6.3" "-" COMPU_TAB_REF NumPinPwmOut /end COMPU_METHOD
/begin COMPU_VTAB NumPinPwmOut "Verbale Umrechnung für PWM-Ausgang Signale" TAB_VERB 13 0 "Boost_Pressure_Actuator_193" 1 "EGR_Actuator_194" 2 "PCV_Actuator_172" 3 "MeUn_Actuator_171" 4 "Variable_Swirl_Actuator_195" 5 "Fan_Actuator_240" 6 "Add_On_Heater_244" 7 "EngM_Bearing_Actuator_124" 8 "EngM_Bearing_Actuator_121" 9 "Throttle Valve" 10 "LSU_Heater_PWMOutput" 11 "Low pressure stage BPA_117" 12 "PWM_DUMMY_NOT_USED" /end COMPU_VTAB
/begin COMPU_METHOD OneToOne "eins zu eins (physikalischer Wert ist gleich dem internen Wert)" RAT_FUNC "%6.2" "-" COEFFS 0 1 0 0 0 1 /end COMPU_METHOD
/begin COMPU_METHOD Period "Periodendauer" RAT_FUNC "%6.3" "ms" COEFFS 0 10 0 0 0 1 /end COMPU_METHOD
/begin COMPU_METHOD Prc "Prozent, gleiche interne Auflösung wie Fact, aber Darstellung in Prozent (0...100%)" RAT_FUNC "%6.4" "%" COEFFS 0 81.92 0 0 0 1 /end COMPU_METHOD
/begin COMPU_METHOD Pres "Druck (angezeigt in [kPa])" RAT_FUNC "%7.2" "hPa" COEFFS 0 1.000000 0 0 0 1 /end COMPU_METHOD
/begin COMPU_METHOD Pres_hPa "Druck (angezeigt in [hPa])" RAT_FUNC "%6.2" "hPa" COEFFS 0 1 0 0 0 1 /end COMPU_METHOD
/begin COMPU_METHOD Pres_Rail "Raildruck in hPa" RAT_FUNC "%4.3" "bar" COEFFS 0 10.000000 0 0 0 1 /end COMPU_METHOD
/begin COMPU_METHOD Qp_mm3_sec "Umrechnung für Volumenstrom" RAT_FUNC "%6.1" "mm3/s" COEFFS 0 0.1 0 0 0 1 /end COMPU_METHOD
/begin COMPU_METHOD Resist_1 "1. Widerstandsvariante" RAT_FUNC "%6.2" "mOhm" COEFFS 0 1 0 0 0 1 /end COMPU_METHOD
/begin COMPU_METHOD Res_hPaHrPerCM "Strömungswiderstand [hPa h/m3]" RAT_FUNC "%6.5" "hPa/(m^3/h)" COEFFS 0 1000 0 0 0 1 /end COMPU_METHOD
/begin COMPU_METHOD RmpPrc "Prozent Rampengradient" RAT_FUNC "%6.5" "%/s" COEFFS 0 5368.70912 0 0 0 1 /end COMPU_METHOD
/begin COMPU_METHOD RmpPres "Rampengradient für Druck" RAT_FUNC "%7.3" "hPa/s" COEFFS 0 65.536000 0 0 0 1 /end COMPU_METHOD
/begin COMPU_METHOD RmpTemp "Rampengradient für Temperatur" RAT_FUNC "%6.4" "deg C/s" COEFFS 0 655.36 0 0 0 1 /end COMPU_METHOD
/begin COMPU_METHOD Temp_Cels "Temperatur dargestellt in °C (gleiche interne Darstellung wie Temp_Kelv)" RAT_FUNC "%6.1" "deg C" COEFFS 0 10 2731.4 0 0 1 /end COMPU_METHOD
/begin COMPU_METHOD Temp_Fahr "Temperatur dargestellt in Fahrenheit (gleiche interne Darstellung wie Temp_Kelv)" RAT_FUNC "%6.1" "deg F" COEFFS 0 5.55555555555556 2553.62222222222 0 0 1 /end COMPU_METHOD
/begin COMPU_METHOD TimeDeb "Entprellzeit in Millisekunden für Libraryfunktion Debounce" RAT_FUNC "%6.1" "ms" COEFFS 0 0.1 0 0 0 1 /end COMPU_METHOD
/begin COMPU_METHOD TimeDelay_ms "Zeitkonstante T1 fuer die Bibliotheksfunktionen PT1, DT1, etc.,  in ms angegeben" RAT_FUNC "%9.0" "ms" COEFFS 0 0 1 0 2.3283064365387e-07 0 /end COMPU_METHOD
/begin COMPU_METHOD TimeDelay_s "Zeitkonstante T1 (in s) für PT1, DT1, etc." RAT_FUNC "%9.3" "s" COEFFS 0 0 1 0 0.00023283064365387 0 /end COMPU_METHOD
/begin COMPU_METHOD TimeEngOn "Motorbetriebszeit in Sekunden" RAT_FUNC "%6.2" "s" COEFFS 0 1 0 0 0 1 /end COMPU_METHOD
/begin COMPU_METHOD Time_ms "Zeit in ms für Fehlerentprellung (DSM) und SW-Timer" RAT_FUNC "%6.1" "ms" COEFFS 0 0.1 0 0 0 1 /end COMPU_METHOD
/begin COMPU_METHOD Time_s "Zeit in s für Fehlerentprellung (DSM) und SW-Timer" RAT_FUNC "%6.4" "s" COEFFS 0 100 0 0 0 1 /end COMPU_METHOD
/begin COMPU_METHOD tiOpRes "Engine operation time" RAT_FUNC "%6.1" "s" COEFFS 0 0.015625 0 0 0 1 /end COMPU_METHOD
/begin COMPU_METHOD tiSncergnRes "Engine operation time since last successful regeneration" RAT_FUNC "%6.0" "s" COEFFS 0 0.00390625 0 0 0 1 /end COMPU_METHOD
/begin COMPU_METHOD Vel "Fahrzeuggeschwindigkeit, gleiche interne Auflösung wie Vel_SI" RAT_FUNC "%6.4" "km/h" COEFFS 0 100 0 0 0 1 /end COMPU_METHOD
/begin COMPU_METHOD Volt "Spannung in V (von ADC)" RAT_FUNC "%6.2" "mV" COEFFS 0 0.2046 0 0 0 1 /end COMPU_METHOD
/begin COMPU_METHOD Volt_Batt "Batteriespannung" RAT_FUNC "%6.1" "mV" COEFFS 0 0.05115 0 0 0 1 /end COMPU_METHOD
/begin RECORD_LAYOUT Kf_Xs16_Ys16_Ws16 NO_AXIS_PTS_X 1 SWORD NO_AXIS_PTS_Y 2 SWORD AXIS_PTS_X 3 SWORD INDEX_INCR DIRECT AXIS_PTS_Y 4 SWORD INDEX_INCR DIRECT FNC_VALUES 5 SWORD COLUMN_DIR DIRECT /end RECORD_LAYOUT
/begin RECORD_LAYOUT Kf_Xu8_Yu8_Wu8 NO_AXIS_PTS_X 1 UBYTE NO_AXIS_PTS_Y 2 UBYTE AXIS_PTS_X 3 UBYTE INDEX_INCR DIRECT AXIS_PTS_Y 4 UBYTE INDEX_INCR DIRECT FNC_VALUES 5 UBYTE COLUMN_DIR DIRECT /end RECORD_LAYOUT
/begin RECORD_LAYOUT Kl_Xs16_Ws16 NO_AXIS_PTS_X 1 SWORD AXIS_PTS_X 2 SWORD INDEX_INCR DIRECT FNC_VALUES 3 SWORD COLUMN_DIR DIRECT /end RECORD_LAYOUT
/begin RECORD_LAYOUT Kwb_Wu32 FNC_VALUES 1 ULONG COLUMN_DIR DIRECT /end RECORD_LAYOUT
/begin RECORD_LAYOUT Kw_Ws16 FNC_VALUES 1 SWORD COLUMN_DIR DIRECT /end RECORD_LAYOUT
/begin RECORD_LAYOUT Kw_Ws32 FNC_VALUES 1 SLONG COLUMN_DIR DIRECT /end RECORD_LAYOUT
/begin RECORD_LAYOUT Kw_Wu16 FNC_VALUES 1 UWORD COLUMN_DIR DIRECT /end RECORD_LAYOUT
/begin RECORD_LAYOUT Kw_Wu32 FNC_VALUES 1 ULONG COLUMN_DIR DIRECT /end RECORD_LAYOUT
/begin RECORD_LAYOUT Kw_Wu8 FNC_VALUES 1 UBYTE COLUMN_DIR DIRECT /end RECORD_LAYOUT
/end MODULE
/end PROJECT
