ASAP2_VERSION 1 31
/begin PROJECT MS45 "BMW Motorsteuerung R6"
/begin HEADER "_default_HeaderComment" PROJECT_NO _57 /end HEADER
/begin MODULE _default_ModuleName "_default_ModuleLongIdentifier"
/begin MOD_COMMON "_default_ModCommonComment" DEPOSIT ABSOLUTE BYTE_ORDER MSB_FIRST ALIGNMENT_BYTE 1 ALIGNMENT_WORD 2 ALIGNMENT_LONG 4 ALIGNMENT_FLOAT32_IEEE 4 ALIGNMENT_FLOAT64_IEEE 8 /end MOD_COMMON
/begin MEASUREMENT cyl_lam_1.crk_cyl_lam_int "Output of the integral-action" SBYTE _CNV_A_R_LINEAR_____159_CM 1 100. -720. 720. DISPLAY_IDENTIFIER CRK_CYL_LAM_INT_1 ECU_ADDRESS 0x3fd3e2 FORMAT "%6.1" /end MEASUREMENT
/begin MEASUREMENT cyl_lam_1.vls_cyl_sel_cq_fil "Filter value of characteristic quantity of upstream oxygen sensor" UWORD _CNV_A_R_LINEAR_____160_CM 1 100. 0. 4.98 DISPLAY_IDENTIFIER VLS_CYL_SEL_CQ_FIL_1 ECU_ADDRESS 0x3fd3e6 BYTE_ORDER MSB_LAST FORMAT "%5.3" /end MEASUREMENT
/begin MEASUREMENT cyl_lam_1.delta_lamb_av "Signal value of the WRAF Sensor, sampled with an appropriate resolution and shifted by its mean value" SWORD _CNV_A_R_LINEAR_____25_CM 1 100. -8. 7.99975586 DISPLAY_IDENTIFIER DELTA_LAMB_AV_1 ECU_ADDRESS 0x3fd3b4 BYTE_ORDER MSB_LAST FORMAT "%7.4" /end MEASUREMENT
/begin MEASUREMENT cyl_lam_1.delta_lamb_mdl "Estimated value of the WRAF Sensor" SWORD _CNV_A_R_LINEAR_____25_CM 1 100. -8. 7.99975586 DISPLAY_IDENTIFIER DELTA_LAMB_MDL_1 ECU_ADDRESS 0x3fd3b6 BYTE_ORDER MSB_LAST FORMAT "%7.4" /end MEASUREMENT
/begin MEASUREMENT cyl_lam_1.delta_lamb_err_raw "Difference between the measured and the estimated value of the WRAF sensor" SWORD _CNV_A_R_LINEAR_____25_CM 1 100. -8. 7.99975586 DISPLAY_IDENTIFIER DELTA_LAMB_ERR_RAW_1 ECU_ADDRESS 0x3fd3c4 BYTE_ORDER MSB_LAST FORMAT "%7.4" /end MEASUREMENT
/begin MEASUREMENT cyl_lam_1.delta_lamb_err "Weighted estimation-error" SWORD _CNV_A_R_LINEAR_____25_CM 1 100. -8. 7.99975586 DISPLAY_IDENTIFIER DELTA_LAMB_ERR_1 ECU_ADDRESS 0x3fd3c6 BYTE_ORDER MSB_LAST FORMAT "%7.4" /end MEASUREMENT
/begin MEASUREMENT cyl_lam_1.delta_lamb_cyl_sel "Reassembled signal, made of individual adjusted signals" SWORD _CNV_A_R_LINEAR_____25_CM 1 100. -8. 7.99975586 DISPLAY_IDENTIFIER DELTA_LAMB_CYL_SEL_1 ECU_ADDRESS 0x3fd3c8 BYTE_ORDER MSB_LAST FORMAT "%7.4" /end MEASUREMENT
/begin MEASUREMENT cyl_lam_2.crk_cyl_lam_int "Output of the integral-action" SBYTE _CNV_A_R_LINEAR_____159_CM 1 100. -720. 720. DISPLAY_IDENTIFIER CRK_CYL_LAM_INT_2 ECU_ADDRESS 0x3fd41a FORMAT "%6.1" /end MEASUREMENT
/begin MEASUREMENT cyl_lam_2.vls_cyl_sel_cq_fil "Filter value of characteristic quantity of upstream oxygen sensor" UWORD _CNV_A_R_LINEAR_____160_CM 1 100. 0. 4.98 DISPLAY_IDENTIFIER VLS_CYL_SEL_CQ_FIL_2 ECU_ADDRESS 0x3fd41e BYTE_ORDER MSB_LAST FORMAT "%5.3" /end MEASUREMENT
/begin MEASUREMENT cyl_lam_2.delta_lamb_av "Signal value of the WRAF Sensor, sampled with an appropriate resolution and shifted by its mean value" SWORD _CNV_A_R_LINEAR_____25_CM 1 100. -8. 7.99975586 DISPLAY_IDENTIFIER DELTA_LAMB_AV_2 ECU_ADDRESS 0x3fd3ec BYTE_ORDER MSB_LAST FORMAT "%7.4" /end MEASUREMENT
/begin MEASUREMENT cyl_lam_2.delta_lamb_mdl "Estimated value of the WRAF Sensor" SWORD _CNV_A_R_LINEAR_____25_CM 1 100. -8. 7.99975586 DISPLAY_IDENTIFIER DELTA_LAMB_MDL_2 ECU_ADDRESS 0x3fd3ee BYTE_ORDER MSB_LAST FORMAT "%7.4" /end MEASUREMENT
/begin MEASUREMENT cyl_lam_2.delta_lamb_err_raw "Difference between the measured and the estimated value of the WRAF sensor" SWORD _CNV_A_R_LINEAR_____25_CM 1 100. -8. 7.99975586 DISPLAY_IDENTIFIER DELTA_LAMB_ERR_RAW_2 ECU_ADDRESS 0x3fd3fc BYTE_ORDER MSB_LAST FORMAT "%7.4" /end MEASUREMENT
/begin MEASUREMENT cyl_lam_2.delta_lamb_err "Weighted estimation-error" SWORD _CNV_A_R_LINEAR_____25_CM 1 100. -8. 7.99975586 DISPLAY_IDENTIFIER DELTA_LAMB_ERR_2 ECU_ADDRESS 0x3fd3fe BYTE_ORDER MSB_LAST FORMAT "%7.4" /end MEASUREMENT
/begin MEASUREMENT cyl_lam_2.delta_lamb_cyl_sel "Reassembled signal, made of individual adjusted signals" SWORD _CNV_A_R_LINEAR_____25_CM 1 100. -8. 7.99975586 DISPLAY_IDENTIFIER DELTA_LAMB_CYL_SEL_2 ECU_ADDRESS 0x3fd400 BYTE_ORDER MSB_LAST FORMAT "%7.4" /end MEASUREMENT
/begin MEASUREMENT cyl_lam_psa_1.lv_crk_cyl_lam_int_sel "Flag for adaptation-direction" UBYTE _CNV_S_2_RANGE______2_CM 1 100. 0. 1. DISPLAY_IDENTIFIER LV_CRK_CYL_LAM_INT_SEL_1 ECU_ADDRESS 0x3fe4e5 /end MEASUREMENT
/begin MEASUREMENT cyl_lam_psa_1.lv_delta_crk_cyl_lam "Activation flag for ageing adaptation" UBYTE _CNV_S_2_RANGE______2_CM 1 100. 0. 1. DISPLAY_IDENTIFIER LV_DELTA_CRK_CYL_LAM_1 ECU_ADDRESS 0x3fe4e6 /end MEASUREMENT
/begin MEASUREMENT cyl_lam_psa_1.lv_delta_crk_cyl_lam_err "Error flag" UBYTE _CNV_S_2_RANGE______2_CM 1 100. 0. 1. DISPLAY_IDENTIFIER LV_DELTA_CRK_CYL_LAM_ERR_1 ECU_ADDRESS 0x3fe4e7 /end MEASUREMENT
/begin MEASUREMENT cyl_lam_psa_2.lv_crk_cyl_lam_int_sel "Flag for adaptation-direction" UBYTE _CNV_S_2_RANGE______2_CM 1 100. 0. 1. DISPLAY_IDENTIFIER LV_CRK_CYL_LAM_INT_SEL_2 ECU_ADDRESS 0x3fe4e8 /end MEASUREMENT
/begin MEASUREMENT cyl_lam_psa_2.lv_delta_crk_cyl_lam "Activation flag for ageing adaptation" UBYTE _CNV_S_2_RANGE______2_CM 1 100. 0. 1. DISPLAY_IDENTIFIER LV_DELTA_CRK_CYL_LAM_2 ECU_ADDRESS 0x3fe4e9 /end MEASUREMENT
/begin MEASUREMENT cyl_lam_psa_2.lv_delta_crk_cyl_lam_err "Error flag" UBYTE _CNV_S_2_RANGE______2_CM 1 100. 0. 1. DISPLAY_IDENTIFIER LV_DELTA_CRK_CYL_LAM_ERR_2 ECU_ADDRESS 0x3fe4ea /end MEASUREMENT
/begin CHARACTERISTIC c_cyl_lam_out_min "Lower limit of the cylinder individual controller output" VALUE 0xffe403e6 _REC_VAL_20_s2 99.99847412 _CNV_A_R_LINEAR_____111_CM -50. 49.99847412 DISPLAY_IDENTIFIER C_CYL_LAM_OUT_MIN FORMAT "%7.3" /end CHARACTERISTIC
/begin CHARACTERISTIC c_cyl_lam_out_max "Upper limit of the cylinder individual controller output" VALUE 0xffe403e4 _REC_VAL_20_s2 99.99847412 _CNV_A_R_LINEAR_____111_CM -50. 49.99847412 DISPLAY_IDENTIFIER C_CYL_LAM_OUT_MAX FORMAT "%7.3" /end CHARACTERISTIC
/begin CHARACTERISTIC c_crlc_adj_fac "Correlation constant for the adaptation" VALUE 0xffe40674 _REC_VAL_20_u1 0.99610001 _CNV_A_R_LINEAR_____29_CM 0. 0.99610001 DISPLAY_IDENTIFIER C_CRLC_ADJ_FAC FORMAT "%5.3" /end CHARACTERISTIC
/begin CHARACTERISTIC ip_lamb_cyl_1 "Characteristic curve of the lambda sensor " CURVE 0xffe4c722 _REC_CUR_20_u2_u2 8. _CNV_A_R_LINEAR_____161_CM 0. 8. DISPLAY_IDENTIFIER IP_LAMB_CYL_1 FORMAT "%6.4"
 /begin AXIS_DESCR COM_AXIS online_dummy _CNV_A_R_LINEAR_____3_CM 16 0. 4.99511719 FORMAT "%5.3" AXIS_PTS_REF ldp_vls_cyl_sel_ip_lamb_1 /end AXIS_DESCR
/end CHARACTERISTIC
/begin CHARACTERISTIC ip_lamb_cyl_2 "Characteristic curve of the lambda sensor " CURVE 0xffe4c742 _REC_CUR_20_u2_u2 8. _CNV_A_R_LINEAR_____161_CM 0. 8. DISPLAY_IDENTIFIER IP_LAMB_CYL_2 FORMAT "%6.4"
 /begin AXIS_DESCR COM_AXIS online_dummy _CNV_A_R_LINEAR_____3_CM 16 0. 4.99511719 FORMAT "%5.3" AXIS_PTS_REF ldp_vls_cyl_sel_ip_lamb_2 /end AXIS_DESCR
/end CHARACTERISTIC
/begin CHARACTERISTIC ip_fac_err_lam_sel "Weight coefficient" CURVE 0xffe4afda _REC_CUR_20_u2_u2 256. _CNV_A_R_LINEAR_____162_CM 0. 256. DISPLAY_IDENTIFIER IP_FAC_ERR_LAM_SEL FORMAT "%7.4"
 /begin AXIS_DESCR COM_AXIS online_dummy _CNV_A_R_LINEAR_____163_CM 6 0. 1.99996948 FORMAT "%6.4" AXIS_PTS_REF ldp_t1_lamb_ip_fac_err_lam_sel /end AXIS_DESCR
/end CHARACTERISTIC
/begin CHARACTERISTIC ip_crk_syn "Phase displacement" MAP 0xffe44d9a _REC_MAP_20_u1_u2_u2 1440. _CNV_A_R_LINEAR_____159_CM 0. 1440. DISPLAY_IDENTIFIER IP_CRK_SYN FORMAT "%4.0"
 /begin AXIS_DESCR COM_AXIS n _CNV_A_R_LINEAR_____10_CM 8 0. 8160. FORMAT "%4.0" AXIS_PTS_REF ldp_n_ip_crk_syn /end AXIS_DESCR
 /begin AXIS_DESCR COM_AXIS maf _CNV_A_R_LINEAR_____108_CM 8 0. 1389. FORMAT "%7.2" AXIS_PTS_REF ldp_maf_ip_crk_syn /end AXIS_DESCR
/end CHARACTERISTIC
/begin CHARACTERISTIC ip_exp_lamb_mdl "Exponential function for the sensor model" CURVE 0xffe4ae2a _REC_CUR_20_u2_u2 0.99998474 _CNV_A_R_LINEAR_____37_CM 0. 0.99998474 DISPLAY_IDENTIFIER IP_EXP_LAMB_MDL FORMAT "%7.6"
 /begin AXIS_DESCR COM_AXIS online_dummy _CNV_A_R_LINEAR_____118_CM 16 0. 63.99902344 FORMAT "%7.4" AXIS_PTS_REF ldpm_fac_t_1_laco /end AXIS_DESCR
/end CHARACTERISTIC
/begin CHARACTERISTIC ip_n1_fac_lamb_mdl "N1 coefficient of the sensor model" CURVE 0xffe4d63a _REC_CUR_20_u2_u2 0.99998474 _CNV_A_R_LINEAR_____37_CM 0. 0.99998474 DISPLAY_IDENTIFIER IP_N1_FAC_LAMB_MDL FORMAT "%7.6"
 /begin AXIS_DESCR COM_AXIS online_dummy _CNV_A_R_LINEAR_____118_CM 16 0. 63.99902344 FORMAT "%7.4" AXIS_PTS_REF ldpm_fac_t_1_laco /end AXIS_DESCR
/end CHARACTERISTIC
/begin CHARACTERISTIC ip_n2_fac_lamb_mdl "N2 coefficient of the sensor model" CURVE 0xffe4d65a _REC_CUR_20_u2_u2 0.99998474 _CNV_A_R_LINEAR_____37_CM 0. 0.99998474 DISPLAY_IDENTIFIER IP_N2_FAC_LAMB_MDL FORMAT "%7.6"
 /begin AXIS_DESCR COM_AXIS online_dummy _CNV_A_R_LINEAR_____118_CM 16 0. 63.99902344 FORMAT "%7.4" AXIS_PTS_REF ldpm_fac_t_1_laco /end AXIS_DESCR
/end CHARACTERISTIC
/begin CHARACTERISTIC c_crlc_cyl_fil "Correlation constant for the filter output" VALUE 0xffe4153c _REC_VAL_20_u2 0.999755 _CNV_A_R_LINEAR_____126_CM 0. 0.999755 DISPLAY_IDENTIFIER C_CRLC_CYL_FIL FORMAT "%7.5" /end CHARACTERISTIC
/begin CHARACTERISTIC c_crlc_exv_fac_1 "exhast-valve manifold-port correlation factor" VALUE 0xffe41548 _REC_VAL_20_u2 1.99996948 _CNV_A_R_LINEAR_____20_CM 0. 1.99996948 DISPLAY_IDENTIFIER C_CRLC_EXV_FAC_1 FORMAT "%7.5" /end CHARACTERISTIC
/begin CHARACTERISTIC c_crlc_exv_fac_2 "exhast-valve manifold-port correlation factor" VALUE 0xffe4154a _REC_VAL_20_u2 1.99996948 _CNV_A_R_LINEAR_____20_CM 0. 1.99996948 DISPLAY_IDENTIFIER C_CRLC_EXV_FAC_2 FORMAT "%7.5" /end CHARACTERISTIC
/begin CHARACTERISTIC c_crlc_exv_fac_3 "exhast-valve manifold-port correlation factor" VALUE 0xffe4154c _REC_VAL_20_u2 1.99996948 _CNV_A_R_LINEAR_____20_CM 0. 1.99996948 DISPLAY_IDENTIFIER C_CRLC_EXV_FAC_3 FORMAT "%7.5" /end CHARACTERISTIC
/begin CHARACTERISTIC c_crlc_exv_fac_4 "exhast-valve manifold-port correlation factor" VALUE 0xffe4154e _REC_VAL_20_u2 1.99996948 _CNV_A_R_LINEAR_____20_CM 0. 1.99996948 DISPLAY_IDENTIFIER C_CRLC_EXV_FAC_4 FORMAT "%7.5" /end CHARACTERISTIC
/begin CHARACTERISTIC c_crlc_exv_fac_5 "exhast-valve manifold-port correlation factor" VALUE 0xffe41550 _REC_VAL_20_u2 1.99996948 _CNV_A_R_LINEAR_____20_CM 0. 1.99996948 DISPLAY_IDENTIFIER C_CRLC_EXV_FAC_5 FORMAT "%7.5" /end CHARACTERISTIC
/begin CHARACTERISTIC lc_adapt_cor_out "Adaptation switch" VALUE 0xffe40f33 _REC_VAL_20_u1 1. _CNV_A_R_LINEAR_____0_CM 0. 1. DISPLAY_IDENTIFIER LC_ADAPT_COR_OUT FORMAT "%2.0" /end CHARACTERISTIC
/begin CHARACTERISTIC lc_delta_crk_cyl_lam_out "Adaptation switch" VALUE 0xffe40f47 _REC_VAL_20_u1 1. _CNV_A_R_LINEAR_____0_CM 0. 1. DISPLAY_IDENTIFIER LC_DELTA_CRK_CYL_LAM_OUT FORMAT "%2.0" /end CHARACTERISTIC
/begin CHARACTERISTIC c_delta_lamb_cyl_sp "Setpoint value" VALUE 0xffe403ec _REC_VAL_20_s2 15.99975586 _CNV_A_R_LINEAR_____25_CM -8. 7.99975586 DISPLAY_IDENTIFIER C_DELTA_LAMB_CYL_SP FORMAT "%7.4" /end CHARACTERISTIC
/begin CHARACTERISTIC c_t_cyl_adj "Time recurrence for adaptation update" VALUE 0xffe4086b _REC_VAL_20_u1 255. _CNV_A_R_LINEAR_____30_CM 0. 255. DISPLAY_IDENTIFIER C_T_CYL_ADJ FORMAT "%3.0" /end CHARACTERISTIC
/begin CHARACTERISTIC c_t_delta_crk_cyl_lam "Time recurrence for adaptation update" VALUE 0xffe4086c _REC_VAL_20_u1 254. _CNV_A_R_LINEAR_____30_CM 1. 255. DISPLAY_IDENTIFIER C_T_DELTA_CRK_CYL_LAM FORMAT "%3.0" /end CHARACTERISTIC
/begin CHARACTERISTIC c_delta_crk_vls_thd "Threshold for the neutral zone (characteristic value for the control-action result)" VALUE 0xffe415b0 _REC_VAL_20_u2 4.98 _CNV_A_R_LINEAR_____160_CM 0. 4.98 DISPLAY_IDENTIFIER C_DELTA_CRK_VLS_THD FORMAT "%5.3" /end CHARACTERISTIC
/begin CHARACTERISTIC c_delta_crk_out_min "Lower limit of the adapted phase displacement" VALUE 0xffe40380 _REC_VAL_20_s1 1440. _CNV_A_R_LINEAR_____159_CM -720. 720. DISPLAY_IDENTIFIER C_DELTA_CRK_OUT_MIN FORMAT "%6.1" /end CHARACTERISTIC
/begin CHARACTERISTIC c_delta_crk_out_max "Upper limit of the adapted phase displacement" VALUE 0xffe4037f _REC_VAL_20_s1 1440. _CNV_A_R_LINEAR_____159_CM -720. 720. DISPLAY_IDENTIFIER C_DELTA_CRK_OUT_MAX FORMAT "%6.1" /end CHARACTERISTIC
/begin CHARACTERISTIC ip_crlc_cyl_lam "Correlation characteristic for AFR equalisation" MAP 0xffe490c0 _REC_MAP_20_u2_u2_u2 1.99997 _CNV_A_R_LINEAR_____164_CM 0. 1.99997 DISPLAY_IDENTIFIER IP_CRLC_CYL_LAM FORMAT "%7.5"
 /begin AXIS_DESCR COM_AXIS n _CNV_A_R_LINEAR_____10_CM 8 0. 8160. FORMAT "%4.0" AXIS_PTS_REF ldp_n_ip_crlc_cyl_lam /end AXIS_DESCR
 /begin AXIS_DESCR COM_AXIS maf_kgh _CNV_A_R_LINEAR_____108_CM 8 0. 1389. FORMAT "%7.2" AXIS_PTS_REF ldp_maf_ip_crlc_cyl_lam /end AXIS_DESCR
/end CHARACTERISTIC
/begin CHARACTERISTIC c_crlc_exv_fac_0 "exhast-valve manifold-port correlation factor" VALUE 0xffe41546 _REC_VAL_20_u2 1.99996948 _CNV_A_R_LINEAR_____20_CM 0. 1.99996948 DISPLAY_IDENTIFIER C_CRLC_EXV_FAC_0 FORMAT "%7.5" /end CHARACTERISTIC
/begin CHARACTERISTIC c_crlc_vls_cq_fil "Correlation constant for the filter output" VALUE 0xffe41580 _REC_VAL_20_u2 0.99998474 _CNV_A_R_LINEAR_____37_CM 0. 0.99998474 DISPLAY_IDENTIFIER C_CRLC_VLS_CQ_FIL FORMAT "%7.6" /end CHARACTERISTIC
/begin CHARACTERISTIC c_crk_chg_fac_max "Upper limit of the CRK change factor" VALUE 0xffe4066c _REC_VAL_20_u1 120. _CNV_A_R_LINEAR_____0_CM 0. 120. DISPLAY_IDENTIFIER C_CRK_CHG_FAC_MAX /end CHARACTERISTIC
/begin CHARACTERISTIC ip_maf_delta_crk_min "min. threshold for calculation of the phase shift adaptation" CURVE 0xffe4cdda _REC_CUR_20_u2_u1 1389. _CNV_A_R_LINEAR_____108_CM 0. 1389. DISPLAY_IDENTIFIER IP_MAF_DELTA_CRK_MIN FORMAT "%7.2"
 /begin AXIS_DESCR COM_AXIS n_32 _CNV_A_R_LINEAR_____15_CM 6 0. 8160. FORMAT "%4.0" AXIS_PTS_REF ldp_n_32_ip_maf_delta_crk_min /end AXIS_DESCR
/end CHARACTERISTIC
/begin CHARACTERISTIC ip_maf_delta_crk_max "max. threshold for calculation of the phase shift adaptation" CURVE 0xffe4cdce _REC_CUR_20_u2_u1 1389. _CNV_A_R_LINEAR_____108_CM 0. 1389. DISPLAY_IDENTIFIER IP_MAF_DELTA_CRK_MAX FORMAT "%7.2"
 /begin AXIS_DESCR COM_AXIS n_32 _CNV_A_R_LINEAR_____15_CM 6 0. 8160. FORMAT "%4.0" AXIS_PTS_REF ldp_n_32_ip_maf_delta_crk_max /end AXIS_DESCR
/end CHARACTERISTIC
/begin MEASUREMENT ti_cyl_lam_[0] "Factor for the injection time correction of cylinder x" SWORD _CNV_A_R_LINEAR_____111_CM 1 100. -50. 49.99847412 DISPLAY_IDENTIFIER TI_CYL_LAM_0 ECU_ADDRESS 0x3fd38c BYTE_ORDER MSB_LAST FORMAT "%7.3" /end MEASUREMENT
/begin MEASUREMENT ti_cyl_lam_[1] "Factor for the injection time correction of cylinder x" SWORD _CNV_A_R_LINEAR_____111_CM 1 100. -50. 49.99847412 DISPLAY_IDENTIFIER TI_CYL_LAM_1 ECU_ADDRESS 0x3fd38e BYTE_ORDER MSB_LAST FORMAT "%7.3" /end MEASUREMENT
/begin MEASUREMENT ti_cyl_lam_[2] "Factor for the injection time correction of cylinder x" SWORD _CNV_A_R_LINEAR_____111_CM 1 100. -50. 49.99847412 DISPLAY_IDENTIFIER TI_CYL_LAM_2 ECU_ADDRESS 0x3fd390 BYTE_ORDER MSB_LAST FORMAT "%7.3" /end MEASUREMENT
/begin MEASUREMENT ti_cyl_lam_[3] "Factor for the injection time correction of cylinder x" SWORD _CNV_A_R_LINEAR_____111_CM 1 100. -50. 49.99847412 DISPLAY_IDENTIFIER TI_CYL_LAM_3 ECU_ADDRESS 0x3fd392 BYTE_ORDER MSB_LAST FORMAT "%7.3" /end MEASUREMENT
/begin MEASUREMENT ti_cyl_lam_[4] "Factor for the injection time correction of cylinder x" SWORD _CNV_A_R_LINEAR_____111_CM 1 100. -50. 49.99847412 DISPLAY_IDENTIFIER TI_CYL_LAM_4 ECU_ADDRESS 0x3fd394 BYTE_ORDER MSB_LAST FORMAT "%7.3" /end MEASUREMENT
/begin MEASUREMENT ti_cyl_lam_[5] "Factor for the injection time correction of cylinder x" SWORD _CNV_A_R_LINEAR_____111_CM 1 100. -50. 49.99847412 DISPLAY_IDENTIFIER TI_CYL_LAM_5 ECU_ADDRESS 0x3fd396 BYTE_ORDER MSB_LAST FORMAT "%7.3" /end MEASUREMENT
/begin MEASUREMENT ti_cyl_lam_add_[0] "Additive factor for the injection time correction of cylinder x" SWORD _CNV_A_R_LINEAR_____165_CM 1 100. -131.072 131.068 DISPLAY_IDENTIFIER TI_CYL_LAM_ADD_0 ECU_ADDRESS 0x3fd398 BYTE_ORDER MSB_LAST FORMAT "%8.3" /end MEASUREMENT
/begin MEASUREMENT ti_cyl_lam_add_[1] "Additive factor for the injection time correction of cylinder x" SWORD _CNV_A_R_LINEAR_____165_CM 1 100. -131.072 131.068 DISPLAY_IDENTIFIER TI_CYL_LAM_ADD_1 ECU_ADDRESS 0x3fd39a BYTE_ORDER MSB_LAST FORMAT "%8.3" /end MEASUREMENT
/begin MEASUREMENT ti_cyl_lam_add_[2] "Additive factor for the injection time correction of cylinder x" SWORD _CNV_A_R_LINEAR_____165_CM 1 100. -131.072 131.068 DISPLAY_IDENTIFIER TI_CYL_LAM_ADD_2 ECU_ADDRESS 0x3fd39c BYTE_ORDER MSB_LAST FORMAT "%8.3" /end MEASUREMENT
/begin MEASUREMENT ti_cyl_lam_add_[3] "Additive factor for the injection time correction of cylinder x" SWORD _CNV_A_R_LINEAR_____165_CM 1 100. -131.072 131.068 DISPLAY_IDENTIFIER TI_CYL_LAM_ADD_3 ECU_ADDRESS 0x3fd39e BYTE_ORDER MSB_LAST FORMAT "%8.3" /end MEASUREMENT
/begin MEASUREMENT ti_cyl_lam_add_[4] "Additive factor for the injection time correction of cylinder x" SWORD _CNV_A_R_LINEAR_____165_CM 1 100. -131.072 131.068 DISPLAY_IDENTIFIER TI_CYL_LAM_ADD_4 ECU_ADDRESS 0x3fd3a0 BYTE_ORDER MSB_LAST FORMAT "%8.3" /end MEASUREMENT
/begin MEASUREMENT ti_cyl_lam_add_[5] "Additive factor for the injection time correction of cylinder x" SWORD _CNV_A_R_LINEAR_____165_CM 1 100. -131.072 131.068 DISPLAY_IDENTIFIER TI_CYL_LAM_ADD_5 ECU_ADDRESS 0x3fd3a2 BYTE_ORDER MSB_LAST FORMAT "%8.3" /end MEASUREMENT
/begin MEASUREMENT ti_cyl_lam_lim_not[0] "Unlimited output of the cylinder individual control system" SWORD _CNV_A_R_LINEAR_____111_CM 1 100. -50. 49.99847412 DISPLAY_IDENTIFIER TI_CYL_LAM_LIM_NOT_0 ECU_ADDRESS 0x3fd424 BYTE_ORDER MSB_LAST FORMAT "%7.3" /end MEASUREMENT
/begin MEASUREMENT ti_cyl_lam_lim_not[1] "Unlimited output of the cylinder individual control system" SWORD _CNV_A_R_LINEAR_____111_CM 1 100. -50. 49.99847412 DISPLAY_IDENTIFIER TI_CYL_LAM_LIM_NOT_1 ECU_ADDRESS 0x3fd426 BYTE_ORDER MSB_LAST FORMAT "%7.3" /end MEASUREMENT
/begin MEASUREMENT ti_cyl_lam_lim_not[2] "Unlimited output of the cylinder individual control system" SWORD _CNV_A_R_LINEAR_____111_CM 1 100. -50. 49.99847412 DISPLAY_IDENTIFIER TI_CYL_LAM_LIM_NOT_2 ECU_ADDRESS 0x3fd428 BYTE_ORDER MSB_LAST FORMAT "%7.3" /end MEASUREMENT
/begin MEASUREMENT ti_cyl_lam_lim_not[3] "Unlimited output of the cylinder individual control system" SWORD _CNV_A_R_LINEAR_____111_CM 1 100. -50. 49.99847412 DISPLAY_IDENTIFIER TI_CYL_LAM_LIM_NOT_3 ECU_ADDRESS 0x3fd42a BYTE_ORDER MSB_LAST FORMAT "%7.3" /end MEASUREMENT
/begin MEASUREMENT ti_cyl_lam_lim_not[4] "Unlimited output of the cylinder individual control system" SWORD _CNV_A_R_LINEAR_____111_CM 1 100. -50. 49.99847412 DISPLAY_IDENTIFIER TI_CYL_LAM_LIM_NOT_4 ECU_ADDRESS 0x3fd42c BYTE_ORDER MSB_LAST FORMAT "%7.3" /end MEASUREMENT
/begin MEASUREMENT ti_cyl_lam_lim_not[5] "Unlimited output of the cylinder individual control system" SWORD _CNV_A_R_LINEAR_____111_CM 1 100. -50. 49.99847412 DISPLAY_IDENTIFIER TI_CYL_LAM_LIM_NOT_5 ECU_ADDRESS 0x3fd42e BYTE_ORDER MSB_LAST FORMAT "%7.3" /end MEASUREMENT
/begin MEASUREMENT fac_cyl_lam_int[0] "Unlimited output of the cylinder individual controller" SWORD _CNV_A_R_LINEAR_____111_CM 1 100. -50. 49.99847412 DISPLAY_IDENTIFIER FAC_CYL_LAM_INT_0 ECU_ADDRESS 0x3fd430 BYTE_ORDER MSB_LAST FORMAT "%7.3" /end MEASUREMENT
/begin MEASUREMENT fac_cyl_lam_int[1] "Unlimited output of the cylinder individual controller" SWORD _CNV_A_R_LINEAR_____111_CM 1 100. -50. 49.99847412 DISPLAY_IDENTIFIER FAC_CYL_LAM_INT_1 ECU_ADDRESS 0x3fd432 BYTE_ORDER MSB_LAST FORMAT "%7.3" /end MEASUREMENT
/begin MEASUREMENT fac_cyl_lam_int[2] "Unlimited output of the cylinder individual controller" SWORD _CNV_A_R_LINEAR_____111_CM 1 100. -50. 49.99847412 DISPLAY_IDENTIFIER FAC_CYL_LAM_INT_2 ECU_ADDRESS 0x3fd434 BYTE_ORDER MSB_LAST FORMAT "%7.3" /end MEASUREMENT
/begin MEASUREMENT fac_cyl_lam_int[3] "Unlimited output of the cylinder individual controller" SWORD _CNV_A_R_LINEAR_____111_CM 1 100. -50. 49.99847412 DISPLAY_IDENTIFIER FAC_CYL_LAM_INT_3 ECU_ADDRESS 0x3fd436 BYTE_ORDER MSB_LAST FORMAT "%7.3" /end MEASUREMENT
/begin MEASUREMENT fac_cyl_lam_int[4] "Unlimited output of the cylinder individual controller" SWORD _CNV_A_R_LINEAR_____111_CM 1 100. -50. 49.99847412 DISPLAY_IDENTIFIER FAC_CYL_LAM_INT_4 ECU_ADDRESS 0x3fd438 BYTE_ORDER MSB_LAST FORMAT "%7.3" /end MEASUREMENT
/begin MEASUREMENT fac_cyl_lam_int[5] "Unlimited output of the cylinder individual controller" SWORD _CNV_A_R_LINEAR_____111_CM 1 100. -50. 49.99847412 DISPLAY_IDENTIFIER FAC_CYL_LAM_INT_5 ECU_ADDRESS 0x3fd43a BYTE_ORDER MSB_LAST FORMAT "%7.3" /end MEASUREMENT
/begin MEASUREMENT fac_cyl_lam[0] "Output of the cylinder individual controller, shifted by its mean value" SWORD _CNV_A_R_LINEAR_____111_CM 1 100. -50. 49.99847412 DISPLAY_IDENTIFIER FAC_CYL_LAM_0 ECU_ADDRESS 0x3fd43c BYTE_ORDER MSB_LAST FORMAT "%7.3" /end MEASUREMENT
/begin MEASUREMENT fac_cyl_lam[1] "Output of the cylinder individual controller, shifted by its mean value" SWORD _CNV_A_R_LINEAR_____111_CM 1 100. -50. 49.99847412 DISPLAY_IDENTIFIER FAC_CYL_LAM_1 ECU_ADDRESS 0x3fd43e BYTE_ORDER MSB_LAST FORMAT "%7.3" /end MEASUREMENT
/begin MEASUREMENT fac_cyl_lam[2] "Output of the cylinder individual controller, shifted by its mean value" SWORD _CNV_A_R_LINEAR_____111_CM 1 100. -50. 49.99847412 DISPLAY_IDENTIFIER FAC_CYL_LAM_2 ECU_ADDRESS 0x3fd440 BYTE_ORDER MSB_LAST FORMAT "%7.3" /end MEASUREMENT
/begin MEASUREMENT fac_cyl_lam[3] "Output of the cylinder individual controller, shifted by its mean value" SWORD _CNV_A_R_LINEAR_____111_CM 1 100. -50. 49.99847412 DISPLAY_IDENTIFIER FAC_CYL_LAM_3 ECU_ADDRESS 0x3fd442 BYTE_ORDER MSB_LAST FORMAT "%7.3" /end MEASUREMENT
/begin MEASUREMENT fac_cyl_lam[4] "Output of the cylinder individual controller, shifted by its mean value" SWORD _CNV_A_R_LINEAR_____111_CM 1 100. -50. 49.99847412 DISPLAY_IDENTIFIER FAC_CYL_LAM_4 ECU_ADDRESS 0x3fd444 BYTE_ORDER MSB_LAST FORMAT "%7.3" /end MEASUREMENT
/begin MEASUREMENT fac_cyl_lam[5] "Output of the cylinder individual controller, shifted by its mean value" SWORD _CNV_A_R_LINEAR_____111_CM 1 100. -50. 49.99847412 DISPLAY_IDENTIFIER FAC_CYL_LAM_5 ECU_ADDRESS 0x3fd446 BYTE_ORDER MSB_LAST FORMAT "%7.3" /end MEASUREMENT
/begin MEASUREMENT lam_cyl_sel_adj_fac[0] "Adaptive correction factor" SWORD _CNV_A_R_LINEAR_____111_CM 1 100. -50. 49.99847412 DISPLAY_IDENTIFIER LAM_CYL_SEL_ADJ_FAC_0 ECU_ADDRESS 0x3fd3a4 BYTE_ORDER MSB_LAST FORMAT "%7.3" /end MEASUREMENT
/begin MEASUREMENT lam_cyl_sel_adj_fac[1] "Adaptive correction factor" SWORD _CNV_A_R_LINEAR_____111_CM 1 100. -50. 49.99847412 DISPLAY_IDENTIFIER LAM_CYL_SEL_ADJ_FAC_1 ECU_ADDRESS 0x3fd3a6 BYTE_ORDER MSB_LAST FORMAT "%7.3" /end MEASUREMENT
/begin MEASUREMENT lam_cyl_sel_adj_fac[2] "Adaptive correction factor" SWORD _CNV_A_R_LINEAR_____111_CM 1 100. -50. 49.99847412 DISPLAY_IDENTIFIER LAM_CYL_SEL_ADJ_FAC_2 ECU_ADDRESS 0x3fd3a8 BYTE_ORDER MSB_LAST FORMAT "%7.3" /end MEASUREMENT
/begin MEASUREMENT lam_cyl_sel_adj_fac[3] "Adaptive correction factor" SWORD _CNV_A_R_LINEAR_____111_CM 1 100. -50. 49.99847412 DISPLAY_IDENTIFIER LAM_CYL_SEL_ADJ_FAC_3 ECU_ADDRESS 0x3fd3aa BYTE_ORDER MSB_LAST FORMAT "%7.3" /end MEASUREMENT
/begin MEASUREMENT lam_cyl_sel_adj_fac[4] "Adaptive correction factor" SWORD _CNV_A_R_LINEAR_____111_CM 1 100. -50. 49.99847412 DISPLAY_IDENTIFIER LAM_CYL_SEL_ADJ_FAC_4 ECU_ADDRESS 0x3fd3ac BYTE_ORDER MSB_LAST FORMAT "%7.3" /end MEASUREMENT
/begin MEASUREMENT lam_cyl_sel_adj_fac[5] "Adaptive correction factor" SWORD _CNV_A_R_LINEAR_____111_CM 1 100. -50. 49.99847412 DISPLAY_IDENTIFIER LAM_CYL_SEL_ADJ_FAC_5 ECU_ADDRESS 0x3fd3ae BYTE_ORDER MSB_LAST FORMAT "%7.3" /end MEASUREMENT
/begin MEASUREMENT lam_cyl_sel_adj_fil[0] "Adaptation filter output" SWORD _CNV_A_R_LINEAR_____111_CM 1 100. -50. 49.99847412 DISPLAY_IDENTIFIER LAM_CYL_SEL_ADJ_FIL_0 ECU_ADDRESS 0x3fd448 BYTE_ORDER MSB_LAST FORMAT "%7.3" /end MEASUREMENT
/begin MEASUREMENT lam_cyl_sel_adj_fil[1] "Adaptation filter output" SWORD _CNV_A_R_LINEAR_____111_CM 1 100. -50. 49.99847412 DISPLAY_IDENTIFIER LAM_CYL_SEL_ADJ_FIL_1 ECU_ADDRESS 0x3fd44a BYTE_ORDER MSB_LAST FORMAT "%7.3" /end MEASUREMENT
/begin MEASUREMENT lam_cyl_sel_adj_fil[2] "Adaptation filter output" SWORD _CNV_A_R_LINEAR_____111_CM 1 100. -50. 49.99847412 DISPLAY_IDENTIFIER LAM_CYL_SEL_ADJ_FIL_2 ECU_ADDRESS 0x3fd44c BYTE_ORDER MSB_LAST FORMAT "%7.3" /end MEASUREMENT
/begin MEASUREMENT lam_cyl_sel_adj_fil[3] "Adaptation filter output" SWORD _CNV_A_R_LINEAR_____111_CM 1 100. -50. 49.99847412 DISPLAY_IDENTIFIER LAM_CYL_SEL_ADJ_FIL_3 ECU_ADDRESS 0x3fd44e BYTE_ORDER MSB_LAST FORMAT "%7.3" /end MEASUREMENT
/begin MEASUREMENT lam_cyl_sel_adj_fil[4] "Adaptation filter output" SWORD _CNV_A_R_LINEAR_____111_CM 1 100. -50. 49.99847412 DISPLAY_IDENTIFIER LAM_CYL_SEL_ADJ_FIL_4 ECU_ADDRESS 0x3fd450 BYTE_ORDER MSB_LAST FORMAT "%7.3" /end MEASUREMENT
/begin MEASUREMENT lam_cyl_sel_adj_fil[5] "Adaptation filter output" SWORD _CNV_A_R_LINEAR_____111_CM 1 100. -50. 49.99847412 DISPLAY_IDENTIFIER LAM_CYL_SEL_ADJ_FIL_5 ECU_ADDRESS 0x3fd452 BYTE_ORDER MSB_LAST FORMAT "%7.3" /end MEASUREMENT
/begin MEASUREMENT delta_lamb_dif_cyl[0] "Control error for each cylinder" SWORD _CNV_A_R_LINEAR_____25_CM 1 100. -8. 7.99975586 DISPLAY_IDENTIFIER DELTA_LAMB_DIF_CYL_0 ECU_ADDRESS 0x3fd460 BYTE_ORDER MSB_LAST FORMAT "%7.4" /end MEASUREMENT
/begin MEASUREMENT delta_lamb_dif_cyl[1] "Control error for each cylinder" SWORD _CNV_A_R_LINEAR_____25_CM 1 100. -8. 7.99975586 DISPLAY_IDENTIFIER DELTA_LAMB_DIF_CYL_1 ECU_ADDRESS 0x3fd462 BYTE_ORDER MSB_LAST FORMAT "%7.4" /end MEASUREMENT
/begin MEASUREMENT delta_lamb_dif_cyl[2] "Control error for each cylinder" SWORD _CNV_A_R_LINEAR_____25_CM 1 100. -8. 7.99975586 DISPLAY_IDENTIFIER DELTA_LAMB_DIF_CYL_2 ECU_ADDRESS 0x3fd464 BYTE_ORDER MSB_LAST FORMAT "%7.4" /end MEASUREMENT
/begin MEASUREMENT delta_lamb_dif_cyl[3] "Control error for each cylinder" SWORD _CNV_A_R_LINEAR_____25_CM 1 100. -8. 7.99975586 DISPLAY_IDENTIFIER DELTA_LAMB_DIF_CYL_3 ECU_ADDRESS 0x3fd466 BYTE_ORDER MSB_LAST FORMAT "%7.4" /end MEASUREMENT
/begin MEASUREMENT delta_lamb_dif_cyl[4] "Control error for each cylinder" SWORD _CNV_A_R_LINEAR_____25_CM 1 100. -8. 7.99975586 DISPLAY_IDENTIFIER DELTA_LAMB_DIF_CYL_4 ECU_ADDRESS 0x3fd468 BYTE_ORDER MSB_LAST FORMAT "%7.4" /end MEASUREMENT
/begin MEASUREMENT delta_lamb_dif_cyl[5] "Control error for each cylinder" SWORD _CNV_A_R_LINEAR_____25_CM 1 100. -8. 7.99975586 DISPLAY_IDENTIFIER DELTA_LAMB_DIF_CYL_5 ECU_ADDRESS 0x3fd46a BYTE_ORDER MSB_LAST FORMAT "%7.4" /end MEASUREMENT
/begin MEASUREMENT delta_lamb_cyl[0] "Individual adjusted signal" SWORD _CNV_A_R_LINEAR_____25_CM 1 100. -8. 7.99975586 DISPLAY_IDENTIFIER DELTA_LAMB_CYL_0 ECU_ADDRESS 0x3fd46c BYTE_ORDER MSB_LAST FORMAT "%7.4" /end MEASUREMENT
/begin MEASUREMENT delta_lamb_cyl[1] "Individual adjusted signal" SWORD _CNV_A_R_LINEAR_____25_CM 1 100. -8. 7.99975586 DISPLAY_IDENTIFIER DELTA_LAMB_CYL_1 ECU_ADDRESS 0x3fd46e BYTE_ORDER MSB_LAST FORMAT "%7.4" /end MEASUREMENT
/begin MEASUREMENT delta_lamb_cyl[2] "Individual adjusted signal" SWORD _CNV_A_R_LINEAR_____25_CM 1 100. -8. 7.99975586 DISPLAY_IDENTIFIER DELTA_LAMB_CYL_2 ECU_ADDRESS 0x3fd470 BYTE_ORDER MSB_LAST FORMAT "%7.4" /end MEASUREMENT
/begin MEASUREMENT delta_lamb_cyl[3] "Individual adjusted signal" SWORD _CNV_A_R_LINEAR_____25_CM 1 100. -8. 7.99975586 DISPLAY_IDENTIFIER DELTA_LAMB_CYL_3 ECU_ADDRESS 0x3fd472 BYTE_ORDER MSB_LAST FORMAT "%7.4" /end MEASUREMENT
/begin MEASUREMENT delta_lamb_cyl[4] "Individual adjusted signal" SWORD _CNV_A_R_LINEAR_____25_CM 1 100. -8. 7.99975586 DISPLAY_IDENTIFIER DELTA_LAMB_CYL_4 ECU_ADDRESS 0x3fd474 BYTE_ORDER MSB_LAST FORMAT "%7.4" /end MEASUREMENT
/begin MEASUREMENT delta_lamb_cyl[5] "Individual adjusted signal" SWORD _CNV_A_R_LINEAR_____25_CM 1 100. -8. 7.99975586 DISPLAY_IDENTIFIER DELTA_LAMB_CYL_5 ECU_ADDRESS 0x3fd476 BYTE_ORDER MSB_LAST FORMAT "%7.4" /end MEASUREMENT
/begin MEASUREMENT crk_cyl_lam[0] "Value of phase displacement" UBYTE _CNV_A_R_LINEAR_____159_CM 1 100. 0. 1440. DISPLAY_IDENTIFIER CRK_CYL_LAM_0 ECU_ADDRESS 0x3fe4eb FORMAT "%4.0" /end MEASUREMENT
/begin MEASUREMENT crk_cyl_lam[1] "Value of phase displacement" UBYTE _CNV_A_R_LINEAR_____159_CM 1 100. 0. 1440. DISPLAY_IDENTIFIER CRK_CYL_LAM_1 ECU_ADDRESS 0x3fe4ec FORMAT "%4.0" /end MEASUREMENT
/begin MEASUREMENT crk_cyl_lam[2] "Value of phase displacement" UBYTE _CNV_A_R_LINEAR_____159_CM 1 100. 0. 1440. DISPLAY_IDENTIFIER CRK_CYL_LAM_2 ECU_ADDRESS 0x3fe4ed FORMAT "%4.0" /end MEASUREMENT
/begin MEASUREMENT crk_cyl_lam[3] "Value of phase displacement" UBYTE _CNV_A_R_LINEAR_____159_CM 1 100. 0. 1440. DISPLAY_IDENTIFIER CRK_CYL_LAM_3 ECU_ADDRESS 0x3fe4ee FORMAT "%4.0" /end MEASUREMENT
/begin MEASUREMENT crk_cyl_lam[4] "Value of phase displacement" UBYTE _CNV_A_R_LINEAR_____159_CM 1 100. 0. 1440. DISPLAY_IDENTIFIER CRK_CYL_LAM_4 ECU_ADDRESS 0x3fe4ef FORMAT "%4.0" /end MEASUREMENT
/begin MEASUREMENT crk_cyl_lam[5] "Value of phase displacement" UBYTE _CNV_A_R_LINEAR_____159_CM 1 100. 0. 1440. DISPLAY_IDENTIFIER CRK_CYL_LAM_5 ECU_ADDRESS 0x3fe4f0 FORMAT "%4.0" /end MEASUREMENT
/begin MEASUREMENT lv_cyl_lam_lim_min_0 "Status detection of lower limit outrun" UBYTE _CNV_S_2_RANGE______2_CM 1 100. 0. 1. DISPLAY_IDENTIFIER LV_CYL_LAM_LIM_MIN_0 ECU_ADDRESS 0x3fe4f3 /end MEASUREMENT
/begin MEASUREMENT lv_cyl_lam_lim_min_1 "Status detection of lower limit outrun" UBYTE _CNV_S_2_RANGE______2_CM 1 100. 0. 1. DISPLAY_IDENTIFIER LV_CYL_LAM_LIM_MIN_1 ECU_ADDRESS 0x3fe4f4 /end MEASUREMENT
/begin MEASUREMENT lv_cyl_lam_lim_min_2 "Status detection of lower limit outrun" UBYTE _CNV_S_2_RANGE______2_CM 1 100. 0. 1. DISPLAY_IDENTIFIER LV_CYL_LAM_LIM_MIN_2 ECU_ADDRESS 0x3fe4f5 /end MEASUREMENT
/begin MEASUREMENT lv_cyl_lam_lim_min_3 "Status detection of lower limit outrun" UBYTE _CNV_S_2_RANGE______2_CM 1 100. 0. 1. DISPLAY_IDENTIFIER LV_CYL_LAM_LIM_MIN_3 ECU_ADDRESS 0x3fe4f9 /end MEASUREMENT
/begin MEASUREMENT lv_cyl_lam_lim_min_4 "Status detection of lower limit outrun" UBYTE _CNV_S_2_RANGE______2_CM 1 100. 0. 1. DISPLAY_IDENTIFIER LV_CYL_LAM_LIM_MIN_4 ECU_ADDRESS 0x3fe4fb /end MEASUREMENT
/begin MEASUREMENT lv_cyl_lam_lim_min_5 "Status detection of lower limit outrun" UBYTE _CNV_S_2_RANGE______2_CM 1 100. 0. 1. DISPLAY_IDENTIFIER LV_CYL_LAM_LIM_MIN_5 ECU_ADDRESS 0x3fe4fd /end MEASUREMENT
/begin MEASUREMENT lv_cyl_lam_lim_max_0 "Status detection of upper limit outrun" UBYTE _CNV_S_2_RANGE______2_CM 1 100. 0. 1. DISPLAY_IDENTIFIER LV_CYL_LAM_LIM_MAX_0 ECU_ADDRESS 0x3fe4f6 /end MEASUREMENT
/begin MEASUREMENT lv_cyl_lam_lim_max_1 "Status detection of upper limit outrun" UBYTE _CNV_S_2_RANGE______2_CM 1 100. 0. 1. DISPLAY_IDENTIFIER LV_CYL_LAM_LIM_MAX_1 ECU_ADDRESS 0x3fe4f7 /end MEASUREMENT
/begin MEASUREMENT lv_cyl_lam_lim_max_2 "Status detection of upper limit outrun" UBYTE _CNV_S_2_RANGE______2_CM 1 100. 0. 1. DISPLAY_IDENTIFIER LV_CYL_LAM_LIM_MAX_2 ECU_ADDRESS 0x3fe4f8 /end MEASUREMENT
/begin MEASUREMENT lv_cyl_lam_lim_max_3 "Status detection of upper limit outrun" UBYTE _CNV_S_2_RANGE______2_CM 1 100. 0. 1. DISPLAY_IDENTIFIER LV_CYL_LAM_LIM_MAX_3 ECU_ADDRESS 0x3fe4fa /end MEASUREMENT
/begin MEASUREMENT lv_cyl_lam_lim_max_4 "Status detection of upper limit outrun" UBYTE _CNV_S_2_RANGE______2_CM 1 100. 0. 1. DISPLAY_IDENTIFIER LV_CYL_LAM_LIM_MAX_4 ECU_ADDRESS 0x3fe4fc /end MEASUREMENT
/begin MEASUREMENT lv_cyl_lam_lim_max_5 "Status detection of upper limit outrun" UBYTE _CNV_S_2_RANGE______2_CM 1 100. 0. 1. DISPLAY_IDENTIFIER LV_CYL_LAM_LIM_MAX_5 ECU_ADDRESS 0x3fe4fe /end MEASUREMENT
/begin MEASUREMENT lv_lam_cyl_act_2 "Cylinder individual lambda control is active" UBYTE _CNV_S_2_RANGE______2_CM 1 100. 0. 1. DISPLAY_IDENTIFIER LV_LAM_CYL_ACT_2 ECU_ADDRESS 0x3fe516 /end MEASUREMENT
/begin MEASUREMENT lv_lam_cyl_act_1 "Cylinder individual lambda control is active" UBYTE _CNV_S_2_RANGE______2_CM 1 100. 0. 1. DISPLAY_IDENTIFIER LV_LAM_CYL_ACT_1 ECU_ADDRESS 0x3fe513 /end MEASUREMENT
/begin MEASUREMENT fac_t "Fime factor of the exponential function for the sensor model" UWORD _CNV_A_R_LINEAR_____118_CM 1 100. 0. 63.99902344 DISPLAY_IDENTIFIER FAC_T ECU_ADDRESS 0x3fd484 BYTE_ORDER MSB_LAST FORMAT "%7.4" /end MEASUREMENT
/begin MEASUREMENT delta_crk_cyl_lam_1 "Value of adapted phase displacement" SBYTE _CNV_A_R_LINEAR_____159_CM 1 100. -720. 720. DISPLAY_IDENTIFIER DELTA_CRK_CYL_LAM_1 ECU_ADDRESS 0x3fe4f1 FORMAT "%6.1" /end MEASUREMENT
/begin MEASUREMENT delta_crk_cyl_lam_2 "Value of adapted phase displacement" SBYTE _CNV_A_R_LINEAR_____159_CM 1 100. -720. 720. DISPLAY_IDENTIFIER DELTA_CRK_CYL_LAM_2 ECU_ADDRESS 0x3fe4f2 FORMAT "%6.1" /end MEASUREMENT
/begin MEASUREMENT delta_lamb_err_cyl_sel[0] "Weighted estimation-error (split)" SWORD _CNV_A_R_LINEAR_____25_CM 1 100. -8. 7.99975586 DISPLAY_IDENTIFIER DELTA_LAMB_ERR_CYL_SEL_0 ECU_ADDRESS 0x3fd454 BYTE_ORDER MSB_LAST FORMAT "%7.4" /end MEASUREMENT
/begin MEASUREMENT delta_lamb_err_cyl_sel[1] "Weighted estimation-error (split)" SWORD _CNV_A_R_LINEAR_____25_CM 1 100. -8. 7.99975586 DISPLAY_IDENTIFIER DELTA_LAMB_ERR_CYL_SEL_1 ECU_ADDRESS 0x3fd456 BYTE_ORDER MSB_LAST FORMAT "%7.4" /end MEASUREMENT
/begin MEASUREMENT delta_lamb_err_cyl_sel[2] "Weighted estimation-error (split)" SWORD _CNV_A_R_LINEAR_____25_CM 1 100. -8. 7.99975586 DISPLAY_IDENTIFIER DELTA_LAMB_ERR_CYL_SEL_2 ECU_ADDRESS 0x3fd458 BYTE_ORDER MSB_LAST FORMAT "%7.4" /end MEASUREMENT
/begin MEASUREMENT delta_lamb_err_cyl_sel[3] "Weighted estimation-error (split)" SWORD _CNV_A_R_LINEAR_____25_CM 1 100. -8. 7.99975586 DISPLAY_IDENTIFIER DELTA_LAMB_ERR_CYL_SEL_3 ECU_ADDRESS 0x3fd45a BYTE_ORDER MSB_LAST FORMAT "%7.4" /end MEASUREMENT
/begin MEASUREMENT delta_lamb_err_cyl_sel[4] "Weighted estimation-error (split)" SWORD _CNV_A_R_LINEAR_____25_CM 1 100. -8. 7.99975586 DISPLAY_IDENTIFIER DELTA_LAMB_ERR_CYL_SEL_4 ECU_ADDRESS 0x3fd45c BYTE_ORDER MSB_LAST FORMAT "%7.4" /end MEASUREMENT
/begin MEASUREMENT delta_lamb_err_cyl_sel[5] "Weighted estimation-error (split)" SWORD _CNV_A_R_LINEAR_____25_CM 1 100. -8. 7.99975586 DISPLAY_IDENTIFIER DELTA_LAMB_ERR_CYL_SEL_5 ECU_ADDRESS 0x3fd45e BYTE_ORDER MSB_LAST FORMAT "%7.4" /end MEASUREMENT
/begin MEASUREMENT vls_cyl_sel[0] "Upstream oxygen sensor voltage (cylinder individual)" UWORD _CNV_A_R_LINEAR_____3_CM 1 100. 0. 4.99511719 DISPLAY_IDENTIFIER VLS_CYL_SEL_0 ECU_ADDRESS 0x3fd478 BYTE_ORDER MSB_LAST FORMAT "%5.3" /end MEASUREMENT
/begin MEASUREMENT vls_cyl_sel[1] "Upstream oxygen sensor voltage (cylinder individual)" UWORD _CNV_A_R_LINEAR_____3_CM 1 100. 0. 4.99511719 DISPLAY_IDENTIFIER VLS_CYL_SEL_1 ECU_ADDRESS 0x3fd47a BYTE_ORDER MSB_LAST FORMAT "%5.3" /end MEASUREMENT
/begin MEASUREMENT vls_cyl_sel[2] "Upstream oxygen sensor voltage (cylinder individual)" UWORD _CNV_A_R_LINEAR_____3_CM 1 100. 0. 4.99511719 DISPLAY_IDENTIFIER VLS_CYL_SEL_2 ECU_ADDRESS 0x3fd47c BYTE_ORDER MSB_LAST FORMAT "%5.3" /end MEASUREMENT
/begin MEASUREMENT vls_cyl_sel[3] "Upstream oxygen sensor voltage (cylinder individual)" UWORD _CNV_A_R_LINEAR_____3_CM 1 100. 0. 4.99511719 DISPLAY_IDENTIFIER VLS_CYL_SEL_3 ECU_ADDRESS 0x3fd47e BYTE_ORDER MSB_LAST FORMAT "%5.3" /end MEASUREMENT
/begin MEASUREMENT vls_cyl_sel[4] "Upstream oxygen sensor voltage (cylinder individual)" UWORD _CNV_A_R_LINEAR_____3_CM 1 100. 0. 4.99511719 DISPLAY_IDENTIFIER VLS_CYL_SEL_4 ECU_ADDRESS 0x3fd480 BYTE_ORDER MSB_LAST FORMAT "%5.3" /end MEASUREMENT
/begin MEASUREMENT vls_cyl_sel[5] "Upstream oxygen sensor voltage (cylinder individual)" UWORD _CNV_A_R_LINEAR_____3_CM 1 100. 0. 4.99511719 DISPLAY_IDENTIFIER VLS_CYL_SEL_5 ECU_ADDRESS 0x3fd482 BYTE_ORDER MSB_LAST FORMAT "%5.3" /end MEASUREMENT
/begin MEASUREMENT vls_cyl_sel_cq_1 "Characteristic value of upstream oxygen sensor" UWORD _CNV_A_R_LINEAR_____160_CM 1 100. 0. 4.98 DISPLAY_IDENTIFIER VLS_CYL_SEL_CQ_1 ECU_ADDRESS 0x3fd3b0 BYTE_ORDER MSB_LAST FORMAT "%5.3" /end MEASUREMENT
/begin MEASUREMENT vls_cyl_sel_cq_2 "Characteristic value of upstream oxygen sensor" UWORD _CNV_A_R_LINEAR_____160_CM 1 100. 0. 4.98 DISPLAY_IDENTIFIER VLS_CYL_SEL_CQ_2 ECU_ADDRESS 0x3fd3b2 BYTE_ORDER MSB_LAST FORMAT "%5.3" /end MEASUREMENT
/begin AXIS_PTS ldp_vls_cyl_sel_ip_lamb_2 "" 0xffe51680 online_dummy _REC_AXS_20_u2 4.99511719 _CNV_A_R_LINEAR_____3_CM 16 0. 4.99511719 DISPLAY_IDENTIFIER LDP_VLS_CYL_SEL_IP_LAMB_2 FORMAT "%5.3" /end AXIS_PTS
/begin AXIS_PTS ldp_vls_cyl_sel_ip_lamb_1 "" 0xffe5165e online_dummy _REC_AXS_20_u2 4.99511719 _CNV_A_R_LINEAR_____3_CM 16 0. 4.99511719 DISPLAY_IDENTIFIER LDP_VLS_CYL_SEL_IP_LAMB_1 FORMAT "%5.3" /end AXIS_PTS
/begin AXIS_PTS ldpm_fac_t_1_laco "" 0xffe5183a online_dummy _REC_AXS_20_u2 63.99902344 _CNV_A_R_LINEAR_____118_CM 16 0. 63.99902344 DISPLAY_IDENTIFIER LDPM_FAC_T_1_LACO FORMAT "%7.4" /end AXIS_PTS
/begin AXIS_PTS ldp_n_ip_crk_syn "" 0xffe51070 n _REC_AXS_20_u2 8160. _CNV_A_R_LINEAR_____10_CM 8 0. 8160. DISPLAY_IDENTIFIER LDP_N_IP_CRK_SYN FORMAT "%4.0" /end AXIS_PTS
/begin AXIS_PTS ldp_maf_ip_crk_syn "" 0xffe50db2 maf _REC_AXS_20_u2 1389. _CNV_A_R_LINEAR_____108_CM 8 0. 1389. DISPLAY_IDENTIFIER LDP_MAF_IP_CRK_SYN FORMAT "%7.2" /end AXIS_PTS
/begin AXIS_PTS ldp_t1_lamb_ip_fac_err_lam_sel "" 0xffe51280 online_dummy _REC_AXS_20_u2 1.99996948 _CNV_A_R_LINEAR_____163_CM 6 0. 1.99996948 DISPLAY_IDENTIFIER LDP_T1_LAMB_IP_FAC_ERR_LAM_SEL FORMAT "%6.4" /end AXIS_PTS
/begin AXIS_PTS ldp_n_ip_crlc_cyl_lam "" 0xffe51082 n _REC_AXS_20_u2 8160. _CNV_A_R_LINEAR_____10_CM 8 0. 8160. DISPLAY_IDENTIFIER LDP_N_IP_CRLC_CYL_LAM FORMAT "%4.0" /end AXIS_PTS
/begin AXIS_PTS ldp_maf_ip_crlc_cyl_lam "" 0xffe50dc4 maf_kgh _REC_AXS_20_u2 1389. _CNV_A_R_LINEAR_____108_CM 8 0. 1389. DISPLAY_IDENTIFIER LDP_MAF_IP_CRLC_CYL_LAM FORMAT "%7.2" /end AXIS_PTS
/begin AXIS_PTS ldp_n_32_ip_maf_delta_crk_max "" 0xffe410f8 n_32 _REC_AXS_20_u1 8160. _CNV_A_R_LINEAR_____15_CM 6 0. 8160. DISPLAY_IDENTIFIER LDP_N_32_IP_MAF_DELTA_CRK_MAX FORMAT "%4.0" /end AXIS_PTS
/begin AXIS_PTS ldp_n_32_ip_maf_delta_crk_min "" 0xffe410ff n_32 _REC_AXS_20_u1 8160. _CNV_A_R_LINEAR_____15_CM 6 0. 8160. DISPLAY_IDENTIFIER LDP_N_32_IP_MAF_DELTA_CRK_MIN FORMAT "%4.0" /end AXIS_PTS
/begin CHARACTERISTIC c_maf_lam_cyl_min "Minimum mass air flow for the activation" VALUE 0xffe417b0 _REC_VAL_20_u2 1389. _CNV_A_R_LINEAR_____108_CM 0. 1389. DISPLAY_IDENTIFIER C_MAF_LAM_CYL_MIN FORMAT "%7.2" /end CHARACTERISTIC
/begin CHARACTERISTIC c_maf_lam_cyl_max "Maximum mass air flow for the activation" VALUE 0xffe417ae _REC_VAL_20_u2 1389. _CNV_A_R_LINEAR_____108_CM 0. 1389. DISPLAY_IDENTIFIER C_MAF_LAM_CYL_MAX FORMAT "%7.2" /end CHARACTERISTIC
/begin CHARACTERISTIC c_tco_lam_cyl_min "Minimum coolant temperature for the activation" VALUE 0xffe40903 _REC_VAL_20_u1 190.5 _CNV_A_R_LINEAR_____11_CM -48. 142.5 DISPLAY_IDENTIFIER C_TCO_LAM_CYL_MIN FORMAT "%5.1" /end CHARACTERISTIC
/begin CHARACTERISTIC c_n_lam_cyl_min "Minimum engine speed for the activation" VALUE 0xffe41808 _REC_VAL_20_u2 8160. _CNV_A_R_LINEAR_____10_CM 0. 8160. DISPLAY_IDENTIFIER C_N_LAM_CYL_MIN FORMAT "%4.0" /end CHARACTERISTIC
/begin CHARACTERISTIC c_n_lam_cyl_max "Maximum engine speed for the activation" VALUE 0xffe41806 _REC_VAL_20_u2 8160. _CNV_A_R_LINEAR_____10_CM 0. 8160. DISPLAY_IDENTIFIER C_N_LAM_CYL_MAX FORMAT "%4.0" /end CHARACTERISTIC
/begin MEASUREMENT lv_lam_cyl_ena_1 "Activation of the cylinder individual lambda control is open" UBYTE _CNV_S_2_RANGE______2_CM 1 100. 0. 1. DISPLAY_IDENTIFIER LV_LAM_CYL_ENA_1 ECU_ADDRESS 0x3fe573 /end MEASUREMENT
/begin MEASUREMENT lv_lam_cyl_ena_2 "Activation of the cylinder individual lambda control is open" UBYTE _CNV_S_2_RANGE______2_CM 1 100. 0. 1. DISPLAY_IDENTIFIER LV_LAM_CYL_ENA_2 ECU_ADDRESS 0x3fe574 /end MEASUREMENT
/begin MEASUREMENT pha_shift_cam_ex_1 "variable phase shift (variable valve timing)" SBYTE _CNV_A_R_LINEAR_____159_CM 1 100. -720. 720. DISPLAY_IDENTIFIER PHA_SHIFT_CAM_EX_1 ECU_ADDRESS 0x3fe571 FORMAT "%6.1" /end MEASUREMENT
/begin MEASUREMENT pha_shift_cam_ex_2 "variable phase shift (variable valve timing)" SBYTE _CNV_A_R_LINEAR_____159_CM 1 100. -720. 720. DISPLAY_IDENTIFIER PHA_SHIFT_CAM_EX_2 ECU_ADDRESS 0x3fe572 FORMAT "%6.1" /end MEASUREMENT
/begin AXIS_PTS ldp_maf_kgh__crlc_vls_down "" 0xffe50e00 maf_kgh _REC_AXS_20_u2 2047.96875 _CNV_A_R_LINEAR_____115_CM 4 0. 2047.96875 DISPLAY_IDENTIFIER LDP_MAF_KGH__CRLC_VLS_DOWN FORMAT "%7.2" /end AXIS_PTS
/begin CHARACTERISTIC id_crlc_vls_down_t_dly "correlation constant downstream signal" CURVE 0xffe40a05 _REC_CUR_20_u1_u2 0.9960940000000002 _CNV_A_R_LINEAR_____50_CM 0. 0.996094 DISPLAY_IDENTIFIER ID_CRLC_VLS_DOWN_T_DLY FORMAT "%5.3"
 /begin AXIS_DESCR COM_AXIS maf_kgh _CNV_A_R_LINEAR_____115_CM 4 0. 2047.96875 FORMAT "%7.2" AXIS_PTS_REF ldp_maf_kgh__crlc_vls_down /end AXIS_DESCR
/end CHARACTERISTIC
/begin CHARACTERISTIC lc_delta_lamb_i_ad_ext_adj "LC for external adjustment of adaptation value for the lambda-shift" VALUE 0xffe40f4a _REC_VAL_20_u1 1. _CNV_A_R_LINEAR_____0_CM 0. 1. DISPLAY_IDENTIFIER LC_DELTA_LAMB_I_AD_EXT_ADJ FORMAT "%2.0" /end CHARACTERISTIC
/begin MEASUREMENT lv_delta_lamb_i_ad_ext_adj "LV indicating external adjustment of adaptation value for the lambda-shift" UBYTE _CNV_S_2_RANGE______2_CM 1 100. 0. 1. DISPLAY_IDENTIFIER LV_DELTA_LAMB_I_AD_EXT_ADJ ECU_ADDRESS 0x3fe575 /end MEASUREMENT
/begin CHARACTERISTIC id_crlc_vls_down_t_dly_cat_diag "correlation constant downstream signal" CURVE 0xffe40a09 _REC_CUR_20_u1_u2 0.9960940000000002 _CNV_A_R_LINEAR_____50_CM 0. 0.996094 DISPLAY_IDENTIFIER ID_CRLC_VLS_DOWN_T_DLY_CAT_DIAG FORMAT "%5.3"
 /begin AXIS_DESCR COM_AXIS maf_kgh _CNV_A_R_LINEAR_____115_CM 4 0. 2047.96875 FORMAT "%7.2" AXIS_PTS_REF ldp_maf_kgh__crlc_vls_down /end AXIS_DESCR
/end CHARACTERISTIC
/begin MEASUREMENT lv_dui_inj_req "Double injection requested" UBYTE _CNV_S_2_RANGE______21_CM 1 100. 0. 1. DISPLAY_IDENTIFIER LV_DUI_INJ_REQ ECU_ADDRESS 0x3fe891 BIT_MASK 0x1 /end MEASUREMENT
/begin MEASUREMENT lv_ch_s_req "request bit to ask the comb.management for stratified combustion" UBYTE _CNV_S_2_RANGE______21_CM 1 100. 0. 1. DISPLAY_IDENTIFIER LV_CH_S_REQ ECU_ADDRESS 0x3fe892 BIT_MASK 0x1 /end MEASUREMENT
/begin MEASUREMENT lv_t_tqi_swi_supp "Request bit to suppress C_T_TQI_SWI for transition to Stratified mode" UBYTE _CNV_S_2_RANGE______21_CM 1 100. 0. 1. DISPLAY_IDENTIFIER LV_T_TQI_SWI_SUPP ECU_ADDRESS 0x3fe890 BIT_MASK 0x1 /end MEASUREMENT
/begin CHARACTERISTIC c_tco_dui_min_st "minimum temperature threshold for double injection" VALUE 0xffe408f5 _REC_VAL_20_u1 190.5 _CNV_A_R_LINEAR_____11_CM -48. 142.5 DISPLAY_IDENTIFIER C_TCO_DUI_MIN_ST FORMAT "%5.1" /end CHARACTERISTIC
/begin CHARACTERISTIC c_tco_dui_max_st "maximum temperature threshold for double injection" VALUE 0xffe408f4 _REC_VAL_20_u1 190.5 _CNV_A_R_LINEAR_____11_CM -48. 142.5 DISPLAY_IDENTIFIER C_TCO_DUI_MAX_ST FORMAT "%5.1" /end CHARACTERISTIC
/begin CHARACTERISTIC c_tqi_dui_thd "threshold for torque limitation for double injection" VALUE 0xffe404ee _REC_VAL_20_s2 2047.96875 _CNV_A_R_LINEAR_____55_CM -1024. 1023.96875 DISPLAY_IDENTIFIER C_TQI_DUI_THD FORMAT "%8.2" /end CHARACTERISTIC
/begin CHARACTERISTIC c_cyc_cast_dui_thd "threshold for cycle counter limitation for double injection" VALUE 0xffe4159e _REC_VAL_20_u2 65535. _CNV_A_R_LINEAR_____0_CM 0. 65535. DISPLAY_IDENTIFIER C_CYC_CAST_DUI_THD FORMAT "%5.0" /end CHARACTERISTIC
/begin MEASUREMENT state_clc_red "Calculation reduction state for runtime optimization" UBYTE _CNV_A_R_LINEAR_____0_CM 1 100. 0. 255. DISPLAY_IDENTIFIER STATE_CLC_RED ECU_ADDRESS 0x3fe88d FORMAT "%3.0" /end MEASUREMENT
/begin MEASUREMENT ctr_cyl_nr_clc "Number of cylinder to be calculated at current segment" UBYTE _CNV_A_R_LINEAR_____0_CM 1 100. 0. 255. DISPLAY_IDENTIFIER CTR_CYL_NR_CLC ECU_ADDRESS 0x3fe88e FORMAT "%3.0" /end MEASUREMENT
/begin MEASUREMENT ctr_cbk_nr_clc "number of cylinder bank to be calculated at current segment" UBYTE _CNV_A_R_LINEAR_____177_CM 1 100. 1. 2. DISPLAY_IDENTIFIER CTR_CBK_NR_CLC ECU_ADDRESS 0x3fe88f FORMAT "%2.0" /end MEASUREMENT
/begin AXIS_PTS ldp_seg_nr_id_ctr_cyl_nr_clc "Cylinder and segment relation for runtime reduction" 0xffe41196 seg_nr _REC_AXS_20_u1 7. _CNV_A_R_LINEAR_____0_CM 6 0. 7. DISPLAY_IDENTIFIER LDP_SEG_NR_ID_CTR_CYL_NR_CLC FORMAT "%3.0" /end AXIS_PTS
/begin CHARACTERISTIC id_ctr_cyl_nr_clc "Cylinder and segment relation for runtime reduction" CURVE 0xffe40a0d _REC_CUR_20_u1_u1 7. _CNV_A_R_LINEAR_____0_CM 0. 7. DISPLAY_IDENTIFIER ID_CTR_CYL_NR_CLC FORMAT "%3.0"
 /begin AXIS_DESCR COM_AXIS seg_nr _CNV_A_R_LINEAR_____0_CM 6 0. 7. FORMAT "%3.0" AXIS_PTS_REF ldp_seg_nr_id_ctr_cyl_nr_clc /end AXIS_DESCR
/end CHARACTERISTIC
/begin CHARACTERISTIC c_seg_nr_st_clc_red "Start segment number for runtime reduction activation" VALUE 0xffe40838 _REC_VAL_20_u1 7. _CNV_A_R_LINEAR_____0_CM 0. 7. DISPLAY_IDENTIFIER C_SEG_NR_ST_CLC_RED FORMAT "%3.0" /end CHARACTERISTIC
/begin CHARACTERISTIC c_n_32_thd_clc_red "Engine speed threshold for activation of runtime reduction" VALUE 0xffe407c8 _REC_VAL_20_u1 8160. _CNV_A_R_LINEAR_____15_CM 0. 8160. DISPLAY_IDENTIFIER C_N_32_THD_CLC_RED FORMAT "%4.0" /end CHARACTERISTIC
/begin CHARACTERISTIC c_n_32_hys_clc_red "Engine speed hysteresis for activation of runtime reduction" VALUE 0xffe407c3 _REC_VAL_20_u1 2016. _CNV_A_R_LINEAR_____15_CM 0. 2016. DISPLAY_IDENTIFIER C_N_32_HYS_CLC_RED FORMAT "%4.0" /end CHARACTERISTIC
/begin CHARACTERISTIC c_lam_mv_lpf_crlc "correlation constant for the calculation of the filtered controller-output meanvalue LAM_MV_LPF" VALUE 0xffe40786 _REC_VAL_20_u1 0.9960940000000002 _CNV_A_R_LINEAR_____50_CM 0. 0.996094 DISPLAY_IDENTIFIER C_LAM_MV_LPF_CRLC FORMAT "%5.3" /end CHARACTERISTIC
/begin CHARACTERISTIC c_lam_n_min "minimum speed for the activation of the lambda-controller" VALUE 0xffe40787 _REC_VAL_20_u1 8160. _CNV_A_R_LINEAR_____15_CM 0. 8160. DISPLAY_IDENTIFIER C_LAM_N_MIN FORMAT "%4.0" /end CHARACTERISTIC
/begin CHARACTERISTIC c_lam_mv_crlc "correlation constant for the calculation of the controller-output meanvalue LAM_MV" VALUE 0xffe40785 _REC_VAL_20_u1 0.9960940000000002 _CNV_A_R_LINEAR_____50_CM 0. 0.996094 DISPLAY_IDENTIFIER C_LAM_MV_CRLC FORMAT "%5.3" /end CHARACTERISTIC
/begin CHARACTERISTIC c_lam_p_max "top limitation of the P-share during activated CP" VALUE 0xffe4043a _REC_VAL_20_s2 99.99847412 _CNV_A_R_LINEAR_____111_CM -50. 49.99847412 DISPLAY_IDENTIFIER C_LAM_P_MAX FORMAT "%7.3" /end CHARACTERISTIC
/begin CHARACTERISTIC c_lam_p_max_cp "top limitation of the P-share" VALUE 0xffe4043c _REC_VAL_20_s2 99.99847412 _CNV_A_R_LINEAR_____111_CM -50. 49.99847412 DISPLAY_IDENTIFIER C_LAM_P_MAX_CP FORMAT "%7.3" /end CHARACTERISTIC
/begin CHARACTERISTIC c_lam_p_min_cp "bottom limitation of the P-share during activated CP" VALUE 0xffe40440 _REC_VAL_20_s2 99.99847412 _CNV_A_R_LINEAR_____111_CM -50. 49.99847412 DISPLAY_IDENTIFIER C_LAM_P_MIN_CP FORMAT "%7.3" /end CHARACTERISTIC
/begin CHARACTERISTIC c_lam_i_i_min_cp "bottom limitation of the  I²-share during activated CP" VALUE 0xffe4042c _REC_VAL_20_s2 99.99847412 _CNV_A_R_LINEAR_____111_CM -50. 49.99847412 DISPLAY_IDENTIFIER C_LAM_I_I_MIN_CP FORMAT "%7.3" /end CHARACTERISTIC
/begin CHARACTERISTIC c_lam_i_i_max_cp "top limitation of the I²-share during activated CP" VALUE 0xffe40428 _REC_VAL_20_s2 99.99847412 _CNV_A_R_LINEAR_____111_CM -50. 49.99847412 DISPLAY_IDENTIFIER C_LAM_I_I_MAX_CP FORMAT "%7.3" /end CHARACTERISTIC
/begin CHARACTERISTIC c_lam_i_i_max "top limitation of the I²-share" VALUE 0xffe40426 _REC_VAL_20_s2 99.99847412 _CNV_A_R_LINEAR_____111_CM -50. 49.99847412 DISPLAY_IDENTIFIER C_LAM_I_I_MAX FORMAT "%7.3" /end CHARACTERISTIC
/begin CHARACTERISTIC c_lam_i_i_min "bottom limitation of the I²-share" VALUE 0xffe4042a _REC_VAL_20_s2 99.99847412 _CNV_A_R_LINEAR_____111_CM -50. 49.99847412 DISPLAY_IDENTIFIER C_LAM_I_I_MIN FORMAT "%7.3" /end CHARACTERISTIC
/begin CHARACTERISTIC c_lam_d_min "bottom limitation of the D-share" VALUE 0xffe40422 _REC_VAL_20_s2 99.99847412 _CNV_A_R_LINEAR_____111_CM -50. 49.99847412 DISPLAY_IDENTIFIER C_LAM_D_MIN FORMAT "%7.3" /end CHARACTERISTIC
/begin CHARACTERISTIC c_lam_d_max "top limitation of the D-share" VALUE 0xffe40420 _REC_VAL_20_s2 99.99847412 _CNV_A_R_LINEAR_____111_CM -50. 49.99847412 DISPLAY_IDENTIFIER C_LAM_D_MAX FORMAT "%7.3" /end CHARACTERISTIC
/begin CHARACTERISTIC c_lam_out_min "bottom limitation of the controller output" VALUE 0xffe40436 _REC_VAL_20_s2 99.99847412 _CNV_A_R_LINEAR_____111_CM -50. 49.99847412 DISPLAY_IDENTIFIER C_LAM_OUT_MIN FORMAT "%7.3" /end CHARACTERISTIC
/begin CHARACTERISTIC c_lam_out_min_cp "bottom limitation of the controller output during activated CP" VALUE 0xffe40438 _REC_VAL_20_s2 99.99847412 _CNV_A_R_LINEAR_____111_CM -50. 49.99847412 DISPLAY_IDENTIFIER C_LAM_OUT_MIN_CP FORMAT "%7.3" /end CHARACTERISTIC
/begin CHARACTERISTIC c_lam_out_max_cp "top limitation of the controller output during activated CP" VALUE 0xffe40434 _REC_VAL_20_s2 99.99847412 _CNV_A_R_LINEAR_____111_CM -50. 49.99847412 DISPLAY_IDENTIFIER C_LAM_OUT_MAX_CP FORMAT "%7.3" /end CHARACTERISTIC
/begin CHARACTERISTIC c_lam_out_max "top limitation of the controller output" VALUE 0xffe40432 _REC_VAL_20_s2 99.99847412 _CNV_A_R_LINEAR_____111_CM -50. 49.99847412 DISPLAY_IDENTIFIER C_LAM_OUT_MAX FORMAT "%7.3" /end CHARACTERISTIC
/begin CHARACTERISTIC ip_crlc_lam_mv_lpf_cp "Damping constant of the low pass filter used by canister purge" CURVE 0xffe40ae5 _REC_CUR_20_u1_u2 0.99610001 _CNV_A_R_LINEAR_____29_CM 0. 0.99610001 DISPLAY_IDENTIFIER IP_CRLC_LAM_MV_LPF_CP FORMAT "%5.3"
 /begin AXIS_DESCR COM_AXIS maf_cyl _CNV_A_R_LINEAR_____115_CM 6 0. 2047.96875 FORMAT "%7.2" AXIS_PTS_REF ldp_maf_cyl_ip_crlc_lam_mv_lpf /end AXIS_DESCR
/end CHARACTERISTIC
/begin CHARACTERISTIC id_lam_cor_min_intr "lower limit of controller output under non-stationary operating conditions" CURVE 0xffe43f2c _REC_CUR_20_s2_u2 99.99847412 _CNV_A_R_LINEAR_____111_CM -50. 49.99847412 DISPLAY_IDENTIFIER ID_LAM_COR_MIN_INTR FORMAT "%7.3"
 /begin AXIS_DESCR COM_AXIS lam_bank_1.lam_up.lam_mv _CNV_A_R_LINEAR_____262_CM 8 -50. 49.99847412 FORMAT "%7.3" AXIS_PTS_REF ldp_lam_mv_id_lam_cor_min_intr /end AXIS_DESCR
/end CHARACTERISTIC
/begin CHARACTERISTIC id_lam_cor_max_intr "upper limit of controller output under non-stationary operating conditions" CURVE 0xffe43f1c _REC_CUR_20_s2_u2 99.99847412 _CNV_A_R_LINEAR_____111_CM -50. 49.99847412 DISPLAY_IDENTIFIER ID_LAM_COR_MAX_INTR FORMAT "%7.3"
 /begin AXIS_DESCR COM_AXIS lam_bank_1.lam_up.lam_mv _CNV_A_R_LINEAR_____262_CM 8 -50. 49.99847412 FORMAT "%7.3" AXIS_PTS_REF ldp_lam_mv_id_lam_cor_max_intr /end AXIS_DESCR
/end CHARACTERISTIC
/begin CHARACTERISTIC c_lam_p_min "bottom limitation of the P-share" VALUE 0xffe4043e _REC_VAL_20_s2 99.99847412 _CNV_A_R_LINEAR_____111_CM -50. 49.99847412 DISPLAY_IDENTIFIER C_LAM_P_MIN FORMAT "%7.3" /end CHARACTERISTIC
/begin CHARACTERISTIC ip_t1_lamb_1 "time lag of the lambda-sensor model" MAP 0xffe4e4ee _REC_MAP_20_u2_u2_u2 1.99996948 _CNV_A_R_LINEAR_____163_CM 0. 1.99996948 DISPLAY_IDENTIFIER IP_T1_LAMB_1 FORMAT "%6.4"
 /begin AXIS_DESCR COM_AXIS n _CNV_A_R_LINEAR_____10_CM 8 0. 8160. FORMAT "%4.0" AXIS_PTS_REF ldpm_n_1_laco /end AXIS_DESCR
 /begin AXIS_DESCR COM_AXIS maf _CNV_A_R_LINEAR_____108_CM 8 0. 1389. FORMAT "%4.0" AXIS_PTS_REF ldpm_maf_1_laco /end AXIS_DESCR
/end CHARACTERISTIC
/begin CHARACTERISTIC c_fac_lam_i_delta_max "maximum delta per sample step for FAC_LAM_I_i" VALUE 0xffe4160a _REC_VAL_20_u2 49.999237 _CNV_A_R_LINEAR_____263_CM 0. 49.999237 DISPLAY_IDENTIFIER C_FAC_LAM_I_DELTA_MAX FORMAT "%7.4" /end CHARACTERISTIC
/begin CHARACTERISTIC ip_t1_lamb_2 "time lag of the lambda-sensor model" MAP 0xffe4e56e _REC_MAP_20_u2_u2_u2 1.99996948 _CNV_A_R_LINEAR_____163_CM 0. 1.99996948 DISPLAY_IDENTIFIER IP_T1_LAMB_2 FORMAT "%6.4"
 /begin AXIS_DESCR COM_AXIS n _CNV_A_R_LINEAR_____10_CM 8 0. 8160. FORMAT "%4.0" AXIS_PTS_REF ldpm_n_1_laco /end AXIS_DESCR
 /begin AXIS_DESCR COM_AXIS maf _CNV_A_R_LINEAR_____108_CM 8 0. 1389. FORMAT "%4.0" AXIS_PTS_REF ldpm_maf_1_laco /end AXIS_DESCR
/end CHARACTERISTIC
/begin AXIS_PTS ldp_maf_cyl_ip_crlc_lam_mv_lpf "" 0xffe50d46 maf_cyl _REC_AXS_20_u2 2047.96875 _CNV_A_R_LINEAR_____115_CM 6 0. 2047.96875 DISPLAY_IDENTIFIER LDP_MAF_CYL_IP_CRLC_LAM_MV_LPF FORMAT "%7.2" /end AXIS_PTS
/begin AXIS_PTS ldp_lam_mv_id_lam_cor_min_intr "" 0xffe50c46 lam_bank_1.lam_up.lam_mv _REC_AXS_20_u2 99.99847412 _CNV_A_R_LINEAR_____262_CM 8 -50. 49.99847412 DISPLAY_IDENTIFIER LDP_LAM_MV_ID_LAM_COR_MIN_INTR FORMAT "%7.3" /end AXIS_PTS
/begin AXIS_PTS ldp_lam_mv_id_lam_cor_max_intr "" 0xffe50c34 lam_bank_1.lam_up.lam_mv _REC_AXS_20_u2 99.99847412 _CNV_A_R_LINEAR_____262_CM 8 -50. 49.99847412 DISPLAY_IDENTIFIER LDP_LAM_MV_ID_LAM_COR_MAX_INTR FORMAT "%7.3" /end AXIS_PTS
/begin AXIS_PTS ldpm_n_1_laco "" 0xffe51a88 n _REC_AXS_20_u2 8160. _CNV_A_R_LINEAR_____10_CM 8 0. 8160. DISPLAY_IDENTIFIER LDPM_N_1_LACO FORMAT "%4.0" /end AXIS_PTS
/begin AXIS_PTS ldpm_t1_lamb_1_lamb_ctl "" 0xffe51cc4 online_dummy _REC_AXS_20_u2 1.99996948 _CNV_A_R_LINEAR_____163_CM 8 0. 1.99996948 DISPLAY_IDENTIFIER LDPM_T1_LAMB_1_LAMB_CTL FORMAT "%6.4" /end AXIS_PTS
/begin AXIS_PTS ldpm_t1_lamb_2_lamb_ctl "" 0xffe51cd6 online_dummy _REC_AXS_20_u2 1.99996948 _CNV_A_R_LINEAR_____163_CM 4 0. 1.99996948 DISPLAY_IDENTIFIER LDPM_T1_LAMB_2_LAMB_CTL FORMAT "%6.4" /end AXIS_PTS
/begin AXIS_PTS ldpm_dly_1_lamb_ctl "" 0xffe517e6 lam_bank_1.lam_up.dly _REC_AXS_20_u2 1.049983 _CNV_A_R_LINEAR_____264_CM 8 0. 1.049983 DISPLAY_IDENTIFIER LDPM_DLY_1_LAMB_CTL FORMAT "%6.4" /end AXIS_PTS
/begin AXIS_PTS ldpm_dly_2_lamb_ctl "" 0xffe517f8 lam_bank_1.lam_up.dly _REC_AXS_20_u2 1.049983 _CNV_A_R_LINEAR_____264_CM 4 0. 1.049983 DISPLAY_IDENTIFIER LDPM_DLY_2_LAMB_CTL FORMAT "%6.4" /end AXIS_PTS
/begin CHARACTERISTIC ip_lam_p "gain of the P-share" MAP 0xffe4c242 _REC_MAP_20_u2_u2_u2 15.99975586 _CNV_A_R_LINEAR_____265_CM 0. 15.99975586 DISPLAY_IDENTIFIER IP_LAM_P FORMAT "%7.4"
 /begin AXIS_DESCR COM_AXIS lam_bank_1.lam_up.dly _CNV_A_R_LINEAR_____264_CM 8 0. 1.049983 FORMAT "%6.4" AXIS_PTS_REF ldpm_dly_1_lamb_ctl /end AXIS_DESCR
 /begin AXIS_DESCR COM_AXIS online_dummy _CNV_A_R_LINEAR_____163_CM 8 0. 1.99996948 FORMAT "%6.4" AXIS_PTS_REF ldpm_t1_lamb_1_lamb_ctl /end AXIS_DESCR
/end CHARACTERISTIC
/begin CHARACTERISTIC ip_lam_p_ctl_gain_swi "gain of the P-share in case of switched parameters controlled by LV_CTL_GAIN_SWI" MAP 0xffe4c2c2 _REC_MAP_20_u2_u2_u2 15.99975586 _CNV_A_R_LINEAR_____265_CM 0. 15.99975586 DISPLAY_IDENTIFIER IP_LAM_P_CTL_GAIN_SWI FORMAT "%7.4"
 /begin AXIS_DESCR COM_AXIS lam_bank_1.lam_up.dly _CNV_A_R_LINEAR_____264_CM 4 0. 1.049983 FORMAT "%6.4" AXIS_PTS_REF ldpm_dly_2_lamb_ctl /end AXIS_DESCR
 /begin AXIS_DESCR COM_AXIS online_dummy _CNV_A_R_LINEAR_____163_CM 4 0. 1.99996948 FORMAT "%6.4" AXIS_PTS_REF ldpm_t1_lamb_2_lamb_ctl /end AXIS_DESCR
/end CHARACTERISTIC
/begin CHARACTERISTIC ip_lam_i "gain of the I-share" MAP 0xffe4c102 _REC_MAP_20_u2_u2_u2 49.989237 _CNV_A_R_LINEAR_____266_CM 1.e-002 49.999237 DISPLAY_IDENTIFIER IP_LAM_I FORMAT "%7.4"
 /begin AXIS_DESCR COM_AXIS lam_bank_1.lam_up.dly _CNV_A_R_LINEAR_____264_CM 8 0. 1.049983 FORMAT "%6.4" AXIS_PTS_REF ldpm_dly_1_lamb_ctl /end AXIS_DESCR
 /begin AXIS_DESCR COM_AXIS online_dummy _CNV_A_R_LINEAR_____163_CM 8 0. 1.99996948 FORMAT "%6.4" AXIS_PTS_REF ldpm_t1_lamb_1_lamb_ctl /end AXIS_DESCR
/end CHARACTERISTIC
/begin CHARACTERISTIC ip_lam_i_ctl_gain_swi "gain of the I-share  in case of switched parameters controlled by LV_CTL_GAIN_SWI" MAP 0xffe4c182 _REC_MAP_20_u2_u2_u2 49.989237 _CNV_A_R_LINEAR_____266_CM 1.e-002 49.999237 DISPLAY_IDENTIFIER IP_LAM_I_CTL_GAIN_SWI FORMAT "%7.4"
 /begin AXIS_DESCR COM_AXIS lam_bank_1.lam_up.dly _CNV_A_R_LINEAR_____264_CM 4 0. 1.049983 FORMAT "%6.4" AXIS_PTS_REF ldpm_dly_2_lamb_ctl /end AXIS_DESCR
 /begin AXIS_DESCR COM_AXIS online_dummy _CNV_A_R_LINEAR_____163_CM 4 0. 1.99996948 FORMAT "%6.4" AXIS_PTS_REF ldpm_t1_lamb_2_lamb_ctl /end AXIS_DESCR
/end CHARACTERISTIC
/begin CHARACTERISTIC ip_lam_i_i "gain of the I²-share" MAP 0xffe4c1a2 _REC_MAP_20_u2_u2_u2 24.99961853 _CNV_A_R_LINEAR_____267_CM 0. 24.99961853 DISPLAY_IDENTIFIER IP_LAM_I_I FORMAT "%7.4"
 /begin AXIS_DESCR COM_AXIS lam_bank_1.lam_up.dly _CNV_A_R_LINEAR_____264_CM 8 0. 1.049983 FORMAT "%6.4" AXIS_PTS_REF ldpm_dly_1_lamb_ctl /end AXIS_DESCR
 /begin AXIS_DESCR COM_AXIS online_dummy _CNV_A_R_LINEAR_____163_CM 8 0. 1.99996948 FORMAT "%6.4" AXIS_PTS_REF ldpm_t1_lamb_1_lamb_ctl /end AXIS_DESCR
/end CHARACTERISTIC
/begin CHARACTERISTIC ip_lam_i_i_ctl_gain_swi "gain of the I²-share  in case of switched parameters controlled by LV_CTL_GAIN_SWI" MAP 0xffe4c222 _REC_MAP_20_u2_u2_u2 24.99961853 _CNV_A_R_LINEAR_____267_CM 0. 24.99961853 DISPLAY_IDENTIFIER IP_LAM_I_I_CTL_GAIN_SWI FORMAT "%7.4"
 /begin AXIS_DESCR COM_AXIS lam_bank_1.lam_up.dly _CNV_A_R_LINEAR_____264_CM 4 0. 1.049983 FORMAT "%6.4" AXIS_PTS_REF ldpm_dly_2_lamb_ctl /end AXIS_DESCR
 /begin AXIS_DESCR COM_AXIS online_dummy _CNV_A_R_LINEAR_____163_CM 4 0. 1.99996948 FORMAT "%6.4" AXIS_PTS_REF ldpm_t1_lamb_2_lamb_ctl /end AXIS_DESCR
/end CHARACTERISTIC
/begin CHARACTERISTIC ip_lam_d "gain of the D-share" MAP 0xffe4c062 _REC_MAP_20_u2_u2_u2 3.9998e-002 _CNV_A_R_LINEAR_____268_CM 0. 3.9998e-002 DISPLAY_IDENTIFIER IP_LAM_D FORMAT "%7.5"
 /begin AXIS_DESCR COM_AXIS lam_bank_1.lam_up.dly _CNV_A_R_LINEAR_____264_CM 8 0. 1.049983 FORMAT "%6.4" AXIS_PTS_REF ldpm_dly_1_lamb_ctl /end AXIS_DESCR
 /begin AXIS_DESCR COM_AXIS online_dummy _CNV_A_R_LINEAR_____163_CM 8 0. 1.99996948 FORMAT "%6.4" AXIS_PTS_REF ldpm_t1_lamb_1_lamb_ctl /end AXIS_DESCR
/end CHARACTERISTIC
/begin CHARACTERISTIC ip_lam_d_ctl_gain_swi "gain of the D-share  in case of switched parameters controlled by LV_CTL_GAIN_SWI" MAP 0xffe4c0e2 _REC_MAP_20_u2_u2_u2 3.9998e-002 _CNV_A_R_LINEAR_____268_CM 0. 3.9998e-002 DISPLAY_IDENTIFIER IP_LAM_D_CTL_GAIN_SWI FORMAT "%7.5"
 /begin AXIS_DESCR COM_AXIS lam_bank_1.lam_up.dly _CNV_A_R_LINEAR_____264_CM 4 0. 1.049983 FORMAT "%6.4" AXIS_PTS_REF ldpm_dly_2_lamb_ctl /end AXIS_DESCR
 /begin AXIS_DESCR COM_AXIS online_dummy _CNV_A_R_LINEAR_____163_CM 4 0. 1.99996948 FORMAT "%6.4" AXIS_PTS_REF ldpm_t1_lamb_2_lamb_ctl /end AXIS_DESCR
/end CHARACTERISTIC
/begin AXIS_PTS ldpm_maf_1_laco "" 0xffe518c6 maf _REC_AXS_20_u2 1389. _CNV_A_R_LINEAR_____108_CM 8 0. 1389. DISPLAY_IDENTIFIER LDPM_MAF_1_LACO FORMAT "%4.0" /end AXIS_PTS
/begin AXIS_PTS ldpm_maf_2_laco "" 0xffe5190c maf _REC_AXS_20_u2 1389. _CNV_A_R_LINEAR_____108_CM 4 0. 1389. DISPLAY_IDENTIFIER LDPM_MAF_2_LACO FORMAT "%4.0" /end AXIS_PTS
/begin AXIS_PTS ldpm_n_2_laco "" 0xffe51ace n _REC_AXS_20_u2 8160. _CNV_A_R_LINEAR_____10_CM 4 0. 8160. DISPLAY_IDENTIFIER LDPM_N_2_LACO FORMAT "%4.0" /end AXIS_PTS
/begin CHARACTERISTIC c_crlc_lamb_dif_mmv_lam "correlation constant for the calculation of lamb_dif_mmv_lam_i" VALUE 0xffe40685 _REC_VAL_20_u1 0.9960940000000002 _CNV_A_R_LINEAR_____50_CM 0. 0.996094 DISPLAY_IDENTIFIER C_CRLC_LAMB_DIF_MMV_LAM FORMAT "%5.3" /end CHARACTERISTIC
/begin CHARACTERISTIC c_t_max_lam_i_1_save_1 "time out for correction after lam_i_1_1  was stored" VALUE 0xffe41998 _REC_VAL_20_u2 1310.7 _CNV_A_R_LINEAR_____198_CM 0. 1310.7 DISPLAY_IDENTIFIER C_T_MAX_LAM_I_1_SAVE_1 FORMAT "%7.2" /end CHARACTERISTIC
/begin CHARACTERISTIC c_t_max_lam_i_1_save_2 "time out for correction after lam_i_1_i was stored" VALUE 0xffe4199a _REC_VAL_20_u2 1310.7 _CNV_A_R_LINEAR_____198_CM 0. 1310.7 DISPLAY_IDENTIFIER C_T_MAX_LAM_I_1_SAVE_2 FORMAT "%7.2" /end CHARACTERISTIC
/begin CHARACTERISTIC c_crlc_vls_down_mmv_lam "correlation constant for filtering downstream sensor signal (used in lambda controller)" VALUE 0xffe4069d _REC_VAL_20_u1 0.9960940000000002 _CNV_A_R_LINEAR_____50_CM 0. 0.996094 DISPLAY_IDENTIFIER C_CRLC_VLS_DOWN_MMV_LAM FORMAT "%5.3" /end CHARACTERISTIC
/begin CHARACTERISTIC c_vls_down_thd_afr_lam "rich threshold of downstream sensor signal for lam_i_1_i correction" VALUE 0xffe41b78 _REC_VAL_20_u2 5. _CNV_A_R_LINEAR_____269_CM 0. 5. DISPLAY_IDENTIFIER C_VLS_DOWN_THD_AFR_LAM FORMAT "%5.3" /end CHARACTERISTIC
/begin CHARACTERISTIC c_vls_down_thd_afl_lam "lean threshold of downstream sensor signal for lam_i_1_i correction" VALUE 0xffe41b74 _REC_VAL_20_u2 5. _CNV_A_R_LINEAR_____269_CM 0. 5. DISPLAY_IDENTIFIER C_VLS_DOWN_THD_AFL_LAM FORMAT "%5.3" /end CHARACTERISTIC
/begin CHARACTERISTIC c_delta_fac_lam_lscl_off "gradient to ramp the output signal to zero in case of deactivated controller" VALUE 0xffe415b2 _REC_VAL_20_u2 49.99850082 _CNV_A_R_LINEAR_____270_CM 0. 49.99850082 DISPLAY_IDENTIFIER C_DELTA_FAC_LAM_LSCL_OFF FORMAT "%7.3" /end CHARACTERISTIC
/begin CHARACTERISTIC ip_t1_lamb_agi_lim_1 "time lag of the lambda-sensor model for an aged WRAF sensor" MAP 0xffe4e5ee _REC_MAP_20_u2_u2_u2 1.99996948 _CNV_A_R_LINEAR_____163_CM 0. 1.99996948 DISPLAY_IDENTIFIER IP_T1_LAMB_AGI_LIM_1 FORMAT "%6.4"
 /begin AXIS_DESCR COM_AXIS n _CNV_A_R_LINEAR_____10_CM 4 0. 8160. FORMAT "%4.0" AXIS_PTS_REF ldpm_n_2_laco /end AXIS_DESCR
 /begin AXIS_DESCR COM_AXIS maf _CNV_A_R_LINEAR_____108_CM 4 0. 1389. FORMAT "%4.0" AXIS_PTS_REF ldpm_maf_2_laco /end AXIS_DESCR
/end CHARACTERISTIC
/begin CHARACTERISTIC ip_t1_lamb_agi_lim_2 "time lag of the lambda-sensor model for an aged WRAF sensor" MAP 0xffe4e60e _REC_MAP_20_u2_u2_u2 1.99996948 _CNV_A_R_LINEAR_____163_CM 0. 1.99996948 DISPLAY_IDENTIFIER IP_T1_LAMB_AGI_LIM_2 FORMAT "%6.4"
 /begin AXIS_DESCR COM_AXIS n _CNV_A_R_LINEAR_____10_CM 4 0. 8160. FORMAT "%4.0" AXIS_PTS_REF ldpm_n_2_laco /end AXIS_DESCR
 /begin AXIS_DESCR COM_AXIS maf _CNV_A_R_LINEAR_____108_CM 4 0. 1389. FORMAT "%4.0" AXIS_PTS_REF ldpm_maf_2_laco /end AXIS_DESCR
/end CHARACTERISTIC
/begin CHARACTERISTIC ip_ex_dly_fac_1 "weighting factor for the calculation of the exhaust gas delay" MAP 0xffe44fae _REC_MAP_20_u1_u2_u2 31.99 _CNV_A_R_LINEAR_____271_CM 0. 31.99 DISPLAY_IDENTIFIER IP_EX_DLY_FAC_1 FORMAT "%4.1"
 /begin AXIS_DESCR COM_AXIS n _CNV_A_R_LINEAR_____10_CM 8 0. 8160. FORMAT "%4.0" AXIS_PTS_REF ldpm_n_1_laco /end AXIS_DESCR
 /begin AXIS_DESCR COM_AXIS maf _CNV_A_R_LINEAR_____108_CM 8 0. 1389. FORMAT "%4.0" AXIS_PTS_REF ldpm_maf_1_laco /end AXIS_DESCR
/end CHARACTERISTIC
/begin CHARACTERISTIC ip_ex_dly_fac_2 "weighting factor for the calculation of the exhaust gas delay" MAP 0xffe44fee _REC_MAP_20_u1_u2_u2 31.99 _CNV_A_R_LINEAR_____271_CM 0. 31.99 DISPLAY_IDENTIFIER IP_EX_DLY_FAC_2 FORMAT "%4.1"
 /begin AXIS_DESCR COM_AXIS n _CNV_A_R_LINEAR_____10_CM 8 0. 8160. FORMAT "%4.0" AXIS_PTS_REF ldpm_n_1_laco /end AXIS_DESCR
 /begin AXIS_DESCR COM_AXIS maf _CNV_A_R_LINEAR_____108_CM 8 0. 1389. FORMAT "%4.0" AXIS_PTS_REF ldpm_maf_1_laco /end AXIS_DESCR
/end CHARACTERISTIC
/begin CHARACTERISTIC ip_lamb_sp_the_puc "weighting factor for the calculation of the exhaust gas delay" CURVE 0xffe41c62 _REC_CUR_20_u2_u2 3.999939 _CNV_A_R_LINEAR_____272_CM 0. 3.999939 DISPLAY_IDENTIFIER IP_LAMB_SP_THE_PUC FORMAT "%7.5"
 /begin AXIS_DESCR COM_AXIS maf_int_puc _CNV_A_R_LINEAR_____273_CM 4 0. 1820.4167 FORMAT "%9.4" AXIS_PTS_REF ldp_maf_int_puc_ip_lamb_sp /end AXIS_DESCR
/end CHARACTERISTIC
/begin AXIS_PTS ldp_maf_int_puc_ip_lamb_sp "" 0xffe50da8 maf_int_puc _REC_AXS_20_u2 1820.4167 _CNV_A_R_LINEAR_____273_CM 4 0. 1820.4167 DISPLAY_IDENTIFIER LDP_MAF_INT_PUC_IP_LAMB_SP FORMAT "%9.4" /end AXIS_PTS
/begin CHARACTERISTIC id_t_min_lscl "maximum time value up to that the controller can activated by the TCO-condition" CURVE 0xffe40a8f _REC_CUR_20_u1_u1 255. _CNV_A_R_LINEAR_____30_CM 0. 255. DISPLAY_IDENTIFIER ID_T_MIN_LSCL FORMAT "%3.0"
 /begin AXIS_DESCR COM_AXIS tco_st _CNV_A_R_LINEAR_____11_CM 6 -48. 142.5 FORMAT "%5.1" AXIS_PTS_REF ldpm_tco_st_2_lamb_ctl /end AXIS_DESCR
/end CHARACTERISTIC
/begin CHARACTERISTIC id_t_tco_lam_max_lscl "maximum time value up to that the controller can activated by the TCO-condition" CURVE 0xffe48df0 _REC_CUR_20_u2_u1 65534. _CNV_A_R_LINEAR_____30_CM 1. 65535. DISPLAY_IDENTIFIER ID_T_TCO_LAM_MAX_LSCL FORMAT "%5.0"
 /begin AXIS_DESCR COM_AXIS tco_st _CNV_A_R_LINEAR_____11_CM 6 -48. 142.5 FORMAT "%5.1" AXIS_PTS_REF ldpm_tco_st_2_lamb_ctl /end AXIS_DESCR
/end CHARACTERISTIC
/begin AXIS_PTS ldpm_tco_st_2_lamb_ctl "" 0xffe41457 tco_st _REC_AXS_20_u1 190.5 _CNV_A_R_LINEAR_____11_CM 6 -48. 142.5 DISPLAY_IDENTIFIER LDPM_TCO_ST_2_LAMB_CTL FORMAT "%5.1" /end AXIS_PTS
/begin MEASUREMENT lamb_hom_afl "lambda setpoint for homogeneous lean combustion" UWORD _CNV_A_R_LINEAR_____206_CM 1 100. 0. 31.99902344 DISPLAY_IDENTIFIER LAMB_HOM_AFL ECU_ADDRESS 0x3fd4b0 BYTE_ORDER MSB_LAST FORMAT "%7.4" /end MEASUREMENT
/begin CHARACTERISTIC ip_lamb_bas_wup_cor "Warm-up correction of basic lambda" MAP 0xffe4c582 _REC_MAP_20_u2_u1_u1 4. _CNV_A_R_LINEAR_____275_CM -2. 2. DISPLAY_IDENTIFIER IP_LAMB_BAS_WUP_COR FORMAT "%8.5"
 /begin AXIS_DESCR COM_AXIS tco _CNV_A_R_LINEAR_____11_CM 8 -48. 142.5 FORMAT "%5.1" AXIS_PTS_REF ldp_tco_ip_lamb_bas_wup_cor /end AXIS_DESCR
 /begin AXIS_DESCR COM_AXIS tco_st _CNV_A_R_LINEAR_____11_CM 8 -48. 142.5 FORMAT "%5.1" AXIS_PTS_REF ldp_tco_st_ip_lamb_bas_wup_cor /end AXIS_DESCR
/end CHARACTERISTIC
/begin CHARACTERISTIC ip_lamb_hom_afl "lambda setpoint for homogeneous lean combustion" MAP 0xffe4c79a _REC_MAP_20_u2_u1_u2 31.99902344 _CNV_A_R_LINEAR_____206_CM 0. 31.99902344 DISPLAY_IDENTIFIER IP_LAMB_HOM_AFL FORMAT "%7.4"
 /begin AXIS_DESCR COM_AXIS n_32 _CNV_A_R_LINEAR_____15_CM 8 0. 8160. FORMAT "%4.0" AXIS_PTS_REF ldp_n_32_ip_lamb_hom_afl /end AXIS_DESCR
 /begin AXIS_DESCR COM_AXIS tqi_req_slow _CNV_A_R_LINEAR_____187_CM 8 -1024. 1023.96875 FORMAT "%6.2" AXIS_PTS_REF ldp_tqi_req_slow_ip_lamb_hom_afl /end AXIS_DESCR
/end CHARACTERISTIC
/begin MEASUREMENT lamb_afl_1 "lambda setpoint for homogeneous lean step value" UWORD _CNV_A_R_LINEAR_____206_CM 1 100. 0. 31.99902344 DISPLAY_IDENTIFIER LAMB_AFL_1 ECU_ADDRESS 0x3fd4b2 BYTE_ORDER MSB_LAST FORMAT "%7.4" /end MEASUREMENT
/begin CHARACTERISTIC ip_lamb_bas_1 "basic lambda setpoint" MAP 0xffe4c482 _REC_MAP_20_u2_u1_u2 4. _CNV_A_R_LINEAR_____127_CM 0. 4. DISPLAY_IDENTIFIER IP_LAMB_BAS_1 FORMAT "%6.4"
 /begin AXIS_DESCR COM_AXIS n_32 _CNV_A_R_LINEAR_____15_CM 8 0. 8160. FORMAT "%4.0" AXIS_PTS_REF ldpm_n_32_1_lasp /end AXIS_DESCR
 /begin AXIS_DESCR COM_AXIS maf _CNV_A_R_LINEAR_____108_CM 8 0. 1389. FORMAT "%7.2" AXIS_PTS_REF ldpm_maf_1_lasp /end AXIS_DESCR
/end CHARACTERISTIC
/begin CHARACTERISTIC ip_lamb_bas_2 "basic lambda setpoint" MAP 0xffe4c502 _REC_MAP_20_u2_u1_u2 4. _CNV_A_R_LINEAR_____127_CM 0. 4. DISPLAY_IDENTIFIER IP_LAMB_BAS_2 FORMAT "%6.4"
 /begin AXIS_DESCR COM_AXIS n_32 _CNV_A_R_LINEAR_____15_CM 8 0. 8160. FORMAT "%4.0" AXIS_PTS_REF ldpm_n_32_1_lasp /end AXIS_DESCR
 /begin AXIS_DESCR COM_AXIS maf _CNV_A_R_LINEAR_____108_CM 8 0. 1389. FORMAT "%7.2" AXIS_PTS_REF ldpm_maf_1_lasp /end AXIS_DESCR
/end CHARACTERISTIC
/begin MEASUREMENT lamb_hom_afs "stociometric lambda setpoint  " UWORD _CNV_A_R_LINEAR_____206_CM 1 100. 0. 31.99902344 DISPLAY_IDENTIFIER LAMB_HOM_AFS ECU_ADDRESS 0x3fd4b4 BYTE_ORDER MSB_LAST FORMAT "%7.4" /end MEASUREMENT
/begin MEASUREMENT lamb_bas "basic lambda setpoint" UWORD _CNV_A_R_LINEAR_____206_CM 1 100. 0. 31.99902344 DISPLAY_IDENTIFIER LAMB_BAS ECU_ADDRESS 0x3fd4ae BYTE_ORDER MSB_LAST FORMAT "%7.4" /end MEASUREMENT
/begin CHARACTERISTIC c_lamb_bas_ofs_cat_diag "Offset for lambda setpoint" VALUE 0xffe40442 _REC_VAL_20_s2 3.999938965 _CNV_A_R_LINEAR_____276_CM -2. 1.999938965 DISPLAY_IDENTIFIER C_LAMB_BAS_OFS_CAT_DIAG FORMAT "%8.4" /end CHARACTERISTIC
/begin CHARACTERISTIC ip_lamb_afl_1 "lambda setpoint for homogeneous lean step value" MAP 0xffe4c402 _REC_MAP_20_u2_u1_u2 31.99902344 _CNV_A_R_LINEAR_____206_CM 0. 31.99902344 DISPLAY_IDENTIFIER IP_LAMB_AFL_1 FORMAT "%7.4"
 /begin AXIS_DESCR COM_AXIS n_32 _CNV_A_R_LINEAR_____15_CM 8 0. 8160. FORMAT "%4.0" AXIS_PTS_REF ldp_n_32_ip_lamb_afl_1 /end AXIS_DESCR
 /begin AXIS_DESCR COM_AXIS tqi_req_slow _CNV_A_R_LINEAR_____187_CM 8 -1024. 1023.96875 FORMAT "%6.2" AXIS_PTS_REF ldp_tqi_req_slow_ip_lamb_afl_1 /end AXIS_DESCR
/end CHARACTERISTIC
/begin CHARACTERISTIC ip_fac_lamb_wup "correction factor for basic lambda warm-up" MAP 0xffe453d6 _REC_MAP_20_u1_u1_u2 1.9921875 _CNV_A_R_LINEAR_____117_CM 0. 1.9921875 DISPLAY_IDENTIFIER IP_FAC_LAMB_WUP FORMAT "%5.3"
 /begin AXIS_DESCR COM_AXIS n_32 _CNV_A_R_LINEAR_____15_CM 6 0. 8160. FORMAT "%4.0" AXIS_PTS_REF ldp_n_32_ip_fac_lamb_wup /end AXIS_DESCR
 /begin AXIS_DESCR COM_AXIS maf _CNV_A_R_LINEAR_____108_CM 6 0. 1389. FORMAT "%7.2" AXIS_PTS_REF ldp_maf_ip_fac_lamb_wup /end AXIS_DESCR
/end CHARACTERISTIC
/begin CHARACTERISTIC ip_fac_lamb_wup_is "correction factor for basic lambda warm-up during idle" MAP 0xffe453fa _REC_MAP_20_u1_u1_u2 1.9921875 _CNV_A_R_LINEAR_____117_CM 0. 1.9921875 DISPLAY_IDENTIFIER IP_FAC_LAMB_WUP_IS FORMAT "%5.3"
 /begin AXIS_DESCR COM_AXIS n_32 _CNV_A_R_LINEAR_____15_CM 3 0. 8160. FORMAT "%4.0" AXIS_PTS_REF ldp_n_32_ip_fac_lamb_wup_is /end AXIS_DESCR
 /begin AXIS_DESCR COM_AXIS maf _CNV_A_R_LINEAR_____108_CM 4 0. 1389. FORMAT "%7.2" AXIS_PTS_REF ldp_maf_ip_fac_lamb_wup_is /end AXIS_DESCR
/end CHARACTERISTIC
/begin AXIS_PTS ldpm_maf_1_lasp "" 0xffe518d8 maf _REC_AXS_20_u2 1389. _CNV_A_R_LINEAR_____108_CM 8 0. 1389. DISPLAY_IDENTIFIER LDPM_MAF_1_LASP FORMAT "%7.2" /end AXIS_PTS
/begin AXIS_PTS ldpm_n_32_1_lasp "" 0xffe48479 n_32 _REC_AXS_20_u1 8160. _CNV_A_R_LINEAR_____15_CM 8 0. 8160. DISPLAY_IDENTIFIER LDPM_N_32_1_LASP FORMAT "%4.0" /end AXIS_PTS
/begin AXIS_PTS ldp_n_32_ip_lamb_afl_1 "" 0xffe480c7 n_32 _REC_AXS_20_u1 8160. _CNV_A_R_LINEAR_____15_CM 8 0. 8160. DISPLAY_IDENTIFIER LDP_N_32_IP_LAMB_AFL_1 FORMAT "%4.0" /end AXIS_PTS
/begin AXIS_PTS ldp_tqi_req_slow_ip_lamb_afl_1 "" 0xffe51500 tqi_req_slow _REC_AXS_20_u2 2047.96875 _CNV_A_R_LINEAR_____187_CM 8 -1024. 1023.96875 DISPLAY_IDENTIFIER LDP_TQI_REQ_SLOW_IP_LAMB_AFL_1 FORMAT "%6.2" /end AXIS_PTS
/begin AXIS_PTS ldp_tco_st_ip_lamb_bas_wup_cor "" 0xffe48281 tco_st _REC_AXS_20_u1 190.5 _CNV_A_R_LINEAR_____11_CM 8 -48. 142.5 DISPLAY_IDENTIFIER LDP_TCO_ST_IP_LAMB_BAS_WUP_COR FORMAT "%5.1" /end AXIS_PTS
/begin AXIS_PTS ldp_n_32_ip_lamb_hom_afl "" 0xffe480d0 n_32 _REC_AXS_20_u1 8160. _CNV_A_R_LINEAR_____15_CM 8 0. 8160. DISPLAY_IDENTIFIER LDP_N_32_IP_LAMB_HOM_AFL FORMAT "%4.0" /end AXIS_PTS
/begin AXIS_PTS ldp_tqi_req_slow_ip_lamb_hom_afl "" 0xffe51512 tqi_req_slow _REC_AXS_20_u2 2047.96875 _CNV_A_R_LINEAR_____187_CM 8 -1024. 1023.96875 DISPLAY_IDENTIFIER LDP_TQI_REQ_SLOW_IP_LAMB_HOM_AFL FORMAT "%6.2" /end AXIS_PTS
/begin AXIS_PTS ldp_tco_ip_lamb_bas_wup_cor "" 0xffe48225 tco _REC_AXS_20_u1 190.5 _CNV_A_R_LINEAR_____11_CM 8 -48. 142.5 DISPLAY_IDENTIFIER LDP_TCO_IP_LAMB_BAS_WUP_COR FORMAT "%5.1" /end AXIS_PTS
/begin AXIS_PTS ldp_n_32_ip_fac_lamb_wup "" 0xffe410ed n_32 _REC_AXS_20_u1 8160. _CNV_A_R_LINEAR_____15_CM 6 0. 8160. DISPLAY_IDENTIFIER LDP_N_32_IP_FAC_LAMB_WUP FORMAT "%4.0" /end AXIS_PTS
/begin AXIS_PTS ldp_n_32_ip_fac_lamb_wup_is "" 0xffe410f4 n_32 _REC_AXS_20_u1 8160. _CNV_A_R_LINEAR_____15_CM 3 0. 8160. DISPLAY_IDENTIFIER LDP_N_32_IP_FAC_LAMB_WUP_IS FORMAT "%4.0" /end AXIS_PTS
/begin AXIS_PTS ldp_maf_ip_fac_lamb_wup "" 0xffe50dd6 maf _REC_AXS_20_u2 1389. _CNV_A_R_LINEAR_____108_CM 6 0. 1389. DISPLAY_IDENTIFIER LDP_MAF_IP_FAC_LAMB_WUP FORMAT "%7.2" /end AXIS_PTS
/begin AXIS_PTS ldp_maf_ip_fac_lamb_wup_is "" 0xffe50de4 maf _REC_AXS_20_u2 1389. _CNV_A_R_LINEAR_____108_CM 4 0. 1389. DISPLAY_IDENTIFIER LDP_MAF_IP_FAC_LAMB_WUP_IS FORMAT "%7.2" /end AXIS_PTS
/begin MEASUREMENT lam_bank_1.lam_up.bf.lv_lam_lim_max "top - threshold of the controller output exceeded" ULONG _CNV_S_2_RANGE______2_CM 1 100. 0. 1. DISPLAY_IDENTIFIER LV_LAM_LIM_MAX_1 ECU_ADDRESS 0x3fc338 BYTE_ORDER MSB_LAST BIT_MASK 0x80000000 /end MEASUREMENT
/begin MEASUREMENT lam_bank_1.lam_up.bf.lv_lam_lim_min "bottom threshold of the controller output exceeded" ULONG _CNV_S_2_RANGE______2_CM 1 100. 0. 1. DISPLAY_IDENTIFIER LV_LAM_LIM_MIN_1 ECU_ADDRESS 0x3fc338 BYTE_ORDER MSB_LAST BIT_MASK 0x40000000 /end MEASUREMENT
/begin MEASUREMENT lam_bank_1.lam_up.bf.lv_lscl "lambda-controller activation signal" ULONG _CNV_S_2_RANGE______2_CM 1 100. 0. 1. DISPLAY_IDENTIFIER LV_LSCL_1 ECU_ADDRESS 0x3fc338 BYTE_ORDER MSB_LAST BIT_MASK 0x20000000 /end MEASUREMENT
/begin MEASUREMENT lam_bank_1.lam_up.bf.lv_t_tco_lam_max_lscl "lambda-controller activation by a timer condition instead of a TCO-condition" ULONG _CNV_S_2_RANGE______2_CM 1 100. 0. 1. DISPLAY_IDENTIFIER LV_T_TCO_LAM_MAX_LSCL_1 ECU_ADDRESS 0x3fc338 BYTE_ORDER MSB_LAST BIT_MASK 0x8000000 /end MEASUREMENT
/begin MEASUREMENT lam_bank_1.lam_up.bf.lv_lam_cor_lim_intr "the sum output signal is limited under non-stationary operating conditions (threshold exceeded)" ULONG _CNV_S_2_RANGE______2_CM 1 100. 0. 1. DISPLAY_IDENTIFIER LV_LAM_COR_LIM_INTR_1 ECU_ADDRESS 0x3fc338 BYTE_ORDER MSB_LAST BIT_MASK 0x2000000 /end MEASUREMENT
/begin MEASUREMENT lam_bank_1.lam_up.bf.lv_lam_adj_ad_end "lambda shift required by lambda adaptation was carried out" ULONG _CNV_S_2_RANGE______2_CM 1 100. 0. 1. DISPLAY_IDENTIFIER LV_LAM_ADJ_AD_END_1 ECU_ADDRESS 0x3fc338 BYTE_ORDER MSB_LAST BIT_MASK 0x800000 /end MEASUREMENT
/begin MEASUREMENT lam_bank_1.lam_up.bf.lv_fac_lam_i_delta_max_act "FAC_LAM_I_i gradient condition fulfilled; correction of LAM_I_1_i is active" ULONG _CNV_S_2_RANGE______2_CM 1 100. 0. 1. DISPLAY_IDENTIFIER LV_FAC_LAM_I_DELTA_MAX_ACT_1 ECU_ADDRESS 0x3fc338 BYTE_ORDER MSB_LAST BIT_MASK 0x200000 /end MEASUREMENT
/begin MEASUREMENT lam_bank_1.lam_up.bf.lv_vls_down_thd_afr_lam "flag indication that downstream sensor signal is above calibration threshold (used for lambda control)" ULONG _CNV_S_2_RANGE______2_CM 1 100. 0. 1. DISPLAY_IDENTIFIER LV_VLS_DOWN_THD_AFR_LAM_1 ECU_ADDRESS 0x3fc338 BYTE_ORDER MSB_LAST BIT_MASK 0x100000 /end MEASUREMENT
/begin MEASUREMENT lam_bank_1.lam_up.bf.lv_vls_down_thd_afl_lam "flag indication that downstream sensor signal is below calibration threshold (used for lambda control)" ULONG _CNV_S_2_RANGE______2_CM 1 100. 0. 1. DISPLAY_IDENTIFIER LV_VLS_DOWN_THD_AFL_LAM_1 ECU_ADDRESS 0x3fc338 BYTE_ORDER MSB_LAST BIT_MASK 0x40000 /end MEASUREMENT
/begin MEASUREMENT lam_bank_1.lam_up.lamb "Signal value of the lambda sensor" UWORD _CNV_A_R_LINEAR_____206_CM 1 100. 0. 31.99902344 DISPLAY_IDENTIFIER LAMB_1 ECU_ADDRESS 0x3fc3ea BYTE_ORDER MSB_LAST FORMAT "%7.4" /end MEASUREMENT
/begin MEASUREMENT lam_bank_1.lam_up.ti_lam_fac "factor for the injection time correction" SWORD _CNV_A_R_LINEAR_____111_CM 1 100. -50. 49.99847412 DISPLAY_IDENTIFIER TI_LAM_FAC_1 ECU_ADDRESS 0x3fc33c BYTE_ORDER MSB_LAST FORMAT "%6.2" /end MEASUREMENT
/begin MEASUREMENT lam_bank_1.lam_up.ti_lam_cor "controller output signal in consideration of the canister purge function and lambda adaptation" SWORD _CNV_A_R_LINEAR_____111_CM 1 100. -50. 49.99847412 DISPLAY_IDENTIFIER TI_LAM_COR_1 ECU_ADDRESS 0x3fc33e BYTE_ORDER MSB_LAST FORMAT "%6.2" /end MEASUREMENT
/begin MEASUREMENT lam_bank_1.lam_up.lamb_av_cor "signal of the lambda-sensor corrected by the trim-controller" UWORD _CNV_A_R_LINEAR_____206_CM 1 100. 0. 31.99902344 DISPLAY_IDENTIFIER LAMB_AV_COR_1 ECU_ADDRESS 0x3fc380 BYTE_ORDER MSB_LAST FORMAT "%7.4" /end MEASUREMENT
/begin MEASUREMENT lam_bank_1.lam_up.dly "Delay between the injection and the lambda-sensor signal" UWORD _CNV_A_R_LINEAR_____264_CM 1 100. 0. 1.049983 DISPLAY_IDENTIFIER DLY_1 ECU_ADDRESS 0x3fc340 BYTE_ORDER MSB_LAST FORMAT "%6.4" /end MEASUREMENT
/begin MEASUREMENT lam_bank_1.lam_up.lamb_dif "controller difference" SWORD _CNV_A_R_LINEAR_____281_CM 1 100. -1. 0.99996948 DISPLAY_IDENTIFIER LAMB_DIF_1 ECU_ADDRESS 0x3fc342 BYTE_ORDER MSB_LAST FORMAT "%8.5" /end MEASUREMENT
/begin MEASUREMENT lam_bank_1.lam_up.lam_p_lim "limited P-share output signal" SWORD _CNV_A_R_LINEAR_____111_CM 1 100. -50. 49.99847412 DISPLAY_IDENTIFIER LAM_P_LIM_1 ECU_ADDRESS 0x3fc35e BYTE_ORDER MSB_LAST FORMAT "%7.3" /end MEASUREMENT
/begin MEASUREMENT lam_bank_1.lam_up.lam_i_i_lim "limited I+I2-share output signal" SWORD _CNV_A_R_LINEAR_____111_CM 1 100. -50. 49.99847412 DISPLAY_IDENTIFIER LAM_I_I_LIM_1 ECU_ADDRESS 0x3fc372 BYTE_ORDER MSB_LAST FORMAT "%7.3" /end MEASUREMENT
/begin MEASUREMENT lam_bank_1.lam_up.lam_d_lim "limited D-share output signal" SWORD _CNV_A_R_LINEAR_____111_CM 1 100. -50. 49.99847412 DISPLAY_IDENTIFIER LAM_D_LIM_1 ECU_ADDRESS 0x3fc376 BYTE_ORDER MSB_LAST FORMAT "%7.3" /end MEASUREMENT
/begin MEASUREMENT lam_bank_1.lam_up.lam_i "unlimited I-share output signal" SWORD _CNV_A_R_LINEAR_____111_CM 1 100. -50. 49.99847412 DISPLAY_IDENTIFIER LAM_I_1 ECU_ADDRESS 0x3fc360 BYTE_ORDER MSB_LAST FORMAT "%7.3" /end MEASUREMENT
/begin MEASUREMENT lam_bank_1.lam_up.lam_cor "unlimited controller output signal" SWORD _CNV_A_R_LINEAR_____111_CM 1 100. -50. 49.99847412 DISPLAY_IDENTIFIER LAM_COR_1 ECU_ADDRESS 0x3fc35a BYTE_ORDER MSB_LAST FORMAT "%7.3" /end MEASUREMENT
/begin MEASUREMENT lam_bank_1.lam_up.lam_lim "limited controller output signal" SWORD _CNV_A_R_LINEAR_____111_CM 1 100. -50. 49.99847412 DISPLAY_IDENTIFIER LAM_LIM_1 ECU_ADDRESS 0x3fc35c BYTE_ORDER MSB_LAST FORMAT "%7.3" /end MEASUREMENT
/begin MEASUREMENT lam_bank_1.lam_up.lam_mv "sum of the controller output from the I-and I2-share" SWORD _CNV_A_R_LINEAR_____111_CM 1 100. -50. 49.99847412 DISPLAY_IDENTIFIER LAM_MV_1 ECU_ADDRESS 0x3fc346 BYTE_ORDER MSB_LAST FORMAT "%7.3" /end MEASUREMENT
/begin MEASUREMENT lam_bank_1.lam_up.lam_mv_lpf "moving mean value of LAM_MV" SWORD _CNV_A_R_LINEAR_____111_CM 1 100. -50. 49.99847412 DISPLAY_IDENTIFIER LAM_MV_LPF_1 ECU_ADDRESS 0x3fc348 BYTE_ORDER MSB_LAST FORMAT "%7.3" /end MEASUREMENT
/begin MEASUREMENT lam_bank_1.lam_up.lamb_sp_fil "output signal of the lambda-sensor model" UWORD _CNV_A_R_LINEAR_____206_CM 1 100. 0. 31.99902344 DISPLAY_IDENTIFIER LAMB_SP_FIL_1 ECU_ADDRESS 0x3fc3c0 BYTE_ORDER MSB_LAST FORMAT "%7.4" /end MEASUREMENT
/begin MEASUREMENT lam_bank_1.lam_up.lamb_sp_pctl_h_res "lambda set point with high resolution including the forced stimulation without influence secondary air influence" ULONG _CNV_A_R_LINEAR_____282_CM 1 100. 0. 32. DISPLAY_IDENTIFIER LAMB_SP_PCTL_H_RES_1 ECU_ADDRESS 0x3fc37c BYTE_ORDER MSB_LAST FORMAT "%8.5" /end MEASUREMENT
/begin MEASUREMENT lam_bank_1.lam_up.lamb_sp_fil_s_cp "output signal of the lambda-sensor model in stratified mode, used by canister purge" UWORD _CNV_A_R_LINEAR_____206_CM 1 100. 0. 31.99902344 DISPLAY_IDENTIFIER LAMB_SP_FIL_S_CP_1 ECU_ADDRESS 0x3fc3d0 BYTE_ORDER MSB_LAST FORMAT "%7.4" /end MEASUREMENT
/begin MEASUREMENT lam_bank_1.lam_up.lamb_mod "Input signal of the lambda-sensor model in homogeneous mode" UWORD _CNV_A_R_LINEAR_____206_CM 1 100. 0. 31.99902344 DISPLAY_IDENTIFIER LAMB_MOD_1 ECU_ADDRESS 0x3fc398 BYTE_ORDER MSB_LAST FORMAT "%7.4" /end MEASUREMENT
/begin MEASUREMENT lam_bank_1.lam_up.lamb_mod_s "Input signal of the lambda-sensor model in stratified mode" UWORD _CNV_A_R_LINEAR_____206_CM 1 100. 0. 31.99902344 DISPLAY_IDENTIFIER LAMB_MOD_S_1 ECU_ADDRESS 0x3fc3ac BYTE_ORDER MSB_LAST FORMAT "%7.4" /end MEASUREMENT
/begin MEASUREMENT lam_bank_1.lam_up.t1_lamb "time lag of the lambda-sensor model" UWORD _CNV_A_R_LINEAR_____163_CM 1 100. 0. 1.99996948 DISPLAY_IDENTIFIER T1_LAMB_1 ECU_ADDRESS 0x3fc34e BYTE_ORDER MSB_LAST FORMAT "%6.4" /end MEASUREMENT
/begin MEASUREMENT lam_bank_1.lam_up.lam_mv_lpf_cp "mean value of the controller output, used by canister purge" SWORD _CNV_A_R_LINEAR_____111_CM 1 100. -50. 49.99847412 DISPLAY_IDENTIFIER LAM_MV_LPF_CP_1 ECU_ADDRESS 0x3fc34a BYTE_ORDER MSB_LAST FORMAT "%7.3" /end MEASUREMENT
/begin MEASUREMENT lam_bank_1.lam_up.lamb_av_cor_h_res "signal of the lambda-sensor corrected by the trim-controller (high resolution)" ULONG _CNV_A_R_LINEAR_____282_CM 1 100. 0. 32. DISPLAY_IDENTIFIER LAMB_AV_COR_H_RES_1 ECU_ADDRESS 0x3fc384 BYTE_ORDER MSB_LAST FORMAT "%8.5" /end MEASUREMENT
/begin MEASUREMENT lam_bank_1.lam_up.lamb_sp_fil_h_res "output signal with high resolution of the lambda-sensor model" ULONG _CNV_A_R_LINEAR_____282_CM 1 100. 0. 32. DISPLAY_IDENTIFIER LAMB_SP_FIL_H_RES_1 ECU_ADDRESS 0x3fc3c4 BYTE_ORDER MSB_LAST FORMAT "%8.5" /end MEASUREMENT
/begin MEASUREMENT lam_bank_1.lam_up.lamb_sp_fil_s_cp_h_res "output signal with high resolution of the lambda-sensor model in stratified mode, used by canister purge" ULONG _CNV_A_R_LINEAR_____282_CM 1 100. 0. 32. DISPLAY_IDENTIFIER LAMB_SP_FIL_S_CP_H_RES_1 ECU_ADDRESS 0x3fc3d4 BYTE_ORDER MSB_LAST FORMAT "%8.5" /end MEASUREMENT
/begin MEASUREMENT lam_bank_1.lam_up.lamb_sp_mod_h_res "lambda-controller set point with high resolution including the forced stimulation and secondary air influence" ULONG _CNV_A_R_LINEAR_____282_CM 1 100. 0. 32. DISPLAY_IDENTIFIER LAMB_SP_MOD_H_RES_1 ECU_ADDRESS 0x3fc378 BYTE_ORDER MSB_LAST FORMAT "%8.5" /end MEASUREMENT
/begin MEASUREMENT lam_bank_1.lam_up.lamb_mod_h_res "Input signal with high resolution of the lambda-sensor model in homogeneous mode" ULONG _CNV_A_R_LINEAR_____282_CM 1 100. 0. 32. DISPLAY_IDENTIFIER LAMB_MOD_H_RES_1 ECU_ADDRESS 0x3fc39c BYTE_ORDER MSB_LAST FORMAT "%8.5" /end MEASUREMENT
/begin MEASUREMENT lam_bank_1.lam_up.lamb_mod_s_h_res "Input signal with high resolution of the lambda-sensor model in stratified mode" ULONG _CNV_A_R_LINEAR_____282_CM 1 100. 0. 32. DISPLAY_IDENTIFIER LAMB_MOD_S_H_RES_1 ECU_ADDRESS 0x3fc3b0 BYTE_ORDER MSB_LAST FORMAT "%8.5" /end MEASUREMENT
/begin MEASUREMENT lam_bank_1.lam_up.lam_i_i_lim_sum "limited I+I2-share output signal" SWORD _CNV_A_R_LINEAR_____111_CM 1 100. -50. 49.99847412 DISPLAY_IDENTIFIER LAM_I_I_LIM_SUM_1 ECU_ADDRESS 0x3fc374 BYTE_ORDER MSB_LAST FORMAT "%7.3" /end MEASUREMENT
/begin MEASUREMENT lam_bank_1.lam_up.lam_i_i "unlimited I2-share output signal" SWORD _CNV_A_R_LINEAR_____111_CM 1 100. -50. 49.99847412 DISPLAY_IDENTIFIER LAM_I_I_1 ECU_ADDRESS 0x3fc370 BYTE_ORDER MSB_LAST FORMAT "%7.3" /end MEASUREMENT
/begin MEASUREMENT lam_bank_1.lam_up.lam_i_1_lim "limited summation of controller difference" SLONG _CNV_A_R_LINEAR_____283_CM 1 100. -65536. 65535.99997 DISPLAY_IDENTIFIER LAM_I_1_LIM_1 ECU_ADDRESS 0x3fc36c BYTE_ORDER MSB_LAST FORMAT "%11.4" /end MEASUREMENT
/begin MEASUREMENT lam_bank_1.lam_up.lam_i_1 "unlimited summation of controller difference" SLONG _CNV_A_R_LINEAR_____283_CM 1 100. -65536. 65535.99997 DISPLAY_IDENTIFIER LAM_I_1_1 ECU_ADDRESS 0x3fc364 BYTE_ORDER MSB_LAST FORMAT "%11.4" /end MEASUREMENT
/begin MEASUREMENT lam_bank_1.lam_up.lam_mv_dyw_tmp "temporary mean value of the controller output, used by limited dynamics" SWORD _CNV_A_R_LINEAR_____111_CM 1 100. -50. 49.99847412 DISPLAY_IDENTIFIER LAM_MV_DYW_TMP_1 ECU_ADDRESS 0x3fc34c BYTE_ORDER MSB_LAST FORMAT "%7.3" /end MEASUREMENT
/begin MEASUREMENT lam_bank_1.lam_up.ex_dly_fac "weighting factor for the calculation of the exhaust gas delay" UBYTE _CNV_A_R_LINEAR_____271_CM 1 100. 0. 31.99 DISPLAY_IDENTIFIER EX_DLY_FAC_1 ECU_ADDRESS 0x3fc3f0 FORMAT "%4.1" /end MEASUREMENT
/begin MEASUREMENT lam_bank_1.lam_up.lamb_dif_mmv_lam "moving mean value of controller difference" SWORD _CNV_A_R_LINEAR_____281_CM 1 100. -1. 0.99996948 DISPLAY_IDENTIFIER LAMB_DIF_MMV_LAM_1 ECU_ADDRESS 0x3fc388 BYTE_ORDER MSB_LAST FORMAT "%8.5" /end MEASUREMENT
/begin MEASUREMENT lam_bank_1.lam_up.lam_i_1_save "saved unlimited summation of controller difference" SLONG _CNV_A_R_LINEAR_____283_CM 1 100. -65536. 65535.99997 DISPLAY_IDENTIFIER LAM_I_1_SAVE_1 ECU_ADDRESS 0x3fc368 BYTE_ORDER MSB_LAST FORMAT "%11.4" /end MEASUREMENT
/begin MEASUREMENT lam_bank_1.lam_up.t_lam_i_1_save_afl "time after LAM_I_1_i was stored for downstream signal too lean" UWORD _CNV_A_R_LINEAR_____198_CM 1 100. 0. 1310.7 DISPLAY_IDENTIFIER T_LAM_I_1_SAVE_AFL_1 ECU_ADDRESS 0x3fc3e2 BYTE_ORDER MSB_LAST FORMAT "%7.2" /end MEASUREMENT
/begin MEASUREMENT lam_bank_1.lam_up.t_lam_i_1_save_afr "time after LAM_I_1_i was stored for downstream signal too rich" UWORD _CNV_A_R_LINEAR_____198_CM 1 100. 0. 1310.7 DISPLAY_IDENTIFIER T_LAM_I_1_SAVE_AFR_1 ECU_ADDRESS 0x3fc3e4 BYTE_ORDER MSB_LAST FORMAT "%7.2" /end MEASUREMENT
/begin MEASUREMENT lam_bank_1.lam_up.delta_lam_i_save "I share shift and opposite I^2 share shift" SWORD _CNV_A_R_LINEAR_____111_CM 1 100. -50. 49.99847412 DISPLAY_IDENTIFIER DELTA_LAM_I_SAVE_1 ECU_ADDRESS 0x3fc3f2 BYTE_ORDER MSB_LAST FORMAT "%7.3" /end MEASUREMENT
/begin MEASUREMENT lam_bank_1.lam_up.vls_down_mmv_lam "moving mean value of downstream sensor signal used for lambda control" UWORD _CNV_A_R_LINEAR_____269_CM 1 100. 0. 5. DISPLAY_IDENTIFIER VLS_DOWN_MMV_LAM_1 ECU_ADDRESS 0x3fc390 BYTE_ORDER MSB_LAST FORMAT "%5.3" /end MEASUREMENT
/begin MEASUREMENT lam_bank_1.lamb_scc.lamb_scc "Lambda setpoint at single cylinder cut off" UWORD _CNV_A_R_LINEAR_____206_CM 1 100. 0. 31.99902344 DISPLAY_IDENTIFIER LAMB_SCC_1 ECU_ADDRESS 0x3fc27e BYTE_ORDER MSB_LAST FORMAT "%7.4" /end MEASUREMENT
/begin MEASUREMENT lam_bank_1.lam_bas_sp.lamb_bas_h_res "bank selektive basic lambda setpoint with high resolution" ULONG _CNV_A_R_LINEAR_____282_CM 1 100. 0. 32. DISPLAY_IDENTIFIER LAMB_BAS_H_RES_1 ECU_ADDRESS 0x3fc2c4 BYTE_ORDER MSB_LAST FORMAT "%8.5" /end MEASUREMENT
/begin MEASUREMENT lam_bank_1.lam_bas_sp.lamb_hom_afs_h_res "stoichiometric lambda setpoint with high resolution" ULONG _CNV_A_R_LINEAR_____282_CM 1 100. 0. 32. DISPLAY_IDENTIFIER LAMB_HOM_AFS_H_RES_1 ECU_ADDRESS 0x3fc2c8 BYTE_ORDER MSB_LAST FORMAT "%8.5" /end MEASUREMENT
/begin MEASUREMENT lam_bank_1.lam_bas_sp.lamb_bas "bank selektive basic lambda setpoint" UWORD _CNV_A_R_LINEAR_____206_CM 1 100. 0. 31.99902344 DISPLAY_IDENTIFIER LAMB_BAS_1 ECU_ADDRESS 0x3fc2cc BYTE_ORDER MSB_LAST FORMAT "%7.4" /end MEASUREMENT
/begin MEASUREMENT lam_bank_1.lam_bas_sp.lamb_hom_afs "stoichiometric lambda setpoint" UWORD _CNV_A_R_LINEAR_____206_CM 1 100. 0. 31.99902344 DISPLAY_IDENTIFIER LAMB_HOM_AFS_1 ECU_ADDRESS 0x3fc2ce BYTE_ORDER MSB_LAST FORMAT "%7.4" /end MEASUREMENT
/begin MEASUREMENT lam_bank_1.lam_bas_sp.lv_lamb_bas_ofs_cat_diag "flag_to indicate lambda offset" UBYTE _CNV_S_2_RANGE______2_CM 1 100. 0. 1. DISPLAY_IDENTIFIER LV_LAMB_BAS_OFS_CAT_DIAG_1 ECU_ADDRESS 0x3fc2d0 /end MEASUREMENT
/begin MEASUREMENT lam_bank_1.lam_dlyl.bf.lv_ldc_dly "status limited dynamic" ULONG _CNV_S_2_RANGE______2_CM 1 100. 0. 1. DISPLAY_IDENTIFIER LV_LDC_DLY_1 ECU_ADDRESS 0x3fc530 BYTE_ORDER MSB_LAST BIT_MASK 0x80000000 /end MEASUREMENT
/begin MEASUREMENT lam_bank_1.lam_dlyl.bf.lv_lam_mv_ldc_dly "status limited dynamic LAM_MV_i" ULONG _CNV_S_2_RANGE______2_CM 1 100. 0. 1. DISPLAY_IDENTIFIER LV_LAM_MV_LDC_DLY_1 ECU_ADDRESS 0x3fc530 BYTE_ORDER MSB_LAST BIT_MASK 0x40000000 /end MEASUREMENT
/begin MEASUREMENT lam_bank_1.lam_dlyl.lam_mv_mmv_dly "floating mean value for limited lambda deviation" SWORD _CNV_A_R_LINEAR_____111_CM 1 100. -50. 49.99847412 DISPLAY_IDENTIFIER LAM_MV_MMV_DLY_1 ECU_ADDRESS 0x3fc534 BYTE_ORDER MSB_LAST FORMAT "%7.3" /end MEASUREMENT
/begin MEASUREMENT lam_bank_1.lam_dlyl.maf_int_ldc_dly "integral of mass air flow since limited dynamic conditions are fulfilled" UWORD _CNV_A_R_LINEAR_____287_CM 1 100. 0. 1820.398 DISPLAY_IDENTIFIER MAF_INT_LDC_DLY_1 ECU_ADDRESS 0x3fc538 BYTE_ORDER MSB_LAST FORMAT "%7.2" /end MEASUREMENT
/begin MEASUREMENT lam_bank_1.lam_dlyl.pv_av_grd_sum_dly "sum. value for limited lambda deviation" UWORD _CNV_A_R_LINEAR_____318_CM 1 100. 0. 639990.2340000001 DISPLAY_IDENTIFIER PV_AV_GRD_SUM_DLY_1 ECU_ADDRESS 0x3fc536 BYTE_ORDER MSB_LAST FORMAT "%8.1" /end MEASUREMENT
/begin MEASUREMENT lam_bank_1.lam_o2l.delta_lamb_sp_o2l_mdl "lambda set point shift of catalyst O2 loading condition function" SWORD _CNV_A_R_LINEAR_____288_CM 1 100. -0.125 0.125 DISPLAY_IDENTIFIER DELTA_LAMB_SP_O2L_MDL_1 ECU_ADDRESS 0x3fc6e0 BYTE_ORDER MSB_LAST FORMAT "%8.5" /end MEASUREMENT
/begin MEASUREMENT lam_bank_1.lam_o2l.maf_int_efc_o2l_mdl "effective air mass integral representing O2 loading used for lambda set point shift calculation " UWORD _CNV_A_R_LINEAR_____344_CM 1 100. 0. 182.0389 DISPLAY_IDENTIFIER MAF_INT_EFC_O2L_MDL_1 ECU_ADDRESS 0x3fc6e2 BYTE_ORDER MSB_LAST FORMAT "%7.3" /end MEASUREMENT
/begin MEASUREMENT lam_bank_1.lam_o2l.maf_int_o2l_mdl "air mass integral representing O2 loading used for calculation of effective one" SLONG _CNV_A_R_LINEAR_____345_CM 1 100. -182.0444 182.0444 DISPLAY_IDENTIFIER MAF_INT_O2L_MDL_1 ECU_ADDRESS 0x3fc6d4 BYTE_ORDER MSB_LAST FORMAT "%10.5" /end MEASUREMENT
/begin MEASUREMENT lam_bank_1.lam_o2l.maf_int_max_o2l_mdl "adaptive maximum of air mass integral representing O2 loading" UWORD _CNV_A_R_LINEAR_____344_CM 1 100. 0. 182.0389 DISPLAY_IDENTIFIER MAF_INT_MAX_O2L_MDL_1 ECU_ADDRESS 0x3fc6e4 BYTE_ORDER MSB_LAST FORMAT "%7.3" /end MEASUREMENT
/begin MEASUREMENT lam_bank_1.lam_o2l.maf_int_sample_step_o2l_mdl "air mass integral representing O2 loading of one sample step" SWORD _CNV_A_R_LINEAR_____346_CM 1 100. -0.355555555555 0.355544704861 DISPLAY_IDENTIFIER MAF_INT_SAMPLE_STEP_O2L_MDL_1 ECU_ADDRESS 0x3fc6e6 BYTE_ORDER MSB_LAST FORMAT "%7.5" /end MEASUREMENT
/begin MEASUREMENT lam_bank_1.lam_o2l.maf_int_mmv_o2l_mdl "moving mean value of effective air mass integral representing O2 loading" UWORD _CNV_A_R_LINEAR_____344_CM 1 100. 0. 182.0389 DISPLAY_IDENTIFIER MAF_INT_MMV_O2L_MDL_1 ECU_ADDRESS 0x3fc6e8 BYTE_ORDER MSB_LAST FORMAT "%7.3" /end MEASUREMENT
/begin MEASUREMENT lam_bank_1.lam_o2l.quo_maf_int_efc_o2l_mdl "quotient between moving mean value of effective air mass integral and adaptive maximum" UWORD _CNV_A_R_LINEAR_____8_CM 1 100. 0. 99.99847412 DISPLAY_IDENTIFIER QUO_MAF_INT_EFC_O2L_MDL_1 ECU_ADDRESS 0x3fc6ea BYTE_ORDER MSB_LAST /end MEASUREMENT
/begin MEASUREMENT lam_bank_1.lam_o2l.fac_maf_int_o2l_mdl "factor for air mass integral calculation taking into account lambda signal and basis lambda set point  " SWORD _CNV_A_R_LINEAR_____276_CM 1 100. -2. 1.999938965 DISPLAY_IDENTIFIER FAC_MAF_INT_O2L_MDL_1 ECU_ADDRESS 0x3fc6ec BYTE_ORDER MSB_LAST FORMAT "%8.4" /end MEASUREMENT
/begin MEASUREMENT lam_bank_1.lam_o2l.fac_add_maf_int_o2l_mdl "additional factor for air mass integral calculation taking into account different integration speeds" UBYTE _CNV_A_R_LINEAR_____117_CM 1 100. 0. 1.9921875 DISPLAY_IDENTIFIER FAC_ADD_MAF_INT_O2L_MDL_1 ECU_ADDRESS 0x3fc6f4 FORMAT "%5.3" /end MEASUREMENT
/begin MEASUREMENT lam_bank_1.lam_o2l.vls_down_mmv_o2l_mdl "moving mean value of downstream sensor signal used for cat O2 loading model" UWORD _CNV_A_R_LINEAR_____269_CM 1 100. 0. 5. DISPLAY_IDENTIFIER VLS_DOWN_MMV_O2L_MDL_1 ECU_ADDRESS 0x3fc6ee BYTE_ORDER MSB_LAST FORMAT "%5.3" /end MEASUREMENT
/begin MEASUREMENT lam_bank_1.lam_o2l.bf.lv_vls_down_thd_afr_o2l_mdl "flag indication that downstream sensor signal is above calibration threshold" ULONG _CNV_S_2_RANGE______2_CM 1 100. 0. 1. DISPLAY_IDENTIFIER LV_VLS_DOWN_THD_AFR_O2L_MDL_1 ECU_ADDRESS 0x3fc6d0 BYTE_ORDER MSB_LAST BIT_MASK 0x40000000 /end MEASUREMENT
/begin MEASUREMENT lam_bank_1.lam_o2l.bf.lv_vls_down_thd_afl_o2l_mdl "flag indication that downstream sensor signal is below calibration threshold" ULONG _CNV_S_2_RANGE______2_CM 1 100. 0. 1. DISPLAY_IDENTIFIER LV_VLS_DOWN_THD_AFL_O2L_MDL_1 ECU_ADDRESS 0x3fc6d0 BYTE_ORDER MSB_LAST BIT_MASK 0x20000000 /end MEASUREMENT
/begin MEASUREMENT lam_bank_1.lam_o2l.bf.lv_pue_o2l_mdl "flag indicating post PUC phase used for cat O2 loading model" ULONG _CNV_S_2_RANGE______2_CM 1 100. 0. 1. DISPLAY_IDENTIFIER LV_PUE_O2L_MDL_1 ECU_ADDRESS 0x3fc6d0 BYTE_ORDER MSB_LAST BIT_MASK 0x10000000 /end MEASUREMENT
/begin MEASUREMENT lam_bank_1.lam_o2l.bf.lv_maf_int_o2l_mdl_clc_act "flag indication that O2 loading integral calculation is active" ULONG _CNV_S_2_RANGE______2_CM 1 100. 0. 1. DISPLAY_IDENTIFIER LV_MAF_INT_O2L_MDL_CLC_ACT_1 ECU_ADDRESS 0x3fc6d0 BYTE_ORDER MSB_LAST BIT_MASK 0x80000000 /end MEASUREMENT
/begin MEASUREMENT lam_bank_1.lam_o2l.lamb_sp_ref_o2l_mdl "lambda setpoint reference for O2 loading model" UWORD _CNV_A_R_LINEAR_____347_CM 1 100. 0. 1.99993897 DISPLAY_IDENTIFIER LAMB_SP_REF_O2L_MDL_1 ECU_ADDRESS 0x3fc6f0 BYTE_ORDER MSB_LAST FORMAT "%7.5" /end MEASUREMENT
/begin MEASUREMENT lam_bank_1.lam_o2l.delta_lamb_cor_o2l_mdl "lambda delta for WRAF sensor signal LAMB_i used for air mass integral calculation" SWORD _CNV_A_R_LINEAR_____286_CM 1 100. -0.125 0.124996 DISPLAY_IDENTIFIER DELTA_LAMB_COR_O2L_MDL_1 ECU_ADDRESS 0x3fc6f2 BYTE_ORDER MSB_LAST FORMAT "%8.6" /end MEASUREMENT
/begin MEASUREMENT lam_bank_1.lsh_down_inci.lv_inh_lsh_down "Boolean flag indicating project specific application conditions for heating not met" UBYTE _CNV_S_2_RANGE______2_CM 1 100. 0. 1. DISPLAY_IDENTIFIER LV_INH_LSH_DOWN ECU_ADDRESS 0x3fc410 /end MEASUREMENT
/begin MEASUREMENT lam_bank_1.lsh_down_inci.temp_ls_down_ini "Oxygen sensor temperature at start" SWORD _CNV_A_R_LINEAR_____303_CM 1 100. -2048. 2047.938 DISPLAY_IDENTIFIER TEMP_LS_DOWN_INI ECU_ADDRESS 0x3fc412 BYTE_ORDER MSB_LAST FORMAT "%8.2" /end MEASUREMENT
/begin MEASUREMENT lam_bank_1.lam_dly_inci.bf.lv_inh_lam_dly "" ULONG _CNV_S_2_RANGE______2_CM 1 100. 0. 1. DISPLAY_IDENTIFIER LV_INH_LAM_DLY_1 ECU_ADDRESS 0x3fc6b8 BYTE_ORDER MSB_LAST BIT_MASK 0x80000000 /end MEASUREMENT
/begin MEASUREMENT lam_bank_1.lam_dly_inci.vls_down_av "" UWORD _CNV_A_R_LINEAR_____3_CM 1 100. 0. 4.99511719 DISPLAY_IDENTIFIER VLS_DOWN_AV_1 ECU_ADDRESS 0x3fc6c0 BYTE_ORDER MSB_LAST FORMAT "%5.3" /end MEASUREMENT
/begin MEASUREMENT lam_bank_2.lam_up.bf.lv_lam_lim_max "top - threshold of the controller output exceeded" ULONG _CNV_S_2_RANGE______2_CM 1 100. 0. 1. DISPLAY_IDENTIFIER LV_LAM_LIM_MAX_2 ECU_ADDRESS 0x3fc7f0 BYTE_ORDER MSB_LAST BIT_MASK 0x80000000 /end MEASUREMENT
/begin MEASUREMENT lam_bank_2.lam_up.bf.lv_lam_lim_min "bottom threshold of the controller output exceeded" ULONG _CNV_S_2_RANGE______2_CM 1 100. 0. 1. DISPLAY_IDENTIFIER LV_LAM_LIM_MIN_2 ECU_ADDRESS 0x3fc7f0 BYTE_ORDER MSB_LAST BIT_MASK 0x40000000 /end MEASUREMENT
/begin MEASUREMENT lam_bank_2.lam_up.bf.lv_lscl "lambda-controller activation signal" ULONG _CNV_S_2_RANGE______2_CM 1 100. 0. 1. DISPLAY_IDENTIFIER LV_LSCL_2 ECU_ADDRESS 0x3fc7f0 BYTE_ORDER MSB_LAST BIT_MASK 0x20000000 /end MEASUREMENT
/begin MEASUREMENT lam_bank_2.lam_up.bf.lv_t_tco_lam_max_lscl "lambda-controller activation by a timer condition instead of a TCO-condition" ULONG _CNV_S_2_RANGE______2_CM 1 100. 0. 1. DISPLAY_IDENTIFIER LV_T_TCO_LAM_MAX_LSCL_2 ECU_ADDRESS 0x3fc7f0 BYTE_ORDER MSB_LAST BIT_MASK 0x8000000 /end MEASUREMENT
/begin MEASUREMENT lam_bank_2.lam_up.bf.lv_lam_cor_lim_intr "the sum output signal is limited under non-stationary operating conditions (threshold exceeded)" ULONG _CNV_S_2_RANGE______2_CM 1 100. 0. 1. DISPLAY_IDENTIFIER LV_LAM_COR_LIM_INTR_2 ECU_ADDRESS 0x3fc7f0 BYTE_ORDER MSB_LAST BIT_MASK 0x2000000 /end MEASUREMENT
/begin MEASUREMENT lam_bank_2.lam_up.bf.lv_lam_adj_ad_end "lambda shift required by lambda adaptation was carried out" ULONG _CNV_S_2_RANGE______2_CM 1 100. 0. 1. DISPLAY_IDENTIFIER LV_LAM_ADJ_AD_END_2 ECU_ADDRESS 0x3fc7f0 BYTE_ORDER MSB_LAST BIT_MASK 0x800000 /end MEASUREMENT
/begin MEASUREMENT lam_bank_2.lam_up.bf.lv_fac_lam_i_delta_max_act "FAC_LAM_I_i gradient condition fulfilled; correction of LAM_I_1_i is active" ULONG _CNV_S_2_RANGE______2_CM 1 100. 0. 1. DISPLAY_IDENTIFIER LV_FAC_LAM_I_DELTA_MAX_ACT_2 ECU_ADDRESS 0x3fc7f0 BYTE_ORDER MSB_LAST BIT_MASK 0x200000 /end MEASUREMENT
/begin MEASUREMENT lam_bank_2.lam_up.bf.lv_vls_down_thd_afr_lam "flag indication that downstream sensor signal is above calibration threshold (used for lambda control)" ULONG _CNV_S_2_RANGE______2_CM 1 100. 0. 1. DISPLAY_IDENTIFIER LV_VLS_DOWN_THD_AFR_LAM_2 ECU_ADDRESS 0x3fc7f0 BYTE_ORDER MSB_LAST BIT_MASK 0x100000 /end MEASUREMENT
/begin MEASUREMENT lam_bank_2.lam_up.bf.lv_vls_down_thd_afl_lam "flag indication that downstream sensor signal is below calibration threshold (used for lambda control)" ULONG _CNV_S_2_RANGE______2_CM 1 100. 0. 1. DISPLAY_IDENTIFIER LV_VLS_DOWN_THD_AFL_LAM_2 ECU_ADDRESS 0x3fc7f0 BYTE_ORDER MSB_LAST BIT_MASK 0x40000 /end MEASUREMENT
/begin MEASUREMENT lam_bank_2.lam_up.lamb "Signal value of the lambda sensor" UWORD _CNV_A_R_LINEAR_____206_CM 1 100. 0. 31.99902344 DISPLAY_IDENTIFIER LAMB_2 ECU_ADDRESS 0x3fc8a2 BYTE_ORDER MSB_LAST FORMAT "%7.4" /end MEASUREMENT
/begin MEASUREMENT lam_bank_2.lam_up.ti_lam_fac "factor for the injection time correction" SWORD _CNV_A_R_LINEAR_____111_CM 1 100. -50. 49.99847412 DISPLAY_IDENTIFIER TI_LAM_FAC_2 ECU_ADDRESS 0x3fc7f4 BYTE_ORDER MSB_LAST FORMAT "%6.2" /end MEASUREMENT
/begin MEASUREMENT lam_bank_2.lam_up.ti_lam_cor "controller output signal in consideration of the canister purge function and lambda adaptation" SWORD _CNV_A_R_LINEAR_____111_CM 1 100. -50. 49.99847412 DISPLAY_IDENTIFIER TI_LAM_COR_2 ECU_ADDRESS 0x3fc7f6 BYTE_ORDER MSB_LAST FORMAT "%6.2" /end MEASUREMENT
/begin MEASUREMENT lam_bank_2.lam_up.lamb_av_cor "signal of the lambda-sensor corrected by the trim-controller" UWORD _CNV_A_R_LINEAR_____206_CM 1 100. 0. 31.99902344 DISPLAY_IDENTIFIER LAMB_AV_COR_2 ECU_ADDRESS 0x3fc838 BYTE_ORDER MSB_LAST FORMAT "%7.4" /end MEASUREMENT
/begin MEASUREMENT lam_bank_2.lam_up.dly "Delay between the injection and the lambda-sensor signal" UWORD _CNV_A_R_LINEAR_____264_CM 1 100. 0. 1.049983 DISPLAY_IDENTIFIER DLY_2 ECU_ADDRESS 0x3fc7f8 BYTE_ORDER MSB_LAST FORMAT "%6.4" /end MEASUREMENT
/begin MEASUREMENT lam_bank_2.lam_up.lamb_dif "controller difference" SWORD _CNV_A_R_LINEAR_____281_CM 1 100. -1. 0.99996948 DISPLAY_IDENTIFIER LAMB_DIF_2 ECU_ADDRESS 0x3fc7fa BYTE_ORDER MSB_LAST FORMAT "%8.5" /end MEASUREMENT
/begin MEASUREMENT lam_bank_2.lam_up.lam_p_lim "limited P-share output signal" SWORD _CNV_A_R_LINEAR_____111_CM 1 100. -50. 49.99847412 DISPLAY_IDENTIFIER LAM_P_LIM_2 ECU_ADDRESS 0x3fc816 BYTE_ORDER MSB_LAST FORMAT "%7.3" /end MEASUREMENT
/begin MEASUREMENT lam_bank_2.lam_up.lam_i_i_lim "limited I+I2-share output signal" SWORD _CNV_A_R_LINEAR_____111_CM 1 100. -50. 49.99847412 DISPLAY_IDENTIFIER LAM_I_I_LIM_2 ECU_ADDRESS 0x3fc82a BYTE_ORDER MSB_LAST FORMAT "%7.3" /end MEASUREMENT
/begin MEASUREMENT lam_bank_2.lam_up.lam_d_lim "limited D-share output signal" SWORD _CNV_A_R_LINEAR_____111_CM 1 100. -50. 49.99847412 DISPLAY_IDENTIFIER LAM_D_LIM_2 ECU_ADDRESS 0x3fc82e BYTE_ORDER MSB_LAST FORMAT "%7.3" /end MEASUREMENT
/begin MEASUREMENT lam_bank_2.lam_up.lam_i "unlimited I-share output signal" SWORD _CNV_A_R_LINEAR_____111_CM 1 100. -50. 49.99847412 DISPLAY_IDENTIFIER LAM_I_2 ECU_ADDRESS 0x3fc818 BYTE_ORDER MSB_LAST FORMAT "%7.3" /end MEASUREMENT
/begin MEASUREMENT lam_bank_2.lam_up.lam_cor "unlimited controller output signal" SWORD _CNV_A_R_LINEAR_____111_CM 1 100. -50. 49.99847412 DISPLAY_IDENTIFIER LAM_COR_2 ECU_ADDRESS 0x3fc812 BYTE_ORDER MSB_LAST FORMAT "%7.3" /end MEASUREMENT
/begin MEASUREMENT lam_bank_2.lam_up.lam_lim "limited controller output signal" SWORD _CNV_A_R_LINEAR_____111_CM 1 100. -50. 49.99847412 DISPLAY_IDENTIFIER LAM_LIM_2 ECU_ADDRESS 0x3fc814 BYTE_ORDER MSB_LAST FORMAT "%7.3" /end MEASUREMENT
/begin MEASUREMENT lam_bank_2.lam_up.lam_mv "sum of the controller output from the I-and I2-share" SWORD _CNV_A_R_LINEAR_____111_CM 1 100. -50. 49.99847412 DISPLAY_IDENTIFIER LAM_MV_2 ECU_ADDRESS 0x3fc7fe BYTE_ORDER MSB_LAST FORMAT "%7.3" /end MEASUREMENT
/begin MEASUREMENT lam_bank_2.lam_up.lam_mv_lpf "moving mean value of LAM_MV" SWORD _CNV_A_R_LINEAR_____111_CM 1 100. -50. 49.99847412 DISPLAY_IDENTIFIER LAM_MV_LPF_2 ECU_ADDRESS 0x3fc800 BYTE_ORDER MSB_LAST FORMAT "%7.3" /end MEASUREMENT
/begin MEASUREMENT lam_bank_2.lam_up.lamb_sp_fil "output signal of the lambda-sensor model" UWORD _CNV_A_R_LINEAR_____206_CM 1 100. 0. 31.99902344 DISPLAY_IDENTIFIER LAMB_SP_FIL_2 ECU_ADDRESS 0x3fc878 BYTE_ORDER MSB_LAST FORMAT "%7.4" /end MEASUREMENT
/begin MEASUREMENT lam_bank_2.lam_up.lamb_sp_pctl_h_res "lambda set point with high resolution including the forced stimulation without influence secondary air influence" ULONG _CNV_A_R_LINEAR_____282_CM 1 100. 0. 32. DISPLAY_IDENTIFIER LAMB_SP_PCTL_H_RES_2 ECU_ADDRESS 0x3fc834 BYTE_ORDER MSB_LAST FORMAT "%8.5" /end MEASUREMENT
/begin MEASUREMENT lam_bank_2.lam_up.lamb_sp_fil_s_cp "output signal of the lambda-sensor model in stratified mode, used by canister purge" UWORD _CNV_A_R_LINEAR_____206_CM 1 100. 0. 31.99902344 DISPLAY_IDENTIFIER LAMB_SP_FIL_S_CP_2 ECU_ADDRESS 0x3fc888 BYTE_ORDER MSB_LAST FORMAT "%7.4" /end MEASUREMENT
/begin MEASUREMENT lam_bank_2.lam_up.lamb_mod "Input signal of the lambda-sensor model in homogeneous mode" UWORD _CNV_A_R_LINEAR_____206_CM 1 100. 0. 31.99902344 DISPLAY_IDENTIFIER LAMB_MOD_2 ECU_ADDRESS 0x3fc850 BYTE_ORDER MSB_LAST FORMAT "%7.4" /end MEASUREMENT
/begin MEASUREMENT lam_bank_2.lam_up.lamb_mod_s "Input signal of the lambda-sensor model in stratified mode" UWORD _CNV_A_R_LINEAR_____206_CM 1 100. 0. 31.99902344 DISPLAY_IDENTIFIER LAMB_MOD_S_2 ECU_ADDRESS 0x3fc864 BYTE_ORDER MSB_LAST FORMAT "%7.4" /end MEASUREMENT
/begin MEASUREMENT lam_bank_2.lam_up.t1_lamb "time lag of the lambda-sensor model" UWORD _CNV_A_R_LINEAR_____163_CM 1 100. 0. 1.99996948 DISPLAY_IDENTIFIER T1_LAMB_2 ECU_ADDRESS 0x3fc806 BYTE_ORDER MSB_LAST FORMAT "%6.4" /end MEASUREMENT
/begin MEASUREMENT lam_bank_2.lam_up.lam_mv_lpf_cp "mean value of the controller output, used by canister purge" SWORD _CNV_A_R_LINEAR_____111_CM 1 100. -50. 49.99847412 DISPLAY_IDENTIFIER LAM_MV_LPF_CP_2 ECU_ADDRESS 0x3fc802 BYTE_ORDER MSB_LAST FORMAT "%7.3" /end MEASUREMENT
/begin MEASUREMENT lam_bank_2.lam_up.lamb_av_cor_h_res "signal of the lambda-sensor corrected by the trim-controller (high resolution)" ULONG _CNV_A_R_LINEAR_____282_CM 1 100. 0. 32. DISPLAY_IDENTIFIER LAMB_AV_COR_H_RES_2 ECU_ADDRESS 0x3fc83c BYTE_ORDER MSB_LAST FORMAT "%8.5" /end MEASUREMENT
/begin MEASUREMENT lam_bank_2.lam_up.lamb_sp_fil_h_res "output signal with high resolution of the lambda-sensor model" ULONG _CNV_A_R_LINEAR_____282_CM 1 100. 0. 32. DISPLAY_IDENTIFIER LAMB_SP_FIL_H_RES_2 ECU_ADDRESS 0x3fc87c BYTE_ORDER MSB_LAST FORMAT "%8.5" /end MEASUREMENT
/begin MEASUREMENT lam_bank_2.lam_up.lamb_sp_fil_s_cp_h_res "output signal with high resolution of the lambda-sensor model in stratified mode, used by canister purge" ULONG _CNV_A_R_LINEAR_____282_CM 1 100. 0. 32. DISPLAY_IDENTIFIER LAMB_SP_FIL_S_CP_H_RES_2 ECU_ADDRESS 0x3fc88c BYTE_ORDER MSB_LAST FORMAT "%8.5" /end MEASUREMENT
/begin MEASUREMENT lam_bank_2.lam_up.lamb_sp_mod_h_res "lambda-controller set point with high resolution including the forced stimulation and secondary air influence" ULONG _CNV_A_R_LINEAR_____282_CM 1 100. 0. 32. DISPLAY_IDENTIFIER LAMB_SP_MOD_H_RES_2 ECU_ADDRESS 0x3fc830 BYTE_ORDER MSB_LAST FORMAT "%8.5" /end MEASUREMENT
/begin MEASUREMENT lam_bank_2.lam_up.lamb_mod_h_res "Input signal with high resolution of the lambda-sensor model in homogeneous mode" ULONG _CNV_A_R_LINEAR_____282_CM 1 100. 0. 32. DISPLAY_IDENTIFIER LAMB_MOD_H_RES_2 ECU_ADDRESS 0x3fc854 BYTE_ORDER MSB_LAST FORMAT "%8.5" /end MEASUREMENT
/begin MEASUREMENT lam_bank_2.lam_up.lamb_mod_s_h_res "Input signal with high resolution of the lambda-sensor model in stratified mode" ULONG _CNV_A_R_LINEAR_____282_CM 1 100. 0. 32. DISPLAY_IDENTIFIER LAMB_MOD_S_H_RES_2 ECU_ADDRESS 0x3fc868 BYTE_ORDER MSB_LAST FORMAT "%8.5" /end MEASUREMENT
/begin MEASUREMENT lam_bank_2.lam_up.lam_i_i_lim_sum "limited I+I2-share output signal" SWORD _CNV_A_R_LINEAR_____111_CM 1 100. -50. 49.99847412 DISPLAY_IDENTIFIER LAM_I_I_LIM_SUM_2 ECU_ADDRESS 0x3fc82c BYTE_ORDER MSB_LAST FORMAT "%7.3" /end MEASUREMENT
/begin MEASUREMENT lam_bank_2.lam_up.lam_i_i "unlimited I2-share output signal" SWORD _CNV_A_R_LINEAR_____111_CM 1 100. -50. 49.99847412 DISPLAY_IDENTIFIER LAM_I_I_2 ECU_ADDRESS 0x3fc828 BYTE_ORDER MSB_LAST FORMAT "%7.3" /end MEASUREMENT
/begin MEASUREMENT lam_bank_2.lam_up.lam_i_1_lim "limited summation of controller difference" SLONG _CNV_A_R_LINEAR_____283_CM 1 100. -65536. 65535.99997 DISPLAY_IDENTIFIER LAM_I_1_LIM_2 ECU_ADDRESS 0x3fc824 BYTE_ORDER MSB_LAST FORMAT "%11.4" /end MEASUREMENT
/begin MEASUREMENT lam_bank_2.lam_up.lam_i_1 "unlimited summation of controller difference" SLONG _CNV_A_R_LINEAR_____283_CM 1 100. -65536. 65535.99997 DISPLAY_IDENTIFIER LAM_I_1_2 ECU_ADDRESS 0x3fc81c BYTE_ORDER MSB_LAST FORMAT "%11.4" /end MEASUREMENT
/begin MEASUREMENT lam_bank_2.lam_up.lam_mv_dyw_tmp "temporary mean value of the controller output, used by limited dynamics" SWORD _CNV_A_R_LINEAR_____111_CM 1 100. -50. 49.99847412 DISPLAY_IDENTIFIER LAM_MV_DYW_TMP_2 ECU_ADDRESS 0x3fc804 BYTE_ORDER MSB_LAST FORMAT "%7.3" /end MEASUREMENT
/begin MEASUREMENT lam_bank_2.lam_up.ex_dly_fac "weighting factor for the calculation of the exhaust gas delay" UBYTE _CNV_A_R_LINEAR_____271_CM 1 100. 0. 31.99 DISPLAY_IDENTIFIER EX_DLY_FAC_2 ECU_ADDRESS 0x3fc8a8 FORMAT "%4.1" /end MEASUREMENT
/begin MEASUREMENT lam_bank_2.lam_up.lamb_dif_mmv_lam "moving mean value of controller difference" SWORD _CNV_A_R_LINEAR_____281_CM 1 100. -1. 0.99996948 DISPLAY_IDENTIFIER LAMB_DIF_MMV_LAM_2 ECU_ADDRESS 0x3fc840 BYTE_ORDER MSB_LAST FORMAT "%8.5" /end MEASUREMENT
/begin MEASUREMENT lam_bank_2.lam_up.lam_i_1_save "saved unlimited summation of controller difference" SLONG _CNV_A_R_LINEAR_____283_CM 1 100. -65536. 65535.99997 DISPLAY_IDENTIFIER LAM_I_1_SAVE_2 ECU_ADDRESS 0x3fc820 BYTE_ORDER MSB_LAST FORMAT "%11.4" /end MEASUREMENT
/begin MEASUREMENT lam_bank_2.lam_up.t_lam_i_1_save_afl "time after LAM_I_1_i was stored for downstream signal too lean" UWORD _CNV_A_R_LINEAR_____198_CM 1 100. 0. 1310.7 DISPLAY_IDENTIFIER T_LAM_I_1_SAVE_AFL_2 ECU_ADDRESS 0x3fc89a BYTE_ORDER MSB_LAST FORMAT "%7.2" /end MEASUREMENT
/begin MEASUREMENT lam_bank_2.lam_up.t_lam_i_1_save_afr "time after LAM_I_1_i was stored for downstream signal too rich" UWORD _CNV_A_R_LINEAR_____198_CM 1 100. 0. 1310.7 DISPLAY_IDENTIFIER T_LAM_I_1_SAVE_AFR_2 ECU_ADDRESS 0x3fc89c BYTE_ORDER MSB_LAST FORMAT "%7.2" /end MEASUREMENT
/begin MEASUREMENT lam_bank_2.lam_up.delta_lam_i_save "I share shift and opposite I^2 share shift" SWORD _CNV_A_R_LINEAR_____111_CM 1 100. -50. 49.99847412 DISPLAY_IDENTIFIER DELTA_LAM_I_SAVE_2 ECU_ADDRESS 0x3fc8aa BYTE_ORDER MSB_LAST FORMAT "%7.3" /end MEASUREMENT
/begin MEASUREMENT lam_bank_2.lam_up.vls_down_mmv_lam "moving mean value of downstream sensor signal used for lambda control" UWORD _CNV_A_R_LINEAR_____269_CM 1 100. 0. 5. DISPLAY_IDENTIFIER VLS_DOWN_MMV_LAM_2 ECU_ADDRESS 0x3fc848 BYTE_ORDER MSB_LAST FORMAT "%5.3" /end MEASUREMENT
/begin MEASUREMENT lam_bank_2.lamb_scc.lamb_scc "Lambda setpoint at single cylinder cut off" UWORD _CNV_A_R_LINEAR_____206_CM 1 100. 0. 31.99902344 DISPLAY_IDENTIFIER LAMB_SCC_2 ECU_ADDRESS 0x3fc736 BYTE_ORDER MSB_LAST FORMAT "%7.4" /end MEASUREMENT
/begin MEASUREMENT lam_bank_2.lam_bas_sp.lamb_bas_h_res "bank selektive basic lambda setpoint with high resolution" ULONG _CNV_A_R_LINEAR_____282_CM 1 100. 0. 32. DISPLAY_IDENTIFIER LAMB_BAS_H_RES_2 ECU_ADDRESS 0x3fc77c BYTE_ORDER MSB_LAST FORMAT "%8.5" /end MEASUREMENT
/begin MEASUREMENT lam_bank_2.lam_bas_sp.lamb_hom_afs_h_res "stoichiometric lambda setpoint with high resolution" ULONG _CNV_A_R_LINEAR_____282_CM 1 100. 0. 32. DISPLAY_IDENTIFIER LAMB_HOM_AFS_H_RES_2 ECU_ADDRESS 0x3fc780 BYTE_ORDER MSB_LAST FORMAT "%8.5" /end MEASUREMENT
/begin MEASUREMENT lam_bank_2.lam_bas_sp.lamb_bas "bank selektive basic lambda setpoint" UWORD _CNV_A_R_LINEAR_____206_CM 1 100. 0. 31.99902344 DISPLAY_IDENTIFIER LAMB_BAS_2 ECU_ADDRESS 0x3fc784 BYTE_ORDER MSB_LAST FORMAT "%7.4" /end MEASUREMENT
/begin MEASUREMENT lam_bank_2.lam_bas_sp.lamb_hom_afs "stoichiometric lambda setpoint" UWORD _CNV_A_R_LINEAR_____206_CM 1 100. 0. 31.99902344 DISPLAY_IDENTIFIER LAMB_HOM_AFS_2 ECU_ADDRESS 0x3fc786 BYTE_ORDER MSB_LAST FORMAT "%7.4" /end MEASUREMENT
/begin MEASUREMENT lam_bank_2.lam_bas_sp.lv_lamb_bas_ofs_cat_diag "flag_to indicate lambda offset" UBYTE _CNV_S_2_RANGE______2_CM 1 100. 0. 1. DISPLAY_IDENTIFIER LV_LAMB_BAS_OFS_CAT_DIAG_2 ECU_ADDRESS 0x3fc788 /end MEASUREMENT
/begin MEASUREMENT lam_bank_2.lam_dlyl.bf.lv_ldc_dly "status limited dynamic" ULONG _CNV_S_2_RANGE______2_CM 1 100. 0. 1. DISPLAY_IDENTIFIER LV_LDC_DLY_2 ECU_ADDRESS 0x3fc9e8 BYTE_ORDER MSB_LAST BIT_MASK 0x80000000 /end MEASUREMENT
/begin MEASUREMENT lam_bank_2.lam_dlyl.bf.lv_lam_mv_ldc_dly "status limited dynamic LAM_MV_i" ULONG _CNV_S_2_RANGE______2_CM 1 100. 0. 1. DISPLAY_IDENTIFIER LV_LAM_MV_LDC_DLY_2 ECU_ADDRESS 0x3fc9e8 BYTE_ORDER MSB_LAST BIT_MASK 0x40000000 /end MEASUREMENT
/begin MEASUREMENT lam_bank_2.lam_dlyl.lam_mv_mmv_dly "floating mean value for limited lambda deviation" SWORD _CNV_A_R_LINEAR_____111_CM 1 100. -50. 49.99847412 DISPLAY_IDENTIFIER LAM_MV_MMV_DLY_2 ECU_ADDRESS 0x3fc9ec BYTE_ORDER MSB_LAST FORMAT "%7.3" /end MEASUREMENT
/begin MEASUREMENT lam_bank_2.lam_dlyl.maf_int_ldc_dly "integral of mass air flow since limited dynamic conditions are fulfilled" UWORD _CNV_A_R_LINEAR_____287_CM 1 100. 0. 1820.398 DISPLAY_IDENTIFIER MAF_INT_LDC_DLY_2 ECU_ADDRESS 0x3fc9f0 BYTE_ORDER MSB_LAST FORMAT "%7.2" /end MEASUREMENT
/begin MEASUREMENT lam_bank_2.lam_dlyl.pv_av_grd_sum_dly "sum. value for limited lambda deviation" UWORD _CNV_A_R_LINEAR_____318_CM 1 100. 0. 639990.2340000001 DISPLAY_IDENTIFIER PV_AV_GRD_SUM_DLY_2 ECU_ADDRESS 0x3fc9ee BYTE_ORDER MSB_LAST FORMAT "%8.1" /end MEASUREMENT
/begin MEASUREMENT lam_bank_2.lam_o2l.delta_lamb_sp_o2l_mdl "lambda set point shift of catalyst O2 loading condition function" SWORD _CNV_A_R_LINEAR_____288_CM 1 100. -0.125 0.125 DISPLAY_IDENTIFIER DELTA_LAMB_SP_O2L_MDL_2 ECU_ADDRESS 0x3fcb98 BYTE_ORDER MSB_LAST FORMAT "%8.5" /end MEASUREMENT
/begin MEASUREMENT lam_bank_2.lam_o2l.maf_int_efc_o2l_mdl "effective air mass integral representing O2 loading used for lambda set point shift calculation " UWORD _CNV_A_R_LINEAR_____344_CM 1 100. 0. 182.0389 DISPLAY_IDENTIFIER MAF_INT_EFC_O2L_MDL_2 ECU_ADDRESS 0x3fcb9a BYTE_ORDER MSB_LAST FORMAT "%7.3" /end MEASUREMENT
/begin MEASUREMENT lam_bank_2.lam_o2l.maf_int_o2l_mdl "air mass integral representing O2 loading used for calculation of effective one" SLONG _CNV_A_R_LINEAR_____345_CM 1 100. -182.0444 182.0444 DISPLAY_IDENTIFIER MAF_INT_O2L_MDL_2 ECU_ADDRESS 0x3fcb8c BYTE_ORDER MSB_LAST FORMAT "%10.5" /end MEASUREMENT
/begin MEASUREMENT lam_bank_2.lam_o2l.maf_int_max_o2l_mdl "adaptive maximum of air mass integral representing O2 loading" UWORD _CNV_A_R_LINEAR_____344_CM 1 100. 0. 182.0389 DISPLAY_IDENTIFIER MAF_INT_MAX_O2L_MDL_2 ECU_ADDRESS 0x3fcb9c BYTE_ORDER MSB_LAST FORMAT "%7.3" /end MEASUREMENT
/begin MEASUREMENT lam_bank_2.lam_o2l.maf_int_sample_step_o2l_mdl "air mass integral representing O2 loading of one sample step" SWORD _CNV_A_R_LINEAR_____346_CM 1 100. -0.355555555555 0.355544704861 DISPLAY_IDENTIFIER MAF_INT_SAMPLE_STEP_O2L_MDL_2 ECU_ADDRESS 0x3fcb9e BYTE_ORDER MSB_LAST FORMAT "%7.5" /end MEASUREMENT
/begin MEASUREMENT lam_bank_2.lam_o2l.maf_int_mmv_o2l_mdl "moving mean value of effective air mass integral representing O2 loading" UWORD _CNV_A_R_LINEAR_____344_CM 1 100. 0. 182.0389 DISPLAY_IDENTIFIER MAF_INT_MMV_O2L_MDL_2 ECU_ADDRESS 0x3fcba0 BYTE_ORDER MSB_LAST FORMAT "%7.3" /end MEASUREMENT
/begin MEASUREMENT lam_bank_2.lam_o2l.quo_maf_int_efc_o2l_mdl "quotient between moving mean value of effective air mass integral and adaptive maximum" UWORD _CNV_A_R_LINEAR_____8_CM 1 100. 0. 99.99847412 DISPLAY_IDENTIFIER QUO_MAF_INT_EFC_O2L_MDL_2 ECU_ADDRESS 0x3fcba2 BYTE_ORDER MSB_LAST /end MEASUREMENT
/begin MEASUREMENT lam_bank_2.lam_o2l.fac_maf_int_o2l_mdl "factor for air mass integral calculation taking into account lambda signal and basis lambda set point  " SWORD _CNV_A_R_LINEAR_____276_CM 1 100. -2. 1.999938965 DISPLAY_IDENTIFIER FAC_MAF_INT_O2L_MDL_2 ECU_ADDRESS 0x3fcba4 BYTE_ORDER MSB_LAST FORMAT "%8.4" /end MEASUREMENT
/begin MEASUREMENT lam_bank_2.lam_o2l.fac_add_maf_int_o2l_mdl "additional factor for air mass integral calculation taking into account different integration speeds" UBYTE _CNV_A_R_LINEAR_____117_CM 1 100. 0. 1.9921875 DISPLAY_IDENTIFIER FAC_ADD_MAF_INT_O2L_MDL_2 ECU_ADDRESS 0x3fcbac FORMAT "%5.3" /end MEASUREMENT
/begin MEASUREMENT lam_bank_2.lam_o2l.vls_down_mmv_o2l_mdl "moving mean value of downstream sensor signal used for cat O2 loading model" UWORD _CNV_A_R_LINEAR_____269_CM 1 100. 0. 5. DISPLAY_IDENTIFIER VLS_DOWN_MMV_O2L_MDL_2 ECU_ADDRESS 0x3fcba6 BYTE_ORDER MSB_LAST FORMAT "%5.3" /end MEASUREMENT
/begin MEASUREMENT lam_bank_2.lam_o2l.bf.lv_vls_down_thd_afr_o2l_mdl "flag indication that downstream sensor signal is above calibration threshold" ULONG _CNV_S_2_RANGE______2_CM 1 100. 0. 1. DISPLAY_IDENTIFIER LV_VLS_DOWN_THD_AFR_O2L_MDL_2 ECU_ADDRESS 0x3fcb88 BYTE_ORDER MSB_LAST BIT_MASK 0x40000000 /end MEASUREMENT
/begin MEASUREMENT lam_bank_2.lam_o2l.bf.lv_vls_down_thd_afl_o2l_mdl "flag indication that downstream sensor signal is below calibration threshold" ULONG _CNV_S_2_RANGE______2_CM 1 100. 0. 1. DISPLAY_IDENTIFIER LV_VLS_DOWN_THD_AFL_O2L_MDL_2 ECU_ADDRESS 0x3fcb88 BYTE_ORDER MSB_LAST BIT_MASK 0x20000000 /end MEASUREMENT
/begin MEASUREMENT lam_bank_2.lam_o2l.bf.lv_pue_o2l_mdl "flag indicating post PUC phase used for cat O2 loading model" ULONG _CNV_S_2_RANGE______2_CM 1 100. 0. 1. DISPLAY_IDENTIFIER LV_PUE_O2L_MDL_2 ECU_ADDRESS 0x3fcb88 BYTE_ORDER MSB_LAST BIT_MASK 0x10000000 /end MEASUREMENT
/begin MEASUREMENT lam_bank_2.lam_o2l.bf.lv_maf_int_o2l_mdl_clc_act "flag indication that O2 loading integral calculation is active" ULONG _CNV_S_2_RANGE______2_CM 1 100. 0. 1. DISPLAY_IDENTIFIER LV_MAF_INT_O2L_MDL_CLC_ACT_2 ECU_ADDRESS 0x3fcb88 BYTE_ORDER MSB_LAST BIT_MASK 0x80000000 /end MEASUREMENT
/begin MEASUREMENT lam_bank_2.lam_o2l.lamb_sp_ref_o2l_mdl "lambda setpoint reference for O2 loading model" UWORD _CNV_A_R_LINEAR_____347_CM 1 100. 0. 1.99993897 DISPLAY_IDENTIFIER LAMB_SP_REF_O2L_MDL_2 ECU_ADDRESS 0x3fcba8 BYTE_ORDER MSB_LAST FORMAT "%7.5" /end MEASUREMENT
/begin MEASUREMENT lam_bank_2.lam_o2l.delta_lamb_cor_o2l_mdl "lambda delta for WRAF sensor signal LAMB_i used for air mass integral calculation" SWORD _CNV_A_R_LINEAR_____286_CM 1 100. -0.125 0.124996 DISPLAY_IDENTIFIER DELTA_LAMB_COR_O2L_MDL_2 ECU_ADDRESS 0x3fcbaa BYTE_ORDER MSB_LAST FORMAT "%8.6" /end MEASUREMENT
/begin MEASUREMENT lam_bank_2.lsh_down_inci.lv_inh_lsh_down "Boolean flag indicating project specific application conditions for heating not met" UBYTE _CNV_S_2_RANGE______2_CM 1 100. 0. 1. DISPLAY_IDENTIFIER LV_INH_LSH_DOWN ECU_ADDRESS 0x3fc8c8 /end MEASUREMENT
/begin MEASUREMENT lam_bank_2.lsh_down_inci.temp_ls_down_ini "Oxygen sensor temperature at start" SWORD _CNV_A_R_LINEAR_____303_CM 1 100. -2048. 2047.938 DISPLAY_IDENTIFIER TEMP_LS_DOWN_INI ECU_ADDRESS 0x3fc8ca BYTE_ORDER MSB_LAST FORMAT "%8.2" /end MEASUREMENT
/begin MEASUREMENT lam_bank_2.lam_dly_inci.bf.lv_inh_lam_dly "" ULONG _CNV_S_2_RANGE______2_CM 1 100. 0. 1. DISPLAY_IDENTIFIER LV_INH_LAM_DLY_2 ECU_ADDRESS 0x3fcb70 BYTE_ORDER MSB_LAST BIT_MASK 0x80000000 /end MEASUREMENT
/begin MEASUREMENT lam_bank_2.lam_dly_inci.vls_down_av "" UWORD _CNV_A_R_LINEAR_____3_CM 1 100. 0. 4.99511719 DISPLAY_IDENTIFIER VLS_DOWN_AV_1 ECU_ADDRESS 0x3fcb78 BYTE_ORDER MSB_LAST FORMAT "%5.3" /end MEASUREMENT
/begin CHARACTERISTIC c_tia_mff_ad_max "Maximum air temperature for adaptive learning" VALUE 0xffe40962 _REC_VAL_20_u1 190.5 _CNV_A_R_LINEAR_____11_CM -48. 142.5 DISPLAY_IDENTIFIER C_TIA_MFF_AD_MAX FORMAT "%5.1" /end CHARACTERISTIC
/begin CHARACTERISTIC c_maf_mff_ad_max "Maximum MAF for adaptive learning" VALUE 0xffe417c2 _REC_VAL_20_u2 2047.96875 _CNV_A_R_LINEAR_____115_CM 0. 2047.96875 DISPLAY_IDENTIFIER C_MAF_MFF_AD_MAX FORMAT "%7.2" /end CHARACTERISTIC
/begin CHARACTERISTIC c_tco_mff_ad_min "Minimum coolant temperature for adaptive learning" VALUE 0xffe4090c _REC_VAL_20_u1 190.5 _CNV_A_R_LINEAR_____11_CM -48. 142.5 DISPLAY_IDENTIFIER C_TCO_MFF_AD_MIN FORMAT "%5.1" /end CHARACTERISTIC
/begin CHARACTERISTIC ip_lamb_scc "lambda setpoint for single cylinder shut off" CURVE 0xffe4cb8e _REC_CUR_20_u2_u1 31.99902344 _CNV_A_R_LINEAR_____206_CM 0. 31.99902344 DISPLAY_IDENTIFIER IP_LAMB_SCC FORMAT "%7.4"
 /begin AXIS_DESCR COM_AXIS tco _CNV_A_R_LINEAR_____11_CM 8 -48. 142.5 FORMAT "%5.1" AXIS_PTS_REF ldp_tco_ip_lamb_scc /end AXIS_DESCR
/end CHARACTERISTIC
/begin AXIS_PTS ldp_tco_ip_lamb_scc "" 0xffe4822e tco _REC_AXS_20_u1 190.5 _CNV_A_R_LINEAR_____11_CM 8 -48. 142.5 DISPLAY_IDENTIFIER LDP_TCO_IP_LAMB_SCC FORMAT "%5.1" /end AXIS_PTS
/begin MEASUREMENT maf_mmv_dly "floating mean value for limited MAF" UWORD _CNV_A_R_LINEAR_____108_CM 1 100. 0. 1389. DISPLAY_IDENTIFIER MAF_MMV_DLY ECU_ADDRESS 0x3fd4a8 BYTE_ORDER MSB_LAST FORMAT "%7.2" /end MEASUREMENT
/begin CHARACTERISTIC c_maf_crlc_dly "floating mean value calculation MAF" VALUE 0xffe41728 _REC_VAL_20_u2 0.99998474 _CNV_A_R_LINEAR_____37_CM 0. 0.99998474 DISPLAY_IDENTIFIER C_MAF_CRLC_DLY FORMAT "%7.5" /end CHARACTERISTIC
/begin CHARACTERISTIC c_lam_mv_crlc_dly "floating mean value calculation lambda " VALUE 0xffe41696 _REC_VAL_20_u2 0.99998474 _CNV_A_R_LINEAR_____37_CM 0. 0.99998474 DISPLAY_IDENTIFIER C_LAM_MV_CRLC_DLY FORMAT "%7.5" /end CHARACTERISTIC
/begin CHARACTERISTIC c_n_dyw_dly "threshold limited dynamic engine speed" VALUE 0xffe41800 _REC_VAL_20_u2 8159. _CNV_A_R_LINEAR_____10_CM 1. 8160. DISPLAY_IDENTIFIER C_N_DYW_DLY FORMAT "%4.0" /end CHARACTERISTIC
/begin CHARACTERISTIC c_maf_dyw_dly "threshold limited dynamic engine MAF " VALUE 0xffe41742 _REC_VAL_20_u2 1389. _CNV_A_R_LINEAR_____108_CM 0. 1389. DISPLAY_IDENTIFIER C_MAF_DYW_DLY FORMAT "%7.2" /end CHARACTERISTIC
/begin CHARACTERISTIC c_lam_mv_dyw_dly "threshold limited dynamic lambda " VALUE 0xffe4169e _REC_VAL_20_u2 99.99847412 _CNV_A_R_LINEAR_____8_CM 0. 99.99847412 DISPLAY_IDENTIFIER C_LAM_MV_DYW_DLY /end CHARACTERISTIC
/begin MEASUREMENT n_mmv_dly "floating mean value for limited engine speed" UWORD _CNV_A_R_LINEAR_____10_CM 1 100. 0. 8160. DISPLAY_IDENTIFIER N_MMV_DLY ECU_ADDRESS 0x3fd4a6 BYTE_ORDER MSB_LAST FORMAT "%4.0" /end MEASUREMENT
/begin MEASUREMENT lv_n_ldc_dly "status limited dynamic N" UBYTE _CNV_S_2_RANGE______2_CM 1 100. 0. 1. DISPLAY_IDENTIFIER LV_N_LDC_DLY ECU_ADDRESS 0x3fe527 /end MEASUREMENT
/begin MEASUREMENT lv_maf_ldc_dly "status limited dynamic MAF" UBYTE _CNV_S_2_RANGE______2_CM 1 100. 0. 1. DISPLAY_IDENTIFIER LV_MAF_LDC_DLY ECU_ADDRESS 0x3fe528 /end MEASUREMENT
/begin CHARACTERISTIC c_n_crlc_dly "floating mean value calculation engine speed" VALUE 0xffe417ea _REC_VAL_20_u2 0.99998474 _CNV_A_R_LINEAR_____37_CM 0. 0.99998474 DISPLAY_IDENTIFIER C_N_CRLC_DLY FORMAT "%7.5" /end CHARACTERISTIC
/begin CHARACTERISTIC c_pv_av_grd_dec_dly "decrement for calculation PV_AV gradient" VALUE 0xffe40822 _REC_VAL_20_u1 2490.234 _CNV_A_R_LINEAR_____358_CM 0. 2490.234 DISPLAY_IDENTIFIER C_PV_AV_GRD_DEC_DLY FORMAT "%6.1" /end CHARACTERISTIC
/begin CHARACTERISTIC c_pv_av_grd_sum_max_dly "max. threshold limited dynamic PV_AV gradient" VALUE 0xffe41888 _REC_VAL_20_u2 639990.2340000001 _CNV_A_R_LINEAR_____318_CM 0. 639990.2340000001 DISPLAY_IDENTIFIER C_PV_AV_GRD_SUM_MAX_DLY FORMAT "%8.1" /end CHARACTERISTIC
/begin CHARACTERISTIC c_pv_av_grd_sum_min_dly "min. threshold limited dynamic PV_AV gradient" VALUE 0xffe4188c _REC_VAL_20_u2 639990.2340000001 _CNV_A_R_LINEAR_____318_CM 0. 639990.2340000001 DISPLAY_IDENTIFIER C_PV_AV_GRD_SUM_MIN_DLY FORMAT "%8.1" /end CHARACTERISTIC
/begin CHARACTERISTIC c_t_pv_av_grd_dec_sum_dly "time periods for calculation limited dynamic PV_AV gradient" VALUE 0xffe408c8 _REC_VAL_20_u1 5.1 _CNV_A_R_LINEAR_____198_CM 0. 5.1 DISPLAY_IDENTIFIER C_T_PV_AV_GRD_DEC_SUM_DLY FORMAT "%4.2" /end CHARACTERISTIC
/begin CHARACTERISTIC c_pv_av_grd_min_sum_dly "minimum value of PV_AV gradient to increment PV_AV_GRD_SUM_DLY" VALUE 0xffe40825 _REC_VAL_20_u1 1240.2 _CNV_A_R_LINEAR_____359_CM 0. 1240.2 DISPLAY_IDENTIFIER C_PV_AV_GRD_MIN_SUM_DLY FORMAT "%6.1" /end CHARACTERISTIC
/begin CHARACTERISTIC c_maf_int_min_ldc_dly "threshold for MAF integral while restart of LAM after inactive " VALUE 0xffe4176e _REC_VAL_20_u2 1820.398 _CNV_A_R_LINEAR_____287_CM 0. 1820.398 DISPLAY_IDENTIFIER C_MAF_INT_MIN_LDC_DLY FORMAT "%7.2" /end CHARACTERISTIC
/begin AXIS_PTS ldpm_maf_hb_2_egtr "" 0xffe483f9 maf _REC_AXS_20_u1 1389. _CNV_A_R_LINEAR_____27_CM 8 0. 1389. DISPLAY_IDENTIFIER LDPM_MAF_HB_2_EGTR FORMAT "%4.0" /end AXIS_PTS
/begin AXIS_PTS ldpm_n_32_2_egtr "" 0xffe4848f n_32 _REC_AXS_20_u1 8160. _CNV_A_R_LINEAR_____15_CM 8 0. 8160. DISPLAY_IDENTIFIER LDPM_N_32_2_EGTR FORMAT "%4.0" /end AXIS_PTS
/begin CHARACTERISTIC c_temp_cat_down_ls_ready "Temperature threshold above which O2 sensor recognised as operatively ready" VALUE 0xffe41a62 _REC_VAL_20_u2 1023.984375 _CNV_A_R_LINEAR_____343_CM -33. 990.984375 DISPLAY_IDENTIFIER C_TEMP_CAT_DOWN_LS_READY FORMAT "%5.2" /end CHARACTERISTIC
/begin CHARACTERISTIC c_vls_down_afl_ready "Lean VLS_xxxx_i threshold for operative readiness detection" VALUE 0xffe41b44 _REC_VAL_20_u2 4.99511719 _CNV_A_R_LINEAR_____3_CM 0. 4.99511719 DISPLAY_IDENTIFIER C_VLS_DOWN_AFL_READY FORMAT "%5.3" /end CHARACTERISTIC
/begin CHARACTERISTIC c_vls_down_afr_ready "Rich VLS_xxxx_i threshold for operative readiness detection" VALUE 0xffe41b4a _REC_VAL_20_u2 4.99511719 _CNV_A_R_LINEAR_____3_CM 0. 4.99511719 DISPLAY_IDENTIFIER C_VLS_DOWN_AFR_READY FORMAT "%5.3" /end CHARACTERISTIC
/begin CHARACTERISTIC c_maf_int_puc_max_down_ls_ready "Maximum MAF integral during PUC for operability reset\n" VALUE 0xffe41784 _REC_VAL_20_u2 1820.398 _CNV_A_R_LINEAR_____287_CM 0. 1820.398 DISPLAY_IDENTIFIER C_MAF_INT_PUC_MAX_DOWN_LS_READY FORMAT "%7.2" /end CHARACTERISTIC
/begin CHARACTERISTIC lc_lsh_down_1 "Boolean variable to enable oxygen sensor heating" VALUE 0xffe40f9a _REC_VAL_20_u1 1. _CNV_A_R_LINEAR_____22_CM 0. 1. DISPLAY_IDENTIFIER LC_LSH_DOWN_1 FORMAT "%1.0" /end CHARACTERISTIC
/begin CHARACTERISTIC lc_lsh_down_2 "Boolean variable to enable oxygen sensor heating" VALUE 0xffe40f9b _REC_VAL_20_u1 1. _CNV_A_R_LINEAR_____22_CM 0. 1. DISPLAY_IDENTIFIER LC_LSH_DOWN_2 FORMAT "%1.0" /end CHARACTERISTIC
/begin MEASUREMENT lamb_mv "mean value lambda in multiple-branched exhaust gas lines" UWORD _CNV_A_R_LINEAR_____206_CM 1 100. 0. 31.99902344 DISPLAY_IDENTIFIER LAMB_MV ECU_ADDRESS 0x3fd4d8 BYTE_ORDER MSB_LAST FORMAT "%7.4" /end MEASUREMENT
/begin MEASUREMENT lamb_min "minimum value lambda in multiple-branched exhaust gas lines" UWORD _CNV_A_R_LINEAR_____206_CM 1 100. 0. 31.99902344 DISPLAY_IDENTIFIER LAMB_MIN ECU_ADDRESS 0x3fd4da BYTE_ORDER MSB_LAST FORMAT "%7.4" /end MEASUREMENT
/begin MEASUREMENT teg_1.appl_inc_struct.lamb_sp_teg "Lambda setpoint for TEG calculation (bank 1,2)" UWORD _CNV_A_R_LINEAR_____206_CM 1 100. 0. 31.99902344 DISPLAY_IDENTIFIER LAMB_SP_TEG_1 ECU_ADDRESS 0x3fcbe8 BYTE_ORDER MSB_LAST FORMAT "%7.4" /end MEASUREMENT
/begin MEASUREMENT teg_1.appl_inc_struct.eff_iga_av_teg "Ignition efficiency actual actual value for TEG calculation" UWORD _CNV_A_R_LINEAR_____20_CM 1 100. 0. 1.99996948 DISPLAY_IDENTIFIER EFF_IGA_AV_TEG_1 ECU_ADDRESS 0x3fcbf0 BYTE_ORDER MSB_LAST FORMAT "%7.5" /end MEASUREMENT
/begin MEASUREMENT teg_1.appl_inc_struct.nr_cyl_scc_teg "Number of shut off cyl for TEG calculation" UBYTE _CNV_A_R_LINEAR_____441_CM 1 100. 0. 13. DISPLAY_IDENTIFIER NR_CYL_SCC_TEG_1 ECU_ADDRESS 0x3fcbf8 FORMAT "%4.1" /end MEASUREMENT
/begin MEASUREMENT teg_2.appl_inc_struct.lamb_sp_teg "Lambda setpoint for TEG calculation (bank 1,2)" UWORD _CNV_A_R_LINEAR_____206_CM 1 100. 0. 31.99902344 DISPLAY_IDENTIFIER LAMB_SP_TEG_2 ECU_ADDRESS 0x3fccdc BYTE_ORDER MSB_LAST FORMAT "%7.4" /end MEASUREMENT
/begin MEASUREMENT teg_2.appl_inc_struct.eff_iga_av_teg "Ignition efficiency actual actual value for TEG calculation" UWORD _CNV_A_R_LINEAR_____20_CM 1 100. 0. 1.99996948 DISPLAY_IDENTIFIER EFF_IGA_AV_TEG_2 ECU_ADDRESS 0x3fcce4 BYTE_ORDER MSB_LAST FORMAT "%7.5" /end MEASUREMENT
/begin MEASUREMENT teg_2.appl_inc_struct.nr_cyl_scc_teg "Number of shut off cyl for TEG calculation" UBYTE _CNV_A_R_LINEAR_____441_CM 1 100. 0. 13. DISPLAY_IDENTIFIER NR_CYL_SCC_TEG_2 ECU_ADDRESS 0x3fccec FORMAT "%4.1" /end MEASUREMENT
/begin MEASUREMENT temp_cat "catalyst temperature" UWORD _CNV_A_R_LINEAR_____343_CM 1 100. -33. 990.984375 DISPLAY_IDENTIFIER TEMP_CAT ECU_ADDRESS 0x3fd6e2 BYTE_ORDER MSB_LAST FORMAT "%6.2" /end MEASUREMENT
/begin MEASUREMENT maf_teg "Air mass for TEG calculation" UWORD _CNV_A_R_LINEAR_____108_CM 1 100. 0. 1389. DISPLAY_IDENTIFIER MAF_TEG ECU_ADDRESS 0x3fd6d8 BYTE_ORDER MSB_LAST FORMAT "%7.2" /end MEASUREMENT
/begin MEASUREMENT maf_int_teg_st "Mass air beginning at  start" UWORD _CNV_A_R_LINEAR_____287_CM 1 100. 0. 1820.398 DISPLAY_IDENTIFIER MAF_INT_TEG_ST ECU_ADDRESS 0x3fd6dc BYTE_ORDER MSB_LAST FORMAT "%7.2" /end MEASUREMENT
/begin MEASUREMENT maf_kgh_teg "Mass air beginning at  start" UWORD _CNV_A_R_LINEAR_____115_CM 1 100. 0. 2047.96875 DISPLAY_IDENTIFIER MAF_KGH_TEG ECU_ADDRESS 0x3fd6da BYTE_ORDER MSB_LAST FORMAT "%7.2" /end MEASUREMENT
/begin MEASUREMENT n_teg "Engine speed for TEG calculation" UWORD _CNV_A_R_LINEAR_____10_CM 1 100. 1. 8160. DISPLAY_IDENTIFIER N_TEG ECU_ADDRESS 0x3fd6de BYTE_ORDER MSB_LAST FORMAT "%4.0" /end MEASUREMENT
/begin MEASUREMENT teg_dyn "model output signal of the exhaust gas temperature" UWORD _CNV_A_R_LINEAR_____6_CM 1 100. 0. 2047. DISPLAY_IDENTIFIER TEG_DYN ECU_ADDRESS 0x3fd6e0 BYTE_ORDER MSB_LAST FORMAT "%7.2" /end MEASUREMENT
/begin MEASUREMENT teg_cat_up_mdl_1 "exhaust gas temperature" UWORD _CNV_A_R_LINEAR_____6_CM 1 100. 0. 2047. DISPLAY_IDENTIFIER TEG_CAT_UP_MDL_1 ECU_ADDRESS 0x3fd6e4 BYTE_ORDER MSB_LAST FORMAT "%7.2" /end MEASUREMENT
/begin MEASUREMENT teg_cat_up_mdl_2 "exhaust gas temperature" UWORD _CNV_A_R_LINEAR_____6_CM 1 100. 0. 2047. DISPLAY_IDENTIFIER TEG_CAT_UP_MDL_2 ECU_ADDRESS 0x3fd6e8 BYTE_ORDER MSB_LAST FORMAT "%7.2" /end MEASUREMENT
/begin MEASUREMENT teg_cat_down_mdl_2 "exhaust gas temperature" UWORD _CNV_A_R_LINEAR_____6_CM 1 100. 0. 2047. DISPLAY_IDENTIFIER TEG_CAT_DOWN_MDL_2 ECU_ADDRESS 0x3fd6ea BYTE_ORDER MSB_LAST FORMAT "%7.2" /end MEASUREMENT
/begin MEASUREMENT teg_cat_down_mdl_1 "exhaust gas temperature" UWORD _CNV_A_R_LINEAR_____6_CM 1 100. 0. 2047. DISPLAY_IDENTIFIER TEG_CAT_DOWN_MDL_1 ECU_ADDRESS 0x3fd6e6 BYTE_ORDER MSB_LAST FORMAT "%7.2" /end MEASUREMENT
/begin CHARACTERISTIC c_ti_min_thd "minimum threshold of the injection time limitation" VALUE 0xffe41a84 _REC_VAL_20_u2 262.14 _CNV_A_R_LINEAR_____165_CM 0. 262.14 DISPLAY_IDENTIFIER C_TI_MIN_THD FORMAT "%7.3" /end CHARACTERISTIC
/begin CHARACTERISTIC c_ti_min "minimum injection time limitation" VALUE 0xffe41a80 _REC_VAL_20_u2 262.14 _CNV_A_R_LINEAR_____165_CM 0. 262.14 DISPLAY_IDENTIFIER C_TI_MIN FORMAT "%7.3" /end CHARACTERISTIC
/begin CHARACTERISTIC ip_prs_inc_cmp "mean pressure increase in cylinder due to compression" MAP 0xffe4de06 _REC_MAP_20_u2_u2_u2 31.99951171875 _CNV_A_R_LINEAR_____426_CM 0. 31.99951171875 DISPLAY_IDENTIFIER IP_PRS_INC_CMP FORMAT "%7.4"
 /begin AXIS_DESCR COM_AXIS online_dummy _CNV_A_R_LINEAR_____82_CM 12 0. 720. FORMAT "%6.2" AXIS_PTS_REF ldp_eoi__prs_inc_cmp /end AXIS_DESCR
 /begin AXIS_DESCR COM_AXIS online_dummy _CNV_A_R_LINEAR_____82_CM 16 0. 600. FORMAT "%5.1" AXIS_PTS_REF ldp_crk_inj__prs_inc_cmp /end AXIS_DESCR
/end CHARACTERISTIC
/begin AXIS_PTS ldp_eoi__prs_inc_cmp "" 0xffe50b70 online_dummy _REC_AXS_20_u2 36. _CNV_A_R_LINEAR_____82_CM 12 0. 720. DISPLAY_IDENTIFIER LDP_EOI__PRS_INC_CMP FORMAT "%6.2" /end AXIS_PTS
/begin AXIS_PTS ldp_crk_inj__prs_inc_cmp "" 0xffe50ab2 online_dummy _REC_AXS_20_u2 30. _CNV_A_R_LINEAR_____82_CM 16 0. 600. DISPLAY_IDENTIFIER LDP_CRK_INJ__PRS_INC_CMP FORMAT "%5.1" /end AXIS_PTS
/begin CHARACTERISTIC ip_fac_ti_prs "Factor for correction of fuel injection due to pressure decrease at the injector" CURVE 0xffe4b71a _REC_CUR_20_u2_u2 31.99951171875 _CNV_A_R_LINEAR_____426_CM 0. 31.99951171875 DISPLAY_IDENTIFIER IP_FAC_TI_PRS FORMAT "%7.4"
 /begin AXIS_DESCR COM_AXIS fup _CNV_A_R_LINEAR_____199_CM 12 0. 173888. FORMAT "%6.0" AXIS_PTS_REF ldpm_prs_dec_inj__fac_ti_prs /end AXIS_DESCR
/end CHARACTERISTIC
/begin AXIS_PTS ldpm_prs_dec_inj__fac_ti_prs "" 0xffe51c9c fup _REC_AXS_20_u2 173888. _CNV_A_R_LINEAR_____199_CM 12 0. 173888. DISPLAY_IDENTIFIER LDPM_PRS_DEC_INJ__FAC_TI_PRS FORMAT "%6.0" /end AXIS_PTS
/begin MEASUREMENT ti_add[0] "Total additive correction value for cylinder balancing" SWORD _CNV_A_R_LINEAR_____165_CM 1 100. -131.072 131.068 DISPLAY_IDENTIFIER TI_ADD_0_ ECU_ADDRESS 0x3fd968 BYTE_ORDER MSB_LAST FORMAT "%8.3" /end MEASUREMENT
/begin MEASUREMENT ti_add[1] "Total additive correction value for cylinder balancing" SWORD _CNV_A_R_LINEAR_____165_CM 1 100. -131.072 131.068 DISPLAY_IDENTIFIER TI_ADD_1_ ECU_ADDRESS 0x3fd96a BYTE_ORDER MSB_LAST FORMAT "%8.3" /end MEASUREMENT
/begin MEASUREMENT ti_add[2] "Total additive correction value for cylinder balancing" SWORD _CNV_A_R_LINEAR_____165_CM 1 100. -131.072 131.068 DISPLAY_IDENTIFIER TI_ADD_2_ ECU_ADDRESS 0x3fd96c BYTE_ORDER MSB_LAST FORMAT "%8.3" /end MEASUREMENT
/begin MEASUREMENT ti_add[3] "Total additive correction value for cylinder balancing" SWORD _CNV_A_R_LINEAR_____165_CM 1 100. -131.072 131.068 DISPLAY_IDENTIFIER TI_ADD_3_ ECU_ADDRESS 0x3fd96e BYTE_ORDER MSB_LAST FORMAT "%8.3" /end MEASUREMENT
/begin MEASUREMENT ti_add[4] "Total additive correction value for cylinder balancing" SWORD _CNV_A_R_LINEAR_____165_CM 1 100. -131.072 131.068 DISPLAY_IDENTIFIER TI_ADD_4_ ECU_ADDRESS 0x3fd970 BYTE_ORDER MSB_LAST FORMAT "%8.3" /end MEASUREMENT
/begin MEASUREMENT ti_add[5] "Total additive correction value for cylinder balancing" SWORD _CNV_A_R_LINEAR_____165_CM 1 100. -131.072 131.068 DISPLAY_IDENTIFIER TI_ADD_5_ ECU_ADDRESS 0x3fd972 BYTE_ORDER MSB_LAST FORMAT "%8.3" /end MEASUREMENT
/begin MEASUREMENT lv_ad_er_bal_ena "Flag for adaptation via engine roughness is enabled" UBYTE _CNV_S_2_RANGE______2_CM 1 100. 0. 1. DISPLAY_IDENTIFIER LV_AD_ER_BAL_ENA ECU_ADDRESS 0x3fe8ad /end MEASUREMENT
/begin CHARACTERISTIC lc_ti_cor_er_bal_global "Flag for correction factors from \"Cyl. Balancing via ER\" applied in the whole engine map" VALUE 0xffe40fe3 _REC_VAL_20_u1 1. _CNV_A_R_LINEAR_____0_CM 0. 1. DISPLAY_IDENTIFIER LC_TI_COR_ER_BAL_GLOBAL FORMAT "%2.0" /end CHARACTERISTIC
/begin MEASUREMENT lv_ad_lam_bal_ena "Flag for adaptation via lambda sensor is enabled" UBYTE _CNV_S_2_RANGE______2_CM 1 100. 0. 1. DISPLAY_IDENTIFIER LV_AD_LAM_BAL_ENA ECU_ADDRESS 0x3fe8ae /end MEASUREMENT
/begin MEASUREMENT ti_fac[0] "Total multiplicative correction value for cylinder balancing" UWORD _CNV_A_R_LINEAR_____20_CM 1 100. 0. 1.99996948 DISPLAY_IDENTIFIER TI_FAC_0 ECU_ADDRESS 0x3fd95c BYTE_ORDER MSB_LAST FORMAT "%7.5" /end MEASUREMENT
/begin MEASUREMENT ti_fac[1] "Total multiplicative correction value for cylinder balancing" UWORD _CNV_A_R_LINEAR_____20_CM 1 100. 0. 1.99996948 DISPLAY_IDENTIFIER TI_FAC_1 ECU_ADDRESS 0x3fd95e BYTE_ORDER MSB_LAST FORMAT "%7.5" /end MEASUREMENT
/begin MEASUREMENT ti_fac[2] "Total multiplicative correction value for cylinder balancing" UWORD _CNV_A_R_LINEAR_____20_CM 1 100. 0. 1.99996948 DISPLAY_IDENTIFIER TI_FAC_2 ECU_ADDRESS 0x3fd960 BYTE_ORDER MSB_LAST FORMAT "%7.5" /end MEASUREMENT
/begin MEASUREMENT ti_fac[3] "Total multiplicative correction value for cylinder balancing" UWORD _CNV_A_R_LINEAR_____20_CM 1 100. 0. 1.99996948 DISPLAY_IDENTIFIER TI_FAC_3 ECU_ADDRESS 0x3fd962 BYTE_ORDER MSB_LAST FORMAT "%7.5" /end MEASUREMENT
/begin MEASUREMENT ti_fac[4] "Total multiplicative correction value for cylinder balancing" UWORD _CNV_A_R_LINEAR_____20_CM 1 100. 0. 1.99996948 DISPLAY_IDENTIFIER TI_FAC_4 ECU_ADDRESS 0x3fd964 BYTE_ORDER MSB_LAST FORMAT "%7.5" /end MEASUREMENT
/begin MEASUREMENT ti_fac[5] "Total multiplicative correction value for cylinder balancing" UWORD _CNV_A_R_LINEAR_____20_CM 1 100. 0. 1.99996948 DISPLAY_IDENTIFIER TI_FAC_5 ECU_ADDRESS 0x3fd966 BYTE_ORDER MSB_LAST FORMAT "%7.5" /end MEASUREMENT
/begin MEASUREMENT add_ad_er_bal_1[0] "Additive correction value for cylinder balancing via ER, logical Cyl. 0" SWORD _CNV_A_R_LINEAR_____165_CM 1 100. -131.072 131.068 DISPLAY_IDENTIFIER ADD_AD_ER_BAL_1_0 ECU_ADDRESS 0x3fd974 BYTE_ORDER MSB_LAST FORMAT "%8.3" /end MEASUREMENT
/begin MEASUREMENT fac_ad_er_bal_1[0] "Multiplicative correction value for cylinder balancing via ER, logical Cyl. 0" SWORD _CNV_A_R_LINEAR_____281_CM 1 100. -1. 0.99996948 DISPLAY_IDENTIFIER FAC_AD_ER_BAL_1_0 ECU_ADDRESS 0x3fd980 BYTE_ORDER MSB_LAST FORMAT "%8.5" /end MEASUREMENT
/begin MEASUREMENT lv_st_h_prs "Logical variable indicating high pressure start active" UBYTE _CNV_S_2_RANGE______21_CM 1 100. 0. 1. DISPLAY_IDENTIFIER LV_ST_H_PRS ECU_ADDRESS 0x3fe8b3 BIT_MASK 0x1 /end MEASUREMENT
/begin MEASUREMENT mff_cst "Basic injection at start (LV_ST)" UWORD _CNV_A_R_LINEAR_____108_CM 1 100. 0. 1389. DISPLAY_IDENTIFIER MFF_CST ECU_ADDRESS 0x3fd9ae BYTE_ORDER MSB_LAST FORMAT "%7.2" /end MEASUREMENT
/begin CHARACTERISTIC c_cyc_cast_h_prs "Cycle counter break off threshold to switch over to \"low pressure start\"" VALUE 0xffe415a0 _REC_VAL_20_u2 65535. _CNV_A_R_LINEAR_____0_CM 0. 65535. DISPLAY_IDENTIFIER C_CYC_CAST_H_PRS FORMAT "%5.0" /end CHARACTERISTIC
/begin CHARACTERISTIC ip_mff_cst "Basic value for cranking injection" MAP 0xffe4d42a _REC_MAP_20_u2_u2_u1 1389. _CNV_A_R_LINEAR_____108_CM 0. 1389. DISPLAY_IDENTIFIER IP_MFF_CST FORMAT "%7.2"
 /begin AXIS_DESCR COM_AXIS n_tooth _CNV_A_R_LINEAR_____10_CM 3 0. 8160. FORMAT "%4.0" AXIS_PTS_REF ldp_n_tooth__mff_cst /end AXIS_DESCR
 /begin AXIS_DESCR COM_AXIS tco _CNV_A_R_LINEAR_____11_CM 8 -48. 142.5 FORMAT "%5.1" AXIS_PTS_REF ldpm_tco__mff_cst /end AXIS_DESCR
/end CHARACTERISTIC
/begin CHARACTERISTIC ip_mff_deac_cst "Cranking injection time deactivation factor" MAP 0xffe46cca _REC_MAP_20_u1_u1_u1 0.1494141 _CNV_A_R_LINEAR_____50_CM 0. 0.996094 DISPLAY_IDENTIFIER IP_MFF_DEAC_CST FORMAT "%5.3"
 /begin AXIS_DESCR COM_AXIS NO_INPUT_QUANTITY _CNV_A_R_LINEAR_____0_CM 4 0. 255. FORMAT "%3.0" AXIS_PTS_REF ldp_cyc__mff_cst /end AXIS_DESCR
 /begin AXIS_DESCR COM_AXIS tco _CNV_A_R_LINEAR_____11_CM 8 -48. 142.5 FORMAT "%5.1" AXIS_PTS_REF ldpm_tco__mff_cst /end AXIS_DESCR
/end CHARACTERISTIC
/begin CHARACTERISTIC ip_fup_min_inj_st "Fuel pressure threshold to reach before injection is started" CURVE 0xffe40c75 _REC_CUR_20_u1_u1 173888. _CNV_A_R_LINEAR_____492_CM 0. 173888. DISPLAY_IDENTIFIER IP_FUP_MIN_INJ_ST FORMAT "%6.0"
 /begin AXIS_DESCR COM_AXIS tco _CNV_A_R_LINEAR_____11_CM 8 -48. 142.5 FORMAT "%5.1" AXIS_PTS_REF ldpm_tco__mff_cst /end AXIS_DESCR
/end CHARACTERISTIC
/begin MEASUREMENT lv_mff_cst_fup_act "Logical variable indicating fuel pressure has reached threshold once" UBYTE _CNV_S_2_RANGE______21_CM 1 100. 0. 1. DISPLAY_IDENTIFIER LV_MFF_CST_FUP_ACT ECU_ADDRESS 0x3fe8b4 BIT_MASK 0x1 /end MEASUREMENT
/begin MEASUREMENT cyc_cast_fup_thd "cycle counter value when high pressure injection starts" UWORD _CNV_A_R_LINEAR_____0_CM 1 100. 0. 65535. DISPLAY_IDENTIFIER CYC_CAST_FUP_THD ECU_ADDRESS 0x3fd9b2 BYTE_ORDER MSB_LAST FORMAT "%5.0" /end MEASUREMENT
/begin CHARACTERISTIC c_tco_st_h_prs "Coolant temp. threshold to select high or low pressure start " VALUE 0xffe40929 _REC_VAL_20_u1 190.5 _CNV_A_R_LINEAR_____11_CM -48. 142.5 DISPLAY_IDENTIFIER C_TCO_ST_H_PRS FORMAT "%5.1" /end CHARACTERISTIC
/begin AXIS_PTS ldp_cyc__mff_cst "" 0xffe41010 NO_INPUT_QUANTITY _REC_AXS_20_u1 255. _CNV_A_R_LINEAR_____0_CM 4 0. 255. DISPLAY_IDENTIFIER LDP_CYC__MFF_CST FORMAT "%3.0" /end AXIS_PTS
/begin AXIS_PTS ldp_n_tooth__mff_cst "" 0xffe41d0e n_tooth _REC_AXS_20_u2 816. _CNV_A_R_LINEAR_____10_CM 3 0. 8160. DISPLAY_IDENTIFIER LDP_N_TOOTH__MFF_CST FORMAT "%4.0" /end AXIS_PTS
/begin AXIS_PTS ldpm_tco__mff_cst "" 0xffe4863f tco _REC_AXS_20_u1 19.05 _CNV_A_R_LINEAR_____11_CM 8 -48. 142.5 DISPLAY_IDENTIFIER LDPM_TCO__MFF_CST FORMAT "%5.1" /end AXIS_PTS
/begin CHARACTERISTIC c_fac_mff_ti_stnd_2 "Injectionvalve characteristic for fuel mass flow to injection time at standard conditions" VALUE 0xffe4161a _REC_VAL_20_u2 0.37745 _CNV_A_R_LINEAR_____493_CM 0. 0.37745 DISPLAY_IDENTIFIER C_FAC_MFF_TI_STND_2 FORMAT "%7.5" /end CHARACTERISTIC
/begin CHARACTERISTIC id_fac_tipr_deac "Pre injection time deactivation factor" CURVE 0xffe40a3f _REC_CUR_20_u1_u1 1.99220002 _CNV_A_R_LINEAR_____39_CM 0. 1.99220002 DISPLAY_IDENTIFIER ID_FAC_TIPR_DEAC FORMAT "%5.3"
 /begin AXIS_DESCR COM_AXIS cycnr_cst _CNV_A_R_LINEAR_____0_CM 6 0. 7. FORMAT "%2.0" AXIS_PTS_REF ldp_cycnr_cst__fac_tipr_deac /end AXIS_DESCR
/end CHARACTERISTIC
/begin MEASUREMENT bios_tipr_bas[0] "injection time preinjection" UWORD _CNV_A_R_LINEAR_____165_CM 1 100. 0. 262.14 DISPLAY_IDENTIFIER BIOS_TIPR_BAS_0 ECU_ADDRESS 0x3fd9fa BYTE_ORDER MSB_LAST FORMAT "%7.3" /end MEASUREMENT
/begin MEASUREMENT bios_tipr_bas[1] "injection time preinjection" UWORD _CNV_A_R_LINEAR_____165_CM 1 100. 0. 262.14 DISPLAY_IDENTIFIER BIOS_TIPR_BAS_1 ECU_ADDRESS 0x3fd9fc BYTE_ORDER MSB_LAST FORMAT "%7.3" /end MEASUREMENT
/begin MEASUREMENT bios_tipr_bas[2] "injection time preinjection" UWORD _CNV_A_R_LINEAR_____165_CM 1 100. 0. 262.14 DISPLAY_IDENTIFIER BIOS_TIPR_BAS_2 ECU_ADDRESS 0x3fd9fe BYTE_ORDER MSB_LAST FORMAT "%7.3" /end MEASUREMENT
/begin MEASUREMENT bios_tipr_bas[3] "injection time preinjection" UWORD _CNV_A_R_LINEAR_____165_CM 1 100. 0. 262.14 DISPLAY_IDENTIFIER BIOS_TIPR_BAS_3 ECU_ADDRESS 0x3fda00 BYTE_ORDER MSB_LAST FORMAT "%7.3" /end MEASUREMENT
/begin MEASUREMENT bios_tipr_bas[4] "injection time preinjection" UWORD _CNV_A_R_LINEAR_____165_CM 1 100. 0. 262.14 DISPLAY_IDENTIFIER BIOS_TIPR_BAS_4 ECU_ADDRESS 0x3fda02 BYTE_ORDER MSB_LAST FORMAT "%7.3" /end MEASUREMENT
/begin MEASUREMENT bios_tipr_bas[5] "injection time preinjection" UWORD _CNV_A_R_LINEAR_____165_CM 1 100. 0. 262.14 DISPLAY_IDENTIFIER BIOS_TIPR_BAS_5 ECU_ADDRESS 0x3fda04 BYTE_ORDER MSB_LAST FORMAT "%7.3" /end MEASUREMENT
/begin MEASUREMENT bios_eoi_min_tipr "Latest permitted predicted end of injection for pre-injection" UWORD _CNV_A_R_LINEAR_____82_CM 1 100. 0. 720. DISPLAY_IDENTIFIER BIOS_EOI_MIN_TIPR ECU_ADDRESS 0x3fd9f4 BYTE_ORDER MSB_LAST FORMAT "%6.2" /end MEASUREMENT
/begin MEASUREMENT bios_nr_max_tooth_tipr "Maximum tooth number till preliminary synchronisation for preinjection" UBYTE _CNV_A_R_LINEAR_____0_CM 1 100. 1. 64. DISPLAY_IDENTIFIER BIOS_NR_MAX_TOOTH_TIPR ECU_ADDRESS 0x3fe8b8 FORMAT "%3.0" /end MEASUREMENT
/begin MEASUREMENT cycnr_cst "Pre injection counter" UBYTE _CNV_A_R_LINEAR_____0_CM 1 100. 0. 7. DISPLAY_IDENTIFIER CYCNR_CST ECU_ADDRESS 0x3fe8b9 FORMAT "%2.0" /end MEASUREMENT
/begin MEASUREMENT tipr[0] "Pre-injection time" UWORD _CNV_A_R_LINEAR_____165_CM 1 100. 0. 262.14 DISPLAY_IDENTIFIER TIPR_0 ECU_ADDRESS 0x3fda06 BYTE_ORDER MSB_LAST FORMAT "%7.3" /end MEASUREMENT
/begin MEASUREMENT tipr[1] "Pre-injection time" UWORD _CNV_A_R_LINEAR_____165_CM 1 100. 0. 262.14 DISPLAY_IDENTIFIER TIPR_1 ECU_ADDRESS 0x3fda08 BYTE_ORDER MSB_LAST FORMAT "%7.3" /end MEASUREMENT
/begin MEASUREMENT tipr[2] "Pre-injection time" UWORD _CNV_A_R_LINEAR_____165_CM 1 100. 0. 262.14 DISPLAY_IDENTIFIER TIPR_2 ECU_ADDRESS 0x3fda0a BYTE_ORDER MSB_LAST FORMAT "%7.3" /end MEASUREMENT
/begin MEASUREMENT tipr[3] "Pre-injection time" UWORD _CNV_A_R_LINEAR_____165_CM 1 100. 0. 262.14 DISPLAY_IDENTIFIER TIPR_3 ECU_ADDRESS 0x3fda0c BYTE_ORDER MSB_LAST FORMAT "%7.3" /end MEASUREMENT
/begin MEASUREMENT tipr[4] "Pre-injection time" UWORD _CNV_A_R_LINEAR_____165_CM 1 100. 0. 262.14 DISPLAY_IDENTIFIER TIPR_4 ECU_ADDRESS 0x3fda0e BYTE_ORDER MSB_LAST FORMAT "%7.3" /end MEASUREMENT
/begin MEASUREMENT tipr[5] "Pre-injection time" UWORD _CNV_A_R_LINEAR_____165_CM 1 100. 0. 262.14 DISPLAY_IDENTIFIER TIPR_5 ECU_ADDRESS 0x3fda10 BYTE_ORDER MSB_LAST FORMAT "%7.3" /end MEASUREMENT
/begin MEASUREMENT mffpr "Calculated mass fuel flow setpoint for pre injection" UWORD _CNV_A_R_LINEAR_____108_CM 1 100. 0. 1389. DISPLAY_IDENTIFIER MFFPR ECU_ADDRESS 0x3fd9f8 BYTE_ORDER MSB_LAST FORMAT "%7.2" /end MEASUREMENT
/begin MEASUREMENT mffpr_cst "Basic value of pre-injection at LV_ES" UWORD _CNV_A_R_LINEAR_____108_CM 1 100. 0. 1389. DISPLAY_IDENTIFIER MFFPR_CST ECU_ADDRESS 0x3fd9f6 BYTE_ORDER MSB_LAST FORMAT "%7.2" /end MEASUREMENT
/begin CHARACTERISTIC ip_mffpr_cst "Pre-injection basic value" CURVE 0xffe4d5ea _REC_CUR_20_u2_u1 1389. _CNV_A_R_LINEAR_____108_CM 0. 1389. DISPLAY_IDENTIFIER IP_MFFPR_CST FORMAT "%7.2"
 /begin AXIS_DESCR COM_AXIS tco _CNV_A_R_LINEAR_____11_CM 8 -48. 142.5 FORMAT "%5.1" AXIS_PTS_REF ldp_tco__mffpr_cst /end AXIS_DESCR
/end CHARACTERISTIC
/begin CHARACTERISTIC ip_mffpr_fac_st_es "Pre-injection basic value correction in case of previous transition ST --> ES" CURVE 0xffe40d20 _REC_CUR_20_u1_u1 0.99610001 _CNV_A_R_LINEAR_____29_CM 0. 0.99610001 DISPLAY_IDENTIFIER IP_MFFPR_FAC_ST_ES FORMAT "%5.3"
 /begin AXIS_DESCR COM_AXIS tco _CNV_A_R_LINEAR_____11_CM 8 -48. 142.5 FORMAT "%5.1" AXIS_PTS_REF ldp_tco__mffpr_fac_st_es /end AXIS_DESCR
/end CHARACTERISTIC
/begin AXIS_PTS ldp_cycnr_cst__fac_tipr_deac "" 0xffe4101c cycnr_cst _REC_AXS_20_u1 7. _CNV_A_R_LINEAR_____0_CM 6 0. 7. DISPLAY_IDENTIFIER LDP_CYCNR_CST__FAC_TIPR_DEAC FORMAT "%2.0" /end AXIS_PTS
/begin AXIS_PTS ldp_tco__mffpr_cst "" 0xffe481e6 tco _REC_AXS_20_u1 190.5 _CNV_A_R_LINEAR_____11_CM 8 -48. 142.5 DISPLAY_IDENTIFIER LDP_TCO__MFFPR_CST FORMAT "%5.1" /end AXIS_PTS
/begin AXIS_PTS ldp_tco__mffpr_fac_st_es "" 0xffe481ef tco _REC_AXS_20_u1 190.5 _CNV_A_R_LINEAR_____11_CM 8 -48. 142.5 DISPLAY_IDENTIFIER LDP_TCO__MFFPR_FAC_ST_ES FORMAT "%5.1" /end AXIS_PTS
/begin MEASUREMENT ti_st_rest "Cold start reduction factor in case of re-start detected" UBYTE _CNV_A_R_LINEAR_____50_CM 1 100. 0. 0.996094 DISPLAY_IDENTIFIER TI_ST_REST ECU_ADDRESS 0x3fe8ba FORMAT "%5.3" /end MEASUREMENT
/begin CHARACTERISTIC ip_ti_st_rest "Cold start reduction factor in case of re-start with no engine stop time T_ES available" CURVE 0xffe40e8d _REC_CUR_20_u1_u1 0.199220002 _CNV_A_R_LINEAR_____29_CM 0. 0.99610001 DISPLAY_IDENTIFIER IP_TI_ST_REST FORMAT "%5.3"
 /begin AXIS_DESCR COM_AXIS tco _CNV_A_R_LINEAR_____11_CM 8 -48. 142.5 FORMAT "%5.1" AXIS_PTS_REF ldpm_tco__ti_st_rest /end AXIS_DESCR
/end CHARACTERISTIC
/begin CHARACTERISTIC ip_rest "Considering the shut-off time for re-start calculation" CURVE 0xffe40dda _REC_CUR_20_u1_u2 0.199220002 _CNV_A_R_LINEAR_____29_CM 0. 0.99610001 DISPLAY_IDENTIFIER IP_REST FORMAT "%5.3"
 /begin AXIS_DESCR COM_AXIS t_es _CNV_A_R_LINEAR_____97_CM 8 0. 65535. FORMAT "%5.0" AXIS_PTS_REF ldp_t_es__rest /end AXIS_DESCR
/end CHARACTERISTIC
/begin CHARACTERISTIC ip_fac_rest "Considering coolant stop temperature and after start time for re-start calculation" MAP 0xffe456aa _REC_MAP_20_u1_u2_u1 0.199220002 _CNV_A_R_LINEAR_____29_CM 0. 0.99610001 DISPLAY_IDENTIFIER IP_FAC_REST FORMAT "%5.3"
 /begin AXIS_DESCR COM_AXIS t_ast_rest _CNV_A_R_LINEAR_____24_CM 8 0. 6553.5 FORMAT "%6.1" AXIS_PTS_REF ldp_t_ast_rest /end AXIS_DESCR
 /begin AXIS_DESCR COM_AXIS tco_stop _CNV_A_R_LINEAR_____11_CM 8 -48. 142.5 FORMAT "%5.1" AXIS_PTS_REF ldp_tco_stop__fac_rest /end AXIS_DESCR
/end CHARACTERISTIC
/begin CHARACTERISTIC ip_fac_stall "Special cold start reduction factor in case of re-start after engine stall out" CURVE 0xffe40be1 _REC_CUR_20_u1_u1 0.199220002 _CNV_A_R_LINEAR_____29_CM 0. 0.99610001 DISPLAY_IDENTIFIER IP_FAC_STALL FORMAT "%5.3"
 /begin AXIS_DESCR COM_AXIS tco _CNV_A_R_LINEAR_____11_CM 8 -48. 142.5 FORMAT "%5.1" AXIS_PTS_REF ldpm_tco__fac_stall /end AXIS_DESCR
/end CHARACTERISTIC
/begin AXIS_PTS ldpm_tco__ti_st_rest "" 0xffe4865c tco _REC_AXS_20_u1 28.575 _CNV_A_R_LINEAR_____11_CM 8 -48. 142.5 DISPLAY_IDENTIFIER LDPM_TCO__TI_ST_REST FORMAT "%5.1" /end AXIS_PTS
/begin AXIS_PTS ldp_tco_stop__fac_rest "" 0xffe4828a tco_stop _REC_AXS_20_u1 28.575 _CNV_A_R_LINEAR_____11_CM 8 -48. 142.5 DISPLAY_IDENTIFIER LDP_TCO_STOP__FAC_REST FORMAT "%5.1" /end AXIS_PTS
/begin AXIS_PTS ldpm_tco__fac_stall "" 0xffe48636 tco _REC_AXS_20_u1 28.575 _CNV_A_R_LINEAR_____11_CM 8 -48. 142.5 DISPLAY_IDENTIFIER LDPM_TCO__FAC_STALL FORMAT "%5.1" /end AXIS_PTS
/begin AXIS_PTS ldp_t_es__rest "" 0xffe512dc t_es _REC_AXS_20_u2 9830.25 _CNV_A_R_LINEAR_____97_CM 8 0. 65535. DISPLAY_IDENTIFIER LDP_T_ES__REST FORMAT "%5.0" /end AXIS_PTS
/begin AXIS_PTS ldp_t_ast_rest "" 0xffe512bc t_ast_rest _REC_AXS_20_u2 983.025 _CNV_A_R_LINEAR_____24_CM 8 0. 6553.5 DISPLAY_IDENTIFIER LDP_T_AST_REST FORMAT "%6.1" /end AXIS_PTS
/begin MEASUREMENT lv_bal_ena "Flag for application of the correction factors for cylinder balancing are enabled" UBYTE _CNV_S_2_RANGE______2_CM 1 100. 0. 1. DISPLAY_IDENTIFIER LV_BAL_ENA ECU_ADDRESS 0x3fe898 /end MEASUREMENT
/begin MEASUREMENT mff_add_reac_cyl[0] "Reactivation enrichment" UWORD _CNV_A_R_LINEAR_____108_CM 1 100. 0. 1389. DISPLAY_IDENTIFIER MFF_ADD_REAC_CYL_0 ECU_ADDRESS 0x3fd94c BYTE_ORDER MSB_LAST FORMAT "%7.2" /end MEASUREMENT
/begin MEASUREMENT mff_add_reac_cyl[1] "Reactivation enrichment" UWORD _CNV_A_R_LINEAR_____108_CM 1 100. 0. 1389. DISPLAY_IDENTIFIER MFF_ADD_REAC_CYL_1 ECU_ADDRESS 0x3fd94e BYTE_ORDER MSB_LAST FORMAT "%7.2" /end MEASUREMENT
/begin MEASUREMENT mff_add_reac_cyl[2] "Reactivation enrichment" UWORD _CNV_A_R_LINEAR_____108_CM 1 100. 0. 1389. DISPLAY_IDENTIFIER MFF_ADD_REAC_CYL_2 ECU_ADDRESS 0x3fd950 BYTE_ORDER MSB_LAST FORMAT "%7.2" /end MEASUREMENT
/begin MEASUREMENT mff_add_reac_cyl[3] "Reactivation enrichment" UWORD _CNV_A_R_LINEAR_____108_CM 1 100. 0. 1389. DISPLAY_IDENTIFIER MFF_ADD_REAC_CYL_3 ECU_ADDRESS 0x3fd952 BYTE_ORDER MSB_LAST FORMAT "%7.2" /end MEASUREMENT
/begin MEASUREMENT mff_add_reac_cyl[4] "Reactivation enrichment" UWORD _CNV_A_R_LINEAR_____108_CM 1 100. 0. 1389. DISPLAY_IDENTIFIER MFF_ADD_REAC_CYL_4 ECU_ADDRESS 0x3fd954 BYTE_ORDER MSB_LAST FORMAT "%7.2" /end MEASUREMENT
/begin MEASUREMENT mff_add_reac_cyl[5] "Reactivation enrichment" UWORD _CNV_A_R_LINEAR_____108_CM 1 100. 0. 1389. DISPLAY_IDENTIFIER MFF_ADD_REAC_CYL_5 ECU_ADDRESS 0x3fd956 BYTE_ORDER MSB_LAST FORMAT "%7.2" /end MEASUREMENT
/begin MEASUREMENT mff_dif_wf[0] "wall film degradation" SLONG _CNV_A_R_LINEAR_____108_CM 1 100. -1389. 0. DISPLAY_IDENTIFIER MFF_DIF_WF_0 ECU_ADDRESS 0x3fcf88 BYTE_ORDER MSB_LAST FORMAT "%9.2" /end MEASUREMENT
/begin MEASUREMENT mff_dif_wf[1] "wall film degradation" SLONG _CNV_A_R_LINEAR_____108_CM 1 100. -1389. 0. DISPLAY_IDENTIFIER MFF_DIF_WF_1 ECU_ADDRESS 0x3fcf8c BYTE_ORDER MSB_LAST FORMAT "%9.2" /end MEASUREMENT
/begin MEASUREMENT mff_dif_wf[2] "wall film degradation" SLONG _CNV_A_R_LINEAR_____108_CM 1 100. -1389. 0. DISPLAY_IDENTIFIER MFF_DIF_WF_2 ECU_ADDRESS 0x3fcf90 BYTE_ORDER MSB_LAST FORMAT "%9.2" /end MEASUREMENT
/begin MEASUREMENT mff_dif_wf[3] "wall film degradation" SLONG _CNV_A_R_LINEAR_____108_CM 1 100. -1389. 0. DISPLAY_IDENTIFIER MFF_DIF_WF_3 ECU_ADDRESS 0x3fcf94 BYTE_ORDER MSB_LAST FORMAT "%9.2" /end MEASUREMENT
/begin MEASUREMENT mff_dif_wf[4] "wall film degradation" SLONG _CNV_A_R_LINEAR_____108_CM 1 100. -1389. 0. DISPLAY_IDENTIFIER MFF_DIF_WF_4 ECU_ADDRESS 0x3fcf98 BYTE_ORDER MSB_LAST FORMAT "%9.2" /end MEASUREMENT
/begin MEASUREMENT mff_dif_wf[5] "wall film degradation" SLONG _CNV_A_R_LINEAR_____108_CM 1 100. -1389. 0. DISPLAY_IDENTIFIER MFF_DIF_WF_5 ECU_ADDRESS 0x3fcf9c BYTE_ORDER MSB_LAST FORMAT "%9.2" /end MEASUREMENT
/begin MEASUREMENT fac_ti_reac[0] "Value of Table ID_FAC_TI_RIS__CYCNR" UBYTE _CNV_A_R_LINEAR_____39_CM 1 100. 0. 1.99220002 DISPLAY_IDENTIFIER FAC_TI_REAC_0 ECU_ADDRESS 0x3fe8a0 FORMAT "%5.3" /end MEASUREMENT
/begin MEASUREMENT fac_ti_reac[1] "Value of Table ID_FAC_TI_RIS__CYCNR" UBYTE _CNV_A_R_LINEAR_____39_CM 1 100. 0. 1.99220002 DISPLAY_IDENTIFIER FAC_TI_REAC_1 ECU_ADDRESS 0x3fe8a1 FORMAT "%5.3" /end MEASUREMENT
/begin MEASUREMENT fac_ti_reac[2] "Value of Table ID_FAC_TI_RIS__CYCNR" UBYTE _CNV_A_R_LINEAR_____39_CM 1 100. 0. 1.99220002 DISPLAY_IDENTIFIER FAC_TI_REAC_2 ECU_ADDRESS 0x3fe8a2 FORMAT "%5.3" /end MEASUREMENT
/begin MEASUREMENT fac_ti_reac[3] "Value of Table ID_FAC_TI_RIS__CYCNR" UBYTE _CNV_A_R_LINEAR_____39_CM 1 100. 0. 1.99220002 DISPLAY_IDENTIFIER FAC_TI_REAC_3 ECU_ADDRESS 0x3fe8a3 FORMAT "%5.3" /end MEASUREMENT
/begin MEASUREMENT fac_ti_reac[4] "Value of Table ID_FAC_TI_RIS__CYCNR" UBYTE _CNV_A_R_LINEAR_____39_CM 1 100. 0. 1.99220002 DISPLAY_IDENTIFIER FAC_TI_REAC_4 ECU_ADDRESS 0x3fe8a4 FORMAT "%5.3" /end MEASUREMENT
/begin MEASUREMENT fac_ti_reac[5] "Value of Table ID_FAC_TI_RIS__CYCNR" UBYTE _CNV_A_R_LINEAR_____39_CM 1 100. 0. 1.99220002 DISPLAY_IDENTIFIER FAC_TI_REAC_5 ECU_ADDRESS 0x3fe8a5 FORMAT "%5.3" /end MEASUREMENT
/begin CHARACTERISTIC id_fac_mff_tco_neg_wf "Wall film factor, begin of fuel cutoff" CURVE 0xffe40a2f _REC_CUR_20_u1_u1 0.4980468800000001 _CNV_A_R_LINEAR_____498_CM 0. 0.49804688 DISPLAY_IDENTIFIER ID_FAC_MFF_TCO_NEG_WF FORMAT "%5.3"
 /begin AXIS_DESCR COM_AXIS tco _CNV_A_R_LINEAR_____11_CM 8 -48. 142.5 FORMAT "%5.1" AXIS_PTS_REF ldpm_tco__reac /end AXIS_DESCR
/end CHARACTERISTIC
/begin CHARACTERISTIC id_fac_mff_tco_pos_wf "Wall film factor, begin of fuel cutoff" CURVE 0xffe40a37 _REC_CUR_20_u1_u1 0.4980468800000001 _CNV_A_R_LINEAR_____498_CM 0. 0.49804688 DISPLAY_IDENTIFIER ID_FAC_MFF_TCO_POS_WF FORMAT "%5.3"
 /begin AXIS_DESCR COM_AXIS tco _CNV_A_R_LINEAR_____11_CM 8 -48. 142.5 FORMAT "%5.1" AXIS_PTS_REF ldpm_tco__reac /end AXIS_DESCR
/end CHARACTERISTIC
/begin CHARACTERISTIC ip_fac_mff_map_wf "MAP dependant factor" CURVE 0xffe40bb5 _REC_CUR_20_u1_u2 0.99610001 _CNV_A_R_LINEAR_____29_CM 0. 0.99610001 DISPLAY_IDENTIFIER IP_FAC_MFF_MAP_WF FORMAT "%5.3"
 /begin AXIS_DESCR COM_AXIS map _CNV_A_R_LINEAR_____49_CM 4 0. 5434. FORMAT "%7.2" AXIS_PTS_REF ldp_map__fac_mff_map_wf /end AXIS_DESCR
/end CHARACTERISTIC
/begin CHARACTERISTIC id_fac_ti_ris "Reactivation correction, soft reactivation" CURVE 0xffe440a7 _REC_CUR_20_u1_u1 1.99220002 _CNV_A_R_LINEAR_____39_CM 0. 1.99220002 DISPLAY_IDENTIFIER ID_FAC_TI_RIS FORMAT "%5.3"
 /begin AXIS_DESCR COM_AXIS online_dummy _CNV_A_R_LINEAR_____0_CM 16 1. 16. FORMAT "%2.0" AXIS_PTS_REF ldpm_cycnr_reac__reac /end AXIS_DESCR
/end CHARACTERISTIC
/begin CHARACTERISTIC id_fac_ti_rpl "Reactivation correction, hard reactivation" CURVE 0xffe440b7 _REC_CUR_20_u1_u1 1.99220002 _CNV_A_R_LINEAR_____39_CM 0. 1.99220002 DISPLAY_IDENTIFIER ID_FAC_TI_RPL FORMAT "%5.3"
 /begin AXIS_DESCR COM_AXIS online_dummy _CNV_A_R_LINEAR_____0_CM 16 1. 16. FORMAT "%2.0" AXIS_PTS_REF ldpm_cycnr_reac__reac /end AXIS_DESCR
/end CHARACTERISTIC
/begin CHARACTERISTIC id_mff_inc_wf "Wall-film degradation" CURVE 0xffe48a68 _REC_CUR_20_u2_u1 1389. _CNV_A_R_LINEAR_____108_CM 0. 1389. DISPLAY_IDENTIFIER ID_MFF_INC_WF FORMAT "%7.2"
 /begin AXIS_DESCR COM_AXIS n_32 _CNV_A_R_LINEAR_____15_CM 8 0. 8160. FORMAT "%4.0" AXIS_PTS_REF ldpm_n_32__reac /end AXIS_DESCR
/end CHARACTERISTIC
/begin CHARACTERISTIC id_mff_dec_wf "Wall-film build-up" CURVE 0xffe48a58 _REC_CUR_20_u2_u1 1389. _CNV_A_R_LINEAR_____108_CM 0. 1389. DISPLAY_IDENTIFIER ID_MFF_DEC_WF FORMAT "%7.2"
 /begin AXIS_DESCR COM_AXIS n_32 _CNV_A_R_LINEAR_____15_CM 8 0. 8160. FORMAT "%4.0" AXIS_PTS_REF ldpm_n_32__reac /end AXIS_DESCR
/end CHARACTERISTIC
/begin AXIS_PTS ldpm_tco__reac "" 0xffe48653 tco _REC_AXS_20_u1 190.5 _CNV_A_R_LINEAR_____11_CM 8 -48. 142.5 DISPLAY_IDENTIFIER LDPM_TCO__REAC FORMAT "%5.1" /end AXIS_PTS
/begin AXIS_PTS ldp_map__fac_mff_map_wf "" 0xffe50ed6 map _REC_AXS_20_u2 5434. _CNV_A_R_LINEAR_____49_CM 4 0. 5434. DISPLAY_IDENTIFIER LDP_MAP__FAC_MFF_MAP_WF FORMAT "%7.2" /end AXIS_PTS
/begin AXIS_PTS ldpm_n_32__reac "" 0xffe484ec n_32 _REC_AXS_20_u1 8160. _CNV_A_R_LINEAR_____15_CM 8 0. 8160. DISPLAY_IDENTIFIER LDPM_N_32__REAC FORMAT "%4.0" /end AXIS_PTS
/begin AXIS_PTS ldpm_cycnr_reac__reac "" 0xffe48359 online_dummy _REC_AXS_20_u1 15. _CNV_A_R_LINEAR_____0_CM 16 1. 16. DISPLAY_IDENTIFIER LDPM_CYCNR_REAC__REAC FORMAT "%2.0" /end AXIS_PTS
/begin CHARACTERISTIC id_tco_lam_min_is__tco_st "minimum TCO for the calculation of  TI_LAM_FAC during idle speed" CURVE 0xffe40a9b _REC_CUR_20_u1_u1 190.5 _CNV_A_R_LINEAR_____11_CM -48. 142.5 DISPLAY_IDENTIFIER ID_TCO_LAM_MIN_IS__TCO_ST FORMAT "%5.1"
 /begin AXIS_DESCR COM_AXIS tco_st _CNV_A_R_LINEAR_____11_CM 6 -48. 142.5 FORMAT "%5.1" AXIS_PTS_REF ldpm_tco_st_tco_lam_min /end AXIS_DESCR
/end CHARACTERISTIC
/begin CHARACTERISTIC id_tco_lam_min__tco_st "minimum TCO for the calculation of TI_LAM_FAC" CURVE 0xffe40a95 _REC_CUR_20_u1_u1 190.5 _CNV_A_R_LINEAR_____11_CM -48. 142.5 DISPLAY_IDENTIFIER ID_TCO_LAM_MIN__TCO_ST FORMAT "%5.1"
 /begin AXIS_DESCR COM_AXIS tco_st _CNV_A_R_LINEAR_____11_CM 6 -48. 142.5 FORMAT "%5.1" AXIS_PTS_REF ldpm_tco_st_tco_lam_min /end AXIS_DESCR
/end CHARACTERISTIC
/begin AXIS_PTS ldpm_tco_st_tco_lam_min "" 0xffe41465 tco_st _REC_AXS_20_u1 190.5 _CNV_A_R_LINEAR_____11_CM 6 -48. 142.5 DISPLAY_IDENTIFIER LDPM_TCO_ST_TCO_LAM_MIN FORMAT "%5.1" /end AXIS_PTS
/begin CHARACTERISTIC c_crk_cyl_lam_1 "Factor for different distance betwwen lambda sensor and cylinder individual exhaust-valves" VALUE 0xffe4066e _REC_VAL_20_u1 720. _CNV_A_R_LINEAR_____159_CM 0. 720. DISPLAY_IDENTIFIER C_CRK_CYL_LAM_1 FORMAT "%4.0" /end CHARACTERISTIC
/begin CHARACTERISTIC c_crk_cyl_lam_2 "Factor for different distance betwwen lambda sensor and cylinder individual exhaust-valves" VALUE 0xffe4066f _REC_VAL_20_u1 720. _CNV_A_R_LINEAR_____159_CM 0. 720. DISPLAY_IDENTIFIER C_CRK_CYL_LAM_2 FORMAT "%4.0" /end CHARACTERISTIC
/begin CHARACTERISTIC c_crk_cyl_lam_3 "Factor for different distance betwwen lambda sensor and cylinder individual exhaust-valves" VALUE 0xffe40670 _REC_VAL_20_u1 720. _CNV_A_R_LINEAR_____159_CM 0. 720. DISPLAY_IDENTIFIER C_CRK_CYL_LAM_3 FORMAT "%4.0" /end CHARACTERISTIC
/begin CHARACTERISTIC c_crk_cyl_lam_4 "Factor for different distance betwwen lambda sensor and cylinder individual exhaust-valves" VALUE 0xffe40671 _REC_VAL_20_u1 720. _CNV_A_R_LINEAR_____159_CM 0. 720. DISPLAY_IDENTIFIER C_CRK_CYL_LAM_4 FORMAT "%4.0" /end CHARACTERISTIC
/begin CHARACTERISTIC c_crk_cyl_lam_5 "Factor for different distance betwwen lambda sensor and cylinder individual exhaust-valves" VALUE 0xffe40672 _REC_VAL_20_u1 720. _CNV_A_R_LINEAR_____159_CM 0. 720. DISPLAY_IDENTIFIER C_CRK_CYL_LAM_5 FORMAT "%4.0" /end CHARACTERISTIC
/begin CHARACTERISTIC c_crk_cyl_lam_0 "Factor for different distance betwwen lambda sensor and cylinder individual exhaust-valves" VALUE 0xffe4066d _REC_VAL_20_u1 720. _CNV_A_R_LINEAR_____159_CM 0. 720. DISPLAY_IDENTIFIER C_CRK_CYL_LAM_0 FORMAT "%4.0" /end CHARACTERISTIC
/begin CHARACTERISTIC lc_maf_int_max_o2l_mdl_ini_2 "calibration flag for forced initialisation of adaptive air mass integral maximum" VALUE 0xffe40fa4 _REC_VAL_20_u1 1. _CNV_A_R_LINEAR_____22_CM 0. 1. DISPLAY_IDENTIFIER LC_MAF_INT_MAX_O2L_MDL_INI_2 FORMAT "%1.0" /end CHARACTERISTIC
/begin CHARACTERISTIC lc_lamb_sp_ref_o2l_mdl_2 "calibration flag for switching between manual and basis lambda set point reference" VALUE 0xffe40f97 _REC_VAL_20_u1 1. _CNV_A_R_LINEAR_____22_CM 0. 1. DISPLAY_IDENTIFIER LC_LAMB_SP_REF_O2L_MDL_2 FORMAT "%1.0" /end CHARACTERISTIC
/begin CHARACTERISTIC lc_lamb_sp_ref_o2l_mdl_1 "calibration flag for switching between manual and basis lambda set point reference" VALUE 0xffe40f96 _REC_VAL_20_u1 1. _CNV_A_R_LINEAR_____22_CM 0. 1. DISPLAY_IDENTIFIER LC_LAMB_SP_REF_O2L_MDL_1 FORMAT "%1.0" /end CHARACTERISTIC
/begin CHARACTERISTIC c_maf_int_max_o2l_mdl_ini_2 "initialisation value of adaptive air mass integral maximum" VALUE 0xffe4175e _REC_VAL_20_u2 182.0389 _CNV_A_R_LINEAR_____344_CM 0. 182.0389 DISPLAY_IDENTIFIER C_MAF_INT_MAX_O2L_MDL_INI_2 FORMAT "%7.3" /end CHARACTERISTIC
/begin CHARACTERISTIC c_lamb_sp_ref_o2l_mdl_1 "manual lambda set point reference" VALUE 0xffe416f0 _REC_VAL_20_u2 1.99993897 _CNV_A_R_LINEAR_____347_CM 0. 1.99993897 DISPLAY_IDENTIFIER C_LAMB_SP_REF_O2L_MDL_1 FORMAT "%7.5" /end CHARACTERISTIC
/begin CHARACTERISTIC c_lamb_sp_ref_o2l_mdl_2 "manual lambda set point reference" VALUE 0xffe416f2 _REC_VAL_20_u2 1.99993897 _CNV_A_R_LINEAR_____347_CM 0. 1.99993897 DISPLAY_IDENTIFIER C_LAMB_SP_REF_O2L_MDL_2 FORMAT "%7.5" /end CHARACTERISTIC
/begin CHARACTERISTIC c_vls_down_thd_afr_o2l_mdl "rich threshold of downstream sensor signal for adaptation of air mass integral" VALUE 0xffe41b7a _REC_VAL_20_u2 5. _CNV_A_R_LINEAR_____269_CM 0. 5. DISPLAY_IDENTIFIER C_VLS_DOWN_THD_AFR_O2L_MDL FORMAT "%5.3" /end CHARACTERISTIC
/begin CHARACTERISTIC c_vls_down_thd_afl_o2l_mdl "lean threshold of downstream sensor signal for adaptation of air mass integral maximum" VALUE 0xffe41b76 _REC_VAL_20_u2 5. _CNV_A_R_LINEAR_____269_CM 0. 5. DISPLAY_IDENTIFIER C_VLS_DOWN_THD_AFL_O2L_MDL FORMAT "%5.3" /end CHARACTERISTIC
/begin CHARACTERISTIC c_vls_down_thd_o2l_ad "threshold of downstream sensor signal for post PUC adaptation of air mass integral maximum" VALUE 0xffe41b7c _REC_VAL_20_u2 5. _CNV_A_R_LINEAR_____269_CM 0. 5. DISPLAY_IDENTIFIER C_VLS_DOWN_THD_O2L_AD FORMAT "%5.3" /end CHARACTERISTIC
/begin CHARACTERISTIC c_fac_maf_int_o2l_mdl_puc "factor for air mass integral calculation used in PUC phase " VALUE 0xffe40402 _REC_VAL_20_s2 3.999938965 _CNV_A_R_LINEAR_____276_CM -2. 1.999938965 DISPLAY_IDENTIFIER C_FAC_MAF_INT_O2L_MDL_PUC FORMAT "%8.4" /end CHARACTERISTIC
/begin CHARACTERISTIC c_fac_add_maf_int_o2l_mdl_afr "additional factor for air mass integral calculation used when mass air integral is below zero" VALUE 0xffe4072c _REC_VAL_20_u1 1.9921875 _CNV_A_R_LINEAR_____117_CM 0. 1.9921875 DISPLAY_IDENTIFIER C_FAC_ADD_MAF_INT_O2L_MDL_AFR FORMAT "%5.3" /end CHARACTERISTIC
/begin CHARACTERISTIC c_fac_add_maf_int_o2l_mdl_afl "additional factor for air mass integral calculation used when mass air integral is above maximum" VALUE 0xffe4072b _REC_VAL_20_u1 1.9921875 _CNV_A_R_LINEAR_____117_CM 0. 1.9921875 DISPLAY_IDENTIFIER C_FAC_ADD_MAF_INT_O2L_MDL_AFL FORMAT "%5.3" /end CHARACTERISTIC
/begin CHARACTERISTIC c_fac_add_maf_int_o2l_mdl_pue "additional factor for air mass integral calculation used in post PUC phase" VALUE 0xffe4072d _REC_VAL_20_u1 1.9921875 _CNV_A_R_LINEAR_____117_CM 0. 1.9921875 DISPLAY_IDENTIFIER C_FAC_ADD_MAF_INT_O2L_MDL_PUE FORMAT "%5.3" /end CHARACTERISTIC
/begin CHARACTERISTIC c_crlc_maf_int_o2l_max_ad_vls "correlation constant for downstream sensor signal based adaptation of air mass integral maximum" VALUE 0xffe4068c _REC_VAL_20_u1 0.99610001 _CNV_A_R_LINEAR_____29_CM 0. 0.99610001 DISPLAY_IDENTIFIER C_CRLC_MAF_INT_O2L_MAX_AD_VLS FORMAT "%5.3" /end CHARACTERISTIC
/begin CHARACTERISTIC c_crlc_maf_int_o2l_max_ad_pue "correlation constant for post PUC based adaptation of air mass integral maximum" VALUE 0xffe4068b _REC_VAL_20_u1 0.99610001 _CNV_A_R_LINEAR_____29_CM 0. 0.99610001 DISPLAY_IDENTIFIER C_CRLC_MAF_INT_O2L_MAX_AD_PUE FORMAT "%5.3" /end CHARACTERISTIC
/begin CHARACTERISTIC c_maf_int_min_o2l_mdl_ad_pue "minimum air mass integral for post PUC adaptation (small value means big post PUC integral)" VALUE 0xffe41770 _REC_VAL_20_u2 182.0389 _CNV_A_R_LINEAR_____344_CM 0. 182.0389 DISPLAY_IDENTIFIER C_MAF_INT_MIN_O2L_MDL_AD_PUE FORMAT "%7.3" /end CHARACTERISTIC
/begin CHARACTERISTIC c_crlc_maf_int_mmv_o2l_mdl "correlation constant for post PUC based adaptation of air mass integral maximum" VALUE 0xffe40688 _REC_VAL_20_u1 0.99610001 _CNV_A_R_LINEAR_____29_CM 0. 0.99610001 DISPLAY_IDENTIFIER C_CRLC_MAF_INT_MMV_O2L_MDL FORMAT "%5.3" /end CHARACTERISTIC
/begin AXIS_PTS ldp_quo_maf_int_efc_o2l_mdl "" 0xffe51236 online_dummy _REC_AXS_20_u2 99.99847412 _CNV_A_R_LINEAR_____8_CM 8 0. 99.99847412 DISPLAY_IDENTIFIER LDP_QUO_MAF_INT_EFC_O2L_MDL /end AXIS_PTS
/begin CHARACTERISTIC ip_delta_lamb_sp_o2l_mdl "lambda set point shift of catalyst O2 loading condition function" CURVE 0xffe49f36 _REC_CUR_20_u2_u2 0.25 _CNV_A_R_LINEAR_____354_CM -0.125 0.125 DISPLAY_IDENTIFIER IP_DELTA_LAMB_SP_O2L_MDL FORMAT "%6.4"
 /begin AXIS_DESCR COM_AXIS online_dummy _CNV_A_R_LINEAR_____8_CM 8 0. 99.99847412 AXIS_PTS_REF ldp_quo_maf_int_efc_o2l_mdl /end AXIS_DESCR
/end CHARACTERISTIC
/begin CHARACTERISTIC ip_fac_maf_int_o2l_mdl "additional factor for air mass integral calculation taking into account air mass flow speed and cat temperature" MAP 0xffe45406 _REC_MAP_20_u1_u1_u1 1.9921875 _CNV_A_R_LINEAR_____117_CM 0. 1.9921875 DISPLAY_IDENTIFIER IP_FAC_MAF_INT_O2L_MDL FORMAT "%5.3"
 /begin AXIS_DESCR COM_AXIS n_32 _CNV_A_R_LINEAR_____15_CM 8 0. 8160. FORMAT "%4.0" AXIS_PTS_REF ldpm_n_32_2_egtr /end AXIS_DESCR
 /begin AXIS_DESCR COM_AXIS maf _CNV_A_R_LINEAR_____27_CM 8 0. 1389. FORMAT "%4.0" AXIS_PTS_REF ldpm_maf_hb_2_egtr /end AXIS_DESCR
/end CHARACTERISTIC
/begin CHARACTERISTIC c_crlc_maf_int_o2l_max_ad_max "correlation constant for adaptation of air mass integral maximum using integral itself near maximum" VALUE 0xffe40689 _REC_VAL_20_u1 0.99610001 _CNV_A_R_LINEAR_____29_CM 0. 0.99610001 DISPLAY_IDENTIFIER C_CRLC_MAF_INT_O2L_MAX_AD_MAX FORMAT "%5.3" /end CHARACTERISTIC
/begin CHARACTERISTIC c_crlc_maf_int_o2l_max_ad_min "correlation constant for adaptation of air mass integral maximum using integral itself near zero" VALUE 0xffe4068a _REC_VAL_20_u1 0.99610001 _CNV_A_R_LINEAR_____29_CM 0. 0.99610001 DISPLAY_IDENTIFIER C_CRLC_MAF_INT_O2L_MAX_AD_MIN FORMAT "%5.3" /end CHARACTERISTIC
/begin CHARACTERISTIC c_delta_lamb_cor_add_o2l_mdl_1 "additional lambda delta for WRAF sensor signal LAMB_i used for air mass integral calculation" VALUE 0xffe403e8 _REC_VAL_20_s2 0.25 _CNV_A_R_LINEAR_____288_CM -0.125 0.125 DISPLAY_IDENTIFIER C_DELTA_LAMB_COR_ADD_O2L_MDL_1 FORMAT "%8.5" /end CHARACTERISTIC
/begin CHARACTERISTIC c_delta_lamb_cor_add_o2l_mdl_2 "additional lambda delta for WRAF sensor signal LAMB_i used for air mass integral calculation" VALUE 0xffe403ea _REC_VAL_20_s2 0.25 _CNV_A_R_LINEAR_____288_CM -0.125 0.125 DISPLAY_IDENTIFIER C_DELTA_LAMB_COR_ADD_O2L_MDL_2 FORMAT "%8.5" /end CHARACTERISTIC
/begin CHARACTERISTIC lc_maf_int_max_o2l_mdl_ini_1 "calibration flag for forced initialisation of adaptive air mass integral maximum" VALUE 0xffe40fa3 _REC_VAL_20_u1 1. _CNV_A_R_LINEAR_____22_CM 0. 1. DISPLAY_IDENTIFIER LC_MAF_INT_MAX_O2L_MDL_INI_1 FORMAT "%1.0" /end CHARACTERISTIC
/begin CHARACTERISTIC c_maf_int_max_o2l_mdl_ini_1 "initialisation value of adaptive air mass integral maximum" VALUE 0xffe4175c _REC_VAL_20_u2 182.0389 _CNV_A_R_LINEAR_____344_CM 0. 182.0389 DISPLAY_IDENTIFIER C_MAF_INT_MAX_O2L_MDL_INI_1 FORMAT "%7.3" /end CHARACTERISTIC
/begin CHARACTERISTIC c_maf_int_puc_min_o2l_mdl_act "minimum MAF integral during PUC for activating function" VALUE 0xffe4178a _REC_VAL_20_u2 1820.4167 _CNV_A_R_LINEAR_____634_CM 0. 1820.4167 DISPLAY_IDENTIFIER C_MAF_INT_PUC_MIN_O2L_MDL_ACT FORMAT "%7.2" /end CHARACTERISTIC
/begin CHARACTERISTIC c_crlc_vls_down_mmv_o2l_mdl "correlation constant for filtering downstream sensor signal " VALUE 0xffe4069e _REC_VAL_20_u1 0.99610001 _CNV_A_R_LINEAR_____29_CM 0. 0.99610001 DISPLAY_IDENTIFIER C_CRLC_VLS_DOWN_MMV_O2L_MDL FORMAT "%5.3" /end CHARACTERISTIC
/begin CHARACTERISTIC c_crlc_delta_lamb_cor_o2l_mdl "correlation constant for filtering lambda delta for WRAF sensor signal  LAMB_i" VALUE 0xffe4067f _REC_VAL_20_u1 0.99610001 _CNV_A_R_LINEAR_____29_CM 0. 0.99610001 DISPLAY_IDENTIFIER C_CRLC_DELTA_LAMB_COR_O2L_MDL FORMAT "%5.3" /end CHARACTERISTIC
/begin CHARACTERISTIC lc_delta_lamb_cor_o2l_mdl_1 "calibration flag to set lambda delta used for air mass integral calculation to adaptation value of trim controller" VALUE 0xffe40f48 _REC_VAL_20_u1 1. _CNV_A_R_LINEAR_____22_CM 0. 1. DISPLAY_IDENTIFIER LC_DELTA_LAMB_COR_O2L_MDL_1 FORMAT "%1.0" /end CHARACTERISTIC
/begin CHARACTERISTIC lc_delta_lamb_cor_o2l_mdl_2 "calibration flag to set lambda delta used for air mass integral calculation to adaptation value of trim controller" VALUE 0xffe40f49 _REC_VAL_20_u1 1. _CNV_A_R_LINEAR_____22_CM 0. 1. DISPLAY_IDENTIFIER LC_DELTA_LAMB_COR_O2L_MDL_2 FORMAT "%1.0" /end CHARACTERISTIC
/begin COMPU_METHOD _CNV_A_R_LINEAR_____0_CM "" RAT_FUNC "%6.3" "-" COEFFS 0 1. 0. 0 0 1 /end COMPU_METHOD
/begin COMPU_METHOD _CNV_S_2_RANGE______2_CM "" TAB_VERB "%6.3" "[-]" COMPU_TAB_REF _CNV_S_2_RANGE______2 /end COMPU_METHOD
/begin COMPU_VTAB _CNV_S_2_RANGE______2 "" TAB_VERB 2 0 "0" 1 "1" /end COMPU_VTAB
/begin COMPU_METHOD _CNV_A_R_LINEAR_____3_CM "" RAT_FUNC "%6.3" "V" COEFFS 0 204.7999998974999 0. 0 0 1 /end COMPU_METHOD
/begin COMPU_METHOD _CNV_A_R_LINEAR_____6_CM "" RAT_FUNC "%6.3" "°C" COEFFS 0 16. 0. 0 0 1 /end COMPU_METHOD
/begin COMPU_METHOD _CNV_A_R_LINEAR_____8_CM "" RAT_FUNC "%6.3" "%" COEFFS 0 655.3600000071681 0. 0 0 1 /end COMPU_METHOD
/begin COMPU_METHOD _CNV_A_R_LINEAR_____10_CM "" RAT_FUNC "%6.3" "rpm" COEFFS 0 1. 0. 0 0 1 /end COMPU_METHOD
/begin COMPU_METHOD _CNV_A_R_LINEAR_____11_CM "" RAT_FUNC "%6.3" "°C" COEFFS 0 1.333333333333333 64. 0 0 1 /end COMPU_METHOD
/begin COMPU_METHOD _CNV_A_R_LINEAR_____15_CM "" RAT_FUNC "%6.3" "rpm" COEFFS 0 3.125e-002 0. 0 0 1 /end COMPU_METHOD
/begin COMPU_METHOD _CNV_A_R_LINEAR_____20_CM "" RAT_FUNC "%6.3" "-" COEFFS 0 32768.00003968061 0. 0 0 1 /end COMPU_METHOD
/begin COMPU_METHOD _CNV_S_2_RANGE______21_CM "" TAB_VERB "%6.3" "-" COMPU_TAB_REF _CNV_S_2_RANGE______21 /end COMPU_METHOD
/begin COMPU_VTAB _CNV_S_2_RANGE______21 "" TAB_VERB 2 0 "0" 1 "1" /end COMPU_VTAB
/begin COMPU_METHOD _CNV_A_R_LINEAR_____22_CM "" RAT_FUNC "%6.3" "[-]" COEFFS 0 1. 0. 0 0 1 /end COMPU_METHOD
/begin COMPU_METHOD _CNV_A_R_LINEAR_____24_CM "" RAT_FUNC "%6.3" "s" COEFFS 0 10. 0. 0 0 1 /end COMPU_METHOD
/begin COMPU_METHOD _CNV_A_R_LINEAR_____25_CM "" RAT_FUNC "%6.3" "-" COEFFS 0 4095.999999839998 -1.280019205296412e-006 0 0 1 /end COMPU_METHOD
/begin COMPU_METHOD _CNV_A_R_LINEAR_____27_CM "" RAT_FUNC "%6.3" "mg/stk" COEFFS 0 0.183585313174946 0. 0 0 1 /end COMPU_METHOD
/begin COMPU_METHOD _CNV_A_R_LINEAR_____29_CM "" RAT_FUNC "%6.3" "-" COEFFS 0 255.9983911655618 0. 0 0 1 /end COMPU_METHOD
/begin COMPU_METHOD _CNV_A_R_LINEAR_____30_CM "" RAT_FUNC "%6.3" "s" COEFFS 0 1. 0. 0 0 1 /end COMPU_METHOD
/begin COMPU_METHOD _CNV_A_R_LINEAR_____37_CM "" RAT_FUNC "%6.3" "-" COEFFS 0 65536.00007936121 0. 0 0 1 /end COMPU_METHOD
/begin COMPU_METHOD _CNV_A_R_LINEAR_____39_CM "" RAT_FUNC "%6.3" "-" COEFFS 0 127.9991955827809 0. 0 0 1 /end COMPU_METHOD
/begin COMPU_METHOD _CNV_A_R_LINEAR_____49_CM "" RAT_FUNC "%6.3" "hPa" COEFFS 0 12.06017666543982 0. 0 0 1 /end COMPU_METHOD
/begin COMPU_METHOD _CNV_A_R_LINEAR_____50_CM "" RAT_FUNC "%6.3" "[-]" COEFFS 0 255.9999357490357 0. 0 0 1 /end COMPU_METHOD
/begin COMPU_METHOD _CNV_A_R_LINEAR_____55_CM "" RAT_FUNC "%6.3" "Nm" COEFFS 0 32. 0. 0 0 1 /end COMPU_METHOD
/begin COMPU_METHOD _CNV_A_R_LINEAR_____82_CM "" RAT_FUNC "%6.3" "°CRK" COEFFS 0 2.666666666666667 0. 0 0 1 /end COMPU_METHOD
/begin COMPU_METHOD _CNV_A_R_LINEAR_____97_CM "" RAT_FUNC "%6.3" "min" COEFFS 0 1. 0. 0 0 1 /end COMPU_METHOD
/begin COMPU_METHOD _CNV_A_R_LINEAR_____108_CM "" RAT_FUNC "%6.3" "mg/stk" COEFFS 0 47.18142548596112 0. 0 0 1 /end COMPU_METHOD
/begin COMPU_METHOD _CNV_A_R_LINEAR_____111_CM "" RAT_FUNC "%6.3" "%" COEFFS 0 655.3600000071681 3.584063961170614e-007 0 0 1 /end COMPU_METHOD
/begin COMPU_METHOD _CNV_A_R_LINEAR_____115_CM "" RAT_FUNC "%6.3" "kg/h" COEFFS 0 32. 0. 0 0 1 /end COMPU_METHOD
/begin COMPU_METHOD _CNV_A_R_LINEAR_____117_CM "" RAT_FUNC "%6.3" "-" COEFFS 0 128. 0. 0 0 1 /end COMPU_METHOD
/begin COMPU_METHOD _CNV_A_R_LINEAR_____118_CM "" RAT_FUNC "%6.3" "-" COEFFS 0 1023.999999959999 0. 0 0 1 /end COMPU_METHOD
/begin COMPU_METHOD _CNV_A_R_LINEAR_____126_CM "" RAT_FUNC "%6.3" "-" COEFFS 0 65551.06000970239 0. 0 0 1 /end COMPU_METHOD
/begin COMPU_METHOD _CNV_A_R_LINEAR_____127_CM "" RAT_FUNC "%6.3" "-" COEFFS 0 16383.75 0. 0 0 1 /end COMPU_METHOD
/begin COMPU_METHOD _CNV_A_R_LINEAR_____159_CM "" RAT_FUNC "%6.3" "°CRK" COEFFS 0 0.1666666666666667 0. 0 0 1 /end COMPU_METHOD
/begin COMPU_METHOD _CNV_A_R_LINEAR_____160_CM "" RAT_FUNC "%6.3" "V" COEFFS 0 3286.746987951807 0. 0 0 1 /end COMPU_METHOD
/begin COMPU_METHOD _CNV_A_R_LINEAR_____161_CM "" RAT_FUNC "%6.3" "-" COEFFS 0 4095.875 0. 0 0 1 /end COMPU_METHOD
/begin COMPU_METHOD _CNV_A_R_LINEAR_____162_CM "" RAT_FUNC "%6.3" "1/s" COEFFS 0 255.99609375 0. 0 0 1 /end COMPU_METHOD
/begin COMPU_METHOD _CNV_A_R_LINEAR_____163_CM "" RAT_FUNC "%6.3" "s" COEFFS 0 32768.00003968061 0. 0 0 1 /end COMPU_METHOD
/begin COMPU_METHOD _CNV_A_R_LINEAR_____164_CM "" RAT_FUNC "%6.3" "%" COEFFS 0 32767.9915198728 0. 0 0 1 /end COMPU_METHOD
/begin COMPU_METHOD _CNV_A_R_LINEAR_____165_CM "" RAT_FUNC "%6.3" "ms" COEFFS 0 250. 0. 0 0 1 /end COMPU_METHOD
/begin COMPU_METHOD _CNV_A_R_LINEAR_____177_CM "" RAT_FUNC "%6.3" "-" COEFFS 0 1. -1. 0 0 1 /end COMPU_METHOD
/begin COMPU_METHOD _CNV_A_R_LINEAR_____187_CM "" RAT_FUNC "%6.3" "Nm" COEFFS 0 32. 32768. 0 0 1 /end COMPU_METHOD
/begin COMPU_METHOD _CNV_A_R_LINEAR_____198_CM "" RAT_FUNC "%6.3" "s" COEFFS 0 50. 0. 0 0 1 /end COMPU_METHOD
/begin COMPU_METHOD _CNV_A_R_LINEAR_____199_CM "" RAT_FUNC "%6.3" "hPa" COEFFS 0 0.3768805207949945 0. 0 0 1 /end COMPU_METHOD
/begin COMPU_METHOD _CNV_A_R_LINEAR_____206_CM "" RAT_FUNC "%6.3" "-" COEFFS 0 1023.999999919998 0. 0 0 1 /end COMPU_METHOD
/begin COMPU_METHOD _CNV_A_R_LINEAR_____262_CM "" RAT_FUNC "%6.3" "%" COEFFS 0 655.3600000071681 32768.00000035841 0 0 1 /end COMPU_METHOD
/begin COMPU_METHOD _CNV_A_R_LINEAR_____263_CM "" RAT_FUNC "%6.3" "%" COEFFS 0 1310.720001587224 0. 0 0 1 /end COMPU_METHOD
/begin COMPU_METHOD _CNV_A_R_LINEAR_____264_CM "" RAT_FUNC "%6.3" "s" COEFFS 0 62415.29624765353 0. 0 0 1 /end COMPU_METHOD
/begin COMPU_METHOD _CNV_A_R_LINEAR_____265_CM "" RAT_FUNC "%6.3" "%" COEFFS 0 4095.999999839998 0. 0 0 1 /end COMPU_METHOD
/begin COMPU_METHOD _CNV_A_R_LINEAR_____266_CM "" RAT_FUNC "%6.3" "%" COEFFS 0 1310.722146049159 -0.1072214604915853 0 0 1 /end COMPU_METHOD
/begin COMPU_METHOD _CNV_A_R_LINEAR_____267_CM "" RAT_FUNC "%6.3" "%/s" COEFFS 0 2621.440000028672 0. 0 0 1 /end COMPU_METHOD
/begin COMPU_METHOD _CNV_A_R_LINEAR_____268_CM "" RAT_FUNC "%6.3" "%" COEFFS 0 819215.9607980399 0. 0 0 1 /end COMPU_METHOD
/begin COMPU_METHOD _CNV_A_R_LINEAR_____269_CM "" RAT_FUNC "%6.3" "V" COEFFS 0 204.8 0. 0 0 1 /end COMPU_METHOD
/begin COMPU_METHOD _CNV_A_R_LINEAR_____270_CM "" RAT_FUNC "%6.3" "%" COEFFS 0 655.359650041603 0. 0 0 1 /end COMPU_METHOD
/begin COMPU_METHOD _CNV_A_R_LINEAR_____271_CM "" RAT_FUNC "%6.3" "-" COEFFS 0 7.971241012816505 0. 0 0 1 /end COMPU_METHOD
/begin COMPU_METHOD _CNV_A_R_LINEAR_____272_CM "" RAT_FUNC "%6.3" "-" COEFFS 0 16383.99985599781 0. 0 0 1 /end COMPU_METHOD
/begin COMPU_METHOD _CNV_A_R_LINEAR_____273_CM "" RAT_FUNC "%6.3" "g" COEFFS 0 35.99999934081027 0. 0 0 1 /end COMPU_METHOD
/begin COMPU_METHOD _CNV_A_R_LINEAR_____275_CM "" RAT_FUNC "%6.3" "-" COEFFS 0 16383.75 32767.5 0 0 1 /end COMPU_METHOD
/begin COMPU_METHOD _CNV_A_R_LINEAR_____276_CM "" RAT_FUNC "%6.3" "-" COEFFS 0 16383.99999935999 -1.280019205296412e-006 0 0 1 /end COMPU_METHOD
/begin COMPU_METHOD _CNV_A_R_LINEAR_____281_CM "" RAT_FUNC "%6.3" "-" COEFFS 0 32768.00003968061 3.96806062781252e-005 0 0 1 /end COMPU_METHOD
/begin COMPU_METHOD _CNV_A_R_LINEAR_____282_CM "" RAT_FUNC "%6.3" "-" COEFFS 0 16383.96875 0. 0 0 1 /end COMPU_METHOD
/begin COMPU_METHOD _CNV_A_R_LINEAR_____283_CM "" RAT_FUNC "%6.3" "-" COEFFS 0 32767.9999998706 -8.480072021484375e-003 0 0 1 /end COMPU_METHOD
/begin COMPU_METHOD _CNV_A_R_LINEAR_____286_CM "" RAT_FUNC "%6.3" "-" COEFFS 0 262144.1943071089 2.428838861669647e-002 0 0 1 /end COMPU_METHOD
/begin COMPU_METHOD _CNV_A_R_LINEAR_____287_CM "" RAT_FUNC "%6.3" "g" COEFFS 0 36.00036915004301 0. 0 0 1 /end COMPU_METHOD
/begin COMPU_METHOD _CNV_A_R_LINEAR_____288_CM "" RAT_FUNC "%6.3" "-" COEFFS 0 16384. 0. 0 0 1 /end COMPU_METHOD
/begin COMPU_METHOD _CNV_A_R_LINEAR_____303_CM "" RAT_FUNC "%6.3" "°C" COEFFS 0 15.99999804684544 -4.000060547696194e-003 0 0 1 /end COMPU_METHOD
/begin COMPU_METHOD _CNV_A_R_LINEAR_____318_CM "" RAT_FUNC "%6.3" "%/s" COEFFS 0 0.1024000000600009 0. 0 0 1 /end COMPU_METHOD
/begin COMPU_METHOD _CNV_A_R_LINEAR_____343_CM "" RAT_FUNC "%6.3" "°C" COEFFS 0 64. 2112. 0 0 1 /end COMPU_METHOD
/begin COMPU_METHOD _CNV_A_R_LINEAR_____344_CM "" RAT_FUNC "%6.3" "g" COEFFS 0 179.9999890133373 0. 0 0 1 /end COMPU_METHOD
/begin COMPU_METHOD _CNV_A_R_LINEAR_____345_CM "" RAT_FUNC "%6.3" "g" COEFFS 0 92160.01975342279 -0.5 0 0 1 /end COMPU_METHOD
/begin COMPU_METHOD _CNV_A_R_LINEAR_____346_CM "" RAT_FUNC "%6.3" "g" COEFFS 0 92160.00000008641 -2.047454472631216e-008 0 0 1 /end COMPU_METHOD
/begin COMPU_METHOD _CNV_A_R_LINEAR_____347_CM "" RAT_FUNC "%6.3" "-" COEFFS 0 16383.99995775871 0. 0 0 1 /end COMPU_METHOD
/begin COMPU_METHOD _CNV_A_R_LINEAR_____354_CM "" RAT_FUNC "%6.3" "-" COEFFS 0 16384. 2048. 0 0 1 /end COMPU_METHOD
/begin COMPU_METHOD _CNV_A_R_LINEAR_____358_CM "" RAT_FUNC "%6.3" "%/s" COEFFS 0 0.1024000154202376 0. 0 0 1 /end COMPU_METHOD
/begin COMPU_METHOD _CNV_A_R_LINEAR_____359_CM "" RAT_FUNC "%6.3" "%/s" COEFFS 0 0.1024028382518949 128. 0 0 1 /end COMPU_METHOD
/begin COMPU_METHOD _CNV_A_R_LINEAR_____426_CM "" RAT_FUNC "%6.3" "-" COEFFS 0 2048. 0. 0 0 1 /end COMPU_METHOD
/begin COMPU_METHOD _CNV_A_R_LINEAR_____441_CM "" RAT_FUNC "%6.3" "-" COEFFS 0 2. 0. 0 0 1 /end COMPU_METHOD
/begin COMPU_METHOD _CNV_A_R_LINEAR_____492_CM "" RAT_FUNC "%6.3" "hPa" COEFFS 0 1.466461170408539e-003 0. 0 0 1 /end COMPU_METHOD
/begin COMPU_METHOD _CNV_A_R_LINEAR_____493_CM "" RAT_FUNC "%6.3" "ms/(mg/stk)" COEFFS 0 173625.6457808981 0. 0 0 1 /end COMPU_METHOD
/begin COMPU_METHOD _CNV_A_R_LINEAR_____498_CM "" RAT_FUNC "%6.3" "-" COEFFS 0 511.9999948599216 0. 0 0 1 /end COMPU_METHOD
/begin COMPU_METHOD _CNV_A_R_LINEAR_____634_CM "" RAT_FUNC "%6.3" "-" COEFFS 0 35.99999934081027 0. 0 0 1 /end COMPU_METHOD
/begin RECORD_LAYOUT _REC_VAL_20_u1 FNC_VALUES 1 UBYTE COLUMN_DIR DIRECT /end RECORD_LAYOUT
/begin RECORD_LAYOUT _REC_VAL_20_u2 FNC_VALUES 1 UWORD COLUMN_DIR DIRECT /end RECORD_LAYOUT
/begin RECORD_LAYOUT _REC_CUR_20_u2_u1 FNC_VALUES 1 UWORD COLUMN_DIR DIRECT /end RECORD_LAYOUT
/begin RECORD_LAYOUT _REC_AXS_20_u1 NO_AXIS_PTS_X 1 UBYTE AXIS_PTS_X 2 UBYTE INDEX_INCR DIRECT /end RECORD_LAYOUT
/begin RECORD_LAYOUT _REC_MAP_20_u1_u1_u1 FNC_VALUES 1 UBYTE COLUMN_DIR DIRECT /end RECORD_LAYOUT
/begin RECORD_LAYOUT _REC_CUR_20_u1_u1 FNC_VALUES 1 UBYTE COLUMN_DIR DIRECT /end RECORD_LAYOUT
/begin RECORD_LAYOUT _REC_AXS_20_u2 NO_AXIS_PTS_X 1 UWORD AXIS_PTS_X 2 UWORD INDEX_INCR DIRECT /end RECORD_LAYOUT
/begin RECORD_LAYOUT _REC_MAP_20_u1_u1_u2 FNC_VALUES 1 UBYTE COLUMN_DIR DIRECT /end RECORD_LAYOUT
/begin RECORD_LAYOUT _REC_MAP_20_u2_u2_u1 FNC_VALUES 1 UWORD COLUMN_DIR DIRECT /end RECORD_LAYOUT
/begin RECORD_LAYOUT _REC_CUR_20_u1_u2 FNC_VALUES 1 UBYTE COLUMN_DIR DIRECT /end RECORD_LAYOUT
/begin RECORD_LAYOUT _REC_MAP_20_u2_u1_u1 FNC_VALUES 1 UWORD COLUMN_DIR DIRECT /end RECORD_LAYOUT
/begin RECORD_LAYOUT _REC_CUR_20_u2_u2 FNC_VALUES 1 UWORD COLUMN_DIR DIRECT /end RECORD_LAYOUT
/begin RECORD_LAYOUT _REC_VAL_20_s1 FNC_VALUES 1 SBYTE COLUMN_DIR DIRECT /end RECORD_LAYOUT
/begin RECORD_LAYOUT _REC_VAL_20_s2 FNC_VALUES 1 SWORD COLUMN_DIR DIRECT /end RECORD_LAYOUT
/begin RECORD_LAYOUT _REC_MAP_20_u2_u1_u2 FNC_VALUES 1 UWORD COLUMN_DIR DIRECT /end RECORD_LAYOUT
/begin RECORD_LAYOUT _REC_MAP_20_u1_u2_u2 FNC_VALUES 1 UBYTE COLUMN_DIR DIRECT /end RECORD_LAYOUT
/begin RECORD_LAYOUT _REC_MAP_20_u2_u2_u2 FNC_VALUES 1 UWORD COLUMN_DIR DIRECT /end RECORD_LAYOUT
/begin RECORD_LAYOUT _REC_MAP_20_u1_u2_u1 FNC_VALUES 1 UBYTE COLUMN_DIR DIRECT /end RECORD_LAYOUT
/begin RECORD_LAYOUT _REC_CUR_20_s2_u2 FNC_VALUES 1 SWORD COLUMN_DIR DIRECT /end RECORD_LAYOUT
/begin FUNCTION INJ_Lambda_controller_for_a_cont "_Lambda-controller for a continuous characteristic lambda-sensor"
 /begin DEF_CHARACTERISTIC c_lam_mv_lpf_crlc c_lam_n_min c_lam_mv_crlc c_lam_p_max c_lam_p_max_cp c_lam_p_min_cp c_lam_i_i_min_cp c_lam_i_i_max_cp c_lam_i_i_max c_lam_i_i_min c_lam_d_min c_lam_d_max c_lam_out_min c_lam_out_min_cp c_lam_out_max_cp c_lam_out_max ip_crlc_lam_mv_lpf_cp id_lam_cor_min_intr id_lam_cor_max_intr c_lam_p_min ip_t1_lamb_1 c_fac_lam_i_delta_max ip_t1_lamb_2 ip_lam_p ip_lam_p_ctl_gain_swi ip_lam_i ip_lam_i_ctl_gain_swi ip_lam_i_i ip_lam_i_i_ctl_gain_swi ip_lam_d ip_lam_d_ctl_gain_swi ldpm_maf_1_laco ldpm_maf_2_laco ldpm_n_2_laco c_crlc_lamb_dif_mmv_lam c_t_max_lam_i_1_save_1 c_t_max_lam_i_1_save_2 c_crlc_vls_down_mmv_lam c_vls_down_thd_afr_lam c_vls_down_thd_afl_lam c_delta_fac_lam_lscl_off ip_t1_lamb_agi_lim_1 ip_t1_lamb_agi_lim_2 ip_ex_dly_fac_1 ip_ex_dly_fac_2 ip_lamb_sp_the_puc id_t_min_lscl id_t_tco_lam_max_lscl id_tco_lam_min_is__tco_st id_tco_lam_min__tco_st /end DEF_CHARACTERISTIC
 /begin OUT_MEASUREMENT lam_bank_1.lam_up.bf.lv_lam_lim_max lam_bank_1.lam_up.bf.lv_lam_lim_min lam_bank_1.lam_up.bf.lv_lscl lam_bank_1.lam_up.bf.lv_t_tco_lam_max_lscl lam_bank_1.lam_up.bf.lv_lam_cor_lim_intr lam_bank_1.lam_up.bf.lv_lam_adj_ad_end lam_bank_1.lam_up.bf.lv_fac_lam_i_delta_max_act lam_bank_1.lam_up.bf.lv_vls_down_thd_afr_lam lam_bank_1.lam_up.bf.lv_vls_down_thd_afl_lam lam_bank_1.lam_up.lamb lam_bank_1.lam_up.ti_lam_fac lam_bank_1.lam_up.ti_lam_cor lam_bank_1.lam_up.lamb_av_cor lam_bank_1.lam_up.dly lam_bank_1.lam_up.lamb_dif lam_bank_1.lam_up.lam_p_lim lam_bank_1.lam_up.lam_i_i_lim lam_bank_1.lam_up.lam_d_lim lam_bank_1.lam_up.lam_i lam_bank_1.lam_up.lam_cor lam_bank_1.lam_up.lam_lim lam_bank_1.lam_up.lam_mv lam_bank_1.lam_up.lam_mv_lpf lam_bank_1.lam_up.lamb_sp_fil lam_bank_1.lam_up.lamb_sp_pctl_h_res lam_bank_1.lam_up.lamb_sp_fil_s_cp lam_bank_1.lam_up.lamb_mod lam_bank_1.lam_up.lamb_mod_s lam_bank_1.lam_up.t1_lamb lam_bank_1.lam_up.lam_mv_lpf_cp lam_bank_1.lam_up.lamb_av_cor_h_res lam_bank_1.lam_up.lamb_sp_fil_h_res lam_bank_1.lam_up.lamb_sp_fil_s_cp_h_res lam_bank_1.lam_up.lamb_sp_mod_h_res lam_bank_1.lam_up.lamb_mod_h_res lam_bank_1.lam_up.lamb_mod_s_h_res lam_bank_1.lam_up.lam_i_i_lim_sum lam_bank_1.lam_up.lam_i_i lam_bank_1.lam_up.lam_i_1_lim lam_bank_1.lam_up.lam_i_1 lam_bank_1.lam_up.lam_mv_dyw_tmp lam_bank_1.lam_up.ex_dly_fac lam_bank_1.lam_up.lamb_dif_mmv_lam lam_bank_1.lam_up.lam_i_1_save lam_bank_1.lam_up.t_lam_i_1_save_afl lam_bank_1.lam_up.t_lam_i_1_save_afr lam_bank_1.lam_up.delta_lam_i_save lam_bank_1.lam_up.vls_down_mmv_lam lam_bank_2.lam_up.bf.lv_lam_lim_max lam_bank_2.lam_up.bf.lv_lam_lim_min lam_bank_2.lam_up.bf.lv_lscl lam_bank_2.lam_up.bf.lv_t_tco_lam_max_lscl lam_bank_2.lam_up.bf.lv_lam_cor_lim_intr lam_bank_2.lam_up.bf.lv_lam_adj_ad_end lam_bank_2.lam_up.bf.lv_fac_lam_i_delta_max_act lam_bank_2.lam_up.bf.lv_vls_down_thd_afr_lam lam_bank_2.lam_up.bf.lv_vls_down_thd_afl_lam lam_bank_2.lam_up.lamb lam_bank_2.lam_up.ti_lam_fac lam_bank_2.lam_up.ti_lam_cor lam_bank_2.lam_up.lamb_av_cor lam_bank_2.lam_up.dly lam_bank_2.lam_up.lamb_dif lam_bank_2.lam_up.lam_p_lim lam_bank_2.lam_up.lam_i_i_lim lam_bank_2.lam_up.lam_d_lim lam_bank_2.lam_up.lam_i lam_bank_2.lam_up.lam_cor lam_bank_2.lam_up.lam_lim lam_bank_2.lam_up.lam_mv lam_bank_2.lam_up.lam_mv_lpf lam_bank_2.lam_up.lamb_sp_fil lam_bank_2.lam_up.lamb_sp_pctl_h_res lam_bank_2.lam_up.lamb_sp_fil_s_cp lam_bank_2.lam_up.lamb_mod lam_bank_2.lam_up.lamb_mod_s lam_bank_2.lam_up.t1_lamb lam_bank_2.lam_up.lam_mv_lpf_cp lam_bank_2.lam_up.lamb_av_cor_h_res lam_bank_2.lam_up.lamb_sp_fil_h_res lam_bank_2.lam_up.lamb_sp_fil_s_cp_h_res lam_bank_2.lam_up.lamb_sp_mod_h_res lam_bank_2.lam_up.lamb_mod_h_res lam_bank_2.lam_up.lamb_mod_s_h_res lam_bank_2.lam_up.lam_i_i_lim_sum lam_bank_2.lam_up.lam_i_i lam_bank_2.lam_up.lam_i_1_lim lam_bank_2.lam_up.lam_i_1 lam_bank_2.lam_up.lam_mv_dyw_tmp lam_bank_2.lam_up.ex_dly_fac lam_bank_2.lam_up.lamb_dif_mmv_lam lam_bank_2.lam_up.lam_i_1_save lam_bank_2.lam_up.t_lam_i_1_save_afl lam_bank_2.lam_up.t_lam_i_1_save_afr lam_bank_2.lam_up.delta_lam_i_save lam_bank_2.lam_up.vls_down_mmv_lam lamb_mv lamb_min /end OUT_MEASUREMENT
/end FUNCTION
/begin FUNCTION INJ_Application_Incidences_Coord "_Application Incidences Coordination of the Injection Time Correction Factors for Cylinder Balancing" /begin OUT_MEASUREMENT lv_bal_ena /end OUT_MEASUREMENT /end FUNCTION
/begin FUNCTION INJ_Coordination_of_the_Injectio "_Coordination of the Injection Time Correction Factors for Cylinder Balancing" /begin DEF_CHARACTERISTIC lc_ti_cor_er_bal_global /end DEF_CHARACTERISTIC
 /begin OUT_MEASUREMENT ti_add[0] ti_add[1] ti_add[2] ti_add[3] ti_add[4] ti_add[5] lv_ad_er_bal_ena lv_ad_lam_bal_ena ti_fac[0] ti_fac[1] ti_fac[2] ti_fac[3] ti_fac[4] ti_fac[5] add_ad_er_bal_1[0] fac_ad_er_bal_1[0] /end OUT_MEASUREMENT
/end FUNCTION
/begin FUNCTION INJ_Cylinder_individual_Lambda_C "_Cylinder individual Lambda Control based on a WRAF Sensor"
 /begin DEF_CHARACTERISTIC c_cyl_lam_out_min c_cyl_lam_out_max c_crlc_adj_fac ip_lamb_cyl_1 ip_lamb_cyl_2 ip_fac_err_lam_sel ip_crk_syn ip_exp_lamb_mdl ip_n1_fac_lamb_mdl ip_n2_fac_lamb_mdl c_crlc_cyl_fil c_crlc_exv_fac_1 c_crlc_exv_fac_2 c_crlc_exv_fac_3 c_crlc_exv_fac_4 c_crlc_exv_fac_5 lc_adapt_cor_out lc_delta_crk_cyl_lam_out c_delta_lamb_cyl_sp c_t_cyl_adj c_t_delta_crk_cyl_lam c_delta_crk_vls_thd c_delta_crk_out_min c_delta_crk_out_max ip_crlc_cyl_lam c_crlc_exv_fac_0 c_crlc_vls_cq_fil c_crk_chg_fac_max ip_maf_delta_crk_min ip_maf_delta_crk_max c_crk_cyl_lam_1 c_crk_cyl_lam_2 c_crk_cyl_lam_3 c_crk_cyl_lam_4 c_crk_cyl_lam_5 c_crk_cyl_lam_0 /end DEF_CHARACTERISTIC
 /begin OUT_MEASUREMENT cyl_lam_1.crk_cyl_lam_int cyl_lam_1.vls_cyl_sel_cq_fil cyl_lam_1.delta_lamb_av cyl_lam_1.delta_lamb_mdl cyl_lam_1.delta_lamb_err_raw cyl_lam_1.delta_lamb_err cyl_lam_1.delta_lamb_cyl_sel cyl_lam_2.crk_cyl_lam_int cyl_lam_2.vls_cyl_sel_cq_fil cyl_lam_2.delta_lamb_av cyl_lam_2.delta_lamb_mdl cyl_lam_2.delta_lamb_err_raw cyl_lam_2.delta_lamb_err cyl_lam_2.delta_lamb_cyl_sel cyl_lam_psa_1.lv_crk_cyl_lam_int_sel cyl_lam_psa_1.lv_delta_crk_cyl_lam cyl_lam_psa_1.lv_delta_crk_cyl_lam_err cyl_lam_psa_2.lv_crk_cyl_lam_int_sel cyl_lam_psa_2.lv_delta_crk_cyl_lam cyl_lam_psa_2.lv_delta_crk_cyl_lam_err ti_cyl_lam_[0] ti_cyl_lam_[1] ti_cyl_lam_[2] ti_cyl_lam_[3] ti_cyl_lam_[4] ti_cyl_lam_[5] ti_cyl_lam_add_[0] ti_cyl_lam_add_[1] ti_cyl_lam_add_[2] ti_cyl_lam_add_[3] ti_cyl_lam_add_[4] ti_cyl_lam_add_[5] ti_cyl_lam_lim_not[0] ti_cyl_lam_lim_not[1] ti_cyl_lam_lim_not[2] ti_cyl_lam_lim_not[3] ti_cyl_lam_lim_not[4] ti_cyl_lam_lim_not[5] fac_cyl_lam_int[0] fac_cyl_lam_int[1] fac_cyl_lam_int[2] fac_cyl_lam_int[3] fac_cyl_lam_int[4] fac_cyl_lam_int[5] fac_cyl_lam[0] fac_cyl_lam[1] fac_cyl_lam[2] fac_cyl_lam[3] fac_cyl_lam[4] fac_cyl_lam[5] lam_cyl_sel_adj_fac[0] lam_cyl_sel_adj_fac[1] lam_cyl_sel_adj_fac[2] lam_cyl_sel_adj_fac[3] lam_cyl_sel_adj_fac[4] lam_cyl_sel_adj_fac[5] lam_cyl_sel_adj_fil[0] lam_cyl_sel_adj_fil[1] lam_cyl_sel_adj_fil[2] lam_cyl_sel_adj_fil[3] lam_cyl_sel_adj_fil[4] lam_cyl_sel_adj_fil[5] delta_lamb_dif_cyl[0] delta_lamb_dif_cyl[1] delta_lamb_dif_cyl[2] delta_lamb_dif_cyl[3] delta_lamb_dif_cyl[4] delta_lamb_dif_cyl[5] delta_lamb_cyl[0] delta_lamb_cyl[1] delta_lamb_cyl[2] delta_lamb_cyl[3] delta_lamb_cyl[4] delta_lamb_cyl[5] crk_cyl_lam[0] crk_cyl_lam[1] crk_cyl_lam[2] crk_cyl_lam[3] crk_cyl_lam[4] crk_cyl_lam[5] lv_cyl_lam_lim_min_0 lv_cyl_lam_lim_min_1 lv_cyl_lam_lim_min_2 lv_cyl_lam_lim_min_3 lv_cyl_lam_lim_min_4 lv_cyl_lam_lim_min_5 lv_cyl_lam_lim_max_0 lv_cyl_lam_lim_max_1 lv_cyl_lam_lim_max_2 lv_cyl_lam_lim_max_3 lv_cyl_lam_lim_max_4 lv_cyl_lam_lim_max_5 lv_lam_cyl_act_2 lv_lam_cyl_act_1 fac_t delta_crk_cyl_lam_1 delta_crk_cyl_lam_2 delta_lamb_err_cyl_sel[0] delta_lamb_err_cyl_sel[1] delta_lamb_err_cyl_sel[2] delta_lamb_err_cyl_sel[3] delta_lamb_err_cyl_sel[4] delta_lamb_err_cyl_sel[5] vls_cyl_sel[0] vls_cyl_sel[1] vls_cyl_sel[2] vls_cyl_sel[3] vls_cyl_sel[4] vls_cyl_sel[5] vls_cyl_sel_cq_1 vls_cyl_sel_cq_2 /end OUT_MEASUREMENT
/end FUNCTION
/begin FUNCTION INJ_Application_Incidences_for_t "_Application Incidences for the Cylinder Individual Lambda Control"
 /begin DEF_CHARACTERISTIC c_maf_lam_cyl_min c_maf_lam_cyl_max c_tco_lam_cyl_min c_n_lam_cyl_min c_n_lam_cyl_max /end DEF_CHARACTERISTIC
 /begin OUT_MEASUREMENT lv_lam_cyl_ena_1 lv_lam_cyl_ena_2 pha_shift_cam_ex_1 pha_shift_cam_ex_2 /end OUT_MEASUREMENT
/end FUNCTION
/begin FUNCTION INJ_Start_Pre_Injection "INJ_Start Pre Injection" /end FUNCTION
/begin FUNCTION INJ_Application_incidences_for_d "_Application incidences for downstream oxygen sensor heater management"
 /begin OUT_MEASUREMENT lam_bank_1.lsh_down_inci.lv_inh_lsh_down lam_bank_1.lsh_down_inci.temp_ls_down_ini lam_bank_2.lsh_down_inci.lv_inh_lsh_down lam_bank_2.lsh_down_inci.temp_ls_down_ini /end OUT_MEASUREMENT
/end FUNCTION
/begin FUNCTION INJ_Application_Incidences_for_D "_Application Incidences for Downstream fuel trim" /end FUNCTION
/begin FUNCTION INJ_MFF_Split_Up_for_DUI_at_Stra "_MFF Split Up for DUI at Stratified Mode" /end FUNCTION
/begin FUNCTION INJ_Application_Incidences_Lambd "_Application Incidences Lambda adaptation" /begin DEF_CHARACTERISTIC c_tia_mff_ad_max c_maf_mff_ad_max c_tco_mff_ad_min /end DEF_CHARACTERISTIC /end FUNCTION
/begin FUNCTION INJ_Application_Incidences_downs "_Application Incidences downstream fuel trim"
 /begin DEF_CHARACTERISTIC id_crlc_vls_down_t_dly lc_delta_lamb_i_ad_ext_adj id_crlc_vls_down_t_dly_cat_diag /end DEF_CHARACTERISTIC
 /begin OUT_MEASUREMENT lv_delta_lamb_i_ad_ext_adj lam_bank_1.lam_dly_inci.bf.lv_inh_lam_dly lam_bank_1.lam_dly_inci.vls_down_av lam_bank_2.lam_dly_inci.bf.lv_inh_lam_dly lam_bank_2.lam_dly_inci.vls_down_av /end OUT_MEASUREMENT
/end FUNCTION
/begin FUNCTION INJ_Injection_Phase_for_Stratifi "_Injection Phase for Stratified Mode" /end FUNCTION
/begin FUNCTION INJ_Application_Incidences_Downs "_Application Incidences Downstream oxygen sensor heater management" /begin DEF_CHARACTERISTIC lc_lsh_down_1 lc_lsh_down_2 /end DEF_CHARACTERISTIC /end FUNCTION
/begin FUNCTION INJ_Restart_function "_Restart function" /begin DEF_CHARACTERISTIC ip_ti_st_rest ip_rest ip_fac_rest ip_fac_stall /end DEF_CHARACTERISTIC /begin OUT_MEASUREMENT ti_st_rest /end OUT_MEASUREMENT /end FUNCTION
/begin FUNCTION INJ_Detection_of_limited_dynamic "_Detection of limited dynamic condition for dynamic fuel trim"
 /begin DEF_CHARACTERISTIC c_maf_crlc_dly c_lam_mv_crlc_dly c_n_dyw_dly c_maf_dyw_dly c_lam_mv_dyw_dly c_n_crlc_dly c_pv_av_grd_dec_dly c_pv_av_grd_sum_max_dly c_pv_av_grd_sum_min_dly c_t_pv_av_grd_dec_sum_dly c_pv_av_grd_min_sum_dly c_maf_int_min_ldc_dly /end DEF_CHARACTERISTIC
 /begin OUT_MEASUREMENT lam_bank_1.lam_dlyl.bf.lv_ldc_dly lam_bank_1.lam_dlyl.bf.lv_lam_mv_ldc_dly lam_bank_1.lam_dlyl.lam_mv_mmv_dly lam_bank_1.lam_dlyl.maf_int_ldc_dly lam_bank_1.lam_dlyl.pv_av_grd_sum_dly lam_bank_2.lam_dlyl.bf.lv_ldc_dly lam_bank_2.lam_dlyl.bf.lv_lam_mv_ldc_dly lam_bank_2.lam_dlyl.lam_mv_mmv_dly lam_bank_2.lam_dlyl.maf_int_ldc_dly lam_bank_2.lam_dlyl.pv_av_grd_sum_dly maf_mmv_dly n_mmv_dly lv_n_ldc_dly lv_maf_ldc_dly /end OUT_MEASUREMENT
/end FUNCTION
/begin FUNCTION INJ_Injection_Pressure_Correctio "_Injection Pressure Correction for Stratified Charge"
 /begin DEF_CHARACTERISTIC c_ti_min_thd c_ti_min ip_prs_inc_cmp ip_fac_ti_prs c_fac_mff_ti_stnd_2 /end DEF_CHARACTERISTIC
/end FUNCTION
/begin FUNCTION INJ_Fuel_mass_setpoint_and_pre_i "_Fuel mass setpoint and pre injection time calculation"
 /begin DEF_CHARACTERISTIC c_cyc_cast_h_prs ip_mff_cst ip_mff_deac_cst ip_fup_min_inj_st c_tco_st_h_prs id_fac_tipr_deac ip_mffpr_cst ip_mffpr_fac_st_es /end DEF_CHARACTERISTIC
 /begin OUT_MEASUREMENT lv_st_h_prs mff_cst lv_mff_cst_fup_act cyc_cast_fup_thd bios_tipr_bas[0] bios_tipr_bas[1] bios_tipr_bas[2] bios_tipr_bas[3] bios_tipr_bas[4] bios_tipr_bas[5] bios_eoi_min_tipr bios_nr_max_tooth_tipr cycnr_cst tipr[0] tipr[1] tipr[2] tipr[3] tipr[4] tipr[5] mffpr mffpr_cst /end OUT_MEASUREMENT
/end FUNCTION
/begin FUNCTION INJ_Injection_at_restart_fuel_fe "_Injection at restart fuel feed"
 /begin DEF_CHARACTERISTIC id_fac_mff_tco_neg_wf id_fac_mff_tco_pos_wf ip_fac_mff_map_wf id_fac_ti_ris id_fac_ti_rpl id_mff_inc_wf id_mff_dec_wf /end DEF_CHARACTERISTIC
 /begin OUT_MEASUREMENT mff_add_reac_cyl[0] mff_add_reac_cyl[1] mff_add_reac_cyl[2] mff_add_reac_cyl[3] mff_add_reac_cyl[4] mff_add_reac_cyl[5] mff_dif_wf[0] mff_dif_wf[1] mff_dif_wf[2] mff_dif_wf[3] mff_dif_wf[4] mff_dif_wf[5] fac_ti_reac[0] fac_ti_reac[1] fac_ti_reac[2] fac_ti_reac[3] fac_ti_reac[4] fac_ti_reac[5] /end OUT_MEASUREMENT
/end FUNCTION
/begin FUNCTION INJ_Application_incidence_exhaus "_Application incidence exhaust gas temperature model"
 /begin OUT_MEASUREMENT teg_1.appl_inc_struct.lamb_sp_teg teg_1.appl_inc_struct.eff_iga_av_teg teg_1.appl_inc_struct.nr_cyl_scc_teg teg_2.appl_inc_struct.lamb_sp_teg teg_2.appl_inc_struct.eff_iga_av_teg teg_2.appl_inc_struct.nr_cyl_scc_teg temp_cat maf_teg maf_int_teg_st maf_kgh_teg n_teg teg_dyn teg_cat_up_mdl_1 teg_cat_up_mdl_2 teg_cat_down_mdl_2 teg_cat_down_mdl_1 /end OUT_MEASUREMENT
/end FUNCTION
/begin FUNCTION INJ_Basic_Lambda_Setpoint_includ "_Basic Lambda Setpoint including Homogeneous Lean Mode"
 /begin DEF_CHARACTERISTIC ip_lamb_bas_wup_cor ip_lamb_hom_afl ip_lamb_bas_1 ip_lamb_bas_2 c_lamb_bas_ofs_cat_diag ip_lamb_afl_1 ip_fac_lamb_wup ip_fac_lamb_wup_is /end DEF_CHARACTERISTIC
 /begin OUT_MEASUREMENT lamb_hom_afl lamb_afl_1 lamb_hom_afs lamb_bas lam_bank_1.lam_bas_sp.lamb_bas_h_res lam_bank_1.lam_bas_sp.lamb_hom_afs_h_res lam_bank_1.lam_bas_sp.lamb_bas lam_bank_1.lam_bas_sp.lamb_hom_afs lam_bank_1.lam_bas_sp.lv_lamb_bas_ofs_cat_diag lam_bank_2.lam_bas_sp.lamb_bas_h_res lam_bank_2.lam_bas_sp.lamb_hom_afs_h_res lam_bank_2.lam_bas_sp.lamb_bas lam_bank_2.lam_bas_sp.lamb_hom_afs lam_bank_2.lam_bas_sp.lv_lamb_bas_ofs_cat_diag /end OUT_MEASUREMENT
/end FUNCTION
/begin FUNCTION INJ_Lambda_Setpoint_for_Single_C "_Lambda Setpoint for Single Cylinder Fuel Shut Off" /begin DEF_CHARACTERISTIC ip_lamb_scc /end DEF_CHARACTERISTIC /begin OUT_MEASUREMENT lam_bank_1.lamb_scc.lamb_scc lam_bank_2.lamb_scc.lamb_scc /end OUT_MEASUREMENT /end FUNCTION
/begin FUNCTION INJ_Application_incidences_for_i "_Application incidences for injection mode management"
 /begin DEF_CHARACTERISTIC c_tco_dui_min_st c_tco_dui_max_st c_tqi_dui_thd c_cyc_cast_dui_thd /end DEF_CHARACTERISTIC
 /begin OUT_MEASUREMENT lv_dui_inj_req lv_ch_s_req lv_t_tqi_swi_supp /end OUT_MEASUREMENT
/end FUNCTION
/begin FUNCTION INJ_Application_incidences_for_s "_Application incidences for some injection functions"
 /begin DEF_CHARACTERISTIC ldp_seg_nr_id_ctr_cyl_nr_clc id_ctr_cyl_nr_clc c_seg_nr_st_clc_red c_n_32_thd_clc_red c_n_32_hys_clc_red /end DEF_CHARACTERISTIC
 /begin OUT_MEASUREMENT state_clc_red ctr_cyl_nr_clc ctr_cbk_nr_clc /end OUT_MEASUREMENT
/end FUNCTION
/begin FUNCTION INJ_Downstream_oxygen_sensor_ope "_Downstream oxygen sensor operative readiness detection"
 /begin DEF_CHARACTERISTIC c_temp_cat_down_ls_ready c_vls_down_afl_ready c_vls_down_afr_ready c_maf_int_puc_max_down_ls_ready /end DEF_CHARACTERISTIC
/end FUNCTION
/begin FUNCTION INJ_Conditioning_of_catalyst_O2_ "_Conditioning of catalyst O2 loading"
 /begin DEF_CHARACTERISTIC lc_maf_int_max_o2l_mdl_ini_2 lc_lamb_sp_ref_o2l_mdl_2 lc_lamb_sp_ref_o2l_mdl_1 c_maf_int_max_o2l_mdl_ini_2 c_lamb_sp_ref_o2l_mdl_1 c_lamb_sp_ref_o2l_mdl_2 c_vls_down_thd_afr_o2l_mdl c_vls_down_thd_afl_o2l_mdl c_vls_down_thd_o2l_ad c_fac_maf_int_o2l_mdl_puc c_fac_add_maf_int_o2l_mdl_afr c_fac_add_maf_int_o2l_mdl_afl c_fac_add_maf_int_o2l_mdl_pue c_crlc_maf_int_o2l_max_ad_vls c_crlc_maf_int_o2l_max_ad_pue c_maf_int_min_o2l_mdl_ad_pue c_crlc_maf_int_mmv_o2l_mdl ip_delta_lamb_sp_o2l_mdl ip_fac_maf_int_o2l_mdl c_crlc_maf_int_o2l_max_ad_max c_crlc_maf_int_o2l_max_ad_min c_delta_lamb_cor_add_o2l_mdl_1 c_delta_lamb_cor_add_o2l_mdl_2 lc_maf_int_max_o2l_mdl_ini_1 c_maf_int_max_o2l_mdl_ini_1 c_maf_int_puc_min_o2l_mdl_act c_crlc_vls_down_mmv_o2l_mdl c_crlc_delta_lamb_cor_o2l_mdl lc_delta_lamb_cor_o2l_mdl_1 lc_delta_lamb_cor_o2l_mdl_2 /end DEF_CHARACTERISTIC
 /begin OUT_MEASUREMENT lam_bank_1.lam_o2l.delta_lamb_sp_o2l_mdl lam_bank_1.lam_o2l.maf_int_efc_o2l_mdl lam_bank_1.lam_o2l.maf_int_o2l_mdl lam_bank_1.lam_o2l.maf_int_max_o2l_mdl lam_bank_1.lam_o2l.maf_int_sample_step_o2l_mdl lam_bank_1.lam_o2l.maf_int_mmv_o2l_mdl lam_bank_1.lam_o2l.quo_maf_int_efc_o2l_mdl lam_bank_1.lam_o2l.fac_maf_int_o2l_mdl lam_bank_1.lam_o2l.fac_add_maf_int_o2l_mdl lam_bank_1.lam_o2l.vls_down_mmv_o2l_mdl lam_bank_1.lam_o2l.bf.lv_vls_down_thd_afr_o2l_mdl lam_bank_1.lam_o2l.bf.lv_vls_down_thd_afl_o2l_mdl lam_bank_1.lam_o2l.bf.lv_pue_o2l_mdl lam_bank_1.lam_o2l.bf.lv_maf_int_o2l_mdl_clc_act lam_bank_1.lam_o2l.lamb_sp_ref_o2l_mdl lam_bank_1.lam_o2l.delta_lamb_cor_o2l_mdl lam_bank_2.lam_o2l.delta_lamb_sp_o2l_mdl lam_bank_2.lam_o2l.maf_int_efc_o2l_mdl lam_bank_2.lam_o2l.maf_int_o2l_mdl lam_bank_2.lam_o2l.maf_int_max_o2l_mdl lam_bank_2.lam_o2l.maf_int_sample_step_o2l_mdl lam_bank_2.lam_o2l.maf_int_mmv_o2l_mdl lam_bank_2.lam_o2l.quo_maf_int_efc_o2l_mdl lam_bank_2.lam_o2l.fac_maf_int_o2l_mdl lam_bank_2.lam_o2l.fac_add_maf_int_o2l_mdl lam_bank_2.lam_o2l.vls_down_mmv_o2l_mdl lam_bank_2.lam_o2l.bf.lv_vls_down_thd_afr_o2l_mdl lam_bank_2.lam_o2l.bf.lv_vls_down_thd_afl_o2l_mdl lam_bank_2.lam_o2l.bf.lv_pue_o2l_mdl lam_bank_2.lam_o2l.bf.lv_maf_int_o2l_mdl_clc_act lam_bank_2.lam_o2l.lamb_sp_ref_o2l_mdl lam_bank_2.lam_o2l.delta_lamb_cor_o2l_mdl /end OUT_MEASUREMENT
/end FUNCTION
/end MODULE
/end PROJECT
