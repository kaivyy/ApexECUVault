ASAP2_VERSION 1 31
/begin PROJECT MS45 "BMW Motorsteuerung R6"
/begin HEADER "_default_HeaderComment" PROJECT_NO _52 /end HEADER
/begin MODULE _default_ModuleName "_default_ModuleLongIdentifier"
/begin MOD_COMMON "_default_ModCommonComment" DEPOSIT ABSOLUTE BYTE_ORDER MSB_FIRST ALIGNMENT_BYTE 1 ALIGNMENT_WORD 2 ALIGNMENT_LONG 4 ALIGNMENT_FLOAT32_IEEE 4 ALIGNMENT_FLOAT64_IEEE 8 /end MOD_COMMON
/begin CHARACTERISTIC ID_ERR_ENVD_IMOB_1 "" CURVE 0x41006 _REC_CUR_20_u1_u1 255. _CNV_A_R_LINEAR_____12_CM 0. 255. FORMAT "%2.0"
 /begin AXIS_DESCR COM_AXIS ONLINE_DUMMY _CNV_A_R_LINEAR_____12_CM 4 0. 3. FORMAT "%2.0" AXIS_PTS_REF ldp_fmy_envd /end AXIS_DESCR
/end CHARACTERISTIC
/begin CHARACTERISTIC ID_ERR_ENVD_IMOB_2 "" CURVE 0x41018 _REC_CUR_20_u1_u1 255. _CNV_A_R_LINEAR_____12_CM 0. 255. FORMAT "%2.0"
 /begin AXIS_DESCR COM_AXIS ONLINE_DUMMY _CNV_A_R_LINEAR_____12_CM 4 0. 3. FORMAT "%2.0" AXIS_PTS_REF ldp_fmy_envd /end AXIS_DESCR
/end CHARACTERISTIC
/begin CHARACTERISTIC ID_ERR_ENVD_IMOB_3 "" CURVE 0x4102a _REC_CUR_20_u1_u1 255. _CNV_A_R_LINEAR_____12_CM 0. 255. FORMAT "%2.0"
 /begin AXIS_DESCR COM_AXIS ONLINE_DUMMY _CNV_A_R_LINEAR_____12_CM 4 0. 3. FORMAT "%2.0" AXIS_PTS_REF ldp_fmy_envd /end AXIS_DESCR
/end CHARACTERISTIC
/begin MEASUREMENT V_DMTL "???" UWORD _CNV_A_R_LINEAR_____33_CM 1 100. 0. 4.99511719 ECU_ADDRESS 0x3fccde FORMAT "%5.3" /end MEASUREMENT
/begin MEASUREMENT V_SOF_SWI "???" UWORD _CNV_A_R_LINEAR_____33_CM 1 100. 0. 4.99511719 ECU_ADDRESS 0x3fcce6 FORMAT "%5.3" /end MEASUREMENT
/begin CHARACTERISTIC C_AMP_DMTL_MAX "lower altitude threshold for DMTL function / upper ambient pressure for DMTL function" VALUE 0x42c20 _REC_VAL_20_u2 5434.25976563 _CNV_A_R_LINEAR_____149_CM 0. 5434.25976563 FORMAT "%7.2" /end CHARACTERISTIC
/begin CHARACTERISTIC C_COD_2_DMTL "2nd  application code word of DMTL function" VALUE 0x4280e _REC_VAL_20_u1 255. _CNV_A_R_LINEAR_____10_CM 0. 255. FORMAT "%3.0" /end CHARACTERISTIC
/begin CHARACTERISTIC C_COD_DMTL "Calibrationconstant" VALUE 0x4280f _REC_VAL_20_u1 255. _CNV_A_R_LINEAR_____10_CM 0. 255. FORMAT "%3.0" /end CHARACTERISTIC
/begin CHARACTERISTIC C_CRLC_CUR_DMTL_FIL "Time constant of pump current filtering" VALUE 0x42c62 _REC_VAL_20_u2 0.99998474 _CNV_A_R_LINEAR_____31_CM 0. 0.99998474 FORMAT "%7.5" /end CHARACTERISTIC
/begin CHARACTERISTIC C_CRLC_CUR_DMTL_FIL_LIM "Time constant at the beginning of pump current filtering" VALUE 0x42c64 _REC_VAL_20_u2 0.99998474 _CNV_A_R_LINEAR_____31_CM 0. 0.99998474 FORMAT "%7.5" /end CHARACTERISTIC
/begin CHARACTERISTIC C_CRLC_CUR_DMTL_FIL_REFU "Correlation constant at the beginning of pump current filtering" VALUE 0x42c66 _REC_VAL_20_u2 0.99998474 _CNV_A_R_LINEAR_____31_CM 0. 0.99998474 FORMAT "%7.5" /end CHARACTERISTIC
/begin CHARACTERISTIC C_CRLC_VB_DMTL_FIL "Time constant of VB filtering" VALUE 0x42c92 _REC_VAL_20_u2 0.99998474 _CNV_A_R_LINEAR_____31_CM 0. 0.99998474 FORMAT "%7.5" /end CHARACTERISTIC
/begin CHARACTERISTIC C_CRLC_VB_DMTL_FIL_LIM "Time constant at the beginning of VB filtering" VALUE 0x42c94 _REC_VAL_20_u2 0.99998474 _CNV_A_R_LINEAR_____31_CM 0. 0.99998474 FORMAT "%7.5" /end CHARACTERISTIC
/begin CHARACTERISTIC C_CUR_DMTL_COR_FIL_OFS_AMP "Pump current offset in case of ambient pressure" VALUE 0x43232 _REC_VAL_20_s2 399.9938 _CNV_A_R_LINEAR_____150_CM -200. 199.9938 FORMAT "%8.3" /end CHARACTERISTIC
/begin CHARACTERISTIC C_CUR_DMTL_DIF_CUR_DMTL_STAT "Delta pump current for pump current" VALUE 0x42ca4 _REC_VAL_20_u2 400. _CNV_A_R_LINEAR_____151_CM 0. 400. FORMAT "%7.3" /end CHARACTERISTIC
/begin CHARACTERISTIC C_CUR_DMTL_REF_LEAK_MAX "upper threshold of pump current for reference measurement" VALUE 0x42caa _REC_VAL_20_u2 400. _CNV_A_R_LINEAR_____151_CM 0. 400. FORMAT "%7.3" /end CHARACTERISTIC
/begin CHARACTERISTIC C_CUR_DMTL_REF_LEAK_MIN "lower threshold of pump current for reference measurement" VALUE 0x42cac _REC_VAL_20_u2 400. _CNV_A_R_LINEAR_____151_CM 0. 400. FORMAT "%7.3" /end CHARACTERISTIC
/begin CHARACTERISTIC C_CUR_DMTL_REF_OFS "Reference pump current offset" VALUE 0x42cae _REC_VAL_20_u2 400. _CNV_A_R_LINEAR_____151_CM 0. 400. FORMAT "%7.3" /end CHARACTERISTIC
/begin CHARACTERISTIC C_ENA_FCO_DIAG "Threshold consumed fuel for diagnosis enable" VALUE 0x42cf0 _REC_VAL_20_u2 4294.9 _CNV_A_R_LINEAR_____152_CM 0. 4294.9 FORMAT "%7.2" /end CHARACTERISTIC
/begin CHARACTERISTIC C_FCO_DIAG_MAX "Upper tolerance variable for level sensor diagnosis" VALUE 0x43341 _REC_VAL_20_s1 255. _CNV_A_R_LINEAR_____85_CM -128. 127. FORMAT "%4.0" /end CHARACTERISTIC
/begin CHARACTERISTIC C_FCO_DIAG_MIN "Lower tolerance variable for level sensor diagnosis" VALUE 0x43342 _REC_VAL_20_s1 255. _CNV_A_R_LINEAR_____85_CM -128. 127. FORMAT "%4.0" /end CHARACTERISTIC
/begin CHARACTERISTIC C_FTL_DEC_FTL_DIAG_MIN "minimum level decrease for refueling detection" VALUE 0x43343 _REC_VAL_20_s1 255. _CNV_A_R_LINEAR_____85_CM -128. 127. FORMAT "%4.0" /end CHARACTERISTIC
/begin CHARACTERISTIC C_FTL_DIAG_MAX "maximum tank level" VALUE 0x42d80 _REC_VAL_20_u2 126. _CNV_A_R_LINEAR_____153_CM 0. 126. FORMAT "%6.2" /end CHARACTERISTIC
/begin CHARACTERISTIC C_FTL_DIAG_MIN "minimum fuel tank volume for refueling detection" VALUE 0x43344 _REC_VAL_20_s1 255. _CNV_A_R_LINEAR_____85_CM -128. 127. FORMAT "%4.0" /end CHARACTERISTIC
/begin CHARACTERISTIC C_FTL_DMTL_MAX "max. tank level for DMTL function" VALUE 0x428c9 _REC_VAL_20_u1 5.04 _CNV_A_R_LINEAR_____85_CM 0. 126. FORMAT "%3.0" /end CHARACTERISTIC
/begin CHARACTERISTIC C_FTL_DMTL_MIN "min. tank level for DMTL function" VALUE 0x428ca _REC_VAL_20_u1 5.04 _CNV_A_R_LINEAR_____85_CM 0. 126. FORMAT "%3.0" /end CHARACTERISTIC
/begin CHARACTERISTIC C_HYS_FTL_DMTL "hysteresis for tank level bit for DMTL function" VALUE 0x428d0 _REC_VAL_20_u1 5.04 _CNV_A_R_LINEAR_____85_CM 0. 126. FORMAT "%3.0" /end CHARACTERISTIC
/begin CHARACTERISTIC C_R_DMTL "Resistance of pump current measurement" VALUE 0x4299c _REC_VAL_20_u1 50. _CNV_A_R_LINEAR_____154_CM 0. 50. /end CHARACTERISTIC
/begin CHARACTERISTIC C_SUM_ENA_ROUGH_LEAK_MAX "maximum number of ENABLES satisfied for rough leak check" VALUE 0x429ac _REC_VAL_20_u1 255. _CNV_A_R_LINEAR_____10_CM 0. 255. FORMAT "%3.0" /end CHARACTERISTIC
/begin CHARACTERISTIC C_SUM_ENA_ROUGH_LEAK_TEST_MAX "max. number of miniature leak checks after refueling" VALUE 0x429ad _REC_VAL_20_u1 255. _CNV_A_R_LINEAR_____10_CM 0. 255. FORMAT "%3.0" /end CHARACTERISTIC
/begin CHARACTERISTIC C_SUM_ENA_SMALL_LEAK_TEST_MAX "max. number of rough leak checks for miniature leak check" VALUE 0x429ae _REC_VAL_20_u1 255. _CNV_A_R_LINEAR_____10_CM 0. 255. FORMAT "%3.0" /end CHARACTERISTIC
/begin CHARACTERISTIC C_SUM_REP_ROUGH_LEAK_MES_FUC_MAX "maximum number of repeated check filler cap checks" VALUE 0x429b0 _REC_VAL_20_u1 255. _CNV_A_R_LINEAR_____10_CM 0. 255. FORMAT "%3.0" /end CHARACTERISTIC
/begin CHARACTERISTIC C_T_CUR_DMTL_ROUGH_LEAK_MAX "max. time pump current check in rough leak phase" VALUE 0x42f66 _REC_VAL_20_u2 6553.5 _CNV_A_R_LINEAR_____14_CM 0. 6553.5 FORMAT "%6.1" /end CHARACTERISTIC
/begin CHARACTERISTIC C_T_CUR_DMTL_ROUGH_LEAK_MIN "min. time pump current check in rough leak phase" VALUE 0x42f68 _REC_VAL_20_u2 6553.5 _CNV_A_R_LINEAR_____14_CM 0. 6553.5 FORMAT "%6.1" /end CHARACTERISTIC
/begin CHARACTERISTIC C_T_CUR_DMTL_STAT "Time for pump current stable" VALUE 0x42f6a _REC_VAL_20_u2 6553.5 _CNV_A_R_LINEAR_____14_CM 0. 6553.5 FORMAT "%6.1" /end CHARACTERISTIC
/begin CHARACTERISTIC C_T_DLY_CUR_DMTL_DIF_MES "Current decrease detection delay during measurement" VALUE 0x42f80 _REC_VAL_20_u2 6553.5 _CNV_A_R_LINEAR_____14_CM 0. 6553.5 FORMAT "%6.1" /end CHARACTERISTIC
/begin CHARACTERISTIC C_T_DLY_DET_REFU "Wait period of refueling detection" VALUE 0x42f82 _REC_VAL_20_u2 655.35 _CNV_A_R_LINEAR_____27_CM 0. 655.35 FORMAT "%6.2" /end CHARACTERISTIC
/begin CHARACTERISTIC C_T_DLY_DMTLS "Waiting time after change-over of solenoid valve" VALUE 0x429d8 _REC_VAL_20_u1 25.5 _CNV_A_R_LINEAR_____14_CM 0. 25.5 FORMAT "%4.1" /end CHARACTERISTIC
/begin CHARACTERISTIC C_T_DLY_ES_PWL "Post-operating wait period until start of DMTL function" VALUE 0x429da _REC_VAL_20_u1 25.5 _CNV_A_R_LINEAR_____14_CM 0. 25.5 FORMAT "%4.1" /end CHARACTERISTIC
/begin CHARACTERISTIC C_T_DLY_FUC_CAN_OFF "Delay time with which Check filler Cap - light is switched off" VALUE 0x429dc _REC_VAL_20_u1 25.5 _CNV_A_R_LINEAR_____14_CM 0. 25.5 FORMAT "%4.1" /end CHARACTERISTIC
/begin CHARACTERISTIC C_T_DLY_FUC_CAN_ON "Delay time with which Check filler Cap - light is switched on" VALUE 0x429dd _REC_VAL_20_u1 25.5 _CNV_A_R_LINEAR_____14_CM 0. 25.5 FORMAT "%4.1" /end CHARACTERISTIC
/begin CHARACTERISTIC C_T_DLY_IGK_FTL "Minimum time for which LV_IGK must be = 1 to issue a validated level" VALUE 0x429e1 _REC_VAL_20_u1 1.02 _CNV_A_R_LINEAR_____14_CM 0. 25.5 FORMAT "%4.1" /end CHARACTERISTIC
/begin CHARACTERISTIC C_T_DLY_REQ_PWL_DMTL "Post-operating time after no request for extending the post-operating phase is present any longer" VALUE 0x429f3 _REC_VAL_20_u1 25.5 _CNV_A_R_LINEAR_____14_CM 0. 25.5 FORMAT "%4.1" /end CHARACTERISTIC
/begin CHARACTERISTIC C_T_DMTL_EOL_MAX "Max. time for end of line diagnosis after test unit initiation" VALUE 0x42fb6 _REC_VAL_20_u2 6553.5 _CNV_A_R_LINEAR_____14_CM 0. 6553.5 FORMAT "%6.1" /end CHARACTERISTIC
/begin CHARACTERISTIC C_T_DMTL_MAX "Maximum time for DMTL diagnosis" VALUE 0x42fb8 _REC_VAL_20_u2 6553.5 _CNV_A_R_LINEAR_____14_CM 0. 6553.5 FORMAT "%6.1" /end CHARACTERISTIC
/begin CHARACTERISTIC C_T_ES_DMTL_MIN "minimum shut-off time for tank leakage diagnosis" VALUE 0x42fd8 _REC_VAL_20_u2 65535. _CNV_A_R_LINEAR_____35_CM 0. 65535. FORMAT "%5.0" /end CHARACTERISTIC
/begin CHARACTERISTIC C_T_ES_SUB_DMTL "Substitute shut-off time for tank leakage diagnosis" VALUE 0x42fde _REC_VAL_20_u2 65535. _CNV_A_R_LINEAR_____35_CM 0. 65535. FORMAT "%5.0" /end CHARACTERISTIC
/begin CHARACTERISTIC C_T_REF_LEAK_MES_MAX "Time for reference leakage measurement" VALUE 0x43022 _REC_VAL_20_u2 6553.5 _CNV_A_R_LINEAR_____14_CM 0. 6553.5 FORMAT "%6.1" /end CHARACTERISTIC
/begin CHARACTERISTIC C_T_REF_LEAK_MES_REP_MAX "Time for repeat reference leakage measurement" VALUE 0x43024 _REC_VAL_20_u2 6553.5 _CNV_A_R_LINEAR_____14_CM 0. 6553.5 FORMAT "%6.1" /end CHARACTERISTIC
/begin CHARACTERISTIC C_T_VB_DLY_DMTL "Time delay for Vbat monitoring" VALUE 0x4304a _REC_VAL_20_u2 6553.5 _CNV_A_R_LINEAR_____14_CM 0. 6553.5 FORMAT "%6.1" /end CHARACTERISTIC
/begin CHARACTERISTIC C_TAM_DMTL_MIN "lower temperature threshold for the DMTL function" VALUE 0x42a35 _REC_VAL_20_u1 190.5 _CNV_A_R_LINEAR_____0_CM -48. 142.5 FORMAT "%5.1" /end CHARACTERISTIC
/begin CHARACTERISTIC C_TCO_ST_DMTL_MIN "min. TCO_ST for DMTL enable" VALUE 0x42a7a _REC_VAL_20_u1 190.5 _CNV_A_R_LINEAR_____0_CM -48. 142.5 FORMAT "%5.1" /end CHARACTERISTIC
/begin CHARACTERISTIC C_TRT_DMTL_EOL_MAX "" VALUE 0x4336c _REC_VAL_20_u4 119304.6471 _CNV_A_R_LINEAR_____155_CM 0. 119304.6471 FORMAT "%12.5" /end CHARACTERISTIC
/begin CHARACTERISTIC C_VB_DMTL_ASA_MAX "Maximum battery threshold at end of line for DMTL" VALUE 0x42b01 _REC_VAL_20_u1 26. _CNV_A_R_LINEAR_____53_CM 0. 26. FORMAT "%4.1" /end CHARACTERISTIC
/begin CHARACTERISTIC C_VB_DMTL_ASA_MIN "Minimum battery threshold at end of line for DMTL" VALUE 0x42b02 _REC_VAL_20_u1 26. _CNV_A_R_LINEAR_____53_CM 0. 26. FORMAT "%4.1" /end CHARACTERISTIC
/begin CHARACTERISTIC C_VB_DMTL_DIF "Delta VB threshold for DMTL" VALUE 0x43156 _REC_VAL_20_u2 26. _CNV_A_R_LINEAR_____156_CM 0. 26. FORMAT "%7.4" /end CHARACTERISTIC
/begin CHARACTERISTIC C_VB_DMTL_MAX "maximum battery threshold for the DMTL function" VALUE 0x42b03 _REC_VAL_20_u1 26. _CNV_A_R_LINEAR_____53_CM 0. 26. FORMAT "%4.1" /end CHARACTERISTIC
/begin CHARACTERISTIC C_VB_DMTL_MIN "minimum battery threshold for the DMTL function" VALUE 0x42b04 _REC_VAL_20_u1 26. _CNV_A_R_LINEAR_____53_CM 0. 26. FORMAT "%4.1" /end CHARACTERISTIC
/begin CHARACTERISTIC C_VS_FTL_DIAG_MAX "" VALUE 0x42b23 _REC_VAL_20_u1 255. _CNV_A_R_LINEAR_____13_CM 0. 255. FORMAT "%3.0" /end CHARACTERISTIC
/begin MEASUREMENT CTR_CNL_ROUGH_LEAK_MES_FUC "Number of aborted check filler cap checks" UBYTE _CNV_A_R_LINEAR_____10_CM 1 100. 0. 255. ECU_ADDRESS 0x3fd00a FORMAT "%3.0" /end MEASUREMENT
/begin MEASUREMENT CTR_CNL_SMALL_LEAK_MES "Number of aborted miniature leak measurements due to current fluctuations" UBYTE _CNV_A_R_LINEAR_____10_CM 1 100. 0. 255. ECU_ADDRESS 0x3fd00b FORMAT "%3.0" /end MEASUREMENT
/begin MEASUREMENT CTR_CUR_DMTL_REF_DIF_MAX "Number of aborted measurements due to current fluctuation" UWORD _CNV_A_R_LINEAR_____10_CM 1 100. 0. 65535. ECU_ADDRESS 0x3fcfe0 FORMAT "%5.0" /end MEASUREMENT
/begin MEASUREMENT CTR_DMTL_ACT "Number of commenced leakage measurements" UWORD _CNV_A_R_LINEAR_____10_CM 1 100. 0. 65535. ECU_ADDRESS 0x3fcfe2 FORMAT "%5.0" /end MEASUREMENT
/begin MEASUREMENT CTR_REP_ROUGH_LEAK_MES_FUC "Number of repeated check filler cap checks" UBYTE _CNV_A_R_LINEAR_____10_CM 1 100. 0. 255. ECU_ADDRESS 0x3fd00f FORMAT "%3.0" /end MEASUREMENT
/begin MEASUREMENT CTR_ROUGH_LEAK_MES "Number of realized rough leak diagnosis" UWORD _CNV_A_R_LINEAR_____10_CM 1 100. 0. 65535. ECU_ADDRESS 0x3fcfe4 FORMAT "%5.0" /end MEASUREMENT
/begin MEASUREMENT CTR_SMALL_LEAK_MES "Number of realized miniature leak diagnosis" UWORD _CNV_A_R_LINEAR_____10_CM 1 100. 0. 65535. ECU_ADDRESS 0x3fcfe6 FORMAT "%5.0" /end MEASUREMENT
/begin MEASUREMENT CUR_DMTL "Pump current tank leakage diagnosis" UWORD _CNV_A_R_LINEAR_____151_CM 1 100. 0. 400. ECU_ADDRESS 0x3fcfe8 FORMAT "%7.3" /end MEASUREMENT
/begin MEASUREMENT CUR_DMTL_COMP_ROUGH_LEAK "Pump current comparision in case of rough leak measurement" UWORD _CNV_A_R_LINEAR_____151_CM 1 100. 0. 400. ECU_ADDRESS 0x3fe5c4 FORMAT "%7.3" /end MEASUREMENT
/begin MEASUREMENT CUR_DMTL_COMP_SMALL_LEAK_LEN "Pump current comparision in case of 2. miniature leak measurement" UWORD _CNV_A_R_LINEAR_____151_CM 1 100. 0. 400. ECU_ADDRESS 0x3fe5c6 FORMAT "%7.3" /end MEASUREMENT
/begin MEASUREMENT CUR_DMTL_COR_FIL_MAX "Maximum pump current during reference leka measurement" UWORD _CNV_A_R_LINEAR_____151_CM 1 100. 0. 400. ECU_ADDRESS 0x3fe5ca FORMAT "%7.3" /end MEASUREMENT
/begin MEASUREMENT CUR_DMTL_COR_FIL_MIN "Minimum pump current during reference leak  measurement" UWORD _CNV_A_R_LINEAR_____151_CM 1 100. 0. 400. ECU_ADDRESS 0x3fe5ce FORMAT "%7.3" /end MEASUREMENT
/begin MEASUREMENT CUR_DMTL_COR_FIL_REFU_HPF "corrected, high-pass filtered pump current" SWORD _CNV_A_R_LINEAR_____150_CM 1 100. -200. 199.9938 ECU_ADDRESS 0x3fe5c0 FORMAT "%8.3" /end MEASUREMENT
/begin MEASUREMENT CUR_DMTL_DIF "Differential pump current" UWORD _CNV_A_R_LINEAR_____151_CM 1 100. 0. 400. ECU_ADDRESS 0x3fe5d0 FORMAT "%7.3" /end MEASUREMENT
/begin MEASUREMENT CUR_DMTL_DIF_REF_ROUGH_LEAK "Difference, pump current  between reference and min. in case of rough leak check" UWORD _CNV_A_R_LINEAR_____151_CM 1 100. 0. 400. ECU_ADDRESS 0x3fcfea FORMAT "%7.3" /end MEASUREMENT
/begin MEASUREMENT CUR_DMTL_REF_LEAK "Pump current reference leakage" UWORD _CNV_A_R_LINEAR_____151_CM 1 100. 0. 400. ECU_ADDRESS 0x3fcfee FORMAT "%7.3" /end MEASUREMENT
/begin MEASUREMENT CUR_DMTL_ROUGH_LEAK_LEN_END "Pump current at the end of the rough leak measurement extension" UWORD _CNV_A_R_LINEAR_____151_CM 1 100. 0. 400. ECU_ADDRESS 0x3fe5d8 FORMAT "%7.3" /end MEASUREMENT
/begin MEASUREMENT CUR_DMTL_ROUGH_LEAK_MIN "Min. pump current in case of rough leak measurement" UWORD _CNV_A_R_LINEAR_____151_CM 1 100. 0. 400. ECU_ADDRESS 0x3fcff2 FORMAT "%7.3" /end MEASUREMENT
/begin MEASUREMENT CUR_DMTL_THD_ROUGH_LEAK_LEN "Pump current threshold in case of rough leak measurement extension" UWORD _CNV_A_R_LINEAR_____151_CM 1 100. 0. 400. ECU_ADDRESS 0x3fe5e0 FORMAT "%7.3" /end MEASUREMENT
/begin MEASUREMENT FCO_AV_DMTL "currently consumed fuel" UWORD _CNV_A_R_LINEAR_____152_CM 1 100. 0. 4294.9 ECU_ADDRESS 0x3fcff6 FORMAT "%7.2" /end MEASUREMENT
/begin MEASUREMENT STATE_DMTL "DMTL state" UBYTE _CNV_S_13_STATE_DMTL_157_CM 1 100. 0. 12. ECU_ADDRESS 0x3fd016 /end MEASUREMENT
/begin MEASUREMENT T_ACT_CUR_DMTL_STAT "Current time, pump current stable" UWORD _CNV_A_R_LINEAR_____14_CM 1 100. 0. 6553.5 ECU_ADDRESS 0x3fe5e4 FORMAT "%6.1" /end MEASUREMENT
/begin MEASUREMENT T_ACT_LEAK_MES "Current time, leakage measurement" UWORD _CNV_A_R_LINEAR_____14_CM 1 100. 0. 6553.5 ECU_ADDRESS 0x3fd002 FORMAT "%6.1" /end MEASUREMENT
/begin MEASUREMENT T_ACT_REF_LEAK_MES "Current time, reference leakage measurement" UWORD _CNV_A_R_LINEAR_____14_CM 1 100. 0. 6553.5 ECU_ADDRESS 0x3fe5e6 FORMAT "%6.1" /end MEASUREMENT
/begin MEASUREMENT T_ES_DMTL "Engine off duration time for the DMTL-function" UWORD _CNV_A_R_LINEAR_____35_CM 1 100. 0. 65535. ECU_ADDRESS 0x3fe5f0 FORMAT "%5.0" /end MEASUREMENT
/begin MEASUREMENT CUR_DMTL_DMTLS_TEST "pump current during pump test" UWORD _CNV_A_R_LINEAR_____151_CM 1 100. 0. 400. ECU_ADDRESS 0x3fe5d2 FORMAT "%7.3" /end MEASUREMENT
/begin MEASUREMENT CUR_DMTL_THD_ROUGH_LEAK "Pump current threshold in case of rough leak measurement" UWORD _CNV_A_R_LINEAR_____151_CM 1 100. 0. 400. ECU_ADDRESS 0x3fe5de FORMAT "%7.3" /end MEASUREMENT
/begin MEASUREMENT CUR_DMTL_THD_DMTLS_TEST "Pump current threshold in case of DMTL valve check" UWORD _CNV_A_R_LINEAR_____151_CM 1 100. 0. 400. ECU_ADDRESS 0x3fe5dc FORMAT "%7.3" /end MEASUREMENT
/begin CHARACTERISTIC C_T_AST_DMTL_MAX "min. post-starting period for canister purge diagnosis" VALUE 0x42f58 _REC_VAL_20_u2 6553.2 _CNV_A_R_LINEAR_____14_CM 0.3 6553.5 FORMAT "%6.1" /end CHARACTERISTIC
/begin CHARACTERISTIC C_T_ACT_ROUGH_LEAK "Time for rough leak measurement" VALUE 0x42f50 _REC_VAL_20_u2 6553.2 _CNV_A_R_LINEAR_____14_CM 0.3 6553.5 FORMAT "%6.1" /end CHARACTERISTIC
/begin CHARACTERISTIC C_T_ACT_SMALL_LEAK "Time for miniature leak measurement" VALUE 0x42f52 _REC_VAL_20_u2 6553.2 _CNV_A_R_LINEAR_____14_CM 0.3 6553.5 FORMAT "%6.1" /end CHARACTERISTIC
/begin CHARACTERISTIC IP_T_ACT_SMALL_LEAK__FTL "Time for miniature leak measurement" CURVE 0x4a4ca _REC_CUR_20_u2_u1 655.35 _CNV_A_R_LINEAR_____14_CM 0. 6553.5 FORMAT "%6.1"
 /begin AXIS_DESCR COM_AXIS FTL _CNV_A_R_LINEAR_____85_CM 5 0. 126. FORMAT "%3.0" AXIS_PTS_REF ldp_ftl__t_small_leak_test /end AXIS_DESCR
/end CHARACTERISTIC
/begin CHARACTERISTIC IP_FAC_CUR_DMTL_ROUGH "Factor delta pump current for rough leak detection" CURVE 0x47500 _REC_CUR_20_u2_u2 0.99998474 _CNV_A_R_LINEAR_____31_CM 0. 0.99998474 FORMAT "%7.5"
 /begin AXIS_DESCR COM_AXIS CUR_DMTL_DIF_REF_ROUGH_LEAK _CNV_A_R_LINEAR_____151_CM 8 0. 400. FORMAT "%7.3" AXIS_PTS_REF ldpm_cur_dmtldifrefroughleak_1 /end AXIS_DESCR
/end CHARACTERISTIC
/begin CHARACTERISTIC IP_FAC_CUR_DMTL_REF "Factor delta pump current for rouh leak detection concerning reference" CURVE 0x474f0 _REC_CUR_20_u2_u2 0.99998474 _CNV_A_R_LINEAR_____31_CM 0. 0.99998474 FORMAT "%7.5"
 /begin AXIS_DESCR COM_AXIS CUR_DMTL_DIF_REF_ROUGH_LEAK _CNV_A_R_LINEAR_____151_CM 8 0. 400. FORMAT "%7.3" AXIS_PTS_REF ldpm_cur_dmtldifrefroughleak_1 /end AXIS_DESCR
/end CHARACTERISTIC
/begin CHARACTERISTIC IP_T_CUR_DMTL_STAT "Time for pump current stable" MAP 0x4a5ec _REC_MAP_20_u2_u2_u1 655.35 _CNV_A_R_LINEAR_____14_CM 0. 6553.5 FORMAT "%6.1"
 /begin AXIS_DESCR COM_AXIS CUR_DMTL_DIF_REF_ROUGH_LEAK _CNV_A_R_LINEAR_____151_CM 8 0. 400. FORMAT "%7.3" AXIS_PTS_REF ldpm_cur_dmtldifrefroughleak_1 /end AXIS_DESCR
 /begin AXIS_DESCR COM_AXIS FTL _CNV_A_R_LINEAR_____85_CM 8 0. 126. FORMAT "%3.0" AXIS_PTS_REF ldp_ftl__t_cur_dmtl_stat /end AXIS_DESCR
/end CHARACTERISTIC
/begin CHARACTERISTIC C_T_REF_TEST_ROUGH_LEAK "Time for reference test in case of rough leak check" VALUE 0x43026 _REC_VAL_20_u2 6553.5 _CNV_A_R_LINEAR_____14_CM 0. 6553.5 FORMAT "%6.1" /end CHARACTERISTIC
/begin CHARACTERISTIC C_FAC_T_CUR_DMTL_STAT_LEN "Factor for 2. stabilization" VALUE 0x42d26 _REC_VAL_20_u2 0.99997 _CNV_A_R_LINEAR_____158_CM 0. 0.99997 FORMAT "%8.6" /end CHARACTERISTIC
/begin MEASUREMENT CUR_DMTL_COR "Corrected pump current" UWORD _CNV_A_R_LINEAR_____151_CM 1 100. 0. 400. ECU_ADDRESS 0x3fe5c8 FORMAT "%7.3" /end MEASUREMENT
/begin MEASUREMENT CUR_DMTL_COR_FIL "corrected and filtered pump current" UWORD _CNV_A_R_LINEAR_____151_CM 1 100. 0. 400. ECU_ADDRESS 0x3fe5a4 FORMAT "%7.3" /end MEASUREMENT
/begin CHARACTERISTIC IP_FAC_CUR_DMTL "Battery-voltage dependent correction factor for the pump current" CURVE 0x4df46 _REC_CUR_20_u1_u2 1.9921875 _CNV_A_R_LINEAR_____103_CM 0. 1.9921875 FORMAT "%5.3"
 /begin AXIS_DESCR COM_AXIS VB_DMTL_FIL _CNV_A_R_LINEAR_____156_CM 6 0. 26. FORMAT "%7.4" AXIS_PTS_REF ldp_vb_dmtl_fil__fac_cur_dmtl /end AXIS_DESCR
/end CHARACTERISTIC
/begin MEASUREMENT VB_DMTL_REF "Filtered battery voltage on transition to refeence leak measurement" UWORD _CNV_A_R_LINEAR_____156_CM 1 100. 0. 26. ECU_ADDRESS 0x3fe5f6 FORMAT "%7.4" /end MEASUREMENT
/begin MEASUREMENT VB_DMTL_FIL "Filtered battery voltage" UWORD _CNV_A_R_LINEAR_____156_CM 1 100. 0. 26. ECU_ADDRESS 0x3fd008 FORMAT "%7.4" /end MEASUREMENT
/begin CHARACTERISTIC C_TAM_DMTL_MAX "upper temperature threshold for the DMTL function" VALUE 0x42a34 _REC_VAL_20_u1 190.5 _CNV_A_R_LINEAR_____0_CM -48. 142.5 FORMAT "%5.1" /end CHARACTERISTIC
/begin CHARACTERISTIC C_CL_DMTL_MAX "maximum loading degree for the DMTL function" VALUE 0x42c46 _REC_VAL_20_u2 1.99996948 _CNV_A_R_LINEAR_____45_CM 0. 1.99996948 FORMAT "%7.5" /end CHARACTERISTIC
/begin CHARACTERISTIC C_VS_FUC_CAN_MIN "Minimum speed for activation Check filler cap" VALUE 0x42b24 _REC_VAL_20_u1 255. _CNV_A_R_LINEAR_____13_CM 0. 255. FORMAT "%3.0" /end CHARACTERISTIC
/begin CHARACTERISTIC C_VS_DMTL_MAX "max. vehicle speed" VALUE 0x42b21 _REC_VAL_20_u1 255. _CNV_A_R_LINEAR_____13_CM 0. 255. FORMAT "%3.0" /end CHARACTERISTIC
/begin MEASUREMENT FTL_INI "Ini value level for diagnostic cycle" UBYTE _CNV_A_R_LINEAR_____85_CM 1 100. 0. 126. ECU_ADDRESS 0x3fd014 FORMAT "%3.0" /end MEASUREMENT
/begin MEASUREMENT FTL_OLD "FTL for plausibility check" UBYTE _CNV_A_R_LINEAR_____85_CM 1 100. 0. 126. ECU_ADDRESS 0x3fd015 FORMAT "%3.0" /end MEASUREMENT
/begin MEASUREMENT CTR_ENA_ROUGH_LEAK "Counter of  enable conditions fulfilled, without rough leak test" UBYTE _CNV_A_R_LINEAR_____10_CM 1 100. 0. 255. ECU_ADDRESS 0x3fd00c FORMAT "%3.0" /end MEASUREMENT
/begin CHARACTERISTIC C_SUM_CNL_ROUGH_LEAK_MES_FUC_MAX "maximum number of aborted check filler cap checks" VALUE 0x429a8 _REC_VAL_20_u1 255. _CNV_A_R_LINEAR_____10_CM 0. 255. FORMAT "%3.0" /end CHARACTERISTIC
/begin CHARACTERISTIC C_SUM_CNL_SMALL_LEAK_MES_MAX "Max. number of aborted miniature leak  checks due to current fluctuations" VALUE 0x429a9 _REC_VAL_20_u1 255. _CNV_A_R_LINEAR_____10_CM 0. 255. FORMAT "%3.0" /end CHARACTERISTIC
/begin MEASUREMENT CTR_ENA_ROUGH_LEAK_TEST "Counter for the number of rough leak checks for miniature leak check" UBYTE _CNV_A_R_LINEAR_____10_CM 1 100. 0. 255. ECU_ADDRESS 0x3fd00d FORMAT "%3.0" /end MEASUREMENT
/begin MEASUREMENT CTR_ENA_SMALL_LEAK_TEST "Counter recording the number of miniature leak checks after refueling" UBYTE _CNV_A_R_LINEAR_____10_CM 1 100. 0. 255. ECU_ADDRESS 0x3fd00e FORMAT "%3.0" /end MEASUREMENT
/begin CHARACTERISTIC C_CUR_DMTL_REF_DIF_MAX "Upper threshold of the Delta pump current" VALUE 0x42ca8 _REC_VAL_20_u2 400. _CNV_A_R_LINEAR_____151_CM 0. 400. FORMAT "%7.3" /end CHARACTERISTIC
/begin CHARACTERISTIC C_CUR_DMTL_DIF_THD_REFU "Threshold pump current change for refueling detection" VALUE 0x43236 _REC_VAL_20_s2 399.9938 _CNV_A_R_LINEAR_____150_CM -200. 199.9938 FORMAT "%8.3" /end CHARACTERISTIC
/begin CHARACTERISTIC C_CUR_DMTL_DIF_THD_FUC "Threshold pump current change for refueling detection" VALUE 0x43234 _REC_VAL_20_s2 399.9938 _CNV_A_R_LINEAR_____150_CM -200. 199.9938 FORMAT "%8.3" /end CHARACTERISTIC
/begin CHARACTERISTIC C_CUR_DMTL_DIF_THD_MES "Current decrease threshold during measurement" VALUE 0x42ca6 _REC_VAL_20_u2 400. _CNV_A_R_LINEAR_____151_CM 0. 400. FORMAT "%7.3" /end CHARACTERISTIC
/begin CHARACTERISTIC C_DIST_REFU_ROUGH_LEAK_MIN "lower threshold of distance covered between refueling and rough leak suspicion" VALUE 0x42cc6 _REC_VAL_20_u2 65535. _CNV_A_R_LINEAR_____159_CM 0. 65535. FORMAT "%5.0" /end CHARACTERISTIC
/begin CHARACTERISTIC LC_COD_HDMTL "Max. time for end of line diagnosis after test unit initiation" VALUE 0x42b6c _REC_VAL_20_u1 1. _CNV_A_R_LINEAR_____10_CM 0. 1. FORMAT "%2.0" /end CHARACTERISTIC
/begin CHARACTERISTIC IP_T_ACT_ROUGH_LEAK "Time for rough leak measurement" CURVE 0x4a4c0 _REC_CUR_20_u2_u1 655.35 _CNV_A_R_LINEAR_____14_CM 0. 6553.5 FORMAT "%6.1"
 /begin AXIS_DESCR COM_AXIS FTL _CNV_A_R_LINEAR_____85_CM 5 0. 126. FORMAT "%3.0" AXIS_PTS_REF ldp_ftl__t_rough_leak_test /end AXIS_DESCR
/end CHARACTERISTIC
/begin AXIS_PTS ldp_ftl__t_cur_dmtl_stat "" 0x433b1 FTL _REC_AXS_20_u1 126. _CNV_A_R_LINEAR_____85_CM 8 0. 126. FORMAT "%3.0" /end AXIS_PTS
/begin AXIS_PTS ldp_ftl__t_small_leak_test "" 0x433c0 FTL _REC_AXS_20_u1 126. _CNV_A_R_LINEAR_____85_CM 5 0. 126. FORMAT "%3.0" /end AXIS_PTS
/begin AXIS_PTS ldp_vb_dmtl_fil__fac_cur_dmtl "" 0x44db2 VB_DMTL_FIL _REC_AXS_20_u2 26. _CNV_A_R_LINEAR_____156_CM 6 0. 26. FORMAT "%7.4" /end AXIS_PTS
/begin AXIS_PTS ldpm_cur_dmtldifrefroughleak_1 "" 0x44ef0 CUR_DMTL_DIF_REF_ROUGH_LEAK _REC_AXS_20_u2 400. _CNV_A_R_LINEAR_____151_CM 8 0. 400. FORMAT "%7.3" /end AXIS_PTS
/begin AXIS_PTS ldp_ftl__t_rough_leak_test "" 0x433ba FTL _REC_AXS_20_u1 126. _CNV_A_R_LINEAR_____85_CM 5 0. 126. FORMAT "%3.0" /end AXIS_PTS
/begin MEASUREMENT LV_CHK_DMTL_CUR_DMTL_VLD "Check of components on pump current thresholds valid" ULONG _CNV_S_2_RANGE______28_CM 1 100. 0. 1. ECU_ADDRESS 0x3fe5b0 BIT_MASK 0x80000000 /end MEASUREMENT
/begin MEASUREMENT LV_CHK_DMTL_VLD "Check of components on current fluctuations valid" ULONG _CNV_S_2_RANGE______28_CM 1 100. 0. 1. ECU_ADDRESS 0x3fe5b0 BIT_MASK 0x40000000 /end MEASUREMENT
/begin MEASUREMENT LV_CUR_DMTL_DMTLS_TEST "Pump current threshold reached in case of  DMTL-valve check" ULONG _CNV_S_2_RANGE______28_CM 1 100. 0. 1. ECU_ADDRESS 0x3fe5b0 BIT_MASK 0x1000000 /end MEASUREMENT
/begin MEASUREMENT LV_CUR_DMTL_REF_MES_MAX "Upper pump current threshold reached during reference measurement" ULONG _CNV_S_2_RANGE______28_CM 1 100. 0. 1. ECU_ADDRESS 0x3fe5b0 BIT_MASK 0x800000 /end MEASUREMENT
/begin MEASUREMENT LV_CUR_DMTL_REF_MES_MIN "Lower pump current threshold reached during reference measurement" ULONG _CNV_S_2_RANGE______28_CM 1 100. 0. 1. ECU_ADDRESS 0x3fe5b0 BIT_MASK 0x400000 /end MEASUREMENT
/begin MEASUREMENT LV_CYC_ROUGH_LEAK_MODE6 "Cycle flag, rough leak error" ULONG _CNV_S_2_RANGE______28_CM 1 100. 0. 1. ECU_ADDRESS 0x3fe5b0 BIT_MASK 0x200000 /end MEASUREMENT
/begin MEASUREMENT LV_CYC_ROUGH_LEAK_SUSP "Cycle flag, rough leak suspected" ULONG _CNV_S_2_RANGE______28_CM 1 100. 0. 1. ECU_ADDRESS 0x3fe5b0 BIT_MASK 0x100000 /end MEASUREMENT
/begin MEASUREMENT LV_CYC_SMALL_LEAK_MODE6 "Cycle flag, miniature leak" ULONG _CNV_S_2_RANGE______28_CM 1 100. 0. 1. ECU_ADDRESS 0x3fe5b0 BIT_MASK 0x20000 /end MEASUREMENT
/begin MEASUREMENT LV_DIST_DMTL "Minimum distance after suspected rough leak or refueling" ULONG _CNV_S_2_RANGE______28_CM 1 100. 0. 1. ECU_ADDRESS 0x3fe5b0 BIT_MASK 0x8000 /end MEASUREMENT
/begin MEASUREMENT LV_DMTL_ASA "Factory test active" ULONG _CNV_S_2_RANGE______28_CM 1 100. 0. 1. ECU_ADDRESS 0x3fe5b0 BIT_MASK 0x4000 /end MEASUREMENT
/begin MEASUREMENT LV_DMTL_EOL "End of line test active" ULONG _CNV_S_2_RANGE______28_CM 1 100. 0. 1. ECU_ADDRESS 0x3fe5b0 BIT_MASK 0x2000 /end MEASUREMENT
/begin MEASUREMENT LV_DMTL_PUMP "controlbit of the DMTL pump powerstage" ULONG _CNV_S_2_RANGE______28_CM 1 100. 0. 1. ECU_ADDRESS 0x3fe5b0 BIT_MASK 0x400 /end MEASUREMENT
/begin MEASUREMENT LV_DMTL_PUMP_ON "DMTL pump motor on" ULONG _CNV_S_2_RANGE______28_CM 1 100. 0. 1. ECU_ADDRESS 0x3fe5b0 BIT_MASK 0x200 /end MEASUREMENT
/begin MEASUREMENT LV_DMTL_RST_ROUGH_LEAK "inhibit small leak diagnosis" ULONG _CNV_S_2_RANGE______28_CM 1 100. 0. 1. ECU_ADDRESS 0x3fe5b0 BIT_MASK 0x100 /end MEASUREMENT
/begin MEASUREMENT LV_DMTLS "controlbit of the DMTL solenoid powerstage" ULONG _CNV_S_2_RANGE______28_CM 1 100. 0. 1. ECU_ADDRESS 0x3fe5b0 BIT_MASK 0x80 /end MEASUREMENT
/begin MEASUREMENT LV_DMTLS_ON "DMTL valve on" ULONG _CNV_S_2_RANGE______28_CM 1 100. 0. 1. ECU_ADDRESS 0x3fe5b0 BIT_MASK 0x40 /end MEASUREMENT
/begin MEASUREMENT LV_DR_DMTL "Enabling the output stages of the DMTL module" ULONG _CNV_S_2_RANGE______28_CM 1 100. 0. 1. ECU_ADDRESS 0x3fe5b0 BIT_MASK 0x20 /end MEASUREMENT
/begin MEASUREMENT LV_DR_DMTL_PUMP "DMTL pump activation" ULONG _CNV_S_2_RANGE______28_CM 1 100. 0. 1. ECU_ADDRESS 0x3fe5b0 BIT_MASK 0x10 /end MEASUREMENT
/begin MEASUREMENT LV_ENA_FCO_DIAG "Consumption diagnosis enable" ULONG _CNV_S_2_RANGE______28_CM 1 100. 0. 1. ECU_ADDRESS 0x3fe5b0 BIT_MASK 0x8 /end MEASUREMENT
/begin MEASUREMENT LV_ENA_FTL_DIAG "Fuel level diagnosis enable" ULONG _CNV_S_2_RANGE______28_CM 1 100. 0. 1. ECU_ADDRESS 0x3fe5b0 BIT_MASK 0x4 /end MEASUREMENT
/begin MEASUREMENT LV_ENA_FUC_ROUGH_LEAK_MES "Enable rough leak measurement due to Check Filler Cap" ULONG _CNV_S_2_RANGE______28_CM 1 100. 0. 1. ECU_ADDRESS 0x3fe5b4 BIT_MASK 0x80000000 /end MEASUREMENT
/begin MEASUREMENT LV_ENA_MAIN_DMTL "DMTL main enabling" ULONG _CNV_S_2_RANGE______28_CM 1 100. 0. 1. ECU_ADDRESS 0x3fe5b4 BIT_MASK 0x40000000 /end MEASUREMENT
/begin MEASUREMENT LV_ENA_MAIN_DMTL_FUC "Main enabling DMTL Check Filler Cap" ULONG _CNV_S_2_RANGE______28_CM 1 100. 0. 1. ECU_ADDRESS 0x3fe5b4 BIT_MASK 0x20000000 /end MEASUREMENT
/begin MEASUREMENT LV_ENA_ROUGH_LEAK_1 "Auxiliary bit enable condition for rough leak check is present" ULONG _CNV_S_2_RANGE______28_CM 1 100. 0. 1. ECU_ADDRESS 0x3fe5b4 BIT_MASK 0x10000000 /end MEASUREMENT
/begin MEASUREMENT LV_ENA_ROUGH_LEAK_2 "Auxiliary bit enabling rough leak check through manual activation" ULONG _CNV_S_2_RANGE______28_CM 1 100. 0. 1. ECU_ADDRESS 0x3fe5b4 BIT_MASK 0x8000000 /end MEASUREMENT
/begin MEASUREMENT LV_ENA_ROUGH_LEAK_3 "Auxiliary bit interruption of rough leak check" ULONG _CNV_S_2_RANGE______28_CM 1 100. 0. 1. ECU_ADDRESS 0x3fe5b4 BIT_MASK 0x4000000 /end MEASUREMENT
/begin MEASUREMENT LV_ENA_ROUGH_LEAK_MES "Enabling rough leak measurement" ULONG _CNV_S_2_RANGE______28_CM 1 100. 0. 1. ECU_ADDRESS 0x3fe5b4 BIT_MASK 0x800000 /end MEASUREMENT
/begin MEASUREMENT LV_ENA_ROUGH_LEAK_MES_ONLY "Enable only rough leak measurement" ULONG _CNV_S_2_RANGE______28_CM 1 100. 0. 1. ECU_ADDRESS 0x3fe5b4 BIT_MASK 0x400000 /end MEASUREMENT
/begin MEASUREMENT LV_ENA_SMALL_LEAK_1 "Enable for miniature leak check via test unit intervention" ULONG _CNV_S_2_RANGE______28_CM 1 100. 0. 1. ECU_ADDRESS 0x3fe5b4 BIT_MASK 0x100000 /end MEASUREMENT
/begin MEASUREMENT LV_ENA_SMALL_LEAK_MES_END "End of enable miniature leak measurement" ULONG _CNV_S_2_RANGE______28_CM 1 100. 0. 1. ECU_ADDRESS 0x3fe5b4 BIT_MASK 0x80000 /end MEASUREMENT
/begin MEASUREMENT LV_ERR_DET_SMALL_LEAK_MIN "Error, minimum value detected, miniature leakage" ULONG _CNV_S_2_RANGE______28_CM 1 100. 0. 1. ECU_ADDRESS 0x3fe5b4 BIT_MASK 0x2000 /end MEASUREMENT
/begin MEASUREMENT LV_FCO_DIAG_MAX "Upper consumption diagnosis threshold" ULONG _CNV_S_2_RANGE______28_CM 1 100. 0. 1. ECU_ADDRESS 0x3fe5b4 BIT_MASK 0x1000 /end MEASUREMENT
/begin MEASUREMENT LV_FCO_DIAG_MIN "Lower consumption diagnosis threshold" ULONG _CNV_S_2_RANGE______28_CM 1 100. 0. 1. ECU_ADDRESS 0x3fe5b4 BIT_MASK 0x800 /end MEASUREMENT
/begin MEASUREMENT LV_FCO_H_FTL "Consumed fuel greater than tank level" ULONG _CNV_S_2_RANGE______28_CM 1 100. 0. 1. ECU_ADDRESS 0x3fe5b4 BIT_MASK 0x400 /end MEASUREMENT
/begin MEASUREMENT LV_FTL_DEC "Tank volume has decreased" ULONG _CNV_S_2_RANGE______28_CM 1 100. 0. 1. ECU_ADDRESS 0x3fe5b4 BIT_MASK 0x20 /end MEASUREMENT
/begin MEASUREMENT LV_FTL_DEC_IGK_ON "Tank filling volume has decreased in case of ignition key ON" ULONG _CNV_S_2_RANGE______28_CM 1 100. 0. 1. ECU_ADDRESS 0x3fe5b4 BIT_MASK 0x10 /end MEASUREMENT
/begin MEASUREMENT LV_FTL_DMTL_MAX "max. tank level for DMTL function" ULONG _CNV_S_2_RANGE______28_CM 1 100. 0. 1. ECU_ADDRESS 0x3fe5b4 BIT_MASK 0x4 /end MEASUREMENT
/begin MEASUREMENT LV_FTL_DMTL_MIN "min. tank level for DMTL function" ULONG _CNV_S_2_RANGE______28_CM 1 100. 0. 1. ECU_ADDRESS 0x3fe5b4 BIT_MASK 0x2 /end MEASUREMENT
/begin MEASUREMENT LV_FTL_DMTL_VAL "validated tank level for DMTL function" ULONG _CNV_S_2_RANGE______28_CM 1 100. 0. 1. ECU_ADDRESS 0x3fe5b4 BIT_MASK 0x1 /end MEASUREMENT
/begin MEASUREMENT LV_FTL_DYN "Level dynamics due to refueling" ULONG _CNV_S_2_RANGE______28_CM 1 100. 0. 1. ECU_ADDRESS 0x3fe5b8 BIT_MASK 0x80000000 /end MEASUREMENT
/begin MEASUREMENT LV_FTL_INC "Tank volume has increased" ULONG _CNV_S_2_RANGE______28_CM 1 100. 0. 1. ECU_ADDRESS 0x3fe5b8 BIT_MASK 0x40000000 /end MEASUREMENT
/begin MEASUREMENT LV_FTL_INC_IGK_ON "Tank filling volume has increased in case of ignition key ON" ULONG _CNV_S_2_RANGE______28_CM 1 100. 0. 1. ECU_ADDRESS 0x3fe5b8 BIT_MASK 0x20000000 /end MEASUREMENT
/begin MEASUREMENT LV_NO_PURGE_DR_DMTL "Pulse width modulation of canister-purge" ULONG _CNV_S_2_RANGE______28_CM 1 100. 0. 1. ECU_ADDRESS 0x3fe5b8 BIT_MASK 0x1000000 /end MEASUREMENT
/begin MEASUREMENT LV_NO_PURGE_DMTL_ROUGH_LEAK "request bit for no_purge" ULONG _CNV_S_2_RANGE______28_CM 1 100. 0. 1. ECU_ADDRESS 0x3fe5b8 BIT_MASK 0x800000 /end MEASUREMENT
/begin MEASUREMENT LV_NO_PURGE_DMTL_SMALL_LEAK "request bit for no_purge" ULONG _CNV_S_2_RANGE______28_CM 1 100. 0. 1. ECU_ADDRESS 0x3fe5b8 BIT_MASK 0x400000 /end MEASUREMENT
/begin MEASUREMENT LV_REF_LEAK_ROUGH_LEAK_SUSP "Condition, second reference measurement due to \"rough leak suspected\"" ULONG _CNV_S_2_RANGE______28_CM 1 100. 0. 1. ECU_ADDRESS 0x3fe5bc BIT_MASK 0x8000000 /end MEASUREMENT
/begin MEASUREMENT LV_REFU "Refueling" ULONG _CNV_S_2_RANGE______28_CM 1 100. 0. 1. ECU_ADDRESS 0x3fe5bc BIT_MASK 0x4000000 /end MEASUREMENT
/begin MEASUREMENT LV_REFU_1 "Refueling process, internal" ULONG _CNV_S_2_RANGE______28_CM 1 100. 0. 1. ECU_ADDRESS 0x3fe5bc BIT_MASK 0x2000000 /end MEASUREMENT
/begin MEASUREMENT LV_REFU_END "Refueling finished" ULONG _CNV_S_2_RANGE______28_CM 1 100. 0. 1. ECU_ADDRESS 0x3fe5bc BIT_MASK 0x1000000 /end MEASUREMENT
/begin MEASUREMENT LV_REFU_RLS_DIAG "Refueling diagnosis possible" ULONG _CNV_S_2_RANGE______28_CM 1 100. 0. 1. ECU_ADDRESS 0x3fe5bc BIT_MASK 0x400000 /end MEASUREMENT
/begin MEASUREMENT LV_REFU_VAL "Refueling bit valid, internal" ULONG _CNV_S_2_RANGE______28_CM 1 100. 0. 1. ECU_ADDRESS 0x3fe5bc BIT_MASK 0x200000 /end MEASUREMENT
/begin MEASUREMENT LV_REFU_VAL_1 "Refueling bit valid, internal" ULONG _CNV_S_2_RANGE______28_CM 1 100. 0. 1. ECU_ADDRESS 0x3fe5bc BIT_MASK 0x100000 /end MEASUREMENT
/begin MEASUREMENT LV_REQ_ENA_ROUGH_LEAK "Request rough leak measurement" ULONG _CNV_S_2_RANGE______28_CM 1 100. 0. 1. ECU_ADDRESS 0x3fe5bc BIT_MASK 0x80000 /end MEASUREMENT
/begin MEASUREMENT LV_REQ_PWL_ROUGH_LEAK "Request of STG off delay, rough leak diagnosis" ULONG _CNV_S_2_RANGE______28_CM 1 100. 0. 1. ECU_ADDRESS 0x3fe5bc BIT_MASK 0x20000 /end MEASUREMENT
/begin MEASUREMENT LV_REQ_PWL_SMALL_LEAK "Request of STG off delay, miniature leak test" ULONG _CNV_S_2_RANGE______28_CM 1 100. 0. 1. ECU_ADDRESS 0x3fe5bc BIT_MASK 0x10000 /end MEASUREMENT
/begin MEASUREMENT LV_REQ_ROUGH_LEAK "Request rough leak measurement (low volatile fuel)" ULONG _CNV_S_2_RANGE______28_CM 1 100. 0. 1. ECU_ADDRESS 0x3fe5bc BIT_MASK 0x8000 /end MEASUREMENT
/begin MEASUREMENT LV_ROUGH_LEAK_MES_LEN "Condition, extension rough leak measurement" ULONG _CNV_S_2_RANGE______28_CM 1 100. 0. 1. ECU_ADDRESS 0x3fe5bc BIT_MASK 0x4000 /end MEASUREMENT
/begin MEASUREMENT LV_ROUGH_LEAK_SUSP "Rough leak suspected" ULONG _CNV_S_2_RANGE______28_CM 1 100. 0. 1. ECU_ADDRESS 0x3fe5bc BIT_MASK 0x2000 /end MEASUREMENT
/begin MEASUREMENT LV_SMALL_LEAK_MES_LEN "Condition, extension miniature leak measurement" ULONG _CNV_S_2_RANGE______28_CM 1 100. 0. 1. ECU_ADDRESS 0x3fe5bc BIT_MASK 0x8 /end MEASUREMENT
/begin MEASUREMENT LV_T_DLY_DMTL_PWL "Waiting time DMTL start finished" ULONG _CNV_S_2_RANGE______28_CM 1 100. 0. 1. ECU_ADDRESS 0x3fe5bc BIT_MASK 0x4 /end MEASUREMENT
/begin MEASUREMENT LV_CTR_CNL_SMALL_LEAK_MES "Threshold of aborted miniature leak measurements due to current fluctuations exceeded" ULONG _CNV_S_2_RANGE______28_CM 1 100. 0. 1. ECU_ADDRESS 0x3fcfd8 BIT_MASK 0x80000000 /end MEASUREMENT
/begin MEASUREMENT LV_CUR_DMTL_REF_DIF_MAX "Condition \"delta reference current\" exceeded" ULONG _CNV_S_2_RANGE______28_CM 1 100. 0. 1. ECU_ADDRESS 0x3fcfd8 BIT_MASK 0x40000000 /end MEASUREMENT
/begin MEASUREMENT LV_CUR_DMTL_THD_DIF_MES "Decreasing pump current during measurement" ULONG _CNV_S_2_RANGE______28_CM 1 100. 0. 1. ECU_ADDRESS 0x3fcfd8 BIT_MASK 0x20000000 /end MEASUREMENT
/begin MEASUREMENT LV_DET_FUC_OPEN "Detection of fuel cap open" ULONG _CNV_S_2_RANGE______28_CM 1 100. 0. 1. ECU_ADDRESS 0x3fcfd8 BIT_MASK 0x10000000 /end MEASUREMENT
/begin MEASUREMENT LV_DET_REFU "Detection of refueling" ULONG _CNV_S_2_RANGE______28_CM 1 100. 0. 1. ECU_ADDRESS 0x3fcfd8 BIT_MASK 0x8000000 /end MEASUREMENT
/begin MEASUREMENT LV_DIST_DET_ROUGH_LEAK "Distance covered since rough leak detection" ULONG _CNV_S_2_RANGE______28_CM 1 100. 0. 1. ECU_ADDRESS 0x3fcfd8 BIT_MASK 0x4000000 /end MEASUREMENT
/begin MEASUREMENT LV_DMTL_ACT "DMTL state machine running" ULONG _CNV_S_2_RANGE______28_CM 1 100. 0. 1. ECU_ADDRESS 0x3fcfd8 BIT_MASK 0x2000000 /end MEASUREMENT
/begin MEASUREMENT LV_DMTL_STOP "Abnormal termination of DMTL function" ULONG _CNV_S_2_RANGE______28_CM 1 100. 0. 1. ECU_ADDRESS 0x3fcfd8 BIT_MASK 0x400000 /end MEASUREMENT
/begin MEASUREMENT LV_ENA_FUC "Request check filler cap" ULONG _CNV_S_2_RANGE______28_CM 1 100. 0. 1. ECU_ADDRESS 0x3fcfd8 BIT_MASK 0x100000 /end MEASUREMENT
/begin MEASUREMENT LV_ENA_LEAK_DMTL "Enabling function request, coarse / miniature leakage measurement" ULONG _CNV_S_2_RANGE______28_CM 1 100. 0. 1. ECU_ADDRESS 0x3fcfd8 BIT_MASK 0x80000 /end MEASUREMENT
/begin MEASUREMENT LV_ENA_OSC_ROUGH_LEAK_MES "Enable rough leak measurement after current fluctuations" ULONG _CNV_S_2_RANGE______28_CM 1 100. 0. 1. ECU_ADDRESS 0x3fcfd8 BIT_MASK 0x40000 /end MEASUREMENT
/begin MEASUREMENT LV_ENA_SMALL_LEAK_MES "Enable miniature leak measurement" ULONG _CNV_S_2_RANGE______28_CM 1 100. 0. 1. ECU_ADDRESS 0x3fcfd8 BIT_MASK 0x8000 /end MEASUREMENT
/begin MEASUREMENT LV_ENA_SMALL_LEAK_REFU "Enable miniature leak check after refueling" ULONG _CNV_S_2_RANGE______28_CM 1 100. 0. 1. ECU_ADDRESS 0x3fcfd8 BIT_MASK 0x4000 /end MEASUREMENT
/begin MEASUREMENT LV_ERR_DET_DMTL_MAX "Error maximum value DMTL" ULONG _CNV_S_2_RANGE______28_CM 1 100. 0. 1. ECU_ADDRESS 0x3fcfd8 BIT_MASK 0x2000 /end MEASUREMENT
/begin MEASUREMENT LV_ERR_DET_DMTL_MIN "Error, minimum value detected in DMTL module" ULONG _CNV_S_2_RANGE______28_CM 1 100. 0. 1. ECU_ADDRESS 0x3fcfd8 BIT_MASK 0x1000 /end MEASUREMENT
/begin MEASUREMENT LV_ERR_DET_ROUGH_LEAK_MIN "Rough leak error" ULONG _CNV_S_2_RANGE______28_CM 1 100. 0. 1. ECU_ADDRESS 0x3fcfd8 BIT_MASK 0x800 /end MEASUREMENT
/begin MEASUREMENT LV_ERR_FTL "Tank level error" ULONG _CNV_S_2_RANGE______28_CM 1 100. 0. 1. ECU_ADDRESS 0x3fcfd8 BIT_MASK 0x400 /end MEASUREMENT
/begin MEASUREMENT LV_ERR_FTL_PLAUS "Tank level plausibility error" ULONG _CNV_S_2_RANGE______28_CM 1 100. 0. 1. ECU_ADDRESS 0x3fcfd8 BIT_MASK 0x200 /end MEASUREMENT
/begin MEASUREMENT LV_ERR_SIG_DMTL "Error signal DMTL" ULONG _CNV_S_2_RANGE______28_CM 1 100. 0. 1. ECU_ADDRESS 0x3fcfd8 BIT_MASK 0x80 /end MEASUREMENT
/begin MEASUREMENT LV_ERR_SMALL_LEAK "Error miniature leak" ULONG _CNV_S_2_RANGE______28_CM 1 100. 0. 1. ECU_ADDRESS 0x3fcfd8 BIT_MASK 0x40 /end MEASUREMENT
/begin MEASUREMENT LV_FTL_DIAG "Level sensor diagnosis" ULONG _CNV_S_2_RANGE______28_CM 1 100. 0. 1. ECU_ADDRESS 0x3fcfd8 BIT_MASK 0x20 /end MEASUREMENT
/begin MEASUREMENT LV_FUC_CAN "Tank cap open - display" ULONG _CNV_S_2_RANGE______28_CM 1 100. 0. 1. ECU_ADDRESS 0x3fcfd8 BIT_MASK 0x10 /end MEASUREMENT
/begin MEASUREMENT LV_FUC_OPEN "Filler cap open" ULONG _CNV_S_2_RANGE______28_CM 1 100. 0. 1. ECU_ADDRESS 0x3fcfd8 BIT_MASK 0x8 /end MEASUREMENT
/begin MEASUREMENT LV_NO_PURGE_DMTL "request for no_purge of the evap.-system" ULONG _CNV_S_2_RANGE______28_CM 1 100. 0. 1. ECU_ADDRESS 0x3fcfd8 BIT_MASK 0x4 /end MEASUREMENT
/begin MEASUREMENT LV_REFU_DMTL "Condition refueling" ULONG _CNV_S_2_RANGE______28_CM 1 100. 0. 1. ECU_ADDRESS 0x3fcfd8 BIT_MASK 0x1 /end MEASUREMENT
/begin MEASUREMENT LV_REQ_PWL_DMTL "Request of STG off delay, tank leakage diagnosis" ULONG _CNV_S_2_RANGE______28_CM 1 100. 0. 1. ECU_ADDRESS 0x3fcfdc BIT_MASK 0x80000000 /end MEASUREMENT
/begin MEASUREMENT LV_ROUGH_LEAK_SUSP_SET "Rough leak suspicion with cycle bit rough leak suspicion present" ULONG _CNV_S_2_RANGE______28_CM 1 100. 0. 1. ECU_ADDRESS 0x3fcfdc BIT_MASK 0x20000000 /end MEASUREMENT
/begin MEASUREMENT LV_RST_SMALL_LEAK_MES_REFU "reset miniature leck after refueling" ULONG _CNV_S_2_RANGE______28_CM 1 100. 0. 1. ECU_ADDRESS 0x3fcfdc BIT_MASK 0x10000000 /end MEASUREMENT
/begin MEASUREMENT LV_SDR_DMTL "Error plausibility DMTL" ULONG _CNV_S_2_RANGE______28_CM 1 100. 0. 1. ECU_ADDRESS 0x3fcfdc BIT_MASK 0x8000000 /end MEASUREMENT
/begin MEASUREMENT LV_T_DMTL_MAX "max. time for DMTL" ULONG _CNV_S_2_RANGE______28_CM 1 100. 0. 1. ECU_ADDRESS 0x3fcfdc BIT_MASK 0x4000000 /end MEASUREMENT
/begin MEASUREMENT LV_VB_DIF_MAX "high battery voltage deviation" ULONG _CNV_S_2_RANGE______28_CM 1 100. 0. 1. ECU_ADDRESS 0x3fcfdc BIT_MASK 0x1000000 /end MEASUREMENT
/begin MEASUREMENT LV_HDMTL_ON "heater DMTL" ULONG _CNV_S_2_RANGE______28_CM 1 100. 0. 1. ECU_ADDRESS 0x3fcfdc BIT_MASK 0x800000 /end MEASUREMENT
/begin MEASUREMENT LV_DR_DMTLS "DMTL solenoid valve activation" ULONG _CNV_S_2_RANGE______28_CM 1 100. 0. 1. ECU_ADDRESS 0x3fcfdc BIT_MASK 0x400000 /end MEASUREMENT
/begin MEASUREMENT LV_VB_RANGE_DMTL "DMTL does not start because battery is out of band width" ULONG _CNV_S_2_RANGE______28_CM 1 100. 0. 1. ECU_ADDRESS 0x3fcfdc BIT_MASK 0x100000 /end MEASUREMENT
/begin MEASUREMENT CUR_DMTL_SMALL_LEAK_END "Pump current at the end of the miniature leak measurement" UWORD _CNV_A_R_LINEAR_____151_CM 1 100. 0. 400. ECU_ADDRESS 0x3fe5da FORMAT "%7.3" /end MEASUREMENT
/begin MEASUREMENT CUR_DMTL_REF_DIF_MAX "???" UWORD _CNV_A_R_LINEAR_____151_CM 1 100. 0. 400. ECU_ADDRESS 0x3fe5d4 FORMAT "%7.3" /end MEASUREMENT
/begin MEASUREMENT LV_DC "driving cycle status flag" UBYTE _CNV_S_2_RANGE______183_CM 1 100. 0. 1. ECU_ADDRESS 0x3fd343 BIT_MASK 0x1 /end MEASUREMENT
/begin MEASUREMENT LV_WUP_CYC "warm-up cycle status flag" UBYTE _CNV_S_2_RANGE______28_CM 1 100. 0. 1. ECU_ADDRESS 0x3fe946 BIT_MASK 0x1 /end MEASUREMENT
/begin MEASUREMENT LV_STATE_WUP "TCO state for exceeding the warm-up cycle tco threshold" UBYTE _CNV_S_2_RANGE______28_CM 1 100. 0. 1. ECU_ADDRESS 0x3fe945 BIT_MASK 0x1 /end MEASUREMENT
/begin CHARACTERISTIC C_TCO_WUP_THD "OBD II required at least 72 °C for GS and 60 °C for DS engines EOBD required at least 70 °C for DS and GS engines" VALUE 0x42a90 _REC_VAL_20_u1 190.5 _CNV_A_R_LINEAR_____0_CM -48. 142.5 FORMAT "%5.1" /end CHARACTERISTIC
/begin CHARACTERISTIC C_TCO_WUP_INC "OBDII required at least 23 °C for GS and DS engines EOBD required at least 22 °C for GS and DS engines" VALUE 0x42a8f _REC_VAL_20_u1 190.5 _CNV_A_R_LINEAR_____0_CM -48. 142.5 FORMAT "%5.1" /end CHARACTERISTIC
/begin CHARACTERISTIC ID_ERR_ENVD_BSD "" CURVE 0x411fe _REC_CUR_20_u1_u1 255. _CNV_A_R_LINEAR_____12_CM 0. 255. FORMAT "%2.0"
 /begin AXIS_DESCR COM_AXIS ONLINE_DUMMY _CNV_A_R_LINEAR_____12_CM 4 0. 3. FORMAT "%2.0" AXIS_PTS_REF ldp_fmy_envd /end AXIS_DESCR
/end CHARACTERISTIC
/begin CHARACTERISTIC ID_ERR_ENVD_CPS "" CURVE 0x407ba _REC_CUR_20_u1_u1 255. _CNV_A_R_LINEAR_____12_CM 0. 255. FORMAT "%2.0"
 /begin AXIS_DESCR COM_AXIS ONLINE_DUMMY _CNV_A_R_LINEAR_____12_CM 4 0. 3. FORMAT "%2.0" AXIS_PTS_REF ldp_fmy_envd /end AXIS_DESCR
/end CHARACTERISTIC
/begin CHARACTERISTIC ID_ERR_ENVD_CAT_DIAG_1 "" CURVE 0x41060 _REC_CUR_20_u1_u1 255. _CNV_A_R_LINEAR_____12_CM 0. 255. FORMAT "%2.0"
 /begin AXIS_DESCR COM_AXIS ONLINE_DUMMY _CNV_A_R_LINEAR_____12_CM 4 0. 3. FORMAT "%2.0" AXIS_PTS_REF ldp_fmy_envd /end AXIS_DESCR
/end CHARACTERISTIC
/begin CHARACTERISTIC ID_ERR_ENVD_CAT_DIAG_2 "" CURVE 0x41072 _REC_CUR_20_u1_u1 255. _CNV_A_R_LINEAR_____12_CM 0. 255. FORMAT "%2.0"
 /begin AXIS_DESCR COM_AXIS ONLINE_DUMMY _CNV_A_R_LINEAR_____12_CM 4 0. 3. FORMAT "%2.0" AXIS_PTS_REF ldp_fmy_envd /end AXIS_DESCR
/end CHARACTERISTIC
/begin CHARACTERISTIC ID_ERR_ENVD_GEN "" CURVE 0x40baa _REC_CUR_20_u1_u1 255. _CNV_A_R_LINEAR_____12_CM 0. 255. FORMAT "%2.0"
 /begin AXIS_DESCR COM_AXIS ONLINE_DUMMY _CNV_A_R_LINEAR_____12_CM 4 0. 3. FORMAT "%2.0" AXIS_PTS_REF ldp_fmy_envd /end AXIS_DESCR
/end CHARACTERISTIC
/begin CHARACTERISTIC ID_ERR_ENVD_CAM_0_NOT_PLAUS "" CURVE 0x40c28 _REC_CUR_20_u1_u1 255. _CNV_A_R_LINEAR_____12_CM 0. 255. FORMAT "%2.0"
 /begin AXIS_DESCR COM_AXIS ONLINE_DUMMY _CNV_A_R_LINEAR_____12_CM 4 0. 3. FORMAT "%2.0" AXIS_PTS_REF ldp_fmy_envd /end AXIS_DESCR
/end CHARACTERISTIC
/begin CHARACTERISTIC ID_ERR_ENVD_BN_ARS "" CURVE 0x412b2 _REC_CUR_20_u1_u1 255. _CNV_A_R_LINEAR_____12_CM 0. 255. FORMAT "%2.0"
 /begin AXIS_DESCR COM_AXIS ONLINE_DUMMY _CNV_A_R_LINEAR_____12_CM 4 0. 3. FORMAT "%2.0" AXIS_PTS_REF ldp_fmy_envd /end AXIS_DESCR
/end CHARACTERISTIC
/begin CHARACTERISTIC ID_ERR_ENVD_TQ_DIF_I_IS_MON_1 "" CURVE 0x40f40 _REC_CUR_20_u1_u1 255. _CNV_A_R_LINEAR_____12_CM 0. 255. FORMAT "%2.0"
 /begin AXIS_DESCR COM_AXIS ONLINE_DUMMY _CNV_A_R_LINEAR_____12_CM 4 0. 3. FORMAT "%2.0" AXIS_PTS_REF ldp_fmy_envd /end AXIS_DESCR
/end CHARACTERISTIC
/begin CHARACTERISTIC ID_ERR_ENVD_PVS_BLS_NOT_PLAUS "" CURVE 0x41126 _REC_CUR_20_u1_u1 255. _CNV_A_R_LINEAR_____12_CM 0. 255. FORMAT "%2.0"
 /begin AXIS_DESCR COM_AXIS ONLINE_DUMMY _CNV_A_R_LINEAR_____12_CM 4 0. 3. FORMAT "%2.0" AXIS_PTS_REF ldp_fmy_envd /end AXIS_DESCR
/end CHARACTERISTIC
/begin CHARACTERISTIC ID_ERR_ENVD_SAP "" CURVE 0x40cee _REC_CUR_20_u1_u1 255. _CNV_A_R_LINEAR_____12_CM 0. 255. FORMAT "%2.0"
 /begin AXIS_DESCR COM_AXIS ONLINE_DUMMY _CNV_A_R_LINEAR_____12_CM 4 0. 3. FORMAT "%2.0" AXIS_PTS_REF ldp_fmy_envd /end AXIS_DESCR
/end CHARACTERISTIC
/begin CHARACTERISTIC ID_ERR_ENVD_POIL_SWI "" CURVE 0x41210 _REC_CUR_20_u1_u1 255. _CNV_A_R_LINEAR_____12_CM 0. 255. FORMAT "%2.0"
 /begin AXIS_DESCR COM_AXIS ONLINE_DUMMY _CNV_A_R_LINEAR_____12_CM 4 0. 3. FORMAT "%2.0" AXIS_PTS_REF ldp_fmy_envd /end AXIS_DESCR
/end CHARACTERISTIC
/begin CHARACTERISTIC ID_ERR_ENVD_BN_ETCU "" CURVE 0x4131e _REC_CUR_20_u1_u1 255. _CNV_A_R_LINEAR_____12_CM 0. 255. FORMAT "%2.0"
 /begin AXIS_DESCR COM_AXIS ONLINE_DUMMY _CNV_A_R_LINEAR_____12_CM 4 0. 3. FORMAT "%2.0" AXIS_PTS_REF ldp_fmy_envd /end AXIS_DESCR
/end CHARACTERISTIC
/begin CHARACTERISTIC ID_ERR_ENVD_SAV "" CURVE 0x40d00 _REC_CUR_20_u1_u1 255. _CNV_A_R_LINEAR_____12_CM 0. 255. FORMAT "%2.0"
 /begin AXIS_DESCR COM_AXIS ONLINE_DUMMY _CNV_A_R_LINEAR_____12_CM 4 0. 3. FORMAT "%2.0" AXIS_PTS_REF ldp_fmy_envd /end AXIS_DESCR
/end CHARACTERISTIC
/begin CHARACTERISTIC ID_ERR_ENVD_PVS_DOUBLE "" CURVE 0x40b08 _REC_CUR_20_u1_u1 255. _CNV_A_R_LINEAR_____12_CM 0. 255. FORMAT "%2.0"
 /begin AXIS_DESCR COM_AXIS ONLINE_DUMMY _CNV_A_R_LINEAR_____12_CM 4 0. 3. FORMAT "%2.0" AXIS_PTS_REF ldp_fmy_envd /end AXIS_DESCR
/end CHARACTERISTIC
/begin CHARACTERISTIC ID_ERR_ENVD_CONV_MON_1 "" CURVE 0x40eb0 _REC_CUR_20_u1_u1 255. _CNV_A_R_LINEAR_____12_CM 0. 255. FORMAT "%2.0"
 /begin AXIS_DESCR COM_AXIS ONLINE_DUMMY _CNV_A_R_LINEAR_____12_CM 4 0. 3. FORMAT "%2.0" AXIS_PTS_REF ldp_fmy_envd /end AXIS_DESCR
/end CHARACTERISTIC
/begin CHARACTERISTIC ID_ERR_ENVD_BN_TQ_TCS "" CURVE 0x412d6 _REC_CUR_20_u1_u1 255. _CNV_A_R_LINEAR_____12_CM 0. 255. FORMAT "%2.0"
 /begin AXIS_DESCR COM_AXIS ONLINE_DUMMY _CNV_A_R_LINEAR_____12_CM 4 0. 3. FORMAT "%2.0" AXIS_PTS_REF ldp_fmy_envd /end AXIS_DESCR
/end CHARACTERISTIC
/begin CHARACTERISTIC ID_ERR_ENVD_SA_SAFM "" CURVE 0x40fd0 _REC_CUR_20_u1_u1 255. _CNV_A_R_LINEAR_____12_CM 0. 255. FORMAT "%2.0"
 /begin AXIS_DESCR COM_AXIS ONLINE_DUMMY _CNV_A_R_LINEAR_____12_CM 4 0. 3. FORMAT "%2.0" AXIS_PTS_REF ldp_fmy_envd /end AXIS_DESCR
/end CHARACTERISTIC
/begin CHARACTERISTIC ID_ERR_ENVD_N_EFP_HIGH "" CURVE 0x4143e _REC_CUR_20_u1_u1 255. _CNV_A_R_LINEAR_____12_CM 0. 255. FORMAT "%2.0"
 /begin AXIS_DESCR COM_AXIS ONLINE_DUMMY _CNV_A_R_LINEAR_____12_CM 4 0. 3. FORMAT "%2.0" AXIS_PTS_REF ldp_fmy_envd /end AXIS_DESCR
/end CHARACTERISTIC
/begin CHARACTERISTIC ID_ERR_ENVD_VLS_UP_PUC_1 "" CURVE 0x41570 _REC_CUR_20_u1_u1 255. _CNV_A_R_LINEAR_____12_CM 0. 255. FORMAT "%2.0"
 /begin AXIS_DESCR COM_AXIS ONLINE_DUMMY _CNV_A_R_LINEAR_____12_CM 4 0. 3. FORMAT "%2.0" AXIS_PTS_REF ldp_fmy_envd /end AXIS_DESCR
/end CHARACTERISTIC
/begin CHARACTERISTIC ID_ERR_ENVD_VLS_UP_PUC_2 "" CURVE 0x41582 _REC_CUR_20_u1_u1 255. _CNV_A_R_LINEAR_____12_CM 0. 255. FORMAT "%2.0"
 /begin AXIS_DESCR COM_AXIS ONLINE_DUMMY _CNV_A_R_LINEAR_____12_CM 4 0. 3. FORMAT "%2.0" AXIS_PTS_REF ldp_fmy_envd /end AXIS_DESCR
/end CHARACTERISTIC
/begin CHARACTERISTIC ID_ERR_ENVD_N_EFP_LOW "" CURVE 0x4142c _REC_CUR_20_u1_u1 255. _CNV_A_R_LINEAR_____12_CM 0. 255. FORMAT "%2.0"
 /begin AXIS_DESCR COM_AXIS ONLINE_DUMMY _CNV_A_R_LINEAR_____12_CM 4 0. 3. FORMAT "%2.0" AXIS_PTS_REF ldp_fmy_envd /end AXIS_DESCR
/end CHARACTERISTIC
/begin CHARACTERISTIC ID_ERR_ENVD_LS_UP_SWT_1 "" CURVE 0x415dc _REC_CUR_20_u1_u1 255. _CNV_A_R_LINEAR_____12_CM 0. 255. FORMAT "%2.0"
 /begin AXIS_DESCR COM_AXIS ONLINE_DUMMY _CNV_A_R_LINEAR_____12_CM 4 0. 3. FORMAT "%2.0" AXIS_PTS_REF ldp_fmy_envd /end AXIS_DESCR
/end CHARACTERISTIC
/begin CHARACTERISTIC ID_ERR_ENVD_LS_UP_SWT_2 "" CURVE 0x415ee _REC_CUR_20_u1_u1 255. _CNV_A_R_LINEAR_____12_CM 0. 255. FORMAT "%2.0"
 /begin AXIS_DESCR COM_AXIS ONLINE_DUMMY _CNV_A_R_LINEAR_____12_CM 4 0. 3. FORMAT "%2.0" AXIS_PTS_REF ldp_fmy_envd /end AXIS_DESCR
/end CHARACTERISTIC
/begin CHARACTERISTIC ID_ERR_ENVD_TOUT_PSTE_1 "" CURVE 0x40934 _REC_CUR_20_u1_u1 255. _CNV_A_R_LINEAR_____12_CM 0. 255. FORMAT "%2.0"
 /begin AXIS_DESCR COM_AXIS ONLINE_DUMMY _CNV_A_R_LINEAR_____12_CM 4 0. 3. FORMAT "%2.0" AXIS_PTS_REF ldp_fmy_envd /end AXIS_DESCR
/end CHARACTERISTIC
/begin CHARACTERISTIC ID_ERR_ENVD_TQ_GS_INC_PLAUS "" CURVE 0x41246 _REC_CUR_20_u1_u1 255. _CNV_A_R_LINEAR_____12_CM 0. 255. FORMAT "%2.0"
 /begin AXIS_DESCR COM_AXIS ONLINE_DUMMY _CNV_A_R_LINEAR_____12_CM 4 0. 3. FORMAT "%2.0" AXIS_PTS_REF ldp_fmy_envd /end AXIS_DESCR
/end CHARACTERISTIC
/begin CHARACTERISTIC ID_ERR_ENVD_TPS_MAF_1 "" CURVE 0x40a8a _REC_CUR_20_u1_u1 255. _CNV_A_R_LINEAR_____12_CM 0. 255. FORMAT "%2.0"
 /begin AXIS_DESCR COM_AXIS ONLINE_DUMMY _CNV_A_R_LINEAR_____12_CM 4 0. 3. FORMAT "%2.0" AXIS_PTS_REF ldp_fmy_envd /end AXIS_DESCR
/end CHARACTERISTIC
/begin CHARACTERISTIC ID_ERR_ENVD_TPS_MAF_2 "" CURVE 0x40a9c _REC_CUR_20_u1_u1 255. _CNV_A_R_LINEAR_____12_CM 0. 255. FORMAT "%2.0"
 /begin AXIS_DESCR COM_AXIS ONLINE_DUMMY _CNV_A_R_LINEAR_____12_CM 4 0. 3. FORMAT "%2.0" AXIS_PTS_REF ldp_fmy_envd /end AXIS_DESCR
/end CHARACTERISTIC
/begin CHARACTERISTIC ID_ERR_ENVD_REF_IVVT_EX_1 "" CURVE 0x40838 _REC_CUR_20_u1_u1 255. _CNV_A_R_LINEAR_____12_CM 0. 255. FORMAT "%2.0"
 /begin AXIS_DESCR COM_AXIS ONLINE_DUMMY _CNV_A_R_LINEAR_____12_CM 4 0. 3. FORMAT "%2.0" AXIS_PTS_REF ldp_fmy_envd /end AXIS_DESCR
/end CHARACTERISTIC
/begin CHARACTERISTIC ID_ERR_ENVD_REF_IVVT_EX_2 "" CURVE 0x4084a _REC_CUR_20_u1_u1 255. _CNV_A_R_LINEAR_____12_CM 0. 255. FORMAT "%2.0"
 /begin AXIS_DESCR COM_AXIS ONLINE_DUMMY _CNV_A_R_LINEAR_____12_CM 4 0. 3. FORMAT "%2.0" AXIS_PTS_REF ldp_fmy_envd /end AXIS_DESCR
/end CHARACTERISTIC
/begin CHARACTERISTIC ID_ERR_ENVD_SA_SAP "" CURVE 0x40fe2 _REC_CUR_20_u1_u1 255. _CNV_A_R_LINEAR_____12_CM 0. 255. FORMAT "%2.0"
 /begin AXIS_DESCR COM_AXIS ONLINE_DUMMY _CNV_A_R_LINEAR_____12_CM 4 0. 3. FORMAT "%2.0" AXIS_PTS_REF ldp_fmy_envd /end AXIS_DESCR
/end CHARACTERISTIC
/begin CHARACTERISTIC ID_ERR_ENVD_MTC_CTL_1 "" CURVE 0x40b2c _REC_CUR_20_u1_u1 255. _CNV_A_R_LINEAR_____12_CM 0. 255. FORMAT "%2.0"
 /begin AXIS_DESCR COM_AXIS ONLINE_DUMMY _CNV_A_R_LINEAR_____12_CM 4 0. 3. FORMAT "%2.0" AXIS_PTS_REF ldp_fmy_envd /end AXIS_DESCR
/end CHARACTERISTIC
/begin CHARACTERISTIC ID_ERR_ENVD_SA_SAV "" CURVE 0x40ff4 _REC_CUR_20_u1_u1 255. _CNV_A_R_LINEAR_____12_CM 0. 255. FORMAT "%2.0"
 /begin AXIS_DESCR COM_AXIS ONLINE_DUMMY _CNV_A_R_LINEAR_____12_CM 4 0. 3. FORMAT "%2.0" AXIS_PTS_REF ldp_fmy_envd /end AXIS_DESCR
/end CHARACTERISTIC
/begin CHARACTERISTIC ID_ERR_ENVD_MTC_CTL_2 "" CURVE 0x40b3e _REC_CUR_20_u1_u1 255. _CNV_A_R_LINEAR_____12_CM 0. 255. FORMAT "%2.0"
 /begin AXIS_DESCR COM_AXIS ONLINE_DUMMY _CNV_A_R_LINEAR_____12_CM 4 0. 3. FORMAT "%2.0" AXIS_PTS_REF ldp_fmy_envd /end AXIS_DESCR
/end CHARACTERISTIC
/begin CHARACTERISTIC ID_ERR_ENVD_MTC_CTL_3 "" CURVE 0x40b50 _REC_CUR_20_u1_u1 255. _CNV_A_R_LINEAR_____12_CM 0. 255. FORMAT "%2.0"
 /begin AXIS_DESCR COM_AXIS ONLINE_DUMMY _CNV_A_R_LINEAR_____12_CM 4 0. 3. FORMAT "%2.0" AXIS_PTS_REF ldp_fmy_envd /end AXIS_DESCR
/end CHARACTERISTIC
/begin CHARACTERISTIC ID_ERR_ENVD_DCC_REV "" CURVE 0x41258 _REC_CUR_20_u1_u1 255. _CNV_A_R_LINEAR_____12_CM 0. 255. FORMAT "%2.0"
 /begin AXIS_DESCR COM_AXIS ONLINE_DUMMY _CNV_A_R_LINEAR_____12_CM 4 0. 3. FORMAT "%2.0" AXIS_PTS_REF ldp_fmy_envd /end AXIS_DESCR
/end CHARACTERISTIC
/begin CHARACTERISTIC ID_ERR_ENVD_CAN_BOFF "" CURVE 0x40ca6 _REC_CUR_20_u1_u1 255. _CNV_A_R_LINEAR_____12_CM 0. 255. FORMAT "%2.0"
 /begin AXIS_DESCR COM_AXIS ONLINE_DUMMY _CNV_A_R_LINEAR_____12_CM 4 0. 3. FORMAT "%2.0" AXIS_PTS_REF ldp_fmy_envd /end AXIS_DESCR
/end CHARACTERISTIC
/begin CHARACTERISTIC ID_ERR_ENVD_ISA_1 "" CURVE 0x40dfc _REC_CUR_20_u1_u1 255. _CNV_A_R_LINEAR_____12_CM 0. 255. FORMAT "%2.0"
 /begin AXIS_DESCR COM_AXIS ONLINE_DUMMY _CNV_A_R_LINEAR_____12_CM 4 0. 3. FORMAT "%2.0" AXIS_PTS_REF ldp_fmy_envd /end AXIS_DESCR
/end CHARACTERISTIC
/begin CHARACTERISTIC ID_ERR_ENVD_ISA_2 "" CURVE 0x40e0e _REC_CUR_20_u1_u1 255. _CNV_A_R_LINEAR_____12_CM 0. 255. FORMAT "%2.0"
 /begin AXIS_DESCR COM_AXIS ONLINE_DUMMY _CNV_A_R_LINEAR_____12_CM 4 0. 3. FORMAT "%2.0" AXIS_PTS_REF ldp_fmy_envd /end AXIS_DESCR
/end CHARACTERISTIC
/begin CHARACTERISTIC ID_ERR_ENVD_TCO_STUCK "" CURVE 0x40d36 _REC_CUR_20_u1_u1 255. _CNV_A_R_LINEAR_____12_CM 0. 255. FORMAT "%2.0"
 /begin AXIS_DESCR COM_AXIS ONLINE_DUMMY _CNV_A_R_LINEAR_____12_CM 4 0. 3. FORMAT "%2.0" AXIS_PTS_REF ldp_fmy_envd /end AXIS_DESCR
/end CHARACTERISTIC
/begin CHARACTERISTIC ID_ERR_ENVD_BN_T_ICL "" CURVE 0x41354 _REC_CUR_20_u1_u1 255. _CNV_A_R_LINEAR_____12_CM 0. 255. FORMAT "%2.0"
 /begin AXIS_DESCR COM_AXIS ONLINE_DUMMY _CNV_A_R_LINEAR_____12_CM 4 0. 3. FORMAT "%2.0" AXIS_PTS_REF ldp_fmy_envd /end AXIS_DESCR
/end CHARACTERISTIC
/begin CHARACTERISTIC ID_ERR_ENVD_PVS_RATIO "" CURVE 0x40af6 _REC_CUR_20_u1_u1 255. _CNV_A_R_LINEAR_____12_CM 0. 255. FORMAT "%2.0"
 /begin AXIS_DESCR COM_AXIS ONLINE_DUMMY _CNV_A_R_LINEAR_____12_CM 4 0. 3. FORMAT "%2.0" AXIS_PTS_REF ldp_fmy_envd /end AXIS_DESCR
/end CHARACTERISTIC
/begin CHARACTERISTIC ID_ERR_ENVD_BN_MSW "" CURVE 0x413c0 _REC_CUR_20_u1_u1 255. _CNV_A_R_LINEAR_____12_CM 0. 255. FORMAT "%2.0"
 /begin AXIS_DESCR COM_AXIS ONLINE_DUMMY _CNV_A_R_LINEAR_____12_CM 4 0. 3. FORMAT "%2.0" AXIS_PTS_REF ldp_fmy_envd /end AXIS_DESCR
/end CHARACTERISTIC
/begin CHARACTERISTIC ID_ERR_ENVD_EBOX_CFA "" CURVE 0x410f0 _REC_CUR_20_u1_u1 255. _CNV_A_R_LINEAR_____12_CM 0. 255. FORMAT "%2.0"
 /begin AXIS_DESCR COM_AXIS ONLINE_DUMMY _CNV_A_R_LINEAR_____12_CM 4 0. 3. FORMAT "%2.0" AXIS_PTS_REF ldp_fmy_envd /end AXIS_DESCR
/end CHARACTERISTIC
/begin CHARACTERISTIC ID_ERR_ENVD_TOUT_ICL_2 "" CURVE 0x408ec _REC_CUR_20_u1_u1 255. _CNV_A_R_LINEAR_____12_CM 0. 255. FORMAT "%2.0"
 /begin AXIS_DESCR COM_AXIS ONLINE_DUMMY _CNV_A_R_LINEAR_____12_CM 4 0. 3. FORMAT "%2.0" AXIS_PTS_REF ldp_fmy_envd /end AXIS_DESCR
/end CHARACTERISTIC
/begin CHARACTERISTIC ID_ERR_ENVD_TOUT_ICL_3 "" CURVE 0x408fe _REC_CUR_20_u1_u1 255. _CNV_A_R_LINEAR_____12_CM 0. 255. FORMAT "%2.0"
 /begin AXIS_DESCR COM_AXIS ONLINE_DUMMY _CNV_A_R_LINEAR_____12_CM 4 0. 3. FORMAT "%2.0" AXIS_PTS_REF ldp_fmy_envd /end AXIS_DESCR
/end CHARACTERISTIC
/begin CHARACTERISTIC ID_ERR_ENVD_MTC_DR "" CURVE 0x40b1a _REC_CUR_20_u1_u1 255. _CNV_A_R_LINEAR_____12_CM 0. 255. FORMAT "%2.0"
 /begin AXIS_DESCR COM_AXIS ONLINE_DUMMY _CNV_A_R_LINEAR_____12_CM 4 0. 3. FORMAT "%2.0" AXIS_PTS_REF ldp_fmy_envd /end AXIS_DESCR
/end CHARACTERISTIC
/begin CHARACTERISTIC ID_ERR_ENVD_LS_DOWN_SWT_1 "" CURVE 0x41084 _REC_CUR_20_u1_u1 255. _CNV_A_R_LINEAR_____12_CM 0. 255. FORMAT "%2.0"
 /begin AXIS_DESCR COM_AXIS ONLINE_DUMMY _CNV_A_R_LINEAR_____12_CM 4 0. 3. FORMAT "%2.0" AXIS_PTS_REF ldp_fmy_envd /end AXIS_DESCR
/end CHARACTERISTIC
/begin CHARACTERISTIC ID_ERR_ENVD_LS_DOWN_SWT_2 "" CURVE 0x41096 _REC_CUR_20_u1_u1 255. _CNV_A_R_LINEAR_____12_CM 0. 255. FORMAT "%2.0"
 /begin AXIS_DESCR COM_AXIS ONLINE_DUMMY _CNV_A_R_LINEAR_____12_CM 4 0. 3. FORMAT "%2.0" AXIS_PTS_REF ldp_fmy_envd /end AXIS_DESCR
/end CHARACTERISTIC
/begin CHARACTERISTIC ID_ERR_ENVD_TPS_AD "" CURVE 0x40b62 _REC_CUR_20_u1_u1 255. _CNV_A_R_LINEAR_____12_CM 0. 255. FORMAT "%2.0"
 /begin AXIS_DESCR COM_AXIS ONLINE_DUMMY _CNV_A_R_LINEAR_____12_CM 4 0. 3. FORMAT "%2.0" AXIS_PTS_REF ldp_fmy_envd /end AXIS_DESCR
/end CHARACTERISTIC
/begin CHARACTERISTIC ID_ERR_ENVD_ECU_CKS "" CURVE 0x408a4 _REC_CUR_20_u1_u1 255. _CNV_A_R_LINEAR_____12_CM 0. 255. FORMAT "%2.0"
 /begin AXIS_DESCR COM_AXIS ONLINE_DUMMY _CNV_A_R_LINEAR_____12_CM 4 0. 3. FORMAT "%2.0" AXIS_PTS_REF ldp_fmy_envd /end AXIS_DESCR
/end CHARACTERISTIC
/begin CHARACTERISTIC ID_ERR_ENVD_BN_ICL "" CURVE 0x4138a _REC_CUR_20_u1_u1 255. _CNV_A_R_LINEAR_____12_CM 0. 255. FORMAT "%2.0"
 /begin AXIS_DESCR COM_AXIS ONLINE_DUMMY _CNV_A_R_LINEAR_____12_CM 4 0. 3. FORMAT "%2.0" AXIS_PTS_REF ldp_fmy_envd /end AXIS_DESCR
/end CHARACTERISTIC
/begin CHARACTERISTIC ID_ERR_ENVD_VLS_DOWN_PUE_1 "" CURVE 0x410a8 _REC_CUR_20_u1_u1 255. _CNV_A_R_LINEAR_____12_CM 0. 255. FORMAT "%2.0"
 /begin AXIS_DESCR COM_AXIS ONLINE_DUMMY _CNV_A_R_LINEAR_____12_CM 4 0. 3. FORMAT "%2.0" AXIS_PTS_REF ldp_fmy_envd /end AXIS_DESCR
/end CHARACTERISTIC
/begin CHARACTERISTIC ID_ERR_ENVD_VLS_DOWN_PUE_2 "" CURVE 0x410ba _REC_CUR_20_u1_u1 255. _CNV_A_R_LINEAR_____12_CM 0. 255. FORMAT "%2.0"
 /begin AXIS_DESCR COM_AXIS ONLINE_DUMMY _CNV_A_R_LINEAR_____12_CM 4 0. 3. FORMAT "%2.0" AXIS_PTS_REF ldp_fmy_envd /end AXIS_DESCR
/end CHARACTERISTIC
/begin CHARACTERISTIC ID_ERR_ENVD_DCC_IRREV "" CURVE 0x4126a _REC_CUR_20_u1_u1 255. _CNV_A_R_LINEAR_____12_CM 0. 255. FORMAT "%2.0"
 /begin AXIS_DESCR COM_AXIS ONLINE_DUMMY _CNV_A_R_LINEAR_____12_CM 4 0. 3. FORMAT "%2.0" AXIS_PTS_REF ldp_fmy_envd /end AXIS_DESCR
/end CHARACTERISTIC
/begin CHARACTERISTIC ID_ERR_ENVD_DUR_IGC_0 "" CURVE 0x409fa _REC_CUR_20_u1_u1 255. _CNV_A_R_LINEAR_____12_CM 0. 255. FORMAT "%2.0"
 /begin AXIS_DESCR COM_AXIS ONLINE_DUMMY _CNV_A_R_LINEAR_____12_CM 4 0. 3. FORMAT "%2.0" AXIS_PTS_REF ldp_fmy_envd /end AXIS_DESCR
/end CHARACTERISTIC
/begin CHARACTERISTIC ID_ERR_ENVD_DUR_IGC_1 "" CURVE 0x40a0c _REC_CUR_20_u1_u1 255. _CNV_A_R_LINEAR_____12_CM 0. 255. FORMAT "%2.0"
 /begin AXIS_DESCR COM_AXIS ONLINE_DUMMY _CNV_A_R_LINEAR_____12_CM 4 0. 3. FORMAT "%2.0" AXIS_PTS_REF ldp_fmy_envd /end AXIS_DESCR
/end CHARACTERISTIC
/begin CHARACTERISTIC ID_ERR_ENVD_DUR_IGC_2 "" CURVE 0x40a1e _REC_CUR_20_u1_u1 255. _CNV_A_R_LINEAR_____12_CM 0. 255. FORMAT "%2.0"
 /begin AXIS_DESCR COM_AXIS ONLINE_DUMMY _CNV_A_R_LINEAR_____12_CM 4 0. 3. FORMAT "%2.0" AXIS_PTS_REF ldp_fmy_envd /end AXIS_DESCR
/end CHARACTERISTIC
/begin CHARACTERISTIC ID_ERR_ENVD_DUR_IGC_3 "" CURVE 0x40a30 _REC_CUR_20_u1_u1 255. _CNV_A_R_LINEAR_____12_CM 0. 255. FORMAT "%2.0"
 /begin AXIS_DESCR COM_AXIS ONLINE_DUMMY _CNV_A_R_LINEAR_____12_CM 4 0. 3. FORMAT "%2.0" AXIS_PTS_REF ldp_fmy_envd /end AXIS_DESCR
/end CHARACTERISTIC
/begin CHARACTERISTIC ID_ERR_ENVD_DUR_IGC_4 "" CURVE 0x40a42 _REC_CUR_20_u1_u1 255. _CNV_A_R_LINEAR_____12_CM 0. 255. FORMAT "%2.0"
 /begin AXIS_DESCR COM_AXIS ONLINE_DUMMY _CNV_A_R_LINEAR_____12_CM 4 0. 3. FORMAT "%2.0" AXIS_PTS_REF ldp_fmy_envd /end AXIS_DESCR
/end CHARACTERISTIC
/begin CHARACTERISTIC ID_ERR_ENVD_DUR_IGC_5 "" CURVE 0x40a54 _REC_CUR_20_u1_u1 255. _CNV_A_R_LINEAR_____12_CM 0. 255. FORMAT "%2.0"
 /begin AXIS_DESCR COM_AXIS ONLINE_DUMMY _CNV_A_R_LINEAR_____12_CM 4 0. 3. FORMAT "%2.0" AXIS_PTS_REF ldp_fmy_envd /end AXIS_DESCR
/end CHARACTERISTIC
/begin CHARACTERISTIC ID_ERR_ENVD_PVS_MON_1 "" CURVE 0x40ed4 _REC_CUR_20_u1_u1 255. _CNV_A_R_LINEAR_____12_CM 0. 255. FORMAT "%2.0"
 /begin AXIS_DESCR COM_AXIS ONLINE_DUMMY _CNV_A_R_LINEAR_____12_CM 4 0. 3. FORMAT "%2.0" AXIS_PTS_REF ldp_fmy_envd /end AXIS_DESCR
/end CHARACTERISTIC
/begin CHARACTERISTIC ID_ERR_ENVD_LOAD_PLAUS "" CURVE 0x41408 _REC_CUR_20_u1_u1 255. _CNV_A_R_LINEAR_____12_CM 0. 255. FORMAT "%2.0"
 /begin AXIS_DESCR COM_AXIS ONLINE_DUMMY _CNV_A_R_LINEAR_____12_CM 4 0. 3. FORMAT "%2.0" AXIS_PTS_REF ldp_fmy_envd /end AXIS_DESCR
/end CHARACTERISTIC
/begin CHARACTERISTIC ID_ERR_ENVD_VLS_UP_MAX_1 "" CURVE 0x41528 _REC_CUR_20_u1_u1 255. _CNV_A_R_LINEAR_____12_CM 0. 255. FORMAT "%2.0"
 /begin AXIS_DESCR COM_AXIS ONLINE_DUMMY _CNV_A_R_LINEAR_____12_CM 4 0. 3. FORMAT "%2.0" AXIS_PTS_REF ldp_fmy_envd /end AXIS_DESCR
/end CHARACTERISTIC
/begin CHARACTERISTIC ID_ERR_ENVD_VLS_UP_MAX_2 "" CURVE 0x4153a _REC_CUR_20_u1_u1 255. _CNV_A_R_LINEAR_____12_CM 0. 255. FORMAT "%2.0"
 /begin AXIS_DESCR COM_AXIS ONLINE_DUMMY _CNV_A_R_LINEAR_____12_CM 4 0. 3. FORMAT "%2.0" AXIS_PTS_REF ldp_fmy_envd /end AXIS_DESCR
/end CHARACTERISTIC
/begin CHARACTERISTIC ID_ERR_ENVD_N_32_MON_1 "" CURVE 0x40ec2 _REC_CUR_20_u1_u1 255. _CNV_A_R_LINEAR_____12_CM 0. 255. FORMAT "%2.0"
 /begin AXIS_DESCR COM_AXIS ONLINE_DUMMY _CNV_A_R_LINEAR_____12_CM 4 0. 3. FORMAT "%2.0" AXIS_PTS_REF ldp_fmy_envd /end AXIS_DESCR
/end CHARACTERISTIC
/begin CHARACTERISTIC ID_ERR_ENVD_ECT_EL "" CURVE 0x40d5a _REC_CUR_20_u1_u1 255. _CNV_A_R_LINEAR_____12_CM 0. 255. FORMAT "%2.0"
 /begin AXIS_DESCR COM_AXIS ONLINE_DUMMY _CNV_A_R_LINEAR_____12_CM 4 0. 3. FORMAT "%2.0" AXIS_PTS_REF ldp_fmy_envd /end AXIS_DESCR
/end CHARACTERISTIC
/begin CHARACTERISTIC ID_ERR_ENVD_VLS_DOWN_MAX_1 "" CURVE 0x40640 _REC_CUR_20_u1_u1 255. _CNV_A_R_LINEAR_____12_CM 0. 255. FORMAT "%2.0"
 /begin AXIS_DESCR COM_AXIS ONLINE_DUMMY _CNV_A_R_LINEAR_____12_CM 4 0. 3. FORMAT "%2.0" AXIS_PTS_REF ldp_fmy_envd /end AXIS_DESCR
/end CHARACTERISTIC
/begin CHARACTERISTIC ID_ERR_ENVD_VLS_DOWN_MAX_2 "" CURVE 0x40652 _REC_CUR_20_u1_u1 255. _CNV_A_R_LINEAR_____12_CM 0. 255. FORMAT "%2.0"
 /begin AXIS_DESCR COM_AXIS ONLINE_DUMMY _CNV_A_R_LINEAR_____12_CM 4 0. 3. FORMAT "%2.0" AXIS_PTS_REF ldp_fmy_envd /end AXIS_DESCR
/end CHARACTERISTIC
/begin CHARACTERISTIC ID_ERR_ENVD_CRU_INH_MON_1 "" CURVE 0x40f88 _REC_CUR_20_u1_u1 255. _CNV_A_R_LINEAR_____12_CM 0. 255. FORMAT "%2.0"
 /begin AXIS_DESCR COM_AXIS ONLINE_DUMMY _CNV_A_R_LINEAR_____12_CM 4 0. 3. FORMAT "%2.0" AXIS_PTS_REF ldp_fmy_envd /end AXIS_DESCR
/end CHARACTERISTIC
/begin CHARACTERISTIC ID_ERR_ENVD_TOUT_ASR_1 "" CURVE 0x40910 _REC_CUR_20_u1_u1 255. _CNV_A_R_LINEAR_____12_CM 0. 255. FORMAT "%2.0"
 /begin AXIS_DESCR COM_AXIS ONLINE_DUMMY _CNV_A_R_LINEAR_____12_CM 4 0. 3. FORMAT "%2.0" AXIS_PTS_REF ldp_fmy_envd /end AXIS_DESCR
/end CHARACTERISTIC
/begin CHARACTERISTIC ID_ERR_ENVD_LSH_DOWN_1 "" CURVE 0x40784 _REC_CUR_20_u1_u1 255. _CNV_A_R_LINEAR_____12_CM 0. 255. FORMAT "%2.0"
 /begin AXIS_DESCR COM_AXIS ONLINE_DUMMY _CNV_A_R_LINEAR_____12_CM 4 0. 3. FORMAT "%2.0" AXIS_PTS_REF ldp_fmy_envd /end AXIS_DESCR
/end CHARACTERISTIC
/begin CHARACTERISTIC ID_ERR_ENVD_LSH_DOWN_2 "" CURVE 0x40796 _REC_CUR_20_u1_u1 255. _CNV_A_R_LINEAR_____12_CM 0. 255. FORMAT "%2.0"
 /begin AXIS_DESCR COM_AXIS ONLINE_DUMMY _CNV_A_R_LINEAR_____12_CM 4 0. 3. FORMAT "%2.0" AXIS_PTS_REF ldp_fmy_envd /end AXIS_DESCR
/end CHARACTERISTIC
/begin CHARACTERISTIC ID_ERR_ENVD_TOUT_ASR_3 "" CURVE 0x40922 _REC_CUR_20_u1_u1 255. _CNV_A_R_LINEAR_____12_CM 0. 255. FORMAT "%2.0"
 /begin AXIS_DESCR COM_AXIS ONLINE_DUMMY _CNV_A_R_LINEAR_____12_CM 4 0. 3. FORMAT "%2.0" AXIS_PTS_REF ldp_fmy_envd /end AXIS_DESCR
/end CHARACTERISTIC
/begin CHARACTERISTIC ID_ERR_ENVD_TCO_PLAUS "" CURVE 0x40d7e _REC_CUR_20_u1_u1 255. _CNV_A_R_LINEAR_____12_CM 0. 255. FORMAT "%2.0"
 /begin AXIS_DESCR COM_AXIS ONLINE_DUMMY _CNV_A_R_LINEAR_____12_CM 4 0. 3. FORMAT "%2.0" AXIS_PTS_REF ldp_fmy_envd /end AXIS_DESCR
/end CHARACTERISTIC
/begin CHARACTERISTIC ID_ERR_ENVD_BN_TCS "" CURVE 0x412fa _REC_CUR_20_u1_u1 255. _CNV_A_R_LINEAR_____12_CM 0. 255. FORMAT "%2.0"
 /begin AXIS_DESCR COM_AXIS ONLINE_DUMMY _CNV_A_R_LINEAR_____12_CM 4 0. 3. FORMAT "%2.0" AXIS_PTS_REF ldp_fmy_envd /end AXIS_DESCR
/end CHARACTERISTIC
/begin CHARACTERISTIC ID_ERR_ENVD_TQ_DIF_P_D_IS_MON_1 "" CURVE 0x40f2e _REC_CUR_20_u1_u1 255. _CNV_A_R_LINEAR_____12_CM 0. 255. FORMAT "%2.0"
 /begin AXIS_DESCR COM_AXIS ONLINE_DUMMY _CNV_A_R_LINEAR_____12_CM 4 0. 3. FORMAT "%2.0" AXIS_PTS_REF ldp_fmy_envd /end AXIS_DESCR
/end CHARACTERISTIC
/begin CHARACTERISTIC ID_ERR_ENVD_ECU_RAM "" CURVE 0x41102 _REC_CUR_20_u1_u1 255. _CNV_A_R_LINEAR_____12_CM 0. 255. FORMAT "%2.0"
 /begin AXIS_DESCR COM_AXIS ONLINE_DUMMY _CNV_A_R_LINEAR_____12_CM 4 0. 3. FORMAT "%2.0" AXIS_PTS_REF ldp_fmy_envd /end AXIS_DESCR
/end CHARACTERISTIC
/begin CHARACTERISTIC ID_ERR_ENVD_TIA "" CURVE 0x4060a _REC_CUR_20_u1_u1 255. _CNV_A_R_LINEAR_____12_CM 0. 255. FORMAT "%2.0"
 /begin AXIS_DESCR COM_AXIS ONLINE_DUMMY _CNV_A_R_LINEAR_____12_CM 4 0. 3. FORMAT "%2.0" AXIS_PTS_REF ldp_fmy_envd /end AXIS_DESCR
/end CHARACTERISTIC
/begin CHARACTERISTIC ID_ERR_ENVD_CRASH_EFP "" CURVE 0x4141a _REC_CUR_20_u1_u1 255. _CNV_A_R_LINEAR_____12_CM 0. 255. FORMAT "%2.0"
 /begin AXIS_DESCR COM_AXIS ONLINE_DUMMY _CNV_A_R_LINEAR_____12_CM 4 0. 3. FORMAT "%2.0" AXIS_PTS_REF ldp_fmy_envd /end AXIS_DESCR
/end CHARACTERISTIC
/begin CHARACTERISTIC ID_ERR_ENVD_TPU_SYN "" CURVE 0x40c70 _REC_CUR_20_u1_u1 255. _CNV_A_R_LINEAR_____12_CM 0. 255. FORMAT "%2.0"
 /begin AXIS_DESCR COM_AXIS ONLINE_DUMMY _CNV_A_R_LINEAR_____12_CM 4 0. 3. FORMAT "%2.0" AXIS_PTS_REF ldp_fmy_envd /end AXIS_DESCR
/end CHARACTERISTIC
/begin CHARACTERISTIC ID_ERR_ENVD_TOUT_AMT_1 "" CURVE 0x40946 _REC_CUR_20_u1_u1 255. _CNV_A_R_LINEAR_____12_CM 0. 255. FORMAT "%2.0"
 /begin AXIS_DESCR COM_AXIS ONLINE_DUMMY _CNV_A_R_LINEAR_____12_CM 4 0. 3. FORMAT "%2.0" AXIS_PTS_REF ldp_fmy_envd /end AXIS_DESCR
/end CHARACTERISTIC
/begin CHARACTERISTIC ID_ERR_ENVD_TECU "" CURVE 0x410de _REC_CUR_20_u1_u1 255. _CNV_A_R_LINEAR_____12_CM 0. 255. FORMAT "%2.0"
 /begin AXIS_DESCR COM_AXIS ONLINE_DUMMY _CNV_A_R_LINEAR_____12_CM 4 0. 3. FORMAT "%2.0" AXIS_PTS_REF ldp_fmy_envd /end AXIS_DESCR
/end CHARACTERISTIC
/begin CHARACTERISTIC ID_ERR_ENVD_TQI_N_MAX_MON_1 "" CURVE 0x40f64 _REC_CUR_20_u1_u1 255. _CNV_A_R_LINEAR_____12_CM 0. 255. FORMAT "%2.0"
 /begin AXIS_DESCR COM_AXIS ONLINE_DUMMY _CNV_A_R_LINEAR_____12_CM 4 0. 3. FORMAT "%2.0" AXIS_PTS_REF ldp_fmy_envd /end AXIS_DESCR
/end CHARACTERISTIC
/begin CHARACTERISTIC ID_ERR_ENVD_MAF "" CURVE 0x4062e _REC_CUR_20_u1_u1 255. _CNV_A_R_LINEAR_____12_CM 0. 255. FORMAT "%2.0"
 /begin AXIS_DESCR COM_AXIS ONLINE_DUMMY _CNV_A_R_LINEAR_____12_CM 4 0. 3. FORMAT "%2.0" AXIS_PTS_REF ldp_fmy_envd /end AXIS_DESCR
/end CHARACTERISTIC
/begin CHARACTERISTIC ID_ERR_ENVD_RLY_EFP "" CURVE 0x407a8 _REC_CUR_20_u1_u1 255. _CNV_A_R_LINEAR_____12_CM 0. 255. FORMAT "%2.0"
 /begin AXIS_DESCR COM_AXIS ONLINE_DUMMY _CNV_A_R_LINEAR_____12_CM 4 0. 3. FORMAT "%2.0" AXIS_PTS_REF ldp_fmy_envd /end AXIS_DESCR
/end CHARACTERISTIC
/begin CHARACTERISTIC ID_ERR_ENVD_BN_KM_ICL "" CURVE 0x41378 _REC_CUR_20_u1_u1 255. _CNV_A_R_LINEAR_____12_CM 0. 255. FORMAT "%2.0"
 /begin AXIS_DESCR COM_AXIS ONLINE_DUMMY _CNV_A_R_LINEAR_____12_CM 4 0. 3. FORMAT "%2.0" AXIS_PTS_REF ldp_fmy_envd /end AXIS_DESCR
/end CHARACTERISTIC
/begin CHARACTERISTIC ID_ERR_ENVD_MEC_IVVT_IN_1 "" CURVE 0x407cc _REC_CUR_20_u1_u1 255. _CNV_A_R_LINEAR_____12_CM 0. 255. FORMAT "%2.0"
 /begin AXIS_DESCR COM_AXIS ONLINE_DUMMY _CNV_A_R_LINEAR_____12_CM 4 0. 3. FORMAT "%2.0" AXIS_PTS_REF ldp_fmy_envd /end AXIS_DESCR
/end CHARACTERISTIC
/begin CHARACTERISTIC ID_ERR_ENVDMEC_IVVT_IN_2 "" CURVE 0x407de _REC_CUR_20_u1_u1 255. _CNV_A_R_LINEAR_____12_CM 0. 255. FORMAT "%2.0"
 /begin AXIS_DESCR COM_AXIS ONLINE_DUMMY _CNV_A_R_LINEAR_____12_CM 4 0. 3. FORMAT "%2.0" AXIS_PTS_REF ldp_fmy_envd /end AXIS_DESCR
/end CHARACTERISTIC
/begin CHARACTERISTIC ID_ERR_ENVD_CRK_NOT_PLAUS "" CURVE 0x40c82 _REC_CUR_20_u1_u1 255. _CNV_A_R_LINEAR_____12_CM 0. 255. FORMAT "%2.0"
 /begin AXIS_DESCR COM_AXIS ONLINE_DUMMY _CNV_A_R_LINEAR_____12_CM 4 0. 3. FORMAT "%2.0" AXIS_PTS_REF ldp_fmy_envd /end AXIS_DESCR
/end CHARACTERISTIC
/begin CHARACTERISTIC ID_ERR_ENVD_TPS_PLAUS "" CURVE 0x413f6 _REC_CUR_20_u1_u1 255. _CNV_A_R_LINEAR_____12_CM 0. 255. FORMAT "%2.0"
 /begin AXIS_DESCR COM_AXIS ONLINE_DUMMY _CNV_A_R_LINEAR_____12_CM 4 0. 3. FORMAT "%2.0" AXIS_PTS_REF ldp_fmy_envd /end AXIS_DESCR
/end CHARACTERISTIC
/begin CHARACTERISTIC ID_ERR_ENVD_TOUT_ETCU_1 "" CURVE 0x408c8 _REC_CUR_20_u1_u1 255. _CNV_A_R_LINEAR_____12_CM 0. 255. FORMAT "%2.0"
 /begin AXIS_DESCR COM_AXIS ONLINE_DUMMY _CNV_A_R_LINEAR_____12_CM 4 0. 3. FORMAT "%2.0" AXIS_PTS_REF ldp_fmy_envd /end AXIS_DESCR
/end CHARACTERISTIC
/begin CHARACTERISTIC ID_ERR_ENVD_TOUT_ETCU_2 "" CURVE 0x408da _REC_CUR_20_u1_u1 255. _CNV_A_R_LINEAR_____12_CM 0. 255. FORMAT "%2.0"
 /begin AXIS_DESCR COM_AXIS ONLINE_DUMMY _CNV_A_R_LINEAR_____12_CM 4 0. 3. FORMAT "%2.0" AXIS_PTS_REF ldp_fmy_envd /end AXIS_DESCR
/end CHARACTERISTIC
/begin CHARACTERISTIC ID_ERR_ENVD_FSD_1 "" CURVE 0x4103c _REC_CUR_20_u1_u1 255. _CNV_A_R_LINEAR_____12_CM 0. 255. FORMAT "%2.0"
 /begin AXIS_DESCR COM_AXIS ONLINE_DUMMY _CNV_A_R_LINEAR_____12_CM 4 0. 3. FORMAT "%2.0" AXIS_PTS_REF ldp_fmy_envd /end AXIS_DESCR
/end CHARACTERISTIC
/begin CHARACTERISTIC ID_ERR_ENVD_FSD_2 "" CURVE 0x4104e _REC_CUR_20_u1_u1 255. _CNV_A_R_LINEAR_____12_CM 0. 255. FORMAT "%2.0"
 /begin AXIS_DESCR COM_AXIS ONLINE_DUMMY _CNV_A_R_LINEAR_____12_CM 4 0. 3. FORMAT "%2.0" AXIS_PTS_REF ldp_fmy_envd /end AXIS_DESCR
/end CHARACTERISTIC
/begin CHARACTERISTIC ID_ERR_ENVD_CAM_PER_0 "" CURVE 0x40be0 _REC_CUR_20_u1_u1 255. _CNV_A_R_LINEAR_____12_CM 0. 255. FORMAT "%2.0"
 /begin AXIS_DESCR COM_AXIS ONLINE_DUMMY _CNV_A_R_LINEAR_____12_CM 4 0. 3. FORMAT "%2.0" AXIS_PTS_REF ldp_fmy_envd /end AXIS_DESCR
/end CHARACTERISTIC
/begin CHARACTERISTIC ID_ERR_ENVD_CAM_PER_1 "" CURVE 0x40bf2 _REC_CUR_20_u1_u1 255. _CNV_A_R_LINEAR_____12_CM 0. 255. FORMAT "%2.0"
 /begin AXIS_DESCR COM_AXIS ONLINE_DUMMY _CNV_A_R_LINEAR_____12_CM 4 0. 3. FORMAT "%2.0" AXIS_PTS_REF ldp_fmy_envd /end AXIS_DESCR
/end CHARACTERISTIC
/begin CHARACTERISTIC ID_ERR_ENVD_SOF "" CURVE 0x411c8 _REC_CUR_20_u1_u1 255. _CNV_A_R_LINEAR_____12_CM 0. 255. FORMAT "%2.0"
 /begin AXIS_DESCR COM_AXIS ONLINE_DUMMY _CNV_A_R_LINEAR_____12_CM 4 0. 3. FORMAT "%2.0" AXIS_PTS_REF ldp_fmy_envd /end AXIS_DESCR
/end CHARACTERISTIC
/begin CHARACTERISTIC ID_ERR_ENVD_BN_ANG_PSTE "" CURVE 0x413d2 _REC_CUR_20_u1_u1 255. _CNV_A_R_LINEAR_____12_CM 0. 255. FORMAT "%2.0"
 /begin AXIS_DESCR COM_AXIS ONLINE_DUMMY _CNV_A_R_LINEAR_____12_CM 4 0. 3. FORMAT "%2.0" AXIS_PTS_REF ldp_fmy_envd /end AXIS_DESCR
/end CHARACTERISTIC
/begin CHARACTERISTIC ID_ERR_ENVD_TEG_PCAT_DOWN_1 "" CURVE 0x405c2 _REC_CUR_20_u1_u1 255. _CNV_A_R_LINEAR_____12_CM 0. 255. FORMAT "%2.0"
 /begin AXIS_DESCR COM_AXIS ONLINE_DUMMY _CNV_A_R_LINEAR_____12_CM 4 0. 3. FORMAT "%2.0" AXIS_PTS_REF ldp_fmy_envd /end AXIS_DESCR
/end CHARACTERISTIC
/begin CHARACTERISTIC ID_ERR_ENVD_TEG_PCAT_DOWN_2 "" CURVE 0x405d4 _REC_CUR_20_u1_u1 255. _CNV_A_R_LINEAR_____12_CM 0. 255. FORMAT "%2.0"
 /begin AXIS_DESCR COM_AXIS ONLINE_DUMMY _CNV_A_R_LINEAR_____12_CM 4 0. 3. FORMAT "%2.0" AXIS_PTS_REF ldp_fmy_envd /end AXIS_DESCR
/end CHARACTERISTIC
/begin CHARACTERISTIC ID_ERR_ENVD_CHK_LS_DOWN_1 "" CURVE 0x414bc _REC_CUR_20_u1_u1 255. _CNV_A_R_LINEAR_____12_CM 0. 255. FORMAT "%2.0"
 /begin AXIS_DESCR COM_AXIS ONLINE_DUMMY _CNV_A_R_LINEAR_____12_CM 4 0. 3. FORMAT "%2.0" AXIS_PTS_REF ldp_fmy_envd /end AXIS_DESCR
/end CHARACTERISTIC
/begin CHARACTERISTIC ID_ERR_ENVD_CHK_LS_DOWN_2 "" CURVE 0x414ce _REC_CUR_20_u1_u1 255. _CNV_A_R_LINEAR_____12_CM 0. 255. FORMAT "%2.0"
 /begin AXIS_DESCR COM_AXIS ONLINE_DUMMY _CNV_A_R_LINEAR_____12_CM 4 0. 3. FORMAT "%2.0" AXIS_PTS_REF ldp_fmy_envd /end AXIS_DESCR
/end CHARACTERISTIC
/begin CHARACTERISTIC ID_ERR_ENVD_TCO_EL "" CURVE 0x40d24 _REC_CUR_20_u1_u1 255. _CNV_A_R_LINEAR_____12_CM 0. 255. FORMAT "%2.0"
 /begin AXIS_DESCR COM_AXIS ONLINE_DUMMY _CNV_A_R_LINEAR_____12_CM 4 0. 3. FORMAT "%2.0" AXIS_PTS_REF ldp_fmy_envd /end AXIS_DESCR
/end CHARACTERISTIC
/begin CHARACTERISTIC ID_ERR_ENVD_BN_ACC "" CURVE 0x41342 _REC_CUR_20_u1_u1 255. _CNV_A_R_LINEAR_____12_CM 0. 255. FORMAT "%2.0"
 /begin AXIS_DESCR COM_AXIS ONLINE_DUMMY _CNV_A_R_LINEAR_____12_CM 4 0. 3. FORMAT "%2.0" AXIS_PTS_REF ldp_fmy_envd /end AXIS_DESCR
/end CHARACTERISTIC
/begin CHARACTERISTIC ID_ERR_ENVD_TCO_EX "" CURVE 0x405f8 _REC_CUR_20_u1_u1 255. _CNV_A_R_LINEAR_____12_CM 0. 255. FORMAT "%2.0"
 /begin AXIS_DESCR COM_AXIS ONLINE_DUMMY _CNV_A_R_LINEAR_____12_CM 4 0. 3. FORMAT "%2.0" AXIS_PTS_REF ldp_fmy_envd /end AXIS_DESCR
/end CHARACTERISTIC
/begin CHARACTERISTIC ID_ERR_ENVD_BN_TQ_DCC "" CURVE 0x412a0 _REC_CUR_20_u1_u1 255. _CNV_A_R_LINEAR_____12_CM 0. 255. FORMAT "%2.0"
 /begin AXIS_DESCR COM_AXIS ONLINE_DUMMY _CNV_A_R_LINEAR_____12_CM 4 0. 3. FORMAT "%2.0" AXIS_PTS_REF ldp_fmy_envd /end AXIS_DESCR
/end CHARACTERISTIC
/begin CHARACTERISTIC ID_ERR_ENVD_MSW_2 "" CURVE 0x40dd8 _REC_CUR_20_u1_u1 255. _CNV_A_R_LINEAR_____12_CM 0. 255. FORMAT "%2.0"
 /begin AXIS_DESCR COM_AXIS ONLINE_DUMMY _CNV_A_R_LINEAR_____12_CM 4 0. 3. FORMAT "%2.0" AXIS_PTS_REF ldp_fmy_envd /end AXIS_DESCR
/end CHARACTERISTIC
/begin CHARACTERISTIC ID_ERR_ENVD_MSW_3 "" CURVE 0x40dea _REC_CUR_20_u1_u1 255. _CNV_A_R_LINEAR_____12_CM 0. 255. FORMAT "%2.0"
 /begin AXIS_DESCR COM_AXIS ONLINE_DUMMY _CNV_A_R_LINEAR_____12_CM 4 0. 3. FORMAT "%2.0" AXIS_PTS_REF ldp_fmy_envd /end AXIS_DESCR
/end CHARACTERISTIC
/begin CHARACTERISTIC ID_ERR_ENVD_SLV_IVVT_IN_1 "" CURVE 0x4085c _REC_CUR_20_u1_u1 255. _CNV_A_R_LINEAR_____12_CM 0. 255. FORMAT "%2.0"
 /begin AXIS_DESCR COM_AXIS ONLINE_DUMMY _CNV_A_R_LINEAR_____12_CM 4 0. 3. FORMAT "%2.0" AXIS_PTS_REF ldp_fmy_envd /end AXIS_DESCR
/end CHARACTERISTIC
/begin CHARACTERISTIC ID_ERR_ENVD_SLV_IVVT_IN_2 "" CURVE 0x4086e _REC_CUR_20_u1_u1 255. _CNV_A_R_LINEAR_____12_CM 0. 255. FORMAT "%2.0"
 /begin AXIS_DESCR COM_AXIS ONLINE_DUMMY _CNV_A_R_LINEAR_____12_CM 4 0. 3. FORMAT "%2.0" AXIS_PTS_REF ldp_fmy_envd /end AXIS_DESCR
/end CHARACTERISTIC
/begin CHARACTERISTIC ID_ERR_ENVD_DMTL_PUMP "" CURVE 0x41192 _REC_CUR_20_u1_u1 255. _CNV_A_R_LINEAR_____12_CM 0. 255. FORMAT "%2.0"
 /begin AXIS_DESCR COM_AXIS ONLINE_DUMMY _CNV_A_R_LINEAR_____12_CM 4 0. 3. FORMAT "%2.0" AXIS_PTS_REF ldp_fmy_envd /end AXIS_DESCR
/end CHARACTERISTIC
/begin CHARACTERISTIC ID_ERR_ENVD_ENG_PSN "" CURVE 0x40c4c _REC_CUR_20_u1_u1 255. _CNV_A_R_LINEAR_____12_CM 0. 255. FORMAT "%2.0"
 /begin AXIS_DESCR COM_AXIS ONLINE_DUMMY _CNV_A_R_LINEAR_____12_CM 4 0. 3. FORMAT "%2.0" AXIS_PTS_REF ldp_fmy_envd /end AXIS_DESCR
/end CHARACTERISTIC
/begin CHARACTERISTIC ID_ERR_ENVD_TPS_MON_1 "" CURVE 0x40ee6 _REC_CUR_20_u1_u1 255. _CNV_A_R_LINEAR_____12_CM 0. 255. FORMAT "%2.0"
 /begin AXIS_DESCR COM_AXIS ONLINE_DUMMY _CNV_A_R_LINEAR_____12_CM 4 0. 3. FORMAT "%2.0" AXIS_PTS_REF ldp_fmy_envd /end AXIS_DESCR
/end CHARACTERISTIC
/begin CHARACTERISTIC ID_ERR_ENVD_MSW_TOG "" CURVE 0x40dc6 _REC_CUR_20_u1_u1 255. _CNV_A_R_LINEAR_____12_CM 0. 255. FORMAT "%2.0"
 /begin AXIS_DESCR COM_AXIS ONLINE_DUMMY _CNV_A_R_LINEAR_____12_CM 4 0. 3. FORMAT "%2.0" AXIS_PTS_REF ldp_fmy_envd /end AXIS_DESCR
/end CHARACTERISTIC
/begin CHARACTERISTIC ID_ERR_ENVD_BN_TQ_AMT "" CURVE 0x41330 _REC_CUR_20_u1_u1 255. _CNV_A_R_LINEAR_____12_CM 0. 255. FORMAT "%2.0"
 /begin AXIS_DESCR COM_AXIS ONLINE_DUMMY _CNV_A_R_LINEAR_____12_CM 4 0. 3. FORMAT "%2.0" AXIS_PTS_REF ldp_fmy_envd /end AXIS_DESCR
/end CHARACTERISTIC
/begin CHARACTERISTIC ID_ERR_ENVD_TOIL "" CURVE 0x405e6 _REC_CUR_20_u1_u1 255. _CNV_A_R_LINEAR_____12_CM 0. 255. FORMAT "%2.0"
 /begin AXIS_DESCR COM_AXIS ONLINE_DUMMY _CNV_A_R_LINEAR_____12_CM 4 0. 3. FORMAT "%2.0" AXIS_PTS_REF ldp_fmy_envd /end AXIS_DESCR
/end CHARACTERISTIC
/begin CHARACTERISTIC ID_ERR_ENVD_VLS_UP_OC_1 "" CURVE 0x4154c _REC_CUR_20_u1_u1 255. _CNV_A_R_LINEAR_____12_CM 0. 255. FORMAT "%2.0"
 /begin AXIS_DESCR COM_AXIS ONLINE_DUMMY _CNV_A_R_LINEAR_____12_CM 4 0. 3. FORMAT "%2.0" AXIS_PTS_REF ldp_fmy_envd /end AXIS_DESCR
/end CHARACTERISTIC
/begin CHARACTERISTIC ID_ERR_ENVD_VLS_UP_OC_2 "" CURVE 0x4155e _REC_CUR_20_u1_u1 255. _CNV_A_R_LINEAR_____12_CM 0. 255. FORMAT "%2.0"
 /begin AXIS_DESCR COM_AXIS ONLINE_DUMMY _CNV_A_R_LINEAR_____12_CM 4 0. 3. FORMAT "%2.0" AXIS_PTS_REF ldp_fmy_envd /end AXIS_DESCR
/end CHARACTERISTIC
/begin CHARACTERISTIC ID_ERR_ENVD_VIM "" CURVE 0x40bce _REC_CUR_20_u1_u1 255. _CNV_A_R_LINEAR_____12_CM 0. 255. FORMAT "%2.0"
 /begin AXIS_DESCR COM_AXIS ONLINE_DUMMY _CNV_A_R_LINEAR_____12_CM 4 0. 3. FORMAT "%2.0" AXIS_PTS_REF ldp_fmy_envd /end AXIS_DESCR
/end CHARACTERISTIC
/begin CHARACTERISTIC ID_ERR_ENVD_BN_POW_GEN "" CURVE 0x413ae _REC_CUR_20_u1_u1 255. _CNV_A_R_LINEAR_____12_CM 0. 255. FORMAT "%2.0"
 /begin AXIS_DESCR COM_AXIS ONLINE_DUMMY _CNV_A_R_LINEAR_____12_CM 4 0. 3. FORMAT "%2.0" AXIS_PTS_REF ldp_fmy_envd /end AXIS_DESCR
/end CHARACTERISTIC
/begin CHARACTERISTIC ID_ERR_ENVD_VLS_UP_STK_1 "" CURVE 0x41594 _REC_CUR_20_u1_u1 255. _CNV_A_R_LINEAR_____12_CM 0. 255. FORMAT "%2.0"
 /begin AXIS_DESCR COM_AXIS ONLINE_DUMMY _CNV_A_R_LINEAR_____12_CM 4 0. 3. FORMAT "%2.0" AXIS_PTS_REF ldp_fmy_envd /end AXIS_DESCR
/end CHARACTERISTIC
/begin CHARACTERISTIC ID_ERR_ENVD_VLS_UP_STK_2 "" CURVE 0x415a6 _REC_CUR_20_u1_u1 255. _CNV_A_R_LINEAR_____12_CM 0. 255. FORMAT "%2.0"
 /begin AXIS_DESCR COM_AXIS ONLINE_DUMMY _CNV_A_R_LINEAR_____12_CM 4 0. 3. FORMAT "%2.0" AXIS_PTS_REF ldp_fmy_envd /end AXIS_DESCR
/end CHARACTERISTIC
/begin CHARACTERISTIC ID_ERR_ENVD_LSH_UP_1 "" CURVE 0x40760 _REC_CUR_20_u1_u1 255. _CNV_A_R_LINEAR_____12_CM 0. 255. FORMAT "%2.0"
 /begin AXIS_DESCR COM_AXIS ONLINE_DUMMY _CNV_A_R_LINEAR_____12_CM 4 0. 3. FORMAT "%2.0" AXIS_PTS_REF ldp_fmy_envd /end AXIS_DESCR
/end CHARACTERISTIC
/begin CHARACTERISTIC ID_ERR_ENVD_LSH_UP_2 "" CURVE 0x40772 _REC_CUR_20_u1_u1 255. _CNV_A_R_LINEAR_____12_CM 0. 255. FORMAT "%2.0"
 /begin AXIS_DESCR COM_AXIS ONLINE_DUMMY _CNV_A_R_LINEAR_____12_CM 4 0. 3. FORMAT "%2.0" AXIS_PTS_REF ldp_fmy_envd /end AXIS_DESCR
/end CHARACTERISTIC
/begin CHARACTERISTIC ID_ERR_ENVD_TOUT_TXU_1 "" CURVE 0x40c94 _REC_CUR_20_u1_u1 255. _CNV_A_R_LINEAR_____12_CM 0. 255. FORMAT "%2.0"
 /begin AXIS_DESCR COM_AXIS ONLINE_DUMMY _CNV_A_R_LINEAR_____12_CM 4 0. 3. FORMAT "%2.0" AXIS_PTS_REF ldp_fmy_envd /end AXIS_DESCR
/end CHARACTERISTIC
/begin CHARACTERISTIC ID_ERR_ENVD_KNKS_1 "" CURVE 0x4096a _REC_CUR_20_u1_u1 255. _CNV_A_R_LINEAR_____12_CM 0. 255. FORMAT "%2.0"
 /begin AXIS_DESCR COM_AXIS ONLINE_DUMMY _CNV_A_R_LINEAR_____12_CM 4 0. 3. FORMAT "%2.0" AXIS_PTS_REF ldp_fmy_envd /end AXIS_DESCR
/end CHARACTERISTIC
/begin CHARACTERISTIC ID_ERR_ENVD_KNKS_2 "" CURVE 0x4097c _REC_CUR_20_u1_u1 255. _CNV_A_R_LINEAR_____12_CM 0. 255. FORMAT "%2.0"
 /begin AXIS_DESCR COM_AXIS ONLINE_DUMMY _CNV_A_R_LINEAR_____12_CM 4 0. 3. FORMAT "%2.0" AXIS_PTS_REF ldp_fmy_envd /end AXIS_DESCR
/end CHARACTERISTIC
/begin CHARACTERISTIC ID_ERR_ENVD_MEC_ISA "" CURVE 0x40e20 _REC_CUR_20_u1_u1 255. _CNV_A_R_LINEAR_____12_CM 0. 255. FORMAT "%2.0"
 /begin AXIS_DESCR COM_AXIS ONLINE_DUMMY _CNV_A_R_LINEAR_____12_CM 4 0. 3. FORMAT "%2.0" AXIS_PTS_REF ldp_fmy_envd /end AXIS_DESCR
/end CHARACTERISTIC
/begin CHARACTERISTIC ID_ERR_ENVD_TQ_MAX_CLU_MON_1 "" CURVE 0x40f1c _REC_CUR_20_u1_u1 255. _CNV_A_R_LINEAR_____12_CM 0. 255. FORMAT "%2.0"
 /begin AXIS_DESCR COM_AXIS ONLINE_DUMMY _CNV_A_R_LINEAR_____12_CM 4 0. 3. FORMAT "%2.0" AXIS_PTS_REF ldp_fmy_envd /end AXIS_DESCR
/end CHARACTERISTIC
/begin CHARACTERISTIC ID_ERR_ENVD_BN_CAS "" CURVE 0x412c4 _REC_CUR_20_u1_u1 255. _CNV_A_R_LINEAR_____12_CM 0. 255. FORMAT "%2.0"
 /begin AXIS_DESCR COM_AXIS ONLINE_DUMMY _CNV_A_R_LINEAR_____12_CM 4 0. 3. FORMAT "%2.0" AXIS_PTS_REF ldp_fmy_envd /end AXIS_DESCR
/end CHARACTERISTIC
/begin CHARACTERISTIC ID_ERR_ENVD_VLS_UP_MIN_COLD_1 "" CURVE 0x414e0 _REC_CUR_20_u1_u1 255. _CNV_A_R_LINEAR_____12_CM 0. 255. FORMAT "%2.0"
 /begin AXIS_DESCR COM_AXIS ONLINE_DUMMY _CNV_A_R_LINEAR_____12_CM 4 0. 3. FORMAT "%2.0" AXIS_PTS_REF ldp_fmy_envd /end AXIS_DESCR
/end CHARACTERISTIC
/begin CHARACTERISTIC ID_ERR_ENVD_VLS_UP_MIN_COLD_2 "" CURVE 0x414f2 _REC_CUR_20_u1_u1 255. _CNV_A_R_LINEAR_____12_CM 0. 255. FORMAT "%2.0"
 /begin AXIS_DESCR COM_AXIS ONLINE_DUMMY _CNV_A_R_LINEAR_____12_CM 4 0. 3. FORMAT "%2.0" AXIS_PTS_REF ldp_fmy_envd /end AXIS_DESCR
/end CHARACTERISTIC
/begin CHARACTERISTIC ID_ERR_ENVD_TD_IGC_CUT_0 "" CURVE 0x4098e _REC_CUR_20_u1_u1 255. _CNV_A_R_LINEAR_____12_CM 0. 255. FORMAT "%2.0"
 /begin AXIS_DESCR COM_AXIS ONLINE_DUMMY _CNV_A_R_LINEAR_____12_CM 4 0. 3. FORMAT "%2.0" AXIS_PTS_REF ldp_fmy_envd /end AXIS_DESCR
/end CHARACTERISTIC
/begin CHARACTERISTIC ID_ERR_ENVD_TD_IGC_CUT_1 "" CURVE 0x409a0 _REC_CUR_20_u1_u1 255. _CNV_A_R_LINEAR_____12_CM 0. 255. FORMAT "%2.0"
 /begin AXIS_DESCR COM_AXIS ONLINE_DUMMY _CNV_A_R_LINEAR_____12_CM 4 0. 3. FORMAT "%2.0" AXIS_PTS_REF ldp_fmy_envd /end AXIS_DESCR
/end CHARACTERISTIC
/begin CHARACTERISTIC ID_ERR_ENVD_TD_IGC_CUT_2 "" CURVE 0x409b2 _REC_CUR_20_u1_u1 255. _CNV_A_R_LINEAR_____12_CM 0. 255. FORMAT "%2.0"
 /begin AXIS_DESCR COM_AXIS ONLINE_DUMMY _CNV_A_R_LINEAR_____12_CM 4 0. 3. FORMAT "%2.0" AXIS_PTS_REF ldp_fmy_envd /end AXIS_DESCR
/end CHARACTERISTIC
/begin CHARACTERISTIC ID_ERR_ENVD_TD_IGC_CUT_3 "" CURVE 0x409c4 _REC_CUR_20_u1_u1 255. _CNV_A_R_LINEAR_____12_CM 0. 255. FORMAT "%2.0"
 /begin AXIS_DESCR COM_AXIS ONLINE_DUMMY _CNV_A_R_LINEAR_____12_CM 4 0. 3. FORMAT "%2.0" AXIS_PTS_REF ldp_fmy_envd /end AXIS_DESCR
/end CHARACTERISTIC
/begin CHARACTERISTIC ID_ERR_ENVD_TD_IGC_CUT_4 "" CURVE 0x409d6 _REC_CUR_20_u1_u1 255. _CNV_A_R_LINEAR_____12_CM 0. 255. FORMAT "%2.0"
 /begin AXIS_DESCR COM_AXIS ONLINE_DUMMY _CNV_A_R_LINEAR_____12_CM 4 0. 3. FORMAT "%2.0" AXIS_PTS_REF ldp_fmy_envd /end AXIS_DESCR
/end CHARACTERISTIC
/begin CHARACTERISTIC ID_ERR_ENVD_TD_IGC_CUT_5 "" CURVE 0x409e8 _REC_CUR_20_u1_u1 255. _CNV_A_R_LINEAR_____12_CM 0. 255. FORMAT "%2.0"
 /begin AXIS_DESCR COM_AXIS ONLINE_DUMMY _CNV_A_R_LINEAR_____12_CM 4 0. 3. FORMAT "%2.0" AXIS_PTS_REF ldp_fmy_envd /end AXIS_DESCR
/end CHARACTERISTIC
/begin CHARACTERISTIC ID_ERR_ENVD_V_REF_1 "" CURVE 0x40aae _REC_CUR_20_u1_u1 255. _CNV_A_R_LINEAR_____12_CM 0. 255. FORMAT "%2.0"
 /begin AXIS_DESCR COM_AXIS ONLINE_DUMMY _CNV_A_R_LINEAR_____12_CM 4 0. 3. FORMAT "%2.0" AXIS_PTS_REF ldp_fmy_envd /end AXIS_DESCR
/end CHARACTERISTIC
/begin CHARACTERISTIC ID_ERR_ENVD_V_REF_2 "" CURVE 0x40ac0 _REC_CUR_20_u1_u1 255. _CNV_A_R_LINEAR_____12_CM 0. 255. FORMAT "%2.0"
 /begin AXIS_DESCR COM_AXIS ONLINE_DUMMY _CNV_A_R_LINEAR_____12_CM 4 0. 3. FORMAT "%2.0" AXIS_PTS_REF ldp_fmy_envd /end AXIS_DESCR
/end CHARACTERISTIC
/begin CHARACTERISTIC ID_ERR_ENVD_BN_VS_TCS "" CURVE 0x412e8 _REC_CUR_20_u1_u1 255. _CNV_A_R_LINEAR_____12_CM 0. 255. FORMAT "%2.0"
 /begin AXIS_DESCR COM_AXIS ONLINE_DUMMY _CNV_A_R_LINEAR_____12_CM 4 0. 3. FORMAT "%2.0" AXIS_PTS_REF ldp_fmy_envd /end AXIS_DESCR
/end CHARACTERISTIC
/begin CHARACTERISTIC ID_ERR_ENVDMEC_IVVT_EX_1 "" CURVE 0x407f0 _REC_CUR_20_u1_u1 255. _CNV_A_R_LINEAR_____12_CM 0. 255. FORMAT "%2.0"
 /begin AXIS_DESCR COM_AXIS ONLINE_DUMMY _CNV_A_R_LINEAR_____12_CM 4 0. 3. FORMAT "%2.0" AXIS_PTS_REF ldp_fmy_envd /end AXIS_DESCR
/end CHARACTERISTIC
/begin CHARACTERISTIC ID_ERR_ENVD_MEC_IVVT_EX_2 "" CURVE 0x40802 _REC_CUR_20_u1_u1 255. _CNV_A_R_LINEAR_____12_CM 0. 255. FORMAT "%2.0"
 /begin AXIS_DESCR COM_AXIS ONLINE_DUMMY _CNV_A_R_LINEAR_____12_CM 4 0. 3. FORMAT "%2.0" AXIS_PTS_REF ldp_fmy_envd /end AXIS_DESCR
/end CHARACTERISTIC
/begin CHARACTERISTIC ID_ERR_ENVD_PVS_1 "" CURVE 0x40ad2 _REC_CUR_20_u1_u1 255. _CNV_A_R_LINEAR_____12_CM 0. 255. FORMAT "%2.0"
 /begin AXIS_DESCR COM_AXIS ONLINE_DUMMY _CNV_A_R_LINEAR_____12_CM 4 0. 3. FORMAT "%2.0" AXIS_PTS_REF ldp_fmy_envd /end AXIS_DESCR
/end CHARACTERISTIC
/begin CHARACTERISTIC ID_ERR_ENVD_PVS_2 "" CURVE 0x40ae4 _REC_CUR_20_u1_u1 255. _CNV_A_R_LINEAR_____12_CM 0. 255. FORMAT "%2.0"
 /begin AXIS_DESCR COM_AXIS ONLINE_DUMMY _CNV_A_R_LINEAR_____12_CM 4 0. 3. FORMAT "%2.0" AXIS_PTS_REF ldp_fmy_envd /end AXIS_DESCR
/end CHARACTERISTIC
/begin CHARACTERISTIC ID_ERR_ENVD_ECT_MEC "" CURVE 0x40d6c _REC_CUR_20_u1_u1 255. _CNV_A_R_LINEAR_____12_CM 0. 255. FORMAT "%2.0"
 /begin AXIS_DESCR COM_AXIS ONLINE_DUMMY _CNV_A_R_LINEAR_____12_CM 4 0. 3. FORMAT "%2.0" AXIS_PTS_REF ldp_fmy_envd /end AXIS_DESCR
/end CHARACTERISTIC
/begin CHARACTERISTIC ID_ERR_ENVD_TQI_AV_MON_1 "" CURVE 0x40f52 _REC_CUR_20_u1_u1 255. _CNV_A_R_LINEAR_____12_CM 0. 255. FORMAT "%2.0"
 /begin AXIS_DESCR COM_AXIS ONLINE_DUMMY _CNV_A_R_LINEAR_____12_CM 4 0. 3. FORMAT "%2.0" AXIS_PTS_REF ldp_fmy_envd /end AXIS_DESCR
/end CHARACTERISTIC
/begin CHARACTERISTIC ID_ERR_ENVD_LS_UP_FRQ_1 "" CURVE 0x41600 _REC_CUR_20_u1_u1 255. _CNV_A_R_LINEAR_____12_CM 0. 255. FORMAT "%2.0"
 /begin AXIS_DESCR COM_AXIS ONLINE_DUMMY _CNV_A_R_LINEAR_____12_CM 4 0. 3. FORMAT "%2.0" AXIS_PTS_REF ldp_fmy_envd /end AXIS_DESCR
/end CHARACTERISTIC
/begin CHARACTERISTIC ID_ERR_ENVD_LS_UP_FRQ_2 "" CURVE 0x41612 _REC_CUR_20_u1_u1 255. _CNV_A_R_LINEAR_____12_CM 0. 255. FORMAT "%2.0"
 /begin AXIS_DESCR COM_AXIS ONLINE_DUMMY _CNV_A_R_LINEAR_____12_CM 4 0. 3. FORMAT "%2.0" AXIS_PTS_REF ldp_fmy_envd /end AXIS_DESCR
/end CHARACTERISTIC
/begin CHARACTERISTIC ID_ERR_ENVD_VLS_DOWN_MIN_COLD_1 "" CURVE 0x40664 _REC_CUR_20_u1_u1 255. _CNV_A_R_LINEAR_____12_CM 0. 255. FORMAT "%2.0"
 /begin AXIS_DESCR COM_AXIS ONLINE_DUMMY _CNV_A_R_LINEAR_____12_CM 4 0. 3. FORMAT "%2.0" AXIS_PTS_REF ldp_fmy_envd /end AXIS_DESCR
/end CHARACTERISTIC
/begin CHARACTERISTIC ID_ERR_ENVD_VLS_DOWN_MIN_COLD_2 "" CURVE 0x40676 _REC_CUR_20_u1_u1 255. _CNV_A_R_LINEAR_____12_CM 0. 255. FORMAT "%2.0"
 /begin AXIS_DESCR COM_AXIS ONLINE_DUMMY _CNV_A_R_LINEAR_____12_CM 4 0. 3. FORMAT "%2.0" AXIS_PTS_REF ldp_fmy_envd /end AXIS_DESCR
/end CHARACTERISTIC
/begin CHARACTERISTIC ID_ERR_ENVD_BN_POW_VB "" CURVE 0x4139c _REC_CUR_20_u1_u1 255. _CNV_A_R_LINEAR_____12_CM 0. 255. FORMAT "%2.0"
 /begin AXIS_DESCR COM_AXIS ONLINE_DUMMY _CNV_A_R_LINEAR_____12_CM 4 0. 3. FORMAT "%2.0" AXIS_PTS_REF ldp_fmy_envd /end AXIS_DESCR
/end CHARACTERISTIC
/begin CHARACTERISTIC ID_ERR_ENVD_SOF_REQ "" CURVE 0x411da _REC_CUR_20_u1_u1 255. _CNV_A_R_LINEAR_____12_CM 0. 255. FORMAT "%2.0"
 /begin AXIS_DESCR COM_AXIS ONLINE_DUMMY _CNV_A_R_LINEAR_____12_CM 4 0. 3. FORMAT "%2.0" AXIS_PTS_REF ldp_fmy_envd /end AXIS_DESCR
/end CHARACTERISTIC
/begin CHARACTERISTIC ID_ERR_ENVD_MSR_INH_MON_1 "" CURVE 0x40f76 _REC_CUR_20_u1_u1 255. _CNV_A_R_LINEAR_____12_CM 0. 255. FORMAT "%2.0"
 /begin AXIS_DESCR COM_AXIS ONLINE_DUMMY _CNV_A_R_LINEAR_____12_CM 4 0. 3. FORMAT "%2.0" AXIS_PTS_REF ldp_fmy_envd /end AXIS_DESCR
/end CHARACTERISTIC
/begin CHARACTERISTIC ID_ERR_ENVD_ECF "" CURVE 0x40d12 _REC_CUR_20_u1_u1 255. _CNV_A_R_LINEAR_____12_CM 0. 255. FORMAT "%2.0"
 /begin AXIS_DESCR COM_AXIS ONLINE_DUMMY _CNV_A_R_LINEAR_____12_CM 4 0. 3. FORMAT "%2.0" AXIS_PTS_REF ldp_fmy_envd /end AXIS_DESCR
/end CHARACTERISTIC
/begin CHARACTERISTIC ID_ERR_ENVD_MIS_LOW_FUEL "" CURVE 0x40e8c _REC_CUR_20_u1_u1 255. _CNV_A_R_LINEAR_____12_CM 0. 255. FORMAT "%2.0"
 /begin AXIS_DESCR COM_AXIS ONLINE_DUMMY _CNV_A_R_LINEAR_____12_CM 4 0. 3. FORMAT "%2.0" AXIS_PTS_REF ldp_fmy_envd /end AXIS_DESCR
/end CHARACTERISTIC
/begin CHARACTERISTIC ID_ERR_ENVD_DMTLM "" CURVE 0x411a4 _REC_CUR_20_u1_u1 255. _CNV_A_R_LINEAR_____12_CM 0. 255. FORMAT "%2.0"
 /begin AXIS_DESCR COM_AXIS ONLINE_DUMMY _CNV_A_R_LINEAR_____12_CM 4 0. 3. FORMAT "%2.0" AXIS_PTS_REF ldp_fmy_envd /end AXIS_DESCR
/end CHARACTERISTIC
/begin CHARACTERISTIC ID_ERR_ENVD_CAM_1_NOT_PLAUS "" CURVE 0x40c3a _REC_CUR_20_u1_u1 255. _CNV_A_R_LINEAR_____12_CM 0. 255. FORMAT "%2.0"
 /begin AXIS_DESCR COM_AXIS ONLINE_DUMMY _CNV_A_R_LINEAR_____12_CM 4 0. 3. FORMAT "%2.0" AXIS_PTS_REF ldp_fmy_envd /end AXIS_DESCR
/end CHARACTERISTIC
/begin CHARACTERISTIC ID_ERR_ENVD_DMTLS "" CURVE 0x41180 _REC_CUR_20_u1_u1 255. _CNV_A_R_LINEAR_____12_CM 0. 255. FORMAT "%2.0"
 /begin AXIS_DESCR COM_AXIS ONLINE_DUMMY _CNV_A_R_LINEAR_____12_CM 4 0. 3. FORMAT "%2.0" AXIS_PTS_REF ldp_fmy_envd /end AXIS_DESCR
/end CHARACTERISTIC
/begin CHARACTERISTIC ID_ERR_ENVD_RLY_ACCOUT "" CURVE 0x40cdc _REC_CUR_20_u1_u1 255. _CNV_A_R_LINEAR_____12_CM 0. 255. FORMAT "%2.0"
 /begin AXIS_DESCR COM_AXIS ONLINE_DUMMY _CNV_A_R_LINEAR_____12_CM 4 0. 3. FORMAT "%2.0" AXIS_PTS_REF ldp_fmy_envd /end AXIS_DESCR
/end CHARACTERISTIC
/begin CHARACTERISTIC ID_ERR_ENVD_LOCAN_BOFF "" CURVE 0x41474 _REC_CUR_20_u1_u1 255. _CNV_A_R_LINEAR_____12_CM 0. 255. FORMAT "%2.0"
 /begin AXIS_DESCR COM_AXIS ONLINE_DUMMY _CNV_A_R_LINEAR_____12_CM 4 0. 3. FORMAT "%2.0" AXIS_PTS_REF ldp_fmy_envd /end AXIS_DESCR
/end CHARACTERISTIC
/begin CHARACTERISTIC ID_ERR_ENVD_IV_0 "" CURVE 0x406f4 _REC_CUR_20_u1_u1 255. _CNV_A_R_LINEAR_____12_CM 0. 255. FORMAT "%2.0"
 /begin AXIS_DESCR COM_AXIS ONLINE_DUMMY _CNV_A_R_LINEAR_____12_CM 4 0. 3. FORMAT "%2.0" AXIS_PTS_REF ldp_fmy_envd /end AXIS_DESCR
/end CHARACTERISTIC
/begin CHARACTERISTIC ID_ERR_ENVD_IV_1 "" CURVE 0x40706 _REC_CUR_20_u1_u1 255. _CNV_A_R_LINEAR_____12_CM 0. 255. FORMAT "%2.0"
 /begin AXIS_DESCR COM_AXIS ONLINE_DUMMY _CNV_A_R_LINEAR_____12_CM 4 0. 3. FORMAT "%2.0" AXIS_PTS_REF ldp_fmy_envd /end AXIS_DESCR
/end CHARACTERISTIC
/begin CHARACTERISTIC ID_ERR_ENVD_IV_2 "" CURVE 0x40718 _REC_CUR_20_u1_u1 255. _CNV_A_R_LINEAR_____12_CM 0. 255. FORMAT "%2.0"
 /begin AXIS_DESCR COM_AXIS ONLINE_DUMMY _CNV_A_R_LINEAR_____12_CM 4 0. 3. FORMAT "%2.0" AXIS_PTS_REF ldp_fmy_envd /end AXIS_DESCR
/end CHARACTERISTIC
/begin CHARACTERISTIC ID_ERR_ENVD_SLV_IVVT_EX_1 "" CURVE 0x40880 _REC_CUR_20_u1_u1 255. _CNV_A_R_LINEAR_____12_CM 0. 255. FORMAT "%2.0"
 /begin AXIS_DESCR COM_AXIS ONLINE_DUMMY _CNV_A_R_LINEAR_____12_CM 4 0. 3. FORMAT "%2.0" AXIS_PTS_REF ldp_fmy_envd /end AXIS_DESCR
/end CHARACTERISTIC
/begin CHARACTERISTIC ID_ERR_ENVD_RLY_MAIN "" CURVE 0x40cb8 _REC_CUR_20_u1_u1 255. _CNV_A_R_LINEAR_____12_CM 0. 255. FORMAT "%2.0"
 /begin AXIS_DESCR COM_AXIS ONLINE_DUMMY _CNV_A_R_LINEAR_____12_CM 4 0. 3. FORMAT "%2.0" AXIS_PTS_REF ldp_fmy_envd /end AXIS_DESCR
/end CHARACTERISTIC
/begin CHARACTERISTIC ID_ERR_ENVD_IV_3 "" CURVE 0x4072a _REC_CUR_20_u1_u1 255. _CNV_A_R_LINEAR_____12_CM 0. 255. FORMAT "%2.0"
 /begin AXIS_DESCR COM_AXIS ONLINE_DUMMY _CNV_A_R_LINEAR_____12_CM 4 0. 3. FORMAT "%2.0" AXIS_PTS_REF ldp_fmy_envd /end AXIS_DESCR
/end CHARACTERISTIC
/begin CHARACTERISTIC ID_ERR_ENVD_SLV_IVVT_EX_2 "" CURVE 0x40892 _REC_CUR_20_u1_u1 255. _CNV_A_R_LINEAR_____12_CM 0. 255. FORMAT "%2.0"
 /begin AXIS_DESCR COM_AXIS ONLINE_DUMMY _CNV_A_R_LINEAR_____12_CM 4 0. 3. FORMAT "%2.0" AXIS_PTS_REF ldp_fmy_envd /end AXIS_DESCR
/end CHARACTERISTIC
/begin CHARACTERISTIC ID_ERR_ENVD_IV_4 "" CURVE 0x4073c _REC_CUR_20_u1_u1 255. _CNV_A_R_LINEAR_____12_CM 0. 255. FORMAT "%2.0"
 /begin AXIS_DESCR COM_AXIS ONLINE_DUMMY _CNV_A_R_LINEAR_____12_CM 4 0. 3. FORMAT "%2.0" AXIS_PTS_REF ldp_fmy_envd /end AXIS_DESCR
/end CHARACTERISTIC
/begin CHARACTERISTIC ID_ERR_ENVD_IV_5 "" CURVE 0x4074e _REC_CUR_20_u1_u1 255. _CNV_A_R_LINEAR_____12_CM 0. 255. FORMAT "%2.0"
 /begin AXIS_DESCR COM_AXIS ONLINE_DUMMY _CNV_A_R_LINEAR_____12_CM 4 0. 3. FORMAT "%2.0" AXIS_PTS_REF ldp_fmy_envd /end AXIS_DESCR
/end CHARACTERISTIC
/begin CHARACTERISTIC ID_ERR_ENVD_MAF_MON_1 "" CURVE 0x40f9a _REC_CUR_20_u1_u1 255. _CNV_A_R_LINEAR_____12_CM 0. 255. FORMAT "%2.0"
 /begin AXIS_DESCR COM_AXIS ONLINE_DUMMY _CNV_A_R_LINEAR_____12_CM 4 0. 3. FORMAT "%2.0" AXIS_PTS_REF ldp_fmy_envd /end AXIS_DESCR
/end CHARACTERISTIC
/begin CHARACTERISTIC ID_ERR_ENVD_VLS_DOWN_OC_1 "" CURVE 0x406ac _REC_CUR_20_u1_u1 255. _CNV_A_R_LINEAR_____12_CM 0. 255. FORMAT "%2.0"
 /begin AXIS_DESCR COM_AXIS ONLINE_DUMMY _CNV_A_R_LINEAR_____12_CM 4 0. 3. FORMAT "%2.0" AXIS_PTS_REF ldp_fmy_envd /end AXIS_DESCR
/end CHARACTERISTIC
/begin CHARACTERISTIC ID_ERR_ENVD_VLS_DOWN_OC_2 "" CURVE 0x406be _REC_CUR_20_u1_u1 255. _CNV_A_R_LINEAR_____12_CM 0. 255. FORMAT "%2.0"
 /begin AXIS_DESCR COM_AXIS ONLINE_DUMMY _CNV_A_R_LINEAR_____12_CM 4 0. 3. FORMAT "%2.0" AXIS_PTS_REF ldp_fmy_envd /end AXIS_DESCR
/end CHARACTERISTIC
/begin CHARACTERISTIC ID_ERR_ENVD_CAM_PSN_0 "" CURVE 0x40c04 _REC_CUR_20_u1_u1 255. _CNV_A_R_LINEAR_____12_CM 0. 255. FORMAT "%2.0"
 /begin AXIS_DESCR COM_AXIS ONLINE_DUMMY _CNV_A_R_LINEAR_____12_CM 4 0. 3. FORMAT "%2.0" AXIS_PTS_REF ldp_fmy_envd /end AXIS_DESCR
/end CHARACTERISTIC
/begin CHARACTERISTIC ID_ERR_ENVD_CAM_PSN_1 "" CURVE 0x40c16 _REC_CUR_20_u1_u1 255. _CNV_A_R_LINEAR_____12_CM 0. 255. FORMAT "%2.0"
 /begin AXIS_DESCR COM_AXIS ONLINE_DUMMY _CNV_A_R_LINEAR_____12_CM 4 0. 3. FORMAT "%2.0" AXIS_PTS_REF ldp_fmy_envd /end AXIS_DESCR
/end CHARACTERISTIC
/begin CHARACTERISTIC ID_ERR_ENVD_LOAD_TPS_PLAUS "" CURVE 0x413e4 _REC_CUR_20_u1_u1 255. _CNV_A_R_LINEAR_____12_CM 0. 255. FORMAT "%2.0"
 /begin AXIS_DESCR COM_AXIS ONLINE_DUMMY _CNV_A_R_LINEAR_____12_CM 4 0. 3. FORMAT "%2.0" AXIS_PTS_REF ldp_fmy_envd /end AXIS_DESCR
/end CHARACTERISTIC
/begin CHARACTERISTIC ID_ERR_ENVD_RLY_ST "" CURVE 0x411ec _REC_CUR_20_u1_u1 255. _CNV_A_R_LINEAR_____12_CM 0. 255. FORMAT "%2.0"
 /begin AXIS_DESCR COM_AXIS ONLINE_DUMMY _CNV_A_R_LINEAR_____12_CM 4 0. 3. FORMAT "%2.0" AXIS_PTS_REF ldp_fmy_envd /end AXIS_DESCR
/end CHARACTERISTIC
/begin CHARACTERISTIC ID_ERR_ENVD_TQ_LOSS_MON_1 "" CURVE 0x40ef8 _REC_CUR_20_u1_u1 255. _CNV_A_R_LINEAR_____12_CM 0. 255. FORMAT "%2.0"
 /begin AXIS_DESCR COM_AXIS ONLINE_DUMMY _CNV_A_R_LINEAR_____12_CM 4 0. 3. FORMAT "%2.0" AXIS_PTS_REF ldp_fmy_envd /end AXIS_DESCR
/end CHARACTERISTIC
/begin CHARACTERISTIC ID_ERR_ENVD_OBD2_LSH_UP_1 "" CURVE 0x41138 _REC_CUR_20_u1_u1 255. _CNV_A_R_LINEAR_____12_CM 0. 255. FORMAT "%2.0"
 /begin AXIS_DESCR COM_AXIS ONLINE_DUMMY _CNV_A_R_LINEAR_____12_CM 4 0. 3. FORMAT "%2.0" AXIS_PTS_REF ldp_fmy_envd /end AXIS_DESCR
/end CHARACTERISTIC
/begin CHARACTERISTIC ID_ERR_ENVD_DIAGCPS "" CURVE 0x41234 _REC_CUR_20_u1_u1 255. _CNV_A_R_LINEAR_____12_CM 0. 255. FORMAT "%2.0"
 /begin AXIS_DESCR COM_AXIS ONLINE_DUMMY _CNV_A_R_LINEAR_____12_CM 4 0. 3. FORMAT "%2.0" AXIS_PTS_REF ldp_fmy_envd /end AXIS_DESCR
/end CHARACTERISTIC
/begin CHARACTERISTIC ID_ERR_ENVD_OBD2_LSH_UP_2 "" CURVE 0x4114a _REC_CUR_20_u1_u1 255. _CNV_A_R_LINEAR_____12_CM 0. 255. FORMAT "%2.0"
 /begin AXIS_DESCR COM_AXIS ONLINE_DUMMY _CNV_A_R_LINEAR_____12_CM 4 0. 3. FORMAT "%2.0" AXIS_PTS_REF ldp_fmy_envd /end AXIS_DESCR
/end CHARACTERISTIC
/begin CHARACTERISTIC ID_ERR_ENVD_TOOTH_PER "" CURVE 0x40c5e _REC_CUR_20_u1_u1 255. _CNV_A_R_LINEAR_____12_CM 0. 255. FORMAT "%2.0"
 /begin AXIS_DESCR COM_AXIS ONLINE_DUMMY _CNV_A_R_LINEAR_____12_CM 4 0. 3. FORMAT "%2.0" AXIS_PTS_REF ldp_fmy_envd /end AXIS_DESCR
/end CHARACTERISTIC
/begin CHARACTERISTIC ID_ERR_ENVD_TPS_1 "" CURVE 0x40a66 _REC_CUR_20_u1_u1 255. _CNV_A_R_LINEAR_____12_CM 0. 255. FORMAT "%2.0"
 /begin AXIS_DESCR COM_AXIS ONLINE_DUMMY _CNV_A_R_LINEAR_____12_CM 4 0. 3. FORMAT "%2.0" AXIS_PTS_REF ldp_fmy_envd /end AXIS_DESCR
/end CHARACTERISTIC
/begin CHARACTERISTIC ID_ERR_ENVD_TPS_2 "" CURVE 0x40a78 _REC_CUR_20_u1_u1 255. _CNV_A_R_LINEAR_____12_CM 0. 255. FORMAT "%2.0"
 /begin AXIS_DESCR COM_AXIS ONLINE_DUMMY _CNV_A_R_LINEAR_____12_CM 4 0. 3. FORMAT "%2.0" AXIS_PTS_REF ldp_fmy_envd /end AXIS_DESCR
/end CHARACTERISTIC
/begin CHARACTERISTIC ID_ERR_ENVD_DMTL_LEAK "" CURVE 0x411b6 _REC_CUR_20_u1_u1 255. _CNV_A_R_LINEAR_____12_CM 0. 255. FORMAT "%2.0"
 /begin AXIS_DESCR COM_AXIS ONLINE_DUMMY _CNV_A_R_LINEAR_____12_CM 4 0. 3. FORMAT "%2.0" AXIS_PTS_REF ldp_fmy_envd /end AXIS_DESCR
/end CHARACTERISTIC
/begin CHARACTERISTIC ID_ERR_ENVD_TQI_LIM "" CURVE 0x41114 _REC_CUR_20_u1_u1 255. _CNV_A_R_LINEAR_____12_CM 0. 255. FORMAT "%2.0"
 /begin AXIS_DESCR COM_AXIS ONLINE_DUMMY _CNV_A_R_LINEAR_____12_CM 4 0. 3. FORMAT "%2.0" AXIS_PTS_REF ldp_fmy_envd /end AXIS_DESCR
/end CHARACTERISTIC
/begin CHARACTERISTIC ID_ERR_ENVD_IM_BLS_PLAUS "" CURVE 0x40da2 _REC_CUR_20_u1_u1 255. _CNV_A_R_LINEAR_____12_CM 0. 255. FORMAT "%2.0"
 /begin AXIS_DESCR COM_AXIS ONLINE_DUMMY _CNV_A_R_LINEAR_____12_CM 4 0. 3. FORMAT "%2.0" AXIS_PTS_REF ldp_fmy_envd /end AXIS_DESCR
/end CHARACTERISTIC
/begin CHARACTERISTIC ID_ERR_ENVD_TQI_N_MAX_NVMY_MON "" CURVE 0x40fbe _REC_CUR_20_u1_u1 255. _CNV_A_R_LINEAR_____12_CM 0. 255. FORMAT "%2.0"
 /begin AXIS_DESCR COM_AXIS ONLINE_DUMMY _CNV_A_R_LINEAR_____12_CM 4 0. 3. FORMAT "%2.0" AXIS_PTS_REF ldp_fmy_envd /end AXIS_DESCR
/end CHARACTERISTIC
/begin CHARACTERISTIC ID_ERR_ENVD_VS "" CURVE 0x40958 _REC_CUR_20_u1_u1 255. _CNV_A_R_LINEAR_____12_CM 0. 255. FORMAT "%2.0"
 /begin AXIS_DESCR COM_AXIS ONLINE_DUMMY _CNV_A_R_LINEAR_____12_CM 4 0. 3. FORMAT "%2.0" AXIS_PTS_REF ldp_fmy_envd /end AXIS_DESCR
/end CHARACTERISTIC
/begin CHARACTERISTIC ID_ERR_ENVD_TOUT_EFP "" CURVE 0x41222 _REC_CUR_20_u1_u1 255. _CNV_A_R_LINEAR_____12_CM 0. 255. FORMAT "%2.0"
 /begin AXIS_DESCR COM_AXIS ONLINE_DUMMY _CNV_A_R_LINEAR_____12_CM 4 0. 3. FORMAT "%2.0" AXIS_PTS_REF ldp_fmy_envd /end AXIS_DESCR
/end CHARACTERISTIC
/begin CHARACTERISTIC ID_ERR_ENVD_EFP_TEMP "" CURVE 0x41450 _REC_CUR_20_u1_u1 255. _CNV_A_R_LINEAR_____12_CM 0. 255. FORMAT "%2.0"
 /begin AXIS_DESCR COM_AXIS ONLINE_DUMMY _CNV_A_R_LINEAR_____12_CM 4 0. 3. FORMAT "%2.0" AXIS_PTS_REF ldp_fmy_envd /end AXIS_DESCR
/end CHARACTERISTIC
/begin CHARACTERISTIC ID_ERR_ENVD_EFP_LIH "" CURVE 0x41462 _REC_CUR_20_u1_u1 255. _CNV_A_R_LINEAR_____12_CM 0. 255. FORMAT "%2.0"
 /begin AXIS_DESCR COM_AXIS ONLINE_DUMMY _CNV_A_R_LINEAR_____12_CM 4 0. 3. FORMAT "%2.0" AXIS_PTS_REF ldp_fmy_envd /end AXIS_DESCR
/end CHARACTERISTIC
/begin CHARACTERISTIC ID_ERR_ENVD_TPS_ST_CHK_1 "" CURVE 0x40b86 _REC_CUR_20_u1_u1 255. _CNV_A_R_LINEAR_____12_CM 0. 255. FORMAT "%2.0"
 /begin AXIS_DESCR COM_AXIS ONLINE_DUMMY _CNV_A_R_LINEAR_____12_CM 4 0. 3. FORMAT "%2.0" AXIS_PTS_REF ldp_fmy_envd /end AXIS_DESCR
/end CHARACTERISTIC
/begin CHARACTERISTIC ID_ERR_ENVD_VLS_UP_MIN_1 "" CURVE 0x41504 _REC_CUR_20_u1_u1 255. _CNV_A_R_LINEAR_____12_CM 0. 255. FORMAT "%2.0"
 /begin AXIS_DESCR COM_AXIS ONLINE_DUMMY _CNV_A_R_LINEAR_____12_CM 4 0. 3. FORMAT "%2.0" AXIS_PTS_REF ldp_fmy_envd /end AXIS_DESCR
/end CHARACTERISTIC
/begin CHARACTERISTIC ID_ERR_ENVD_TPS_ST_CHK_2 "" CURVE 0x40b98 _REC_CUR_20_u1_u1 255. _CNV_A_R_LINEAR_____12_CM 0. 255. FORMAT "%2.0"
 /begin AXIS_DESCR COM_AXIS ONLINE_DUMMY _CNV_A_R_LINEAR_____12_CM 4 0. 3. FORMAT "%2.0" AXIS_PTS_REF ldp_fmy_envd /end AXIS_DESCR
/end CHARACTERISTIC
/begin CHARACTERISTIC ID_ERR_ENVD_VLS_UP_MIN_2 "" CURVE 0x41516 _REC_CUR_20_u1_u1 255. _CNV_A_R_LINEAR_____12_CM 0. 255. FORMAT "%2.0"
 /begin AXIS_DESCR COM_AXIS ONLINE_DUMMY _CNV_A_R_LINEAR_____12_CM 4 0. 3. FORMAT "%2.0" AXIS_PTS_REF ldp_fmy_envd /end AXIS_DESCR
/end CHARACTERISTIC
/begin CHARACTERISTIC ID_ERR_ENVD_GEN_IF "" CURVE 0x40bbc _REC_CUR_20_u1_u1 255. _CNV_A_R_LINEAR_____12_CM 0. 255. FORMAT "%2.0"
 /begin AXIS_DESCR COM_AXIS ONLINE_DUMMY _CNV_A_R_LINEAR_____12_CM 4 0. 3. FORMAT "%2.0" AXIS_PTS_REF ldp_fmy_envd /end AXIS_DESCR
/end CHARACTERISTIC
/begin CHARACTERISTIC ID_ERR_ENVD_TPS_AD_BOL "" CURVE 0x40b74 _REC_CUR_20_u1_u1 255. _CNV_A_R_LINEAR_____12_CM 0. 255. FORMAT "%2.0"
 /begin AXIS_DESCR COM_AXIS ONLINE_DUMMY _CNV_A_R_LINEAR_____12_CM 4 0. 3. FORMAT "%2.0" AXIS_PTS_REF ldp_fmy_envd /end AXIS_DESCR
/end CHARACTERISTIC
/begin CHARACTERISTIC ID_ERR_ENVD_OBD2_LSH_DOWN_1 "" CURVE 0x4115c _REC_CUR_20_u1_u1 255. _CNV_A_R_LINEAR_____12_CM 0. 255. FORMAT "%2.0"
 /begin AXIS_DESCR COM_AXIS ONLINE_DUMMY _CNV_A_R_LINEAR_____12_CM 4 0. 3. FORMAT "%2.0" AXIS_PTS_REF ldp_fmy_envd /end AXIS_DESCR
/end CHARACTERISTIC
/begin CHARACTERISTIC ID_ERR_ENVD_VLS_DOWN_MIN_1 "" CURVE 0x40688 _REC_CUR_20_u1_u1 255. _CNV_A_R_LINEAR_____12_CM 0. 255. FORMAT "%2.0"
 /begin AXIS_DESCR COM_AXIS ONLINE_DUMMY _CNV_A_R_LINEAR_____12_CM 4 0. 3. FORMAT "%2.0" AXIS_PTS_REF ldp_fmy_envd /end AXIS_DESCR
/end CHARACTERISTIC
/begin CHARACTERISTIC ID_ERR_ENVD_TCO_GRD "" CURVE 0x40d48 _REC_CUR_20_u1_u1 255. _CNV_A_R_LINEAR_____12_CM 0. 255. FORMAT "%2.0"
 /begin AXIS_DESCR COM_AXIS ONLINE_DUMMY _CNV_A_R_LINEAR_____12_CM 4 0. 3. FORMAT "%2.0" AXIS_PTS_REF ldp_fmy_envd /end AXIS_DESCR
/end CHARACTERISTIC
/begin CHARACTERISTIC ID_ERR_ENVD_OBD2_LSH_DOWN_2 "" CURVE 0x4116e _REC_CUR_20_u1_u1 255. _CNV_A_R_LINEAR_____12_CM 0. 255. FORMAT "%2.0"
 /begin AXIS_DESCR COM_AXIS ONLINE_DUMMY _CNV_A_R_LINEAR_____12_CM 4 0. 3. FORMAT "%2.0" AXIS_PTS_REF ldp_fmy_envd /end AXIS_DESCR
/end CHARACTERISTIC
/begin CHARACTERISTIC ID_ERR_ENVD_VLS_DOWN_MIN_2 "" CURVE 0x4069a _REC_CUR_20_u1_u1 255. _CNV_A_R_LINEAR_____12_CM 0. 255. FORMAT "%2.0"
 /begin AXIS_DESCR COM_AXIS ONLINE_DUMMY _CNV_A_R_LINEAR_____12_CM 4 0. 3. FORMAT "%2.0" AXIS_PTS_REF ldp_fmy_envd /end AXIS_DESCR
/end CHARACTERISTIC
/begin CHARACTERISTIC ID_ERR_ENVD_IM_BTS_PLAUS "" CURVE 0x40db4 _REC_CUR_20_u1_u1 255. _CNV_A_R_LINEAR_____12_CM 0. 255. FORMAT "%2.0"
 /begin AXIS_DESCR COM_AXIS ONLINE_DUMMY _CNV_A_R_LINEAR_____12_CM 4 0. 3. FORMAT "%2.0" AXIS_PTS_REF ldp_fmy_envd /end AXIS_DESCR
/end CHARACTERISTIC
/begin CHARACTERISTIC ID_ERR_ENVD_REF_IVVT_IN_1 "" CURVE 0x40814 _REC_CUR_20_u1_u1 255. _CNV_A_R_LINEAR_____12_CM 0. 255. FORMAT "%2.0"
 /begin AXIS_DESCR COM_AXIS ONLINE_DUMMY _CNV_A_R_LINEAR_____12_CM 4 0. 3. FORMAT "%2.0" AXIS_PTS_REF ldp_fmy_envd /end AXIS_DESCR
/end CHARACTERISTIC
/begin CHARACTERISTIC ID_ERR_ENVD_REF_IVVT_IN_2 "" CURVE 0x40826 _REC_CUR_20_u1_u1 255. _CNV_A_R_LINEAR_____12_CM 0. 255. FORMAT "%2.0"
 /begin AXIS_DESCR COM_AXIS ONLINE_DUMMY _CNV_A_R_LINEAR_____12_CM 4 0. 3. FORMAT "%2.0" AXIS_PTS_REF ldp_fmy_envd /end AXIS_DESCR
/end CHARACTERISTIC
/begin CHARACTERISTIC ID_ERR_ENVD_BN_TQ_ETCU "" CURVE 0x4130c _REC_CUR_20_u1_u1 255. _CNV_A_R_LINEAR_____12_CM 0. 255. FORMAT "%2.0"
 /begin AXIS_DESCR COM_AXIS ONLINE_DUMMY _CNV_A_R_LINEAR_____12_CM 4 0. 3. FORMAT "%2.0" AXIS_PTS_REF ldp_fmy_envd /end AXIS_DESCR
/end CHARACTERISTIC
/begin CHARACTERISTIC ID_ERR_ENVD_TQ_MIN_CLU_MON_1 "" CURVE 0x40f0a _REC_CUR_20_u1_u1 255. _CNV_A_R_LINEAR_____12_CM 0. 255. FORMAT "%2.0"
 /begin AXIS_DESCR COM_AXIS ONLINE_DUMMY _CNV_A_R_LINEAR_____12_CM 4 0. 3. FORMAT "%2.0" AXIS_PTS_REF ldp_fmy_envd /end AXIS_DESCR
/end CHARACTERISTIC
/begin MEASUREMENT LV_ERR_DMTL_LEAK "error leak detection" UBYTE _CNV_S_2_RANGE______28_CM 1 100. 0. 1. ECU_ADDRESS 0x3fd5f3 /end MEASUREMENT
/begin CHARACTERISTIC ID_ERR_ENVD_BN_VEH_MOD "" CURVE 0x41366 _REC_CUR_20_u1_u1 255. _CNV_A_R_LINEAR_____12_CM 0. 255. FORMAT "%2.0"
 /begin AXIS_DESCR COM_AXIS ONLINE_DUMMY _CNV_A_R_LINEAR_____12_CM 4 0. 3. FORMAT "%2.0" AXIS_PTS_REF ldp_fmy_envd /end AXIS_DESCR
/end CHARACTERISTIC
/begin CHARACTERISTIC ID_ERR_ENVD_QOIL_SENS "" CURVE 0x414aa _REC_CUR_20_u1_u1 255. _CNV_A_R_LINEAR_____12_CM 0. 255. FORMAT "%2.0"
 /begin AXIS_DESCR COM_AXIS ONLINE_DUMMY _CNV_A_R_LINEAR_____12_CM 4 0. 3. FORMAT "%2.0" AXIS_PTS_REF ldp_fmy_envd /end AXIS_DESCR
/end CHARACTERISTIC
/begin CHARACTERISTIC ID_ERR_ENVD_EF "" CURVE 0x410cc _REC_CUR_20_u1_u1 255. _CNV_A_R_LINEAR_____12_CM 0. 255. FORMAT "%2.0"
 /begin AXIS_DESCR COM_AXIS ONLINE_DUMMY _CNV_A_R_LINEAR_____12_CM 4 0. 3. FORMAT "%2.0" AXIS_PTS_REF ldp_fmy_envd /end AXIS_DESCR
/end CHARACTERISTIC
/begin CHARACTERISTIC ID_ERR_ENVD_TOIL_LEVEL "" CURVE 0x408b6 _REC_CUR_20_u1_u1 255. _CNV_A_R_LINEAR_____12_CM 0. 255. FORMAT "%2.0"
 /begin AXIS_DESCR COM_AXIS ONLINE_DUMMY _CNV_A_R_LINEAR_____12_CM 4 0. 3. FORMAT "%2.0" AXIS_PTS_REF ldp_fmy_envd /end AXIS_DESCR
/end CHARACTERISTIC
/begin CHARACTERISTIC ID_ERR_ENVD_AMP "" CURVE 0x4061c _REC_CUR_20_u1_u1 255. _CNV_A_R_LINEAR_____12_CM 0. 255. FORMAT "%2.0"
 /begin AXIS_DESCR COM_AXIS ONLINE_DUMMY _CNV_A_R_LINEAR_____12_CM 4 0. 3. FORMAT "%2.0" AXIS_PTS_REF ldp_fmy_envd /end AXIS_DESCR
/end CHARACTERISTIC
/begin CHARACTERISTIC ID_ERR_ENVD_RLY_MAIN_DLY "" CURVE 0x40cca _REC_CUR_20_u1_u1 255. _CNV_A_R_LINEAR_____12_CM 0. 255. FORMAT "%2.0"
 /begin AXIS_DESCR COM_AXIS ONLINE_DUMMY _CNV_A_R_LINEAR_____12_CM 4 0. 3. FORMAT "%2.0" AXIS_PTS_REF ldp_fmy_envd /end AXIS_DESCR
/end CHARACTERISTIC
/begin CHARACTERISTIC ID_ERR_ENVD_ISC "" CURVE 0x40d90 _REC_CUR_20_u1_u1 255. _CNV_A_R_LINEAR_____12_CM 0. 255. FORMAT "%2.0"
 /begin AXIS_DESCR COM_AXIS ONLINE_DUMMY _CNV_A_R_LINEAR_____12_CM 4 0. 3. FORMAT "%2.0" AXIS_PTS_REF ldp_fmy_envd /end AXIS_DESCR
/end CHARACTERISTIC
/begin MEASUREMENT LV_INH_DIAG_OBD2_LSH_UP_1 "" ULONG _CNV_S_2_RANGE______28_CM 1 100. 0. 1. ECU_ADDRESS 0x3fa95c BIT_MASK 0x80000000 /end MEASUREMENT
/begin MEASUREMENT POW_INT_OBD2_LSH_UP_1 "Integral indicates measure of cooling energy of exhaust gas at sensor location" UWORD _CNV_A_R_LINEAR_____294_CM 1 100. 0. 65535. ECU_ADDRESS 0x3fa962 FORMAT "%5.0" /end MEASUREMENT
/begin MEASUREMENT STATE_OBD2_LSH_UP_1 "Indicates current phase of oxygen sensor heater OBDII diagnosis" UBYTE _CNV_S_9_STATE_OBD2_295_CM 1 100. 0. 8. ECU_ADDRESS 0x3fa960 /end MEASUREMENT
/begin MEASUREMENT TCC_OBD2_LSH_UP_1 "Number of completed valid diagnosis cycles" UWORD _CNV_A_R_LINEAR_____12_CM 1 100. 0. 1023. ECU_ADDRESS 0x3fa964 FORMAT "%4.0" /end MEASUREMENT
/begin MEASUREMENT FRC_OBD2_LSH_UP_1 "Number of faults detected during valid diagnosis cycles" UWORD _CNV_A_R_LINEAR_____12_CM 1 100. 0. 1023. ECU_ADDRESS 0x3fa966 FORMAT "%4.0" /end MEASUREMENT
/begin MEASUREMENT CTR_CYCNR_R_OBD2_LSH_UP_1 "Value of handshake counter for last valid resistance value used for diagnosis" UWORD _CNV_A_R_LINEAR_____10_CM 1 100. 0. 65535. ECU_ADDRESS 0x3fa968 FORMAT "%5.0" /end MEASUREMENT
/begin MEASUREMENT R_UP_LS_OBD2_LSH_UP_1 "Most current upstream oxygen sensor internal resistance used for diagnosis cycle, Mode 6 information" UWORD _CNV_A_R_LINEAR_____10_CM 1 100. 0. 65535. ECU_ADDRESS 0x3fa96a FORMAT "%5.0" /end MEASUREMENT
/begin MEASUREMENT TEMP_DIF_OBD2_LSH_UP_1 "Indicates difference in temperature between set operating temperature & exhaust gas at sensor location" UWORD _CNV_A_R_LINEAR_____2_CM 1 100. 0. 2047. ECU_ADDRESS 0x3fa96c FORMAT "%4.0" /end MEASUREMENT
/begin MEASUREMENT LV_INH_DIAG_OBD2_LSH_UP_2 "" ULONG _CNV_S_2_RANGE______28_CM 1 100. 0. 1. ECU_ADDRESS 0x3fac74 BIT_MASK 0x80000000 /end MEASUREMENT
/begin MEASUREMENT POW_INT_OBD2_LSH_UP_2 "Integral indicates measure of cooling energy of exhaust gas at sensor location" UWORD _CNV_A_R_LINEAR_____294_CM 1 100. 0. 65535. ECU_ADDRESS 0x3fac7a FORMAT "%5.0" /end MEASUREMENT
/begin MEASUREMENT STATE_OBD2_LSH_UP_2 "Indicates current phase of oxygen sensor heater OBDII diagnosis" UBYTE _CNV_S_9_STATE_OBD2_295_CM 1 100. 0. 8. ECU_ADDRESS 0x3fac78 /end MEASUREMENT
/begin MEASUREMENT TCC_OBD2_LSH_UP_2 "Number of completed valid diagnosis cycles" UWORD _CNV_A_R_LINEAR_____12_CM 1 100. 0. 1023. ECU_ADDRESS 0x3fac7c FORMAT "%4.0" /end MEASUREMENT
/begin MEASUREMENT FRC_OBD2_LSH_UP_2 "Number of faults detected during valid diagnosis cycles" UWORD _CNV_A_R_LINEAR_____12_CM 1 100. 0. 1023. ECU_ADDRESS 0x3fac7e FORMAT "%4.0" /end MEASUREMENT
/begin MEASUREMENT CTR_CYCNR_R_OBD2_LSH_UP_2 "Value of handshake counter for last valid resistance value used for diagnosis" UWORD _CNV_A_R_LINEAR_____10_CM 1 100. 0. 65535. ECU_ADDRESS 0x3fac80 FORMAT "%5.0" /end MEASUREMENT
/begin MEASUREMENT R_UP_LS_OBD2_LSH_UP_2 "Most current upstream oxygen sensor internal resistance used for diagnosis cycle, Mode 6 information" UWORD _CNV_A_R_LINEAR_____10_CM 1 100. 0. 65535. ECU_ADDRESS 0x3fac82 FORMAT "%5.0" /end MEASUREMENT
/begin MEASUREMENT TEMP_DIF_OBD2_LSH_UP_2 "Indicates difference in temperature between set operating temperature & exhaust gas at sensor location" UWORD _CNV_A_R_LINEAR_____2_CM 1 100. 0. 2047. ECU_ADDRESS 0x3fac84 FORMAT "%4.0" /end MEASUREMENT
/begin CHARACTERISTIC ID_ERR_ENVD_CHG_LS_DOWN "" CURVE 0x41498 _REC_CUR_20_u1_u1 255. _CNV_A_R_LINEAR_____12_CM 0. 255. FORMAT "%2.0"
 /begin AXIS_DESCR COM_AXIS ONLINE_DUMMY _CNV_A_R_LINEAR_____12_CM 4 0. 3. FORMAT "%2.0" AXIS_PTS_REF ldp_fmy_envd /end AXIS_DESCR
/end CHARACTERISTIC
/begin CHARACTERISTIC ID_ERR_ENVD_CHG_LS_UP "" CURVE 0x41486 _REC_CUR_20_u1_u1 255. _CNV_A_R_LINEAR_____12_CM 0. 255. FORMAT "%2.0"
 /begin AXIS_DESCR COM_AXIS ONLINE_DUMMY _CNV_A_R_LINEAR_____12_CM 4 0. 3. FORMAT "%2.0" AXIS_PTS_REF ldp_fmy_envd /end AXIS_DESCR
/end CHARACTERISTIC
/begin MEASUREMENT LV_ERR_DMTLM "error DMTL module" UBYTE _CNV_S_2_RANGE______28_CM 1 100. 0. 1. ECU_ADDRESS 0x3fd5ef /end MEASUREMENT
/begin CHARACTERISTIC ID_ERR_ENVD_LAM_DLY_1 "" CURVE 0x415b8 _REC_CUR_20_u1_u1 255. _CNV_A_R_LINEAR_____12_CM 0. 255. FORMAT "%2.0"
 /begin AXIS_DESCR COM_AXIS ONLINE_DUMMY _CNV_A_R_LINEAR_____12_CM 4 0. 3. FORMAT "%2.0" AXIS_PTS_REF ldp_fmy_envd /end AXIS_DESCR
/end CHARACTERISTIC
/begin CHARACTERISTIC ID_ERR_ENVD_LAM_DLY_2 "" CURVE 0x415ca _REC_CUR_20_u1_u1 255. _CNV_A_R_LINEAR_____12_CM 0. 255. FORMAT "%2.0"
 /begin AXIS_DESCR COM_AXIS ONLINE_DUMMY _CNV_A_R_LINEAR_____12_CM 4 0. 3. FORMAT "%2.0" AXIS_PTS_REF ldp_fmy_envd /end AXIS_DESCR
/end CHARACTERISTIC
/begin CHARACTERISTIC IP_FAC_MAF_LSH_UP "Factor reflecting forced convection influence of cooling area, gas velocity and heat transfer coefficient" CURVE 0x4e231 _REC_CUR_20_u1_u2 15.9375 _CNV_A_R_LINEAR_____40_CM 0. 15.9375 FORMAT "%5.2"
 /begin AXIS_DESCR COM_AXIS MAF_KGH _CNV_A_R_LINEAR_____101_CM 6 0. 2047.96875 FORMAT "%7.2" AXIS_PTS_REF ldp_maf_kgh__fac_maf_lsh_up /end AXIS_DESCR
/end CHARACTERISTIC
/begin CHARACTERISTIC C_PWM_MIN_OBD2_LSH_UP "Minimum permitted heater effective voltage PWM for upstream LSH OBDII diagnosis " VALUE 0x4299a _REC_VAL_20_u1 99.609375 _CNV_A_R_LINEAR_____4_CM 0. 99.609375 FORMAT "%4.1" /end CHARACTERISTIC
/begin CHARACTERISTIC C_PWM_MAX_OBD2_LSH_UP "Maximum permitted heater effective voltage PWM for upstream LSH OBDII diagnosis " VALUE 0x42998 _REC_VAL_20_u1 99.609375 _CNV_A_R_LINEAR_____4_CM 0. 99.609375 FORMAT "%4.1" /end CHARACTERISTIC
/begin CHARACTERISTIC C_T_DLY_OBD2_LSH_UP "Minimum delay prior to checking status of OBDI heater / signal faults" VALUE 0x429f1 _REC_VAL_20_u1 255. _CNV_A_R_LINEAR_____47_CM 0. 255. FORMAT "%3.0" /end CHARACTERISTIC
/begin CHARACTERISTIC C_TEMP_MIN_OBD2_LSH_UP "Temperature threshold under which upstream LSH OBDII diagnosis activated" VALUE 0x4308a _REC_VAL_20_u2 2047. _CNV_A_R_LINEAR_____211_CM 0. 2047. FORMAT "%7.2" /end CHARACTERISTIC
/begin CHARACTERISTIC C_TEMP_SET_OBD2_LSH_UP "Set temperature for upstream LSH operation used to generate power integral" VALUE 0x4308e _REC_VAL_20_u2 2047. _CNV_A_R_LINEAR_____211_CM 0. 2047. FORMAT "%7.2" /end CHARACTERISTIC
/begin CHARACTERISTIC C_EGY_MIN_OBD2_LSH_UP "Measure of minimum required cooling energy required at upstream sensor prior to checking Ri threshold" VALUE 0x42ce6 _REC_VAL_20_u2 65535. _CNV_A_R_LINEAR_____294_CM 0. 65535. FORMAT "%5.0" /end CHARACTERISTIC
/begin CHARACTERISTIC C_R_THD_OBD2_LSH_UP "Internal resistance threshold, when exceeded, heater is determined to be defective for current diagnosis cycle" VALUE 0x42f16 _REC_VAL_20_u2 65535. _CNV_A_R_LINEAR_____285_CM 0. 65535. FORMAT "%5.0" /end CHARACTERISTIC
/begin CHARACTERISTIC C_TCC_OBD2_LSH_UP "Number of valid upstream LSH OBDII diagnosis cycles over which statistic evaluation to be carried out" VALUE 0x43050 _REC_VAL_20_u2 1023. _CNV_A_R_LINEAR_____12_CM 0. 1023. FORMAT "%4.0" /end CHARACTERISTIC
/begin CHARACTERISTIC C_FRC_OBD2_LSH_UP "Fault detection threshold, when exceeded, heater is determined to be defective during driving cycle" VALUE 0x42d7e _REC_VAL_20_u2 1023. _CNV_A_R_LINEAR_____12_CM 0. 1023. FORMAT "%4.0" /end CHARACTERISTIC
/begin AXIS_PTS ldp_maf_kgh__fac_maf_lsh_up "" 0x44606 MAF_KGH _REC_AXS_20_u2 2047.96875 _CNV_A_R_LINEAR_____101_CM 6 0. 2047.96875 FORMAT "%7.2" /end AXIS_PTS
/begin MEASUREMENT LV_INTR_DIAG_SA "Secondary air system diagnosis: application incidence to interrupt the diagnosis" UBYTE _CNV_S_2_RANGE______28_CM 1 100. 0. 1. ECU_ADDRESS 0x3fcc88 BIT_MASK 0x1 /end MEASUREMENT
/begin CHARACTERISTIC IP_N_32_MIN_DIAG_SA "Minimum speed to start the SA diagnosis" CURVE 0x4fb87 _REC_CUR_20_u1_u2 8160. _CNV_A_R_LINEAR_____5_CM 0. 8160. FORMAT "%4.0"
 /begin AXIS_DESCR COM_AXIS FAC_AMP _CNV_A_R_LINEAR_____45_CM 6 0. 1.99996948 FORMAT "%7.5" AXIS_PTS_REF ldpm_fac_amp /end AXIS_DESCR
/end CHARACTERISTIC
/begin CHARACTERISTIC IP_MAF_KGH_MAX_DIAG_SA "Maximum load [kg/h] for break-off the SA diagnosis" CURVE 0x4905e _REC_CUR_20_u2_u2 2047.96875 _CNV_A_R_LINEAR_____101_CM 0. 2047.96875 FORMAT "%7.2"
 /begin AXIS_DESCR COM_AXIS FAC_AMP _CNV_A_R_LINEAR_____45_CM 6 0. 1.99996948 FORMAT "%7.5" AXIS_PTS_REF ldpm_fac_amp /end AXIS_DESCR
/end CHARACTERISTIC
/begin CHARACTERISTIC IP_MAF_MAX_DIAG_SA "Maximum load [mg/str] for break-off the SA diagnosis" CURVE 0x4facb _REC_CUR_20_u1_u1 1389. _CNV_A_R_LINEAR_____18_CM 0. 1389. FORMAT "%4.0"
 /begin AXIS_DESCR COM_AXIS N_32 _CNV_A_R_LINEAR_____5_CM 8 0. 8160. FORMAT "%4.0" AXIS_PTS_REF ldp_n_32__maf_max_diag_sa /end AXIS_DESCR
/end CHARACTERISTIC
/begin CHARACTERISTIC C_TI_ADD_WF_MAX_DIAG_SA "Maximum TI_ADD_WF threshold to start the SA diagnosis" VALUE 0x432ca _REC_VAL_20_s2 262.14 _CNV_A_R_LINEAR_____208_CM -131.072 131.068 FORMAT "%8.3" /end CHARACTERISTIC
/begin CHARACTERISTIC C_TI_ADD_WF_MIN_DIAG_SA "Minimum TI_ADD_WF threshold to start the SA diagnosis" VALUE 0x432cc _REC_VAL_20_s2 262.14 _CNV_A_R_LINEAR_____208_CM -131.072 131.068 FORMAT "%8.3" /end CHARACTERISTIC
/begin CHARACTERISTIC LC_INH_SA_MAN_DEAC "Manual deactivation of SA diagnosis inhibition conditions" VALUE 0x42b9d _REC_VAL_20_u1 1. _CNV_A_R_LINEAR_____10_CM 0. 1. FORMAT "%2.0" /end CHARACTERISTIC
/begin CHARACTERISTIC ID_TCO_MIN_DIAG_SA "Minimum load [mg/str] to start the SA diagnosis" CURVE 0x4cfc5 _REC_CUR_20_u1_u1 190.5 _CNV_A_R_LINEAR_____0_CM -48. 142.5 FORMAT "%5.1"
 /begin AXIS_DESCR COM_AXIS TIA _CNV_A_R_LINEAR_____0_CM 6 -48. 142.5 FORMAT "%5.1" AXIS_PTS_REF ldp_tia_id_tco_min_diag_sa /end AXIS_DESCR
/end CHARACTERISTIC
/begin CHARACTERISTIC IP_MAF_MIN_DIAG_SA "Minimum load [mg/str] to start the SA diagnosis" CURVE 0x4faeb _REC_CUR_20_u1_u2 1389. _CNV_A_R_LINEAR_____18_CM 0. 1389. FORMAT "%4.0"
 /begin AXIS_DESCR COM_AXIS FAC_AMP _CNV_A_R_LINEAR_____45_CM 6 0. 1.99996948 FORMAT "%7.5" AXIS_PTS_REF ldpm_fac_amp /end AXIS_DESCR
/end CHARACTERISTIC
/begin CHARACTERISTIC C_N_32_MAX_DIAG_SA "Maximum speed to start the SA diagnosis" VALUE 0x42927 _REC_VAL_20_u1 8160. _CNV_A_R_LINEAR_____5_CM 0. 8160. FORMAT "%4.0" /end CHARACTERISTIC
/begin AXIS_PTS ldp_tia_id_tco_min_diag_sa "" 0x439e3 TIA _REC_AXS_20_u1 190.5 _CNV_A_R_LINEAR_____0_CM 6 -48. 142.5 FORMAT "%5.1" /end AXIS_PTS
/begin AXIS_PTS ldpm_fac_amp "" 0x44f48 FAC_AMP _REC_AXS_20_u2 1.99996948 _CNV_A_R_LINEAR_____45_CM 6 0. 1.99996948 FORMAT "%7.5" /end AXIS_PTS
/begin MEASUREMENT LV_ERR_OBD2_LSH_UP_1 "Boolean flag indicating that fault is present and has been debounced" UBYTE _CNV_S_2_RANGE______21_R_CM 1 100. 0. 255. ECU_ADDRESS 0x3fd5d7 /end MEASUREMENT
/begin MEASUREMENT LV_ERR_OBD2_LSH_UP_2 "Boolean flag indicating that fault is present and has been debounced" UBYTE _CNV_S_2_RANGE______21_R_CM 1 100. 0. 255. ECU_ADDRESS 0x3fd5db /end MEASUREMENT
/begin CHARACTERISTIC C_T_AST_TIA_DIAG_SA "Time after start for TAM - determination" VALUE 0x42f5e _REC_VAL_20_u2 6553.2 _CNV_A_R_LINEAR_____14_CM 0.3 6553.5 FORMAT "%6.1" /end CHARACTERISTIC
/begin CHARACTERISTIC C_TCO_MAX_DIAG_SA "???" VALUE 0x42a5d _REC_VAL_20_u1 190.5 _CNV_A_R_LINEAR_____0_CM -48. 142.5 FORMAT "%5.1" /end CHARACTERISTIC
/begin CHARACTERISTIC C_VLS_AFR_READY_SA_DIAG "VLS rich threshold to start the SAFM-monitoring" VALUE 0x43172 _REC_VAL_20_u2 1.275 _CNV_A_R_LINEAR_____403_CM 0. 1.275 FORMAT "%7.5" /end CHARACTERISTIC
/begin CHARACTERISTIC C_VLS_AFL_READY_SA_DIAG "VLS lean threshold to start the SAFM-monitoring" VALUE 0x43168 _REC_VAL_20_u2 1.275 _CNV_A_R_LINEAR_____403_CM 0. 1.275 FORMAT "%7.5" /end CHARACTERISTIC
/begin AXIS_PTS ldp_n_32__maf_max_diag_sa "" 0x43583 N_32 _REC_AXS_20_u1 816. _CNV_A_R_LINEAR_____5_CM 8 0. 8160. FORMAT "%4.0" /end AXIS_PTS
/begin CHARACTERISTIC ID_ERR_ENVD_SEG_T_AD "" CURVE 0x40e32 _REC_CUR_20_u1_u1 255. _CNV_A_R_LINEAR_____12_CM 0. 255. FORMAT "%2.0"
 /begin AXIS_DESCR COM_AXIS ONLINE_DUMMY _CNV_A_R_LINEAR_____12_CM 4 0. 3. FORMAT "%2.0" AXIS_PTS_REF ldp_fmy_envd /end AXIS_DESCR
/end CHARACTERISTIC
/begin CHARACTERISTIC ID_ERR_ENVD_SEG_T "" CURVE 0x40e44 _REC_CUR_20_u1_u1 255. _CNV_A_R_LINEAR_____12_CM 0. 255. FORMAT "%2.0"
 /begin AXIS_DESCR COM_AXIS ONLINE_DUMMY _CNV_A_R_LINEAR_____12_CM 4 0. 3. FORMAT "%2.0" AXIS_PTS_REF ldp_fmy_envd /end AXIS_DESCR
/end CHARACTERISTIC
/begin CHARACTERISTIC ID_ERR_ENVD_MIS_B1 "" CURVE 0x40e68 _REC_CUR_20_u1_u1 255. _CNV_A_R_LINEAR_____12_CM 0. 255. FORMAT "%2.0"
 /begin AXIS_DESCR COM_AXIS ONLINE_DUMMY _CNV_A_R_LINEAR_____12_CM 4 0. 3. FORMAT "%2.0" AXIS_PTS_REF ldp_fmy_envd /end AXIS_DESCR
/end CHARACTERISTIC
/begin CHARACTERISTIC ID_ERR_ENVD_MIS_B4 "" CURVE 0x40e7a _REC_CUR_20_u1_u1 255. _CNV_A_R_LINEAR_____12_CM 0. 255. FORMAT "%2.0"
 /begin AXIS_DESCR COM_AXIS ONLINE_DUMMY _CNV_A_R_LINEAR_____12_CM 4 0. 3. FORMAT "%2.0" AXIS_PTS_REF ldp_fmy_envd /end AXIS_DESCR
/end CHARACTERISTIC
/begin CHARACTERISTIC ID_ERR_ENVD_MIS_A "" CURVE 0x40e56 _REC_CUR_20_u1_u1 255. _CNV_A_R_LINEAR_____12_CM 0. 255. FORMAT "%2.0"
 /begin AXIS_DESCR COM_AXIS ONLINE_DUMMY _CNV_A_R_LINEAR_____12_CM 4 0. 3. FORMAT "%2.0" AXIS_PTS_REF ldp_fmy_envd /end AXIS_DESCR
/end CHARACTERISTIC
/begin CHARACTERISTIC ID_ERR_ENVD_ECRAS "" CURVE 0x4127c _REC_CUR_20_u1_u1 255. _CNV_A_R_LINEAR_____12_CM 0. 255. FORMAT "%2.0"
 /begin AXIS_DESCR COM_AXIS ONLINE_DUMMY _CNV_A_R_LINEAR_____12_CM 4 0. 3. FORMAT "%2.0" AXIS_PTS_REF ldp_fmy_envd /end AXIS_DESCR
/end CHARACTERISTIC
/begin CHARACTERISTIC ID_ERR_ENVD_DMTLH "" CURVE 0x4128e _REC_CUR_20_u1_u1 255. _CNV_A_R_LINEAR_____12_CM 0. 255. FORMAT "%2.0"
 /begin AXIS_DESCR COM_AXIS ONLINE_DUMMY _CNV_A_R_LINEAR_____12_CM 4 0. 3. FORMAT "%2.0" AXIS_PTS_REF ldp_fmy_envd /end AXIS_DESCR
/end CHARACTERISTIC
/begin CHARACTERISTIC C_T_DLY_STOP_REFU "Delay time stop before refueling" VALUE 0x42fa8 _REC_VAL_20_u2 65535. _CNV_A_R_LINEAR_____47_CM 0. 65535. FORMAT "%5.0" /end CHARACTERISTIC
/begin CHARACTERISTIC C_T_ENA_DR_DMTL_MAX "max. time for function request DMTL output stages" VALUE 0x42fc8 _REC_VAL_20_u2 6553.5 _CNV_A_R_LINEAR_____14_CM 0. 6553.5 FORMAT "%6.1" /end CHARACTERISTIC
/begin MEASUREMENT DIST_DMTL "Distance covered for DMTL function" UWORD _CNV_A_R_LINEAR_____159_CM 1 100. 0. 65535. ECU_ADDRESS 0x3fcfd4 FORMAT "%5.0" /end MEASUREMENT
/begin AXIS_PTS ldp_fmy_envd "" 0x433ac ENVD _REC_AXS_20_u1 3. _CNV_A_R_LINEAR_____12_CM 4 0. 3. FORMAT "%2.0" /end AXIS_PTS
/begin COMPU_METHOD _CNV_A_R_LINEAR_____0_CM "" RAT_FUNC "%6.3" "°C" COEFFS 0 1.333333333333333 64. 0 0 1 /end COMPU_METHOD
/begin COMPU_METHOD _CNV_A_R_LINEAR_____2_CM "" RAT_FUNC "%6.3" "°C" COEFFS 0 1. 0. 0 0 1 /end COMPU_METHOD
/begin COMPU_METHOD _CNV_A_R_LINEAR_____4_CM "" RAT_FUNC "%6.3" "%" COEFFS 0 2.56 0. 0 0 1 /end COMPU_METHOD
/begin COMPU_METHOD _CNV_A_R_LINEAR_____5_CM "" RAT_FUNC "%6.3" "rpm" COEFFS 0 3.125e-002 0. 0 0 1 /end COMPU_METHOD
/begin COMPU_METHOD _CNV_A_R_LINEAR_____10_CM "" RAT_FUNC "%6.3" "-" COEFFS 0 1. 0. 0 0 1 /end COMPU_METHOD
/begin COMPU_METHOD _CNV_A_R_LINEAR_____12_CM "" RAT_FUNC "%6.3" "[-]" COEFFS 0 1. 0. 0 0 1 /end COMPU_METHOD
/begin COMPU_METHOD _CNV_A_R_LINEAR_____13_CM "" RAT_FUNC "%6.3" "km/h" COEFFS 0 1. 0. 0 0 1 /end COMPU_METHOD
/begin COMPU_METHOD _CNV_A_R_LINEAR_____14_CM "" RAT_FUNC "%6.3" "s" COEFFS 0 10. 0. 0 0 1 /end COMPU_METHOD
/begin COMPU_METHOD _CNV_A_R_LINEAR_____18_CM "" RAT_FUNC "%6.3" "mg/stk" COEFFS 0 0.183585313174946 0. 0 0 1 /end COMPU_METHOD
/begin COMPU_METHOD _CNV_S_2_RANGE______21_R_CM "" TAB_VERB "%6.3" "[-]" COMPU_TAB_REF _CNV_S_2_RANGE______21_R /end COMPU_METHOD
/begin COMPU_VTAB_RANGE _CNV_S_2_RANGE______21_R "" 2 0 0 "0" 1 255 "1" /end COMPU_VTAB_RANGE
/begin COMPU_METHOD _CNV_A_R_LINEAR_____27_CM "" RAT_FUNC "%6.3" "s" COEFFS 0 100. 0. 0 0 1 /end COMPU_METHOD
/begin COMPU_METHOD _CNV_S_2_RANGE______28_CM "" TAB_VERB "%6.3" "[-]" COMPU_TAB_REF _CNV_S_2_RANGE______28 /end COMPU_METHOD
/begin COMPU_VTAB _CNV_S_2_RANGE______28 "" TAB_VERB 2 0 "0" 1 "1" /end COMPU_VTAB
/begin COMPU_METHOD _CNV_A_R_LINEAR_____31_CM "" RAT_FUNC "%6.3" "-" COEFFS 0 65536.00007936121 0. 0 0 1 /end COMPU_METHOD
/begin COMPU_METHOD _CNV_A_R_LINEAR_____33_CM "" RAT_FUNC "%6.3" "V" COEFFS 0 204.7999998974999 0. 0 0 1 /end COMPU_METHOD
/begin COMPU_METHOD _CNV_A_R_LINEAR_____35_CM "" RAT_FUNC "%6.3" "min" COEFFS 0 1. 0. 0 0 1 /end COMPU_METHOD
/begin COMPU_METHOD _CNV_A_R_LINEAR_____40_CM "" RAT_FUNC "%6.3" "-" COEFFS 0 16. 0. 0 0 1 /end COMPU_METHOD
/begin COMPU_METHOD _CNV_A_R_LINEAR_____45_CM "" RAT_FUNC "%6.3" "-" COEFFS 0 32768.00003968061 0. 0 0 1 /end COMPU_METHOD
/begin COMPU_METHOD _CNV_A_R_LINEAR_____47_CM "" RAT_FUNC "%6.3" "s" COEFFS 0 1. 0. 0 0 1 /end COMPU_METHOD
/begin COMPU_METHOD _CNV_A_R_LINEAR_____53_CM "" RAT_FUNC "%6.3" "V" COEFFS 0 9.807692307692308 0. 0 0 1 /end COMPU_METHOD
/begin COMPU_METHOD _CNV_A_R_LINEAR_____85_CM "" RAT_FUNC "%6.3" "l" COEFFS 0 1. 0. 0 0 1 /end COMPU_METHOD
/begin COMPU_METHOD _CNV_A_R_LINEAR_____101_CM "" RAT_FUNC "%6.3" "kg/h" COEFFS 0 32. 0. 0 0 1 /end COMPU_METHOD
/begin COMPU_METHOD _CNV_A_R_LINEAR_____103_CM "" RAT_FUNC "%6.3" "-" COEFFS 0 128. 0. 0 0 1 /end COMPU_METHOD
/begin COMPU_METHOD _CNV_A_R_LINEAR_____149_CM "" RAT_FUNC "%6.3" "hPa" COEFFS 0 12.05960017121163 0. 0 0 1 /end COMPU_METHOD
/begin COMPU_METHOD _CNV_A_R_LINEAR_____150_CM "" RAT_FUNC "%6.3" "mA" COEFFS 0 163.8400395206126 7.904122518084478e-003 0 0 1 /end COMPU_METHOD
/begin COMPU_METHOD _CNV_A_R_LINEAR_____151_CM "" RAT_FUNC "%6.3" "mA" COEFFS 0 163.8375 0. 0 0 1 /end COMPU_METHOD
/begin COMPU_METHOD _CNV_A_R_LINEAR_____152_CM "" RAT_FUNC "%6.3" "l" COEFFS 0 15.25879531537405 0. 0 0 1 /end COMPU_METHOD
/begin COMPU_METHOD _CNV_A_R_LINEAR_____153_CM "" RAT_FUNC "%6.3" "l" COEFFS 0 15.26190476190476 0. 0 0 1 /end COMPU_METHOD
/begin COMPU_METHOD _CNV_A_R_LINEAR_____154_CM "" RAT_FUNC "%6.3" "ohm" COEFFS 0 5.1 0. 0 0 1 /end COMPU_METHOD
/begin COMPU_METHOD _CNV_A_R_LINEAR_____155_CM "" RAT_FUNC "%6.3" "h" COEFFS 0 35999.99999497086 0. 0 0 1 /end COMPU_METHOD
/begin COMPU_METHOD _CNV_A_R_LINEAR_____156_CM "" RAT_FUNC "%6.3" "V" COEFFS 0 2510.769230769231 0. 0 0 1 /end COMPU_METHOD
/begin COMPU_METHOD _CNV_S_13_STATE_DMTL_157_CM "" TAB_VERB "%6.3" "-" COMPU_TAB_REF _CNV_S_13_STATE_DMTL_157 /end COMPU_METHOD
/begin COMPU_VTAB _CNV_S_13_STATE_DMTL_157 "" TAB_VERB 13 0 "START" 1 "REF_LEAK_MES" 2 "ROUGH_LEAK_MES" 3 "ROUGH_LEAK_MES_LEN" 4 "ROUGH_LEAK_MES_END" 5 "SMALL_LEAK_MES" 6 "SMALL_LEAK_MES_LEN" 7 "2.REF_LEAK_MES" 8 "TANK_PROOFED" 9 "SMALL_LEAK" 10 "ROUGH_LEAK" 11 "MODULE_ERROR" 12 "END" /end COMPU_VTAB
/begin COMPU_METHOD _CNV_A_R_LINEAR_____158_CM "" RAT_FUNC "%6.3" "-" COEFFS 0 32767.98303949118 0. 0 0 1 /end COMPU_METHOD
/begin COMPU_METHOD _CNV_A_R_LINEAR_____159_CM "" RAT_FUNC "%6.3" "m" COEFFS 0 1. 0. 0 0 1 /end COMPU_METHOD
/begin COMPU_METHOD _CNV_S_2_RANGE______183_CM "" TAB_VERB "%6.3" "[-]" COMPU_TAB_REF _CNV_S_2_RANGE______183 /end COMPU_METHOD
/begin COMPU_VTAB _CNV_S_2_RANGE______183 "" TAB_VERB 2 0 "PASSIVE" 1 "ACTIVE" /end COMPU_VTAB
/begin COMPU_METHOD _CNV_A_R_LINEAR_____208_CM "" RAT_FUNC "%6.3" "ms" COEFFS 0 250. 0. 0 0 1 /end COMPU_METHOD
/begin COMPU_METHOD _CNV_A_R_LINEAR_____211_CM "" RAT_FUNC "%6.3" "°C" COEFFS 0 16. 0. 0 0 1 /end COMPU_METHOD
/begin COMPU_METHOD _CNV_A_R_LINEAR_____285_CM "" RAT_FUNC "%6.3" "ohm" COEFFS 0 1. 0. 0 0 1 /end COMPU_METHOD
/begin COMPU_METHOD _CNV_A_R_LINEAR_____294_CM "" RAT_FUNC "%6.3" "J" COEFFS 0 1. 0. 0 0 1 /end COMPU_METHOD
/begin COMPU_METHOD _CNV_S_9_STATE_OBD2_295_CM "" TAB_VERB "%6.3" "[-]" COMPU_TAB_REF _CNV_S_9_STATE_OBD2_295 /end COMPU_METHOD
/begin COMPU_VTAB _CNV_S_9_STATE_OBD2_295 "" TAB_VERB 9 0 "DIAG_OFF" 1 "DIAG_INIT" 2 "LS_READY" 3 "OBD1_DLY" 4 "OBD1_CHK" 5 "TEG_THD" 6 "POW_INT" 7 "DIAG_ACT" 8 "DIAG_END" /end COMPU_VTAB
/begin COMPU_METHOD _CNV_A_R_LINEAR_____403_CM "" RAT_FUNC "%6.3" "V" COEFFS 0 51400. 0. 0 0 1 /end COMPU_METHOD
/begin RECORD_LAYOUT _REC_VAL_20_u1 FNC_VALUES 1 UBYTE COLUMN_DIR DIRECT /end RECORD_LAYOUT
/begin RECORD_LAYOUT _REC_AXS_20_u1 NO_AXIS_PTS_X 1 UBYTE AXIS_PTS_X 2 UBYTE INDEX_INCR DIRECT /end RECORD_LAYOUT
/begin RECORD_LAYOUT _REC_CUR_20_u1_u1 FNC_VALUES 1 UBYTE COLUMN_DIR DIRECT /end RECORD_LAYOUT
/begin RECORD_LAYOUT _REC_MAP_20_u2_u2_u1 FNC_VALUES 1 UWORD COLUMN_DIR DIRECT /end RECORD_LAYOUT
/begin RECORD_LAYOUT _REC_AXS_20_u2 NO_AXIS_PTS_X 1 UWORD AXIS_PTS_X 2 UWORD INDEX_INCR DIRECT /end RECORD_LAYOUT
/begin RECORD_LAYOUT _REC_CUR_20_u2_u2 FNC_VALUES 1 UWORD COLUMN_DIR DIRECT /end RECORD_LAYOUT
/begin RECORD_LAYOUT _REC_VAL_20_u2 FNC_VALUES 1 UWORD COLUMN_DIR DIRECT /end RECORD_LAYOUT
/begin RECORD_LAYOUT _REC_CUR_20_u2_u1 FNC_VALUES 1 UWORD COLUMN_DIR DIRECT /end RECORD_LAYOUT
/begin RECORD_LAYOUT _REC_CUR_20_u1_u2 FNC_VALUES 1 UBYTE COLUMN_DIR DIRECT /end RECORD_LAYOUT
/begin RECORD_LAYOUT _REC_VAL_20_u4 FNC_VALUES 1 ULONG COLUMN_DIR DIRECT /end RECORD_LAYOUT
/begin RECORD_LAYOUT _REC_VAL_20_s2 FNC_VALUES 1 SWORD COLUMN_DIR DIRECT /end RECORD_LAYOUT
/begin RECORD_LAYOUT _REC_VAL_20_s1 FNC_VALUES 1 SBYTE COLUMN_DIR DIRECT /end RECORD_LAYOUT
/begin FUNCTION OBD_Upstream_oxygen_sensor_heate "_Upstream oxygen sensor heater OBDII monitoring"
 /begin DEF_CHARACTERISTIC IP_FAC_MAF_LSH_UP C_PWM_MIN_OBD2_LSH_UP C_PWM_MAX_OBD2_LSH_UP C_T_DLY_OBD2_LSH_UP C_TEMP_MIN_OBD2_LSH_UP C_TEMP_SET_OBD2_LSH_UP C_EGY_MIN_OBD2_LSH_UP C_R_THD_OBD2_LSH_UP C_TCC_OBD2_LSH_UP C_FRC_OBD2_LSH_UP /end DEF_CHARACTERISTIC
 /begin OUT_MEASUREMENT LV_INH_DIAG_OBD2_LSH_UP_1 POW_INT_OBD2_LSH_UP_1 STATE_OBD2_LSH_UP_1 TCC_OBD2_LSH_UP_1 FRC_OBD2_LSH_UP_1 CTR_CYCNR_R_OBD2_LSH_UP_1 R_UP_LS_OBD2_LSH_UP_1 TEMP_DIF_OBD2_LSH_UP_1 LV_INH_DIAG_OBD2_LSH_UP_2 POW_INT_OBD2_LSH_UP_2 STATE_OBD2_LSH_UP_2 TCC_OBD2_LSH_UP_2 FRC_OBD2_LSH_UP_2 CTR_CYCNR_R_OBD2_LSH_UP_2 R_UP_LS_OBD2_LSH_UP_2 TEMP_DIF_OBD2_LSH_UP_2 LV_ERR_OBD2_LSH_UP_1 LV_ERR_OBD2_LSH_UP_2 /end OUT_MEASUREMENT
/end FUNCTION
/begin FUNCTION OBD_Application_incidences_Secon "_Application incidences Secondary air system monitoring through binary lambda sensor (ZrO2)"
 /begin DEF_CHARACTERISTIC IP_N_32_MIN_DIAG_SA IP_MAF_KGH_MAX_DIAG_SA IP_MAF_MAX_DIAG_SA C_TI_ADD_WF_MAX_DIAG_SA C_TI_ADD_WF_MIN_DIAG_SA LC_INH_SA_MAN_DEAC ID_TCO_MIN_DIAG_SA IP_MAF_MIN_DIAG_SA C_N_32_MAX_DIAG_SA C_T_AST_TIA_DIAG_SA C_TCO_MAX_DIAG_SA C_VLS_AFR_READY_SA_DIAG C_VLS_AFL_READY_SA_DIAG /end DEF_CHARACTERISTIC
 /begin OUT_MEASUREMENT LV_INTR_DIAG_SA /end OUT_MEASUREMENT
/end FUNCTION
/begin FUNCTION OBD_Tank_leakage_diagnosis_based "_Tank leakage diagnosis based on DMTL"
 /begin DEF_CHARACTERISTIC C_AMP_DMTL_MAX C_COD_2_DMTL C_COD_DMTL C_CRLC_CUR_DMTL_FIL C_CRLC_CUR_DMTL_FIL_LIM C_CRLC_CUR_DMTL_FIL_REFU C_CRLC_VB_DMTL_FIL C_CRLC_VB_DMTL_FIL_LIM C_CUR_DMTL_COR_FIL_OFS_AMP C_CUR_DMTL_DIF_CUR_DMTL_STAT C_CUR_DMTL_REF_LEAK_MAX C_CUR_DMTL_REF_LEAK_MIN C_CUR_DMTL_REF_OFS C_ENA_FCO_DIAG C_FCO_DIAG_MAX C_FCO_DIAG_MIN C_FTL_DEC_FTL_DIAG_MIN C_FTL_DIAG_MAX C_FTL_DIAG_MIN C_FTL_DMTL_MAX C_FTL_DMTL_MIN C_HYS_FTL_DMTL C_R_DMTL C_SUM_ENA_ROUGH_LEAK_MAX C_SUM_ENA_ROUGH_LEAK_TEST_MAX C_SUM_ENA_SMALL_LEAK_TEST_MAX C_SUM_REP_ROUGH_LEAK_MES_FUC_MAX C_T_CUR_DMTL_ROUGH_LEAK_MAX C_T_CUR_DMTL_ROUGH_LEAK_MIN C_T_CUR_DMTL_STAT C_T_DLY_CUR_DMTL_DIF_MES C_T_DLY_DET_REFU C_T_DLY_DMTLS C_T_DLY_ES_PWL C_T_DLY_FUC_CAN_OFF C_T_DLY_FUC_CAN_ON C_T_DLY_IGK_FTL C_T_DLY_REQ_PWL_DMTL C_T_DMTL_EOL_MAX C_T_DMTL_MAX C_T_ES_DMTL_MIN C_T_ES_SUB_DMTL C_T_REF_LEAK_MES_MAX C_T_REF_LEAK_MES_REP_MAX C_T_VB_DLY_DMTL C_TAM_DMTL_MIN C_TCO_ST_DMTL_MIN C_TRT_DMTL_EOL_MAX C_VB_DMTL_ASA_MAX C_VB_DMTL_ASA_MIN C_VB_DMTL_DIF C_VB_DMTL_MAX C_VB_DMTL_MIN C_VS_FTL_DIAG_MAX C_T_AST_DMTL_MAX C_T_ACT_ROUGH_LEAK C_T_ACT_SMALL_LEAK IP_T_ACT_SMALL_LEAK__FTL IP_FAC_CUR_DMTL_ROUGH IP_FAC_CUR_DMTL_REF IP_T_CUR_DMTL_STAT C_T_REF_TEST_ROUGH_LEAK C_FAC_T_CUR_DMTL_STAT_LEN IP_FAC_CUR_DMTL C_TAM_DMTL_MAX C_CL_DMTL_MAX C_VS_FUC_CAN_MIN C_VS_DMTL_MAX C_SUM_CNL_ROUGH_LEAK_MES_FUC_MAX C_SUM_CNL_SMALL_LEAK_MES_MAX C_CUR_DMTL_REF_DIF_MAX C_CUR_DMTL_DIF_THD_REFU C_CUR_DMTL_DIF_THD_FUC C_CUR_DMTL_DIF_THD_MES C_DIST_REFU_ROUGH_LEAK_MIN LC_COD_HDMTL IP_T_ACT_ROUGH_LEAK C_T_DLY_STOP_REFU C_T_ENA_DR_DMTL_MAX /end DEF_CHARACTERISTIC
 /begin OUT_MEASUREMENT V_DMTL V_SOF_SWI CTR_CNL_ROUGH_LEAK_MES_FUC CTR_CNL_SMALL_LEAK_MES CTR_CUR_DMTL_REF_DIF_MAX CTR_DMTL_ACT CTR_REP_ROUGH_LEAK_MES_FUC CTR_ROUGH_LEAK_MES CTR_SMALL_LEAK_MES CUR_DMTL CUR_DMTL_COMP_ROUGH_LEAK CUR_DMTL_COMP_SMALL_LEAK_LEN CUR_DMTL_COR_FIL_MAX CUR_DMTL_COR_FIL_MIN CUR_DMTL_COR_FIL_REFU_HPF CUR_DMTL_DIF CUR_DMTL_DIF_REF_ROUGH_LEAK CUR_DMTL_REF_LEAK CUR_DMTL_ROUGH_LEAK_LEN_END CUR_DMTL_ROUGH_LEAK_MIN CUR_DMTL_THD_ROUGH_LEAK_LEN FCO_AV_DMTL STATE_DMTL T_ACT_CUR_DMTL_STAT T_ACT_LEAK_MES T_ACT_REF_LEAK_MES T_ES_DMTL CUR_DMTL_DMTLS_TEST CUR_DMTL_THD_ROUGH_LEAK CUR_DMTL_THD_DMTLS_TEST CUR_DMTL_COR CUR_DMTL_COR_FIL VB_DMTL_REF VB_DMTL_FIL FTL_INI FTL_OLD CTR_ENA_ROUGH_LEAK CTR_ENA_ROUGH_LEAK_TEST CTR_ENA_SMALL_LEAK_TEST LV_CHK_DMTL_CUR_DMTL_VLD LV_CHK_DMTL_VLD LV_CUR_DMTL_DMTLS_TEST LV_CUR_DMTL_REF_MES_MAX LV_CUR_DMTL_REF_MES_MIN LV_CYC_ROUGH_LEAK_MODE6 LV_CYC_ROUGH_LEAK_SUSP LV_CYC_SMALL_LEAK_MODE6 LV_DIST_DMTL LV_DMTL_ASA LV_DMTL_EOL LV_DMTL_PUMP LV_DMTL_PUMP_ON LV_DMTL_RST_ROUGH_LEAK LV_DMTLS LV_DMTLS_ON LV_DR_DMTL LV_DR_DMTL_PUMP LV_ENA_FCO_DIAG LV_ENA_FTL_DIAG LV_ENA_FUC_ROUGH_LEAK_MES LV_ENA_MAIN_DMTL LV_ENA_MAIN_DMTL_FUC LV_ENA_ROUGH_LEAK_1 LV_ENA_ROUGH_LEAK_2 LV_ENA_ROUGH_LEAK_3 LV_ENA_ROUGH_LEAK_MES LV_ENA_ROUGH_LEAK_MES_ONLY LV_ENA_SMALL_LEAK_1 LV_ENA_SMALL_LEAK_MES_END LV_ERR_DET_SMALL_LEAK_MIN LV_FCO_DIAG_MAX LV_FCO_DIAG_MIN LV_FCO_H_FTL LV_FTL_DEC LV_FTL_DEC_IGK_ON LV_FTL_DMTL_MAX LV_FTL_DMTL_MIN LV_FTL_DMTL_VAL LV_FTL_DYN LV_FTL_INC LV_FTL_INC_IGK_ON LV_NO_PURGE_DR_DMTL LV_NO_PURGE_DMTL_ROUGH_LEAK LV_NO_PURGE_DMTL_SMALL_LEAK LV_REF_LEAK_ROUGH_LEAK_SUSP LV_REFU LV_REFU_1 LV_REFU_END LV_REFU_RLS_DIAG LV_REFU_VAL LV_REFU_VAL_1 LV_REQ_ENA_ROUGH_LEAK LV_REQ_PWL_ROUGH_LEAK LV_REQ_PWL_SMALL_LEAK LV_REQ_ROUGH_LEAK LV_ROUGH_LEAK_MES_LEN LV_ROUGH_LEAK_SUSP LV_SMALL_LEAK_MES_LEN LV_T_DLY_DMTL_PWL LV_CTR_CNL_SMALL_LEAK_MES LV_CUR_DMTL_REF_DIF_MAX LV_CUR_DMTL_THD_DIF_MES LV_DET_FUC_OPEN LV_DET_REFU LV_DIST_DET_ROUGH_LEAK LV_DMTL_ACT LV_DMTL_STOP LV_ENA_FUC LV_ENA_LEAK_DMTL LV_ENA_OSC_ROUGH_LEAK_MES LV_ENA_SMALL_LEAK_MES LV_ENA_SMALL_LEAK_REFU LV_ERR_DET_DMTL_MAX LV_ERR_DET_DMTL_MIN LV_ERR_DET_ROUGH_LEAK_MIN LV_ERR_FTL LV_ERR_FTL_PLAUS LV_ERR_SIG_DMTL LV_ERR_SMALL_LEAK LV_FTL_DIAG LV_FUC_CAN LV_FUC_OPEN LV_NO_PURGE_DMTL LV_REFU_DMTL LV_REQ_PWL_DMTL LV_ROUGH_LEAK_SUSP_SET LV_RST_SMALL_LEAK_MES_REFU LV_SDR_DMTL LV_T_DMTL_MAX LV_VB_DIF_MAX LV_HDMTL_ON LV_DR_DMTLS LV_VB_RANGE_DMTL CUR_DMTL_SMALL_LEAK_END CUR_DMTL_REF_DIF_MAX LV_ERR_DMTL_LEAK LV_ERR_DMTLM DIST_DMTL /end OUT_MEASUREMENT
/end FUNCTION
/begin FUNCTION OBD_Cycle_manager "_Cycle manager" /begin DEF_CHARACTERISTIC C_TCO_WUP_THD C_TCO_WUP_INC /end DEF_CHARACTERISTIC /begin OUT_MEASUREMENT LV_DC LV_WUP_CYC LV_STATE_WUP /end OUT_MEASUREMENT /end FUNCTION
/begin FUNCTION OBD_Environmental_Data "_Environmental Data"
 /begin DEF_CHARACTERISTIC ID_ERR_ENVD_IMOB_1 ID_ERR_ENVD_IMOB_2 ID_ERR_ENVD_IMOB_3 ID_ERR_ENVD_BSD ID_ERR_ENVD_CPS ID_ERR_ENVD_CAT_DIAG_1 ID_ERR_ENVD_CAT_DIAG_2 ID_ERR_ENVD_GEN ID_ERR_ENVD_CAM_0_NOT_PLAUS ID_ERR_ENVD_BN_ARS ID_ERR_ENVD_TQ_DIF_I_IS_MON_1 ID_ERR_ENVD_PVS_BLS_NOT_PLAUS ID_ERR_ENVD_SAP ID_ERR_ENVD_POIL_SWI ID_ERR_ENVD_BN_ETCU ID_ERR_ENVD_SAV ID_ERR_ENVD_PVS_DOUBLE ID_ERR_ENVD_CONV_MON_1 ID_ERR_ENVD_BN_TQ_TCS ID_ERR_ENVD_SA_SAFM ID_ERR_ENVD_N_EFP_HIGH ID_ERR_ENVD_VLS_UP_PUC_1 ID_ERR_ENVD_VLS_UP_PUC_2 ID_ERR_ENVD_N_EFP_LOW ID_ERR_ENVD_LS_UP_SWT_1 ID_ERR_ENVD_LS_UP_SWT_2 ID_ERR_ENVD_TOUT_PSTE_1 ID_ERR_ENVD_TQ_GS_INC_PLAUS ID_ERR_ENVD_TPS_MAF_1 ID_ERR_ENVD_TPS_MAF_2 ID_ERR_ENVD_REF_IVVT_EX_1 ID_ERR_ENVD_REF_IVVT_EX_2 ID_ERR_ENVD_SA_SAP ID_ERR_ENVD_MTC_CTL_1 ID_ERR_ENVD_SA_SAV ID_ERR_ENVD_MTC_CTL_2 ID_ERR_ENVD_MTC_CTL_3 ID_ERR_ENVD_DCC_REV ID_ERR_ENVD_CAN_BOFF ID_ERR_ENVD_ISA_1 ID_ERR_ENVD_ISA_2 ID_ERR_ENVD_TCO_STUCK ID_ERR_ENVD_BN_T_ICL ID_ERR_ENVD_PVS_RATIO ID_ERR_ENVD_BN_MSW ID_ERR_ENVD_EBOX_CFA ID_ERR_ENVD_TOUT_ICL_2 ID_ERR_ENVD_TOUT_ICL_3 ID_ERR_ENVD_MTC_DR ID_ERR_ENVD_LS_DOWN_SWT_1 ID_ERR_ENVD_LS_DOWN_SWT_2 ID_ERR_ENVD_TPS_AD ID_ERR_ENVD_ECU_CKS ID_ERR_ENVD_BN_ICL ID_ERR_ENVD_VLS_DOWN_PUE_1 ID_ERR_ENVD_VLS_DOWN_PUE_2 ID_ERR_ENVD_DCC_IRREV ID_ERR_ENVD_DUR_IGC_0 ID_ERR_ENVD_DUR_IGC_1 ID_ERR_ENVD_DUR_IGC_2 ID_ERR_ENVD_DUR_IGC_3 ID_ERR_ENVD_DUR_IGC_4 ID_ERR_ENVD_DUR_IGC_5 ID_ERR_ENVD_PVS_MON_1 ID_ERR_ENVD_LOAD_PLAUS ID_ERR_ENVD_VLS_UP_MAX_1 ID_ERR_ENVD_VLS_UP_MAX_2 ID_ERR_ENVD_N_32_MON_1 ID_ERR_ENVD_ECT_EL ID_ERR_ENVD_VLS_DOWN_MAX_1 ID_ERR_ENVD_VLS_DOWN_MAX_2 ID_ERR_ENVD_CRU_INH_MON_1 ID_ERR_ENVD_TOUT_ASR_1 ID_ERR_ENVD_LSH_DOWN_1 ID_ERR_ENVD_LSH_DOWN_2 ID_ERR_ENVD_TOUT_ASR_3 ID_ERR_ENVD_TCO_PLAUS ID_ERR_ENVD_BN_TCS ID_ERR_ENVD_TQ_DIF_P_D_IS_MON_1 ID_ERR_ENVD_ECU_RAM ID_ERR_ENVD_TIA ID_ERR_ENVD_CRASH_EFP ID_ERR_ENVD_TPU_SYN ID_ERR_ENVD_TOUT_AMT_1 ID_ERR_ENVD_TECU ID_ERR_ENVD_TQI_N_MAX_MON_1 ID_ERR_ENVD_MAF ID_ERR_ENVD_RLY_EFP ID_ERR_ENVD_BN_KM_ICL ID_ERR_ENVD_MEC_IVVT_IN_1 ID_ERR_ENVDMEC_IVVT_IN_2 ID_ERR_ENVD_CRK_NOT_PLAUS ID_ERR_ENVD_TPS_PLAUS ID_ERR_ENVD_TOUT_ETCU_1 ID_ERR_ENVD_TOUT_ETCU_2 ID_ERR_ENVD_FSD_1 ID_ERR_ENVD_FSD_2 ID_ERR_ENVD_CAM_PER_0 ID_ERR_ENVD_CAM_PER_1 ID_ERR_ENVD_SOF ID_ERR_ENVD_BN_ANG_PSTE ID_ERR_ENVD_TEG_PCAT_DOWN_1 ID_ERR_ENVD_TEG_PCAT_DOWN_2 ID_ERR_ENVD_CHK_LS_DOWN_1 ID_ERR_ENVD_CHK_LS_DOWN_2 ID_ERR_ENVD_TCO_EL ID_ERR_ENVD_BN_ACC ID_ERR_ENVD_TCO_EX ID_ERR_ENVD_BN_TQ_DCC ID_ERR_ENVD_MSW_2 ID_ERR_ENVD_MSW_3 ID_ERR_ENVD_SLV_IVVT_IN_1 ID_ERR_ENVD_SLV_IVVT_IN_2 ID_ERR_ENVD_DMTL_PUMP ID_ERR_ENVD_ENG_PSN ID_ERR_ENVD_TPS_MON_1 ID_ERR_ENVD_MSW_TOG ID_ERR_ENVD_BN_TQ_AMT ID_ERR_ENVD_TOIL ID_ERR_ENVD_VLS_UP_OC_1 ID_ERR_ENVD_VLS_UP_OC_2 ID_ERR_ENVD_VIM ID_ERR_ENVD_BN_POW_GEN ID_ERR_ENVD_VLS_UP_STK_1 ID_ERR_ENVD_VLS_UP_STK_2 ID_ERR_ENVD_LSH_UP_1 ID_ERR_ENVD_LSH_UP_2 ID_ERR_ENVD_TOUT_TXU_1 ID_ERR_ENVD_KNKS_1 ID_ERR_ENVD_KNKS_2 ID_ERR_ENVD_MEC_ISA ID_ERR_ENVD_TQ_MAX_CLU_MON_1 ID_ERR_ENVD_BN_CAS ID_ERR_ENVD_VLS_UP_MIN_COLD_1 ID_ERR_ENVD_VLS_UP_MIN_COLD_2 ID_ERR_ENVD_TD_IGC_CUT_0 ID_ERR_ENVD_TD_IGC_CUT_1 ID_ERR_ENVD_TD_IGC_CUT_2 ID_ERR_ENVD_TD_IGC_CUT_3 ID_ERR_ENVD_TD_IGC_CUT_4 ID_ERR_ENVD_TD_IGC_CUT_5 ID_ERR_ENVD_V_REF_1 ID_ERR_ENVD_V_REF_2 ID_ERR_ENVD_BN_VS_TCS ID_ERR_ENVDMEC_IVVT_EX_1 ID_ERR_ENVD_MEC_IVVT_EX_2 ID_ERR_ENVD_PVS_1 ID_ERR_ENVD_PVS_2 ID_ERR_ENVD_ECT_MEC ID_ERR_ENVD_TQI_AV_MON_1 ID_ERR_ENVD_LS_UP_FRQ_1 ID_ERR_ENVD_LS_UP_FRQ_2 ID_ERR_ENVD_VLS_DOWN_MIN_COLD_1 ID_ERR_ENVD_VLS_DOWN_MIN_COLD_2 ID_ERR_ENVD_BN_POW_VB ID_ERR_ENVD_SOF_REQ ID_ERR_ENVD_MSR_INH_MON_1 ID_ERR_ENVD_ECF ID_ERR_ENVD_MIS_LOW_FUEL ID_ERR_ENVD_DMTLM ID_ERR_ENVD_CAM_1_NOT_PLAUS ID_ERR_ENVD_DMTLS ID_ERR_ENVD_RLY_ACCOUT ID_ERR_ENVD_LOCAN_BOFF ID_ERR_ENVD_IV_0 ID_ERR_ENVD_IV_1 ID_ERR_ENVD_IV_2 ID_ERR_ENVD_SLV_IVVT_EX_1 ID_ERR_ENVD_RLY_MAIN ID_ERR_ENVD_IV_3 ID_ERR_ENVD_SLV_IVVT_EX_2 ID_ERR_ENVD_IV_4 ID_ERR_ENVD_IV_5 ID_ERR_ENVD_MAF_MON_1 ID_ERR_ENVD_VLS_DOWN_OC_1 ID_ERR_ENVD_VLS_DOWN_OC_2 ID_ERR_ENVD_CAM_PSN_0 ID_ERR_ENVD_CAM_PSN_1 ID_ERR_ENVD_LOAD_TPS_PLAUS ID_ERR_ENVD_RLY_ST ID_ERR_ENVD_TQ_LOSS_MON_1 ID_ERR_ENVD_OBD2_LSH_UP_1 ID_ERR_ENVD_DIAGCPS ID_ERR_ENVD_OBD2_LSH_UP_2 ID_ERR_ENVD_TOOTH_PER ID_ERR_ENVD_TPS_1 ID_ERR_ENVD_TPS_2 ID_ERR_ENVD_DMTL_LEAK ID_ERR_ENVD_TQI_LIM ID_ERR_ENVD_IM_BLS_PLAUS ID_ERR_ENVD_TQI_N_MAX_NVMY_MON ID_ERR_ENVD_VS ID_ERR_ENVD_TOUT_EFP ID_ERR_ENVD_EFP_TEMP ID_ERR_ENVD_EFP_LIH ID_ERR_ENVD_TPS_ST_CHK_1 ID_ERR_ENVD_VLS_UP_MIN_1 ID_ERR_ENVD_TPS_ST_CHK_2 ID_ERR_ENVD_VLS_UP_MIN_2 ID_ERR_ENVD_GEN_IF ID_ERR_ENVD_TPS_AD_BOL ID_ERR_ENVD_OBD2_LSH_DOWN_1 ID_ERR_ENVD_VLS_DOWN_MIN_1 ID_ERR_ENVD_TCO_GRD ID_ERR_ENVD_OBD2_LSH_DOWN_2 ID_ERR_ENVD_VLS_DOWN_MIN_2 ID_ERR_ENVD_IM_BTS_PLAUS ID_ERR_ENVD_REF_IVVT_IN_1 ID_ERR_ENVD_REF_IVVT_IN_2 ID_ERR_ENVD_BN_TQ_ETCU ID_ERR_ENVD_TQ_MIN_CLU_MON_1 ID_ERR_ENVD_BN_VEH_MOD ID_ERR_ENVD_QOIL_SENS ID_ERR_ENVD_EF ID_ERR_ENVD_TOIL_LEVEL ID_ERR_ENVD_AMP ID_ERR_ENVD_RLY_MAIN_DLY ID_ERR_ENVD_ISC ID_ERR_ENVD_CHG_LS_DOWN ID_ERR_ENVD_CHG_LS_UP ID_ERR_ENVD_LAM_DLY_1 ID_ERR_ENVD_LAM_DLY_2 ID_ERR_ENVD_SEG_T_AD ID_ERR_ENVD_SEG_T ID_ERR_ENVD_MIS_B1 ID_ERR_ENVD_MIS_B4 ID_ERR_ENVD_MIS_A ID_ERR_ENVD_ECRAS ID_ERR_ENVD_DMTLH /end DEF_CHARACTERISTIC
/end FUNCTION
/end MODULE
/end PROJECT
