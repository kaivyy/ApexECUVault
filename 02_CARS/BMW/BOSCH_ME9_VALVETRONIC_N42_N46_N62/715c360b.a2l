ASAP2_VERSION 1 3
/begin PROJECT _715C360B "basisme9"
/begin HEADER "" VERSION "_715C360B" PROJECT_NO _715C360B /end HEADER
/begin MODULE DIM ""
/begin MOD_COMMON "" BYTE_ORDER MSB_FIRST ALIGNMENT_BYTE 1 ALIGNMENT_WORD 2 ALIGNMENT_LONG 2 ALIGNMENT_FLOAT32_IEEE 4 /end MOD_COMMON
/begin CHARACTERISTIC AFSTB "Anzahl rasterabh. Entprellung Fuellstandsbedingungen" VALUE 0xFCDF28 KwUb 255.0 dez 0.00 255.0 FORMAT "%5.1" /end CHARACTERISTIC
/begin CHARACTERISTIC ANZRIBEH "Anzahl der Ri-Berechnungen hinter KAT" VALUE 0xFC63E0 KwUb 255.0 dez 0.00 255.0 FORMAT "%5.1" /end CHARACTERISTIC
/begin CHARACTERISTIC ANZRIBEV "Anzahl der Ri-Berechnungen vor KAT" VALUE 0xFC63CA KwUb 255.0 dez 0.00 255.0 FORMAT "%5.1" /end CHARACTERISTIC
/begin CHARACTERISTIC ANZTPMX "Maximale Anzahl von hintereinander erlaubten Tips" VALUE 0xFC206C KwUb 255.0 dez 0.00 255.0 FORMAT "%5.1" /end CHARACTERISTIC
/begin CHARACTERISTIC ATISLATM "Anzti-Schwelle zur Umschaltung von lamns_w auf lamwl_w" CURVE 0xFCDBD4 GklWUw 50176.00 dez 0.00 50176.00 FORMAT "%8.2"
 /begin AXIS_DESCR COM_AXIS tmst temp_ub_q0p75_o48 12 -48.00 143.3 FORMAT "%5.1" AXIS_PTS_REF STS12ESUB /end AXIS_DESCR
/end CHARACTERISTIC
/begin CHARACTERISTIC ATIWKSTM "Anzti-Schwelle zur Umschaltung von lamns_w auf lamwl_w bei Wiederholkaltstart" CURVE 0xFCDBEC GklWUw 50176.00 dez 0.00 50176.00 FORMAT "%8.2"
 /begin AXIS_DESCR COM_AXIS tmst temp_ub_q0p75_o48 12 -48.00 143.3 FORMAT "%5.1" AXIS_PTS_REF STS12ESUB /end AXIS_DESCR
/end CHARACTERISTIC
/begin CHARACTERISTIC BRABEVI "Beschleunigung bei Rampe Beschleunigen" CURVE 0xFC2072 KlAUwSstUwWUw 7110.547 bfzg_uw_q0p1085 0.00 7110.547 FORMAT "%8.3"
 /begin AXIS_DESCR STD_AXIS vfgr_w vfzg_uw_b512 8 0.00 511.9922 FORMAT "%8.4" DEPOSIT ABSOLUTE /end AXIS_DESCR
/end CHARACTERISTIC
/begin CHARACTERISTIC BRATD "Beschleunigung (Betrag) bei Rampe Tip-Down" VALUE 0xFC206D KwUb 27.56 bfzg_ub_b27p67 0.00 27.56 FORMAT "%5.2" /end CHARACTERISTIC
/begin CHARACTERISTIC BRATU "Beschleunigung bei Rampe Tip-Up" VALUE 0xFC206E KwUb 27.56 bfzg_ub_b27p67 0.00 27.56 FORMAT "%5.2" /end CHARACTERISTIC
/begin CHARACTERISTIC BRAWA1GA "Beschleunigung Rampe Wiederaufnahme im Lande-Mode Bereich 1" CURVE 0xFCCD5E KlAUwSstUwWUw 7110.547 bfzg_uw_q0p1085 0.00 7110.547 FORMAT "%8.3"
 /begin AXIS_DESCR STD_AXIS vfgr_w vfzg_uw_b512 8 0.00 511.9922 FORMAT "%8.4" DEPOSIT ABSOLUTE /end AXIS_DESCR
/end CHARACTERISTIC
/begin CHARACTERISTIC BRAWA2GA "Beschleunigung Rampe Wiederaufnahme im Lande-Mode Bereich 2" CURVE 0xFCCD80 KlAUwSstUwWUw 7110.547 bfzg_uw_q0p1085 0.00 7110.547 FORMAT "%8.3"
 /begin AXIS_DESCR STD_AXIS vfgr_w vfzg_uw_b512 8 0.00 511.9922 FORMAT "%8.4" DEPOSIT ABSOLUTE /end AXIS_DESCR
/end CHARACTERISTIC
/begin CHARACTERISTIC BRAWA3GA "Beschleunigung Rampe Wiederaufnahme im Lande-Mode Bereich 3" CURVE 0xFCCDA2 KlAUwSstUwWUw 7110.547 bfzg_uw_q0p1085 0.00 7110.547 FORMAT "%8.3"
 /begin AXIS_DESCR STD_AXIS vfgr_w vfzg_uw_b512 8 0.00 511.9922 FORMAT "%8.4" DEPOSIT ABSOLUTE /end AXIS_DESCR
/end CHARACTERISTIC
/begin CHARACTERISTIC BRAWAVI "Beschleunigung Rampe Wiederaufnahme" CURVE 0xFC2094 KlAUwSstUwWUw 7110.547 bfzg_uw_q0p1085 0.00 7110.547 FORMAT "%8.3"
 /begin AXIS_DESCR STD_AXIS vfgr_w vfzg_uw_b512 8 0.00 511.9922 FORMAT "%8.4" DEPOSIT ABSOLUTE /end AXIS_DESCR
/end CHARACTERISTIC
/begin CHARACTERISTIC CWBWEEN "Codewort zur Deaktivierung der Bewegungserkennung" VALUE 0xFC6326 KwUb 255.0 dez 0.00 255.0 FORMAT "%5.1" /end CHARACTERISTIC
/begin CHARACTERISTIC CWESVW "Codewort: Einspritzung Vorlagerungswinkel" VALUE 0xFC4F11 KwWU8 7.000 dez 0.00 7.000 FORMAT "%5.3" /end CHARACTERISTIC
/begin CHARACTERISTIC CWFGRMD "Codewort f¸r FGRMD" VALUE 0xFC206F KwUb 255.0 dez 0.00 255.0 FORMAT "%5.1" /end CHARACTERISTIC
/begin CHARACTERISTIC CWGGEGAS "Codewort f¸r GGEGAS" VALUE 0xFCDF22 KwUb 255.0 dez 0.00 255.0 FORMAT "%5.1" /end CHARACTERISTIC
/begin CHARACTERISTIC CWGGFST "Codewort Gebergroesse Fuellstand" VALUE 0xFCDF29 KwUb 255.0 dez 0.00 255.0 FORMAT "%5.1" /end CHARACTERISTIC
/begin CHARACTERISTIC CWGGLSH "Codeword f¸r Ri-Auswertung f¸r Sonde hinter KAT" VALUE 0xFCE305 KwUb 255.0 dez 0.00 255.0 FORMAT "%5.1" /end CHARACTERISTIC
/begin CHARACTERISTIC CWGGLSV "Codeword f¸r Ri-Auswertung f¸r Sonde vor KAT (Heizung nicht voll ein)" VALUE 0xFCE304 KwUb 255.0 dez 0.00 255.0 FORMAT "%5.1" /end CHARACTERISTIC
/begin CHARACTERISTIC CWGGMFL "Codewort f¸r %GGMFL ( Auswertung Multifunktionslenkrad)" VALUE 0xFC63FC KwWU8 255.0 dez 0.00 255.0 FORMAT "%5.1" /end CHARACTERISTIC
/begin CHARACTERISTIC CWGGPBKV "Codewort f¸r Bremskraftverst‰rker Funktion GGPBKV" VALUE 0xFC6324 KwUb 255.0 dez 0.00 255.0 FORMAT "%5.1" /end CHARACTERISTIC
/begin CHARACTERISTIC CWWL "Codewort f¸r Warmlaufsteuerung" VALUE 0xFCDAA4 KwUb 255.0 dez 0.00 255.0 FORMAT "%5.1" /end CHARACTERISTIC
/begin CHARACTERISTIC CW_FFZ "Codewort Folgefunken (aktiv: >0)" VALUE 0xFCB120 KwUb 255.0 DEZ 0.00 255.0 FORMAT "%5.1" /end CHARACTERISTIC
/begin CHARACTERISTIC DKROKD "Obere Drehzahlschwelle f¸r Nulltest-Diagnose Klopfregelung" VALUE 0xFC63C7 KwUb 10200. nmot_ub_q40 0.00 10200. FORMAT "%5.0" /end CHARACTERISTIC
/begin CHARACTERISTIC DKROKMX "Maximaler Offsetkompensationswert" VALUE 0xFC63C8 KwUb 4.980 spg_ub_b5 0.00 4.980 FORMAT "%5.3" /end CHARACTERISTIC
/begin CHARACTERISTIC DKROKO "Obere Drehzahlschwelle f¸r Ermittlung Offsetkompensationswert" VALUE 0xFC63C9 KwUb 10200. nmot_ub_q40 0.00 10200. FORMAT "%5.0" /end CHARACTERISTIC
/begin CHARACTERISTIC DLAMNSWL "max. Abweichung f¸r lamnswl_w=1.0" VALUE 0xFC4F34 KwUb 0.9961 fak_ub_b1 0.00 0.9961 /end CHARACTERISTIC
/begin CHARACTERISTIC DMRFGRAL "Delta Relatives Moment bei langsamer FGR-Abschaltung" VALUE 0xFC2068 KwUw 199.9969 rel_uw_b200 0.00 199.9969 FORMAT "%8.4" /end CHARACTERISTIC
/begin CHARACTERISTIC DPBKVBBG "Faktor Druckgradient am Beginn einer Bremsung" VALUE 0xFCDF5C KwUw 7.999878 fak_uw_b8 0.00 7.999878 FORMAT "%8.6" /end CHARACTERISTIC
/begin CHARACTERISTIC DPBKVBSGV0 "Faktor Druckgradient w‰hrend Bremsung bei v=0" VALUE 0xFCDF5E KwUw 7.999878 fak_uw_b8 0.00 7.999878 FORMAT "%8.6" /end CHARACTERISTIC
/begin CHARACTERISTIC DPBKVBSGVS "Faktor Druckgradient w‰hrend Bremsung bei v>Schwelle" VALUE 0xFCDF60 KwUw 7.999878 fak_uw_b8 0.00 7.999878 FORMAT "%8.6" /end CHARACTERISTIC
/begin CHARACTERISTIC DPBKVEBG "Faktor Druckgradient am Ende einer Bremsung" VALUE 0xFCDF62 KwUw 7.999878 fak_uw_b8 0.00 7.999878 FORMAT "%8.6" /end CHARACTERISTIC
/begin CHARACTERISTIC DPBKVEBGVS "Faktor Druckgradient am Ende einer Bremsung bei vfzg>Schwelle" VALUE 0xFCDF64 KwUw 7.999878 fak_uw_b8 0.00 7.999878 FORMAT "%8.6" /end CHARACTERISTIC
/begin CHARACTERISTIC DPBKVEVK "Faktor Druckgradient w‰hrend Evakuierung des Bremskraftverst‰rkers" VALUE 0xFCDF66 KwUw 15.99976 fak_uw_b16 0.00 15.99976 FORMAT "%8.5" /end CHARACTERISTIC
/begin CHARACTERISTIC DPBKVEVKEP "Fak. Druckgrad. w‰hrend Evakuierung des Bremskraftverst‰rkers durch el. Pumpe" VALUE 0xFCDF68 KwUw 15.99976 fak_uw_b16 0.00 15.99976 FORMAT "%8.5" /end CHARACTERISTIC
/begin CHARACTERISTIC DPBKVEVKSP "Fak. Druckgrad. w‰hrend Evakuierung des BKV durch Saugstrahlpumpe" VALUE 0xFCDF6A KwUw 15.99976 fak_uw_b16 0.00 15.99976 FORMAT "%8.5" /end CHARACTERISTIC
/begin CHARACTERISTIC DPBKVSTG "Faktor Druckgradient durch Undichtigkeit des Bremskraftverst‰rkers" VALUE 0xFCDF6C KwUw 7.999878 fak_uw_b8 0.00 7.999878 FORMAT "%8.6" /end CHARACTERISTIC
/begin CHARACTERISTIC DPDSVLU "Delta Druckwert f¸r Signalvergleich Ladedruck mit Umgebungsdruck" VALUE 0xFCE1C6 KwUw 2559.961 p_uw_q0p039 0.00 2559.961 FORMAT "%8.3" /end CHARACTERISTIC
/begin CHARACTERISTIC DPLLMX "Maximales Druckverh‰ltnis im LL gedrosselt" VALUE 0xFC479C KwWU16 1.999969 fak_uw_b2 0.00 1.999969 FORMAT "%8.6" /end CHARACTERISTIC
/begin CHARACTERISTIC DPSFGDVH "" VALUE 0xFC3EA4 KwWU8 1.000 fak_ub_q0p00392 0.00 1.000 FORMAT "%5.3" /end CHARACTERISTIC
/begin CHARACTERISTIC DPSGRADDR "" VALUE 0xFC3E7E KwWS16 2559.961 zk_p_q0p039 -1280.000 1279.961 FORMAT "%8.3" /end CHARACTERISTIC
/begin CHARACTERISTIC DPSGRADDRN "" VALUE 0xFC3E80 KwWS16 2559.961 zk_p_q0p039 -1280.000 1279.961 FORMAT "%8.3" /end CHARACTERISTIC
/begin CHARACTERISTIC DPSGRADTD "Filterparameter f¸r Druckvorsteuerungsfilter bei positivem Gradienten" VALUE 0xFC3E82 KwWU16 0.9999847 fak_uw_b1 0.00 0.9999847 FORMAT "%9.7" /end CHARACTERISTIC
/begin CHARACTERISTIC DPSGRADUD "" VALUE 0xFC3E84 KwWS16 2559.961 zk_p_q0p039 -1280.000 1279.961 FORMAT "%8.3" /end CHARACTERISTIC
/begin CHARACTERISTIC DPSGRADUTD "Filterparameter f¸r Druckvorsteuerungsfilter bei negativem Gradienten" VALUE 0xFC3E86 KwWU16 0.9999847 fak_uw_b1 0.00 0.9999847 FORMAT "%9.7" /end CHARACTERISTIC
/begin CHARACTERISTIC DPSGRENDK "Grenzwert Drosselklappensollwinkel zur Umschaltung der Filterzeitkonstanten" VALUE 0xFC479E KwWS16 2559.961 p_q0p039 -1280.000 1279.961 FORMAT "%8.3" /end CHARACTERISTIC
/begin CHARACTERISTIC DPSGRENZ "Begrenzung Differenzdruck Saugrohr f¸r ‹bergang ungedrosselt in gedrosselt" VALUE 0xFC3E88 KwWU16 1279.688 p_q0p039 0.00 1279.688 FORMAT "%8.3" /end CHARACTERISTIC
/begin CHARACTERISTIC DPSMN "minimaler Drosselfaktor f¸r Reglerstop" VALUE 0xFC3E8A KwWU16 1279.688 p_q0p039 0.00 1279.688 FORMAT "%8.3" /end CHARACTERISTIC
/begin CHARACTERISTIC DPSMX "maximaler Drosselfaktor f¸r Reglerstop" VALUE 0xFC3E8C KwWU16 1279.688 p_q0p039 0.00 1279.688 FORMAT "%8.3" /end CHARACTERISTIC
/begin CHARACTERISTIC DPSRAMPE "Rampe f¸r Differenzdruck Saugrohr" VALUE 0xFC3EA5 KwWU8 9.961 p_q0p039 0.00 9.961 FORMAT "%5.3" /end CHARACTERISTIC
/begin CHARACTERISTIC DPSTDMAMX "" VALUE 0xFCD5F4 KwUw 2559.96 p_q0p039s32768 -1280.00 1279.96 FORMAT "%7.2" /end CHARACTERISTIC
/begin CHARACTERISTIC DPUPVDK "Differenzdruck pu-pvdk" CURVE 0xFCE1C8 KlAUwSstUwWUw 2559.961 p_uw_q0p039 0.00 2559.961 FORMAT "%8.3"
 /begin AXIS_DESCR STD_AXIS ml_w m_uw_b6553p5 8 0.00 6553.500 FORMAT "%8.3" DEPOSIT ABSOLUTE /end AXIS_DESCR
/end CHARACTERISTIC
/begin CHARACTERISTIC DSUGRAD "Gradient f¸r Drucksensor Umgebung" VALUE 0xFCE1EA KwUw 1023.984 dgrad_uw_q0p015 0.00 1023.984 FORMAT "%8.3" /end CHARACTERISTIC
/begin CHARACTERISTIC DSUOFS "Offset Drucksensor Umgebung" VALUE 0xFCE1EC KwSw 2559.961 p_sw_q0p039 -1280.000 1279.961 FORMAT "%8.3" /end CHARACTERISTIC
/begin CHARACTERISTIC DUDKP1HY "Offset f¸r Hysterese bei Umschaltung auf verst‰rktes Signal von DK-Poti 1" VALUE 0xFC1E70 KwUw 80.08377 spg_uw_q0p001222 0.00 80.08377 FORMAT "%8.5" /end CHARACTERISTIC
/begin CHARACTERISTIC DUPW12 "Zul‰ssige Spannungsabweichung zwischen PWG-Poti 1 und 2" VALUE 0xFC6327 KwUb 4.980 spg_ub_b5 0.00 4.980 FORMAT "%5.3" /end CHARACTERISTIC
/begin CHARACTERISTIC DUPW12BE "notweniger Spannungsweg von Poti 2 zur Bewegungserkennung" VALUE 0xFC6346 KwUw 4.995117 spg_uw_q0p00488 0.00 4.995117 FORMAT "%8.6" /end CHARACTERISTIC
/begin CHARACTERISTIC DUPW12TG "Zul‰ssige Spannungsabweichung zwischen PWG Poti 1 und  2 im Teilgasbereich" VALUE 0xFC6328 KwUb 4.980 spg_ub_b5 0.00 4.980 FORMAT "%5.3" /end CHARACTERISTIC
/begin CHARACTERISTIC DUPW12VG "Zul‰ssige Spannungsabweichung zwischen PWG-Poti 1 und 2 im Vollgasbereich" VALUE 0xFC6329 KwUb 4.980 spg_ub_b5 0.00 4.980 FORMAT "%5.3" /end CHARACTERISTIC
/begin CHARACTERISTIC DUPWGHY "Spannungshysterese bei Entjitterung der PWG-Spannung" VALUE 0xFC6348 KwUw 4.995117 spg_uw_q0p00488 0.00 4.995117 FORMAT "%8.6" /end CHARACTERISTIC
/begin CHARACTERISTIC DUSRIH "Delta Sondenspannung hinter Kat zwischen Neu-und Altwert  f¸r Ri-Messung" VALUE 0xFC63E4 KwSw 319.9951 spg_sw_q0p00488 -160.0000 159.9951 FORMAT "%8.4" /end CHARACTERISTIC
/begin CHARACTERISTIC DUSRIV "Delta Sondenspannung vor Kat zwischen Neu-und Altwert im Raster f¸r Ri-Messung" VALUE 0xFC63CC KwSw 319.9951 spg_sw_q0p00488 -160.0000 159.9951 FORMAT "%8.4" /end CHARACTERISTIC
/begin CHARACTERISTIC DUSSPH "Delta Sondensp. hinter Kat zwischen Neu-und 2 Altwerten f¸r Sonden Sprungmessung" VALUE 0xFC63E6 KwSw 319.9951 spg_sw_q0p00488 -160.0000 159.9951 FORMAT "%8.4" /end CHARACTERISTIC
/begin CHARACTERISTIC DUSSPV "Delta Sondensp. vor Kat zwischen Neu-und Altwert f¸r Sonden Sprungmessung" VALUE 0xFC63CE KwSw 319.9951 spg_sw_q0p00488 -160.0000 159.9951 FORMAT "%8.4" /end CHARACTERISTIC
/begin CHARACTERISTIC DVIVZTMX "Maximales Delta zw. Ist- und Zielgeschw. f¸r Tip-Erlaubnis" VALUE 0xFC20B6 KwUw 511.9922 vfzg_uw_b512 0.00 511.9922 FORMAT "%8.4" /end CHARACTERISTIC
/begin CHARACTERISTIC DVSAVO "Delta Geschwindigkeit f¸r R¸cksetzen Schubabschalteverbot vom FGR" VALUE 0xFC20B8 KwUw 511.9922 vfzg_uw_b512 0.00 511.9922 FORMAT "%8.4" /end CHARACTERISTIC
/begin CHARACTERISTIC DVSAVU "Delta Geschwindigkeit f¸r Setzen Schubabschalteverbot vom FGR" VALUE 0xFC20BA KwUw 511.9922 vfzg_uw_b512 0.00 511.9922 FORMAT "%8.4" /end CHARACTERISTIC
/begin CHARACTERISTIC DVSKNBGA "Delta Geschwindigkeit f¸r Setzwertkorrektur nach Beschleunigen" CURVE 0xFCCDC4 KlAUwSstUwWUw 511.9922 vfzg_uw_b512 0.00 511.9922 FORMAT "%8.4"
 /begin AXIS_DESCR STD_AXIS gangi dez 8 0.00 255.0 FORMAT "%5.1" DEPOSIT ABSOLUTE /end AXIS_DESCR
/end CHARACTERISTIC
/begin CHARACTERISTIC DVSKNVGA "Delta Geschwindigkeit f¸r Setzwertkorrektur nach Verzˆgern" CURVE 0xFCCDE6 KlAUwSstUwWUw 511.9922 vfzg_uw_b512 0.00 511.9922 FORMAT "%8.4"
 /begin AXIS_DESCR STD_AXIS gangi dez 8 0.00 255.0 FORMAT "%5.1" DEPOSIT ABSOLUTE /end AXIS_DESCR
/end CHARACTERISTIC
/begin CHARACTERISTIC DVTIPUD "ƒnderung der Zielgeschwindigkeit bei Tip-Up oder Tip-Down" VALUE 0xFC20BC KwUw 511.9922 vfzg_uw_b512 0.00 511.9922 FORMAT "%8.4" /end CHARACTERISTIC
/begin CHARACTERISTIC DVZVITMX "Maximales Delta zw. Ziel- und Istgeschw. f¸r Tip-Erlaubnis" VALUE 0xFC20BE KwUw 511.9922 vfzg_uw_b512 0.00 511.9922 FORMAT "%8.4" /end CHARACTERISTIC
/begin CHARACTERISTIC DVZVIWA "Delta zw. Ziel- und Istgeschw. f¸r ‹bergang von Konstantfahrt in Wiederaufnahme" VALUE 0xFC20C0 KwUw 511.9922 vfzg_uw_b512 0.00 511.9922 FORMAT "%8.4" /end CHARACTERISTIC
/begin CHARACTERISTIC DVZVRWA1 "Delta zw. Ziel- und Sollgeschw. f¸r ‹bergang in WA-Lande-Mode Bereich 1" VALUE 0xFC20C2 KwUw 511.9922 vfzg_uw_b512 0.00 511.9922 FORMAT "%8.4" /end CHARACTERISTIC
/begin CHARACTERISTIC DVZVRWA2 "Delta zw. Ziel- und Sollgeschw. f¸r ‹bergang in WA-Lande-Mode Bereich 2" VALUE 0xFC20C4 KwUw 511.9922 vfzg_uw_b512 0.00 511.9922 FORMAT "%8.4" /end CHARACTERISTIC
/begin CHARACTERISTIC DVZVRWA3 "Delta zw. Ziel- und Sollgeschw. f¸r ‹bergang in WA-Lande-Mode Bereich 3" VALUE 0xFC20C6 KwUw 511.9922 vfzg_uw_b512 0.00 511.9922 FORMAT "%8.4" /end CHARACTERISTIC
/begin CHARACTERISTIC DWDK12O "Maximal zul‰ssige Abweichung zwischen den DK-Winkeln aus Poti 1 und 2" VALUE 0xFC1E50 KwUb 100.0 relDK_ub_b100 0.00 100.0 FORMAT "%5.1" /end CHARACTERISTIC
/begin CHARACTERISTIC DWDK13O "Maximal zul‰ssige Abweichung zwischen DK-Winkel aus Poti 1 und Ersatzwert" VALUE 0xFC1E51 KwUb 100.0 relDK_ub_b100 0.00 100.0 FORMAT "%5.1" /end CHARACTERISTIC
/begin CHARACTERISTIC DWDK23O "Maximal zul‰ssige Abweichung zwischen DK-Winkel aus Poti 2 und Ersatzwert" VALUE 0xFC1E52 KwUb 100.0 relDK_ub_b100 0.00 100.0 FORMAT "%5.1" /end CHARACTERISTIC
/begin CHARACTERISTIC DWEEMX "maximal zul‰ssige Zunahme Winkel Einspritzende pro Syncro" VALUE 0xFC4F12 KwWU8 765.0 kw_q3 0.00 765.0 FORMAT "%5.1" /end CHARACTERISTIC
/begin CHARACTERISTIC DWPMXNB "Maximal zul‰ssige Pedalwerterhˆhung pro Rechenschritt nach Bremsbet‰tigung" VALUE 0xFC634A KwUw 100.0000 relPED_uw_b100 0.00 100.0000 FORMAT "%8.4" /end CHARACTERISTIC
/begin CHARACTERISTIC DWPMXNOT "Maximal zul‰ssige Pedalwerterhˆhung pro Rechenschritt im PWG-Ersatzbetrieb" VALUE 0xFC634C KwUw 100.0000 relPED_uw_b100 0.00 100.0000 FORMAT "%8.4" /end CHARACTERISTIC
/begin CHARACTERISTIC EVHUBSOFKF "" VALUE 0xFCD5F6 KwUw 65.53500 hub_uw_q0p001 0.00 65.53500 FORMAT "%8.5" /end CHARACTERISTIC
/begin CHARACTERISTIC FBKVP "Faktor zur Berechnung des min. Pumpdrucks abh‰ngig von Umgebungsdruck" VALUE 0xFCDF6E KwUw 1.999969 fak_uw_b2 0.00 1.999969 FORMAT "%8.6" /end CHARACTERISTIC
/begin CHARACTERISTIC FFLDZ "Folgefunkenladezeit" CURVE 0xFCB164 KlAUwSstUwWUw 24.95000 txms_uw_q0p001 0.05000000 25.00000 FORMAT "%8.5"
 /begin AXIS_DESCR STD_AXIS ub_w spg_ubatt 8 0.00 6173.397 FORMAT "%8.3" DEPOSIT ABSOLUTE /end AXIS_DESCR
/end CHARACTERISTIC
/begin CHARACTERISTIC FFZOF "Folgefunkenoffenzeit" VALUE 0xFCB186 KwUw 11.95000 txms_uw_q0p001 0.05000000 12.00000 FORMAT "%8.5" /end CHARACTERISTIC
/begin CHARACTERISTIC FHOE "Ersatzwert f¸r Hˆhe" VALUE 0xFCE1AC KwUb 3.984 fak_ub_b4 0.00 3.984 FORMAT "%5.3" /end CHARACTERISTIC
/begin CHARACTERISTIC FHOMIN "Minimaler Hˆhenfaktor" VALUE 0xFC3EA6 KwWU8 3.984 fak_ub_b4 0.00 3.984 FORMAT "%5.3" /end CHARACTERISTIC
/begin CHARACTERISTIC FIMHU "Faktor Impuls hart" CURVE 0xFC4F14 FklWUb 1.992 fak_ub_b2 0.00 1.992 FORMAT "%5.3"
 /begin AXIS_DESCR FIX_AXIS anzwefim dez 16 0.00 15.00 FORMAT "%5.2" FIX_AXIS_PAR 0 0 16 /end AXIS_DESCR
/end CHARACTERISTIC
/begin CHARACTERISTIC FIMWU "Faktor Impuls weich" CURVE 0xFC4F24 FklWUb 1.992 fak_ub_b2 0.00 1.992 FORMAT "%5.3"
 /begin AXIS_DESCR FIX_AXIS anzwefim dez 16 0.00 15.00 FORMAT "%5.2" FIX_AXIS_PAR 0 0 16 /end AXIS_DESCR
/end CHARACTERISTIC
/begin CHARACTERISTIC FMFKRN1 "Filtermittenfrequenz f¸r Bandpaﬂfilter Klopfregelung Zyl. 1" CURVE 0xFC6368 KlAxU8SstxU8WU8 255.0 fmfkr_dez 0.00 255.0 FORMAT "%5.1"
 /begin AXIS_DESCR STD_AXIS nmot nmot_ub_q40 5 0.00 10200. FORMAT "%5.0" DEPOSIT ABSOLUTE /end AXIS_DESCR
/end CHARACTERISTIC
/begin CHARACTERISTIC FMFKRN2 "Filtermittenfrequenz f¸r Bandpaﬂfilter Klopfregelung Zyl. 2" CURVE 0xFC6374 KlAxU8SstxU8WU8 255.0 fmfkr_dez 0.00 255.0 FORMAT "%5.1"
 /begin AXIS_DESCR STD_AXIS nmot nmot_ub_q40 5 0.00 10200. FORMAT "%5.0" DEPOSIT ABSOLUTE /end AXIS_DESCR
/end CHARACTERISTIC
/begin CHARACTERISTIC FMFKRN3 "Filtermittenfrequenz f¸r Bandpaﬂfilter Klopfregelung Zyl. 3" CURVE 0xFC6380 KlAxU8SstxU8WU8 255.0 fmfkr_dez 0.00 255.0 FORMAT "%5.1"
 /begin AXIS_DESCR STD_AXIS nmot nmot_ub_q40 5 0.00 10200. FORMAT "%5.0" DEPOSIT ABSOLUTE /end AXIS_DESCR
/end CHARACTERISTIC
/begin CHARACTERISTIC FMFKRN4 "Filtermittenfrequenz f¸r Bandpaﬂfilter Klopfregelung Zyl. 4" CURVE 0xFC638C KlAxU8SstxU8WU8 255.0 fmfkr_dez 0.00 255.0 FORMAT "%5.1"
 /begin AXIS_DESCR STD_AXIS nmot nmot_ub_q40 5 0.00 10200. FORMAT "%5.0" DEPOSIT ABSOLUTE /end AXIS_DESCR
/end CHARACTERISTIC
/begin CHARACTERISTIC FMFKRN5 "Filtermittenfrequenz f¸r Bandpaﬂfilter Klopfregelung Zyl. 5" CURVE 0xFC6398 KlAxU8SstxU8WU8 255.0 fmfkr_dez 0.00 255.0 FORMAT "%5.1"
 /begin AXIS_DESCR STD_AXIS nmot nmot_ub_q40 5 0.00 10200. FORMAT "%5.0" DEPOSIT ABSOLUTE /end AXIS_DESCR
/end CHARACTERISTIC
/begin CHARACTERISTIC FMFKRN6 "Filtermittenfrequenz f¸r Bandpaﬂfilter Klopfregelung Zyl. 6" CURVE 0xFC63A4 KlAxU8SstxU8WU8 255.0 fmfkr_dez 0.00 255.0 FORMAT "%5.1"
 /begin AXIS_DESCR STD_AXIS nmot nmot_ub_q40 5 0.00 10200. FORMAT "%5.0" DEPOSIT ABSOLUTE /end AXIS_DESCR
/end CHARACTERISTIC
/begin CHARACTERISTIC FMFKRN7 "Filtermittenfrequenz f¸r Bandpaﬂfilter Klopfregelung Zyl. 7" CURVE 0xFC63B0 KlAxU8SstxU8WU8 255.0 fmfkr_dez 0.00 255.0 FORMAT "%5.1"
 /begin AXIS_DESCR STD_AXIS nmot nmot_ub_q40 5 0.00 10200. FORMAT "%5.0" DEPOSIT ABSOLUTE /end AXIS_DESCR
/end CHARACTERISTIC
/begin CHARACTERISTIC FMFKRN8 "Filtermittenfrequenz f¸r Bandpaﬂfilter Klopfregelung Zyl. 8" CURVE 0xFC63BC KlAxU8SstxU8WU8 255.0 fmfkr_dez 0.00 255.0 FORMAT "%5.1"
 /begin AXIS_DESCR STD_AXIS nmot nmot_ub_q40 5 0.00 10200. FORMAT "%5.0" DEPOSIT ABSOLUTE /end AXIS_DESCR
/end CHARACTERISTIC
/begin CHARACTERISTIC FPUPSMAX "" VALUE 0xFC3E8E KwWU16 7.999878 fak_uw_b8 0.00 7.999878 FORMAT "%8.6" /end CHARACTERISTIC
/begin CHARACTERISTIC FPWDKAPP "Drosselklappenkennlinie abh. von Fahrpedal nur f. Applik." CURVE 0xFC45EA KlAxU8SstxU16WU16 99.99847 rel_uw_b100 0.00 99.99847 FORMAT "%8.5"
 /begin AXIS_DESCR STD_AXIS wped_w relPED_uw_b100 16 0.00 100.0000 FORMAT "%8.4" DEPOSIT ABSOLUTE /end AXIS_DESCR
/end CHARACTERISTIC
/begin CHARACTERISTIC FQFSTT "Quantisierungsfaktor Fuellstand" VALUE 0xFCDF2A KwUb 25.50 vol_q0p1_l 0.00 25.50 FORMAT "%5.2" /end CHARACTERISTIC
/begin CHARACTERISTIC FRINOF "Faktor f¸r Bewertung alter Ri-Wert ohne Filter" VALUE 0xFC63E1 KwUb 15.94 fak_ub_b16 0.00 15.94 FORMAT "%5.2" /end CHARACTERISTIC
/begin CHARACTERISTIC FSTDMN "minimaler Tankfuellstand fuer Tankdiagnosefunktionen" VALUE 0xFCDF2C KwUw 6553.500 vol_q0p1_l 0.00 6553.500 FORMAT "%8.3" /end CHARACTERISTIC
/begin CHARACTERISTIC FSTDMX "maximaler Tankfuellstand fuer Tankdiagnosefunktionen" VALUE 0xFCDF2E KwUw 6553.500 vol_q0p1_l 0.00 6553.500 FORMAT "%8.3" /end CHARACTERISTIC
/begin CHARACTERISTIC FSTDTOL "Toleranz Fuellstandsdynamik" VALUE 0xFCDF30 KwUw 6553.500 vol_q0p1_l 0.00 6553.500 FORMAT "%8.3" /end CHARACTERISTIC
/begin CHARACTERISTIC FSTHYS "Hysterese fuer Tankfuellstandsschwellen B_tal, B_tav, etc." VALUE 0xFCDF32 KwUw 6553.500 vol_q0p1_l 0.00 6553.500 FORMAT "%8.3" /end CHARACTERISTIC
/begin CHARACTERISTIC FSTTAL "Tankfuellstand fuer ""Tank leer"" Erkennung" VALUE 0xFCDF34 KwUw 6553.500 vol_q0p1_l 0.00 6553.500 FORMAT "%8.3" /end CHARACTERISTIC
/begin CHARACTERISTIC FSTTAL1 "Tankfuellstand fuer ""Tank leer"" Erkennung Tank1" VALUE 0xFCDF36 KwUw 6553.500 vol_q0p1_l 0.00 6553.500 FORMAT "%8.3" /end CHARACTERISTIC
/begin CHARACTERISTIC FSTTAV "Tankfuellstand fuer ""Tank voll"" Erkennung" VALUE 0xFCDF38 KwUw 6553.500 vol_q0p1_l 0.00 6553.500 FORMAT "%8.3" /end CHARACTERISTIC
/begin CHARACTERISTIC FSTTEW "Ersatzwert Fuellstand Kraftstofftank" VALUE 0xFCDF3A KwUw 6553.500 vol_q0p1_l 0.00 6553.500 FORMAT "%8.3" /end CHARACTERISTIC
/begin CHARACTERISTIC FSTTMX "maximaler Tankinhalt" VALUE 0xFCDF3C KwUw 319.9951 vol_q4p8828Em3_l 0.00 319.9951 FORMAT "%8.4" /end CHARACTERISTIC
/begin CHARACTERISTIC GVTMX "Gasvolumen Tank maximal" VALUE 0xFCDF3E KwUw 319.9951 vol_q4p8828Em3_l 0.00 319.9951 FORMAT "%8.4" /end CHARACTERISTIC
/begin CHARACTERISTIC HFM_MODE "Betriebsartenschalter f¸r HFM-Korrektur" VALUE 0xFCDF58 KwUb 4.000 dez 0.00 4.000 FORMAT "%5.3" /end CHARACTERISTIC
/begin CHARACTERISTIC ILMRMN "Minimalwert des Luftmassenreglers" VALUE 0xFC47AA KwSw 1535.977 rel_sw_q0p0234 -768.0000 767.9766 FORMAT "%8.4" /end CHARACTERISTIC
/begin CHARACTERISTIC ILMRMX "Maximalwert des Luftmassenreglers" VALUE 0xFC47AC KwSw 1535.977 rel_sw_q0p0234 -768.0000 767.9766 FORMAT "%8.4" /end CHARACTERISTIC
/begin CHARACTERISTIC ILMRN "Integratorverst‰rkung von Luftmassenregler" CURVE 0xFCD5FC GklWUb 7.969 fak_ub_b8 0.00 7.969 FORMAT "%5.3"
 /begin AXIS_DESCR COM_AXIS nmot nmot_ub_q40 8 0.00 10200. FORMAT "%5.0" AXIS_PTS_REF SNM08FEUB /end AXIS_DESCR
/end CHARACTERISTIC
/begin CHARACTERISTIC KAFPBKVPU "Korrektur Ausfluﬂ abh. von pbkvmod_w/pubkv_w" CURVE 0xFCDF70 KlAUwSstUwWUw 1.999969 fak_uw_b2 0.00 1.999969 FORMAT "%8.6"
 /begin AXIS_DESCR STD_AXIS pbkvmpu_w fak_uw_b2 4 0.00 1.999969 FORMAT "%8.6" DEPOSIT ABSOLUTE /end AXIS_DESCR
/end CHARACTERISTIC
/begin CHARACTERISTIC KEMLN "Messfensterl‰nge f¸r Klopfregelung" CURVE 0xFCE1F8 KlAUbSstUbWUb 191.3 zw_ub_q0p75 0.00 191.3 FORMAT "%5.1"
 /begin AXIS_DESCR STD_AXIS nmot nmot_ub_q40 16 0.00 10200. FORMAT "%5.0" DEPOSIT ABSOLUTE /end AXIS_DESCR
/end CHARACTERISTIC
/begin CHARACTERISTIC KFDPS "Kennfeld f¸r Differenzdruckvorgabe" MAP 0xFC3878 KfAxU16AyU16SstxU16SstyU16WU16 2559.96 p_q0p039s32768 -1280.00 1279.96 FORMAT "%7.2"
 /begin AXIS_DESCR STD_AXIS nmot_w nmot_uw_q0p25 8 0.00 16383.75 FORMAT "%8.2" DEPOSIT ABSOLUTE /end AXIS_DESCR
 /begin AXIS_DESCR STD_AXIS rlvw_w rel_uw_q0p0234 8 0.00 1535.977 FORMAT "%8.3" DEPOSIT ABSOLUTE /end AXIS_DESCR
/end CHARACTERISTIC
/begin CHARACTERISTIC KFFFANZ "Anzahl Folgefunken" MAP 0xFCB124 KfAxUbAyUbSstxUbSstyUbWUb 255.0 dez 0.00 255.0 FORMAT "%5.1"
 /begin AXIS_DESCR STD_AXIS tmot temp_ub_q0p75_o48 6 -48.00 143.3 FORMAT "%5.1" DEPOSIT ABSOLUTE /end AXIS_DESCR
 /begin AXIS_DESCR STD_AXIS nmot nmot_ub_q40 8 0.00 10200. FORMAT "%5.0" DEPOSIT ABSOLUTE /end AXIS_DESCR
/end CHARACTERISTIC
/begin CHARACTERISTIC KFFWL "Kennfeld Warmlauffaktor" MAP 0xFCDAA8 GkfWUb 1.992 fak_ub_b2 0.00 1.992 FORMAT "%5.3"
 /begin AXIS_DESCR COM_AXIS tmot temp_ub_q0p75_o48 12 -48.00 143.3 FORMAT "%5.1" AXIS_PTS_REF STM12ESUB /end AXIS_DESCR
 /begin AXIS_DESCR COM_AXIS tmst temp_ub_q0p75_o48 12 -48.00 143.3 FORMAT "%5.1" AXIS_PTS_REF STS12ESUB /end AXIS_DESCR
/end CHARACTERISTIC
/begin CHARACTERISTIC KFFWLW "Kennfeld Wichtung Warmlauffaktor" MAP 0xFC4F38 GkfWUb 0.9961 fak_ub_b1 0.00 0.9961
 /begin AXIS_DESCR COM_AXIS nmot nmot_ub_q40 12 0.00 10200. FORMAT "%5.0" AXIS_PTS_REF SNM12ESUB /end AXIS_DESCR
 /begin AXIS_DESCR COM_AXIS rl rel_ub_q0p75 12 0.00 191.3 FORMAT "%5.1" AXIS_PTS_REF SRL12ESUB /end AXIS_DESCR
/end CHARACTERISTIC
/begin CHARACTERISTIC KFHFMKOH "Kennfeld Luftmassenkorr. ¸ber Varianz und Ventilhub, bei HFM_MODE=0" MAP 0xFC5644 KfAxU8AyU8SstxU16SstyU16WU16 1.999969 fak_uw_b2 0.00 1.999969 FORMAT "%8.6"
 /begin AXIS_DESCR STD_AXIS evhubi_w hub_uw_q0p001 8 0.00 65.53500 FORMAT "%8.5" DEPOSIT ABSOLUTE /end AXIS_DESCR
 /begin AXIS_DESCR STD_AXIS hfm_sigma dez 12 0.00 65535.00 FORMAT "%8.2" DEPOSIT ABSOLUTE /end AXIS_DESCR
/end CHARACTERISTIC
/begin CHARACTERISTIC KFHFMKOM "Kennfeld Luftmassenkorr. ¸ber Varianz und unkorr.Luftmasse, bei HFM_MODE=1" MAP 0xFC5730 KfAxU8AyU8SstxU16SstyU16WU16 1.999969 fak_uw_b2 0.00 1.999969 FORMAT "%8.6"
 /begin AXIS_DESCR STD_AXIS mlhfmofs m_uw_b6553p5 8 0.00 6553.500 FORMAT "%8.3" DEPOSIT ABSOLUTE /end AXIS_DESCR
 /begin AXIS_DESCR STD_AXIS hfm_sigma dez 12 0.00 65535.00 FORMAT "%8.2" DEPOSIT ABSOLUTE /end AXIS_DESCR
/end CHARACTERISTIC
/begin CHARACTERISTIC KFHFMKOW "Kennfeld Luftmassenkorr. ¸ber Varianz und DK-Winkel, bei HFM_MODE=2" MAP 0xFC581C KfAxU8AyU8SstxU16SstyU16WU16 1.999969 fak_uw_b2 0.00 1.999969 FORMAT "%8.6"
 /begin AXIS_DESCR STD_AXIS wdkbau16 rel_uw_b100 8 0.00 99.99847 FORMAT "%8.5" DEPOSIT ABSOLUTE /end AXIS_DESCR
 /begin AXIS_DESCR STD_AXIS hfm_sigma dez 12 0.00 65535.00 FORMAT "%8.2" DEPOSIT ABSOLUTE /end AXIS_DESCR
/end CHARACTERISTIC
/begin CHARACTERISTIC KFKHFM "Korrekturkennfeld f¸r HFM" MAP 0xFC5A9C KfAxUbAyUbSstxUbSstyUbWUb 1.992 fak_ub_b2 0.00 1.992 FORMAT "%5.3"
 /begin AXIS_DESCR STD_AXIS nmot nmot_ub_q40 14 0.00 10200. FORMAT "%5.0" DEPOSIT ABSOLUTE /end AXIS_DESCR
 /begin AXIS_DESCR STD_AXIS rl rel_ub_q0p75 14 0.00 191.3 FORMAT "%5.1" DEPOSIT ABSOLUTE /end AXIS_DESCR
/end CHARACTERISTIC
/begin CHARACTERISTIC KFLASWLR "Kennfeld Lambda-Motor-Soll im Warmlauf bei aktiver LR" MAP 0xFCDB38 GkfWUb 1.992 fak_ub_b2 0.00 1.992 FORMAT "%5.3"
 /begin AXIS_DESCR COM_AXIS tmot temp_ub_q0p75_o48 12 -48.00 143.3 FORMAT "%5.1" AXIS_PTS_REF STM12ESUB /end AXIS_DESCR
 /begin AXIS_DESCR COM_AXIS tmst temp_ub_q0p75_o48 12 -48.00 143.3 FORMAT "%5.1" AXIS_PTS_REF STS12ESUB /end AXIS_DESCR
/end CHARACTERISTIC
/begin CHARACTERISTIC KFLM0812 "" MAP 0xFC391C KfAxU8AyU8SstxU16SstyU16WU16 1638.375 m_uw_b1638p4 0.00 1638.375 FORMAT "%8.3"
 /begin AXIS_DESCR STD_AXIS minhub_w hub_uw_q0p001 8 0.00 65.53500 FORMAT "%8.5" DEPOSIT ABSOLUTE /end AXIS_DESCR
 /begin AXIS_DESCR STD_AXIS nmot_w nmot_uw_q0p25 12 0.00 16383.75 FORMAT "%8.2" DEPOSIT ABSOLUTE /end AXIS_DESCR
/end CHARACTERISTIC
/begin CHARACTERISTIC KFMAKR "Kennfeld Meﬂfensteranfang Klopfregelung" MAP 0xFCE21C KfAxUbAyUbSstxUbSstyUbWUb 191.3 zw_ub_q0p75 0.00 191.3 FORMAT "%5.1"
 /begin AXIS_DESCR STD_AXIS nmot nmot_ub_q40 16 0.00 10200. FORMAT "%5.0" DEPOSIT ABSOLUTE /end AXIS_DESCR
 /begin AXIS_DESCR STD_AXIS rl rel_ub_q0p75 12 0.00 191.3 FORMAT "%5.1" DEPOSIT ABSOLUTE /end AXIS_DESCR
/end CHARACTERISTIC
/begin CHARACTERISTIC KFMSZSVNS "" MAP 0xFC3DA8 KfAxU8AyU8SstxU8SstyU8WU8 0.9961 fak_ub_b1 0.00 0.9961
 /begin AXIS_DESCR STD_AXIS nmot nmot_ub_q40 8 0.00 10200. FORMAT "%5.0" DEPOSIT ABSOLUTE /end AXIS_DESCR
 /begin AXIS_DESCR STD_AXIS rlvw rel_ub_q0p75 8 0.00 191.3 FORMAT "%5.1" DEPOSIT ABSOLUTE /end AXIS_DESCR
/end CHARACTERISTIC
/begin CHARACTERISTIC KFMSZSVNST "" MAP 0xFC3DFC KfAxU8AyU8SstxU8SstyU8WU8 0.9961 fak_ub_b1 0.00 0.9961
 /begin AXIS_DESCR STD_AXIS nmot nmot_ub_q40 8 0.00 10200. FORMAT "%5.0" DEPOSIT ABSOLUTE /end AXIS_DESCR
 /begin AXIS_DESCR STD_AXIS rlvw rel_ub_q0p75 8 0.00 191.3 FORMAT "%5.1" DEPOSIT ABSOLUTE /end AXIS_DESCR
/end CHARACTERISTIC
/begin CHARACTERISTIC KFPU "Pulsations - Kennfeld" MAP 0xFC5B80 KfAxUbAyUbSstxUbSstyUbWUb 1.992 fak_ub_b2 0.00 1.992 FORMAT "%5.3"
 /begin AXIS_DESCR STD_AXIS nmotkor nmot_ub_q40 14 0.00 10200. FORMAT "%5.0" DEPOSIT ABSOLUTE /end AXIS_DESCR
 /begin AXIS_DESCR STD_AXIS wdkba relDK_ub_b100 14 0.00 100.0 FORMAT "%5.1" DEPOSIT ABSOLUTE /end AXIS_DESCR
/end CHARACTERISTIC
/begin CHARACTERISTIC KFPU2SU "Pulsationskennfeld bei aktiver Saugrohrumschaltung sumode=2" MAP 0xFC5C64 KfAxUbAyUbSstxUbSstyUbWUb 1.992 fak_ub_b2 0.00 1.992 FORMAT "%5.3"
 /begin AXIS_DESCR STD_AXIS nmotkor nmot_ub_q40 14 0.00 10200. FORMAT "%5.0" DEPOSIT ABSOLUTE /end AXIS_DESCR
 /begin AXIS_DESCR STD_AXIS wdkba relDK_ub_b100 14 0.00 100.0 FORMAT "%5.1" DEPOSIT ABSOLUTE /end AXIS_DESCR
/end CHARACTERISTIC
/begin CHARACTERISTIC KFPU3SU "Pulsationskennfeld bei aktiver Saugrohrumschaltung sumode=3" MAP 0xFC5D48 KfAxUbAyUbSstxUbSstyUbWUb 1.992 fak_ub_b2 0.00 1.992 FORMAT "%5.3"
 /begin AXIS_DESCR STD_AXIS nmotkor nmot_ub_q40 14 0.00 10200. FORMAT "%5.0" DEPOSIT ABSOLUTE /end AXIS_DESCR
 /begin AXIS_DESCR STD_AXIS wdkba relDK_ub_b100 14 0.00 100.0 FORMAT "%5.1" DEPOSIT ABSOLUTE /end AXIS_DESCR
/end CHARACTERISTIC
/begin CHARACTERISTIC KFPUSU "Pulsationskennfeld bei aktiver Saugrohrumschaltung sumode=1" MAP 0xFC5E2C KfAxUbAyUbSstxUbSstyUbWUb 1.992 fak_ub_b2 0.00 1.992 FORMAT "%5.3"
 /begin AXIS_DESCR STD_AXIS nmotkor nmot_ub_q40 14 0.00 10200. FORMAT "%5.0" DEPOSIT ABSOLUTE /end AXIS_DESCR
 /begin AXIS_DESCR STD_AXIS wdkba relDK_ub_b100 14 0.00 100.0 FORMAT "%5.1" DEPOSIT ABSOLUTE /end AXIS_DESCR
/end CHARACTERISTIC
/begin CHARACTERISTIC KFTDKLM "" MAP 0xFC3A08 KfAxU8AyU8SstxU16SstyU16WU16 1638.375 m_uw_b1638p4 0.00 1638.375 FORMAT "%8.3"
 /begin AXIS_DESCR STD_AXIS Vse_spri sprzi_q0p1 8 0.00 6554. FORMAT "%4.0" DEPOSIT ABSOLUTE /end AXIS_DESCR
 /begin AXIS_DESCR STD_AXIS Vsa_spri sprzi_q0p1 8 0.00 6554. FORMAT "%4.0" DEPOSIT ABSOLUTE /end AXIS_DESCR
/end CHARACTERISTIC
/begin CHARACTERISTIC KFTDKST "" MAP 0xFC3AAC KfAxU8AyU8SstxU16SstyU16WU16 1.999969 fak_uw_b2 0.00 1.999969 FORMAT "%8.6"
 /begin AXIS_DESCR STD_AXIS Vse_spri sprzi_q0p1 8 0.00 6554. FORMAT "%4.0" DEPOSIT ABSOLUTE /end AXIS_DESCR
 /begin AXIS_DESCR STD_AXIS Vsa_spri sprzi_q0p1 8 0.00 6554. FORMAT "%4.0" DEPOSIT ABSOLUTE /end AXIS_DESCR
/end CHARACTERISTIC
/begin CHARACTERISTIC KFTDVNSFIL "" MAP 0xFC3EBA KfAxUwAyUwSstxUwSstyUwWUw 655.34999985 zk10msxs_uw_b655 0.010000152590 655.36000000 FORMAT "%12.8"
 /begin AXIS_DESCR STD_AXIS minhub_w hub_uw_q0p001 8 0.00 65.53500 FORMAT "%8.5" DEPOSIT ABSOLUTE /end AXIS_DESCR
 /begin AXIS_DESCR STD_AXIS dpssol_uw p_q0p039 8 0.00 2559.961 FORMAT "%8.3" DEPOSIT ABSOLUTE /end AXIS_DESCR
/end CHARACTERISTIC
/begin CHARACTERISTIC KFTHFM "Temperaturkompensationskennfeld f¸r HFM" MAP 0xFC5908 KfAxU8AyU8SstxU16SstyU16WU16 1.999969 fak_uw_b2 0.00 1.999969 FORMAT "%8.6"
 /begin AXIS_DESCR STD_AXIS tans16 temp_uw_q0p75_o48 8 -48.00000 49103.25 FORMAT "%8.2" DEPOSIT ABSOLUTE /end AXIS_DESCR
 /begin AXIS_DESCR STD_AXIS mshfmkor m_uw_b6553p5 12 0.00 6553.500 FORMAT "%8.3" DEPOSIT ABSOLUTE /end AXIS_DESCR
/end CHARACTERISTIC
/begin CHARACTERISTIC KFUMLTD "" MAP 0xFC3B50 KfAxU8AyU8SstxU16SstyU16WU16 1.999969 fak_uw_b2 0.00 1.999969 FORMAT "%8.6"
 /begin AXIS_DESCR STD_AXIS minhub_w hub_uw_q0p001 8 0.00 65.53500 FORMAT "%8.5" DEPOSIT ABSOLUTE /end AXIS_DESCR
 /begin AXIS_DESCR STD_AXIS nmot_w nmot_uw_q0p25 12 0.00 16383.75 FORMAT "%8.2" DEPOSIT ABSOLUTE /end AXIS_DESCR
/end CHARACTERISTIC
/begin CHARACTERISTIC KFVHUBML "" MAP 0xFC3C3C KfAxU8AyU8SstxU16SstyU16WU16 23.30133 m_uw_b23p3 0.00 23.30133 FORMAT "%8.5"
 /begin AXIS_DESCR STD_AXIS tmst temp_ub_q0p75_o48 12 -48.00 143.3 FORMAT "%5.1" DEPOSIT ABSOLUTE /end AXIS_DESCR
 /begin AXIS_DESCR STD_AXIS kmstand km_uw_q10 8 0.00 655350.0 FORMAT "%8.1" DEPOSIT ABSOLUTE /end AXIS_DESCR
/end CHARACTERISTIC
/begin CHARACTERISTIC KFVHUBON "" MAP 0xFC3D28 KfAxU8AyU8SstxU16SstyU16WU16 6553.500 t100msxs_uw_b6553p5 0.00 6553.500 FORMAT "%8.3"
 /begin AXIS_DESCR STD_AXIS tmst temp_ub_q0p75_o48 6 -48.00 143.3 FORMAT "%5.1" DEPOSIT ABSOLUTE /end AXIS_DESCR
 /begin AXIS_DESCR STD_AXIS kmstand km_uw_q10 8 0.00 655350.0 FORMAT "%8.1" DEPOSIT ABSOLUTE /end AXIS_DESCR
/end CHARACTERISTIC
/begin CHARACTERISTIC KFVOFFS "Geschwindigkeits-Offset f¸r FGR-Regler" MAP 0xFC20C8 KfAxUwAyUwSstxUwSstyUwWUw 511.9922 vfzg_uw_b512 0.00 511.9922 FORMAT "%8.4"
 /begin AXIS_DESCR STD_AXIS vziel_w vfzg_uw_b512 6 0.00 511.9922 FORMAT "%8.4" DEPOSIT ABSOLUTE /end AXIS_DESCR
 /begin AXIS_DESCR STD_AXIS gangi dez 8 0.00 255.0 FORMAT "%5.1" DEPOSIT ABSOLUTE /end AXIS_DESCR
/end CHARACTERISTIC
/begin CHARACTERISTIC KFWDKDPS "Kennfeld Drosselklappensollwinkel" MAP 0xFC436C KfAxU8AyU8SstxU16SstyU16WU16 99.99847 rel_uw_b100 0.00 99.99847 FORMAT "%8.5"
 /begin AXIS_DESCR STD_AXIS mlsoladte m_uw_b6553p5 21 0.00 6553.500 FORMAT "%8.3" DEPOSIT ABSOLUTE /end AXIS_DESCR
 /begin AXIS_DESCR STD_AXIS dpipol fak_uw_b2 8 0.00 1.999969 FORMAT "%8.6" DEPOSIT ABSOLUTE /end AXIS_DESCR
/end CHARACTERISTIC
/begin CHARACTERISTIC KFWDKMSN "Kennfeld f¸r Drosselklappen-Sollwinkel" MAP 0xFC44FA KfAxU8AyU8SstxU16SstyU16WU16 99.99847 rel_uw_b100 0.00 99.99847 FORMAT "%8.5"
 /begin AXIS_DESCR STD_AXIS mlwdkns_w m_uw_b6553p5 16 0.00 6553.500 FORMAT "%8.3" DEPOSIT ABSOLUTE /end AXIS_DESCR
 /begin AXIS_DESCR STD_AXIS nmot_w nmot_uw_q0p25 6 0.00 16383.75 FORMAT "%8.2" DEPOSIT ABSOLUTE /end AXIS_DESCR
/end CHARACTERISTIC
/begin CHARACTERISTIC KFWEE "Kennfeld Winkel Einspritzende" MAP 0xFC4E10 GkfWU8 765.0 kw_q3 0.00 765.0 FORMAT "%5.1"
 /begin AXIS_DESCR COM_AXIS nmot nmot_ub_q40 8 0.00 10200. FORMAT "%5.0" AXIS_PTS_REF SNM08GKUB /end AXIS_DESCR
 /begin AXIS_DESCR COM_AXIS rl rel_ub_q0p75 8 0.00 191.3 FORMAT "%5.1" AXIS_PTS_REF SRL08GKUB /end AXIS_DESCR
/end CHARACTERISTIC
/begin CHARACTERISTIC KFWEEGD "Kennfeld Winkel Einspritzende f¸r gedrosselten Betrieb" MAP 0xFC4E50 GkfWU8 765.0 kw_q3 0.00 765.0 FORMAT "%5.1"
 /begin AXIS_DESCR COM_AXIS nmot nmot_ub_q40 8 0.00 10200. FORMAT "%5.0" AXIS_PTS_REF SNM08GKUB /end AXIS_DESCR
 /begin AXIS_DESCR COM_AXIS rl rel_ub_q0p75 8 0.00 191.3 FORMAT "%5.1" AXIS_PTS_REF SRL08GKUB /end AXIS_DESCR
/end CHARACTERISTIC
/begin CHARACTERISTIC KFZKHFM "Zeitkonstantenkennfeld f¸r Gl‰ttung der Luftmasse" MAP 0xFC59F4 KfAxU8AyU8SstxU16SstyU16WU16 655.34999985 zk10msxs_uw_b655 0.010000152590 655.36000000 FORMAT "%12.8"
 /begin AXIS_DESCR STD_AXIS nmot_w nmot_uw_q0p25 8 0.00 16383.75 FORMAT "%8.2" DEPOSIT ABSOLUTE /end AXIS_DESCR
 /begin AXIS_DESCR STD_AXIS rlvw_w rel_uw_q0p0234 8 0.00 1535.977 FORMAT "%8.3" DEPOSIT ABSOLUTE /end AXIS_DESCR
/end CHARACTERISTIC
/begin CHARACTERISTIC KKFFGRGA "Verst‰rkungsfaktor bei Konstantfahrt f¸r FGR-Regler" CURVE 0xFCCE08 KlAUwSstUwWUw 3199.951 rel_uw_b3200 0.00 3199.951 FORMAT "%8.3"
 /begin AXIS_DESCR STD_AXIS gangi dez 8 0.00 255.0 FORMAT "%5.1" DEPOSIT ABSOLUTE /end AXIS_DESCR
/end CHARACTERISTIC
/begin CHARACTERISTIC KLAF "Ausfluﬂkennlinie" CURVE 0xFC3F82 FklWU16 0.9999847 fak_uw_b1 0.00 0.9999847 FORMAT "%9.7"
 /begin AXIS_DESCR FIX_AXIS kldpin_in fak_uw_q0p001 501 0.5000000 1.000000 FORMAT "%8.6" FIX_AXIS_PAR 500 0 501 /end AXIS_DESCR
/end CHARACTERISTIC
/begin CHARACTERISTIC KLDKVL "Vollast-Kennlinie f¸r Drosselklappen-Sollwinkel" CURVE 0xFC462C KlAxU8SstxU16WU16 99.99847 rel_uw_b100 0.00 99.99847 FORMAT "%8.5"
 /begin AXIS_DESCR STD_AXIS nmot_w nmot_uw_q0p25 16 0.00 16383.75 FORMAT "%8.2" DEPOSIT ABSOLUTE /end AXIS_DESCR
/end CHARACTERISTIC
/begin CHARACTERISTIC KLDPIPOL "Kennlinie dp Interpolation" CURVE 0xFC466E KlAxU8SstxU16WU16 1.999969 fak_uw_b2 0.00 1.999969 FORMAT "%8.6"
 /begin AXIS_DESCR STD_AXIS kldpin_w fak_uw_b2 24 0.00 1.999969 FORMAT "%8.6" DEPOSIT ABSOLUTE /end AXIS_DESCR
/end CHARACTERISTIC
/begin CHARACTERISTIC KLDPSDKM "Ueberblendung zwischen Ansteuerung DK bei gedrosseltem oder VVT-Betrieb" CURVE 0xFC46D0 KlAxU8SstxU16WU16 0.9999695 fak_uw_b2 0.00003051758 1.000000 FORMAT "%8.6"
 /begin AXIS_DESCR STD_AXIS kldpin_w fak_uw_b2 6 0.00 1.999969 FORMAT "%8.6" DEPOSIT ABSOLUTE /end AXIS_DESCR
/end CHARACTERISTIC
/begin CHARACTERISTIC KLDPSFAK "" CURVE 0xFC3E70 KlAxU8SstxU8WU8 1.000 fak_ub_q0p00392 0.00 1.000 FORMAT "%5.3"
 /begin AXIS_DESCR STD_AXIS dpsfakro fak_ub_q0p00392 6 0.00 1.000 FORMAT "%5.3" DEPOSIT ABSOLUTE /end AXIS_DESCR
/end CHARACTERISTIC
/begin CHARACTERISTIC KLDPSREGOF "" CURVE 0xFC46EA KlAxU8SstxU16WU16 1.999969 fak_uw_b2 0.00 1.999969 FORMAT "%8.6"
 /begin AXIS_DESCR STD_AXIS dpssol_w p_q0p039 6 -1280.000 1279.961 FORMAT "%8.3" DEPOSIT ABSOLUTE /end AXIS_DESCR
/end CHARACTERISTIC
/begin CHARACTERISTIC KLGDVNSFIL "" CURVE 0xFC3F5E KlAUwSstSwWUw 655.34999985 zk10msxs_uw_b655 0.010000152590 655.36000000 FORMAT "%12.8"
 /begin AXIS_DESCR STD_AXIS dpsfg_w p_sw_q0p039 8 -1280.000 1279.961 FORMAT "%8.3" DEPOSIT ABSOLUTE /end AXIS_DESCR
/end CHARACTERISTIC
/begin CHARACTERISTIC KLTDFUEREG "" CURVE 0xFC3E4E KlAxU8SstxS16WS16 1638.375 m_uw_b1638p4 -819.2000 819.1750 FORMAT "%8.4"
 /begin AXIS_DESCR STD_AXIS rlfe_w rel_uw_q0p0234 8 -768.0000 767.9766 FORMAT "%8.4" DEPOSIT ABSOLUTE /end AXIS_DESCR
/end CHARACTERISTIC
/begin CHARACTERISTIC KRAFGRGA "Verst‰rkungsfaktor bei Rampe f¸r FGR-Regler" CURVE 0xFCCE2A KlAUwSstUwWUw 3199.951 rel_uw_b3200 0.00 3199.951 FORMAT "%8.3"
 /begin AXIS_DESCR STD_AXIS gangi dez 8 0.00 255.0 FORMAT "%5.1" DEPOSIT ABSOLUTE /end AXIS_DESCR
/end CHARACTERISTIC
/begin CHARACTERISTIC KWNSIGMA "Drehzahlschwelle f¸r Korrekturabschaltung" VALUE 0xFCDF59 KwUb 10200. nmot_ub_q40 0.00 10200. FORMAT "%5.0" /end CHARACTERISTIC
/begin CHARACTERISTIC LASWLTM "Offset Lambda-Motor-Soll bei inaktiver Lambdaregelung" CURVE 0xFCDBC8 GklWSb 1.992 fak_sb_b1 -1.000 0.9922 FORMAT "%5.3"
 /begin AXIS_DESCR COM_AXIS tmot temp_ub_q0p75_o48 12 -48.00 143.3 FORMAT "%5.1" AXIS_PTS_REF STM12ESUB /end AXIS_DESCR
/end CHARACTERISTIC
/begin CHARACTERISTIC MINHUBOFTD "Offset minhub f¸r Bedingung B_lltd" VALUE 0xFC3E90 KwWU16 65.53500 hub_uw_q0p001 0.00 65.53500 FORMAT "%8.5" /end CHARACTERISTIC
/begin CHARACTERISTIC MLHFM "Linearisierung der Heiﬂfilmspannung" CURVE 0xFC5F22 FklWUw 6553.500 m_uw_b6553p5 0.00 6553.500 FORMAT "%8.3"
 /begin AXIS_DESCR FIX_AXIS uhfm_w spg_q0p00977 512 0.00 4.990234 FORMAT "%8.6" FIX_AXIS_PAR 0 0 512 /end AXIS_DESCR
/end CHARACTERISTIC
/begin CHARACTERISTIC MLOFS "Kennlinienoffset HFM 5" VALUE 0xFC6322 KwUw 6553.500 m_uw_b6553p5 0.00 6553.500 FORMAT "%8.3" /end CHARACTERISTIC
/begin CHARACTERISTIC MLTDDIV "Divisionsfaktor f¸r Ausgang Druckregler" VALUE 0xFC3EB6 KwUb 254.0 dez 1.000 255.0 FORMAT "%5.1" /end CHARACTERISTIC
/begin CHARACTERISTIC MLTDMAMN "" VALUE 0xFCD5F8 KwSw 1638.375 m_uw_b1638p4 -819.2000 819.1750 FORMAT "%8.4" /end CHARACTERISTIC
/begin CHARACTERISTIC MLTDMAMX "" VALUE 0xFCD5FA KwSw 1638.375 m_uw_b1638p4 -819.2000 819.1750 FORMAT "%8.4" /end CHARACTERISTIC
/begin CHARACTERISTIC MRFAVW "Schwelle zur Umschaltung des Vorlagerungswinkels bei max. Fahrerwunsches" CURVE 0xFC4E90 GklWU16 199.9969 rel_uw_b200 0.00 199.9969 FORMAT "%8.4"
 /begin AXIS_DESCR COM_AXIS nmot nmot_ub_q40 8 0.00 10200. FORMAT "%5.0" AXIS_PTS_REF SNM08GKUB /end AXIS_DESCR
/end CHARACTERISTIC
/begin CHARACTERISTIC MRFGRMAX "Maximalwert f¸r relatives Moment aus FGR" VALUE 0xFC206A KwUw 199.9969 rel_uw_b200 0.00 199.9969 FORMAT "%8.4" /end CHARACTERISTIC
/begin CHARACTERISTIC MRFGRMR "FGR-Korrekturkennlinie" CURVE 0xFC2148 KlAUwSstUwWUw 199.9969 rel_uw_b200 0.00 199.9969 FORMAT "%8.4"
 /begin AXIS_DESCR STD_AXIS mrregl_w rel_uw_b200 8 0.00 199.9969 FORMAT "%8.4" DEPOSIT ABSOLUTE /end AXIS_DESCR
/end CHARACTERISTIC
/begin CHARACTERISTIC MRFGRSTA "Startwert f¸r Relatives Moment bei Aktivierung FGR-Regler" VALUE 0xFC216A KwUw 199.9969 rel_uw_b200 0.00 199.9969 FORMAT "%8.4" /end CHARACTERISTIC
/begin CHARACTERISTIC MRMRFGR "Inverse FGR-Korrekturkennlinie" CURVE 0xFC216C KlAUwSstUwWUw 199.9969 rel_uw_b200 0.00 199.9969 FORMAT "%8.4"
 /begin AXIS_DESCR STD_AXIS mrfgri_w rel_uw_b200 8 0.00 199.9969 FORMAT "%8.4" DEPOSIT ABSOLUTE /end AXIS_DESCR
/end CHARACTERISTIC
/begin CHARACTERISTIC MSNLG "Leckluft DK geschlossen" VALUE 0xFC47A0 KwWU16 6553.500 m_uw_b6553p5 0.00 6553.500 FORMAT "%8.3" /end CHARACTERISTIC
/begin CHARACTERISTIC NDKPPU "Minimaldrehzahl f¸r Plausibilisierung DK-Poti 2 nach unten im Normalbetrieb" VALUE 0xFC1E53 KwUb 10000. nmot_ub_q40 200.0 10200. FORMAT "%5.0" /end CHARACTERISTIC
/begin CHARACTERISTIC NDSVLO "obere Drehzahlschwelle f¸r Signalvergleich Ladedruck mit Umgebungsdruck" VALUE 0xFCE1AD KwUb 10200. nmot_ub_q40 0.00 10200. FORMAT "%5.0" /end CHARACTERISTIC
/begin CHARACTERISTIC NDSVLU "Drehzahlschwelle f¸r Signalvergleich Ladedruck mit Umgebungsdruck" VALUE 0xFCE1AE KwUb 10200. nmot_ub_q40 0.00 10200. FORMAT "%5.0" /end CHARACTERISTIC
/begin CHARACTERISTIC NGDHZONMN "Minimaldrehzahl f¸r Drosselung wg. Heizleistung" VALUE 0xFC3E92 KwWU16 16383.75 nmot_uw_q0p25 0.00 16383.75 FORMAT "%8.2" /end CHARACTERISTIC
/begin CHARACTERISTIC NMOTGD "Untere Grenze nmot f¸r R¸cksetzen gedrosselter Warmlauf" VALUE 0xFC3E94 KwWU16 16383.75 nmot_uw_q0p25 0.00 16383.75 FORMAT "%8.2" /end CHARACTERISTIC
/begin CHARACTERISTIC NTDMAO "" VALUE 0xFC3EB7 KwUb 2550. nmot_ub_q10 0.00 2550. FORMAT "%5.0" /end CHARACTERISTIC
/begin CHARACTERISTIC NVGDSLL "Drehzahlschwelle  f¸r Drucksensorvergleich DSU/DSL im Leerlauf" VALUE 0xFCE1AF KwUb 10200. nmot_ub_q40 0.00 10200. FORMAT "%5.0" /end CHARACTERISTIC
/begin CHARACTERISTIC NWDK3 "Minimaldrehzahl f¸r Berechnung DK-Winkel-Ersatzwert aus F¸llungssignal" VALUE 0xFC1E54 KwUb 10000. nmot_ub_q40 200.0 10200. FORMAT "%5.0" /end CHARACTERISTIC
/begin CHARACTERISTIC NWPMBBR "Mindestdrehzahl f¸r Pedalwertbegrenzung bei bet‰tigter Bremse" VALUE 0xFC632A KwUb 10200. nmot_ub_q40 0.00 10200. FORMAT "%5.0" /end CHARACTERISTIC
/begin CHARACTERISTIC PBKVVLVF "" VALUE 0xFCDF82 KwUw 2559.961 p_uw_q0p039 0.00 2559.961 FORMAT "%8.3" /end CHARACTERISTIC
/begin CHARACTERISTIC PBKVVSTGPV "Unterdruckverst‰rkung durch Saugstrahleffekt" CURVE 0xFCDF84 KlAUwSstUwWUw 2559.961 p_uw_q0p039 0.00 2559.961 FORMAT "%8.3"
 /begin AXIS_DESCR STD_AXIS dpspvdkd_w p_uw_q0p039 6 0.00 2559.961 FORMAT "%8.3" DEPOSIT ABSOLUTE /end AXIS_DESCR
/end CHARACTERISTIC
/begin CHARACTERISTIC PLMRN "P-Anteil von Luftmassenregler" CURVE 0xFCD604 GklWUb 7.969 fak_ub_b8 0.00 7.969 FORMAT "%5.3"
 /begin AXIS_DESCR COM_AXIS nmot nmot_ub_q40 8 0.00 10200. FORMAT "%5.0" AXIS_PTS_REF SNM08FEUB /end AXIS_DESCR
/end CHARACTERISTIC
/begin CHARACTERISTIC PUE "Ersatzwert f¸r Umgebungsdruck" VALUE 0xFCE1EE KwUw 2559.961 p_uw_q0p039 0.00 2559.961 FORMAT "%8.3" /end CHARACTERISTIC
/begin CHARACTERISTIC PUEBKV "Ersatzwert f¸r Umgebungsdruck f¸r BKV" VALUE 0xFCDF9E KwUw 1279.961 p_uw_q0p039 0.00 1279.961 FORMAT "%8.3" /end CHARACTERISTIC
/begin CHARACTERISTIC PUKANS "Pulsationskorrektur abh‰ngig von Ansauglufttemperatur" CURVE 0xFC5F10 KlAUbSstUbWUb 1.992 fak_ub_b2 0.00 1.992 FORMAT "%5.3"
 /begin AXIS_DESCR STD_AXIS tans temp_ub_q0p75_o48 8 -48.00 143.3 FORMAT "%5.1" DEPOSIT ABSOLUTE /end AXIS_DESCR
/end CHARACTERISTIC
/begin CHARACTERISTIC PUMN "Umgebungsdruckbegrenzung minimal" VALUE 0xFCE1F0 KwUw 2559.961 p_uw_q0p039 0.00 2559.961 FORMAT "%8.3" /end CHARACTERISTIC
/begin CHARACTERISTIC PUMX "Umgebungsdruckbegrenzung maximal" VALUE 0xFCE1F2 KwUw 2559.961 p_uw_q0p039 0.00 2559.961 FORMAT "%8.3" /end CHARACTERISTIC
/begin CHARACTERISTIC PUSPSMX "max. Abweichung von Umgebungsdruck und Saugrohrdruck" VALUE 0xFCE1F4 KwUw 2559.961 p_uw_q0p039 0.00 2559.961 FORMAT "%8.3" /end CHARACTERISTIC
/begin CHARACTERISTIC PVDKPUD "Schwelle unterhalb welcher die Diff. zw. pvdkds und pu als 0 ausgegeben wird" VALUE 0xFCE1B0 KwUb 2550. p_ub_q10 0.00 2550. FORMAT "%5.0" /end CHARACTERISTIC
/begin CHARACTERISTIC RBEL "Belastungswiderstand f¸r Pumpstrom-Erzeugung" VALUE 0xFC63E8 KwUw 131070.0 r_uw_q2 0.00 131070.0 FORMAT "%8.1" /end CHARACTERISTIC
/begin CHARACTERISTIC RINHMX "Innenwiderstand Ri der Nernstsonde hinter KAT auf Maximalwert begrenzen" VALUE 0xFC63EA KwUw 131070.0 r_uw_q2 0.00 131070.0 FORMAT "%8.1" /end CHARACTERISTIC
/begin CHARACTERISTIC RINVMX "Innenwiderstand Ri der Nernstsonde vor KAT auf Maximalwert begrenzen" VALUE 0xFC63D0 KwUw 131070.0 r_uw_q2 0.00 131070.0 FORMAT "%8.1" /end CHARACTERISTIC
/begin CHARACTERISTIC RKSP "Widerstand zwischen kongurierende Spannung und Sondensignal" VALUE 0xFC63EC KwUw 131070.0 r_uw_q2 0.00 131070.0 FORMAT "%8.1" /end CHARACTERISTIC
/begin CHARACTERISTIC RLGD "Untere Grenze rl f¸r R¸cksetzen gedrosselter Warmlauf" VALUE 0xFC3E96 KwWU16 1535.977 rel_uw_q0p0234 0.00 1535.977 FORMAT "%8.3" /end CHARACTERISTIC
/begin CHARACTERISTIC RLGDHZONMN "Untere Grenze rl f¸r Drosselung wg. Heizleistung" VALUE 0xFC3E98 KwWU16 1535.977 rel_uw_q0p0234 0.00 1535.977 FORMAT "%8.3" /end CHARACTERISTIC
/begin CHARACTERISTIC SENZZYL "Klopfsensoren f¸r SW-Zylinderz‰hler 0-7" VAL_BLK 0xFCE2FC KwbUb 3.000 dezsub1 1.000 4.000 FORMAT "%5.3" NUMBER 8 /end CHARACTERISTIC
/begin AXIS_PTS SNM08FEUB "St¸tzstellenverteilung Drehzahl, 08 Sst., F¸llungseingriffe" 0xFC0FC4 nmot SstAUbSstUb 10200. nmot_ub_q40 8 0.00 10200. FORMAT "%5.0" DEPOSIT ABSOLUTE /end AXIS_PTS
/begin AXIS_PTS SNM08GKUB "St¸tzstellenverteilung Gemischkontrolle 8 nmot St¸tzstellen" 0xFC0F40 nmot SstAU8SstU8 10200. nmot_ub_q40 8 0.00 10200. FORMAT "%5.0" DEPOSIT ABSOLUTE /end AXIS_PTS
/begin AXIS_PTS SNM12ESUB "SST-Verteilung f¸r die Motordrehzahl nmot" 0xFC0FF4 nmot SstAUbSstUb 10200. nmot_ub_q40 12 0.00 10200. FORMAT "%5.0" DEPOSIT ABSOLUTE /end AXIS_PTS
/begin AXIS_PTS SRL08GKUB "St¸tzstellenverteilung Gemischkontrolle 8 rl St¸tzstellen" 0xFC0F4C rl SstAU8SstU8 191.3 rel_ub_q0p75 8 0.00 191.3 FORMAT "%5.1" DEPOSIT ABSOLUTE /end AXIS_PTS
/begin AXIS_PTS SRL12ESUB "Sst-Verteilung f¸r die relative F¸llung rl" 0xFC10BC rl SstAUbSstUb 191.3 rel_ub_q0p75 12 0.00 191.3 FORMAT "%5.1" DEPOSIT ABSOLUTE /end AXIS_PTS
/begin AXIS_PTS STM12ESUB "SST-Verteilung f¸r die Motortemperatur tmot" 0xFCC8CC tmot SstAUbSstUb 191.3 temp_ub_q0p75_o48 12 -48.00 143.3 FORMAT "%5.1" DEPOSIT ABSOLUTE /end AXIS_PTS
/begin AXIS_PTS STS12ESUB "SST-Verteilung f¸r Motorstarttemperatur" 0xFC1108 tmst SstAUbSstUb 191.3 temp_ub_q0p75_o48 12 -48.00 143.3 FORMAT "%5.1" DEPOSIT ABSOLUTE /end AXIS_PTS
/begin CHARACTERISTIC S_DPSRLVW "" VALUE 0xFC3EA7 KwWU8 1.000 dez 0.00 1.000 FORMAT "%5.3" /end CHARACTERISTIC
/begin CHARACTERISTIC S_DPSTDO "" VALUE 0xFC3EA8 KwWU8 1.000 dez 0.00 1.000 FORMAT "%5.3" /end CHARACTERISTIC
/begin CHARACTERISTIC S_FPUPS "" VALUE 0xFC3EA9 KwWU8 1.000 dez 0.00 1.000 FORMAT "%5.3" /end CHARACTERISTIC
/begin CHARACTERISTIC S_FPUPSSOL "Dichteberechnung fuer Hub ueber Solldruck ein" VALUE 0xFC3EAA KwWU8 1.000 dez 0.00 1.000 FORMAT "%5.3" /end CHARACTERISTIC
/begin CHARACTERISTIC S_GD "Schalter Gedrosselt manuell" VALUE 0xFC3EAB KwWU8 1.000 dez 0.00 1.000 FORMAT "%5.3" /end CHARACTERISTIC
/begin CHARACTERISTIC S_GDNMOT "" VALUE 0xFC3EAC KwWU8 1.000 dez 0.00 1.000 FORMAT "%5.3" /end CHARACTERISTIC
/begin CHARACTERISTIC S_GDVHUB "Schalter Gedrosselt mit Vollhub manuell" VALUE 0xFC3EAD KwWU8 1.000 dez 0.00 1.000 FORMAT "%5.3" /end CHARACTERISTIC
/begin CHARACTERISTIC S_HEIZL "Anforderung Heizleistungseingriff" VALUE 0xFC3EB8 KwUb 1.000 dez 0.00 1.000 FORMAT "%5.3" /end CHARACTERISTIC
/begin CHARACTERISTIC S_LLGD "Schalter Gedrosselt nur im Leerlauf" VALUE 0xFC3EAE KwWU8 1.000 dez 0.00 1.000 FORMAT "%5.3" /end CHARACTERISTIC
/begin CHARACTERISTIC S_LLTD "" VALUE 0xFC3EAF KwWU8 1.000 dez 0.00 1.000 FORMAT "%5.3" /end CHARACTERISTIC
/begin CHARACTERISTIC TABMIN "Minimale Abstellzeit" VALUE 0xFC3E9A KwWU16 65535.00 t1sxs_uw_q1 0.00 65535.00 FORMAT "%8.2" /end CHARACTERISTIC
/begin CHARACTERISTIC TBKVP "Evakuierzeit der BKV-Pumpe" VALUE 0xFCDF5A KwUb 12.7498 zk50msxs_ub_b12p8 0.0501961 12.8000 FORMAT "%7.4" /end CHARACTERISTIC
/begin CHARACTERISTIC TCEKP "‹berwachung CAN time out f¸r EKP-Abschaltung" VALUE 0xFC5640 KwUb 2.550 t10msxs_ub_b2p55 0.00 2.550 FORMAT "%5.3" /end CHARACTERISTIC
/begin CHARACTERISTIC TDDFU "Entprellzeit f¸r Fehlereintrag Druckksensor Umgebung" VALUE 0xFCE1B1 KwUb 25.50 t100msxs_ub_b25p5 0.00 25.50 FORMAT "%5.2" /end CHARACTERISTIC
/begin CHARACTERISTIC TDDFUUGD "Entprellzeit f¸r Fehlereintrag Druckksensor Umgebung" VALUE 0xFCE1B2 KwUb 25.50 t100msxs_ub_b25p5 0.00 25.50 FORMAT "%5.2" /end CHARACTERISTIC
/begin CHARACTERISTIC TDKPAW "Zeit f¸r DK-Poti-Auswahl" VALUE 0xFC1E55 KwUb 2.540 t10msxs_ub_b2p55 0.01000 2.550 FORMAT "%5.3" /end CHARACTERISTIC
/begin CHARACTERISTIC TDMFL "Verzˆgerungszeit MFL-Fehler" VALUE 0xFC63FD KwWU8 2.450 t10msxs_ub_b2p55 0.1000 2.550 FORMAT "%5.3" /end CHARACTERISTIC
/begin CHARACTERISTIC TDMFLH "Verzˆgerungszeit MFL-Fehler-Heilung" VALUE 0xFC63FE KwWU8 2.450 t10msxs_ub_b2p55 0.1000 2.550 FORMAT "%5.3" /end CHARACTERISTIC
/begin CHARACTERISTIC TDVGDSLL "Verzˆgerungszeit f¸r Drucksensorvergleich DSU/DSL im Leerlauf" VALUE 0xFCE1B3 KwUb 25.50 t100msxs_ub_b25p5 0.00 25.50 FORMAT "%5.2" /end CHARACTERISTIC
/begin CHARACTERISTIC TEBBREMS "Entprellzeit von B_brems" VALUE 0xFCDF5B KwUb 0.5000 t50msxs_q0p05 0.00 0.5000 /end CHARACTERISTIC
/begin CHARACTERISTIC TFGRARLG "Rampenlaufzeit bei langsamer FGR-Abschaltung" CURVE 0xFCCD4C KlAUbSstUbWUb 5.100 t20msxs_ub_b5p1 0.00 5.100 FORMAT "%5.3"
 /begin AXIS_DESCR STD_AXIS gangi dez 8 0.00 255.0 FORMAT "%5.1" DEPOSIT ABSOLUTE /end AXIS_DESCR
/end CHARACTERISTIC
/begin CHARACTERISTIC TFGRBTOFF "Zeit Null-Taste bet‰tigt (FGR. Mainswitchnachbildung ausschalten)" VALUE 0xFC63FF KwWU8 5.080 t20msxs_ub_b5p1 0.02000 5.100 FORMAT "%5.3" /end CHARACTERISTIC
/begin CHARACTERISTIC TFGRBTON "Zeit Null-Taste bet‰tigt (FGR. Mainswitchnachbildung einschalten)" VALUE 0xFC6400 KwWU8 5.080 t20msxs_ub_b5p1 0.02000 5.100 FORMAT "%5.3" /end CHARACTERISTIC
/begin CHARACTERISTIC TFGRBTUBT "Zeit Null-Taste min. nicht bet‰tigt" VALUE 0xFC6401 KwWU8 5.080 t20msxs_ub_b5p1 0.02000 5.100 FORMAT "%5.3" /end CHARACTERISTIC
/begin CHARACTERISTIC TFGRMNLE "Min. Zeit f¸r FGR-Lampe an (im Fehlerfall)" VALUE 0xFC6402 KwWU8 5.080 t20msxs_ub_b5p1 0.02000 5.100 FORMAT "%5.3" /end CHARACTERISTIC
/begin CHARACTERISTIC TFGRTP "Zeit f¸r Tip-Erkennung bei FGR-Bedientasten" VALUE 0xFC2070 KwUb 5.080 t20msxs_ub_b5p1 0.02000 5.100 FORMAT "%5.3" /end CHARACTERISTIC
/begin CHARACTERISTIC TFPWG2 "Filterzeit zur Filterung von Poti 2 bei der Bewegungserkennung" VALUE 0xFC634E KwUw 655.34999985 zk10msxs_uw_b655 0.010000152590 655.36000000 FORMAT "%12.8" /end CHARACTERISTIC
/begin CHARACTERISTIC TFWDKPN "Zeitkonstante f¸r Filterung der DK-Winkel vor Vergl. mit Ersatzwert aus F¸llung" CURVE 0xFC1E58 KlAUbSstUbWUb 2.54000 zk10msxs_ub_b2p55 0.0100000 2.55000 FORMAT "%7.5"
 /begin AXIS_DESCR STD_AXIS nmot nmot_ub_q40 6 0.00 10200. FORMAT "%5.0" DEPOSIT ABSOLUTE /end AXIS_DESCR
/end CHARACTERISTIC
/begin CHARACTERISTIC TFWDKSOM "Zeitkonstante f¸r Drosselklappensollwinkelfilterung bei Kl15 aus" VALUE 0xFC47A2 KwWU16 655.34999985 zk10msxs_uw_b655 0.010000152590 655.36000000 FORMAT "%12.8" /end CHARACTERISTIC
/begin CHARACTERISTIC TGDHZNST "Zeit nach Startende, in der keine Drosselung wg. Heizleistung" VALUE 0xFC3EB0 KwWU8 25.50 t100msxs_ub_b25p5 0.00 25.50 FORMAT "%5.2" /end CHARACTERISTIC
/begin CHARACTERISTIC TGGLS "Zeitdauer f¸r ADC nach Interrupt im Funktionsrechner (Asic)" VALUE 0xFC63E2 KwUb 2.000 t1msxms_q1 3.000 5.000 FORMAT "%5.3" /end CHARACTERISTIC
/begin CHARACTERISTIC THOPP1 "Fehlerzeit bei Hochohmigkeitspr¸fung Poti 1" VALUE 0xFC632B KwUb 2.550 t10msxs_ub_b2p55 0.00 2.550 FORMAT "%5.3" /end CHARACTERISTIC
/begin CHARACTERISTIC THOPP2 "Fehlerzeit bei Hochohmigkeitspr¸fung Poti 2" VALUE 0xFC632C KwUb 2.550 t10msxs_ub_b2p55 0.00 2.550 FORMAT "%5.3" /end CHARACTERISTIC
/begin CHARACTERISTIC THSRIH "Zeitverzˆg. Bereitschaft der Ri-Messung nach eingesch. Sondenheizung hinter KAT" VALUE 0xFC63EE KwUw 655.3500 t10msxs_uw_b655p35 0.00 655.3500 FORMAT "%8.4" /end CHARACTERISTIC
/begin CHARACTERISTIC THSRIV "Zeitverzˆgerte Bereitschaft der Ri-Messung nach eingesch. Sondenheizung vor KAT" VALUE 0xFC63D2 KwUw 655.3500 t10msxs_uw_b655p35 0.00 655.3500 FORMAT "%8.4" /end CHARACTERISTIC
/begin CHARACTERISTIC TMABMIN "Minimale Abstelltemperatur" VALUE 0xFC3EB1 KwWU8 191.3 temp_ub_q0p75_o48 -48.00 143.3 FORMAT "%5.1" /end CHARACTERISTIC
/begin CHARACTERISTIC TMBVH "Verzˆgerungszeit f¸r Aktivierung Miﬂbrauchsverhinderung" VALUE 0xFC6350 KwUw 655.3500 t10msxs_uw_b655p35 0.00 655.3500 FORMAT "%8.4" /end CHARACTERISTIC
/begin CHARACTERISTIC TMFLBE "Fehlerentprellung keine neue MFL-Botschaft empfangen" VALUE 0xFC6403 KwWU8 2.540 t10msxs_ub_b2p55 0.01000 2.550 FORMAT "%5.3" /end CHARACTERISTIC
/begin CHARACTERISTIC TMFLFQE "Fehlerentprellung: Telegrammfrequenz ausserhalb des Toleranzbandes" VALUE 0xFC6404 KwWU8 2.540 t10msxs_ub_b2p55 0.01000 2.550 FORMAT "%5.3" /end CHARACTERISTIC
/begin CHARACTERISTIC TMFLTC "Fehlerentprellung: Toggelbit-Check" VALUE 0xFC6405 KwWU8 2.540 t10msxs_ub_b2p55 0.01000 2.550 FORMAT "%5.3" /end CHARACTERISTIC
/begin CHARACTERISTIC TMGDHZONMN "Minimale Motortemp. f¸r Drosselung wg. Heizleistung" VALUE 0xFC3EB2 KwWU8 191.3 temp_ub_q0p75_o48 -48.00 143.3 FORMAT "%5.1" /end CHARACTERISTIC
/begin CHARACTERISTIC TMNGDVH "" VALUE 0xFC3E9C KwWU16 6553.500 t100msxs_uw_b6553p5 0.00 6553.500 FORMAT "%8.3" /end CHARACTERISTIC
/begin CHARACTERISTIC TN2FGRGA "Doppelte Nennerzeitkonstante f¸r FGR-Regler" CURVE 0xFCCE4C KlAUwSstUwWUw 1310.700 t20msxs_uw_q0p02 0.00 1310.700 FORMAT "%8.3"
 /begin AXIS_DESCR STD_AXIS gangi dez 8 0.00 255.0 FORMAT "%5.1" DEPOSIT ABSOLUTE /end AXIS_DESCR
/end CHARACTERISTIC
/begin CHARACTERISTIC TPNSE1 "Pr¸fzeit nach Startende f¸r PWG-Diagnose" VALUE 0xFCDFA2 KwUb 12.70 t50msxs_ub_b12p75 0.05000 12.75 FORMAT "%5.2" /end CHARACTERISTIC
/begin CHARACTERISTIC TRIAKTH "Zeitdauer f¸r Ri-Berechnung aktuell hinter KAT" VALUE 0xFC63F0 KwUw 6553.500 t100msxs_uw_b6553p5 0.00 6553.500 FORMAT "%8.3" /end CHARACTERISTIC
/begin CHARACTERISTIC TRIAKTV "Zeitdauer f¸r Ri-Berechnung aktuell vor KAT" VALUE 0xFC63D4 KwUw 6553.500 t100msxs_uw_b6553p5 0.00 6553.500 FORMAT "%8.3" /end CHARACTERISTIC
/begin CHARACTERISTIC TRIIMPH "Zeitdauer f¸r Pumpimpuls f¸r beide B‰nke hinter KAT" VALUE 0xFC63F2 KwUw 655.3500 t10msxs_uw_b655p35 0.00 655.3500 FORMAT "%8.4" /end CHARACTERISTIC
/begin CHARACTERISTIC TRIIMPV "Zeitdauer f¸r Pumpimpuls f¸r beide B‰nke vor KAT" VALUE 0xFC63D6 KwUw 655.3500 t10msxs_uw_b655p35 0.00 655.3500 FORMAT "%8.4" /end CHARACTERISTIC
/begin CHARACTERISTIC TSCHWGD "" VALUE 0xFC3EB3 KwWU8 25.50 t100msxs_ub_b25p5 0.00 25.50 FORMAT "%5.2" /end CHARACTERISTIC
/begin CHARACTERISTIC TSTAEBR "Zeit f¸r Steckerabfall-Erkennung Bremse" VALUE 0xFCDF26 KwUw 6553.500 t100msxs_uw_b6553p5 0.00 6553.500 FORMAT "%8.3" /end CHARACTERISTIC
/begin CHARACTERISTIC TSWKNBGA "Zeit bis Setzwertkorrektur nach Ende Beschleunigen" CURVE 0xFCCE6E KlAUwSstUwWUw 1310.700 t20msxs_uw_q0p02 0.00 1310.700 FORMAT "%8.3"
 /begin AXIS_DESCR STD_AXIS gangi dez 8 0.00 255.0 FORMAT "%5.1" DEPOSIT ABSOLUTE /end AXIS_DESCR
/end CHARACTERISTIC
/begin CHARACTERISTIC TSWKNVGA "Zeit bis Setzwertkorrektur nach Ende Verzˆgern" CURVE 0xFCCE90 KlAUwSstUwWUw 1310.700 t20msxs_uw_q0p02 0.00 1310.700 FORMAT "%8.3"
 /begin AXIS_DESCR STD_AXIS gangi dez 8 0.00 255.0 FORMAT "%5.1" DEPOSIT ABSOLUTE /end AXIS_DESCR
/end CHARACTERISTIC
/begin CHARACTERISTIC TUPWBWF "Fehlerzeit bei Bewegungserkennung" VALUE 0xFC632D KwUb 2.550 t10msxs_ub_b2p55 0.00 2.550 FORMAT "%5.3" /end CHARACTERISTIC
/begin CHARACTERISTIC TUPWBWV "Zeitverzˆgerung zum Einspeichern eines neuen Poti 2 Wertes" VALUE 0xFC632E KwUb 2.550 t10msxs_ub_b2p55 0.00 2.550 FORMAT "%5.3" /end CHARACTERISTIC
/begin CHARACTERISTIC TUPWG12 "Fehlerzeit bei Vergleich von PWG-Poti 1 und 2" VALUE 0xFC632F KwUb 2.550 t10msxs_ub_b2p55 0.00 2.550 FORMAT "%5.3" /end CHARACTERISTIC
/begin CHARACTERISTIC TUPWG1O "Fehlerzeit bei Bereichsverletzung von PWG-Poti 1 nach oben" VALUE 0xFC6330 KwUb 2.550 t10msxs_ub_b2p55 0.00 2.550 FORMAT "%5.3" /end CHARACTERISTIC
/begin CHARACTERISTIC TUPWG1U "Fehlerzeit bei Bereichsverletzung von PWG-Poti 1 nach unten" VALUE 0xFC6331 KwUb 2.550 t10msxs_ub_b2p55 0.00 2.550 FORMAT "%5.3" /end CHARACTERISTIC
/begin CHARACTERISTIC TUPWG2O "Fehlerzeit bei Bereichsverletzung von PWG-Poti 2 nach oben" VALUE 0xFC6332 KwUb 2.550 t10msxs_ub_b2p55 0.00 2.550 FORMAT "%5.3" /end CHARACTERISTIC
/begin CHARACTERISTIC TUPWG2U "Fehlerzeit bei Bereichsverletzung von PWG-Poti 2 nach unten" VALUE 0xFC6333 KwUb 2.550 t10msxs_ub_b2p55 0.00 2.550 FORMAT "%5.3" /end CHARACTERISTIC
/begin CHARACTERISTIC TUSBELH "Zeit f¸r Festhaltung der Sondenspannung nach Impulsbelastung  hinter KAT" VALUE 0xFC63E3 KwUb 2.550 t10msxs_ub_b2p55 0.00 2.550 FORMAT "%5.3" /end CHARACTERISTIC
/begin CHARACTERISTIC TUSBELV "Zeit f¸r Festhaltung der Sondenspannung nach Impulsbelastung  vor KAT" VALUE 0xFC63CB KwUb 2.550 t10msxs_ub_b2p55 0.00 2.550 FORMAT "%5.3" /end CHARACTERISTIC
/begin CHARACTERISTIC TVDPSRLVW "" VALUE 0xFC3E9E KwWU16 655.3500 t10msxs_uw_b655p35 0.00 655.3500 FORMAT "%8.4" /end CHARACTERISTIC
/begin CHARACTERISTIC TVERBR "Verzˆgerungszeit f¸r Bremsschalter-Plausibilit‰tspr¸fung" VALUE 0xFCDF23 KwUb 25.50 t100msxs_ub_b25p5 0.00 25.50 FORMAT "%5.2" /end CHARACTERISTIC
/begin CHARACTERISTIC TVHALT "Verzoegerungszeit nach Fahrzeughalt" VALUE 0xFCDF40 KwUw 6553.500 t100msxs_uw_b6553p5 0.00 6553.500 FORMAT "%8.3" /end CHARACTERISTIC
/begin CHARACTERISTIC TVHEIZLGOF "" VALUE 0xFC3EB4 KwWU8 25.50 t100msxs_ub_b25p5 0.00 25.50 FORMAT "%5.2" /end CHARACTERISTIC
/begin CHARACTERISTIC TVHEIZLGON "" VALUE 0xFC3EB5 KwWU8 25.50 t100msxs_ub_b25p5 0.00 25.50 FORMAT "%5.2" /end CHARACTERISTIC
/begin CHARACTERISTIC TVKL15 "Verzoegerungszeit Klemme 15" VALUE 0xFCDF42 KwUw 6553.500 t100msxs_uw_b6553p5 0.00 6553.500 FORMAT "%8.3" /end CHARACTERISTIC
/begin CHARACTERISTIC TVKUP "Verzˆgerungszeit f¸r B_kupplv" VALUE 0xFC5641 KwUb 5.100 t20msxs_ub_b5p1 0.00 5.100 FORMAT "%5.3" /end CHARACTERISTIC
/begin CHARACTERISTIC TVLADV "Zeitkonstante f¸r Integrator bei vlast-Berechnung" CURVE 0xFC218E KlAUwSstSwWUw 1309.9800107 zk20msxs_uw_b1310 0.019989318685 1310.0000000 FORMAT "%12.7"
 /begin AXIS_DESCR STD_AXIS dvzvi_w vfzg_sw_q0p00781 8 -256.0000 255.9922 FORMAT "%8.4" DEPOSIT ABSOLUTE /end AXIS_DESCR
/end CHARACTERISTIC
/begin CHARACTERISTIC TVPDKP1 "Fehlertoleranzzeit bei Bereichspr¸fung DK-Poti 1" VALUE 0xFC1E65 KwUb 2.540 t10msxs_ub_b2p55 0.01000 2.550 FORMAT "%5.3" /end CHARACTERISTIC
/begin CHARACTERISTIC TVPDKP2 "Fehlertoleranzzeit bei Bereichspr¸fung DK-Poti 2" VALUE 0xFC1E66 KwUb 2.540 t10msxs_ub_b2p55 0.01000 2.550 FORMAT "%5.3" /end CHARACTERISTIC
/begin CHARACTERISTIC TVPWDK12 "Fehlertoleranzzeit bei Gleichlaufpr¸fung der DK-Potis" VALUE 0xFC1E67 KwUb 2.540 t10msxs_ub_b2p55 0.01000 2.550 FORMAT "%5.3" /end CHARACTERISTIC
/begin CHARACTERISTIC TVPWDK13 "Fehlertoleranzzeit bei Gleichlaufpr¸fung DK-Poti 1 und Ersatzwert aus F¸llung" VALUE 0xFC1E68 KwUb 2.540 t10msxs_ub_b2p55 0.01000 2.550 FORMAT "%5.3" /end CHARACTERISTIC
/begin CHARACTERISTIC TVPWDK23 "Fehlertoleranzzeit bei Gleichlaufpr¸fung DK-Poti 2 und Ersatzwert aus F¸llung" VALUE 0xFC1E69 KwUb 2.540 t10msxs_ub_b2p55 0.01000 2.550 FORMAT "%5.3" /end CHARACTERISTIC
/begin CHARACTERISTIC TVTDDPSADP "" VALUE 0xFC3F80 KwUw 655.3500 fak_uw_q0p01 0.00 655.3500 FORMAT "%8.4" /end CHARACTERISTIC
/begin CHARACTERISTIC TVWDKS "Verzˆgerungszeit f¸r Drosselklappen-Sollwinkel" VALUE 0xFC47A8 KwWU8 7.000 dez 0.00 7.000 FORMAT "%5.3" /end CHARACTERISTIC
/begin CHARACTERISTIC TWDKNV "Zeitkonstante f¸r Drosselklappensollwinkelfilterung" CURVE 0xFC4704 KlAxU8SstxU16WU16 655.34999985 zk10msxs_uw_b655 0.010000152590 655.36000000 FORMAT "%12.8"
 /begin AXIS_DESCR STD_AXIS nmot_w nmot_uw_q0p25 8 0.00 16383.75 FORMAT "%8.2" DEPOSIT ABSOLUTE /end AXIS_DESCR
/end CHARACTERISTIC
/begin CHARACTERISTIC TWDKSV "Zeitkonstante f¸r Drosselklappensollwinkelfilterung" CURVE 0xFC4726 KlAxU8SstxU16WU16 655.34999985 zk10msxs_uw_b655 0.010000152590 655.36000000 FORMAT "%12.8"
 /begin AXIS_DESCR STD_AXIS dpsvbgms_w fak_uw_b2 8 0.00 1.999969 FORMAT "%8.6" DEPOSIT ABSOLUTE /end AXIS_DESCR
/end CHARACTERISTIC
/begin CHARACTERISTIC TWDKSVST "" VALUE 0xFC47A4 KwWU16 655.34999985 zk10msxs_uw_b655 0.010000152590 655.36000000 FORMAT "%12.8" /end CHARACTERISTIC
/begin CHARACTERISTIC TWPMBBR "Verzˆgerungszeit f¸r Pedalwertbegrenzung bei bet‰tigter Bremse" VALUE 0xFC6334 KwUb 2.550 t10msxs_ub_b2p55 0.00 2.550 FORMAT "%5.3" /end CHARACTERISTIC
/begin CHARACTERISTIC TZ2FGRGA "Doppelte Z‰hlerzeitkonstante f¸r FGR-Regler" CURVE 0xFCCEB2 KlAUwSstUwWUw 1310.700 t20msxs_uw_q0p02 0.00 1310.700 FORMAT "%8.3"
 /begin AXIS_DESCR STD_AXIS gangi dez 8 0.00 255.0 FORMAT "%5.1" DEPOSIT ABSOLUTE /end AXIS_DESCR
/end CHARACTERISTIC
/begin CHARACTERISTIC UADPUMN "min. Spannungswert f¸r Diagnose Drucksensor" VALUE 0xFCE1B4 KwUb 4.845 spg_ub_q0p019 0.00 4.845 FORMAT "%5.3" /end CHARACTERISTIC
/begin CHARACTERISTIC UADPUMX "max. Spannungswert f¸r Diagnose Drucksensor" VALUE 0xFCE1B5 KwUb 4.845 spg_ub_q0p019 0.00 4.845 FORMAT "%5.3" /end CHARACTERISTIC
/begin CHARACTERISTIC UBMFLMN "min. UB-Schwelle f¸r Erkennung defektes MFL" VALUE 0xFC6406 KwWU8 24.02 spg_ubatt 0.00 24.02 FORMAT "%5.2" /end CHARACTERISTIC
/begin CHARACTERISTIC UBVDKPO "Batteriespannungsschwelle f¸r Umschaltung auf verst‰rktes Signal von DK-Poti 1" VALUE 0xFC1E6A KwUb 24.02 spg_ubatt 0.00 24.02 FORMAT "%5.2" /end CHARACTERISTIC
/begin CHARACTERISTIC UBVDKPU "Batteriespannungsschwelle f¸r Umschaltung auf unverst‰rktes Signal von DK-Poti 1" VALUE 0xFC1E6B KwUb 24.02 spg_ubatt 0.00 24.02 FORMAT "%5.2" /end CHARACTERISTIC
/begin CHARACTERISTIC UDKP1O "Maximale zul‰ssige Spannung von DK-Poti 1" VALUE 0xFC1E6C KwUb 4.980 spg_ub_b5 0.00 4.980 FORMAT "%5.3" /end CHARACTERISTIC
/begin CHARACTERISTIC UDKP1U "Minimale zul‰ssige Spannung von DK-Poti 1" VALUE 0xFC1E6D KwUb 4.980 spg_ub_b5 0.00 4.980 FORMAT "%5.3" /end CHARACTERISTIC
/begin CHARACTERISTIC UDKP2O "Maximale zul‰ssige Spannung von DK-Poti 2" VALUE 0xFC1E6E KwUb 4.980 spg_ub_b5 0.00 4.980 FORMAT "%5.3" /end CHARACTERISTIC
/begin CHARACTERISTIC UDKP2U "Minimale zul‰ssige Spannung von DK-Poti 2" VALUE 0xFC1E6F KwUb 4.980 spg_ub_b5 0.00 4.980 FORMAT "%5.3" /end CHARACTERISTIC
/begin CHARACTERISTIC UPW1BE "Spannung PWG-Poti 1 f¸r Durchf¸hrung der Bewegungserkennung" VALUE 0xFC6335 KwUb 4.980 spg_ub_b5 0.00 4.980 FORMAT "%5.3" /end CHARACTERISTIC
/begin CHARACTERISTIC UPW1LLMX "Maximale Spannung von Poti 1 im Leergaspunkt" VALUE 0xFC6336 KwUb 4.980 spg_ub_b5 0.00 4.980 FORMAT "%5.3" /end CHARACTERISTIC
/begin CHARACTERISTIC UPWG12U "Untere Begrenzung PWG-Poti-Spannung vor Vergleich Poti 1 und 2" VALUE 0xFC6337 KwUb 4.980 spg_ub_b5 0.00 4.980 FORMAT "%5.3" /end CHARACTERISTIC
/begin CHARACTERISTIC UPWG1O "Obere Schranke f¸r PWG-Poti-1-Spannung" VALUE 0xFC6338 KwUb 4.980 spg_ub_b5 0.00 4.980 FORMAT "%5.3" /end CHARACTERISTIC
/begin CHARACTERISTIC UPWG1U "Untere Schranke f¸r PWG-Poti-1-Spannung" VALUE 0xFC6339 KwUb 4.980 spg_ub_b5 0.00 4.980 FORMAT "%5.3" /end CHARACTERISTIC
/begin CHARACTERISTIC UPWG2O "Obere Schranke f¸r PWG-Poti-2-Spannung" VALUE 0xFC633A KwUb 4.980 spg_ub_b5 0.00 4.980 FORMAT "%5.3" /end CHARACTERISTIC
/begin CHARACTERISTIC UPWG2U "Untere Schranke f¸r PWG-Poti-2-Spannung" VALUE 0xFC633B KwUb 4.980 spg_ub_b5 0.00 4.980 FORMAT "%5.3" /end CHARACTERISTIC
/begin CHARACTERISTIC UPWGO "Oberer PWG-Spannungswert f¸r Umnormierung auf Pedalwert" VALUE 0xFC633C KwUb 4.980 spg_ub_b5 0.00 4.980 FORMAT "%5.3" /end CHARACTERISTIC
/begin CHARACTERISTIC UPWGTG "PWG-Spannungsschwelle f¸r Teilgasbereich" VALUE 0xFC633D KwUb 4.980 spg_ub_b5 0.00 4.980 FORMAT "%5.3" /end CHARACTERISTIC
/begin CHARACTERISTIC UPWGTL "Teillastschwelle der PWG-Spannung in Hochohmigkeitspr¸fung" VALUE 0xFC633E KwUb 4.980 spg_ub_b5 0.00 4.980 FORMAT "%5.3" /end CHARACTERISTIC
/begin CHARACTERISTIC UPWGU "Unterer PWG-Spannungswert f¸r Umnormierung auf Pedalwert" VALUE 0xFC633F KwUb 4.980 spg_ub_b5 0.00 4.980 FORMAT "%5.3" /end CHARACTERISTIC
/begin CHARACTERISTIC UPWGUBF "Unterer Spannungswert zur Umnormierung bei erkanntem Bewegungsfehler" VALUE 0xFC6340 KwUb 4.980 spg_ub_b5 0.00 4.980 FORMAT "%5.3" /end CHARACTERISTIC
/begin CHARACTERISTIC UPWGUR "Reduzierter unterer PWG-Spannungswert f¸r Umnormierung auf Pedalwert" VALUE 0xFC6341 KwUb 4.980 spg_ub_b5 0.00 4.980 FORMAT "%5.3" /end CHARACTERISTIC
/begin CHARACTERISTIC UPWGVG "PWG-Spannungsschwelle f¸r Vollgasbereich" VALUE 0xFC6342 KwUb 4.980 spg_ub_b5 0.00 4.980 FORMAT "%5.3" /end CHARACTERISTIC
/begin CHARACTERISTIC USRIMINH "Mindest Spannungs-Schwelle f¸r Ri-Messung der Sonde hinter KAT" VALUE 0xFC63F4 KwUw 319.9951 spg_uw_q0p00488_o1 -1.000000 318.9951 FORMAT "%8.4" /end CHARACTERISTIC
/begin CHARACTERISTIC USRIMINV "Mindest Spannungs-Schwelle f¸r Ri-Messung der Sonde vor KAT" VALUE 0xFC63D8 KwUw 319.9951 spg_uw_q0p00488_o1 -1.000000 318.9951 FORMAT "%8.4" /end CHARACTERISTIC
/begin CHARACTERISTIC USRIOH "Obere Spannungs-Schwelle f¸r Ri-Messung der Sonde hinter KAT" VALUE 0xFC63F6 KwUw 319.9951 spg_uw_q0p00488_o1 -1.000000 318.9951 FORMAT "%8.4" /end CHARACTERISTIC
/begin CHARACTERISTIC USRIOV "Obere Spannungs-Schwelle f¸r Ri-Messung der Sonde vor KAT" VALUE 0xFC63DA KwUw 319.9951 spg_uw_q0p00488_o1 -1.000000 318.9951 FORMAT "%8.4" /end CHARACTERISTIC
/begin CHARACTERISTIC USRIUH "Untere Spannungs-Schwelle f¸r Ri-Messung der Sonde hinter KAT" VALUE 0xFC63F8 KwUw 319.9951 spg_uw_q0p00488_o1 -1.000000 318.9951 FORMAT "%8.4" /end CHARACTERISTIC
/begin CHARACTERISTIC USRIUV "Untere Spannungs-Schwelle f¸r Ri-Messung der Sonde vor KAT" VALUE 0xFC63DC KwUw 319.9951 spg_uw_q0p00488_o1 -1.000000 318.9951 FORMAT "%8.4" /end CHARACTERISTIC
/begin CHARACTERISTIC VFZGSCH "Schwelle f¸r Fahrzeuggeschwindigkeit" VALUE 0xFCDFA0 KwUw 511.9922 vfzg_uw_q0p00781 0.00 511.9922 FORMAT "%8.4" /end CHARACTERISTIC
/begin CHARACTERISTIC VLMXVZ "Maximalwert f¸r vlast_w" CURVE 0xFC21B0 KlAUwSstUwWUw 511.9844 vfzg_uw_b512 0.007812500 511.9922 FORMAT "%8.4"
 /begin AXIS_DESCR STD_AXIS vziel_w vfzg_uw_b512 6 0.00 511.9922 FORMAT "%8.4" DEPOSIT ABSOLUTE /end AXIS_DESCR
/end CHARACTERISTIC
/begin CHARACTERISTIC VWPMBBR "Mindestgeschwindigkeit f¸r Pedalwertbegrenzung bei bet‰tigter Bremse" VALUE 0xFC6343 KwUb 318.8 vfzg_ub_q1p25 0.00 318.8 FORMAT "%5.1" /end CHARACTERISTIC
/begin CHARACTERISTIC WDKDSVLU "Drosselklappenschwelle f¸r Drucksensorplausibilisierung" CURVE 0xFCE1B8 KlAUbSstUbWUb 100.0 relDK_ub_b100 0.00 100.0 FORMAT "%5.1"
 /begin AXIS_DESCR STD_AXIS nmot nmot_ub_q40 6 0.00 10200. FORMAT "%5.0" DEPOSIT ABSOLUTE /end AXIS_DESCR
/end CHARACTERISTIC
/begin CHARACTERISTIC WDKSAPP "Drosselklappensollwert f¸r Applikationszwecke" VALUE 0xFC47A6 KwWU16 99.99847 rel_uw_b100 0.00 99.99847 FORMAT "%8.5" /end CHARACTERISTIC
/begin CHARACTERISTIC WDKSNLN "Sollwinkel f¸r Drosselklappe bei Kl15 aus" CURVE 0xFC4748 KlAxU8SstxU16WU16 99.99847 rel_uw_b100 0.00 99.99847 FORMAT "%8.5"
 /begin AXIS_DESCR STD_AXIS nmot_w nmot_uw_q0p25 8 0.00 16383.75 FORMAT "%8.2" DEPOSIT ABSOLUTE /end AXIS_DESCR
/end CHARACTERISTIC
/begin CHARACTERISTIC WDKUGDN "KL Drosselklappenwinkel, ab der keine Drosselung mehr erfolgt" CURVE 0xFC476A KlAxU16SstxU16WU16 99.99847 rel_uw_b100 0.00 99.99847 FORMAT "%8.5"
 /begin AXIS_DESCR STD_AXIS nmot nmot_ub_q40 12 0.00 10200. FORMAT "%5.0" DEPOSIT ABSOLUTE /end AXIS_DESCR
/end CHARACTERISTIC
/begin CHARACTERISTIC WEAN "Winkel Einspritzabbruch" CURVE 0xFC4EA0 GklWU8 765.0 kw_q3 0.00 765.0 FORMAT "%5.1"
 /begin AXIS_DESCR COM_AXIS nmot nmot_ub_q40 8 0.00 10200. FORMAT "%5.0" AXIS_PTS_REF SNM08GKUB /end AXIS_DESCR
/end CHARACTERISTIC
/begin CHARACTERISTIC WEEM "Vorlagerungswinkel - Korrektur" CURVE 0xFC4EB0 KlAxU8SstxU8WS8 765.0 kw_q3 -384.0 381.0 FORMAT "%5.1"
 /begin AXIS_DESCR STD_AXIS tmot temp_ub_q0p75_o48 8 -48.00 143.3 FORMAT "%5.1" DEPOSIT ABSOLUTE /end AXIS_DESCR
/end CHARACTERISTIC
/begin CHARACTERISTIC WEEMGD "Vorlagerungswinkel - Korrektur gedrosselt" CURVE 0xFC4EC1 KlAxU8SstxU8WS8 765.0 kw_q3 -384.0 381.0 FORMAT "%5.1"
 /begin AXIS_DESCR STD_AXIS tmot temp_ub_q0p75_o48 8 -48.00 143.3 FORMAT "%5.1" DEPOSIT ABSOLUTE /end AXIS_DESCR
/end CHARACTERISTIC
/begin CHARACTERISTIC WEEMRFAN "Winkel Einspritzende bei maximalem Fahrerwunsch" CURVE 0xFC4EA8 GklWU8 765.0 kw_q3 0.00 765.0 FORMAT "%5.1"
 /begin AXIS_DESCR COM_AXIS nmot nmot_ub_q40 8 0.00 10200. FORMAT "%5.0" AXIS_PTS_REF SNM08GKUB /end AXIS_DESCR
/end CHARACTERISTIC
/begin CHARACTERISTIC WEESTM "Vorlagerunswinkel-Korrektur im Start" CURVE 0xFC4ED4 KlAxU8SstxU8WU8 765.0 kw_q3 0.00 765.0 FORMAT "%5.1"
 /begin AXIS_DESCR STD_AXIS tmot temp_ub_q0p75_o48 8 -48.00 143.3 FORMAT "%5.1" DEPOSIT ABSOLUTE /end AXIS_DESCR
/end CHARACTERISTIC
/begin CHARACTERISTIC WEESTMGD "Vorlagerunswinkel-Korrektur im Start mit Vollhub" CURVE 0xFC4EE8 KlAxU8SstxU8WU8 765.0 kw_q3 0.00 765.0 FORMAT "%5.1"
 /begin AXIS_DESCR STD_AXIS tmot temp_ub_q0p75_o48 8 -48.00 143.3 FORMAT "%5.1" DEPOSIT ABSOLUTE /end AXIS_DESCR
/end CHARACTERISTIC
/begin CHARACTERISTIC WEESTN "Winkel Einspritzende im Start" CURVE 0xFC4EFC KlAxU8SstxU8WU8 765.0 kw_q3 0.00 765.0 FORMAT "%5.1"
 /begin AXIS_DESCR STD_AXIS nmot nmot_ub_q40 4 0.00 10200. FORMAT "%5.0" DEPOSIT ABSOLUTE /end AXIS_DESCR
/end CHARACTERISTIC
/begin CHARACTERISTIC WEESTNGD "Winkel Einspritzende im Start mit Vollhub" CURVE 0xFC4F08 KlAxU8SstxU8WU8 765.0 kw_q3 0.00 765.0 FORMAT "%5.1"
 /begin AXIS_DESCR STD_AXIS nmot nmot_ub_q40 4 0.00 10200. FORMAT "%5.0" DEPOSIT ABSOLUTE /end AXIS_DESCR
/end CHARACTERISTIC
/begin CHARACTERISTIC WPEDGD "Untere Grenze Fahrpedalstellung f¸r R¸cksetzen gedrosselter Warmlauf" VALUE 0xFC3EA0 KwWU16 100.0000 relPED_uw_b100 0.00 100.0000 FORMAT "%8.4" /end CHARACTERISTIC
/begin CHARACTERISTIC WPMXBR "Maximal zul‰ssiger Pedalwert bei bet‰tigter Bremse (vor Erkennung wped = 0)" VALUE 0xFC6352 KwUw 100.0000 relPED_uw_b100 0.00 100.0000 FORMAT "%8.4" /end CHARACTERISTIC
/begin CHARACTERISTIC WPMXNOT "Maximal zul‰ssiger Fahrpedalwert im PWG-Notfahren" VALUE 0xFC6344 KwUb 100.0 relPED_ub_b100 0.00 100.0 FORMAT "%5.1" /end CHARACTERISTIC
/begin CHARACTERISTIC ZBWF "Z‰hlerstand f¸r Fehlereintrag Bewegungserkennung" VALUE 0xFC6345 KwUb 255.0 dez 0.00 255.0 FORMAT "%5.1" /end CHARACTERISTIC
/begin CHARACTERISTIC ZDSU "Zeitkonstante f¸r Filterung von pu und fho in GGDSU" VALUE 0xFCE1C5 KwUb 25.4996 zk100msxs_ub_b25p5 0.100392 25.6000 FORMAT "%7.4" /end CHARACTERISTIC
/begin CHARACTERISTIC ZERBR "Fehlerz‰hler f¸r Bremsschalter-Unplausibilit‰ten" VALUE 0xFCDF24 KwUb 255.0 dez 0.00 255.0 FORMAT "%5.1" /end CHARACTERISTIC
/begin CHARACTERISTIC ZFRIH "Abschw‰chungsfaktor f¸r Innenwiderstand Ri-Nernst-Filter hinter KAT" VALUE 0xFC63FA KwUw 0.9999847 fak_uw_b1 0.00 0.9999847 FORMAT "%9.7" /end CHARACTERISTIC
/begin CHARACTERISTIC ZFRIV "Abschw‰chungsfaktor f¸r Innenwiderstand Ri-Nernst-Filter vor KAT" VALUE 0xFC63DE KwUw 0.9999847 fak_uw_b1 0.00 0.9999847 FORMAT "%9.7" /end CHARACTERISTIC
/begin CHARACTERISTIC ZKDFST "Zeitkonstante DT1-Filter Tankfuellstand" VALUE 0xFCDF44 KwUw 6553.50000 zk100msxs_uw_b6553 0.100001526 6553.60000 FORMAT "%10.5" /end CHARACTERISTIC
/begin CHARACTERISTIC ZKFSTV "Kennlinie Zeitkonstante Fuellstandssignal-Filter" CURVE 0xFCDF46 KlAUwSstUwWUw 6553.50000 zk100msxs_uw_b6553 0.100001526 6553.60000 FORMAT "%10.5"
 /begin AXIS_DESCR STD_AXIS vfzg vfzg_ub_q1p25 4 0.00 318.8 FORMAT "%5.1" DEPOSIT ABSOLUTE /end AXIS_DESCR
/end CHARACTERISTIC
/begin CHARACTERISTIC ZKLANSWL "Zeitkonstante Filterung lamnswl_w" VALUE 0xFC4FC8 KwUw 655.34999985 zk10msxs_uw_b655 0.010000152590 655.36000000 FORMAT "%12.8" /end CHARACTERISTIC
/begin CHARACTERISTIC ZSIGHFM "Zeitkonstante zum Gl‰tten der berechneten Varianz" VALUE 0xFC5A98 KwWU16 655.34999985 zk10msxs_uw_b655 0.010000152590 655.36000000 FORMAT "%12.8" /end CHARACTERISTIC
/begin CHARACTERISTIC ZTDDPS "" VALUE 0xFC3EA2 KwWU16 655.34999985 zk10msxs_uw_b655 0.010000152590 655.36000000 FORMAT "%12.8" /end CHARACTERISTIC
/begin MEASUREMENT anztpdn "Anzahl der hintereinander erfolgten Tip-Downs" UBYTE dez 1 100 0 255 FORMAT "%5.1" ECU_ADDRESS 0x5B8E76 /end MEASUREMENT
/begin MEASUREMENT anztpup "Anzahl der hintereinander erfolgten Tip-Ups" UBYTE dez 1 100 0 255 FORMAT "%5.1" ECU_ADDRESS 0x5B8E77 /end MEASUREMENT
/begin MEASUREMENT anzwefim "Anzahl der abgearbeiteten Wiedereinsetzfaktoren" UBYTE dez 1 100 0 255 FORMAT "%5.1" ECU_ADDRESS 0x5B8EB0 /end MEASUREMENT
/begin MEASUREMENT AS_bf0 "" UWORD B_TRUE 1 100 0 1 BIT_MASK 0x8 FORMAT "%13.11" ECU_ADDRESS 0x5B968A /end MEASUREMENT
/begin MEASUREMENT AS_bf1 "" UWORD B_TRUE 1 100 0 1 BIT_MASK 0x10 FORMAT "%13.11" ECU_ADDRESS 0x5B968A /end MEASUREMENT
/begin MEASUREMENT AS_bf2 "" UWORD B_TRUE 1 100 0 1 BIT_MASK 0x20 FORMAT "%13.11" ECU_ADDRESS 0x5B968A /end MEASUREMENT
/begin MEASUREMENT AS_bf3 "" UWORD B_TRUE 1 100 0 1 BIT_MASK 0x40 FORMAT "%13.11" ECU_ADDRESS 0x5B968A /end MEASUREMENT
/begin MEASUREMENT AS_g0 "" UWORD B_TRUE 1 100 0 1 BIT_MASK 0x1 FORMAT "%13.11" ECU_ADDRESS 0x5B968A /end MEASUREMENT
/begin MEASUREMENT AS_g1 "" UWORD B_TRUE 1 100 0 1 BIT_MASK 0x2 FORMAT "%13.11" ECU_ADDRESS 0x5B968A /end MEASUREMENT
/begin MEASUREMENT AS_g2 "" UWORD B_TRUE 1 100 0 1 BIT_MASK 0x4 FORMAT "%13.11" ECU_ADDRESS 0x5B968A /end MEASUREMENT
/begin MEASUREMENT AS_ksa1 "" UWORD B_TRUE 1 100 0 1 BIT_MASK 0x80 FORMAT "%13.11" ECU_ADDRESS 0x5B968A /end MEASUREMENT
/begin MEASUREMENT AS_ksa2 "" UWORD B_TRUE 1 100 0 1 BIT_MASK 0x100 FORMAT "%13.11" ECU_ADDRESS 0x5B968A /end MEASUREMENT
/begin MEASUREMENT AS_ksa3 "" UWORD B_TRUE 1 100 0 1 BIT_MASK 0x200 FORMAT "%13.11" ECU_ADDRESS 0x5B968A /end MEASUREMENT
/begin MEASUREMENT AS_kti "" UWORD B_TRUE 1 100 0 1 BIT_MASK 0x400 FORMAT "%13.11" ECU_ADDRESS 0x5B968A /end MEASUREMENT
/begin MEASUREMENT atislatm_w "Rover" UWORD dez 1 100 0 65535 FORMAT "%8.2" ECU_ADDRESS 0x5B91C2 /end MEASUREMENT
/begin MEASUREMENT atiwkstm_w "Rover" UWORD dez 1 100 0 65535 FORMAT "%8.2" ECU_ADDRESS 0x5B91C4 /end MEASUREMENT
/begin MEASUREMENT azylwe "Anzahl wiedereingesetzter Zylinder" UBYTE dez 1 100 0 255 FORMAT "%5.1" ECU_ADDRESS 0x5B8EB1 /end MEASUREMENT
/begin MEASUREMENT Btvdpsrlvw "" UBYTE dez 1 100 0 255 FORMAT "%5.1" ECU_ADDRESS 0x5B86F8 /end MEASUREMENT
/begin MEASUREMENT B_afwe "Bedingung Anzahl der Wiedereinsetzfaktoren" UBYTE B_TRUE 1 100 0 1 BIT_MASK 0x1 FORMAT "%13.11" ECU_ADDRESS 0x3FBD88 /end MEASUREMENT
/begin MEASUREMENT B_airbag "Bedingung Airbag ausgelˆst" UBYTE B_TRUE 1 100 0 1 BIT_MASK 0x1 FORMAT "%13.11" ECU_ADDRESS 0x3FBDAC /end MEASUREMENT
/begin MEASUREMENT B_besch "Bedingung FGR im Zustand Beschleunigen" UWORD B_TRUE 1 100 0 1 BIT_MASK 0x1 FORMAT "%13.11" ECU_ADDRESS 0x5B90E4 /end MEASUREMENT
/begin MEASUREMENT B_biterr "Bedingung Biterror in Botschaft vorhanden" UBYTE B_TRUE 1 100 0 1 BIT_MASK 0x1 FORMAT "%13.11" ECU_ADDRESS 0x5B8B4F /end MEASUREMENT
/begin MEASUREMENT B_bl "Bedingung Bremslichtschalter bet‰tigt" UBYTE B_TRUE 1 100 0 1 BIT_MASK 0x1 FORMAT "%13.11" ECU_ADDRESS 0x3FBDAD /end MEASUREMENT
/begin MEASUREMENT B_br "Bedingung Bremstestschalter bet‰tigt" UBYTE B_TRUE 1 100 0 1 BIT_MASK 0x1 FORMAT "%13.11" ECU_ADDRESS 0x3FBDAE /end MEASUREMENT
/begin MEASUREMENT B_br2k "Bedingung Bremse bet‰tigt 2-kanalig erkannt" UBYTE B_TRUE 1 100 0 1 BIT_MASK 0x1 FORMAT "%13.11" ECU_ADDRESS 0x3FBDAF /end MEASUREMENT
/begin MEASUREMENT B_brems "Bedingung Bremse bet‰tigt" UBYTE B_TRUE 1 100 0 1 BIT_MASK 0x1 FORMAT "%13.11" ECU_ADDRESS 0x3FBDB0 /end MEASUREMENT
/begin MEASUREMENT B_bwf "Bedingung: Bewegungserkennung hat Fehler erkannt" UWORD B_TRUE 1 100 0 1 BIT_MASK 0x1 FORMAT "%13.11" ECU_ADDRESS 0x5B91F0 /end MEASUREMENT
/begin MEASUREMENT B_bwunpl "Bedingung Unplausibilit‰t bei Bewegungserkennung" UWORD B_TRUE 1 100 0 1 BIT_MASK 0x2 FORMAT "%13.11" ECU_ADDRESS 0x5B91F0 /end MEASUREMENT
/begin MEASUREMENT B_c95bf0 "Ansteuersignal zum Einstellen der Filtermittenfrequenz des CC195 (Pin BF0)" UBYTE B_TRUE 1 100 0 1 BIT_MASK 0x1 FORMAT "%13.11" ECU_ADDRESS 0x3FBDD1 /end MEASUREMENT
/begin MEASUREMENT B_c95bf1 "Ansteuersignal zum Einstellen der Filtermittenfrequenz des CC195 (Pin BF1)" UBYTE B_TRUE 1 100 0 1 BIT_MASK 0x1 FORMAT "%13.11" ECU_ADDRESS 0x3FBDD2 /end MEASUREMENT
/begin MEASUREMENT B_c95bf2 "Ansteuersignal zum Einstellen der Filtermittenfrequenz des CC195 (Pin BF2)" UBYTE B_TRUE 1 100 0 1 BIT_MASK 0x1 FORMAT "%13.11" ECU_ADDRESS 0x3FBDD3 /end MEASUREMENT
/begin MEASUREMENT B_c95bf3 "Ansteuersignal zum Eintstellen der Filtermittenfrequenz des CC195 (Pin BF3)" UBYTE B_TRUE 1 100 0 1 BIT_MASK 0x1 FORMAT "%13.11" ECU_ADDRESS 0x3FBDD4 /end MEASUREMENT
/begin MEASUREMENT B_c95ks3 "Ansteuersignal f¸r den Nulltest des CC195" UBYTE B_TRUE 1 100 0 1 BIT_MASK 0x1 FORMAT "%13.11" ECU_ADDRESS 0x3FBDD5 /end MEASUREMENT
/begin MEASUREMENT B_clradhoe "Bedingung: Adaptionswerte Hoehenfaktor selektiv loeschen" UBYTE B_TRUE 1 100 0 1 BIT_MASK 0x1 FORMAT "%13.11" ECU_ADDRESS 0x3FBDCE /end MEASUREMENT
/begin MEASUREMENT B_dkp1e "Bedingung Fehler DK-Poti 1" UBYTE B_TRUE 1 100 0 1 BIT_MASK 0x1 FORMAT "%13.11" ECU_ADDRESS 0x3FBC67 /end MEASUREMENT
/begin MEASUREMENT B_dkp1ev "Bedingung Vorl‰ufige Bereichsverletzung DK-Poti 1" UBYTE B_TRUE 1 100 0 1 BIT_MASK 0x1 FORMAT "%13.11" ECU_ADDRESS 0x3FBC68 /end MEASUREMENT
/begin MEASUREMENT B_dkp1mn "Bedingung Bereichsverletzung DK-Poti 1 nach unten" UBYTE B_TRUE 1 100 0 1 BIT_MASK 0x1 FORMAT "%13.11" ECU_ADDRESS 0x3FBC69 /end MEASUREMENT
/begin MEASUREMENT B_dkp1mx "Bedingung Bereichsverletzung DK-Poti 1 nach oben" UBYTE B_TRUE 1 100 0 1 BIT_MASK 0x1 FORMAT "%13.11" ECU_ADDRESS 0x3FBC6A /end MEASUREMENT
/begin MEASUREMENT B_dkp1np "Bedingung DK-Poti 1 unplausibel zu Ersatzwert aus F¸llung" UBYTE B_TRUE 1 100 0 1 BIT_MASK 0x1 FORMAT "%13.11" ECU_ADDRESS 0x3FBC6B /end MEASUREMENT
/begin MEASUREMENT B_dkp2e "Bedingung Fehler DK-Poti 2" UBYTE B_TRUE 1 100 0 1 BIT_MASK 0x1 FORMAT "%13.11" ECU_ADDRESS 0x3FBC6C /end MEASUREMENT
/begin MEASUREMENT B_dkp2ev "Bedingung Vorl‰ufige Bereichsverletzung DK-Poti 2" UBYTE B_TRUE 1 100 0 1 BIT_MASK 0x1 FORMAT "%13.11" ECU_ADDRESS 0x3FBC6D /end MEASUREMENT
/begin MEASUREMENT B_dkp2mn "Bedingung Bereichsverletzung DK-Poti 2 nach unten" UBYTE B_TRUE 1 100 0 1 BIT_MASK 0x1 FORMAT "%13.11" ECU_ADDRESS 0x3FBC6E /end MEASUREMENT
/begin MEASUREMENT B_dkp2mx "Bedingung Bereichsverletzung DK-Poti 2 nach oben" UBYTE B_TRUE 1 100 0 1 BIT_MASK 0x1 FORMAT "%13.11" ECU_ADDRESS 0x3FBC6F /end MEASUREMENT
/begin MEASUREMENT B_dkp2np "Bedingung DK-Poti 2 unplausibel zu Ersatzwert aus F¸llung" UBYTE B_TRUE 1 100 0 1 BIT_MASK 0x1 FORMAT "%13.11" ECU_ADDRESS 0x3FBC70 /end MEASUREMENT
/begin MEASUREMENT B_dkpaw "Bedingung DK-Poti-Auswahl f¸r DK-Sensor-Ersatzbetrieb" UBYTE B_TRUE 1 100 0 1 BIT_MASK 0x1 FORMAT "%13.11" ECU_ADDRESS 0x3FBC71 /end MEASUREMENT
/begin MEASUREMENT B_dksbeg "Bedingung DK-Sollwertbegrenzung" UBYTE B_TRUE 1 100 0 1 BIT_MASK 0x1 FORMAT "%13.11" ECU_ADDRESS 0x3FBC72 /end MEASUREMENT
/begin MEASUREMENT B_dnt "Aktive Diagnose: Klopfregelung Nulltest" UBYTE B_TRUE 1 100 0 1 BIT_MASK 0x1 FORMAT "%13.11" ECU_ADDRESS 0x3FBDD6 /end MEASUREMENT
/begin MEASUREMENT B_dntb "Bedingung Diagnose: Bereitschaft zum Nulltest (Nulltest im n‰chsten MF)" UBYTE B_TRUE 1 100 0 1 BIT_MASK 0x1 FORMAT "%13.11" ECU_ADDRESS 0x3FBDD7 /end MEASUREMENT
/begin MEASUREMENT B_dpsadp "Bedingung Differenzdruck Saugrohr Adaption eingeschaltet" UBYTE dez 1 100 0 255 FORMAT "%5.1" ECU_ADDRESS 0x5B86F9 /end MEASUREMENT
/begin MEASUREMENT B_dtp "Aktive Diagnose: Klopfregelung Testimpuls" UBYTE B_TRUE 1 100 0 1 BIT_MASK 0x1 FORMAT "%13.11" ECU_ADDRESS 0x3FBDD8 /end MEASUREMENT
/begin MEASUREMENT B_dtpb "Bedingung Diagnose: Bereitschaft zum Testpuls (Testpuls im n‰chsten MF)" UBYTE B_TRUE 1 100 0 1 BIT_MASK 0x1 FORMAT "%13.11" ECU_ADDRESS 0x3FBDD9 /end MEASUREMENT
/begin MEASUREMENT B_dummy "" UBYTE B_TRUE 1 100 0 1 BIT_MASK 0x1 FORMAT "%13.11" ECU_ADDRESS 0x3FBDDA /end MEASUREMENT
/begin MEASUREMENT B_dupw "Bedingung Abweichung zwischen Poti 1 und 2 zu groﬂ" UWORD B_TRUE 1 100 0 1 BIT_MASK 0x4 FORMAT "%13.11" ECU_ADDRESS 0x5B91F0 /end MEASUREMENT
/begin MEASUREMENT B_dupw12 "Bedingung zul‰ssige Abweichung zwischen PWG-Poti 1 und 2 ¸berschritten" UWORD B_TRUE 1 100 0 1 BIT_MASK 0x8 FORMAT "%13.11" ECU_ADDRESS 0x5B91F0 /end MEASUREMENT
/begin MEASUREMENT B_edks "Bedingung Fehler Drosselklappen-Sensor" UBYTE B_TRUE 1 100 0 1 BIT_MASK 0x1 FORMAT "%13.11" ECU_ADDRESS 0x3FBC73 /end MEASUREMENT
/begin MEASUREMENT B_edsl "Bedingung Error Ladedrucksensor" UBYTE B_TRUE 1 100 0 1 BIT_MASK 0x1 FORMAT "%13.11" ECU_ADDRESS 0x3FBDCF /end MEASUREMENT
/begin MEASUREMENT B_edsuu "Bedingung Error Umgebungsdrucksensor nicht zeitentprellt" UBYTE B_TRUE 1 100 0 1 BIT_MASK 0x1 FORMAT "%13.11" ECU_ADDRESS 0x3FDC5F /end MEASUREMENT
/begin MEASUREMENT B_enrinh "Bedingung enable f¸r Ri-Nernst mit Filter hinter KAT" UBYTE B_TRUE 1 100 0 1 BIT_MASK 0x1 FORMAT "%13.11" ECU_ADDRESS 0x3FBDFE /end MEASUREMENT
/begin MEASUREMENT B_enrinv "Bedingung enable f¸r Ri-Nernst mit Filter vor KAT" UBYTE B_TRUE 1 100 0 1 BIT_MASK 0x1 FORMAT "%13.11" ECU_ADDRESS 0x3FBDE3 /end MEASUREMENT
/begin MEASUREMENT B_enrinv2 "Bedingung enable f¸r Ri-Nernst mit Filter vor KAT Bank2" UBYTE B_TRUE 1 100 0 1 BIT_MASK 0x1 FORMAT "%13.11" ECU_ADDRESS 0x3FBDE4 /end MEASUREMENT
/begin MEASUREMENT B_erbr "Bedingung Bremsschaltersignale unplausibel" UBYTE B_TRUE 1 100 0 1 BIT_MASK 0x1 FORMAT "%13.11" ECU_ADDRESS 0x3FBDB1 /end MEASUREMENT
/begin MEASUREMENT B_erinofh "Bedingung enable f¸r Ri-Nernst ohne Filter hinter KAT" UBYTE B_TRUE 1 100 0 1 BIT_MASK 0x1 FORMAT "%13.11" ECU_ADDRESS 0x3FBDFF /end MEASUREMENT
/begin MEASUREMENT B_erinofv "Bedingung enable f¸r Ri-Nernst ohne Filter vor KAT" UBYTE B_TRUE 1 100 0 1 BIT_MASK 0x1 FORMAT "%13.11" ECU_ADDRESS 0x3FBDE5 /end MEASUREMENT
/begin MEASUREMENT B_erinofv2 "Bedingung enable f¸r Ri-Nernst ohne Filter vor KAT Bank2" UBYTE B_TRUE 1 100 0 1 BIT_MASK 0x1 FORMAT "%13.11" ECU_ADDRESS 0x3FBDE6 /end MEASUREMENT
/begin MEASUREMENT B_esbnb "Bedingung Einspritzbeginn im Normalbetrieb" UBYTE B_TRUE 1 100 0 1 BIT_MASK 0x2 FORMAT "%13.11" ECU_ADDRESS 0x5B8C44 /end MEASUREMENT
/begin MEASUREMENT B_esbst "Bedingung Einspritzbeginn im Start" UBYTE B_TRUE 1 100 0 1 BIT_MASK 0x1 FORMAT "%13.11" ECU_ADDRESS 0x5B8C44 /end MEASUREMENT
/begin MEASUREMENT B_fe "Betriebsartenbyte" UBYTE dez 1 100 0 255 FORMAT "%5.1" ECU_ADDRESS 0x5B86FA /end MEASUREMENT
/begin MEASUREMENT B_ff "Bedingung Folgefunkenz¸ndung" UBYTE B_TRUE 1 100 0 1 BIT_MASK 0x1 FORMAT "%13.11" ECU_ADDRESS 0x3FBFE6 /end MEASUREMENT
/begin MEASUREMENT B_fgrakt "Bedingung FGR-Regler aktiv" UWORD B_TRUE 1 100 0 1 BIT_MASK 0x4 FORMAT "%13.11" ECU_ADDRESS 0x5B90E4 /end MEASUREMENT
/begin MEASUREMENT B_fgrari "Bedingung FGR-Abschaltrampe Initialisierung" UBYTE B_TRUE 1 100 0 1 BIT_MASK 0x1 FORMAT "%13.11" ECU_ADDRESS 0x3FBD12 /end MEASUREMENT
/begin MEASUREMENT B_fgrat "Bedingung: Tip-Schalter Aus am FGR-Bedienteil bet‰tigt" UBYTE B_TRUE 1 100 0 1 BIT_MASK 0x1 FORMAT "%13.11" ECU_ADDRESS 0x5B8B50 /end MEASUREMENT
/begin MEASUREMENT B_fgrdvi "Bedingung FGR-Regler Initialisierung der gespeicherten Regelabweichung" UWORD B_TRUE 1 100 0 1 BIT_MASK 0x8 FORMAT "%13.11" ECU_ADDRESS 0x5B90E4 /end MEASUREMENT
/begin MEASUREMENT B_fgren "Bedingung Fahrgeschwindigkeitsregelung aktiv (Enable)" UBYTE B_TRUE 1 100 0 1 BIT_MASK 0x1 FORMAT "%13.11" ECU_ADDRESS 0x3FBD17 /end MEASUREMENT
/begin MEASUREMENT B_fgrene "Bedingung FGR-Regelung aktiv (Enable) erweitert" UBYTE B_TRUE 1 100 0 1 BIT_MASK 0x1 FORMAT "%13.11" ECU_ADDRESS 0x3FBD13 /end MEASUREMENT
/begin MEASUREMENT B_fgrhe "Bedingung: FGR-Bedienteil-Fehler" UBYTE B_TRUE 1 100 0 1 BIT_MASK 0x1 FORMAT "%13.11" ECU_ADDRESS 0x5B8B51 /end MEASUREMENT
/begin MEASUREMENT B_fgrhsa "Bedingung: FGR-Hauptschalter aus" UBYTE B_TRUE 1 100 0 1 BIT_MASK 0x1 FORMAT "%13.11" ECU_ADDRESS 0x5B8B52 /end MEASUREMENT
/begin MEASUREMENT B_fgrkf "Bedingung: FGR im Zustand Konstantfahrt" UBYTE B_TRUE 1 100 0 1 BIT_MASK 0x1 FORMAT "%13.11" ECU_ADDRESS 0x3FBD18 /end MEASUREMENT
/begin MEASUREMENT B_fgrkfm "Bedingung: FGR im Zustand Konstantfahrt (aus ME)" UBYTE B_TRUE 1 100 0 1 BIT_MASK 0x1 FORMAT "%13.11" ECU_ADDRESS 0x3FBD14 /end MEASUREMENT
/begin MEASUREMENT B_fgrra "Bedingung FGR-Rampe" UWORD B_TRUE 1 100 0 1 BIT_MASK 0x10 FORMAT "%13.11" ECU_ADDRESS 0x5B90E4 /end MEASUREMENT
/begin MEASUREMENT B_fgrtbe "Bedingung FGR-Taste Beschleunigen" UBYTE B_TRUE 1 100 0 1 BIT_MASK 0x1 FORMAT "%13.11" ECU_ADDRESS 0x5B8B53 /end MEASUREMENT
/begin MEASUREMENT B_fgrtse "Bedingung FGR-Taste Setzen" UBYTE B_TRUE 1 100 0 1 BIT_MASK 0x1 FORMAT "%13.11" ECU_ADDRESS 0x5B8B54 /end MEASUREMENT
/begin MEASUREMENT B_fgrtve "Bedingung FGR-Taste Verzˆgern" UBYTE B_TRUE 1 100 0 1 BIT_MASK 0x1 FORMAT "%13.11" ECU_ADDRESS 0x5B8B55 /end MEASUREMENT
/begin MEASUREMENT B_fgrtwa "Bedingung FGR-Taste Wiederaufnahme" UBYTE B_TRUE 1 100 0 1 BIT_MASK 0x1 FORMAT "%13.11" ECU_ADDRESS 0x5B8B56 /end MEASUREMENT
/begin MEASUREMENT B_fgrvem "Bedingung: FGR im Zustand Verzˆgern (aus ME)" UBYTE B_TRUE 1 100 0 1 BIT_MASK 0x1 FORMAT "%13.11" ECU_ADDRESS 0x3FBD15 /end MEASUREMENT
/begin MEASUREMENT B_fgrver "Bedingung: FGR im Zustand Verzˆgern" UBYTE B_TRUE 1 100 0 1 BIT_MASK 0x1 FORMAT "%13.11" ECU_ADDRESS 0x3FBD19 /end MEASUREMENT
/begin MEASUREMENT B_fmfkrc "Filtermittenfrequenz des CC195/CC650 umgeschaltet" UBYTE B_TRUE 1 100 0 1 BIT_MASK 0x1 FORMAT "%13.11" ECU_ADDRESS 0x3FBDDB /end MEASUREMENT
/begin MEASUREMENT B_fmfkrco "Filtermittenfrequenz umgeschaltet, neue Frequenz ist hˆher" UBYTE B_TRUE 1 100 0 1 BIT_MASK 0x1 FORMAT "%13.11" ECU_ADDRESS 0x3FBDDC /end MEASUREMENT
/begin MEASUREMENT B_fmfkrcu "Filtermittenfrequenz umgeschaltet, neue Frequenz ist kleiner" UBYTE B_TRUE 1 100 0 1 BIT_MASK 0x1 FORMAT "%13.11" ECU_ADDRESS 0x3FBDDD /end MEASUREMENT
/begin MEASUREMENT B_fstdmn "Bedingung minimaler Tankfuellstand fuer Diagnosefunkionen" UWORD B_TRUE 1 100 0 1 BIT_MASK 0x1 FORMAT "%13.11" ECU_ADDRESS 0x5B8788 /end MEASUREMENT
/begin MEASUREMENT B_fstdmx "Bedingung maximaler Tankfuellstand fuer Diagnosefunktionen" UWORD B_TRUE 1 100 0 1 BIT_MASK 0x2 FORMAT "%13.11" ECU_ADDRESS 0x5B8788 /end MEASUREMENT
/begin MEASUREMENT B_fstdy "Bedingung Tankfuellstand dynamisch" UBYTE B_TRUE 1 100 0 1 BIT_MASK 0x1 FORMAT "%13.11" ECU_ADDRESS 0x3FBDB5 /end MEASUREMENT
/begin MEASUREMENT B_fststa "Bedingung Fuellstand nach Start" UBYTE B_TRUE 1 100 0 1 BIT_MASK 0x1 FORMAT "%13.11" ECU_ADDRESS 0x3FBDB6 /end MEASUREMENT
/begin MEASUREMENT B_fsttal "Bedigung Fuellstand Tank leer" UWORD B_TRUE 1 100 0 1 BIT_MASK 0x20 FORMAT "%13.11" ECU_ADDRESS 0x5B8788 /end MEASUREMENT
/begin MEASUREMENT B_fsttew "Bedingung Ersatzwert Tankfuellstand" UBYTE B_TRUE 1 100 0 1 BIT_MASK 0x1 FORMAT "%13.11" ECU_ADDRESS 0x3FBDB7 /end MEASUREMENT
/begin MEASUREMENT B_fsttg "Fuellstand Tank gueltig (auch im Steuergerdtenachlauf)" UWORD B_TRUE 1 100 0 1 BIT_MASK 0x100 FORMAT "%13.11" ECU_ADDRESS 0x5B8788 /end MEASUREMENT
/begin MEASUREMENT B_fsttsh "Bedingung Tankfuellstandssignal Sample/Hold" UWORD B_TRUE 1 100 0 1 BIT_MASK 0x4 FORMAT "%13.11" ECU_ADDRESS 0x5B8788 /end MEASUREMENT
/begin MEASUREMENT B_fsttval "Bedingung Fuellstand Tank validiert" UWORD B_TRUE 1 100 0 1 BIT_MASK 0x8 FORMAT "%13.11" ECU_ADDRESS 0x5B8788 /end MEASUREMENT
/begin MEASUREMENT B_furena "Bedingung Aktivierung des F¸llungsreglers" UBYTE B_TRUE 1 100 0 1 BIT_MASK 0x1 FORMAT "%13.11" ECU_ADDRESS 0x3FBD26 /end MEASUREMENT
/begin MEASUREMENT B_fwe "Bedingung Faktor Wiedereinsetzen" UBYTE B_TRUE 1 100 0 1 BIT_MASK 0x1 FORMAT "%13.11" ECU_ADDRESS 0x3FBD89 /end MEASUREMENT
/begin MEASUREMENT B_gd "Bedingung gedrosselt" UBYTE dez 1 100 0 255 FORMAT "%5.1" ECU_ADDRESS 0x5B86FB /end MEASUREMENT
/begin MEASUREMENT B_gdhz "Bedingung gedrosselt wegen Heizleistung" UBYTE dez 1 100 0 255 FORMAT "%5.1" ECU_ADDRESS 0x5B86FC /end MEASUREMENT
/begin MEASUREMENT B_gdon "Bedingung gedrosselt wegen Heizleistung oder Testeranforderung" UBYTE dez 1 100 0 255 FORMAT "%5.1" ECU_ADDRESS 0x5B86FD /end MEASUREMENT
/begin MEASUREMENT B_gdst "" UBYTE dez 1 100 0 255 FORMAT "%5.1" ECU_ADDRESS 0x5B86FE /end MEASUREMENT
/begin MEASUREMENT B_gdvhub "Gedrosselt mit Vollhub" UBYTE dez 1 100 0 255 FORMAT "%5.1" ECU_ADDRESS 0x5B86FF /end MEASUREMENT
/begin MEASUREMENT B_gdvvtueb "" UBYTE dez 1 100 0 255 FORMAT "%5.1" ECU_ADDRESS 0x5B8700 /end MEASUREMENT
/begin MEASUREMENT B_gd_alt "" UBYTE dez 1 100 0 255 FORMAT "%5.1" ECU_ADDRESS 0x5B8701 /end MEASUREMENT
/begin MEASUREMENT B_genfprl "Bedingung Generatorfehler entprellt" UBYTE B_TRUE 1 100 0 1 FORMAT "%13.11" ECU_ADDRESS 0x5B892D /end MEASUREMENT
/begin MEASUREMENT B_gerr1 "" UBYTE B_TRUE 1 100 0 1 FORMAT "%13.11" ECU_ADDRESS 0x5B892E /end MEASUREMENT
/begin MEASUREMENT B_gerr2 "" UBYTE B_TRUE 1 100 0 1 FORMAT "%13.11" ECU_ADDRESS 0x5B892F /end MEASUREMENT
/begin MEASUREMENT B_gerr3 "" UBYTE B_TRUE 1 100 0 1 FORMAT "%13.11" ECU_ADDRESS 0x5B8930 /end MEASUREMENT
/begin MEASUREMENT B_gerr4 "" UBYTE B_TRUE 1 100 0 1 FORMAT "%13.11" ECU_ADDRESS 0x5B8931 /end MEASUREMENT
/begin MEASUREMENT B_gerr5 "" UBYTE B_TRUE 1 100 0 1 FORMAT "%13.11" ECU_ADDRESS 0x5B8932 /end MEASUREMENT
/begin MEASUREMENT B_gfbsupak "Generator Typ unplausibel aus Fehlerspeicher" UBYTE B_TRUE 1 100 0 1 FORMAT "%13.11" ECU_ADDRESS 0x5B8933 /end MEASUREMENT
/begin MEASUREMENT B_gfelak "Generatorfehler elektrisch aus Fehlerspeicher" UBYTE B_TRUE 1 100 0 1 FORMAT "%13.11" ECU_ADDRESS 0x5B8934 /end MEASUREMENT
/begin MEASUREMENT B_gfhtak "Generatorfehler Uebertemperatur aus Fehlerspeicher" UBYTE B_TRUE 1 100 0 1 FORMAT "%13.11" ECU_ADDRESS 0x5B8935 /end MEASUREMENT
/begin MEASUREMENT B_gfmeak "Generatorfehler mechanisch aus Fehlerspeicher" UBYTE B_TRUE 1 100 0 1 FORMAT "%13.11" ECU_ADDRESS 0x5B8936 /end MEASUREMENT
/begin MEASUREMENT B_gfnobsak "Generator BSD Kommunikationsverlust aus Fehlerspeicher" UBYTE B_TRUE 1 100 0 1 FORMAT "%13.11" ECU_ADDRESS 0x5B8937 /end MEASUREMENT
/begin MEASUREMENT B_glf "Bedingung Gleichlauf zwischen Poti 1 und Poti 2 verletzt" UBYTE B_TRUE 1 100 0 1 BIT_MASK 0x1 FORMAT "%13.11" ECU_ADDRESS 0x3FBDB8 /end MEASUREMENT
/begin MEASUREMENT B_hag "Bedingung Hˆhenadaption g¸ltig" UBYTE B_TRUE 1 100 0 1 BIT_MASK 0x1 FORMAT "%13.11" ECU_ADDRESS 0x3FBDD0 /end MEASUREMENT
/begin MEASUREMENT B_holp1 "Bedingung Hochohmigkeit im Leerlauf an PWG-Poti 1 erkannt" UWORD B_TRUE 1 100 0 1 BIT_MASK 0x10 FORMAT "%13.11" ECU_ADDRESS 0x5B91F0 /end MEASUREMENT
/begin MEASUREMENT B_holp1a "Bedingung Hochohmigkeit im Leerlauf an PWG-Poti 1 im aktuellen Fahrzyklus" UWORD B_TRUE 1 100 0 1 BIT_MASK 0x20 FORMAT "%13.11" ECU_ADDRESS 0x5B91F0 /end MEASUREMENT
/begin MEASUREMENT B_holp1l "Bedingung Hochohmigkeit im Leerlauf an PWG-Poti 1 im letzten Fahrzyklus" UBYTE B_TRUE 1 100 0 1 BIT_MASK 0x1 FORMAT "%13.11" ECU_ADDRESS 0x3FDC54 /end MEASUREMENT
/begin MEASUREMENT B_holp2 "Bedingung Hochohmigkeit im Leerlauf an PWG-Poti 2 erkannt" UWORD B_TRUE 1 100 0 1 BIT_MASK 0x40 FORMAT "%13.11" ECU_ADDRESS 0x5B91F0 /end MEASUREMENT
/begin MEASUREMENT B_holp2a "Bedingung Hochohmigkeit im Leerlauf an PWG-Poti 2 im aktuellen Fahrzyklus" UWORD B_TRUE 1 100 0 1 BIT_MASK 0x80 FORMAT "%13.11" ECU_ADDRESS 0x5B91F0 /end MEASUREMENT
/begin MEASUREMENT B_holp2l "Bedingung Hochohmigkeit im Leerlauf an PWG-Poti 2 im letzten Fahrzyklus" UBYTE B_TRUE 1 100 0 1 BIT_MASK 0x2 FORMAT "%13.11" ECU_ADDRESS 0x3FDC54 /end MEASUREMENT
/begin MEASUREMENT B_hop1mn "Bedingung Bereichsverletzung nach unten an Poti 1 in Hochohmigkeitspr¸fung" UWORD B_TRUE 1 100 0 1 BIT_MASK 0x100 FORMAT "%13.11" ECU_ADDRESS 0x5B91F0 /end MEASUREMENT
/begin MEASUREMENT B_hop2mn "Bedingung Bereichsverletzung nach unten an Poti 2 in Hochohmigkeitspr¸fung" UWORD B_TRUE 1 100 0 1 BIT_MASK 0x200 FORMAT "%13.11" ECU_ADDRESS 0x5B91F0 /end MEASUREMENT
/begin MEASUREMENT B_hopakt "Bedingung Hochohmigkeitspr¸fung aktiv" UWORD B_TRUE 1 100 0 1 BIT_MASK 0x400 FORMAT "%13.11" ECU_ADDRESS 0x5B91F0 /end MEASUREMENT
/begin MEASUREMENT B_hz_tpoff "" UBYTE B_TRUE 1 100 0 1 FORMAT "%13.11" ECU_ADDRESS 0x5B8B43 /end MEASUREMENT
/begin MEASUREMENT B_hz_tpon "" UBYTE B_TRUE 1 100 0 1 FORMAT "%13.11" ECU_ADDRESS 0x5B8B44 /end MEASUREMENT
/begin MEASUREMENT B_imlvhb "Bedingung Luftmasse f¸r B_gdst" UBYTE dez 1 100 0 255 FORMAT "%5.1" ECU_ADDRESS 0x5B8702 /end MEASUREMENT
/begin MEASUREMENT B_kfnb "Bedingung Konstantfahrt nach Beschleunigen" UWORD B_TRUE 1 100 0 1 BIT_MASK 0x20 FORMAT "%13.11" ECU_ADDRESS 0x5B90E4 /end MEASUREMENT
/begin MEASUREMENT B_kfnv "Bedingung Konstantfahrt nach Verzˆgern" UWORD B_TRUE 1 100 0 1 BIT_MASK 0x40 FORMAT "%13.11" ECU_ADDRESS 0x5B90E4 /end MEASUREMENT
/begin MEASUREMENT B_krmfok "Bedingung: Berechnung des Messfensters abgeschlossen" UBYTE B_TRUE 1 100 0 1 BIT_MASK 0x1 FORMAT "%13.11" ECU_ADDRESS 0x3FBDDE /end MEASUREMENT
/begin MEASUREMENT B_kuppl "Bedingung Kupplung bet‰tigt" UBYTE B_TRUE 1 100 0 1 BIT_MASK 0x1 FORMAT "%13.11" ECU_ADDRESS 0x3FBDB2 /end MEASUREMENT
/begin MEASUREMENT B_kupplv "Bedingung Kupplung bet‰tigt verzˆgert" UBYTE B_TRUE 1 100 0 1 BIT_MASK 0x1 FORMAT "%13.11" ECU_ADDRESS 0x3FBDB3 /end MEASUREMENT
/begin MEASUREMENT B_lawlon "lamwl_w ist aktiv" UBYTE B_TRUE 1 100 0 1 BIT_MASK 0x1 FORMAT "%13.11" ECU_ADDRESS 0x3FBD8A /end MEASUREMENT
/begin MEASUREMENT B_lltd "Leerlauf teilgedrosselt" UBYTE dez 1 100 0 255 FORMAT "%5.1" ECU_ADDRESS 0x5B8703 /end MEASUREMENT
/begin MEASUREMENT B_mbvh "Bedingung Miﬂbrauchsverhinderung" UBYTE B_TRUE 1 100 0 1 BIT_MASK 0x1 FORMAT "%13.11" ECU_ADDRESS 0x3FBDB9 /end MEASUREMENT
/begin MEASUREMENT B_mfl "Bedingung: MFL vorhanden" UBYTE B_TRUE 1 100 0 1 BIT_MASK 0x1 FORMAT "%13.11" ECU_ADDRESS 0x3FDC60 /end MEASUREMENT
/begin MEASUREMENT B_mflon "" UBYTE B_TRUE 1 100 0 1 BIT_MASK 0x1 FORMAT "%13.11" ECU_ADDRESS 0x5B8B57 /end MEASUREMENT
/begin MEASUREMENT B_mnmflv "Bedingung MFL-Signal weist Frequenzfehler auf" UBYTE B_TRUE 1 100 0 1 BIT_MASK 0x1 FORMAT "%13.11" ECU_ADDRESS 0x5B8B58 /end MEASUREMENT
/begin MEASUREMENT B_mrfamx "Vorlagerungswinkel ¸ber maximales Fahrerwunschmomment aktiv" UBYTE B_TRUE 1 100 0 1 BIT_MASK 0x1 FORMAT "%13.11" ECU_ADDRESS 0x5B8B45 /end MEASUREMENT
/begin MEASUREMENT B_mxmflv "Bedingung MFL-Signal weist Toggelbitfehler auf" UBYTE B_TRUE 1 100 0 1 BIT_MASK 0x1 FORMAT "%13.11" ECU_ADDRESS 0x5B8B59 /end MEASUREMENT
/begin MEASUREMENT B_npmflv "Bedingung MFL-Signal nicht plausibel" UBYTE B_TRUE 1 100 0 1 BIT_MASK 0x1 FORMAT "%13.11" ECU_ADDRESS 0x5B8B5A /end MEASUREMENT
/begin MEASUREMENT B_ntini "KR: Bedingung f¸r Initialisierungs-Nulltest" UBYTE B_TRUE 1 100 0 1 BIT_MASK 0x1 FORMAT "%13.11" ECU_ADDRESS 0x3FBDDF /end MEASUREMENT
/begin MEASUREMENT B_ot_isr "" UBYTE B_TRUE 1 100 0 1 BIT_MASK 0x1 FORMAT "%13.11" ECU_ADDRESS 0x3FBDE0 /end MEASUREMENT
/begin MEASUREMENT B_priph "Bedingung Port schalten f¸r Pumpimpuls hinter KAT" UBYTE B_TRUE 1 100 0 1 BIT_MASK 0x1 FORMAT "%13.11" ECU_ADDRESS 0x3FBE00 /end MEASUREMENT
/begin MEASUREMENT B_pripv "Bedingung Port schalten f¸r Pumpimpuls vor KAT" UBYTE B_TRUE 1 100 0 1 BIT_MASK 0x1 FORMAT "%13.11" ECU_ADDRESS 0x3FBDE7 /end MEASUREMENT
/begin MEASUREMENT B_pripv2 "Bedingung Port schalten f¸r Pumpimpuls vor KAT Bank2" UBYTE B_TRUE 1 100 0 1 BIT_MASK 0x1 FORMAT "%13.11" ECU_ADDRESS 0x3FBDE8 /end MEASUREMENT
/begin MEASUREMENT B_pump "Bedingung Starten des Timers TTGLS" UBYTE B_TRUE 1 100 0 1 BIT_MASK 0x1 FORMAT "%13.11" ECU_ADDRESS 0x3FBE01 /end MEASUREMENT
/begin MEASUREMENT B_pwgbwf "Bedingung PWG-Bewegungsfehler" UBYTE B_TRUE 1 100 0 1 BIT_MASK 0x80 FORMAT "%13.11" ECU_ADDRESS 0x5B8EBE /end MEASUREMENT
/begin MEASUREMENT B_pwgnotfr "FR-Fehlerreaktion PWG-Notfahren" UBYTE B_TRUE 1 100 0 1 BIT_MASK 0x1 FORMAT "%13.11" ECU_ADDRESS 0x3FBDBA /end MEASUREMENT
/begin MEASUREMENT B_riakh "Bedingung f¸r Strom-Pumpen aktualisiert hinter KAT" UBYTE B_TRUE 1 100 0 1 BIT_MASK 0x1 FORMAT "%13.11" ECU_ADDRESS 0x3FBE02 /end MEASUREMENT
/begin MEASUREMENT B_riakv "Bedingung f¸r Strom-Pumpen aktualisiert vor KAT" UBYTE B_TRUE 1 100 0 1 BIT_MASK 0x1 FORMAT "%13.11" ECU_ADDRESS 0x3FBDE9 /end MEASUREMENT
/begin MEASUREMENT B_riakv2 "Bedingung f¸r Strom-Pumpen aktualisiert vor KAT Bank2" UBYTE B_TRUE 1 100 0 1 BIT_MASK 0x1 FORMAT "%13.11" ECU_ADDRESS 0x3FBDEA /end MEASUREMENT
/begin MEASUREMENT B_ribeh "Bedingung Innenwiderstand Ri berechnen f¸r Sonde hinter KAT" UBYTE B_TRUE 1 100 0 1 BIT_MASK 0x1 FORMAT "%13.11" ECU_ADDRESS 0x3FBE03 /end MEASUREMENT
/begin MEASUREMENT B_ribev "Bedingung Innenwiderstand Ri berechnen f¸r Sonde vor KAT" UBYTE B_TRUE 1 100 0 1 BIT_MASK 0x1 FORMAT "%13.11" ECU_ADDRESS 0x3FBDEB /end MEASUREMENT
/begin MEASUREMENT B_ribev2 "Bedingung Resultat f¸r Innenwiderstand Ri f¸r Sonde vor KAT Bank2" UBYTE B_TRUE 1 100 0 1 BIT_MASK 0x1 FORMAT "%13.11" ECU_ADDRESS 0x3FBDEC /end MEASUREMENT
/begin MEASUREMENT B_riibh "Bedingung Sondenspannung im zul‰ssigen Band f¸r Strompumpen hinter KAT" UBYTE B_TRUE 1 100 0 1 BIT_MASK 0x1 FORMAT "%13.11" ECU_ADDRESS 0x3FBE04 /end MEASUREMENT
/begin MEASUREMENT B_riibv "Bedingung Sondenspannung im zul‰ssigen Band f¸r Strompumpen vor KAT" UBYTE B_TRUE 1 100 0 1 BIT_MASK 0x1 FORMAT "%13.11" ECU_ADDRESS 0x3FBDED /end MEASUREMENT
/begin MEASUREMENT B_riibv2 "Bedingung Sondenspannung im zul‰ssigen Band f¸r Strompumpen vor KAT Bank2" UBYTE B_TRUE 1 100 0 1 BIT_MASK 0x1 FORMAT "%13.11" ECU_ADDRESS 0x3FBDEE /end MEASUREMENT
/begin MEASUREMENT B_riimph "Bedingung Impuls f¸r Strom-Pumpen hinter KAT" UBYTE B_TRUE 1 100 0 1 BIT_MASK 0x1 FORMAT "%13.11" ECU_ADDRESS 0x3FBE05 /end MEASUREMENT
/begin MEASUREMENT B_riimpv "Bedingung Impuls f¸r Strom-Pumpen vor KAT" UBYTE B_TRUE 1 100 0 1 BIT_MASK 0x1 FORMAT "%13.11" ECU_ADDRESS 0x3FBDEF /end MEASUREMENT
/begin MEASUREMENT B_rimh "Bedingung (ADC-Trigger) f¸r Messen belastete Sondenspannung hinter KAT" UBYTE B_TRUE 1 100 0 1 BIT_MASK 0x1 FORMAT "%13.11" ECU_ADDRESS 0x3FBE06 /end MEASUREMENT
/begin MEASUREMENT B_rimv "Bedingung (ADC-Trigger) f¸r Messen belastete Sondenspannung vor KAT" UBYTE B_TRUE 1 100 0 1 BIT_MASK 0x1 FORMAT "%13.11" ECU_ADDRESS 0x3FBDF0 /end MEASUREMENT
/begin MEASUREMENT B_rimv2 "Bedingung (ADC-Trigger) f¸r Messen belastete Sondenspannung vor KAT Bank2" UBYTE B_TRUE 1 100 0 1 BIT_MASK 0x1 FORMAT "%13.11" ECU_ADDRESS 0x3FBDF1 /end MEASUREMENT
/begin MEASUREMENT B_rinh "Bedingung Innenwiderstand Ri-Messung der Nernstsonde aktiv hinter Kat" UBYTE B_TRUE 1 100 0 1 BIT_MASK 0x1 FORMAT "%13.11" ECU_ADDRESS 0x3FBE07 /end MEASUREMENT
/begin MEASUREMENT B_rinv "Bedingung Innenwiderstand Ri-Messung der Nernstsonde aktiv vor Kat" UBYTE B_TRUE 1 100 0 1 BIT_MASK 0x1 FORMAT "%13.11" ECU_ADDRESS 0x3FBDF2 /end MEASUREMENT
/begin MEASUREMENT B_rinv2 "Bedingung Innenwiderstand Ri-Messung der Nernstsonde aktiv vor Kat Bank2" UBYTE B_TRUE 1 100 0 1 BIT_MASK 0x1 FORMAT "%13.11" ECU_ADDRESS 0x3FBDF3 /end MEASUREMENT
/begin MEASUREMENT B_ripuh "Bedingung Strom-Pumpen f¸r Sonde hinter KAT" UBYTE B_TRUE 1 100 0 1 BIT_MASK 0x1 FORMAT "%13.11" ECU_ADDRESS 0x3FBE08 /end MEASUREMENT
/begin MEASUREMENT B_ripuv "Bedingung Strom-Pumpen f¸r Sonde vor KAT" UBYTE B_TRUE 1 100 0 1 BIT_MASK 0x1 FORMAT "%13.11" ECU_ADDRESS 0x3FBDF4 /end MEASUREMENT
/begin MEASUREMENT B_ripuv2 "Bedingung Strom-Pumpen f¸r Sonde vor KAT Bank2" UBYTE B_TRUE 1 100 0 1 BIT_MASK 0x1 FORMAT "%13.11" ECU_ADDRESS 0x3FBDF5 /end MEASUREMENT
/begin MEASUREMENT B_rireh "Bedingung Resultat f¸r Innenwiderstand Ri f¸r Sonde hinter KAT" UBYTE B_TRUE 1 100 0 1 BIT_MASK 0x1 FORMAT "%13.11" ECU_ADDRESS 0x3FBE09 /end MEASUREMENT
/begin MEASUREMENT B_rirev "Bedingung Resultat f¸r Innenwiderstand Ri f¸r Sonde vor KAT" UBYTE B_TRUE 1 100 0 1 BIT_MASK 0x1 FORMAT "%13.11" ECU_ADDRESS 0x3FBDF6 /end MEASUREMENT
/begin MEASUREMENT B_rirev2 "Bedingung Resultat f¸r Innenwiderstand Ri f¸r Sonde vor KAT Bank2" UBYTE B_TRUE 1 100 0 1 BIT_MASK 0x1 FORMAT "%13.11" ECU_ADDRESS 0x3FBDF7 /end MEASUREMENT
/begin MEASUREMENT B_risph "Bedingung Sondensprung hinter KAT" UBYTE B_TRUE 1 100 0 1 BIT_MASK 0x1 FORMAT "%13.11" ECU_ADDRESS 0x3FBE0A /end MEASUREMENT
/begin MEASUREMENT B_rispv "Bedingung Sondensprung vor KAT" UBYTE B_TRUE 1 100 0 1 BIT_MASK 0x1 FORMAT "%13.11" ECU_ADDRESS 0x3FBDF8 /end MEASUREMENT
/begin MEASUREMENT B_rispv2 "Bedingung Sondensprung vor KAT Bank2" UBYTE B_TRUE 1 100 0 1 BIT_MASK 0x1 FORMAT "%13.11" ECU_ADDRESS 0x3FBDF9 /end MEASUREMENT
/begin MEASUREMENT B_savfgr "Bedingung: Schubabschalteverbot durch FGR" UBYTE B_TRUE 1 100 0 1 BIT_MASK 0x1 FORMAT "%13.11" ECU_ADDRESS 0x3FBD1A /end MEASUREMENT
/begin MEASUREMENT B_savm "Bedingung: Schubabschalteverbot durch FGR (aus ME)" UBYTE B_TRUE 1 100 0 1 BIT_MASK 0x1 FORMAT "%13.11" ECU_ADDRESS 0x3FBD16 /end MEASUREMENT
/begin MEASUREMENT B_shuerf "Bedingung Sondenspannung hinter KAT erfassen" UBYTE B_TRUE 1 100 0 1 BIT_MASK 0x1 FORMAT "%13.11" ECU_ADDRESS 0x3FBE0B /end MEASUREMENT
/begin MEASUREMENT B_simflv "Bedingung MFL-Signal Timeout" UBYTE B_TRUE 1 100 0 1 BIT_MASK 0x1 FORMAT "%13.11" ECU_ADDRESS 0x5B8B5B /end MEASUREMENT
/begin MEASUREMENT B_sp1s "Mitteilung an SR: SP1S ist F¸hrungsgrˆﬂe." UBYTE B_TRUE 1 100 0 1 BIT_MASK 0x1 FORMAT "%13.11" ECU_ADDRESS 0x3FBDBB /end MEASUREMENT
/begin MEASUREMENT B_sp2s "Mitteilung an SR:Poti2 SP2S F¸hrungsgrˆﬂe,Poti1 Ober-oder Untergrenze ¸berschr." UBYTE B_TRUE 1 100 0 1 BIT_MASK 0x1 FORMAT "%13.11" ECU_ADDRESS 0x3FBDBC /end MEASUREMENT
/begin MEASUREMENT B_spsmin "Mitteilung an SR: '1'= PWG-Notfahren mit SPSMIN" UBYTE B_TRUE 1 100 0 1 BIT_MASK 0x1 FORMAT "%13.11" ECU_ADDRESS 0x3FBDBD /end MEASUREMENT
/begin MEASUREMENT B_staebr "Bedingung Steckerabfall-Erkennung Bremse" UBYTE B_TRUE 1 100 0 1 BIT_MASK 0x1 FORMAT "%13.11" ECU_ADDRESS 0x3FBDB4 /end MEASUREMENT
/begin MEASUREMENT B_stmerker "Merker f¸r erfolgten Start" UBYTE dez 1 100 0 255 FORMAT "%5.1" ECU_ADDRESS 0x5B8704 /end MEASUREMENT
/begin MEASUREMENT B_svuerf "Bedingung Sondenspannung vor KAT erfassen" UBYTE B_TRUE 1 100 0 1 BIT_MASK 0x1 FORMAT "%13.11" ECU_ADDRESS 0x3FBDFA /end MEASUREMENT
/begin MEASUREMENT B_svuerf2 "Bedingung Sondenspannung vor KAT erfassen Bank2" UBYTE B_TRUE 1 100 0 1 BIT_MASK 0x1 FORMAT "%13.11" ECU_ADDRESS 0x3FBDFB /end MEASUREMENT
/begin MEASUREMENT B_swknb "Bedingung Setzwertkorrektur nach Beschleunigen" UWORD B_TRUE 1 100 0 1 BIT_MASK 0x80 FORMAT "%13.11" ECU_ADDRESS 0x5B90E4 /end MEASUREMENT
/begin MEASUREMENT B_swknv "Bedingung Setzwertkorrektur nach Verzˆgern" UWORD B_TRUE 1 100 0 1 BIT_MASK 0x100 FORMAT "%13.11" ECU_ADDRESS 0x5B90E4 /end MEASUREMENT
/begin MEASUREMENT B_taerr "Bedingung Ansaugluftfehler" UBYTE B_TRUE 1 100 0 1 FORMAT "%13.11" ECU_ADDRESS 0x5B8938 /end MEASUREMENT
/begin MEASUREMENT B_tal "Bedingung Tank leer bzw. Reserve" UWORD B_TRUE 1 100 0 1 BIT_MASK 0x40 FORMAT "%13.11" ECU_ADDRESS 0x5B8788 /end MEASUREMENT
/begin MEASUREMENT B_talval "Bedingung : Bit Tank leer g¸ltig" UWORD B_TRUE 1 100 0 1 BIT_MASK 0x80 FORMAT "%13.11" ECU_ADDRESS 0x5B8788 /end MEASUREMENT
/begin MEASUREMENT B_tav "Bedingung Tank voll" UWORD B_TRUE 1 100 0 1 BIT_MASK 0x10 FORMAT "%13.11" ECU_ADDRESS 0x5B8788 /end MEASUREMENT
/begin MEASUREMENT B_tbenh "Bedingung Taste Beschleunigen negative Flanke nach Halten" UWORD B_TRUE 1 100 0 1 BIT_MASK 0x200 FORMAT "%13.11" ECU_ADDRESS 0x5B90E4 /end MEASUREMENT
/begin MEASUREMENT B_tbent "Bedingung Taste Beschleunigen negative Flanke nach Tip" UWORD B_TRUE 1 100 0 1 BIT_MASK 0x400 FORMAT "%13.11" ECU_ADDRESS 0x5B90E4 /end MEASUREMENT
/begin MEASUREMENT B_tbep "Bedingung Taste Beschleunigen positive Flanke" UWORD B_TRUE 1 100 0 1 BIT_MASK 0x800 FORMAT "%13.11" ECU_ADDRESS 0x5B90E4 /end MEASUREMENT
/begin MEASUREMENT B_tbeph "Bedingung Taste Beschleunigen positive Flanke Halten" UWORD B_TRUE 1 100 0 1 BIT_MASK 0x1000 FORMAT "%13.11" ECU_ADDRESS 0x5B90E4 /end MEASUREMENT
/begin MEASUREMENT B_tctoggle "Toggelbit der MFL-Botschaft" UBYTE B_TRUE 1 100 0 1 BIT_MASK 0x1 FORMAT "%13.11" ECU_ADDRESS 0x5B8B5C /end MEASUREMENT
/begin MEASUREMENT B_tdfuereg "Regler f¸r Druck teilgedrosselt l‰uft" UBYTE dez 1 100 0 255 FORMAT "%5.1" ECU_ADDRESS 0x5B8705 /end MEASUREMENT
/begin MEASUREMENT B_tfwdksom "Zeitkonstante f¸r Filterung Drosselklappenwinkel ohne Momentenstruktur aktiv" UBYTE dez 1 100 0 255 FORMAT "%5.1" ECU_ADDRESS 0x5B870A /end MEASUREMENT
/begin MEASUREMENT B_tpderl "Bedingung Tip-Down erlaubt" UWORD B_TRUE 1 100 0 1 BIT_MASK 0x2000 FORMAT "%13.11" ECU_ADDRESS 0x5B90E4 /end MEASUREMENT
/begin MEASUREMENT B_tpdn "Bedingung FGR im Zustand Tip-Down" UWORD B_TRUE 1 100 0 1 BIT_MASK 0x4000 FORMAT "%13.11" ECU_ADDRESS 0x5B90E4 /end MEASUREMENT
/begin MEASUREMENT B_tpnt_aw "KR: Auswahl Nulltest oder Testimpuls" UBYTE B_TRUE 1 100 0 1 BIT_MASK 0x1 FORMAT "%13.11" ECU_ADDRESS 0x3FBDE1 /end MEASUREMENT
/begin MEASUREMENT B_tpnt_e "KR: Nulltest/Testimpuls freigegeben" UBYTE B_TRUE 1 100 0 1 BIT_MASK 0x1 FORMAT "%13.11" ECU_ADDRESS 0x3FBDE2 /end MEASUREMENT
/begin MEASUREMENT B_tpuerl "Bedingung Tip-Up erlaubt" UWORD B_TRUE 1 100 0 1 BIT_MASK 0x8000 FORMAT "%13.11" ECU_ADDRESS 0x5B90E4 /end MEASUREMENT
/begin MEASUREMENT B_tpup "Bedingung FGR im Zustand Tip-Up" UWORD B_TRUE 1 100 0 1 BIT_MASK 0x1 FORMAT "%13.11" ECU_ADDRESS 0x5B90E6 /end MEASUREMENT
/begin MEASUREMENT B_tsenh "Bedingung Taste Setzen negative Flanke nach Halten" UWORD B_TRUE 1 100 0 1 BIT_MASK 0x2 FORMAT "%13.11" ECU_ADDRESS 0x5B90E6 /end MEASUREMENT
/begin MEASUREMENT B_tsent "Bedingung Taste setzen negative Flanke nach Tip" UWORD B_TRUE 1 100 0 1 BIT_MASK 0x4 FORMAT "%13.11" ECU_ADDRESS 0x5B90E6 /end MEASUREMENT
/begin MEASUREMENT B_tumers "Bedingung Ansaugluftersatzwert" UBYTE B_TRUE 1 100 0 1 FORMAT "%13.11" ECU_ADDRESS 0x5B8939 /end MEASUREMENT
/begin MEASUREMENT B_tvenh "Bedingung Taste Verzˆgern negative Flanke nach Halten" UWORD B_TRUE 1 100 0 1 BIT_MASK 0x8 FORMAT "%13.11" ECU_ADDRESS 0x5B90E6 /end MEASUREMENT
/begin MEASUREMENT B_tvent "Bedingung Taste Verzˆgern negative Flanke nach Tip" UWORD B_TRUE 1 100 0 1 BIT_MASK 0x10 FORMAT "%13.11" ECU_ADDRESS 0x5B90E6 /end MEASUREMENT
/begin MEASUREMENT B_tvep "Bedingung Taste Verzˆgern positive Flanke" UWORD B_TRUE 1 100 0 1 BIT_MASK 0x20 FORMAT "%13.11" ECU_ADDRESS 0x5B90E6 /end MEASUREMENT
/begin MEASUREMENT B_tveph "Bedingung Taste Verzˆgern positive Flanke Halten" UWORD B_TRUE 1 100 0 1 BIT_MASK 0x40 FORMAT "%13.11" ECU_ADDRESS 0x5B90E6 /end MEASUREMENT
/begin MEASUREMENT B_twap "Bedingung Taste Wiederaufnahme positive Fanke" UWORD B_TRUE 1 100 0 1 BIT_MASK 0x80 FORMAT "%13.11" ECU_ADDRESS 0x5B90E6 /end MEASUREMENT
/begin MEASUREMENT B_ubvdkp "Bedingung Batteriespannung ausreichend f¸r Verst‰rkung von DK-Poti 1" UBYTE B_TRUE 1 100 0 1 BIT_MASK 0x1 FORMAT "%13.11" ECU_ADDRESS 0x3FBC74 /end MEASUREMENT
/begin MEASUREMENT B_udk1nv "Bedingung Spannung DK-Poti 1 oberhalb des Verst‰rkungsbereichs" UBYTE B_TRUE 1 100 0 1 BIT_MASK 0x1 FORMAT "%13.11" ECU_ADDRESS 0x3FBC75 /end MEASUREMENT
/begin MEASUREMENT B_uebetu "Bedingung ‹bergang Beschleunigen nach Tip-Up erfolgt" UWORD B_TRUE 1 100 0 1 BIT_MASK 0x100 FORMAT "%13.11" ECU_ADDRESS 0x5B90E6 /end MEASUREMENT
/begin MEASUREMENT B_uebrkf "Bedingung ‹bergang von begrenzter Rampe nach Konstantfahrt erfolgt" UWORD B_TRUE 1 100 0 1 BIT_MASK 0x200 FORMAT "%13.11" ECU_ADDRESS 0x5B90E6 /end MEASUREMENT
/begin MEASUREMENT B_uebvau "Bedingung ‹bergang von Beschleunigen oder Verzˆgern nach Aus erfolgt" UWORD B_TRUE 1 100 0 1 BIT_MASK 0x400 FORMAT "%13.11" ECU_ADDRESS 0x5B90E6 /end MEASUREMENT
/begin MEASUREMENT B_uevztd "Bedingung ‹bergang von Verzˆgern nach Tip-Down erfolgt" UWORD B_TRUE 1 100 0 1 BIT_MASK 0x800 FORMAT "%13.11" ECU_ADDRESS 0x5B90E6 /end MEASUREMENT
/begin MEASUREMENT B_upw12e "Bedingung: Fehler bei Vergleich der beiden normierten PWG-Poti-Spannungen" UBYTE B_TRUE 1 100 0 1 BIT_MASK 0x4 FORMAT "%13.11" ECU_ADDRESS 0x5B8EBE /end MEASUREMENT
/begin MEASUREMENT B_upw1mn "Bedingung: Spannung PWG-Poti 1 unterhalb Minimalwert" UBYTE B_TRUE 1 100 0 1 BIT_MASK 0x8 FORMAT "%13.11" ECU_ADDRESS 0x5B8EBE /end MEASUREMENT
/begin MEASUREMENT B_upw1mx "Bedingung: Spannung PWG-Poti 1 oberhalb Maximalwert" UBYTE B_TRUE 1 100 0 1 BIT_MASK 0x10 FORMAT "%13.11" ECU_ADDRESS 0x5B8EBE /end MEASUREMENT
/begin MEASUREMENT B_upw2mn "Bedingung: Spannung PWG-Poti 2 unterhalb Minimalwert" UBYTE B_TRUE 1 100 0 1 BIT_MASK 0x20 FORMAT "%13.11" ECU_ADDRESS 0x5B8EBE /end MEASUREMENT
/begin MEASUREMENT B_upw2mx "Bedingung: Spannung PWG-Poti 2 oberhalb Maximalwert" UBYTE B_TRUE 1 100 0 1 BIT_MASK 0x40 FORMAT "%13.11" ECU_ADDRESS 0x5B8EBE /end MEASUREMENT
/begin MEASUREMENT B_upwbwf "Bewegungserkennung hat im aktuellen Fahrzyklus einen Fehler erkannt" UBYTE B_TRUE 1 100 0 1 BIT_MASK 0x1 FORMAT "%13.11" ECU_ADDRESS 0x3FBDBE /end MEASUREMENT
/begin MEASUREMENT B_upwg1o "Bedingung Bereichsverletzung an PWG-Poti 1 nach oben" UWORD B_TRUE 1 100 0 1 BIT_MASK 0x800 FORMAT "%13.11" ECU_ADDRESS 0x5B91F0 /end MEASUREMENT
/begin MEASUREMENT B_upwg1u "Bedingung Bereichsverletzung an PWG-Poti 1 nach unten" UWORD B_TRUE 1 100 0 1 BIT_MASK 0x1000 FORMAT "%13.11" ECU_ADDRESS 0x5B91F0 /end MEASUREMENT
/begin MEASUREMENT B_upwg2o "Bedingung Bereichsverletzung an PWG-Poti 2 nach oben" UBYTE B_TRUE 1 100 0 1 BIT_MASK 0x1 FORMAT "%13.11" ECU_ADDRESS 0x5B8EBE /end MEASUREMENT
/begin MEASUREMENT B_upwg2u "Bedingung Bereichsverletzung an PWG-Poti 2 nach unten" UBYTE B_TRUE 1 100 0 1 BIT_MASK 0x2 FORMAT "%13.11" ECU_ADDRESS 0x5B8EBE /end MEASUREMENT
/begin MEASUREMENT B_usbeh "Bedingung f¸r Zeitz‰hler zur Ausblendung der Sondenbelastung hinter KAT" UBYTE B_TRUE 1 100 0 1 BIT_MASK 0x1 FORMAT "%13.11" ECU_ADDRESS 0x3FBE0C /end MEASUREMENT
/begin MEASUREMENT B_usbev "Bedingung f¸r Zeitz‰hler zur Ausblendung der Sondenbelastung vor KAT" UBYTE B_TRUE 1 100 0 1 BIT_MASK 0x1 FORMAT "%13.11" ECU_ADDRESS 0x3FBDFC /end MEASUREMENT
/begin MEASUREMENT B_usbev2 "Bedingung f¸r Zeitz‰hler zur Ausblendung der Sondenbelastung vor KAT Bank 2" UBYTE B_TRUE 1 100 0 1 BIT_MASK 0x1 FORMAT "%13.11" ECU_ADDRESS 0x3FBDFD /end MEASUREMENT
/begin MEASUREMENT B_wavo "Bedingung Wiederaufnahme von oben" UWORD B_TRUE 1 100 0 1 BIT_MASK 0x2 FORMAT "%13.11" ECU_ADDRESS 0x5B90E4 /end MEASUREMENT
/begin MEASUREMENT B_wdk12ev "Bedingung Vorl‰ufiger Gleichlauffehler der DK-Potis" UBYTE B_TRUE 1 100 0 1 BIT_MASK 0x1 FORMAT "%13.11" ECU_ADDRESS 0x3FBC76 /end MEASUREMENT
/begin MEASUREMENT B_wdk13ev "Bedingung Vorl‰ufige Unplausibilit‰t zw. DK-Poti 1 und Ersatzwert aus F¸llung" UBYTE B_TRUE 1 100 0 1 BIT_MASK 0x1 FORMAT "%13.11" ECU_ADDRESS 0x3FBC77 /end MEASUREMENT
/begin MEASUREMENT B_wdk1v "Bedingung Berechnung des DK-Winkels aus verst‰rktem Signal von Poti 1" UBYTE B_TRUE 1 100 0 1 BIT_MASK 0x1 FORMAT "%13.11" ECU_ADDRESS 0x3FBC78 /end MEASUREMENT
/begin MEASUREMENT B_wdk23ev "Bedingung Vorl‰ufige Unplausibilit‰t zw. DK-Poti 2 und Ersatzwert aus F¸llung" UBYTE B_TRUE 1 100 0 1 BIT_MASK 0x1 FORMAT "%13.11" ECU_ADDRESS 0x3FBC79 /end MEASUREMENT
/begin MEASUREMENT B_wdk2sel "Bedingung DK-Winkel-Berechnung f¸r Lageregler aus Poti 2" UBYTE B_TRUE 1 100 0 1 BIT_MASK 0x1 FORMAT "%13.11" ECU_ADDRESS 0x3FBC7A /end MEASUREMENT
/begin MEASUREMENT B_wdk2st "Bedingung DK-Winkel-Berechnung f¸r Lageregler tempor‰r aus Poti 2" UBYTE B_TRUE 1 100 0 1 BIT_MASK 0x1 FORMAT "%13.11" ECU_ADDRESS 0x3FBC7B /end MEASUREMENT
/begin MEASUREMENT B_wdksom "Drosselklappensollwinkel ohne Momentenstruktur aktiv" UBYTE dez 1 100 0 255 FORMAT "%5.1" ECU_ADDRESS 0x5B870B /end MEASUREMENT
/begin MEASUREMENT B_wiauf "Bedingung FGR im Zustand Wiederaufnahme" UWORD B_TRUE 1 100 0 1 BIT_MASK 0x1000 FORMAT "%13.11" ECU_ADDRESS 0x5B90E6 /end MEASUREMENT
/begin MEASUREMENT B_wpabnb "Bedingung ƒnderungsbegrenzung des Pedalwerts nach Bremsbet‰tigung" UBYTE B_TRUE 1 100 0 1 BIT_MASK 0x1 FORMAT "%13.11" ECU_ADDRESS 0x3FBDBF /end MEASUREMENT
/begin MEASUREMENT B_wpmbbr "Bedingung Maximalbegrenzung des Pedalwerts bei Bremsbet‰tigung" UBYTE B_TRUE 1 100 0 1 BIT_MASK 0x1 FORMAT "%13.11" ECU_ADDRESS 0x3FBDC0 /end MEASUREMENT
/begin MEASUREMENT counter_mfa "" UWORD dez 1 100 0 65535 FORMAT "%8.2" ECU_ADDRESS 0x5B9686 /end MEASUREMENT
/begin MEASUREMENT counter_mfe "" UWORD dez 1 100 0 65535 FORMAT "%8.2" ECU_ADDRESS 0x5B9688 /end MEASUREMENT
/begin MEASUREMENT cpaw1 "Z‰hler f¸r Poti 1 bei DK-Poti-Auswahl" UBYTE dez 1 100 0 255 FORMAT "%5.1" ECU_ADDRESS 0x5B8E39 /end MEASUREMENT
/begin MEASUREMENT cpaw2 "Z‰hler f¸r Poti 2 bei DK-Poti-Auswahl" UBYTE dez 1 100 0 255 FORMAT "%5.1" ECU_ADDRESS 0x5B8E3A /end MEASUREMENT
/begin MEASUREMENT ctdkp1 "Fehlerzeitz‰hler f¸r Bereichspr¸fung DK-Poti 1" UBYTE t10msxs_ub_b2p55 1 100 0 2.55 FORMAT "%5.3" ECU_ADDRESS 0x5B8E3B /end MEASUREMENT
/begin MEASUREMENT ctdkp2 "Fehlerzeitz‰hler f¸r Bereichspr¸fung DK-Poti 2" UBYTE t10msxs_ub_b2p55 1 100 0 2.55 FORMAT "%5.3" ECU_ADDRESS 0x5B8E3C /end MEASUREMENT
/begin MEASUREMENT ctdkpaw "Zeitz‰hler f¸r DK-Poti-Auswahl" UBYTE t10msxs_ub_b2p55 1 100 0 2.55 FORMAT "%5.3" ECU_ADDRESS 0x5B8E3D /end MEASUREMENT
/begin MEASUREMENT ctrbwf "Fehlerz‰hler Bewegungserkennung" UBYTE dez 1 100 0 255 FORMAT "%5.1" ECU_ADDRESS 0x5B8EBC /end MEASUREMENT
/begin MEASUREMENT ctrerbr "Fehlerz‰hler f¸r Bremsschalter-Plausibilisierung" UBYTE dez 1 100 0 255 FORMAT "%5.1" ECU_ADDRESS 0x5B877C /end MEASUREMENT
/begin MEASUREMENT ctwdk12 "Fehlerzeitz‰hler f¸r Gleichlaufpr¸fung der DK-Potis" UBYTE t10msxs_ub_b2p55 1 100 0 2.55 FORMAT "%5.3" ECU_ADDRESS 0x5B8E3E /end MEASUREMENT
/begin MEASUREMENT ctwdk13 "Fehlerzeitz‰hler f¸r Plausibilit‰tspr¸fung DK-Poti 1 mit Ersatzwert aus F¸llung" UBYTE t10msxs_ub_b2p55 1 100 0 2.55 FORMAT "%5.3" ECU_ADDRESS 0x5B8E3F /end MEASUREMENT
/begin MEASUREMENT ctwdk23 "Fehlerzeitz‰hler f¸r Plausibilit‰tspr¸fung DK-Poti 2 mit Ersatzwert aus F¸llung" UBYTE t10msxs_ub_b2p55 1 100 0 2.55 FORMAT "%5.3" ECU_ADDRESS 0x5B8E40 /end MEASUREMENT
/begin MEASUREMENT ddps_w "Differenz delta Saugrohrdruck Vorsteuerung zu delta Saugrohrdruck gemessen" SWORD p_q0p039 1 100 -1280 1279.96 FORMAT "%8.3" ECU_ADDRESS 0x5B9602 /end MEASUREMENT
/begin MEASUREMENT dmnpbkv_w "Delta um das modellierter Bremskraftverst‰rkerdruck minimiert wird" SWORD pgrad_q0p15625 1 100 -5120 5119.84 FORMAT "%8.3" ECU_ADDRESS 0x5B879E /end MEASUREMENT
/begin MEASUREMENT dmrar_w "Delta Relatives Moment bei Abschaltrampe FGR" UWORD rel_uw_b200 1 100 0 199.997 FORMAT "%8.4" ECU_ADDRESS 0x5B90D8 /end MEASUREMENT
/begin MEASUREMENT dmxpbkv_w "Delta um das modellierter Bremskraftverst‰rkerdruck vergrˆﬂert wird" UWORD pgrad_q0p15625 1 100 0 10239.8 FORMAT "%8.2" ECU_ADDRESS 0x5B87A0 /end MEASUREMENT
/begin MEASUREMENT dpbkvep_w "Druckgradient w‰hrend Evakuierung des BKV durch el. Pumpe" SWORD pgrad_q0p039 1 100 -1280 1279.96 FORMAT "%8.3" ECU_ADDRESS 0x5B87A2 /end MEASUREMENT
/begin MEASUREMENT dpbkvmx_w "Faktor Druckgradient f¸r Berechnung von dmxpbkv_w" UWORD fak_uw_b8 1 100 0 7.99988 FORMAT "%8.6" ECU_ADDRESS 0x5B87A4 /end MEASUREMENT
/begin MEASUREMENT dpbkvps_w "Druckgradient w‰hrend Evakuierung des BKV durch ps" SWORD pgrad_q0p039 1 100 -1280 1279.96 FORMAT "%8.3" ECU_ADDRESS 0x5B87A6 /end MEASUREMENT
/begin MEASUREMENT dpbkvsp_w "Druckgradient w‰hrend Evakuierung des BKV durch Saugstrahlpumpe" SWORD pgrad_q0p039 1 100 -1280 1279.96 FORMAT "%8.3" ECU_ADDRESS 0x5B87A8 /end MEASUREMENT
/begin MEASUREMENT dpbkvu_w "Differenz zwischen Bremskraftverst‰rker-Druck und Umgebungsdruck" UWORD p_uw_q0p039 1 100 0 2559.96 FORMAT "%8.3" ECU_ADDRESS 0x5B87AA /end MEASUREMENT
/begin MEASUREMENT dpipol "Kennlinieninterpolation aus dp" UWORD fak_uw_b2 1 100 0 1.99997 FORMAT "%8.6" ECU_ADDRESS 0x5B9644 /end MEASUREMENT
/begin MEASUREMENT dpsfak "normierter Faktor delta Saugrohrdruck" UBYTE fak_ub_q0p00392 1 100 0 1 FORMAT "%5.3" ECU_ADDRESS 0x5B8C30 /end MEASUREMENT
/begin MEASUREMENT dpsfakro "normierter Faktor delta Saugrohrdruck vor Kennlinie" UBYTE fak_ub_q0p00392 1 100 0 1 FORMAT "%5.3" ECU_ADDRESS 0x5B8C31 /end MEASUREMENT
/begin MEASUREMENT dpsgedr_w "Differenzdruck Saugrohr gedrosselter Motor aus Modell" SWORD p_q0p039 1 100 -1280 1279.96 FORMAT "%8.3" ECU_ADDRESS 0x5B9604 /end MEASUREMENT
/begin MEASUREMENT dpspvdkd_w "Delta zwischen Saugrohrdruck und Druck vor Drosselklappe" UWORD p_uw_q0p039 1 100 0 2559.96 FORMAT "%8.3" ECU_ADDRESS 0x5B87AC /end MEASUREMENT
/begin MEASUREMENT dpssolad_w "Differenzdruck Saugrohr in FUEDK" UWORD p_q0p039s32768 1 100 -1280 1279.96 FORMAT "%7.2" ECU_ADDRESS 0x5B9646 /end MEASUREMENT
/begin MEASUREMENT dpssolgd_w "Differenzdruck gedrosselter Motor aus Modell" UWORD p_uw_q0p039 1 100 0 2559.96 FORMAT "%8.3" ECU_ADDRESS 0x5B9606 /end MEASUREMENT
/begin MEASUREMENT dpssoltdr_w "" UWORD p_q0p039s32768 1 100 -1280 1279.96 FORMAT "%7.2" ECU_ADDRESS 0x5B9608 /end MEASUREMENT
/begin MEASUREMENT dpssoltd_w "" UWORD p_q0p039s32768 1 100 -1280 1279.96 FORMAT "%7.2" ECU_ADDRESS 0x5B960A /end MEASUREMENT
/begin MEASUREMENT dpssolud_w "Solldifferenzdruck Saugrohr ungedrosselt" SWORD p_q0p039 1 100 -1280 1279.96 FORMAT "%8.3" ECU_ADDRESS 0x5B960C /end MEASUREMENT
/begin MEASUREMENT dpssol_ub "" UBYTE p_q10p0 1 100 0 2550 FORMAT "%5.0" ECU_ADDRESS 0x3FC028 /end MEASUREMENT
/begin MEASUREMENT dpssol_uw "Solldifferenzdruck Saugrohr" UWORD p_q0p039 1 100 0 2559.96 FORMAT "%8.3" ECU_ADDRESS 0x5B960E /end MEASUREMENT
/begin MEASUREMENT dpssol_w "Solldifferenzdruck Saugrohr" SWORD p_q0p039 1 100 -1280 1279.96 FORMAT "%8.3" ECU_ADDRESS 0x5B9610 /end MEASUREMENT
/begin MEASUREMENT dpsuddr_w "Differenzdruck Saugrohr f¸r ‹bergang ungedrosselt in gedrosselt" SWORD p_q0p039 1 100 -1280 1279.96 FORMAT "%8.3" ECU_ADDRESS 0x5B9612 /end MEASUREMENT
/begin MEASUREMENT dpsvvt_w "" UWORD p_q0p039s32768 1 100 -1280 1279.96 FORMAT "%7.2" ECU_ADDRESS 0x5B9614 /end MEASUREMENT
/begin MEASUREMENT dpvdkspu_w "delta zwischen Druck vor Drosselklappe und Umgebungsdruck" UWORD p_uw_q0p039 1 100 0 2559.96 FORMAT "%8.3" ECU_ADDRESS 0x5B87F4 /end MEASUREMENT
/begin MEASUREMENT drlfue_w "Lastkorrektur des F¸llungsreglers" SWORD rel_sw_q0p0234 1 100 -768 767.977 FORMAT "%8.4" ECU_ADDRESS 0x5B9164 /end MEASUREMENT
/begin MEASUREMENT drlm_w "Soll- Istwertdifferenz des Luftmassenreglers" SWORD rel_sw_q0p0234 1 100 -768 767.977 FORMAT "%8.4" ECU_ADDRESS 0x5B9166 /end MEASUREMENT
/begin MEASUREMENT dvrabe_w "Delta Geschwindigkeit bei Beschleunigungsrampe" UWORD vfzg_uw_b512 1 100 0 511.992 FORMAT "%8.4" ECU_ADDRESS 0x5B90DE /end MEASUREMENT
/begin MEASUREMENT dvrave_w "Delta Geschwindigkeit bei Verzˆgerungsrampe" UWORD vfzg_uw_b512 1 100 0 511.992 FORMAT "%8.4" ECU_ADDRESS 0x5B90E0 /end MEASUREMENT
/begin MEASUREMENT dvzvi_w "Differenz zwischen Ziel- und Istgeschwindigkeit" SWORD vfzg_sw_q0p00781 1 100 -256 255.992 FORMAT "%8.4" ECU_ADDRESS 0x5B90E2 /end MEASUREMENT
/begin MEASUREMENT dwdkba_w "Gradient DK-Winkel" SWORD relDK_q0p02441 1 100 -800 799.976 FORMAT "%8.4" ECU_ADDRESS 0x5B90A2 /end MEASUREMENT
/begin MEASUREMENT dwdks_w "ƒnderung des Drosselklappen-Sollwinkels" SWORD rel_sw_b50 1 100 -50 49.9985 FORMAT "%8.5" ECU_ADDRESS 0x5B9648 /end MEASUREMENT
/begin MEASUREMENT dwped "Gradient des normierten Fahrpedalwinkels" SBYTE rel_sb_q0p39 1 100 -49.9968 49.6062 FORMAT "%5.2" ECU_ADDRESS 0x5B8EBD /end MEASUREMENT
/begin MEASUREMENT dwped_w "Gradient des normierten Fahrpedalwinkels" SWORD rel_sw_b50 1 100 -50 49.9985 FORMAT "%8.5" ECU_ADDRESS 0x5B91EE /end MEASUREMENT
/begin MEASUREMENT eprl1 "Entprellter Generatorfehler vorhanden" UBYTE B_TRUE 1 100 0 1 FORMAT "%13.11" ECU_ADDRESS 0x5B893A /end MEASUREMENT
/begin MEASUREMENT eprl2 "Entprellter Kommunikationsfehler vorhanden" UBYTE B_TRUE 1 100 0 1 FORMAT "%13.11" ECU_ADDRESS 0x5B893B /end MEASUREMENT
/begin MEASUREMENT esvw_bit "" UBYTE dez 1 100 0 255 FORMAT "%5.1" ECU_ADDRESS 0x5B8C44 /end MEASUREMENT
/begin MEASUREMENT fdpsdkm_w "Ausgang von KLDPSDKM" UWORD fak_uw_b2 1 100 0 1.99997 FORMAT "%8.6" ECU_ADDRESS 0x5B964A /end MEASUREMENT
/begin MEASUREMENT ffzanz "Anzahl Folgefunken" UBYTE dez 1 100 0 255 FORMAT "%5.1" ECU_ADDRESS 0x5B8FF0 /end MEASUREMENT
/begin MEASUREMENT ffztld_w "Ladezeit Folgefunken" UWORD txms_uw_q0p001 1 100 0 65.535 FORMAT "%8.5" ECU_ADDRESS 0x5B948E /end MEASUREMENT
/begin MEASUREMENT ffztof_w "Offenzeit Folgefunken" UWORD txms_uw_q0p001 1 100 0 65.535 FORMAT "%8.5" ECU_ADDRESS 0x5B9490 /end MEASUREMENT
/begin MEASUREMENT FGRMDlokBits1 "" UWORD dez 1 100 0 65535 FORMAT "%8.2" ECU_ADDRESS 0x5B90E4 /end MEASUREMENT
/begin MEASUREMENT FGRMDlokBits2 "" UWORD dez 1 100 0 65535 FORMAT "%8.2" ECU_ADDRESS 0x5B90E6 /end MEASUREMENT
/begin MEASUREMENT fho "Korrekturfaktor Hˆhe" UBYTE fak_ub_b4 1 100 0 3.98438 FORMAT "%5.3" ECU_ADDRESS 0x5B87F0 /end MEASUREMENT
/begin MEASUREMENT fho_w "Korrekturfaktor Hˆhe (word)" UWORD fak_uw_b4 1 100 0 3.99994 FORMAT "%8.6" ECU_ADDRESS 0x5B87F6 /end MEASUREMENT
/begin MEASUREMENT fkhfm "HFM-Korrekturfaktor" UBYTE fak_ub_b2 1 100 0 1.99219 FORMAT "%5.3" ECU_ADDRESS 0x5B8EB9 /end MEASUREMENT
/begin MEASUREMENT fmfkrakt "Mittenfrequenz f¸r Bandpaﬂfilter Klopfregelung" UBYTE dez 1 100 0 255 FORMAT "%5.1" ECU_ADDRESS 0x5B8ECC /end MEASUREMENT
/begin MEASUREMENT fmfkraktne "Mittenfrequenz f¸r Bandpaﬂfilter Klopfregelung, neuer Wert" UBYTE dez 1 100 0 255 FORMAT "%5.1" ARRAY_SIZE 8 ECU_ADDRESS 0x5B8808 /end MEASUREMENT
/begin MEASUREMENT fpuk "HFM-Korrekturfaktor im Pulsationsbereich" UBYTE fak_ub_b2 1 100 0 1.99219 FORMAT "%5.3" ECU_ADDRESS 0x5B8EBA /end MEASUREMENT
/begin MEASUREMENT fpups_w "Faktor Umgebung zu Saugrohrdruck" UWORD fak_uw_b8 1 100 0 7.99988 FORMAT "%8.6" ECU_ADDRESS 0x5B9616 /end MEASUREMENT
/begin MEASUREMENT fpvdkds "Faktor Druck vor Drosselklappe von Drucksensor" UBYTE fak_ub_b4 1 100 0 3.98438 FORMAT "%5.3" ECU_ADDRESS 0x5B8EC9 /end MEASUREMENT
/begin MEASUREMENT fpvdkdsl_w "Faktor Druck vor Drosselklappe von Ladedrucksensor (word)" UWORD fak_uw_b4 1 100 0 3.99994 FORMAT "%8.6" ECU_ADDRESS 0x5B920C /end MEASUREMENT
/begin MEASUREMENT fpvdkdsu_w "Faktor Druck vor Drosselklappe von Umgebungsdrucksensor (word)" UWORD fak_uw_b4 1 100 0 3.99994 FORMAT "%8.6" ECU_ADDRESS 0x5B87F8 /end MEASUREMENT
/begin MEASUREMENT fpvdkds_w "Faktor Druck vor Drosselklappe von Drucksensor (word)" UWORD fak_uw_b4 1 100 0 3.99994 FORMAT "%8.6" ECU_ADDRESS 0x5B920E /end MEASUREMENT
/begin MEASUREMENT frhol_w "Faktor Luftdichte f(Ansauglufttemp., Hˆhe) 16-Bit" UWORD fak_uw_b2 1 100 0 1.99997 FORMAT "%8.6" ECU_ADDRESS 0x5B87FA /end MEASUREMENT
/begin MEASUREMENT fstadf_w "Tankfuellstand DT1-gefiltert" UWORD vol_q0p1_l 1 100 0 6553.5 FORMAT "%8.3" ECU_ADDRESS 0x5B8782 /end MEASUREMENT
/begin MEASUREMENT fstt "Fuellstand Kraftstofftank" UBYTE vol_q1_l 1 100 0 255 FORMAT "%5.1" ECU_ADDRESS 0x5B877E /end MEASUREMENT
/begin MEASUREMENT fsttaf_w "Tankfuellstand gefiltert" UWORD vol_q0p1_l 1 100 0 6553.5 FORMAT "%8.3" ECU_ADDRESS 0x5B8784 /end MEASUREMENT
/begin MEASUREMENT fsttval_w "Fuellstand Kraftstofftank validiert" UWORD vol_q0p1_l 1 100 0 6553.5 FORMAT "%8.3" ECU_ADDRESS 0x3FDC52 /end MEASUREMENT
/begin MEASUREMENT fstt_w "Fuellstand Kraftstofftank" UWORD vol_q0p1_l 1 100 0 6553.5 FORMAT "%8.3" ECU_ADDRESS 0x5B8786 /end MEASUREMENT
/begin MEASUREMENT ftvdkho_w "" UWORD fak_uw_b8 1 100 0 7.99988 FORMAT "%8.6" ECU_ADDRESS 0x5B9618 /end MEASUREMENT
/begin MEASUREMENT fwe "Faktor Wiedereinsetzen" UBYTE fak_ub_b2 1 100 0 1.99219 FORMAT "%5.3" ECU_ADDRESS 0x5B8EB2 /end MEASUREMENT
/begin MEASUREMENT fwl "Faktor Warmlauf" UBYTE fak_ub_b2 1 100 0 1.99219 FORMAT "%5.3" ECU_ADDRESS 0x5B8EB3 /end MEASUREMENT
/begin MEASUREMENT fwl0 "Rover" UBYTE fak_ub_b2 1 100 0 1.99219 FORMAT "%5.3" ECU_ADDRESS 0x5B8EB4 /end MEASUREMENT
/begin MEASUREMENT fwl1 "Rover" UBYTE fak_ub_b2 1 100 0 1.99219 FORMAT "%5.3" ECU_ADDRESS 0x5B8EB5 /end MEASUREMENT
/begin MEASUREMENT fwlw "Rover" UBYTE fak_ub_b1 1 100 0 0.996094 ECU_ADDRESS 0x5B8EB6 /end MEASUREMENT
/begin MEASUREMENT GgdsasNvBits "" UBYTE dez 1 100 0 255 FORMAT "%5.1" ECU_ADDRESS 0x3FDC5F /end MEASUREMENT
/begin MEASUREMENT GGFSTTBits "" UWORD dez 1 100 0 65535 FORMAT "%8.2" ECU_ADDRESS 0x5B8788 /end MEASUREMENT
/begin MEASUREMENT ggks_cc195_Bits "" UWORD default 1 100 0 65535 FORMAT "%8.2" ECU_ADDRESS 0x5B968A /end MEASUREMENT
/begin MEASUREMENT GGPEDlokbits "" UWORD dez 1 100 0 65535 FORMAT "%8.2" ECU_ADDRESS 0x5B91F0 /end MEASUREMENT
/begin MEASUREMENT GGPEDlokbits2 "" UBYTE dez 1 100 0 255 FORMAT "%5.1" ECU_ADDRESS 0x5B8EBE /end MEASUREMENT
/begin MEASUREMENT GGPEDnonVolbits "" UBYTE dez 1 100 0 255 FORMAT "%5.1" ECU_ADDRESS 0x3FDC54 /end MEASUREMENT
/begin MEASUREMENT gvtaf_w "freies Gasvolumen Kraftstofftank" UWORD vol_q0p1_l 1 100 0 6553.5 FORMAT "%8.3" ECU_ADDRESS 0x5B878A /end MEASUREMENT
/begin MEASUREMENT hfmkor "Luftmassenkorrekturfaktor" UWORD fak_uw_b2 1 100 0 1.99997 FORMAT "%8.6" ECU_ADDRESS 0x5B9678 /end MEASUREMENT
/begin MEASUREMENT hfm_sigma "HFM-Varianz gegl‰ttet f¸r Korrekturkennfeld(er)" UWORD dez 1 100 0 65535 FORMAT "%8.2" ECU_ADDRESS 0x5B967A /end MEASUREMENT
/begin MEASUREMENT igod_w "Integratorgradient f¸r Nulltest-Diagnose Klopfregelung" SWORD spgg_sw_b3052 1 100 -3051.76 3051.67 FORMAT "%8.3" ECU_ADDRESS 0x5B921E /end MEASUREMENT
/begin MEASUREMENT igokr_w "Integratorgradient f¸r Offsetkorrektur Klopfregelung (Word)" SWORD spgg_sw_b3052 1 100 -3051.76 3051.67 FORMAT "%8.3" ECU_ADDRESS 0x5B9220 /end MEASUREMENT
/begin MEASUREMENT ikr "Integratorwert Klopfregelung offsetkorrigiert" UBYTE spg_ub_b5 1 100 0 4.98047 FORMAT "%5.3" ARRAY_SIZE 8 ECU_ADDRESS 0x3FC02C /end MEASUREMENT
/begin MEASUREMENT ikrma "Integratorwert Klopfregelung Meﬂfensteranfang" UBYTE spg_ub_b5 1 100 0 4.98047 FORMAT "%5.3" ECU_ADDRESS 0x5B8ECD /end MEASUREMENT
/begin MEASUREMENT ikrme "Integratorwert Klopfregelung Meﬂfensterende" UBYTE spg_ub_b5 1 100 0 4.98047 FORMAT "%5.3" ARRAY_SIZE 8 ECU_ADDRESS 0x3FC034 /end MEASUREMENT
/begin MEASUREMENT ikrmen "Integratorwert Klopfregelung Meﬂfensterende Nulltest" UBYTE spg_ub_b5 1 100 0 4.98047 FORMAT "%5.3" ECU_ADDRESS 0x5B8ECE /end MEASUREMENT
/begin MEASUREMENT ikrmet "Integratorwert Klopfregelung Meﬂfensterende Testimpuls" UBYTE spg_ub_b5 1 100 0 4.98047 FORMAT "%5.3" ECU_ADDRESS 0x5B8ECF /end MEASUREMENT
/begin MEASUREMENT ikr_tst "Integratorwert Klopfregelung offsetkorregiert rollierend mit Zyl.z‰hler" UBYTE spg_ub_b5 1 100 0 4.98047 FORMAT "%5.3" ECU_ADDRESS 0x5B8ED0 /end MEASUREMENT
/begin MEASUREMENT imlvhb_w "Durchgesetzte Luftmasse f¸r B_gd" UWORD m_uw_b23p3 1 100 0 23.3013 FORMAT "%8.5" ECU_ADDRESS 0x5B8708 /end MEASUREMENT
/begin MEASUREMENT iokkr "Integratoroffsetkorrektur Klopfregelung" UBYTE spg_ub_b5 1 100 0 4.98047 FORMAT "%5.3" ECU_ADDRESS 0x5B8ED1 /end MEASUREMENT
/begin MEASUREMENT kfdps_aus "" UWORD p_q0p039s32768 1 100 -1280 1279.96 FORMAT "%7.2" ECU_ADDRESS 0x5B961A /end MEASUREMENT
/begin MEASUREMENT kfgr_w "Verst‰rkungsfaktor FGR-Regler" UWORD rel_uw_b3200 1 100 0 3199.95 FORMAT "%8.3" ECU_ADDRESS 0x5B90E8 /end MEASUREMENT
/begin MEASUREMENT kldpin_in "Eingang Kennlinie dp Interpolation in Integer f¸r Adressierung KLAF" UWORD fak_uw_q0p001 1 100 0 0.5 FORMAT "%9.7" ECU_ADDRESS 0x5B964C /end MEASUREMENT
/begin MEASUREMENT kldpin_w "Eingang Kennlinie dp Interpolation" UWORD fak_uw_b2 1 100 0 1.99997 FORMAT "%8.6" ECU_ADDRESS 0x5B964E /end MEASUREMENT
/begin MEASUREMENT kmstandold "Kilometerstand aus letztem Driving Cycle" UWORD km_uw_q10 1 100 0 655350 FORMAT "%8.1" ECU_ADDRESS 0x3FDC0E /end MEASUREMENT
/begin MEASUREMENT ks_sym "Eingang des Klopfauswerte-IC" UBYTE dez 1 100 0 255 FORMAT "%5.1" ARRAY_SIZE 4 ECU_ADDRESS 0x3FC03C /end MEASUREMENT
/begin MEASUREMENT lamnswl_w "Lambda-Motor-Soll f¸r Nachstart und Warmlauf" UWORD fak_uw_b16 1 100 0 15.9998 FORMAT "%8.5" ECU_ADDRESS 0x5B91C6 /end MEASUREMENT
/begin MEASUREMENT lamwl_w "Lambda-Motor-Soll f¸r Warmlauf" UWORD fak_uw_b16 1 100 0 15.9998 FORMAT "%8.5" ECU_ADDRESS 0x5B91C8 /end MEASUREMENT
/begin MEASUREMENT laswlr "Rover" UBYTE fak_ub_b2 1 100 0 1.99219 FORMAT "%5.3" ECU_ADDRESS 0x5B8EB7 /end MEASUREMENT
/begin MEASUREMENT ldfki_w "Ladedruck Filterzeitkonstante aus Kennfeld" UWORD zk10msxs_uw_b655 1 100 0.0100002 655.36 FORMAT "%12.8" ECU_ADDRESS 0x5B9210 /end MEASUREMENT
/begin MEASUREMENT L_fgr "Status FGR-Bereitschafts-Leuchte" UBYTE B_TRUE 1 100 0 1 BIT_MASK 0x1 FORMAT "%13.11" ECU_ADDRESS 0x5B8B5D /end MEASUREMENT
/begin MEASUREMENT maxtime_mfa "" UWORD txms_uw_q0p001 1 100 0 65.535 FORMAT "%8.5" ECU_ADDRESS 0x5B968C /end MEASUREMENT
/begin MEASUREMENT maxtime_mfe "" UWORD txms_uw_q0p001 1 100 0 65.535 FORMAT "%8.5" ECU_ADDRESS 0x5B968E /end MEASUREMENT
/begin MEASUREMENT mflctr "rollierender Z‰hler ""empfangene MFL-Botschaften""" UBYTE dez 1 100 0 255 FORMAT "%5.1" ECU_ADDRESS 0x5B8C4F /end MEASUREMENT
/begin MEASUREMENT mflroh "Rohdaten des MFL (serielle Daten in mflroh kopiert)" UBYTE dez 1 100 0 255 FORMAT "%5.1" ECU_ADDRESS 0x5B8C50 /end MEASUREMENT
/begin MEASUREMENT mintime_mfa "" UWORD txms_uw_q0p001 1 100 0 65.535 FORMAT "%8.5" ECU_ADDRESS 0x5B9690 /end MEASUREMENT
/begin MEASUREMENT mintime_mfe "" UWORD txms_uw_q0p001 1 100 0 65.535 FORMAT "%8.5" ECU_ADDRESS 0x5B9692 /end MEASUREMENT
/begin MEASUREMENT mldtma_w "Ausgang Druckregler" SWORD m_uw_b1638p4 1 100 -819.2 819.175 FORMAT "%8.4" ECU_ADDRESS 0x5B961C /end MEASUREMENT
/begin MEASUREMENT mlhfma_w "Luftmassenabtastwert von HFM 16-Bit" UWORD m_uw_b6553p5 1 100 0 6553.5 FORMAT "%8.3" ECU_ADDRESS 0x3FC06A /end MEASUREMENT
/begin MEASUREMENT mlhfmm_w "Luftmassen HFM-Mittelwert 16Bit-Wert" UWORD m_uw_b6553p5 1 100 0 6553.5 FORMAT "%8.3" ECU_ADDRESS 0x5B91EA /end MEASUREMENT
/begin MEASUREMENT mlhfmofs "Luftmasse HFM-Mittelwert inklusive Offset ohne Korrekturfaktoren" UWORD m_uw_b6553p5 1 100 0 6553.5 FORMAT "%8.3" ECU_ADDRESS 0x3FC06C /end MEASUREMENT
/begin MEASUREMENT mlhubmn_w "" UWORD m_uw_b1638p4 1 100 0 1638.38 FORMAT "%8.3" ECU_ADDRESS 0x5B961E /end MEASUREMENT
/begin MEASUREMENT mlnsold_w "" UWORD m_uw_b1638p4 1 100 0 1638.38 FORMAT "%8.3" ECU_ADDRESS 0x5B9620 /end MEASUREMENT
/begin MEASUREMENT mlnsol_w "" UWORD m_uw_b1638p4 1 100 0 1638.38 FORMAT "%8.3" ECU_ADDRESS 0x5B9622 /end MEASUREMENT
/begin MEASUREMENT mlsoladte "Solluftmassenstrom inkl. Adaption und Tankentl¸ftung" UWORD m_uw_b6553p5 1 100 0 6553.5 FORMAT "%8.3" ECU_ADDRESS 0x5B9650 /end MEASUREMENT
/begin MEASUREMENT mlsolkor_w "korrigierter Soll-Luftmassenstrom" UWORD m_uw_b1638p4 1 100 0 1638.38 FORMAT "%8.3" ECU_ADDRESS 0x5B9624 /end MEASUREMENT
/begin MEASUREMENT mlsol_w "Soll-Luftmassenstrom" UWORD m_uw_b6553p5 1 100 0 6553.5 FORMAT "%8.3" ECU_ADDRESS 0x5B9626 /end MEASUREMENT
/begin MEASUREMENT mlwdkns_w "Normierter Luftmassenstrom f¸r Sollwinkelbestimmung Drosselklappe" UWORD m_uw_b6553p5 1 100 0 6553.5 FORMAT "%8.3" ECU_ADDRESS 0x5B9652 /end MEASUREMENT
/begin MEASUREMENT mrfgri_w "Relatives Moment Initialisierungswert f¸r FGR-Regler" UWORD rel_uw_b200 1 100 0 199.997 FORMAT "%8.4" ECU_ADDRESS 0x5B90EA /end MEASUREMENT
/begin MEASUREMENT mrfgrm_w "Relativer Momentenwunsch von FGR (aus ME)" UWORD rel_uw_b200 1 100 0 199.997 FORMAT "%8.4" ECU_ADDRESS 0x5B90EC /end MEASUREMENT
/begin MEASUREMENT mrfgru_w "Untere Grenze f¸r relatives Moment aus FGR" UWORD rel_uw_b200 1 100 0 199.997 FORMAT "%8.4" ECU_ADDRESS 0x5B90DA /end MEASUREMENT
/begin MEASUREMENT mrfgrv_w "Relativer Momentenwunsch aus FGR vor Begrenzung" UWORD rel_uw_b200 1 100 0 199.997 FORMAT "%8.4" ECU_ADDRESS 0x5B9102 /end MEASUREMENT
/begin MEASUREMENT mrfgr_w "Relative Momentenanforderung von FGR" UWORD rel_uw_b200 1 100 0 199.997 FORMAT "%8.4" ECU_ADDRESS 0x5B90DC /end MEASUREMENT
/begin MEASUREMENT mrregl_w "Relatives Moment Reglerausgang FGR" UWORD rel_uw_b200 1 100 0 199.997 FORMAT "%8.4" ECU_ADDRESS 0x5B90EE /end MEASUREMENT
/begin MEASUREMENT mrrgli_w "Initialisierungswert Relatives Moment f¸r FGR-Regler" UWORD rel_uw_b200 1 100 0 199.997 FORMAT "%8.4" ECU_ADDRESS 0x5B90F0 /end MEASUREMENT
/begin MEASUREMENT mshfmkor "Massenstrom HFM mit Korrektur ¸ber Varianz" UWORD m_uw_b6553p5 1 100 0 6553.5 FORMAT "%8.3" ECU_ADDRESS 0x3FC06E /end MEASUREMENT
/begin MEASUREMENT mshfmnof "Luftmassen HFM Mittelwert ohne Filter" UWORD m_uw_b6553p5 1 100 0 6553.5 FORMAT "%8.3" ECU_ADDRESS 0x3FC070 /end MEASUREMENT
/begin MEASUREMENT mshfm_w "Massenstrom HFM 16-Bit Grˆﬂe" UWORD m_uw_b6553p5 1 100 0 6553.5 FORMAT "%8.3" ECU_ADDRESS 0x3FC072 /end MEASUREMENT
/begin MEASUREMENT nmotkor "Motordrehzahl ansaugluftkorrigiert (zur Pulsationskorrektur)" UBYTE nmot_ub_q40 1 100 0 10200 FORMAT "%5.0" ECU_ADDRESS 0x5B8EBB /end MEASUREMENT
/begin MEASUREMENT pbkvmod_w "Bremskraftverst‰rkerdruck modelliert" UWORD p_uw_q0p039 1 100 0 2559.96 FORMAT "%8.3" ECU_ADDRESS 0x5B87AE /end MEASUREMENT
/begin MEASUREMENT pbkvmpu_w "Druckverh‰ltnis pbkvmod_w/pubkv_w" UWORD fak_uw_b2 1 100 0 1.99997 FORMAT "%8.6" ECU_ADDRESS 0x5B87B0 /end MEASUREMENT
/begin MEASUREMENT pbkvpmn_w "min. Druck druch elektrische Bremskraftverst‰rkerpumpe" UWORD p_uw_q0p039 1 100 0 2559.96 FORMAT "%8.3" ECU_ADDRESS 0x5B87B2 /end MEASUREMENT
/begin MEASUREMENT percent_mfa "" UWORD rel_q0p1 1 100 0 6553.5 FORMAT "%8.3" ECU_ADDRESS 0x5B9694 /end MEASUREMENT
/begin MEASUREMENT percent_mfe "" UWORD rel_q0p1 1 100 0 6553.5 FORMAT "%8.3" ECU_ADDRESS 0x5B9696 /end MEASUREMENT
/begin MEASUREMENT plsol "Soll-Ladedruck" UBYTE p_ub_q10 1 100 0 2550 FORMAT "%5.0" ECU_ADDRESS 0x5B8C32 /end MEASUREMENT
/begin MEASUREMENT plsol_w "Soll-Ladedruck" UWORD p_uw_q0p039 1 100 0 2559.96 FORMAT "%8.3" ECU_ADDRESS 0x5B9628 /end MEASUREMENT
/begin MEASUREMENT pssol_w "Sollsaugrohrdruck" UWORD p_uw_q0p039 1 100 0 2559.96 FORMAT "%8.3" ECU_ADDRESS 0x5B962A /end MEASUREMENT
/begin MEASUREMENT psspbkv_w "Druck Saugstrahlpumpe von Bremskraftverst‰rker" UWORD p_uw_q0p039 1 100 0 2559.96 FORMAT "%8.3" ECU_ADDRESS 0x5B87B4 /end MEASUREMENT
/begin MEASUREMENT psspvdkd_w "Verh‰ltnis Sollsaugrohrdruck/Druck vor Drosselklappe von Drucksensor (word)" UWORD fak_uw_b4 1 100 0 3.99994 FORMAT "%8.6" ECU_ADDRESS 0x5B9212 /end MEASUREMENT
/begin MEASUREMENT pu "Umgebungsdruck" UBYTE p_ub_q5 1 100 0 1275 FORMAT "%5.0" ECU_ADDRESS 0x5B87F1 /end MEASUREMENT
/begin MEASUREMENT pubkv_w "Umgebungsdruck f¸r Bremskraftver. (im Fehlerfall Umgebungsd. anderer Ersatzwert)" UWORD p_uw_q0p039 1 100 0 2559.96 FORMAT "%8.3" ECU_ADDRESS 0x5B87B6 /end MEASUREMENT
/begin MEASUREMENT pus_w "Umgebungsdruck ohne Umschaltung auf Ersatzwert bei Sensorfehler" UWORD p_uw_q0p039 1 100 0 2559.96 FORMAT "%8.3" ECU_ADDRESS 0x5B87FC /end MEASUREMENT
/begin MEASUREMENT pu_w "Umgebungsdruck" UWORD p_uw_q0p039 1 100 0 2559.96 FORMAT "%8.3" ECU_ADDRESS 0x5B87FE /end MEASUREMENT
/begin MEASUREMENT pvdkds "Druck vor Drosselklappe von Drucksensor" UBYTE p_ub_q10 1 100 0 2550 FORMAT "%5.0" ECU_ADDRESS 0x5B8ECA /end MEASUREMENT
/begin MEASUREMENT pvdkdsl_w "Druck vor Drosselklappe von Ladedrucksensor (word)" UWORD p_uw_q0p039 1 100 0 2559.96 FORMAT "%8.3" ECU_ADDRESS 0x5B9214 /end MEASUREMENT
/begin MEASUREMENT pvdkdsu_w "Druck vor Drosselklappe von Umgebungsdrucksensor (word)" UWORD p_uw_q0p039 1 100 0 2559.96 FORMAT "%8.3" ECU_ADDRESS 0x5B8800 /end MEASUREMENT
/begin MEASUREMENT pvdkds_w "Druck vor Drosselklappe von Drucksensor (word)" UWORD p_uw_q0p039 1 100 0 2559.96 FORMAT "%8.3" ECU_ADDRESS 0x5B9216 /end MEASUREMENT
/begin MEASUREMENT pvdkmx_w "Maximaler Druck vor Drosselklappe Ausgangswert aus Kennlinie PVDKMX" UWORD p_uw_q0p039 1 100 0 2559.96 FORMAT "%8.3" ECU_ADDRESS 0x5B9218 /end MEASUREMENT
/begin MEASUREMENT pvdksf_w "gefilterter Druck vor Drosselklappe (Ladedruck) vom Drucksensor" UWORD p_uw_q0p039 1 100 0 2559.96 FORMAT "%8.3" ECU_ADDRESS 0x5B921A /end MEASUREMENT
/begin MEASUREMENT pvdkspud "Differenz zwischen Umgebungsdruck und Druck vor Drosselklappe" UBYTE p_ub_q10 1 100 0 2550 FORMAT "%5.0" ECU_ADDRESS 0x5B87F2 /end MEASUREMENT
/begin MEASUREMENT pvdks_w "Druck vor Drosselklappe ohne Umschaltung auf Ersatzwert bei Sensorfehler" UWORD p_uw_q0p039 1 100 0 2559.96 FORMAT "%8.3" ECU_ADDRESS 0x5B921C /end MEASUREMENT
/begin MEASUREMENT relmlhubmn "" UWORD fak_uw_b4 1 100 0 3.99994 FORMAT "%8.6" ECU_ADDRESS 0x5B962C /end MEASUREMENT
/begin MEASUREMENT rfstt "relativer Fuellstand Kraftstofftank" UBYTE rel_ub_b127p5 1 100 0 127.5 FORMAT "%5.1" ECU_ADDRESS 0x5B877F /end MEASUREMENT
/begin MEASUREMENT rgvtaf "relatives freies Gasvolumen Kraftstofftank" UBYTE rel_ub_b127p5 1 100 0 127.5 FORMAT "%5.1" ECU_ADDRESS 0x5B8780 /end MEASUREMENT
/begin MEASUREMENT rinh_w "Istwert (word) Innenwiderstand Ri-Nernstzelle der Lambdasonde hinter KAT" UWORD r_uw_q2 1 100 0 131070 FORMAT "%8.1" ECU_ADDRESS 0x5B925A /end MEASUREMENT
/begin MEASUREMENT rinofha_w "Innenwiderstand (word) Ri Nernst (alter Wert) ohne Filterung hinter KAT" UWORD r_uw_q2 1 100 0 131070 FORMAT "%8.1" ECU_ADDRESS 0x5B925C /end MEASUREMENT
/begin MEASUREMENT rinofh_w "Innenwiderstand (word) Ri Nernst ohne Filterung hinter KAT" UWORD r_uw_q2 1 100 0 131070 FORMAT "%8.1" ECU_ADDRESS 0x5B925E /end MEASUREMENT
/begin MEASUREMENT rinofv2_w "Innenwiderstand (word) Ri Nernst ohne Filterung vor KAT Bank2" UWORD r_uw_q2 1 100 0 131070 FORMAT "%8.1" ECU_ADDRESS 0x5B9226 /end MEASUREMENT
/begin MEASUREMENT rinofva2_w "Innenwiderstand (word) Ri Nernst (alter Wert) ohne Filterung vor KAT Bank2" UWORD r_uw_q2 1 100 0 131070 FORMAT "%8.1" ECU_ADDRESS 0x5B9228 /end MEASUREMENT
/begin MEASUREMENT rinofva_w "Innenwiderstand (word) Ri Nernst (alter Wert) ohne Filterung vor KAT" UWORD r_uw_q2 1 100 0 131070 FORMAT "%8.1" ECU_ADDRESS 0x5B922A /end MEASUREMENT
/begin MEASUREMENT rinofv_w "Innenwiderstand (word) Ri Nernst ohne Filterung vor KAT" UWORD r_uw_q2 1 100 0 131070 FORMAT "%8.1" ECU_ADDRESS 0x5B922C /end MEASUREMENT
/begin MEASUREMENT rinv2_w "Istwert (word) Innenwiderstand Ri-Nernstzelle der Lambdasonde vor KAT Bank2" UWORD r_uw_q2 1 100 0 131070 FORMAT "%8.1" ECU_ADDRESS 0x5B922E /end MEASUREMENT
/begin MEASUREMENT rinv_w "Istwert (word) Innenwiderstand Ri-Nernstzelle der Lambdasonde vor KAT" UWORD r_uw_q2 1 100 0 131070 FORMAT "%8.1" ECU_ADDRESS 0x5B9230 /end MEASUREMENT
/begin MEASUREMENT rlfe_w "" SWORD rel_uw_q0p0234 1 100 -768 767.977 FORMAT "%8.4" ECU_ADDRESS 0x5B962E /end MEASUREMENT
/begin MEASUREMENT rlsolk_w "Korrigierte relative Sollf¸llung" UWORD rel_uw_q0p0234 1 100 0 1535.98 FORMAT "%8.3" ECU_ADDRESS 0x5B9630 /end MEASUREMENT
/begin MEASUREMENT rlvw "relative Luftf¸llung (druck- und hˆhenkorrigiert)" UBYTE rel_ub_q0p75 1 100 0 191.25 FORMAT "%5.1" ECU_ADDRESS 0x5B8C33 /end MEASUREMENT
/begin MEASUREMENT rlvwvnstf_w "" UWORD rel_uw_q0p0234 1 100 0 1535.98 FORMAT "%8.3" ECU_ADDRESS 0x5B9632 /end MEASUREMENT
/begin MEASUREMENT rlvwvnst_w "" UWORD rel_uw_q0p0234 1 100 0 1535.98 FORMAT "%8.3" ECU_ADDRESS 0x5B9634 /end MEASUREMENT
/begin MEASUREMENT rlvwvnsvf_w "" UWORD rel_uw_q0p0234 1 100 0 1535.98 FORMAT "%8.3" ECU_ADDRESS 0x5B9636 /end MEASUREMENT
/begin MEASUREMENT rlvwvnsv_w "" UWORD rel_uw_q0p0234 1 100 0 1535.98 FORMAT "%8.3" ECU_ADDRESS 0x5B9638 /end MEASUREMENT
/begin MEASUREMENT rlvwvns_w "relative Fuellung fuer Spreizung" UWORD rel_uw_q0p0234 1 100 0 1535.98 FORMAT "%8.3" ECU_ADDRESS 0x5B963A /end MEASUREMENT
/begin MEASUREMENT rlvwvvt_w "relative Fuellung" UWORD rel_uw_q0p0234 1 100 0 1535.98 FORMAT "%8.3" ECU_ADDRESS 0x5B963C /end MEASUREMENT
/begin MEASUREMENT rlvw_w "relative Luftf¸llung (druck- und hˆhenkorrigiert) Word" UWORD rel_uw_q0p0234 1 100 0 1535.98 FORMAT "%8.3" ECU_ADDRESS 0x5B963E /end MEASUREMENT
/begin MEASUREMENT runtime_mfa "" UWORD txms_uw_q0p001 1 100 0 65.535 FORMAT "%8.5" ECU_ADDRESS 0x5B9698 /end MEASUREMENT
/begin MEASUREMENT runtime_mfe "" UWORD txms_uw_q0p001 1 100 0 65.535 FORMAT "%8.5" ECU_ADDRESS 0x5B969A /end MEASUREMENT
/begin MEASUREMENT sen_c95 "Klopfsensoreingang am Klopfauswerte-IC" UBYTE dez 1 100 0 255 FORMAT "%5.1" ARRAY_SIZE 8 ECU_ADDRESS 0x5B8ED4 /end MEASUREMENT
/begin MEASUREMENT S_VSGDVHUB "Bedingung: Umschalten Motor auf gedrosselt mit VVT-Vollhub" UBYTE dez 1 100 0 255 FORMAT "%5.1" ECU_ADDRESS 0x5B8706 /end MEASUREMENT
/begin MEASUREMENT tans16 "" UWORD temp_uw_q0p75_o48 1 100 -48 49103.3 FORMAT "%8.2" ECU_ADDRESS 0x5B91EC /end MEASUREMENT
/begin MEASUREMENT tdmflc "Timer f¸r Entprellung Plaus-Fehler (MFL)" UBYTE t10msxs_ub_b2p55 1 100 0 2.55 FORMAT "%5.3" ECU_ADDRESS 0x5B8C51 /end MEASUREMENT
/begin MEASUREMENT tdmflhc "Timer f¸r Entprellung Heilung (MFL)" UBYTE t10msxs_ub_b2p55 1 100 0 2.55 FORMAT "%5.3" ECU_ADDRESS 0x5B8C52 /end MEASUREMENT
/begin MEASUREMENT tframe "Telegramml‰nge der MFL-Botschaft" UWORD t_q0p4us 1 100 0 26214 FORMAT "%8.2" ECU_ADDRESS 0x5B969C /end MEASUREMENT
/begin MEASUREMENT tfst2nq_dez "" UWORD dez 1 100 0 65535 FORMAT "%8.2" ECU_ADDRESS 0x5B878C /end MEASUREMENT
/begin MEASUREMENT tfst2nq_w "Tankfuellstand mit Standard-Quantisierung Tank2" UWORD vol_q0p1_l 1 100 0 6553.5 FORMAT "%8.3" ECU_ADDRESS 0x5B878E /end MEASUREMENT
/begin MEASUREMENT tfst2_dez "Dezimalwert von Fuellstandswert Tank 2" UWORD dez 1 100 0 65535 FORMAT "%8.2" ECU_ADDRESS 0x5B8790 /end MEASUREMENT
/begin MEASUREMENT tfstnf_w "Tankfuellstand nach Tiefpa?" UWORD vol_q0p1_l 1 100 0 6553.5 FORMAT "%8.3" ECU_ADDRESS 0x5B8792 /end MEASUREMENT
/begin MEASUREMENT tfstnq_dez "Dezimalwert der neuen Qunatisierung Fuellstandswert Tank 1" UWORD dez 1 100 0 65535 FORMAT "%8.2" ECU_ADDRESS 0x5B8794 /end MEASUREMENT
/begin MEASUREMENT tfstnq_w "Tankfuellstand mit Standard-Quantisierung" UWORD vol_q0p1_l 1 100 0 6553.5 FORMAT "%8.3" ECU_ADDRESS 0x5B8796 /end MEASUREMENT
/begin MEASUREMENT tfst_dez "Dezimalwert von Fuellstandswert Tank 1" UWORD dez 1 100 0 65535 FORMAT "%8.2" ECU_ADDRESS 0x5B8798 /end MEASUREMENT
/begin MEASUREMENT tfst_w "Tankfuellstand" UWORD vol_q0p1_l 1 100 0 6553.5 FORMAT "%8.3" ECU_ADDRESS 0x5B879A /end MEASUREMENT
/begin MEASUREMENT tfwdksom_w "Zeitkonstante f¸r Filterung Drosselklappenwinkel ohne Momentenstruktur" UWORD zk10msxs_uw_b655 1 100 0.0100002 655.36 FORMAT "%12.8" ECU_ADDRESS 0x5B9654 /end MEASUREMENT
/begin MEASUREMENT tmflbc "Interner Timer f¸r Wechsel innerhalb Zustandsautomat (MFL)" UBYTE t20msxs_ub_b5p1 1 100 0 5.1 FORMAT "%5.3" ECU_ADDRESS 0x5B8C53 /end MEASUREMENT
/begin MEASUREMENT tmflbec "Timer f¸r MFL-Timeout" UBYTE t10msxs_ub_b2p55 1 100 0 2.55 FORMAT "%5.3" ECU_ADDRESS 0x5B8C54 /end MEASUREMENT
/begin MEASUREMENT tmflfqec "Timer f¸r Telegramm-Frequenzcheck" UBYTE t10msxs_ub_b2p55 1 100 0 2.55 FORMAT "%5.3" ECU_ADDRESS 0x5B8C55 /end MEASUREMENT
/begin MEASUREMENT tmfln_w "Meﬂfensterl‰nge w‰hrend Nulltest, KR" UWORD tus_uw_q3p2 1 100 0 209712 FORMAT "%8.1" ECU_ADDRESS 0x5B9222 /end MEASUREMENT
/begin MEASUREMENT tmfltcc "Timer f¸r Toggelbitcheck" UBYTE t10msxs_ub_b2p55 1 100 0 2.55 FORMAT "%5.3" ECU_ADDRESS 0x5B8C56 /end MEASUREMENT
/begin MEASUREMENT tmfl_w "Meﬂfensterl‰nge Klopfregelung" UWORD tus_uw_q3p2 1 100 0 209712 FORMAT "%8.1" ECU_ADDRESS 0x5B9224 /end MEASUREMENT
/begin MEASUREMENT tn2 "Segmentzeit pro Z¸ndung" UWORD tus_uw_q3p2 1 100 0 209712 FORMAT "%8.1" ECU_ADDRESS 0x5B8804 /end MEASUREMENT
/begin MEASUREMENT tn2fgr_w "Doppelte Nennerzeitkonstante FGR-Regler" UWORD t20msxs_uw_q0p02 1 100 0 1310.7 FORMAT "%8.3" ECU_ADDRESS 0x5B90F2 /end MEASUREMENT
/begin MEASUREMENT tpnt_aktiv "Aktivierung von KR-Funktionen" UBYTE dez 1 100 0 255 FORMAT "%5.1" ECU_ADDRESS 0x5B8EDC /end MEASUREMENT
/begin MEASUREMENT Ttvdpsrlvw "" UWORD t10msxs_uw_b655p35 1 100 0 655.35 FORMAT "%8.4" ECU_ADDRESS 0x5B9640 /end MEASUREMENT
/begin MEASUREMENT tz2fgr_w "Doppelte Z‰hlerzeitkonstante FGR-Regler" UWORD t20msxs_uw_q0p02 1 100 0 1310.7 FORMAT "%8.3" ECU_ADDRESS 0x5B90F4 /end MEASUREMENT
/begin MEASUREMENT t_hubon "" UWORD t100msxs_uw_b6553p5 1 100 0 6553.5 FORMAT "%8.3" ECU_ADDRESS 0x5B9642 /end MEASUREMENT
/begin MEASUREMENT t_nmot "" UBYTE t100msxs_ub_b25p5 1 100 0 25.5 FORMAT "%5.2" ECU_ADDRESS 0x5B8C34 /end MEASUREMENT
/begin MEASUREMENT t_rl "" UBYTE t100msxs_ub_b25p5 1 100 0 25.5 FORMAT "%5.2" ECU_ADDRESS 0x5B8C35 /end MEASUREMENT
/begin MEASUREMENT t_stend "" UBYTE t100msxs_ub_b25p5 1 100 0 25.5 FORMAT "%5.2" ECU_ADDRESS 0x5B8C36 /end MEASUREMENT
/begin MEASUREMENT t_wped "" UBYTE t100msxs_ub_b25p5 1 100 0 25.5 FORMAT "%5.2" ECU_ADDRESS 0x5B8C37 /end MEASUREMENT
/begin MEASUREMENT uadki "eingelesener Integratorwert von Klopfauswerteschaltung" UWORD dez 1 100 0 65535 FORMAT "%8.2" ECU_ADDRESS 0x5B8806 /end MEASUREMENT
/begin MEASUREMENT upw2ll_w "Spannungswert von PWG-Poti 2 vor der Bewegung" UWORD spg_uw_q0p00488 1 100 0 319.995 FORMAT "%8.4" ECU_ADDRESS 0x3FDC56 /end MEASUREMENT
/begin MEASUREMENT upwg2d_w "Verdoppelte PWG-Poti-2-Spannung (Word)" UWORD spg_uw_q0p00488 1 100 0 319.995 FORMAT "%8.4" ECU_ADDRESS 0x5B91F2 /end MEASUREMENT
/begin MEASUREMENT upwg2fil_w "Gefilterte Poti 2 Spannung" UWORD spg_uw_q0p00488 1 100 0 319.995 FORMAT "%8.4" ECU_ADDRESS 0x5B91F4 /end MEASUREMENT
/begin MEASUREMENT upwgej_w "Entjitterte PWG-Poti-Spannung" UWORD spg_uw_q0p00488 1 100 0 319.995 FORMAT "%8.4" ECU_ADDRESS 0x5B91F6 /end MEASUREMENT
/begin MEASUREMENT upwg_w "Resultierende PWG-Poti-Spannung nach Plausibilit‰tspr¸fung" UWORD spg_uw_q0p00488 1 100 0 319.995 FORMAT "%8.4" ECU_ADDRESS 0x5B91F8 /end MEASUREMENT
/begin MEASUREMENT usbeh_w "Spannung (word) Lambdasonde mit Widerstand belastet hinter KAT" UWORD spg_uw_q0p00488_o1 1 100 -1 318.995 FORMAT "%8.4" ECU_ADDRESS 0x5B9260 /end MEASUREMENT
/begin MEASUREMENT usbev2_w "Spannung (word) Lambdasonde mit Widerstand belastet vor KAT Bank2" UWORD spg_uw_q0p00488_o1 1 100 -1 318.995 FORMAT "%8.4" ECU_ADDRESS 0x5B9232 /end MEASUREMENT
/begin MEASUREMENT usbev_w "Spannung (word) Lambdasonde mit Widerstand belastet vor KAT" UWORD spg_uw_q0p00488_o1 1 100 -1 318.995 FORMAT "%8.4" ECU_ADDRESS 0x5B9234 /end MEASUREMENT
/begin MEASUREMENT ushb_w "Spannung (word) Lambdasonde mit Widerstand belastet hinter KAT" UWORD spg_uw_q0p00488_o1 1 100 -1 318.995 FORMAT "%8.4" ECU_ADDRESS 0x5B9262 /end MEASUREMENT
/begin MEASUREMENT ushk "Spannung Lambdasonde hinter Katalysator" UBYTE spg_ub_q0p0052_o0p2 1 100 -0.2 1.13 FORMAT "%5.3" ECU_ADDRESS 0x5B8EE6 /end MEASUREMENT
/begin MEASUREMENT ushk2 "Spannung Lambdasonde hinter Katalysator 2" UBYTE spg_ub_q0p0052_o0p2 1 100 -0.2 1.13 FORMAT "%5.3" ECU_ADDRESS 0x5B8EE7 /end MEASUREMENT
/begin MEASUREMENT ushkr_w "Spannung (word) Lambdasonde Rohwert hinter KAT" UWORD spg_uw_q0p00488_o1 1 100 -1 318.995 FORMAT "%8.4" ECU_ADDRESS 0x5B9264 /end MEASUREMENT
/begin MEASUREMENT ushk_w "Spannung Lambdasonde (4.88mV/LSB) hinter Katalysator" UWORD spg_uw_q0p00488_o1 1 100 -1 318.995 FORMAT "%8.4" ECU_ADDRESS 0x5B9266 /end MEASUREMENT
/begin MEASUREMENT ushmb_w "Spannung (word, 10 ms-Raster) Lambdasonde mit Widerstand belastet hinter KAT" UWORD spg_uw_q0p00488_o1 1 100 -1 318.995 FORMAT "%8.4" ECU_ADDRESS 0x5B9268 /end MEASUREMENT
/begin MEASUREMENT ushob_w "Spannung (word, 10 ms-Raster) Lambdasonde ohne Belastung hinter KAT" UWORD spg_uw_q0p00488_o1 1 100 -1 318.995 FORMAT "%8.4" ECU_ADDRESS 0x5B926A /end MEASUREMENT
/begin MEASUREMENT usobh_w "Spannung (word) Lambdasonde ohne Belastung hinter KAT" UWORD spg_uw_q0p00488_o1 1 100 -1 318.995 FORMAT "%8.4" ECU_ADDRESS 0x5B926C /end MEASUREMENT
/begin MEASUREMENT usobv2_w "Spannung (word) Lambdasonde ohne Belastung vor KAT Bank2" UWORD spg_uw_q0p00488_o1 1 100 -1 318.995 FORMAT "%8.4" ECU_ADDRESS 0x5B9236 /end MEASUREMENT
/begin MEASUREMENT usobv_w "Spannung (word) Lambdasonde ohne Belastung vor KAT" UWORD spg_uw_q0p00488_o1 1 100 -1 318.995 FORMAT "%8.4" ECU_ADDRESS 0x5B9238 /end MEASUREMENT
/begin MEASUREMENT usvb2_w "Spannung (word) Lambdasonde mit Widerstand belastet vor KAT" UWORD spg_uw_q0p00488_o1 1 100 -1 318.995 FORMAT "%8.4" ECU_ADDRESS 0x5B923A /end MEASUREMENT
/begin MEASUREMENT usvb_w "Spannung (word) Lambdasonde mit Widerstand belastet vor KAT" UWORD spg_uw_q0p00488_o1 1 100 -1 318.995 FORMAT "%8.4" ECU_ADDRESS 0x5B923C /end MEASUREMENT
/begin MEASUREMENT usvk "Spannung Lambdasonde vor Kat" UBYTE spg_ub_q0p0052_o0p2 1 100 -0.2 1.13 FORMAT "%5.3" ECU_ADDRESS 0x5B8EE2 /end MEASUREMENT
/begin MEASUREMENT usvk2 "Spannung Lambdasonde vor Kat 2" UBYTE spg_ub_q0p0052_o0p2 1 100 -0.2 1.13 FORMAT "%5.3" ECU_ADDRESS 0x5B8EE3 /end MEASUREMENT
/begin MEASUREMENT usvk2_w "Spannung Lambdasonde (4.88mV/LSB) vor Kat 2" UWORD spg_uw_q0p00488_o1 1 100 -1 318.995 FORMAT "%8.4" ECU_ADDRESS 0x5B923E /end MEASUREMENT
/begin MEASUREMENT usvkr2_w "Spannung (word) Lambdasonde Rohwert vor KAT Bank2" UWORD spg_uw_q0p00488_o1 1 100 -1 318.995 FORMAT "%8.4" ECU_ADDRESS 0x5B9240 /end MEASUREMENT
/begin MEASUREMENT usvkr_w "Spannung (word) Lambdasonde Rohwert vor Kat" UWORD spg_uw_q0p00488_o1 1 100 -1 318.995 FORMAT "%8.4" ECU_ADDRESS 0x5B9242 /end MEASUREMENT
/begin MEASUREMENT usvk_w "Spannung Lambdasonde (4.88mV/LSB) vor Kat" UWORD spg_uw_q0p00488_o1 1 100 -1 318.995 FORMAT "%8.4" ECU_ADDRESS 0x5B9244 /end MEASUREMENT
/begin MEASUREMENT usvmb2_w "Spannung (word, 10 ms-Raster) Lambdasonde mit Widerstand belastet vor KAT Bank2" UWORD spg_uw_q0p00488_o1 1 100 -1 318.995 FORMAT "%8.4" ECU_ADDRESS 0x5B9246 /end MEASUREMENT
/begin MEASUREMENT usvmb_w "Spannung (word, 10 ms-Raster) Lambdasonde mit Widerstand belastet vor KAT" UWORD spg_uw_q0p00488_o1 1 100 -1 318.995 FORMAT "%8.4" ECU_ADDRESS 0x5B9248 /end MEASUREMENT
/begin MEASUREMENT usvob2_w "Spannung (word, 10 ms-Raster) Lambdasonde ohne Belastung vor KAT Bank2" UWORD spg_uw_q0p00488_o1 1 100 -1 318.995 FORMAT "%8.4" ECU_ADDRESS 0x5B924A /end MEASUREMENT
/begin MEASUREMENT usvob_w "Spannung (word, 10 ms-Raster) Lambdasonde ohne Belastung vor KAT" UWORD spg_uw_q0p00488_o1 1 100 -1 318.995 FORMAT "%8.4" ECU_ADDRESS 0x5B924C /end MEASUREMENT
/begin MEASUREMENT uushmb_w "Spannung (word, 1 ms-Raster) Lambdasonde mit Widerstand belastet hinter KAT" UWORD spg_uw_q0p00488 1 100 0 319.995 FORMAT "%8.4" ECU_ADDRESS 0x3FC074 /end MEASUREMENT
/begin MEASUREMENT uushob_w "ADC-Spannung (word, 1 ms-Raster) Sonde ohne Belastung hinter Katalysator" UWORD spg_uw_q0p00488 1 100 0 319.995 FORMAT "%8.4" ECU_ADDRESS 0x3FC076 /end MEASUREMENT
/begin MEASUREMENT uusvmb2_w "Spannung (word, 1 ms-Raster) Lambdasonde mit Widerstand belastet vor KAT Bank2" UWORD spg_uw_q0p00488 1 100 0 319.995 FORMAT "%8.4" ECU_ADDRESS 0x5B924E /end MEASUREMENT
/begin MEASUREMENT uusvmb_w "Spannung (word, 1 ms-Raster) Lambdasonde mit Widerstand belastet vor KAT" UWORD spg_uw_q0p00488 1 100 0 319.995 FORMAT "%8.4" ECU_ADDRESS 0x5B9250 /end MEASUREMENT
/begin MEASUREMENT uusvob2_w "ADC-Spannung (word, 1 ms-Raster) Sonde ohne Belastung vor Katalysator Bank2" UWORD spg_uw_q0p00488 1 100 0 319.995 FORMAT "%8.4" ECU_ADDRESS 0x5B9252 /end MEASUREMENT
/begin MEASUREMENT uusvob_w "ADC-Spannung (word, 1 ms-Raster) Sonde ohne Belastung vor Katalysator" UWORD spg_uw_q0p00488 1 100 0 319.995 FORMAT "%8.4" ECU_ADDRESS 0x5B9254 /end MEASUREMENT
/begin MEASUREMENT vlast_w "Zus‰tzliche Offset-Geschwindigkeit f¸r FGR-Regler bei hˆherer Last" UWORD vfzg_uw_b512 1 100 0 511.992 FORMAT "%8.4" ECU_ADDRESS 0x5B90F6 /end MEASUREMENT
/begin MEASUREMENT voffs_w "Offsetgeschwindigkeit f¸r FGR-Regler" UWORD vfzg_uw_b512 1 100 0 511.992 FORMAT "%8.4" ECU_ADDRESS 0x5B90F8 /end MEASUREMENT
/begin MEASUREMENT vrbemx_w "Maximalwert f¸r vregl_w bei Beschleunigung" UWORD vfzg_uw_b512 1 100 0 511.992 FORMAT "%8.4" ECU_ADDRESS 0x5B90FA /end MEASUREMENT
/begin MEASUREMENT vregl_w "Sollgeschwindigkeit f¸r FGR-Regler" UWORD vfzg_uw_b512 1 100 0 511.992 FORMAT "%8.4" ECU_ADDRESS 0x5B90FC /end MEASUREMENT
/begin MEASUREMENT vrvemn_w "Minimalwert f¸r vregl_w bei Verzˆgern" UWORD vfzg_uw_b512 1 100 0 511.992 FORMAT "%8.4" ECU_ADDRESS 0x5B90FE /end MEASUREMENT
/begin MEASUREMENT vziel_w "Zielgeschwindigkeit FGR" UWORD vfzg_uw_b512 1 100 0 511.992 FORMAT "%8.4" ECU_ADDRESS 0x5B9100 /end MEASUREMENT
/begin MEASUREMENT wdk1 "Drosselklappenwinkel aus Poti 1" UBYTE relDK_ub_b100 1 100 0 100 FORMAT "%5.1" ECU_ADDRESS 0x5B8E41 /end MEASUREMENT
/begin MEASUREMENT wdk1g "DK-Winkel aus Poti 1 begrenzt u. gefiltert f¸r Vergl. mit Ersatzwert aus F¸llung" UBYTE relDK_ub_b100 1 100 0 100 FORMAT "%5.1" ECU_ADDRESS 0x5B8E42 /end MEASUREMENT
/begin MEASUREMENT wdk1_w "DK-Winkel aus Poti 1" SWORD relDK_q0p02441 1 100 -800 799.976 FORMAT "%8.4" ECU_ADDRESS 0x5B90A4 /end MEASUREMENT
/begin MEASUREMENT wdk2 "Drosselklappenwinkel aus Poti 2" UBYTE relDK_ub_b100 1 100 0 100 FORMAT "%5.1" ECU_ADDRESS 0x5B8E43 /end MEASUREMENT
/begin MEASUREMENT wdk2g "DK-Winkel aus Poti 2 begrenzt u. gefiltert f¸r Vergl. mit Ersatzwert aus F¸llung" UBYTE relDK_ub_b100 1 100 0 100 FORMAT "%5.1" ECU_ADDRESS 0x5B8E44 /end MEASUREMENT
/begin MEASUREMENT wdk2_w "DK-Winkel aus Poti 2" SWORD relDK_q0p02441 1 100 -800 799.976 FORMAT "%8.4" ECU_ADDRESS 0x5B90A6 /end MEASUREMENT
/begin MEASUREMENT wdk3g "Gefilterter Drosselklappenwinkel berechnet aus Hauptf¸llungssignal" UBYTE relDK_ub_b100 1 100 0 100 FORMAT "%5.1" ECU_ADDRESS 0x5B8E45 /end MEASUREMENT
/begin MEASUREMENT wdkba "Drosselklappenwinkel bezogen auf unteren Anschlag" UBYTE relDK_ub_b100 1 100 0 100 FORMAT "%5.1" ECU_ADDRESS 0x5B8E46 /end MEASUREMENT
/begin MEASUREMENT wdkbau16 "" UWORD rel_uw_b100 1 100 0 99.9985 FORMAT "%8.5" ECU_ADDRESS 0x5B967C /end MEASUREMENT
/begin MEASUREMENT wdkba_w "Drosselklappenwinkel bezogen auf unteren Anschlag" SWORD relDK_q0p02441 1 100 -800 799.976 FORMAT "%8.4" ECU_ADDRESS 0x3FC060 /end MEASUREMENT
/begin MEASUREMENT wdks "Sollwert DK-Winkel, bezogen auf unteren Anschlag" UBYTE rel_ub_b99p6 1 100 0 99.6094 FORMAT "%5.2" ECU_ADDRESS 0x5B8C38 /end MEASUREMENT
/begin MEASUREMENT wdksgd "Winkel DK aus KLAF und KFWDKMSN VVT-Betrieb" UWORD rel_uw_b100 1 100 0 99.9985 FORMAT "%8.5" ECU_ADDRESS 0x5B9656 /end MEASUREMENT
/begin MEASUREMENT wdksom_w "Drosselklappensollwinkel ohne Momentenstruktur" UWORD rel_uw_b100 1 100 0 99.9985 FORMAT "%8.5" ECU_ADDRESS 0x5B9658 /end MEASUREMENT
/begin MEASUREMENT wdksp_w "Pr‰dizierter Drosselklappen-Sollwinkel" UWORD rel_uw_b100 1 100 0 99.9985 FORMAT "%8.5" ECU_ADDRESS 0x5B965A /end MEASUREMENT
/begin MEASUREMENT wdksvt "Drosselklappenwinkel aus KFWDKDPS VVT Betrieb" UWORD rel_uw_b100 1 100 0 99.9985 FORMAT "%8.5" ECU_ADDRESS 0x5B965C /end MEASUREMENT
/begin MEASUREMENT wdksv_w "Drosselklappen-Sollwinkel vor Applikationsschnittstelle (ungefiltert)" UWORD rel_uw_b100 1 100 0 99.9985 FORMAT "%8.5" ECU_ADDRESS 0x5B965E /end MEASUREMENT
/begin MEASUREMENT wdks_w "Sollwert Drosselklappenwinkel, bezogen auf (unteren) Anschlag" UWORD rel_uw_b100 1 100 0 99.9985 FORMAT "%8.5" ECU_ADDRESS 0x5B9660 /end MEASUREMENT
/begin MEASUREMENT wdkugd_w "Drosselklappenwinkel, bei dem 95% F¸llung erreicht wird" UWORD rel_uw_b100 1 100 0 99.9985 FORMAT "%8.5" ECU_ADDRESS 0x5B9662 /end MEASUREMENT
/begin MEASUREMENT wea "Winkelmarke Einspritzabbruch" UBYTE kw_q3 1 100 0 765 FORMAT "%5.1" ECU_ADDRESS 0x5B8C45 /end MEASUREMENT
/begin MEASUREMENT weemrfa "Winkel Einspritzende im maximalem Fahrerwunschmomment" UBYTE kw_q3 1 100 0 765 FORMAT "%5.1" ECU_ADDRESS 0x5B8752 /end MEASUREMENT
/begin MEASUREMENT wmfa "Meﬂfensteranfang in Grad Kurbelwinkel" UBYTE zw_ub_q0p75 1 100 0 191.25 FORMAT "%5.1" ECU_ADDRESS 0x5B8EDD /end MEASUREMENT
/begin MEASUREMENT wmfa_new "Meﬂfensteranfang: aktueller Wert aus KL/KF" UBYTE zw_ub_q0p75 1 100 0 191.25 FORMAT "%5.1" ECU_ADDRESS 0x5B8EDE /end MEASUREMENT
/begin MEASUREMENT wmfl "Meﬂfensterl‰nge in Grad Kurbelwinkel" UBYTE zw_ub_q0p75 1 100 0 191.25 FORMAT "%5.1" ECU_ADDRESS 0x5B8EDF /end MEASUREMENT
/begin MEASUREMENT wmfl_new "Meﬂfensterl‰nge: aktueller Wert aus KL/KF" UBYTE zw_ub_q0p75 1 100 0 191.25 FORMAT "%5.1" ECU_ADDRESS 0x5B8EE0 /end MEASUREMENT
/begin MEASUREMENT wped "Normierter Fahrpedalwinkel" UBYTE relPED_ub_b100 1 100 0 100 FORMAT "%5.1" ECU_ADDRESS 0x5B8EBF /end MEASUREMENT
/begin MEASUREMENT wpedt_w "Pedalwert (tempor‰r) bei 2 ME-Steuerger‰ten" UWORD relPED_uw_b100 1 100 0 100 FORMAT "%8.4" ECU_ADDRESS 0x5B91FA /end MEASUREMENT
/begin MEASUREMENT wpedv_w "Normierter Fahrpedalwinkel vor Ber¸cksichtigung der Begrenzungen im Notfahren" UWORD relPED_uw_b100 1 100 0 100 FORMAT "%8.4" ECU_ADDRESS 0x5B91FC /end MEASUREMENT
/begin MEASUREMENT wped_w "Normierter Fahrpedalwinkel" UWORD relPED_uw_b100 1 100 0 100 FORMAT "%8.4" ECU_ADDRESS 0x5B91FE /end MEASUREMENT
/begin MEASUREMENT wvesp "Vorlagerungswinkel Einspritzung im Start und bei Normalbetrieb" UBYTE kw_q3 1 100 0 765 FORMAT "%5.1" ECU_ADDRESS 0x5B8C46 /end MEASUREMENT
/begin MEASUREMENT wvespnst "Vorlagerungswinkel Einspritzung im Normalbetrieb" UBYTE kw_q3 1 100 0 765 FORMAT "%5.1" ECU_ADDRESS 0x5B8753 /end MEASUREMENT
/begin MEASUREMENT wvespst "Vorlagerungswinkel Einspritzung im Start" UBYTE kw_q3 1 100 0 765 FORMAT "%5.1" ECU_ADDRESS 0x5B8754 /end MEASUREMENT
/begin MEASUREMENT zaaccflag "Zustandsautomat Positionsflag" UBYTE dez 1 100 0 255 FORMAT "%5.1" ECU_ADDRESS 0x5B8C57 /end MEASUREMENT
/begin MEASUREMENT zkfstf "Zeitkonstante Fuellstandssignalfilter" UWORD zk100msxs_uw_b6553 1 100 0.100002 6553.6 FORMAT "%10.5" ECU_ADDRESS 0x5B879C /end MEASUREMENT
/begin MEASUREMENT zriberh "Ri-Berechnungsz‰hler nach Start hinter KAT" UBYTE dez 1 100 0 255 FORMAT "%5.1" ECU_ADDRESS 0x5B8EE8 /end MEASUREMENT
/begin MEASUREMENT zriberv "Ri-Berechnungsz‰hler nach Start vor KAT" UBYTE dez 1 100 0 255 FORMAT "%5.1" ECU_ADDRESS 0x5B8EE4 /end MEASUREMENT
/begin MEASUREMENT zriberv2 "Ri-Berechnungsz‰hler nach Start vor KAT Bank2" UBYTE dez 1 100 0 255 FORMAT "%5.1" ECU_ADDRESS 0x5B8EE5 /end MEASUREMENT
/begin MEASUREMENT zrinh_w "Zeitz‰hler zur Bereitstellung der aktuellen Bedingung Ri-Nernst hinter KAT" UWORD t100msxs_uw_b6553p5 1 100 0 6553.5 FORMAT "%8.3" ECU_ADDRESS 0x5B926E /end MEASUREMENT
/begin MEASUREMENT zrinv2_w "Zeitz‰hler zur Bereitstellung der aktuellen Bedingung Ri-Nernst vor KAT Bank2" UWORD t100msxs_uw_b6553p5 1 100 0 6553.5 FORMAT "%8.3" ECU_ADDRESS 0x5B9256 /end MEASUREMENT
/begin MEASUREMENT zrinv_w "Zeitz‰hler zur Bereitstellung der aktuellen Bedingung Ri-Nernst vor KAT" UWORD t100msxs_uw_b6553p5 1 100 0 6553.5 FORMAT "%8.3" ECU_ADDRESS 0x5B9258 /end MEASUREMENT
/begin MEASUREMENT ztpnt_a "KR: Z‰hler f¸r die Freigabe von Nulltest oder Testimpuls" UBYTE dez 1 100 0 255 FORMAT "%5.1" ECU_ADDRESS 0x5B8EE1 /end MEASUREMENT
/begin MEASUREMENT zzylkr "Zylinderz‰hler der Klopfregelung" UBYTE dez 1 100 0 255 FORMAT "%5.1" ECU_ADDRESS 0x3FC040 /end MEASUREMENT
/begin FUNCTION ESVW "ESVW.exportedEinspritzung: Berechnung der Vorlagerungswinkel"
 /begin DEF_CHARACTERISTIC CWESVW DWEEMX KFWEE KFWEEGD MRFAVW WEAN WEEM WEEMGD WEEMRFAN WEESTM WEESTMGD WEESTN WEESTNGD /end DEF_CHARACTERISTIC
 /begin REF_CHARACTERISTIC SNM08GKUB SRL08GKUB /end REF_CHARACTERISTIC
 /begin IN_MEASUREMENT B_stend dpsfak esst_snm08gkub esst_srl08gkub mrfa_w nmot rl tmot vsvw /end IN_MEASUREMENT
 /begin OUT_MEASUREMENT B_esbnb B_esbst esvw_bit wea wvesp /end OUT_MEASUREMENT
 /begin LOC_MEASUREMENT B_mrfamx weemrfa wvespnst wvespst /end LOC_MEASUREMENT
/end FUNCTION
/begin FUNCTION ESWE "Einspritzung Schubabschalten Wiedereinsetzen" /begin DEF_CHARACTERISTIC FIMHU FIMWU /end DEF_CHARACTERISTIC /begin IN_MEASUREMENT anzti B_ll B_sa /end IN_MEASUREMENT /begin OUT_MEASUREMENT fwe /end OUT_MEASUREMENT /begin LOC_MEASUREMENT anzwefim azylwe B_afwe B_fwe /end LOC_MEASUREMENT /end FUNCTION
/begin FUNCTION ESWL "Einspritzung Warmlauf"
 /begin DEF_CHARACTERISTIC ATISLATM ATIWKSTM CWWL DLAMNSWL KFFWL KFFWLW KFLASWLR LASWLTM ZKLANSWL /end DEF_CHARACTERISTIC
 /begin REF_CHARACTERISTIC SNM12ESUB SRL12ESUB STM12ESUB STS12ESUB /end REF_CHARACTERISTIC
 /begin IN_MEASUREMENT anztib_w B_lrnda B_stend B_wks esst_snm12esub esst_srl12esub esst_stm12esub esst_sts12esub lamns_w nmot rl tmot tmst /end IN_MEASUREMENT
 /begin OUT_MEASUREMENT atislatm_w atiwkstm_w fwl fwl0 fwl1 fwlw lamnswl_w laswlr /end OUT_MEASUREMENT
 /begin LOC_MEASUREMENT B_lawlon lamwl_w /end LOC_MEASUREMENT
/end FUNCTION
/begin FUNCTION FE "F¸llungseingriffe"
 /begin DEF_CHARACTERISTIC DPSFGDVH DPSGRADDR DPSGRADDRN DPSGRADTD DPSGRADUD DPSGRADUTD DPSGRENZ DPSMN DPSMX DPSRAMPE DPSTDMAMX EVHUBSOFKF FHOMIN FPUPSMAX KFDPS KFLM0812 KFMSZSVNS KFMSZSVNST KFTDKLM KFTDKST KFTDVNSFIL KFUMLTD KFVHUBML KFVHUBON KLDPSFAK KLGDVNSFIL KLTDFUEREG MINHUBOFTD MLTDDIV MLTDMAMN MLTDMAMX NGDHZONMN NMOTGD NTDMAO RLGD RLGDHZONMN S_DPSRLVW S_DPSTDO S_FPUPS S_FPUPSSOL S_GD S_GDNMOT S_GDVHUB S_HEIZL S_LLGD S_LLTD TABMIN TGDHZNST TMABMIN TMGDHZONMN TMNGDVH TSCHWGD TVDPSRLVW TVHEIZLGOF TVHEIZLGON TVTDDPSADP WPEDGD ZTDDPS /end DEF_CHARACTERISTIC
 /begin REF_CHARACTERISTIC CWMDAPP DHUBMX S_TDKF /end REF_CHARACTERISTIC
 /begin IN_MEASUREMENT bbhz_m B_hz B_ll B_llk B_llrein B_nmot B_psapp B_st B_stend B_vl B_vvtnotl dhubra_w dpsad_w dpsfg_w dpssolad_w dps_w drlfue_w evhubs_kf E_ddss E_dk E_pddss fho fkmsdk_w fkmsvvt_w ftbr_w ftvdk fupsrl_w imlatm_w kmstand minhub_w msndko_w msnvvto_w nmot nmot_w nsol nstat pirg_w ps_w pu_w pvdkds_w rl rlsol_w rl_w tabst_w tmot tmotab tmst umsrln_w Vsa_spri Vse_spri wped_w /end IN_MEASUREMENT
 /begin OUT_MEASUREMENT Btvdpsrlvw B_dpsadp B_fe B_gd B_gdhz B_gdon B_gdst B_gdvhub B_gdvvtueb B_gd_alt B_imlvhb B_lltd B_stmerker B_tdfuereg ddps_w dpsfak dpsfakro dpsgedr_w dpssolgd_w dpssoltdr_w dpssoltd_w dpssolud_w dpssol_ub dpssol_uw dpssol_w dpsuddr_w dpsvvt_w fpups_w ftvdkho_w imlvhb_w kfdps_aus mldtma_w mlhubmn_w mlnsold_w mlnsol_w mlsolkor_w mlsol_w plsol plsol_w pssol_w rlfe_w rlvw rlvwvnstf_w rlvwvnst_w rlvwvnsvf_w rlvwvnsv_w rlvwvns_w rlvwvvt_w rlvw_w S_VSGDVHUB Ttvdpsrlvw t_hubon t_nmot t_rl t_stend t_wped /end OUT_MEASUREMENT
 /begin LOC_MEASUREMENT B_hz_tpoff B_hz_tpon kmstandold relmlhubmn rlsolk_w /end LOC_MEASUREMENT
/end FUNCTION
/begin FUNCTION FFZ "Folgefunkenz¸ndung" /begin DEF_CHARACTERISTIC CW_FFZ FFLDZ FFZOF KFFFANZ /end DEF_CHARACTERISTIC /begin IN_MEASUREMENT B_stend nmot tmot ub_w zwout /end IN_MEASUREMENT /begin OUT_MEASUREMENT B_ff ffzanz ffztld_w ffztof_w /end OUT_MEASUREMENT /end FUNCTION
/begin FUNCTION FGRAUS "Abschaltung Fahrgeschwindigkeitsregler" /begin DEF_CHARACTERISTIC DMRFGRAL MRFGRMAX TFGRARLG /end DEF_CHARACTERISTIC
 /begin IN_MEASUREMENT B_acc B_fgr B_fgras B_fgren B_fgrver gangi mracc_w mrfgrv_w /end IN_MEASUREMENT
 /begin OUT_MEASUREMENT mrfgr_w /end OUT_MEASUREMENT
 /begin LOC_MEASUREMENT B_fgrari dmrar_w mrfgru_w /end LOC_MEASUREMENT
/end FUNCTION
/begin FUNCTION FGRMD "Funktionslogik und Regelalgorithmus Fahrgeschwindigkeitsregler"
 /begin DEF_CHARACTERISTIC ANZTPMX BRABEVI BRATD BRATU BRAWA1GA BRAWA2GA BRAWA3GA BRAWAVI CWFGRMD DVIVZTMX DVSAVO DVSAVU DVSKNBGA DVSKNVGA DVTIPUD DVZVITMX DVZVIWA DVZVRWA1 DVZVRWA2 DVZVRWA3 KFVOFFS KKFFGRGA KRAFGRGA MRFGRMR MRFGRSTA MRMRFGR TFGRTP TN2FGRGA TSWKNBGA TSWKNVGA TVLADV TZ2FGRGA VLMXVZ /end DEF_CHARACTERISTIC
 /begin REF_CHARACTERISTIC MRFGRMAX VFGRMAX VFGRMIN VREGLMAX VREGLMIN /end REF_CHARACTERISTIC
 /begin IN_MEASUREMENT B_acc B_fgr B_fgrenv B_fgresv B_fgrhsa B_fgrtbe B_fgrtse B_fgrtve B_fgrtwa gangi mrfgr_w mrped_w vfgr_w /end IN_MEASUREMENT
 /begin OUT_MEASUREMENT B_fgrene B_fgrkfm B_fgrvem B_savm B_tpdn B_tpup B_wiauf mrfgrm_w mrregl_w mrrgli_w vziel_w /end OUT_MEASUREMENT
 /begin LOC_MEASUREMENT anztpdn anztpup B_besch B_fgrakt B_fgrdvi B_fgrra B_kfnb B_kfnv B_swknb B_swknv B_tbenh B_tbent B_tbep B_tbeph B_tpderl B_tpuerl B_tsenh B_tsent B_tvenh B_tvent B_tvep B_tveph B_twap B_uebetu B_uebrkf B_uebvau B_uevztd B_wavo dvrabe_w dvrave_w dvzvi_w FGRMDlokBits1 FGRMDlokBits2 kfgr_w mrfgri_w tn2fgr_w tz2fgr_w vlast_w voffs_w vrbemx_w vregl_w vrvemn_w /end LOC_MEASUREMENT
/end FUNCTION
/begin FUNCTION FGRUE "‹bersicht Fahrgeschwindigkeitsregler"
 /begin IN_MEASUREMENT B_acc B_fgrene B_fgrenv B_fgrkfm B_fgrvem B_savacc B_savm mracc_w mrfgrm_w /end IN_MEASUREMENT
 /begin OUT_MEASUREMENT B_fgren B_fgrkf B_fgrver B_savfgr mrfgrv_w /end OUT_MEASUREMENT
/end FUNCTION
/begin FUNCTION FSPVDGEN "FSPVDGEN.exportedFehlerspeicherverwaltung Generator"
 /begin IN_MEASUREMENT B_gfbsupep B_gfelep B_gfhtep B_gfmeep B_gfnobsep B_pwf genfbsak genstatroh /end IN_MEASUREMENT
 /begin OUT_MEASUREMENT B_genfprl B_gfbsupak B_gfelak B_gfhtak B_gfmeak B_gfnobsak B_taerr B_tumers /end OUT_MEASUREMENT
 /begin LOC_MEASUREMENT B_gerr1 B_gerr2 B_gerr3 B_gerr4 B_gerr5 eprl1 eprl2 /end LOC_MEASUREMENT
 /begin SUB_FUNCTION DFPM_FSPVDGEN INDEX_FSPVDGEN /end SUB_FUNCTION
/end FUNCTION
/begin FUNCTION FUEDK "F¸llungssteuerung (Berechnung DK-Sollwinkel)"
 /begin DEF_CHARACTERISTIC DPLLMX DPSGRENDK FPWDKAPP KFWDKDPS KFWDKMSN KLAF KLDKVL KLDPIPOL KLDPSDKM KLDPSREGOF MSNLG TFWDKSOM TVWDKS TWDKNV TWDKSV TWDKSVST WDKSAPP WDKSNLN WDKUGDN /end DEF_CHARACTERISTIC
 /begin REF_CHARACTERISTIC CWMDAPP /end REF_CHARACTERISTIC
 /begin IN_MEASUREMENT B_fpwdkap B_gd B_gdst B_kl15 B_ll B_nmot B_stend B_vl B_vvtnotl B_wdksap B_wdksapcw dpsdpsad_w dpsfak dpssol_w dpsvbgms_w fho fkmsdk_w ftvdk ftvdkho_w mldpsad mlsol_w msndko_w mssp_w mste nmot nmot_w pvdkds_w rlvwvugd_w rlvw_w wdkdpsad wped_w /end IN_MEASUREMENT
 /begin OUT_MEASUREMENT B_tfwdksom B_wdksom dpipol dpssolad_w dwdks_w fdpsdkm_w kldpin_in kldpin_w mlsoladte mlwdkns_w tfwdksom_w wdks wdksgd wdksom_w wdksp_w wdksvt wdksv_w wdks_w wdkugd_w /end OUT_MEASUREMENT
/end FUNCTION
/begin FUNCTION FUEREG "1.20      F¸llungsregelung" /begin DEF_CHARACTERISTIC ILMRMN ILMRMX ILMRN PLMRN /end DEF_CHARACTERISTIC /begin REF_CHARACTERISTIC SNM08FEUB /end REF_CHARACTERISTIC /begin IN_MEASUREMENT B_stend esst_snm08feub nmot rlsol_w rl_w zkmsdk_w /end IN_MEASUREMENT /begin OUT_MEASUREMENT drlfue_w /end OUT_MEASUREMENT /begin LOC_MEASUREMENT B_furena drlm_w /end LOC_MEASUREMENT /end FUNCTION
/begin FUNCTION ggairb "Gebergrˆﬂe Airbag" /begin DEF_CHARACTERISTIC TCEKP /end DEF_CHARACTERISTIC /begin IN_MEASUREMENT B_ins3cok B_nmot ekpausc /end IN_MEASUREMENT /begin OUT_MEASUREMENT B_airbag /end OUT_MEASUREMENT /end FUNCTION
/begin FUNCTION GGDSAS "Gebergrˆﬂe Drucksensoren auﬂerhalb Saugrohr"
 /begin DEF_CHARACTERISTIC DPDSVLU DPUPVDK DSUGRAD DSUOFS FHOE NDSVLO NDSVLU NVGDSLL PUE PUMN PUMX PUSPSMX PVDKPUD TDDFU TDDFUUGD TDVGDSLL UADPUMN UADPUMX WDKDSVLU ZDSU /end DEF_CHARACTERISTIC
 /begin IN_MEASUREMENT B_nmot ftu ml_w nmot plsol_w pspvdk_w pssol_w ps_w udsl_w udsu_w wdkba /end IN_MEASUREMENT
 /begin OUT_MEASUREMENT B_clradhoe B_edsl B_edsuu B_hag fho fho_w fpvdkds fpvdkds_w frhol_w GgdsasNvBits pu pus_w pu_w pvdkds pvdkds_w pvdkmx_w pvdksf_w pvdkspud pvdks_w /end OUT_MEASUREMENT
 /begin LOC_MEASUREMENT dpvdkspu_w fpvdkdsl_w fpvdkdsu_w ldfki_w psspvdkd_w pvdkdsl_w pvdkdsu_w /end LOC_MEASUREMENT
/end FUNCTION
/begin FUNCTION GGDVE "Gebergrˆﬂen Drosselklappensteller"
 /begin DEF_CHARACTERISTIC DUDKP1HY DWDK12O DWDK13O DWDK23O NDKPPU NWDK3 TDKPAW TFWDKPN TVPDKP1 TVPDKP2 TVPWDK12 TVPWDK13 TVPWDK23 UBVDKPO UBVDKPU UDKP1O UDKP1U UDKP2O UDKP2U /end DEF_CHARACTERISTIC
 /begin IN_MEASUREMENT B_dkpu B_ehfs B_st B_ubpvg B_wdkhfu dkpstg_w nmot ub udkp1a_w udkp1sv udkp1vo_w udkp1vv_w udkp1v_w udkp1_w udkp2a_w udkp2_w wdkhf_w /end IN_MEASUREMENT
 /begin OUT_MEASUREMENT B_dkp1e B_dkp1mn B_dkp1mx B_dkp1np B_dkp2e B_dkp2mn B_dkp2mx B_dkp2np B_dkpaw B_dksbeg B_edks B_wdk2sel dwdkba_w wdk1_w wdk2_w wdkba wdkba_w /end OUT_MEASUREMENT
 /begin LOC_MEASUREMENT B_dkp1ev B_dkp2ev B_ubvdkp B_udk1nv B_wdk12ev B_wdk13ev B_wdk1v B_wdk23ev B_wdk2st cpaw1 cpaw2 ctdkp1 ctdkp2 ctdkpaw ctwdk12 ctwdk13 ctwdk23 wdk1 wdk1g wdk2 wdk2g wdk3g /end LOC_MEASUREMENT
/end FUNCTION
/begin FUNCTION GGEGAS "Gebergrˆﬂe Brems- und Kupplungsschalter" /begin DEF_CHARACTERISTIC CWGGEGAS TSTAEBR TVERBR TVKUP ZERBR /end DEF_CHARACTERISTIC /begin IN_MEASUREMENT B_autget B_pwf S_bls S_brs S_kupp /end IN_MEASUREMENT /begin OUT_MEASUREMENT B_bl B_br B_br2k B_brems B_kuppl B_kupplv ctrerbr /end OUT_MEASUREMENT /begin LOC_MEASUREMENT B_erbr B_staebr /end LOC_MEASUREMENT /end FUNCTION
/begin FUNCTION GGFSTT "Gebergroesse Fuellstandsgeber Tank"
 /begin DEF_CHARACTERISTIC AFSTB CWGGFST FQFSTT FSTDMN FSTDMX FSTDTOL FSTHYS FSTTAL FSTTAL1 FSTTAV FSTTEW FSTTMX GVTMX TVHALT TVKL15 ZKDFST ZKFSTV /end DEF_CHARACTERISTIC
 /begin IN_MEASUREMENT B_kl15 B_pwf B_talcan tfst tfst2 vfzg /end IN_MEASUREMENT
 /begin OUT_MEASUREMENT B_fstdmn B_fstdmx B_fsttal B_fsttg B_fsttsh B_fsttval B_tal B_talval B_tav fstt fstt_w GGFSTTBits gvtaf_w rfstt rgvtaf /end OUT_MEASUREMENT
 /begin LOC_MEASUREMENT B_fstdy B_fststa B_fsttew fstadf_w fsttaf_w fsttval_w tfst2nq_dez tfst2nq_w tfst2_dez tfstnf_w tfstnq_dez tfstnq_w tfst_dez tfst_w zkfstf /end LOC_MEASUREMENT
/end FUNCTION
/begin FUNCTION GGHFM "Gebersignal HFM"
 /begin DEF_CHARACTERISTIC HFM_MODE KFHFMKOH KFHFMKOM KFHFMKOW KFKHFM KFPU KFPU2SU KFPU3SU KFPUSU KFTHFM KFZKHFM KWNSIGMA MLHFM MLOFS PUKANS ZSIGHFM /end DEF_CHARACTERISTIC
 /begin IN_MEASUREMENT B_gdvhub B_st B_stend evhubi_w nmot nmot_w rl rlvw_w sumode tans uhfm_w wdkba /end IN_MEASUREMENT
 /begin OUT_MEASUREMENT fkhfm fpuk hfmkor hfm_sigma mlhfma_w mlhfmm_w mlhfmofs mshfmkor mshfmnof mshfm_w nmotkor tans16 wdkbau16 /end OUT_MEASUREMENT
/end FUNCTION
/begin FUNCTION GGKS "Gebergrˆﬂe Klopfsensor"
 /begin DEF_CHARACTERISTIC DKROKD DKROKMX DKROKO FMFKRN1 FMFKRN2 FMFKRN3 FMFKRN4 FMFKRN5 FMFKRN6 FMFKRN7 FMFKRN8 KEMLN KFMAKR SENZZYL /end DEF_CHARACTERISTIC
 /begin REF_CHARACTERISTIC CWDKRTP KRANH KRFHT SNM16KRUB SRL04KRUB TMKR /end REF_CHARACTERISTIC
 /begin IN_MEASUREMENT B_kr B_krldy B_krndy B_krntfv B_krtpfv B_st B_stend B_tmkr common_rt esst_snm16krub esst_srl04krub kereffw nmot rl tmot tseg_l zzyl /end IN_MEASUREMENT
 /begin OUT_MEASUREMENT AS_bf0 AS_bf1 AS_bf2 AS_bf3 AS_g0 AS_g1 AS_g2 AS_ksa1 AS_ksa2 AS_ksa3 AS_kti B_c95bf0 B_c95bf1 B_c95bf2 B_c95bf3 B_c95ks3 B_dnt B_dntb B_dtp B_dtpb B_dummy B_fmfkrc B_fmfkrco B_fmfkrcu B_krmfok B_ntini B_ot_isr B_tpnt_aw B_tpnt_e counter_mfa counter_mfe fmfkrakt fmfkraktne ggks_cc195_Bits igod_w igokr_w ikr ikrma ikrme ikrmen ikrmet ikr_tst iokkr ks_sym maxtime_mfa maxtime_mfe mintime_mfa mintime_mfe percent_mfa percent_mfe runtime_mfa runtime_mfe sen_c95 tmfln_w tmfl_w tn2 tpnt_aktiv uadki wmfa wmfa_new wmfl wmfl_new ztpnt_a zzylkr /end OUT_MEASUREMENT
/end FUNCTION
/begin FUNCTION GGLSH "Gebergrˆﬂe Lambdasondensignal (Nernst-Type) hinter Kat"
 /begin DEF_CHARACTERISTIC ANZRIBEH CWGGLSH DUSRIH DUSSPH FRINOF RBEL RINHMX RKSP TGGLS THSRIH TRIAKTH TRIIMPH TUSBELH USRIMINH USRIOH USRIUH ZFRIH /end DEF_CHARACTERISTIC
 /begin IN_MEASUREMENT B_lsh B_lsv B_ripuv B_sa B_svuerf B_ttbmhh uushk_w uushk_w_1ms uusvk_w uusvk_w_1ms uusvmb_w uusvob_w /end IN_MEASUREMENT
 /begin OUT_MEASUREMENT B_priph B_pump B_rinh B_shuerf rinh_w ushk ushk2 ushk_w /end OUT_MEASUREMENT
 /begin LOC_MEASUREMENT B_enrinh B_erinofh B_riakh B_ribeh B_riibh B_riimph B_rimh B_ripuh B_rireh B_risph B_usbeh rinofha_w rinofh_w usbeh_w ushb_w ushkr_w ushmb_w ushob_w usobh_w uushmb_w uushob_w zriberh zrinh_w /end LOC_MEASUREMENT
/end FUNCTION
/begin FUNCTION GGLSV "Gebergrˆﬂe Lambdasonde vor KAT"
 /begin DEF_CHARACTERISTIC ANZRIBEV CWGGLSV DUSRIV DUSSPV RINVMX THSRIV TRIAKTV TRIIMPV TUSBELV USRIMINV USRIOV USRIUV ZFRIV /end DEF_CHARACTERISTIC
 /begin REF_CHARACTERISTIC FRINOF RBEL RKSP TGGLS /end REF_CHARACTERISTIC
 /begin IN_MEASUREMENT B_lsv B_lsv2 B_sa B_shuerf B_ttbmh B_ttbmh2 uusvk_w /end IN_MEASUREMENT
 /begin OUT_MEASUREMENT B_pripv B_pripv2 B_rinv B_rinv2 B_ripuv B_ripuv2 B_svuerf B_svuerf2 rinofv2_w rinofv_w rinv2_w rinv_w usvb2_w usvb_w usvk usvk2 usvk2_w usvk_w uusvmb2_w uusvmb_w uusvob2_w uusvob_w /end OUT_MEASUREMENT
 /begin LOC_MEASUREMENT B_enrinv B_enrinv2 B_erinofv B_erinofv2 B_riakv B_riakv2 B_ribev B_ribev2 B_riibv B_riibv2 B_riimpv B_rimv B_rimv2 B_rirev B_rirev2 B_rispv B_rispv2 B_usbev B_usbev2 rinofva2_w rinofva_w usbev2_w usbev_w usobv2_w usobv_w usvkr2_w usvkr_w usvmb2_w usvmb_w usvob2_w usvob_w zriberv zriberv2 zrinv2_w zrinv_w /end LOC_MEASUREMENT
/end FUNCTION
/begin FUNCTION GGMFL "Gebergrˆﬂe Multifunktionslenkrad"
 /begin DEF_CHARACTERISTIC CWGGMFL TDMFL TDMFLH TFGRBTOFF TFGRBTON TFGRBTUBT TFGRMNLE TMFLBE TMFLFQE TMFLTC UBMFLMN /end DEF_CHARACTERISTIC
 /begin IN_MEASUREMENT B_bt B_btefgr B_btfgr B_clvar B_lowra B_mflai B_mflal B_mflar B_mflas B_mflen B_pwf ub /end IN_MEASUREMENT
 /begin OUT_MEASUREMENT B_fgrat B_fgrhe B_fgrhsa B_fgrtbe B_fgrtse B_fgrtve B_fgrtwa B_mfl L_fgr /end OUT_MEASUREMENT
 /begin LOC_MEASUREMENT B_biterr B_mflon B_mnmflv B_mxmflv B_npmflv B_simflv B_tctoggle mflctr mflroh tdmflc tdmflhc tframe tmflbc tmflbec tmflfqec tmfltcc zaaccflag /end LOC_MEASUREMENT
/end FUNCTION
/begin FUNCTION GGPBKV "Gebergrˆﬂe Druck f¸r Bremskraftverst‰rker"
 /begin DEF_CHARACTERISTIC CWGGPBKV DPBKVBBG DPBKVBSGV0 DPBKVBSGVS DPBKVEBG DPBKVEBGVS DPBKVEVK DPBKVEVKEP DPBKVEVKSP DPBKVSTG FBKVP KAFPBKVPU PBKVVLVF PBKVVSTGPV PUEBKV TBKVP TEBBREMS VFZGSCH /end DEF_CHARACTERISTIC
 /begin IN_MEASUREMENT B_bkvp B_brems B_cddsbkv ps_w pu_w pvdkds_w vfzg_w /end IN_MEASUREMENT
 /begin OUT_MEASUREMENT dpbkvu_w pbkvpmn_w psspbkv_w pubkv_w /end OUT_MEASUREMENT
 /begin LOC_MEASUREMENT dmnpbkv_w dmxpbkv_w dpbkvep_w dpbkvmx_w dpbkvps_w dpbkvsp_w dpspvdkd_w pbkvmod_w pbkvmpu_w /end LOC_MEASUREMENT
/end FUNCTION
/begin FUNCTION GGPED "Gebergrˆﬂe Fahrpedal"
 /begin DEF_CHARACTERISTIC CWBWEEN DUPW12 DUPW12BE DUPW12TG DUPW12VG DUPWGHY DWPMXNB DWPMXNOT NWPMBBR TFPWG2 THOPP1 THOPP2 TMBVH TPNSE1 TUPWBWF TUPWBWV TUPWG12 TUPWG1O TUPWG1U TUPWG2O TUPWG2U TWPMBBR UPW1BE UPW1LLMX UPWG12U UPWG1O UPWG1U UPWG2O UPWG2U UPWGO UPWGTG UPWGTL UPWGU UPWGUBF UPWGUR UPWGVG VWPMBBR WPMXBR WPMXNOT ZBWF /end DEF_CHARACTERISTIC
 /begin IN_MEASUREMENT B_bkva B_bkvv B_br2k B_brems B_dknot B_dksbeg B_fabr B_nmax B_pwf B_pwgnotum B_stend B_ubpvg nmot upwg1_w upwg2_w vfzg /end IN_MEASUREMENT
 /begin OUT_MEASUREMENT B_pwgnotfr B_sp1s B_sp2s B_spsmin B_upwbwf dwped dwped_w upwg2d_w upwgej_w wped wpedt_w wped_w /end OUT_MEASUREMENT
 /begin LOC_MEASUREMENT B_bwf B_bwunpl B_dupw B_dupw12 B_glf B_holp1 B_holp1a B_holp1l B_holp2 B_holp2a B_holp2l B_hop1mn B_hop2mn B_hopakt B_mbvh B_pwgbwf B_upw12e B_upw1mn B_upw1mx B_upw2mn B_upw2mx B_upwg1o B_upwg1u B_upwg2o B_upwg2u B_wpabnb B_wpmbbr ctrbwf GGPEDlokbits GGPEDlokbits2 GGPEDnonVolbits upw2ll_w upwg2fil_w upwg_w wpedv_w /end LOC_MEASUREMENT
/end FUNCTION
/begin COMPU_METHOD bfzg_ub_b27p67 "" RAT_FUNC "%6.3" "m/s^2" COEFFS 0 256 0 0 0 27.67 /end COMPU_METHOD
/begin COMPU_METHOD bfzg_uw_q0p1085 "" RAT_FUNC "%6.3" "m/s^2" COEFFS 0 1 0 0 0 0.1085 /end COMPU_METHOD
/begin COMPU_METHOD B_TRUE "boolsche Zust‰nde, positive Logik" TAB_VERB "%6.3" "" COMPU_TAB_REF B_TRUE /end COMPU_METHOD
/begin COMPU_VTAB B_TRUE "boolsche Zust‰nde, positive Logik" TAB_VERB 2 0 "----" 1 "TRUE" /end COMPU_VTAB
/begin COMPU_METHOD DEZ "1 : 1 Umrechnug (dez/hex)" RAT_FUNC "%6.2" "" COEFFS 0 1 0 0 0 1 /end COMPU_METHOD
/begin COMPU_METHOD dez "1 : 1 Umrechnug (dez/hex)" RAT_FUNC "%6.2" "" COEFFS 0 1 0 0 0 1 /end COMPU_METHOD
/begin COMPU_METHOD dezsub1 "" RAT_FUNC "%6.2" "-" COEFFS 0 1 -1 0 0 1 /end COMPU_METHOD
/begin COMPU_METHOD dgrad_uw_q0p015 "" RAT_FUNC "%6.4" "hPa/V" COEFFS 0 65536 0 0 0 1024 /end COMPU_METHOD
/begin COMPU_METHOD fak_sb_b1 "" RAT_FUNC "%6.4" "-" COEFFS 0 256 0 0 0 2 /end COMPU_METHOD
/begin COMPU_METHOD fak_ub_b1 "" RAT_FUNC "%6.4" "-" COEFFS 0 256 0 0 0 1 /end COMPU_METHOD
/begin COMPU_METHOD fak_ub_b16 "" RAT_FUNC "%6.4" "-" COEFFS 0 256 0 0 0 16 /end COMPU_METHOD
/begin COMPU_METHOD fak_ub_b2 "" RAT_FUNC "%6.4" "-" COEFFS 0 256 0 0 0 2 /end COMPU_METHOD
/begin COMPU_METHOD fak_ub_b4 "" RAT_FUNC "%6.4" "-" COEFFS 0 256 0 0 0 4 /end COMPU_METHOD
/begin COMPU_METHOD fak_ub_b8 "" RAT_FUNC "%6.4" "-" COEFFS 0 256 0 0 0 8 /end COMPU_METHOD
/begin COMPU_METHOD fak_ub_q0p00392 "" RAT_FUNC "%6.4" "-" COEFFS 0 255 0 0 0 1 /end COMPU_METHOD
/begin COMPU_METHOD fak_uw_b1 "" RAT_FUNC "%7.6" "-" COEFFS 0 65536 0 0 0 1 /end COMPU_METHOD
/begin COMPU_METHOD fak_uw_b16 "" RAT_FUNC "%6.5" "-" COEFFS 0 65536 0 0 0 16 /end COMPU_METHOD
/begin COMPU_METHOD fak_uw_b2 "" RAT_FUNC "%7.6" "-" COEFFS 0 65536 0 0 0 2 /end COMPU_METHOD
/begin COMPU_METHOD fak_uw_b4 "" RAT_FUNC "%7.6" "-" COEFFS 0 65536 0 0 0 4 /end COMPU_METHOD
/begin COMPU_METHOD fak_uw_b8 "" RAT_FUNC "%6.5" "-" COEFFS 0 65536 0 0 0 8 /end COMPU_METHOD
/begin COMPU_METHOD fak_uw_q0p001 "" RAT_FUNC "%6.5" "-" COEFFS 0 65536 0 0 0 65.536 /end COMPU_METHOD
/begin COMPU_METHOD fak_uw_q0p01 "" RAT_FUNC "%6.4" "-" COEFFS 0 1 0 0 0 0.01 /end COMPU_METHOD
/begin COMPU_METHOD fmfkr_dez "" RAT_FUNC "%5.2" "kHz" COEFFS 0 1 0 0 0 1 /end COMPU_METHOD
/begin COMPU_METHOD hub_uw_q0p001 "" RAT_FUNC "%6.5" "mm" COEFFS 0 1000 0 0 0 1 /end COMPU_METHOD
/begin COMPU_METHOD km_uw_q10 "" RAT_FUNC "%6.1" "km" COEFFS 0 1 0 0 0 10 /end COMPU_METHOD
/begin COMPU_METHOD kw_q3 "" RAT_FUNC "%6.2" "Grad KW" COEFFS 0 1 0 0 0 3 /end COMPU_METHOD
/begin COMPU_METHOD m_uw_b1638p4 "" RAT_FUNC "%6.4" "kg/h" COEFFS 0 1 0 0 0 0.025 /end COMPU_METHOD
/begin COMPU_METHOD m_uw_b23p3 "" RAT_FUNC "%6.5" "kg" COEFFS 0 2812.5 0 0 0 1 /end COMPU_METHOD
/begin COMPU_METHOD m_uw_b6553p5 "" RAT_FUNC "%6.3" "kg/h" COEFFS 0 1 0 0 0 0.1 /end COMPU_METHOD
/begin COMPU_METHOD nmot_ub_q10 "" RAT_FUNC "%6.1" "1/min" COEFFS 0 1 0 0 0 10 /end COMPU_METHOD
/begin COMPU_METHOD nmot_ub_q40 "" RAT_FUNC "%6.1" "1/min" COEFFS 0 1 0 0 0 40 /end COMPU_METHOD
/begin COMPU_METHOD nmot_uw_q0p25 "" RAT_FUNC "%6.3" "1/min" COEFFS 0 1 0 0 0 0.25 /end COMPU_METHOD
/begin COMPU_METHOD pgrad_q0p039 "" RAT_FUNC "%6.4" "hPa/s" COEFFS 0 128 0 0 0 5 /end COMPU_METHOD
/begin COMPU_METHOD pgrad_q0p15625 "" RAT_FUNC "%6.3" "hPa/s" COEFFS 0 32 0 0 0 5 /end COMPU_METHOD
/begin COMPU_METHOD p_q0p039 "" RAT_FUNC "%6.4" "hPa" COEFFS 0 256 0 0 0 10 /end COMPU_METHOD
/begin COMPU_METHOD p_q0p039s32768 "" RAT_FUNC "%7.1" "hPa" COEFFS 0 256 327680 0 0 10 /end COMPU_METHOD
/begin COMPU_METHOD p_q10p0 "" RAT_FUNC "%6.1" "hPa" COEFFS 0 1 0 0 0 10 /end COMPU_METHOD
/begin COMPU_METHOD p_sw_q0p039 "" RAT_FUNC "%6.4" "hPa" COEFFS 0 256 0 0 0 10 /end COMPU_METHOD
/begin COMPU_METHOD p_ub_q10 "" RAT_FUNC "%6.1" "hPa" COEFFS 0 1 0 0 0 10 /end COMPU_METHOD
/begin COMPU_METHOD p_ub_q5 "" RAT_FUNC "%6.2" "hPa" COEFFS 0 1 0 0 0 5 /end COMPU_METHOD
/begin COMPU_METHOD p_uw_q0p039 "" RAT_FUNC "%6.4" "hPa" COEFFS 0 256 0 0 0 10 /end COMPU_METHOD
/begin COMPU_METHOD relDK_q0p02441 "" RAT_FUNC "%6.4" "%DK" COEFFS 0 65536 0 0 0 1600 /end COMPU_METHOD
/begin COMPU_METHOD relDK_ub_b100 "" RAT_FUNC "%6.3" "%DK" COEFFS 0 255 0 0 0 100 /end COMPU_METHOD
/begin COMPU_METHOD relPED_ub_b100 "" RAT_FUNC "%6.3" "%PED" COEFFS 0 255 0 0 0 100 /end COMPU_METHOD
/begin COMPU_METHOD relPED_uw_b100 "" RAT_FUNC "%6.4" "%PED" COEFFS 0 65535 0 0 0 100 /end COMPU_METHOD
/begin COMPU_METHOD rel_q0p1 "" RAT_FUNC "%6.3" "%" COEFFS 0 10 0 0 0 1 /end COMPU_METHOD
/begin COMPU_METHOD rel_sb_q0p39 "" RAT_FUNC "%6.3" "%" COEFFS 0 1 0 0 0 0.3906 /end COMPU_METHOD
/begin COMPU_METHOD rel_sw_b50 "" RAT_FUNC "%6.4" "%" COEFFS 0 65536 0 0 0 100 /end COMPU_METHOD
/begin COMPU_METHOD rel_sw_q0p0234 "" RAT_FUNC "%6.4" "%/seg" COEFFS 0 32 0 0 0 0.75 /end COMPU_METHOD
/begin COMPU_METHOD rel_ub_b127p5 "" RAT_FUNC "%6.3" "%" COEFFS 0 2 0 0 0 1 /end COMPU_METHOD
/begin COMPU_METHOD rel_ub_b99p6 "" RAT_FUNC "%6.3" "%" COEFFS 0 256 0 0 0 100 /end COMPU_METHOD
/begin COMPU_METHOD rel_ub_q0p75 "" RAT_FUNC "%6.3" "%" COEFFS 0 1 0 0 0 0.75 /end COMPU_METHOD
/begin COMPU_METHOD rel_uw_b100 "" RAT_FUNC "%6.4" "%" COEFFS 0 65536 0 0 0 100 /end COMPU_METHOD
/begin COMPU_METHOD rel_uw_b200 "" RAT_FUNC "%6.4" "%" COEFFS 0 65536 0 0 0 200 /end COMPU_METHOD
/begin COMPU_METHOD rel_uw_b3200 "" RAT_FUNC "%6.4" "%" COEFFS 0 65536 0 0 0 3200 /end COMPU_METHOD
/begin COMPU_METHOD rel_uw_q0p0234 "" RAT_FUNC "%6.4" "%" COEFFS 0 32 0 0 0 0.75 /end COMPU_METHOD
/begin COMPU_METHOD r_uw_q2 "" RAT_FUNC "%6.2" "Ohm" COEFFS 0 1 0 0 0 2 /end COMPU_METHOD
/begin COMPU_METHOD spgg_sw_b3052 "" RAT_FUNC "%6.3" "V/s" COEFFS 0 1 0 0 0 0.0931323 /end COMPU_METHOD
/begin COMPU_METHOD spg_q0p00977 "" RAT_FUNC "%6.4" "V" COEFFS 0 256 0 0 0 2.5 /end COMPU_METHOD
/begin COMPU_METHOD spg_sw_q0p00488 "" RAT_FUNC "%6.4" "V" COEFFS 0 1024 0 0 0 5 /end COMPU_METHOD
/begin COMPU_METHOD spg_ubatt "" RAT_FUNC "%6.3" "V" COEFFS 0 1 0 0 0 0.0942 /end COMPU_METHOD
/begin COMPU_METHOD spg_ub_b5 "" RAT_FUNC "%6.4" "V" COEFFS 0 256 0 0 0 5 /end COMPU_METHOD
/begin COMPU_METHOD spg_ub_q0p0052_o0p2 "" RAT_FUNC "%6.3" "V" COEFFS 0 255 51 0 0 1.33 /end COMPU_METHOD
/begin COMPU_METHOD spg_ub_q0p019 "" RAT_FUNC "%6.4" "V" COEFFS 0 1 0 0 0 0.019 /end COMPU_METHOD
/begin COMPU_METHOD spg_uw_q0p001222 "" RAT_FUNC "%6.4" "V" COEFFS 0 1 0 0 0 0.001222 /end COMPU_METHOD
/begin COMPU_METHOD spg_uw_q0p00488 "" RAT_FUNC "%6.4" "V" COEFFS 0 1024 0 0 0 5 /end COMPU_METHOD
/begin COMPU_METHOD spg_uw_q0p00488_o1 "" RAT_FUNC "%6.3" "V" COEFFS 0 1024 1024 0 0 5 /end COMPU_METHOD
/begin COMPU_METHOD sprzi_q0p1 "" RAT_FUNC "%4.2" "Grad KW" COEFFS 0 10 0 0 0 1 /end COMPU_METHOD
/begin COMPU_METHOD t100msxs_ub_b25p5 "" RAT_FUNC "%6.3" "s" COEFFS 0 1 0 0 0 0.1 /end COMPU_METHOD
/begin COMPU_METHOD t100msxs_uw_b6553p5 "" RAT_FUNC "%6.3" "s" COEFFS 0 1 0 0 0 0.1 /end COMPU_METHOD
/begin COMPU_METHOD t10msxs_ub_b2p55 "" RAT_FUNC "%6.4" "s" COEFFS 0 1 0 0 0 0.01 /end COMPU_METHOD
/begin COMPU_METHOD t10msxs_uw_b655p35 "" RAT_FUNC "%6.4" "s" COEFFS 0 1 0 0 0 0.01 /end COMPU_METHOD
/begin COMPU_METHOD t1msxms_q1 "" RAT_FUNC "%6.2" "ms" COEFFS 0 1 0 0 0 1 /end COMPU_METHOD
/begin COMPU_METHOD t1sxs_uw_q1 "" RAT_FUNC "%6.2" "s" COEFFS 0 1 0 0 0 1 /end COMPU_METHOD
/begin COMPU_METHOD t20msxs_ub_b5p1 "" RAT_FUNC "%6.4" "s" COEFFS 0 1 0 0 0 0.02 /end COMPU_METHOD
/begin COMPU_METHOD t20msxs_uw_q0p02 "" RAT_FUNC "%6.4" "s" COEFFS 0 1 0 0 0 0.02 /end COMPU_METHOD
/begin COMPU_METHOD t50msxs_q0p05 "" RAT_FUNC "%6.4" "s" COEFFS 0 1 0 0 0 0.05 /end COMPU_METHOD
/begin COMPU_METHOD t50msxs_ub_b12p75 "" RAT_FUNC "%6.4" "s" COEFFS 0 1 0 0 0 0.05 /end COMPU_METHOD
/begin COMPU_METHOD temp_ub_q0p75_o48 "" RAT_FUNC "%6.2" "Grad C" COEFFS 0 1 48 0 0 0.75 /end COMPU_METHOD
/begin COMPU_METHOD temp_uw_q0p75_o48 "" RAT_FUNC "%6.2" "Grad C" COEFFS 0 1 48 0 0 0.75 /end COMPU_METHOD
/begin COMPU_METHOD tus_uw_q3p2 "" RAT_FUNC "%6.2" "us" COEFFS 0 1 0 0 0 3.2 /end COMPU_METHOD
/begin COMPU_METHOD txms_uw_q0p001 "" RAT_FUNC "%6.5" "ms" COEFFS 0 1000 0 0 0 1 /end COMPU_METHOD
/begin COMPU_METHOD t_q0p4us "" RAT_FUNC "%6.3" "us" COEFFS 0 1 0 0 0 0.4 /end COMPU_METHOD
/begin COMPU_METHOD vfzg_sw_q0p00781 "" RAT_FUNC "%6.4" "km/h" COEFFS 0 1 0 0 0 0.0078125 /end COMPU_METHOD
/begin COMPU_METHOD vfzg_ub_q1p25 "" RAT_FUNC "%6.2" "km/h" COEFFS 0 1 0 0 0 1.25 /end COMPU_METHOD
/begin COMPU_METHOD vfzg_uw_b512 "" RAT_FUNC "%6.4" "km/h" COEFFS 0 65536 0 0 0 512 /end COMPU_METHOD
/begin COMPU_METHOD vfzg_uw_q0p00781 "" RAT_FUNC "%6.4" "km/h" COEFFS 0 1 0 0 0 0.0078125 /end COMPU_METHOD
/begin COMPU_METHOD vol_q0p1_l "" RAT_FUNC "%6.3" "l" COEFFS 0 1 0 0 0 0.1 /end COMPU_METHOD
/begin COMPU_METHOD vol_q1_l "" RAT_FUNC "%6.2" "l" COEFFS 0 1 0 0 0 1 /end COMPU_METHOD
/begin COMPU_METHOD vol_q4p8828Em3_l "" RAT_FUNC "%6.4" "l" COEFFS 0 65536 0 0 0 320 /end COMPU_METHOD
/begin COMPU_METHOD zk100msxs_ub_b25p5 "" RAT_FUNC "%6.3" "s" COEFFS 0 0 256 0 10 0 /end COMPU_METHOD
/begin COMPU_METHOD zk100msxs_uw_b6553 "" RAT_FUNC "%10.3" "s" COEFFS 0 0 65536 0 10 0 /end COMPU_METHOD
/begin COMPU_METHOD zk10msxs_ub_b2p55 "" RAT_FUNC "%6.4" "s" COEFFS 0 0 255 0 100 0 /end COMPU_METHOD
/begin COMPU_METHOD zk10msxs_uw_b655 "" RAT_FUNC "%6.2" "s" COEFFS 0 0 65536 0 100 0 /end COMPU_METHOD
/begin COMPU_METHOD zk20msxs_uw_b1310 "" RAT_FUNC "%6.1" "s" COEFFS 0 0 1310 0 1 0 /end COMPU_METHOD
/begin COMPU_METHOD zk50msxs_ub_b12p8 "" RAT_FUNC "%6.3" "s" COEFFS 0 0 128 0 10 0 /end COMPU_METHOD
/begin COMPU_METHOD zk_p_q0p039 "" RAT_FUNC "%6.4" "hPa/100ms" COEFFS 0 256 0 0 0 10 /end COMPU_METHOD
/begin COMPU_METHOD zw_ub_q0p75 "" RAT_FUNC "%6.3" "Grad KW" COEFFS 0 255 0 0 0 191.25 /end COMPU_METHOD
/begin COMPU_METHOD default "" RAT_FUNC "%6.2" "" COEFFS 0 1 0 0 0 1 /end COMPU_METHOD
/begin RECORD_LAYOUT FklWU16 FNC_VALUES 1 UWORD COLUMN_DIR DIRECT /end RECORD_LAYOUT
/begin RECORD_LAYOUT FklWUb FNC_VALUES 1 UBYTE COLUMN_DIR DIRECT /end RECORD_LAYOUT
/begin RECORD_LAYOUT FklWUw FNC_VALUES 1 UWORD COLUMN_DIR DIRECT /end RECORD_LAYOUT
/begin RECORD_LAYOUT GkfWU8 FNC_VALUES 1 UBYTE COLUMN_DIR DIRECT /end RECORD_LAYOUT
/begin RECORD_LAYOUT GkfWUb FNC_VALUES 1 UBYTE COLUMN_DIR DIRECT /end RECORD_LAYOUT
/begin RECORD_LAYOUT GklWSb FNC_VALUES 1 SBYTE COLUMN_DIR DIRECT /end RECORD_LAYOUT
/begin RECORD_LAYOUT GklWU16 FNC_VALUES 1 UWORD COLUMN_DIR DIRECT /end RECORD_LAYOUT
/begin RECORD_LAYOUT GklWU8 FNC_VALUES 1 UBYTE COLUMN_DIR DIRECT /end RECORD_LAYOUT
/begin RECORD_LAYOUT GklWUb FNC_VALUES 1 UBYTE COLUMN_DIR DIRECT /end RECORD_LAYOUT
/begin RECORD_LAYOUT GklWUw FNC_VALUES 1 UWORD COLUMN_DIR DIRECT /end RECORD_LAYOUT
/begin RECORD_LAYOUT KfAxU16AyU16SstxU16SstyU16WU16 NO_AXIS_PTS_X 1 UWORD NO_AXIS_PTS_Y 2 UWORD AXIS_PTS_X 3 UWORD INDEX_INCR DIRECT AXIS_PTS_Y 4 UWORD INDEX_INCR DIRECT FNC_VALUES 5 UWORD COLUMN_DIR DIRECT /end RECORD_LAYOUT
/begin RECORD_LAYOUT KfAxU8AyU8SstxU16SstyU16WU16 NO_AXIS_PTS_X 1 UWORD NO_AXIS_PTS_Y 2 UWORD AXIS_PTS_X 3 UWORD INDEX_INCR DIRECT AXIS_PTS_Y 4 UWORD INDEX_INCR DIRECT FNC_VALUES 5 UWORD COLUMN_DIR DIRECT /end RECORD_LAYOUT
/begin RECORD_LAYOUT KfAxU8AyU8SstxU8SstyU8WU8 NO_AXIS_PTS_X 1 UBYTE NO_AXIS_PTS_Y 2 UBYTE AXIS_PTS_X 3 UBYTE INDEX_INCR DIRECT AXIS_PTS_Y 4 UBYTE INDEX_INCR DIRECT FNC_VALUES 5 UBYTE COLUMN_DIR DIRECT /end RECORD_LAYOUT
/begin RECORD_LAYOUT KfAxUbAyUbSstxUbSstyUbWUb NO_AXIS_PTS_X 1 UBYTE NO_AXIS_PTS_Y 2 UBYTE AXIS_PTS_X 3 UBYTE INDEX_INCR DIRECT AXIS_PTS_Y 4 UBYTE INDEX_INCR DIRECT FNC_VALUES 5 UBYTE COLUMN_DIR DIRECT /end RECORD_LAYOUT
/begin RECORD_LAYOUT KfAxUwAyUwSstxUwSstyUwWUw NO_AXIS_PTS_X 1 UWORD NO_AXIS_PTS_Y 2 UWORD AXIS_PTS_X 3 UWORD INDEX_INCR DIRECT AXIS_PTS_Y 4 UWORD INDEX_INCR DIRECT FNC_VALUES 5 UWORD COLUMN_DIR DIRECT /end RECORD_LAYOUT
/begin RECORD_LAYOUT KlAUbSstUbWUb NO_AXIS_PTS_X 1 UBYTE AXIS_PTS_X 2 UBYTE INDEX_INCR DIRECT FNC_VALUES 3 UBYTE COLUMN_DIR DIRECT /end RECORD_LAYOUT
/begin RECORD_LAYOUT KlAUwSstSwWUw NO_AXIS_PTS_X 1 UWORD AXIS_PTS_X 2 SWORD INDEX_INCR DIRECT FNC_VALUES 3 UWORD COLUMN_DIR DIRECT /end RECORD_LAYOUT
/begin RECORD_LAYOUT KlAUwSstUwWUw NO_AXIS_PTS_X 1 UWORD AXIS_PTS_X 2 UWORD INDEX_INCR DIRECT FNC_VALUES 3 UWORD COLUMN_DIR DIRECT /end RECORD_LAYOUT
/begin RECORD_LAYOUT KlAxU16SstxU16WU16 NO_AXIS_PTS_X 1 UWORD AXIS_PTS_X 2 UWORD INDEX_INCR DIRECT FNC_VALUES 3 UWORD COLUMN_DIR DIRECT /end RECORD_LAYOUT
/begin RECORD_LAYOUT KlAxU8SstxS16WS16 NO_AXIS_PTS_X 1 SWORD AXIS_PTS_X 2 SWORD INDEX_INCR DIRECT FNC_VALUES 3 SWORD COLUMN_DIR DIRECT /end RECORD_LAYOUT
/begin RECORD_LAYOUT KlAxU8SstxU16WU16 NO_AXIS_PTS_X 1 UWORD AXIS_PTS_X 2 UWORD INDEX_INCR DIRECT FNC_VALUES 3 UWORD COLUMN_DIR DIRECT /end RECORD_LAYOUT
/begin RECORD_LAYOUT KlAxU8SstxU8WS8 NO_AXIS_PTS_X 1 UBYTE AXIS_PTS_X 2 UBYTE INDEX_INCR DIRECT FNC_VALUES 3 SBYTE COLUMN_DIR DIRECT /end RECORD_LAYOUT
/begin RECORD_LAYOUT KlAxU8SstxU8WU8 NO_AXIS_PTS_X 1 UBYTE AXIS_PTS_X 2 UBYTE INDEX_INCR DIRECT FNC_VALUES 3 UBYTE COLUMN_DIR DIRECT /end RECORD_LAYOUT
/begin RECORD_LAYOUT KwbUb FNC_VALUES 1 UBYTE COLUMN_DIR DIRECT /end RECORD_LAYOUT
/begin RECORD_LAYOUT KwSw FNC_VALUES 1 SWORD COLUMN_DIR DIRECT /end RECORD_LAYOUT
/begin RECORD_LAYOUT KwUb FNC_VALUES 1 UBYTE COLUMN_DIR DIRECT /end RECORD_LAYOUT
/begin RECORD_LAYOUT KwUw FNC_VALUES 1 UWORD COLUMN_DIR DIRECT /end RECORD_LAYOUT
/begin RECORD_LAYOUT KwWS16 FNC_VALUES 1 SWORD COLUMN_DIR DIRECT /end RECORD_LAYOUT
/begin RECORD_LAYOUT KwWU16 FNC_VALUES 1 UWORD COLUMN_DIR DIRECT /end RECORD_LAYOUT
/begin RECORD_LAYOUT KwWU8 FNC_VALUES 1 UBYTE COLUMN_DIR DIRECT /end RECORD_LAYOUT
/begin RECORD_LAYOUT SstAU8SstU8 NO_AXIS_PTS_X 1 UBYTE AXIS_PTS_X 2 UBYTE INDEX_INCR DIRECT /end RECORD_LAYOUT
/begin RECORD_LAYOUT SstAUbSstUb NO_AXIS_PTS_X 1 UBYTE AXIS_PTS_X 2 UBYTE INDEX_INCR DIRECT /end RECORD_LAYOUT
/end MODULE
/end PROJECT
