ASAP2_VERSION 1 3
/begin PROJECT basisme9 ""
/begin HEADER "" VERSION "basisme9" PROJECT_NO basisme9 /end HEADER
/begin MODULE DIM ""
/begin MOD_COMMON "" BYTE_ORDER MSB_FIRST ALIGNMENT_BYTE 1 ALIGNMENT_WORD 2 ALIGNMENT_LONG 2 ALIGNMENT_FLOAT32_IEEE 4 /end MOD_COMMON
/begin CHARACTERISTIC ATVINI "Initialisierungswert f¸r Stellgrˆﬂe atv, Aktivieren ¸ber Codewort NOATV" VALUE 0x4E8778 KwSb 2.550 t100msxs_sb_q0p01 -1.280 1.270 FORMAT "%5.3" /end CHARACTERISTIC
/begin CHARACTERISTIC ATVINI2 "Initialisierungswert f¸r Stellgrˆﬂe atv, Bank 2, Aktivieren ¸ber Codewort NOATV" VALUE 0x4E8779 KwSb 2.550 t100msxs_sb_q0p01 -1.280 1.270 FORMAT "%5.3" /end CHARACTERISTIC
/begin CHARACTERISTIC ATVMN "untere Regelbereichsgrenze f¸r Stellgrˆﬂe atv" VALUE 0x4E877A KwSb 2.550 t100msxs_sb_q0p01 -1.280 1.270 FORMAT "%5.3" /end CHARACTERISTIC
/begin CHARACTERISTIC ATVMX "obere Regelbereichsgrenze f¸r Stellgrˆﬂe atv" VALUE 0x4E877B KwSb 2.550 t100msxs_sb_q0p01 -1.280 1.270 FORMAT "%5.3" /end CHARACTERISTIC
/begin CHARACTERISTIC Ausble_en "Steuerbyte Zylinderausblendung" VALUE 0x4E9810 KwWU8 255.0 dez 0.00 255.0 FORMAT "%5.1" /end CHARACTERISTIC
/begin CHARACTERISTIC Ausble_init "" VALUE 0x4E9804 KwWU16 65535.00 dez 0.00 65535.00 FORMAT "%8.2" /end CHARACTERISTIC
/begin CHARACTERISTIC CFRA "" VALUE 0x4E86E0 KwUb 255.0 dez 0.00 255.0 FORMAT "%5.1" /end CHARACTERISTIC
/begin CHARACTERISTIC CLRHK "" VALUE 0x4E877C KwUb 255.0 dez 0.00 255.0 FORMAT "%5.1" /end CHARACTERISTIC
/begin CHARACTERISTIC CLRKA "" VALUE 0x4E8808 KwUb 255.0 dez 0.00 255.0 FORMAT "%5.1" /end CHARACTERISTIC
/begin CHARACTERISTIC CLRZWTMS "Codewort Zwangseinschaltung LR gem‰ﬂ CARB-Forderung" VALUE 0x4EE134 KwUb 255.0 dez 0.00 255.0 FORMAT "%5.1" /end CHARACTERISTIC
/begin CHARACTERISTIC CNFMDVER "Codewort zur Konfiguration von MDVER" VALUE 0x4ED74C KwUb 255.0 dez 0.00 255.0 FORMAT "%5.1" /end CHARACTERISTIC
/begin CHARACTERISTIC CREDSTU "Codewort f¸r Reduzierstufe ein/aus" VALUE 0x4E839E KwUb 255.0 dez 0.00 255.0 FORMAT "%5.1" /end CHARACTERISTIC
/begin CHARACTERISTIC CWDMFAB "Codewort Sw-Schalter f¸r ƒnderungsbegrenzung" VALUE 0x4E6B8C KwUb 255.0 DEZ 0.00 255.0 FORMAT "%5.1" /end CHARACTERISTIC
/begin CHARACTERISTIC CWDMFAB2 "" VALUE 0x4E6B8D KwUb 255.0 DEZ 0.00 255.0 FORMAT "%5.1" /end CHARACTERISTIC
/begin CHARACTERISTIC CWETAZWBM "" VALUE 0x4E61D2 KwUb 255.0 dez 0.00 255.0 FORMAT "%5.1" /end CHARACTERISTIC
/begin CHARACTERISTIC CWLRATZYL "" VALUE 0x4E4DA8 KwWU8 255.0 dez 0.00 255.0 FORMAT "%5.1" /end CHARACTERISTIC
/begin CHARACTERISTIC CWLRFSLS "" VALUE 0x4EE135 KwUb 255.0 dez 0.00 255.0 FORMAT "%5.1" /end CHARACTERISTIC
/begin CHARACTERISTIC CWLRSLS "" VALUE 0x4EE136 KwUb 255.0 dez 0.00 255.0 FORMAT "%5.1" /end CHARACTERISTIC
/begin CHARACTERISTIC CWMAS "" VALUE 0x4E8308 KwUb 255.0 dez 0.00 255.0 FORMAT "%5.1" /end CHARACTERISTIC
/begin CHARACTERISTIC CWMBAS "Codewort f¸r MDBAS" VALUE 0x4E61D3 KwUb 255.0 dez 0.00 255.0 FORMAT "%5.1" /end CHARACTERISTIC
/begin CHARACTERISTIC CWMDKOG "Codewort MDKOG: Z¸ndwinkelsp‰tverstellung bei Unterdruckbegrenzung" VALUE 0x4E70D2 KwUb 255.0 dez 0.00 255.0 FORMAT "%5.1" /end CHARACTERISTIC
/begin CHARACTERISTIC CWMFS "" VALUE 0x4E8309 KwUb 255.0 dez 0.00 255.0 FORMAT "%5.1" /end CHARACTERISTIC
/begin CHARACTERISTIC CWTEZW "Codewort Z¸ndwinkeleingriff bei TEV-Pr¸fung" VALUE 0x4E70D3 KwUb 255.0 dez 0.00 255.0 FORMAT "%5.1" /end CHARACTERISTIC
/begin CHARACTERISTIC CWZWE "Codewort ZW-Eingriffe f¸r MD-Struktur aktiv" VALUE 0x4E70D4 KwUb 255.0 dez 0.00 255.0 FORMAT "%5.1" /end CHARACTERISTIC
/begin CHARACTERISTIC CWZWVMX "Codewort Z¸ndwinkeleingriff bei VMAX-Begrenzung" VALUE 0x4E70D5 KwUb 255.0 dez 0.00 255.0 FORMAT "%5.1" /end CHARACTERISTIC
/begin CHARACTERISTIC CW_FDSU "" VALUE 0x4E9762 KwWU8 255.0 dez 0.00 255.0 FORMAT "%5.1" /end CHARACTERISTIC
/begin CHARACTERISTIC CW_FMKNUL "" VALUE 0x4E6B8E KwUb 255.0 dez 0.00 255.0 FORMAT "%5.1" /end CHARACTERISTIC
/begin CHARACTERISTIC CW_FSST2E "" VALUE 0x4E9763 KwWU8 255.0 dez 0.00 255.0 FORMAT "%5.1" /end CHARACTERISTIC
/begin CHARACTERISTIC CW_FTA "" VALUE 0x4E9764 KwWU8 255.0 dez 0.00 255.0 FORMAT "%5.1" /end CHARACTERISTIC
/begin CHARACTERISTIC CW_LRAFDSU "" VALUE 0x4E4DA9 KwWU8 255.0 dez 0.00 255.0 FORMAT "%5.1" /end CHARACTERISTIC
/begin CHARACTERISTIC CW_LRAFTA "" VALUE 0x4E4DAA KwWU8 255.0 dez 0.00 255.0 FORMAT "%5.1" /end CHARACTERISTIC
/begin CHARACTERISTIC CW_LRAST "" VALUE 0x4E4D76 KwUb 1.00000000000 B_TRUE 0.00 1.00000000000 FORMAT "%13.11" /end CHARACTERISTIC
/begin CHARACTERISTIC DFRMN "" VALUE 0x4E8708 KwSw 1.999969 fak_sw_b1 -1.000000 0.9999695 FORMAT "%8.6" /end CHARACTERISTIC
/begin CHARACTERISTIC DFRSPS "" VALUE 0x4E870A KwSw 1.999969 fak_sw_b1 -1.000000 0.9999695 FORMAT "%8.6" /end CHARACTERISTIC
/begin CHARACTERISTIC DLSDHK "D‰mpfung PT2-Filter Lastschlagd‰mpfung bei hohem Kupplungsmoment" VALUE 0x4E6B92 KwUw 1.999969 fak_uw_b2 0.00 1.999969 FORMAT "%8.6" /end CHARACTERISTIC
/begin CHARACTERISTIC DLSDWE "" VALUE 0x4E6B94 KwUw 3.999939 fak_uw_b4 0.00 3.999939 FORMAT "%8.6" /end CHARACTERISTIC
/begin CHARACTERISTIC Dlurmx "Aenderungsbegrenzung Lur" VALUE 0x4E9811 KwWU8 255.0 lur_q1 0.00 255.0 FORMAT "%5.1" /end CHARACTERISTIC
/begin CHARACTERISTIC DMADFK "Maximal adaptierbares Delta-Verlustmoment pro Adaptionsphase Fahrst.+Kompr." VALUE 0x4ED7AA KwUb 24.90 rel_ub_b24p9 0.00 24.90 FORMAT "%5.2" /end CHARACTERISTIC
/begin CHARACTERISTIC DMADFS "Maximal adaptierbares Delta-Verlustmoment pro Adaptionsphase mit Fahrstufe ein" VALUE 0x4ED7AB KwUb 24.90 rel_ub_b24p9 0.00 24.90 FORMAT "%5.2" /end CHARACTERISTIC
/begin CHARACTERISTIC DMADKO "Maximal adaptierbares Delta-Verlustmoment pro Adaptionsphase Kompr.ein" VALUE 0x4ED7AC KwUb 24.90 rel_ub_b24p9 0.00 24.90 FORMAT "%5.2" /end CHARACTERISTIC
/begin CHARACTERISTIC DMADLL "Maximal adaptierbares Delta-Verlustmoment pro Adaptionsphase ohne Last" VALUE 0x4ED7AD KwUb 24.90 rel_ub_b24p9 0.00 24.90 FORMAT "%5.2" /end CHARACTERISTIC
/begin CHARACTERISTIC DMADMNFK "Minimal adaptierbares Delta-Verlustmoment Fahrstufe eingelegt + Kompressor ein" VALUE 0x4ED7AE KwUb 24.90 rel_ub_bn24p9 -24.90 0.00 FORMAT "%5.2" /end CHARACTERISTIC
/begin CHARACTERISTIC DMADMNFS "Minimal adaptierbares Delta-Verlustmoment Fahrstufe eingelegt" VALUE 0x4ED7AF KwUb 24.90 rel_ub_bn24p9 -24.90 0.00 FORMAT "%5.2" /end CHARACTERISTIC
/begin CHARACTERISTIC DMADMNKO "Minimal adaptierbares Delta-Verlustmoment Klimakompressor ein" VALUE 0x4ED7B0 KwUb 24.90 rel_ub_bn24p9 -24.90 0.00 FORMAT "%5.2" /end CHARACTERISTIC
/begin CHARACTERISTIC DMADMNLL "Minimal adaptierbares Delta-Verlustmoment ohne Last" VALUE 0x4ED7B1 KwUb 24.90 rel_ub_bn24p9 -24.90 0.00 FORMAT "%5.2" /end CHARACTERISTIC
/begin CHARACTERISTIC DMADMXFK "Maximal adaptierbares Delta-Verlustmoment Farstufe + Klimakompressor ein" VALUE 0x4ED7B2 KwUb 24.90 rel_ub_b24p9 0.00 24.90 FORMAT "%5.2" /end CHARACTERISTIC
/begin CHARACTERISTIC DMADMXFS "Maximal adaptierbares Delta-Verlustmoment Farstufe ein" VALUE 0x4ED7B3 KwUb 24.90 rel_ub_b24p9 0.00 24.90 FORMAT "%5.2" /end CHARACTERISTIC
/begin CHARACTERISTIC DMADMXKO "Maximal adaptierbares Delta-Verlustmoment Klimakompressor ein" VALUE 0x4ED7B4 KwUb 24.90 rel_ub_b24p9 0.00 24.90 FORMAT "%5.2" /end CHARACTERISTIC
/begin CHARACTERISTIC DMADMXLL "Maximal adaptierbares Delta-Verlustmoment ohne Last" VALUE 0x4ED7B5 KwUb 24.90 rel_ub_b24p9 0.00 24.90 FORMAT "%5.2" /end CHARACTERISTIC
/begin CHARACTERISTIC DMAXMFS "" VALUE 0x4EDE62 KwSw 199.9969 rel_sw_b100 -100.0000 99.99695 FORMAT "%8.4" /end CHARACTERISTIC
/begin CHARACTERISTIC Dmde "Delta Mde fuer Ausblendung" VALUE 0x4E9812 KwWU8 255.0 dez 0.00 255.0 FORMAT "%5.1" /end CHARACTERISTIC
/begin CHARACTERISTIC Dmdind "Maximale Lastaenderung (max. Dmdind/seg)" VALUE 0x4E9813 KwWU8 510.0 lur_dmd 0.00 510.0 FORMAT "%5.1" /end CHARACTERISTIC
/begin CHARACTERISTIC DMDNSM "Delta Moment zur Nachstartkompensation" CURVE 0x4ED750 KlAUbSstUbWUb 99.61 rel_ub_b99p6 0.00 99.61 FORMAT "%5.2"
 /begin AXIS_DESCR STD_AXIS tmot temp_ub_q0p75_o48 8 -48.00 143.3 FORMAT "%5.1" DEPOSIT ABSOLUTE /end AXIS_DESCR
/end CHARACTERISTIC
/begin CHARACTERISTIC DMDNSMVT "Delta Moment zur Nachstartkompensation (VVT)" CURVE 0x4ED764 KlAUbSstUbWUb 99.61 rel_ub_b99p6 0.00 99.61 FORMAT "%5.2"
 /begin AXIS_DESCR STD_AXIS tmot temp_ub_q0p75_o48 8 -48.00 143.3 FORMAT "%5.1" DEPOSIT ABSOLUTE /end AXIS_DESCR
/end CHARACTERISTIC
/begin CHARACTERISTIC DMDPUG "delta Moment Dashpotende" CURVE 0x4ED9FE GklWSw 199.9969 rel_sw_b100 -100.0000 99.99695 FORMAT "%8.4" /begin AXIS_DESCR COM_AXIS gangi dez 8 0.00 255.0 AXIS_PTS_REF SGA08MDUB /end AXIS_DESCR /end CHARACTERISTIC
/begin CHARACTERISTIC DMIFSAWE "Schwelle bei mimin-Sprung f¸r R¸cksetzen von B_fil" VALUE 0x4E6B96 KwUw 99.99695 rel_uw_b100 0.001525879 99.99847 FORMAT "%8.5" /end CHARACTERISTIC
/begin CHARACTERISTIC DMINMFS "" VALUE 0x4EDE64 KwSw 199.9969 rel_sw_b100 -100.0000 99.99695 FORMAT "%8.4" /end CHARACTERISTIC
/begin CHARACTERISTIC DMIZWMN "Offset auf indiziertes Motormoment bei sp‰testem Z¸ndwinkel und ASR-Eingriff" VALUE 0x4E839F KwUb 99.61 rel_ub_b99p6 0.00 99.61 FORMAT "%5.2" /end CHARACTERISTIC
/begin CHARACTERISTIC DMLLRIMXN "Sicherheitskonzept: obere Begrenzung f¸r dmllri" CURVE 0x4E5A5C GklWUb 99.61 rel_ub_b99p6 0.00 99.61 FORMAT "%5.2"
 /begin AXIS_DESCR COM_AXIS nmot nmot_ub_q40 6 0.00 10200. AXIS_PTS_REF SNM06LLUB /end AXIS_DESCR
/end CHARACTERISTIC
/begin CHARACTERISTIC DMLLRMN "Untere Begrenzung f¸r dmllr_w" VALUE 0x4E5B34 KwSw 199.9969 rel_sw_b100 -100.0000 99.99695 FORMAT "%8.4" /end CHARACTERISTIC
/begin CHARACTERISTIC DMLLRMXN "Sicherheitskonzept: obere Begrenzung f¸r dmllr" CURVE 0x4E5A64 GklWUb 99.61 rel_ub_b99p6 0.00 99.61 FORMAT "%5.2"
 /begin AXIS_DESCR COM_AXIS nmot nmot_ub_q40 6 0.00 10200. AXIS_PTS_REF SNM06LLUB /end AXIS_DESCR
/end CHARACTERISTIC
/begin CHARACTERISTIC DMLLRZMN "untere Begrenzung f¸r dmllrz_w" VALUE 0x4E5B36 KwSw 199.9969 rel_sw_b100 -100.0000 99.99695 FORMAT "%8.4" /end CHARACTERISTIC
/begin CHARACTERISTIC DMLLRZMXN "obere Begrenzung f¸r dmllrz_w" CURVE 0x4E5A6C GklWUb 99.61 rel_ub_b99p6 0.00 99.61 FORMAT "%5.2"
 /begin AXIS_DESCR COM_AXIS nmot nmot_ub_q40 6 0.00 10200. AXIS_PTS_REF SNM06LLUB /end AXIS_DESCR
/end CHARACTERISTIC
/begin CHARACTERISTIC DMLSDUG "Delta Moment Ende Lastschlagd‰mpfung" CURVE 0x4EDA0E GklWSw 199.9969 rel_sw_b100 -100.0000 99.99695 FORMAT "%8.4" /begin AXIS_DESCR COM_AXIS gangi dez 8 0.00 255.0 AXIS_PTS_REF SGA08MDUB /end AXIS_DESCR /end CHARACTERISTIC
/begin CHARACTERISTIC DMOFK "LLR Adaptionsoffset bei FK" VALUE 0x4ED7BC KwSw 199.9969 rel_sw_b100 -100.0000 99.99695 FORMAT "%8.4" /end CHARACTERISTIC
/begin CHARACTERISTIC DMOFS "LLR Adaptionsoffset bei FS" VALUE 0x4ED7BE KwSw 199.9969 rel_sw_b100 -100.0000 99.99695 FORMAT "%8.4" /end CHARACTERISTIC
/begin CHARACTERISTIC DMOKO "LLR Adaptionsoffset bei KO" VALUE 0x4ED7C0 KwSw 199.9969 rel_sw_b100 -100.0000 99.99695 FORMAT "%8.4" /end CHARACTERISTIC
/begin CHARACTERISTIC DMOLL "LLR Adaptionsoffset bei LL" VALUE 0x4ED7C2 KwSw 199.9969 rel_sw_b100 -100.0000 99.99695 FORMAT "%8.4" /end CHARACTERISTIC
/begin CHARACTERISTIC DMRFAV "ƒnderungsbegrenzung von mr bei EGS-Notlauf" CURVE 0x4EDA1E KlAUwSstUwWUw 199.9969 rel_uw_b200 0.00 199.9969 FORMAT "%8.4"
 /begin AXIS_DESCR STD_AXIS vfzg_w vfzg_uw_b512 2 0.00 511.9922 FORMAT "%8.4" DEPOSIT ABSOLUTE /end AXIS_DESCR
/end CHARACTERISTIC
/begin CHARACTERISTIC DMRKHO "obere Hytereseschwelle Katheiz-Momentenreserve mit ZW-Eingriff" VALUE 0x4E70D6 KwUb 99.61 rel_ub_b99p6 0.00 99.61 FORMAT "%5.2" /end CHARACTERISTIC
/begin CHARACTERISTIC DMRKHU "Untere Hytereseschwelle Katheiz-Momentenreserve mit ZW-Eingriff" VALUE 0x4E70D7 KwUb 99.61 rel_ub_b99p6 0.00 99.61 FORMAT "%5.2" /end CHARACTERISTIC
/begin CHARACTERISTIC Dnlumx "Maximale Drehzahlaenderung (max. dN/seg)" VALUE 0x4E9806 KwWU16 16383.75 nmot_uw_q0p25 0.00 16383.75 FORMAT "%8.2" /end CHARACTERISTIC
/begin CHARACTERISTIC DNMNI "Kleinstmˆglicher Wert f¸r dn beim I-Anteil" VALUE 0x4E5A72 KwSb 2550. nmotd_sb_q10 -1280. 1270. FORMAT "%5.0" /end CHARACTERISTIC
/begin CHARACTERISTIC DTMR "Hysterese f¸r Einschaltschwelle" VALUE 0x4EE176 KwUw 49151.25 temp_ub_b191p25 0.00 49151.25 FORMAT "%8.2" /end CHARACTERISTIC
/begin CHARACTERISTIC DTMTMRW "Temperaturdiff.-Schwelle f¸r die Pr¸fung, ob Zwangseinschaltung LR nˆtig (CARB)" VALUE 0x4EE137 KwUb 191.3 temp_sb_q0p75 0.00 191.3 FORMAT "%5.1" /end CHARACTERISTIC
/begin CHARACTERISTIC Dtsbmx "Dynamikschwelle Adaptionsabbruch (Delta Tseg)" VALUE 0x4E9808 KwWU16 65535.00 ta_diag 0.00 65535.00 FORMAT "%8.2" /end CHARACTERISTIC
/begin CHARACTERISTIC DTVKAML "" CURVE 0x4EE23C GklWSb 2.550 t100msxs_sb_q0p01 -1.280 1.270 FORMAT "%5.3" /begin AXIS_DESCR COM_AXIS ml m_ub_b1020 5 0.00 1020. AXIS_PTS_REF SML05LKUB /end AXIS_DESCR /end CHARACTERISTIC
/begin CHARACTERISTIC DTVKAML2 "" CURVE 0x4EE244 GklWSb 2.550 t100msxs_sb_q0p01 -1.280 1.270 FORMAT "%5.3" /begin AXIS_DESCR COM_AXIS ml m_ub_b1020 5 0.00 1020. AXIS_PTS_REF SML05LKUB /end AXIS_DESCR /end CHARACTERISTIC
/begin CHARACTERISTIC DVNG "LLR: D-Verst‰rkung abh. von ngfil bei stehendem Fahrzeug" CURVE 0x4E5A74 GklWUb 0.1245 rel_ub_bn0p125 -0.1245 0.00 FORMAT "%6.4"
 /begin AXIS_DESCR COM_AXIS ngfil nmotg_sb_q100 6 -12800. 12700. AXIS_PTS_REF SNG06LLSB /end AXIS_DESCR
/end CHARACTERISTIC
/begin CHARACTERISTIC DVNGV "LLR: D-Verst‰rkung abh. von ngfil bei roolendem Fahrzeug" CURVE 0x4E5A7C GklWUb 0.9961 fak_ub_b1 0.00 0.9961
 /begin AXIS_DESCR COM_AXIS ngfil nmotg_sb_q100 6 -12800. 12700. AXIS_PTS_REF SNG06LLSB /end AXIS_DESCR
/end CHARACTERISTIC
/begin CHARACTERISTIC DVZNG "LLR: D-Z¸ndungsanteil abh. vom ngfil bei stehendem Fzg." CURVE 0x4E5A84 GklWUb 0.1245 rel_ub_bn0p125 -0.1245 0.00 FORMAT "%6.4"
 /begin AXIS_DESCR COM_AXIS ngfil nmotg_sb_q100 6 -12800. 12700. AXIS_PTS_REF SNG06LLSB /end AXIS_DESCR
/end CHARACTERISTIC
/begin CHARACTERISTIC DVZNGT "" CURVE 0x4E5A8C GklWUb 0.1245 rel_ub_bn0p125 -0.1245 0.00 FORMAT "%6.4"
 /begin AXIS_DESCR COM_AXIS ngfil nmotg_sb_q100 6 -12800. 12700. AXIS_PTS_REF SNG06LLTSB /end AXIS_DESCR
/end CHARACTERISTIC
/begin CHARACTERISTIC DVZNGV "LLR: D-Z¸ndungsanteil abh. vom ngfil bei rollendem Fzg." CURVE 0x4E5A94 GklWUb 0.9961 fak_ub_b1 0.00 0.9961
 /begin AXIS_DESCR COM_AXIS ngfil nmotg_sb_q100 6 -12800. 12700. AXIS_PTS_REF SNG06LLSB /end AXIS_DESCR
/end CHARACTERISTIC
/begin CHARACTERISTIC DVZNGVT "" CURVE 0x4E5A9C GklWUb 0.9961 fak_ub_b1 0.00 0.9961
 /begin AXIS_DESCR COM_AXIS ngfil nmotg_sb_q100 6 -12800. 12700. AXIS_PTS_REF SNG06LLTSB /end AXIS_DESCR
/end CHARACTERISTIC
/begin CHARACTERISTIC DZW2DZWQ "Deltaz¸ndwinkel (quadratisch)" CURVE 0x4E61D4 FklWUb 90.72 kwq_ub_q0p35576 0.00 90.72 FORMAT "%5.2"
 /begin AXIS_DESCR FIX_AXIS dzwb zw_sb_q0p75 128 0.00 95.25 FORMAT "%5.2" FIX_AXIS_PAR 0 0 128 /end AXIS_DESCR
/end CHARACTERISTIC
/begin CHARACTERISTIC DZWOLA "Lambda-Abh‰ngigkeit des optimalen Z¸ndwinkels bezogen auf Lambda 1" CURVE 0x4E647A KlAUbSstUbWSb 191.3 zw_sb_q0p75 -96.00 95.25 FORMAT "%5.2"
 /begin AXIS_DESCR STD_AXIS lambas fak_ub_b2 10 0.00 1.992 FORMAT "%5.3" DEPOSIT ABSOLUTE /end AXIS_DESCR
/end CHARACTERISTIC
/begin CHARACTERISTIC DZWOM "temperaturabh‰ngiger Offset des optimalen ZW" CURVE 0x4E6490 KlAUwSstUwWSw 191.2500 zw_sb_q0p75 -96.00000 95.25000 FORMAT "%8.5"
 /begin AXIS_DESCR STD_AXIS tmotzyl_w temp_ub_q0p75_o48 5 -48.00000 49103.25 FORMAT "%8.2" DEPOSIT ABSOLUTE /end AXIS_DESCR
/end CHARACTERISTIC
/begin CHARACTERISTIC ETALAM "Lambda-Wirkungsgrad" CURVE 0x4E6254 KlAUbSstUbWUb 127.5 rel_ub_b127p5 0.00 127.5 FORMAT "%5.1"
 /begin AXIS_DESCR STD_AXIS lambas fak_ub_b2 10 0.00 1.992 FORMAT "%5.3" DEPOSIT ABSOLUTE /end AXIS_DESCR
/end CHARACTERISTIC
/begin CHARACTERISTIC FDDN "LLR: Gewichtungsfaktor f¸r D-Verst‰rkung" CURVE 0x4E5AA4 GklWUb 0.9961 fak_ub_b1 0.00 0.9961
 /begin AXIS_DESCR COM_AXIS dns nmotd_sb_q10 6 -1280. 1270. AXIS_PTS_REF SNS06LLSB /end AXIS_DESCR
/end CHARACTERISTIC
/begin CHARACTERISTIC FDDZN "LLR: Gewichtungsfaktor f¸r D-Z¸ndungsanteil" CURVE 0x4E5AAC GklWUb 0.9961 fak_ub_b1 0.00 0.9961
 /begin AXIS_DESCR COM_AXIS dns nmotd_sb_q10 6 -1280. 1270. AXIS_PTS_REF SNS06LLSB /end AXIS_DESCR
/end CHARACTERISTIC
/begin CHARACTERISTIC FDDZNT "" CURVE 0x4E5AB4 GklWUb 0.9961 fak_ub_b1 0.00 0.9961
 /begin AXIS_DESCR COM_AXIS dns nmotd_sb_q10 6 -1280. 1270. AXIS_PTS_REF SNS06LLTSB /end AXIS_DESCR
/end CHARACTERISTIC
/begin CHARACTERISTIC Fesa_gut "Schwelle Adaption gut" VALUE 0x4E9814 KwWS8 1.556 lur_fak_b4 -0.7813 0.7751 /end CHARACTERISTIC
/begin CHARACTERISTIC FFRITMS "" CURVE 0x4EE0D2 KlAUbSstUwWUw 0.9960938 fak_ub_b1 0.00 0.9960938 FORMAT "%9.7"
 /begin AXIS_DESCR STD_AXIS tmstzyl_w temp_ub_q0p75_o48 4 -48.00000 49103.25 FORMAT "%8.2" DEPOSIT ABSOLUTE /end AXIS_DESCR
/end CHARACTERISTIC
/begin CHARACTERISTIC FFWEKA "" VALUE 0x4E8809 KwUb 0.9961 fak_ub_b1 0.00 0.9961 /end CHARACTERISTIC
/begin CHARACTERISTIC Fiasa1 "ZK schnelle Adaption (schnelle Ad.)" VALUE 0x4E9815 KwWU8 9.961 lur_fakseg_b1 0.00 9.961 FORMAT "%5.3" /end CHARACTERISTIC
/begin CHARACTERISTIC Fiasa2 "ZK langsame Adaption (langs. Ad.)" VALUE 0x4E9816 KwWU8 9.961 lur_fakseg_b1 0.00 9.961 FORMAT "%5.3" /end CHARACTERISTIC
/begin CHARACTERISTIC Fifesa "ZK Lernfortschitt" VALUE 0x4E9817 KwWU8 9.961 lur_fakseg_b1 0.00 9.961 FORMAT "%5.3" /end CHARACTERISTIC
/begin CHARACTERISTIC Filum "Filterkonstante Lum (Mittelwert)" VALUE 0x4E9818 KwWU8 9.961 lur_fakseg_b1 0.00 9.961 FORMAT "%5.3" /end CHARACTERISTIC
/begin CHARACTERISTIC Filut "Filterkonstante Laufqualitaet" VALUE 0x4E9819 KwWU8 9.961 lur_fakasp_b1 0.00 9.961 FORMAT "%5.3" /end CHARACTERISTIC
/begin CHARACTERISTIC FKAXAVKAT "Gewichtungsfaktor Sauerstoffspeicher in Abh‰ngigkeit von avkatf" CURVE 0x4EE24C KlAUbSstUbWUb 0.9961 fak_ub_b1 0.00 0.9961 /begin AXIS_DESCR STD_AXIS avkatf fak_ub_b1 5 0.00 0.9961 DEPOSIT ABSOLUTE /end AXIS_DESCR /end CHARACTERISTIC
/begin CHARACTERISTIC FKNZNSEGMD "" CURVE 0x4EDE40 KlAUbSstUbWUb 1.000 fak_ub_b2 0.00 1.000 FORMAT "%5.3"
 /begin AXIS_DESCR STD_AXIS nmot nmot_ub_q40 6 0.00 10200. FORMAT "%5.0" DEPOSIT ABSOLUTE /end AXIS_DESCR
/end CHARACTERISTIC
/begin CHARACTERISTIC FLMLKAMA "Faktor zur Bewertung Schwellwert integr. Fettfl. f. Abbruch Kat-Ausr. Pre/Main" VALUE 0x4E880A KwUb 7.969 fak_ub_b8 0.00 7.969 FORMAT "%5.3" /end CHARACTERISTIC
/begin CHARACTERISTIC FLMLKAMA2 "" VALUE 0x4E880B KwUb 7.969 fak_ub_b8 0.00 7.969 FORMAT "%5.3" /end CHARACTERISTIC
/begin CHARACTERISTIC FLMLKAPR "" VALUE 0x4E880C KwUb 7.969 fak_ub_b8 0.00 7.969 FORMAT "%5.3" /end CHARACTERISTIC
/begin CHARACTERISTIC FLMLKAPR2 "" VALUE 0x4E880D KwUb 7.969 fak_ub_b8 0.00 7.969 FORMAT "%5.3" /end CHARACTERISTIC
/begin CHARACTERISTIC FLRFKATE "" CURVE 0x4E870C KlAUbSstSbWUb 1.992 fak_ub_b2 0.00 1.992 FORMAT "%5.3"
 /begin AXIS_DESCR STD_AXIS fkatei fak_sb_b1 5 -1.000 0.9922 FORMAT "%5.3" DEPOSIT ABSOLUTE /end AXIS_DESCR
/end CHARACTERISTIC
/begin CHARACTERISTIC FLRM "" CURVE 0x4E8718 KlAUbSstUwWUw 3.984375 fak_ub_b4 0.00 3.984375 FORMAT "%8.6"
 /begin AXIS_DESCR STD_AXIS tmotzyl_w temp_ub_q0p75_o48 5 -48.00000 49103.25 FORMAT "%8.2" DEPOSIT ABSOLUTE /end AXIS_DESCR
/end CHARACTERISTIC
/begin CHARACTERISTIC FMIHGN "Wichtungsfaktor Momentenbegrenzung bei Schaltgetriebeschutz" CURVE 0x4EDE2C KlAUbSstUbWUb 1.992 rel_ub_b2p0 0.00 1.992 FORMAT "%5.3"
 /begin AXIS_DESCR STD_AXIS nmot nmot_ub_q40 8 0.00 10200. FORMAT "%5.0" DEPOSIT ABSOLUTE /end AXIS_DESCR
/end CHARACTERISTIC
/begin CHARACTERISTIC FMIMASG0 "" VALUE 0x4EDE52 KwSw 3071.953 rel_uw_b3072 -1536.000 1535.953 FORMAT "%8.3" /end CHARACTERISTIC
/begin CHARACTERISTIC FMIMASG1 "" VALUE 0x4EDE54 KwSw 3071.953 rel_uw_b3072 -1536.000 1535.953 FORMAT "%8.3" /end CHARACTERISTIC
/begin CHARACTERISTIC FMIMASG2 "" VALUE 0x4EDE56 KwSw 3071.953 rel_uw_b3072 -1536.000 1535.953 FORMAT "%8.3" /end CHARACTERISTIC
/begin CHARACTERISTIC FMIMASG3 "" VALUE 0x4EDE58 KwSw 3071.953 rel_uw_b3072 -1536.000 1535.953 FORMAT "%8.3" /end CHARACTERISTIC
/begin CHARACTERISTIC FMIMASG4 "" VALUE 0x4EDE5A KwSw 3071.953 rel_uw_b3072 -1536.000 1535.953 FORMAT "%8.3" /end CHARACTERISTIC
/begin CHARACTERISTIC FMIMASG5 "" VALUE 0x4EDE5C KwSw 3071.953 rel_uw_b3072 -1536.000 1535.953 FORMAT "%8.3" /end CHARACTERISTIC
/begin CHARACTERISTIC FMIMASG6 "" VALUE 0x4EDE5E KwSw 3071.953 rel_uw_b3072 -1536.000 1535.953 FORMAT "%8.3" /end CHARACTERISTIC
/begin CHARACTERISTIC FMIMASGUPL "" VALUE 0x4EDE60 KwSw 3071.953 rel_uw_b3072 -1536.000 1535.953 FORMAT "%8.3" /end CHARACTERISTIC
/begin CHARACTERISTIC FMIVL "Faktor Korrektur maximales Moment bei VL" VALUE 0x4E8360 KwUb 1.992 fak_ub_b2 0.00 1.992 FORMAT "%5.3" /end CHARACTERISTIC
/begin CHARACTERISTIC FMLKAMA "" VALUE 0x4E880E KwUb 7.969 fak_ub_b8 0.00 7.969 FORMAT "%5.3" /end CHARACTERISTIC
/begin CHARACTERISTIC FMLKAMA2 "" VALUE 0x4E880F KwUb 7.969 fak_ub_b8 0.00 7.969 FORMAT "%5.3" /end CHARACTERISTIC
/begin CHARACTERISTIC FNSTABNV "Faktor zur Drehzahlstabilisierung durch Drehmoment" CURVE 0x4E5BF0 KlAxU8SstxU16WU16 7.999878 fak_uw_b8 0.00 7.999878 FORMAT "%8.6"
 /begin AXIS_DESCR STD_AXIS fnsta_in fak_uw_b8 6 0.00 7.999878 FORMAT "%8.6" DEPOSIT ABSOLUTE /end AXIS_DESCR
/end CHARACTERISTIC
/begin CHARACTERISTIC FRAOMN "untere Begrenzung des Korrekturfaktors frao" VALUE 0x4EC548 KwUb 1.992 fak_ub_b2 0.00 1.992 FORMAT "%5.3" /end CHARACTERISTIC
/begin CHARACTERISTIC FRAOMX "obere Begrenzung des Korrekturfaktors frao" VALUE 0x4EC549 KwUb 1.992 fak_ub_b2 0.00 1.992 FORMAT "%5.3" /end CHARACTERISTIC
/begin CHARACTERISTIC FRAORN "untere reduzierte Schwelle des Korrekturfaktors frao" VALUE 0x4EC54A KwUb 1.992 fak_ub_b2 0.00 1.992 FORMAT "%5.3" /end CHARACTERISTIC
/begin CHARACTERISTIC FRAORX "obere reduzierte Schwelle des Korrekturfaktors frao" VALUE 0x4EC54B KwUb 1.992 fak_ub_b2 0.00 1.992 FORMAT "%5.3" /end CHARACTERISTIC
/begin CHARACTERISTIC FRAUMN "untere Begrenzung des Korrekturfaktors frau" VALUE 0x4EC54C KwUb 1.992 fak_ub_b2 0.00 1.992 FORMAT "%5.3" /end CHARACTERISTIC
/begin CHARACTERISTIC FRAUMX "obere Begrenzung des Korrekturfaktors frau" VALUE 0x4EC54D KwUb 1.992 fak_ub_b2 0.00 1.992 FORMAT "%5.3" /end CHARACTERISTIC
/begin CHARACTERISTIC FRAURN "untere reduzierte Schwelle des Korrekturfaktors frau" VALUE 0x4EC54E KwUb 1.992 fak_ub_b2 0.00 1.992 FORMAT "%5.3" /end CHARACTERISTIC
/begin CHARACTERISTIC FRAURX "obere reduzierte Schwelle des Korrekturfaktors frau" VALUE 0x4EC54F KwUb 1.992 fak_ub_b2 0.00 1.992 FORMAT "%5.3" /end CHARACTERISTIC
/begin CHARACTERISTIC FRIPDSL1 "" VALUE 0x4E86E1 KwUb 3.984 fak_ub_b4 0.00 3.984 FORMAT "%5.3" /end CHARACTERISTIC
/begin CHARACTERISTIC FRIPDSL4 "" VALUE 0x4E86E2 KwUb 3.984 fak_ub_b4 0.00 3.984 FORMAT "%5.3" /end CHARACTERISTIC
/begin CHARACTERISTIC FRIPDTES "" VALUE 0x4E86E3 KwUb 3.984 fak_ub_b4 0.00 3.984 FORMAT "%5.3" /end CHARACTERISTIC
/begin CHARACTERISTIC FRIPTES "" VALUE 0x4E86E4 KwUb 3.984 fak_ub_b4 0.00 3.984 FORMAT "%5.3" /end CHARACTERISTIC
/begin CHARACTERISTIC FRLMNHO "" CURVE 0x4E3D30 KlAUbSstUbWUb 1.992 fak_ub_b2 0.00 1.992 FORMAT "%5.3"
 /begin AXIS_DESCR STD_AXIS fho fak_ub_b4 5 0.00 3.984 FORMAT "%5.3" DEPOSIT ABSOLUTE /end AXIS_DESCR
/end CHARACTERISTIC
/begin CHARACTERISTIC FRLVTM "Korrekturfaktor max. Volumenstrom bei offener Drosselklappe" CURVE 0x4E8388 KlAUbSstUwWUw 1.992188 fak_ub_b2 0.00 1.992188 FORMAT "%8.6"
 /begin AXIS_DESCR STD_AXIS tmotzyl_w temp_ub_q0p75_o48 5 -48.00000 49103.25 FORMAT "%8.2" DEPOSIT ABSOLUTE /end AXIS_DESCR
/end CHARACTERISTIC
/begin CHARACTERISTIC FRMAX "obere Regelbereichsgrenze" VALUE 0x4E872E KwUw 1.999969 fak_uw_b2 0.00 1.999969 FORMAT "%8.6" /end CHARACTERISTIC
/begin CHARACTERISTIC FRMINSLS "" VALUE 0x4EE0E4 KwUw 1.999969 fak_uw_b2 0.00 1.999969 FORMAT "%8.6" /end CHARACTERISTIC
/begin CHARACTERISTIC FRMINSLSK "Minimaler Lambdaregelfaktor w‰hrend Phase 1 Kurtztest  Sekund‰rluftdiagnose" VALUE 0x4EE0E6 KwUw 1.999969 fak_uw_b2 0.00 1.999969 FORMAT "%8.6" /end CHARACTERISTIC
/begin CHARACTERISTIC FRTEMX "" VALUE 0x4E8730 KwUw 1.999969 fak_uw_b2 0.00 1.999969 FORMAT "%8.6" /end CHARACTERISTIC
/begin CHARACTERISTIC Ftssk "" VAL_BLK 0x4E9800 KwbWS8 1.556 lur_fak_b4 -0.7813 0.7751 NUMBER 4 /end CHARACTERISTIC
/begin CHARACTERISTIC Geradzyk "Anzahl zulaessiger ADP-Zyklen" VALUE 0x4E980A KwWU16 65535.00 lur_seg 0.00 65535.00 FORMAT "%8.2" /end CHARACTERISTIC
/begin CHARACTERISTIC Geratol "Geberrad Fertigungstoleranz" VALUE 0x4E980C KwWU16 399.9939 lur_fak_b4 0.00 399.9939 FORMAT "%8.4" /end CHARACTERISTIC
/begin CHARACTERISTIC ILMLKAXTK "Schwelle Fettfl‰che Kat-Ausr‰umen nach SA, Funktion der Kat-Temperatur" CURVE 0x4EE258 KlAUwSstUwWUw 4660.267 m_uw_b4660 0.00 4660.267 FORMAT "%8.3"
 /begin AXIS_DESCR STD_AXIS tkatms_w temp_uw_q0p0195_o50 5 -50.00000 1229.980 FORMAT "%8.3" DEPOSIT ABSOLUTE /end AXIS_DESCR
/end CHARACTERISTIC
/begin CHARACTERISTIC IMLAKMN "" VALUE 0x4E8816 KwUw 4660.267 m_uw_b4660 0.00 4660.267 FORMAT "%8.3" /end CHARACTERISTIC
/begin CHARACTERISTIC IMLKAXTK "" CURVE 0x4EE26E KlAUwSstUwWUw 4660.267 m_uw_b4660 0.00 4660.267 FORMAT "%8.3"
 /begin AXIS_DESCR STD_AXIS tkatms_w temp_uw_q0p0195_o50 5 -50.00000 1229.980 FORMAT "%8.3" DEPOSIT ABSOLUTE /end AXIS_DESCR
/end CHARACTERISTIC
/begin CHARACTERISTIC IMLSALR "Schwellwert integr. Luftmasse f. Einschaltverzˆgerung LR nach SA" VALUE 0x4E873C KwUw 4660.267 m_uw_b4660 0.00 4660.267 FORMAT "%8.3" /end CHARACTERISTIC
/begin CHARACTERISTIC IVDN "LLR: I-Verst‰rkung bei stehendem Fahrzeug" CURVE 0x4E5ABC GklWUb 0.9961 rel_ub_b1p0 0.00 0.9961
 /begin AXIS_DESCR COM_AXIS dn_w nmotd_sw_q0p25 8 -8192.000 8191.750 AXIS_PTS_REF SDN08LLSW /end AXIS_DESCR
/end CHARACTERISTIC
/begin CHARACTERISTIC IVDNT "" CURVE 0x4E5AC4 GklWUb 0.9961 rel_ub_b1p0 0.00 0.9961
 /begin AXIS_DESCR COM_AXIS dn_w nmotd_sw_q0p25 8 -8192.000 8191.750 AXIS_PTS_REF SDN08LLTSW /end AXIS_DESCR
/end CHARACTERISTIC
/begin CHARACTERISTIC IVDNTV "" CURVE 0x4E5ACC GklWUb 0.9961 rel_ub_b1p0 0.00 0.9961
 /begin AXIS_DESCR COM_AXIS dn_w nmotd_sw_q0p25 8 -8192.000 8191.750 AXIS_PTS_REF SDN08LLTSW /end AXIS_DESCR
/end CHARACTERISTIC
/begin CHARACTERISTIC IVDNV "LLR: I-Verst‰rkung bei rollendem Fahrzeug" CURVE 0x4E5AD4 GklWUb 0.9961 rel_ub_b1p0 0.00 0.9961
 /begin AXIS_DESCR COM_AXIS dn_w nmotd_sw_q0p25 8 -8192.000 8191.750 AXIS_PTS_REF SDN08LLSW /end AXIS_DESCR
/end CHARACTERISTIC
/begin CHARACTERISTIC KDLASHKI "Kennlinie ¸ber dlashkm, Bewertungsfaktor f¸r I-Anteil in der LRHK" CURVE 0x4EE1E8 KlASwSstSwWSw 1.999969 fak_sw_b1 -1.000000 0.9999695 FORMAT "%8.6"
 /begin AXIS_DESCR STD_AXIS idlashkm_w fak_sw_b1 10 -1.000000 0.9999695 FORMAT "%8.6" DEPOSIT ABSOLUTE /end AXIS_DESCR
/end CHARACTERISTIC
/begin CHARACTERISTIC KDLASHKP "Kennlinie ¸ber dlashkm, Bewertungsfaktor f¸r P-Anteil in der LRHK" CURVE 0x4EE212 KlASwSstSwWSw 1.999969 fak_sw_b1 -1.000000 0.9999695 FORMAT "%8.6"
 /begin AXIS_DESCR STD_AXIS idlashkm_w fak_sw_b1 10 -1.000000 0.9999695 FORMAT "%8.6" DEPOSIT ABSOLUTE /end AXIS_DESCR
/end CHARACTERISTIC
/begin CHARACTERISTIC KFDLSD "D‰mpfung PT2-Filter Lastschlagd‰mpfung" MAP 0x4EDA28 GkfWUw 3.999939 fak_uw_b4 0.00 3.999939 FORMAT "%8.6" /begin AXIS_DESCR COM_AXIS gangi dez 8 0.00 255.0 AXIS_PTS_REF SGA08MDUB /end AXIS_DESCR
 /begin AXIS_DESCR COM_AXIS nmot_w nmot_uw_q0p25 6 0.00 16383.75 AXIS_PTS_REF SNM06MDUW /end AXIS_DESCR
/end CHARACTERISTIC
/begin CHARACTERISTIC KFDMDPO "Delta Moment Dashpotauslˆsung" MAP 0x4E6B98 GkfWSw 199.9969 rel_sw_b100 -100.0000 99.99695 FORMAT "%8.4" /begin AXIS_DESCR COM_AXIS gangi dez 8 0.00 255.0 AXIS_PTS_REF SGA08MDUB /end AXIS_DESCR
 /begin AXIS_DESCR COM_AXIS mkfanb_w rel_sw_b100 6 -100.0000 99.99695 AXIS_PTS_REF SMK06MDUW /end AXIS_DESCR
/end CHARACTERISTIC
/begin CHARACTERISTIC KFDMLSDO "Delta Moment Auslˆsung Lastschlagd‰mpfung" MAP 0x4E6BF8 GkfWSw 199.9969 rel_sw_b100 -100.0000 99.99695 FORMAT "%8.4" /begin AXIS_DESCR COM_AXIS gangi dez 8 0.00 255.0 AXIS_PTS_REF SGA08MDUB /end AXIS_DESCR
 /begin AXIS_DESCR COM_AXIS mkfanb_w rel_sw_b100 6 -100.0000 99.99695 AXIS_PTS_REF SMK06MDUW /end AXIS_DESCR
/end CHARACTERISTIC
/begin CHARACTERISTIC KFDZWAGR "Z¸ndwinkeloffset bei AGR" MAP 0x4ED966 KfAxUbAyUbSstxUbSstyUbWSb 191.3 zw_sb_q0p75 -96.00 95.25 FORMAT "%5.2"
 /begin AXIS_DESCR STD_AXIS rl rel_ub_q0p75 8 0.00 191.3 FORMAT "%5.1" DEPOSIT ABSOLUTE /end AXIS_DESCR
 /begin AXIS_DESCR STD_AXIS agrr rel_ub_b99p6 6 0.00 99.61 FORMAT "%5.2" DEPOSIT ABSOLUTE /end AXIS_DESCR
/end CHARACTERISTIC
/begin CHARACTERISTIC KFDZWKOEF "Kennfeld Koeffizient f¸r ZW-Wirkungsgrad" MAP 0x4E5F64 GkfWU8 11.20 fak_q0p0439 0.00 11.20 FORMAT "%5.2"
 /begin AXIS_DESCR COM_AXIS nmot_w nmot_uw_q0p25 16 0.00 16383.75 AXIS_PTS_REF SNM16OPUW /end AXIS_DESCR
 /begin AXIS_DESCR COM_AXIS rl_w_kge rel_uw_q0p0234 16 0.00 1535.977 AXIS_PTS_REF SRL16OPUW /end AXIS_DESCR
/end CHARACTERISTIC
/begin CHARACTERISTIC KFDZWKOEFT "Kennfeld Koeffizient f¸r ZW-Wirkungsgrad Teil-Dross" MAP 0x4E6064 GkfWU8 11.20 fak_q0p0439 0.00 11.20 FORMAT "%5.2"
 /begin AXIS_DESCR COM_AXIS nmot_w nmot_uw_q0p25 16 0.00 16383.75 AXIS_PTS_REF SNM16OPUW /end AXIS_DESCR
 /begin AXIS_DESCR COM_AXIS rl_w_kge rel_uw_q0p0234 16 0.00 1535.977 AXIS_PTS_REF SRL16OPUW /end AXIS_DESCR
/end CHARACTERISTIC
/begin CHARACTERISTIC KFETAGD "KF Wirkungsgrad gedrosselt in Bezug auf 100% bei ungedrosseltem Betrieb" MAP 0x4E64A6 GkfWUw 99.99847 rel_uw_b100 0.00 99.99847 FORMAT "%8.5"
 /begin AXIS_DESCR COM_AXIS nmot_w nmot_uw_q0p25 16 0.00 16383.75 AXIS_PTS_REF SNM16OPUW /end AXIS_DESCR
 /begin AXIS_DESCR COM_AXIS rl_w_kge rel_uw_q0p0234 16 0.00 1535.977 AXIS_PTS_REF SRL16OPUW /end AXIS_DESCR
/end CHARACTERISTIC
/begin CHARACTERISTIC KFETAMN "Minimaler ZW-Wirkungsgrad bei LSD" MAP 0x4E830C KfAxUbAyUbSstxUbSstyUbWUb 127.5 rel_ub_b127p5 0.00 127.5 FORMAT "%5.1"
 /begin AXIS_DESCR STD_AXIS mifa rel_ub_b99p6 8 0.00 99.61 FORMAT "%5.2" DEPOSIT ABSOLUTE /end AXIS_DESCR
 /begin AXIS_DESCR STD_AXIS gangi dez 8 0.00 255.0 FORMAT "%5.1" DEPOSIT ABSOLUTE /end AXIS_DESCR
/end CHARACTERISTIC
/begin CHARACTERISTIC KFFDMFBT "" MAP 0x4ED9A8 KfAxUbAyUbSstxUbSstyUbWUb 0.9961 fak_ub_b1 0.00 0.9961
 /begin AXIS_DESCR STD_AXIS dpsfaktd fak_ub_q0p00392 6 0.00 1.000 FORMAT "%5.3" DEPOSIT ABSOLUTE /end AXIS_DESCR
 /begin AXIS_DESCR STD_AXIS dpsfak fak_ub_q0p00392 2 0.00 1.000 FORMAT "%5.3" DEPOSIT ABSOLUTE /end AXIS_DESCR
/end CHARACTERISTIC
/begin CHARACTERISTIC KFFMKNULFS "" MAP 0x4E6B0C KfAxUbAyUbSstxUwSstyUwWUw 1.999969 fak_uw_b2 0.00 1.999969 FORMAT "%8.6"
 /begin AXIS_DESCR STD_AXIS ntnmot_w fak_uw_b4 6 0.00 3.999939 FORMAT "%8.6" DEPOSIT ABSOLUTE /end AXIS_DESCR
 /begin AXIS_DESCR STD_AXIS gangi dez 8 0.00 7.000000 FORMAT "%8.6" DEPOSIT ABSOLUTE /end AXIS_DESCR
/end CHARACTERISTIC
/begin CHARACTERISTIC KFFRMIN "untere Regelbereichsgrenze" MAP 0x4EE0E8 KfAxUbAyUbSstxUwSstyUwWUw 1.999969 fak_uw_b2 0.00 1.999969 FORMAT "%8.6"
 /begin AXIS_DESCR STD_AXIS tmotzyl_w temp_ub_q0p75_o48 5 -48.00000 49103.25 FORMAT "%8.2" DEPOSIT ABSOLUTE /end AXIS_DESCR
 /begin AXIS_DESCR STD_AXIS tnst_w t10msxs_uw_b655p35 5 0.00 655.3500 FORMAT "%8.4" DEPOSIT ABSOLUTE /end AXIS_DESCR
/end CHARACTERISTIC
/begin CHARACTERISTIC KFFTV "" MAP 0x4EE180 GkfWUb 1.992 fak_ub_b2 0.00 1.992 FORMAT "%5.3"
 /begin AXIS_DESCR COM_AXIS nmot nmot_ub_q40 6 0.00 10200. AXIS_PTS_REF SNM06LHUB /end AXIS_DESCR
 /begin AXIS_DESCR COM_AXIS rl rel_ub_q0p75 6 0.00 191.3 AXIS_PTS_REF SRL06LHUB /end AXIS_DESCR
/end CHARACTERISTIC
/begin CHARACTERISTIC KFLUR "" MAP 0x4E9768 KfAxU8AyU8SstxU8SstyU8WU8 255.0 lur_q1 0.00 255.0 FORMAT "%5.1"
 /begin AXIS_DESCR STD_AXIS nmot nmot_ub_q40 8 0.00 10200. FORMAT "%5.0" DEPOSIT ABSOLUTE /end AXIS_DESCR
 /begin AXIS_DESCR STD_AXIS rl rel_ub_q0p75 8 0.00 191.3 FORMAT "%5.1" DEPOSIT ABSOLUTE /end AXIS_DESCR
/end CHARACTERISTIC
/begin CHARACTERISTIC KFLURAB "Lur-Absenkung" MAP 0x4E97BC KfAxU8AyU8SstxU8SstyU8WU8 0.9961 fak_ub_b1 0.00 0.9961
 /begin AXIS_DESCR STD_AXIS nmot nmot_ub_q40 4 0.00 10200. FORMAT "%5.0" DEPOSIT ABSOLUTE /end AXIS_DESCR
 /begin AXIS_DESCR STD_AXIS rl rel_ub_q0p75 4 0.00 191.3 FORMAT "%5.1" DEPOSIT ABSOLUTE /end AXIS_DESCR
/end CHARACTERISTIC
/begin CHARACTERISTIC KFMDGANG0 "" MAP 0x4E70E6 KfAxUwAyUwSstxUwSstyUwWUw 3071.953 rel_uw_b3072 0.00 3071.953 FORMAT "%8.3"
 /begin AXIS_DESCR STD_AXIS wped_w relPED_uw_b100 16 0.00 100.0000 FORMAT "%8.4" DEPOSIT ABSOLUTE /end AXIS_DESCR
 /begin AXIS_DESCR STD_AXIS nmdkog_w nmot_uw_q0p25 16 0.00 16383.75 FORMAT "%8.2" DEPOSIT ABSOLUTE /end AXIS_DESCR
/end CHARACTERISTIC
/begin CHARACTERISTIC KFMDGANG1 "" MAP 0x4E732A KfAxUwAyUwSstxUwSstyUwWUw 3071.953 rel_uw_b3072 0.00 3071.953 FORMAT "%8.3"
 /begin AXIS_DESCR STD_AXIS wped_w relPED_uw_b100 16 0.00 100.0000 FORMAT "%8.4" DEPOSIT ABSOLUTE /end AXIS_DESCR
 /begin AXIS_DESCR STD_AXIS nmdkog_w nmot_uw_q0p25 16 0.00 16383.75 FORMAT "%8.2" DEPOSIT ABSOLUTE /end AXIS_DESCR
/end CHARACTERISTIC
/begin CHARACTERISTIC KFMDGANG2 "" MAP 0x4E756E KfAxUwAyUwSstxUwSstyUwWUw 3071.953 rel_uw_b3072 0.00 3071.953 FORMAT "%8.3"
 /begin AXIS_DESCR STD_AXIS wped_w relPED_uw_b100 16 0.00 100.0000 FORMAT "%8.4" DEPOSIT ABSOLUTE /end AXIS_DESCR
 /begin AXIS_DESCR STD_AXIS nmdkog_w nmot_uw_q0p25 16 0.00 16383.75 FORMAT "%8.2" DEPOSIT ABSOLUTE /end AXIS_DESCR
/end CHARACTERISTIC
/begin CHARACTERISTIC KFMDGANG3 "" MAP 0x4E77B2 KfAxUwAyUwSstxUwSstyUwWUw 3071.953 rel_uw_b3072 0.00 3071.953 FORMAT "%8.3"
 /begin AXIS_DESCR STD_AXIS wped_w relPED_uw_b100 16 0.00 100.0000 FORMAT "%8.4" DEPOSIT ABSOLUTE /end AXIS_DESCR
 /begin AXIS_DESCR STD_AXIS nmdkog_w nmot_uw_q0p25 16 0.00 16383.75 FORMAT "%8.2" DEPOSIT ABSOLUTE /end AXIS_DESCR
/end CHARACTERISTIC
/begin CHARACTERISTIC KFMDGANG4 "" MAP 0x4E79F6 KfAxUwAyUwSstxUwSstyUwWUw 3071.953 rel_uw_b3072 0.00 3071.953 FORMAT "%8.3"
 /begin AXIS_DESCR STD_AXIS wped_w relPED_uw_b100 16 0.00 100.0000 FORMAT "%8.4" DEPOSIT ABSOLUTE /end AXIS_DESCR
 /begin AXIS_DESCR STD_AXIS nmdkog_w nmot_uw_q0p25 16 0.00 16383.75 FORMAT "%8.2" DEPOSIT ABSOLUTE /end AXIS_DESCR
/end CHARACTERISTIC
/begin CHARACTERISTIC KFMDGANG5 "" MAP 0x4E7C3A KfAxUwAyUwSstxUwSstyUwWUw 3071.953 rel_uw_b3072 0.00 3071.953 FORMAT "%8.3"
 /begin AXIS_DESCR STD_AXIS wped_w relPED_uw_b100 16 0.00 100.0000 FORMAT "%8.4" DEPOSIT ABSOLUTE /end AXIS_DESCR
 /begin AXIS_DESCR STD_AXIS nmdkog_w nmot_uw_q0p25 16 0.00 16383.75 FORMAT "%8.2" DEPOSIT ABSOLUTE /end AXIS_DESCR
/end CHARACTERISTIC
/begin CHARACTERISTIC KFMDGANG6 "" MAP 0x4E7E7E KfAxUwAyUwSstxUwSstyUwWUw 3071.953 rel_uw_b3072 0.00 3071.953 FORMAT "%8.3"
 /begin AXIS_DESCR STD_AXIS wped_w relPED_uw_b100 16 0.00 100.0000 FORMAT "%8.4" DEPOSIT ABSOLUTE /end AXIS_DESCR
 /begin AXIS_DESCR STD_AXIS nmdkog_w nmot_uw_q0p25 16 0.00 16383.75 FORMAT "%8.2" DEPOSIT ABSOLUTE /end AXIS_DESCR
/end CHARACTERISTIC
/begin CHARACTERISTIC KFMDGANGUPL "" MAP 0x4E80C2 KfAxUwAyUwSstxUwSstyUwWUw 3071.953 rel_uw_b3072 0.00 3071.953 FORMAT "%8.3"
 /begin AXIS_DESCR STD_AXIS wped_w relPED_uw_b100 16 0.00 100.0000 FORMAT "%8.4" DEPOSIT ABSOLUTE /end AXIS_DESCR
 /begin AXIS_DESCR STD_AXIS nmdkog_w nmot_uw_q0p25 16 0.00 16383.75 FORMAT "%8.2" DEPOSIT ABSOLUTE /end AXIS_DESCR
/end CHARACTERISTIC
/begin CHARACTERISTIC KFMDS "Schleppmoment Drehzahl- und Lastabh‰ngigkeit" MAP 0x4E5C30 KfAxUwAyUwSstxUwSstyUwWUw 99.99847 rel_uw_b100 0.00 99.99847 FORMAT "%8.5"
 /begin AXIS_DESCR STD_AXIS nmot_w nmot_uw_q0p25 10 0.00 16383.75 FORMAT "%8.2" DEPOSIT ABSOLUTE /end AXIS_DESCR
 /begin AXIS_DESCR STD_AXIS rl_w rel_uw_q0p0234 12 0.00 1535.977 FORMAT "%8.3" DEPOSIT ABSOLUTE /end AXIS_DESCR
/end CHARACTERISTIC
/begin CHARACTERISTIC KFMDSM "Schleppmoment Temperaturanteil" MAP 0x4E5D50 KfAxUbAyUbSstxUbSstyUwWUw 99.99847 rel_uw_b100 0.00 99.99847 FORMAT "%8.5"
 /begin AXIS_DESCR STD_AXIS tmot temp_ub_q0p75_o48 6 -48.00 143.3 FORMAT "%5.1" DEPOSIT ABSOLUTE /end AXIS_DESCR
 /begin AXIS_DESCR STD_AXIS tol temp_ub_q0p75_o48 6 -48.00000 49103.25 FORMAT "%8.2" DEPOSIT ABSOLUTE /end AXIS_DESCR
/end CHARACTERISTIC
/begin CHARACTERISTIC KFMIFALGD "" MAP 0x4EDA88 KfAxUbAyUbSstxUbSstyUwWUw 99.99847 rel_uw_b100 0.00 99.99847 FORMAT "%8.5"
 /begin AXIS_DESCR STD_AXIS gangi dez 8 0.00 255.0 FORMAT "%5.1" DEPOSIT ABSOLUTE /end AXIS_DESCR
 /begin AXIS_DESCR STD_AXIS minbeg_w rel_uw_b100 8 0.00 99.99847 FORMAT "%8.5" DEPOSIT ABSOLUTE /end AXIS_DESCR
/end CHARACTERISTIC
/begin CHARACTERISTIC KFMIFALS "Indiziertes Fahrerwunschmoment f¸r F¸llungspfad bei Lastschlagd‰mpfung" MAP 0x4EDB22 KfAxUbAyUbSstxUbSstyUwWUw 99.99847 rel_uw_b100 0.00 99.99847 FORMAT "%8.5"
 /begin AXIS_DESCR STD_AXIS gangi dez 8 0.00 255.0 FORMAT "%5.1" DEPOSIT ABSOLUTE /end AXIS_DESCR
 /begin AXIS_DESCR STD_AXIS minbeg_w rel_uw_b100 8 0.00 99.99847 FORMAT "%8.5" DEPOSIT ABSOLUTE /end AXIS_DESCR
/end CHARACTERISTIC
/begin CHARACTERISTIC KFMILSD "Startwert indiziertes Moment f¸r Lastschlagd‰mpfung" MAP 0x4EDBBC GkfWUw 98.99902 rel_uw_b100 0.9994507 99.99847 FORMAT "%8.5" /begin AXIS_DESCR COM_AXIS gangi dez 8 0.00 255.0 AXIS_PTS_REF SGA08MDUB /end AXIS_DESCR
 /begin AXIS_DESCR COM_AXIS nmot_w nmot_uw_q0p25 6 0.00 16383.75 AXIS_PTS_REF SNM06MDUW /end AXIS_DESCR
/end CHARACTERISTIC
/begin CHARACTERISTIC KFMIMR "Kennfeld fuer Momenten¸berhˆhung im Pedal¸berweg" MAP 0x4E6C58 KfAxUwAyUwSstxUwSstyUwWUw 199.9969 rel_uw_b200 0.00 199.9969 FORMAT "%8.4"
 /begin AXIS_DESCR STD_AXIS nmot_w nmot_uw_q0p25 16 0.00 16383.75 FORMAT "%8.2" DEPOSIT ABSOLUTE /end AXIS_DESCR
 /begin AXIS_DESCR STD_AXIS mrfa_w rel_uw_b200 6 0.00 199.9969 FORMAT "%8.4" DEPOSIT ABSOLUTE /end AXIS_DESCR
/end CHARACTERISTIC
/begin CHARACTERISTIC KFMIOP "Kennfeld optimales Motormoment" MAP 0x4E66A6 GkfWUw 99.99847 rel_uw_b100 0.00 99.99847 FORMAT "%8.5"
 /begin AXIS_DESCR COM_AXIS nmot_w nmot_uw_q0p25 16 0.00 16383.75 AXIS_PTS_REF SNM16OPUW /end AXIS_DESCR
 /begin AXIS_DESCR COM_AXIS rl_w_kge rel_uw_q0p0234 16 0.00 1535.977 AXIS_PTS_REF SRL16OPUW /end AXIS_DESCR
/end CHARACTERISTIC
/begin CHARACTERISTIC KFMIRL "Kennfeld f¸r Berechnung Sollf¸llung" MAP 0x4E3D3C KfAxUwAyUwSstxUwSstyUwWUw 1535.977 rel_uw_q0p0234 0.00 1535.977 FORMAT "%8.3"
 /begin AXIS_DESCR STD_AXIS nmot_w nmot_uw_q0p25 16 0.00 16383.75 FORMAT "%8.2" DEPOSIT ABSOLUTE /end AXIS_DESCR
 /begin AXIS_DESCR STD_AXIS misopl1_w rel_uw_b100 16 0.00 99.99847 FORMAT "%8.5" DEPOSIT ABSOLUTE /end AXIS_DESCR
/end CHARACTERISTIC
/begin CHARACTERISTIC KFMRMI "Kennfeld f¸r Momenten¸berhˆhung im Pedal¸berweg rel. in ind. Moment" MAP 0x4E6D48 KfAxUwAyUwSstxUwSstyUwWUw 175.5829 rel_uw_b200 24.41406 199.9969 FORMAT "%8.4"
 /begin AXIS_DESCR STD_AXIS nmot_w nmot_uw_q0p25 16 0.00 16383.75 FORMAT "%8.2" DEPOSIT ABSOLUTE /end AXIS_DESCR
 /begin AXIS_DESCR STD_AXIS fmil_w rel_uw_b200 6 0.00 199.9969 FORMAT "%8.4" DEPOSIT ABSOLUTE /end AXIS_DESCR
/end CHARACTERISTIC
/begin CHARACTERISTIC KFPED "Pedalkennfeld (MR)" MAP 0x4E6E38 KfAxUwAyUwSstxUwSstyUwWUw 199.9969 rel_uw_b200 0.00 199.9969 FORMAT "%8.4"
 /begin AXIS_DESCR STD_AXIS wped_w relPED_uw_b100 16 0.00 100.0000 FORMAT "%8.4" DEPOSIT ABSOLUTE /end AXIS_DESCR
 /begin AXIS_DESCR STD_AXIS nmot_w nmot_uw_q0p25 16 0.00 16383.75 FORMAT "%8.2" DEPOSIT ABSOLUTE /end AXIS_DESCR
/end CHARACTERISTIC
/begin CHARACTERISTIC KFRI "" MAP 0x4EDFCC GkfWUb 77.82 fak_ub_b77p81 0.00 77.82 FORMAT "%5.2"
 /begin AXIS_DESCR COM_AXIS nmot nmot_ub_q40 7 0.00 10200. AXIS_PTS_REF SNM07LRUB /end AXIS_DESCR
 /begin AXIS_DESCR COM_AXIS rl rel_ub_q0p75 6 0.00 191.3 AXIS_PTS_REF SRL06LRUB /end AXIS_DESCR
/end CHARACTERISTIC
/begin CHARACTERISTIC KFRI2 "" MAP 0x4EDFF8 GkfWUb 77.82 fak_ub_b77p81 0.00 77.82 FORMAT "%5.2"
 /begin AXIS_DESCR COM_AXIS nmot nmot_ub_q40 7 0.00 10200. AXIS_PTS_REF SNM07LRUB /end AXIS_DESCR
 /begin AXIS_DESCR COM_AXIS rl rel_ub_q0p75 6 0.00 191.3 AXIS_PTS_REF SRL06LRUB /end AXIS_DESCR
/end CHARACTERISTIC
/begin CHARACTERISTIC KFRLMN "" MAP 0x4EB780 GkfWUb 191.3 rel_ub_q0p75 0.00 191.3 FORMAT "%5.1"
 /begin AXIS_DESCR COM_AXIS nmot nmot_ub_q40 12 0.00 10200. AXIS_PTS_REF SNM12FEUB /end AXIS_DESCR
 /begin AXIS_DESCR COM_AXIS tmot temp_ub_q0p75_o48 4 -48.00 143.3 AXIS_PTS_REF STM04FEUB /end AXIS_DESCR
/end CHARACTERISTIC
/begin CHARACTERISTIC KFRLMNSA "" MAP 0x4EB7B0 GkfWUb 191.3 rel_ub_q0p75 0.00 191.3 FORMAT "%5.1"
 /begin AXIS_DESCR COM_AXIS nmot nmot_ub_q40 12 0.00 10200. AXIS_PTS_REF SNM12FEUB /end AXIS_DESCR
 /begin AXIS_DESCR COM_AXIS tmot temp_ub_q0p75_o48 4 -48.00 143.3 AXIS_PTS_REF STM04FEUB /end AXIS_DESCR
/end CHARACTERISTIC
/begin CHARACTERISTIC KFRP "" MAP 0x4EE024 GkfWUb 9.766 fak_ub_b12p45 0.00 9.766 FORMAT "%5.3"
 /begin AXIS_DESCR COM_AXIS nmot nmot_ub_q40 7 0.00 10200. AXIS_PTS_REF SNM07LRUB /end AXIS_DESCR
 /begin AXIS_DESCR COM_AXIS rl rel_ub_q0p75 6 0.00 191.3 AXIS_PTS_REF SRL06LRUB /end AXIS_DESCR
/end CHARACTERISTIC
/begin CHARACTERISTIC KFRP2 "" MAP 0x4EE050 GkfWUb 9.766 fak_ub_b12p45 0.00 9.766 FORMAT "%5.3"
 /begin AXIS_DESCR COM_AXIS nmot nmot_ub_q40 7 0.00 10200. AXIS_PTS_REF SNM07LRUB /end AXIS_DESCR
 /begin AXIS_DESCR COM_AXIS rl rel_ub_q0p75 6 0.00 191.3 AXIS_PTS_REF SRL06LRUB /end AXIS_DESCR
/end CHARACTERISTIC
/begin CHARACTERISTIC KFRTV "" MAP 0x4EE07C GkfWSb 2.550 t10msxs_sb_q0p01 -1.280 1.270 FORMAT "%5.3"
 /begin AXIS_DESCR COM_AXIS nmot nmot_ub_q40 7 0.00 10200. AXIS_PTS_REF SNM07LRUB /end AXIS_DESCR
 /begin AXIS_DESCR COM_AXIS rl rel_ub_q0p75 6 0.00 191.3 AXIS_PTS_REF SRL06LRUB /end AXIS_DESCR
/end CHARACTERISTIC
/begin CHARACTERISTIC KFRTV2 "" MAP 0x4EE0A8 GkfWSb 2.550 t10msxs_sb_q0p01 -1.280 1.270 FORMAT "%5.3"
 /begin AXIS_DESCR COM_AXIS nmot nmot_ub_q40 7 0.00 10200. AXIS_PTS_REF SNM07LRUB /end AXIS_DESCR
 /begin AXIS_DESCR COM_AXIS rl rel_ub_q0p75 6 0.00 191.3 AXIS_PTS_REF SRL06LRUB /end AXIS_DESCR
/end CHARACTERISTIC
/begin CHARACTERISTIC KFUSHK "Sondenspannungssollwert f¸r Regelung hinter Kat. (statt KFUSRHK f¸r Variantenk.)" MAP 0x4EE1A4 GkfWUb 1.330 spg_ub_q0p0052_o0p2 -0.2000 1.130 FORMAT "%5.3"
 /begin AXIS_DESCR COM_AXIS nmot nmot_ub_q40 6 0.00 10200. AXIS_PTS_REF SNM06LHUB /end AXIS_DESCR
 /begin AXIS_DESCR COM_AXIS rl rel_ub_q0p75 6 0.00 191.3 AXIS_PTS_REF SRL06LHUB /end AXIS_DESCR
/end CHARACTERISTIC
/begin CHARACTERISTIC KFWPFGR "Inverses Pedalkennfeld f¸r FGR-Betrieb" MAP 0x4EDC1C KfAxUwAyUwSstxUwSstyUwWUw 99.99847 rel_uw_b100 0.00 99.99847 FORMAT "%8.5"
 /begin AXIS_DESCR STD_AXIS mrfgr_w rel_uw_b200 16 0.00 199.9969 FORMAT "%8.4" DEPOSIT ABSOLUTE /end AXIS_DESCR
 /begin AXIS_DESCR STD_AXIS nmot_w nmot_uw_q0p25 8 0.00 16383.75 FORMAT "%8.2" DEPOSIT ABSOLUTE /end AXIS_DESCR
/end CHARACTERISTIC
/begin CHARACTERISTIC KFZDASH "Zeitkonstante PT1-Filter Dashpot" MAP 0x4EDD50 GkfWUw 655.350000 zk10msxs_uw_b655 0.0100001526 655.360000 FORMAT "%10.6" /begin AXIS_DESCR COM_AXIS gangi dez 8 0.00 255.0 AXIS_PTS_REF SGA08MDUB /end AXIS_DESCR
 /begin AXIS_DESCR COM_AXIS nmot_w nmot_uw_q0p25 6 0.00 16383.75 AXIS_PTS_REF SNM06MDUW /end AXIS_DESCR
/end CHARACTERISTIC
/begin CHARACTERISTIC KFZLSD "Zeitkonstante PT2-Filter Lastschlagd‰mpfung" MAP 0x4EDDB0 GkfWUw 655.350000 zk10msxs_uw_b655 0.0100001526 655.360000 FORMAT "%10.6" /begin AXIS_DESCR COM_AXIS gangi dez 8 0.00 255.0 AXIS_PTS_REF SGA08MDUB /end AXIS_DESCR
 /begin AXIS_DESCR COM_AXIS nmot_w nmot_uw_q0p25 6 0.00 16383.75 AXIS_PTS_REF SNM06MDUW /end AXIS_DESCR
/end CHARACTERISTIC
/begin CHARACTERISTIC KFZLSDVZ "" MAP 0x4ED9C0 GkfWUb 0.1990 t10msxs_uw_q0p001 0.001000 0.2000 FORMAT "%6.4" /begin AXIS_DESCR COM_AXIS gangi dez 8 0.00 255.0 AXIS_PTS_REF SGA08MDUB /end AXIS_DESCR
 /begin AXIS_DESCR COM_AXIS nmot_w nmot_uw_q0p25 6 0.00 16383.75 AXIS_PTS_REF SNM06MDUW /end AXIS_DESCR
/end CHARACTERISTIC
/begin CHARACTERISTIC KFZWOP "optimaler Z¸ndwinkel" MAP 0x4E626C GkfWSb 191.3 zw_sb_q0p75 -96.00 95.25 FORMAT "%5.2"
 /begin AXIS_DESCR COM_AXIS nmot_w nmot_uw_q0p25 16 0.00 16383.75 AXIS_PTS_REF SNM16OPUW /end AXIS_DESCR
 /begin AXIS_DESCR COM_AXIS rl_w_kge rel_uw_q0p0234 16 0.00 1535.977 AXIS_PTS_REF SRL16OPUW /end AXIS_DESCR
/end CHARACTERISTIC
/begin CHARACTERISTIC KFZWOP2 "optimaler Z¸ndwinkel Variante 2" MAP 0x4E636C GkfWSb 191.3 zw_sb_q0p75 -96.00 95.25 FORMAT "%5.2"
 /begin AXIS_DESCR COM_AXIS nmot_w nmot_uw_q0p25 16 0.00 16383.75 AXIS_PTS_REF SNM16OPUW /end AXIS_DESCR
 /begin AXIS_DESCR COM_AXIS rl_w_kge rel_uw_q0p0234 16 0.00 1535.977 AXIS_PTS_REF SRL16OPUW /end AXIS_DESCR
/end CHARACTERISTIC
/begin CHARACTERISTIC KFZWOPLL "optimaler Z¸ndwinkel im Leerlauf" MAP 0x4E6164 KfAxU8AyU8SstxU8SstyU8WS8 191.3 zw_sb_q0p75 -96.00 95.25 FORMAT "%5.2"
 /begin AXIS_DESCR STD_AXIS nmot nmot_ub_q40 8 0.00 10200. FORMAT "%5.0" DEPOSIT ABSOLUTE /end AXIS_DESCR
 /begin AXIS_DESCR STD_AXIS rl_kge rel_ub_q0p75 5 0.00 191.3 FORMAT "%5.1" DEPOSIT ABSOLUTE /end AXIS_DESCR
/end CHARACTERISTIC
/begin CHARACTERISTIC KFZWOPLLT "optimaler Z¸ndwinkel im Leerlauf (VVT)" MAP 0x4E619B KfAxU8AyU8SstxU8SstyU8WS8 191.3 zw_sb_q0p75 -96.00 95.25 FORMAT "%5.2"
 /begin AXIS_DESCR STD_AXIS nmot nmot_ub_q40 8 0.00 10200. FORMAT "%5.0" DEPOSIT ABSOLUTE /end AXIS_DESCR
 /begin AXIS_DESCR STD_AXIS rl_kge rel_ub_q0p75 5 0.00 191.3 FORMAT "%5.1" DEPOSIT ABSOLUTE /end AXIS_DESCR
/end CHARACTERISTIC
/begin CHARACTERISTIC KLFMKNUL "" CURVE 0x4EDE10 GklWUw 1.999939 fak_uw_b2 0.00003051758 1.999969 FORMAT "%8.6"
 /begin AXIS_DESCR COM_AXIS mkfanb_w rel_sw_b100 6 -100.0000 99.99695 AXIS_PTS_REF SMK06MDUW /end AXIS_DESCR
/end CHARACTERISTIC
/begin CHARACTERISTIC KLFWUELL "Umrechnung von Summenverh‰ltnis der Spreizungen in zwopt LL-Gewichtung" CURVE 0x4E646C KlAUbSstUbWUb 0.9961 fak_ub_b1 0.00 0.9961
 /begin AXIS_DESCR STD_AXIS fwuell fak_ub_b2 6 0.00 1.992 FORMAT "%5.3" DEPOSIT ABSOLUTE /end AXIS_DESCR
/end CHARACTERISTIC
/begin CHARACTERISTIC KLLUR "Referenzwert f(tmot)" CURVE 0x4E97D8 KlAxU8SstxU8WU8 255.0 lur_q1 0.00 255.0 FORMAT "%5.1"
 /begin AXIS_DESCR STD_AXIS tmot temp_ub_q0p75_o48 6 -48.00 143.3 FORMAT "%5.1" DEPOSIT ABSOLUTE /end AXIS_DESCR
/end CHARACTERISTIC
/begin CHARACTERISTIC KLLURAN "" CURVE 0x4E97E8 KlAxU8SstxU8WU8 255.0 lur_q1 0.00 255.0 FORMAT "%5.1"
 /begin AXIS_DESCR STD_AXIS nmot nmot_ub_q40 4 0.00 10200. FORMAT "%5.0" DEPOSIT ABSOLUTE /end AXIS_DESCR
/end CHARACTERISTIC
/begin CHARACTERISTIC KLMDHUB "Hubabhaengiger Anteil des Schleppmoments" CURVE 0x4E5C0C KlAxU8SstxU16WU16 99.99847 rel_uw_b100 0.00 99.99847 FORMAT "%8.5"
 /begin AXIS_DESCR STD_AXIS evhubi_w hub_uw_q0p001 8 0.00 65.53500 FORMAT "%8.5" DEPOSIT ABSOLUTE /end AXIS_DESCR
/end CHARACTERISTIC
/begin CHARACTERISTIC KLTWEMEMO "" CURVE 0x4ED9F0 GklWUb 2.550 t10msxs_ub_b2p55 0.00 2.550 FORMAT "%5.3"
 /begin AXIS_DESCR COM_AXIS nmot_w nmot_uw_q0p25 6 0.00 16383.75 AXIS_PTS_REF SNM06MDUW /end AXIS_DESCR
/end CHARACTERISTIC
/begin CHARACTERISTIC KLTWEMEMO2 "" CURVE 0x4ED9F8 GklWUb 2.550 t10msxs_ub_b2p55 0.00 2.550 FORMAT "%5.3"
 /begin AXIS_DESCR COM_AXIS nmot_w nmot_uw_q0p25 6 0.00 16383.75 AXIS_PTS_REF SNM06MDUW /end AXIS_DESCR
/end CHARACTERISTIC
/begin CHARACTERISTIC KMIN "" VALUE 0x4E707C KwUw 0.9990000 t10msxs_uw_q0p001 0.001000000 1.000000 FORMAT "%8.6" /end CHARACTERISTIC
/begin CHARACTERISTIC LALIUSH "Lambdalinearisierung, Sonde hinter Katalysator" CURVE 0x4E8796 KlAUwSstUwWUw 15.99976 fak_uw_b16 0.00 15.99976 FORMAT "%8.5"
 /begin AXIS_DESCR STD_AXIS ushk_w spg_uw_q0p00488_o1 10 -1.000000 318.9951 FORMAT "%8.4" DEPOSIT ABSOLUTE /end AXIS_DESCR
/end CHARACTERISTIC
/begin CHARACTERISTIC LALIUSRH "Lambdalinearisierung, Sonde hinter Katalysator, Sollwert" CURVE 0x4E87C0 KlAUbSstUbWUw 15.99976 fak_uw_b16 0.00 15.99976 FORMAT "%8.5"
 /begin AXIS_DESCR STD_AXIS usrhk spg_ub_q0p0052_o0p2 10 -0.2000 1.130 FORMAT "%5.3" DEPOSIT ABSOLUTE /end AXIS_DESCR
/end CHARACTERISTIC
/begin CHARACTERISTIC LAMKAML "Lambdasollwert f¸r Katalysator-Ausr‰umen (luftmassenabh‰ngig)" CURVE 0x4EE284 GklWUw 15.99976 fak_uw_b16 0.00 15.99976 FORMAT "%8.5" /begin AXIS_DESCR COM_AXIS ml m_ub_b1020 5 0.00 1020. AXIS_PTS_REF SML05LKUB /end AXIS_DESCR /end CHARACTERISTIC
/begin CHARACTERISTIC LAMKAML2 "" CURVE 0x4EE28E GklWUw 15.99976 fak_uw_b16 0.00 15.99976 FORMAT "%8.5" /begin AXIS_DESCR COM_AXIS ml m_ub_b1020 5 0.00 1020. AXIS_PTS_REF SML05LKUB /end AXIS_DESCR /end CHARACTERISTIC
/begin CHARACTERISTIC LASHKAB "Startwert f¸r dynamische Sollwertanhebung (lamsolh) in der LRHK" VALUE 0x4E87E0 KwSw 0.9999695 fak_sw_b1 0.00 0.9999695 FORMAT "%9.7" /end CHARACTERISTIC
/begin CHARACTERISTIC LIMN "Untere Integratorbegrenzung bei stehendem Fahrzeug" VALUE 0x4E5ADC KwUb 24.90 rel_ub_bn24p9 -24.90 0.00 FORMAT "%5.2" /end CHARACTERISTIC
/begin CHARACTERISTIC LIMNDLLR "Untere Integratorbegrenzung bei Diagnose Leerlaufregelung" VALUE 0x4E5ADD KwUb 24.90 rel_ub_bn24p9 -24.90 0.00 FORMAT "%5.2" /end CHARACTERISTIC
/begin CHARACTERISTIC LIMNDTES "Untere Integratorbegrenzung bei DTES" VALUE 0x4E5ADE KwUb 24.90 rel_ub_bn24p9 -24.90 0.00 FORMAT "%5.2" /end CHARACTERISTIC
/begin CHARACTERISTIC LIMNV "Untere Integratorbegrenzung bei rollendem Fahrzeug" VALUE 0x4E5ADF KwUb 24.90 rel_ub_bn24p9 -24.90 0.00 FORMAT "%5.2" /end CHARACTERISTIC
/begin CHARACTERISTIC LIMX "Obere Integratorbegrenzung bei stehendem Fahrzeug" VALUE 0x4E5AE0 KwUb 24.90 rel_ub_b24p9 0.00 24.90 FORMAT "%5.2" /end CHARACTERISTIC
/begin CHARACTERISTIC LIMXV "Obere Integratorbegrenzung bei rollendem Fahrzeug" VALUE 0x4E5AE1 KwUb 24.90 rel_ub_b24p9 0.00 24.90 FORMAT "%5.2" /end CHARACTERISTIC
/begin CHARACTERISTIC LISTM "Wert des Leerlaufintegrators im Start" CURVE 0x4ED738 GklWUb 24.90 rel_ub_b24p9 0.00 24.90 FORMAT "%5.2"
 /begin AXIS_DESCR COM_AXIS tmot temp_ub_q0p75_o48 6 -48.00 143.3 AXIS_PTS_REF STM06LLUB /end AXIS_DESCR
/end CHARACTERISTIC
/begin CHARACTERISTIC LISTMT "" CURVE 0x4ED740 GklWUb 24.90 rel_ub_b24p9 0.00 24.90 FORMAT "%5.2"
 /begin AXIS_DESCR COM_AXIS tmot temp_ub_q0p75_o48 6 -48.00 143.3 AXIS_PTS_REF STM06LLTUB /end AXIS_DESCR
/end CHARACTERISTIC
/begin CHARACTERISTIC LLRICNF "Configurationsbyte f¸r LLR Integrator" VALUE 0x4E5AE2 KwUb 255.0 dez 0.00 255.0 FORMAT "%5.1" /end CHARACTERISTIC
/begin CHARACTERISTIC Lu_mod "LUR Schalter EIN/AUS" VALUE 0x4E981A KwWU8 255.0 dez 0.00 255.0 FORMAT "%5.1" /end CHARACTERISTIC
/begin CHARACTERISTIC MDHYEZ "Momenten-Hysterese bei Entscheidung der Zylinderausblendung" VALUE 0x4E83A0 KwUb 99.61 rel_ub_b99p6 0.00 99.61 FORMAT "%5.2" /end CHARACTERISTIC
/begin CHARACTERISTIC MDHYST "Hysterese bei der Begrenzung des Sollmoments (Ebene 1 ‹berwachungskonzept)" VALUE 0x4E8306 KwUw 99.99847 rel_uw_b100 0.00 99.99847 FORMAT "%8.5" /end CHARACTERISTIC
/begin CHARACTERISTIC MDIAGMX "Festwert max. erlaubtes ind. Motormoment (bei AG) bei CAN-Timeout" VALUE 0x4E70B8 KwUb 99.61 rel_ub_b99p6 0.00 99.61 FORMAT "%5.2" /end CHARACTERISTIC
/begin CHARACTERISTIC MDSH "Hˆhenabh‰ngiger Anteil des Schleppmomentes" CURVE 0x4ED79D KlAUbSstUbWSb 49.90 rel_q0p1957 -25.05 24.85 FORMAT "%5.2"
 /begin AXIS_DESCR STD_AXIS fho fak_ub_b4 6 0.00 3.984 FORMAT "%5.3" DEPOSIT ABSOLUTE /end AXIS_DESCR
/end CHARACTERISTIC
/begin CHARACTERISTIC MIHGSLG "Drehmomentbegrenzung f¸r Schaltgetriebeschutz" CURVE 0x4E70BC KlAUbSstUbWUb 99.61 rel_ub_b99p6 0.00 99.61 FORMAT "%5.2"
 /begin AXIS_DESCR STD_AXIS gangi dez 7 0.00 255.0 FORMAT "%5.1" DEPOSIT ABSOLUTE /end AXIS_DESCR
/end CHARACTERISTIC
/begin CHARACTERISTIC MIMINMFS "" VALUE 0x4EDE66 KwUw 99.99847 rel_uw_b100 0.00 99.99847 FORMAT "%8.5" /end CHARACTERISTIC
/begin CHARACTERISTIC MINMFS "" VALUE 0x4EDE68 KwSw 199.9969 rel_sw_b100 -100.0000 99.99695 FORMAT "%8.4" /end CHARACTERISTIC
/begin CHARACTERISTIC MIPMFS "" VALUE 0x4EDE6A KwSw 199.9969 rel_sw_b100 -100.0000 99.99695 FORMAT "%8.4" /end CHARACTERISTIC
/begin CHARACTERISTIC MKLSDUGA "" CURVE 0x4EDE1C GklWSw 199.9969 rel_sw_b100 -100.0000 99.99695 FORMAT "%8.4" /begin AXIS_DESCR COM_AXIS gangi dez 8 0.00 255.0 AXIS_PTS_REF SGA08MDUB /end AXIS_DESCR /end CHARACTERISTIC
/begin CHARACTERISTIC MLNKAX "Luftmassenschwelle f¸r Einschaltbereitschaft LRSHK I-Anteil" VALUE 0x4E87E2 KwUw 7281.667 m_uw_b7281 0.00 7281.667 FORMAT "%8.3" /end CHARACTERISTIC
/begin CHARACTERISTIC MLO1 "obere Luftmengenschwelle Bereich 1" VALUE 0x4EC558 KwUw 6553.500 m_uw_b6553p5 0.00 6553.500 FORMAT "%8.3" /end CHARACTERISTIC
/begin CHARACTERISTIC MLO2 "obere Luftmengenschwelle Bereich 2" VALUE 0x4E4D7A KwUw 6553.500 m_uw_b6553p5 0.00 6553.500 FORMAT "%8.3" /end CHARACTERISTIC
/begin CHARACTERISTIC MLO3 "obere Luftmengenschwelle Bereich 3" VALUE 0x4EC55A KwUw 6553.500 m_uw_b6553p5 0.00 6553.500 FORMAT "%8.3" /end CHARACTERISTIC
/begin CHARACTERISTIC MLU2 "untere Luftmengenschwelle Bereich 2" VALUE 0x4EC55C KwUw 6553.500 m_uw_b6553p5 0.00 6553.500 FORMAT "%8.3" /end CHARACTERISTIC
/begin CHARACTERISTIC MLU4 "untere Luftmengenschwelle Bereich 4" VALUE 0x4E4D7C KwUw 6553.500 m_uw_b6553p5 0.00 6553.500 FORMAT "%8.3" /end CHARACTERISTIC
/begin CHARACTERISTIC MPNMFS "" VALUE 0x4EDE6C KwSw 199.9969 rel_sw_b100 -100.0000 99.99695 FORMAT "%8.4" /end CHARACTERISTIC
/begin CHARACTERISTIC MPPMFS "" VALUE 0x4EDE6E KwSw 199.9969 rel_sw_b100 -100.0000 99.99695 FORMAT "%8.4" /end CHARACTERISTIC
/begin CHARACTERISTIC MRFALLO "Obere Leerlaufschwelle des relativen Fahrerwunschmoments" VALUE 0x4E707E KwUw 199.9969 rel_uw_b200 0.00 199.9969 FORMAT "%8.4" /end CHARACTERISTIC
/begin CHARACTERISTIC MRFALLU "Untere Leerlaufschwelle des relativen Fahrerwunschmoments" VALUE 0x4E7080 KwUw 199.9969 rel_uw_b200 0.00 199.9969 FORMAT "%8.4" /end CHARACTERISTIC
/begin CHARACTERISTIC MRFUEMXN "Kennlinie max. ereichbares Fahrerwunschmoment f¸r Pedal¸berweg" CURVE 0x4E7082 KlAUwSstUwWUw 199.9969 rel_uw_b200 0.00 199.9969 FORMAT "%8.4"
 /begin AXIS_DESCR STD_AXIS nmot_w nmot_uw_q0p25 6 0.00 16383.75 FORMAT "%8.2" DEPOSIT ABSOLUTE /end AXIS_DESCR
/end CHARACTERISTIC
/begin CHARACTERISTIC N0 "Umrechnungskonstante f¸r Einrechnung Gemischkorrektur rkat" VALUE 0x4E4D77 KwUb 10200. nmot_ub_q40 0.00 10200. FORMAT "%5.0" /end CHARACTERISTIC
/begin CHARACTERISTIC NASNOT "Drehzahlschwelle f¸r ASR-Verbot wegen Abw¸rgeschutz" VALUE 0x4E70D8 KwUb 2560. nmot_ub_q40 0.00 2560. FORMAT "%5.0" /end CHARACTERISTIC
/begin CHARACTERISTIC NDSU "Differenzdrehzahl f¸r Integratorreset" VALUE 0x4E5B38 KwSw 8191.750 nmotd_sw_q0p25 0.00 8191.750 FORMAT "%8.3" /end CHARACTERISTIC
/begin CHARACTERISTIC Ngerad11 "Drehzahlschwelle 11" VALUE 0x4E981B KwWU8 10200. nmot_ub_q40 0.00 10200. FORMAT "%5.0" /end CHARACTERISTIC
/begin CHARACTERISTIC Ngerad12 "Drehzahlschwelle 12" VALUE 0x4E981C KwWU8 10200. nmot_ub_q40 0.00 10200. FORMAT "%5.0" /end CHARACTERISTIC
/begin CHARACTERISTIC Ngerad21 "Drehzahlschwelle 21" VALUE 0x4E981D KwWU8 10200. nmot_ub_q40 0.00 10200. FORMAT "%5.0" /end CHARACTERISTIC
/begin CHARACTERISTIC Ngerad22 "Drehzahlschwelle 22" VALUE 0x4E981E KwWU8 10200. nmot_ub_q40 0.00 10200. FORMAT "%5.0" /end CHARACTERISTIC
/begin CHARACTERISTIC NGFSAWE "Schwelle Drehzahlgradient f¸r Sperrung Filter SA/WE" VALUE 0x4E709C KwSw 25599.94 nmotg_sw_q0p39 -12800.16 12799.77 FORMAT "%8.2" /end CHARACTERISTIC
/begin CHARACTERISTIC NGHGS "Drehzahlgradient f¸r gangabh‰ngige Momentenbegrenzung" VALUE 0x4E70CC KwSw 25599.94 nmotg_sw_q0p39 -12800.16 12799.77 FORMAT "%8.2" /end CHARACTERISTIC
/begin CHARACTERISTIC NKUPZWEO "Obere Drehzahl-Hytereseschwelle f¸r KUP-ZW-Eingriffe" VALUE 0x4E70D9 KwUb 10200. nmot_ub_q40 0.00 10200. FORMAT "%5.0" /end CHARACTERISTIC
/begin CHARACTERISTIC NKUPZWEU "Untere Drehzahl-Hytereseschwelle f¸r KUP-ZW-Eingriffe" VALUE 0x4E70DA KwUb 10200. nmot_ub_q40 0.00 10200. FORMAT "%5.0" /end CHARACTERISTIC
/begin CHARACTERISTIC NLLZWEO "Obere  Drehzahl-Hytereseschwelle f¸r LL-ZW-Eingriffe" VALUE 0x4E70DB KwUb 10200. nmot_ub_q40 0.00 10200. FORMAT "%5.0" /end CHARACTERISTIC
/begin CHARACTERISTIC NLLZWEU "Untere Drehzahl-Hytereseschwelle f¸r LL-ZW-Eingriffe" VALUE 0x4E70DC KwUb 10200. nmot_ub_q40 0.00 10200. FORMAT "%5.0" /end CHARACTERISTIC
/begin CHARACTERISTIC NLRHO "obere Drehzahlgrenze f¸r Regelung hinter Kat" VALUE 0x4E877D KwUb 10200. nmot_ub_q40 0.00 10200. FORMAT "%5.0" /end CHARACTERISTIC
/begin CHARACTERISTIC NLRHU "untere Drehzahlgrenze f¸r Regelung hinter Kat" VALUE 0x4E877E KwUb 10200. nmot_ub_q40 0.00 10200. FORMAT "%5.0" /end CHARACTERISTIC
/begin CHARACTERISTIC NLRKA "Drehzahlschwelle f¸r Unterdr¸cken gesteuertes Kat-Ausr‰umen" VALUE 0x4E8810 KwUb 10200. nmot_ub_q40 0.00 10200. FORMAT "%5.0" /end CHARACTERISTIC
/begin CHARACTERISTIC NLRSHB "Drehzahlschwelle, Abschalten LR bei Schub, in Verbindung mit LL und TLLRSHB" VALUE 0x4E8738 KwUb 10200. nmot_ub_q40 0.00 10200. FORMAT "%5.0" /end CHARACTERISTIC
/begin CHARACTERISTIC NLSDZWEO "Obere Drehzahl-Hytereseschwelle f¸r LSD-ZW-Eingriffe" VALUE 0x4E70DD KwUb 10200. nmot_ub_q40 0.00 10200. FORMAT "%5.0" /end CHARACTERISTIC
/begin CHARACTERISTIC NLSDZWEU "Untere Drehzahl-Hytereseschwelle f¸r LSD-ZW-Eingriffe" VALUE 0x4E70DE KwUb 10200. nmot_ub_q40 0.00 10200. FORMAT "%5.0" /end CHARACTERISTIC
/begin CHARACTERISTIC Nlumn "Drehzahl Minimum" VALUE 0x4E981F KwWU8 10200. nmot_ub_q40 0.00 10200. FORMAT "%5.0" /end CHARACTERISTIC
/begin CHARACTERISTIC Nlumx "Drehzahlschwelle 2" VALUE 0x4E9820 KwWU8 10200. nmot_ub_q40 0.00 10200. FORMAT "%5.0" /end CHARACTERISTIC
/begin CHARACTERISTIC NMDSTAOF "Drehzahloffset auf Wiedereinsetzdrehzahl f¸r Momentenberechnung" VALUE 0x4E5C0A KwUb 10200. nmot_ub_q40 0.00 10200. FORMAT "%5.0" /end CHARACTERISTIC
/begin CHARACTERISTIC NO1 "obere Drehzahlschwelle Bereich 1" VALUE 0x4EC550 KwUb 10200. nmot_ub_q40 0.00 10200. FORMAT "%5.0" /end CHARACTERISTIC
/begin CHARACTERISTIC NOLRA "Codewort f¸r Adaptionsfreigabe" VALUE 0x4EC551 KwUb 255.0 dez 0.00 255.0 FORMAT "%5.1" /end CHARACTERISTIC
/begin CHARACTERISTIC NRKAB "Mindestdrehzahl f¸r Begrenzung Stelleingriff rkat bei niedrigen Drehzahlen" VALUE 0x4E4D78 KwUb 10200. nmot_ub_q40 0.00 10200. FORMAT "%5.0" /end CHARACTERISTIC
/begin CHARACTERISTIC NU3 "untere Drehzahlschwelle Bereich 3" VALUE 0x4EC552 KwUb 10200. nmot_ub_q40 0.00 10200. FORMAT "%5.0" /end CHARACTERISTIC
/begin CHARACTERISTIC PLRHAV "Wichtungsfaktor des P-Anteils in der LRHK ¸ber KAT-Alterung" CURVE 0x4E8780 KlAUbSstUbWUb 0.9961 fak_ub_b1 0.00 0.9961 /begin AXIS_DESCR STD_AXIS iavkatf fak_ub_b1 8 0.00 0.9961 DEPOSIT ABSOLUTE /end AXIS_DESCR /end CHARACTERISTIC
/begin CHARACTERISTIC PLRHML "" CURVE 0x4EE1C8 GklWSb 2.550 t100msxs_sb_q0p01 -1.280 1.270 FORMAT "%5.3" /begin AXIS_DESCR COM_AXIS ml m_ub_b1020 8 0.00 1020. AXIS_PTS_REF SML08LHUB /end AXIS_DESCR /end CHARACTERISTIC
/begin CHARACTERISTIC PVDN "LLR: P-Verst‰rkung bei stehendem Fahrzeug" CURVE 0x4E5AE4 GklWUb 0.7782 rel_ub_b0p78 0.00 0.7782
 /begin AXIS_DESCR COM_AXIS dn_w nmotd_sw_q0p25 8 -8192.000 8191.750 AXIS_PTS_REF SDN08LLSW /end AXIS_DESCR
/end CHARACTERISTIC
/begin CHARACTERISTIC PVDNT "" CURVE 0x4E5AEC GklWUb 0.7782 rel_ub_b0p78 0.00 0.7782
 /begin AXIS_DESCR COM_AXIS dn_w nmotd_sw_q0p25 8 -8192.000 8191.750 AXIS_PTS_REF SDN08LLTSW /end AXIS_DESCR
/end CHARACTERISTIC
/begin CHARACTERISTIC PVDNTV "" CURVE 0x4E5AF4 GklWUb 0.7782 rel_ub_b0p78 0.00 0.7782
 /begin AXIS_DESCR COM_AXIS dn_w nmotd_sw_q0p25 8 -8192.000 8191.750 AXIS_PTS_REF SDN08LLTSW /end AXIS_DESCR
/end CHARACTERISTIC
/begin CHARACTERISTIC PVDNV "LLR: P-Verst‰rkung bei rollendem Fahrzeug" CURVE 0x4E5AFC GklWUb 0.7782 rel_ub_b0p78 0.00 0.7782
 /begin AXIS_DESCR COM_AXIS dn_w nmotd_sw_q0p25 8 -8192.000 8191.750 AXIS_PTS_REF SDN08LLSW /end AXIS_DESCR
/end CHARACTERISTIC
/begin CHARACTERISTIC PVDNVZ "LLR: P-Z¸ndungsanteilverst‰rkung bei rollendem Fzg." CURVE 0x4E5B04 GklWUb 0.7782 rel_ub_b0p78 0.00 0.7782
 /begin AXIS_DESCR COM_AXIS dn_w nmotd_sw_q0p25 8 -8192.000 8191.750 AXIS_PTS_REF SDN08LLSW /end AXIS_DESCR
/end CHARACTERISTIC
/begin CHARACTERISTIC PVDNVZT "" CURVE 0x4E5B0C GklWUb 0.7782 rel_ub_b0p78 0.00 0.7782
 /begin AXIS_DESCR COM_AXIS dn_w nmotd_sw_q0p25 8 -8192.000 8191.750 AXIS_PTS_REF SDN08LLTSW /end AXIS_DESCR
/end CHARACTERISTIC
/begin CHARACTERISTIC PVDNZ "LLR: P-Z¸ndungsanteilverst‰rkung bei stehendem Fzg." CURVE 0x4E5B14 GklWUb 0.7782 rel_ub_b0p78 0.00 0.7782
 /begin AXIS_DESCR COM_AXIS dn_w nmotd_sw_q0p25 8 -8192.000 8191.750 AXIS_PTS_REF SDN08LLSW /end AXIS_DESCR
/end CHARACTERISTIC
/begin CHARACTERISTIC PVDNZT "" CURVE 0x4E5B1C GklWUb 0.7782 rel_ub_b0p78 0.00 0.7782
 /begin AXIS_DESCR COM_AXIS dn_w nmotd_sw_q0p25 8 -8192.000 8191.750 AXIS_PTS_REF SDN08LLTSW /end AXIS_DESCR
/end CHARACTERISTIC
/begin CHARACTERISTIC QUFRMN "" VALUE 0x4E8732 KwUw 1.999969 fak_uw_b2 0.00 1.999969 FORMAT "%8.6" /end CHARACTERISTIC
/begin CHARACTERISTIC QUFRMX "" VALUE 0x4E8734 KwUw 1.999969 fak_uw_b2 0.00 1.999969 FORMAT "%8.6" /end CHARACTERISTIC
/begin CHARACTERISTIC REDHYOC "Hysterese der Reduzierstufe bei grˆﬂerer Soll-Reduzierstufe als Ist-Wert" VALUE 0x4E83A1 KwSb 3.984 rel_sb_q0p02 -2.000 1.984 FORMAT "%5.3" /end CHARACTERISTIC
/begin CHARACTERISTIC REDHYUC "Hysterese der Reduzierstufe bei kleinerer Soll-Reduzierstufe als Ist-Wert" VALUE 0x4E83A2 KwSb 3.984 rel_sb_q0p02 -2.000 1.984 FORMAT "%5.3" /end CHARACTERISTIC
/begin CHARACTERISTIC REDMXSA "maximale Reduzierstufe bei sequentieller Schubabschaltung" VALUE 0x4E83A3 KwUb 255.0 dez 0.00 255.0 FORMAT "%5.1" /end CHARACTERISTIC
/begin CHARACTERISTIC REDZEM "Schwelle zwischen Z¸ndeingriff und Einspritzausblendung" CURVE 0x4EDE70 KlAUbSstUbWUb 255.0 dez 0.00 255.0 FORMAT "%5.1"
 /begin AXIS_DESCR STD_AXIS tmot temp_ub_q0p75_o48 5 -48.00 143.3 FORMAT "%5.1" DEPOSIT ABSOLUTE /end AXIS_DESCR
/end CHARACTERISTIC
/begin CHARACTERISTIC RKATMN "untere Schwelle additive Korrektur pro Zeit" VALUE 0x4EC55E KwSw 3071.953 rel_sw_b1536 -1536.000 1535.953 FORMAT "%8.3" /end CHARACTERISTIC
/begin CHARACTERISTIC RKATMX "obere Schwelle additive Korrektur pro Zeit" VALUE 0x4EC560 KwSw 3071.953 rel_sw_b1536 -1536.000 1535.953 FORMAT "%8.3" /end CHARACTERISTIC
/begin CHARACTERISTIC RKATRN "reduzierte untere Schwelle additive Korrektur pro Zeit" VALUE 0x4EC562 KwSw 3071.953 rel_sw_b1536 -1536.000 1535.953 FORMAT "%8.3" /end CHARACTERISTIC
/begin CHARACTERISTIC RKATRX "reduzierte obere Schwelle additive Korrektur pro Zeit" VALUE 0x4EC564 KwSw 3071.953 rel_sw_b1536 -1536.000 1535.953 FORMAT "%8.3" /end CHARACTERISTIC
/begin CHARACTERISTIC RKAZMN "untere Schwelle additive Korrektur pro Z¸ndung" VALUE 0x4EC566 KwSw 3071.953 rel_sw_b1536 -1536.000 1535.953 FORMAT "%8.3" /end CHARACTERISTIC
/begin CHARACTERISTIC RKAZMX "obere Schwelle additive Korrektur pro Z¸ndung" VALUE 0x4EC568 KwSw 3071.953 rel_sw_b1536 -1536.000 1535.953 FORMAT "%8.3" /end CHARACTERISTIC
/begin CHARACTERISTIC RKAZRN "reduzierte untere Schwelle additive Korrektur pro Z¸ndung" VALUE 0x4EC56A KwSw 3071.953 rel_sw_b1536 -1536.000 1535.953 FORMAT "%8.3" /end CHARACTERISTIC
/begin CHARACTERISTIC RKAZRX "reduzierte obere Schwelle additive Korrektur pro Z¸ndung" VALUE 0x4EC56C KwSw 3071.953 rel_sw_b1536 -1536.000 1535.953 FORMAT "%8.3" /end CHARACTERISTIC
/begin CHARACTERISTIC RLLRHON "Kennlinie ¸ber nmot, obere rL Regelgrenze f¸r Regler hinter KAT" CURVE 0x4EE1D0 GklWUb 191.3 rel_ub_q0p75 0.00 191.3 FORMAT "%5.1"
 /begin AXIS_DESCR COM_AXIS nmot nmot_ub_q40 8 0.00 10200. AXIS_PTS_REF SNM08LHUB /end AXIS_DESCR
/end CHARACTERISTIC
/begin CHARACTERISTIC RLLRHUN "Kennlinie ¸ber nmot, untere rL Regelgrenze f¸r Regler hinter KAT" CURVE 0x4EE1D8 GklWUb 191.3 rel_ub_q0p75 0.00 191.3 FORMAT "%5.1"
 /begin AXIS_DESCR COM_AXIS nmot nmot_ub_q40 8 0.00 10200. AXIS_PTS_REF SNM08LHUB /end AXIS_DESCR
/end CHARACTERISTIC
/begin CHARACTERISTIC RLLRSHB "relative Lastschwelle, Abschalten LR bei SLS, in Verbindung mit LL und NLRSHB" VALUE 0x4E8739 KwUb 191.3 rel_ub_q0p75 0.00 191.3 FORMAT "%5.1" /end CHARACTERISTIC
/begin CHARACTERISTIC RLLRUN "Kennlinie ¸ber nmot, untere rL Regelgrenze f¸r Regler vor KAT" CURVE 0x4EE138 KlAUbSstUbWUb 191.3 rel_ub_q0p75 0.00 191.3 FORMAT "%5.1"
 /begin AXIS_DESCR STD_AXIS nmot nmot_ub_q40 8 0.00 10200. FORMAT "%5.0" DEPOSIT ABSOLUTE /end AXIS_DESCR
/end CHARACTERISTIC
/begin CHARACTERISTIC RLO2 "obere Lastschwelle Bereich 2" VALUE 0x4EC553 KwUb 191.3 rel_ub_q0p75 0.00 191.3 FORMAT "%5.1" /end CHARACTERISTIC
/begin CHARACTERISTIC RLO3 "obere rl - Schwelle Bereich 3" VALUE 0x4EC554 KwUb 191.3 rel_ub_q0p75 0.00 191.3 FORMAT "%5.1" /end CHARACTERISTIC
/begin CHARACTERISTIC RLRAN "" CURVE 0x4EE14C KlAUbSstUbWUb 191.3 rel_ub_q0p75 0.00 191.3 FORMAT "%5.1"
 /begin AXIS_DESCR STD_AXIS nmot nmot_ub_q40 8 0.00 10200. FORMAT "%5.0" DEPOSIT ABSOLUTE /end AXIS_DESCR
/end CHARACTERISTIC
/begin CHARACTERISTIC RLRVAO "" VALUE 0x4EE15D KwUb 191.3 rel_ub_q0p75 0.00 191.3 FORMAT "%5.1" /end CHARACTERISTIC
/begin CHARACTERISTIC RLU2 "untere rl - Schwelle Bereich 2" VALUE 0x4EC555 KwUb 191.3 rel_ub_q0p75 0.00 191.3 FORMAT "%5.1" /end CHARACTERISTIC
/begin CHARACTERISTIC RLU3 "untere rl - Schwelle Bereich 3" VALUE 0x4EC556 KwUb 191.3 rel_ub_q0p75 0.00 191.3 FORMAT "%5.1" /end CHARACTERISTIC
/begin CHARACTERISTIC RLU4 "untere rl -Schwelle oberer multiplikativer Bereich" VALUE 0x4EC557 KwUb 191.3 rel_ub_q0p75 0.00 191.3 FORMAT "%5.1" /end CHARACTERISTIC
/begin CHARACTERISTIC RLVMXN "Maximaler Volumenstrom bei offener Drosselklappe" CURVE 0x4E8364 KlAUbSstUbWUb 191.3 rel_ub_q0p75 0.00 191.3 FORMAT "%5.1"
 /begin AXIS_DESCR STD_AXIS snmta nmot_ub_q40 11 0.00 10200. FORMAT "%5.0" DEPOSIT ABSOLUTE /end AXIS_DESCR
/end CHARACTERISTIC
/begin AXIS_PTS SDN08LLSW "" 0x4E5B3A dn_w SstASwSstSw 16383.75 nmotd_sw_q0p25 8 -8192.000 8191.750 FORMAT "%8.3" DEPOSIT ABSOLUTE /end AXIS_PTS
/begin AXIS_PTS SDN08LLTSW "" 0x4E5B4C dn_w SstASwSstSw 16383.75 nmotd_sw_q0p25 8 -8192.000 8191.750 FORMAT "%8.3" DEPOSIT ABSOLUTE /end AXIS_PTS
/begin CHARACTERISTIC Segklu "Ausblendung nach LU-Berechnung frei" VALUE 0x4E9821 KwWU8 255.0 lur_seg 0.00 255.0 FORMAT "%5.1" /end CHARACTERISTIC
/begin CHARACTERISTIC SEGMENT_ZYL "" VAL_BLK 0x4E9824 KwbUb 3.000 dez 0.00 3.000 FORMAT "%5.3" NUMBER 4 /end CHARACTERISTIC
/begin CHARACTERISTIC Segsazad "Segmente SA aktiv bis AD erlaubt" VALUE 0x4E9822 KwWU8 255.0 lur_seg 0.00 255.0 FORMAT "%5.1" /end CHARACTERISTIC
/begin AXIS_PTS SGA08MDUB "St¸tzstellenverteilung Ist Gang 8 Sst." 0x4E2A64 gangi SstAUbSstUb 255.0 dez 8 0.00 255.0 FORMAT "%5.1" DEPOSIT ABSOLUTE /end AXIS_PTS
/begin AXIS_PTS SMK06MDUW "" 0x4E709E mkfanb_w SstASwSstSw 199.9969 rel_sw_b100 6 -100.0000 99.99695 FORMAT "%8.4" DEPOSIT ABSOLUTE /end AXIS_PTS
/begin AXIS_PTS SML05LKUB "" 0x4E2A80 ml SstAUbSstUb 1020. m_ub_b1020 5 0.00 1020. FORMAT "%5.0" DEPOSIT ABSOLUTE /end AXIS_PTS
/begin AXIS_PTS SML08LHUB "ml abh‰ngige St¸tzstellen (Anzahl 8)" 0x4EA10C ml SstAUbSstUb 1020. m_ub_b1020 8 0.00 1020. FORMAT "%5.0" DEPOSIT ABSOLUTE /end AXIS_PTS
/begin AXIS_PTS SNG06LLSB "St¸tzstellenverteilung Drehzahlgradient, 6 Sst." 0x4E2A88 ngfil SstAUbSstSb 25500. nmotg_sb_q100 6 -12800. 12700. FORMAT "%5.0" DEPOSIT ABSOLUTE /end AXIS_PTS
/begin AXIS_PTS SNG06LLTSB "" 0x4E2A90 ngfil SstAUbSstSb 25500. nmotg_sb_q100 6 -12800. 12700. FORMAT "%5.0" DEPOSIT ABSOLUTE /end AXIS_PTS
/begin AXIS_PTS SNM06LHUB "" 0x4EA118 nmot SstAUbSstUb 10200. nmot_ub_q40 6 0.00 10200. FORMAT "%5.0" DEPOSIT ABSOLUTE /end AXIS_PTS
/begin AXIS_PTS SNM06LLUB "S¸tzstellenverteilung f¸r Motordrehzahl" 0x4E2AA0 nmot SstAUbSstUb 10200. nmot_ub_q40 6 0.00 10200. FORMAT "%5.0" DEPOSIT ABSOLUTE /end AXIS_PTS
/begin AXIS_PTS SNM06MDUW "Rover" 0x4EA216 nmot_w SstAUwSstUw 16383.75 nmot_uw_q0p25 6 0.00 16383.75 FORMAT "%8.2" DEPOSIT ABSOLUTE /end AXIS_PTS
/begin AXIS_PTS SNM07LRUB "" 0x4E2AA8 nmot SstAUbSstUb 10200. nmot_ub_q40 7 0.00 10200. FORMAT "%5.0" DEPOSIT ABSOLUTE /end AXIS_PTS
/begin AXIS_PTS SNM08LHUB "nmot abh‰ngige St¸tzstellen (Anzahl 8)" 0x4EA128 nmot SstAUbSstUb 10200. nmot_ub_q40 8 0.00 10200. FORMAT "%5.0" DEPOSIT ABSOLUTE /end AXIS_PTS
/begin AXIS_PTS SNM12FEUB "St¸tzstellen f¸r WDKSMX, WDKUGDN" 0x4E2AF0 nmot SstAUbSstUb 10200. nmot_ub_q40 12 0.00 10200. FORMAT "%5.0" DEPOSIT ABSOLUTE /end AXIS_PTS
/begin AXIS_PTS SNM16OPUW "St¸tzstellenverteilung Drehzahl" 0x4E2BBC nmot_w SstAUwSstUw 16383.75 nmot_uw_q0p25 16 0.00 16383.75 FORMAT "%8.2" DEPOSIT ABSOLUTE /end AXIS_PTS
/begin AXIS_PTS SNS06LLSB "St¸tzstellenvert., Solldrehzahlabw., 06 Sst., LL-Regel." 0x4E5A38 dns SstAUbSstSb 2550. nmotd_sb_q10 6 -1280. 1270. FORMAT "%5.0" DEPOSIT ABSOLUTE /end AXIS_PTS
/begin AXIS_PTS SNS06LLTSB "" 0x4E5A40 dns SstAUbSstSb 2550. nmotd_sb_q10 6 -1280. 1270. FORMAT "%5.0" DEPOSIT ABSOLUTE /end AXIS_PTS
/begin AXIS_PTS SRL06LHUB "" 0x4E2B3C rl SstAUbSstUb 191.3 rel_ub_q0p75 6 0.00 191.3 FORMAT "%5.1" DEPOSIT ABSOLUTE /end AXIS_PTS
/begin AXIS_PTS SRL06LRUB "" 0x4E2B44 rl SstAUbSstUb 191.3 rel_ub_q0p75 6 0.00 191.3 FORMAT "%5.1" DEPOSIT ABSOLUTE /end AXIS_PTS
/begin AXIS_PTS SRL16OPUW "St¸tzstellenverteilung relative Luftf¸llung" 0x4E68A6 rl_w_kge SstAUwSstUw 1535.977 rel_uw_q0p0234 16 0.00 1535.977 FORMAT "%8.3" DEPOSIT ABSOLUTE /end AXIS_PTS
/begin AXIS_PTS STM04FEUB "St¸tzstellenverteilung Motortemperatur" 0x4E2B88 tmot SstAUbSstUb 191.3 temp_ub_q0p75_o48 4 -48.00 143.3 FORMAT "%5.1" DEPOSIT ABSOLUTE /end AXIS_PTS
/begin AXIS_PTS STM06LLTUB "" 0x4EA1A4 tmot SstAUbSstUb 191.3 temp_ub_q0p75_o48 6 -48.00 143.3 FORMAT "%5.1" DEPOSIT ABSOLUTE /end AXIS_PTS
/begin AXIS_PTS STM06LLUB "St¸tzstellenverteilung Motortemperatur, 6 Sst." 0x4EA1AC tmot SstAUbSstUb 191.3 temp_ub_q0p75_o48 6 -48.00 143.3 FORMAT "%5.1" DEPOSIT ABSOLUTE /end AXIS_PTS
/begin AXIS_PTS STMZYL08LEUW "" 0x4EA268 tmotzyl_w SstAUwSstUw 49151.25 temp_ub_q0p75_o48 8 -48.00000 49103.25 FORMAT "%8.2" DEPOSIT ABSOLUTE /end AXIS_PTS
/begin CHARACTERISTIC STNMTA "St¸tzstellen-Korrektur von nmot" CURVE 0x4E837B KlAUbSstUbWSb 10200. nmot_sb_q40 -5120. 5080. FORMAT "%5.0"
 /begin AXIS_DESCR STD_AXIS tans temp_ub_q0p75_o48 6 -48.00 143.3 FORMAT "%5.1" DEPOSIT ABSOLUTE /end AXIS_DESCR
/end CHARACTERISTIC
/begin CHARACTERISTIC S_dmfbdpf "" VALUE 0x4E6B8F KwUb 255.0 dez 0.00 255.0 FORMAT "%5.1" /end CHARACTERISTIC
/begin CHARACTERISTIC S_mdversta "Umschalter f¸r Einrechnung Verbrauchermomente in mimin_w" VALUE 0x4E5C2E KwUb 255.0 dez 0.00 255.0 FORMAT "%5.1" /end CHARACTERISTIC
/begin CHARACTERISTIC TANSDMAD "" VALUE 0x4E5DAC KwUb 191.3 temp_ub_q0p75_o48 -48.00 143.3 FORMAT "%5.1" /end CHARACTERISTIC
/begin CHARACTERISTIC TANSDMADMX "" VALUE 0x4E5DAD KwUb 191.3 temp_ub_q0p75_o48 -48.00 143.3 FORMAT "%5.1" /end CHARACTERISTIC
/begin CHARACTERISTIC TARA "Temperaturschwelle Ansaugluft" VALUE 0x4E4DAB KwUb 191.3 temp_ub_q0p75_o48 -48.00 143.3 FORMAT "%5.1" /end CHARACTERISTIC
/begin CHARACTERISTIC TARAU "Ansauglufttemperaturschwelle f¸r Einschalten der Lambda - Regelung" VALUE 0x4EE15E KwUb 191.3 temp_ub_q0p75_o48 -48.00 143.3 FORMAT "%5.1" /end CHARACTERISTIC
/begin CHARACTERISTIC TASHS "Schwelle Ansauglufttemp. f¸r Auslˆsung TLRHS - Sperrzeit LR bei Heiﬂstart" VALUE 0x4EE15F KwUb 191.3 temp_ub_q0p75_o48 -48.00 143.3 FORMAT "%5.1" /end CHARACTERISTIC
/begin CHARACTERISTIC TBLRH "Sperrzeit f¸r Regelung hinter Kat nach Freigabe durch Regelung vor Kat" VALUE 0x4E8791 KwUb 25.40 t100msxs_ub_b25p5 0.1000 25.50 FORMAT "%5.2" /end CHARACTERISTIC
/begin CHARACTERISTIC TBLRH2 "Sperrzeit f¸r Regelung hinter Kat nach Freigabe durch Regelung vor Kat Bank 2" VALUE 0x4E8792 KwUb 25.40 t100msxs_ub_b25p5 0.1000 25.50 FORMAT "%5.2" /end CHARACTERISTIC
/begin CHARACTERISTIC TDFRKAD "" VALUE 0x4E8818 KwUw 1309.9800107 zk20msxs_uw_b1310 0.019989318685 1310.0000000 FORMAT "%12.7" /end CHARACTERISTIC
/begin CHARACTERISTIC TDFRKAU "" VALUE 0x4E881A KwUw 1309.9800107 zk20msxs_uw_b1310 0.019989318685 1310.0000000 FORMAT "%12.7" /end CHARACTERISTIC
/begin CHARACTERISTIC TDMFBSA "Zeitkonstante PT1-Filter beim Schubabschalten" VALUE 0x4E70AC KwUw 655.350000 zk10msxs_uw_b655 0.0100001526 655.360000 FORMAT "%10.6" /end CHARACTERISTIC
/begin CHARACTERISTIC TDMFBWE "Zeitkonstante PT1-Filter beim weichen Wiedereinsetzen" VALUE 0x4E70AE KwUw 655.350000 zk10msxs_uw_b655 0.0100001526 655.360000 FORMAT "%10.6" /end CHARACTERISTIC
/begin CHARACTERISTIC TKATMLRH "Einschaltschwelle Kat-Modelltemperatur  f¸r Lambdaregelung hinter Kat" VALUE 0x4E8793 KwUb 1275. temp_ub_q5_o50 -50.00 1225. FORMAT "%5.0" /end CHARACTERISTIC
/begin CHARACTERISTIC TKATMLRH2 "Einschaltschwelle Kat-Modelltemperatur  f¸r Lambdaregelung hinter Kat, Bank 2" VALUE 0x4E8794 KwUb 1275. temp_ub_q5_o50 -50.00 1225. FORMAT "%5.0" /end CHARACTERISTIC
/begin CHARACTERISTIC TLRBAM "Sperrzeit f¸r Einschalten LR nach BA" CURVE 0x4EE160 GklWUb 25.50 t100msxs_ub_b25p5 0.00 25.50 FORMAT "%5.2"
 /begin AXIS_DESCR COM_AXIS tmotzyl_w temp_ub_q0p75_o48 8 -48.00000 49103.25 AXIS_PTS_REF STMZYL08LEUW /end AXIS_DESCR
/end CHARACTERISTIC
/begin CHARACTERISTIC TLRHS "Sperrzeit LR bei Heiﬂstart, ausgelˆst ¸ber Schwellen TASHS und TMSHS" VALUE 0x4EE168 KwUb 25.50 t100msxs_ub_b25p5 0.00 25.50 FORMAT "%5.2" /end CHARACTERISTIC
/begin CHARACTERISTIC TLRTMS "Sperrzeit LR nach Start, abh‰ngig von der Motortemperatur bei Start" CURVE 0x4E873E KlAUbSstUwWUw 6553.500 t100msxs_uw_b6553p5 0.00 6553.500 FORMAT "%8.3"
 /begin AXIS_DESCR STD_AXIS tmstzyl_w temp_ub_q0p75_o48 5 -48.00000 49103.25 FORMAT "%8.2" DEPOSIT ABSOLUTE /end AXIS_DESCR
/end CHARACTERISTIC
/begin CHARACTERISTIC TLRVAM "Sperrzeit f¸r Einschalten LR nach VA" CURVE 0x4EE16C GklWUb 25.50 t100msxs_ub_b25p5 0.00 25.50 FORMAT "%5.2"
 /begin AXIS_DESCR COM_AXIS tmotzyl_w temp_ub_q0p75_o48 8 -48.00000 49103.25 AXIS_PTS_REF STMZYL08LEUW /end AXIS_DESCR
/end CHARACTERISTIC
/begin CHARACTERISTIC TLRZWTMS "Zeit f¸r Zwangseinschaltung LR (CARB-Forderung) nach Start" CURVE 0x4E8754 KlAUbSstUwWUw 6553.500 t100msxs_uw_b6553p5 0.00 6553.500 FORMAT "%8.3"
 /begin AXIS_DESCR STD_AXIS tmstzyl_w temp_ub_q0p75_o48 4 -48.00000 49103.25 FORMAT "%8.2" DEPOSIT ABSOLUTE /end AXIS_DESCR
/end CHARACTERISTIC
/begin CHARACTERISTIC TMDMAD "Motortemperaturschwelle f¸r Freigabe der Adaption des Verlustmoments" VALUE 0x4ED7B6 KwUb 191.3 temp_ub_q0p75_o48 -48.00 143.3 FORMAT "%5.1" /end CHARACTERISTIC
/begin CHARACTERISTIC TMDMADMX "" VALUE 0x4ED7B7 KwUb 191.3 temp_ub_q0p75_o48 -48.00 143.3 FORMAT "%5.1" /end CHARACTERISTIC
/begin CHARACTERISTIC TMRA1 "Ausschaltbedingung (S_LL = 0)" VALUE 0x4EE178 KwUw 49151.25 temp_ub_q0p75_o48 -48.00000 49103.25 FORMAT "%8.2" /end CHARACTERISTIC
/begin CHARACTERISTIC TMRA2 "Ausschaltbedingung (S_LL = 1)" VALUE 0x4EE17A KwUw 49151.25 temp_ub_q0p75_o48 -48.00000 49103.25 FORMAT "%8.2" /end CHARACTERISTIC
/begin CHARACTERISTIC TMRAA "Einschalttemperatur LRA" VALUE 0x4E4DAE KwUw 49151.25 temp_ub_q0p75_o48 -48.00000 49103.25 FORMAT "%8.2" /end CHARACTERISTIC
/begin CHARACTERISTIC TMRAK "Ausschaltschwelle der Lambda - Regelung bei niedriger Starttemperatur" VALUE 0x4EE17C KwUw 49151.25 temp_ub_q0p75_o48 -48.00000 49103.25 FORMAT "%8.2" /end CHARACTERISTIC
/begin CHARACTERISTIC TMSHS "Schwelle Motortemp. f¸r Auslˆsung TLRHS - Sperrzeit LR bei Heiﬂstart" VALUE 0x4EE17E KwUw 49151.25 temp_ub_q0p75_o48 -48.00000 49103.25 FORMAT "%8.2" /end CHARACTERISTIC
/begin CHARACTERISTIC TMVER "Entprellzeit zur Erkennung einer dauerhaften Momentenbegrenzung" VALUE 0x4EDE4E KwUw 65535.00 t1sxs_uw_b65535 0.00 65535.00 FORMAT "%8.2" /end CHARACTERISTIC
/begin CHARACTERISTIC TPNSMD "Pr¸fzeit nach Startende f¸r Diagnose Momentenbegrenzung" VALUE 0x4EDE50 KwUw 65535.00 t1sxs_uw_b65535 0.00 65535.00 FORMAT "%8.2" /end CHARACTERISTIC
/begin CHARACTERISTIC TRAB "" VALUE 0x4E873A KwUb 25.50 t100msxs_ub_b25p5 0.00 25.50 FORMAT "%5.2" /end CHARACTERISTIC
/begin CHARACTERISTIC TRAU "‹berwachungszeit f¸r untere Lastschwelle der Lambdaregelung" VALUE 0x4EE174 KwUb 25.50 t100msxs_ub_b25p5 0.00 25.50 FORMAT "%5.2" /end CHARACTERISTIC
/begin CHARACTERISTIC TSAKAMN "Mindestdauer SA f¸r Funktion Katalysator-Ausr‰umen" VALUE 0x4E8811 KwUb 5.100 t20msxs_ub_b5p1 0.00 5.100 FORMAT "%5.3" /end CHARACTERISTIC
/begin CHARACTERISTIC TSAKAMN2 "" VALUE 0x4E8812 KwUb 5.100 t20msxs_ub_b5p1 0.00 5.100 FORMAT "%5.3" /end CHARACTERISTIC
/begin CHARACTERISTIC TSBBVTMS "" CURVE 0x4E8766 KlAUbSstUwWUw 6553.500 t100msxs_uw_b6553p5 0.00 6553.500 FORMAT "%8.3"
 /begin AXIS_DESCR STD_AXIS tmstzyl_w temp_ub_q0p75_o48 4 -48.00000 49103.25 FORMAT "%8.2" DEPOSIT ABSOLUTE /end AXIS_DESCR
/end CHARACTERISTIC
/begin CHARACTERISTIC TSPERN "" CURVE 0x4E86E8 KlAUbSstUbWUb 2.550 t10msxs_ub_b2p55 0.00 2.550 FORMAT "%5.3"
 /begin AXIS_DESCR STD_AXIS nmot nmot_ub_q40 7 0.00 10200. FORMAT "%5.0" DEPOSIT ABSOLUTE /end AXIS_DESCR
/end CHARACTERISTIC
/begin CHARACTERISTIC TSPERN2 "" CURVE 0x4E86F8 KlAUbSstUbWUb 2.550 t10msxs_ub_b2p55 0.00 2.550 FORMAT "%5.3"
 /begin AXIS_DESCR STD_AXIS nmot nmot_ub_q40 7 0.00 10200. FORMAT "%5.0" DEPOSIT ABSOLUTE /end AXIS_DESCR
/end CHARACTERISTIC
/begin CHARACTERISTIC TVDPSTEND "" VALUE 0x4E70B0 KwUw 655.3500 t10msxs_uw_b655p35 0.00 655.3500 FORMAT "%8.4" /end CHARACTERISTIC
/begin CHARACTERISTIC TVFSAWE "Verzˆgerungszeit f¸r R¸cksetzen von B_fil" VALUE 0x4E6B90 KwUb 2.540 t10msxs_ub_b2p55 0.01000 2.550 FORMAT "%5.3" /end CHARACTERISTIC
/begin CHARACTERISTIC TVLISTUM "Verbotszeit f¸r negativen Integratoranteil nach Start" CURVE 0x4E5B24 KlAUbSstUbWUb 5.100 t20msxs_ub_b5p1 0.00 5.100 FORMAT "%5.3"
 /begin AXIS_DESCR STD_AXIS tmot temp_ub_q0p75_o48 3 -48.00 143.3 FORMAT "%5.1" DEPOSIT ABSOLUTE /end AXIS_DESCR
/end CHARACTERISTIC
/begin CHARACTERISTIC TVLISTUMT "" CURVE 0x4E5B2C KlAUbSstUbWUb 5.100 t20msxs_ub_b5p1 0.00 5.100 FORMAT "%5.3"
 /begin AXIS_DESCR STD_AXIS tmot temp_ub_q0p75_o48 3 -48.00 143.3 FORMAT "%5.1" DEPOSIT ABSOLUTE /end AXIS_DESCR
/end CHARACTERISTIC
/begin CHARACTERISTIC TVLRA "Verzˆgerungszeit f¸r Aktivierung Gemischadaption nach Lambdaregelung aktiv" VALUE 0x4E4DAC KwUb 25.40 t100msxs_ub_b25p5 0.1000 25.50 FORMAT "%5.2" /end CHARACTERISTIC
/begin CHARACTERISTIC TWDMAD "Wartezeit bis Freigabe der Adaption des Verlustmoments" VALUE 0x4ED7B8 KwUb 51.00 t200msxs_ub_b51 0.00 51.00 FORMAT "%5.2" /end CHARACTERISTIC
/begin CHARACTERISTIC TWPFGR "" VALUE 0x4E70B2 KwUw 3276.7499992 zk50msxs_uw_b3276p8 0.050000762951 3276.8000000 FORMAT "%12.7" /end CHARACTERISTIC
/begin CHARACTERISTIC TZYLDMAD "" VALUE 0x4ED7B9 KwUb 191.3 temp_ub_q0p75_o48 -48.00 143.3 FORMAT "%5.1" /end CHARACTERISTIC
/begin CHARACTERISTIC TZYLDMADMX "" VALUE 0x4ED7BA KwUb 191.3 temp_ub_q0p75_o48 -48.00 143.3 FORMAT "%5.1" /end CHARACTERISTIC
/begin CHARACTERISTIC T_keinlu "Sperre nach Start" VALUE 0x4E980E KwWU16 655.3500 t10msxs_uw_b655p35 0.00 655.3500 FORMAT "%8.4" /end CHARACTERISTIC
/begin CHARACTERISTIC USR "" VALUE 0x4E8707 KwUb 1.330 spg_ub_q0p0052_o0p2 -0.2000 1.130 FORMAT "%5.3" /end CHARACTERISTIC
/begin CHARACTERISTIC USVKAMX "" VALUE 0x4E8813 KwUb 1.330 spg_ub_q0p0052_o0p2 -0.2000 1.130 FORMAT "%5.3" /end CHARACTERISTIC
/begin CHARACTERISTIC USVKAMX2 "" VALUE 0x4E8814 KwUb 1.330 spg_ub_q0p0052_o0p2 -0.2000 1.130 FORMAT "%5.3" /end CHARACTERISTIC
/begin CHARACTERISTIC VKUPZWEO "Obere vfzg-Hytereseschwelle f¸r KUP-ZW-Eingriffe" VALUE 0x4E70DF KwUb 318.8 vfzg_ub_q1p25 0.00 318.8 FORMAT "%5.1" /end CHARACTERISTIC
/begin CHARACTERISTIC VKUPZWEU "Untere vfzg-Hytereseschwelle f¸r KUP-ZW-Eingriffe" VALUE 0x4E70E0 KwUb 318.8 vfzg_ub_q1p25 0.00 318.8 FORMAT "%5.1" /end CHARACTERISTIC
/begin CHARACTERISTIC VLLZWEO "Obere vfzg-Hytereseschwelle f¸r LL-ZW-Eingriffe" VALUE 0x4E70E1 KwUb 318.8 vfzg_ub_q1p25 0.00 318.8 FORMAT "%5.1" /end CHARACTERISTIC
/begin CHARACTERISTIC VLLZWEU "Untere vfzg-Hytereseschwelle f¸r LL-ZW-Eingriffe" VALUE 0x4E70E2 KwUb 318.8 vfzg_ub_q1p25 0.00 318.8 FORMAT "%5.1" /end CHARACTERISTIC
/begin CHARACTERISTIC VLSDZWEO "Obere vfzg-Hytereseschwelle f¸r LSD-ZW-Eingriffe" VALUE 0x4E70E3 KwUb 318.8 vfzg_ub_q1p25 0.00 318.8 FORMAT "%5.1" /end CHARACTERISTIC
/begin CHARACTERISTIC VLSDZWEU "Untere vfzg-Hytereseschwelle f¸r LSD-ZW-Eingriffe" VALUE 0x4E70E4 KwUb 318.8 vfzg_ub_q1p25 0.00 318.8 FORMAT "%5.1" /end CHARACTERISTIC
/begin CHARACTERISTIC WDKARN "DK-Winkel-Schwelle f¸r Gemischadaption aktiv" CURVE 0x4EC570 KlAUbSstUbWUb 99.61 rel_ub_b99p6 0.00 99.61 FORMAT "%5.2"
 /begin AXIS_DESCR STD_AXIS nmot nmot_ub_q40 10 0.00 10200. FORMAT "%5.0" DEPOSIT ABSOLUTE /end AXIS_DESCR
/end CHARACTERISTIC
/begin CHARACTERISTIC Wllumn "Minimale Last(RL)" VALUE 0x4E9823 KwWU8 191.3 rel_ub_q0p75 0.00 191.3 FORMAT "%5.1" /end CHARACTERISTIC
/begin CHARACTERISTIC WLLURN "Lur-Ausblendung Minimal-Last" CURVE 0x4E97F4 KlAxU8SstxU8WU8 191.3 rel_ub_q0p75 0.00 191.3 FORMAT "%5.1"
 /begin AXIS_DESCR STD_AXIS nmot nmot_ub_q40 4 0.00 10200. FORMAT "%5.0" DEPOSIT ABSOLUTE /end AXIS_DESCR
/end CHARACTERISTIC
/begin CHARACTERISTIC WPEDRL "Parameter for switching between methods of driver torque demand calculation" VALUE 0x4E6B91 KwUb 255.0 DEZ 0.00 255.0 FORMAT "%5.1" /end CHARACTERISTIC
/begin CHARACTERISTIC ZDFR "" VALUE 0x4E8736 KwUw 0.9999847 fak_uw_b1 0.00 0.9999847 FORMAT "%9.7" /end CHARACTERISTIC
/begin CHARACTERISTIC ZFMDVERL "Zeitkonstante f¸r Filterung Verlustmoment" VALUE 0x4E5C2F KwUb 2.53000 zk20msxs_ub_b5p1 0.0200000 2.55000 FORMAT "%7.5" /end CHARACTERISTIC
/begin CHARACTERISTIC ZKDMADFK "Zeitkonstante f¸r Adaption des Verlustmoments Fahrstufe und Kompressor ein" VALUE 0x4ED7C4 KwUw 815.98754883 zk200msxs_uw_b13107 3.1999511719 819.18750000 FORMAT "%12.8" /end CHARACTERISTIC
/begin CHARACTERISTIC ZKDMADFS "Zeitkonstante f¸r Adaption des Verlustmoments Fahrstufe ein" VALUE 0x4ED7C6 KwUw 815.98754883 zk200msxs_uw_b13107 3.1999511719 819.18750000 FORMAT "%12.8" /end CHARACTERISTIC
/begin CHARACTERISTIC ZKDMADKO "Zeitkonstante f¸r Adaption des Verlustmoments Klimakompressor ein" VALUE 0x4ED7C8 KwUw 815.98754883 zk200msxs_uw_b13107 3.1999511719 819.18750000 FORMAT "%12.8" /end CHARACTERISTIC
/begin CHARACTERISTIC ZKDMADLL "Zeitkonstante f¸r Adaption des Verlustmoments ohne Last" VALUE 0x4ED7CA KwUw 815.98754883 zk200msxs_uw_b13107 3.1999511719 819.18750000 FORMAT "%12.8" /end CHARACTERISTIC
/begin CHARACTERISTIC ZKDRLSOL "" VALUE 0x4E3F80 KwUw 655.350000 zk10msxs_uw_b655 0.0100001526 655.360000 FORMAT "%10.6" /end CHARACTERISTIC
/begin CHARACTERISTIC ZKFRAOA "Zeitkonstante f¸r frao-Integrator, f(Anzahl Starts mit ÷lverd¸nnung)" CURVE 0x4E4D7E KlAUwSstUwWUw 4.999924 zk200msxs_uw_b5 0.00 4.999924 FORMAT "%8.6"
 /begin AXIS_DESCR STD_AXIS abo dez 3 0.00 65535.00 FORMAT "%8.2" DEPOSIT ABSOLUTE /end AXIS_DESCR
/end CHARACTERISTIC
/begin CHARACTERISTIC ZKFRAUA "Zeitkonstante f¸r frau-Integrator, f(Anzahl Stats mit ÷lverd¸nnung)" CURVE 0x4E4D8C KlAUwSstUwWUw 4.999924 zk200msxs_uw_b5 0.00 4.999924 FORMAT "%8.6"
 /begin AXIS_DESCR STD_AXIS abo dez 3 0.00 65535.00 FORMAT "%8.2" DEPOSIT ABSOLUTE /end AXIS_DESCR
/end CHARACTERISTIC
/begin CHARACTERISTIC ZKFZNWLL "Zeitkonstante Ausblendung der zwopt LL-Umschaltung" VALUE 0x4E6479 KwUb 7.969 zk10msxs_ub_b8 0.00 7.969 FORMAT "%5.3" /end CHARACTERISTIC
/begin CHARACTERISTIC ZKLLRD "Zeitkonstante f¸r die Abregelung des D-Anteils" VALUE 0x4E5B5E KwUw 1309.9800107 zk20msxs_uw_b1310 0.019989318685 1310.0000000 FORMAT "%12.7" /end CHARACTERISTIC
/begin CHARACTERISTIC ZKLLRDZ "Zeitkonstante zum Abregeln des D-Z¸ndungsanteils" VALUE 0x4E5B60 KwUw 1309.9800107 zk20msxs_uw_b1310 0.019989318685 1310.0000000 FORMAT "%12.7" /end CHARACTERISTIC
/begin CHARACTERISTIC ZKRKATA "Integrationsgeschwindigkeit Integrator rkat, f(abo)" CURVE 0x4E4D9A KlAUwSstUwWUw 959.9854 zk200msxs_uw_b960 0.00 959.9854 FORMAT "%8.4"
 /begin AXIS_DESCR STD_AXIS abo dez 3 0.00 65535.00 FORMAT "%8.2" DEPOSIT ABSOLUTE /end AXIS_DESCR
/end CHARACTERISTIC
/begin CHARACTERISTIC ZKRKAZ "" VALUE 0x4EC56E KwUw 959.9854 zk200msxs_uw_b960 0.00 959.9854 FORMAT "%8.4" /end CHARACTERISTIC
/begin CHARACTERISTIC ZLASHKAB "Zeitkonstante f¸r Abregelung der dyn. Sollwertanhebung (dlasohkab) rin der LRHK" VALUE 0x4E87E4 KwUw 655.350000 zk10msxs_uw_b655 0.0100001526 655.360000 FORMAT "%10.6" /end CHARACTERISTIC
/begin CHARACTERISTIC ZLASOHML "Zeitkonstante f¸r PT1-Filter des Pseudo-Lambda hinter Kat" CURVE 0x4E87E6 KlAUwSstUwWUw 655.350000 zk10msxs_uw_b655 0.0100001526 655.360000 FORMAT "%10.6"
 /begin AXIS_DESCR STD_AXIS ml_w m_uw_b6553p5 8 0.00 6553.500 FORMAT "%8.3" DEPOSIT ABSOLUTE /end AXIS_DESCR
/end CHARACTERISTIC
/begin CHARACTERISTIC ZLIBG "Filterzeitkonstante f¸r die Nachf¸hrung der Integratorgrenzen" VALUE 0x4E5B33 KwUb 5.08000 zk20msxs_ub_b5p1 0.0200000 5.10000 FORMAT "%7.5" /end CHARACTERISTIC
/begin CHARACTERISTIC ZLRFRI "" VALUE 0x4EE132 KwUw 6553.4999985 zk100msxs_uw_b655 0.10000152590 6553.6000000 FORMAT "%12.7" /end CHARACTERISTIC
/begin CHARACTERISTIC ZLRHML "" CURVE 0x4EE1E0 GklWUb 9.961 tgrad_ub_q0p039 0.00 9.961 FORMAT "%5.3" /begin AXIS_DESCR COM_AXIS ml m_ub_b1020 8 0.00 1020. AXIS_PTS_REF SML08LHUB /end AXIS_DESCR /end CHARACTERISTIC
/begin CHARACTERISTIC ZLSDHK "Zeitkonstante PT2-Filter Lastschlagd‰mpfung bei hohem Kupplungsmoment" VALUE 0x4E70B4 KwUw 655.350000 zk10msxs_uw_b655 0.0100001526 655.360000 FORMAT "%10.6" /end CHARACTERISTIC
/begin CHARACTERISTIC ZLSDWE "" VALUE 0x4E70B6 KwUw 655.350000 zk10msxs_uw_b655 0.0100001526 655.360000 FORMAT "%10.6" /end CHARACTERISTIC
/begin CHARACTERISTIC ZMDNSM "Zeitkonstante zur Abrgelung des Nachstart-Momentenoffset" CURVE 0x4ED778 KlAUbSstUbWUb 50.9992 zk200msxs_ub_b51p2 0.200784 51.2000 FORMAT "%7.4"
 /begin AXIS_DESCR STD_AXIS tmot temp_ub_q0p75_o48 8 -48.00 143.3 FORMAT "%5.1" DEPOSIT ABSOLUTE /end AXIS_DESCR
/end CHARACTERISTIC
/begin CHARACTERISTIC ZMDNSMVT "Zeitkonstante zur Abrgelung des Nachstart-Momentenoffset (VVT)" CURVE 0x4ED78C KlAUbSstUbWUb 50.9992 zk200msxs_ub_b51p2 0.200784 51.2000 FORMAT "%7.4"
 /begin AXIS_DESCR STD_AXIS tmot temp_ub_q0p75_o48 8 -48.00 143.3 FORMAT "%5.1" DEPOSIT ABSOLUTE /end AXIS_DESCR
/end CHARACTERISTIC
/begin CHARACTERISTIC ZMIBGR "Zeitkonstante f¸r Faktor gangabh. Momentenbegrenzung" VALUE 0x4E70CE KwUw 3276.7499992 zk50msxs_uw_b3276p8 0.050000762951 3276.8000000 FORMAT "%12.7" /end CHARACTERISTIC
/begin CHARACTERISTIC ZNGHGS "Zeitkonstante Tiefpaﬂ f¸r Drehzahlgradient" VALUE 0x4E70D0 KwUw 3276.7499992 zk50msxs_uw_b3276p8 0.050000762951 3276.8000000 FORMAT "%12.7" /end CHARACTERISTIC
/begin CHARACTERISTIC ZRL_W_KGE "" MAP 0x4E68C8 KfAxUwAyUwSstxUwSstyUwWUw 655.350000 zk10msxs_uw_b655 0.0100001526 655.360000 FORMAT "%10.6"
 /begin AXIS_DESCR STD_AXIS wped_w relPED_uw_b100 16 0.00 100.0000 FORMAT "%8.4" DEPOSIT ABSOLUTE /end AXIS_DESCR
 /begin AXIS_DESCR STD_AXIS nmot_w nmot_uw_q0p25 16 0.00 16383.75 FORMAT "%8.2" DEPOSIT ABSOLUTE /end AXIS_DESCR
/end CHARACTERISTIC
/begin MEASUREMENT Ad_stop_cnt "" SBYTE dez 1 100 -128 127 FORMAT "%5.1" ECU_ADDRESS 0x7FD868 /end MEASUREMENT
/begin MEASUREMENT Asa_word "Adaptionswert 16 Bit Aufloesung" SWORD dez 1 100 -32768 32767 FORMAT "%8.2" ECU_ADDRESS 0x7F9CC0 /end MEASUREMENT
/begin MEASUREMENT Asprll "Soll-Auslassspreizung im Leerlauf" UBYTE sprzi_q0p8 1 100 0 204 FORMAT "%5.1" ECU_ADDRESS 0x7FD848 /end MEASUREMENT
/begin MEASUREMENT atv "" SBYTE t100msxs_sb_q0p01 1 100 -1.28 1.27 FORMAT "%5.3" ECU_ADDRESS 0x7F9C64 /end MEASUREMENT
/begin MEASUREMENT atv2 "" SBYTE t100msxs_sb_q0p01 1 100 -1.28 1.27 FORMAT "%5.3" ECU_ADDRESS 0x7F9C65 /end MEASUREMENT
/begin MEASUREMENT atvinii "" SBYTE t100msxs_sb_q0p01 1 100 -1.28 1.27 FORMAT "%5.3" ECU_ADDRESS 0x7FDA93 /end MEASUREMENT
/begin MEASUREMENT Ausble_cnt "Segmentzaehler" UWORD dez 1 100 0 65535 FORMAT "%8.2" ECU_ADDRESS 0x7FE1F2 /end MEASUREMENT
/begin MEASUREMENT B_adwfk "Bedingung Adaptionswert Fahrstufe und Kompressor ein verwenden" UBYTE B_TRUE 1 100 0 1 BIT_MASK 0x1 FORMAT "%13.11" ECU_ADDRESS 0x7FBB33 /end MEASUREMENT
/begin MEASUREMENT B_adwfs "Bedingung Adaptionswert Fahrstufe ein verwenden" UBYTE B_TRUE 1 100 0 1 BIT_MASK 0x1 FORMAT "%13.11" ECU_ADDRESS 0x7FBB34 /end MEASUREMENT
/begin MEASUREMENT B_adwko "Bedingung Adaptionswert Klimakompressor ein verwenden" UBYTE B_TRUE 1 100 0 1 BIT_MASK 0x1 FORMAT "%13.11" ECU_ADDRESS 0x7FBB35 /end MEASUREMENT
/begin MEASUREMENT B_ad_gut "Adaption gut" UBYTE B_TRUE 1 100 0 1 BIT_MASK 0x8 FORMAT "%13.11" ECU_ADDRESS 0x7FD875 /end MEASUREMENT
/begin MEASUREMENT B_allzw "" UBYTE B_TRUE 1 100 0 1 BIT_MASK 0x1 FORMAT "%13.11" ECU_ADDRESS 0x7FBB52 /end MEASUREMENT
/begin MEASUREMENT B_allzwe "Bedingung zw-Verstellung durch MD-Struktur aktiv (LL,DASH,LSD,KUP)" UBYTE B_TRUE 1 100 0 1 BIT_MASK 0x1 FORMAT "%13.11" ECU_ADDRESS 0x7FBB53 /end MEASUREMENT
/begin MEASUREMENT B_asr "Bedingung f¸r ASR aktiv" UBYTE B_TRUE 1 100 0 1 BIT_MASK 0x1 FORMAT "%13.11" ECU_ADDRESS 0x7FBB54 /end MEASUREMENT
/begin MEASUREMENT B_atvini "" UBYTE B_TRUE 1 100 0 1 BIT_MASK 0x1 FORMAT "%13.11" ECU_ADDRESS 0x7FDA97 /end MEASUREMENT
/begin MEASUREMENT B_blrka "Bedingung gesteuertes Katalysator-Ausr‰umen angefordert" UBYTE B_TRUE 1 100 0 1 BIT_MASK 0x1 FORMAT "%13.11" ECU_ADDRESS 0x7FBBD0 /end MEASUREMENT
/begin MEASUREMENT B_blrka2 "" UBYTE B_TRUE 1 100 0 1 BIT_MASK 0x1 FORMAT "%13.11" ECU_ADDRESS 0x7FBBD1 /end MEASUREMENT
/begin MEASUREMENT B_bvdel "ODER-Verkn¸pfung der verzˆgerten Sperrbedingungen B_bag / B_vag" UBYTE B_TRUE 1 100 0 1 BIT_MASK 0x1 FORMAT "%13.11" ECU_ADDRESS 0x7FBBAE /end MEASUREMENT
/begin MEASUREMENT B_clradllr "Bedingung:  Adaptionswerte LL-Regelung selektiv loeschen" UBYTE B_TRUE 1 100 0 1 BIT_MASK 0x1 FORMAT "%13.11" ECU_ADDRESS 0x7FBB36 /end MEASUREMENT
/begin MEASUREMENT B_dash "Bedingung: Dashpot-ƒnderungsbegrenzung aktiv" UBYTE B_TRUE 1 100 0 1 BIT_MASK 0x1 FORMAT "%13.11" ECU_ADDRESS 0x7FBB43 /end MEASUREMENT
/begin MEASUREMENT B_dfrf "" UBYTE B_TRUE 1 100 0 1 BIT_MASK 0x1 FORMAT "%13.11" ECU_ADDRESS 0x7FBB8A /end MEASUREMENT
/begin MEASUREMENT B_dfrf2 "" UBYTE B_TRUE 1 100 0 1 BIT_MASK 0x1 FORMAT "%13.11" ECU_ADDRESS 0x7FBB8B /end MEASUREMENT
/begin MEASUREMENT B_dfrm "" UBYTE B_TRUE 1 100 0 1 BIT_MASK 0x1 FORMAT "%13.11" ECU_ADDRESS 0x7FBB8C /end MEASUREMENT
/begin MEASUREMENT B_dfrm2 "" UBYTE B_TRUE 1 100 0 1 BIT_MASK 0x1 FORMAT "%13.11" ECU_ADDRESS 0x7FBB8D /end MEASUREMENT
/begin MEASUREMENT B_dp "Bedingung: Dashpotwert grˆﬂer Fahrerwunsch (=1)" UBYTE B_TRUE 1 100 0 1 BIT_MASK 0x1 FORMAT "%13.11" ECU_ADDRESS 0x7FBB44 /end MEASUREMENT
/begin MEASUREMENT B_edp "Bedingung Erlaubnis Dashpot" UBYTE B_TRUE 1 100 0 1 BIT_MASK 0x1 FORMAT "%13.11" ECU_ADDRESS 0x7FBB45 /end MEASUREMENT
/begin MEASUREMENT B_elsd "Bedingung Erlaubnis Lastschlagd‰mpfung" UBYTE B_TRUE 1 100 0 1 BIT_MASK 0x1 FORMAT "%13.11" ECU_ADDRESS 0x7FBB46 /end MEASUREMENT
/begin MEASUREMENT B_eobdlr "OBDII-Summenfehler. sperrt die LR" UBYTE B_TRUE 1 100 0 1 BIT_MASK 0x1 FORMAT "%13.11" ECU_ADDRESS 0x7FBBAF /end MEASUREMENT
/begin MEASUREMENT B_eobdlr2 "OBDII-Summenfehler. sperrt die LR, Bank 2" UBYTE B_TRUE 1 100 0 1 BIT_MASK 0x1 FORMAT "%13.11" ECU_ADDRESS 0x7FBBB0 /end MEASUREMENT
/begin MEASUREMENT B_ffuerf "" UBYTE B_TRUE 1 100 0 1 BIT_MASK 0x2 FORMAT "%13.11" ECU_ADDRESS 0x7FD7ED /end MEASUREMENT
/begin MEASUREMENT B_ffuerfse "" UBYTE B_TRUE 1 100 0 1 BIT_MASK 0x4 FORMAT "%13.11" ECU_ADDRESS 0x7FD7ED /end MEASUREMENT
/begin MEASUREMENT B_ffuest "" UBYTE B_TRUE 1 100 0 1 BIT_MASK 0x20 FORMAT "%13.11" ECU_ADDRESS 0x7FD7ED /end MEASUREMENT
/begin MEASUREMENT B_fgr "Bedingung FGR (Tempomat) aktiv" UBYTE B_TRUE 1 100 0 1 BIT_MASK 0x1 FORMAT "%13.11" ECU_ADDRESS 0x7FBB47 /end MEASUREMENT
/begin MEASUREMENT B_fil "Bedingung PT1-Filter f¸r SAWE aktiv" UBYTE B_TRUE 1 100 0 1 BIT_MASK 0x1 FORMAT "%13.11" ECU_ADDRESS 0x7FBB48 /end MEASUREMENT
/begin MEASUREMENT B_fkvs "" UBYTE B_TRUE 1 100 0 1 BIT_MASK 0x8 FORMAT "%13.11" ECU_ADDRESS 0x7FD7ED /end MEASUREMENT
/begin MEASUREMENT B_flam "" UBYTE B_TRUE 1 100 0 1 BIT_MASK 0x40 FORMAT "%13.11" ECU_ADDRESS 0x7FD7ED /end MEASUREMENT
/begin MEASUREMENT B_flamad "" UBYTE B_TRUE 1 100 0 1 BIT_MASK 0x80 FORMAT "%13.11" ECU_ADDRESS 0x7FD7ED /end MEASUREMENT
/begin MEASUREMENT B_fnstab "" UBYTE B_TRUE 1 100 0 1 BIT_MASK 0x1 FORMAT "%13.11" ECU_ADDRESS 0x7FBB32 /end MEASUREMENT
/begin MEASUREMENT B_fosb "" UBYTE B_TRUE 1 100 0 1 BIT_MASK 0x1 FORMAT "%13.11" ECU_ADDRESS 0x7FD7ED /end MEASUREMENT
/begin MEASUREMENT B_frab "" UBYTE B_TRUE 1 100 0 1 BIT_MASK 0x1 FORMAT "%13.11" ECU_ADDRESS 0x7FBB8E /end MEASUREMENT
/begin MEASUREMENT B_frab2 "" UBYTE B_TRUE 1 100 0 1 BIT_MASK 0x1 FORMAT "%13.11" ECU_ADDRESS 0x7FBB8F /end MEASUREMENT
/begin MEASUREMENT B_frao "Einschaltbedingung f¸r Adaption von frao" UBYTE B_TRUE 1 100 0 1 BIT_MASK 0x1 FORMAT "%13.11" ECU_ADDRESS 0x7FBA53 /end MEASUREMENT
/begin MEASUREMENT B_fraor "Bedingung frao-Integrator auﬂerhalb reduzierter Bereich" UBYTE B_TRUE 1 100 0 1 BIT_MASK 0x1 FORMAT "%13.11" ECU_ADDRESS 0x7FBA54 /end MEASUREMENT
/begin MEASUREMENT B_fraor2 "Bedingung frao2-Integrator auﬂerhalb reduzierter Bereich" UBYTE B_TRUE 1 100 0 1 BIT_MASK 0x1 FORMAT "%13.11" ECU_ADDRESS 0x7FBA55 /end MEASUREMENT
/begin MEASUREMENT B_frau "Einschaltbedingung f¸r Adaption von frau" UBYTE B_TRUE 1 100 0 1 BIT_MASK 0x1 FORMAT "%13.11" ECU_ADDRESS 0x7FBA56 /end MEASUREMENT
/begin MEASUREMENT B_fraur "Bedingung frau-Integrator auﬂerhalb reduzierter Bereich" UBYTE B_TRUE 1 100 0 1 BIT_MASK 0x1 FORMAT "%13.11" ECU_ADDRESS 0x7FBA57 /end MEASUREMENT
/begin MEASUREMENT B_fraur2 "Bedingung frau2-Integrator auﬂerhalb reduzierter Bereich" UBYTE B_TRUE 1 100 0 1 BIT_MASK 0x1 FORMAT "%13.11" ECU_ADDRESS 0x7FBA58 /end MEASUREMENT
/begin MEASUREMENT B_frini "Bedingung Regelfaktor fr initialisieren" UBYTE B_TRUE 1 100 0 1 BIT_MASK 0x1 FORMAT "%13.11" ECU_ADDRESS 0x7FBBCE /end MEASUREMENT
/begin MEASUREMENT B_frini2 "Bedingung Regelfaktor fr initialisieren, Bank 2" UBYTE B_TRUE 1 100 0 1 BIT_MASK 0x1 FORMAT "%13.11" ECU_ADDRESS 0x7FBBCF /end MEASUREMENT
/begin MEASUREMENT B_frmax "Lambda-Regelung setzt Bit sobald FR am Anschlag FRMAX" UBYTE B_TRUE 1 100 0 1 BIT_MASK 0x1 FORMAT "%13.11" ECU_ADDRESS 0x7FBB90 /end MEASUREMENT
/begin MEASUREMENT B_frmax2 "Lambda-Regelung setzt Bit sobald FR am Anschlag FRMAX, Bank 2" UBYTE B_TRUE 1 100 0 1 BIT_MASK 0x1 FORMAT "%13.11" ECU_ADDRESS 0x7FBB91 /end MEASUREMENT
/begin MEASUREMENT B_frmin "Lambda-Regelung setzt Bit sobald FR am Anschlag FRMIN" UBYTE B_TRUE 1 100 0 1 BIT_MASK 0x1 FORMAT "%13.11" ECU_ADDRESS 0x7FBB92 /end MEASUREMENT
/begin MEASUREMENT B_frmin2 "Lambda-Regelung setzt Bit sobald FR am Anschlag FRMIN, Bank 2" UBYTE B_TRUE 1 100 0 1 BIT_MASK 0x1 FORMAT "%13.11" ECU_ADDRESS 0x7FBB93 /end MEASUREMENT
/begin MEASUREMENT B_frmini "" UBYTE B_TRUE 1 100 0 1 BIT_MASK 0x1 FORMAT "%13.11" ECU_ADDRESS 0x7FBB94 /end MEASUREMENT
/begin MEASUREMENT B_frmini2 "" UBYTE B_TRUE 1 100 0 1 BIT_MASK 0x1 FORMAT "%13.11" ECU_ADDRESS 0x7FBB95 /end MEASUREMENT
/begin MEASUREMENT B_frsp "" UBYTE B_TRUE 1 100 0 1 BIT_MASK 0x1 FORMAT "%13.11" ECU_ADDRESS 0x7FBB96 /end MEASUREMENT
/begin MEASUREMENT B_frsp2 "" UBYTE B_TRUE 1 100 0 1 BIT_MASK 0x1 FORMAT "%13.11" ECU_ADDRESS 0x7FBB97 /end MEASUREMENT
/begin MEASUREMENT B_fslr "" UBYTE B_TRUE 1 100 0 1 BIT_MASK 0x1 FORMAT "%13.11" ECU_ADDRESS 0x7FBBB1 /end MEASUREMENT
/begin MEASUREMENT B_fslr2 "" UBYTE B_TRUE 1 100 0 1 BIT_MASK 0x1 FORMAT "%13.11" ECU_ADDRESS 0x7FBBB2 /end MEASUREMENT
/begin MEASUREMENT B_ftev "" UBYTE B_TRUE 1 100 0 1 BIT_MASK 0x10 FORMAT "%13.11" ECU_ADDRESS 0x7FD7ED /end MEASUREMENT
/begin MEASUREMENT B_gasp "Bedingung Grundadaption gesperrt" UBYTE B_TRUE 1 100 0 1 BIT_MASK 0x1 FORMAT "%13.11" ECU_ADDRESS 0x7FBA65 /end MEASUREMENT
/begin MEASUREMENT B_gerad "Lur Geberradadaption" UBYTE B_TRUE 1 100 0 1 BIT_MASK 0x4 FORMAT "%13.11" ECU_ADDRESS 0x7FD875 /end MEASUREMENT
/begin MEASUREMENT B_hgsndy "Bedingung Drehzahldynamik in gangabh‰ngiger Momentenbegrenzung" UBYTE B_TRUE 1 100 0 1 BIT_MASK 0x1 FORMAT "%13.11" ECU_ADDRESS 0x7FBB50 /end MEASUREMENT
/begin MEASUREMENT B_iflsd "Bedingung Initialisierung Filter Lastschlagd‰mpfung" UBYTE B_TRUE 1 100 0 1 BIT_MASK 0x1 FORMAT "%13.11" ECU_ADDRESS 0x7FBB49 /end MEASUREMENT
/begin MEASUREMENT B_ilmlkat "Bedingung g¸ltige Messung des Sauerstoffspeichers" UBYTE B_TRUE 1 100 0 1 BIT_MASK 0x1 FORMAT "%13.11" ECU_ADDRESS 0x7FBBD2 /end MEASUREMENT
/begin MEASUREMENT B_ilmlkat2 "Bedingung g¸ltige Messung des Sauerstoffspeichers, Bank 2" UBYTE B_TRUE 1 100 0 1 BIT_MASK 0x1 FORMAT "%13.11" ECU_ADDRESS 0x7FBBD3 /end MEASUREMENT
/begin MEASUREMENT B_inifrm "" UBYTE B_TRUE 1 100 0 1 BIT_MASK 0x1 FORMAT "%13.11" ECU_ADDRESS 0x7FBB98 /end MEASUREMENT
/begin MEASUREMENT B_inifrm2 "" UBYTE B_TRUE 1 100 0 1 BIT_MASK 0x1 FORMAT "%13.11" ECU_ADDRESS 0x7FBB99 /end MEASUREMENT
/begin MEASUREMENT B_inipmfs "" UBYTE B_TRUE 1 100 0 1 BIT_MASK 0x1 FORMAT "%13.11" ECU_ADDRESS 0x7FBB5B /end MEASUREMENT
/begin MEASUREMENT B_int "" UBYTE B_TRUE 1 100 0 1 BIT_MASK 0x1 FORMAT "%13.11" ECU_ADDRESS 0x7FBB9A /end MEASUREMENT
/begin MEASUREMENT B_int2 "" UBYTE B_TRUE 1 100 0 1 BIT_MASK 0x1 FORMAT "%13.11" ECU_ADDRESS 0x7FBB9B /end MEASUREMENT
/begin MEASUREMENT B_kawe "Faktor fwe aktiv w‰hrend Kat-Ausr‰umen, Bank 1" UBYTE B_TRUE 1 100 0 1 BIT_MASK 0x1 FORMAT "%13.11" ECU_ADDRESS 0x7FBBD4 /end MEASUREMENT
/begin MEASUREMENT B_kawe2 "Faktor fwe aktiv w‰hrend Kat-Ausr‰umen, Bank 2" UBYTE B_TRUE 1 100 0 1 BIT_MASK 0x1 FORMAT "%13.11" ECU_ADDRESS 0x7FBBD5 /end MEASUREMENT
/begin MEASUREMENT B_ll "Bedingung Leerlauf" UBYTE B_TRUE 1 100 0 1 BIT_MASK 0x1 FORMAT "%13.11" ECU_ADDRESS 0x7FBB4A /end MEASUREMENT
/begin MEASUREMENT B_llrimx "Bedingung dmllri hat Sicherheitsgrenze erreicht" UBYTE B_TRUE 1 100 0 1 BIT_MASK 0x1 FORMAT "%13.11" ECU_ADDRESS 0x7FBB31 /end MEASUREMENT
/begin MEASUREMENT B_lr "LREB: Bedingung Lambdaregelung (vor Kat); (Bank 1)" UBYTE B_TRUE 1 100 0 1 BIT_MASK 0x1 FORMAT "%13.11" ECU_ADDRESS 0x7FBBB3 /end MEASUREMENT
/begin MEASUREMENT B_lr2 "Bedingung Lambdaregelung (vor Kat); Bank 2" UBYTE B_TRUE 1 100 0 1 BIT_MASK 0x1 FORMAT "%13.11" ECU_ADDRESS 0x7FBBB4 /end MEASUREMENT
/begin MEASUREMENT B_lr2s "CARB FREEZE FRAME, Bank1 bit 1, LR: Regelbetrieb mit zwei Sonden" UBYTE B_TRUE 1 100 0 1 BIT_MASK 0x2 FORMAT "%13.11" ECU_ADDRESS 0x7FDA91 /end MEASUREMENT
/begin MEASUREMENT B_lr2s2 "CARB FREEZE FRAME, Bank2 Bit 1, LR: Regelbetrieb mit zwei Sonden" UBYTE B_TRUE 1 100 0 1 BIT_MASK 0x2 FORMAT "%13.11" ECU_ADDRESS 0x7FDA92 /end MEASUREMENT
/begin MEASUREMENT B_lra "Bedingung Gemischadaption freigegeben" UBYTE B_TRUE 1 100 0 1 BIT_MASK 0x1 FORMAT "%13.11" ECU_ADDRESS 0x7FBA66 /end MEASUREMENT
/begin MEASUREMENT B_lra2 "Bedingung Gemischadaption 2 freigegeben" UBYTE B_TRUE 1 100 0 1 BIT_MASK 0x1 FORMAT "%13.11" ECU_ADDRESS 0x7FBA67 /end MEASUREMENT
/begin MEASUREMENT B_lrare "Bedingung Reset LRA" UBYTE B_TRUE 1 100 0 1 BIT_MASK 0x1 FORMAT "%13.11" ECU_ADDRESS 0x7FBA59 /end MEASUREMENT
/begin MEASUREMENT B_lrare2 "Bedingung Reset LRA Bank 2" UBYTE B_TRUE 1 100 0 1 BIT_MASK 0x1 FORMAT "%13.11" ECU_ADDRESS 0x7FBA5A /end MEASUREMENT
/begin MEASUREMENT B_lrareb "Bedingung Resetbereitschaft LRA" UBYTE B_TRUE 1 100 0 1 BIT_MASK 0x1 FORMAT "%13.11" ECU_ADDRESS 0x7FBA5B /end MEASUREMENT
/begin MEASUREMENT B_lreb100 "Sammelbit der im 100 ms-Raster gebildeten Sperrbedingungen" UBYTE B_TRUE 1 100 0 1 BIT_MASK 0x1 FORMAT "%13.11" ECU_ADDRESS 0x7FBBB5 /end MEASUREMENT
/begin MEASUREMENT B_lreble "fett" UBYTE B_TRUE 1 100 0 1 BIT_MASK 0x1 FORMAT "%13.11" ECU_ADDRESS 0x7FBBB6 /end MEASUREMENT
/begin MEASUREMENT B_lreble2 "fett" UBYTE B_TRUE 1 100 0 1 BIT_MASK 0x1 FORMAT "%13.11" ECU_ADDRESS 0x7FBBB7 /end MEASUREMENT
/begin MEASUREMENT B_lrebpr "mager" UBYTE B_TRUE 1 100 0 1 BIT_MASK 0x1 FORMAT "%13.11" ECU_ADDRESS 0x7FBBB8 /end MEASUREMENT
/begin MEASUREMENT B_lrebpr2 "mager" UBYTE B_TRUE 1 100 0 1 BIT_MASK 0x1 FORMAT "%13.11" ECU_ADDRESS 0x7FBBB9 /end MEASUREMENT
/begin MEASUREMENT B_lrebri "" UBYTE B_TRUE 1 100 0 1 BIT_MASK 0x1 FORMAT "%13.11" ECU_ADDRESS 0x7FBBBA /end MEASUREMENT
/begin MEASUREMENT B_lrebri2 "" UBYTE B_TRUE 1 100 0 1 BIT_MASK 0x1 FORMAT "%13.11" ECU_ADDRESS 0x7FBBBB /end MEASUREMENT
/begin MEASUREMENT B_lrhk "Bedingung Lambdaregelung hinter Kat" UBYTE B_TRUE 1 100 0 1 BIT_MASK 0x1 FORMAT "%13.11" ECU_ADDRESS 0x7FBBCC /end MEASUREMENT
/begin MEASUREMENT B_lrhk2 "Bedingung Lambdaregelung hinter Kat (Bank 2)" UBYTE B_TRUE 1 100 0 1 BIT_MASK 0x1 FORMAT "%13.11" ECU_ADDRESS 0x7FBBCD /end MEASUREMENT
/begin MEASUREMENT B_lrhkb "LRHK: Bedingung Lambdaregelung h. Kat, bankspez. Parameter Bank 1" UBYTE B_TRUE 1 100 0 1 BIT_MASK 0x4 FORMAT "%13.11" ECU_ADDRESS 0x7FDA97 /end MEASUREMENT
/begin MEASUREMENT B_lrhkg "LRHK: bankunabh‰ngige Bedingung Lambdaregelung hinter Kat" UBYTE B_TRUE 1 100 0 1 BIT_MASK 0x10 FORMAT "%13.11" ECU_ADDRESS 0x7FDA97 /end MEASUREMENT
/begin MEASUREMENT B_lrhkgi "bankunabh‰ngige Bedingung I-Anteil Lambdaregelung hinter Kat" UBYTE B_TRUE 1 100 0 1 BIT_MASK 0x20 FORMAT "%13.11" ECU_ADDRESS 0x7FDA97 /end MEASUREMENT
/begin MEASUREMENT B_lrhkp "LRHK: Freigabebedingung P-Anteil Lambdaregelung hinter Kat" UBYTE B_TRUE 1 100 0 1 BIT_MASK 0x40 FORMAT "%13.11" ECU_ADDRESS 0x7FDA97 /end MEASUREMENT
/begin MEASUREMENT B_lrka "Bedingung Katalysator-Ausr‰umen" UBYTE B_TRUE 1 100 0 1 BIT_MASK 0x1 FORMAT "%13.11" ECU_ADDRESS 0x7FBBD6 /end MEASUREMENT
/begin MEASUREMENT B_lrka2 "Bedingung Katalysator-Ausr‰umen f¸r Stereo-LR Bank 2" UBYTE B_TRUE 1 100 0 1 BIT_MASK 0x1 FORMAT "%13.11" ECU_ADDRESS 0x7FBBD7 /end MEASUREMENT
/begin MEASUREMENT B_lrkaa "Bedingung Katalysator-Ausr‰umen auf-/abregeln" UBYTE B_TRUE 1 100 0 1 BIT_MASK 0x1 FORMAT "%13.11" ECU_ADDRESS 0x7FBBD8 /end MEASUREMENT
/begin MEASUREMENT B_lrkaa2 "" UBYTE B_TRUE 1 100 0 1 BIT_MASK 0x1 FORMAT "%13.11" ECU_ADDRESS 0x7FBBD9 /end MEASUREMENT
/begin MEASUREMENT B_lrkae "Bedingung gesteuertes Katalysator-Ausr‰umen mˆglich" UBYTE B_TRUE 1 100 0 1 BIT_MASK 0x1 FORMAT "%13.11" ECU_ADDRESS 0x7FBBDA /end MEASUREMENT
/begin MEASUREMENT B_lrkae2 "" UBYTE B_TRUE 1 100 0 1 BIT_MASK 0x1 FORMAT "%13.11" ECU_ADDRESS 0x7FBBDB /end MEASUREMENT
/begin MEASUREMENT B_lrkaei "" UBYTE B_TRUE 1 100 0 1 BIT_MASK 0x1 FORMAT "%13.11" ECU_ADDRESS 0x7FBBDC /end MEASUREMENT
/begin MEASUREMENT B_lrkaei2 "" UBYTE B_TRUE 1 100 0 1 BIT_MASK 0x1 FORMAT "%13.11" ECU_ADDRESS 0x7FBBDD /end MEASUREMENT
/begin MEASUREMENT B_lrkaon "Status aktives Ausr‰umen wird durch erneute Ausr‰umbedingung unterbrochen" UBYTE B_TRUE 1 100 0 1 BIT_MASK 0x1 FORMAT "%13.11" ECU_ADDRESS 0x7FBBDE /end MEASUREMENT
/begin MEASUREMENT B_lrkaon2 "" UBYTE B_TRUE 1 100 0 1 BIT_MASK 0x1 FORMAT "%13.11" ECU_ADDRESS 0x7FBBDF /end MEASUREMENT
/begin MEASUREMENT B_lrkarg "" UBYTE B_TRUE 1 100 0 1 BIT_MASK 0x1 FORMAT "%13.11" ECU_ADDRESS 0x7FBBE0 /end MEASUREMENT
/begin MEASUREMENT B_lrkarg2 "" UBYTE B_TRUE 1 100 0 1 BIT_MASK 0x1 FORMAT "%13.11" ECU_ADDRESS 0x7FBBE1 /end MEASUREMENT
/begin MEASUREMENT B_lrkast "" UBYTE B_TRUE 1 100 0 1 BIT_MASK 0x1 FORMAT "%13.11" ECU_ADDRESS 0x7FBBE2 /end MEASUREMENT
/begin MEASUREMENT B_lrkast2 "" UBYTE B_TRUE 1 100 0 1 BIT_MASK 0x1 FORMAT "%13.11" ECU_ADDRESS 0x7FBBE3 /end MEASUREMENT
/begin MEASUREMENT B_lrnd "" UBYTE B_TRUE 1 100 0 1 BIT_MASK 0x1 FORMAT "%13.11" ECU_ADDRESS 0x7FBBBC /end MEASUREMENT
/begin MEASUREMENT B_lrnd2 "NORMAL" UBYTE B_TRUE 1 100 0 1 BIT_MASK 0x1 FORMAT "%13.11" ECU_ADDRESS 0x7FBBBD /end MEASUREMENT
/begin MEASUREMENT B_lrnda "LR Bank1 aktiv bei Bedingungen : B_lrpspa & B_lrkasn & !E_obdlr" UBYTE B_TRUE 1 100 0 1 BIT_MASK 0x1 FORMAT "%13.11" ECU_ADDRESS 0x7FBBBE /end MEASUREMENT
/begin MEASUREMENT B_lrnda2 "LR Bank2 aktiv bei Bedingungen : B_lrpspa & B_lrkasn & !E_obdlr" UBYTE B_TRUE 1 100 0 1 BIT_MASK 0x1 FORMAT "%13.11" ECU_ADDRESS 0x7FBBBF /end MEASUREMENT
/begin MEASUREMENT B_lrpspa "" UBYTE B_TRUE 1 100 0 1 BIT_MASK 0x1 FORMAT "%13.11" ECU_ADDRESS 0x7FBBC0 /end MEASUREMENT
/begin MEASUREMENT B_lrrl "LREB: Von Last abh‰ngige Bedingung Lambdaregelung (vor Kat)" UBYTE B_TRUE 1 100 0 1 BIT_MASK 0x1 FORMAT "%13.11" ECU_ADDRESS 0x7FBBC1 /end MEASUREMENT
/begin MEASUREMENT B_lrsp "" UBYTE B_TRUE 1 100 0 1 BIT_MASK 0x1 FORMAT "%13.11" ECU_ADDRESS 0x7FBB9C /end MEASUREMENT
/begin MEASUREMENT B_lrsp2 "" UBYTE B_TRUE 1 100 0 1 BIT_MASK 0x1 FORMAT "%13.11" ECU_ADDRESS 0x7FBB9D /end MEASUREMENT
/begin MEASUREMENT B_lrstat "" UBYTE B_TRUE 1 100 0 1 BIT_MASK 0x1 FORMAT "%13.11" ECU_ADDRESS 0x7FBB9E /end MEASUREMENT
/begin MEASUREMENT B_lrstat2 "" UBYTE B_TRUE 1 100 0 1 BIT_MASK 0x1 FORMAT "%13.11" ECU_ADDRESS 0x7FBB9F /end MEASUREMENT
/begin MEASUREMENT B_lrstta "" UBYTE B_TRUE 1 100 0 1 BIT_MASK 0x1 FORMAT "%13.11" ECU_ADDRESS 0x7FBBA0 /end MEASUREMENT
/begin MEASUREMENT B_lrstta2 "" UBYTE B_TRUE 1 100 0 1 BIT_MASK 0x1 FORMAT "%13.11" ECU_ADDRESS 0x7FBBA1 /end MEASUREMENT
/begin MEASUREMENT B_lrtpp "" UBYTE B_TRUE 1 100 0 1 BIT_MASK 0x1 FORMAT "%13.11" ECU_ADDRESS 0x7FBBA2 /end MEASUREMENT
/begin MEASUREMENT B_lrtpp2 "" UBYTE B_TRUE 1 100 0 1 BIT_MASK 0x1 FORMAT "%13.11" ECU_ADDRESS 0x7FBBA3 /end MEASUREMENT
/begin MEASUREMENT B_lrvk "CARB FREEZE FRAME, Bank1 Bit 4, LR: Regelung nur mit einer Sonde (vor KAT)" UBYTE B_TRUE 1 100 0 1 BIT_MASK 0x10 FORMAT "%13.11" ECU_ADDRESS 0x7FDA91 /end MEASUREMENT
/begin MEASUREMENT B_lrvk2 "CARB FREEZE FRAME, Bank2 Bit 4, LR: Regelung nur mit einer Sonde (vor KAT)" UBYTE B_TRUE 1 100 0 1 BIT_MASK 0x10 FORMAT "%13.11" ECU_ADDRESS 0x7FDA92 /end MEASUREMENT
/begin MEASUREMENT B_lrwla "" UBYTE B_TRUE 1 100 0 1 BIT_MASK 0x1 FORMAT "%13.11" ECU_ADDRESS 0x7FBBC2 /end MEASUREMENT
/begin MEASUREMENT B_ls "Bedingung: Lastschlagbegrenzung kleiner Fahrerwunsch (=1)" UBYTE B_TRUE 1 100 0 1 BIT_MASK 0x1 FORMAT "%13.11" ECU_ADDRESS 0x7FBB4B /end MEASUREMENT
/begin MEASUREMENT B_lsd "Bedingung: Pos. Lastschlagd‰mpfung aktiv" UBYTE B_TRUE 1 100 0 1 BIT_MASK 0x1 FORMAT "%13.11" ECU_ADDRESS 0x7FBB4C /end MEASUREMENT
/begin MEASUREMENT B_lurstp "" UBYTE B_TRUE 1 100 0 1 BIT_MASK 0x1 FORMAT "%13.11" ECU_ADDRESS 0x7FBCA6 /end MEASUREMENT
/begin MEASUREMENT B_lu_aktiv "Lur aktiv" UBYTE B_TRUE 1 100 0 1 BIT_MASK 0x1 FORMAT "%13.11" ECU_ADDRESS 0x7FD875 /end MEASUREMENT
/begin MEASUREMENT B_lu_erlaubt "" UBYTE B_TRUE 1 100 0 1 BIT_MASK 0x2 FORMAT "%13.11" ECU_ADDRESS 0x7FD875 /end MEASUREMENT
/begin MEASUREMENT B_lu_war_aktiv "" UBYTE B_TRUE 1 100 0 1 BIT_MASK 0x20 FORMAT "%13.11" ECU_ADDRESS 0x7FD874 /end MEASUREMENT
/begin MEASUREMENT B_madfk "Bedingung Momentenadaption Fahrstufe und Klimakompressor ein" UBYTE B_TRUE 1 100 0 1 BIT_MASK 0x1 FORMAT "%13.11" ECU_ADDRESS 0x7FBB37 /end MEASUREMENT
/begin MEASUREMENT B_madfs "Bedingung Momentenadaption Fahrstufe ein" UBYTE B_TRUE 1 100 0 1 BIT_MASK 0x1 FORMAT "%13.11" ECU_ADDRESS 0x7FBB38 /end MEASUREMENT
/begin MEASUREMENT B_madko "Bedingung Momentenadaption Klimakompressor ein" UBYTE B_TRUE 1 100 0 1 BIT_MASK 0x1 FORMAT "%13.11" ECU_ADDRESS 0x7FBB39 /end MEASUREMENT
/begin MEASUREMENT B_madll "Bedingung Momentenadaption ohne Last" UBYTE B_TRUE 1 100 0 1 BIT_MASK 0x1 FORMAT "%13.11" ECU_ADDRESS 0x7FBB3A /end MEASUREMENT
/begin MEASUREMENT B_madstp "Bedingung Momentenadaption durch Fehler im System gestoppt" UBYTE B_TRUE 1 100 0 1 BIT_MASK 0x1 FORMAT "%13.11" ECU_ADDRESS 0x7FBB3B /end MEASUREMENT
/begin MEASUREMENT B_mdee "Bedingung Momentenreduzierung ¸ber Einspritzausblendung erlaubt" UBYTE B_TRUE 1 100 0 1 BIT_MASK 0x1 FORMAT "%13.11" ECU_ADDRESS 0x7FBB5D /end MEASUREMENT
/begin MEASUREMENT B_mdein "Bedingung Momenteneingriff aktiv" UBYTE B_TRUE 1 100 0 1 BIT_MASK 0x1 FORMAT "%13.11" ECU_ADDRESS 0x7FBB55 /end MEASUREMENT
/begin MEASUREMENT B_mdmin "Bedingung minimal erreichbares indiziertes Moment erreicht" UBYTE B_TRUE 1 100 0 1 BIT_MASK 0x1 FORMAT "%13.11" ECU_ADDRESS 0x7FB9D1 /end MEASUREMENT
/begin MEASUREMENT B_mdredhyein "" UBYTE B_TRUE 1 100 0 1 BIT_MASK 0x1 FORMAT "%13.11" ECU_ADDRESS 0x7FBB5E /end MEASUREMENT
/begin MEASUREMENT B_mibeg "Bedingung Momentenbegrenzung ist aktiv" UBYTE B_TRUE 1 100 0 1 BIT_MASK 0x1 FORMAT "%13.11" ECU_ADDRESS 0x7FBB56 /end MEASUREMENT
/begin MEASUREMENT B_mibegdau "Bedingung: Momenten¸berwachung begrenzt dauerhaft" UBYTE B_TRUE 1 100 0 1 BIT_MASK 0x1 FORMAT "%13.11" ECU_ADDRESS 0x7FBB57 /end MEASUREMENT
/begin MEASUREMENT B_mibgr "Bedingung Regelung der gangabh. Momentenbegrenzung aktiv" UBYTE B_TRUE 1 100 0 1 BIT_MASK 0x1 FORMAT "%13.11" ECU_ADDRESS 0x7FBB51 /end MEASUREMENT
/begin MEASUREMENT B_mlrsa "LRSEB: Ausschaltbed. f¸r Lambdareg. auf bei und nach Schub ¸ber Luftmassenschw." UBYTE B_TRUE 1 100 0 1 BIT_MASK 0x1 FORMAT "%13.11" ECU_ADDRESS 0x7FBBC3 /end MEASUREMENT
/begin MEASUREMENT B_msfslr "" UBYTE B_TRUE 1 100 0 1 BIT_MASK 0x1 FORMAT "%13.11" ECU_ADDRESS 0x7FBBC4 /end MEASUREMENT
/begin MEASUREMENT B_msfslr2 "" UBYTE B_TRUE 1 100 0 1 BIT_MASK 0x1 FORMAT "%13.11" ECU_ADDRESS 0x7FBBC5 /end MEASUREMENT
/begin MEASUREMENT B_mslr "" UBYTE B_TRUE 1 100 0 1 BIT_MASK 0x1 FORMAT "%13.11" ECU_ADDRESS 0x7FBBC6 /end MEASUREMENT
/begin MEASUREMENT B_mslr2 "" UBYTE B_TRUE 1 100 0 1 BIT_MASK 0x1 FORMAT "%13.11" ECU_ADDRESS 0x7FBBC7 /end MEASUREMENT
/begin MEASUREMENT B_msr "Bedingung f¸r Momentenschlupfregelung" UBYTE B_TRUE 1 100 0 1 BIT_MASK 0x1 FORMAT "%13.11" ECU_ADDRESS 0x7FBB58 /end MEASUREMENT
/begin MEASUREMENT B_nofra "Bedingung Sperren der multiplikativen Gemischkorrektur" UBYTE B_TRUE 1 100 0 1 BIT_MASK 0x1 FORMAT "%13.11" ECU_ADDRESS 0x7FBA5C /end MEASUREMENT
/begin MEASUREMENT B_nolrb "CARB FREEZE FRAME, Bank1 Bit 2, LR: Steuerbetrieb durch Betriebsbedingungen" UBYTE B_TRUE 1 100 0 1 BIT_MASK 0x4 FORMAT "%13.11" ECU_ADDRESS 0x7FDA91 /end MEASUREMENT
/begin MEASUREMENT B_nolrb2 "CARB FREEZE FRAME, Bank2 Bit 2, LR: Steuerung durch Betriebsbedingung" UBYTE B_TRUE 1 100 0 1 BIT_MASK 0x4 FORMAT "%13.11" ECU_ADDRESS 0x7FDA92 /end MEASUREMENT
/begin MEASUREMENT B_nolre "CARB FREEZE FRAME, Bank1 Bit 3, LR: Steuerung nach Systemfehler" UBYTE B_TRUE 1 100 0 1 BIT_MASK 0x8 FORMAT "%13.11" ECU_ADDRESS 0x7FDA91 /end MEASUREMENT
/begin MEASUREMENT B_nolre2 "CARB FREEZE FRAME, Bank2 Bit 3, LR: Steuerung nach Systemfehler" UBYTE B_TRUE 1 100 0 1 BIT_MASK 0x8 FORMAT "%13.11" ECU_ADDRESS 0x7FDA92 /end MEASUREMENT
/begin MEASUREMENT B_nolrw "CARB FREEZE FRAME, Bank1 Bit 0, LR: Steuerbetrieb, Startbed. noch nicht erf¸llt" UBYTE B_TRUE 1 100 0 1 BIT_MASK 0x1 FORMAT "%13.11" ECU_ADDRESS 0x7FDA91 /end MEASUREMENT
/begin MEASUREMENT B_nolrw2 "CARB FREEZE FRAME, Bank2 Bit 0, LR: Steuerbetrieb, Startbed. noch nicht erf¸llt" UBYTE B_TRUE 1 100 0 1 BIT_MASK 0x1 FORMAT "%13.11" ECU_ADDRESS 0x7FDA92 /end MEASUREMENT
/begin MEASUREMENT B_norkat "Bedingung additive Korrektur der Gemischadaption pro Zeit abgeschaltet" UBYTE B_TRUE 1 100 0 1 BIT_MASK 0x1 FORMAT "%13.11" ECU_ADDRESS 0x7FBA5D /end MEASUREMENT
/begin MEASUREMENT B_norkaz "Bedingung additive Korrektur der Gemischadaption pro Z¸ndung abgeschaltet" UBYTE B_TRUE 1 100 0 1 BIT_MASK 0x1 FORMAT "%13.11" ECU_ADDRESS 0x7FBA5E /end MEASUREMENT
/begin MEASUREMENT B_pspaus "Bedingung LR inaktiv bei projektspez. AUS-Bedingungen" UBYTE B_TRUE 1 100 0 1 BIT_MASK 0x1 FORMAT "%13.11" ECU_ADDRESS 0x7FBBC8 /end MEASUREMENT
/begin MEASUREMENT B_pspwl "Bedingung LR inaktiv bei projektspez. Warmlauf-Bedingungen" UBYTE B_TRUE 1 100 0 1 BIT_MASK 0x1 FORMAT "%13.11" ECU_ADDRESS 0x7FBBC9 /end MEASUREMENT
/begin MEASUREMENT B_reset_lur "" UBYTE B_TRUE 1 100 0 1 BIT_MASK 0x80 FORMAT "%13.11" ECU_ADDRESS 0x7FD875 /end MEASUREMENT
/begin MEASUREMENT B_rkat "Bedingung Lernbereich additive Korrektur pro Zeit aktiv" UBYTE B_TRUE 1 100 0 1 BIT_MASK 0x1 FORMAT "%13.11" ECU_ADDRESS 0x7FBA5F /end MEASUREMENT
/begin MEASUREMENT B_rkatr "Bedingung rkat-Integrator auﬂerhalb reduzierten Bereich" UBYTE B_TRUE 1 100 0 1 BIT_MASK 0x1 FORMAT "%13.11" ECU_ADDRESS 0x7FBA60 /end MEASUREMENT
/begin MEASUREMENT B_rkatr2 "Bedingung rkat2-Integrator auﬂerhalb reduzierten Bereich" UBYTE B_TRUE 1 100 0 1 BIT_MASK 0x1 FORMAT "%13.11" ECU_ADDRESS 0x7FBA61 /end MEASUREMENT
/begin MEASUREMENT B_rkaz "Bedingung Lernbereich additive Korrektur pro Z¸ndung aktiv" UBYTE B_TRUE 1 100 0 1 BIT_MASK 0x1 FORMAT "%13.11" ECU_ADDRESS 0x7FBA62 /end MEASUREMENT
/begin MEASUREMENT B_rkazr "Bedingung rkaz-Integrator auﬂerhalb reduzierten Bereich" UBYTE B_TRUE 1 100 0 1 BIT_MASK 0x1 FORMAT "%13.11" ECU_ADDRESS 0x7FBA63 /end MEASUREMENT
/begin MEASUREMENT B_rkazr2 "Bedingung rkaz2-Integrator auﬂerhalb reduzierten Bereich" UBYTE B_TRUE 1 100 0 1 BIT_MASK 0x1 FORMAT "%13.11" ECU_ADDRESS 0x7FBA64 /end MEASUREMENT
/begin MEASUREMENT B_sa "Bedingung Schubabschalten" UBYTE B_TRUE 1 100 0 1 BIT_MASK 0x1 FORMAT "%13.11" ECU_ADDRESS 0x7FBB5F /end MEASUREMENT
/begin MEASUREMENT B_sgnalt "" UBYTE B_TRUE 1 100 0 1 BIT_MASK 0x1 FORMAT "%13.11" ECU_ADDRESS 0x7FBBA4 /end MEASUREMENT
/begin MEASUREMENT B_sgnalt2 "" UBYTE B_TRUE 1 100 0 1 BIT_MASK 0x1 FORMAT "%13.11" ECU_ADDRESS 0x7FBBA5 /end MEASUREMENT
/begin MEASUREMENT B_sgnlr "" UBYTE B_TRUE 1 100 0 1 BIT_MASK 0x1 FORMAT "%13.11" ECU_ADDRESS 0x7FBBA6 /end MEASUREMENT
/begin MEASUREMENT B_sgnlr2 "" UBYTE B_TRUE 1 100 0 1 BIT_MASK 0x1 FORMAT "%13.11" ECU_ADDRESS 0x7FBBA7 /end MEASUREMENT
/begin MEASUREMENT B_sgnra "" UBYTE B_TRUE 1 100 0 1 BIT_MASK 0x1 FORMAT "%13.11" ECU_ADDRESS 0x7FBBA8 /end MEASUREMENT
/begin MEASUREMENT B_sgnra2 "" UBYTE B_TRUE 1 100 0 1 BIT_MASK 0x1 FORMAT "%13.11" ECU_ADDRESS 0x7FBBA9 /end MEASUREMENT
/begin MEASUREMENT B_sync_lu "Synchronisation ueber Lur" UBYTE B_TRUE 1 100 0 1 BIT_MASK 0x10 FORMAT "%13.11" ECU_ADDRESS 0x7FD875 /end MEASUREMENT
/begin MEASUREMENT B_sync_zyl1 "" UBYTE B_TRUE 1 100 0 1 BIT_MASK 0x20 FORMAT "%13.11" ECU_ADDRESS 0x7FD875 /end MEASUREMENT
/begin MEASUREMENT B_sync_zyl4 "" UBYTE B_TRUE 1 100 0 1 BIT_MASK 0x40 FORMAT "%13.11" ECU_ADDRESS 0x7FD875 /end MEASUREMENT
/begin MEASUREMENT B_tarau "LREB: Bedingung Start bei niedrigen Ansauglufttemperaturen" UBYTE B_TRUE 1 100 0 1 BIT_MASK 0x1 FORMAT "%13.11" ECU_ADDRESS 0x7FBBCA /end MEASUREMENT
/begin MEASUREMENT B_tmlr "LREB: Von Motortemp. abh‰ngige Bedingungen Lambdaregelung (vor Kat)" UBYTE B_TRUE 1 100 0 1 BIT_MASK 0x1 FORMAT "%13.11" ECU_ADDRESS 0x7FBBCB /end MEASUREMENT
/begin MEASUREMENT B_tpimfs "" UBYTE B_TRUE 1 100 0 1 BIT_MASK 0x1 FORMAT "%13.11" ECU_ADDRESS 0x7FBB5C /end MEASUREMENT
/begin MEASUREMENT B_tsper "" UBYTE B_TRUE 1 100 0 1 BIT_MASK 0x1 FORMAT "%13.11" ECU_ADDRESS 0x7FBBAA /end MEASUREMENT
/begin MEASUREMENT B_tsper2 "" UBYTE B_TRUE 1 100 0 1 BIT_MASK 0x1 FORMAT "%13.11" ECU_ADDRESS 0x7FBBAB /end MEASUREMENT
/begin MEASUREMENT B_tspon "" UBYTE B_TRUE 1 100 0 1 BIT_MASK 0x1 FORMAT "%13.11" ECU_ADDRESS 0x7FBBAC /end MEASUREMENT
/begin MEASUREMENT B_tspon2 "" UBYTE B_TRUE 1 100 0 1 BIT_MASK 0x1 FORMAT "%13.11" ECU_ADDRESS 0x7FBBAD /end MEASUREMENT
/begin MEASUREMENT B_wememo "" UBYTE B_TRUE 1 100 0 1 BIT_MASK 0x1 FORMAT "%13.11" ECU_ADDRESS 0x7FBB4D /end MEASUREMENT
/begin MEASUREMENT B_zwvs "Bedingung f¸r schnellen ‰uﬂeren ZW-Eingriff der Momentenschnittstelle" UBYTE B_TRUE 1 100 0 1 BIT_MASK 0x1 FORMAT "%13.11" ECU_ADDRESS 0x7FBB59 /end MEASUREMENT
/begin MEASUREMENT B_zwvz "Bedingung f¸r Z¸ndwinkeleingriff der Momentenschnittstelle" UBYTE B_TRUE 1 100 0 1 BIT_MASK 0x1 FORMAT "%13.11" ECU_ADDRESS 0x7FBB5A /end MEASUREMENT
/begin MEASUREMENT B_zyl1_erk "Aussetzender auf Zyl 1" UBYTE B_TRUE 1 100 0 1 BIT_MASK 0x10 FORMAT "%13.11" ECU_ADDRESS 0x7FD874 /end MEASUREMENT
/begin MEASUREMENT B_zyl1_f "Aussetzender auf Zyl 1" UBYTE B_TRUE 1 100 0 1 BIT_MASK 0x1 FORMAT "%13.11" ECU_ADDRESS 0x7FD874 /end MEASUREMENT
/begin MEASUREMENT B_zyl2_f "Aussetzender auf Zyl 2" UBYTE B_TRUE 1 100 0 1 BIT_MASK 0x2 FORMAT "%13.11" ECU_ADDRESS 0x7FD874 /end MEASUREMENT
/begin MEASUREMENT B_zyl3_f "Aussetzender auf Zyl 3" UBYTE B_TRUE 1 100 0 1 BIT_MASK 0x4 FORMAT "%13.11" ECU_ADDRESS 0x7FD874 /end MEASUREMENT
/begin MEASUREMENT B_zyl4_f "Aussetzender auf Zyl 4" UBYTE B_TRUE 1 100 0 1 BIT_MASK 0x8 FORMAT "%13.11" ECU_ADDRESS 0x7FD874 /end MEASUREMENT
/begin MEASUREMENT dfrm2_w "Abweichung schneller Mittelwert des Lambdareglers von 1.0 (Word)" SWORD fak_sw_b1 1 100 -1 0.999969 FORMAT "%8.6" ECU_ADDRESS 0x7FD5EC /end MEASUREMENT
/begin MEASUREMENT dfrm_w "Abweichung schneller Mittelwert des Lambdareglers von 1.0 (Word)" SWORD fak_sw_b1 1 100 -1 0.999969 FORMAT "%8.6" ECU_ADDRESS 0x7FD5EE /end MEASUREMENT
/begin MEASUREMENT dfrsp2_w "" SWORD fak_sw_b1 1 100 -1 0.999969 FORMAT "%8.6" ECU_ADDRESS 0x7FDFA4 /end MEASUREMENT
/begin MEASUREMENT dfrsp_w "" SWORD fak_sw_b1 1 100 -1 0.999969 FORMAT "%8.6" ECU_ADDRESS 0x7FDFA6 /end MEASUREMENT
/begin MEASUREMENT dfrst2_w "" SWORD fak_sw_b1 1 100 -1 0.999969 FORMAT "%8.6" ECU_ADDRESS 0x7FDFA8 /end MEASUREMENT
/begin MEASUREMENT dfrstga2_w "" SWORD fak_sw_b1 1 100 -1 0.999969 FORMAT "%8.6" ECU_ADDRESS 0x7F9C5C /end MEASUREMENT
/begin MEASUREMENT dfrstga_w "" SWORD fak_sw_b1 1 100 -1 0.999969 FORMAT "%8.6" ECU_ADDRESS 0x7F9C5E /end MEASUREMENT
/begin MEASUREMENT dfrstte2_w "" SWORD fak_sw_b1 1 100 -1 0.999969 FORMAT "%8.6" ECU_ADDRESS 0x7F9C60 /end MEASUREMENT
/begin MEASUREMENT dfrstte_w "" SWORD fak_sw_b1 1 100 -1 0.999969 FORMAT "%8.6" ECU_ADDRESS 0x7F9C62 /end MEASUREMENT
/begin MEASUREMENT dfrst_w "" SWORD fak_sw_b1 1 100 -1 0.999969 FORMAT "%8.6" ECU_ADDRESS 0x7FDFAA /end MEASUREMENT
/begin MEASUREMENT dlahkab_w "Dynamische ‹berhˆhung des Pseudo Lambda-Sollwertes hinter Kat" SWORD fak_sw_b1 1 100 -1 0.999969 FORMAT "%8.6" ECU_ADDRESS 0x7FDFE2 /end MEASUREMENT
/begin MEASUREMENT dlashki_w "Delta-Lambda gewichtet f¸r I-Anteil LRSHK" SWORD fak_sw_b1 1 100 -1 0.999969 FORMAT "%8.6" ECU_ADDRESS 0x7FDFE4 /end MEASUREMENT
/begin MEASUREMENT dlashkm_w "Delta-Lambda aus Lambdaregelung hinter Kat (Ist-Wert fr-synchron gemittelt)" SWORD fak_sw_b1 1 100 -1 0.999969 FORMAT "%8.6" ECU_ADDRESS 0x7FDFE6 /end MEASUREMENT
/begin MEASUREMENT dlashkp_w "Delta-Lambda gewichtet f¸r P-Anteil LRSHK5.30" SWORD fak_sw_b1 1 100 -1 0.999969 FORMAT "%8.6" ECU_ADDRESS 0x7FDFE8 /end MEASUREMENT
/begin MEASUREMENT dlsd_w "D‰mpfung PT2-Filter in Lastschlagd‰mpfung" UWORD fak_uw_b4 1 100 0 3.99994 FORMAT "%8.6" ECU_ADDRESS 0x7FDEB2 /end MEASUREMENT
/begin MEASUREMENT dmaxmfs_w "" SWORD rel_sw_b100 1 100 -100 99.9969 FORMAT "%8.4" ECU_ADDRESS 0x7FDF30 /end MEASUREMENT
/begin MEASUREMENT dmdpo_w "delta Moment Dashpot-Ausloesung" SWORD rel_sw_b100 1 100 -100 99.9969 FORMAT "%8.4" ECU_ADDRESS 0x7FDEB4 /end MEASUREMENT
/begin MEASUREMENT dmdpu_w "delta Moment Dashpot-Ende" SWORD rel_sw_b100 1 100 -100 99.9969 FORMAT "%8.4" ECU_ADDRESS 0x7FDEB6 /end MEASUREMENT
/begin MEASUREMENT dminmfs_w "" SWORD rel_sw_b100 1 100 -100 99.9969 FORMAT "%8.4" ECU_ADDRESS 0x7FDF32 /end MEASUREMENT
/begin MEASUREMENT dmllrdz_w "geforderte Drehmoment‰nderung von der LLR (D-Z¸ndungsanteil)" SWORD rel_sw_b100 1 100 -100 99.9969 FORMAT "%8.4" ECU_ADDRESS 0x7FDE4E /end MEASUREMENT
/begin MEASUREMENT dmllrd_w "geforderte Drehmoment‰nderung von der LLR (D-Anteil)" SWORD rel_sw_b100 1 100 -100 99.9969 FORMAT "%8.4" ECU_ADDRESS 0x7FDE50 /end MEASUREMENT
/begin MEASUREMENT dmllri_w "geforderte Drehmoment‰nderung von der LLR (I-Anteil)" SWORD rel_sw_b100 1 100 -100 99.9969 FORMAT "%8.4" ECU_ADDRESS 0x7FDE52 /end MEASUREMENT
/begin MEASUREMENT dmllrpz_w "geforderte Drehmoment‰nderung von der LLR (P-Z¸ndungsanteil)" SWORD rel_sw_b100 1 100 -100 99.9969 FORMAT "%8.4" ECU_ADDRESS 0x7FDE54 /end MEASUREMENT
/begin MEASUREMENT dmllrp_w "geforderte Drehmoment‰nderung von der LLR (P-Anteil)" SWORD rel_sw_b100 1 100 -100 99.9969 FORMAT "%8.4" ECU_ADDRESS 0x7FDE56 /end MEASUREMENT
/begin MEASUREMENT dmllrz_w "geforderte MD-ƒnderung von der LLR (PD-Z¸ndungsanteil)" SWORD rel_sw_b100 1 100 -100 99.9969 FORMAT "%8.4" ECU_ADDRESS 0x7FDE58 /end MEASUREMENT
/begin MEASUREMENT dmllr_w "geforderte Drehmoment‰nderung von der LLR (PD-Anteil)" SWORD rel_sw_b100 1 100 -100 99.9969 FORMAT "%8.4" ECU_ADDRESS 0x7FDE5A /end MEASUREMENT
/begin MEASUREMENT dmlsdo_w "Delta Moment Auslˆsung Lastschlagd‰mpfung" SWORD rel_sw_b100 1 100 -100 99.9969 FORMAT "%8.4" ECU_ADDRESS 0x7FDEB8 /end MEASUREMENT
/begin MEASUREMENT dmlsdu_w "Delta Moment Ende Lastschlagd‰mpfung" SWORD rel_sw_b100 1 100 -100 99.9969 FORMAT "%8.4" ECU_ADDRESS 0x7FDEBA /end MEASUREMENT
/begin MEASUREMENT dmmfs_w "" SWORD rel_sw_b100 1 100 -100 99.9969 FORMAT "%8.4" ECU_ADDRESS 0x7FDF34 /end MEASUREMENT
/begin MEASUREMENT dmrkt_w "Momentenreserve im Kurztrip" UWORD rel_uw_b100 1 100 0 99.9985 FORMAT "%8.5" ECU_ADDRESS 0x7FDF52 /end MEASUREMENT
/begin MEASUREMENT dmrmx_w "Delta-Moment F¸llung durch Momentenreserve" UWORD rel_uw_b100 1 100 0 99.9985 FORMAT "%8.5" ECU_ADDRESS 0x7FDF40 /end MEASUREMENT
/begin MEASUREMENT dmvadfk_w "Delta-Motordrehmoment aus Verlustmoment-Adaption (B_fs=1 & B_ko=1)" SWORD rel_sw_b100 1 100 -100 99.9969 FORMAT "%8.4" ECU_ADDRESS 0x7F9C38 /end MEASUREMENT
/begin MEASUREMENT dmvadfs_w "Delta-Motordrehmoment aus Verlustmoment-Adaption (B_fs=1)" SWORD rel_sw_b100 1 100 -100 99.9969 FORMAT "%8.4" ECU_ADDRESS 0x7F9C3A /end MEASUREMENT
/begin MEASUREMENT dmvadko_w "Delta-Motordrehmoment aus Verlustmoment-Adaption (B_ko=1)" SWORD rel_sw_b100 1 100 -100 99.9969 FORMAT "%8.4" ECU_ADDRESS 0x7F9C3C /end MEASUREMENT
/begin MEASUREMENT dmvadll_w "Delta-Motordrehmoment aus Verlustmoment-Adaption (B_ll=1)" SWORD rel_sw_b100 1 100 -100 99.9969 FORMAT "%8.4" ECU_ADDRESS 0x7F9C3E /end MEASUREMENT
/begin MEASUREMENT dmvad_w "Delta-Motordrehmoment aus Verlustmoment-Adaption" SWORD rel_sw_b100 1 100 -100 99.9969 FORMAT "%8.4" ECU_ADDRESS 0x7FD6DC /end MEASUREMENT
/begin MEASUREMENT dmvamnfk_w "Minimalbegrenzung der Verlustmomentadaption (B_fs=1 & B_ko=1)" SWORD rel_sw_b100 1 100 -100 99.9969 FORMAT "%8.4" ECU_ADDRESS 0x7FD6DE /end MEASUREMENT
/begin MEASUREMENT dmvamnfs_w "Minimalbegrenzung der Verlustmomentadaption (B_fs=1)" SWORD rel_sw_b100 1 100 -100 99.9969 FORMAT "%8.4" ECU_ADDRESS 0x7FD6E0 /end MEASUREMENT
/begin MEASUREMENT dmvamnko_w "Minimalbegrenzung der Verlustmomentadaption (B_ko=1)" SWORD rel_sw_b100 1 100 -100 99.9969 FORMAT "%8.4" ECU_ADDRESS 0x7FD6E2 /end MEASUREMENT
/begin MEASUREMENT dmvamnll_w "Minimalbegrenzung der Verlustmomentadaption (B_ll=1)" SWORD rel_sw_b100 1 100 -100 99.9969 FORMAT "%8.4" ECU_ADDRESS 0x7FD6E4 /end MEASUREMENT
/begin MEASUREMENT dmvamxfk_w "0aximalbegrenzung der Verlustmomentadaption (B_fs=1 & B_ko=1)" SWORD rel_sw_b100 1 100 -100 99.9969 FORMAT "%8.4" ECU_ADDRESS 0x7FD6E6 /end MEASUREMENT
/begin MEASUREMENT dmvamxfs_w "Maximalbegrenzung der Verlustmomentadaption (B_fs=1)" SWORD rel_sw_b100 1 100 -100 99.9969 FORMAT "%8.4" ECU_ADDRESS 0x7FD6E8 /end MEASUREMENT
/begin MEASUREMENT dmvamxko_w "Maximalbegrenzung der Verlustmomentadaption (B_ko=1)" SWORD rel_sw_b100 1 100 -100 99.9969 FORMAT "%8.4" ECU_ADDRESS 0x7FD6EA /end MEASUREMENT
/begin MEASUREMENT dmvamxll_w "Maximalbegrenzung der Verlustmomentadaption (B_ll=1)" SWORD rel_sw_b100 1 100 -100 99.9969 FORMAT "%8.4" ECU_ADDRESS 0x7FD6EC /end MEASUREMENT
/begin MEASUREMENT dmverl_w "Verlustmoment nach DT1-Filter" SWORD rel_sw_b100 1 100 -100 99.9969 FORMAT "%8.4" ECU_ADDRESS 0x7FDE6A /end MEASUREMENT
/begin MEASUREMENT dmzms_w "Abstand des indizierten Sollmoments vom zul‰ssigen Sollmoment" SWORD rel_sw_b100 1 100 -100 99.9969 FORMAT "%8.4" ECU_ADDRESS 0x7FDF18 /end MEASUREMENT
/begin MEASUREMENT dn "Drehzahlabweichung bei Leerlaufregelung" SBYTE nmotd_sb_q10 1 100 -1280 1270 FORMAT "%5.0" ECU_ADDRESS 0x7FDA4B /end MEASUREMENT
/begin MEASUREMENT dn_w "Drehzahlabweichung bei Leerlaufregelung" SWORD nmotd_sw_q0p25 1 100 -8192 8191.75 FORMAT "%8.3" ECU_ADDRESS 0x7FDE5C /end MEASUREMENT
/begin MEASUREMENT dpsfaktd "" UBYTE fak_ub_q0p00392 1 100 0 1 FORMAT "%5.3" ECU_ADDRESS 0x7FD84E /end MEASUREMENT
/begin MEASUREMENT drlsolf_w "" SWORD rel_sw_q0p0234 1 100 -768 767.977 FORMAT "%8.4" ECU_ADDRESS 0x7FDC60 /end MEASUREMENT
/begin MEASUREMENT drlsol_w "ƒnderung Sollf¸llung" SWORD rel_sw_q0p0234 1 100 -768 767.977 FORMAT "%8.4" ECU_ADDRESS 0x7FDC62 /end MEASUREMENT
/begin MEASUREMENT dtvka "" SBYTE t100msxs_sb_q0p01 1 100 -1.28 1.27 FORMAT "%5.3" ECU_ADDRESS 0x7FDAA1 /end MEASUREMENT
/begin MEASUREMENT dtvka2 "" SBYTE t100msxs_sb_q0p01 1 100 -1.28 1.27 FORMAT "%5.3" ECU_ADDRESS 0x7FDAA2 /end MEASUREMENT
/begin MEASUREMENT dtvkai "" SBYTE t100msxs_sb_q0p01 1 100 -1.28 1.27 FORMAT "%5.3" ECU_ADDRESS 0x7FDAA3 /end MEASUREMENT
/begin MEASUREMENT dtvkai2 "" SBYTE t100msxs_sb_q0p01 1 100 -1.28 1.27 FORMAT "%5.3" ECU_ADDRESS 0x7FDAA4 /end MEASUREMENT
/begin MEASUREMENT dzwagr "delta Z¸ndwinkel bei B_AGR=1 (AGR aktiv)" SBYTE zw_sb_q0p75 1 100 -96 95.25 FORMAT "%5.2" ECU_ADDRESS 0x7FDA5A /end MEASUREMENT
/begin MEASUREMENT dzwb "Differenz BasisZW optimaler Z¸ndwinkel" SBYTE zw_sb_q0p75 1 100 -96 95.25 FORMAT "%5.2" ECU_ADDRESS 0x7FDA5B /end MEASUREMENT
/begin MEASUREMENT dzwi "Delta Z¸ndwinkel zwischen zwopt und zwout" SBYTE zw_sb_q0p75 1 100 -96 95.25 FORMAT "%5.2" ECU_ADDRESS 0x7FDA68 /end MEASUREMENT
/begin MEASUREMENT dzwkoef "Koeffizient auf delta Z¸ndwinkel" UBYTE fak_q0p0439 1 100 0 11.1961 FORMAT "%5.2" ECU_ADDRESS 0x7FD6F6 /end MEASUREMENT
/begin MEASUREMENT dzwoag "abgasr¸ckf¸hrratenabh. Z¸ndwinkelkorrektur des optimalen ZW" SBYTE zw_sb_q0p75 1 100 -96 95.25 FORMAT "%5.2" ECU_ADDRESS 0x7FDA5C /end MEASUREMENT
/begin MEASUREMENT dzwol "lambdaabh. Z¸ndwinkelkorrektur des optimalen ZW" SBYTE zw_sb_q0p75 1 100 -96 95.25 FORMAT "%5.2" ECU_ADDRESS 0x7FDA5D /end MEASUREMENT
/begin MEASUREMENT dzwotm "temperaturabh‰ngige Z¸ndwinkelkorrektur des optimalen ZW" SBYTE zw_sb_q0p75 1 100 -96 95.25 FORMAT "%5.2" ECU_ADDRESS 0x7FDA5E /end MEASUREMENT
/begin MEASUREMENT Erznerk "Erzeugt und nicht erkannt" UWORD dez 1 100 0 65535 FORMAT "%8.2" ECU_ADDRESS 0x7FE1F4 /end MEASUREMENT
/begin MEASUREMENT Erzuerk "Erzeugt und erkannt" UWORD dez 1 100 0 65535 FORMAT "%8.2" ECU_ADDRESS 0x7FE1F6 /end MEASUREMENT
/begin MEASUREMENT Esprll "Soll-Einlassspreizung im Leerlauf" UBYTE sprzi_q0p8 1 100 0 204 FORMAT "%5.1" ECU_ADDRESS 0x7FD849 /end MEASUREMENT
/begin MEASUREMENT esst_sdn08llsw "" ULONG dez 1 100 0 4.29497e+009 FORMAT "%13.2" ECU_ADDRESS 0x7FE498 /end MEASUREMENT
/begin MEASUREMENT esst_sdn08lltsw "" ULONG dez 1 100 0 4.29497e+009 FORMAT "%13.2" ECU_ADDRESS 0x7FE49C /end MEASUREMENT
/begin MEASUREMENT esst_smk06mduw "" ULONG dez 1 100 0 4.29497e+009 FORMAT "%13.2" ECU_ADDRESS 0x7FE4A4 /end MEASUREMENT
/begin MEASUREMENT esst_srl16opuw "" ULONG dez 1 100 0 4.29497e+009 FORMAT "%13.2" ECU_ADDRESS 0x7FE4A0 /end MEASUREMENT
/begin MEASUREMENT etabas_w "multiplizierter zw und lambda-Wirkungsgrad" UWORD rel_uw_b100 1 100 0 99.9985 FORMAT "%8.5" ECU_ADDRESS 0x7FDEBC /end MEASUREMENT
/begin MEASUREMENT etagd "Wirkungsgrad gedrosselt in Bezug auf 100% bei ungedrosseltem Betrieb" UBYTE rel_ub_b127p5 1 100 0 127.5 FORMAT "%5.1" ECU_ADDRESS 0x7FDA5F /end MEASUREMENT
/begin MEASUREMENT etalab "Lambda-Wirkungsgrad ohne Eingriff bezogen auf optimales Moment bei Lambda=1" UBYTE rel_ub_b127p5 1 100 0 127.5 FORMAT "%5.1" ECU_ADDRESS 0x7FDA60 /end MEASUREMENT
/begin MEASUREMENT etatrmn "minimaler Wert in der Wirkungsgradtrommel" UBYTE rel_ub_b127p5 1 100 0 127.5 FORMAT "%5.1" ECU_ADDRESS 0x7FDA61 /end MEASUREMENT
/begin MEASUREMENT etazaist "Ist-Zylinderausblendungswirkungsgrad" UBYTE rel_ub_b127p5 1 100 0 127.5 FORMAT "%5.1" ECU_ADDRESS 0x7FDA69 /end MEASUREMENT
/begin MEASUREMENT etazwb "Z¸ndwinkelwirkungsgrad des Basisz¸ndwinkels" UBYTE rel_ub_b127p5 1 100 0 127.5 FORMAT "%5.1" ECU_ADDRESS 0x7FDA62 /end MEASUREMENT
/begin MEASUREMENT etazwbm "gemittelter Z¸ndwinkelwirkungsgrad des Basisz¸ndwinkels" UBYTE rel_ub_b127p5 1 100 0 127.5 FORMAT "%5.1" ECU_ADDRESS 0x7FDA63 /end MEASUREMENT
/begin MEASUREMENT etazwist "Ist-Z¸ndwinkelwirkungsgrad" UBYTE rel_ub_b127p5 1 100 0 127.5 FORMAT "%5.1" ECU_ADDRESS 0x7FDA6A /end MEASUREMENT
/begin MEASUREMENT favkatmx "Gewichtungsfaktor Sauerstoffspeicher ¸ber avkatf" UBYTE fak_ub_b1 1 100 0 0.996094 ECU_ADDRESS 0x7FD75E /end MEASUREMENT
/begin MEASUREMENT fdmfbt "" UBYTE fak_ub_b1 1 100 0 0.996094 ECU_ADDRESS 0x7FDA66 /end MEASUREMENT
/begin MEASUREMENT Fesa1 "gefilteter Lernfortschritt 1" SBYTE lur_fak_b4 1 100 -0.78125 0.775146 ECU_ADDRESS 0x7F9CC4 /end MEASUREMENT
/begin MEASUREMENT Fesa2 "gefilteter Lernfortschritt 2" SBYTE lur_fak_b4 1 100 -0.78125 0.775146 ECU_ADDRESS 0x7F9CC5 /end MEASUREMENT
/begin MEASUREMENT ffri "" UBYTE fak_ub_b4 1 100 0 3.98438 FORMAT "%5.3" ECU_ADDRESS 0x7FD758 /end MEASUREMENT
/begin MEASUREMENT ffri2 "" UBYTE fak_ub_b4 1 100 0 3.98438 FORMAT "%5.3" ECU_ADDRESS 0x7FD759 /end MEASUREMENT
/begin MEASUREMENT ffrip_w "" UWORD fak_uw_b8 1 100 0 7.99988 FORMAT "%8.6" ECU_ADDRESS 0x7FD75A /end MEASUREMENT
/begin MEASUREMENT Fiasa "Adaptionsfilterkonstante" UBYTE lur_fakseg_b1 1 100 0 9.96094 FORMAT "%5.3" ECU_ADDRESS 0x7FD869 /end MEASUREMENT
/begin MEASUREMENT flglrs "CARB FREEZE FRAME Byte, Bank 1, f¸r LR" UBYTE dez 1 100 0 255 FORMAT "%5.1" ECU_ADDRESS 0x7FDA91 /end MEASUREMENT
/begin MEASUREMENT flglrs2 "CARB FREEZE FRAME Byte, Bank 2, f¸r LR" UBYTE dez 1 100 0 255 FORMAT "%5.1" ECU_ADDRESS 0x7FDA92 /end MEASUREMENT
/begin MEASUREMENT fmibgrv_w "Regelfaktor f¸r Korrektur gangabh‰ngige Momentenbegrenzung vor Filterung" UWORD fak_uw_b2 1 100 0 1.99997 FORMAT "%8.6" ECU_ADDRESS 0x7FDF06 /end MEASUREMENT
/begin MEASUREMENT fmibgr_w "Regelfaktor f¸r Korrektur gangabh‰ngige Momentenbegrenzung" UWORD fak_uw_b2 1 100 0 1.99997 FORMAT "%8.6" ECU_ADDRESS 0x7FDF08 /end MEASUREMENT
/begin MEASUREMENT fmil_w "Faktor rel/ind Moment" UWORD rel_uw_b200 1 100 0 199.997 FORMAT "%8.4" ECU_ADDRESS 0x7FDEBE /end MEASUREMENT
/begin MEASUREMENT fmimas_w "" UWORD rel_uw_b3072 1 100 0 3071.95 FORMAT "%8.3" ECU_ADDRESS 0x7FDF2C /end MEASUREMENT
/begin MEASUREMENT fmknul "" UWORD fak_uw_b2 1 100 3.05176e-005 1.99997 FORMAT "%8.6" ECU_ADDRESS 0x7FDEC0 /end MEASUREMENT
/begin MEASUREMENT fmrgang_w "" UWORD rel_uw_b3072 1 100 0 3071.95 FORMAT "%8.3" ECU_ADDRESS 0x7FDF1A /end MEASUREMENT
/begin MEASUREMENT fnstab_w "Faktor zur Stabilisierung mittels Drehzahlquotient" UWORD fak_uw_b8 1 100 0 7.99988 FORMAT "%8.6" ECU_ADDRESS 0x7FE166 /end MEASUREMENT
/begin MEASUREMENT fnsta_in "Source f¸r FNSTABNV" UWORD fak_uw_b8 1 100 0 7.99988 FORMAT "%8.6" ECU_ADDRESS 0x7FE168 /end MEASUREMENT
/begin MEASUREMENT fnwll "Gewichtungsfaktor fuer zwoptLL" UBYTE fak_ub_b1 1 100 0 0.996094 ECU_ADDRESS 0x7FD84A /end MEASUREMENT
/begin MEASUREMENT fnwlleff "Gewichtungsfaktor fuer zwoptLL" UBYTE fak_ub_b1 1 100 0 0.996094 ECU_ADDRESS 0x7FD84B /end MEASUREMENT
/begin MEASUREMENT fr2_w "Lambda-Regler-Ausgang; Bank2 (Word)" UWORD fak_uw_b2 1 100 0 1.99997 FORMAT "%8.6" ECU_ADDRESS 0x7FDFAC /end MEASUREMENT
/begin MEASUREMENT fra2_w "multiplikative Gemischkorrektur der Gemischadaption (Word)" UWORD fak_uw_b2 1 100 0 1.99997 FORMAT "%8.6" ECU_ADDRESS 0x7FDD26 /end MEASUREMENT
/begin MEASUREMENT frao2_w "multipl. Gemischadaptionsfaktor oberer Lastbereich Bank 2 (Word)" UWORD fak_uw_b2 1 100 0 1.99997 FORMAT "%8.6" ECU_ADDRESS 0x7F9BD0 /end MEASUREMENT
/begin MEASUREMENT frao_w "multiplikativer Gemischadaptionsfaktor oberer Lastbereich (Word)" UWORD fak_uw_b2 1 100 0 1.99997 FORMAT "%8.6" ECU_ADDRESS 0x7F9BD2 /end MEASUREMENT
/begin MEASUREMENT frau2_w "multipl. Gemischadaptionsfaktor unterer mult. Bereich der Bank 2 (Word)" UWORD fak_uw_b2 1 100 0 1.99997 FORMAT "%8.6" ECU_ADDRESS 0x7F9BD4 /end MEASUREMENT
/begin MEASUREMENT frau_w "multiplikativer Gemischadaptionsfaktor unterer mult. Bereich (Word)" UWORD fak_uw_b2 1 100 0 1.99997 FORMAT "%8.6" ECU_ADDRESS 0x7F9BD6 /end MEASUREMENT
/begin MEASUREMENT fra_w "multiplikative Gemischkorrektur der Gemischadaption (Word)" UWORD fak_uw_b2 1 100 0 1.99997 FORMAT "%8.6" ECU_ADDRESS 0x7FDD28 /end MEASUREMENT
/begin MEASUREMENT frband2_w "" SWORD fak_sw_b1 1 100 -1 0.999969 FORMAT "%8.6" ECU_ADDRESS 0x7FDFAE /end MEASUREMENT
/begin MEASUREMENT frband_w "" SWORD fak_sw_b1 1 100 -1 0.999969 FORMAT "%8.6" ECU_ADDRESS 0x7FDFB0 /end MEASUREMENT
/begin MEASUREMENT fri "" UBYTE fak_ub_b77p81 1 100 0 77.8198 FORMAT "%5.2" ECU_ADDRESS 0x7FDA7D /end MEASUREMENT
/begin MEASUREMENT fri2 "" UBYTE fak_ub_b77p81 1 100 0 77.8198 FORMAT "%5.2" ECU_ADDRESS 0x7FDA7E /end MEASUREMENT
/begin MEASUREMENT friband2_w "" SWORD fak_sw_b1 1 100 -1 0.999969 FORMAT "%8.6" ECU_ADDRESS 0x7FDFB2 /end MEASUREMENT
/begin MEASUREMENT friband_w "" SWORD fak_sw_b1 1 100 -1 0.999969 FORMAT "%8.6" ECU_ADDRESS 0x7FDFB4 /end MEASUREMENT
/begin MEASUREMENT friint "" UBYTE fak_ub_b77p81 1 100 0 77.8198 FORMAT "%5.2" ECU_ADDRESS 0x7FDA7F /end MEASUREMENT
/begin MEASUREMENT friint2 "" UBYTE fak_ub_b77p81 1 100 0 77.8198 FORMAT "%5.2" ECU_ADDRESS 0x7FDA80 /end MEASUREMENT
/begin MEASUREMENT frini2_w "Initialisierungswert f¸r Regelfaktor Lambdaregelung, Bank 2" UWORD fak_uw_b2 1 100 0 1.99997 FORMAT "%8.6" ECU_ADDRESS 0x7FDFF8 /end MEASUREMENT
/begin MEASUREMENT frini_w "Initialisierungswert f¸r Regelfaktor Lambdaregelung" UWORD fak_uw_b2 1 100 0 1.99997 FORMAT "%8.6" ECU_ADDRESS 0x7FDFFA /end MEASUREMENT
/begin MEASUREMENT frint2_w "" UWORD fak_uw_b2 1 100 0 1.99997 FORMAT "%8.6" ECU_ADDRESS 0x7FDFB6 /end MEASUREMENT
/begin MEASUREMENT frint_w "" UWORD fak_uw_b2 1 100 0 1.99997 FORMAT "%8.6" ECU_ADDRESS 0x7FDFB8 /end MEASUREMENT
/begin MEASUREMENT frm2_w "schneller Mittelwert des Lambdaregelfaktors Bank 2(Word)" UWORD fak_uw_b2 1 100 0 1.99997 FORMAT "%8.6" ECU_ADDRESS 0x7FDFBA /end MEASUREMENT
/begin MEASUREMENT frmn2_w "Lambda-Regler-Ausgang Minimalwert, Bank 2" UWORD fak_uw_b2 1 100 0 1.99997 FORMAT "%8.6" ECU_ADDRESS 0x7FDFBC /end MEASUREMENT
/begin MEASUREMENT frmn_w "Lambda-Regler-Ausgang Minimalwert" UWORD fak_uw_b2 1 100 0 1.99997 FORMAT "%8.6" ECU_ADDRESS 0x7FDFBE /end MEASUREMENT
/begin MEASUREMENT frmx2_w "" UWORD fak_uw_b2 1 100 0 1.99997 FORMAT "%8.6" ECU_ADDRESS 0x7FDFC0 /end MEASUREMENT
/begin MEASUREMENT frmx_w "LR mit Integratorstop : Max. Begrenzung Integrator fr,; FRMAX / angehoben d.DSLS" UWORD fak_uw_b2 1 100 0 1.99997 FORMAT "%8.6" ECU_ADDRESS 0x7FDFC2 /end MEASUREMENT
/begin MEASUREMENT frm_w "schneller Mittelwert des Lambdaregelfaktors (Word)" UWORD fak_uw_b2 1 100 0 1.99997 FORMAT "%8.6" ECU_ADDRESS 0x7FDFC4 /end MEASUREMENT
/begin MEASUREMENT frp "" UBYTE fak_ub_b12p45 1 100 0 12.4512 FORMAT "%5.2" ECU_ADDRESS 0x7FDA81 /end MEASUREMENT
/begin MEASUREMENT frp2 "" UBYTE fak_ub_b12p45 1 100 0 12.4512 FORMAT "%5.2" ECU_ADDRESS 0x7FDA82 /end MEASUREMENT
/begin MEASUREMENT frpint "" UBYTE fak_ub_b12p45 1 100 0 12.4512 FORMAT "%5.2" ECU_ADDRESS 0x7FDA83 /end MEASUREMENT
/begin MEASUREMENT frpint2 "" UBYTE fak_ub_b12p45 1 100 0 12.4512 FORMAT "%5.2" ECU_ADDRESS 0x7FDA84 /end MEASUREMENT
/begin MEASUREMENT frsp2_w "" UWORD fak_uw_b2 1 100 0 1.99997 FORMAT "%8.6" ECU_ADDRESS 0x7FDFC6 /end MEASUREMENT
/begin MEASUREMENT frsp_w "" UWORD fak_uw_b2 1 100 0 1.99997 FORMAT "%8.6" ECU_ADDRESS 0x7FDFC8 /end MEASUREMENT
/begin MEASUREMENT frtv "" SBYTE t10msxs_sb_q0p01 1 100 -1.28 1.27 FORMAT "%5.3" ECU_ADDRESS 0x7FDA85 /end MEASUREMENT
/begin MEASUREMENT frtv2 "" SBYTE t10msxs_sb_q0p01 1 100 -1.28 1.27 FORMAT "%5.3" ECU_ADDRESS 0x7FDA86 /end MEASUREMENT
/begin MEASUREMENT fr_w "Lambda-Regler-Ausgang (Word)" UWORD fak_uw_b2 1 100 0 1.99997 FORMAT "%8.6" ECU_ADDRESS 0x7FDFCA /end MEASUREMENT
/begin MEASUREMENT ftv "" UBYTE fak_ub_b2 1 100 0 1.99219 FORMAT "%5.3" ECU_ADDRESS 0x7FDA94 /end MEASUREMENT
/begin MEASUREMENT fwuell "Summenverh‰ltnis LL-Sollspreizungen zu aktuellen Ist-Spreizungen" UBYTE fak_ub_b2 1 100 0 1.99219 FORMAT "%5.3" ECU_ADDRESS 0x7FD84C /end MEASUREMENT
/begin MEASUREMENT fznwll "Faktor Ausblendung der zwopt LL-Umschaltung" UBYTE fak_ub_b1 1 100 0 0.996094 ECU_ADDRESS 0x7FD84D /end MEASUREMENT
/begin MEASUREMENT Geradcnt "Zaehler fuer Adaptionsstop" UWORD lur_seg 1 100 0 65535 FORMAT "%8.2" ECU_ADDRESS 0x7F9CC2 /end MEASUREMENT
/begin MEASUREMENT iavkatf "" UBYTE fak_ub_b1 1 100 0 0.996094 ECU_ADDRESS 0x7FDA95 /end MEASUREMENT
/begin MEASUREMENT idlashkm_w "" SWORD fak_sw_b1 1 100 -1 0.999969 FORMAT "%8.6" ECU_ADDRESS 0x7FDFEA /end MEASUREMENT
/begin MEASUREMENT ilmlka2_w "" UWORD m_uw_b4660 1 100 0 4660.27 FORMAT "%8.3" ECU_ADDRESS 0x7FDFFC /end MEASUREMENT
/begin MEASUREMENT ilmlkah2_w "" UWORD m_uw_b4660 1 100 0 4660.27 FORMAT "%8.3" ECU_ADDRESS 0x7FDFFE /end MEASUREMENT
/begin MEASUREMENT ilmlkah_w "" UWORD m_uw_b4660 1 100 0 4660.27 FORMAT "%8.3" ECU_ADDRESS 0x7FE000 /end MEASUREMENT
/begin MEASUREMENT ilmlkam2_w "" UWORD m_uw_b4660 1 100 0 4660.27 FORMAT "%8.3" ECU_ADDRESS 0x7FE002 /end MEASUREMENT
/begin MEASUREMENT ilmlkam_w "" UWORD m_uw_b4660 1 100 0 4660.27 FORMAT "%8.3" ECU_ADDRESS 0x7FE004 /end MEASUREMENT
/begin MEASUREMENT ilmlkat2_w "" UWORD m_uw_b4660 1 100 0 4660.27 FORMAT "%8.3" ECU_ADDRESS 0x7FE006 /end MEASUREMENT
/begin MEASUREMENT ilmlkat_w "" UWORD m_uw_b4660 1 100 0 4660.27 FORMAT "%8.3" ECU_ADDRESS 0x7FE008 /end MEASUREMENT
/begin MEASUREMENT ilmlkav2_w "" UWORD m_uw_b4660 1 100 0 4660.27 FORMAT "%8.3" ECU_ADDRESS 0x7FE00A /end MEASUREMENT
/begin MEASUREMENT ilmlkav_w "" UWORD m_uw_b4660 1 100 0 4660.27 FORMAT "%8.3" ECU_ADDRESS 0x7FE00C /end MEASUREMENT
/begin MEASUREMENT ilmlkax2_w "" UWORD m_uw_b4660 1 100 0 4660.27 FORMAT "%8.3" ECU_ADDRESS 0x7FE00E /end MEASUREMENT
/begin MEASUREMENT ilmlkax_w "" UWORD m_uw_b4660 1 100 0 4660.27 FORMAT "%8.3" ECU_ADDRESS 0x7FE010 /end MEASUREMENT
/begin MEASUREMENT ilmlka_w "Integrator Fettfl‰che f¸r Katalysator-Ausr‰umen" UWORD m_uw_b4660 1 100 0 4660.27 FORMAT "%8.3" ECU_ADDRESS 0x7FE012 /end MEASUREMENT
/begin MEASUREMENT imlka2_w "" UWORD m_uw_b4660 1 100 0 4660.27 FORMAT "%8.3" ECU_ADDRESS 0x7FE014 /end MEASUREMENT
/begin MEASUREMENT imlkav2_w "" UWORD m_uw_b4660 1 100 0 4660.27 FORMAT "%8.3" ECU_ADDRESS 0x7FE016 /end MEASUREMENT
/begin MEASUREMENT imlkav_w "" UWORD m_uw_b4660 1 100 0 4660.27 FORMAT "%8.3" ECU_ADDRESS 0x7FE018 /end MEASUREMENT
/begin MEASUREMENT imlkax2_w "" UWORD m_uw_b4660 1 100 0 4660.27 FORMAT "%8.3" ECU_ADDRESS 0x7FE01A /end MEASUREMENT
/begin MEASUREMENT imlkax_w "" UWORD m_uw_b4660 1 100 0 4660.27 FORMAT "%8.3" ECU_ADDRESS 0x7FE01C /end MEASUREMENT
/begin MEASUREMENT imlka_w "Integrator Luftmasse f¸r Katalysator-Ausr‰umen" UWORD m_uw_b4660 1 100 0 4660.27 FORMAT "%8.3" ECU_ADDRESS 0x7FE01E /end MEASUREMENT
/begin MEASUREMENT imlrsa_w "Luftmasse nach SA f¸r stetige Lambdaregelung" UWORD m_uw_b4660 1 100 0 4660.27 FORMAT "%8.3" ECU_ADDRESS 0x7FDFE0 /end MEASUREMENT
/begin MEASUREMENT iwflsd_w "Initialisierungswert Filter Lastschlagd‰mpfung" UWORD rel_uw_b100 1 100 0 99.9985 FORMAT "%8.5" ECU_ADDRESS 0x7FDEC2 /end MEASUREMENT
/begin MEASUREMENT Klu_cnt "Zaehler Lur erlaubt bis Lur aktiv" UBYTE dez 1 100 0 255 FORMAT "%5.1" ECU_ADDRESS 0x7FD86A /end MEASUREMENT
/begin MEASUREMENT k_alt "" UWORD t10msxs_uw_q0p001 1 100 0.001 65.535 FORMAT "%8.5" ECU_ADDRESS 0x7FDEC4 /end MEASUREMENT
/begin MEASUREMENT k_neu "" UWORD t10msxs_uw_q0p001 1 100 0.001 65.535 FORMAT "%8.5" ECU_ADDRESS 0x7FDEC6 /end MEASUREMENT
/begin MEASUREMENT lahkmz "Zustandsbyte des Automaten: fr-synchrone Mittelung Pseodo-Lambda hinter Kat" UBYTE dez 1 100 0 255 FORMAT "%5.1" ECU_ADDRESS 0x7FDA96 /end MEASUREMENT
/begin MEASUREMENT lamhf_w "Pseudolinearisietes Lambda hinter Kat, PT1-gefiltert, Word" UWORD fak_uw_b16 1 100 0 15.9998 FORMAT "%8.5" ECU_ADDRESS 0x7FDFEC /end MEASUREMENT
/begin MEASUREMENT lamhm_w "" UWORD fak_uw_b16 1 100 0 15.9998 FORMAT "%8.5" ECU_ADDRESS 0x7FDFEE /end MEASUREMENT
/begin MEASUREMENT lamka2_w "Lambdasollwert Katausr‰umen, Bank2" UWORD fak_uw_b16 1 100 0 15.9998 FORMAT "%8.5" ECU_ADDRESS 0x7FE020 /end MEASUREMENT
/begin MEASUREMENT lamkai2_w "" UWORD fak_uw_b16 1 100 0 15.9998 FORMAT "%8.5" ECU_ADDRESS 0x7FE022 /end MEASUREMENT
/begin MEASUREMENT lamkaii2_w "" UWORD fak_uw_b16 1 100 0 15.9998 FORMAT "%8.5" ECU_ADDRESS 0x7FE024 /end MEASUREMENT
/begin MEASUREMENT lamkaii_w "" UWORD fak_uw_b16 1 100 0 15.9998 FORMAT "%8.5" ECU_ADDRESS 0x7FE026 /end MEASUREMENT
/begin MEASUREMENT lamkai_w "" UWORD fak_uw_b16 1 100 0 15.9998 FORMAT "%8.5" ECU_ADDRESS 0x7FE028 /end MEASUREMENT
/begin MEASUREMENT lamka_w "Lambdasollwert Katausr‰umen" UWORD fak_uw_b16 1 100 0 15.9998 FORMAT "%8.5" ECU_ADDRESS 0x7FE02A /end MEASUREMENT
/begin MEASUREMENT lamsnka2_w "" UWORD fak_uw_b16 1 100 0 15.9998 FORMAT "%8.5" ECU_ADDRESS 0x7FE02C /end MEASUREMENT
/begin MEASUREMENT lamsnka_w "" UWORD fak_uw_b16 1 100 0 15.9998 FORMAT "%8.5" ECU_ADDRESS 0x7FE02E /end MEASUREMENT
/begin MEASUREMENT lamsolh_w "" UWORD fak_uw_b16 1 100 0 15.9998 FORMAT "%8.5" ECU_ADDRESS 0x7FDFF0 /end MEASUREMENT
/begin MEASUREMENT lamsonh_w "" UWORD fak_uw_b16 1 100 0 15.9998 FORMAT "%8.5" ECU_ADDRESS 0x7FDFF2 /end MEASUREMENT
/begin MEASUREMENT limax_w "LLR-Integrator-Maximalwert" SWORD rel_sw_b100 1 100 -100 99.9969 FORMAT "%8.4" ECU_ADDRESS 0x7FDE5E /end MEASUREMENT
/begin MEASUREMENT limin_w "LLR-Integrator-Minimalwert" SWORD rel_sw_b100 1 100 -100 99.9969 FORMAT "%8.4" ECU_ADDRESS 0x7FDE60 /end MEASUREMENT
/begin MEASUREMENT limnst "LLR-Integrator-Minimalwert w‰hrend Nachstart" UBYTE rel_ub_b24p9 1 100 0 24.9 FORMAT "%5.2" ECU_ADDRESS 0x7FDA4C /end MEASUREMENT
/begin MEASUREMENT lrfrmz "" UBYTE dez 1 100 0 255 FORMAT "%5.1" ECU_ADDRESS 0x7FDA87 /end MEASUREMENT
/begin MEASUREMENT lrfrmz2 "" UBYTE dez 1 100 0 255 FORMAT "%5.1" ECU_ADDRESS 0x7FDA88 /end MEASUREMENT
/begin MEASUREMENT lrfrz "" UBYTE dez 1 100 0 255 FORMAT "%5.1" ECU_ADDRESS 0x7FDA89 /end MEASUREMENT
/begin MEASUREMENT lrfrz2 "" UBYTE dez 1 100 0 255 FORMAT "%5.1" ECU_ADDRESS 0x7FDA8A /end MEASUREMENT
/begin MEASUREMENT LRHKlokbits "" UBYTE dez 1 100 0 255 FORMAT "%5.1" ECU_ADDRESS 0x7FDA97 /end MEASUREMENT
/begin MEASUREMENT lrkaz "Zustandsbyte des Automaten Kat-Ausr‰umen" UBYTE dez 1 100 0 255 FORMAT "%5.1" ECU_ADDRESS 0x7FDAA5 /end MEASUREMENT
/begin MEASUREMENT lrkaz2 "" UBYTE dez 1 100 0 255 FORMAT "%5.1" ECU_ADDRESS 0x7FDAA6 /end MEASUREMENT
/begin MEASUREMENT Lum "" UBYTE lur_q1 1 100 0 255 FORMAT "%5.1" ECU_ADDRESS 0x7FD86B /end MEASUREMENT
/begin MEASUREMENT LURSTOPbits "" UBYTE dez 1 100 0 255 FORMAT "%5.1" ECU_ADDRESS 0x7FD7ED /end MEASUREMENT
/begin MEASUREMENT Lur_alt "Referenzwert" UBYTE lur_q1 1 100 0 255 FORMAT "%5.1" ECU_ADDRESS 0x7FD86C /end MEASUREMENT
/begin MEASUREMENT Lut "aktuelle Laufunruhewerte" UBYTE lur_q1 1 100 0 255 FORMAT "%5.1" ARRAY_SIZE 4 ECU_ADDRESS 0x7FD870 /end MEASUREMENT
/begin MEASUREMENT Lut_f "Laufqualitaet" UWORD fak_ub_b1 1 100 0 255.996 FORMAT "%8.4" ARRAY_SIZE 4 ECU_ADDRESS 0x7FE1F8 /end MEASUREMENT
/begin MEASUREMENT mdindg_w "indiziertes Motormoment Hochdruckphase wenn alle Zylinder befeuert" UWORD rel_uw_b100 1 100 0 99.9985 FORMAT "%8.5" ECU_ADDRESS 0x7FDF12 /end MEASUREMENT
/begin MEASUREMENT Mdind_alt "" UWORD rel_uw_b100 1 100 0 99.9985 FORMAT "%8.5" ECU_ADDRESS 0x7FE200 /end MEASUREMENT
/begin MEASUREMENT mdsh_aus "" SBYTE rel_q0p1957 1 100 -25.0489 24.8532 FORMAT "%5.2" ECU_ADDRESS 0x7FDA4F /end MEASUREMENT
/begin MEASUREMENT mdsm_w "Schleppmoment Temperatur-Anteil" UWORD rel_uw_b100 1 100 0 99.9985 FORMAT "%8.5" ECU_ADDRESS 0x7FDE6C /end MEASUREMENT
/begin MEASUREMENT mdsvad_w "" UWORD rel_uw_b100 1 100 0 99.9985 FORMAT "%8.5" ECU_ADDRESS 0x7FDE6E /end MEASUREMENT
/begin MEASUREMENT mdsw_w "Motorschleppmoment" UWORD rel_uw_b100 1 100 0 99.9985 FORMAT "%8.5" ECU_ADDRESS 0x7FDE70 /end MEASUREMENT
/begin MEASUREMENT mds_w "Motorschleppmoment" UWORD rel_uw_b100 1 100 0 99.9985 FORMAT "%8.5" ECU_ADDRESS 0x7FDE72 /end MEASUREMENT
/begin MEASUREMENT mdverbfa_w "" SWORD rel_sw_b100 1 100 -100 99.9969 FORMAT "%8.4" ECU_ADDRESS 0x7FDEC8 /end MEASUREMENT
/begin MEASUREMENT mdverf_w "Gefiltertes Verlustmoment" UWORD rel_uw_b100 1 100 0 99.9985 FORMAT "%8.5" ECU_ADDRESS 0x7FDE74 /end MEASUREMENT
/begin MEASUREMENT mdverl_w "Motor-Verlustmoment" UWORD rel_uw_b100 1 100 0 99.9985 FORMAT "%8.5" ECU_ADDRESS 0x7FDE76 /end MEASUREMENT
/begin MEASUREMENT meist_w "" UWORD md_q0p5 1 100 0 32767.5 FORMAT "%8.2" ECU_ADDRESS 0x7FDF14 /end MEASUREMENT
/begin MEASUREMENT menist_w "" UWORD rel_uw_b100 1 100 0 99.9985 FORMAT "%8.5" ECU_ADDRESS 0x7FDF16 /end MEASUREMENT
/begin MEASUREMENT mibas_w "indiziertes Basis-Moment" UWORD rel_uw_b100 1 100 0 99.9985 FORMAT "%8.5" ECU_ADDRESS 0x7FDEA8 /end MEASUREMENT
/begin MEASUREMENT mibdp_w "indiziertes Soll-Motormoment Dashpot" UWORD rel_uw_b100 1 100 0 99.9985 FORMAT "%8.5" ECU_ADDRESS 0x7FDECA /end MEASUREMENT
/begin MEASUREMENT mibeg_w "Begrenzungsmoment" UWORD rel_uw_b100 1 100 0 99.9985 FORMAT "%8.5" ECU_ADDRESS 0x7FDF1C /end MEASUREMENT
/begin MEASUREMENT mibgrv_w "indiziertes soll-Moment f¸r gangabh‰ngige Momentenbegrenzung vor Regelung" UWORD rel_uw_b100 1 100 0 99.9985 FORMAT "%8.5" ECU_ADDRESS 0x7FDF0A /end MEASUREMENT
/begin MEASUREMENT mibgr_w "indiziertes soll-Moment f¸r gangabh‰ngige Kupplungsmomentbegrenzung" UWORD rel_uw_b100 1 100 0 99.9985 FORMAT "%8.5" ECU_ADDRESS 0x7FDF0C /end MEASUREMENT
/begin MEASUREMENT miblsd_w "Begrenztes indiziertes Moment aus Lastschlagd‰mpfung" UWORD rel_uw_b100 1 100 0 99.9985 FORMAT "%8.5" ECU_ADDRESS 0x7FDECC /end MEASUREMENT
/begin MEASUREMENT miextv_w "von extern gefordertes Moment vor Abw¸rgeschutz" UWORD rel_uw_b100 1 100 0 99.9985 FORMAT "%8.5" ECU_ADDRESS 0x7FDF1E /end MEASUREMENT
/begin MEASUREMENT miext_w "von auﬂen (ASR, GS, usw.) angefordertes indiziertes Motormoment" UWORD rel_uw_b100 1 100 0 99.9985 FORMAT "%8.5" ECU_ADDRESS 0x7FDF20 /end MEASUREMENT
/begin MEASUREMENT mifa "indiziertes Motormoment Fahrerwunsch" UBYTE rel_ub_b99p6 1 100 0 99.6094 FORMAT "%5.2" ECU_ADDRESS 0x7FDA67 /end MEASUREMENT
/begin MEASUREMENT mifab_w "Begrenztes indiziertes Fahrerwunschmoment" UWORD rel_uw_b100 1 100 0 99.9985 FORMAT "%8.5" ECU_ADDRESS 0x7FDF22 /end MEASUREMENT
/begin MEASUREMENT mifafu_w "Fahrermomentenwunsch f¸r F¸llung" UWORD rel_uw_b100 1 100 0 99.9985 FORMAT "%8.5" ECU_ADDRESS 0x7FDF42 /end MEASUREMENT
/begin MEASUREMENT mifag_w "" UWORD rel_uw_b100 1 100 0 99.9985 FORMAT "%8.5" ECU_ADDRESS 0x7FBCF2 /end MEASUREMENT
/begin MEASUREMENT mifal_w "Indiziertes Fahrerwunschmoment f¸r Momentenkoordination F¸llung" UWORD rel_uw_b100 1 100 0 99.9985 FORMAT "%8.5" ECU_ADDRESS 0x7FDECE /end MEASUREMENT
/begin MEASUREMENT migef_w "Gefiltertes indiziertes Fahrerwunschmoment" UWORD rel_uw_b100 1 100 0 99.9985 FORMAT "%8.5" ECU_ADDRESS 0x7FDED0 /end MEASUREMENT
/begin MEASUREMENT miges_w "Indiziertes Soll-Motormoment f¸r Getriebeschutz" UWORD rel_uw_b100 1 100 0 99.9985 FORMAT "%8.5" ECU_ADDRESS 0x7FDF0E /end MEASUREMENT
/begin MEASUREMENT miinmfs_w "" SWORD rel_sw_b100 1 100 -100 99.9969 FORMAT "%8.4" ECU_ADDRESS 0x7FDF36 /end MEASUREMENT
/begin MEASUREMENT mil1_w "ind. Moment aus MINMAX-Auswahl" UWORD rel_uw_b100 1 100 0 99.9985 FORMAT "%8.5" ECU_ADDRESS 0x7FDED2 /end MEASUREMENT
/begin MEASUREMENT mil2_w "ind. Moment aus MINMAX-Auswahl" UWORD rel_uw_b100 1 100 0 99.9985 FORMAT "%8.5" ECU_ADDRESS 0x7FDED4 /end MEASUREMENT
/begin MEASUREMENT mil3_w "ind. Moment aus MINMAX-Auswahl" UWORD rel_uw_b100 1 100 0 99.9985 FORMAT "%8.5" ECU_ADDRESS 0x7FDED6 /end MEASUREMENT
/begin MEASUREMENT mill_w "Indiziertes Motormoment im Leerlauf" UWORD rel_uw_b100 1 100 0 99.9985 FORMAT "%8.5" ECU_ADDRESS 0x7FDE66 /end MEASUREMENT
/begin MEASUREMENT milres_w "Momentenanforderung f¸r Luftpfad mit allen Reserven" UWORD rel_uw_b100 1 100 0 99.9985 FORMAT "%8.5" ECU_ADDRESS 0x7FDF44 /end MEASUREMENT
/begin MEASUREMENT milsol_w "Fahrermomentenwunsch f¸r F¸llung" UWORD rel_uw_b100 1 100 0 99.9985 FORMAT "%8.5" ECU_ADDRESS 0x7FDF46 /end MEASUREMENT
/begin MEASUREMENT mimas_w "" UWORD rel_uw_b100 1 100 0 99.9985 FORMAT "%8.5" ECU_ADDRESS 0x7FDF2E /end MEASUREMENT
/begin MEASUREMENT mimax_w "maximal erreichbares indiziertes Moment" UWORD rel_uw_b100 1 100 0 99.9985 FORMAT "%8.5" ECU_ADDRESS 0x7FDF48 /end MEASUREMENT
/begin MEASUREMENT mimin_w "Minimales Motor-Moment" UWORD rel_uw_b100 1 100 0 99.9985 FORMAT "%8.5" ECU_ADDRESS 0x7FDE68 /end MEASUREMENT
/begin MEASUREMENT mimxl1_w "Maximales optimales Moment bei Lambda = 1" UWORD rel_uw_b100 1 100 0 99.9985 FORMAT "%8.5" ECU_ADDRESS 0x7FDF4A /end MEASUREMENT
/begin MEASUREMENT minbeg_w "Indiziertes Fahrerwunschmoment nach ƒnderungsbegrenzung" UWORD rel_uw_b100 1 100 0 99.9985 FORMAT "%8.5" ECU_ADDRESS 0x7FDED8 /end MEASUREMENT
/begin MEASUREMENT minmfs_w "" UWORD rel_uw_b100 1 100 0 99.9985 FORMAT "%8.5" ECU_ADDRESS 0x7FDF38 /end MEASUREMENT
/begin MEASUREMENT mioptl1_w "optimales indiziertes Motormoment bei Lambda = 1" UWORD rel_uw_b100 1 100 0 99.9985 FORMAT "%8.5" ECU_ADDRESS 0x7FDEAA /end MEASUREMENT
/begin MEASUREMENT mioptugd_w "optimales indiziertes Moment ungedrosselt" UWORD rel_uw_b100 1 100 0 99.9985 FORMAT "%8.5" ECU_ADDRESS 0x7FDEAC /end MEASUREMENT
/begin MEASUREMENT miopt_w "optimales indiziertes Moment" UWORD rel_uw_b100 1 100 0 99.9985 FORMAT "%8.5" ECU_ADDRESS 0x7FDEAE /end MEASUREMENT
/begin MEASUREMENT mipmfs_w "" SWORD rel_sw_b100 1 100 -100 99.9969 FORMAT "%8.4" ECU_ADDRESS 0x7FDF3A /end MEASUREMENT
/begin MEASUREMENT mirfa_w "Maximum of driver indicated and starting torque" UWORD rel_uw_b200 1 100 0 199.997 FORMAT "%8.4" ECU_ADDRESS 0x7FDEDA /end MEASUREMENT
/begin MEASUREMENT misolv_w "Indiziertes resultierendes Sollmoment vor Momentenbegrenzung" UWORD rel_uw_b100 1 100 0 99.9985 FORMAT "%8.5" ECU_ADDRESS 0x7FDF24 /end MEASUREMENT
/begin MEASUREMENT misol_w "Indiziertes resultierendes Sollmoment" UWORD rel_uw_b100 1 100 0 99.9985 FORMAT "%8.5" ECU_ADDRESS 0x7FBCF4 /end MEASUREMENT
/begin MEASUREMENT misopl1_w "Solluftmoment, r¸ckgerechnet auf Lambda=1 und zwopt" UWORD rel_uw_b100 1 100 0 99.9985 FORMAT "%8.5" ECU_ADDRESS 0x7FDC64 /end MEASUREMENT
/begin MEASUREMENT mivbeb_w "Indiziertes Moment vor ƒnderungsbegrenzung, nach oben auf mimax_w begrenzt" UWORD rel_uw_b100 1 100 0 99.9985 FORMAT "%8.5" ECU_ADDRESS 0x7FDEDC /end MEASUREMENT
/begin MEASUREMENT mivbeg_w "inidziertes Fahrerwunschmoment vor ƒnderungsbegrenzung" UWORD rel_uw_b100 1 100 0 99.9985 FORMAT "%8.5" ECU_ADDRESS 0x7FDEDE /end MEASUREMENT
/begin MEASUREMENT miwped_w "Driver demanded optimal torque at lambda = 1" UWORD rel_uw_b100 1 100 0 99.9985 FORMAT "%8.5" ECU_ADDRESS 0x7FDEE0 /end MEASUREMENT
/begin MEASUREMENT mizsolv_w "Indiziertes resultierendes Sollmoment f¸r ZW-Eingriff vor Momentenbegrenzung" UWORD rel_uw_b100 1 100 0 99.9985 FORMAT "%8.5" ECU_ADDRESS 0x7FDF26 /end MEASUREMENT
/begin MEASUREMENT mizsol_w "Indiziertes resultierendes Sollmoment f¸r ZW-Eingriff" UWORD rel_uw_b100 1 100 0 99.9985 FORMAT "%8.5" ECU_ADDRESS 0x7FDF28 /end MEASUREMENT
/begin MEASUREMENT mizwmn_w "indiziertes Motormoment beim sp‰testen Z¸ndwinkel" UWORD rel_uw_b100 1 100 0 99.9985 FORMAT "%8.5" ECU_ADDRESS 0x7FDF4E /end MEASUREMENT
/begin MEASUREMENT mi_mr_w "ind. Moment in rel. Moment" UWORD rel_uw_b200 1 100 0 199.997 FORMAT "%8.4" ECU_ADDRESS 0x7FDEE2 /end MEASUREMENT
/begin MEASUREMENT mkfanb_w "Kupplungsmoment aus begrenztem Fahrerwunsch" SWORD rel_sw_b100 1 100 -100 99.9969 FORMAT "%8.4" ECU_ADDRESS 0x7FDEE4 /end MEASUREMENT
/begin MEASUREMENT mlnka_w "Luftmasse nach Kat-Ausr‰umen" UWORD m_uw_b7281 1 100 0 7281.67 FORMAT "%8.3" ECU_ADDRESS 0x7FDFF4 /end MEASUREMENT
/begin MEASUREMENT mpnmfs_w "" SWORD rel_sw_b100 1 100 -100 99.9969 FORMAT "%8.4" ECU_ADDRESS 0x7FDF3C /end MEASUREMENT
/begin MEASUREMENT mppmfs_w "" SWORD rel_sw_b100 1 100 -100 99.9969 FORMAT "%8.4" ECU_ADDRESS 0x7FDF3E /end MEASUREMENT
/begin MEASUREMENT mrfamx_w "Relatives Fahrerwunschmoment Maximalwert" UWORD rel_uw_b200 1 100 0 199.997 FORMAT "%8.4" ECU_ADDRESS 0x7FDEE6 /end MEASUREMENT
/begin MEASUREMENT mrfav_w "Relatives Fahrerwunschmoment vor Ber¸cksichtigung Notfahren" UWORD rel_uw_b200 1 100 0 199.997 FORMAT "%8.4" ECU_ADDRESS 0x7FDEE8 /end MEASUREMENT
/begin MEASUREMENT mrfa_w "Relatives Fahrerwunschmoment aus FGR und Pedal" UWORD rel_uw_b200 1 100 0 199.997 FORMAT "%8.4" ECU_ADDRESS 0x7FDEEA /end MEASUREMENT
/begin MEASUREMENT mrfuemx_w "max. erreichbares rel. Fahrerwunschmoment f¸r Pedal¸berweg" UWORD rel_uw_b200 1 100 0 199.997 FORMAT "%8.4" ECU_ADDRESS 0x7FDEEC /end MEASUREMENT
/begin MEASUREMENT mrfue_w "Relatives Fahrerwunschmoment im Pedal¸berweg" UWORD rel_uw_b200 1 100 0 199.997 FORMAT "%8.4" ECU_ADDRESS 0x7FDEEE /end MEASUREMENT
/begin MEASUREMENT mrpedv_w "relatives Fahrerwunschmoment aus Fahrpedalkennfeld" UWORD rel_uw_b200 1 100 0 199.997 FORMAT "%8.4" ECU_ADDRESS 0x7FDEF0 /end MEASUREMENT
/begin MEASUREMENT mrped_w "relatives Fahrerwunschmoment aus Fahrpedal" UWORD rel_uw_b200 1 100 0 199.997 FORMAT "%8.4" ECU_ADDRESS 0x7FDEF2 /end MEASUREMENT
/begin MEASUREMENT Nerzerk "nicht erzeugt und erkannt" UWORD dez 1 100 0 65535 FORMAT "%8.2" ECU_ADDRESS 0x7FE202 /end MEASUREMENT
/begin MEASUREMENT nghgs_w "gefilterter Drehzahlgradient" SWORD nmotg_sw_q0p39 1 100 -12800.2 12799.8 FORMAT "%8.2" ECU_ADDRESS 0x7FDF10 /end MEASUREMENT
/begin MEASUREMENT Ngradlur "" UWORD nmot_uw_q0p25 1 100 0 16383.8 FORMAT "%8.2" ECU_ADDRESS 0x7FE204 /end MEASUREMENT
/begin MEASUREMENT nmdkog_w "" UWORD nmot_uw_q0p25 1 100 0 16383.8 FORMAT "%8.2" ECU_ADDRESS 0x7FDF2A /end MEASUREMENT
/begin MEASUREMENT nstatfak "" UWORD fak_uw_b8 1 100 0 7.99988 FORMAT "%8.6" ECU_ADDRESS 0x7FE16A /end MEASUREMENT
/begin MEASUREMENT ntnmot_w "" UWORD fak_uw_b4 1 100 0 3.99994 FORMAT "%8.6" ECU_ADDRESS 0x7FDEF4 /end MEASUREMENT
/begin MEASUREMENT nwem_fak "" UWORD fak_uw_b8 1 100 0 7.99988 FORMAT "%8.6" ECU_ADDRESS 0x7FE16C /end MEASUREMENT
/begin MEASUREMENT percnt_w "Z‰hler 10-ms-Schritte f¸r fr-synchrone lamsolh-Mittelung" UWORD dez 1 100 0 65535 FORMAT "%8.2" ECU_ADDRESS 0x7FDFF6 /end MEASUREMENT
/begin MEASUREMENT ptv "" SBYTE t100msxs_sb_q0p01 1 100 -1.28 1.27 FORMAT "%5.3" ECU_ADDRESS 0x7FDA98 /end MEASUREMENT
/begin MEASUREMENT redhyst "Reduzierstufenhysterese" SBYTE fak_sb_b2 1 100 -2 1.98438 FORMAT "%5.3" ECU_ADDRESS 0x7FDA6D /end MEASUREMENT
/begin MEASUREMENT redneu "neu berechnete Reduzierstufe" UBYTE dez 1 100 0 255 FORMAT "%5.1" ECU_ADDRESS 0x7FDA6E /end MEASUREMENT
/begin MEASUREMENT redsol "Berechnete Soll-Reduzierstufe" UBYTE dez 1 100 0 255 FORMAT "%5.1" ECU_ADDRESS 0x7FDA6F /end MEASUREMENT
/begin MEASUREMENT redze "Schwelle in Reduzierstufe zwischen Z¸nd- und Einspritzeingriff" UBYTE dez 1 100 0 255 FORMAT "%5.1" ECU_ADDRESS 0x7FDA70 /end MEASUREMENT
/begin MEASUREMENT redzst_w "Reduzierstufe ohne Hysterese und Rundung" UWORD fak_uw_q0p001 1 100 0 65.535 FORMAT "%8.5" ECU_ADDRESS 0x7FDF50 /end MEASUREMENT
/begin MEASUREMENT rka2_w "Additive adaptive Korrektur der relativen Kraftstoffmasse" SWORD rel_sw_b1536 1 100 -1536 1535.95 FORMAT "%8.3" ECU_ADDRESS 0x7FDD2A /end MEASUREMENT
/begin MEASUREMENT rkat2_w "additive Gemischkorrektur (pro Zeit) der Gemischadaption Bank 2 (Word)" SWORD rel_sw_b1536 1 100 -1536 1535.95 FORMAT "%8.3" ECU_ADDRESS 0x7F9BD8 /end MEASUREMENT
/begin MEASUREMENT rkat_w "additive Gemischkorrektur (pro Zeit) der Gemischdaption (Word)" SWORD rel_sw_b1536 1 100 -1536 1535.95 FORMAT "%8.3" ECU_ADDRESS 0x7F9BDA /end MEASUREMENT
/begin MEASUREMENT rkaz2_w "additive Gemischkorrektur (pro Z¸ndung) der Gemischadaption Bank2 (Word)" SWORD rel_sw_b1536 1 100 -1536 1535.95 FORMAT "%8.3" ECU_ADDRESS 0x7F9BDC /end MEASUREMENT
/begin MEASUREMENT rkaz_w "additive Gemischkorrektur (pro Z¸ndung) der Gemischadaption" SWORD rel_sw_b1536 1 100 -1536 1535.95 FORMAT "%8.3" ECU_ADDRESS 0x7F9BDE /end MEASUREMENT
/begin MEASUREMENT rka_w "Additive adaptive Korrektur der relativen Kraftstoffmasse" SWORD rel_sw_b1536 1 100 -1536 1535.95 FORMAT "%8.3" ECU_ADDRESS 0x7FDD2C /end MEASUREMENT
/begin MEASUREMENT rlmin_w "minimal zul‰ssiges rl" UWORD rel_uw_q0p0234 1 100 0 1535.98 FORMAT "%8.3" ECU_ADDRESS 0x7FDC66 /end MEASUREMENT
/begin MEASUREMENT rlsol_w "Soll-F¸llung" UWORD rel_uw_q0p0234 1 100 0 1535.98 FORMAT "%8.3" ECU_ADDRESS 0x7FDC68 /end MEASUREMENT
/begin MEASUREMENT rlugd_w "F¸llung im ungedrosselten Zustand" UWORD rel_uw_q0p0234 1 100 0 1535.98 FORMAT "%8.3" ECU_ADDRESS 0x7FDF4C /end MEASUREMENT
/begin MEASUREMENT rlvugd "unkorrigierte F¸llung im ungedrosselten Zustand" UBYTE rel_ub_q0p75 1 100 0 191.25 FORMAT "%5.1" ECU_ADDRESS 0x7FDA6B /end MEASUREMENT
/begin MEASUREMENT rl_kge "" UBYTE rel_ub_q0p75 1 100 0 191.25 FORMAT "%5.1" ECU_ADDRESS 0x7FBCDB /end MEASUREMENT
/begin MEASUREMENT rl_w_kge "Eingang relative F¸llung (Word) f¸r mehrfach verwendete Kenngr." UWORD rel_uw_q0p0234 1 100 0 1535.98 FORMAT "%8.3" ECU_ADDRESS 0x7FDEB0 /end MEASUREMENT
/begin MEASUREMENT snmta "St¸tzstellenkorrektur von nmot" UBYTE nmot_ub_q40 1 100 0 10200 FORMAT "%5.0" ECU_ADDRESS 0x7FDA6C /end MEASUREMENT
/begin MEASUREMENT sst_rlwped "" ULONG dez 1 100 0 4.29497e+009 FORMAT "%13.2" ECU_ADDRESS 0x7FE4A8 /end MEASUREMENT
/begin MEASUREMENT St_ausble "Status Ausblendung" UBYTE dez 1 100 0 255 FORMAT "%5.1" ECU_ADDRESS 0x7FD874 /end MEASUREMENT
/begin MEASUREMENT St_lur "Status Laufunruhe" UBYTE dez 1 100 0 255 FORMAT "%5.1" ECU_ADDRESS 0x7FD875 /end MEASUREMENT
/begin MEASUREMENT S_dp "Schalter Dashpot (1=ein)" UBYTE B_TRUE 1 100 0 1 BIT_MASK 0x1 FORMAT "%13.11" ECU_ADDRESS 0x7FBB4E /end MEASUREMENT
/begin MEASUREMENT S_ls "Schalter Lastschlagd‰mpfung (1=ein)" UBYTE B_TRUE 1 100 0 1 BIT_MASK 0x1 FORMAT "%13.11" ECU_ADDRESS 0x7FBB4F /end MEASUREMENT
/begin MEASUREMENT tansst "Ansaugluft - Temperatur bei start" UBYTE temp_ub_q0p75_o48 1 100 -48 143.25 FORMAT "%5.1" ECU_ADDRESS 0x7FD75C /end MEASUREMENT
/begin MEASUREMENT tfrn2_w "" UWORD t10msxs_uw_b655p35 1 100 0 655.35 FORMAT "%8.4" ECU_ADDRESS 0x7FDFCC /end MEASUREMENT
/begin MEASUREMENT tfrnint2_w "" UWORD t10msxs_uw_b655p35 1 100 0 655.35 FORMAT "%8.4" ECU_ADDRESS 0x7FDFCE /end MEASUREMENT
/begin MEASUREMENT tfrnint_w "" UWORD t10msxs_uw_b655p35 1 100 0 655.35 FORMAT "%8.4" ECU_ADDRESS 0x7FDFD0 /end MEASUREMENT
/begin MEASUREMENT tfrn_w "" UWORD t10msxs_uw_b655p35 1 100 0 655.35 FORMAT "%8.4" ECU_ADDRESS 0x7FDFD2 /end MEASUREMENT
/begin MEASUREMENT tfrp2_w "" UWORD t10msxs_uw_b655p35 1 100 0 655.35 FORMAT "%8.4" ECU_ADDRESS 0x7FDFD4 /end MEASUREMENT
/begin MEASUREMENT tfrpint2_w "" UWORD t10msxs_uw_b655p35 1 100 0 655.35 FORMAT "%8.4" ECU_ADDRESS 0x7FDFD6 /end MEASUREMENT
/begin MEASUREMENT tfrpint_w "" UWORD t10msxs_uw_b655p35 1 100 0 655.35 FORMAT "%8.4" ECU_ADDRESS 0x7FDFD8 /end MEASUREMENT
/begin MEASUREMENT tfrp_w "" UWORD t10msxs_uw_b655p35 1 100 0 655.35 FORMAT "%8.4" ECU_ADDRESS 0x7FDFDA /end MEASUREMENT
/begin MEASUREMENT Timer_start "" UWORD dez 1 100 0 65535 FORMAT "%8.2" ECU_ADDRESS 0x7FE206 /end MEASUREMENT
/begin MEASUREMENT tkatms2_w "" UWORD temp_uw_q0p0195_o50 1 100 -50 1229.98 FORMAT "%8.3" ECU_ADDRESS 0x7FD760 /end MEASUREMENT
/begin MEASUREMENT tkatms_w "" UWORD temp_uw_q0p0195_o50 1 100 -50 1229.98 FORMAT "%8.3" ECU_ADDRESS 0x7FD762 /end MEASUREMENT
/begin MEASUREMENT tplrvk2_w "Periodendauerwert Rohwert der Sonde vor Kat, ermittelt in %LR, Bank 2" UWORD t10msxs_uw_b655p35 1 100 0 655.35 FORMAT "%8.4" ECU_ADDRESS 0x7FDFDC /end MEASUREMENT
/begin MEASUREMENT tplrvk_w "Periodendauerwert Rohwert der Sonde vor Kat, ermittelt in %LR" UWORD t10msxs_uw_b655p35 1 100 0 655.35 FORMAT "%8.4" ECU_ADDRESS 0x7FDFDE /end MEASUREMENT
/begin MEASUREMENT tsaka "Timer Schubdauer f¸r Katalysator-Ausr‰umen" UBYTE t20msxs_ub_b5p1 1 100 0 5.1 FORMAT "%5.3" ECU_ADDRESS 0x7FDAA7 /end MEASUREMENT
/begin MEASUREMENT tsaka2 "" UBYTE t20msxs_ub_b5p1 1 100 0 5.1 FORMAT "%5.3" ECU_ADDRESS 0x7FDAA8 /end MEASUREMENT
/begin MEASUREMENT Tseg " Array mit den 8 aktuellsten Segmentzeiten" UWORD ta_diag 1 100 0 65535 FORMAT "%8.2" ARRAY_SIZE 8 ECU_ADDRESS 0x7FE208 /end MEASUREMENT
/begin MEASUREMENT Tseg_ptr "Zeiger auf aktuelle Segmentzeit in Tseg" UBYTE dez 1 100 0 255 FORMAT "%5.1" ECU_ADDRESS 0x7FD876 /end MEASUREMENT
/begin MEASUREMENT tsperr "" UBYTE t10msxs_ub_b2p55 1 100 0 2.55 FORMAT "%5.3" ECU_ADDRESS 0x7FDA8B /end MEASUREMENT
/begin MEASUREMENT tsperr2 "" UBYTE t10msxs_ub_b2p55 1 100 0 2.55 FORMAT "%5.3" ECU_ADDRESS 0x7FDA8C /end MEASUREMENT
/begin MEASUREMENT tv "" SBYTE t10msxs_sb_q0p01 1 100 -1.28 1.27 FORMAT "%5.3" ECU_ADDRESS 0x7FDA8D /end MEASUREMENT
/begin MEASUREMENT tv2 "" SBYTE t10msxs_sb_q0p01 1 100 -1.28 1.27 FORMAT "%5.3" ECU_ADDRESS 0x7FDA8E /end MEASUREMENT
/begin MEASUREMENT tvlr "" SBYTE t10msxs_sb_q0p01 1 100 -1.28 1.27 FORMAT "%5.3" ECU_ADDRESS 0x7FDA8F /end MEASUREMENT
/begin MEASUREMENT tvlr2 "" SBYTE t10msxs_sb_q0p01 1 100 -1.28 1.27 FORMAT "%5.3" ECU_ADDRESS 0x7FDA90 /end MEASUREMENT
/begin MEASUREMENT tvlrh "" SBYTE t100msxs_sb_q0p01 1 100 -1.28 1.27 FORMAT "%5.3" ECU_ADDRESS 0x7FDA99 /end MEASUREMENT
/begin MEASUREMENT tvlrh2 "" SBYTE t100msxs_sb_q0p01 1 100 -1.28 1.27 FORMAT "%5.3" ECU_ADDRESS 0x7FDA9A /end MEASUREMENT
/begin MEASUREMENT tvlrhi "" SBYTE t100msxs_sb_q0p01 1 100 -1.28 1.27 FORMAT "%5.3" ECU_ADDRESS 0x7FDA9B /end MEASUREMENT
/begin MEASUREMENT tvlrhi2 "" SBYTE t100msxs_sb_q0p01 1 100 -1.28 1.27 FORMAT "%5.3" ECU_ADDRESS 0x7FDA9C /end MEASUREMENT
/begin MEASUREMENT tvlrhp "" SBYTE t100msxs_sb_q0p01 1 100 -1.28 1.27 FORMAT "%5.3" ECU_ADDRESS 0x7FDA9D /end MEASUREMENT
/begin MEASUREMENT T_kwalt " 5.Element von T_kwseg[4]" UWORD dez 1 100 0 65535 FORMAT "%8.2" ECU_ADDRESS 0x7FE218 /end MEASUREMENT
/begin MEASUREMENT T_kwseglur "" UWORD ta_diag 1 100 0 65535 FORMAT "%8.2" ARRAY_SIZE 4 ECU_ADDRESS 0x7FE21A /end MEASUREMENT
/begin MEASUREMENT usrhk "aktuelle Regelschwelle Lambdasignal h.K." UBYTE spg_ub_q0p0052_o0p2 1 100 -0.2 1.13 FORMAT "%5.3" ECU_ADDRESS 0x7FDA9E /end MEASUREMENT
/begin MEASUREMENT usrhk2 "aktuelle Regelschwelle Lambdasignal h.K., Bank 2" UBYTE spg_ub_q0p0052_o0p2 1 100 -0.2 1.13 FORMAT "%5.3" ECU_ADDRESS 0x7FDA9F /end MEASUREMENT
/begin MEASUREMENT wpfgruf_w "" UWORD rel_uw_b100 1 100 0 99.9985 FORMAT "%8.5" ECU_ADDRESS 0x7FDEF6 /end MEASUREMENT
/begin MEASUREMENT wpfgr_w "R¸ckgerechneter Pedalwert bei FGR-Betrieb" UWORD rel_uw_b100 1 100 0 99.9985 FORMAT "%8.5" ECU_ADDRESS 0x7FDEF8 /end MEASUREMENT
/begin MEASUREMENT Xsa "mom. Ad-Wert" SBYTE lur_xsa 1 100 -100.781 -99.2249 FORMAT "%5.1" ECU_ADDRESS 0x7FD877 /end MEASUREMENT
/begin MEASUREMENT zatv "" UBYTE tgrad_ub_q0p039 1 100 0 9.96094 FORMAT "%5.3" ECU_ADDRESS 0x7FDAA0 /end MEASUREMENT
/begin MEASUREMENT zdashvfmk "" UWORD zk10msxs_uw_b655 1 100 0.0100002 655.36 FORMAT "%10.6" ECU_ADDRESS 0x7FDEFA /end MEASUREMENT
/begin MEASUREMENT zdash_w "Zeitkonstante Dashpot" UWORD zk10msxs_uw_b655 1 100 0.0100002 655.36 FORMAT "%10.6" ECU_ADDRESS 0x7FDEFC /end MEASUREMENT
/begin MEASUREMENT zlsddvz "" UWORD t10msxs_uw_q0p001 1 100 0.001 65.535 FORMAT "%8.5" ECU_ADDRESS 0x7FDEFE /end MEASUREMENT
/begin MEASUREMENT zlsdr_w "" UWORD zk10msxs_uw_b655 1 100 0.0100002 655.36 FORMAT "%10.6" ECU_ADDRESS 0x7FDF00 /end MEASUREMENT
/begin MEASUREMENT zlsdvfmk "" UWORD zk10msxs_uw_b655 1 100 0.0100002 655.36 FORMAT "%10.6" ECU_ADDRESS 0x7FDF02 /end MEASUREMENT
/begin MEASUREMENT zlsd_w "Zeitkonstante PT2-Filter Lastschlagd‰mpfung" UWORD zk10msxs_uw_b655 1 100 0.0100002 655.36 FORMAT "%10.6" ECU_ADDRESS 0x7FDF04 /end MEASUREMENT
/begin MEASUREMENT zwopt "optimaler Z¸ndwinkel" SBYTE zw_sb_q0p75 1 100 -96 95.25 FORMAT "%5.2" ECU_ADDRESS 0x7FDA64 /end MEASUREMENT
/begin MEASUREMENT zwoptl1 "optimaler Z¸ndwinkel bei Lambda=1" SBYTE zw_sb_q0p75 1 100 -96 95.25 FORMAT "%5.2" ECU_ADDRESS 0x7FDA65 /end MEASUREMENT
/begin FUNCTION LLRRM "Leerlaufregelung Reglereingriff Drehmoment"
 /begin DEF_CHARACTERISTIC DMLLRIMXN DMLLRMN DMLLRMXN DMLLRZMN DMLLRZMXN DNMNI DVNG DVNGV DVZNG DVZNGT DVZNGV DVZNGVT FDDN FDDZN FDDZNT IVDN IVDNT IVDNTV IVDNV LIMN LIMNDLLR LIMNDTES LIMNV LIMX LIMXV LISTM LISTMT LLRICNF NDSU PVDN PVDNT PVDNTV PVDNV PVDNVZ PVDNVZT PVDNZ PVDNZT SDN08LLSW SDN08LLTSW TVLISTUM TVLISTUMT ZKLLRD ZKLLRDZ ZLIBG /end DEF_CHARACTERISTIC
 /begin REF_CHARACTERISTIC SNG06LLSB SNG06LLTSB SNM06LLUB SNS06LLSB SNS06LLTSB STM06LLTUB STM06LLUB /end REF_CHARACTERISTIC
 /begin IN_MEASUREMENT B_dllr B_dtes B_gd B_llr B_llrein B_llri B_llrpd B_mdmin B_nswo1 B_st B_stend B_vllr dns dpsfak esst_sng06llsb esst_sng06lltsb esst_snm06llub esst_sns06llsb esst_sns06lltsb esst_stm06lltub esst_stm06llub ngfil nmot nmot_w nsol tmot /end IN_MEASUREMENT
 /begin OUT_MEASUREMENT dmllri_w dmllrz_w dmllr_w dn dn_w esst_sdn08llsw esst_sdn08lltsw limax_w limin_w /end OUT_MEASUREMENT
 /begin LOC_MEASUREMENT B_llrimx dmllrdz_w dmllrd_w dmllrpz_w dmllrp_w limnst /end LOC_MEASUREMENT
 /begin SUB_FUNCTION /end SUB_FUNCTION
/end FUNCTION
/begin FUNCTION LR ""
 /begin DEF_CHARACTERISTIC CFRA DFRMN DFRSPS FFRITMS FLRFKATE FLRM FRIPDSL1 FRIPDSL4 FRIPDTES FRIPTES FRMAX FRMINSLS FRMINSLSK FRTEMX KFFRMIN KFRI KFRI2 KFRP KFRP2 KFRTV KFRTV2 QUFRMN QUFRMX TSPERN TSPERN2 USR ZDFR ZLRFRI /end DEF_CHARACTERISTIC
 /begin REF_CHARACTERISTIC SNM07LRUB SRL06LRUB /end REF_CHARACTERISTIC
 /begin IN_MEASUREMENT B_adpini B_atmtpa B_atmtpa2 B_dktlp B_dsl1 B_dsl4 B_dslme B_dtefrr B_dtes B_dtest B_fasls B_frini B_frini2 B_ll B_lrnd B_lrnd2 B_te B_tehbx dtvka dtvka2 esst_snm07lrub esst_srl06lrub falrdkt fkatei frini2_w frini_w nmot rl tmotzyl_w tmstzyl_w tnst_w tvlrh tvlrh2 tvlrhi tvlrhi2 usvk usvk2 /end IN_MEASUREMENT
 /begin OUT_MEASUREMENT B_dfrf B_dfrf2 B_dfrm B_dfrm2 B_frab B_frab2 B_frmax B_frmax2 B_frmin B_frmin2 B_lrsp B_lrsp2 B_lrstat B_lrstat2 B_lrstta B_lrstta2 B_lrtpp B_lrtpp2 B_sgnlr B_sgnlr2 dfrsp2_w dfrsp_w dfrst2_w dfrst_w fr2_w frm2_w frmn2_w frmn_w frmx2_w frmx_w frm_w fr_w tfrn2_w tfrn_w tplrvk2_w tplrvk_w /end OUT_MEASUREMENT
 /begin LOC_MEASUREMENT B_frmini B_frmini2 B_frsp B_frsp2 B_inifrm B_inifrm2 B_int B_int2 B_sgnalt B_sgnalt2 B_sgnra B_sgnra2 B_tsper B_tsper2 B_tspon B_tspon2 dfrstga2_w dfrstga_w dfrstte2_w dfrstte_w ffri ffri2 ffrip_w frband2_w frband_w fri fri2 friband2_w friband_w friint friint2 frint2_w frint_w frp frp2 frpint frpint2 frsp2_w frsp_w frtv frtv2 lrfrmz lrfrmz2 lrfrz lrfrz2 tfrnint2_w tfrnint_w tfrp2_w tfrpint2_w tfrpint_w tfrp_w tsperr tsperr2 tv tv2 tvlr tvlr2 /end LOC_MEASUREMENT
 /begin SUB_FUNCTION /end SUB_FUNCTION
/end FUNCTION
/begin FUNCTION LRA "Adaptive Vorsteuerung f¸r Lambdaregelung"
 /begin DEF_CHARACTERISTIC CW_LRAST FRAOMN FRAOMX FRAORN FRAORX FRAUMN FRAUMX FRAURN FRAURX MLO1 MLO2 MLO3 MLU2 MLU4 N0 NO1 NOLRA NRKAB NU3 RKATMN RKATMX RKATRN RKATRX RKAZMN RKAZMX RKAZRN RKAZRX RLO2 RLO3 RLU2 RLU3 RLU4 ZKFRAOA ZKFRAUA ZKRKATA ZKRKAZ /end DEF_CHARACTERISTIC
 /begin REF_CHARACTERISTIC /end REF_CHARACTERISTIC
 /begin IN_MEASUREMENT abo B_abor B_adpini B_edkvs B_edkvs2 B_fa B_fakvs B_lra B_lra2 B_lrar B_lsvvsp B_st frm2_w frm_w ml_w nmot rl /end IN_MEASUREMENT
 /begin OUT_MEASUREMENT B_frao B_fraor B_fraor2 B_frau B_fraur B_fraur2 B_lrare B_lrare2 B_nofra B_norkat B_norkaz B_rkat B_rkatr B_rkatr2 B_rkaz B_rkazr B_rkazr2 fra2_w frao2_w frao_w frau2_w frau_w fra_w rka2_w rkat2_w rkat_w rkaz2_w rkaz_w rka_w /end OUT_MEASUREMENT
 /begin LOC_MEASUREMENT B_lrareb dfrm2_w dfrm_w /end LOC_MEASUREMENT
 /begin SUB_FUNCTION /end SUB_FUNCTION
/end FUNCTION
/begin FUNCTION LRAEB "Einschaltbedingungen Gemischadaption" /begin DEF_CHARACTERISTIC CWLRATZYL CW_LRAFDSU CW_LRAFTA TARA TMRAA TVLRA WDKARN /end DEF_CHARACTERISTIC /begin REF_CHARACTERISTIC CW_TZYL /end REF_CHARACTERISTIC
 /begin IN_MEASUREMENT B_auakt B_dsls B_dslste B_dslve B_dtest B_esnws B_fa B_fakvs B_falra B_ffuerf B_ffuest B_fkvs B_flam B_fosb B_ftev B_gap B_lr B_lr2 B_mdarv B_sls B_slste B_te B_ukg B_vl E_akle E_dsu E_ph E_slv E_ta E_tm E_TZYL1 E_TZYL2 nmot tans tmotzyl_w wdkba /end IN_MEASUREMENT
 /begin OUT_MEASUREMENT B_gasp B_lra B_lra2 /end OUT_MEASUREMENT
 /begin LOC_MEASUREMENT /end LOC_MEASUREMENT
 /begin SUB_FUNCTION /end SUB_FUNCTION
/end FUNCTION
/begin FUNCTION LREB ""
 /begin DEF_CHARACTERISTIC CLRZWTMS CWLRFSLS CWLRSLS DTMR DTMTMRW IMLSALR NLRSHB RLLRSHB RLLRUN RLRAN RLRVAO TARAU TASHS TLRBAM TLRHS TLRTMS TLRVAM TLRZWTMS TMRA1 TMRA2 TMRAK TMSHS TRAB TRAU TSBBVTMS /end DEF_CHARACTERISTIC
 /begin REF_CHARACTERISTIC CLRKA STMZYL08LEUW USR /end REF_CHARACTERISTIC
 /begin IN_MEASUREMENT B_bag B_blkmd B_craus B_dsl B_dsls B_eeve B_esls B_evloc B_falr B_fosb B_kse B_ll B_lrka B_lrkast B_lrkast2 B_lsvvsp B_sa B_sbbvk B_sbbvk2 B_sls B_slsfz B_slsoff B_st B_stend B_temin B_temin2 B_vag esst_stmzyl08leuw E_HSSEKP E_HSSZDG fr2_w fr_w lamsons2_w lamsons_w ml_w nmot rl tans tmotlin tmotzyl_w tmrw tmstzyl_w usvk usvk2 /end IN_MEASUREMENT
 /begin OUT_MEASUREMENT B_eobdlr B_lr B_lr2 B_lr2s B_lr2s2 B_lrnd B_lrnd2 B_lrnda B_lrnda2 B_lrvk B_lrvk2 B_mlrsa B_nolrb B_nolrb2 B_nolre B_nolre2 B_nolrw B_nolrw2 B_tmlr flglrs flglrs2 /end OUT_MEASUREMENT
 /begin LOC_MEASUREMENT B_bvdel B_eobdlr2 B_fslr B_fslr2 B_lreb100 B_lreble B_lreble2 B_lrebpr B_lrebpr2 B_lrebri B_lrebri2 B_lrpspa B_lrrl B_lrwla B_msfslr B_msfslr2 B_mslr B_mslr2 B_pspaus B_pspwl B_tarau imlrsa_w tansst /end LOC_MEASUREMENT
 /begin SUB_FUNCTION /end SUB_FUNCTION
/end FUNCTION
/begin FUNCTION LRHK ""
 /begin DEF_CHARACTERISTIC ATVINI ATVINI2 ATVMN ATVMX CLRHK KDLASHKI KDLASHKP KFFTV KFUSHK LALIUSH LALIUSRH LASHKAB MLNKAX NLRHO NLRHU PLRHAV PLRHML RLLRHON RLLRHUN TBLRH TBLRH2 TKATMLRH TKATMLRH2 ZLASHKAB ZLASOHML ZLRHML /end DEF_CHARACTERISTIC
 /begin REF_CHARACTERISTIC SML08LHUB SNM06LHUB SNM08LHUB SRL06LHUB /end REF_CHARACTERISTIC
 /begin IN_MEASUREMENT avkatf avkatf2 B_adpini B_dsls B_edkvs B_edkvs2 B_lr B_lr2 B_lrka B_lrsp B_lrsp2 B_mdarv B_st B_tehb esst_sml08lhub esst_snm06lhub esst_snm08lhub esst_srl06lhub ml ml_w nmot rl tkatm ushk_w /end IN_MEASUREMENT
 /begin OUT_MEASUREMENT atv atv2 B_lrhk B_lrhk2 lamsolh_w lamsonh_w tvlrh tvlrh2 tvlrhi tvlrhi2 usrhk usrhk2 /end OUT_MEASUREMENT
 /begin LOC_MEASUREMENT atvinii B_atvini B_lrhkb B_lrhkg B_lrhkgi B_lrhkp dlahkab_w dlashki_w dlashkm_w dlashkp_w ftv iavkatf idlashkm_w lahkmz lamhf_w lamhm_w LRHKlokbits mlnka_w percnt_w ptv tvlrhp zatv /end LOC_MEASUREMENT
 /begin SUB_FUNCTION /end SUB_FUNCTION
/end FUNCTION
/begin FUNCTION LRINI "" /begin DEF_CHARACTERISTIC /end DEF_CHARACTERISTIC /begin REF_CHARACTERISTIC /end REF_CHARACTERISTIC /begin IN_MEASUREMENT B_dtefrr B_lrnd B_lrnd2 frdter_w /end IN_MEASUREMENT /begin OUT_MEASUREMENT B_frini B_frini2 frini2_w frini_w /end OUT_MEASUREMENT /begin LOC_MEASUREMENT /end LOC_MEASUREMENT /begin SUB_FUNCTION /end SUB_FUNCTION /end FUNCTION
/begin FUNCTION LRKA ""
 /begin DEF_CHARACTERISTIC CLRKA DTVKAML DTVKAML2 FFWEKA FKAXAVKAT FLMLKAMA FLMLKAMA2 FLMLKAPR FLMLKAPR2 FMLKAMA FMLKAMA2 ILMLKAXTK IMLAKMN IMLKAXTK LAMKAML LAMKAML2 NLRKA TDFRKAD TDFRKAU TSAKAMN TSAKAMN2 USVKAMX USVKAMX2 /end DEF_CHARACTERISTIC
 /begin REF_CHARACTERISTIC SML05LKUB /end REF_CHARACTERISTIC
 /begin IN_MEASUREMENT avkatf B_bevab B_bevab2 B_dslste B_sa B_sls B_slste esst_sml05lkub fwe lamsons2_w lamsons_w ml ml_w nmot tikatm2_w tikatm_w tkatm2_w tkatm_w usvk usvk2 /end IN_MEASUREMENT
 /begin OUT_MEASUREMENT B_ilmlkat B_ilmlkat2 B_lrka B_lrka2 B_lrkast B_lrkast2 dtvka dtvka2 ilmlkat2_w ilmlkat_w lamka2_w lamka_w /end OUT_MEASUREMENT
 /begin LOC_MEASUREMENT B_blrka B_blrka2 B_kawe B_kawe2 B_lrkaa B_lrkaa2 B_lrkae B_lrkae2 B_lrkaei B_lrkaei2 B_lrkaon B_lrkaon2 B_lrkarg B_lrkarg2 dtvkai dtvkai2 favkatmx ilmlka2_w ilmlkah2_w ilmlkah_w ilmlkam2_w ilmlkam_w ilmlkav2_w ilmlkav_w ilmlkax2_w ilmlkax_w ilmlka_w imlka2_w imlkav2_w imlkav_w imlkax2_w imlkax_w imlka_w lamkai2_w lamkaii2_w lamkaii_w lamkai_w lamsnka2_w lamsnka_w lrkaz lrkaz2 tkatms2_w tkatms_w tsaka tsaka2 /end LOC_MEASUREMENT
 /begin SUB_FUNCTION /end SUB_FUNCTION
/end FUNCTION
/begin FUNCTION LURSTOP "" /begin DEF_CHARACTERISTIC CW_FDSU CW_FSST2E CW_FTA /end DEF_CHARACTERISTIC /begin REF_CHARACTERISTIC /end REF_CHARACTERISTIC
 /begin IN_MEASUREMENT B_eeve B_kl15 B_MotorStp B_tal ES_kill E_akle E_dkp E_dkpa E_dsu E_ekpe E_frao E_frao2 E_frau E_frau2 E_frps E_frst E_frst2 E_HSSEKP E_HSSSYS E_HSSZDG E_kill E_llr E_lshvk1e E_lshvk2e E_lsv E_lsv2 E_ph E_rkat E_rkat2 E_rkaz E_rkaz2 E_sst2e E_stp1 E_stp2 E_ta E_tes E_teve E_u5vg1 E_u5vg3 E_ub /end IN_MEASUREMENT
 /begin OUT_MEASUREMENT B_ffuerf B_ffuerfse B_ffuest B_fkvs B_flam B_flamad B_fosb B_ftev B_lurstp /end OUT_MEASUREMENT
 /begin LOC_MEASUREMENT LURSTOPbits /end LOC_MEASUREMENT
 /begin SUB_FUNCTION /end SUB_FUNCTION
/end FUNCTION
/begin FUNCTION LUR_BMW ""
 /begin DEF_CHARACTERISTIC Ausble_en Ausble_init Dlurmx Dmde Dmdind Dnlumx Dtsbmx Fesa_gut Fiasa1 Fiasa2 Fifesa Filum Filut Ftssk Geradzyk Geratol KFLUR KFLURAB KLLUR KLLURAN Lu_mod Ngerad11 Ngerad12 Ngerad21 Ngerad22 Nlumn Nlumx Segklu SEGMENT_ZYL Segsazad T_keinlu Wllumn WLLURN /end DEF_CHARACTERISTIC
 /begin REF_CHARACTERISTIC /end REF_CHARACTERISTIC
 /begin IN_MEASUREMENT B_adpini B_ll B_lurstp B_nmin B_sa B_stend B_synph evz_austot miint_w nmot nmot_w rl rlroh_w Segakt tez_l Tkwlur tmot tnst_w /end IN_MEASUREMENT
 /begin OUT_MEASUREMENT Ad_stop_cnt Asa_word Ausble_cnt B_ad_gut B_gerad B_lu_aktiv B_lu_erlaubt B_lu_war_aktiv B_reset_lur B_sync_lu B_sync_zyl1 B_sync_zyl4 B_zyl1_erk B_zyl1_f B_zyl2_f B_zyl3_f B_zyl4_f Erznerk Erzuerk Fesa1 Fesa2 Fiasa Geradcnt Klu_cnt Lum Lur_alt Lut Lut_f Mdind_alt Nerzerk Ngradlur St_ausble St_lur Timer_start Tseg Tseg_ptr T_kwalt T_kwseglur Xsa /end OUT_MEASUREMENT
 /begin LOC_MEASUREMENT /end LOC_MEASUREMENT
 /begin SUB_FUNCTION /end SUB_FUNCTION
/end FUNCTION
/begin FUNCTION MDBAS "Berechnung der Basisgrˆﬂen f¸r Momentenschnittstelle"
 /begin DEF_CHARACTERISTIC CWETAZWBM CWMBAS DZW2DZWQ DZWOLA DZWOM ETALAM KFDZWAGR KFDZWKOEF KFDZWKOEFT KFETAGD KFMIOP KFZWOP KFZWOP2 KFZWOPLL KFZWOPLLT KLFWUELL SRL16OPUW ZKFZNWLL ZRL_W_KGE /end DEF_CHARACTERISTIC
 /begin REF_CHARACTERISTIC SNM16OPUW /end REF_CHARACTERISTIC
 /begin IN_MEASUREMENT agrr Asprl Asprlu B_agr B_ll B_st dpsfak dzwwl Esprl Esprlu esst_snm16opuw lambas nmot nmot_w rl rl_w tmot tmotzyl_w Vsa_spri Vse_spri wped_w zwbas /end IN_MEASUREMENT
 /begin OUT_MEASUREMENT dzwkoef dzwoag dzwol esst_srl16opuw etagd etalab etatrmn etazwb etazwbm mibas_w miopt_w rl_kge rl_w_kge zwopt zwoptl1 /end OUT_MEASUREMENT
 /begin LOC_MEASUREMENT Asprll dzwagr dzwb dzwotm Esprll fnwll fnwlleff fwuell fznwll mioptl1_w mioptugd_w /end LOC_MEASUREMENT
 /begin SUB_FUNCTION /end SUB_FUNCTION
/end FUNCTION
/begin FUNCTION MDFAW "Fahrerwunschmoment"
 /begin DEF_CHARACTERISTIC CWDMFAB CWDMFAB2 CW_FMKNUL DLSDHK DLSDWE DMDPUG DMIFSAWE DMLSDUG DMRFAV KFDLSD KFDMDPO KFDMLSDO KFFDMFBT KFFMKNULFS KFMIFALGD KFMIFALS KFMILSD KFMIMR KFMRMI KFPED KFWPFGR KFZDASH KFZLSD KFZLSDVZ KLFMKNUL KLTWEMEMO KLTWEMEMO2 KMIN MKLSDUGA MRFALLO MRFALLU MRFUEMXN NGFSAWE SMK06MDUW S_dmfbdpf TDMFBSA TDMFBWE TVDPSTEND TVFSAWE TWPFGR WPEDRL ZLSDHK ZLSDWE /end DEF_CHARACTERISTIC
 /begin REF_CHARACTERISTIC KFMIOP MDIMX SGA08MDUB SNM06MDUW SNM16OPUW SRL16OPUW S_mdversta /end REF_CHARACTERISTIC
 /begin IN_MEASUREMENT B_kuppl B_nmot B_sa B_sab B_savfgr B_stend B_vnull dmllri_w dmverl_w dpsfak dpssolgd_w dpssol_uw dpssol_w esst_sga08mdub esst_snm06mduw esst_snm16opuw esst_srl16opuw etalab etazwbm gangi kfdps_aus mdverb_w mdverl_w miasrl_w mibas_w mibgr_w mifa_w miges_w miist_w milsol_w mimax_w mimin_w mimxl1_w minmx_w mistt mivmx_w mizwmn_w mrfgr_w mrstt_w ngfil_w nmot_w nturbc_w nturbv_w rlwped_w rl_w_kge vfzg_w wped_w /end IN_MEASUREMENT
 /begin OUT_MEASUREMENT B_dash B_fgr B_fil B_ll B_lsd esst_smk06mduw fdmfbt fmil_w mifa mifal_w mivbeg_w mrfamx_w mrfav_w mrfa_w mrfuemx_w mrfue_w mrped_w ntnmot_w wpfgruf_w wpfgr_w /end OUT_MEASUREMENT
 /begin LOC_MEASUREMENT B_dp B_edp B_elsd B_iflsd B_ls B_wememo dlsd_w dmdpo_w dmdpu_w dmlsdo_w dmlsdu_w dpsfaktd etabas_w fmknul iwflsd_w k_alt k_neu mdverbfa_w mibdp_w miblsd_w migef_w mil1_w mil2_w mil3_w minbeg_w mirfa_w mivbeb_w miwped_w mi_mr_w mkfanb_w mrpedv_w sst_rlwped S_dp S_ls zdashvfmk zdash_w zlsddvz zlsdr_w zlsdvfmk zlsd_w /end LOC_MEASUREMENT
 /begin SUB_FUNCTION /end SUB_FUNCTION
/end FUNCTION
/begin FUNCTION MDFUE "Sollwertvorgabe f¸r Luftmasse aus Sollmoment" /begin DEF_CHARACTERISTIC FRLMNHO KFMIRL KFRLMN KFRLMNSA ZKDRLSOL /end DEF_CHARACTERISTIC /begin REF_CHARACTERISTIC SNM12FEUB STM04FEUB /end REF_CHARACTERISTIC
 /begin IN_MEASUREMENT B_sa esst_snm12feub esst_stm04feub etalab etazwbm fho milsol_w nmot nmot_w rlmax_w rltedte_w tmot /end IN_MEASUREMENT
 /begin OUT_MEASUREMENT B_mdmin drlsolf_w drlsol_w rlmin_w rlsol_w /end OUT_MEASUREMENT
 /begin LOC_MEASUREMENT misopl1_w /end LOC_MEASUREMENT
 /begin SUB_FUNCTION /end SUB_FUNCTION
/end FUNCTION
/begin FUNCTION MDIHGS "Momentenbegrenzung Gangabh‰ngig" /begin DEF_CHARACTERISTIC FMIHGN MDIAGMX MIHGSLG NGHGS ZMIBGR ZNGHGS /end DEF_CHARACTERISTIC /begin REF_CHARACTERISTIC MDIMX /end REF_CHARACTERISTIC
 /begin IN_MEASUREMENT B_autget B_gts gangi mifafu_w migs_w miint_w milsol_w ngas_w nmot /end IN_MEASUREMENT
 /begin OUT_MEASUREMENT B_hgsndy B_mibgr fmibgrv_w fmibgr_w mibgrv_w mibgr_w miges_w nghgs_w /end OUT_MEASUREMENT
 /begin LOC_MEASUREMENT /end LOC_MEASUREMENT
 /begin SUB_FUNCTION /end SUB_FUNCTION
/end FUNCTION
/begin FUNCTION MDIST "Motormomentenberechnung" /begin DEF_CHARACTERISTIC /end DEF_CHARACTERISTIC /begin REF_CHARACTERISTIC DZW2DZWQ MDNORM REDANZ /end REF_CHARACTERISTIC /begin IN_MEASUREMENT dzwkoef mdverl_w miist_w miopt_w redist zwist zwopt /end IN_MEASUREMENT /begin OUT_MEASUREMENT etazaist etazwist meist_w menist_w /end OUT_MEASUREMENT /begin LOC_MEASUREMENT dzwi mdindg_w /end LOC_MEASUREMENT /begin SUB_FUNCTION /end SUB_FUNCTION /end FUNCTION
/begin FUNCTION MDKOG "9.40      Drehmomentenkoordination f¸r Gesamteingriffe"
 /begin DEF_CHARACTERISTIC CWMDKOG CWTEZW CWZWE CWZWVMX DMRKHO DMRKHU FKNZNSEGMD KFMDGANG0 KFMDGANG1 KFMDGANG2 KFMDGANG3 KFMDGANG4 KFMDGANG5 KFMDGANG6 KFMDGANGUPL MDHYST NASNOT NKUPZWEO NKUPZWEU NLLZWEO NLLZWEU NLSDZWEO NLSDZWEU TMVER TPNSMD VKUPZWEO VKUPZWEU VLLZWEO VLLZWEU VLSDZWEO VLSDZWEU /end DEF_CHARACTERISTIC
 /begin REF_CHARACTERISTIC MDIMX /end REF_CHARACTERISTIC
 /begin IN_MEASUREMENT B_dash B_fil B_kh B_kuppl B_kw B_ll B_llrein B_lsd B_stend dmar_w dmllrz_w dmrkh dmrkt_w gangi miasrl_w miasrs_w mibas_w mibgr_w mifa_w migs_w milres_w mimas_w mimax_w mimsr_w minmfs_w minmx_w miszul_w mitebg_w mivmx_w nmot nmot_w nzahn_w rlmin_w rlsol_w vfzg wped_w /end IN_MEASUREMENT
 /begin OUT_MEASUREMENT B_allzw B_allzwe B_asr B_mdein B_mibeg B_msr B_zwvs B_zwvz dmzms_w fmrgang_w miext_w mifab_w mifag_w misolv_w misol_w mizsol_w nmdkog_w /end OUT_MEASUREMENT
 /begin LOC_MEASUREMENT B_mibegdau mibeg_w miextv_w mizsolv_w /end LOC_MEASUREMENT
 /begin SUB_FUNCTION /end SUB_FUNCTION
/end FUNCTION
/begin FUNCTION MDKOL "Momentenkoordination auf F¸llungsebene" /begin DEF_CHARACTERISTIC KFETAMN /end DEF_CHARACTERISTIC /begin REF_CHARACTERISTIC MDIMX NASNOT /end REF_CHARACTERISTIC
 /begin IN_MEASUREMENT B_dash B_fil B_llrein B_lsd B_mibeg B_zwms dmllr_w dmrkh dmrkt_w dmrllr_w etazwbm etazwmn gangi miasrl_w mibgr_w mifa mifal_w mifa_w miges_w mimsr_w minmx_w misgsl_w miszul_w mitebg_w mivmx_w nmot vsdmr /end IN_MEASUREMENT
 /begin OUT_MEASUREMENT dmrmx_w mifafu_w milres_w milsol_w /end OUT_MEASUREMENT
 /begin LOC_MEASUREMENT /end LOC_MEASUREMENT
 /begin SUB_FUNCTION /end SUB_FUNCTION
/end FUNCTION
/begin FUNCTION MDMAS ""
 /begin DEF_CHARACTERISTIC CWMAS FMIMASG0 FMIMASG1 FMIMASG2 FMIMASG3 FMIMASG4 FMIMASG5 FMIMASG6 FMIMASGUPL /end DEF_CHARACTERISTIC
 /begin REF_CHARACTERISTIC MDIMX /end REF_CHARACTERISTIC
 /begin IN_MEASUREMENT B_noise_er gangi mimxl1_w /end IN_MEASUREMENT
 /begin OUT_MEASUREMENT mimas_w /end OUT_MEASUREMENT
 /begin LOC_MEASUREMENT fmimas_w /end LOC_MEASUREMENT
 /begin SUB_FUNCTION /end SUB_FUNCTION
/end FUNCTION
/begin FUNCTION MDMAX "Berechnung maximales indiziertes Motormoment" /begin DEF_CHARACTERISTIC FMIVL FRLVTM RLVMXN STNMTA /end DEF_CHARACTERISTIC /begin REF_CHARACTERISTIC KFMIOP SNM16OPUW SRL16OPUW /end REF_CHARACTERISTIC
 /begin IN_MEASUREMENT esst_snm16opuw esst_srl16opuw fho_w ftvdk mrfamx_w nmot nmot_w rl_w_kge tans tmot tmotzyl_w /end IN_MEASUREMENT
 /begin OUT_MEASUREMENT mimax_w mimxl1_w rlugd_w rlvugd /end OUT_MEASUREMENT
 /begin LOC_MEASUREMENT snmta /end LOC_MEASUREMENT
 /begin SUB_FUNCTION /end SUB_FUNCTION
/end FUNCTION
/begin FUNCTION MDMFS "" /begin DEF_CHARACTERISTIC CWMFS DMAXMFS DMINMFS MIMINMFS MINMFS MIPMFS MPNMFS MPPMFS /end DEF_CHARACTERISTIC /begin REF_CHARACTERISTIC MDIMX /end REF_CHARACTERISTIC /begin IN_MEASUREMENT B_msf mimxl1_w /end IN_MEASUREMENT /begin OUT_MEASUREMENT B_inipmfs B_tpimfs minmfs_w /end OUT_MEASUREMENT
 /begin LOC_MEASUREMENT dmaxmfs_w dminmfs_w dmmfs_w miinmfs_w mipmfs_w mpnmfs_w mppmfs_w /end LOC_MEASUREMENT
 /begin SUB_FUNCTION /end SUB_FUNCTION
/end FUNCTION
/begin FUNCTION MDMIN "Minimales Motormoment Koordination" /begin DEF_CHARACTERISTIC /end DEF_CHARACTERISTIC /begin REF_CHARACTERISTIC /end REF_CHARACTERISTIC /begin IN_MEASUREMENT B_sab fnstab_w mdverf_w mistt nmot_w /end IN_MEASUREMENT /begin OUT_MEASUREMENT mill_w mimin_w /end OUT_MEASUREMENT /begin LOC_MEASUREMENT /end LOC_MEASUREMENT /begin SUB_FUNCTION /end SUB_FUNCTION /end FUNCTION
/begin FUNCTION MDNSTAB "Drehmoment: Drehzahlstabilisierung" /begin DEF_CHARACTERISTIC FNSTABNV NMDSTAOF /end DEF_CHARACTERISTIC /begin REF_CHARACTERISTIC /end REF_CHARACTERISTIC /begin IN_MEASUREMENT B_stend nmot_w nstat nwem_out /end IN_MEASUREMENT /begin OUT_MEASUREMENT B_fnstab fnstab_w fnsta_in /end OUT_MEASUREMENT /begin LOC_MEASUREMENT nstatfak nwem_fak /end LOC_MEASUREMENT /begin SUB_FUNCTION /end SUB_FUNCTION /end FUNCTION
/begin FUNCTION MDRED "Berechnung Reduzierstufe aus Momentenanforderung" /begin DEF_CHARACTERISTIC CREDSTU DMIZWMN MDHYEZ REDHYOC REDHYUC REDMXSA REDZEM /end DEF_CHARACTERISTIC /begin REF_CHARACTERISTIC REDANZ /end REF_CHARACTERISTIC
 /begin IN_MEASUREMENT B_asr B_dknolu B_dkpu B_mdee_kup B_msr B_nmax B_sab etazwmn mibas_w miopt_w misol_w redist tmot /end IN_MEASUREMENT
 /begin OUT_MEASUREMENT B_sa mizwmn_w redsol /end OUT_MEASUREMENT
 /begin LOC_MEASUREMENT B_mdee B_mdredhyein redhyst redneu redze redzst_w /end LOC_MEASUREMENT
 /begin SUB_FUNCTION /end SUB_FUNCTION
/end FUNCTION
/begin FUNCTION MDTRIP "2.10      Berechnung der Momentenreserve im Kurztrip" /begin DEF_CHARACTERISTIC /end DEF_CHARACTERISTIC /begin REF_CHARACTERISTIC /end REF_CHARACTERISTIC /begin IN_MEASUREMENT dmrdsls_w /end IN_MEASUREMENT /begin OUT_MEASUREMENT dmrkt_w /end OUT_MEASUREMENT /begin LOC_MEASUREMENT /end LOC_MEASUREMENT /begin SUB_FUNCTION /end SUB_FUNCTION /end FUNCTION
/begin FUNCTION MDVER "Motor-Verlustmoment"
 /begin DEF_CHARACTERISTIC CNFMDVER DMDNSM DMDNSMVT KFMDS KFMDSM KLMDHUB MDSH S_mdversta ZFMDVERL ZMDNSM ZMDNSMVT /end DEF_CHARACTERISTIC
 /begin REF_CHARACTERISTIC /end REF_CHARACTERISTIC
 /begin IN_MEASUREMENT B_gdst B_llrein B_sa dmvad_w evhubi_w fho mdgen mdko mdverb_w mdwan_w nmot_w rl_w tmot tol /end IN_MEASUREMENT
 /begin OUT_MEASUREMENT dmverl_w mdsh_aus mdsm_w mdsvad_w mdsw_w mdverf_w mdverl_w /end OUT_MEASUREMENT
 /begin LOC_MEASUREMENT mds_w /end LOC_MEASUREMENT
 /begin SUB_FUNCTION /end SUB_FUNCTION
/end FUNCTION
/begin FUNCTION MDVERAD "Adaption Verlustmoment"
 /begin DEF_CHARACTERISTIC DMADFK DMADFS DMADKO DMADLL DMADMNFK DMADMNFS DMADMNKO DMADMNLL DMADMXFK DMADMXFS DMADMXKO DMADMXLL DMOFK DMOFS DMOKO DMOLL TANSDMAD TANSDMADMX TMDMAD TMDMADMX TWDMAD TZYLDMAD TZYLDMADMX ZKDMADFK ZKDMADFS ZKDMADKO ZKDMADLL /end DEF_CHARACTERISTIC
 /begin REF_CHARACTERISTIC /end REF_CHARACTERISTIC
 /begin IN_MEASUREMENT B_adpini B_dknolu B_dkpu B_dtes B_edkvs B_edkvs2 B_eepdif B_eeve B_evloc B_ffuerfse B_ffuest B_fkvs B_flam B_fosb B_fs B_ftev B_koe B_llr B_llrein B_mdarv B_nswo1 B_vllr dmllri_w tans tmot tmotzyl1_w tmotzyl2_w /end IN_MEASUREMENT
 /begin OUT_MEASUREMENT B_clradllr B_madll dmvadfk_w dmvadfs_w dmvadko_w dmvadll_w dmvad_w /end OUT_MEASUREMENT
 /begin LOC_MEASUREMENT B_adwfk B_adwfs B_adwko B_madfk B_madfs B_madko B_madstp dmvamnfk_w dmvamnfs_w dmvamnko_w dmvamnll_w dmvamxfk_w dmvamxfs_w dmvamxko_w dmvamxll_w /end LOC_MEASUREMENT
 /begin SUB_FUNCTION /end SUB_FUNCTION
/end FUNCTION
/begin COMPU_METHOD B_TRUE "" TAB_VERB "%6.3" "" COMPU_TAB_REF B_TRUE /end COMPU_METHOD
/begin COMPU_VTAB B_TRUE "" TAB_VERB 2 0 "false" 1 "TRUE" /end COMPU_VTAB
/begin COMPU_METHOD DEZ "" RAT_FUNC "%6.2" "" COEFFS 0 1 0 0 0 1 /end COMPU_METHOD
/begin COMPU_METHOD dez "" RAT_FUNC "%6.2" "" COEFFS 0 1 0 0 0 1 /end COMPU_METHOD
/begin COMPU_METHOD fak_q0p0439 "" RAT_FUNC "%6.4" "%/(Grad KWQ)" COEFFS 0 32 0 0 0 1.405 /end COMPU_METHOD
/begin COMPU_METHOD fak_sb_b1 "" RAT_FUNC "%6.4" "-" COEFFS 0 256 0 0 0 2 /end COMPU_METHOD
/begin COMPU_METHOD fak_sb_b2 "" RAT_FUNC "%6.4" "-" COEFFS 0 256 0 0 0 4 /end COMPU_METHOD
/begin COMPU_METHOD fak_sw_b1 "" RAT_FUNC "%7.6" "-" COEFFS 0 65536 0 0 0 2 /end COMPU_METHOD
/begin COMPU_METHOD fak_ub_b1 "" RAT_FUNC "%6.4" "-" COEFFS 0 256 0 0 0 1 /end COMPU_METHOD
/begin COMPU_METHOD fak_ub_b12p45 "" RAT_FUNC "%6.4" "%" COEFFS 0 2048 0 0 0 100 /end COMPU_METHOD
/begin COMPU_METHOD fak_ub_b2 "" RAT_FUNC "%6.4" "-" COEFFS 0 256 0 0 0 2 /end COMPU_METHOD
/begin COMPU_METHOD fak_ub_b4 "" RAT_FUNC "%6.4" "-" COEFFS 0 256 0 0 0 4 /end COMPU_METHOD
/begin COMPU_METHOD fak_ub_b77p81 "" RAT_FUNC "%6.3" "%/s" COEFFS 0 327.68 0 0 0 100 /end COMPU_METHOD
/begin COMPU_METHOD fak_ub_b8 "" RAT_FUNC "%6.4" "-" COEFFS 0 256 0 0 0 8 /end COMPU_METHOD
/begin COMPU_METHOD fak_ub_q0p00392 "" RAT_FUNC "%6.4" "-" COEFFS 0 255 0 0 0 1 /end COMPU_METHOD
/begin COMPU_METHOD fak_uw_b1 "" RAT_FUNC "%7.6" "-" COEFFS 0 65536 0 0 0 1 /end COMPU_METHOD
/begin COMPU_METHOD fak_uw_b16 "" RAT_FUNC "%6.5" "-" COEFFS 0 65536 0 0 0 16 /end COMPU_METHOD
/begin COMPU_METHOD fak_uw_b2 "" RAT_FUNC "%7.6" "-" COEFFS 0 65536 0 0 0 2 /end COMPU_METHOD
/begin COMPU_METHOD fak_uw_b4 "" RAT_FUNC "%7.6" "-" COEFFS 0 65536 0 0 0 4 /end COMPU_METHOD
/begin COMPU_METHOD fak_uw_b8 "" RAT_FUNC "%6.5" "-" COEFFS 0 65536 0 0 0 8 /end COMPU_METHOD
/begin COMPU_METHOD fak_uw_q0p001 "" RAT_FUNC "%6.5" "-" COEFFS 0 65536 0 0 0 65.536 /end COMPU_METHOD
/begin COMPU_METHOD hub_uw_q0p001 "" RAT_FUNC "%6.5" "mm" COEFFS 0 1000 0 0 0 1 /end COMPU_METHOD
/begin COMPU_METHOD kwq_ub_q0p35576 "" RAT_FUNC "%6.3" "Grad KWQ" COEFFS 0 25500 0 0 0 9072 /end COMPU_METHOD
/begin COMPU_METHOD lur_dmd "" RAT_FUNC "%6.2" "Nm" COEFFS 0 0.5 0 0 0 1 /end COMPU_METHOD
/begin COMPU_METHOD lur_fakasp_b1 "" RAT_FUNC "%6.4" "" COEFFS 0 25.6 0 0 0 1 /end COMPU_METHOD
/begin COMPU_METHOD lur_fakseg_b1 "" RAT_FUNC "%6.4" "%/seg" COEFFS 0 25.6 0 0 0 1 /end COMPU_METHOD
/begin COMPU_METHOD lur_fak_b4 "" RAT_FUNC "%6.4" "" COEFFS 0 163.84 0 0 0 1 /end COMPU_METHOD
/begin COMPU_METHOD lur_q1 "" RAT_FUNC "%6.2" "1/(s^2)" COEFFS 0 1 0 0 0 1 /end COMPU_METHOD
/begin COMPU_METHOD lur_seg "" RAT_FUNC "%6.2" "seg" COEFFS 0 1 0 0 0 1 /end COMPU_METHOD
/begin COMPU_METHOD lur_xsa "" RAT_FUNC "%6.2" "%" COEFFS 0 163.84 16384 0 0 1 /end COMPU_METHOD
/begin COMPU_METHOD md_q0p5 "" RAT_FUNC "%6.3" "Nm" COEFFS 0 1 0 0 0 0.5 /end COMPU_METHOD
/begin COMPU_METHOD m_ub_b1020 "" RAT_FUNC "%6.2" "kg/h" COEFFS 0 1 0 0 0 4 /end COMPU_METHOD
/begin COMPU_METHOD m_uw_b4660 "" RAT_FUNC "%6.4" "g" COEFFS 0 3600 0 0 0 256 /end COMPU_METHOD
/begin COMPU_METHOD m_uw_b6553p5 "" RAT_FUNC "%6.3" "kg/h" COEFFS 0 1 0 0 0 0.1 /end COMPU_METHOD
/begin COMPU_METHOD m_uw_b7281 "" RAT_FUNC "%6.3" "g" COEFFS 0 9 0 0 0 1 /end COMPU_METHOD
/begin COMPU_METHOD nmotd_sb_q10 "" RAT_FUNC "%6.1" "1/min" COEFFS 0 1 0 0 0 10 /end COMPU_METHOD
/begin COMPU_METHOD nmotd_sw_q0p25 "" RAT_FUNC "%6.3" "1/min" COEFFS 0 1 0 0 0 0.25 /end COMPU_METHOD
/begin COMPU_METHOD nmotg_sb_q100 "" RAT_FUNC "%6.0" "1/min/s" COEFFS 0 1 0 0 0 100 /end COMPU_METHOD
/begin COMPU_METHOD nmotg_sw_q0p39 "" RAT_FUNC "%6.3" "1/min/s" COEFFS 0 1 0 0 0 0.39063 /end COMPU_METHOD
/begin COMPU_METHOD nmot_sb_q40 "" RAT_FUNC "%6.1" "1/min" COEFFS 0 1 0 0 0 40 /end COMPU_METHOD
/begin COMPU_METHOD nmot_ub_q40 "" RAT_FUNC "%6.1" "1/min" COEFFS 0 1 0 0 0 40 /end COMPU_METHOD
/begin COMPU_METHOD nmot_uw_q0p25 "" RAT_FUNC "%6.3" "1/min" COEFFS 0 1 0 0 0 0.25 /end COMPU_METHOD
/begin COMPU_METHOD relPED_uw_b100 "" RAT_FUNC "%6.4" "%PED" COEFFS 0 65535 0 0 0 100 /end COMPU_METHOD
/begin COMPU_METHOD rel_q0p1957 "" RAT_FUNC "%6.3" "%" COEFFS 0 511 0 0 0 100 /end COMPU_METHOD
/begin COMPU_METHOD rel_sb_q0p02 "" RAT_FUNC "%6.4" "%" COEFFS 0 64 0 0 0 1 /end COMPU_METHOD
/begin COMPU_METHOD rel_sw_b100 "" RAT_FUNC "%6.4" "%" COEFFS 0 32768 0 0 0 100 /end COMPU_METHOD
/begin COMPU_METHOD rel_sw_b1536 "" RAT_FUNC "%6.4" "%" COEFFS 0 65536 0 0 0 3072 /end COMPU_METHOD
/begin COMPU_METHOD rel_sw_q0p0234 "" RAT_FUNC "%6.4" "%/seg" COEFFS 0 32 0 0 0 0.75 /end COMPU_METHOD
/begin COMPU_METHOD rel_ub_b0p78 "" RAT_FUNC "%6.4" "%" COEFFS 0 256 0 0 0 0.78125 /end COMPU_METHOD
/begin COMPU_METHOD rel_ub_b127p5 "" RAT_FUNC "%6.3" "%" COEFFS 0 2 0 0 0 1 /end COMPU_METHOD
/begin COMPU_METHOD rel_ub_b1p0 "" RAT_FUNC "%6.4" "%" COEFFS 0 256 0 0 0 1 /end COMPU_METHOD
/begin COMPU_METHOD rel_ub_b24p9 "" RAT_FUNC "%6.3" "%" COEFFS 0 255 0 0 0 24.9 /end COMPU_METHOD
/begin COMPU_METHOD rel_ub_b2p0 "" RAT_FUNC "%6.4" "%" COEFFS 0 256 0 0 0 2 /end COMPU_METHOD
/begin COMPU_METHOD rel_ub_b99p6 "" RAT_FUNC "%6.3" "%" COEFFS 0 256 0 0 0 100 /end COMPU_METHOD
/begin COMPU_METHOD rel_ub_bn0p125 "" RAT_FUNC "%8.7" "%" COEFFS 0 -256 0 0 0 0.125 /end COMPU_METHOD
/begin COMPU_METHOD rel_ub_bn24p9 "" RAT_FUNC "%6.5" "%" COEFFS 0 -255 0 0 0 24.9 /end COMPU_METHOD
/begin COMPU_METHOD rel_ub_q0p75 "" RAT_FUNC "%6.3" "%" COEFFS 0 1 0 0 0 0.75 /end COMPU_METHOD
/begin COMPU_METHOD rel_uw_b100 "" RAT_FUNC "%6.4" "%" COEFFS 0 65536 0 0 0 100 /end COMPU_METHOD
/begin COMPU_METHOD rel_uw_b200 "" RAT_FUNC "%6.4" "%" COEFFS 0 65536 0 0 0 200 /end COMPU_METHOD
/begin COMPU_METHOD rel_uw_b3072 "" RAT_FUNC "%6.4" "%" COEFFS 0 65536 0 0 0 3072 /end COMPU_METHOD
/begin COMPU_METHOD rel_uw_q0p0234 "" RAT_FUNC "%6.4" "%" COEFFS 0 32 0 0 0 0.75 /end COMPU_METHOD
/begin COMPU_METHOD spg_ub_q0p0052_o0p2 "" RAT_FUNC "%6.3" "V" COEFFS 0 255 51 0 0 1.33 /end COMPU_METHOD
/begin COMPU_METHOD spg_uw_q0p00488_o1 "" RAT_FUNC "%6.3" "V" COEFFS 0 1024 1024 0 0 5 /end COMPU_METHOD
/begin COMPU_METHOD sprzi_q0p8 "" RAT_FUNC "%6.2" "Grad KW" COEFFS 0 1 0 0 0 0.8 /end COMPU_METHOD
/begin COMPU_METHOD t100msxs_sb_q0p01 "" RAT_FUNC "%6.4" "s" COEFFS 0 1 0 0 0 0.01 /end COMPU_METHOD
/begin COMPU_METHOD t100msxs_ub_b25p5 "" RAT_FUNC "%6.3" "s" COEFFS 0 1 0 0 0 0.1 /end COMPU_METHOD
/begin COMPU_METHOD t100msxs_uw_b6553p5 "" RAT_FUNC "%6.3" "s" COEFFS 0 1 0 0 0 0.1 /end COMPU_METHOD
/begin COMPU_METHOD t10msxs_sb_q0p01 "" RAT_FUNC "%6.4" "s" COEFFS 0 1 0 0 0 0.01 /end COMPU_METHOD
/begin COMPU_METHOD t10msxs_ub_b2p55 "" RAT_FUNC "%6.4" "s" COEFFS 0 1 0 0 0 0.01 /end COMPU_METHOD
/begin COMPU_METHOD t10msxs_uw_b655p35 "" RAT_FUNC "%6.4" "s" COEFFS 0 1 0 0 0 0.01 /end COMPU_METHOD
/begin COMPU_METHOD t10msxs_uw_q0p001 "" RAT_FUNC "%6.5" "s" COEFFS 0 1 0 0 0 0.001 /end COMPU_METHOD
/begin COMPU_METHOD t1sxs_uw_b65535 "" RAT_FUNC "%6.2" "s" COEFFS 0 1 0 0 0 1 /end COMPU_METHOD
/begin COMPU_METHOD t200msxs_ub_b51 "" RAT_FUNC "%6.3" "s" COEFFS 0 1 0 0 0 0.2 /end COMPU_METHOD
/begin COMPU_METHOD t20msxs_ub_b5p1 "" RAT_FUNC "%6.4" "s" COEFFS 0 1 0 0 0 0.02 /end COMPU_METHOD
/begin COMPU_METHOD ta_diag "" RAT_FUNC "%6.2" "us" COEFFS 0 1 0 0 0 1 /end COMPU_METHOD
/begin COMPU_METHOD temp_sb_q0p75 "" RAT_FUNC "%6.3" "Grad C" COEFFS 0 1 0 0 0 0.75 /end COMPU_METHOD
/begin COMPU_METHOD temp_ub_b191p25 "" RAT_FUNC "%6.3" "Grad C" COEFFS 0 1 0 0 0 0.75 /end COMPU_METHOD
/begin COMPU_METHOD temp_ub_q0p75_o48 "" RAT_FUNC "%6.2" "Grad C" COEFFS 0 1 48 0 0 0.75 /end COMPU_METHOD
/begin COMPU_METHOD temp_ub_q5_o50 "" RAT_FUNC "%6.2" "Grad C" COEFFS 0 1 50 0 0 5 /end COMPU_METHOD
/begin COMPU_METHOD temp_uw_q0p0195_o50 "" RAT_FUNC "%6.2" "Grad C" COEFFS 0 256 12800 0 0 5 /end COMPU_METHOD
/begin COMPU_METHOD tgrad_ub_q0p039 "" RAT_FUNC "%6.4" "ms/s" COEFFS 0 256 0 0 0 10 /end COMPU_METHOD
/begin COMPU_METHOD vfzg_ub_q1p25 "" RAT_FUNC "%6.2" "km/h" COEFFS 0 1 0 0 0 1.25 /end COMPU_METHOD
/begin COMPU_METHOD vfzg_uw_b512 "" RAT_FUNC "%6.4" "km/h" COEFFS 0 65536 0 0 0 512 /end COMPU_METHOD
/begin COMPU_METHOD zk100msxs_uw_b655 "" RAT_FUNC "%6.1" "s" COEFFS 0 0 65536 0 10 0 /end COMPU_METHOD
/begin COMPU_METHOD zk10msxs_ub_b8 "" RAT_FUNC "%6.4" "1/s" COEFFS 0 256 0 0 0 8 /end COMPU_METHOD
/begin COMPU_METHOD zk10msxs_uw_b655 "" RAT_FUNC "%10.4" "s" COEFFS 0 0 65536 0 100 0 /end COMPU_METHOD
/begin COMPU_METHOD zk200msxs_ub_b51p2 "" RAT_FUNC "%6.3" "s" COEFFS 0 0 51.2 0 1 0 /end COMPU_METHOD
/begin COMPU_METHOD zk200msxs_uw_b13107 "" RAT_FUNC "%6.0" "s" COEFFS 0 0 13107 0 1 0 /end COMPU_METHOD
/begin COMPU_METHOD zk200msxs_uw_b5 "" RAT_FUNC "%7.6" "1/s" COEFFS 0 65536 0 0 0 5 /end COMPU_METHOD
/begin COMPU_METHOD zk200msxs_uw_b960 "" RAT_FUNC "%6.4" "%/s" COEFFS 0 65536 0 0 0 960 /end COMPU_METHOD
/begin COMPU_METHOD zk20msxs_ub_b5p1 "" RAT_FUNC "%6.4" "s" COEFFS 0 0 5.1 0 1 0 /end COMPU_METHOD
/begin COMPU_METHOD zk20msxs_uw_b1310 "" RAT_FUNC "%6.1" "s" COEFFS 0 0 1310 0 1 0 /end COMPU_METHOD
/begin COMPU_METHOD zk50msxs_uw_b3276p8 "" RAT_FUNC "%6.1" "s" COEFFS 0 0 65536 0 20 0 /end COMPU_METHOD
/begin COMPU_METHOD zw_sb_q0p75 "" RAT_FUNC "%6.3" "Grad KW" COEFFS 0 255 0 0 0 191.25 /end COMPU_METHOD
/begin RECORD_LAYOUT FklWUb FNC_VALUES 1 UBYTE COLUMN_DIR DIRECT /end RECORD_LAYOUT
/begin RECORD_LAYOUT GkfWSb FNC_VALUES 1 SBYTE COLUMN_DIR DIRECT /end RECORD_LAYOUT
/begin RECORD_LAYOUT GkfWSw FNC_VALUES 1 SWORD COLUMN_DIR DIRECT /end RECORD_LAYOUT
/begin RECORD_LAYOUT GkfWU8 FNC_VALUES 1 UBYTE COLUMN_DIR DIRECT /end RECORD_LAYOUT
/begin RECORD_LAYOUT GkfWUb FNC_VALUES 1 UBYTE COLUMN_DIR DIRECT /end RECORD_LAYOUT
/begin RECORD_LAYOUT GkfWUw FNC_VALUES 1 UWORD COLUMN_DIR DIRECT /end RECORD_LAYOUT
/begin RECORD_LAYOUT GklWSb FNC_VALUES 1 SBYTE COLUMN_DIR DIRECT /end RECORD_LAYOUT
/begin RECORD_LAYOUT GklWSw FNC_VALUES 1 SWORD COLUMN_DIR DIRECT /end RECORD_LAYOUT
/begin RECORD_LAYOUT GklWUb FNC_VALUES 1 UBYTE COLUMN_DIR DIRECT /end RECORD_LAYOUT
/begin RECORD_LAYOUT GklWUw FNC_VALUES 1 UWORD COLUMN_DIR DIRECT /end RECORD_LAYOUT
/begin RECORD_LAYOUT KfAxU8AyU8SstxU8SstyU8WS8 NO_AXIS_PTS_X 1 UBYTE NO_AXIS_PTS_Y 2 UBYTE AXIS_PTS_X 3 UBYTE INDEX_INCR DIRECT AXIS_PTS_Y 4 UBYTE INDEX_INCR DIRECT FNC_VALUES 5 SBYTE COLUMN_DIR DIRECT /end RECORD_LAYOUT
/begin RECORD_LAYOUT KfAxU8AyU8SstxU8SstyU8WU8 NO_AXIS_PTS_X 1 UBYTE NO_AXIS_PTS_Y 2 UBYTE AXIS_PTS_X 3 UBYTE INDEX_INCR DIRECT AXIS_PTS_Y 4 UBYTE INDEX_INCR DIRECT FNC_VALUES 5 UBYTE COLUMN_DIR DIRECT /end RECORD_LAYOUT
/begin RECORD_LAYOUT KfAxUbAyUbSstxUbSstyUbWSb NO_AXIS_PTS_X 1 UBYTE NO_AXIS_PTS_Y 2 UBYTE AXIS_PTS_X 3 UBYTE INDEX_INCR DIRECT AXIS_PTS_Y 4 UBYTE INDEX_INCR DIRECT FNC_VALUES 5 SBYTE COLUMN_DIR DIRECT /end RECORD_LAYOUT
/begin RECORD_LAYOUT KfAxUbAyUbSstxUbSstyUbWUb NO_AXIS_PTS_X 1 UBYTE NO_AXIS_PTS_Y 2 UBYTE AXIS_PTS_X 3 UBYTE INDEX_INCR DIRECT AXIS_PTS_Y 4 UBYTE INDEX_INCR DIRECT FNC_VALUES 5 UBYTE COLUMN_DIR DIRECT /end RECORD_LAYOUT
/begin RECORD_LAYOUT KfAxUbAyUbSstxUbSstyUwWUw NO_AXIS_PTS_X 1 UBYTE NO_AXIS_PTS_Y 2 UBYTE AXIS_PTS_X 3 UBYTE INDEX_INCR DIRECT AXIS_PTS_Y 4 UWORD INDEX_INCR DIRECT FNC_VALUES 5 UWORD COLUMN_DIR DIRECT /end RECORD_LAYOUT
/begin RECORD_LAYOUT KfAxUbAyUbSstxUwSstyUwWUw NO_AXIS_PTS_X 1 UWORD NO_AXIS_PTS_Y 2 UWORD AXIS_PTS_X 3 UWORD INDEX_INCR DIRECT AXIS_PTS_Y 4 UWORD INDEX_INCR DIRECT FNC_VALUES 5 UWORD COLUMN_DIR DIRECT /end RECORD_LAYOUT
/begin RECORD_LAYOUT KfAxUwAyUwSstxUwSstyUwWUw NO_AXIS_PTS_X 1 UWORD NO_AXIS_PTS_Y 2 UWORD AXIS_PTS_X 3 UWORD INDEX_INCR DIRECT AXIS_PTS_Y 4 UWORD INDEX_INCR DIRECT FNC_VALUES 5 UWORD COLUMN_DIR DIRECT /end RECORD_LAYOUT
/begin RECORD_LAYOUT KlASwSstSwWSw NO_AXIS_PTS_X 1 SWORD AXIS_PTS_X 2 SWORD INDEX_INCR DIRECT FNC_VALUES 3 SWORD COLUMN_DIR DIRECT /end RECORD_LAYOUT
/begin RECORD_LAYOUT KlAUbSstSbWUb NO_AXIS_PTS_X 1 UBYTE AXIS_PTS_X 2 SBYTE INDEX_INCR DIRECT FNC_VALUES 3 UBYTE COLUMN_DIR DIRECT /end RECORD_LAYOUT
/begin RECORD_LAYOUT KlAUbSstUbWSb NO_AXIS_PTS_X 1 UBYTE AXIS_PTS_X 2 UBYTE INDEX_INCR DIRECT FNC_VALUES 3 SBYTE COLUMN_DIR DIRECT /end RECORD_LAYOUT
/begin RECORD_LAYOUT KlAUbSstUbWUb NO_AXIS_PTS_X 1 UBYTE AXIS_PTS_X 2 UBYTE INDEX_INCR DIRECT FNC_VALUES 3 UBYTE COLUMN_DIR DIRECT /end RECORD_LAYOUT
/begin RECORD_LAYOUT KlAUbSstUbWUw NO_AXIS_PTS_X 1 UBYTE AXIS_PTS_X 2 UBYTE INDEX_INCR DIRECT FNC_VALUES 3 UWORD COLUMN_DIR DIRECT /end RECORD_LAYOUT
/begin RECORD_LAYOUT KlAUbSstUwWUw NO_AXIS_PTS_X 1 UWORD AXIS_PTS_X 2 UWORD INDEX_INCR DIRECT FNC_VALUES 3 UWORD COLUMN_DIR DIRECT /end RECORD_LAYOUT
/begin RECORD_LAYOUT KlAUwSstUwWSw NO_AXIS_PTS_X 1 UWORD AXIS_PTS_X 2 UWORD INDEX_INCR DIRECT FNC_VALUES 3 SWORD COLUMN_DIR DIRECT /end RECORD_LAYOUT
/begin RECORD_LAYOUT KlAUwSstUwWUw NO_AXIS_PTS_X 1 UWORD AXIS_PTS_X 2 UWORD INDEX_INCR DIRECT FNC_VALUES 3 UWORD COLUMN_DIR DIRECT /end RECORD_LAYOUT
/begin RECORD_LAYOUT KlAxU8SstxU16WU16 NO_AXIS_PTS_X 1 UWORD AXIS_PTS_X 2 UWORD INDEX_INCR DIRECT FNC_VALUES 3 UWORD COLUMN_DIR DIRECT /end RECORD_LAYOUT
/begin RECORD_LAYOUT KlAxU8SstxU8WU8 NO_AXIS_PTS_X 1 UBYTE AXIS_PTS_X 2 UBYTE INDEX_INCR DIRECT FNC_VALUES 3 UBYTE COLUMN_DIR DIRECT /end RECORD_LAYOUT
/begin RECORD_LAYOUT KwbUb FNC_VALUES 1 UBYTE COLUMN_DIR DIRECT /end RECORD_LAYOUT
/begin RECORD_LAYOUT KwbWS8 FNC_VALUES 1 SBYTE COLUMN_DIR DIRECT /end RECORD_LAYOUT
/begin RECORD_LAYOUT KwSb FNC_VALUES 1 SBYTE COLUMN_DIR DIRECT /end RECORD_LAYOUT
/begin RECORD_LAYOUT KwSw FNC_VALUES 1 SWORD COLUMN_DIR DIRECT /end RECORD_LAYOUT
/begin RECORD_LAYOUT KwUb FNC_VALUES 1 UBYTE COLUMN_DIR DIRECT /end RECORD_LAYOUT
/begin RECORD_LAYOUT KwUw FNC_VALUES 1 UWORD COLUMN_DIR DIRECT /end RECORD_LAYOUT
/begin RECORD_LAYOUT KwWS8 FNC_VALUES 1 SBYTE COLUMN_DIR DIRECT /end RECORD_LAYOUT
/begin RECORD_LAYOUT KwWU16 FNC_VALUES 1 UWORD COLUMN_DIR DIRECT /end RECORD_LAYOUT
/begin RECORD_LAYOUT KwWU8 FNC_VALUES 1 UBYTE COLUMN_DIR DIRECT /end RECORD_LAYOUT
/begin RECORD_LAYOUT SstASwSstSw NO_AXIS_PTS_X 1 SWORD AXIS_PTS_X 2 SWORD INDEX_INCR DIRECT /end RECORD_LAYOUT
/begin RECORD_LAYOUT SstAUbSstSb NO_AXIS_PTS_X 1 UBYTE AXIS_PTS_X 2 SBYTE INDEX_INCR DIRECT /end RECORD_LAYOUT
/begin RECORD_LAYOUT SstAUbSstUb NO_AXIS_PTS_X 1 UBYTE AXIS_PTS_X 2 UBYTE INDEX_INCR DIRECT /end RECORD_LAYOUT
/begin RECORD_LAYOUT SstAUwSstUw NO_AXIS_PTS_X 1 UWORD AXIS_PTS_X 2 UWORD INDEX_INCR DIRECT /end RECORD_LAYOUT
/end MODULE
/end PROJECT
