/* File created by ROBGEN 5.33.05.softing - 32bit - Created by Softing AG - Copyright (C) 1995-2002 BMW AG */
/begin PROJECT MSS65-ign "Generiert am 05.06.02 um 07:49:27"
/begin HEADER "" VERSION "R341" /end HEADER
/begin MODULE _MSS65-ign "Generiert am 05.06.02 um 07:49:27"
/* ( interne Register ... ) */
/* leider verschluckt der Robgen noch die Darstellung - wird noch optimiert !! */
/* Formel fuer 1:1-Wiedergabe ohne Einheit */
/begin MOD_PAR "" VERSION "ccp 2.1" ADDR_EPK 0x0 EPK "" SUPPLIER "EE-24" CUSTOMER "ZS-M-52" CUSTOMER_NO "xxx" USER "Q......." ECU "MSS65-IGN" /* Description of memory-segments. There has to be a CODE and DATA-Segment to */ /* support the generation of valid flashable HEX-Files */
 /begin MEMORY_SEGMENT /* The new keyword MEMORY_SEGMENT is */ CODESEG1 "Program" CODE FLASH INTERN 0x0000 0x60000 -1 -1 -1 -1 -1 /end MEMORY_SEGMENT
 /begin MEMORY_SEGMENT /* The new keyword MEMORY_SEGMENT is */ DATASEG1 "Appl.-DATA" DATA FLASH /* Memorytype; RAM wird nicht unterstützt */ INTERN 0x60000 0x10000 -1 -1 -1 -1 -1 /end MEMORY_SEGMENT
 /begin MEMORY_SEGMENT /* The new keyword MEMORY_SEGMENT */ VARSEG "Variablen" VARIABLES RAM INTERN 0x3F9800 0x6800 -1 -1 -1 -1 -1 /end MEMORY_SEGMENT
/end MOD_PAR
/begin MOD_COMMON "" BYTE_ORDER MSB_FIRST /* Default byteorder (Motorola) */ /end MOD_COMMON
/begin IF_DATA ASAP1B_CCP /* spezific definition for CCP */ /* schnelle zeitsynchrone DAQ-Liste */
 /begin SOURCE "5 ms" 3 /* Basic Scale Unit: 3 -> 1ms */ 5 /* Rate: 5 * 1ms = 5ms */
  /begin QP_BLOB /* The QP-BLOB specifies the behavior of*/ 0 LENGTH 20 CAN_ID_FIXED 0x410 RASTER 0 /end QP_BLOB
 /end SOURCE
 /* langsame zeitsynchrone DAQ-Liste */
 /begin SOURCE "100 ms" 5 /* Basic Scale Unit: 5 -> 100ms */ 1 /* Rate: 1 * 100ms = 100ms */
  /begin QP_BLOB /* The QP-BLOB specifies the behavior of*/ 1 LENGTH 20 CAN_ID_FIXED 0x411 RASTER 1 /end QP_BLOB
 /end SOURCE
 /* winkelsynchrone DAQ-Liste */
 /begin SOURCE "segment-synchron" 103 /* Basic Scale Unit: 103 -> Segment */ 1 /* Rate: 1 * Seg = Seg */
  /begin QP_BLOB /* The QP-BLOB specify the behavior of */ 2 LENGTH 10 CAN_ID_FIXED 0x412 RASTER 2 /* noch pruefen!!!! p_wax */ /end QP_BLOB
 /end SOURCE
 /begin RASTER "5ms-Task" "5ms" 0 3 /* Scaling Unit: 3 = 1 msec */ 5 /* Rate in Scaling Unit: 5 */ /end RASTER
 /begin RASTER "100ms-Task" "100ms" 1 5 /* Scaling Unit: 5 = 100 msec */ 1 /* Rate in Scaling Unit: 1 */ /end RASTER
 /begin RASTER "sync-Task" "sync" 2 103 /* Scaling Unit: 103 = cylinder segment */ 1 /* Rate in Scaling Unit: 1 */ /end RASTER
 /begin TP_BLOB /* This BLOB describes all parameters */ /* that are necessary for CAN-timing and*/ /* ECU-calibration-technics */ 0x0201 /* CCP-Version V2.1 => 0x0201 */ 0x0202 /* BLOB-Version V2.2 => 0x0202 */ 0x400 /* CAN-ID INCA -> ECU */ 0x401 /* CAN-ID ECU -> INCA */ 0x1234 /* ECU CCP-Address */ 1 /* Byte-order: 1 - High-Byte-First (MOT)*/ /* 2 - Low-Byte-First(INTEL)*/
  /begin CAN_PARAM /* Interface CAN-Conrtoller settings */ 0x01f4 /* CAN-Baudrate in kBd: 0x01F4 = 500 kBd*/ 0x41 /* Bittimingregister BTR0: 0X41 */ 0x25 /* Bittimingregister BTR1: 0x25 */ /end CAN_PARAM
  /begin DEFINED_PAGES /* Description of the memory-page */ 1 /* Logical-page-number */ "Workingpage" /* Name of page */ 0x0000 /* Address-Extension */ /* (only low-byte sgnificant) */ 0xc60000 /* Address of Memorypage */ 0x10000 /* Memorysize */ RAM RAM_INIT_BY_ECU /* Initialisationmethode: die ECU initialisiert die WP eigenstaendig */ /* INCA vermeidet mit dieser Einstellung das Senden des MOVE-Commands */ /* beim CCP-Session-Login. */ /end DEFINED_PAGES
  /begin DEFINED_PAGES /* Description of the memory-page */ 2 /* Logical-page-number */ "Referenzpage" /* Name of page */ 0x0000 /* Address-Extension */ /* (only low-byte sgnificant) */ 0x60000 /* Address of Memorypage */ 0x10000 /* Memorysize */ ROM RAM_INIT_BY_ECU /* Initialisationmethode: die ECU initialisiert die WP eigenstaendig */ /* INCA vermeidet mit dieser Einstellung das Senden des MOVE-Commands */ /* beim CCP-Session-Login. */ /end DEFINED_PAGES
  OPTIONAL_CMD 0x0C OPTIONAL_CMD 0x0D OPTIONAL_CMD 0x0E OPTIONAL_CMD 0x11 /* optional CCP-command: SELECT_CAL_PAGE */ OPTIONAL_CMD 0x19 /* optional CCP-command of(quatsch! nix 'of') the ECU */ OPTIONAL_CMD 0x12 OPTIONAL_CMD 0x13 /end TP_BLOB
/end IF_DATA
/begin IF_DATA EDIC_ISO_DS2 "V1.0" 0x12 25 1 SUPP_SERVICE READMEM SUPP_SERVICE WRITEMEM SUPP_SERVICE ACK TELDATA 0x9E /end IF_DATA
/* ------------------ Abschnitt erzeugt aus debug.dat ------------------ */
/begin COMPU_METHOD FORMULA_0000 "FORMULA_0000" RAT_FUNC "%5.0" "-" COEFFS 0 1 0 0 0 1 /end COMPU_METHOD
/begin COMPU_METHOD FORMULA_0001 "FORMULA_0001" RAT_FUNC "%7.0" "-" COEFFS 0 1 0 0 0 1 /end COMPU_METHOD
/* ------------------ Abschnitt erzeugt aus glob.dat ------------------ */
/begin COMPU_METHOD FORMULA_0004 "FORMULA_0004" RAT_FUNC "%8.3" "-" COEFFS 0 16384 0 0 0 1 /end COMPU_METHOD
/begin COMPU_METHOD FORMULA_0006 "FORMULA_0006" RAT_FUNC "%8.3" "-" COEFFS 0 10000 0 0 0 1 /end COMPU_METHOD
/begin COMPU_METHOD FORMULA_0007 "FORMULA_0007" RAT_FUNC "%7.2" "-" COEFFS 0 10000 0 0 0 1 /end COMPU_METHOD
/begin COMPU_METHOD FORMULA_0008 "FORMULA_0008" RAT_FUNC "%3.0" "-" COEFFS 0 1 0 0 0 1 /end COMPU_METHOD
/begin COMPU_METHOD FORMULA_0010 "FORMULA_0010" RAT_FUNC "%6.1" "kg/h" COEFFS 0 10 0 0 0 1 /end COMPU_METHOD
/begin COMPU_METHOD FORMULA_0011 "FORMULA_0011" RAT_FUNC "%5.0" "Upm" COEFFS 0 1 0 0 0 1 /end COMPU_METHOD
/begin COMPU_METHOD FORMULA_0019 "FORMULA_0019" RAT_FUNC "%6.1" "øC" COEFFS 0 10 2732 0 0 1 /end COMPU_METHOD
/begin COMPU_METHOD FORMULA_0022 "FORMULA_0022" RAT_FUNC "%6.1" "%" COEFFS 0 10 0 0 0 1 /end COMPU_METHOD
/begin COMPU_METHOD FORMULA_0035 "FORMULA_0035" RAT_FUNC "%8.3" "-" COEFFS 0 1024 0 0 0 1 /end COMPU_METHOD
/* ------------------ Abschnitt erzeugt aus adapt_ign.dat ------------------ */
/begin COMPU_METHOD FORMULA_0084 "FORMULA_0084" RAT_FUNC "%7.0" "mal" COEFFS 0 1 0 0 0 1 /end COMPU_METHOD
/begin COMPU_METHOD FORMULA_0085 "FORMULA_0085" RAT_FUNC "%5.0" "VERS" COEFFS 0 1 0 0 0 1 /end COMPU_METHOD
/begin COMPU_METHOD FORMULA_0086 "FORMULA_0086" RAT_FUNC "%8.1" "s" COEFFS 0 10 0 0 0 1 /end COMPU_METHOD
/begin COMPU_METHOD FORMULA_0087 "FORMULA_0087" RAT_FUNC "%5.0" "zyklen" COEFFS 0 1 0 0 0 1 /end COMPU_METHOD
/begin COMPU_METHOD FORMULA_0088 "FORMULA_0088" RAT_FUNC "%8.3" "V" COEFFS 0 1024 0 0 0 5 /end COMPU_METHOD
/begin COMPU_METHOD FORMULA_0089 "FORMULA_0089" RAT_FUNC "%8.3" "V" COEFFS 0 2048 0 0 0 5 /end COMPU_METHOD
/begin COMPU_METHOD FORMULA_0090 "FORMULA_0090" RAT_FUNC "%6.1" "Kelvin" COEFFS 0 10 0 0 0 1 /end COMPU_METHOD
/* ------------------ Abschnitt erzeugt aus bsd.dat ------------------ */
/begin COMPU_METHOD FORMULA_0091 "FORMULA_0091" RAT_FUNC "%4.1" "V" COEFFS 0 10 0 0 0 1 /end COMPU_METHOD
/begin COMPU_METHOD FORMULA_0092 "FORMULA_0092" RAT_FUNC "%3.0" "s" COEFFS 0 1 0 0 0 3 /end COMPU_METHOD
/* ------------------ Abschnitt erzeugt aus dsp.dat ------------------ */
/begin COMPU_METHOD FORMULA_0093 "FORMULA_0093" RAT_FUNC "%7.0" "U/min" COEFFS 0 1 0 0 0 1 /end COMPU_METHOD
/begin COMPU_METHOD FORMULA_0094 "FORMULA_0094" RAT_FUNC "%10.3" "-" COEFFS 0 10000 0 0 0 1 /end COMPU_METHOD
/begin COMPU_METHOD FORMULA_0095 "FORMULA_0095" RAT_FUNC "%8.1" "Grad" COEFFS 0 10 0 0 0 1 /end COMPU_METHOD
/begin COMPU_METHOD FORMULA_0096 "FORMULA_0096" RAT_FUNC "%10.3" "V" COEFFS 0 1802.1445 0 0 0 1 /end COMPU_METHOD
/begin COMPU_METHOD FORMULA_0097 "FORMULA_0097" RAT_FUNC "%7.0" "Volt" COEFFS 0 1 0 0 0 0.00161133 /end COMPU_METHOD
/begin COMPU_METHOD FORMULA_0098 "FORMULA_0098" RAT_FUNC "%7.0" "Bar" COEFFS 0 1 0 0 0 0.04 /end COMPU_METHOD
/begin COMPU_METHOD FORMULA_0099 "FORMULA_0099" RAT_FUNC "%5.0" "Volt" COEFFS 0 1 0 0 0 0.00161133 /end COMPU_METHOD
/begin COMPU_METHOD FORMULA_0100 "FORMULA_0100" RAT_FUNC "%5.0" "Bar" COEFFS 0 1 0 0 0 0.04 /end COMPU_METHOD
/begin COMPU_METHOD FORMULA_0101 "FORMULA_0101" RAT_FUNC "%5.0" "-" COEFFS 0 1 0 0 0 0.00161133 /end COMPU_METHOD
/begin COMPU_METHOD FORMULA_0102 "FORMULA_0102" RAT_FUNC "%6.1" "Grad" COEFFS 0 100 0 0 0 1 /end COMPU_METHOD
/begin COMPU_METHOD FORMULA_0103 "FORMULA_0103" RAT_FUNC "%8.1" "-" COEFFS 0 1 0 0 0 1 /end COMPU_METHOD
/begin COMPU_METHOD FORMULA_0104 "FORMULA_0104" RAT_FUNC "%9.2" "-" COEFFS 0 1 0 0 0 1 /end COMPU_METHOD
/begin COMPU_METHOD FORMULA_0105 "FORMULA_0105" RAT_FUNC "%10.3" "x/1024" COEFFS 0 1 0 0 0 1 /end COMPU_METHOD
/* ------------------ Abschnitt erzeugt aus ion.dat ------------------ */
/begin COMPU_METHOD FORMULA_0147 "FORMULA_0147" TAB_VERB "%5.0" "-" COMPU_TAB_REF FORMULA_0147_VTAB /end COMPU_METHOD
/begin COMPU_VTAB FORMULA_0147_VTAB "FORMULA_0147_VTAB" TAB_VERB 2 0 "Aus" 4095 "Aktiv" DEFAULT_VALUE "undefiniert" /end COMPU_VTAB
/begin COMPU_METHOD FORMULA_0148 "FORMULA_0148" RAT_FUNC "%8.3" "V" COEFFS 0 1802.1445 0 0 0 1 /end COMPU_METHOD
/begin COMPU_METHOD FORMULA_0149 "FORMULA_0149" RAT_FUNC "%8.3" "Vµs" COEFFS 0 1 0 0 0 0.01611328 /end COMPU_METHOD
/begin COMPU_METHOD FORMULA_0150 "FORMULA_0150" RAT_FUNC "%8.3" "Vµs" COEFFS 0 18021.4452 0 0 0 1 /end COMPU_METHOD
/begin COMPU_METHOD FORMULA_0181 "FORMULA_0181" RAT_FUNC "%6.1" "%" COEFFS 0 32768 0 0 0 100 /end COMPU_METHOD
/begin COMPU_METHOD FORMULA_0183 "FORMULA_0183" RAT_FUNC "%5.2" "s" COEFFS 0 0 2.56 0 1 0 /end COMPU_METHOD
/begin COMPU_METHOD FORMULA_0206 "FORMULA_0206" RAT_FUNC "%5.0" "digit" COEFFS 0 1 0 0 0 1 /end COMPU_METHOD
/begin COMPU_METHOD FORMULA_0210 "FORMULA_0210" RAT_FUNC "%5.2" "s" COEFFS 0 0 25.6 0 1 0 /end COMPU_METHOD
/* ------------------ Abschnitt erzeugt aus tabg.dat ------------------ */
/begin COMPU_METHOD FORMULA_0213 "FORMULA_0213" RAT_FUNC "%7.2" "øC" COEFFS 0 20 5463 0 0 1 /end COMPU_METHOD
/begin COMPU_METHOD FORMULA_0214 "FORMULA_0214" RAT_FUNC "%7.2" "Kelvin" COEFFS 0 100 0 0 0 1 /end COMPU_METHOD
/begin COMPU_METHOD FORMULA_0215 "FORMULA_0215" TAB_VERB "%3.0" "-" COMPU_TAB_REF FORMULA_0215_VTAB /end COMPU_METHOD
/begin COMPU_VTAB FORMULA_0215_VTAB "FORMULA_0215_VTAB" TAB_VERB 2 0 "TABG" 1 "VKAT" /end COMPU_VTAB
/begin COMPU_METHOD FORMULA_0216 "FORMULA_0216" RAT_FUNC "%9.4" "W/Km²" COEFFS 0 1000 0 0 0 1 /end COMPU_METHOD
/begin COMPU_METHOD FORMULA_0217 "FORMULA_0217" RAT_FUNC "%9.4" "Wh/Km²km" COEFFS 0 10000 0 0 0 1 /end COMPU_METHOD
/begin COMPU_METHOD FORMULA_0218 "FORMULA_0218" RAT_FUNC "%5.0" "J/(kg*K)" COEFFS 0 1 0 0 0 1 /end COMPU_METHOD
/begin COMPU_METHOD FORMULA_0219 "FORMULA_0219" RAT_FUNC "%5.0" "J/Kelvin" COEFFS 0 1 0 0 0 1 /end COMPU_METHOD
/begin COMPU_METHOD FORMULA_0220 "FORMULA_0220" RAT_FUNC "%9.4" "m²" COEFFS 0 10000 0 0 0 1 /end COMPU_METHOD
/begin COMPU_METHOD FORMULA_0221 "FORMULA_0221" RAT_FUNC "%6.1" "Kelvin/s" COEFFS 0 10 0 0 0 1 /end COMPU_METHOD
/begin COMPU_METHOD FORMULA_0222 "FORMULA_0222" RAT_FUNC "%7.2" "min" COEFFS 0 60 0 0 0 1 /end COMPU_METHOD
/* ------------------ Abschnitt erzeugt aus tan.dat ------------------ */
/begin COMPU_METHOD FORMULA_0223 "FORMULA_0223" RAT_FUNC "%8.3" "øC" COEFFS 0 40 10926 0 0 1 /end COMPU_METHOD
/* ------------------ Abschnitt erzeugt aus ub.dat ------------------ */
/begin COMPU_METHOD FORMULA_0243 "FORMULA_0243" RAT_FUNC "%8.3" "V" COEFFS 0 1 0 0 0 0.00155892 /end COMPU_METHOD
/begin COMPU_METHOD FORMULA_0244 "FORMULA_0244" RAT_FUNC "%3.0" "s" COEFFS 0 1 0 0 0 1 /end COMPU_METHOD
/* ------------------ Abschnitt erzeugt aus adapt_ign.dat ------------------ */
/begin MEASUREMENT eeprom_anzahl_schreiben "Anzahl der schreibvorgaenge ins Flash" ULONG FORMULA_0084 0 0 0.0 2147483647.0000 ECU_ADDRESS 0x3F9B6C /begin FUNCTION_LIST Adaptionswerte /end FUNCTION_LIST /end MEASUREMENT
/begin MEASUREMENT eeprom_version_prog "Programmversion beim Abspeichern" UWORD FORMULA_0085 0 0 0.0 65535.0000 ECU_ADDRESS 0x3F9B70 /begin FUNCTION_LIST Adaptionswerte /end FUNCTION_LIST /end MEASUREMENT
/begin MEASUREMENT hdw_1 "HDW" ULONG FORMULA_0001 0 0 0.0 2147483647.0000 ECU_ADDRESS 0x3F9B74 /begin FUNCTION_LIST Adaptionswerte /end FUNCTION_LIST /end MEASUREMENT
/begin MEASUREMENT hdw_2 "HDW" ULONG FORMULA_0001 0 0 0.0 2147483647.0000 ECU_ADDRESS 0x3F9B78 /begin FUNCTION_LIST Adaptionswerte /end FUNCTION_LIST /end MEASUREMENT
/begin MEASUREMENT hdw_3 "HDW" ULONG FORMULA_0001 0 0 0.0 2147483647.0000 ECU_ADDRESS 0x3F9B7C /begin FUNCTION_LIST Adaptionswerte /end FUNCTION_LIST /end MEASUREMENT
/begin MEASUREMENT tdme_max "Maximale DME-Temperatur ueber alle Zyklen" SWORD FORMULA_0019 0 0 -50.0000 150.0000 ECU_ADDRESS 0x3F9B80 /begin FUNCTION_LIST Adaptionswerte /end FUNCTION_LIST /end MEASUREMENT
/begin MEASUREMENT tdme_min "Minimale DME-Temperatur ueber alle Zyklen" SWORD FORMULA_0019 0 0 -50.0000 150.0000 ECU_ADDRESS 0x3F9B82 /begin FUNCTION_LIST Adaptionswerte /end FUNCTION_LIST /end MEASUREMENT
/begin MEASUREMENT tdme_time_zaehler "Zeit fuer Temperatur oberhalb Schwelle" ULONG FORMULA_0086 0 0 0.0 214748364.7000 ECU_ADDRESS 0x3F9B84 /begin FUNCTION_LIST Adaptionswerte /end FUNCTION_LIST /end MEASUREMENT
/begin MEASUREMENT tdme_zyklen "Fahrzyklen oberhalb der Temperatur Schwelle" UWORD FORMULA_0087 0 0 0.0 65535.0000 ECU_ADDRESS 0x3F9B88 /begin FUNCTION_LIST Adaptionswerte /end FUNCTION_LIST /end MEASUREMENT
/begin MEASUREMENT tmot_abstell "Abstelltemperatur des Motors" SWORD FORMULA_0019 0 0 -50.0000 150.0000 ECU_ADDRESS 0x3F9B8A /begin FUNCTION_LIST Adaptionswerte /end FUNCTION_LIST /end MEASUREMENT
/begin MEASUREMENT pwg_max_diff_adapt "Maximal aufgetretene Differenz der Pedalwertgeber" SWORD FORMULA_0022 0 0 0.0 120.0000 ECU_ADDRESS 0x3F9B8C /begin FUNCTION_LIST Adaptionswerte /end FUNCTION_LIST /end MEASUREMENT
/begin MEASUREMENT pwg1_a0 "Absolute Potentiometerspannung 1 fuer LL" SWORD FORMULA_0088 0 0 0.0 5.0000 ECU_ADDRESS 0x3F9B8E /begin FUNCTION_LIST Adaptionswerte /end FUNCTION_LIST /end MEASUREMENT
/begin MEASUREMENT pwg2_a0 "Absolute Potentiometerspannung 2 fuer LL" SWORD FORMULA_0089 0 0 0.0 5.0000 ECU_ADDRESS 0x3F9B90 /begin FUNCTION_LIST Adaptionswerte /end FUNCTION_LIST /end MEASUREMENT
/begin MEASUREMENT egas_wdk_a0_b1 "WDK-Nullpunkt" SWORD FORMULA_0088 0 0 0.0 5.0000 ECU_ADDRESS 0x3F9B92 /begin FUNCTION_LIST Adaptionswerte /end FUNCTION_LIST /end MEASUREMENT
/begin MEASUREMENT egas_wdk_a0_b2 "WDK-Nullpunkt" SWORD FORMULA_0088 0 0 0.0 5.0000 ECU_ADDRESS 0x3F9B94 /begin FUNCTION_LIST Adaptionswerte /end FUNCTION_LIST /end MEASUREMENT
/begin MEASUREMENT tabg_lw_stand_b1 "Ladungswechsel-Abgasabstelltemperatur" SWORD FORMULA_0090 0 0 0.0 1250.0000 ECU_ADDRESS 0x3F9B96 /begin FUNCTION_LIST Adaptionswerte /end FUNCTION_LIST /end MEASUREMENT
/begin MEASUREMENT tabg_lw_stand_b2 "Ladungswechsel-Abgasabstelltemperatur" SWORD FORMULA_0090 0 0 0.0 1250.0000 ECU_ADDRESS 0x3F9B98 /begin FUNCTION_LIST Adaptionswerte /end FUNCTION_LIST /end MEASUREMENT
/begin MEASUREMENT tabg_kat_stand_b1 "Kat-Abgasabstelltemperatur" SWORD FORMULA_0090 0 0 0.0 1250.0000 ECU_ADDRESS 0x3F9B9A /begin FUNCTION_LIST Adaptionswerte /end FUNCTION_LIST /end MEASUREMENT
/begin MEASUREMENT tabg_kat_stand_b2 "Kat-Abgasabstelltemperatur" SWORD FORMULA_0090 0 0 0.0 1250.0000 ECU_ADDRESS 0x3F9B9C /begin FUNCTION_LIST Adaptionswerte /end FUNCTION_LIST /end MEASUREMENT
/begin MEASUREMENT ipk_sync_errorcount "Fehlerzaehler fuer Sync-Timeout" UBYTE FORMULA_0008 0 0 0.0 255.0000 ECU_ADDRESS 0x3F9B9E /begin FUNCTION_LIST Adaptionswerte /end FUNCTION_LIST /end MEASUREMENT
/begin MEASUREMENT ipk_sync_error_st "Telegramm-Maske fuer Sync-Timeout" UBYTE FORMULA_0008 0 0 0.0 255.0000 ECU_ADDRESS 0x3F9B9F /begin FUNCTION_LIST Adaptionswerte /end FUNCTION_LIST /end MEASUREMENT
/* ------------------ Abschnitt erzeugt aus bsd.dat ------------------ */
/begin CHARACTERISTIC K_GEN_ENABLE "BSD Generatorregelung aktivieren." VALUE 0x60258 TKW_VV_VV_UB 100.0 FORMULA_0008 0.0 1.0000 /begin FUNCTION_LIST BSD /end FUNCTION_LIST /end CHARACTERISTIC
/begin CHARACTERISTIC K_GEN_DEMAND_VOLTAGE "BSD Generatorregelspannung." VALUE 0x60259 TKW_VV_VV_UB 100.0 FORMULA_0091 0.0 16.0000 /begin FUNCTION_LIST BSD /end FUNCTION_LIST /end CHARACTERISTIC
/begin CHARACTERISTIC K_GEN_LOAD_RESPONSE "BSD Generator-Anstiegszeit-Lastsprungverhalten." VALUE 0x6025A TKW_VV_VV_UB 100.0 FORMULA_0092 0.0 9.0000 /begin FUNCTION_LIST BSD /end FUNCTION_LIST /end CHARACTERISTIC
/begin MEASUREMENT bsd_error_cnt "BSD Error Counter." ULONG FORMULA_0001 0 0 0.0 2147483647.0000 ECU_ADDRESS 0x3FB7F8 /begin FUNCTION_LIST BSD /end FUNCTION_LIST /end MEASUREMENT
/* ------------------ Abschnitt erzeugt aus dsp.dat ------------------ */
/begin CHARACTERISTIC K_DSP_SCHLT "Schalter Freigabe DSP: 0 = Aus; 1 = Aktiv" VALUE 0x62AE4 TKW_VV_VV_UB 100.0 FORMULA_0008 0.0 1.0000 /begin FUNCTION_LIST DSP /end FUNCTION_LIST /end CHARACTERISTIC
/begin CHARACTERISTIC K_DSP_SYS_GAIN "On board gain." VALUE 0x62AE5 TKW_VV_VV_UB 100.0 FORMULA_0008 0.0 63.0000 /begin FUNCTION_LIST DSP /end FUNCTION_LIST /end CHARACTERISTIC
/begin CHARACTERISTIC K_DSP_PRES_SYS_GAIN "On board gain." VALUE 0x62AE6 TKW_VV_VV_UB 100.0 FORMULA_0008 0.0 63.0000 /begin FUNCTION_LIST DSP /end FUNCTION_LIST /end CHARACTERISTIC
/begin MEASUREMENT dsp_status "DSP status." UWORD FORMULA_0000 0 0 0.0 65535.0000 ECU_ADDRESS 0x3FC0FC /begin FUNCTION_LIST DSP /end FUNCTION_LIST /end MEASUREMENT
/begin MEASUREMENT dsp_bus_cnt "DSP bus error counter." UWORD FORMULA_0000 0 0 0.0 65535.0000 ECU_ADDRESS 0x3FC0FE /begin FUNCTION_LIST DSP /end FUNCTION_LIST /end MEASUREMENT
/begin MEASUREMENT dsp_bank_cnt_1of2_ "DSP bank counter." UWORD FORMULA_0000 0 0 0.0 65535.0000 ECU_ADDRESS 0x3FC100 /begin FUNCTION_LIST DSP /end FUNCTION_LIST /end MEASUREMENT
/begin MEASUREMENT dsp_bank_cnt_2of2_ "DSP bank counter." UWORD FORMULA_0000 0 0 0.0 65535.0000 ECU_ADDRESS 0x3FC102 /begin FUNCTION_LIST DSP /end FUNCTION_LIST /end MEASUREMENT
/begin MEASUREMENT dsp_ZylDat_1of10_.p2d.PPCStat "PPCStat,0,Y" ULONG FORMULA_0001 0 0 0.0 2147483647.0000 ECU_ADDRESS 0x3FC104 /begin FUNCTION_LIST DSP /end FUNCTION_LIST /end MEASUREMENT
/begin MEASUREMENT dsp_ZylDat_2of10_.p2d.PPCStat "PPCStat,0,Y" ULONG FORMULA_0001 0 0 0.0 2147483647.0000 ECU_ADDRESS 0x3FC1AC /begin FUNCTION_LIST DSP /end FUNCTION_LIST /end MEASUREMENT
/begin MEASUREMENT dsp_ZylDat_3of10_.p2d.PPCStat "PPCStat,0,Y" ULONG FORMULA_0001 0 0 0.0 2147483647.0000 ECU_ADDRESS 0x3FC254 /begin FUNCTION_LIST DSP /end FUNCTION_LIST /end MEASUREMENT
/begin MEASUREMENT dsp_ZylDat_4of10_.p2d.PPCStat "PPCStat,0,Y" ULONG FORMULA_0001 0 0 0.0 2147483647.0000 ECU_ADDRESS 0x3FC2FC /begin FUNCTION_LIST DSP /end FUNCTION_LIST /end MEASUREMENT
/begin MEASUREMENT dsp_ZylDat_5of10_.p2d.PPCStat "PPCStat,0,Y" ULONG FORMULA_0001 0 0 0.0 2147483647.0000 ECU_ADDRESS 0x3FC3A4 /begin FUNCTION_LIST DSP /end FUNCTION_LIST /end MEASUREMENT
/begin MEASUREMENT dsp_ZylDat_6of10_.p2d.PPCStat "PPCStat,0,Y" ULONG FORMULA_0001 0 0 0.0 2147483647.0000 ECU_ADDRESS 0x3FC44C /begin FUNCTION_LIST DSP /end FUNCTION_LIST /end MEASUREMENT
/begin MEASUREMENT dsp_ZylDat_7of10_.p2d.PPCStat "PPCStat,0,Y" ULONG FORMULA_0001 0 0 0.0 2147483647.0000 ECU_ADDRESS 0x3FC4F4 /begin FUNCTION_LIST DSP /end FUNCTION_LIST /end MEASUREMENT
/begin MEASUREMENT dsp_ZylDat_8of10_.p2d.PPCStat "PPCStat,0,Y" ULONG FORMULA_0001 0 0 0.0 2147483647.0000 ECU_ADDRESS 0x3FC59C /begin FUNCTION_LIST DSP /end FUNCTION_LIST /end MEASUREMENT
/begin MEASUREMENT dsp_ZylDat_9of10_.p2d.PPCStat "PPCStat,0,Y" ULONG FORMULA_0001 0 0 0.0 2147483647.0000 ECU_ADDRESS 0x3FC644 /begin FUNCTION_LIST DSP /end FUNCTION_LIST /end MEASUREMENT
/begin MEASUREMENT dsp_ZylDat_10of10_.p2d.PPCStat "PPCStat,0,Y" ULONG FORMULA_0001 0 0 0.0 2147483647.0000 ECU_ADDRESS 0x3FC6EC /begin FUNCTION_LIST DSP /end FUNCTION_LIST /end MEASUREMENT
/begin MEASUREMENT dsp_ZylDat_1of10_.p2d.Nmot "Nmot,1,Y" SLONG FORMULA_0093 0 0 0.0 10000.0000 ECU_ADDRESS 0x3FC108 /begin FUNCTION_LIST DSP /end FUNCTION_LIST /end MEASUREMENT
/begin MEASUREMENT dsp_ZylDat_2of10_.p2d.Nmot "Nmot,1,Y" SLONG FORMULA_0093 0 0 0.0 10000.0000 ECU_ADDRESS 0x3FC1B0 /begin FUNCTION_LIST DSP /end FUNCTION_LIST /end MEASUREMENT
/begin MEASUREMENT dsp_ZylDat_3of10_.p2d.Nmot "Nmot,1,Y" SLONG FORMULA_0093 0 0 0.0 10000.0000 ECU_ADDRESS 0x3FC258 /begin FUNCTION_LIST DSP /end FUNCTION_LIST /end MEASUREMENT
/begin MEASUREMENT dsp_ZylDat_4of10_.p2d.Nmot "Nmot,1,Y" SLONG FORMULA_0093 0 0 0.0 10000.0000 ECU_ADDRESS 0x3FC300 /begin FUNCTION_LIST DSP /end FUNCTION_LIST /end MEASUREMENT
/begin MEASUREMENT dsp_ZylDat_5of10_.p2d.Nmot "Nmot,1,Y" SLONG FORMULA_0093 0 0 0.0 10000.0000 ECU_ADDRESS 0x3FC3A8 /begin FUNCTION_LIST DSP /end FUNCTION_LIST /end MEASUREMENT
/begin MEASUREMENT dsp_ZylDat_6of10_.p2d.Nmot "Nmot,1,Y" SLONG FORMULA_0093 0 0 0.0 10000.0000 ECU_ADDRESS 0x3FC450 /begin FUNCTION_LIST DSP /end FUNCTION_LIST /end MEASUREMENT
/begin MEASUREMENT dsp_ZylDat_7of10_.p2d.Nmot "Nmot,1,Y" SLONG FORMULA_0093 0 0 0.0 10000.0000 ECU_ADDRESS 0x3FC4F8 /begin FUNCTION_LIST DSP /end FUNCTION_LIST /end MEASUREMENT
/begin MEASUREMENT dsp_ZylDat_8of10_.p2d.Nmot "Nmot,1,Y" SLONG FORMULA_0093 0 0 0.0 10000.0000 ECU_ADDRESS 0x3FC5A0 /begin FUNCTION_LIST DSP /end FUNCTION_LIST /end MEASUREMENT
/begin MEASUREMENT dsp_ZylDat_9of10_.p2d.Nmot "Nmot,1,Y" SLONG FORMULA_0093 0 0 0.0 10000.0000 ECU_ADDRESS 0x3FC648 /begin FUNCTION_LIST DSP /end FUNCTION_LIST /end MEASUREMENT
/begin MEASUREMENT dsp_ZylDat_10of10_.p2d.Nmot "Nmot,1,Y" SLONG FORMULA_0093 0 0 0.0 10000.0000 ECU_ADDRESS 0x3FC6F0 /begin FUNCTION_LIST DSP /end FUNCTION_LIST /end MEASUREMENT
/begin MEASUREMENT dsp_ZylDat_1of10_.p2d.Rf "Rf,2,Y" SLONG FORMULA_0094 0 0 0.0 2.0000 ECU_ADDRESS 0x3FC10C /begin FUNCTION_LIST DSP /end FUNCTION_LIST /end MEASUREMENT
/begin MEASUREMENT dsp_ZylDat_2of10_.p2d.Rf "Rf,2,Y" SLONG FORMULA_0094 0 0 0.0 2.0000 ECU_ADDRESS 0x3FC1B4 /begin FUNCTION_LIST DSP /end FUNCTION_LIST /end MEASUREMENT
/begin MEASUREMENT dsp_ZylDat_3of10_.p2d.Rf "Rf,2,Y" SLONG FORMULA_0094 0 0 0.0 2.0000 ECU_ADDRESS 0x3FC25C /begin FUNCTION_LIST DSP /end FUNCTION_LIST /end MEASUREMENT
/begin MEASUREMENT dsp_ZylDat_4of10_.p2d.Rf "Rf,2,Y" SLONG FORMULA_0094 0 0 0.0 2.0000 ECU_ADDRESS 0x3FC304 /begin FUNCTION_LIST DSP /end FUNCTION_LIST /end MEASUREMENT
/begin MEASUREMENT dsp_ZylDat_5of10_.p2d.Rf "Rf,2,Y" SLONG FORMULA_0094 0 0 0.0 2.0000 ECU_ADDRESS 0x3FC3AC /begin FUNCTION_LIST DSP /end FUNCTION_LIST /end MEASUREMENT
/begin MEASUREMENT dsp_ZylDat_6of10_.p2d.Rf "Rf,2,Y" SLONG FORMULA_0094 0 0 0.0 2.0000 ECU_ADDRESS 0x3FC454 /begin FUNCTION_LIST DSP /end FUNCTION_LIST /end MEASUREMENT
/begin MEASUREMENT dsp_ZylDat_7of10_.p2d.Rf "Rf,2,Y" SLONG FORMULA_0094 0 0 0.0 2.0000 ECU_ADDRESS 0x3FC4FC /begin FUNCTION_LIST DSP /end FUNCTION_LIST /end MEASUREMENT
/begin MEASUREMENT dsp_ZylDat_8of10_.p2d.Rf "Rf,2,Y" SLONG FORMULA_0094 0 0 0.0 2.0000 ECU_ADDRESS 0x3FC5A4 /begin FUNCTION_LIST DSP /end FUNCTION_LIST /end MEASUREMENT
/begin MEASUREMENT dsp_ZylDat_9of10_.p2d.Rf "Rf,2,Y" SLONG FORMULA_0094 0 0 0.0 2.0000 ECU_ADDRESS 0x3FC64C /begin FUNCTION_LIST DSP /end FUNCTION_LIST /end MEASUREMENT
/begin MEASUREMENT dsp_ZylDat_10of10_.p2d.Rf "Rf,2,Y" SLONG FORMULA_0094 0 0 0.0 2.0000 ECU_ADDRESS 0x3FC6F4 /begin FUNCTION_LIST DSP /end FUNCTION_LIST /end MEASUREMENT
/begin MEASUREMENT dsp_ZylDat_1of10_.p2d.IgnAngle "IgnAngle,3,Y" SLONG FORMULA_0095 0 0 -50.0000 60.0000 ECU_ADDRESS 0x3FC110 /begin FUNCTION_LIST DSP /end FUNCTION_LIST /end MEASUREMENT
/begin MEASUREMENT dsp_ZylDat_2of10_.p2d.IgnAngle "IgnAngle,3,Y" SLONG FORMULA_0095 0 0 -50.0000 60.0000 ECU_ADDRESS 0x3FC1B8 /begin FUNCTION_LIST DSP /end FUNCTION_LIST /end MEASUREMENT
/begin MEASUREMENT dsp_ZylDat_3of10_.p2d.IgnAngle "IgnAngle,3,Y" SLONG FORMULA_0095 0 0 -50.0000 60.0000 ECU_ADDRESS 0x3FC260 /begin FUNCTION_LIST DSP /end FUNCTION_LIST /end MEASUREMENT
/begin MEASUREMENT dsp_ZylDat_4of10_.p2d.IgnAngle "IgnAngle,3,Y" SLONG FORMULA_0095 0 0 -50.0000 60.0000 ECU_ADDRESS 0x3FC308 /begin FUNCTION_LIST DSP /end FUNCTION_LIST /end MEASUREMENT
/begin MEASUREMENT dsp_ZylDat_5of10_.p2d.IgnAngle "IgnAngle,3,Y" SLONG FORMULA_0095 0 0 -50.0000 60.0000 ECU_ADDRESS 0x3FC3B0 /begin FUNCTION_LIST DSP /end FUNCTION_LIST /end MEASUREMENT
/begin MEASUREMENT dsp_ZylDat_6of10_.p2d.IgnAngle "IgnAngle,3,Y" SLONG FORMULA_0095 0 0 -50.0000 60.0000 ECU_ADDRESS 0x3FC458 /begin FUNCTION_LIST DSP /end FUNCTION_LIST /end MEASUREMENT
/begin MEASUREMENT dsp_ZylDat_7of10_.p2d.IgnAngle "IgnAngle,3,Y" SLONG FORMULA_0095 0 0 -50.0000 60.0000 ECU_ADDRESS 0x3FC500 /begin FUNCTION_LIST DSP /end FUNCTION_LIST /end MEASUREMENT
/begin MEASUREMENT dsp_ZylDat_8of10_.p2d.IgnAngle "IgnAngle,3,Y" SLONG FORMULA_0095 0 0 -50.0000 60.0000 ECU_ADDRESS 0x3FC5A8 /begin FUNCTION_LIST DSP /end FUNCTION_LIST /end MEASUREMENT
/begin MEASUREMENT dsp_ZylDat_9of10_.p2d.IgnAngle "IgnAngle,3,Y" SLONG FORMULA_0095 0 0 -50.0000 60.0000 ECU_ADDRESS 0x3FC650 /begin FUNCTION_LIST DSP /end FUNCTION_LIST /end MEASUREMENT
/begin MEASUREMENT dsp_ZylDat_10of10_.p2d.IgnAngle "IgnAngle,3,Y" SLONG FORMULA_0095 0 0 -50.0000 60.0000 ECU_ADDRESS 0x3FC6F8 /begin FUNCTION_LIST DSP /end FUNCTION_LIST /end MEASUREMENT
/begin MEASUREMENT dsp_ZylDat_1of10_.p2d.IonGain "IonGain,4,Y" ULONG FORMULA_0001 0 0 0.0 3.0000 ECU_ADDRESS 0x3FC114 /begin FUNCTION_LIST DSP /end FUNCTION_LIST /end MEASUREMENT
/begin MEASUREMENT dsp_ZylDat_2of10_.p2d.IonGain "IonGain,4,Y" ULONG FORMULA_0001 0 0 0.0 3.0000 ECU_ADDRESS 0x3FC1BC /begin FUNCTION_LIST DSP /end FUNCTION_LIST /end MEASUREMENT
/begin MEASUREMENT dsp_ZylDat_3of10_.p2d.IonGain "IonGain,4,Y" ULONG FORMULA_0001 0 0 0.0 3.0000 ECU_ADDRESS 0x3FC264 /begin FUNCTION_LIST DSP /end FUNCTION_LIST /end MEASUREMENT
/begin MEASUREMENT dsp_ZylDat_4of10_.p2d.IonGain "IonGain,4,Y" ULONG FORMULA_0001 0 0 0.0 3.0000 ECU_ADDRESS 0x3FC30C /begin FUNCTION_LIST DSP /end FUNCTION_LIST /end MEASUREMENT
/begin MEASUREMENT dsp_ZylDat_5of10_.p2d.IonGain "IonGain,4,Y" ULONG FORMULA_0001 0 0 0.0 3.0000 ECU_ADDRESS 0x3FC3B4 /begin FUNCTION_LIST DSP /end FUNCTION_LIST /end MEASUREMENT
/begin MEASUREMENT dsp_ZylDat_6of10_.p2d.IonGain "IonGain,4,Y" ULONG FORMULA_0001 0 0 0.0 3.0000 ECU_ADDRESS 0x3FC45C /begin FUNCTION_LIST DSP /end FUNCTION_LIST /end MEASUREMENT
/begin MEASUREMENT dsp_ZylDat_7of10_.p2d.IonGain "IonGain,4,Y" ULONG FORMULA_0001 0 0 0.0 3.0000 ECU_ADDRESS 0x3FC504 /begin FUNCTION_LIST DSP /end FUNCTION_LIST /end MEASUREMENT
/begin MEASUREMENT dsp_ZylDat_8of10_.p2d.IonGain "IonGain,4,Y" ULONG FORMULA_0001 0 0 0.0 3.0000 ECU_ADDRESS 0x3FC5AC /begin FUNCTION_LIST DSP /end FUNCTION_LIST /end MEASUREMENT
/begin MEASUREMENT dsp_ZylDat_9of10_.p2d.IonGain "IonGain,4,Y" ULONG FORMULA_0001 0 0 0.0 3.0000 ECU_ADDRESS 0x3FC654 /begin FUNCTION_LIST DSP /end FUNCTION_LIST /end MEASUREMENT
/begin MEASUREMENT dsp_ZylDat_10of10_.p2d.IonGain "IonGain,4,Y" ULONG FORMULA_0001 0 0 0.0 3.0000 ECU_ADDRESS 0x3FC6FC /begin FUNCTION_LIST DSP /end FUNCTION_LIST /end MEASUREMENT
/begin MEASUREMENT dsp_ZylDat_1of10_.p2d.SystemGain "SystemGain,5,Y" ULONG FORMULA_0001 0 0 0.0 63.0000 ECU_ADDRESS 0x3FC118 /begin FUNCTION_LIST DSP /end FUNCTION_LIST /end MEASUREMENT
/begin MEASUREMENT dsp_ZylDat_2of10_.p2d.SystemGain "SystemGain,5,Y" ULONG FORMULA_0001 0 0 0.0 63.0000 ECU_ADDRESS 0x3FC1C0 /begin FUNCTION_LIST DSP /end FUNCTION_LIST /end MEASUREMENT
/begin MEASUREMENT dsp_ZylDat_3of10_.p2d.SystemGain "SystemGain,5,Y" ULONG FORMULA_0001 0 0 0.0 63.0000 ECU_ADDRESS 0x3FC268 /begin FUNCTION_LIST DSP /end FUNCTION_LIST /end MEASUREMENT
/begin MEASUREMENT dsp_ZylDat_4of10_.p2d.SystemGain "SystemGain,5,Y" ULONG FORMULA_0001 0 0 0.0 63.0000 ECU_ADDRESS 0x3FC310 /begin FUNCTION_LIST DSP /end FUNCTION_LIST /end MEASUREMENT
/begin MEASUREMENT dsp_ZylDat_5of10_.p2d.SystemGain "SystemGain,5,Y" ULONG FORMULA_0001 0 0 0.0 63.0000 ECU_ADDRESS 0x3FC3B8 /begin FUNCTION_LIST DSP /end FUNCTION_LIST /end MEASUREMENT
/begin MEASUREMENT dsp_ZylDat_6of10_.p2d.SystemGain "SystemGain,5,Y" ULONG FORMULA_0001 0 0 0.0 63.0000 ECU_ADDRESS 0x3FC460 /begin FUNCTION_LIST DSP /end FUNCTION_LIST /end MEASUREMENT
/begin MEASUREMENT dsp_ZylDat_7of10_.p2d.SystemGain "SystemGain,5,Y" ULONG FORMULA_0001 0 0 0.0 63.0000 ECU_ADDRESS 0x3FC508 /begin FUNCTION_LIST DSP /end FUNCTION_LIST /end MEASUREMENT
/begin MEASUREMENT dsp_ZylDat_8of10_.p2d.SystemGain "SystemGain,5,Y" ULONG FORMULA_0001 0 0 0.0 63.0000 ECU_ADDRESS 0x3FC5B0 /begin FUNCTION_LIST DSP /end FUNCTION_LIST /end MEASUREMENT
/begin MEASUREMENT dsp_ZylDat_9of10_.p2d.SystemGain "SystemGain,5,Y" ULONG FORMULA_0001 0 0 0.0 63.0000 ECU_ADDRESS 0x3FC658 /begin FUNCTION_LIST DSP /end FUNCTION_LIST /end MEASUREMENT
/begin MEASUREMENT dsp_ZylDat_10of10_.p2d.SystemGain "SystemGain,5,Y" ULONG FORMULA_0001 0 0 0.0 63.0000 ECU_ADDRESS 0x3FC700 /begin FUNCTION_LIST DSP /end FUNCTION_LIST /end MEASUREMENT
/begin MEASUREMENT dsp_ZylDat_1of10_.p2d.ion_tz_offs_time "ion_tz_offs_time,6,Y" ULONG FORMULA_0001 0 0 0.0 1000.0000 ECU_ADDRESS 0x3FC11C /begin FUNCTION_LIST DSP /end FUNCTION_LIST /end MEASUREMENT
/begin MEASUREMENT dsp_ZylDat_2of10_.p2d.ion_tz_offs_time "ion_tz_offs_time,6,Y" ULONG FORMULA_0001 0 0 0.0 1000.0000 ECU_ADDRESS 0x3FC1C4 /begin FUNCTION_LIST DSP /end FUNCTION_LIST /end MEASUREMENT
/begin MEASUREMENT dsp_ZylDat_3of10_.p2d.ion_tz_offs_time "ion_tz_offs_time,6,Y" ULONG FORMULA_0001 0 0 0.0 1000.0000 ECU_ADDRESS 0x3FC26C /begin FUNCTION_LIST DSP /end FUNCTION_LIST /end MEASUREMENT
/begin MEASUREMENT dsp_ZylDat_4of10_.p2d.ion_tz_offs_time "ion_tz_offs_time,6,Y" ULONG FORMULA_0001 0 0 0.0 1000.0000 ECU_ADDRESS 0x3FC314 /begin FUNCTION_LIST DSP /end FUNCTION_LIST /end MEASUREMENT
/begin MEASUREMENT dsp_ZylDat_5of10_.p2d.ion_tz_offs_time "ion_tz_offs_time,6,Y" ULONG FORMULA_0001 0 0 0.0 1000.0000 ECU_ADDRESS 0x3FC3BC /begin FUNCTION_LIST DSP /end FUNCTION_LIST /end MEASUREMENT
/begin MEASUREMENT dsp_ZylDat_6of10_.p2d.ion_tz_offs_time "ion_tz_offs_time,6,Y" ULONG FORMULA_0001 0 0 0.0 1000.0000 ECU_ADDRESS 0x3FC464 /begin FUNCTION_LIST DSP /end FUNCTION_LIST /end MEASUREMENT
/begin MEASUREMENT dsp_ZylDat_7of10_.p2d.ion_tz_offs_time "ion_tz_offs_time,6,Y" ULONG FORMULA_0001 0 0 0.0 1000.0000 ECU_ADDRESS 0x3FC50C /begin FUNCTION_LIST DSP /end FUNCTION_LIST /end MEASUREMENT
/begin MEASUREMENT dsp_ZylDat_8of10_.p2d.ion_tz_offs_time "ion_tz_offs_time,6,Y" ULONG FORMULA_0001 0 0 0.0 1000.0000 ECU_ADDRESS 0x3FC5B4 /begin FUNCTION_LIST DSP /end FUNCTION_LIST /end MEASUREMENT
/begin MEASUREMENT dsp_ZylDat_9of10_.p2d.ion_tz_offs_time "ion_tz_offs_time,6,Y" ULONG FORMULA_0001 0 0 0.0 1000.0000 ECU_ADDRESS 0x3FC65C /begin FUNCTION_LIST DSP /end FUNCTION_LIST /end MEASUREMENT
/begin MEASUREMENT dsp_ZylDat_10of10_.p2d.ion_tz_offs_time "ion_tz_offs_time,6,Y" ULONG FORMULA_0001 0 0 0.0 1000.0000 ECU_ADDRESS 0x3FC704 /begin FUNCTION_LIST DSP /end FUNCTION_LIST /end MEASUREMENT
/begin MEASUREMENT dsp_ZylDat_1of10_.p2d.knock_sample_time "knock_sample_time,7,Y" ULONG FORMULA_0001 0 0 0.0 10000.0000 ECU_ADDRESS 0x3FC120 /begin FUNCTION_LIST DSP /end FUNCTION_LIST /end MEASUREMENT
/begin MEASUREMENT dsp_ZylDat_2of10_.p2d.knock_sample_time "knock_sample_time,7,Y" ULONG FORMULA_0001 0 0 0.0 10000.0000 ECU_ADDRESS 0x3FC1C8 /begin FUNCTION_LIST DSP /end FUNCTION_LIST /end MEASUREMENT
/begin MEASUREMENT dsp_ZylDat_3of10_.p2d.knock_sample_time "knock_sample_time,7,Y" ULONG FORMULA_0001 0 0 0.0 10000.0000 ECU_ADDRESS 0x3FC270 /begin FUNCTION_LIST DSP /end FUNCTION_LIST /end MEASUREMENT
/begin MEASUREMENT dsp_ZylDat_4of10_.p2d.knock_sample_time "knock_sample_time,7,Y" ULONG FORMULA_0001 0 0 0.0 10000.0000 ECU_ADDRESS 0x3FC318 /begin FUNCTION_LIST DSP /end FUNCTION_LIST /end MEASUREMENT
/begin MEASUREMENT dsp_ZylDat_5of10_.p2d.knock_sample_time "knock_sample_time,7,Y" ULONG FORMULA_0001 0 0 0.0 10000.0000 ECU_ADDRESS 0x3FC3C0 /begin FUNCTION_LIST DSP /end FUNCTION_LIST /end MEASUREMENT
/begin MEASUREMENT dsp_ZylDat_6of10_.p2d.knock_sample_time "knock_sample_time,7,Y" ULONG FORMULA_0001 0 0 0.0 10000.0000 ECU_ADDRESS 0x3FC468 /begin FUNCTION_LIST DSP /end FUNCTION_LIST /end MEASUREMENT
/begin MEASUREMENT dsp_ZylDat_7of10_.p2d.knock_sample_time "knock_sample_time,7,Y" ULONG FORMULA_0001 0 0 0.0 10000.0000 ECU_ADDRESS 0x3FC510 /begin FUNCTION_LIST DSP /end FUNCTION_LIST /end MEASUREMENT
/begin MEASUREMENT dsp_ZylDat_8of10_.p2d.knock_sample_time "knock_sample_time,7,Y" ULONG FORMULA_0001 0 0 0.0 10000.0000 ECU_ADDRESS 0x3FC5B8 /begin FUNCTION_LIST DSP /end FUNCTION_LIST /end MEASUREMENT
/begin MEASUREMENT dsp_ZylDat_9of10_.p2d.knock_sample_time "knock_sample_time,7,Y" ULONG FORMULA_0001 0 0 0.0 10000.0000 ECU_ADDRESS 0x3FC660 /begin FUNCTION_LIST DSP /end FUNCTION_LIST /end MEASUREMENT
/begin MEASUREMENT dsp_ZylDat_10of10_.p2d.knock_sample_time "knock_sample_time,7,Y" ULONG FORMULA_0001 0 0 0.0 10000.0000 ECU_ADDRESS 0x3FC708 /begin FUNCTION_LIST DSP /end FUNCTION_LIST /end MEASUREMENT
/begin MEASUREMENT dsp_ZylDat_1of10_.p2d.PreasureSystemGain "PreasureSystemGain,8,Y" ULONG FORMULA_0001 0 0 0.0 63.0000 ECU_ADDRESS 0x3FC124 /begin FUNCTION_LIST DSP /end FUNCTION_LIST /end MEASUREMENT
/begin MEASUREMENT dsp_ZylDat_2of10_.p2d.PreasureSystemGain "PreasureSystemGain,8,Y" ULONG FORMULA_0001 0 0 0.0 63.0000 ECU_ADDRESS 0x3FC1CC /begin FUNCTION_LIST DSP /end FUNCTION_LIST /end MEASUREMENT
/begin MEASUREMENT dsp_ZylDat_3of10_.p2d.PreasureSystemGain "PreasureSystemGain,8,Y" ULONG FORMULA_0001 0 0 0.0 63.0000 ECU_ADDRESS 0x3FC274 /begin FUNCTION_LIST DSP /end FUNCTION_LIST /end MEASUREMENT
/begin MEASUREMENT dsp_ZylDat_4of10_.p2d.PreasureSystemGain "PreasureSystemGain,8,Y" ULONG FORMULA_0001 0 0 0.0 63.0000 ECU_ADDRESS 0x3FC31C /begin FUNCTION_LIST DSP /end FUNCTION_LIST /end MEASUREMENT
/begin MEASUREMENT dsp_ZylDat_5of10_.p2d.PreasureSystemGain "PreasureSystemGain,8,Y" ULONG FORMULA_0001 0 0 0.0 63.0000 ECU_ADDRESS 0x3FC3C4 /begin FUNCTION_LIST DSP /end FUNCTION_LIST /end MEASUREMENT
/begin MEASUREMENT dsp_ZylDat_6of10_.p2d.PreasureSystemGain "PreasureSystemGain,8,Y" ULONG FORMULA_0001 0 0 0.0 63.0000 ECU_ADDRESS 0x3FC46C /begin FUNCTION_LIST DSP /end FUNCTION_LIST /end MEASUREMENT
/begin MEASUREMENT dsp_ZylDat_7of10_.p2d.PreasureSystemGain "PreasureSystemGain,8,Y" ULONG FORMULA_0001 0 0 0.0 63.0000 ECU_ADDRESS 0x3FC514 /begin FUNCTION_LIST DSP /end FUNCTION_LIST /end MEASUREMENT
/begin MEASUREMENT dsp_ZylDat_8of10_.p2d.PreasureSystemGain "PreasureSystemGain,8,Y" ULONG FORMULA_0001 0 0 0.0 63.0000 ECU_ADDRESS 0x3FC5BC /begin FUNCTION_LIST DSP /end FUNCTION_LIST /end MEASUREMENT
/begin MEASUREMENT dsp_ZylDat_9of10_.p2d.PreasureSystemGain "PreasureSystemGain,8,Y" ULONG FORMULA_0001 0 0 0.0 63.0000 ECU_ADDRESS 0x3FC664 /begin FUNCTION_LIST DSP /end FUNCTION_LIST /end MEASUREMENT
/begin MEASUREMENT dsp_ZylDat_10of10_.p2d.PreasureSystemGain "PreasureSystemGain,8,Y" ULONG FORMULA_0001 0 0 0.0 63.0000 ECU_ADDRESS 0x3FC70C /begin FUNCTION_LIST DSP /end FUNCTION_LIST /end MEASUREMENT
/begin MEASUREMENT dsp_ZylDat_1of10_.p2d.Error "Error,9,Y" SLONG FORMULA_0001 0 0 -2147483648.0000 2147483647.0000 ECU_ADDRESS 0x3FC128 /begin FUNCTION_LIST DSP /end FUNCTION_LIST /end MEASUREMENT
/begin MEASUREMENT dsp_ZylDat_2of10_.p2d.Error "Error,9,Y" SLONG FORMULA_0001 0 0 -2147483648.0000 2147483647.0000 ECU_ADDRESS 0x3FC1D0 /begin FUNCTION_LIST DSP /end FUNCTION_LIST /end MEASUREMENT
/begin MEASUREMENT dsp_ZylDat_3of10_.p2d.Error "Error,9,Y" SLONG FORMULA_0001 0 0 -2147483648.0000 2147483647.0000 ECU_ADDRESS 0x3FC278 /begin FUNCTION_LIST DSP /end FUNCTION_LIST /end MEASUREMENT
/begin MEASUREMENT dsp_ZylDat_4of10_.p2d.Error "Error,9,Y" SLONG FORMULA_0001 0 0 -2147483648.0000 2147483647.0000 ECU_ADDRESS 0x3FC320 /begin FUNCTION_LIST DSP /end FUNCTION_LIST /end MEASUREMENT
/begin MEASUREMENT dsp_ZylDat_5of10_.p2d.Error "Error,9,Y" SLONG FORMULA_0001 0 0 -2147483648.0000 2147483647.0000 ECU_ADDRESS 0x3FC3C8 /begin FUNCTION_LIST DSP /end FUNCTION_LIST /end MEASUREMENT
/begin MEASUREMENT dsp_ZylDat_6of10_.p2d.Error "Error,9,Y" SLONG FORMULA_0001 0 0 -2147483648.0000 2147483647.0000 ECU_ADDRESS 0x3FC470 /begin FUNCTION_LIST DSP /end FUNCTION_LIST /end MEASUREMENT
/begin MEASUREMENT dsp_ZylDat_7of10_.p2d.Error "Error,9,Y" SLONG FORMULA_0001 0 0 -2147483648.0000 2147483647.0000 ECU_ADDRESS 0x3FC518 /begin FUNCTION_LIST DSP /end FUNCTION_LIST /end MEASUREMENT
/begin MEASUREMENT dsp_ZylDat_8of10_.p2d.Error "Error,9,Y" SLONG FORMULA_0001 0 0 -2147483648.0000 2147483647.0000 ECU_ADDRESS 0x3FC5C0 /begin FUNCTION_LIST DSP /end FUNCTION_LIST /end MEASUREMENT
/begin MEASUREMENT dsp_ZylDat_9of10_.p2d.Error "Error,9,Y" SLONG FORMULA_0001 0 0 -2147483648.0000 2147483647.0000 ECU_ADDRESS 0x3FC668 /begin FUNCTION_LIST DSP /end FUNCTION_LIST /end MEASUREMENT
/begin MEASUREMENT dsp_ZylDat_10of10_.p2d.Error "Error,9,Y" SLONG FORMULA_0001 0 0 -2147483648.0000 2147483647.0000 ECU_ADDRESS 0x3FC710 /begin FUNCTION_LIST DSP /end FUNCTION_LIST /end MEASUREMENT
/begin MEASUREMENT dsp_ZylDat_1of10_.d2p.DSPStat "DSPStat,10,Y" ULONG FORMULA_0001 0 0 0.0 2147483647.0000 ECU_ADDRESS 0x3FC12C /begin FUNCTION_LIST DSP /end FUNCTION_LIST /end MEASUREMENT
/begin MEASUREMENT dsp_ZylDat_2of10_.d2p.DSPStat "DSPStat,10,Y" ULONG FORMULA_0001 0 0 0.0 2147483647.0000 ECU_ADDRESS 0x3FC1D4 /begin FUNCTION_LIST DSP /end FUNCTION_LIST /end MEASUREMENT
/begin MEASUREMENT dsp_ZylDat_3of10_.d2p.DSPStat "DSPStat,10,Y" ULONG FORMULA_0001 0 0 0.0 2147483647.0000 ECU_ADDRESS 0x3FC27C /begin FUNCTION_LIST DSP /end FUNCTION_LIST /end MEASUREMENT
/begin MEASUREMENT dsp_ZylDat_4of10_.d2p.DSPStat "DSPStat,10,Y" ULONG FORMULA_0001 0 0 0.0 2147483647.0000 ECU_ADDRESS 0x3FC324 /begin FUNCTION_LIST DSP /end FUNCTION_LIST /end MEASUREMENT
/begin MEASUREMENT dsp_ZylDat_5of10_.d2p.DSPStat "DSPStat,10,Y" ULONG FORMULA_0001 0 0 0.0 2147483647.0000 ECU_ADDRESS 0x3FC3CC /begin FUNCTION_LIST DSP /end FUNCTION_LIST /end MEASUREMENT
/begin MEASUREMENT dsp_ZylDat_6of10_.d2p.DSPStat "DSPStat,10,Y" ULONG FORMULA_0001 0 0 0.0 2147483647.0000 ECU_ADDRESS 0x3FC474 /begin FUNCTION_LIST DSP /end FUNCTION_LIST /end MEASUREMENT
/begin MEASUREMENT dsp_ZylDat_7of10_.d2p.DSPStat "DSPStat,10,Y" ULONG FORMULA_0001 0 0 0.0 2147483647.0000 ECU_ADDRESS 0x3FC51C /begin FUNCTION_LIST DSP /end FUNCTION_LIST /end MEASUREMENT
/begin MEASUREMENT dsp_ZylDat_8of10_.d2p.DSPStat "DSPStat,10,Y" ULONG FORMULA_0001 0 0 0.0 2147483647.0000 ECU_ADDRESS 0x3FC5C4 /begin FUNCTION_LIST DSP /end FUNCTION_LIST /end MEASUREMENT
/begin MEASUREMENT dsp_ZylDat_9of10_.d2p.DSPStat "DSPStat,10,Y" ULONG FORMULA_0001 0 0 0.0 2147483647.0000 ECU_ADDRESS 0x3FC66C /begin FUNCTION_LIST DSP /end FUNCTION_LIST /end MEASUREMENT
/begin MEASUREMENT dsp_ZylDat_10of10_.d2p.DSPStat "DSPStat,10,Y" ULONG FORMULA_0001 0 0 0.0 2147483647.0000 ECU_ADDRESS 0x3FC714 /begin FUNCTION_LIST DSP /end FUNCTION_LIST /end MEASUREMENT
/begin MEASUREMENT dsp_ZylDat_1of10_.d2p.APPLStat "APPLStat,11,Y" ULONG FORMULA_0001 0 0 0.0 2147483647.0000 ECU_ADDRESS 0x3FC130 /begin FUNCTION_LIST DSP /end FUNCTION_LIST /end MEASUREMENT
/begin MEASUREMENT dsp_ZylDat_2of10_.d2p.APPLStat "APPLStat,11,Y" ULONG FORMULA_0001 0 0 0.0 2147483647.0000 ECU_ADDRESS 0x3FC1D8 /begin FUNCTION_LIST DSP /end FUNCTION_LIST /end MEASUREMENT
/begin MEASUREMENT dsp_ZylDat_3of10_.d2p.APPLStat "APPLStat,11,Y" ULONG FORMULA_0001 0 0 0.0 2147483647.0000 ECU_ADDRESS 0x3FC280 /begin FUNCTION_LIST DSP /end FUNCTION_LIST /end MEASUREMENT
/begin MEASUREMENT dsp_ZylDat_4of10_.d2p.APPLStat "APPLStat,11,Y" ULONG FORMULA_0001 0 0 0.0 2147483647.0000 ECU_ADDRESS 0x3FC328 /begin FUNCTION_LIST DSP /end FUNCTION_LIST /end MEASUREMENT
/begin MEASUREMENT dsp_ZylDat_5of10_.d2p.APPLStat "APPLStat,11,Y" ULONG FORMULA_0001 0 0 0.0 2147483647.0000 ECU_ADDRESS 0x3FC3D0 /begin FUNCTION_LIST DSP /end FUNCTION_LIST /end MEASUREMENT
/begin MEASUREMENT dsp_ZylDat_6of10_.d2p.APPLStat "APPLStat,11,Y" ULONG FORMULA_0001 0 0 0.0 2147483647.0000 ECU_ADDRESS 0x3FC478 /begin FUNCTION_LIST DSP /end FUNCTION_LIST /end MEASUREMENT
/begin MEASUREMENT dsp_ZylDat_7of10_.d2p.APPLStat "APPLStat,11,Y" ULONG FORMULA_0001 0 0 0.0 2147483647.0000 ECU_ADDRESS 0x3FC520 /begin FUNCTION_LIST DSP /end FUNCTION_LIST /end MEASUREMENT
/begin MEASUREMENT dsp_ZylDat_8of10_.d2p.APPLStat "APPLStat,11,Y" ULONG FORMULA_0001 0 0 0.0 2147483647.0000 ECU_ADDRESS 0x3FC5C8 /begin FUNCTION_LIST DSP /end FUNCTION_LIST /end MEASUREMENT
/begin MEASUREMENT dsp_ZylDat_9of10_.d2p.APPLStat "APPLStat,11,Y" ULONG FORMULA_0001 0 0 0.0 2147483647.0000 ECU_ADDRESS 0x3FC670 /begin FUNCTION_LIST DSP /end FUNCTION_LIST /end MEASUREMENT
/begin MEASUREMENT dsp_ZylDat_10of10_.d2p.APPLStat "APPLStat,11,Y" ULONG FORMULA_0001 0 0 0.0 2147483647.0000 ECU_ADDRESS 0x3FC718 /begin FUNCTION_LIST DSP /end FUNCTION_LIST /end MEASUREMENT
/begin MEASUREMENT dsp_ZylDat_1of10_.d2p.MeaWinStartAngle "MeaWinStartAngle,12,Y" SLONG FORMULA_0095 0 0 -50.0000 60.0000 ECU_ADDRESS 0x3FC134 /begin FUNCTION_LIST DSP /end FUNCTION_LIST /end MEASUREMENT
/begin MEASUREMENT dsp_ZylDat_2of10_.d2p.MeaWinStartAngle "MeaWinStartAngle,12,Y" SLONG FORMULA_0095 0 0 -50.0000 60.0000 ECU_ADDRESS 0x3FC1DC /begin FUNCTION_LIST DSP /end FUNCTION_LIST /end MEASUREMENT
/begin MEASUREMENT dsp_ZylDat_3of10_.d2p.MeaWinStartAngle "MeaWinStartAngle,12,Y" SLONG FORMULA_0095 0 0 -50.0000 60.0000 ECU_ADDRESS 0x3FC284 /begin FUNCTION_LIST DSP /end FUNCTION_LIST /end MEASUREMENT
/begin MEASUREMENT dsp_ZylDat_4of10_.d2p.MeaWinStartAngle "MeaWinStartAngle,12,Y" SLONG FORMULA_0095 0 0 -50.0000 60.0000 ECU_ADDRESS 0x3FC32C /begin FUNCTION_LIST DSP /end FUNCTION_LIST /end MEASUREMENT
/begin MEASUREMENT dsp_ZylDat_5of10_.d2p.MeaWinStartAngle "MeaWinStartAngle,12,Y" SLONG FORMULA_0095 0 0 -50.0000 60.0000 ECU_ADDRESS 0x3FC3D4 /begin FUNCTION_LIST DSP /end FUNCTION_LIST /end MEASUREMENT
/begin MEASUREMENT dsp_ZylDat_6of10_.d2p.MeaWinStartAngle "MeaWinStartAngle,12,Y" SLONG FORMULA_0095 0 0 -50.0000 60.0000 ECU_ADDRESS 0x3FC47C /begin FUNCTION_LIST DSP /end FUNCTION_LIST /end MEASUREMENT
/begin MEASUREMENT dsp_ZylDat_7of10_.d2p.MeaWinStartAngle "MeaWinStartAngle,12,Y" SLONG FORMULA_0095 0 0 -50.0000 60.0000 ECU_ADDRESS 0x3FC524 /begin FUNCTION_LIST DSP /end FUNCTION_LIST /end MEASUREMENT
/begin MEASUREMENT dsp_ZylDat_8of10_.d2p.MeaWinStartAngle "MeaWinStartAngle,12,Y" SLONG FORMULA_0095 0 0 -50.0000 60.0000 ECU_ADDRESS 0x3FC5CC /begin FUNCTION_LIST DSP /end FUNCTION_LIST /end MEASUREMENT
/begin MEASUREMENT dsp_ZylDat_9of10_.d2p.MeaWinStartAngle "MeaWinStartAngle,12,Y" SLONG FORMULA_0095 0 0 -50.0000 60.0000 ECU_ADDRESS 0x3FC674 /begin FUNCTION_LIST DSP /end FUNCTION_LIST /end MEASUREMENT
/begin MEASUREMENT dsp_ZylDat_10of10_.d2p.MeaWinStartAngle "MeaWinStartAngle,12,Y" SLONG FORMULA_0095 0 0 -50.0000 60.0000 ECU_ADDRESS 0x3FC71C /begin FUNCTION_LIST DSP /end FUNCTION_LIST /end MEASUREMENT
/begin MEASUREMENT dsp_ZylDat_1of10_.d2p.MeaWinAngle "MeaWinAngle,13,Y" SLONG FORMULA_0095 0 0 0.0 18.0000 ECU_ADDRESS 0x3FC138 /begin FUNCTION_LIST DSP /end FUNCTION_LIST /end MEASUREMENT
/begin MEASUREMENT dsp_ZylDat_2of10_.d2p.MeaWinAngle "MeaWinAngle,13,Y" SLONG FORMULA_0095 0 0 0.0 18.0000 ECU_ADDRESS 0x3FC1E0 /begin FUNCTION_LIST DSP /end FUNCTION_LIST /end MEASUREMENT
/begin MEASUREMENT dsp_ZylDat_3of10_.d2p.MeaWinAngle "MeaWinAngle,13,Y" SLONG FORMULA_0095 0 0 0.0 18.0000 ECU_ADDRESS 0x3FC288 /begin FUNCTION_LIST DSP /end FUNCTION_LIST /end MEASUREMENT
/begin MEASUREMENT dsp_ZylDat_4of10_.d2p.MeaWinAngle "MeaWinAngle,13,Y" SLONG FORMULA_0095 0 0 0.0 18.0000 ECU_ADDRESS 0x3FC330 /begin FUNCTION_LIST DSP /end FUNCTION_LIST /end MEASUREMENT
/begin MEASUREMENT dsp_ZylDat_5of10_.d2p.MeaWinAngle "MeaWinAngle,13,Y" SLONG FORMULA_0095 0 0 0.0 18.0000 ECU_ADDRESS 0x3FC3D8 /begin FUNCTION_LIST DSP /end FUNCTION_LIST /end MEASUREMENT
/begin MEASUREMENT dsp_ZylDat_6of10_.d2p.MeaWinAngle "MeaWinAngle,13,Y" SLONG FORMULA_0095 0 0 0.0 18.0000 ECU_ADDRESS 0x3FC480 /begin FUNCTION_LIST DSP /end FUNCTION_LIST /end MEASUREMENT
/begin MEASUREMENT dsp_ZylDat_7of10_.d2p.MeaWinAngle "MeaWinAngle,13,Y" SLONG FORMULA_0095 0 0 0.0 18.0000 ECU_ADDRESS 0x3FC528 /begin FUNCTION_LIST DSP /end FUNCTION_LIST /end MEASUREMENT
/begin MEASUREMENT dsp_ZylDat_8of10_.d2p.MeaWinAngle "MeaWinAngle,13,Y" SLONG FORMULA_0095 0 0 0.0 18.0000 ECU_ADDRESS 0x3FC5D0 /begin FUNCTION_LIST DSP /end FUNCTION_LIST /end MEASUREMENT
/begin MEASUREMENT dsp_ZylDat_9of10_.d2p.MeaWinAngle "MeaWinAngle,13,Y" SLONG FORMULA_0095 0 0 0.0 18.0000 ECU_ADDRESS 0x3FC678 /begin FUNCTION_LIST DSP /end FUNCTION_LIST /end MEASUREMENT
/begin MEASUREMENT dsp_ZylDat_10of10_.d2p.MeaWinAngle "MeaWinAngle,13,Y" SLONG FORMULA_0095 0 0 0.0 18.0000 ECU_ADDRESS 0x3FC720 /begin FUNCTION_LIST DSP /end FUNCTION_LIST /end MEASUREMENT
/begin MEASUREMENT dsp_ZylDat_1of10_.d2p.MeaSamplePoints "MeaSamplePoints,14,Y" SLONG FORMULA_0001 0 0 0.0 10000.0000 ECU_ADDRESS 0x3FC13C /begin FUNCTION_LIST DSP /end FUNCTION_LIST /end MEASUREMENT
/begin MEASUREMENT dsp_ZylDat_2of10_.d2p.MeaSamplePoints "MeaSamplePoints,14,Y" SLONG FORMULA_0001 0 0 0.0 10000.0000 ECU_ADDRESS 0x3FC1E4 /begin FUNCTION_LIST DSP /end FUNCTION_LIST /end MEASUREMENT
/begin MEASUREMENT dsp_ZylDat_3of10_.d2p.MeaSamplePoints "MeaSamplePoints,14,Y" SLONG FORMULA_0001 0 0 0.0 10000.0000 ECU_ADDRESS 0x3FC28C /begin FUNCTION_LIST DSP /end FUNCTION_LIST /end MEASUREMENT
/begin MEASUREMENT dsp_ZylDat_4of10_.d2p.MeaSamplePoints "MeaSamplePoints,14,Y" SLONG FORMULA_0001 0 0 0.0 10000.0000 ECU_ADDRESS 0x3FC334 /begin FUNCTION_LIST DSP /end FUNCTION_LIST /end MEASUREMENT
/begin MEASUREMENT dsp_ZylDat_5of10_.d2p.MeaSamplePoints "MeaSamplePoints,14,Y" SLONG FORMULA_0001 0 0 0.0 10000.0000 ECU_ADDRESS 0x3FC3DC /begin FUNCTION_LIST DSP /end FUNCTION_LIST /end MEASUREMENT
/begin MEASUREMENT dsp_ZylDat_6of10_.d2p.MeaSamplePoints "MeaSamplePoints,14,Y" SLONG FORMULA_0001 0 0 0.0 10000.0000 ECU_ADDRESS 0x3FC484 /begin FUNCTION_LIST DSP /end FUNCTION_LIST /end MEASUREMENT
/begin MEASUREMENT dsp_ZylDat_7of10_.d2p.MeaSamplePoints "MeaSamplePoints,14,Y" SLONG FORMULA_0001 0 0 0.0 10000.0000 ECU_ADDRESS 0x3FC52C /begin FUNCTION_LIST DSP /end FUNCTION_LIST /end MEASUREMENT
/begin MEASUREMENT dsp_ZylDat_8of10_.d2p.MeaSamplePoints "MeaSamplePoints,14,Y" SLONG FORMULA_0001 0 0 0.0 10000.0000 ECU_ADDRESS 0x3FC5D4 /begin FUNCTION_LIST DSP /end FUNCTION_LIST /end MEASUREMENT
/begin MEASUREMENT dsp_ZylDat_9of10_.d2p.MeaSamplePoints "MeaSamplePoints,14,Y" SLONG FORMULA_0001 0 0 0.0 10000.0000 ECU_ADDRESS 0x3FC67C /begin FUNCTION_LIST DSP /end FUNCTION_LIST /end MEASUREMENT
/begin MEASUREMENT dsp_ZylDat_10of10_.d2p.MeaSamplePoints "MeaSamplePoints,14,Y" SLONG FORMULA_0001 0 0 0.0 10000.0000 ECU_ADDRESS 0x3FC724 /begin FUNCTION_LIST DSP /end FUNCTION_LIST /end MEASUREMENT
/begin MEASUREMENT dsp_ZylDat_1of10_.d2p.MisfWinStartAngle "MisfWinStartAngle,15,Y" SLONG FORMULA_0095 0 0 -50.0000 60.0000 ECU_ADDRESS 0x3FC140 /begin FUNCTION_LIST DSP /end FUNCTION_LIST /end MEASUREMENT
/begin MEASUREMENT dsp_ZylDat_2of10_.d2p.MisfWinStartAngle "MisfWinStartAngle,15,Y" SLONG FORMULA_0095 0 0 -50.0000 60.0000 ECU_ADDRESS 0x3FC1E8 /begin FUNCTION_LIST DSP /end FUNCTION_LIST /end MEASUREMENT
/begin MEASUREMENT dsp_ZylDat_3of10_.d2p.MisfWinStartAngle "MisfWinStartAngle,15,Y" SLONG FORMULA_0095 0 0 -50.0000 60.0000 ECU_ADDRESS 0x3FC290 /begin FUNCTION_LIST DSP /end FUNCTION_LIST /end MEASUREMENT
/begin MEASUREMENT dsp_ZylDat_4of10_.d2p.MisfWinStartAngle "MisfWinStartAngle,15,Y" SLONG FORMULA_0095 0 0 -50.0000 60.0000 ECU_ADDRESS 0x3FC338 /begin FUNCTION_LIST DSP /end FUNCTION_LIST /end MEASUREMENT
/begin MEASUREMENT dsp_ZylDat_5of10_.d2p.MisfWinStartAngle "MisfWinStartAngle,15,Y" SLONG FORMULA_0095 0 0 -50.0000 60.0000 ECU_ADDRESS 0x3FC3E0 /begin FUNCTION_LIST DSP /end FUNCTION_LIST /end MEASUREMENT
/begin MEASUREMENT dsp_ZylDat_6of10_.d2p.MisfWinStartAngle "MisfWinStartAngle,15,Y" SLONG FORMULA_0095 0 0 -50.0000 60.0000 ECU_ADDRESS 0x3FC488 /begin FUNCTION_LIST DSP /end FUNCTION_LIST /end MEASUREMENT
/begin MEASUREMENT dsp_ZylDat_7of10_.d2p.MisfWinStartAngle "MisfWinStartAngle,15,Y" SLONG FORMULA_0095 0 0 -50.0000 60.0000 ECU_ADDRESS 0x3FC530 /begin FUNCTION_LIST DSP /end FUNCTION_LIST /end MEASUREMENT
/begin MEASUREMENT dsp_ZylDat_8of10_.d2p.MisfWinStartAngle "MisfWinStartAngle,15,Y" SLONG FORMULA_0095 0 0 -50.0000 60.0000 ECU_ADDRESS 0x3FC5D8 /begin FUNCTION_LIST DSP /end FUNCTION_LIST /end MEASUREMENT
/begin MEASUREMENT dsp_ZylDat_9of10_.d2p.MisfWinStartAngle "MisfWinStartAngle,15,Y" SLONG FORMULA_0095 0 0 -50.0000 60.0000 ECU_ADDRESS 0x3FC680 /begin FUNCTION_LIST DSP /end FUNCTION_LIST /end MEASUREMENT
/begin MEASUREMENT dsp_ZylDat_10of10_.d2p.MisfWinStartAngle "MisfWinStartAngle,15,Y" SLONG FORMULA_0095 0 0 -50.0000 60.0000 ECU_ADDRESS 0x3FC728 /begin FUNCTION_LIST DSP /end FUNCTION_LIST /end MEASUREMENT
/begin MEASUREMENT dsp_ZylDat_1of10_.d2p.MisfWinAngle "MisfWinAngle,16,Y" SLONG FORMULA_0095 0 0 -50.0000 60.0000 ECU_ADDRESS 0x3FC144 /begin FUNCTION_LIST DSP /end FUNCTION_LIST /end MEASUREMENT
/begin MEASUREMENT dsp_ZylDat_2of10_.d2p.MisfWinAngle "MisfWinAngle,16,Y" SLONG FORMULA_0095 0 0 -50.0000 60.0000 ECU_ADDRESS 0x3FC1EC /begin FUNCTION_LIST DSP /end FUNCTION_LIST /end MEASUREMENT
/begin MEASUREMENT dsp_ZylDat_3of10_.d2p.MisfWinAngle "MisfWinAngle,16,Y" SLONG FORMULA_0095 0 0 -50.0000 60.0000 ECU_ADDRESS 0x3FC294 /begin FUNCTION_LIST DSP /end FUNCTION_LIST /end MEASUREMENT
/begin MEASUREMENT dsp_ZylDat_4of10_.d2p.MisfWinAngle "MisfWinAngle,16,Y" SLONG FORMULA_0095 0 0 -50.0000 60.0000 ECU_ADDRESS 0x3FC33C /begin FUNCTION_LIST DSP /end FUNCTION_LIST /end MEASUREMENT
/begin MEASUREMENT dsp_ZylDat_5of10_.d2p.MisfWinAngle "MisfWinAngle,16,Y" SLONG FORMULA_0095 0 0 -50.0000 60.0000 ECU_ADDRESS 0x3FC3E4 /begin FUNCTION_LIST DSP /end FUNCTION_LIST /end MEASUREMENT
/begin MEASUREMENT dsp_ZylDat_6of10_.d2p.MisfWinAngle "MisfWinAngle,16,Y" SLONG FORMULA_0095 0 0 -50.0000 60.0000 ECU_ADDRESS 0x3FC48C /begin FUNCTION_LIST DSP /end FUNCTION_LIST /end MEASUREMENT
/begin MEASUREMENT dsp_ZylDat_7of10_.d2p.MisfWinAngle "MisfWinAngle,16,Y" SLONG FORMULA_0095 0 0 -50.0000 60.0000 ECU_ADDRESS 0x3FC534 /begin FUNCTION_LIST DSP /end FUNCTION_LIST /end MEASUREMENT
/begin MEASUREMENT dsp_ZylDat_8of10_.d2p.MisfWinAngle "MisfWinAngle,16,Y" SLONG FORMULA_0095 0 0 -50.0000 60.0000 ECU_ADDRESS 0x3FC5DC /begin FUNCTION_LIST DSP /end FUNCTION_LIST /end MEASUREMENT
/begin MEASUREMENT dsp_ZylDat_9of10_.d2p.MisfWinAngle "MisfWinAngle,16,Y" SLONG FORMULA_0095 0 0 -50.0000 60.0000 ECU_ADDRESS 0x3FC684 /begin FUNCTION_LIST DSP /end FUNCTION_LIST /end MEASUREMENT
/begin MEASUREMENT dsp_ZylDat_10of10_.d2p.MisfWinAngle "MisfWinAngle,16,Y" SLONG FORMULA_0095 0 0 -50.0000 60.0000 ECU_ADDRESS 0x3FC72C /begin FUNCTION_LIST DSP /end FUNCTION_LIST /end MEASUREMENT
/begin MEASUREMENT dsp_ZylDat_1of10_.d2p.miss_sample_points "miss_sample_points,17,Y" SLONG FORMULA_0001 0 0 0.0 10000.0000 ECU_ADDRESS 0x3FC148 /begin FUNCTION_LIST DSP /end FUNCTION_LIST /end MEASUREMENT
/begin MEASUREMENT dsp_ZylDat_2of10_.d2p.miss_sample_points "miss_sample_points,17,Y" SLONG FORMULA_0001 0 0 0.0 10000.0000 ECU_ADDRESS 0x3FC1F0 /begin FUNCTION_LIST DSP /end FUNCTION_LIST /end MEASUREMENT
/begin MEASUREMENT dsp_ZylDat_3of10_.d2p.miss_sample_points "miss_sample_points,17,Y" SLONG FORMULA_0001 0 0 0.0 10000.0000 ECU_ADDRESS 0x3FC298 /begin FUNCTION_LIST DSP /end FUNCTION_LIST /end MEASUREMENT
/begin MEASUREMENT dsp_ZylDat_4of10_.d2p.miss_sample_points "miss_sample_points,17,Y" SLONG FORMULA_0001 0 0 0.0 10000.0000 ECU_ADDRESS 0x3FC340 /begin FUNCTION_LIST DSP /end FUNCTION_LIST /end MEASUREMENT
/begin MEASUREMENT dsp_ZylDat_5of10_.d2p.miss_sample_points "miss_sample_points,17,Y" SLONG FORMULA_0001 0 0 0.0 10000.0000 ECU_ADDRESS 0x3FC3E8 /begin FUNCTION_LIST DSP /end FUNCTION_LIST /end MEASUREMENT
/begin MEASUREMENT dsp_ZylDat_6of10_.d2p.miss_sample_points "miss_sample_points,17,Y" SLONG FORMULA_0001 0 0 0.0 10000.0000 ECU_ADDRESS 0x3FC490 /begin FUNCTION_LIST DSP /end FUNCTION_LIST /end MEASUREMENT
/begin MEASUREMENT dsp_ZylDat_7of10_.d2p.miss_sample_points "miss_sample_points,17,Y" SLONG FORMULA_0001 0 0 0.0 10000.0000 ECU_ADDRESS 0x3FC538 /begin FUNCTION_LIST DSP /end FUNCTION_LIST /end MEASUREMENT
/begin MEASUREMENT dsp_ZylDat_8of10_.d2p.miss_sample_points "miss_sample_points,17,Y" SLONG FORMULA_0001 0 0 0.0 10000.0000 ECU_ADDRESS 0x3FC5E0 /begin FUNCTION_LIST DSP /end FUNCTION_LIST /end MEASUREMENT
/begin MEASUREMENT dsp_ZylDat_9of10_.d2p.miss_sample_points "miss_sample_points,17,Y" SLONG FORMULA_0001 0 0 0.0 10000.0000 ECU_ADDRESS 0x3FC688 /begin FUNCTION_LIST DSP /end FUNCTION_LIST /end MEASUREMENT
/begin MEASUREMENT dsp_ZylDat_10of10_.d2p.miss_sample_points "miss_sample_points,17,Y" SLONG FORMULA_0001 0 0 0.0 10000.0000 ECU_ADDRESS 0x3FC730 /begin FUNCTION_LIST DSP /end FUNCTION_LIST /end MEASUREMENT
/begin MEASUREMENT dsp_ZylDat_1of10_.d2p.KnockWinStartAngle "KnockWinStartAngle,18,Y" SLONG FORMULA_0095 0 0 -50.0000 60.0000 ECU_ADDRESS 0x3FC14C /begin FUNCTION_LIST DSP /end FUNCTION_LIST /end MEASUREMENT
/begin MEASUREMENT dsp_ZylDat_2of10_.d2p.KnockWinStartAngle "KnockWinStartAngle,18,Y" SLONG FORMULA_0095 0 0 -50.0000 60.0000 ECU_ADDRESS 0x3FC1F4 /begin FUNCTION_LIST DSP /end FUNCTION_LIST /end MEASUREMENT
/begin MEASUREMENT dsp_ZylDat_3of10_.d2p.KnockWinStartAngle "KnockWinStartAngle,18,Y" SLONG FORMULA_0095 0 0 -50.0000 60.0000 ECU_ADDRESS 0x3FC29C /begin FUNCTION_LIST DSP /end FUNCTION_LIST /end MEASUREMENT
/begin MEASUREMENT dsp_ZylDat_4of10_.d2p.KnockWinStartAngle "KnockWinStartAngle,18,Y" SLONG FORMULA_0095 0 0 -50.0000 60.0000 ECU_ADDRESS 0x3FC344 /begin FUNCTION_LIST DSP /end FUNCTION_LIST /end MEASUREMENT
/begin MEASUREMENT dsp_ZylDat_5of10_.d2p.KnockWinStartAngle "KnockWinStartAngle,18,Y" SLONG FORMULA_0095 0 0 -50.0000 60.0000 ECU_ADDRESS 0x3FC3EC /begin FUNCTION_LIST DSP /end FUNCTION_LIST /end MEASUREMENT
/begin MEASUREMENT dsp_ZylDat_6of10_.d2p.KnockWinStartAngle "KnockWinStartAngle,18,Y" SLONG FORMULA_0095 0 0 -50.0000 60.0000 ECU_ADDRESS 0x3FC494 /begin FUNCTION_LIST DSP /end FUNCTION_LIST /end MEASUREMENT
/begin MEASUREMENT dsp_ZylDat_7of10_.d2p.KnockWinStartAngle "KnockWinStartAngle,18,Y" SLONG FORMULA_0095 0 0 -50.0000 60.0000 ECU_ADDRESS 0x3FC53C /begin FUNCTION_LIST DSP /end FUNCTION_LIST /end MEASUREMENT
/begin MEASUREMENT dsp_ZylDat_8of10_.d2p.KnockWinStartAngle "KnockWinStartAngle,18,Y" SLONG FORMULA_0095 0 0 -50.0000 60.0000 ECU_ADDRESS 0x3FC5E4 /begin FUNCTION_LIST DSP /end FUNCTION_LIST /end MEASUREMENT
/begin MEASUREMENT dsp_ZylDat_9of10_.d2p.KnockWinStartAngle "KnockWinStartAngle,18,Y" SLONG FORMULA_0095 0 0 -50.0000 60.0000 ECU_ADDRESS 0x3FC68C /begin FUNCTION_LIST DSP /end FUNCTION_LIST /end MEASUREMENT
/begin MEASUREMENT dsp_ZylDat_10of10_.d2p.KnockWinStartAngle "KnockWinStartAngle,18,Y" SLONG FORMULA_0095 0 0 -50.0000 60.0000 ECU_ADDRESS 0x3FC734 /begin FUNCTION_LIST DSP /end FUNCTION_LIST /end MEASUREMENT
/begin MEASUREMENT dsp_ZylDat_1of10_.d2p.KnockWinAngle "KnockWinAngle,19,Y" SLONG FORMULA_0095 0 0 -50.0000 60.0000 ECU_ADDRESS 0x3FC150 /begin FUNCTION_LIST DSP /end FUNCTION_LIST /end MEASUREMENT
/begin MEASUREMENT dsp_ZylDat_2of10_.d2p.KnockWinAngle "KnockWinAngle,19,Y" SLONG FORMULA_0095 0 0 -50.0000 60.0000 ECU_ADDRESS 0x3FC1F8 /begin FUNCTION_LIST DSP /end FUNCTION_LIST /end MEASUREMENT
/begin MEASUREMENT dsp_ZylDat_3of10_.d2p.KnockWinAngle "KnockWinAngle,19,Y" SLONG FORMULA_0095 0 0 -50.0000 60.0000 ECU_ADDRESS 0x3FC2A0 /begin FUNCTION_LIST DSP /end FUNCTION_LIST /end MEASUREMENT
/begin MEASUREMENT dsp_ZylDat_4of10_.d2p.KnockWinAngle "KnockWinAngle,19,Y" SLONG FORMULA_0095 0 0 -50.0000 60.0000 ECU_ADDRESS 0x3FC348 /begin FUNCTION_LIST DSP /end FUNCTION_LIST /end MEASUREMENT
/begin MEASUREMENT dsp_ZylDat_5of10_.d2p.KnockWinAngle "KnockWinAngle,19,Y" SLONG FORMULA_0095 0 0 -50.0000 60.0000 ECU_ADDRESS 0x3FC3F0 /begin FUNCTION_LIST DSP /end FUNCTION_LIST /end MEASUREMENT
/begin MEASUREMENT dsp_ZylDat_6of10_.d2p.KnockWinAngle "KnockWinAngle,19,Y" SLONG FORMULA_0095 0 0 -50.0000 60.0000 ECU_ADDRESS 0x3FC498 /begin FUNCTION_LIST DSP /end FUNCTION_LIST /end MEASUREMENT
/begin MEASUREMENT dsp_ZylDat_7of10_.d2p.KnockWinAngle "KnockWinAngle,19,Y" SLONG FORMULA_0095 0 0 -50.0000 60.0000 ECU_ADDRESS 0x3FC540 /begin FUNCTION_LIST DSP /end FUNCTION_LIST /end MEASUREMENT
/begin MEASUREMENT dsp_ZylDat_8of10_.d2p.KnockWinAngle "KnockWinAngle,19,Y" SLONG FORMULA_0095 0 0 -50.0000 60.0000 ECU_ADDRESS 0x3FC5E8 /begin FUNCTION_LIST DSP /end FUNCTION_LIST /end MEASUREMENT
/begin MEASUREMENT dsp_ZylDat_9of10_.d2p.KnockWinAngle "KnockWinAngle,19,Y" SLONG FORMULA_0095 0 0 -50.0000 60.0000 ECU_ADDRESS 0x3FC690 /begin FUNCTION_LIST DSP /end FUNCTION_LIST /end MEASUREMENT
/begin MEASUREMENT dsp_ZylDat_10of10_.d2p.KnockWinAngle "KnockWinAngle,19,Y" SLONG FORMULA_0095 0 0 -50.0000 60.0000 ECU_ADDRESS 0x3FC738 /begin FUNCTION_LIST DSP /end FUNCTION_LIST /end MEASUREMENT
/begin MEASUREMENT dsp_ZylDat_1of10_.d2p.KnockSamplePoints "KnockSamplePoints,20,Y" ULONG FORMULA_0001 0 0 0.0 10000.0000 ECU_ADDRESS 0x3FC154 /begin FUNCTION_LIST DSP /end FUNCTION_LIST /end MEASUREMENT
/begin MEASUREMENT dsp_ZylDat_2of10_.d2p.KnockSamplePoints "KnockSamplePoints,20,Y" ULONG FORMULA_0001 0 0 0.0 10000.0000 ECU_ADDRESS 0x3FC1FC /begin FUNCTION_LIST DSP /end FUNCTION_LIST /end MEASUREMENT
/begin MEASUREMENT dsp_ZylDat_3of10_.d2p.KnockSamplePoints "KnockSamplePoints,20,Y" ULONG FORMULA_0001 0 0 0.0 10000.0000 ECU_ADDRESS 0x3FC2A4 /begin FUNCTION_LIST DSP /end FUNCTION_LIST /end MEASUREMENT
/begin MEASUREMENT dsp_ZylDat_4of10_.d2p.KnockSamplePoints "KnockSamplePoints,20,Y" ULONG FORMULA_0001 0 0 0.0 10000.0000 ECU_ADDRESS 0x3FC34C /begin FUNCTION_LIST DSP /end FUNCTION_LIST /end MEASUREMENT
/begin MEASUREMENT dsp_ZylDat_5of10_.d2p.KnockSamplePoints "KnockSamplePoints,20,Y" ULONG FORMULA_0001 0 0 0.0 10000.0000 ECU_ADDRESS 0x3FC3F4 /begin FUNCTION_LIST DSP /end FUNCTION_LIST /end MEASUREMENT
/begin MEASUREMENT dsp_ZylDat_6of10_.d2p.KnockSamplePoints "KnockSamplePoints,20,Y" ULONG FORMULA_0001 0 0 0.0 10000.0000 ECU_ADDRESS 0x3FC49C /begin FUNCTION_LIST DSP /end FUNCTION_LIST /end MEASUREMENT
/begin MEASUREMENT dsp_ZylDat_7of10_.d2p.KnockSamplePoints "KnockSamplePoints,20,Y" ULONG FORMULA_0001 0 0 0.0 10000.0000 ECU_ADDRESS 0x3FC544 /begin FUNCTION_LIST DSP /end FUNCTION_LIST /end MEASUREMENT
/begin MEASUREMENT dsp_ZylDat_8of10_.d2p.KnockSamplePoints "KnockSamplePoints,20,Y" ULONG FORMULA_0001 0 0 0.0 10000.0000 ECU_ADDRESS 0x3FC5EC /begin FUNCTION_LIST DSP /end FUNCTION_LIST /end MEASUREMENT
/begin MEASUREMENT dsp_ZylDat_9of10_.d2p.KnockSamplePoints "KnockSamplePoints,20,Y" ULONG FORMULA_0001 0 0 0.0 10000.0000 ECU_ADDRESS 0x3FC694 /begin FUNCTION_LIST DSP /end FUNCTION_LIST /end MEASUREMENT
/begin MEASUREMENT dsp_ZylDat_10of10_.d2p.KnockSamplePoints "KnockSamplePoints,20,Y" ULONG FORMULA_0001 0 0 0.0 10000.0000 ECU_ADDRESS 0x3FC73C /begin FUNCTION_LIST DSP /end FUNCTION_LIST /end MEASUREMENT
/begin MEASUREMENT dsp_ZylDat_1of10_.d2p.miss_max_value "miss_max_value,21,Y" SLONG FORMULA_0096 0 0 0.0 3.4436 ECU_ADDRESS 0x3FC158 /begin FUNCTION_LIST DSP /end FUNCTION_LIST /end MEASUREMENT
/begin MEASUREMENT dsp_ZylDat_2of10_.d2p.miss_max_value "miss_max_value,21,Y" SLONG FORMULA_0096 0 0 0.0 3.4436 ECU_ADDRESS 0x3FC200 /begin FUNCTION_LIST DSP /end FUNCTION_LIST /end MEASUREMENT
/begin MEASUREMENT dsp_ZylDat_3of10_.d2p.miss_max_value "miss_max_value,21,Y" SLONG FORMULA_0096 0 0 0.0 3.4436 ECU_ADDRESS 0x3FC2A8 /begin FUNCTION_LIST DSP /end FUNCTION_LIST /end MEASUREMENT
/begin MEASUREMENT dsp_ZylDat_4of10_.d2p.miss_max_value "miss_max_value,21,Y" SLONG FORMULA_0096 0 0 0.0 3.4436 ECU_ADDRESS 0x3FC350 /begin FUNCTION_LIST DSP /end FUNCTION_LIST /end MEASUREMENT
/begin MEASUREMENT dsp_ZylDat_5of10_.d2p.miss_max_value "miss_max_value,21,Y" SLONG FORMULA_0096 0 0 0.0 3.4436 ECU_ADDRESS 0x3FC3F8 /begin FUNCTION_LIST DSP /end FUNCTION_LIST /end MEASUREMENT
/begin MEASUREMENT dsp_ZylDat_6of10_.d2p.miss_max_value "miss_max_value,21,Y" SLONG FORMULA_0096 0 0 0.0 3.4436 ECU_ADDRESS 0x3FC4A0 /begin FUNCTION_LIST DSP /end FUNCTION_LIST /end MEASUREMENT
/begin MEASUREMENT dsp_ZylDat_7of10_.d2p.miss_max_value "miss_max_value,21,Y" SLONG FORMULA_0096 0 0 0.0 3.4436 ECU_ADDRESS 0x3FC548 /begin FUNCTION_LIST DSP /end FUNCTION_LIST /end MEASUREMENT
/begin MEASUREMENT dsp_ZylDat_8of10_.d2p.miss_max_value "miss_max_value,21,Y" SLONG FORMULA_0096 0 0 0.0 3.4436 ECU_ADDRESS 0x3FC5F0 /begin FUNCTION_LIST DSP /end FUNCTION_LIST /end MEASUREMENT
/begin MEASUREMENT dsp_ZylDat_9of10_.d2p.miss_max_value "miss_max_value,21,Y" SLONG FORMULA_0096 0 0 0.0 3.4436 ECU_ADDRESS 0x3FC698 /begin FUNCTION_LIST DSP /end FUNCTION_LIST /end MEASUREMENT
/begin MEASUREMENT dsp_ZylDat_10of10_.d2p.miss_max_value "miss_max_value,21,Y" SLONG FORMULA_0096 0 0 0.0 3.4436 ECU_ADDRESS 0x3FC740 /begin FUNCTION_LIST DSP /end FUNCTION_LIST /end MEASUREMENT
/begin MEASUREMENT dsp_ZylDat_1of10_.d2p.IonMisfMaxAngle "IonMisfMaxAngle,22,Y" SLONG FORMULA_0095 0 0 -50.0000 60.0000 ECU_ADDRESS 0x3FC15C /begin FUNCTION_LIST DSP /end FUNCTION_LIST /end MEASUREMENT
/begin MEASUREMENT dsp_ZylDat_2of10_.d2p.IonMisfMaxAngle "IonMisfMaxAngle,22,Y" SLONG FORMULA_0095 0 0 -50.0000 60.0000 ECU_ADDRESS 0x3FC204 /begin FUNCTION_LIST DSP /end FUNCTION_LIST /end MEASUREMENT
/begin MEASUREMENT dsp_ZylDat_3of10_.d2p.IonMisfMaxAngle "IonMisfMaxAngle,22,Y" SLONG FORMULA_0095 0 0 -50.0000 60.0000 ECU_ADDRESS 0x3FC2AC /begin FUNCTION_LIST DSP /end FUNCTION_LIST /end MEASUREMENT
/begin MEASUREMENT dsp_ZylDat_4of10_.d2p.IonMisfMaxAngle "IonMisfMaxAngle,22,Y" SLONG FORMULA_0095 0 0 -50.0000 60.0000 ECU_ADDRESS 0x3FC354 /begin FUNCTION_LIST DSP /end FUNCTION_LIST /end MEASUREMENT
/begin MEASUREMENT dsp_ZylDat_5of10_.d2p.IonMisfMaxAngle "IonMisfMaxAngle,22,Y" SLONG FORMULA_0095 0 0 -50.0000 60.0000 ECU_ADDRESS 0x3FC3FC /begin FUNCTION_LIST DSP /end FUNCTION_LIST /end MEASUREMENT
/begin MEASUREMENT dsp_ZylDat_6of10_.d2p.IonMisfMaxAngle "IonMisfMaxAngle,22,Y" SLONG FORMULA_0095 0 0 -50.0000 60.0000 ECU_ADDRESS 0x3FC4A4 /begin FUNCTION_LIST DSP /end FUNCTION_LIST /end MEASUREMENT
/begin MEASUREMENT dsp_ZylDat_7of10_.d2p.IonMisfMaxAngle "IonMisfMaxAngle,22,Y" SLONG FORMULA_0095 0 0 -50.0000 60.0000 ECU_ADDRESS 0x3FC54C /begin FUNCTION_LIST DSP /end FUNCTION_LIST /end MEASUREMENT
/begin MEASUREMENT dsp_ZylDat_8of10_.d2p.IonMisfMaxAngle "IonMisfMaxAngle,22,Y" SLONG FORMULA_0095 0 0 -50.0000 60.0000 ECU_ADDRESS 0x3FC5F4 /begin FUNCTION_LIST DSP /end FUNCTION_LIST /end MEASUREMENT
/begin MEASUREMENT dsp_ZylDat_9of10_.d2p.IonMisfMaxAngle "IonMisfMaxAngle,22,Y" SLONG FORMULA_0095 0 0 -50.0000 60.0000 ECU_ADDRESS 0x3FC69C /begin FUNCTION_LIST DSP /end FUNCTION_LIST /end MEASUREMENT
/begin MEASUREMENT dsp_ZylDat_10of10_.d2p.IonMisfMaxAngle "IonMisfMaxAngle,22,Y" SLONG FORMULA_0095 0 0 -50.0000 60.0000 ECU_ADDRESS 0x3FC744 /begin FUNCTION_LIST DSP /end FUNCTION_LIST /end MEASUREMENT
/begin MEASUREMENT dsp_ZylDat_1of10_.d2p.IonMisfAveValue "IonMisfAveValue,23,Y" SLONG FORMULA_0096 0 0 0.0 3.4436 ECU_ADDRESS 0x3FC160 /begin FUNCTION_LIST DSP /end FUNCTION_LIST /end MEASUREMENT
/begin MEASUREMENT dsp_ZylDat_2of10_.d2p.IonMisfAveValue "IonMisfAveValue,23,Y" SLONG FORMULA_0096 0 0 0.0 3.4436 ECU_ADDRESS 0x3FC208 /begin FUNCTION_LIST DSP /end FUNCTION_LIST /end MEASUREMENT
/begin MEASUREMENT dsp_ZylDat_3of10_.d2p.IonMisfAveValue "IonMisfAveValue,23,Y" SLONG FORMULA_0096 0 0 0.0 3.4436 ECU_ADDRESS 0x3FC2B0 /begin FUNCTION_LIST DSP /end FUNCTION_LIST /end MEASUREMENT
/begin MEASUREMENT dsp_ZylDat_4of10_.d2p.IonMisfAveValue "IonMisfAveValue,23,Y" SLONG FORMULA_0096 0 0 0.0 3.4436 ECU_ADDRESS 0x3FC358 /begin FUNCTION_LIST DSP /end FUNCTION_LIST /end MEASUREMENT
/begin MEASUREMENT dsp_ZylDat_5of10_.d2p.IonMisfAveValue "IonMisfAveValue,23,Y" SLONG FORMULA_0096 0 0 0.0 3.4436 ECU_ADDRESS 0x3FC400 /begin FUNCTION_LIST DSP /end FUNCTION_LIST /end MEASUREMENT
/begin MEASUREMENT dsp_ZylDat_6of10_.d2p.IonMisfAveValue "IonMisfAveValue,23,Y" SLONG FORMULA_0096 0 0 0.0 3.4436 ECU_ADDRESS 0x3FC4A8 /begin FUNCTION_LIST DSP /end FUNCTION_LIST /end MEASUREMENT
/begin MEASUREMENT dsp_ZylDat_7of10_.d2p.IonMisfAveValue "IonMisfAveValue,23,Y" SLONG FORMULA_0096 0 0 0.0 3.4436 ECU_ADDRESS 0x3FC550 /begin FUNCTION_LIST DSP /end FUNCTION_LIST /end MEASUREMENT
/begin MEASUREMENT dsp_ZylDat_8of10_.d2p.IonMisfAveValue "IonMisfAveValue,23,Y" SLONG FORMULA_0096 0 0 0.0 3.4436 ECU_ADDRESS 0x3FC5F8 /begin FUNCTION_LIST DSP /end FUNCTION_LIST /end MEASUREMENT
/begin MEASUREMENT dsp_ZylDat_9of10_.d2p.IonMisfAveValue "IonMisfAveValue,23,Y" SLONG FORMULA_0096 0 0 0.0 3.4436 ECU_ADDRESS 0x3FC6A0 /begin FUNCTION_LIST DSP /end FUNCTION_LIST /end MEASUREMENT
/begin MEASUREMENT dsp_ZylDat_10of10_.d2p.IonMisfAveValue "IonMisfAveValue,23,Y" SLONG FORMULA_0096 0 0 0.0 3.4436 ECU_ADDRESS 0x3FC748 /begin FUNCTION_LIST DSP /end FUNCTION_LIST /end MEASUREMENT
/begin MEASUREMENT dsp_ZylDat_1of10_.d2p.IonMisfAveAngle "IonMisfAveAngle,24,Y" SLONG FORMULA_0095 0 0 -50.0000 60.0000 ECU_ADDRESS 0x3FC164 /begin FUNCTION_LIST DSP /end FUNCTION_LIST /end MEASUREMENT
/begin MEASUREMENT dsp_ZylDat_2of10_.d2p.IonMisfAveAngle "IonMisfAveAngle,24,Y" SLONG FORMULA_0095 0 0 -50.0000 60.0000 ECU_ADDRESS 0x3FC20C /begin FUNCTION_LIST DSP /end FUNCTION_LIST /end MEASUREMENT
/begin MEASUREMENT dsp_ZylDat_3of10_.d2p.IonMisfAveAngle "IonMisfAveAngle,24,Y" SLONG FORMULA_0095 0 0 -50.0000 60.0000 ECU_ADDRESS 0x3FC2B4 /begin FUNCTION_LIST DSP /end FUNCTION_LIST /end MEASUREMENT
/begin MEASUREMENT dsp_ZylDat_4of10_.d2p.IonMisfAveAngle "IonMisfAveAngle,24,Y" SLONG FORMULA_0095 0 0 -50.0000 60.0000 ECU_ADDRESS 0x3FC35C /begin FUNCTION_LIST DSP /end FUNCTION_LIST /end MEASUREMENT
/begin MEASUREMENT dsp_ZylDat_5of10_.d2p.IonMisfAveAngle "IonMisfAveAngle,24,Y" SLONG FORMULA_0095 0 0 -50.0000 60.0000 ECU_ADDRESS 0x3FC404 /begin FUNCTION_LIST DSP /end FUNCTION_LIST /end MEASUREMENT
/begin MEASUREMENT dsp_ZylDat_6of10_.d2p.IonMisfAveAngle "IonMisfAveAngle,24,Y" SLONG FORMULA_0095 0 0 -50.0000 60.0000 ECU_ADDRESS 0x3FC4AC /begin FUNCTION_LIST DSP /end FUNCTION_LIST /end MEASUREMENT
/begin MEASUREMENT dsp_ZylDat_7of10_.d2p.IonMisfAveAngle "IonMisfAveAngle,24,Y" SLONG FORMULA_0095 0 0 -50.0000 60.0000 ECU_ADDRESS 0x3FC554 /begin FUNCTION_LIST DSP /end FUNCTION_LIST /end MEASUREMENT
/begin MEASUREMENT dsp_ZylDat_8of10_.d2p.IonMisfAveAngle "IonMisfAveAngle,24,Y" SLONG FORMULA_0095 0 0 -50.0000 60.0000 ECU_ADDRESS 0x3FC5FC /begin FUNCTION_LIST DSP /end FUNCTION_LIST /end MEASUREMENT
/begin MEASUREMENT dsp_ZylDat_9of10_.d2p.IonMisfAveAngle "IonMisfAveAngle,24,Y" SLONG FORMULA_0095 0 0 -50.0000 60.0000 ECU_ADDRESS 0x3FC6A4 /begin FUNCTION_LIST DSP /end FUNCTION_LIST /end MEASUREMENT
/begin MEASUREMENT dsp_ZylDat_10of10_.d2p.IonMisfAveAngle "IonMisfAveAngle,24,Y" SLONG FORMULA_0095 0 0 -50.0000 60.0000 ECU_ADDRESS 0x3FC74C /begin FUNCTION_LIST DSP /end FUNCTION_LIST /end MEASUREMENT
/begin MEASUREMENT dsp_ZylDat_1of10_.d2p.miss_int_value "miss_int_value,25,Y" ULONG FORMULA_0001 0 0 0.0 2147483647.0000 ECU_ADDRESS 0x3FC168 /begin FUNCTION_LIST DSP /end FUNCTION_LIST /end MEASUREMENT
/begin MEASUREMENT dsp_ZylDat_2of10_.d2p.miss_int_value "miss_int_value,25,Y" ULONG FORMULA_0001 0 0 0.0 2147483647.0000 ECU_ADDRESS 0x3FC210 /begin FUNCTION_LIST DSP /end FUNCTION_LIST /end MEASUREMENT
/begin MEASUREMENT dsp_ZylDat_3of10_.d2p.miss_int_value "miss_int_value,25,Y" ULONG FORMULA_0001 0 0 0.0 2147483647.0000 ECU_ADDRESS 0x3FC2B8 /begin FUNCTION_LIST DSP /end FUNCTION_LIST /end MEASUREMENT
/begin MEASUREMENT dsp_ZylDat_4of10_.d2p.miss_int_value "miss_int_value,25,Y" ULONG FORMULA_0001 0 0 0.0 2147483647.0000 ECU_ADDRESS 0x3FC360 /begin FUNCTION_LIST DSP /end FUNCTION_LIST /end MEASUREMENT
/begin MEASUREMENT dsp_ZylDat_5of10_.d2p.miss_int_value "miss_int_value,25,Y" ULONG FORMULA_0001 0 0 0.0 2147483647.0000 ECU_ADDRESS 0x3FC408 /begin FUNCTION_LIST DSP /end FUNCTION_LIST /end MEASUREMENT
/begin MEASUREMENT dsp_ZylDat_6of10_.d2p.miss_int_value "miss_int_value,25,Y" ULONG FORMULA_0001 0 0 0.0 2147483647.0000 ECU_ADDRESS 0x3FC4B0 /begin FUNCTION_LIST DSP /end FUNCTION_LIST /end MEASUREMENT
/begin MEASUREMENT dsp_ZylDat_7of10_.d2p.miss_int_value "miss_int_value,25,Y" ULONG FORMULA_0001 0 0 0.0 2147483647.0000 ECU_ADDRESS 0x3FC558 /begin FUNCTION_LIST DSP /end FUNCTION_LIST /end MEASUREMENT
/begin MEASUREMENT dsp_ZylDat_8of10_.d2p.miss_int_value "miss_int_value,25,Y" ULONG FORMULA_0001 0 0 0.0 2147483647.0000 ECU_ADDRESS 0x3FC600 /begin FUNCTION_LIST DSP /end FUNCTION_LIST /end MEASUREMENT
/begin MEASUREMENT dsp_ZylDat_9of10_.d2p.miss_int_value "miss_int_value,25,Y" ULONG FORMULA_0001 0 0 0.0 2147483647.0000 ECU_ADDRESS 0x3FC6A8 /begin FUNCTION_LIST DSP /end FUNCTION_LIST /end MEASUREMENT
/begin MEASUREMENT dsp_ZylDat_10of10_.d2p.miss_int_value "miss_int_value,25,Y" ULONG FORMULA_0001 0 0 0.0 2147483647.0000 ECU_ADDRESS 0x3FC750 /begin FUNCTION_LIST DSP /end FUNCTION_LIST /end MEASUREMENT
/begin MEASUREMENT dsp_ZylDat_1of10_.d2p.IonKnockMaxValue "IonKnockMaxValue,26,Y" SLONG FORMULA_0097 0 0 0.0 10.0000 ECU_ADDRESS 0x3FC16C /begin FUNCTION_LIST DSP /end FUNCTION_LIST /end MEASUREMENT
/begin MEASUREMENT dsp_ZylDat_2of10_.d2p.IonKnockMaxValue "IonKnockMaxValue,26,Y" SLONG FORMULA_0097 0 0 0.0 10.0000 ECU_ADDRESS 0x3FC214 /begin FUNCTION_LIST DSP /end FUNCTION_LIST /end MEASUREMENT
/begin MEASUREMENT dsp_ZylDat_3of10_.d2p.IonKnockMaxValue "IonKnockMaxValue,26,Y" SLONG FORMULA_0097 0 0 0.0 10.0000 ECU_ADDRESS 0x3FC2BC /begin FUNCTION_LIST DSP /end FUNCTION_LIST /end MEASUREMENT
/begin MEASUREMENT dsp_ZylDat_4of10_.d2p.IonKnockMaxValue "IonKnockMaxValue,26,Y" SLONG FORMULA_0097 0 0 0.0 10.0000 ECU_ADDRESS 0x3FC364 /begin FUNCTION_LIST DSP /end FUNCTION_LIST /end MEASUREMENT
/begin MEASUREMENT dsp_ZylDat_5of10_.d2p.IonKnockMaxValue "IonKnockMaxValue,26,Y" SLONG FORMULA_0097 0 0 0.0 10.0000 ECU_ADDRESS 0x3FC40C /begin FUNCTION_LIST DSP /end FUNCTION_LIST /end MEASUREMENT
/begin MEASUREMENT dsp_ZylDat_6of10_.d2p.IonKnockMaxValue "IonKnockMaxValue,26,Y" SLONG FORMULA_0097 0 0 0.0 10.0000 ECU_ADDRESS 0x3FC4B4 /begin FUNCTION_LIST DSP /end FUNCTION_LIST /end MEASUREMENT
/begin MEASUREMENT dsp_ZylDat_7of10_.d2p.IonKnockMaxValue "IonKnockMaxValue,26,Y" SLONG FORMULA_0097 0 0 0.0 10.0000 ECU_ADDRESS 0x3FC55C /begin FUNCTION_LIST DSP /end FUNCTION_LIST /end MEASUREMENT
/begin MEASUREMENT dsp_ZylDat_8of10_.d2p.IonKnockMaxValue "IonKnockMaxValue,26,Y" SLONG FORMULA_0097 0 0 0.0 10.0000 ECU_ADDRESS 0x3FC604 /begin FUNCTION_LIST DSP /end FUNCTION_LIST /end MEASUREMENT
/begin MEASUREMENT dsp_ZylDat_9of10_.d2p.IonKnockMaxValue "IonKnockMaxValue,26,Y" SLONG FORMULA_0097 0 0 0.0 10.0000 ECU_ADDRESS 0x3FC6AC /begin FUNCTION_LIST DSP /end FUNCTION_LIST /end MEASUREMENT
/begin MEASUREMENT dsp_ZylDat_10of10_.d2p.IonKnockMaxValue "IonKnockMaxValue,26,Y" SLONG FORMULA_0097 0 0 0.0 10.0000 ECU_ADDRESS 0x3FC754 /begin FUNCTION_LIST DSP /end FUNCTION_LIST /end MEASUREMENT
/begin MEASUREMENT dsp_ZylDat_1of10_.d2p.IonKnockMaxAngle "IonKnockMaxAngle,27,Y" SLONG FORMULA_0095 0 0 -50.0000 60.0000 ECU_ADDRESS 0x3FC170 /begin FUNCTION_LIST DSP /end FUNCTION_LIST /end MEASUREMENT
/begin MEASUREMENT dsp_ZylDat_2of10_.d2p.IonKnockMaxAngle "IonKnockMaxAngle,27,Y" SLONG FORMULA_0095 0 0 -50.0000 60.0000 ECU_ADDRESS 0x3FC218 /begin FUNCTION_LIST DSP /end FUNCTION_LIST /end MEASUREMENT
/begin MEASUREMENT dsp_ZylDat_3of10_.d2p.IonKnockMaxAngle "IonKnockMaxAngle,27,Y" SLONG FORMULA_0095 0 0 -50.0000 60.0000 ECU_ADDRESS 0x3FC2C0 /begin FUNCTION_LIST DSP /end FUNCTION_LIST /end MEASUREMENT
/begin MEASUREMENT dsp_ZylDat_4of10_.d2p.IonKnockMaxAngle "IonKnockMaxAngle,27,Y" SLONG FORMULA_0095 0 0 -50.0000 60.0000 ECU_ADDRESS 0x3FC368 /begin FUNCTION_LIST DSP /end FUNCTION_LIST /end MEASUREMENT
/begin MEASUREMENT dsp_ZylDat_5of10_.d2p.IonKnockMaxAngle "IonKnockMaxAngle,27,Y" SLONG FORMULA_0095 0 0 -50.0000 60.0000 ECU_ADDRESS 0x3FC410 /begin FUNCTION_LIST DSP /end FUNCTION_LIST /end MEASUREMENT
/begin MEASUREMENT dsp_ZylDat_6of10_.d2p.IonKnockMaxAngle "IonKnockMaxAngle,27,Y" SLONG FORMULA_0095 0 0 -50.0000 60.0000 ECU_ADDRESS 0x3FC4B8 /begin FUNCTION_LIST DSP /end FUNCTION_LIST /end MEASUREMENT
/begin MEASUREMENT dsp_ZylDat_7of10_.d2p.IonKnockMaxAngle "IonKnockMaxAngle,27,Y" SLONG FORMULA_0095 0 0 -50.0000 60.0000 ECU_ADDRESS 0x3FC560 /begin FUNCTION_LIST DSP /end FUNCTION_LIST /end MEASUREMENT
/begin MEASUREMENT dsp_ZylDat_8of10_.d2p.IonKnockMaxAngle "IonKnockMaxAngle,27,Y" SLONG FORMULA_0095 0 0 -50.0000 60.0000 ECU_ADDRESS 0x3FC608 /begin FUNCTION_LIST DSP /end FUNCTION_LIST /end MEASUREMENT
/begin MEASUREMENT dsp_ZylDat_9of10_.d2p.IonKnockMaxAngle "IonKnockMaxAngle,27,Y" SLONG FORMULA_0095 0 0 -50.0000 60.0000 ECU_ADDRESS 0x3FC6B0 /begin FUNCTION_LIST DSP /end FUNCTION_LIST /end MEASUREMENT
/begin MEASUREMENT dsp_ZylDat_10of10_.d2p.IonKnockMaxAngle "IonKnockMaxAngle,27,Y" SLONG FORMULA_0095 0 0 -50.0000 60.0000 ECU_ADDRESS 0x3FC758 /begin FUNCTION_LIST DSP /end FUNCTION_LIST /end MEASUREMENT
/begin MEASUREMENT dsp_ZylDat_1of10_.d2p.IonKnockAveValue "IonKnockAveValue,28,Y" SLONG FORMULA_0097 0 0 0.0 10.0000 ECU_ADDRESS 0x3FC174 /begin FUNCTION_LIST DSP /end FUNCTION_LIST /end MEASUREMENT
/begin MEASUREMENT dsp_ZylDat_2of10_.d2p.IonKnockAveValue "IonKnockAveValue,28,Y" SLONG FORMULA_0097 0 0 0.0 10.0000 ECU_ADDRESS 0x3FC21C /begin FUNCTION_LIST DSP /end FUNCTION_LIST /end MEASUREMENT
/begin MEASUREMENT dsp_ZylDat_3of10_.d2p.IonKnockAveValue "IonKnockAveValue,28,Y" SLONG FORMULA_0097 0 0 0.0 10.0000 ECU_ADDRESS 0x3FC2C4 /begin FUNCTION_LIST DSP /end FUNCTION_LIST /end MEASUREMENT
/begin MEASUREMENT dsp_ZylDat_4of10_.d2p.IonKnockAveValue "IonKnockAveValue,28,Y" SLONG FORMULA_0097 0 0 0.0 10.0000 ECU_ADDRESS 0x3FC36C /begin FUNCTION_LIST DSP /end FUNCTION_LIST /end MEASUREMENT
/begin MEASUREMENT dsp_ZylDat_5of10_.d2p.IonKnockAveValue "IonKnockAveValue,28,Y" SLONG FORMULA_0097 0 0 0.0 10.0000 ECU_ADDRESS 0x3FC414 /begin FUNCTION_LIST DSP /end FUNCTION_LIST /end MEASUREMENT
/begin MEASUREMENT dsp_ZylDat_6of10_.d2p.IonKnockAveValue "IonKnockAveValue,28,Y" SLONG FORMULA_0097 0 0 0.0 10.0000 ECU_ADDRESS 0x3FC4BC /begin FUNCTION_LIST DSP /end FUNCTION_LIST /end MEASUREMENT
/begin MEASUREMENT dsp_ZylDat_7of10_.d2p.IonKnockAveValue "IonKnockAveValue,28,Y" SLONG FORMULA_0097 0 0 0.0 10.0000 ECU_ADDRESS 0x3FC564 /begin FUNCTION_LIST DSP /end FUNCTION_LIST /end MEASUREMENT
/begin MEASUREMENT dsp_ZylDat_8of10_.d2p.IonKnockAveValue "IonKnockAveValue,28,Y" SLONG FORMULA_0097 0 0 0.0 10.0000 ECU_ADDRESS 0x3FC60C /begin FUNCTION_LIST DSP /end FUNCTION_LIST /end MEASUREMENT
/begin MEASUREMENT dsp_ZylDat_9of10_.d2p.IonKnockAveValue "IonKnockAveValue,28,Y" SLONG FORMULA_0097 0 0 0.0 10.0000 ECU_ADDRESS 0x3FC6B4 /begin FUNCTION_LIST DSP /end FUNCTION_LIST /end MEASUREMENT
/begin MEASUREMENT dsp_ZylDat_10of10_.d2p.IonKnockAveValue "IonKnockAveValue,28,Y" SLONG FORMULA_0097 0 0 0.0 10.0000 ECU_ADDRESS 0x3FC75C /begin FUNCTION_LIST DSP /end FUNCTION_LIST /end MEASUREMENT
/begin MEASUREMENT dsp_ZylDat_1of10_.d2p.IonKnockAveAngle "IonKnockAveAngle,29,Y" SLONG FORMULA_0095 0 0 -50.0000 60.0000 ECU_ADDRESS 0x3FC178 /begin FUNCTION_LIST DSP /end FUNCTION_LIST /end MEASUREMENT
/begin MEASUREMENT dsp_ZylDat_2of10_.d2p.IonKnockAveAngle "IonKnockAveAngle,29,Y" SLONG FORMULA_0095 0 0 -50.0000 60.0000 ECU_ADDRESS 0x3FC220 /begin FUNCTION_LIST DSP /end FUNCTION_LIST /end MEASUREMENT
/begin MEASUREMENT dsp_ZylDat_3of10_.d2p.IonKnockAveAngle "IonKnockAveAngle,29,Y" SLONG FORMULA_0095 0 0 -50.0000 60.0000 ECU_ADDRESS 0x3FC2C8 /begin FUNCTION_LIST DSP /end FUNCTION_LIST /end MEASUREMENT
/begin MEASUREMENT dsp_ZylDat_4of10_.d2p.IonKnockAveAngle "IonKnockAveAngle,29,Y" SLONG FORMULA_0095 0 0 -50.0000 60.0000 ECU_ADDRESS 0x3FC370 /begin FUNCTION_LIST DSP /end FUNCTION_LIST /end MEASUREMENT
/begin MEASUREMENT dsp_ZylDat_5of10_.d2p.IonKnockAveAngle "IonKnockAveAngle,29,Y" SLONG FORMULA_0095 0 0 -50.0000 60.0000 ECU_ADDRESS 0x3FC418 /begin FUNCTION_LIST DSP /end FUNCTION_LIST /end MEASUREMENT
/begin MEASUREMENT dsp_ZylDat_6of10_.d2p.IonKnockAveAngle "IonKnockAveAngle,29,Y" SLONG FORMULA_0095 0 0 -50.0000 60.0000 ECU_ADDRESS 0x3FC4C0 /begin FUNCTION_LIST DSP /end FUNCTION_LIST /end MEASUREMENT
/begin MEASUREMENT dsp_ZylDat_7of10_.d2p.IonKnockAveAngle "IonKnockAveAngle,29,Y" SLONG FORMULA_0095 0 0 -50.0000 60.0000 ECU_ADDRESS 0x3FC568 /begin FUNCTION_LIST DSP /end FUNCTION_LIST /end MEASUREMENT
/begin MEASUREMENT dsp_ZylDat_8of10_.d2p.IonKnockAveAngle "IonKnockAveAngle,29,Y" SLONG FORMULA_0095 0 0 -50.0000 60.0000 ECU_ADDRESS 0x3FC610 /begin FUNCTION_LIST DSP /end FUNCTION_LIST /end MEASUREMENT
/begin MEASUREMENT dsp_ZylDat_9of10_.d2p.IonKnockAveAngle "IonKnockAveAngle,29,Y" SLONG FORMULA_0095 0 0 -50.0000 60.0000 ECU_ADDRESS 0x3FC6B8 /begin FUNCTION_LIST DSP /end FUNCTION_LIST /end MEASUREMENT
/begin MEASUREMENT dsp_ZylDat_10of10_.d2p.IonKnockAveAngle "IonKnockAveAngle,29,Y" SLONG FORMULA_0095 0 0 -50.0000 60.0000 ECU_ADDRESS 0x3FC760 /begin FUNCTION_LIST DSP /end FUNCTION_LIST /end MEASUREMENT
/begin MEASUREMENT dsp_ZylDat_1of10_.d2p.IonKnockIntgValue "IonKnockIntgValue,30,Y" SLONG FORMULA_0001 0 0 -2147483648.0000 2147483647.0000 ECU_ADDRESS 0x3FC17C /begin FUNCTION_LIST DSP /end FUNCTION_LIST /end MEASUREMENT
/begin MEASUREMENT dsp_ZylDat_2of10_.d2p.IonKnockIntgValue "IonKnockIntgValue,30,Y" SLONG FORMULA_0001 0 0 -2147483648.0000 2147483647.0000 ECU_ADDRESS 0x3FC224 /begin FUNCTION_LIST DSP /end FUNCTION_LIST /end MEASUREMENT
/begin MEASUREMENT dsp_ZylDat_3of10_.d2p.IonKnockIntgValue "IonKnockIntgValue,30,Y" SLONG FORMULA_0001 0 0 -2147483648.0000 2147483647.0000 ECU_ADDRESS 0x3FC2CC /begin FUNCTION_LIST DSP /end FUNCTION_LIST /end MEASUREMENT
/begin MEASUREMENT dsp_ZylDat_4of10_.d2p.IonKnockIntgValue "IonKnockIntgValue,30,Y" SLONG FORMULA_0001 0 0 -2147483648.0000 2147483647.0000 ECU_ADDRESS 0x3FC374 /begin FUNCTION_LIST DSP /end FUNCTION_LIST /end MEASUREMENT
/begin MEASUREMENT dsp_ZylDat_5of10_.d2p.IonKnockIntgValue "IonKnockIntgValue,30,Y" SLONG FORMULA_0001 0 0 -2147483648.0000 2147483647.0000 ECU_ADDRESS 0x3FC41C /begin FUNCTION_LIST DSP /end FUNCTION_LIST /end MEASUREMENT
/begin MEASUREMENT dsp_ZylDat_6of10_.d2p.IonKnockIntgValue "IonKnockIntgValue,30,Y" SLONG FORMULA_0001 0 0 -2147483648.0000 2147483647.0000 ECU_ADDRESS 0x3FC4C4 /begin FUNCTION_LIST DSP /end FUNCTION_LIST /end MEASUREMENT
/begin MEASUREMENT dsp_ZylDat_7of10_.d2p.IonKnockIntgValue "IonKnockIntgValue,30,Y" SLONG FORMULA_0001 0 0 -2147483648.0000 2147483647.0000 ECU_ADDRESS 0x3FC56C /begin FUNCTION_LIST DSP /end FUNCTION_LIST /end MEASUREMENT
/begin MEASUREMENT dsp_ZylDat_8of10_.d2p.IonKnockIntgValue "IonKnockIntgValue,30,Y" SLONG FORMULA_0001 0 0 -2147483648.0000 2147483647.0000 ECU_ADDRESS 0x3FC614 /begin FUNCTION_LIST DSP /end FUNCTION_LIST /end MEASUREMENT
/begin MEASUREMENT dsp_ZylDat_9of10_.d2p.IonKnockIntgValue "IonKnockIntgValue,30,Y" SLONG FORMULA_0001 0 0 -2147483648.0000 2147483647.0000 ECU_ADDRESS 0x3FC6BC /begin FUNCTION_LIST DSP /end FUNCTION_LIST /end MEASUREMENT
/begin MEASUREMENT dsp_ZylDat_10of10_.d2p.IonKnockIntgValue "IonKnockIntgValue,30,Y" SLONG FORMULA_0001 0 0 -2147483648.0000 2147483647.0000 ECU_ADDRESS 0x3FC764 /begin FUNCTION_LIST DSP /end FUNCTION_LIST /end MEASUREMENT
/begin MEASUREMENT dsp_ZylDat_1of10_.d2p.PreMaxValue "PreMaxValue,31,Y" SLONG FORMULA_0098 0 0 0.0 150.0000 ECU_ADDRESS 0x3FC180 /begin FUNCTION_LIST DSP /end FUNCTION_LIST /end MEASUREMENT
/begin MEASUREMENT dsp_ZylDat_2of10_.d2p.PreMaxValue "PreMaxValue,31,Y" SLONG FORMULA_0098 0 0 0.0 150.0000 ECU_ADDRESS 0x3FC228 /begin FUNCTION_LIST DSP /end FUNCTION_LIST /end MEASUREMENT
/begin MEASUREMENT dsp_ZylDat_3of10_.d2p.PreMaxValue "PreMaxValue,31,Y" SLONG FORMULA_0098 0 0 0.0 150.0000 ECU_ADDRESS 0x3FC2D0 /begin FUNCTION_LIST DSP /end FUNCTION_LIST /end MEASUREMENT
/begin MEASUREMENT dsp_ZylDat_4of10_.d2p.PreMaxValue "PreMaxValue,31,Y" SLONG FORMULA_0098 0 0 0.0 150.0000 ECU_ADDRESS 0x3FC378 /begin FUNCTION_LIST DSP /end FUNCTION_LIST /end MEASUREMENT
/begin MEASUREMENT dsp_ZylDat_5of10_.d2p.PreMaxValue "PreMaxValue,31,Y" SLONG FORMULA_0098 0 0 0.0 150.0000 ECU_ADDRESS 0x3FC420 /begin FUNCTION_LIST DSP /end FUNCTION_LIST /end MEASUREMENT
/begin MEASUREMENT dsp_ZylDat_6of10_.d2p.PreMaxValue "PreMaxValue,31,Y" SLONG FORMULA_0098 0 0 0.0 150.0000 ECU_ADDRESS 0x3FC4C8 /begin FUNCTION_LIST DSP /end FUNCTION_LIST /end MEASUREMENT
/begin MEASUREMENT dsp_ZylDat_7of10_.d2p.PreMaxValue "PreMaxValue,31,Y" SLONG FORMULA_0098 0 0 0.0 150.0000 ECU_ADDRESS 0x3FC570 /begin FUNCTION_LIST DSP /end FUNCTION_LIST /end MEASUREMENT
/begin MEASUREMENT dsp_ZylDat_8of10_.d2p.PreMaxValue "PreMaxValue,31,Y" SLONG FORMULA_0098 0 0 0.0 150.0000 ECU_ADDRESS 0x3FC618 /begin FUNCTION_LIST DSP /end FUNCTION_LIST /end MEASUREMENT
/begin MEASUREMENT dsp_ZylDat_9of10_.d2p.PreMaxValue "PreMaxValue,31,Y" SLONG FORMULA_0098 0 0 0.0 150.0000 ECU_ADDRESS 0x3FC6C0 /begin FUNCTION_LIST DSP /end FUNCTION_LIST /end MEASUREMENT
/begin MEASUREMENT dsp_ZylDat_10of10_.d2p.PreMaxValue "PreMaxValue,31,Y" SLONG FORMULA_0098 0 0 0.0 150.0000 ECU_ADDRESS 0x3FC768 /begin FUNCTION_LIST DSP /end FUNCTION_LIST /end MEASUREMENT
/begin MEASUREMENT dsp_ZylDat_1of10_.d2p.PreMaxAngle "PreMaxAngle,32,Y" SLONG FORMULA_0095 0 0 -50.0000 60.0000 ECU_ADDRESS 0x3FC184 /begin FUNCTION_LIST DSP /end FUNCTION_LIST /end MEASUREMENT
/begin MEASUREMENT dsp_ZylDat_2of10_.d2p.PreMaxAngle "PreMaxAngle,32,Y" SLONG FORMULA_0095 0 0 -50.0000 60.0000 ECU_ADDRESS 0x3FC22C /begin FUNCTION_LIST DSP /end FUNCTION_LIST /end MEASUREMENT
/begin MEASUREMENT dsp_ZylDat_3of10_.d2p.PreMaxAngle "PreMaxAngle,32,Y" SLONG FORMULA_0095 0 0 -50.0000 60.0000 ECU_ADDRESS 0x3FC2D4 /begin FUNCTION_LIST DSP /end FUNCTION_LIST /end MEASUREMENT
/begin MEASUREMENT dsp_ZylDat_4of10_.d2p.PreMaxAngle "PreMaxAngle,32,Y" SLONG FORMULA_0095 0 0 -50.0000 60.0000 ECU_ADDRESS 0x3FC37C /begin FUNCTION_LIST DSP /end FUNCTION_LIST /end MEASUREMENT
/begin MEASUREMENT dsp_ZylDat_5of10_.d2p.PreMaxAngle "PreMaxAngle,32,Y" SLONG FORMULA_0095 0 0 -50.0000 60.0000 ECU_ADDRESS 0x3FC424 /begin FUNCTION_LIST DSP /end FUNCTION_LIST /end MEASUREMENT
/begin MEASUREMENT dsp_ZylDat_6of10_.d2p.PreMaxAngle "PreMaxAngle,32,Y" SLONG FORMULA_0095 0 0 -50.0000 60.0000 ECU_ADDRESS 0x3FC4CC /begin FUNCTION_LIST DSP /end FUNCTION_LIST /end MEASUREMENT
/begin MEASUREMENT dsp_ZylDat_7of10_.d2p.PreMaxAngle "PreMaxAngle,32,Y" SLONG FORMULA_0095 0 0 -50.0000 60.0000 ECU_ADDRESS 0x3FC574 /begin FUNCTION_LIST DSP /end FUNCTION_LIST /end MEASUREMENT
/begin MEASUREMENT dsp_ZylDat_8of10_.d2p.PreMaxAngle "PreMaxAngle,32,Y" SLONG FORMULA_0095 0 0 -50.0000 60.0000 ECU_ADDRESS 0x3FC61C /begin FUNCTION_LIST DSP /end FUNCTION_LIST /end MEASUREMENT
/begin MEASUREMENT dsp_ZylDat_9of10_.d2p.PreMaxAngle "PreMaxAngle,32,Y" SLONG FORMULA_0095 0 0 -50.0000 60.0000 ECU_ADDRESS 0x3FC6C4 /begin FUNCTION_LIST DSP /end FUNCTION_LIST /end MEASUREMENT
/begin MEASUREMENT dsp_ZylDat_10of10_.d2p.PreMaxAngle "PreMaxAngle,32,Y" SLONG FORMULA_0095 0 0 -50.0000 60.0000 ECU_ADDRESS 0x3FC76C /begin FUNCTION_LIST DSP /end FUNCTION_LIST /end MEASUREMENT
/begin MEASUREMENT dsp_ZylDat_1of10_.d2p.PreAveValue "PreAveValue,33,Y" ULONG FORMULA_0098 0 0 0.0 150.0000 ECU_ADDRESS 0x3FC188 /begin FUNCTION_LIST DSP /end FUNCTION_LIST /end MEASUREMENT
/begin MEASUREMENT dsp_ZylDat_2of10_.d2p.PreAveValue "PreAveValue,33,Y" ULONG FORMULA_0098 0 0 0.0 150.0000 ECU_ADDRESS 0x3FC230 /begin FUNCTION_LIST DSP /end FUNCTION_LIST /end MEASUREMENT
/begin MEASUREMENT dsp_ZylDat_3of10_.d2p.PreAveValue "PreAveValue,33,Y" ULONG FORMULA_0098 0 0 0.0 150.0000 ECU_ADDRESS 0x3FC2D8 /begin FUNCTION_LIST DSP /end FUNCTION_LIST /end MEASUREMENT
/begin MEASUREMENT dsp_ZylDat_4of10_.d2p.PreAveValue "PreAveValue,33,Y" ULONG FORMULA_0098 0 0 0.0 150.0000 ECU_ADDRESS 0x3FC380 /begin FUNCTION_LIST DSP /end FUNCTION_LIST /end MEASUREMENT
/begin MEASUREMENT dsp_ZylDat_5of10_.d2p.PreAveValue "PreAveValue,33,Y" ULONG FORMULA_0098 0 0 0.0 150.0000 ECU_ADDRESS 0x3FC428 /begin FUNCTION_LIST DSP /end FUNCTION_LIST /end MEASUREMENT
/begin MEASUREMENT dsp_ZylDat_6of10_.d2p.PreAveValue "PreAveValue,33,Y" ULONG FORMULA_0098 0 0 0.0 150.0000 ECU_ADDRESS 0x3FC4D0 /begin FUNCTION_LIST DSP /end FUNCTION_LIST /end MEASUREMENT
/begin MEASUREMENT dsp_ZylDat_7of10_.d2p.PreAveValue "PreAveValue,33,Y" ULONG FORMULA_0098 0 0 0.0 150.0000 ECU_ADDRESS 0x3FC578 /begin FUNCTION_LIST DSP /end FUNCTION_LIST /end MEASUREMENT
/begin MEASUREMENT dsp_ZylDat_8of10_.d2p.PreAveValue "PreAveValue,33,Y" ULONG FORMULA_0098 0 0 0.0 150.0000 ECU_ADDRESS 0x3FC620 /begin FUNCTION_LIST DSP /end FUNCTION_LIST /end MEASUREMENT
/begin MEASUREMENT dsp_ZylDat_9of10_.d2p.PreAveValue "PreAveValue,33,Y" ULONG FORMULA_0098 0 0 0.0 150.0000 ECU_ADDRESS 0x3FC6C8 /begin FUNCTION_LIST DSP /end FUNCTION_LIST /end MEASUREMENT
/begin MEASUREMENT dsp_ZylDat_10of10_.d2p.PreAveValue "PreAveValue,33,Y" ULONG FORMULA_0098 0 0 0.0 150.0000 ECU_ADDRESS 0x3FC770 /begin FUNCTION_LIST DSP /end FUNCTION_LIST /end MEASUREMENT
/begin MEASUREMENT dsp_ZylDat_1of10_.d2p.PreAveAngle "PreAveAngle,34,Y" SLONG FORMULA_0095 0 0 -50.0000 60.0000 ECU_ADDRESS 0x3FC18C /begin FUNCTION_LIST DSP /end FUNCTION_LIST /end MEASUREMENT
/begin MEASUREMENT dsp_ZylDat_2of10_.d2p.PreAveAngle "PreAveAngle,34,Y" SLONG FORMULA_0095 0 0 -50.0000 60.0000 ECU_ADDRESS 0x3FC234 /begin FUNCTION_LIST DSP /end FUNCTION_LIST /end MEASUREMENT
/begin MEASUREMENT dsp_ZylDat_3of10_.d2p.PreAveAngle "PreAveAngle,34,Y" SLONG FORMULA_0095 0 0 -50.0000 60.0000 ECU_ADDRESS 0x3FC2DC /begin FUNCTION_LIST DSP /end FUNCTION_LIST /end MEASUREMENT
/begin MEASUREMENT dsp_ZylDat_4of10_.d2p.PreAveAngle "PreAveAngle,34,Y" SLONG FORMULA_0095 0 0 -50.0000 60.0000 ECU_ADDRESS 0x3FC384 /begin FUNCTION_LIST DSP /end FUNCTION_LIST /end MEASUREMENT
/begin MEASUREMENT dsp_ZylDat_5of10_.d2p.PreAveAngle "PreAveAngle,34,Y" SLONG FORMULA_0095 0 0 -50.0000 60.0000 ECU_ADDRESS 0x3FC42C /begin FUNCTION_LIST DSP /end FUNCTION_LIST /end MEASUREMENT
/begin MEASUREMENT dsp_ZylDat_6of10_.d2p.PreAveAngle "PreAveAngle,34,Y" SLONG FORMULA_0095 0 0 -50.0000 60.0000 ECU_ADDRESS 0x3FC4D4 /begin FUNCTION_LIST DSP /end FUNCTION_LIST /end MEASUREMENT
/begin MEASUREMENT dsp_ZylDat_7of10_.d2p.PreAveAngle "PreAveAngle,34,Y" SLONG FORMULA_0095 0 0 -50.0000 60.0000 ECU_ADDRESS 0x3FC57C /begin FUNCTION_LIST DSP /end FUNCTION_LIST /end MEASUREMENT
/begin MEASUREMENT dsp_ZylDat_8of10_.d2p.PreAveAngle "PreAveAngle,34,Y" SLONG FORMULA_0095 0 0 -50.0000 60.0000 ECU_ADDRESS 0x3FC624 /begin FUNCTION_LIST DSP /end FUNCTION_LIST /end MEASUREMENT
/begin MEASUREMENT dsp_ZylDat_9of10_.d2p.PreAveAngle "PreAveAngle,34,Y" SLONG FORMULA_0095 0 0 -50.0000 60.0000 ECU_ADDRESS 0x3FC6CC /begin FUNCTION_LIST DSP /end FUNCTION_LIST /end MEASUREMENT
/begin MEASUREMENT dsp_ZylDat_10of10_.d2p.PreAveAngle "PreAveAngle,34,Y" SLONG FORMULA_0095 0 0 -50.0000 60.0000 ECU_ADDRESS 0x3FC774 /begin FUNCTION_LIST DSP /end FUNCTION_LIST /end MEASUREMENT
/begin MEASUREMENT dsp_ZylDat_1of10_.d2p.PreKnockIntg "PreKnockIntg,35,Y" ULONG FORMULA_0001 0 0 0.0 2147483647.0000 ECU_ADDRESS 0x3FC190 /begin FUNCTION_LIST DSP /end FUNCTION_LIST /end MEASUREMENT
/begin MEASUREMENT dsp_ZylDat_2of10_.d2p.PreKnockIntg "PreKnockIntg,35,Y" ULONG FORMULA_0001 0 0 0.0 2147483647.0000 ECU_ADDRESS 0x3FC238 /begin FUNCTION_LIST DSP /end FUNCTION_LIST /end MEASUREMENT
/begin MEASUREMENT dsp_ZylDat_3of10_.d2p.PreKnockIntg "PreKnockIntg,35,Y" ULONG FORMULA_0001 0 0 0.0 2147483647.0000 ECU_ADDRESS 0x3FC2E0 /begin FUNCTION_LIST DSP /end FUNCTION_LIST /end MEASUREMENT
/begin MEASUREMENT dsp_ZylDat_4of10_.d2p.PreKnockIntg "PreKnockIntg,35,Y" ULONG FORMULA_0001 0 0 0.0 2147483647.0000 ECU_ADDRESS 0x3FC388 /begin FUNCTION_LIST DSP /end FUNCTION_LIST /end MEASUREMENT
/begin MEASUREMENT dsp_ZylDat_5of10_.d2p.PreKnockIntg "PreKnockIntg,35,Y" ULONG FORMULA_0001 0 0 0.0 2147483647.0000 ECU_ADDRESS 0x3FC430 /begin FUNCTION_LIST DSP /end FUNCTION_LIST /end MEASUREMENT
/begin MEASUREMENT dsp_ZylDat_6of10_.d2p.PreKnockIntg "PreKnockIntg,35,Y" ULONG FORMULA_0001 0 0 0.0 2147483647.0000 ECU_ADDRESS 0x3FC4D8 /begin FUNCTION_LIST DSP /end FUNCTION_LIST /end MEASUREMENT
/begin MEASUREMENT dsp_ZylDat_7of10_.d2p.PreKnockIntg "PreKnockIntg,35,Y" ULONG FORMULA_0001 0 0 0.0 2147483647.0000 ECU_ADDRESS 0x3FC580 /begin FUNCTION_LIST DSP /end FUNCTION_LIST /end MEASUREMENT
/begin MEASUREMENT dsp_ZylDat_8of10_.d2p.PreKnockIntg "PreKnockIntg,35,Y" ULONG FORMULA_0001 0 0 0.0 2147483647.0000 ECU_ADDRESS 0x3FC628 /begin FUNCTION_LIST DSP /end FUNCTION_LIST /end MEASUREMENT
/begin MEASUREMENT dsp_ZylDat_9of10_.d2p.PreKnockIntg "PreKnockIntg,35,Y" ULONG FORMULA_0001 0 0 0.0 2147483647.0000 ECU_ADDRESS 0x3FC6D0 /begin FUNCTION_LIST DSP /end FUNCTION_LIST /end MEASUREMENT
/begin MEASUREMENT dsp_ZylDat_10of10_.d2p.PreKnockIntg "PreKnockIntg,35,Y" ULONG FORMULA_0001 0 0 0.0 2147483647.0000 ECU_ADDRESS 0x3FC778 /begin FUNCTION_LIST DSP /end FUNCTION_LIST /end MEASUREMENT
/begin MEASUREMENT dsp_ZylDat_1of10_.d2p.PreEffValue "PreEffValue,36,Y" ULONG FORMULA_0098 0 0 0.0 150.0000 ECU_ADDRESS 0x3FC194 /begin FUNCTION_LIST DSP /end FUNCTION_LIST /end MEASUREMENT
/begin MEASUREMENT dsp_ZylDat_2of10_.d2p.PreEffValue "PreEffValue,36,Y" ULONG FORMULA_0098 0 0 0.0 150.0000 ECU_ADDRESS 0x3FC23C /begin FUNCTION_LIST DSP /end FUNCTION_LIST /end MEASUREMENT
/begin MEASUREMENT dsp_ZylDat_3of10_.d2p.PreEffValue "PreEffValue,36,Y" ULONG FORMULA_0098 0 0 0.0 150.0000 ECU_ADDRESS 0x3FC2E4 /begin FUNCTION_LIST DSP /end FUNCTION_LIST /end MEASUREMENT
/begin MEASUREMENT dsp_ZylDat_4of10_.d2p.PreEffValue "PreEffValue,36,Y" ULONG FORMULA_0098 0 0 0.0 150.0000 ECU_ADDRESS 0x3FC38C /begin FUNCTION_LIST DSP /end FUNCTION_LIST /end MEASUREMENT
/begin MEASUREMENT dsp_ZylDat_5of10_.d2p.PreEffValue "PreEffValue,36,Y" ULONG FORMULA_0098 0 0 0.0 150.0000 ECU_ADDRESS 0x3FC434 /begin FUNCTION_LIST DSP /end FUNCTION_LIST /end MEASUREMENT
/begin MEASUREMENT dsp_ZylDat_6of10_.d2p.PreEffValue "PreEffValue,36,Y" ULONG FORMULA_0098 0 0 0.0 150.0000 ECU_ADDRESS 0x3FC4DC /begin FUNCTION_LIST DSP /end FUNCTION_LIST /end MEASUREMENT
/begin MEASUREMENT dsp_ZylDat_7of10_.d2p.PreEffValue "PreEffValue,36,Y" ULONG FORMULA_0098 0 0 0.0 150.0000 ECU_ADDRESS 0x3FC584 /begin FUNCTION_LIST DSP /end FUNCTION_LIST /end MEASUREMENT
/begin MEASUREMENT dsp_ZylDat_8of10_.d2p.PreEffValue "PreEffValue,36,Y" ULONG FORMULA_0098 0 0 0.0 150.0000 ECU_ADDRESS 0x3FC62C /begin FUNCTION_LIST DSP /end FUNCTION_LIST /end MEASUREMENT
/begin MEASUREMENT dsp_ZylDat_9of10_.d2p.PreEffValue "PreEffValue,36,Y" ULONG FORMULA_0098 0 0 0.0 150.0000 ECU_ADDRESS 0x3FC6D4 /begin FUNCTION_LIST DSP /end FUNCTION_LIST /end MEASUREMENT
/begin MEASUREMENT dsp_ZylDat_10of10_.d2p.PreEffValue "PreEffValue,36,Y" ULONG FORMULA_0098 0 0 0.0 150.0000 ECU_ADDRESS 0x3FC77C /begin FUNCTION_LIST DSP /end FUNCTION_LIST /end MEASUREMENT
/begin MEASUREMENT dsp_ZylDat_1of10_.d2p.ion_tz_offs_time "KnockSamplePoints,37,Y" ULONG FORMULA_0001 0 0 0.0 1000.0000 ECU_ADDRESS 0x3FC198 /begin FUNCTION_LIST DSP /end FUNCTION_LIST /end MEASUREMENT
/begin MEASUREMENT dsp_ZylDat_2of10_.d2p.ion_tz_offs_time "KnockSamplePoints,37,Y" ULONG FORMULA_0001 0 0 0.0 1000.0000 ECU_ADDRESS 0x3FC240 /begin FUNCTION_LIST DSP /end FUNCTION_LIST /end MEASUREMENT
/begin MEASUREMENT dsp_ZylDat_3of10_.d2p.ion_tz_offs_time "KnockSamplePoints,37,Y" ULONG FORMULA_0001 0 0 0.0 1000.0000 ECU_ADDRESS 0x3FC2E8 /begin FUNCTION_LIST DSP /end FUNCTION_LIST /end MEASUREMENT
/begin MEASUREMENT dsp_ZylDat_4of10_.d2p.ion_tz_offs_time "KnockSamplePoints,37,Y" ULONG FORMULA_0001 0 0 0.0 1000.0000 ECU_ADDRESS 0x3FC390 /begin FUNCTION_LIST DSP /end FUNCTION_LIST /end MEASUREMENT
/begin MEASUREMENT dsp_ZylDat_5of10_.d2p.ion_tz_offs_time "KnockSamplePoints,37,Y" ULONG FORMULA_0001 0 0 0.0 1000.0000 ECU_ADDRESS 0x3FC438 /begin FUNCTION_LIST DSP /end FUNCTION_LIST /end MEASUREMENT
/begin MEASUREMENT dsp_ZylDat_6of10_.d2p.ion_tz_offs_time "KnockSamplePoints,37,Y" ULONG FORMULA_0001 0 0 0.0 1000.0000 ECU_ADDRESS 0x3FC4E0 /begin FUNCTION_LIST DSP /end FUNCTION_LIST /end MEASUREMENT
/begin MEASUREMENT dsp_ZylDat_7of10_.d2p.ion_tz_offs_time "KnockSamplePoints,37,Y" ULONG FORMULA_0001 0 0 0.0 1000.0000 ECU_ADDRESS 0x3FC588 /begin FUNCTION_LIST DSP /end FUNCTION_LIST /end MEASUREMENT
/begin MEASUREMENT dsp_ZylDat_8of10_.d2p.ion_tz_offs_time "KnockSamplePoints,37,Y" ULONG FORMULA_0001 0 0 0.0 1000.0000 ECU_ADDRESS 0x3FC630 /begin FUNCTION_LIST DSP /end FUNCTION_LIST /end MEASUREMENT
/begin MEASUREMENT dsp_ZylDat_9of10_.d2p.ion_tz_offs_time "KnockSamplePoints,37,Y" ULONG FORMULA_0001 0 0 0.0 1000.0000 ECU_ADDRESS 0x3FC6D8 /begin FUNCTION_LIST DSP /end FUNCTION_LIST /end MEASUREMENT
/begin MEASUREMENT dsp_ZylDat_10of10_.d2p.ion_tz_offs_time "KnockSamplePoints,37,Y" ULONG FORMULA_0001 0 0 0.0 1000.0000 ECU_ADDRESS 0x3FC780 /begin FUNCTION_LIST DSP /end FUNCTION_LIST /end MEASUREMENT
/begin MEASUREMENT dsp_ZylDat_1of10_.d2p.IonGain "IonGain,38,Y" ULONG FORMULA_0001 0 0 0.0 3.0000 ECU_ADDRESS 0x3FC19C /begin FUNCTION_LIST DSP /end FUNCTION_LIST /end MEASUREMENT
/begin MEASUREMENT dsp_ZylDat_2of10_.d2p.IonGain "IonGain,38,Y" ULONG FORMULA_0001 0 0 0.0 3.0000 ECU_ADDRESS 0x3FC244 /begin FUNCTION_LIST DSP /end FUNCTION_LIST /end MEASUREMENT
/begin MEASUREMENT dsp_ZylDat_3of10_.d2p.IonGain "IonGain,38,Y" ULONG FORMULA_0001 0 0 0.0 3.0000 ECU_ADDRESS 0x3FC2EC /begin FUNCTION_LIST DSP /end FUNCTION_LIST /end MEASUREMENT
/begin MEASUREMENT dsp_ZylDat_4of10_.d2p.IonGain "IonGain,38,Y" ULONG FORMULA_0001 0 0 0.0 3.0000 ECU_ADDRESS 0x3FC394 /begin FUNCTION_LIST DSP /end FUNCTION_LIST /end MEASUREMENT
/begin MEASUREMENT dsp_ZylDat_5of10_.d2p.IonGain "IonGain,38,Y" ULONG FORMULA_0001 0 0 0.0 3.0000 ECU_ADDRESS 0x3FC43C /begin FUNCTION_LIST DSP /end FUNCTION_LIST /end MEASUREMENT
/begin MEASUREMENT dsp_ZylDat_6of10_.d2p.IonGain "IonGain,38,Y" ULONG FORMULA_0001 0 0 0.0 3.0000 ECU_ADDRESS 0x3FC4E4 /begin FUNCTION_LIST DSP /end FUNCTION_LIST /end MEASUREMENT
/begin MEASUREMENT dsp_ZylDat_7of10_.d2p.IonGain "IonGain,38,Y" ULONG FORMULA_0001 0 0 0.0 3.0000 ECU_ADDRESS 0x3FC58C /begin FUNCTION_LIST DSP /end FUNCTION_LIST /end MEASUREMENT
/begin MEASUREMENT dsp_ZylDat_8of10_.d2p.IonGain "IonGain,38,Y" ULONG FORMULA_0001 0 0 0.0 3.0000 ECU_ADDRESS 0x3FC634 /begin FUNCTION_LIST DSP /end FUNCTION_LIST /end MEASUREMENT
/begin MEASUREMENT dsp_ZylDat_9of10_.d2p.IonGain "IonGain,38,Y" ULONG FORMULA_0001 0 0 0.0 3.0000 ECU_ADDRESS 0x3FC6DC /begin FUNCTION_LIST DSP /end FUNCTION_LIST /end MEASUREMENT
/begin MEASUREMENT dsp_ZylDat_10of10_.d2p.IonGain "IonGain,38,Y" ULONG FORMULA_0001 0 0 0.0 3.0000 ECU_ADDRESS 0x3FC784 /begin FUNCTION_LIST DSP /end FUNCTION_LIST /end MEASUREMENT
/begin MEASUREMENT dsp_ZylDat_1of10_.d2p.SystemGain "SystemGain,39,Y" ULONG FORMULA_0001 0 0 0.0 63.0000 ECU_ADDRESS 0x3FC1A0 /begin FUNCTION_LIST DSP /end FUNCTION_LIST /end MEASUREMENT
/begin MEASUREMENT dsp_ZylDat_2of10_.d2p.SystemGain "SystemGain,39,Y" ULONG FORMULA_0001 0 0 0.0 63.0000 ECU_ADDRESS 0x3FC248 /begin FUNCTION_LIST DSP /end FUNCTION_LIST /end MEASUREMENT
/begin MEASUREMENT dsp_ZylDat_3of10_.d2p.SystemGain "SystemGain,39,Y" ULONG FORMULA_0001 0 0 0.0 63.0000 ECU_ADDRESS 0x3FC2F0 /begin FUNCTION_LIST DSP /end FUNCTION_LIST /end MEASUREMENT
/begin MEASUREMENT dsp_ZylDat_4of10_.d2p.SystemGain "SystemGain,39,Y" ULONG FORMULA_0001 0 0 0.0 63.0000 ECU_ADDRESS 0x3FC398 /begin FUNCTION_LIST DSP /end FUNCTION_LIST /end MEASUREMENT
/begin MEASUREMENT dsp_ZylDat_5of10_.d2p.SystemGain "SystemGain,39,Y" ULONG FORMULA_0001 0 0 0.0 63.0000 ECU_ADDRESS 0x3FC440 /begin FUNCTION_LIST DSP /end FUNCTION_LIST /end MEASUREMENT
/begin MEASUREMENT dsp_ZylDat_6of10_.d2p.SystemGain "SystemGain,39,Y" ULONG FORMULA_0001 0 0 0.0 63.0000 ECU_ADDRESS 0x3FC4E8 /begin FUNCTION_LIST DSP /end FUNCTION_LIST /end MEASUREMENT
/begin MEASUREMENT dsp_ZylDat_7of10_.d2p.SystemGain "SystemGain,39,Y" ULONG FORMULA_0001 0 0 0.0 63.0000 ECU_ADDRESS 0x3FC590 /begin FUNCTION_LIST DSP /end FUNCTION_LIST /end MEASUREMENT
/begin MEASUREMENT dsp_ZylDat_8of10_.d2p.SystemGain "SystemGain,39,Y" ULONG FORMULA_0001 0 0 0.0 63.0000 ECU_ADDRESS 0x3FC638 /begin FUNCTION_LIST DSP /end FUNCTION_LIST /end MEASUREMENT
/begin MEASUREMENT dsp_ZylDat_9of10_.d2p.SystemGain "SystemGain,39,Y" ULONG FORMULA_0001 0 0 0.0 63.0000 ECU_ADDRESS 0x3FC6E0 /begin FUNCTION_LIST DSP /end FUNCTION_LIST /end MEASUREMENT
/begin MEASUREMENT dsp_ZylDat_10of10_.d2p.SystemGain "SystemGain,39,Y" ULONG FORMULA_0001 0 0 0.0 63.0000 ECU_ADDRESS 0x3FC788 /begin FUNCTION_LIST DSP /end FUNCTION_LIST /end MEASUREMENT
/begin MEASUREMENT dsp_ZylDat_1of10_.d2p.PreasureSystemGain "PreasureSystemGain,40,Y" ULONG FORMULA_0001 0 0 0.0 63.0000 ECU_ADDRESS 0x3FC1A4 /begin FUNCTION_LIST DSP /end FUNCTION_LIST /end MEASUREMENT
/begin MEASUREMENT dsp_ZylDat_2of10_.d2p.PreasureSystemGain "PreasureSystemGain,40,Y" ULONG FORMULA_0001 0 0 0.0 63.0000 ECU_ADDRESS 0x3FC24C /begin FUNCTION_LIST DSP /end FUNCTION_LIST /end MEASUREMENT
/begin MEASUREMENT dsp_ZylDat_3of10_.d2p.PreasureSystemGain "PreasureSystemGain,40,Y" ULONG FORMULA_0001 0 0 0.0 63.0000 ECU_ADDRESS 0x3FC2F4 /begin FUNCTION_LIST DSP /end FUNCTION_LIST /end MEASUREMENT
/begin MEASUREMENT dsp_ZylDat_4of10_.d2p.PreasureSystemGain "PreasureSystemGain,40,Y" ULONG FORMULA_0001 0 0 0.0 63.0000 ECU_ADDRESS 0x3FC39C /begin FUNCTION_LIST DSP /end FUNCTION_LIST /end MEASUREMENT
/begin MEASUREMENT dsp_ZylDat_5of10_.d2p.PreasureSystemGain "PreasureSystemGain,40,Y" ULONG FORMULA_0001 0 0 0.0 63.0000 ECU_ADDRESS 0x3FC444 /begin FUNCTION_LIST DSP /end FUNCTION_LIST /end MEASUREMENT
/begin MEASUREMENT dsp_ZylDat_6of10_.d2p.PreasureSystemGain "PreasureSystemGain,40,Y" ULONG FORMULA_0001 0 0 0.0 63.0000 ECU_ADDRESS 0x3FC4EC /begin FUNCTION_LIST DSP /end FUNCTION_LIST /end MEASUREMENT
/begin MEASUREMENT dsp_ZylDat_7of10_.d2p.PreasureSystemGain "PreasureSystemGain,40,Y" ULONG FORMULA_0001 0 0 0.0 63.0000 ECU_ADDRESS 0x3FC594 /begin FUNCTION_LIST DSP /end FUNCTION_LIST /end MEASUREMENT
/begin MEASUREMENT dsp_ZylDat_8of10_.d2p.PreasureSystemGain "PreasureSystemGain,40,Y" ULONG FORMULA_0001 0 0 0.0 63.0000 ECU_ADDRESS 0x3FC63C /begin FUNCTION_LIST DSP /end FUNCTION_LIST /end MEASUREMENT
/begin MEASUREMENT dsp_ZylDat_9of10_.d2p.PreasureSystemGain "PreasureSystemGain,40,Y" ULONG FORMULA_0001 0 0 0.0 63.0000 ECU_ADDRESS 0x3FC6E4 /begin FUNCTION_LIST DSP /end FUNCTION_LIST /end MEASUREMENT
/begin MEASUREMENT dsp_ZylDat_10of10_.d2p.PreasureSystemGain "PreasureSystemGain,40,Y" ULONG FORMULA_0001 0 0 0.0 63.0000 ECU_ADDRESS 0x3FC78C /begin FUNCTION_LIST DSP /end FUNCTION_LIST /end MEASUREMENT
/begin MEASUREMENT dsp_ZylDat_1of10_.d2p.Error "Error,41,Y" SLONG FORMULA_0001 0 0 -2147483648.0000 2147483647.0000 ECU_ADDRESS 0x3FC1A8 /begin FUNCTION_LIST DSP /end FUNCTION_LIST /end MEASUREMENT
/begin MEASUREMENT dsp_ZylDat_2of10_.d2p.Error "Error,41,Y" SLONG FORMULA_0001 0 0 -2147483648.0000 2147483647.0000 ECU_ADDRESS 0x3FC250 /begin FUNCTION_LIST DSP /end FUNCTION_LIST /end MEASUREMENT
/begin MEASUREMENT dsp_ZylDat_3of10_.d2p.Error "Error,41,Y" SLONG FORMULA_0001 0 0 -2147483648.0000 2147483647.0000 ECU_ADDRESS 0x3FC2F8 /begin FUNCTION_LIST DSP /end FUNCTION_LIST /end MEASUREMENT
/begin MEASUREMENT dsp_ZylDat_4of10_.d2p.Error "Error,41,Y" SLONG FORMULA_0001 0 0 -2147483648.0000 2147483647.0000 ECU_ADDRESS 0x3FC3A0 /begin FUNCTION_LIST DSP /end FUNCTION_LIST /end MEASUREMENT
/begin MEASUREMENT dsp_ZylDat_5of10_.d2p.Error "Error,41,Y" SLONG FORMULA_0001 0 0 -2147483648.0000 2147483647.0000 ECU_ADDRESS 0x3FC448 /begin FUNCTION_LIST DSP /end FUNCTION_LIST /end MEASUREMENT
/begin MEASUREMENT dsp_ZylDat_6of10_.d2p.Error "Error,41,Y" SLONG FORMULA_0001 0 0 -2147483648.0000 2147483647.0000 ECU_ADDRESS 0x3FC4F0 /begin FUNCTION_LIST DSP /end FUNCTION_LIST /end MEASUREMENT
/begin MEASUREMENT dsp_ZylDat_7of10_.d2p.Error "Error,41,Y" SLONG FORMULA_0001 0 0 -2147483648.0000 2147483647.0000 ECU_ADDRESS 0x3FC598 /begin FUNCTION_LIST DSP /end FUNCTION_LIST /end MEASUREMENT
/begin MEASUREMENT dsp_ZylDat_8of10_.d2p.Error "Error,41,Y" SLONG FORMULA_0001 0 0 -2147483648.0000 2147483647.0000 ECU_ADDRESS 0x3FC640 /begin FUNCTION_LIST DSP /end FUNCTION_LIST /end MEASUREMENT
/begin MEASUREMENT dsp_ZylDat_9of10_.d2p.Error "Error,41,Y" SLONG FORMULA_0001 0 0 -2147483648.0000 2147483647.0000 ECU_ADDRESS 0x3FC6E8 /begin FUNCTION_LIST DSP /end FUNCTION_LIST /end MEASUREMENT
/begin MEASUREMENT dsp_ZylDat_10of10_.d2p.Error "Error,41,Y" SLONG FORMULA_0001 0 0 -2147483648.0000 2147483647.0000 ECU_ADDRESS 0x3FC790 /begin FUNCTION_LIST DSP /end FUNCTION_LIST /end MEASUREMENT
/begin MEASUREMENT dsp_100KHzDat_1of10_.Ion "Ion,1,Y" UWORD FORMULA_0099 0 0 0.0 10.0000 ECU_ADDRESS 0x3FC794 /begin FUNCTION_LIST DSP /end FUNCTION_LIST /end MEASUREMENT
/begin MEASUREMENT dsp_100KHzDat_2of10_.Ion "Ion,1,Y" UWORD FORMULA_0099 0 0 0.0 10.0000 ECU_ADDRESS 0x3FC7A4 /begin FUNCTION_LIST DSP /end FUNCTION_LIST /end MEASUREMENT
/begin MEASUREMENT dsp_100KHzDat_3of10_.Ion "Ion,1,Y" UWORD FORMULA_0099 0 0 0.0 10.0000 ECU_ADDRESS 0x3FC7B4 /begin FUNCTION_LIST DSP /end FUNCTION_LIST /end MEASUREMENT
/begin MEASUREMENT dsp_100KHzDat_4of10_.Ion "Ion,1,Y" UWORD FORMULA_0099 0 0 0.0 10.0000 ECU_ADDRESS 0x3FC7C4 /begin FUNCTION_LIST DSP /end FUNCTION_LIST /end MEASUREMENT
/begin MEASUREMENT dsp_100KHzDat_5of10_.Ion "Ion,1,Y" UWORD FORMULA_0099 0 0 0.0 10.0000 ECU_ADDRESS 0x3FC7D4 /begin FUNCTION_LIST DSP /end FUNCTION_LIST /end MEASUREMENT
/begin MEASUREMENT dsp_100KHzDat_6of10_.Ion "Ion,1,Y" UWORD FORMULA_0099 0 0 0.0 10.0000 ECU_ADDRESS 0x3FC7E4 /begin FUNCTION_LIST DSP /end FUNCTION_LIST /end MEASUREMENT
/begin MEASUREMENT dsp_100KHzDat_7of10_.Ion "Ion,1,Y" UWORD FORMULA_0099 0 0 0.0 10.0000 ECU_ADDRESS 0x3FC7F4 /begin FUNCTION_LIST DSP /end FUNCTION_LIST /end MEASUREMENT
/begin MEASUREMENT dsp_100KHzDat_8of10_.Ion "Ion,1,Y" UWORD FORMULA_0099 0 0 0.0 10.0000 ECU_ADDRESS 0x3FC804 /begin FUNCTION_LIST DSP /end FUNCTION_LIST /end MEASUREMENT
/begin MEASUREMENT dsp_100KHzDat_9of10_.Ion "Ion,1,Y" UWORD FORMULA_0099 0 0 0.0 10.0000 ECU_ADDRESS 0x3FC814 /begin FUNCTION_LIST DSP /end FUNCTION_LIST /end MEASUREMENT
/begin MEASUREMENT dsp_100KHzDat_10of10_.Ion "Ion,1,Y" UWORD FORMULA_0099 0 0 0.0 10.0000 ECU_ADDRESS 0x3FC824 /begin FUNCTION_LIST DSP /end FUNCTION_LIST /end MEASUREMENT
/begin MEASUREMENT dsp_100KHzDat_1of10_.Preasure "Preasure,2,Y" UWORD FORMULA_0100 0 0 0.0 150.0000 ECU_ADDRESS 0x3FC796 /begin FUNCTION_LIST DSP /end FUNCTION_LIST /end MEASUREMENT
/begin MEASUREMENT dsp_100KHzDat_2of10_.Preasure "Preasure,2,Y" UWORD FORMULA_0100 0 0 0.0 150.0000 ECU_ADDRESS 0x3FC7A6 /begin FUNCTION_LIST DSP /end FUNCTION_LIST /end MEASUREMENT
/begin MEASUREMENT dsp_100KHzDat_3of10_.Preasure "Preasure,2,Y" UWORD FORMULA_0100 0 0 0.0 150.0000 ECU_ADDRESS 0x3FC7B6 /begin FUNCTION_LIST DSP /end FUNCTION_LIST /end MEASUREMENT
/begin MEASUREMENT dsp_100KHzDat_4of10_.Preasure "Preasure,2,Y" UWORD FORMULA_0100 0 0 0.0 150.0000 ECU_ADDRESS 0x3FC7C6 /begin FUNCTION_LIST DSP /end FUNCTION_LIST /end MEASUREMENT
/begin MEASUREMENT dsp_100KHzDat_5of10_.Preasure "Preasure,2,Y" UWORD FORMULA_0100 0 0 0.0 150.0000 ECU_ADDRESS 0x3FC7D6 /begin FUNCTION_LIST DSP /end FUNCTION_LIST /end MEASUREMENT
/begin MEASUREMENT dsp_100KHzDat_6of10_.Preasure "Preasure,2,Y" UWORD FORMULA_0100 0 0 0.0 150.0000 ECU_ADDRESS 0x3FC7E6 /begin FUNCTION_LIST DSP /end FUNCTION_LIST /end MEASUREMENT
/begin MEASUREMENT dsp_100KHzDat_7of10_.Preasure "Preasure,2,Y" UWORD FORMULA_0100 0 0 0.0 150.0000 ECU_ADDRESS 0x3FC7F6 /begin FUNCTION_LIST DSP /end FUNCTION_LIST /end MEASUREMENT
/begin MEASUREMENT dsp_100KHzDat_8of10_.Preasure "Preasure,2,Y" UWORD FORMULA_0100 0 0 0.0 150.0000 ECU_ADDRESS 0x3FC806 /begin FUNCTION_LIST DSP /end FUNCTION_LIST /end MEASUREMENT
/begin MEASUREMENT dsp_100KHzDat_9of10_.Preasure "Preasure,2,Y" UWORD FORMULA_0100 0 0 0.0 150.0000 ECU_ADDRESS 0x3FC816 /begin FUNCTION_LIST DSP /end FUNCTION_LIST /end MEASUREMENT
/begin MEASUREMENT dsp_100KHzDat_10of10_.Preasure "Preasure,2,Y" UWORD FORMULA_0100 0 0 0.0 150.0000 ECU_ADDRESS 0x3FC826 /begin FUNCTION_LIST DSP /end FUNCTION_LIST /end MEASUREMENT
/begin MEASUREMENT dsp_100KHzDat_1of10_.IonTPFilter "IonTPFilter,3,Y" SWORD FORMULA_0099 0 0 0.0 10.0000 ECU_ADDRESS 0x3FC798 /begin FUNCTION_LIST DSP /end FUNCTION_LIST /end MEASUREMENT
/begin MEASUREMENT dsp_100KHzDat_2of10_.IonTPFilter "IonTPFilter,3,Y" SWORD FORMULA_0099 0 0 0.0 10.0000 ECU_ADDRESS 0x3FC7A8 /begin FUNCTION_LIST DSP /end FUNCTION_LIST /end MEASUREMENT
/begin MEASUREMENT dsp_100KHzDat_3of10_.IonTPFilter "IonTPFilter,3,Y" SWORD FORMULA_0099 0 0 0.0 10.0000 ECU_ADDRESS 0x3FC7B8 /begin FUNCTION_LIST DSP /end FUNCTION_LIST /end MEASUREMENT
/begin MEASUREMENT dsp_100KHzDat_4of10_.IonTPFilter "IonTPFilter,3,Y" SWORD FORMULA_0099 0 0 0.0 10.0000 ECU_ADDRESS 0x3FC7C8 /begin FUNCTION_LIST DSP /end FUNCTION_LIST /end MEASUREMENT
/begin MEASUREMENT dsp_100KHzDat_5of10_.IonTPFilter "IonTPFilter,3,Y" SWORD FORMULA_0099 0 0 0.0 10.0000 ECU_ADDRESS 0x3FC7D8 /begin FUNCTION_LIST DSP /end FUNCTION_LIST /end MEASUREMENT
/begin MEASUREMENT dsp_100KHzDat_6of10_.IonTPFilter "IonTPFilter,3,Y" SWORD FORMULA_0099 0 0 0.0 10.0000 ECU_ADDRESS 0x3FC7E8 /begin FUNCTION_LIST DSP /end FUNCTION_LIST /end MEASUREMENT
/begin MEASUREMENT dsp_100KHzDat_7of10_.IonTPFilter "IonTPFilter,3,Y" SWORD FORMULA_0099 0 0 0.0 10.0000 ECU_ADDRESS 0x3FC7F8 /begin FUNCTION_LIST DSP /end FUNCTION_LIST /end MEASUREMENT
/begin MEASUREMENT dsp_100KHzDat_8of10_.IonTPFilter "IonTPFilter,3,Y" SWORD FORMULA_0099 0 0 0.0 10.0000 ECU_ADDRESS 0x3FC808 /begin FUNCTION_LIST DSP /end FUNCTION_LIST /end MEASUREMENT
/begin MEASUREMENT dsp_100KHzDat_9of10_.IonTPFilter "IonTPFilter,3,Y" SWORD FORMULA_0099 0 0 0.0 10.0000 ECU_ADDRESS 0x3FC818 /begin FUNCTION_LIST DSP /end FUNCTION_LIST /end MEASUREMENT
/begin MEASUREMENT dsp_100KHzDat_10of10_.IonTPFilter "IonTPFilter,3,Y" SWORD FORMULA_0099 0 0 0.0 10.0000 ECU_ADDRESS 0x3FC828 /begin FUNCTION_LIST DSP /end FUNCTION_LIST /end MEASUREMENT
/begin MEASUREMENT dsp_100KHzDat_1of10_.IonHPFilter "IonHPFilter,4,Y" SWORD FORMULA_0099 0 0 -2.0000 2.0000 ECU_ADDRESS 0x3FC79A /begin FUNCTION_LIST DSP /end FUNCTION_LIST /end MEASUREMENT
/begin MEASUREMENT dsp_100KHzDat_2of10_.IonHPFilter "IonHPFilter,4,Y" SWORD FORMULA_0099 0 0 -2.0000 2.0000 ECU_ADDRESS 0x3FC7AA /begin FUNCTION_LIST DSP /end FUNCTION_LIST /end MEASUREMENT
/begin MEASUREMENT dsp_100KHzDat_3of10_.IonHPFilter "IonHPFilter,4,Y" SWORD FORMULA_0099 0 0 -2.0000 2.0000 ECU_ADDRESS 0x3FC7BA /begin FUNCTION_LIST DSP /end FUNCTION_LIST /end MEASUREMENT
/begin MEASUREMENT dsp_100KHzDat_4of10_.IonHPFilter "IonHPFilter,4,Y" SWORD FORMULA_0099 0 0 -2.0000 2.0000 ECU_ADDRESS 0x3FC7CA /begin FUNCTION_LIST DSP /end FUNCTION_LIST /end MEASUREMENT
/begin MEASUREMENT dsp_100KHzDat_5of10_.IonHPFilter "IonHPFilter,4,Y" SWORD FORMULA_0099 0 0 -2.0000 2.0000 ECU_ADDRESS 0x3FC7DA /begin FUNCTION_LIST DSP /end FUNCTION_LIST /end MEASUREMENT
/begin MEASUREMENT dsp_100KHzDat_6of10_.IonHPFilter "IonHPFilter,4,Y" SWORD FORMULA_0099 0 0 -2.0000 2.0000 ECU_ADDRESS 0x3FC7EA /begin FUNCTION_LIST DSP /end FUNCTION_LIST /end MEASUREMENT
/begin MEASUREMENT dsp_100KHzDat_7of10_.IonHPFilter "IonHPFilter,4,Y" SWORD FORMULA_0099 0 0 -2.0000 2.0000 ECU_ADDRESS 0x3FC7FA /begin FUNCTION_LIST DSP /end FUNCTION_LIST /end MEASUREMENT
/begin MEASUREMENT dsp_100KHzDat_8of10_.IonHPFilter "IonHPFilter,4,Y" SWORD FORMULA_0099 0 0 -2.0000 2.0000 ECU_ADDRESS 0x3FC80A /begin FUNCTION_LIST DSP /end FUNCTION_LIST /end MEASUREMENT
/begin MEASUREMENT dsp_100KHzDat_9of10_.IonHPFilter "IonHPFilter,4,Y" SWORD FORMULA_0099 0 0 -2.0000 2.0000 ECU_ADDRESS 0x3FC81A /begin FUNCTION_LIST DSP /end FUNCTION_LIST /end MEASUREMENT
/begin MEASUREMENT dsp_100KHzDat_10of10_.IonHPFilter "IonHPFilter,4,Y" SWORD FORMULA_0099 0 0 -2.0000 2.0000 ECU_ADDRESS 0x3FC82A /begin FUNCTION_LIST DSP /end FUNCTION_LIST /end MEASUREMENT
/begin MEASUREMENT dsp_100KHzDat_1of10_.IonIntegrator "IonIntegrator,5,Y" SWORD FORMULA_0101 0 0 -52.7999 52.7983 ECU_ADDRESS 0x3FC79C /begin FUNCTION_LIST DSP /end FUNCTION_LIST /end MEASUREMENT
/begin MEASUREMENT dsp_100KHzDat_2of10_.IonIntegrator "IonIntegrator,5,Y" SWORD FORMULA_0101 0 0 -52.7999 52.7983 ECU_ADDRESS 0x3FC7AC /begin FUNCTION_LIST DSP /end FUNCTION_LIST /end MEASUREMENT
/begin MEASUREMENT dsp_100KHzDat_3of10_.IonIntegrator "IonIntegrator,5,Y" SWORD FORMULA_0101 0 0 -52.7999 52.7983 ECU_ADDRESS 0x3FC7BC /begin FUNCTION_LIST DSP /end FUNCTION_LIST /end MEASUREMENT
/begin MEASUREMENT dsp_100KHzDat_4of10_.IonIntegrator "IonIntegrator,5,Y" SWORD FORMULA_0101 0 0 -52.7999 52.7983 ECU_ADDRESS 0x3FC7CC /begin FUNCTION_LIST DSP /end FUNCTION_LIST /end MEASUREMENT
/begin MEASUREMENT dsp_100KHzDat_5of10_.IonIntegrator "IonIntegrator,5,Y" SWORD FORMULA_0101 0 0 -52.7999 52.7983 ECU_ADDRESS 0x3FC7DC /begin FUNCTION_LIST DSP /end FUNCTION_LIST /end MEASUREMENT
/begin MEASUREMENT dsp_100KHzDat_6of10_.IonIntegrator "IonIntegrator,5,Y" SWORD FORMULA_0101 0 0 -52.7999 52.7983 ECU_ADDRESS 0x3FC7EC /begin FUNCTION_LIST DSP /end FUNCTION_LIST /end MEASUREMENT
/begin MEASUREMENT dsp_100KHzDat_7of10_.IonIntegrator "IonIntegrator,5,Y" SWORD FORMULA_0101 0 0 -52.7999 52.7983 ECU_ADDRESS 0x3FC7FC /begin FUNCTION_LIST DSP /end FUNCTION_LIST /end MEASUREMENT
/begin MEASUREMENT dsp_100KHzDat_8of10_.IonIntegrator "IonIntegrator,5,Y" SWORD FORMULA_0101 0 0 -52.7999 52.7983 ECU_ADDRESS 0x3FC80C /begin FUNCTION_LIST DSP /end FUNCTION_LIST /end MEASUREMENT
/begin MEASUREMENT dsp_100KHzDat_9of10_.IonIntegrator "IonIntegrator,5,Y" SWORD FORMULA_0101 0 0 -52.7999 52.7983 ECU_ADDRESS 0x3FC81C /begin FUNCTION_LIST DSP /end FUNCTION_LIST /end MEASUREMENT
/begin MEASUREMENT dsp_100KHzDat_10of10_.IonIntegrator "IonIntegrator,5,Y" SWORD FORMULA_0101 0 0 -52.7999 52.7983 ECU_ADDRESS 0x3FC82C /begin FUNCTION_LIST DSP /end FUNCTION_LIST /end MEASUREMENT
/begin MEASUREMENT dsp_100KHzDat_1of10_.PreHPFilter "PreHPFilter,6,Y" SWORD FORMULA_0100 0 0 -25.0000 25.0000 ECU_ADDRESS 0x3FC79E /begin FUNCTION_LIST DSP /end FUNCTION_LIST /end MEASUREMENT
/begin MEASUREMENT dsp_100KHzDat_2of10_.PreHPFilter "PreHPFilter,6,Y" SWORD FORMULA_0100 0 0 -25.0000 25.0000 ECU_ADDRESS 0x3FC7AE /begin FUNCTION_LIST DSP /end FUNCTION_LIST /end MEASUREMENT
/begin MEASUREMENT dsp_100KHzDat_3of10_.PreHPFilter "PreHPFilter,6,Y" SWORD FORMULA_0100 0 0 -25.0000 25.0000 ECU_ADDRESS 0x3FC7BE /begin FUNCTION_LIST DSP /end FUNCTION_LIST /end MEASUREMENT
/begin MEASUREMENT dsp_100KHzDat_4of10_.PreHPFilter "PreHPFilter,6,Y" SWORD FORMULA_0100 0 0 -25.0000 25.0000 ECU_ADDRESS 0x3FC7CE /begin FUNCTION_LIST DSP /end FUNCTION_LIST /end MEASUREMENT
/begin MEASUREMENT dsp_100KHzDat_5of10_.PreHPFilter "PreHPFilter,6,Y" SWORD FORMULA_0100 0 0 -25.0000 25.0000 ECU_ADDRESS 0x3FC7DE /begin FUNCTION_LIST DSP /end FUNCTION_LIST /end MEASUREMENT
/begin MEASUREMENT dsp_100KHzDat_6of10_.PreHPFilter "PreHPFilter,6,Y" SWORD FORMULA_0100 0 0 -25.0000 25.0000 ECU_ADDRESS 0x3FC7EE /begin FUNCTION_LIST DSP /end FUNCTION_LIST /end MEASUREMENT
/begin MEASUREMENT dsp_100KHzDat_7of10_.PreHPFilter "PreHPFilter,6,Y" SWORD FORMULA_0100 0 0 -25.0000 25.0000 ECU_ADDRESS 0x3FC7FE /begin FUNCTION_LIST DSP /end FUNCTION_LIST /end MEASUREMENT
/begin MEASUREMENT dsp_100KHzDat_8of10_.PreHPFilter "PreHPFilter,6,Y" SWORD FORMULA_0100 0 0 -25.0000 25.0000 ECU_ADDRESS 0x3FC80E /begin FUNCTION_LIST DSP /end FUNCTION_LIST /end MEASUREMENT
/begin MEASUREMENT dsp_100KHzDat_9of10_.PreHPFilter "PreHPFilter,6,Y" SWORD FORMULA_0100 0 0 -25.0000 25.0000 ECU_ADDRESS 0x3FC81E /begin FUNCTION_LIST DSP /end FUNCTION_LIST /end MEASUREMENT
/begin MEASUREMENT dsp_100KHzDat_10of10_.PreHPFilter "PreHPFilter,6,Y" SWORD FORMULA_0100 0 0 -25.0000 25.0000 ECU_ADDRESS 0x3FC82E /begin FUNCTION_LIST DSP /end FUNCTION_LIST /end MEASUREMENT
/begin MEASUREMENT dsp_100KHzDat_1of10_.PreTPFilter "PreTPFilter,7,Y" SWORD FORMULA_0100 0 0 0.0 150.0000 ECU_ADDRESS 0x3FC7A0 /begin FUNCTION_LIST DSP /end FUNCTION_LIST /end MEASUREMENT
/begin MEASUREMENT dsp_100KHzDat_2of10_.PreTPFilter "PreTPFilter,7,Y" SWORD FORMULA_0100 0 0 0.0 150.0000 ECU_ADDRESS 0x3FC7B0 /begin FUNCTION_LIST DSP /end FUNCTION_LIST /end MEASUREMENT
/begin MEASUREMENT dsp_100KHzDat_3of10_.PreTPFilter "PreTPFilter,7,Y" SWORD FORMULA_0100 0 0 0.0 150.0000 ECU_ADDRESS 0x3FC7C0 /begin FUNCTION_LIST DSP /end FUNCTION_LIST /end MEASUREMENT
/begin MEASUREMENT dsp_100KHzDat_4of10_.PreTPFilter "PreTPFilter,7,Y" SWORD FORMULA_0100 0 0 0.0 150.0000 ECU_ADDRESS 0x3FC7D0 /begin FUNCTION_LIST DSP /end FUNCTION_LIST /end MEASUREMENT
/begin MEASUREMENT dsp_100KHzDat_5of10_.PreTPFilter "PreTPFilter,7,Y" SWORD FORMULA_0100 0 0 0.0 150.0000 ECU_ADDRESS 0x3FC7E0 /begin FUNCTION_LIST DSP /end FUNCTION_LIST /end MEASUREMENT
/begin MEASUREMENT dsp_100KHzDat_6of10_.PreTPFilter "PreTPFilter,7,Y" SWORD FORMULA_0100 0 0 0.0 150.0000 ECU_ADDRESS 0x3FC7F0 /begin FUNCTION_LIST DSP /end FUNCTION_LIST /end MEASUREMENT
/begin MEASUREMENT dsp_100KHzDat_7of10_.PreTPFilter "PreTPFilter,7,Y" SWORD FORMULA_0100 0 0 0.0 150.0000 ECU_ADDRESS 0x3FC800 /begin FUNCTION_LIST DSP /end FUNCTION_LIST /end MEASUREMENT
/begin MEASUREMENT dsp_100KHzDat_8of10_.PreTPFilter "PreTPFilter,7,Y" SWORD FORMULA_0100 0 0 0.0 150.0000 ECU_ADDRESS 0x3FC810 /begin FUNCTION_LIST DSP /end FUNCTION_LIST /end MEASUREMENT
/begin MEASUREMENT dsp_100KHzDat_9of10_.PreTPFilter "PreTPFilter,7,Y" SWORD FORMULA_0100 0 0 0.0 150.0000 ECU_ADDRESS 0x3FC820 /begin FUNCTION_LIST DSP /end FUNCTION_LIST /end MEASUREMENT
/begin MEASUREMENT dsp_100KHzDat_10of10_.PreTPFilter "PreTPFilter,7,Y" SWORD FORMULA_0100 0 0 0.0 150.0000 ECU_ADDRESS 0x3FC830 /begin FUNCTION_LIST DSP /end FUNCTION_LIST /end MEASUREMENT
/begin MEASUREMENT dsp_100KHzDat_1of10_.KWG "KWG,8,X" SWORD FORMULA_0102 0 0 -50.0000 60.0000 ECU_ADDRESS 0x3FC7A2 /begin FUNCTION_LIST DSP /end FUNCTION_LIST /end MEASUREMENT
/begin MEASUREMENT dsp_100KHzDat_2of10_.KWG "KWG,8,X" SWORD FORMULA_0102 0 0 -50.0000 60.0000 ECU_ADDRESS 0x3FC7B2 /begin FUNCTION_LIST DSP /end FUNCTION_LIST /end MEASUREMENT
/begin MEASUREMENT dsp_100KHzDat_3of10_.KWG "KWG,8,X" SWORD FORMULA_0102 0 0 -50.0000 60.0000 ECU_ADDRESS 0x3FC7C2 /begin FUNCTION_LIST DSP /end FUNCTION_LIST /end MEASUREMENT
/begin MEASUREMENT dsp_100KHzDat_4of10_.KWG "KWG,8,X" SWORD FORMULA_0102 0 0 -50.0000 60.0000 ECU_ADDRESS 0x3FC7D2 /begin FUNCTION_LIST DSP /end FUNCTION_LIST /end MEASUREMENT
/begin MEASUREMENT dsp_100KHzDat_5of10_.KWG "KWG,8,X" SWORD FORMULA_0102 0 0 -50.0000 60.0000 ECU_ADDRESS 0x3FC7E2 /begin FUNCTION_LIST DSP /end FUNCTION_LIST /end MEASUREMENT
/begin MEASUREMENT dsp_100KHzDat_6of10_.KWG "KWG,8,X" SWORD FORMULA_0102 0 0 -50.0000 60.0000 ECU_ADDRESS 0x3FC7F2 /begin FUNCTION_LIST DSP /end FUNCTION_LIST /end MEASUREMENT
/begin MEASUREMENT dsp_100KHzDat_7of10_.KWG "KWG,8,X" SWORD FORMULA_0102 0 0 -50.0000 60.0000 ECU_ADDRESS 0x3FC802 /begin FUNCTION_LIST DSP /end FUNCTION_LIST /end MEASUREMENT
/begin MEASUREMENT dsp_100KHzDat_8of10_.KWG "KWG,8,X" SWORD FORMULA_0102 0 0 -50.0000 60.0000 ECU_ADDRESS 0x3FC812 /begin FUNCTION_LIST DSP /end FUNCTION_LIST /end MEASUREMENT
/begin MEASUREMENT dsp_100KHzDat_9of10_.KWG "KWG,8,X" SWORD FORMULA_0102 0 0 -50.0000 60.0000 ECU_ADDRESS 0x3FC822 /begin FUNCTION_LIST DSP /end FUNCTION_LIST /end MEASUREMENT
/begin MEASUREMENT dsp_100KHzDat_10of10_.KWG "KWG,8,X" SWORD FORMULA_0102 0 0 -50.0000 60.0000 ECU_ADDRESS 0x3FC832 /begin FUNCTION_LIST DSP /end FUNCTION_LIST /end MEASUREMENT
/begin MEASUREMENT dsp_MotDat.PPCStat "PPCStat,0,Y" ULONG FORMULA_0001 0 0 0.0 2147483647.0000 ECU_ADDRESS 0x3FC834 /begin FUNCTION_LIST DSP /end FUNCTION_LIST /end MEASUREMENT
/begin MEASUREMENT dsp_MotDat.Nmot "Nmot,0,Y" SLONG FORMULA_0093 0 0 0.0 10000.0000 ECU_ADDRESS 0x3FC838 /begin FUNCTION_LIST DSP /end FUNCTION_LIST /end MEASUREMENT
/begin MEASUREMENT dsp_MotDat.Rf_1of2_ "Rf,0,Y" SLONG FORMULA_0094 0 0 0.0 2.0000 ECU_ADDRESS 0x3FC83C /begin FUNCTION_LIST DSP /end FUNCTION_LIST /end MEASUREMENT
/begin MEASUREMENT dsp_MotDat.Rf_2of2_ "Rf,0,Y" SLONG FORMULA_0094 0 0 0.0 2.0000 ECU_ADDRESS 0x3FC840 /begin FUNCTION_LIST DSP /end FUNCTION_LIST /end MEASUREMENT
/begin MEASUREMENT dsp_MotDat.IgnAngle_1of12_ "IgnAngle,0,Y" SLONG FORMULA_0095 0 0 -50.0000 60.0000 ECU_ADDRESS 0x3FC854 /begin FUNCTION_LIST DSP /end FUNCTION_LIST /end MEASUREMENT
/begin MEASUREMENT dsp_MotDat.IgnAngle_2of12_ "IgnAngle,0,Y" SLONG FORMULA_0095 0 0 -50.0000 60.0000 ECU_ADDRESS 0x3FC858 /begin FUNCTION_LIST DSP /end FUNCTION_LIST /end MEASUREMENT
/begin MEASUREMENT dsp_MotDat.IgnAngle_3of12_ "IgnAngle,0,Y" SLONG FORMULA_0095 0 0 -50.0000 60.0000 ECU_ADDRESS 0x3FC85C /begin FUNCTION_LIST DSP /end FUNCTION_LIST /end MEASUREMENT
/begin MEASUREMENT dsp_MotDat.IgnAngle_4of12_ "IgnAngle,0,Y" SLONG FORMULA_0095 0 0 -50.0000 60.0000 ECU_ADDRESS 0x3FC860 /begin FUNCTION_LIST DSP /end FUNCTION_LIST /end MEASUREMENT
/begin MEASUREMENT dsp_MotDat.IgnAngle_5of12_ "IgnAngle,0,Y" SLONG FORMULA_0095 0 0 -50.0000 60.0000 ECU_ADDRESS 0x3FC864 /begin FUNCTION_LIST DSP /end FUNCTION_LIST /end MEASUREMENT
/begin MEASUREMENT dsp_MotDat.IgnAngle_6of12_ "IgnAngle,0,Y" SLONG FORMULA_0095 0 0 -50.0000 60.0000 ECU_ADDRESS 0x3FC868 /begin FUNCTION_LIST DSP /end FUNCTION_LIST /end MEASUREMENT
/begin MEASUREMENT dsp_MotDat.IgnAngle_7of12_ "IgnAngle,0,Y" SLONG FORMULA_0095 0 0 -50.0000 60.0000 ECU_ADDRESS 0x3FC86C /begin FUNCTION_LIST DSP /end FUNCTION_LIST /end MEASUREMENT
/begin MEASUREMENT dsp_MotDat.IgnAngle_8of12_ "IgnAngle,0,Y" SLONG FORMULA_0095 0 0 -50.0000 60.0000 ECU_ADDRESS 0x3FC870 /begin FUNCTION_LIST DSP /end FUNCTION_LIST /end MEASUREMENT
/begin MEASUREMENT dsp_MotDat.IgnAngle_9of12_ "IgnAngle,0,Y" SLONG FORMULA_0095 0 0 -50.0000 60.0000 ECU_ADDRESS 0x3FC874 /begin FUNCTION_LIST DSP /end FUNCTION_LIST /end MEASUREMENT
/begin MEASUREMENT dsp_MotDat.IgnAngle_10of12_ "IgnAngle,0,Y" SLONG FORMULA_0095 0 0 -50.0000 60.0000 ECU_ADDRESS 0x3FC878 /begin FUNCTION_LIST DSP /end FUNCTION_LIST /end MEASUREMENT
/begin MEASUREMENT dsp_MotDat.IgnAngle_11of12_ "IgnAngle,0,Y" SLONG FORMULA_0095 0 0 -50.0000 60.0000 ECU_ADDRESS 0x3FC87C /begin FUNCTION_LIST DSP /end FUNCTION_LIST /end MEASUREMENT
/begin MEASUREMENT dsp_MotDat.IgnAngle_12of12_ "IgnAngle,0,Y" SLONG FORMULA_0095 0 0 -50.0000 60.0000 ECU_ADDRESS 0x3FC880 /begin FUNCTION_LIST DSP /end FUNCTION_LIST /end MEASUREMENT
/begin MEASUREMENT dsp_MotDat.IonGain "IonGain,0,Y" ULONG FORMULA_0103 0 0 0.0 3.0000 ECU_ADDRESS 0x3FC884 /begin FUNCTION_LIST DSP /end FUNCTION_LIST /end MEASUREMENT
/begin MEASUREMENT dsp_MotDat.SystemGain "SystemGain,0,Y" ULONG FORMULA_0104 0 0 0.0 63.0000 ECU_ADDRESS 0x3FC888 /begin FUNCTION_LIST DSP /end FUNCTION_LIST /end MEASUREMENT
/begin MEASUREMENT dsp_MotDat.ion_tz_offs_time_1of2_ "ion_tz_offs_time,0,Y" ULONG FORMULA_0001 0 0 0.0 2147483647.0000 ECU_ADDRESS 0x3FC844 /begin FUNCTION_LIST DSP /end FUNCTION_LIST /end MEASUREMENT
/begin MEASUREMENT dsp_MotDat.ion_tz_offs_time_2of2_ "ion_tz_offs_time,0,Y" ULONG FORMULA_0001 0 0 0.0 2147483647.0000 ECU_ADDRESS 0x3FC848 /begin FUNCTION_LIST DSP /end FUNCTION_LIST /end MEASUREMENT
/begin MEASUREMENT dsp_MotDat.knock_sample_time_1of2_ "knock_sample_time,0,Y" ULONG FORMULA_0001 0 0 0.0 2147483647.0000 ECU_ADDRESS 0x3FC84C /begin FUNCTION_LIST DSP /end FUNCTION_LIST /end MEASUREMENT
/begin MEASUREMENT dsp_MotDat.knock_sample_time_2of2_ "knock_sample_time,0,Y" ULONG FORMULA_0001 0 0 0.0 2147483647.0000 ECU_ADDRESS 0x3FC850 /begin FUNCTION_LIST DSP /end FUNCTION_LIST /end MEASUREMENT
/begin MEASUREMENT dsp_MotDat.PreasureSystemGain "PreasureSystemGain,0,Y" ULONG FORMULA_0104 0 0 0.0 63.0000 ECU_ADDRESS 0x3FC88C /begin FUNCTION_LIST DSP /end FUNCTION_LIST /end MEASUREMENT
/begin MEASUREMENT dsp_MotDat.Error "Error,0,Y" SLONG FORMULA_0001 0 0 -2147483648.0000 2147483647.0000 ECU_ADDRESS 0x3FC890 /begin FUNCTION_LIST DSP /end FUNCTION_LIST /end MEASUREMENT
/begin MEASUREMENT dsp_MotDat.co_bp_a_1of4_ "BP-Filterkoeffizienten A." SLONG FORMULA_0105 0 0 -2147483648.0000 2147483647.0000 ECU_ADDRESS 0x3FC894 /begin FUNCTION_LIST DSP /end FUNCTION_LIST /end MEASUREMENT
/begin MEASUREMENT dsp_MotDat.co_bp_a_2of4_ "BP-Filterkoeffizienten A." SLONG FORMULA_0105 0 0 -2147483648.0000 2147483647.0000 ECU_ADDRESS 0x3FC898 /begin FUNCTION_LIST DSP /end FUNCTION_LIST /end MEASUREMENT
/begin MEASUREMENT dsp_MotDat.co_bp_a_3of4_ "BP-Filterkoeffizienten A." SLONG FORMULA_0105 0 0 -2147483648.0000 2147483647.0000 ECU_ADDRESS 0x3FC89C /begin FUNCTION_LIST DSP /end FUNCTION_LIST /end MEASUREMENT
/begin MEASUREMENT dsp_MotDat.co_bp_a_4of4_ "BP-Filterkoeffizienten A." SLONG FORMULA_0105 0 0 -2147483648.0000 2147483647.0000 ECU_ADDRESS 0x3FC8A0 /begin FUNCTION_LIST DSP /end FUNCTION_LIST /end MEASUREMENT
/begin MEASUREMENT dsp_MotDat.co_bp_b_1of4_ "BP-Filterkoeffizienten B." SLONG FORMULA_0105 0 0 -2147483648.0000 2147483647.0000 ECU_ADDRESS 0x3FC8A4 /begin FUNCTION_LIST DSP /end FUNCTION_LIST /end MEASUREMENT
/begin MEASUREMENT dsp_MotDat.co_bp_b_2of4_ "BP-Filterkoeffizienten B." SLONG FORMULA_0105 0 0 -2147483648.0000 2147483647.0000 ECU_ADDRESS 0x3FC8A8 /begin FUNCTION_LIST DSP /end FUNCTION_LIST /end MEASUREMENT
/begin MEASUREMENT dsp_MotDat.co_bp_b_3of4_ "BP-Filterkoeffizienten B." SLONG FORMULA_0105 0 0 -2147483648.0000 2147483647.0000 ECU_ADDRESS 0x3FC8AC /begin FUNCTION_LIST DSP /end FUNCTION_LIST /end MEASUREMENT
/begin MEASUREMENT dsp_MotDat.co_bp_b_4of4_ "BP-Filterkoeffizienten B." SLONG FORMULA_0105 0 0 -2147483648.0000 2147483647.0000 ECU_ADDRESS 0x3FC8B0 /begin FUNCTION_LIST DSP /end FUNCTION_LIST /end MEASUREMENT
/begin MEASUREMENT dsp_MotDat.co_tp_a_1of4_ "TP-Filterkoeffizienten A." SLONG FORMULA_0105 0 0 -2147483648.0000 2147483647.0000 ECU_ADDRESS 0x3FC8B4 /begin FUNCTION_LIST DSP /end FUNCTION_LIST /end MEASUREMENT
/begin MEASUREMENT dsp_MotDat.co_tp_a_2of4_ "TP-Filterkoeffizienten A." SLONG FORMULA_0105 0 0 -2147483648.0000 2147483647.0000 ECU_ADDRESS 0x3FC8B8 /begin FUNCTION_LIST DSP /end FUNCTION_LIST /end MEASUREMENT
/begin MEASUREMENT dsp_MotDat.co_tp_a_3of4_ "TP-Filterkoeffizienten A." SLONG FORMULA_0105 0 0 -2147483648.0000 2147483647.0000 ECU_ADDRESS 0x3FC8BC /begin FUNCTION_LIST DSP /end FUNCTION_LIST /end MEASUREMENT
/begin MEASUREMENT dsp_MotDat.co_tp_a_4of4_ "TP-Filterkoeffizienten A." SLONG FORMULA_0105 0 0 -2147483648.0000 2147483647.0000 ECU_ADDRESS 0x3FC8C0 /begin FUNCTION_LIST DSP /end FUNCTION_LIST /end MEASUREMENT
/begin MEASUREMENT dsp_MotDat.co_tp_b_1of4_ "TP-Filterkoeffizienten B." SLONG FORMULA_0105 0 0 -2147483648.0000 2147483647.0000 ECU_ADDRESS 0x3FC8C4 /begin FUNCTION_LIST DSP /end FUNCTION_LIST /end MEASUREMENT
/begin MEASUREMENT dsp_MotDat.co_tp_b_2of4_ "TP-Filterkoeffizienten B." SLONG FORMULA_0105 0 0 -2147483648.0000 2147483647.0000 ECU_ADDRESS 0x3FC8C8 /begin FUNCTION_LIST DSP /end FUNCTION_LIST /end MEASUREMENT
/begin MEASUREMENT dsp_MotDat.co_tp_b_3of4_ "TP-Filterkoeffizienten B." SLONG FORMULA_0105 0 0 -2147483648.0000 2147483647.0000 ECU_ADDRESS 0x3FC8CC /begin FUNCTION_LIST DSP /end FUNCTION_LIST /end MEASUREMENT
/begin MEASUREMENT dsp_MotDat.co_tp_b_4of4_ "TP-Filterkoeffizienten B." SLONG FORMULA_0105 0 0 -2147483648.0000 2147483647.0000 ECU_ADDRESS 0x3FC8D0 /begin FUNCTION_LIST DSP /end FUNCTION_LIST /end MEASUREMENT
/* ------------------ Abschnitt erzeugt aus ion.dat ------------------ */
/begin CHARACTERISTIC K_ION_SCHLT "Schalter Freigabe Aussetzererkennung: 0 = Aus; 1 = Aktiv" VALUE 0x606BC TKW_VV_VV_UB 100.0 FORMULA_0008 0.0 1.0000 /begin FUNCTION_LIST Aussetzererkennung /end FUNCTION_LIST /end CHARACTERISTIC
/begin CHARACTERISTIC K_ION_SCALE "Skalierung der Messspannungen: 0 = Aus; 1 = Aktiv" VALUE 0x606BD TKW_VV_VV_UB 100.0 FORMULA_0008 0.0 1.0000 /begin FUNCTION_LIST Aussetzererkennung /end FUNCTION_LIST /end CHARACTERISTIC
/begin CHARACTERISTIC KF_ION_U_TP_MIN "Minimale TP-Ionenspannungschwelle zur Aussetzererkennung." MAP 0x606BE TKF_SW_SW_SW 100.0 FORMULA_0148 0.0 3.4436 /begin FUNCTION_LIST Aussetzererkennung /end FUNCTION_LIST /begin AXIS_DESCR STD_AXIS n FORMULA_0011 8 0.0 10000.0000 /end AXIS_DESCR /begin AXIS_DESCR STD_AXIS rf FORMULA_0006 8 0.0 2.0000 FORMAT "%6.3" /end AXIS_DESCR FORMAT "%6.3" /end CHARACTERISTIC
/begin CHARACTERISTIC KF_ION_U_INT_MIN "Minimales Ionenspannungsintegral zur Aussetzererkennung." MAP 0x60760 TKF_SW_SW_SW 100.0 FORMULA_0150 -1.8182 1.8182 /begin FUNCTION_LIST Aussetzererkennung /end FUNCTION_LIST /begin AXIS_DESCR STD_AXIS n FORMULA_0011 8 0.0 10000.0000 /end AXIS_DESCR /begin AXIS_DESCR STD_AXIS rf FORMULA_0006 8 0.0 2.0000 FORMAT "%6.3" /end AXIS_DESCR FORMAT "%6.3" /end CHARACTERISTIC
/begin MEASUREMENT ion_zustand "Zustandsvariable Aussetzererkennung." UWORD FORMULA_0147 0 0 0.0 65535.0 ECU_ADDRESS 0x3FBA54 /begin FUNCTION_LIST Aussetzererkennung /end FUNCTION_LIST BIT_MASK 0xFFFF /end MEASUREMENT
/begin MEASUREMENT ion_sample_window_auss_1of12_ "Anzahl Samples im Aussetzerfenster." UWORD FORMULA_0000 0 0 0.0 65535.0000 ECU_ADDRESS 0x3FBA56 /begin FUNCTION_LIST Aussetzererkennung /end FUNCTION_LIST /end MEASUREMENT
/begin MEASUREMENT ion_sample_window_auss_2of12_ "Anzahl Samples im Aussetzerfenster." UWORD FORMULA_0000 0 0 0.0 65535.0000 ECU_ADDRESS 0x3FBA58 /begin FUNCTION_LIST Aussetzererkennung /end FUNCTION_LIST /end MEASUREMENT
/begin MEASUREMENT ion_sample_window_auss_3of12_ "Anzahl Samples im Aussetzerfenster." UWORD FORMULA_0000 0 0 0.0 65535.0000 ECU_ADDRESS 0x3FBA5A /begin FUNCTION_LIST Aussetzererkennung /end FUNCTION_LIST /end MEASUREMENT
/begin MEASUREMENT ion_sample_window_auss_4of12_ "Anzahl Samples im Aussetzerfenster." UWORD FORMULA_0000 0 0 0.0 65535.0000 ECU_ADDRESS 0x3FBA5C /begin FUNCTION_LIST Aussetzererkennung /end FUNCTION_LIST /end MEASUREMENT
/begin MEASUREMENT ion_sample_window_auss_5of12_ "Anzahl Samples im Aussetzerfenster." UWORD FORMULA_0000 0 0 0.0 65535.0000 ECU_ADDRESS 0x3FBA5E /begin FUNCTION_LIST Aussetzererkennung /end FUNCTION_LIST /end MEASUREMENT
/begin MEASUREMENT ion_sample_window_auss_6of12_ "Anzahl Samples im Aussetzerfenster." UWORD FORMULA_0000 0 0 0.0 65535.0000 ECU_ADDRESS 0x3FBA60 /begin FUNCTION_LIST Aussetzererkennung /end FUNCTION_LIST /end MEASUREMENT
/begin MEASUREMENT ion_sample_window_auss_7of12_ "Anzahl Samples im Aussetzerfenster." UWORD FORMULA_0000 0 0 0.0 65535.0000 ECU_ADDRESS 0x3FBA62 /begin FUNCTION_LIST Aussetzererkennung /end FUNCTION_LIST /end MEASUREMENT
/begin MEASUREMENT ion_sample_window_auss_8of12_ "Anzahl Samples im Aussetzerfenster." UWORD FORMULA_0000 0 0 0.0 65535.0000 ECU_ADDRESS 0x3FBA64 /begin FUNCTION_LIST Aussetzererkennung /end FUNCTION_LIST /end MEASUREMENT
/begin MEASUREMENT ion_sample_window_auss_9of12_ "Anzahl Samples im Aussetzerfenster." UWORD FORMULA_0000 0 0 0.0 65535.0000 ECU_ADDRESS 0x3FBA66 /begin FUNCTION_LIST Aussetzererkennung /end FUNCTION_LIST /end MEASUREMENT
/begin MEASUREMENT ion_sample_window_auss_10of12_ "Anzahl Samples im Aussetzerfenster." UWORD FORMULA_0000 0 0 0.0 65535.0000 ECU_ADDRESS 0x3FBA68 /begin FUNCTION_LIST Aussetzererkennung /end FUNCTION_LIST /end MEASUREMENT
/begin MEASUREMENT ion_sample_window_auss_11of12_ "Anzahl Samples im Aussetzerfenster." UWORD FORMULA_0000 0 0 0.0 65535.0000 ECU_ADDRESS 0x3FBA6A /begin FUNCTION_LIST Aussetzererkennung /end FUNCTION_LIST /end MEASUREMENT
/begin MEASUREMENT ion_sample_window_auss_12of12_ "Anzahl Samples im Aussetzerfenster." UWORD FORMULA_0000 0 0 0.0 65535.0000 ECU_ADDRESS 0x3FBA6C /begin FUNCTION_LIST Aussetzererkennung /end FUNCTION_LIST /end MEASUREMENT
/begin MEASUREMENT ion_u_tp_max_1of12_ "Maximalwert des TP-Ionenspannung im Aussetzerfenster." SWORD FORMULA_0148 0 0 0.0 3.4436 ECU_ADDRESS 0x3FBA6E /begin FUNCTION_LIST Aussetzererkennung /end FUNCTION_LIST /end MEASUREMENT
/begin MEASUREMENT ion_u_tp_max_2of12_ "Maximalwert des TP-Ionenspannung im Aussetzerfenster." SWORD FORMULA_0148 0 0 0.0 3.4436 ECU_ADDRESS 0x3FBA70 /begin FUNCTION_LIST Aussetzererkennung /end FUNCTION_LIST /end MEASUREMENT
/begin MEASUREMENT ion_u_tp_max_3of12_ "Maximalwert des TP-Ionenspannung im Aussetzerfenster." SWORD FORMULA_0148 0 0 0.0 3.4436 ECU_ADDRESS 0x3FBA72 /begin FUNCTION_LIST Aussetzererkennung /end FUNCTION_LIST /end MEASUREMENT
/begin MEASUREMENT ion_u_tp_max_4of12_ "Maximalwert des TP-Ionenspannung im Aussetzerfenster." SWORD FORMULA_0148 0 0 0.0 3.4436 ECU_ADDRESS 0x3FBA74 /begin FUNCTION_LIST Aussetzererkennung /end FUNCTION_LIST /end MEASUREMENT
/begin MEASUREMENT ion_u_tp_max_5of12_ "Maximalwert des TP-Ionenspannung im Aussetzerfenster." SWORD FORMULA_0148 0 0 0.0 3.4436 ECU_ADDRESS 0x3FBA76 /begin FUNCTION_LIST Aussetzererkennung /end FUNCTION_LIST /end MEASUREMENT
/begin MEASUREMENT ion_u_tp_max_6of12_ "Maximalwert des TP-Ionenspannung im Aussetzerfenster." SWORD FORMULA_0148 0 0 0.0 3.4436 ECU_ADDRESS 0x3FBA78 /begin FUNCTION_LIST Aussetzererkennung /end FUNCTION_LIST /end MEASUREMENT
/begin MEASUREMENT ion_u_tp_max_7of12_ "Maximalwert des TP-Ionenspannung im Aussetzerfenster." SWORD FORMULA_0148 0 0 0.0 3.4436 ECU_ADDRESS 0x3FBA7A /begin FUNCTION_LIST Aussetzererkennung /end FUNCTION_LIST /end MEASUREMENT
/begin MEASUREMENT ion_u_tp_max_8of12_ "Maximalwert des TP-Ionenspannung im Aussetzerfenster." SWORD FORMULA_0148 0 0 0.0 3.4436 ECU_ADDRESS 0x3FBA7C /begin FUNCTION_LIST Aussetzererkennung /end FUNCTION_LIST /end MEASUREMENT
/begin MEASUREMENT ion_u_tp_max_9of12_ "Maximalwert des TP-Ionenspannung im Aussetzerfenster." SWORD FORMULA_0148 0 0 0.0 3.4436 ECU_ADDRESS 0x3FBA7E /begin FUNCTION_LIST Aussetzererkennung /end FUNCTION_LIST /end MEASUREMENT
/begin MEASUREMENT ion_u_tp_max_10of12_ "Maximalwert des TP-Ionenspannung im Aussetzerfenster." SWORD FORMULA_0148 0 0 0.0 3.4436 ECU_ADDRESS 0x3FBA80 /begin FUNCTION_LIST Aussetzererkennung /end FUNCTION_LIST /end MEASUREMENT
/begin MEASUREMENT ion_u_tp_max_11of12_ "Maximalwert des TP-Ionenspannung im Aussetzerfenster." SWORD FORMULA_0148 0 0 0.0 3.4436 ECU_ADDRESS 0x3FBA82 /begin FUNCTION_LIST Aussetzererkennung /end FUNCTION_LIST /end MEASUREMENT
/begin MEASUREMENT ion_u_tp_max_12of12_ "Maximalwert des TP-Ionenspannung im Aussetzerfenster." SWORD FORMULA_0148 0 0 0.0 3.4436 ECU_ADDRESS 0x3FBA84 /begin FUNCTION_LIST Aussetzererkennung /end FUNCTION_LIST /end MEASUREMENT
/begin MEASUREMENT ion_u_tp_min_1of12_ "Minimale TP-Ionenspannungschwelle zur Aussetzererkennung." SWORD FORMULA_0148 0 0 0.0 3.4436 ECU_ADDRESS 0x3FBA86 /begin FUNCTION_LIST Aussetzererkennung /end FUNCTION_LIST /end MEASUREMENT
/begin MEASUREMENT ion_u_tp_min_2of12_ "Minimale TP-Ionenspannungschwelle zur Aussetzererkennung." SWORD FORMULA_0148 0 0 0.0 3.4436 ECU_ADDRESS 0x3FBA88 /begin FUNCTION_LIST Aussetzererkennung /end FUNCTION_LIST /end MEASUREMENT
/begin MEASUREMENT ion_u_tp_min_3of12_ "Minimale TP-Ionenspannungschwelle zur Aussetzererkennung." SWORD FORMULA_0148 0 0 0.0 3.4436 ECU_ADDRESS 0x3FBA8A /begin FUNCTION_LIST Aussetzererkennung /end FUNCTION_LIST /end MEASUREMENT
/begin MEASUREMENT ion_u_tp_min_4of12_ "Minimale TP-Ionenspannungschwelle zur Aussetzererkennung." SWORD FORMULA_0148 0 0 0.0 3.4436 ECU_ADDRESS 0x3FBA8C /begin FUNCTION_LIST Aussetzererkennung /end FUNCTION_LIST /end MEASUREMENT
/begin MEASUREMENT ion_u_tp_min_5of12_ "Minimale TP-Ionenspannungschwelle zur Aussetzererkennung." SWORD FORMULA_0148 0 0 0.0 3.4436 ECU_ADDRESS 0x3FBA8E /begin FUNCTION_LIST Aussetzererkennung /end FUNCTION_LIST /end MEASUREMENT
/begin MEASUREMENT ion_u_tp_min_6of12_ "Minimale TP-Ionenspannungschwelle zur Aussetzererkennung." SWORD FORMULA_0148 0 0 0.0 3.4436 ECU_ADDRESS 0x3FBA90 /begin FUNCTION_LIST Aussetzererkennung /end FUNCTION_LIST /end MEASUREMENT
/begin MEASUREMENT ion_u_tp_min_7of12_ "Minimale TP-Ionenspannungschwelle zur Aussetzererkennung." SWORD FORMULA_0148 0 0 0.0 3.4436 ECU_ADDRESS 0x3FBA92 /begin FUNCTION_LIST Aussetzererkennung /end FUNCTION_LIST /end MEASUREMENT
/begin MEASUREMENT ion_u_tp_min_8of12_ "Minimale TP-Ionenspannungschwelle zur Aussetzererkennung." SWORD FORMULA_0148 0 0 0.0 3.4436 ECU_ADDRESS 0x3FBA94 /begin FUNCTION_LIST Aussetzererkennung /end FUNCTION_LIST /end MEASUREMENT
/begin MEASUREMENT ion_u_tp_min_9of12_ "Minimale TP-Ionenspannungschwelle zur Aussetzererkennung." SWORD FORMULA_0148 0 0 0.0 3.4436 ECU_ADDRESS 0x3FBA96 /begin FUNCTION_LIST Aussetzererkennung /end FUNCTION_LIST /end MEASUREMENT
/begin MEASUREMENT ion_u_tp_min_10of12_ "Minimale TP-Ionenspannungschwelle zur Aussetzererkennung." SWORD FORMULA_0148 0 0 0.0 3.4436 ECU_ADDRESS 0x3FBA98 /begin FUNCTION_LIST Aussetzererkennung /end FUNCTION_LIST /end MEASUREMENT
/begin MEASUREMENT ion_u_tp_min_11of12_ "Minimale TP-Ionenspannungschwelle zur Aussetzererkennung." SWORD FORMULA_0148 0 0 0.0 3.4436 ECU_ADDRESS 0x3FBA9A /begin FUNCTION_LIST Aussetzererkennung /end FUNCTION_LIST /end MEASUREMENT
/begin MEASUREMENT ion_u_tp_min_12of12_ "Minimale TP-Ionenspannungschwelle zur Aussetzererkennung." SWORD FORMULA_0148 0 0 0.0 3.4436 ECU_ADDRESS 0x3FBA9C /begin FUNCTION_LIST Aussetzererkennung /end FUNCTION_LIST /end MEASUREMENT
/begin MEASUREMENT ion_u_int_1of12_ "Integralspannung im Aussetzerfenster." SLONG FORMULA_0001 0 0 -2147483648.0000 2147483647.0000 ECU_ADDRESS 0x3FBAA0 /begin FUNCTION_LIST Aussetzererkennung /end FUNCTION_LIST /end MEASUREMENT
/begin MEASUREMENT ion_u_int_2of12_ "Integralspannung im Aussetzerfenster." SLONG FORMULA_0001 0 0 -2147483648.0000 2147483647.0000 ECU_ADDRESS 0x3FBAA4 /begin FUNCTION_LIST Aussetzererkennung /end FUNCTION_LIST /end MEASUREMENT
/begin MEASUREMENT ion_u_int_3of12_ "Integralspannung im Aussetzerfenster." SLONG FORMULA_0001 0 0 -2147483648.0000 2147483647.0000 ECU_ADDRESS 0x3FBAA8 /begin FUNCTION_LIST Aussetzererkennung /end FUNCTION_LIST /end MEASUREMENT
/begin MEASUREMENT ion_u_int_4of12_ "Integralspannung im Aussetzerfenster." SLONG FORMULA_0001 0 0 -2147483648.0000 2147483647.0000 ECU_ADDRESS 0x3FBAAC /begin FUNCTION_LIST Aussetzererkennung /end FUNCTION_LIST /end MEASUREMENT
/begin MEASUREMENT ion_u_int_5of12_ "Integralspannung im Aussetzerfenster." SLONG FORMULA_0001 0 0 -2147483648.0000 2147483647.0000 ECU_ADDRESS 0x3FBAB0 /begin FUNCTION_LIST Aussetzererkennung /end FUNCTION_LIST /end MEASUREMENT
/begin MEASUREMENT ion_u_int_6of12_ "Integralspannung im Aussetzerfenster." SLONG FORMULA_0001 0 0 -2147483648.0000 2147483647.0000 ECU_ADDRESS 0x3FBAB4 /begin FUNCTION_LIST Aussetzererkennung /end FUNCTION_LIST /end MEASUREMENT
/begin MEASUREMENT ion_u_int_7of12_ "Integralspannung im Aussetzerfenster." SLONG FORMULA_0001 0 0 -2147483648.0000 2147483647.0000 ECU_ADDRESS 0x3FBAB8 /begin FUNCTION_LIST Aussetzererkennung /end FUNCTION_LIST /end MEASUREMENT
/begin MEASUREMENT ion_u_int_8of12_ "Integralspannung im Aussetzerfenster." SLONG FORMULA_0001 0 0 -2147483648.0000 2147483647.0000 ECU_ADDRESS 0x3FBABC /begin FUNCTION_LIST Aussetzererkennung /end FUNCTION_LIST /end MEASUREMENT
/begin MEASUREMENT ion_u_int_9of12_ "Integralspannung im Aussetzerfenster." SLONG FORMULA_0001 0 0 -2147483648.0000 2147483647.0000 ECU_ADDRESS 0x3FBAC0 /begin FUNCTION_LIST Aussetzererkennung /end FUNCTION_LIST /end MEASUREMENT
/begin MEASUREMENT ion_u_int_10of12_ "Integralspannung im Aussetzerfenster." SLONG FORMULA_0001 0 0 -2147483648.0000 2147483647.0000 ECU_ADDRESS 0x3FBAC4 /begin FUNCTION_LIST Aussetzererkennung /end FUNCTION_LIST /end MEASUREMENT
/begin MEASUREMENT ion_u_int_11of12_ "Integralspannung im Aussetzerfenster." SLONG FORMULA_0001 0 0 -2147483648.0000 2147483647.0000 ECU_ADDRESS 0x3FBAC8 /begin FUNCTION_LIST Aussetzererkennung /end FUNCTION_LIST /end MEASUREMENT
/begin MEASUREMENT ion_u_int_12of12_ "Integralspannung im Aussetzerfenster." SLONG FORMULA_0001 0 0 -2147483648.0000 2147483647.0000 ECU_ADDRESS 0x3FBACC /begin FUNCTION_LIST Aussetzererkennung /end FUNCTION_LIST /end MEASUREMENT
/begin MEASUREMENT ion_u_int_norm_1of12_ "Normierte Integralspannung im Aussetzerfenster." SWORD FORMULA_0149 0 0 -528.0000 527.9838 ECU_ADDRESS 0x3FBAD0 /begin FUNCTION_LIST Aussetzererkennung /end FUNCTION_LIST /end MEASUREMENT
/begin MEASUREMENT ion_u_int_norm_2of12_ "Normierte Integralspannung im Aussetzerfenster." SWORD FORMULA_0149 0 0 -528.0000 527.9838 ECU_ADDRESS 0x3FBAD2 /begin FUNCTION_LIST Aussetzererkennung /end FUNCTION_LIST /end MEASUREMENT
/begin MEASUREMENT ion_u_int_norm_3of12_ "Normierte Integralspannung im Aussetzerfenster." SWORD FORMULA_0149 0 0 -528.0000 527.9838 ECU_ADDRESS 0x3FBAD4 /begin FUNCTION_LIST Aussetzererkennung /end FUNCTION_LIST /end MEASUREMENT
/begin MEASUREMENT ion_u_int_norm_4of12_ "Normierte Integralspannung im Aussetzerfenster." SWORD FORMULA_0149 0 0 -528.0000 527.9838 ECU_ADDRESS 0x3FBAD6 /begin FUNCTION_LIST Aussetzererkennung /end FUNCTION_LIST /end MEASUREMENT
/begin MEASUREMENT ion_u_int_norm_5of12_ "Normierte Integralspannung im Aussetzerfenster." SWORD FORMULA_0149 0 0 -528.0000 527.9838 ECU_ADDRESS 0x3FBAD8 /begin FUNCTION_LIST Aussetzererkennung /end FUNCTION_LIST /end MEASUREMENT
/begin MEASUREMENT ion_u_int_norm_6of12_ "Normierte Integralspannung im Aussetzerfenster." SWORD FORMULA_0149 0 0 -528.0000 527.9838 ECU_ADDRESS 0x3FBADA /begin FUNCTION_LIST Aussetzererkennung /end FUNCTION_LIST /end MEASUREMENT
/begin MEASUREMENT ion_u_int_norm_7of12_ "Normierte Integralspannung im Aussetzerfenster." SWORD FORMULA_0149 0 0 -528.0000 527.9838 ECU_ADDRESS 0x3FBADC /begin FUNCTION_LIST Aussetzererkennung /end FUNCTION_LIST /end MEASUREMENT
/begin MEASUREMENT ion_u_int_norm_8of12_ "Normierte Integralspannung im Aussetzerfenster." SWORD FORMULA_0149 0 0 -528.0000 527.9838 ECU_ADDRESS 0x3FBADE /begin FUNCTION_LIST Aussetzererkennung /end FUNCTION_LIST /end MEASUREMENT
/begin MEASUREMENT ion_u_int_norm_9of12_ "Normierte Integralspannung im Aussetzerfenster." SWORD FORMULA_0149 0 0 -528.0000 527.9838 ECU_ADDRESS 0x3FBAE0 /begin FUNCTION_LIST Aussetzererkennung /end FUNCTION_LIST /end MEASUREMENT
/begin MEASUREMENT ion_u_int_norm_10of12_ "Normierte Integralspannung im Aussetzerfenster." SWORD FORMULA_0149 0 0 -528.0000 527.9838 ECU_ADDRESS 0x3FBAE2 /begin FUNCTION_LIST Aussetzererkennung /end FUNCTION_LIST /end MEASUREMENT
/begin MEASUREMENT ion_u_int_norm_11of12_ "Normierte Integralspannung im Aussetzerfenster." SWORD FORMULA_0149 0 0 -528.0000 527.9838 ECU_ADDRESS 0x3FBAE4 /begin FUNCTION_LIST Aussetzererkennung /end FUNCTION_LIST /end MEASUREMENT
/begin MEASUREMENT ion_u_int_norm_12of12_ "Normierte Integralspannung im Aussetzerfenster." SWORD FORMULA_0149 0 0 -528.0000 527.9838 ECU_ADDRESS 0x3FBAE6 /begin FUNCTION_LIST Aussetzererkennung /end FUNCTION_LIST /end MEASUREMENT
/begin MEASUREMENT ion_u_int_min_1of12_ "Minimales Ionenspannungsintegral zur Aussetzererkennung." SWORD FORMULA_0149 0 0 -528.0000 527.9838 ECU_ADDRESS 0x3FBAE8 /begin FUNCTION_LIST Aussetzererkennung /end FUNCTION_LIST /end MEASUREMENT
/begin MEASUREMENT ion_u_int_min_2of12_ "Minimales Ionenspannungsintegral zur Aussetzererkennung." SWORD FORMULA_0149 0 0 -528.0000 527.9838 ECU_ADDRESS 0x3FBAEA /begin FUNCTION_LIST Aussetzererkennung /end FUNCTION_LIST /end MEASUREMENT
/begin MEASUREMENT ion_u_int_min_3of12_ "Minimales Ionenspannungsintegral zur Aussetzererkennung." SWORD FORMULA_0149 0 0 -528.0000 527.9838 ECU_ADDRESS 0x3FBAEC /begin FUNCTION_LIST Aussetzererkennung /end FUNCTION_LIST /end MEASUREMENT
/begin MEASUREMENT ion_u_int_min_4of12_ "Minimales Ionenspannungsintegral zur Aussetzererkennung." SWORD FORMULA_0149 0 0 -528.0000 527.9838 ECU_ADDRESS 0x3FBAEE /begin FUNCTION_LIST Aussetzererkennung /end FUNCTION_LIST /end MEASUREMENT
/begin MEASUREMENT ion_u_int_min_5of12_ "Minimales Ionenspannungsintegral zur Aussetzererkennung." SWORD FORMULA_0149 0 0 -528.0000 527.9838 ECU_ADDRESS 0x3FBAF0 /begin FUNCTION_LIST Aussetzererkennung /end FUNCTION_LIST /end MEASUREMENT
/begin MEASUREMENT ion_u_int_min_6of12_ "Minimales Ionenspannungsintegral zur Aussetzererkennung." SWORD FORMULA_0149 0 0 -528.0000 527.9838 ECU_ADDRESS 0x3FBAF2 /begin FUNCTION_LIST Aussetzererkennung /end FUNCTION_LIST /end MEASUREMENT
/begin MEASUREMENT ion_u_int_min_7of12_ "Minimales Ionenspannungsintegral zur Aussetzererkennung." SWORD FORMULA_0149 0 0 -528.0000 527.9838 ECU_ADDRESS 0x3FBAF4 /begin FUNCTION_LIST Aussetzererkennung /end FUNCTION_LIST /end MEASUREMENT
/begin MEASUREMENT ion_u_int_min_8of12_ "Minimales Ionenspannungsintegral zur Aussetzererkennung." SWORD FORMULA_0149 0 0 -528.0000 527.9838 ECU_ADDRESS 0x3FBAF6 /begin FUNCTION_LIST Aussetzererkennung /end FUNCTION_LIST /end MEASUREMENT
/begin MEASUREMENT ion_u_int_min_9of12_ "Minimales Ionenspannungsintegral zur Aussetzererkennung." SWORD FORMULA_0149 0 0 -528.0000 527.9838 ECU_ADDRESS 0x3FBAF8 /begin FUNCTION_LIST Aussetzererkennung /end FUNCTION_LIST /end MEASUREMENT
/begin MEASUREMENT ion_u_int_min_10of12_ "Minimales Ionenspannungsintegral zur Aussetzererkennung." SWORD FORMULA_0149 0 0 -528.0000 527.9838 ECU_ADDRESS 0x3FBAFA /begin FUNCTION_LIST Aussetzererkennung /end FUNCTION_LIST /end MEASUREMENT
/begin MEASUREMENT ion_u_int_min_11of12_ "Minimales Ionenspannungsintegral zur Aussetzererkennung." SWORD FORMULA_0149 0 0 -528.0000 527.9838 ECU_ADDRESS 0x3FBAFC /begin FUNCTION_LIST Aussetzererkennung /end FUNCTION_LIST /end MEASUREMENT
/begin MEASUREMENT ion_u_int_min_12of12_ "Minimales Ionenspannungsintegral zur Aussetzererkennung." SWORD FORMULA_0149 0 0 -528.0000 527.9838 ECU_ADDRESS 0x3FBAFE /begin FUNCTION_LIST Aussetzererkennung /end FUNCTION_LIST /end MEASUREMENT
/* ------------------ Abschnitt erzeugt aus tabg.dat ------------------ */
/begin CHARACTERISTIC K_TABG_DIAG_CFG "Schalter welches TABG" VALUE 0x62316 TKW_VV_VV_UB 100.0 FORMULA_0215 0.0 255.0 /begin FUNCTION_LIST Abgastemperatur /end FUNCTION_LIST BIT_MASK 0x1 /end CHARACTERISTIC
/begin CHARACTERISTIC K_TABG_VKAT_K_TMOT "Waermeuebergangskoeffizient" VALUE 0x62318 TKW_VV_VV_UW 100.0 FORMULA_0216 0.0 65.5350 /begin FUNCTION_LIST Abgastemperatur /end FUNCTION_LIST FORMAT "%7.4" /end CHARACTERISTIC
/begin CHARACTERISTIC K_TABG_NKAT_K_TUMG "Waermeuebergangskoeffizient" VALUE 0x6231A TKW_VV_VV_UW 100.0 FORMULA_0216 0.0 65.5350 /begin FUNCTION_LIST Abgastemperatur /end FUNCTION_LIST FORMAT "%7.4" /end CHARACTERISTIC
/begin CHARACTERISTIC K_TABG_VKAT_K_V "Geschwindikeitsabhaengiger Waermeuebergangskoeffizient" VALUE 0x6231C TKW_VV_VV_UW 100.0 FORMULA_0217 0.0 6.5535 /begin FUNCTION_LIST Abgastemperatur /end FUNCTION_LIST FORMAT "%7.4" /end CHARACTERISTIC
/begin CHARACTERISTIC K_TABG_NKAT_K_V "Geschwindikeitsabhaengiger Waermeuebergangskoeffizient" VALUE 0x6231E TKW_VV_VV_UW 100.0 FORMULA_0217 0.0 6.5535 /begin FUNCTION_LIST Abgastemperatur /end FUNCTION_LIST FORMAT "%7.4" /end CHARACTERISTIC
/begin CHARACTERISTIC K_TABG_DIAG_MIN "Unter Grenze Abgastemperatur" VALUE 0x62320 TKW_VV_VV_SW 100.0 FORMULA_0213 -50.0000 1250.0000 /begin FUNCTION_LIST Abgastemperatur /end FUNCTION_LIST FORMAT "%5.2" /end CHARACTERISTIC
/begin CHARACTERISTIC K_TABG_DIAG_MAX "Obere Grenze Abgastemperatur" VALUE 0x62322 TKW_VV_VV_SW 100.0 FORMULA_0213 -50.0000 1250.0000 /begin FUNCTION_LIST Abgastemperatur /end FUNCTION_LIST FORMAT "%5.2" /end CHARACTERISTIC
/begin CHARACTERISTIC K_TABG_STAND_MAX "Maximale Abstellabgastemperatur" VALUE 0x62324 TKW_VV_VV_SW 100.0 FORMULA_0090 0.0 1250.0000 /begin FUNCTION_LIST Abgastemperatur /end FUNCTION_LIST FORMAT "%4.1" /end CHARACTERISTIC
/begin CHARACTERISTIC K_TABG_VKAT_KATSCHUTZ "Katschutzschwelle" VALUE 0x62326 TKW_VV_VV_SW 100.0 FORMULA_0019 -50.0000 1250.0000 /begin FUNCTION_LIST Abgastemperatur /end FUNCTION_LIST FORMAT "%4.1" /end CHARACTERISTIC
/begin CHARACTERISTIC K_TABG_TAU "Filterkonstante fuer die Abgastemperaturerfassung" VALUE 0x62328 TKW_VV_VV_UB 100.0 FORMULA_0210 0.1004 25.6000 /begin FUNCTION_LIST Abgastemperatur /end FUNCTION_LIST /end CHARACTERISTIC
/begin CHARACTERISTIC K_TABG_C "Mittlere spezifische Waermekapazitaet" VALUE 0x6232A TKW_VV_VV_UW 100.0 FORMULA_0218 1.0000 65535.0000 /begin FUNCTION_LIST Abgastemperatur /end FUNCTION_LIST /end CHARACTERISTIC
/begin CHARACTERISTIC K_TABG_NKAT_MC "Waermekapazitaet des Katalysators" VALUE 0x6232C TKW_VV_VV_UW 100.0 FORMULA_0219 1.0000 65535.0000 /begin FUNCTION_LIST Abgastemperatur /end FUNCTION_LIST /end CHARACTERISTIC
/begin CHARACTERISTIC K_TABG_LW_AUSBLEND_OFFS "Temperaturoffset ausgeblendeter Zylinder" VALUE 0x6232E TKW_VV_VV_SW 100.0 FORMULA_0090 0.0 1000.0000 /begin FUNCTION_LIST Abgastemperatur /end FUNCTION_LIST FORMAT "%4.1" /end CHARACTERISTIC
/begin CHARACTERISTIC K_TABG_VKAT_A "Kruemmerflaeche" VALUE 0x62330 TKW_VV_VV_UW 100.0 FORMULA_0220 0.0 6.5535 /begin FUNCTION_LIST Abgastemperatur /end FUNCTION_LIST FORMAT "%7.4" /end CHARACTERISTIC
/begin CHARACTERISTIC K_TABG_NKAT_A "Katflaeche" VALUE 0x62332 TKW_VV_VV_UW 100.0 FORMULA_0220 0.0 6.5535 /begin FUNCTION_LIST Abgastemperatur /end FUNCTION_LIST FORMAT "%7.4" /end CHARACTERISTIC
/begin CHARACTERISTIC K_TABG_NKAT_T_OFFS_AUF "Aufregelrampe Enthalpie" VALUE 0x62334 TKW_VV_VV_SW 100.0 FORMULA_0221 0.0 3276.7000 /begin FUNCTION_LIST Abgastemperatur /end FUNCTION_LIST FORMAT "%4.1" /end CHARACTERISTIC
/begin CHARACTERISTIC K_TABG_NKAT_T_OFFS_AB "Abregelrampe Enthalpie" VALUE 0x62336 TKW_VV_VV_SW 100.0 FORMULA_0221 0.0 3276.7000 /begin FUNCTION_LIST Abgastemperatur /end FUNCTION_LIST FORMAT "%4.1" /end CHARACTERISTIC
/begin CHARACTERISTIC K_TABG_NKAT_T_OFFS_MAX "Maximale Enthalpie" VALUE 0x62338 TKW_VV_VV_SW 100.0 FORMULA_0214 0.0 327.6700 /begin FUNCTION_LIST Abgastemperatur /end FUNCTION_LIST FORMAT "%5.2" /end CHARACTERISTIC
/begin CHARACTERISTIC K_TABG_NKAT_EXO_HYS "Hysterese fuer Enthalpie" VALUE 0x6233A TKW_VV_VV_SW 100.0 FORMULA_0090 0.0 1000.0000 /begin FUNCTION_LIST Abgastemperatur /end FUNCTION_LIST FORMAT "%4.1" /end CHARACTERISTIC
/begin CHARACTERISTIC KL_TABG_PT200 "Kennlinie Abgastemperatur" CURVE 0x6233C TKL_SW_VV_SW 100.0 FORMULA_0213 -50.0000 1250.0000 /begin FUNCTION_LIST Abgastemperatur /end FUNCTION_LIST /begin AXIS_DESCR STD_AXIS tabg_ad FORMULA_0206 18 0.0 1023.0000 /end AXIS_DESCR FORMAT "%5.2" /end CHARACTERISTIC
/begin CHARACTERISTIC KL_TABG_LW_F_RG "Gewichtungsfaktor Restgas" CURVE 0x62386 TKL_SW_VV_UW 100.0 FORMULA_0035 0.0 4.0000 /begin FUNCTION_LIST Abgastemperatur /end FUNCTION_LIST /begin AXIS_DESCR STD_AXIS rg_x FORMULA_0007 4 -0.1000 0.5000 FORMAT "%5.2" /end AXIS_DESCR FORMAT "%6.3" /end CHARACTERISTIC
/begin CHARACTERISTIC KL_TABG_LW_F_ETA_ZW "Gewichtungsfaktor Zuendwinkel" CURVE 0x62398 TKL_UW_VV_UW 100.0 FORMULA_0035 0.0 4.0000 /begin FUNCTION_LIST Abgastemperatur /end FUNCTION_LIST
 /begin AXIS_DESCR STD_AXIS md_eta_zw_ne FORMULA_0181 4 0.0 150.0000 FORMAT "%4.1" /end AXIS_DESCR
 FORMAT "%6.3" /end CHARACTERISTIC
/begin CHARACTERISTIC KL_TABG_LW_F_LAM "Gewichtungsfaktor Lambda" CURVE 0x623AA TKL_UW_VV_UW 100.0 FORMULA_0035 0.0 4.0000 /begin FUNCTION_LIST Abgastemperatur /end FUNCTION_LIST
 /begin AXIS_DESCR STD_AXIS lam_ist_mw FORMULA_0004 4 0.0 3.9990 FORMAT "%6.3" /end AXIS_DESCR
 FORMAT "%6.3" /end CHARACTERISTIC
/begin CHARACTERISTIC KL_TABG_LW_VERH_WURZEL "Verhaeltnis der Ladungswechseltemperaturen" CURVE 0x623BC TKL_UW_VV_UW 100.0 FORMULA_0035 0.0 4.0000 /begin FUNCTION_LIST Abgastemperatur /end FUNCTION_LIST
 /begin AXIS_DESCR STD_AXIS tabg_lw_verh FORMULA_0035 7 0.0 4.0000 FORMAT "%6.3" /end AXIS_DESCR
 FORMAT "%6.3" /end CHARACTERISTIC
/begin CHARACTERISTIC KL_TABG_KAT_STAND_F "Faktor Standzeit" CURVE 0x623DA TKL_UW_VV_UW 100.0 FORMULA_0035 0.0 4.0000 /begin FUNCTION_LIST Abgastemperatur /end FUNCTION_LIST
 /begin AXIS_DESCR STD_AXIS time_ms FORMULA_0222 8 0.0 1092.2500 FORMAT "%5.2" /end AXIS_DESCR
 FORMAT "%6.3" /end CHARACTERISTIC
/begin CHARACTERISTIC KL_TABG_LW_STAND_F "Faktor Standzeit" CURVE 0x623FC TKL_UW_VV_UW 100.0 FORMULA_0035 0.0 4.0000 /begin FUNCTION_LIST Abgastemperatur /end FUNCTION_LIST
 /begin AXIS_DESCR STD_AXIS time_ms FORMULA_0222 4 0.0 1092.2500 FORMAT "%5.2" /end AXIS_DESCR
 FORMAT "%6.3" /end CHARACTERISTIC
/begin CHARACTERISTIC KL_TABG_LW_TAU "Filterzeitkonstante" CURVE 0x6240E TKL_SW_VV_UB 100.0 FORMULA_0210 0.1004 25.6000 /begin FUNCTION_LIST Abgastemperatur /end FUNCTION_LIST
 /begin AXIS_DESCR STD_AXIS tabg_lw_ml_ges FORMULA_0010 4 -100.0000 1400.0000 FORMAT "%4.1" /end AXIS_DESCR
/end CHARACTERISTIC
/begin CHARACTERISTIC KL_TABG_VKAT_TAU "Filterzeitkonstante" CURVE 0x6241C TKL_SW_VV_UB 100.0 FORMULA_0210 0.1004 25.6000 /begin FUNCTION_LIST Abgastemperatur /end FUNCTION_LIST
 /begin AXIS_DESCR STD_AXIS tabg_lw_ml_ges FORMULA_0010 4 -100.0000 1400.0000 FORMAT "%4.1" /end AXIS_DESCR
/end CHARACTERISTIC
/begin CHARACTERISTIC KL_TABG_VKAT_F_REAK "Reaktion im Kruemmer" CURVE 0x6242A TKL_UW_VV_UW 100.0 FORMULA_0035 0.0 4.0000 /begin FUNCTION_LIST Abgastemperatur /end FUNCTION_LIST
 /begin AXIS_DESCR STD_AXIS lam_ist_mw FORMULA_0004 4 0.0 3.9990 FORMAT "%6.3" /end AXIS_DESCR
 FORMAT "%6.3" /end CHARACTERISTIC
/begin CHARACTERISTIC KL_TABG_NKAT_EXO_ON "Einschaltschwelle fuer Enthalpie" CURVE 0x6243C TKL_SW_VV_SW 100.0 FORMULA_0019 -50.0000 1250.0000 /begin FUNCTION_LIST Abgastemperatur /end FUNCTION_LIST
 /begin AXIS_DESCR STD_AXIS mkat FORMULA_0019 4 -50.0000 1250.0000 FORMAT "%4.1" /end AXIS_DESCR
 FORMAT "%4.1" /end CHARACTERISTIC
/begin CHARACTERISTIC KF_TABG_LW_STAT "Stationaere Abgastemperatur nach Ladungswechsel" MAP 0x6244E TKF_SW_SW_SW 100.0 FORMULA_0019 -50.0000 1250.0000 /begin FUNCTION_LIST Abgastemperatur /end FUNCTION_LIST /begin AXIS_DESCR STD_AXIS n FORMULA_0011 6 0.0 10000.0000 /end AXIS_DESCR /begin AXIS_DESCR STD_AXIS rf FORMULA_0006 6 0.0 2.0000 FORMAT "%6.3" /end AXIS_DESCR FORMAT "%4.1" /end CHARACTERISTIC
/begin MEASUREMENT tabg_ad_b1 "Eingelesener Spannungswert fuer Abgastemperatur" SWORD FORMULA_0206 0 0 0.0 1023.0000 ECU_ADDRESS 0x3FBF68 /begin FUNCTION_LIST Abgastemperatur /end FUNCTION_LIST /end MEASUREMENT
/begin MEASUREMENT tabg_ad_b2 "Eingelesener Spannungswert fuer Abgastemperatur" SWORD FORMULA_0206 0 0 0.0 1023.0000 ECU_ADDRESS 0x3FBF6A /begin FUNCTION_LIST Abgastemperatur /end FUNCTION_LIST /end MEASUREMENT
/begin MEASUREMENT tabg_roh_b1 "Ungefilterter Messwert der Abgastemperatur" SWORD FORMULA_0213 0 0 -50.0000 1250.0000 ECU_ADDRESS 0x3FBF6C /begin FUNCTION_LIST Abgastemperatur /end FUNCTION_LIST /end MEASUREMENT
/begin MEASUREMENT tabg_roh_b2 "Ungefilterter Messwert der Abgastemperatur" SWORD FORMULA_0213 0 0 -50.0000 1250.0000 ECU_ADDRESS 0x3FBF6E /begin FUNCTION_LIST Abgastemperatur /end FUNCTION_LIST /end MEASUREMENT
/begin MEASUREMENT tabg_filter_b1 "Gefilterter Messwert der Abgastemperatur" SWORD FORMULA_0213 0 0 -50.0000 1250.0000 ECU_ADDRESS 0x3FBF70 /begin FUNCTION_LIST Abgastemperatur /end FUNCTION_LIST /end MEASUREMENT
/begin MEASUREMENT tabg_filter_b2 "Gefilterter Messwert der Abgastemperatur" SWORD FORMULA_0213 0 0 -50.0000 1250.0000 ECU_ADDRESS 0x3FBF72 /begin FUNCTION_LIST Abgastemperatur /end FUNCTION_LIST /end MEASUREMENT
/begin MEASUREMENT tabg_lw_stat_b1 "Temperatur in Celsius" SWORD FORMULA_0019 0 0 -50.0000 1250.0000 ECU_ADDRESS 0x3FBF74 /begin FUNCTION_LIST Abgastemperatur /end FUNCTION_LIST /end MEASUREMENT
/begin MEASUREMENT tabg_lw_stat_b2 "Temperatur in Celsius" SWORD FORMULA_0019 0 0 -50.0000 1250.0000 ECU_ADDRESS 0x3FBF76 /begin FUNCTION_LIST Abgastemperatur /end FUNCTION_LIST /end MEASUREMENT
/begin MEASUREMENT tabg_lw_roh_b1 "Ungefilterte Ladungswechseltemperatur" SWORD FORMULA_0213 0 0 -50.0000 1250.0000 ECU_ADDRESS 0x3FBF78 /begin FUNCTION_LIST Abgastemperatur /end FUNCTION_LIST /end MEASUREMENT
/begin MEASUREMENT tabg_lw_roh_b2 "Ungefilterte Ladungswechseltemperatur" SWORD FORMULA_0213 0 0 -50.0000 1250.0000 ECU_ADDRESS 0x3FBF7A /begin FUNCTION_LIST Abgastemperatur /end FUNCTION_LIST /end MEASUREMENT
/begin MEASUREMENT tabg_lw_filter_b1 "Gefilterte Ladungswechseltemperatur" SWORD FORMULA_0213 0 0 -50.0000 1250.0000 ECU_ADDRESS 0x3FBF7C /begin FUNCTION_LIST Abgastemperatur /end FUNCTION_LIST /end MEASUREMENT
/begin MEASUREMENT tabg_lw_filter_b2 "Gefilterte Ladungswechseltemperatur" SWORD FORMULA_0213 0 0 -50.0000 1250.0000 ECU_ADDRESS 0x3FBF7E /begin FUNCTION_LIST Abgastemperatur /end FUNCTION_LIST /end MEASUREMENT
/begin MEASUREMENT tabg_vkat_roh_b1 "Ungefilterte Vorkattemperatur" SWORD FORMULA_0213 0 0 -50.0000 1250.0000 ECU_ADDRESS 0x3FBF80 /begin FUNCTION_LIST Abgastemperatur /end FUNCTION_LIST /end MEASUREMENT
/begin MEASUREMENT tabg_vkat_roh_b2 "Ungefilterte Vorkattemperatur" SWORD FORMULA_0213 0 0 -50.0000 1250.0000 ECU_ADDRESS 0x3FBF82 /begin FUNCTION_LIST Abgastemperatur /end FUNCTION_LIST /end MEASUREMENT
/begin MEASUREMENT tabg_vkat_filter_b1 "Gefilterte Vorkattemperatur" SWORD FORMULA_0213 0 0 -50.0000 1250.0000 ECU_ADDRESS 0x3FBF84 /begin FUNCTION_LIST Abgastemperatur /end FUNCTION_LIST /end MEASUREMENT
/begin MEASUREMENT tabg_vkat_filter_b2 "Gefilterte Vorkattemperatur" SWORD FORMULA_0213 0 0 -50.0000 1250.0000 ECU_ADDRESS 0x3FBF86 /begin FUNCTION_LIST Abgastemperatur /end FUNCTION_LIST /end MEASUREMENT
/begin MEASUREMENT tabg_lw_f_rg_b1 "Resteinflussgasfaktor" UWORD FORMULA_0035 0 0 0.0 4.0000 ECU_ADDRESS 0x3FBF88 /begin FUNCTION_LIST Abgastemperatur /end FUNCTION_LIST /end MEASUREMENT
/begin MEASUREMENT tabg_lw_f_rg_b2 "Resteinflussgasfaktor" UWORD FORMULA_0035 0 0 0.0 4.0000 ECU_ADDRESS 0x3FBF8A /begin FUNCTION_LIST Abgastemperatur /end FUNCTION_LIST /end MEASUREMENT
/begin MEASUREMENT tabg_lw_f_eta_zw_ne_b1 "Zuendwinkeleinflussfaktor" UWORD FORMULA_0035 0 0 0.0 4.0000 ECU_ADDRESS 0x3FBF8C /begin FUNCTION_LIST Abgastemperatur /end FUNCTION_LIST /end MEASUREMENT
/begin MEASUREMENT tabg_lw_f_eta_zw_ne_b2 "Zuendwinkeleinflussfaktor" UWORD FORMULA_0035 0 0 0.0 4.0000 ECU_ADDRESS 0x3FBF8E /begin FUNCTION_LIST Abgastemperatur /end FUNCTION_LIST /end MEASUREMENT
/begin MEASUREMENT tabg_lw_f_lam_b1 "Lambdaeinflussfaktor" UWORD FORMULA_0035 0 0 0.0 4.0000 ECU_ADDRESS 0x3FBF90 /begin FUNCTION_LIST Abgastemperatur /end FUNCTION_LIST /end MEASUREMENT
/begin MEASUREMENT tabg_lw_f_lam_b2 "Lambdaeinflussfaktor" UWORD FORMULA_0035 0 0 0.0 4.0000 ECU_ADDRESS 0x3FBF92 /begin FUNCTION_LIST Abgastemperatur /end FUNCTION_LIST /end MEASUREMENT
/begin MEASUREMENT tabg_vkat_f_reak_b1 "Faktor der Reaktion im Kruemmer" UWORD FORMULA_0035 0 0 0.0 4.0000 ECU_ADDRESS 0x3FBF94 /begin FUNCTION_LIST Abgastemperatur /end FUNCTION_LIST /end MEASUREMENT
/begin MEASUREMENT tabg_vkat_f_reak_b2 "Faktor der Reaktion im Kruemmer" UWORD FORMULA_0035 0 0 0.0 4.0000 ECU_ADDRESS 0x3FBF96 /begin FUNCTION_LIST Abgastemperatur /end FUNCTION_LIST /end MEASUREMENT
/begin MEASUREMENT tabg_ml_ges_b1 "Gesamte Luftmasse im Abgasstrang" SWORD FORMULA_0010 0 0 -100.0000 1400.0000 ECU_ADDRESS 0x3FBF98 /begin FUNCTION_LIST Abgastemperatur /end FUNCTION_LIST /end MEASUREMENT
/begin MEASUREMENT tabg_ml_ges_b2 "Gesamte Luftmasse im Abgasstrang" SWORD FORMULA_0010 0 0 -100.0000 1400.0000 ECU_ADDRESS 0x3FBF9A /begin FUNCTION_LIST Abgastemperatur /end FUNCTION_LIST /end MEASUREMENT
/begin MEASUREMENT tabg_lw_tau_b1 "Filterzeitkonstante fuer Ladungswechsel" UBYTE FORMULA_0210 0 0 0.1004 25.6000 ECU_ADDRESS 0x3FBF9C /begin FUNCTION_LIST Abgastemperatur /end FUNCTION_LIST /end MEASUREMENT
/begin MEASUREMENT tabg_lw_tau_b2 "Filterzeitkonstante fuer Ladungswechsel" UBYTE FORMULA_0210 0 0 0.1004 25.6000 ECU_ADDRESS 0x3FBF9D /begin FUNCTION_LIST Abgastemperatur /end FUNCTION_LIST /end MEASUREMENT
/begin MEASUREMENT tabg_vkat_tau_b1 "Filterzeitkonstante fuer Ladungswechsel" UBYTE FORMULA_0210 0 0 0.1004 25.6000 ECU_ADDRESS 0x3FBFA0 /begin FUNCTION_LIST Abgastemperatur /end FUNCTION_LIST /end MEASUREMENT
/begin MEASUREMENT tabg_vkat_tau_b2 "Filterzeitkonstante fuer Ladungswechsel" UBYTE FORMULA_0210 0 0 0.1004 25.6000 ECU_ADDRESS 0x3FBFA1 /begin FUNCTION_LIST Abgastemperatur /end FUNCTION_LIST /end MEASUREMENT
/begin MEASUREMENT tabg_nkat_t_offs_b1 "Enthalpietemperatur" SWORD FORMULA_0214 0 0 0.0 327.6700 ECU_ADDRESS 0x3FBFA2 /begin FUNCTION_LIST Abgastemperatur /end FUNCTION_LIST /end MEASUREMENT
/begin MEASUREMENT tabg_nkat_t_offs_b2 "Enthalpietemperatur" SWORD FORMULA_0214 0 0 0.0 327.6700 ECU_ADDRESS 0x3FBFA4 /begin FUNCTION_LIST Abgastemperatur /end FUNCTION_LIST /end MEASUREMENT
/begin MEASUREMENT tabg_nkat_exo_on_b1 "Einschaltschwelle fuer Enthalpie" SWORD FORMULA_0019 0 0 -50.0000 1250.0000 ECU_ADDRESS 0x3FBFA6 /begin FUNCTION_LIST Abgastemperatur /end FUNCTION_LIST /end MEASUREMENT
/begin MEASUREMENT tabg_nkat_exo_on_b2 "Einschaltschwelle fuer Enthalpie" SWORD FORMULA_0019 0 0 -50.0000 1250.0000 ECU_ADDRESS 0x3FBFA8 /begin FUNCTION_LIST Abgastemperatur /end FUNCTION_LIST /end MEASUREMENT
/* ------------------ Abschnitt erzeugt aus tan.dat ------------------ */
/begin CHARACTERISTIC K_TAN_DIAG_MIN "Unter Grenze Ansauglufttemperatur" VALUE 0x624B0 TKW_VV_VV_SW 100.0 FORMULA_0223 -50.0000 150.0000 /begin FUNCTION_LIST Ansauglufttemperatur /end FUNCTION_LIST FORMAT "%6.3" /end CHARACTERISTIC
/begin CHARACTERISTIC K_TAN_DIAG_MAX "Obere Grenze Ansauglufttemperatur" VALUE 0x624B2 TKW_VV_VV_SW 100.0 FORMULA_0223 -50.0000 150.0000 /begin FUNCTION_LIST Ansauglufttemperatur /end FUNCTION_LIST FORMAT "%6.3" /end CHARACTERISTIC
/begin CHARACTERISTIC K_TAN_ERSATZ "Ersatzwert fuer die Ansauglufttemperatur" VALUE 0x624B4 TKW_VV_VV_SW 100.0 FORMULA_0223 -50.0000 150.0000 /begin FUNCTION_LIST Ansauglufttemperatur /end FUNCTION_LIST FORMAT "%6.3" /end CHARACTERISTIC
/begin CHARACTERISTIC K_TAN_TAU "Filterkonstante fuer die Ansauglufttemperaturerfassung" VALUE 0x624B6 TKW_VV_VV_UB 100.0 FORMULA_0210 0.1004 25.6000 /begin FUNCTION_LIST Ansauglufttemperatur /end FUNCTION_LIST /end CHARACTERISTIC
/begin CHARACTERISTIC KL_TAN_NTC "Kennlinie Ansauglufttemperatur" CURVE 0x624B8 TKL_SW_VV_SW 100.0 FORMULA_0223 -50.0000 150.0000 /begin FUNCTION_LIST Ansauglufttemperatur /end FUNCTION_LIST /begin AXIS_DESCR STD_AXIS tan_ad FORMULA_0206 8 0.0 1023.0000 /end AXIS_DESCR FORMAT "%6.3" /end CHARACTERISTIC
/begin MEASUREMENT tan_ad_b1 "Eingelesener Spannungswert fuer Ansauglufttemperatur" SWORD FORMULA_0206 0 0 0.0 1023.0000 ECU_ADDRESS 0x3FBFAA /begin FUNCTION_LIST Ansauglufttemperatur /end FUNCTION_LIST /end MEASUREMENT
/begin MEASUREMENT tan_ad_b2 "Eingelesener Spannungswert fuer Ansauglufttemperatur" SWORD FORMULA_0206 0 0 0.0 1023.0000 ECU_ADDRESS 0x3FBFAC /begin FUNCTION_LIST Ansauglufttemperatur /end FUNCTION_LIST /end MEASUREMENT
/begin MEASUREMENT tan_roh_b1 "Ungefilterter Messwert der Ansauglufttemperatur" SWORD FORMULA_0223 0 0 -50.0000 150.0000 ECU_ADDRESS 0x3FBFAE /begin FUNCTION_LIST Ansauglufttemperatur /end FUNCTION_LIST /end MEASUREMENT
/begin MEASUREMENT tan_roh_b2 "Ungefilterter Messwert der Ansauglufttemperatur" SWORD FORMULA_0223 0 0 -50.0000 150.0000 ECU_ADDRESS 0x3FBFB0 /begin FUNCTION_LIST Ansauglufttemperatur /end FUNCTION_LIST /end MEASUREMENT
/begin MEASUREMENT tan_filter_b1 "Gefilterter Messwert der Ansauglufttemperatur" SWORD FORMULA_0223 0 0 -50.0000 150.0000 ECU_ADDRESS 0x3FBFB2 /begin FUNCTION_LIST Ansauglufttemperatur /end FUNCTION_LIST /end MEASUREMENT
/begin MEASUREMENT tan_filter_b2 "Gefilterter Messwert der Ansauglufttemperatur" SWORD FORMULA_0223 0 0 -50.0000 150.0000 ECU_ADDRESS 0x3FBFB4 /begin FUNCTION_LIST Ansauglufttemperatur /end FUNCTION_LIST /end MEASUREMENT
/* ------------------ Abschnitt erzeugt aus ub.dat ------------------ */
/begin CHARACTERISTIC K_UB_TAU "Filterkonstante Bordspannungserfassung" VALUE 0x62A5C TKW_VV_VV_UB 100.0 FORMULA_0183 0.0101 2.5600 /begin FUNCTION_LIST Bordspannung /end FUNCTION_LIST /end CHARACTERISTIC
/begin CHARACTERISTIC K_UB_DIAG_MIN "Untere Grenze Bordspannung" VALUE 0x62A5E TKW_VV_VV_SW 100.0 FORMULA_0243 0.0 28.0000 /begin FUNCTION_LIST Bordspannung /end FUNCTION_LIST FORMAT "%6.3" /end CHARACTERISTIC
/begin CHARACTERISTIC K_UB_DIAG_MAX "Obere Grenze Bordspannung" VALUE 0x62A60 TKW_VV_VV_SW 100.0 FORMULA_0243 0.0 28.0000 /begin FUNCTION_LIST Bordspannung /end FUNCTION_LIST FORMAT "%6.3" /end CHARACTERISTIC
/begin CHARACTERISTIC K_UB_ML_MIN "Untere Grenze Bordspannung bei laufendem Motor" VALUE 0x62A62 TKW_VV_VV_SW 100.0 FORMULA_0243 0.0 28.0000 /begin FUNCTION_LIST Bordspannung /end FUNCTION_LIST FORMAT "%6.3" /end CHARACTERISTIC
/begin CHARACTERISTIC K_UB_ERSATZ "Ersatzwert Bordspannung" VALUE 0x62A64 TKW_VV_VV_SW 100.0 FORMULA_0243 0.0 28.0000 /begin FUNCTION_LIST Bordspannung /end FUNCTION_LIST FORMAT "%6.3" /end CHARACTERISTIC
/begin CHARACTERISTIC K_UB_START_TIME "Ansprechzeit der Plausibilitaet" VALUE 0x62A66 TKW_VV_VV_UB 100.0 FORMULA_0244 0.0 255.0000 /begin FUNCTION_LIST Bordspannung /end FUNCTION_LIST /end CHARACTERISTIC
/begin MEASUREMENT ub_15_ad "AD-Wert der U_KL15-Erfassung" SWORD FORMULA_0206 0 0 0.0 1023.0000 ECU_ADDRESS 0x3FC0C8 /begin FUNCTION_LIST Bordspannung /end FUNCTION_LIST /end MEASUREMENT
/begin MEASUREMENT ub_ad "AD-Wert der U_KL87-Erfassung" SWORD FORMULA_0206 0 0 0.0 1023.0000 ECU_ADDRESS 0x3FC0CA /begin FUNCTION_LIST Bordspannung /end FUNCTION_LIST /end MEASUREMENT
/begin MEASUREMENT ub_15_roh "Rohwert der U_KL15-Erfassung" SWORD FORMULA_0243 0 0 0.0 28.0000 ECU_ADDRESS 0x3FC0CC /begin FUNCTION_LIST Bordspannung /end FUNCTION_LIST /end MEASUREMENT
/begin MEASUREMENT ub_roh "Rohwert der U_KL87-Erfassung" SWORD FORMULA_0243 0 0 0.0 28.0000 ECU_ADDRESS 0x3FC0CE /begin FUNCTION_LIST Bordspannung /end FUNCTION_LIST /end MEASUREMENT
/begin MEASUREMENT ub_15_filter "Gefilterter Messwert der U_KL15-Erfassung" SWORD FORMULA_0243 0 0 0.0 28.0000 ECU_ADDRESS 0x3FC0D0 /begin FUNCTION_LIST Bordspannung /end FUNCTION_LIST /end MEASUREMENT
/begin MEASUREMENT ub_filter "Gefilterter Messwert der U_KL87-Erfassung" SWORD FORMULA_0243 0 0 0.0 28.0000 ECU_ADDRESS 0x3FC0D2 /begin FUNCTION_LIST Bordspannung /end FUNCTION_LIST /end MEASUREMENT
/begin FUNCTION Abgastemperatur "Abgastemperatur" /end FUNCTION
/begin FUNCTION Adaptionswerte "Adaptionswerte" /end FUNCTION
/begin FUNCTION Ansauglufttemperatur "Ansauglufttemperatur" /end FUNCTION
/begin FUNCTION Aussetzererkennung "Aussetzererkennung" /end FUNCTION
/begin FUNCTION BSD "BSD" /end FUNCTION
/begin FUNCTION Bordspannung "Bordspannung" /end FUNCTION
/begin FUNCTION DSP "DSP" /end FUNCTION
/begin RECORD_LAYOUT TKW_VV_VV_UB FNC_VALUES 1 UBYTE COLUMN_DIR DIRECT /end RECORD_LAYOUT
/begin RECORD_LAYOUT TKW_VV_VV_UW FNC_VALUES 1 UWORD COLUMN_DIR DIRECT /end RECORD_LAYOUT
/begin RECORD_LAYOUT TKW_VV_VV_SW FNC_VALUES 1 SWORD COLUMN_DIR DIRECT /end RECORD_LAYOUT
/begin RECORD_LAYOUT TKL_UW_VV_UW NO_AXIS_PTS_X 1 UBYTE RESERVED 2 BYTE AXIS_PTS_X 3 UWORD INDEX_INCR DIRECT FNC_VALUES 4 UWORD COLUMN_DIR DIRECT /end RECORD_LAYOUT
/begin RECORD_LAYOUT TKL_SW_VV_UB NO_AXIS_PTS_X 1 UBYTE RESERVED 2 BYTE AXIS_PTS_X 3 SWORD INDEX_INCR DIRECT FNC_VALUES 4 UBYTE COLUMN_DIR DIRECT /end RECORD_LAYOUT
/begin RECORD_LAYOUT TKL_SW_VV_UW NO_AXIS_PTS_X 1 UBYTE RESERVED 2 BYTE AXIS_PTS_X 3 SWORD INDEX_INCR DIRECT FNC_VALUES 4 UWORD COLUMN_DIR DIRECT /end RECORD_LAYOUT
/begin RECORD_LAYOUT TKL_SW_VV_SW NO_AXIS_PTS_X 1 UBYTE RESERVED 2 BYTE AXIS_PTS_X 3 SWORD INDEX_INCR DIRECT FNC_VALUES 4 SWORD COLUMN_DIR DIRECT /end RECORD_LAYOUT
/begin RECORD_LAYOUT TKF_SW_SW_SW NO_AXIS_PTS_X 1 UBYTE NO_AXIS_PTS_Y 2 UBYTE AXIS_PTS_X 3 SWORD INDEX_INCR DIRECT AXIS_PTS_Y 4 SWORD INDEX_INCR DIRECT FNC_VALUES 5 SWORD COLUMN_DIR DIRECT /end RECORD_LAYOUT
/end MODULE
/end PROJECT
