ASAP2_VERSION 1 41
/begin PROJECT MSD85 "Spray Guided DI-System with Piezo Injectors for 8-Cylinder"
/begin HEADER "_default_HeaderComment" PROJECT_NO _91 /end HEADER
/begin MODULE _default_ModuleName "_default_ModuleLongIdentifier"
/begin MOD_COMMON "_default_ModCommonComment" DEPOSIT ABSOLUTE BYTE_ORDER MSB_LAST ALIGNMENT_BYTE 1 ALIGNMENT_WORD 2 ALIGNMENT_LONG 2 ALIGNMENT_FLOAT32_IEEE 2 ALIGNMENT_FLOAT64_IEEE 4 /end MOD_COMMON
/begin CHARACTERISTIC c_t_cyc_disp_icl_can "recurrence for transmission of  check control message" VALUE 0xa080c156 _REC_VAL_20_u1 15. _CNV_A_R_LINEAR_____36_CM 0. 15. DISPLAY_IDENTIFIER C_T_CYC_DISP_ICL_CAN FORMAT "%2.0" /end CHARACTERISTIC
/begin MEASUREMENT ctl_acin_eng_typ "special function for air conditioning control - not used with engine type M54" UBYTE _CNV_A_R_LINEAR_____0_CM 1 100. 0. 3. DISPLAY_IDENTIFIER CTL_ACIN_ENG_TYP ECU_ADDRESS 0xd0000435 FORMAT "%1.0" /end MEASUREMENT
/begin MEASUREMENT state_swi_off_vb "state switch off battery voltage (kl30)" UBYTE _CNV_A_R_LINEAR_____0_CM 1 100. 0. 3. DISPLAY_IDENTIFIER STATE_SWI_OFF_VB ECU_ADDRESS 0xd000043a FORMAT "%1.0" /end MEASUREMENT
/begin MEASUREMENT cks_can_tq_dcc "Checksum TQ_DCC from CAN" UBYTE _CNV_A_R_LINEAR_____0_CM 1 100. 0. 255. DISPLAY_IDENTIFIER CKS_CAN_TQ_DCC ECU_ADDRESS 0xd0000409 FORMAT "%3.0" /end MEASUREMENT
/begin MEASUREMENT cks_can_tq_tcs "checksum traction control system TQ_TCS from CAN" UBYTE _CNV_A_R_LINEAR_____0_CM 1 100. 0. 255. DISPLAY_IDENTIFIER CKS_CAN_TQ_TCS ECU_ADDRESS 0xd0000421 FORMAT "%3.0" /end MEASUREMENT
/begin MEASUREMENT cks_can_tq_etcu "check sum TQ_ETCU from CAN" UBYTE _CNV_A_R_LINEAR_____0_CM 1 100. 0. 255. DISPLAY_IDENTIFIER CKS_CAN_TQ_ETCU ECU_ADDRESS 0xd0000425 FORMAT "%3.0" /end MEASUREMENT
/begin MEASUREMENT cks_can_tq_amt "check sum TQ_AMT from CAN" UBYTE _CNV_A_R_LINEAR_____0_CM 1 100. 0. 255. DISPLAY_IDENTIFIER CKS_CAN_TQ_AMT ECU_ADDRESS 0xd000042d FORMAT "%3.0" /end MEASUREMENT
/begin MEASUREMENT cks_can_msw "checksum MSW - SZL" UBYTE _CNV_A_R_LINEAR_____0_CM 1 100. 0. 255. DISPLAY_IDENTIFIER CKS_CAN_MSW ECU_ADDRESS 0xd0000431 FORMAT "%3.0" /end MEASUREMENT
/begin MEASUREMENT tcc_can_ecu "free running test cycle counter ECU1 (alive counter)" UBYTE _CNV_A_R_LINEAR_____50_CM 1 100. 0. 14. DISPLAY_IDENTIFIER TCC_CAN_ECU ECU_ADDRESS 0xd000043c FORMAT "%2.0" /end MEASUREMENT
/begin MEASUREMENT tcc_can_ecu1 "free running test cycle counter ECU1 (alive counter)" UBYTE _CNV_A_R_LINEAR_____50_CM 1 100. 0. 14. DISPLAY_IDENTIFIER TCC_CAN_ECU1 ECU_ADDRESS 0xd000043d FORMAT "%2.0" /end MEASUREMENT
/begin MEASUREMENT tcc_can_ecu2 "free running test cycle counter ECU2 (alive counter)" UBYTE _CNV_A_R_LINEAR_____50_CM 1 100. 0. 14. DISPLAY_IDENTIFIER TCC_CAN_ECU2 ECU_ADDRESS 0xd000043e FORMAT "%2.0" /end MEASUREMENT
/begin MEASUREMENT tcc_can_ecu3 "free running test cycle counter ECU3 (alive counter)" UBYTE _CNV_A_R_LINEAR_____50_CM 1 100. 0. 14. DISPLAY_IDENTIFIER TCC_CAN_ECU3 ECU_ADDRESS 0xd000043f FORMAT "%2.0" /end MEASUREMENT
/begin CHARACTERISTIC c_icl_disp_frq "calibratable constant for display messages on ICL" VALUE 0xa080bdad _REC_VAL_20_u1 3. _CNV_A_R_LINEAR_____0_CM 0. 3. DISPLAY_IDENTIFIER C_ICL_DISP_FRQ FORMAT "%2.0" /end CHARACTERISTIC
/begin MEASUREMENT cks_can_cas "check sum CAS from CAN" UBYTE _CNV_A_R_LINEAR_____0_CM 1 100. 0. 255. DISPLAY_IDENTIFIER CKS_CAN_CAS ECU_ADDRESS 0xd0000418 FORMAT "%3.0" /end MEASUREMENT
/begin MEASUREMENT cks_clc_cas "check sum CAS" UBYTE _CNV_A_R_LINEAR_____0_CM 1 100. 0. 255. DISPLAY_IDENTIFIER CKS_CLC_CAS ECU_ADDRESS 0xd0000419 FORMAT "%3.0" /end MEASUREMENT
/begin MEASUREMENT cks_can_etcu_3 "check sum ETCU_3 from CAN" UBYTE _CNV_A_R_LINEAR_____0_CM 1 100. 0. 255. DISPLAY_IDENTIFIER CKS_CAN_ETCU_3 ECU_ADDRESS 0xd0000429 FORMAT "%3.0" /end MEASUREMENT
/begin MEASUREMENT cks_clc_etcu_3 "Checksum ETCU_3" UBYTE _CNV_A_R_LINEAR_____0_CM 1 100. 0. 255. DISPLAY_IDENTIFIER CKS_CLC_ETCU_3 ECU_ADDRESS 0xd000042a FORMAT "%3.0" /end MEASUREMENT
/begin MEASUREMENT cks_clc_tq_dcc "check sum TQ_DCC" UBYTE _CNV_A_R_LINEAR_____0_CM 1 100. 0. 255. DISPLAY_IDENTIFIER CKS_CLC_TQ_DCC ECU_ADDRESS 0xd000040a FORMAT "%3.0" /end MEASUREMENT
/begin MEASUREMENT cks_clc_tq_tcs "check sum TQ_TCS" UBYTE _CNV_A_R_LINEAR_____0_CM 1 100. 0. 255. DISPLAY_IDENTIFIER CKS_CLC_TQ_TCS ECU_ADDRESS 0xd0000422 FORMAT "%3.0" /end MEASUREMENT
/begin MEASUREMENT cks_clc_tq_etcu "check sum TQ_ETCU" UBYTE _CNV_A_R_LINEAR_____0_CM 1 100. 0. 255. DISPLAY_IDENTIFIER CKS_CLC_TQ_ETCU ECU_ADDRESS 0xd0000426 FORMAT "%3.0" /end MEASUREMENT
/begin MEASUREMENT cks_clc_tq_amt "check sum TQ_AMT" UBYTE _CNV_A_R_LINEAR_____0_CM 1 100. 0. 255. DISPLAY_IDENTIFIER CKS_CLC_TQ_AMT ECU_ADDRESS 0xd000042e FORMAT "%3.0" /end MEASUREMENT
/begin MEASUREMENT cks_clc_msw "check sum CRU (SZL)" UBYTE _CNV_A_R_LINEAR_____0_CM 1 100. 0. 255. DISPLAY_IDENTIFIER CKS_CLC_MSW ECU_ADDRESS 0xd0000432 FORMAT "%3.0" /end MEASUREMENT
/begin MEASUREMENT cks_clc_ecu1 "check sum ECU 1" UBYTE _CNV_A_R_LINEAR_____0_CM 1 100. 0. 255. DISPLAY_IDENTIFIER CKS_CLC_ECU1 ECU_ADDRESS 0xd0000440 FORMAT "%3.0" /end MEASUREMENT
/begin MEASUREMENT cks_clc_ecu2 "check sum ECU 2" UBYTE _CNV_A_R_LINEAR_____0_CM 1 100. 0. 255. DISPLAY_IDENTIFIER CKS_CLC_ECU2 ECU_ADDRESS 0xd0000441 FORMAT "%3.0" /end MEASUREMENT
/begin MEASUREMENT cks_clc_ecu3 "check sum ECU 3" UBYTE _CNV_A_R_LINEAR_____0_CM 1 100. 0. 255. DISPLAY_IDENTIFIER CKS_CLC_ECU3 ECU_ADDRESS 0xd0000442 FORMAT "%3.0" /end MEASUREMENT
/begin CHARACTERISTIC c_cc_mess "ID2 check-control message standard ID2_CC_MESS_STD (Standard CC-report)" VALUE 0xa080baa2 _REC_VAL_20_u1 255. _CNV_A_R_LINEAR_____0_CM 0. 255. DISPLAY_IDENTIFIER C_CC_MESS FORMAT "%3.0" /end CHARACTERISTIC
/begin MEASUREMENT cks_can_veh_mod "check sum VEH_MOD from CAN" UBYTE _CNV_A_R_LINEAR_____0_CM 1 100. 0. 255. DISPLAY_IDENTIFIER CKS_CAN_VEH_MOD ECU_ADDRESS 0xd000041c FORMAT "%3.0" /end MEASUREMENT
/begin MEASUREMENT cc_id "Checkcontrol ID" UWORD _CNV_A_R_LINEAR_____0_CM 1 100. 0. 65535. DISPLAY_IDENTIFIER CC_ID ECU_ADDRESS 0xd00003a4 FORMAT "%5.0" /end MEASUREMENT
/begin MEASUREMENT lv_mil_fll "bit for MIL flash light" UBYTE _CNV_S_2_RANGE__0___1_CM 1 100. 0. 1. DISPLAY_IDENTIFIER LV_MIL_FLL ECU_ADDRESS 0xd0000474 BIT_MASK 0x1 /end MEASUREMENT
/begin MEASUREMENT tq_ems_bn "actual engine torque - driver's choice (converted for BN)" SWORD _CNV_A_R_LINEAR_____31_CM 1 100. -1024. 1023.96875 DISPLAY_IDENTIFIER TQ_EMS_BN ECU_ADDRESS 0xd00003a2 FORMAT "%8.2" /end MEASUREMENT
/begin MEASUREMENT tq_maf "actual engine torque - spare, positive (converted for BN)" SWORD _CNV_A_R_LINEAR_____31_CM 1 100. -1024. 1023.96875 DISPLAY_IDENTIFIER TQ_MAF ECU_ADDRESS 0xd000039c FORMAT "%8.2" /end MEASUREMENT
/begin CHARACTERISTIC ip_t_ast_swi_wup__ctr_km_can "Time condition for setting the LV_WUP_CAN" CURVE 0xa080b400 _REC_CUR_20_u2_u2 6553.5 _CNV_A_R_LINEAR_____4_CM 0. 6553.5 DISPLAY_IDENTIFIER IP_T_AST_SWI_WUP__CTR_KM_CAN FORMAT "%6.1"
 /begin AXIS_DESCR COM_AXIS ctr_km_can _CNV_A_R_LINEAR_____58_CM 4 0. 655340. FORMAT "%6.0" AXIS_PTS_REF lpdm_ctr_km_can /end AXIS_DESCR
/end CHARACTERISTIC
/begin AXIS_PTS lpdm_ctr_km_can "" 0xa0809928 ctr_km_can _REC_AXS_20_u2 655340. _CNV_A_R_LINEAR_____58_CM 4 0. 655340. FORMAT "%6.0" /end AXIS_PTS
/begin CHARACTERISTIC c_n_32_thd_cc_poil_swi "N_32-Threshold for activating CC-message LV_POIL_SWI" VALUE 0xa080bf13 _REC_VAL_20_u1 8160. _CNV_A_R_LINEAR_____10_CM 0. 8160. DISPLAY_IDENTIFIER C_N_32_THD_CC_POIL_SWI FORMAT "%4.0" /end CHARACTERISTIC
/begin CHARACTERISTIC ip_t_dly_poil_swi_can__toil "Delay-time for first activation of CC-message LV_POIL_SWI" CURVE 0xa080b420 _REC_CUR_20_u2_u1 6553.5 _CNV_A_R_LINEAR_____4_CM 0. 6553.5 DISPLAY_IDENTIFIER IP_T_DLY_POIL_SWI_CAN__TOIL FORMAT "%6.1"
 /begin AXIS_DESCR COM_AXIS toil _CNV_A_R_LINEAR_____26_CM 6 -40. 160. FORMAT "%3.0" AXIS_PTS_REF ldp_toil__t_dly_poil_swi_can /end AXIS_DESCR
/end CHARACTERISTIC
/begin AXIS_PTS ldp_toil__t_dly_poil_swi_can "" 0xa0808eee toil _REC_AXS_20_u1 200. _CNV_A_R_LINEAR_____26_CM 6 -40. 160. FORMAT "%3.0" /end AXIS_PTS
/begin CHARACTERISTIC c_n_sp_is_thd_can "engine speed setpoint threshold for reconition of ST_SW_LEV_RPM condition" VALUE 0xa080bfce _REC_VAL_20_u2 8159. _CNV_A_R_LINEAR_____14_CM 1. 8160. DISPLAY_IDENTIFIER C_N_SP_IS_THD_CAN FORMAT "%4.0" /end CHARACTERISTIC
/begin MEASUREMENT cks_can_tq_pste_2 "Checksum TQ_PSTE_2 from CAN" UBYTE _CNV_A_R_LINEAR_____0_CM 1 100. 0. 255. DISPLAY_IDENTIFIER CKS_CAN_TQ_PSTE_2 ECU_ADDRESS 0xd000040d FORMAT "%3.0" /end MEASUREMENT
/begin MEASUREMENT cks_can_tq_pste_3 "Checksum TQ_PSTE_3 from CAN" UBYTE _CNV_A_R_LINEAR_____0_CM 1 100. 0. 255. DISPLAY_IDENTIFIER CKS_CAN_TQ_PSTE_3 ECU_ADDRESS 0xd0000411 FORMAT "%3.0" /end MEASUREMENT
/begin MEASUREMENT cks_clc_tq_pste_2 "check sum TQ_PSTE_2" UBYTE _CNV_A_R_LINEAR_____0_CM 1 100. 0. 255. DISPLAY_IDENTIFIER CKS_CLC_TQ_PSTE_2 ECU_ADDRESS 0xd000040e FORMAT "%3.0" /end MEASUREMENT
/begin MEASUREMENT cks_clc_tq_pste_3 "Check sum EHB3 (PSTE 3)" UBYTE _CNV_A_R_LINEAR_____0_CM 1 100. 0. 255. DISPLAY_IDENTIFIER CKS_CLC_TQ_PSTE_3 ECU_ADDRESS 0xd0000412 FORMAT "%3.0" /end MEASUREMENT
/begin CHARACTERISTIC lc_msr_bn "LC for allowing MSR-intervention in case of TQ_TCS_FAST_BN <> TQ_TCS_SLOW_BN by DSC" VALUE 0xa080c5b3 _REC_VAL_20_u1 1. _CNV_A_R_LINEAR_____0_CM 0. 1. DISPLAY_IDENTIFIER LC_MSR_BN FORMAT "%2.0" /end CHARACTERISTIC
/begin CHARACTERISTIC lc_ena_cc_mil_1 "" VALUE 0xa080c559 _REC_VAL_20_u1 1. _CNV_A_R_LINEAR_____0_CM 0. 1. DISPLAY_IDENTIFIER LC_ENA_CC_MIL_1 FORMAT "%2.0" /end CHARACTERISTIC
/begin CHARACTERISTIC lc_ena_cc_mil_2 "" VALUE 0xa080c55a _REC_VAL_20_u1 1. _CNV_A_R_LINEAR_____0_CM 0. 1. DISPLAY_IDENTIFIER LC_ENA_CC_MIL_2 FORMAT "%2.0" /end CHARACTERISTIC
/begin CHARACTERISTIC c_state_cc_id_34 "sending-condition for CC-message (e.g. LV_IGK, LV_KEY_AUX, etc.)" VALUE 0xa080c0d3 _REC_VAL_20_u1 15. _CNV_A_R_LINEAR_____0_CM 0. 15. DISPLAY_IDENTIFIER C_STATE_CC_ID_34 FORMAT "%2.0" /end CHARACTERISTIC
/begin CHARACTERISTIC c_state_cc_id_33 "sending-condition for CC-message (e.g. LV_IGK, LV_KEY_AUX, etc.)" VALUE 0xa080c0d2 _REC_VAL_20_u1 15. _CNV_A_R_LINEAR_____0_CM 0. 15. DISPLAY_IDENTIFIER C_STATE_CC_ID_33 FORMAT "%2.0" /end CHARACTERISTIC
/begin CHARACTERISTIC c_state_cc_id_257 "sending-condition for CC-message (e.g. LV_IGK, LV_KEY_AUX, etc.)" VALUE 0xa080c0c6 _REC_VAL_20_u1 15. _CNV_A_R_LINEAR_____0_CM 0. 15. DISPLAY_IDENTIFIER C_STATE_CC_ID_257 FORMAT "%2.0" /end CHARACTERISTIC
/begin CHARACTERISTIC c_tco_swi_wup "TCO condition for setting the bit S_WL" VALUE 0xa080c2ea _REC_VAL_20_u1 190.5 _CNV_A_R_LINEAR_____17_CM -48. 142.5 DISPLAY_IDENTIFIER C_TCO_SWI_WUP FORMAT "%5.1" /end CHARACTERISTIC
/begin CHARACTERISTIC c_state_cc_id_39 "sending-condition for CC-message (e.g. LV_IGK, LV_KEY_AUX, etc.)" VALUE 0xa080c0d5 _REC_VAL_20_u1 15. _CNV_A_R_LINEAR_____0_CM 0. 15. DISPLAY_IDENTIFIER C_STATE_CC_ID_39 FORMAT "%2.0" /end CHARACTERISTIC
/begin CHARACTERISTIC c_state_cc_id_212 "sending-condition for CC-message (e.g. LV_IGK, LV_KEY_AUX, etc.)" VALUE 0xa080c0c1 _REC_VAL_20_u1 15. _CNV_A_R_LINEAR_____0_CM 0. 15. DISPLAY_IDENTIFIER C_STATE_CC_ID_212 FORMAT "%2.0" /end CHARACTERISTIC
/begin CHARACTERISTIC c_state_cc_id_213 "sending-condition for CC-message (e.g. LV_IGK, LV_KEY_AUX, etc.)" VALUE 0xa080c0c2 _REC_VAL_20_u1 15. _CNV_A_R_LINEAR_____0_CM 0. 15. DISPLAY_IDENTIFIER C_STATE_CC_ID_213 FORMAT "%2.0" /end CHARACTERISTIC
/begin CHARACTERISTIC c_state_cc_id_26 "sending-condition for CC-message (e.g. LV_IGK, LV_KEY_AUX, etc.)" VALUE 0xa080c0c7 _REC_VAL_20_u1 15. _CNV_A_R_LINEAR_____0_CM 0. 15. DISPLAY_IDENTIFIER C_STATE_CC_ID_26 FORMAT "%2.0" /end CHARACTERISTIC
/begin CHARACTERISTIC c_state_cc_id_28 "sending-condition for CC-message (e.g. LV_IGK, LV_KEY_AUX, etc.)" VALUE 0xa080c0cb _REC_VAL_20_u1 15. _CNV_A_R_LINEAR_____0_CM 0. 15. DISPLAY_IDENTIFIER C_STATE_CC_ID_28 FORMAT "%2.0" /end CHARACTERISTIC
/begin CHARACTERISTIC c_state_cc_id_29 "sending-condition for CC-message (e.g. LV_IGK, LV_KEY_AUX, etc.)" VALUE 0xa080c0cc _REC_VAL_20_u1 15. _CNV_A_R_LINEAR_____0_CM 0. 15. DISPLAY_IDENTIFIER C_STATE_CC_ID_29 FORMAT "%2.0" /end CHARACTERISTIC
/begin CHARACTERISTIC c_state_cc_id_31 "sending-condition for CC-message (e.g. LV_IGK, LV_KEY_AUX, etc.)" VALUE 0xa080c0d0 _REC_VAL_20_u1 15. _CNV_A_R_LINEAR_____0_CM 0. 15. DISPLAY_IDENTIFIER C_STATE_CC_ID_31 FORMAT "%2.0" /end CHARACTERISTIC
/begin CHARACTERISTIC c_state_cc_id_155 "sending-condition for CC-message (e.g. LV_IGK, LV_KEY_AUX, etc.)" VALUE 0xa080c0bf _REC_VAL_20_u1 15. _CNV_A_R_LINEAR_____0_CM 0. 15. DISPLAY_IDENTIFIER C_STATE_CC_ID_155 FORMAT "%2.0" /end CHARACTERISTIC
/begin CHARACTERISTIC c_state_cc_id_27 "sending-condition for CC-message (e.g. LV_IGK, LV_KEY_AUX, etc.)" VALUE 0xa080c0c8 _REC_VAL_20_u1 15. _CNV_A_R_LINEAR_____0_CM 0. 15. DISPLAY_IDENTIFIER C_STATE_CC_ID_27 FORMAT "%2.0" /end CHARACTERISTIC
/begin CHARACTERISTIC c_state_cc_id_32 "sending-condition for CC-message (e.g. LV_IGK, LV_KEY_AUX, etc.)" VALUE 0xa080c0d1 _REC_VAL_20_u1 15. _CNV_A_R_LINEAR_____0_CM 0. 15. DISPLAY_IDENTIFIER C_STATE_CC_ID_32 FORMAT "%2.0" /end CHARACTERISTIC
/begin CHARACTERISTIC c_state_cc_id_182 "sending-condition for CC-message (e.g. LV_IGK, LV_KEY_AUX, etc.)" VALUE 0xa080c0c0 _REC_VAL_20_u1 15. _CNV_A_R_LINEAR_____0_CM 0. 15. DISPLAY_IDENTIFIER C_STATE_CC_ID_182 FORMAT "%2.0" /end CHARACTERISTIC
/begin CHARACTERISTIC c_state_cc_id_229 "sending-condition for CC-message (e.g. LV_IGK, LV_KEY_AUX, etc.)" VALUE 0xa080c0c4 _REC_VAL_20_u1 15. _CNV_A_R_LINEAR_____0_CM 0. 15. DISPLAY_IDENTIFIER C_STATE_CC_ID_229 FORMAT "%2.0" /end CHARACTERISTIC
/begin CHARACTERISTIC c_state_cc_id_247 "sending-condition for CC-message (e.g. LV_IGK, LV_KEY_AUX, etc.)" VALUE 0xa080c0c5 _REC_VAL_20_u1 15. _CNV_A_R_LINEAR_____0_CM 0. 15. DISPLAY_IDENTIFIER C_STATE_CC_ID_247 FORMAT "%2.0" /end CHARACTERISTIC
/begin CHARACTERISTIC c_state_cc_id_220 "sending-condition for CC-message (e.g. LV_IGK, LV_KEY_AUX, etc.)" VALUE 0xa080c0c3 _REC_VAL_20_u1 15. _CNV_A_R_LINEAR_____0_CM 0. 15. DISPLAY_IDENTIFIER C_STATE_CC_ID_220 FORMAT "%2.0" /end CHARACTERISTIC
/begin CHARACTERISTIC c_state_cc_id_304 "sending-condition for CC-message (e.g. LV_IGK, LV_KEY_AUX, etc.)" VALUE 0xa080c0cd _REC_VAL_20_u1 15. _CNV_A_R_LINEAR_____0_CM 0. 15. DISPLAY_IDENTIFIER C_STATE_CC_ID_304 FORMAT "%2.0" /end CHARACTERISTIC
/begin CHARACTERISTIC c_state_cc_id_305 "sending-condition for CC-message (e.g. LV_IGK, LV_KEY_AUX, etc.)" VALUE 0xa080c0ce _REC_VAL_20_u1 15. _CNV_A_R_LINEAR_____0_CM 0. 15. DISPLAY_IDENTIFIER C_STATE_CC_ID_305 FORMAT "%2.0" /end CHARACTERISTIC
/begin CHARACTERISTIC c_state_cc_id_148 "sending-condition for CC-message (e.g. LV_IGK, LV_KEY_AUX, etc.)" VALUE 0xa080c0be _REC_VAL_20_u1 15. _CNV_A_R_LINEAR_____0_CM 0. 15. DISPLAY_IDENTIFIER C_STATE_CC_ID_148 FORMAT "%2.0" /end CHARACTERISTIC
/begin CHARACTERISTIC c_state_cc_id_276 "sending-condition for CC-message (e.g. LV_IGK, LV_KEY_AUX, etc.)" VALUE 0xa080c0c9 _REC_VAL_20_u1 15. _CNV_A_R_LINEAR_____0_CM 0. 15. DISPLAY_IDENTIFIER C_STATE_CC_ID_276 FORMAT "%2.0" /end CHARACTERISTIC
/begin CHARACTERISTIC c_state_cc_id_278 "sending-condition for CC-message (e.g. LV_IGK, LV_KEY_AUX, etc.)" VALUE 0xa080c0ca _REC_VAL_20_u1 15. _CNV_A_R_LINEAR_____0_CM 0. 15. DISPLAY_IDENTIFIER C_STATE_CC_ID_278 FORMAT "%2.0" /end CHARACTERISTIC
/begin CHARACTERISTIC c_state_cc_id_bench "sending-condition for CC-message (e.g. LV_IGK, LV_KEY_AUX, etc.)" VALUE 0xa080c0d8 _REC_VAL_20_u1 15. _CNV_A_R_LINEAR_____0_CM 0. 15. DISPLAY_IDENTIFIER C_STATE_CC_ID_BENCH FORMAT "%2.0" /end CHARACTERISTIC
/begin MEASUREMENT state_cc_key "CC-message transmission-condition ID xx " UBYTE _CNV_A_R_LINEAR_____0_CM 1 100. 0. 15. DISPLAY_IDENTIFIER STATE_CC_KEY ECU_ADDRESS 0xd0000445 FORMAT "%2.0" /end MEASUREMENT
/begin MEASUREMENT state_dcc_ctl "Status DCC control" UBYTE _CNV_A_R_LINEAR_____0_CM 1 100. 0. 7. DISPLAY_IDENTIFIER STATE_DCC_CTL ECU_ADDRESS 0xd00081ba FORMAT "%1.0" /end MEASUREMENT
/begin MEASUREMENT cks_can_ldm "Checksum LDM from CAN" UBYTE _CNV_A_R_LINEAR_____0_CM 1 100. 0. 255. DISPLAY_IDENTIFIER CKS_CAN_LDM ECU_ADDRESS 0xd000044e FORMAT "%3.0" /end MEASUREMENT
/begin MEASUREMENT cks_clc_ldm "Checksum LDM" UBYTE _CNV_A_R_LINEAR_____0_CM 1 100. 0. 255. DISPLAY_IDENTIFIER CKS_CLC_LDM ECU_ADDRESS 0xd000044f FORMAT "%3.0" /end MEASUREMENT
/begin MEASUREMENT cks_clc_tq_wheel_1 "check sum TQ_WHEEL_1" UBYTE _CNV_A_R_LINEAR_____0_CM 1 100. 0. 255. DISPLAY_IDENTIFIER CKS_CLC_TQ_WHEEL_1 ECU_ADDRESS 0xd0000454 FORMAT "%3.0" /end MEASUREMENT
/begin MEASUREMENT cks_clc_tq_wheel_2 "check sum TQ_WHEEL_2" UBYTE _CNV_A_R_LINEAR_____0_CM 1 100. 0. 255. DISPLAY_IDENTIFIER CKS_CLC_TQ_WHEEL_2 ECU_ADDRESS 0xd0000455 FORMAT "%3.0" /end MEASUREMENT
/begin MEASUREMENT state_pow_clas_veh "status vehicle power class via CAN" UBYTE _CNV_A_R_LINEAR_____0_CM 1 100. 0. 3. DISPLAY_IDENTIFIER STATE_POW_CLAS_VEH ECU_ADDRESS 0xd00081d9 FORMAT "%1.0" /end MEASUREMENT
/begin MEASUREMENT t_clk_icl_disp_1 "Display of date (day)" UBYTE _CNV_A_R_LINEAR_____0_CM 1 100. 0. 255. DISPLAY_IDENTIFIER T_CLK_ICL_DISP_1 ECU_ADDRESS 0xd00081d7 FORMAT "%3.0" /end MEASUREMENT
/begin MEASUREMENT t_clk_icl_disp_2 "Display of date (month)" UBYTE _CNV_A_R_LINEAR_____0_CM 1 100. 0. 255. DISPLAY_IDENTIFIER T_CLK_ICL_DISP_2 ECU_ADDRESS 0xd00081d8 FORMAT "%3.0" /end MEASUREMENT
/begin MEASUREMENT t_clk_icl_disp_3 "Display of date (year)" UWORD _CNV_A_R_LINEAR_____0_CM 1 100. 0. 65535. DISPLAY_IDENTIFIER T_CLK_ICL_DISP_3 ECU_ADDRESS 0xd000a068 FORMAT "%5.0" /end MEASUREMENT
/begin MEASUREMENT n_ecf_can "relative desired ECF speed from ext. ECU (AFS, EPS)" UBYTE _CNV_A_R_LINEAR_____5_CM 1 100. 0. 99.609375 DISPLAY_IDENTIFIER N_ECF_CAN ECU_ADDRESS 0xd00081da FORMAT "%9.6" /end MEASUREMENT
/begin MEASUREMENT ecf_req_ext "ext. ECU (AFS, EPS) requiring ECF speed" UBYTE _CNV_A_R_LINEAR_____0_CM 1 100. 0. 255. DISPLAY_IDENTIFIER ECF_REQ_EXT ECU_ADDRESS 0xd0000446 FORMAT "%3.0" /end MEASUREMENT
/begin MEASUREMENT qoil_ds_rst_can_2_1 "ID2_BOS_resetting_2" UBYTE _CNV_A_R_LINEAR_____0_CM 1 100. 0. 255. DISPLAY_IDENTIFIER QOIL_DS_RST_CAN_2_1 ECU_ADDRESS 0xd00081db FORMAT "%3.0" /end MEASUREMENT
/begin MEASUREMENT qoil_ds_rst_can_2_2 "ID_function_BOS_resetting_2" UWORD _CNV_A_R_LINEAR_____0_CM 1 100. 0. 65535. DISPLAY_IDENTIFIER QOIL_DS_RST_CAN_2_2 ECU_ADDRESS 0xd000a06c FORMAT "%5.0" /end MEASUREMENT
/begin MEASUREMENT qoil_ds_rst_can_2_3 "Prognose_Intervall_Weg_BOS_Rückstellung_2" UBYTE _CNV_A_R_LINEAR_____0_CM 1 100. 0. 255. DISPLAY_IDENTIFIER QOIL_DS_RST_CAN_2_3 ECU_ADDRESS 0xd00081dc FORMAT "%3.0" /end MEASUREMENT
/begin MEASUREMENT qoil_ds_rst_can_2_4 "Zieltermin_Monat_BOS_Rückstellung_2" UBYTE _CNV_A_R_LINEAR_____0_CM 1 100. 0. 255. DISPLAY_IDENTIFIER QOIL_DS_RST_CAN_2_4 ECU_ADDRESS 0xd00081dd FORMAT "%3.0" /end MEASUREMENT
/begin MEASUREMENT qoil_ds_rst_can_2_5 "Zieltermin_Jahr_BOS_Rückstellung_2" UBYTE _CNV_A_R_LINEAR_____0_CM 1 100. 0. 255. DISPLAY_IDENTIFIER QOIL_DS_RST_CAN_2_5 ECU_ADDRESS 0xd00081de FORMAT "%3.0" /end MEASUREMENT
/begin MEASUREMENT qoil_ds_rst_can_2_6 "Prognose_Intervall_Zeit_BOS_Rückstellung_2" UBYTE _CNV_A_R_LINEAR_____0_CM 1 100. 0. 255. DISPLAY_IDENTIFIER QOIL_DS_RST_CAN_2_6 ECU_ADDRESS 0xd00081df FORMAT "%3.0" /end MEASUREMENT
/begin MEASUREMENT ctr_dly_msg_oil "Counter for delay of oil message" UBYTE _CNV_A_R_LINEAR_____0_CM 1 100. 0. 255. DISPLAY_IDENTIFIER CTR_DLY_MSG_OIL ECU_ADDRESS 0xd000820c FORMAT "%3.0" /end MEASUREMENT
/begin CHARACTERISTIC c_ctr_dly_msg_oil "Counter for transmitting Layer-values after Kl.15 on" VALUE 0xa080bb84 _REC_VAL_20_u1 255. _CNV_A_R_LINEAR_____0_CM 0. 255. DISPLAY_IDENTIFIER C_CTR_DLY_MSG_OIL FORMAT "%3.0" /end CHARACTERISTIC
/begin CHARACTERISTIC c_state_loil_sub "Default value for transmitting layer-values" VALUE 0xa080c0e6 _REC_VAL_20_u1 255. _CNV_A_R_LINEAR_____36_CM 0. 255. DISPLAY_IDENTIFIER C_STATE_LOIL_SUB FORMAT "%3.0" /end CHARACTERISTIC
/begin CHARACTERISTIC c_n_ecf_can "Default value for ECF-request" VALUE 0xa080bf2e _REC_VAL_20_u1 99.609375 _CNV_A_R_LINEAR_____5_CM 0. 99.609375 DISPLAY_IDENTIFIER C_N_ECF_CAN FORMAT "%9.6" /end CHARACTERISTIC
/begin CHARACTERISTIC c_ctr_ldm_can_ini "Default counter value for sending ini-value of ST_INTF_PT" VALUE 0xa080bba2 _REC_VAL_20_u1 255. _CNV_A_R_LINEAR_____0_CM 0. 255. DISPLAY_IDENTIFIER C_CTR_LDM_CAN_INI FORMAT "%3.0" /end CHARACTERISTIC
/begin CHARACTERISTIC lc_efppwm_ctl "Switch between PT-CAN definition and EKP Ctl funktionality" VALUE 0xa080c552 _REC_VAL_20_u1 1. _CNV_A_R_LINEAR_____0_CM 0. 1. DISPLAY_IDENTIFIER LC_EFPPWM_CTL FORMAT "%1.0" /end CHARACTERISTIC
/begin CHARACTERISTIC lc_cc_test_bench "LC for enabling CC test bench" VALUE 0xa080c53b _REC_VAL_20_u1 1. _CNV_A_R_LINEAR_____0_CM 0. 1. DISPLAY_IDENTIFIER LC_CC_TEST_BENCH FORMAT "%1.0" /end CHARACTERISTIC
/begin CHARACTERISTIC c_state_cc_test_bench "Bit coded trigger conditions for activating Checkcontrol test bench" VALUE 0xa080c0d9 _REC_VAL_20_u1 255. _CNV_A_R_LINEAR_____0_CM 0. 255. DISPLAY_IDENTIFIER C_STATE_CC_TEST_BENCH FORMAT "%3.0" /end CHARACTERISTIC
/begin CHARACTERISTIC c_state_cc_test_mask_obd_1 "Bit mask for readiness code completion status 1" VALUE 0xa080c0dc _REC_VAL_20_u1 255. _CNV_A_R_LINEAR_____0_CM 0. 255. DISPLAY_IDENTIFIER C_STATE_CC_TEST_MASK_OBD_1 FORMAT "%3.0" /end CHARACTERISTIC
/begin CHARACTERISTIC c_state_cc_test_mask_obd_2 "Bit mask for readiness code completion status 2" VALUE 0xa080c0dd _REC_VAL_20_u1 255. _CNV_A_R_LINEAR_____0_CM 0. 255. DISPLAY_IDENTIFIER C_STATE_CC_TEST_MASK_OBD_2 FORMAT "%3.0" /end CHARACTERISTIC
/begin CHARACTERISTIC c_ctr_err_dyn_cc_test_bench "Threshold for number of failures stored in dynamic memory" VALUE 0xa080bb8e _REC_VAL_20_u1 255. _CNV_A_R_LINEAR_____0_CM 0. 255. DISPLAY_IDENTIFIER C_CTR_ERR_DYN_CC_TEST_BENCH FORMAT "%3.0" /end CHARACTERISTIC
/begin CHARACTERISTIC c_state_opm_max_cc_test_bench "maximum trigger threshold (OPM_AV) for CC bench mode" VALUE 0xa080c0e7 _REC_VAL_20_u1 8. _CNV_A_R_LINEAR_____0_CM 0. 8. DISPLAY_IDENTIFIER C_STATE_OPM_MAX_CC_TEST_BENCH FORMAT "%1.0" /end CHARACTERISTIC
/begin CHARACTERISTIC c_state_opm_min_cc_test_bench "minimum trigger threshold (OPM_AV) for CC bench mode" VALUE 0xa080c0e8 _REC_VAL_20_u1 8. _CNV_A_R_LINEAR_____0_CM 0. 8. DISPLAY_IDENTIFIER C_STATE_OPM_MIN_CC_TEST_BENCH FORMAT "%1.0" /end CHARACTERISTIC
/begin CHARACTERISTIC c_state_cc_test_bench_obd_1 "Bit coded readiness code status 1 threshold for CC bench mode" VALUE 0xa080c0da _REC_VAL_20_u1 255. _CNV_A_R_LINEAR_____0_CM 0. 255. DISPLAY_IDENTIFIER C_STATE_CC_TEST_BENCH_OBD_1 FORMAT "%3.0" /end CHARACTERISTIC
/begin CHARACTERISTIC c_state_cc_test_bench_obd_2 "Bit coded readiness code status 2 threshold for CC bench mode" VALUE 0xa080c0db _REC_VAL_20_u1 255. _CNV_A_R_LINEAR_____0_CM 0. 255. DISPLAY_IDENTIFIER C_STATE_CC_TEST_BENCH_OBD_2 FORMAT "%3.0" /end CHARACTERISTIC
/begin CHARACTERISTIC c_state_coc_min_cc_test_bench "minimum state of coolant circuit management for CC test bench" VALUE 0xa080c0df _REC_VAL_20_u1 255. _CNV_A_R_LINEAR_____0_CM 0. 255. DISPLAY_IDENTIFIER C_STATE_COC_MIN_CC_TEST_BENCH FORMAT "%3.0" /end CHARACTERISTIC
/begin CHARACTERISTIC c_state_coc_max_cc_test_bench "maximum state of coolant circuit management for CC test bench" VALUE 0xa080c0de _REC_VAL_20_u1 255. _CNV_A_R_LINEAR_____0_CM 0. 255. DISPLAY_IDENTIFIER C_STATE_COC_MAX_CC_TEST_BENCH FORMAT "%3.0" /end CHARACTERISTIC
/begin CHARACTERISTIC c_state_cc_id_397 "sending-condition for CC- test - message " VALUE 0xa080c0d6 _REC_VAL_20_u1 15. _CNV_A_R_LINEAR_____0_CM 0. 15. DISPLAY_IDENTIFIER C_STATE_CC_ID_397 FORMAT "%2.0" /end CHARACTERISTIC
/begin CHARACTERISTIC c_state_cc_id_367 "sending-condition for CC- test - message " VALUE 0xa080c0d4 _REC_VAL_20_u1 15. _CNV_A_R_LINEAR_____0_CM 0. 15. DISPLAY_IDENTIFIER C_STATE_CC_ID_367 FORMAT "%2.0" /end CHARACTERISTIC
/begin CHARACTERISTIC c_cc_id_test_bench "Checkcontrol ID for test message" VALUE 0xa080baa0 _REC_VAL_20_u2 65535. _CNV_A_R_LINEAR_____0_CM 0. 65535. DISPLAY_IDENTIFIER C_CC_ID_TEST_BENCH FORMAT "%5.0" /end CHARACTERISTIC
/begin MEASUREMENT tq_max_acc_can "air-conditioning-compressor limited torque after switch on" UBYTE _CNV_A_R_LINEAR_____57_CM 1 100. 0. 127.5 DISPLAY_IDENTIFIER TQ_MAX_ACC_CAN ECU_ADDRESS 0xd0000461 FORMAT "%3.1" /end MEASUREMENT
/begin CHARACTERISTIC c_ctr_tout_n_ecf_can "Threshold for counter timeout-detection ext. ECF-request" VALUE 0xa080bc09 _REC_VAL_20_u1 255. _CNV_A_R_LINEAR_____0_CM 0. 255. DISPLAY_IDENTIFIER C_CTR_TOUT_N_ECF_CAN FORMAT "%3.0" /end CHARACTERISTIC
/begin CHARACTERISTIC c_ctr_tout_state_err_can "Threshold for counter timeout-detection of OBD diagnosis service message" VALUE 0xa080bc0a _REC_VAL_20_u1 255. _CNV_A_R_LINEAR_____0_CM 0. 255. DISPLAY_IDENTIFIER C_CTR_TOUT_STATE_ERR_CAN FORMAT "%3.0" /end CHARACTERISTIC
/begin CHARACTERISTIC c_t_max_err_n_eng "Threshold for sending RPM_ENG_ERR true or false without debounced CRK error" VALUE 0xa080c1ec _REC_VAL_20_u1 2.55 _CNV_A_R_LINEAR_____3_CM 0. 2.55 DISPLAY_IDENTIFIER C_T_MAX_ERR_N_ENG FORMAT "%4.2" /end CHARACTERISTIC
/begin CHARACTERISTIC c_tq_max_acc "air-conditioning-compressor limit torque after switch on " VALUE 0xa080c394 _REC_VAL_20_u1 127.5 _CNV_A_R_LINEAR_____57_CM 0. 127.5 DISPLAY_IDENTIFIER C_TQ_MAX_ACC FORMAT "%3.1" /end CHARACTERISTIC
/begin CHARACTERISTIC c_state_cc_id_306 "sending-condition for CC-message (e.g. LV_IGK, LV_KEY_AUX, etc.)" VALUE 0xa080c0cf _REC_VAL_20_u1 15. _CNV_A_R_LINEAR_____0_CM 0. 15. DISPLAY_IDENTIFIER C_STATE_CC_ID_306 FORMAT "%2.0" /end CHARACTERISTIC
/begin CHARACTERISTIC c_state_cc_id_427 "sending-condition for CC-message (e.g. LV_IGK, LV_KEY_AUX, etc.)" VALUE 0xa080c0d7 _REC_VAL_20_u1 15. _CNV_A_R_LINEAR_____0_CM 0. 15. DISPLAY_IDENTIFIER C_STATE_CC_ID_427 FORMAT "%2.0" /end CHARACTERISTIC
/begin MEASUREMENT ctl_shift_lock_can "control shift-lock" UBYTE _CNV_A_R_LINEAR_____0_CM 1 100. 0. 3. DISPLAY_IDENTIFIER CTL_SHIFT_LOCK_CAN ECU_ADDRESS 0xd0008246 FORMAT "%1.0" /end MEASUREMENT
/begin MEASUREMENT lv_level_is "status switch level rpm" UBYTE _CNV_S_2_RANGE__0___1_CM 1 100. 0. 1. DISPLAY_IDENTIFIER LV_LEVEL_IS ECU_ADDRESS 0xd0008247 BIT_MASK 0x1 /end MEASUREMENT
/begin MEASUREMENT tq_amt_fast_dec_bn "fast torque decreased intervention due to AMT" SWORD _CNV_A_R_LINEAR_____31_CM 1 100. -1024. 1023.96875 DISPLAY_IDENTIFIER TQ_AMT_FAST_DEC_BN ECU_ADDRESS 0xd000a088 FORMAT "%8.2" /end MEASUREMENT
/begin MEASUREMENT tq_amt_slow_dec_bn "slow torque decreased intervention due to AMT" SWORD _CNV_A_R_LINEAR_____31_CM 1 100. -1024. 1023.96875 DISPLAY_IDENTIFIER TQ_AMT_SLOW_DEC_BN ECU_ADDRESS 0xd000a08a FORMAT "%8.2" /end MEASUREMENT
/begin MEASUREMENT tq_amt_fast_inc_bn "fast torque increased intervention due to AMT" SWORD _CNV_A_R_LINEAR_____31_CM 1 100. -1024. 1023.96875 DISPLAY_IDENTIFIER TQ_AMT_FAST_INC_BN ECU_ADDRESS 0xd000a084 FORMAT "%8.2" /end MEASUREMENT
/begin MEASUREMENT tq_amt_slow_inc_bn "slow torque increased intervention due to AMT" SWORD _CNV_A_R_LINEAR_____31_CM 1 100. -1024. 1023.96875 DISPLAY_IDENTIFIER TQ_AMT_SLOW_INC_BN ECU_ADDRESS 0xd000a086 FORMAT "%8.2" /end MEASUREMENT
/begin MEASUREMENT tq_dcc_fast_inc_bn "fast torque increased intervention due to DCC" SWORD _CNV_A_R_LINEAR_____31_CM 1 100. -1024. 1023.96875 DISPLAY_IDENTIFIER TQ_DCC_FAST_INC_BN ECU_ADDRESS 0xd000a08c FORMAT "%8.2" /end MEASUREMENT
/begin MEASUREMENT tq_dcc_slow_inc_bn "slow torque increased intervention due to DCC" SWORD _CNV_A_R_LINEAR_____31_CM 1 100. -1024. 1023.96875 DISPLAY_IDENTIFIER TQ_DCC_SLOW_INC_BN ECU_ADDRESS 0xd000a08e FORMAT "%8.2" /end MEASUREMENT
/begin MEASUREMENT tq_gs_fast_dec_bn "fast torque decreased intervention due to GS" SWORD _CNV_A_R_LINEAR_____31_CM 1 100. -1024. 1023.96875 DISPLAY_IDENTIFIER TQ_GS_FAST_DEC_BN ECU_ADDRESS 0xd000a080 FORMAT "%8.2" /end MEASUREMENT
/begin MEASUREMENT tq_gs_fast_inc_bn "fast torque increased intervention due to GS" SWORD _CNV_A_R_LINEAR_____31_CM 1 100. -1024. 1023.96875 DISPLAY_IDENTIFIER TQ_GS_FAST_INC_BN ECU_ADDRESS 0xd000a07c FORMAT "%8.2" /end MEASUREMENT
/begin MEASUREMENT tq_gs_slow_dec_bn "slow torque decreased intervention due to GS" SWORD _CNV_A_R_LINEAR_____31_CM 1 100. -1024. 1023.96875 DISPLAY_IDENTIFIER TQ_GS_SLOW_DEC_BN ECU_ADDRESS 0xd000a082 FORMAT "%8.2" /end MEASUREMENT
/begin MEASUREMENT tq_gs_slow_inc_bn "slow torque increased intervention due to GS" SWORD _CNV_A_R_LINEAR_____31_CM 1 100. -1024. 1023.96875 DISPLAY_IDENTIFIER TQ_GS_SLOW_INC_BN ECU_ADDRESS 0xd000a07e FORMAT "%8.2" /end MEASUREMENT
/begin MEASUREMENT tq_msr_fast_inc_bn "fast torque increased intervention due to TCS" SWORD _CNV_A_R_LINEAR_____31_CM 1 100. -1024. 1023.96875 DISPLAY_IDENTIFIER TQ_MSR_FAST_INC_BN ECU_ADDRESS 0xd000a094 FORMAT "%8.2" /end MEASUREMENT
/begin MEASUREMENT tq_msr_slow_inc_bn "slow torque increased intervention due to TCS" SWORD _CNV_A_R_LINEAR_____31_CM 1 100. -1024. 1023.96875 DISPLAY_IDENTIFIER TQ_MSR_SLOW_INC_BN ECU_ADDRESS 0xd000a096 FORMAT "%8.2" /end MEASUREMENT
/begin MEASUREMENT tq_asr_fast_dec_bn "fast torque decreased intervention due to TCS" SWORD _CNV_A_R_LINEAR_____31_CM 1 100. -1024. 1023.96875 DISPLAY_IDENTIFIER TQ_ASR_FAST_DEC_BN ECU_ADDRESS 0xd000a098 FORMAT "%8.2" /end MEASUREMENT
/begin MEASUREMENT tq_asr_slow_dec_bn "slow torque decreased intervention due to TCS" SWORD _CNV_A_R_LINEAR_____31_CM 1 100. -1024. 1023.96875 DISPLAY_IDENTIFIER TQ_ASR_SLOW_DEC_BN ECU_ADDRESS 0xd000a09a FORMAT "%8.2" /end MEASUREMENT
/begin MEASUREMENT t_tq_dcc_cs "Time of clutch switch intervention during DCC active" UBYTE _CNV_A_R_LINEAR_____3_CM 1 100. 0. 2.55 DISPLAY_IDENTIFIER T_TQ_DCC_CS ECU_ADDRESS 0xd0000488 FORMAT "%4.2" /end MEASUREMENT
/begin MEASUREMENT lv_err_sym_tq_dcc_cs "Logical bit for TQ_REQ_CAN error due to DCC torque intervention clutch switch" UBYTE _CNV_S_2_RANGE__0___1_CM 1 100. 0. 1. DISPLAY_IDENTIFIER LV_ERR_SYM_TQ_DCC_CS ECU_ADDRESS 0xd00082d0 BIT_MASK 0x1 /end MEASUREMENT
/begin CHARACTERISTIC c_thd_t_tq_dcc_cs "Threshold for maximum allowed torque intervention concerning clutch switch" VALUE 0xa080c31f _REC_VAL_20_u1 2.55 _CNV_A_R_LINEAR_____3_CM 0. 2.55 DISPLAY_IDENTIFIER C_THD_T_TQ_DCC_CS FORMAT "%4.2" /end CHARACTERISTIC
/begin CHARACTERISTIC c_crlc_tq_dcc_cs_dec "Correlation constant for decrement TQ_DCC_CS intervention " VALUE 0xa080bb12 _REC_VAL_20_u1 0.99610001 _CNV_A_R_LINEAR_____18_CM 0. 0.99610001 DISPLAY_IDENTIFIER C_CRLC_TQ_DCC_CS_DEC FORMAT "%5.3" /end CHARACTERISTIC
/begin CHARACTERISTIC c_crlc_tq_dcc_cs_inc "Correlation constant for increment TQ_DCC_CS intervention " VALUE 0xa080bb13 _REC_VAL_20_u1 0.99610001 _CNV_A_R_LINEAR_____18_CM 0. 0.99610001 DISPLAY_IDENTIFIER C_CRLC_TQ_DCC_CS_INC FORMAT "%5.3" /end CHARACTERISTIC
/begin CHARACTERISTIC lc_ena_tq_dcc_cs "Logical constant to set the TQ_DCC_CS intervention active" VALUE 0xa080c565 _REC_VAL_20_u1 1. _CNV_A_R_LINEAR_____0_CM 0. 1. DISPLAY_IDENTIFIER LC_ENA_TQ_DCC_CS FORMAT "%2.0" /end CHARACTERISTIC
/begin CHARACTERISTIC ip_tq_dcc_cs "Intended DCC torque during clutch switch on" CURVE 0xa080b724 _REC_CUR_20_u2_u2 2047.96875 _CNV_A_R_LINEAR_____87_CM -1024. 1023.96875 DISPLAY_IDENTIFIER IP_TQ_DCC_CS FORMAT "%6.2"
 /begin AXIS_DESCR COM_AXIS n _CNV_A_R_LINEAR_____14_CM 6 0. 8160. FORMAT "%4.0" AXIS_PTS_REF ldp_n_tq_dcc_cs /end AXIS_DESCR
/end CHARACTERISTIC
/begin AXIS_PTS ldp_n_tq_dcc_cs "" 0xa0808bb4 n _REC_AXS_20_u2 8160. _CNV_A_R_LINEAR_____14_CM 6 0. 8160. FORMAT "%4.0" /end AXIS_PTS
/begin MEASUREMENT tq_wheel_ldm_inc_dec_bn "torque increased intervention due to LDM" SWORD _CNV_A_R_LINEAR_____64_CM 1 100. -32768. 32767. DISPLAY_IDENTIFIER TQ_WHEEL_LDM_INC_DEC_BN ECU_ADDRESS 0xd000a09c FORMAT "%6.0" /end MEASUREMENT
/begin MEASUREMENT fast_ecu_tran_pwl_ctr "fast transition counter for transition from SYN_ENG_IGK_OFF to PWL despite engine running" UWORD _CNV_A_R_LINEAR_____3_CM 1 100. 0. 655.35 DISPLAY_IDENTIFIER FAST_ECU_TRAN_PWL_CTR ECU_ADDRESS 0xd0000b06 FORMAT "%6.2" /end MEASUREMENT
/begin CHARACTERISTIC c_t_di_eng_run "Time of disabled ENG_RUN after engine stall during drive off" VALUE 0xa080c15e _REC_VAL_20_u2 655.35 _CNV_A_R_LINEAR_____3_CM 0. 655.35 DISPLAY_IDENTIFIER C_T_DI_ENG_RUN FORMAT "%5.2" /end CHARACTERISTIC
/begin MEASUREMENT ecu_state "Information on ECU state" UBYTE _CNV_S_7_RANGE_ECU__159_CM 1 100. 0. 6. DISPLAY_IDENTIFIER ECU_STATE ECU_ADDRESS 0xd0008af8 /end MEASUREMENT
/begin CHARACTERISTIC c_fac_mff_fco "Transition factor MFF to FCO" VALUE 0xa080bce0 _REC_VAL_20_u2 0.9999847412109381 _CNV_A_R_LINEAR_____89_CM 0. 0.9999847412109381 DISPLAY_IDENTIFIER C_FAC_MFF_FCO FORMAT "%7.5" /end CHARACTERISTIC
/begin CHARACTERISTIC c_crlc_fco_av "Correlation constant for moving mean value calculation of FCO" VALUE 0xa080bae9 _REC_VAL_20_u1 0.99610001 _CNV_A_R_LINEAR_____18_CM 0. 0.99610001 DISPLAY_IDENTIFIER C_CRLC_FCO_AV FORMAT "%5.3" /end CHARACTERISTIC
/begin CHARACTERISTIC c_fco_dif_max "threshold to activate balance controller" VALUE 0xa080bd2e _REC_VAL_20_u2 65535. _CNV_A_R_LINEAR_____168_CM 0. 65535. DISPLAY_IDENTIFIER C_FCO_DIF_MAX FORMAT "%5.0" /end CHARACTERISTIC
/begin CHARACTERISTIC c_t_fac_fco_fil_rgn[0] "Filter constant for FCO filter during NOx regeneration " VALUE 0xa080c1c0 _REC_VAL_20_u1 25.5 _CNV_A_R_LINEAR_____4_CM 0. 25.5 DISPLAY_IDENTIFIER C_T_FAC_FCO_FIL_RGN[0] FORMAT "%4.1" /end CHARACTERISTIC
/begin CHARACTERISTIC c_t_fac_fco_fil_rgn[1] "Filter constant for FCO filter during NOx regeneration " VALUE 0xa080c1c1 _REC_VAL_20_u1 25.5 _CNV_A_R_LINEAR_____4_CM 0. 25.5 DISPLAY_IDENTIFIER C_T_FAC_FCO_FIL_RGN[1] FORMAT "%4.1" /end CHARACTERISTIC
/begin CHARACTERISTIC c_t_fac_fco_fil_so2p[0] "Filter constant for FCO filter during desulfurization" VALUE 0xa080c1c2 _REC_VAL_20_u1 25.5 _CNV_A_R_LINEAR_____4_CM 0. 25.5 DISPLAY_IDENTIFIER C_T_FAC_FCO_FIL_SO2P[0] FORMAT "%4.1" /end CHARACTERISTIC
/begin CHARACTERISTIC c_t_fac_fco_fil_so2p[1] "Filter constant for FCO filter during desulfurization" VALUE 0xa080c1c3 _REC_VAL_20_u1 25.5 _CNV_A_R_LINEAR_____4_CM 0. 25.5 DISPLAY_IDENTIFIER C_T_FAC_FCO_FIL_SO2P[1] FORMAT "%4.1" /end CHARACTERISTIC
/begin CHARACTERISTIC c_t_fac_ramp_fco_fil "Ramp constant to ramp FCO filter constant to 0" VALUE 0xa080c1c6 _REC_VAL_20_u1 25.5 _CNV_A_R_LINEAR_____4_CM 0. 25.5 DISPLAY_IDENTIFIER C_T_FAC_RAMP_FCO_FIL FORMAT "%4.1" /end CHARACTERISTIC
/begin CHARACTERISTIC c_fco_dif_gain "Gain for P-controller" VALUE 0xa080bd2c _REC_VAL_20_u1 1.9921875 _CNV_A_R_LINEAR_____103_CM 0. 1.9921875 DISPLAY_IDENTIFIER C_FCO_DIF_GAIN FORMAT "%8.6" /end CHARACTERISTIC
/begin MEASUREMENT fco "integrated fuel consumption" ULONG _CNV_A_R_LINEAR_____168_CM 1 100. 0. 4294967295. DISPLAY_IDENTIFIER FCO ECU_ADDRESS 0xd000ba38 FORMAT "%11.0" /end MEASUREMENT
/begin MEASUREMENT fco_av_mmv "Moving mean value of the integrated fuel consumption" UWORD _CNV_A_R_LINEAR_____168_CM 1 100. 0. 65535. DISPLAY_IDENTIFIER FCO_AV_MMV ECU_ADDRESS 0xd000a820 FORMAT "%5.0" /end MEASUREMENT
/begin MEASUREMENT fco_dmtl "integrated fuel consumption for DMTL" ULONG _CNV_A_R_LINEAR_____168_CM 1 100. 0. 4294967295. DISPLAY_IDENTIFIER FCO_DMTL ECU_ADDRESS 0xd000ba3c FORMAT "%11.0" /end MEASUREMENT
/begin MEASUREMENT fco_av "actual fuel consumption" UWORD _CNV_A_R_LINEAR_____168_CM 1 100. 0. 65535. DISPLAY_IDENTIFIER FCO_AV ECU_ADDRESS 0xd0000c8c FORMAT "%5.0" /end MEASUREMENT
/begin MEASUREMENT fco_av_fil[0] "actual fuel consumption filtered" ULONG _CNV_A_R_LINEAR_____169_CM 1 100. 0. 65535. DISPLAY_IDENTIFIER FCO_AV_FIL[0] ECU_ADDRESS 0xd0000c98 FORMAT "%11.5" /end MEASUREMENT
/begin MEASUREMENT fco_av_fil[1] "actual fuel consumption filtered" ULONG _CNV_A_R_LINEAR_____169_CM 1 100. 0. 65535. DISPLAY_IDENTIFIER FCO_AV_FIL[1] ECU_ADDRESS 0xd0000c9c FORMAT "%11.5" /end MEASUREMENT
/begin MEASUREMENT t_fac_fco_fil[0] "filter time for FCO filter" UBYTE _CNV_A_R_LINEAR_____4_CM 1 100. 0. 25.5 DISPLAY_IDENTIFIER T_FAC_FCO_FIL[0] ECU_ADDRESS 0xd0000ca0 FORMAT "%4.1" /end MEASUREMENT
/begin MEASUREMENT t_fac_fco_fil[1] "filter time for FCO filter" UBYTE _CNV_A_R_LINEAR_____4_CM 1 100. 0. 25.5 DISPLAY_IDENTIFIER T_FAC_FCO_FIL[1] ECU_ADDRESS 0xd0000ca1 FORMAT "%4.1" /end MEASUREMENT
/begin MEASUREMENT fac_fco_fil[0] "filter factor for FCO filter" UWORD _CNV_A_R_LINEAR_____89_CM 1 100. 0. 0.9999847412109381 DISPLAY_IDENTIFIER FAC_FCO_FIL[0] ECU_ADDRESS 0xd0000c8e FORMAT "%7.5" /end MEASUREMENT
/begin MEASUREMENT fac_fco_fil[1] "filter factor for FCO filter" UWORD _CNV_A_R_LINEAR_____89_CM 1 100. 0. 0.9999847412109381 DISPLAY_IDENTIFIER FAC_FCO_FIL[1] ECU_ADDRESS 0xd0000c90 FORMAT "%7.5" /end MEASUREMENT
/begin MEASUREMENT fco_fil_dif "difference of actual and filtered actual fuel consumption" SLONG _CNV_A_R_LINEAR_____168_CM 1 100. -2147483648. 2147483647. DISPLAY_IDENTIFIER FCO_FIL_DIF ECU_ADDRESS 0xd0000c94 FORMAT "%11.0" /end MEASUREMENT
/begin CHARACTERISTIC c_t_fac_fco_fil_isc[0] "Filter constant for FCO filter during active idle speed controller in stratified mode" VALUE 0xa080c1be _REC_VAL_20_u1 25.5 _CNV_A_R_LINEAR_____4_CM 0. 25.5 DISPLAY_IDENTIFIER C_T_FAC_FCO_FIL_ISC[0] FORMAT "%4.1" /end CHARACTERISTIC
/begin CHARACTERISTIC c_t_fac_fco_fil_isc[1] "Filter constant for FCO filter during active idle speed controller in stratified mode" VALUE 0xa080c1bf _REC_VAL_20_u1 25.5 _CNV_A_R_LINEAR_____4_CM 0. 25.5 DISPLAY_IDENTIFIER C_T_FAC_FCO_FIL_ISC[1] FORMAT "%4.1" /end CHARACTERISTIC
/begin CHARACTERISTIC c_t_fac_fco_fil_so2p_fast[0] "Filter constant for FCO filter during fast desulfurization" VALUE 0xa080c1c4 _REC_VAL_20_u1 25.5 _CNV_A_R_LINEAR_____4_CM 0. 25.5 DISPLAY_IDENTIFIER C_T_FAC_FCO_FIL_SO2P_FAST[0] FORMAT "%4.1" /end CHARACTERISTIC
/begin CHARACTERISTIC c_t_fac_fco_fil_so2p_fast[1] "Filter constant for FCO filter during fast desulfurization" VALUE 0xa080c1c5 _REC_VAL_20_u1 25.5 _CNV_A_R_LINEAR_____4_CM 0. 25.5 DISPLAY_IDENTIFIER C_T_FAC_FCO_FIL_SO2P_FAST[1] FORMAT "%4.1" /end CHARACTERISTIC
/begin MEASUREMENT tq_ecu_etcu "actual torque ecu/etcu" SWORD _CNV_A_R_LINEAR_____31_CM 1 100. -1024. 1023.96875 DISPLAY_IDENTIFIER TQ_ECU_ETCU ECU_ADDRESS 0xd00012c0 FORMAT "%8.2" /end MEASUREMENT
/begin MEASUREMENT crc_clc_com_1_tq_crk_1 "CRC calculated for communication on bus 1 (FlexRay)" UBYTE _CNV_A_R_LINEAR_____0_CM 1 100. 0. 255. DISPLAY_IDENTIFIER CRC_CLC_COM_1_TQ_CRK_1 ECU_ADDRESS 0xd0008554 FORMAT "%3.0" /end MEASUREMENT
/begin MEASUREMENT crc_clc_com_2_tq_crk_1 "CRC calculated for communication on bus 2 (FA-CAN)" UBYTE _CNV_A_R_LINEAR_____0_CM 1 100. 0. 255. DISPLAY_IDENTIFIER CRC_CLC_COM_2_TQ_CRK_1 ECU_ADDRESS 0xd0008555 FORMAT "%3.0" /end MEASUREMENT
/begin MEASUREMENT crc_clc_com_3_tq_crk_1 "CRC calculated for communication on bus 3 (A-CAN)" UBYTE _CNV_A_R_LINEAR_____0_CM 1 100. 0. 255. DISPLAY_IDENTIFIER CRC_CLC_COM_3_TQ_CRK_1 ECU_ADDRESS 0xd0008556 FORMAT "%3.0" /end MEASUREMENT
/begin MEASUREMENT crc_clc_com_2_tq_crk_2 "CRC calculated for communication on bus 2 (FA-CAN)" UBYTE _CNV_A_R_LINEAR_____0_CM 1 100. 0. 255. DISPLAY_IDENTIFIER CRC_CLC_COM_2_TQ_CRK_2 ECU_ADDRESS 0xd000855a FORMAT "%3.0" /end MEASUREMENT
/begin MEASUREMENT crc_clc_com_3_tq_crk_2 "CRC calculated for communication on bus 3 (A-CAN)" UBYTE _CNV_A_R_LINEAR_____0_CM 1 100. 0. 255. DISPLAY_IDENTIFIER CRC_CLC_COM_3_TQ_CRK_2 ECU_ADDRESS 0xd000855b FORMAT "%3.0" /end MEASUREMENT
/begin MEASUREMENT crc_clc_com_1_tq_crk_3 "CRC calculated for communication on bus 1 (FlexRay)" UBYTE _CNV_A_R_LINEAR_____0_CM 1 100. 0. 255. DISPLAY_IDENTIFIER CRC_CLC_COM_1_TQ_CRK_3 ECU_ADDRESS 0xd000855e FORMAT "%3.0" /end MEASUREMENT
/begin MEASUREMENT crc_clc_com_2_tq_crk_3 "CRC calculated for communication on bus 2 (FA-CAN)" UBYTE _CNV_A_R_LINEAR_____0_CM 1 100. 0. 255. DISPLAY_IDENTIFIER CRC_CLC_COM_2_TQ_CRK_3 ECU_ADDRESS 0xd000855f FORMAT "%3.0" /end MEASUREMENT
/begin MEASUREMENT crc_clc_com_3_tq_crk_3 "CRC calculated for communication on bus 3 (A-CAN)" UBYTE _CNV_A_R_LINEAR_____0_CM 1 100. 0. 255. DISPLAY_IDENTIFIER CRC_CLC_COM_3_TQ_CRK_3 ECU_ADDRESS 0xd0008560 FORMAT "%3.0" /end MEASUREMENT
/begin MEASUREMENT crc_clc_com_1_tq_wheel "CRC calculated for communication on bus 1 (FlexRay)" UBYTE _CNV_A_R_LINEAR_____0_CM 1 100. 0. 255. DISPLAY_IDENTIFIER CRC_CLC_COM_1_TQ_WHEEL ECU_ADDRESS 0xd0008565 FORMAT "%3.0" /end MEASUREMENT
/begin MEASUREMENT crc_clc_com_1_etcu_dt "CRC calculated for communication on bus 1 (FlexRay)" UBYTE _CNV_A_R_LINEAR_____0_CM 1 100. 0. 255. DISPLAY_IDENTIFIER CRC_CLC_COM_1_ETCU_DT ECU_ADDRESS 0xd0008568 FORMAT "%3.0" /end MEASUREMENT
/begin MEASUREMENT crc_clc_com_2_etcu_dt "CRC calculated for communication on bus 2 (FA-CAN)" UBYTE _CNV_A_R_LINEAR_____0_CM 1 100. 0. 255. DISPLAY_IDENTIFIER CRC_CLC_COM_2_ETCU_DT ECU_ADDRESS 0xd0008569 FORMAT "%3.0" /end MEASUREMENT
/begin MEASUREMENT crc_clc_com_1_info_dt_2 "CRC calculated for communication on bus 1 (FlexRay)" UBYTE _CNV_A_R_LINEAR_____0_CM 1 100. 0. 255. DISPLAY_IDENTIFIER CRC_CLC_COM_1_INFO_DT_2 ECU_ADDRESS 0xd000856a FORMAT "%3.0" /end MEASUREMENT
/begin MEASUREMENT crc_clc_com_2_info_dt_2 "CRC calculated for communication on FA_CAN" UBYTE _CNV_A_R_LINEAR_____0_CM 1 100. 0. 255. DISPLAY_IDENTIFIER CRC_CLC_COM_2_INFO_DT_2 ECU_ADDRESS 0xd000856b FORMAT "%3.0" /end MEASUREMENT
/begin MEASUREMENT crc_clc_com_3_info_dt_2 "CRC calculated for communication on A_CAN" UBYTE _CNV_A_R_LINEAR_____0_CM 1 100. 0. 255. DISPLAY_IDENTIFIER CRC_CLC_COM_3_INFO_DT_2 ECU_ADDRESS 0xd000856c FORMAT "%3.0" /end MEASUREMENT
/begin MEASUREMENT crc_clc_com_1_pv "CRC calculated for communication on bus 1 (felxray)" UBYTE _CNV_A_R_LINEAR_____0_CM 1 100. 0. 255. DISPLAY_IDENTIFIER CRC_CLC_COM_1_PV ECU_ADDRESS 0xd0008570 FORMAT "%3.0" /end MEASUREMENT
/begin MEASUREMENT fup_mes_mmv[0] "Measured mean value fuel pressure" UWORD _CNV_A_R_LINEAR_____171_CM 1 100. 0. 347776. DISPLAY_IDENTIFIER FUP_MES_MMV[0] ECU_ADDRESS 0xd000a3cc FORMAT "%6.0" /end MEASUREMENT
/begin MEASUREMENT fup_mes_mmv[1] "Measured mean value fuel pressure" UWORD _CNV_A_R_LINEAR_____171_CM 1 100. 0. 347776. DISPLAY_IDENTIFIER FUP_MES_MMV[1] ECU_ADDRESS 0xd000a3ce FORMAT "%6.0" /end MEASUREMENT
/begin MEASUREMENT fup_mes[0] "Measured fuel pressure" UWORD _CNV_A_R_LINEAR_____171_CM 1 100. 0. 347776. DISPLAY_IDENTIFIER FUP_MES[0] ECU_ADDRESS 0xd0000cb8 FORMAT "%6.0" /end MEASUREMENT
/begin MEASUREMENT fup_mes[1] "Measured fuel pressure" UWORD _CNV_A_R_LINEAR_____171_CM 1 100. 0. 347776. DISPLAY_IDENTIFIER FUP_MES[1] ECU_ADDRESS 0xd0000cba FORMAT "%6.0" /end MEASUREMENT
/begin CHARACTERISTIC ip_fup_mes "Fuel pressure sensor linearisation table" CURVE 0xa080acfc _REC_CUR_20_u2_u2 347776. _CNV_A_R_LINEAR_____171_CM 0. 347776. DISPLAY_IDENTIFIER IP_FUP_MES FORMAT "%6.0"
 /begin AXIS_DESCR COM_AXIS online_dummy _CNV_A_R_LINEAR_____172_CM 8 0. 4.999847 FORMAT "%7.5" AXIS_PTS_REF ldp_v_fup_mv_ip_fup_mes /end AXIS_DESCR
/end CHARACTERISTIC
/begin AXIS_PTS ldp_v_fup_mv_ip_fup_mes "" 0xa0809098 online_dummy _REC_AXS_20_u2 4.999847 _CNV_A_R_LINEAR_____172_CM 8 0. 4.999847 FORMAT "%7.5" /end AXIS_PTS
/begin MEASUREMENT v_fup_mv[0] "Mean value of the acquired sensor voltage" UWORD _CNV_A_R_LINEAR_____172_CM 1 100. 0. 4.999847 DISPLAY_IDENTIFIER V_FUP_MV[0] ECU_ADDRESS 0xd000a3d0 FORMAT "%7.5" /end MEASUREMENT
/begin MEASUREMENT v_fup_mv[1] "Mean value of the acquired sensor voltage" UWORD _CNV_A_R_LINEAR_____172_CM 1 100. 0. 4.999847 DISPLAY_IDENTIFIER V_FUP_MV[1] ECU_ADDRESS 0xd000a3d2 FORMAT "%7.5" /end MEASUREMENT
/begin MEASUREMENT lv_fup_seg "idicates if segment number is even or odd" UBYTE _CNV_S_2_RANGE__0___1_CM 1 100. 0. 1. DISPLAY_IDENTIFIER LV_FUP_SEG ECU_ADDRESS 0xd000888c BIT_MASK 0x1 /end MEASUREMENT
/begin MEASUREMENT fup_h[0] "Fuel pressure, high range" UWORD _CNV_A_R_LINEAR_____171_CM 1 100. 0. 347776. DISPLAY_IDENTIFIER FUP_H[0] ECU_ADDRESS 0xd000a3c8 FORMAT "%6.0" /end MEASUREMENT
/begin MEASUREMENT fup_h[1] "Fuel pressure, high range" UWORD _CNV_A_R_LINEAR_____171_CM 1 100. 0. 347776. DISPLAY_IDENTIFIER FUP_H[1] ECU_ADDRESS 0xd000a3ca FORMAT "%6.0" /end MEASUREMENT
/begin CHARACTERISTIC c_fup_mes_crlc "Correlation constatnt for the fuel pressure value" VALUE 0xa080bd7e _REC_VAL_20_u1 0.99609375 _CNV_A_R_LINEAR_____28_CM 0. 0.99609375 DISPLAY_IDENTIFIER C_FUP_MES_CRLC FORMAT "%5.3" /end CHARACTERISTIC
/begin CHARACTERISTIC c_fup_ofs_lih_l_prs_ctl_req "Offset for FUP at low pressure control limphome" VALUE 0xa080bd84 _REC_VAL_20_u2 173888. _CNV_A_R_LINEAR_____173_CM 0. 173888. DISPLAY_IDENTIFIER C_FUP_OFS_LIH_L_PRS_CTL_REQ FORMAT "%8.1" /end CHARACTERISTIC
/begin MEASUREMENT fup[0] "Fuel pressure" UWORD _CNV_A_R_LINEAR_____171_CM 1 100. 0. 347776. DISPLAY_IDENTIFIER FUP[0] ECU_ADDRESS 0xd000a3c4 FORMAT "%6.0" /end MEASUREMENT
/begin MEASUREMENT fup[1] "Fuel pressure" UWORD _CNV_A_R_LINEAR_____171_CM 1 100. 0. 347776. DISPLAY_IDENTIFIER FUP[1] ECU_ADDRESS 0xd000a3c6 FORMAT "%6.0" /end MEASUREMENT
/begin MEASUREMENT fup_mv "Fuel pressure mean value" UWORD _CNV_A_R_LINEAR_____171_CM 1 100. 0. 347776. DISPLAY_IDENTIFIER FUP_MV ECU_ADDRESS 0xd000a3d4 FORMAT "%6.0" /end MEASUREMENT
/begin MEASUREMENT fup_h_mv "Fuel pressure, high range, mean value" UWORD _CNV_A_R_LINEAR_____171_CM 1 100. 0. 347776. DISPLAY_IDENTIFIER FUP_H_MV ECU_ADDRESS 0xd000a3d6 FORMAT "%6.0" /end MEASUREMENT
/begin MEASUREMENT fup_efp "Fuel pressure efp" UWORD _CNV_A_R_LINEAR_____173_CM 1 100. 0. 173888. DISPLAY_IDENTIFIER FUP_EFP ECU_ADDRESS 0xd000a400 FORMAT "%8.1" /end MEASUREMENT
/begin MEASUREMENT fup_efp_mes "Measured fuel pressure value in the feedline" UWORD _CNV_A_R_LINEAR_____173_CM 1 100. 0. 173888. DISPLAY_IDENTIFIER FUP_EFP_MES ECU_ADDRESS 0xd000a402 FORMAT "%8.1" /end MEASUREMENT
/begin CHARACTERISTIC c_fup_efp_mes_crlc "Correlation constant for fuel pressure filter for the low pressure pump" VALUE 0xa080bd60 _REC_VAL_20_u1 0.99609375 _CNV_A_R_LINEAR_____28_CM 0. 0.99609375 DISPLAY_IDENTIFIER C_FUP_EFP_MES_CRLC FORMAT "%5.3" /end CHARACTERISTIC
/begin AXIS_PTS ldp_v_fup_efp_ip_fup_efp "" 0xa0809090 v_fup_efp_mv _REC_AXS_20_u2 4.9951171875 _CNV_A_R_LINEAR_____2_CM 3 0. 4.9951171875 FORMAT "%5.3" /end AXIS_PTS
/begin CHARACTERISTIC ip_fup_efp "Fuel pressure sensor linearisation table" CURVE 0xa080acb4 _REC_CUR_20_u2_u2 173888. _CNV_A_R_LINEAR_____173_CM 0. 173888. DISPLAY_IDENTIFIER IP_FUP_EFP FORMAT "%8.1"
 /begin AXIS_DESCR COM_AXIS v_fup_efp_mv _CNV_A_R_LINEAR_____2_CM 3 0. 4.9951171875 FORMAT "%5.3" AXIS_PTS_REF ldp_v_fup_efp_ip_fup_efp /end AXIS_DESCR
/end CHARACTERISTIC
/begin MEASUREMENT fup_efp_mmv "Mean fuel pressure value in the feedline" UWORD _CNV_A_R_LINEAR_____173_CM 1 100. 0. 173888. DISPLAY_IDENTIFIER FUP_EFP_MMV ECU_ADDRESS 0xd0000cf4 FORMAT "%8.1" /end MEASUREMENT
/begin CHARACTERISTIC c_fup_efp_lih "Limp home value for fuel pressure of low pressure circuit (opening pressure of safety valve)" VALUE 0xa080bd5c _REC_VAL_20_u2 173888. _CNV_A_R_LINEAR_____173_CM 0. 173888. DISPLAY_IDENTIFIER C_FUP_EFP_LIH FORMAT "%8.1" /end CHARACTERISTIC
/begin MEASUREMENT v_fup_efp_mv "Voltage of the low fuel pressure sensor ( for diagnosis)" UWORD _CNV_A_R_LINEAR_____2_CM 1 100. 0. 4.9951171875 DISPLAY_IDENTIFIER V_FUP_EFP_MV ECU_ADDRESS 0xd000a404 FORMAT "%5.3" /end MEASUREMENT
/begin MEASUREMENT lv_etcu_disable "Logical variable for disabling GS intervention due to EMS error" UBYTE _CNV_S_2_RANGE__0___1_CM 1 100. 0. 1. DISPLAY_IDENTIFIER LV_ETCU_DISABLE ECU_ADDRESS 0xd0008e7d BIT_MASK 0x1 /end MEASUREMENT
/begin MEASUREMENT lv_etcu_disable_can "logical variable for disabling GS intervention due to CAN error" UBYTE _CNV_S_2_RANGE__0___1_CM 1 100. 0. 1. DISPLAY_IDENTIFIER LV_ETCU_DISABLE_CAN ECU_ADDRESS 0xd0008e7e BIT_MASK 0x1 /end MEASUREMENT
/begin MEASUREMENT lv_gs_ena_dec "logical variable for decreased torque intervention due to gear shift" UBYTE _CNV_S_2_RANGE__0___1_CM 1 100. 0. 1. DISPLAY_IDENTIFIER LV_GS_ENA_DEC ECU_ADDRESS 0xd0008e7f BIT_MASK 0x1 /end MEASUREMENT
/begin MEASUREMENT lv_gs_ena "Logical variable for GS intervention enabling" UBYTE _CNV_S_2_RANGE__0___1_CM 1 100. 0. 1. DISPLAY_IDENTIFIER LV_GS_ENA ECU_ADDRESS 0xd0000d1e BIT_MASK 0x1 /end MEASUREMENT
/begin CHARACTERISTIC c_t_max_tqr_gs_intv "Maximum duration of torque reduction due gear shift intervention" VALUE 0xa080c20a _REC_VAL_20_u2 655.35 _CNV_A_R_LINEAR_____3_CM 0. 655.35 DISPLAY_IDENTIFIER C_T_MAX_TQR_GS_INTV FORMAT "%6.2" /end CHARACTERISTIC
/begin MEASUREMENT tqi_gs_fast_dec_req_1 "Torque decrement for fast torque intervention during gear shift" SWORD _CNV_A_R_LINEAR_____31_CM 1 100. -1024. 1023.96875 DISPLAY_IDENTIFIER TQI_GS_FAST_DEC_REQ_1 ECU_ADDRESS 0xd000aaca FORMAT "%8.2" /end MEASUREMENT
/begin MEASUREMENT tqi_gs_slow_dec_req "Torque decrement for slow torque intervention during gear shift" SWORD _CNV_A_R_LINEAR_____31_CM 1 100. -1024. 1023.96875 DISPLAY_IDENTIFIER TQI_GS_SLOW_DEC_REQ ECU_ADDRESS 0xd000aac4 FORMAT "%8.2" /end MEASUREMENT
/begin MEASUREMENT tqi_gs_fast_inc_req_1 "torque increase for fast torque intervention during gear shift" SWORD _CNV_A_R_LINEAR_____31_CM 1 100. -1024. 1023.96875 DISPLAY_IDENTIFIER TQI_GS_FAST_INC_REQ_1 ECU_ADDRESS 0xd000aace FORMAT "%8.2" /end MEASUREMENT
/begin MEASUREMENT tqi_gs_slow_inc_req "torque increase for slow torque intervention during gear shift" SWORD _CNV_A_R_LINEAR_____31_CM 1 100. -1024. 1023.96875 DISPLAY_IDENTIFIER TQI_GS_SLOW_INC_REQ ECU_ADDRESS 0xd000aac8 FORMAT "%8.2" /end MEASUREMENT
/begin MEASUREMENT t_tqr_gs_intv "duration of gear shift torque intervention" UWORD _CNV_A_R_LINEAR_____3_CM 1 100. 0. 655.35 DISPLAY_IDENTIFIER T_TQR_GS_INTV ECU_ADDRESS 0xd000aac0 FORMAT "%6.2" /end MEASUREMENT
/begin MEASUREMENT tqi_gs_fast_dec_req "Torque decrement for fast torque intervention during gear shift" SWORD _CNV_A_R_LINEAR_____31_CM 1 100. -1024. 1023.96875 DISPLAY_IDENTIFIER TQI_GS_FAST_DEC_REQ ECU_ADDRESS 0xd000aac2 FORMAT "%8.2" /end MEASUREMENT
/begin MEASUREMENT tqi_gs_fast_dec "torque decrement for fast torque intervention during gear shift" SWORD _CNV_A_R_LINEAR_____31_CM 1 100. -1024. 1023.96875 DISPLAY_IDENTIFIER TQI_GS_FAST_DEC ECU_ADDRESS 0xd000aad2 FORMAT "%8.2" /end MEASUREMENT
/begin MEASUREMENT tqi_gs_slow_dec_req_1 "Torque decrement for slow torque intervention during gear shift" SWORD _CNV_A_R_LINEAR_____31_CM 1 100. -1024. 1023.96875 DISPLAY_IDENTIFIER TQI_GS_SLOW_DEC_REQ_1 ECU_ADDRESS 0xd000aacc FORMAT "%8.2" /end MEASUREMENT
/begin MEASUREMENT tqi_gs_slow_dec "Torque decrement for slow torque intervention during gear shift" SWORD _CNV_A_R_LINEAR_____31_CM 1 100. -1024. 1023.96875 DISPLAY_IDENTIFIER TQI_GS_SLOW_DEC ECU_ADDRESS 0xd000aad4 FORMAT "%8.2" /end MEASUREMENT
/begin MEASUREMENT lv_gs_ena_inc "logical variable for increased torque intervention due to gear shift" UBYTE _CNV_S_2_RANGE__0___1_CM 1 100. 0. 1. DISPLAY_IDENTIFIER LV_GS_ENA_INC ECU_ADDRESS 0xd0008e80 BIT_MASK 0x1 /end MEASUREMENT
/begin MEASUREMENT lv_gs_dec_lih "logical variable for torque intervention LIH due to gear shift" UBYTE _CNV_S_2_RANGE__0___1_CM 1 100. 0. 1. DISPLAY_IDENTIFIER LV_GS_DEC_LIH ECU_ADDRESS 0xd0000d1f BIT_MASK 0x1 /end MEASUREMENT
/begin CHARACTERISTIC c_gs_ena_inc_dec "Enable switch GS intervention" VALUE 0xa080bda8 _REC_VAL_20_u1 3. _CNV_S_4_STATE_AMT__186_CM 0. 3. DISPLAY_IDENTIFIER C_GS_ENA_INC_DEC /end CHARACTERISTIC
/begin MEASUREMENT tqi_gs_fast_inc_req "torque increase for fast torque intervention during gear shift" SWORD _CNV_A_R_LINEAR_____31_CM 1 100. -1024. 1023.96875 DISPLAY_IDENTIFIER TQI_GS_FAST_INC_REQ ECU_ADDRESS 0xd000aac6 FORMAT "%8.2" /end MEASUREMENT
/begin MEASUREMENT tqi_gs_fast_inc "torque increase for fast torque intervention during gear shift" SWORD _CNV_A_R_LINEAR_____31_CM 1 100. -1024. 1023.96875 DISPLAY_IDENTIFIER TQI_GS_FAST_INC ECU_ADDRESS 0xd000aad6 FORMAT "%8.2" /end MEASUREMENT
/begin MEASUREMENT tqi_gs_slow_inc_req_1 "torque increase for slow torque intervention during gear shift" SWORD _CNV_A_R_LINEAR_____31_CM 1 100. -1024. 1023.96875 DISPLAY_IDENTIFIER TQI_GS_SLOW_INC_REQ_1 ECU_ADDRESS 0xd000aad0 FORMAT "%8.2" /end MEASUREMENT
/begin MEASUREMENT tqi_gs_slow_inc "torque increase for slow torque intervention during gear shift" SWORD _CNV_A_R_LINEAR_____31_CM 1 100. -1024. 1023.96875 DISPLAY_IDENTIFIER TQI_GS_SLOW_INC ECU_ADDRESS 0xd000aad8 FORMAT "%8.2" /end MEASUREMENT
/begin MEASUREMENT lv_gs_dec_act "logical variable for torque intervention due to gear shift" UBYTE _CNV_S_2_RANGE__0___1_CM 1 100. 0. 1. DISPLAY_IDENTIFIER LV_GS_DEC_ACT ECU_ADDRESS 0xd0008e81 BIT_MASK 0x1 /end MEASUREMENT
/begin MEASUREMENT lv_gs_inc_lih "logical variable for torque intervention LIH due to gear shift" UBYTE _CNV_S_2_RANGE__0___1_CM 1 100. 0. 1. DISPLAY_IDENTIFIER LV_GS_INC_LIH ECU_ADDRESS 0xd0008e83 BIT_MASK 0x1 /end MEASUREMENT
/begin CHARACTERISTIC c_lgrd_lih_gs_dec "limiting gradient for GS emergency ramp function (default  0.6 Nm/10ms)" VALUE 0xa080be0e _REC_VAL_20_u2 1023.96875 _CNV_A_R_LINEAR_____187_CM 0. 1023.96875 DISPLAY_IDENTIFIER C_LGRD_LIH_GS_DEC FORMAT "%7.2" /end CHARACTERISTIC
/begin CHARACTERISTIC c_lgrd_lih_gs_inc "limiting gradient for GS emergency ramp function (default  0.6 Nm/10ms)" VALUE 0xa080be10 _REC_VAL_20_u2 1023.96875 _CNV_A_R_LINEAR_____187_CM 0. 1023.96875 DISPLAY_IDENTIFIER C_LGRD_LIH_GS_INC FORMAT "%7.2" /end CHARACTERISTIC
/begin CHARACTERISTIC c_t_dly_lih_gs_dec "delay time for activation of GS emergency ramp function (default 0s)" VALUE 0xa080c17c _REC_VAL_20_u1 2.55 _CNV_A_R_LINEAR_____3_CM 0. 2.55 DISPLAY_IDENTIFIER C_T_DLY_LIH_GS_DEC FORMAT "%4.2" /end CHARACTERISTIC
/begin CHARACTERISTIC c_t_dly_lih_gs_inc "delay time for activation of GS emergency ramp function (default 0s)" VALUE 0xa080c17d _REC_VAL_20_u1 2.55 _CNV_A_R_LINEAR_____3_CM 0. 2.55 DISPLAY_IDENTIFIER C_T_DLY_LIH_GS_INC FORMAT "%4.2" /end CHARACTERISTIC
/begin MEASUREMENT lv_gs_inc_act "logical variable for torque intervention due to gear shift" UBYTE _CNV_S_2_RANGE__0___1_CM 1 100. 0. 1. DISPLAY_IDENTIFIER LV_GS_INC_ACT ECU_ADDRESS 0xd0008e82 BIT_MASK 0x1 /end MEASUREMENT
/begin MEASUREMENT t_gs_inc_lih_ctr "delay time for activation of GS emergency ramp function " UBYTE _CNV_A_R_LINEAR_____3_CM 1 100. 0. 2.55 DISPLAY_IDENTIFIER T_GS_INC_LIH_CTR ECU_ADDRESS 0xd0000d1d FORMAT "%4.2" /end MEASUREMENT
/begin MEASUREMENT t_gs_dec_lih_ctr "delay time for activation of GS emergency ramp function" UBYTE _CNV_A_R_LINEAR_____3_CM 1 100. 0. 2.55 DISPLAY_IDENTIFIER T_GS_DEC_LIH_CTR ECU_ADDRESS 0xd0000d1c FORMAT "%4.2" /end MEASUREMENT
/begin MEASUREMENT state_tq_etcu_plaus "Bitwise coded State for ETCU intervention state" UBYTE _CNV_A_R_LINEAR_____0_CM 1 100. 0. 255. DISPLAY_IDENTIFIER STATE_TQ_ETCU_PLAUS ECU_ADDRESS 0xd0008e7c FORMAT "%3.0" /end MEASUREMENT
/begin AXIS_PTS ldp_v_put__put_mes_bas "Conversion characteristic for PUT_MES_BAS" 0xa08090ce online_dummy _REC_AXS_20_u2 4.5 _CNV_A_R_LINEAR_____2_CM 2 0. 5. FORMAT "%5.3" /end AXIS_PTS
/begin CHARACTERISTIC ip_put_mes_bas "Conversion characteristic for PUT_MES_BAS" CURVE 0xa080b398 _REC_CUR_20_u2_u2 5434. _CNV_A_R_LINEAR_____27_CM 0. 5434. DISPLAY_IDENTIFIER IP_PUT_MES_BAS FORMAT "%7.2"
 /begin AXIS_DESCR COM_AXIS online_dummy _CNV_A_R_LINEAR_____2_CM 2 0. 5. FORMAT "%5.3" AXIS_PTS_REF ldp_v_put__put_mes_bas /end AXIS_DESCR
/end CHARACTERISTIC
/begin CHARACTERISTIC lc_map_absv_rel_swi "Switch for calculation map_mes_bas with measured absolut or relative pressure" VALUE 0xa080c5a9 _REC_VAL_20_u1 1. _CNV_A_R_LINEAR_____0_CM 0. 1. DISPLAY_IDENTIFIER LC_MAP_ABSV_REL_SWI FORMAT "%1.0" /end CHARACTERISTIC
/begin CHARACTERISTIC lc_put_absv_rel_swi "Switch for calculation put_mes_bas with measured absolut or relative pressure" VALUE 0xa080c5d7 _REC_VAL_20_u1 1. _CNV_A_R_LINEAR_____0_CM 0. 1. DISPLAY_IDENTIFIER LC_PUT_ABSV_REL_SWI FORMAT "%1.0" /end CHARACTERISTIC
/begin MEASUREMENT map_dip_mes_bas[0] "Intake manifold air pressure per segment measured" UWORD _CNV_A_R_LINEAR_____27_CM 1 100. 0. 5434. DISPLAY_IDENTIFIER MAP_DIP_MES_BAS[1] ECU_ADDRESS 0xd000a468 FORMAT "%7.2" /end MEASUREMENT
/begin MEASUREMENT map_dip_mes_bas[1] "Intake manifold air pressure per segment measured" UWORD _CNV_A_R_LINEAR_____27_CM 1 100. 0. 5434. DISPLAY_IDENTIFIER MAP_DIP_MES_BAS[2] ECU_ADDRESS 0xd000a46a FORMAT "%7.2" /end MEASUREMENT
/begin MEASUREMENT put_mes_bas[0] "Intake manifold pressure up throttle per segment measured" UWORD _CNV_A_R_LINEAR_____27_CM 1 100. 0. 5434. DISPLAY_IDENTIFIER PUT_MES_BAS[1] ECU_ADDRESS 0xd000a474 FORMAT "%7.2" /end MEASUREMENT
/begin MEASUREMENT put_mes_bas[1] "Intake manifold pressure up throttle per segment measured" UWORD _CNV_A_R_LINEAR_____27_CM 1 100. 0. 5434. DISPLAY_IDENTIFIER PUT_MES_BAS[2] ECU_ADDRESS 0xd000a476 FORMAT "%7.2" /end MEASUREMENT
/begin MEASUREMENT map_dip_mes_bas_2seg[0] "Intake manifold air pressure per second segment measured" UWORD _CNV_A_R_LINEAR_____27_CM 1 100. 0. 5434. DISPLAY_IDENTIFIER MAP_DIP_MES_BAS_2SEG[1] ECU_ADDRESS 0xd000a46c FORMAT "%7.2" /end MEASUREMENT
/begin MEASUREMENT map_dip_mes_bas_2seg[1] "Intake manifold air pressure per second segment measured" UWORD _CNV_A_R_LINEAR_____27_CM 1 100. 0. 5434. DISPLAY_IDENTIFIER MAP_DIP_MES_BAS_2SEG[2] ECU_ADDRESS 0xd000a46e FORMAT "%7.2" /end MEASUREMENT
/begin MEASUREMENT put_mes_bas_2seg[0] "Intake manifold pressure up throttle per second segment measured" UWORD _CNV_A_R_LINEAR_____27_CM 1 100. 0. 5434. DISPLAY_IDENTIFIER PUT_MES_BAS_2SEG[1] ECU_ADDRESS 0xd000a478 FORMAT "%7.2" /end MEASUREMENT
/begin MEASUREMENT put_mes_bas_2seg[1] "Intake manifold pressure up throttle per second segment measured" UWORD _CNV_A_R_LINEAR_____27_CM 1 100. 0. 5434. DISPLAY_IDENTIFIER PUT_MES_BAS_2SEG[2] ECU_ADDRESS 0xd000a47a FORMAT "%7.2" /end MEASUREMENT
/begin MEASUREMENT v_put[0] "Voltage of the intake manifold pressure sensor up throttle (for diagnosis)" UWORD _CNV_A_R_LINEAR_____2_CM 1 100. 0. 5. DISPLAY_IDENTIFIER V_PUT[1] ECU_ADDRESS 0xd000a47c FORMAT "%5.3" /end MEASUREMENT
/begin MEASUREMENT v_put[1] "Voltage of the intake manifold pressure sensor up throttle (for diagnosis)" UWORD _CNV_A_R_LINEAR_____2_CM 1 100. 0. 5. DISPLAY_IDENTIFIER V_PUT[2] ECU_ADDRESS 0xd000a47e FORMAT "%5.3" /end MEASUREMENT
/begin CHARACTERISTIC ip_map_mes_bas "Conversion characteristic for MAP_MES_BAS" CURVE 0xa080aec8 _REC_CUR_20_u2_u2 5434. _CNV_A_R_LINEAR_____27_CM 0. 5434. DISPLAY_IDENTIFIER IP_MAP_MES_BAS__V_MAP FORMAT "%7.2"
 /begin AXIS_DESCR COM_AXIS online_dummy _CNV_A_R_LINEAR_____2_CM 2 0. 5. FORMAT "%5.3" AXIS_PTS_REF ldp_v_map__map_mes_bas /end AXIS_DESCR
/end CHARACTERISTIC
/begin AXIS_PTS ldp_v_map__map_mes_bas "" 0xa08090aa online_dummy _REC_AXS_20_u2 4.5 _CNV_A_R_LINEAR_____2_CM 2 0. 5. FORMAT "%5.3" /end AXIS_PTS
/begin CHARACTERISTIC lc_ptcha_absv_rel_swi "Switch for Calculation PTCHA_1/2 with measured absolute (1) or relative pressure (0)" VALUE 0xa080c5d6 _REC_VAL_20_u1 1. _CNV_A_R_LINEAR_____0_CM 0. 1. DISPLAY_IDENTIFIER LC_PTCHA_ABSV_REL_SWI FORMAT "%1.0" /end CHARACTERISTIC
/begin MEASUREMENT temp_map_dip_mdl[0] "estimated temperature of manifold pressure sensor" UBYTE _CNV_A_R_LINEAR_____17_CM 1 100. -48. 142.5 DISPLAY_IDENTIFIER TEMP_MAP_DIP_MDL[1] ECU_ADDRESS 0xd000143c FORMAT "%6.2" /end MEASUREMENT
/begin MEASUREMENT temp_map_dip_mdl[1] "estimated temperature of manifold pressure sensor" UBYTE _CNV_A_R_LINEAR_____17_CM 1 100. -48. 142.5 DISPLAY_IDENTIFIER TEMP_MAP_DIP_MDL[2] ECU_ADDRESS 0xd000143d FORMAT "%6.2" /end MEASUREMENT
/begin MEASUREMENT v_map_ad[0] "Adapted voltage offset of manifold pressure sensor" SWORD _CNV_A_R_LINEAR_____2_CM 1 100. -2.5 2.5 DISPLAY_IDENTIFIER V_MAP_AD[1] ECU_ADDRESS 0xd000a49a /end MEASUREMENT
/begin MEASUREMENT v_map_ad[1] "Adapted voltage offset of manifold pressure sensor" SWORD _CNV_A_R_LINEAR_____2_CM 1 100. -2.5 2.5 DISPLAY_IDENTIFIER V_MAP_AD[2] ECU_ADDRESS 0xd000a49c /end MEASUREMENT
/begin MEASUREMENT v_map_dif[0] "Deviation to nominal output at differential pressure 0" SWORD _CNV_A_R_LINEAR_____2_CM 1 100. -2.5 2.5 DISPLAY_IDENTIFIER V_MAP_DIF[1] ECU_ADDRESS 0xd000a492 /end MEASUREMENT
/begin MEASUREMENT v_map_dif[1] "Deviation to nominal output at differential pressure 0" SWORD _CNV_A_R_LINEAR_____2_CM 1 100. -2.5 2.5 DISPLAY_IDENTIFIER V_MAP_DIF[2] ECU_ADDRESS 0xd000a494 /end MEASUREMENT
/begin MEASUREMENT v_map_dif_vld[0] "Allowed sensor output deviation at differential pressure 0" SWORD _CNV_A_R_LINEAR_____2_CM 1 100. -2.5 2.5 DISPLAY_IDENTIFIER V_MAP_DIF_VLD[1] ECU_ADDRESS 0xd000a496 /end MEASUREMENT
/begin MEASUREMENT v_map_dif_vld[1] "Allowed sensor output deviation at differential pressure 0" SWORD _CNV_A_R_LINEAR_____2_CM 1 100. -2.5 2.5 DISPLAY_IDENTIFIER V_MAP_DIF_VLD[2] ECU_ADDRESS 0xd000a498 /end MEASUREMENT
/begin MEASUREMENT lv_t_dly_map_mes_ad[0] "logical value delay time for manifold evacuation is over" UBYTE _CNV_S_2_RANGE__0___1_CM 1 100. 0. 1. DISPLAY_IDENTIFIER LV_T_DLY_MAP_MES_AD[1] ECU_ADDRESS 0xd0001442 /end MEASUREMENT
/begin MEASUREMENT lv_t_dly_map_mes_ad[1] "logical value delay time for manifold evacuation is over" UBYTE _CNV_S_2_RANGE__0___1_CM 1 100. 0. 1. DISPLAY_IDENTIFIER LV_T_DLY_MAP_MES_AD[2] ECU_ADDRESS 0xd0001443 /end MEASUREMENT
/begin CHARACTERISTIC c_t_dly_map_mes_ad "Delay time after LV_ES detection before starting adaptation of sensor characteristic" VALUE 0xa080c182 _REC_VAL_20_u2 10.23 _CNV_A_R_LINEAR_____3_CM 0. 10.23 DISPLAY_IDENTIFIER C_T_DLY_MAP_MES_AD FORMAT "%5.2" /end CHARACTERISTIC
/begin CHARACTERISTIC c_tps_v_map_ad_min "minimum tps to enable v_map adaptation" VALUE 0xa080c352 _REC_VAL_20_u2 119.5 _CNV_A_R_LINEAR_____227_CM 0. 119.5 DISPLAY_IDENTIFIER C_TPS_V_MAP_AD_MIN FORMAT "%7.3" /end CHARACTERISTIC
/begin CHARACTERISTIC c_fac_temp_map_dip_tco_ex "factor for tco_ex correction for map_dip temperature model" VALUE 0xa080bcf1 _REC_VAL_20_u1 0.99609375 _CNV_A_R_LINEAR_____28_CM 0. 0.99609375 DISPLAY_IDENTIFIER C_FAC_TEMP_MAP_DIP_TCO_EX FORMAT "%5.3" /end CHARACTERISTIC
/begin CHARACTERISTIC c_fac_temp_map_dip_tia "factor for tia correction for map_dip temperature model" VALUE 0xa080bcf2 _REC_VAL_20_u1 0.99609375 _CNV_A_R_LINEAR_____28_CM 0. 0.99609375 DISPLAY_IDENTIFIER C_FAC_TEMP_MAP_DIP_TIA FORMAT "%5.3" /end CHARACTERISTIC
/begin CHARACTERISTIC c_fac_temp_map_dip_tam "factor for tam correction for map_dip temperature model" VALUE 0xa080bcf0 _REC_VAL_20_u1 0.99609375 _CNV_A_R_LINEAR_____28_CM 0. 0.99609375 DISPLAY_IDENTIFIER C_FAC_TEMP_MAP_DIP_TAM FORMAT "%5.3" /end CHARACTERISTIC
/begin CHARACTERISTIC c_fac_v_map_ad "factor for tam correction for map_dip temperature model" VALUE 0xa080bd27 _REC_VAL_20_u1 0.99609375 _CNV_A_R_LINEAR_____28_CM 0. 0.99609375 DISPLAY_IDENTIFIER C_FAC_V_MAP_AD FORMAT "%5.3" /end CHARACTERISTIC
/begin CHARACTERISTIC c_fac_temp_v_map_ad "factor for tam correction for map_dip temperature model" VALUE 0xa080bcf3 _REC_VAL_20_u1 0.99609375 _CNV_A_R_LINEAR_____28_CM 0. 0.99609375 DISPLAY_IDENTIFIER C_FAC_TEMP_V_MAP_AD FORMAT "%5.3" /end CHARACTERISTIC
/begin CHARACTERISTIC c_nr_v_map_acq "number of acquisitions to build the mean value v_map_mv" VALUE 0xa080c035 _REC_VAL_20_u1 255. _CNV_A_R_LINEAR_____0_CM 0. 255. DISPLAY_IDENTIFIER C_NR_V_MAP_ACQ FORMAT "%3.0" /end CHARACTERISTIC
/begin CHARACTERISTIC c_v_map_sp_ad "number of acquisitions to build the mean value v_map_mv" VALUE 0xa080c3d6 _REC_VAL_20_u2 2.5 _CNV_A_R_LINEAR_____2_CM 0. 2.5 DISPLAY_IDENTIFIER C_V_MAP_SP_AD FORMAT "%5.3" /end CHARACTERISTIC
/begin CHARACTERISTIC c_v_map_ad_max "setpoint of map sensor output at stopped engine" VALUE 0xa080c3d0 _REC_VAL_20_u2 2.5 _CNV_A_R_LINEAR_____2_CM 0. 2.5 DISPLAY_IDENTIFIER C_V_MAP_AD_MAX FORMAT "%5.3" /end CHARACTERISTIC
/begin CHARACTERISTIC c_temp_map_dip_mdl_fac_min "lower temp_map_dip_mdl temperature threshold to switch adaptation/diagnosis values" VALUE 0xa080c315 _REC_VAL_20_u1 190.5 _CNV_A_R_LINEAR_____17_CM -48. 142.5 DISPLAY_IDENTIFIER C_TEMP_MAP_DIP_MDL_FAC_MIN FORMAT "%6.2" /end CHARACTERISTIC
/begin CHARACTERISTIC c_temp_map_dip_mdl_fac_max "upper temp_map_dip_mdl temperature threshold to switch adaptation/diagnosis values" VALUE 0xa080c314 _REC_VAL_20_u1 190.5 _CNV_A_R_LINEAR_____17_CM -48. 142.5 DISPLAY_IDENTIFIER C_TEMP_MAP_DIP_MDL_FAC_MAX FORMAT "%6.2" /end CHARACTERISTIC
/begin CHARACTERISTIC c_v_map_sp_dif_max "allowed sensor output deviation at stopped engine at regular temperature condition" VALUE 0xa080c3d8 _REC_VAL_20_s2 5. _CNV_A_R_LINEAR_____2_CM -2.5 2.5 DISPLAY_IDENTIFIER C_V_MAP_SP_DIF_MAX /end CHARACTERISTIC
/begin CHARACTERISTIC c_fac_temp_v_map_sp_dif_max "factor on allowed sensor output deviation at stopped engine at irregular temperature condition" VALUE 0xa080bcf4 _REC_VAL_20_u1 1.9921875 _CNV_A_R_LINEAR_____103_CM 0. 1.9921875 DISPLAY_IDENTIFIER C_FAC_TEMP_V_MAP_SP_DIF_MAX FORMAT "%8.6" /end CHARACTERISTIC
/begin MEASUREMENT prs_cha_up[0] "Pressure up charger" UWORD _CNV_A_R_LINEAR_____27_CM 1 100. 0. 5434. DISPLAY_IDENTIFIER PRS_CHA_UP[1] ECU_ADDRESS 0xd000a480 FORMAT "%7.2" /end MEASUREMENT
/begin MEASUREMENT prs_cha_up[1] "Pressure up charger" UWORD _CNV_A_R_LINEAR_____27_CM 1 100. 0. 5434. DISPLAY_IDENTIFIER PRS_CHA_UP[2] ECU_ADDRESS 0xd000a482 FORMAT "%7.2" /end MEASUREMENT
/begin MEASUREMENT v_map[0] "Voltage of the intake manifold pressure sensor (for diagnosis)" UWORD _CNV_A_R_LINEAR_____2_CM 1 100. 0. 5. DISPLAY_IDENTIFIER V_MAP[1] ECU_ADDRESS 0xd000a470 FORMAT "%5.3" /end MEASUREMENT
/begin MEASUREMENT v_map[1] "Voltage of the intake manifold pressure sensor (for diagnosis)" UWORD _CNV_A_R_LINEAR_____2_CM 1 100. 0. 5. DISPLAY_IDENTIFIER V_MAP[2] ECU_ADDRESS 0xd000a472 FORMAT "%5.3" /end MEASUREMENT
/begin MEASUREMENT v_prs_cha_up[0] "Voltage of the intake manifold pressure sensor up charger (for diagnosis)" UWORD _CNV_A_R_LINEAR_____2_CM 1 100. 0. 5. DISPLAY_IDENTIFIER V_PRS_CHA_UP[1] ECU_ADDRESS 0xd000a484 FORMAT "%5.3" /end MEASUREMENT
/begin MEASUREMENT v_prs_cha_up[1] "Voltage of the intake manifold pressure sensor up charger (for diagnosis)" UWORD _CNV_A_R_LINEAR_____2_CM 1 100. 0. 5. DISPLAY_IDENTIFIER V_PRS_CHA_UP[2] ECU_ADDRESS 0xd000a486 FORMAT "%5.3" /end MEASUREMENT
/begin CHARACTERISTIC ip_prs_cha_up "Conversion characteristic for PRS_CHA_UP" CURVE 0xa080b374 _REC_CUR_20_u2_u2 5434. _CNV_A_R_LINEAR_____27_CM 0. 5434. DISPLAY_IDENTIFIER IP_PRS_CHA_UP FORMAT "%7.2"
 /begin AXIS_DESCR COM_AXIS online_dummy _CNV_A_R_LINEAR_____2_CM 2 0. 5. FORMAT "%5.3" AXIS_PTS_REF ldp_v_prs_cha_up /end AXIS_DESCR
/end CHARACTERISTIC
/begin AXIS_PTS ldp_v_prs_cha_up "" 0xa08090c8 online_dummy _REC_AXS_20_u2 4.5 _CNV_A_R_LINEAR_____2_CM 2 0. 5. FORMAT "%5.3" /end AXIS_PTS
/begin CHARACTERISTIC ip_prs_cha_down "Conversion characteristic for PRS_CHA_DOWN" CURVE 0xa080b370 _REC_CUR_20_u2_u2 5434. _CNV_A_R_LINEAR_____27_CM 0. 5434. DISPLAY_IDENTIFIER IP_PRS_CHA_DOWN FORMAT "%7.2"
 /begin AXIS_DESCR COM_AXIS online_dummy _CNV_A_R_LINEAR_____2_CM 2 0. 5. FORMAT "%5.3" AXIS_PTS_REF ldp_v_prs_cha_down /end AXIS_DESCR
/end CHARACTERISTIC
/begin AXIS_PTS ldp_v_prs_cha_down "" 0xa08090c2 online_dummy _REC_AXS_20_u2 4.5 _CNV_A_R_LINEAR_____2_CM 2 0. 5. FORMAT "%5.3" /end AXIS_PTS
/begin MEASUREMENT iga_igc_h_rng_mux "Multiplexed ignition angle applied on the respective cylinder" SWORD _CNV_A_R_LINEAR_____188_CM 1 100. -90. 90. DISPLAY_IDENTIFIER IGA_IGC_H_RNG_MUX ECU_ADDRESS 0xd000a79c FORMAT "%8.4" /end MEASUREMENT
/begin MEASUREMENT iga_knk_mux "Multiplexed spark retard due to knocking combustion of the respective cylinder" UBYTE _CNV_A_R_LINEAR_____198_CM 1 100. -48. 0. DISPLAY_IDENTIFIER IGA_KNK_MUX ECU_ADDRESS 0xd0001464 FORMAT "%5.1" /end MEASUREMENT
/begin MEASUREMENT knk_thd_mux "Multiplexed knock threshold of the respective cylinder" UBYTE _CNV_A_R_LINEAR_____199_CM 1 100. 0. 4.998 DISPLAY_IDENTIFIER KNK_THD_MUX ECU_ADDRESS 0xd0001465 FORMAT "%6.4" /end MEASUREMENT
/begin MEASUREMENT knks_mux "Multiplexed knock control signal of the respective cylinder" UWORD _CNV_A_R_LINEAR_____201_CM 1 100. 0. 4.99992371 DISPLAY_IDENTIFIER KNKS_MUX ECU_ADDRESS 0xd0001456 FORMAT "%7.5" /end MEASUREMENT
/begin MEASUREMENT nl_mux "Multiplexed noise level of the respective cylinder" UWORD _CNV_A_R_LINEAR_____201_CM 1 100. 0. 4.99992371 DISPLAY_IDENTIFIER NL_MUX ECU_ADDRESS 0xd0001458 FORMAT "%7.5" /end MEASUREMENT
/begin MEASUREMENT ti_1_hom_mux "Multiplexed cylinder individual injection time, homogeneous mode, first pulse" UWORD _CNV_A_R_LINEAR_____228_CM 1 100. 0. 65.535 DISPLAY_IDENTIFIER TI_1_HOM_MUX ECU_ADDRESS 0xd000145a /end MEASUREMENT
/begin MEASUREMENT ti_2_hom_mux "Multiplexed cylinder individual injection time, homogeneous mode, second pulse" UWORD _CNV_A_R_LINEAR_____228_CM 1 100. 0. 65.535 DISPLAY_IDENTIFIER TI_2_HOM_MUX ECU_ADDRESS 0xd000145c /end MEASUREMENT
/begin MEASUREMENT ti_1_s_mux "Multiplexed cylinder individual injection time, stratified mode, fist pulse" UWORD _CNV_A_R_LINEAR_____228_CM 1 100. 0. 65.535 DISPLAY_IDENTIFIER TI_1_S_MUX ECU_ADDRESS 0xd000145e /end MEASUREMENT
/begin MEASUREMENT ti_2_s_mux "Multiplexed cylinder individual injection time, stratified mode, second pulse" UWORD _CNV_A_R_LINEAR_____228_CM 1 100. 0. 65.535 DISPLAY_IDENTIFIER TI_2_S_MUX ECU_ADDRESS 0xd0001460 /end MEASUREMENT
/begin MEASUREMENT knks_rel_nl_mux "Multiplexed relative knock value" UWORD _CNV_A_R_LINEAR_____229_CM 1 100. 0. 1. DISPLAY_IDENTIFIER KNKS_REL_NL_MUX ECU_ADDRESS 0xd0001454 FORMAT "%6.4" /end MEASUREMENT
/begin CHARACTERISTIC c_iga_ini_h_rng "Init value for ignition angle in wide range" VALUE 0xa080bdb2 _REC_VAL_20_s2 180. _CNV_A_R_LINEAR_____188_CM -90. 90. DISPLAY_IDENTIFIER C_IGA_INI_H_RNG FORMAT "%8.4" /end CHARACTERISTIC
/begin CHARACTERISTIC c_t_es_tco_plaus_max "Threshold for maximum T_ES time" VALUE 0xa080c1ba _REC_VAL_20_u2 65535. _CNV_A_R_LINEAR_____84_CM 0. 65535. DISPLAY_IDENTIFIER C_T_ES_TCO_PLAUS_MAX FORMAT "%5.0" /end CHARACTERISTIC
/begin CHARACTERISTIC c_t_es_tco_plaus_min "Threshold for minimum T_ES time" VALUE 0xa080c1bc _REC_VAL_20_u2 65535. _CNV_A_R_LINEAR_____84_CM 0. 65535. DISPLAY_IDENTIFIER C_T_ES_TCO_PLAUS_MIN FORMAT "%5.0" /end CHARACTERISTIC
/begin CHARACTERISTIC c_tco_stop_t_es_plaus_min "Threshold for minimum differences of cooling temperature " VALUE 0xa080c2e8 _REC_VAL_20_u1 190.5 _CNV_A_R_LINEAR_____25_CM 0. 190.5 DISPLAY_IDENTIFIER C_TCO_STOP_T_ES_PLAUS_MIN FORMAT "%5.1" /end CHARACTERISTIC
/begin CHARACTERISTIC c_t_es_sub "substitute value of T_ES" VALUE 0xa080c1b8 _REC_VAL_20_u2 65535. _CNV_A_R_LINEAR_____84_CM 0. 65535. DISPLAY_IDENTIFIER C_T_ES_SUB FORMAT "%5.0" /end CHARACTERISTIC
/begin CHARACTERISTIC c_t_ast_t_es "2nd plausibilisation of T_ES after start" VALUE 0xa080c13c _REC_VAL_20_u2 6553.5 _CNV_A_R_LINEAR_____4_CM 0. 6553.5 DISPLAY_IDENTIFIER C_T_AST_T_ES FORMAT "%5.1" /end CHARACTERISTIC
/begin CHARACTERISTIC c_tco_stop_t_es_plaus_max "Threshold for maximum differences of cooling temperature" VALUE 0xa080c2e7 _REC_VAL_20_u1 190.5 _CNV_A_R_LINEAR_____25_CM 0. 190.5 DISPLAY_IDENTIFIER C_TCO_STOP_T_ES_PLAUS_MAX FORMAT "%5.1" /end CHARACTERISTIC
/begin CHARACTERISTIC c_tco_stop_t_es_min "Threshold for minimum cooling temperature at engine stop" VALUE 0xa080c2e6 _REC_VAL_20_u1 190.5 _CNV_A_R_LINEAR_____17_CM -48. 142.5 DISPLAY_IDENTIFIER C_TCO_STOP_T_ES_MIN FORMAT "%5.1" /end CHARACTERISTIC
/begin MEASUREMENT t_es "Engine off duration" UWORD _CNV_A_R_LINEAR_____84_CM 1 100. 0. 65535. DISPLAY_IDENTIFIER T_ES ECU_ADDRESS 0xd000a7a0 FORMAT "%5.0" /end MEASUREMENT
/begin MEASUREMENT t_es_ast "Engine off duration for plausibilsiation AST" UWORD _CNV_A_R_LINEAR_____84_CM 1 100. 0. 65535. DISPLAY_IDENTIFIER T_ES_AST ECU_ADDRESS 0xd0001628 FORMAT "%5.0" /end MEASUREMENT
/begin MEASUREMENT t_rel_can_es "Time counter value at the start of engine off phase" ULONG _CNV_A_R_LINEAR_____84_CM 1 100. 0. 4294967295. DISPLAY_IDENTIFIER T_REL_CAN_ES ECU_ADDRESS 0xd000ba30 FORMAT "%10.0" /end MEASUREMENT
/begin MEASUREMENT t_rel_can_st "Time counter value at the end of engine off phase" ULONG _CNV_A_R_LINEAR_____84_CM 1 100. 0. 4294967295. DISPLAY_IDENTIFIER T_REL_CAN_ST ECU_ADDRESS 0xd000162c FORMAT "%10.0" /end MEASUREMENT
/begin MEASUREMENT t_rel_can_ast "Time counter value at the after-start" ULONG _CNV_A_R_LINEAR_____84_CM 1 100. 0. 4294967295. DISPLAY_IDENTIFIER T_REL_CAN_AST ECU_ADDRESS 0xd0001630 FORMAT "%10.0" /end MEASUREMENT
/begin MEASUREMENT lv_t_rel_can_reg "T_REL_CAN receiving of INSTR2 message" UBYTE _CNV_S_2_RANGE__0___1_CM 1 100. 0. 1. DISPLAY_IDENTIFIER LV_T_REL_CAN_REG ECU_ADDRESS 0xd0008bd8 BIT_MASK 0x1 /end MEASUREMENT
/begin MEASUREMENT lv_t_es_not_plaus "T_ES not plausible" UBYTE _CNV_S_2_RANGE__0___1_CM 1 100. 0. 1. DISPLAY_IDENTIFIER LV_T_ES_NOT_PLAUS ECU_ADDRESS 0xd0008bd9 BIT_MASK 0x1 /end MEASUREMENT
/begin MEASUREMENT lv_t_es_not_plaus_ast "T_ES not plausible AST" UBYTE _CNV_S_2_RANGE__0___1_CM 1 100. 0. 1. DISPLAY_IDENTIFIER LV_T_ES_NOT_PLAUS_AST ECU_ADDRESS 0xd0008bda BIT_MASK 0x1 /end MEASUREMENT
/begin MEASUREMENT t_es_cus "Engine off duration time for customer - value holds while engine is running" UWORD _CNV_A_R_LINEAR_____84_CM 1 100. 0. 65535. DISPLAY_IDENTIFIER T_ES_CUS ECU_ADDRESS 0xd000a7a2 FORMAT "%5.0" /end MEASUREMENT
/begin MEASUREMENT lv_t_es_plaus_ast_end "Second plausi of T_ES  after start finished (for T_ES-diagnosis)" UBYTE _CNV_S_2_RANGE__0___1_CM 1 100. 0. 1. DISPLAY_IDENTIFIER LV_T_ES_PLAUS_AST_END ECU_ADDRESS 0xd0008bdb BIT_MASK 0x1 /end MEASUREMENT
/begin MEASUREMENT ctr_stc_tecu_1 "statistic counter 1 for TECU monitoring" ULONG _CNV_A_R_LINEAR_____0_CM 1 100. 0. 4294967295. DISPLAY_IDENTIFIER CTR_STC_TECU_1 ECU_ADDRESS 0xd000a668 FORMAT "%10.0" /end MEASUREMENT
/begin MEASUREMENT ctr_stc_tecu_2 "statistic counter 2 for TECU monitoring" ULONG _CNV_A_R_LINEAR_____0_CM 1 100. 0. 4294967295. DISPLAY_IDENTIFIER CTR_STC_TECU_2 ECU_ADDRESS 0xd000a66c FORMAT "%10.0" /end MEASUREMENT
/begin MEASUREMENT ctr_stc_tecu_3 "statistic counter 3 for TECU monitoring" ULONG _CNV_A_R_LINEAR_____0_CM 1 100. 0. 4294967295. DISPLAY_IDENTIFIER CTR_STC_TECU_3 ECU_ADDRESS 0xd000a670 FORMAT "%10.0" /end MEASUREMENT
/begin MEASUREMENT ctr_stc_tecu_4 "statistic counter 4 for TECU monitoring" ULONG _CNV_A_R_LINEAR_____0_CM 1 100. 0. 4294967295. DISPLAY_IDENTIFIER CTR_STC_TECU_4 ECU_ADDRESS 0xd000a674 FORMAT "%10.0" /end MEASUREMENT
/begin MEASUREMENT ctr_stc_tecu_5 "statistic counter 5 for TECU monitoring" ULONG _CNV_A_R_LINEAR_____0_CM 1 100. 0. 4294967295. DISPLAY_IDENTIFIER CTR_STC_TECU_5 ECU_ADDRESS 0xd000a678 FORMAT "%10.0" /end MEASUREMENT
/begin MEASUREMENT ctr_stc_tecu_6 "statistic counter 6 for TECU monitoring" ULONG _CNV_A_R_LINEAR_____0_CM 1 100. 0. 4294967295. DISPLAY_IDENTIFIER CTR_STC_TECU_6 ECU_ADDRESS 0xd000a67c FORMAT "%10.0" /end MEASUREMENT
/begin MEASUREMENT ctr_stc_tecu_7 "statistic counter 7 for TECU monitoring" ULONG _CNV_A_R_LINEAR_____0_CM 1 100. 0. 4294967295. DISPLAY_IDENTIFIER CTR_STC_TECU_7 ECU_ADDRESS 0xd000a680 FORMAT "%10.0" /end MEASUREMENT
/begin MEASUREMENT ctr_stc_tecu_8 "statistic counter 8 for TECU monitoring" ULONG _CNV_A_R_LINEAR_____0_CM 1 100. 0. 4294967295. DISPLAY_IDENTIFIER CTR_STC_TECU_8 ECU_ADDRESS 0xd000a684 FORMAT "%10.0" /end MEASUREMENT
/begin CHARACTERISTIC ip_tecu "NTC characteristic" CURVE 0xa080b4d8 _REC_CUR_20_u1_u2 190.5 _CNV_A_R_LINEAR_____17_CM -48. 142.5 DISPLAY_IDENTIFIER IP_TECU FORMAT "%5.1"
 /begin AXIS_DESCR COM_AXIS vp_tecu _CNV_A_R_LINEAR_____172_CM 16 0. 4.999847 FORMAT "%7.5" AXIS_PTS_REF ldp_vp_tecu__tecu /end AXIS_DESCR
/end CHARACTERISTIC
/begin CHARACTERISTIC c_tecu_sub "TECU substitute value" VALUE 0xa080c2ef _REC_VAL_20_u1 190.5 _CNV_A_R_LINEAR_____17_CM -48. 142.5 DISPLAY_IDENTIFIER C_TECU_SUB FORMAT "%5.1" /end CHARACTERISTIC
/begin CHARACTERISTIC c_tecu_thd_1 "ETCU threshold 1" VALUE 0xa080c2f0 _REC_VAL_20_u1 190.5 _CNV_A_R_LINEAR_____17_CM -48. 142.5 DISPLAY_IDENTIFIER C_TECU_THD_1 FORMAT "%5.1" /end CHARACTERISTIC
/begin CHARACTERISTIC c_tecu_thd_2 "ETCU threshold 2" VALUE 0xa080c2f1 _REC_VAL_20_u1 190.5 _CNV_A_R_LINEAR_____17_CM -48. 142.5 DISPLAY_IDENTIFIER C_TECU_THD_2 FORMAT "%5.1" /end CHARACTERISTIC
/begin CHARACTERISTIC c_tecu_thd_3 "ETCU threshold 3" VALUE 0xa080c2f2 _REC_VAL_20_u1 190.5 _CNV_A_R_LINEAR_____17_CM -48. 142.5 DISPLAY_IDENTIFIER C_TECU_THD_3 FORMAT "%5.1" /end CHARACTERISTIC
/begin CHARACTERISTIC c_tecu_thd_4 "ETCU threshold 4" VALUE 0xa080c2f3 _REC_VAL_20_u1 190.5 _CNV_A_R_LINEAR_____17_CM -48. 142.5 DISPLAY_IDENTIFIER C_TECU_THD_4 FORMAT "%5.1" /end CHARACTERISTIC
/begin CHARACTERISTIC c_tecu_thd_5 "ETCU threshold 5" VALUE 0xa080c2f4 _REC_VAL_20_u1 190.5 _CNV_A_R_LINEAR_____17_CM -48. 142.5 DISPLAY_IDENTIFIER C_TECU_THD_5 FORMAT "%5.1" /end CHARACTERISTIC
/begin CHARACTERISTIC c_tecu_thd_6 "ETCU threshold 6" VALUE 0xa080c2f5 _REC_VAL_20_u1 190.5 _CNV_A_R_LINEAR_____17_CM -48. 142.5 DISPLAY_IDENTIFIER C_TECU_THD_6 FORMAT "%5.1" /end CHARACTERISTIC
/begin CHARACTERISTIC c_tecu_thd_7 "ETCU threshold 7" VALUE 0xa080c2f6 _REC_VAL_20_u1 190.5 _CNV_A_R_LINEAR_____17_CM -48. 142.5 DISPLAY_IDENTIFIER C_TECU_THD_7 FORMAT "%5.1" /end CHARACTERISTIC
/begin CHARACTERISTIC c_trt_dif_tecu "TRT difference for ETCU statistic" VALUE 0xa080c3b2 _REC_VAL_20_u4 119304.6471 _CNV_A_R_LINEAR_____152_CM 0. 119304.6471 DISPLAY_IDENTIFIER C_TRT_DIF_TECU FORMAT "%12.5" /end CHARACTERISTIC
/begin MEASUREMENT tecu "ECU temperature" UBYTE _CNV_A_R_LINEAR_____17_CM 1 100. -48. 142.5 DISPLAY_IDENTIFIER TECU ECU_ADDRESS 0xd0008a14 FORMAT "%5.1" /end MEASUREMENT
/begin AXIS_PTS ldp_vp_tecu__tecu "" 0xa0809208 vp_tecu _REC_AXS_20_u2 4.4998623 _CNV_A_R_LINEAR_____172_CM 16 0. 4.999847 FORMAT "%7.5" /end AXIS_PTS
/begin MEASUREMENT lv_err_tecu "TECU error flag" UBYTE _CNV_S_2_RANGE__0___1_CM 1 100. 0. 1. DISPLAY_IDENTIFIER LV_ERR_TECU ECU_ADDRESS 0xd0007f7b BIT_MASK 0x1 /end MEASUREMENT
/begin MEASUREMENT vp_tecu "Voltage of ECU-temperature-sensor" UWORD _CNV_A_R_LINEAR_____172_CM 1 100. 0. 4.999847 DISPLAY_IDENTIFIER VP_TECU ECU_ADDRESS 0xd000a688 FORMAT "%6.4" /end MEASUREMENT
/begin MEASUREMENT lv_v_tecu_vld "Flag indicating that a valid VP_TECU value is available at MU" UBYTE _CNV_S_2_RANGE______252_R_CM 1 100. 0. 255. DISPLAY_IDENTIFIER LV_V_TECU_VLD ECU_ADDRESS 0xd0008a16 BIT_MASK 0x1 /end MEASUREMENT
/begin MEASUREMENT v_tecu_mc "Voltage of microcontroller temperature-sensor" UWORD _CNV_A_R_LINEAR_____172_CM 1 100. 0. 4.999847 DISPLAY_IDENTIFIER V_TECU_MC ECU_ADDRESS 0xd000a68a FORMAT "%6.4" /end MEASUREMENT
/begin MEASUREMENT tecu_mc "Microcontroller temperature" UBYTE _CNV_A_R_LINEAR_____17_CM 1 100. -48. 142.5 DISPLAY_IDENTIFIER TECU_MC ECU_ADDRESS 0xd0008a15 FORMAT "%5.1" /end MEASUREMENT
/begin CHARACTERISTIC lc_tecu_swi "Selection of TECU source" VALUE 0xa080c5fd _REC_VAL_20_u1 1. _CNV_A_R_LINEAR_____0_CM 0. 1. DISPLAY_IDENTIFIER LC_TECU_SWI FORMAT "%2.0" /end CHARACTERISTIC
/begin MEASUREMENT tq_st_1 "Engine Start Torque raw value" SWORD _CNV_A_R_LINEAR_____31_CM 1 100. -1024. 1023.96875 DISPLAY_IDENTIFIER TQ_ST_1 ECU_ADDRESS 0xd00017a4 FORMAT "%6.2" /end MEASUREMENT
/begin CHARACTERISTIC c_crlc_tq_st "" VALUE 0xa080bb15 _REC_VAL_20_u1 0.99609375 _CNV_A_R_LINEAR_____185_CM 0. 0.99609375 DISPLAY_IDENTIFIER C_CRLC_TQ_ST FORMAT "%5.3" /end CHARACTERISTIC
/begin AXIS_PTS ldpm_tco_ip_tq_st "" 0xa08097e8 tco _REC_AXS_20_u1 190.5 _CNV_A_R_LINEAR_____17_CM 8 -48. 142.5 FORMAT "%5.1" /end AXIS_PTS
/begin AXIS_PTS ldpm_n_dif_ip_tq_st "" 0xa0809684 n_dif _REC_AXS_20_u2 65535. _CNV_A_R_LINEAR_____193_CM 8 -32768. 32767. FORMAT "%6.0" /end AXIS_PTS
/begin CHARACTERISTIC ip_tq_st_mt_opm_2 "Engine torque at start for manual transmission in engine operation mode 2" MAP 0xa0816f04 _REC_MAP_20_u2_u2_u1 2047.96875 _CNV_A_R_LINEAR_____87_CM -1024. 1023.96875 DISPLAY_IDENTIFIER IP_TQ_ST_MT_OPM_2 FORMAT "%6.2"
 /begin AXIS_DESCR COM_AXIS n_dif _CNV_A_R_LINEAR_____193_CM 8 -32768. 32767. FORMAT "%6.0" AXIS_PTS_REF ldpm_n_dif_ip_tq_st /end AXIS_DESCR
 /begin AXIS_DESCR COM_AXIS tco _CNV_A_R_LINEAR_____17_CM 8 -48. 142.5 FORMAT "%5.1" AXIS_PTS_REF ldpm_tco_ip_tq_st /end AXIS_DESCR
/end CHARACTERISTIC
/begin CHARACTERISTIC ip_tq_st_mt_opm_1 "Engine torque at start for manual transmission in engine operation mode 1" MAP 0xa0816e84 _REC_MAP_20_u2_u2_u1 2047.96875 _CNV_A_R_LINEAR_____87_CM -1024. 1023.96875 DISPLAY_IDENTIFIER IP_TQ_ST_MT_OPM_1 FORMAT "%6.2"
 /begin AXIS_DESCR COM_AXIS n_dif _CNV_A_R_LINEAR_____193_CM 8 -32768. 32767. FORMAT "%6.0" AXIS_PTS_REF ldpm_n_dif_ip_tq_st /end AXIS_DESCR
 /begin AXIS_DESCR COM_AXIS tco _CNV_A_R_LINEAR_____17_CM 8 -48. 142.5 FORMAT "%5.1" AXIS_PTS_REF ldpm_tco_ip_tq_st /end AXIS_DESCR
/end CHARACTERISTIC
/begin CHARACTERISTIC ip_tq_st_at_opm_1 "Engine torque at start for automatic transmission in engine operation mode 1" MAP 0xa0816d84 _REC_MAP_20_u2_u2_u1 2047.96875 _CNV_A_R_LINEAR_____87_CM -1024. 1023.96875 DISPLAY_IDENTIFIER IP_TQ_ST_AT_OPM_1 FORMAT "%6.2"
 /begin AXIS_DESCR COM_AXIS n_dif _CNV_A_R_LINEAR_____193_CM 8 -32768. 32767. FORMAT "%6.0" AXIS_PTS_REF ldpm_n_dif_ip_tq_st /end AXIS_DESCR
 /begin AXIS_DESCR COM_AXIS tco _CNV_A_R_LINEAR_____17_CM 8 -48. 142.5 FORMAT "%5.1" AXIS_PTS_REF ldpm_tco_ip_tq_st /end AXIS_DESCR
/end CHARACTERISTIC
/begin CHARACTERISTIC ip_tq_st_at_opm_2 "Engine torque at start for automatic transmission in engine operation mode 2" MAP 0xa0816e04 _REC_MAP_20_u2_u2_u1 2047.96875 _CNV_A_R_LINEAR_____87_CM -1024. 1023.96875 DISPLAY_IDENTIFIER IP_TQ_ST_AT_OPM_2 FORMAT "%6.2"
 /begin AXIS_DESCR COM_AXIS n_dif _CNV_A_R_LINEAR_____193_CM 8 -32768. 32767. FORMAT "%6.0" AXIS_PTS_REF ldpm_n_dif_ip_tq_st /end AXIS_DESCR
 /begin AXIS_DESCR COM_AXIS tco _CNV_A_R_LINEAR_____17_CM 8 -48. 142.5 FORMAT "%5.1" AXIS_PTS_REF ldpm_tco_ip_tq_st /end AXIS_DESCR
/end CHARACTERISTIC
/begin CHARACTERISTIC id_opm_av_tq_st "Operation mode matrix (actual)" CURVE 0xa0809da4 _REC_CUR_20_u1_u1 7. _CNV_A_R_LINEAR_____0_CM 1. 8. DISPLAY_IDENTIFIER ID_OPM_AV_TQ_ST FORMAT "%1.0"
 /begin AXIS_DESCR COM_AXIS opm_av _CNV_A_R_LINEAR_____0_CM 8 0. 8. FORMAT "%1.0" AXIS_PTS_REF ldpm_opm_av /end AXIS_DESCR
/end CHARACTERISTIC
/begin MEASUREMENT tq_st "Engine Start Torque" SWORD _CNV_A_R_LINEAR_____31_CM 1 100. -1024. 1023.96875 DISPLAY_IDENTIFIER TQ_ST ECU_ADDRESS 0xd000ab0c FORMAT "%6.2" /end MEASUREMENT
/begin MEASUREMENT opm_av_sel_tq_st "Operation mode ( after selection )" UBYTE _CNV_A_R_LINEAR_____0_CM 1 100. 1. 8. DISPLAY_IDENTIFIER OPM_AV_SEL_TQ_ST ECU_ADDRESS 0xd00017a8 FORMAT "%1.0" /end MEASUREMENT
/begin MEASUREMENT tqi_vs_max "???" SWORD _CNV_A_R_LINEAR_____31_CM 1 100. -1024. 1023.96875 DISPLAY_IDENTIFIER TQI_VS_MAX ECU_ADDRESS 0xd000ab6c FORMAT "%6.2" /end MEASUREMENT
/begin MEASUREMENT lv_tq_loss_acc_inp_orng "???" UBYTE _CNV_S_2_RANGE__0___1_CM 1 100. 0. 1. DISPLAY_IDENTIFIER LV_TQ_LOSS_ACC_INP_ORNG ECU_ADDRESS 0xd0008ed8 BIT_MASK 0x1 /end MEASUREMENT
/begin MEASUREMENT lv_iga_ch_so2p_stb "???" UBYTE _CNV_S_2_RANGE__0___1_CM 1 100. 0. 1. DISPLAY_IDENTIFIER LV_IGA_CH_SO2P_STB ECU_ADDRESS 0xd0008edf BIT_MASK 0x1 /end MEASUREMENT
/begin MEASUREMENT lamb_bas_cor_max "Maximum value basic lambda value" UWORD _CNV_A_R_LINEAR_____129_CM 1 100. 0. 31.9990234375 DISPLAY_IDENTIFIER LAMB_BAS_COR_MAX ECU_ADDRESS 0xd000ab58 FORMAT "%7.4" /end MEASUREMENT
/begin MEASUREMENT lv_can_gs_ack "???" UBYTE _CNV_S_2_RANGE__0___1_CM 1 100. 0. 1. DISPLAY_IDENTIFIER LV_CAN_GS_ACK ECU_ADDRESS 0xd0008ed7 BIT_MASK 0x1 /end MEASUREMENT
/begin MEASUREMENT lv_acp_orng "???" UBYTE _CNV_S_2_RANGE__0___1_CM 1 100. 0. 1. DISPLAY_IDENTIFIER LV_ACP_ORNG ECU_ADDRESS 0xd0008ed9 BIT_MASK 0x1 /end MEASUREMENT
/begin MEASUREMENT eff_egr_s "???" UWORD _CNV_A_R_LINEAR_____9_CM 1 100. 0. 1.99996948242188 DISPLAY_IDENTIFIER EFF_EGR_S ECU_ADDRESS 0xd000ab5a FORMAT "%7.5" /end MEASUREMENT
/begin MEASUREMENT eff_pha_s "???" UWORD _CNV_A_R_LINEAR_____9_CM 1 100. 0. 1.99996948242188 DISPLAY_IDENTIFIER EFF_PHA_S ECU_ADDRESS 0xd000ab5c FORMAT "%7.5" /end MEASUREMENT
/begin MEASUREMENT tq_ad_add_s_swi "Adaptive engine torque value for switch between hom. and strat." SWORD _CNV_A_R_LINEAR_____31_CM 1 100. -1024. 1023.96875 DISPLAY_IDENTIFIER TQ_AD_ADD_S_SWI ECU_ADDRESS 0xd000ab70 FORMAT "%7.1" /end MEASUREMENT
/begin MEASUREMENT tqi_cat_prot "???" SWORD _CNV_A_R_LINEAR_____31_CM 1 100. -1024. 1023.96875 DISPLAY_IDENTIFIER TQI_CAT_PROT ECU_ADDRESS 0xd000ab6e FORMAT "%6.2" /end MEASUREMENT
/begin MEASUREMENT tq_loss_thermo "Engine torque losses thermostat" SWORD _CNV_A_R_LINEAR_____31_CM 1 100. -1024. 1023.96875 DISPLAY_IDENTIFIER TQ_LOSS_THERMO ECU_ADDRESS 0xd000ab66 FORMAT "%8.2" /end MEASUREMENT
/begin MEASUREMENT tq_loss_win_heat "Engine torque losses rar window heater" SWORD _CNV_A_R_LINEAR_____31_CM 1 100. -1024. 1023.96875 DISPLAY_IDENTIFIER TQ_LOSS_WIN_HEAT ECU_ADDRESS 0xd000ab68 FORMAT "%8.2" /end MEASUREMENT
/begin MEASUREMENT tqi_p_max "???" SWORD _CNV_A_R_LINEAR_____31_CM 1 100. -1024. 1023.96875 DISPLAY_IDENTIFIER TQI_P_MAX ECU_ADDRESS 0xd000ab80 FORMAT "%6.2" /end MEASUREMENT
/begin MEASUREMENT tqi_pbr_max "maximum allowed indicated torque due to PBR" UWORD _CNV_A_R_LINEAR_____31_CM 1 100. 0. 1023.96875 DISPLAY_IDENTIFIER TQI_PBR_MAX ECU_ADDRESS 0xd000ab82 FORMAT "%7.2" /end MEASUREMENT
/begin MEASUREMENT trt "total running time" ULONG _CNV_A_R_LINEAR_____152_CM 1 100. 0. 119304.6471 DISPLAY_IDENTIFIER TRT ECU_ADDRESS 0xd000ba34 FORMAT "%12.5" /end MEASUREMENT
/begin CHARACTERISTIC c_t_igk_lih "Timeout for LV_IGK=1 if no CAN message \"Klemmenstatus\" available" VALUE 0xa080c1d4 _REC_VAL_20_u1 2.55 _CNV_A_R_LINEAR_____3_CM 0. 2.55 DISPLAY_IDENTIFIER C_T_IGK_LIH FORMAT "%4.2" /end CHARACTERISTIC
/begin CHARACTERISTIC c_t_dly_igk_off_prel "Delay time ignition off after driver's command" VALUE 0xa080c177 _REC_VAL_20_u1 2.55 _CNV_A_R_LINEAR_____3_CM 0. 2.55 DISPLAY_IDENTIFIER C_T_DLY_IGK_OFF_PREL FORMAT "%4.2" /end CHARACTERISTIC
/begin CHARACTERISTIC c_t_temp_igk_off_prel "Temp. time prel. ignition off after CAS-HW-error during dc" VALUE 0xa080c27e _REC_VAL_20_u2 655.35 _CNV_A_R_LINEAR_____3_CM 0. 655.35 DISPLAY_IDENTIFIER C_T_TEMP_IGK_OFF_PREL FORMAT "%6.2" /end CHARACTERISTIC
/begin CHARACTERISTIC ip_t_ast_is_ad_inh "Time after start during which idle speed adaptation is disabled" CURVE 0xa0807fe4 _REC_CUR_20_u2_u1 6553.5 _CNV_A_R_LINEAR_____4_CM 0. 6553.5 DISPLAY_IDENTIFIER IP_T_AST_IS_AD_INH FORMAT "%6.1"
 /begin AXIS_DESCR COM_AXIS tco _CNV_A_R_LINEAR_____17_CM 4 -48. 142.5 FORMAT "%5.1" AXIS_PTS_REF ldp_tco_ip_t_ast_is_ad_inh /end AXIS_DESCR
/end CHARACTERISTIC
/begin AXIS_PTS ldp_tco_ip_t_ast_is_ad_inh "" 0xa0807fcc tco _REC_AXS_20_u1 190.5 _CNV_A_R_LINEAR_____17_CM 4 -48. 142.5 FORMAT "%5.1" /end AXIS_PTS
/begin MEASUREMENT ang_pste_stnd "relative steering wheel sensor angle" SWORD _CNV_A_R_LINEAR_____212_CM 1 100. -100. 99.9969482421875 DISPLAY_IDENTIFIER ANG_PSTE_STND ECU_ADDRESS 0xd000a7bc FORMAT "%8.3" /end MEASUREMENT
/begin MEASUREMENT ang_pste_end_ri_ad "relative steering wheel sensor angle right" SWORD _CNV_A_R_LINEAR_____72_CM 1 100. -1439.98976 1439.945815 DISPLAY_IDENTIFIER ANG_PSTE_END_RI_AD ECU_ADDRESS 0xd000a7be FORMAT "%8.3" /end MEASUREMENT
/begin MEASUREMENT ang_pste_end_le_ad "relative steering wheel sensor left side adaptation" SWORD _CNV_A_R_LINEAR_____72_CM 1 100. -1439.98976 1439.945815 DISPLAY_IDENTIFIER ANG_PSTE_END_LE_AD ECU_ADDRESS 0xd000a7c0 FORMAT "%8.3" /end MEASUREMENT
/begin CHARACTERISTIC c_ang_pste_end_le_ini "initialisation value  left  ANG_PSTE_STND" VALUE 0xa080ba96 _REC_VAL_20_s2 2879.935575 _CNV_A_R_LINEAR_____72_CM -1439.98976 1439.945815 DISPLAY_IDENTIFIER C_ANG_PSTE_END_LE_INI FORMAT "%8.3" /end CHARACTERISTIC
/begin CHARACTERISTIC c_ang_pste_end_ri_ini "initialisation value  right  ANG_PSTE_STND" VALUE 0xa080ba98 _REC_VAL_20_s2 2879.935575 _CNV_A_R_LINEAR_____72_CM -1439.98976 1439.945815 DISPLAY_IDENTIFIER C_ANG_PSTE_END_RI_INI FORMAT "%8.3" /end CHARACTERISTIC
/begin CHARACTERISTIC c_ang_pste_end_dif "cal. difference between  ANG_PSTE_END_LE/RI_AD out of NVMY and init-value (at reset)" VALUE 0xa080ba94 _REC_VAL_20_s2 2879.935575 _CNV_A_R_LINEAR_____72_CM -1439.98976 1439.945815 DISPLAY_IDENTIFIER C_ANG_PSTE_END_DIF FORMAT "%8.3" /end CHARACTERISTIC
/begin MEASUREMENT vel_ang_pste_cor "Filtered steering-wheel-angle velocity" SWORD _CNV_A_R_LINEAR_____85_CM 1 100. -1439.98976 1439.945815 DISPLAY_IDENTIFIER VEL_ANG_PSTE_COR ECU_ADDRESS 0xd000a7c2 FORMAT "%8.3" /end MEASUREMENT
/begin MEASUREMENT vel_ang_pste_mmv "moving mean value of steering-wheel-angle velocity" SWORD _CNV_A_R_LINEAR_____85_CM 1 100. -1439.98976 1439.945815 DISPLAY_IDENTIFIER VEL_ANG_PSTE_MMV ECU_ADDRESS 0xd00015d8 FORMAT "%8.3" /end MEASUREMENT
/begin MEASUREMENT t_vel_ang_pste "Time for detecting \"released\" steering wheel" UBYTE _CNV_A_R_LINEAR_____3_CM 1 100. 0. 2.55 DISPLAY_IDENTIFIER T_VEL_ANG_PSTE ECU_ADDRESS 0xd00015e0 FORMAT "%4.2" /end MEASUREMENT
/begin MEASUREMENT lv_vel_ang_pste_min_det "LV indicating \"released\" steering wheel" UBYTE _CNV_S_2_RANGE__0___1_CM 1 100. 0. 1. DISPLAY_IDENTIFIER LV_VEL_ANG_PSTE_MIN_DET ECU_ADDRESS 0xd00015e1 BIT_MASK 0x1 /end MEASUREMENT
/begin MEASUREMENT lv_stg_ri_act "LV indicating steering active(direction:1  = right , 0 = left)" UBYTE _CNV_S_2_RANGE__0___1_CM 1 100. 0. 1. DISPLAY_IDENTIFIER LV_STG_RI_ACT ECU_ADDRESS 0xd00015e2 BIT_MASK 0x1 /end MEASUREMENT
/begin CHARACTERISTIC c_crlc_vel_ang_pste "Correlation constant for steering wheel angle velocity" VALUE 0xa080bb1c _REC_VAL_20_u1 0.99609375 _CNV_A_R_LINEAR_____185_CM 0. 0.99609375 DISPLAY_IDENTIFIER C_CRLC_VEL_ANG_PSTE FORMAT "%5.3" /end CHARACTERISTIC
/begin CHARACTERISTIC c_vel_ang_pste_min_1 "minimum threshold VEL_ANG_PSTE_MMV for detection of steering active" VALUE 0xa080c43a _REC_VAL_20_s2 2879.935575 _CNV_A_R_LINEAR_____85_CM -1439.98976 1439.945815 DISPLAY_IDENTIFIER C_VEL_ANG_PSTE_MIN_1 FORMAT "%8.3" /end CHARACTERISTIC
/begin CHARACTERISTIC c_vel_ang_pste_min_2 "minimum threshold VEL_ANG_PSTE_MMV for detection of \"released\" steering wheel" VALUE 0xa080c43c _REC_VAL_20_s2 2879.935575 _CNV_A_R_LINEAR_____85_CM -1439.98976 1439.945815 DISPLAY_IDENTIFIER C_VEL_ANG_PSTE_MIN_2 FORMAT "%8.3" /end CHARACTERISTIC
/begin CHARACTERISTIC c_t_vel_ang_pste "Time for detecting \"released steering wheel" VALUE 0xa080c294 _REC_VAL_20_u1 2.55 _CNV_A_R_LINEAR_____3_CM 0. 2.55 DISPLAY_IDENTIFIER C_T_VEL_ANG_PSTE FORMAT "%4.2" /end CHARACTERISTIC
/begin CHARACTERISTIC lc_vel_ang_pste_cor "calculation of VEL_ANG_PSTE_COR depending on steering wheel state" VALUE 0xa080c620 _REC_VAL_20_u1 1. _CNV_A_R_LINEAR_____0_CM 0. 1. DISPLAY_IDENTIFIER LC_VEL_ANG_PSTE_COR FORMAT "%1.0" /end CHARACTERISTIC
/begin CHARACTERISTIC c_vs_pste "vehicle speed threshold for power steering" VALUE 0xa080c4f1 _REC_VAL_20_u1 255. _CNV_A_R_LINEAR_____6_CM 0. 255. DISPLAY_IDENTIFIER C_VS_PSTE FORMAT "%3.0" /end CHARACTERISTIC
/begin CHARACTERISTIC c_vel_ang_pste_max_ad "VEL_ANG_PSTE-threshold for adaptation of steering wheel angle" VALUE 0xa080c438 _REC_VAL_20_s2 2879.935575 _CNV_A_R_LINEAR_____85_CM -1439.98976 1439.945815 DISPLAY_IDENTIFIER C_VEL_ANG_PSTE_MAX_AD FORMAT "%8.3" /end CHARACTERISTIC
/begin CHARACTERISTIC c_ang_pste_ad_lgrd "" VALUE 0xa080ba92 _REC_VAL_20_u2 1439.945815 _CNV_A_R_LINEAR_____72_CM 0. 1439.945815 DISPLAY_IDENTIFIER C_ANG_PSTE_AD_LGRD FORMAT "%8.2" /end CHARACTERISTIC
/begin CHARACTERISTIC c_t_ang_pste_ad "Time during which adaptation of steering wheel angle is inhibited" VALUE 0xa080c11a _REC_VAL_20_u2 655.35 _CNV_A_R_LINEAR_____3_CM 0. 655.35 DISPLAY_IDENTIFIER C_T_ANG_PSTE_AD FORMAT "%6.2" /end CHARACTERISTIC
/begin MEASUREMENT tq_add_pl_drof "TQ reserve for drive off support" UWORD _CNV_A_R_LINEAR_____31_CM 1 100. 0. 1023.96875 DISPLAY_IDENTIFIER TQ_ADD_PL_DROF ECU_ADDRESS 0xd000a7b4 FORMAT "%7.2" /end MEASUREMENT
/begin MEASUREMENT n_dif_pred_pl_drof "Predicted idle speed control variable at drive-off-support" SWORD _CNV_A_R_LINEAR_____14_CM 1 100. -32768. 32767. DISPLAY_IDENTIFIER N_DIF_PRED_PL_DROF ECU_ADDRESS 0xd00009c0 FORMAT "%6.0" /end MEASUREMENT
/begin MEASUREMENT lv_fast_load_im "Fast Manifold Filling enabled" UBYTE _CNV_S_2_RANGE__0___1_CM 1 100. 0. 1. DISPLAY_IDENTIFIER LV_FAST_LOAD_IM ECU_ADDRESS 0xd0008bfd BIT_MASK 0x1 /end MEASUREMENT
/begin CHARACTERISTIC ip_t_n_dif_ofs_pred_drof "Time constant for calculation of predicted engine speed deviation at drive-off-support (PL)" CURVE 0xa080b458 _REC_CUR_20_u1_u2 7.96875 _CNV_A_R_LINEAR_____191_CM 0. 7.96875 DISPLAY_IDENTIFIER IP_T_N_DIF_OFS_PRED_DROF FORMAT "%4.2"
 /begin AXIS_DESCR COM_AXIS n _CNV_A_R_LINEAR_____14_CM 8 0. 8160. FORMAT "%4.0" AXIS_PTS_REF ldpm_n_t_n_dif_ofs_pred /end AXIS_DESCR
/end CHARACTERISTIC
/begin AXIS_PTS ldpm_n_t_n_dif_ofs_pred "" 0xa080970c n _REC_AXS_20_u2 8160. _CNV_A_R_LINEAR_____14_CM 8 0. 8160. FORMAT "%4.0" /end AXIS_PTS
/begin CHARACTERISTIC c_gear_max_fast_load_im "Highest gear for Fast Manifold Filling" VALUE 0xa080bda4 _REC_VAL_20_u1 255. _CNV_A_R_LINEAR_____0_CM 0. 255. DISPLAY_IDENTIFIER C_GEAR_MAX_FAST_LOAD_IM FORMAT "%3.0" /end CHARACTERISTIC
/begin CHARACTERISTIC c_vs_max_fast_load_im "Highest vehicle speed  for Fast Manifold Filling" VALUE 0xa080c4cd _REC_VAL_20_u1 255. _CNV_A_R_LINEAR_____6_CM 0. 255. DISPLAY_IDENTIFIER C_VS_MAX_FAST_LOAD_IM FORMAT "%3.0" /end CHARACTERISTIC
/begin CHARACTERISTIC c_n_max_fast_load_im "Highest engine speed  for Fast Manifold Filling" VALUE 0xa080bf88 _REC_VAL_20_u2 8160. _CNV_A_R_LINEAR_____14_CM 0. 8160. DISPLAY_IDENTIFIER C_N_MAX_FAST_LOAD_IM FORMAT "%4.0" /end CHARACTERISTIC
/begin CHARACTERISTIC c_t_ast_min_fast_load_im "Minimum time after start before enabling Fast Manifold Filling" VALUE 0xa080c134 _REC_VAL_20_u2 6553.5 _CNV_A_R_LINEAR_____4_CM 0. 6553.5 DISPLAY_IDENTIFIER C_T_AST_MIN_FAST_LOAD_IM FORMAT "%6.1" /end CHARACTERISTIC
/begin CHARACTERISTIC lc_fast_load_im_is "0: Fast Manifold Filling possible only during 'idle'" VALUE 0xa080c574 _REC_VAL_20_u1 1. _CNV_A_R_LINEAR_____0_CM 0. 1. DISPLAY_IDENTIFIER LC_FAST_LOAD_IM_IS FORMAT "%2.0" /end CHARACTERISTIC
/begin CHARACTERISTIC lc_ena_fast_load_im_n_sp "1: Fast Manifold Filling can be requested by LV_N_SP_IS_CS = 1" VALUE 0xa080c55c _REC_VAL_20_u1 1. _CNV_A_R_LINEAR_____0_CM 0. 1. DISPLAY_IDENTIFIER LC_ENA_FAST_LOAD_IM_N_SP FORMAT "%2.0" /end CHARACTERISTIC
/begin AXIS_PTS ldp_vs_fil_ip_fac_vs_tq_add_pl "" 0xa08092e4 vs_fil _REC_AXS_20_u2 511.99218 _CNV_A_R_LINEAR_____86_CM 4 0. 511.99218 FORMAT "%7.3" /end AXIS_PTS
/begin CHARACTERISTIC ip_fac_vs_tq_add_pl_drof "Vehicle speed correction for IP_TQ_ADD_PL_DROF" CURVE 0xa080ac74 _REC_CUR_20_u2_u2 1.99996948242188 _CNV_A_R_LINEAR_____9_CM 0. 1.99996948242188 DISPLAY_IDENTIFIER IP_FAC_VS_TQ_ADD_PL_DROF FORMAT "%9.8"
 /begin AXIS_DESCR COM_AXIS vs_fil _CNV_A_R_LINEAR_____86_CM 4 0. 511.99218 FORMAT "%7.3" AXIS_PTS_REF ldp_vs_fil_ip_fac_vs_tq_add_pl /end AXIS_DESCR
/end CHARACTERISTIC
/begin AXIS_PTS ldp_tq_av_ip_fac_n_grd "" 0xa0808f58 tq_av _REC_AXS_20_u2 2047.96875 _CNV_A_R_LINEAR_____87_CM 4 -1024. 1023.96875 FORMAT "%6.2" /end AXIS_PTS
/begin CHARACTERISTIC ip_fac_n_grd_tq_av "Weighing of additive part of N_DIF_DROF dependent from actual torque" CURVE 0xa080a3a4 _REC_CUR_20_u2_u2 1.99996948242188 _CNV_A_R_LINEAR_____9_CM 0. 1.99996948242188 DISPLAY_IDENTIFIER IP_FAC_N_GRD_TQ_AV FORMAT "%9.8"
 /begin AXIS_DESCR COM_AXIS tq_av _CNV_A_R_LINEAR_____87_CM 4 -1024. 1023.96875 FORMAT "%6.2" AXIS_PTS_REF ldp_tq_av_ip_fac_n_grd /end AXIS_DESCR
/end CHARACTERISTIC
/begin AXIS_PTS ldp_fac_tq_req_ip_fac_tq_drof "" 0xa080864c fac_tq_req _REC_AXS_20_u2 1.99996948242188 _CNV_A_R_LINEAR_____9_CM 6 0. 1.99996948242188 FORMAT "%9.8" /end AXIS_PTS
/begin CHARACTERISTIC ip_fac_tq_drof_fac_tq_req "Weighing of IP_TQ_DROF dependent from FAC_TQ_REQ" CURVE 0xa080a978 _REC_CUR_20_u2_u2 1.99996948242188 _CNV_A_R_LINEAR_____9_CM 0. 1.99996948242188 DISPLAY_IDENTIFIER IP_FAC_TQ_DROF_FAC_TQ_REQ FORMAT "%9.8"
 /begin AXIS_DESCR COM_AXIS fac_tq_req _CNV_A_R_LINEAR_____9_CM 6 0. 1.99996948242188 FORMAT "%9.8" AXIS_PTS_REF ldp_fac_tq_req_ip_fac_tq_drof /end AXIS_DESCR
/end CHARACTERISTIC
/begin CHARACTERISTIC c_n_dif_drof_min "Minimum N_DIF_DROF for functionTQ_DROF" VALUE 0xa080bf22 _REC_VAL_20_s2 65535. _CNV_A_R_LINEAR_____14_CM -32768. 32767. DISPLAY_IDENTIFIER C_N_DIF_DROF_MIN FORMAT "%6.0" /end CHARACTERISTIC
/begin CHARACTERISTIC c_n_dif_drof_max "Maximum N_DIF_DROF for functionTQ_DROF" VALUE 0xa080bf20 _REC_VAL_20_s2 65535. _CNV_A_R_LINEAR_____14_CM -32768. 32767. DISPLAY_IDENTIFIER C_N_DIF_DROF_MAX FORMAT "%6.0" /end CHARACTERISTIC
/begin CHARACTERISTIC lc_tq_drof_isc_off "Boolean to enable/disable idle speed controller during drive-off; 1 = disabled" VALUE 0xa080c608 _REC_VAL_20_u1 1. _CNV_A_R_LINEAR_____0_CM 0. 1. DISPLAY_IDENTIFIER LC_TQ_DROF_ISC_OFF FORMAT "%2.0" /end CHARACTERISTIC
/begin MEASUREMENT tq_drof_slow "TQ request for drive-off assistance" SWORD _CNV_A_R_LINEAR_____31_CM 1 100. -1024. 1023.96875 DISPLAY_IDENTIFIER TQ_DROF_SLOW ECU_ADDRESS 0xd000a7b8 FORMAT "%8.2" /end MEASUREMENT
/begin MEASUREMENT n_dif_drof "Engine speed difference effective for TQ_DROF" SWORD _CNV_A_R_LINEAR_____14_CM 1 100. -32768. 32767. DISPLAY_IDENTIFIER N_DIF_DROF ECU_ADDRESS 0xd00009c2 FORMAT "%6.0" /end MEASUREMENT
/begin MEASUREMENT lv_isc_off_drof "Boolean to enable/disable idle speed controller during drive-off; 1=disabled" UBYTE _CNV_S_2_RANGE__0___1_CM 1 100. 0. 1. DISPLAY_IDENTIFIER LV_ISC_OFF_DROF ECU_ADDRESS 0xd0008bfc BIT_MASK 0x1 /end MEASUREMENT
/begin MEASUREMENT tq_drof_fast "TQ request for drive-off assistance" SWORD _CNV_A_R_LINEAR_____31_CM 1 100. -1024. 1023.96875 DISPLAY_IDENTIFIER TQ_DROF_FAST ECU_ADDRESS 0xd000a7b6 FORMAT "%8.2" /end MEASUREMENT
/begin AXIS_PTS ldp_n_dif_drof__id_tq_drof "" 0xa0808af8 n_dif_drof _REC_AXS_20_u2 65535. _CNV_A_R_LINEAR_____193_CM 3 -32768. 32767. FORMAT "%6.0" /end AXIS_PTS
/begin AXIS_PTS ldp_n_grd__id_tq_drof "" 0xa0808b0e n_grd _REC_AXS_20_u1 8160. _CNV_A_R_LINEAR_____29_CM 3 -4096. 4064. FORMAT "%5.0" /end AXIS_PTS
/begin CHARACTERISTIC id_tq_drof_ena "Enable conditions" MAP 0xa0809ef0 _REC_MAP_20_u1_u2_u1 1. _CNV_A_R_LINEAR_____0_CM 0. 1. DISPLAY_IDENTIFIER ID_TQ_DROF_ENA FORMAT "%1.0"
 /begin AXIS_DESCR COM_AXIS n_dif_drof _CNV_A_R_LINEAR_____193_CM 3 -32768. 32767. FORMAT "%6.0" AXIS_PTS_REF ldp_n_dif_drof__id_tq_drof /end AXIS_DESCR
 /begin AXIS_DESCR COM_AXIS n_grd _CNV_A_R_LINEAR_____29_CM 3 -4096. 4064. FORMAT "%5.0" AXIS_PTS_REF ldp_n_grd__id_tq_drof /end AXIS_DESCR
/end CHARACTERISTIC
/begin CHARACTERISTIC c_tq_drof_min "threshold TQ_DRF fast load" VALUE 0xa080c374 _REC_VAL_20_s2 2047.96875 _CNV_A_R_LINEAR_____31_CM -1024. 1023.96875 DISPLAY_IDENTIFIER C_TQ_DROF_MIN FORMAT "%8.2" /end CHARACTERISTIC
/begin AXIS_PTS ldp_gear__var_amt_load_im "" 0xa080876c gear _REC_AXS_20_u1 255. _CNV_A_R_LINEAR_____0_CM 8 0. 255. FORMAT "%3.0" /end AXIS_PTS
/begin CHARACTERISTIC id_var_amt_load_im "enabled gears at LV_VAR_AMT" CURVE 0xa0809f34 _REC_CUR_20_u1_u1 1. _CNV_S_2_RANGE______76_CM 0. 1. DISPLAY_IDENTIFIER ID_VAR_AMT_LOAD_IM
 /begin AXIS_DESCR COM_AXIS gear _CNV_A_R_LINEAR_____0_CM 8 0. 255. FORMAT "%3.0" AXIS_PTS_REF ldp_gear__var_amt_load_im /end AXIS_DESCR
/end CHARACTERISTIC
/begin MEASUREMENT lv_tq_drof_is_ad_inh "Flag for inhibition of IS-control adaptations" UBYTE _CNV_S_2_RANGE__0___1_CM 1 100. 0. 1. DISPLAY_IDENTIFIER LV_TQ_DROF_IS_AD_INH ECU_ADDRESS 0xd0008bfe BIT_MASK 0x1 /end MEASUREMENT
/begin CHARACTERISTIC c_tq_drof_ad "threshold TQ_DROF for inhibition of IS-control adaptations" VALUE 0xa080c372 _REC_VAL_20_s2 2047.96875 _CNV_A_R_LINEAR_____31_CM -1024. 1023.96875 DISPLAY_IDENTIFIER C_TQ_DROF_AD FORMAT "%8.2" /end CHARACTERISTIC
/begin CHARACTERISTIC c_t_tq_drof_dly_ad "timer TQ_DROF for inhibition of IS-control adaptations" VALUE 0xa080c28b _REC_VAL_20_u1 2.55 _CNV_A_R_LINEAR_____3_CM 0. 2.55 DISPLAY_IDENTIFIER C_T_TQ_DROF_DLY_AD FORMAT "%4.2" /end CHARACTERISTIC
/begin AXIS_PTS ldp_n_dif_pred_fac_tq_add_is_1 "" 0xa0808b00 n_dif_pred_pl_drof _REC_AXS_20_u2 65535. _CNV_A_R_LINEAR_____193_CM 6 -32768. 32767. FORMAT "%6.0" /end AXIS_PTS
/begin AXIS_PTS ldp_fac_tq_req_drof_1 "" 0xa080863c fac_tq_req _REC_AXS_20_u2 1.99996948242188 _CNV_A_R_LINEAR_____9_CM 6 0. 1.99996948242188 FORMAT "%7.5" /end AXIS_PTS
/begin CHARACTERISTIC ip_tq_add_pl_drof_opm_1 "Torque reserve at part load for drive off support in operation mode 1" MAP 0xa081627c _REC_MAP_20_u2_u2_u2 1023.96875 _CNV_A_R_LINEAR_____31_CM 0. 1023.96875 DISPLAY_IDENTIFIER IP_TQ_ADD_PL_DROF_OPM_1 FORMAT "%7.2"
 /begin AXIS_DESCR COM_AXIS n_dif_pred_pl_drof _CNV_A_R_LINEAR_____193_CM 6 -32768. 32767. FORMAT "%6.0" AXIS_PTS_REF ldp_n_dif_pred_fac_tq_add_is_1 /end AXIS_DESCR
 /begin AXIS_DESCR COM_AXIS fac_tq_req _CNV_A_R_LINEAR_____9_CM 6 0. 1.99996948242188 FORMAT "%7.5" AXIS_PTS_REF ldp_fac_tq_req_drof_1 /end AXIS_DESCR
/end CHARACTERISTIC
/begin CHARACTERISTIC ip_tq_add_pl_drof_opm_2 "Torque reserve at part load for drive off support in operation mode 2" MAP 0xa08162c4 _REC_MAP_20_u2_u2_u2 1023.96875 _CNV_A_R_LINEAR_____31_CM 0. 1023.96875 DISPLAY_IDENTIFIER IP_TQ_ADD_PL_DROF_OPM_2 FORMAT "%7.2"
 /begin AXIS_DESCR COM_AXIS n_dif_pred_pl_drof _CNV_A_R_LINEAR_____193_CM 6 -32768. 32767. FORMAT "%6.0" AXIS_PTS_REF ldp_n_dif_pred_fac_tq_add_is_1 /end AXIS_DESCR
 /begin AXIS_DESCR COM_AXIS fac_tq_req _CNV_A_R_LINEAR_____9_CM 6 0. 1.99996948242188 FORMAT "%7.5" AXIS_PTS_REF ldp_fac_tq_req_drof_1 /end AXIS_DESCR
/end CHARACTERISTIC
/begin AXIS_PTS ldp_tia_ip_fac_temp_tq_add_1 "" 0xa0808e96 tia _REC_AXS_20_u1 190.5 _CNV_A_R_LINEAR_____17_CM 6 -48. 142.5 FORMAT "%5.1" /end AXIS_PTS
/begin AXIS_PTS ldp_toil_ip_fac_temp_tq_add_1 "" 0xa0808f02 toil _REC_AXS_20_u1 200. _CNV_A_R_LINEAR_____26_CM 6 -40. 160. FORMAT "%3.0" /end AXIS_PTS
/begin CHARACTERISTIC ip_fac_temp_tq_add_drof_opm_1 "Temperature correction  for IP_TQ_ADD_PL_DROF in operation mode 1" MAP 0xa08145b4 _REC_MAP_20_u2_u1_u1 1.99996948242188 _CNV_A_R_LINEAR_____9_CM 0. 1.99996948242188 DISPLAY_IDENTIFIER IP_FAC_TEMP_TQ_ADD_DROF_OPM_1 FORMAT "%9.8"
 /begin AXIS_DESCR COM_AXIS tia _CNV_A_R_LINEAR_____17_CM 6 -48. 142.5 FORMAT "%5.1" AXIS_PTS_REF ldp_tia_ip_fac_temp_tq_add_1 /end AXIS_DESCR
 /begin AXIS_DESCR COM_AXIS toil _CNV_A_R_LINEAR_____26_CM 6 -40. 160. FORMAT "%3.0" AXIS_PTS_REF ldp_toil_ip_fac_temp_tq_add_1 /end AXIS_DESCR
/end CHARACTERISTIC
/begin CHARACTERISTIC ip_fac_temp_tq_add_drof_opm_2 "Temperature correction  for IP_TQ_ADD_PL_DROF in operation mode 2" MAP 0xa08145fc _REC_MAP_20_u2_u1_u1 1.99996948242188 _CNV_A_R_LINEAR_____9_CM 0. 1.99996948242188 DISPLAY_IDENTIFIER IP_FAC_TEMP_TQ_ADD_DROF_OPM_2 FORMAT "%9.8"
 /begin AXIS_DESCR COM_AXIS tia _CNV_A_R_LINEAR_____17_CM 6 -48. 142.5 FORMAT "%5.1" AXIS_PTS_REF ldp_tia_ip_fac_temp_tq_add_1 /end AXIS_DESCR
 /begin AXIS_DESCR COM_AXIS toil _CNV_A_R_LINEAR_____26_CM 6 -40. 160. FORMAT "%3.0" AXIS_PTS_REF ldp_toil_ip_fac_temp_tq_add_1 /end AXIS_DESCR
/end CHARACTERISTIC
/begin AXIS_PTS ldp_n_grd_ip_n_dif_add_drof_1 "" 0xa0808b12 n_grd _REC_AXS_20_u1 8160. _CNV_A_R_LINEAR_____29_CM 4 -4096. 4064. FORMAT "%5.0" /end AXIS_PTS
/begin AXIS_PTS ldp_n_sp_is_ip_n_dif_add_drof_1 "" 0xa0808ba8 n_sp_is _REC_AXS_20_u2 8160. _CNV_A_R_LINEAR_____14_CM 4 0. 8160. FORMAT "%4.0" /end AXIS_PTS
/begin CHARACTERISTIC ip_n_dif_add_drof_opm_1 "Additive part of N_DIF_DROF dependant from engine speed gradient in operation mode 1" MAP 0xa080b030 _REC_MAP_20_u2_u1_u2 65535. _CNV_A_R_LINEAR_____193_CM -32768. 32767. DISPLAY_IDENTIFIER IP_N_DIF_ADD_DROF_OPM_1 FORMAT "%6.0"
 /begin AXIS_DESCR COM_AXIS n_grd _CNV_A_R_LINEAR_____29_CM 4 -4096. 4064. FORMAT "%5.0" AXIS_PTS_REF ldp_n_grd_ip_n_dif_add_drof_1 /end AXIS_DESCR
 /begin AXIS_DESCR COM_AXIS n_sp_is _CNV_A_R_LINEAR_____14_CM 4 0. 8160. FORMAT "%4.0" AXIS_PTS_REF ldp_n_sp_is_ip_n_dif_add_drof_1 /end AXIS_DESCR
/end CHARACTERISTIC
/begin CHARACTERISTIC ip_n_dif_add_drof_opm_2 "Additive part of N_DIF_DROF dependant from engine speed gradient in operation mode 2" MAP 0xa080b050 _REC_MAP_20_u2_u1_u2 65535. _CNV_A_R_LINEAR_____193_CM -32768. 32767. DISPLAY_IDENTIFIER IP_N_DIF_ADD_DROF_OPM_2 FORMAT "%6.0"
 /begin AXIS_DESCR COM_AXIS n_grd _CNV_A_R_LINEAR_____29_CM 4 -4096. 4064. FORMAT "%5.0" AXIS_PTS_REF ldp_n_grd_ip_n_dif_add_drof_1 /end AXIS_DESCR
 /begin AXIS_DESCR COM_AXIS n_sp_is _CNV_A_R_LINEAR_____14_CM 4 0. 8160. FORMAT "%4.0" AXIS_PTS_REF ldp_n_sp_is_ip_n_dif_add_drof_1 /end AXIS_DESCR
/end CHARACTERISTIC
/begin CHARACTERISTIC id_idx_opm_drof "Switch map to choose DROF calculation path (OPM_1 or OPM_2) depending on OPM_AV" CURVE 0xa08099d4 _REC_CUR_20_u1_u1 1. _CNV_A_R_LINEAR_____0_CM 0. 1. DISPLAY_IDENTIFIER ID_IDX_OPM_DROF FORMAT "%1.0"
 /begin AXIS_DESCR COM_AXIS opm_av _CNV_A_R_LINEAR_____0_CM 8 0. 8. FORMAT "%1.0" AXIS_PTS_REF ldpm_opm_av /end AXIS_DESCR
/end CHARACTERISTIC
/begin AXIS_PTS ldpm_n_dif_drof_ip_tq_drof_1 "" 0xa080966c n_dif_drof _REC_AXS_20_u2 65535. _CNV_A_R_LINEAR_____193_CM 11 -32768. 32767. FORMAT "%6.0" /end AXIS_PTS
/begin AXIS_PTS ldpm_n_grd_ip_tq_drof_1 "" 0xa08096b8 n_grd _REC_AXS_20_u1 8160. _CNV_A_R_LINEAR_____29_CM 10 -4096. 4064. FORMAT "%5.0" /end AXIS_PTS
/begin CHARACTERISTIC ip_tq_drof_slow_opm_1 "Torque for driving off assistance, basic value in operation mode 1" MAP 0xa0816784 _REC_MAP_20_u2_u2_u1 2047.96875 _CNV_A_R_LINEAR_____87_CM -1024. 1023.96875 DISPLAY_IDENTIFIER IP_TQ_DROF_SLOW_OPM_1 FORMAT "%6.2"
 /begin AXIS_DESCR COM_AXIS n_dif_drof _CNV_A_R_LINEAR_____193_CM 11 -32768. 32767. FORMAT "%6.0" AXIS_PTS_REF ldpm_n_dif_drof_ip_tq_drof_1 /end AXIS_DESCR
 /begin AXIS_DESCR COM_AXIS n_grd _CNV_A_R_LINEAR_____29_CM 10 -4096. 4064. FORMAT "%5.0" AXIS_PTS_REF ldpm_n_grd_ip_tq_drof_1 /end AXIS_DESCR
/end CHARACTERISTIC
/begin CHARACTERISTIC ip_tq_drof_slow_opm_2 "Torque for driving off assistance, basic value in operation mode 2" MAP 0xa0816860 _REC_MAP_20_u2_u2_u1 2047.96875 _CNV_A_R_LINEAR_____87_CM -1024. 1023.96875 DISPLAY_IDENTIFIER IP_TQ_DROF_SLOW_OPM_2 FORMAT "%6.2"
 /begin AXIS_DESCR COM_AXIS n_dif_drof _CNV_A_R_LINEAR_____193_CM 11 -32768. 32767. FORMAT "%6.0" AXIS_PTS_REF ldpm_n_dif_drof_ip_tq_drof_1 /end AXIS_DESCR
 /begin AXIS_DESCR COM_AXIS n_grd _CNV_A_R_LINEAR_____29_CM 10 -4096. 4064. FORMAT "%5.0" AXIS_PTS_REF ldpm_n_grd_ip_tq_drof_1 /end AXIS_DESCR
/end CHARACTERISTIC
/begin CHARACTERISTIC ip_tq_drof_fast_opm_1 "Torque for driving off assistance, basic value in operation mode 1" MAP 0xa08165cc _REC_MAP_20_u2_u2_u1 2047.96875 _CNV_A_R_LINEAR_____87_CM -1024. 1023.96875 DISPLAY_IDENTIFIER IP_TQ_DROF_FAST_OPM_1 FORMAT "%6.2"
 /begin AXIS_DESCR COM_AXIS n_dif_drof _CNV_A_R_LINEAR_____193_CM 11 -32768. 32767. FORMAT "%6.0" AXIS_PTS_REF ldpm_n_dif_drof_ip_tq_drof_1 /end AXIS_DESCR
 /begin AXIS_DESCR COM_AXIS n_grd _CNV_A_R_LINEAR_____29_CM 10 -4096. 4064. FORMAT "%5.0" AXIS_PTS_REF ldpm_n_grd_ip_tq_drof_1 /end AXIS_DESCR
/end CHARACTERISTIC
/begin CHARACTERISTIC ip_tq_drof_fast_opm_2 "Torque for driving off assistance, basic value in operation mode 2" MAP 0xa08166a8 _REC_MAP_20_u2_u2_u1 2047.96875 _CNV_A_R_LINEAR_____87_CM -1024. 1023.96875 DISPLAY_IDENTIFIER IP_TQ_DROF_FAST_OPM_2 FORMAT "%6.2"
 /begin AXIS_DESCR COM_AXIS n_dif_drof _CNV_A_R_LINEAR_____193_CM 11 -32768. 32767. FORMAT "%6.0" AXIS_PTS_REF ldpm_n_dif_drof_ip_tq_drof_1 /end AXIS_DESCR
 /begin AXIS_DESCR COM_AXIS n_grd _CNV_A_R_LINEAR_____29_CM 10 -4096. 4064. FORMAT "%5.0" AXIS_PTS_REF ldpm_n_grd_ip_tq_drof_1 /end AXIS_DESCR
/end CHARACTERISTIC
/begin AXIS_PTS ldp_vs_fil_ip_fac_tq_drof_vs_1 "" 0xa08092d4 vs_fil _REC_AXS_20_u2 511.99218 _CNV_A_R_LINEAR_____86_CM 6 0. 511.99218 FORMAT "%7.3" /end AXIS_PTS
/begin AXIS_PTS ldp_n_ip_fac_tq_drof_vs_1 "" 0xa0808b5c n _REC_AXS_20_u2 8160. _CNV_A_R_LINEAR_____14_CM 6 0. 8160. FORMAT "%4.0" /end AXIS_PTS
/begin CHARACTERISTIC ip_fac_tq_drof_vs_opm_1 "Weighing of IP_TQ_DROF dependant from engine and vehicle speed in operation mode 1" MAP 0xa0814764 _REC_MAP_20_u2_u2_u2 1.99996948242188 _CNV_A_R_LINEAR_____9_CM 0. 1.99996948242188 DISPLAY_IDENTIFIER IP_FAC_TQ_DROF_VS_OPM_1 FORMAT "%9.8"
 /begin AXIS_DESCR COM_AXIS vs_fil _CNV_A_R_LINEAR_____86_CM 6 0. 511.99218 FORMAT "%7.3" AXIS_PTS_REF ldp_vs_fil_ip_fac_tq_drof_vs_1 /end AXIS_DESCR
 /begin AXIS_DESCR COM_AXIS n _CNV_A_R_LINEAR_____14_CM 6 0. 8160. FORMAT "%4.0" AXIS_PTS_REF ldp_n_ip_fac_tq_drof_vs_1 /end AXIS_DESCR
/end CHARACTERISTIC
/begin CHARACTERISTIC ip_fac_tq_drof_vs_opm_2 "Weighing of IP_TQ_DROF dependant from engine and vehicle speed in operation mode 2" MAP 0xa08147ac _REC_MAP_20_u2_u2_u2 1.99996948242188 _CNV_A_R_LINEAR_____9_CM 0. 1.99996948242188 DISPLAY_IDENTIFIER IP_FAC_TQ_DROF_VS_OPM_2 FORMAT "%9.8"
 /begin AXIS_DESCR COM_AXIS vs_fil _CNV_A_R_LINEAR_____86_CM 6 0. 511.99218 FORMAT "%7.3" AXIS_PTS_REF ldp_vs_fil_ip_fac_tq_drof_vs_1 /end AXIS_DESCR
 /begin AXIS_DESCR COM_AXIS n _CNV_A_R_LINEAR_____14_CM 6 0. 8160. FORMAT "%4.0" AXIS_PTS_REF ldp_n_ip_fac_tq_drof_vs_1 /end AXIS_DESCR
/end CHARACTERISTIC
/begin AXIS_PTS ldp_tq_drof_grd_deac_1 "" 0xa0808f78 tq_drof_fast _REC_AXS_20_u2 1023.96875 _CNV_A_R_LINEAR_____31_CM 6 0. 1023.96875 FORMAT "%7.2" /end AXIS_PTS
/begin AXIS_PTS ldp_tq_drof_grd_deac_2 "" 0xa0808f88 tq_drof_fast _REC_AXS_20_u2 1023.96875 _CNV_A_R_LINEAR_____31_CM 6 0. 1023.96875 FORMAT "%7.2" /end AXIS_PTS
/begin CHARACTERISTIC ip_tq_drof_grd_deac_opm_1 "Decrement for the termination ramp of TQ_DROF_SLOW/_FAST in operation mode 1" CURVE 0xa080b730 _REC_CUR_20_u2_u2 1023.96875 _CNV_A_R_LINEAR_____31_CM 0. 1023.96875 DISPLAY_IDENTIFIER IP_TQ_DROF_GRD_DEAC_OPM_1 FORMAT "%7.2"
 /begin AXIS_DESCR COM_AXIS tq_drof_fast _CNV_A_R_LINEAR_____31_CM 6 0. 1023.96875 FORMAT "%7.2" AXIS_PTS_REF ldp_tq_drof_grd_deac_1 /end AXIS_DESCR
/end CHARACTERISTIC
/begin CHARACTERISTIC ip_tq_drof_grd_deac_opm_2 "Decrement for the termination ramp of TQ_DROF_SLOW/_FAST in operation mode 2" CURVE 0xa080b73c _REC_CUR_20_u2_u2 1023.96875 _CNV_A_R_LINEAR_____31_CM 0. 1023.96875 DISPLAY_IDENTIFIER IP_TQ_DROF_GRD_DEAC_OPM_2 FORMAT "%7.2"
 /begin AXIS_DESCR COM_AXIS tq_drof_fast _CNV_A_R_LINEAR_____31_CM 6 0. 1023.96875 FORMAT "%7.2" AXIS_PTS_REF ldp_tq_drof_grd_deac_2 /end AXIS_DESCR
/end CHARACTERISTIC
/begin CHARACTERISTIC lc_tq_add_pl_drof_ena_brake "Switch to select deactivation of drive off support TQ reserve by brake pedal; 0: deactivation when brake, 1: no deactivation when brake" VALUE 0xa080c604 _REC_VAL_20_u1 1. _CNV_A_R_LINEAR_____0_CM 0. 1. DISPLAY_IDENTIFIER LC_TQ_ADD_PL_DROF_ENA_BRAKE FORMAT "%2.0" /end CHARACTERISTIC
/begin CHARACTERISTIC c_tq_add_pl_drof_lgrd "Gradient limitation for drive off support TQ reserve" VALUE 0xa080c363 _REC_VAL_20_u1 7.96875 _CNV_A_R_LINEAR_____31_CM 0. 7.96875 DISPLAY_IDENTIFIER C_TQ_ADD_PL_DROF_LGRD FORMAT "%4.3" /end CHARACTERISTIC
/begin MEASUREMENT load_bat "DF-Monitor for accumulator charge in %" UBYTE _CNV_A_R_LINEAR_____5_CM 1 100. 0. 99.609375 DISPLAY_IDENTIFIER LOAD_BAT ECU_ADDRESS 0xd000877c /end MEASUREMENT
/begin MEASUREMENT state_cur_eng_cns "current consumption of engine" SWORD _CNV_A_R_LINEAR_____446_CM 1 100. -32768. 32767. DISPLAY_IDENTIFIER STATE_CUR_ENG_CNS ECU_ADDRESS 0xd000a334 FORMAT "%6.0" /end MEASUREMENT
/begin MEASUREMENT n_st_pow_mod "engine speed at start for power module" UBYTE _CNV_A_R_LINEAR_____10_CM 1 100. 0. 8160. DISPLAY_IDENTIFIER N_ST_POW_MOD ECU_ADDRESS 0xd000877f FORMAT "%4.0" /end MEASUREMENT
/begin MEASUREMENT lv_n_sp_is_pow_act "nominal idle speed setpoint by powermanagement" UBYTE _CNV_S_2_RANGE__0___1_CM 1 100. 0. 1. DISPLAY_IDENTIFIER LV_N_SP_IS_POW_ACT ECU_ADDRESS 0xd000878d BIT_MASK 0x1 /end MEASUREMENT
/begin MEASUREMENT state_alter "Status of alternator diagnosis" UBYTE _CNV_A_R_LINEAR_____0_CM 1 100. 0. 255. DISPLAY_IDENTIFIER STATE_ALTER ECU_ADDRESS 0xd0008781 FORMAT "%3.0" /end MEASUREMENT
/begin CHARACTERISTIC lc_pwsl_ena "Ultra-low-cost powermanagement enabled" VALUE 0xa080c5d8 _REC_VAL_20_u1 1. _CNV_S_2_RANGE__0___1_CM 0. 1. DISPLAY_IDENTIFIER LC_PWSL_ENA /end CHARACTERISTIC
/begin CHARACTERISTIC c_bat_psn "Position of battery in vehicle" VALUE 0xa080ba9c _REC_VAL_20_u1 255. _CNV_A_R_LINEAR_____0_CM 0. 255. DISPLAY_IDENTIFIER C_BAT_PSN FORMAT "%3.0" /end CHARACTERISTIC
/begin MEASUREMENT tq_loss_alter_1 "Torque losses by alternator" SWORD _CNV_A_R_LINEAR_____31_CM 1 100. -1024. 1023.96875 DISPLAY_IDENTIFIER TQ_LOSS_ALTER_1 ECU_ADDRESS 0xd000a338 FORMAT "%8.2" /end MEASUREMENT
/begin MEASUREMENT cur_alter_max "maximum current alternator" UBYTE _CNV_A_R_LINEAR_____446_CM 1 100. 0. 255. DISPLAY_IDENTIFIER CUR_ALTER_MAX ECU_ADDRESS 0xd0008783 FORMAT "%4.1" /end MEASUREMENT
/begin MEASUREMENT pow_rel_alter_clc "calculated DF-signal from alternator" UBYTE _CNV_A_R_LINEAR_____5_CM 1 100. 0. 99.609375 DISPLAY_IDENTIFIER POW_REL_ALTER_CLC ECU_ADDRESS 0xd0008784 /end MEASUREMENT
/begin MEASUREMENT temp_alter "temperature alternator (for environmental fault memory)" UBYTE _CNV_A_R_LINEAR_____17_CM 1 100. -48. 142.5 DISPLAY_IDENTIFIER TEMP_ALTER ECU_ADDRESS 0xd0008785 FORMAT "%6.2" /end MEASUREMENT
/begin MEASUREMENT vb_pow_mng "current battery voltage" UWORD _CNV_A_R_LINEAR_____447_CM 1 100. 0. 61.425 DISPLAY_IDENTIFIER VB_POW_MNG ECU_ADDRESS 0xd000a336 FORMAT "%7.3" /end MEASUREMENT
/begin MEASUREMENT cur_gen "alternator current" UBYTE _CNV_A_R_LINEAR_____446_CM 1 100. 0. 255. DISPLAY_IDENTIFIER CUR_GEN ECU_ADDRESS 0xd0008780 FORMAT "%4.1" /end MEASUREMENT
/begin MEASUREMENT lv_alter_swi_off "Logical variable indicating 'alternator switched off = 1'" UBYTE _CNV_S_2_RANGE__0___1_CM 1 100. 0. 1. DISPLAY_IDENTIFIER LV_ALTER_SWI_OFF ECU_ADDRESS 0xd000878e BIT_MASK 0x1 /end MEASUREMENT
/begin MEASUREMENT t_fil_cur_exct_alter "Calibratable filter time constant for  exciting current of the alternator (Powermanagement)" UBYTE _CNV_A_R_LINEAR_____3_CM 1 100. 0. 2.55 DISPLAY_IDENTIFIER T_FIL_CUR_EXCT_ALTER ECU_ADDRESS 0xd000878b FORMAT "%4.2" /end MEASUREMENT
/begin MEASUREMENT lv_n_sp_is_pwr_stab "request for idle speed setpoint due to power management request for power supply stability" UBYTE _CNV_S_2_RANGE__0___1_CM 1 100. 0. 1. DISPLAY_IDENTIFIER LV_N_SP_IS_PWR_STAB ECU_ADDRESS 0xd000878f /end MEASUREMENT
/begin MEASUREMENT n_alter "alternator speed" SWORD _CNV_A_R_LINEAR_____14_CM 1 100. -32768. 32767. DISPLAY_IDENTIFIER N_ALTER ECU_ADDRESS 0xd000a33e FORMAT "%6.0" /end MEASUREMENT
/begin MEASUREMENT lv_maf_ctl "MAF controlled system" UBYTE _CNV_S_2_RANGE__0___1_CM 1 100. 0. 1. DISPLAY_IDENTIFIER LV_MAF_CTL ECU_ADDRESS 0xd00088e0 BIT_MASK 0x1 /end MEASUREMENT
/begin MEASUREMENT n_sp_is_pow_1 "nominal idle speed setpoint by powermanagement" UWORD _CNV_A_R_LINEAR_____14_CM 1 100. 0. 8160. DISPLAY_IDENTIFIER N_SP_IS_POW_1 ECU_ADDRESS 0xd000a150 FORMAT "%4.0" /end MEASUREMENT
/begin CHARACTERISTIC c_maf_ref "reference air mass flow for rl" VALUE 0xa080be4a _REC_VAL_20_u2 1389. _CNV_A_R_LINEAR_____111_CM 0. 1389. DISPLAY_IDENTIFIER C_MAF_REF FORMAT "%7.2" /end CHARACTERISTIC
/begin CHARACTERISTIC c_mff_sp_1_homs_man "Fuel mass setpoint for the first pulse in homogeneous-s mode (manual adjustment)" VALUE 0xa080be98 _REC_VAL_20_u2 1389. _CNV_A_R_LINEAR_____111_CM 0. 1389. DISPLAY_IDENTIFIER C_MFF_SP_1_HOMS_MAN FORMAT "%7.2" /end CHARACTERISTIC
/begin CHARACTERISTIC c_mff_sp_2_homs_man "Fuel mass setpoint for the second pulse in homogeneous-s mode (manual adjustment)" VALUE 0xa080be9e _REC_VAL_20_u2 1389. _CNV_A_R_LINEAR_____111_CM 0. 1389. DISPLAY_IDENTIFIER C_MFF_SP_2_HOMS_MAN FORMAT "%7.2" /end CHARACTERISTIC
/begin CHARACTERISTIC lc_mff_sp_homs_man_act "Switch for manual homogeneus-s mode active" VALUE 0xa080c5b1 _REC_VAL_20_u1 1. _CNV_S_2_RANGE__0___1_CM 0. 1. DISPLAY_IDENTIFIER LC_MFF_SP_HOMS_MAN_ACT /end CHARACTERISTIC
/begin CHARACTERISTIC lc_fac_s_cor_man "Manual switch to enable additive compensation of third injection pulse per calibration constant" VALUE 0xa080c56f _REC_VAL_20_u1 1. _CNV_S_2_RANGE__0___1_CM 0. 1. DISPLAY_IDENTIFIER LC_FAC_S_COR_MAN /end CHARACTERISTIC
/begin CHARACTERISTIC c_fac_3_s_cor "Constant defining how quantitatively the additive adaptation value shall be used in the third injection pulse " VALUE 0xa080bcac _REC_VAL_20_u2 0.9999847412109381 _CNV_A_R_LINEAR_____89_CM 0. 0.9999847412109381 DISPLAY_IDENTIFIER C_FAC_3_S_COR FORMAT "%7.5" /end CHARACTERISTIC
/begin CHARACTERISTIC c_add_pulse_ena "Constant for enabling additional pulses in case of injection time update at transient conditions, homogeneous mode (0 = disable, 1 = enable, 2 = enable at start end)" VALUE 0xa080ba80 _REC_VAL_20_u1 2. _CNV_A_R_LINEAR_____0_CM 0. 2. DISPLAY_IDENTIFIER C_ADD_PULSE_ENA FORMAT "%1.0" /end CHARACTERISTIC
/begin CHARACTERISTIC c_t_nox_sens_nox_hld "max. time of hold the last valid NOx signal value" VALUE 0xa0807a60 _REC_VAL_20_u2 655.35 _CNV_A_R_LINEAR_____3_CM 0. 655.35 DISPLAY_IDENTIFIER C_T_NOX_SENS_NOX_HLD FORMAT "%6.2" /end CHARACTERISTIC
/begin CHARACTERISTIC c_t_nox_sens_nox_auth "min. time of full NOx sensor readiness to set the NOx signal authorisation bit" VALUE 0xa0807a5e _REC_VAL_20_u2 655.35 _CNV_A_R_LINEAR_____3_CM 0. 655.35 DISPLAY_IDENTIFIER C_T_NOX_SENS_NOX_AUTH FORMAT "%6.2" /end CHARACTERISTIC
/begin CHARACTERISTIC c_t_nox_sens_nox_mdl "min. NOx signal \"valid\" time for set of model \"valid\" bit" VALUE 0xa0807a62 _REC_VAL_20_u2 655.35 _CNV_A_R_LINEAR_____3_CM 0. 655.35 DISPLAY_IDENTIFIER C_T_NOX_SENS_NOX_MDL FORMAT "%6.2" /end CHARACTERISTIC
/begin CHARACTERISTIC c_crlc_nox_nox_sens "Correlation constant for 1st NOx signal filter" VALUE 0xa0807a1e _REC_VAL_20_u2 0.9999847412109381 _CNV_A_R_LINEAR_____89_CM 0. 0.9999847412109381 DISPLAY_IDENTIFIER C_CRLC_NOX_NOX_SENS FORMAT "%7.5" /end CHARACTERISTIC
/begin CHARACTERISTIC c_crlc_nox_nox_sens_diag "Correlation constant for 2nd NOx signal filter" VALUE 0xa0807a20 _REC_VAL_20_u2 0.9999847412109381 _CNV_A_R_LINEAR_____89_CM 0. 0.9999847412109381 DISPLAY_IDENTIFIER C_CRLC_NOX_NOX_SENS_DIAG FORMAT "%7.5" /end CHARACTERISTIC
/begin CHARACTERISTIC c_t_nox_sens_lamb_hld "max. time of hold the last valid lambda signal value" VALUE 0xa0807a5c _REC_VAL_20_u2 655.35 _CNV_A_R_LINEAR_____3_CM 0. 655.35 DISPLAY_IDENTIFIER C_T_NOX_SENS_LAMB_HLD FORMAT "%6.2" /end CHARACTERISTIC
/begin CHARACTERISTIC c_t_nox_sens_vls_hld "max. time of hold the last valid binary O2 signal value" VALUE 0xa0807a68 _REC_VAL_20_u2 655.35 _CNV_A_R_LINEAR_____3_CM 0. 655.35 DISPLAY_IDENTIFIER C_T_NOX_SENS_VLS_HLD FORMAT "%6.2" /end CHARACTERISTIC
/begin CHARACTERISTIC c_t_nox_sens_pwr_hld "debounce time for NOx sensor power supply failures" VALUE 0xa0807a64 _REC_VAL_20_u2 655.35 _CNV_A_R_LINEAR_____3_CM 0. 655.35 DISPLAY_IDENTIFIER C_T_NOX_SENS_PWR_HLD FORMAT "%6.2" /end CHARACTERISTIC
/begin CHARACTERISTIC c_t_nox_sens_lamb_auth "minimum time of Lambda signal readiness to set the authorization bit" VALUE 0xa0807a5a _REC_VAL_20_u2 655.35 _CNV_A_R_LINEAR_____3_CM 0. 655.35 DISPLAY_IDENTIFIER C_T_NOX_SENS_LAMB_AUTH FORMAT "%6.2" /end CHARACTERISTIC
/begin CHARACTERISTIC c_t_nox_sens_vls_auth "minimum time of binary O2 signal readiness to set the authorisation bit" VALUE 0xa0807a66 _REC_VAL_20_u2 655.35 _CNV_A_R_LINEAR_____3_CM 0. 655.35 DISPLAY_IDENTIFIER C_T_NOX_SENS_VLS_AUTH FORMAT "%6.2" /end CHARACTERISTIC
/begin MEASUREMENT nox_nox_sens_diag[0] "NOx concentration value for diagnosis function, measured by NOx-sensor" SWORD _CNV_A_R_NOXD_LINEA_486_CM 1 100. -100. 1500. DISPLAY_IDENTIFIER NOX_NOX_SENS_DIAG[1] ECU_ADDRESS 0xd00071a8 FORMAT "%4.0" /end MEASUREMENT
/begin MEASUREMENT nox_nox_sens_diag[1] "NOx concentration value for diagnosis function, measured by NOx-sensor" SWORD _CNV_A_R_NOXD_LINEA_486_CM 1 100. -100. 1500. DISPLAY_IDENTIFIER NOX_NOX_SENS_DIAG[2] ECU_ADDRESS 0xd00071aa FORMAT "%4.0" /end MEASUREMENT
/begin MEASUREMENT err_ns[0] "NOx sensor failure byte" UBYTE _CNV_A_R_LINEAR_____0_CM 1 100. 0. 255. DISPLAY_IDENTIFIER err_nox_sens[1] ECU_ADDRESS 0xd0007710 FORMAT "%3.0" /end MEASUREMENT
/begin MEASUREMENT err_ns[1] "NOx sensor failure byte" UBYTE _CNV_A_R_LINEAR_____0_CM 1 100. 0. 255. DISPLAY_IDENTIFIER err_nox_sens[2] ECU_ADDRESS 0xd0007711 FORMAT "%3.0" /end MEASUREMENT
/begin MEASUREMENT lv_nox_sens_nox_diag_vld[0] "indicator that the NOx signal is valid for use into the diagnosis functions" UBYTE _CNV_S_2_RANGE__0___1_CM 1 100. 0. 1. DISPLAY_IDENTIFIER LV_NOX_SENS_NOX_DIAG_VLD[1] ECU_ADDRESS 0xd000771e BIT_MASK 0x1 /end MEASUREMENT
/begin MEASUREMENT lv_nox_sens_nox_diag_vld[1] "indicator that the NOx signal is valid for use into the diagnosis functions" UBYTE _CNV_S_2_RANGE__0___1_CM 1 100. 0. 1. DISPLAY_IDENTIFIER LV_NOX_SENS_NOX_DIAG_VLD[2] ECU_ADDRESS 0xd000771f BIT_MASK 0x1 /end MEASUREMENT
/begin MEASUREMENT nox_nox_sens[0] "NOx concentration value, measured by NOx-sensor" SWORD _CNV_A_R_NOXD_LINEA_486_CM 1 100. -100. 1500. DISPLAY_IDENTIFIER NOX_NOX_SENS[1] ECU_ADDRESS 0xd00071a4 FORMAT "%4.0" /end MEASUREMENT
/begin MEASUREMENT nox_nox_sens[1] "NOx concentration value, measured by NOx-sensor" SWORD _CNV_A_R_NOXD_LINEA_486_CM 1 100. -100. 1500. DISPLAY_IDENTIFIER NOX_NOX_SENS[2] ECU_ADDRESS 0xd00071a6 FORMAT "%4.0" /end MEASUREMENT
/begin MEASUREMENT lv_nox_sens_nox_vld[0] "indicator that the NOx signal is valid" UBYTE _CNV_S_2_RANGE__0___1_CM 1 100. 0. 1. DISPLAY_IDENTIFIER LV_NOX_SENS_NOX_VLD[1] ECU_ADDRESS 0xd0007722 BIT_MASK 0x1 /end MEASUREMENT
/begin MEASUREMENT lv_nox_sens_nox_vld[1] "indicator that the NOx signal is valid" UBYTE _CNV_S_2_RANGE__0___1_CM 1 100. 0. 1. DISPLAY_IDENTIFIER LV_NOX_SENS_NOX_VLD[2] ECU_ADDRESS 0xd0007723 BIT_MASK 0x1 /end MEASUREMENT
/begin MEASUREMENT lv_nox_sens_vls_auth[0] "indicator that the binary O2 signal has reached the valid state after start" UBYTE _CNV_S_2_RANGE__0___1_CM 1 100. 0. 1. DISPLAY_IDENTIFIER LV_NOX_SENS_VLS_AUTH[1] ECU_ADDRESS 0xd0007724 BIT_MASK 0x1 /end MEASUREMENT
/begin MEASUREMENT lv_nox_sens_vls_auth[1] "indicator that the binary O2 signal has reached the valid state after start" UBYTE _CNV_S_2_RANGE__0___1_CM 1 100. 0. 1. DISPLAY_IDENTIFIER LV_NOX_SENS_VLS_AUTH[2] ECU_ADDRESS 0xd0007725 BIT_MASK 0x1 /end MEASUREMENT
/begin MEASUREMENT lv_nox_sens_nox_auth[0] "indicator that the NOx signal has been reached the valid state after the start" UBYTE _CNV_S_2_RANGE__0___1_CM 1 100. 0. 1. DISPLAY_IDENTIFIER LV_NOX_SENS_NOX_AUTH[1] ECU_ADDRESS 0xd000771c BIT_MASK 0x1 /end MEASUREMENT
/begin MEASUREMENT lv_nox_sens_nox_auth[1] "indicator that the NOx signal has been reached the valid state after the start" UBYTE _CNV_S_2_RANGE__0___1_CM 1 100. 0. 1. DISPLAY_IDENTIFIER LV_NOX_SENS_NOX_AUTH[2] ECU_ADDRESS 0xd000771d BIT_MASK 0x1 /end MEASUREMENT
/begin MEASUREMENT t_nox_sens_nox_hld[0] "timer for hold of last valid NOx signal value" UWORD _CNV_A_R_LINEAR_____3_CM 1 100. 0. 655.35 DISPLAY_IDENTIFIER T_NOX_SENS_NOX_HLD[1] ECU_ADDRESS 0xd00071c4 FORMAT "%6.2" /end MEASUREMENT
/begin MEASUREMENT t_nox_sens_nox_hld[1] "timer for hold of last valid NOx signal value" UWORD _CNV_A_R_LINEAR_____3_CM 1 100. 0. 655.35 DISPLAY_IDENTIFIER T_NOX_SENS_NOX_HLD[2] ECU_ADDRESS 0xd00071c6 FORMAT "%6.2" /end MEASUREMENT
/begin MEASUREMENT lv_nox_sens_nox_mdl_vld[0] "indicator that the NOx signal is valid for use. The state \"valid\" is debounced presently." UBYTE _CNV_S_2_RANGE__0___1_CM 1 100. 0. 1. DISPLAY_IDENTIFIER LV_NOX_SENS_NOX_MDL_VLD[1] ECU_ADDRESS 0xd0007720 BIT_MASK 0x1 /end MEASUREMENT
/begin MEASUREMENT lv_nox_sens_nox_mdl_vld[1] "indicator that the NOx signal is valid for use. The state \"valid\" is debounced presently." UBYTE _CNV_S_2_RANGE__0___1_CM 1 100. 0. 1. DISPLAY_IDENTIFIER LV_NOX_SENS_NOX_MDL_VLD[2] ECU_ADDRESS 0xd0007721 BIT_MASK 0x1 /end MEASUREMENT
/begin MEASUREMENT t_nox_sens_nox_mdl[0] "timer for debounce of signal state \"valid\" after re-entry into state \"valid\"" UWORD _CNV_A_R_LINEAR_____3_CM 1 100. 0. 655.35 DISPLAY_IDENTIFIER T_NOX_SENS_NOX_MDL[1] ECU_ADDRESS 0xd00071c8 FORMAT "%6.2" /end MEASUREMENT
/begin MEASUREMENT t_nox_sens_nox_mdl[1] "timer for debounce of signal state \"valid\" after re-entry into state \"valid\"" UWORD _CNV_A_R_LINEAR_____3_CM 1 100. 0. 655.35 DISPLAY_IDENTIFIER T_NOX_SENS_NOX_MDL[2] ECU_ADDRESS 0xd00071ca FORMAT "%6.2" /end MEASUREMENT
/begin CHARACTERISTIC lc_nox_sens_nox_man[0] "manual setting of NOx concentration value on/off" VALUE 0xa0807a7e _REC_VAL_20_u1 1. _CNV_A_R_LINEAR_____0_CM 0. 1. DISPLAY_IDENTIFIER LC_NOX_SENS_NOX_MAN[1] FORMAT "%1.0" /end CHARACTERISTIC
/begin CHARACTERISTIC lc_nox_sens_nox_man[1] "manual setting of NOx concentration value on/off" VALUE 0xa0807a7f _REC_VAL_20_u1 1. _CNV_A_R_LINEAR_____0_CM 0. 1. DISPLAY_IDENTIFIER LC_NOX_SENS_NOX_MAN[2] FORMAT "%1.0" /end CHARACTERISTIC
/begin CHARACTERISTIC c_nox_nox_sens[0] "manual NOx concentration value" VALUE 0xa0807a38 _REC_VAL_20_s2 1600. _CNV_A_R_NOXD_LINEA_486_CM -100. 1500. DISPLAY_IDENTIFIER C_NOX_NOX_SENS[1] FORMAT "%4.0" /end CHARACTERISTIC
/begin CHARACTERISTIC c_nox_nox_sens[1] "manual NOx concentration value" VALUE 0xa0807a3a _REC_VAL_20_s2 1600. _CNV_A_R_NOXD_LINEA_486_CM -100. 1500. DISPLAY_IDENTIFIER C_NOX_NOX_SENS[2] FORMAT "%4.0" /end CHARACTERISTIC
/begin CHARACTERISTIC lc_nox_sens_nox_vld[0] "permanently authorisation NOx signal on/off" VALUE 0xa0807a80 _REC_VAL_20_u1 1. _CNV_A_R_LINEAR_____0_CM 0. 1. DISPLAY_IDENTIFIER LC_NOX_SENS_NOX_VLD[1] FORMAT "%1.0" /end CHARACTERISTIC
/begin CHARACTERISTIC lc_nox_sens_nox_vld[1] "permanently authorisation NOx signal on/off" VALUE 0xa0807a81 _REC_VAL_20_u1 1. _CNV_A_R_LINEAR_____0_CM 0. 1. DISPLAY_IDENTIFIER LC_NOX_SENS_NOX_VLD[2] FORMAT "%1.0" /end CHARACTERISTIC
/begin MEASUREMENT lamb_nox_sens_diag[0] "lambda value for diagnosis functions, measured by NOx-sensor" UWORD _CNV_A_R_LINEAR_____129_CM 1 100. 0. 31.9990234375 DISPLAY_IDENTIFIER LAMB_NOX_SENS_DIAG[1] ECU_ADDRESS 0xd00071a0 FORMAT "%7.4" /end MEASUREMENT
/begin MEASUREMENT lamb_nox_sens_diag[1] "lambda value for diagnosis functions, measured by NOx-sensor" UWORD _CNV_A_R_LINEAR_____129_CM 1 100. 0. 31.9990234375 DISPLAY_IDENTIFIER LAMB_NOX_SENS_DIAG[2] ECU_ADDRESS 0xd00071a2 FORMAT "%7.4" /end MEASUREMENT
/begin MEASUREMENT lv_nox_sens_lamb_diag_vld[0] "indicator that the lambda signal is valid for use into the diagnosis functions" UBYTE _CNV_S_2_RANGE__0___1_CM 1 100. 0. 1. DISPLAY_IDENTIFIER LV_NOX_SENS_LAMB_DIAG_VLD[1] ECU_ADDRESS 0xd0007718 BIT_MASK 0x1 /end MEASUREMENT
/begin MEASUREMENT lv_nox_sens_lamb_diag_vld[1] "indicator that the lambda signal is valid for use into the diagnosis functions" UBYTE _CNV_S_2_RANGE__0___1_CM 1 100. 0. 1. DISPLAY_IDENTIFIER LV_NOX_SENS_LAMB_DIAG_VLD[2] ECU_ADDRESS 0xd0007719 BIT_MASK 0x1 /end MEASUREMENT
/begin MEASUREMENT lamb_nox_sens[0] "lambda value, measured by NOx-sensor" UWORD _CNV_A_R_LINEAR_____129_CM 1 100. 0. 31.9990234375 DISPLAY_IDENTIFIER LAMB_NOX_SENS[1] ECU_ADDRESS 0xd000719c FORMAT "%7.4" /end MEASUREMENT
/begin MEASUREMENT lamb_nox_sens[1] "lambda value, measured by NOx-sensor" UWORD _CNV_A_R_LINEAR_____129_CM 1 100. 0. 31.9990234375 DISPLAY_IDENTIFIER LAMB_NOX_SENS[2] ECU_ADDRESS 0xd000719e FORMAT "%7.4" /end MEASUREMENT
/begin MEASUREMENT lv_nox_sens_lamb_vld[0] "indicator that the lambda signal is valid" UBYTE _CNV_S_2_RANGE__0___1_CM 1 100. 0. 1. DISPLAY_IDENTIFIER LV_NOX_SENS_LAMB_VLD[1] ECU_ADDRESS 0xd000771a BIT_MASK 0x1 /end MEASUREMENT
/begin MEASUREMENT lv_nox_sens_lamb_vld[1] "indicator that the lambda signal is valid" UBYTE _CNV_S_2_RANGE__0___1_CM 1 100. 0. 1. DISPLAY_IDENTIFIER LV_NOX_SENS_LAMB_VLD[2] ECU_ADDRESS 0xd000771b BIT_MASK 0x1 /end MEASUREMENT
/begin MEASUREMENT lv_nox_sens_lamb_auth[0] "indicator that the lambda signal has reached the valid state after start" UBYTE _CNV_S_2_RANGE__0___1_CM 1 100. 0. 1. DISPLAY_IDENTIFIER LV_NOX_SENS_LAMB_AUTH[1] ECU_ADDRESS 0xd0007716 BIT_MASK 0x1 /end MEASUREMENT
/begin MEASUREMENT lv_nox_sens_lamb_auth[1] "indicator that the lambda signal has reached the valid state after start" UBYTE _CNV_S_2_RANGE__0___1_CM 1 100. 0. 1. DISPLAY_IDENTIFIER LV_NOX_SENS_LAMB_AUTH[2] ECU_ADDRESS 0xd0007717 BIT_MASK 0x1 /end MEASUREMENT
/begin MEASUREMENT t_nox_sens_lamb_hld[0] "timer for hold of last valid lambda signal value" UWORD _CNV_A_R_LINEAR_____3_CM 1 100. 0. 655.35 DISPLAY_IDENTIFIER T_NOX_SENS_LAMB_HLD[1] ECU_ADDRESS 0xd00071c0 FORMAT "%6.2" /end MEASUREMENT
/begin MEASUREMENT t_nox_sens_lamb_hld[1] "timer for hold of last valid lambda signal value" UWORD _CNV_A_R_LINEAR_____3_CM 1 100. 0. 655.35 DISPLAY_IDENTIFIER T_NOX_SENS_LAMB_HLD[2] ECU_ADDRESS 0xd00071c2 FORMAT "%6.2" /end MEASUREMENT
/begin CHARACTERISTIC lc_nox_sens_lamb_man[0] "manual setting of lambda value on/off" VALUE 0xa0807a7a _REC_VAL_20_u1 1. _CNV_A_R_LINEAR_____0_CM 0. 1. DISPLAY_IDENTIFIER LC_NOX_SENS_LAMB_MAN[1] FORMAT "%1.0" /end CHARACTERISTIC
/begin CHARACTERISTIC lc_nox_sens_lamb_man[1] "manual setting of lambda value on/off" VALUE 0xa0807a7b _REC_VAL_20_u1 1. _CNV_A_R_LINEAR_____0_CM 0. 1. DISPLAY_IDENTIFIER LC_NOX_SENS_LAMB_MAN[2] FORMAT "%1.0" /end CHARACTERISTIC
/begin CHARACTERISTIC c_lamb_nox_sens[0] "manual lambda value" VALUE 0xa0807a2a _REC_VAL_20_u2 31.9990234375 _CNV_A_R_LINEAR_____129_CM 0. 31.9990234375 DISPLAY_IDENTIFIER C_LAMB_NOX_SENS[1] FORMAT "%7.4" /end CHARACTERISTIC
/begin CHARACTERISTIC c_lamb_nox_sens[1] "manual lambda value" VALUE 0xa0807a2c _REC_VAL_20_u2 31.9990234375 _CNV_A_R_LINEAR_____129_CM 0. 31.9990234375 DISPLAY_IDENTIFIER C_LAMB_NOX_SENS[2] FORMAT "%7.4" /end CHARACTERISTIC
/begin CHARACTERISTIC lc_nox_sens_lamb_vld[0] "permanently authorisation lambda signal on/off" VALUE 0xa0807a7c _REC_VAL_20_u1 1. _CNV_A_R_LINEAR_____0_CM 0. 1. DISPLAY_IDENTIFIER LC_NOX_SENS_LAMB_VLD[1] FORMAT "%1.0" /end CHARACTERISTIC
/begin CHARACTERISTIC lc_nox_sens_lamb_vld[1] "permanently authorisation lambda signal on/off" VALUE 0xa0807a7d _REC_VAL_20_u1 1. _CNV_A_R_LINEAR_____0_CM 0. 1. DISPLAY_IDENTIFIER LC_NOX_SENS_LAMB_VLD[2] FORMAT "%1.0" /end CHARACTERISTIC
/begin MEASUREMENT vls_nox_sens_diag[0] "binary O2 signal voltage for diagnosis functions, raw value, measured by NOx-sensor" UWORD _CNV_A_R_LINEAR_____219_CM 1 100. -200. 1200. DISPLAY_IDENTIFIER VLS_NOX_SENS_DIAG[1] ECU_ADDRESS 0xd00071d4 FORMAT "%4.0" /end MEASUREMENT
/begin MEASUREMENT vls_nox_sens_diag[1] "binary O2 signal voltage for diagnosis functions, raw value, measured by NOx-sensor" UWORD _CNV_A_R_LINEAR_____219_CM 1 100. -200. 1200. DISPLAY_IDENTIFIER VLS_NOX_SENS_DIAG[2] ECU_ADDRESS 0xd00071d6 FORMAT "%4.0" /end MEASUREMENT
/begin MEASUREMENT lv_nox_sens_vls_diag_vld[0] "indicator that the binary O2 signal is valid for use in the diagnosis functions" UBYTE _CNV_S_2_RANGE__0___1_CM 1 100. 0. 1. DISPLAY_IDENTIFIER LV_NOX_SENS_VLS_DIAG_VLD[1] ECU_ADDRESS 0xd0007726 BIT_MASK 0x1 /end MEASUREMENT
/begin MEASUREMENT lv_nox_sens_vls_diag_vld[1] "indicator that the binary O2 signal is valid for use in the diagnosis functions" UBYTE _CNV_S_2_RANGE__0___1_CM 1 100. 0. 1. DISPLAY_IDENTIFIER LV_NOX_SENS_VLS_DIAG_VLD[2] ECU_ADDRESS 0xd0007727 BIT_MASK 0x1 /end MEASUREMENT
/begin MEASUREMENT vls_nox_sens[0] "binary O2 signal voltage, raw value, measured by NOx-sensor" UWORD _CNV_A_R_LINEAR_____219_CM 1 100. -200. 1200. DISPLAY_IDENTIFIER VLS_NOX_SENS[1] ECU_ADDRESS 0xd00071d0 FORMAT "%4.0" /end MEASUREMENT
/begin MEASUREMENT vls_nox_sens[1] "binary O2 signal voltage, raw value, measured by NOx-sensor" UWORD _CNV_A_R_LINEAR_____219_CM 1 100. -200. 1200. DISPLAY_IDENTIFIER VLS_NOX_SENS[2] ECU_ADDRESS 0xd00071d2 FORMAT "%4.0" /end MEASUREMENT
/begin MEASUREMENT lv_nox_sens_vls_vld[0] "indicator that the binary O2 signal is valid" UBYTE _CNV_S_2_RANGE__0___1_CM 1 100. 0. 1. DISPLAY_IDENTIFIER LV_NOX_SENS_VLS_VLD[1] ECU_ADDRESS 0xd0007728 BIT_MASK 0x1 /end MEASUREMENT
/begin MEASUREMENT lv_nox_sens_vls_vld[1] "indicator that the binary O2 signal is valid" UBYTE _CNV_S_2_RANGE__0___1_CM 1 100. 0. 1. DISPLAY_IDENTIFIER LV_NOX_SENS_VLS_VLD[2] ECU_ADDRESS 0xd0007729 BIT_MASK 0x1 /end MEASUREMENT
/begin MEASUREMENT t_nox_sens_vls_hld[0] "timer for hold of last valid binary O2 signal value" UWORD _CNV_A_R_LINEAR_____3_CM 1 100. 0. 655.35 DISPLAY_IDENTIFIER T_NOX_SENS_VLS_HLD[1] ECU_ADDRESS 0xd00071cc FORMAT "%6.2" /end MEASUREMENT
/begin MEASUREMENT t_nox_sens_vls_hld[1] "timer for hold of last valid binary O2 signal value" UWORD _CNV_A_R_LINEAR_____3_CM 1 100. 0. 655.35 DISPLAY_IDENTIFIER T_NOX_SENS_VLS_HLD[2] ECU_ADDRESS 0xd00071ce FORMAT "%6.2" /end MEASUREMENT
/begin CHARACTERISTIC lc_nox_sens_vls_man[0] "manual setting of binary O2 value on/off" VALUE 0xa0807a82 _REC_VAL_20_u1 1. _CNV_A_R_LINEAR_____0_CM 0. 1. DISPLAY_IDENTIFIER LC_NOX_SENS_VLS_MAN[1] FORMAT "%1.0" /end CHARACTERISTIC
/begin CHARACTERISTIC lc_nox_sens_vls_man[1] "manual setting of binary O2 value on/off" VALUE 0xa0807a83 _REC_VAL_20_u1 1. _CNV_A_R_LINEAR_____0_CM 0. 1. DISPLAY_IDENTIFIER LC_NOX_SENS_VLS_MAN[2] FORMAT "%1.0" /end CHARACTERISTIC
/begin CHARACTERISTIC c_vls_nox_sens[0] "manual binary O2 value" VALUE 0xa0807a72 _REC_VAL_20_u2 1400. _CNV_A_R_LINEAR_____219_CM -200. 1200. DISPLAY_IDENTIFIER C_VLS_NOX_SENS[1] FORMAT "%4.0" /end CHARACTERISTIC
/begin CHARACTERISTIC c_vls_nox_sens[1] "manual binary O2 value" VALUE 0xa0807a74 _REC_VAL_20_u2 1400. _CNV_A_R_LINEAR_____219_CM -200. 1200. DISPLAY_IDENTIFIER C_VLS_NOX_SENS[2] FORMAT "%4.0" /end CHARACTERISTIC
/begin CHARACTERISTIC lc_nox_sens_vls_vld[0] "permanently authorisation binary O2 signal on/off" VALUE 0xa0807a84 _REC_VAL_20_u1 1. _CNV_A_R_LINEAR_____0_CM 0. 1. DISPLAY_IDENTIFIER LC_NOX_SENS_VLS_VLD[1] FORMAT "%1.0" /end CHARACTERISTIC
/begin CHARACTERISTIC lc_nox_sens_vls_vld[1] "permanently authorisation binary O2 signal on/off" VALUE 0xa0807a85 _REC_VAL_20_u1 1. _CNV_A_R_LINEAR_____0_CM 0. 1. DISPLAY_IDENTIFIER LC_NOX_SENS_VLS_VLD[2] FORMAT "%1.0" /end CHARACTERISTIC
/begin CHARACTERISTIC lc_nox_sens_err_man[0] "manual setting of error byte on/off" VALUE 0xa0807a78 _REC_VAL_20_u1 1. _CNV_A_R_LINEAR_____0_CM 0. 1. DISPLAY_IDENTIFIER LC_NOX_SENS_ERR_MAN[0] FORMAT "%1.0" /end CHARACTERISTIC
/begin CHARACTERISTIC lc_nox_sens_err_man[1] "manual setting of error byte on/off" VALUE 0xa0807a79 _REC_VAL_20_u1 1. _CNV_A_R_LINEAR_____0_CM 0. 1. DISPLAY_IDENTIFIER LC_NOX_SENS_ERR_MAN[1] FORMAT "%1.0" /end CHARACTERISTIC
/begin CHARACTERISTIC c_err_nox_sens[0] "manual value for error byte" VALUE 0xa0807a28 _REC_VAL_20_u1 255. _CNV_A_R_LINEAR_____0_CM 0. 255. DISPLAY_IDENTIFIER C_ERR_NOX_SENS[1] FORMAT "%3.0" /end CHARACTERISTIC
/begin CHARACTERISTIC c_err_nox_sens[1] "manual value for error byte" VALUE 0xa0807a29 _REC_VAL_20_u1 255. _CNV_A_R_LINEAR_____0_CM 0. 255. DISPLAY_IDENTIFIER C_ERR_NOX_SENS[2] FORMAT "%3.0" /end CHARACTERISTIC
/begin MEASUREMENT nox_sens_temp[0] "Indicator for state of  sensor heater management" UBYTE _CNV_A_R_LINEAR_____0_CM 1 100. 0. 3. DISPLAY_IDENTIFIER NOX_SENS_TEMP[1] ECU_ADDRESS 0xd0007712 FORMAT "%1.0" /end MEASUREMENT
/begin MEASUREMENT nox_sens_temp[1] "Indicator for state of  sensor heater management" UBYTE _CNV_A_R_LINEAR_____0_CM 1 100. 0. 3. DISPLAY_IDENTIFIER NOX_SENS_TEMP[2] ECU_ADDRESS 0xd0007713 FORMAT "%1.0" /end MEASUREMENT
/begin MEASUREMENT t_nox_sens_pwr[0] "timer for debounce of NOx sensor power supply failures" UWORD _CNV_A_R_LINEAR_____3_CM 1 100. 0. 655.35 DISPLAY_IDENTIFIER T_NOX_SENS_PWR[1] ECU_ADDRESS 0xd0003658 FORMAT "%6.2" /end MEASUREMENT
/begin MEASUREMENT t_nox_sens_pwr[1] "timer for debounce of NOx sensor power supply failures" UWORD _CNV_A_R_LINEAR_____3_CM 1 100. 0. 655.35 DISPLAY_IDENTIFIER T_NOX_SENS_PWR[2] ECU_ADDRESS 0xd000365a FORMAT "%6.2" /end MEASUREMENT
/begin CHARACTERISTIC lc_nox_sens_2 "NOx sensor for exhaust line-2 exists" VALUE 0xa080c5c6 _REC_VAL_20_u1 1. _CNV_A_R_LINEAR_____0_CM 0. 1. DISPLAY_IDENTIFIER LC_NOX_SENS_2 FORMAT "%2.0" /end CHARACTERISTIC
/begin MEASUREMENT can_nox_nox_sens[0] "NOx concentration value, measured by NOx-Sensor" SWORD _CNV_A_R_NOXD_LINEA_486_CM 1 100. -100. 1500. DISPLAY_IDENTIFIER CAN_NOX_NOX_SENS[1] ECU_ADDRESS 0xd000a0cc FORMAT "%4.0" /end MEASUREMENT
/begin MEASUREMENT can_nox_nox_sens[1] "NOx concentration value, measured by NOx-Sensor" SWORD _CNV_A_R_NOXD_LINEA_486_CM 1 100. -100. 1500. DISPLAY_IDENTIFIER CAN_NOX_NOX_SENS[2] ECU_ADDRESS 0xd000a0ce FORMAT "%4.0" /end MEASUREMENT
/begin MEASUREMENT can_lamb_nox_sens[0] "Lambda value as measured by NOx-Sensor" UWORD _CNV_A_R_LINEAR_____0_CM 1 100. 0. 1540. DISPLAY_IDENTIFIER CAN_LAMB_NOX_SENS[1] ECU_ADDRESS 0xd000a0d0 FORMAT "%4.0" /end MEASUREMENT
/begin MEASUREMENT can_lamb_nox_sens[1] "Lambda value as measured by NOx-Sensor" UWORD _CNV_A_R_LINEAR_____0_CM 1 100. 0. 1540. DISPLAY_IDENTIFIER CAN_LAMB_NOX_SENS[2] ECU_ADDRESS 0xd000a0d2 FORMAT "%4.0" /end MEASUREMENT
/begin MEASUREMENT can_err_nox_sens[0] "NOx-Sensor error byte" UBYTE _CNV_A_R_LINEAR_____0_CM 1 100. 0. 255. DISPLAY_IDENTIFIER CAN_ERR_NOX_SENS[1] ECU_ADDRESS 0xd00085fa FORMAT "%3.0" /end MEASUREMENT
/begin MEASUREMENT can_err_nox_sens[1] "NOx-Sensor error byte" UBYTE _CNV_A_R_LINEAR_____0_CM 1 100. 0. 255. DISPLAY_IDENTIFIER CAN_ERR_NOX_SENS[2] ECU_ADDRESS 0xd00085fb FORMAT "%3.0" /end MEASUREMENT
/begin MEASUREMENT can_vls_nox_sens[0] "Binary O2 signal voltage, raw value, measured by NOx-Sensor" UWORD _CNV_A_R_LINEAR_____219_CM 1 100. -200. 1200. DISPLAY_IDENTIFIER CAN_VLS_NOX_SENS[1] ECU_ADDRESS 0xd000a0d4 FORMAT "%4.0" /end MEASUREMENT
/begin MEASUREMENT can_vls_nox_sens[1] "Binary O2 signal voltage, raw value, measured by NOx-Sensor" UWORD _CNV_A_R_LINEAR_____219_CM 1 100. -200. 1200. DISPLAY_IDENTIFIER CAN_VLS_NOX_SENS[2] ECU_ADDRESS 0xd000a0d6 FORMAT "%4.0" /end MEASUREMENT
/begin MEASUREMENT can_state_nox_sens[0] "NOx-Sensor status byte" UBYTE _CNV_A_R_LINEAR_____0_CM 1 100. 0. 255. DISPLAY_IDENTIFIER CAN_STATE_NOX_SENS[1] ECU_ADDRESS 0xd00085f8 FORMAT "%3.0" /end MEASUREMENT
/begin MEASUREMENT can_state_nox_sens[1] "NOx-Sensor status byte" UBYTE _CNV_A_R_LINEAR_____0_CM 1 100. 0. 255. DISPLAY_IDENTIFIER CAN_STATE_NOX_SENS[2] ECU_ADDRESS 0xd00085f9 FORMAT "%3.0" /end MEASUREMENT
/begin CHARACTERISTIC c_nox_sens_cycnr_max "maximum number of missing NOX_SENS messages for error debounce counter increment" VALUE 0xa080c002 _REC_VAL_20_u1 254. _CNV_A_R_LINEAR_____0_CM 1. 255. DISPLAY_IDENTIFIER C_NOX_SENS_CYCNR_MAX FORMAT "%3.0" /end CHARACTERISTIC
/begin MEASUREMENT lv_can_temp_min_thd_1 "Dew point recognition for NOx sensor" UBYTE _CNV_S_2_RANGE__0___1_CM 1 100. 0. 1. DISPLAY_IDENTIFIER LV_CAN_TEMP_MIN_THD_1 ECU_ADDRESS 0xd00085fc BIT_MASK 0x1 /end MEASUREMENT
/begin MEASUREMENT lv_can_temp_min_thd_2 "Dew point recognition for NOx sensor" UBYTE _CNV_S_2_RANGE__0___1_CM 1 100. 0. 1. DISPLAY_IDENTIFIER LV_CAN_TEMP_MIN_THD_2 ECU_ADDRESS 0xd00085fd BIT_MASK 0x1 /end MEASUREMENT
/begin MEASUREMENT lv_mdl_temp_min_thd_1 "Temperature model has reached the dew point for NOx sensor" UBYTE _CNV_S_2_RANGE__0___1_CM 1 100. 0. 1. DISPLAY_IDENTIFIER LV_MDL_TEMP_MIN_THD_1 ECU_ADDRESS 0xd00004c0 BIT_MASK 0x1 /end MEASUREMENT
/begin MEASUREMENT lv_mdl_temp_min_thd_2 "Temperature model has reached the dew point for NOx sensor" UBYTE _CNV_S_2_RANGE__0___1_CM 1 100. 0. 1. DISPLAY_IDENTIFIER LV_MDL_TEMP_MIN_THD_2 ECU_ADDRESS 0xd00004c1 BIT_MASK 0x1 /end MEASUREMENT
/begin CHARACTERISTIC c_r_ratio_nox_sens_min "Minimum sensor element temperature for set of dew point ahead of temperature model" VALUE 0xa080c09e _REC_VAL_20_s2 65535. _CNV_A_R_LINEAR_____0_CM -32768. 32767. DISPLAY_IDENTIFIER C_R_RATIO_NOX_SENS_MIN FORMAT "%6.0" /end CHARACTERISTIC
/begin MEASUREMENT can_r_ratio_nox_sens[0] "Sensor element temperature dependend resistance ratio as 1000*R/R25" SWORD _CNV_A_R_LINEAR_____0_CM 1 100. -32768. 32767. DISPLAY_IDENTIFIER CAN_R_RATIO_NOX_SENS[1] ECU_ADDRESS 0xd000a0d8 FORMAT "%6.0" /end MEASUREMENT
/begin MEASUREMENT can_r_ratio_nox_sens[1] "Sensor element temperature dependend resistance ratio as 1000*R/R25" SWORD _CNV_A_R_LINEAR_____0_CM 1 100. -32768. 32767. DISPLAY_IDENTIFIER CAN_R_RATIO_NOX_SENS[2] ECU_ADDRESS 0xd000a0da FORMAT "%6.0" /end MEASUREMENT
/begin MEASUREMENT teg_pcat_down_st "Exhaust gas temperature downstream of pre-catalyst at engine start " UWORD _CNV_A_R_LINEAR_____209_CM 1 100. 0. 1023.984375 DISPLAY_IDENTIFIER TEG_PCAT_DOWN_ST ECU_ADDRESS 0xd000a64c FORMAT "%7.2" /end MEASUREMENT
/begin CHARACTERISTIC c_teg_pcat_down_st_ini "Initialisation value of TEG_PCAT_DOWN_ST_i used in case of sensor error" VALUE 0xa080c30c _REC_VAL_20_u2 1023.984375 _CNV_A_R_LINEAR_____209_CM 0. 1023.984375 DISPLAY_IDENTIFIER C_TEG_PCAT_DOWN_ST_INI FORMAT "%7.2" /end CHARACTERISTIC
/begin AXIS_PTS ldp_maf_kgh_ip_teg_pcat_err "" 0xa080889e maf_kgh _REC_AXS_20_u1 2040. _CNV_A_R_LINEAR_____494_CM 4 0. 2040. FORMAT "%4.0" /end AXIS_PTS
/begin CHARACTERISTIC ip_teg_pcat_down_add_err "Additional offset on the temperature model in case of sensor error" CURVE 0xa080b518 _REC_CUR_20_u1_u1 510. _CNV_A_R_LINEAR_____522_CM 0. 510. DISPLAY_IDENTIFIER IP_TEG_PCAT_DOWN_ADD_ERR FORMAT "%5.1"
 /begin AXIS_DESCR COM_AXIS maf_kgh _CNV_A_R_LINEAR_____494_CM 4 0. 2040. FORMAT "%4.0" AXIS_PTS_REF ldp_maf_kgh_ip_teg_pcat_err /end AXIS_DESCR
/end CHARACTERISTIC
/begin MEASUREMENT teg_pcat_down_wide_rng_st "Exhaust gas temperature downstream of pre-catalyst at engine start with wide range, unit: Kelvin" UWORD _CNV_A_R_LINEAR_____523_CM 1 100. 0. 2047.96875 DISPLAY_IDENTIFIER TEG_PCAT_DOWN_WIDE_RNG_ST ECU_ADDRESS 0xd000a64e FORMAT "%8.5" /end MEASUREMENT
/begin AXIS_PTS ldp_vp_teg__teg "" 0xa080922c NO_INPUT_QUANTITY _REC_AXS_20_u2 4.999847 _CNV_A_R_LINEAR_____172_CM 16 0. 4.999847 FORMAT "%7.5" /end AXIS_PTS
/begin AXIS_PTS ldp_vp_teg__teg_wide_rng "" 0xa0809250 NO_INPUT_QUANTITY _REC_AXS_20_u2 4.999847 _CNV_A_R_LINEAR_____172_CM 8 0. 4.999847 FORMAT "%7.5" /end AXIS_PTS
/begin CHARACTERISTIC ip_teg__vp_teg "conversion table of exhaust gas temp." CURVE 0xa080b4e8 _REC_CUR_20_u2_u2 1023.984375 _CNV_A_R_LINEAR_____209_CM 0. 1023.984375 DISPLAY_IDENTIFIER IP_TEG__VP_TEG FORMAT "%7.2"
 /begin AXIS_DESCR COM_AXIS NO_INPUT_QUANTITY _CNV_A_R_LINEAR_____172_CM 16 0. 4.999847 FORMAT "%7.5" AXIS_PTS_REF ldp_vp_teg__teg /end AXIS_DESCR
/end CHARACTERISTIC
/begin CHARACTERISTIC ip_teg_wide_rng__vp_teg "conversion table of exhaust gas temp. with extended range " CURVE 0xa080b53c _REC_CUR_20_u2_u2 2047.96875 _CNV_A_R_LINEAR_____523_CM 0. 2047.96875 DISPLAY_IDENTIFIER IP_TEG_WIDE_RNG__VP_TEG FORMAT "%8.5"
 /begin AXIS_DESCR COM_AXIS NO_INPUT_QUANTITY _CNV_A_R_LINEAR_____172_CM 8 0. 4.999847 FORMAT "%7.5" AXIS_PTS_REF ldp_vp_teg__teg_wide_rng /end AXIS_DESCR
/end CHARACTERISTIC
/begin MEASUREMENT teg_pcat_down_1 "Exhaust gas temperature downstream of pre-catalyst" UWORD _CNV_A_R_LINEAR_____209_CM 1 100. 0. 1023.984375 DISPLAY_IDENTIFIER TEG_PCAT_DOWN_1 ECU_ADDRESS 0xd000a652 FORMAT "%7.2" /end MEASUREMENT
/begin MEASUREMENT teg_pcat_down_2 "Exhaust gas temperature downstream of pre-catalyst" UWORD _CNV_A_R_LINEAR_____209_CM 1 100. 0. 1023.984375 DISPLAY_IDENTIFIER TEG_PCAT_DOWN_2 ECU_ADDRESS 0xd000a658 FORMAT "%7.2" /end MEASUREMENT
/begin MEASUREMENT teg_pcat_down_raw "Exhaust gas temp downstream of pre-catalyst, raw value i.e. not replaced by substitute value, wide range " UWORD _CNV_A_R_LINEAR_____523_CM 1 100. 0. 2047.96875 DISPLAY_IDENTIFIER TEG_PCAT_DOWN_RAW ECU_ADDRESS 0xd000a654 FORMAT "%8.5" /end MEASUREMENT
/begin MEASUREMENT teg_pcat_down_wide_rng "Exhaust gas temperature downstream of pre-catalyst with wide range, unit: Kelvin" UWORD _CNV_A_R_LINEAR_____523_CM 1 100. 0. 2047.96875 DISPLAY_IDENTIFIER TEG_PCAT_DOWN_WIDE_RNG ECU_ADDRESS 0xd000a650 FORMAT "%8.5" /end MEASUREMENT
/begin MEASUREMENT vp_teg_pcat_down "Catalyst temperature sensor raw acquisition" UWORD _CNV_A_R_LINEAR_____172_CM 1 100. 0. 4.999847 DISPLAY_IDENTIFIER VP_TEG_PCAT_DOWN ECU_ADDRESS 0xd000a656 FORMAT "%7.5" /end MEASUREMENT
/begin MEASUREMENT tfu "fuel temperature" UBYTE _CNV_A_R_LINEAR_____17_CM 1 100. -48. 142.5 DISPLAY_IDENTIFIER TFU ECU_ADDRESS 0xd00088a0 FORMAT "%6.2" /end MEASUREMENT
/begin MEASUREMENT tfu_sub_stop "Modeled fuel temperature at last engine stop" UBYTE _CNV_A_R_LINEAR_____17_CM 1 100. -48. 142.5 DISPLAY_IDENTIFIER TFU_SUB_STOP ECU_ADDRESS 0xd00088a1 FORMAT "%6.2" /end MEASUREMENT
/begin CHARACTERISTIC c_tfu_sub_stop_ini "TFU_SUB_STOP initialization value" VALUE 0xa080c31d _REC_VAL_20_u1 190.5 _CNV_A_R_LINEAR_____17_CM -48. 142.5 DISPLAY_IDENTIFIER C_TFU_SUB_STOP_INI FORMAT "%6.2" /end CHARACTERISTIC
/begin CHARACTERISTIC ip_fac_vs_ecfpwm_ecf "Weighting factor for air speed" MAP 0xa080ac3c _REC_MAP_20_u1_u1_u1 1.9921875 _CNV_A_R_LINEAR_____103_CM 0. 1.9921875 DISPLAY_IDENTIFIER IP_FAC_VS_ECFPWM_ECF FORMAT "%8.6"
 /begin AXIS_DESCR COM_AXIS vs _CNV_A_R_LINEAR_____6_CM 6 0. 255. FORMAT "%3.0" AXIS_PTS_REF ldp_vs_ip_fac_vs_ecfpwm_ecf /end AXIS_DESCR
 /begin AXIS_DESCR COM_AXIS ecfpwm_ecf _CNV_A_R_LINEAR_____5_CM 6 0. 99.609375 FORMAT "%4.1" AXIS_PTS_REF ldp_ecfpwm_ecf_ip_fac /end AXIS_DESCR
/end CHARACTERISTIC
/begin AXIS_PTS ldp_vs_ip_fac_vs_ecfpwm_ecf "" 0xa08092f4 vs _REC_AXS_20_u1 255. _CNV_A_R_LINEAR_____6_CM 6 0. 255. FORMAT "%3.0" /end AXIS_PTS
/begin AXIS_PTS ldp_ecfpwm_ecf_ip_fac "" 0xa0808582 ecfpwm_ecf _REC_AXS_20_u1 99.609375 _CNV_A_R_LINEAR_____5_CM 6 0. 99.609375 FORMAT "%4.1" /end AXIS_PTS
/begin CHARACTERISTIC ip_fac_teg_t_es_teg_dyn_stop "Weighting factor for exhaust temperature" MAP 0xa080a514 _REC_MAP_20_u1_u2_u2 1.9921875 _CNV_A_R_LINEAR_____103_CM 0. 1.9921875 DISPLAY_IDENTIFIER IP_FAC_TEG_T_ES_TEG_DYN_STOP FORMAT "%8.6"
 /begin AXIS_DESCR COM_AXIS teg_dyn_stop _CNV_A_R_LINEAR_____130_CM 6 0. 2047. FORMAT "%7.2" AXIS_PTS_REF ldp_teg_dyn_stop_ip_fac_teg /end AXIS_DESCR
 /begin AXIS_DESCR COM_AXIS t_es _CNV_A_R_LINEAR_____84_CM 6 0. 65535. FORMAT "%5.0" AXIS_PTS_REF ldp_t_es_ip_fac_teg_t_es /end AXIS_DESCR
/end CHARACTERISTIC
/begin AXIS_PTS ldp_teg_dyn_stop_ip_fac_teg "" 0xa0808e4c teg_dyn_stop _REC_AXS_20_u2 2047. _CNV_A_R_LINEAR_____130_CM 6 0. 2047. FORMAT "%7.2" /end AXIS_PTS
/begin AXIS_PTS ldp_t_es_ip_fac_teg_t_es "" 0xa0808d54 t_es _REC_AXS_20_u2 65535. _CNV_A_R_LINEAR_____84_CM 6 0. 65535. FORMAT "%5.0" /end AXIS_PTS
/begin AXIS_PTS ldp_t_es_ip_fac_t_es "" 0xa0808d40 t_es _REC_AXS_20_u2 65535. _CNV_A_R_LINEAR_____84_CM 9 0. 65535. FORMAT "%5.0" /end AXIS_PTS
/begin MEASUREMENT temp_dif_tco_tia "Temperature difference between TCO_EX and TCO or TIA and TCO" UBYTE _CNV_A_R_LINEAR_____17_CM 1 100. -48. 142.5 DISPLAY_IDENTIFIER TEMP_DIF_TCO_TIA ECU_ADDRESS 0xd00088a2 FORMAT "%6.2" /end MEASUREMENT
/begin MEASUREMENT tfu_lpf_tco "Modeled fuel temperature with low pass filter" UBYTE _CNV_A_R_LINEAR_____17_CM 1 100. -48. 142.5 DISPLAY_IDENTIFIER TFU_LPF_TCO ECU_ADDRESS 0xd0001699 FORMAT "%6.2" /end MEASUREMENT
/begin MEASUREMENT tfu_raw "Modeled fuel temperature raw value" UBYTE _CNV_A_R_LINEAR_____17_CM 1 100. -48. 142.5 DISPLAY_IDENTIFIER TFU_RAW ECU_ADDRESS 0xd0001698 FORMAT "%6.2" /end MEASUREMENT
/begin MEASUREMENT tfu_add_fuel_flow "Fuel temperature increase / decrease due to fuel flow" UBYTE _CNV_A_R_LINEAR_____17_CM 1 100. -48. 142.5 DISPLAY_IDENTIFIER TFU_ADD_FUEL_FLOW ECU_ADDRESS 0xd0001697 FORMAT "%6.2" /end MEASUREMENT
/begin MEASUREMENT temp_fuel_rail_wall "Modeled rail wall temperature" UBYTE _CNV_A_R_LINEAR_____17_CM 1 100. -48. 142.5 DISPLAY_IDENTIFIER TEMP_FUEL_RAIL_WALL ECU_ADDRESS 0xd0001696 FORMAT "%6.2" /end MEASUREMENT
/begin MEASUREMENT tfu_ofs_air "Fuel temperature offset depending on ambient conditions" UBYTE _CNV_A_R_LINEAR_____17_CM 1 100. -48. 142.5 DISPLAY_IDENTIFIER TFU_OFS_AIR ECU_ADDRESS 0xd0001695 FORMAT "%6.2" /end MEASUREMENT
/begin CHARACTERISTIC c_crlc_fac_temp_dif_tco_tia "Low pass filter correlation constant for difference of coolant temperature" VALUE 0xa080bae3 _REC_VAL_20_u1 0.99609375 _CNV_A_R_LINEAR_____185_CM 0. 0.99609375 DISPLAY_IDENTIFIER C_CRLC_FAC_TEMP_DIF_TCO_TIA FORMAT "%5.3" /end CHARACTERISTIC
/begin CHARACTERISTIC c_crlc_fac_vff_mff_sp_fup_ctl "Low pass filter correlation constant for the weighting factor of volume fuel flow through the injectors" VALUE 0xa080bae7 _REC_VAL_20_u1 0.99609375 _CNV_A_R_LINEAR_____185_CM 0. 0.99609375 DISPLAY_IDENTIFIER C_CRLC_FAC_VFF_MFF_SP_FUP_CTL FORMAT "%5.3" /end CHARACTERISTIC
/begin CHARACTERISTIC ip_fac_t_es "Factor for correction of  Engine off duration time" CURVE 0xa080a504 _REC_CUR_20_u1_u2 1.9921875 _CNV_A_R_LINEAR_____103_CM 0. 1.9921875 DISPLAY_IDENTIFIER IP_FAC_T_ES FORMAT "%8.6"
 /begin AXIS_DESCR COM_AXIS t_es _CNV_A_R_LINEAR_____84_CM 9 0. 65535. FORMAT "%5.0" AXIS_PTS_REF ldp_t_es_ip_fac_t_es /end AXIS_DESCR
/end CHARACTERISTIC
/begin CHARACTERISTIC ip_fac_vff_mff_sp_fup_ctl "Factor for conversion of required fuel volume to cooling" CURVE 0xa080ac08 _REC_CUR_20_u1_u2 1.9921875 _CNV_A_R_LINEAR_____103_CM 0. 1.9921875 DISPLAY_IDENTIFIER IP_FAC_VFF_MFF_SP_FUP_CTL FORMAT "%8.6"
 /begin AXIS_DESCR COM_AXIS vff_mff_sp_fup_ctl _CNV_A_R_LINEAR_____176_CM 9 0. 255. FORMAT "%7.3" AXIS_PTS_REF ldp_vff_mff_sp_fup_ctl /end AXIS_DESCR
/end CHARACTERISTIC
/begin AXIS_PTS ldp_vff_mff_sp_fup_ctl "" 0xa0809138 vff_mff_sp_fup_ctl _REC_AXS_20_u2 25.5 _CNV_A_R_LINEAR_____176_CM 9 0. 255. FORMAT "%7.3" /end AXIS_PTS
/begin CHARACTERISTIC ip_crlc_tfu_t_ast_vff_mff_sp "Weighting factor for correction of the fuel temperature" MAP 0xa080a0d8 _REC_MAP_20_u1_u2_u2 0.99609375 _CNV_A_R_LINEAR_____185_CM 0. 0.99609375 DISPLAY_IDENTIFIER IP_CRLC_TFU_T_AST_VFF_MFF_SP FORMAT "%5.3"
 /begin AXIS_DESCR COM_AXIS t_ast _CNV_A_R_LINEAR_____4_CM 6 0. 6553.5 FORMAT "%6.1" AXIS_PTS_REF ldp_t_ast_ip_crlc_tfu_vff_mff /end AXIS_DESCR
 /begin AXIS_DESCR COM_AXIS vff_mff_sp_fup_ctl _CNV_A_R_LINEAR_____176_CM 6 0. 255. FORMAT "%7.3" AXIS_PTS_REF ldp_vff_mff_sp_fup_ctl_ip_crlc /end AXIS_DESCR
/end CHARACTERISTIC
/begin AXIS_PTS ldp_t_ast_ip_crlc_tfu_vff_mff "" 0xa0808d08 t_ast _REC_AXS_20_u2 6553.5 _CNV_A_R_LINEAR_____4_CM 6 0. 6553.5 FORMAT "%6.1" /end AXIS_PTS
/begin AXIS_PTS ldp_vff_mff_sp_fup_ctl_ip_crlc "" 0xa080914c vff_mff_sp_fup_ctl _REC_AXS_20_u2 255. _CNV_A_R_LINEAR_____176_CM 6 0. 255. FORMAT "%7.3" /end AXIS_PTS
/begin CHARACTERISTIC ip_tam_add_tfu_iv "Correction of the influence of ambient temperature on TFU_IV" CURVE 0xa080b4c0 _REC_CUR_20_u1_u1 190.5 _CNV_A_R_LINEAR_____17_CM -48. 142.5 DISPLAY_IDENTIFIER IP_TAM_ADD_TFU_IV FORMAT "%5.1"
 /begin AXIS_DESCR COM_AXIS tam _CNV_A_R_LINEAR_____17_CM 8 -48. 142.5 FORMAT "%5.1" AXIS_PTS_REF ldp_tam_add_tfu_iv /end AXIS_DESCR
/end CHARACTERISTIC
/begin CHARACTERISTIC ip_tam_add_tfu_raw "Correction of the influence of ambient temperature on TFU_RAW" CURVE 0xa080b4c8 _REC_CUR_20_u1_u1 190.5 _CNV_A_R_LINEAR_____17_CM -48. 142.5 DISPLAY_IDENTIFIER IP_TAM_ADD_TFU_RAW FORMAT "%5.1"
 /begin AXIS_DESCR COM_AXIS tam _CNV_A_R_LINEAR_____17_CM 8 -48. 142.5 FORMAT "%5.1" AXIS_PTS_REF ldp_tam_add_tfu_raw /end AXIS_DESCR
/end CHARACTERISTIC
/begin CHARACTERISTIC ip_tco_temp_dif_tco_tia "Factor for correction of the coolant temperature" CURVE 0xa080b4d0 _REC_CUR_20_u1_u1 190.5 _CNV_A_R_LINEAR_____17_CM -48. 142.5 DISPLAY_IDENTIFIER IP_TCO_TEMP_DIF_TCO_TIA FORMAT "%5.1"
 /begin AXIS_DESCR COM_AXIS temp_dif_tco_tia _CNV_A_R_LINEAR_____17_CM 6 -48. 142.5 FORMAT "%5.1" AXIS_PTS_REF ldp_temp_dif_tco_tia_ip_tco /end AXIS_DESCR
/end CHARACTERISTIC
/begin AXIS_PTS ldp_tam_add_tfu_iv "" 0xa0808db4 tam _REC_AXS_20_u1 190.5 _CNV_A_R_LINEAR_____17_CM 8 -48. 142.5 FORMAT "%5.1" /end AXIS_PTS
/begin AXIS_PTS ldp_tam_add_tfu_raw "" 0xa0808dc0 tam _REC_AXS_20_u1 190.5 _CNV_A_R_LINEAR_____17_CM 8 -48. 142.5 FORMAT "%5.1" /end AXIS_PTS
/begin AXIS_PTS ldp_temp_dif_tco_tia_ip_tco "" 0xa0808e64 temp_dif_tco_tia _REC_AXS_20_u1 190.5 _CNV_A_R_LINEAR_____17_CM 6 -48. 142.5 FORMAT "%5.1" /end AXIS_PTS
/begin CHARACTERISTIC c_crlc_fac_vs_ecfpwm_ecf "Low pass filter correlation constant for the weighting factor for air speed" VALUE 0xa080bae8 _REC_VAL_20_u1 0.99609375 _CNV_A_R_LINEAR_____185_CM 0. 0.99609375 DISPLAY_IDENTIFIER C_CRLC_FAC_VS_ECFPWM_ECF FORMAT "%5.3" /end CHARACTERISTIC
/begin CHARACTERISTIC c_t_tfu_clc "Time recurrence for TFU calculation" VALUE 0xa080c280 _REC_VAL_20_u1 254. _CNV_A_R_LINEAR_____36_CM 1. 255. DISPLAY_IDENTIFIER C_T_TFU_CLC FORMAT "%3.0" /end CHARACTERISTIC
/begin CHARACTERISTIC ip_d_tiv_norm_n_mff_sp "Load-dependent temperature differential to coolant temperature" MAP 0xa080a118 _REC_MAP_20_u1_u2_u2 190.5 _CNV_A_R_LINEAR_____17_CM -48. 142.5 DISPLAY_IDENTIFIER IP_D_TIV_NORM_N_MFF_SP FORMAT "%5.1"
 /begin AXIS_DESCR COM_AXIS n _CNV_A_R_LINEAR_____14_CM 6 0. 8160. FORMAT "%4.0" AXIS_PTS_REF ldp_n_ip_d_tiv_norm_n_mff_sp /end AXIS_DESCR
 /begin AXIS_DESCR COM_AXIS mff_sp_mv _CNV_A_R_LINEAR_____111_CM 4 0. 1389. FORMAT "%7.2" AXIS_PTS_REF ldp_mff_sp_ip_d_tiv_norm_n_mff /end AXIS_DESCR
/end CHARACTERISTIC
/begin CHARACTERISTIC ip_temp_dif_n_mff_sp_iv "N and MFF_SP dependent injektor temperatur differential to coolant temperature" MAP 0xa080b54c _REC_MAP_20_u1_u2_u2 190.5 _CNV_A_R_LINEAR_____17_CM -48. 142.5 DISPLAY_IDENTIFIER IP_TEMP_DIF_N_MFF_SP_IV FORMAT "%5.1"
 /begin AXIS_DESCR COM_AXIS n _CNV_A_R_LINEAR_____14_CM 6 0. 8160. FORMAT "%4.0" AXIS_PTS_REF ldp_n_ip_temp_dif_iv /end AXIS_DESCR
 /begin AXIS_DESCR COM_AXIS mff_sp_mv _CNV_A_R_LINEAR_____111_CM 4 0. 1389. FORMAT "%7.2" AXIS_PTS_REF ldp_mff_sp_ip_temp_dif_iv /end AXIS_DESCR
/end CHARACTERISTIC
/begin CHARACTERISTIC ip_fac_tiv_ewp_cor "Factor for correction between RPM of electrical water pump and injector temperature" CURVE 0xa080a80e _REC_CUR_20_u1_u1 1.9921875 _CNV_A_R_LINEAR_____103_CM 0. 1.9921875 DISPLAY_IDENTIFIER IP_FAC_TIV_EWP_COR FORMAT "%8.6"
 /begin AXIS_DESCR COM_AXIS n_rel_cwp _CNV_A_R_LINEAR_____0_CM 6 0. 255. FORMAT "%3.0" AXIS_PTS_REF ldp_tiv_ewp_cor_ip_fac_tiv_ewp /end AXIS_DESCR
/end CHARACTERISTIC
/begin CHARACTERISTIC ip_fac_tiv_tco_cor "Factor for correction between TCO and injector temperature" CURVE 0xa080a814 _REC_CUR_20_u1_u1 1.9921875 _CNV_A_R_LINEAR_____103_CM 0. 1.9921875 DISPLAY_IDENTIFIER IP_FAC_TIV_TCO_COR FORMAT "%8.6"
 /begin AXIS_DESCR COM_AXIS tco _CNV_A_R_LINEAR_____17_CM 6 -48. 142.5 FORMAT "%6.2" AXIS_PTS_REF ldp_tiv_tco_cor_ip_fac_tiv_tco /end AXIS_DESCR
/end CHARACTERISTIC
/begin CHARACTERISTIC ip_fac_tco_temp_iv_cor "Correction factor for correlation between TCO and injector temperature" CURVE 0xa080a50e _REC_CUR_20_u1_u1 1.9921875 _CNV_A_R_LINEAR_____103_CM 0. 1.9921875 DISPLAY_IDENTIFIER IP_FAC_TCO_TEMP_IV_COR FORMAT "%8.6"
 /begin AXIS_DESCR COM_AXIS tco _CNV_A_R_LINEAR_____17_CM 6 -48. 142.5 FORMAT "%6.2" AXIS_PTS_REF ldp_tco_ip_fac_tco_temp_iv_cor /end AXIS_DESCR
/end CHARACTERISTIC
/begin CHARACTERISTIC c_crlc_fac_temp_iv "Low pass filter correlation constant for the injection valve temperature out of coolant temperature" VALUE 0xa080bae4 _REC_VAL_20_u1 0.99609375 _CNV_A_R_LINEAR_____185_CM 0. 0.99609375 DISPLAY_IDENTIFIER C_CRLC_FAC_TEMP_IV FORMAT "%5.3" /end CHARACTERISTIC
/begin MEASUREMENT temp_fuel_rail_sub "Modeled fuel rail temperature depending from tco and N" UBYTE _CNV_A_R_LINEAR_____17_CM 1 100. -48. 142.5 DISPLAY_IDENTIFIER TEMP_FUEL_RAIL_SUB ECU_ADDRESS 0xd0001694 FORMAT "%6.2" /end MEASUREMENT
/begin MEASUREMENT tfu_iv_sub "Modeled injektor fuel temperature depending from TCO, N, MFF_SP, and EWP" UBYTE _CNV_A_R_LINEAR_____17_CM 1 100. -48. 142.5 DISPLAY_IDENTIFIER TFU_IV_SUB ECU_ADDRESS 0xd00088a3 FORMAT "%6.2" /end MEASUREMENT
/begin MEASUREMENT tfu_iv "Injektor fuel temperature depending from TCO, N, MFF_SP, and EWP" UBYTE _CNV_A_R_LINEAR_____17_CM 1 100. -48. 142.5 DISPLAY_IDENTIFIER TFU_IV ECU_ADDRESS 0xd00088a4 FORMAT "%6.2" /end MEASUREMENT
/begin CHARACTERISTIC lc_tfu_tia_tco_ex "Logical switch TIA and TCO_EX for TFU_OFS_AIR calculation" VALUE 0xa080c601 _REC_VAL_20_u1 1. _CNV_S_2_RANGE__0___1_CM 0. 1. DISPLAY_IDENTIFIER LC_TFU_TIA_TCO_EX /end CHARACTERISTIC
/begin CHARACTERISTIC lc_tco_tfu_iv_sub "Logical switch TIA and TCO_EX for TFU_OFS_AIR calculation" VALUE 0xa080c5fc _REC_VAL_20_u1 1. _CNV_S_2_RANGE__0___1_CM 0. 1. DISPLAY_IDENTIFIER LC_TCO_TFU_IV_SUB /end CHARACTERISTIC
/begin CHARACTERISTIC lc_temp_fuel_rail_wall_tam "Logical switch TEMP_FUEL_RAIL_WALL and TAM for TFU_RAW calculation" VALUE 0xa080c600 _REC_VAL_20_u1 1. _CNV_S_2_RANGE__0___1_CM 0. 1. DISPLAY_IDENTIFIER LC_TEMP_FUEL_RAIL_WALL_TAM /end CHARACTERISTIC
/begin AXIS_PTS ldp_n_ip_d_tiv_norm_n_mff_sp "" 0xa0808b44 n _REC_AXS_20_u2 8160. _CNV_A_R_LINEAR_____14_CM 6 0. 8160. FORMAT "%4.0" /end AXIS_PTS
/begin AXIS_PTS ldp_n_ip_temp_dif_iv "" 0xa0808b6c n _REC_AXS_20_u2 8160. _CNV_A_R_LINEAR_____14_CM 6 0. 8160. FORMAT "%4.0" /end AXIS_PTS
/begin AXIS_PTS ldp_mff_sp_ip_d_tiv_norm_n_mff "" 0xa0808954 mff_sp_mv _REC_AXS_20_u2 1389. _CNV_A_R_LINEAR_____111_CM 4 0. 1389. FORMAT "%7.2" /end AXIS_PTS
/begin AXIS_PTS ldp_mff_sp_ip_temp_dif_iv "" 0xa0808960 mff_sp_mv _REC_AXS_20_u2 1389. _CNV_A_R_LINEAR_____111_CM 4 0. 1389. FORMAT "%7.2" /end AXIS_PTS
/begin AXIS_PTS ldp_tiv_tco_cor_ip_fac_tiv_tco "" 0xa0808eae tco _REC_AXS_20_u1 19.05 _CNV_A_R_LINEAR_____17_CM 6 -48. 142.5 FORMAT "%6.2" /end AXIS_PTS
/begin AXIS_PTS ldp_tco_ip_fac_tco_temp_iv_cor "" 0xa0808e00 tco _REC_AXS_20_u1 19.05 _CNV_A_R_LINEAR_____17_CM 6 -48. 142.5 FORMAT "%6.2" /end AXIS_PTS
/begin AXIS_PTS ldp_tiv_ewp_cor_ip_fac_tiv_ewp "" 0xa0808ea6 n_rel_cwp _REC_AXS_20_u1 25.5 _CNV_A_R_LINEAR_____0_CM 6 0. 255. FORMAT "%3.0" /end AXIS_PTS
/begin MEASUREMENT tfu_efp "Fuel temperature for the low pressure pump" UBYTE _CNV_A_R_LINEAR_____17_CM 1 100. -48. 142.5 DISPLAY_IDENTIFIER TFU_EFP ECU_ADDRESS 0xd00088a5 FORMAT "%6.2" /end MEASUREMENT
/begin CHARACTERISTIC c_tfu_efp_ofs "Offset for the modelling of the fuel temperature of the low pressure pump" VALUE 0xa080c316 _REC_VAL_20_u1 190.5 _CNV_A_R_LINEAR_____17_CM -48. 142.5 DISPLAY_IDENTIFIER C_TFU_EFP_OFS FORMAT "%6.2" /end CHARACTERISTIC
/begin CHARACTERISTIC ip_fac_temp_iv_cwp_cor "Factor for correlation between RPM of cooling water pump and injector temperature" CURVE 0xa080a538 _REC_CUR_20_u1_u1 1.9921875 _CNV_A_R_LINEAR_____103_CM 0. 1.9921875 DISPLAY_IDENTIFIER IP_FAC_TEMP_IV_CWP_COR FORMAT "%8.6"
 /begin AXIS_DESCR COM_AXIS n_rel_cwp _CNV_A_R_LINEAR_____0_CM 6 0. 255. FORMAT "%3.0" AXIS_PTS_REF ldp_n_ip_fac_temp_iv_cwp_cor /end AXIS_DESCR
/end CHARACTERISTIC
/begin CHARACTERISTIC ip_crlc_tfu_iv_sub_vff_mff_sp "Low pass filter correlation depending on VFF_MFF_SP_FUP_CTL" CURVE 0xa080a0c4 _REC_CUR_20_u2_u2 0.9999847412109381 _CNV_A_R_LINEAR_____89_CM 0. 0.9999847412109381 DISPLAY_IDENTIFIER IP_CRLC_TFU_IV_SUB_VFF_MFF_SP FORMAT "%7.5"
 /begin AXIS_DESCR COM_AXIS vff_mff_sp_fup_ctl _CNV_A_R_LINEAR_____176_CM 9 0. 255. FORMAT "%7.3" AXIS_PTS_REF ldp_vff_mff_sp_ip_crlc_tfu_iv /end AXIS_DESCR
/end CHARACTERISTIC
/begin AXIS_PTS ldp_n_ip_fac_temp_iv_cwp_cor "" 0xa0808b52 n_rel_cwp _REC_AXS_20_u1 25.5 _CNV_A_R_LINEAR_____0_CM 6 0. 255. FORMAT "%3.0" /end AXIS_PTS
/begin AXIS_PTS ldp_vff_mff_sp_ip_crlc_tfu_iv "" 0xa080915c vff_mff_sp_fup_ctl _REC_AXS_20_u2 25.5 _CNV_A_R_LINEAR_____176_CM 9 0. 255. FORMAT "%7.3" /end AXIS_PTS
/begin CHARACTERISTIC c_crlc_tfu_iv_sub_rise "Low pass filter correlation constant for TFU_IV_SUB, rising temperature" VALUE 0xa080bb10 _REC_VAL_20_u2 0.9999847412109381 _CNV_A_R_LINEAR_____89_CM 0. 0.9999847412109381 DISPLAY_IDENTIFIER C_CRLC_TFU_IV_SUB_RISE FORMAT "%7.5" /end CHARACTERISTIC
/begin CHARACTERISTIC c_crlc_tfu_iv_sub_fall "Low pass filter correlation constant for TFU_IV_SUB, falling temperature" VALUE 0xa080bb0e _REC_VAL_20_u2 0.9999847412109381 _CNV_A_R_LINEAR_____89_CM 0. 0.9999847412109381 DISPLAY_IDENTIFIER C_CRLC_TFU_IV_SUB_FALL FORMAT "%7.5" /end CHARACTERISTIC
/begin MEASUREMENT tfu_iv_sub_raw "Modeled injektor fuel temperature depending from TCO, N, MFF_SP, and EWP, raw-value after first low pass" UBYTE _CNV_A_R_LINEAR_____17_CM 1 100. -48. 142.5 DISPLAY_IDENTIFIER TFU_IV_SUB_RAW ECU_ADDRESS 0xd000169b FORMAT "%6.2" /end MEASUREMENT
/begin CHARACTERISTIC c_tfu_raw_swi_ini "Switch for initial value for gradient limitation of TFU_RAW after reset" VALUE 0xa080c31c _REC_VAL_20_u1 10. _CNV_A_R_LINEAR_____50_CM 0. 10. DISPLAY_IDENTIFIER C_TFU_RAW_SWI_INI FORMAT "%2.0" /end CHARACTERISTIC
/begin MEASUREMENT tfu_raw_step_clc_inc "counter value tfu_raw positve edge" UWORD _CNV_A_R_LINEAR_____548_CM 1 100. 0. 23.9996 DISPLAY_IDENTIFIER TFU_RAW_STEP_CLC_INC ECU_ADDRESS 0xd0001690 FORMAT "%7.4" /end MEASUREMENT
/begin MEASUREMENT tfu_raw_step_clc_dec "counter value tfu_raw negative edge" UWORD _CNV_A_R_LINEAR_____548_CM 1 100. 0. 23.9996 DISPLAY_IDENTIFIER TFU_RAW_STEP_CLC_DEC ECU_ADDRESS 0xd0001692 FORMAT "%7.4" /end MEASUREMENT
/begin CHARACTERISTIC c_tfu_raw_lim_dec "Gradient limitation for TFU_RAW decrement" VALUE 0xa080c318 _REC_VAL_20_u2 23.9996 _CNV_A_R_LINEAR_____548_CM 0. 23.9996 DISPLAY_IDENTIFIER C_TFU_RAW_LIM_DEC FORMAT "%7.4" /end CHARACTERISTIC
/begin CHARACTERISTIC c_tfu_raw_lim_inc "Gradient limitation for TFU_RAW increment" VALUE 0xa080c31a _REC_VAL_20_u2 23.9996 _CNV_A_R_LINEAR_____548_CM 0. 23.9996 DISPLAY_IDENTIFIER C_TFU_RAW_LIM_INC FORMAT "%7.4" /end CHARACTERISTIC
/begin AXIS_PTS ldpm_opm_av "" 0xa0809750 opm_av _REC_AXS_20_u1 8. _CNV_A_R_LINEAR_____0_CM 8 0. 8. FORMAT "%1.0" /end AXIS_PTS
/begin MEASUREMENT tps_av_mv "Opening angle of the throttle valve, mean value" UWORD _CNV_A_R_LINEAR_____227_CM 1 100. 0. 119.5 DISPLAY_IDENTIFIER TPS_AV_MV ECU_ADDRESS 0xd000a1f8 FORMAT "%7.3" /end MEASUREMENT
/begin MEASUREMENT tps_grd_mv "Throttle position gradient, mean value" UBYTE _CNV_A_R_LINEAR_____888_CM 1 100. 0. 2988.28125 DISPLAY_IDENTIFIER TPS_GRD_MV ECU_ADDRESS 0xd00086ac FORMAT "%4.0" /end MEASUREMENT
/begin MEASUREMENT lv_cdn_com_diag "Status aperture water valve" UBYTE _CNV_S_2_RANGE__0___1_CM 1 100. 0. 1. DISPLAY_IDENTIFIER LV_CDN_COM_DIAG ECU_ADDRESS 0xd0008bb4 BIT_MASK 0x1 /end MEASUREMENT
/begin CHARACTERISTIC c_ctr_tout_com_2_trl "Maximum number of missing messages events before error detection of message TRL" VALUE 0xa080bc02 _REC_VAL_20_u1 255. _CNV_A_R_LINEAR_____0_CM 0. 255. DISPLAY_IDENTIFIER C_CTR_TOUT_COM_2_TRL FORMAT "%3.0" /end CHARACTERISTIC
/begin CHARACTERISTIC c_ctr_tout_com_2_gear_rev "Maximum number of missing messages events before error detection of message GEAR_REV" VALUE 0xa080bbf8 _REC_VAL_20_u1 255. _CNV_A_R_LINEAR_____0_CM 0. 255. DISPLAY_IDENTIFIER C_CTR_TOUT_COM_2_GEAR_REV FORMAT "%3.0" /end CHARACTERISTIC
/begin CHARACTERISTIC c_ctr_tout_com_2_efp_crash "Maximum number of missing messages events before error detection of message HIV" VALUE 0xa080bbf4 _REC_VAL_20_u1 255. _CNV_A_R_LINEAR_____0_CM 0. 255. DISPLAY_IDENTIFIER C_CTR_TOUT_COM_2_EFP_CRASH FORMAT "%3.0" /end CHARACTERISTIC
/begin CHARACTERISTIC c_ctr_tout_com_2_state_veh "Maximum number of missing messages events before error detection of message STATE_VEH" VALUE 0xa080bbfc _REC_VAL_20_u1 255. _CNV_A_R_LINEAR_____0_CM 0. 255. DISPLAY_IDENTIFIER C_CTR_TOUT_COM_2_STATE_VEH FORMAT "%3.0" /end CHARACTERISTIC
/begin MEASUREMENT lv_veh_state_msg_vld "Indicating CAN message received at least once" UBYTE _CNV_S_2_RANGE__0___1_CM 1 100. 0. 1. DISPLAY_IDENTIFIER LV_VEH_STATE_MSG_VLD ECU_ADDRESS 0xd000857a BIT_MASK 0x1 /end MEASUREMENT
/begin CHARACTERISTIC c_ctr_tout_veh_state "Threshold for timeout behaviour of CAN message after reset" VALUE 0xa080bc0b _REC_VAL_20_u1 255. _CNV_A_R_LINEAR_____0_CM 0. 255. FORMAT "%3.0" /end CHARACTERISTIC
/begin CHARACTERISTIC c_ctr_tout_com_1_vs "Maximum number of missing messages events before error detection of message VS" VALUE 0xa080bbed _REC_VAL_20_u1 255. _CNV_A_R_LINEAR_____0_CM 0. 255. DISPLAY_IDENTIFIER C_CTR_TOUT_COM_1_VS FORMAT "%3.0" /end CHARACTERISTIC
/begin CHARACTERISTIC c_ctr_crc_com_1_vs "Maximum number of wrong Checksum calculation events before error detection of message VS" VALUE 0xa080bb33 _REC_VAL_20_u1 255. _CNV_A_R_LINEAR_____0_CM 0. 255. DISPLAY_IDENTIFIER C_CTR_CRC_COM_1_VS FORMAT "%3.0" /end CHARACTERISTIC
/begin CHARACTERISTIC c_ctr_tcc_com_1_vs "Maximum number of wrong TCC_COM_1 count events before error detection of message VS" VALUE 0xa080bbd3 _REC_VAL_20_u1 255. _CNV_A_R_LINEAR_____0_CM 0. 255. DISPLAY_IDENTIFIER C_CTR_TCC_COM_1_VS FORMAT "%3.0" /end CHARACTERISTIC
/begin CHARACTERISTIC c_ctr_crc_com_1_tq_pste "Maximum number of wrong Checksum calculation events before error detection of message TQ_PSTE" VALUE 0xa080bb30 _REC_VAL_20_u1 255. _CNV_A_R_LINEAR_____0_CM 0. 255. DISPLAY_IDENTIFIER C_CTR_CRC_COM_1_TQ_PSTE FORMAT "%3.0" /end CHARACTERISTIC
/begin CHARACTERISTIC c_ctr_tcc_com_1_tq_pste "Maximum number of wrong TCC_COM_1 count events before error detection of message TQ_PSTE" VALUE 0xa080bbd0 _REC_VAL_20_u1 255. _CNV_A_R_LINEAR_____0_CM 0. 255. DISPLAY_IDENTIFIER C_CTR_TCC_COM_1_TQ_PSTE FORMAT "%3.0" /end CHARACTERISTIC
/begin CHARACTERISTIC c_ctr_tout_com_1_tq_pste "Maximum number of missing messages events before error detection of message TQ_PSTE" VALUE 0xa080bbe9 _REC_VAL_20_u1 255. _CNV_A_R_LINEAR_____0_CM 0. 255. DISPLAY_IDENTIFIER C_CTR_TOUT_COM_1_TQ_PSTE FORMAT "%3.0" /end CHARACTERISTIC
/begin CHARACTERISTIC c_ctr_tout_com_1_req_tqdw "Maximum number of missing messages events before error detection of message REQ_TQDW" VALUE 0xa080bbe4 _REC_VAL_20_u1 255. _CNV_A_R_LINEAR_____0_CM 0. 255. DISPLAY_IDENTIFIER C_CTR_TOUT_COM_1_REQ_TQDW FORMAT "%3.0" /end CHARACTERISTIC
/begin CHARACTERISTIC c_ctr_crc_com_1_req_tqdw "Maximum number of wrong Checksum calculation events before error detection of message REQ_TQDW" VALUE 0xa080bb2c _REC_VAL_20_u1 255. _CNV_A_R_LINEAR_____0_CM 0. 255. DISPLAY_IDENTIFIER C_CTR_CRC_COM_1_REQ_TQDW FORMAT "%3.0" /end CHARACTERISTIC
/begin CHARACTERISTIC c_ctr_tcc_com_1_req_tqdw "Maximum number of wrong TCC_COM_1 count events before error detection of message REQ_TQDW" VALUE 0xa080bbcc _REC_VAL_20_u1 255. _CNV_A_R_LINEAR_____0_CM 0. 255. DISPLAY_IDENTIFIER C_CTR_TCC_COM_1_REQ_TQDW FORMAT "%3.0" /end CHARACTERISTIC
/begin CHARACTERISTIC c_ctr_crc_com_1_ac_lgt "Maximum number of wrong Checksum calculation events before error detection of message AC_LGT" VALUE 0xa080bb2a _REC_VAL_20_u1 255. _CNV_A_R_LINEAR_____0_CM 0. 255. DISPLAY_IDENTIFIER C_CTR_CRC_COM_1_AC_LGT FORMAT "%3.0" /end CHARACTERISTIC
/begin CHARACTERISTIC c_ctr_tcc_com_1_ac_lgt "Maximum number of wrong TCC_COM_1 count events before error detection of message AC_LGT" VALUE 0xa080bbca _REC_VAL_20_u1 255. _CNV_A_R_LINEAR_____0_CM 0. 255. DISPLAY_IDENTIFIER C_CTR_TCC_COM_1_AC_LGT FORMAT "%3.0" /end CHARACTERISTIC
/begin CHARACTERISTIC c_ctr_tout_com_1_ac_lgt "Maximum number of missing messages events before error detection of message AC_LGT" VALUE 0xa080bbe0 _REC_VAL_20_u1 255. _CNV_A_R_LINEAR_____0_CM 0. 255. DISPLAY_IDENTIFIER C_CTR_TOUT_COM_1_AC_LGT FORMAT "%3.0" /end CHARACTERISTIC
/begin AXIS_PTS ldp_v_teg_tur_up_mmv_ip_teg_tur "" 0xa08090dc online_dummy _REC_AXS_20_u2 4.999847 _CNV_A_R_LINEAR_____172_CM 16 0. 4.999847 FORMAT "%6.4" /end AXIS_PTS
/begin CHARACTERISTIC ip_teg_tur_up_mes "conversion table of exhaust gas temperature upstream turbine" CURVE 0xa080b51c _REC_CUR_20_u2_u2 2047. _CNV_A_R_LINEAR_____925_CM -273.15 1773.85 DISPLAY_IDENTIFIER IP_TEG_TUR_UP_MES FORMAT "%8.3"
 /begin AXIS_DESCR COM_AXIS online_dummy _CNV_A_R_LINEAR_____172_CM 16 0. 4.999847 FORMAT "%6.4" AXIS_PTS_REF ldp_v_teg_tur_up_mmv_ip_teg_tur /end AXIS_DESCR
/end CHARACTERISTIC
/begin CHARACTERISTIC c_crlc_v_teg_tur_up "Correlations constant of exhaust gas temperature upstream turbine" VALUE 0xa080bb16 _REC_VAL_20_u1 0.99609375 _CNV_A_R_LINEAR_____28_CM 0. 0.99609375 DISPLAY_IDENTIFIER C_CRLC_V_TEG_TUR_UP FORMAT "%5.3" /end CHARACTERISTIC
/begin CHARACTERISTIC c_ctr_tout_com_1_ang_pste "Maximum number of missing messages events before error detection of message ANG_PSTE" VALUE 0xa080bbe2 _REC_VAL_20_u1 255. _CNV_A_R_LINEAR_____0_CM 0. 255. DISPLAY_IDENTIFIER C_CTR_TOUT_COM_1_ANG_PSTE FORMAT "%3.0" /end CHARACTERISTIC
/begin CHARACTERISTIC c_ctr_tout_com_1_swi_gear "Maximum number of missing messages events before error detection of message ANG_PSTE" VALUE 0xa080bbe5 _REC_VAL_20_u1 255. _CNV_A_R_LINEAR_____0_CM 0. 255. DISPLAY_IDENTIFIER C_CTR_TOUT_COM_1_SWI_GEAR FORMAT "%3.0" /end CHARACTERISTIC
/begin CHARACTERISTIC id_opm_av "Switch map to choose DROF calculation path (OPM_1 or OPM_2) depending on OPM_AV" CURVE 0xa0809d94 _REC_CUR_20_u1_u1 1. _CNV_A_R_LINEAR_____0_CM 0. 1. DISPLAY_IDENTIFIER ID_OPM_AV FORMAT "%1.0"
 /begin AXIS_DESCR COM_AXIS opm_av _CNV_A_R_LINEAR_____0_CM 8 0. 8. FORMAT "%1.0" AXIS_PTS_REF ldpm_opm_av /end AXIS_DESCR
/end CHARACTERISTIC
/begin CHARACTERISTIC id_opm_req "Switch map to choose DROF calculation path (OPM_1 or OPM_2) depending on OPM_AV" CURVE 0xa0809dac _REC_CUR_20_u1_u1 1. _CNV_A_R_LINEAR_____0_CM 0. 1. DISPLAY_IDENTIFIER ID_OPM_REQ FORMAT "%1.0"
 /begin AXIS_DESCR COM_AXIS opm_av _CNV_A_R_LINEAR_____0_CM 8 0. 8. FORMAT "%1.0" AXIS_PTS_REF ldpm_opm_av /end AXIS_DESCR
/end CHARACTERISTIC
/begin COMPU_METHOD _CNV_A_R_LINEAR_____0_CM "" RAT_FUNC "%6.3" "-" COEFFS 0 1. 0. 0 0 1 /end COMPU_METHOD
/begin COMPU_METHOD _CNV_S_2_RANGE__0___1_CM "" TAB_VERB "%6.3" "-" COMPU_TAB_REF _CNV_S_2_RANGE__0___1 /end COMPU_METHOD
/begin COMPU_VTAB _CNV_S_2_RANGE__0___1 "" TAB_VERB 2 0 "0" 1 "1" /end COMPU_VTAB
/begin COMPU_METHOD _CNV_A_R_LINEAR_____2_CM "" RAT_FUNC "%6.3" "V" COEFFS 0 204.8 0. 0 0 1 /end COMPU_METHOD
/begin COMPU_METHOD _CNV_A_R_LINEAR_____3_CM "" RAT_FUNC "%6.3" "s" COEFFS 0 100. 0. 0 0 1 /end COMPU_METHOD
/begin COMPU_METHOD _CNV_A_R_LINEAR_____4_CM "" RAT_FUNC "%6.3" "s" COEFFS 0 10. 0. 0 0 1 /end COMPU_METHOD
/begin COMPU_METHOD _CNV_A_R_LINEAR_____5_CM "" RAT_FUNC "%6.3" "%" COEFFS 0 2.56 0. 0 0 1 /end COMPU_METHOD
/begin COMPU_METHOD _CNV_A_R_LINEAR_____6_CM "" RAT_FUNC "%6.3" "km/h" COEFFS 0 1. 0. 0 0 1 /end COMPU_METHOD
/begin COMPU_METHOD _CNV_A_R_LINEAR_____9_CM "" RAT_FUNC "%6.3" "-" COEFFS 0 32767.99999999992 0. 0 0 1 /end COMPU_METHOD
/begin COMPU_METHOD _CNV_A_R_LINEAR_____10_CM "" RAT_FUNC "%6.3" "rpm" COEFFS 0 3.125e-002 0. 0 0 1 /end COMPU_METHOD
/begin COMPU_METHOD _CNV_A_R_LINEAR_____14_CM "" RAT_FUNC "%6.3" "rpm" COEFFS 0 1. 0. 0 0 1 /end COMPU_METHOD
/begin COMPU_METHOD _CNV_A_R_LINEAR_____17_CM "" RAT_FUNC "%6.3" "°C" COEFFS 0 1.333333333333333 64. 0 0 1 /end COMPU_METHOD
/begin COMPU_METHOD _CNV_A_R_LINEAR_____18_CM "" RAT_FUNC "%6.3" "-" COEFFS 0 255.9983911655618 0. 0 0 1 /end COMPU_METHOD
/begin COMPU_METHOD _CNV_A_R_LINEAR_____25_CM "" RAT_FUNC "%6.3" "°C" COEFFS 0 1.333333333333333 0. 0 0 1 /end COMPU_METHOD
/begin COMPU_METHOD _CNV_A_R_LINEAR_____26_CM "" RAT_FUNC "%6.3" "°C" COEFFS 0 1. 40. 0 0 1 /end COMPU_METHOD
/begin COMPU_METHOD _CNV_A_R_LINEAR_____27_CM "" RAT_FUNC "%6.3" "hPa" COEFFS 0 12.06017666543982 0. 0 0 1 /end COMPU_METHOD
/begin COMPU_METHOD _CNV_A_R_LINEAR_____28_CM "" RAT_FUNC "%6.3" "-" COEFFS 0 256. 0. 0 0 1 /end COMPU_METHOD
/begin COMPU_METHOD _CNV_A_R_LINEAR_____29_CM "" RAT_FUNC "%6.3" "rpm/s" COEFFS 0 3.125e-002 128. 0 0 1 /end COMPU_METHOD
/begin COMPU_METHOD _CNV_A_R_LINEAR_____31_CM "" RAT_FUNC "%6.3" "Nm" COEFFS 0 32. 0. 0 0 1 /end COMPU_METHOD
/begin COMPU_METHOD _CNV_A_R_LINEAR_____36_CM "" RAT_FUNC "%6.3" "s" COEFFS 0 1. 0. 0 0 1 /end COMPU_METHOD
/begin COMPU_METHOD _CNV_A_R_LINEAR_____50_CM "" RAT_FUNC "%6.3" "" COEFFS 0 1. 0. 0 0 1 /end COMPU_METHOD
/begin COMPU_METHOD _CNV_A_R_LINEAR_____57_CM "" RAT_FUNC "%6.3" "Nm" COEFFS 0 2. 0. 0 0 1 /end COMPU_METHOD
/begin COMPU_METHOD _CNV_A_R_LINEAR_____58_CM "" RAT_FUNC "%6.3" "km" COEFFS 0 0.1 0. 0 0 1 /end COMPU_METHOD
/begin COMPU_METHOD _CNV_A_R_LINEAR_____64_CM "" RAT_FUNC "%6.3" "Nm" COEFFS 0 1. 0. 0 0 1 /end COMPU_METHOD
/begin COMPU_METHOD _CNV_A_R_LINEAR_____72_CM "" RAT_FUNC "%6.3" "°STW" COEFFS 0 22.75571737399022 0. 0 0 1 /end COMPU_METHOD
/begin COMPU_METHOD _CNV_S_2_RANGE______76_CM "" TAB_VERB "%6.3" "" COMPU_TAB_REF _CNV_S_2_RANGE______76 /end COMPU_METHOD
/begin COMPU_VTAB _CNV_S_2_RANGE______76 "" TAB_VERB 2 0 "0" 1 "1" /end COMPU_VTAB
/begin COMPU_METHOD _CNV_A_R_LINEAR_____84_CM "" RAT_FUNC "%6.3" "min" COEFFS 0 1. 0. 0 0 1 /end COMPU_METHOD
/begin COMPU_METHOD _CNV_A_R_LINEAR_____85_CM "" RAT_FUNC "%6.3" "°STW/s" COEFFS 0 22.75571737399022 0. 0 0 1 /end COMPU_METHOD
/begin COMPU_METHOD _CNV_A_R_LINEAR_____86_CM "" RAT_FUNC "%6.3" "km/h" COEFFS 0 128.0000018750286 0. 0 0 1 /end COMPU_METHOD
/begin COMPU_METHOD _CNV_A_R_LINEAR_____87_CM "" RAT_FUNC "%6.3" "Nm" COEFFS 0 32. 32768. 0 0 1 /end COMPU_METHOD
/begin COMPU_METHOD _CNV_A_R_LINEAR_____89_CM "" RAT_FUNC "%6.3" "-" COEFFS 0 65535.99999999996 0. 0 0 1 /end COMPU_METHOD
/begin COMPU_METHOD _CNV_A_R_LINEAR_____103_CM "" RAT_FUNC "%6.3" "-" COEFFS 0 128. 0. 0 0 1 /end COMPU_METHOD
/begin COMPU_METHOD _CNV_A_R_LINEAR_____111_CM "" RAT_FUNC "%6.3" "mg/stk" COEFFS 0 47.18142548596112 0. 0 0 1 /end COMPU_METHOD
/begin COMPU_METHOD _CNV_A_R_LINEAR_____129_CM "" RAT_FUNC "%6.3" "-" COEFFS 0 1024. 0. 0 0 1 /end COMPU_METHOD
/begin COMPU_METHOD _CNV_A_R_LINEAR_____130_CM "" RAT_FUNC "%6.3" "°C" COEFFS 0 16. 0. 0 0 1 /end COMPU_METHOD
/begin COMPU_METHOD _CNV_A_R_LINEAR_____152_CM "" RAT_FUNC "%6.3" "h" COEFFS 0 35999.99999497086 0. 0 0 1 /end COMPU_METHOD
/begin COMPU_METHOD _CNV_S_7_RANGE_ECU__159_CM "" TAB_VERB "%6.3" "" COMPU_TAB_REF _CNV_S_7_RANGE_ECU__159 /end COMPU_METHOD
/begin COMPU_VTAB _CNV_S_7_RANGE_ECU__159 "" TAB_VERB 7 0 "ENG_STOP" 1 "RUN_ENG" 2 "SYN_ENG_IGK_ON" 3 "SYN_ENG_IGK_OFF" 4 "PWL" 5 "ENG_LOCK" 6 "WAKE_UP" /end COMPU_VTAB
/begin COMPU_METHOD _CNV_A_R_LINEAR_____168_CM "" RAT_FUNC "%6.3" "µl" COEFFS 0 1. 0. 0 0 1 /end COMPU_METHOD
/begin COMPU_METHOD _CNV_A_R_LINEAR_____169_CM "" RAT_FUNC "%6.3" "µl" COEFFS 0 65537. 0. 0 0 1 /end COMPU_METHOD
/begin COMPU_METHOD _CNV_A_R_LINEAR_____171_CM "" RAT_FUNC "%6.3" "hPa" COEFFS 0 0.1884402603974972 0. 0 0 1 /end COMPU_METHOD
/begin COMPU_METHOD _CNV_A_R_LINEAR_____172_CM "" RAT_FUNC "%6.3" "V" COEFFS 0 6553.60054017653 0. 0 0 1 /end COMPU_METHOD
/begin COMPU_METHOD _CNV_A_R_LINEAR_____173_CM "" RAT_FUNC "%6.3" "hPa" COEFFS 0 0.3768805207949945 0. 0 0 1 /end COMPU_METHOD
/begin COMPU_METHOD _CNV_A_R_LINEAR_____176_CM "" RAT_FUNC "%6.3" "l/h" COEFFS 0 257. 0. 0 0 1 /end COMPU_METHOD
/begin COMPU_METHOD _CNV_A_R_LINEAR_____185_CM "" RAT_FUNC "%6.3" "" COEFFS 0 256. 0. 0 0 1 /end COMPU_METHOD
/begin COMPU_METHOD _CNV_S_4_STATE_AMT__186_CM "" TAB_VERB "%6.3" "" COMPU_TAB_REF _CNV_S_4_STATE_AMT__186 /end COMPU_METHOD
/begin COMPU_VTAB _CNV_S_4_STATE_AMT__186 "" TAB_VERB 4 0 "NO" 1 "DEC" 2 "INC" 3 "DEC_INC" /end COMPU_VTAB
/begin COMPU_METHOD _CNV_A_R_LINEAR_____187_CM "" RAT_FUNC "%6.3" "Nm/10ms" COEFFS 0 32. 0. 0 0 1 /end COMPU_METHOD
/begin COMPU_METHOD _CNV_A_R_LINEAR_____188_CM "" RAT_FUNC "%6.3" "°CRK" COEFFS 0 16. 0. 0 0 1 /end COMPU_METHOD
/begin COMPU_METHOD _CNV_A_R_LINEAR_____191_CM "" RAT_FUNC "%6.3" "s" COEFFS 0 32. 0. 0 0 1 /end COMPU_METHOD
/begin COMPU_METHOD _CNV_A_R_LINEAR_____193_CM "" RAT_FUNC "%6.3" "rpm" COEFFS 0 1. 32768. 0 0 1 /end COMPU_METHOD
/begin COMPU_METHOD _CNV_A_R_LINEAR_____198_CM "" RAT_FUNC "%6.3" "°CRK" COEFFS 0 2.666666666666667 128. 0 0 1 /end COMPU_METHOD
/begin COMPU_METHOD _CNV_A_R_LINEAR_____199_CM "" RAT_FUNC "%6.3" "V" COEFFS 0 51.0204081632653 0. 0 0 1 /end COMPU_METHOD
/begin COMPU_METHOD _CNV_A_R_LINEAR_____201_CM "" RAT_FUNC "%6.3" "V" COEFFS 0 13107.19998965744 0. 0 0 1 /end COMPU_METHOD
/begin COMPU_METHOD _CNV_A_R_LINEAR_____209_CM "" RAT_FUNC "%6.3" "°C" COEFFS 0 64. 0. 0 0 1 /end COMPU_METHOD
/begin COMPU_METHOD _CNV_A_R_LINEAR_____212_CM "" RAT_FUNC "%6.3" "%" COEFFS 0 327.68 0. 0 0 1 /end COMPU_METHOD
/begin COMPU_METHOD _CNV_A_R_LINEAR_____219_CM "" RAT_FUNC "%6.3" "mV" COEFFS 0 1. 200. 0 0 1 /end COMPU_METHOD
/begin COMPU_METHOD _CNV_A_R_LINEAR_____227_CM "" RAT_FUNC "%6.3" "°TPS" COEFFS 0 137.0962343096234 0. 0 0 1 /end COMPU_METHOD
/begin COMPU_METHOD _CNV_A_R_LINEAR_____228_CM "" RAT_FUNC "%6.3" "ms" COEFFS 0 1000. 0. 0 0 1 /end COMPU_METHOD
/begin COMPU_METHOD _CNV_A_R_LINEAR_____229_CM "" RAT_FUNC "%6.3" "" COEFFS 0 65535. 0. 0 0 1 /end COMPU_METHOD
/begin COMPU_METHOD _CNV_S_2_RANGE______252_R_CM "" TAB_VERB "%6.3" "-" COMPU_TAB_REF _CNV_S_2_RANGE______252_R /end COMPU_METHOD
/begin COMPU_VTAB_RANGE _CNV_S_2_RANGE______252_R "" 2 0 0 "0" 1 255 "1" /end COMPU_VTAB_RANGE
/begin COMPU_METHOD _CNV_A_R_LINEAR_____446_CM "" RAT_FUNC "%6.3" "A" COEFFS 0 1. 0. 0 0 1 /end COMPU_METHOD
/begin COMPU_METHOD _CNV_A_R_LINEAR_____447_CM "" RAT_FUNC "%6.3" "V" COEFFS 0 66.66666666666667 0. 0 0 1 /end COMPU_METHOD
/begin COMPU_METHOD _CNV_A_R_NOXD_LINEA_486_CM "" RAT_FUNC "%6.3" "ppm" COEFFS 0 1. 0. 0 0 1 /end COMPU_METHOD
/begin COMPU_METHOD _CNV_A_R_LINEAR_____494_CM "" RAT_FUNC "%6.3" "kg/h" COEFFS 0 0.125 0. 0 0 1 /end COMPU_METHOD
/begin COMPU_METHOD _CNV_A_R_LINEAR_____522_CM "" RAT_FUNC "%6.3" "°C" COEFFS 0 0.5 0. 0 0 1 /end COMPU_METHOD
/begin COMPU_METHOD _CNV_A_R_LINEAR_____523_CM "" RAT_FUNC "%6.3" "K" COEFFS 0 32. 0. 0 0 1 /end COMPU_METHOD
/begin COMPU_METHOD _CNV_A_R_LINEAR_____548_CM "" RAT_FUNC "%6.3" "°C" COEFFS 0 2730.670511175186 0. 0 0 1 /end COMPU_METHOD
/begin COMPU_METHOD _CNV_A_R_LINEAR_____888_CM "" RAT_FUNC "%6.3" "°TPS/s" COEFFS 0 8.533333333333333e-002 0. 0 0 1 /end COMPU_METHOD
/begin COMPU_METHOD _CNV_A_R_LINEAR_____925_CM "" RAT_FUNC "%6.3" "°C" COEFFS 0 32. 8740.799999999999 0 0 1 /end COMPU_METHOD
/begin RECORD_LAYOUT _REC_VAL_20_u1 FNC_VALUES 1 UBYTE COLUMN_DIR DIRECT /end RECORD_LAYOUT
/begin RECORD_LAYOUT _REC_VAL_20_u2 FNC_VALUES 1 UWORD COLUMN_DIR DIRECT /end RECORD_LAYOUT
/begin RECORD_LAYOUT _REC_AXS_20_u1 NO_AXIS_PTS_X 1 UBYTE AXIS_PTS_X 2 UBYTE INDEX_INCR DIRECT /end RECORD_LAYOUT
/begin RECORD_LAYOUT _REC_MAP_20_u2_u1_u1 FNC_VALUES 1 UWORD COLUMN_DIR DIRECT /end RECORD_LAYOUT
/begin RECORD_LAYOUT _REC_CUR_20_u1_u1 FNC_VALUES 1 UBYTE COLUMN_DIR DIRECT /end RECORD_LAYOUT
/begin RECORD_LAYOUT _REC_VAL_20_s2 FNC_VALUES 1 SWORD COLUMN_DIR DIRECT /end RECORD_LAYOUT
/begin RECORD_LAYOUT _REC_MAP_20_u2_u2_u1 FNC_VALUES 1 UWORD COLUMN_DIR DIRECT /end RECORD_LAYOUT
/begin RECORD_LAYOUT _REC_AXS_20_u2 NO_AXIS_PTS_X 1 UWORD AXIS_PTS_X 2 UWORD INDEX_INCR DIRECT /end RECORD_LAYOUT
/begin RECORD_LAYOUT _REC_CUR_20_u2_u1 FNC_VALUES 1 UWORD COLUMN_DIR DIRECT /end RECORD_LAYOUT
/begin RECORD_LAYOUT _REC_CUR_20_u2_u2 FNC_VALUES 1 UWORD COLUMN_DIR DIRECT /end RECORD_LAYOUT
/begin RECORD_LAYOUT _REC_CUR_20_u1_u2 FNC_VALUES 1 UBYTE COLUMN_DIR DIRECT /end RECORD_LAYOUT
/begin RECORD_LAYOUT _REC_MAP_20_u2_u2_u2 FNC_VALUES 1 UWORD COLUMN_DIR DIRECT /end RECORD_LAYOUT
/begin RECORD_LAYOUT _REC_MAP_20_u2_u1_u2 FNC_VALUES 1 UWORD COLUMN_DIR DIRECT /end RECORD_LAYOUT
/begin RECORD_LAYOUT _REC_MAP_20_u1_u2_u2 FNC_VALUES 1 UBYTE COLUMN_DIR DIRECT /end RECORD_LAYOUT
/begin RECORD_LAYOUT _REC_VAL_20_u4 FNC_VALUES 1 ULONG COLUMN_DIR DIRECT /end RECORD_LAYOUT
/begin RECORD_LAYOUT _REC_MAP_20_u1_u1_u1 FNC_VALUES 1 UBYTE COLUMN_DIR DIRECT /end RECORD_LAYOUT
/begin RECORD_LAYOUT _REC_MAP_20_u1_u2_u1 FNC_VALUES 1 UBYTE COLUMN_DIR DIRECT /end RECORD_LAYOUT
/begin FUNCTION SYS_System_variables_for_and_from_CUS "_System variables for and from CUS"
 /begin DEF_CHARACTERISTIC lc_pwsl_ena c_bat_psn c_maf_ref c_mff_sp_1_homs_man c_mff_sp_2_homs_man lc_mff_sp_homs_man_act lc_fac_s_cor_man c_fac_3_s_cor c_add_pulse_ena /end DEF_CHARACTERISTIC
 /begin OUT_MEASUREMENT load_bat state_cur_eng_cns n_st_pow_mod lv_n_sp_is_pow_act state_alter tq_loss_alter_1 cur_alter_max pow_rel_alter_clc temp_alter vb_pow_mng cur_gen lv_alter_swi_off t_fil_cur_exct_alter lv_n_sp_is_pwr_stab n_alter n_sp_is_pow_1 /end OUT_MEASUREMENT
/end FUNCTION
/begin FUNCTION SYS_ECU_state "_ECU state" /begin DEF_CHARACTERISTIC c_t_di_eng_run /end DEF_CHARACTERISTIC /begin OUT_MEASUREMENT fast_ecu_tran_pwl_ctr ecu_state /end OUT_MEASUREMENT /end FUNCTION
/begin FUNCTION SYS_Pressure_Variables "_Pressure Variables"
 /begin DEF_CHARACTERISTIC ldp_v_put__put_mes_bas ip_put_mes_bas lc_map_absv_rel_swi lc_put_absv_rel_swi ip_map_mes_bas lc_ptcha_absv_rel_swi c_t_dly_map_mes_ad c_tps_v_map_ad_min c_fac_temp_map_dip_tco_ex c_fac_temp_map_dip_tia c_fac_temp_map_dip_tam c_fac_v_map_ad c_fac_temp_v_map_ad c_nr_v_map_acq c_v_map_sp_ad c_v_map_ad_max c_temp_map_dip_mdl_fac_min c_temp_map_dip_mdl_fac_max c_v_map_sp_dif_max c_fac_temp_v_map_sp_dif_max ip_prs_cha_up ldp_v_prs_cha_up ip_prs_cha_down ldp_v_prs_cha_down /end DEF_CHARACTERISTIC
 /begin OUT_MEASUREMENT map_dip_mes_bas[0] map_dip_mes_bas[1] put_mes_bas[0] put_mes_bas[1] map_dip_mes_bas_2seg[0] map_dip_mes_bas_2seg[1] put_mes_bas_2seg[0] put_mes_bas_2seg[1] v_put[0] v_put[1] temp_map_dip_mdl[0] temp_map_dip_mdl[1] v_map_ad[0] v_map_ad[1] v_map_dif[0] v_map_dif[1] v_map_dif_vld[0] v_map_dif_vld[1] lv_t_dly_map_mes_ad[0] lv_t_dly_map_mes_ad[1] prs_cha_up[0] prs_cha_up[1] v_map[0] v_map[1] v_prs_cha_up[0] v_prs_cha_up[1] lv_cdn_com_diag lv_veh_state_msg_vld /end OUT_MEASUREMENT
/end FUNCTION
/begin FUNCTION SYS_Engine_off_duration "_Engine off duration"
 /begin DEF_CHARACTERISTIC c_t_es_tco_plaus_max c_t_es_tco_plaus_min c_tco_stop_t_es_plaus_min c_t_es_sub c_t_ast_t_es c_tco_stop_t_es_plaus_max c_tco_stop_t_es_min /end DEF_CHARACTERISTIC
 /begin OUT_MEASUREMENT t_es t_es_ast t_rel_can_es t_rel_can_st t_rel_can_ast lv_t_rel_can_reg lv_t_es_not_plaus lv_t_es_not_plaus_ast t_es_cus lv_t_es_plaus_ast_end /end OUT_MEASUREMENT
/end FUNCTION
/begin FUNCTION SYS_Total_running_time "_Total running time" /begin OUT_MEASUREMENT trt /end OUT_MEASUREMENT /end FUNCTION
/begin FUNCTION SYS_Determination_of_Throttle_Position "_Determination of Throttle Position" /begin OUT_MEASUREMENT tps_av_mv tps_grd_mv /end OUT_MEASUREMENT /end FUNCTION
/begin FUNCTION _Intake_manifold_model "_Appl. Inc. Intake manifold model" /begin OUT_MEASUREMENT lv_maf_ctl /end OUT_MEASUREMENT /end FUNCTION
/begin FUNCTION SYS_ECU_Temperature "_ECU Temperature"
 /begin DEF_CHARACTERISTIC ip_tecu c_tecu_sub c_tecu_thd_1 c_tecu_thd_2 c_tecu_thd_3 c_tecu_thd_4 c_tecu_thd_5 c_tecu_thd_6 c_tecu_thd_7 c_trt_dif_tecu lc_tecu_swi /end DEF_CHARACTERISTIC
 /begin OUT_MEASUREMENT ctr_stc_tecu_1 ctr_stc_tecu_2 ctr_stc_tecu_3 ctr_stc_tecu_4 ctr_stc_tecu_5 ctr_stc_tecu_6 ctr_stc_tecu_7 ctr_stc_tecu_8 tecu lv_err_tecu vp_tecu lv_v_tecu_vld v_tecu_mc tecu_mc /end OUT_MEASUREMENT
/end FUNCTION
/begin FUNCTION SYS_Output_signals_of_the_DME_to_the_CAN_bus "_Output signals of the DME to the CAN bus"
 /begin DEF_CHARACTERISTIC c_t_cyc_disp_icl_can c_icl_disp_frq c_cc_mess ip_t_ast_swi_wup__ctr_km_can c_n_32_thd_cc_poil_swi ip_t_dly_poil_swi_can__toil c_n_sp_is_thd_can lc_msr_bn lc_ena_cc_mil_1 lc_ena_cc_mil_2 c_state_cc_id_34 c_state_cc_id_33 c_state_cc_id_257 c_tco_swi_wup c_state_cc_id_39 c_state_cc_id_212 c_state_cc_id_213 c_state_cc_id_26 c_state_cc_id_28 c_state_cc_id_29 c_state_cc_id_31 c_state_cc_id_155 c_state_cc_id_27 c_state_cc_id_32 c_state_cc_id_182 c_state_cc_id_229 c_state_cc_id_247 c_state_cc_id_220 c_state_cc_id_304 c_state_cc_id_305 c_state_cc_id_148 c_state_cc_id_276 c_state_cc_id_278 c_state_cc_id_bench c_ctr_dly_msg_oil c_state_loil_sub c_n_ecf_can c_ctr_ldm_can_ini lc_efppwm_ctl lc_cc_test_bench c_state_cc_test_bench c_state_cc_test_mask_obd_1 c_state_cc_test_mask_obd_2 c_ctr_err_dyn_cc_test_bench c_state_opm_max_cc_test_bench c_state_opm_min_cc_test_bench c_state_cc_test_bench_obd_1 c_state_cc_test_bench_obd_2 c_state_coc_min_cc_test_bench c_state_coc_max_cc_test_bench c_state_cc_id_397 c_state_cc_id_367 c_cc_id_test_bench c_ctr_tout_n_ecf_can c_ctr_tout_state_err_can c_t_max_err_n_eng c_tq_max_acc c_state_cc_id_306 c_state_cc_id_427 c_fac_mff_fco c_crlc_fco_av c_fco_dif_max c_t_fac_fco_fil_rgn[0] c_t_fac_fco_fil_rgn[1] c_t_fac_fco_fil_so2p[0] c_t_fac_fco_fil_so2p[1] c_t_fac_ramp_fco_fil c_fco_dif_gain c_t_fac_fco_fil_isc[0] c_t_fac_fco_fil_isc[1] c_t_fac_fco_fil_so2p_fast[0] c_t_fac_fco_fil_so2p_fast[1] c_t_igk_lih c_t_dly_igk_off_prel c_t_temp_igk_off_prel ip_t_ast_is_ad_inh c_ctr_tout_com_2_trl c_ctr_tout_com_2_gear_rev c_ctr_tout_com_2_efp_crash c_ctr_tout_com_2_state_veh c_ctr_tout_veh_state c_ctr_tout_com_1_vs c_ctr_crc_com_1_vs c_ctr_tcc_com_1_vs c_ctr_crc_com_1_tq_pste c_ctr_tcc_com_1_tq_pste c_ctr_tout_com_1_tq_pste c_ctr_tout_com_1_req_tqdw c_ctr_crc_com_1_req_tqdw c_ctr_tcc_com_1_req_tqdw c_ctr_crc_com_1_ac_lgt c_ctr_tcc_com_1_ac_lgt c_ctr_tout_com_1_ac_lgt c_ctr_tout_com_1_ang_pste c_ctr_tout_com_1_swi_gear /end DEF_CHARACTERISTIC
 /begin OUT_MEASUREMENT tcc_can_ecu tcc_can_ecu1 tcc_can_ecu2 tcc_can_ecu3 cc_id lv_mil_fll tq_ems_bn tq_maf state_cc_key state_dcc_ctl ctr_dly_msg_oil tq_max_acc_can ctl_shift_lock_can lv_level_is fco fco_av_mmv fco_dmtl fco_av fco_av_fil[0] fco_av_fil[1] t_fac_fco_fil[0] t_fac_fco_fil[1] fac_fco_fil[0] fac_fco_fil[1] fco_fil_dif tq_ecu_etcu /end OUT_MEASUREMENT
/end FUNCTION
/begin FUNCTION SYS_Check_Sum_Calculation "_Check Sum Calculation"
 /begin OUT_MEASUREMENT ctl_acin_eng_typ state_swi_off_vb cks_can_tq_dcc cks_can_tq_tcs cks_can_tq_etcu cks_can_tq_amt cks_can_msw cks_can_cas cks_clc_cas cks_can_etcu_3 cks_clc_etcu_3 cks_clc_tq_dcc cks_clc_tq_tcs cks_clc_tq_etcu cks_clc_tq_amt cks_clc_msw cks_clc_ecu1 cks_clc_ecu2 cks_clc_ecu3 cks_can_veh_mod cks_can_tq_pste_2 cks_can_tq_pste_3 cks_clc_tq_pste_2 cks_clc_tq_pste_3 cks_can_ldm cks_clc_ldm cks_clc_tq_wheel_1 cks_clc_tq_wheel_2 state_pow_clas_veh t_clk_icl_disp_1 t_clk_icl_disp_2 t_clk_icl_disp_3 n_ecf_can ecf_req_ext qoil_ds_rst_can_2_1 qoil_ds_rst_can_2_2 qoil_ds_rst_can_2_3 qoil_ds_rst_can_2_4 qoil_ds_rst_can_2_5 qoil_ds_rst_can_2_6 crc_clc_com_1_tq_crk_1 crc_clc_com_2_tq_crk_1 crc_clc_com_3_tq_crk_1 crc_clc_com_2_tq_crk_2 crc_clc_com_3_tq_crk_2 crc_clc_com_1_tq_crk_3 crc_clc_com_2_tq_crk_3 crc_clc_com_3_tq_crk_3 crc_clc_com_1_tq_wheel crc_clc_com_1_etcu_dt crc_clc_com_2_etcu_dt crc_clc_com_1_info_dt_2 crc_clc_com_2_info_dt_2 crc_clc_com_3_info_dt_2 crc_clc_com_1_pv /end OUT_MEASUREMENT
/end FUNCTION
/begin FUNCTION SYS_Multiplexed_segment_synchronous_output_variables "_Multiplexed segment-synchronous output variables" /begin DEF_CHARACTERISTIC c_iga_ini_h_rng /end DEF_CHARACTERISTIC
 /begin OUT_MEASUREMENT iga_igc_h_rng_mux iga_knk_mux knk_thd_mux knks_mux nl_mux ti_1_hom_mux ti_2_hom_mux ti_1_s_mux ti_2_s_mux knks_rel_nl_mux /end OUT_MEASUREMENT
/end FUNCTION
/begin FUNCTION SYS_NOx_Sensor_Interface "_NOx-Sensor Interface"
 /begin DEF_CHARACTERISTIC c_t_nox_sens_nox_hld c_t_nox_sens_nox_auth c_t_nox_sens_nox_mdl c_crlc_nox_nox_sens c_crlc_nox_nox_sens_diag c_t_nox_sens_lamb_hld c_t_nox_sens_vls_hld c_t_nox_sens_pwr_hld c_t_nox_sens_lamb_auth c_t_nox_sens_vls_auth lc_nox_sens_nox_man[0] lc_nox_sens_nox_man[1] c_nox_nox_sens[0] c_nox_nox_sens[1] lc_nox_sens_nox_vld[0] lc_nox_sens_nox_vld[1] lc_nox_sens_lamb_man[0] lc_nox_sens_lamb_man[1] c_lamb_nox_sens[0] c_lamb_nox_sens[1] lc_nox_sens_lamb_vld[0] lc_nox_sens_lamb_vld[1] lc_nox_sens_vls_man[0] lc_nox_sens_vls_man[1] c_vls_nox_sens[0] c_vls_nox_sens[1] lc_nox_sens_vls_vld[0] lc_nox_sens_vls_vld[1] lc_nox_sens_err_man[0] lc_nox_sens_err_man[1] c_err_nox_sens[0] c_err_nox_sens[1] /end DEF_CHARACTERISTIC
 /begin OUT_MEASUREMENT nox_nox_sens_diag[0] nox_nox_sens_diag[1] err_ns[0] err_ns[1] lv_nox_sens_nox_diag_vld[0] lv_nox_sens_nox_diag_vld[1] nox_nox_sens[0] nox_nox_sens[1] lv_nox_sens_nox_vld[0] lv_nox_sens_nox_vld[1] lv_nox_sens_vls_auth[0] lv_nox_sens_vls_auth[1] lv_nox_sens_nox_auth[0] lv_nox_sens_nox_auth[1] t_nox_sens_nox_hld[0] t_nox_sens_nox_hld[1] lv_nox_sens_nox_mdl_vld[0] lv_nox_sens_nox_mdl_vld[1] t_nox_sens_nox_mdl[0] t_nox_sens_nox_mdl[1] lamb_nox_sens_diag[0] lamb_nox_sens_diag[1] lv_nox_sens_lamb_diag_vld[0] lv_nox_sens_lamb_diag_vld[1] lamb_nox_sens[0] lamb_nox_sens[1] lv_nox_sens_lamb_vld[0] lv_nox_sens_lamb_vld[1] lv_nox_sens_lamb_auth[0] lv_nox_sens_lamb_auth[1] t_nox_sens_lamb_hld[0] t_nox_sens_lamb_hld[1] vls_nox_sens_diag[0] vls_nox_sens_diag[1] lv_nox_sens_vls_diag_vld[0] lv_nox_sens_vls_diag_vld[1] vls_nox_sens[0] vls_nox_sens[1] lv_nox_sens_vls_vld[0] lv_nox_sens_vls_vld[1] t_nox_sens_vls_hld[0] t_nox_sens_vls_hld[1] nox_sens_temp[0] nox_sens_temp[1] t_nox_sens_pwr[0] t_nox_sens_pwr[1] /end OUT_MEASUREMENT
/end FUNCTION
/begin FUNCTION SYS_Application_Incidences_NOx_Sensor_Interface "_Application Incidences NOx-Sensor Interface" /begin DEF_CHARACTERISTIC lc_nox_sens_2 c_nox_sens_cycnr_max c_r_ratio_nox_sens_min /end DEF_CHARACTERISTIC
 /begin OUT_MEASUREMENT can_nox_nox_sens[0] can_nox_nox_sens[1] can_lamb_nox_sens[0] can_lamb_nox_sens[1] can_err_nox_sens[0] can_err_nox_sens[1] can_vls_nox_sens[0] can_vls_nox_sens[1] can_state_nox_sens[0] can_state_nox_sens[1] lv_can_temp_min_thd_1 lv_can_temp_min_thd_2 lv_mdl_temp_min_thd_1 lv_mdl_temp_min_thd_2 can_r_ratio_nox_sens[0] can_r_ratio_nox_sens[1] /end OUT_MEASUREMENT
/end FUNCTION
/begin FUNCTION SYS_BN2000_interface_torque_distribution "_BN2000 interface torque distribution"
 /begin DEF_CHARACTERISTIC c_thd_t_tq_dcc_cs c_crlc_tq_dcc_cs_dec c_crlc_tq_dcc_cs_inc lc_ena_tq_dcc_cs ip_tq_dcc_cs ldp_n_tq_dcc_cs /end DEF_CHARACTERISTIC
 /begin OUT_MEASUREMENT tq_amt_fast_dec_bn tq_amt_slow_dec_bn tq_amt_fast_inc_bn tq_amt_slow_inc_bn tq_dcc_fast_inc_bn tq_dcc_slow_inc_bn tq_gs_fast_dec_bn tq_gs_fast_inc_bn tq_gs_slow_dec_bn tq_gs_slow_inc_bn tq_msr_fast_inc_bn tq_msr_slow_inc_bn tq_asr_fast_dec_bn tq_asr_slow_dec_bn t_tq_dcc_cs lv_err_sym_tq_dcc_cs tq_wheel_ldm_inc_dec_bn /end OUT_MEASUREMENT
/end FUNCTION
/begin FUNCTION SYS_Driving_off_assistance "_Driving off assistance"
 /begin DEF_CHARACTERISTIC ip_t_n_dif_ofs_pred_drof c_gear_max_fast_load_im c_vs_max_fast_load_im c_n_max_fast_load_im c_t_ast_min_fast_load_im lc_fast_load_im_is lc_ena_fast_load_im_n_sp ip_fac_vs_tq_add_pl_drof ip_fac_n_grd_tq_av ip_fac_tq_drof_fac_tq_req c_n_dif_drof_min c_n_dif_drof_max lc_tq_drof_isc_off id_tq_drof_ena c_tq_drof_min id_var_amt_load_im c_tq_drof_ad c_t_tq_drof_dly_ad ip_tq_add_pl_drof_opm_1 ip_tq_add_pl_drof_opm_2 ip_fac_temp_tq_add_drof_opm_1 ip_fac_temp_tq_add_drof_opm_2 ip_n_dif_add_drof_opm_1 ip_n_dif_add_drof_opm_2 id_idx_opm_drof ip_tq_drof_slow_opm_1 ip_tq_drof_slow_opm_2 ip_tq_drof_fast_opm_1 ip_tq_drof_fast_opm_2 ip_fac_tq_drof_vs_opm_1 ip_fac_tq_drof_vs_opm_2 ip_tq_drof_grd_deac_opm_1 ip_tq_drof_grd_deac_opm_2 lc_tq_add_pl_drof_ena_brake c_tq_add_pl_drof_lgrd id_opm_av id_opm_req /end DEF_CHARACTERISTIC
 /begin OUT_MEASUREMENT tq_add_pl_drof n_dif_pred_pl_drof lv_fast_load_im tq_drof_slow n_dif_drof lv_isc_off_drof tq_drof_fast lv_tq_drof_is_ad_inh /end OUT_MEASUREMENT
/end FUNCTION
/begin FUNCTION SYS_Power_Steering_acquisition_variable "_Power Steering acquisition variable"
 /begin DEF_CHARACTERISTIC c_ang_pste_end_le_ini c_ang_pste_end_ri_ini c_ang_pste_end_dif c_crlc_vel_ang_pste c_vel_ang_pste_min_1 c_vel_ang_pste_min_2 c_t_vel_ang_pste lc_vel_ang_pste_cor c_vs_pste c_vel_ang_pste_max_ad c_ang_pste_ad_lgrd c_t_ang_pste_ad /end DEF_CHARACTERISTIC
 /begin OUT_MEASUREMENT ang_pste_stnd ang_pste_end_ri_ad ang_pste_end_le_ad vel_ang_pste_cor vel_ang_pste_mmv t_vel_ang_pste lv_vel_ang_pste_min_det lv_stg_ri_act /end OUT_MEASUREMENT
/end FUNCTION
/begin FUNCTION SYS_Acquisition_of_exhaust_gas_temperature_downstream_of_pre_catalyst "_Acquisition of exhaust gas temperature downstream of pre-catalyst"
 /begin DEF_CHARACTERISTIC c_teg_pcat_down_st_ini ldp_maf_kgh_ip_teg_pcat_err ip_teg_pcat_down_add_err ldp_vp_teg__teg ldp_vp_teg__teg_wide_rng ip_teg__vp_teg ip_teg_wide_rng__vp_teg /end DEF_CHARACTERISTIC
 /begin OUT_MEASUREMENT teg_pcat_down_st teg_pcat_down_wide_rng_st teg_pcat_down_1 teg_pcat_down_2 teg_pcat_down_raw teg_pcat_down_wide_rng vp_teg_pcat_down /end OUT_MEASUREMENT
/end FUNCTION
/begin FUNCTION SYS_Fuel_pressure "_Fuel pressure"
 /begin DEF_CHARACTERISTIC ip_fup_mes ldp_v_fup_mv_ip_fup_mes c_fup_mes_crlc c_fup_ofs_lih_l_prs_ctl_req /end DEF_CHARACTERISTIC
 /begin OUT_MEASUREMENT fup_mes_mmv[0] fup_mes_mmv[1] fup_mes[0] fup_mes[1] v_fup_mv[0] v_fup_mv[1] lv_fup_seg fup_h[0] fup_h[1] fup[0] fup[1] fup_mv fup_h_mv /end OUT_MEASUREMENT
/end FUNCTION
/begin FUNCTION SYS_Modeled_Fuel_Temperature "_Modeled Fuel Temperature"
 /begin DEF_CHARACTERISTIC c_tfu_sub_stop_ini ip_fac_vs_ecfpwm_ecf ldp_vs_ip_fac_vs_ecfpwm_ecf ldp_ecfpwm_ecf_ip_fac ip_fac_teg_t_es_teg_dyn_stop ldp_teg_dyn_stop_ip_fac_teg ldp_t_es_ip_fac_teg_t_es ldp_t_es_ip_fac_t_es c_crlc_fac_temp_dif_tco_tia c_crlc_fac_vff_mff_sp_fup_ctl ip_fac_t_es ip_fac_vff_mff_sp_fup_ctl ldp_vff_mff_sp_fup_ctl ip_crlc_tfu_t_ast_vff_mff_sp ldp_t_ast_ip_crlc_tfu_vff_mff ldp_vff_mff_sp_fup_ctl_ip_crlc ip_tam_add_tfu_iv ip_tam_add_tfu_raw ip_tco_temp_dif_tco_tia ldp_tam_add_tfu_iv ldp_tam_add_tfu_raw ldp_temp_dif_tco_tia_ip_tco c_crlc_fac_vs_ecfpwm_ecf c_t_tfu_clc ip_d_tiv_norm_n_mff_sp ip_temp_dif_n_mff_sp_iv ip_fac_tiv_ewp_cor ip_fac_tiv_tco_cor ip_fac_tco_temp_iv_cor c_crlc_fac_temp_iv lc_tfu_tia_tco_ex lc_tco_tfu_iv_sub lc_temp_fuel_rail_wall_tam ldp_n_ip_d_tiv_norm_n_mff_sp ldp_n_ip_temp_dif_iv ldp_mff_sp_ip_d_tiv_norm_n_mff ldp_mff_sp_ip_temp_dif_iv ldp_tiv_tco_cor_ip_fac_tiv_tco ldp_tco_ip_fac_tco_temp_iv_cor ldp_tiv_ewp_cor_ip_fac_tiv_ewp c_tfu_efp_ofs ip_fac_temp_iv_cwp_cor ip_crlc_tfu_iv_sub_vff_mff_sp ldp_n_ip_fac_temp_iv_cwp_cor ldp_vff_mff_sp_ip_crlc_tfu_iv c_crlc_tfu_iv_sub_rise c_crlc_tfu_iv_sub_fall c_tfu_raw_swi_ini c_tfu_raw_lim_dec c_tfu_raw_lim_inc /end DEF_CHARACTERISTIC
 /begin OUT_MEASUREMENT tfu tfu_sub_stop temp_dif_tco_tia tfu_lpf_tco tfu_raw tfu_add_fuel_flow temp_fuel_rail_wall tfu_ofs_air temp_fuel_rail_sub tfu_iv_sub tfu_iv tfu_efp tfu_iv_sub_raw tfu_raw_step_clc_inc tfu_raw_step_clc_dec /end OUT_MEASUREMENT
/end FUNCTION
/begin FUNCTION SYS_Fuel_pres_acq_ele_fuel_pump "Fuel_pres_acq_ele_fuel_pump"
 /begin DEF_CHARACTERISTIC c_fup_efp_mes_crlc ldp_v_fup_efp_ip_fup_efp ip_fup_efp c_fup_efp_lih /end DEF_CHARACTERISTIC
 /begin OUT_MEASUREMENT fup_efp fup_efp_mes fup_efp_mmv v_fup_efp_mv /end OUT_MEASUREMENT
/end FUNCTION
/begin FUNCTION SYS_Exhaust_gas_temperature "_Exhaust gas temperature"
 /begin DEF_CHARACTERISTIC ldp_v_teg_tur_up_mmv_ip_teg_tur ip_teg_tur_up_mes c_crlc_v_teg_tur_up /end DEF_CHARACTERISTIC
/end FUNCTION
/begin FUNCTION C_D_TQM "C_D_TQM"
 /begin SUB_FUNCTION TQM_Torque_request_for_gear_shift_intervention TQM_Initialization_module TQM_Torque_control_at_engine_start TQM_Reference_and_basic_torque TQM_Torque_loss_and_reserve_for_ACC TQM_Torque_based_pattern_calculation TQM_Minimum_torque_at_clutch TQM_Converter_torque TQM_Pedal_value_interpretation TQM_Maximum_torque_at_clutch TQM_Torque_Request_at_Clutch_General TQM_Actual_Engine_Torque TQM_Engine_torque_limitation TQM_Torque_Request_for_Cruise_Control TQM_Torque_Request_for_safety TQM_Torque_loss_for_power_steering TQM_Torque_Monitoring_Limitation_and_Coordination TQM_Application_incidences_for_torque_based_pattern_calculation TQM_Torque_Transient TQM_Torque_request_for_distance_cruise_control TQM_AMT_Clutch_torque TQM_Torque_request_for_AMT_intervention TQM_Minimum_indicated_engine_torque_at_trailing_throttle TQM_Torque_Request_for_Traction_Control_TCS TQM_Torque_Loss___Anti_Roll_Stabilisation TQM_TQ_Based_CH_For_Desulf TQM_Torque_Request_for_LDM TQM_General_Flag_for_inhibition_of_external_torque_request /end SUB_FUNCTION
/end FUNCTION
/begin FUNCTION TQM_Torque_request_for_gear_shift_intervention "_Torque request for gear shift intervention"
 /begin DEF_CHARACTERISTIC c_t_max_tqr_gs_intv c_gs_ena_inc_dec c_lgrd_lih_gs_dec c_lgrd_lih_gs_inc c_t_dly_lih_gs_dec c_t_dly_lih_gs_inc /end DEF_CHARACTERISTIC
 /begin OUT_MEASUREMENT lv_etcu_disable lv_etcu_disable_can lv_gs_ena_dec lv_gs_ena tqi_gs_fast_dec_req_1 tqi_gs_slow_dec_req tqi_gs_fast_inc_req_1 tqi_gs_slow_inc_req t_tqr_gs_intv tqi_gs_fast_dec_req tqi_gs_fast_dec tqi_gs_slow_dec_req_1 tqi_gs_slow_dec lv_gs_ena_inc lv_gs_dec_lih tqi_gs_fast_inc_req tqi_gs_fast_inc tqi_gs_slow_inc_req_1 tqi_gs_slow_inc lv_gs_dec_act lv_gs_inc_lih lv_gs_inc_act t_gs_inc_lih_ctr t_gs_dec_lih_ctr state_tq_etcu_plaus /end OUT_MEASUREMENT
/end FUNCTION
/begin FUNCTION TQM_Initialization_module "_Initialization module"
 /begin OUT_MEASUREMENT tqi_vs_max lv_tq_loss_acc_inp_orng lv_iga_ch_so2p_stb lamb_bas_cor_max lv_can_gs_ack lv_acp_orng eff_egr_s eff_pha_s tq_ad_add_s_swi tqi_cat_prot tq_loss_thermo tq_loss_win_heat tqi_p_max tqi_pbr_max /end OUT_MEASUREMENT
/end FUNCTION
/begin FUNCTION TQM_Torque_control_at_engine_start "_Torque control at engine start"
 /begin DEF_CHARACTERISTIC c_crlc_tq_st ip_tq_st_mt_opm_2 ip_tq_st_mt_opm_1 ip_tq_st_at_opm_1 ip_tq_st_at_opm_2 id_opm_av_tq_st /end DEF_CHARACTERISTIC
 /begin OUT_MEASUREMENT tq_st_1 tq_st opm_av_sel_tq_st /end OUT_MEASUREMENT
/end FUNCTION
/end MODULE
/end PROJECT
