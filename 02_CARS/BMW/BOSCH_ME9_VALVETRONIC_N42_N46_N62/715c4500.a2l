/* Erstellt von DAMOS++ V1.19-5 */
ASAP2_VERSION 1 3
/begin PROJECT _715C4500 "basisme9"
/begin HEADER "" VERSION "_715C4500" PROJECT_NO _715C4500 /end HEADER
/begin MODULE DIM ""
/begin MOD_PAR "basisme9" VERSION "basisme9" CUSTOMER_NO "11" USER "ME(D)9" PHONE_NO "" CPU_TYPE "GoldenOak" ECU "ME92"
 /begin MEMORY_SEGMENT Pst8000 "" CODE EPROM INTERN 0x8000 0x68000 -1 -1 -1 -1 -1 /begin IF_DATA ETK ADDRESS_MAPPING 0x8000 0x8000 0x68000 /end IF_DATA /begin IF_DATA ASAP1B_CCP ADDRESS_MAPPING 0x8000 0x8000 0x68000 /end IF_DATA /begin IF_DATA ASAP1B_KWP2000 ADDRESS_MAPPING 0x8000 0x8000 0x68000 /end IF_DATA /end MEMORY_SEGMENT
 /begin MEMORY_SEGMENT PstF00000 "" CODE EPROM EXTERN 0xF00000 0xC0000 -1 -1 -1 -1 -1 /begin IF_DATA ETK ADDRESS_MAPPING 0xF00000 0xF00000 0xC0000 /end IF_DATA /begin IF_DATA ASAP1B_CCP ADDRESS_MAPPING 0xF00000 0xF00000 0xC0000 /end IF_DATA /begin IF_DATA ASAP1B_KWP2000 ADDRESS_MAPPING 0xF00000 0xF00000 0xC0000 /end IF_DATA /end MEMORY_SEGMENT
 /begin MEMORY_SEGMENT DstFC0000 "" DATA EPROM INTERN 0xFC0000 0x20000 -1 -1 -1 -1 -1 /begin IF_DATA ETK ADDRESS_MAPPING 0xFC0000 0x5C0000 0x20000 /end IF_DATA /begin IF_DATA ASAP1B_CCP ADDRESS_MAPPING 0xFC0000 0x1C0000 0x20000 /end IF_DATA /begin IF_DATA ASAP1B_KWP2000 ADDRESS_MAPPING 0xFC0000 0x1C0000 0x20000 /end IF_DATA /end MEMORY_SEGMENT
 /begin MEMORY_SEGMENT ExtRam5E0000 "" VARIABLES RAM EXTERN 0x5E0000 0x10000 -1 -1 -1 -1 -1 /* AsapMLXFm - CCP_V2_1 */ /begin IF_DATA ETK ADDRESS_MAPPING 0x5E0000 0x5E0000 0x10000 /end IF_DATA /* AsapMLXFm - KWP2000 */ /end MEMORY_SEGMENT
 /begin MEMORY_SEGMENT Ram3F9800 "" VARIABLES RAM INTERN 0x3F9800 0x6800 -1 -1 -1 -1 -1 /end MEMORY_SEGMENT
 /begin MEMORY_SEGMENT Ram5B8000 "" VARIABLES RAM INTERN 0x5B8000 0x8000 -1 -1 -1 -1 -1 /end MEMORY_SEGMENT
 SYSTEM_CONSTANT "ACTIV" "1"
 SYSTEM_CONSTANT "DPS_ANWSE" "0"
 SYSTEM_CONSTANT "DPS_BKVPE" "0"
 SYSTEM_CONSTANT "DPS_ELS" "0"
 SYSTEM_CONSTANT "DPS_ENWSE" "0"
 SYSTEM_CONSTANT "DPS_ETS" "0"
 SYSTEM_CONSTANT "DPS_EV1E" "0"
 SYSTEM_CONSTANT "DPS_EV2E" "1"
 SYSTEM_CONSTANT "DPS_EV3E" "2"
 SYSTEM_CONSTANT "DPS_EV4E" "3"
 SYSTEM_CONSTANT "DPS_KOSE" "0"
 SYSTEM_CONSTANT "DPS_KPE" "0"
 SYSTEM_CONSTANT "DPS_MLE" "0"
 SYSTEM_CONSTANT "DPS_SLPE" "0"
 SYSTEM_CONSTANT "DPS_TEVE" "0"
 SYSTEM_CONSTANT "SWOFFDL_REQUEST_MASK" "16383"
 SYSTEM_CONSTANT "SYNWS1" "3"
 SYSTEM_CONSTANT "SY_2SG" "0"
 SYSTEM_CONSTANT "SY_2SLS" "0"
 SYSTEM_CONSTANT "SY_2TEV" "0"
 SYSTEM_CONSTANT "SY_AAU" "0"
 SYSTEM_CONSTANT "SY_AAV" "0"
 SYSTEM_CONSTANT "SY_ABGY" "0"
 SYSTEM_CONSTANT "SY_ABMZND" "0"
 SYSTEM_CONSTANT "SY_AGR" "0"
 SYSTEM_CONSTANT "SY_AGR_DSS" "0"
 SYSTEM_CONSTANT "SY_AIRBAG" "1"
 SYSTEM_CONSTANT "SY_ANNWSYN" "4"
 SYSTEM_CONSTANT "SY_ANSKL" "0"
 SYSTEM_CONSTANT "SY_ASR" "1"
 SYSTEM_CONSTANT "SY_ATR" "0"
 SYSTEM_CONSTANT "SY_AVS" "1"
 SYSTEM_CONSTANT "SY_BATTORT" "1"
 SYSTEM_CONSTANT "SY_BATTSG" "0"
 SYSTEM_CONSTANT "SY_BDE" "0"
 SYSTEM_CONSTANT "SY_BKV" "0"
 SYSTEM_CONSTANT "SY_BKVP" "4"
 SYSTEM_CONSTANT "SY_BLOOP" "0"
 SYSTEM_CONSTANT "SY_C95ANZ" "1"
 SYSTEM_CONSTANT "SY_CAN" "0"
 SYSTEM_CONSTANT "SY_CARBPROT" "1"
 SYSTEM_CONSTANT "SY_CDCSIZE" "4"
 SYSTEM_CONSTANT "SY_CDKSIZE" "1"
 SYSTEM_CONSTANT "SY_CDTSIZE" "1"
 SYSTEM_CONSTANT "SY_CJ125" "0"
 SYSTEM_CONSTANT "SY_CKBI" "1"
 SYSTEM_CONSTANT "SY_CLASIZE" "1"
 SYSTEM_CONSTANT "SY_CSBVAR" "0"
 SYSTEM_CONSTANT "SY_DEGFE" "1"
 SYSTEM_CONSTANT "SY_DELFCMS" "0"
 SYSTEM_CONSTANT "SY_DFPMENV" "4"
 SYSTEM_CONSTANT "SY_DFPMTIM" "2"
 SYSTEM_CONSTANT "SY_DFPMVAR" "3"
 SYSTEM_CONSTANT "SY_DGANZ" "1"
 SYSTEM_CONSTANT "SY_DISA" "1"
 SYSTEM_CONSTANT "SY_DKAT" "0"
 SYSTEM_CONSTANT "SY_DKATLRS" "1"
 SYSTEM_CONSTANT "SY_DKATSP" "0"
 SYSTEM_CONSTANT "SY_DKATTH" "0"
 SYSTEM_CONSTANT "SY_DLCKD" "10"
 SYSTEM_CONSTANT "SY_DLCPEN" "20"
 SYSTEM_CONSTANT "SY_DLDP" "0"
 SYSTEM_CONSTANT "SY_DLSHV" "0"
 SYSTEM_CONSTANT "SY_DLSU" "0"
 SYSTEM_CONSTANT "SY_DLSUV" "0"
 SYSTEM_CONSTANT "SY_DMDZAG" "1"
 SYSTEM_CONSTANT "SY_DMTL" "0"
 SYSTEM_CONSTANT "SY_DOPZW" "0"
 SYSTEM_CONSTANT "SY_DSL10MS" "0"
 SYSTEM_CONSTANT "SY_DSL2MS" "0"
 SYSTEM_CONSTANT "SY_DTES" "2"
 SYSTEM_CONSTANT "SY_DVEADA" "0"
 SYSTEM_CONSTANT "SY_DZKDMD" "1"
 SYSTEM_CONSTANT "SY_EGAS" "1"
 SYSTEM_CONSTANT "SY_EGFE" "9"
 SYSTEM_CONSTANT "SY_ELKUP" "0"
 SYSTEM_CONSTANT "SY_ENVBLOK" "3"
 SYSTEM_CONSTANT "SY_ESTZ" "0"
 SYSTEM_CONSTANT "SY_ETKBYP" "1"
 SYSTEM_CONSTANT "SY_F1GETR" "0"
 SYSTEM_CONSTANT "SY_FCMDISP" "10"
 SYSTEM_CONSTANT "SY_FCMIRD" "0"
 SYSTEM_CONSTANT "SY_FCMSIZE" "11"
 SYSTEM_CONSTANT "SY_FFESIZE" "0"
 SYSTEM_CONSTANT "SY_FFTSIZE" "4"
 SYSTEM_CONSTANT "SY_FFXSIZE" "11"
 SYSTEM_CONSTANT "SY_FLC" "3"
 SYSTEM_CONSTANT "SY_GAP" "2"
 SYSTEM_CONSTANT "SY_GRDWOF" "0"
 SYSTEM_CONSTANT "SY_GRDWRT" "18"
 SYSTEM_CONSTANT "SY_GRUNDWERT" "108"
 SYSTEM_CONSTANT "SY_HLCCARB" "4"
 SYSTEM_CONSTANT "SY_IEGR" "1"
 SYSTEM_CONSTANT "SY_IGNMX" "15"
 SYSTEM_CONSTANT "SY_INGASOS" "6"
 SYSTEM_CONSTANT "SY_KRLZ" "1"
 SYSTEM_CONSTANT "SY_KS1" "0"
 SYSTEM_CONSTANT "SY_KS2" "1"
 SYSTEM_CONSTANT "SY_KS3" "2"
 SYSTEM_CONSTANT "SY_KS4" "3"
 SYSTEM_CONSTANT "SY_KSZA" "2"
 SYSTEM_CONSTANT "SY_LAMBTS" "1"
 SYSTEM_CONSTANT "SY_LECK" "0"
 SYSTEM_CONSTANT "SY_LOWRA" "0"
 SYSTEM_CONSTANT "SY_M1I00A" "190"
 SYSTEM_CONSTANT "SY_M1I00B" "31"
 SYSTEM_CONSTANT "SY_M1I00C" "248"
 SYSTEM_CONSTANT "SY_M1I00D" "17"
 SYSTEM_CONSTANT "SY_M1I20A" "128"
 SYSTEM_CONSTANT "SY_M1I20B" "0"
 SYSTEM_CONSTANT "SY_M1I20C" "0"
 SYSTEM_CONSTANT "SY_M1I20D" "0"
 SYSTEM_CONSTANT "SY_M2I00A" "126"
 SYSTEM_CONSTANT "SY_M2I00B" "24"
 SYSTEM_CONSTANT "SY_M2I00C" "0"
 SYSTEM_CONSTANT "SY_M2I00D" "0"
 SYSTEM_CONSTANT "SY_M5IH00A" "195"
 SYSTEM_CONSTANT "SY_M5IH00B" "0"
 SYSTEM_CONSTANT "SY_M5IH00C" "0"
 SYSTEM_CONSTANT "SY_M5IH00D" "0"
 SYSTEM_CONSTANT "SY_M5IH20A" "0"
 SYSTEM_CONSTANT "SY_M5IH20B" "0"
 SYSTEM_CONSTANT "SY_M5IH20C" "0"
 SYSTEM_CONSTANT "SY_M5IH20D" "0"
 SYSTEM_CONSTANT "SY_M5IH40A" "0"
 SYSTEM_CONSTANT "SY_M5IH40B" "0"
 SYSTEM_CONSTANT "SY_M5IH40C" "0"
 SYSTEM_CONSTANT "SY_M5IH40D" "0"
 SYSTEM_CONSTANT "SY_M5IH60A" "0"
 SYSTEM_CONSTANT "SY_M5IH60B" "0"
 SYSTEM_CONSTANT "SY_M5IH60C" "0"
 SYSTEM_CONSTANT "SY_M5IH60D" "0"
 SYSTEM_CONSTANT "SY_M5IH80A" "0"
 SYSTEM_CONSTANT "SY_M5IH80B" "0"
 SYSTEM_CONSTANT "SY_M5IH80C" "0"
 SYSTEM_CONSTANT "SY_M5IH80D" "0"
 SYSTEM_CONSTANT "SY_M5IV00A" "195"
 SYSTEM_CONSTANT "SY_M5IV00B" "128"
 SYSTEM_CONSTANT "SY_M5IV00C" "0"
 SYSTEM_CONSTANT "SY_M5IV00D" "1"
 SYSTEM_CONSTANT "SY_M5IV20A" "0"
 SYSTEM_CONSTANT "SY_M5IV20B" "1"
 SYSTEM_CONSTANT "SY_M5IV20C" "192"
 SYSTEM_CONSTANT "SY_M5IV20D" "0"
 SYSTEM_CONSTANT "SY_M5IV40A" "0"
 SYSTEM_CONSTANT "SY_M5IV40B" "0"
 SYSTEM_CONSTANT "SY_M5IV40C" "0"
 SYSTEM_CONSTANT "SY_M5IV40D" "0"
 SYSTEM_CONSTANT "SY_M5IV60A" "0"
 SYSTEM_CONSTANT "SY_M5IV60B" "0"
 SYSTEM_CONSTANT "SY_M5IV60C" "0"
 SYSTEM_CONSTANT "SY_M5IV60D" "0"
 SYSTEM_CONSTANT "SY_M5IV80A" "0"
 SYSTEM_CONSTANT "SY_M5IV80B" "0"
 SYSTEM_CONSTANT "SY_M5IV80C" "0"
 SYSTEM_CONSTANT "SY_M5IV80D" "0"
 SYSTEM_CONSTANT "SY_M6I00A" "168"
 SYSTEM_CONSTANT "SY_M6I00B" "0"
 SYSTEM_CONSTANT "SY_M6I00C" "0"
 SYSTEM_CONSTANT "SY_M6I00D" "0"
 SYSTEM_CONSTANT "SY_M7VAR" "0"
 SYSTEM_CONSTANT "SY_M8I00B" "0"
 SYSTEM_CONSTANT "SY_M8I00C" "0"
 SYSTEM_CONSTANT "SY_M8I00D" "0"
 SYSTEM_CONSTANT "SY_M8I00E" "0"
 SYSTEM_CONSTANT "SY_M9I00A" "48"
 SYSTEM_CONSTANT "SY_M9I00B" "0"
 SYSTEM_CONSTANT "SY_M9I00C" "0"
 SYSTEM_CONSTANT "SY_M9I00D" "0"
 SYSTEM_CONSTANT "SY_MLSUBREF" "138"
 SYSTEM_CONSTANT "SY_MODMASK" "0"
 SYSTEM_CONSTANT "SY_NLDG" "0"
 SYSTEM_CONSTANT "SY_NOHK" "0"
 SYSTEM_CONSTANT "SY_NOXKAT" "0"
 SYSTEM_CONSTANT "SY_NVRAMBK" "1"
 SYSTEM_CONSTANT "SY_NWACED1" "1"
 SYSTEM_CONSTANT "SY_NWACED2" "1"
 SYSTEM_CONSTANT "SY_NWACED3" "0"
 SYSTEM_CONSTANT "SY_NWACED4" "0"
 SYSTEM_CONSTANT "SY_NWGA" "2"
 SYSTEM_CONSTANT "SY_NWGA2" "0"
 SYSTEM_CONSTANT "SY_NWGE" "1"
 SYSTEM_CONSTANT "SY_NWGE2" "0"
 SYSTEM_CONSTANT "SY_NWS" "2"
 SYSTEM_CONSTANT "SY_NWSA" "2"
 SYSTEM_CONSTANT "SY_NWVAR" "3"
 SYSTEM_CONSTANT "SY_NWZUHW1" "1"
 SYSTEM_CONSTANT "SY_NWZUHW2" "3"
 SYSTEM_CONSTANT "SY_NWZUHW3" "0"
 SYSTEM_CONSTANT "SY_NWZUHW4" "0"
 SYSTEM_CONSTANT "SY_ODT_100MS" "10"
 SYSTEM_CONSTANT "SY_ODT_10MS" "7"
 SYSTEM_CONSTANT "SY_ODT_SYN" "2"
 SYSTEM_CONSTANT "SY_OVERSIZE" "2"
 SYSTEM_CONSTANT "SY_OZ" "0"
 SYSTEM_CONSTANT "SY_PBRPW" "1"
 SYSTEM_CONSTANT "SY_PGRAD" "4"
 SYSTEM_CONSTANT "SY_PGRAD2" "4"
 SYSTEM_CONSTANT "SY_PGRAD3" "0"
 SYSTEM_CONSTANT "SY_PGRAD4" "0"
 SYSTEM_CONSTANT "SY_PGTPO" "1"
 SYSTEM_CONSTANT "SY_PHTWIN" "0"
 SYSTEM_CONSTANT "SY_PTCAN" "0"
 SYSTEM_CONSTANT "SY_RASFAKM" "128"
 SYSTEM_CONSTANT "SY_RASNMAX" "150"
 SYSTEM_CONSTANT "SY_RASNMIN" "75"
 SYSTEM_CONSTANT "SY_REDMX" "4"
 SYSTEM_CONSTANT "SY_RLTEST" "50"
 SYSTEM_CONSTANT "SY_SEGL" "180"
 SYSTEM_CONSTANT "SY_SGANZ" "1"
 SYSTEM_CONSTANT "SY_SLPANZ" "1"
 SYSTEM_CONSTANT "SY_SLS" "1"
 SYSTEM_CONSTANT "SY_SLWG" "0"
 SYSTEM_CONSTANT "SY_STA" "0"
 SYSTEM_CONSTANT "SY_STERBTS" "0"
 SYSTEM_CONSTANT "SY_STEREO" "0"
 SYSTEM_CONSTANT "SY_STERHK" "0"
 SYSTEM_CONSTANT "SY_STERSY" "0"
 SYSTEM_CONSTANT "SY_STERVK" "0"
 SYSTEM_CONSTANT "SY_STETLR" "0"
 SYSTEM_CONSTANT "SY_SWE" "1"
 SYSTEM_CONSTANT "SY_SWE_B" "0"
 SYSTEM_CONSTANT "SY_SWE_C" "1"
 SYSTEM_CONSTANT "SY_SWE_K" "0"
 SYSTEM_CONSTANT "SY_SWE_S" "0"
 SYSTEM_CONSTANT "SY_TABST" "1"
 SYSTEM_CONSTANT "SY_TEBF" "0"
 SYSTEM_CONSTANT "SY_TEETH" "60"
 SYSTEM_CONSTANT "SY_TFA" "0"
 SYSTEM_CONSTANT "SY_TFBA" "0"
 SYSTEM_CONSTANT "SY_TFMA" "1"
 SYSTEM_CONSTANT "SY_TFMAP" "0"
 SYSTEM_CONSTANT "SY_TFMHST" "1"
 SYSTEM_CONSTANT "SY_TFMO" "0"
 SYSTEM_CONSTANT "SY_TFNS" "0"
 SYSTEM_CONSTANT "SY_TFRK" "0"
 SYSTEM_CONSTANT "SY_TFUMG" "1"
 SYSTEM_CONSTANT "SY_TFVA" "0"
 SYSTEM_CONSTANT "SY_TFWL" "0"
 SYSTEM_CONSTANT "SY_TGET" "0"
 SYSTEM_CONSTANT "SY_TKAT" "0"
 SYSTEM_CONSTANT "SY_TLR" "0"
 SYSTEM_CONSTANT "SY_TMKR" "0"
 SYSTEM_CONSTANT "SY_TN" "1"
 SYSTEM_CONSTANT "SY_TRLX" "0"
 SYSTEM_CONSTANT "SY_TSFSIZE" "1"
 SYSTEM_CONSTANT "SY_TURBO" "0"
 SYSTEM_CONSTANT "SY_TVVR" "0"
 SYSTEM_CONSTANT "SY_TWDKS" "0"
 SYSTEM_CONSTANT "SY_TWSLP" "1"
 SYSTEM_CONSTANT "SY_UB13V" "138"
 SYSTEM_CONSTANT "SY_UBDEDIS" "74"
 SYSTEM_CONSTANT "SY_UBDEEN" "86"
 SYSTEM_CONSTANT "SY_UBOKDIS" "63"
 SYSTEM_CONSTANT "SY_UBOKEN" "74"
 SYSTEM_CONSTANT "SY_UBR" "1"
 SYSTEM_CONSTANT "SY_UBRSQ_W" "3860"
 SYSTEM_CONSTANT "SY_UBSQ_W" "965"
 SYSTEM_CONSTANT "SY_UMALS" "0"
 SYSTEM_CONSTANT "SY_USOFF" "205"
 SYSTEM_CONSTANT "SY_VS" "0"
 SYSTEM_CONSTANT "SY_VVT" "0"
 SYSTEM_CONSTANT "SY_WFS" "1"
 SYSTEM_CONSTANT "SY_WMAX" "72"
 SYSTEM_CONSTANT "SY_WMIN" "-30"
 SYSTEM_CONSTANT "SY_WNBM" "6"
 SYSTEM_CONSTANT "SY_ZAS" "0"
 SYSTEM_CONSTANT "SY_ZKANZ" "4"
 SYSTEM_CONSTANT "SY_ZMS" "1"
 SYSTEM_CONSTANT "SY_ZNDAUS" "1"
 SYSTEM_CONSTANT "SY_ZWCALC" "0"
 SYSTEM_CONSTANT "SY_ZYLZA" "4"
 SYSTEM_CONSTANT "SY_ZZBANK" "0" /end MOD_PAR
/begin MOD_COMMON "" BYTE_ORDER MSB_FIRST ALIGNMENT_BYTE 1 ALIGNMENT_WORD 2 ALIGNMENT_LONG 2 ALIGNMENT_FLOAT32_IEEE 4 /end MOD_COMMON
/* --- AgI-Objekt f¸r CCP (ASAP V1.21), Stand 1.0 31.7.98 --- */
/begin IF_DATA ASAP1B_CCP
 /begin SOURCE "time synchronous event channel - 10 ms" 4 1 /begin QP_BLOB 0 LENGTH 7 CAN_ID_FIXED 0x7A0 RASTER 0 /end QP_BLOB /end SOURCE
 /begin SOURCE "time synchronous event channel - 100 ms" 5 1 /begin QP_BLOB 1 LENGTH 10 CAN_ID_FIXED 0x7A1 RASTER 1 /end QP_BLOB /end SOURCE
 /begin SOURCE "segment synchronous event channel" 103 1 /begin QP_BLOB 2 LENGTH 2 CAN_ID_FIXED 0x7A2 RASTER 2 /end QP_BLOB /end SOURCE
 /begin RASTER "time synchronous event channel - 10 ms" "10_ms" 0 4 1 /end RASTER
 /begin RASTER "time synchronous event channel - 100 ms" "100_ms" 1 5 1 /end RASTER
 /begin RASTER "segment synchronous event channel" "seg_sync" 2 103 1 /end RASTER
 /begin SEED_KEY /* seed&key dll for CAL privilege */ "" /* seed&key dll for DAQ privilege */ "" /* seed&key dll for PGM privilege */ "" /end SEED_KEY
 /begin TP_BLOB /* CCP version */ 0x201 /* Blob version */ 0x202 /* CAN msg ID - send */ 0x7BC /* CAN msg ID - recv */ 0x7BD /* station address */ 0x12ED /* byte order */ 1
  /begin CAN_PARAM /* crystal frequency */ 0x1F4 /* timing register 0 */ 0x41 /* timing register 1 */ 0x25 /end CAN_PARAM
  DAQ_MODE BURST CONSISTENCY ODT ADDRESS_EXTENSION ODT
  /begin CHECKSUM_PARAM /* algorithm */ 0xC001 /* limit */ 0xFFFFFFFF CHECKSUM_CALCULATION ACTIVE_PAGE /end CHECKSUM_PARAM
  /begin DEFINED_PAGES 1 "reference page" /* address ext. */ 0x1 /* base address */ 0x1C0000 /* page length */ 0x1FFFF ROM /end DEFINED_PAGES
  OPTIONAL_CMD 0xC /* SELECT_CAL_PAGE */ OPTIONAL_CMD 0xD /* BUILD_CHKSUM */ OPTIONAL_CMD 0xE /* MOVE */ OPTIONAL_CMD 0x11 /* GET_ACTIVE_CAL_PAGE */ OPTIONAL_CMD 0x19 /* SET_S_STATUS */ OPTIONAL_CMD 0xD /* GET_S_STATUS */ OPTIONAL_CMD 0x12 /* GET_SEED */ OPTIONAL_CMD 0x13 /* UNLOCK */ /end TP_BLOB
/end IF_DATA
/* --- Default-AgI-Objekt */ /* --- AgI-Objekt f¸r ETK (ASAP V1.3B0), Stand 1.0 16.7.98 --- */
/begin IF_DATA ETK
 /begin TP_BLOB /*version:*/ 0x1000001 /*pba:*/ 0x0 /*reset_cfg:*/ 0x40001800
  /begin DISTAB_CFG /*dsptab:*/ 0xD /*dat_mod:*/ 0x1 /*rfg:*/ 0x1 /*trgsegad:*/ 0x5E0000 /*trg_cfg:*/ 0x1020100 TRG_MOD /*Id:*/ 0x0 /*trg_mod:*/ 0xFF 0x0 0x0 0x0 /end DISTAB_CFG
  CODE_CHK /*prg_data:*/ 0x5C0210 /*prg_length:*/ 0xC /*prg_eram:*/ 0x5E01DC /*prg_length:*/ 0xC ETK_CFG 0x2 0xc2 0x3d 0xff 0xef 0x3e 0xdf 0xef 0x3d 0xff 0xfb 0xfe 0xff 0xff 0xfe 0xff 0xff 0xff 0xff 0xff 0x3 0x60 0x5 0xff /* EMU_RAM start_addr length CS offset >>>>> (multiple) */ /* EMU_DATA start_addr length CS offset >>>>> (multiple) */ /* EMU_CODE start_addr length CS offset >>>>> (multiple) */ /* RESERVED start_addr length CS offset >>>>> (multiple) */ RESERVED /*start_addr:*/ 0x5C0250 0x618 EXTERN -1 -1 -1 -1 -1 ETK_MAILBOX /*pattern:*/ 0x55555555 /*page_ecu:*/ DATA /*ecu_adr:*/ 0x560000 /*..length:*/ 0x8000 /*page_am:*/ EXRAM /*am_adr:*/ 0x5E1000 /*..length:*/ 0x7000 /end TP_BLOB
 /begin SOURCE "Synchro" 103 1 QP_BLOB 1 0x38 0x5C0250 0x5E0094 0x5E0080 0 0 0 /end SOURCE
 /begin SOURCE "10ms" 4 1 QP_BLOB 2 0x58 0x5C0338 0x5E00CC 0x5E0084 10 0 0 /end SOURCE
 /begin SOURCE "100ms" 5 1 QP_BLOB 3 0x58 0x5C04A0 0x5E0124 0x5E0088 100 0 0 /end SOURCE
 /begin SOURCE "Bypass_Synchro" 103 1 QP_BLOB 4 0x30 0x5C0608 0x5E017C 0x5E008C 0 0x30 0x5C0798 /end SOURCE
 /begin SOURCE "Bypass_10ms" 4 1 QP_BLOB 5 0x30 0x5C06D0 0x5E01AC 0x5E0090 10 0x30 0x5C0800 /end SOURCE
/end IF_DATA
/begin IF_DATA ASAP1B_KWP2000
 /begin SOURCE "timeslot" 0 0 QP_BLOB 0 BLOCKMODE 0xF0 0 20 /end SOURCE
 /begin TP_BLOB /* Blob version */ 0x100 /* ECU address on k line */ 0x12 /* requ. tester address */ 0xF1 /* ECU stimulation mode */ WuP /* byte order */ MSB_FIRST 1 /* project base address */ 0x0 SERAM /* SERAM_A */ 0x1C0000 /* SERAM_O */ 0x1C0000 /* SERAM_U */ 0x1DFFFE /* SERAM_E */ 0x1DFFFE /* Flash address */ 0x000000 /* RAM address */ 0x000000 /* Data Read */ 1 /* Code Verify */ 0 /* Code Read */ 0 /* Load mode */ 1 /begin CHECKSUM 0x010201 1 1 RequestRoutineResults RNC_RESULT 0x23 /end CHECKSUM
  /begin FLASH_COPY NOFLASHBACK 3 RequestRoutineResults RAM_InitByECU 0x86 COPY_FRAME 1 RNC_RESULT 0x23 0xFB 0xFC /end FLASH_COPY
  BAUD_DEF /* BaudRate */ 10400 /* DiagMode */ 0x86 0x14 BAUD_DEF /* BaudRate */ 20800 /* DiagMode */ 0x86 0x34 TIME_DEF 0x0005 0x0000 0x0032 0x000F 0x1388 0x0002 TIME_DEF 0x0005 0x0000 0x0032 0x0014 0x1388 0x0003 TIME_DEF 0x0014 0x000A 0x0032 0x0014 0x1388 0x0004 TIME_DEF 0x0014 0x0019 0x0032 0x001E 0x1388 0x0005 /end TP_BLOB
/end IF_DATA
/begin CHARACTERISTIC A0 "‹bertragungsfunktionskoeffizient" VALUE 0xFC71C0 KwSw 0.1249981 fak_sw_b0p0625 -0.06250000 0.06249809 FORMAT "%10.8" /end CHARACTERISTIC
/begin CHARACTERISTIC A1 "‹bertragungsfunktionskoeffizient" VALUE 0xFC71C2 KwSw 0.1249981 fak_sw_b0p0625 -0.06250000 0.06249809 FORMAT "%10.8" /end CHARACTERISTIC
/begin CHARACTERISTIC A2 "‹bertragungsfunktionskoeffizient" VALUE 0xFC71C4 KwSw 0.1249981 fak_sw_b0p0625 -0.06250000 0.06249809 FORMAT "%10.8" /end CHARACTERISTIC
/begin CHARACTERISTIC ABOLRAR "Schwelle Anzahl Starts mit Benzin im ÷l f¸r reduzierte LRA" VALUE 0xFCDF55 KwUb 255.0 dez 0.00 255.0 FORMAT "%5.1" /end CHARACTERISTIC
/begin CHARACTERISTIC ABOMX "max. Anzahl Start-Z‰hler f¸r Erkennung Benzin im ÷l" VALUE 0xFCDF56 KwUb 255.0 dez 0.00 255.0 FORMAT "%5.1" /end CHARACTERISTIC
/begin CHARACTERISTIC ATMTANS "Temperaturkorrektur der Abgas-Modell-Temperatur" CURVE 0xFCCAF6 KlAUbSstUbWSb 1275. temp_q5 -640.0 635.0 FORMAT "%5.1"
 /begin AXIS_DESCR STD_AXIS tatu temp_ub_q0p75_o48 3 -48.00 143.3 FORMAT "%5.1" DEPOSIT ABSOLUTE /end AXIS_DESCR
/end CHARACTERISTIC
/begin CHARACTERISTIC AWALEMX "max. Drehwinkel nach Motorstop" VALUE 0xFC1DB8 KwWU16 180.0000 kw_q0p1 0.00 180.0000 FORMAT "%8.4" /end CHARACTERISTIC
/begin CHARACTERISTIC B1 "‹bertragungsfunktionskoeffizient" VALUE 0xFC71C6 KwSw 3.999939 fak_sw_b2 -2.000000 1.999939 FORMAT "%8.6" /end CHARACTERISTIC
/begin CHARACTERISTIC B2 "‹bertragungsfunktionskoeffizient" VALUE 0xFC71C8 KwSw 3.999939 fak_sw_b2 -2.000000 1.999939 FORMAT "%8.6" /end CHARACTERISTIC
/begin CHARACTERISTIC BFGRO "Obere Schwelle f¸r Beschleunigung im FGR-Betrieb" VALUE 0xFC2042 KwSb 55.34 bfzg_sb_q0p217 -27.78 27.56 FORMAT "%5.2" /end CHARACTERISTIC
/begin CHARACTERISTIC BFGRU "Untere Schwelle f¸r Beschleunigung im FGR-Betrieb" VALUE 0xFC2043 KwSb 55.34 bfzg_sb_q0p217 -27.78 27.56 FORMAT "%5.2" /end CHARACTERISTIC
/begin CHARACTERISTIC BTRKHTMS "Kennline zur Freigabe B_trkh" CURVE 0xFCE34C KlAUbSstUbWUb 255.0 dez 0.00 255.0 FORMAT "%5.1"
 /begin AXIS_DESCR STD_AXIS tmst temp_ub_q0p75_o48 8 -48.00 143.3 FORMAT "%5.1" DEPOSIT ABSOLUTE /end AXIS_DESCR
/end CHARACTERISTIC
/begin CHARACTERISTIC CRENGOF "Offset f¸r Strombedarf Motor" VALUE 0xFC8470 KwWU8 127.0 i_vvt_ub_q0p50_om63p50 -63.50 63.50 FORMAT "%5.2" /end CHARACTERISTIC
/begin CHARACTERISTIC CRVVTNOT "" VALUE 0xFC8471 KwWU8 127.5 i_vvt_ub_q0p50_om63p50 -63.50 64.00 FORMAT "%5.2" /end CHARACTERISTIC
/begin CHARACTERISTIC CRVVTOF "Stromoffset VVT" VALUE 0xFC8472 KwWU8 64.00 i_vvt_ub_q0p50_om63p50 0.00 64.00 FORMAT "%5.2" /end CHARACTERISTIC
/begin CHARACTERISTIC CWARMD "Codewort Antiruckelfunktion" VALUE 0xFC7184 KwUb 255.0 dez 0.00 255.0 FORMAT "%5.1" /end CHARACTERISTIC
/begin CHARACTERISTIC CWBBFGR "Codewort f¸r BBFGR" VALUE 0xFC2044 KwUb 255.0 dez 0.00 255.0 FORMAT "%5.1" /end CHARACTERISTIC
/begin CHARACTERISTIC CWBFGROF "Codewort f¸r BBFGR bei externen Abschalt-Anforderungen" VALUE 0xFC2045 KwUb 255.0 dez 0.00 255.0 FORMAT "%5.1" /end CHARACTERISTIC
/begin CHARACTERISTIC CWDKNOLU "" VALUE 0xFCC9A7 KwUb 255.0 dez 0.00 255.0 FORMAT "%5.1" /end CHARACTERISTIC
/begin CHARACTERISTIC CWDVEFO "Codeword ˆffnende Federpr¸fung" VALUE 0xFC1DE0 KwUb 255.0 dez 0.00 255.0 FORMAT "%5.1" /end CHARACTERISTIC
/begin CHARACTERISTIC CWEVAB "Codewort zur Abschaltung von Einspritzventilen" VALUE 0xFCD704 KwUb 255.0 dez 0.00 255.0 FORMAT "%5.1" /end CHARACTERISTIC
/begin CHARACTERISTIC CWKHZ "Codewort f¸r Katheizsteuerung" VALUE 0xFCE35D KwUb 255.0 dez 0.00 255.0 FORMAT "%5.1" /end CHARACTERISTIC
/begin CHARACTERISTIC CWNVRAMBK "Codewort NVRAM-Backup aktiviert" VALUE 0xFC9B01 KwUb 255.0 DEZ 0.00 255.0 FORMAT "%5.1" /end CHARACTERISTIC
/begin CHARACTERISTIC DFTEDS "Hysteresebreite Beladung f¸r Umschaltung auf Dauertankentl¸ftung" VALUE 0xFCD71A KwSw 127.9980 fak_sw_b64 -64.00000 63.99805 FORMAT "%8.5" /end CHARACTERISTIC
/begin CHARACTERISTIC DKPSTGMIN "min. Steigung des DK-Poti zur Umr. abs. auf rel. Winkel im worst case" VALUE 0xFC1DF8 KwUw 39.99939 rel_uw_b40 0.00 39.99939 FORMAT "%8.5" /end CHARACTERISTIC
/begin CHARACTERISTIC DLRPIDSTMN "min. Schwelle f¸r PWM-Tastverh‰ltnis des DLR bei temp. UMA-Adapt." VALUE 0xFC1DFA KwUw 99.99847 rel_uw_b100 0.00 99.99847 FORMAT "%8.5" /end CHARACTERISTIC
/begin CHARACTERISTIC DMRFATE "Hysterese Hochlasterkennung" VALUE 0xFCD708 KwUb 99.61 rel_ub_b99p6 0.00 99.61 FORMAT "%5.2" /end CHARACTERISTIC
/begin CHARACTERISTIC DNFILO "obere Schwelle f¸r Gradient des Filterausgangs ndfil" VALUE 0xFC71CA KwSw 8191.750 nmot_sw_q0p25 0.00 8191.750 FORMAT "%8.3" /end CHARACTERISTIC
/begin CHARACTERISTIC DNSAH "Delta n SA high bezogen auf nWE" VALUE 0xFC6BA8 KwUb 5080. nmot_ub_q40 0.00 5080. FORMAT "%5.0" /end CHARACTERISTIC
/begin CHARACTERISTIC DNSAL "Delta n SA low bezogen auf nWE" VALUE 0xFC6BA9 KwUb 5080. nmot_ub_q40 0.00 5080. FORMAT "%5.0" /end CHARACTERISTIC
/begin CHARACTERISTIC DNSLL "Schubabschalte-Hysterese bei WE im Leerlauf" VALUE 0xFC6BAA KwUb 10200. nmot_ub_q40 0.00 10200. FORMAT "%5.0" /end CHARACTERISTIC
/begin CHARACTERISTIC DNVSA "Schubabschaltedrehzahlanhebung bei kleiner Geschwindigkeit" VALUE 0xFC6BAB KwUb 10200. nmot_ub_q40 0.00 10200. FORMAT "%5.0" /end CHARACTERISTIC
/begin CHARACTERISTIC DNWEK "Delta n f¸r WE bei Klima (AC)" VALUE 0xFC6BAC KwUb 10200. nmot_ub_q40 0.00 10200. FORMAT "%5.0" /end CHARACTERISTIC
/begin CHARACTERISTIC DTKATMN "Hysterese Katalysatortemperaturregelschwelle f¸r Kat warmhalten" VALUE 0xFCE35E KwUb 1275. temp_ub_q5_o50 -50.00 1225. FORMAT "%5.0" /end CHARACTERISTIC
/begin CHARACTERISTIC DTKH "Betrag Differenztemperatur (tans-tmst) f¸r Katheizen" VALUE 0xFCE35F KwUb 191.3 temp_ub_b191p25 0.00 191.3 FORMAT "%5.1" /end CHARACTERISTIC
/begin CHARACTERISTIC DTMABKH "Temperaturdifferenz zwischen Abstellen und Neustart f¸r Freigabe Katheizen" VALUE 0xFCE360 KwUb 191.3 temp_ub_b191p25 0.00 191.3 FORMAT "%5.1" /end CHARACTERISTIC
/begin CHARACTERISTIC DTUMTAT "Offset Ansauglufttemperatur -> Umgebungstemperatur" VALUE 0xFCC9AC KwUb 191.3 temp_ub_b191p25 0.00 191.3 FORMAT "%5.1" /end CHARACTERISTIC
/begin CHARACTERISTIC DUDKNLPO "Toleranzband f¸r NLP nach oben (inkl. R¸)" VALUE 0xFC1DFC KwUw 5.004090 spg_uw_q0p001222 0.00 5.004090 FORMAT "%8.6" /end CHARACTERISTIC
/begin CHARACTERISTIC DUDKNLPU "Toleranzband f¸r NLP nach unten" VALUE 0xFC1DFE KwUw 5.004090 spg_uw_q0p001222 0.00 5.004090 FORMAT "%8.6" /end CHARACTERISTIC
/begin CHARACTERISTIC DUDKPTMP "Delta eines Rampenschrittes bei der temp. UMA-Adaption" VALUE 0xFC1E00 KwUw 80.07888 spg_uw_q0p001222 0.004888000 80.08377 FORMAT "%8.5" /end CHARACTERISTIC
/begin CHARACTERISTIC DVAQUGMX "Max. zul. Geschw.differenz bei Aquaplaningerkennung f¸r groﬂe Geschw." VALUE 0xFC204E KwUw 511.9922 vfzg_uw_b512 0.00 511.9922 FORMAT "%8.4" /end CHARACTERISTIC
/begin CHARACTERISTIC DVAQUKMX "Max. zul. Geschw.differenz bei Aquaplaningerkennung f¸r kleine Geschw." VALUE 0xFC2050 KwUw 511.9922 vfzg_uw_b512 0.00 511.9922 FORMAT "%8.4" /end CHARACTERISTIC
/begin CHARACTERISTIC DVFGREO "Delta-Geschw. f¸r obere FGR-Einschaltgeschwindigkeit" VALUE 0xFC2052 KwUw 511.9922 vfzg_uw_b512 0.00 511.9922 FORMAT "%8.4" /end CHARACTERISTIC
/begin CHARACTERISTIC DVFGREU "Delta-Geschw. f¸r untere FGR-Einschaltgeschwindigkeit" VALUE 0xFC2054 KwUw 511.9922 vfzg_uw_b512 0.00 511.9922 FORMAT "%8.4" /end CHARACTERISTIC
/begin CHARACTERISTIC DVFZAR "Hysterese fuer Geschwindigkeitsschwelle bei AR" VALUE 0xFC7185 KwUb 318.8 vfzg_ub_q1p25 0.00 318.8 FORMAT "%5.1" /end CHARACTERISTIC
/begin CHARACTERISTIC DVIVZMX "Max. zul. Abweichung zw. Istgeschw. und Zielgeschw. bei FGR-Konstantfahrt" VALUE 0xFC2056 KwUw 511.9922 vfzg_uw_b512 0.00 511.9922 FORMAT "%8.4" /end CHARACTERISTIC
/begin CHARACTERISTIC DVSA "delta Geschwindigkeitsschwelle f¸r SA-Drehzahlanhebung" VALUE 0xFC6BAD KwUb 318.8 vfzg_ub_q1p25 0.00 318.8 FORMAT "%5.1" /end CHARACTERISTIC
/begin CHARACTERISTIC DVZVIMX "Max. zul. Abweichung zw. Zielgeschw. und Istgeschw. bei FGR-Konstantfahrt" VALUE 0xFC2058 KwUw 511.9922 vfzg_uw_b512 0.00 511.9922 FORMAT "%8.4" /end CHARACTERISTIC
/begin CHARACTERISTIC ENASAG "Freigabe SA gangabhaengig" VALUE 0xFC6BAE KwUb 255.0 dez 0.00 255.0 FORMAT "%5.1" /end CHARACTERISTIC
/begin CHARACTERISTIC FATMRML "Faktor fuer die Aufteilung Abgas-/Abgas-Rohrwandtemperatur" CURVE 0xFCC9B0 GklWUb 0.9961 fak_ub_b1 0.00 0.9961
 /begin AXIS_DESCR COM_AXIS ml_w m_uw_b6553p5 7 0.00 6553.500 FORMAT "%8.3" AXIS_PTS_REF SML07TMUW /end AXIS_DESCR
/end CHARACTERISTIC
/begin CHARACTERISTIC FATMVM "Abgastemperaturaenderung abhaengig von der Fahrgeschwindigkeit" CURVE 0xFCC9B8 KlAUbSstUbWUb 0.9961 fak_ub_b1 0.00 0.9961
 /begin AXIS_DESCR STD_AXIS vfzg vfzg_ub_q1p25 6 0.00 318.8 FORMAT "%5.1" DEPOSIT ABSOLUTE /end AXIS_DESCR
/end CHARACTERISTIC
/begin CHARACTERISTIC FHOKH "minimaler Hˆhenfaktor f¸r Katheizen" VALUE 0xFCE39E KwUw 3.999939 fak_uw_b4 0.00 3.999939 FORMAT "%8.6" /end CHARACTERISTIC
/begin CHARACTERISTIC FKEEV0N "Korrekturfaktor zur Einspritzzeitkorrektur Ev1" CURVE 0xFC4A1C GklWU8 1.992 fak_ub_b2 0.00 1.992 FORMAT "%5.3"
 /begin AXIS_DESCR COM_AXIS nmot nmot_ub_q40 8 0.00 10200. FORMAT "%5.0" AXIS_PTS_REF SNM08GKUB /end AXIS_DESCR
/end CHARACTERISTIC
/begin CHARACTERISTIC FKEEV1N "Korrekturfaktor zur Einspritzzeitkorrektur Ev2" CURVE 0xFC4A24 GklWU8 1.992 fak_ub_b2 0.00 1.992 FORMAT "%5.3"
 /begin AXIS_DESCR COM_AXIS nmot nmot_ub_q40 8 0.00 10200. FORMAT "%5.0" AXIS_PTS_REF SNM08GKUB /end AXIS_DESCR
/end CHARACTERISTIC
/begin CHARACTERISTIC FKEEV2N "Korrekturfaktor zur Einspritzzeitkorrektur Ev3" CURVE 0xFC4A2C GklWU8 1.992 fak_ub_b2 0.00 1.992 FORMAT "%5.3"
 /begin AXIS_DESCR COM_AXIS nmot nmot_ub_q40 8 0.00 10200. FORMAT "%5.0" AXIS_PTS_REF SNM08GKUB /end AXIS_DESCR
/end CHARACTERISTIC
/begin CHARACTERISTIC FKEEV3N "Korrekturfaktor zur Einspritzzeitkorrektur Ev4" CURVE 0xFC4A34 GklWU8 1.992 fak_ub_b2 0.00 1.992 FORMAT "%5.3"
 /begin AXIS_DESCR COM_AXIS nmot nmot_ub_q40 8 0.00 10200. FORMAT "%5.0" AXIS_PTS_REF SNM08GKUB /end AXIS_DESCR
/end CHARACTERISTIC
/begin CHARACTERISTIC FKEEV4N "Korrekturfaktor zur Einspritzzeitkorrektur Ev5" CURVE 0xFC4A3C GklWU8 1.992 fak_ub_b2 0.00 1.992 FORMAT "%5.3"
 /begin AXIS_DESCR COM_AXIS nmot nmot_ub_q40 8 0.00 10200. FORMAT "%5.0" AXIS_PTS_REF SNM08GKUB /end AXIS_DESCR
/end CHARACTERISTIC
/begin CHARACTERISTIC FKEEV5N "Korrekturfaktor zur Einspritzzeitkorrektur Ev6" CURVE 0xFC4A44 GklWU8 1.992 fak_ub_b2 0.00 1.992 FORMAT "%5.3"
 /begin AXIS_DESCR COM_AXIS nmot nmot_ub_q40 8 0.00 10200. FORMAT "%5.0" AXIS_PTS_REF SNM08GKUB /end AXIS_DESCR
/end CHARACTERISTIC
/begin CHARACTERISTIC FKEEV6N "Korrekturfaktor zur Einspritzzeitkorrektur Ev7" CURVE 0xFC4A4C GklWU8 1.992 fak_ub_b2 0.00 1.992 FORMAT "%5.3"
 /begin AXIS_DESCR COM_AXIS nmot nmot_ub_q40 8 0.00 10200. FORMAT "%5.0" AXIS_PTS_REF SNM08GKUB /end AXIS_DESCR
/end CHARACTERISTIC
/begin CHARACTERISTIC FKEEV7N "Korrekturfaktor zur Einspritzzeitkorrektur Ev8" CURVE 0xFC4A54 GklWU8 1.992 fak_ub_b2 0.00 1.992 FORMAT "%5.3"
 /begin AXIS_DESCR COM_AXIS nmot nmot_ub_q40 8 0.00 10200. FORMAT "%5.0" AXIS_PTS_REF SNM08GKUB /end AXIS_DESCR
/end CHARACTERISTIC
/begin CHARACTERISTIC FKHABMN "Schwelle Abregelfaktor Katheizen" VALUE 0xFCE361 KwUb 0.9961 fak_ub_b1 0.00 0.9961 /end CHARACTERISTIC
/begin CHARACTERISTIC FKHLA "Wichtungsfaktor Lambda-Soll f¸r Katheizen" CURVE 0xFCE3A0 KlAUwSstUwWUw 0.9999847 fak_uw_b1 0.00 0.9999847 FORMAT "%9.7"
 /begin AXIS_DESCR STD_AXIS imlpr_w fak_uw_b1 8 0.00 0.9999847 FORMAT "%9.7" DEPOSIT ABSOLUTE /end AXIS_DESCR
/end CHARACTERISTIC
/begin CHARACTERISTIC FKHMD "Wichtungsfaktor Drehmomentreserve f¸r Katheizen" CURVE 0xFCE3C2 KlAUwSstUwWUw 0.9999847 fak_uw_b1 0.00 0.9999847 FORMAT "%9.7"
 /begin AXIS_DESCR STD_AXIS imlpr_w fak_uw_b1 8 0.00 0.9999847 FORMAT "%9.7" DEPOSIT ABSOLUTE /end AXIS_DESCR
/end CHARACTERISTIC
/begin CHARACTERISTIC FLRAG "Verst‰rkung Lastregler bei AT" CURVE 0xFCF44C FklWUb 15.94 fak_ub_b16 0.00 15.94 FORMAT "%5.2"
 /begin AXIS_DESCR FIX_AXIS gangi dez 6 1.000 6.000 FORMAT "%5.3" FIX_AXIS_PAR 1 0 6 /end AXIS_DESCR
/end CHARACTERISTIC
/begin CHARACTERISTIC FLRAWG "Verst‰rkung Lastregler bei AT, WK geschlossen" CURVE 0xFCF454 FklWUb 15.94 fak_ub_b16 0.00 15.94 FORMAT "%5.2"
 /begin AXIS_DESCR FIX_AXIS gangi dez 6 1.000 6.000 FORMAT "%5.3" FIX_AXIS_PAR 1 0 6 /end AXIS_DESCR
/end CHARACTERISTIC
/begin CHARACTERISTIC FLRHG "Verst‰rkung Lastregler" CURVE 0xFCF45C FklWUb 15.94 fak_ub_b16 0.00 15.94 FORMAT "%5.2"
 /begin AXIS_DESCR FIX_AXIS gangi dez 6 1.000 6.000 FORMAT "%5.3" FIX_AXIS_PAR 1 0 6 /end AXIS_DESCR
/end CHARACTERISTIC
/begin CHARACTERISTIC FMRFAZTE "Gewichtung der Drehzahl um jetzige Leistung zu berechnen" CURVE 0xFCD70C KlAUbSstUbWUb 3.984 fak_ub_b4 0.00 3.984 FORMAT "%5.3"
 /begin AXIS_DESCR STD_AXIS nmot nmot_ub_q40 4 0.00 10200. FORMAT "%5.0" DEPOSIT ABSOLUTE /end AXIS_DESCR
/end CHARACTERISTIC
/begin CHARACTERISTIC FNSKHLL "Faktor f¸r Drehzahlanhebung direkt nach Start" CURVE 0xFCE364 KlAUbSstUbWUb 1.992 fak_ub_b2 0.00 1.992 FORMAT "%5.3" /begin AXIS_DESCR STD_AXIS imlpr fak_ub_b1 5 0.00 0.9961 DEPOSIT ABSOLUTE /end AXIS_DESCR /end CHARACTERISTIC
/begin CHARACTERISTIC FPRAT "Ansauglufttemperaturschwelle f¸r DV-E-Federpr¸fung" VALUE 0xFC1DE1 KwUb 191.3 temp_ub_q0p75_o48 -48.00 143.3 FORMAT "%5.1" /end CHARACTERISTIC
/begin CHARACTERISTIC FPRMT "Motortemperaturschwelle f¸r DV-E-Federpr¸fung" VALUE 0xFC1DE2 KwUb 191.3 temp_ub_q0p75_o48 -48.00 143.3 FORMAT "%5.1" /end CHARACTERISTIC
/begin CHARACTERISTIC FPRNMAX "Motordrehzahlschwelle f¸r DV-E-Federpr¸fung" VALUE 0xFC1DE3 KwUb 2550. nmot_ub_q10 0.00 2550. FORMAT "%5.0" /end CHARACTERISTIC
/begin CHARACTERISTIC FPRTIM1_T "DV-E-Federpr¸fung, Wartezeit in Pr¸fschritt 1" VALUE 0xFC1DE4 KwUb 2.540 t10msxs_ub_b2p55 0.01000 2.550 FORMAT "%5.3" /end CHARACTERISTIC
/begin CHARACTERISTIC FPRTIM2_T "DV-E-Federpr¸fung, Wartezeit in Pr¸fschritt 2" VALUE 0xFC1DE5 KwUb 2.540 t10msxs_ub_b2p55 0.01000 2.550 FORMAT "%5.3" /end CHARACTERISTIC
/begin CHARACTERISTIC FPRTIM3_T "DV-E-Federpr¸fung: Wartezeit in Pr¸fschritt 5" VALUE 0xFC1DE6 KwUb 2.540 t10msxs_ub_b2p55 0.01000 2.550 FORMAT "%5.3" /end CHARACTERISTIC
/begin CHARACTERISTIC FPRTIM4_T "DV-E-Federpr¸fung: Wartezeit in Pr¸fschritt 6" VALUE 0xFC1DE7 KwUb 2.540 t10msxs_ub_b2p55 0.01000 2.550 FORMAT "%5.3" /end CHARACTERISTIC
/begin CHARACTERISTIC FRARAG "Verst‰rkungsfaktor bei AT" CURVE 0xFCF464 FklWUb 3.113 fak_ub_b3p125 0.00 3.113 FORMAT "%5.3"
 /begin AXIS_DESCR FIX_AXIS gangi dez 6 1.000 6.000 FORMAT "%5.3" FIX_AXIS_PAR 1 0 6 /end AXIS_DESCR
/end CHARACTERISTIC
/begin CHARACTERISTIC FRARAWG "Verst‰rkungsfaktor bei AT, WK geschlossen" CURVE 0xFCF46C FklWUb 3.113 fak_ub_b3p125 0.00 3.113 FORMAT "%5.3"
 /begin AXIS_DESCR FIX_AXIS gangi dez 6 1.000 6.000 FORMAT "%5.3" FIX_AXIS_PAR 1 0 6 /end AXIS_DESCR
/end CHARACTERISTIC
/begin CHARACTERISTIC FRARHG "Verst‰rkungsfaktor" CURVE 0xFCF474 FklWUb 3.113 fak_ub_b3p125 0.00 3.113 FORMAT "%5.3"
 /begin AXIS_DESCR FIX_AXIS gangi dez 6 1.000 6.000 FORMAT "%5.3" FIX_AXIS_PAR 1 0 6 /end AXIS_DESCR
/end CHARACTERISTIC
/begin CHARACTERISTIC FTEADZU "Schwelle Beladung f¸r Unterbrechung TE-Phase f¸r Diagnose Funktionen" VALUE 0xFCD71C KwSw 127.9980 fak_sw_b64 -64.00000 63.99805 FORMAT "%8.5" /end CHARACTERISTIC
/begin CHARACTERISTIC FTEDS "Schwelle Beladung f¸r Umschaltung auf Dauertankentl¸ftung" VALUE 0xFCD71E KwSw 127.9980 fak_sw_b64 -64.00000 63.99805 FORMAT "%8.5" /end CHARACTERISTIC
/begin CHARACTERISTIC FTMLAKH "tmot-Korrektur der Lambda-Bewertung bei Katheizen" CURVE 0xFCE370 KlAUbSstUbWUb 0.9961 fak_ub_b1 0.00 0.9961
 /begin AXIS_DESCR STD_AXIS tmot temp_ub_q0p75_o48 4 -48.00 143.3 FORMAT "%5.1" DEPOSIT ABSOLUTE /end AXIS_DESCR
/end CHARACTERISTIC
/begin CHARACTERISTIC FWMABGW "Faktor f¸r W‰rmemengen bei Wiederholstart f¸r Taupunktende Abgas vor Vorkat" VALUE 0xFCC9C5 KwUb 0.9961 fak_ub_b1 0.00 0.9961 /end CHARACTERISTIC
/begin CHARACTERISTIC FWMKATW "Faktor f¸r W‰rmemengen bei Wiederholstart f¸r Taupunktende hinter Hauptkat" VALUE 0xFCC9C6 KwUb 0.9961 fak_ub_b1 0.00 0.9961 /end CHARACTERISTIC
/begin CHARACTERISTIC GAFGRO "Max. zul. Gang bei FGR-Betrieb" VALUE 0xFC2046 KwUb 255.0 dez 0.00 255.0 FORMAT "%5.1" /end CHARACTERISTIC
/begin CHARACTERISTIC GAFGRU "Min. zul. Gang bei FGR-Betrieb" VALUE 0xFC2047 KwUb 255.0 dez 0.00 255.0 FORMAT "%5.1" /end CHARACTERISTIC
/begin CHARACTERISTIC GAP_TOOTH "Differenz L¸cke SW-Benchmark in Z‰hnen" VALUE 0xFC1DC4 KwWU8 120.0 dez 0.00 120.0 FORMAT "%5.1" /end CHARACTERISTIC
/begin CHARACTERISTIC IGESGA "Gesamt-‹bersetzungsverh‰ltnis" CURVE 0xFC1EF4 FklWUb 25.50 fak_q0p1 0.00 25.50 FORMAT "%5.2"
 /begin AXIS_DESCR FIX_AXIS gangi dez 8 0.00 7.000 FORMAT "%5.3" FIX_AXIS_PAR 0 0 8 /end AXIS_DESCR
/end CHARACTERISTIC
/begin CHARACTERISTIC IMLATWS "Luftmassen-Schwelle f¸r Kat-Heizen nach Wiederholstart" VALUE 0xFCE3E4 KwUw 23.30133 m_uw_b23p3 0.00 23.30133 FORMAT "%8.5" /end CHARACTERISTIC
/begin CHARACTERISTIC IMLKHTMS "imlpr-Schwelle f¸r ‹bergang auf Lambda-Katheizen" CURVE 0xFC65E4 KlAUbSstUbWUb 0.9961 fak_ub_b1 0.00 0.9961
 /begin AXIS_DESCR STD_AXIS tmst temp_ub_q0p75_o48 8 -48.00 143.3 FORMAT "%5.1" DEPOSIT ABSOLUTE /end AXIS_DESCR
/end CHARACTERISTIC
/begin CHARACTERISTIC IMLKS "Schwelle f¸r integrierten Luftmassenstrom f¸r Erkennung Benzin im ÷l" VALUE 0xFCDF57 KwUb 23.21 m_ub_b23p3 0.00 23.21 FORMAT "%5.2" /end CHARACTERISTIC
/begin CHARACTERISTIC IMTUMTAT "Schwelle integrierte Luftmasse f¸r Bestimmung Umgebungstemperatur aus TANS" VALUE 0xFCC9C7 KwUb 23.21 m_ub_b23p3 0.00 23.21 FORMAT "%5.2" /end CHARACTERISTIC
/begin CHARACTERISTIC KATMEXML "Exotherme Temperatur im KAT tkatm" CURVE 0xFCC9C8 GklWSb 1275. temp_q5 -640.0 635.0 FORMAT "%5.1"
 /begin AXIS_DESCR COM_AXIS ml_w m_uw_b6553p5 7 0.00 6553.500 FORMAT "%8.3" AXIS_PTS_REF SML07TMUW /end AXIS_DESCR
/end CHARACTERISTIC
/begin CHARACTERISTIC KATMIEXML "Exotherme Temperatur im KAT tikatm" CURVE 0xFCC9D0 GklWSb 1275. temp_q5 -640.0 635.0 FORMAT "%5.1"
 /begin AXIS_DESCR COM_AXIS ml_w m_uw_b6553p5 7 0.00 6553.500 FORMAT "%8.3" AXIS_PTS_REF SML07TMUW /end AXIS_DESCR
/end CHARACTERISTIC
/begin CHARACTERISTIC KFATMABKA "Faktor f¸r Abgastemperaturabnahme = f(Abstellzeit,Umgebungstemperatur)" MAP 0xFCC9D8 GkfWUb 0.9961 fak_ub_b1 0.00 0.9961
 /begin AXIS_DESCR COM_AXIS tabstatm_w t1sxs_uw_q1 6 0.00 65535.00 FORMAT "%8.2" AXIS_PTS_REF STS06TMUW /end AXIS_DESCR
 /begin AXIS_DESCR COM_AXIS tatu temp_ub_q0p75_o48 5 -48.00 143.3 FORMAT "%5.1" AXIS_PTS_REF STU05TMUB /end AXIS_DESCR
/end CHARACTERISTIC
/begin CHARACTERISTIC KFATMABKK "Faktor f¸r Abnahme der Katalysatortemperatur = f(Abstellzeit,Umg.temp.)" MAP 0xFCC9F8 GkfWUb 0.9961 fak_ub_b1 0.00 0.9961
 /begin AXIS_DESCR COM_AXIS tabstatm_w t1sxs_uw_q1 6 0.00 65535.00 FORMAT "%8.2" AXIS_PTS_REF STS06TMUW /end AXIS_DESCR
 /begin AXIS_DESCR COM_AXIS tatu temp_ub_q0p75_o48 5 -48.00 143.3 FORMAT "%5.1" AXIS_PTS_REF STU05TMUB /end AXIS_DESCR
/end CHARACTERISTIC
/begin CHARACTERISTIC KFATMLA "Kennfeld Abgastemperatur-Korrektur = f(Lambda)" MAP 0xFCCA18 GkfWSb 1275. temp_q5 -640.0 635.0 FORMAT "%5.1"
 /begin AXIS_DESCR COM_AXIS ml_w m_uw_b6553p5 6 0.00 6553.500 FORMAT "%8.3" AXIS_PTS_REF SML06TMUW /end AXIS_DESCR
 /begin AXIS_DESCR COM_AXIS lamsons_w fak_uw_b16 6 0.00 15.99976 FORMAT "%8.5" AXIS_PTS_REF SLX06TMUW /end AXIS_DESCR
/end CHARACTERISTIC
/begin CHARACTERISTIC KFATMZW "Kennfeld Abgastemperatur-Korrektur = f(Z¸ndwinkelverstellung)" MAP 0xFCCA3C GkfWSb 1275. temp_q5 -640.0 635.0 FORMAT "%5.1"
 /begin AXIS_DESCR COM_AXIS ml_w m_uw_b6553p5 6 0.00 6553.500 FORMAT "%8.3" AXIS_PTS_REF SML06TMUW /end AXIS_DESCR
 /begin AXIS_DESCR COM_AXIS etazwimt rel_ub_b127p5 6 0.00 127.5 FORMAT "%5.1" AXIS_PTS_REF SEZ06TMUB /end AXIS_DESCR
/end CHARACTERISTIC
/begin CHARACTERISTIC KFDMDARO "Obere Schwelle f¸r Momenteneingriff" MAP 0xFCF47A GkfWSw 199.9969 rel_sw_b100 -100.0000 99.99695 FORMAT "%8.4"
 /begin AXIS_DESCR COM_AXIS gangi dez 8 0.00 255.0 FORMAT "%5.1" AXIS_PTS_REF SGA08MDUB /end AXIS_DESCR
 /begin AXIS_DESCR COM_AXIS mkar_w rel_sw_b100 8 -100.0000 99.99695 FORMAT "%8.4" AXIS_PTS_REF SMK08MDSW /end AXIS_DESCR
/end CHARACTERISTIC
/begin CHARACTERISTIC KFDMDARU "Untere Schwelle f¸r Momenteneingriff" MAP 0xFCF4FA GkfWSw 199.9969 rel_sw_b100 -100.0000 99.99695 FORMAT "%8.4"
 /begin AXIS_DESCR COM_AXIS gangi dez 8 0.00 255.0 FORMAT "%5.1" AXIS_PTS_REF SGA08MDUB /end AXIS_DESCR
 /begin AXIS_DESCR COM_AXIS mkar_w rel_sw_b100 8 -100.0000 99.99695 FORMAT "%8.4" AXIS_PTS_REF SMK08MDSW /end AXIS_DESCR
/end CHARACTERISTIC
/begin CHARACTERISTIC KFELUPWM "Strom E-L¸fter ¸ber pwm und ub" MAP 0xFC83B4 KfAxU8AyU8SstxU16SstyU16WU16 64.00000 i_eluft_q0p0625 0.00 64.00000 FORMAT "%8.5"
 /begin AXIS_DESCR STD_AXIS taml_tmp rel_ub_b100 7 0.00 100.0000 FORMAT "%8.4" DEPOSIT ABSOLUTE /end AXIS_DESCR
 /begin AXIS_DESCR STD_AXIS vfzg_tmp vfzg_ub_q1p25 7 0.00 318.7500 FORMAT "%8.4" DEPOSIT ABSOLUTE /end AXIS_DESCR
/end CHARACTERISTIC
/begin CHARACTERISTIC KFNFSKHM "Leerlaufsolldrehzahl bei Katheizen mit eingelegter Fahrstufe" MAP 0xFC65A4 GkfWU8 2550. nmot_ub_q10 0.00 2550. FORMAT "%5.0"
 /begin AXIS_DESCR COM_AXIS tmot temp_ub_q0p75_o48 8 -48.00 143.3 FORMAT "%5.1" AXIS_PTS_REF STM08BBUB /end AXIS_DESCR
 /begin AXIS_DESCR COM_AXIS frhol_w fak_uw_b2 4 0.00 1.999969 FORMAT "%8.6" AXIS_PTS_REF SFR04BBUW /end AXIS_DESCR
/end CHARACTERISTIC
/begin CHARACTERISTIC KFNLLKHM "Leerlaufsolldrehzahl bei Kat.-Heizung" MAP 0xFC65C4 GkfWU8 2550. nmot_ub_q10 0.00 2550. FORMAT "%5.0"
 /begin AXIS_DESCR COM_AXIS tmot temp_ub_q0p75_o48 8 -48.00 143.3 FORMAT "%5.1" AXIS_PTS_REF STM08BBUB /end AXIS_DESCR
 /begin AXIS_DESCR COM_AXIS frhol_w fak_uw_b2 4 0.00 1.999969 FORMAT "%8.6" AXIS_PTS_REF SFR04BBUW /end AXIS_DESCR
/end CHARACTERISTIC
/begin CHARACTERISTIC KFTATM "Kennfeld Abgastemperatur   f(nmot,rl)" MAP 0xFCCA60 KfAxUbAyUbSstxUbSstyUbWUb 1275. temp_ub_q5_o50 -50.00 1225. FORMAT "%5.0"
 /begin AXIS_DESCR STD_AXIS nmot nmot_ub_q40 8 0.00 10200. FORMAT "%5.0" DEPOSIT ABSOLUTE /end AXIS_DESCR
 /begin AXIS_DESCR STD_AXIS rl rel_ub_q0p75 8 0.00 191.3 FORMAT "%5.1" DEPOSIT ABSOLUTE /end AXIS_DESCR
/end CHARACTERISTIC
/begin CHARACTERISTIC KFTEVP "Kennfeld Periodendauer TEV" MAP 0xFCFB08 KfAxUbAyUbSstxUbSstyUbWUb 127.5 t500usxms_ub_q0p5 0.00 127.5 FORMAT "%5.1"
 /begin AXIS_DESCR STD_AXIS nmot nmot_ub_q40 5 0.00 10200. FORMAT "%5.0" DEPOSIT ABSOLUTE /end AXIS_DESCR
 /begin AXIS_DESCR STD_AXIS tateroh rel_ub_b99p6 9 0.00 99.61 FORMAT "%5.2" DEPOSIT ABSOLUTE /end AXIS_DESCR
/end CHARACTERISTIC
/begin CHARACTERISTIC KFTVSA "Verzˆgerungszeit f¸r Schubabschalten" MAP 0xFCF1DC GkfWUb 5.100 t20msxs_ub_b5p1 0.00 5.100 FORMAT "%5.3"
 /begin AXIS_DESCR COM_AXIS tmot temp_ub_q0p75_o48 5 -48.00 143.3 FORMAT "%5.1" AXIS_PTS_REF STM05SAUB /end AXIS_DESCR
 /begin AXIS_DESCR COM_AXIS nmot nmot_ub_q40 8 0.00 10200. FORMAT "%5.0" AXIS_PTS_REF SNM08__UB /end AXIS_DESCR
/end CHARACTERISTIC
/begin CHARACTERISTIC KFTVSAM "Verzˆgerungszeit f¸r Schubabschalten" MAP 0xFCF204 GkfWUb 5.100 t20msxs_ub_b5p1 0.00 5.100 FORMAT "%5.3"
 /begin AXIS_DESCR COM_AXIS tmot temp_ub_q0p75_o48 5 -48.00 143.3 FORMAT "%5.1" AXIS_PTS_REF STM05SAUB /end AXIS_DESCR
 /begin AXIS_DESCR COM_AXIS nmot nmot_ub_q40 8 0.00 10200. FORMAT "%5.0" AXIS_PTS_REF SNM08__UB /end AXIS_DESCR
/end CHARACTERISTIC
/begin CHARACTERISTIC KFTVTEV "Kennfeld Verzugszeit Tankentl¸ftungsventil" MAP 0xFCFB46 KfAxUwAyUwSstxUwSstyUwWUw 127.5000 t500usxms_ub_q0p5 0.00 127.5000 FORMAT "%8.4"
 /begin AXIS_DESCR STD_AXIS ub_w spg_ubatt 6 0.00 6173.397 FORMAT "%8.3" DEPOSIT ABSOLUTE /end AXIS_DESCR
 /begin AXIS_DESCR STD_AXIS dps_uw p_q0p039s32768 6 -1280.00 1279.96 FORMAT "%7.2" DEPOSIT ABSOLUTE /end AXIS_DESCR
/end CHARACTERISTIC
/begin CHARACTERISTIC KFWMABG "Kennfeld f¸r W‰rmemengen-Schwellwert Taupunktende Abgas" MAP 0xFCCAFE GkfWUw 29825.71 q_q0p4551 0.00 29825.71 FORMAT "%8.2"
 /begin AXIS_DESCR COM_AXIS tabgmst temp_ub_q5_o50 7 -50.00 1225. FORMAT "%5.0" AXIS_PTS_REF ST107TMUB /end AXIS_DESCR
 /begin AXIS_DESCR COM_AXIS tmst temp_ub_q0p75_o48 5 -48.00 143.3 FORMAT "%5.1" AXIS_PTS_REF STM05TMUB /end AXIS_DESCR
/end CHARACTERISTIC
/begin CHARACTERISTIC KFWMKAT "Kennfeld f¸r W‰rmemengen-Schwellwert Taupunktende hinter Kat" MAP 0xFCCB44 GkfWUw 29825.71 q_q0p4551 0.00 29825.71 FORMAT "%8.2"
 /begin AXIS_DESCR COM_AXIS tkatmst temp_ub_q5_o50 7 -50.00 1225. FORMAT "%5.0" AXIS_PTS_REF ST307TMUB /end AXIS_DESCR
 /begin AXIS_DESCR COM_AXIS tmst temp_ub_q0p75_o48 5 -48.00 143.3 FORMAT "%5.1" AXIS_PTS_REF STM05TMUB /end AXIS_DESCR
/end CHARACTERISTIC
/begin CHARACTERISTIC KIFZGAG "Integratorverst‰rkung des Fahrzeugmodells bei AT" CURVE 0xFCF57A FklWUw 4863.926 fak_uw_b4864 0.00 4863.926 FORMAT "%8.3"
 /begin AXIS_DESCR FIX_AXIS gangi dez 6 1.000 6.000 FORMAT "%5.3" FIX_AXIS_PAR 1 0 6 /end AXIS_DESCR
/end CHARACTERISTIC
/begin CHARACTERISTIC KIFZGAWG "Integratorverst‰rkung des Fahrzeugmodells bei AT, geschlossene WK" CURVE 0xFCF586 FklWUw 4863.926 fak_uw_b4864 0.00 4863.926 FORMAT "%8.3"
 /begin AXIS_DESCR FIX_AXIS gangi dez 6 1.000 6.000 FORMAT "%5.3" FIX_AXIS_PAR 1 0 6 /end AXIS_DESCR
/end CHARACTERISTIC
/begin CHARACTERISTIC KIFZGHG "Integratorverst‰rkung des Fahrzeugmodells bei Handschalter" CURVE 0xFCF592 FklWUw 4863.926 fak_uw_b4864 0.00 4863.926 FORMAT "%8.3"
 /begin AXIS_DESCR FIX_AXIS gangi dez 6 1.000 6.000 FORMAT "%5.3" FIX_AXIS_PAR 1 0 6 /end AXIS_DESCR
/end CHARACTERISTIC
/begin CHARACTERISTIC KLALETM "Kennlinie f¸r R¸ckdreh Zahnzeiten" CURVE 0xFC1DB0 KlAxU8SstxU8WU8 255.000 t1ms_ub_b255 0.00 255.000
 /begin AXIS_DESCR STD_AXIS tmot temp_ub_q0p75_o48 3 -48.00 143.3 FORMAT "%5.1" DEPOSIT ABSOLUTE /end AXIS_DESCR
/end CHARACTERISTIC
/begin CHARACTERISTIC KLATMILAE "Exotherme Temperaturabnahme bei Anfettung tikatm" CURVE 0xFCCAB4 GklWUb 1.992 fak_ub_b2 0.00 1.992 FORMAT "%5.3"
 /begin AXIS_DESCR COM_AXIS lamsons_w fak_uw_b16 6 0.00 15.99976 FORMAT "%8.5" AXIS_PTS_REF SLX06TMUW /end AXIS_DESCR
/end CHARACTERISTIC
/begin CHARACTERISTIC KLATMIZWE "Exotherme Temperaturabnahme im Kat bei sp‰terem Z¸ndwinkel tikatm" CURVE 0xFCCABC GklWUb 1.992 fak_ub_b2 0.00 1.992 FORMAT "%5.3"
 /begin AXIS_DESCR COM_AXIS etazwimt rel_ub_b127p5 6 0.00 127.5 FORMAT "%5.1" AXIS_PTS_REF SEZ06TMUB /end AXIS_DESCR
/end CHARACTERISTIC
/begin CHARACTERISTIC KLATMLAE "Exotherme Temperaturabnahme bei Anfettung" CURVE 0xFCCAC4 GklWUb 1.992 fak_ub_b2 0.00 1.992 FORMAT "%5.3"
 /begin AXIS_DESCR COM_AXIS lamsons_w fak_uw_b16 6 0.00 15.99976 FORMAT "%8.5" AXIS_PTS_REF SLX06TMUW /end AXIS_DESCR
/end CHARACTERISTIC
/begin CHARACTERISTIC KLATMZWE "Exotherme Temperaturabnahme im Kat bei sp‰terem Z¸ndwinkel tkatm" CURVE 0xFCCACC GklWUb 1.992 fak_ub_b2 0.00 1.992 FORMAT "%5.3"
 /begin AXIS_DESCR COM_AXIS etazwimt rel_ub_b127p5 6 0.00 127.5 FORMAT "%5.1" AXIS_PTS_REF SEZ06TMUB /end AXIS_DESCR
/end CHARACTERISTIC
/begin CHARACTERISTIC KLELSLP "" CURVE 0xFC8466 KlAxU8SstxU8WU16 255.0000 i_eluft_q0p0625 0.00 255.0000 FORMAT "%8.4"
 /begin AXIS_DESCR STD_AXIS ub_tmp spg_ubatt 3 0.00 24.02100 FORMAT "%8.5" DEPOSIT ABSOLUTE /end AXIS_DESCR
/end CHARACTERISTIC
/begin CHARACTERISTIC KLELTEMP "Temperaturfaktor El¸fter" CURVE 0xFC8436 KlAxU8SstxU16WU16 1.992188 fak_ub_b2 0.00 1.992188 FORMAT "%8.6"
 /begin AXIS_DESCR STD_AXIS tans_tmp temp_ub_q0p75_o48 6 -48.00000 143.2500 FORMAT "%8.4" DEPOSIT ABSOLUTE /end AXIS_DESCR
/end CHARACTERISTIC
/begin CHARACTERISTIC KLELUB "" CURVE 0xFC8450 KlAxU8SstxU16WU16 1.992188 fak_ub_b2 0.00 1.992188 FORMAT "%8.6"
 /begin AXIS_DESCR STD_AXIS ub_tmp spg_ubatt 5 0.00 24.02100 FORMAT "%8.5" DEPOSIT ABSOLUTE /end AXIS_DESCR
/end CHARACTERISTIC
/begin CHARACTERISTIC KLIMLKHKM "Max. Verh. psum_w/mlsu f¸r Katheizen in Abh‰ngigkeit von der Laufleistung" CURVE 0xFCE3E6 KlAUbSstUwWUb 0.9961 fak_ub_b1 0.00 0.9961
 /begin AXIS_DESCR STD_AXIS kmstand km_uw_q10 8 0.00 655350.0 FORMAT "%8.1" DEPOSIT ABSOLUTE /end AXIS_DESCR
/end CHARACTERISTIC
/begin CHARACTERISTIC KLTKHKM "Maximale Einschaltdauer der Funktion Katheizen in Abh‰ngigkeit von der Laufleist" CURVE 0xFCE400 KlAUwSstUwWUw 655.3500 t10msxs_uw_b655p35 0.00 655.3500 FORMAT "%8.4"
 /begin AXIS_DESCR STD_AXIS kmstand km_uw_q10 8 0.00 655350.0 FORMAT "%8.1" DEPOSIT ABSOLUTE /end AXIS_DESCR
/end CHARACTERISTIC
/begin CHARACTERISTIC KTNDMRKH "Int.-Konstante f¸r Anforderung Drehmomentenreserve Katheizen" VALUE 0xFCE422 KwUw 0.9999847 fak_uw_b1 0.00 0.9999847 FORMAT "%9.7" /end CHARACTERISTIC
/begin CHARACTERISTIC LRNST1_T "Wartezeit in Lernschritt 1" VALUE 0xFC1DE8 KwUb 5.080 t20msxs_ub_b5p1 0.02000 5.100 FORMAT "%5.3" /end CHARACTERISTIC
/begin CHARACTERISTIC LRNST3_T "Wartezeit in Lernschritt 3" VALUE 0xFC1DE9 KwUb 5.080 t20msxs_ub_b5p1 0.02000 5.100 FORMAT "%5.3" /end CHARACTERISTIC
/begin CHARACTERISTIC LRNST7_T "Wartezeit in Lernschritt 7" VALUE 0xFC1DEA KwUb 5.080 t20msxs_ub_b5p1 0.02000 5.100 FORMAT "%5.3" /end CHARACTERISTIC
/begin CHARACTERISTIC LRNST9_T "Wartezeit in Lernschritt 9" VALUE 0xFC1DEB KwUb 5.080 t20msxs_ub_b5p1 0.02000 5.100 FORMAT "%5.3" /end CHARACTERISTIC
/begin CHARACTERISTIC LRNVB_T "Lernverbotszeit f¸r 'normales Lernen'" VALUE 0xFC1E02 KwUw 1310.700 t20msxs_uw_q0p02 0.00 1310.700 FORMAT "%8.3" /end CHARACTERISTIC
/begin CHARACTERISTIC MIFAVLN "Vollasterkennung ¸ber Momentenanforderung" CURVE 0xFC82D0 KlAUwSstUwWUw 199.9969 rel_uw_b200 0.00 199.9969 FORMAT "%8.4"
 /begin AXIS_DESCR STD_AXIS nmot_w nmot_uw_q0p25 14 0.00 16383.75 FORMAT "%8.2" DEPOSIT ABSOLUTE /end AXIS_DESCR
/end CHARACTERISTIC
/begin CHARACTERISTIC MIFAVLNHYS "Hysterese f¸r Vollasterkennung ¸ber Momenentanforderung" VALUE 0xFC82CA KwWU16 199.9969 rel_uw_b200 0.00 199.9969 FORMAT "%8.4" /end CHARACTERISTIC
/begin CHARACTERISTIC MLKHMX "max. Luftmasse f¸r Katheizen" VALUE 0xFCE379 KwUb 1020. m_ub_b1020 0.00 1020. FORMAT "%5.0" /end CHARACTERISTIC
/begin CHARACTERISTIC MLSUS "Sollwert Luftmassen-Integral f¸r motorisches Katheizen" CURVE 0xFCE37C KlAUbSstUbWUb 5.803 m_ub_b5p8 0.00 5.803 FORMAT "%5.3"
 /begin AXIS_DESCR STD_AXIS tmst temp_ub_q0p75_o48 12 -48.00 143.3 FORMAT "%5.1" DEPOSIT ABSOLUTE /end AXIS_DESCR
/end CHARACTERISTIC
/begin CHARACTERISTIC MRFABNTE "Schwelle zur Erkennung von Dauer-Hochlastfahrt" VALUE 0xFCD715 KwUb 99.61 rel_ub_b99p6 0.00 99.61 FORMAT "%5.2" /end CHARACTERISTIC
/begin CHARACTERISTIC MRFAVLN "Vollasterkennungsschwelle des relativen Fahrerwunsches" CURVE 0xFC830A KlAUwSstUwWUw 199.9969 rel_uw_b200 0.00 199.9969 FORMAT "%8.4"
 /begin AXIS_DESCR STD_AXIS nmot_w nmot_uw_q0p25 14 0.00 16383.75 FORMAT "%8.2" DEPOSIT ABSOLUTE /end AXIS_DESCR
/end CHARACTERISTIC
/begin CHARACTERISTIC MRFAVLNHYS "Hysterese f¸r Vollasterkennung Fahrerwunsch" VALUE 0xFC82CC KwWU16 199.9969 rel_uw_b200 0.00 199.9969 FORMAT "%8.4" /end CHARACTERISTIC
/begin CHARACTERISTIC NALEMIN "Drehzahl,untehalb der der Zahnint. aktiviert wird" VALUE 0xFC1DBA KwWU16 1000.000 nmot_uw_q0p25 0.00 1000.000 FORMAT "%8.3" /end CHARACTERISTIC
/begin CHARACTERISTIC NARAO "obere Drehzahlschwelle f¸r AR aktiv" VALUE 0xFC7186 KwUb 10200. nmot_ub_q40 0.00 10200. FORMAT "%5.0" /end CHARACTERISTIC
/begin CHARACTERISTIC NARASTG "Drehzahlschwelle in hoeherem Gang fuer AR aktiv" CURVE 0xFC7188 FklWUb 10200. nmot_ub_q40 0.00 10200. FORMAT "%5.0"
 /begin AXIS_DESCR FIX_AXIS gangi dez 6 1.000 6.000 FORMAT "%5.3" FIX_AXIS_PAR 1 0 6 /end AXIS_DESCR
/end CHARACTERISTIC
/begin CHARACTERISTIC NARLL "Drehzahlschwelle f¸r AR im Leerlauf" VALUE 0xFC718E KwUb 10200. nmot_ub_q40 0.00 10200. FORMAT "%5.0" /end CHARACTERISTIC
/begin CHARACTERISTIC NDFILOG "Schwelle f¸r Filterausgang ndfil" CURVE 0xFC71CC FklWUw 16383.75 nmot_uw_q0p25 0.00 16383.75 FORMAT "%8.2"
 /begin AXIS_DESCR FIX_AXIS gangi dez 6 1.000 6.000 FORMAT "%5.3" FIX_AXIS_PAR 1 0 6 /end AXIS_DESCR
/end CHARACTERISTIC
/begin CHARACTERISTIC NDIFFOG "Schwelle Drehzahldifferenz zum Auslˆsen Ini der AR beim Verzˆgern" CURVE 0xFCF59E FklWSw 16383.75 nmot_sw_q0p25 -8192.000 8191.750 FORMAT "%8.3"
 /begin AXIS_DESCR FIX_AXIS gangi dez 6 1.000 6.000 FORMAT "%5.3" FIX_AXIS_PAR 1 0 6 /end AXIS_DESCR
/end CHARACTERISTIC
/begin CHARACTERISTIC NFGRMAX "Max. zul. Drehzahl bei FGR-Betrieb" VALUE 0xFC2048 KwUb 10200. nmot_ub_q40 0.00 10200. FORMAT "%5.0" /end CHARACTERISTIC
/begin CHARACTERISTIC NGANGMIN "Schwelle fuer Gangerkennung, Mindestwert PLausibilitaetstest" VALUE 0xFC1EFC KwUw 16383.75 nmot_uw_q0p25 0.00 16383.75 FORMAT "%8.2" /end CHARACTERISTIC
/begin CHARACTERISTIC NGDNSA "Drehzahlgradient beim Absteuern der Schubabschalthysterese" VALUE 0xFC6BB0 KwSw 10239.84 nmotg_sw_q0p15625 -5120.000 5119.844 FORMAT "%8.3" /end CHARACTERISTIC
/begin CHARACTERISTIC NLLKT "Leerlaufsolldrehzahl bei Kurztest Sekund‰rluftdiagnose" VALUE 0xFCE395 KwUb 2550. nmot_ub_q10 0.00 2550. FORMAT "%5.0" /end CHARACTERISTIC
/begin CHARACTERISTIC NLPST1T "Wartezeit 1 im NLP-Lernen" VALUE 0xFC1DEC KwUb 2.540 t10msxs_ub_b2p55 0.01000 2.550 FORMAT "%5.3" /end CHARACTERISTIC
/begin CHARACTERISTIC NLPST2T "Wartezeit 2 im NLP-Lernen" VALUE 0xFC1DED KwUb 2.540 t10msxs_ub_b2p55 0.01000 2.550 FORMAT "%5.3" /end CHARACTERISTIC
/begin CHARACTERISTIC NMXSKA "Maximaldrehzahl bei unbekannter Drosselklappenposition -> Ev-Abschaltung" VALUE 0xFC4A18 KwUb 10200. nmot_ub_q40 0.00 10200. FORMAT "%5.0" /end CHARACTERISTIC
/begin CHARACTERISTIC NNSTA "Drehzahl¸bergang Normal -> Start" CURVE 0xFCCD40 KlAUbSstUbWUb 10200. nmot_ub_q40 0.00 10200. FORMAT "%5.0"
 /begin AXIS_DESCR STD_AXIS tans temp_ub_q0p75_o48 3 -48.00 143.3 FORMAT "%5.1" DEPOSIT ABSOLUTE /end AXIS_DESCR
/end CHARACTERISTIC
/begin CHARACTERISTIC NSTNM "‹bergang Start -> Normal" CURVE 0xFCCD48 KlAUbSstUbWUb 10200. nmot_ub_q40 0.00 10200. FORMAT "%5.0"
 /begin AXIS_DESCR STD_AXIS tmot temp_ub_q0p75_o48 3 -48.00 143.3 FORMAT "%5.1" DEPOSIT ABSOLUTE /end AXIS_DESCR
/end CHARACTERISTIC
/begin CHARACTERISTIC NTUMTAT "Schwelle Drehzahl f¸r Bestimmung Umgebungstemperatur aus TANS" VALUE 0xFCCAD2 KwUb 10200. nmot_ub_q40 0.00 10200. FORMAT "%5.0" /end CHARACTERISTIC
/begin CHARACTERISTIC NUEMAX "Motor¸berdrehzahlgrenzwert" VALUE 0xFC1DC6 KwUw 16383.75 nmot_uw_q0p25 0.00 16383.75 FORMAT "%8.2" /end CHARACTERISTIC
/begin CHARACTERISTIC NVG "Faktor zur Berechnung Initialisierungsdrehzahl" CURVE 0xFCF5AA FklWUw 511.9922 qnv_uw_b512 0.00 511.9922 FORMAT "%8.4"
 /begin AXIS_DESCR FIX_AXIS gangi dez 6 1.000 6.000 FORMAT "%5.3" FIX_AXIS_PAR 1 0 6 /end AXIS_DESCR
/end CHARACTERISTIC
/begin CHARACTERISTIC NVMNG "Minimales Drehzahl/Geschwindigkeits-Verh‰ltnis" CURVE 0xFCF5B6 FklWUw 511.9922 qnv_uw_b512 0.00 511.9922 FORMAT "%8.4"
 /begin AXIS_DESCR FIX_AXIS gangi dez 6 1.000 6.000 FORMAT "%5.3" FIX_AXIS_PAR 1 0 6 /end AXIS_DESCR
/end CHARACTERISTIC
/begin CHARACTERISTIC NVMXG "Maximales Drehzahl/Geschwindigkeits-Verh‰ltnis" CURVE 0xFCF5C2 FklWUw 511.9922 qnv_uw_b512 0.00 511.9922 FORMAT "%8.4"
 /begin AXIS_DESCR FIX_AXIS gangi dez 6 1.000 6.000 FORMAT "%5.3" FIX_AXIS_PAR 1 0 6 /end AXIS_DESCR
/end CHARACTERISTIC
/begin CHARACTERISTIC NVQUOT1O "Gangerkennung n/v 1 Gang oben" VALUE 0xFC1EFE KwUw 511.9922 qnv_uw_b512 0.00 511.9922 FORMAT "%8.4" /end CHARACTERISTIC
/begin CHARACTERISTIC NVQUOT1U "Gangerekennung n/v 1 Gang unten" VALUE 0xFC1F00 KwUw 511.9922 qnv_uw_b512 0.00 511.9922 FORMAT "%8.4" /end CHARACTERISTIC
/begin CHARACTERISTIC NVQUOT2O "Gangerkennung n/v 2 Gang oben" VALUE 0xFC1F02 KwUw 511.9922 qnv_uw_b512 0.00 511.9922 FORMAT "%8.4" /end CHARACTERISTIC
/begin CHARACTERISTIC NVQUOT2U "Gangerkennung n/v 2 Gang unten" VALUE 0xFC1F04 KwUw 511.9922 qnv_uw_b512 0.00 511.9922 FORMAT "%8.4" /end CHARACTERISTIC
/begin CHARACTERISTIC NVQUOT3O "Gangerkennung n/v 3 Gang oben" VALUE 0xFC1F06 KwUw 511.9922 qnv_uw_b512 0.00 511.9922 FORMAT "%8.4" /end CHARACTERISTIC
/begin CHARACTERISTIC NVQUOT3U "Gangerkennung n/v 3 Gang unten" VALUE 0xFC1F08 KwUw 511.9922 qnv_uw_b512 0.00 511.9922 FORMAT "%8.4" /end CHARACTERISTIC
/begin CHARACTERISTIC NVQUOT4O "Gangerkennung n/v 4 Gang oben" VALUE 0xFC1F0A KwUw 511.9922 qnv_uw_b512 0.00 511.9922 FORMAT "%8.4" /end CHARACTERISTIC
/begin CHARACTERISTIC NVQUOT4U "Gangerkennung n/v 4 Gang unten" VALUE 0xFC1F0C KwUw 511.9922 qnv_uw_b512 0.00 511.9922 FORMAT "%8.4" /end CHARACTERISTIC
/begin CHARACTERISTIC NVQUOT5O "Gangerkennung n/v 5 Gang oben" VALUE 0xFC1F0E KwUw 511.9922 qnv_uw_b512 0.00 511.9922 FORMAT "%8.4" /end CHARACTERISTIC
/begin CHARACTERISTIC NVQUOT5U "Gangerkennung n/v 5 Gang unten" VALUE 0xFC1F10 KwUw 511.9922 qnv_uw_b512 0.00 511.9922 FORMAT "%8.4" /end CHARACTERISTIC
/begin CHARACTERISTIC NVQUOT6O "Gangerkennung n/v 6 Gang oben" VALUE 0xFC1F12 KwUw 511.9922 qnv_uw_b512 0.00 511.9922 FORMAT "%8.4" /end CHARACTERISTIC
/begin CHARACTERISTIC NVQUOT6U "Gangerkennung n/v 6 Gang unten" VALUE 0xFC1F14 KwUw 511.9922 qnv_uw_b512 0.00 511.9922 FORMAT "%8.4" /end CHARACTERISTIC
/begin CHARACTERISTIC NWEM "Wiedereinsetzdrehzahl" CURVE 0xFCF22C GklWUb 10200. nmot_ub_q40 0.00 10200. FORMAT "%5.0"
 /begin AXIS_DESCR COM_AXIS tmot temp_ub_q0p75_o48 5 -48.00 143.3 FORMAT "%5.1" AXIS_PTS_REF STM05SAUB /end AXIS_DESCR
/end CHARACTERISTIC
/begin CHARACTERISTIC NWEMT "Wiedereinsetzdrehzahl gedrosselt" CURVE 0xFCF234 GklWUb 10200. nmot_ub_q40 0.00 10200. FORMAT "%5.0"
 /begin AXIS_DESCR COM_AXIS tmot temp_ub_q0p75_o48 5 -48.00 143.3 FORMAT "%5.1" AXIS_PTS_REF STM05SAUB /end AXIS_DESCR
/end CHARACTERISTIC
/begin CHARACTERISTIC NWENG "Wiedereinsetzdrehzahl" CURVE 0xFC6BB2 KlAUbSstSbWUb 10200. nmot_ub_q40 0.00 10200. FORMAT "%5.0"
 /begin AXIS_DESCR STD_AXIS ngfil nmotg_sb_q100 5 -12800. 12700. FORMAT "%5.0" DEPOSIT ABSOLUTE /end AXIS_DESCR
/end CHARACTERISTIC
/begin CHARACTERISTIC NZMSE "Drehzahlgrenze f¸r sicheres Verlassen der ZMS-Resonanz" VALUE 0xFCCD50 KwUw 16383.75 nmot_uw_q0p25 0.00 16383.75 FORMAT "%8.2" /end CHARACTERISTIC
/begin CHARACTERISTIC NZMSMN "untere Drehzahlgrenze f¸r ZMS-Schutz" VALUE 0xFCCD52 KwUw 16383.75 nmot_uw_q0p25 0.00 16383.75 FORMAT "%8.2" /end CHARACTERISTIC
/begin CHARACTERISTIC NZMSMX "obere Drehzahlgrenze f¸r ZMS-Schutz" VALUE 0xFCCD54 KwUw 16383.75 nmot_uw_q0p25 0.00 16383.75 FORMAT "%8.2" /end CHARACTERISTIC
/begin CHARACTERISTIC RALEMAX "Begrenzungswinkel f¸r max R¸ckdrehen" VALUE 0xFC1DBC KwWU16 360.0000 kw_q0p1 0.00 360.0000 FORMAT "%8.4" /end CHARACTERISTIC
/begin CHARACTERISTIC RDUNDEF "Winkelbereich in dem keine Plausibilisierung des R¸ckdrehverdachts mˆglich ist" VALUE 0xFC1DBE KwWS16 180.0000 kw_q0p1 0.00 180.0000 FORMAT "%8.4" /end CHARACTERISTIC
/begin CHARACTERISTIC REDABM "Ev-Abschaltmuster f¸r Momentenreduzierung" MAP 0xFC4A08 FkfNoShNoOffWUb 255.0 dez 0.00 255.0 FORMAT "%5.1"
 /begin AXIS_DESCR FIX_AXIS evrbgn_one dez 4 0.00 3.000 FORMAT "%5.3" FIX_AXIS_PAR 0 0 4 /end AXIS_DESCR
 /begin AXIS_DESCR FIX_AXIS redsol_one dez 4 0.00 3.000 FORMAT "%5.3" FIX_AXIS_PAR 0 0 4 /end AXIS_DESCR
/end CHARACTERISTIC
/begin AXIS_PTS SEZ06TMUB "St¸tzstellenverteilung, Z¸ndwinkelwirkungsgrad" 0xFCC81C etazwimt SstAUbSstUb 127.5 rel_ub_b127p5 6 0.00 127.5 FORMAT "%5.1" DEPOSIT ABSOLUTE /end AXIS_PTS
/begin AXIS_PTS SFR04BBUW "" 0xFC0ED4 frhol_w SstAU8SstU16 1.999969 fak_uw_b2 4 0.00 1.999969 FORMAT "%8.6" DEPOSIT ABSOLUTE /end AXIS_PTS
/begin AXIS_PTS SGA08MDUB "St¸tzstellenverteilung Ist Gang 8 Sst." 0xFC0F6C gangi SstAUbSstUb 255.0 dez 8 0.00 255.0 FORMAT "%5.1" DEPOSIT ABSOLUTE /end AXIS_PTS
/begin AXIS_PTS SLX06TMUW "St¸tzstellenverteilung, Lambdasoll" 0xFCC928 lamsons_w SstAUwSstUw 15.99976 fak_uw_b16 6 0.00 15.99976 FORMAT "%8.5" DEPOSIT ABSOLUTE /end AXIS_PTS
/begin AXIS_PTS SMK08MDSW "Antiruckelmoment-abh‰ngige St¸tzstellen (Anzahl =8)" 0xFCF5CE mkar_w SstASwSstSw 199.9969 rel_sw_b100 8 -100.0000 99.99695 FORMAT "%8.4" DEPOSIT ABSOLUTE /end AXIS_PTS
/begin AXIS_PTS SML06TMUW "St¸tzstellenverteilung, Luftmasse, 6 St¸tzstellen" 0xFCC936 ml_w SstAUwSstUw 6553.500 m_uw_b6553p5 6 0.00 6553.500 FORMAT "%8.3" DEPOSIT ABSOLUTE /end AXIS_PTS
/begin AXIS_PTS SML07TMUW "St¸tzstellenverteilung, Luftmasse, 7 St¸tzstellen" 0xFCC944 ml_w SstAUwSstUw 6553.500 m_uw_b6553p5 7 0.00 6553.500 FORMAT "%8.3" DEPOSIT ABSOLUTE /end AXIS_PTS
/begin AXIS_PTS SMT06TMUW "St¸tzstellenverteilung, Luftmasse, 6 St¸tzstellen" 0xFCCAD4 ml_w SstAUbSstUb 6553.500 m_uw_b6553p5 6 0.00 6553.500 FORMAT "%8.3" DEPOSIT ABSOLUTE /end AXIS_PTS
/begin AXIS_PTS SNM08GKUB "St¸tzstellenverteilung Gemischkontrolle 8 nmot St¸tzstellen" 0xFC0F40 nmot SstAU8SstU8 10200. nmot_ub_q40 8 0.00 10200. FORMAT "%5.0" DEPOSIT ABSOLUTE /end AXIS_PTS
/begin AXIS_PTS SNM08__UB "St¸tzstellenverteilung Drehzahl, 8 Sst." 0xFC0FE8 nmot SstAUbSstUb 10200. nmot_ub_q40 8 0.00 10200. FORMAT "%5.0" DEPOSIT ABSOLUTE /end AXIS_PTS
/begin AXIS_PTS ST107TMUB "St¸tzstellenverteilung, Starttemperatur an Sonde vorne" 0xFCC8A4 tabgmst SstAUbSstUb 1275. temp_ub_q5_o50 7 -50.00 1225. FORMAT "%5.0" DEPOSIT ABSOLUTE /end AXIS_PTS
/begin AXIS_PTS ST307TMUB "St¸tzstellenverteilung, Starttemperatur an Sonde hinten" 0xFCC8AC tkatmst SstAUbSstUb 1275. temp_ub_q5_o50 7 -50.00 1225. FORMAT "%5.0" DEPOSIT ABSOLUTE /end AXIS_PTS
/begin AXIS_PTS STM05SAUB "St¸tzstellenverteilung" 0xFCC8BC tmot SstAUbSstUb 191.3 temp_ub_q0p75_o48 5 -48.00 143.3 FORMAT "%5.1" DEPOSIT ABSOLUTE /end AXIS_PTS
/begin AXIS_PTS STM05TMUB "St¸tzstellenverteilung, Motorstarttemperatur" 0xFCC97C tmst SstAUwSstUw 191.3 temp_ub_q0p75_o48 5 -48.00 143.3 FORMAT "%5.1" DEPOSIT ABSOLUTE /end AXIS_PTS
/begin AXIS_PTS STM08BBUB "" 0xFC0F58 tmot SstAU8SstU8 191.3 temp_ub_q0p75_o48 8 -48.00 143.3 FORMAT "%5.1" DEPOSIT ABSOLUTE /end AXIS_PTS
/begin AXIS_PTS STS06TMUW "St¸tzstellenverteilung, Abgasmassenfluﬂ" 0xFCCB8A tabstatm_w SstAUwSstUw 65535.00 t1sxs_uw_q1 6 0.00 65535.00 FORMAT "%8.2" DEPOSIT ABSOLUTE /end AXIS_PTS
/begin AXIS_PTS STU05TMUB "St¸tzstellenverteilung, Ersatz-Umgebungstemperatur" 0xFCCADC tatu SstAUbSstUb 191.3 temp_ub_q0p75_o48 5 -48.00 143.3 FORMAT "%5.1" DEPOSIT ABSOLUTE /end AXIS_PTS
/begin CHARACTERISTIC TABGMEX "Abgastemperatur unterhalb der Kat-Anspringtemperatur" VALUE 0xFCCAE2 KwUb 1275. temp_ub_q5_o50 -50.00 1225. FORMAT "%5.0" /end CHARACTERISTIC
/begin CHARACTERISTIC TABSTKH "Mindestabstellzeit f¸r Freigabe Kat-Heizen" VALUE 0xFCE424 KwUw 65535.00 t1sxs_uw_b65535 0.00 65535.00 FORMAT "%8.2" /end CHARACTERISTIC
/begin CHARACTERISTIC TABSTKHX "Mindestabstellzeit f¸r Reset imlatmw_w-ACCU" VALUE 0xFCE426 KwUw 65535.00 t1sxs_uw_b65535 0.00 65535.00 FORMAT "%8.2" /end CHARACTERISTIC
/begin CHARACTERISTIC TAPVLTM "Schwelle Abstellzeit f¸r EKP-Vorlauf" CURVE 0xFCC084 KlAUbSstUbWUw 65535.00 t1sxs_uw_b65535 0.00 65535.00 FORMAT "%8.2"
 /begin AXIS_DESCR STD_AXIS tmotab temp_ub_q0p75_o48 12 -48.00 143.3 FORMAT "%5.1" DEPOSIT ABSOLUTE /end AXIS_DESCR
/end CHARACTERISTIC
/begin CHARACTERISTIC TAREIN "Sperrzeit f¸r Antiruckelfunktion" VALUE 0xFC718F KwUb 2.550 t10msxs_ub_b2p55 0.00 2.550 FORMAT "%5.3" /end CHARACTERISTIC
/begin CHARACTERISTIC TASTBFA "Modell-Temperatur vor Vorkatalysator Startwert bei B_faatm Anforderung" VALUE 0xFCCAE3 KwUb 1275. temp_ub_q5_o50 -50.00 1225. FORMAT "%5.0" /end CHARACTERISTIC
/begin CHARACTERISTIC TATEGRDO "Obere Schwelle Tastverh‰ltnis TEV zur Erkennung eines neg. Gradienten tatesoll" VALUE 0xFC9B02 KwUb 99.61 rel_ub_b99p6 0.00 99.61 FORMAT "%5.2" /end CHARACTERISTIC
/begin CHARACTERISTIC TATEGRDU "Untere Schwelle Tastverh‰ltnis TEV zur Erkennung eines neg. Gradienten tatesoll" VALUE 0xFC9B03 KwUb 99.61 rel_ub_b99p6 0.00 99.61 FORMAT "%5.2" /end CHARACTERISTIC
/begin CHARACTERISTIC TATELL "tans- Schwelle f¸r Tankentl¸fung bei B_ll = 1" VALUE 0xFCD716 KwUb 191.3 temp_ub_q0p75_o48 -48.00 143.3 FORMAT "%5.1" /end CHARACTERISTIC
/begin CHARACTERISTIC TATMKH "Abgastemperaturkorrektur bei Kat-Heizen aktiv" VALUE 0xFCCAE4 KwUb 1275. temp_q5 0.00 1275. FORMAT "%5.0" /end CHARACTERISTIC
/begin CHARACTERISTIC TATMKW "Abgastemperaturkorrektur bei Kat warmhalten aktiv" VALUE 0xFCCAE5 KwUb 1275. temp_q5 0.00 1275. FORMAT "%5.0" /end CHARACTERISTIC
/begin CHARACTERISTIC TATMSA "Abgastemperatur bei Schubabschneiden" VALUE 0xFCCAE6 KwUb 1275. temp_ub_q5_o50 -50.00 1225. FORMAT "%5.0" /end CHARACTERISTIC
/begin CHARACTERISTIC TATMSAE "exotherme Temperaturerhˆhung im Schub" VALUE 0xFCCAE7 KwUb 1275. temp_ub_q5_o50 -50.00 1225. FORMAT "%5.0" /end CHARACTERISTIC
/begin CHARACTERISTIC TATMSTI "Initialisierungswert f¸r tabgm, tkatm Startwert bei Powerfail" VALUE 0xFCCAE8 KwUb 1275. temp_ub_q5_o50 -50.00 1225. FORMAT "%5.0" /end CHARACTERISTIC
/begin CHARACTERISTIC TATMTMOT "Motortemperatur warmer Motor , f¸r Temperaturkorrektur beim Kaltstart" VALUE 0xFCCAE9 KwUb 191.3 temp_ub_q0p75_o48 -48.00 143.3 FORMAT "%5.1" /end CHARACTERISTIC
/begin CHARACTERISTIC TATMTP "Abgastaupunkttemperatur" VALUE 0xFCCAEA KwUb 1275. temp_ub_q5_o50 -50.00 1225. FORMAT "%5.0" /end CHARACTERISTIC
/begin CHARACTERISTIC TATMTRKH "Abgastemperaturkorrektur bei Thermoreaktor-Katheizen" VALUE 0xFCCAEB KwUb 1275. temp_q5 0.00 1275. FORMAT "%5.0" /end CHARACTERISTIC
/begin CHARACTERISTIC TATMWMK "Temperaturoffset  f¸r W‰rmemengenberechnung" VALUE 0xFCCAEC KwSb 1275. temp_q5 -640.0 635.0 FORMAT "%5.1" /end CHARACTERISTIC
/begin CHARACTERISTIC TDBKVSTEND "Einschaltverzˆgerung BKV-Pumpe nach Startende" VALUE 0xFD03D8 KwUb 2.550 t10msxs_ub_b2p55 0.00 2.550 FORMAT "%5.3" /end CHARACTERISTIC
/begin CHARACTERISTIC TDDEDBKVP "max. Einschaltdauer der elektrischen BKV-Pumpe" VALUE 0xFD03DC KwUw 1310.700 t20msxs_uw_q0p02 0.00 1310.700 FORMAT "%8.3" /end CHARACTERISTIC
/begin CHARACTERISTIC TDKNACH "Zeit im Nachlauf bis stromlose DK im NLP einschwingt" VALUE 0xFC1E04 KwUw 655.3500 t10msxs_uw_b655p35 0.00 655.3500 FORMAT "%8.4" /end CHARACTERISTIC
/begin CHARACTERISTIC TDLRPIDMX "max. Zeit f¸r PWM-Tastverh‰ltnis des DLR bei temp. UMA-Adapt." VALUE 0xFC1DEE KwUb 12.75 t50msxs_q0p05 0.00 12.75 FORMAT "%5.2" /end CHARACTERISTIC
/begin CHARACTERISTIC TDVIVZ "Toleranzzeit bei zu groﬂer Abweichung zw. Istgeschw. und Zielgeschw." VALUE 0xFC205A KwUw 1310.680 t20msxs_uw_q0p02 0.02000000 1310.700 FORMAT "%8.3" /end CHARACTERISTIC
/begin CHARACTERISTIC TDVZVI "Toleranzzeit bei zu groﬂer Abweichung zw. Zielgeschw. und Istgeschw." VALUE 0xFC205C KwUw 1310.680 t20msxs_uw_q0p02 0.02000000 1310.700 FORMAT "%8.3" /end CHARACTERISTIC
/begin CHARACTERISTIC TEVPMN1 "Minimale Ansteuerzeit f¸r TEV Schwelle 1" VALUE 0xFC9B04 KwUb 127.5 t500usxms_ub_q0p5 0.00 127.5 FORMAT "%5.1" /end CHARACTERISTIC
/begin CHARACTERISTIC TEVPMN2 "Minimale Ansteuerzeit f¸r TEV Schwelle 2" VALUE 0xFC9B05 KwUb 127.5 t500usxms_ub_q0p5 0.00 127.5 FORMAT "%5.1" /end CHARACTERISTIC
/begin CHARACTERISTIC TFGRAQU "Toleranzzeit f¸r Aquaplaningerkennung im FGR-Betrieb" VALUE 0xFC2049 KwUb 5.080 t20msxs_ub_b5p1 0.02000 5.100 FORMAT "%5.3" /end CHARACTERISTIC
/begin CHARACTERISTIC TFGRASCOF "Zeit f¸r FGR-Abschaltung bei aktivem Brems-Eingriff" VALUE 0xFC205E KwUw 1310.700 t20msxs_uw_q0p02 0.00 1310.700 FORMAT "%8.3" /end CHARACTERISTIC
/begin CHARACTERISTIC TFGRBREOF "Zeit f¸r FGR-Abschaltung bei aktivem Brems-Eingriff" VALUE 0xFC2060 KwUw 1310.700 t20msxs_uw_q0p02 0.00 1310.700 FORMAT "%8.3" /end CHARACTERISTIC
/begin CHARACTERISTIC TFGRDSCOF "Zeit f¸r FGR-Abschaltung bei aktivem DSC-Eingriff" VALUE 0xFC2062 KwUw 1310.700 t20msxs_uw_q0p02 0.00 1310.700 FORMAT "%8.3" /end CHARACTERISTIC
/begin CHARACTERISTIC TFGRUEOB "Toleranzzeit f¸r ‹berschreiten der oberen Beschleunigungsschwelle im FGR-Betrieb" VALUE 0xFC204A KwUb 5.080 t20msxs_ub_b5p1 0.02000 5.100 FORMAT "%5.3" /end CHARACTERISTIC
/begin CHARACTERISTIC TFGRUM "Toleranzzeit f¸r Erkennung FGR-Betrieb in der Funktions¸berwachung" VALUE 0xFC204B KwUb 5.080 t20msxs_ub_b5p1 0.02000 5.100 FORMAT "%5.3" /end CHARACTERISTIC
/begin CHARACTERISTIC TFGRUNUB "Toleranzzeit f¸r Unterschreiten der unteren Beschl.schwelle im FGR-Betrieb" VALUE 0xFC204C KwUb 5.080 t20msxs_ub_b5p1 0.02000 5.100 FORMAT "%5.3" /end CHARACTERISTIC
/begin CHARACTERISTIC TIKATMOE "Temperaturkorrektur im Kat ohne Exotherme tikatm" VALUE 0xFCCAED KwSb 1275. temp_q5 -640.0 635.0 FORMAT "%5.1" /end CHARACTERISTIC
/begin CHARACTERISTIC TKATMN "Katalysatortemperaturregelschwelle f¸r Kat warmhalten" VALUE 0xFCE396 KwUb 1275. temp_ub_q5_o50 -50.00 1225. FORMAT "%5.0" /end CHARACTERISTIC
/begin CHARACTERISTIC TKATMOE "Temperaturkorrektur Kat ohne Exotherme tkatm" VALUE 0xFCCAEE KwSb 1275. temp_q5 -640.0 635.0 FORMAT "%5.1" /end CHARACTERISTIC
/begin CHARACTERISTIC TKATSAN "Katalysator-Temperaturschwelle f¸r Schubabschalten f(nmot)" CURVE 0xFCF23C KlAUbSstUbWUb 1275. temp_ub_q5_o50 -50.00 1225. FORMAT "%5.0"
 /begin AXIS_DESCR STD_AXIS nmot nmot_ub_q40 4 0.00 10200. FORMAT "%5.0" DEPOSIT ABSOLUTE /end AXIS_DESCR
/end CHARACTERISTIC
/begin CHARACTERISTIC TKATW "Katalysatortemperaturschwelle f¸r Kat warmhalten" VALUE 0xFCE397 KwUb 1275. temp_ub_q5_o50 -50.00 1225. FORMAT "%5.0" /end CHARACTERISTIC
/begin CHARACTERISTIC TKHABB "Entprellzeit f¸r Abbruchbedingungen der Funktion Katheizen" VALUE 0xFCE398 KwUb 25.50 t100msxs_ub_b25p5 0.00 25.50 FORMAT "%5.2" /end CHARACTERISTIC
/begin CHARACTERISTIC TKHFSAB "Entprellzeit f¸r Umschaltung auf Katheizdrehzahl bei Fahrstufe" VALUE 0xFCE399 KwUb 25.50 t100msxs_ub_b25p5 0.00 25.50 FORMAT "%5.2" /end CHARACTERISTIC
/begin CHARACTERISTIC TKHLL "Abbruchzeit Katheizen Leerlauf" VALUE 0xFCE428 KwUw 6553.500 t100msxs_uw_b6553p5 0.00 6553.500 FORMAT "%8.3" /end CHARACTERISTIC
/begin CHARACTERISTIC TKHLLAB "Entprellzeit f¸r Ende Katheizdrehzahl im LL" VALUE 0xFCE39A KwUb 25.50 t100msxs_ub_b25p5 0.00 25.50 FORMAT "%5.2" /end CHARACTERISTIC
/begin CHARACTERISTIC TKHLLMX "Maximale Zeit f¸r angehobene Katheiz-Drehzahl" VALUE 0xFCE42A KwUw 655.3500 t10msxs_uw_b655p35 0.00 655.3500 FORMAT "%8.4" /end CHARACTERISTIC
/begin CHARACTERISTIC TKHNAB "Zeitdauer Absteuern Katheizdrehzahl" VALUE 0xFCE42C KwUw 6553.500 t100msxs_uw_b6553p5 0.00 6553.500 FORMAT "%8.3" /end CHARACTERISTIC
/begin CHARACTERISTIC TKSTBFA "Modell-Temperatur hinter Hauptkat Startwert bei B_faatm Anforderun" VALUE 0xFCCAEF KwUb 1275. temp_ub_q5_o50 -50.00 1225. FORMAT "%5.0" /end CHARACTERISTIC
/begin CHARACTERISTIC TMAR "Untere tmot-Schwelle f¸r AR-Freigabe" VALUE 0xFC7190 KwUb 191.3 temp_ub_q0p75_o48 -48.00 143.3 FORMAT "%5.1" /end CHARACTERISTIC
/begin CHARACTERISTIC TMLAST "Sperrzeit bis zum Auslˆsen des Ini der AR beim Verzˆgern" VALUE 0xFC7191 KwUb 2.550 t10msxs_ub_b2p55 0.00 2.550 FORMAT "%5.3" /end CHARACTERISTIC
/begin CHARACTERISTIC TMNTEVZU "Minimale Zeit bis TEV nach Ansteuerung schlieﬂt" VALUE 0xFC9B06 KwUb 0.1245 t_tev0p0005 0.00 0.1245 FORMAT "%6.4" /end CHARACTERISTIC
/begin CHARACTERISTIC TMSKLH "Motortemperaturschwelle f¸r kurze LRA-Anfangsphase bei Heiﬂstart" VALUE 0xFCD717 KwUb 191.3 temp_ub_q0p75_o48 -48.00 143.3 FORMAT "%5.1" /end CHARACTERISTIC
/begin CHARACTERISTIC TMSKS "Motortemperaturschwelle f¸r Erkennung Benzin im ÷l" VALUE 0xFCDF58 KwUb 191.3 temp_ub_q0p75_o48 -48.00 143.3 FORMAT "%5.1" /end CHARACTERISTIC
/begin CHARACTERISTIC TMSLOF "Motortemperaturschwelle f¸r Sperre Sekund‰rluft" VALUE 0xFCE39B KwUb 191.3 temp_ub_q0p75_o48 -48.00 143.3 FORMAT "%5.1" /end CHARACTERISTIC
/begin CHARACTERISTIC TMSNOGA "Schwelle tms f¸r Dauersp¸len nach Fahrzyklus mit erfolgter Gemischadaption" VALUE 0xFCD718 KwUb 191.3 temp_ub_q0p75_o48 -48.00 143.3 FORMAT "%5.1" /end CHARACTERISTIC
/begin CHARACTERISTIC TMSUTMUMA "untere Tmot-Schwelle f¸r tempor‰re UMA-Adaption" VALUE 0xFC1DEF KwUb 191.3 temp_ub_q0p75_o48 -48.00 143.3 FORMAT "%5.1" /end CHARACTERISTIC
/begin CHARACTERISTIC TNKL15DC "Zeit nach KL15 ein zur Freigabe der CAN-Diagnosen." VALUE 0xFC0EA0 KwWU8 25.50 t100msxs_ub_b25p5 0.00 25.50 FORMAT "%5.2" /end CHARACTERISTIC
/begin CHARACTERISTIC TNLATM "Minimale SG-Nachlaufzeit f¸r ATM - Abstellzeit" VALUE 0xFCCB98 KwUw 65535.00 t1sxs_uw_q1 0.00 65535.00 FORMAT "%8.2" /end CHARACTERISTIC
/begin CHARACTERISTIC TNLATMTM "bei tmot > Schwellert  SG-Nachlauf-Anforderung B_nlatm = 1" VALUE 0xFCCAF0 KwUb 191.3 temp_ub_q0p75_o48 -48.00 143.3 FORMAT "%5.1" /end CHARACTERISTIC
/begin CHARACTERISTIC TNLATMTU "bei tumg (tatu -ATM) > Schwellwert SG-Nachlauf-Anforderung" VALUE 0xFCCAF1 KwUb 191.3 temp_ub_q0p75_o48 -48.00 143.3 FORMAT "%5.1" /end CHARACTERISTIC
/begin CHARACTERISTIC TNLEKPVL "Schwelle SG-Nachlaufzeit f¸r EKP-Vorlauf" VALUE 0xFCC07E KwUb 255.0 t1sxs_ub_b255 0.00 255.0 FORMAT "%5.1" /end CHARACTERISTIC
/begin CHARACTERISTIC TNSDMRKH "Zeit nach Start f¸r Drehmomentenreserve Katheizen" VALUE 0xFCE42E KwUw 655.3500 t10msxs_uw_b655p35 0.00 655.3500 FORMAT "%8.4" /end CHARACTERISTIC
/begin CHARACTERISTIC TPVL "Zeit f¸r Pumpenvorlauf" VALUE 0xFCC07F KwUb 2.550 t10msxs_ub_b2p55 0.00 2.550 FORMAT "%5.3" /end CHARACTERISTIC
/begin CHARACTERISTIC TTE "Zeit f¸r Tankentl¸ftungsphase" VALUE 0xFCD720 KwUw 6553.500 t100msxs_uw_b6553p6 0.00 6553.500 FORMAT "%8.3" /end CHARACTERISTIC
/begin CHARACTERISTIC TTEAE "Zeit f¸r Tankentl¸ftungsphase bei eingeschwungener Gemischadaption" VALUE 0xFCD722 KwUw 6553.500 t100msxs_uw_b6553p6 0.00 6553.500 FORMAT "%8.3" /end CHARACTERISTIC
/begin CHARACTERISTIC TTEBSTP "Maximal Zeit f¸r TE-Stop im Leerlauf bei nicht gesetzten Zyklusflags" VALUE 0xFCD724 KwUw 6553.500 t100msxs_uw_b6553p6 0.00 6553.500 FORMAT "%8.3" /end CHARACTERISTIC
/begin CHARACTERISTIC TTEGA "Zeit bei der Tankentl¸ftung f¸r Grundadaption" VALUE 0xFCD726 KwUw 6553.500 t100msxs_uw_b6553p6 0.00 6553.500 FORMAT "%8.3" /end CHARACTERISTIC
/begin CHARACTERISTIC TTEGAI "Zeitdauer der ersten  Gemischadaptionsphase" VALUE 0xFCD728 KwUw 6553.500 t100msxs_uw_b6553p6 0.00 6553.500 FORMAT "%8.3" /end CHARACTERISTIC
/begin CHARACTERISTIC TTEGAIH "Zeitdauer der ersten  Gemischadaptionsphase bei Heiﬂstart" VALUE 0xFCD72A KwUw 6553.500 t100msxs_uw_b6553p6 0.00 6553.500 FORMAT "%8.3" /end CHARACTERISTIC
/begin CHARACTERISTIC TTEGAZO "Zeit f¸r Tankentl¸ftungsstop wg. Gemischadaption, obere Schwelle" VALUE 0xFCD72C KwUw 6553.500 t100msxs_uw_b6553p6 0.00 6553.500 FORMAT "%8.3" /end CHARACTERISTIC
/begin CHARACTERISTIC TTEGAZU "Zeit f¸r Tankentl¸ftungsstop wg. Gemischadaption, untere Schwelle" VALUE 0xFCD72E KwUw 6553.500 t100msxs_uw_b6553p6 0.00 6553.500 FORMAT "%8.3" /end CHARACTERISTIC
/begin CHARACTERISTIC TTEINI "Zeit f¸r Tankentl¸ftung in erster TE-Phase nach Initialisierung (B_ini)" VALUE 0xFCD730 KwUw 6553.500 t100msxs_uw_b6553p6 0.00 6553.500 FORMAT "%8.3" /end CHARACTERISTIC
/begin CHARACTERISTIC TTEMN "Zeit f¸r Tankentl¸ftungsphase minimal" VALUE 0xFCD732 KwUw 6553.500 t100msxs_uw_b6553p6 0.00 6553.500 FORMAT "%8.3" /end CHARACTERISTIC
/begin CHARACTERISTIC TTEPRIO "Zeit ab Start f¸r Umschalten auf Dauertankentl¸ftung" VALUE 0xFCD734 KwUw 6553.500 t100msxs_uw_b6553p6 0.00 6553.500 FORMAT "%8.3" /end CHARACTERISTIC
/begin CHARACTERISTIC TTEZAO "Zeit f¸r Tankentl¸ftung Daueraktivierung, obere Schwelle" VALUE 0xFCD736 KwUw 6553.500 t100msxs_uw_b6553p6 0.00 6553.500 FORMAT "%8.3" /end CHARACTERISTIC
/begin CHARACTERISTIC TTEZAU "Zeit f¸r Tankentl¸ftung Daueraktivierung, untere Schwelle" VALUE 0xFCD738 KwUw 6553.500 t100msxs_uw_b6553p6 0.00 6553.500 FORMAT "%8.3" /end CHARACTERISTIC
/begin CHARACTERISTIC TTMUMASTA "Zeitdauer f¸r Station‰rzustand bei temp. UMA-Adaption" VALUE 0xFC1E06 KwUw 3276.750 t50msxs_q0p05 0.00 3276.750 FORMAT "%8.3" /end CHARACTERISTIC
/begin CHARACTERISTIC TUMTAIT "Initialisierungswert Umgebungstemperatur aus TANS" VALUE 0xFCCAF2 KwUb 191.3 temp_ub_q0p75_o48 -48.00 143.3 FORMAT "%5.1" /end CHARACTERISTIC
/begin CHARACTERISTIC TVARDASHG "Verzˆgerungszeit f¸r AR wieder inaktiv nach Dashpot gangabh‰ngig" CURVE 0xFC7194 FklWUb 2.550 t10msxs_ub_b2p55 0.00 2.550 FORMAT "%5.3"
 /begin AXIS_DESCR FIX_AXIS gangi dez 8 0.00 7.000 FORMAT "%5.3" FIX_AXIS_PAR 0 0 8 /end AXIS_DESCR
/end CHARACTERISTIC
/begin CHARACTERISTIC TVARKUPPLG "Verzˆgerungszeit f¸r AR wieder inaktiv nach Kupplung gangabh‰ngig" CURVE 0xFC719C FklWUb 2.550 t10msxs_ub_b2p55 0.00 2.550 FORMAT "%5.3"
 /begin AXIS_DESCR FIX_AXIS gangi dez 8 0.00 7.000 FORMAT "%5.3" FIX_AXIS_PAR 0 0 8 /end AXIS_DESCR
/end CHARACTERISTIC
/begin CHARACTERISTIC TVARLSDG "Verzˆgerungszeit f¸r AR wieder inaktiv nach Lastschlag gangabh‰ngig" CURVE 0xFC71A4 FklWUb 2.550 t10msxs_ub_b2p55 0.00 2.550 FORMAT "%5.3"
 /begin AXIS_DESCR FIX_AXIS gangi dez 8 0.00 7.000 FORMAT "%5.3" FIX_AXIS_PAR 0 0 8 /end AXIS_DESCR
/end CHARACTERISTIC
/begin CHARACTERISTIC TVARS "Verzoegerungszeit fuer AR wieder inaktiv" VALUE 0xFC71AC KwUb 2.550 t10msxs_ub_b2p55 0.00 2.550 FORMAT "%5.3" /end CHARACTERISTIC
/begin CHARACTERISTIC TVKUPAR "Verzˆgerungszeit Kupplung f¸r Antiruckelfunktion" VALUE 0xFC71AD KwUb 5.100 t20msxs_ub_b5p1 0.00 5.100 FORMAT "%5.3" /end CHARACTERISTIC
/begin CHARACTERISTIC TVKUPHS "Verzˆgerungszeit Kupplungsschalter beim Hochschalten" CURVE 0xFC71B0 FklWUb 2.550 t10msxs_ub_b2p55 0.00 2.550 FORMAT "%5.3"
 /begin AXIS_DESCR FIX_AXIS gangi dez 6 1.000 6.000 FORMAT "%5.3" FIX_AXIS_PAR 1 0 6 /end AXIS_DESCR
/end CHARACTERISTIC
/begin CHARACTERISTIC TVKUPRS "Verzˆgerungszeit Kupplungsschalter beim Runterschalten" CURVE 0xFC71B8 FklWUb 2.550 t10msxs_ub_b2p55 0.00 2.550 FORMAT "%5.3"
 /begin AXIS_DESCR FIX_AXIS gangi dez 6 1.000 6.000 FORMAT "%5.3" FIX_AXIS_PAR 1 0 6 /end AXIS_DESCR
/end CHARACTERISTIC
/begin CHARACTERISTIC TVSATM "Sperrzeit Schubabschalten nach Startende" CURVE 0xFCF248 GklWUb 255.0 t1sxs_ub_b255 0.00 255.0 FORMAT "%5.1"
 /begin AXIS_DESCR COM_AXIS tmot temp_ub_q0p75_o48 5 -48.00 143.3 FORMAT "%5.1" AXIS_PTS_REF STM05SAUB /end AXIS_DESCR
/end CHARACTERISTIC
/begin CHARACTERISTIC TVZMSE "Zeitgrenze f¸r R¸cksetzen ‹berwachungsz‰hler ZMS- Resonanz" VALUE 0xFCCD56 KwUw 655.3500 t10msxs_uw_b655p35 0.00 655.3500 FORMAT "%8.4" /end CHARACTERISTIC
/begin CHARACTERISTIC TWPEDBR "Entprellzeit f¸r Plausibilisierung Fahrpedalwert mit Bremspedal" VALUE 0xFC1F1A KwUb 2.550 t10msxs_ub_b2p55 0.00 2.550 FORMAT "%5.3" /end CHARACTERISTIC
/begin CHARACTERISTIC TZMIN "Zeitfenster f¸r Zahnerkennung nach UBatt-Einbruch" VALUE 0xFCC080 KwUb 2.550 t10msxs_ub_b2p55 0.00 2.550 FORMAT "%5.3" /end CHARACTERISTIC
/begin CHARACTERISTIC TZMSAS "Zeitgrenze f¸r ZMS-Resonanz auﬂerhalb Start" VALUE 0xFC1F1E KwUw 655.3500 t10msxs_uw_b655p35 0.00 655.3500 FORMAT "%8.4" /end CHARACTERISTIC
/begin CHARACTERISTIC TZMSST "Zeitgrenze f¸r ZMS-Resonanz innerhalb Start" VALUE 0xFC1F20 KwUw 655.3500 t10msxs_uw_b655p35 0.00 655.3500 FORMAT "%8.4" /end CHARACTERISTIC
/begin CHARACTERISTIC TZSPINI "Sperrzeit fuer Filterinitialisierung" VALUE 0xFC71BE KwUb 2.550 t10msxs_ub_b2p55 0.00 2.550 FORMAT "%5.3" /end CHARACTERISTIC
/begin CHARACTERISTIC UANAUFRP "Schrittweite f¸r AUF-Rampe" VALUE 0xFC1E08 KwUw 0.9994659 relDK_uw_b100 0.00 0.9994659 FORMAT "%9.7" /end CHARACTERISTIC
/begin CHARACTERISTIC UANNMAX "Motordrehzahlschwelle f¸r Freigabe UMA-Lernen und Verst‰rkerabgleich" VALUE 0xFC1DF0 KwUb 2550. nmot_ub_q10 0.00 2550. FORMAT "%5.0" /end CHARACTERISTIC
/begin CHARACTERISTIC UANPEDMAX "Pedalschwelle f¸r UMA-Lernen erlaubt" VALUE 0xFC1DF1 KwUb 100.0 relDK_ub_b100 0.00 100.0 FORMAT "%5.1" /end CHARACTERISTIC
/begin CHARACTERISTIC UANPIDMIN "Abbruchschwelle PID-Summe f¸r ZU-Rampe" VALUE 0xFC1E0A KwUw 99.99847 rel_uw_b100 0.00 99.99847 FORMAT "%8.5" /end CHARACTERISTIC
/begin CHARACTERISTIC UANPIDMINA "Abbruchschwelle PID-Summe f¸r AUF-Rampe" VALUE 0xFC1E0C KwUw 99.99847 rel_uw_b100 0.00 99.99847 FORMAT "%8.5" /end CHARACTERISTIC
/begin CHARACTERISTIC UANUATS "untere Ansauglufttemperaturschwelle f¸r Lernfreigabe" VALUE 0xFC1DF2 KwUb 191.3 temp_ub_q0p75_o48 -48.00 143.3 FORMAT "%5.1" /end CHARACTERISTIC
/begin CHARACTERISTIC UANVFZG "Geschwindigkeitssschelle f¸r DV-E-Pr¸fung/Lernroutine" VALUE 0xFC1DF3 KwUb 318.8 vfzg_ub_q1p25 0.00 318.8 FORMAT "%5.1" /end CHARACTERISTIC
/begin CHARACTERISTIC UANZURP "Schrittweite f¸r ZU-Rampe" VALUE 0xFC1E0E KwUw 0.05010200 spg_uw_q0p001222 0.00 0.05010200 FORMAT "%10.8" /end CHARACTERISTIC
/begin CHARACTERISTIC UAN_O_MT "obere Motortemperaturschwelle f¸r Anschlag" VALUE 0xFC1DF4 KwUb 191.3 temp_ub_q0p75_o48 -48.00 143.3 FORMAT "%5.1" /end CHARACTERISTIC
/begin CHARACTERISTIC UAN_STORE "Schwelle f¸r Abspeicherung neuer Lernwerte" VALUE 0xFC1E10 KwUw 0.05010200 spg_uw_q0p001222 0.00 0.05010200 FORMAT "%10.8" /end CHARACTERISTIC
/begin CHARACTERISTIC UAN_U_MT "untere Motortemperaturschwelle f¸r Lernfreigabe" VALUE 0xFC1DF5 KwUb 191.3 temp_ub_q0p75_o48 -48.00 143.3 FORMAT "%5.1" /end CHARACTERISTIC
/begin CHARACTERISTIC UBDCAN "UBatt-Schwelle f¸r Diagnose CAN-Timeout" VALUE 0xFC0EA1 KwWU8 24.02 spg_ubatt 0.00 24.02 FORMAT "%5.2" /end CHARACTERISTIC
/begin CHARACTERISTIC UBSQBKVMN "min. Spannungsschwelle f¸r BKV-Pumpe-Ansteuerung mˆglich" VALUE 0xFD03D9 KwUb 25.50 spg_q0p1 0.00 25.50 FORMAT "%5.2" /end CHARACTERISTIC
/begin CHARACTERISTIC UBSQBKVMX "max. Spannungsschwelle f¸r BKV-Pumpe-Ansteuerung mˆglich" VALUE 0xFD03DA KwUb 25.50 spg_q0p1 0.00 25.50 FORMAT "%5.2" /end CHARACTERISTIC
/begin CHARACTERISTIC UBSTS "Schwelle zur Erkennung UBatt-Einbruch im Start" VALUE 0xFCC081 KwUb 24.02 spg_ubatt 0.00 24.02 FORMAT "%5.2" /end CHARACTERISTIC
/begin CHARACTERISTIC UB_UANL "Batteriespannungsschwelle f¸r Lernfreigabe" VALUE 0xFC1DF6 KwUb 24.02 spg_ubatt 0.00 24.02 FORMAT "%5.2" /end CHARACTERISTIC
/begin CHARACTERISTIC UDKNLP1N "Nennwert-Spannung DK-Poti 1 in NLP-Stellung" VALUE 0xFC1E12 KwUw 5.004090 spg_uw_q0p001222 0.00 5.004090 FORMAT "%8.6" /end CHARACTERISTIC
/begin CHARACTERISTIC UDKNLP2N "Nennwert-Spannung DK-Poti 2 in NLP-Stellung" VALUE 0xFC1E14 KwUw 5.004090 spg_uw_q0p001222 0.00 5.004090 FORMAT "%8.6" /end CHARACTERISTIC
/begin CHARACTERISTIC UDKP1AMAX "max. Spannung DK-Poti 1 am unteren DK-Anschlag" VALUE 0xFC1E16 KwUw 5.004090 spg_uw_q0p001222 0.00 5.004090 FORMAT "%8.6" /end CHARACTERISTIC
/begin CHARACTERISTIC UDKP1AMIN "min. Spannung DK-Poti 1 am unteren DK-Anschlag" VALUE 0xFC1E18 KwUw 5.004090 spg_uw_q0p001222 0.00 5.004090 FORMAT "%8.6" /end CHARACTERISTIC
/begin CHARACTERISTIC UDKP1AURI "Spannung DK-Poti 1 am unt. DK-Anschlag, Initial. Wert" VALUE 0xFC1E1A KwUw 5.004090 spg_uw_q0p001222 0.00 5.004090 FORMAT "%8.6" /end CHARACTERISTIC
/begin CHARACTERISTIC UDKP1DUS "Nennumschaltschwelle zur DK-Poti-1-Umschaltung" VALUE 0xFC1DF7 KwUb 4.980 spg_ub_b5 0.00 4.980 FORMAT "%5.3" /end CHARACTERISTIC
/begin CHARACTERISTIC UDKP1NHUB "Nennhub der Drosselklappe im DV-E, (Poti 1)" VALUE 0xFC1E1C KwUw 5.004090 spg_uw_q0p001222 0.00 5.004090 FORMAT "%8.6" /end CHARACTERISTIC
/begin CHARACTERISTIC UDKP1VID "Nennverst‰rkung f¸r DK-Poti 1" VALUE 0xFC1E1E KwUw 7.996094 fak_q0p0039 0.00 7.996094 FORMAT "%8.6" /end CHARACTERISTIC
/begin CHARACTERISTIC UDKP1VOMA "max. Offsetfehler f¸r DK-Poti-1-Verst‰rker" VALUE 0xFC1E20 KwSw 5.004090 spg_sw_q0p001222 0.00 5.004090 FORMAT "%8.6" /end CHARACTERISTIC
/begin CHARACTERISTIC UDKP1VOMI "min. Offsetfehler f¸r DK-Poti-1-Verst‰rker" VALUE 0xFC1E22 KwSw 5.004090 spg_sw_q0p001222 -5.004090 0.00 FORMAT "%8.6" /end CHARACTERISTIC
/begin CHARACTERISTIC UDKP1VVMA "ob. Wert Verst‰rkungsfehler f¸r Verst‰rker" VALUE 0xFC1E24 KwUw 7.996094 fak_q0p0039 0.00 7.996094 FORMAT "%8.6" /end CHARACTERISTIC
/begin CHARACTERISTIC UDKP1VVMI "unt. Wert Verst‰rkungsfehler f¸r Verst‰rker" VALUE 0xFC1E26 KwUw 7.996094 fak_q0p0039 0.00 7.996094 FORMAT "%8.6" /end CHARACTERISTIC
/begin CHARACTERISTIC UDKP2AMAX "max. Spannung DK-Poti 2 am unteren DK-Anschlag" VALUE 0xFC1E28 KwUw 5.004090 spg_uw_q0p001222 0.00 5.004090 FORMAT "%8.6" /end CHARACTERISTIC
/begin CHARACTERISTIC UDKP2AMIN "min. Spannung DK-Poti 2 am unteren DK-Anschlag" VALUE 0xFC1E2A KwUw 5.004090 spg_uw_q0p001222 0.00 5.004090 FORMAT "%8.6" /end CHARACTERISTIC
/begin CHARACTERISTIC UDKP2AURI "Spannung DK-Poti 2 am unt. DK-Anschlag, Initial. Wert" VALUE 0xFC1E2C KwUw 5.004090 spg_uw_q0p001222 0.00 5.004090 FORMAT "%8.6" /end CHARACTERISTIC
/begin CHARACTERISTIC UDKPALOS "Spannungsoffset zur Erkennung des Loslˆsens" VALUE 0xFC1E2E KwUw 0.4008160 spg_uw_q0p001222 0.00 0.4008160 FORMAT "%9.7" /end CHARACTERISTIC
/begin CHARACTERISTIC UDKPAOFF "Spannungsoffset am unteren Anschlag" VALUE 0xFC1E30 KwUw 0.05010200 spg_uw_q0p001222 0.00 0.05010200 FORMAT "%10.8" /end CHARACTERISTIC
/begin CHARACTERISTIC UDKPATMX "max. mˆglicher Offset der temp. UMA-Adaption" VALUE 0xFC1E32 KwUw 5.004090 spg_uw_q0p001222 0.00 5.004090 FORMAT "%8.6" /end CHARACTERISTIC
/begin CHARACTERISTIC UPVGNENN "Nennwert f¸r DV-E Potiversorgungsspannung" VALUE 0xFCC9A8 KwUw 1.000000 dez 65534.00 65535.00 FORMAT "%8.2" /end CHARACTERISTIC
/begin CHARACTERISTIC UPWGKDO "Oberer Hysterese-Schaltpunkt zur Kick-Down-Erkennung aus Potispannung" VALUE 0xFC1F16 KwUb 4.980 spg_ub_b5 0.00 4.980 FORMAT "%5.3" /end CHARACTERISTIC
/begin CHARACTERISTIC UPWGKDU "Unterer Hysterese-Schaltpunkt zur Kick-Down-Erkennung aus Potispannung" VALUE 0xFC1F17 KwUb 4.980 spg_ub_b5 0.00 4.980 FORMAT "%5.3" /end CHARACTERISTIC
/begin CHARACTERISTIC VARAU "minimale Fahrzeuggeschwindigkeit f¸r ARA - Funktion" VALUE 0xFC71BF KwUb 317.5 fak_ub_b318p75 0.00 317.5 FORMAT "%5.1" /end CHARACTERISTIC
/begin CHARACTERISTIC VBGFGRAQ "Geschwindigkeit Bereichsgrenze bei Aquaplaningerkennung" VALUE 0xFC2064 KwUw 511.9922 vfzg_uw_b512 0.00 511.9922 FORMAT "%8.4" /end CHARACTERISTIC
/begin CHARACTERISTIC VFGRMAX "Maximal zul‰ssige Geschwindigkeit im FGR-Betrieb" VALUE 0xFC2066 KwUw 511.9922 vfzg_uw_b512 0.00 511.9922 FORMAT "%8.4" /end CHARACTERISTIC
/begin CHARACTERISTIC VFGRMIN "Minimal zul‰ssige Geschwindigkeit im FGR-Betrieb" VALUE 0xFC2068 KwUw 511.9922 vfzg_uw_b512 0.00 511.9922 FORMAT "%8.4" /end CHARACTERISTIC
/begin CHARACTERISTIC VREGLMAX "Maximal zul‰ssige Sollgeschwindigkeit f¸r FGR" VALUE 0xFC206A KwUw 511.9922 vfzg_uw_b512 0.00 511.9922 FORMAT "%8.4" /end CHARACTERISTIC
/begin CHARACTERISTIC VREGLMIN "Minimal zul‰ssige Sollgeschwindigkeit f¸r FGR" VALUE 0xFC206C KwUw 511.9922 vfzg_uw_b512 0.00 511.9922 FORMAT "%8.4" /end CHARACTERISTIC
/begin CHARACTERISTIC VSAA "Geschwindigkeitsschwelle f¸r SA-Drehzahlanhebung" VALUE 0xFC6BAF KwUb 318.8 vfzg_ub_q1p25 0.00 318.8 FORMAT "%5.1" /end CHARACTERISTIC
/begin CHARACTERISTIC VTUMTAT "Schwelle Fahrzeuggeschwindigkeit f¸r TANS -> Umgebungstemperatur" VALUE 0xFCCAF3 KwUb 318.8 vfzg_ub_q1p25 0.00 318.8 FORMAT "%5.1" /end CHARACTERISTIC
/begin CHARACTERISTIC W360_ALE_IMPL "" VALUE 0xFC1DC0 KwWU16 360.0000 kw_q0p1 0.00 360.0000 FORMAT "%8.4" READ_ONLY /end CHARACTERISTIC
/begin CHARACTERISTIC W720_ALE_IMPL "" VALUE 0xFC1DC2 KwWU16 719.9000 kw_q0p1 0.1000000 720.0000 FORMAT "%8.4" READ_ONLY /end CHARACTERISTIC
/begin CHARACTERISTIC WDKFPRO2 "Pr¸fschwelle DK-Istwert f¸r ˆffnende DV-E-Federpr¸fung" VALUE 0xFC1E34 KwSw 1599.976 relDK_q0p02441 -800.0000 799.9756 FORMAT "%8.4" /end CHARACTERISTIC
/begin CHARACTERISTIC WDKFPROO "Obere Abschaltschwelle DK-Istwert f¸r ˆffnende DV-E-Federpr¸fung" VALUE 0xFC1E36 KwSw 1599.976 relDK_q0p02441 -800.0000 799.9756 FORMAT "%8.4" /end CHARACTERISTIC
/begin CHARACTERISTIC WDKFPROU "Untere Abschaltschwelle DK-Istwert f¸r ˆffnende DV-E-Federpr¸fung" VALUE 0xFC1E38 KwSw 1599.976 relDK_q0p02441 -800.0000 799.9756 FORMAT "%8.4" /end CHARACTERISTIC
/begin CHARACTERISTIC WDKFPRZ1 "Abschaltschwelle DK-Istwert f¸r DV-E-R¸ckstellfederpr¸fung" VALUE 0xFC1E3A KwUw 100.0000 relDK_uw_b100 0.00 100.0000 FORMAT "%8.4" /end CHARACTERISTIC
/begin CHARACTERISTIC WDKFPRZ2 "Pr¸fschwelle DK-Istwert f¸r DV-E-R¸ckstellfederpr¸fung" VALUE 0xFC1E3C KwUw 100.0000 relDK_uw_b100 0.00 100.0000 FORMAT "%8.4" /end CHARACTERISTIC
/begin CHARACTERISTIC WDKNLPMA "oberer erlaubter Istwert f¸r NLP-Stellung" VALUE 0xFC1E3E KwUw 100.0000 relDK_uw_b100 0.00 100.0000 FORMAT "%8.4" /end CHARACTERISTIC
/begin CHARACTERISTIC WDKNLPMI "unterer erlaubter Istwert f¸r NLP-Stellung" VALUE 0xFC1E40 KwUw 100.0000 relDK_uw_b100 0.00 100.0000 FORMAT "%8.4" /end CHARACTERISTIC
/begin CHARACTERISTIC WDKNPLAUS "Schwelle rechnerische Plausibilisierung NLP wdknlp_w in Ini2" VALUE 0xFC1E42 KwUw 100.0000 relDK_uw_b100 0.00 100.0000 FORMAT "%8.4" /end CHARACTERISTIC
/begin CHARACTERISTIC WDKNSTORE "Schwelle Abspeichern neuer Lernwerte relativer NLP" VALUE 0xFC1E44 KwUw 100.0000 relDK_uw_b100 0.00 100.0000 FORMAT "%8.4" /end CHARACTERISTIC
/begin CHARACTERISTIC WDKSFPR "DK-Sollwert f¸r DV-E-R¸ckstellfederpr¸fung" VALUE 0xFC1E46 KwUw 100.0000 relDK_uw_b100 0.00 100.0000 FORMAT "%8.4" /end CHARACTERISTIC
/begin CHARACTERISTIC WDKSFPRO "DK-Sollwert f¸r ˆffnende DV-E-Federpr¸fung" VALUE 0xFC1E48 KwUw 100.0000 relDK_uw_b100 0.00 100.0000 FORMAT "%8.4" /end CHARACTERISTIC
/begin CHARACTERISTIC WDKSTMUMA "DK-Winkel-Schwelle f¸r tempor‰re UMA-Adaption" VALUE 0xFC1E4A KwUw 100.0000 relDK_uw_b100 0.00 100.0000 FORMAT "%8.4" /end CHARACTERISTIC
/begin CHARACTERISTIC WDKVLN "Drosselklappenwinkelschwelle f¸r Vollasterkennung" CURVE 0xFC8344 KlAUwSstUwWUw 1599.976 relDK_q0p02441 0.00 1599.976 FORMAT "%8.3"
 /begin AXIS_DESCR STD_AXIS nmot_w nmot_uw_q0p25 14 0.00 16383.75 FORMAT "%8.2" DEPOSIT ABSOLUTE /end AXIS_DESCR
/end CHARACTERISTIC
/begin CHARACTERISTIC WDKVLNHYS "Hysterese f¸r Drosselklappenwinkelschwelle" VALUE 0xFC82CE KwWU16 1599.976 relDK_q0p02441 0.00 1599.976 FORMAT "%8.3" /end CHARACTERISTIC
/begin CHARACTERISTIC WMABGKH "Faktor f¸r W‰rmemengenkorrektur bei Katheizen f¸r Taupunktende" VALUE 0xFCCAF4 KwUb 1.000 fak_ub_b2 0.00 1.000 FORMAT "%5.3" /end CHARACTERISTIC
/begin CHARACTERISTIC WMKATKH "Faktor f¸r W‰rmemengenkorrektur bei Katheizen f¸r Taupunktende hinter Kat" VALUE 0xFCCAF5 KwUb 1.000 fak_ub_b2 0.00 1.000 FORMAT "%5.3" /end CHARACTERISTIC
/begin CHARACTERISTIC WPEDFMX "Fahrpedalschwelle f¸r PWG-Bremspedal Plausibilisierung" VALUE 0xFC1F1C KwUw 100.0000 relPED_uw_b100 0.00 100.0000 FORMAT "%8.4" /end CHARACTERISTIC
/begin CHARACTERISTIC WPEDU "Untere Schwelle Pedalwert f¸r Antiruckelfunktion" VALUE 0xFC71D8 KwUw 100.0000 relPED_uw_b100 0.00 100.0000 FORMAT "%8.4" /end CHARACTERISTIC
/begin CHARACTERISTIC WPKDMN "Minimaler Pedalwert f¸r Kick-Down-Erkennung" VALUE 0xFC1F18 KwUw 100.0000 relPED_uw_b100 0.00 100.0000 FORMAT "%8.4" /end CHARACTERISTIC
/begin CHARACTERISTIC ZATMAML "Zeitkonstante fuer Abgastemperaturmodell" CURVE 0xFCCB9A GklWUw 13106.800000 zk200msxs_uw_b13107 0.20000000000 13107.000000 FORMAT "%12.6"
 /begin AXIS_DESCR COM_AXIS ml_w m_uw_b6553p5 7 0.00 6553.500 FORMAT "%8.3" AXIS_PTS_REF SML07TMUW /end AXIS_DESCR
/end CHARACTERISTIC
/begin CHARACTERISTIC ZATMIKML "Zeitkonstante fuer Katalysatortemperaturmodell - Temperatur im Kat tikatm" CURVE 0xFCCBA8 GklWUw 13106.800000 zk200msxs_uw_b13107 0.20000000000 13107.000000 FORMAT "%12.6"
 /begin AXIS_DESCR COM_AXIS ml_w m_uw_b6553p5 7 0.00 6553.500 FORMAT "%8.3" AXIS_PTS_REF SML07TMUW /end AXIS_DESCR
/end CHARACTERISTIC
/begin CHARACTERISTIC ZATMKML "Zeitkonstante fuer Katalysatortemperaturmodell - Kat-Temperatur tkatm" CURVE 0xFCCBB6 GklWUw 13106.800000 zk200msxs_uw_b13107 0.20000000000 13107.000000 FORMAT "%12.6"
 /begin AXIS_DESCR COM_AXIS ml_w m_uw_b6553p5 7 0.00 6553.500 FORMAT "%8.3" AXIS_PTS_REF SML07TMUW /end AXIS_DESCR
/end CHARACTERISTIC
/begin CHARACTERISTIC ZATMRML "Zeitkonstante fuer Abgastemperaturmodell - Rohrwandtemperatur" CURVE 0xFCCBC4 GklWUw 13106.800000 zk200msxs_uw_b13107 0.20000000000 13107.000000 FORMAT "%12.6"
 /begin AXIS_DESCR COM_AXIS ml_w m_uw_b6553p5 7 0.00 6553.500 FORMAT "%8.3" AXIS_PTS_REF SML07TMUW /end AXIS_DESCR
/end CHARACTERISTIC
/begin CHARACTERISTIC ZKHABB "Zeitkonstante f¸r Abbruch-Tiefpass Katheizen" VALUE 0xFCE39C KwUb 25.4996 zk100msxs_ub_b25p5 0.100392 25.6000 FORMAT "%7.4" /end CHARACTERISTIC
/begin CHARACTERISTIC ZKLAMKH "Zeitkonstante Lambda-Motor-Soll bei Katheizen" VALUE 0xFC65F6 KwUw 655.34999985 zk10msxs_uw_b655 0.010000152590 655.36000000 FORMAT "%12.8" /end CHARACTERISTIC
/begin CHARACTERISTIC ZMRFABN "berechnet aktuelle Zeitkonstante des Tiefpaﬂ (Dauerhochlast) mrfabnf_w" CURVE 0xFCD73A KlAUwSstSwWUw 6553.50000 zk100msxs_uw_b6553 0.100001526 6553.60000 FORMAT "%10.5"
 /begin AXIS_DESCR STD_AXIS dmrfabn_w rel_sw_b100 5 -100.0000 99.99695 FORMAT "%8.4" DEPOSIT ABSOLUTE /end AXIS_DESCR
/end CHARACTERISTIC
/begin CHARACTERISTIC ZNOSTMX "Anzahl Z¸ndung=ein ohne Erreichen von Startende f¸r kein EKP-Vorlauf" VALUE 0xFCC082 KwUb 255.0 dez 0.00 255.0 FORMAT "%5.1" /end CHARACTERISTIC
/begin MEASUREMENT abmf "Festeinspritzausblendmuster" UBYTE dez 1 100 0 255 FORMAT "%5.1" ECU_ADDRESS 0x5B8E82 /end MEASUREMENT
/begin MEASUREMENT abo "Anzahl Starts mit Benzin im ÷l" UBYTE dez 1 100 0 255 FORMAT "%5.1" ECU_ADDRESS 0x3FDC50 /end MEASUREMENT
/begin MEASUREMENT AEKPintbits "" UBYTE dez 1 100 0 255 FORMAT "%5.1" ECU_ADDRESS 0x3FDD04 /end MEASUREMENT
/begin MEASUREMENT ALEBits1_10msSwOff "" UBYTE dez 1 100 0 255 FORMAT "%5.1" ECU_ADDRESS 0x5B8BFA /end MEASUREMENT
/begin MEASUREMENT ALEBits_10msSwOff "" UBYTE dez 1 100 0 255 FORMAT "%5.1" ECU_ADDRESS 0x3FDB98 /end MEASUREMENT
/begin MEASUREMENT ALEBits_tooth_int "" UBYTE dez 1 100 0 255 FORMAT "%5.1" ECU_ADDRESS 0x5B8BFB /end MEASUREMENT
/begin MEASUREMENT anzeab "Anzahl Segmente Ev-Abschaltung f¸r Notlauf Phasensuche" UBYTE dez 1 100 0 255 FORMAT "%5.1" ECU_ADDRESS 0x5B8E83 /end MEASUREMENT
/begin MEASUREMENT anznmax "Anzahl NMAX-‹berschreitungen" UBYTE dez 1 100 0 255 FORMAT "%5.1" ECU_ADDRESS 0x3FE930 /end MEASUREMENT
/begin MEASUREMENT anzpbr_w "Anzahl Ereignisse PWG-Bremspedal Plausibilisierung" UWORD dez 1 100 0 65535 FORMAT "%8.2" ECU_ADDRESS 0x3FE944 /end MEASUREMENT
/begin MEASUREMENT AS_hr "" UBYTE B_TRUE 1 100 0 1 BIT_MASK 0x1 FORMAT "%13.11" ECU_ADDRESS 0x3FBFBF /end MEASUREMENT
/begin MEASUREMENT AS_nl "" UBYTE B_TRUE 1 100 0 1 BIT_MASK 0x1 FORMAT "%13.11" ECU_ADDRESS 0x3FBFC0 /end MEASUREMENT
/begin MEASUREMENT AS_psoff "" UBYTE B_TRUE 1 100 0 1 BIT_MASK 0x1 FORMAT "%13.11" ECU_ADDRESS 0x3FBFC1 /end MEASUREMENT
/begin MEASUREMENT ATMbits "" UBYTE dez 1 100 0 255 FORMAT "%5.1" ECU_ADDRESS 0x3FDBA0 /end MEASUREMENT
/begin MEASUREMENT ATMbits1 "" UBYTE dez 1 100 0 255 FORMAT "%5.1" ECU_ADDRESS 0x5B8638 /end MEASUREMENT
/begin MEASUREMENT BBFGRlokBits "" UBYTE dez 1 100 0 255 FORMAT "%5.1" ECU_ADDRESS 0x5B8E79 /end MEASUREMENT
/begin MEASUREMENT BBKHZlokBits "" UWORD dez 1 100 0 65535 FORMAT "%8.2" ECU_ADDRESS 0x5B8832 /end MEASUREMENT
/begin MEASUREMENT BBSAWElokbits "" UBYTE dez 1 100 0 255 FORMAT "%5.1" ECU_ADDRESS 0x5B8F80 /end MEASUREMENT
/begin MEASUREMENT BGBNausbits0 "" UBYTE dez 1 100 0 255 FORMAT "%5.1" ECU_ADDRESS 0x5B902F /end MEASUREMENT
/begin MEASUREMENT BGDVEintbits "" UBYTE dez 1 100 0 255 FORMAT "%5.1" ECU_ADDRESS 0x3FE942 /end MEASUREMENT
/begin MEASUREMENT bmlosctr_w "Z‰hler (Word) Neusynchronisationen durch L¸ckenverlust" UWORD dez 1 100 0 65535 FORMAT "%8.2" ECU_ADDRESS 0x3FDC62 /end MEASUREMENT
/begin MEASUREMENT B_abgle "Bedingung: Fehler beim Verst‰rkerabgleich" UBYTE B_TRUE 1 100 0 1 BIT_MASK 0x1 FORMAT "%13.11" ECU_ADDRESS 0x3FBC4F /end MEASUREMENT
/begin MEASUREMENT B_abor "Bedigung Anzahl Starts mit Benzin im ÷l f¸r reduzierte LRA" UBYTE B_TRUE 1 100 0 1 BIT_MASK 0x1 FORMAT "%13.11" ECU_ADDRESS 0x3FBDAF /end MEASUREMENT
/begin MEASUREMENT B_ale "Bedingung Motorabstellposition erkannt" UBYTE B_TRUE 1 100 0 1 BIT_MASK 0x1 FORMAT "%13.11" ECU_ADDRESS 0x3FDB98 /end MEASUREMENT
/begin MEASUREMENT B_alechk "Bedingung R¸ckdrehen erkannt" UBYTE B_TRUE 1 100 0 1 BIT_MASK 0x4 FORMAT "%13.11" ECU_ADDRESS 0x5B8BFB /end MEASUREMENT
/begin MEASUREMENT B_aleundef "R¸ckdreherkennung im undefiniertem Bereich" UBYTE B_TRUE 1 100 0 1 FORMAT "%13.11" ECU_ADDRESS 0x3FDB99 /end MEASUREMENT
/begin MEASUREMENT B_apnoluv "Verriegelungsbit: Applikationshilfe DK-Notluftfahren" UBYTE B_TRUE 1 100 0 1 BIT_MASK 0x1 FORMAT "%13.11" ECU_ADDRESS 0x3FBC4D /end MEASUREMENT
/begin MEASUREMENT B_appnolu "Bedingung: DK-Notluftfahren durch Applikation angefordert" UBYTE B_TRUE 1 100 0 1 BIT_MASK 0x1 FORMAT "%13.11" ECU_ADDRESS 0x3FBC4E /end MEASUREMENT
/begin MEASUREMENT B_ar "Antiruckeleingriff aktiv" UBYTE B_TRUE 1 100 0 1 BIT_MASK 0x1 FORMAT "%13.11" ECU_ADDRESS 0x3FBF0B /end MEASUREMENT
/begin MEASUREMENT B_aren "Bedingung AR-Freigabe" UBYTE B_TRUE 1 100 0 1 BIT_MASK 0x1 FORMAT "%13.11" ECU_ADDRESS 0x3FBF0C /end MEASUREMENT
/begin MEASUREMENT B_argf "Bedingung Gangfenster Antiruckel" UBYTE B_TRUE 1 100 0 1 BIT_MASK 0x1 FORMAT "%13.11" ECU_ADDRESS 0x3FBF0D /end MEASUREMENT
/begin MEASUREMENT B_atmst "Bedingung Startwert tabgmst,tkatmst berechnet" UBYTE B_TRUE 1 100 0 1 BIT_MASK 0x2 FORMAT "%13.11" ECU_ADDRESS 0x5B8638 /end MEASUREMENT
/begin MEASUREMENT B_atmtpa "Bedingung Taupunkt vor Kat ueberschritten" UBYTE B_TRUE 1 100 0 1 BIT_MASK 0x1 FORMAT "%13.11" ECU_ADDRESS 0x3FBC89 /end MEASUREMENT
/begin MEASUREMENT B_atmtpf "Bedingung Taupunkt vor Kat ¸berschritten (last trip)" UBYTE B_TRUE 1 100 0 1 BIT_MASK 0x4 FORMAT "%13.11" ECU_ADDRESS 0x3FDBA0 /end MEASUREMENT
/begin MEASUREMENT B_atmtpk "Bedingung Taupunkt hinter Kat ueberschritten" UBYTE B_TRUE 1 100 0 1 BIT_MASK 0x1 FORMAT "%13.11" ECU_ADDRESS 0x3FBC8A /end MEASUREMENT
/begin MEASUREMENT B_atmtpl "Bedingung Taupunkt hinter Kat ¸berschritten (last trip)" UBYTE B_TRUE 1 100 0 1 BIT_MASK 0x1 FORMAT "%13.11" ECU_ADDRESS 0x3FDBA0 /end MEASUREMENT
/begin MEASUREMENT B_bevab "Bedingung EV-Abschaltung auf Bank/Bank1" UBYTE B_TRUE 1 100 0 1 BIT_MASK 0x1 FORMAT "%13.11" ECU_ADDRESS 0x3FBD43 /end MEASUREMENT
/begin MEASUREMENT B_bkvp "Bedingung: Bremskraftverst‰rker-Pumpe ansteuern" UBYTE B_TRUE 1 100 0 1 BIT_MASK 0x1 FORMAT "%13.11" ECU_ADDRESS 0x3FBFF1 /end MEASUREMENT
/begin MEASUREMENT B_bvhfm "Bedingung: Bordnetzversorgung HFM" UBYTE B_TRUE 1 100 0 1 BIT_MASK 0x1 FORMAT "%13.11" ECU_ADDRESS 0x5B902F /end MEASUREMENT
/begin MEASUREMENT B_bvhls "Bedingung: Bordnetzversorgung Lambdasondenheizung" UBYTE B_TRUE 1 100 0 1 BIT_MASK 0x2 FORMAT "%13.11" ECU_ADDRESS 0x5B902F /end MEASUREMENT
/begin MEASUREMENT B_cksbrdy "Checksummemberechnung ist fertig (ready)" UBYTE B_TRUE 1 100 0 1 BIT_MASK 0x1 FORMAT "%13.11" ECU_ADDRESS 0x3FBEA2 /end MEASUREMENT
/begin MEASUREMENT B_cksbrdy2 "2. Checksummemberechnung ist fertig (ready)" UBYTE B_TRUE 1 100 0 1 BIT_MASK 0x1 FORMAT "%13.11" ECU_ADDRESS 0x3FBEA3 /end MEASUREMENT
/begin MEASUREMENT B_dcdisr "Bedingung: DV-E-Endstufenabschaltung wird angefordert" UBYTE B_TRUE 1 100 0 1 BIT_MASK 0x1 FORMAT "%13.11" ECU_ADDRESS 0x3FBC50 /end MEASUREMENT
/begin MEASUREMENT B_dkaden "Bedingung: DK-Sollwert aus DK-Adaption und -Pr¸fung verwenden" UBYTE B_TRUE 1 100 0 1 BIT_MASK 0x1 FORMAT "%13.11" ECU_ADDRESS 0x3FBC51 /end MEASUREMENT
/begin MEASUREMENT B_dknach "Dauer-RAM, Bedingung: DK im Nachlauf stromlos und in NLP" UBYTE B_TRUE 1 100 0 1 BIT_MASK 0x8 FORMAT "%13.11" ECU_ADDRESS 0x3FE942 /end MEASUREMENT
/begin MEASUREMENT B_dkuevab "Bedingung Ev-Abschaltung bei unplausibler DK" UBYTE B_TRUE 1 100 0 1 BIT_MASK 0x1 FORMAT "%13.11" ECU_ADDRESS 0x3FBD31 /end MEASUREMENT
/begin MEASUREMENT B_dlrien "Bedingung: keine temp. Begrenzung des I-Anteils im DLR durchf¸hren" UBYTE B_TRUE 1 100 0 1 BIT_MASK 0x1 FORMAT "%13.11" ECU_ADDRESS 0x3FBC52 /end MEASUREMENT
/begin MEASUREMENT B_dmdstop "Ev-Abschaltung aktiv --> Aussetzerekennung sperren" UBYTE B_TRUE 1 100 0 1 BIT_MASK 0x1 FORMAT "%13.11" ECU_ADDRESS 0x3FBD2C /end MEASUREMENT
/begin MEASUREMENT B_dnsll "Bedingung SA-Drehzahl-Hysterese DNSLL" UBYTE B_TRUE 1 100 0 1 BIT_MASK 0x1 FORMAT "%13.11" ECU_ADDRESS 0x5B8F80 /end MEASUREMENT
/begin MEASUREMENT B_dveada "Bedingung: DV-E-Adaption sperrt Einspritzung" UBYTE B_TRUE 1 100 0 1 BIT_MASK 0x1 FORMAT "%13.11" ECU_ADDRESS 0x3FBC53 /end MEASUREMENT
/begin MEASUREMENT B_dvetv "Bedingung: Verriegelungsbit erweiterte Stellertauscherkennung" UBYTE B_TRUE 1 100 0 1 BIT_MASK 0x1 FORMAT "%13.11" ECU_ADDRESS 0x3FBC54 /end MEASUREMENT
/begin MEASUREMENT B_eepwf "Bedingung Powerfail EEPROM" UBYTE B_TRUE 1 100 0 1 BIT_MASK 0x1 FORMAT "%13.11" ECU_ADDRESS 0x3FBFBD /end MEASUREMENT
/begin MEASUREMENT B_ekp "Freigabe der EKP-Versorgung" UBYTE B_TRUE 1 100 0 1 BIT_MASK 0x1 FORMAT "%13.11" ECU_ADDRESS 0x3FBFF3 /end MEASUREMENT
/begin MEASUREMENT B_ekpd "Bedingung EKP Dauerbetrieb" UBYTE B_TRUE 1 100 0 1 BIT_MASK 0x8 FORMAT "%13.11" ECU_ADDRESS 0x5B8A8F /end MEASUREMENT
/begin MEASUREMENT B_ekpn "Bedingung EKP-Einschaltbedingung Drehzahl erf¸llt" UBYTE B_TRUE 1 100 0 1 BIT_MASK 0x10 FORMAT "%13.11" ECU_ADDRESS 0x5B8A8F /end MEASUREMENT
/begin MEASUREMENT B_ekpubn "Bedingung EKP-Einschaltbedingung UBatt-Einbruch und Zahnsignal erf¸llt" UBYTE B_TRUE 1 100 0 1 BIT_MASK 0x20 FORMAT "%13.11" ECU_ADDRESS 0x5B8A8F /end MEASUREMENT
/begin MEASUREMENT B_ekpvl "Bedingung EKP-Vorlauf" UBYTE B_TRUE 1 100 0 1 BIT_MASK 0x40 FORMAT "%13.11" ECU_ADDRESS 0x5B8A8F /end MEASUREMENT
/begin MEASUREMENT B_enabale "Bedingung: Freigabe zur Berechnung der Motorabstellposition" UBYTE B_TRUE 1 100 0 1 FORMAT "%13.11" ECU_ADDRESS 0x5B8BFC /end MEASUREMENT
/begin MEASUREMENT B_enabint "Bedingung Zahninterrupt f¸r ALE aktiviert" UBYTE B_TRUE 1 100 0 1 FORMAT "%13.11" ECU_ADDRESS 0x5B8BFD /end MEASUREMENT
/begin MEASUREMENT B_engstop "Bedingung Motor steht l‰nger als 100ms" UBYTE B_TRUE 1 100 0 1 BIT_MASK 0x4 FORMAT "%13.11" ECU_ADDRESS 0x5B8BFA /end MEASUREMENT
/begin MEASUREMENT B_ESrdy "" UBYTE B_TRUE 1 100 0 1 BIT_MASK 0x1 FORMAT "%13.11" ECU_ADDRESS 0x3FBC55 /end MEASUREMENT
/begin MEASUREMENT B_evabu "Bedingung Ev-Abschaltung durch ‹berwachungsfunktionen" UBYTE B_TRUE 1 100 0 1 BIT_MASK 0x1 FORMAT "%13.11" ECU_ADDRESS 0x3FBD32 /end MEASUREMENT
/begin MEASUREMENT B_evakt "Bedingung alle Einspritzventile aktiv/angesteuert" UBYTE B_TRUE 1 100 0 1 BIT_MASK 0x1 FORMAT "%13.11" ECU_ADDRESS 0x3FBD44 /end MEASUREMENT
/begin MEASUREMENT B_evasel "Status alle f¸r DASE relevant. lokalen Einspritzventile d. SG werden angesteuert" UBYTE B_TRUE 1 100 0 1 BIT_MASK 0x1 FORMAT "%13.11" ECU_ADDRESS 0x3FBD34 /end MEASUREMENT
/begin MEASUREMENT B_evloc "Status: alle lokalen Einspritzventile werden angesteuert, = B_EVTOT bei einem SG" UBYTE B_TRUE 1 100 0 1 BIT_MASK 0x1 FORMAT "%13.11" ECU_ADDRESS 0x3FBD45 /end MEASUREMENT
/begin MEASUREMENT B_fbkvpa "Bedingung: Freigabe BKV-Pumpe ansteuern" UBYTE B_TRUE 1 100 0 1 BIT_MASK 0x1 FORMAT "%13.11" ECU_ADDRESS 0x3FBFF2 /end MEASUREMENT
/begin MEASUREMENT B_fbm "Bedingung Bezugsmarkenfehler => mindestens 1 Zahn zuviel oder zuwenig erkannt" UBYTE B_TRUE 1 100 0 1 BIT_MASK 0x1 FORMAT "%13.11" ECU_ADDRESS 0x3FBE32 /end MEASUREMENT
/begin MEASUREMENT B_fgdcan "Bedingung CAN Diagnosen freigegeben" UBYTE B_TRUE 1 100 0 1 BIT_MASK 0x1 FORMAT "%13.11" ECU_ADDRESS 0x3FBC12 /end MEASUREMENT
/begin MEASUREMENT B_fgrab "FGR-/ACC-Abschaltung aus der Funktion" UBYTE B_TRUE 1 100 0 1 BIT_MASK 0x1 FORMAT "%13.11" ECU_ADDRESS 0x3FBD10 /end MEASUREMENT
/begin MEASUREMENT B_fgraext "Bedingung: FGR-Abschaltung durch externe Anforderung ASC/DSC" UBYTE B_TRUE 1 100 0 1 BIT_MASK 0x8 FORMAT "%13.11" ECU_ADDRESS 0x5B8E79 /end MEASUREMENT
/begin MEASUREMENT B_fgrai "Bedingung FGR-Abschaltung irreversibel" UBYTE B_TRUE 1 100 0 1 BIT_MASK 0x1 FORMAT "%13.11" ECU_ADDRESS 0x3FBD11 /end MEASUREMENT
/begin MEASUREMENT B_fgral "Bedingung FGR-Abschaltung langsam" UBYTE B_TRUE 1 100 0 1 BIT_MASK 0x1 FORMAT "%13.11" ECU_ADDRESS 0x3FBD12 /end MEASUREMENT
/begin MEASUREMENT B_fgrars "Bedingung: FGR-Abschaltung reversibel schnell" UBYTE B_TRUE 1 100 0 1 BIT_MASK 0x2 FORMAT "%13.11" ECU_ADDRESS 0x5B8E79 /end MEASUREMENT
/begin MEASUREMENT B_fgras "Bedingung: FGR-Abschaltung schnell" UBYTE B_TRUE 1 100 0 1 BIT_MASK 0x1 FORMAT "%13.11" ECU_ADDRESS 0x3FBD13 /end MEASUREMENT
/begin MEASUREMENT B_fgrenv "Bedingung FGR-Regelung aktiv (Enable) vorl‰ufig" UBYTE B_TRUE 1 100 0 1 BIT_MASK 0x1 FORMAT "%13.11" ECU_ADDRESS 0x3FBD14 /end MEASUREMENT
/begin MEASUREMENT B_fgres "Bedingung FGR-Einschaltung" UBYTE B_TRUE 1 100 0 1 BIT_MASK 0x4 FORMAT "%13.11" ECU_ADDRESS 0x5B8E79 /end MEASUREMENT
/begin MEASUREMENT B_fgresv "Bedingung FGR-Einschaltgeschwindigkeit erreicht" UBYTE B_TRUE 1 100 0 1 BIT_MASK 0x1 FORMAT "%13.11" ECU_ADDRESS 0x3FBD15 /end MEASUREMENT
/begin MEASUREMENT B_fophsnl "Evabschaltung ¸ber feste Abschaltmuster ohne Notlauf Phasensuche" UBYTE B_TRUE 1 100 0 1 BIT_MASK 0x1 FORMAT "%13.11" ECU_ADDRESS 0x3FBD2D /end MEASUREMENT
/begin MEASUREMENT B_fprakt "DK-R¸ckstellfeder-Pr¸fung aktiv" UBYTE B_TRUE 1 100 0 1 BIT_MASK 0x1 FORMAT "%13.11" ECU_ADDRESS 0x3FBC56 /end MEASUREMENT
/begin MEASUREMENT B_fproab "Bedingung: DV-E-Pr¸fung ˆffnende Feder Abbruch, Feder ˆffnet nicht" UBYTE B_TRUE 1 100 0 1 BIT_MASK 0x1 FORMAT "%13.11" ECU_ADDRESS 0x3FBC57 /end MEASUREMENT
/begin MEASUREMENT B_fproe "Bedingung: ÷ffnende Federpr¸fung Fehler" UBYTE B_TRUE 1 100 0 1 BIT_MASK 0x1 FORMAT "%13.11" ECU_ADDRESS 0x3FBC58 /end MEASUREMENT
/begin MEASUREMENT B_fprook "Bedingung: ˆffnende Federpr¸fung i.O." UBYTE B_TRUE 1 100 0 1 BIT_MASK 0x1 FORMAT "%13.11" ECU_ADDRESS 0x3FBC59 /end MEASUREMENT
/begin MEASUREMENT B_fprordy "Bedingung: ÷ffnende Federpr¸fung fertig" UBYTE B_TRUE 1 100 0 1 BIT_MASK 0x1 FORMAT "%13.11" ECU_ADDRESS 0x3FBC5A /end MEASUREMENT
/begin MEASUREMENT B_fprovb "Bedingung: ÷ffnende Federpr¸fung verboten" UBYTE B_TRUE 1 100 0 1 BIT_MASK 0x1 FORMAT "%13.11" ECU_ADDRESS 0x3FBC5B /end MEASUREMENT
/begin MEASUREMENT B_fprrdy "DK-R¸ckstellfeder-Pr¸fung beendet" UBYTE B_TRUE 1 100 0 1 BIT_MASK 0x1 FORMAT "%13.11" ECU_ADDRESS 0x3FBC5C /end MEASUREMENT
/begin MEASUREMENT B_fprzab "Bedingung: DV-E-R¸ckstellfederpr¸fung Abbruch, Feder schlieﬂt nicht" UBYTE B_TRUE 1 100 0 1 BIT_MASK 0x1 FORMAT "%13.11" ECU_ADDRESS 0x3FBC5D /end MEASUREMENT
/begin MEASUREMENT B_fprze "Bedingung: Fehler in der DV-E-R¸ckstellfederpr¸fung" UBYTE B_TRUE 1 100 0 1 BIT_MASK 0x1 FORMAT "%13.11" ECU_ADDRESS 0x3FBC5E /end MEASUREMENT
/begin MEASUREMENT B_fprzok "Bedingung: DV-E-R¸ckstellfederpr¸fung i.O." UBYTE B_TRUE 1 100 0 1 BIT_MASK 0x1 FORMAT "%13.11" ECU_ADDRESS 0x3FBC5F /end MEASUREMENT
/begin MEASUREMENT B_fprzvb "Bedingung: DV-E-R¸ckstellfederpr¸fung verboten" UBYTE B_TRUE 1 100 0 1 BIT_MASK 0x1 FORMAT "%13.11" ECU_ADDRESS 0x3FBC60 /end MEASUREMENT
/begin MEASUREMENT B_fraoan "Anforderung TEV schnell schlieﬂen zur Aktivierung der Gemischadaption" UBYTE B_TRUE 1 100 0 1 BIT_MASK 0x1 FORMAT "%13.11" ECU_ADDRESS 0x3FBD35 /end MEASUREMENT
/begin MEASUREMENT B_frdph "Bed. Transition 'to_Fixred' aktiviert durch Notlauf-Phasensuche" UBYTE B_TRUE 1 100 0 1 BIT_MASK 0x1 FORMAT "%13.11" ECU_ADDRESS 0x3FBD2E /end MEASUREMENT
/begin MEASUREMENT B_gap "Bedingung Gemischadaptionsphase aktiv" UBYTE B_TRUE 1 100 0 1 BIT_MASK 0x1 FORMAT "%13.11" ECU_ADDRESS 0x3FBD36 /end MEASUREMENT
/begin MEASUREMENT B_gfen "Bedingung Gangfenster" UBYTE B_TRUE 1 100 0 1 BIT_MASK 0x1 FORMAT "%13.11" ECU_ADDRESS 0x3FBF0E /end MEASUREMENT
/begin MEASUREMENT B_gwhs "Bedingung Gangwechsel bei Handschalter" UBYTE B_TRUE 1 100 0 1 BIT_MASK 0x1 FORMAT "%13.11" ECU_ADDRESS 0x3FBD01 /end MEASUREMENT
/begin MEASUREMENT B_hpnmot "Bedingung Hochpunkt Drehzahlschwingung" UBYTE B_TRUE 1 100 0 1 BIT_MASK 0x1 FORMAT "%13.11" ECU_ADDRESS 0x3FBF0F /end MEASUREMENT
/begin MEASUREMENT B_hr "Bedingung Hauptrelais ein" UBYTE B_TRUE 1 100 0 1 BIT_MASK 0x1 FORMAT "%13.11" ECU_ADDRESS 0x3FDCB7 /end MEASUREMENT
/begin MEASUREMENT B_hwpwf "" UBYTE B_TRUE 1 100 0 1 BIT_MASK 0x1 FORMAT "%13.11" ECU_ADDRESS 0x5B8B72 /end MEASUREMENT
/begin MEASUREMENT B_imlprini "Initialisierung imlpr/imlpr_w" UWORD B_TRUE 1 100 0 1 BIT_MASK 0x200 FORMAT "%13.11" ECU_ADDRESS 0x5B8832 /end MEASUREMENT
/begin MEASUREMENT B_iniar "Bedingung Initialisierung der AR-Funktion" UBYTE B_TRUE 1 100 0 1 BIT_MASK 0x1 FORMAT "%13.11" ECU_ADDRESS 0x3FBF10 /end MEASUREMENT
/begin MEASUREMENT B_iniar1 "Bedingung Initialisierung ARMD vorl‰ufig" UBYTE B_TRUE 1 100 0 1 BIT_MASK 0x1 FORMAT "%13.11" ECU_ADDRESS 0x3FBF11 /end MEASUREMENT
/begin MEASUREMENT B_iniarv "Bedingung Initialisierung der Filterfunktion verzˆgert" UBYTE B_TRUE 1 100 0 1 BIT_MASK 0x1 FORMAT "%13.11" ECU_ADDRESS 0x3FBF12 /end MEASUREMENT
/begin MEASUREMENT B_kd "Bedingung Kick-Down" UBYTE B_TRUE 1 100 0 1 BIT_MASK 0x1 FORMAT "%13.11" ECU_ADDRESS 0x3FBD02 /end MEASUREMENT
/begin MEASUREMENT B_kh "Bedingung Kat-Heizung" UBYTE B_TRUE 1 100 0 1 BIT_MASK 0x1 FORMAT "%13.11" ECU_ADDRESS 0x3FBE35 /end MEASUREMENT
/begin MEASUREMENT B_kha "Anforderung Katheizen" UBYTE B_TRUE 1 100 0 1 BIT_MASK 0x1 FORMAT "%13.11" ECU_ADDRESS 0x3FBE36 /end MEASUREMENT
/begin MEASUREMENT B_khab "Bedingung Katheizen Abbruch" UBYTE B_TRUE 1 100 0 1 BIT_MASK 0x1 FORMAT "%13.11" ECU_ADDRESS 0x3FBE37 /end MEASUREMENT
/begin MEASUREMENT B_khares "Bedingung R¸cksetzen von Bit B_kha" UWORD B_TRUE 1 100 0 1 BIT_MASK 0x40 FORMAT "%13.11" ECU_ADDRESS 0x5B8832 /end MEASUREMENT
/begin MEASUREMENT B_khaset "Bedingung Setzen von Bit B_kha" UWORD B_TRUE 1 100 0 1 BIT_MASK 0x20 FORMAT "%13.11" ECU_ADDRESS 0x5B8832 /end MEASUREMENT
/begin MEASUREMENT B_kherr "Fehler bedingte Sperrbedingung f¸r Bit B_kh" UWORD B_TRUE 1 100 0 1 BIT_MASK 0x100 FORMAT "%13.11" ECU_ADDRESS 0x5B8832 /end MEASUREMENT
/begin MEASUREMENT B_khll "Bedingung Katheizen Leerlauf (Abbruchbedingung)" UWORD B_TRUE 1 100 0 1 BIT_MASK 0x4 FORMAT "%13.11" ECU_ADDRESS 0x5B8832 /end MEASUREMENT
/begin MEASUREMENT B_khlle "Bedingung Leerlauf w‰hrend Katheizen verlassen" UWORD B_TRUE 1 100 0 1 BIT_MASK 0x1 FORMAT "%13.11" ECU_ADDRESS 0x5B8832 /end MEASUREMENT
/begin MEASUREMENT B_khllmx "Bedingung max. Katheitzeit im Leerlauf erreicht" UWORD B_TRUE 1 100 0 1 BIT_MASK 0x2 FORMAT "%13.11" ECU_ADDRESS 0x5B8832 /end MEASUREMENT
/begin MEASUREMENT B_khn "Bedingung Katheiz-Drehzahl" UBYTE B_TRUE 1 100 0 1 BIT_MASK 0x1 FORMAT "%13.11" ECU_ADDRESS 0x3FBE38 /end MEASUREMENT
/begin MEASUREMENT B_khno "" UBYTE B_TRUE 1 100 0 1 BIT_MASK 0x1 FORMAT "%13.11" ECU_ADDRESS 0x3FBE39 /end MEASUREMENT
/begin MEASUREMENT B_khres "Bedingung R¸cksetzen von Bit B_kh" UWORD B_TRUE 1 100 0 1 BIT_MASK 0x10 FORMAT "%13.11" ECU_ADDRESS 0x5B8832 /end MEASUREMENT
/begin MEASUREMENT B_khset "Bedingung Setzen von Bit B_kh" UWORD B_TRUE 1 100 0 1 BIT_MASK 0x8 FORMAT "%13.11" ECU_ADDRESS 0x5B8832 /end MEASUREMENT
/begin MEASUREMENT B_khstc "von Temperaturen oder Abstellzeit abh‰ngige Freigabe Kat-Heizen" UWORD B_TRUE 1 100 0 1 BIT_MASK 0x400 FORMAT "%13.11" ECU_ADDRESS 0x5B8832 /end MEASUREMENT
/begin MEASUREMENT B_kl15 "Bedingung Klemme 15" UBYTE B_TRUE 1 100 0 1 BIT_MASK 0x1 FORMAT "%13.11" ECU_ADDRESS 0x5B8B76 /end MEASUREMENT
/begin MEASUREMENT B_kupgw "Bedingung Kupplung bet‰tigt bis erkannter Gangwechsel" UBYTE B_TRUE 1 100 0 1 BIT_MASK 0x1 FORMAT "%13.11" ECU_ADDRESS 0x3FBF13 /end MEASUREMENT
/begin MEASUREMENT B_kupplar "Bedingung Kupplung bet‰tigt (Kupplungsschalter oder aus Modell)" UBYTE B_TRUE 1 100 0 1 BIT_MASK 0x1 FORMAT "%13.11" ECU_ADDRESS 0x3FBF14 /end MEASUREMENT
/begin MEASUREMENT B_kw "Bedingung Kat warmhalten" UBYTE B_TRUE 1 100 0 1 BIT_MASK 0x1 FORMAT "%13.11" ECU_ADDRESS 0x3FBE3A /end MEASUREMENT
/begin MEASUREMENT B_lrnakt "Lernaktiv Bit" UBYTE B_TRUE 1 100 0 1 BIT_MASK 0x1 FORMAT "%13.11" ECU_ADDRESS 0x3FBC61 /end MEASUREMENT
/begin MEASUREMENT B_lrnerf "Lernerfolg Bit" UBYTE B_TRUE 1 100 0 1 BIT_MASK 0x2 FORMAT "%13.11" ECU_ADDRESS 0x3FE942 /end MEASUREMENT
/begin MEASUREMENT B_lrnfg "Lernfreigabe Bit" UBYTE B_TRUE 1 100 0 1 BIT_MASK 0x1 FORMAT "%13.11" ECU_ADDRESS 0x3FBC62 /end MEASUREMENT
/begin MEASUREMENT B_lrnrdy "Lernen ist beendet" UBYTE B_TRUE 1 100 0 1 BIT_MASK 0x1 FORMAT "%13.11" ECU_ADDRESS 0x3FBC63 /end MEASUREMENT
/begin MEASUREMENT B_lrntesa "Bedingung: UMA-Lernen u. Verst.abgl wegen Tester-Anford. aktiviert" UBYTE B_TRUE 1 100 0 1 BIT_MASK 0x1 FORMAT "%13.11" ECU_ADDRESS 0x3FBC64 /end MEASUREMENT
/begin MEASUREMENT B_lrnvb "Lernverbot Bit" UBYTE B_TRUE 1 100 0 1 BIT_MASK 0x1 FORMAT "%13.11" ECU_ADDRESS 0x3FBC65 /end MEASUREMENT
/begin MEASUREMENT B_lrnws "Lernwertspeicherung Bit" UBYTE B_TRUE 1 100 0 1 BIT_MASK 0x1 FORMAT "%13.11" ECU_ADDRESS 0x3FE942 /end MEASUREMENT
/begin MEASUREMENT B_mflai "Bedingung FGR-ACC-Abschaltung irrev." UBYTE B_TRUE 1 100 0 1 FORMAT "%13.11" ECU_ADDRESS 0x5B8B41 /end MEASUREMENT
/begin MEASUREMENT B_mflal "Bedingung FGR-ACC-Abschaltung langsam" UBYTE B_TRUE 1 100 0 1 FORMAT "%13.11" ECU_ADDRESS 0x5B8B42 /end MEASUREMENT
/begin MEASUREMENT B_mflar "Bedingung FGR-Abschaltung rev." UBYTE B_TRUE 1 100 0 1 FORMAT "%13.11" ECU_ADDRESS 0x5B8B43 /end MEASUREMENT
/begin MEASUREMENT B_mflas "Bedingung FGR-ACC-Abschaltung schnell" UBYTE B_TRUE 1 100 0 1 FORMAT "%13.11" ECU_ADDRESS 0x5B8B44 /end MEASUREMENT
/begin MEASUREMENT B_mflen "Bedingung FGR-ACC-Regelung aktiv" UBYTE B_TRUE 1 100 0 1 FORMAT "%13.11" ECU_ADDRESS 0x5B8B45 /end MEASUREMENT
/begin MEASUREMENT B_mlsu "Bedingung mslu nicht grˆﬂer 0" UWORD B_TRUE 1 100 0 1 BIT_MASK 0x80 FORMAT "%13.11" ECU_ADDRESS 0x5B8832 /end MEASUREMENT
/begin MEASUREMENT B_nachlauf "Steuerung SG-Nachlauf" UBYTE B_TRUE 1 100 0 1 BIT_MASK 0x1 FORMAT "%13.11" ECU_ADDRESS 0x5B8B77 /end MEASUREMENT
/begin MEASUREMENT B_nftev "Bedingung Drehzahlanhebung f¸r erhˆhte TE-Sp¸lrate" UBYTE B_TRUE 1 100 0 1 BIT_MASK 0x1 FORMAT "%13.11" ECU_ADDRESS 0x3FBD37 /end MEASUREMENT
/begin MEASUREMENT B_nloff "Bedingung: Schalter SG aus" UBYTE B_TRUE 1 100 0 1 BIT_MASK 0x1 FORMAT "%13.11" ECU_ADDRESS 0x5B8B78 /end MEASUREMENT
/begin MEASUREMENT B_nlpe "Bedingung: Fehler in NLP-Pr¸fung u. -Lernen" UBYTE B_TRUE 1 100 0 1 BIT_MASK 0x1 FORMAT "%13.11" ECU_ADDRESS 0x3FBC66 /end MEASUREMENT
/begin MEASUREMENT B_nlperf "Dauer-RAM, Bedingung: NLP-Erfassung erfolgreich" UBYTE B_TRUE 1 100 0 1 BIT_MASK 0x4 FORMAT "%13.11" ECU_ADDRESS 0x3FE942 /end MEASUREMENT
/begin MEASUREMENT B_nlphea "Ev-Abschaltung f¸r Notlauf Phasensynchronisation aktiv" UBYTE B_TRUE 1 100 0 1 BIT_MASK 0x1 FORMAT "%13.11" ECU_ADDRESS 0x3FBD2F /end MEASUREMENT
/begin MEASUREMENT B_nlpheai "Ev-Abschaltung f¸r Notlauf Phasensynchronisation aktiv AEVAB intern" UBYTE B_TRUE 1 100 0 1 BIT_MASK 0x1 FORMAT "%13.11" ECU_ADDRESS 0x3FBD30 /end MEASUREMENT
/begin MEASUREMENT B_nlpnew "Bedingung: NLP-Position ist noch nicht bekannt" UBYTE B_TRUE 1 100 0 1 BIT_MASK 0x1 FORMAT "%13.11" ECU_ADDRESS 0x3FBC67 /end MEASUREMENT
/begin MEASUREMENT B_nlpreq "Bedingung: NLP-Lernen anfordern" UBYTE B_TRUE 1 100 0 1 BIT_MASK 0x1 FORMAT "%13.11" ECU_ADDRESS 0x3FBC68 /end MEASUREMENT
/begin MEASUREMENT B_nocampos "Position der Nockenwelle konnte nicht ermittelt werden" UBYTE B_TRUE 1 100 0 1 BIT_MASK 0x1 FORMAT "%13.11" ECU_ADDRESS 0x3FBE33 /end MEASUREMENT
/begin MEASUREMENT B_norm "SG-Bedingung normaler Motorsteuerungsbetrieb" UBYTE B_TRUE 1 100 0 1 BIT_MASK 0x1 FORMAT "%13.11" ECU_ADDRESS 0x5B8B79 /end MEASUREMENT
/begin MEASUREMENT B_outofsyn "Nockenwellenposition ausserhalb des zul‰ssigen Synchronisationsbereichs" UBYTE B_TRUE 1 100 0 1 BIT_MASK 0x1 FORMAT "%13.11" ECU_ADDRESS 0x3FBE34 /end MEASUREMENT
/begin MEASUREMENT B_pvl1 "Bedingung Pumpenvorlauf bei Systemen mit Uhr" UBYTE B_TRUE 1 100 0 1 BIT_MASK 0x1 FORMAT "%13.11" ECU_ADDRESS 0x5B8A8F /end MEASUREMENT
/begin MEASUREMENT B_pvl2 "Bedingung Pumpenvorlauf bei Systemen ohne Uhr" UBYTE B_TRUE 1 100 0 1 BIT_MASK 0x2 FORMAT "%13.11" ECU_ADDRESS 0x5B8A8F /end MEASUREMENT
/begin MEASUREMENT B_pvlnl "Bedingung EKP-Vorlauf aus Nachlaufzeit¸berschreitung" UBYTE B_TRUE 1 100 0 1 BIT_MASK 0x1 FORMAT "%13.11" ECU_ADDRESS 0x3FDD04 /end MEASUREMENT
/begin MEASUREMENT B_pwf "Bedingung Powerfail" UBYTE B_TRUE 1 100 0 1 BIT_MASK 0x1 FORMAT "%13.11" ECU_ADDRESS 0x3FBFBE /end MEASUREMENT
/begin MEASUREMENT B_pwfPat "Bedingung Neuinitialisierung NVRAM angefordert durch SW" UBYTE B_TRUE 1 100 0 1 BIT_MASK 0x1 FORMAT "%13.11" ECU_ADDRESS 0x5B8B73 /end MEASUREMENT
/begin MEASUREMENT B_ralectr "Bedingung letzte Zahnzeit > TRD" UBYTE B_TRUE 1 100 0 1 FORMAT "%13.11" ECU_ADDRESS 0x5B8BFE /end MEASUREMENT
/begin MEASUREMENT B_raleok "Bedingung letzter Zahn liegt im plausiblen R¸ckdrehbereich" UBYTE B_TRUE 1 100 0 1 FORMAT "%13.11" ECU_ADDRESS 0x5B8BFF /end MEASUREMENT
/begin MEASUREMENT B_restore "" UBYTE B_TRUE 1 100 0 1 BIT_MASK 0x1 FORMAT "%13.11" ECU_ADDRESS 0x5B8B74 /end MEASUREMENT
/begin MEASUREMENT B_restoreok "" UBYTE B_TRUE 1 100 0 1 BIT_MASK 0x1 FORMAT "%13.11" ECU_ADDRESS 0x5B8B75 /end MEASUREMENT
/begin MEASUREMENT B_rrdet "Bedingung R¸ckdrehen erkannt" UBYTE B_TRUE 1 100 0 1 BIT_MASK 0x8 FORMAT "%13.11" ECU_ADDRESS 0x5B8BFB /end MEASUREMENT
/begin MEASUREMENT B_sab "Bedingung Schubabschaltebereitschaft" UBYTE B_TRUE 1 100 0 1 BIT_MASK 0x1 FORMAT "%13.11" ECU_ADDRESS 0x3FBEEF /end MEASUREMENT
/begin MEASUREMENT B_sabt "Bedingung Schubabschaltebereitschaft" UBYTE B_TRUE 1 100 0 1 BIT_MASK 0x2 FORMAT "%13.11" ECU_ADDRESS 0x5B8F80 /end MEASUREMENT
/begin MEASUREMENT B_skaevab "Bedingung Ev-Abschaltung durch Sicherheitskraftstoffabschaltung aktiv" UBYTE B_TRUE 1 100 0 1 BIT_MASK 0x1 FORMAT "%13.11" ECU_ADDRESS 0x3FBD33 /end MEASUREMENT
/begin MEASUREMENT B_st "Bedingung Start" UBYTE B_TRUE 1 100 0 1 BIT_MASK 0x1 FORMAT "%13.11" ECU_ADDRESS 0x3FBD03 /end MEASUREMENT
/begin MEASUREMENT B_stend "Bedingung Startende erreicht" UBYTE B_TRUE 1 100 0 1 BIT_MASK 0x1 FORMAT "%13.11" ECU_ADDRESS 0x3FBD04 /end MEASUREMENT
/begin MEASUREMENT B_stndnl "Bedingung Beginn SG-Nachlauf oder Startende (1->0)" UBYTE B_TRUE 1 100 0 1 BIT_MASK 0x1 FORMAT "%13.11" ECU_ADDRESS 0x5B8638 /end MEASUREMENT
/begin MEASUREMENT B_strtint "Bedingung Start Zahninterrupt (Initialisierung)" SBYTE B_TRUE 1 100 0 1 FORMAT "%13.11" ECU_ADDRESS 0x5B8C00 /end MEASUREMENT
/begin MEASUREMENT B_strtswof "Bedingung Nachlaufphase beginnt" UBYTE B_TRUE 1 100 0 1 FORMAT "%13.11" ECU_ADDRESS 0x5B8C01 /end MEASUREMENT
/begin MEASUREMENT B_tedtev "Bedingung Tankentl¸ftung zum Sp¸len vor TEV-Diagnose" UBYTE B_TRUE 1 100 0 1 BIT_MASK 0x1 FORMAT "%13.11" ECU_ADDRESS 0x3FBD38 /end MEASUREMENT
/begin MEASUREMENT B_tehbxf "Bedingung Beladungsintegrator ftead am Maximalanschlag, gefiltert" UBYTE B_TRUE 1 100 0 1 BIT_MASK 0x1 FORMAT "%13.11" ECU_ADDRESS 0x3FBD39 /end MEASUREMENT
/begin MEASUREMENT B_tep "Bedingung Tankentl¸ftungsphase" UBYTE B_TRUE 1 100 0 1 BIT_MASK 0x1 FORMAT "%13.11" ECU_ADDRESS 0x3FBD3A /end MEASUREMENT
/begin MEASUREMENT B_tepi "Bedingung TE-Phase intern aktiv" UBYTE B_TRUE 1 100 0 1 BIT_MASK 0x1 FORMAT "%13.11" ECU_ADDRESS 0x3FBD3B /end MEASUREMENT
/begin MEASUREMENT B_tepzhl "Bedingung Tankentl¸ftungphase zus‰tzlich wegen Dauerhochlast" UBYTE B_TRUE 1 100 0 1 BIT_MASK 0x1 FORMAT "%13.11" ECU_ADDRESS 0x3FBD3C /end MEASUREMENT
/begin MEASUREMENT B_tepzus "Bedingung zus‰tzliche Tankentl¸ftungsphase" UBYTE B_TRUE 1 100 0 1 BIT_MASK 0x1 FORMAT "%13.11" ECU_ADDRESS 0x3FBD3D /end MEASUREMENT
/begin MEASUREMENT B_tesstp "Bedingung Tankentl¸ftung schnell stoppen" UBYTE B_TRUE 1 100 0 1 BIT_MASK 0x1 FORMAT "%13.11" ECU_ADDRESS 0x3FBD3E /end MEASUREMENT
/begin MEASUREMENT B_testop "Bedingung Tankentl¸ftung stoppen" UBYTE B_TRUE 1 100 0 1 BIT_MASK 0x1 FORMAT "%13.11" ECU_ADDRESS 0x3FBD3F /end MEASUREMENT
/begin MEASUREMENT B_tevtstp "Bedingung Stop f¸r TEV Timer" UBYTE B_TRUE 1 100 0 1 BIT_MASK 0x1 FORMAT "%13.11" ECU_ADDRESS 0x3FBFC3 /end MEASUREMENT
/begin MEASUREMENT B_tezstp "Bedingung Tankentl¸ftung zwang stoppen" UBYTE B_TRUE 1 100 0 1 BIT_MASK 0x1 FORMAT "%13.11" ECU_ADDRESS 0x3FBD40 /end MEASUREMENT
/begin MEASUREMENT B_tpnmot "Bedingung Tiefpunkt Drehzahlschwingung" UBYTE B_TRUE 1 100 0 1 BIT_MASK 0x1 FORMAT "%13.11" ECU_ADDRESS 0x3FBF15 /end MEASUREMENT
/begin MEASUREMENT B_tpvl "Bedingung Pumpenvorlauf der L‰nge TPVL Sekunden" UBYTE B_TRUE 1 100 0 1 BIT_MASK 0x4 FORMAT "%13.11" ECU_ADDRESS 0x5B8A8F /end MEASUREMENT
/begin MEASUREMENT B_trkh "Bedingung Katheizen, Thermoreaktor wirksam" UBYTE B_TRUE 1 100 0 1 BIT_MASK 0x1 FORMAT "%13.11" ECU_ADDRESS 0x3FBE3B /end MEASUREMENT
/begin MEASUREMENT B_tteae "Bedingung Umschaltung auf lange TE-Phase" UBYTE B_TRUE 1 100 0 1 BIT_MASK 0x1 FORMAT "%13.11" ECU_ADDRESS 0x3FBD41 /end MEASUREMENT
/begin MEASUREMENT B_ttegais "Bedingung erste GA-Phase ist kurz" UBYTE B_TRUE 1 100 0 1 BIT_MASK 0x1 FORMAT "%13.11" ECU_ADDRESS 0x3FBD42 /end MEASUREMENT
/begin MEASUREMENT B_umae "Bedingung: Fehler beim UMA-Lernen" UBYTE B_TRUE 1 100 0 1 BIT_MASK 0x1 FORMAT "%13.11" ECU_ADDRESS 0x3FBC69 /end MEASUREMENT
/begin MEASUREMENT B_umauab "Bedingung: UMA-Lernen w‰hrend Urinitialisierung abgebrochen (SKA)" UBYTE B_TRUE 1 100 0 1 BIT_MASK 0x1 FORMAT "%13.11" ECU_ADDRESS 0x3FBC6A /end MEASUREMENT
/begin MEASUREMENT B_undef "Bedingung R¸ckdreherkennung im undef. Bereich (Zwischenspeicher)" UBYTE B_TRUE 1 100 0 1 FORMAT "%13.11" ECU_ADDRESS 0x5B8C02 /end MEASUREMENT
/begin MEASUREMENT B_utzms "Bedingung Umschaltung Zeitgrenze ZMS-Resonanz" UBYTE B_TRUE 1 100 0 1 BIT_MASK 0x1 FORMAT "%13.11" ECU_ADDRESS 0x3FBD05 /end MEASUREMENT
/begin MEASUREMENT B_vl "Bedingung Vollast" UBYTE dez 1 100 0 255 FORMAT "%5.1" ECU_ADDRESS 0x5B8B67 /end MEASUREMENT
/begin MEASUREMENT B_vlb "Vollastbereitschaft vom Fahrerwunsch" UBYTE dez 1 100 0 255 FORMAT "%5.1" ECU_ADDRESS 0x5B8B68 /end MEASUREMENT
/begin MEASUREMENT B_vlmi "Vollasterkennung ¸ber Momentenanforderung" UBYTE dez 1 100 0 255 FORMAT "%5.1" ECU_ADDRESS 0x5B8B69 /end MEASUREMENT
/begin MEASUREMENT B_wakeup "SG-Bedingung: wake up Betrieb" UBYTE B_TRUE 1 100 0 1 BIT_MASK 0x1 FORMAT "%13.11" ECU_ADDRESS 0x5B8B7A /end MEASUREMENT
/begin MEASUREMENT B_wdapwf "Bedingung Neuinitialisierung NVRAM angefordert nach WDA-Abschaltung" UBYTE B_TRUE 1 100 0 1 BIT_MASK 0x1 FORMAT "%13.11" ECU_ADDRESS 0x3FE950 /end MEASUREMENT
/begin MEASUREMENT B_zms "Bedingung Motordrehzahl im ZMS-Resonanzbereich" UBYTE B_TRUE 1 100 0 1 BIT_MASK 0x1 FORMAT "%13.11" ECU_ADDRESS 0x3FBD06 /end MEASUREMENT
/begin MEASUREMENT B_zmse "Bedingung Motordrehzahl sicher auﬂerhalb der ZMS-Resonanz" UBYTE B_TRUE 1 100 0 1 BIT_MASK 0x1 FORMAT "%13.11" ECU_ADDRESS 0x3FBD07 /end MEASUREMENT
/begin MEASUREMENT B_zmsoff "Bedingung Motorabstellen wegen ZMS-Resonanz" UBYTE B_TRUE 1 100 0 1 BIT_MASK 0x1 FORMAT "%13.11" ECU_ADDRESS 0x3FBD08 /end MEASUREMENT
/begin MEASUREMENT CALIBID1 "Calibration ID 1 zur SG Identifikation f¸r Mode $09" UBYTE dez 1 100 0 255 FORMAT "%5.1" ARRAY_SIZE 12 ECU_ADDRESS 0x5B8888 /end MEASUREMENT
/begin MEASUREMENT CALIBID2 "Calibration ID 2 zur SG Identifikation f¸r Mode $09" UBYTE dez 1 100 0 255 FORMAT "%5.1" ARRAY_SIZE 12 ECU_ADDRESS 0x5B8894 /end MEASUREMENT
/begin MEASUREMENT CO_GAP "Winkel zur L¸ckenkorrekturerkennung" UWORD kw_q0p1 1 100 0 1440 FORMAT "%8.3" ECU_ADDRESS 0x5B9556 /end MEASUREMENT
/begin MEASUREMENT CO_WAS "Winkel zur L¸ckenerkennung" UWORD kw_q0p1 1 100 0 720 FORMAT "%8.4" ECU_ADDRESS 0x5B9558 /end MEASUREMENT
/begin MEASUREMENT CO_WNBM "Winkel pro Zahn" UBYTE kw_q0p1 1 100 0 25.5 FORMAT "%5.2" ECU_ADDRESS 0x5B8C03 /end MEASUREMENT
/begin MEASUREMENT cvn "auszugebende Checksumme (CVN) entsprechend SAE J1979 Mode $09" UBYTE dez 1 100 0 255 FORMAT "%5.1" ARRAY_SIZE 4 ECU_ADDRESS 0x5B88A0 /end MEASUREMENT
/begin MEASUREMENT cvn2 "zweite auszugebende Checksumme (CVN) entsprechend SAE J1979 Mode $09" UBYTE dez 1 100 0 255 FORMAT "%5.1" ARRAY_SIZE 4 ECU_ADDRESS 0x5B88A4 /end MEASUREMENT
/begin MEASUREMENT dekpub "Differenz der Batteriespannung zwischen zwei Messungen bis EKP-Dauerbetrieb" UBYTE spg_ubatt 1 100 0 24.021 FORMAT "%5.2" ECU_ADDRESS 0x5B902E /end MEASUREMENT
/begin MEASUREMENT dkpstg_w "Steigung DK-Poti (% DK / V)" UWORD rel_uw_b40 1 100 0 39.9994 FORMAT "%8.5" ECU_ADDRESS 0x5B907A /end MEASUREMENT
/begin MEASUREMENT dlrmxt "timer f¸r DLR im UMA in der Begrenzung" UBYTE t50msxs_q0p05 1 100 0 12.75 FORMAT "%5.2" ECU_ADDRESS 0x5B8E30 /end MEASUREMENT
/begin MEASUREMENT dmar_w "Delta Drehmoment antiruckel" SWORD rel_sw_b100 1 100 -100 99.9969 FORMAT "%8.4" ECU_ADDRESS 0x5B9352 /end MEASUREMENT
/begin MEASUREMENT dmdevab "Ev-Abschaltmuster der Aussetzererkennung das auf dem aktuellen SG umgesetzt wird" UBYTE dez 1 100 0 255 FORMAT "%5.1" ECU_ADDRESS 0x5B8E84 /end MEASUREMENT
/begin MEASUREMENT dmrfabn_w "Aktuelle gewichtete Leistung um Schwelle MRFABNTE verschoben" SWORD rel_sw_b100 1 100 -100 99.9969 FORMAT "%8.4" ECU_ADDRESS 0x5B8712 /end MEASUREMENT
/begin MEASUREMENT dnsa "Zeitabh‰ngige Schubhysterese" UBYTE nmot_ub_q40 1 100 0 10200 FORMAT "%5.0" ECU_ADDRESS 0x5B8F81 /end MEASUREMENT
/begin MEASUREMENT dveadchst "DV-E-Adaption: Status Pr¸fbedingungen" UBYTE dez 1 100 0 255 FORMAT "%5.1" ECU_ADDRESS 0x5B8E31 /end MEASUREMENT
/begin MEASUREMENT eeeExitStatus "" UBYTE dez 1 100 0 255 FORMAT "%5.1" ECU_ADDRESS 0x3FDCB6 /end MEASUREMENT
/begin MEASUREMENT eevx "EV Fehlerbyte" UBYTE dez 1 100 0 255 FORMAT "%5.1" ECU_ADDRESS 0x5B870C /end MEASUREMENT
/begin MEASUREMENT erdrcamctr "Anzahl der Fehlermeldungen die vom Hardware Treiber der NW gemeldet wurden" UBYTE dez 1 100 0 255 FORMAT "%5.1" ECU_ADDRESS 0x5B8C8F /end MEASUREMENT
/begin MEASUREMENT erdrrevctr "Anzahl der Fehlermeldungen die vom Hardware Treiber der KW gemeldet wurden" UBYTE dez 1 100 0 255 FORMAT "%5.1" ECU_ADDRESS 0x5B8C90 /end MEASUREMENT
/begin MEASUREMENT erdrsynctr "Anzahl der Fehlermeldungen die vom HWT f¸r Synchronisation gemeldet werden" UBYTE dez 1 100 0 255 FORMAT "%5.1" ECU_ADDRESS 0x5B8C91 /end MEASUREMENT
/begin MEASUREMENT esst_smk08mdsw "" ULONG dez 1 100 0 4.29497e+009 FORMAT "%13.2" ECU_ADDRESS 0x5B9A7C /end MEASUREMENT
/begin MEASUREMENT esst_smt06tmuw "" ULONG dez 1 100 0 4.29497e+009 FORMAT "%13.2" ECU_ADDRESS 0x5B9A04 /end MEASUREMENT
/begin MEASUREMENT esst_sts06tmuw "" ULONG dez 1 100 0 4.29497e+009 FORMAT "%13.2" ECU_ADDRESS 0x5B9A08 /end MEASUREMENT
/begin MEASUREMENT esst_stu05tmub "" ULONG dez 1 100 0 4.29497e+009 FORMAT "%13.2" ECU_ADDRESS 0x5B9A0C /end MEASUREMENT
/begin MEASUREMENT etazwimt "Ist_Z¸ndwinkelwirkungsgrad f¸r ATM gemittelt (200 ms)" UBYTE rel_ub_b127p5 1 100 0 127.5 FORMAT "%5.1" ECU_ADDRESS 0x5B8639 /end MEASUREMENT
/begin MEASUREMENT etxdvef "" UBYTE dez 1 100 0 255 FORMAT "%5.1" ECU_ADDRESS 0x5B8507 /end MEASUREMENT
/begin MEASUREMENT etxdvefo "" UBYTE dez 1 100 0 255 FORMAT "%5.1" ECU_ADDRESS 0x5B8508 /end MEASUREMENT
/begin MEASUREMENT etxdven "" UBYTE dez 1 100 0 255 FORMAT "%5.1" ECU_ADDRESS 0x5B8509 /end MEASUREMENT
/begin MEASUREMENT etxdveu "" UBYTE dez 1 100 0 255 FORMAT "%5.1" ECU_ADDRESS 0x5B850A /end MEASUREMENT
/begin MEASUREMENT etxdveuw "" UBYTE dez 1 100 0 255 FORMAT "%5.1" ECU_ADDRESS 0x5B850B /end MEASUREMENT
/begin MEASUREMENT etxdvev "" UBYTE dez 1 100 0 255 FORMAT "%5.1" ECU_ADDRESS 0x5B850C /end MEASUREMENT
/begin MEASUREMENT etxfrao "" UBYTE dez 1 100 0 255 FORMAT "%5.1" ECU_ADDRESS 0x5B850D /end MEASUREMENT
/begin MEASUREMENT etxfrau "" UBYTE dez 1 100 0 255 FORMAT "%5.1" ECU_ADDRESS 0x5B850E /end MEASUREMENT
/begin MEASUREMENT etxhsh "Fehlerart-Erweiterungsbyte: Diagnosestatus Heizung Lambdasonde hinter Kat" UBYTE dez 1 100 0 255 FORMAT "%5.1" ECU_ADDRESS 0x5B850F /end MEASUREMENT
/begin MEASUREMENT etxhsv "Fehlerart-Erweiterungsbyte: Diagnosestatus Heizung Lambdasonde v.Kat" UBYTE dez 1 100 0 255 FORMAT "%5.1" ECU_ADDRESS 0x5B8510 /end MEASUREMENT
/begin MEASUREMENT etxhsvsa "Fehlerart-Erweiterungsbyte: Diagnosestatus Heizung/Kennlinie Lambdasonde v.Kat" UBYTE dez 1 100 0 255 FORMAT "%5.1" ECU_ADDRESS 0x5B8511 /end MEASUREMENT
/begin MEASUREMENT etxkatsp "" UBYTE dez 1 100 0 255 FORMAT "%5.1" ECU_ADDRESS 0x5B8512 /end MEASUREMENT
/begin MEASUREMENT etxlash "" UBYTE dez 1 100 0 255 FORMAT "%5.1" ECU_ADDRESS 0x5B8513 /end MEASUREMENT
/begin MEASUREMENT etxlatp "" UBYTE dez 1 100 0 255 FORMAT "%5.1" ECU_ADDRESS 0x5B8514 /end MEASUREMENT
/begin MEASUREMENT etxlatv "" UBYTE dez 1 100 0 255 FORMAT "%5.1" ECU_ADDRESS 0x5B8515 /end MEASUREMENT
/begin MEASUREMENT etxlsh "" UBYTE dez 1 100 0 255 FORMAT "%5.1" ECU_ADDRESS 0x5B8516 /end MEASUREMENT
/begin MEASUREMENT etxlsv "" UBYTE dez 1 100 0 255 FORMAT "%5.1" ECU_ADDRESS 0x5B8517 /end MEASUREMENT
/begin MEASUREMENT etxrkat "" UBYTE dez 1 100 0 255 FORMAT "%5.1" ECU_ADDRESS 0x5B8518 /end MEASUREMENT
/begin MEASUREMENT etxrkaz "" UBYTE dez 1 100 0 255 FORMAT "%5.1" ECU_ADDRESS 0x5B8519 /end MEASUREMENT
/begin MEASUREMENT etxsls "Fehlerart-Erweiterungsbyte: Diagnosestatus Sekund‰rluft-System" UBYTE dez 1 100 0 255 FORMAT "%5.1" ECU_ADDRESS 0x5B851A /end MEASUREMENT
/begin MEASUREMENT etxslv "Fehlerart-Erweiterungsbyte: Diagnosestatus Sekund‰rluft-Ventil" UBYTE dez 1 100 0 255 FORMAT "%5.1" ECU_ADDRESS 0x5B851B /end MEASUREMENT
/begin MEASUREMENT etxtes "" UBYTE dez 1 100 0 255 FORMAT "%5.1" ECU_ADDRESS 0x5B851C /end MEASUREMENT
/begin MEASUREMENT evrbgn_one "Ev Nr -1 bei Beginn der Ev-Abschaltung zur Adressierung von REDABM" UBYTE dez 1 100 0 255 FORMAT "%5.1" ECU_ADDRESS 0x5B8E85 /end MEASUREMENT
/begin MEASUREMENT evz_aus "Einspritzausblendmuster" UBYTE dez 1 100 0 255 FORMAT "%5.1" ECU_ADDRESS 0x5B8E86 /end MEASUREMENT
/begin MEASUREMENT evz_austot "Einspritzausblendmuster total" UBYTE dez 1 100 0 255 FORMAT "%5.1" ECU_ADDRESS 0x5B8E8B /end MEASUREMENT
/begin MEASUREMENT fakttansel "Ansaugluftfaktor E-L¸fterstrom" UWORD fak_ub_b2 1 100 0 1.99219 FORMAT "%8.6" ECU_ADDRESS 0x5B88FE /end MEASUREMENT
/begin MEASUREMENT faktubel "" UWORD fak_ub_b2 1 100 0 1.99219 FORMAT "%8.6" ECU_ADDRESS 0x5B8900 /end MEASUREMENT
/begin MEASUREMENT fdar "Verst‰rkungsfaktor des AR-Eingriffs" UBYTE fak_ub_b3p125 1 100 0 3.11279 FORMAT "%5.3" ECU_ADDRESS 0x5B8F98 /end MEASUREMENT
/begin MEASUREMENT fevab "festes Muster EV-Abschaltung" UBYTE dez 1 100 0 255 FORMAT "%5.1" ECU_ADDRESS 0x5B870D /end MEASUREMENT
/begin MEASUREMENT fevabe "Ausblendmuster aus erkannten Fehlern" UBYTE dez 1 100 0 255 FORMAT "%5.1" ECU_ADDRESS 0x5B870E /end MEASUREMENT
/begin MEASUREMENT fgr_stat "Status Fahrgeschwindigkeitsregler" UBYTE dez 1 100 0 255 FORMAT "%5.1" ECU_ADDRESS 0x5B8C2D /end MEASUREMENT
/begin MEASUREMENT fhost_w "Korrekturfaktor Hˆhe bei Start(word)" UWORD fak_uw_b4 1 100 0 3.99994 FORMAT "%8.6" ECU_ADDRESS 0x5B8834 /end MEASUREMENT
/begin MEASUREMENT fkez "Faktor Korrektur Einspritzzeit zylinderindividuell" UBYTE fak_ub_b2 1 100 0 1.99219 FORMAT "%5.3" ARRAY_SIZE 8 ECU_ADDRESS 0x5B8C40 /end MEASUREMENT
/begin MEASUREMENT fkhab "Faktor Katheizen zur Abregelung" UBYTE fak_ub_b1 1 100 0 0.996094 ECU_ADDRESS 0x5B8F00 /end MEASUREMENT
/begin MEASUREMENT fkhnab "Leerlaufdrehzahl-Absteuerfaktor" UBYTE fak_ub_b1 1 100 0 0.996094 ECU_ADDRESS 0x5B8F01 /end MEASUREMENT
/begin MEASUREMENT flakh "Faktor Lambda-Steuerung bei Katheizen" UBYTE fak_ub_b1 1 100 0 0.996094 ECU_ADDRESS 0x5B8F02 /end MEASUREMENT
/begin MEASUREMENT flamkh "Faktor Aufregelung Lambda-Motor-Soll bei Katheizen" UBYTE fak_ub_b1 1 100 0 0.996094 ECU_ADDRESS 0x5B8F03 /end MEASUREMENT
/begin MEASUREMENT flrar "Verst‰rkungsfaktor zum Nachbilden der externen Last" UBYTE fak_ub_b16 1 100 0 15.9375 FORMAT "%5.2" ECU_ADDRESS 0x5B8F99 /end MEASUREMENT
/begin MEASUREMENT fmdkh "Faktor Steuerung Drehmomentreserve f¸r Katheizen" UBYTE fak_ub_b1 1 100 0 0.996094 ECU_ADDRESS 0x5B8F04 /end MEASUREMENT
/begin MEASUREMENT fmdkhtns_w "" UWORD fak_uw_b1 1 100 0 0.999985 FORMAT "%9.7" ECU_ADDRESS 0x5B9296 /end MEASUREMENT
/begin MEASUREMENT fprstep_c "Schrittz‰hler DK-R¸ckstellfeder-Pr¸fung" UBYTE dez 1 100 0 255 FORMAT "%5.1" ECU_ADDRESS 0x5B8E32 /end MEASUREMENT
/begin MEASUREMENT fprtim_c "Zeitz‰hler DK-R¸ckstellfeder-Pr¸fung" UBYTE t10msxs_ub_b2p55 1 100 0 2.55 FORMAT "%5.3" ECU_ADDRESS 0x5B8E33 /end MEASUREMENT
/begin MEASUREMENT gangi "Ist-Gang" UBYTE dez 1 100 0 255 FORMAT "%5.1" ECU_ADDRESS 0x5B8E70 /end MEASUREMENT
/begin MEASUREMENT imlatm "integr. Luftmassenfluss ab Motorstart bis Max.wert" UBYTE m_ub_b23p3 1 100 0 23.2107 FORMAT "%5.2" ECU_ADDRESS 0x5B863A /end MEASUREMENT
/begin MEASUREMENT imlatmw_w "Dauer-RAM integr. Luftmassenfluss bei Abstellen" UWORD m_uw_b23p3 1 100 0 23.3013 FORMAT "%8.5" ECU_ADDRESS 0x3FDC64 /end MEASUREMENT
/begin MEASUREMENT imlatm_w "integr. Luftmassenfluss ab Startende bis max. Wert, (Word)" UWORD m_uw_b23p3 1 100 0 23.3013 FORMAT "%8.5" ECU_ADDRESS 0x5B864A /end MEASUREMENT
/begin MEASUREMENT imlbbo "Integrator Luftmasse f¸r Erkennung Benzin im ÷l" UBYTE m_ub_b23p3 1 100 0 23.2107 FORMAT "%5.2" ECU_ADDRESS 0x5B8778 /end MEASUREMENT
/begin MEASUREMENT imlbbo_w "" UWORD m_uw_b23p3 1 100 0 23.3013 FORMAT "%8.5" ECU_ADDRESS 0x5B877A /end MEASUREMENT
/begin MEASUREMENT imlpr "Relatives Luftmassenintegral bei Katheizung" UBYTE fak_ub_b1 1 100 0 0.996094 ECU_ADDRESS 0x5B8F05 /end MEASUREMENT
/begin MEASUREMENT imlpr_w "Relatives Luftmassenintegral bei Katheizung (word)" UWORD fak_uw_b1 1 100 0 0.999985 FORMAT "%9.7" ECU_ADDRESS 0x5B9298 /end MEASUREMENT
/begin MEASUREMENT iwmatm_w "W‰rmemenge f¸r Kondenswasser-Taupunktende Abgas/Kat (word)" UWORD q_q0p4551 1 100 0 29825.7 FORMAT "%8.2" ECU_ADDRESS 0x5B864C /end MEASUREMENT
/begin MEASUREMENT i_eluefter "" UWORD i_eluft_q0p0625 1 100 0 128 FORMAT "%8.4" ECU_ADDRESS 0x5B8902 /end MEASUREMENT
/begin MEASUREMENT i_elupwm "" UWORD i_eluft_q0p0625 1 100 0 64 FORMAT "%8.5" ECU_ADDRESS 0x5B8904 /end MEASUREMENT
/begin MEASUREMENT i_eluvfzg "" UWORD i_eluft_q0p0625 1 100 0 128 FORMAT "%8.4" ECU_ADDRESS 0x5B8906 /end MEASUREMENT
/begin MEASUREMENT i_elu_vvt "Strom E-L¸fter und VVT-System" UWORD i_vvt_q0p0625 1 100 0 4095.94 FORMAT "%8.3" ECU_ADDRESS 0x5B8908 /end MEASUREMENT
/begin MEASUREMENT i_slp "berechnete Groesse Strombedarf Sekundˆrluftpumpe" UWORD i_eluft_q0p0625 1 100 0 255 FORMAT "%8.4" ECU_ADDRESS 0x5B890A /end MEASUREMENT
/begin MEASUREMENT kftevp "" UBYTE t500usxms_ub_q0p5 1 100 0 127.5 FORMAT "%5.1" ECU_ADDRESS 0x5B8FD9 /end MEASUREMENT
/begin MEASUREMENT kifz_w "Verst‰rkung des Fahrzeugmodells" UWORD fak_uw_b4864 1 100 0 4863.93 FORMAT "%8.3" ECU_ADDRESS 0x5B9354 /end MEASUREMENT
/begin MEASUREMENT kmstmil_w "Zur¸ckgelegte Fahrstrecke mit MIL on" UWORD s_q1_km 1 100 0 65535 FORMAT "%8.2" ECU_ADDRESS 0x3FD7EC /end MEASUREMENT
/begin MEASUREMENT kmstnmax "Bezugspunkt beim Auftreten der ‹berdrehzahl" UWORD km_uw_q10 1 100 0 655350 FORMAT "%8.1" ECU_ADDRESS 0x3FE92C /end MEASUREMENT
/begin MEASUREMENT kmstpbr_w "Bezugspunkt beim Auftreten der PWG-Bremspedal Plausibilisierung" UWORD km_uw_q10 1 100 0 655350 FORMAT "%8.1" ECU_ADDRESS 0x3FE946 /end MEASUREMENT
/begin MEASUREMENT kmst_w "Zur¸ckgelegte Fahrstrecke seit Powerfail" UWORD s_q6_km 1 100 0 393210 FORMAT "%8.1" ECU_ADDRESS 0x3FD7EE /end MEASUREMENT
/begin MEASUREMENT kryptoCounter "" UWORD dez 1 100 0 65535 FORMAT "%8.2" ECU_ADDRESS 0x5B88A8 /end MEASUREMENT
/begin MEASUREMENT lokBits_Aekp "" UBYTE dez 1 100 0 255 FORMAT "%5.1" ECU_ADDRESS 0x5B8A8F /end MEASUREMENT
/begin MEASUREMENT lrnstat "Statusbyte DV-E-Adaption f¸r Testerkommunikation" UBYTE dez 1 100 0 255 FORMAT "%5.1" ECU_ADDRESS 0x5B8E34 /end MEASUREMENT
/begin MEASUREMENT lrnstep_c "Z‰hler f¸r Lerndauer eines Lernsteps" UBYTE dez 1 100 0 255 FORMAT "%5.1" ECU_ADDRESS 0x5B8E35 /end MEASUREMENT
/begin MEASUREMENT lrntim_c "Zeitz‰hler f¸r Wartezeit in den Lernschritten" UBYTE t20msxs_ub_b5p1 1 100 0 5.1 FORMAT "%5.3" ECU_ADDRESS 0x5B8E36 /end MEASUREMENT
/begin MEASUREMENT lrnvb_c "Lernverbotsz‰hler (Wartezeit)" UWORD t20msxs_uw_q0p02 1 100 0 1310.7 FORMAT "%8.3" ECU_ADDRESS 0x5B907C /end MEASUREMENT
/begin MEASUREMENT mdbes_w "Beschleunigungsmoment" SWORD rel_sw_b100 1 100 -100 99.9969 FORMAT "%8.4" ECU_ADDRESS 0x5B9356 /end MEASUREMENT
/begin MEASUREMENT milmxvl_w "gefordertes Moment bezogen auf das maximale Moment aus MDMAX" UWORD rel_uw_b200 1 100 0 199.997 FORMAT "%8.4" ECU_ADDRESS 0x5B940A /end MEASUREMENT
/begin MEASUREMENT mkar_w "Berechnetes Kupplungsmoment f¸r Antiruckelfunktion" SWORD rel_sw_b100 1 100 -100 99.9969 FORMAT "%8.4" ECU_ADDRESS 0x5B9358 /end MEASUREMENT
/begin MEASUREMENT mlast_w "gesch‰tztes Lastmoment" SWORD rel_sw_b100 1 100 -100 99.9969 FORMAT "%8.4" ECU_ADDRESS 0x5B935A /end MEASUREMENT
/begin MEASUREMENT mlsu "Soll-Luftmasse f¸r Katheizen" UBYTE m_ub_b5p8 1 100 0 5.80267 FORMAT "%5.3" ECU_ADDRESS 0x5B8830 /end MEASUREMENT
/begin MEASUREMENT mrfabn "aktuelle gewichtete Leistung (f¸r Dauer-Hochlasterkennung)" UBYTE rel_ub_b100 1 100 0 100 FORMAT "%5.1" ECU_ADDRESS 0x5B8710 /end MEASUREMENT
/begin MEASUREMENT mrfabnf "Tiefpaﬂ-gefilterte gewichtete Leistung - DauerHochlasterkenung" UBYTE rel_ub_b100 1 100 0 100 FORMAT "%5.1" ECU_ADDRESS 0x5B8711 /end MEASUREMENT
/begin MEASUREMENT ndar_w "Differenzdrehzahl f¸r Momenteneingriff" SWORD nmot_sw_q0p25 1 100 -8192 8191.75 FORMAT "%8.3" ECU_ADDRESS 0x5B935C /end MEASUREMENT
/begin MEASUREMENT ndfibet_w "Betrag der gefilterten Differenzdrehzahl" UWORD nmot_uw_q0p25 1 100 0 16383.8 FORMAT "%8.2" ECU_ADDRESS 0x5B935E /end MEASUREMENT
/begin MEASUREMENT ndfil_w "gefilterte Differenzdrehzahl" SWORD nmot_sw_q0p25 1 100 -8192 8191.75 FORMAT "%8.3" ECU_ADDRESS 0x5B9360 /end MEASUREMENT
/begin MEASUREMENT ndiffog_w "Schwelle Drehzahldifferenz zum Resetieren der AR beim Verzˆgern" SWORD nmot_sw_q0p25 1 100 -8192 8191.75 FORMAT "%8.3" ECU_ADDRESS 0x5B9362 /end MEASUREMENT
/begin MEASUREMENT ndiff_w "Differenzdrehzahl f¸r LFR-HS-Verst‰rkungen" SWORD nmot_sw_q0p25 1 100 -8192 8191.75 FORMAT "%8.3" ECU_ADDRESS 0x5B9364 /end MEASUREMENT
/begin MEASUREMENT nfskh "Leerlaufdrehzahl Fahrstufe bei Katheizen" UBYTE nmot_ub_q10 1 100 0 2550 FORMAT "%5.0" ECU_ADDRESS 0x5B8F06 /end MEASUREMENT
/begin MEASUREMENT nllkh "Leerlaufdrehzahl bei Katheizen" UBYTE nmot_ub_q10 1 100 0 2550 FORMAT "%5.0" ECU_ADDRESS 0x5B8F07 /end MEASUREMENT
/begin MEASUREMENT nlp1tim "Zeitz‰hler f¸r Wartezeit 1 im NLP-Lernen" UBYTE t10msxs_ub_b2p55 1 100 0 2.55 FORMAT "%5.3" ECU_ADDRESS 0x5B8E37 /end MEASUREMENT
/begin MEASUREMENT nmaxvk_w "vorgekommene Maximaldrehzahl" UWORD nmot_uw_q0p15625 1 100 0 10239.8 FORMAT "%8.2" ECU_ADDRESS 0x3FE92E /end MEASUREMENT
/begin MEASUREMENT nmodiv_w "Drehzahl f¸r Initialisierung ARMD berechnet aus Geschwindigkeit" UWORD nmot_uw_q0p25 1 100 0 16383.8 FORMAT "%8.2" ECU_ADDRESS 0x5B9366 /end MEASUREMENT
/begin MEASUREMENT nmod_w "Motordrehzahl aus Modell" UWORD nmot_uw_q0p25 1 100 0 16383.8 FORMAT "%8.2" ECU_ADDRESS 0x5B9368 /end MEASUREMENT
/begin MEASUREMENT nmotk1_w "Motordrehzahl 1 Synchro vorher" UWORD nmot_uw_q0p25 1 100 0 16383.8 FORMAT "%8.2" ECU_ADDRESS 0x5B936A /end MEASUREMENT
/begin MEASUREMENT nmotk2_w "Motordrehzahl 2 Synchros vorher" UWORD nmot_uw_q0p25 1 100 0 16383.8 FORMAT "%8.2" ECU_ADDRESS 0x5B936C /end MEASUREMENT
/begin MEASUREMENT nsa "Drehzahl Schub" UBYTE nmot_ub_q40 1 100 0 10200 FORMAT "%5.0" ECU_ADDRESS 0x5B8F82 /end MEASUREMENT
/begin MEASUREMENT nvquot_w "Quotient Motordrehzahl nmot / Fahrgeschwindigkeit vfzg" UWORD qnv_uw_b512 1 100 0 511.992 FORMAT "%8.4" ECU_ADDRESS 0x5B90D0 /end MEASUREMENT
/begin MEASUREMENT nwe "Wiedereinsetzdrehzahl" UBYTE nmot_ub_q40 1 100 0 10200 FORMAT "%5.0" ECU_ADDRESS 0x5B8F83 /end MEASUREMENT
/begin MEASUREMENT nwem_out "Ausgangsgrˆﬂe von NWEM" UBYTE nmot_ub_q40 1 100 0 10200 FORMAT "%5.0" ECU_ADDRESS 0x5B8F84 /end MEASUREMENT
/begin MEASUREMENT ottstamp_l "Berechnungsgrˆsse letzte Zahnzeit absolut" SLONG t_q0p0001_ms 1 100 -107374 107374 FORMAT "%13.6" ECU_ADDRESS 0x5B99B0 /end MEASUREMENT
/begin MEASUREMENT recRes5vSt "" UBYTE dez 1 100 0 255 FORMAT "%5.1" ECU_ADDRESS 0x3FE951 /end MEASUREMENT
/begin MEASUREMENT recWDASt "" UBYTE dez 1 100 0 255 FORMAT "%5.1" ECU_ADDRESS 0x3FE952 /end MEASUREMENT
/begin MEASUREMENT redbas "Basis-Reduzierstufe" UBYTE dez 1 100 0 255 FORMAT "%5.1" ECU_ADDRESS 0x5B8E8C /end MEASUREMENT
/begin MEASUREMENT redist "Ist-Reduzierstufe" UBYTE dez 1 100 0 255 FORMAT "%5.1" ECU_ADDRESS 0x5B8E8D /end MEASUREMENT
/begin MEASUREMENT redistb1 "Ist-Reduzierstufe Bank 1" UBYTE dez 1 100 0 255 FORMAT "%5.1" ECU_ADDRESS 0x5B8E8E /end MEASUREMENT
/begin MEASUREMENT redsolr "Realisierte Reduzierstufe" UBYTE dez 1 100 0 255 FORMAT "%5.1" ECU_ADDRESS 0x5B8E87 /end MEASUREMENT
/begin MEASUREMENT redsol_one "Berechnete Soll-Reduzierstufe - 1 zur Adress. von REDABM" UBYTE dez 1 100 0 255 FORMAT "%5.1" ECU_ADDRESS 0x5B8E88 /end MEASUREMENT
/begin MEASUREMENT res5vctr_w "" UWORD dez 1 100 0 65535 FORMAT "%8.2" ECU_ADDRESS 0x3FD7AC /end MEASUREMENT
/begin MEASUREMENT res5vsta_l "" ULONG dez 1 100 0 4.29497e+009 FORMAT "%13.2" ECU_ADDRESS 0x3FD7B0 /end MEASUREMENT
/begin MEASUREMENT res5vsts_l "" ULONG dez 1 100 0 4.29497e+009 FORMAT "%13.2" ECU_ADDRESS 0x3FD7B4 /end MEASUREMENT
/begin MEASUREMENT rlvwvugd_w "geforderter Luftvolumenstrom bezogen auf maximalen Volumenstrom" UWORD rel_uw_b200 1 100 0 199.997 FORMAT "%8.4" ECU_ADDRESS 0x5B940C /end MEASUREMENT
/begin MEASUREMENT stateaevab "Nr des aktiven Zustandes in AEVAB" UBYTE dez 1 100 0 255 FORMAT "%5.1" ECU_ADDRESS 0x5B8E89 /end MEASUREMENT
/begin MEASUREMENT st_craweng "Strombedarf Motor" UBYTE igen_ub_q1 1 100 0 254 FORMAT "%5.1" ECU_ADDRESS 0x5B8918 /end MEASUREMENT
/begin MEASUREMENT tabgm "Abgastemperatur vor Kat aus Modell" UBYTE temp_ub_q5_o50 1 100 -50 1225 FORMAT "%5.0" ECU_ADDRESS 0x5B863B /end MEASUREMENT
/begin MEASUREMENT tabgmab "Abgastemperatur beim Abstellen des Motors" UBYTE temp_ub_q5_o50 1 100 -50 1225 FORMAT "%5.0" ECU_ADDRESS 0x3FDBA1 /end MEASUREMENT
/begin MEASUREMENT tabgmst "Abgastemperatur bei Motorstart" UBYTE temp_ub_q5_o50 1 100 -50 1225 FORMAT "%5.0" ECU_ADDRESS 0x5B863C /end MEASUREMENT
/begin MEASUREMENT tabgm_w "Abgastemperatur vor Kat aus Modell (Word)" UWORD temp_uw_q0p0195_o50 1 100 -50 1229.98 FORMAT "%8.3" ECU_ADDRESS 0x5B864E /end MEASUREMENT
/begin MEASUREMENT tabstatm_w "Abstellzeit im SG-Nachlauf f¸r ATM" UWORD t1sxs_uw_q1 1 100 0 65535 FORMAT "%8.2" ECU_ADDRESS 0x5B8650 /end MEASUREMENT
/begin MEASUREMENT tabstmx_w "Abstellzeit Maximumabfrage f¸r ATM" UWORD t1sxs_uw_q1 1 100 0 65535 FORMAT "%8.2" ECU_ADDRESS 0x3FDBA6 /end MEASUREMENT
/begin MEASUREMENT taml_tmp "Tastverh‰ltnis E-L¸fter (TMP)" UWORD rel_ub_b100 1 100 0 100 FORMAT "%8.4" ECU_ADDRESS 0x5B890C /end MEASUREMENT
/begin MEASUREMENT tanskhst "Ansaugluft - Temperatur bei start" UBYTE temp_ub_q0p75_o48 1 100 -48 143.25 FORMAT "%5.1" ECU_ADDRESS 0x5B8831 /end MEASUREMENT
/begin MEASUREMENT tans_tmp "Ansaugtemperatur (TMP)" UWORD temp_ub_q0p75_o48 1 100 -48 143.25 FORMAT "%8.4" ECU_ADDRESS 0x5B890E /end MEASUREMENT
/begin MEASUREMENT tateist "aktuelles Ist-Tastverh‰ltnis Tankentl¸ftungsventil" UBYTE rel_ub_b99p6 1 100 0 99.6094 FORMAT "%5.2" ECU_ADDRESS 0x5B8FDA /end MEASUREMENT
/begin MEASUREMENT tatemxfq "max Tastverh‰ltnis TEV ˆffnet" UBYTE rel_ub_b99p6 1 100 0 99.6094 FORMAT "%5.2" ECU_ADDRESS 0x5B8FDB /end MEASUREMENT
/begin MEASUREMENT tateout "ausgegebenes Tastverh‰ltnis f¸r Tankentl¸ftungsventil" UBYTE rel_ub_b99p6 1 100 0 99.6094 FORMAT "%5.2" ECU_ADDRESS 0x5B8FDC /end MEASUREMENT
/begin MEASUREMENT tateroh "Rohwert Tastverh‰ltnis TEV" UBYTE rel_ub_b99p6 1 100 0 99.6094 FORMAT "%5.2" ECU_ADDRESS 0x5B8FDD /end MEASUREMENT
/begin MEASUREMENT tatesoll "gew¸nschtes Soll-Tastverh‰ltnis Tankentl¸ftungsventil" UBYTE rel_ub_b99p6 1 100 0 99.6094 FORMAT "%5.2" ECU_ADDRESS 0x5B8FDE /end MEASUREMENT
/begin MEASUREMENT tatmaml "Ausgang aus PT1-Glied Abgastemperatur-Einfluﬂ auf tabgm" UBYTE temp_ub_q5_o50 1 100 -50 1225 FORMAT "%5.0" ECU_ADDRESS 0x5B863D /end MEASUREMENT
/begin MEASUREMENT tatmkf "Abgastemperatur vor Kat aus Kennfeld KFTATM" UBYTE temp_ub_q5_o50 1 100 -50 1225 FORMAT "%5.0" ECU_ADDRESS 0x5B863E /end MEASUREMENT
/begin MEASUREMENT tatmrml "Ausgang aus PT1-Glied Rohrwandtemperatur-Einfluﬂ auf tabgm" UBYTE temp_ub_q5_o50 1 100 -50 1225 FORMAT "%5.0" ECU_ADDRESS 0x5B863F /end MEASUREMENT
/begin MEASUREMENT tatmsta "Abgastemperatur vor Kat aus Modell station‰r" UBYTE temp_ub_q5_o50 1 100 -50 1225 FORMAT "%5.0" ECU_ADDRESS 0x5B8640 /end MEASUREMENT
/begin MEASUREMENT tatu "Ansaugluft- oder Umgebungstemperatur" UBYTE temp_ub_q0p75_o48 1 100 -48 143.25 FORMAT "%5.1" ECU_ADDRESS 0x5B8641 /end MEASUREMENT
/begin MEASUREMENT tdknach_w "Zeitz‰hler im Nachlauf bis stromlose DK in NLP einschwingt" UWORD t10msxs_uw_b655p35 1 100 0 655.35 FORMAT "%8.4" ECU_ADDRESS 0x5B907E /end MEASUREMENT
/begin MEASUREMENT temp_klt_l "Zahnzeit aus KLALETM mit der Temperatur zum Beginn der Nachlaufphase" SLONG t_q0p0001_ms 1 100 -214748 214748 FORMAT "%13.6" ECU_ADDRESS 0x5B99B4 /end MEASUREMENT
/begin MEASUREMENT temp_tn1_l "Ringpuffervariable, letzte Zahnzeit" SLONG t_q0p0001_ms 1 100 -214748 214748 FORMAT "%13.6" ECU_ADDRESS 0x5B99B8 /end MEASUREMENT
/begin MEASUREMENT temp_tn2_l "Ringpuffervariable, vorletzte Zahnzeit" SLONG t_q0p0001_ms 1 100 -214748 214748 FORMAT "%13.6" ECU_ADDRESS 0x5B99BC /end MEASUREMENT
/begin MEASUREMENT temp_tn_l "Ringpuffervariable, aktuelle Zahnzeit" SLONG t_q0p0001_ms 1 100 -214748 214748 FORMAT "%13.6" ECU_ADDRESS 0x5B99C0 /end MEASUREMENT
/begin MEASUREMENT temp_w1 "Zwischenwerte f¸r Plausibilisierung" SWORD kw_q0p1 1 100 0 412 FORMAT "%8.4" ECU_ADDRESS 0x5B955A /end MEASUREMENT
/begin MEASUREMENT temp_w2 "Zwischenwerte f¸r Plausibilisierung" SWORD kw_q0p1 1 100 -3276.8 3276.7 FORMAT "%8.3" ECU_ADDRESS 0x5B955C /end MEASUREMENT
/begin MEASUREMENT temp_w3 "Zwischenwerte f¸r Plausibilisierung" SWORD kw_q0p1 1 100 -3276.8 3276.7 FORMAT "%8.3" ECU_ADDRESS 0x5B955E /end MEASUREMENT
/begin MEASUREMENT temp_w4 "Zwischenwerte f¸r Plausibilisierung" SWORD kw_q0p1 1 100 -3276.8 3276.7 FORMAT "%8.3" ECU_ADDRESS 0x5B9560 /end MEASUREMENT
/begin MEASUREMENT tephc "Phasenz‰hler Grundadaption / Tankentl¸ftung" UWORD t100msxs_uw_b6553p6 1 100 0 6553.5 FORMAT "%8.3" ECU_ADDRESS 0x5B8714 /end MEASUREMENT
/begin MEASUREMENT tevper "Periodendauer bei Ansteuerung Tankentl¸ftungsventil" UBYTE t500usxms_ub_q0p5 1 100 0 127.5 FORMAT "%5.1" ECU_ADDRESS 0x5B8A1D /end MEASUREMENT
/begin MEASUREMENT texkor "Korrektur der exothermen Temperaturerhˆhung im Kat texom_w" UBYTE fak_ub_b2 1 100 0 1.99219 FORMAT "%5.3" ECU_ADDRESS 0x5B8642 /end MEASUREMENT
/begin MEASUREMENT texml "Exotherme Temperaturerhˆhung im Kat f¸r tkatm aus Kennlinie" SBYTE temp_q5 1 100 -640 635 FORMAT "%5.1" ECU_ADDRESS 0x5B8643 /end MEASUREMENT
/begin MEASUREMENT texoikm_w "Exotherme Temperaturerhˆhung im Kat f¸r tikatm" SWORD temp_q0p0195 1 100 -640 639.98 FORMAT "%8.4" ECU_ADDRESS 0x5B8652 /end MEASUREMENT
/begin MEASUREMENT texom_w "Exotherme Temperaturerhˆhung im Kat f¸r tkatm" SWORD temp_q0p0195 1 100 -640 639.98 FORMAT "%8.4" ECU_ADDRESS 0x5B8654 /end MEASUREMENT
/begin MEASUREMENT tiexkor "Korrektur der exothermen Temperaturerhˆhung im Kat texoikm_w" UBYTE fak_ub_b2 1 100 0 1.99219 FORMAT "%5.3" ECU_ADDRESS 0x5B8644 /end MEASUREMENT
/begin MEASUREMENT tiexml "Exotherme Temperaturerhˆhung im Kat f¸r tikatm aus Kennlinie" SBYTE temp_q5 1 100 -640 635 FORMAT "%5.1" ECU_ADDRESS 0x5B8645 /end MEASUREMENT
/begin MEASUREMENT tikatm "Abgastemperatur im Katalysator aus Modell" UBYTE temp_ub_q5_o50 1 100 -50 1225 FORMAT "%5.0" ECU_ADDRESS 0x5B8646 /end MEASUREMENT
/begin MEASUREMENT tikatm_w "Abgastemperatur im Katalysator aus Modell" UWORD temp_uw_q0p0195_o50 1 100 -50 1229.98 FORMAT "%8.3" ECU_ADDRESS 0x5B8656 /end MEASUREMENT
/begin MEASUREMENT tirq1ofd_w "" UWORD dez 1 100 0 65535 FORMAT "%8.2" ECU_ADDRESS 0x3F9BE0 /end MEASUREMENT
/begin MEASUREMENT tkatm "Katalysatortemperatur aus Modell" UBYTE temp_ub_q5_o50 1 100 -50 1225 FORMAT "%5.0" ECU_ADDRESS 0x5B8647 /end MEASUREMENT
/begin MEASUREMENT tkatmab "Abgastemperatur hinter Kat beim Abstellen des Motors (Modell)" UBYTE temp_ub_q5_o50 1 100 -50 1225 FORMAT "%5.0" ECU_ADDRESS 0x3FDBA2 /end MEASUREMENT
/begin MEASUREMENT tkatmst "Katalysatortemperatur Modell Startwert = f(Abstellwert, Abstellzeit)" UBYTE temp_ub_q5_o50 1 100 -50 1225 FORMAT "%5.0" ECU_ADDRESS 0x5B8648 /end MEASUREMENT
/begin MEASUREMENT tkatm_w "Katalysatortemperatur aus Modell (Word)" UWORD temp_uw_q0p0195_o50 1 100 -50 1229.98 FORMAT "%8.3" ECU_ADDRESS 0x5B8658 /end MEASUREMENT
/begin MEASUREMENT tkhnab_ctr "" UWORD t100msxs_uw_b6553p5 1 100 0 6553.5 FORMAT "%8.3" ECU_ADDRESS 0x5B929A /end MEASUREMENT
/begin MEASUREMENT tloop_w "" UWORD t50msxs_q0p05 1 100 0 3276.75 FORMAT "%8.3" ECU_ADDRESS 0x5B9080 /end MEASUREMENT
/begin MEASUREMENT tmcorctr_w "Z‰hler L¸ckenkorrektur bei fehlendem Zahn" UWORD dez 1 100 0 65535 FORMAT "%8.2" ECU_ADDRESS 0x5B972C /end MEASUREMENT
/begin MEASUREMENT tmlastz "Abw‰rtsz‰hler zum Resetieren der AR beim Verzˆgern" UBYTE t10msxs_ub_b2p55 1 100 0 2.55 FORMAT "%5.3" ECU_ADDRESS 0x5B8F9A /end MEASUREMENT
/begin MEASUREMENT tmpumast "Status f¸r tempor‰re UMA-Adaption" UBYTE dez 1 100 0 255 FORMAT "%5.1" ECU_ADDRESS 0x5B8E38 /end MEASUREMENT
/begin MEASUREMENT tnmst1z "" UBYTE t10msxs_ub_b2p55 1 100 0 2.55 FORMAT "%5.3" ECU_ADDRESS 0x5B8F9B /end MEASUREMENT
/begin MEASUREMENT tnmst2z "" UBYTE t10msxs_ub_b2p55 1 100 0 2.55 FORMAT "%5.3" ECU_ADDRESS 0x5B8F9C /end MEASUREMENT
/begin MEASUREMENT tnse_w "Zeitz‰hler ab Startende (16bit)" UWORD t100msxs_uw_b6553p5 1 100 0 6553.5 FORMAT "%8.3" ECU_ADDRESS 0x5B8698 /end MEASUREMENT
/begin MEASUREMENT tnst_w "Zeit nach Startende" UWORD t10msxs_uw_b655p35 1 100 0 655.35 FORMAT "%8.4" ECU_ADDRESS 0x5B90D2 /end MEASUREMENT
/begin MEASUREMENT tooth10ms "Z‰hlvariable; f¸r die Abfrage, ob der letzte Zahnint l‰nger als 100ms her ist" UBYTE dez 1 100 0 127 FORMAT "%5.1" ECU_ADDRESS 0x5B8C04 /end MEASUREMENT
/begin MEASUREMENT toothtim_l "Zahnzeit" SLONG t_q0p0001_ms 1 100 -214748 214748 FORMAT "%13.6" ECU_ADDRESS 0x5B99C4 /end MEASUREMENT
/begin MEASUREMENT tpcorctr_w "Z‰hler L¸ckenkorrektur bei einem zus‰tzlichen Zahn" UWORD dez 1 100 0 65535 FORMAT "%8.2" ECU_ADDRESS 0x5B972E /end MEASUREMENT
/begin MEASUREMENT ttevein "aktuelle Einschaltdauer TEV" UWORD t128ms_uw 1 100 0 127.998 FORMAT "%6.2" ECU_ADDRESS 0x5B9444 /end MEASUREMENT
/begin MEASUREMENT tteveroh "TEV-Soll-Ansteuerzeit" UWORD t128ms_uw 1 100 0 127.998 FORMAT "%6.2" ECU_ADDRESS 0x5B9446 /end MEASUREMENT
/begin MEASUREMENT ttmumad_w "" UWORD t50msxs_q0p05 1 100 0 3276.75 FORMAT "%8.3" ECU_ADDRESS 0x5B9082 /end MEASUREMENT
/begin MEASUREMENT ttstamp_l "Berechnungsgrˆsse aktuelle Zahnzeit absolut" SLONG t_q0p0001_ms 1 100 -107374 107374 FORMAT "%13.6" ECU_ADDRESS 0x5B99C8 /end MEASUREMENT
/begin MEASUREMENT ttstmpmx_l "‹berlauf Zahnzeit Ausgabe aus HW-Treiber" ULONG t_q0p0001_ms 1 100 0 214748 FORMAT "%13.6" ECU_ADDRESS 0x5B99CC /end MEASUREMENT
/begin MEASUREMENT tvrnr "Verzˆgerungszeit bis zum wirklichen Ev-Abschaltende" UBYTE dez 1 100 0 255 FORMAT "%5.1" ECU_ADDRESS 0x5B8E8A /end MEASUREMENT
/begin MEASUREMENT tvtevptu "Verzugszeit von TEV  (druck-, batteriespannung- und temperaturabh‰ngig)" UBYTE t500usxms_ub_q0p5 1 100 0 127.5 FORMAT "%5.1" ECU_ADDRESS 0x5B8FDF /end MEASUREMENT
/begin MEASUREMENT tzarni "Zeitz‰hler AR nach Initialisierung" UBYTE t10msxs_ub_b2p55 1 100 0 2.55 FORMAT "%5.3" ECU_ADDRESS 0x5B8F9D /end MEASUREMENT
/begin MEASUREMENT tzms_w "Zeitdauer ZMS-Resonanz" UWORD t10msxs_uw_b655p35 1 100 0 655.35 FORMAT "%8.4" ECU_ADDRESS 0x5B869A /end MEASUREMENT
/begin MEASUREMENT ubuanlr "Spannungsschwelle f¸r UMA-Learning in Quantisierung von ubrsq" UBYTE spg_q0p1 1 100 0 25.5 FORMAT "%5.2" ECU_ADDRESS 0x5B8E39 /end MEASUREMENT
/begin MEASUREMENT ub_tmp "Batteriespannung (TMP)" UWORD spg_ubatt 1 100 0 24.021 FORMAT "%8.5" ECU_ADDRESS 0x5B8910 /end MEASUREMENT
/begin MEASUREMENT udknlp1 "Spannung DK-Poti 1 im NLP" UWORD spg_uw_q0p001222 1 100 0 80.0838 FORMAT "%8.5" ECU_ADDRESS 0x5B9084 /end MEASUREMENT
/begin MEASUREMENT udknlp1r "Dauer-RAM: Spannung DK-Poti 1 im NLP" UWORD spg_uw_q0p001222 1 100 0 80.0838 FORMAT "%8.5" ECU_ADDRESS 0x3FE932 /end MEASUREMENT
/begin MEASUREMENT udknlp2 "Spannung DK-Poti 2 im NLP" UWORD spg_uw_q0p001222 1 100 0 80.0838 FORMAT "%8.5" ECU_ADDRESS 0x5B9086 /end MEASUREMENT
/begin MEASUREMENT udknlp2r "Dauer-RAM: Spannung DK-Poti 2 im NLP" UWORD spg_uw_q0p001222 1 100 0 80.0838 FORMAT "%8.5" ECU_ADDRESS 0x3FE934 /end MEASUREMENT
/begin MEASUREMENT udkp1a "Spannung Drosselklappen-Poti 1 am (unteren) Anschlag" UBYTE spg_ub_b5 1 100 0 4.98047 FORMAT "%5.3" ECU_ADDRESS 0x5B8E3A /end MEASUREMENT
/begin MEASUREMENT udkp1aalt "temp. Spannung DK-Poti 1 am unteren DK-Anschlag" UWORD spg_uw_q0p001222 1 100 0 80.0838 FORMAT "%8.5" ECU_ADDRESS 0x5B9088 /end MEASUREMENT
/begin MEASUREMENT udkp1asr_w "Dauer-RAM: Spannung DK-Poti 1 am unteren DK-Anschlag, station‰rer Anteil" UWORD spg_uw_q0p001222 1 100 0 80.0838 FORMAT "%8.5" ECU_ADDRESS 0x3FE936 /end MEASUREMENT
/begin MEASUREMENT udkp1as_w "Spannung DK-Poti 1 am unteren Anschlag, station‰rer Anteil" UWORD spg_uw_q0p001222 1 100 0 80.0838 FORMAT "%8.5" ECU_ADDRESS 0x5B908A /end MEASUREMENT
/begin MEASUREMENT udkp1a_w "Spannung DK-Poti 1 am unteren Anschlag" UWORD spg_uw_q0p001222 1 100 0 80.0838 FORMAT "%8.5" ECU_ADDRESS 0x5B908C /end MEASUREMENT
/begin MEASUREMENT udkp1rob "realer DK-Poti-1-Wert am ob. Abgleichpkt." UWORD spg_uw_q0p00488 1 100 0 319.995 FORMAT "%8.4" ECU_ADDRESS 0x5B908E /end MEASUREMENT
/begin MEASUREMENT udkp1run "realer DK-Poti-1-Wert am unt. Abgleichpkt." UWORD spg_uw_q0p00488 1 100 0 319.995 FORMAT "%8.4" ECU_ADDRESS 0x5B9090 /end MEASUREMENT
/begin MEASUREMENT udkp1sv "Maximalwert DK-Poti 1 f¸r Verwendung des verst‰rkten Signals" UBYTE spg_ub_b5 1 100 0 4.98047 FORMAT "%5.3" ECU_ADDRESS 0x5B8E3B /end MEASUREMENT
/begin MEASUREMENT udkp1vor "Dauer-RAM: Spannungsoffset bei DK-Poti-1-Verst‰rkung" SWORD spg_sw_q0p001222 1 100 -40.0425 40.0413 FORMAT "%8.5" ECU_ADDRESS 0x3FE938 /end MEASUREMENT
/begin MEASUREMENT udkp1vou "Diagnose: 8 Bit Kopie von udkp1vo_w als Umweltgrˆﬂe" SBYTE spg_q0p00977 1 100 -1.25 1.24023 FORMAT "%5.3" ECU_ADDRESS 0x5B8633 /end MEASUREMENT
/begin MEASUREMENT udkp1vo_w "Spannungsoffset Verst‰rker DK-Poti 1" SWORD spg_sw_q0p001222 1 100 -40.0425 40.0413 FORMAT "%8.5" ECU_ADDRESS 0x5B9092 /end MEASUREMENT
/begin MEASUREMENT udkp1vrob "realer verst‰rkter DK-Poti-1-Wert am ob. Abgleichpkt." UWORD spg_uw_q0p00488 1 100 0 319.995 FORMAT "%8.4" ECU_ADDRESS 0x5B9094 /end MEASUREMENT
/begin MEASUREMENT udkp1vrun "realer verst‰rkter DK-Poti-1-Wert am unt. Abgleichpkt." UWORD spg_uw_q0p00488 1 100 0 319.995 FORMAT "%8.4" ECU_ADDRESS 0x5B9096 /end MEASUREMENT
/begin MEASUREMENT udkp1vv "Diagnose: 8 Bit Kopie von udkp1vv_w als Umweltgrˆﬂe" UBYTE spg_q0p03125 1 100 0 7.96875 FORMAT "%5.3" ECU_ADDRESS 0x5B8634 /end MEASUREMENT
/begin MEASUREMENT udkp1vvr "Dauer-RAM: Verst‰rkung bei DK-Poti-1-Verst‰rkung" UWORD fak_q0p0039 1 100 0 255.996 FORMAT "%8.4" ECU_ADDRESS 0x3FE93A /end MEASUREMENT
/begin MEASUREMENT udkp1vv_w "Verst‰rkung DK-Poti 1" UWORD fak_q0p0039 1 100 0 255.996 FORMAT "%8.4" ECU_ADDRESS 0x5B9098 /end MEASUREMENT
/begin MEASUREMENT udkp2a "Spannung Drosselklappen-Poti 2 am (unteren) Anschlag" UBYTE spg_ub_b5 1 100 0 4.98047 FORMAT "%5.3" ECU_ADDRESS 0x5B8E3C /end MEASUREMENT
/begin MEASUREMENT udkp2aalt "temp. Spannung DK-Poti 2 am unteren DK-Anschlag" UWORD spg_uw_q0p001222 1 100 0 80.0838 FORMAT "%8.5" ECU_ADDRESS 0x5B909A /end MEASUREMENT
/begin MEASUREMENT udkp2asr_w "Dauer-RAM: Spannung DK-Poti 2 am unteren DK-Anschlag, station‰rer Anteil" UWORD spg_uw_q0p001222 1 100 0 80.0838 FORMAT "%8.5" ECU_ADDRESS 0x3FE93C /end MEASUREMENT
/begin MEASUREMENT udkp2as_w "Spannung DK-Poti 2 am unteren Anschlag, station‰rer Anteil" UWORD spg_uw_q0p001222 1 100 0 80.0838 FORMAT "%8.5" ECU_ADDRESS 0x3FE93E /end MEASUREMENT
/begin MEASUREMENT udkp2a_w "Spannung DK-Poti 2 am unteren Anschlag" UWORD spg_uw_q0p001222 1 100 0 80.0838 FORMAT "%8.5" ECU_ADDRESS 0x5B909C /end MEASUREMENT
/begin MEASUREMENT udkpat_w "tempor‰rer UEA-Offset des DK-Poti" UWORD spg_uw_q0p001222 1 100 0 80.0838 FORMAT "%8.5" ECU_ADDRESS 0x5B909E /end MEASUREMENT
/begin MEASUREMENT uevges "‹bersetzungsverh‰ltnis gesamt" UBYTE fak_q0p1 1 100 0 25.5 FORMAT "%5.2" ECU_ADDRESS 0x5B8E71 /end MEASUREMENT
/begin MEASUREMENT uzkw_w "Kurbelwellen-Umdrehungsz‰hler" UWORD dez 1 100 0 65535 FORMAT "%8.2" ECU_ADDRESS 0x5B9730 /end MEASUREMENT
/begin MEASUREMENT vfzg_tmp "Fahrzeuggeschwindigkeit (TMP)" UWORD vfzg_ub_q1p25 1 100 0 318.75 FORMAT "%8.4" ECU_ADDRESS 0x5B8912 /end MEASUREMENT
/begin MEASUREMENT vvt_ib1_2 "Gesamtstrom VVT Bank1 bzw 4Zyl. und Bank2" UWORD i_vvt_ub_q0p50_om63p50 1 100 0 128 FORMAT "%8.4" ECU_ADDRESS 0x5B8914 /end MEASUREMENT
/begin MEASUREMENT vvt_iges "Strombedarf des gesamten VVT-Systems" UWORD i_vvt_q0p0625 1 100 0 192 FORMAT "%8.4" ECU_ADDRESS 0x5B8916 /end MEASUREMENT
/begin MEASUREMENT wdaacpat_l "" ULONG dez 1 100 0 4.29497e+009 FORMAT "%13.2" ECU_ADDRESS 0x3FDCB8 /end MEASUREMENT
/begin MEASUREMENT wdaoffdeb_u16 "" UWORD dez 1 100 0 65535 FORMAT "%8.2" ECU_ADDRESS 0x5B97B4 /end MEASUREMENT
/begin MEASUREMENT wdaondeb_u16 "" UWORD dez 1 100 0 65535 FORMAT "%8.2" ECU_ADDRESS 0x5B97B6 /end MEASUREMENT
/begin MEASUREMENT wdaovpat_l "" ULONG dez 1 100 0 4.29497e+009 FORMAT "%13.2" ECU_ADDRESS 0x3FDCBC /end MEASUREMENT
/begin MEASUREMENT wdastate_l "" ULONG dez 1 100 0 4.29497e+009 FORMAT "%13.2" ECU_ADDRESS 0x5B9B58 /end MEASUREMENT
/begin MEASUREMENT wdkada_w "Sollwert DK-Winkel, aus DV-E Adaption- und Pr¸ffunktion" UWORD relDK_uw_b100 1 100 0 100 FORMAT "%8.4" ECU_ADDRESS 0x5B90A0 /end MEASUREMENT
/begin MEASUREMENT wdknlp "Diagnose: 8 Bit Kopie von wdknlp_w als Umweltgrˆﬂe" UBYTE relDK_q0p3922 1 100 0 100 FORMAT "%5.1" ECU_ADDRESS 0x5B8635 /end MEASUREMENT
/begin MEASUREMENT wdknlpr "Diagnose: 8 Bit Kopie von wdknlpr_w als Umweltgrˆﬂe" UBYTE relDK_q0p3922 1 100 0 100 FORMAT "%5.1" ECU_ADDRESS 0x5B8636 /end MEASUREMENT
/begin MEASUREMENT wdknlpr_w "Dauer-RAM: Sollwert DK-Winkel in NLP-Stellung, bez. auf UMA" UWORD relDK_uw_b100 1 100 0 100 FORMAT "%8.4" ECU_ADDRESS 0x3FE940 /end MEASUREMENT
/begin MEASUREMENT wdknlp_w "DK-Winkel der Notluftposition" UWORD relDK_uw_b100 1 100 0 100 FORMAT "%8.4" ECU_ADDRESS 0x5B90A2 /end MEASUREMENT
/begin MEASUREMENT wdkvabob "DK-Sollwert f¸r oberen Abgleichpunkt" UWORD relDK_uw_b100 1 100 0 100 FORMAT "%8.4" ECU_ADDRESS 0x5B90A4 /end MEASUREMENT
/begin MEASUREMENT wdkvabub "DK-Sollwert f¸r unteren Abgleichpunkt" UWORD relDK_uw_b100 1 100 0 100 FORMAT "%8.4" ECU_ADDRESS 0x5B90A6 /end MEASUREMENT
/begin MEASUREMENT wkwalerr_w "unkorrigierter Auslaufwinkel" SWORD kw_q0p1 1 100 -3276.8 3276.7 FORMAT "%8.3" ECU_ADDRESS 0x5B9562 /end MEASUREMENT
/begin MEASUREMENT wkwale_w "Kurbelwellenwinkel im Arbeitsspiel ohne L¸ckenkorrektur" SWORD kw_q0p1 1 100 -720 1440 FORMAT "%8.3" ECU_ADDRESS 0x5B9564 /end MEASUREMENT
/begin MEASUREMENT wkwalkor_w "Winkel inklusive L¸cke bei Start ALE" UWORD kw_q0p1 1 100 0 720 FORMAT "%8.4" ECU_ADDRESS 0x5B9566 /end MEASUREMENT
/begin MEASUREMENT wkwalold_w "Kurbelwinkel zum Zeitpunkt B_ale  = 1" SWORD kw_q0p1 1 100 -3276.8 3276.7 FORMAT "%8.3" ECU_ADDRESS 0x5B9568 /end MEASUREMENT
/begin MEASUREMENT wkwaskor_w "korrigierter Auslaufwinkel" SWORD kw_q0p1 1 100 -3276.8 3276.7 FORMAT "%8.3" ECU_ADDRESS 0x5B956A /end MEASUREMENT
/begin MEASUREMENT wkwrale_w "Winkel Kurbelwelle beim ersten r¸ckdrehenden Zahn (word)" SWORD kw_q0p1 1 100 -720 1440 FORMAT "%8.3" ECU_ADDRESS 0x5B956C /end MEASUREMENT
/begin MEASUREMENT wkwstop_w "Motorabstellposition im Arbeitsspiel mit L¸ckenkorrektur" UWORD kw_q0p1 1 100 0 1000 FORMAT "%8.3" ECU_ADDRESS 0x3FDB96 /end MEASUREMENT
/begin MEASUREMENT znostend "Anzahl Z¸ndung=ein ohne Erreichen von Startende" UBYTE dez 1 100 0 255 FORMAT "%5.1" ECU_ADDRESS 0x3FDD05 /end MEASUREMENT
/begin MEASUREMENT zwmatm "Z‰hler f¸r ATM-Wiederholstart und Faktor f¸r W‰rmemengen-Schwellen" UBYTE dez 1 100 0 255 FORMAT "%5.1" ECU_ADDRESS 0x3FDBA3 /end MEASUREMENT
/begin MEASUREMENT zwmatmf "Z‰hler f¸r ATM-Wiederholstart und Faktor f¸r W‰rmemengen-Schwellwert upstream" UBYTE dez 1 100 0 255 FORMAT "%5.1" ECU_ADDRESS 0x3FDBA4 /end MEASUREMENT
/begin FUNCTION ABKVP "Ansteuerung Bremskraftverst‰rker-Pumpe" /begin DEF_CHARACTERISTIC TDBKVSTEND TDDEDBKVP UBSQBKVMN UBSQBKVMX /end DEF_CHARACTERISTIC /begin IN_MEASUREMENT B_avset B_bkvpa B_brems B_btavs B_cdbkvp B_pwf tnst_w ubsq /end IN_MEASUREMENT /begin OUT_MEASUREMENT B_bkvp /end OUT_MEASUREMENT /begin LOC_MEASUREMENT B_fbkvpa /end LOC_MEASUREMENT /end FUNCTION
/begin FUNCTION ADVE "Ansteuerung der DV-E mit dem DLR" /begin DEF_CHARACTERISTIC CWDKNOLU /end DEF_CHARACTERISTIC /begin REF_CHARACTERISTIC DLRHAFTMN DLRININI DLRKREIS DLRUBSOLL /end REF_CHARACTERISTIC
 /begin IN_MEASUREMENT B_dlrbe B_dlrpide B_dveese B_kl15 B_lrnrdy B_nldve B_st B_wdk1v B_wdksive dklagerc dlrhaftak dlrini_w dlrpidc dlrubrsq dveesc nmot ubdedis ubdeen /end IN_MEASUREMENT
 /begin OUT_MEASUREMENT B_apnoluv B_appnolu /end OUT_MEASUREMENT
/end FUNCTION
/begin FUNCTION AEKP "Ausgabe EKP-Ansteuerung" /begin DEF_CHARACTERISTIC TAPVLTM TNLEKPVL TPVL TZMIN UBSTS ZNOSTMX /end DEF_CHARACTERISTIC
 /begin IN_MEASUREMENT B_airbag B_nachlend B_nmin B_st B_stend B_uhrrsec swOffDlBits tabst_w tmotab tnachl_w ub /end IN_MEASUREMENT
 /begin OUT_MEASUREMENT B_ekp /end OUT_MEASUREMENT
 /begin LOC_MEASUREMENT AEKPintbits B_ekpd B_ekpn B_ekpubn B_ekpvl B_pvl1 B_pvl2 B_pvlnl B_tpvl dekpub lokBits_Aekp znostend /end LOC_MEASUREMENT
/end FUNCTION
/begin FUNCTION AEVAB "Ausgabe Einspritzung Ev-Ausblendung" /begin DEF_CHARACTERISTIC CWEVAB REDABM /end DEF_CHARACTERISTIC
 /begin IN_MEASUREMENT anzeausb B_dkuevab B_faevz B_phsnl devoff flgstinj_w flgtiab redsol zyleausb zzyl /end IN_MEASUREMENT
 /begin OUT_MEASUREMENT abmf B_dmdstop B_nlphea eevx evz_aus fevab stateaevab /end OUT_MEASUREMENT
 /begin LOC_MEASUREMENT anzeab B_fophsnl B_frdph B_nlpheai dmdevab evrbgn_one fevabe redsolr redsol_one tvrnr /end LOC_MEASUREMENT
/end FUNCTION
/begin FUNCTION AEVABU "Ausgabe EV-Abschaltung durch ‹berwachungsfunktionen bei EGAS" /begin DEF_CHARACTERISTIC NMXSKA /end DEF_CHARACTERISTIC /begin IN_MEASUREMENT B_dknolu B_dkpu B_i_ska_um B_nmaxd nmot /end IN_MEASUREMENT /begin OUT_MEASUREMENT B_dkuevab B_evabu /end OUT_MEASUREMENT /begin LOC_MEASUREMENT B_skaevab /end LOC_MEASUREMENT /end FUNCTION
/begin FUNCTION AEVABZK "Ausgabe Ev-Abschaltung %MDRED + Komplettabschaltung durch ‹berwachungsfunktionen" /begin IN_MEASUREMENT B_ausc_act B_dmdstop B_dveada B_evabu B_nlph evz_aus /end IN_MEASUREMENT /begin OUT_MEASUREMENT B_evasel evz_austot /end OUT_MEASUREMENT /end FUNCTION
/begin FUNCTION ALE "ALE.exportedAuslauferkennung"
 /begin DEF_CHARACTERISTIC AWALEMX GAP_TOOTH KLALETM NALEMIN RALEMAX RDUNDEF W360_ALE_IMPL W720_ALE_IMPL /end DEF_CHARACTERISTIC
 /begin REF_CHARACTERISTIC CWALE /end REF_CHARACTERISTIC
 /begin IN_MEASUREMENT B_bm B_nlale B_nldg B_nmot B_phsnlinv B_pwf B_stend B_zprel nmot_w tmot /end IN_MEASUREMENT
 /begin OUT_MEASUREMENT ALEBits1_10msSwOff ALEBits_10msSwOff ALEBits_tooth_int B_ale B_aleundef wkwstop_w /end OUT_MEASUREMENT
 /begin LOC_MEASUREMENT B_alechk B_enabale B_enabint B_engstop B_ralectr B_raleok B_rrdet B_strtint B_strtswof B_undef CO_GAP CO_WAS CO_WNBM ottstamp_l temp_klt_l temp_tn1_l temp_tn2_l temp_tn_l temp_w1 temp_w2 temp_w3 temp_w4 tooth10ms toothtim_l ttstamp_l ttstmpmx_l wkwalerr_w wkwale_w wkwalkor_w wkwalold_w wkwaskor_w wkwrale_w /end LOC_MEASUREMENT
/end FUNCTION
/begin FUNCTION AMUENE "Abspeicherung von Motor¸berdrehzahlereignissen" /begin DEF_CHARACTERISTIC NUEMAX /end DEF_CHARACTERISTIC /begin IN_MEASUREMENT B_eemrdy B_eepwf kmstand nmot_w /end IN_MEASUREMENT /begin OUT_MEASUREMENT anznmax kmstnmax nmaxvk_w /end OUT_MEASUREMENT /end FUNCTION
/begin FUNCTION ARMD "Momentenbasierte Antiruckelfunktion"
 /begin DEF_CHARACTERISTIC A0 A1 A2 B1 B2 CWARMD DNFILO DVFZAR FLRAG FLRAWG FLRHG FRARAG FRARAWG FRARHG KFDMDARO KFDMDARU KIFZGAG KIFZGAWG KIFZGHG NARAO NARASTG NARLL NDFILOG NDIFFOG NVG NVMNG NVMXG SMK08MDSW TAREIN TMAR TMLAST TVARDASHG TVARKUPPLG TVARLSDG TVARS TVKUPAR TVKUPHS TVKUPRS TZSPINI VARAU WPEDU /end DEF_CHARACTERISTIC
 /begin REF_CHARACTERISTIC SGA08MDUB /end REF_CHARACTERISTIC
 /begin IN_MEASUREMENT B_autget B_brems B_dash B_gwhs B_kuppl B_kupplmod B_ll B_lsd B_mdein B_sa B_stend B_wk esst_sga08mdub gangi mdverl_w mifa_w misolv_w nmot nmot_w nvquot_w tmot vfzg vfzg_w wped_w /end IN_MEASUREMENT
 /begin OUT_MEASUREMENT B_ar dmar_w esst_smk08mdsw nmotk1_w nmotk2_w tmlastz tnmst1z tnmst2z /end OUT_MEASUREMENT
 /begin LOC_MEASUREMENT B_aren B_argf B_gfen B_hpnmot B_iniar B_iniar1 B_iniarv B_kupgw B_kupplar B_tpnmot fdar flrar kifz_w mdbes_w mkar_w mlast_w ndar_w ndfibet_w ndfil_w ndiffog_w ndiff_w nmodiv_w nmod_w tzarni /end LOC_MEASUREMENT
/end FUNCTION
/begin FUNCTION ATD "Ansteuerung TD-Signal (segmentsynchron)" /end FUNCTION
/begin FUNCTION ATEV "Ansteuerung Tankentl¸ftungsventil (Periodendauer)" /begin DEF_CHARACTERISTIC KFTEVP KFTVTEV TATEGRDO TATEGRDU TEVPMN1 TEVPMN2 TMNTEVZU /end DEF_CHARACTERISTIC /begin REF_CHARACTERISTIC CWTEACFG FMTEVEIN /end REF_CHARACTERISTIC
 /begin IN_MEASUREMENT B_dtes B_evloc B_tevcheck B_tevtini dpssol_w dps_uw dps_w msteo_w mstesoll_w nmot pu tadtea tans tefreq ub ub_w /end IN_MEASUREMENT
 /begin OUT_MEASUREMENT B_tevtstp tateist tateout tatesoll tevper ttevein /end OUT_MEASUREMENT
 /begin LOC_MEASUREMENT kftevp tatemxfq tateroh tteveroh tvtevptu /end LOC_MEASUREMENT
/end FUNCTION
/begin FUNCTION ATM "Abgastemperaturmodell"
 /begin DEF_CHARACTERISTIC ATMTANS DTUMTAT FATMRML FATMVM FWMABGW FWMKATW IMTUMTAT KATMEXML KATMIEXML KFATMABKA KFATMABKK KFATMLA KFATMZW KFTATM KFWMABG KFWMKAT KLATMILAE KLATMIZWE KLATMLAE KLATMZWE NTUMTAT SMT06TMUW STS06TMUW STU05TMUB TABGMEX TASTBFA TATMKH TATMKW TATMSA TATMSAE TATMSTI TATMTMOT TATMTP TATMTRKH TATMWMK TIKATMOE TKATMOE TKSTBFA TNLATM TNLATMTM TNLATMTU TUMTAIT VTUMTAT WMABGKH WMKATKH ZATMAML ZATMIKML ZATMKML ZATMRML /end DEF_CHARACTERISTIC
 /begin REF_CHARACTERISTIC SEZ06TMUB SLX06TMUW SML06TMUW SML07TMUW ST107TMUB ST307TMUB STM05TMUB /end REF_CHARACTERISTIC
 /begin IN_MEASUREMENT B_bktum B_faatm B_kh B_kw B_nachlend B_nlatm B_nmot B_pwf B_sa B_st B_stend B_tfu B_trkh B_uhrrmin B_uhrrsec esst_sez06tmub esst_slx06tmuw esst_sml06tmuw esst_sml07tmuw esst_st107tmub esst_st307tmub esst_stm05tmub etazwist lamsbg_w lamsons_w ml ml_w nmot rl tabst_w tans tmot tmst tumg vfzg /end IN_MEASUREMENT
 /begin OUT_MEASUREMENT ATMbits B_atmtpa B_atmtpf B_atmtpk B_atmtpl esst_smt06tmuw esst_sts06tmuw esst_stu05tmub etazwimt imlatm imlatm_w iwmatm_w tabgm tabgmab tabgmst tabgm_w tatu tikatm tikatm_w tkatm tkatmab tkatmst tkatm_w zwmatm zwmatmf /end OUT_MEASUREMENT
 /begin LOC_MEASUREMENT ATMbits1 B_atmst B_stndnl tabstatm_w tabstmx_w tatmaml tatmkf tatmrml tatmsta texkor texml texoikm_w texom_w tiexkor tiexml /end LOC_MEASUREMENT
/end FUNCTION
/begin FUNCTION BBACC "BBACC.    Ein.- und Ausschaltbedingungen ACC (Adaptiv Cruise Control)"
 /begin IN_MEASUREMENT B_fgrai B_fgral B_fgras B_fgren B_fgrkf B_fgrtbe B_fgrtve B_tpdn B_tpup B_wiauf /end IN_MEASUREMENT
 /begin OUT_MEASUREMENT B_mflai B_mflal B_mflar B_mflas B_mflen fgr_stat /end OUT_MEASUREMENT
/end FUNCTION
/begin FUNCTION BBBO "Betriebsbereich Erkennung Benzin im ÷l" /begin DEF_CHARACTERISTIC ABOLRAR ABOMX IMLKS TMSKS /end DEF_CHARACTERISTIC /begin IN_MEASUREMENT B_clradbbo B_pwf B_stend ml_w tmst /end IN_MEASUREMENT /begin OUT_MEASUREMENT abo B_abor imlbbo imlbbo_w /end OUT_MEASUREMENT /end FUNCTION
/begin FUNCTION BBFEWNE "Aufbereitung der Fehlermeldungen des Hardwaretreibers von KW u. NW" /begin IN_MEASUREMENT B_bm B_nmot inisynmon zzyl /end IN_MEASUREMENT
 /begin OUT_MEASUREMENT bmlosctr_w B_fbm B_nocampos B_outofsyn erdrcamctr erdrrevctr erdrsynctr tmcorctr_w tpcorctr_w uzkw_w /end OUT_MEASUREMENT
/end FUNCTION
/begin FUNCTION BBFGR "Ein- und Ausschaltbedingungen Fahrgeschwindigkeitsregler"
 /begin DEF_CHARACTERISTIC BFGRO BFGRU CWBBFGR CWBFGROF DVAQUGMX DVAQUKMX DVFGREO DVFGREU DVIVZMX DVZVIMX GAFGRO GAFGRU NFGRMAX TDVIVZ TDVZVI TFGRAQU TFGRASCOF TFGRBREOF TFGRDSCOF TFGRUEOB TFGRUM TFGRUNUB VBGFGRAQ VFGRMAX VFGRMIN VREGLMAX VREGLMIN /end DEF_CHARACTERISTIC
 /begin REF_CHARACTERISTIC TFGRARLG /end REF_CHARACTERISTIC
 /begin IN_MEASUREMENT bfzglfgr B_acc B_asc_reg B_asr B_asrext B_brems B_dknolu B_dknot B_dkpiu B_dsc_reg B_evfzgv1 B_fgr B_fgrabz B_fgrat B_fgren B_fgrhe B_fgrhsa B_fgrkf B_fgrtbe B_fgrtse B_fgrtve B_fgrtwa B_fgr_um B_gwhs B_hdc B_kuppl B_lowra B_msrext B_pwgnotfr gangi nmot vfgrrf_w vfgr_w vziel_w /end IN_MEASUREMENT
 /begin OUT_MEASUREMENT B_fgrab B_fgrai B_fgral B_fgras B_fgrenv B_fgresv /end OUT_MEASUREMENT
 /begin LOC_MEASUREMENT BBFGRlokBits B_fgraext B_fgrars B_fgres /end LOC_MEASUREMENT
/end FUNCTION
/begin FUNCTION BBGANG "Betriebsbereich Gang"
 /begin DEF_CHARACTERISTIC IGESGA NGANGMIN NVQUOT1O NVQUOT1U NVQUOT2O NVQUOT2U NVQUOT3O NVQUOT3U NVQUOT4O NVQUOT4U NVQUOT5O NVQUOT5U NVQUOT6O NVQUOT6U /end DEF_CHARACTERISTIC
 /begin IN_MEASUREMENT B_autget B_vnull gangauti nmot_w vfzg_w /end IN_MEASUREMENT
 /begin OUT_MEASUREMENT B_gwhs gangi nvquot_w uevges /end OUT_MEASUREMENT
/end FUNCTION
/begin FUNCTION BBHWONOF "Betriebsbereich SG HW Startup und abschalten" /begin DEF_CHARACTERISTIC CWNVRAMBK /end DEF_CHARACTERISTIC /begin REF_CHARACTERISTIC CWPWF /end REF_CHARACTERISTIC /begin IN_MEASUREMENT B_wdapwf /end IN_MEASUREMENT
 /begin OUT_MEASUREMENT B_eepwf B_hwpwf B_pwf B_pwfPat B_restore B_restoreok eeeExitStatus /end OUT_MEASUREMENT
/end FUNCTION
/begin FUNCTION BBKD "Berechnung der Kick-Down-Information" /begin DEF_CHARACTERISTIC UPWGKDO UPWGKDU WPKDMN /end DEF_CHARACTERISTIC /begin IN_MEASUREMENT B_pwgnotfr upwgej_w wped_w /end IN_MEASUREMENT /begin OUT_MEASUREMENT B_kd /end OUT_MEASUREMENT /end FUNCTION
/begin FUNCTION BBKHZ "Betriebsbereich motorisches Katheizen"
 /begin DEF_CHARACTERISTIC BTRKHTMS CWKHZ DTKATMN DTKH DTMABKH FHOKH FKHABMN FKHLA FKHMD FNSKHLL FTMLAKH IMLATWS IMLKHTMS KFNFSKHM KFNLLKHM KLIMLKHKM KLTKHKM KTNDMRKH MLKHMX MLSUS NLLKT TABSTKH TABSTKHX TKATMN TKATW TKHABB TKHFSAB TKHLL TKHLLAB TKHLLMX TKHNAB TMSLOF TNSDMRKH ZKHABB ZKLAMKH /end DEF_CHARACTERISTIC
 /begin REF_CHARACTERISTIC SFR04BBUW STM08BBUB /end REF_CHARACTERISTIC
 /begin IN_MEASUREMENT B_bkvleer B_dsla B_fa B_fasla B_fs B_hag B_katfz B_ll B_lmsslof B_msloff B_nmot B_pwf B_slkhof B_slpoff B_slsfz B_st B_stend B_wst esst_sfr04bbuw esst_stm08bbub fho_w frhol_w imlatm_w kmstand ml tabst_w tans tkatm tmot tmotab tmst tnst_w /end IN_MEASUREMENT
 /begin OUT_MEASUREMENT B_kh B_kha B_khab B_khn B_khno B_kw B_trkh fhost_w fkhab fkhnab flakh flamkh fmdkh imlpr imlpr_w nfskh nllkh /end OUT_MEASUREMENT
 /begin LOC_MEASUREMENT BBKHZlokBits B_imlprini B_khares B_khaset B_kherr B_khll B_khlle B_khllmx B_khres B_khset B_khstc B_mlsu fmdkhtns_w imlatmw_w mlsu tanskhst tkhnab_ctr /end LOC_MEASUREMENT
/end FUNCTION
/begin FUNCTION BBLOWBAT "Betriebsbereich Spannungseinbruch unter 5V" /begin OUT_MEASUREMENT res5vctr_w res5vsta_l res5vsts_l tirq1ofd_w /end OUT_MEASUREMENT /end FUNCTION
/begin FUNCTION BBPEDBR "Plausibilisierung Fahrpedalwert/Bremspedal; Dokumentation" /begin DEF_CHARACTERISTIC TWPEDBR WPEDFMX /end DEF_CHARACTERISTIC /begin IN_MEASUREMENT B_bl B_br B_eemrdy B_eepwf B_nmot kmstand wped_w /end IN_MEASUREMENT /begin OUT_MEASUREMENT anzpbr_w kmstpbr_w /end OUT_MEASUREMENT /end FUNCTION
/begin FUNCTION BBRCVRY "System Recovery nach Reset" /begin OUT_MEASUREMENT B_wdapwf recRes5vSt recWDASt /end OUT_MEASUREMENT /end FUNCTION
/begin FUNCTION BBSAWE "Betriebsbereich Schubabschalten/Wiedereinsetzen"
 /begin DEF_CHARACTERISTIC DNSAH DNSAL DNSLL DNVSA DNWEK DVSA ENASAG KFTVSA KFTVSAM NGDNSA NWEM NWEMT NWENG TKATSAN TVSATM VSAA /end DEF_CHARACTERISTIC
 /begin REF_CHARACTERISTIC SNM08__UB STM05SAUB /end REF_CHARACTERISTIC
 /begin IN_MEASUREMENT B_cvt B_dash B_dsls B_falls B_kh B_koe B_kuppl B_ll B_llrein B_sacvt B_savfgr B_stend dpsfak esst_snm08__ub esst_stm05saub gangi ngfil nmot tkatm tmot tmst vfzg /end IN_MEASUREMENT
 /begin OUT_MEASUREMENT B_sab nsa nwe nwem_out /end OUT_MEASUREMENT
 /begin LOC_MEASUREMENT BBSAWElokbits B_dnsll B_sabt dnsa /end LOC_MEASUREMENT
/end FUNCTION
/begin FUNCTION BBSTT "Betriebsbereich: Start" /begin DEF_CHARACTERISTIC NNSTA NSTNM /end DEF_CHARACTERISTIC /begin IN_MEASUREMENT B_nmot nmot tans tmot /end IN_MEASUREMENT /begin OUT_MEASUREMENT B_st B_stend tnse_w tnst_w /end OUT_MEASUREMENT /end FUNCTION
/begin FUNCTION BBSYSCON "Betriebsbereich Systemzustandssteuerung" /begin IN_MEASUREMENT B_nachl S_kl15 /end IN_MEASUREMENT
 /begin OUT_MEASUREMENT AS_hr AS_nl AS_psoff B_hr B_kl15 B_nachlauf B_nloff B_norm B_wakeup /end OUT_MEASUREMENT
/end FUNCTION
/begin FUNCTION BBTEGA "Phasensteuerung f¸r Tankentl¸ftung und Gemischadaption"
 /begin DEF_CHARACTERISTIC DFTEDS DMRFATE FMRFAZTE FTEADZU FTEDS MRFABNTE TATELL TMSKLH TMSNOGA TTE TTEAE TTEBSTP TTEGA TTEGAI TTEGAIH TTEGAZO TTEGAZU TTEINI TTEMN TTEPRIO TTEZAO TTEZAU ZMRFABN /end DEF_CHARACTERISTIC
 /begin IN_MEASUREMENT B_dktb B_dldpte B_dmmtev B_dmtltz B_dtes B_edkvs B_frao B_gae B_gaefra B_gasp B_grdst B_ll B_lr B_nmot B_te B_teabb B_tehbx B_teza ftead_w mrfa_w nmot tans tmst tnse_w /end IN_MEASUREMENT
 /begin OUT_MEASUREMENT B_fraoan B_gap B_nftev B_tep /end OUT_MEASUREMENT
 /begin LOC_MEASUREMENT B_tedtev B_tehbxf B_tepi B_tepzhl B_tepzus B_tesstp B_testop B_tezstp B_tteae B_ttegais dmrfabn_w mrfabn mrfabnf tephc /end LOC_MEASUREMENT
/end FUNCTION
/begin FUNCTION BBVL "Betriebsbereich Vollast" /begin DEF_CHARACTERISTIC MIFAVLN MIFAVLNHYS MRFAVLN MRFAVLNHYS WDKVLN WDKVLNHYS /end DEF_CHARACTERISTIC
 /begin IN_MEASUREMENT B_dkunb B_ll B_mibeg B_mrfavl B_temxon milsol_w mimax_w mrfa_w nmot_w rlvugd rlvw_w wdkba_w /end IN_MEASUREMENT
 /begin OUT_MEASUREMENT B_vl milmxvl_w rlvwvugd_w /end OUT_MEASUREMENT
 /begin LOC_MEASUREMENT B_vlb B_vlmi /end LOC_MEASUREMENT
/end FUNCTION
/begin FUNCTION BBWDA "Betriebsbereich WDA-Abschaltung" /begin IN_MEASUREMENT B_ausc_act umerr_c_um /end IN_MEASUREMENT
 /begin OUT_MEASUREMENT wdaacpat_l wdaoffdeb_u16 wdaondeb_u16 wdaovpat_l wdastate_l /end OUT_MEASUREMENT
/end FUNCTION
/begin FUNCTION BBZMS "Betriebsbereich ZMS-Schutz" /begin DEF_CHARACTERISTIC NZMSE NZMSMN NZMSMX TVZMSE TZMSAS TZMSST /end DEF_CHARACTERISTIC /begin IN_MEASUREMENT B_stend nmot_w /end IN_MEASUREMENT /begin OUT_MEASUREMENT B_utzms B_zms B_zmse B_zmsoff /end OUT_MEASUREMENT /begin LOC_MEASUREMENT tzms_w /end LOC_MEASUREMENT /end FUNCTION
/begin FUNCTION BGBN "Berechnete Grˆﬂe Bordnetzversorgung" /begin IN_MEASUREMENT B_airbag /end IN_MEASUREMENT /begin OUT_MEASUREMENT BGBNausbits0 B_bvhfm B_bvhls /end OUT_MEASUREMENT /end FUNCTION
/begin FUNCTION BGCRENG "BGCRENG.  Berechnete Grˆﬂe Strombedarf Motor" /begin DEF_CHARACTERISTIC CRENGOF CRVVTNOT CRVVTOF KFELUPWM KLELSLP KLELTEMP KLELUB /end DEF_CHARACTERISTIC /begin IN_MEASUREMENT B_kl15 B_masterhw B_slp taml tans ub vfzg vvt_es vvt_es2 /end IN_MEASUREMENT
 /begin OUT_MEASUREMENT fakttansel faktubel i_eluefter i_elupwm i_elu_vvt i_slp st_craweng taml_tmp tans_tmp ub_tmp vfzg_tmp vvt_ib1_2 vvt_iges /end OUT_MEASUREMENT
 /begin LOC_MEASUREMENT i_eluvfzg /end LOC_MEASUREMENT
/end FUNCTION
/begin FUNCTION BGCVN "Berechnete Grˆﬂe Calibration Verification Number CVN" /begin IN_MEASUREMENT B_m9cvn /end IN_MEASUREMENT
 /begin OUT_MEASUREMENT B_cksbrdy B_cksbrdy2 CALIBID1 CALIBID2 cvn cvn2 kryptoCounter /end OUT_MEASUREMENT
/end FUNCTION
/begin FUNCTION BGDETX "Kundenspez. Fehlerart-Erweiterungs-Byte (Status Diagnosefunktion)" /begin REF_CHARACTERISTIC TADHMNH TADHMXH UBDLS UBDLSMX /end REF_CHARACTERISTIC
 /begin IN_MEASUREMENT B_atmtpk B_cdhsh B_cdhsv B_cdhsvsa B_cdkatsp B_cdkvs B_cdlash B_cdlatp B_cdlatv B_cdlsh B_cdlsv B_cdsls B_cdtes B_cwdslt B_dktb B_dktsbs B_dkvsf B_dshen B_dsl2e B_dslerr B_dslo B_dsloab B_dsls B_dtebel B_dtebn B_elsu B_elsuv B_fakat B_fasla B_fates B_fprakt B_fprovb B_fprzvb B_frao B_frau B_hsv B_lra B_lrnakt B_lrnvb B_lrs B_lsastp B_nmot B_nofra B_norkat B_norkaz B_rinh B_rkat B_rkaz B_slsfz B_stend tahsom_w ub /end IN_MEASUREMENT
 /begin OUT_MEASUREMENT etxdvef etxdvefo etxdven etxdveu etxdveuw etxdvev etxfrao etxfrau etxhsh etxhsv etxhsvsa etxkatsp etxlash etxlatp etxlatv etxlsh etxlsv etxrkat etxrkaz etxsls etxslv etxtes /end OUT_MEASUREMENT
/end FUNCTION
/begin FUNCTION BGDVE "Grˆﬂen f¸r DV-E-Ansteuerung aus Lern- und Pr¸froutinen"
 /begin DEF_CHARACTERISTIC CWDVEFO DKPSTGMIN DLRPIDSTMN DUDKNLPO DUDKNLPU DUDKPTMP FPRAT FPRMT FPRNMAX FPRTIM1_T FPRTIM2_T FPRTIM3_T FPRTIM4_T LRNST1_T LRNST3_T LRNST7_T LRNST9_T LRNVB_T NLPST1T NLPST2T TDKNACH TDLRPIDMX TMSUTMUMA TTMUMASTA UANAUFRP UANNMAX UANPEDMAX UANPIDMIN UANPIDMINA UANUATS UANVFZG UANZURP UAN_O_MT UAN_STORE UAN_U_MT UB_UANL UDKNLP1N UDKNLP2N UDKP1AMAX UDKP1AMIN UDKP1AURI UDKP1DUS UDKP1NHUB UDKP1VID UDKP1VOMA UDKP1VOMI UDKP1VVMA UDKP1VVMI UDKP2AMAX UDKP2AMIN UDKP2AURI UDKPALOS UDKPAOFF UDKPATMX UPVGNENN WDKFPRO2 WDKFPROO WDKFPROU WDKFPRZ1 WDKFPRZ2 WDKNLPMA WDKNLPMI WDKNPLAUS WDKNSTORE WDKSFPR WDKSFPRO WDKSTMUMA /end DEF_CHARACTERISTIC
 /begin REF_CHARACTERISTIC DUDKP1HY /end REF_CHARACTERISTIC
 /begin IN_MEASUREMENT B_dcdisfr B_dknolu B_dknot B_dkp1e B_dkp2e B_dkpiu B_dlrspid B_dvete B_eemrdy B_eepwf B_i_ska_um B_lrndia B_stend B_ubdve B_wdk2sel dlrspid_w nmotll tans tmot ub ubrsq udkp1v_w udkp1_w udkp2_w vfzg wdkba_w wdks_w wped /end IN_MEASUREMENT
 /begin OUT_MEASUREMENT B_abgle B_dcdisr B_dkaden B_dknach B_dlrien B_dveada B_dvetv B_ESrdy B_fprakt B_fproab B_fproe B_fprook B_fprordy B_fprovb B_fprrdy B_fprzab B_fprze B_fprzok B_fprzvb B_lrnakt B_lrnerf B_lrnfg B_lrnrdy B_lrnvb B_lrnws B_nlpe B_nlperf B_nlpnew B_umae B_umauab dkpstg_w dlrmxt dveadchst fprstep_c lrnstat lrnstep_c tdknach_w tloop_w tmpumast ttmumad_w ubuanlr udknlp1 udknlp2 udkp1a udkp1asr_w udkp1as_w udkp1a_w udkp1sv udkp1vou udkp1vo_w udkp1vv udkp1vv_w udkp2a udkp2asr_w udkp2as_w udkp2a_w udkpat_w wdkada_w wdknlp wdknlpr wdknlpr_w wdknlp_w /end OUT_MEASUREMENT
 /begin LOC_MEASUREMENT BGDVEintbits B_lrntesa B_nlpreq fprtim_c lrntim_c lrnvb_c nlp1tim udknlp1r udknlp2r udkp1aalt udkp1rob udkp1run udkp1vor udkp1vrob udkp1vrun udkp1vvr udkp2aalt wdkvabob wdkvabub /end LOC_MEASUREMENT
/end FUNCTION
/begin FUNCTION BGEVAB "Berechnung der tats‰chlichen Reduzierstufe durch EV-Abschaltung" /begin IN_MEASUREMENT abmf evz_austot stateaevab zzbank /end IN_MEASUREMENT /begin OUT_MEASUREMENT B_bevab B_evakt B_evloc redbas redist redistb1 /end OUT_MEASUREMENT /end FUNCTION
/begin FUNCTION BGFDCAN "Berechnete Grˆsse Freigabe CAN-Diagnose" /begin DEF_CHARACTERISTIC TNKL15DC UBDCAN /end DEF_CHARACTERISTIC /begin IN_MEASUREMENT B_cdiagoff B_kl15 ub /end IN_MEASUREMENT /begin OUT_MEASUREMENT B_fgdcan /end OUT_MEASUREMENT /end FUNCTION
/begin FUNCTION BGFKEZ "Berechnete Grˆﬂe zylinderidividuelle Faktoren zur Kraftstoffkorrektur"
 /begin DEF_CHARACTERISTIC FKEEV0N FKEEV1N FKEEV2N FKEEV3N FKEEV4N FKEEV5N FKEEV6N FKEEV7N /end DEF_CHARACTERISTIC
 /begin REF_CHARACTERISTIC SNM08GKUB /end REF_CHARACTERISTIC
 /begin IN_MEASUREMENT esst_snm08gkub nmot /end IN_MEASUREMENT
 /begin OUT_MEASUREMENT fkez /end OUT_MEASUREMENT
/end FUNCTION
/begin FUNCTION BGKMST "Berechnete Grˆﬂe: Kilometerstand" /begin IN_MEASUREMENT B_ins2cok B_kmmil B_pwf fcmEnd FCMTab kmstand vfzg_u /end IN_MEASUREMENT /begin OUT_MEASUREMENT kmstmil_w kmst_w /end OUT_MEASUREMENT /end FUNCTION
/begin COMPU_METHOD bfzg_sb_q0p217 "" RAT_FUNC "%6.3" "m/s^2" COEFFS 0 1 0 0 0 0.217 /end COMPU_METHOD
/begin COMPU_METHOD B_TRUE "boolsche Zust‰nde, positive Logik" TAB_VERB "%6.3" "" COMPU_TAB_REF B_TRUE /end COMPU_METHOD
/begin COMPU_VTAB B_TRUE "boolsche Zust‰nde, positive Logik" TAB_VERB 2 0 "----" 1 "TRUE" /end COMPU_VTAB
/begin COMPU_METHOD DEZ "1 : 1 Umrechnug (dez/hex)" RAT_FUNC "%6.2" "" COEFFS 0 1 0 0 0 1 /end COMPU_METHOD
/begin COMPU_METHOD dez "1 : 1 Umrechnug (dez/hex)" RAT_FUNC "%6.2" "" COEFFS 0 1 0 0 0 1 /end COMPU_METHOD
/begin COMPU_METHOD fak_q0p0039 "" RAT_FUNC "%6.4" "-" COEFFS 0 256 0 0 0 1 /end COMPU_METHOD
/begin COMPU_METHOD fak_q0p1 "" RAT_FUNC "%6.3" "-" COEFFS 0 1 0 0 0 0.1 /end COMPU_METHOD
/begin COMPU_METHOD fak_sw_b0p0625 "" RAT_FUNC "%8.7" "-" COEFFS 0 65536 0 0 0 0.125 /end COMPU_METHOD
/begin COMPU_METHOD fak_sw_b2 "" RAT_FUNC "%7.6" "-" COEFFS 0 65536 0 0 0 4 /end COMPU_METHOD
/begin COMPU_METHOD fak_sw_b64 "" RAT_FUNC "%6.4" "-" COEFFS 0 65536 0 0 0 128 /end COMPU_METHOD
/begin COMPU_METHOD fak_ub_b1 "" RAT_FUNC "%6.4" "-" COEFFS 0 256 0 0 0 1 /end COMPU_METHOD
/begin COMPU_METHOD fak_ub_b16 "" RAT_FUNC "%6.4" "-" COEFFS 0 256 0 0 0 16 /end COMPU_METHOD
/begin COMPU_METHOD fak_ub_b2 "" RAT_FUNC "%6.4" "-" COEFFS 0 256 0 0 0 2 /end COMPU_METHOD
/begin COMPU_METHOD fak_ub_b318p75 "" RAT_FUNC "%6.2" "-" COEFFS 0 256 0 0 0 318.75 /end COMPU_METHOD
/begin COMPU_METHOD fak_ub_b3p125 "" RAT_FUNC "%6.4" "%/1/min" COEFFS 0 2048 0 0 0 25 /end COMPU_METHOD
/begin COMPU_METHOD fak_ub_b4 "" RAT_FUNC "%6.4" "-" COEFFS 0 256 0 0 0 4 /end COMPU_METHOD
/begin COMPU_METHOD fak_uw_b1 "" RAT_FUNC "%7.6" "-" COEFFS 0 65536 0 0 0 1 /end COMPU_METHOD
/begin COMPU_METHOD fak_uw_b16 "" RAT_FUNC "%6.5" "-" COEFFS 0 65536 0 0 0 16 /end COMPU_METHOD
/begin COMPU_METHOD fak_uw_b2 "" RAT_FUNC "%7.6" "-" COEFFS 0 65536 0 0 0 2 /end COMPU_METHOD
/begin COMPU_METHOD fak_uw_b4 "" RAT_FUNC "%7.6" "-" COEFFS 0 65536 0 0 0 4 /end COMPU_METHOD
/begin COMPU_METHOD fak_uw_b4864 "" RAT_FUNC "%6.4" "-" COEFFS 0 65536 0 0 0 4864 /end COMPU_METHOD
/begin COMPU_METHOD igen_ub_q1 "" RAT_FUNC "%6.2" "" COEFFS 0 1 0 0 0 1 /end COMPU_METHOD
/begin COMPU_METHOD i_eluft_q0p0625 "" RAT_FUNC "%6.4" "" COEFFS 0 65536 0 0 0 4096 /end COMPU_METHOD
/begin COMPU_METHOD i_vvt_q0p0625 "" RAT_FUNC "%6.4" "" COEFFS 0 65536 0 0 0 4096 /end COMPU_METHOD
/begin COMPU_METHOD i_vvt_ub_q0p50_om63p50 "" RAT_FUNC "%6.4" "" COEFFS 0 1 63.5 0 0 0.5 /end COMPU_METHOD
/begin COMPU_METHOD km_uw_q10 "" RAT_FUNC "%6.1" "km" COEFFS 0 1 0 0 0 10 /end COMPU_METHOD
/begin COMPU_METHOD kw_q0p1 "" RAT_FUNC "%6.3" "Grad KW" COEFFS 0 10 0 0 0 1 /end COMPU_METHOD
/begin COMPU_METHOD m_ub_b1020 "" RAT_FUNC "%6.2" "kg/h" COEFFS 0 1 0 0 0 4 /end COMPU_METHOD
/begin COMPU_METHOD m_ub_b23p3 "" RAT_FUNC "%6.3" "kg" COEFFS 0 2812.5 0 0 0 256 /end COMPU_METHOD
/begin COMPU_METHOD m_ub_b5p8 "" RAT_FUNC "%6.4" "kg" COEFFS 0 5625 0 0 0 128 /end COMPU_METHOD
/begin COMPU_METHOD m_uw_b23p3 "" RAT_FUNC "%6.5" "kg" COEFFS 0 2812.5 0 0 0 1 /end COMPU_METHOD
/begin COMPU_METHOD m_uw_b6553p5 "" RAT_FUNC "%6.3" "kg/h" COEFFS 0 1 0 0 0 0.1 /end COMPU_METHOD
/begin COMPU_METHOD nmotg_sb_q100 "" RAT_FUNC "%6.0" "1/min/s" COEFFS 0 1 0 0 0 100 /end COMPU_METHOD
/begin COMPU_METHOD nmotg_sw_q0p15625 "" RAT_FUNC "%6.3" "1/min/s" COEFFS 0 1 0 0 0 0.15625 /end COMPU_METHOD
/begin COMPU_METHOD nmot_sw_q0p25 "" RAT_FUNC "%6.3" "1/min" COEFFS 0 1 0 0 0 0.25 /end COMPU_METHOD
/begin COMPU_METHOD nmot_ub_q10 "" RAT_FUNC "%6.1" "1/min" COEFFS 0 1 0 0 0 10 /end COMPU_METHOD
/begin COMPU_METHOD nmot_ub_q40 "" RAT_FUNC "%6.1" "1/min" COEFFS 0 1 0 0 0 40 /end COMPU_METHOD
/begin COMPU_METHOD nmot_uw_q0p15625 "" RAT_FUNC "%6.3" "1/min" COEFFS 0 6.4 0 0 0 1 /end COMPU_METHOD
/begin COMPU_METHOD nmot_uw_q0p25 "" RAT_FUNC "%6.3" "1/min" COEFFS 0 1 0 0 0 0.25 /end COMPU_METHOD
/begin COMPU_METHOD p_q0p039s32768 "" RAT_FUNC "%7.1" "hPa" COEFFS 0 256 327680 0 0 10 /end COMPU_METHOD
/begin COMPU_METHOD qnv_uw_b512 "" RAT_FUNC "%6.4" "(1/min) / (km/h)" COEFFS 0 65536 0 0 0 512 /end COMPU_METHOD
/begin COMPU_METHOD q_q0p4551 "" RAT_FUNC "%6.3" "kJ" COEFFS 0 36000 0 0 0 16384 /end COMPU_METHOD
/begin COMPU_METHOD relDK_q0p02441 "" RAT_FUNC "%6.4" "%DK" COEFFS 0 65536 0 0 0 1600 /end COMPU_METHOD
/begin COMPU_METHOD relDK_q0p3922 "" RAT_FUNC "%6.3" "%DK" COEFFS 0 255 0 0 0 100 /end COMPU_METHOD
/begin COMPU_METHOD relDK_ub_b100 "" RAT_FUNC "%6.3" "%DK" COEFFS 0 255 0 0 0 100 /end COMPU_METHOD
/begin COMPU_METHOD relDK_uw_b100 "" RAT_FUNC "%6.4" "%DK" COEFFS 0 65535 0 0 0 100 /end COMPU_METHOD
/begin COMPU_METHOD relPED_uw_b100 "" RAT_FUNC "%6.4" "%PED" COEFFS 0 65535 0 0 0 100 /end COMPU_METHOD
/begin COMPU_METHOD rel_sw_b100 "" RAT_FUNC "%6.4" "%" COEFFS 0 32768 0 0 0 100 /end COMPU_METHOD
/begin COMPU_METHOD rel_ub_b100 "" RAT_FUNC "%6.3" "%" COEFFS 0 255 0 0 0 100 /end COMPU_METHOD
/begin COMPU_METHOD rel_ub_b127p5 "" RAT_FUNC "%6.3" "%" COEFFS 0 2 0 0 0 1 /end COMPU_METHOD
/begin COMPU_METHOD rel_ub_b99p6 "" RAT_FUNC "%6.3" "%" COEFFS 0 256 0 0 0 100 /end COMPU_METHOD
/begin COMPU_METHOD rel_ub_q0p75 "" RAT_FUNC "%6.3" "%" COEFFS 0 1 0 0 0 0.75 /end COMPU_METHOD
/begin COMPU_METHOD rel_uw_b100 "" RAT_FUNC "%6.4" "%" COEFFS 0 65536 0 0 0 100 /end COMPU_METHOD
/begin COMPU_METHOD rel_uw_b200 "" RAT_FUNC "%6.4" "%" COEFFS 0 65536 0 0 0 200 /end COMPU_METHOD
/begin COMPU_METHOD rel_uw_b40 "" RAT_FUNC "%6.5" "%" COEFFS 0 65536 0 0 0 40 /end COMPU_METHOD
/begin COMPU_METHOD spg_q0p00977 "" RAT_FUNC "%6.4" "V" COEFFS 0 256 0 0 0 2.5 /end COMPU_METHOD
/begin COMPU_METHOD spg_q0p03125 "" RAT_FUNC "%6.4" "V" COEFFS 0 256 0 0 0 8 /end COMPU_METHOD
/begin COMPU_METHOD spg_q0p1 "" RAT_FUNC "%6.3" "V" COEFFS 0 1 0 0 0 0.1 /end COMPU_METHOD
/begin COMPU_METHOD spg_sw_q0p001222 "" RAT_FUNC "%6.4" "V" COEFFS 0 1 0 0 0 0.001222 /end COMPU_METHOD
/begin COMPU_METHOD spg_ubatt "" RAT_FUNC "%6.3" "V" COEFFS 0 1 0 0 0 0.0942 /end COMPU_METHOD
/begin COMPU_METHOD spg_ub_b5 "" RAT_FUNC "%6.4" "V" COEFFS 0 256 0 0 0 5 /end COMPU_METHOD
/begin COMPU_METHOD spg_uw_q0p001222 "" RAT_FUNC "%6.4" "V" COEFFS 0 1 0 0 0 0.001222 /end COMPU_METHOD
/begin COMPU_METHOD spg_uw_q0p00488 "" RAT_FUNC "%6.4" "V" COEFFS 0 1024 0 0 0 5 /end COMPU_METHOD
/begin COMPU_METHOD s_q1_km "" RAT_FUNC "%6.2" "km" COEFFS 0 1 0 0 0 1 /end COMPU_METHOD
/begin COMPU_METHOD s_q6_km "" RAT_FUNC "%6.2" "km" COEFFS 0 1 0 0 0 6 /end COMPU_METHOD
/begin COMPU_METHOD t100msxs_ub_b25p5 "" RAT_FUNC "%6.3" "s" COEFFS 0 1 0 0 0 0.1 /end COMPU_METHOD
/begin COMPU_METHOD t100msxs_uw_b6553p5 "" RAT_FUNC "%6.3" "s" COEFFS 0 1 0 0 0 0.1 /end COMPU_METHOD
/begin COMPU_METHOD t100msxs_uw_b6553p6 "" RAT_FUNC "%6.3" "s" COEFFS 0 10 0 0 0 1 /end COMPU_METHOD
/begin COMPU_METHOD t10msxs_ub_b2p55 "" RAT_FUNC "%6.4" "s" COEFFS 0 1 0 0 0 0.01 /end COMPU_METHOD
/begin COMPU_METHOD t10msxs_uw_b655p35 "" RAT_FUNC "%6.4" "s" COEFFS 0 1 0 0 0 0.01 /end COMPU_METHOD
/begin COMPU_METHOD t128ms_uw "" RAT_FUNC "%6.4" "ms" COEFFS 0 512 0 0 0 1 /end COMPU_METHOD
/begin COMPU_METHOD t1ms_ub_b255 "" RAT_FUNC "%7.3" "ms" COEFFS 0 1 0 0 0 1 /end COMPU_METHOD
/begin COMPU_METHOD t1sxs_ub_b255 "" RAT_FUNC "%6.2" "s" COEFFS 0 1 0 0 0 1 /end COMPU_METHOD
/begin COMPU_METHOD t1sxs_uw_b65535 "" RAT_FUNC "%6.2" "s" COEFFS 0 1 0 0 0 1 /end COMPU_METHOD
/begin COMPU_METHOD t1sxs_uw_q1 "" RAT_FUNC "%6.2" "s" COEFFS 0 1 0 0 0 1 /end COMPU_METHOD
/begin COMPU_METHOD t20msxs_ub_b5p1 "" RAT_FUNC "%6.4" "s" COEFFS 0 1 0 0 0 0.02 /end COMPU_METHOD
/begin COMPU_METHOD t20msxs_uw_q0p02 "" RAT_FUNC "%6.4" "s" COEFFS 0 1 0 0 0 0.02 /end COMPU_METHOD
/begin COMPU_METHOD t500usxms_ub_q0p5 "" RAT_FUNC "%6.3" "ms" COEFFS 0 1 0 0 0 0.5 /end COMPU_METHOD
/begin COMPU_METHOD t50msxs_q0p05 "" RAT_FUNC "%6.4" "s" COEFFS 0 1 0 0 0 0.05 /end COMPU_METHOD
/begin COMPU_METHOD temp_q0p0195 "" RAT_FUNC "%6.4" "Grad C" COEFFS 0 256 0 0 0 5 /end COMPU_METHOD
/begin COMPU_METHOD temp_q5 "" RAT_FUNC "%6.2" "Grad C" COEFFS 0 1 0 0 0 5 /end COMPU_METHOD
/begin COMPU_METHOD temp_ub_b191p25 "" RAT_FUNC "%6.3" "Grad C" COEFFS 0 1 0 0 0 0.75 /end COMPU_METHOD
/begin COMPU_METHOD temp_ub_q0p75_o48 "" RAT_FUNC "%6.2" "Grad C" COEFFS 0 1 48 0 0 0.75 /end COMPU_METHOD
/begin COMPU_METHOD temp_ub_q5_o50 "" RAT_FUNC "%6.2" "Grad C" COEFFS 0 1 50 0 0 5 /end COMPU_METHOD
/begin COMPU_METHOD temp_uw_q0p0195_o50 "" RAT_FUNC "%6.2" "Grad C" COEFFS 0 256 12800 0 0 5 /end COMPU_METHOD
/begin COMPU_METHOD t_q0p0001_ms "" RAT_FUNC "%7.6" "ms" COEFFS 0 1 0 0 0 0.0001 /end COMPU_METHOD
/begin COMPU_METHOD t_tev0p0005 "" RAT_FUNC "%6.5" "s" COEFFS 0 2048 0 0 0 1 /end COMPU_METHOD
/begin COMPU_METHOD vfzg_ub_q1p25 "" RAT_FUNC "%6.2" "km/h" COEFFS 0 1 0 0 0 1.25 /end COMPU_METHOD
/begin COMPU_METHOD vfzg_uw_b512 "" RAT_FUNC "%6.4" "km/h" COEFFS 0 65536 0 0 0 512 /end COMPU_METHOD
/begin COMPU_METHOD zk100msxs_ub_b25p5 "" RAT_FUNC "%6.3" "s" COEFFS 0 0 256 0 10 0 /end COMPU_METHOD
/begin COMPU_METHOD zk100msxs_uw_b6553 "" RAT_FUNC "%10.3" "s" COEFFS 0 0 65536 0 10 0 /end COMPU_METHOD
/begin COMPU_METHOD zk10msxs_uw_b655 "" RAT_FUNC "%6.2" "s" COEFFS 0 0 65536 0 100 0 /end COMPU_METHOD
/begin COMPU_METHOD zk200msxs_uw_b13107 "" RAT_FUNC "%6.0" "s" COEFFS 0 0 13107 0 1 0 /end COMPU_METHOD
/begin RECORD_LAYOUT FkfNoShNoOffWUb FNC_VALUES 1 UBYTE COLUMN_DIR DIRECT /end RECORD_LAYOUT
/begin RECORD_LAYOUT FklWSw FNC_VALUES 1 SWORD COLUMN_DIR DIRECT /end RECORD_LAYOUT
/begin RECORD_LAYOUT FklWUb FNC_VALUES 1 UBYTE COLUMN_DIR DIRECT /end RECORD_LAYOUT
/begin RECORD_LAYOUT FklWUw FNC_VALUES 1 UWORD COLUMN_DIR DIRECT /end RECORD_LAYOUT
/begin RECORD_LAYOUT GkfWSb FNC_VALUES 1 SBYTE COLUMN_DIR DIRECT /end RECORD_LAYOUT
/begin RECORD_LAYOUT GkfWSw FNC_VALUES 1 SWORD COLUMN_DIR DIRECT /end RECORD_LAYOUT
/begin RECORD_LAYOUT GkfWU8 FNC_VALUES 1 UBYTE COLUMN_DIR DIRECT /end RECORD_LAYOUT
/begin RECORD_LAYOUT GkfWUb FNC_VALUES 1 UBYTE COLUMN_DIR DIRECT /end RECORD_LAYOUT
/begin RECORD_LAYOUT GkfWUw FNC_VALUES 1 UWORD COLUMN_DIR DIRECT /end RECORD_LAYOUT
/begin RECORD_LAYOUT GklWSb FNC_VALUES 1 SBYTE COLUMN_DIR DIRECT /end RECORD_LAYOUT
/begin RECORD_LAYOUT GklWU8 FNC_VALUES 1 UBYTE COLUMN_DIR DIRECT /end RECORD_LAYOUT
/begin RECORD_LAYOUT GklWUb FNC_VALUES 1 UBYTE COLUMN_DIR DIRECT /end RECORD_LAYOUT
/begin RECORD_LAYOUT GklWUw FNC_VALUES 1 UWORD COLUMN_DIR DIRECT /end RECORD_LAYOUT
/begin RECORD_LAYOUT KfAxU8AyU8SstxU16SstyU16WU16 NO_AXIS_PTS_X 1 UWORD NO_AXIS_PTS_Y 2 UWORD AXIS_PTS_X 3 UWORD INDEX_INCR DIRECT AXIS_PTS_Y 4 UWORD INDEX_INCR DIRECT FNC_VALUES 5 UWORD COLUMN_DIR DIRECT /end RECORD_LAYOUT
/begin RECORD_LAYOUT KfAxUbAyUbSstxUbSstyUbWUb NO_AXIS_PTS_X 1 UBYTE NO_AXIS_PTS_Y 2 UBYTE AXIS_PTS_X 3 UBYTE INDEX_INCR DIRECT AXIS_PTS_Y 4 UBYTE INDEX_INCR DIRECT FNC_VALUES 5 UBYTE COLUMN_DIR DIRECT /end RECORD_LAYOUT
/begin RECORD_LAYOUT KfAxUwAyUwSstxUwSstyUwWUw NO_AXIS_PTS_X 1 UWORD NO_AXIS_PTS_Y 2 UWORD AXIS_PTS_X 3 UWORD INDEX_INCR DIRECT AXIS_PTS_Y 4 UWORD INDEX_INCR DIRECT FNC_VALUES 5 UWORD COLUMN_DIR DIRECT /end RECORD_LAYOUT
/begin RECORD_LAYOUT KlAUbSstSbWUb NO_AXIS_PTS_X 1 UBYTE AXIS_PTS_X 2 SBYTE INDEX_INCR DIRECT FNC_VALUES 3 UBYTE COLUMN_DIR DIRECT /end RECORD_LAYOUT
/begin RECORD_LAYOUT KlAUbSstUbWSb NO_AXIS_PTS_X 1 UBYTE AXIS_PTS_X 2 UBYTE INDEX_INCR DIRECT FNC_VALUES 3 SBYTE COLUMN_DIR DIRECT /end RECORD_LAYOUT
/begin RECORD_LAYOUT KlAUbSstUbWUb NO_AXIS_PTS_X 1 UBYTE AXIS_PTS_X 2 UBYTE INDEX_INCR DIRECT FNC_VALUES 3 UBYTE COLUMN_DIR DIRECT /end RECORD_LAYOUT
/begin RECORD_LAYOUT KlAUbSstUbWUw NO_AXIS_PTS_X 1 UBYTE AXIS_PTS_X 2 UBYTE INDEX_INCR DIRECT FNC_VALUES 3 UWORD COLUMN_DIR DIRECT /end RECORD_LAYOUT
/begin RECORD_LAYOUT KlAUbSstUwWUb NO_AXIS_PTS_X 1 UBYTE AXIS_PTS_X 2 UWORD INDEX_INCR DIRECT FNC_VALUES 3 UBYTE COLUMN_DIR DIRECT /end RECORD_LAYOUT
/begin RECORD_LAYOUT KlAUwSstSwWUw NO_AXIS_PTS_X 1 UWORD AXIS_PTS_X 2 SWORD INDEX_INCR DIRECT FNC_VALUES 3 UWORD COLUMN_DIR DIRECT /end RECORD_LAYOUT
/begin RECORD_LAYOUT KlAUwSstUwWUw NO_AXIS_PTS_X 1 UWORD AXIS_PTS_X 2 UWORD INDEX_INCR DIRECT FNC_VALUES 3 UWORD COLUMN_DIR DIRECT /end RECORD_LAYOUT
/begin RECORD_LAYOUT KlAxU8SstxU16WU16 NO_AXIS_PTS_X 1 UWORD AXIS_PTS_X 2 UWORD INDEX_INCR DIRECT FNC_VALUES 3 UWORD COLUMN_DIR DIRECT /end RECORD_LAYOUT
/begin RECORD_LAYOUT KlAxU8SstxU8WU16 NO_AXIS_PTS_X 1 UBYTE AXIS_PTS_X 2 UBYTE INDEX_INCR DIRECT FNC_VALUES 3 UWORD COLUMN_DIR DIRECT /end RECORD_LAYOUT
/begin RECORD_LAYOUT KlAxU8SstxU8WU8 NO_AXIS_PTS_X 1 UBYTE AXIS_PTS_X 2 UBYTE INDEX_INCR DIRECT FNC_VALUES 3 UBYTE COLUMN_DIR DIRECT /end RECORD_LAYOUT
/begin RECORD_LAYOUT KwSb FNC_VALUES 1 SBYTE COLUMN_DIR DIRECT /end RECORD_LAYOUT
/begin RECORD_LAYOUT KwSw FNC_VALUES 1 SWORD COLUMN_DIR DIRECT /end RECORD_LAYOUT
/begin RECORD_LAYOUT KwUb FNC_VALUES 1 UBYTE COLUMN_DIR DIRECT /end RECORD_LAYOUT
/begin RECORD_LAYOUT KwUw FNC_VALUES 1 UWORD COLUMN_DIR DIRECT /end RECORD_LAYOUT
/begin RECORD_LAYOUT KwWS16 FNC_VALUES 1 SWORD COLUMN_DIR DIRECT /end RECORD_LAYOUT
/begin RECORD_LAYOUT KwWU16 FNC_VALUES 1 UWORD COLUMN_DIR DIRECT /end RECORD_LAYOUT
/begin RECORD_LAYOUT KwWU8 FNC_VALUES 1 UBYTE COLUMN_DIR DIRECT /end RECORD_LAYOUT
/begin RECORD_LAYOUT SstASwSstSw NO_AXIS_PTS_X 1 SWORD AXIS_PTS_X 2 SWORD INDEX_INCR DIRECT /end RECORD_LAYOUT
/begin RECORD_LAYOUT SstAU8SstU16 NO_AXIS_PTS_X 1 UWORD AXIS_PTS_X 2 UWORD INDEX_INCR DIRECT /end RECORD_LAYOUT
/begin RECORD_LAYOUT SstAU8SstU8 NO_AXIS_PTS_X 1 UBYTE AXIS_PTS_X 2 UBYTE INDEX_INCR DIRECT /end RECORD_LAYOUT
/begin RECORD_LAYOUT SstAUbSstUb NO_AXIS_PTS_X 1 UBYTE AXIS_PTS_X 2 UBYTE INDEX_INCR DIRECT /end RECORD_LAYOUT
/begin RECORD_LAYOUT SstAUwSstUw NO_AXIS_PTS_X 1 UWORD AXIS_PTS_X 2 UWORD INDEX_INCR DIRECT /end RECORD_LAYOUT
/end MODULE
/end PROJECT
