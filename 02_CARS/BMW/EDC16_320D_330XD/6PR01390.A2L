ASAP2_VERSION 1 3
/begin PROJECT P390 "BMW DDE6.2 6-Zylinder VR0.1 15.03.2004 CAN11/12H"
/begin HEADER "" VERSION "VR0.1_6Z_CAN11/12H" PROJECT_NO P390 /end HEADER
/begin MODULE DIM ""
/begin MOD_COMMON "" BYTE_ORDER MSB_FIRST ALIGNMENT_BYTE 1 ALIGNMENT_WORD 2 ALIGNMENT_LONG 4 ALIGNMENT_FLOAT32_IEEE 4 /end MOD_COMMON
/begin CHARACTERISTIC ExeMon_stEnaTst_C "#SSD Schalter zum Testen der Programmablaufkontrolle" VALUE 0xC3164 Kw_Wu8 255.0 OneToOne 0.00 255.0 FORMAT "%5.1" /end CHARACTERISTIC
/begin CHARACTERISTIC MSidCD_Comm_DebNplDef_C "#SSD Fehlererkennungszeit Fehler Plausibilisierung privater CAN" VALUE 0xE650A Kw_Wu16 655350.0 Time_ms 0.00 655350.0 FORMAT "%8.1" /end CHARACTERISTIC
/begin CHARACTERISTIC MSidCD_Comm_DebNplOk_C "Heilungszeit SG-Auswahl, Fehler Plausibilisierung privater CAN" VALUE 0xE650C Kw_Wu16 655350.0 Time_ms 0.00 655350.0 FORMAT "%8.1" /end CHARACTERISTIC
/begin CHARACTERISTIC MSidCD_numECUS_C "#SSD Anzahl der ECU in diesem system: 1 - 4 (Master/Slave)" VALUE 0xE650E Kw_Wu8 3.000 OneToOne 1.000 4.000 FORMAT "%5.3" EXTENDED_LIMITS 0.00 255.0 /end CHARACTERISTIC
/begin CHARACTERISTIC MSidCD_Pin_DebSigDef_C "Defekterkennungszeit SG-Asuwahl, Pinfehler" VALUE 0xE6510 Kw_Wu16 655350.0 Time_ms 0.00 655350.0 FORMAT "%8.1" /end CHARACTERISTIC
/begin CHARACTERISTIC MSidCD_Pin_DebSigOk_C "Heilungszeit SG-Auswahl, Pinfehler" VALUE 0xE6512 Kw_Wu16 655350.0 Time_ms 0.00 655350.0 FORMAT "%8.1" /end CHARACTERISTIC
/begin CHARACTERISTIC MSidCD_Select_DebNplDef_C "#SSD Defekterkennungszeit ECU Selection (Botschaften nicht plausibel)" VALUE 0xE6514 Kw_Wu16 655350.0 Time_ms 0.00 655350.0 FORMAT "%8.1" /end CHARACTERISTIC
/begin CHARACTERISTIC MSidCD_Select_DebNplOk_C "#SSD Heilungszeit SG-Auswahl (Botschaften nicht plausibel)" VALUE 0xE6516 Kw_Wu16 655350.0 Time_ms 0.00 655350.0 FORMAT "%8.1" /end CHARACTERISTIC
/begin CHARACTERISTIC MSidCD_Sel_INI_DebNplDef_C "Defekterkennungszeit SG-Auswahl (NeuLernen ist nicht erlaubt)" VALUE 0xE6518 Kw_Wu16 655350.0 Time_ms 0.00 655350.0 FORMAT "%8.1" /end CHARACTERISTIC
/begin CHARACTERISTIC MSidCD_Sel_INI_DebNplOk_C "Heilungszeit SG-Auswahl (NeuLernen ist nicht erlaubt)" VALUE 0xE651A Kw_Wu16 655350.0 Time_ms 0.00 655350.0 FORMAT "%8.1" /end CHARACTERISTIC
/begin CHARACTERISTIC MSidCD_Sel_INI_DebSigDef_C "Defekterkennungszeit SG-Auswahl (1.Plaus. am Beginn jedes Fahrzyklus)" VALUE 0xE651C Kw_Wu16 655350.0 Time_ms 0.00 655350.0 FORMAT "%8.1" /end CHARACTERISTIC
/begin CHARACTERISTIC MSidCD_Sel_INI_DebSigOk_C "Heilungszeit SG-Auswahl (1.Plaus. am Beginn des Fahrzyklus)" VALUE 0xE651E Kw_Wu16 655350.0 Time_ms 0.00 655350.0 FORMAT "%8.1" /end CHARACTERISTIC
/begin CHARACTERISTIC MSidCD_stCANprivErrMsk_C "Maske für Auswahl Error-Stati Kommunikation priv. CAN" VALUE 0xE6520 Kw_Wu16 255.0000 OneToOne 0.00 255.0000 FORMAT "%8.4" EXTENDED_LIMITS 0.00 65535.00 /end CHARACTERISTIC
/begin CHARACTERISTIC MSidCD_stErrInjOFF_C "#SSD Maske für Abschaltung Einspritzung im Fehlerfall SG-Auswahl" VALUE 0xE6522 Kw_Wu8 255.0 OneToOne 0.00 255.0 FORMAT "%5.1" /end CHARACTERISTIC
/begin CHARACTERISTIC MSidCD_stInv_C "Schalter zur Invertierung des digitalen Eingangsignals" VALUE 0xE6523 Kw_Wu8 1.000 OneToOne 0.00 1.000 FORMAT "%5.3" EXTENDED_LIMITS 0.00 255.0 /end CHARACTERISTIC
/begin CHARACTERISTIC MSidCD_swtCanDeb_C "#SSD Entprellmodus Zustandsautomat priv. CAN (1...Entprellen, 0...kein Entprellen)" VALUE 0xE6524 Kw_Ws8 255.0 OneToOne -128.0 127.0 FORMAT "%5.1" /end CHARACTERISTIC
/begin CHARACTERISTIC MSidCD_swtLearn_C "Schalter Lern-Modus Neulernen SG-Auswahl (1...lernen erlaubt, 0...lernen nicht erlaubt)" VALUE 0xE6525 Kw_Ws8 255.0 OneToOne -128.0 127.0 FORMAT "%5.1" /end CHARACTERISTIC
/begin CHARACTERISTIC MSidCD_swtMAIN_C "#SSD ID SG-Auswahl (-1/FFh...Single, 0...Master, 1...Slave, 64/40h...detection with pin)" VALUE 0xE6526 Kw_Ws8 255.0 OneToOne -128.0 127.0 FORMAT "%5.1" /end CHARACTERISTIC
/begin CHARACTERISTIC MSidCD_tiCanDeb_C "#SSD Entprelltimer Status privater CAN" VALUE 0xE6528 Kw_Wu16 655350.0 Time_ms 0.00 655350.0 FORMAT "%8.1" /end CHARACTERISTIC
/begin CHARACTERISTIC NetMng_CANFadeOutMaskA_C "#SSD CAN-Ausblendmaske CAN A" VALUE 0xE652C Kw_Wu8 255.0 OneToOne 0.00 255.0 FORMAT "%5.1" /end CHARACTERISTIC
/begin CHARACTERISTIC NetMng_CANFadeOutMaskB_C "#SSD CAN-Ausblendmaske CAN B" VALUE 0xE652D Kw_Wu8 255.0 OneToOne 0.00 255.0 FORMAT "%5.1" /end CHARACTERISTIC
/begin CHARACTERISTIC NetMng_CANFadeOutMaskC_C "CAN-Ausblendmaske CAN C" VALUE 0xE652E Kw_Wu8 255.0 OneToOne 0.00 255.0 FORMAT "%5.1" /end CHARACTERISTIC
/begin CHARACTERISTIC NetMng_ctBusOffRetriesA_C "#SSD Zählergrenze für Recoveries nach Busoff CAN A" VALUE 0xE652F Kw_Wu8 255.0 OneToOne 0.00 255.0 FORMAT "%5.1" /end CHARACTERISTIC
/begin CHARACTERISTIC NetMng_ctBusOffRetriesB_C "#SSD Zählergrenze für Recoveries nach Busoff CAN B" VALUE 0xE6530 Kw_Wu8 255.0 OneToOne 0.00 255.0 FORMAT "%5.1" /end CHARACTERISTIC
/begin CHARACTERISTIC NetMng_ctBusOffRetriesC_C "Zählergrenze für Recoveries nach Busoff CAN C" VALUE 0xE6531 Kw_Wu8 255.0 OneToOne 0.00 255.0 FORMAT "%5.1" /end CHARACTERISTIC
/begin CHARACTERISTIC NetMng_ctInitRetryCanA_C "#SSD Zählergrenze für Initretries CAN A" VALUE 0xE6532 Kw_Wu8 255.0 OneToOne 0.00 255.0 FORMAT "%5.1" /end CHARACTERISTIC
/begin CHARACTERISTIC NetMng_ctInitRetryCanB_C "#SSD Zählergrenze für Initretries CAN B" VALUE 0xE6533 Kw_Wu8 255.0 OneToOne 0.00 255.0 FORMAT "%5.1" /end CHARACTERISTIC
/begin CHARACTERISTIC NetMng_ctInitRetryCanC_C "Zählergrenze für Initretries CAN C" VALUE 0xE6534 Kw_Wu8 255.0 OneToOne 0.00 255.0 FORMAT "%5.1" /end CHARACTERISTIC
/begin CHARACTERISTIC NetMng_tiDebPosBusMonCanA_C "#SSD Entprellzeit CAN-Ausblendung ein Can A" VALUE 0xE6536 Kw_Wu16 2000.000 TimeDeb 0.00 2000.000 FORMAT "%8.3" EXTENDED_LIMITS 0.00 655350.0 /end CHARACTERISTIC
/begin CHARACTERISTIC NetMng_tiDebNegBusMonCanA_C "#SSD Entprellzeit CAN-Ausblendung aus Can A" VALUE 0xE6538 Kw_Wu16 2000.000 TimeDeb 0.00 2000.000 FORMAT "%8.3" EXTENDED_LIMITS 0.00 655350.0 /end CHARACTERISTIC
/begin CHARACTERISTIC NetMng_tiDebPosBusMonCanB_C "#SSD Entprellzeit CAN-Ausblendung ein Can B" VALUE 0xE653A Kw_Wu16 2000.000 TimeDeb 0.00 2000.000 FORMAT "%8.3" EXTENDED_LIMITS 0.00 655350.0 /end CHARACTERISTIC
/begin CHARACTERISTIC NetMng_tiDebNegBusMonCanB_C "#SSD Entprellzeit CAN-Ausblendung aus Can B" VALUE 0xE653C Kw_Wu16 2000.000 TimeDeb 0.00 2000.000 FORMAT "%8.3" EXTENDED_LIMITS 0.00 655350.0 /end CHARACTERISTIC
/begin CHARACTERISTIC NetMng_tiDebPosBusMonCanC_C "Entprellzeit CAN-Ausblendung ein Can C" VALUE 0xE653E Kw_Wu16 2000.000 TimeDeb 0.00 2000.000 FORMAT "%8.3" EXTENDED_LIMITS 0.00 655350.0 /end CHARACTERISTIC
/begin CHARACTERISTIC NetMng_tiDebNegBusMonCanC_C "Entprellzeit CAN-Ausblendung aus Can C" VALUE 0xE6540 Kw_Wu16 2000.000 TimeDeb 0.00 2000.000 FORMAT "%8.3" EXTENDED_LIMITS 0.00 655350.0 /end CHARACTERISTIC
/begin CHARACTERISTIC NetMng_tiDebPosBusOffCanA_C "#SSD Defektzeit Busoff Can A" VALUE 0xE6542 Kw_Wu16 2000.000 TimeDeb 0.00 2000.000 FORMAT "%8.3" EXTENDED_LIMITS 0.00 655350.0 /end CHARACTERISTIC
/begin CHARACTERISTIC NetMng_tiDebNegBusOffCanA_C "#SSD Heilzeit Busoff Can A" VALUE 0xE6544 Kw_Wu16 2000.000 TimeDeb 0.00 2000.000 FORMAT "%8.3" EXTENDED_LIMITS 0.00 655350.0 /end CHARACTERISTIC
/begin CHARACTERISTIC NetMng_tiDebPosBusOffCanB_C "#SSD Defektzeit Busoff Can B" VALUE 0xE6546 Kw_Wu16 2000.000 TimeDeb 0.00 2000.000 FORMAT "%8.3" EXTENDED_LIMITS 0.00 655350.0 /end CHARACTERISTIC
/begin CHARACTERISTIC NetMng_tiDebNegBusOffCanB_C "#SSD Heilzeit Busoff Can B" VALUE 0xE6548 Kw_Wu16 2000.000 TimeDeb 0.00 2000.000 FORMAT "%8.3" EXTENDED_LIMITS 0.00 655350.0 /end CHARACTERISTIC
/begin CHARACTERISTIC NetMng_tiDebPosBusOffCanC_C "Defektzeit Busoff Can C" VALUE 0xE654A Kw_Wu16 2000.000 TimeDeb 0.00 2000.000 FORMAT "%8.3" EXTENDED_LIMITS 0.00 655350.0 /end CHARACTERISTIC
/begin CHARACTERISTIC NetMng_tiDebNegBusOffCanC_C "Heilzeit Busoff Can C" VALUE 0xE654C Kw_Wu16 2000.000 TimeDeb 0.00 2000.000 FORMAT "%8.3" EXTENDED_LIMITS 0.00 655350.0 /end CHARACTERISTIC
/begin CHARACTERISTIC NetMng_tiDebPosErrCanA_C "#SSD Defektzeit ""error active"" Can A" VALUE 0xE654E Kw_Wu16 2000.000 TimeDeb 0.00 2000.000 FORMAT "%8.3" EXTENDED_LIMITS 0.00 655350.0 /end CHARACTERISTIC
/begin CHARACTERISTIC NetMng_tiDebNegErrCanA_C "#SSD Heilzeit ""error active"" Can A" VALUE 0xE6550 Kw_Wu16 2000.000 TimeDeb 0.00 2000.000 FORMAT "%8.3" EXTENDED_LIMITS 0.00 655350.0 /end CHARACTERISTIC
/begin CHARACTERISTIC NetMng_tiDebPosErrCanB_C "#SSD Defektzeit ""error active"" Can B" VALUE 0xE6552 Kw_Wu16 2000.000 TimeDeb 0.00 2000.000 FORMAT "%8.3" EXTENDED_LIMITS 0.00 655350.0 /end CHARACTERISTIC
/begin CHARACTERISTIC NetMng_tiDebNegErrCanB_C "#SSD Heilzeit ""error active"" Can B" VALUE 0xE6554 Kw_Wu16 2000.000 TimeDeb 0.00 2000.000 FORMAT "%8.3" EXTENDED_LIMITS 0.00 655350.0 /end CHARACTERISTIC
/begin CHARACTERISTIC NetMng_tiDebPosErrCanC_C "Defektzeit ""error active"" Can C" VALUE 0xE6556 Kw_Wu16 2000.000 TimeDeb 0.00 2000.000 FORMAT "%8.3" EXTENDED_LIMITS 0.00 655350.0 /end CHARACTERISTIC
/begin CHARACTERISTIC NetMng_tiDebNegErrCanC_C "Heilzeit ""error active"" Can C" VALUE 0xE6558 Kw_Wu16 2000.000 TimeDeb 0.00 2000.000 FORMAT "%8.3" EXTENDED_LIMITS 0.00 655350.0 /end CHARACTERISTIC
/begin CHARACTERISTIC NetMng_tiDebPosMonCanA_C "#SSD Entprellzeit Ausblendung für SW ein Can A" VALUE 0xE655A Kw_Wu16 2000.000 TimeDeb 0.00 2000.000 FORMAT "%8.3" EXTENDED_LIMITS 0.00 655350.0 /end CHARACTERISTIC
/begin CHARACTERISTIC NetMng_tiDebNegMonCanA_C "#SSD Entprellzeit Ausblendung für SW aus Can A" VALUE 0xE655C Kw_Wu16 2000.000 TimeDeb 0.00 2000.000 FORMAT "%8.3" EXTENDED_LIMITS 0.00 655350.0 /end CHARACTERISTIC
/begin CHARACTERISTIC NetMng_tiDebPosMonCanB_C "#SSD Entprellzeit Ausblendung für SW ein Can B" VALUE 0xE655E Kw_Wu16 2000.000 TimeDeb 0.00 2000.000 FORMAT "%8.3" EXTENDED_LIMITS 0.00 655350.0 /end CHARACTERISTIC
/begin CHARACTERISTIC NetMng_tiDebNegMonCanB_C "#SSD Entprellzeit Ausblendung für SW aus Can B" VALUE 0xE6560 Kw_Wu16 2000.000 TimeDeb 0.00 2000.000 FORMAT "%8.3" EXTENDED_LIMITS 0.00 655350.0 /end CHARACTERISTIC
/begin CHARACTERISTIC NetMng_tiDebPosMonCanC_C "Entprellzeit Ausblendung für SW ein Can C" VALUE 0xE6562 Kw_Wu16 2000.000 TimeDeb 0.00 2000.000 FORMAT "%8.3" EXTENDED_LIMITS 0.00 655350.0 /end CHARACTERISTIC
/begin CHARACTERISTIC NetMng_tiDebNegMonCanC_C "Entprellzeit Ausblendung für SW aus Can C" VALUE 0xE6564 Kw_Wu16 2000.000 TimeDeb 0.00 2000.000 FORMAT "%8.3" EXTENDED_LIMITS 0.00 655350.0 /end CHARACTERISTIC
/begin CHARACTERISTIC NetMng_FadeOutMaskA_C "#SSD SW-Ausblendmaske CAN A" VALUE 0xE6566 Kw_Wu16 65535.00 OneToOne 0.00 65535.00 FORMAT "%8.2" /end CHARACTERISTIC
/begin CHARACTERISTIC NetMng_FadeOutMaskB_C "#SSD SW-Ausblendmaske CAN B" VALUE 0xE6568 Kw_Wu16 65535.00 OneToOne 0.00 65535.00 FORMAT "%8.2" /end CHARACTERISTIC
/begin CHARACTERISTIC NetMng_FadeOutMaskC_C "SW-Ausblendmaske CAN C" VALUE 0xE656A Kw_Wu16 65535.00 OneToOne 0.00 65535.00 FORMAT "%8.2" /end CHARACTERISTIC
/begin CHARACTERISTIC NetMng_SplyVltgHysXLow_C "Untere Grenze Hysterese Versorgungsspannung" VALUE 0xE656C Kw_Ws16 13998.04 Volt_Batt 0.00 13998.04 FORMAT "%8.2" EXTENDED_LIMITS -640625.6 640606.1 /end CHARACTERISTIC
/begin CHARACTERISTIC NetMng_SplyVltgHysXHigh_C "Obere Grenze Hysterese Versorgungsspannung" VALUE 0xE656E Kw_Ws16 13998.04 Volt_Batt 0.00 13998.04 FORMAT "%8.2" EXTENDED_LIMITS -640625.6 640606.1 /end CHARACTERISTIC
/begin CHARACTERISTIC NetMng_SplyVltgHysYLow_C "#SSD Unterer Ausgangswert Hysterese Versorgungsspannung" VALUE 0xE6570 Kw_Ws16 0.00 OneToOne 1.000000 1.000000 FORMAT "%8.6" EXTENDED_LIMITS -32768.00 32767.00 READ_ONLY /end CHARACTERISTIC
/begin CHARACTERISTIC NetMng_SplyVltgHysYHigh_C "#SSD Oberer Ausgangswert Hysterese Versorgungsspannung" VALUE 0xE6572 Kw_Ws16 0.00 OneToOne 0.00 0.00 FORMAT "%8.2" EXTENDED_LIMITS -32768.00 32767.00 READ_ONLY /end CHARACTERISTIC
/begin CHARACTERISTIC NetMng_swtONWM_C "#SSD Enable/disable OSEK Netzwerkmanagement (0...NWM disabled, >0...NWM enabled)" VALUE 0xE652A Kw_Wu8 1.000 OneToOne 0.00 1.000 FORMAT "%5.3" EXTENDED_LIMITS 0.00 255.0 /end CHARACTERISTIC
/begin CHARACTERISTIC NetMng_tiFadeoutLowBat_C "#SSD Ausblendzeit nach Unterspannung Versorgung" VALUE 0xE6574 Kw_Wu16 327670.0 Time_ms 0.00 327670.0 FORMAT "%8.1" EXTENDED_LIMITS 0.00 655350.0 /end CHARACTERISTIC
/begin CHARACTERISTIC NetMng_tiFadeoutMin_C "Ausblendzeit nach Initialisierung" VALUE 0xE6576 Kw_Wu16 327670.0 Time_ms 0.00 327670.0 FORMAT "%8.1" EXTENDED_LIMITS 0.00 655350.0 /end CHARACTERISTIC
/begin CHARACTERISTIC NetMng_tiRecoverA_C "#SSD Zeit zwischen den Recoveries Can A" VALUE 0xE6578 Kw_Wu16 327670.0 Time_ms 0.00 327670.0 FORMAT "%8.1" EXTENDED_LIMITS 0.00 655350.0 /end CHARACTERISTIC
/begin CHARACTERISTIC NetMng_tiRecoverB_C "#SSD Zeit zwischen den Recoveries Can B" VALUE 0xE657A Kw_Wu16 327670.0 Time_ms 0.00 327670.0 FORMAT "%8.1" EXTENDED_LIMITS 0.00 655350.0 /end CHARACTERISTIC
/begin CHARACTERISTIC NetMng_tiRecoverC_C "Zeit zwischen den Recoveries Can C" VALUE 0xE657C Kw_Wu16 327670.0 Time_ms 0.00 327670.0 FORMAT "%8.1" EXTENDED_LIMITS 0.00 655350.0 /end CHARACTERISTIC
/begin CHARACTERISTIC NetMng_tiTimeoutDNMT_C "Timeout for Tester Present after Disable Normal Message Transmission" VALUE 0xE657E Kw_Wu16 16000.00 Time_ms 0.00 16000.00 FORMAT "%8.2" EXTENDED_LIMITS 0.00 655350.0 /end CHARACTERISTIC
/begin CHARACTERISTIC NSC_numPrio_C "#SSD Applikationswert für Testzwecke" VALUE 0xE6580 Kw_Wu16 65535.00 OneToOne 0.00 65535.00 FORMAT "%8.2" /end CHARACTERISTIC
/begin CHARACTERISTIC NSC_st_C "#SSD Applikationswert für Testzwecke" VALUE 0xE6584 Kw_Wu32 4294967295.00 OneToOne 0.00 4294967295.00 FORMAT "%13.2" /end CHARACTERISTIC
/begin CHARACTERISTIC OPSCD_uSRCMin_C "#SSD Threshold low value for SRC low error : Oil pressure sensor" VALUE 0xE65C4 Kw_Ws16 5200.391 Volt 0.00 5200.391 FORMAT "%8.3" EXTENDED_LIMITS -160156.4 160151.5 /end CHARACTERISTIC
/begin CHARACTERISTIC OPSCD_uSRCMax_C "#SSD Threshold high value for SRC High error: Oil pressure sensor" VALUE 0xE65C6 Kw_Ws16 5200.391 Volt 0.00 5200.391 FORMAT "%8.3" EXTENDED_LIMITS -160156.4 160151.5 /end CHARACTERISTIC
/begin CHARACTERISTIC OPSCD_pLin_CUR "Linearization curve : oil pressure sensor" CURVE 0xE65C8 Kl_Xs16_Ws16 1.000000 OneToOne 0.00 1.000000 FORMAT "%8.6" EXTENDED_LIMITS -32768.00 32767.00
 /begin AXIS_DESCR STD_AXIS OPSCD_uRaw_POEL_mp Volt 25 0.00 5200.391 FORMAT "%8.3" EXTENDED_LIMITS -160156.4 160151.5 DEPOSIT ABSOLUTE /end AXIS_DESCR
/end CHARACTERISTIC
/begin CHARACTERISTIC OPSCD_aMinBack_C "Statuswort für Deaktivierung der Endstufe" VALUE 0xE6588 Kw_Ws16 65.53500 Acc -32.76800 32.76700 FORMAT "%8.5" /end CHARACTERISTIC
/begin CHARACTERISTIC OPSCD_aMinFor_C "Statuswort für Auflösung des Powerstages" VALUE 0xE658A Kw_Ws16 65.53500 Acc -32.76800 32.76700 FORMAT "%8.5" /end CHARACTERISTIC
/begin CHARACTERISTIC OPSCD_ctPwrStgOnMax_C "Maximaler Zähler für Powerstage On im Fehlerfall" VALUE 0xE658C Kw_Wu16 65535.00 OneToOne 0.00 65535.00 FORMAT "%8.2" /end CHARACTERISTIC
/begin CHARACTERISTIC OPSCD_DebSRCHiDef_C "Error debounce for SRC-High error" VALUE 0xE662E Kw_Wu16 655350.0 Time_ms 0.00 655350.0 FORMAT "%8.1" /end CHARACTERISTIC
/begin CHARACTERISTIC OPSCD_DebSRCHiOk_C "Healing debounce for SRC-High error" VALUE 0xE6630 Kw_Wu16 655350.0 Time_ms 0.00 655350.0 FORMAT "%8.1" /end CHARACTERISTIC
/begin CHARACTERISTIC OPSCD_DebSRCLoDef_C "#SSD Error debounce for SRC-Low error" VALUE 0xE6632 Kw_Wu16 655350.0 Time_ms 0.00 655350.0 FORMAT "%8.1" /end CHARACTERISTIC
/begin CHARACTERISTIC OPSCD_DebSRCLoOk_C "Healing debounce for SRC-Low error" VALUE 0xE6634 Kw_Wu16 655350.0 Time_ms 0.00 655350.0 FORMAT "%8.1" /end CHARACTERISTIC
/begin CHARACTERISTIC OPSCD_dtRmpSlpUp_C "Ramp slope up parameter" VALUE 0xE6638 Kw_Wu32 65535999.9847 RmpPres 0.00 65535999.9847 FORMAT "%14.4" /end CHARACTERISTIC
/begin CHARACTERISTIC OPSCD_dtRmpSlpDwn_C "Ramp slope down parameter" VALUE 0xE663C Kw_Wu32 65535999.9847 RmpPres 0.00 65535999.9847 FORMAT "%14.4" /end CHARACTERISTIC
/begin CHARACTERISTIC OPSCD_LampDebExcTempDef_C "endstufen fehlerentprellung" VALUE 0xE658E Kw_Wu16 655350.0 Time_ms 0.00 655350.0 FORMAT "%8.1" /end CHARACTERISTIC
/begin CHARACTERISTIC OPSCD_LampDebExcTempOk_C "Endstufen Fehlerentprellung" VALUE 0xE6590 Kw_Wu16 655350.0 Time_ms 0.00 655350.0 FORMAT "%8.1" /end CHARACTERISTIC
/begin CHARACTERISTIC OPSCD_LampDebNoLoadDef_C "endstufen fehlerentprellung" VALUE 0xE6592 Kw_Wu16 655350.0 Time_ms 0.00 655350.0 FORMAT "%8.1" /end CHARACTERISTIC
/begin CHARACTERISTIC OPSCD_LampDebNoLoadOk_C "Endstufen Fehlerentprellung" VALUE 0xE6594 Kw_Wu16 655350.0 Time_ms 0.00 655350.0 FORMAT "%8.1" /end CHARACTERISTIC
/begin CHARACTERISTIC OPSCD_LampDebShortCircBatDef_C "endstufen fehlerentprellung" VALUE 0xE6596 Kw_Wu16 655350.0 Time_ms 0.00 655350.0 FORMAT "%8.1" /end CHARACTERISTIC
/begin CHARACTERISTIC OPSCD_LampDebShortCircBatOk_C "Endstufen Fehlerentprellung" VALUE 0xE6598 Kw_Wu16 655350.0 Time_ms 0.00 655350.0 FORMAT "%8.1" /end CHARACTERISTIC
/begin CHARACTERISTIC OPSCD_LampDebShortCircGndDef_C "Endstufen Fehlerentprellung" VALUE 0xE659A Kw_Wu16 655350.0 Time_ms 0.00 655350.0 FORMAT "%8.1" /end CHARACTERISTIC
/begin CHARACTERISTIC OPSCD_LampDebShortCircGndOk_C "Endstufen Fehlerentprellung" VALUE 0xE659C Kw_Wu16 655350.0 Time_ms 0.00 655350.0 FORMAT "%8.1" /end CHARACTERISTIC
/begin CHARACTERISTIC OPSCD_nStart_C "Drehzahlschwelle beim Starten" VALUE 0xE659E Kw_Ws16 5960.000 EngN 40.00000 6000.000 FORMAT "%8.3" EXTENDED_LIMITS -32768.00 32767.00 /end CHARACTERISTIC
/begin CHARACTERISTIC OPSCD_numAdc_C "#SSD application parameter for Engine Oil Pressure input" VALUE 0xE6640 Kw_Wu8 46.0000000000 NumPinAdc 0.00 46.0000000000 FORMAT "%13.10" /end CHARACTERISTIC
/begin CHARACTERISTIC OPSCD_numDia_C "#SSD application parameter for Oil Pressure Lamp Switch" VALUE 0xE65A0 Kw_Wu8 35.0000000000 NumPinDia 0.00 35.0000000000 FORMAT "%13.10" /end CHARACTERISTIC
/begin CHARACTERISTIC OPSCD_numDioOut_C "#SSD application parameter for DPF_Regeneration" VALUE 0xE65A1 Kw_Wu8 11.0000000000 NumPinDioOut 0.00 11.0000000000 FORMAT "%13.10" /end CHARACTERISTIC
/begin CHARACTERISTIC OPSCD_nZero_C "engine speed value threshold in starting case" VALUE 0xE65A2 Kw_Ws16 5960.000 EngN 40.00000 6000.000 FORMAT "%8.3" EXTENDED_LIMITS -32768.00 32767.00 /end CHARACTERISTIC
/begin CHARACTERISTIC OPSCD_stLampInvOut_C "Zustand der Öldrucklampe invertiert" VALUE 0xE65A4 Kw_Wu8 1.000 OneToOne 0.00 1.000 FORMAT "%5.3" EXTENDED_LIMITS 0.00 255.0 /end CHARACTERISTIC
/begin CHARACTERISTIC OPSCD_stPwrStgLampDia_C "Spezifikation des Abschaltverhaltens der Endstufendiagnose" VALUE 0xE65A5 Kw_Wu8 255.0 OneToOne 0.00 255.0 FORMAT "%5.1" /end CHARACTERISTIC
/begin CHARACTERISTIC OPSCD_stSPICtl_C "Schalter ob Endstufe SPI kontrollierbar = 1 oder nicht SPI kontrollierbar = 0" VALUE 0xE65A6 Kw_Wu8 1.000 OneToOne 0.00 1.000 FORMAT "%5.3" EXTENDED_LIMITS 0.00 255.0 /end CHARACTERISTIC
/begin CHARACTERISTIC OPSCD_swtSigOut_C "Ölsensor Signal über CAN(1) oder DIO(0)" VALUE 0xE65A7 Kw_Wu8 1.000 OneToOne 0.00 1.000 FORMAT "%5.3" EXTENDED_LIMITS 0.00 255.0 /end CHARACTERISTIC
/begin CHARACTERISTIC OPSCD_tiABSDebNegBack_C "debouncezeit für fallende Flanke" VALUE 0xE65A8 Kw_Wu16 655350.0 TimeDeb 0.00 655350.0 FORMAT "%8.1" /end CHARACTERISTIC
/begin CHARACTERISTIC OPSCD_tiABSDebPosBack_C "Debouncezeit für positive Flanke" VALUE 0xE65AA Kw_Wu16 655350.0 TimeDeb 0.00 655350.0 FORMAT "%8.1" /end CHARACTERISTIC
/begin CHARACTERISTIC OPSCD_tiABSDebNegFor_C "debouncezeit für fallende Flanke" VALUE 0xE65AC Kw_Wu16 655350.0 TimeDeb 0.00 655350.0 FORMAT "%8.1" /end CHARACTERISTIC
/begin CHARACTERISTIC OPSCD_tiABSDebPosFor_C "Debouncezeit für positive Flanke" VALUE 0xE65AE Kw_Wu16 655350.0 TimeDeb 0.00 655350.0 FORMAT "%8.1" /end CHARACTERISTIC
/begin CHARACTERISTIC OPSCD_tiBtwTst_C "Zeitabstand, in dem die Endstufe im Fehlerfall getestet wird" VALUE 0xE65B0 Kw_Wu16 29980.00 Time_ms 20.00000 30000.00 FORMAT "%8.2" EXTENDED_LIMITS 0.00 655350.0 /end CHARACTERISTIC
/begin CHARACTERISTIC OPSCD_tiInactiv1Back_C "status word for timer (inactivate in ABS case)" VALUE 0xE65B2 Kw_Wu16 655350.0 Time_ms 0.00 655350.0 FORMAT "%8.1" /end CHARACTERISTIC
/begin CHARACTERISTIC OPSCD_tiInactiv1For_C "status word for timer (inactivate in ABS case)" VALUE 0xE65B4 Kw_Wu16 655350.0 Time_ms 0.00 655350.0 FORMAT "%8.1" /end CHARACTERISTIC
/begin CHARACTERISTIC OPSCD_tiInactivStart_C "status word for timer inactivate in starting case" VALUE 0xE65B6 Kw_Wu16 655350.0 Time_ms 0.00 655350.0 FORMAT "%8.1" /end CHARACTERISTIC
/begin CHARACTERISTIC OPSCD_tipOELDebNeg_C "debounce time for negative edge of glow control unit feedback" VALUE 0xE65B8 Kw_Wu16 655350.0 TimeDeb 0.00 655350.0 FORMAT "%8.1" /end CHARACTERISTIC
/begin CHARACTERISTIC OPSCD_tipOELDebPos_C "debounce time for positive edge of glow control unit feedback" VALUE 0xE65BA Kw_Wu16 655350.0 TimeDeb 0.00 655350.0 FORMAT "%8.1" /end CHARACTERISTIC
/begin CHARACTERISTIC OPSCD_tiPwrStgOn_C "Zeit für welche die Endstufe im Fehlerfall eingeschalten wird (nur nicht SPI kontrolliert)" VALUE 0xE65BC Kw_Wu16 655140.0 Time_ms 0.00 655140.0 FORMAT "%8.1" EXTENDED_LIMITS 0.00 655350.0 /end CHARACTERISTIC
/begin CHARACTERISTIC OPSCD_stSensIDWord_C "ID-Word for transition stage for oil pressure" VALUE 0xE6642 Kw_Wu16 65535.00 OneToOne 0.00 65535.00 FORMAT "%8.2" /end CHARACTERISTIC
/begin CHARACTERISTIC OPSCD_stPDfl_C "default value if error" VALUE 0xE6644 Kw_Ws16 1.000000 OneToOne 0.00 1.000000 FORMAT "%8.6" EXTENDED_LIMITS -32768.00 32767.00 /end CHARACTERISTIC
/begin CHARACTERISTIC OPSCD_vMinBack_C "status word for deactivation of the powerstage" VALUE 0xE65BE Kw_Ws16 655.3500 Vel -327.6800 327.6700 FORMAT "%8.4" /end CHARACTERISTIC
/begin CHARACTERISTIC OPSCD_vMinFor_C "status word for deactivation of the powerstage" VALUE 0xE65C0 Kw_Ws16 655.3500 Vel -327.6800 327.6700 FORMAT "%8.4" /end CHARACTERISTIC
/begin CHARACTERISTIC OTSCD_uSRCMin_C "#SSD Minimalwert für SRC OTF-Sensor" VALUE 0xE6648 Kw_Ws16 5200.391 Volt 0.00 5200.391 FORMAT "%8.3" EXTENDED_LIMITS -160156.4 160151.5 /end CHARACTERISTIC
/begin CHARACTERISTIC OTSCD_uSRCMax_C "#SSD Maximalwert für SRC OTF-Sensor" VALUE 0xE664A Kw_Ws16 5200.391 Volt 0.00 5200.391 FORMAT "%8.3" EXTENDED_LIMITS -160156.4 160151.5 /end CHARACTERISTIC
/begin CHARACTERISTIC OTSCD_tLin_CUR "Linearisierungskennlinie für OTF-Sensor" CURVE 0xE664C Kl_Xs16_Ws16 950.0000 Temp_Cels -50.1400 899.8600 FORMAT "%8.4" EXTENDED_LIMITS -3549.940 3003.560
 /begin AXIS_DESCR STD_AXIS OTSCD_uRaw Volt 2 0.00 5200.391 FORMAT "%8.3" EXTENDED_LIMITS -160156.4 160151.5 DEPOSIT ABSOLUTE /end AXIS_DESCR
/end CHARACTERISTIC
/begin CHARACTERISTIC OTSCD_DebNplDef_C "#SSD OTS Fehlerentprellzeit fuer Plausibilitaet" VALUE 0xE6656 Kw_Wu16 655350.0 Time_ms 0.00 655350.0 FORMAT "%8.1" /end CHARACTERISTIC
/begin CHARACTERISTIC OTSCD_DebNplOk_C "OTS Heilungsentprellzeit fuer Plausibilitaet" VALUE 0xE6658 Kw_Wu16 655350.0 Time_ms 0.00 655350.0 FORMAT "%8.1" /end CHARACTERISTIC
/begin CHARACTERISTIC OTSCD_DebSigDef_C "#SSD Fehlerentprellzeit für Öltemperatur Signal von CAN" VALUE 0xE665A Kw_Wu16 655350.0 Time_ms 0.00 655350.0 FORMAT "%8.1" /end CHARACTERISTIC
/begin CHARACTERISTIC OTSCD_DebSigOk_C "Heilungsentprellzeit für Öltemperatur Signal von CAN" VALUE 0xE665C Kw_Wu16 655350.0 Time_ms 0.00 655350.0 FORMAT "%8.1" /end CHARACTERISTIC
/begin CHARACTERISTIC OTSCD_DebSRCHighDef_C "#SSD OTS Fehlerentprellzeit fuer SRC-High" VALUE 0xE665E Kw_Wu16 655350.0 Time_ms 0.00 655350.0 FORMAT "%8.1" /end CHARACTERISTIC
/begin CHARACTERISTIC OTSCD_DebSRCHighOk_C "OTS Heilungsentprellzeit fuer SRC-High" VALUE 0xE6660 Kw_Wu16 655350.0 Time_ms 0.00 655350.0 FORMAT "%8.1" /end CHARACTERISTIC
/begin CHARACTERISTIC OTSCD_DebSRCLowDef_C "#SSD OTS Fehlerentprellzeit fuer SRC-Low" VALUE 0xE6662 Kw_Wu16 655350.0 Time_ms 0.00 655350.0 FORMAT "%8.1" /end CHARACTERISTIC
/begin CHARACTERISTIC OTSCD_DebSRCLowOk_C "OTS Heilungsentprellzeit fuer SRC-Low" VALUE 0xE6664 Kw_Wu16 655350.0 Time_ms 0.00 655350.0 FORMAT "%8.1" /end CHARACTERISTIC
/begin CHARACTERISTIC OTSCD_numAdc_C "#SSD application paramter for engine oil temperature sensor" VALUE 0xE6666 Kw_Wu8 46.0000000000 NumPinAdc 0.00 46.0000000000 FORMAT "%13.10" /end CHARACTERISTIC
/begin CHARACTERISTIC OTSCD_tiStrtOilClntPlaus_C "Zeit nach Start für Plausibilitätsprüfung OTF mit WTF" VALUE 0xE6668 Kw_Wu32 42949672.9500 Time_s 0.00 42949672.9500 FORMAT "%13.4" /end CHARACTERISTIC
/begin CHARACTERISTIC OTSCD_tiDelOilClntPlaus_C "Verzögerungszeit für Plausibilitätsprüfung OTF mit WTF" VALUE 0xE666C Kw_Wu32 42949672.9500 Time_s 0.00 42949672.9500 FORMAT "%13.4" /end CHARACTERISTIC
/begin CHARACTERISTIC OTSCD_tThresOilClntPlaus_C "Schwelle für Plausibilitätsprüfung OTF mit WTF" VALUE 0xE6670 Kw_Ws16 950.000 Temp_Cels -50.140 899.860 FORMAT "%8.3" EXTENDED_LIMITS -3549.940 3003.560 /end CHARACTERISTIC
/begin CHARACTERISTIC OTSCD_tLimOilClntPlaus_C "Plausibilitaets-Fehlergrenze fuer die Oeltemperatur" VALUE 0xE6672 Kw_Ws16 950.000 Temp_Cels -50.140 899.860 FORMAT "%8.3" EXTENDED_LIMITS -3549.940 3003.560 /end CHARACTERISTIC
/begin CHARACTERISTIC OTSCD_dtRmpSlpUp_C "Rampensteigung bei Heilung/Vorgabewert für OTF" VALUE 0xE6674 Kw_Wu32 6553598.99749 RmpTemp 1.00097656250 6553599.99847 FORMAT "%13.5" EXTENDED_LIMITS 0.00 6553599.99847 /end CHARACTERISTIC
/begin CHARACTERISTIC OTSCD_dtRmpSlpDwn_C "Rampensteigung bei Heilung/Vorgabewert für OTF" VALUE 0xE6678 Kw_Wu32 6553598.99749 RmpTemp 1.00097656250 6553599.99847 FORMAT "%13.5" EXTENDED_LIMITS 0.00 6553599.99847 /end CHARACTERISTIC
/begin CHARACTERISTIC OTSCD_swtSigVal_C "Schalterwert, Signal von ADC/CAN" VALUE 0xE667C Kw_Wu8 1.000 OneToOne 0.00 1.000 FORMAT "%5.3" EXTENDED_LIMITS 0.00 255.0 /end CHARACTERISTIC
/begin CHARACTERISTIC OTSCD_stSensIDWord_C "Geberkennwort OTF-Sensor" VALUE 0xE667E Kw_Wu16 65535.00 OneToOne 0.00 65535.00 FORMAT "%8.2" /end CHARACTERISTIC
/begin CHARACTERISTIC OTSCD_tDfl_C "Öltemperatur Vorgabewert" VALUE 0xE6680 Kw_Ws16 950.0000 Temp_Cels -50.1400 899.8600 FORMAT "%8.4" EXTENDED_LIMITS -3549.940 3003.560 /end CHARACTERISTIC
/begin CHARACTERISTIC OvRMon_ctDebToTORQUE_DSCDef_C "Fehlerentprellung für redundante CAN Signalerfassung (ST_TORQ_TAR_DSC)" VALUE 0xC33EC Kw_Wu16 65535.00 OneToOne 0.00 65535.00 FORMAT "%8.2" /end CHARACTERISTIC
/begin CHARACTERISTIC OvRMon_ctDebToTORQUE_DSCOk_C "Heilungsentprellung für redundante CAN Signalerfassung (ST_TORQ_TAR_DSC)" VALUE 0xC33EE Kw_Wu16 65535.00 OneToOne 0.00 65535.00 FORMAT "%8.2" /end CHARACTERISTIC
/begin CHARACTERISTIC OvRMon_ctDebToTORQUE_EGSDef_C "Defektentprellung der redundanten Can-Signalerfassung von ST_TORQ_TAR_GEARBX" VALUE 0xC33E8 Kw_Wu16 65535.00 OneToOne 0.00 65535.00 FORMAT "%8.2" /end CHARACTERISTIC
/begin CHARACTERISTIC OvRMon_ctDebToTORQUE_EGSOk_C "Heilungsentprellung der redundanten Can-Signalerfassung von ST_TORQ_TAR_GEARBX" VALUE 0xC33EA Kw_Wu16 65535.00 OneToOne 0.00 65535.00 FORMAT "%8.2" /end CHARACTERISTIC
/begin CHARACTERISTIC OvRMon_ctDebToTORQUE_SSGDef_C "Fehlerentprellung der redundanten Can-Signalerfassung von ST_TORQ_TAR_SSG" VALUE 0xC33F0 Kw_Wu16 65535.00 OneToOne 0.00 65535.00 FORMAT "%8.2" /end CHARACTERISTIC
/begin CHARACTERISTIC OvRMon_ctDebToTORQUE_SSGOk_C "Heilungsentprellung der redundanten Can-Signalerfassung von ST_TORQ_TAR_SSG" VALUE 0xC33F2 Kw_Wu16 65535.00 OneToOne 0.00 65535.00 FORMAT "%8.2" /end CHARACTERISTIC
/begin CHARACTERISTIC OvRMon_ctEngSpdGrad_C "#SSD Zähler zum Erkennen eines positiven Drehzahlgradients" VALUE 0xC3166 Kw_Wu16 65535.00 OneToOne 0.00 65535.00 FORMAT "%8.2" /end CHARACTERISTIC
/begin CHARACTERISTIC OvRMon_DebETDef_C "#SSD Defekt Entprellzeit wenn Ansteuerdauer größer Grenzwert" VALUE 0xC3168 Kw_Wu16 65535.00 OneToOne 0.00 65535.00 FORMAT "%8.2" /end CHARACTERISTIC
/begin CHARACTERISTIC OvRMon_DebSigA0Def_C "#SSD Defekterkennungszeit für Drehzahlplausibilisierung in Schubüberwachung" VALUE 0xC31F4 Kw_Wu16 655350.0 TimeDeb 0.00 655350.0 FORMAT "%8.1" /end CHARACTERISTIC
/begin CHARACTERISTIC OvRMon_facInjEff_MAP "#SSD Wirkungsfaktorkennfeld in der Schubüberwachung" MAP 0xC3204 Kf_Xs16_Ys16_Ws16 1.000000 Fact 0.00 1.000000 FORMAT "%8.6" EXTENDED_LIMITS -4.000000 3.999878
 /begin AXIS_DESCR STD_AXIS Eng_nAvrg EngN 16 0.00 6000.000 FORMAT "%8.3" EXTENDED_LIMITS -32768.00 32767.00 DEPOSIT ABSOLUTE /end AXIS_DESCR
 /begin AXIS_DESCR STD_AXIS OvRMon_phiInjAct_mp AngleCrS 12 -720.0000 720.0000 FORMAT "%8.4" EXTENDED_LIMITS -768.0000 767.9766 DEPOSIT ABSOLUTE /end AXIS_DESCR
/end CHARACTERISTIC
/begin CHARACTERISTIC OvRMon_nDiffMax_C "#SSD Maximal zulässige Abweichung der Drehzahlen Ebene1 - Ebene 2" VALUE 0xC31F6 Kw_Ws16 5960.000 EngN 40.00000 6000.000 FORMAT "%8.3" EXTENDED_LIMITS -32768.00 32767.00 /end CHARACTERISTIC
/begin CHARACTERISTIC OvRMon_nLIGovLim_C "#SSD Grenze Kurbelwellen Drehzahl für aktive Leerlaufregler Überwachung" VALUE 0xC316A Kw_Ws16 6000.000 EngN 0.00 6000.000 FORMAT "%8.3" EXTENDED_LIMITS -32768.00 32767.00 /end CHARACTERISTIC
/begin CHARACTERISTIC OvRMon_nMin_C "Drehzahlschwelle zur Aktivierung der Schubüberwachung" VALUE 0xC316C Kw_Ws16 6000.000 EngN 0.00 6000.000 FORMAT "%8.3" EXTENDED_LIMITS -32768.00 32767.00 /end CHARACTERISTIC
/begin CHARACTERISTIC OvRMon_nSegMax_C "#SSD Ersatzwert für Segmentdrehzahl bei Unterschreitung der Mindestsegmentdauer" VALUE 0xC31F8 Kw_Ws16 5960.000 EngN 40.00000 6000.000 FORMAT "%8.3" EXTENDED_LIMITS -32768.00 32767.00 /end CHARACTERISTIC
/begin CHARACTERISTIC OvRMon_nSegMin_C "#SSD Mindestdrehzahl zur Aktivierung der Drehzahlplausibilisierung" VALUE 0xC31FA Kw_Ws16 5960.000 EngN 40.00000 6000.000 FORMAT "%8.3" EXTENDED_LIMITS -32768.00 32767.00 /end CHARACTERISTIC
/begin CHARACTERISTIC OvRMon_nStSysLim_C "#SSD Grenze Kurbelwellen Drehzahl für aktive Startsystem Überwachung" VALUE 0xC316E Kw_Ws16 6000.000 EngN 0.00 6000.000 FORMAT "%8.3" EXTENDED_LIMITS -32768.00 32767.00 /end CHARACTERISTIC
/begin CHARACTERISTIC OvRMon_nThresNrml2Strt_C "#SSD Grenze Kurbelwellen Drehzahl inaktive Startsystem Überwachung" VALUE 0xC3170 Kw_Ws16 6000.000 EngN 0.00 6000.000 FORMAT "%8.3" EXTENDED_LIMITS -32768.00 32767.00 /end CHARACTERISTIC
/begin CHARACTERISTIC OvRMon_stIntrInit_C "#SSD Kennung für Interruptstatus" VALUE 0xC31FC Kw_Wu8 255.0 OneToOne 0.00 255.0 FORMAT "%5.1" /end CHARACTERISTIC
/begin CHARACTERISTIC OvRMon_tiAPP1Flt_C "#SSD Wartezeit Fahrpedalfilterung, Führungsformung in der Schubüberwachung" VALUE 0xC3172 Kw_Wu16 655350.0 TimeDeb 0.00 655350.0 FORMAT "%8.1" /end CHARACTERISTIC
/begin CHARACTERISTIC OvRMon_tiASDdc_C "#SSD Wartezeit Eingriff Störungsregler aktiv" VALUE 0xC3174 Kw_Wu16 655350.0 TimeDeb 0.00 655350.0 FORMAT "%8.1" /end CHARACTERISTIC
/begin CHARACTERISTIC OvRMon_tiCompAcsTemp_C "#SSD Wartezeit Kompensation Nebenaggregate in der Schubüberwachung" VALUE 0xC3176 Kw_Wu16 655350.0 TimeDeb 0.00 655350.0 FORMAT "%8.1" /end CHARACTERISTIC
/begin CHARACTERISTIC OvRMon_tiCrCtlBrkRmp_C "#SSD Wartezeit Fahrgeschwindigkeitsregler-Ausschaltrampe nach Bremse in der Schubüberwachung" VALUE 0xC3178 Kw_Wu16 655350.0 TimeDeb 0.00 655350.0 FORMAT "%8.1" /end CHARACTERISTIC
/begin CHARACTERISTIC OvRMon_tiCrCtlConvRmp_C "#SSD Wartezeit Fahrgeschwindigkeitsregler-Ausschaltrampe nach Kupplung in der Schubüberwachung" VALUE 0xC317A Kw_Wu16 655350.0 TimeDeb 0.00 655350.0 FORMAT "%8.1" /end CHARACTERISTIC
/begin CHARACTERISTIC OvRMon_tiDebBrk_C "#SSD Entprellzeit für redundante Erfassung des Bremssignals" VALUE 0xC31EE Kw_Wu8 2550. TimeDeb 0.00 2550. FORMAT "%5.0" /end CHARACTERISTIC
/begin CHARACTERISTIC OvRMon_tiDebConv_C "#SSD Entprellzeit für redundante Erfassung des Kupplungssignals" VALUE 0xC31EF Kw_Wu8 2550. TimeDeb 0.00 2550. FORMAT "%5.0" /end CHARACTERISTIC
/begin CHARACTERISTIC OvRMon_tiDebT15_C "#SSD Entprellzeit für redundante Erfassung der Klemme 15" VALUE 0xC31F0 Kw_Wu8 2550. TimeDeb 0.00 2550. FORMAT "%5.0" /end CHARACTERISTIC
/begin CHARACTERISTIC OvRMon_tiEngSpdRlsBrkRmp_C "Entprellzeit des Bremssignals im Falle der allgemeinen Drehzahlanforderung" VALUE 0xC317C Kw_Wu16 655350.0 TimeDeb 0.00 655350.0 FORMAT "%8.1" /end CHARACTERISTIC
/begin CHARACTERISTIC OvRMon_tiErrAPP_C "#SSD Fehlerentprellzeit für Fahrpedalüberwachung" VALUE 0xC31E6 Kw_Wu8 2550. TimeDeb 0.00 2550. FORMAT "%5.0" /end CHARACTERISTIC
/begin CHARACTERISTIC OvRMon_tiErrDblStorage_C "#SSD Entprellzeit für Fehler in der Doppelablage" VALUE 0xC317E Kw_Wu8 5100. Time_ms_20ms 0.00 5100. FORMAT "%5.0" /end CHARACTERISTIC
/begin CHARACTERISTIC OvRMon_tiLimET_MAP "zulässige Ansteuerdauer abhängig von Drehzahl und Zeit nach Aktivierung der Schubüberwachung" MAP 0xC3180 Kf_Xs16_Ys16_Ws16 32767.00 InjTime_us 0.00 32767.00 FORMAT "%8.2" EXTENDED_LIMITS -32768.00 32767.00
 /begin AXIS_DESCR STD_AXIS OvRMon_nAvrg EngN 6 0.00 6000.000 FORMAT "%8.3" EXTENDED_LIMITS -32768.00 32767.00 DEPOSIT ABSOLUTE /end AXIS_DESCR
 /begin AXIS_DESCR STD_AXIS OvRMon_tiOvRMonActive_mp Time_ms 6 0.00 5000.000 FORMAT "%8.3" EXTENDED_LIMITS -327680.0 327670.0 DEPOSIT ABSOLUTE /end AXIS_DESCR
/end CHARACTERISTIC
/begin CHARACTERISTIC OvRMon_tiSegMin_C "#SSD Mindestsegmentdauer für Übernahme der Segmentdrehzahl aus Systemzeit" VALUE 0xC3200 Kw_Wu32 4294967295.00 TimeUSResolution 0.00 4294967295.00 FORMAT "%13.2" /end CHARACTERISTIC
/begin CHARACTERISTIC OvRMon_uAPP1Lim_C "#SSD Spannungsgrenze für Überwachung Pedalwertgeber, Leergasschwelle der Überwachung" VALUE 0xC31E4 Kw_Ws16 5200.391 Volt 0.00 5200.391 FORMAT "%8.3" EXTENDED_LIMITS -160156.4 160151.5 /end CHARACTERISTIC
/begin CHARACTERISTIC OvRMon_uAPPFull_C "#SSD Spannungsgrenze für Fahrpedal im Volllastbereich" VALUE 0xC31E8 Kw_Ws16 5200.391 Volt 0.00 5200.391 FORMAT "%8.3" EXTENDED_LIMITS -160156.4 160151.5 /end CHARACTERISTIC
/begin CHARACTERISTIC OvRMon_uPlaWinFull_C "#SSD Plausibilitätsfenster für Fahrpedal im Volllastbereich" VALUE 0xC31EA Kw_Ws16 5200.391 Volt 0.00 5200.391 FORMAT "%8.3" EXTENDED_LIMITS -160156.4 160151.5 /end CHARACTERISTIC
/begin CHARACTERISTIC OvRMon_uPlaWinIdle_C "#SSD Plausibilitätsfenster für Fahpedal im Leerlaufbereich" VALUE 0xC31EC Kw_Ws16 5200.391 Volt 0.00 5200.391 FORMAT "%8.3" EXTENDED_LIMITS -160156.4 160151.5 /end CHARACTERISTIC
/begin CHARACTERISTIC OxiCCD_uSRCMinTPre_C "Minimalwert SRC-Überwachung von OxiCCD_uRawTempPre" VALUE 0xE6684 Kw_Ws16 5200.391 Volt 0.00 5200.391 FORMAT "%8.3" EXTENDED_LIMITS -160156.4 160151.5 /end CHARACTERISTIC
/begin CHARACTERISTIC OxiCCD_uSRCMaxTPre_C "Maximalwert SRC-Überwachung von OxiCCD_uRawTempPre" VALUE 0xE6686 Kw_Ws16 5200.391 Volt 0.00 5200.391 FORMAT "%8.3" EXTENDED_LIMITS -160156.4 160151.5 /end CHARACTERISTIC
/begin CHARACTERISTIC OxiCCD_tLinPre_CUR "Linearisierungskennlinie für OxiCCD_uRawTempPre" CURVE 0xE6688 Kl_Xs16_Ws16 950.000 Temp_Cels -50.140 899.860 FORMAT "%8.3" EXTENDED_LIMITS -3549.940 3003.560
 /begin AXIS_DESCR STD_AXIS OxiCCD_uRawTempPre Volt 16 0.00 160151.5 FORMAT "%8.1" EXTENDED_LIMITS -160156.4 160151.5 DEPOSIT ABSOLUTE /end AXIS_DESCR
/end CHARACTERISTIC
/begin CHARACTERISTIC OxiCCD_DebSRCHighDefTPre_C "Entprellzeit für Fehlererkennung SRC-high-Fehler für Dfp_OxiCCDTPre" VALUE 0xE66CA Kw_Wu16 655350.0 Time_ms 0.00 655350.0 FORMAT "%8.1" /end CHARACTERISTIC
/begin CHARACTERISTIC OxiCCD_DebSRCHighOkTPre_C "Entprellzeit für Fehlerheilung SRC-high-Fehler für Dfp_OxiCCDTPre" VALUE 0xE66CC Kw_Wu16 655350.0 Time_ms 0.00 655350.0 FORMAT "%8.1" /end CHARACTERISTIC
/begin CHARACTERISTIC OxiCCD_DebSRCLowDefTPre_C "Entprellzeit für Fehlererkennung SRC-low-Fehler für Dfp_OxiCCDTPre" VALUE 0xE66CE Kw_Wu16 655350.0 Time_ms 0.00 655350.0 FORMAT "%8.1" /end CHARACTERISTIC
/begin CHARACTERISTIC OxiCCD_DebSRCLowOkTPre_C "Entprellzeit für Fehlerheilung SRC-low-Fehler für Dfp_OxiCCDTPre" VALUE 0xE66D0 Kw_Wu16 655350.0 Time_ms 0.00 655350.0 FORMAT "%8.1" /end CHARACTERISTIC
/begin CHARACTERISTIC OxiCCD_numTempPreADC_C "Zahl zur Auswahl des ADC-Kanals" VALUE 0xE66D2 Kw_Wu8 46.0000000000 NumPinAdc 0.00 46.0000000000 FORMAT "%13.10" /end CHARACTERISTIC
/begin CHARACTERISTIC OxiCCD_dtRmpSlpUpPre_C "Rampensteigung aufwärts für Komponententreiber Temperatur vor Oxidationskatalysator" VALUE 0xE66D4 Kw_Wu32 6553598.99749 RmpTemp 1.00097656250 6553599.99847 FORMAT "%13.5" EXTENDED_LIMITS 0.00 6553599.99847 /end CHARACTERISTIC
/begin CHARACTERISTIC OxiCCD_dtRmpSlpDwnPre_C "Rampensteigung abwärts für Komponententreiber Temperatur vor Oxidationskatalysator" VALUE 0xE66D8 Kw_Wu32 6553598.99749 RmpTemp 1.00097656250 6553599.99847 FORMAT "%13.5" EXTENDED_LIMITS 0.00 6553599.99847 /end CHARACTERISTIC
/begin CHARACTERISTIC OxiCCD_stSensIDWordTPre_C "Sensor ID Word für Übergangsbedingungen Temperatursensor vor Oxidationskatalysator" VALUE 0xE66DC Kw_Wu16 65535.00 OneToOne 0.00 65535.00 FORMAT "%8.2" /end CHARACTERISTIC
/begin CHARACTERISTIC OxiCCD_tDflPre_C "Ersatzwert Temperatur vor Oxidationskatalysator im Fehlerfall" VALUE 0xE66DE Kw_Ws16 950.000 Temp_Cels -50.140 899.860 FORMAT "%8.3" EXTENDED_LIMITS -3549.940 3003.560 /end CHARACTERISTIC
/begin CHARACTERISTIC PCBS_facFlTotDMEChg_C "liter calculation in the case of DME change" VALUE 0xE66E0 Kw_Ws16 65535.00 OneToOne -32768.00 32767.00 FORMAT "%8.2" /end CHARACTERISTIC
/begin CHARACTERISTIC PCBS_lCalcDistance_CUR "Curve for calculation of rest distance" CURVE 0xE66E2 Kl_Xs16_Ws16 35000.00 km_sw_q10 -5000.000 30000.00 FORMAT "%8.2" EXTENDED_LIMITS -327680.0 327670.0
 /begin AXIS_DESCR STD_AXIS PFlt_mAshOil mSoot_g 8 0.00 15.00000 FORMAT "%8.5" EXTENDED_LIMITS -327.6800 327.6700 DEPOSIT ABSOLUTE /end AXIS_DESCR
/end CHARACTERISTIC
/begin CHARACTERISTIC PCBS_qCalcFlTot_CUR "curve for calculation of the used liters" CURVE 0xE6704 Kl_Xs16_Ws16 320.0000 Fl_2 0.00 320.0000 FORMAT "%8.4" EXTENDED_LIMITS -327680.0 327670.0
 /begin AXIS_DESCR STD_AXIS PCBS_dAvaiDMEChg_mp OneToOne 8 0.00 100.0 FORMAT "%5.1" EXTENDED_LIMITS 0.00 255.0 DEPOSIT ABSOLUTE /end AXIS_DESCR
/end CHARACTERISTIC
/begin CHARACTERISTIC PCR_I1AdPCVKi_C "Grundwert der I-Verstaerkung des I-Reglers bei Kleinsignalen" VALUE 0xE8BD4 Kw_Wu32 999999.999767 Ki 0.00 999999.999767 FORMAT "%13.6" /end CHARACTERISTIC
/begin CHARACTERISTIC PCR_I1AdPCVKiPos_C "Grundwert der I-Verstaerkung des I-Reglers bei positiven Grossesignalen" VALUE 0xE8BD8 Kw_Wu32 999999.999767 Ki 0.00 999999.999767 FORMAT "%13.6" /end CHARACTERISTIC
/begin CHARACTERISTIC PCR_I1AdPCVKiNeg_C "Grundwert der I-Verstaerkung des I-Reglers bei negativen Grossesignalen" VALUE 0xE8BDC Kw_Wu32 999999.999767 Ki 0.00 999999.999767 FORMAT "%13.6" /end CHARACTERISTIC
/begin CHARACTERISTIC PCR_rI1AdPCVWinPos_C "obere Kleinsignalgrenze des I-Reglers" VALUE 0xE8BE0 Kw_Ws16 799.9878 Prc -400.0000 399.9878 FORMAT "%8.4" /end CHARACTERISTIC
/begin CHARACTERISTIC PCR_rI1AdPCVWinNeg_C "untere Kleinsignalgrenze des I-Reglers" VALUE 0xE8BE2 Kw_Ws16 799.9878 Prc -400.0000 399.9878 FORMAT "%8.4" /end CHARACTERISTIC
/begin CHARACTERISTIC PCR_I2AdPCVKi_C "Grundwert der I-Verstaerkung des I-Reglers bei Kleinsignalen" VALUE 0xE8BE4 Kw_Wu32 999999.999767 Ki 0.00 999999.999767 FORMAT "%13.6" /end CHARACTERISTIC
/begin CHARACTERISTIC PCR_I2AdPCVKiPos_C "Grundwert der I-Verstaerkung des I-Reglers bei positiven Grossesignalen" VALUE 0xE8BE8 Kw_Wu32 999999.999767 Ki 0.00 999999.999767 FORMAT "%13.6" /end CHARACTERISTIC
/begin CHARACTERISTIC PCR_I2AdPCVKiNeg_C "Grundwert der I-Verstaerkung des I-Reglers bei negativen Grossesignalen" VALUE 0xE8BEC Kw_Wu32 999999.999767 Ki 0.00 999999.999767 FORMAT "%13.6" /end CHARACTERISTIC
/begin CHARACTERISTIC PCR_rI2AdPCVWinPos_C "obere Kleinsignalgrenze des I-Reglers" VALUE 0xE8BF0 Kw_Ws16 799.9878 Prc -400.0000 399.9878 FORMAT "%8.4" /end CHARACTERISTIC
/begin CHARACTERISTIC PCR_rI2AdPCVWinNeg_C "untere Kleinsignalgrenze des I-Reglers" VALUE 0xE8BF2 Kw_Ws16 799.9878 Prc -400.0000 399.9878 FORMAT "%8.4" /end CHARACTERISTIC
/begin CHARACTERISTIC PCR_I3AdPCVKi_C "Grundwert der I-Verstaerkung des I-Reglers bei Kleinsignalen" VALUE 0xE8BF4 Kw_Wu32 999999.999767 Ki 0.00 999999.999767 FORMAT "%13.6" /end CHARACTERISTIC
/begin CHARACTERISTIC PCR_I3AdPCVKiPos_C "Grundwert der I-Verstaerkung des I-Reglers bei positiven Grossesignalen" VALUE 0xE8BF8 Kw_Wu32 999999.999767 Ki 0.00 999999.999767 FORMAT "%13.6" /end CHARACTERISTIC
/begin CHARACTERISTIC PCR_I3AdPCVKiNeg_C "Grundwert der I-Verstaerkung des I-Reglers bei negativen Grossesignalen" VALUE 0xE8BFC Kw_Wu32 999999.999767 Ki 0.00 999999.999767 FORMAT "%13.6" /end CHARACTERISTIC
/begin CHARACTERISTIC PCR_rI3AdPCVWinPos_C "obere Kleinsignalgrenze des I-Reglers" VALUE 0xE8C00 Kw_Ws16 799.9878 Prc -400.0000 399.9878 FORMAT "%8.4" /end CHARACTERISTIC
/begin CHARACTERISTIC PCR_rI3AdPCVWinNeg_C "untere Kleinsignalgrenze des I-Reglers" VALUE 0xE8C02 Kw_Ws16 799.9878 Prc -400.0000 399.9878 FORMAT "%8.4" /end CHARACTERISTIC
/begin CHARACTERISTIC PCR_I4AdPCVKi_C "Grundwert der I-Verstaerkung des I-Reglers bei Kleinsignalen" VALUE 0xE8C04 Kw_Wu32 999999.999767 Ki 0.00 999999.999767 FORMAT "%13.6" /end CHARACTERISTIC
/begin CHARACTERISTIC PCR_I4AdPCVKiPos_C "Grundwert der I-Verstaerkung des I-Reglers bei positiven Grossesignalen" VALUE 0xE8C08 Kw_Wu32 999999.999767 Ki 0.00 999999.999767 FORMAT "%13.6" /end CHARACTERISTIC
/begin CHARACTERISTIC PCR_I4AdPCVKiNeg_C "Grundwert der I-Verstaerkung des I-Reglers bei negativen Grossesignalen" VALUE 0xE8C0C Kw_Wu32 999999.999767 Ki 0.00 999999.999767 FORMAT "%13.6" /end CHARACTERISTIC
/begin CHARACTERISTIC PCR_rI4AdPCVWinPos_C "obere Kleinsignalgrenze des I-Reglers" VALUE 0xE8C10 Kw_Ws16 799.9878 Prc -400.0000 399.9878 FORMAT "%8.4" /end CHARACTERISTIC
/begin CHARACTERISTIC PCR_rI4AdPCVWinNeg_C "untere Kleinsignalgrenze des I-Reglers" VALUE 0xE8C12 Kw_Ws16 799.9878 Prc -400.0000 399.9878 FORMAT "%8.4" /end CHARACTERISTIC
/begin CHARACTERISTIC PCR_tiDT1DesCld_C "Verzögerungszeitkonstante der dynamischen Sollwertbildung bei kaltem Motor" VALUE 0xE7ECC Kw_Wu32 4294.9663 TimeDelay_s 0.0010000001 4294.9673 FORMAT "%9.4" EXTENDED_LIMITS 0.0000010000000 4294.9673 /end CHARACTERISTIC
/begin CHARACTERISTIC PCR_DKdDesCld_C "Kleinsignalverstärkung der dynamischen Sollwertbildung bei kaltem Motor" VALUE 0xE7ED0 Kw_Ws32 65535.9999847 Kd -32768.0000000 32767.9999847 FORMAT "%13.7" /end CHARACTERISTIC
/begin CHARACTERISTIC PCR_DKdPosDesCld_C "Positive Großsignalverstärkung der dynamischen Sollwertbildung bei kaltem Motor" VALUE 0xE7ED4 Kw_Ws32 65535.9999847 Kd -32768.0000000 32767.9999847 FORMAT "%13.7" /end CHARACTERISTIC
/begin CHARACTERISTIC PCR_DKdNegDesCld_C "Negative Großsignalverstärkung der dynamischen Sollwertbildung bei kaltem Motor" VALUE 0xE7ED8 Kw_Ws32 65535.9999847 Kd -32768.0000000 32767.9999847 FORMAT "%13.7" /end CHARACTERISTIC
/begin CHARACTERISTIC PCR_dpDWinPosDesCld_C "Positive Kleinsignalgrenze bei kaltem Motor" VALUE 0xE7EDC Kw_Ws16 65535.00 Pres_hPa -32768.00 32767.00 FORMAT "%8.2" /end CHARACTERISTIC
/begin CHARACTERISTIC PCR_dpDWinNegDesCld_C "Negative Kleinsignalgrenze bei kaltem Motor" VALUE 0xE7EDE Kw_Ws16 65535.00 Pres_hPa -32768.00 32767.00 FORMAT "%8.2" /end CHARACTERISTIC
/begin CHARACTERISTIC PCR_dlyPT1_C "Zeitkonstante der Sollwertverzögerung für I-Anteil" VALUE 0xE8C14 Kw_Wu32 4294.9663 TimeDelay_s 0.0010000001 4294.9673 FORMAT "%9.4" EXTENDED_LIMITS 0.0000010000000 4294.9673 /end CHARACTERISTIC
/begin CHARACTERISTIC PCR_dnAvrgAdPCVLim_C "Maximale Grenze fuer Motordrehzahl Beschleunigung" VALUE 0xE8C18 Kw_Ws16 655350.0 dn_dZ20 -327680.0 327670.0 FORMAT "%8.1" /end CHARACTERISTIC
/begin CHARACTERISTIC PCR_tiDnCorrDT1_C "Time delay for DT1 (engine-speed gradient calculation)" VALUE 0xE8C1C Kw_Wu32 4294.9673 TimeDelay_s 0.0000010000000 4294.9673 FORMAT "%9.4" /end CHARACTERISTIC
/begin CHARACTERISTIC PCR_DnCorrDKd_C "Gain for DT1 (engine-speed gradient calculation)" VALUE 0xE8C20 Kw_Ws32 32767.9999924 Kd_rpm2dndt -16384.0000000 16383.9999924 FORMAT "%13.7" /end CHARACTERISTIC
/begin CHARACTERISTIC PCR_dnSurgeHigh_CUR "Higher limit for hysteresis to monitor rate of change of Eng_nAvrg for Anti-Surge LIGov" CURVE 0xE7DFC Kl_Xs16_Ws16 3000.000 dn_dZ20 0.00 3000.000 FORMAT "%8.3" EXTENDED_LIMITS -327680.0 327670.0
 /begin AXIS_DESCR STD_AXIS Eng_nAvrg EngN 5 0.00 6000.000 FORMAT "%8.3" EXTENDED_LIMITS -32768.00 32767.00 DEPOSIT ABSOLUTE /end AXIS_DESCR
/end CHARACTERISTIC
/begin CHARACTERISTIC PCR_dnSurgeLow_CUR "Lower limit for hysteresis to monitor rate of change of Eng_nAvrg for Anti-Surge LIGov" CURVE 0xE7E12 Kl_Xs16_Ws16 3000.000 dn_dZ20 0.00 3000.000 FORMAT "%8.3" EXTENDED_LIMITS -327680.0 327670.0
 /begin AXIS_DESCR STD_AXIS Eng_nAvrg EngN 5 0.00 6000.000 FORMAT "%8.3" EXTENDED_LIMITS -32768.00 32767.00 DEPOSIT ABSOLUTE /end AXIS_DESCR
/end CHARACTERISTIC
/begin CHARACTERISTIC PCR_dpBDes_C "Derivative of desired boost pressure" VALUE 0xE7EE0 Kw_Ws16 8000.000 dp_dZ20 -4000.000 4000.000 FORMAT "%8.3" EXTENDED_LIMITS -327680.0 327670.0 /end CHARACTERISTIC
/begin CHARACTERISTIC PCR_tiDpCorrDT1_C "Zeitverzögerung für die D-Parameterkorrektur aus dem Ladedruckgradienten" VALUE 0xE8C24 Kw_Wu32 4294.9673 TimeDelay_s 0.0000010000000 4294.9673 FORMAT "%9.4" /end CHARACTERISTIC
/begin CHARACTERISTIC PCR_dpCorrDKd_C "Faktor für D-Parameter Korrektur generiert aus dem Ladedruckgradient" VALUE 0xE8C28 Kw_Ws32 32767.9999924 Kd_Pres2dpdt -16384.0000000 16383.9999924 FORMAT "%13.7" /end CHARACTERISTIC
/begin CHARACTERISTIC PCR_dpSlpLimDwn_C "Down slope" VALUE 0xE7EE4 Kw_Wu32 65535949.9817 RmpPres_hPa 50.0030517578 65535999.9847 FORMAT "%13.4" EXTENDED_LIMITS 0.00 65535999.9847 /end CHARACTERISTIC
/begin CHARACTERISTIC PCR_dpSlpLimUp_C "Up slope" VALUE 0xE7EE8 Kw_Wu32 65535949.9817 RmpPres_hPa 50.0030517578 65535999.9847 FORMAT "%13.4" EXTENDED_LIMITS 0.00 65535999.9847 /end CHARACTERISTIC
/begin CHARACTERISTIC PCR_dqCtlAdPCVLim_C "Maximale Grenze fuer Einspritzmenge" VALUE 0xE8C2C Kw_Ws16 32767.50 InjMassPerSec_20ms -16384.00 16383.50 FORMAT "%8.2" /end CHARACTERISTIC
/begin CHARACTERISTIC PCR_tiAdPCVqCtlDT1_C "Zeitkonstante T1 des PT1-Filters im DT1-Filter" VALUE 0xE8C30 Kw_Wu32 4294.9663 TimeDelay_s 0.0010000001 4294.9673 FORMAT "%9.4" EXTENDED_LIMITS 0.0000010000000 4294.9673 /end CHARACTERISTIC
/begin CHARACTERISTIC PCR_DKdAdPCVqCtlDT1_C "Differentiationsfaktor Kd (fuer Kd=0.02 gilt y(k)=exp(-Ts/T1)*y(k-1)+(x(k)-x(k-1)))" VALUE 0xE8C34 Kw_Ws32 10.0000000000 Kd 0.00 10.0000000000 FORMAT "%13.10" EXTENDED_LIMITS -32768.0000000 32767.9999847 /end CHARACTERISTIC
/begin CHARACTERISTIC PCR_dqDes_C "Application constant for derivative of desired fuel quantity" VALUE 0xE7EEC Kw_Ws16 200.0000 InjMassPerSec_20ms 0.00 200.0000 FORMAT "%8.4" EXTENDED_LIMITS -16384.00 16383.50 /end CHARACTERISTIC
/begin CHARACTERISTIC PCR_drAdPCVCtlRmpUp_C "Rampensteigung (steigend) für Ausgabewert der adaptiven Vorsteuerung" VALUE 0xE8C38 Kw_Wu32 799998.699874 RmpPrc 1.29994004965 799999.999814 FORMAT "%13.6" EXTENDED_LIMITS 0.00 799999.999814 /end CHARACTERISTIC
/begin CHARACTERISTIC PCR_drAdPCVCtlRmpDwn_C "Rampensteigung (fallend) für Ausgabewert der adaptiven Vorsteuerung" VALUE 0xE8C3C Kw_Wu32 799998.699874 RmpPrc 1.29994004965 799999.999814 FORMAT "%13.6" EXTENDED_LIMITS 0.00 799999.999814 /end CHARACTERISTIC
/begin CHARACTERISTIC PCR_drAPP1UnFlt_C "Application constant for ratio of Accelerator pedal 1 position unfiltered value" VALUE 0xE7EEE Kw_Ws16 100.0977 PrcPerSec 0.00 100.0977 FORMAT "%8.4" EXTENDED_LIMITS -20000.00 19999.39 /end CHARACTERISTIC
/begin CHARACTERISTIC PCR_drBPALPRmpUp_C "Positive Rampensteigung" VALUE 0xE95B4 Kw_Wu32 799999.999814 RmpPrc 0.00 799999.999814 FORMAT "%13.6" /end CHARACTERISTIC
/begin CHARACTERISTIC PCR_drBPALPRmpDwn_C "Negative Rampensteigung" VALUE 0xE95B8 Kw_Wu32 799999.999814 RmpPrc 0.00 799999.999814 FORMAT "%13.6" /end CHARACTERISTIC
/begin CHARACTERISTIC PCR_drBPGovMaxDynUp_C "Rate of increase of dynamic correction for maximum allowable PCR governor output" VALUE 0xE8C40 Kw_Wu32 100.000016391 RmpPrc 0.00 100.000016391 FORMAT "%13.9" EXTENDED_LIMITS 0.00 799999.999814 /end CHARACTERISTIC
/begin CHARACTERISTIC PCR_drBPGovMaxDynDn_C "Rate of decrease of dynamic correction for maximum allowable PCR governor output" VALUE 0xE8C44 Kw_Wu32 100.000016391 RmpPrc 0.00 100.000016391 FORMAT "%13.9" EXTENDED_LIMITS 0.00 799999.999814 /end CHARACTERISTIC
/begin CHARACTERISTIC PCR_drSurge2RmpUp_C "Rampe Up AntiSurge - PCR_rCtlVal" VALUE 0xE6728 Kw_Wu32 3999.99991059 RmpPrc 0.00 3999.99991059 FORMAT "%13.8" EXTENDED_LIMITS 0.00 799999.999814 /end CHARACTERISTIC
/begin CHARACTERISTIC PCR_drSurge2RmpDwn_C "Rampe Down AntiSurge - PCR_rCtlVal" VALUE 0xE672C Kw_Wu32 3999.99991059 RmpPrc 0.00 3999.99991059 FORMAT "%13.8" EXTENDED_LIMITS 0.00 799999.999814 /end CHARACTERISTIC
/begin CHARACTERISTIC PCR_tiBDesRaw_C "Reciprocal of time delay" VALUE 0xE7EF0 Kw_Wu32 4294.9663 TimeDelay_s 0.0010000001 4294.9673 FORMAT "%9.4" EXTENDED_LIMITS 0.0000010000000 4294.9673 /end CHARACTERISTIC
/begin CHARACTERISTIC PCR_dpBDesRaw_C "Differential factor" VALUE 0xE7EF4 Kw_Ws32 8000.00000000 Kd_Pres2dpdt -4000.00000000 4000.00000000 FORMAT "%13.8" EXTENDED_LIMITS -16384.0000000 16383.9999924 /end CHARACTERISTIC
/begin CHARACTERISTIC PCR_tiDT1qDes_C "Time delay factor for the DT1 filter for desired fuel quantity" VALUE 0xE7EF8 Kw_Wu32 4294.9663 TimeDelay_s 0.0010000001 4294.9673 FORMAT "%9.4" EXTENDED_LIMITS 0.0000010000000 4294.9673 /end CHARACTERISTIC
/begin CHARACTERISTIC PCR_DKdqDes_C "Differential factor for DT1 filter for desired fuel quantity" VALUE 0xE7EFC Kw_Ws32 10.0000000000 Kd 0.00 10.0000000000 FORMAT "%13.10" EXTENDED_LIMITS -32768.0000000 32767.9999847 /end CHARACTERISTIC
/begin CHARACTERISTIC PCR_tiDT1rAPP1_C "time delay for DT1 filter for Accelerator pedal 1 position" VALUE 0xE7F00 Kw_Wu32 4294.9663 TimeDelay_s 0.0010000001 4294.9673 FORMAT "%9.4" EXTENDED_LIMITS 0.0000010000000 4294.9673 /end CHARACTERISTIC
/begin CHARACTERISTIC PCR_DKdrAPP1_C "Derivative factor for DT1 Filter for Accelerator pedal 1 position" VALUE 0xE7F04 Kw_Ws32 10.0000000000 Kd 0.00 10.0000000000 FORMAT "%13.10" EXTENDED_LIMITS -32768.0000000 32767.9999847 /end CHARACTERISTIC
/begin CHARACTERISTIC PCR_tiDT1LP_C "Verzoegerungszeitkonstante fuer das DT1-Glied des PIDT1-Reglers" VALUE 0xE95BC Kw_Wu32 4294.9663 TimeDelay_s 0.0010000001 4294.9673 FORMAT "%9.4" EXTENDED_LIMITS 0.0000010000000 4294.9673 /end CHARACTERISTIC
/begin CHARACTERISTIC PCR_DKdLP_C "Grundwert der D-Verstaerkung des PIDT1-Reglers bei Kleinsignalen" VALUE 0xE95C0 Kw_Ws32 9.99999996275 Kd_Pres_hPa2Prc 0.00 9.99999996275 FORMAT "%13.10" EXTENDED_LIMITS -400.000000000 399.999999814 /end CHARACTERISTIC
/begin CHARACTERISTIC PCR_DKdPosLP_C "Grundwert der D-Verstaerkung des PIDT1-Reglers bei positiven Groszsignalen" VALUE 0xE95C4 Kw_Ws32 9.99999996275 Kd_Pres_hPa2Prc 0.00 9.99999996275 FORMAT "%13.10" EXTENDED_LIMITS -400.000000000 399.999999814 /end CHARACTERISTIC
/begin CHARACTERISTIC PCR_DKdNegLP_C "Grundwert der  D-Verstaerkung des PIDT1-Reglers bei negativen Groszsignalen" VALUE 0xE95C8 Kw_Ws32 9.99999996275 Kd_Pres_hPa2Prc 0.00 9.99999996275 FORMAT "%13.10" EXTENDED_LIMITS -400.000000000 399.999999814 /end CHARACTERISTIC
/begin CHARACTERISTIC PCR_pDWinPosLP_C "obere Kleinsignalgrenze fuer das I-Glied des PIDT1-Reglers" VALUE 0xE95CC Kw_Ws16 10000.00 Pres_hPa -5000.000 5000.000 FORMAT "%8.3" EXTENDED_LIMITS -32768.00 32767.00 /end CHARACTERISTIC
/begin CHARACTERISTIC PCR_pDWinNegLP_C "untere Kleinsignalgrenze fuer das DT1-Glied des PIDT1-Reglers" VALUE 0xE95CE Kw_Ws16 10000.00 Pres_hPa -5000.000 5000.000 FORMAT "%8.3" EXTENDED_LIMITS -32768.00 32767.00 /end CHARACTERISTIC
/begin CHARACTERISTIC PCR_DT1_C "Verzögerungszeitkonstante für das DT1-Glied des PIDT1-Reglers" VALUE 0xE8C48 Kw_Wu32 4294.9663 TimeDelay_s 0.0010000001 4294.9673 FORMAT "%9.4" EXTENDED_LIMITS 0.0000010000000 4294.9673 /end CHARACTERISTIC
/begin CHARACTERISTIC PCR_DKd_C "Grundwert der D-Verstärkung des PIDT1-Reglers bei Kleinsignalen" VALUE 0xE8C4C Kw_Ws32 9.99999996275 Kd_Pres_hPa2Prc 0.00 9.99999996275 FORMAT "%13.10" EXTENDED_LIMITS -400.000000000 399.999999814 /end CHARACTERISTIC
/begin CHARACTERISTIC PCR_DKdPos_C "Grundwert der D-Verstärkung des PIDT1-Reglers bei positiven Großssignalen" VALUE 0xE8C50 Kw_Ws32 9.99999996275 Kd_Pres_hPa2Prc 0.00 9.99999996275 FORMAT "%13.10" EXTENDED_LIMITS -400.000000000 399.999999814 /end CHARACTERISTIC
/begin CHARACTERISTIC PCR_DKdNeg_C "Grundwert der D-Verstärkung des PIDT1-Reglers bei negativen Großsignalen" VALUE 0xE8C54 Kw_Ws32 9.99999996275 Kd_Pres_hPa2Prc 0.00 9.99999996275 FORMAT "%13.10" EXTENDED_LIMITS -400.000000000 399.999999814 /end CHARACTERISTIC
/begin CHARACTERISTIC PCR_pDWinPos_C "Obere Kleinsignalgrenze für das DT1-Glied des PIDT1-Reglers" VALUE 0xE8C58 Kw_Ws16 10000.00 Pres_hPa -5000.000 5000.000 FORMAT "%8.3" EXTENDED_LIMITS -32768.00 32767.00 /end CHARACTERISTIC
/begin CHARACTERISTIC PCR_pDWinNeg_C "Untere Kleinsignalgrenze für das DT1-Glied des PIDT1-Reglers" VALUE 0xE8C5A Kw_Ws16 10000.00 Pres_hPa -5000.000 5000.000 FORMAT "%8.3" EXTENDED_LIMITS -32768.00 32767.00 /end CHARACTERISTIC
/begin CHARACTERISTIC PCR_facATRgn_CUR "Kennlinie für lufttemperaturabhängigen Korrekturwert bei Regenerationsbetrieb" CURVE 0xE7F08 Kl_Xs16_Ws16 3.000000 Fact 0.00 3.000000 FORMAT "%8.6" EXTENDED_LIMITS -4.000000 3.999878
 /begin AXIS_DESCR STD_AXIS IATSCD_tAir Temp_Cels 6 -50.14000 199.8600 FORMAT "%8.4" EXTENDED_LIMITS -3549.940 3003.560 DEPOSIT ABSOLUTE /end AXIS_DESCR
/end CHARACTERISTIC
/begin CHARACTERISTIC PCR_facBPCtlBasCorr_CUR "Correcting factor of boost pressure control value according to particle filter soot mass" CURVE 0xE6730 Kl_Xs16_Ws16 5.000000 Fact 0.00 5.000000 FORMAT "%8.6" EXTENDED_LIMITS -4.000000 3.999878
 /begin AXIS_DESCR STD_AXIS PFlt_mSot mSoot_g 8 0.00 300.0000 FORMAT "%8.4" EXTENDED_LIMITS -327.6800 327.6700 DEPOSIT ABSOLUTE /end AXIS_DESCR
/end CHARACTERISTIC
/begin CHARACTERISTIC PCR_facBPCtlBasRgn1Corr_CUR "correcting factor of boost pressure control value for regeneration according to particle filter soot mass" CURVE 0xE6752 Kl_Xs16_Ws16 5.000000 Fact 0.00 5.000000 FORMAT "%8.6" EXTENDED_LIMITS -4.000000 3.999878
 /begin AXIS_DESCR STD_AXIS PFlt_mSot mSoot_g 8 0.00 300.0000 FORMAT "%8.4" EXTENDED_LIMITS -327.6800 327.6700 DEPOSIT ABSOLUTE /end AXIS_DESCR
/end CHARACTERISTIC
/begin CHARACTERISTIC PCR_facBPGovMaxCorr_CUR "Correction factor(MAX)of D-parameter according to engine speed and particle filter soot mass" CURVE 0xE8C5C Kl_Xs16_Ws16 5.000000 Fact1 0.00 5.000000 FORMAT "%8.6" EXTENDED_LIMITS -256.0000 255.9922
 /begin AXIS_DESCR STD_AXIS PFlt_mSot mSoot_g 8 0.00 300.0000 FORMAT "%8.4" EXTENDED_LIMITS -327.6800 327.6700 DEPOSIT ABSOLUTE /end AXIS_DESCR
/end CHARACTERISTIC
/begin CHARACTERISTIC PCR_facCtlAPRgn_MAP "Offset on boost pressure regeneration control value according to intake air pressure" MAP 0xE6774 Kf_Xs16_Ys16_Ws16 5.000000 Fact 0.00 5.000000 FORMAT "%8.6" EXTENDED_LIMITS -4.000000 3.999878
 /begin AXIS_DESCR STD_AXIS Eng_nAvrg EngN 10 0.00 8000.000 FORMAT "%8.3" EXTENDED_LIMITS -32768.00 32767.00 DEPOSIT ABSOLUTE /end AXIS_DESCR
 /begin AXIS_DESCR STD_AXIS APSCD_pVal Pres_hPa 12 0.00 3500.000 FORMAT "%8.3" EXTENDED_LIMITS -32768.00 32767.00 DEPOSIT ABSOLUTE /end AXIS_DESCR
/end CHARACTERISTIC
/begin CHARACTERISTIC PCR_facCtlAP_MAP "Kennfeld für atmosphärendruckabhängige Korrektur für Steuerung" MAP 0xE6894 Kf_Xs16_Ys16_Ws16 5.000000 Fact 0.00 5.000000 FORMAT "%8.6" EXTENDED_LIMITS -4.000000 3.999878
 /begin AXIS_DESCR STD_AXIS Eng_nAvrg EngN 10 0.00 8000.000 FORMAT "%8.3" EXTENDED_LIMITS -32768.00 32767.00 DEPOSIT ABSOLUTE /end AXIS_DESCR
 /begin AXIS_DESCR STD_AXIS APSCD_pVal Pres_hPa 12 0.00 3500.000 FORMAT "%8.3" EXTENDED_LIMITS -32768.00 32767.00 DEPOSIT ABSOLUTE /end AXIS_DESCR
/end CHARACTERISTIC
/begin CHARACTERISTIC PCR_facCtlATRgn_CUR "Kennlinie für lufttemperaturabhängingen Korrekturfaktor für Ladedruckregelung bei Regenerationsbetrieb" CURVE 0xE69B4 Kl_Xs16_Ws16 3.000000 Fact 0.00 3.000000 FORMAT "%8.6" EXTENDED_LIMITS -4.000000 3.999878
 /begin AXIS_DESCR STD_AXIS IATSCD_tAir Temp_Cels 6 -50.1400 199.8600 FORMAT "%8.4" EXTENDED_LIMITS -3549.940 3003.560 DEPOSIT ABSOLUTE /end AXIS_DESCR
/end CHARACTERISTIC
/begin CHARACTERISTIC PCR_facCtlIAT_CUR "Kennlinie für lufttemperaturabhängigen Korrekturfaktor für Ladedrucksteuerung" CURVE 0xE69CE Kl_Xs16_Ws16 3.000000 Fact 0.00 3.000000 FORMAT "%8.6" EXTENDED_LIMITS -4.000000 3.999878
 /begin AXIS_DESCR STD_AXIS IATSCD_tAir Temp_Cels 6 -50.1400 199.8600 FORMAT "%8.4" EXTENDED_LIMITS -3549.940 3003.560 DEPOSIT ABSOLUTE /end AXIS_DESCR
/end CHARACTERISTIC
/begin CHARACTERISTIC PCR_facCtQ_MAP "Kennfeld für Kühlwassertemperaturkorrekturfaktor de Sollwertberechnung" MAP 0xE7F22 Kf_Xs16_Ys16_Ws16 7.999878 Fact -4.000000 3.999878 FORMAT "%8.6"
 /begin AXIS_DESCR STD_AXIS CTSCD_tClnt Temp_Cels 2 -50.1400 199.8600 FORMAT "%8.4" EXTENDED_LIMITS -3549.940 3003.560 DEPOSIT ABSOLUTE /end AXIS_DESCR
 /begin AXIS_DESCR STD_AXIS PCR_qDes InjMass 2 0.00 200.0000 FORMAT "%8.4" EXTENDED_LIMITS -327.6800 327.6700 DEPOSIT ABSOLUTE /end AXIS_DESCR
/end CHARACTERISTIC
/begin CHARACTERISTIC PCR_facDnCorr_CUR "Curve for Correction factor based on the engine-speed gradient" CURVE 0xE8C7E Kl_Xs16_Ws16 511.9922 Fact1 -256.0000 255.9922 FORMAT "%8.4"
 /begin AXIS_DESCR STD_AXIS PCR_dn_mp dn_dZ20 6 -6000.000 6000.000 FORMAT "%8.3" EXTENDED_LIMITS -327680.0 327670.0 DEPOSIT ABSOLUTE /end AXIS_DESCR
/end CHARACTERISTIC
/begin CHARACTERISTIC PCR_facDpCorr_CUR "Korrekturfaktor für D-Parameter Korrektur aus dem Ladedruckgradienten" CURVE 0xE8C98 Kl_Xs16_Ws16 511.9922 Fact1 -256.0000 255.9922 FORMAT "%8.4"
 /begin AXIS_DESCR STD_AXIS PCR_dpBGDev_mp dp_dZ20 10 -350000.0 350000.0 FORMAT "%8.1" EXTENDED_LIMITS -327680.0 327670.0 DEPOSIT ABSOLUTE /end AXIS_DESCR
/end CHARACTERISTIC
/begin CHARACTERISTIC PCR_facD_MAP "Kennfeld für Adaptionsfaktor der D-Verstärkung" MAP 0xE8CC2 Kf_Xs16_Ys16_Ws16 50.00000 Fact1 0.00 50.00000 FORMAT "%8.5" EXTENDED_LIMITS -256.0000 255.9922
 /begin AXIS_DESCR STD_AXIS Eng_nAvrg EngN 10 0.00 8000.000 FORMAT "%8.3" EXTENDED_LIMITS -32768.00 32767.00 DEPOSIT ABSOLUTE /end AXIS_DESCR
 /begin AXIS_DESCR STD_AXIS InjCtl_qCurr InjMassCyc 4 0.00 200.0000 FORMAT "%8.4" EXTENDED_LIMITS -327.6800 327.6700 DEPOSIT ABSOLUTE /end AXIS_DESCR
/end CHARACTERISTIC
/begin CHARACTERISTIC PCR_facIAT_CUR "Lufttemperaturabhängiger Faktor für Sollwertbildung" CURVE 0xE7F36 Kl_Xs16_Ws16 3.000000 Fact 0.00 3.000000 FORMAT "%8.6" EXTENDED_LIMITS -4.000000 3.999878
 /begin AXIS_DESCR STD_AXIS CTSCD_tClnt Temp_Cels 6 -50.14000 199.8600 FORMAT "%8.4" EXTENDED_LIMITS -3549.940 3003.560 DEPOSIT ABSOLUTE /end AXIS_DESCR
/end CHARACTERISTIC
/begin CHARACTERISTIC PCR_facI_MAP "Kennfeld für Adaptionsfaktor der I-Verstärkung" MAP 0xE8D32 Kf_Xs16_Ys16_Ws16 50.00000 Fact1 0.00 50.00000 FORMAT "%8.5" EXTENDED_LIMITS -256.0000 255.9922
 /begin AXIS_DESCR STD_AXIS Eng_nAvrg EngN 10 0.00 8000.000 FORMAT "%8.3" EXTENDED_LIMITS -32768.00 32767.00 DEPOSIT ABSOLUTE /end AXIS_DESCR
 /begin AXIS_DESCR STD_AXIS InjCtl_qCurr InjMassCyc 4 0.00 200.0000 FORMAT "%8.4" EXTENDED_LIMITS -327.6800 327.6700 DEPOSIT ABSOLUTE /end AXIS_DESCR
/end CHARACTERISTIC
/begin CHARACTERISTIC PCR_facmSotCorr_MAP "Correction factor of D-parameter  according to engine speed and particle filter soot mass" MAP 0xE8DA2 Kf_Xs16_Ys16_Ws16 5.000000 Fact1 0.00 5.000000 FORMAT "%8.6" EXTENDED_LIMITS -256.0000 255.9922
 /begin AXIS_DESCR STD_AXIS Eng_nAvrg EngN 10 0.00 8000.000 FORMAT "%8.3" EXTENDED_LIMITS -32768.00 32767.00 DEPOSIT ABSOLUTE /end AXIS_DESCR
 /begin AXIS_DESCR STD_AXIS PFlt_mSot mSoot_g 8 0.00 300.0000 FORMAT "%8.4" EXTENDED_LIMITS -327.6800 327.6700 DEPOSIT ABSOLUTE /end AXIS_DESCR
/end CHARACTERISTIC
/begin CHARACTERISTIC PCR_facN_CUR "Gewichtungsfaktor über Drehzahl für Athmosphärendruckkorrektur" CURVE 0xE7F50 Kl_Xs16_Ws16 1.000000 Fact 0.00 1.000000 FORMAT "%8.6" EXTENDED_LIMITS -4.000000 3.999878
 /begin AXIS_DESCR STD_AXIS Eng_nAvrg EngN 6 0.00 6000.000 FORMAT "%8.3" EXTENDED_LIMITS -32768.00 32767.00 DEPOSIT ABSOLUTE /end AXIS_DESCR
/end CHARACTERISTIC
/begin CHARACTERISTIC PCR_facPresPFltMax_CUR "Korrekturfaktor für maximal zulässige Stellgröße in Abhängigkeit des Staudrucks vor Partikelfilter" CURVE 0xE8E6A Kl_Xs16_Ws16 5.000000 Fact1 0.00 5.000000 FORMAT "%8.6" EXTENDED_LIMITS -256.0000 255.9922
 /begin AXIS_DESCR STD_AXIS PFlt_pPre Pres_hPa 8 0.00 3500.0000 FORMAT "%8.4" EXTENDED_LIMITS -32768.00 32767.00 DEPOSIT ABSOLUTE /end AXIS_DESCR
/end CHARACTERISTIC
/begin CHARACTERISTIC PCR_facPresPFltMin_CUR "Korrekturfaktor für minimal zulässige Stellgröße in Abhängigkeit des Staudrucks vor Partikelfilter" CURVE 0xE8E8C Kl_Xs16_Ws16 5.000000 Fact1 0.00 5.000000 FORMAT "%8.6" EXTENDED_LIMITS -256.0000 255.9922
 /begin AXIS_DESCR STD_AXIS PFlt_pPre Pres_hPa 8 0.00 3500.0000 FORMAT "%8.4" EXTENDED_LIMITS -32768.00 32767.00 DEPOSIT ABSOLUTE /end AXIS_DESCR
/end CHARACTERISTIC
/begin CHARACTERISTIC PCR_facP_MAP "Kennfeld für Adaptionsfaktor der P-Verstärkung" MAP 0xE8EAE Kf_Xs16_Ys16_Ws16 50.00000 Fact1 0.00 50.00000 FORMAT "%8.5" EXTENDED_LIMITS -256.0000 255.9922
 /begin AXIS_DESCR STD_AXIS Eng_nAvrg EngN 10 0.00 8000.000 FORMAT "%8.3" EXTENDED_LIMITS -32768.00 32767.00 DEPOSIT ABSOLUTE /end AXIS_DESCR
 /begin AXIS_DESCR STD_AXIS InjCtl_qCurr InjMassCyc 4 0.00 200.0000 FORMAT "%8.4" EXTENDED_LIMITS -327.6800 327.6700 DEPOSIT ABSOLUTE /end AXIS_DESCR
/end CHARACTERISTIC
/begin CHARACTERISTIC PCR_IKiLP_C "Grundwert der I-Verstaerkung des PIDT1-Reglers bei Kleinsignalen" VALUE 0xE95D0 Kw_Wu32 12207.0312472 Ki_Pres_hPa2Prc 0.00 12207.0312472 FORMAT "%13.7" /end CHARACTERISTIC
/begin CHARACTERISTIC PCR_IKiPosLP_C "Grundwert der I-Verstaerkung des PIDT1-Reglers bei positiven Groszsignalen" VALUE 0xE95D4 Kw_Wu32 12207.0312472 Ki_Pres_hPa2Prc 0.00 12207.0312472 FORMAT "%13.7" /end CHARACTERISTIC
/begin CHARACTERISTIC PCR_IKiNegLP_C "Grundwert der I-Verstaerkung des PIDT1-Reglers bei negativen Groszsignalen" VALUE 0xE95D8 Kw_Wu32 12207.0312472 Ki_Pres_hPa2Prc 0.00 12207.0312472 FORMAT "%13.7" /end CHARACTERISTIC
/begin CHARACTERISTIC PCR_pIWinPosLP_C "obere Kleinsignalgrenze fuer das I-Glied des PIDT1-Reglers" VALUE 0xE95DC Kw_Ws16 65535.00 Pres_hPa -32768.00 32767.00 FORMAT "%8.2" /end CHARACTERISTIC
/begin CHARACTERISTIC PCR_pIWinNegLP_C "untere Kleinsignalgrenze fuer das I-Glied des PIDT1-Reglers" VALUE 0xE95DE Kw_Ws16 65535.00 Pres_hPa -32768.00 32767.00 FORMAT "%8.2" /end CHARACTERISTIC
/begin CHARACTERISTIC PCR_IKi_C "Grundwert der I-Verstärkung des PIDT1-Reglers bei Kleinsignalen" VALUE 0xE8F20 Kw_Wu32 12207.0312472 Ki_Pres_hPa2Prc 0.00 12207.0312472 FORMAT "%13.7" /end CHARACTERISTIC
/begin CHARACTERISTIC PCR_IKiPos_C "Grundwert der I-Verstärkung des PIDT1-Reglers bei positiven Großsignalen" VALUE 0xE8F24 Kw_Wu32 12207.0312472 Ki_Pres_hPa2Prc 0.00 12207.0312472 FORMAT "%13.7" /end CHARACTERISTIC
/begin CHARACTERISTIC PCR_IKiNeg_C "Grundwert der I-Verstärkung des PIDT1-Reglers bei negativen Großsignalen" VALUE 0xE8F28 Kw_Wu32 12207.0312472 Ki_Pres_hPa2Prc 0.00 12207.0312472 FORMAT "%13.7" /end CHARACTERISTIC
/begin CHARACTERISTIC PCR_pIWinPos_C "Obere Kleinsignalgrenze für das I-Glied des PIDT1-Reglers" VALUE 0xE8F2C Kw_Ws16 65535.00 Pres_hPa -32768.00 32767.00 FORMAT "%8.2" /end CHARACTERISTIC
/begin CHARACTERISTIC PCR_pIWinNeg_C "Untere Kleinsignalgrenze für das I-Glied des PIDT1-Reglers" VALUE 0xE8F2E Kw_Ws16 65535.00 Pres_hPa -32768.00 32767.00 FORMAT "%8.2" /end CHARACTERISTIC
/begin CHARACTERISTIC PCR_mskNoAdPCVVal_C "Maske zur Auswahl der Bedingungen, die zu einem Ignorieren der Lernwerte fuehren" VALUE 0xE8F30 Kw_Wu16 65535.00 OneToOne 0.00 65535.00 FORMAT "%8.2" /end CHARACTERISTIC
/begin CHARACTERISTIC PCR_mskResetVal_C "Maske zur Auswahl der Bedingungen, die zu einem Reset der Lernwerte fuehren" VALUE 0xE8F32 Kw_Wu16 65535.00 OneToOne 0.00 65535.00 FORMAT "%8.2" /end CHARACTERISTIC
/begin CHARACTERISTIC PCR_mskStopLearning_C "Maske zur Auswahl der Bedingungen, die zu einem Stop des Lernalgorithmus fuehren" VALUE 0xE8F34 Kw_Wu16 65535.00 OneToOne 0.00 65535.00 FORMAT "%8.2" /end CHARACTERISTIC
/begin CHARACTERISTIC PCR_nAvrgAdPCV1_C "Wert der Drehzahl des ersten Referenz-Betriebspunktes" VALUE 0xE8F36 Kw_Ws16 6000.000 EngN 0.00 6000.000 FORMAT "%8.3" EXTENDED_LIMITS -32768.00 32767.00 /end CHARACTERISTIC
/begin CHARACTERISTIC PCR_nAvrgAdPCV2_C "Wert der Drehzahl des zweiten Referenz-Betriebspunktes" VALUE 0xE8F38 Kw_Ws16 6000.000 EngN 0.00 6000.000 FORMAT "%8.3" EXTENDED_LIMITS -32768.00 32767.00 /end CHARACTERISTIC
/begin CHARACTERISTIC PCR_nLIGovBase_C "#SSD LL-Solldrehzahl bei Anti-Surge inaktiv" VALUE 0xE7E28 Kw_Ws16 6000.000 EngN 0.00 6000.000 FORMAT "%8.3" EXTENDED_LIMITS -32768.00 32767.00 /end CHARACTERISTIC
/begin CHARACTERISTIC PCR_nLimMax_C "Upper threshold for engine speed." VALUE 0xE7F6A Kw_Ws16 6000.000 EngN 0.00 6000.000 FORMAT "%8.3" EXTENDED_LIMITS -32768.00 32767.00 /end CHARACTERISTIC
/begin CHARACTERISTIC PCR_nLimMin_C "Lower threshold for engine speed." VALUE 0xE7F6C Kw_Ws16 6000.000 EngN 0.00 6000.000 FORMAT "%8.3" EXTENDED_LIMITS -32768.00 32767.00 /end CHARACTERISTIC
/begin CHARACTERISTIC PCR_nPCVMax_C "Maximale Drehzahl bei Verwendung des PCVs" VALUE 0xE8F3A Kw_Ws16 6000.000 EngN 0.00 6000.000 FORMAT "%8.3" EXTENDED_LIMITS -32768.00 32767.00 /end CHARACTERISTIC
/begin CHARACTERISTIC PCR_nPCVMin_C "Minimale Drehzahl bei Verwendung des PCVs" VALUE 0xE8F3C Kw_Ws16 6000.000 EngN 0.00 6000.000 FORMAT "%8.3" EXTENDED_LIMITS -32768.00 32767.00 /end CHARACTERISTIC
/begin CHARACTERISTIC PCR_nSetPointLIGov_C "LIGov set point for Anti_Surge" VALUE 0xE7E2A Kw_Ws16 6000.000 EngN 0.00 6000.000 FORMAT "%8.3" EXTENDED_LIMITS -32768.00 32767.00 /end CHARACTERISTIC
/begin CHARACTERISTIC PCR_nSurgeMon1_C "#SSD Schwelle Low Überwachung Anti-Surge  LIGov/ PCR_nSetpoint" VALUE 0xE7E2C Kw_Ws16 6000.000 EngN 0.00 6000.000 FORMAT "%8.3" EXTENDED_LIMITS -32768.00 32767.00 /end CHARACTERISTIC
/begin CHARACTERISTIC PCR_nSurgeMon2_C "#SSD Schwelle High Überwachung Anti-Surge  LIGov/ PCR_nSetpoint" VALUE 0xE7E2E Kw_Ws16 6000.000 EngN 0.00 6000.000 FORMAT "%8.3" EXTENDED_LIMITS -32768.00 32767.00 /end CHARACTERISTIC
/begin CHARACTERISTIC PCR_pAPQCmpnRgn_MAP "Kennfeld für atmosphärendruckabhängigen Korrekturwert bei Regenerationsbetrieb" MAP 0xE7F6E Kf_Xs16_Ys16_Ws16 4400.000 Pres_hPa -400.0000 4000.000 FORMAT "%8.3" EXTENDED_LIMITS -32768.00 32767.00
 /begin AXIS_DESCR STD_AXIS APSCD_pVal Pres_hPa 6 0.00 4000.000 FORMAT "%8.3" EXTENDED_LIMITS -32768.00 32767.00 DEPOSIT ABSOLUTE /end AXIS_DESCR
 /begin AXIS_DESCR STD_AXIS PCR_qDes InjMass 6 0.00 200.0000 FORMAT "%8.4" EXTENDED_LIMITS -327.6800 327.6700 DEPOSIT ABSOLUTE /end AXIS_DESCR
/end CHARACTERISTIC
/begin CHARACTERISTIC PCR_pAPQCmpn_MAP "Kennfeld für atmosphärendruckabhängige Kompensation für Sollwertberechnung" MAP 0xE7FD2 Kf_Xs16_Ys16_Ws16 8000.000 Pres_hPa -4000.000 4000.000 FORMAT "%8.3" EXTENDED_LIMITS -32768.00 32767.00
 /begin AXIS_DESCR STD_AXIS APSCD_pVal Pres_hPa 6 0.00 4000.000 FORMAT "%8.3" EXTENDED_LIMITS -32768.00 32767.00 DEPOSIT ABSOLUTE /end AXIS_DESCR
 /begin AXIS_DESCR STD_AXIS PCR_qDes InjMass 6 0.00 200.0000 FORMAT "%8.4" EXTENDED_LIMITS -327.6800 327.6700 DEPOSIT ABSOLUTE /end AXIS_DESCR
/end CHARACTERISTIC
/begin CHARACTERISTIC PCR_pBDesBasFDC_MAP "base desired boost pressure map for sport mode" MAP 0xE8036 Kf_Xs16_Ys16_Ws16 4000.000 Pres_hPa 0.00 4000.000 FORMAT "%8.3" EXTENDED_LIMITS -32768.00 32767.00
 /begin AXIS_DESCR STD_AXIS Eng_nAvrg EngN 16 0.00 8000.000 FORMAT "%8.3" EXTENDED_LIMITS -32768.00 32767.00 DEPOSIT ABSOLUTE /end AXIS_DESCR
 /begin AXIS_DESCR STD_AXIS PCR_qDes InjMass 16 0.00 200.0000 FORMAT "%8.4" EXTENDED_LIMITS -327.6800 327.6700 DEPOSIT ABSOLUTE /end AXIS_DESCR
/end CHARACTERISTIC
/begin CHARACTERISTIC PCR_pBDesBasRgn1_MAP "Erstes Regenerationskennfeld zur Ermittlung des Ladedruckbasissollwerts" MAP 0xE827A Kf_Xs16_Ys16_Ws16 4000.000 Pres_hPa 0.00 4000.000 FORMAT "%8.3" EXTENDED_LIMITS -32768.00 32767.00
 /begin AXIS_DESCR STD_AXIS Eng_nAvrg EngN 16 0.00 8000.000 FORMAT "%8.3" EXTENDED_LIMITS -32768.00 32767.00 DEPOSIT ABSOLUTE /end AXIS_DESCR
 /begin AXIS_DESCR STD_AXIS PCR_qDes InjMass 16 0.00 200.0000 FORMAT "%8.4" EXTENDED_LIMITS -327.6800 327.6700 DEPOSIT ABSOLUTE /end AXIS_DESCR
/end CHARACTERISTIC
/begin CHARACTERISTIC PCR_pBDesBasRgn2_MAP "Zweites Regenerationskennfeld zur Ermittlung des Ladedruckbasissollwerts" MAP 0xE84BE Kf_Xs16_Ys16_Ws16 4000.000 Pres_hPa 0.00 4000.000 FORMAT "%8.3" EXTENDED_LIMITS -32768.00 32767.00
 /begin AXIS_DESCR STD_AXIS Eng_nAvrg EngN 16 0.00 8000.000 FORMAT "%8.3" EXTENDED_LIMITS -32768.00 32767.00 DEPOSIT ABSOLUTE /end AXIS_DESCR
 /begin AXIS_DESCR STD_AXIS PCR_qDes InjMass 16 0.00 200.0000 FORMAT "%8.4" EXTENDED_LIMITS -327.6800 327.6700 DEPOSIT ABSOLUTE /end AXIS_DESCR
/end CHARACTERISTIC
/begin CHARACTERISTIC PCR_pBDesLPRgn1_MAP "Kennfeld zum Ladedrucksollwert bei niedrigem Druck in regenaration1" MAP 0xE95E0 Kf_Xs16_Ys16_Ws16 4000.000 Pres_hPa 0.00 4000.000 FORMAT "%8.3" EXTENDED_LIMITS -32768.00 32767.00
 /begin AXIS_DESCR STD_AXIS Eng_nAvrg EngN 16 0.00 8000.000 FORMAT "%8.3" EXTENDED_LIMITS -32768.00 32767.00 DEPOSIT ABSOLUTE /end AXIS_DESCR
 /begin AXIS_DESCR STD_AXIS PCR_qDes InjMass 16 0.00 200.0000 FORMAT "%8.4" EXTENDED_LIMITS -327.6800 327.6700 DEPOSIT ABSOLUTE /end AXIS_DESCR
/end CHARACTERISTIC
/begin CHARACTERISTIC PCR_pBDesLPRgn2_MAP "Kennfeld zum Ladedrucksollwert bei niedrigem Druck in Regeneration 2" MAP 0xE9824 Kf_Xs16_Ys16_Ws16 4000.000 Pres_hPa 0.00 4000.000 FORMAT "%8.3" EXTENDED_LIMITS -32768.00 32767.00
 /begin AXIS_DESCR STD_AXIS Eng_nAvrg EngN 16 0.00 8000.000 FORMAT "%8.3" EXTENDED_LIMITS -32768.00 32767.00 DEPOSIT ABSOLUTE /end AXIS_DESCR
 /begin AXIS_DESCR STD_AXIS PCR_qDes InjMass 16 0.00 200.0000 FORMAT "%8.4" EXTENDED_LIMITS -327.6800 327.6700 DEPOSIT ABSOLUTE /end AXIS_DESCR
/end CHARACTERISTIC
/begin CHARACTERISTIC PCR_pBDesLP_MAP " KF Ladedruck-Sollwert bei Kompressorbypass offen" MAP 0xE9A68 Kf_Xs16_Ys16_Ws16 4000.000 Pres_hPa 0.00 4000.000 FORMAT "%8.3" EXTENDED_LIMITS -32768.00 32767.00
 /begin AXIS_DESCR STD_AXIS Eng_nAvrg EngN 16 0.00 8000.000 FORMAT "%8.3" EXTENDED_LIMITS -32768.00 32767.00 DEPOSIT ABSOLUTE /end AXIS_DESCR
 /begin AXIS_DESCR STD_AXIS PCR_qDes InjMass 16 0.00 200.0000 FORMAT "%8.4" EXTENDED_LIMITS -327.6800 327.6700 DEPOSIT ABSOLUTE /end AXIS_DESCR
/end CHARACTERISTIC
/begin CHARACTERISTIC PCR_pBDesMaxAPLP_MAP "KF max Ladedruck bei Kompressorbypass offen" MAP 0xE9CAC Kf_Xs16_Ys16_Ws16 4000.000 Pres_hPa 0.00 4000.000 FORMAT "%8.3" EXTENDED_LIMITS -32768.00 32767.00
 /begin AXIS_DESCR STD_AXIS Eng_nAvrg EngN 10 0.00 8000.000 FORMAT "%8.3" EXTENDED_LIMITS -32768.00 32767.00 DEPOSIT ABSOLUTE /end AXIS_DESCR
 /begin AXIS_DESCR STD_AXIS APSCD_pVal Pres_hPa 10 0.00 4000.000 FORMAT "%8.3" EXTENDED_LIMITS -32768.00 32767.00 DEPOSIT ABSOLUTE /end AXIS_DESCR
/end CHARACTERISTIC
/begin CHARACTERISTIC PCR_pBGDevAdPCVLim_C "Maximale Grenze fuer die Regler-Abweichung" VALUE 0xE8F3E Kw_Ws16 65535.00 Pres_hPa -32768.00 32767.00 FORMAT "%8.2" /end CHARACTERISTIC
/begin CHARACTERISTIC PCR_pDesAdd_Vector "#SSD Bypass-Label für additiven Bypass von PCR_pBDes (Nicht verstellen!)" VALUE 0xC3140 Kw_Wu8 255.0 OneToOne 0.00 255.0 FORMAT "%5.1" /end CHARACTERISTIC
/begin CHARACTERISTIC PCR_pDesAdd_Channel "#SSD Bypass-Label für additiven Bypass von PCR_pBDes (Nicht verstellen!)" VALUE 0xC3141 Kw_Wu8 255.0 OneToOne 0.00 255.0 FORMAT "%5.1" /end CHARACTERISTIC
/begin CHARACTERISTIC PCR_pDesBas_MAP "Kennfeld für die Grundwertbestimmung des Ladedruckbasissollwerts" MAP 0xE8702 Kf_Xs16_Ys16_Ws16 4000.000 Pres_hPa 0.00 4000.000 FORMAT "%8.3" EXTENDED_LIMITS -32768.00 32767.00
 /begin AXIS_DESCR STD_AXIS Eng_nAvrg EngN 16 0.00 8000.000 FORMAT "%8.3" EXTENDED_LIMITS -32768.00 32767.00 DEPOSIT ABSOLUTE /end AXIS_DESCR
 /begin AXIS_DESCR STD_AXIS PCR_qDes InjMass 16 0.00 200.0000 FORMAT "%8.4" EXTENDED_LIMITS -327.6800 327.6700 DEPOSIT ABSOLUTE /end AXIS_DESCR
/end CHARACTERISTIC
/begin CHARACTERISTIC PCR_pDesMaxAP_MAP "Größter erlaubter Ladedrucksollwert in Abhängigkeit vom Luftdruck" MAP 0xE8946 Kf_Xs16_Ys16_Ws16 4000.000 Pres_hPa 0.00 4000.000 FORMAT "%8.3" EXTENDED_LIMITS -32768.00 32767.00
 /begin AXIS_DESCR STD_AXIS Eng_nAvrg EngN 16 0.00 8000.000 FORMAT "%8.3" EXTENDED_LIMITS -32768.00 32767.00 DEPOSIT ABSOLUTE /end AXIS_DESCR
 /begin AXIS_DESCR STD_AXIS APSCD_pVal Pres_hPa 16 0.00 4000.000 FORMAT "%8.3" EXTENDED_LIMITS -32768.00 32767.00 DEPOSIT ABSOLUTE /end AXIS_DESCR
/end CHARACTERISTIC
/begin CHARACTERISTIC PCR_pDesMax_C "Größter erlaubter Ladedrucksollwert" VALUE 0xE8B8A Kw_Ws16 4000.000 Pres_hPa 0.00 4000.000 FORMAT "%8.3" EXTENDED_LIMITS -32768.00 32767.00 /end CHARACTERISTIC
/begin CHARACTERISTIC PCR_pDesMin_C "Kleinster erlaubter Ladedrucksollwert" VALUE 0xE8B8C Kw_Ws16 4000.000 Pres_hPa 0.00 4000.000 FORMAT "%8.3" EXTENDED_LIMITS -32768.00 32767.00 /end CHARACTERISTIC
/begin CHARACTERISTIC PCR_pDes_Vector "#SSD Bypass-Label für PCR_pBDes (Nicht verstellen!)" VALUE 0xC3142 Kw_Wu8 255.0 OneToOne 0.00 255.0 FORMAT "%5.1" /end CHARACTERISTIC
/begin CHARACTERISTIC PCR_pDes_Channel "#SSD Bypass-Label für PCR_pBDes (Nicht verstellen!)" VALUE 0xC3143 Kw_Wu8 255.0 OneToOne 0.00 255.0 FORMAT "%5.1" /end CHARACTERISTIC
/begin CHARACTERISTIC PCR_pFltValLim_C "Maximale Grenze fuer Ladedruck" VALUE 0xE8F40 Kw_Ws16 65535.00 Pres_hPa -32768.00 32767.00 FORMAT "%8.2" /end CHARACTERISTIC
/begin CHARACTERISTIC PCR_PKpLP_C "Grundwert der P-Verstaerkung des PIDT1-Reglers bei Kleinsignalen" VALUE 0xE9DA0 Kw_Wu32 799.999999814 Kp_Pres_hPa2Prc 0.00 799.999999814 FORMAT "%13.9" /end CHARACTERISTIC
/begin CHARACTERISTIC PCR_PKpPosLP_C "Grundwert der P-Verstaerkung des PIDT1-Reglers bei positiven Groszsignalen" VALUE 0xE9DA4 Kw_Wu32 799.999999814 Kp_Pres_hPa2Prc 0.00 799.999999814 FORMAT "%13.9" /end CHARACTERISTIC
/begin CHARACTERISTIC PCR_PKpNegLP_C "Grundwert der P-Verstaerkung des PIDT1-Reglers bei negativen Groszsignalen" VALUE 0xE9DA8 Kw_Wu32 799.999999814 Kp_Pres_hPa2Prc 0.00 799.999999814 FORMAT "%13.9" /end CHARACTERISTIC
/begin CHARACTERISTIC PCR_pPWinPosLP_C "obere Kleinsignalgrenze fuer das P-Glied des PIDT1-Reglers" VALUE 0xE9DAC Kw_Ws16 65535.00 Pres_hPa -32768.00 32767.00 FORMAT "%8.2" /end CHARACTERISTIC
/begin CHARACTERISTIC PCR_pPWinNegLP_C "untere Kleinsignalgrenze fuer das P-Glied des PIDT1-Reglers" VALUE 0xE9DAE Kw_Ws16 65535.00 Pres_hPa -32768.00 32767.00 FORMAT "%8.2" /end CHARACTERISTIC
/begin CHARACTERISTIC PCR_pNQCtCmpn_MAP "Kennfeld für Kühlwassertemperaturkorrekturwert für Sollwertberechnung" MAP 0xE8B8E Kf_Xs16_Ys16_Ws16 4000.000 Pres_hPa 0.00 4000.000 FORMAT "%8.3" EXTENDED_LIMITS -32768.00 32767.00
 /begin AXIS_DESCR STD_AXIS Eng_nAvrg EngN 2 0.00 8000.000 FORMAT "%8.3" EXTENDED_LIMITS -32768.00 32767.00 DEPOSIT ABSOLUTE /end AXIS_DESCR
 /begin AXIS_DESCR STD_AXIS PCR_qDes InjMass 2 0.00 200.0000 FORMAT "%8.4" EXTENDED_LIMITS -327.6800 327.6700 DEPOSIT ABSOLUTE /end AXIS_DESCR
/end CHARACTERISTIC
/begin CHARACTERISTIC PCR_pValAdPCVMax_C "Maximale Grenze für Luftdruck" VALUE 0xE8F42 Kw_Ws16 65535.00 Pres_hPa -32768.00 32767.00 FORMAT "%8.2" /end CHARACTERISTIC
/begin CHARACTERISTIC PCR_pValAdPCVMin_C "Minimale Grenze fuer Luftdruck" VALUE 0xE8F44 Kw_Ws16 65535.00 Pres_hPa -32768.00 32767.00 FORMAT "%8.2" /end CHARACTERISTIC
/begin CHARACTERISTIC PCR_PKp_C "Grundwert der P-Verstärkung des PIDT1-Reglers bei Kleinsignalen" VALUE 0xE8F48 Kw_Wu32 799.999999814 Kp_Pres_hPa2Prc 0.00 799.999999814 FORMAT "%13.9" /end CHARACTERISTIC
/begin CHARACTERISTIC PCR_PKpPos_C "Grundwert der P-Verstärkung des PIDT1-Reglers bei positiven Großsignalen" VALUE 0xE8F4C Kw_Wu32 799.999999814 Kp_Pres_hPa2Prc 0.00 799.999999814 FORMAT "%13.9" /end CHARACTERISTIC
/begin CHARACTERISTIC PCR_PKpNeg_C "Grundwert der P-Verstärkung des PIDT1-Reglers bei negativen Großsignalen" VALUE 0xE8F50 Kw_Wu32 799.999999814 Kp_Pres_hPa2Prc 0.00 799.999999814 FORMAT "%13.9" /end CHARACTERISTIC
/begin CHARACTERISTIC PCR_pPWinPos_C "Obere Kleinsignalgrenze für das P-Glied des PIDT1-Reglers" VALUE 0xE8F54 Kw_Ws16 65535.00 Pres_hPa -32768.00 32767.00 FORMAT "%8.2" /end CHARACTERISTIC
/begin CHARACTERISTIC PCR_pPWinNeg_C "Untere Kleinsignalgrenze für das P-Glied des PIDT1-Reglers" VALUE 0xE8F56 Kw_Ws16 65535.00 Pres_hPa -32768.00 32767.00 FORMAT "%8.2" /end CHARACTERISTIC
/begin CHARACTERISTIC PCR_qCtlAdPCV1_C "Wert der Einspritzmenge des ersten Referenz-Betriebspunktes" VALUE 0xE8F58 Kw_Ws16 327.6700 InjMassCyc 0.00 327.6700 FORMAT "%8.4" EXTENDED_LIMITS -327.6800 327.6700 /end CHARACTERISTIC
/begin CHARACTERISTIC PCR_qCtlAdPCV2_C "Wert der Einspritzmenge des zweiten Referenz-Betriebspunktes" VALUE 0xE8F5A Kw_Ws16 327.6700 InjMassCyc 0.00 327.6700 FORMAT "%8.4" EXTENDED_LIMITS -327.6800 327.6700 /end CHARACTERISTIC
/begin CHARACTERISTIC PCR_qPCVMax_C "Maximale Einspritzmenge bei Verwendung des PCVs" VALUE 0xE8F5C Kw_Ws16 327.6700 InjMassCyc 0.00 327.6700 FORMAT "%8.4" EXTENDED_LIMITS -327.6800 327.6700 /end CHARACTERISTIC
/begin CHARACTERISTIC PCR_qPCVMin_C "Minimale Einspritzmenge bei Verwendung des PCVs" VALUE 0xE8F5E Kw_Ws16 327.6700 InjMassCyc 0.00 327.6700 FORMAT "%8.4" EXTENDED_LIMITS -327.6800 327.6700 /end CHARACTERISTIC
/begin CHARACTERISTIC PCR_qSurgeHigh_CUR "Higher quantity limit for hysteresis of Anti-Surge LIGov" CURVE 0xE7E30 Kl_Xs16_Ws16 100.0000 InjMass 0.00 100.0000 FORMAT "%8.4" EXTENDED_LIMITS -327.6800 327.6700
 /begin AXIS_DESCR STD_AXIS Eng_nAvrg EngN 5 0.00 6000.000 FORMAT "%8.3" EXTENDED_LIMITS -32768.00 32767.00 DEPOSIT ABSOLUTE /end AXIS_DESCR
/end CHARACTERISTIC
/begin CHARACTERISTIC PCR_qSurgeLow_CUR "Lower quantity limit for hysteresis of Anti-Surge LIGov" CURVE 0xE7E46 Kl_Xs16_Ws16 100.0000 InjMass 0.00 100.0000 FORMAT "%8.4" EXTENDED_LIMITS -327.6800 327.6700
 /begin AXIS_DESCR STD_AXIS Eng_nAvrg EngN 5 0.00 6000.000 FORMAT "%8.3" EXTENDED_LIMITS -32768.00 32767.00 DEPOSIT ABSOLUTE /end AXIS_DESCR
/end CHARACTERISTIC
/begin CHARACTERISTIC PCR_rAdPCVCtlValMax_C "Maximale Grenze fuer Adaptives Vorsteuerkennfeld" VALUE 0xE8F60 Kw_Ws16 100.0000 Prc 0.00 100.0000 FORMAT "%8.4" EXTENDED_LIMITS -400.0000 399.9878 /end CHARACTERISTIC
/begin CHARACTERISTIC PCR_rAdPCVCtlValMin_C "Minimale Grenze fuer Adaptives Vorsteuerkennfeld" VALUE 0xE8F62 Kw_Ws16 100.0000 Prc 0.00 100.0000 FORMAT "%8.4" EXTENDED_LIMITS -400.0000 399.9878 /end CHARACTERISTIC
/begin CHARACTERISTIC PCR_rARWIMin_C "Minimum value in case of ""Anti-Reset-Windup""" VALUE 0xE95B0 Kw_Ws16 100.0000 Prc 0.00 100.0000 FORMAT "%8.4" EXTENDED_LIMITS -400.0000 399.9878 /end CHARACTERISTIC
/begin CHARACTERISTIC PCR_rBPBasLPRgn1_MAP "1. RGN Map für LPA" MAP 0xE9DB0 Kf_Xs16_Ys16_Ws16 100.0000 Prc 0.00 100.0000 FORMAT "%8.4" EXTENDED_LIMITS -400.0000 399.9878
 /begin AXIS_DESCR STD_AXIS Eng_nAvrg EngN 16 0.00 8000.000 FORMAT "%8.3" EXTENDED_LIMITS -32768.00 32767.00 DEPOSIT ABSOLUTE /end AXIS_DESCR
 /begin AXIS_DESCR STD_AXIS PCR_qDes InjMass 16 0.00 200.0000 FORMAT "%8.4" EXTENDED_LIMITS -327.6800 327.6700 DEPOSIT ABSOLUTE /end AXIS_DESCR
/end CHARACTERISTIC
/begin CHARACTERISTIC PCR_rBPBasLPRgn2_MAP "2. RGN Map für LPA" MAP 0xE9FF4 Kf_Xs16_Ys16_Ws16 100.0000 Prc 0.00 100.0000 FORMAT "%8.4" EXTENDED_LIMITS -400.0000 399.9878
 /begin AXIS_DESCR STD_AXIS Eng_nAvrg EngN 16 0.00 8000.000 FORMAT "%8.3" EXTENDED_LIMITS -32768.00 32767.00 DEPOSIT ABSOLUTE /end AXIS_DESCR
 /begin AXIS_DESCR STD_AXIS PCR_qDes InjMass 16 0.00 200.0000 FORMAT "%8.4" EXTENDED_LIMITS -327.6800 327.6700 DEPOSIT ABSOLUTE /end AXIS_DESCR
/end CHARACTERISTIC
/begin CHARACTERISTIC PCR_rBPBasLP_MAP "KF TV an steller(LPA) bei Kompressorbypass geschlossen" MAP 0xEA238 Kf_Xs16_Ys16_Ws16 100.0000 Prc 0.00 100.0000 FORMAT "%8.4" EXTENDED_LIMITS -400.0000 399.9878
 /begin AXIS_DESCR STD_AXIS Eng_nAvrg EngN 16 0.00 8000.000 FORMAT "%8.3" EXTENDED_LIMITS -32768.00 32767.00 DEPOSIT ABSOLUTE /end AXIS_DESCR
 /begin AXIS_DESCR STD_AXIS PCR_qDes InjMass 16 0.00 200.0000 FORMAT "%8.4" EXTENDED_LIMITS -327.6800 327.6700 DEPOSIT ABSOLUTE /end AXIS_DESCR
/end CHARACTERISTIC
/begin CHARACTERISTIC PCR_rBPCtlBasUp_C "Ramp up slope for dynamic adjustment" VALUE 0xE69E8 Kw_Wu32 300.000049174 RmpPrc -100.000016391 200.000032783 FORMAT "%13.9" EXTENDED_LIMITS 0.00 799999.999814 /end CHARACTERISTIC
/begin CHARACTERISTIC PCR_rBPCtlBasDwn_C "Ramp down slope for dynamic adjustment" VALUE 0xE69EC Kw_Wu32 300.000049174 RmpPrc -100.000016391 200.000032783 FORMAT "%13.9" EXTENDED_LIMITS 0.00 799999.999814 /end CHARACTERISTIC
/begin CHARACTERISTIC PCR_rBPCtlBasAirCtlOff_MAP "Map to calculate VGT lift ratio in %" MAP 0xE69F0 Kf_Xs16_Ys16_Ws16 300.0000 Prc -100.0000 200.0000 FORMAT "%8.4" EXTENDED_LIMITS -400.0000 399.9878
 /begin AXIS_DESCR STD_AXIS Eng_nAvrg EngN 16 0.00 6000.000 FORMAT "%8.3" EXTENDED_LIMITS -32768.00 32767.00 DEPOSIT ABSOLUTE /end AXIS_DESCR
 /begin AXIS_DESCR STD_AXIS PCR_qCtl_mp InjMassCyc 16 0.00 327.6700 FORMAT "%8.4" EXTENDED_LIMITS -327.6800 327.6700 DEPOSIT ABSOLUTE /end AXIS_DESCR
/end CHARACTERISTIC
/begin CHARACTERISTIC PCR_rBPCtlBasCorr_MAP "Base correction value according to particle filter soot mass" MAP 0xE6C34 Kf_Xs16_Ys16_Ws16 300.0000 Prc -100.0000 200.0000 FORMAT "%8.4" EXTENDED_LIMITS -400.0000 399.9878
 /begin AXIS_DESCR STD_AXIS Eng_nAvrg EngN 16 0.00 8000.000 FORMAT "%8.3" EXTENDED_LIMITS -32768.00 32767.00 DEPOSIT ABSOLUTE /end AXIS_DESCR
 /begin AXIS_DESCR STD_AXIS PCR_qCtl_mp InjMassCyc 10 0.00 300.0000 FORMAT "%8.4" EXTENDED_LIMITS -327.6800 327.6700 DEPOSIT ABSOLUTE /end AXIS_DESCR
/end CHARACTERISTIC
/begin CHARACTERISTIC PCR_rBPCtlBasFDC_MAP "map for Calculation of the base control value" MAP 0xE6DAC Kf_Xs16_Ys16_Ws16 300.0000 Prc -100.0000 200.0000 FORMAT "%8.4" EXTENDED_LIMITS -400.0000 399.9878
 /begin AXIS_DESCR STD_AXIS Eng_nAvrg EngN 16 0.00 6000.000 FORMAT "%8.3" EXTENDED_LIMITS -32768.00 32767.00 DEPOSIT ABSOLUTE /end AXIS_DESCR
 /begin AXIS_DESCR STD_AXIS PCR_qCtl_mp InjMassCyc 16 0.00 327.6700 FORMAT "%8.4" EXTENDED_LIMITS -327.6800 327.6700 DEPOSIT ABSOLUTE /end AXIS_DESCR
/end CHARACTERISTIC
/begin CHARACTERISTIC PCR_rBPCtlBasRgn1Corr_MAP "Map to determine offset on boost pressure control value for regeneration according to particle filter soot mass" MAP 0xE6FF0 Kf_Xs16_Ys16_Ws16 300.0000 Prc -100.0000 200.0000 FORMAT "%8.4" EXTENDED_LIMITS -400.0000 399.9878
 /begin AXIS_DESCR STD_AXIS Eng_nAvrg EngN 16 0.00 8000.000 FORMAT "%8.3" EXTENDED_LIMITS -32768.00 32767.00 DEPOSIT ABSOLUTE /end AXIS_DESCR
 /begin AXIS_DESCR STD_AXIS PCR_qCtl_mp InjMassCyc 10 0.00 300.0000 FORMAT "%8.4" EXTENDED_LIMITS -327.6800 327.6700 DEPOSIT ABSOLUTE /end AXIS_DESCR
/end CHARACTERISTIC
/begin CHARACTERISTIC PCR_rBPCtlBasRgn1_MAP "Basiskennfeld 1 für Regenerationsbetrieb" MAP 0xE7168 Kf_Xs16_Ys16_Ws16 300.0000 Prc -100.0000 200.0000 FORMAT "%8.4" EXTENDED_LIMITS -400.0000 399.9878
 /begin AXIS_DESCR STD_AXIS Eng_nAvrg EngN 16 0.00 6000.000 FORMAT "%8.3" EXTENDED_LIMITS -32768.00 32767.00 DEPOSIT ABSOLUTE /end AXIS_DESCR
 /begin AXIS_DESCR STD_AXIS PCR_qCtl_mp InjMassCyc 16 0.00 327.6700 FORMAT "%8.4" EXTENDED_LIMITS -327.6800 327.6700 DEPOSIT ABSOLUTE /end AXIS_DESCR
/end CHARACTERISTIC
/begin CHARACTERISTIC PCR_rBPCtlBasRgn2_MAP "Basiskennfeld 2 für Regenerationsbetrieb" MAP 0xE73AC Kf_Xs16_Ys16_Ws16 300.0000 Prc -100.0000 200.0000 FORMAT "%8.4" EXTENDED_LIMITS -400.0000 399.9878
 /begin AXIS_DESCR STD_AXIS Eng_nAvrg EngN 16 0.00 6000.000 FORMAT "%8.3" EXTENDED_LIMITS -32768.00 32767.00 DEPOSIT ABSOLUTE /end AXIS_DESCR
 /begin AXIS_DESCR STD_AXIS PCR_qCtl_mp InjMassCyc 16 0.00 327.6700 FORMAT "%8.4" EXTENDED_LIMITS -327.6800 327.6700 DEPOSIT ABSOLUTE /end AXIS_DESCR
/end CHARACTERISTIC
/begin CHARACTERISTIC PCR_rBPGovMaxCorr_MAP "Correction factor(MAX) of D-parameter according to engine speed and particle filter soot mass" MAP 0xE8F64 Kf_Xs16_Ys16_Ws16 100.0000 Prc 0.00 100.0000 FORMAT "%8.4" EXTENDED_LIMITS -400.0000 399.9878
 /begin AXIS_DESCR STD_AXIS Eng_nAvrg EngN 16 0.00 8000.000 FORMAT "%8.3" EXTENDED_LIMITS -32768.00 32767.00 DEPOSIT ABSOLUTE /end AXIS_DESCR
 /begin AXIS_DESCR STD_AXIS PCR_qReal InjMassCyc 10 0.00 100.0000 FORMAT "%8.4" EXTENDED_LIMITS -327.6800 327.6700 DEPOSIT ABSOLUTE /end AXIS_DESCR
/end CHARACTERISTIC
/begin CHARACTERISTIC PCR_rBPGovMaxDynCorr_MAP "MAP für dynamische Korrektur des BP-Regler-Maximums" MAP 0xE90DC Kf_Xs16_Ys16_Ws16 100.0000 Prc 0.00 100.0000 FORMAT "%8.4" EXTENDED_LIMITS -400.0000 399.9878
 /begin AXIS_DESCR STD_AXIS APSCD_pVal Pres_hPa 8 0.00 4000.000 FORMAT "%8.3" EXTENDED_LIMITS -32768.00 32767.00 DEPOSIT ABSOLUTE /end AXIS_DESCR
 /begin AXIS_DESCR STD_AXIS Eng_nAvrg EngN 8 40.00000 6000.000 FORMAT "%8.3" EXTENDED_LIMITS -32768.00 32767.00 DEPOSIT ABSOLUTE /end AXIS_DESCR
/end CHARACTERISTIC
/begin CHARACTERISTIC PCR_rBPGovMaxDynEnd_C "Ramp correction end value for maximum allowable PCR governor output" VALUE 0xE9180 Kw_Ws16 100.0000 Prc 0.00 100.0000 FORMAT "%8.4" EXTENDED_LIMITS -400.0000 399.9878 /end CHARACTERISTIC
/begin CHARACTERISTIC PCR_rBPGovMaxDynStrt_C "Ramp correction start value for maximum allowable PCR governor output" VALUE 0xE9182 Kw_Ws16 100.0000 Prc 0.00 100.0000 FORMAT "%8.4" EXTENDED_LIMITS -400.0000 399.9878 /end CHARACTERISTIC
/begin CHARACTERISTIC PCR_rBPGovMaxDyn_MAP "Map for Maximum allowable PCR output for actuator" MAP 0xE9184 Kf_Xs16_Ys16_Ws16 100.0000 Prc 0.00 100.0000 FORMAT "%8.4" EXTENDED_LIMITS -400.0000 399.9878
 /begin AXIS_DESCR STD_AXIS Eng_nAvrg EngN 8 40.00000 6000.000 FORMAT "%8.3" EXTENDED_LIMITS -32768.00 32767.00 DEPOSIT ABSOLUTE /end AXIS_DESCR
 /begin AXIS_DESCR STD_AXIS PCR_qReal InjMassCyc 8 0.00 100.0000 FORMAT "%8.4" EXTENDED_LIMITS -327.6800 327.6700 DEPOSIT ABSOLUTE /end AXIS_DESCR
/end CHARACTERISTIC
/begin CHARACTERISTIC PCR_rBPRglBasLPRgn1_MAP "KF fuer Vorsteuertastverhaeltnis" MAP 0xEA47C Kf_Xs16_Ys16_Ws16 100.0000 Prc 0.00 100.0000 FORMAT "%8.4" EXTENDED_LIMITS -400.0000 399.9878
 /begin AXIS_DESCR STD_AXIS Eng_nAvrg EngN 16 0.00 8000.000 FORMAT "%8.3" EXTENDED_LIMITS -32768.00 32767.00 DEPOSIT ABSOLUTE /end AXIS_DESCR
 /begin AXIS_DESCR STD_AXIS PCR_qDes InjMass 16 0.00 200.0000 FORMAT "%8.4" EXTENDED_LIMITS -327.6800 327.6700 DEPOSIT ABSOLUTE /end AXIS_DESCR
/end CHARACTERISTIC
/begin CHARACTERISTIC PCR_rBPRglBasLPRgn2_MAP "KF fuer Vorsteuertastverhaeltnis" MAP 0xEA6C0 Kf_Xs16_Ys16_Ws16 100.0000 Prc 0.00 100.0000 FORMAT "%8.4" EXTENDED_LIMITS -400.0000 399.9878
 /begin AXIS_DESCR STD_AXIS Eng_nAvrg EngN 16 0.00 8000.000 FORMAT "%8.3" EXTENDED_LIMITS -32768.00 32767.00 DEPOSIT ABSOLUTE /end AXIS_DESCR
 /begin AXIS_DESCR STD_AXIS PCR_qDes InjMass 16 0.00 200.0000 FORMAT "%8.4" EXTENDED_LIMITS -327.6800 327.6700 DEPOSIT ABSOLUTE /end AXIS_DESCR
/end CHARACTERISTIC
/begin CHARACTERISTIC PCR_rBPRglBasLP_MAP "KF fuer Vorsteuertastverhaeltnis" MAP 0xEA904 Kf_Xs16_Ys16_Ws16 100.0000 Prc 0.00 100.0000 FORMAT "%8.4" EXTENDED_LIMITS -400.0000 399.9878
 /begin AXIS_DESCR STD_AXIS Eng_nAvrg EngN 16 0.00 8000.000 FORMAT "%8.3" EXTENDED_LIMITS -32768.00 32767.00 DEPOSIT ABSOLUTE /end AXIS_DESCR
 /begin AXIS_DESCR STD_AXIS PCR_qDes InjMass 16 0.00 200.0000 FORMAT "%8.4" EXTENDED_LIMITS -327.6800 327.6700 DEPOSIT ABSOLUTE /end AXIS_DESCR
/end CHARACTERISTIC
/begin CHARACTERISTIC PCR_rCtlAPCmpnRgn_MAP "Kennfeld für Atmosphärendruckabhängigen Korrekturwert" MAP 0xE75F0 Kf_Xs16_Ys16_Ws16 200.0000 Prc -100.0000 100.0000 FORMAT "%8.4" EXTENDED_LIMITS -400.0000 399.9878
 /begin AXIS_DESCR STD_AXIS Eng_nAvrg EngN 8 0.00 6000.000 FORMAT "%8.3" EXTENDED_LIMITS -32768.00 32767.00 DEPOSIT ABSOLUTE /end AXIS_DESCR
 /begin AXIS_DESCR STD_AXIS PCR_qCtl_mp InjMassCyc 16 0.00 327.6700 FORMAT "%8.4" EXTENDED_LIMITS -327.6800 327.6700 DEPOSIT ABSOLUTE /end AXIS_DESCR
/end CHARACTERISTIC
/begin CHARACTERISTIC PCR_rCtlAPCor_MAP "Kennfeld für atmosphärendruckabhängigen Korrekturwert für Ladedrucksteuerung" MAP 0xE7724 Kf_Xs16_Ys16_Ws16 200.0000 Prc -100.0000 100.0000 FORMAT "%8.4" EXTENDED_LIMITS -400.0000 399.9878
 /begin AXIS_DESCR STD_AXIS Eng_nAvrg EngN 10 0.00 6000.000 FORMAT "%8.3" EXTENDED_LIMITS -32768.00 32767.00 DEPOSIT ABSOLUTE /end AXIS_DESCR
 /begin AXIS_DESCR STD_AXIS PCR_qCtl_mp InjMassCyc 8 0.00 327.6700 FORMAT "%8.4" EXTENDED_LIMITS -327.6800 327.6700 DEPOSIT ABSOLUTE /end AXIS_DESCR
/end CHARACTERISTIC
/begin CHARACTERISTIC PCR_rCtlATCmpnRgn_MAP "Kennfeld für lufttemperaturabhängige Korrektur im Regenerationsbetrieb" MAP 0xE77EC Kf_Xs16_Ys16_Ws16 200.0000 Prc -100.0000 100.0000 FORMAT "%8.4" EXTENDED_LIMITS -400.0000 399.9878
 /begin AXIS_DESCR STD_AXIS Eng_nAvrg EngN 8 0.00 6000.000 FORMAT "%8.3" EXTENDED_LIMITS -32768.00 32767.00 DEPOSIT ABSOLUTE /end AXIS_DESCR
 /begin AXIS_DESCR STD_AXIS PCR_qCtl_mp InjMassCyc 8 0.00 327.6700 FORMAT "%8.4" EXTENDED_LIMITS -327.6800 327.6700 DEPOSIT ABSOLUTE /end AXIS_DESCR
/end CHARACTERISTIC
/begin CHARACTERISTIC PCR_rCtlATCmpn_MAP "Kennfeld für lufttemperaturabhängige Korrektur" MAP 0xE7890 Kf_Xs16_Ys16_Ws16 200.0000 Prc -100.0000 100.0000 FORMAT "%8.4" EXTENDED_LIMITS -400.0000 399.9878
 /begin AXIS_DESCR STD_AXIS Eng_nAvrg EngN 10 0.00 6000.000 FORMAT "%8.3" EXTENDED_LIMITS -32768.00 32767.00 DEPOSIT ABSOLUTE /end AXIS_DESCR
 /begin AXIS_DESCR STD_AXIS PCR_qCtl_mp InjMassCyc 8 0.00 327.6700 FORMAT "%8.4" EXTENDED_LIMITS -327.6800 327.6700 DEPOSIT ABSOLUTE /end AXIS_DESCR
/end CHARACTERISTIC
/begin CHARACTERISTIC PCR_rCtlBas_MAP "Basissteuerkennfeld für Ladedruck" MAP 0xE7958 Kf_Xs16_Ys16_Ws16 300.0000 Prc -100.0000 200.0000 FORMAT "%8.4" EXTENDED_LIMITS -400.0000 399.9878
 /begin AXIS_DESCR STD_AXIS Eng_nAvrg EngN 16 0.00 6000.000 FORMAT "%8.3" EXTENDED_LIMITS -32768.00 32767.00 DEPOSIT ABSOLUTE /end AXIS_DESCR
 /begin AXIS_DESCR STD_AXIS PCR_qCtl_mp InjMassCyc 16 0.00 327.6700 FORMAT "%8.4" EXTENDED_LIMITS -327.6800 327.6700 DEPOSIT ABSOLUTE /end AXIS_DESCR
/end CHARACTERISTIC
/begin CHARACTERISTIC PCR_rCtlInit_C "Initialisierungswert für Steuersignal" VALUE 0xE7B9C Kw_Ws16 50.00000 Prc 0.00 50.00000 FORMAT "%8.5" EXTENDED_LIMITS -400.0000 399.9878 /end CHARACTERISTIC
/begin CHARACTERISTIC PCR_rDistAdPCV1_C "Verzerrung eingang des I1-Reglers" VALUE 0xE9228 Kw_Ws16 100.0000 Prc 0.00 100.0000 FORMAT "%8.4" EXTENDED_LIMITS -400.0000 399.9878 /end CHARACTERISTIC
/begin CHARACTERISTIC PCR_rDistAdPCV2_C "Verzerrung eingang des I2-Reglers" VALUE 0xE922A Kw_Ws16 100.0000 Prc 0.00 100.0000 FORMAT "%8.4" EXTENDED_LIMITS -400.0000 399.9878 /end CHARACTERISTIC
/begin CHARACTERISTIC PCR_rDistAdPCV3_C "Verzerrung eingang des I3-Reglers" VALUE 0xE922C Kw_Ws16 100.0000 Prc 0.00 100.0000 FORMAT "%8.4" EXTENDED_LIMITS -400.0000 399.9878 /end CHARACTERISTIC
/begin CHARACTERISTIC PCR_rDistAdPCV4_C "Verzerrung eingang des I4-Reglers" VALUE 0xE922E Kw_Ws16 100.0000 Prc 0.00 100.0000 FORMAT "%8.4" EXTENDED_LIMITS -400.0000 399.9878 /end CHARACTERISTIC
/begin CHARACTERISTIC PCR_rDt1InitLP_C "Initialisierungs-Wert fuer DT1-Regler" VALUE 0xEAB48 Kw_Ws16 200.0000 Prc -100.0000 100.0000 FORMAT "%8.4" EXTENDED_LIMITS -400.0000 399.9878 /end CHARACTERISTIC
/begin CHARACTERISTIC PCR_rGovMaxLP_C "Maximale Grenze fuer Regler Ausgang" VALUE 0xEAB4A Kw_Ws16 200.0000 Prc -100.0000 100.0000 FORMAT "%8.4" EXTENDED_LIMITS -400.0000 399.9878 /end CHARACTERISTIC
/begin CHARACTERISTIC PCR_rGovMinLP_C "Minimale Grenze fuer Regler Ausgang" VALUE 0xEAB4C Kw_Ws16 200.0000 Prc -100.0000 100.0000 FORMAT "%8.4" EXTENDED_LIMITS -400.0000 399.9878 /end CHARACTERISTIC
/begin CHARACTERISTIC PCR_rGvnrMax_CUR "Kennlinie zur Bestimmung der maximal zulässigen Stellgroesse aus dem Verbrauch" CURVE 0xE9230 Kl_Xs16_Ws16 300.0000 Prc -100.0000 200.0000 FORMAT "%8.4" EXTENDED_LIMITS -400.0000 399.9878
 /begin AXIS_DESCR STD_AXIS CoEng_dvolFlConsum FlConsum_l_h 16 0.00 327.6700 FORMAT "%8.4" EXTENDED_LIMITS -327.6800 327.6700 DEPOSIT ABSOLUTE /end AXIS_DESCR
/end CHARACTERISTIC
/begin CHARACTERISTIC PCR_rGvnrMax_MAP "Kennfeld/Kennlinie zur Bestimmung der maximal zulässigen Stellgröße aus Drehzahl und Einspritzmenge" MAP 0xE9272 Kf_Xs16_Ys16_Ws16 300.0000 Prc -100.0000 200.0000 FORMAT "%8.4" EXTENDED_LIMITS -400.0000 399.9878
 /begin AXIS_DESCR STD_AXIS Eng_nAvrg EngN 16 0.00 8000.000 FORMAT "%8.3" EXTENDED_LIMITS -32768.00 32767.00 DEPOSIT ABSOLUTE /end AXIS_DESCR
 /begin AXIS_DESCR STD_AXIS PCR_qReal InjMassCyc 16 0.00 200.0000 FORMAT "%8.4" EXTENDED_LIMITS -327.6800 327.6700 DEPOSIT ABSOLUTE /end AXIS_DESCR
/end CHARACTERISTIC
/begin CHARACTERISTIC PCR_rGvnrMin_CUR "Kennlinie zur Bestimmung der minimal zulässigen Stellgoesse aus dem Verbrauch" CURVE 0xE94B6 Kl_Xs16_Ws16 300.0000 Prc -100.0000 200.0000 FORMAT "%8.4" EXTENDED_LIMITS -400.0000 399.9878
 /begin AXIS_DESCR STD_AXIS CoEng_dvolFlConsum FlConsum_l_h 2 0.00 327.6700 FORMAT "%8.4" EXTENDED_LIMITS -327.6800 327.6700 DEPOSIT ABSOLUTE /end AXIS_DESCR
/end CHARACTERISTIC
/begin CHARACTERISTIC PCR_rGvnrMin_MAP "Kennfeld/Kennlinie zur Bestimmung der minimal zulässigen Stellgröße aus Drehzahl und Einspritzmenge" MAP 0xE94C0 Kf_Xs16_Ys16_Ws16 300.0000 Prc -100.0000 200.0000 FORMAT "%8.4" EXTENDED_LIMITS -400.0000 399.9878
 /begin AXIS_DESCR STD_AXIS Eng_nAvrg EngN 4 0.00 8000.000 FORMAT "%8.3" EXTENDED_LIMITS -32768.00 32767.00 DEPOSIT ABSOLUTE /end AXIS_DESCR
 /begin AXIS_DESCR STD_AXIS PCR_qReal InjMassCyc 4 0.00 200.0000 FORMAT "%8.4" EXTENDED_LIMITS -327.6800 327.6700 DEPOSIT ABSOLUTE /end AXIS_DESCR
/end CHARACTERISTIC
/begin CHARACTERISTIC PCR_rIInitLP_C "Initialisierungs-Wert fuer PI-Regler" VALUE 0xEAB4E Kw_Ws16 200.0000 Prc -100.0000 100.0000 FORMAT "%8.4" EXTENDED_LIMITS -400.0000 399.9878 /end CHARACTERISTIC
/begin CHARACTERISTIC PCR_rMaxLP_C "Maximale Grenze fuer PID + Vorsteuertastverhaeltnis Ausgang" VALUE 0xEAB50 Kw_Ws16 200.0000 Prc -100.0000 100.0000 FORMAT "%8.4" EXTENDED_LIMITS -400.0000 399.9878 /end CHARACTERISTIC
/begin CHARACTERISTIC PCR_rMinLP_C "Minimale Grenze fuer PID + Vorsteuertastverhaeltnis Ausgang" VALUE 0xEAB52 Kw_Ws16 200.0000 Prc -100.0000 100.0000 FORMAT "%8.4" EXTENDED_LIMITS -400.0000 399.9878 /end CHARACTERISTIC
/begin CHARACTERISTIC PCR_rOutIMax_MAP "Kennfeld zur Limitierung des I-Reglers über Drehzahl und differentzierten gefilterteren Werts des Ladedrucks" MAP 0xE94F4 Kf_Xs16_Ys16_Ws16 5.004883 Prc 0.00 5.004883 FORMAT "%8.6" EXTENDED_LIMITS -400.0000 399.9878
 /begin AXIS_DESCR STD_AXIS BPSCD_dFltValDT1 dp_dZ10 8 -350000.0 350000.0 FORMAT "%8.1" EXTENDED_LIMITS -327680.0 327670.0 DEPOSIT ABSOLUTE /end AXIS_DESCR
 /begin AXIS_DESCR STD_AXIS Eng_nAvrg EngN 8 40.00000 6000.000 FORMAT "%8.3" EXTENDED_LIMITS -32768.00 32767.00 DEPOSIT ABSOLUTE /end AXIS_DESCR
/end CHARACTERISTIC
/begin CHARACTERISTIC PCR_rSurgeCtlVal_MAP "boost pressure control value for Anti-Surge LIGov" MAP 0xE7B9E Kf_Xs16_Ys16_Ws16 100.0000 Prc 0.00 100.0000 FORMAT "%8.4" EXTENDED_LIMITS -400.0000 399.9878
 /begin AXIS_DESCR STD_AXIS Eng_nAvrg EngN 16 0.00 6000.000 FORMAT "%8.3" EXTENDED_LIMITS -32768.00 32767.00 DEPOSIT ABSOLUTE /end AXIS_DESCR
 /begin AXIS_DESCR STD_AXIS PCR_qCtl_mp InjMassCyc 16 0.00 327.6700 FORMAT "%8.4" EXTENDED_LIMITS -327.6800 327.6700 DEPOSIT ABSOLUTE /end AXIS_DESCR
/end CHARACTERISTIC
/begin CHARACTERISTIC PCR_rSurgeHigh_MAP "#SSD Hystereseschwelle oben Druckverhältnis Anti-Surge LIGov" MAP 0xE7E5C Kf_Xs16_Ys16_Ws16 100.0000 Prc 0.00 100.0000 FORMAT "%8.4" EXTENDED_LIMITS -400.0000 399.9878
 /begin AXIS_DESCR STD_AXIS Eng_nAvrg EngN 8 0.00 6000.000 FORMAT "%8.3" EXTENDED_LIMITS -32768.00 32767.00 DEPOSIT ABSOLUTE /end AXIS_DESCR
 /begin AXIS_DESCR STD_AXIS APSCD_pVal Pres_hPa 3 0.00 3500.000 FORMAT "%8.3" EXTENDED_LIMITS -32768.00 32767.00 DEPOSIT ABSOLUTE /end AXIS_DESCR
/end CHARACTERISTIC
/begin CHARACTERISTIC PCR_rSurgeOfs_CUR "Lower ATL pressure ratio limit for hysteresis of Anti-Surge LIGov" CURVE 0xE7EA6 Kl_Xs16_Ws16 280.0049 Prc 0.00 280.0049 FORMAT "%8.4" EXTENDED_LIMITS -400.0000 399.9878
 /begin AXIS_DESCR STD_AXIS Eng_nAvrg EngN 5 0.00 6000.000 FORMAT "%8.3" EXTENDED_LIMITS -32768.00 32767.00 DEPOSIT ABSOLUTE /end AXIS_DESCR
/end CHARACTERISTIC
/begin CHARACTERISTIC PCR_stAdPCVReset_C "Status fuer die eeprom Spiegel-Werte neu zu fassen" VALUE 0xE9598 Kw_Wu8 255.0 OneToOne 0.00 255.0 FORMAT "%5.1" /end CHARACTERISTIC
/begin CHARACTERISTIC PCR_stCtlVal1_C "Maske für Regenerationswert 1" VALUE 0xE7DE4 Kw_Wu32 4294967295.00 OneToOne 0.00 4294967295.00 FORMAT "%13.2" /end CHARACTERISTIC
/begin CHARACTERISTIC PCR_stCtlVal2_C "Maske für Regenerationswert 2" VALUE 0xE7DE8 Kw_Wu32 4294967295.00 OneToOne 0.00 4294967295.00 FORMAT "%13.2" /end CHARACTERISTIC
/begin CHARACTERISTIC PCR_stRgnMsk1_C "applizierbare Bitmaske für erstes Regenerationskennfeld" VALUE 0xE8BA4 Kw_Wu32 4294967295.00 OneToOne 0.00 4294967295.00 FORMAT "%13.2" /end CHARACTERISTIC
/begin CHARACTERISTIC PCR_stRgnMsk2_C "applizierbare Bitmaske für zweites Regenerationskennfeld" VALUE 0xE8BA8 Kw_Wu32 4294967295.00 OneToOne 0.00 4294967295.00 FORMAT "%13.2" /end CHARACTERISTIC
/begin CHARACTERISTIC PCR_stRgnMskLP1_C "Erste Maske für Auswahl LPGov Regeneration Mode" VALUE 0xEAB54 Kw_Wu32 4294967295.00 OneToOne 0.00 4294967295.00 FORMAT "%13.2" /end CHARACTERISTIC
/begin CHARACTERISTIC PCR_stRgnMskLP2_C "Zweite Maske für Auswahl LPGov Regeneration Mode" VALUE 0xEAB58 Kw_Wu32 4294967295.00 OneToOne 0.00 4294967295.00 FORMAT "%13.2" /end CHARACTERISTIC
/begin CHARACTERISTIC PCR_tiSurgePT1_C "Time constant of PT1 delay element of PCR_SurgePT1" VALUE 0xE7EBC Kw_Wu32 4294.8273 TimeDelay_s 0.14000154 4294.9673 FORMAT "%9.4" EXTENDED_LIMITS 0.0000010000000 4294.9673 /end CHARACTERISTIC
/begin CHARACTERISTIC PCR_swtActSlpLim_C "Schalter Status Sollwert AbfallBegrenzung (1: PWG/Menge, 0: Ladedrucksollwert)" VALUE 0xE8BAC Kw_Wu8 255.0 OneToOne 0.00 255.0 FORMAT "%5.1" /end CHARACTERISTIC
/begin CHARACTERISTIC PCR_swtAdPCVrLim_C "Schalter Status Stop Lernen - Anhebung / Absenkung adaptiver Vorsteuerwertes (0: >0, 1: <0)" VALUE 0xE9599 Kw_Wu8 255.0 OneToOne 0.00 255.0 FORMAT "%5.1" /end CHARACTERISTIC
/begin CHARACTERISTIC PCR_swtARWMode_C "Schalter für ""Anti-Reset-Windup""- Massnahme (0: einfrieren, 1: rückrechnen)" VALUE 0xE95B2 Kw_Wu8 1.000 OneToOne 0.00 1.000 FORMAT "%5.3" EXTENDED_LIMITS 0.00 255.0 /end CHARACTERISTIC
/begin CHARACTERISTIC PCR_swtIDevType_C "Deviation I/P  Integrator selection switch (0: Zusatzfunktion aktiviert, 1: deaktiviert)" VALUE 0xE959A Kw_Wu8 255.0 OneToOne 0.00 255.0 FORMAT "%5.1" /end CHARACTERISTIC
/begin CHARACTERISTIC PCR_swtLimMpCrVal_C "Schalter zur Auswahl der Größen, aus denen der Stellgrößenbereich bestimmt wird (1: Verbrauch, 0: Drehzahl und Einspritzmenge)" VALUE 0xE959B Kw_Wu8 0.00 OneToOne 1.000 1.000 FORMAT "%5.3" EXTENDED_LIMITS 0.00 255.0 /end CHARACTERISTIC
/begin CHARACTERISTIC PCR_swtLimMpCrType_C "Schaltertyp zur Auswahl der Größen, aus denen der zulässige Stellgrößenbereich bestimmt wird" VALUE 0xE959C Kw_Wu8 0.00 OneToOne 0.00 0.00 FORMAT "%5.2" EXTENDED_LIMITS 0.00 255.0 /end CHARACTERISTIC
/begin CHARACTERISTIC PCR_swtLimSelVal_C "Auswahl Größen f. Bestimmung des zuläss. Stellgrößenbereichs (P263:bei Init. gelesen)(0:PCR_swtLimSel_CSTR; 1:Eng_nAvrg,qInjCtl)" VALUE 0xE959D Kw_Wu8 0.00 OneToOne 1.000 1.000 FORMAT "%5.3" EXTENDED_LIMITS 0.00 255.0 /end CHARACTERISTIC
/begin CHARACTERISTIC PCR_swtLimSelType_C "Schaltertyp zur Auswahl der Größen, aus denen der zulässige Stellgrößenbereich bestimmt wird" VALUE 0xE959E Kw_Wu8 0.00 OneToOne 0.00 0.00 FORMAT "%5.2" EXTENDED_LIMITS 0.00 255.0 /end CHARACTERISTIC
/begin CHARACTERISTIC PCR_swtOffStat1_C "Schalter um den Einfluss von PCR_stSurge1 zu deaktivieren (1...deaktiviert, 0...aktiviert)" VALUE 0xE7EC0 Kw_Wu8 1.000 OneToOne 0.00 1.000 FORMAT "%5.3" EXTENDED_LIMITS 0.00 255.0 /end CHARACTERISTIC
/begin CHARACTERISTIC PCR_swtQntCtlVal_C "Schalterwert zur Auswahl der für Steuerung verwendeten Einspritzmenge (1: akt. Einspritzmenge, 2: Rohwert, 3: berechnet)" VALUE 0xE7DEC Kw_Wu8 4.000 OneToOne 1.000 5.000 FORMAT "%5.3" EXTENDED_LIMITS 0.00 255.0 /end CHARACTERISTIC
/begin CHARACTERISTIC PCR_swtQntCtlType_C "Schaltertyp zur Auswahl der für Steuerung verwendeten Einspritzmenge" VALUE 0xE7DED Kw_Wu8 1.000 OneToOne 1.000 2.000 FORMAT "%5.3" EXTENDED_LIMITS 0.00 255.0 /end CHARACTERISTIC
/begin CHARACTERISTIC PCR_swtQntDesVal_C "Mengeneingangswunsch bei der Sollwertberechnung (1: akt Einspritzmenge, 2: Rohwert, 3: Berechnet, 4: CurrCor, d: RawCor)" VALUE 0xE8BAD Kw_Wu8 4.000 OneToOne 1.000 5.000 FORMAT "%5.3" EXTENDED_LIMITS 0.00 255.0 /end CHARACTERISTIC
/begin CHARACTERISTIC PCR_swtQntDesType_C "Schaltertyp für Mengeneingangswunsch bei der Sollwertberechnung" VALUE 0xE8BAE Kw_Wu8 1.000 OneToOne 1.000 2.000 FORMAT "%5.3" EXTENDED_LIMITS 0.00 255.0 /end CHARACTERISTIC
/begin CHARACTERISTIC PCR_swtRawCur_C "Auswahl der Einspritzmenge - 0: Rohwert oder 1: aktueller Wert" VALUE 0xE959F Kw_Wu8 255.0 OneToOne 0.00 255.0 FORMAT "%5.1" /end CHARACTERISTIC
/begin CHARACTERISTIC PCR_swtRelAbsVal_C "#SSD Schalterwert zur  Auswahl zwischen Absolut- und Relativdruckregelung  (0: absolut, 1: relativ)" VALUE 0xE95A0 Kw_Wu8 1.000 OneToOne 0.00 1.000 FORMAT "%5.3" EXTENDED_LIMITS 0.00 255.0 /end CHARACTERISTIC
/begin CHARACTERISTIC PCR_swtRelAbsType_C "#SSD Softwareschalter Typ zur  Auswahl zwischen Absolut- und Relativdruckregelung" VALUE 0xE95A1 Kw_Wu8 1.000 OneToOne 1.000 2.000 FORMAT "%5.3" EXTENDED_LIMITS 0.00 255.0 /end CHARACTERISTIC
/begin CHARACTERISTIC PCR_swtSlpLimInputType_C "Switch for selection of Slope limitation type" VALUE 0xE8BAF Kw_Wu8 255.0 OneToOne 0.00 255.0 FORMAT "%5.1" /end CHARACTERISTIC
/begin CHARACTERISTIC PCR_swtSurgeGearBPA_C "Maske AntiSurge-LDR Gang-Auswahl (Bit0 für FrmMng_stConv=0, bit1 für FrmMng_stConv=1)" VALUE 0xE7EC1 Kw_Wu8 127.0 OneToOne 0.00 127.0 FORMAT "%5.1" EXTENDED_LIMITS 0.00 255.0 /end CHARACTERISTIC
/begin CHARACTERISTIC PCR_swtSurgeGearLIGov_C "Maske AntiSurge-LLR Gang-Auswahl (Bit0/1 für ConvCD_stDebVal=0/1, Bit4/5/6 für FrmMng_stConv=0/1/2)" VALUE 0xE7EC2 Kw_Wu8 3.000 OneToOne 0.00 3.000 FORMAT "%5.3" EXTENDED_LIMITS 0.00 255.0 /end CHARACTERISTIC
/begin CHARACTERISTIC PCR_tAirAdPCVMax_C "Maximale Grenze fuer Kuehlmitteltemperatur" VALUE 0xE95A2 Kw_Ws16 950.000 Temp_Cels -50.140 899.860 FORMAT "%8.3" EXTENDED_LIMITS -3549.940 3003.560 /end CHARACTERISTIC
/begin CHARACTERISTIC PCR_tAirAdPCVMin_C "Minimale Grenze fuer  Lufttemperatur" VALUE 0xE95A4 Kw_Ws16 950.000 Temp_Cels -50.140 899.860 FORMAT "%8.3" EXTENDED_LIMITS -3549.940 3003.560 /end CHARACTERISTIC
/begin CHARACTERISTIC PCR_tClntAdPCVLim_C "Minimale Grenze fuer Kuehlmittel temperatur" VALUE 0xE95A6 Kw_Ws16 950.000 Temp_Cels -50.140 899.860 FORMAT "%8.3" EXTENDED_LIMITS -3549.940 3003.560 /end CHARACTERISTIC
/begin CHARACTERISTIC PCR_tClntThres_C "Kühlwassertemperaturschwelle zur Parametersatzumschaltung bei der Berechnung des dyn. Anteils" VALUE 0xE8BB0 Kw_Ws16 950.000 Temp_Cels -50.140 899.860 FORMAT "%8.3" EXTENDED_LIMITS -3549.940 3003.560 /end CHARACTERISTIC
/begin CHARACTERISTIC PCR_tiHiLoAdPCVRelCond0_C "Entprellzeit der Aktivierung Releasecondition 0 (RegelabweiRegelabweichung) der adaptiven Vorsteuerung" VALUE 0xE95A8 Kw_Wu16 655350.0 TimeDeb 0.00 655350.0 FORMAT "%8.1" /end CHARACTERISTIC
/begin CHARACTERISTIC PCR_tiLoHiAdPCVRelCond0_C "Entprellzeit der Deaktivierung Releasecondition 0 (RegelabweiRegelabweichung)der adaptiven Vorsteuerung" VALUE 0xE95AA Kw_Wu16 655350.0 TimeDeb 0.00 655350.0 FORMAT "%8.1" /end CHARACTERISTIC
/begin CHARACTERISTIC PCR_tiHiLoAdPCVRelCond3_C "Entprellzeit der Deaktivierung Releasecondition 3 RegelabweiRegelabweichung) der adaptiven Vorsteuerung" VALUE 0xE95AC Kw_Wu16 655350.0 TimeDeb 0.00 655350.0 FORMAT "%8.1" /end CHARACTERISTIC
/begin CHARACTERISTIC PCR_tiLoHiAdPCVRelCond3_C "Entprellzeit der Aktivierung Releasecondition 3 RegelabweiRegelabweichung)der adaptiven Vorsteuerung" VALUE 0xE95AE Kw_Wu16 655350.0 TimeDeb 0.00 655350.0 FORMAT "%8.1" /end CHARACTERISTIC
/begin CHARACTERISTIC PCR_tiBDesSlpLim_C "Time duration for which desired boost pressure value is through the ramp." VALUE 0xE8BB2 Kw_Wu16 655.3500 Time_s 0.00 655.3500 FORMAT "%8.4" /end CHARACTERISTIC
/begin CHARACTERISTIC PCR_tiRmpCtl_C "Ramplaufzeit für Umschaltung der Korrekturwerte" VAL_BLK 0xE7DF0 Kwb_Wu32 65.535999984741210 EGTRmp 0.000000015258789066052715 65.536000000000001 FORMAT "%19.16" NUMBER 3 /end CHARACTERISTIC
/begin CHARACTERISTIC PCR_tiRmpMswt_C "Rampenlaufzeit für Mehrfachumschalter" VAL_BLK 0xE8BB4 Kwb_Wu32 65.535999984741210 EGTRmp 0.000000015258789066052715 65.536000000000001 FORMAT "%19.16" NUMBER 3 /end CHARACTERISTIC
/begin CHARACTERISTIC PCR_tiRmpSlp_C "Rampensteigungen für EGT_RgnSwt" VAL_BLK 0xEAB5C Kwb_Wu32 65.535999984741210 EGTRmp 0.000000015258789066052715 65.536000000000001 FORMAT "%19.16" NUMBER 3 /end CHARACTERISTIC
/begin CHARACTERISTIC PCR_tiSurgeBPAHiLo_C "Entprellzeit für Status PCR_stSurge2 für Übergang von 1 auf 0" VALUE 0xE7EC4 Kw_Wu16 4000.000 Time_ms 0.00 4000.000 FORMAT "%8.3" EXTENDED_LIMITS 0.00 655350.0 /end CHARACTERISTIC
/begin CHARACTERISTIC PCR_tiSurgeBPALoHi_C "Entprellzeit für Status PCR_stSurge2 für Übergang von 0 auf 1" VALUE 0xE7EC6 Kw_Wu16 4000.000 Time_ms 0.00 4000.000 FORMAT "%8.3" EXTENDED_LIMITS 0.00 655350.0 /end CHARACTERISTIC
/begin CHARACTERISTIC PCR_tiSurgeMonLIGov_C "#SSD Überwachungszeit Drehzahlanhebung Anti-Surge" VALUE 0xE7EC8 Kw_Wu16 655350.0 Time_ms 0.00 655350.0 FORMAT "%8.1" /end CHARACTERISTIC
/begin CHARACTERISTIC PCR_vSurgeLIGov_C "#SSD Schwelle Geschwindigkeit Anti-Surge/ Laderpumpen LIGov" VALUE 0xE7ECA Kw_Ws16 300.0000 Vel 0.00 300.0000 FORMAT "%8.4" EXTENDED_LIMITS -327.6800 327.6700 /end CHARACTERISTIC
/begin CHARACTERISTIC PCR_tiDT1DesWrm_C "Verzögerungszeitkonstante der dynamischen Sollwertbildung bei warmem Motor" VALUE 0xE8BC0 Kw_Wu32 4294.9663 TimeDelay_s 0.0010000001 4294.9673 FORMAT "%9.4" EXTENDED_LIMITS 0.0000010000000 4294.9673 /end CHARACTERISTIC
/begin CHARACTERISTIC PCR_DKdDesWrm_C "Kleinsignalverstärkung der dynamischen Sollwertbildung bei warmem Motor" VALUE 0xE8BC4 Kw_Ws32 65535.9999847 Kd -32768.0000000 32767.9999847 FORMAT "%13.7" /end CHARACTERISTIC
/begin CHARACTERISTIC PCR_DKdPosDesWrm_C "Positive Großsignalverstärkung der dynamischen Sollwertbildung bei warmem Motor" VALUE 0xE8BC8 Kw_Ws32 65535.9999847 Kd -32768.0000000 32767.9999847 FORMAT "%13.7" /end CHARACTERISTIC
/begin CHARACTERISTIC PCR_DKdNegDesWrm_C "Negative Großsignalverstärkung der dynamischen Sollwertbildung bei warmem Motor" VALUE 0xE8BCC Kw_Ws32 65535.9999847 Kd -32768.0000000 32767.9999847 FORMAT "%13.7" /end CHARACTERISTIC
/begin CHARACTERISTIC PCR_dpDWinPosDesWrm_C "Positive Kleinsignalgrenze bei warmem Motor" VALUE 0xE8BD0 Kw_Ws16 65535.00 Pres_hPa -32768.00 32767.00 FORMAT "%8.2" /end CHARACTERISTIC
/begin CHARACTERISTIC PCR_dpDWinNegDesWrm_C "Negative Kleinsignalgrenze bei warmem Motor" VALUE 0xE8BD2 Kw_Ws16 65535.00 Pres_hPa -32768.00 32767.00 FORMAT "%8.2" /end CHARACTERISTIC
/begin MEASUREMENT MSidCD_numECUS "Anzahl der ECU in diesem system: 1 - 4 (Master/Slave)" UBYTE OneToOne 1 100 0.00 255.0 FORMAT "%5.1" ECU_ADDRESS 0x7F8972 /end MEASUREMENT
/begin MEASUREMENT MSidCD_stCANpriv_mp "Status Plausibilisierung über priv. CAN (entprellt)" UBYTE OneToOne 1 100 0.00 255.0 FORMAT "%5.1" ECU_ADDRESS 0x8FF9E8 /end MEASUREMENT
/begin MEASUREMENT MSidCD_stECUCANpriv_mp "Status privater CAN (nicht entprellt)" UWORD OneToOne 1 100 0.00 65535.00 FORMAT "%8.2" ECU_ADDRESS 0x8FF9EA /end MEASUREMENT
/begin MEASUREMENT MSidCD_stECUCANPtHelp_mp "Olda privater CAN Fehler-Status Senden um Empfangen" UWORD OneToOne 1 100 0.00 65535.00 FORMAT "%8.2" ECU_ADDRESS 0x8FF9EC /end MEASUREMENT
/begin MEASUREMENT MSidCD_stECULearned_mp "Status SG-Auswahl gelernt (EEPROM-info)" UBYTE OneToOne 1 100 0.00 255.0 FORMAT "%5.1" ECU_ADDRESS 0x8FF9EE /end MEASUREMENT
/begin MEASUREMENT MSidCD_stECULTmp_mp "Status SG-Auswahl vorläufig gelernt" UBYTE OneToOne 1 100 0.00 255.0 FORMAT "%5.1" ECU_ADDRESS 0x8FF9EF /end MEASUREMENT
/begin MEASUREMENT MSidCD_stECUPlaus_mp "Status Plausibilisierung SG-Auswahl" UBYTE OneToOne 1 100 0.00 255.0 FORMAT "%5.1" ECU_ADDRESS 0x8FF9F0 /end MEASUREMENT
/begin MEASUREMENT MSidCD_stECUSelect_mp "Zusammenfassung Stati SG-Auswahl" UBYTE OneToOne 1 100 0.00 255.0 FORMAT "%5.1" ECU_ADDRESS 0x8FF9F1 /end MEASUREMENT
/begin MEASUREMENT MSidCD_stECUStatus_mp "Zustandsautomat SG-Auswahl" UBYTE OneToOne 1 100 0.00 255.0 FORMAT "%5.1" ECU_ADDRESS 0x8FF9F2 /end MEASUREMENT
/begin MEASUREMENT MSidCD_stErrEcuPinComm_mp "State of ECU pin error" UBYTE OneToOne 1 100 0.00 255.0 FORMAT "%5.1" ECU_ADDRESS 0x8FF9F3 /end MEASUREMENT
/begin MEASUREMENT MSidCD_stErrECUSelect_mp "Errorflag SG-Auswahl nicht plausibel" UBYTE OneToOne 1 100 0.00 255.0 FORMAT "%5.1" ECU_ADDRESS 0x8FF9F4 /end MEASUREMENT
/begin MEASUREMENT MSidCD_stInjOffECU "Einspritzverbot durch SG-Auswahl" UBYTE OneToOne 1 100 0.00 255.0 FORMAT "%5.1" ECU_ADDRESS 0x7F8973 /end MEASUREMENT
/begin MEASUREMENT MSidCD_stSetEEPROM_mp "Status EEPROM (Schreiben) Lernen (SG-Auswahl)" UBYTE OneToOne 1 100 0.00 255.0 FORMAT "%5.1" ECU_ADDRESS 0x8FF9F5 /end MEASUREMENT
/begin MEASUREMENT MSidCD_swtECUinfo_mp "Input SG-Auswahl Info-EEPROM" UBYTE OneToOne 1 100 0.00 255.0 FORMAT "%5.1" ECU_ADDRESS 0x8FF9F6 /end MEASUREMENT
/begin MEASUREMENT MSidCD_swtECUnum_mp "storing EEPROM-info" UBYTE OneToOne 1 100 0.00 255.0 FORMAT "%5.1" ECU_ADDRESS 0x8FF9F7 /end MEASUREMENT
/begin MEASUREMENT MSidCD_swtMAIN "Typ der ECU: Single ECU=0xFF, Master Slave - Master: 0, Master Slave - Slave: 1,2,3 or 4" SBYTE OneToOne 1 100 -128.0 127.0 FORMAT "%5.1" ECU_ADDRESS 0x7F8975 /end MEASUREMENT
/begin MEASUREMENT MSidCD_swtMasterHW_mp "Info SG-Auswahl (plausibilisiert)" SBYTE OneToOne 1 100 -128.0 127.0 FORMAT "%5.1" ECU_ADDRESS 0x8FF9F8 /end MEASUREMENT
/begin MEASUREMENT MSidCD_swtPinDrive_mp "Status SGA-Pin Rohwert" SBYTE OneToOne 1 100 -128.0 127.0 FORMAT "%5.1" ECU_ADDRESS 0x8FF9F9 /end MEASUREMENT
/begin MEASUREMENT MSidCD_swtPinECU_mp "Input HW-Pin" SBYTE OneToOne 1 100 -128.0 127.0 FORMAT "%5.1" ECU_ADDRESS 0x8FF9FA /end MEASUREMENT
/begin MEASUREMENT NetMng_stCANBus "Status der CAN Controller" ULONG OneToOne 1 100 0.00 4294967295.00 FORMAT "%13.2" ECU_ADDRESS 0x7F9260 /end MEASUREMENT
/begin MEASUREMENT NetMng_stDfpCanA_mp "" UBYTE OneToOne 1 100 0.00 255.0 FORMAT "%5.1" ECU_ADDRESS 0x8FF9FB /end MEASUREMENT
/begin MEASUREMENT NetMng_stDfpCanB_mp "" UBYTE OneToOne 1 100 0.00 255.0 FORMAT "%5.1" ECU_ADDRESS 0x8FF9FC /end MEASUREMENT
/begin MEASUREMENT NetMng_stDfpCanC_mp "" UBYTE OneToOne 1 100 0.00 255.0 FORMAT "%5.1" ECU_ADDRESS 0x8FF9FD /end MEASUREMENT
/begin MEASUREMENT NetMng_stDfpMaskPtCan_mp "" UBYTE OneToOne 1 100 0.00 255.0 FORMAT "%5.1" ECU_ADDRESS 0x8FF9FE /end MEASUREMENT
/begin MEASUREMENT NetMng_stDisableMsg "disable message by diagnosis" UBYTE OneToOne 1 100 0.00 255.0 FORMAT "%5.1" ECU_ADDRESS 0x7F8976 /end MEASUREMENT
/begin MEASUREMENT NetMng_stFadeOut "Status der CAN Ausblendung" UWORD OneToOne 1 100 0.00 65535.00 FORMAT "%8.2" ECU_ADDRESS 0x7F8FD8 /end MEASUREMENT
/begin MEASUREMENT NetMng_stONWM "Aktueller Zustand des OSEK Netzwerkmanagements" UWORD OneToOne 1 100 0.00 65535.00 FORMAT "%8.2" ECU_ADDRESS 0x7F8FDA /end MEASUREMENT
/begin MEASUREMENT NSC_numPrio "Prioritätszahl des Regenerationsanforderungslevel des NOx-Specherkat" UWORD OneToOne 1 100 0.00 65535.00 FORMAT "%8.2" ECU_ADDRESS 0x7F8FD6 /end MEASUREMENT
/begin MEASUREMENT NSC_st "von NOx-Speicherkatalysator angeforderter Regenerationsstatus" ULONG OneToOne 1 100 0.00 4294967295.00 FORMAT "%13.2" ECU_ADDRESS 0x7F925C /end MEASUREMENT
/begin MEASUREMENT OPSCD_stInactive_mp "Status Abschaltung (Nachlauf,  ABS-Bremsung, Startfall)" UWORD OneToOne 1 100 0.00 65535.00 FORMAT "%8.2" ECU_ADDRESS 0x8FFA02 /end MEASUREMENT
/begin MEASUREMENT OPSCD_stLampRun_mp "Meßpunkt für Laufzeitmessung" UWORD OneToOne 1 100 0.00 65535.00 FORMAT "%8.2" ECU_ADDRESS 0x8FFA04 /end MEASUREMENT
/begin MEASUREMENT OPSCD_stpOEL "oil pressure sensor signal" UBYTE OneToOne 1 100 0.00 255.0 FORMAT "%5.1" ECU_ADDRESS 0x7F8978 /end MEASUREMENT
/begin MEASUREMENT OPSCD_stSigOut "Ausgangssignal Öldruckschalter" UBYTE OneToOne 1 100 0.00 255.0 FORMAT "%5.1" ECU_ADDRESS 0x7F8977 /end MEASUREMENT
/begin MEASUREMENT OPSCD_uRaw_POEL_mp "Voltage raw value of the oil pressure sensor" SWORD Volt 1 100 -160156.4 160151.5 FORMAT "%8.1" ECU_ADDRESS 0x8FFA00 /end MEASUREMENT
/begin MEASUREMENT OTSCD_stPlaus "status der Plausibilitaetspruefung OTF/WTF" UBYTE OneToOne 1 100 0.00 255.0 FORMAT "%5.1" ECU_ADDRESS 0x7F8979 /end MEASUREMENT
/begin MEASUREMENT OTSCD_swtSig "Signalquelle Schalter ADC/CAN" UBYTE OneToOne 1 100 0.00 255.0 FORMAT "%5.1" ECU_ADDRESS 0x7F897A /end MEASUREMENT
/begin MEASUREMENT OTSCD_tEngOil "Motoröltemperatur" SWORD Temp_Cels 1 100 -50.140 899.860 FORMAT "%8.3" ECU_ADDRESS 0x7F8FDC /end MEASUREMENT
/begin MEASUREMENT OTSCD_tEngOilLin "linearisierter Wert aus HWK vorm Aufruf der Übergangsfunktion" SWORD Temp_Cels 1 100 -50.140 899.860 FORMAT "%8.3" ECU_ADDRESS 0x7F8FDE /end MEASUREMENT
/begin MEASUREMENT OTSCD_uRaw "Rohwert des OTF-Sensors" SWORD Volt 1 100 -160156.4 160151.5 FORMAT "%8.1" ECU_ADDRESS 0x7F8FE0 /end MEASUREMENT
/begin MEASUREMENT OvRMon_ct10MS "In der 10ms Scheibe inkrementierter Zähler, welcher zur Zeitlichen Steuerung von OvRMon_Co verwendet wird." UWORD OneToOne 1 100 0.00 65535.00 FORMAT "%8.2" ECU_ADDRESS 0x7F9CE8 /end MEASUREMENT
/begin MEASUREMENT OvRMon_ctDebET_mp "Entprellzähler der Schubüberwachung" UWORD OneToOne 1 100 0.00 65535.00 FORMAT "%8.2" ECU_ADDRESS 0x6F823C /end MEASUREMENT
/begin MEASUREMENT OvRMon_ctTORQUE_DSC "Zeitbegrenzungszähler für DSC Momentanforderung" UWORD OneToOne 1 100 0.00 65535.00 FORMAT "%8.2" ECU_ADDRESS 0x7F9D14 /end MEASUREMENT
/begin MEASUREMENT OvRMon_ctTORQUE_EGS "Zeitbegrenzungszähler für EGS; elektronisch gesteuertes Getriebe" UWORD OneToOne 1 100 0.00 65535.00 FORMAT "%8.2" ECU_ADDRESS 0x7F9D18 /end MEASUREMENT
/begin MEASUREMENT OvRMon_ctTORQUE_SSG "Zeitbegrenzungszähler für Momentenanforderung von SSG, Getriebe" UWORD OneToOne 1 100 0.00 65535.00 FORMAT "%8.2" ECU_ADDRESS 0x7F9D1C /end MEASUREMENT
/begin MEASUREMENT OvRMon_nAvrg "Redundante mittlere Drehzahl in der Schubüberwachung" SWORD EngN 1 100 -32768.00 32767.00 FORMAT "%8.2" ECU_ADDRESS 0x7F9D10 /end MEASUREMENT
/begin MEASUREMENT OvRMon_nSeg_mp "Mittlere Segmentdrehzahl in der Schubüberwachung" SWORD EngN 1 100 -32768.00 32767.00 FORMAT "%8.2" ECU_ADDRESS 0x8FFA1A /end MEASUREMENT
/begin MEASUREMENT OvRMon_numTORQUE_DSCbyteraw_mp "Botschaft der DSC- Momentenanforderung; bitweise" UBYTE OneToOne 1 100 0.00 255.0 FORMAT "%5.1" ECU_ADDRESS 0x8FFA2E /end MEASUREMENT
/begin MEASUREMENT OvRMon_numTORQUE_EGSbyteraw_mp "Botschaft der EGS- Momentenanforderung; bitweise, elektronisch gesteuertes Getriebe" UBYTE OneToOne 1 100 0.00 255.0 FORMAT "%5.1" ECU_ADDRESS 0x8FFA33 /end MEASUREMENT
/begin MEASUREMENT OvRMon_numTORQUE_SSGbyteraw_mp "Botschaft Momentenanforderung SSG; bitweise, Getriebe" UBYTE OneToOne 1 100 0.00 255.0 FORMAT "%5.1" ECU_ADDRESS 0x8FFA38 /end MEASUREMENT
/begin MEASUREMENT OvRMon_phiInjAct_mp "Winkel der zuletzt bearbeiteten Einspritzung" SWORD AngleCrS 1 100 -768.0000 767.9766 FORMAT "%8.4" ECU_ADDRESS 0x8FFA2A /end MEASUREMENT
/begin MEASUREMENT OvRMon_stActive "zeigt die Aktivierung der Schubüberwachung für Ebene 1 an" UBYTE OneToOne 1 100 0.00 255.0 FORMAT "%5.1" ECU_ADDRESS 0x7F897B /end MEASUREMENT
/begin MEASUREMENT OvRMon_stAPPDiff_mp "Status der Fahrpedalüberwachung" UBYTE OneToOne 1 100 0.00 255.0 FORMAT "%5.1" ECU_ADDRESS 0x8FFA06 /end MEASUREMENT
/begin MEASUREMENT OvRMon_stBrkPressed_mp "Meldung Bremse betätigt in der Schubüberwachung" UBYTE OneToOne 1 100 0.00 255.0 FORMAT "%5.1" ECU_ADDRESS 0x8FFA0C /end MEASUREMENT
/begin MEASUREMENT OvRMon_stBusOffDSC_mp "Zustand des inaktiven CAN- Bus der DSC Momentenanforderung;" UBYTE OneToOne 1 100 0.00 255.0 FORMAT "%5.1" ECU_ADDRESS 0x8FFA2F /end MEASUREMENT
/begin MEASUREMENT OvRMon_stBusOffEGS_mp "Zustand des inaktiven CAN- Bus der EGS Momentenanforderung; elektronisch gesteuertes Getriebe" UBYTE OneToOne 1 100 0.00 255.0 FORMAT "%5.1" ECU_ADDRESS 0x8FFA34 /end MEASUREMENT
/begin MEASUREMENT OvRMon_stBusOffSSG_mp "Zustand des inaktiven CAN- Bus der SSG Momentenanforderung; Getriebe" UBYTE OneToOne 1 100 0.00 255.0 FORMAT "%5.1" ECU_ADDRESS 0x8FFA39 /end MEASUREMENT
/begin MEASUREMENT OvRMon_stConvDebVal_mp "entprelltes Kupplungssignal in der Schubüberwachung" UBYTE OneToOne 1 100 0.00 255.0 FORMAT "%5.1" ECU_ADDRESS 0x8FFA0D /end MEASUREMENT
/begin MEASUREMENT OvRMon_stDCS_mp "Status DCS-Eingriff in der Schubüberwachung" UBYTE OneToOne 1 100 0.00 255.0 FORMAT "%5.1" ECU_ADDRESS 0x8FFA0E /end MEASUREMENT
/begin MEASUREMENT OvRMon_stEngSpdRls_mp "redundante Erfassung der Drehzahlanforderungsfreigabe in der Überwachungsebene 2" UBYTE OneToOne 1 100 0.00 255.0 FORMAT "%5.1" ECU_ADDRESS 0x8FFA0F /end MEASUREMENT
/begin MEASUREMENT OvRMon_stErrPassDSC_mp "Hardware Statusfehler für DSC" UBYTE OneToOne 1 100 0.00 255.0 FORMAT "%5.1" ECU_ADDRESS 0x8FFA30 /end MEASUREMENT
/begin MEASUREMENT OvRMon_stErrPassEGS_mp "Hardware Fehlerstatus fuer EGS; elektronisch gesteuertes Getriebe" UBYTE OneToOne 1 100 0.00 255.0 FORMAT "%5.1" ECU_ADDRESS 0x8FFA35 /end MEASUREMENT
/begin MEASUREMENT OvRMon_stErrPassSSG_mp "Hardware Statusfehler für SSG, Getriebe" UBYTE OneToOne 1 100 0.00 255.0 FORMAT "%5.1" ECU_ADDRESS 0x8FFA3A /end MEASUREMENT
/begin MEASUREMENT OvRMon_stGrip_mp "redundante Kraftschlusserfassung in der Überwachungsebene 2" UBYTE OneToOne 1 100 0.00 255.0 FORMAT "%5.1" ECU_ADDRESS 0x8FFA10 /end MEASUREMENT
/begin MEASUREMENT OvRMon_stHwDefDSC_mp "Zustand der inaktiven bzw. defekten Hardware für die DSC Momentenanforderung" UBYTE OneToOne 1 100 0.00 255.0 FORMAT "%5.1" ECU_ADDRESS 0x8FFA31 /end MEASUREMENT
/begin MEASUREMENT OvRMon_stHwDefEGS_mp "Zustand der inaktiven bzw. defekten Hardware für die EGS Momentenanforderung" UBYTE OneToOne 1 100 0.00 255.0 FORMAT "%5.1" ECU_ADDRESS 0x8FFA36 /end MEASUREMENT
/begin MEASUREMENT OvRMon_stHwDefSSG_mp "Zustand der inaktiven bzw. defekten Hardware für die SSG Momentenanforderung, Getriebe" UBYTE OneToOne 1 100 0.00 255.0 FORMAT "%5.1" ECU_ADDRESS 0x8FFA3B /end MEASUREMENT
/begin MEASUREMENT OvRMon_stIntr "Interrupt-Status der operativen Ebene" UBYTE OneToOne 1 100 0.00 255.0 FORMAT "%5.1" ECU_ADDRESS 0x7FCC58 /end MEASUREMENT
/begin MEASUREMENT OvRMon_stIntrInactv_mp "Status der Interruptkennung" UBYTE OneToOne 1 100 0.00 255.0 FORMAT "%5.1" ECU_ADDRESS 0x8FFA1C /end MEASUREMENT
/begin MEASUREMENT OvRMon_stLIGovRls "Status der LLR-Freigabe in der Schubüberwachung" UBYTE OneToOne 1 100 0.00 255.0 FORMAT "%5.1" ECU_ADDRESS 0x7F897C /end MEASUREMENT
/begin MEASUREMENT OvRMon_stOvR "Freigabestatus der Schubüberwachung zur Übertragung vom Master zum Slave" UBYTE OneToOne 1 100 0.00 255.0 FORMAT "%5.1" ECU_ADDRESS 0x7F897D /end MEASUREMENT
/begin MEASUREMENT OvRMon_stRls_mp "Status aller Freigabe Bits für die Schubüberwachung" UWORD OneToOne 1 100 0.00 65535.00 FORMAT "%8.2" ECU_ADDRESS 0x8FFA12 /end MEASUREMENT
/begin MEASUREMENT OvRMon_stT15DebVal_mp "Entprelltes Klemme 15 Signal der Schubüberwachung" UBYTE OneToOne 1 100 0.00 255.0 FORMAT "%5.1" ECU_ADDRESS 0x8FFA14 /end MEASUREMENT
/begin MEASUREMENT OvRMon_stTODSC_mp "Zeitbegrenzungszustand der Hardware für die DSC Momentenanforderung" UBYTE OneToOne 1 100 0.00 255.0 FORMAT "%5.1" ECU_ADDRESS 0x8FFA32 /end MEASUREMENT
/begin MEASUREMENT OvRMon_stTOEGS_mp "Zeitbegrenzungszustand der Hardware für die EGS Momentenanforderung" UBYTE OneToOne 1 100 0.00 255.0 FORMAT "%5.1" ECU_ADDRESS 0x8FFA37 /end MEASUREMENT
/begin MEASUREMENT OvRMon_stTOSSG_mp "Zeitbegrenzungszustand der Hardware für die SSG Momentenanforderung; Getriebe" UBYTE OneToOne 1 100 0.00 255.0 FORMAT "%5.1" ECU_ADDRESS 0x8FFA3C /end MEASUREMENT
/begin MEASUREMENT OvRMon_stTrqDesDSC "Zustand der gewünschten Momentenanforderung der DSC" UBYTE OneToOne 1 100 0.00 255.0 FORMAT "%5.1" ECU_ADDRESS 0x7F9D16 /end MEASUREMENT
/begin MEASUREMENT OvRMon_stTrqDesEGS "Zustand der gewünschten Momentenanforderung der EGS" UBYTE OneToOne 1 100 0.00 255.0 FORMAT "%5.1" ECU_ADDRESS 0x7F9D1A /end MEASUREMENT
/begin MEASUREMENT OvRMon_stTrqDesSSG "Zustand der gewünschten Momentenanforderung der SSG; Getriebe" UBYTE OneToOne 1 100 0.00 255.0 FORMAT "%5.1" ECU_ADDRESS 0x7F9D1E /end MEASUREMENT
/begin MEASUREMENT OvRMon_stTSCInc_mp "Status erhöhender Eingriff Getriebesteuerung in der Schubüberwachung" UBYTE OneToOne 1 100 0.00 255.0 FORMAT "%5.1" ECU_ADDRESS 0x8FFA15 /end MEASUREMENT
/begin MEASUREMENT OvRMon_tiInjAct_mp "Ansteuerdauer der zuletzt bearbeiteten Einspritzung" UWORD InjTime_us 1 100 0.00 65535.00 FORMAT "%8.2" ECU_ADDRESS 0x8FFA2C /end MEASUREMENT
/begin MEASUREMENT OvRMon_tiIntrSysAct "Systemzeit vom aktuellen Main-Interrupt" ULONG OneToOne 1 100 0.00 4294967295.00 FORMAT "%13.2" ECU_ADDRESS 0x7FCC50 /end MEASUREMENT
/begin MEASUREMENT OvRMon_tiIntrSysLst "Systemzeit vom vorhergehenden Main-Interrupt" ULONG OneToOne 1 100 0.00 4294967295.00 FORMAT "%13.2" ECU_ADDRESS 0x7FCC54 /end MEASUREMENT
/begin MEASUREMENT OvRMon_tiLimET_mp "Obergrenze der Ansteuerdauer der Schubüberwachung" SWORD InjTime_us 1 100 -32768.00 32767.00 FORMAT "%8.2" ECU_ADDRESS 0x8FFA16 /end MEASUREMENT
/begin MEASUREMENT OvRMon_tiOvRMonActive_mp "Zeit nach Aktivierung der Schubüberwachung" SWORD Time_ms 1 100 -327680.0 327670.0 FORMAT "%8.1" ECU_ADDRESS 0x6F823E /end MEASUREMENT
/begin MEASUREMENT OvRMon_tiTDCAvrg "Mittlere momentwirksame Ansteuerdauer pro Zylinder in der Schubüberwachung" UWORD InjTime_us 1 100 0.00 65535.00 FORMAT "%8.2" ECU_ADDRESS 0x7FCC5C /end MEASUREMENT
/begin MEASUREMENT OvRMon_tiTDCSumET_mp "Summe der momentwirksamen Ansteuerdauern eines Zylinders" UWORD InjTime_us 1 100 0.00 65535.00 FORMAT "%8.2" ARRAY_SIZE 6 ECU_ADDRESS 0x8FFA1E /end MEASUREMENT
/begin MEASUREMENT OvRMon_uRawAPP1_mp "APP1 - Fahrpedalrohwert über OvRMon eingelesen" SWORD Volt 1 100 -160156.4 160151.5 FORMAT "%8.1" ECU_ADDRESS 0x8FFA18 /end MEASUREMENT
/begin MEASUREMENT OvRMon_uRegAPP1_mp "ADC-Registerwert der Position von Fahrpedal 1" SWORD Volt 1 100 -160156.4 160151.5 FORMAT "%8.1" ECU_ADDRESS 0x8FFA08 /end MEASUREMENT
/begin MEASUREMENT OvRMon_uRegAPP2_mp "ADC-Registerwert der Position von Fahrpedal 2" SWORD Volt 1 100 -160156.4 160151.5 FORMAT "%8.1" ECU_ADDRESS 0x8FFA0A /end MEASUREMENT
/begin MEASUREMENT OxiCCD_tLinPre "linearisierter Wert Abgastemperatur vor Oxidationskatalysator" SWORD Temp_Cels 1 100 -50.140 899.860 FORMAT "%8.3" ECU_ADDRESS 0x7F8FE2 /end MEASUREMENT
/begin MEASUREMENT OxiCCD_tPre "Abgastemperatur vor Oxidationskatalysator" SWORD Temp_Cels 1 100 -50.140 899.860 FORMAT "%8.3" ECU_ADDRESS 0x7F8FE4 /end MEASUREMENT
/begin MEASUREMENT OxiCCD_uRawTempPre "Abgastemperatur vor Oxidationskatalysator Rohwert" SWORD Volt 1 100 0.00 5000.000 FORMAT "%8.3" ECU_ADDRESS 0x7F8FE6 /end MEASUREMENT
/begin MEASUREMENT PCBS_dAvaiDiag_mp "measure point for availability for reset CBS message with diagnose" UBYTE OneToOne 1 100 0.00 255.0 FORMAT "%5.1" ECU_ADDRESS 0x8FFA3D /end MEASUREMENT
/begin MEASUREMENT PCBS_dAvaiDMEChg_mp "measure point for availability after DME change" UBYTE OneToOne 1 100 0.00 255.0 FORMAT "%5.1" ECU_ADDRESS 0x8FFA3E /end MEASUREMENT
/begin MEASUREMENT PCBS_dAvaiOut "availability (CAN: AVAI_BOS_MESS)" UBYTE OneToOne 1 100 0.00 255.0 FORMAT "%5.1" ECU_ADDRESS 0x7F897F /end MEASUREMENT
/begin MEASUREMENT PCBS_lDistanceOut "Available rest distance" SWORD km_sw_q10 1 100 -327680.0 327670.0 FORMAT "%8.1" ECU_ADDRESS 0x7F8FE8 /end MEASUREMENT
/begin MEASUREMENT PCBS_lMaxDistance_mp "maximum of the curve PCBS_lCalcDistance_CUR" SWORD km_sw_q10 1 100 -327680.0 327670.0 FORMAT "%8.1" ECU_ADDRESS 0x8FFA40 /end MEASUREMENT
/begin MEASUREMENT PCBS_qFlTotDMEChg "" SLONG Fl_L 1 100 -21474836.4800 21474836.4700 FORMAT "%13.4" ECU_ADDRESS 0x7F9264 /end MEASUREMENT
/begin MEASUREMENT PCBS_stCBSMsg "state for CBS message" UBYTE OneToOne 1 100 0.00 255.0 FORMAT "%5.1" ECU_ADDRESS 0x7F8980 /end MEASUREMENT
/begin MEASUREMENT PCBS_stCntChgCAN_mp "measure point for service value after CBS reset by CAN" UBYTE OneToOne 1 100 0.00 255.0 FORMAT "%5.1" ECU_ADDRESS 0x8FFA42 /end MEASUREMENT
/begin MEASUREMENT PCBS_stCntChgDIAG_mp "measure point for service value after CBS reset by diagnose" UBYTE OneToOne 1 100 0.00 255.0 FORMAT "%5.1" ECU_ADDRESS 0x8FFA43 /end MEASUREMENT
/begin MEASUREMENT PCBS_stCntChg_mp "measure point for service value after CBS reset" UBYTE OneToOne 1 100 0.00 255.0 FORMAT "%5.1" ECU_ADDRESS 0x8FFA44 /end MEASUREMENT
/begin MEASUREMENT PCBS_stCntDiag_mp "measure point service counter for reset CBS message with diagnose" UBYTE OneToOne 1 100 0.00 255.0 FORMAT "%5.1" ECU_ADDRESS 0x8FFA45 /end MEASUREMENT
/begin MEASUREMENT PCBS_stCntValOut "service counter value" UBYTE OneToOne 1 100 0.00 255.0 FORMAT "%5.1" ECU_ADDRESS 0x7F8981 /end MEASUREMENT
/begin MEASUREMENT PCBS_stCntVal_mp "measure point for service counter value after CBS reset" UBYTE OneToOne 1 100 0.00 255.0 FORMAT "%5.1" ECU_ADDRESS 0x8FFA46 /end MEASUREMENT
/begin MEASUREMENT PCBS_stDMEChg "" UBYTE OneToOne 1 100 0.00 255.0 FORMAT "%5.1" ECU_ADDRESS 0x7F8982 /end MEASUREMENT
/begin MEASUREMENT PCBS_stDMEChgOld "" UBYTE OneToOne 1 100 0.00 255.0 FORMAT "%5.1" ECU_ADDRESS 0x7F8983 /end MEASUREMENT
/begin MEASUREMENT PCBS_stDMEIni_mp "measure point for CBS function init" UBYTE OneToOne 1 100 0.00 255.0 FORMAT "%5.1" ECU_ADDRESS 0x8FFA47 /end MEASUREMENT
/begin MEASUREMENT PCBS_stIDMsg "ID for CBS message" UWORD OneToOne 1 100 0.00 65535.00 FORMAT "%8.2" ECU_ADDRESS 0x7F8FEA /end MEASUREMENT
/begin MEASUREMENT PCBS_stPFltChg "" UBYTE OneToOne 1 100 0.00 255.0 FORMAT "%5.1" ECU_ADDRESS 0x7F8984 /end MEASUREMENT
/begin MEASUREMENT PCBS_stPFltChgCAN_mp "measure point which shows if particulate filter were changed by CAN" UBYTE OneToOne 1 100 0.00 255.0 FORMAT "%5.1" ECU_ADDRESS 0x8FFA48 /end MEASUREMENT
/begin MEASUREMENT PCBS_stPFltChgDIAG_mp "measure point which shows if particulate filter were changed by diagnose" UBYTE OneToOne 1 100 0.00 255.0 FORMAT "%5.1" ECU_ADDRESS 0x8FFA49 /end MEASUREMENT
/begin MEASUREMENT PCBS_stResetDiag_mp "measure point for reset CBS message for PFlt with diagnose" UBYTE OneToOne 1 100 0.00 255.0 FORMAT "%5.1" ECU_ADDRESS 0x8FFA4A /end MEASUREMENT
/begin MEASUREMENT PCBS_stUnit "unit of mearurement for CBS" UBYTE OneToOne 1 100 0.00 255.0 FORMAT "%5.1" ECU_ADDRESS 0x7F8985 /end MEASUREMENT
/begin MEASUREMENT PCR_bpMap_mp "Calculation of the correction factor based on atmospheric factor" UBYTE OneToOne 1 100 0.00 255.0 FORMAT "%5.1" ECU_ADDRESS 0x8FFA7B /end MEASUREMENT
/begin MEASUREMENT PCR_DKd_mp "Kleinsignalverstärkung des Regler-DT1-Anteils" SLONG Kd_Pres2Prc 1 100 -400.000000000 399.999999814 FORMAT "%12.9" ECU_ADDRESS 0x8FFABC /end MEASUREMENT
/begin MEASUREMENT PCR_dnAvrg "Drehzahlgradient Basis für Korrekturfaktor D-Verstärkung" SWORD dn_dZ20 1 100 -327680.0 327670.0 FORMAT "%8.1" ECU_ADDRESS 0x7F8FEC /end MEASUREMENT
/begin MEASUREMENT PCR_dnAvrgNeg_mp "Rate of change of engine speed in negative direction" SWORD dn_dZ20 1 100 -327680.0 327670.0 FORMAT "%8.1" ECU_ADDRESS 0x8FFA68 /end MEASUREMENT
/begin MEASUREMENT PCR_dnSurgeHigh_mp "Higher limit for hysteresis to monitor rate of change of Eng_nAvrg for Anti-Surge LIGov" SWORD dn_dZ20 1 100 -327680.0 327670.0 FORMAT "%8.1" ECU_ADDRESS 0x8FFA6A /end MEASUREMENT
/begin MEASUREMENT PCR_dnSurgeLow_mp "Lower limit for hysteresis to monitor rate of change of Eng_nAvrg for Anti-Surge LIGov" SWORD dn_dZ20 1 100 -327680.0 327670.0 FORMAT "%8.1" ECU_ADDRESS 0x8FFA6C /end MEASUREMENT
/begin MEASUREMENT PCR_dn_mp "value of engine speed gradient" SWORD dn_dZ20 1 100 -327680.0 327670.0 FORMAT "%8.1" ECU_ADDRESS 0x8FFAC0 /end MEASUREMENT
/begin MEASUREMENT PCR_dpBDesRaw_mp "Derivative of unlimited desired boost pressure with preconttrol" SWORD dp_dZ20 1 100 -327680.0 327670.0 FORMAT "%8.1" ECU_ADDRESS 0x8FFA7C /end MEASUREMENT
/begin MEASUREMENT PCR_dpBGDev_mp "Ladedruckgradient" SWORD dp_dZ20 1 100 -327680.0 327670.0 FORMAT "%8.1" ECU_ADDRESS 0x8FFAC2 /end MEASUREMENT
/begin MEASUREMENT PCR_dqCtlA "Ableitung der Kraftstoffmasse" SWORD InjMassPerSec_20ms 1 100 -16384.00 16383.50 FORMAT "%8.2" ECU_ADDRESS 0x7F8FEE /end MEASUREMENT
/begin MEASUREMENT PCR_dqDes_mp "Einspritzmengen-Änderung" SWORD InjMassPerSec_20ms 1 100 -16384.00 16383.50 FORMAT "%8.2" ECU_ADDRESS 0x8FFA7E /end MEASUREMENT
/begin MEASUREMENT PCR_drAPP1UnFlt_mp "Measuring point for ratio of Accelerator pedal 1 position - Unfiltered value" SWORD PrcPerSec 1 100 -20000.00 19999.39 FORMAT "%8.2" ECU_ADDRESS 0x8FFA80 /end MEASUREMENT
/begin MEASUREMENT PCR_facAdPCVc1_mp "Faktor c1 zur Bestimmung des VorSteuerkennfeldes der Ladedruckregelung" SWORD Fact 1 100 -4.000000 3.999878 FORMAT "%8.6" ECU_ADDRESS 0x8FFAC4 /end MEASUREMENT
/begin MEASUREMENT PCR_facAdPCVc2_mp "Faktor c2 zur Bestimmung des VorSteuerkennfeldes der Ladedruckregelung" SWORD Fact 1 100 -4.000000 3.999878 FORMAT "%8.6" ECU_ADDRESS 0x8FFAC6 /end MEASUREMENT
/begin MEASUREMENT PCR_facAdPCVc3_mp "Faktor c3 zur Bestimmung des VorSteuerkennfeldes der Ladedruckregelung" SWORD Fact 1 100 -4.000000 3.999878 FORMAT "%8.6" ECU_ADDRESS 0x8FFAC8 /end MEASUREMENT
/begin MEASUREMENT PCR_facAdPCVc4_mp "Faktor c4 zur Bestimmung des VorSteuerkennfeldes der Ladedruckregelung" SWORD Fact 1 100 -4.000000 3.999878 FORMAT "%8.6" ECU_ADDRESS 0x8FFACA /end MEASUREMENT
/begin MEASUREMENT PCR_facAdPCVrx_mp "Faktor rx zur Bestimmung des VorSteuerkennfeldes der Ladedruckregelung" SWORD Fact 1 100 -4.000000 3.999878 FORMAT "%8.6" ECU_ADDRESS 0x8FFACC /end MEASUREMENT
/begin MEASUREMENT PCR_facAdPCVry_mp "Faktor ry zur Bestimmung des VorSteuerkennfeldes der Ladedruckregelung" SWORD Fact 1 100 -4.000000 3.999878 FORMAT "%8.6" ECU_ADDRESS 0x8FFACE /end MEASUREMENT
/begin MEASUREMENT PCR_facATRgn_mp "lufttemperaturabhängigerKorrekturfactor bei Regenerationsbetrieb" SWORD Fact 1 100 -4.000000 3.999878 FORMAT "%8.6" ECU_ADDRESS 0x8FFA82 /end MEASUREMENT
/begin MEASUREMENT PCR_facAT_mp "Lufttemperaturabhängiger Faktor für Sollwertberechnung" SWORD Fact 1 100 -4.000000 3.999878 FORMAT "%8.6" ECU_ADDRESS 0x8FFA84 /end MEASUREMENT
/begin MEASUREMENT PCR_facCtQ_mp "Kühltemperaturabhängiger Faktor für Sollwertberechnung" SWORD Fact 1 100 -4.000000 3.999878 FORMAT "%8.6" ECU_ADDRESS 0x8FFA86 /end MEASUREMENT
/begin MEASUREMENT PCR_facD1_mp "Adaptionsfaktor für Regler-D-Verstärkung" SWORD Fact1 1 100 -256.0000 255.9922 FORMAT "%8.4" ECU_ADDRESS 0x8FFAD0 /end MEASUREMENT
/begin MEASUREMENT PCR_facDnCorr_mp "corrective factor based on engine speed gradient" SWORD Fact1 1 100 -256.0000 255.9922 FORMAT "%8.4" ECU_ADDRESS 0x8FFAD2 /end MEASUREMENT
/begin MEASUREMENT PCR_facDpCorr_mp "Korrekturfaktor für D-Parameter Korrektur aus dem Ladedruckgradienten" SWORD Fact1 1 100 -256.0000 255.9922 FORMAT "%8.4" ECU_ADDRESS 0x8FFAD4 /end MEASUREMENT
/begin MEASUREMENT PCR_facD_mp "Adaptionsfaktor für Regler-D-Verstärkung" SWORD Fact1 1 100 -256.0000 255.9922 FORMAT "%8.4" ECU_ADDRESS 0x8FFAD6 /end MEASUREMENT
/begin MEASUREMENT PCR_facI_mp "Adaptionsfaktor für Regler-I-Verstärkung" SWORD Fact1 1 100 -256.0000 255.9922 FORMAT "%8.4" ECU_ADDRESS 0x8FFAD8 /end MEASUREMENT
/begin MEASUREMENT PCR_facmSotCorr_mp "Adaption factor for D-Govrnr. Parameter" SWORD Fact1 1 100 -256.0000 255.9922 FORMAT "%8.4" ECU_ADDRESS 0x8FFADA /end MEASUREMENT
/begin MEASUREMENT PCR_facN_mp "Faktor für Berücksichtigung der Drehzahl DesValCalc" SWORD Fact 1 100 -4.000000 3.999878 FORMAT "%8.6" ECU_ADDRESS 0x8FFA88 /end MEASUREMENT
/begin MEASUREMENT PCR_facP_mp "Adaptionsfaktor für Regler-P-Verstärkung" SWORD Fact1 1 100 -256.0000 255.9922 FORMAT "%8.4" ECU_ADDRESS 0x8FFADC /end MEASUREMENT
/begin MEASUREMENT PCR_nSetPointSurge "Set Point for Anti-Surge LIGov" SWORD EngN 1 100 -32768.00 32767.00 FORMAT "%8.2" ECU_ADDRESS 0x7F8FF2 /end MEASUREMENT
/begin MEASUREMENT PCR_pAPQCmpnRgn_mp "atmosphärendruckabhängigen Korrekturwert bei Regenerationsbetrieb" SWORD Pres 1 100 -32768.00 32767.00 FORMAT "%9.2" ECU_ADDRESS 0x8FFA8A /end MEASUREMENT
/begin MEASUREMENT PCR_pAPQCmpn_mp "luftdruckabhängige Kompensation für Sollwertbildung" SWORD Pres 1 100 -32768.00 32767.00 FORMAT "%9.2" ECU_ADDRESS 0x8FFA8C /end MEASUREMENT
/begin MEASUREMENT PCR_pBasMAP_mp "stationärer Ladedrucksollwert aus Basiskennfeld" SWORD Pres 1 100 -32768.00 32767.00 FORMAT "%9.2" ECU_ADDRESS 0x8FFA8E /end MEASUREMENT
/begin MEASUREMENT PCR_pBDesAPCorrRgn1_mp "in Abhängigkeit des atmosphärendruck korrigierter Sollwert aus erstem Regenerationskennfeld" SWORD Pres 1 100 -32768.00 32767.00 FORMAT "%9.2" ECU_ADDRESS 0x8FFA90 /end MEASUREMENT
/begin MEASUREMENT PCR_pBDesAPCorrRgn2_mp "in Abhängigkeit des atmosphärendrucks korrigierter Sollwert aus zweitem Regenerationskennfeld" SWORD Pres 1 100 -32768.00 32767.00 FORMAT "%9.2" ECU_ADDRESS 0x8FFA92 /end MEASUREMENT
/begin MEASUREMENT PCR_pBDesAPCorr_mp "Luftdruckabhängige Korrektur des Ladedrucksollwerts" SWORD Pres 1 100 -32768.00 32767.00 FORMAT "%9.2" ECU_ADDRESS 0x8FFA94 /end MEASUREMENT
/begin MEASUREMENT PCR_pBDesATCorrRgn1_mp "korrigierter Ladedrucksollwert aus Regenerationskennfeld 1" SWORD Pres 1 100 -32768.00 32767.00 FORMAT "%9.2" ECU_ADDRESS 0x8FFA96 /end MEASUREMENT
/begin MEASUREMENT PCR_pBDesATCorrRgn2_mp "korriegerter Ladedrucksollwert aus zweitem Regenerationskennfeld 2" SWORD Pres 1 100 -32768.00 32767.00 FORMAT "%9.2" ECU_ADDRESS 0x8FFA98 /end MEASUREMENT
/begin MEASUREMENT PCR_pBDesATCorr_mp "Bezüglich Lufttemperatur korrigierter Ladedrucksollwert" SWORD Pres 1 100 -32768.00 32767.00 FORMAT "%9.2" ECU_ADDRESS 0x8FFA9A /end MEASUREMENT
/begin MEASUREMENT PCR_pBDesCtCorr_mp "Kühltemperaturkorrigierter Wert des Ladedrucksollwerts" SWORD Pres 1 100 -32768.00 32767.00 FORMAT "%9.2" ECU_ADDRESS 0x8FFA9C /end MEASUREMENT
/begin MEASUREMENT PCR_pBDesDyn_mp "Dynamischer Teil des Ladedrucksollwerts" SWORD Pres_hPa 1 100 -32768.00 32767.00 FORMAT "%8.2" ECU_ADDRESS 0x8FFA9E /end MEASUREMENT
/begin MEASUREMENT PCR_pBDesFlt_mp "Output value from PT1 Filter" SWORD Pres_hPa 1 100 -32768.00 32767.00 FORMAT "%8.2" ECU_ADDRESS 0x8FFADE /end MEASUREMENT
/begin MEASUREMENT PCR_pBDesLPUnLim_mp "" SWORD Pres_hPa 1 100 -32768.00 32767.00 FORMAT "%8.2" ECU_ADDRESS 0x8FFB1E /end MEASUREMENT
/begin MEASUREMENT PCR_pBDesLP_mp "Gewuenschter Ladedrucksollwert" SWORD Pres_hPa 1 100 -32768.00 32767.00 FORMAT "%8.2" ECU_ADDRESS 0x8FFB20 /end MEASUREMENT
/begin MEASUREMENT PCR_pBDesMaxAP_mp "Größter erlaubter Ladedrucksollwert in Abhängigkeit vom Luftdruck" SWORD Pres 1 100 -32768.00 32767.00 FORMAT "%9.2" ECU_ADDRESS 0x8FFAA0 /end MEASUREMENT
/begin MEASUREMENT PCR_pBDesNCorr_mp "Boost press. value corr. by eng. spd. fac." SWORD Pres 1 100 -32768.00 32767.00 FORMAT "%9.2" ECU_ADDRESS 0x8FFAA2 /end MEASUREMENT
/begin MEASUREMENT PCR_pBDesRaw2_mp "Unlimited desired boost pressure with rampcontrol." SWORD Pres_hPa 1 100 -32768.00 32767.00 FORMAT "%8.2" ECU_ADDRESS 0x8FFAA4 /end MEASUREMENT
/begin MEASUREMENT PCR_pBDesRaw3_mp "Unbegrentzer Laderdrucksollwert mit Vorsterung und Anti Surge Regler" SWORD Pres_hPa 1 100 -32768.00 32767.00 FORMAT "%8.2" ECU_ADDRESS 0x8FFAA6 /end MEASUREMENT
/begin MEASUREMENT PCR_pBDesRaw_mp "Unbegrenzter Ladedrucksollwert mit Vorsteuerung" SWORD Pres_hPa 1 100 -32768.00 32767.00 FORMAT "%8.2" ECU_ADDRESS 0x8FFAA8 /end MEASUREMENT
/begin MEASUREMENT PCR_pBDesStat_mp "Stationärer Teil des Ladedrucksollwerts" SWORD Pres 1 100 -32768.00 32767.00 FORMAT "%9.2" ECU_ADDRESS 0x8FFAAA /end MEASUREMENT
/begin MEASUREMENT PCR_pBDes_mp "gewälter unbegrenzerter Ladedrucksollwert" SWORD Pres 1 100 -32768.00 32767.00 FORMAT "%9.2" ECU_ADDRESS 0x8FFAAC /end MEASUREMENT
/begin MEASUREMENT PCR_pBGDev "Regelabweichung" SWORD Pres_hPa 1 100 -32768.00 32767.00 FORMAT "%8.2" ECU_ADDRESS 0x7F8FF4 /end MEASUREMENT
/begin MEASUREMENT PCR_pBGDev2_mp "Deviation I/P for Integrator" SWORD Pres_hPa 1 100 -32768.00 32767.00 FORMAT "%8.2" ECU_ADDRESS 0x8FFAE0 /end MEASUREMENT
/begin MEASUREMENT PCR_pBGDevI_mp "Regelabweichung für I-Anteil" SWORD Pres_hPa 1 100 -32768.00 32767.00 FORMAT "%8.2" ECU_ADDRESS 0x8FFAE2 /end MEASUREMENT
/begin MEASUREMENT PCR_pBGDvtLP "Regelabweichung" SWORD Pres_hPa 1 100 -32768.00 32767.00 FORMAT "%8.2" ECU_ADDRESS 0x7F8FF6 /end MEASUREMENT
/begin MEASUREMENT PCR_pDesByp_mp "Bypass-Label, Kopie von PCR_pBDes" SWORD Pres_hPa 1 100 -32768.00 32767.00 FORMAT "%8.2" ECU_ADDRESS 0x8FFAAE /end MEASUREMENT
/begin MEASUREMENT PCR_pDesVal "Ladedrucksollwert" SWORD Pres_hPa 1 100 -32768.00 32767.00 FORMAT "%8.2" ECU_ADDRESS 0x7F8FFA /end MEASUREMENT
/begin MEASUREMENT PCR_pNQCtCmpn_mp "Korrekturwert für Kühlwassertemperaturkorrektur für Sollwertberechnung" SWORD Pres 1 100 -32768.00 32767.00 FORMAT "%9.2" ECU_ADDRESS 0x8FFAB0 /end MEASUREMENT
/begin MEASUREMENT PCR_pRgnMAP1_mp "stationärer Ladedrucksollwert aus erstem Regenerationskennfeld" SWORD Pres 1 100 -32768.00 32767.00 FORMAT "%9.2" ECU_ADDRESS 0x8FFAB2 /end MEASUREMENT
/begin MEASUREMENT PCR_pRgnMAP2_mp "stationärer Ladedrucksollwert aus zweitem Regenerationskennfeld" SWORD Pres 1 100 -32768.00 32767.00 FORMAT "%9.2" ECU_ADDRESS 0x8FFAB4 /end MEASUREMENT
/begin MEASUREMENT PCR_qCtlFrmMngTrqInr_mp "Controlled quantity based on FrmMng_trqInr and FMTC_etaCurr" SWORD InjMass 1 100 -327.6800 327.6700 FORMAT "%8.4" ECU_ADDRESS 0x8FFA4C /end MEASUREMENT
/begin MEASUREMENT PCR_qCtl_mp "für die Ladedruck Steuerung begrenzte Einspritzmenge" SWORD InjMassCyc 1 100 -327.6800 327.6700 FORMAT "%8.4" ECU_ADDRESS 0x8FFA4E /end MEASUREMENT
/begin MEASUREMENT PCR_qDes "Einspritzmenge für Sollwertbildung" SWORD InjMass 1 100 -327.6800 327.6700 FORMAT "%8.4" ECU_ADDRESS 0x7F8FFC /end MEASUREMENT
/begin MEASUREMENT PCR_qDesFrmMngTrqInr_mp "Desired quantity based on FrmMng_trqInr and FMTC_etaCurr" SWORD InjMassCyc 1 100 -327.6800 327.6700 FORMAT "%8.4" ECU_ADDRESS 0x8FFAB6 /end MEASUREMENT
/begin MEASUREMENT PCR_qReal "Injection quantity after switching" SWORD InjMassCyc 1 100 -327.6800 327.6700 FORMAT "%8.4" ECU_ADDRESS 0x7F8FFE /end MEASUREMENT
/begin MEASUREMENT PCR_qSurgeHigh_mp "Higher quantity limit for hysteresis of Anti-Surge LIGov" SWORD InjMass 1 100 -327.6800 327.6700 FORMAT "%8.4" ECU_ADDRESS 0x8FFA6E /end MEASUREMENT
/begin MEASUREMENT PCR_qSurgeLow_mp "Lower quantity limit for hysteresis of Anti-Surge LIGov" SWORD InjMass 1 100 -327.6800 327.6700 FORMAT "%8.4" ECU_ADDRESS 0x8FFA70 /end MEASUREMENT
/begin MEASUREMENT PCR_rAdPCVCtlValLim_mp "Beschraenkter Adaption des VorSteuerkennfeldes der Ladedruckregelung" SWORD Prc 1 100 -400.0000 399.9878 FORMAT "%8.4" ECU_ADDRESS 0x8FFAE4 /end MEASUREMENT
/begin MEASUREMENT PCR_rAdPCVCtlVal_mp "Adaption des VorSteuerkennfeldes der Ladedruckregelung" SWORD Prc 1 100 -400.0000 399.9878 FORMAT "%8.4" ECU_ADDRESS 0x8FFAE6 /end MEASUREMENT
/begin MEASUREMENT PCR_rAdPCVI1_mp "Eingang in den I1-Regler nach Multiplizieren mit C1" SWORD Prc 1 100 -400.0000 399.9878 FORMAT "%8.4" ECU_ADDRESS 0x8FFAE8 /end MEASUREMENT
/begin MEASUREMENT PCR_rAdPCVI2_mp "Eingang in den I2-Regler nach Multiplizieren mit C2" SWORD Prc 1 100 -400.0000 399.9878 FORMAT "%8.4" ECU_ADDRESS 0x8FFAEA /end MEASUREMENT
/begin MEASUREMENT PCR_rAdPCVI3_mp "Eingang in den I3-Regler nach Multiplizieren mit C3" SWORD Prc 1 100 -400.0000 399.9878 FORMAT "%8.4" ECU_ADDRESS 0x8FFAEC /end MEASUREMENT
/begin MEASUREMENT PCR_rAdPCVI4_mp "Eingang in den I4-Regler nach Multiplizieren mit C4" SWORD Prc 1 100 -400.0000 399.9878 FORMAT "%8.4" ECU_ADDRESS 0x8FFAEE /end MEASUREMENT
/begin MEASUREMENT PCR_rBalGvnrDiff "Tastverhältnis Gleichstellungsregler" SWORD Prc 1 100 -400.0000 399.9878 FORMAT "%8.4" ECU_ADDRESS 0x7F900E /end MEASUREMENT
/begin MEASUREMENT PCR_rBPBasLP_mp "" SWORD Prc 1 100 -400.0000 399.9878 FORMAT "%8.4" ECU_ADDRESS 0x8FFB22 /end MEASUREMENT
/begin MEASUREMENT PCR_rBPCtlAPCorrRgn_mp "in Abhängigkeit des Atmosphärendruckskorrigierter Steuerwert bei Regenerationsbetrieb" SWORD Prc 1 100 -400.0000 399.9878 FORMAT "%8.4" ECU_ADDRESS 0x8FFA50 /end MEASUREMENT
/begin MEASUREMENT PCR_rBPCtlAPCorr_mp "in Abhängigkeit des Atmosphärendrucks korrigierter Steuerwert" SWORD Prc 1 100 -400.0000 399.9878 FORMAT "%8.4" ECU_ADDRESS 0x8FFA52 /end MEASUREMENT
/begin MEASUREMENT PCR_rBPCtlATCorrRgn_mp "Lufttemperaturabhängige Korrektur im Regenerationsbetrieb" SWORD Prc 1 100 -400.0000 399.9878 FORMAT "%8.4" ECU_ADDRESS 0x8FFA54 /end MEASUREMENT
/begin MEASUREMENT PCR_rBPCtlATCorr_mp "Lufttemperaturabhängige Korrektur" SWORD Prc 1 100 -400.0000 399.9878 FORMAT "%8.4" ECU_ADDRESS 0x8FFA56 /end MEASUREMENT
/begin MEASUREMENT PCR_rBPCtlBasCorr_mp "Corrected value in normal operation" SWORD Prc 1 100 -400.0000 399.9878 FORMAT "%8.4" ECU_ADDRESS 0x8FFA58 /end MEASUREMENT
/begin MEASUREMENT PCR_rBPCtlBasRgn1Corr_mp "Corrected value for particle filter soot mass" SWORD Prc 1 100 -400.0000 399.9878 FORMAT "%8.4" ECU_ADDRESS 0x8FFA5A /end MEASUREMENT
/begin MEASUREMENT PCR_rBPCtlBasRgn1_mp "Basisregenerationswert 1" SWORD Prc 1 100 -400.0000 399.9878 FORMAT "%8.4" ECU_ADDRESS 0x8FFA5C /end MEASUREMENT
/begin MEASUREMENT PCR_rBPCtlBasRgn2_mp "Basisregenerationswert 2" SWORD Prc 1 100 -400.0000 399.9878 FORMAT "%8.4" ECU_ADDRESS 0x8FFA5E /end MEASUREMENT
/begin MEASUREMENT PCR_rBPCtlBas_mp "Basissteuerwert für Ladedruck" SWORD Prc 1 100 -400.0000 399.9878 FORMAT "%8.4" ECU_ADDRESS 0x8FFA60 /end MEASUREMENT
/begin MEASUREMENT PCR_rBPGovMax "Maximal zulässige Reglerstellgröße" SWORD Prc 1 100 -400.0000 399.9878 FORMAT "%8.4" ECU_ADDRESS 0x7F9008 /end MEASUREMENT
/begin MEASUREMENT PCR_rBPGovMaxDynRamp_mp "Ramp correction to Maximum allowable PCR governer output" SWORD Prc 1 100 -400.0000 399.9878 FORMAT "%8.4" ECU_ADDRESS 0x6F8240 /end MEASUREMENT
/begin MEASUREMENT PCR_rBPGovMaxDyn_mp "Maximum allowable PCR governer output before ramp correction" SWORD Prc 1 100 -400.0000 399.9878 FORMAT "%8.4" ECU_ADDRESS 0x6F8242 /end MEASUREMENT
/begin MEASUREMENT PCR_rBPGovMaxVal1_mp "Maximum allowable PCR governer output without dynamic correction" SWORD Prc 1 100 -400.0000 399.9878 FORMAT "%8.4" ECU_ADDRESS 0x6F8244 /end MEASUREMENT
/begin MEASUREMENT PCR_rBPGovMaxVal2_mp "Maximum allowable PCR governer output with dynamic correction" SWORD Prc 1 100 -400.0000 399.9878 FORMAT "%8.4" ECU_ADDRESS 0x6F8246 /end MEASUREMENT
/begin MEASUREMENT PCR_rBPGovMax_mp "Maximal zulässige Reglerstellgröße" SWORD Prc 1 100 -400.0000 399.9878 FORMAT "%8.4" ECU_ADDRESS 0x6F8248 /end MEASUREMENT
/begin MEASUREMENT PCR_rBPGovMin "Minimal zulässige Reglerstellgröße" SWORD Prc 1 100 -400.0000 399.9878 FORMAT "%8.4" ECU_ADDRESS 0x7F900A /end MEASUREMENT
/begin MEASUREMENT PCR_rBPGovMin_mp "Minimal zulässige Reglerstellgröße" SWORD Prc 1 100 -400.0000 399.9878 FORMAT "%8.4" ECU_ADDRESS 0x6F824A /end MEASUREMENT
/begin MEASUREMENT PCR_rBPGvnrUnLim1_mp "Ladedrucksteller- Tastverhältnis 1 (unbegrenzt)" SWORD Prc 1 100 -400.0000 399.9878 FORMAT "%8.4" ECU_ADDRESS 0x8FFAF0 /end MEASUREMENT
/begin MEASUREMENT PCR_rBPGvnrUnLim2_mp "Ladedrucksteller- Tastverhältnis 2 (unbegrenzt)" SWORD Prc 1 100 -400.0000 399.9878 FORMAT "%8.4" ECU_ADDRESS 0x8FFAF2 /end MEASUREMENT
/begin MEASUREMENT PCR_rBPLim "limited boost pressure actuator value" SWORD Prc 1 100 -400.0000 399.9878 FORMAT "%8.4" ECU_ADDRESS 0x7F900C /end MEASUREMENT
/begin MEASUREMENT PCR_rBPLim_mp "limited value of PID output" SWORD Prc 1 100 -400.0000 399.9878 FORMAT "%8.4" ECU_ADDRESS 0x8FFAF4 /end MEASUREMENT
/begin MEASUREMENT PCR_rBPRglBasLP_mp "" SWORD Prc 1 100 -400.0000 399.9878 FORMAT "%8.4" ECU_ADDRESS 0x8FFB24 /end MEASUREMENT
/begin MEASUREMENT PCR_rCtlSurgeBas_mp "boost pressure control value for Anti-Surge LIGov" SWORD Prc 1 100 -400.0000 399.9878 FORMAT "%8.4" ECU_ADDRESS 0x8FFA62 /end MEASUREMENT
/begin MEASUREMENT PCR_rCtlVal "Ladedruck Steueranteil der Stellgrösse" SWORD Prc 1 100 -400.0000 399.9878 FORMAT "%8.4" ECU_ADDRESS 0x7F9010 /end MEASUREMENT
/begin MEASUREMENT PCR_rCtlVal1_mp "Kühlmitteltemperatur behob Wert der gewünschten Erhöhungsdruckregelung" SWORD Prc 1 100 -400.0000 399.9878 FORMAT "%8.4" ECU_ADDRESS 0x8FFA64 /end MEASUREMENT
/begin MEASUREMENT PCR_rCtlVal2_mp "Kühlmitteltemperatur behob Wert der gewünschten Erhöhungsdruckregelung" SWORD Prc 1 100 -400.0000 399.9878 FORMAT "%8.4" ECU_ADDRESS 0x8FFA66 /end MEASUREMENT
/begin MEASUREMENT PCR_rGvnr "Reglerstellgröße für den Ladedruck" SWORD Prc 1 100 -400.0000 399.9878 FORMAT "%8.4" ECU_ADDRESS 0x7F9012 /end MEASUREMENT
/begin MEASUREMENT PCR_rGvnr2 "Ratio 2 of valve lift from governor with PCR Balancing governor" SWORD Prc 1 100 -400.0000 399.9878 FORMAT "%8.4" ECU_ADDRESS 0x7F9014 /end MEASUREMENT
/begin MEASUREMENT PCR_rGvnrLP "Stellgröße des Ladedruckreglers LP - Steller 1" SWORD Prc 1 100 -400.0000 399.9878 FORMAT "%8.4" ECU_ADDRESS 0x7F9016 /end MEASUREMENT
/begin MEASUREMENT PCR_rInitI1AdPCV_mp "Initialisationswerte fuer I1-Regler" SWORD Prc 1 100 -400.0000 399.9878 FORMAT "%8.4" ECU_ADDRESS 0x8FFAF6 /end MEASUREMENT
/begin MEASUREMENT PCR_rInitI2AdPCV_mp "Initialisationswerte fuer I2-Regler" SWORD Prc 1 100 -400.0000 399.9878 FORMAT "%8.4" ECU_ADDRESS 0x8FFAF8 /end MEASUREMENT
/begin MEASUREMENT PCR_rInitI3AdPCV_mp "Initialisationswerte fuer I3-Regler" SWORD Prc 1 100 -400.0000 399.9878 FORMAT "%8.4" ECU_ADDRESS 0x8FFAFA /end MEASUREMENT
/begin MEASUREMENT PCR_rInitI4AdPCV_mp "Initialisationswerte fuer I4-Regler" SWORD Prc 1 100 -400.0000 399.9878 FORMAT "%8.4" ECU_ADDRESS 0x8FFAFC /end MEASUREMENT
/begin MEASUREMENT PCR_rOutAdPCVI1_mp "Ausgang Des I1-Regler" SWORD Prc 1 100 -400.0000 399.9878 FORMAT "%8.4" ECU_ADDRESS 0x8FFAFE /end MEASUREMENT
/begin MEASUREMENT PCR_rOutAdPCVI2_mp "Ausgang Des I2-Regler" SWORD Prc 1 100 -400.0000 399.9878 FORMAT "%8.4" ECU_ADDRESS 0x8FFB00 /end MEASUREMENT
/begin MEASUREMENT PCR_rOutAdPCVI3_mp "Ausgang Des I3-Regler" SWORD Prc 1 100 -400.0000 399.9878 FORMAT "%8.4" ECU_ADDRESS 0x8FFB02 /end MEASUREMENT
/begin MEASUREMENT PCR_rOutAdPCVI4_mp "Ausgang Des I4-Regler" SWORD Prc 1 100 -400.0000 399.9878 FORMAT "%8.4" ECU_ADDRESS 0x8FFB04 /end MEASUREMENT
/begin MEASUREMENT PCR_rOutDLP_mp "DTWin1-Regler Ausgang" SWORD Prc 1 100 -400.0000 399.9878 FORMAT "%8.4" ECU_ADDRESS 0x8FFB26 /end MEASUREMENT
/begin MEASUREMENT PCR_rOutDT1_mp "DT1-Anteil des PIDT1 Reglers" SWORD Prc 1 100 -400.0000 399.9878 FORMAT "%8.4" ECU_ADDRESS 0x8FFB06 /end MEASUREMENT
/begin MEASUREMENT PCR_rOutILim_mp "limited value of output" SWORD Prc 1 100 -400.0000 399.9878 FORMAT "%8.4" ECU_ADDRESS 0x8FFB08 /end MEASUREMENT
/begin MEASUREMENT PCR_rOutILP_mp "I-Regler Ausgang" SWORD Prc 1 100 -400.0000 399.9878 FORMAT "%8.4" ECU_ADDRESS 0x8FFB28 /end MEASUREMENT
/begin MEASUREMENT PCR_rOutIMax_mp "Ausgangsgröße des Kennfeldes PCR_rOutIMax_MAP" SWORD Prc 1 100 -400.0000 399.9878 FORMAT "%8.4" ECU_ADDRESS 0x8FFB0A /end MEASUREMENT
/begin MEASUREMENT PCR_rOutI_mp "I-Anteil des PIDT1 Reglers" SWORD Prc 1 100 -400.0000 399.9878 FORMAT "%8.4" ECU_ADDRESS 0x8FFB0C /end MEASUREMENT
/begin MEASUREMENT PCR_rOutLimLP_mp "Beschraenkter PID + Vorsteuertastverhaeltnis Ausgang" SWORD Prc 1 100 -400.0000 399.9878 FORMAT "%8.4" ECU_ADDRESS 0x8FFB2A /end MEASUREMENT
/begin MEASUREMENT PCR_rOutLP_mp "PID + Vorsteuertastverhaeltnis Ausgang" SWORD Prc 1 100 -400.0000 399.9878 FORMAT "%8.4" ECU_ADDRESS 0x8FFB2C /end MEASUREMENT
/begin MEASUREMENT PCR_rOutPIDLP_mp "" SWORD Prc 1 100 -400.0000 399.9878 FORMAT "%8.4" ECU_ADDRESS 0x8FFB2E /end MEASUREMENT
/begin MEASUREMENT PCR_rOutPILP_mp "PI-Regler Ausgang" SWORD Prc 1 100 -400.0000 399.9878 FORMAT "%8.4" ECU_ADDRESS 0x8FFB30 /end MEASUREMENT
/begin MEASUREMENT PCR_rOutPLP_mp "P-Regler Ausgang" SWORD Prc 1 100 -400.0000 399.9878 FORMAT "%8.4" ECU_ADDRESS 0x8FFB32 /end MEASUREMENT
/begin MEASUREMENT PCR_rOutP_mp "P-Anteil des PIDT1 Reglers" SWORD Prc 1 100 -400.0000 399.9878 FORMAT "%8.4" ECU_ADDRESS 0x8FFB0E /end MEASUREMENT
/begin MEASUREMENT PCR_rPICtl_mp "P+I+Steueranteil der Stellgröße (vor ARW)" SWORD Prc 1 100 -400.0000 399.9878 FORMAT "%8.4" ECU_ADDRESS 0x8FFB10 /end MEASUREMENT
/begin MEASUREMENT PCR_rPIDCtl_mp "Regel- und Steueranteil der Stellgrösse des Ladedruckreglers" SWORD Prc 1 100 -400.0000 399.9878 FORMAT "%8.4" ECU_ADDRESS 0x8FFB1A /end MEASUREMENT
/begin MEASUREMENT PCR_rstI_mp "Integratorzustand in Basisvariante" SWORD Prc 1 100 -400.0000 399.9878 FORMAT "%8.4" ECU_ADDRESS 0x8FFB1C /end MEASUREMENT
/begin MEASUREMENT PCR_rSurgeHysHigh_mp "Higher ATL pressure ratio limit for hysteresis of Anti-Surge LIGov" SWORD Prc 1 100 -400.0000 399.9878 FORMAT "%8.4" ECU_ADDRESS 0x8FFA72 /end MEASUREMENT
/begin MEASUREMENT PCR_rSurgeHysLow_mp "Lower ATL pressure ratio limit for hysteresis of Anti-Surge LIGov" SWORD Prc 1 100 -400.0000 399.9878 FORMAT "%8.4" ECU_ADDRESS 0x8FFA74 /end MEASUREMENT
/begin MEASUREMENT PCR_rSurgeLIGov "" SWORD Prc 1 100 -400.0000 399.9878 FORMAT "%8.4" ECU_ADDRESS 0x7F901C /end MEASUREMENT
/begin MEASUREMENT PCR_rSurgeLIGov_mp "ALT Pressure ratio for Anti-Surge LIGov" SWORD Prc 1 100 -400.0000 399.9878 FORMAT "%8.4" ECU_ADDRESS 0x8FFA76 /end MEASUREMENT
/begin MEASUREMENT PCR_stAdPCVLogic_mp "Status zur Freigabe verschiedener Funktionsmodi des Lernalgorithmus (aktiv, nicht aktiv, ruecksetzen, ignorieren)" UBYTE OneToOne 1 100 0.00 255.0 FORMAT "%5.1" ECU_ADDRESS 0x8FFB12 /end MEASUREMENT
/begin MEASUREMENT PCR_stAdPCVRelCond_mp "Status der Bedingungen zur Freigabe des Lernprozesses" UBYTE OneToOne 1 100 0.00 255.0 FORMAT "%5.1" ECU_ADDRESS 0x8FFB13 /end MEASUREMENT
/begin MEASUREMENT PCR_stAdPCV_mp "Bedingungen fuer verschiedene Funktionsmodi des Lernalgorithmus (aktiv, nicht aktiv ruecksetzen, ignorieren)" UWORD OneToOne 1 100 0.00 65535.00 FORMAT "%8.2" ECU_ADDRESS 0x8FFB14 /end MEASUREMENT
/begin MEASUREMENT PCR_stBDesLogic_mp "Status bits based on which raw or ramped unlimited desired boost pressure selection is made." UBYTE OneToOne 1 100 0.00 255.0 FORMAT "%5.1" ECU_ADDRESS 0x8FFAB8 /end MEASUREMENT
/begin MEASUREMENT PCR_stCmpEnd_mp "Calculation of the correction factor based on atmospheric factor" UBYTE OneToOne 1 100 0.00 255.0 FORMAT "%5.1" ECU_ADDRESS 0x8FFAB9 /end MEASUREMENT
/begin MEASUREMENT PCR_stEepAdPCV_mp "Status von eeprom schreibt" UBYTE OneToOne 1 100 0.00 255.0 FORMAT "%5.1" ECU_ADDRESS 0x8FFB16 /end MEASUREMENT
/begin MEASUREMENT PCR_stEepBlock_mp "Status des Eeprom-Blockes" SWORD OneToOne 1 100 -32768.00 32767.00 FORMAT "%8.2" ECU_ADDRESS 0x8FFB18 /end MEASUREMENT
/begin MEASUREMENT PCR_stSurge1 "Anti-Surge LIGov status1" UBYTE OneToOne 1 100 0.00 255.0 FORMAT "%5.1" ECU_ADDRESS 0x7F898B /end MEASUREMENT
/begin MEASUREMENT PCR_stSurge1_mp "Anti-Surge LIGov status1 without engine speed monitoring" UBYTE OneToOne 1 100 0.00 255.0 FORMAT "%5.1" ECU_ADDRESS 0x8FFA78 /end MEASUREMENT
/begin MEASUREMENT PCR_stSurge2 "Anti-Surge LIGov status2" UBYTE OneToOne 1 100 0.00 255.0 FORMAT "%5.1" ECU_ADDRESS 0x7F898C /end MEASUREMENT
/begin MEASUREMENT PCR_stSurgePre1_mp "Pre1 status of  Anti-Surge LIGov" UBYTE OneToOne 1 100 0.00 255.0 FORMAT "%5.1" ECU_ADDRESS 0x8FFA79 /end MEASUREMENT
/begin MEASUREMENT PCR_stSurgePre2_mp "Pre2 status of  Anti-Surge LIGov" UBYTE OneToOne 1 100 0.00 255.0 FORMAT "%5.1" ECU_ADDRESS 0x8FFA7A /end MEASUREMENT
/begin MEASUREMENT PCR_stSwtBPGovMaxDyn_mp "Ramp switch position, for dynamic adjustment of maximum allowable PCR governor output" UBYTE OneToOne 1 100 0.00 255.0 FORMAT "%5.1" ECU_ADDRESS 0x6F824C /end MEASUREMENT
/begin MEASUREMENT PCR_swtLimSel "Schalter zur Auswahl der Größen, aus denen der zulässige Stellgrößenbereich bestimmt wird" UBYTE OneToOne 1 100 0.00 255.0 FORMAT "%5.1" ECU_ADDRESS 0x7F8990 /end MEASUREMENT
/begin MEASUREMENT PCR_swtQntCtl "Schalter zur Auswahl der für Steuerung verwendeten Einspritzmenge" UBYTE OneToOne 1 100 0.00 255.0 FORMAT "%5.1" ECU_ADDRESS 0x7F8991 /end MEASUREMENT
/begin MEASUREMENT PCR_swtQntDes "Schalter für Mengeneingangswunsch bei der Sollwertberechnung" UBYTE OneToOne 1 100 0.00 255.0 FORMAT "%5.1" ECU_ADDRESS 0x7F8992 /end MEASUREMENT
/begin MEASUREMENT PCR_swtRelAbs "Schalter zur Auswahl zwischen Absolut- und Relativdruckregelung" UBYTE OneToOne 1 100 0.00 255.0 FORMAT "%5.1" ECU_ADDRESS 0x7F8993 /end MEASUREMENT
/begin FUNCTION msid "Master-Slave-Erkennung (Steuergeräteauswahl)"
 /begin DEF_CHARACTERISTIC MSidCD_Comm_DebNplDef_C MSidCD_Comm_DebNplOk_C MSidCD_numECUS_C MSidCD_Pin_DebSigDef_C MSidCD_Pin_DebSigOk_C MSidCD_Select_DebNplDef_C MSidCD_Select_DebNplOk_C MSidCD_Sel_INI_DebNplDef_C MSidCD_Sel_INI_DebNplOk_C MSidCD_Sel_INI_DebSigDef_C MSidCD_Sel_INI_DebSigOk_C MSidCD_stCANprivErrMsk_C MSidCD_stErrInjOFF_C MSidCD_stInv_C MSidCD_swtCanDeb_C MSidCD_swtLearn_C MSidCD_swtMAIN_C MSidCD_tiCanDeb_C /end DEF_CHARACTERISTIC
/end FUNCTION
/begin FUNCTION msid_msg "" /begin OUT_MEASUREMENT MSidCD_numECUS MSidCD_stInjOffECU MSidCD_swtMAIN /end OUT_MEASUREMENT /end FUNCTION
/begin FUNCTION msid_uic ""
 /begin OUT_MEASUREMENT MSidCD_stCANpriv_mp MSidCD_stECUCANpriv_mp MSidCD_stECUCANPtHelp_mp MSidCD_stECULearned_mp MSidCD_stECULTmp_mp MSidCD_stECUPlaus_mp MSidCD_stECUSelect_mp MSidCD_stECUStatus_mp MSidCD_stErrEcuPinComm_mp MSidCD_stErrECUSelect_mp MSidCD_stSetEEPROM_mp MSidCD_swtECUinfo_mp MSidCD_swtECUnum_mp MSidCD_swtMasterHW_mp MSidCD_swtPinDrive_mp MSidCD_swtPinECU_mp /end OUT_MEASUREMENT
/end FUNCTION
/begin FUNCTION netmng "Netzwerk Manager" /begin DEF_CHARACTERISTIC NetMng_swtONWM_C /end DEF_CHARACTERISTIC /end FUNCTION
/begin FUNCTION netmng_errhndl "Fehlerhandler"
 /begin DEF_CHARACTERISTIC NetMng_CANFadeOutMaskA_C NetMng_CANFadeOutMaskB_C NetMng_CANFadeOutMaskC_C NetMng_ctBusOffRetriesA_C NetMng_ctBusOffRetriesB_C NetMng_ctBusOffRetriesC_C NetMng_ctInitRetryCanA_C NetMng_ctInitRetryCanB_C NetMng_ctInitRetryCanC_C NetMng_tiDebPosBusMonCanA_C NetMng_tiDebNegBusMonCanA_C NetMng_tiDebPosBusMonCanB_C NetMng_tiDebNegBusMonCanB_C NetMng_tiDebPosBusMonCanC_C NetMng_tiDebNegBusMonCanC_C NetMng_tiDebPosBusOffCanA_C NetMng_tiDebNegBusOffCanA_C NetMng_tiDebPosBusOffCanB_C NetMng_tiDebNegBusOffCanB_C NetMng_tiDebPosBusOffCanC_C NetMng_tiDebNegBusOffCanC_C NetMng_tiDebPosErrCanA_C NetMng_tiDebNegErrCanA_C NetMng_tiDebPosErrCanB_C NetMng_tiDebNegErrCanB_C NetMng_tiDebPosErrCanC_C NetMng_tiDebNegErrCanC_C NetMng_tiDebPosMonCanA_C NetMng_tiDebNegMonCanA_C NetMng_tiDebPosMonCanB_C NetMng_tiDebNegMonCanB_C NetMng_tiDebPosMonCanC_C NetMng_tiDebNegMonCanC_C NetMng_FadeOutMaskA_C NetMng_FadeOutMaskB_C NetMng_FadeOutMaskC_C NetMng_SplyVltgHysXLow_C NetMng_SplyVltgHysXHigh_C NetMng_SplyVltgHysYLow_C NetMng_SplyVltgHysYHigh_C NetMng_tiFadeoutLowBat_C NetMng_tiFadeoutMin_C NetMng_tiRecoverA_C NetMng_tiRecoverB_C NetMng_tiRecoverC_C NetMng_tiTimeoutDNMT_C /end DEF_CHARACTERISTIC
/end FUNCTION
/begin FUNCTION netmng_msg ""
 /begin OUT_MEASUREMENT NetMng_stCANBus NetMng_stDisableMsg NetMng_stFadeOut NetMng_stONWM /end OUT_MEASUREMENT
/end FUNCTION
/begin FUNCTION netmng_uic ""
 /begin OUT_MEASUREMENT NetMng_stDfpCanA_mp NetMng_stDfpCanB_mp NetMng_stDfpCanC_mp NetMng_stDfpMaskPtCan_mp /end OUT_MEASUREMENT
/end FUNCTION
/begin FUNCTION nsc_corgn "coordinator for NOx cat regeneration" /begin DEF_CHARACTERISTIC NSC_numPrio_C NSC_st_C /end DEF_CHARACTERISTIC /end FUNCTION
/begin FUNCTION nsc_corgn_msg "" /begin OUT_MEASUREMENT NSC_numPrio NSC_st /end OUT_MEASUREMENT /end FUNCTION
/begin FUNCTION nsc_corgn_uic "" /end FUNCTION
/begin FUNCTION nvclb_calibration "" /end FUNCTION
/begin FUNCTION nvclb_calibration_uic "" /end FUNCTION
/begin FUNCTION opscd "Öldruckerfassung"
 /begin DEF_CHARACTERISTIC OPSCD_aMinBack_C OPSCD_aMinFor_C OPSCD_ctPwrStgOnMax_C OPSCD_LampDebExcTempDef_C OPSCD_LampDebExcTempOk_C OPSCD_LampDebNoLoadDef_C OPSCD_LampDebNoLoadOk_C OPSCD_LampDebShortCircBatDef_C OPSCD_LampDebShortCircBatOk_C OPSCD_LampDebShortCircGndDef_C OPSCD_LampDebShortCircGndOk_C OPSCD_nStart_C OPSCD_numDia_C OPSCD_numDioOut_C OPSCD_nZero_C OPSCD_stLampInvOut_C OPSCD_stPwrStgLampDia_C OPSCD_stSPICtl_C OPSCD_swtSigOut_C OPSCD_tiABSDebNegBack_C OPSCD_tiABSDebPosBack_C OPSCD_tiABSDebNegFor_C OPSCD_tiABSDebPosFor_C OPSCD_tiBtwTst_C OPSCD_tiInactiv1Back_C OPSCD_tiInactiv1For_C OPSCD_tiInactivStart_C OPSCD_tipOELDebNeg_C OPSCD_tipOELDebPos_C OPSCD_tiPwrStgOn_C OPSCD_vMinBack_C OPSCD_vMinFor_C /end DEF_CHARACTERISTIC
/end FUNCTION
/begin FUNCTION opscd_anain ""
 /begin DEF_CHARACTERISTIC OPSCD_uSRCMin_C OPSCD_uSRCMax_C OPSCD_pLin_CUR OPSCD_DebSRCHiDef_C OPSCD_DebSRCHiOk_C OPSCD_DebSRCLoDef_C OPSCD_DebSRCLoOk_C OPSCD_dtRmpSlpUp_C OPSCD_dtRmpSlpDwn_C OPSCD_numAdc_C OPSCD_stSensIDWord_C OPSCD_stPDfl_C /end DEF_CHARACTERISTIC
 /begin IN_MEASUREMENT OPSCD_uRaw_POEL_mp /end IN_MEASUREMENT
/end FUNCTION
/begin FUNCTION opscd_anain_msg "" /begin OUT_MEASUREMENT OPSCD_stpOEL /end OUT_MEASUREMENT /end FUNCTION
/begin FUNCTION opscd_anain_uic "" /begin OUT_MEASUREMENT OPSCD_uRaw_POEL_mp /end OUT_MEASUREMENT /end FUNCTION
/begin FUNCTION opscd_msg "" /begin OUT_MEASUREMENT OPSCD_stSigOut /end OUT_MEASUREMENT /end FUNCTION
/begin FUNCTION opscd_uic "" /begin OUT_MEASUREMENT OPSCD_stInactive_mp OPSCD_stLampRun_mp /end OUT_MEASUREMENT /end FUNCTION
/begin FUNCTION otscd_co "Öltemperaturfühler"
 /begin DEF_CHARACTERISTIC OTSCD_uSRCMin_C OTSCD_uSRCMax_C OTSCD_tLin_CUR OTSCD_DebNplDef_C OTSCD_DebNplOk_C OTSCD_DebSigDef_C OTSCD_DebSigOk_C OTSCD_DebSRCHighDef_C OTSCD_DebSRCHighOk_C OTSCD_DebSRCLowDef_C OTSCD_DebSRCLowOk_C OTSCD_numAdc_C OTSCD_tiStrtOilClntPlaus_C OTSCD_tiDelOilClntPlaus_C OTSCD_tThresOilClntPlaus_C OTSCD_tLimOilClntPlaus_C OTSCD_dtRmpSlpUp_C OTSCD_dtRmpSlpDwn_C OTSCD_swtSigVal_C OTSCD_stSensIDWord_C OTSCD_tDfl_C /end DEF_CHARACTERISTIC
 /begin IN_MEASUREMENT OTSCD_uRaw /end IN_MEASUREMENT
/end FUNCTION
/begin FUNCTION otscd_co_msg ""
 /begin OUT_MEASUREMENT OTSCD_stPlaus OTSCD_swtSig OTSCD_tEngOil OTSCD_tEngOilLin OTSCD_uRaw /end OUT_MEASUREMENT
/end FUNCTION
/begin FUNCTION otscd_co_uic "" /end FUNCTION
/begin FUNCTION ovrmon_10msctr_msg "" /begin OUT_MEASUREMENT OvRMon_ct10MS /end OUT_MEASUREMENT /end FUNCTION
/begin FUNCTION ovrmon_10msctr_uic "" /end FUNCTION
/begin FUNCTION ovrmon_accped ""
 /begin DEF_CHARACTERISTIC OvRMon_tiErrAPP_C OvRMon_uAPPFull_C OvRMon_uPlaWinFull_C OvRMon_uPlaWinIdle_C /end DEF_CHARACTERISTIC
/end FUNCTION
/begin FUNCTION ovrmon_accped_uic "" /begin OUT_MEASUREMENT OvRMon_stAPPDiff_mp OvRMon_uRegAPP1_mp OvRMon_uRegAPP2_mp /end OUT_MEASUREMENT /end FUNCTION
/begin FUNCTION ovrmon_brksens "" /begin DEF_CHARACTERISTIC OvRMon_tiDebBrk_C /end DEF_CHARACTERISTIC /end FUNCTION
/begin FUNCTION ovrmon_brksens_uic "" /end FUNCTION
/begin FUNCTION ovrmon_co "Funktionsüberwachung auf Systemebene Koordination"
 /begin DEF_CHARACTERISTIC ExeMon_stEnaTst_C OvRMon_ctEngSpdGrad_C OvRMon_DebETDef_C OvRMon_nLIGovLim_C OvRMon_nMin_C OvRMon_nStSysLim_C OvRMon_nThresNrml2Strt_C OvRMon_tiAPP1Flt_C OvRMon_tiASDdc_C OvRMon_tiCompAcsTemp_C OvRMon_tiCrCtlBrkRmp_C OvRMon_tiCrCtlConvRmp_C OvRMon_tiEngSpdRlsBrkRmp_C OvRMon_tiErrDblStorage_C OvRMon_tiLimET_MAP OvRMon_uAPP1Lim_C /end DEF_CHARACTERISTIC
 /begin IN_MEASUREMENT OvRMon_nAvrg OvRMon_tiOvRMonActive_mp /end IN_MEASUREMENT
/end FUNCTION
/begin FUNCTION ovrmon_convsens "" /begin DEF_CHARACTERISTIC OvRMon_tiDebConv_C /end DEF_CHARACTERISTIC /end FUNCTION
/begin FUNCTION ovrmon_convsens_uic "" /end FUNCTION
/begin FUNCTION ovrmon_co_msg "" /begin OUT_MEASUREMENT OvRMon_stActive OvRMon_stLIGovRls /end OUT_MEASUREMENT /end FUNCTION
/begin FUNCTION ovrmon_co_uic ""
 /begin OUT_MEASUREMENT OvRMon_ctDebET_mp OvRMon_stBrkPressed_mp OvRMon_stConvDebVal_mp OvRMon_stDCS_mp OvRMon_stEngSpdRls_mp OvRMon_stGrip_mp OvRMon_stRls_mp OvRMon_stT15DebVal_mp OvRMon_stTSCInc_mp OvRMon_tiLimET_mp OvRMon_tiOvRMonActive_mp OvRMon_uRawAPP1_mp /end OUT_MEASUREMENT
/end FUNCTION
/begin FUNCTION ovrmon_dcsdem "Signalerfassung der dynamische Fahrsteuerung" /end FUNCTION
/begin FUNCTION ovrmon_dcsdem_uic "" /end FUNCTION
/begin FUNCTION ovrmon_engspdrlssens "" /end FUNCTION
/begin FUNCTION ovrmon_engspdrlssens_uic "" /end FUNCTION
/begin FUNCTION ovrmon_engspdsens "Drehzahlüberwachung für die Schubüberwachung"
 /begin DEF_CHARACTERISTIC OvRMon_DebSigA0Def_C OvRMon_nDiffMax_C OvRMon_nSegMax_C OvRMon_nSegMin_C OvRMon_stIntrInit_C OvRMon_tiSegMin_C /end DEF_CHARACTERISTIC
/end FUNCTION
/begin FUNCTION ovrmon_engspdsens_msg ""
 /begin OUT_MEASUREMENT OvRMon_nAvrg OvRMon_stIntr OvRMon_tiIntrSysAct OvRMon_tiIntrSysLst /end OUT_MEASUREMENT
/end FUNCTION
/begin FUNCTION ovrmon_engspdsens_uic "" /begin OUT_MEASUREMENT OvRMon_nSeg_mp OvRMon_stIntrInactv_mp /end OUT_MEASUREMENT /end FUNCTION
/begin FUNCTION ovrmon_gearbxdem "Signalerfassung der Getriebesteuerung" /end FUNCTION
/begin FUNCTION ovrmon_gearbxdem_uic "" /end FUNCTION
/begin FUNCTION ovrmon_getsuminj "Berechnung des Drehmoments zur Schubüberwachung" /begin DEF_CHARACTERISTIC OvRMon_facInjEff_MAP /end DEF_CHARACTERISTIC /begin IN_MEASUREMENT Eng_nAvrg OvRMon_phiInjAct_mp /end IN_MEASUREMENT /begin OUT_MEASUREMENT OvRMon_tiTDCSumET_mp /end OUT_MEASUREMENT /end FUNCTION
/begin FUNCTION ovrmon_getsuminj_msg "" /begin OUT_MEASUREMENT OvRMon_tiTDCAvrg /end OUT_MEASUREMENT /end FUNCTION
/begin FUNCTION ovrmon_getsuminj_uic "" /begin OUT_MEASUREMENT OvRMon_phiInjAct_mp OvRMon_tiInjAct_mp /end OUT_MEASUREMENT /end FUNCTION
/begin FUNCTION ovrmon_gripsens "" /end FUNCTION
/begin FUNCTION ovrmon_gripsens_uic "" /end FUNCTION
/begin FUNCTION ovrmon_msg "" /begin OUT_MEASUREMENT OvRMon_stOvR /end OUT_MEASUREMENT /end FUNCTION
/begin FUNCTION ovrmon_t15sens "" /begin DEF_CHARACTERISTIC OvRMon_tiDebT15_C /end DEF_CHARACTERISTIC /end FUNCTION
/begin FUNCTION ovrmon_t15sens_uic "" /end FUNCTION
/begin FUNCTION ovrmon_trqdsc "" /begin DEF_CHARACTERISTIC OvRMon_ctDebToTORQUE_DSCDef_C OvRMon_ctDebToTORQUE_DSCOk_C /end DEF_CHARACTERISTIC /end FUNCTION
/begin FUNCTION ovrmon_trqdsc_msg "" /begin OUT_MEASUREMENT OvRMon_ctTORQUE_DSC OvRMon_stTrqDesDSC /end OUT_MEASUREMENT /end FUNCTION
/begin FUNCTION ovrmon_trqdsc_uic ""
 /begin OUT_MEASUREMENT OvRMon_numTORQUE_DSCbyteraw_mp OvRMon_stBusOffDSC_mp OvRMon_stErrPassDSC_mp OvRMon_stHwDefDSC_mp OvRMon_stTODSC_mp /end OUT_MEASUREMENT
/end FUNCTION
/begin FUNCTION ovrmon_trqegs "" /begin DEF_CHARACTERISTIC OvRMon_ctDebToTORQUE_EGSDef_C OvRMon_ctDebToTORQUE_EGSOk_C /end DEF_CHARACTERISTIC /end FUNCTION
/begin FUNCTION ovrmon_trqegs_msg "" /begin OUT_MEASUREMENT OvRMon_ctTORQUE_EGS OvRMon_stTrqDesEGS /end OUT_MEASUREMENT /end FUNCTION
/begin FUNCTION ovrmon_trqegs_uic ""
 /begin OUT_MEASUREMENT OvRMon_numTORQUE_EGSbyteraw_mp OvRMon_stBusOffEGS_mp OvRMon_stErrPassEGS_mp OvRMon_stHwDefEGS_mp OvRMon_stTOEGS_mp /end OUT_MEASUREMENT
/end FUNCTION
/begin FUNCTION ovrmon_trqssg "" /begin DEF_CHARACTERISTIC OvRMon_ctDebToTORQUE_SSGDef_C OvRMon_ctDebToTORQUE_SSGOk_C /end DEF_CHARACTERISTIC /end FUNCTION
/begin FUNCTION ovrmon_trqssg_msg "" /begin OUT_MEASUREMENT OvRMon_ctTORQUE_SSG OvRMon_stTrqDesSSG /end OUT_MEASUREMENT /end FUNCTION
/begin FUNCTION ovrmon_trqssg_uic ""
 /begin OUT_MEASUREMENT OvRMon_numTORQUE_SSGbyteraw_mp OvRMon_stBusOffSSG_mp OvRMon_stErrPassSSG_mp OvRMon_stHwDefSSG_mp OvRMon_stTOSSG_mp /end OUT_MEASUREMENT
/end FUNCTION
/begin FUNCTION oxiccd_gettemppre "Abgastemperatur vor Oxidationskatalysator"
 /begin DEF_CHARACTERISTIC OxiCCD_uSRCMinTPre_C OxiCCD_uSRCMaxTPre_C OxiCCD_tLinPre_CUR OxiCCD_DebSRCHighDefTPre_C OxiCCD_DebSRCHighOkTPre_C OxiCCD_DebSRCLowDefTPre_C OxiCCD_DebSRCLowOkTPre_C OxiCCD_numTempPreADC_C OxiCCD_dtRmpSlpUpPre_C OxiCCD_dtRmpSlpDwnPre_C OxiCCD_stSensIDWordTPre_C OxiCCD_tDflPre_C /end DEF_CHARACTERISTIC
 /begin IN_MEASUREMENT OxiCCD_uRawTempPre /end IN_MEASUREMENT
/end FUNCTION
/begin FUNCTION oxiccd_gettemppre_msg "" /begin OUT_MEASUREMENT OxiCCD_tLinPre OxiCCD_tPre OxiCCD_uRawTempPre /end OUT_MEASUREMENT /end FUNCTION
/begin FUNCTION oxiccd_gettemppre_uic "" /end FUNCTION
/begin FUNCTION pcbs_calccbs ""
 /begin DEF_CHARACTERISTIC PCBS_facFlTotDMEChg_C PCBS_lCalcDistance_CUR PCBS_qCalcFlTot_CUR /end DEF_CHARACTERISTIC
 /begin IN_MEASUREMENT PCBS_dAvaiDMEChg_mp PFlt_mAshOil /end IN_MEASUREMENT
/end FUNCTION
/begin FUNCTION pcbs_calccbs_msg ""
 /begin OUT_MEASUREMENT PCBS_dAvaiOut PCBS_lDistanceOut PCBS_qFlTotDMEChg PCBS_stCBSMsg PCBS_stCntValOut PCBS_stDMEChg PCBS_stDMEChgOld PCBS_stIDMsg PCBS_stPFltChg PCBS_stUnit /end OUT_MEASUREMENT
/end FUNCTION
/begin FUNCTION pcbs_calccbs_uic ""
 /begin OUT_MEASUREMENT PCBS_dAvaiDiag_mp PCBS_dAvaiDMEChg_mp PCBS_lMaxDistance_mp PCBS_stCntChgCAN_mp PCBS_stCntChgDIAG_mp PCBS_stCntChg_mp PCBS_stCntDiag_mp PCBS_stCntVal_mp PCBS_stDMEIni_mp PCBS_stPFltChgCAN_mp PCBS_stPFltChgDIAG_mp PCBS_stResetDiag_mp /end OUT_MEASUREMENT
/end FUNCTION
/begin FUNCTION pcr_balgvnr "Gleichstellungsregler" /end FUNCTION
/begin FUNCTION pcr_balgvnr_msg "" /begin OUT_MEASUREMENT PCR_rBalGvnrDiff /end OUT_MEASUREMENT /end FUNCTION
/begin FUNCTION pcr_balgvnr_uic "" /end FUNCTION
/begin FUNCTION pcr_ctlvalcalc "Ladedruck-Steuerung"
 /begin DEF_CHARACTERISTIC PCR_drSurge2RmpUp_C PCR_drSurge2RmpDwn_C PCR_facBPCtlBasCorr_CUR PCR_facBPCtlBasRgn1Corr_CUR PCR_facCtlAPRgn_MAP PCR_facCtlAP_MAP PCR_facCtlATRgn_CUR PCR_facCtlIAT_CUR PCR_rBPCtlBasUp_C PCR_rBPCtlBasDwn_C PCR_rBPCtlBasAirCtlOff_MAP PCR_rBPCtlBasCorr_MAP PCR_rBPCtlBasFDC_MAP PCR_rBPCtlBasRgn1Corr_MAP PCR_rBPCtlBasRgn1_MAP PCR_rBPCtlBasRgn2_MAP PCR_rCtlAPCmpnRgn_MAP PCR_rCtlAPCor_MAP PCR_rCtlATCmpnRgn_MAP PCR_rCtlATCmpn_MAP PCR_rCtlBas_MAP PCR_rCtlInit_C PCR_rSurgeCtlVal_MAP PCR_stCtlVal1_C PCR_stCtlVal2_C PCR_swtQntCtlVal_C PCR_swtQntCtlType_C PCR_tiRmpCtl_C /end DEF_CHARACTERISTIC
 /begin IN_MEASUREMENT APSCD_pVal Eng_nAvrg IATSCD_tAir PCR_qCtl_mp PFlt_mSot /end IN_MEASUREMENT
/end FUNCTION
/begin FUNCTION pcr_ctlvalcalc_msg "" /begin OUT_MEASUREMENT PCR_rCtlVal PCR_swtQntCtl /end OUT_MEASUREMENT /end FUNCTION
/begin FUNCTION pcr_ctlvalcalc_uic ""
 /begin OUT_MEASUREMENT PCR_qCtlFrmMngTrqInr_mp PCR_qCtl_mp PCR_rBPCtlAPCorrRgn_mp PCR_rBPCtlAPCorr_mp PCR_rBPCtlATCorrRgn_mp PCR_rBPCtlATCorr_mp PCR_rBPCtlBasCorr_mp PCR_rBPCtlBasRgn1Corr_mp PCR_rBPCtlBasRgn1_mp PCR_rBPCtlBasRgn2_mp PCR_rBPCtlBas_mp PCR_rCtlSurgeBas_mp PCR_rCtlVal1_mp PCR_rCtlVal2_mp /end OUT_MEASUREMENT
/end FUNCTION
/begin FUNCTION pcr_ctlvalcalc_var ""
 /begin DEF_CHARACTERISTIC PCR_dnSurgeHigh_CUR PCR_dnSurgeLow_CUR PCR_nLIGovBase_C PCR_nSetPointLIGov_C PCR_nSurgeMon1_C PCR_nSurgeMon2_C PCR_qSurgeHigh_CUR PCR_qSurgeLow_CUR PCR_rSurgeHigh_MAP PCR_rSurgeOfs_CUR PCR_tiSurgePT1_C PCR_swtOffStat1_C PCR_swtSurgeGearBPA_C PCR_swtSurgeGearLIGov_C PCR_tiSurgeBPAHiLo_C PCR_tiSurgeBPALoHi_C PCR_tiSurgeMonLIGov_C PCR_vSurgeLIGov_C /end DEF_CHARACTERISTIC
 /begin IN_MEASUREMENT APSCD_pVal Eng_nAvrg /end IN_MEASUREMENT
/end FUNCTION
/begin FUNCTION pcr_ctlvalcalc_var_msg ""
 /begin OUT_MEASUREMENT PCR_dnAvrg PCR_nSetPointSurge PCR_rSurgeLIGov PCR_stSurge1 PCR_stSurge2 /end OUT_MEASUREMENT
/end FUNCTION
/begin FUNCTION pcr_ctlvalcalc_var_uic ""
 /begin OUT_MEASUREMENT PCR_dnAvrgNeg_mp PCR_dnSurgeHigh_mp PCR_dnSurgeLow_mp PCR_qSurgeHigh_mp PCR_qSurgeLow_mp PCR_rSurgeHysHigh_mp PCR_rSurgeHysLow_mp PCR_rSurgeLIGov_mp PCR_stSurge1_mp PCR_stSurgePre1_mp PCR_stSurgePre2_mp /end OUT_MEASUREMENT
/end FUNCTION
/begin FUNCTION pcr_desvalcalc "Ladedruck Sollwertbildung"
 /begin DEF_CHARACTERISTIC PCR_tiDT1DesCld_C PCR_DKdDesCld_C PCR_DKdPosDesCld_C PCR_DKdNegDesCld_C PCR_dpDWinPosDesCld_C PCR_dpDWinNegDesCld_C PCR_dpBDes_C PCR_dpSlpLimDwn_C PCR_dpSlpLimUp_C PCR_dqDes_C PCR_drAPP1UnFlt_C PCR_tiBDesRaw_C PCR_dpBDesRaw_C PCR_tiDT1qDes_C PCR_DKdqDes_C PCR_tiDT1rAPP1_C PCR_DKdrAPP1_C PCR_facATRgn_CUR PCR_facCtQ_MAP PCR_facIAT_CUR PCR_facN_CUR PCR_nLimMax_C PCR_nLimMin_C PCR_pAPQCmpnRgn_MAP PCR_pAPQCmpn_MAP PCR_pBDesBasFDC_MAP PCR_pBDesBasRgn1_MAP PCR_pBDesBasRgn2_MAP PCR_pDesBas_MAP PCR_pDesMaxAP_MAP PCR_pDesMax_C PCR_pDesMin_C PCR_pNQCtCmpn_MAP PCR_stRgnMsk1_C PCR_stRgnMsk2_C PCR_swtActSlpLim_C PCR_swtQntDesVal_C PCR_swtQntDesType_C PCR_swtSlpLimInputType_C PCR_tClntThres_C PCR_tiBDesSlpLim_C PCR_tiRmpMswt_C PCR_tiDT1DesWrm_C PCR_DKdDesWrm_C PCR_DKdPosDesWrm_C PCR_DKdNegDesWrm_C PCR_dpDWinPosDesWrm_C PCR_dpDWinNegDesWrm_C /end DEF_CHARACTERISTIC
 /begin IN_MEASUREMENT APSCD_pVal CTSCD_tClnt Eng_nAvrg IATSCD_tAir PCR_qDes /end IN_MEASUREMENT
/end FUNCTION
/begin FUNCTION pcr_desvalcalc_msg "" /begin OUT_MEASUREMENT PCR_pDesVal PCR_qDes PCR_swtQntDes /end OUT_MEASUREMENT /end FUNCTION
/begin FUNCTION pcr_desvalcalc_uic ""
 /begin DEF_CHARACTERISTIC PCR_pDesAdd_Vector PCR_pDesAdd_Channel PCR_pDes_Vector PCR_pDes_Channel /end DEF_CHARACTERISTIC
 /begin OUT_MEASUREMENT PCR_bpMap_mp PCR_dpBDesRaw_mp PCR_dqDes_mp PCR_drAPP1UnFlt_mp PCR_facATRgn_mp PCR_facAT_mp PCR_facCtQ_mp PCR_facN_mp PCR_pAPQCmpnRgn_mp PCR_pAPQCmpn_mp PCR_pBasMAP_mp PCR_pBDesAPCorrRgn1_mp PCR_pBDesAPCorrRgn2_mp PCR_pBDesAPCorr_mp PCR_pBDesATCorrRgn1_mp PCR_pBDesATCorrRgn2_mp PCR_pBDesATCorr_mp PCR_pBDesCtCorr_mp PCR_pBDesDyn_mp PCR_pBDesMaxAP_mp PCR_pBDesNCorr_mp PCR_pBDesRaw2_mp PCR_pBDesRaw3_mp PCR_pBDesRaw_mp PCR_pBDesStat_mp PCR_pBDes_mp PCR_pDesByp_mp PCR_pNQCtCmpn_mp PCR_pRgnMAP1_mp PCR_pRgnMAP2_mp PCR_qDesFrmMngTrqInr_mp PCR_stBDesLogic_mp PCR_stCmpEnd_mp /end OUT_MEASUREMENT
/end FUNCTION
/begin FUNCTION pcr_governor "Adaptiver Ladedruckregler"
 /begin DEF_CHARACTERISTIC PCR_I1AdPCVKi_C PCR_I1AdPCVKiPos_C PCR_I1AdPCVKiNeg_C PCR_rI1AdPCVWinPos_C PCR_rI1AdPCVWinNeg_C PCR_I2AdPCVKi_C PCR_I2AdPCVKiPos_C PCR_I2AdPCVKiNeg_C PCR_rI2AdPCVWinPos_C PCR_rI2AdPCVWinNeg_C PCR_I3AdPCVKi_C PCR_I3AdPCVKiPos_C PCR_I3AdPCVKiNeg_C PCR_rI3AdPCVWinPos_C PCR_rI3AdPCVWinNeg_C PCR_I4AdPCVKi_C PCR_I4AdPCVKiPos_C PCR_I4AdPCVKiNeg_C PCR_rI4AdPCVWinPos_C PCR_rI4AdPCVWinNeg_C PCR_dlyPT1_C PCR_dnAvrgAdPCVLim_C PCR_tiDnCorrDT1_C PCR_DnCorrDKd_C PCR_tiDpCorrDT1_C PCR_dpCorrDKd_C PCR_dqCtlAdPCVLim_C PCR_tiAdPCVqCtlDT1_C PCR_DKdAdPCVqCtlDT1_C PCR_drAdPCVCtlRmpUp_C PCR_drAdPCVCtlRmpDwn_C PCR_drBPGovMaxDynUp_C PCR_drBPGovMaxDynDn_C PCR_DT1_C PCR_DKd_C PCR_DKdPos_C PCR_DKdNeg_C PCR_pDWinPos_C PCR_pDWinNeg_C PCR_facBPGovMaxCorr_CUR PCR_facDnCorr_CUR PCR_facDpCorr_CUR PCR_facD_MAP PCR_facI_MAP PCR_facmSotCorr_MAP PCR_facPresPFltMax_CUR PCR_facPresPFltMin_CUR PCR_facP_MAP PCR_IKi_C PCR_IKiPos_C PCR_IKiNeg_C PCR_pIWinPos_C PCR_pIWinNeg_C PCR_mskNoAdPCVVal_C PCR_mskResetVal_C PCR_mskStopLearning_C PCR_nAvrgAdPCV1_C PCR_nAvrgAdPCV2_C PCR_nPCVMax_C PCR_nPCVMin_C PCR_pBGDevAdPCVLim_C PCR_pFltValLim_C PCR_pValAdPCVMax_C PCR_pValAdPCVMin_C PCR_PKp_C PCR_PKpPos_C PCR_PKpNeg_C PCR_pPWinPos_C PCR_pPWinNeg_C PCR_qCtlAdPCV1_C PCR_qCtlAdPCV2_C PCR_qPCVMax_C PCR_qPCVMin_C PCR_rAdPCVCtlValMax_C PCR_rAdPCVCtlValMin_C PCR_rBPGovMaxCorr_MAP PCR_rBPGovMaxDynCorr_MAP PCR_rBPGovMaxDynEnd_C PCR_rBPGovMaxDynStrt_C PCR_rBPGovMaxDyn_MAP PCR_rDistAdPCV1_C PCR_rDistAdPCV2_C PCR_rDistAdPCV3_C PCR_rDistAdPCV4_C PCR_rGvnrMax_CUR PCR_rGvnrMax_MAP PCR_rGvnrMin_CUR PCR_rGvnrMin_MAP PCR_rOutIMax_MAP PCR_stAdPCVReset_C PCR_swtAdPCVrLim_C PCR_swtIDevType_C PCR_swtLimMpCrVal_C PCR_swtLimMpCrType_C PCR_swtLimSelVal_C PCR_swtLimSelType_C PCR_swtRawCur_C PCR_swtRelAbsVal_C PCR_swtRelAbsType_C PCR_tAirAdPCVMax_C PCR_tAirAdPCVMin_C PCR_tClntAdPCVLim_C PCR_tiHiLoAdPCVRelCond0_C PCR_tiLoHiAdPCVRelCond0_C PCR_tiHiLoAdPCVRelCond3_C PCR_tiLoHiAdPCVRelCond3_C /end DEF_CHARACTERISTIC
 /begin IN_MEASUREMENT APSCD_pVal BPSCD_dFltValDT1 CoEng_dvolFlConsum Eng_nAvrg InjCtl_qCurr PCR_dn_mp PCR_dpBGDev_mp PCR_qReal PFlt_mSot PFlt_pPre /end IN_MEASUREMENT
/end FUNCTION
/begin FUNCTION pcr_governor_msg ""
 /begin OUT_MEASUREMENT PCR_dqCtlA PCR_pBGDev PCR_qReal PCR_rBPGovMax PCR_rBPGovMin PCR_rBPLim PCR_rGvnr PCR_rGvnr2 PCR_swtLimSel PCR_swtRelAbs /end OUT_MEASUREMENT
/end FUNCTION
/begin FUNCTION pcr_governor_uic ""
 /begin OUT_MEASUREMENT PCR_DKd_mp PCR_dn_mp PCR_dpBGDev_mp PCR_facAdPCVc1_mp PCR_facAdPCVc2_mp PCR_facAdPCVc3_mp PCR_facAdPCVc4_mp PCR_facAdPCVrx_mp PCR_facAdPCVry_mp PCR_facD1_mp PCR_facDnCorr_mp PCR_facDpCorr_mp PCR_facD_mp PCR_facI_mp PCR_facmSotCorr_mp PCR_facP_mp PCR_pBDesFlt_mp PCR_pBGDev2_mp PCR_pBGDevI_mp PCR_rAdPCVCtlValLim_mp PCR_rAdPCVCtlVal_mp PCR_rAdPCVI1_mp PCR_rAdPCVI2_mp PCR_rAdPCVI3_mp PCR_rAdPCVI4_mp PCR_rBPGovMaxDynRamp_mp PCR_rBPGovMaxDyn_mp PCR_rBPGovMaxVal1_mp PCR_rBPGovMaxVal2_mp PCR_rBPGovMax_mp PCR_rBPGovMin_mp PCR_rBPGvnrUnLim1_mp PCR_rBPGvnrUnLim2_mp PCR_rBPLim_mp PCR_rInitI1AdPCV_mp PCR_rInitI2AdPCV_mp PCR_rInitI3AdPCV_mp PCR_rInitI4AdPCV_mp PCR_rOutAdPCVI1_mp PCR_rOutAdPCVI2_mp PCR_rOutAdPCVI3_mp PCR_rOutAdPCVI4_mp PCR_rOutDT1_mp PCR_rOutILim_mp PCR_rOutIMax_mp PCR_rOutI_mp PCR_rOutP_mp PCR_rPICtl_mp PCR_stAdPCVLogic_mp PCR_stAdPCVRelCond_mp PCR_stAdPCV_mp PCR_stEepAdPCV_mp PCR_stEepBlock_mp PCR_stSwtBPGovMaxDyn_mp /end OUT_MEASUREMENT
/end FUNCTION
/begin FUNCTION pcr_governor_var "" /begin DEF_CHARACTERISTIC PCR_rARWIMin_C PCR_swtARWMode_C /end DEF_CHARACTERISTIC /end FUNCTION
/begin FUNCTION pcr_governor_var_msg "" /end FUNCTION
/begin FUNCTION pcr_governor_var_uic "" /begin OUT_MEASUREMENT PCR_rPIDCtl_mp PCR_rstI_mp /end OUT_MEASUREMENT /end FUNCTION
/begin FUNCTION pcr_lpgovernor ""
 /begin DEF_CHARACTERISTIC PCR_drBPALPRmpUp_C PCR_drBPALPRmpDwn_C PCR_tiDT1LP_C PCR_DKdLP_C PCR_DKdPosLP_C PCR_DKdNegLP_C PCR_pDWinPosLP_C PCR_pDWinNegLP_C PCR_IKiLP_C PCR_IKiPosLP_C PCR_IKiNegLP_C PCR_pIWinPosLP_C PCR_pIWinNegLP_C PCR_pBDesLPRgn1_MAP PCR_pBDesLPRgn2_MAP PCR_pBDesLP_MAP PCR_pBDesMaxAPLP_MAP PCR_PKpLP_C PCR_PKpPosLP_C PCR_PKpNegLP_C PCR_pPWinPosLP_C PCR_pPWinNegLP_C PCR_rBPBasLPRgn1_MAP PCR_rBPBasLPRgn2_MAP PCR_rBPBasLP_MAP PCR_rBPRglBasLPRgn1_MAP PCR_rBPRglBasLPRgn2_MAP PCR_rBPRglBasLP_MAP PCR_rDt1InitLP_C PCR_rGovMaxLP_C PCR_rGovMinLP_C PCR_rIInitLP_C PCR_rMaxLP_C PCR_rMinLP_C PCR_stRgnMskLP1_C PCR_stRgnMskLP2_C PCR_tiRmpSlp_C /end DEF_CHARACTERISTIC
 /begin IN_MEASUREMENT APSCD_pVal Eng_nAvrg PCR_qDes /end IN_MEASUREMENT
/end FUNCTION
/begin FUNCTION pcr_lpgovernor_msg "" /begin OUT_MEASUREMENT PCR_pBGDvtLP PCR_rGvnrLP /end OUT_MEASUREMENT /end FUNCTION
/begin FUNCTION pcr_lpgovernor_uic ""
 /begin OUT_MEASUREMENT PCR_pBDesLPUnLim_mp PCR_pBDesLP_mp PCR_rBPBasLP_mp PCR_rBPRglBasLP_mp PCR_rOutDLP_mp PCR_rOutILP_mp PCR_rOutLimLP_mp PCR_rOutLP_mp PCR_rOutPIDLP_mp PCR_rOutPILP_mp PCR_rOutPLP_mp /end OUT_MEASUREMENT
/end FUNCTION
/begin COMPU_METHOD Acc "Fahrzeugbeschleunigung" RAT_FUNC "%6.5" "m/s^2" COEFFS 0 1000 0 0 0 1 /end COMPU_METHOD
/begin COMPU_METHOD AngleCrS "Winkel Kurbelwelle" RAT_FUNC "%6.4" "deg CrS" COEFFS 0 42.6666666666667 0 0 0 1 /end COMPU_METHOD
/begin COMPU_METHOD dn_dZ20 "Motorbeschleunigung pro Zeit (dn/dt) (im 20 ms Raster)" RAT_FUNC "%6.1" "rmp/s" COEFFS 0 0.1 0 0 0 1 /end COMPU_METHOD
/begin COMPU_METHOD dp_dZ10 "boost pressure per time (dp/dt) every 10ms" RAT_FUNC "%6.1" "hPa/s" COEFFS 0 0.1 0 0 0 1 /end COMPU_METHOD
/begin COMPU_METHOD dp_dZ20 " boost pressure per time (dp/dt) every 20ms" RAT_FUNC "%6.1" "hPa/s" COEFFS 0 0.1 0 0 0 1 /end COMPU_METHOD
/begin COMPU_METHOD EGTRmp "Zeitrampe verwendet von EGT Lib Funktionen" RAT_FUNC "%6.3" "s" COEFFS 0 0 1 0 0.0152587890625 0 /end COMPU_METHOD
/begin COMPU_METHOD EngN "Motordrehzahl" RAT_FUNC "%6.2" "rpm" COEFFS 0 1 0 0 0 1 /end COMPU_METHOD
/begin COMPU_METHOD Fact "Faktor mit Auflösung 1 / 8192, hauptsächlich für einen Faktorenbereich 0...1 verwendet" RAT_FUNC "%6.5" "-" COEFFS 0 8192 0 0 0 1 /end COMPU_METHOD
/begin COMPU_METHOD Fact1 "Faktor mit Auflösung 0,01 (100 mal höherer Bereich als Fact)" RAT_FUNC "%6.4" "-" COEFFS 0 128 0 0 0 1 /end COMPU_METHOD
/begin COMPU_METHOD FlConsum_l_h "Kraftstoffverbrauch" RAT_FUNC "%6.4" "l/h" COEFFS 0 100 0 0 0 1 /end COMPU_METHOD
/begin COMPU_METHOD Fl_2 "Umrechnung for getting 16 bit  total fuel consumption" RAT_FUNC "%6.1" "l" COEFFS 0 0.1 0 0 0 1 /end COMPU_METHOD
/begin COMPU_METHOD Fl_L "Treibstoffmenge [l]" RAT_FUNC "%6.4" "l" COEFFS 0 100 0 0 0 1 /end COMPU_METHOD
/begin COMPU_METHOD InjMass "Einspritzmenge" RAT_FUNC "%6.4" "mg/hub" COEFFS 0 100 0 0 0 1 /end COMPU_METHOD
/begin COMPU_METHOD InjMassCyc "Einspritzmenge pro Zyklus (mg/Zyklus)" RAT_FUNC "%6.4" "mg/cyc" COEFFS 0 100 0 0 0 1 /end COMPU_METHOD
/begin COMPU_METHOD InjMassPerSec_20ms "Einspritzmengenänderung pro Sekunde für 20ms-Tasks" RAT_FUNC "%6.3" "mg/hub/s" COEFFS 0 2 0 0 0 1 /end COMPU_METHOD
/begin COMPU_METHOD InjTime_us "Zeit in Microsekunden für das Einspritztiming" RAT_FUNC "%6.2" "us" COEFFS 0 1 0 0 0 1 /end COMPU_METHOD
/begin COMPU_METHOD Kd "Differentialverstärkung Kd (gleiche Einheit/Umrechnungsformel an Ein- und Ausgang)" RAT_FUNC "%7.6" "1/1" COEFFS 0 65536 0 0 0 1 /end COMPU_METHOD
/begin COMPU_METHOD Kd_Pres2dpdt "differential gain(boost pressure to rate of change of boost pressure)" RAT_FUNC "%8.7" "hPa/sec/hPa" COEFFS 0 131072 0 0 0 1 /end COMPU_METHOD
/begin COMPU_METHOD Kd_Pres2Prc "Differentialverstärkung Kd (Druck Pres zu Prozent Prc)" RAT_FUNC "%9.8" "%/hPa" COEFFS 0 5368709.120000 0 0 0 1 /end COMPU_METHOD
/begin COMPU_METHOD Kd_Pres_hPa2Prc "Differentialverstärkung Kd (Druck Pres_hPa zu Prozent Prc)" RAT_FUNC "%9.8" "%/hPa" COEFFS 0 5368709.12 0 0 0 1 /end COMPU_METHOD
/begin COMPU_METHOD Kd_rpm2dndt "differential gain(engine speed to rate of change of engine speed)" RAT_FUNC "%8.7" "rmp/sec/rpm" COEFFS 0 131072 0 0 0 1 /end COMPU_METHOD
/begin COMPU_METHOD Ki "Integrale Verstärkung Ki (gleiche Einheit/Umrechnungsregel an Ein- und Ausgang)" RAT_FUNC "%6.5" "1/s" COEFFS 0 4294.967296 0 0 0 1 /end COMPU_METHOD
/begin COMPU_METHOD Ki_Pres_hPa2Prc "Integralverstärkung (Druck Pres_hPa zu Prozent Prc)" RAT_FUNC "%8.7" "%/(hPa*s)" COEFFS 0 351843.72088832 0 0 0 1 /end COMPU_METHOD
/begin COMPU_METHOD km_sw_q10 "K3 Umwandlungen" RAT_FUNC "%6.1" "-" COEFFS 0 0.1 0 0 0 1 /end COMPU_METHOD
/begin COMPU_METHOD Kp_Pres_hPa2Prc "Proportionale Verstärkung (Druck Pres_hPa zu Prozent Prc)" RAT_FUNC "%9.8" "%/hPa" COEFFS 0 5368709.12 0 0 0 1 /end COMPU_METHOD
/begin COMPU_METHOD mSoot_g "Rußmasse [g]" RAT_FUNC "%6.4" "g" COEFFS 0 100 0 0 0 1 /end COMPU_METHOD
/begin COMPU_METHOD NumPinAdc "verbale Umrechnung für ADC Signale" TAB_VERB "%6.3" "-" COMPU_TAB_REF NumPinAdc /end COMPU_METHOD
/begin COMPU_VTAB NumPinAdc "verbale Umrechnung für ADC Signale" TAB_VERB 47 0 "Water_Temperature_Sensor_182" 1 "Intake_Air_Temperature_Sensor_157" 2 "Charge_Air_Temperature_Sensor_183" 3 "Exhaust_Temperature_Sensor_2_134" 4 "Exhaust_Temperature_Sensor_1_158" 5 "1st_APP_Sensor_252" 6 "2nd_APP_Sensor_239" 7 "ADC_REF" 8 "Boost_Pressure_Sensor_154" 9 "Atmospheric_Pressure_Sensor" 10 "Battery_Voltage_Sensor" 11 "Rail_Pressure_Sensor_156" 12 "Rail_Pressure_Peak_Value_156" 13 "Booster_Voltage_Sensor" 14 "Current_MeUn_Sensor" 15 "Current_PCV_Sensor" 16 "Voltage_Bank_1" 17 "Voltage_Bank_2" 18 "Pressure_Upstream_Particle_Filter_159" 19 "Engine_Oil_Pressure_110" 20 "Temperature_ECU_PCB" 21 "Voltage_Lambda_Ua" 22 "Voltage_Lambda_Ri" 23 "EMCCD_Current_Governor1_124" 24 "EMCCD_Current_Governor2_121" 25 "ADC_DUMMY_A_NOT_USED" 26 "ADC_DUMMY_NOT_USED" 27 "Charge_Actuator_Event_0" 28 "Voltage_Piezo_Actuator_Bank_2_Event_0" 29 "Voltage_Piezo_Actuator_Bank_1_Event_0" 30 "Charge_Actuator_Event_1" 31 "Voltage_Piezo_Actuator_Bank_2_Event_1" 32 "Voltage_Piezo_Actuator_Bank_1_Event_1" 33 "Charge_Actuator_Event_2" 34 "Voltage_Piezo_Actuator_Bank_2_Event_2" 35 "Voltage_Piezo_Actuator_Bank_1_Event_2" 36 "Charge_Actuator_Event_3" 37 "Voltage_Piezo_Actuator_Bank_2_Event_3" 38 "Voltage_Piezo_Actuator_Bank_1_Event_3" 39 "Charge_Actuator_Event_4" 40 "Voltage_Piezo_Actuator_Bank_2_Event_4" 41 "Voltage_Piezo_Actuator_Bank_1_Event_4" 42 "Charge_Actuator_Event_5" 43 "Voltage_Piezo_Actuator_Bank_2_Event_5" 44 "Voltage_Piezo_Actuator_Bank_1_Event_5" 45 "Booster_Voltage_Piezo" 46 "Piezo_Voltage" /end COMPU_VTAB
/begin COMPU_METHOD NumPinDia "Verbale Umrechnung für Diagnose Signale" TAB_VERB "%6.3" "-" COMPU_TAB_REF NumPinDia /end COMPU_METHOD
/begin COMPU_VTAB NumPinDia "Verbale Umrechnung für Diagnose Signale" TAB_VERB 36 0 "CJ945_Diagnostic_Signal" 1 "AC_Compressor_DiaSig" 2 "Fuel_Pump_DiaSig" 3 "Starter_234" 4 "Oil_Pressure_Lamp_Switch_245" 5 "Engine_Bay_Air_Flaps_123" 6 "Glow_Relay_Diagnostic_Signal1" 7 "reserved Glow_Relay_Diagnostic_Signal2" 8 "Ebox_Fan_Actuator_Diagnostic_Signal_219" 9 "Dummy_Actuator_Diagnostic_Signal" 10 "Twostage_TurboLoading_SW_DiaSig" 11 "DIO_OUT_DIAGNOSTIC_DUMMY_NOT_USED" 12 "1st_Pressure_Control_Valve_Diagnostic_Signal_172" 13 "2nd_Pressure_Control_Valve_Diagnostic_Signal_172" 14 "1st_Metering_Unit_Diagnostic_Signal_171" 15 "2nd_Metering_Unit_Diagnostic_Signal_171" 16 "Boost_Pressure_Actuator_Diagnostic_Signal_193" 17 "Boost_Pressure_Actuator_Diagnostic_Signal_193_2" 18 "EGR_Actuator_Diagnostic_Signal_194" 19 "EGR_Actuator_Diagnostic_Signal2" 20 "Variable_Swirl_Actuator_Diagnostic_Signal_195" 21 "Throttle_Valve_Diagnostic_Signal_196" 22 "Throttle_Valve2_Diagnostic_Signal_196" 23 "FAN_240" 24 "Add_On_Heater_244" 25 "EngM_Bearing_Actuator_Diagnostic_Signal_124" 26 "EngM_Bearing_Actuator_Diagnostic_Signal_121" 27 "Low pressure stage BPA_Diagnostic_Signal_117" 28 "Shuttr_Actuator_Diagnostic_Signal_231" 29 "PWM_DIAGNOSTIC_DUMMY_NOT_USED" 30 "1st_Sensor_Supply_Voltage_DiaSig" 31 "2nd_Sensor_Supply_Voltage_DiaSig" 32 "3rd_Sensor_Supply_Voltage_DiaSig" 33 "4th_Sensor_Supply_Voltage_DiaSig" 34 "5th_Sensor_Supply_Voltage_DiaSig" 35 "6th_Sensor_Supply_Voltage_DiaSig" /end COMPU_VTAB
/begin COMPU_METHOD NumPinDioOut "Verbale Umrechnung für Digitalausgang Signale" TAB_VERB "%6.3" "-" COMPU_TAB_REF NumPinDioOut /end COMPU_METHOD
/begin COMPU_VTAB NumPinDioOut "Verbale Umrechnung für Digitalausgang Signale" TAB_VERB 12 0 "Main_Relay_220(144)" 1 "AC_Compressor" 2 "Fuel_Pump_232" 3 "Starter_234" 4 "OPS_Lamp_245" 5 "EBAF_123" 6 "Ebox_Fan_Actuator_219" 7 "Shuttr_Actuator_Digital_231" 8 "STATREG_PSOFF_Bit" 9 "Twostage_TurboLoading_120" 10 "TD_Signal_253" 11 "DIO_OUT_DUMMY_NOT_USED" /end COMPU_VTAB
/begin COMPU_METHOD OneToOne "eins zu eins (physikalischer Wert ist gleich dem internen Wert)" RAT_FUNC "%6.2" "-" COEFFS 0 1 0 0 0 1 /end COMPU_METHOD
/begin COMPU_METHOD Prc "Prozent, gleiche interne Auflösung wie Fact, aber Darstellung in Prozent (0...100%)" RAT_FUNC "%6.4" "%" COEFFS 0 81.92 0 0 0 1 /end COMPU_METHOD
/begin COMPU_METHOD PrcPerSec "Prozentänderung pro Sekunde für 20ms-Tasks" RAT_FUNC "%6.3" "%/s" COEFFS 0 1.6384 0 0 0 1 /end COMPU_METHOD
/begin COMPU_METHOD Pres "Druck (angezeigt in [kPa])" RAT_FUNC "%7.2" "hPa" COEFFS 0 1.000000 0 0 0 1 /end COMPU_METHOD
/begin COMPU_METHOD Pres_hPa "Druck (angezeigt in [hPa])" RAT_FUNC "%6.2" "hPa" COEFFS 0 1 0 0 0 1 /end COMPU_METHOD
/begin COMPU_METHOD RmpPrc "Prozent Rampengradient" RAT_FUNC "%6.5" "%/s" COEFFS 0 5368.70912 0 0 0 1 /end COMPU_METHOD
/begin COMPU_METHOD RmpPres "Rampengradient für Druck" RAT_FUNC "%7.3" "hPa/s" COEFFS 0 65.536000 0 0 0 1 /end COMPU_METHOD
/begin COMPU_METHOD RmpPres_hPa "Rampengradient für Druck angezeigt in [hPa/s]" RAT_FUNC "%6.4" "hPa/s" COEFFS 0 65.536 0 0 0 1 /end COMPU_METHOD
/begin COMPU_METHOD RmpTemp "Rampengradient für Temperatur" RAT_FUNC "%6.4" "deg C/s" COEFFS 0 655.36 0 0 0 1 /end COMPU_METHOD
/begin COMPU_METHOD TempDiff_Kelv "Offsettemperatur dargestellt in [K]" RAT_FUNC "%6.3" "deg C" COEFFS 0 10 0 0 0 1 /end COMPU_METHOD
/begin COMPU_METHOD Temp_Cels "Temperatur dargestellt in °C (gleiche interne Darstellung wie Temp_Kelv)" RAT_FUNC "%6.1" "deg C" COEFFS 0 10 2731.4 0 0 1 /end COMPU_METHOD
/begin COMPU_METHOD Temp_Fahr "Temperatur dargestellt in Fahrenheit (gleiche interne Darstellung wie Temp_Kelv)" RAT_FUNC "%6.1" "deg F" COEFFS 0 5.55555555555556 2553.62222222222 0 0 1 /end COMPU_METHOD
/begin COMPU_METHOD TimeDeb "Entprellzeit in Millisekunden für Libraryfunktion Debounce" RAT_FUNC "%6.1" "ms" COEFFS 0 0.1 0 0 0 1 /end COMPU_METHOD
/begin COMPU_METHOD TimeDelay_s "Zeitkonstante T1 (in s) für PT1, DT1, etc." RAT_FUNC "%9.3" "s" COEFFS 0 0 1 0 0.00023283064365387 0 /end COMPU_METHOD
/begin COMPU_METHOD TimeUSResolution "Zeit in Mikrosekunden für TPU Zeiten, Auflösung 1 us" RAT_FUNC "%6.2" "us" COEFFS 0 1 0 0 0 1 /end COMPU_METHOD
/begin COMPU_METHOD Time_ms "Zeit in ms für Fehlerentprellung (DSM) und SW-Timer" RAT_FUNC "%6.1" "ms" COEFFS 0 0.1 0 0 0 1 /end COMPU_METHOD
/begin COMPU_METHOD Time_ms_20ms "Zeitzähler im 20 ms Raster, dargestellt in ms" RAT_FUNC "%6.1" "ms" COEFFS 0 0.05 0 0 0 1 /end COMPU_METHOD
/begin COMPU_METHOD Time_s "Zeit in s für Fehlerentprellung (DSM) und SW-Timer" RAT_FUNC "%6.4" "s" COEFFS 0 100 0 0 0 1 /end COMPU_METHOD
/begin COMPU_METHOD Vel "Fahrzeuggeschwindigkeit, gleiche interne Auflösung wie Vel_SI" RAT_FUNC "%6.4" "km/h" COEFFS 0 100 0 0 0 1 /end COMPU_METHOD
/begin COMPU_METHOD Volt "Spannung in V (von ADC)" RAT_FUNC "%6.2" "mV" COEFFS 0 0.2046 0 0 0 1 /end COMPU_METHOD
/begin COMPU_METHOD Volt_Batt "Batteriespannung" RAT_FUNC "%6.1" "mV" COEFFS 0 0.05115 0 0 0 1 /end COMPU_METHOD
/begin RECORD_LAYOUT Kf_Xs16_Ys16_Ws16 NO_AXIS_PTS_X 1 SWORD NO_AXIS_PTS_Y 2 SWORD AXIS_PTS_X 3 SWORD INDEX_INCR DIRECT AXIS_PTS_Y 4 SWORD INDEX_INCR DIRECT FNC_VALUES 5 SWORD COLUMN_DIR DIRECT /end RECORD_LAYOUT
/begin RECORD_LAYOUT Kl_Xs16_Ws16 NO_AXIS_PTS_X 1 SWORD AXIS_PTS_X 2 SWORD INDEX_INCR DIRECT FNC_VALUES 3 SWORD COLUMN_DIR DIRECT /end RECORD_LAYOUT
/begin RECORD_LAYOUT Kwb_Wu32 FNC_VALUES 1 ULONG COLUMN_DIR DIRECT /end RECORD_LAYOUT
/begin RECORD_LAYOUT Kw_Ws16 FNC_VALUES 1 SWORD COLUMN_DIR DIRECT /end RECORD_LAYOUT
/begin RECORD_LAYOUT Kw_Ws32 FNC_VALUES 1 SLONG COLUMN_DIR DIRECT /end RECORD_LAYOUT
/begin RECORD_LAYOUT Kw_Ws8 FNC_VALUES 1 SBYTE COLUMN_DIR DIRECT /end RECORD_LAYOUT
/begin RECORD_LAYOUT Kw_Wu16 FNC_VALUES 1 UWORD COLUMN_DIR DIRECT /end RECORD_LAYOUT
/begin RECORD_LAYOUT Kw_Wu32 FNC_VALUES 1 ULONG COLUMN_DIR DIRECT /end RECORD_LAYOUT
/begin RECORD_LAYOUT Kw_Wu8 FNC_VALUES 1 UBYTE COLUMN_DIR DIRECT /end RECORD_LAYOUT
/end MODULE
/end PROJECT
