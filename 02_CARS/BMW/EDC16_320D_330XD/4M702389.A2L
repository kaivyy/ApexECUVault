ASAP2_VERSION 1 3
/begin PROJECT P389 "BMW DDE6.0 4-Zylinder V70.2 30.03.2004"
/begin HEADER "" VERSION "V70.2_4Z" PROJECT_NO P389 /end HEADER
/begin MODULE DIM ""
/begin MOD_COMMON "" BYTE_ORDER MSB_FIRST ALIGNMENT_BYTE 1 ALIGNMENT_WORD 2 ALIGNMENT_LONG 4 ALIGNMENT_FLOAT32_IEEE 4 /end MOD_COMMON
/begin CHARACTERISTIC CrSCD_numGlFilter_C "Wert Glitch Filter (MCy315)" VALUE 0xC0631 Kw_Wu8 3.000 OneToOne 0.00 3.000 FORMAT "%5.3" EXTENDED_LIMITS 0.00 255.0 /end CHARACTERISTIC
/begin CHARACTERISTIC CrSCD_numThresCtlHigh_C "obere Schwelle (MCy315)" VALUE 0xC0632 Kw_Wu8 7.000 OneToOne 0.00 7.000 FORMAT "%5.3" EXTENDED_LIMITS 0.00 255.0 /end CHARACTERISTIC
/begin CHARACTERISTIC CrSCD_numThresCtlLow_C "untere Schwelle (MCy315)" VALUE 0xC0633 Kw_Wu8 7.000 OneToOne 0.00 7.000 FORMAT "%5.3" EXTENDED_LIMITS 0.00 255.0 /end CHARACTERISTIC
/begin CHARACTERISTIC ExeMon_stEnaTst_C "#SSD Schalter zum Testen der Programmablaufkontrolle" VALUE 0xC31B0 Kw_Wu8 255.0 OneToOne 0.00 255.0 FORMAT "%5.1" /end CHARACTERISTIC
/begin CHARACTERISTIC InjVlv_iLvlHi1_C "#SSD Oberes Stromniveau 1 (Boosterstrom)" VAL_BLK 0xC0634 Kwb_Wu16 30.00000 UC_Curr 0.00 30.00000 FORMAT "%8.5" EXTENDED_LIMITS 0.00 6553.500 NUMBER 4 /end CHARACTERISTIC
/begin CHARACTERISTIC InjVlv_iLvlHi2_C "#SSD Oberes Stromniveau 2 (Anzugstrom)" VAL_BLK 0xC063C Kwb_Wu16 30.00000 UC_Curr 0.00 30.00000 FORMAT "%8.5" EXTENDED_LIMITS 0.00 6553.500 NUMBER 4 /end CHARACTERISTIC
/begin CHARACTERISTIC InjVlv_iLvlHi3_C "Oberes Stromniveau 3 (Haltestrom)" VAL_BLK 0xC0644 Kwb_Wu16 30.00000 UC_Curr 0.00 30.00000 FORMAT "%8.5" EXTENDED_LIMITS 0.00 6553.500 NUMBER 4 /end CHARACTERISTIC
/begin CHARACTERISTIC InjVlv_iLvlLo1_C "Unteres Stromniveau 1 (Boosterstrom)" VAL_BLK 0xC064C Kwb_Wu16 30.00000 UC_Curr 0.00 30.00000 FORMAT "%8.5" EXTENDED_LIMITS 0.00 6553.500 NUMBER 4 /end CHARACTERISTIC
/begin CHARACTERISTIC InjVlv_iLvlLo2_C "Unteres Stromniveau 2 (Haltestrom)" VAL_BLK 0xC0654 Kwb_Wu16 30.00000 UC_Curr 0.00 30.00000 FORMAT "%8.5" EXTENDED_LIMITS 0.00 6553.500 NUMBER 4 /end CHARACTERISTIC
/begin CHARACTERISTIC InjVlv_iLvlLo3_C "Unteres Stromniveau 3 (Haltestrom)" VAL_BLK 0xC065C Kwb_Wu16 30.00000 UC_Curr 0.00 30.00000 FORMAT "%8.5" EXTENDED_LIMITS 0.00 6553.500 NUMBER 4 /end CHARACTERISTIC
/begin CHARACTERISTIC InjVlv_iThresMax_C "Schwelle für Überstromerkennung" VALUE 0xC0664 Kw_Wu16 30.00000 UC_Curr 0.00 30.00000 FORMAT "%8.5" EXTENDED_LIMITS 0.00 6553.500 /end CHARACTERISTIC
/begin CHARACTERISTIC InjVlv_stInj_C "#SSD interne Einspritzbefehlsfolge des CY33x" VAL_BLK 0xC0666 Kwb_Wu16 255.0000 OneToOne 0.00 255.0000 FORMAT "%8.4" EXTENDED_LIMITS 0.00 65535.00 NUMBER 16 /end CHARACTERISTIC
/begin CHARACTERISTIC InjVlv_stRatRchgOff_C "#SSD PWM zum automatischen Unterbrechen des Nachladens, um Bootstrap-C am HS-Treiber nachzuladen" VALUE 0xC0686 Kw_Wu16 255.0000 OneToOne 0.00 255.0000 FORMAT "%8.4" EXTENDED_LIMITS 0.00 65535.00 /end CHARACTERISTIC
/begin CHARACTERISTIC InjVlv_stRegCfg_C "#SSD Inhalt des CY33x CFG Registers (SMR- / RCHG- / LS- mode)" VALUE 0xC0688 Kw_Wu16 255.0000 OneToOne 0.00 255.0000 FORMAT "%8.4" EXTENDED_LIMITS 0.00 65535.00 /end CHARACTERISTIC
/begin CHARACTERISTIC InjVlv_stRegDcc_C "#SSD Inhalt des CY33x DCC registers (enable / err / I low / I high / I max)" VALUE 0xC068A Kw_Wu16 255.0000 OneToOne 0.00 255.0000 FORMAT "%8.4" EXTENDED_LIMITS 0.00 65535.00 /end CHARACTERISTIC
/begin CHARACTERISTIC InjVlv_stRegDmsk_C "#SSD Inhalt des CY33x DMSK Registers (Stromniveau 1-3 / Differenzstrom 1-3 / Umin )" VALUE 0xC068C Kw_Wu16 255.0000 OneToOne 0.00 255.0000 FORMAT "%8.4" EXTENDED_LIMITS 0.00 65535.00 /end CHARACTERISTIC
/begin CHARACTERISTIC InjVlv_stRegMode_C "#SSD Inhalt des CY33x Mode Registers ( CP / CP1 / CP2 / 1-2 Bank )" VALUE 0xC068E Kw_Wu16 255.0000 OneToOne 0.00 255.0000 FORMAT "%8.4" EXTENDED_LIMITS 0.00 65535.00 /end CHARACTERISTIC
/begin CHARACTERISTIC InjVlv_stTiBstErrMax_C "#SSD maximal zulässige Zeit einer Boosterphase" VALUE 0xC0690 Kw_Wu16 63.00000 OneToOne 0.00 63.00000 FORMAT "%8.5" EXTENDED_LIMITS 0.00 65535.00 /end CHARACTERISTIC
/begin CHARACTERISTIC InjVlv_stTiBstErrMin_C "#SSD minimale Zeit bis ein Stromanstieg während einer Boosterphase erkannt sein muss" VALUE 0xC0692 Kw_Wu16 63.00000 OneToOne 0.00 63.00000 FORMAT "%8.5" EXTENDED_LIMITS 0.00 65535.00 /end CHARACTERISTIC
/begin CHARACTERISTIC InjVlv_stTiCY330Del_C "#SSD Interne Wartezeit des CY33x für Schnellöschprüfung" VALUE 0xC0694 Kw_Wu16 63.00000 OneToOne 0.00 63.00000 FORMAT "%8.5" EXTENDED_LIMITS 0.00 65535.00 /end CHARACTERISTIC
/begin CHARACTERISTIC InjVlv_stTiDelAftFastIDec_C "#SSD Wartezeit vor Beginn der Messung der Schnellöschzeit" VALUE 0xC0696 Kw_Wu16 63.00000 OneToOne 0.00 63.00000 FORMAT "%8.5" EXTENDED_LIMITS 0.00 65535.00 /end CHARACTERISTIC
/begin CHARACTERISTIC InjVlv_stTiDelAftRchg_C "#SSD Wartezeit, bevor ein neuer Nachladepuls gestartet wird" VALUE 0xC0698 Kw_Wu16 63.00000 OneToOne 0.00 63.00000 FORMAT "%8.5" EXTENDED_LIMITS 0.00 65535.00 /end CHARACTERISTIC
/begin CHARACTERISTIC InjVlv_stTiDelBefLSMode_C "#SSD Wartezeit bevor der LS mode aktiviert wird (für CRIPx: Stromunterdrückung nach Einspritzung)" VALUE 0xC069A Kw_Wu16 63.00000 OneToOne 0.00 63.00000 FORMAT "%8.5" EXTENDED_LIMITS 0.00 65535.00 /end CHARACTERISTIC
/begin CHARACTERISTIC InjVlv_stTiFastIDecErrMax_C "#SSD maximal zulässige Zeit für eine Schnellöschung" VALUE 0xC069C Kw_Wu16 63.00000 OneToOne 0.00 63.00000 FORMAT "%8.5" EXTENDED_LIMITS 0.00 65535.00 /end CHARACTERISTIC
/begin CHARACTERISTIC InjVlv_stTiInjMax_C "#SSD maximal zulässige Zeit für aktives ON-Signal" VALUE 0xC069E Kw_Wu16 255.0000 OneToOne 0.00 255.0000 FORMAT "%8.4" EXTENDED_LIMITS 0.00 65535.00 /end CHARACTERISTIC
/begin CHARACTERISTIC InjVlv_stTiMaxRchg_C "#SSD CY331 : max. zulaessige Zeit für einen Rechargepuls" VALUE 0xC06A0 Kw_Wu16 63.00000 OneToOne 0.00 63.00000 FORMAT "%8.5" EXTENDED_LIMITS 0.00 65535.00 /end CHARACTERISTIC
/begin CHARACTERISTIC InjVlv_uCMax_C "#SSD CY33x : Schwelle für Boosterüberspannung" VALUE 0xC06A2 Kw_Wu16 80.00000 UC_Volt 0.00 80.00000 FORMAT "%8.5" EXTENDED_LIMITS 0.00 6553.500 /end CHARACTERISTIC
/begin CHARACTERISTIC InjVlv_uCMin_C "#SSD (Adr:0x31)CY33x : Schwelle für Booster-Voltage-Error" VALUE 0xC06A4 Kw_Wu16 80.00000 UC_Volt 0.00 80.00000 FORMAT "%8.5" EXTENDED_LIMITS 0.00 6553.500 /end CHARACTERISTIC
/begin CHARACTERISTIC InjVlv_uCSetPoint_C "#SSD Sollspannung des Boosterkondensators" VALUE 0xC06A6 Kw_Wu16 80.00000 UC_Volt 0.00 80.00000 FORMAT "%8.5" EXTENDED_LIMITS 0.00 6553.500 /end CHARACTERISTIC
/begin CHARACTERISTIC InjVlv_uCThresBstStop_C "#SSD wenn die Boosterkondensatorspannung unter diese Schwelle fällt, wird eine Boosterphase beendet" VALUE 0xC06A8 Kw_Wu16 80.00000 UC_Volt 0.00 80.00000 FORMAT "%8.5" EXTENDED_LIMITS 0.00 6553.500 /end CHARACTERISTIC
/begin CHARACTERISTIC LSUCD_dcycMinGrad_C "Minimale Änderung des Tastverhältnisses zur Freigabe der Diagnose der Heizungskopplung" VALUE 0xE53D8 Kw_Ws16 655.3500 DtyCyc -327.6800 327.6700 FORMAT "%8.4" /end CHARACTERISTIC
/begin CHARACTERISTIC LSUCD_DebHtCoupDef_C "Fehlerentprellzeit für Heizungskopplung" VALUE 0xE53DA Kw_Wu16 65535.00 OneToOne 0.00 65535.00 FORMAT "%8.2" /end CHARACTERISTIC
/begin CHARACTERISTIC LSUCD_DebHtCoupOk_C "Fehlerheilungszeit für Heizungskopplung" VALUE 0xE53DC Kw_Wu16 65535.00 OneToOne 0.00 65535.00 FORMAT "%8.2" /end CHARACTERISTIC
/begin CHARACTERISTIC LSUCD_DebWireIpDef_C "Defektentprellzähler der Nebenschlusserkennung" VALUE 0xE53DE Kw_Wu16 65535.00 OneToOne 0.00 65535.00 FORMAT "%8.2" /end CHARACTERISTIC
/begin CHARACTERISTIC LSUCD_DebWireIpOk_C "Heilungsentprellzähler der Nebenschlusserkennung" VALUE 0xE53E0 Kw_Wu16 65535.00 OneToOne 0.00 65535.00 FORMAT "%8.2" /end CHARACTERISTIC
/begin CHARACTERISTIC LSUCD_dNumHtCoup_C "Anzahl der für ein signifikantes Resultat notwendigen Aktivierungen der Heizungskoplungsprüfung" VALUE 0xE53E2 Kw_Wu16 65535.00 OneToOne 0.00 65535.00 FORMAT "%8.2" /end CHARACTERISTIC
/begin CHARACTERISTIC LSUCD_resRiMaxGrad_C "Maximale Änderung des Innenwiderstands zur Freigabe der Diagnose der Heizungskopplung" VALUE 0xE53E4 Kw_Ws16 6553.500 Resist -3276.800 3276.700 FORMAT "%8.3" /end CHARACTERISTIC
/begin CHARACTERISTIC LSUCD_rO2IsolChkMax_C "Maximal zulässige Sauerstoffanzeige für kalte Sonde" VALUE 0xE53E6 Kw_Ws16 0.6553500 O2 -0.3276800 0.3276700 FORMAT "%9.7" /end CHARACTERISTIC
/begin CHARACTERISTIC LSUCD_rO2IsolChkMin_C "Minimal zulässige Sauerstoffanzeige für kalte Sonde" VALUE 0xE53E8 Kw_Ws16 0.6553500 O2 -0.3276800 0.3276700 FORMAT "%9.7" /end CHARACTERISTIC
/begin CHARACTERISTIC LSUCD_stCJChpSel_C "Applikationskonstante zur Auswahl von CJ120 (=0) oder CJ125 (=1)" VALUE 0xE51A4 Kw_Wu16 1.000000 OneToOne 0.00 1.000000 FORMAT "%8.6" EXTENDED_LIMITS 0.00 65535.00 /end CHARACTERISTIC
/begin CHARACTERISTIC LSUCD_stRgnEna_C "Applikationskonstante zur Aktivierung oder Deaktivierung der Regeneration" VALUE 0xE51A6 Kw_Wu8 1.000 OneToOne 0.00 1.000 FORMAT "%5.3" EXTENDED_LIMITS 0.00 255.0 /end CHARACTERISTIC
/begin CHARACTERISTIC LSUCD_stWireDiaActv_C "Ansteuerungsflags für Diagnoseroutinen" VALUE 0xE53EA Kw_Wu16 65535.00 OneToOne 0.00 65535.00 FORMAT "%8.2" /end CHARACTERISTIC
/begin CHARACTERISTIC LSUCD_tiHtCoupChk_C "Zeitdauer der Heizungsabschaltung für Diagnose der Heizungskopplung" VALUE 0xE53EC Kw_Wu16 655.3500 Time_s 0.00 655.3500 FORMAT "%8.4" /end CHARACTERISTIC
/begin CHARACTERISTIC LSUCD_tiHtCoupPer_C "Zeitspanne zur Ansteuerung der Diagnose der Heizungskopplung" VALUE 0xE53EE Kw_Wu16 655.3500 Time_s 0.00 655.3500 FORMAT "%8.4" /end CHARACTERISTIC
/begin CHARACTERISTIC LSUCD_tiIsolChkErr_C "Maximale Abkühlzeit LSU" VALUE 0xE53F0 Kw_Wu16 655.3500 Time_s 0.00 655.3500 FORMAT "%8.4" /end CHARACTERISTIC
/begin CHARACTERISTIC LSUCD_tiIsolChkPer_C "Periodendauer zur Einschaltung des Pumpstroms zur Nebenschlusserkennung" VALUE 0xE53F2 Kw_Wu16 655.3500 Time_s 0.00 655.3500 FORMAT "%8.4" /end CHARACTERISTIC
/begin CHARACTERISTIC LSUCD_tiIsolChkPump_C "Einschaltdauer für Pumpstrom bei Nebenschlusserkennung" VALUE 0xE53F4 Kw_Wu16 655.3500 Time_s 0.00 655.3500 FORMAT "%8.4" /end CHARACTERISTIC
/begin CHARACTERISTIC LSUCD_tiOpnLdTstActv_C "Zeitdauer der Kabelunterbrechungsdiagnose am Anschluss Nernst-Zelle(UN) und virtuelle Masse(VM)" VALUE 0xE5400 Kw_Wu16 655.3500 Time_s 0.00 655.3500 FORMAT "%8.4" /end CHARACTERISTIC
/begin CHARACTERISTIC LSUCD_tiRiMeasDisa_C "Zeitdauer der Abschaltung der Ri-Messfrequenz" VALUE 0xE5402 Kw_Wu16 655.3500 Time_s 0.00 655.3500 FORMAT "%8.4" /end CHARACTERISTIC
/begin CHARACTERISTIC LSUCD_tiHtCoupFlt_C "Zeitkonstante Glättungsfilter in Diagnose der Heizungskopplung" VALUE 0xE53F8 Kw_Wu32 4294.9673 TimeDelay_s 0.0000010000000 4294.9673 FORMAT "%9.4" /end CHARACTERISTIC
/begin CHARACTERISTIC LSUCD_uO2MaxGrad_C "Maximale Änderung des Sauerstoff-Spannungssignals zur Freigabe der Diagnose der Heizungskopplung" VALUE 0xE53FC Kw_Ws16 320307.9 Volt -160156.4 160151.5 FORMAT "%8.1" /end CHARACTERISTIC
/begin CHARACTERISTIC LSUCD_uO2MaxRippel_C "Maximal zulässige Änderung des Sauerstoff-Spannungssignals zur Abschaltung der Heizung" VALUE 0xE53FE Kw_Ws16 320307.9 Volt -160156.4 160151.5 FORMAT "%8.1" /end CHARACTERISTIC
/begin CHARACTERISTIC LSUCD_uO2OpnLdNernstMax_C "Maximalspannung der Kabelunterbrechungsdiagnose am Anschluss Nerns-Zelle (UN)" VALUE 0xE5404 Kw_Ws16 5000.000 Volt 0.00 5000.000 FORMAT "%8.3" EXTENDED_LIMITS -160156.4 160151.5 /end CHARACTERISTIC
/begin CHARACTERISTIC LSUCD_uO2OpnLdNernstMin_C "Minimalspannung der Kabelunterbrechungsdiagnose am Anschluss Nerns-Zelle (UN)" VALUE 0xE5406 Kw_Ws16 6999.022 Volt -1999.022 5000.000 FORMAT "%8.3" EXTENDED_LIMITS -160156.4 160151.5 /end CHARACTERISTIC
/begin CHARACTERISTIC LSUCD_uO2OpnLdVirtGndMax_C "SRC-Maximalwert der Kabelunterbrechungsdiagnose am Anschluss virtuelle Masse (VM)" VALUE 0xE5408 Kw_Ws16 5097.752 Volt -97.75171 5000.000 FORMAT "%8.3" EXTENDED_LIMITS -160156.4 160151.5 /end CHARACTERISTIC
/begin CHARACTERISTIC LSUCD_uO2OpnLdVirtGndMin_C "SRC-Minimalwert der Kabelunterbrechungsdiagnose am Anschluss virtuelle Masse (VM)" VALUE 0xE540A Kw_Ws16 5498.534 Volt -498.5337 5000.000 FORMAT "%8.3" EXTENDED_LIMITS -160156.4 160151.5 /end CHARACTERISTIC
/begin CHARACTERISTIC LSUCD_uRiOpnLdTstMax_C "Maximalwert der Ri-Spannung für Kabelunterbrechungsdiagnose am Anschluss Nernst-Zelle und virtuelle Masse" VALUE 0xE540C Kw_Ws16 5200.391 Volt 0.00 5200.391 FORMAT "%8.3" EXTENDED_LIMITS -160156.4 160151.5 /end CHARACTERISTIC
/begin CHARACTERISTIC LSUCtl_tUpLim_C "Obere Widerstandsgrenze für eingeregelten Zustand" VALUE 0xE542C Kw_Ws16 950.000 Temp_Cels -50.140 899.860 FORMAT "%8.3" EXTENDED_LIMITS -3549.940 3003.560 /end CHARACTERISTIC
/begin CHARACTERISTIC LSUCtl_tLowLim_C "Untere Widerstandsgrenze für eingeregelten Zustand" VALUE 0xE542E Kw_Ws16 950.000 Temp_Cels -50.140 899.860 FORMAT "%8.3" EXTENDED_LIMITS -3549.940 3003.560 /end CHARACTERISTIC
/begin CHARACTERISTIC LSUCtl_tRiSetPoint_C "#SSD Sollwert der LSU-Heizungsregelung" VALUE 0xE5430 Kw_Ws16 950.000 Temp_Cels -50.140 899.860 FORMAT "%8.3" EXTENDED_LIMITS -3549.940 3003.560 /end CHARACTERISTIC
/begin CHARACTERISTIC LSUCtl_tHtCtlEna_C "Temperaturminimalwert für Freigabe der Regelung" VALUE 0xE5432 Kw_Ws16 950.000 Temp_Cels -50.140 899.860 FORMAT "%8.3" EXTENDED_LIMITS -3549.940 3003.560 /end CHARACTERISTIC
/begin CHARACTERISTIC LSUCtl_nHtCtlEna_C "Mindestdrehzahl für Freigabe Aufheizrampe" VALUE 0xE5434 Kw_Ws16 32767.00 EngN 0.00 32767.00 FORMAT "%8.2" EXTENDED_LIMITS -32768.00 32767.00 /end CHARACTERISTIC
/begin CHARACTERISTIC LSUCtl_dcycHtMin_C "#SSD Tastverhältnis Heizeransteuerung vor Taupunktende (Vorwärmen)" VALUE 0xE5436 Kw_Ws16 100.0000 DtyCyc 0.00 100.0000 FORMAT "%8.4" EXTENDED_LIMITS -327.6800 327.6700 /end CHARACTERISTIC
/begin CHARACTERISTIC LSUCtl_tExcMax_C "Grenzwert zur Erkennung von ""obere Schwelle bleibend überschritten""" VALUE 0xE5438 Kw_Ws16 950.000 Temp_Cels -50.140 899.860 FORMAT "%8.3" EXTENDED_LIMITS -3549.940 3003.560 /end CHARACTERISTIC
/begin CHARACTERISTIC LSUCtl_tExcMin_C "Grenzwert zur Erkennung von ""untere Schwelle bleibend nicht erreicht""" VALUE 0xE543A Kw_Ws16 950.000 Temp_Cels -50.140 899.860 FORMAT "%8.3" EXTENDED_LIMITS -3549.940 3003.560 /end CHARACTERISTIC
/begin CHARACTERISTIC LSUCtl_tiDelIniVal_C "Verzögerungszeit für die Erfassung der initialen Ansauglufttemperatur" VALUE 0xE543C Kw_Wu16 655350.0 Time_ms 0.00 655350.0 FORMAT "%8.1" /end CHARACTERISTIC
/begin CHARACTERISTIC LSUCtl_dcycRmpUp_C "#SSD Anstiegsgeschwindigkeit Aufheizkurvenrampe" VALUE 0xE5440 Kw_Wu32 655359.999847 RmpDtyCyc 0.00 655359.999847 FORMAT "%13.6" /end CHARACTERISTIC
/begin CHARACTERISTIC LSUCtl_dcycRmpDwn_C "Fallgeschwindigkeit Aufheizrampe" VALUE 0xE5444 Kw_Wu32 655359.999847 RmpDtyCyc 0.00 655359.999847 FORMAT "%13.6" /end CHARACTERISTIC
/begin CHARACTERISTIC LSUCtl_dcycStrt_CUR "#SSD Kennlinie Anfangsheizungs Tastverhältnis in Abhängigkeit von Ansauglufttemperatur bei Start" CURVE 0xE5448 Kl_Xs16_Ws16 100.0000 DtyCyc 0.00 100.0000 FORMAT "%8.4" EXTENDED_LIMITS -327.6800 327.6700
 /begin AXIS_DESCR STD_AXIS LSUCtl_tAirStrt_mp Temp_Cels 5 -50.1400 199.8600 FORMAT "%8.4" EXTENDED_LIMITS -3549.940 3003.560 DEPOSIT ABSOLUTE /end AXIS_DESCR
/end CHARACTERISTIC
/begin CHARACTERISTIC LSUCtl_tiDebRiExcMaxDef_C "Defekterkennungszeit bleibend obere Ri Schwelle überschritten" VALUE 0xE545E Kw_Wu16 655350.0 Time_ms 0.00 655350.0 FORMAT "%8.1" /end CHARACTERISTIC
/begin CHARACTERISTIC LSUCtl_tiDebRiExcMaxOk_C "Heilungszeit bleibend obere Ri Schwelle überschritten" VALUE 0xE5460 Kw_Wu16 655350.0 Time_ms 0.00 655350.0 FORMAT "%8.1" /end CHARACTERISTIC
/begin CHARACTERISTIC LSUCtl_tiDebRiExcMinDef_C "Defekterkennungszeit bleibend untere Ri Schwelle unterschritten" VALUE 0xE5462 Kw_Wu16 655350.0 Time_ms 0.00 655350.0 FORMAT "%8.1" /end CHARACTERISTIC
/begin CHARACTERISTIC LSUCtl_tiDebRiExcMinOk_C "Heilungszeit bleibend untere Ri Schwelle unterschritten" VALUE 0xE5464 Kw_Wu16 655350.0 Time_ms 0.00 655350.0 FORMAT "%8.1" /end CHARACTERISTIC
/begin CHARACTERISTIC LSUCtl_tiSens1HtDT1_C "Verzugszeit T1 des D-Gliedes der LSU Heizungsregelung Sensoren vor Katalysator" VALUE 0xE5468 Kw_Wu32 4294.9673 TimeDelay_s 0.0000010000000 4294.9673 FORMAT "%9.4" /end CHARACTERISTIC
/begin CHARACTERISTIC LSUCtl_Sens1HtDT1Kd_C "Kd Parameter der Heizungsregelung für die Sensoren vor Katalysator" VALUE 0xE546C Kw_Ws32 6553.59999847 Kd_Temp_Kelv2Dcyc -3276.80000000 3276.79999847 FORMAT "%13.8" /end CHARACTERISTIC
/begin CHARACTERISTIC LSUCtl_Sens1HtIKi_C "Ki Parameter der Heizungsregelung für die Sensoren vor Katalysator (Kleinsignalbereich)" VALUE 0xE5470 Kw_Wu32 99999.9999767 Ki_Temp_Kelv2Dcyc 0.00 99999.9999767 FORMAT "%13.7" /end CHARACTERISTIC
/begin CHARACTERISTIC LSUCtl_Sens1HtIKiPos_C "Ki Parameter der Heizungsregelung für die Sensoren vor Katalysator (positiver Großsignalbereich)" VALUE 0xE5474 Kw_Wu32 99999.9999767 Ki_Temp_Kelv2Dcyc 0.00 99999.9999767 FORMAT "%13.7" /end CHARACTERISTIC
/begin CHARACTERISTIC LSUCtl_Sens1HtIKiNeg_C "Ki Parameter der Heizungsregelung für die Sensoren vor Katalysator (negativer Großsignalbereich)" VALUE 0xE5478 Kw_Wu32 99999.9999767 Ki_Temp_Kelv2Dcyc 0.00 99999.9999767 FORMAT "%13.7" /end CHARACTERISTIC
/begin CHARACTERISTIC LSUCtl_tSens1HtIWinPos_C "Obere Fenstergrenze des I-Anteils der LSU-Heizungsregelung (Sensoren vor Katalysator)" VALUE 0xE547C Kw_Ws16 6553.500 TempDiff_Cels -3276.800 3276.700 FORMAT "%8.3" /end CHARACTERISTIC
/begin CHARACTERISTIC LSUCtl_tSens1HtIWinNeg_C "Untere Fenstergrenze des I-Anteils der LSU-Heizungsregelung (Sensoren vor Katalysator)" VALUE 0xE547E Kw_Ws16 6553.500 TempDiff_Cels -3276.800 3276.700 FORMAT "%8.3" /end CHARACTERISTIC
/begin CHARACTERISTIC LSUCtl_Sens1HtPKp_C "Kp Parameter der Heizungsregelung für die Sensoren vor Katalysator (Kleinsignalbereich)" VALUE 0xE5480 Kw_Wu32 6553.59999847 Kp_Temp_Kelv2Dcyc 0.00 6553.59999847 FORMAT "%13.8" /end CHARACTERISTIC
/begin CHARACTERISTIC LSUCtl_Sens1HtPKpPos_C "Kp Parameter der Heizungsregelung für die Sensoren vor Katalysator (positiver Großsignalbereich)" VALUE 0xE5484 Kw_Wu32 6553.59999847 Kp_Temp_Kelv2Dcyc 0.00 6553.59999847 FORMAT "%13.8" /end CHARACTERISTIC
/begin CHARACTERISTIC LSUCtl_Sens1HtPKpNeg_C "Kp Parameter der Heizungsregelung für die Sensoren vor Katalysator (negativer Großsignalbereich)" VALUE 0xE5488 Kw_Wu32 6553.59999847 Kp_Temp_Kelv2Dcyc 0.00 6553.59999847 FORMAT "%13.8" /end CHARACTERISTIC
/begin CHARACTERISTIC LSUCtl_tSens1HtPWinPos_C "Obere Fenstergrenze des P-Anteils der LSU-Heizungsregelung (Sensoren vor Katalysator)" VALUE 0xE548C Kw_Ws16 6553.500 TempDiff_Cels -3276.800 3276.700 FORMAT "%8.3" /end CHARACTERISTIC
/begin CHARACTERISTIC LSUCtl_tSens1HtPWinNeg_C "Untere Fenstergrenze des P-Anteils der LSU-Heizungsregelung (Sensoren vor Katalysator)" VALUE 0xE548E Kw_Ws16 6553.500 TempDiff_Cels -3276.800 3276.700 FORMAT "%8.3" /end CHARACTERISTIC
/begin CHARACTERISTIC LSUCtl_tiSens2HtDT1_C "Verzugszeit T1 des D-Gliedes der LSU Heizungsregelung Sensoren nach Katalysator" VALUE 0xE5490 Kw_Wu32 4294.9673 TimeDelay_s 0.0000010000000 4294.9673 FORMAT "%9.4" /end CHARACTERISTIC
/begin CHARACTERISTIC LSUCtl_Sens2HtDT1Kd_C "Kd Parameter der Heizungsregelung für die Sensoren nach Katalysator" VALUE 0xE5494 Kw_Ws32 6553.59999847 Kd_Temp_Kelv2Dcyc -3276.80000000 3276.79999847 FORMAT "%13.8" /end CHARACTERISTIC
/begin CHARACTERISTIC LSUCtl_Sens2HtIKi_C "Ki Parameter der Heizungsregelung für die Sensoren nach Katalysator (Kleinsignalbereich)" VALUE 0xE5498 Kw_Wu32 99999.9999767 Ki_Temp_Kelv2Dcyc 0.00 99999.9999767 FORMAT "%13.7" /end CHARACTERISTIC
/begin CHARACTERISTIC LSUCtl_Sens2HtIKiPos_C "Ki Parameter der Heizungsregelung für die Sensoren nach Katalysator (positiver Großsignalbereich)" VALUE 0xE549C Kw_Wu32 99999.9999767 Ki_Temp_Kelv2Dcyc 0.00 99999.9999767 FORMAT "%13.7" /end CHARACTERISTIC
/begin CHARACTERISTIC LSUCtl_Sens2HtIKiNeg_C "Ki Parameter der Heizungsregelung für die Sensoren nach Katalysator (negativer Großsignalbereich)" VALUE 0xE54A0 Kw_Wu32 99999.9999767 Ki_Temp_Kelv2Dcyc 0.00 99999.9999767 FORMAT "%13.7" /end CHARACTERISTIC
/begin CHARACTERISTIC LSUCtl_tSens2HtIWinPos_C "Obere Fenstergrenze des I-Anteils der LSU-Heizungsregelung (Sensoren nach Katalysator)" VALUE 0xE54A4 Kw_Ws16 6553.500 TempDiff_Cels -3276.800 3276.700 FORMAT "%8.3" /end CHARACTERISTIC
/begin CHARACTERISTIC LSUCtl_tSens2HtIWinNeg_C "Untere Fenstergrenze des I-Anteils der LSU-Heizungsregelung (Sensoren nach Katalysator)" VALUE 0xE54A6 Kw_Ws16 6553.500 TempDiff_Cels -3276.800 3276.700 FORMAT "%8.3" /end CHARACTERISTIC
/begin CHARACTERISTIC LSUCtl_Sens2HtPKp_C "Kp Parameter der Heizungsregelung für die Sensoren nach Katalysator (Kleinsignalbereich)" VALUE 0xE54A8 Kw_Wu32 6553.59999847 Kp_Temp_Kelv2Dcyc 0.00 6553.59999847 FORMAT "%13.8" /end CHARACTERISTIC
/begin CHARACTERISTIC LSUCtl_Sens2HtPKpPos_C "Kp Parameter der Heizungsregelung für die Sensoren nach Katalysator (positiver Großsignalbereich)" VALUE 0xE54AC Kw_Wu32 6553.59999847 Kp_Temp_Kelv2Dcyc 0.00 6553.59999847 FORMAT "%13.8" /end CHARACTERISTIC
/begin CHARACTERISTIC LSUCtl_Sens2HtPKpNeg_C "Kp Parameter der Heizungsregelung für die Sensoren nach Katalysator (negativer Großsignalbereich)" VALUE 0xE54B0 Kw_Wu32 6553.59999847 Kp_Temp_Kelv2Dcyc 0.00 6553.59999847 FORMAT "%13.8" /end CHARACTERISTIC
/begin CHARACTERISTIC LSUCtl_tSens2HtPWinPos_C "Obere Fenstergrenze des P-Anteils der LSU-Heizungsregelung (Sensoren nach Katalysator)" VALUE 0xE54B4 Kw_Ws16 6553.500 TempDiff_Cels -3276.800 3276.700 FORMAT "%8.3" /end CHARACTERISTIC
/begin CHARACTERISTIC LSUCtl_tSens2HtPWinNeg_C "Untere Fenstergrenze des P-Anteils der LSU-Heizungsregelung (Sensoren nach Katalysator)" VALUE 0xE54B6 Kw_Ws16 6553.500 TempDiff_Cels -3276.800 3276.700 FORMAT "%8.3" /end CHARACTERISTIC
/begin CHARACTERISTIC LSU_ctRgnEna_C "Zahl von Kalibrierungs-Zyklen, nach der Regeneration vorkommen soll" VALUE 0xE517C Kw_Wu8 255.0 OneToOne 0.00 255.0 FORMAT "%5.1" /end CHARACTERISTIC
/begin CHARACTERISTIC LSU_dcycMax_C "minimale Tastverhältnis-Änderung für Aktivierung Heizereinkopplungs-Diagnose" VALUE 0xE51A8 Kw_Ws16 655.3500 DtyCyc -327.6800 327.6700 FORMAT "%8.4" /end CHARACTERISTIC
/begin CHARACTERISTIC LSU_tiBattHighDebNeg_C "Entprellzeit (Übergang von high nach low) der Batteriespannungsüberwachung" VALUE 0xE51AA Kw_Wu16 655350.0 TimeDeb 0.00 655350.0 FORMAT "%8.1" /end CHARACTERISTIC
/begin CHARACTERISTIC LSU_tiBattHighDebPos_C "Entprellzeit (Übergang von low nach high) der Batteriespannungsüberwachung" VALUE 0xE51AC Kw_Wu16 655350.0 TimeDeb 0.00 655350.0 FORMAT "%8.1" /end CHARACTERISTIC
/begin CHARACTERISTIC LSU_DebDynErrDef_C "Zählerstand zur Defektentprellung Dynamikfehler" VALUE 0xE51E8 Kw_Wu16 65535.00 OneToOne 0.00 65535.00 FORMAT "%8.2" /end CHARACTERISTIC
/begin CHARACTERISTIC LSU_DebDynErrOk_C "Zählerstand zur Heilungsentprellung Dynamikfehler" VALUE 0xE51EA Kw_Wu16 65535.00 OneToOne 0.00 65535.00 FORMAT "%8.2" /end CHARACTERISTIC
/begin CHARACTERISTIC LSUCD_tiDebNoLdErrIPDef_C "Defekterkennungszeit der Kabelunterbrechungsdiagnose am Anschluss Pumpzelle (IP)" VALUE 0xE540E Kw_Wu16 655350.0 Time_ms 0.00 655350.0 FORMAT "%8.1" /end CHARACTERISTIC
/begin CHARACTERISTIC LSUCD_tiDebNoLdErrIPOk_C "Heilungsdauer der Kabelunterbrechungsdiagnose am Anschluss Pumpzelle (IP)" VALUE 0xE5410 Kw_Wu16 655350.0 Time_ms 0.00 655350.0 FORMAT "%8.1" /end CHARACTERISTIC
/begin CHARACTERISTIC LSUCD_DebOpnLdVirtGndDef_C "Defektentprellzeit der Kabelabfallerkennung am Pin Virtuelle Masse" VALUE 0xE5412 Kw_Wu16 655350.0 Time_ms 0.00 655350.0 FORMAT "%8.1" /end CHARACTERISTIC
/begin CHARACTERISTIC LSUCD_DebOpnLdVirtGndOk_C "Heilungsentprellzeit der Kabelabfallerkennung am Pin Virtuelle Masse" VALUE 0xE5414 Kw_Wu16 655350.0 Time_ms 0.00 655350.0 FORMAT "%8.1" /end CHARACTERISTIC
/begin CHARACTERISTIC LSUCD_DebOpnLdNernstDef_C "Defektentprellzeit der Kabelabfallerkennung am Pin UN" VALUE 0xE5416 Kw_Wu16 655350.0 Time_ms 0.00 655350.0 FORMAT "%8.1" /end CHARACTERISTIC
/begin CHARACTERISTIC LSUCD_DebOpnLdNernstOk_C "Heilungsentprellzeit der Kabelabfallerkennung am Pin UN" VALUE 0xE5418 Kw_Wu16 655350.0 Time_ms 0.00 655350.0 FORMAT "%8.1" /end CHARACTERISTIC
/begin CHARACTERISTIC LSU_DebO2ConcHighDef_C "Zählerstand zur Defektentprellung unplausibel hohe O2-Konzentration" VALUE 0xE51EC Kw_Wu16 65535.00 OneToOne 0.00 65535.00 FORMAT "%8.2" /end CHARACTERISTIC
/begin CHARACTERISTIC LSU_DebO2ConcHighOk_C "Zählerstand zur Heilungsentprellung unplausibel hohe O2-Konzentration" VALUE 0xE51EE Kw_Wu16 65535.00 OneToOne 0.00 65535.00 FORMAT "%8.2" /end CHARACTERISTIC
/begin CHARACTERISTIC LSU_DebO2ConcLowDef_C "Zählerstand zur Defektentprellung unplausibel niedrige O2-Konzentration" VALUE 0xE51F0 Kw_Wu16 65535.00 OneToOne 0.00 65535.00 FORMAT "%8.2" /end CHARACTERISTIC
/begin CHARACTERISTIC LSU_DebO2ConcLowOk_C "Zählerstand zur Heilungsentprellung unplausibel niedrige O2-Konzentration" VALUE 0xE51F2 Kw_Wu16 65535.00 OneToOne 0.00 65535.00 FORMAT "%8.2" /end CHARACTERISTIC
/begin CHARACTERISTIC LSU_tiOvrRunDebNeg_C "Entprellzeit (Übergang von high nach low) der Schuberkennung" VALUE 0xE51AE Kw_Wu16 655350.0 TimeDeb 0.00 655350.0 FORMAT "%8.1" /end CHARACTERISTIC
/begin CHARACTERISTIC LSU_tiOvrRunDebPos_C "Entprellzeit (Übergang von low nach high) der Schuberkennung" VALUE 0xE51B0 Kw_Wu16 655350.0 TimeDeb 0.00 655350.0 FORMAT "%8.1" /end CHARACTERISTIC
/begin CHARACTERISTIC LSUCD_tiDebLowBattErrDef_C "Defekterkennungszeit für Fehler niedrige Batteriespannung" VALUE 0xE541A Kw_Wu16 655350.0 Time_ms 0.00 655350.0 FORMAT "%8.1" /end CHARACTERISTIC
/begin CHARACTERISTIC LSUCD_tiDebLowBattErrOk_C "Heilungszeit für Fehler niedrige Batteriespannung" VALUE 0xE541C Kw_Wu16 655350.0 Time_ms 0.00 655350.0 FORMAT "%8.1" /end CHARACTERISTIC
/begin CHARACTERISTIC LSU_mAirMaxClb1_C "upper air mass threshold for calibration/regeneration of  CJ120/125 (for operating point1)" VALUE 0xE517E Kw_Ws16 6553.500 AirMassPerCyl -3276.800 3276.700 FORMAT "%8.3" /end CHARACTERISTIC
/begin CHARACTERISTIC LSU_mAirMaxClb2_C "upper air mass threshold for calibration/regeneration of CJ120/125 (for operating point2)" VALUE 0xE5180 Kw_Ws16 6553.500 AirMassPerCyl -3276.800 3276.700 FORMAT "%8.3" /end CHARACTERISTIC
/begin CHARACTERISTIC LSU_mAirMax_C "obere Luftmassen-Schwelle für Plausibilitätscheck (0 - Vollast, 1 - Teillast, 2 - Schub)" VAL_BLK 0xE51F4 Kwb_Ws16 6553.500 AirMassPerCyl -3276.800 3276.700 FORMAT "%8.3" NUMBER 3 /end CHARACTERISTIC
/begin CHARACTERISTIC LSU_mAirMinClb1_C "lower air mass threshold for calibration/regeneration of CJ120/125 (for operating point1)" VALUE 0xE5182 Kw_Ws16 6553.500 AirMassPerCyl -3276.800 3276.700 FORMAT "%8.3" /end CHARACTERISTIC
/begin CHARACTERISTIC LSU_mAirMinClb2_C "lower air mass threshold for calibration/regeneration of  CJ120/125 (for operating point2)" VALUE 0xE5184 Kw_Ws16 6553.500 AirMassPerCyl -3276.800 3276.700 FORMAT "%8.3" /end CHARACTERISTIC
/begin CHARACTERISTIC LSU_mAirMin_C "untere Luftmassenschwelle für Plausibilitäts-Check (0 - Vollast, 1 - Teillast, 2 - Schub)" VAL_BLK 0xE51FA Kwb_Ws16 6553.500 AirMassPerCyl -3276.800 3276.700 FORMAT "%8.3" NUMBER 3 /end CHARACTERISTIC
/begin CHARACTERISTIC LSUCD_tiDebCircNernstDef_C "Defekt Entprellung des Nernst Anschlusses der Lambdasonde" VALUE 0xE541E Kw_Wu16 655350.0 Time_ms 0.00 655350.0 FORMAT "%8.1" /end CHARACTERISTIC
/begin CHARACTERISTIC LSUCD_tiDebCircNernstOk_C "Heilungsentprellung des Nernst Anschlusses Lambdasensor" VALUE 0xE5420 Kw_Wu16 655350.0 Time_ms 0.00 655350.0 FORMAT "%8.1" /end CHARACTERISTIC
/begin CHARACTERISTIC LSU_nMaxClb1_C "upper engine speed  threshold for calibration/regeneration of  CJ120/125 (for operating point1)" VALUE 0xE5186 Kw_Ws16 65535.00 EngN -32768.00 32767.00 FORMAT "%8.2" /end CHARACTERISTIC
/begin CHARACTERISTIC LSU_nMaxClb2_C "lower engine speed  threshold for calibration/regeneration of CJ120/125 (for operating point2)" VALUE 0xE5188 Kw_Ws16 65535.00 EngN -32768.00 32767.00 FORMAT "%8.2" /end CHARACTERISTIC
/begin CHARACTERISTIC LSU_nMax_C "obere Drehzahlschwelle für Plausibilitäts-Check (0 - Vollast, 1 - Teillast, 2 - Schub)" VAL_BLK 0xE5200 Kwb_Ws16 65535.00 EngN -32768.00 32767.00 FORMAT "%8.2" NUMBER 3 /end CHARACTERISTIC
/begin CHARACTERISTIC LSU_nMinChkDyn_C "minimale Drehzahl zur Aktivierung Dynamiküberwachung" VALUE 0xE5206 Kw_Ws16 65535.00 EngN -32768.00 32767.00 FORMAT "%8.2" /end CHARACTERISTIC
/begin CHARACTERISTIC LSU_nMinClb1_C "lower engine speed threshold for for calibration/regeneration of  CJ120/125 (for operating point1)" VALUE 0xE518A Kw_Ws16 65535.00 EngN -32768.00 32767.00 FORMAT "%8.2" /end CHARACTERISTIC
/begin CHARACTERISTIC LSU_nMinClb2_C "lower engine speed  threshold for for calibration/regeneration of  CJ120/125 (for operating point2)" VALUE 0xE518C Kw_Ws16 65535.00 EngN -32768.00 32767.00 FORMAT "%8.2" /end CHARACTERISTIC
/begin CHARACTERISTIC LSU_nMin_C "untere Drehzahlschwelle für Plausibilitäts-Check (0 - Vollast, 1 - Teillast, 2 - Schub)" VAL_BLK 0xE5208 Kwb_Ws16 65535.00 EngN -32768.00 32767.00 FORMAT "%8.2" NUMBER 3 /end CHARACTERISTIC
/begin CHARACTERISTIC LSUCD_tiDebCircPumpDef_C "Defekt Entrpellung des Pumpstromanschlusses der Lambdasonde" VALUE 0xE5422 Kw_Wu16 655350.0 Time_ms 0.00 655350.0 FORMAT "%8.1" /end CHARACTERISTIC
/begin CHARACTERISTIC LSUCD_tiDebCircPumpOk_C "Heilungsentprellung des Pumpstromanschlusses Lambdasensor" VALUE 0xE5424 Kw_Wu16 655350.0 Time_ms 0.00 655350.0 FORMAT "%8.1" /end CHARACTERISTIC
/begin CHARACTERISTIC LSU_qDiffMax_C "Toleranzband Einspritzmenge für Stationärerkennung" VALUE 0xE520E Kw_Ws16 655.3500 InjMass -327.6800 327.6700 FORMAT "%8.4" /end CHARACTERISTIC
/begin CHARACTERISTIC LSU_qMaxClb1_C "upper fuel quantity threshold for calibration/regeneration of  CJ120/125 (for operating point1)" VALUE 0xE518E Kw_Ws16 655.3500 InjMass -327.6800 327.6700 FORMAT "%8.4" /end CHARACTERISTIC
/begin CHARACTERISTIC LSU_qMaxClb2_C "upper fuel quantity threshold for calibration/regeneration of CJ120/125 (for operating point2)" VALUE 0xE5190 Kw_Ws16 655.3500 InjMass -327.6800 327.6700 FORMAT "%8.4" /end CHARACTERISTIC
/begin CHARACTERISTIC LSU_qMax_C "obere Mengenschwelle für Plausibilitäts-Check (0 - Vollast, 1 - Teillast, 2 - Schub)" VAL_BLK 0xE5210 Kwb_Ws16 655.3500 InjMass -327.6800 327.6700 FORMAT "%8.4" NUMBER 3 /end CHARACTERISTIC
/begin CHARACTERISTIC LSU_qMinClb1_C "lower fuel quantity threshold for calibration/regeneration of CJ120/125 (for operating point1)" VALUE 0xE5192 Kw_Ws16 655.3500 InjMass -327.6800 327.6700 FORMAT "%8.4" /end CHARACTERISTIC
/begin CHARACTERISTIC LSU_qMinClb2_C "lower fuel quantity threshold for calibration/regeneration of CJ120/125 (for operating point2)" VALUE 0xE5194 Kw_Ws16 655.3500 InjMass -327.6800 327.6700 FORMAT "%8.4" /end CHARACTERISTIC
/begin CHARACTERISTIC LSU_qMin_C "untere Mengenschwelle für Plausibilitäts-Check (0 - Vollast, 1 - Teillast, 2 - Schub)" VAL_BLK 0xE5216 Kwb_Ws16 655.3500 InjMass -327.6800 327.6700 FORMAT "%8.4" NUMBER 3 /end CHARACTERISTIC
/begin CHARACTERISTIC LSU_qThresChkDyn_C "minimale Kraftstoffmenge für Aktivierung Dynamiküberwachung" VALUE 0xE521C Kw_Ws16 655.3500 InjMass -327.6800 327.6700 FORMAT "%8.4" /end CHARACTERISTIC
/begin CHARACTERISTIC LSU_qThresOvrRun_C "Mengenschwelle zur Schuberkennung" VALUE 0xE521E Kw_Ws16 655.3500 InjMass -327.6800 327.6700 FORMAT "%8.4" /end CHARACTERISTIC
/begin CHARACTERISTIC LSU_rLmbdRec_CUR "#SSD Kennlinie für Kehrwert von Lambda" CURVE 0xE51B6 Kl_Xs16_Ws16 65.53500 lambdaRecVal -32.76800 32.76700 FORMAT "%8.5"
 /begin AXIS_DESCR STD_AXIS LSU_rO2AdptLastLSU_mp O2 12 -0.3276800 0.3276700 FORMAT "%9.7" DEPOSIT ABSOLUTE /end AXIS_DESCR
/end CHARACTERISTIC
/begin CHARACTERISTIC LSU_rO2ConstVal_C "Mitte Toleranzband für Lambda-1-Erkennung" VALUE 0xE5220 Kw_Ws16 0.6553500 O2 -0.3276800 0.3276700 FORMAT "%9.7" /end CHARACTERISTIC
/begin CHARACTERISTIC LSU_tiDvtFlt_C "Filterzeitkonstante Lambda-1-Erkennung" VALUE 0xE5224 Kw_Wu32 4294.9673 TimeDelay_s 0.0000010000000 4294.9673 FORMAT "%9.4" /end CHARACTERISTIC
/begin CHARACTERISTIC LSU_rO2Lmbd1Thres_C "Toleranzband für Lambda-1-Erkennung" VALUE 0xE5228 Kw_Ws16 0.6553500 O2 -0.3276800 0.3276700 FORMAT "%9.7" /end CHARACTERISTIC
/begin CHARACTERISTIC LSU_rO2MaxVar_C "Breite des Toleranzbands für O2-Stationärerkennung" VALUE 0xE522A Kw_Ws16 0.6553500 O2 -0.3276800 0.3276700 FORMAT "%9.7" /end CHARACTERISTIC
/begin CHARACTERISTIC LSU_rO2Min_C "minimaler O2-Sollwert für Aktivierung der Lambda-1-Erkennung" VALUE 0xE522C Kw_Ws16 0.6553500 O2 -0.3276800 0.3276700 FORMAT "%9.7" /end CHARACTERISTIC
/begin CHARACTERISTIC LSU_rO2NegDvt_C "negative O2-Toleranz (0 - Vollast, 1 - Teillast, 2 - Schub)" VAL_BLK 0xE522E Kwb_Ws16 0.6553500 O2 -0.3276800 0.3276700 FORMAT "%9.7" NUMBER 3 /end CHARACTERISTIC
/begin CHARACTERISTIC LSU_rO2PosDvt_C "positive O2-Toleranz (0 - Vollast, 1 - Teillast, 2 - Schub)" VAL_BLK 0xE5234 Kwb_Ws16 0.6553500 O2 -0.3276800 0.3276700 FORMAT "%9.7" NUMBER 3 /end CHARACTERISTIC
/begin CHARACTERISTIC LSU_stChpClbActv_C "Aktivierungsflags für O2- und Ri-Kalibrierung" VALUE 0xE5196 Kw_Wu8 3.000 OneToOne 0.00 3.000 FORMAT "%5.3" EXTENDED_LIMITS 0.00 255.0 /end CHARACTERISTIC
/begin CHARACTERISTIC LSU_stEGTClbOff_C "Bitmaske zur Unterdrückung der CJ12x-Kalibrierung bei Regenerationsanforderung Abgasnachbehandlung" VALUE 0xE5198 Kw_Wu32 4294967295.00 OneToOne 0.00 4294967295.00 FORMAT "%13.2" /end CHARACTERISTIC
/begin CHARACTERISTIC LSU_stMonActv_C "Aktivierungsflags für Diagnoseroutinen" VALUE 0xE523A Kw_Wu16 65535.00 OneToOne 0.00 65535.00 FORMAT "%8.2" /end CHARACTERISTIC
/begin CHARACTERISTIC LSU_stMonMsk_C "Bitmaske zur Unterdrückung der Diagnosen im Fall einer Regenerationsanforderung der Abgasnachbehandlung" VALUE 0xE523C Kw_Wu32 4294967295.00 OneToOne 0.00 4294967295.00 FORMAT "%13.2" /end CHARACTERISTIC
/begin CHARACTERISTIC LSU_stSelPlausChkSig_C "Auswahl O2-Signal für Plausibilisierung" VALUE 0xE5240 Kw_Wu16 65535.00 OneToOne 0.00 65535.00 FORMAT "%8.2" /end CHARACTERISTIC
/begin CHARACTERISTIC LSU_swtVal_C "Freigabe oder Sperren der LSU-Funktionen - 1: ON,  0: OFF" VALUE 0xE51B2 Kw_Wu8 1.000 OneToOne 0.00 1.000 FORMAT "%5.3" EXTENDED_LIMITS 0.00 255.0 /end CHARACTERISTIC
/begin CHARACTERISTIC LSU_swtType_C "Datensatz oder EEPROM-Wert Freigabe LSU Funktion" VALUE 0xE51B3 Kw_Wu8 0.00 OneToOne 2.000 2.000 FORMAT "%5.3" EXTENDED_LIMITS 0.00 255.0 /end CHARACTERISTIC
/begin CHARACTERISTIC LSU_ti1stClb_C "Zeitdauer von SG-Start bis zu erster Kalibrierung CJ120" VALUE 0xE519C Kw_Wu16 655.3500 Time_s 0.00 655.3500 FORMAT "%8.4" /end CHARACTERISTIC
/begin CHARACTERISTIC LSU_tiDvt1Flt_C "Filterzeitkonstante für Lambda-1-Erkennung" VALUE 0xE5242 Kw_Wu16 655.3500 Time_s 0.00 655.3500 FORMAT "%8.4" /end CHARACTERISTIC
/begin CHARACTERISTIC LSU_tiO2CalcFlt_C "Filterzeitkonstante für berechneten O2-Wert" VAL_BLK 0xE5244 Kwb_Wu32 4294.9673 TimeDelay_s 0.0000010000000 4294.9673 FORMAT "%9.4" NUMBER 1 /end CHARACTERISTIC
/begin CHARACTERISTIC LSU_tiO2Eval_C "erforderliche Dauer für O2-Stationärerkennung" VALUE 0xE5248 Kw_Wu16 655.3500 Time_s 0.00 655.3500 FORMAT "%8.4" /end CHARACTERISTIC
/begin CHARACTERISTIC LSU_tiPerClb_C "Periodendauer CJ120-Kalibrierung" VALUE 0xE519E Kw_Wu16 655.3500 Time_s 0.00 655.3500 FORMAT "%8.4" /end CHARACTERISTIC
/begin CHARACTERISTIC LSU_tiSwitch_CA "maximal zulässige Werte für Flankenzeit Last->Schub" VAL_BLK 0xE524A Kwb_Wu16 655.3500 Time_s 0.00 655.3500 FORMAT "%8.4" NUMBER 1 /end CHARACTERISTIC
/begin CHARACTERISTIC LSU_tiWait1_CA "Zeitdauer für Stationärerkennung Dynamiküberwachung" VAL_BLK 0xE524C Kwb_Wu16 655.3500 Time_s 0.00 655.3500 FORMAT "%8.4" NUMBER 1 /end CHARACTERISTIC
/begin CHARACTERISTIC LSU_tiWait2_CA "maximale Zeitdauer zum Erreichen der oberen O2-Schwelle in Dynamiküberwachung" VAL_BLK 0xE524E Kwb_Wu16 655.3500 Time_s 0.00 655.3500 FORMAT "%8.4" NUMBER 1 /end CHARACTERISTIC
/begin CHARACTERISTIC LSU_tiWait3_CA "maximale Zeitdauer zum Erreichen der oberen O2-Schwelle in Dynamiküberwachung" VAL_BLK 0xE5250 Kwb_Wu16 655.3500 Time_s 0.00 655.3500 FORMAT "%8.4" NUMBER 1 /end CHARACTERISTIC
/begin CHARACTERISTIC LSU_uBattMin_C "minimale Batteriespannung" VALUE 0xE51B4 Kw_Wu16 15992.18 Volt_Batt 0.00 15992.18 FORMAT "%8.2" EXTENDED_LIMITS 0.00 1281232. /end CHARACTERISTIC
/begin CHARACTERISTIC LSU_uMinClb_C "Minimalwert zur Erkennung einer niedrigen Batteriespannung" VALUE 0xE51A0 Kw_Wu16 15992.18 Volt_Batt 0.00 15992.18 FORMAT "%8.2" EXTENDED_LIMITS 0.00 1281232. /end CHARACTERISTIC
/begin CHARACTERISTIC LSUCD_tiDebCircVirtGndDef_C "Defekt Entprellung der virtuellen Masse Lambdasensor" VALUE 0xE5426 Kw_Wu16 655350.0 Time_ms 0.00 655350.0 FORMAT "%8.1" /end CHARACTERISTIC
/begin CHARACTERISTIC LSUCD_tiDebCircVirtGndOk_C "Heilungsentprellung der virtuellen Masse Lambdasensor" VALUE 0xE5428 Kw_Wu16 655350.0 Time_ms 0.00 655350.0 FORMAT "%8.1" /end CHARACTERISTIC
/begin CHARACTERISTIC LSU_volMinFl_C "Minimales Kraftstoffvolumen im Tank" VALUE 0xE5252 Kw_Ws16 300.0000 Fl_Half_L 0.00 300.0000 FORMAT "%8.4" EXTENDED_LIMITS -1638.400 1638.350 /end CHARACTERISTIC
/begin CHARACTERISTIC LubCD_ctInitDly_C "counter for delay after initialisation" VALUE 0xE54B8 Kw_Wu16 65535.00 OneToOne 0.00 65535.00 FORMAT "%8.2" /end CHARACTERISTIC
/begin CHARACTERISTIC LubCD_ctTogErr_C "debounce counter for interface error" VALUE 0xE54BA Kw_Wu8 255.0 OneToOne 0.00 255.0 FORMAT "%5.1" /end CHARACTERISTIC
/begin CHARACTERISTIC LubCD_numDioIn_C "Digitaler Eingang für Schmierungsteiltreiber" VALUE 0xE54BB Kw_Wu8 14.0000000000 NumPinDioIn 0.00 14.0000000000 FORMAT "%13.10" /end CHARACTERISTIC
/begin CHARACTERISTIC LubCD_stLoadPwmInInv_C "PWM Input to be inverted" VALUE 0xE54BC Kw_Wu8 1.000 OneToOne 0.00 1.000 FORMAT "%5.3" EXTENDED_LIMITS 0.00 255.0 /end CHARACTERISTIC
/begin CHARACTERISTIC LubCD_swtTogVer_C "Version des Ölniveausensors (1: Temperatur und Korrekturwert)" VALUE 0xE54BD Kw_Wu8 2.000 OneToOne 0.00 2.000 FORMAT "%5.3" EXTENDED_LIMITS 0.00 255.0 /end CHARACTERISTIC
/begin CHARACTERISTIC LubCD_tiTimeOut_C "Zeitbegrenzung für LubCD-Flankenerkennung" VALUE 0xE54BE Kw_Wu16 131070000. TimeCount_2ms 0.00 131070000. FORMAT "%8.0" /end CHARACTERISTIC
/begin CHARACTERISTIC MemMon_numErrChkRam_C "#SSD Fehlertoleranzschwelle für Doppelablage und zyklischen RAM-Test" VALUE 0xC3430 Kw_Wu8 255.0 OneToOne 0.00 255.0 FORMAT "%5.1" /end CHARACTERISTIC
/begin CHARACTERISTIC MemMon_numErrChkRom_C "#SSD Fehlertoleranzschwelle für zyklischen ROM-Test" VALUE 0xC3431 Kw_Wu8 255.0 OneToOne 0.00 255.0 FORMAT "%5.1" /end CHARACTERISTIC
/begin CHARACTERISTIC MemMon_tiHealChkRam_C "#SSD Heilungszeit für Fehler in der Doppelablage und im zyklischen RAM-Test" VALUE 0xC3432 Kw_Wu8 10200. Time_ms_40ms 0.00 10200. FORMAT "%5.0" /end CHARACTERISTIC
/begin CHARACTERISTIC MemMon_tiHealChkRom_C "#SSD Heilungszeit für Fehler im zyklischen ROM-Test" VALUE 0xC3433 Kw_Wu8 10200. Time_ms_40ms 0.00 10200. FORMAT "%5.0" /end CHARACTERISTIC
/begin CHARACTERISTIC MeUnCD_uSRCMin_C "#SSD Analogeingang, Signal Range Check Min-Spannungswert" VALUE 0xE54F0 Kw_Ws16 5200.391 Volt 0.00 5200.391 FORMAT "%8.3" EXTENDED_LIMITS -160156.4 160151.5 /end CHARACTERISTIC
/begin CHARACTERISTIC MeUnCD_uSRCMax_C "#SSD Analogeingang, Signal Range Check Max-Spannungswert" VALUE 0xE54F2 Kw_Ws16 5200.391 Volt 0.00 5200.391 FORMAT "%8.3" EXTENDED_LIMITS -160156.4 160151.5 /end CHARACTERISTIC
/begin CHARACTERISTIC MeUnCD_iLin_CUR "#SSD Analogeingang, Linearisierungskennlinie" CURVE 0xE54F4 Kl_Xs16_Ws16 5000.000 Curr 0.00 5000.000 FORMAT "%8.3" EXTENDED_LIMITS -32768.00 32767.00
 /begin AXIS_DESCR STD_AXIS MeUnCD_uRawVal_mp Volt 2 0.00 5200.391 FORMAT "%8.3" EXTENDED_LIMITS -160156.4 160151.5 DEPOSIT ABSOLUTE /end AXIS_DESCR
/end CHARACTERISTIC
/begin CHARACTERISTIC MeUnCD_ctPwrStgOnMax_C "maximale Anzahl von Endstufen-Einschaltungen pro Fahrzyklus bei SCB oder Übertemperatur" VALUE 0xE54FE Kw_Wu16 65535.00 OneToOne 0.00 65535.00 FORMAT "%8.2" /end CHARACTERISTIC
/begin CHARACTERISTIC MeUnCD_dcycMax_C "#SSD Max-Wert, Ausgangstastverhältnis" VALUE 0xE5500 Kw_Ws16 100.0000 DtyCyc 0.00 100.0000 FORMAT "%8.4" EXTENDED_LIMITS -327.6800 327.6700 /end CHARACTERISTIC
/begin CHARACTERISTIC MeUnCD_dcycMin_C "#SSD Min-Wert, Ausgangstastverhältnis" VALUE 0xE5502 Kw_Ws16 100.0000 DtyCyc 0.00 100.0000 FORMAT "%8.4" EXTENDED_LIMITS -327.6800 327.6700 /end CHARACTERISTIC
/begin CHARACTERISTIC MeUnCD_dcycSetValLin_CUR "#SSD Linearisierungskurve des Tastverhältnisses der  Zumesseinheit" CURVE 0xE5504 Kl_Xs16_Ws16 100.0000 DtyCyc 0.00 100.0000 FORMAT "%8.4" EXTENDED_LIMITS -327.6800 327.6700
 /begin AXIS_DESCR STD_AXIS MeUnCD_dcycSetVal_mp DtyCyc 4 -327.6800 327.6700 FORMAT "%8.4" DEPOSIT ABSOLUTE /end AXIS_DESCR
/end CHARACTERISTIC
/begin CHARACTERISTIC MeUnCD_dcycTst_C "#SSD Tastverhältnis, das im Fehlerfall zyklisch ausgegeben wird" VALUE 0xE5516 Kw_Ws16 100.0000 DtyCyc 0.00 100.0000 FORMAT "%8.4" EXTENDED_LIMITS -327.6800 327.6700 /end CHARACTERISTIC
/begin CHARACTERISTIC MeUnCD_DebExcTempDef_C "#SSD Fehlerentprellzeit Übertemperatur" VALUE 0xE5518 Kw_Wu16 655350.0 Time_ms 0.00 655350.0 FORMAT "%8.1" /end CHARACTERISTIC
/begin CHARACTERISTIC MeUnCD_DebExcTempOk_C "#SSD Heilungsentprellzeit Übertemperatur" VALUE 0xE551A Kw_Wu16 655350.0 Time_ms 0.00 655350.0 FORMAT "%8.1" /end CHARACTERISTIC
/begin CHARACTERISTIC MeUnCD_DebNoLoadDef_C "#SSD Fehlerentprellzeit Leerlauf" VALUE 0xE551C Kw_Wu16 655350.0 Time_ms 0.00 655350.0 FORMAT "%8.1" /end CHARACTERISTIC
/begin CHARACTERISTIC MeUnCD_DebNoLoadOk_C "#SSD Heilungszeit Leerlauf" VALUE 0xE551E Kw_Wu16 655350.0 Time_ms 0.00 655350.0 FORMAT "%8.1" /end CHARACTERISTIC
/begin CHARACTERISTIC MeUnCD_DebShortCircBatDef_C "#SSD Fehlerentprellzeit Kurzschluss Batterie" VALUE 0xE5520 Kw_Wu16 655350.0 Time_ms 0.00 655350.0 FORMAT "%8.1" /end CHARACTERISTIC
/begin CHARACTERISTIC MeUnCD_DebShortCircBatOk_C "#SSD Heilungsentprellzeit Kurzschluss Batterie" VALUE 0xE5522 Kw_Wu16 655350.0 Time_ms 0.00 655350.0 FORMAT "%8.1" /end CHARACTERISTIC
/begin CHARACTERISTIC MeUnCD_DebShortCircGndDef_C "#SSD Fehlerentprellzeit Kurzschluss Masse" VALUE 0xE5524 Kw_Wu16 655350.0 Time_ms 0.00 655350.0 FORMAT "%8.1" /end CHARACTERISTIC
/begin CHARACTERISTIC MeUnCD_DebShortCircGndOk_C "#SSD Heilungsentprellzeit Kurzschluss Masse" VALUE 0xE5526 Kw_Wu16 655350.0 Time_ms 0.00 655350.0 FORMAT "%8.1" /end CHARACTERISTIC
/begin CHARACTERISTIC MeUnCD_DebSRCHighDef_C "#SSD Fehlerentprellzeit für Analogeingang SRC-High Fehler" VALUE 0xE5528 Kw_Wu16 655350.0 Time_ms 0.00 655350.0 FORMAT "%8.1" /end CHARACTERISTIC
/begin CHARACTERISTIC MeUnCD_DebSRCHighOk_C "#SSD Heilungsentprellzeit für Analogeingang SRC-High Fehler" VALUE 0xE552A Kw_Wu16 655350.0 Time_ms 0.00 655350.0 FORMAT "%8.1" /end CHARACTERISTIC
/begin CHARACTERISTIC MeUnCD_DebSRCLowDef_C "#SSD Fehlerentprellzeit Analogeingang SRC-Low Fehler" VALUE 0xE552C Kw_Wu16 655350.0 Time_ms 0.00 655350.0 FORMAT "%8.1" /end CHARACTERISTIC
/begin CHARACTERISTIC MeUnCD_DebSRCLowOk_C "#SSD Heilungsentprellzeit für Analogeingang SRC-Low Fehler" VALUE 0xE552E Kw_Wu16 655350.0 Time_ms 0.00 655350.0 FORMAT "%8.1" /end CHARACTERISTIC
/begin CHARACTERISTIC MeUnCD_facIGovInit_CUR "#SSD Initialisierungsfaktor für I-Anteil des Stromreglers als Funktion der Systemtemperatur" CURVE 0xE5530 Kl_Xs16_Ws16 2.000000 Fact 0.00 2.000000 FORMAT "%8.6" EXTENDED_LIMITS -4.000000 3.999878
 /begin AXIS_DESCR STD_AXIS FlSys_t Temp_Cels 3 -50.14000 199.8600 FORMAT "%8.4" EXTENDED_LIMITS -3549.940 3003.560 DEPOSIT ABSOLUTE /end AXIS_DESCR
/end CHARACTERISTIC
/begin CHARACTERISTIC MeUnCD_facIGovMax_C "#SSD maximaler I-Anteil" VALUE 0xE553E Kw_Ws16 1.000000 Fact 1.000000 2.000000 FORMAT "%8.6" EXTENDED_LIMITS -4.000000 3.999878 /end CHARACTERISTIC
/begin CHARACTERISTIC MeUnCD_facIGovMin_C "#SSD minimaler I-Anteil" VALUE 0xE5540 Kw_Ws16 0.5000000 Fact 0.5000000 1.000000 FORMAT "%8.6" EXTENDED_LIMITS -4.000000 3.999878 /end CHARACTERISTIC
/begin CHARACTERISTIC MeUnCD_tiFlt1PT1_C "#SSD PT1 Filter Zeitkonstante für Strom-Istwert" VALUE 0xE5544 Kw_Wu32 4294.9673 TimeDelay_s 0.0000010000000 4294.9673 FORMAT "%9.4" /end CHARACTERISTIC
/begin CHARACTERISTIC MeUnCD_tiFlt2PT1_C "#SSD PT1 Filter Zeitkonstante für Strom-Sollwert" VALUE 0xE5548 Kw_Wu32 4294.9673 TimeDelay_s 0.0000010000000 4294.9673 FORMAT "%9.4" /end CHARACTERISTIC
/begin CHARACTERISTIC MeUnCD_tiIGovDT1_C "#SSD DT1 Zeitkonstante" VALUE 0xE554C Kw_Wu32 4294.9673 TimeDelay_s 0.0000010000000 4294.9673 FORMAT "%9.4" /end CHARACTERISTIC
/begin CHARACTERISTIC MeUnCD_IGovDKd_C "#SSD DT1 Differenziationsfaktor" VALUE 0xE5550 Kw_Ws32 65535.9999847 Kd -32768.0000000 32767.9999847 FORMAT "%13.7" /end CHARACTERISTIC
/begin CHARACTERISTIC MeUnCD_IGovIKi_C "#SSD I-Glied, Kleinsignalverstärkung" VALUE 0xE5554 Kw_Wu32 122.070312472 Ki_curr2fact 0.00 122.070312472 FORMAT "%13.9" /end CHARACTERISTIC
/begin CHARACTERISTIC MeUnCD_IGovIKiPos_C "#SSD I-Glied, Verstärkung für positive Großsignale" VALUE 0xE5558 Kw_Wu32 122.070312472 Ki_curr2fact 0.00 122.070312472 FORMAT "%13.9" /end CHARACTERISTIC
/begin CHARACTERISTIC MeUnCD_IGovIKiNeg_C "#SSD I-Glied, Verstärkung für negative Großsignale" VALUE 0xE555C Kw_Wu32 122.070312472 Ki_curr2fact 0.00 122.070312472 FORMAT "%13.9" /end CHARACTERISTIC
/begin CHARACTERISTIC MeUnCD_iIGovIWinPos_C "#SSD I-Glied, Kleinsignalfenster positiv" VALUE 0xE5560 Kw_Ws16 65535.00 Curr -32768.00 32767.00 FORMAT "%8.2" /end CHARACTERISTIC
/begin CHARACTERISTIC MeUnCD_iIGovIWinNeg_C "#SSD I-Glied, Kleinsignalfenster negativ" VALUE 0xE5562 Kw_Ws16 65535.00 Curr -32768.00 32767.00 FORMAT "%8.2" /end CHARACTERISTIC
/begin CHARACTERISTIC MeUnCD_tiFltPT1Init_C "#SSD PT1 Filter Zeitkonstante während Initialisierungsphase des Stromreglers" VALUE 0xE5564 Kw_Wu32 4294.9673 TimeDelay_s 0.0000010000000 4294.9673 FORMAT "%9.4" /end CHARACTERISTIC
/begin CHARACTERISTIC MeUnCD_nDiffMax_C "#SSD maximale Differenz zwischen gefilterter Drehzahl für Kennlinie und aktueller Drehzahl um neuen Drehzahlwert zu übernehmen" VALUE 0xE5568 Kw_Ws16 6000.000 EngN 0.00 6000.000 FORMAT "%8.3" EXTENDED_LIMITS -32768.00 32767.00 /end CHARACTERISTIC
/begin CHARACTERISTIC MeUnCD_numAdc_C "#SSD Parameter für die Auswahl des Analogkanals für die Zumesseinheit" VALUE 0xE556A Kw_Wu8 26.0000000000 NumPinAdc 0.00 26.0000000000 FORMAT "%13.10" /end CHARACTERISTIC
/begin CHARACTERISTIC MeUnCD_numDia1_C "#SSD Parameter für Zuordnung der Diagnose zur 1. Endstufe der Zumesseinheit" VALUE 0xE556B Kw_Wu8 27.0000000000 NumPinDia 0.00 27.0000000000 FORMAT "%13.10" /end CHARACTERISTIC
/begin CHARACTERISTIC MeUnCD_numDia2_C "#SSD Parameter für Zuordnung der Diagnose zur 2. Endstufe der Zumesseinheit" VALUE 0xE556C Kw_Wu8 27.0000000000 NumPinDia 0.00 27.0000000000 FORMAT "%13.10" /end CHARACTERISTIC
/begin CHARACTERISTIC MeUnCD_numPwmOut_C "#SSD Parameter für die Auswahl des Hardware-Pins für die Zumesseinheit" VALUE 0xE556D Kw_Wu8 13.0000000000 NumPinPwmOut 0.00 13.0000000000 FORMAT "%13.10" /end CHARACTERISTIC
/begin CHARACTERISTIC MeUnCD_resCoil_C "#SSD Widerstandswert der Spule für die Zumesseinheit" VALUE 0xE556E Kw_Ws16 5000.000 Resist_1 0.00 5000.000 FORMAT "%8.3" EXTENDED_LIMITS -32768.00 32767.00 /end CHARACTERISTIC
/begin CHARACTERISTIC MeUnCD_stInvOut_C "#SSD Invertierungsparameter der PWM Endstufe" VALUE 0xE5570 Kw_Wu8 1.000 OneToOne 0.00 1.000 FORMAT "%5.3" EXTENDED_LIMITS 0.00 255.0 /end CHARACTERISTIC
/begin CHARACTERISTIC MeUnCD_stPwrStgDia_C "#SSD Statuswort zur Spezifikation des Abschaltverhaltens der Endstufenfehlerdiagnose Zumesseinheit" VALUE 0xE5571 Kw_Wu8 255.0 OneToOne 0.00 255.0 FORMAT "%5.1" /end CHARACTERISTIC
/begin CHARACTERISTIC MeUnCD_stSPICtl_C "Parameter zur Anzeige der verwendeten Endstufenart ( 1 = SPI fähige Endstufe, 0 = nicht SPI fähige Endstufe )" VALUE 0xE5572 Kw_Wu8 1.000 OneToOne 0.00 1.000 FORMAT "%5.3" EXTENDED_LIMITS 0.00 255.0 /end CHARACTERISTIC
/begin CHARACTERISTIC MeUnCD_swt_C "#SSD allgemeine Schalterfunktionen der Endstufe für die Zumesseinheit (Bit0: 1...Korrektur ein, 0...aus; Bit1-7: reserviert)" VALUE 0xE5573 Kw_Wu8 255.0 OneToOne 0.00 255.0 FORMAT "%5.1" /end CHARACTERISTIC
/begin CHARACTERISTIC MeUnCD_tiBtwTst_C "#SSD Zeitabstand, in dem im Fehlerfall die Endstufe getestet wird" VALUE 0xE5574 Kw_Wu16 29990.00 Time_ms 10.00000 30000.00 FORMAT "%8.2" EXTENDED_LIMITS 0.00 655350.0 /end CHARACTERISTIC
/begin CHARACTERISTIC MeUnCD_tiIGovInit_C "#SSD maximale Zeitdauer der Initialisierungsphase" VALUE 0xE5576 Kw_Wu16 655350.0 Time_ms 0.00 655350.0 FORMAT "%8.1" /end CHARACTERISTIC
/begin CHARACTERISTIC MeUnCD_tiPer_CUR "#SSD Kennlinie für Periodendauer der PWM-Endstufe" CURVE 0xE5578 Kl_Xs16_Ws16 6.400000 Period 0.1000000 6.500000 FORMAT "%8.6" EXTENDED_LIMITS -3276.800 3276.700
 /begin AXIS_DESCR STD_AXIS MeUnCD_nDiffRef_mp EngN 30 -32768.00 32767.00 FORMAT "%8.2" DEPOSIT ABSOLUTE /end AXIS_DESCR
/end CHARACTERISTIC
/begin CHARACTERISTIC MeUnCD_tiPwrStgOn_C "Zeit, für welche die Endstufe beim Fall der nicht SPI fähige Endstufe eingeschaltet wird." VALUE 0xE55F2 Kw_Wu16 655140.0 Time_ms 0.00 655140.0 FORMAT "%8.1" EXTENDED_LIMITS 0.00 655350.0 /end CHARACTERISTIC
/begin CHARACTERISTIC MeUnCD_tiDebSigDefSigTst_C "Fehlerentprellzeit fuer Fehlerpfad Dfp_MeUnCD_SigTst" VALUE 0xE55F4 Kw_Wu16 655350.0 Time_ms 0.00 655350.0 FORMAT "%8.1" /end CHARACTERISTIC
/begin CHARACTERISTIC MeUnCD_tiDebSigOkSigTst_C "Heilungsentprellzeit fuer Fehlerpfad Dfp_MeUnCD_SigTst" VALUE 0xE55F6 Kw_Wu16 655350.0 Time_ms 0.00 655350.0 FORMAT "%8.1" /end CHARACTERISTIC
/begin CHARACTERISTIC MeUn_iCnvFlowRate_CUR "#SSD Kennlinie zur Umrechnung von Volumenstrom nach Strom" CURVE 0xE54C0 Kl_Xs16_Ws16 5000.000 Curr 0.00 5000.000 FORMAT "%8.3" EXTENDED_LIMITS -32768.00 32767.00
 /begin AXIS_DESCR STD_AXIS Rail_dvolMeUnSet Qp_mm3_sec 10 -10000.00 50000.00 FORMAT "%8.2" EXTENDED_LIMITS -327680.0 327670.0 DEPOSIT ABSOLUTE /end AXIS_DESCR
/end CHARACTERISTIC
/begin CHARACTERISTIC MeUn_iSetMin_C "#SSD Sollstrom bei elektrischer Abschaltung der Zumesseinheit" VALUE 0xE54EA Kw_Ws16 65535.00 Curr -32768.00 32767.00 FORMAT "%8.2" /end CHARACTERISTIC
/begin CHARACTERISTIC MeUn_iSet_Vector "#SSD Bypass-Label für MeUn_iSet (Nicht verstellen!)" VALUE 0xC318A Kw_Wu8 255.0 OneToOne 0.00 255.0 FORMAT "%5.1" /end CHARACTERISTIC
/begin CHARACTERISTIC MeUn_iSet_Channel "#SSD Bypass-Label für MeUn_iSet, nicht editieren !" VALUE 0xC318B Kw_Wu8 255.0 OneToOne 0.00 255.0 FORMAT "%5.1" /end CHARACTERISTIC
/begin CHARACTERISTIC MeUn_pActrPrt_C "#SSD Raildruckschwelle für die Freigabe der Stellerschutzfunktion" VALUE 0xE54EC Kw_Ws16 6553.500 Pres_Rail -3276.800 3276.700 FORMAT "%5.3" /end CHARACTERISTIC
/begin CHARACTERISTIC MeUn_pFlowOfFl_C "#SSD Raildruckschwelle zum Rückschalten auf Stellwertvorgabe der Hochdruckregelung" VALUE 0xE54EE Kw_Ws16 6553.500 Pres_Rail -3276.800 3276.700 FORMAT "%5.3" /end CHARACTERISTIC
/begin CHARACTERISTIC MRlyCD_ctTooEarlyThres_C "#SSD Schwelle die MRlyCD_ctTooEarly_mp überschreiten muß bis Fehler Hauptrelais öffnet zu früh gemeldet wird" VALUE 0xE55F8 Kw_Wu8 255.0 OneToOne 0.00 255.0 FORMAT "%5.1" /end CHARACTERISTIC
/begin CHARACTERISTIC MRlyCD_numDioOutMnRly_C "#SSD application parameter for main relay" VALUE 0xE55F9 Kw_Wu8 11.0000000000 NumPinDioOut 0.00 11.0000000000 FORMAT "%13.10" /end CHARACTERISTIC
/begin CHARACTERISTIC MRlyCD_numDioOutPSOFF_C "#SSD application parameter for CY310 PSOFF bit" VALUE 0xE55FA Kw_Wu8 11.0000000000 NumPinDioOut 0.00 11.0000000000 FORMAT "%13.10" /end CHARACTERISTIC
/begin CHARACTERISTIC MRlyCD_stInvOut_C "#SSD Invertierungsparameter für Hauptrelais Ausgangssignal" VALUE 0xE55FB Kw_Wu8 1.000 OneToOne 0.00 1.000 FORMAT "%5.3" EXTENDED_LIMITS 0.00 255.0 READ_ONLY /end CHARACTERISTIC
/begin CHARACTERISTIC MRlyCD_tiNotOpen_C "#SSD Zeit nach dem Öffnen des Hauptrelais bis Fehler Hauptrelais öffnet nicht rechtzeitig erkannt wird" VALUE 0xE55FC Kw_Wu16 655350.0 Time_ms 0.00 655350.0 FORMAT "%8.1" /end CHARACTERISTIC
/begin CHARACTERISTIC MSidCD_Comm_DebNplDef_C "#SSD Fehlererkennungszeit Fehler Plausibilisierung privater CAN" VALUE 0xE55FE Kw_Wu16 655350.0 Time_ms 0.00 655350.0 FORMAT "%8.1" /end CHARACTERISTIC
/begin CHARACTERISTIC MSidCD_Comm_DebNplOk_C "Heilungszeit SG-Auswahl, Fehler Plausibilisierung privater CAN" VALUE 0xE5600 Kw_Wu16 655350.0 Time_ms 0.00 655350.0 FORMAT "%8.1" /end CHARACTERISTIC
/begin CHARACTERISTIC MSidCD_numECUS_C "#SSD Anzahl der ECU in diesem system: 1 - 4 (Master/Slave)" VALUE 0xE5602 Kw_Wu8 3.000 OneToOne 1.000 4.000 FORMAT "%5.3" EXTENDED_LIMITS 0.00 255.0 /end CHARACTERISTIC
/begin CHARACTERISTIC MSidCD_Pin_DebSigDef_C "Defekterkennungszeit SG-Asuwahl, Pinfehler" VALUE 0xE5604 Kw_Wu16 655350.0 Time_ms 0.00 655350.0 FORMAT "%8.1" /end CHARACTERISTIC
/begin CHARACTERISTIC MSidCD_Pin_DebSigOk_C "Heilungszeit SG-Auswahl, Pinfehler" VALUE 0xE5606 Kw_Wu16 655350.0 Time_ms 0.00 655350.0 FORMAT "%8.1" /end CHARACTERISTIC
/begin CHARACTERISTIC MSidCD_Select_DebNplDef_C "#SSD Defekterkennungszeit ECU Selection (Botschaften nicht plausibel)" VALUE 0xE5608 Kw_Wu16 655350.0 Time_ms 0.00 655350.0 FORMAT "%8.1" /end CHARACTERISTIC
/begin CHARACTERISTIC MSidCD_Select_DebNplOk_C "#SSD Heilungszeit SG-Auswahl (Botschaften nicht plausibel)" VALUE 0xE560A Kw_Wu16 655350.0 Time_ms 0.00 655350.0 FORMAT "%8.1" /end CHARACTERISTIC
/begin CHARACTERISTIC MSidCD_Sel_INI_DebNplDef_C "Defekterkennungszeit SG-Auswahl (NeuLernen ist nicht erlaubt)" VALUE 0xE560C Kw_Wu16 655350.0 Time_ms 0.00 655350.0 FORMAT "%8.1" /end CHARACTERISTIC
/begin CHARACTERISTIC MSidCD_Sel_INI_DebNplOk_C "Heilungszeit SG-Auswahl (NeuLernen ist nicht erlaubt)" VALUE 0xE560E Kw_Wu16 655350.0 Time_ms 0.00 655350.0 FORMAT "%8.1" /end CHARACTERISTIC
/begin CHARACTERISTIC MSidCD_Sel_INI_DebSigDef_C "Defekterkennungszeit SG-Auswahl (1.Plaus. am Beginn jedes Fahrzyklus)" VALUE 0xE5610 Kw_Wu16 655350.0 Time_ms 0.00 655350.0 FORMAT "%8.1" /end CHARACTERISTIC
/begin CHARACTERISTIC MSidCD_Sel_INI_DebSigOk_C "Heilungszeit SG-Auswahl (1.Plaus. am Beginn des Fahrzyklus)" VALUE 0xE5612 Kw_Wu16 655350.0 Time_ms 0.00 655350.0 FORMAT "%8.1" /end CHARACTERISTIC
/begin CHARACTERISTIC MSidCD_stCANprivErrMsk_C "Maske für Auswahl Error-Stati Kommunikation priv. CAN" VALUE 0xE5614 Kw_Wu16 255.0000 OneToOne 0.00 255.0000 FORMAT "%8.4" EXTENDED_LIMITS 0.00 65535.00 /end CHARACTERISTIC
/begin CHARACTERISTIC MSidCD_stErrInjOFF_C "#SSD Maske für Abschaltung Einspritzung im Fehlerfall SG-Auswahl" VALUE 0xE5616 Kw_Wu8 255.0 OneToOne 0.00 255.0 FORMAT "%5.1" /end CHARACTERISTIC
/begin CHARACTERISTIC MSidCD_stInv_C "Schalter zur Invertierung des digitalen Eingangsignals" VALUE 0xE5617 Kw_Wu8 1.000 OneToOne 0.00 1.000 FORMAT "%5.3" EXTENDED_LIMITS 0.00 255.0 /end CHARACTERISTIC
/begin CHARACTERISTIC MSidCD_swtCanDeb_C "#SSD Entprellmodus Zustandsautomat priv. CAN (1...Entprellen, 0...kein Entprellen)" VALUE 0xE5618 Kw_Ws8 255.0 OneToOne -128.0 127.0 FORMAT "%5.1" /end CHARACTERISTIC
/begin CHARACTERISTIC MSidCD_swtLearn_C "Schalter Lern-Modus Neulernen SG-Auswahl (1...lernen erlaubt, 0...lernen nicht erlaubt)" VALUE 0xE5619 Kw_Ws8 255.0 OneToOne -128.0 127.0 FORMAT "%5.1" /end CHARACTERISTIC
/begin CHARACTERISTIC MSidCD_swtMAIN_C "#SSD ID SG-Auswahl (-1/FFh...Single, 0...Master, 1...Slave, 64/40h...detection with pin)" VALUE 0xE561A Kw_Ws8 255.0 OneToOne -128.0 127.0 FORMAT "%5.1" /end CHARACTERISTIC
/begin CHARACTERISTIC MSidCD_tiCanDeb_C "#SSD Entprelltimer Status privater CAN" VALUE 0xE561C Kw_Wu16 655350.0 Time_ms 0.00 655350.0 FORMAT "%8.1" /end CHARACTERISTIC
/begin CHARACTERISTIC NetMng_CANFadeOutMaskA_C "#SSD CAN-Ausblendmaske CAN A" VALUE 0xE5620 Kw_Wu8 255.0 OneToOne 0.00 255.0 FORMAT "%5.1" /end CHARACTERISTIC
/begin CHARACTERISTIC NetMng_CANFadeOutMaskB_C "#SSD CAN-Ausblendmaske CAN B" VALUE 0xE5621 Kw_Wu8 255.0 OneToOne 0.00 255.0 FORMAT "%5.1" /end CHARACTERISTIC
/begin CHARACTERISTIC NetMng_CANFadeOutMaskC_C "CAN-Ausblendmaske CAN C" VALUE 0xE5622 Kw_Wu8 255.0 OneToOne 0.00 255.0 FORMAT "%5.1" /end CHARACTERISTIC
/begin CHARACTERISTIC NetMng_ctBusOffRetriesA_C "#SSD Zählergrenze für Recoveries nach Busoff CAN A" VALUE 0xE5623 Kw_Wu8 255.0 OneToOne 0.00 255.0 FORMAT "%5.1" /end CHARACTERISTIC
/begin CHARACTERISTIC NetMng_ctBusOffRetriesB_C "#SSD Zählergrenze für Recoveries nach Busoff CAN B" VALUE 0xE5624 Kw_Wu8 255.0 OneToOne 0.00 255.0 FORMAT "%5.1" /end CHARACTERISTIC
/begin CHARACTERISTIC NetMng_ctBusOffRetriesC_C "Zählergrenze für Recoveries nach Busoff CAN C" VALUE 0xE5625 Kw_Wu8 255.0 OneToOne 0.00 255.0 FORMAT "%5.1" /end CHARACTERISTIC
/begin CHARACTERISTIC NetMng_ctInitRetryCanA_C "#SSD Zählergrenze für Initretries CAN A" VALUE 0xE5626 Kw_Wu8 255.0 OneToOne 0.00 255.0 FORMAT "%5.1" /end CHARACTERISTIC
/begin CHARACTERISTIC NetMng_ctInitRetryCanB_C "#SSD Zählergrenze für Initretries CAN B" VALUE 0xE5627 Kw_Wu8 255.0 OneToOne 0.00 255.0 FORMAT "%5.1" /end CHARACTERISTIC
/begin CHARACTERISTIC NetMng_ctInitRetryCanC_C "Zählergrenze für Initretries CAN C" VALUE 0xE5628 Kw_Wu8 255.0 OneToOne 0.00 255.0 FORMAT "%5.1" /end CHARACTERISTIC
/begin CHARACTERISTIC NetMng_tiDebPosBusMonCanA_C "#SSD Entprellzeit CAN-Ausblendung ein Can A" VALUE 0xE562A Kw_Wu16 2000.000 TimeDeb 0.00 2000.000 FORMAT "%8.3" EXTENDED_LIMITS 0.00 655350.0 /end CHARACTERISTIC
/begin CHARACTERISTIC NetMng_tiDebNegBusMonCanA_C "#SSD Entprellzeit CAN-Ausblendung aus Can A" VALUE 0xE562C Kw_Wu16 2000.000 TimeDeb 0.00 2000.000 FORMAT "%8.3" EXTENDED_LIMITS 0.00 655350.0 /end CHARACTERISTIC
/begin CHARACTERISTIC NetMng_tiDebPosBusMonCanB_C "#SSD Entprellzeit CAN-Ausblendung ein Can B" VALUE 0xE562E Kw_Wu16 2000.000 TimeDeb 0.00 2000.000 FORMAT "%8.3" EXTENDED_LIMITS 0.00 655350.0 /end CHARACTERISTIC
/begin CHARACTERISTIC NetMng_tiDebNegBusMonCanB_C "#SSD Entprellzeit CAN-Ausblendung aus Can B" VALUE 0xE5630 Kw_Wu16 2000.000 TimeDeb 0.00 2000.000 FORMAT "%8.3" EXTENDED_LIMITS 0.00 655350.0 /end CHARACTERISTIC
/begin CHARACTERISTIC NetMng_tiDebPosBusMonCanC_C "Entprellzeit CAN-Ausblendung ein Can C" VALUE 0xE5632 Kw_Wu16 2000.000 TimeDeb 0.00 2000.000 FORMAT "%8.3" EXTENDED_LIMITS 0.00 655350.0 /end CHARACTERISTIC
/begin CHARACTERISTIC NetMng_tiDebNegBusMonCanC_C "Entprellzeit CAN-Ausblendung aus Can C" VALUE 0xE5634 Kw_Wu16 2000.000 TimeDeb 0.00 2000.000 FORMAT "%8.3" EXTENDED_LIMITS 0.00 655350.0 /end CHARACTERISTIC
/begin CHARACTERISTIC NetMng_tiDebPosBusOffCanA_C "#SSD Defektzeit Busoff Can A" VALUE 0xE5636 Kw_Wu16 2000.000 TimeDeb 0.00 2000.000 FORMAT "%8.3" EXTENDED_LIMITS 0.00 655350.0 /end CHARACTERISTIC
/begin CHARACTERISTIC NetMng_tiDebNegBusOffCanA_C "#SSD Heilzeit Busoff Can A" VALUE 0xE5638 Kw_Wu16 2000.000 TimeDeb 0.00 2000.000 FORMAT "%8.3" EXTENDED_LIMITS 0.00 655350.0 /end CHARACTERISTIC
/begin CHARACTERISTIC NetMng_tiDebPosBusOffCanB_C "#SSD Defektzeit Busoff Can B" VALUE 0xE563A Kw_Wu16 2000.000 TimeDeb 0.00 2000.000 FORMAT "%8.3" EXTENDED_LIMITS 0.00 655350.0 /end CHARACTERISTIC
/begin CHARACTERISTIC NetMng_tiDebNegBusOffCanB_C "#SSD Heilzeit Busoff Can B" VALUE 0xE563C Kw_Wu16 2000.000 TimeDeb 0.00 2000.000 FORMAT "%8.3" EXTENDED_LIMITS 0.00 655350.0 /end CHARACTERISTIC
/begin CHARACTERISTIC NetMng_tiDebPosBusOffCanC_C "Defektzeit Busoff Can C" VALUE 0xE563E Kw_Wu16 2000.000 TimeDeb 0.00 2000.000 FORMAT "%8.3" EXTENDED_LIMITS 0.00 655350.0 /end CHARACTERISTIC
/begin CHARACTERISTIC NetMng_tiDebNegBusOffCanC_C "Heilzeit Busoff Can C" VALUE 0xE5640 Kw_Wu16 2000.000 TimeDeb 0.00 2000.000 FORMAT "%8.3" EXTENDED_LIMITS 0.00 655350.0 /end CHARACTERISTIC
/begin CHARACTERISTIC NetMng_tiDebPosErrCanA_C "#SSD Defektzeit ""error active"" Can A" VALUE 0xE5642 Kw_Wu16 2000.000 TimeDeb 0.00 2000.000 FORMAT "%8.3" EXTENDED_LIMITS 0.00 655350.0 /end CHARACTERISTIC
/begin CHARACTERISTIC NetMng_tiDebNegErrCanA_C "#SSD Heilzeit ""error active"" Can A" VALUE 0xE5644 Kw_Wu16 2000.000 TimeDeb 0.00 2000.000 FORMAT "%8.3" EXTENDED_LIMITS 0.00 655350.0 /end CHARACTERISTIC
/begin CHARACTERISTIC NetMng_tiDebPosErrCanB_C "#SSD Defektzeit ""error active"" Can B" VALUE 0xE5646 Kw_Wu16 2000.000 TimeDeb 0.00 2000.000 FORMAT "%8.3" EXTENDED_LIMITS 0.00 655350.0 /end CHARACTERISTIC
/begin CHARACTERISTIC NetMng_tiDebNegErrCanB_C "#SSD Heilzeit ""error active"" Can B" VALUE 0xE5648 Kw_Wu16 2000.000 TimeDeb 0.00 2000.000 FORMAT "%8.3" EXTENDED_LIMITS 0.00 655350.0 /end CHARACTERISTIC
/begin CHARACTERISTIC NetMng_tiDebPosErrCanC_C "Defektzeit ""error active"" Can C" VALUE 0xE564A Kw_Wu16 2000.000 TimeDeb 0.00 2000.000 FORMAT "%8.3" EXTENDED_LIMITS 0.00 655350.0 /end CHARACTERISTIC
/begin CHARACTERISTIC NetMng_tiDebNegErrCanC_C "Heilzeit ""error active"" Can C" VALUE 0xE564C Kw_Wu16 2000.000 TimeDeb 0.00 2000.000 FORMAT "%8.3" EXTENDED_LIMITS 0.00 655350.0 /end CHARACTERISTIC
/begin CHARACTERISTIC NetMng_tiDebPosMonCanA_C "#SSD Entprellzeit Ausblendung für SW ein Can A" VALUE 0xE564E Kw_Wu16 2000.000 TimeDeb 0.00 2000.000 FORMAT "%8.3" EXTENDED_LIMITS 0.00 655350.0 /end CHARACTERISTIC
/begin CHARACTERISTIC NetMng_tiDebNegMonCanA_C "#SSD Entprellzeit Ausblendung für SW aus Can A" VALUE 0xE5650 Kw_Wu16 2000.000 TimeDeb 0.00 2000.000 FORMAT "%8.3" EXTENDED_LIMITS 0.00 655350.0 /end CHARACTERISTIC
/begin CHARACTERISTIC NetMng_tiDebPosMonCanB_C "#SSD Entprellzeit Ausblendung für SW ein Can B" VALUE 0xE5652 Kw_Wu16 2000.000 TimeDeb 0.00 2000.000 FORMAT "%8.3" EXTENDED_LIMITS 0.00 655350.0 /end CHARACTERISTIC
/begin CHARACTERISTIC NetMng_tiDebNegMonCanB_C "#SSD Entprellzeit Ausblendung für SW aus Can B" VALUE 0xE5654 Kw_Wu16 2000.000 TimeDeb 0.00 2000.000 FORMAT "%8.3" EXTENDED_LIMITS 0.00 655350.0 /end CHARACTERISTIC
/begin CHARACTERISTIC NetMng_tiDebPosMonCanC_C "Entprellzeit Ausblendung für SW ein Can C" VALUE 0xE5656 Kw_Wu16 2000.000 TimeDeb 0.00 2000.000 FORMAT "%8.3" EXTENDED_LIMITS 0.00 655350.0 /end CHARACTERISTIC
/begin CHARACTERISTIC NetMng_tiDebNegMonCanC_C "Entprellzeit Ausblendung für SW aus Can C" VALUE 0xE5658 Kw_Wu16 2000.000 TimeDeb 0.00 2000.000 FORMAT "%8.3" EXTENDED_LIMITS 0.00 655350.0 /end CHARACTERISTIC
/begin CHARACTERISTIC NetMng_FadeOutMaskA_C "#SSD SW-Ausblendmaske CAN A" VALUE 0xE565A Kw_Wu16 65535.00 OneToOne 0.00 65535.00 FORMAT "%8.2" /end CHARACTERISTIC
/begin CHARACTERISTIC NetMng_FadeOutMaskB_C "#SSD SW-Ausblendmaske CAN B" VALUE 0xE565C Kw_Wu16 65535.00 OneToOne 0.00 65535.00 FORMAT "%8.2" /end CHARACTERISTIC
/begin CHARACTERISTIC NetMng_FadeOutMaskC_C "SW-Ausblendmaske CAN C" VALUE 0xE565E Kw_Wu16 65535.00 OneToOne 0.00 65535.00 FORMAT "%8.2" /end CHARACTERISTIC
/begin CHARACTERISTIC NetMng_SplyVltgHysXLow_C "Untere Grenze Hysterese Versorgungsspannung" VALUE 0xE5660 Kw_Ws16 13998.04 Volt_Batt 0.00 13998.04 FORMAT "%8.2" EXTENDED_LIMITS -640625.6 640606.1 /end CHARACTERISTIC
/begin CHARACTERISTIC NetMng_SplyVltgHysXHigh_C "Obere Grenze Hysterese Versorgungsspannung" VALUE 0xE5662 Kw_Ws16 13998.04 Volt_Batt 0.00 13998.04 FORMAT "%8.2" EXTENDED_LIMITS -640625.6 640606.1 /end CHARACTERISTIC
/begin CHARACTERISTIC NetMng_SplyVltgHysYLow_C "#SSD Unterer Ausgangswert Hysterese Versorgungsspannung" VALUE 0xE5664 Kw_Ws16 0.00 OneToOne 1.000000 1.000000 FORMAT "%8.6" EXTENDED_LIMITS -32768.00 32767.00 READ_ONLY /end CHARACTERISTIC
/begin CHARACTERISTIC NetMng_SplyVltgHysYHigh_C "#SSD Oberer Ausgangswert Hysterese Versorgungsspannung" VALUE 0xE5666 Kw_Ws16 0.00 OneToOne 0.00 0.00 FORMAT "%8.2" EXTENDED_LIMITS -32768.00 32767.00 READ_ONLY /end CHARACTERISTIC
/begin CHARACTERISTIC NetMng_swtONWM_C "#SSD Enable/disable OSEK Netzwerkmanagement (0...NWM disabled, >0...NWM enabled)" VALUE 0xE561E Kw_Wu8 1.000 OneToOne 0.00 1.000 FORMAT "%5.3" EXTENDED_LIMITS 0.00 255.0 /end CHARACTERISTIC
/begin CHARACTERISTIC NetMng_tiFadeoutLowBat_C "#SSD Ausblendzeit nach Unterspannung Versorgung" VALUE 0xE5668 Kw_Wu16 327670.0 Time_ms 0.00 327670.0 FORMAT "%8.1" EXTENDED_LIMITS 0.00 655350.0 /end CHARACTERISTIC
/begin CHARACTERISTIC NetMng_tiFadeoutMin_C "Ausblendzeit nach Initialisierung" VALUE 0xE566A Kw_Wu16 327670.0 Time_ms 0.00 327670.0 FORMAT "%8.1" EXTENDED_LIMITS 0.00 655350.0 /end CHARACTERISTIC
/begin CHARACTERISTIC NetMng_tiRecoverA_C "#SSD Zeit zwischen den Recoveries Can A" VALUE 0xE566C Kw_Wu16 327670.0 Time_ms 0.00 327670.0 FORMAT "%8.1" EXTENDED_LIMITS 0.00 655350.0 /end CHARACTERISTIC
/begin CHARACTERISTIC NetMng_tiRecoverB_C "#SSD Zeit zwischen den Recoveries Can B" VALUE 0xE566E Kw_Wu16 327670.0 Time_ms 0.00 327670.0 FORMAT "%8.1" EXTENDED_LIMITS 0.00 655350.0 /end CHARACTERISTIC
/begin CHARACTERISTIC NetMng_tiRecoverC_C "Zeit zwischen den Recoveries Can C" VALUE 0xE5670 Kw_Wu16 327670.0 Time_ms 0.00 327670.0 FORMAT "%8.1" EXTENDED_LIMITS 0.00 655350.0 /end CHARACTERISTIC
/begin CHARACTERISTIC NetMng_tiTimeoutDNMT_C "Timeout for Tester Present after Disable Normal Message Transmission" VALUE 0xE5672 Kw_Wu16 16000.00 Time_ms 0.00 16000.00 FORMAT "%8.2" EXTENDED_LIMITS 0.00 655350.0 /end CHARACTERISTIC
/begin CHARACTERISTIC NSC_numPrio_C "#SSD Applikationswert für Testzwecke" VALUE 0xE5674 Kw_Wu16 65535.00 OneToOne 0.00 65535.00 FORMAT "%8.2" /end CHARACTERISTIC
/begin CHARACTERISTIC NSC_st_C "#SSD Applikationswert für Testzwecke" VALUE 0xE5678 Kw_Wu32 4294967295.00 OneToOne 0.00 4294967295.00 FORMAT "%13.2" /end CHARACTERISTIC
/begin CHARACTERISTIC OPSCD_uSRCMin_C "#SSD Threshold low value for SRC low error : Oil pressure sensor" VALUE 0xE56B8 Kw_Ws16 5200.391 Volt 0.00 5200.391 FORMAT "%8.3" EXTENDED_LIMITS -160156.4 160151.5 /end CHARACTERISTIC
/begin CHARACTERISTIC OPSCD_uSRCMax_C "#SSD Threshold high value for SRC High error: Oil pressure sensor" VALUE 0xE56BA Kw_Ws16 5200.391 Volt 0.00 5200.391 FORMAT "%8.3" EXTENDED_LIMITS -160156.4 160151.5 /end CHARACTERISTIC
/begin CHARACTERISTIC OPSCD_pLin_CUR "Linearization curve : oil pressure sensor" CURVE 0xE56BC Kl_Xs16_Ws16 1.000000 OneToOne 0.00 1.000000 FORMAT "%8.6" EXTENDED_LIMITS -32768.00 32767.00
 /begin AXIS_DESCR STD_AXIS OPSCD_uRaw_POEL_mp Volt 25 0.00 5200.391 FORMAT "%8.3" EXTENDED_LIMITS -160156.4 160151.5 DEPOSIT ABSOLUTE /end AXIS_DESCR
/end CHARACTERISTIC
/begin CHARACTERISTIC OPSCD_aMinBack_C "Statuswort für Deaktivierung der Endstufe" VALUE 0xE567C Kw_Ws16 65.53500 Acc -32.76800 32.76700 FORMAT "%8.5" /end CHARACTERISTIC
/begin CHARACTERISTIC OPSCD_aMinFor_C "Statuswort für Auflösung des Powerstages" VALUE 0xE567E Kw_Ws16 65.53500 Acc -32.76800 32.76700 FORMAT "%8.5" /end CHARACTERISTIC
/begin CHARACTERISTIC OPSCD_ctPwrStgOnMax_C "Maximaler Zähler für Powerstage On im Fehlerfall" VALUE 0xE5680 Kw_Wu16 65535.00 OneToOne 0.00 65535.00 FORMAT "%8.2" /end CHARACTERISTIC
/begin CHARACTERISTIC OPSCD_DebSRCHiDef_C "Error debounce for SRC-High error" VALUE 0xE5722 Kw_Wu16 655350.0 Time_ms 0.00 655350.0 FORMAT "%8.1" /end CHARACTERISTIC
/begin CHARACTERISTIC OPSCD_DebSRCHiOk_C "Healing debounce for SRC-High error" VALUE 0xE5724 Kw_Wu16 655350.0 Time_ms 0.00 655350.0 FORMAT "%8.1" /end CHARACTERISTIC
/begin CHARACTERISTIC OPSCD_DebSRCLoDef_C "#SSD Error debounce for SRC-Low error" VALUE 0xE5726 Kw_Wu16 655350.0 Time_ms 0.00 655350.0 FORMAT "%8.1" /end CHARACTERISTIC
/begin CHARACTERISTIC OPSCD_DebSRCLoOk_C "Healing debounce for SRC-Low error" VALUE 0xE5728 Kw_Wu16 655350.0 Time_ms 0.00 655350.0 FORMAT "%8.1" /end CHARACTERISTIC
/begin CHARACTERISTIC OPSCD_dtRmpSlpUp_C "Ramp slope up parameter" VALUE 0xE572C Kw_Wu32 65535999.9847 RmpPres 0.00 65535999.9847 FORMAT "%14.4" /end CHARACTERISTIC
/begin CHARACTERISTIC OPSCD_dtRmpSlpDwn_C "Ramp slope down parameter" VALUE 0xE5730 Kw_Wu32 65535999.9847 RmpPres 0.00 65535999.9847 FORMAT "%14.4" /end CHARACTERISTIC
/begin CHARACTERISTIC OPSCD_LampDebExcTempDef_C "endstufen fehlerentprellung" VALUE 0xE5682 Kw_Wu16 655350.0 Time_ms 0.00 655350.0 FORMAT "%8.1" /end CHARACTERISTIC
/begin CHARACTERISTIC OPSCD_LampDebExcTempOk_C "Endstufen Fehlerentprellung" VALUE 0xE5684 Kw_Wu16 655350.0 Time_ms 0.00 655350.0 FORMAT "%8.1" /end CHARACTERISTIC
/begin CHARACTERISTIC OPSCD_LampDebNoLoadDef_C "endstufen fehlerentprellung" VALUE 0xE5686 Kw_Wu16 655350.0 Time_ms 0.00 655350.0 FORMAT "%8.1" /end CHARACTERISTIC
/begin CHARACTERISTIC OPSCD_LampDebNoLoadOk_C "Endstufen Fehlerentprellung" VALUE 0xE5688 Kw_Wu16 655350.0 Time_ms 0.00 655350.0 FORMAT "%8.1" /end CHARACTERISTIC
/begin CHARACTERISTIC OPSCD_LampDebShortCircBatDef_C "endstufen fehlerentprellung" VALUE 0xE568A Kw_Wu16 655350.0 Time_ms 0.00 655350.0 FORMAT "%8.1" /end CHARACTERISTIC
/begin CHARACTERISTIC OPSCD_LampDebShortCircBatOk_C "Endstufen Fehlerentprellung" VALUE 0xE568C Kw_Wu16 655350.0 Time_ms 0.00 655350.0 FORMAT "%8.1" /end CHARACTERISTIC
/begin CHARACTERISTIC OPSCD_LampDebShortCircGndDef_C "Endstufen Fehlerentprellung" VALUE 0xE568E Kw_Wu16 655350.0 Time_ms 0.00 655350.0 FORMAT "%8.1" /end CHARACTERISTIC
/begin CHARACTERISTIC OPSCD_LampDebShortCircGndOk_C "Endstufen Fehlerentprellung" VALUE 0xE5690 Kw_Wu16 655350.0 Time_ms 0.00 655350.0 FORMAT "%8.1" /end CHARACTERISTIC
/begin CHARACTERISTIC OPSCD_nStart_C "Drehzahlschwelle beim Starten" VALUE 0xE5692 Kw_Ws16 5960.000 EngN 40.00000 6000.000 FORMAT "%8.3" EXTENDED_LIMITS -32768.00 32767.00 /end CHARACTERISTIC
/begin CHARACTERISTIC OPSCD_numAdc_C "#SSD application parameter for Engine Oil Pressure input" VALUE 0xE5734 Kw_Wu8 26.0000000000 NumPinAdc 0.00 26.0000000000 FORMAT "%13.10" /end CHARACTERISTIC
/begin CHARACTERISTIC OPSCD_numDia_C "#SSD application parameter for Oil Pressure Lamp Switch" VALUE 0xE5694 Kw_Wu8 27.0000000000 NumPinDia 0.00 27.0000000000 FORMAT "%13.10" /end CHARACTERISTIC
/begin CHARACTERISTIC OPSCD_numDioOut_C "#SSD application parameter for DPF_Regeneration" VALUE 0xE5695 Kw_Wu8 11.0000000000 NumPinDioOut 0.00 11.0000000000 FORMAT "%13.10" /end CHARACTERISTIC
/begin CHARACTERISTIC OPSCD_nZero_C "engine speed value threshold in starting case" VALUE 0xE5696 Kw_Ws16 5960.000 EngN 40.00000 6000.000 FORMAT "%8.3" EXTENDED_LIMITS -32768.00 32767.00 /end CHARACTERISTIC
/begin CHARACTERISTIC OPSCD_stLampInvOut_C "Zustand der Öldrucklampe invertiert" VALUE 0xE5698 Kw_Wu8 1.000 OneToOne 0.00 1.000 FORMAT "%5.3" EXTENDED_LIMITS 0.00 255.0 /end CHARACTERISTIC
/begin CHARACTERISTIC OPSCD_stPwrStgLampDia_C "Spezifikation des Abschaltverhaltens der Endstufendiagnose" VALUE 0xE5699 Kw_Wu8 255.0 OneToOne 0.00 255.0 FORMAT "%5.1" /end CHARACTERISTIC
/begin CHARACTERISTIC OPSCD_stSPICtl_C "Schalter ob Endstufe SPI kontrollierbar = 1 oder nicht SPI kontrollierbar = 0" VALUE 0xE569A Kw_Wu8 1.000 OneToOne 0.00 1.000 FORMAT "%5.3" EXTENDED_LIMITS 0.00 255.0 /end CHARACTERISTIC
/begin CHARACTERISTIC OPSCD_swtSigOut_C "Ölsensor Signal über CAN(1) oder DIO(0)" VALUE 0xE569B Kw_Wu8 1.000 OneToOne 0.00 1.000 FORMAT "%5.3" EXTENDED_LIMITS 0.00 255.0 /end CHARACTERISTIC
/begin CHARACTERISTIC OPSCD_tiABSDebNegBack_C "debouncezeit für fallende Flanke" VALUE 0xE569C Kw_Wu16 655350.0 TimeDeb 0.00 655350.0 FORMAT "%8.1" /end CHARACTERISTIC
/begin CHARACTERISTIC OPSCD_tiABSDebPosBack_C "Debouncezeit für positive Flanke" VALUE 0xE569E Kw_Wu16 655350.0 TimeDeb 0.00 655350.0 FORMAT "%8.1" /end CHARACTERISTIC
/begin CHARACTERISTIC OPSCD_tiABSDebNegFor_C "debouncezeit für fallende Flanke" VALUE 0xE56A0 Kw_Wu16 655350.0 TimeDeb 0.00 655350.0 FORMAT "%8.1" /end CHARACTERISTIC
/begin CHARACTERISTIC OPSCD_tiABSDebPosFor_C "Debouncezeit für positive Flanke" VALUE 0xE56A2 Kw_Wu16 655350.0 TimeDeb 0.00 655350.0 FORMAT "%8.1" /end CHARACTERISTIC
/begin CHARACTERISTIC OPSCD_tiBtwTst_C "Zeitabstand, in dem die Endstufe im Fehlerfall getestet wird" VALUE 0xE56A4 Kw_Wu16 29980.00 Time_ms 20.00000 30000.00 FORMAT "%8.2" EXTENDED_LIMITS 0.00 655350.0 /end CHARACTERISTIC
/begin CHARACTERISTIC OPSCD_tiInactiv1Back_C "status word for timer (inactivate in ABS case)" VALUE 0xE56A6 Kw_Wu16 655350.0 Time_ms 0.00 655350.0 FORMAT "%8.1" /end CHARACTERISTIC
/begin CHARACTERISTIC OPSCD_tiInactiv1For_C "status word for timer (inactivate in ABS case)" VALUE 0xE56A8 Kw_Wu16 655350.0 Time_ms 0.00 655350.0 FORMAT "%8.1" /end CHARACTERISTIC
/begin CHARACTERISTIC OPSCD_tiInactivStart_C "status word for timer inactivate in starting case" VALUE 0xE56AA Kw_Wu16 655350.0 Time_ms 0.00 655350.0 FORMAT "%8.1" /end CHARACTERISTIC
/begin CHARACTERISTIC OPSCD_tipOELDebNeg_C "debounce time for negative edge of glow control unit feedback" VALUE 0xE56AC Kw_Wu16 655350.0 TimeDeb 0.00 655350.0 FORMAT "%8.1" /end CHARACTERISTIC
/begin CHARACTERISTIC OPSCD_tipOELDebPos_C "debounce time for positive edge of glow control unit feedback" VALUE 0xE56AE Kw_Wu16 655350.0 TimeDeb 0.00 655350.0 FORMAT "%8.1" /end CHARACTERISTIC
/begin CHARACTERISTIC OPSCD_tiPwrStgOn_C "Zeit für welche die Endstufe im Fehlerfall eingeschalten wird (nur nicht SPI kontrolliert)" VALUE 0xE56B0 Kw_Wu16 655140.0 Time_ms 0.00 655140.0 FORMAT "%8.1" EXTENDED_LIMITS 0.00 655350.0 /end CHARACTERISTIC
/begin CHARACTERISTIC OPSCD_stSensIDWord_C "ID-Word for transition stage for oil pressure" VALUE 0xE5736 Kw_Wu16 65535.00 OneToOne 0.00 65535.00 FORMAT "%8.2" /end CHARACTERISTIC
/begin CHARACTERISTIC OPSCD_stPDfl_C "default value if error" VALUE 0xE5738 Kw_Ws16 1.000000 OneToOne 0.00 1.000000 FORMAT "%8.6" EXTENDED_LIMITS -32768.00 32767.00 /end CHARACTERISTIC
/begin CHARACTERISTIC OPSCD_vMinBack_C "status word for deactivation of the powerstage" VALUE 0xE56B2 Kw_Ws16 655.3500 Vel -327.6800 327.6700 FORMAT "%8.4" /end CHARACTERISTIC
/begin CHARACTERISTIC OPSCD_vMinFor_C "status word for deactivation of the powerstage" VALUE 0xE56B4 Kw_Ws16 655.3500 Vel -327.6800 327.6700 FORMAT "%8.4" /end CHARACTERISTIC
/begin CHARACTERISTIC OTSCD_uSRCMin_C "#SSD Minimalwert für SRC OTF-Sensor" VALUE 0xE573C Kw_Ws16 5200.391 Volt 0.00 5200.391 FORMAT "%8.3" EXTENDED_LIMITS -160156.4 160151.5 /end CHARACTERISTIC
/begin CHARACTERISTIC OTSCD_uSRCMax_C "#SSD Maximalwert für SRC OTF-Sensor" VALUE 0xE573E Kw_Ws16 5200.391 Volt 0.00 5200.391 FORMAT "%8.3" EXTENDED_LIMITS -160156.4 160151.5 /end CHARACTERISTIC
/begin CHARACTERISTIC OTSCD_tLin_CUR "Linearisierungskennlinie für OTF-Sensor" CURVE 0xE5740 Kl_Xs16_Ws16 950.0000 Temp_Cels -50.1400 899.8600 FORMAT "%8.4" EXTENDED_LIMITS -3549.940 3003.560
 /begin AXIS_DESCR STD_AXIS OTSCD_uRaw Volt 2 0.00 5200.391 FORMAT "%8.3" EXTENDED_LIMITS -160156.4 160151.5 DEPOSIT ABSOLUTE /end AXIS_DESCR
/end CHARACTERISTIC
/begin CHARACTERISTIC OTSCD_DebNplDef_C "#SSD OTS Fehlerentprellzeit fuer Plausibilitaet" VALUE 0xE574A Kw_Wu16 655350.0 Time_ms 0.00 655350.0 FORMAT "%8.1" /end CHARACTERISTIC
/begin CHARACTERISTIC OTSCD_DebNplOk_C "OTS Heilungsentprellzeit fuer Plausibilitaet" VALUE 0xE574C Kw_Wu16 655350.0 Time_ms 0.00 655350.0 FORMAT "%8.1" /end CHARACTERISTIC
/begin CHARACTERISTIC OTSCD_DebSigDef_C "#SSD Fehlerentprellzeit für Öltemperatur Signal von CAN" VALUE 0xE574E Kw_Wu16 655350.0 Time_ms 0.00 655350.0 FORMAT "%8.1" /end CHARACTERISTIC
/begin CHARACTERISTIC OTSCD_DebSigOk_C "Heilungsentprellzeit für Öltemperatur Signal von CAN" VALUE 0xE5750 Kw_Wu16 655350.0 Time_ms 0.00 655350.0 FORMAT "%8.1" /end CHARACTERISTIC
/begin CHARACTERISTIC OTSCD_DebSRCHighDef_C "#SSD OTS Fehlerentprellzeit fuer SRC-High" VALUE 0xE5752 Kw_Wu16 655350.0 Time_ms 0.00 655350.0 FORMAT "%8.1" /end CHARACTERISTIC
/begin CHARACTERISTIC OTSCD_DebSRCHighOk_C "OTS Heilungsentprellzeit fuer SRC-High" VALUE 0xE5754 Kw_Wu16 655350.0 Time_ms 0.00 655350.0 FORMAT "%8.1" /end CHARACTERISTIC
/begin CHARACTERISTIC OTSCD_DebSRCLowDef_C "#SSD OTS Fehlerentprellzeit fuer SRC-Low" VALUE 0xE5756 Kw_Wu16 655350.0 Time_ms 0.00 655350.0 FORMAT "%8.1" /end CHARACTERISTIC
/begin CHARACTERISTIC OTSCD_DebSRCLowOk_C "OTS Heilungsentprellzeit fuer SRC-Low" VALUE 0xE5758 Kw_Wu16 655350.0 Time_ms 0.00 655350.0 FORMAT "%8.1" /end CHARACTERISTIC
/begin CHARACTERISTIC OTSCD_numAdc_C "#SSD application paramter for engine oil temperature sensor" VALUE 0xE575A Kw_Wu8 26.0000000000 NumPinAdc 0.00 26.0000000000 FORMAT "%13.10" /end CHARACTERISTIC
/begin CHARACTERISTIC OTSCD_tiStrtOilClntPlaus_C "Zeit nach Start für Plausibilitätsprüfung OTF mit WTF" VALUE 0xE575C Kw_Wu32 42949672.9500 Time_s 0.00 42949672.9500 FORMAT "%13.4" /end CHARACTERISTIC
/begin CHARACTERISTIC OTSCD_tiDelOilClntPlaus_C "Verzögerungszeit für Plausibilitätsprüfung OTF mit WTF" VALUE 0xE5760 Kw_Wu32 42949672.9500 Time_s 0.00 42949672.9500 FORMAT "%13.4" /end CHARACTERISTIC
/begin CHARACTERISTIC OTSCD_tThresOilClntPlaus_C "Schwelle für Plausibilitätsprüfung OTF mit WTF" VALUE 0xE5764 Kw_Ws16 950.000 Temp_Cels -50.140 899.860 FORMAT "%8.3" EXTENDED_LIMITS -3549.940 3003.560 /end CHARACTERISTIC
/begin CHARACTERISTIC OTSCD_tLimOilClntPlaus_C "Plausibilitaets-Fehlergrenze fuer die Oeltemperatur" VALUE 0xE5766 Kw_Ws16 950.000 Temp_Cels -50.140 899.860 FORMAT "%8.3" EXTENDED_LIMITS -3549.940 3003.560 /end CHARACTERISTIC
/begin CHARACTERISTIC OTSCD_dtRmpSlpUp_C "Rampensteigung bei Heilung/Vorgabewert für OTF" VALUE 0xE5768 Kw_Wu32 6553598.99749 RmpTemp 1.00097656250 6553599.99847 FORMAT "%13.5" EXTENDED_LIMITS 0.00 6553599.99847 /end CHARACTERISTIC
/begin CHARACTERISTIC OTSCD_dtRmpSlpDwn_C "Rampensteigung bei Heilung/Vorgabewert für OTF" VALUE 0xE576C Kw_Wu32 6553598.99749 RmpTemp 1.00097656250 6553599.99847 FORMAT "%13.5" EXTENDED_LIMITS 0.00 6553599.99847 /end CHARACTERISTIC
/begin CHARACTERISTIC OTSCD_swtSigVal_C "Schalterwert, Signal von ADC/CAN" VALUE 0xE5770 Kw_Wu8 1.000 OneToOne 0.00 1.000 FORMAT "%5.3" EXTENDED_LIMITS 0.00 255.0 /end CHARACTERISTIC
/begin CHARACTERISTIC OTSCD_stSensIDWord_C "Geberkennwort OTF-Sensor" VALUE 0xE5772 Kw_Wu16 65535.00 OneToOne 0.00 65535.00 FORMAT "%8.2" /end CHARACTERISTIC
/begin CHARACTERISTIC OTSCD_tDfl_C "Öltemperatur Vorgabewert" VALUE 0xE5774 Kw_Ws16 950.0000 Temp_Cels -50.1400 899.8600 FORMAT "%8.4" EXTENDED_LIMITS -3549.940 3003.560 /end CHARACTERISTIC
/begin CHARACTERISTIC OvRMon_ctDebToTORQUE_DSCDef_C "Fehlerentprellung für redundante CAN Signalerfassung (ST_TORQ_TAR_DSC)" VALUE 0xC3438 Kw_Wu16 65535.00 OneToOne 0.00 65535.00 FORMAT "%8.2" /end CHARACTERISTIC
/begin CHARACTERISTIC OvRMon_ctDebToTORQUE_DSCOk_C "Heilungsentprellung für redundante CAN Signalerfassung (ST_TORQ_TAR_DSC)" VALUE 0xC343A Kw_Wu16 65535.00 OneToOne 0.00 65535.00 FORMAT "%8.2" /end CHARACTERISTIC
/begin CHARACTERISTIC OvRMon_ctDebToTORQUE_EGSDef_C "Defektentprellung der redundanten Can-Signalerfassung von ST_TORQ_TAR_GEARBX" VALUE 0xC3434 Kw_Wu16 65535.00 OneToOne 0.00 65535.00 FORMAT "%8.2" /end CHARACTERISTIC
/begin CHARACTERISTIC OvRMon_ctDebToTORQUE_EGSOk_C "Heilungsentprellung der redundanten Can-Signalerfassung von ST_TORQ_TAR_GEARBX" VALUE 0xC3436 Kw_Wu16 65535.00 OneToOne 0.00 65535.00 FORMAT "%8.2" /end CHARACTERISTIC
/begin CHARACTERISTIC OvRMon_ctDebToTORQUE_SSGDef_C "Fehlerentprellung der redundanten Can-Signalerfassung von ST_TORQ_TAR_SSG" VALUE 0xC343C Kw_Wu16 65535.00 OneToOne 0.00 65535.00 FORMAT "%8.2" /end CHARACTERISTIC
/begin CHARACTERISTIC OvRMon_ctDebToTORQUE_SSGOk_C "Heilungsentprellung der redundanten Can-Signalerfassung von ST_TORQ_TAR_SSG" VALUE 0xC343E Kw_Wu16 65535.00 OneToOne 0.00 65535.00 FORMAT "%8.2" /end CHARACTERISTIC
/begin CHARACTERISTIC OvRMon_ctEngSpdGrad_C "#SSD Zähler zum Erkennen eines positiven Drehzahlgradients" VALUE 0xC31B2 Kw_Wu16 65535.00 OneToOne 0.00 65535.00 FORMAT "%8.2" /end CHARACTERISTIC
/begin CHARACTERISTIC OvRMon_DebETDef_C "#SSD Defekt Entprellzeit wenn Ansteuerdauer größer Grenzwert" VALUE 0xC31B4 Kw_Wu16 65535.00 OneToOne 0.00 65535.00 FORMAT "%8.2" /end CHARACTERISTIC
/begin CHARACTERISTIC OvRMon_DebSigA0Def_C "#SSD Defekterkennungszeit für Drehzahlplausibilisierung in Schubüberwachung" VALUE 0xC3240 Kw_Wu16 655350.0 TimeDeb 0.00 655350.0 FORMAT "%8.1" /end CHARACTERISTIC
/begin CHARACTERISTIC OvRMon_facInjEff_MAP "#SSD Wirkungsfaktorkennfeld in der Schubüberwachung" MAP 0xC3250 Kf_Xs16_Ys16_Ws16 1.000000 Fact 0.00 1.000000 FORMAT "%8.6" EXTENDED_LIMITS -4.000000 3.999878
 /begin AXIS_DESCR STD_AXIS Eng_nAvrg EngN 16 0.00 6000.000 FORMAT "%8.3" EXTENDED_LIMITS -32768.00 32767.00 DEPOSIT ABSOLUTE /end AXIS_DESCR
 /begin AXIS_DESCR STD_AXIS OvRMon_phiInjAct_mp AngleCrS 12 -720.0000 720.0000 FORMAT "%8.4" EXTENDED_LIMITS -768.0000 767.9766 DEPOSIT ABSOLUTE /end AXIS_DESCR
/end CHARACTERISTIC
/begin CHARACTERISTIC OvRMon_nDiffMax_C "#SSD Maximal zulässige Abweichung der Drehzahlen Ebene1 - Ebene 2" VALUE 0xC3242 Kw_Ws16 5960.000 EngN 40.00000 6000.000 FORMAT "%8.3" EXTENDED_LIMITS -32768.00 32767.00 /end CHARACTERISTIC
/begin CHARACTERISTIC OvRMon_nLIGovLim_C "#SSD Grenze Kurbelwellen Drehzahl für aktive Leerlaufregler Überwachung" VALUE 0xC31B6 Kw_Ws16 6000.000 EngN 0.00 6000.000 FORMAT "%8.3" EXTENDED_LIMITS -32768.00 32767.00 /end CHARACTERISTIC
/begin CHARACTERISTIC OvRMon_nMin_C "#SSD Drehzahlschwelle zur Aktivierung der Schubüberwachung" VALUE 0xC31B8 Kw_Ws16 6000.000 EngN 0.00 6000.000 FORMAT "%8.3" EXTENDED_LIMITS -32768.00 32767.00 /end CHARACTERISTIC
/begin CHARACTERISTIC OvRMon_nSegMax_C "Ersatzwert für Segmentdrehzahl bei Unterschreitung der Mindestsegmentdauer" VALUE 0xC3244 Kw_Ws16 5960.000 EngN 40.00000 6000.000 FORMAT "%8.3" EXTENDED_LIMITS -32768.00 32767.00 /end CHARACTERISTIC
/begin CHARACTERISTIC OvRMon_nSegMin_C "#SSD Mindestdrehzahl zur Aktivierung der Drehzahlplausibilisierung" VALUE 0xC3246 Kw_Ws16 5960.000 EngN 40.00000 6000.000 FORMAT "%8.3" EXTENDED_LIMITS -32768.00 32767.00 /end CHARACTERISTIC
/begin CHARACTERISTIC OvRMon_nStSysLim_C "#SSD Grenze Kurbelwellen Drehzahl für aktive Startsystem Überwachung" VALUE 0xC31BA Kw_Ws16 6000.000 EngN 0.00 6000.000 FORMAT "%8.3" EXTENDED_LIMITS -32768.00 32767.00 /end CHARACTERISTIC
/begin CHARACTERISTIC OvRMon_nThresNrml2Strt_C "#SSD Grenze Kurbelwellen Drehzahl inaktive Startsystem Überwachung" VALUE 0xC31BC Kw_Ws16 6000.000 EngN 0.00 6000.000 FORMAT "%8.3" EXTENDED_LIMITS -32768.00 32767.00 /end CHARACTERISTIC
/begin CHARACTERISTIC OvRMon_stIntrInit_C "#SSD Kennung für Interruptstatus" VALUE 0xC3248 Kw_Wu8 255.0 OneToOne 0.00 255.0 FORMAT "%5.1" /end CHARACTERISTIC
/begin CHARACTERISTIC OvRMon_tiAPP1Flt_C "#SSD Wartezeit Fahrpedalfilterung, Führungsformung in der Schubüberwachung" VALUE 0xC31BE Kw_Wu16 655350.0 TimeDeb 0.00 655350.0 FORMAT "%8.1" /end CHARACTERISTIC
/begin CHARACTERISTIC OvRMon_tiASDdc_C "#SSD Wartezeit Eingriff Störungsregler aktiv" VALUE 0xC31C0 Kw_Wu16 655350.0 TimeDeb 0.00 655350.0 FORMAT "%8.1" /end CHARACTERISTIC
/begin CHARACTERISTIC OvRMon_tiCompAcsTemp_C "#SSD Wartezeit Kompensation Nebenaggregate in der Schubüberwachung" VALUE 0xC31C2 Kw_Wu16 655350.0 TimeDeb 0.00 655350.0 FORMAT "%8.1" /end CHARACTERISTIC
/begin CHARACTERISTIC OvRMon_tiCrCtlBrkRmp_C "#SSD Wartezeit Fahrgeschwindigkeitsregler-Ausschaltrampe nach Bremse in der Schubüberwachung" VALUE 0xC31C4 Kw_Wu16 655350.0 TimeDeb 0.00 655350.0 FORMAT "%8.1" /end CHARACTERISTIC
/begin CHARACTERISTIC OvRMon_tiCrCtlConvRmp_C "#SSD Wartezeit Fahrgeschwindigkeitsregler-Ausschaltrampe nach Kupplung in der Schubüberwachung" VALUE 0xC31C6 Kw_Wu16 655350.0 TimeDeb 0.00 655350.0 FORMAT "%8.1" /end CHARACTERISTIC
/begin CHARACTERISTIC OvRMon_tiDebBrk_C "#SSD Entprellzeit für redundante Erfassung des Bremssignals" VALUE 0xC323A Kw_Wu8 2550. TimeDeb 0.00 2550. FORMAT "%5.0" /end CHARACTERISTIC
/begin CHARACTERISTIC OvRMon_tiDebConv_C "#SSD Entprellzeit für redundante Erfassung des Kupplungssignals" VALUE 0xC323B Kw_Wu8 2550. TimeDeb 0.00 2550. FORMAT "%5.0" /end CHARACTERISTIC
/begin CHARACTERISTIC OvRMon_tiDebT15_C "#SSD Entprellzeit für redundante Erfassung der Klemme 15" VALUE 0xC323C Kw_Wu8 2550. TimeDeb 0.00 2550. FORMAT "%5.0" /end CHARACTERISTIC
/begin CHARACTERISTIC OvRMon_tiEngSpdRlsBrkRmp_C "Entprellzeit des Bremssignals im Falle der allgemeinen Drehzahlanforderung" VALUE 0xC31C8 Kw_Wu16 655350.0 TimeDeb 0.00 655350.0 FORMAT "%8.1" /end CHARACTERISTIC
/begin CHARACTERISTIC OvRMon_tiErrAPP_C "#SSD Fehlerentprellzeit für Fahrpedalüberwachung" VALUE 0xC3232 Kw_Wu8 10200. Time_ms_40ms 0.00 10200. FORMAT "%5.0" /end CHARACTERISTIC
/begin CHARACTERISTIC OvRMon_tiErrDblStorage_C "#SSD Entprellzeit für Fehler in der Doppelablage" VALUE 0xC31CA Kw_Wu8 5100. Time_ms_20ms 0.00 5100. FORMAT "%5.0" /end CHARACTERISTIC
/begin CHARACTERISTIC OvRMon_tiLimET_MAP "#SSD zulässige Ansteuerdauer abhängig von Drehzahl und Zeit nach Aktivierung der Schubüberwachung" MAP 0xC31CC Kf_Xs16_Ys16_Ws16 32767.00 InjTime_us 0.00 32767.00 FORMAT "%8.2" EXTENDED_LIMITS -32768.00 32767.00
 /begin AXIS_DESCR STD_AXIS OvRMon_nAvrg EngN 6 0.00 6000.000 FORMAT "%8.3" EXTENDED_LIMITS -32768.00 32767.00 DEPOSIT ABSOLUTE /end AXIS_DESCR
 /begin AXIS_DESCR STD_AXIS OvRMon_tiOvRMonActive_mp Time_ms 6 0.00 5000.000 FORMAT "%8.3" EXTENDED_LIMITS -327680.0 327670.0 DEPOSIT ABSOLUTE /end AXIS_DESCR
/end CHARACTERISTIC
/begin CHARACTERISTIC OvRMon_tiSegMin_C "#SSD Mindestsegmentdauer für Übernahme der Segmentdrehzahl aus Systemzeit" VALUE 0xC324C Kw_Wu32 4294967295.00 TimeUSResolution 0.00 4294967295.00 FORMAT "%13.2" /end CHARACTERISTIC
/begin CHARACTERISTIC OvRMon_uAPP1Lim_C "#SSD Spannungsgrenze für Überwachung Pedalwertgeber, Leergasschwelle der Überwachung" VALUE 0xC3230 Kw_Ws16 5200.391 Volt 0.00 5200.391 FORMAT "%8.3" EXTENDED_LIMITS -160156.4 160151.5 /end CHARACTERISTIC
/begin CHARACTERISTIC OvRMon_uAPPFull_C "#SSD Spannungsgrenze für Fahrpedal im Volllastbereich" VALUE 0xC3234 Kw_Ws16 5200.391 Volt 0.00 5200.391 FORMAT "%8.3" EXTENDED_LIMITS -160156.4 160151.5 /end CHARACTERISTIC
/begin CHARACTERISTIC OvRMon_uPlaWinFull_C "#SSD Plausibilitätsfenster für Fahrpedal im Volllastbereich" VALUE 0xC3236 Kw_Ws16 5200.391 Volt 0.00 5200.391 FORMAT "%8.3" EXTENDED_LIMITS -160156.4 160151.5 /end CHARACTERISTIC
/begin CHARACTERISTIC OvRMon_uPlaWinIdle_C "#SSD Plausibilitätsfenster für Fahpedal im Leerlaufbereich" VALUE 0xC3238 Kw_Ws16 5200.391 Volt 0.00 5200.391 FORMAT "%8.3" EXTENDED_LIMITS -160156.4 160151.5 /end CHARACTERISTIC
/begin CHARACTERISTIC OxiCCD_uSRCMinTPre_C "Minimalwert SRC-Überwachung von OxiCCD_uRawTempPre" VALUE 0xE5778 Kw_Ws16 5200.391 Volt 0.00 5200.391 FORMAT "%8.3" EXTENDED_LIMITS -160156.4 160151.5 /end CHARACTERISTIC
/begin CHARACTERISTIC OxiCCD_uSRCMaxTPre_C "Maximalwert SRC-Überwachung von OxiCCD_uRawTempPre" VALUE 0xE577A Kw_Ws16 5200.391 Volt 0.00 5200.391 FORMAT "%8.3" EXTENDED_LIMITS -160156.4 160151.5 /end CHARACTERISTIC
/begin CHARACTERISTIC OxiCCD_tLinPre_CUR "Linearisierungskennlinie für OxiCCD_uRawTempPre" CURVE 0xE577C Kl_Xs16_Ws16 950.000 Temp_Cels -50.140 899.860 FORMAT "%8.3" EXTENDED_LIMITS -3549.940 3003.560
 /begin AXIS_DESCR STD_AXIS OxiCCD_uRawTempPre Volt 16 0.00 160151.5 FORMAT "%8.1" EXTENDED_LIMITS -160156.4 160151.5 DEPOSIT ABSOLUTE /end AXIS_DESCR
/end CHARACTERISTIC
/begin CHARACTERISTIC OxiCCD_DebSRCHighDefTPre_C "Entprellzeit für Fehlererkennung SRC-high-Fehler für Dfp_OxiCCDTPre" VALUE 0xE57BE Kw_Wu16 655350.0 Time_ms 0.00 655350.0 FORMAT "%8.1" /end CHARACTERISTIC
/begin CHARACTERISTIC OxiCCD_DebSRCHighOkTPre_C "Entprellzeit für Fehlerheilung SRC-high-Fehler für Dfp_OxiCCDTPre" VALUE 0xE57C0 Kw_Wu16 655350.0 Time_ms 0.00 655350.0 FORMAT "%8.1" /end CHARACTERISTIC
/begin CHARACTERISTIC OxiCCD_DebSRCLowDefTPre_C "Entprellzeit für Fehlererkennung SRC-low-Fehler für Dfp_OxiCCDTPre" VALUE 0xE57C2 Kw_Wu16 655350.0 Time_ms 0.00 655350.0 FORMAT "%8.1" /end CHARACTERISTIC
/begin CHARACTERISTIC OxiCCD_DebSRCLowOkTPre_C "Entprellzeit für Fehlerheilung SRC-low-Fehler für Dfp_OxiCCDTPre" VALUE 0xE57C4 Kw_Wu16 655350.0 Time_ms 0.00 655350.0 FORMAT "%8.1" /end CHARACTERISTIC
/begin CHARACTERISTIC OxiCCD_numTempPreADC_C "Zahl zur Auswahl des ADC-Kanals" VALUE 0xE57C6 Kw_Wu8 26.0000000000 NumPinAdc 0.00 26.0000000000 FORMAT "%13.10" /end CHARACTERISTIC
/begin CHARACTERISTIC OxiCCD_dtRmpSlpUpPre_C "Rampensteigung aufwärts für Komponententreiber Temperatur vor Oxidationskatalysator" VALUE 0xE57C8 Kw_Wu32 6553598.99749 RmpTemp 1.00097656250 6553599.99847 FORMAT "%13.5" EXTENDED_LIMITS 0.00 6553599.99847 /end CHARACTERISTIC
/begin CHARACTERISTIC OxiCCD_dtRmpSlpDwnPre_C "Rampensteigung abwärts für Komponententreiber Temperatur vor Oxidationskatalysator" VALUE 0xE57CC Kw_Wu32 6553598.99749 RmpTemp 1.00097656250 6553599.99847 FORMAT "%13.5" EXTENDED_LIMITS 0.00 6553599.99847 /end CHARACTERISTIC
/begin CHARACTERISTIC OxiCCD_stSensIDWordTPre_C "Sensor ID Word für Übergangsbedingungen Temperatursensor vor Oxidationskatalysator" VALUE 0xE57D0 Kw_Wu16 65535.00 OneToOne 0.00 65535.00 FORMAT "%8.2" /end CHARACTERISTIC
/begin CHARACTERISTIC OxiCCD_tDflPre_C "Ersatzwert Temperatur vor Oxidationskatalysator im Fehlerfall" VALUE 0xE57D2 Kw_Ws16 950.000 Temp_Cels -50.140 899.860 FORMAT "%8.3" EXTENDED_LIMITS -3549.940 3003.560 /end CHARACTERISTIC
/begin CHARACTERISTIC PCBS_facFlTotDMEChg_C "liter calculation in the case of DME change" VALUE 0xE57D4 Kw_Ws16 65535.00 OneToOne -32768.00 32767.00 FORMAT "%8.2" /end CHARACTERISTIC
/begin CHARACTERISTIC PCBS_lCalcDistance_CUR "Curve for calculation of rest distance" CURVE 0xE57D6 Kl_Xs16_Ws16 35000.00 km_sw_q10 -5000.000 30000.00 FORMAT "%8.2" EXTENDED_LIMITS -327680.0 327670.0
 /begin AXIS_DESCR STD_AXIS PFlt_mAshOil mSoot_g 8 0.00 15.00000 FORMAT "%8.5" EXTENDED_LIMITS -327.6800 327.6700 DEPOSIT ABSOLUTE /end AXIS_DESCR
/end CHARACTERISTIC
/begin CHARACTERISTIC PCBS_qCalcFlTot_CUR "curve for calculation of the used liters" CURVE 0xE57F8 Kl_Xs16_Ws16 320.0000 Fl_2 0.00 320.0000 FORMAT "%8.4" EXTENDED_LIMITS -327680.0 327670.0
 /begin AXIS_DESCR STD_AXIS PCBS_dAvaiDMEChg_mp OneToOne 8 0.00 100.0 FORMAT "%5.1" EXTENDED_LIMITS 0.00 255.0 DEPOSIT ABSOLUTE /end AXIS_DESCR
/end CHARACTERISTIC
/begin CHARACTERISTIC PCR_dnSurgeHigh_CUR "Higher limit for hysteresis to monitor rate of change of Eng_nAvrg for Anti-Surge LIGov" CURVE 0xE6EF0 Kl_Xs16_Ws16 3000.000 dn_dZ20 0.00 3000.000 FORMAT "%8.3" EXTENDED_LIMITS -327680.0 327670.0
 /begin AXIS_DESCR STD_AXIS Eng_nAvrg EngN 5 0.00 6000.000 FORMAT "%8.3" EXTENDED_LIMITS -32768.00 32767.00 DEPOSIT ABSOLUTE /end AXIS_DESCR
/end CHARACTERISTIC
/begin CHARACTERISTIC PCR_dnSurgeLow_CUR "Lower limit for hysteresis to monitor rate of change of Eng_nAvrg for Anti-Surge LIGov" CURVE 0xE6F06 Kl_Xs16_Ws16 3000.000 dn_dZ20 0.00 3000.000 FORMAT "%8.3" EXTENDED_LIMITS -327680.0 327670.0
 /begin AXIS_DESCR STD_AXIS Eng_nAvrg EngN 5 0.00 6000.000 FORMAT "%8.3" EXTENDED_LIMITS -32768.00 32767.00 DEPOSIT ABSOLUTE /end AXIS_DESCR
/end CHARACTERISTIC
/begin CHARACTERISTIC PCR_drSurge2RmpUp_C "Rampe Up AntiSurge - PCR_rCtlVal" VALUE 0xE581C Kw_Wu32 3999.99991059 RmpPrc 0.00 3999.99991059 FORMAT "%13.8" EXTENDED_LIMITS 0.00 799999.999814 /end CHARACTERISTIC
/begin CHARACTERISTIC PCR_drSurge2RmpDwn_C "Rampe Down AntiSurge - PCR_rCtlVal" VALUE 0xE5820 Kw_Wu32 3999.99991059 RmpPrc 0.00 3999.99991059 FORMAT "%13.8" EXTENDED_LIMITS 0.00 799999.999814 /end CHARACTERISTIC
/begin CHARACTERISTIC PCR_facBPCtlBasCorr_CUR "Correcting factor of boost pressure control value according to particle filter soot mass" CURVE 0xE5824 Kl_Xs16_Ws16 5.000000 Fact 0.00 5.000000 FORMAT "%8.6" EXTENDED_LIMITS -4.000000 3.999878
 /begin AXIS_DESCR STD_AXIS PFlt_mSot mSoot_g 8 0.00 300.0000 FORMAT "%8.4" EXTENDED_LIMITS -327.6800 327.6700 DEPOSIT ABSOLUTE /end AXIS_DESCR
/end CHARACTERISTIC
/begin CHARACTERISTIC PCR_facBPCtlBasRgn1Corr_CUR "correcting factor of boost pressure control value for regeneration according to particle filter soot mass" CURVE 0xE5846 Kl_Xs16_Ws16 5.000000 Fact 0.00 5.000000 FORMAT "%8.6" EXTENDED_LIMITS -4.000000 3.999878
 /begin AXIS_DESCR STD_AXIS PFlt_mSot mSoot_g 8 0.00 300.0000 FORMAT "%8.4" EXTENDED_LIMITS -327.6800 327.6700 DEPOSIT ABSOLUTE /end AXIS_DESCR
/end CHARACTERISTIC
/begin CHARACTERISTIC PCR_facCtlAPRgn_MAP "Offset on boost pressure regeneration control value according to intake air pressure" MAP 0xE5868 Kf_Xs16_Ys16_Ws16 5.000000 Fact 0.00 5.000000 FORMAT "%8.6" EXTENDED_LIMITS -4.000000 3.999878
 /begin AXIS_DESCR STD_AXIS Eng_nAvrg EngN 10 0.00 8000.000 FORMAT "%8.3" EXTENDED_LIMITS -32768.00 32767.00 DEPOSIT ABSOLUTE /end AXIS_DESCR
 /begin AXIS_DESCR STD_AXIS APSCD_pVal Pres_hPa 12 0.00 3500.000 FORMAT "%8.3" EXTENDED_LIMITS -32768.00 32767.00 DEPOSIT ABSOLUTE /end AXIS_DESCR
/end CHARACTERISTIC
/begin CHARACTERISTIC PCR_facCtlAP_MAP "Kennfeld für atmosphärendruckabhängige Korrektur für Steuerung" MAP 0xE5988 Kf_Xs16_Ys16_Ws16 5.000000 Fact 0.00 5.000000 FORMAT "%8.6" EXTENDED_LIMITS -4.000000 3.999878
 /begin AXIS_DESCR STD_AXIS Eng_nAvrg EngN 10 0.00 8000.000 FORMAT "%8.3" EXTENDED_LIMITS -32768.00 32767.00 DEPOSIT ABSOLUTE /end AXIS_DESCR
 /begin AXIS_DESCR STD_AXIS APSCD_pVal Pres_hPa 12 0.00 3500.000 FORMAT "%8.3" EXTENDED_LIMITS -32768.00 32767.00 DEPOSIT ABSOLUTE /end AXIS_DESCR
/end CHARACTERISTIC
/begin CHARACTERISTIC PCR_facCtlATRgn_CUR "Kennlinie für lufttemperaturabhängingen Korrekturfaktor für Ladedruckregelung bei Regenerationsbetrieb" CURVE 0xE5AA8 Kl_Xs16_Ws16 3.000000 Fact 0.00 3.000000 FORMAT "%8.6" EXTENDED_LIMITS -4.000000 3.999878
 /begin AXIS_DESCR STD_AXIS IATSCD_tAir Temp_Cels 6 -50.1400 199.8600 FORMAT "%8.4" EXTENDED_LIMITS -3549.940 3003.560 DEPOSIT ABSOLUTE /end AXIS_DESCR
/end CHARACTERISTIC
/begin CHARACTERISTIC PCR_facCtlIAT_CUR "Kennlinie für lufttemperaturabhängigen Korrekturfaktor für Ladedrucksteuerung" CURVE 0xE5AC2 Kl_Xs16_Ws16 3.000000 Fact 0.00 3.000000 FORMAT "%8.6" EXTENDED_LIMITS -4.000000 3.999878
 /begin AXIS_DESCR STD_AXIS IATSCD_tAir Temp_Cels 6 -50.1400 199.8600 FORMAT "%8.4" EXTENDED_LIMITS -3549.940 3003.560 DEPOSIT ABSOLUTE /end AXIS_DESCR
/end CHARACTERISTIC
/begin CHARACTERISTIC PCR_nLIGovBase_C "#SSD LL-Solldrehzahl bei Anti-Surge inaktiv" VALUE 0xE6F1C Kw_Ws16 6000.000 EngN 0.00 6000.000 FORMAT "%8.3" EXTENDED_LIMITS -32768.00 32767.00 /end CHARACTERISTIC
/begin CHARACTERISTIC PCR_nSetPointLIGov_C "LIGov set point for Anti_Surge" VALUE 0xE6F1E Kw_Ws16 6000.000 EngN 0.00 6000.000 FORMAT "%8.3" EXTENDED_LIMITS -32768.00 32767.00 /end CHARACTERISTIC
/begin CHARACTERISTIC PCR_nSurgeMon1_C "#SSD Schwelle Low Überwachung Anti-Surge  LIGov/ PCR_nSetpoint" VALUE 0xE6F20 Kw_Ws16 6000.000 EngN 0.00 6000.000 FORMAT "%8.3" EXTENDED_LIMITS -32768.00 32767.00 /end CHARACTERISTIC
/begin CHARACTERISTIC PCR_nSurgeMon2_C "#SSD Schwelle High Überwachung Anti-Surge  LIGov/ PCR_nSetpoint" VALUE 0xE6F22 Kw_Ws16 6000.000 EngN 0.00 6000.000 FORMAT "%8.3" EXTENDED_LIMITS -32768.00 32767.00 /end CHARACTERISTIC
/begin CHARACTERISTIC PCR_qSurgeHigh_CUR "Higher quantity limit for hysteresis of Anti-Surge LIGov" CURVE 0xE6F24 Kl_Xs16_Ws16 100.0000 InjMass 0.00 100.0000 FORMAT "%8.4" EXTENDED_LIMITS -327.6800 327.6700
 /begin AXIS_DESCR STD_AXIS Eng_nAvrg EngN 5 0.00 6000.000 FORMAT "%8.3" EXTENDED_LIMITS -32768.00 32767.00 DEPOSIT ABSOLUTE /end AXIS_DESCR
/end CHARACTERISTIC
/begin CHARACTERISTIC PCR_qSurgeLow_CUR "Lower quantity limit for hysteresis of Anti-Surge LIGov" CURVE 0xE6F3A Kl_Xs16_Ws16 100.0000 InjMass 0.00 100.0000 FORMAT "%8.4" EXTENDED_LIMITS -327.6800 327.6700
 /begin AXIS_DESCR STD_AXIS Eng_nAvrg EngN 5 0.00 6000.000 FORMAT "%8.3" EXTENDED_LIMITS -32768.00 32767.00 DEPOSIT ABSOLUTE /end AXIS_DESCR
/end CHARACTERISTIC
/begin CHARACTERISTIC PCR_rBPCtlBasUp_C "Ramp up slope for dynamic adjustment" VALUE 0xE5ADC Kw_Wu32 300.000049174 RmpPrc -100.000016391 200.000032783 FORMAT "%13.9" EXTENDED_LIMITS 0.00 799999.999814 /end CHARACTERISTIC
/begin CHARACTERISTIC PCR_rBPCtlBasDwn_C "Ramp down slope for dynamic adjustment" VALUE 0xE5AE0 Kw_Wu32 300.000049174 RmpPrc -100.000016391 200.000032783 FORMAT "%13.9" EXTENDED_LIMITS 0.00 799999.999814 /end CHARACTERISTIC
/begin CHARACTERISTIC PCR_rBPCtlBasAirCtlOff_MAP "Map to calculate VGT lift ratio in %" MAP 0xE5AE4 Kf_Xs16_Ys16_Ws16 300.0000 Prc -100.0000 200.0000 FORMAT "%8.4" EXTENDED_LIMITS -400.0000 399.9878
 /begin AXIS_DESCR STD_AXIS Eng_nAvrg EngN 16 0.00 6000.000 FORMAT "%8.3" EXTENDED_LIMITS -32768.00 32767.00 DEPOSIT ABSOLUTE /end AXIS_DESCR
 /begin AXIS_DESCR STD_AXIS PCR_qCtl_mp InjMassCyc 16 0.00 327.6700 FORMAT "%8.4" EXTENDED_LIMITS -327.6800 327.6700 DEPOSIT ABSOLUTE /end AXIS_DESCR
/end CHARACTERISTIC
/begin CHARACTERISTIC PCR_rBPCtlBasCorr_MAP "Base correction value according to particle filter soot mass" MAP 0xE5D28 Kf_Xs16_Ys16_Ws16 300.0000 Prc -100.0000 200.0000 FORMAT "%8.4" EXTENDED_LIMITS -400.0000 399.9878
 /begin AXIS_DESCR STD_AXIS Eng_nAvrg EngN 16 0.00 8000.000 FORMAT "%8.3" EXTENDED_LIMITS -32768.00 32767.00 DEPOSIT ABSOLUTE /end AXIS_DESCR
 /begin AXIS_DESCR STD_AXIS PCR_qCtl_mp InjMassCyc 10 0.00 300.0000 FORMAT "%8.4" EXTENDED_LIMITS -327.6800 327.6700 DEPOSIT ABSOLUTE /end AXIS_DESCR
/end CHARACTERISTIC
/begin CHARACTERISTIC PCR_rBPCtlBasFDC_MAP "map for Calculation of the base control value" MAP 0xE5EA0 Kf_Xs16_Ys16_Ws16 300.0000 Prc -100.0000 200.0000 FORMAT "%8.4" EXTENDED_LIMITS -400.0000 399.9878
 /begin AXIS_DESCR STD_AXIS Eng_nAvrg EngN 16 0.00 6000.000 FORMAT "%8.3" EXTENDED_LIMITS -32768.00 32767.00 DEPOSIT ABSOLUTE /end AXIS_DESCR
 /begin AXIS_DESCR STD_AXIS PCR_qCtl_mp InjMassCyc 16 0.00 327.6700 FORMAT "%8.4" EXTENDED_LIMITS -327.6800 327.6700 DEPOSIT ABSOLUTE /end AXIS_DESCR
/end CHARACTERISTIC
/begin CHARACTERISTIC PCR_rBPCtlBasRgn1Corr_MAP "Map to determine offset on boost pressure control value for regeneration according to particle filter soot mass" MAP 0xE60E4 Kf_Xs16_Ys16_Ws16 300.0000 Prc -100.0000 200.0000 FORMAT "%8.4" EXTENDED_LIMITS -400.0000 399.9878
 /begin AXIS_DESCR STD_AXIS Eng_nAvrg EngN 16 0.00 8000.000 FORMAT "%8.3" EXTENDED_LIMITS -32768.00 32767.00 DEPOSIT ABSOLUTE /end AXIS_DESCR
 /begin AXIS_DESCR STD_AXIS PCR_qCtl_mp InjMassCyc 10 0.00 300.0000 FORMAT "%8.4" EXTENDED_LIMITS -327.6800 327.6700 DEPOSIT ABSOLUTE /end AXIS_DESCR
/end CHARACTERISTIC
/begin CHARACTERISTIC PCR_rBPCtlBasRgn1_MAP "Basiskennfeld 1 für Regenerationsbetrieb" MAP 0xE625C Kf_Xs16_Ys16_Ws16 300.0000 Prc -100.0000 200.0000 FORMAT "%8.4" EXTENDED_LIMITS -400.0000 399.9878
 /begin AXIS_DESCR STD_AXIS Eng_nAvrg EngN 16 0.00 6000.000 FORMAT "%8.3" EXTENDED_LIMITS -32768.00 32767.00 DEPOSIT ABSOLUTE /end AXIS_DESCR
 /begin AXIS_DESCR STD_AXIS PCR_qCtl_mp InjMassCyc 16 0.00 327.6700 FORMAT "%8.4" EXTENDED_LIMITS -327.6800 327.6700 DEPOSIT ABSOLUTE /end AXIS_DESCR
/end CHARACTERISTIC
/begin CHARACTERISTIC PCR_rBPCtlBasRgn2_MAP "Basiskennfeld 2 für Regenerationsbetrieb" MAP 0xE64A0 Kf_Xs16_Ys16_Ws16 300.0000 Prc -100.0000 200.0000 FORMAT "%8.4" EXTENDED_LIMITS -400.0000 399.9878
 /begin AXIS_DESCR STD_AXIS Eng_nAvrg EngN 16 0.00 6000.000 FORMAT "%8.3" EXTENDED_LIMITS -32768.00 32767.00 DEPOSIT ABSOLUTE /end AXIS_DESCR
 /begin AXIS_DESCR STD_AXIS PCR_qCtl_mp InjMassCyc 16 0.00 327.6700 FORMAT "%8.4" EXTENDED_LIMITS -327.6800 327.6700 DEPOSIT ABSOLUTE /end AXIS_DESCR
/end CHARACTERISTIC
/begin CHARACTERISTIC PCR_rCtlAPCmpnRgn_MAP "Kennfeld für Atmosphärendruckabhängigen Korrekturwert" MAP 0xE66E4 Kf_Xs16_Ys16_Ws16 200.0000 Prc -100.0000 100.0000 FORMAT "%8.4" EXTENDED_LIMITS -400.0000 399.9878
 /begin AXIS_DESCR STD_AXIS Eng_nAvrg EngN 8 0.00 6000.000 FORMAT "%8.3" EXTENDED_LIMITS -32768.00 32767.00 DEPOSIT ABSOLUTE /end AXIS_DESCR
 /begin AXIS_DESCR STD_AXIS PCR_qCtl_mp InjMassCyc 16 0.00 327.6700 FORMAT "%8.4" EXTENDED_LIMITS -327.6800 327.6700 DEPOSIT ABSOLUTE /end AXIS_DESCR
/end CHARACTERISTIC
/begin CHARACTERISTIC PCR_rCtlAPCor_MAP "Kennfeld für atmosphärendruckabhängigen Korrekturwert für Ladedrucksteuerung" MAP 0xE6818 Kf_Xs16_Ys16_Ws16 200.0000 Prc -100.0000 100.0000 FORMAT "%8.4" EXTENDED_LIMITS -400.0000 399.9878
 /begin AXIS_DESCR STD_AXIS Eng_nAvrg EngN 10 0.00 6000.000 FORMAT "%8.3" EXTENDED_LIMITS -32768.00 32767.00 DEPOSIT ABSOLUTE /end AXIS_DESCR
 /begin AXIS_DESCR STD_AXIS PCR_qCtl_mp InjMassCyc 8 0.00 327.6700 FORMAT "%8.4" EXTENDED_LIMITS -327.6800 327.6700 DEPOSIT ABSOLUTE /end AXIS_DESCR
/end CHARACTERISTIC
/begin CHARACTERISTIC PCR_rCtlATCmpnRgn_MAP "Kennfeld für lufttemperaturabhängige Korrektur im Regenerationsbetrieb" MAP 0xE68E0 Kf_Xs16_Ys16_Ws16 200.0000 Prc -100.0000 100.0000 FORMAT "%8.4" EXTENDED_LIMITS -400.0000 399.9878
 /begin AXIS_DESCR STD_AXIS Eng_nAvrg EngN 8 0.00 6000.000 FORMAT "%8.3" EXTENDED_LIMITS -32768.00 32767.00 DEPOSIT ABSOLUTE /end AXIS_DESCR
 /begin AXIS_DESCR STD_AXIS PCR_qCtl_mp InjMassCyc 8 0.00 327.6700 FORMAT "%8.4" EXTENDED_LIMITS -327.6800 327.6700 DEPOSIT ABSOLUTE /end AXIS_DESCR
/end CHARACTERISTIC
/begin CHARACTERISTIC PCR_rCtlATCmpn_MAP "Kennfeld für lufttemperaturabhängige Korrektur" MAP 0xE6984 Kf_Xs16_Ys16_Ws16 200.0000 Prc -100.0000 100.0000 FORMAT "%8.4" EXTENDED_LIMITS -400.0000 399.9878
 /begin AXIS_DESCR STD_AXIS Eng_nAvrg EngN 10 0.00 6000.000 FORMAT "%8.3" EXTENDED_LIMITS -32768.00 32767.00 DEPOSIT ABSOLUTE /end AXIS_DESCR
 /begin AXIS_DESCR STD_AXIS PCR_qCtl_mp InjMassCyc 8 0.00 327.6700 FORMAT "%8.4" EXTENDED_LIMITS -327.6800 327.6700 DEPOSIT ABSOLUTE /end AXIS_DESCR
/end CHARACTERISTIC
/begin CHARACTERISTIC PCR_rCtlBas_MAP "Basissteuerkennfeld für Ladedruck" MAP 0xE6A4C Kf_Xs16_Ys16_Ws16 300.0000 Prc -100.0000 200.0000 FORMAT "%8.4" EXTENDED_LIMITS -400.0000 399.9878
 /begin AXIS_DESCR STD_AXIS Eng_nAvrg EngN 16 0.00 6000.000 FORMAT "%8.3" EXTENDED_LIMITS -32768.00 32767.00 DEPOSIT ABSOLUTE /end AXIS_DESCR
 /begin AXIS_DESCR STD_AXIS PCR_qCtl_mp InjMassCyc 16 0.00 327.6700 FORMAT "%8.4" EXTENDED_LIMITS -327.6800 327.6700 DEPOSIT ABSOLUTE /end AXIS_DESCR
/end CHARACTERISTIC
/begin CHARACTERISTIC PCR_rCtlInit_C "Initialisierungswert für Steuersignal" VALUE 0xE6C90 Kw_Ws16 50.00000 Prc 0.00 50.00000 FORMAT "%8.5" EXTENDED_LIMITS -400.0000 399.9878 /end CHARACTERISTIC
/begin CHARACTERISTIC PCR_rSurgeCtlVal_MAP "boost pressure control value for Anti-Surge LIGov" MAP 0xE6C92 Kf_Xs16_Ys16_Ws16 100.0000 Prc 0.00 100.0000 FORMAT "%8.4" EXTENDED_LIMITS -400.0000 399.9878
 /begin AXIS_DESCR STD_AXIS Eng_nAvrg EngN 16 0.00 6000.000 FORMAT "%8.3" EXTENDED_LIMITS -32768.00 32767.00 DEPOSIT ABSOLUTE /end AXIS_DESCR
 /begin AXIS_DESCR STD_AXIS PCR_qCtl_mp InjMassCyc 16 0.00 327.6700 FORMAT "%8.4" EXTENDED_LIMITS -327.6800 327.6700 DEPOSIT ABSOLUTE /end AXIS_DESCR
/end CHARACTERISTIC
/begin CHARACTERISTIC PCR_rSurgeHigh_MAP "#SSD Hystereseschwelle oben Druckverhältnis Anti-Surge LIGov" MAP 0xE6F50 Kf_Xs16_Ys16_Ws16 100.0000 Prc 0.00 100.0000 FORMAT "%8.4" EXTENDED_LIMITS -400.0000 399.9878
 /begin AXIS_DESCR STD_AXIS Eng_nAvrg EngN 8 0.00 6000.000 FORMAT "%8.3" EXTENDED_LIMITS -32768.00 32767.00 DEPOSIT ABSOLUTE /end AXIS_DESCR
 /begin AXIS_DESCR STD_AXIS APSCD_pVal Pres_hPa 3 0.00 3500.000 FORMAT "%8.3" EXTENDED_LIMITS -32768.00 32767.00 DEPOSIT ABSOLUTE /end AXIS_DESCR
/end CHARACTERISTIC
/begin CHARACTERISTIC PCR_rSurgeOfs_CUR "Lower ATL pressure ratio limit for hysteresis of Anti-Surge LIGov" CURVE 0xE6F9A Kl_Xs16_Ws16 280.0049 Prc 0.00 280.0049 FORMAT "%8.4" EXTENDED_LIMITS -400.0000 399.9878
 /begin AXIS_DESCR STD_AXIS Eng_nAvrg EngN 5 0.00 6000.000 FORMAT "%8.3" EXTENDED_LIMITS -32768.00 32767.00 DEPOSIT ABSOLUTE /end AXIS_DESCR
/end CHARACTERISTIC
/begin CHARACTERISTIC PCR_stCtlVal1_C "Maske für Regenerationswert 1" VALUE 0xE6ED8 Kw_Wu32 4294967295.00 OneToOne 0.00 4294967295.00 FORMAT "%13.2" /end CHARACTERISTIC
/begin CHARACTERISTIC PCR_stCtlVal2_C "Maske für Regenerationswert 2" VALUE 0xE6EDC Kw_Wu32 4294967295.00 OneToOne 0.00 4294967295.00 FORMAT "%13.2" /end CHARACTERISTIC
/begin CHARACTERISTIC PCR_tiSurgePT1_C "Time constant of PT1 delay element of PCR_SurgePT1" VALUE 0xE6FB0 Kw_Wu32 4294.8273 TimeDelay_s 0.14000154 4294.9673 FORMAT "%9.4" EXTENDED_LIMITS 0.0000010000000 4294.9673 /end CHARACTERISTIC
/begin CHARACTERISTIC PCR_swtOffStat1_C "Schalter um den Einfluss von PCR_stSurge1 zu deaktivieren (1...deaktiviert, 0...aktiviert)" VALUE 0xE6FB4 Kw_Wu8 1.000 OneToOne 0.00 1.000 FORMAT "%5.3" EXTENDED_LIMITS 0.00 255.0 /end CHARACTERISTIC
/begin CHARACTERISTIC PCR_swtQntCtlVal_C "Schalterwert zur Auswahl der für Steuerung verwendeten Einspritzmenge (1: akt. Einspritzmenge, 2: Rohwert, 3: berechnet)" VALUE 0xE6EE0 Kw_Wu8 4.000 OneToOne 1.000 5.000 FORMAT "%5.3" EXTENDED_LIMITS 0.00 255.0 /end CHARACTERISTIC
/begin CHARACTERISTIC PCR_swtQntCtlType_C "Schaltertyp zur Auswahl der für Steuerung verwendeten Einspritzmenge" VALUE 0xE6EE1 Kw_Wu8 1.000 OneToOne 1.000 2.000 FORMAT "%5.3" EXTENDED_LIMITS 0.00 255.0 /end CHARACTERISTIC
/begin CHARACTERISTIC PCR_swtSurgeGearBPA_C "Maske AntiSurge-LDR Gang-Auswahl (Bit0 für FrmMng_stConv=0, bit1 für FrmMng_stConv=1)" VALUE 0xE6FB5 Kw_Wu8 127.0 OneToOne 0.00 127.0 FORMAT "%5.1" EXTENDED_LIMITS 0.00 255.0 /end CHARACTERISTIC
/begin CHARACTERISTIC PCR_swtSurgeGearLIGov_C "Maske AntiSurge-LLR Gang-Auswahl (Bit0/1 für ConvCD_stDebVal=0/1, Bit4/5/6 für FrmMng_stConv=0/1/2)" VALUE 0xE6FB6 Kw_Wu8 3.000 OneToOne 0.00 3.000 FORMAT "%5.3" EXTENDED_LIMITS 0.00 255.0 /end CHARACTERISTIC
/begin CHARACTERISTIC PCR_tiRmpCtl_C "Ramplaufzeit für Umschaltung der Korrekturwerte" VAL_BLK 0xE6EE4 Kwb_Wu32 65.535999984741210 EGTRmp 0.000000015258789066052715 65.536000000000001 FORMAT "%19.16" NUMBER 3 /end CHARACTERISTIC
/begin CHARACTERISTIC PCR_tiSurgeBPAHiLo_C "Entprellzeit für Status PCR_stSurge2 für Übergang von 1 auf 0" VALUE 0xE6FB8 Kw_Wu16 4000.000 Time_ms 0.00 4000.000 FORMAT "%8.3" EXTENDED_LIMITS 0.00 655350.0 /end CHARACTERISTIC
/begin CHARACTERISTIC PCR_tiSurgeBPALoHi_C "Entprellzeit für Status PCR_stSurge2 für Übergang von 0 auf 1" VALUE 0xE6FBA Kw_Wu16 4000.000 Time_ms 0.00 4000.000 FORMAT "%8.3" EXTENDED_LIMITS 0.00 655350.0 /end CHARACTERISTIC
/begin CHARACTERISTIC PCR_tiSurgeMonLIGov_C "#SSD Überwachungszeit Drehzahlanhebung Anti-Surge" VALUE 0xE6FBC Kw_Wu16 655350.0 Time_ms 0.00 655350.0 FORMAT "%8.1" /end CHARACTERISTIC
/begin CHARACTERISTIC PCR_vSurgeLIGov_C "#SSD Schwelle Geschwindigkeit Anti-Surge/ Laderpumpen LIGov" VALUE 0xE6FBE Kw_Ws16 300.0000 Vel 0.00 300.0000 FORMAT "%8.4" EXTENDED_LIMITS -327.6800 327.6700 /end CHARACTERISTIC
/begin MEASUREMENT ctHigh "" UWORD OneToOne 1 100 0.00 65535.00 FORMAT "%8.2" ECU_ADDRESS 0x7FCA9C /end MEASUREMENT
/begin MEASUREMENT ctLow "" UWORD OneToOne 1 100 0.00 65535.00 FORMAT "%8.2" ECU_ADDRESS 0x7FCA9E /end MEASUREMENT
/begin MEASUREMENT LSUCD_ctHtCoup "Zähler für LSU Diagnose Heizerkopplung" UWORD OneToOne 1 100 0.00 65535.00 FORMAT "%8.2" ARRAY_SIZE 1 ECU_ADDRESS 0x7F8F20 /end MEASUREMENT
/begin MEASUREMENT LSUCD_dcycHtCoupStep1 "Heizungs-Aufgabe fährt im ersten Signalerwerbungs-Zyklus rad" SWORD DtyCyc 1 100 -327.6800 327.6700 FORMAT "%8.4" ARRAY_SIZE 1 ECU_ADDRESS 0x7F8F24 /end MEASUREMENT
/begin MEASUREMENT LSUCD_dcycHtCoupStep2 "Heizungs-Aufgabe fährt im zweiten Signalerwerbungs-Zyklus rad" SWORD DtyCyc 1 100 -327.6800 327.6700 FORMAT "%8.4" ARRAY_SIZE 1 ECU_ADDRESS 0x7F8F26 /end MEASUREMENT
/begin MEASUREMENT LSUCD_dcycHtCoupStep3 "Heizungs-Aufgabe fährt im dritten Signalerwerbungs-Zyklus rad" SWORD DtyCyc 1 100 -327.6800 327.6700 FORMAT "%8.4" ARRAY_SIZE 1 ECU_ADDRESS 0x7F8F28 /end MEASUREMENT
/begin MEASUREMENT LSUCD_dcycRippel_mp "Änderung des Heizungs-Tastverhältnisses bei Diagnose der Heizungskopplung" SWORD DtyCyc 1 100 -327.6800 327.6700 FORMAT "%8.4" ARRAY_SIZE 1 ECU_ADDRESS 0x8FF702 /end MEASUREMENT
/begin MEASUREMENT LSUCD_dHtCoupStep "Schieberegister für die Aufzeichnung der Werte" UBYTE OneToOne 1 100 0.00 255.0 FORMAT "%5.1" ECU_ADDRESS 0x7F891A /end MEASUREMENT
/begin MEASUREMENT LSUCD_dHtCoupStepLast "Letzter Wert des Schieberegisters" UBYTE OneToOne 1 100 0.00 255.0 FORMAT "%5.1" ECU_ADDRESS 0x7F891B /end MEASUREMENT
/begin MEASUREMENT LSUCD_resRiHtCoupStep1 "Innerer Wiederstand im ersten Datenakquisitionszyklus" SWORD Resist 1 100 -3276.800 3276.700 FORMAT "%8.3" ARRAY_SIZE 1 ECU_ADDRESS 0x7F8F3A /end MEASUREMENT
/begin MEASUREMENT LSUCD_resRiHtCoupStep2 "Innerer Wiederstand im zweiten Datenakquisitionszyklus" SWORD Resist 1 100 -3276.800 3276.700 FORMAT "%8.3" ARRAY_SIZE 1 ECU_ADDRESS 0x7F8F3C /end MEASUREMENT
/begin MEASUREMENT LSUCD_resRiHtCoupStep3 "Innerer Wiederstand im dritten Datenakquisitionszyklus" SWORD Resist 1 100 -3276.800 3276.700 FORMAT "%8.3" ARRAY_SIZE 1 ECU_ADDRESS 0x7F8F3E /end MEASUREMENT
/begin MEASUREMENT LSUCD_resRiRippel_mp "Änderung des Innenwiderstands bei Freigabe der Heizung" SWORD Resist 1 100 -3276.800 3276.700 FORMAT "%8.3" ARRAY_SIZE 1 ECU_ADDRESS 0x8FF704 /end MEASUREMENT
/begin MEASUREMENT LSUCD_stDiaIAEna "Message um die Erkennung von IA oder IP Kurzschluss nach Masse freizugeben" UBYTE OneToOne 1 100 0.00 255.0 FORMAT "%5.1" ARRAY_SIZE 1 ECU_ADDRESS 0x7F891D /end MEASUREMENT
/begin MEASUREMENT LSUCD_stHtCoupActv "Statusbotschaft für Heizungskopplung aktiv" UBYTE OneToOne 1 100 0.00 255.0 FORMAT "%5.1" ECU_ADDRESS 0x7F891E /end MEASUREMENT
/begin MEASUREMENT LSUCD_stInitClb "Erste CJ120-Kalibrierung wurde angefordert" UBYTE OneToOne 1 100 0.00 255.0 FORMAT "%5.1" ECU_ADDRESS 0x7F8920 /end MEASUREMENT
/begin MEASUREMENT LSUCD_stIsolChkActv "Nebenschlußerkennung ist momentan aktiv" UBYTE OneToOne 1 100 0.00 255.0 FORMAT "%5.1" ARRAY_SIZE 1 ECU_ADDRESS 0x7F8923 /end MEASUREMENT
/begin MEASUREMENT LSUCD_stIsolChkO2Last "Status ob die O2 Konzentration im letzten Zyklus innerhalb des vorgegebenen Fensters war" UBYTE OneToOne 1 100 0.00 255.0 FORMAT "%5.1" ARRAY_SIZE 1 ECU_ADDRESS 0x7F8924 /end MEASUREMENT
/begin MEASUREMENT LSUCD_stIsolChkStrt "Statusmessage zum Starten der Nebenschlusserkennung" UBYTE OneToOne 1 100 0.00 255.0 FORMAT "%5.1" ARRAY_SIZE 1 ECU_ADDRESS 0x7F8925 /end MEASUREMENT
/begin MEASUREMENT LSUCD_stOpnErrIP "Status Leerlauf-Fehler Pumpstrom Pin (IP)" UBYTE OneToOne 1 100 0.00 255.0 FORMAT "%5.1" ARRAY_SIZE 1 ECU_ADDRESS 0x7F892B /end MEASUREMENT
/begin MEASUREMENT LSUCD_stOpnLdTstActv "Message von LSU_WireDiagnosis, die anzeigt, ob die Kabelunterbrechungsdiagnose für Nernst-Zelle und virtuelle Masse aktiv ist" UBYTE OneToOne 1 100 0.00 255.0 FORMAT "%5.1" ARRAY_SIZE 1 ECU_ADDRESS 0x7F892C /end MEASUREMENT
/begin MEASUREMENT LSUCD_stPumpEna "Zustand der CJ 120 Pumpstromregelung (0 = abgeschaltet, 1 = aktiv = Strom angeschaltet)" UBYTE OneToOne 1 100 0.00 255.0 FORMAT "%5.1" ARRAY_SIZE 1 ECU_ADDRESS 0x7F892F /end MEASUREMENT
/begin MEASUREMENT LSUCD_stRecValEval_mp "Messpunkt für den Status der Auswertung erfasster Werte in der Heizungskopplung" UBYTE OneToOne 1 100 0.00 255.0 FORMAT "%5.1" ARRAY_SIZE 1 ECU_ADDRESS 0x8FF706 /end MEASUREMENT
/begin MEASUREMENT LSUCD_stTstTrigger_mp "Messpunkt für den Status zur Auslösung des Tests der Nebenschlusserkennung" UBYTE OneToOne 1 100 0.00 255.0 FORMAT "%5.1" ARRAY_SIZE 1 ECU_ADDRESS 0x8FF707 /end MEASUREMENT
/begin MEASUREMENT LSUCD_stWireDiaChk_mp "Bitfeld: Unterdiagnosen ausgeführt" UBYTE OneToOne 1 100 0.00 255.0 FORMAT "%5.1" ARRAY_SIZE 1 ECU_ADDRESS 0x8FF708 /end MEASUREMENT
/begin MEASUREMENT LSUCD_stWireDiaErr_mp "Status des Fehlers Nebenschlusserkennung" UBYTE OneToOne 1 100 0.00 255.0 FORMAT "%5.1" ARRAY_SIZE 1 ECU_ADDRESS 0x8FF709 /end MEASUREMENT
/begin MEASUREMENT LSUCD_uO2FltRippel_mp "Gefilterte, überlagerte Sauerstoff-Wechselspannung bei Diagnose der Heizungskopplung" SWORD Volt 1 100 -160156.4 160151.5 FORMAT "%8.1" ARRAY_SIZE 1 ECU_ADDRESS 0x8FF70A /end MEASUREMENT
/begin MEASUREMENT LSUCD_uO2Grad_mp "Gradient der Sauerstoff-Spannung bei Diagnose der Heizungskopplung" SWORD Volt 1 100 -160156.4 160151.5 FORMAT "%8.1" ARRAY_SIZE 1 ECU_ADDRESS 0x8FF70C /end MEASUREMENT
/begin MEASUREMENT LSUCD_uO2HtCoupStep1 "O2 Konzentration im ersten Datenakquisitionszyklus" SWORD Volt 1 100 -160156.4 160151.5 FORMAT "%8.1" ARRAY_SIZE 1 ECU_ADDRESS 0x7F8F4E /end MEASUREMENT
/begin MEASUREMENT LSUCD_uO2HtCoupStep2 "O2 Konzentration im zweiten Datenakquisitionszyklus" SWORD Volt 1 100 -160156.4 160151.5 FORMAT "%8.1" ARRAY_SIZE 1 ECU_ADDRESS 0x7F8F50 /end MEASUREMENT
/begin MEASUREMENT LSUCD_uO2HtCoupStep3 "O2 Konzentration im dritten Datenakquisitionszyklus" SWORD Volt 1 100 -160156.4 160151.5 FORMAT "%8.1" ARRAY_SIZE 1 ECU_ADDRESS 0x7F8F52 /end MEASUREMENT
/begin MEASUREMENT LSUCD_uO2Rippel_mp "Sauerstoff-Wechselspannung bei Diagnose der Heizungskopplung" SWORD Volt 1 100 -160156.4 160151.5 FORMAT "%8.1" ARRAY_SIZE 1 ECU_ADDRESS 0x8FF70E /end MEASUREMENT
/begin MEASUREMENT LSUCtl_dcycDT1_mp "DT1 Anteil der Heizungsregler Tastverhältnisanforderung" SWORD DtyCyc 1 100 -327.6800 327.6700 FORMAT "%8.4" ARRAY_SIZE 1 ECU_ADDRESS 0x8FF710 /end MEASUREMENT
/begin MEASUREMENT LSUCtl_dcycHt "Heizertastverhältnis Anforderung durch Ri Regelung" SWORD DtyCyc 1 100 -327.6800 327.6700 FORMAT "%8.4" ARRAY_SIZE 1 ECU_ADDRESS 0x7F8F58 /end MEASUREMENT
/begin MEASUREMENT LSUCtl_dcycHtIniRamp "Startwert für Aufheizkurven Rampe" SWORD DtyCyc 1 100 -327.6800 327.6700 FORMAT "%8.4" ECU_ADDRESS 0x7F8F5A /end MEASUREMENT
/begin MEASUREMENT LSUCtl_dcycHtStrt "Tastverhältnisvorgabe Heizung durch Aufheizstrategie" SWORD DtyCyc 1 100 -327.6800 327.6700 FORMAT "%8.4" ARRAY_SIZE 1 ECU_ADDRESS 0x7F8F5C /end MEASUREMENT
/begin MEASUREMENT LSUCtl_dcycPI_mp "Tastverhältnisforderung aus dem P I Regelglied" SWORD DtyCyc 1 100 -327.6800 327.6700 FORMAT "%8.4" ARRAY_SIZE 1 ECU_ADDRESS 0x8FF712 /end MEASUREMENT
/begin MEASUREMENT LSUCtl_stHtCtl "Statusbits Zustand Heizungsregelung" UBYTE OneToOne 1 100 0.00 255.0 FORMAT "%5.1" ARRAY_SIZE 1 ECU_ADDRESS 0x7F8938 /end MEASUREMENT
/begin MEASUREMENT LSUCtl_stHtDisable "High level Diagnose Anforderung Heizungsregelungsabschaltung (0 = nicht abgeschaltet, >0 Ausgang = 0 %)" UBYTE OneToOne 1 100 0.00 255.0 FORMAT "%5.1" ARRAY_SIZE 1 ECU_ADDRESS 0x7F8939 /end MEASUREMENT
/begin MEASUREMENT LSUCtl_stRmp_mp "Ansteuerstatus für geschaltete Rampe" UBYTE OneToOne 1 100 0.00 255.0 FORMAT "%5.1" ARRAY_SIZE 1 ECU_ADDRESS 0x8FF714 /end MEASUREMENT
/begin MEASUREMENT LSUCtl_stSCUNEna "Message um Test für Erkennung von Kurzschluss nach Vbat bei UNI freizugeben" UBYTE OneToOne 1 100 0.00 255.0 FORMAT "%5.1" ARRAY_SIZE 1 ECU_ADDRESS 0x7F893A /end MEASUREMENT
/begin MEASUREMENT LSUCtl_tAirStrt_mp "Ansauglufttemperatur nach Zündung an (mit Verzögerung erfasst!)" SWORD Temp_Cels 1 100 -50.140 899.860 FORMAT "%8.3" ECU_ADDRESS 0x8FF716 /end MEASUREMENT
/begin MEASUREMENT LSUCtl_tDvt_mp "Regelabweichung Sensortemperatur" SWORD TempDiff_Cels 1 100 -3276.800 3276.700 FORMAT "%8.3" ARRAY_SIZE 1 ECU_ADDRESS 0x8FF718 /end MEASUREMENT
/begin MEASUREMENT LSU_bpPlausSetPoint_mp "Bitposition für Zugriff auf LSU_stO2Err(_mp)" UBYTE OneToOne 1 100 0.00 255.0 FORMAT "%5.1" ECU_ADDRESS 0x8FF6D4 /end MEASUREMENT
/begin MEASUREMENT LSU_qStrt_mp "anfängliche Kraftstoffmenge in Dynamik-Überwachung" SWORD InjMass 1 100 -327.6800 327.6700 FORMAT "%8.4" ECU_ADDRESS 0x8FF6D6 /end MEASUREMENT
/begin MEASUREMENT LSU_rLmbd "Lambda" SWORD lambda 1 100 -32.76800 32.76700 FORMAT "%8.5" ARRAY_SIZE 1 ECU_ADDRESS 0x7F8F5E /end MEASUREMENT
/begin MEASUREMENT LSU_rLmbdRec "Kehrwert von Lambda" SWORD lambdaRecVal 1 100 -32.76800 32.76700 FORMAT "%8.5" ARRAY_SIZE 1 ECU_ADDRESS 0x7F8F60 /end MEASUREMENT
/begin MEASUREMENT LSU_rO2ActVal "Aktuell von Plausibilisierung verwendete O2-Konzentration" SWORD O2 1 100 -0.3276800 0.3276700 FORMAT "%9.7" ARRAY_SIZE 1 ECU_ADDRESS 0x7F8F62 /end MEASUREMENT
/begin MEASUREMENT LSU_rO2Adpt "Adaptierte Sauerstoffkonzentration die an externe Module übertragen wird" SWORD O2 1 100 -0.3276800 0.3276700 FORMAT "%9.7" ARRAY_SIZE 1 ECU_ADDRESS 0x7F8F64 /end MEASUREMENT
/begin MEASUREMENT LSU_rO2AdptLastLSU_mp "Adaptierte Sauerstoffkonzentration des Sensors mit der höchsten Nummer" SWORD O2 1 100 -0.3276800 0.3276700 FORMAT "%9.7" ECU_ADDRESS 0x8FF6C2 /end MEASUREMENT
/begin MEASUREMENT LSU_rO2Calc_mp "aktuelle O2-Konzentration aus Luftmasse und Einspritzmenge" SWORD O2 1 100 -0.3276800 0.3276700 FORMAT "%9.7" ECU_ADDRESS 0x8FF6D8 /end MEASUREMENT
/begin MEASUREMENT LSU_rO2DiffCmpChk "O2-Unterscheid eines Sondenpaars" SWORD O2 1 100 -0.3276800 0.3276700 FORMAT "%9.7" ECU_ADDRESS 0x7FA950 /end MEASUREMENT
/begin MEASUREMENT LSU_rO2DvtNeg_mp "Minustoleranz für Plausibilisierung O2-Signal LSU" SWORD O2 1 100 -0.3276800 0.3276700 FORMAT "%9.7" ECU_ADDRESS 0x8FF6DA /end MEASUREMENT
/begin MEASUREMENT LSU_rO2DvtPos_mp "Plustoleranz für Plausibilisierung O2-Signal LSU" SWORD O2 1 100 -0.3276800 0.3276700 FORMAT "%9.7" ECU_ADDRESS 0x8FF6DC /end MEASUREMENT
/begin MEASUREMENT LSU_rO2Lmbd1Thres "Message: Toleranzband für Lambda-1-Erkennung" SWORD O2 1 100 -0.3276800 0.3276700 FORMAT "%9.7" ECU_ADDRESS 0x7F8F66 /end MEASUREMENT
/begin MEASUREMENT LSU_rO2MaxDiff "Maximale O2 Differenz zwischen ausgewählten Lambdasonden" SWORD O2 1 100 -0.3276800 0.3276700 FORMAT "%9.7" ECU_ADDRESS 0x7FA950 /end MEASUREMENT
/begin MEASUREMENT LSU_rO2MaxVal "Oberer Grenzwert der Plausibilisierung" SWORD O2 1 100 -0.3276800 0.3276700 FORMAT "%9.7" ARRAY_SIZE 1 ECU_ADDRESS 0x7F8F68 /end MEASUREMENT
/begin MEASUREMENT LSU_rO2MinVal "Unterer Grenzwert der Plausibilisierung" SWORD O2 1 100 -0.3276800 0.3276700 FORMAT "%9.7" ARRAY_SIZE 1 ECU_ADDRESS 0x7F8F6A /end MEASUREMENT
/begin MEASUREMENT LSU_rO2RawFlt "Gefilterte O2Raw-Sauerstoffkonzentration in Lambda-1-Erkennung" SWORD O2 1 100 -0.3276800 0.3276700 FORMAT "%9.7" ARRAY_SIZE 1 ECU_ADDRESS 0x7F8F6C /end MEASUREMENT
/begin MEASUREMENT LSU_rO2Stat_mp "gefilterte O2-Konzentration aus Luftmasse und Einspritzmenge" SWORD O2 1 100 -0.3276800 0.3276700 FORMAT "%9.7" ARRAY_SIZE 1 ECU_ADDRESS 0x8FF6C4 /end MEASUREMENT
/begin MEASUREMENT LSU_rO2Thres1_mp "untere O2-Schwelle für Messung der Anstiegszeit" SWORD O2 1 100 -0.3276800 0.3276700 FORMAT "%9.7" ARRAY_SIZE 1 ECU_ADDRESS 0x8FF6C6 /end MEASUREMENT
/begin MEASUREMENT LSU_rO2Thres2_mp "obere O2-Schwelle für Messung der Anstiegszeit" SWORD O2 1 100 -0.3276800 0.3276700 FORMAT "%9.7" ARRAY_SIZE 1 ECU_ADDRESS 0x8FF6C8 /end MEASUREMENT
/begin MEASUREMENT LSU_stChkDyn_mp "Nummer der zuletzt erreichten O2-Schwelle" UBYTE OneToOne 1 100 0.00 255.0 FORMAT "%5.1" ARRAY_SIZE 1 ECU_ADDRESS 0x8FF6CA /end MEASUREMENT
/begin MEASUREMENT LSU_stClbDisable "Disable-Signal für CJ120-Kalibrierung" UBYTE OneToOne 1 100 0.00 255.0 FORMAT "%5.1" ECU_ADDRESS 0x7F893B /end MEASUREMENT
/begin MEASUREMENT LSU_stClbTrg_mp "CJ125-Kalibrierung bzw. Pumpstromumkehr ist freigegeben" UBYTE OneToOne 1 100 0.00 255.0 FORMAT "%5.1" ECU_ADDRESS 0x8FF6BE /end MEASUREMENT
/begin MEASUREMENT LSU_stConstPOp "Statusmessage konstanter Betriebspunkt" UBYTE OneToOne 1 100 0.00 255.0 FORMAT "%5.1" ECU_ADDRESS 0x7F893C /end MEASUREMENT
/begin MEASUREMENT LSU_stNotOpPoint1_mp "Messen des Punktes für Status des Betriebsgebiets 1" UBYTE OneToOne 1 100 0.00 255.0 FORMAT "%5.1" ECU_ADDRESS 0x8FF6BF /end MEASUREMENT
/begin MEASUREMENT LSU_stNotOpPoint2_mp "Messen des Punktes für Status des Betriebsgebiets 2" UBYTE OneToOne 1 100 0.00 255.0 FORMAT "%5.1" ECU_ADDRESS 0x8FF6C0 /end MEASUREMENT
/begin MEASUREMENT LSU_stO2Chk_mp "Bitfeld :: Teildiagnosen durchgeführt" UWORD OneToOne 1 100 0.00 65535.00 FORMAT "%8.2" ARRAY_SIZE 1 ECU_ADDRESS 0x8FF6CC /end MEASUREMENT
/begin MEASUREMENT LSU_stO2Err_mp "Statuswort :: Diagnoseergebnisse" UWORD OneToOne 1 100 0.00 65535.00 FORMAT "%8.2" ARRAY_SIZE 1 ECU_ADDRESS 0x8FF6CE /end MEASUREMENT
/begin MEASUREMENT LSU_stPlausChkCon_mp "Statuswort Zustand der Voraussetzungen für Plausibilitätscheck" UBYTE OneToOne 1 100 0.00 255.0 FORMAT "%5.1" ECU_ADDRESS 0x8FF6D0 /end MEASUREMENT
/begin MEASUREMENT LSU_stPlausChk_mp "Statuswort Zustand Plausibilitäts-Check" UBYTE OneToOne 1 100 0.00 255.0 FORMAT "%5.1" ARRAY_SIZE 1 ECU_ADDRESS 0x8FF6D1 /end MEASUREMENT
/begin MEASUREMENT LSU_stStrtClb "Hilfsvariable für Kalibrierungs-Scheduler" UBYTE OneToOne 1 100 0.00 255.0 FORMAT "%5.1" ECU_ADDRESS 0x7F893D /end MEASUREMENT
/begin MEASUREMENT LSU_stTmrClbPerRun "Status des Kalibrier-Timers" UBYTE OneToOne 1 100 0.00 255.0 FORMAT "%5.1" ECU_ADDRESS 0x7F893E /end MEASUREMENT
/begin MEASUREMENT LSU_tiState1_mp "Timervariable: Kraftstoffmenge liegt innerhalb Toleranzband" UWORD Time_s 1 100 0.00 655.3500 FORMAT "%8.4" ARRAY_SIZE 1 ECU_ADDRESS 0x8FF6D2 /end MEASUREMENT
/begin MEASUREMENT LSU_tiState2 "Message: Anstiegszeit O2-Signal beim Übergang Last-Schub (Dynamiküberwachung)" UWORD Time_s 1 100 0.00 655.3500 FORMAT "%8.4" ARRAY_SIZE 1 ECU_ADDRESS 0x7F8F6E /end MEASUREMENT
/begin MEASUREMENT LSU_tiState3 "Message: Zeitdauer bis zum Erreichen des Schubs (Kraftstoffmenge kleiner als Schwellwert)" UWORD Time_s 1 100 0.00 655.3500 FORMAT "%8.4" ARRAY_SIZE 1 ECU_ADDRESS 0x7F8F70 /end MEASUREMENT
/begin MEASUREMENT LSU_tiSwitch "Message: Maximal zulässiger Wert für O2-Flankenzeit Last -> Schub" UWORD Time_s 1 100 0.00 655.3500 FORMAT "%8.4" ARRAY_SIZE 1 ECU_ADDRESS 0x7F8F72 /end MEASUREMENT
/begin MEASUREMENT LSU_tiWait3 "Message: maximale Zeitdauer zum erreichen der oberen O2-Schwelle in Dynamiküberwachung" UWORD Time_s 1 100 0.00 655.3500 FORMAT "%8.4" ARRAY_SIZE 1 ECU_ADDRESS 0x7F8F74 /end MEASUREMENT
/begin MEASUREMENT LubCD_ctHigh "" UWORD OneToOne 1 100 0.00 65535.00 FORMAT "%8.2" ECU_ADDRESS 0x7F8F80 /end MEASUREMENT
/begin MEASUREMENT LubCD_ctLow "" UWORD OneToOne 1 100 0.00 65535.00 FORMAT "%8.2" ECU_ADDRESS 0x7F8F82 /end MEASUREMENT
/begin MEASUREMENT LubCD_ctTog "Counter für fallende Flanken" UBYTE OneToOne 1 100 0.00 255.0 FORMAT "%5.1" ECU_ADDRESS 0x7F8951 /end MEASUREMENT
/begin MEASUREMENT LubCD_dioIn "" UBYTE OneToOne 1 100 0.00 255.0 FORMAT "%5.1" ECU_ADDRESS 0x7F8952 /end MEASUREMENT
/begin MEASUREMENT LubCD_st "Status LubCD" UBYTE OneToOne 1 100 0.00 255.0 FORMAT "%5.1" ECU_ADDRESS 0x7F8953 /end MEASUREMENT
/begin MEASUREMENT LubCD_stErr_mp "error status" UBYTE OneToOne 1 100 0.00 255.0 FORMAT "%5.1" ECU_ADDRESS 0x8FF71A /end MEASUREMENT
/begin MEASUREMENT LubCD_stOelTog "condition oil niveau not valid" UBYTE OneToOne 1 100 0.00 255.0 FORMAT "%5.1" ECU_ADDRESS 0x7F8954 /end MEASUREMENT
/begin MEASUREMENT LubCD_stTOel "Öltemperatur ist valid" UBYTE OneToOne 1 100 0.00 255.0 FORMAT "%5.1" ECU_ADDRESS 0x7F8955 /end MEASUREMENT
/begin MEASUREMENT LubCD_stTog "condition oil niveau valid" UBYTE OneToOne 1 100 0.00 255.0 FORMAT "%5.1" ECU_ADDRESS 0x7F8956 /end MEASUREMENT
/begin MEASUREMENT LubCD_tiHigh_mp "Hightime" UWORD Period_ms 1 100 0.00 6553.500 FORMAT "%8.3" ECU_ADDRESS 0x8FF71C /end MEASUREMENT
/begin MEASUREMENT LubCD_tiLow_mp "Lowtime" UWORD Period_ms 1 100 0.00 6553.500 FORMAT "%8.3" ECU_ADDRESS 0x8FF71E /end MEASUREMENT
/begin MEASUREMENT LubCD_titk "Periodendauer für Ölniveau" UWORD Period_ms 1 100 0.00 6553.500 FORMAT "%8.3" ECU_ADDRESS 0x7F8F84 /end MEASUREMENT
/begin MEASUREMENT LubCD_titr "Periodendauer Öltemperatur Referenzsignal" UWORD Period_ms 1 100 0.00 6553.500 FORMAT "%8.3" ECU_ADDRESS 0x7F8F86 /end MEASUREMENT
/begin MEASUREMENT LubCD_titv "Periodendauer für Öltemperatur" UWORD Period_ms 1 100 0.00 6553.500 FORMAT "%8.3" ECU_ADDRESS 0x7F8F88 /end MEASUREMENT
/begin MEASUREMENT LubCD_Tog_icnt "" UWORD OneToOne 1 100 0.00 65535.00 FORMAT "%8.2" ECU_ADDRESS 0x7F8F7E /end MEASUREMENT
/begin MEASUREMENT LubCD_Tog_uplcnt "" UBYTE OneToOne 1 100 0.00 255.0 FORMAT "%5.1" ECU_ADDRESS 0x7F8950 /end MEASUREMENT
/begin MEASUREMENT MemMon_ctErrChkRam "Fehlerzähler für Doppelablage und zyklischen RAM-Test" UBYTE OneToOne 1 100 0.00 255.0 FORMAT "%5.1" ECU_ADDRESS 0x7F9AD9 /end MEASUREMENT
/begin MEASUREMENT MemMon_ctErrChkRom "Fehlerzähler für zyklischen ROM-Test" UBYTE OneToOne 1 100 0.00 255.0 FORMAT "%5.1" ECU_ADDRESS 0x7F9ADA /end MEASUREMENT
/begin MEASUREMENT MemMon_ctHealChkRam "Heilungszähler für Doppelablage und zyklischen RAM-Test" UBYTE Time_ms_40ms 1 100 0.00 10200. FORMAT "%5.0" ECU_ADDRESS 0x7F9ADB /end MEASUREMENT
/begin MEASUREMENT MemMon_ctHealChkRom "Heilungszähler für zyklischen ROM-Test" UBYTE Time_ms_40ms 1 100 0.00 10200. FORMAT "%5.0" ECU_ADDRESS 0x7F9ADC /end MEASUREMENT
/begin MEASUREMENT MemMon_st "Status der Speicherüberwachung" UBYTE OneToOne 1 100 0.00 255.0 FORMAT "%5.1" ECU_ADDRESS 0x7F9AD8 /end MEASUREMENT
/begin MEASUREMENT MeUnCD_dcycDT1_mp "Sollwert Tastverhältnis mit DT1-Anteil" SWORD DtyCyc 1 100 -327.6800 327.6700 FORMAT "%8.4" ECU_ADDRESS 0x8FF722 /end MEASUREMENT
/begin MEASUREMENT MeUnCD_dcycOut_mp "Ausgangstastverhältnis" SWORD DtyCyc 1 100 -327.6800 327.6700 FORMAT "%8.4" ECU_ADDRESS 0x6F81B2 /end MEASUREMENT
/begin MEASUREMENT MeUnCD_dcycSetValLin_mp "linearisierter Sollwert der Zumesseinheit" SWORD DtyCyc 1 100 -327.6800 327.6700 FORMAT "%8.4" ECU_ADDRESS 0x8FF724 /end MEASUREMENT
/begin MEASUREMENT MeUnCD_dcycSetVal_mp "Sollwert Tastverhältnis für Zumesseinheit" SWORD DtyCyc 1 100 -327.6800 327.6700 FORMAT "%8.4" ECU_ADDRESS 0x8FF726 /end MEASUREMENT
/begin MEASUREMENT MeUnCD_facIGov_mp "Zumesseinheit-Stromregelung I-Anteil" SWORD Fact 1 100 -4.000000 3.999878 FORMAT "%8.6" ECU_ADDRESS 0x8FF728 /end MEASUREMENT
/begin MEASUREMENT MeUnCD_iActFlt_mp "Zumesseinheit-Stromregelung gefilterter Strom-Istwert" SWORD Curr 1 100 -32768.00 32767.00 FORMAT "%8.2" ECU_ADDRESS 0x6F81B4 /end MEASUREMENT
/begin MEASUREMENT MeUnCD_iDvt_mp "Zumesseinheit-Stromregelung Regelabweichung" SWORD Curr 1 100 -32768.00 32767.00 FORMAT "%8.2" ECU_ADDRESS 0x8FF72A /end MEASUREMENT
/begin MEASUREMENT MeUnCD_iGovActVal "Analogeingang Strom-Istwert" SWORD Curr 1 100 -32768.00 32767.00 FORMAT "%8.2" ECU_ADDRESS 0x7F8F90 /end MEASUREMENT
/begin MEASUREMENT MeUnCD_iSetFlt "Zumesseinheit-Stromregelung gefilterter Strom-Sollwert" SWORD Curr 1 100 -32768.00 32767.00 FORMAT "%8.2" ECU_ADDRESS 0x7F8F92 /end MEASUREMENT
/begin MEASUREMENT MeUnCD_nDiffRef_mp "gefilterte Drehzahl für Kennlinie" SWORD EngN 1 100 -32768.00 32767.00 FORMAT "%8.2" ECU_ADDRESS 0x8FF72C /end MEASUREMENT
/begin MEASUREMENT MeUnCD_tiPer_mp "Periodendauer der PWM-Endstufe" SWORD Period 1 100 -3276.800 3276.700 FORMAT "%8.3" ECU_ADDRESS 0x8FF72E /end MEASUREMENT
/begin MEASUREMENT MeUnCD_uRawVal_mp "Analogeingang Spannungsrohwert" SWORD Volt 1 100 -160156.4 160151.5 FORMAT "%8.1" ECU_ADDRESS 0x8FF730 /end MEASUREMENT
/begin MEASUREMENT MeUn_iSet_mp "Sollstrom für die Zumesseinheit" SWORD Curr 1 100 -32768.00 32767.00 FORMAT "%8.2" ECU_ADDRESS 0x6F81B0 /end MEASUREMENT
/begin MEASUREMENT MeUn_stActrCtl_mp "Zustand der Stellwertsteuerung für die Zumesseinheit" UBYTE OneToOne 1 100 0.00 255.0 FORMAT "%5.1" ECU_ADDRESS 0x8FF720 /end MEASUREMENT
/begin MEASUREMENT MRlyCD_ctTooEarlyInit_mp "Fehlerzähler ""Hauptrelais öffnet zu früh"",Zählerwert nach SG Ini." UBYTE OneToOne 1 100 0.00 255.0 FORMAT "%5.1" ECU_ADDRESS 0x8FF732 /end MEASUREMENT
/begin MEASUREMENT MRlyCD_ctTooEarly_mp "Fehlerzähler für ""Hauptrelais öffnet zu früh"" Fehler" UBYTE OneToOne 1 100 0.00 255.0 FORMAT "%5.1" ECU_ADDRESS 0x8FF733 /end MEASUREMENT
/begin MEASUREMENT MRlyCD_stMon "aktueller Zustand der Hauptrelaisüberwachung" UBYTE OneToOne 1 100 0.00 255.0 FORMAT "%5.1" ECU_ADDRESS 0x7F8957 /end MEASUREMENT
/begin MEASUREMENT MRlyCD_stPrevOpening "Bedingung / Grund für das Öffnen des Hauptrelais während letztem Steuergerätelauf" UBYTE OneToOne 1 100 0.00 255.0 FORMAT "%5.1" ECU_ADDRESS 0x7F8958 /end MEASUREMENT
/begin MEASUREMENT MSidCD_numECUS "Anzahl der ECU in diesem system: 1 - 4 (Master/Slave)" UBYTE OneToOne 1 100 0.00 255.0 FORMAT "%5.1" ECU_ADDRESS 0x7F8959 /end MEASUREMENT
/begin MEASUREMENT MSidCD_stCANpriv_mp "Status Plausibilisierung über priv. CAN (entprellt)" UBYTE OneToOne 1 100 0.00 255.0 FORMAT "%5.1" ECU_ADDRESS 0x8FF734 /end MEASUREMENT
/begin MEASUREMENT MSidCD_stECUCANpriv_mp "Status privater CAN (nicht entprellt)" UWORD OneToOne 1 100 0.00 65535.00 FORMAT "%8.2" ECU_ADDRESS 0x8FF736 /end MEASUREMENT
/begin MEASUREMENT MSidCD_stECUCANPtHelp_mp "Olda privater CAN Fehler-Status Senden um Empfangen" UWORD OneToOne 1 100 0.00 65535.00 FORMAT "%8.2" ECU_ADDRESS 0x8FF738 /end MEASUREMENT
/begin MEASUREMENT MSidCD_stECULearned_mp "Status SG-Auswahl gelernt (EEPROM-info)" UBYTE OneToOne 1 100 0.00 255.0 FORMAT "%5.1" ECU_ADDRESS 0x8FF73A /end MEASUREMENT
/begin MEASUREMENT MSidCD_stECULTmp_mp "Status SG-Auswahl vorläufig gelernt" UBYTE OneToOne 1 100 0.00 255.0 FORMAT "%5.1" ECU_ADDRESS 0x8FF73B /end MEASUREMENT
/begin MEASUREMENT MSidCD_stECUPlaus_mp "Status Plausibilisierung SG-Auswahl" UBYTE OneToOne 1 100 0.00 255.0 FORMAT "%5.1" ECU_ADDRESS 0x8FF73C /end MEASUREMENT
/begin MEASUREMENT MSidCD_stECUSelect_mp "Zusammenfassung Stati SG-Auswahl" UBYTE OneToOne 1 100 0.00 255.0 FORMAT "%5.1" ECU_ADDRESS 0x8FF73D /end MEASUREMENT
/begin MEASUREMENT MSidCD_stECUStatus_mp "Zustandsautomat SG-Auswahl" UBYTE OneToOne 1 100 0.00 255.0 FORMAT "%5.1" ECU_ADDRESS 0x8FF73E /end MEASUREMENT
/begin MEASUREMENT MSidCD_stErrEcuPinComm_mp "State of ECU pin error" UBYTE OneToOne 1 100 0.00 255.0 FORMAT "%5.1" ECU_ADDRESS 0x8FF73F /end MEASUREMENT
/begin MEASUREMENT MSidCD_stErrECUSelect_mp "Errorflag SG-Auswahl nicht plausibel" UBYTE OneToOne 1 100 0.00 255.0 FORMAT "%5.1" ECU_ADDRESS 0x8FF740 /end MEASUREMENT
/begin MEASUREMENT MSidCD_stInjOffECU "Einspritzverbot durch SG-Auswahl" UBYTE OneToOne 1 100 0.00 255.0 FORMAT "%5.1" ECU_ADDRESS 0x7F895A /end MEASUREMENT
/begin MEASUREMENT MSidCD_stSetEEPROM_mp "Status EEPROM (Schreiben) Lernen (SG-Auswahl)" UBYTE OneToOne 1 100 0.00 255.0 FORMAT "%5.1" ECU_ADDRESS 0x8FF741 /end MEASUREMENT
/begin MEASUREMENT MSidCD_swtECUinfo_mp "Input SG-Auswahl Info-EEPROM" UBYTE OneToOne 1 100 0.00 255.0 FORMAT "%5.1" ECU_ADDRESS 0x8FF742 /end MEASUREMENT
/begin MEASUREMENT MSidCD_swtECUnum_mp "storing EEPROM-info" UBYTE OneToOne 1 100 0.00 255.0 FORMAT "%5.1" ECU_ADDRESS 0x8FF743 /end MEASUREMENT
/begin MEASUREMENT MSidCD_swtMAIN "Typ der ECU: Single ECU=0xFF, Master Slave - Master: 0, Master Slave - Slave: 1,2,3 or 4" SBYTE OneToOne 1 100 -128.0 127.0 FORMAT "%5.1" ECU_ADDRESS 0x7F895C /end MEASUREMENT
/begin MEASUREMENT MSidCD_swtMasterHW_mp "Info SG-Auswahl (plausibilisiert)" SBYTE OneToOne 1 100 -128.0 127.0 FORMAT "%5.1" ECU_ADDRESS 0x8FF744 /end MEASUREMENT
/begin MEASUREMENT MSidCD_swtPinDrive_mp "Status SGA-Pin Rohwert" SBYTE OneToOne 1 100 -128.0 127.0 FORMAT "%5.1" ECU_ADDRESS 0x8FF745 /end MEASUREMENT
/begin MEASUREMENT MSidCD_swtPinECU_mp "Input HW-Pin" SBYTE OneToOne 1 100 -128.0 127.0 FORMAT "%5.1" ECU_ADDRESS 0x8FF746 /end MEASUREMENT
/begin MEASUREMENT NetMng_stCANBus "Status der CAN Controller" ULONG OneToOne 1 100 0.00 4294967295.00 FORMAT "%13.2" ECU_ADDRESS 0x7F9214 /end MEASUREMENT
/begin MEASUREMENT NetMng_stDfpCanA_mp "" UBYTE OneToOne 1 100 0.00 255.0 FORMAT "%5.1" ECU_ADDRESS 0x8FF747 /end MEASUREMENT
/begin MEASUREMENT NetMng_stDfpCanB_mp "" UBYTE OneToOne 1 100 0.00 255.0 FORMAT "%5.1" ECU_ADDRESS 0x8FF748 /end MEASUREMENT
/begin MEASUREMENT NetMng_stDfpCanC_mp "" UBYTE OneToOne 1 100 0.00 255.0 FORMAT "%5.1" ECU_ADDRESS 0x8FF749 /end MEASUREMENT
/begin MEASUREMENT NetMng_stDfpMaskPtCan_mp "" UBYTE OneToOne 1 100 0.00 255.0 FORMAT "%5.1" ECU_ADDRESS 0x8FF74A /end MEASUREMENT
/begin MEASUREMENT NetMng_stDisableMsg "disable message by diagnosis" UBYTE OneToOne 1 100 0.00 255.0 FORMAT "%5.1" ECU_ADDRESS 0x7F895D /end MEASUREMENT
/begin MEASUREMENT NetMng_stFadeOut "Status der CAN Ausblendung" UWORD OneToOne 1 100 0.00 65535.00 FORMAT "%8.2" ECU_ADDRESS 0x7F8F96 /end MEASUREMENT
/begin MEASUREMENT NetMng_stONWM "Aktueller Zustand des OSEK Netzwerkmanagements" UWORD OneToOne 1 100 0.00 65535.00 FORMAT "%8.2" ECU_ADDRESS 0x7F8F98 /end MEASUREMENT
/begin MEASUREMENT NSC_numPrio "Prioritätszahl des Regenerationsanforderungslevel des NOx-Specherkat" UWORD OneToOne 1 100 0.00 65535.00 FORMAT "%8.2" ECU_ADDRESS 0x7F8F94 /end MEASUREMENT
/begin MEASUREMENT NSC_st "von NOx-Speicherkatalysator angeforderter Regenerationsstatus" ULONG OneToOne 1 100 0.00 4294967295.00 FORMAT "%13.2" ECU_ADDRESS 0x7F9210 /end MEASUREMENT
/begin MEASUREMENT OPSCD_stInactive_mp "Status Abschaltung (Nachlauf,  ABS-Bremsung, Startfall)" UWORD OneToOne 1 100 0.00 65535.00 FORMAT "%8.2" ECU_ADDRESS 0x8FF74E /end MEASUREMENT
/begin MEASUREMENT OPSCD_stLampRun_mp "Meßpunkt für Laufzeitmessung" UWORD OneToOne 1 100 0.00 65535.00 FORMAT "%8.2" ECU_ADDRESS 0x8FF750 /end MEASUREMENT
/begin MEASUREMENT OPSCD_stpOEL "oil pressure sensor signal" UBYTE OneToOne 1 100 0.00 255.0 FORMAT "%5.1" ECU_ADDRESS 0x7F895F /end MEASUREMENT
/begin MEASUREMENT OPSCD_stSigOut "Ausgangssignal Öldruckschalter" UBYTE OneToOne 1 100 0.00 255.0 FORMAT "%5.1" ECU_ADDRESS 0x7F895E /end MEASUREMENT
/begin MEASUREMENT OPSCD_uRaw_POEL_mp "Voltage raw value of the oil pressure sensor" SWORD Volt 1 100 -160156.4 160151.5 FORMAT "%8.1" ECU_ADDRESS 0x8FF74C /end MEASUREMENT
/begin MEASUREMENT OTSCD_stPlaus "status der Plausibilitaetspruefung OTF/WTF" UBYTE OneToOne 1 100 0.00 255.0 FORMAT "%5.1" ECU_ADDRESS 0x7F8960 /end MEASUREMENT
/begin MEASUREMENT OTSCD_swtSig "Signalquelle Schalter ADC/CAN" UBYTE OneToOne 1 100 0.00 255.0 FORMAT "%5.1" ECU_ADDRESS 0x7F8961 /end MEASUREMENT
/begin MEASUREMENT OTSCD_tEngOil "Motoröltemperatur" SWORD Temp_Cels 1 100 -50.140 899.860 FORMAT "%8.3" ECU_ADDRESS 0x7F8F9A /end MEASUREMENT
/begin MEASUREMENT OTSCD_tEngOilLin "linearisierter Wert aus HWK vorm Aufruf der Übergangsfunktion" SWORD Temp_Cels 1 100 -50.140 899.860 FORMAT "%8.3" ECU_ADDRESS 0x7F8F9C /end MEASUREMENT
/begin MEASUREMENT OTSCD_uRaw "Rohwert des OTF-Sensors" SWORD Volt 1 100 -160156.4 160151.5 FORMAT "%8.1" ECU_ADDRESS 0x7F8F9E /end MEASUREMENT
/begin MEASUREMENT OvRMon_ct10MS "In der 10ms Scheibe inkrementierter Zähler, welcher zur Zeitlichen Steuerung von OvRMon_Co verwendet wird." UWORD OneToOne 1 100 0.00 65535.00 FORMAT "%8.2" ECU_ADDRESS 0x7F9AF0 /end MEASUREMENT
/begin MEASUREMENT OvRMon_ctDebET_mp "Entprellzähler der Schubüberwachung" UWORD OneToOne 1 100 0.00 65535.00 FORMAT "%8.2" ECU_ADDRESS 0x6F81B6 /end MEASUREMENT
/begin MEASUREMENT OvRMon_ctTORQUE_DSC "Zeitbegrenzungszähler für DSC Momentanforderung" UWORD OneToOne 1 100 0.00 65535.00 FORMAT "%8.2" ECU_ADDRESS 0x7F9B1C /end MEASUREMENT
/begin MEASUREMENT OvRMon_ctTORQUE_EGS "Zeitbegrenzungszähler für EGS; elektronisch gesteuertes Getriebe" UWORD OneToOne 1 100 0.00 65535.00 FORMAT "%8.2" ECU_ADDRESS 0x7F9B20 /end MEASUREMENT
/begin MEASUREMENT OvRMon_ctTORQUE_SSG "Zeitbegrenzungszähler für Momentenanforderung von SSG, Getriebe" UWORD OneToOne 1 100 0.00 65535.00 FORMAT "%8.2" ECU_ADDRESS 0x7F9B24 /end MEASUREMENT
/begin MEASUREMENT OvRMon_nAvrg "Redundante mittlere Drehzahl in der Schubüberwachung" SWORD EngN 1 100 -32768.00 32767.00 FORMAT "%8.2" ECU_ADDRESS 0x7F9B18 /end MEASUREMENT
/begin MEASUREMENT OvRMon_nSeg_mp "Mittlere Segmentdrehzahl in der Schubüberwachung" SWORD EngN 1 100 -32768.00 32767.00 FORMAT "%8.2" ECU_ADDRESS 0x8FF766 /end MEASUREMENT
/begin MEASUREMENT OvRMon_numTORQUE_DSCbyteraw_mp "Botschaft der DSC- Momentenanforderung; bitweise" UBYTE OneToOne 1 100 0.00 255.0 FORMAT "%5.1" ECU_ADDRESS 0x8FF77A /end MEASUREMENT
/begin MEASUREMENT OvRMon_numTORQUE_EGSbyteraw_mp "Botschaft der EGS- Momentenanforderung; bitweise, elektronisch gesteuertes Getriebe" UBYTE OneToOne 1 100 0.00 255.0 FORMAT "%5.1" ECU_ADDRESS 0x8FF77F /end MEASUREMENT
/begin MEASUREMENT OvRMon_numTORQUE_SSGbyteraw_mp "Botschaft Momentenanforderung SSG; bitweise, Getriebe" UBYTE OneToOne 1 100 0.00 255.0 FORMAT "%5.1" ECU_ADDRESS 0x8FF784 /end MEASUREMENT
/begin MEASUREMENT OvRMon_phiInjAct_mp "Winkel der zuletzt bearbeiteten Einspritzung" SWORD AngleCrS 1 100 -768.0000 767.9766 FORMAT "%8.4" ECU_ADDRESS 0x8FF776 /end MEASUREMENT
/begin MEASUREMENT OvRMon_stActive "zeigt die Aktivierung der Schubüberwachung für Ebene 1 an" UBYTE OneToOne 1 100 0.00 255.0 FORMAT "%5.1" ECU_ADDRESS 0x7F8962 /end MEASUREMENT
/begin MEASUREMENT OvRMon_stAPPDiff_mp "Status der Fahrpedalüberwachung" UBYTE OneToOne 1 100 0.00 255.0 FORMAT "%5.1" ECU_ADDRESS 0x8FF752 /end MEASUREMENT
/begin MEASUREMENT OvRMon_stBrkPressed_mp "Meldung Bremse betätigt in der Schubüberwachung" UBYTE OneToOne 1 100 0.00 255.0 FORMAT "%5.1" ECU_ADDRESS 0x8FF758 /end MEASUREMENT
/begin MEASUREMENT OvRMon_stBusOffDSC_mp "Zustand des inaktiven CAN- Bus der DSC Momentenanforderung;" UBYTE OneToOne 1 100 0.00 255.0 FORMAT "%5.1" ECU_ADDRESS 0x8FF77B /end MEASUREMENT
/begin MEASUREMENT OvRMon_stBusOffEGS_mp "Zustand des inaktiven CAN- Bus der EGS Momentenanforderung; elektronisch gesteuertes Getriebe" UBYTE OneToOne 1 100 0.00 255.0 FORMAT "%5.1" ECU_ADDRESS 0x8FF780 /end MEASUREMENT
/begin MEASUREMENT OvRMon_stBusOffSSG_mp "Zustand des inaktiven CAN- Bus der SSG Momentenanforderung; Getriebe" UBYTE OneToOne 1 100 0.00 255.0 FORMAT "%5.1" ECU_ADDRESS 0x8FF785 /end MEASUREMENT
/begin MEASUREMENT OvRMon_stConvDebVal_mp "entprelltes Kupplungssignal in der Schubüberwachung" UBYTE OneToOne 1 100 0.00 255.0 FORMAT "%5.1" ECU_ADDRESS 0x8FF759 /end MEASUREMENT
/begin MEASUREMENT OvRMon_stDCS_mp "Status DCS-Eingriff in der Schubüberwachung" UBYTE OneToOne 1 100 0.00 255.0 FORMAT "%5.1" ECU_ADDRESS 0x8FF75A /end MEASUREMENT
/begin MEASUREMENT OvRMon_stEngSpdRls_mp "redundante Erfassung der Drehzahlanforderungsfreigabe in der Überwachungsebene 2" UBYTE OneToOne 1 100 0.00 255.0 FORMAT "%5.1" ECU_ADDRESS 0x8FF75B /end MEASUREMENT
/begin MEASUREMENT OvRMon_stErrPassDSC_mp "Hardware Statusfehler für DSC" UBYTE OneToOne 1 100 0.00 255.0 FORMAT "%5.1" ECU_ADDRESS 0x8FF77C /end MEASUREMENT
/begin MEASUREMENT OvRMon_stErrPassEGS_mp "Hardware Fehlerstatus fuer EGS; elektronisch gesteuertes Getriebe" UBYTE OneToOne 1 100 0.00 255.0 FORMAT "%5.1" ECU_ADDRESS 0x8FF781 /end MEASUREMENT
/begin MEASUREMENT OvRMon_stErrPassSSG_mp "Hardware Statusfehler für SSG, Getriebe" UBYTE OneToOne 1 100 0.00 255.0 FORMAT "%5.1" ECU_ADDRESS 0x8FF786 /end MEASUREMENT
/begin MEASUREMENT OvRMon_stGrip_mp "redundante Kraftschlusserfassung in der Überwachungsebene 2" UBYTE OneToOne 1 100 0.00 255.0 FORMAT "%5.1" ECU_ADDRESS 0x8FF75C /end MEASUREMENT
/begin MEASUREMENT OvRMon_stHwDefDSC_mp "Zustand der inaktiven bzw. defekten Hardware für die DSC Momentenanforderung" UBYTE OneToOne 1 100 0.00 255.0 FORMAT "%5.1" ECU_ADDRESS 0x8FF77D /end MEASUREMENT
/begin MEASUREMENT OvRMon_stHwDefEGS_mp "Zustand der inaktiven bzw. defekten Hardware für die EGS Momentenanforderung" UBYTE OneToOne 1 100 0.00 255.0 FORMAT "%5.1" ECU_ADDRESS 0x8FF782 /end MEASUREMENT
/begin MEASUREMENT OvRMon_stHwDefSSG_mp "Zustand der inaktiven bzw. defekten Hardware für die SSG Momentenanforderung, Getriebe" UBYTE OneToOne 1 100 0.00 255.0 FORMAT "%5.1" ECU_ADDRESS 0x8FF787 /end MEASUREMENT
/begin MEASUREMENT OvRMon_stIntr "Interrupt-Status der operativen Ebene" UBYTE OneToOne 1 100 0.00 255.0 FORMAT "%5.1" ECU_ADDRESS 0x7FCD6C /end MEASUREMENT
/begin MEASUREMENT OvRMon_stIntrInactv_mp "Status der Interruptkennung" UBYTE OneToOne 1 100 0.00 255.0 FORMAT "%5.1" ECU_ADDRESS 0x8FF768 /end MEASUREMENT
/begin MEASUREMENT OvRMon_stLIGovRls "Status der LLR-Freigabe in der Schubüberwachung" UBYTE OneToOne 1 100 0.00 255.0 FORMAT "%5.1" ECU_ADDRESS 0x7F8963 /end MEASUREMENT
/begin MEASUREMENT OvRMon_stOvR "Freigabestatus der Schubüberwachung zur Übertragung vom Master zum Slave" UBYTE OneToOne 1 100 0.00 255.0 FORMAT "%5.1" ECU_ADDRESS 0x7F8964 /end MEASUREMENT
/begin MEASUREMENT OvRMon_stRls_mp "Status aller Freigabe Bits für die Schubüberwachung" UWORD OneToOne 1 100 0.00 65535.00 FORMAT "%8.2" ECU_ADDRESS 0x8FF75E /end MEASUREMENT
/begin MEASUREMENT OvRMon_stT15DebVal_mp "Entprelltes Klemme 15 Signal der Schubüberwachung" UBYTE OneToOne 1 100 0.00 255.0 FORMAT "%5.1" ECU_ADDRESS 0x8FF760 /end MEASUREMENT
/begin MEASUREMENT OvRMon_stTODSC_mp "Zeitbegrenzungszustand der Hardware für die DSC Momentenanforderung" UBYTE OneToOne 1 100 0.00 255.0 FORMAT "%5.1" ECU_ADDRESS 0x8FF77E /end MEASUREMENT
/begin MEASUREMENT OvRMon_stTOEGS_mp "Zeitbegrenzungszustand der Hardware für die EGS Momentenanforderung" UBYTE OneToOne 1 100 0.00 255.0 FORMAT "%5.1" ECU_ADDRESS 0x8FF783 /end MEASUREMENT
/begin MEASUREMENT OvRMon_stTOSSG_mp "Zeitbegrenzungszustand der Hardware für die SSG Momentenanforderung; Getriebe" UBYTE OneToOne 1 100 0.00 255.0 FORMAT "%5.1" ECU_ADDRESS 0x8FF788 /end MEASUREMENT
/begin MEASUREMENT OvRMon_stTrqDesDSC "Zustand der gewünschten Momentenanforderung der DSC" UBYTE OneToOne 1 100 0.00 255.0 FORMAT "%5.1" ECU_ADDRESS 0x7F9B1E /end MEASUREMENT
/begin MEASUREMENT OvRMon_stTrqDesEGS "Zustand der gewünschten Momentenanforderung der EGS" UBYTE OneToOne 1 100 0.00 255.0 FORMAT "%5.1" ECU_ADDRESS 0x7F9B22 /end MEASUREMENT
/begin MEASUREMENT OvRMon_stTrqDesSSG "Zustand der gewünschten Momentenanforderung der SSG; Getriebe" UBYTE OneToOne 1 100 0.00 255.0 FORMAT "%5.1" ECU_ADDRESS 0x7F9B26 /end MEASUREMENT
/begin MEASUREMENT OvRMon_stTSCInc_mp "Status erhöhender Eingriff Getriebesteuerung in der Schubüberwachung" UBYTE OneToOne 1 100 0.00 255.0 FORMAT "%5.1" ECU_ADDRESS 0x8FF761 /end MEASUREMENT
/begin MEASUREMENT OvRMon_tiInjAct_mp "Ansteuerdauer der zuletzt bearbeiteten Einspritzung" UWORD InjTime_us 1 100 0.00 65535.00 FORMAT "%8.2" ECU_ADDRESS 0x8FF778 /end MEASUREMENT
/begin MEASUREMENT OvRMon_tiIntrSysAct "Systemzeit vom aktuellen Main-Interrupt" ULONG OneToOne 1 100 0.00 4294967295.00 FORMAT "%13.2" ECU_ADDRESS 0x7FCD64 /end MEASUREMENT
/begin MEASUREMENT OvRMon_tiIntrSysLst "Systemzeit vom vorhergehenden Main-Interrupt" ULONG OneToOne 1 100 0.00 4294967295.00 FORMAT "%13.2" ECU_ADDRESS 0x7FCD68 /end MEASUREMENT
/begin MEASUREMENT OvRMon_tiLimET_mp "Obergrenze der Ansteuerdauer der Schubüberwachung" SWORD InjTime_us 1 100 -32768.00 32767.00 FORMAT "%8.2" ECU_ADDRESS 0x8FF762 /end MEASUREMENT
/begin MEASUREMENT OvRMon_tiOvRMonActive_mp "Zeit nach Aktivierung der Schubüberwachung" SWORD Time_ms 1 100 -327680.0 327670.0 FORMAT "%8.1" ECU_ADDRESS 0x6F81B8 /end MEASUREMENT
/begin MEASUREMENT OvRMon_tiTDCAvrg "Mittlere momentwirksame Ansteuerdauer pro Zylinder in der Schubüberwachung" UWORD InjTime_us 1 100 0.00 65535.00 FORMAT "%8.2" ECU_ADDRESS 0x7FCD70 /end MEASUREMENT
/begin MEASUREMENT OvRMon_tiTDCSumET_mp "Summe der momentwirksamen Ansteuerdauern eines Zylinders" UWORD InjTime_us 1 100 0.00 65535.00 FORMAT "%8.2" ARRAY_SIZE 6 ECU_ADDRESS 0x8FF76A /end MEASUREMENT
/begin MEASUREMENT OvRMon_uRawAPP1_mp "APP1 - Fahrpedalrohwert über OvRMon eingelesen" SWORD Volt 1 100 -160156.4 160151.5 FORMAT "%8.1" ECU_ADDRESS 0x8FF764 /end MEASUREMENT
/begin MEASUREMENT OvRMon_uRegAPP1_mp "ADC-Registerwert der Position von Fahrpedal 1" SWORD Volt 1 100 -160156.4 160151.5 FORMAT "%8.1" ECU_ADDRESS 0x8FF754 /end MEASUREMENT
/begin MEASUREMENT OvRMon_uRegAPP2_mp "ADC-Registerwert der Position von Fahrpedal 2" SWORD Volt 1 100 -160156.4 160151.5 FORMAT "%8.1" ECU_ADDRESS 0x8FF756 /end MEASUREMENT
/begin MEASUREMENT OxiCCD_tLinPre "linearisierter Wert Abgastemperatur vor Oxidationskatalysator" SWORD Temp_Cels 1 100 -50.140 899.860 FORMAT "%8.3" ECU_ADDRESS 0x7F8FA0 /end MEASUREMENT
/begin MEASUREMENT OxiCCD_tPre "Abgastemperatur vor Oxidationskatalysator" SWORD Temp_Cels 1 100 -50.140 899.860 FORMAT "%8.3" ECU_ADDRESS 0x7F8FA2 /end MEASUREMENT
/begin MEASUREMENT OxiCCD_uRawTempPre "Abgastemperatur vor Oxidationskatalysator Rohwert" SWORD Volt 1 100 0.00 5000.000 FORMAT "%8.3" ECU_ADDRESS 0x7F8FA4 /end MEASUREMENT
/begin MEASUREMENT PCBS_dAvaiDiag_mp "measure point for availability for reset CBS message with diagnose" UBYTE OneToOne 1 100 0.00 255.0 FORMAT "%5.1" ECU_ADDRESS 0x8FF789 /end MEASUREMENT
/begin MEASUREMENT PCBS_dAvaiDMEChg_mp "measure point for availability after DME change" UBYTE OneToOne 1 100 0.00 255.0 FORMAT "%5.1" ECU_ADDRESS 0x8FF78A /end MEASUREMENT
/begin MEASUREMENT PCBS_dAvaiOut "availability (CAN: AVAI_BOS_MESS)" UBYTE OneToOne 1 100 0.00 255.0 FORMAT "%5.1" ECU_ADDRESS 0x7F8966 /end MEASUREMENT
/begin MEASUREMENT PCBS_lDistanceOut "Available rest distance" SWORD km_sw_q10 1 100 -327680.0 327670.0 FORMAT "%8.1" ECU_ADDRESS 0x7F8FA6 /end MEASUREMENT
/begin MEASUREMENT PCBS_lMaxDistance_mp "maximum of the curve PCBS_lCalcDistance_CUR" SWORD km_sw_q10 1 100 -327680.0 327670.0 FORMAT "%8.1" ECU_ADDRESS 0x8FF78C /end MEASUREMENT
/begin MEASUREMENT PCBS_qFlTotDMEChg "" SLONG Fl_L 1 100 -21474836.4800 21474836.4700 FORMAT "%13.4" ECU_ADDRESS 0x7F9218 /end MEASUREMENT
/begin MEASUREMENT PCBS_stCBSMsg "state for CBS message" UBYTE OneToOne 1 100 0.00 255.0 FORMAT "%5.1" ECU_ADDRESS 0x7F8967 /end MEASUREMENT
/begin MEASUREMENT PCBS_stCntChgCAN_mp "measure point for service value after CBS reset by CAN" UBYTE OneToOne 1 100 0.00 255.0 FORMAT "%5.1" ECU_ADDRESS 0x8FF78E /end MEASUREMENT
/begin MEASUREMENT PCBS_stCntChgDIAG_mp "measure point for service value after CBS reset by diagnose" UBYTE OneToOne 1 100 0.00 255.0 FORMAT "%5.1" ECU_ADDRESS 0x8FF78F /end MEASUREMENT
/begin MEASUREMENT PCBS_stCntChg_mp "measure point for service value after CBS reset" UBYTE OneToOne 1 100 0.00 255.0 FORMAT "%5.1" ECU_ADDRESS 0x8FF790 /end MEASUREMENT
/begin MEASUREMENT PCBS_stCntDiag_mp "measure point service counter for reset CBS message with diagnose" UBYTE OneToOne 1 100 0.00 255.0 FORMAT "%5.1" ECU_ADDRESS 0x8FF791 /end MEASUREMENT
/begin MEASUREMENT PCBS_stCntValOut "service counter value" UBYTE OneToOne 1 100 0.00 255.0 FORMAT "%5.1" ECU_ADDRESS 0x7F8968 /end MEASUREMENT
/begin MEASUREMENT PCBS_stCntVal_mp "measure point for service counter value after CBS reset" UBYTE OneToOne 1 100 0.00 255.0 FORMAT "%5.1" ECU_ADDRESS 0x8FF792 /end MEASUREMENT
/begin MEASUREMENT PCBS_stDMEChg "" UBYTE OneToOne 1 100 0.00 255.0 FORMAT "%5.1" ECU_ADDRESS 0x7F8969 /end MEASUREMENT
/begin MEASUREMENT PCBS_stDMEChgOld "" UBYTE OneToOne 1 100 0.00 255.0 FORMAT "%5.1" ECU_ADDRESS 0x7F896A /end MEASUREMENT
/begin MEASUREMENT PCBS_stDMEIni_mp "measure point for CBS function init" UBYTE OneToOne 1 100 0.00 255.0 FORMAT "%5.1" ECU_ADDRESS 0x8FF793 /end MEASUREMENT
/begin MEASUREMENT PCBS_stIDMsg "ID for CBS message" UWORD OneToOne 1 100 0.00 65535.00 FORMAT "%8.2" ECU_ADDRESS 0x7F8FA8 /end MEASUREMENT
/begin MEASUREMENT PCBS_stPFltChg "" UBYTE OneToOne 1 100 0.00 255.0 FORMAT "%5.1" ECU_ADDRESS 0x7F896B /end MEASUREMENT
/begin MEASUREMENT PCBS_stPFltChgCAN_mp "measure point which shows if particulate filter were changed by CAN" UBYTE OneToOne 1 100 0.00 255.0 FORMAT "%5.1" ECU_ADDRESS 0x8FF794 /end MEASUREMENT
/begin MEASUREMENT PCBS_stPFltChgDIAG_mp "measure point which shows if particulate filter were changed by diagnose" UBYTE OneToOne 1 100 0.00 255.0 FORMAT "%5.1" ECU_ADDRESS 0x8FF795 /end MEASUREMENT
/begin MEASUREMENT PCBS_stResetDiag_mp "measure point for reset CBS message for PFlt with diagnose" UBYTE OneToOne 1 100 0.00 255.0 FORMAT "%5.1" ECU_ADDRESS 0x8FF796 /end MEASUREMENT
/begin MEASUREMENT PCBS_stUnit "unit of mearurement for CBS" UBYTE OneToOne 1 100 0.00 255.0 FORMAT "%5.1" ECU_ADDRESS 0x7F896C /end MEASUREMENT
/begin MEASUREMENT PCR_dnAvrg "Drehzahlgradient Basis für Korrekturfaktor D-Verstärkung" SWORD dn_dZ20 1 100 -327680.0 327670.0 FORMAT "%8.1" ECU_ADDRESS 0x7F8FAA /end MEASUREMENT
/begin MEASUREMENT PCR_dnAvrgNeg_mp "Rate of change of engine speed in negative direction" SWORD dn_dZ20 1 100 -327680.0 327670.0 FORMAT "%8.1" ECU_ADDRESS 0x8FF7B4 /end MEASUREMENT
/begin MEASUREMENT PCR_dnSurgeHigh_mp "Higher limit for hysteresis to monitor rate of change of Eng_nAvrg for Anti-Surge LIGov" SWORD dn_dZ20 1 100 -327680.0 327670.0 FORMAT "%8.1" ECU_ADDRESS 0x8FF7B6 /end MEASUREMENT
/begin MEASUREMENT PCR_dnSurgeLow_mp "Lower limit for hysteresis to monitor rate of change of Eng_nAvrg for Anti-Surge LIGov" SWORD dn_dZ20 1 100 -327680.0 327670.0 FORMAT "%8.1" ECU_ADDRESS 0x8FF7B8 /end MEASUREMENT
/begin MEASUREMENT PCR_nSetPointSurge "Set Point for Anti-Surge LIGov" SWORD EngN 1 100 -32768.00 32767.00 FORMAT "%8.2" ECU_ADDRESS 0x7F8FB0 /end MEASUREMENT
/begin MEASUREMENT PCR_qCtlFrmMngTrqInr_mp "Controlled quantity based on FrmMng_trqInr and FMTC_etaCurr" SWORD InjMass 1 100 -327.6800 327.6700 FORMAT "%8.4" ECU_ADDRESS 0x8FF798 /end MEASUREMENT
/begin MEASUREMENT PCR_qCtl_mp "für die Ladedruck Steuerung begrenzte Einspritzmenge" SWORD InjMassCyc 1 100 -327.6800 327.6700 FORMAT "%8.4" ECU_ADDRESS 0x8FF79A /end MEASUREMENT
/begin MEASUREMENT PCR_qSurgeHigh_mp "Higher quantity limit for hysteresis of Anti-Surge LIGov" SWORD InjMass 1 100 -327.6800 327.6700 FORMAT "%8.4" ECU_ADDRESS 0x8FF7BA /end MEASUREMENT
/begin MEASUREMENT PCR_qSurgeLow_mp "Lower quantity limit for hysteresis of Anti-Surge LIGov" SWORD InjMass 1 100 -327.6800 327.6700 FORMAT "%8.4" ECU_ADDRESS 0x8FF7BC /end MEASUREMENT
/begin MEASUREMENT PCR_rBalGvnrDiff "Tastverhältnis Gleichstellungsregler" SWORD Prc 1 100 -400.0000 399.9878 FORMAT "%8.4" ECU_ADDRESS 0x7F8FCC /end MEASUREMENT
/begin MEASUREMENT PCR_rBPCtlAPCorrRgn_mp "in Abhängigkeit des Atmosphärendruckskorrigierter Steuerwert bei Regenerationsbetrieb" SWORD Prc 1 100 -400.0000 399.9878 FORMAT "%8.4" ECU_ADDRESS 0x8FF79C /end MEASUREMENT
/begin MEASUREMENT PCR_rBPCtlAPCorr_mp "in Abhängigkeit des Atmosphärendrucks korrigierter Steuerwert" SWORD Prc 1 100 -400.0000 399.9878 FORMAT "%8.4" ECU_ADDRESS 0x8FF79E /end MEASUREMENT
/begin MEASUREMENT PCR_rBPCtlATCorrRgn_mp "Lufttemperaturabhängige Korrektur im Regenerationsbetrieb" SWORD Prc 1 100 -400.0000 399.9878 FORMAT "%8.4" ECU_ADDRESS 0x8FF7A0 /end MEASUREMENT
/begin MEASUREMENT PCR_rBPCtlATCorr_mp "Lufttemperaturabhängige Korrektur" SWORD Prc 1 100 -400.0000 399.9878 FORMAT "%8.4" ECU_ADDRESS 0x8FF7A2 /end MEASUREMENT
/begin MEASUREMENT PCR_rBPCtlBasCorr_mp "Corrected value in normal operation" SWORD Prc 1 100 -400.0000 399.9878 FORMAT "%8.4" ECU_ADDRESS 0x8FF7A4 /end MEASUREMENT
/begin MEASUREMENT PCR_rBPCtlBasRgn1Corr_mp "Corrected value for particle filter soot mass" SWORD Prc 1 100 -400.0000 399.9878 FORMAT "%8.4" ECU_ADDRESS 0x8FF7A6 /end MEASUREMENT
/begin MEASUREMENT PCR_rBPCtlBasRgn1_mp "Basisregenerationswert 1" SWORD Prc 1 100 -400.0000 399.9878 FORMAT "%8.4" ECU_ADDRESS 0x8FF7A8 /end MEASUREMENT
/begin MEASUREMENT PCR_rBPCtlBasRgn2_mp "Basisregenerationswert 2" SWORD Prc 1 100 -400.0000 399.9878 FORMAT "%8.4" ECU_ADDRESS 0x8FF7AA /end MEASUREMENT
/begin MEASUREMENT PCR_rBPCtlBas_mp "Basissteuerwert für Ladedruck" SWORD Prc 1 100 -400.0000 399.9878 FORMAT "%8.4" ECU_ADDRESS 0x8FF7AC /end MEASUREMENT
/begin MEASUREMENT PCR_rCtlSurgeBas_mp "boost pressure control value for Anti-Surge LIGov" SWORD Prc 1 100 -400.0000 399.9878 FORMAT "%8.4" ECU_ADDRESS 0x8FF7AE /end MEASUREMENT
/begin MEASUREMENT PCR_rCtlVal "Ladedruck Steueranteil der Stellgrösse" SWORD Prc 1 100 -400.0000 399.9878 FORMAT "%8.4" ECU_ADDRESS 0x7F8FCE /end MEASUREMENT
/begin MEASUREMENT PCR_rCtlVal1_mp "Kühlmitteltemperatur behob Wert der gewünschten Erhöhungsdruckregelung" SWORD Prc 1 100 -400.0000 399.9878 FORMAT "%8.4" ECU_ADDRESS 0x8FF7B0 /end MEASUREMENT
/begin MEASUREMENT PCR_rCtlVal2_mp "Kühlmitteltemperatur behob Wert der gewünschten Erhöhungsdruckregelung" SWORD Prc 1 100 -400.0000 399.9878 FORMAT "%8.4" ECU_ADDRESS 0x8FF7B2 /end MEASUREMENT
/begin MEASUREMENT PCR_rSurgeHysHigh_mp "Higher ATL pressure ratio limit for hysteresis of Anti-Surge LIGov" SWORD Prc 1 100 -400.0000 399.9878 FORMAT "%8.4" ECU_ADDRESS 0x8FF7BE /end MEASUREMENT
/begin MEASUREMENT PCR_rSurgeHysLow_mp "Lower ATL pressure ratio limit for hysteresis of Anti-Surge LIGov" SWORD Prc 1 100 -400.0000 399.9878 FORMAT "%8.4" ECU_ADDRESS 0x8FF7C0 /end MEASUREMENT
/begin MEASUREMENT PCR_rSurgeLIGov "" SWORD Prc 1 100 -400.0000 399.9878 FORMAT "%8.4" ECU_ADDRESS 0x7F8FDA /end MEASUREMENT
/begin MEASUREMENT PCR_rSurgeLIGov_mp "ALT Pressure ratio for Anti-Surge LIGov" SWORD Prc 1 100 -400.0000 399.9878 FORMAT "%8.4" ECU_ADDRESS 0x8FF7C2 /end MEASUREMENT
/begin MEASUREMENT PCR_stSurge1 "Anti-Surge LIGov status1" UBYTE OneToOne 1 100 0.00 255.0 FORMAT "%5.1" ECU_ADDRESS 0x7F8972 /end MEASUREMENT
/begin MEASUREMENT PCR_stSurge1_mp "Anti-Surge LIGov status1 without engine speed monitoring" UBYTE OneToOne 1 100 0.00 255.0 FORMAT "%5.1" ECU_ADDRESS 0x8FF7C4 /end MEASUREMENT
/begin MEASUREMENT PCR_stSurge2 "Anti-Surge LIGov status2" UBYTE OneToOne 1 100 0.00 255.0 FORMAT "%5.1" ECU_ADDRESS 0x7F8973 /end MEASUREMENT
/begin MEASUREMENT PCR_stSurgePre1_mp "Pre1 status of  Anti-Surge LIGov" UBYTE OneToOne 1 100 0.00 255.0 FORMAT "%5.1" ECU_ADDRESS 0x8FF7C5 /end MEASUREMENT
/begin MEASUREMENT PCR_stSurgePre2_mp "Pre2 status of  Anti-Surge LIGov" UBYTE OneToOne 1 100 0.00 255.0 FORMAT "%5.1" ECU_ADDRESS 0x8FF7C6 /end MEASUREMENT
/begin MEASUREMENT PCR_swtQntCtl "Schalter zur Auswahl der für Steuerung verwendeten Einspritzmenge" UBYTE OneToOne 1 100 0.00 255.0 FORMAT "%5.1" ECU_ADDRESS 0x7F8978 /end MEASUREMENT
/begin FUNCTION lsucd_wiredia "Überwachung und Fehlererkennung von Kabel"
 /begin DEF_CHARACTERISTIC LSUCD_dcycMinGrad_C LSUCD_DebHtCoupDef_C LSUCD_DebHtCoupOk_C LSUCD_DebWireIpDef_C LSUCD_DebWireIpOk_C LSUCD_dNumHtCoup_C LSUCD_resRiMaxGrad_C LSUCD_rO2IsolChkMax_C LSUCD_rO2IsolChkMin_C LSUCD_stWireDiaActv_C LSUCD_tiHtCoupChk_C LSUCD_tiHtCoupPer_C LSUCD_tiIsolChkErr_C LSUCD_tiIsolChkPer_C LSUCD_tiIsolChkPump_C LSUCD_tiHtCoupFlt_C LSUCD_uO2MaxGrad_C LSUCD_uO2MaxRippel_C /end DEF_CHARACTERISTIC
 /begin OUT_MEASUREMENT LSUCD_dcycRippel_mp LSUCD_resRiRippel_mp LSUCD_stRecValEval_mp LSUCD_stTstTrigger_mp LSUCD_stWireDiaChk_mp LSUCD_stWireDiaErr_mp LSUCD_uO2FltRippel_mp LSUCD_uO2Grad_mp LSUCD_uO2Rippel_mp /end OUT_MEASUREMENT
/end FUNCTION
/begin FUNCTION lsucd_wiredia_100ms ""
 /begin DEF_CHARACTERISTIC LSUCD_tiOpnLdTstActv_C LSUCD_tiRiMeasDisa_C LSUCD_uO2OpnLdNernstMax_C LSUCD_uO2OpnLdNernstMin_C LSUCD_uO2OpnLdVirtGndMax_C LSUCD_uO2OpnLdVirtGndMin_C LSUCD_uRiOpnLdTstMax_C LSUCD_tiDebNoLdErrIPDef_C LSUCD_tiDebNoLdErrIPOk_C LSUCD_DebOpnLdVirtGndDef_C LSUCD_DebOpnLdVirtGndOk_C LSUCD_DebOpnLdNernstDef_C LSUCD_DebOpnLdNernstOk_C LSUCD_tiDebLowBattErrDef_C LSUCD_tiDebLowBattErrOk_C LSUCD_tiDebCircNernstDef_C LSUCD_tiDebCircNernstOk_C LSUCD_tiDebCircPumpDef_C LSUCD_tiDebCircPumpOk_C LSUCD_tiDebCircVirtGndDef_C LSUCD_tiDebCircVirtGndOk_C /end DEF_CHARACTERISTIC
/end FUNCTION
/begin FUNCTION lsucd_wiredia_100ms_msg "" /begin OUT_MEASUREMENT LSUCD_stOpnErrIP LSUCD_stOpnLdTstActv /end OUT_MEASUREMENT /end FUNCTION
/begin FUNCTION lsucd_wiredia_msg ""
 /begin OUT_MEASUREMENT LSUCD_ctHtCoup LSUCD_dcycHtCoupStep1 LSUCD_dcycHtCoupStep2 LSUCD_dcycHtCoupStep3 LSUCD_dHtCoupStep LSUCD_dHtCoupStepLast LSUCD_resRiHtCoupStep1 LSUCD_resRiHtCoupStep2 LSUCD_resRiHtCoupStep3 LSUCD_stDiaIAEna LSUCD_stHtCoupActv LSUCD_stInitClb LSUCD_stIsolChkActv LSUCD_stIsolChkO2Last LSUCD_stIsolChkStrt LSUCD_stPumpEna LSUCD_uO2HtCoupStep1 LSUCD_uO2HtCoupStep2 LSUCD_uO2HtCoupStep3 /end OUT_MEASUREMENT
/end FUNCTION
/begin FUNCTION lsucd_wiredia_uic "" /end FUNCTION
/begin FUNCTION lsuctl "Regelung zur Lambdaerfassung"
 /begin DEF_CHARACTERISTIC LSUCtl_tUpLim_C LSUCtl_tLowLim_C LSUCtl_tRiSetPoint_C LSUCtl_tHtCtlEna_C LSUCtl_nHtCtlEna_C LSUCtl_dcycHtMin_C LSUCtl_tExcMax_C LSUCtl_tExcMin_C LSUCtl_tiDelIniVal_C LSUCtl_dcycRmpUp_C LSUCtl_dcycRmpDwn_C LSUCtl_dcycStrt_CUR LSUCtl_tiDebRiExcMaxDef_C LSUCtl_tiDebRiExcMaxOk_C LSUCtl_tiDebRiExcMinDef_C LSUCtl_tiDebRiExcMinOk_C LSUCtl_tiSens1HtDT1_C LSUCtl_Sens1HtDT1Kd_C LSUCtl_Sens1HtIKi_C LSUCtl_Sens1HtIKiPos_C LSUCtl_Sens1HtIKiNeg_C LSUCtl_tSens1HtIWinPos_C LSUCtl_tSens1HtIWinNeg_C LSUCtl_Sens1HtPKp_C LSUCtl_Sens1HtPKpPos_C LSUCtl_Sens1HtPKpNeg_C LSUCtl_tSens1HtPWinPos_C LSUCtl_tSens1HtPWinNeg_C LSUCtl_tiSens2HtDT1_C LSUCtl_Sens2HtDT1Kd_C LSUCtl_Sens2HtIKi_C LSUCtl_Sens2HtIKiPos_C LSUCtl_Sens2HtIKiNeg_C LSUCtl_tSens2HtIWinPos_C LSUCtl_tSens2HtIWinNeg_C LSUCtl_Sens2HtPKp_C LSUCtl_Sens2HtPKpPos_C LSUCtl_Sens2HtPKpNeg_C LSUCtl_tSens2HtPWinPos_C LSUCtl_tSens2HtPWinNeg_C /end DEF_CHARACTERISTIC
 /begin OUT_MEASUREMENT LSUCtl_dcycDT1_mp LSUCtl_dcycPI_mp LSUCtl_stRmp_mp LSUCtl_tAirStrt_mp LSUCtl_tDvt_mp /end OUT_MEASUREMENT
/end FUNCTION
/begin FUNCTION lsuctl_msg ""
 /begin OUT_MEASUREMENT LSUCtl_dcycHt LSUCtl_dcycHtIniRamp LSUCtl_dcycHtStrt LSUCtl_stHtCtl LSUCtl_stHtDisable LSUCtl_stSCUNEna /end OUT_MEASUREMENT
/end FUNCTION
/begin FUNCTION lsu_clbsched "Lambda-Sensor Universal-Kalibrierungs-Scheduler"
 /begin DEF_CHARACTERISTIC LSU_ctRgnEna_C LSU_mAirMaxClb1_C LSU_mAirMaxClb2_C LSU_mAirMinClb1_C LSU_mAirMinClb2_C LSU_nMaxClb1_C LSU_nMaxClb2_C LSU_nMinClb1_C LSU_nMinClb2_C LSU_qMaxClb1_C LSU_qMaxClb2_C LSU_qMinClb1_C LSU_qMinClb2_C LSU_stChpClbActv_C LSU_stEGTClbOff_C LSU_ti1stClb_C LSU_tiPerClb_C LSU_uMinClb_C /end DEF_CHARACTERISTIC
 /begin OUT_MEASUREMENT LSU_stClbTrg_mp LSU_stNotOpPoint1_mp LSU_stNotOpPoint2_mp /end OUT_MEASUREMENT
/end FUNCTION
/begin FUNCTION lsu_clbsched_msg "" /begin OUT_MEASUREMENT LSU_stClbDisable LSU_stStrtClb LSU_stTmrClbPerRun /end OUT_MEASUREMENT /end FUNCTION
/begin FUNCTION lsu_conf ""
 /begin DEF_CHARACTERISTIC LSUCD_stCJChpSel_C LSUCD_stRgnEna_C LSU_dcycMax_C LSU_tiBattHighDebNeg_C LSU_tiBattHighDebPos_C LSU_tiOvrRunDebNeg_C LSU_tiOvrRunDebPos_C LSU_swtVal_C LSU_swtType_C LSU_uBattMin_C /end DEF_CHARACTERISTIC
/end FUNCTION
/begin FUNCTION lsu_lmbdcalc "Berechnung Lambda und 1/Lambda" /begin DEF_CHARACTERISTIC LSU_rLmbdRec_CUR /end DEF_CHARACTERISTIC /begin OUT_MEASUREMENT LSU_rO2AdptLastLSU_mp /end OUT_MEASUREMENT /end FUNCTION
/begin FUNCTION lsu_lmbdcalc_msg "" /end FUNCTION
/begin FUNCTION lsu_lmbdcalc_msg_var "" /begin OUT_MEASUREMENT LSU_rLmbd LSU_rLmbdRec LSU_rO2Adpt /end OUT_MEASUREMENT /end FUNCTION
/begin FUNCTION lsu_lmbdcalc_uic "" /end FUNCTION
/begin FUNCTION lsu_mon "Lambda-Sensor Universal-Diagnosefunktion"
 /begin DEF_CHARACTERISTIC LSU_DebDynErrDef_C LSU_DebDynErrOk_C LSU_DebO2ConcHighDef_C LSU_DebO2ConcHighOk_C LSU_DebO2ConcLowDef_C LSU_DebO2ConcLowOk_C LSU_mAirMax_C LSU_mAirMin_C LSU_nMax_C LSU_nMinChkDyn_C LSU_nMin_C LSU_qDiffMax_C LSU_qMax_C LSU_qMin_C LSU_qThresChkDyn_C LSU_qThresOvrRun_C LSU_rO2ConstVal_C LSU_tiDvtFlt_C LSU_rO2Lmbd1Thres_C LSU_rO2MaxVar_C LSU_rO2Min_C LSU_rO2NegDvt_C LSU_rO2PosDvt_C LSU_stMonActv_C LSU_stMonMsk_C LSU_stSelPlausChkSig_C LSU_tiDvt1Flt_C LSU_tiO2CalcFlt_C LSU_tiO2Eval_C LSU_tiSwitch_CA LSU_tiWait1_CA LSU_tiWait2_CA LSU_tiWait3_CA LSU_volMinFl_C /end DEF_CHARACTERISTIC
 /begin OUT_MEASUREMENT LSU_rO2Stat_mp LSU_rO2Thres1_mp LSU_rO2Thres2_mp LSU_stChkDyn_mp LSU_stO2Chk_mp LSU_stO2Err_mp LSU_stPlausChkCon_mp LSU_stPlausChk_mp LSU_tiState1_mp /end OUT_MEASUREMENT
/end FUNCTION
/begin FUNCTION lsu_mon_msg ""
 /begin OUT_MEASUREMENT LSU_rO2ActVal LSU_rO2DiffCmpChk LSU_rO2Lmbd1Thres LSU_rO2MaxDiff LSU_rO2MaxVal LSU_rO2MinVal LSU_rO2RawFlt LSU_stConstPOp LSU_tiState2 LSU_tiState3 LSU_tiSwitch LSU_tiWait3 /end OUT_MEASUREMENT
/end FUNCTION
/begin FUNCTION lsu_mon_uic ""
 /begin OUT_MEASUREMENT LSU_bpPlausSetPoint_mp LSU_qStrt_mp LSU_rO2Calc_mp LSU_rO2DvtNeg_mp LSU_rO2DvtPos_mp /end OUT_MEASUREMENT
/end FUNCTION
/begin FUNCTION lubcd_co ""
 /begin DEF_CHARACTERISTIC LubCD_ctInitDly_C LubCD_ctTogErr_C LubCD_numDioIn_C LubCD_stLoadPwmInInv_C LubCD_swtTogVer_C LubCD_tiTimeOut_C /end DEF_CHARACTERISTIC
/end FUNCTION
/begin FUNCTION lubcd_co_msg ""
 /begin OUT_MEASUREMENT ctHigh ctLow LubCD_ctHigh LubCD_ctLow LubCD_ctTog LubCD_dioIn LubCD_st LubCD_stOelTog LubCD_stTOel LubCD_stTog LubCD_titk LubCD_titr LubCD_titv LubCD_Tog_icnt LubCD_Tog_uplcnt /end OUT_MEASUREMENT
/end FUNCTION
/begin FUNCTION lubcd_co_uic "" /begin OUT_MEASUREMENT LubCD_stErr_mp LubCD_tiHigh_mp LubCD_tiLow_mp /end OUT_MEASUREMENT /end FUNCTION
/begin FUNCTION mcy315_conf ""
 /begin DEF_CHARACTERISTIC CrSCD_numGlFilter_C CrSCD_numThresCtlHigh_C CrSCD_numThresCtlLow_C /end DEF_CHARACTERISTIC
/end FUNCTION
/begin FUNCTION mcy33x_conf ""
 /begin DEF_CHARACTERISTIC InjVlv_iLvlHi1_C InjVlv_iLvlHi2_C InjVlv_iLvlHi3_C InjVlv_iLvlLo1_C InjVlv_iLvlLo2_C InjVlv_iLvlLo3_C InjVlv_iThresMax_C InjVlv_stInj_C InjVlv_stRatRchgOff_C InjVlv_stRegCfg_C InjVlv_stRegDcc_C InjVlv_stRegDmsk_C InjVlv_stRegMode_C InjVlv_stTiBstErrMax_C InjVlv_stTiBstErrMin_C InjVlv_stTiCY330Del_C InjVlv_stTiDelAftFastIDec_C InjVlv_stTiDelAftRchg_C InjVlv_stTiDelBefLSMode_C InjVlv_stTiFastIDecErrMax_C InjVlv_stTiInjMax_C InjVlv_stTiMaxRchg_C InjVlv_uCMax_C InjVlv_uCMin_C InjVlv_uCSetPoint_C InjVlv_uCThresBstStop_C /end DEF_CHARACTERISTIC
/end FUNCTION
/begin FUNCTION memmon "Überwachung des Speichers"
 /begin DEF_CHARACTERISTIC MemMon_numErrChkRam_C MemMon_numErrChkRom_C MemMon_tiHealChkRam_C MemMon_tiHealChkRom_C /end DEF_CHARACTERISTIC
/end FUNCTION
/begin FUNCTION memmon_msg ""
 /begin OUT_MEASUREMENT MemMon_ctErrChkRam MemMon_ctErrChkRom MemMon_ctHealChkRam MemMon_ctHealChkRom MemMon_st /end OUT_MEASUREMENT
/end FUNCTION
/begin FUNCTION meuncd_co "Zumeßeinheit"
 /begin DEF_CHARACTERISTIC MeUnCD_uSRCMin_C MeUnCD_uSRCMax_C MeUnCD_iLin_CUR MeUnCD_ctPwrStgOnMax_C MeUnCD_dcycMax_C MeUnCD_dcycMin_C MeUnCD_dcycSetValLin_CUR MeUnCD_dcycTst_C MeUnCD_DebExcTempDef_C MeUnCD_DebExcTempOk_C MeUnCD_DebNoLoadDef_C MeUnCD_DebNoLoadOk_C MeUnCD_DebShortCircBatDef_C MeUnCD_DebShortCircBatOk_C MeUnCD_DebShortCircGndDef_C MeUnCD_DebShortCircGndOk_C MeUnCD_DebSRCHighDef_C MeUnCD_DebSRCHighOk_C MeUnCD_DebSRCLowDef_C MeUnCD_DebSRCLowOk_C MeUnCD_facIGovInit_CUR MeUnCD_facIGovMax_C MeUnCD_facIGovMin_C MeUnCD_tiFlt1PT1_C MeUnCD_tiFlt2PT1_C MeUnCD_tiIGovDT1_C MeUnCD_IGovDKd_C MeUnCD_IGovIKi_C MeUnCD_IGovIKiPos_C MeUnCD_IGovIKiNeg_C MeUnCD_iIGovIWinPos_C MeUnCD_iIGovIWinNeg_C MeUnCD_tiFltPT1Init_C MeUnCD_nDiffMax_C MeUnCD_numAdc_C MeUnCD_numDia1_C MeUnCD_numDia2_C MeUnCD_numPwmOut_C MeUnCD_resCoil_C MeUnCD_stInvOut_C MeUnCD_stPwrStgDia_C MeUnCD_stSPICtl_C MeUnCD_swt_C MeUnCD_tiBtwTst_C MeUnCD_tiIGovInit_C MeUnCD_tiPer_CUR MeUnCD_tiPwrStgOn_C MeUnCD_tiDebSigDefSigTst_C MeUnCD_tiDebSigOkSigTst_C /end DEF_CHARACTERISTIC
 /begin IN_MEASUREMENT FlSys_t MeUnCD_dcycSetVal_mp MeUnCD_nDiffRef_mp MeUnCD_uRawVal_mp /end IN_MEASUREMENT
/end FUNCTION
/begin FUNCTION meuncd_co_msg "" /begin OUT_MEASUREMENT MeUnCD_iGovActVal MeUnCD_iSetFlt /end OUT_MEASUREMENT /end FUNCTION
/begin FUNCTION meuncd_co_uic ""
 /begin OUT_MEASUREMENT MeUnCD_dcycDT1_mp MeUnCD_dcycOut_mp MeUnCD_dcycSetValLin_mp MeUnCD_dcycSetVal_mp MeUnCD_facIGov_mp MeUnCD_iActFlt_mp MeUnCD_iDvt_mp MeUnCD_nDiffRef_mp MeUnCD_tiPer_mp MeUnCD_uRawVal_mp /end OUT_MEASUREMENT
/end FUNCTION
/begin FUNCTION meun_setcurr "Berechnung elektrischer Sollstrom für die Zumesseinheit"
 /begin DEF_CHARACTERISTIC MeUn_iCnvFlowRate_CUR MeUn_iSetMin_C MeUn_pActrPrt_C MeUn_pFlowOfFl_C /end DEF_CHARACTERISTIC
 /begin IN_MEASUREMENT Rail_dvolMeUnSet /end IN_MEASUREMENT
/end FUNCTION
/begin FUNCTION meun_setcurr_uic "" /begin DEF_CHARACTERISTIC MeUn_iSet_Vector MeUn_iSet_Channel /end DEF_CHARACTERISTIC /begin OUT_MEASUREMENT MeUn_iSet_mp MeUn_stActrCtl_mp /end OUT_MEASUREMENT /end FUNCTION
/begin FUNCTION models "" /end FUNCTION
/begin FUNCTION mrlycd "Hauptrelais Komponententreiber"
 /begin DEF_CHARACTERISTIC MRlyCD_ctTooEarlyThres_C MRlyCD_numDioOutMnRly_C MRlyCD_numDioOutPSOFF_C MRlyCD_stInvOut_C MRlyCD_tiNotOpen_C /end DEF_CHARACTERISTIC
/end FUNCTION
/begin FUNCTION mrlycd_msg "" /begin OUT_MEASUREMENT MRlyCD_stMon MRlyCD_stPrevOpening /end OUT_MEASUREMENT /end FUNCTION
/begin FUNCTION mrlycd_uic "" /begin OUT_MEASUREMENT MRlyCD_ctTooEarlyInit_mp MRlyCD_ctTooEarly_mp /end OUT_MEASUREMENT /end FUNCTION
/begin FUNCTION msid "Master-Slave-Erkennung (Steuergeräteauswahl)"
 /begin DEF_CHARACTERISTIC MSidCD_Comm_DebNplDef_C MSidCD_Comm_DebNplOk_C MSidCD_numECUS_C MSidCD_Pin_DebSigDef_C MSidCD_Pin_DebSigOk_C MSidCD_Select_DebNplDef_C MSidCD_Select_DebNplOk_C MSidCD_Sel_INI_DebNplDef_C MSidCD_Sel_INI_DebNplOk_C MSidCD_Sel_INI_DebSigDef_C MSidCD_Sel_INI_DebSigOk_C MSidCD_stCANprivErrMsk_C MSidCD_stErrInjOFF_C MSidCD_stInv_C MSidCD_swtCanDeb_C MSidCD_swtLearn_C MSidCD_swtMAIN_C MSidCD_tiCanDeb_C /end DEF_CHARACTERISTIC
/end FUNCTION
/begin FUNCTION msid_msg "" /begin OUT_MEASUREMENT MSidCD_numECUS MSidCD_stInjOffECU MSidCD_swtMAIN /end OUT_MEASUREMENT /end FUNCTION
/begin FUNCTION msid_uic ""
 /begin OUT_MEASUREMENT MSidCD_stCANpriv_mp MSidCD_stECUCANpriv_mp MSidCD_stECUCANPtHelp_mp MSidCD_stECULearned_mp MSidCD_stECULTmp_mp MSidCD_stECUPlaus_mp MSidCD_stECUSelect_mp MSidCD_stECUStatus_mp MSidCD_stErrEcuPinComm_mp MSidCD_stErrECUSelect_mp MSidCD_stSetEEPROM_mp MSidCD_swtECUinfo_mp MSidCD_swtECUnum_mp MSidCD_swtMasterHW_mp MSidCD_swtPinDrive_mp MSidCD_swtPinECU_mp /end OUT_MEASUREMENT
/end FUNCTION
/begin FUNCTION netmng "Netzwerk Manager" /begin DEF_CHARACTERISTIC NetMng_swtONWM_C /end DEF_CHARACTERISTIC /end FUNCTION
/begin FUNCTION netmng_errhndl "Fehlerhandler"
 /begin DEF_CHARACTERISTIC NetMng_CANFadeOutMaskA_C NetMng_CANFadeOutMaskB_C NetMng_CANFadeOutMaskC_C NetMng_ctBusOffRetriesA_C NetMng_ctBusOffRetriesB_C NetMng_ctBusOffRetriesC_C NetMng_ctInitRetryCanA_C NetMng_ctInitRetryCanB_C NetMng_ctInitRetryCanC_C NetMng_tiDebPosBusMonCanA_C NetMng_tiDebNegBusMonCanA_C NetMng_tiDebPosBusMonCanB_C NetMng_tiDebNegBusMonCanB_C NetMng_tiDebPosBusMonCanC_C NetMng_tiDebNegBusMonCanC_C NetMng_tiDebPosBusOffCanA_C NetMng_tiDebNegBusOffCanA_C NetMng_tiDebPosBusOffCanB_C NetMng_tiDebNegBusOffCanB_C NetMng_tiDebPosBusOffCanC_C NetMng_tiDebNegBusOffCanC_C NetMng_tiDebPosErrCanA_C NetMng_tiDebNegErrCanA_C NetMng_tiDebPosErrCanB_C NetMng_tiDebNegErrCanB_C NetMng_tiDebPosErrCanC_C NetMng_tiDebNegErrCanC_C NetMng_tiDebPosMonCanA_C NetMng_tiDebNegMonCanA_C NetMng_tiDebPosMonCanB_C NetMng_tiDebNegMonCanB_C NetMng_tiDebPosMonCanC_C NetMng_tiDebNegMonCanC_C NetMng_FadeOutMaskA_C NetMng_FadeOutMaskB_C NetMng_FadeOutMaskC_C NetMng_SplyVltgHysXLow_C NetMng_SplyVltgHysXHigh_C NetMng_SplyVltgHysYLow_C NetMng_SplyVltgHysYHigh_C NetMng_tiFadeoutLowBat_C NetMng_tiFadeoutMin_C NetMng_tiRecoverA_C NetMng_tiRecoverB_C NetMng_tiRecoverC_C NetMng_tiTimeoutDNMT_C /end DEF_CHARACTERISTIC
/end FUNCTION
/begin FUNCTION netmng_msg ""
 /begin OUT_MEASUREMENT NetMng_stCANBus NetMng_stDisableMsg NetMng_stFadeOut NetMng_stONWM /end OUT_MEASUREMENT
/end FUNCTION
/begin FUNCTION netmng_uic ""
 /begin OUT_MEASUREMENT NetMng_stDfpCanA_mp NetMng_stDfpCanB_mp NetMng_stDfpCanC_mp NetMng_stDfpMaskPtCan_mp /end OUT_MEASUREMENT
/end FUNCTION
/begin FUNCTION nsc_corgn "coordinator for NOx cat regeneration" /begin DEF_CHARACTERISTIC NSC_numPrio_C NSC_st_C /end DEF_CHARACTERISTIC /end FUNCTION
/begin FUNCTION nsc_corgn_msg "" /begin OUT_MEASUREMENT NSC_numPrio NSC_st /end OUT_MEASUREMENT /end FUNCTION
/begin FUNCTION nsc_corgn_uic "" /end FUNCTION
/begin FUNCTION nvclb_calibration "" /end FUNCTION
/begin FUNCTION nvclb_calibration_uic "" /end FUNCTION
/begin FUNCTION opscd "Öldruckerfassung"
 /begin DEF_CHARACTERISTIC OPSCD_aMinBack_C OPSCD_aMinFor_C OPSCD_ctPwrStgOnMax_C OPSCD_LampDebExcTempDef_C OPSCD_LampDebExcTempOk_C OPSCD_LampDebNoLoadDef_C OPSCD_LampDebNoLoadOk_C OPSCD_LampDebShortCircBatDef_C OPSCD_LampDebShortCircBatOk_C OPSCD_LampDebShortCircGndDef_C OPSCD_LampDebShortCircGndOk_C OPSCD_nStart_C OPSCD_numDia_C OPSCD_numDioOut_C OPSCD_nZero_C OPSCD_stLampInvOut_C OPSCD_stPwrStgLampDia_C OPSCD_stSPICtl_C OPSCD_swtSigOut_C OPSCD_tiABSDebNegBack_C OPSCD_tiABSDebPosBack_C OPSCD_tiABSDebNegFor_C OPSCD_tiABSDebPosFor_C OPSCD_tiBtwTst_C OPSCD_tiInactiv1Back_C OPSCD_tiInactiv1For_C OPSCD_tiInactivStart_C OPSCD_tipOELDebNeg_C OPSCD_tipOELDebPos_C OPSCD_tiPwrStgOn_C OPSCD_vMinBack_C OPSCD_vMinFor_C /end DEF_CHARACTERISTIC
/end FUNCTION
/begin FUNCTION opscd_anain ""
 /begin DEF_CHARACTERISTIC OPSCD_uSRCMin_C OPSCD_uSRCMax_C OPSCD_pLin_CUR OPSCD_DebSRCHiDef_C OPSCD_DebSRCHiOk_C OPSCD_DebSRCLoDef_C OPSCD_DebSRCLoOk_C OPSCD_dtRmpSlpUp_C OPSCD_dtRmpSlpDwn_C OPSCD_numAdc_C OPSCD_stSensIDWord_C OPSCD_stPDfl_C /end DEF_CHARACTERISTIC
 /begin IN_MEASUREMENT OPSCD_uRaw_POEL_mp /end IN_MEASUREMENT
/end FUNCTION
/begin FUNCTION opscd_anain_msg "" /begin OUT_MEASUREMENT OPSCD_stpOEL /end OUT_MEASUREMENT /end FUNCTION
/begin FUNCTION opscd_anain_uic "" /begin OUT_MEASUREMENT OPSCD_uRaw_POEL_mp /end OUT_MEASUREMENT /end FUNCTION
/begin FUNCTION opscd_msg "" /begin OUT_MEASUREMENT OPSCD_stSigOut /end OUT_MEASUREMENT /end FUNCTION
/begin FUNCTION opscd_uic "" /begin OUT_MEASUREMENT OPSCD_stInactive_mp OPSCD_stLampRun_mp /end OUT_MEASUREMENT /end FUNCTION
/begin FUNCTION otscd_co "Öltemperaturfühler"
 /begin DEF_CHARACTERISTIC OTSCD_uSRCMin_C OTSCD_uSRCMax_C OTSCD_tLin_CUR OTSCD_DebNplDef_C OTSCD_DebNplOk_C OTSCD_DebSigDef_C OTSCD_DebSigOk_C OTSCD_DebSRCHighDef_C OTSCD_DebSRCHighOk_C OTSCD_DebSRCLowDef_C OTSCD_DebSRCLowOk_C OTSCD_numAdc_C OTSCD_tiStrtOilClntPlaus_C OTSCD_tiDelOilClntPlaus_C OTSCD_tThresOilClntPlaus_C OTSCD_tLimOilClntPlaus_C OTSCD_dtRmpSlpUp_C OTSCD_dtRmpSlpDwn_C OTSCD_swtSigVal_C OTSCD_stSensIDWord_C OTSCD_tDfl_C /end DEF_CHARACTERISTIC
 /begin IN_MEASUREMENT OTSCD_uRaw /end IN_MEASUREMENT
/end FUNCTION
/begin FUNCTION otscd_co_msg ""
 /begin OUT_MEASUREMENT OTSCD_stPlaus OTSCD_swtSig OTSCD_tEngOil OTSCD_tEngOilLin OTSCD_uRaw /end OUT_MEASUREMENT
/end FUNCTION
/begin FUNCTION otscd_co_uic "" /end FUNCTION
/begin FUNCTION ovrmon_10msctr_msg "" /begin OUT_MEASUREMENT OvRMon_ct10MS /end OUT_MEASUREMENT /end FUNCTION
/begin FUNCTION ovrmon_10msctr_uic "" /end FUNCTION
/begin FUNCTION ovrmon_accped ""
 /begin DEF_CHARACTERISTIC OvRMon_tiErrAPP_C OvRMon_uAPPFull_C OvRMon_uPlaWinFull_C OvRMon_uPlaWinIdle_C /end DEF_CHARACTERISTIC
/end FUNCTION
/begin FUNCTION ovrmon_accped_uic "" /begin OUT_MEASUREMENT OvRMon_stAPPDiff_mp OvRMon_uRegAPP1_mp OvRMon_uRegAPP2_mp /end OUT_MEASUREMENT /end FUNCTION
/begin FUNCTION ovrmon_brksens "" /begin DEF_CHARACTERISTIC OvRMon_tiDebBrk_C /end DEF_CHARACTERISTIC /end FUNCTION
/begin FUNCTION ovrmon_brksens_uic "" /end FUNCTION
/begin FUNCTION ovrmon_co "Funktionsüberwachung auf Systemebene Koordination"
 /begin DEF_CHARACTERISTIC ExeMon_stEnaTst_C OvRMon_ctEngSpdGrad_C OvRMon_DebETDef_C OvRMon_nLIGovLim_C OvRMon_nMin_C OvRMon_nStSysLim_C OvRMon_nThresNrml2Strt_C OvRMon_tiAPP1Flt_C OvRMon_tiASDdc_C OvRMon_tiCompAcsTemp_C OvRMon_tiCrCtlBrkRmp_C OvRMon_tiCrCtlConvRmp_C OvRMon_tiEngSpdRlsBrkRmp_C OvRMon_tiErrDblStorage_C OvRMon_tiLimET_MAP OvRMon_uAPP1Lim_C /end DEF_CHARACTERISTIC
 /begin IN_MEASUREMENT OvRMon_nAvrg OvRMon_tiOvRMonActive_mp /end IN_MEASUREMENT
/end FUNCTION
/begin FUNCTION ovrmon_convsens "" /begin DEF_CHARACTERISTIC OvRMon_tiDebConv_C /end DEF_CHARACTERISTIC /end FUNCTION
/begin FUNCTION ovrmon_convsens_uic "" /end FUNCTION
/begin FUNCTION ovrmon_co_msg "" /begin OUT_MEASUREMENT OvRMon_stActive OvRMon_stLIGovRls /end OUT_MEASUREMENT /end FUNCTION
/begin FUNCTION ovrmon_co_uic ""
 /begin OUT_MEASUREMENT OvRMon_ctDebET_mp OvRMon_stBrkPressed_mp OvRMon_stConvDebVal_mp OvRMon_stDCS_mp OvRMon_stEngSpdRls_mp OvRMon_stGrip_mp OvRMon_stRls_mp OvRMon_stT15DebVal_mp OvRMon_stTSCInc_mp OvRMon_tiLimET_mp OvRMon_tiOvRMonActive_mp OvRMon_uRawAPP1_mp /end OUT_MEASUREMENT
/end FUNCTION
/begin FUNCTION ovrmon_dcsdem "Signalerfassung der dynamische Fahrsteuerung" /end FUNCTION
/begin FUNCTION ovrmon_dcsdem_uic "" /end FUNCTION
/begin FUNCTION ovrmon_engspdrlssens "" /end FUNCTION
/begin FUNCTION ovrmon_engspdrlssens_uic "" /end FUNCTION
/begin FUNCTION ovrmon_engspdsens "Drehzahlüberwachung für die Schubüberwachung"
 /begin DEF_CHARACTERISTIC OvRMon_DebSigA0Def_C OvRMon_nDiffMax_C OvRMon_nSegMax_C OvRMon_nSegMin_C OvRMon_stIntrInit_C OvRMon_tiSegMin_C /end DEF_CHARACTERISTIC
/end FUNCTION
/begin FUNCTION ovrmon_engspdsens_msg ""
 /begin OUT_MEASUREMENT OvRMon_nAvrg OvRMon_stIntr OvRMon_tiIntrSysAct OvRMon_tiIntrSysLst /end OUT_MEASUREMENT
/end FUNCTION
/begin FUNCTION ovrmon_engspdsens_uic "" /begin OUT_MEASUREMENT OvRMon_nSeg_mp OvRMon_stIntrInactv_mp /end OUT_MEASUREMENT /end FUNCTION
/begin FUNCTION ovrmon_gearbxdem "Signalerfassung der Getriebesteuerung" /end FUNCTION
/begin FUNCTION ovrmon_gearbxdem_uic "" /end FUNCTION
/begin FUNCTION ovrmon_getsuminj "Berechnung des Drehmoments zur Schubüberwachung" /begin DEF_CHARACTERISTIC OvRMon_facInjEff_MAP /end DEF_CHARACTERISTIC /begin IN_MEASUREMENT Eng_nAvrg OvRMon_phiInjAct_mp /end IN_MEASUREMENT /begin OUT_MEASUREMENT OvRMon_tiTDCSumET_mp /end OUT_MEASUREMENT /end FUNCTION
/begin FUNCTION ovrmon_getsuminj_msg "" /begin OUT_MEASUREMENT OvRMon_tiTDCAvrg /end OUT_MEASUREMENT /end FUNCTION
/begin FUNCTION ovrmon_getsuminj_uic "" /begin OUT_MEASUREMENT OvRMon_phiInjAct_mp OvRMon_tiInjAct_mp /end OUT_MEASUREMENT /end FUNCTION
/begin FUNCTION ovrmon_gripsens "" /end FUNCTION
/begin FUNCTION ovrmon_gripsens_uic "" /end FUNCTION
/begin FUNCTION ovrmon_msg "" /begin OUT_MEASUREMENT OvRMon_stOvR /end OUT_MEASUREMENT /end FUNCTION
/begin FUNCTION ovrmon_t15sens "" /begin DEF_CHARACTERISTIC OvRMon_tiDebT15_C /end DEF_CHARACTERISTIC /end FUNCTION
/begin FUNCTION ovrmon_t15sens_uic "" /end FUNCTION
/begin FUNCTION ovrmon_trqdsc "" /begin DEF_CHARACTERISTIC OvRMon_ctDebToTORQUE_DSCDef_C OvRMon_ctDebToTORQUE_DSCOk_C /end DEF_CHARACTERISTIC /end FUNCTION
/begin FUNCTION ovrmon_trqdsc_msg "" /begin OUT_MEASUREMENT OvRMon_ctTORQUE_DSC OvRMon_stTrqDesDSC /end OUT_MEASUREMENT /end FUNCTION
/begin FUNCTION ovrmon_trqdsc_uic ""
 /begin OUT_MEASUREMENT OvRMon_numTORQUE_DSCbyteraw_mp OvRMon_stBusOffDSC_mp OvRMon_stErrPassDSC_mp OvRMon_stHwDefDSC_mp OvRMon_stTODSC_mp /end OUT_MEASUREMENT
/end FUNCTION
/begin FUNCTION ovrmon_trqegs "" /begin DEF_CHARACTERISTIC OvRMon_ctDebToTORQUE_EGSDef_C OvRMon_ctDebToTORQUE_EGSOk_C /end DEF_CHARACTERISTIC /end FUNCTION
/begin FUNCTION ovrmon_trqegs_msg "" /begin OUT_MEASUREMENT OvRMon_ctTORQUE_EGS OvRMon_stTrqDesEGS /end OUT_MEASUREMENT /end FUNCTION
/begin FUNCTION ovrmon_trqegs_uic ""
 /begin OUT_MEASUREMENT OvRMon_numTORQUE_EGSbyteraw_mp OvRMon_stBusOffEGS_mp OvRMon_stErrPassEGS_mp OvRMon_stHwDefEGS_mp OvRMon_stTOEGS_mp /end OUT_MEASUREMENT
/end FUNCTION
/begin FUNCTION ovrmon_trqssg "" /begin DEF_CHARACTERISTIC OvRMon_ctDebToTORQUE_SSGDef_C OvRMon_ctDebToTORQUE_SSGOk_C /end DEF_CHARACTERISTIC /end FUNCTION
/begin FUNCTION ovrmon_trqssg_msg "" /begin OUT_MEASUREMENT OvRMon_ctTORQUE_SSG OvRMon_stTrqDesSSG /end OUT_MEASUREMENT /end FUNCTION
/begin FUNCTION ovrmon_trqssg_uic ""
 /begin OUT_MEASUREMENT OvRMon_numTORQUE_SSGbyteraw_mp OvRMon_stBusOffSSG_mp OvRMon_stErrPassSSG_mp OvRMon_stHwDefSSG_mp OvRMon_stTOSSG_mp /end OUT_MEASUREMENT
/end FUNCTION
/begin FUNCTION oxiccd_gettemppre "Abgastemperatur vor Oxidationskatalysator"
 /begin DEF_CHARACTERISTIC OxiCCD_uSRCMinTPre_C OxiCCD_uSRCMaxTPre_C OxiCCD_tLinPre_CUR OxiCCD_DebSRCHighDefTPre_C OxiCCD_DebSRCHighOkTPre_C OxiCCD_DebSRCLowDefTPre_C OxiCCD_DebSRCLowOkTPre_C OxiCCD_numTempPreADC_C OxiCCD_dtRmpSlpUpPre_C OxiCCD_dtRmpSlpDwnPre_C OxiCCD_stSensIDWordTPre_C OxiCCD_tDflPre_C /end DEF_CHARACTERISTIC
 /begin IN_MEASUREMENT OxiCCD_uRawTempPre /end IN_MEASUREMENT
/end FUNCTION
/begin FUNCTION oxiccd_gettemppre_msg "" /begin OUT_MEASUREMENT OxiCCD_tLinPre OxiCCD_tPre OxiCCD_uRawTempPre /end OUT_MEASUREMENT /end FUNCTION
/begin FUNCTION oxiccd_gettemppre_uic "" /end FUNCTION
/begin FUNCTION pcbs_calccbs ""
 /begin DEF_CHARACTERISTIC PCBS_facFlTotDMEChg_C PCBS_lCalcDistance_CUR PCBS_qCalcFlTot_CUR /end DEF_CHARACTERISTIC
 /begin IN_MEASUREMENT PCBS_dAvaiDMEChg_mp PFlt_mAshOil /end IN_MEASUREMENT
/end FUNCTION
/begin FUNCTION pcbs_calccbs_msg ""
 /begin OUT_MEASUREMENT PCBS_dAvaiOut PCBS_lDistanceOut PCBS_qFlTotDMEChg PCBS_stCBSMsg PCBS_stCntValOut PCBS_stDMEChg PCBS_stDMEChgOld PCBS_stIDMsg PCBS_stPFltChg PCBS_stUnit /end OUT_MEASUREMENT
/end FUNCTION
/begin FUNCTION pcbs_calccbs_uic ""
 /begin OUT_MEASUREMENT PCBS_dAvaiDiag_mp PCBS_dAvaiDMEChg_mp PCBS_lMaxDistance_mp PCBS_stCntChgCAN_mp PCBS_stCntChgDIAG_mp PCBS_stCntChg_mp PCBS_stCntDiag_mp PCBS_stCntVal_mp PCBS_stDMEIni_mp PCBS_stPFltChgCAN_mp PCBS_stPFltChgDIAG_mp PCBS_stResetDiag_mp /end OUT_MEASUREMENT
/end FUNCTION
/begin FUNCTION pcr_balgvnr "Gleichstellungsregler" /end FUNCTION
/begin FUNCTION pcr_balgvnr_msg "" /begin OUT_MEASUREMENT PCR_rBalGvnrDiff /end OUT_MEASUREMENT /end FUNCTION
/begin FUNCTION pcr_balgvnr_uic "" /end FUNCTION
/begin FUNCTION pcr_ctlvalcalc "Ladedruck-Steuerung"
 /begin DEF_CHARACTERISTIC PCR_drSurge2RmpUp_C PCR_drSurge2RmpDwn_C PCR_facBPCtlBasCorr_CUR PCR_facBPCtlBasRgn1Corr_CUR PCR_facCtlAPRgn_MAP PCR_facCtlAP_MAP PCR_facCtlATRgn_CUR PCR_facCtlIAT_CUR PCR_rBPCtlBasUp_C PCR_rBPCtlBasDwn_C PCR_rBPCtlBasAirCtlOff_MAP PCR_rBPCtlBasCorr_MAP PCR_rBPCtlBasFDC_MAP PCR_rBPCtlBasRgn1Corr_MAP PCR_rBPCtlBasRgn1_MAP PCR_rBPCtlBasRgn2_MAP PCR_rCtlAPCmpnRgn_MAP PCR_rCtlAPCor_MAP PCR_rCtlATCmpnRgn_MAP PCR_rCtlATCmpn_MAP PCR_rCtlBas_MAP PCR_rCtlInit_C PCR_rSurgeCtlVal_MAP PCR_stCtlVal1_C PCR_stCtlVal2_C PCR_swtQntCtlVal_C PCR_swtQntCtlType_C PCR_tiRmpCtl_C /end DEF_CHARACTERISTIC
 /begin IN_MEASUREMENT APSCD_pVal Eng_nAvrg IATSCD_tAir PCR_qCtl_mp PFlt_mSot /end IN_MEASUREMENT
/end FUNCTION
/begin FUNCTION pcr_ctlvalcalc_msg "" /begin OUT_MEASUREMENT PCR_rCtlVal PCR_swtQntCtl /end OUT_MEASUREMENT /end FUNCTION
/begin FUNCTION pcr_ctlvalcalc_uic ""
 /begin OUT_MEASUREMENT PCR_qCtlFrmMngTrqInr_mp PCR_qCtl_mp PCR_rBPCtlAPCorrRgn_mp PCR_rBPCtlAPCorr_mp PCR_rBPCtlATCorrRgn_mp PCR_rBPCtlATCorr_mp PCR_rBPCtlBasCorr_mp PCR_rBPCtlBasRgn1Corr_mp PCR_rBPCtlBasRgn1_mp PCR_rBPCtlBasRgn2_mp PCR_rBPCtlBas_mp PCR_rCtlSurgeBas_mp PCR_rCtlVal1_mp PCR_rCtlVal2_mp /end OUT_MEASUREMENT
/end FUNCTION
/begin FUNCTION pcr_ctlvalcalc_var ""
 /begin DEF_CHARACTERISTIC PCR_dnSurgeHigh_CUR PCR_dnSurgeLow_CUR PCR_nLIGovBase_C PCR_nSetPointLIGov_C PCR_nSurgeMon1_C PCR_nSurgeMon2_C PCR_qSurgeHigh_CUR PCR_qSurgeLow_CUR PCR_rSurgeHigh_MAP PCR_rSurgeOfs_CUR PCR_tiSurgePT1_C PCR_swtOffStat1_C PCR_swtSurgeGearBPA_C PCR_swtSurgeGearLIGov_C PCR_tiSurgeBPAHiLo_C PCR_tiSurgeBPALoHi_C PCR_tiSurgeMonLIGov_C PCR_vSurgeLIGov_C /end DEF_CHARACTERISTIC
 /begin IN_MEASUREMENT APSCD_pVal Eng_nAvrg /end IN_MEASUREMENT
/end FUNCTION
/begin FUNCTION pcr_ctlvalcalc_var_msg ""
 /begin OUT_MEASUREMENT PCR_dnAvrg PCR_nSetPointSurge PCR_rSurgeLIGov PCR_stSurge1 PCR_stSurge2 /end OUT_MEASUREMENT
/end FUNCTION
/begin FUNCTION pcr_ctlvalcalc_var_uic ""
 /begin OUT_MEASUREMENT PCR_dnAvrgNeg_mp PCR_dnSurgeHigh_mp PCR_dnSurgeLow_mp PCR_qSurgeHigh_mp PCR_qSurgeLow_mp PCR_rSurgeHysHigh_mp PCR_rSurgeHysLow_mp PCR_rSurgeLIGov_mp PCR_stSurge1_mp PCR_stSurgePre1_mp PCR_stSurgePre2_mp /end OUT_MEASUREMENT
/end FUNCTION
/begin COMPU_METHOD Acc "Fahrzeugbeschleunigung" RAT_FUNC "%6.5" "m/s^2" COEFFS 0 1000 0 0 0 1 /end COMPU_METHOD
/begin COMPU_METHOD AirMassPerCyl "Luftmasse pro Zylinder" RAT_FUNC "%6.3" "mg/Hub" COEFFS 0 10 0 0 0 1 /end COMPU_METHOD
/begin COMPU_METHOD AngleCrS "Winkel Kurbelwelle" RAT_FUNC "%6.4" "deg CrS" COEFFS 0 42.6666666666667 0 0 0 1 /end COMPU_METHOD
/begin COMPU_METHOD Curr "Strom" RAT_FUNC "%6.2" "mA" COEFFS 0 1 0 0 0 1 /end COMPU_METHOD
/begin COMPU_METHOD dn_dZ20 "Motorbeschleunigung pro Zeit (dn/dt) (im 20 ms Raster)" RAT_FUNC "%6.1" "rmp/s" COEFFS 0 0.1 0 0 0 1 /end COMPU_METHOD
/begin COMPU_METHOD DtyCyc "Tastverhaeltnis" RAT_FUNC "%6.4" "%" COEFFS 0 100 0 0 0 1 /end COMPU_METHOD
/begin COMPU_METHOD EGTRmp "Zeitrampe verwendet von EGT Lib Funktionen" RAT_FUNC "%6.3" "s" COEFFS 0 0 1 0 0.0152587890625 0 /end COMPU_METHOD
/begin COMPU_METHOD EngN "Motordrehzahl" RAT_FUNC "%6.2" "rpm" COEFFS 0 1 0 0 0 1 /end COMPU_METHOD
/begin COMPU_METHOD Fact "Faktor mit Auflösung 1 / 8192, hauptsächlich für einen Faktorenbereich 0...1 verwendet" RAT_FUNC "%6.5" "-" COEFFS 0 8192 0 0 0 1 /end COMPU_METHOD
/begin COMPU_METHOD Fl_2 "Umrechnung for getting 16 bit  total fuel consumption" RAT_FUNC "%6.1" "l" COEFFS 0 0.1 0 0 0 1 /end COMPU_METHOD
/begin COMPU_METHOD Fl_Half_L "Kraftstoffverbrauchsintegral" RAT_FUNC "%6.4" "l" COEFFS 0 20 0 0 0 1 /end COMPU_METHOD
/begin COMPU_METHOD Fl_L "Treibstoffmenge [l]" RAT_FUNC "%6.4" "l" COEFFS 0 100 0 0 0 1 /end COMPU_METHOD
/begin COMPU_METHOD InjMass "Einspritzmenge" RAT_FUNC "%6.4" "mg/hub" COEFFS 0 100 0 0 0 1 /end COMPU_METHOD
/begin COMPU_METHOD InjMassCyc "Einspritzmenge pro Zyklus (mg/Zyklus)" RAT_FUNC "%6.4" "mg/cyc" COEFFS 0 100 0 0 0 1 /end COMPU_METHOD
/begin COMPU_METHOD InjTime_us "Zeit in Microsekunden für das Einspritztiming" RAT_FUNC "%6.2" "us" COEFFS 0 1 0 0 0 1 /end COMPU_METHOD
/begin COMPU_METHOD Kd "Differentialverstärkung Kd (gleiche Einheit/Umrechnungsformel an Ein- und Ausgang)" RAT_FUNC "%7.6" "1/1" COEFFS 0 65536 0 0 0 1 /end COMPU_METHOD
/begin COMPU_METHOD Kd_Temp_Kelv2Dcyc "Differentialverstärkung Kd (Temperatur zu Tastverhältnis)" RAT_FUNC "%8.7" "%/(K)" COEFFS 0 655360 0 0 0 1 /end COMPU_METHOD
/begin COMPU_METHOD Ki_curr2fact "Integralverstärkung (Strom Curr zu Faktor Fact)" RAT_FUNC "%10.9" "1/mA*s" COEFFS 0 35184372.088832 0 0 0 1 /end COMPU_METHOD
/begin COMPU_METHOD Ki_Temp_Kelv2Dcyc "Integralverstärkung (Temperatur zu Tastverhältnis)" RAT_FUNC "%7.6" "%/(K)" COEFFS 0 42949.67296 0 0 0 1 /end COMPU_METHOD
/begin COMPU_METHOD km_sw_q10 "K3 Umwandlungen" RAT_FUNC "%6.1" "-" COEFFS 0 0.1 0 0 0 1 /end COMPU_METHOD
/begin COMPU_METHOD Kp_Temp_Kelv2Dcyc "Proportionalverstärkung (Temperatur zu Tastverhältnis)" RAT_FUNC "%8.7" "%/(K)" COEFFS 0 655360 0 0 0 1 /end COMPU_METHOD
/begin COMPU_METHOD lambda "Lambda" RAT_FUNC "%6.5" "-" COEFFS 0 1000 0 0 0 1 /end COMPU_METHOD
/begin COMPU_METHOD lambdaRecVal "Reziproker Lambda Wert" RAT_FUNC "%6.5" "-" COEFFS 0 1000 0 0 0 1 /end COMPU_METHOD
/begin COMPU_METHOD mSoot_g "Rußmasse [g]" RAT_FUNC "%6.4" "g" COEFFS 0 100 0 0 0 1 /end COMPU_METHOD
/begin COMPU_METHOD NumPinAdc "verbale Umrechnung für ADC Signale" TAB_VERB "%6.3" "-" COMPU_TAB_REF NumPinAdc /end COMPU_METHOD
/begin COMPU_VTAB NumPinAdc "verbale Umrechnung für ADC Signale" TAB_VERB 27 0 "Water_Temperature_Sensor_182" 1 "Intake_Air_Temperature_Sensor_157" 2 "Charge_Air_Temperature_Sensor_183" 3 "Exhaust_Temperature_Sensor_2_134" 4 "Exhaust_Temperature_Sensor_1_158" 5 "1st_APP_Sensor_252" 6 "2nd_APP_Sensor_239" 7 "ADC_REF" 8 "Boost_Pressure_Sensor_154" 9 "Atmospheric_Pressure_Sensor" 10 "Battery_Voltage_Sensor" 11 "Rail_Pressure_Sensor_156" 12 "Rail_Pressure_Peak_Value_156" 13 "Booster_Voltage_Sensor" 14 "Current_MeUn_Sensor" 15 "Current_PCV_Sensor" 16 "Voltage_Bank_1" 17 "Voltage_Bank_2" 18 "Pressure_Upstream_Particle_Filter_159" 19 "Engine_Oil_Pressure_110" 20 "Temperature_ECU_PCB" 21 "Voltage_Lambda_Ua" 22 "Voltage_Lambda_Ri" 23 "EMCCD_Current_Governor1_124" 24 "EMCCD_Current_Governor2_121" 25 "ADC_DUMMY_NOT_USED" 26 "ADC_DUMMY_A_NOT_USED" /end COMPU_VTAB
/begin COMPU_METHOD NumPinDia "Verbale Umrechnung für Diagnose Signale" TAB_VERB "%6.3" "-" COMPU_TAB_REF NumPinDia /end COMPU_METHOD
/begin COMPU_VTAB NumPinDia "Verbale Umrechnung für Diagnose Signale" TAB_VERB 28 0 "CJ945_Diagnostic_Signal" 1 "AC_Compressor_DiaSig" 2 "Fuel_Pump_Diagnostic_Signal_232" 3 "Starter_234" 4 "Oil_Pressure_Lamp_Switch_245" 5 "Engine_Bay_Air_Flaps_123" 6 "Ebox_Fan_Actuator_Diagnostic_Signal_219" 7 "Shuttr_Actuator_Diagnostic_Signal_231" 8 "Twostage_TurboLoading_SW_DiaSig" 9 "DIO_OUT_DIAGNOSTIC_DUMMY_NOT_USED" 10 "Alternator" 11 "Boost_Pressure_Actuator_Diagnostic_Signal_193" 12 "EGR_Actuator_Diagnostic_Signal_194" 13 "1st_Pressure_Control_Valve_Diagnostic_Signal_172" 14 "2nd_Pressure_Control_Valve_Diagnostic_Signal_172" 15 "1st_Metering_Unit_Diagnostic_Signal_171" 16 "2nd_Metering_Unit_Diagnostic_Signal_171" 17 "Variable_Swirl_Actuator_Diagnostic_Signal_195" 18 "FAN_240" 19 "Add_On_Heater_244" 20 "EngM_Bearing_Actuator_Diagnostic_Signal_124" 21 "EngM_Bearing_Actuator_Diagnostic_Signal_121" 22 "Throttle_Valve_Diagnostic_Signal_196" 23 "Low pressure stage BPA_Diagnostic_Signal_117" 24 "PWM_DIAGNOSTIC_DUMMY_NOT_USED" 25 "1st_Sensor_Supply_Voltage_DiaSig" 26 "2nd_Sensor_Supply_Voltage_DiaSig" 27 "3rd_Sensor_Supply_Voltage_DiaSig" /end COMPU_VTAB
/begin COMPU_METHOD NumPinDioIn "Verbale Umrechnung für Digitaleingang Signale" TAB_VERB "%6.3" "-" COMPU_TAB_REF NumPinDioIn /end COMPU_METHOD
/begin COMPU_VTAB NumPinDioIn "Verbale Umrechnung für Digitaleingang Signale" TAB_VERB 15 0 "Terminal_15_207" 1 "Main_Brake_Switch_236" 2 "Redundant_Brake_Switch_223" 3 "Clutch_Switch" 4 "Terminal_50_224" 5 "ECU_selection_Switch_251" 6 "FlFlt_Switch_211" 7 "Coolant-heater_212" 8 "Redundant_Terminal_15_209(118)" 9 "AC-compressor_overboost_213" 10 "Additive_tank_level_switch_235" 11 "Terminal_61_113" 12 "Lambda_Regeneration" 13 "Oil_Level_sensor_138" 14 "DIO_IN_DUMMY_NOT_USED" /end COMPU_VTAB
/begin COMPU_METHOD NumPinDioOut "Verbale Umrechnung für Digitalausgang Signale" TAB_VERB "%6.3" "-" COMPU_TAB_REF NumPinDioOut /end COMPU_METHOD
/begin COMPU_VTAB NumPinDioOut "Verbale Umrechnung für Digitalausgang Signale" TAB_VERB 12 0 "Main_Relay_220(144)" 1 "AC_Compressor" 2 "Fuel_Pump_232" 3 "Starter_234" 4 "OPS_Lamp_245" 5 "EBAF_123" 6 "Ebox_Fan_Actuator_219" 7 "Shuttr_Actuator_Digital_231" 8 "STATREG_PSOFF_Bit" 9 "Twostage_TurboLoading_120" 10 "TD_Signal_253" 11 "DIO_OUT_DUMMY_NOT_USED" /end COMPU_VTAB
/begin COMPU_METHOD NumPinPwmOut "Verbale Umrechnung für PWM-Ausgang Signale" TAB_VERB "%6.3" "-" COMPU_TAB_REF NumPinPwmOut /end COMPU_METHOD
/begin COMPU_VTAB NumPinPwmOut "Verbale Umrechnung für PWM-Ausgang Signale" TAB_VERB 14 0 "Boost_Pressure_Actuator_193" 1 "EGR_Actuator_194" 2 "PCV_Actuator_172" 3 "MeUn_Actuator_171" 4 "Variable_Swirl_Actuator_195" 5 "Fan_Actuator_240" 6 "Add_On_Heater_244" 7 "EngM_Bearing_Actuator_124" 8 "EngM_Bearing_Actuator_121" 9 "Throttle_Valve_196" 10 "LSU_Heater_PWMOutput" 11 "Low pressure stage BPA_117" 12 "Shuttr_Actuator_PWM_231" 13 "PWM_DUMMY_NOT_USED" /end COMPU_VTAB
/begin COMPU_METHOD O2 "Sauerstoffkonzentration" RAT_FUNC "%8.7" "-" COEFFS 0 100000 0 0 0 1 /end COMPU_METHOD
/begin COMPU_METHOD OneToOne "eins zu eins (physikalischer Wert ist gleich dem internen Wert)" RAT_FUNC "%6.2" "-" COEFFS 0 1 0 0 0 1 /end COMPU_METHOD
/begin COMPU_METHOD Period "Periodendauer" RAT_FUNC "%6.3" "ms" COEFFS 0 10 0 0 0 1 /end COMPU_METHOD
/begin COMPU_METHOD Period_ms "Periodendauer in ms" RAT_FUNC "%6.3" "ms" COEFFS 0 10 0 0 0 1 /end COMPU_METHOD
/begin COMPU_METHOD Prc "Prozent, gleiche interne Auflösung wie Fact, aber Darstellung in Prozent (0...100%)" RAT_FUNC "%6.4" "%" COEFFS 0 81.92 0 0 0 1 /end COMPU_METHOD
/begin COMPU_METHOD Pres_hPa "Druck (angezeigt in [hPa])" RAT_FUNC "%6.2" "hPa" COEFFS 0 1 0 0 0 1 /end COMPU_METHOD
/begin COMPU_METHOD Pres_Rail "Raildruck in hPa" RAT_FUNC "%4.3" "bar" COEFFS 0 10.000000 0 0 0 1 /end COMPU_METHOD
/begin COMPU_METHOD Qp_mm3_sec "Umrechnung für Volumenstrom" RAT_FUNC "%6.1" "mm3/s" COEFFS 0 0.1 0 0 0 1 /end COMPU_METHOD
/begin COMPU_METHOD Resist "Widerstand" RAT_FUNC "%6.3" "Ohm" COEFFS 0 10 0 0 0 1 /end COMPU_METHOD
/begin COMPU_METHOD Resist_1 "1. Widerstandsvariante" RAT_FUNC "%6.2" "mOhm" COEFFS 0 1 0 0 0 1 /end COMPU_METHOD
/begin COMPU_METHOD RmpDtyCyc "Rampengradient für Tastverhältnis" RAT_FUNC "%6.5" "%/s" COEFFS 0 6553.6 0 0 0 1 /end COMPU_METHOD
/begin COMPU_METHOD RmpPrc "Prozent Rampengradient" RAT_FUNC "%6.5" "%/s" COEFFS 0 5368.70912 0 0 0 1 /end COMPU_METHOD
/begin COMPU_METHOD RmpPres "Rampengradient für Druck" RAT_FUNC "%7.3" "hPa/s" COEFFS 0 65.536000 0 0 0 1 /end COMPU_METHOD
/begin COMPU_METHOD RmpTemp "Rampengradient für Temperatur" RAT_FUNC "%6.4" "deg C/s" COEFFS 0 655.36 0 0 0 1 /end COMPU_METHOD
/begin COMPU_METHOD TempDiff_Cels "difference/offset temperature displayed in degree celcius" RAT_FUNC "%6.3" "deg C" COEFFS 0 10 0 0 0 1 /end COMPU_METHOD
/begin COMPU_METHOD TempDiff_Kelv "Offsettemperatur dargestellt in [K]" RAT_FUNC "%6.3" "deg C" COEFFS 0 10 0 0 0 1 /end COMPU_METHOD
/begin COMPU_METHOD Temp_Cels "Temperatur dargestellt in °C (gleiche interne Darstellung wie Temp_Kelv)" RAT_FUNC "%6.1" "deg C" COEFFS 0 10 2731.4 0 0 1 /end COMPU_METHOD
/begin COMPU_METHOD Temp_Fahr "Temperatur dargestellt in Fahrenheit (gleiche interne Darstellung wie Temp_Kelv)" RAT_FUNC "%6.1" "deg F" COEFFS 0 5.55555555555556 2553.62222222222 0 0 1 /end COMPU_METHOD
/begin COMPU_METHOD TimeCount_2ms "Zeit in Mikrosekunden für Zeitcounter mit 2 ms Abtastzeit" RAT_FUNC "%7.0" "usec" COEFFS 0 0.0005 0 0 0 1 /end COMPU_METHOD
/begin COMPU_METHOD TimeDeb "Entprellzeit in Millisekunden für Libraryfunktion Debounce" RAT_FUNC "%6.1" "ms" COEFFS 0 0.1 0 0 0 1 /end COMPU_METHOD
/begin COMPU_METHOD TimeDelay_s "Zeitkonstante T1 (in s) für PT1, DT1, etc." RAT_FUNC "%9.3" "s" COEFFS 0 0 1 0 0.00023283064365387 0 /end COMPU_METHOD
/begin COMPU_METHOD TimeUSResolution "Zeit in Mikrosekunden für TPU Zeiten, Auflösung 1 us" RAT_FUNC "%6.2" "us" COEFFS 0 1 0 0 0 1 /end COMPU_METHOD
/begin COMPU_METHOD Time_ms "Zeit in ms für Fehlerentprellung (DSM) und SW-Timer" RAT_FUNC "%6.1" "ms" COEFFS 0 0.1 0 0 0 1 /end COMPU_METHOD
/begin COMPU_METHOD Time_ms_20ms "Zeitzähler im 20 ms Raster, dargestellt in ms" RAT_FUNC "%6.1" "ms" COEFFS 0 0.05 0 0 0 1 /end COMPU_METHOD
/begin COMPU_METHOD Time_ms_40ms "Aktuelle Zaehler in 40 ms Takt" RAT_FUNC "%6.1" "ms" COEFFS 0 0.025 0 0 0 1 /end COMPU_METHOD
/begin COMPU_METHOD Time_s "Zeit in s für Fehlerentprellung (DSM) und SW-Timer" RAT_FUNC "%6.4" "s" COEFFS 0 100 0 0 0 1 /end COMPU_METHOD
/begin COMPU_METHOD UC_Curr "Hardwarekapselung Kondensator : MCy330" RAT_FUNC "%6.3" "A" COEFFS 0 10 0 0 0 1 /end COMPU_METHOD
/begin COMPU_METHOD UC_Volt "Hardwarekapselung: Kondensatorspannung fuer MCy330" RAT_FUNC "%6.3" "V" COEFFS 0 10 0 0 0 1 /end COMPU_METHOD
/begin COMPU_METHOD Vel "Fahrzeuggeschwindigkeit, gleiche interne Auflösung wie Vel_SI" RAT_FUNC "%6.4" "km/h" COEFFS 0 100 0 0 0 1 /end COMPU_METHOD
/begin COMPU_METHOD Volt "Spannung in V (von ADC)" RAT_FUNC "%6.2" "mV" COEFFS 0 0.2046 0 0 0 1 /end COMPU_METHOD
/begin COMPU_METHOD Volt_Batt "Batteriespannung" RAT_FUNC "%6.1" "mV" COEFFS 0 0.05115 0 0 0 1 /end COMPU_METHOD
/begin RECORD_LAYOUT Kf_Xs16_Ys16_Ws16 NO_AXIS_PTS_X 1 SWORD NO_AXIS_PTS_Y 2 SWORD AXIS_PTS_X 3 SWORD INDEX_INCR DIRECT AXIS_PTS_Y 4 SWORD INDEX_INCR DIRECT FNC_VALUES 5 SWORD COLUMN_DIR DIRECT /end RECORD_LAYOUT
/begin RECORD_LAYOUT Kl_Xs16_Ws16 NO_AXIS_PTS_X 1 SWORD AXIS_PTS_X 2 SWORD INDEX_INCR DIRECT FNC_VALUES 3 SWORD COLUMN_DIR DIRECT /end RECORD_LAYOUT
/begin RECORD_LAYOUT Kwb_Ws16 FNC_VALUES 1 SWORD COLUMN_DIR DIRECT /end RECORD_LAYOUT
/begin RECORD_LAYOUT Kwb_Wu16 FNC_VALUES 1 UWORD COLUMN_DIR DIRECT /end RECORD_LAYOUT
/begin RECORD_LAYOUT Kwb_Wu32 FNC_VALUES 1 ULONG COLUMN_DIR DIRECT /end RECORD_LAYOUT
/begin RECORD_LAYOUT Kw_Ws16 FNC_VALUES 1 SWORD COLUMN_DIR DIRECT /end RECORD_LAYOUT
/begin RECORD_LAYOUT Kw_Ws32 FNC_VALUES 1 SLONG COLUMN_DIR DIRECT /end RECORD_LAYOUT
/begin RECORD_LAYOUT Kw_Ws8 FNC_VALUES 1 SBYTE COLUMN_DIR DIRECT /end RECORD_LAYOUT
/begin RECORD_LAYOUT Kw_Wu16 FNC_VALUES 1 UWORD COLUMN_DIR DIRECT /end RECORD_LAYOUT
/begin RECORD_LAYOUT Kw_Wu32 FNC_VALUES 1 ULONG COLUMN_DIR DIRECT /end RECORD_LAYOUT
/begin RECORD_LAYOUT Kw_Wu8 FNC_VALUES 1 UBYTE COLUMN_DIR DIRECT /end RECORD_LAYOUT
/end MODULE
/end PROJECT
