ASAP2_VERSION 1 3
/begin PROJECT P390 "BMW DDE6.2 6-Zylinder VP0.1 11.11.2003 CAN12H"
/begin HEADER "" VERSION "VP01_6Z_CAN12H" PROJECT_NO P390 /end HEADER
/begin MODULE DIM ""
/begin MOD_COMMON "" BYTE_ORDER MSB_FIRST ALIGNMENT_BYTE 1 ALIGNMENT_WORD 2 ALIGNMENT_LONG 4 ALIGNMENT_FLOAT32_IEEE 4 /end MOD_COMMON
/begin CHARACTERISTIC K2REI_dCodInd_C "Kennwert Codier Index" VALUE 0xC024A Kw_Wu8 255.0 OneToOne 0.00 255.0 FORMAT "%3.0" /end CHARACTERISTIC
/begin CHARACTERISTIC K2REI_dDiaInd_C "Kennwerteblock Diagnose Index" VAL_BLK 0xC024B Kwb_Wu8 255.0 OneToOne 0.00 255.0 FORMAT "%3.0" NUMBER 2 /end CHARACTERISTIC
/begin CHARACTERISTIC K2REI_dSGFam_C "Kennwerteblock Steuergeraetefamilie/Motortype" VAL_BLK 0xC0248 Kwb_Wu8 255.0 OneToOne 0.00 255.0 FORMAT "%3.0" NUMBER 2 /end CHARACTERISTIC
/begin CHARACTERISTIC Chiste_stEnaTst_C "#SSD Schalter zum Testen des Befehlstests" VALUE 0xEBBC0 Kw_Wu8 255.0 OneToOne 0.00 255.0 FORMAT "%5.1" /end CHARACTERISTIC
/begin CHARACTERISTIC KF_DFIGEN1 "inv. Generator-DF-Ausgang" MAP 0xc0b07 TKF_UB_UB_UB 100.0 Def_f_ub_b100 0.0 99.6093 /begin FUNCTION_LIST BGLLGEN_1PR /end FUNCTION_LIST /begin AXIS_DESCR STD_AXIS NO_INPUT_QUANTITY Def_i_ub_q1 8 0.0 255.0000 /end AXIS_DESCR /begin AXIS_DESCR STD_AXIS NO_INPUT_QUANTITY Def_i_ub_q1 8 0.0 255.0000 /end AXIS_DESCR /end CHARACTERISTIC
/begin CHARACTERISTIC KF_DFIGEN2 "inv. Generator-DF-Ausgang" MAP 0xc0ab5 TKF_UB_UB_UB 100.0 Def_f_ub_b100 0.0 99.6093 /begin FUNCTION_LIST BGLLGEN_1PR /end FUNCTION_LIST /begin AXIS_DESCR STD_AXIS NO_INPUT_QUANTITY Def_i_ub_q1 8 0.0 255.0000 /end AXIS_DESCR /begin AXIS_DESCR STD_AXIS NO_INPUT_QUANTITY Def_i_ub_q1 8 0.0 255.0000 /end AXIS_DESCR /end CHARACTERISTIC
/begin CHARACTERISTIC KF_DFIGEN3 "inv. Generator-DF-Ausgang" MAP 0xc0bab TKF_UB_UB_UB 100.0 Def_f_ub_b100 0.0 99.6093 /begin FUNCTION_LIST BGLLGEN_1PR /end FUNCTION_LIST /begin AXIS_DESCR STD_AXIS NO_INPUT_QUANTITY Def_i_ub_q1 8 0.0 255.0000 /end AXIS_DESCR /begin AXIS_DESCR STD_AXIS NO_INPUT_QUANTITY Def_i_ub_q1 8 0.0 255.0000 /end AXIS_DESCR /end CHARACTERISTIC
/begin CHARACTERISTIC KF_DFIGEN4 "inv. Generator-DF-Ausgang" MAP 0xc0b59 TKF_UB_UB_UB 100.0 Def_f_ub_b100 0.0 99.6093 /begin FUNCTION_LIST BGLLGEN_1PR /end FUNCTION_LIST /begin AXIS_DESCR STD_AXIS NO_INPUT_QUANTITY Def_i_ub_q1 8 0.0 255.0000 /end AXIS_DESCR /begin AXIS_DESCR STD_AXIS NO_INPUT_QUANTITY Def_i_ub_q1 8 0.0 255.0000 /end AXIS_DESCR /end CHARACTERISTIC
/begin CHARACTERISTIC KF_ELUPWM39 "Strom E-Lüfter über pwm und ub" MAP 0xc0a14 TKF_UW_UB_UW 100.0 Def_i_uw_q0p0635 0.0 64.0000 /begin FUNCTION_LIST BGCRENG /end FUNCTION_LIST /begin AXIS_DESCR STD_AXIS L_pwmout Def_tv_ub_q0p390625 8 0.0 99.6093 /end AXIS_DESCR /begin AXIS_DESCR STD_AXIS V Def_v_uw_q1p0 8 0.0 360.0000 /end AXIS_DESCR FORMAT "%6.3" /end CHARACTERISTIC
/begin CHARACTERISTIC KF_ELUPWM60 "Strom E-Lüfter über pwm und ub" MAP 0xc097a TKF_UW_UB_UW 100.0 Def_i_uw_q0p0635 0.0 64.0000 /begin FUNCTION_LIST BGCRENG /end FUNCTION_LIST /begin AXIS_DESCR STD_AXIS L_pwmout Def_tv_ub_q0p390625 8 0.0 99.6093 /end AXIS_DESCR /begin AXIS_DESCR STD_AXIS V Def_v_uw_q1p0 8 0.0 360.0000 /end AXIS_DESCR FORMAT "%6.3" /end CHARACTERISTIC
/begin CHARACTERISTIC KF_GENWETA1 "Wirkungsgrad1 Generator mit 2*PI" MAP 0xc123a TKF_SW_UB_UB 100.0 Def_f_ub_b8 0.0 7.9687 /begin FUNCTION_LIST IMDGEN_1PR /end FUNCTION_LIST /begin AXIS_DESCR STD_AXIS I_gm Def_i_ub_q1 8 0.0 255.0000 /end AXIS_DESCR /begin AXIS_DESCR STD_AXIS N_gen Def_n_sw_q1p0 8 -32768.0000 32767.0000 /end AXIS_DESCR /end CHARACTERISTIC
/begin CHARACTERISTIC KF_GENWETA2 "Wirkungsgrad2 Generator mit 2*PI" MAP 0xc1294 TKF_SW_UB_UB 100.0 Def_f_ub_b8 0.0 7.9687 /begin FUNCTION_LIST IMDGEN_1PR /end FUNCTION_LIST /begin AXIS_DESCR STD_AXIS I_gm Def_i_ub_q1 8 0.0 255.0000 /end AXIS_DESCR /begin AXIS_DESCR STD_AXIS N_gen Def_n_sw_q1p0 8 -32768.0000 32767.0000 /end AXIS_DESCR /end CHARACTERISTIC
/begin CHARACTERISTIC KF_GENWETA3 "Wirkungsgrad3 Generator mit 2*PI" MAP 0xc13aa TKF_SW_UB_UB 100.0 Def_f_ub_b8 0.0 7.9687 /begin FUNCTION_LIST IMDGEN_1PR /end FUNCTION_LIST /begin AXIS_DESCR STD_AXIS I_gm Def_i_ub_q1 8 0.0 255.0000 /end AXIS_DESCR /begin AXIS_DESCR STD_AXIS N_gen Def_n_sw_q1p0 8 -32768.0000 32767.0000 /end AXIS_DESCR /end CHARACTERISTIC
/begin CHARACTERISTIC KF_GENWETA4 "Wirkungsgrad4 Generator mit 2*PI" MAP 0xc1350 TKF_SW_UB_UB 100.0 Def_f_ub_b8 0.0 7.9687 /begin FUNCTION_LIST IMDGEN_1PR /end FUNCTION_LIST /begin AXIS_DESCR STD_AXIS I_gm Def_i_ub_q1 8 0.0 255.0000 /end AXIS_DESCR /begin AXIS_DESCR STD_AXIS N_gen Def_n_sw_q1p0 8 -32768.0000 32767.0000 /end AXIS_DESCR /end CHARACTERISTIC
/begin CHARACTERISTIC KF_IGENDF1 "Generatorstrom1 DF-Kennfeld" MAP 0xc144d TKF_UB_UB_UB 100.0 Def_i_ub_q1 0.0 255.0000 /begin FUNCTION_LIST IMDGEN_1PR /end FUNCTION_LIST /begin AXIS_DESCR STD_AXIS Dffgen Def_f_ub_b100 7 0.0 99.6093 /end AXIS_DESCR /begin AXIS_DESCR STD_AXIS I_genmax Def_i_ub_q1 8 0.0 255.0000 /end AXIS_DESCR /end CHARACTERISTIC
/begin CHARACTERISTIC KF_IGENDF2 "Generatorstrom2 DF-Kennfeld" MAP 0xc1404 TKF_UB_UB_UB 100.0 Def_i_ub_q1 0.0 255.0000 /begin FUNCTION_LIST IMDGEN_1PR /end FUNCTION_LIST /begin AXIS_DESCR STD_AXIS Dffgen Def_f_ub_b100 7 0.0 99.6093 /end AXIS_DESCR /begin AXIS_DESCR STD_AXIS I_genmax Def_i_ub_q1 8 0.0 255.0000 /end AXIS_DESCR /end CHARACTERISTIC
/begin CHARACTERISTIC KF_IGENDF3 "Generatorstrom3 DF-Kennfeld" MAP 0xc14df TKF_UB_UB_UB 100.0 Def_i_ub_q1 0.0 255.0000 /begin FUNCTION_LIST IMDGEN_1PR /end FUNCTION_LIST /begin AXIS_DESCR STD_AXIS Dffgen Def_f_ub_b100 7 0.0 99.6093 /end AXIS_DESCR /begin AXIS_DESCR STD_AXIS I_genmax Def_i_ub_q1 8 0.0 255.0000 /end AXIS_DESCR /end CHARACTERISTIC
/begin CHARACTERISTIC KF_IGENDF4 "Generatorstrom4 DF-Kennfeld" MAP 0xc1496 TKF_UB_UB_UB 100.0 Def_i_ub_q1 0.0 255.0000 /begin FUNCTION_LIST IMDGEN_1PR /end FUNCTION_LIST /begin AXIS_DESCR STD_AXIS Dffgen Def_f_ub_b100 7 0.0 99.6093 /end AXIS_DESCR /begin AXIS_DESCR STD_AXIS I_genmax Def_i_ub_q1 8 0.0 255.0000 /end AXIS_DESCR /end CHARACTERISTIC
/begin CHARACTERISTIC KF_IGENKA1 "Kaltkennfeld 1 Generator" MAP 0xc0de8 TKF_SW_UW_UB 100.0 Def_i_ub_q1 0.0 255.0000 /begin FUNCTION_LIST IMDGEN_1PR /end FUNCTION_LIST /begin AXIS_DESCR STD_AXIS U_gen Def_u_uw_q0p1 7 0.0 6553.5000 FORMAT "%6.3" /end AXIS_DESCR /begin AXIS_DESCR STD_AXIS N_gen Def_n_sw_q1p0 9 -32768.0000 32767.0000 /end AXIS_DESCR /end CHARACTERISTIC
/begin CHARACTERISTIC KF_IGENKA2 "Kaltkennfeld 2 Generator" MAP 0xc0c24 TKF_SW_UW_UB 100.0 Def_i_ub_q1 0.0 255.0000 /begin FUNCTION_LIST IMDGEN_1PR /end FUNCTION_LIST /begin AXIS_DESCR STD_AXIS U_gen Def_u_uw_q0p1 7 0.0 6553.5000 FORMAT "%6.3" /end AXIS_DESCR /begin AXIS_DESCR STD_AXIS N_gen Def_n_sw_q1p0 9 -32768.0000 32767.0000 /end AXIS_DESCR /end CHARACTERISTIC
/begin CHARACTERISTIC KF_IGENKA3 "Kaltkennfeld 3 Generator" MAP 0xc0d06 TKF_SW_UW_UB 100.0 Def_i_ub_q1 0.0 255.0000 /begin FUNCTION_LIST IMDGEN_1PR /end FUNCTION_LIST /begin AXIS_DESCR STD_AXIS U_gen Def_u_uw_q0p1 7 0.0 6553.5000 FORMAT "%6.3" /end AXIS_DESCR /begin AXIS_DESCR STD_AXIS N_gen Def_n_sw_q1p0 9 -32768.0000 32767.0000 /end AXIS_DESCR /end CHARACTERISTIC
/begin CHARACTERISTIC KF_IGENKA4 "Kaltkennfeld 4 Generator" MAP 0xc0e4a TKF_SW_UW_UB 100.0 Def_i_ub_q1 0.0 255.0000 /begin FUNCTION_LIST IMDGEN_1PR /end FUNCTION_LIST /begin AXIS_DESCR STD_AXIS U_gen Def_u_uw_q0p1 7 0.0 6553.5000 FORMAT "%6.3" /end AXIS_DESCR /begin AXIS_DESCR STD_AXIS N_gen Def_n_sw_q1p0 9 -32768.0000 32767.0000 /end AXIS_DESCR /end CHARACTERISTIC
/begin CHARACTERISTIC KF_IGENWA1 "Warmkennfeld 1 Generator" MAP 0xc0cc6 TKF_SW_UB_UB 100.0 Def_i_ub_q1 0.0 255.0000 /begin FUNCTION_LIST IMDGEN_1PR /end FUNCTION_LIST /begin AXIS_DESCR STD_AXIS Gen_i_kaltun Def_i_ub_q1 6 0.0 255.0000 /end AXIS_DESCR
 /begin AXIS_DESCR STD_AXIS Tgen_end Def_t_sw_q0p1 7 -3276.8000 3276.7000 FORMAT "%4.1" /end AXIS_DESCR
/end CHARACTERISTIC
/begin CHARACTERISTIC KF_IGENWA2 "Warmkennfeld 2 Generator" MAP 0xc0c86 TKF_SW_UB_UB 100.0 Def_i_ub_q1 0.0 255.0000 /begin FUNCTION_LIST IMDGEN_1PR /end FUNCTION_LIST /begin AXIS_DESCR STD_AXIS Gen_i_kaltun Def_i_ub_q1 6 0.0 255.0000 /end AXIS_DESCR
 /begin AXIS_DESCR STD_AXIS Tgen_end Def_t_sw_q0p1 7 -3276.8000 3276.7000 FORMAT "%4.1" /end AXIS_DESCR
/end CHARACTERISTIC
/begin CHARACTERISTIC KF_IGENWA3 "Warmkennfeld  3 Generator" MAP 0xc0da8 TKF_SW_UB_UB 100.0 Def_i_ub_q1 0.0 255.0000 /begin FUNCTION_LIST IMDGEN_1PR /end FUNCTION_LIST /begin AXIS_DESCR STD_AXIS Gen_i_kaltun Def_i_ub_q1 6 0.0 255.0000 /end AXIS_DESCR
 /begin AXIS_DESCR STD_AXIS Tgen_end Def_t_sw_q0p1 7 -3276.8000 3276.7000 FORMAT "%4.1" /end AXIS_DESCR
/end CHARACTERISTIC
/begin CHARACTERISTIC KF_IGENWA4 "Warmkennfeld 4 Generator" MAP 0xc0d68 TKF_SW_UB_UB 100.0 Def_i_ub_q1 0.0 255.0000 /begin FUNCTION_LIST IMDGEN_1PR /end FUNCTION_LIST /begin AXIS_DESCR STD_AXIS Gen_i_kaltun Def_i_ub_q1 6 0.0 255.0000 /end AXIS_DESCR
 /begin AXIS_DESCR STD_AXIS Tgen_end Def_t_sw_q0p1 7 -3276.8000 3276.7000 FORMAT "%4.1" /end AXIS_DESCR
/end CHARACTERISTIC
/begin CHARACTERISTIC KF_MDGENFIL "Filterung Generatormoment" MAP 0xc12ee TKF_SW_SW_UW 100.0 Def_f_uw_b1 0.0 0.9999 /begin FUNCTION_LIST IMDGEN_1PR /end FUNCTION_LIST
 /begin AXIS_DESCR STD_AXIS Md_gennmufi Def_m_sw_q0p1 6 -3276.8000 3276.7000 FORMAT "%5.2" /end AXIS_DESCR
 /begin AXIS_DESCR STD_AXIS Nkw Def_n_sw_q1p0 6 -32768.0000 32767.0000 /end AXIS_DESCR
/end CHARACTERISTIC
/begin CHARACTERISTIC KL_ELSLS "Kennlinie E-Lüfter Strom" CURVE 0xc095a TKL_UW_VV_UW 100.0 Def_i_uw_q0p0635 0.0 255.0000 /begin FUNCTION_LIST BGCRENG /end FUNCTION_LIST /begin AXIS_DESCR STD_AXIS Ub Def_u_uw_q0p0942 3 0.0 6173.3970 FORMAT "%4.1" /end AXIS_DESCR FORMAT "%6.3" /end CHARACTERISTIC
/begin CHARACTERISTIC KL_ELTEMP39 "Temperaturfaktor Elüfter" CURVE 0xc08d6 TKL_SW_VV_UW 100.0 Def_f_uw_b512 0.0 511.9921 /begin FUNCTION_LIST BGCRENG /end FUNCTION_LIST
 /begin AXIS_DESCR STD_AXIS Tans Def_t_sw_q0p1 6 -3276.8000 3276.7000 FORMAT "%4.1" /end AXIS_DESCR
 FORMAT "%6.3" /end CHARACTERISTIC
/begin CHARACTERISTIC KL_ELTEMP60 "Temperaturfaktor Elüfter" CURVE 0xc0940 TKL_SW_VV_UW 100.0 Def_f_uw_b512 0.0 511.9921 /begin FUNCTION_LIST BGCRENG /end FUNCTION_LIST
 /begin AXIS_DESCR STD_AXIS Tans Def_t_sw_q0p1 6 -3276.8000 3276.7000 FORMAT "%4.1" /end AXIS_DESCR
 FORMAT "%6.3" /end CHARACTERISTIC
/begin CHARACTERISTIC KL_ELUB39 "" CURVE 0xc092a TKL_UW_VV_UW 100.0 Def_f_uw_b512 0.0 511.9921 /begin FUNCTION_LIST BGCRENG /end FUNCTION_LIST /begin AXIS_DESCR STD_AXIS Ub Def_u_uw_q0p0942 5 0.0 6173.3970 FORMAT "%4.1" /end AXIS_DESCR FORMAT "%6.3" /end CHARACTERISTIC
/begin CHARACTERISTIC KL_ELUB60 "" CURVE 0xc08f0 TKL_UW_VV_UW 100.0 Def_f_uw_b512 0.0 511.9921 /begin FUNCTION_LIST BGCRENG /end FUNCTION_LIST /begin AXIS_DESCR STD_AXIS Ub Def_u_uw_q0p0942 5 0.0 6173.3970 FORMAT "%4.1" /end AXIS_DESCR FORMAT "%6.3" /end CHARACTERISTIC
/begin CHARACTERISTIC KL_FPDIODE1 "Verlustleistungsfaktor eines Diodenpaars1" CURVE 0xc11c4 TKL_SW_VV_UB 100.0 Def_f_ub_b2 0.0 1.9921 /begin FUNCTION_LIST IMDGEN_1PR /end FUNCTION_LIST
 /begin AXIS_DESCR STD_AXIS Tgen Def_t_sw_q0p1 5 -3276.8000 3276.7000 FORMAT "%4.1" /end AXIS_DESCR
/end CHARACTERISTIC
/begin CHARACTERISTIC KL_FPDIODE2 "Verlustleistungsfaktor eines Diodenpaars2" CURVE 0xc1228 TKL_SW_VV_UB 100.0 Def_f_ub_b2 0.0 1.9921 /begin FUNCTION_LIST IMDGEN_1PR /end FUNCTION_LIST
 /begin AXIS_DESCR STD_AXIS Tgen Def_t_sw_q0p1 5 -3276.8000 3276.7000 FORMAT "%4.1" /end AXIS_DESCR
/end CHARACTERISTIC
/begin CHARACTERISTIC KL_FPDIODE3 "Verlustleistungsfaktor eines Diodenpaars" CURVE 0xc118c TKL_SW_VV_UB 100.0 Def_f_ub_b2 0.0 1.9921 /begin FUNCTION_LIST IMDGEN_1PR /end FUNCTION_LIST
 /begin AXIS_DESCR STD_AXIS Tgen Def_t_sw_q0p1 5 -3276.8000 3276.7000 FORMAT "%4.1" /end AXIS_DESCR
/end CHARACTERISTIC
/begin CHARACTERISTIC KL_FPDIODE4 "Verlustleistungsfaktor eines Diodenpaars4" CURVE 0xc1216 TKL_SW_VV_UB 100.0 Def_f_ub_b2 0.0 1.9921 /begin FUNCTION_LIST IMDGEN_1PR /end FUNCTION_LIST
 /begin AXIS_DESCR STD_AXIS Tgen Def_t_sw_q0p1 5 -3276.8000 3276.7000 FORMAT "%4.1" /end AXIS_DESCR
/end CHARACTERISTIC
/begin CHARACTERISTIC KL_GENEXP1 "Abkühlkurve Generator1" CURVE 0xc1036 TKL_UW_VV_UB 100.0 Def_f_ub_b1 0.0 0.9960 /begin FUNCTION_LIST IMDGEN_1PR /end FUNCTION_LIST /begin AXIS_DESCR STD_AXIS Tn_abstell Def_st_uw_q1 13 0.0 65535.0000 /end AXIS_DESCR /end CHARACTERISTIC
/begin CHARACTERISTIC KL_GENEXP2 "Abkühlkurve Generator2" CURVE 0xc0fda TKL_UW_VV_UB 100.0 Def_f_ub_b1 0.0 0.9960 /begin FUNCTION_LIST IMDGEN_1PR /end FUNCTION_LIST /begin AXIS_DESCR STD_AXIS Tn_abstell Def_st_uw_q1 13 0.0 65535.0000 /end AXIS_DESCR /end CHARACTERISTIC
/begin CHARACTERISTIC KL_GENEXP3 "Abkühlkurve Generator3" CURVE 0xc1162 TKL_UW_VV_UB 100.0 Def_f_ub_b1 0.0 0.9960 /begin FUNCTION_LIST IMDGEN_1PR /end FUNCTION_LIST /begin AXIS_DESCR STD_AXIS Tn_abstell Def_st_uw_q1 13 0.0 65535.0000 /end AXIS_DESCR /end CHARACTERISTIC
/begin CHARACTERISTIC KL_GENEXP4 "Abkühlkurve Generator4" CURVE 0xc108a TKL_UW_VV_UB 100.0 Def_f_ub_b1 0.0 0.9960 /begin FUNCTION_LIST IMDGEN_1PR /end FUNCTION_LIST /begin AXIS_DESCR STD_AXIS Tn_abstell Def_st_uw_q1 13 0.0 65535.0000 /end AXIS_DESCR /end CHARACTERISTIC
/begin CHARACTERISTIC KL_GENTETA1 "Temperatur_eta_faktor Generator1" CURVE 0xc119e TKL_SW_VV_UW 100.0 Def_f_uw_b2 0.0 1.9999 /begin FUNCTION_LIST IMDGEN_1PR /end FUNCTION_LIST
 /begin AXIS_DESCR STD_AXIS Tgen Def_t_sw_q0p1 3 -3276.8000 3276.7000 FORMAT "%4.1" /end AXIS_DESCR
/end CHARACTERISTIC
/begin CHARACTERISTIC KL_GENTETA2 "Temperatur_eta_faktor Generator2" CURVE 0xc11f0 TKL_SW_VV_UW 100.0 Def_f_uw_b2 0.0 1.9999 /begin FUNCTION_LIST IMDGEN_1PR /end FUNCTION_LIST
 /begin AXIS_DESCR STD_AXIS Tgen Def_t_sw_q0p1 3 -3276.8000 3276.7000 FORMAT "%4.1" /end AXIS_DESCR
/end CHARACTERISTIC
/begin CHARACTERISTIC KL_GENTETA3 "Temperatur_eta_faktor Generator3" CURVE 0xc0f82 TKL_SW_VV_UW 100.0 Def_f_uw_b2 0.0 1.9999 /begin FUNCTION_LIST IMDGEN_1PR /end FUNCTION_LIST
 /begin AXIS_DESCR STD_AXIS Tgen Def_t_sw_q0p1 3 -3276.8000 3276.7000 FORMAT "%4.1" /end AXIS_DESCR
/end CHARACTERISTIC
/begin CHARACTERISTIC KL_GENTETA4 "Temperatur_eta_faktor Generator4" CURVE 0xc0f5a TKL_SW_VV_UW 100.0 Def_f_uw_b2 0.0 1.9999 /begin FUNCTION_LIST IMDGEN_1PR /end FUNCTION_LIST
 /begin AXIS_DESCR STD_AXIS Tgen Def_t_sw_q0p1 3 -3276.8000 3276.7000 FORMAT "%4.1" /end AXIS_DESCR
/end CHARACTERISTIC
/begin CHARACTERISTIC KL_IABGLMOT "Abgleichstrom Motor" CURVE 0xc0918 TKL_UW_VV_UB 100.0 Def_f_ub_b8 0.0 7.9687 /begin FUNCTION_LIST BGCRENG /end FUNCTION_LIST /begin AXIS_DESCR STD_AXIS Ub Def_u_uw_q0p0942 5 0.0 6173.3970 FORMAT "%4.1" /end AXIS_DESCR /end CHARACTERISTIC
/begin CHARACTERISTIC KL_IABGLNL "Abgleichstrom Kl. 15" CURVE 0xc0968 TKL_UW_VV_UB 100.0 Def_f_ub_b8 0.0 7.9687 /begin FUNCTION_LIST BGCRENG /end FUNCTION_LIST /begin AXIS_DESCR STD_AXIS Ub Def_u_uw_q0p0942 5 0.0 6173.3970 FORMAT "%4.1" /end AXIS_DESCR /end CHARACTERISTIC
/begin CHARACTERISTIC KL_IABGLST "Abgleichstrom Start" CURVE 0xc0906 TKL_UW_VV_UB 100.0 Def_f_ub_b8 0.0 7.9687 /begin FUNCTION_LIST BGCRENG /end FUNCTION_LIST /begin AXIS_DESCR STD_AXIS Ub Def_u_uw_q0p0942 5 0.0 6173.3970 FORMAT "%4.1" /end AXIS_DESCR /end CHARACTERISTIC
/begin CHARACTERISTIC KL_RTH0FAK1 "RTHfaktor1 ueber Generatorstrom" CURVE 0xc0f90 TKL_UB_VV_UB 100.0 Def_f_ub_b4 0.0 3.9843 /begin FUNCTION_LIST IMDGEN_1PR /end FUNCTION_LIST /begin AXIS_DESCR STD_AXIS I_gen_end Def_i_ub_q1 11 0.0 255.0000 /end AXIS_DESCR /end CHARACTERISTIC
/begin CHARACTERISTIC KL_RTH0FAK2 "RTHfaktor 2 ueber Generatorstrom" CURVE 0xc11ac TKL_UB_VV_UB 100.0 Def_f_ub_b4 0.0 3.9843 /begin FUNCTION_LIST IMDGEN_1PR /end FUNCTION_LIST /begin AXIS_DESCR STD_AXIS I_gen_end Def_i_ub_q1 11 0.0 255.0000 /end AXIS_DESCR /end CHARACTERISTIC
/begin CHARACTERISTIC KL_RTH0FAK3 "RTHfaktor3 ueber Generatorstrom" CURVE 0xc0f41 TKL_UB_VV_UB 100.0 Def_f_ub_b4 0.0 3.9843 /begin FUNCTION_LIST IMDGEN_1PR /end FUNCTION_LIST /begin AXIS_DESCR STD_AXIS I_gen_end Def_i_ub_q1 11 0.0 255.0000 /end AXIS_DESCR /end CHARACTERISTIC
/begin CHARACTERISTIC KL_RTH0FAK4 "RTHfaktor4 ueber Generatorstrom" CURVE 0xc0fc2 TKL_UB_VV_UB 100.0 Def_f_ub_b4 0.0 3.9843 /begin FUNCTION_LIST IMDGEN_1PR /end FUNCTION_LIST /begin AXIS_DESCR STD_AXIS I_gen_end Def_i_ub_q1 11 0.0 255.0000 /end AXIS_DESCR /end CHARACTERISTIC
/begin CHARACTERISTIC KL_RTHFAK1 "RTHfaktor ueber Generatorstrom" CURVE 0xc11fe TKL_UB_VV_UB 100.0 Def_f_ub_b4 0.0 3.9843 /begin FUNCTION_LIST IMDGEN_1PR /end FUNCTION_LIST /begin AXIS_DESCR STD_AXIS I_gen_end Def_i_ub_q1 11 0.0 255.0000 /end AXIS_DESCR /end CHARACTERISTIC
/begin CHARACTERISTIC KL_RTHFAK2 "RTHfaktor2 ueber Generatorstrom Fahrt" CURVE 0xc101e TKL_UB_VV_UB 100.0 Def_f_ub_b4 0.0 3.9843 /begin FUNCTION_LIST IMDGEN_1PR /end FUNCTION_LIST /begin AXIS_DESCR STD_AXIS I_gen_end Def_i_ub_q1 11 0.0 255.0000 /end AXIS_DESCR /end CHARACTERISTIC
/begin CHARACTERISTIC KL_RTHFAK3 "RTHfaktor3 ueber Generatorstrom Fahrt" CURVE 0xc1108 TKL_UB_VV_UB 100.0 Def_f_ub_b4 0.0 3.9843 /begin FUNCTION_LIST IMDGEN_1PR /end FUNCTION_LIST /begin AXIS_DESCR STD_AXIS I_gen_end Def_i_ub_q1 11 0.0 255.0000 /end AXIS_DESCR /end CHARACTERISTIC
/begin CHARACTERISTIC KL_RTHFAK4 "RTHfaktor4 ueber Generatorstrom Fahrt" CURVE 0xc114a TKL_UB_VV_UB 100.0 Def_f_ub_b4 0.0 3.9843 /begin FUNCTION_LIST IMDGEN_1PR /end FUNCTION_LIST /begin AXIS_DESCR STD_AXIS I_gen_end Def_i_ub_q1 11 0.0 255.0000 /end AXIS_DESCR /end CHARACTERISTIC
/begin CHARACTERISTIC KL_RTHGEN1 "RTH-Kennfeld Generator1" CURVE 0xc0fa8 TKL_SW_VV_UW 100.0 Def_f_uw_b64 0.0 63.9990 /begin FUNCTION_LIST IMDGEN_1PR /end FUNCTION_LIST /begin AXIS_DESCR STD_AXIS N_gen Def_n_sw_q1p0 6 -32768.0000 32767.0000 /end AXIS_DESCR FORMAT "%7.4" /end CHARACTERISTIC
/begin CHARACTERISTIC KL_RTHGEN2 "RTH-Kennfeld Generator2" CURVE 0xc0f68 TKL_SW_VV_UW 100.0 Def_f_uw_b64 0.0 63.9990 /begin FUNCTION_LIST IMDGEN_1PR /end FUNCTION_LIST /begin AXIS_DESCR STD_AXIS N_gen Def_n_sw_q1p0 6 -32768.0000 32767.0000 /end AXIS_DESCR FORMAT "%7.4" /end CHARACTERISTIC
/begin CHARACTERISTIC KL_RTHGEN3 "RTH-Kennfeld Generator3" CURVE 0xc1004 TKL_SW_VV_UW 100.0 Def_f_uw_b64 0.0 63.9990 /begin FUNCTION_LIST IMDGEN_1PR /end FUNCTION_LIST /begin AXIS_DESCR STD_AXIS N_gen Def_n_sw_q1p0 6 -32768.0000 32767.0000 /end AXIS_DESCR FORMAT "%7.4" /end CHARACTERISTIC
/begin CHARACTERISTIC KL_RTHGEN4 "RTH-Kennfeld Generator4" CURVE 0xc11d6 TKL_SW_VV_UW 100.0 Def_f_uw_b64 0.0 63.9990 /begin FUNCTION_LIST IMDGEN_1PR /end FUNCTION_LIST /begin AXIS_DESCR STD_AXIS N_gen Def_n_sw_q1p0 6 -32768.0000 32767.0000 /end AXIS_DESCR FORMAT "%7.4" /end CHARACTERISTIC
/begin CHARACTERISTIC KL_TANSGEN1 "Kennlinie Generatoransaugluft1" CURVE 0xc10de TKL_UW_VV_SW 100.0 Def_t_sw_q0p1 -3276.8000 3276.7000 /begin FUNCTION_LIST IMDGEN_1PR /end FUNCTION_LIST /begin AXIS_DESCR STD_AXIS V Def_v_uw_q1p0 10 0.0 360.0000 /end AXIS_DESCR FORMAT "%4.1" /end CHARACTERISTIC
/begin CHARACTERISTIC KL_TANSGEN2 "Kennlinie Generatoransaugluft2" CURVE 0xc1120 TKL_UW_VV_SW 100.0 Def_t_sw_q0p1 -3276.8000 3276.7000 /begin FUNCTION_LIST IMDGEN_1PR /end FUNCTION_LIST /begin AXIS_DESCR STD_AXIS V Def_v_uw_q1p0 10 0.0 360.0000 /end AXIS_DESCR FORMAT "%4.1" /end CHARACTERISTIC
/begin CHARACTERISTIC KL_TANSGEN3 "Kennlinie Generatoransaugluft3" CURVE 0xc10b4 TKL_UW_VV_SW 100.0 Def_t_sw_q0p1 -3276.8000 3276.7000 /begin FUNCTION_LIST IMDGEN_1PR /end FUNCTION_LIST /begin AXIS_DESCR STD_AXIS V Def_v_uw_q1p0 10 0.0 360.0000 /end AXIS_DESCR FORMAT "%4.1" /end CHARACTERISTIC
/begin CHARACTERISTIC KL_TANSGEN4 "Kennlinie Generatoransaugluft4" CURVE 0xc1060 TKL_UW_VV_SW 100.0 Def_t_sw_q0p1 -3276.8000 3276.7000 /begin FUNCTION_LIST IMDGEN_1PR /end FUNCTION_LIST /begin AXIS_DESCR STD_AXIS V Def_v_uw_q1p0 10 0.0 360.0000 /end AXIS_DESCR FORMAT "%4.1" /end CHARACTERISTIC
/begin CHARACTERISTIC K_CRENGOF "" VALUE 0xc08d0 TKW_VV_VV_UW 100.0 Def_i_uw_q0p0635 0.0 4095.9375 /begin FUNCTION_LIST BGCRENG /end FUNCTION_LIST FORMAT "%6.3" /end CHARACTERISTIC
/begin CHARACTERISTIC K_CRVVTNOT "Wert vvt_iges bei vvt_es Fehlersignal" VALUE 0xc08d2 TKW_VV_VV_UW 100.0 Def_i_uw_q0p0635 0.0 4095.9375 /begin FUNCTION_LIST BGCRENG /end FUNCTION_LIST FORMAT "%6.3" /end CHARACTERISTIC
/begin CHARACTERISTIC K_CRVVTOF "" VALUE 0xc08d4 TKW_VV_VV_UW 100.0 Def_i_uw_q0p0635 0.0 4095.9375 /begin FUNCTION_LIST BGCRENG /end FUNCTION_LIST FORMAT "%6.3" /end CHARACTERISTIC
/begin CHARACTERISTIC K_DFRUTYP "DF-Rückschaltungstyp für LLR-Anhebung" VALUE 0xc0aae TKW_VV_VV_UB 100.0 Def_st_ub_q1 0.0 255.0000 /begin FUNCTION_LIST BGLLGEN_1PR /end FUNCTION_LIST /end CHARACTERISTIC
/begin CHARACTERISTIC K_DF_DEAKAPP "Df-Schwelle für IG 0A Zwangssetzung" VALUE 0xc0f02 TKW_VV_VV_UB 100.0 Def_f_ub_b100 0.0 99.6093 /begin FUNCTION_LIST IMDGEN_1PR /end FUNCTION_LIST /end CHARACTERISTIC
/begin CHARACTERISTIC K_DTOG_UBMIN "" VALUE 0xc0c10 TKW_VV_VV_UW 100.0 Def_u_uw_q0p0942 0.0 6173.3970 /begin FUNCTION_LIST DQLT /end FUNCTION_LIST FORMAT "%4.1" /end CHARACTERISTIC
/begin CHARACTERISTIC K_ENGENTANS "Schwelle Motortemperatur fuer Freigabe Generaturansaugluft " VALUE 0xc0eac TKW_VV_VV_SW 100.0 Def_t_sw_q0p1 -3276.8000 3276.7000 /begin FUNCTION_LIST IMDGEN_1PR /end FUNCTION_LIST FORMAT "%4.1" /end CHARACTERISTIC
/begin CHARACTERISTIC K_EN_MDGEN "" VALUE 0xc0f03 TKW_VV_VV_UB 100.0 Def_st_ub_q1 0.0 255.0000 /begin FUNCTION_LIST IMDGEN_1PR /end FUNCTION_LIST /end CHARACTERISTIC
/begin CHARACTERISTIC K_GENDIFAK1 "Stromfaktor Diode1" VALUE 0xc0f04 TKW_VV_VV_UB 100.0 Def_f_ub_b1 0.0 0.9960 /begin FUNCTION_LIST IMDGEN_1PR /end FUNCTION_LIST /end CHARACTERISTIC
/begin CHARACTERISTIC K_GENDIFAK2 "Stromfaktor Diode2" VALUE 0xc0f05 TKW_VV_VV_UB 100.0 Def_f_ub_b1 0.0 0.9960 /begin FUNCTION_LIST IMDGEN_1PR /end FUNCTION_LIST /end CHARACTERISTIC
/begin CHARACTERISTIC K_GENDIFAK3 "Stromfaktor Diode3" VALUE 0xc0f06 TKW_VV_VV_UB 100.0 Def_f_ub_b1 0.0 0.9960 /begin FUNCTION_LIST IMDGEN_1PR /end FUNCTION_LIST /end CHARACTERISTIC
/begin CHARACTERISTIC K_GENDIFAK4 "Stromfaktor Diode4" VALUE 0xc0f07 TKW_VV_VV_UB 100.0 Def_f_ub_b1 0.0 0.9960 /begin FUNCTION_LIST IMDGEN_1PR /end FUNCTION_LIST /end CHARACTERISTIC
/begin CHARACTERISTIC K_GENITYP "Generatorstrotyp 0=gerechnet / 1=gemessen" VALUE 0xc0f08 TKW_VV_VV_UB 100.0 Def_st_ub_q1 0.0 1.0000 /begin FUNCTION_LIST IMDGEN_1PR /end FUNCTION_LIST /end CHARACTERISTIC
/begin CHARACTERISTIC K_GENMDNMOF "Offset des Generatormoments" VALUE 0xc0eae TKW_VV_VV_SW 100.0 Def_m_sw_q0p1 -3276.8000 3276.7000 /begin FUNCTION_LIST IMDGEN_1PR /end FUNCTION_LIST FORMAT "%5.2" /end CHARACTERISTIC
/begin CHARACTERISTIC K_GENPDTIME "Predrivetime für Ladekontrollampe KL61" VALUE 0xc0c02 TKW_VV_VV_UB 100.0 Def_td_ub_q0p1 0.0 25.5000 /begin FUNCTION_LIST DGEN /end FUNCTION_LIST /end CHARACTERISTIC
/begin CHARACTERISTIC K_GENRS0_1 "Generatorstatorwiderstand1 bei 25°" VALUE 0xc0ebc TKW_VV_VV_UW 100.0 Def_f_uw_b1 0.0 9.99984741210938e-1 /begin FUNCTION_LIST IMDGEN_1PR /end FUNCTION_LIST /end CHARACTERISTIC
/begin CHARACTERISTIC K_GENRS0_2 "Generatorstatorwiderstand2 bei 25°" VALUE 0xc0ebe TKW_VV_VV_UW 100.0 Def_f_uw_b1 0.0 9.99984741210938e-1 /begin FUNCTION_LIST IMDGEN_1PR /end FUNCTION_LIST /end CHARACTERISTIC
/begin CHARACTERISTIC K_GENRS0_3 "Generatorstatorwiderstand3 bei 25°" VALUE 0xc0ec0 TKW_VV_VV_UW 100.0 Def_f_uw_b1 0.0 9.99984741210938e-1 /begin FUNCTION_LIST IMDGEN_1PR /end FUNCTION_LIST /end CHARACTERISTIC
/begin CHARACTERISTIC K_GENRS0_4 "Generatorstatorwiderstand4 bei 25°" VALUE 0xc0ec2 TKW_VV_VV_UW 100.0 Def_f_uw_b1 0.0 9.99984741210938e-1 /begin FUNCTION_LIST IMDGEN_1PR /end FUNCTION_LIST /end CHARACTERISTIC
/begin CHARACTERISTIC K_GENSTFAK1 "Stromfaktor Statorspule" VALUE 0xc0f09 TKW_VV_VV_UB 100.0 Def_f_ub_b1 0.0 0.9960 /begin FUNCTION_LIST IMDGEN_1PR /end FUNCTION_LIST /end CHARACTERISTIC
/begin CHARACTERISTIC K_GENSTFAK2 "Stromfaktor Statorspule2" VALUE 0xc0f0a TKW_VV_VV_UB 100.0 Def_f_ub_b1 0.0 0.9960 /begin FUNCTION_LIST IMDGEN_1PR /end FUNCTION_LIST /end CHARACTERISTIC
/begin CHARACTERISTIC K_GENSTFAK3 "Stromfaktor Statorspule3" VALUE 0xc0f0b TKW_VV_VV_UB 100.0 Def_f_ub_b1 0.0 0.9960 /begin FUNCTION_LIST IMDGEN_1PR /end FUNCTION_LIST /end CHARACTERISTIC
/begin CHARACTERISTIC K_GENSTFAK4 "Stromfaktor Statorspule4" VALUE 0xc0f0c TKW_VV_VV_UB 100.0 Def_f_ub_b1 0.0 0.9960 /begin FUNCTION_LIST IMDGEN_1PR /end FUNCTION_LIST /end CHARACTERISTIC
/begin CHARACTERISTIC K_GENTEMPAPP "Geneeratortemperatur mauelle Vorgabe" VALUE 0xc0eb0 TKW_VV_VV_SW 100.0 Def_t_sw_q0p1 -3276.8000 3276.7000 /begin FUNCTION_LIST IMDGEN_1PR /end FUNCTION_LIST FORMAT "%4.1" /end CHARACTERISTIC
/begin CHARACTERISTIC K_GENTEMPMAN "Manuelle Generatorvorgabe" VALUE 0xc0f0d TKW_VV_VV_UB 100.0 Def_st_ub_q1 0.0 255.0000 /begin FUNCTION_LIST IMDGEN_1PR /end FUNCTION_LIST /end CHARACTERISTIC
/begin CHARACTERISTIC K_GENTMOTDT "" VALUE 0xc0eb2 TKW_VV_VV_SW 100.0 Def_t_sw_q0p1 -3276.8000 3276.7000 /begin FUNCTION_LIST IMDGEN_1PR /end FUNCTION_LIST FORMAT "%4.1" /end CHARACTERISTIC
/begin CHARACTERISTIC K_GENTMOTOF1 "Offset Generatoransaugluft" VALUE 0xc0eb4 TKW_VV_VV_SW 100.0 Def_t_sw_q0p1 -3276.8000 3276.7000 /begin FUNCTION_LIST IMDGEN_1PR /end FUNCTION_LIST FORMAT "%4.1" /end CHARACTERISTIC
/begin CHARACTERISTIC K_GENTMOTOF2 "Offset Generatoransaugluft" VALUE 0xc0eb6 TKW_VV_VV_SW 100.0 Def_t_sw_q0p1 -3276.8000 3276.7000 /begin FUNCTION_LIST IMDGEN_1PR /end FUNCTION_LIST FORMAT "%4.1" /end CHARACTERISTIC
/begin CHARACTERISTIC K_GENTMOTOF3 "Offset Generatoransaugluft" VALUE 0xc0eb8 TKW_VV_VV_SW 100.0 Def_t_sw_q0p1 -3276.8000 3276.7000 /begin FUNCTION_LIST IMDGEN_1PR /end FUNCTION_LIST FORMAT "%4.1" /end CHARACTERISTIC
/begin CHARACTERISTIC K_GENTMOTOF4 "Offset Generatoransaugluft" VALUE 0xc0eba TKW_VV_VV_SW 100.0 Def_t_sw_q0p1 -3276.8000 3276.7000 /begin FUNCTION_LIST IMDGEN_1PR /end FUNCTION_LIST FORMAT "%4.1" /end CHARACTERISTIC
/begin CHARACTERISTIC K_GENTYP "Generatortyp" VALUE 0xc0f0e TKW_VV_VV_UB 100.0 Def_st_ub_q1 0.0 255.0000 /begin FUNCTION_LIST IMDGEN_1PR /end FUNCTION_LIST /end CHARACTERISTIC
/begin CHARACTERISTIC K_GENTYPFELD "Generatorkennfeldzuordnung" VAL_BLK 0xc0f20 TKW_VV_VV_UB 100.0 Def_st_ub_q1 0.0 255.0000 /begin FUNCTION_LIST IMDGEN_1PR /end FUNCTION_LIST NUMBER 33 /end CHARACTERISTIC
/begin CHARACTERISTIC K_GENUEBSETZ1 "Generatoruebersetzung1" VALUE 0xc0c20 TKW_VV_VV_UB 100.0 Def_f_ub_b4 0.0 3.9843 /begin FUNCTION_LIST IMDGEN_1PR /end FUNCTION_LIST /end CHARACTERISTIC
/begin CHARACTERISTIC K_GENUEBSETZ2 "Generatoruebersetzung2" VALUE 0xc0c21 TKW_VV_VV_UB 100.0 Def_f_ub_b4 0.0 3.9843 /begin FUNCTION_LIST IMDGEN_1PR /end FUNCTION_LIST /end CHARACTERISTIC
/begin CHARACTERISTIC K_GENUEBSETZ3 "Generatoruebersetzung3" VALUE 0xc0c22 TKW_VV_VV_UB 100.0 Def_f_ub_b4 0.0 3.9843 /begin FUNCTION_LIST IMDGEN_1PR /end FUNCTION_LIST /end CHARACTERISTIC
/begin CHARACTERISTIC K_GENUEBSETZ4 "Generatoruebersetzung4" VALUE 0xc0c23 TKW_VV_VV_UB 100.0 Def_f_ub_b4 0.0 3.9843 /begin FUNCTION_LIST IMDGEN_1PR /end FUNCTION_LIST /end CHARACTERISTIC
/begin CHARACTERISTIC K_GENUMGTYP "" VALUE 0xc0f0f TKW_VV_VV_UB 100.0 Def_st_ub_q1 0.0 255.0000 /begin FUNCTION_LIST IMDGEN_1PR /end FUNCTION_LIST /end CHARACTERISTIC
/begin CHARACTERISTIC K_GENVFZGSW "geschwindigkeitsabhängige Generatoransaugluftschwelle" VALUE 0xc0ec4 TKW_VV_VV_UW 100.0 Def_v_uw_q1p0 0.0 65535.0000 /begin FUNCTION_LIST IMDGEN_1PR /end FUNCTION_LIST /end CHARACTERISTIC
/begin CHARACTERISTIC K_GEN_DNMIN "Motordrehzahlschwelle  für Auswertung der Generatorfehler" VALUE 0xc0bfe TKW_VV_VV_SW 100.0 Def_n_sw_q1p0 -32768.0000 32767.0000 /begin FUNCTION_LIST DGEN /end FUNCTION_LIST /end CHARACTERISTIC
/begin CHARACTERISTIC K_GEN_IGOF "Offsetwert Generatorstrom" VALUE 0xc0ec6 TKW_VV_VV_UW 100.0 Def_f_uw_b2048 0.0 254.0000 /begin FUNCTION_LIST IMDGEN_1PR /end FUNCTION_LIST FORMAT "%5.2" /end CHARACTERISTIC
/begin CHARACTERISTIC K_IABGLMOT "Konstante Abgleichstrom Motor" VALUE 0xc08c8 TKW_VV_VV_SW 100.0 Def_i_sw_q0p001 -32.7680 32.7670 /begin FUNCTION_LIST BGCRENG /end FUNCTION_LIST FORMAT "%6.3" /end CHARACTERISTIC
/begin CHARACTERISTIC K_IABGLNL "Konstante Abgleichstrom Kl. 15" VALUE 0xc08ca TKW_VV_VV_SW 100.0 Def_i_sw_q0p001 -32.7680 32.7670 /begin FUNCTION_LIST BGCRENG /end FUNCTION_LIST FORMAT "%6.3" /end CHARACTERISTIC
/begin CHARACTERISTIC K_IABGLST "Konstante Abgleichstrom Start" VALUE 0xc08cc TKW_VV_VV_SW 100.0 Def_i_sw_q0p001 -32.7680 32.7670 /begin FUNCTION_LIST BGCRENG /end FUNCTION_LIST FORMAT "%6.3" /end CHARACTERISTIC
/begin CHARACTERISTIC K_IGBASIS "Generatorgrundstrombedarf FZG " VALUE 0xc0f10 TKW_VV_VV_UB 100.0 Def_i_ub_q1 0.0 255.0000 /begin FUNCTION_LIST IMDGEN_1PR /end FUNCTION_LIST /end CHARACTERISTIC
/begin CHARACTERISTIC K_IGBASISOFF "Generatorgrundstrombedarf FZG bei Genred" VALUE 0xc0f11 TKW_VV_VV_UB 100.0 Def_i_ub_q1 0.0 255.0000 /begin FUNCTION_LIST IMDGEN_1PR /end FUNCTION_LIST /end CHARACTERISTIC
/begin CHARACTERISTIC K_IGENLLRANH "Generatorstromabstand für LL-Anhebung" VALUE 0xc0aaf TKW_VV_VV_UB 100.0 Def_i_ub_q1 0.0 254.0000 /begin FUNCTION_LIST BGLLGEN_1PR /end FUNCTION_LIST /end CHARACTERISTIC
/begin CHARACTERISTIC K_IGNOTWERT "" VALUE 0xc0f12 TKW_VV_VV_UB 100.0 Def_i_ub_q1 0.0 255.0000 /begin FUNCTION_LIST IMDGEN_1PR /end FUNCTION_LIST /end CHARACTERISTIC
/begin CHARACTERISTIC K_IKEINESA "Konstante Strom wenn keine SA" VALUE 0xc08ce TKW_VV_VV_SW 100.0 Def_i_sw_q0p001 -32.7680 32.7670 /begin FUNCTION_LIST BGCRENG /end FUNCTION_LIST FORMAT "%6.3" /end CHARACTERISTIC
/begin CHARACTERISTIC K_LLRABS_DF "DF-Schwelle für LL-Absenkung" VALUE 0xc0ab0 TKW_VV_VV_UB 100.0 Def_f_ub_b100 0.0 99.6093 /begin FUNCTION_LIST BGLLGEN_1PR /end FUNCTION_LIST /end CHARACTERISTIC
/begin CHARACTERISTIC K_LLRANH_DF "DF-Schwelle für LL-Anhebung" VALUE 0xc0ab1 TKW_VV_VV_UB 100.0 Def_f_ub_b100 0.0 99.6093 /begin FUNCTION_LIST BGLLGEN_1PR /end FUNCTION_LIST /end CHARACTERISTIC
/begin CHARACTERISTIC K_MANAWNUMM "" VALUE 0xc0f13 TKW_VV_VV_UB 100.0 Def_st_ub_q1 0.0 255.0000 /begin FUNCTION_LIST IMDGEN_1PR /end FUNCTION_LIST /end CHARACTERISTIC
/begin CHARACTERISTIC K_MSKGENDFP "Bitmaske Generator Fehler-> DFP" VALUE 0xc0c03 TKW_VV_VV_UB 100.0 Def_st_ub_q1 0.0 255.0000 /begin FUNCTION_LIST DGEN /end FUNCTION_LIST /end CHARACTERISTIC
/begin CHARACTERISTIC K_MSKGENKL61 "Bitmaske fuer Generatorfehler -> Ladekontrolle" VALUE 0xc0c04 TKW_VV_VV_UB 100.0 Def_st_ub_q1 0.0 255.0000 /begin FUNCTION_LIST DGEN /end FUNCTION_LIST /end CHARACTERISTIC
/begin CHARACTERISTIC K_MSKIBSDFP "Bitmaske Generator Fehler-> DFP" VALUE 0xc0c07 TKW_VV_VV_UB 100.0 Def_st_ub_q1 0.0 255.0000 /begin FUNCTION_LIST DIBS /end FUNCTION_LIST /end CHARACTERISTIC
/begin CHARACTERISTIC K_MSKIBSDFP2 "" VALUE 0xc0c08 TKW_VV_VV_UB 100.0 Def_st_ub_q1 0.0 255.0000 /begin FUNCTION_LIST DIBS /end FUNCTION_LIST /end CHARACTERISTIC
/begin CHARACTERISTIC K_MSKIBSDIAG "Test AK disable Diagnose" VALUE 0xc0c09 TKW_VV_VV_UB 100.0 Def_st_ub_q1 0.0 255.0000 /begin FUNCTION_LIST DIBS /end FUNCTION_LIST /end CHARACTERISTIC
/begin CHARACTERISTIC K_MSKIBSERR "" VALUE 0xc0c0a TKW_VV_VV_UB 100.0 ident 0.0 255.0000 /begin FUNCTION_LIST DIBS /end FUNCTION_LIST /end CHARACTERISTIC
/begin CHARACTERISTIC K_MSKIBSERR2 "" VALUE 0xc0c0b TKW_VV_VV_UB 100.0 ident 0.0 255.0000 /begin FUNCTION_LIST DIBS /end FUNCTION_LIST /end CHARACTERISTIC
/begin CHARACTERISTIC K_NTWBGLLGEN "Notlaufwert Leerlaufanhebung bei Generatorfehler" VALUE 0xc0ab2 TKW_VV_VV_UB 100.0 Def_st_ub_q1 0.0 1.0000 /begin FUNCTION_LIST BGLLGEN_1PR /end FUNCTION_LIST /end CHARACTERISTIC
/begin CHARACTERISTIC K_OZDIAGNMOT "Mindestdrehzahl zur QLT-Diagnose" VALUE 0xc0c0c TKW_VV_VV_SW 100.0 Def_n_sw_q1p0 -32768.0000 32767.0000 /begin FUNCTION_LIST DQLT /end FUNCTION_LIST /end CHARACTERISTIC
/begin CHARACTERISTIC K_OZDIAGSPG "Spannung, unterhalb der die Diagnose ausgeblendet wird" VALUE 0xc0c12 TKW_VV_VV_UW 100.0 Def_u_uw_q0p0942 0.0 6173.3970 /begin FUNCTION_LIST DQLT /end FUNCTION_LIST FORMAT "%4.1" /end CHARACTERISTIC
/begin CHARACTERISTIC K_OZERRD "Entprellzeit Sensor- und Kommunikationsfehler" VALUE 0xc0c14 TKW_VV_VV_UW 100.0 Def_dez_uw_q1 0.0 65535.0000 /begin FUNCTION_LIST DQLT /end FUNCTION_LIST /end CHARACTERISTIC
/begin CHARACTERISTIC K_OZHEAL "Entprellzeit Fehler-Healing" VALUE 0xc0c16 TKW_VV_VV_UW 100.0 Def_dez_uw_q1 0.0 65535.0000 /begin FUNCTION_LIST DQLT /end FUNCTION_LIST /end CHARACTERISTIC
/begin CHARACTERISTIC K_OZTEMPQERR "Temperaturschwelle für den Permittivitätsfehler" VALUE 0xc0c0e TKW_VV_VV_SW 100.0 Def_t_sw_q0p1 -3276.8000 3276.7000 /begin FUNCTION_LIST DQLT /end FUNCTION_LIST FORMAT "%4.1" /end CHARACTERISTIC
/begin CHARACTERISTIC K_PRELLDFAH "Prellzeit für LLR-Anhebung" VALUE 0xc0ab3 TKW_VV_VV_UB 100.0 Def_td_ub_q0p1 0.0 25.5000 /begin FUNCTION_LIST BGLLGEN_1PR /end FUNCTION_LIST /end CHARACTERISTIC
/begin CHARACTERISTIC K_PRELLDFRF "Prellzeit für LLR-Absenkung" VALUE 0xc0ab4 TKW_VV_VV_UB 100.0 Def_td_ub_q0p1 0.0 25.5000 /begin FUNCTION_LIST BGLLGEN_1PR /end FUNCTION_LIST /end CHARACTERISTIC
/begin CHARACTERISTIC K_PRELLGTMOT "Prellzeit für Tmot-Schwelle" VALUE 0xc0f14 TKW_VV_VV_UB 100.0 Def_td_ub_q1 0.0 255.0000 /begin FUNCTION_LIST IMDGEN_1PR /end FUNCTION_LIST /end CHARACTERISTIC
/begin CHARACTERISTIC K_SNMBSDKL61 "" VALUE 0xc0c00 TKW_VV_VV_SW 100.0 Def_n_sw_q1p0 -32768.0000 32767.0000 /begin FUNCTION_LIST DGEN /end FUNCTION_LIST /end CHARACTERISTIC
/begin CHARACTERISTIC K_TIGMISCH "" VALUE 0xc0f15 TKW_VV_VV_UB 100.0 Def_td_ub_q0p01 0.0 2.5500 /begin FUNCTION_LIST IMDGEN_1PR /end FUNCTION_LIST /end CHARACTERISTIC
/begin CHARACTERISTIC K_TOGMAXUNPL "" VALUE 0xc0c18 TKW_VV_VV_UL 100.0 Def_dez_ul_q1 0.0 2147483647.0000 /begin FUNCTION_LIST DQLT /end FUNCTION_LIST /end CHARACTERISTIC
/begin CHARACTERISTIC K_TOG_CNTMAX "" VALUE 0xc0c1c TKW_VV_VV_UL 100.0 Def_dez_ul_q1 0.0 4294967295.0000 /begin FUNCTION_LIST DQLT /end FUNCTION_LIST /end CHARACTERISTIC
/begin CHARACTERISTIC K_TSTCNTEN "" VALUE 0xc0f16 TKW_VV_VV_UB 100.0 Def_st_ub_q1 0.0 255.0000 /begin FUNCTION_LIST IMDGEN_1PR /end FUNCTION_LIST /end CHARACTERISTIC
/begin CHARACTERISTIC K_TSTFIL_IN "" VALUE 0xc0ec8 TKW_VV_VV_UW 100.0 Def_t_uw_q0p075 0.0 49151.2500 /begin FUNCTION_LIST IMDGEN_1PR /end FUNCTION_LIST FORMAT "%5.2" /end CHARACTERISTIC
/begin CHARACTERISTIC K_TSTFIL_INI "" VALUE 0xc0f17 TKW_VV_VV_UB 100.0 Def_st_ub_q1 0.0 255.0000 /begin FUNCTION_LIST IMDGEN_1PR /end FUNCTION_LIST /end CHARACTERISTIC
/begin CHARACTERISTIC K_UDIODERMS1 "RMS-Schwellspannung Generatordiode1" VALUE 0xc0f18 TKW_VV_VV_UB 100.0 Def_f_ub_b2 0.0 1.9921 /begin FUNCTION_LIST IMDGEN_1PR /end FUNCTION_LIST /end CHARACTERISTIC
/begin CHARACTERISTIC K_UDIODERMS2 "RMS-Schwellspannung Generatordiode2" VALUE 0xc0f19 TKW_VV_VV_UB 100.0 Def_f_ub_b2 0.0 1.9921 /begin FUNCTION_LIST IMDGEN_1PR /end FUNCTION_LIST /end CHARACTERISTIC
/begin CHARACTERISTIC K_UDIODERMS3 "RMS-Schwellspannung Generatordiode3" VALUE 0xc0f1a TKW_VV_VV_UB 100.0 Def_f_ub_b2 0.0 1.9921 /begin FUNCTION_LIST IMDGEN_1PR /end FUNCTION_LIST /end CHARACTERISTIC
/begin CHARACTERISTIC K_UDIODERMS4 "RMS-Schwellspannung Generatordiode3" VALUE 0xc0f1b TKW_VV_VV_UB 100.0 Def_f_ub_b2 0.0 1.9921 /begin FUNCTION_LIST IMDGEN_1PR /end FUNCTION_LIST /end CHARACTERISTIC
/begin CHARACTERISTIC K_ZMGENIG "" VALUE 0xc0eca TKW_VV_VV_UW 100.0 Def_f_uw_b1 0.0 9.99984741210938e-1 /begin FUNCTION_LIST IMDGEN_1PR /end FUNCTION_LIST /end CHARACTERISTIC
/begin CHARACTERISTIC K_ZMGENS0HZ1 "Zeitkonstante Generatorstator1 Aufheizung im Stand" VALUE 0xc0ecc TKW_VV_VV_UW 100.0 Def_f_uw_b1 0.0 9.99984741210938e-1 /begin FUNCTION_LIST IMDGEN_1PR /end FUNCTION_LIST /end CHARACTERISTIC
/begin CHARACTERISTIC K_ZMGENS0HZ2 "Zeitkonstante Generatorstator2 Aufheizung im Stand" VALUE 0xc0ece TKW_VV_VV_UW 100.0 Def_f_uw_b1 0.0 9.99984741210938e-1 /begin FUNCTION_LIST IMDGEN_1PR /end FUNCTION_LIST /end CHARACTERISTIC
/begin CHARACTERISTIC K_ZMGENS0HZ3 "Zeitkonstante Generatorstator3 Aufheizung im Stand" VALUE 0xc0ed0 TKW_VV_VV_UW 100.0 Def_f_uw_b1 0.0 9.99984741210938e-1 /begin FUNCTION_LIST IMDGEN_1PR /end FUNCTION_LIST /end CHARACTERISTIC
/begin CHARACTERISTIC K_ZMGENS0HZ4 "Zeitkonstante Generatorstator4 Aufheizung im Stand" VALUE 0xc0ed2 TKW_VV_VV_UW 100.0 Def_f_uw_b1 0.0 9.99984741210938e-1 /begin FUNCTION_LIST IMDGEN_1PR /end FUNCTION_LIST /end CHARACTERISTIC
/begin CHARACTERISTIC K_ZMGENS0KL1 "Zeitkonstante Abkühlung Generator im Stand1" VALUE 0xc0ed4 TKW_VV_VV_UW 100.0 Def_f_uw_b1 0.0 9.99984741210938e-1 /begin FUNCTION_LIST IMDGEN_1PR /end FUNCTION_LIST /end CHARACTERISTIC
/begin CHARACTERISTIC K_ZMGENS0KL2 "Zeitkonstante Abkühlung Generator im Stand2" VALUE 0xc0ed6 TKW_VV_VV_UW 100.0 Def_f_uw_b1 0.0 9.99984741210938e-1 /begin FUNCTION_LIST IMDGEN_1PR /end FUNCTION_LIST /end CHARACTERISTIC
/begin CHARACTERISTIC K_ZMGENS0KL3 "Zeitkonstante Abkühlung Generator im Stand3" VALUE 0xc0ed8 TKW_VV_VV_UW 100.0 Def_f_uw_b1 0.0 9.99984741210938e-1 /begin FUNCTION_LIST IMDGEN_1PR /end FUNCTION_LIST /end CHARACTERISTIC
/begin CHARACTERISTIC K_ZMGENS0KL4 "Zeitkonstante Abkühlung Generator im Stand4" VALUE 0xc0eda TKW_VV_VV_UW 100.0 Def_f_uw_b1 0.0 9.99984741210938e-1 /begin FUNCTION_LIST IMDGEN_1PR /end FUNCTION_LIST /end CHARACTERISTIC
/begin CHARACTERISTIC K_ZMGENSTHZ1 "Zeitkonstante Generatorstator1 Aufheizung" VALUE 0xc0edc TKW_VV_VV_UW 100.0 Def_f_uw_b1 0.0 9.99984741210938e-1 /begin FUNCTION_LIST IMDGEN_1PR /end FUNCTION_LIST /end CHARACTERISTIC
/begin CHARACTERISTIC K_ZMGENSTHZ2 "Zeitkonstante Generatorstator2 Aufheizung" VALUE 0xc0ede TKW_VV_VV_UW 100.0 Def_f_uw_b1 0.0 9.99984741210938e-1 /begin FUNCTION_LIST IMDGEN_1PR /end FUNCTION_LIST /end CHARACTERISTIC
/begin CHARACTERISTIC K_ZMGENSTHZ3 "Zeitkonstante Generatorstator3 Aufheizung" VALUE 0xc0ee0 TKW_VV_VV_UW 100.0 Def_f_uw_b1 0.0 9.99984741210938e-1 /begin FUNCTION_LIST IMDGEN_1PR /end FUNCTION_LIST /end CHARACTERISTIC
/begin CHARACTERISTIC K_ZMGENSTHZ4 "Zeitkonstante Generatorstator4 Aufheizung" VALUE 0xc0ee2 TKW_VV_VV_UW 100.0 Def_f_uw_b1 0.0 9.99984741210938e-1 /begin FUNCTION_LIST IMDGEN_1PR /end FUNCTION_LIST /end CHARACTERISTIC
/begin CHARACTERISTIC K_ZMGENSTKL1 "Zeitkonstante Abkühlung Generator1" VALUE 0xc0ee4 TKW_VV_VV_UW 100.0 Def_f_uw_b1 0.0 9.99984741210938e-1 /begin FUNCTION_LIST IMDGEN_1PR /end FUNCTION_LIST /end CHARACTERISTIC
/begin CHARACTERISTIC K_ZMGENSTKL2 "Zeitkonstante Abkühlung Generator2" VALUE 0xc0ee6 TKW_VV_VV_UW 100.0 Def_f_uw_b1 0.0 9.99984741210938e-1 /begin FUNCTION_LIST IMDGEN_1PR /end FUNCTION_LIST /end CHARACTERISTIC
/begin CHARACTERISTIC K_ZMGENSTKL3 "Zeitkonstante Abkühlung Generator3" VALUE 0xc0ee8 TKW_VV_VV_UW 100.0 Def_f_uw_b1 0.0 9.99984741210938e-1 /begin FUNCTION_LIST IMDGEN_1PR /end FUNCTION_LIST /end CHARACTERISTIC
/begin CHARACTERISTIC K_ZMGENSTKL4 "Zeitkonstante Abkühlung Generator4" VALUE 0xc0eea TKW_VV_VV_UW 100.0 Def_f_uw_b1 0.0 9.99984741210938e-1 /begin FUNCTION_LIST IMDGEN_1PR /end FUNCTION_LIST /end CHARACTERISTIC
/begin CHARACTERISTIC K_ZMGENTWA "" VALUE 0xc0eec TKW_VV_VV_UW 100.0 Def_f_uw_b1 0.0 9.99984741210938e-1 /begin FUNCTION_LIST IMDGEN_1PR /end FUNCTION_LIST /end CHARACTERISTIC
/begin CHARACTERISTIC K_ZMGN0TANS1 "Zeitkonstante Generatoransaugluft1 bei vfzg = 0" VALUE 0xc0eee TKW_VV_VV_UW 100.0 Def_f_uw_b1 0.0 9.99984741210938e-1 /begin FUNCTION_LIST IMDGEN_1PR /end FUNCTION_LIST /end CHARACTERISTIC
/begin CHARACTERISTIC K_ZMGN0TANS2 "Zeitkonstante Generatoransaugluft2 bei vfzg = 0" VALUE 0xc0ef0 TKW_VV_VV_UW 100.0 Def_f_uw_b1 0.0 9.99984741210938e-1 /begin FUNCTION_LIST IMDGEN_1PR /end FUNCTION_LIST /end CHARACTERISTIC
/begin CHARACTERISTIC K_ZMGN0TANS3 "Zeitkonstante Generatoransaugluft3 bei vfzg = 0" VALUE 0xc0ef2 TKW_VV_VV_UW 100.0 Def_f_uw_b1 0.0 9.99984741210938e-1 /begin FUNCTION_LIST IMDGEN_1PR /end FUNCTION_LIST /end CHARACTERISTIC
/begin CHARACTERISTIC K_ZMGN0TANS4 "Zeitkonstante Generatoransaugluft4 bei vfzg = 0" VALUE 0xc0ef4 TKW_VV_VV_UW 100.0 Def_f_uw_b1 0.0 9.99984741210938e-1 /begin FUNCTION_LIST IMDGEN_1PR /end FUNCTION_LIST /end CHARACTERISTIC
/begin CHARACTERISTIC K_ZMGNTANS1 "Zeitkonstante Generatoransaugluft1" VALUE 0xc0ef6 TKW_VV_VV_UW 100.0 Def_f_uw_b1 0.0 9.99984741210938e-1 /begin FUNCTION_LIST IMDGEN_1PR /end FUNCTION_LIST /end CHARACTERISTIC
/begin CHARACTERISTIC K_ZMGNTANS2 "Zeitkonstante Generatoransaugluft2" VALUE 0xc0ef8 TKW_VV_VV_UW 100.0 Def_f_uw_b1 0.0 9.99984741210938e-1 /begin FUNCTION_LIST IMDGEN_1PR /end FUNCTION_LIST /end CHARACTERISTIC
/begin CHARACTERISTIC K_ZMGNTANS3 "Zeitkonstante Generatoransaugluft3" VALUE 0xc0efa TKW_VV_VV_UW 100.0 Def_f_uw_b1 0.0 9.99984741210938e-1 /begin FUNCTION_LIST IMDGEN_1PR /end FUNCTION_LIST /end CHARACTERISTIC
/begin CHARACTERISTIC K_ZMGNTANS4 "Zeitkonstante Generatoransaugluft3" VALUE 0xc0efc TKW_VV_VV_UW 100.0 Def_f_uw_b1 0.0 9.99984741210938e-1 /begin FUNCTION_LIST IMDGEN_1PR /end FUNCTION_LIST /end CHARACTERISTIC
/begin CHARACTERISTIC K_ZMIGMISCH "Zeitkonstante IG Mischung" VALUE 0xc0efe TKW_VV_VV_UW 100.0 Def_f_uw_b1 0.0 9.99984741210938e-1 /begin FUNCTION_LIST IMDGEN_1PR /end FUNCTION_LIST /end CHARACTERISTIC
/begin CHARACTERISTIC K_ZMTESTFIL "" VALUE 0xc0f00 TKW_VV_VV_UW 100.0 Def_f_uw_b1 0.0 9.99984741210938e-1 /begin FUNCTION_LIST IMDGEN_1PR /end FUNCTION_LIST /end CHARACTERISTIC
/begin CHARACTERISTIC S_BSDKOORD "" VALUE 0xc0c06 TKW_VV_VV_UB 100.0 Identity 0.0 1.0000 /begin FUNCTION_LIST DIBS /end FUNCTION_LIST /end CHARACTERISTIC
/begin CHARACTERISTIC S_BSDKORD "Einschalten DGEN für BSD Koordinator" VALUE 0xc0c05 TKW_VV_VV_UB 100.0 Identity 0.0 1.0000 /begin FUNCTION_LIST DGEN /end FUNCTION_LIST /end CHARACTERISTIC
/begin CHARACTERISTIC S_IGMISCH "" VALUE 0xc0f1c TKW_VV_VV_UB 100.0 Identity 0.0 1.0000 /begin FUNCTION_LIST IMDGEN_1PR /end FUNCTION_LIST /end CHARACTERISTIC
/begin CHARACTERISTIC S_RDGENTYP "" VALUE 0xc0f1d TKW_VV_VV_UB 100.0 Def_st_ub_q1 0.0 255.0000 /begin FUNCTION_LIST IMDGEN_1PR /end FUNCTION_LIST /end CHARACTERISTIC
/begin CHARACTERISTIC StSys_DebTrqShutOffDef_C "Fehlerentprellzeit T50shutoff" VALUE 0xEBA3A Kw_Wu16 655350.0 Time_ms 0.00 655350.0 FORMAT "%8.1" /end CHARACTERISTIC
/begin CHARACTERISTIC StSys_DebTrqShutOffOk_C "Heilungsentprellzeit T50shutoff" VALUE 0xEBA3C Kw_Wu16 655350.0 Time_ms 0.00 655350.0 FORMAT "%8.1" /end CHARACTERISTIC
/begin CHARACTERISTIC StSys_n2MsWhlLoLim_C "untere kritische Drehzahlgrenze (ZMS-Resonanz)" VALUE 0xEBA44 Kw_Ws16 1000.000 EngN 0.00 1000.000 FORMAT "%8.3" EXTENDED_LIMITS -32768.00 32767.00 /end CHARACTERISTIC
/begin CHARACTERISTIC StSys_n2MsWhlUpOfs_C "Offset for starting trq shutoff" VALUE 0xEBA46 Kw_Ws16 1000.000 EngN 0.00 1000.000 FORMAT "%8.3" EXTENDED_LIMITS -32768.00 32767.00 /end CHARACTERISTIC
/begin CHARACTERISTIC StSys_tinFltPT1_C "time constant for the engine speed low pass filter" VALUE 0xEBA48 Kw_Wu32 4294.9673 TimeDelay_s 0.0000010000000 4294.9673 FORMAT "%9.4" /end CHARACTERISTIC
/begin CHARACTERISTIC StSys_nStarter_C "maximale Drehzahl für Start ohne Kl50" VALUE 0xEBA3E Kw_Ws16 6000.000 EngN 0.00 6000.000 FORMAT "%8.3" EXTENDED_LIMITS -32768.00 32767.00 /end CHARACTERISTIC
/begin CHARACTERISTIC StSys_swtShutOff_C "switch to deactivate the torque shutoff function" VALUE 0xEBA4C Kw_Wu8 1.000 OneToOne 0.00 1.000 FORMAT "%5.3" EXTENDED_LIMITS 0.00 255.0 /end CHARACTERISTIC
/begin CHARACTERISTIC StSys_ti2MsWhlPrt_C "Verzögerungszeit Startmomentenabschaltung" VALUE 0xEBA4E Kw_Wu16 655350.0 Time_ms 0.00 655350.0 FORMAT "%8.1" /end CHARACTERISTIC
/begin CHARACTERISTIC StSys_tiEngageCutOut_C "Ausblendzeit nEng-ueberwachung bei Start" VALUE 0xEBA40 Kw_Wu16 655350.0 Time_ms 0.00 655350.0 FORMAT "%8.1" /end CHARACTERISTIC
/begin CHARACTERISTIC StSys_tiStartOszilDef_C "Defect time for pulsation error" VALUE 0xEBA50 Kw_Wu16 655350.0 Time_ms 0.00 655350.0 FORMAT "%8.1" /end CHARACTERISTIC
/begin CHARACTERISTIC StSys_tiStartOszilOk_C "Healing time for pulsation error" VALUE 0xEBA52 Kw_Wu16 655350.0 Time_ms 0.00 655350.0 FORMAT "%8.1" /end CHARACTERISTIC
/begin CHARACTERISTIC StSys_vThres_C "Geschw.grenze Fzg. wird angeschoben" VALUE 0xEBA42 Kw_Ws16 251.0000 Vel -1.000000 250.0000 FORMAT "%8.4" EXTENDED_LIMITS -327.6800 327.6700 /end CHARACTERISTIC
/begin CHARACTERISTIC T15CD_tiDebNeg_C "#SSD Filterzeitkonstante der Klemme 15 für fallende Flanken" VALUE 0xEBA54 Kw_Wu16 655350.0 TimeDeb 0.00 655350.0 FORMAT "%8.1" /end CHARACTERISTIC
/begin CHARACTERISTIC T15CD_tiDebPos_C "#SSD Filterzeitkonstante der Klemme 15 für steigende Flanken" VALUE 0xEBA56 Kw_Wu16 655350.0 TimeDeb 0.00 655350.0 FORMAT "%8.1" /end CHARACTERISTIC
/begin CHARACTERISTIC T15CD_DebNplDef_C "Fehlerentprellzeit für Plausibilitätsfehler" VALUE 0xEBA58 Kw_Wu16 655350.0 Time_ms 0.00 655350.0 FORMAT "%8.1" /end CHARACTERISTIC
/begin CHARACTERISTIC T15CD_DebNplOk_C "Heilungsentprellzeit für Plausibilitätsfehler" VALUE 0xEBA5A Kw_Wu16 655350.0 Time_ms 0.00 655350.0 FORMAT "%8.1" /end CHARACTERISTIC
/begin CHARACTERISTIC T15CD_numDioIn_C "#SSD Applikationsparameter fuer Klemme 15" VALUE 0xEBA5C Kw_Wu8 14.0000000000 NumPinDioIn 0.00 14.0000000000 FORMAT "%13.10" /end CHARACTERISTIC
/begin CHARACTERISTIC T15CD_stInvIn_C "Invertierungsparameter für Klemme 15 Eingangssignal" VALUE 0xEBA5D Kw_Wu8 1.000 OneToOne 0.00 1.000 FORMAT "%5.3" EXTENDED_LIMITS 0.00 255.0 READ_ONLY /end CHARACTERISTIC
/begin CHARACTERISTIC T15CD_tiDebWakeUp_C "Maximale Zeitverzögerung zwischen pos.Flankedesentprellen WakeUp Signals und Klemme15 über CAN" VALUE 0xEBA5E Kw_Wu16 655350.0 Time_ms 0.00 655350.0 FORMAT "%8.1" /end CHARACTERISTIC
/begin CHARACTERISTIC T50CD_tiDebNeg_C "Entprellzeit  fallende Flanke" VALUE 0xEBA60 Kw_Wu16 655350.0 TimeDeb 0.00 655350.0 FORMAT "%8.1" /end CHARACTERISTIC
/begin CHARACTERISTIC T50CD_tiDebPos_C "entprellzeit steigende Flanke" VALUE 0xEBA62 Kw_Wu16 655350.0 TimeDeb 0.00 655350.0 FORMAT "%8.1" /end CHARACTERISTIC
/begin CHARACTERISTIC T50CD_stDflVal_C "Vorgabewert Zustand T50" VALUE 0xEBA64 Kw_Wu8 1.000 OneToOne 0.00 1.000 FORMAT "%5.3" EXTENDED_LIMITS 0.00 255.0 /end CHARACTERISTIC
/begin CHARACTERISTIC T50CD_stInv_C "Invertierung Eingangssignal T50CD_stRawVal" VALUE 0xEBA65 Kw_Wu8 1.000 OneToOne 0.00 1.000 FORMAT "%5.3" EXTENDED_LIMITS 0.00 255.0 /end CHARACTERISTIC
/begin CHARACTERISTIC T50CD_swtSigVal_C "Signalschalter T50 (1=CAN 0=HW)" VALUE 0xEBA66 Kw_Wu8 1.000 OneToOne 0.00 1.000 FORMAT "%5.3" EXTENDED_LIMITS 0.00 255.0 /end CHARACTERISTIC
/begin CHARACTERISTIC ThrVlv_rTVA_Vector "#SSD Bypass-Label für ThrVlv_rTVA" VALUE 0xC2E1C Kw_Wu8 255.0 OneToOne 0.00 255.0 FORMAT "%5.1" /end CHARACTERISTIC
/begin CHARACTERISTIC ThrVlv_rTVA_Channel "#SSD Bypass-Label für ThrVlv_rTVA" VALUE 0xC2E1D Kw_Wu8 255.0 OneToOne 0.00 255.0 FORMAT "%5.1" /end CHARACTERISTIC
/begin CHARACTERISTIC TPUMon_ctDfctLim_C "#SSD Oberer Entprellzähler Grenzwert für Defekterkennung" VALUE 0xC303C Kw_Wu16 65535.00 OneToOne 0.00 65535.00 FORMAT "%8.2" /end CHARACTERISTIC
/begin CHARACTERISTIC TPUMon_ctTPU_C "Index der auf den Messpunkten dargestellten TPU" VALUE 0xC303E Kw_Wu8 255.0 OneToOne 0.00 255.0 FORMAT "%5.1" /end CHARACTERISTIC
/begin CHARACTERISTIC TPUMon_tiDiffMaxLimit_C "#SSD Maximal zulässige einzelne Timerdifferenz" VALUE 0xC3040 Kw_Ws32 2147483647.00 TimeUSResolution 0.00 2147483647.00 FORMAT "%13.2" EXTENDED_LIMITS -2147483648.00 2147483647.00 /end CHARACTERISTIC
/begin CHARACTERISTIC TPUMon_tiDiffMinLimit_C "#SSD Minimal zulässige einzelne Timerdifferenz (negativer Wert)" VALUE 0xC3044 Kw_Ws32 2147483648.00 TimeUSResolution -2147483648.00 0.00 FORMAT "%13.2" EXTENDED_LIMITS -2147483648.00 2147483647.00 /end CHARACTERISTIC
/begin CHARACTERISTIC TPUMon_tiDiffSumLimit_C "#SSD Maximal zulässige Betragsumme Timerdifferenz" VALUE 0xC3048 Kw_Ws32 2147483647.00 TimeUSResolution 0.00 2147483647.00 FORMAT "%13.2" EXTENDED_LIMITS -2147483648.00 2147483647.00 /end CHARACTERISTIC
/begin CHARACTERISTIC TVACD_DebExcTempDef_C "Fehlerentprellzeit für Übertemperatur" VALUE 0xEBA68 Kw_Wu16 655350.0 Time_ms 0.00 655350.0 FORMAT "%8.1" /end CHARACTERISTIC
/begin CHARACTERISTIC TVACD_DebExcTempOk_C "Heilungsentprellzeit für Übertemperatur" VALUE 0xEBA6A Kw_Wu16 655350.0 Time_ms 0.00 655350.0 FORMAT "%8.1" /end CHARACTERISTIC
/begin CHARACTERISTIC TVACD_DebNoLoadDef_C "Fehlerentprellzeit für Lastabfall" VALUE 0xEBA6C Kw_Wu16 655350.0 Time_ms 0.00 655350.0 FORMAT "%8.1" /end CHARACTERISTIC
/begin CHARACTERISTIC TVACD_DebNoLoadOk_C "Heilungsentprellzeit für Lastabfall" VALUE 0xEBA6E Kw_Wu16 655350.0 Time_ms 0.00 655350.0 FORMAT "%8.1" /end CHARACTERISTIC
/begin CHARACTERISTIC TVACD_DebShortCircBatDef_C "Fehlerentprellzeit für Kurzschluß nach Batterie" VALUE 0xEBA70 Kw_Wu16 655350.0 Time_ms 0.00 655350.0 FORMAT "%8.1" /end CHARACTERISTIC
/begin CHARACTERISTIC TVACD_DebShortCircBatOk_C "Heilungsentprellzeit für Kurzschluß nach Batterie" VALUE 0xEBA72 Kw_Wu16 655350.0 Time_ms 0.00 655350.0 FORMAT "%8.1" /end CHARACTERISTIC
/begin CHARACTERISTIC TVACD_DebShortCircGndDef_C "Fehlerentprellzeit für Kurzschluß nach Masse" VALUE 0xEBA74 Kw_Wu16 655350.0 Time_ms 0.00 655350.0 FORMAT "%8.1" /end CHARACTERISTIC
/begin CHARACTERISTIC TVACD_DebShortCircGndOk_C "Heilungsentprellzeit für Kurzschluß nach Masse" VALUE 0xEBA76 Kw_Wu16 655350.0 Time_ms 0.00 655350.0 FORMAT "%8.1" /end CHARACTERISTIC
/begin CHARACTERISTIC TVACD_tiDebTVADia1Def_C "Fehlerentprellzeit für Drosselklappenstellers Diagnose erstes Zeitfenster" VALUE 0xEBA78 Kw_Wu16 655350.0 Time_ms 0.00 655350.0 FORMAT "%8.1" /end CHARACTERISTIC
/begin CHARACTERISTIC TVACD_tiDebTVADia1Ok_C "Fehlerheilzeit für Drosselklappenstellers Diagnose erstes Zeitfenster" VALUE 0xEBA7A Kw_Wu16 655350.0 Time_ms 0.00 655350.0 FORMAT "%8.1" /end CHARACTERISTIC
/begin CHARACTERISTIC TVACD_tiDebTVADia2Def_C "Fehlerentprellzeit für Drosselklappenstellers Diagnose zweites Zeitfenster" VALUE 0xEBA7C Kw_Wu16 655350.0 Time_ms 0.00 655350.0 FORMAT "%8.1" /end CHARACTERISTIC
/begin CHARACTERISTIC TVACD_tiDebTVADia2Ok_C "Fehlerheilzeit für Drosselklappenstellers Diagnose zweites Zeitfenster" VALUE 0xEBA7E Kw_Wu16 655350.0 Time_ms 0.00 655350.0 FORMAT "%8.1" /end CHARACTERISTIC
/begin CHARACTERISTIC TVACD_tiDebTVADia3Def_C "Fehlerentprellzeit für Drosselklappenstellers Diagnose drittes Zeitfenster" VALUE 0xEBA80 Kw_Wu16 655350.0 Time_ms 0.00 655350.0 FORMAT "%8.1" /end CHARACTERISTIC
/begin CHARACTERISTIC TVACD_tiDebTVADia3Ok_C "Fehlerheilzeit für Drosselklappenstellers Diagnose drittes Zeitfenster" VALUE 0xEBA82 Kw_Wu16 655350.0 Time_ms 0.00 655350.0 FORMAT "%8.1" /end CHARACTERISTIC
/begin CHARACTERISTIC TVACD_numDia_C "#SSD Applikationsparameter fuer Diagnose-Signal von Drossel-Steller" VALUE 0xEBA84 Kw_Wu8 34.0000000000 NumPinDia 0.00 34.0000000000 FORMAT "%13.10" /end CHARACTERISTIC
/begin CHARACTERISTIC TVACD_numPwmOut_C "#SSD Applikationsparameter fuer Drosselwert-Steller" VALUE 0xEBA85 Kw_Wu8 12.0000000000 NumPinPwmOut 0.00 12.0000000000 FORMAT "%13.10" /end CHARACTERISTIC
/begin CHARACTERISTIC TVACD_stInvOut_C "Invertierungsparameter für das Signal der Drosselklappenstellerendstufe" VALUE 0xEBA86 Kw_Wu8 1.000 OneToOne 0.00 1.000 FORMAT "%5.3" EXTENDED_LIMITS 0.00 255.0 /end CHARACTERISTIC
/begin CHARACTERISTIC TVACD_tiPer_C "Periodendauer Drosselklappensteller" VALUE 0xEBA88 Kw_Ws16 6553.500 Period -3276.800 3276.700 FORMAT "%8.3" /end CHARACTERISTIC
/begin CHARACTERISTIC TVACD_rCnv_CUR "Kennlinie zur konvertierung von Öffnungsgrad in Tastverhältnis" CURVE 0xEBA8A Kl_Xs16_Ws16 100.0000 DtyCyc 0.00 100.0000 FORMAT "%8.4" EXTENDED_LIMITS -327.6800 327.6700
 /begin AXIS_DESCR STD_AXIS ThrVlv_rTVA Prc 25 -100.0000 200.0000 FORMAT "%8.4" EXTENDED_LIMITS -400.0000 399.9878 DEPOSIT ABSOLUTE /end AXIS_DESCR
/end CHARACTERISTIC
/begin CHARACTERISTIC TVACD_rOutMax_C "Maximal auszugebendes Tastverhältnis" VALUE 0xEBAF0 Kw_Ws16 655.3500 DtyCyc -327.6800 327.6700 FORMAT "%8.4" /end CHARACTERISTIC
/begin CHARACTERISTIC TVACD_rOutMin_C "Minimal auszugebendes Tastverhältnis" VALUE 0xEBAF2 Kw_Ws16 655.3500 DtyCyc -327.6800 327.6700 FORMAT "%8.4" /end CHARACTERISTIC
/begin CHARACTERISTIC TVACD_rTst_C "Tastverhältnis, dass im Fehlerfall zyklisch ausgegeben wird" VALUE 0xEBAF4 Kw_Ws16 100.0000 DtyCyc 0.00 100.0000 FORMAT "%8.4" EXTENDED_LIMITS -327.6800 327.6700 /end CHARACTERISTIC
/begin CHARACTERISTIC TVACD_stPwrStgActv_C "Aktivierung der Abschaltbedingungen der Endstufe" VALUE 0xEBAF6 Kw_Wu8 255.0 OneToOne 0.00 255.0 FORMAT "%5.1" /end CHARACTERISTIC
/begin CHARACTERISTIC TVACD_stPwrStgDia_C "Aktivierung der Abschaltbedingungen der Endstufendiagnose" VALUE 0xEBAF7 Kw_Wu8 255.0 OneToOne 0.00 255.0 FORMAT "%5.1" /end CHARACTERISTIC
/begin CHARACTERISTIC TVACD_swt_C "Schalter Batteriespannungskorrektur (0 = AUS, 1 = EIN)" VALUE 0xEBAF8 Kw_Wu8 255.0 OneToOne 0.00 255.0 FORMAT "%5.1" /end CHARACTERISTIC
/begin CHARACTERISTIC TVACD_tiBtwTst_C "Zeitabstand, in dem im Fehlerfall die Endstufe getestet wird" VALUE 0xEBAFA Kw_Wu16 29980.00 Time_ms 20.00000 30000.00 FORMAT "%8.2" EXTENDED_LIMITS 0.00 655350.0 /end CHARACTERISTIC
/begin CHARACTERISTIC TVACD_tiDiag1Max_C "Maximum des ersten Signalfensters für Fehlersignale des Drosselklappensteller" VALUE 0xEBAFC Kw_Wu16 655350.0 Time_ms 0.00 655350.0 FORMAT "%8.1" /end CHARACTERISTIC
/begin CHARACTERISTIC TVACD_tiDiag1Min_C "Minimum des ersten Signalfensters für Fehlersignale des Drosselklappensteller" VALUE 0xEBAFE Kw_Wu16 655350.0 Time_ms 0.00 655350.0 FORMAT "%8.1" /end CHARACTERISTIC
/begin CHARACTERISTIC TVACD_tiDiag2Max_C "Maximum des zweiten Signalfensters für Fehlersignale des Drosselklappensteller" VALUE 0xEBB00 Kw_Wu16 655350.0 Time_ms 0.00 655350.0 FORMAT "%8.1" /end CHARACTERISTIC
/begin CHARACTERISTIC TVACD_tiDiag2Min_C "Minimum des zweiten Signalfensters für Fehlersignale des Drosselklappensteller" VALUE 0xEBB02 Kw_Wu16 655350.0 Time_ms 0.00 655350.0 FORMAT "%8.1" /end CHARACTERISTIC
/begin CHARACTERISTIC TVACD_tiDiag3Max_C "Maximum des dritten Signalfensters für Fehlersignale des Drosselklappensteller" VALUE 0xEBB04 Kw_Wu16 655350.0 Time_ms 0.00 655350.0 FORMAT "%8.1" /end CHARACTERISTIC
/begin CHARACTERISTIC TVACD_tiDiag3Min_C "Minimum des dritten Signalfensters für Fehlersignale des Drosselklappensteller" VALUE 0xEBB06 Kw_Wu16 655350.0 Time_ms 0.00 655350.0 FORMAT "%8.1" /end CHARACTERISTIC
/begin CHARACTERISTIC UAddr_stCalibration_C "#SSD ECU Applikationszugriff (0 = unterbunden, 1 = erlaubt)" VALUE 0xC08C6 Kw_Wu8 1.000 OneToOne 0.00 1.000 FORMAT "%5.3" EXTENDED_LIMITS 0.00 255.0 /end CHARACTERISTIC
/begin CHARACTERISTIC Uaddr_stMeasurement_C "ECU Messzugriff (0 = unterbunden, 1 = erlaubt)" VALUE 0xC08C7 Kw_Wu8 1.000 OneToOne 0.00 1.000 FORMAT "%5.3" EXTENDED_LIMITS 0.00 255.0 /end CHARACTERISTIC
/begin CHARACTERISTIC USAp_dDataVariantIdInv_C "Identifier dieser Datensatzvariante (invertiert)" VALUE 0xEBB08 Kw_Wu32 4294967295.00 OneToOne 0.00 4294967295.00 FORMAT "%13.2" /end CHARACTERISTIC
/begin CHARACTERISTIC USAp_dDataVariantId_C "Identifier dieser Datensatzvariante" VALUE 0xEBB0C Kw_Wu32 4294967295.00 OneToOne 0.00 4294967295.00 FORMAT "%13.2" /end CHARACTERISTIC
/begin CHARACTERISTIC UsrDa_swtFDC_C "Schalter zur Auswahl des FDC-Sportmoduseingriffs" VALUE 0xEBB10 Kw_Wu8 255.0 OneToOne 0.00 255.0 FORMAT "%5.1" /end CHARACTERISTIC
/begin CHARACTERISTIC VehDa_lEepUpd_C "#SSD Streckenintervall zwischen zwei EEPROM Block Updates für Vehicle Data (VehDa_lSum, VehDa_tiEngOn)" VALUE 0xEBB20 Kw_Wu32 4294957295.00 Length 10000.0000000 4294967295.00 FORMAT "%13.2" EXTENDED_LIMITS 0.00 4294967295.00 /end CHARACTERISTIC
/begin CHARACTERISTIC VehDa_nMaxEepUpd_C "Maximale Motordrehzahl für Update EEPROM Block (VehDa_lSum, VehDa_tiEngOn)" VALUE 0xEBB24 Kw_Ws16 6000.000 EngN 0.00 6000.000 FORMAT "%8.3" EXTENDED_LIMITS -32768.00 32767.00 /end CHARACTERISTIC
/begin CHARACTERISTIC VehDa_nMinEepUpd_C "Minimale Motordrehzahl für Update EEPROM Block (VehDa_lSum, VehDa_tiEngOn)" VALUE 0xEBB26 Kw_Ws16 5000.000 EngN 1000.000 6000.000 FORMAT "%8.3" EXTENDED_LIMITS -32768.00 32767.00 /end CHARACTERISTIC
/begin CHARACTERISTIC VehDa_rVnMax_C "maximales v/n-Verhältnis" VALUE 0xEBB14 Kw_Ws16 0.3276700 VelToN 0.00 0.3276700 FORMAT "%9.7" EXTENDED_LIMITS -0.3276800 0.3276700 /end CHARACTERISTIC
/begin CHARACTERISTIC VehDa_tiNPT1_C "T1 Zeitkonstante zur Vorfilterung der Motordrehzahl für v/n-Verhältnis" VALUE 0xEBB18 Kw_Wu32 4294.9673 TimeDelay_s 0.0000010000000 4294.9673 FORMAT "%9.4" /end CHARACTERISTIC
/begin CHARACTERISTIC VehDa_tiVnPT1_C "T1 Zeitkonstante zur Filterung des v/n-Verhältnisses" VALUE 0xEBB1C Kw_Wu32 4294.9673 TimeDelay_s 0.0000010000000 4294.9673 FORMAT "%9.4" /end CHARACTERISTIC
/begin CHARACTERISTIC VSACD_DebExcTempDef_C "Fehlerentprellzeit für Übertemperatur" VALUE 0xEBB28 Kw_Wu16 655350.0 Time_ms 0.00 655350.0 FORMAT "%8.1" /end CHARACTERISTIC
/begin CHARACTERISTIC VSACD_DebExcTempOk_C "Heilungsentprellzeit für Übertemperatur" VALUE 0xEBB2A Kw_Wu16 655350.0 Time_ms 0.00 655350.0 FORMAT "%8.1" /end CHARACTERISTIC
/begin CHARACTERISTIC VSACD_DebNoLoadDef_C "Fehlerentprellzeit für Lastabfall" VALUE 0xEBB2C Kw_Wu16 655350.0 Time_ms 0.00 655350.0 FORMAT "%8.1" /end CHARACTERISTIC
/begin CHARACTERISTIC VSACD_DebNoLoadOk_C "Heilungsentprellzeit für Lastabfall" VALUE 0xEBB2E Kw_Wu16 655350.0 Time_ms 0.00 655350.0 FORMAT "%8.1" /end CHARACTERISTIC
/begin CHARACTERISTIC VSACD_DebShortCircBatDef_C "Fehlerentprellzeit für Kurzschluß nach Batterie" VALUE 0xEBB30 Kw_Wu16 655350.0 Time_ms 0.00 655350.0 FORMAT "%8.1" /end CHARACTERISTIC
/begin CHARACTERISTIC VSACD_DebShortCircBatOk_C "Heilungsentprellzeit für Kurzschluß nach Batterie" VALUE 0xEBB32 Kw_Wu16 655350.0 Time_ms 0.00 655350.0 FORMAT "%8.1" /end CHARACTERISTIC
/begin CHARACTERISTIC VSACD_DebShortCircGndDef_C "Fehlerentprellzeit für Kurzschluß nach Masse" VALUE 0xEBB34 Kw_Wu16 655350.0 Time_ms 0.00 655350.0 FORMAT "%8.1" /end CHARACTERISTIC
/begin CHARACTERISTIC VSACD_DebShortCircGndOk_C "Heilungsentprellzeit für Kurzschluß nach Masse" VALUE 0xEBB36 Kw_Wu16 655350.0 Time_ms 0.00 655350.0 FORMAT "%8.1" /end CHARACTERISTIC
/begin CHARACTERISTIC VSACD_tiDebVSADia1Def_C "debounce duration for VSACD diagnosis error detection" VALUE 0xEBB38 Kw_Wu16 655350.0 Time_ms 0.00 655350.0 FORMAT "%8.1" /end CHARACTERISTIC
/begin CHARACTERISTIC VSACD_tiDebVSADia1Ok_C "debounce duration for VSACD diagnosis error healing" VALUE 0xEBB3A Kw_Wu16 655350.0 Time_ms 0.00 655350.0 FORMAT "%8.1" /end CHARACTERISTIC
/begin CHARACTERISTIC VSACD_tiDebVSADia2Def_C "debounce duration for VSACD diagnosis error detection" VALUE 0xEBB3C Kw_Wu16 655350.0 Time_ms 0.00 655350.0 FORMAT "%8.1" /end CHARACTERISTIC
/begin CHARACTERISTIC VSACD_tiDebVSADia2Ok_C "debounce duration for VSACD diagnosis error healing" VALUE 0xEBB3E Kw_Wu16 655350.0 Time_ms 0.00 655350.0 FORMAT "%8.1" /end CHARACTERISTIC
/begin CHARACTERISTIC VSACD_tiDebVSADia3Def_C "debounce duration for VSACD diagnosis error detection" VALUE 0xEBB40 Kw_Wu16 655350.0 Time_ms 0.00 655350.0 FORMAT "%8.1" /end CHARACTERISTIC
/begin CHARACTERISTIC VSACD_tiDebVSADia3Ok_C "debounce duration for VSACD diagnosis error healing" VALUE 0xEBB42 Kw_Wu16 655350.0 Time_ms 0.00 655350.0 FORMAT "%8.1" /end CHARACTERISTIC
/begin CHARACTERISTIC VSACD_tiDebVSADia4Def_C "Fehlerentprellzeit für Drallklappensteller Diagnose viertes Zeitfenster" VALUE 0xEBB44 Kw_Wu16 655350.0 Time_ms 0.00 655350.0 FORMAT "%8.1" /end CHARACTERISTIC
/begin CHARACTERISTIC VSACD_tiDebVSADia4Ok_C "Heilentprellzeit für Drallklappensteller Diagnose viertes Zeitfenster" VALUE 0xEBB46 Kw_Wu16 655350.0 Time_ms 0.00 655350.0 FORMAT "%8.1" /end CHARACTERISTIC
/begin CHARACTERISTIC VSACD_numDia_C "#SSD Applikationsparameter fuer das Diagnose-Signal von Einlasskanal-Steller" VALUE 0xEBB48 Kw_Wu8 34.0000000000 NumPinDia 0.00 34.0000000000 FORMAT "%13.10" /end CHARACTERISTIC
/begin CHARACTERISTIC VSACD_numPwmOut_C "#SSD Applikationsparameter fuer Einlasskanal-Steller" VALUE 0xEBB49 Kw_Wu8 12.0000000000 NumPinPwmOut 0.00 12.0000000000 FORMAT "%13.10" /end CHARACTERISTIC
/begin CHARACTERISTIC VSACD_stInvOut_C "Invertierungsparameter für das Signal der Drallniveaustellerendstufe" VALUE 0xEBB4A Kw_Wu8 1.000 OneToOne 0.00 1.000 FORMAT "%5.3" EXTENDED_LIMITS 0.00 255.0 /end CHARACTERISTIC
/begin CHARACTERISTIC VSACD_tiPer_C "Periodendauer des Ausgangssignal für den Drallniveausteller" VALUE 0xEBB4C Kw_Ws16 6553.500 Period -3276.800 3276.700 FORMAT "%8.3" /end CHARACTERISTIC
/begin CHARACTERISTIC VSACD_rCnv_CUR "Kennlinie zur Konvertierung von Öffnungsgrad in Tastverhältnis" CURVE 0xEBB4E Kl_Xs16_Ws16 100.0000 DtyCyc 0.00 100.0000 FORMAT "%8.4" EXTENDED_LIMITS -327.6800 327.6700
 /begin AXIS_DESCR STD_AXIS VSA_rVSA DtyCyc 8 -100.0000 200.0000 FORMAT "%8.4" EXTENDED_LIMITS -327.6800 327.6700 DEPOSIT ABSOLUTE /end AXIS_DESCR
/end CHARACTERISTIC
/begin CHARACTERISTIC VSACD_rOutMax_C "Maximal auszugebendes Tastverhältnis" VALUE 0xEBB70 Kw_Ws16 655.3500 DtyCyc -327.6800 327.6700 FORMAT "%8.4" /end CHARACTERISTIC
/begin CHARACTERISTIC VSACD_rOutMin_C "Minimal auszugebendes Tastverhältnis" VALUE 0xEBB72 Kw_Ws16 655.3500 DtyCyc -327.6800 327.6700 FORMAT "%8.4" /end CHARACTERISTIC
/begin CHARACTERISTIC VSACD_rTst_C "Tastverhältnis, dass im Fehlerfall zyklisch ausgegeben wird" VALUE 0xEBB74 Kw_Ws16 100.0000 DtyCyc 0.00 100.0000 FORMAT "%8.4" EXTENDED_LIMITS -327.6800 327.6700 /end CHARACTERISTIC
/begin CHARACTERISTIC VSACD_stPwrStgActv_C "Aktivierung der Abschaltbedingungen der Endstufe" VALUE 0xEBB76 Kw_Wu8 255.0 OneToOne 0.00 255.0 FORMAT "%5.1" /end CHARACTERISTIC
/begin CHARACTERISTIC VSACD_stPwrStgDia_C "Aktivierung der Abschaltbedingungen der Endstufendiagnose" VALUE 0xEBB77 Kw_Wu8 255.0 OneToOne 0.00 255.0 FORMAT "%5.1" /end CHARACTERISTIC
/begin CHARACTERISTIC VSACD_swt_C "Schalter Batteriespannungskorrektur (0 = AUS, 1 = EIN)" VALUE 0xEBB78 Kw_Wu8 255.0 OneToOne 0.00 255.0 FORMAT "%5.1" /end CHARACTERISTIC
/begin CHARACTERISTIC VSACD_tiBtwTst_C "Zeitabstand, in dem im Fehlerfall die Endstufe getestet wird" VALUE 0xEBB7A Kw_Wu16 29980.00 Time_ms 20.00000 30000.00 FORMAT "%8.2" EXTENDED_LIMITS 0.00 655350.0 /end CHARACTERISTIC
/begin CHARACTERISTIC VSACD_tiDiag1Max_C "window 1 max. time" VALUE 0xEBB7C Kw_Wu16 655350.0 Time_ms 0.00 655350.0 FORMAT "%8.1" /end CHARACTERISTIC
/begin CHARACTERISTIC VSACD_tiDiag1Min_C "window 1 min. time" VALUE 0xEBB7E Kw_Wu16 655350.0 Time_ms 0.00 655350.0 FORMAT "%8.1" /end CHARACTERISTIC
/begin CHARACTERISTIC VSACD_tiDiag2Max_C "window 2 min. time" VALUE 0xEBB80 Kw_Wu16 655350.0 Time_ms 0.00 655350.0 FORMAT "%8.1" /end CHARACTERISTIC
/begin CHARACTERISTIC VSACD_tiDiag2Min_C "window 2 min. time" VALUE 0xEBB82 Kw_Wu16 655350.0 Time_ms 0.00 655350.0 FORMAT "%8.1" /end CHARACTERISTIC
/begin CHARACTERISTIC VSACD_tiDiag3Max_C "window 3 max. time" VALUE 0xEBB84 Kw_Wu16 655350.0 Time_ms 0.00 655350.0 FORMAT "%8.1" /end CHARACTERISTIC
/begin CHARACTERISTIC VSACD_tiDiag3Min_C "window 3 Min. time" VALUE 0xEBB86 Kw_Wu16 655350.0 Time_ms 0.00 655350.0 FORMAT "%8.1" /end CHARACTERISTIC
/begin CHARACTERISTIC VSACD_tiDiag4Max_C "Maximum des vierten Signalfensters für Fehlersignale des Drallklappenstellers" VALUE 0xEBB88 Kw_Wu16 655350.0 Time_ms 0.00 655350.0 FORMAT "%8.1" /end CHARACTERISTIC
/begin CHARACTERISTIC VSACD_tiDiag4Min_C "Minimum des vierten Signalfensters für Fehlersignale des Drallklappenstellers" VALUE 0xEBB8A Kw_Wu16 655350.0 Time_ms 0.00 655350.0 FORMAT "%8.1" /end CHARACTERISTIC
/begin CHARACTERISTIC VSA_rVSA_Vector "#SSD Bypass-Label für VSA_rVSA" VALUE 0xC2E1E Kw_Wu8 255.0 OneToOne 0.00 255.0 FORMAT "%5.1" /end CHARACTERISTIC
/begin CHARACTERISTIC VSA_rVSA_Channel "#SSD Bypass-Label für VSA_rVSA" VALUE 0xC2E1F Kw_Wu8 255.0 OneToOne 0.00 255.0 FORMAT "%5.1" /end CHARACTERISTIC
/begin CHARACTERISTIC VSSCD_DebCanSigDef_C "#SSD Entprellzeit CAN Signal für Fahrgeschwindigkeit defekt" VALUE 0xEBB8C Kw_Wu16 655350.0 Time_ms 0.00 655350.0 FORMAT "%8.1" /end CHARACTERISTIC
/begin CHARACTERISTIC VSSCD_DebCanSigOk_C "Entprellzeit Heilung CAN-Signal für Fahrgeschwindigkeit" VALUE 0xEBB8E Kw_Wu16 655350.0 Time_ms 0.00 655350.0 FORMAT "%8.1" /end CHARACTERISTIC
/begin CHARACTERISTIC VSSCD_DebMaxDef_C "Entprellzeit für Defekterkennung bei Maximumtest der Fahrgeschwindigkeit" VALUE 0xEBB90 Kw_Wu16 655350.0 Time_ms 0.00 655350.0 FORMAT "%8.1" /end CHARACTERISTIC
/begin CHARACTERISTIC VSSCD_DebMaxOk_C "Entprellzeit für Heilung bei Maximumtest der Fahrgeschwindigkeit" VALUE 0xEBB92 Kw_Wu16 655350.0 Time_ms 0.00 655350.0 FORMAT "%8.1" /end CHARACTERISTIC
/begin CHARACTERISTIC VSSCD_DebNegPlaMonCond_C "Vorhaltlabel, nicht applizieren" VALUE 0xEBB94 Kw_Wu16 655350.0 Time_ms 0.00 655350.0 FORMAT "%8.1" READ_ONLY /end CHARACTERISTIC
/begin CHARACTERISTIC VSSCD_DebPlaMonCond_C "Entprellzeit Überwachungsbedingungen für Plausibilitätstest der Fahrgeschwindigkeit" VALUE 0xEBB96 Kw_Wu16 655350.0 Time_ms 0.00 655350.0 FORMAT "%8.1" /end CHARACTERISTIC
/begin CHARACTERISTIC VSSCD_DebPlaDef_C "Entprellzeit für Defekterkennung bei Plausibilitätstest der Fahrgeschwindigkeit" VALUE 0xEBB98 Kw_Wu16 655350.0 Time_ms 0.00 655350.0 FORMAT "%8.1" /end CHARACTERISTIC
/begin CHARACTERISTIC VSSCD_DebPlaOk_C "Entprellzeit für Heilung bei Plausibilitätstest der Fahrgeschwindigkeit" VALUE 0xEBB9A Kw_Wu16 655350.0 Time_ms 0.00 655350.0 FORMAT "%8.1" /end CHARACTERISTIC
/begin CHARACTERISTIC VSSCD_DebSigDef_C "Entprellzeit defekt für ungültiges Eingangssignal Fahrgeschwindigkeit" VALUE 0xEBB9C Kw_Wu16 655350.0 Time_ms 0.00 655350.0 FORMAT "%8.1" /end CHARACTERISTIC
/begin CHARACTERISTIC VSSCD_DebSigOk_C "Entprellzeit für Heilung ungültiges Eingangssignal der Fahrgeschwindigkeit" VALUE 0xEBB9E Kw_Wu16 655350.0 Time_ms 0.00 655350.0 FORMAT "%8.1" /end CHARACTERISTIC
/begin CHARACTERISTIC VSSCD_ImpPerDist_C "Streckenfaktor: FGG-Impulse pro Strecke" VALUE 0xEBBBC Kw_Wu32 17.500000000000000 VSS_DistFac 2.5000000000000000 20.000000000000000 FORMAT "%20.17" EXTENDED_LIMITS 0.83819031734908711 3600000000.0000000 /end CHARACTERISTIC
/begin CHARACTERISTIC VSSCD_nThresPla_C "Drehzahschwelle für NPL-Test der Fahrgeschwindigkeit" VALUE 0xEBBA0 Kw_Ws16 32767.00 EngN 0.00 32767.00 FORMAT "%8.2" EXTENDED_LIMITS -32768.00 32767.00 /end CHARACTERISTIC
/begin CHARACTERISTIC VSSCD_qThresPla_C "Einspritzschwelle für NPL-Test der Fahrgeschwindigkeit" VALUE 0xEBBA2 Kw_Ws16 327.6700 InjMass 0.00 327.6700 FORMAT "%8.4" EXTENDED_LIMITS -327.6800 327.6700 /end CHARACTERISTIC
/begin CHARACTERISTIC VSSCD_swtSigVal_C "#SSD Signalquelle Fahrgeschwindigkeit, Datensatzwert für SW-Schalter VSSCD_swtSig" VALUE 0xEBBA4 Kw_Wu8 1.000 OneToOne 0.00 1.000 FORMAT "%5.3" EXTENDED_LIMITS 0.00 255.0 /end CHARACTERISTIC
/begin CHARACTERISTIC VSSCD_swtSigType_C "#SSD Einlesen SW-Schalter VSSCD_swtSig aus E2PROM (1) oder VSSCD_swtSigVal_C (2) bei Ini." VALUE 0xEBBA5 Kw_Wu8 1.000 OneToOne 1.000 2.000 FORMAT "%5.3" EXTENDED_LIMITS 0.00 255.0 /end CHARACTERISTIC
/begin CHARACTERISTIC VSSCD_tiAPT1_C "Zeitkonstante Filterung Fahrbeschleunigung" VALUE 0xEBBA8 Kw_Wu32 4294.9673 TimeDelay_s 0.0000010000000 4294.9673 FORMAT "%9.4" /end CHARACTERISTIC
/begin CHARACTERISTIC VSSCD_tiPerMax_C "Maximale Periodendauer zwischen zwei FGG-Impulsen (VSSCD_vRaw = 0  wenn VSSCD_tiPerArvg > VSSCD_tiPerMax)" VALUE 0xEBBAC Kw_Ws32 9586980.60000 Time_PwmHigh 0.00 9586980.60000 FORMAT "%13.5" EXTENDED_LIMITS -214748364.800 214748364.700 /end CHARACTERISTIC
/begin CHARACTERISTIC VSSCD_tiVPT1_C "Zeitkonstante Filterung Fahrgeschwindigkeit" VALUE 0xEBBB0 Kw_Wu32 4294.9673 TimeDelay_s 0.0000010000000 4294.9673 FORMAT "%9.4" /end CHARACTERISTIC
/begin CHARACTERISTIC VSSCD_vDfl_C "Vorgabewert Fahrgeschwindigkeit" VALUE 0xEBBB4 Kw_Ws16 327.6700 Vel 0.00 327.6700 FORMAT "%8.4" EXTENDED_LIMITS -327.6800 327.6700 /end CHARACTERISTIC
/begin CHARACTERISTIC VSSCD_vMax_C "v-Schwelle für Max-Test der Fahrgeschwindigkeit" VALUE 0xEBBB6 Kw_Ws16 327.6700 Vel 0.00 327.6700 FORMAT "%8.4" EXTENDED_LIMITS -327.6800 327.6700 /end CHARACTERISTIC
/begin CHARACTERISTIC VSSCD_vMin_C "Minimum-Schwelle für v=0 Erkennung" VALUE 0xEBBB8 Kw_Ws16 20.00000 Vel 0.00 20.00000 FORMAT "%8.5" EXTENDED_LIMITS -327.6800 327.6700 /end CHARACTERISTIC
/begin CHARACTERISTIC VSSCD_vThresPla_C "v-Schwelle für NPL-Test der Fahrgeschwindigkeit" VALUE 0xEBBBA Kw_Ws16 327.6700 Vel 0.00 327.6700 FORMAT "%8.4" EXTENDED_LIMITS -327.6800 327.6700 /end CHARACTERISTIC
/begin CHARACTERISTIC ZFC_dBPFacNumFBCG3_CA "Bandpassverstärkungen für Schubbetrieb im 3. Gang" VAL_BLK 0xEBBF8 Kwb_Wr32 30.0000000 OneToOne -15.0000000 15.0000000 FORMAT "%10.7" EXTENDED_LIMITS -1.00000000E+37 1.00000000E+37 NUMBER 3 /end CHARACTERISTIC
/begin CHARACTERISTIC ZFC_dBPFacNumFBCG4_CA "Bandpassverstärkungen für Schubbetrieb im 4. Gang" VAL_BLK 0xEBC04 Kwb_Wr32 30.0000000 OneToOne -15.0000000 15.0000000 FORMAT "%10.7" EXTENDED_LIMITS -1.00000000E+37 1.00000000E+37 NUMBER 3 /end CHARACTERISTIC
/begin CHARACTERISTIC ZFC_dBPFacNumFBCG5_CA "Bandpassverstärkungen für Schubbetrieb im 5. Gang" VAL_BLK 0xEBC10 Kwb_Wr32 30.0000000 OneToOne -15.0000000 15.0000000 FORMAT "%10.7" EXTENDED_LIMITS -1.00000000E+37 1.00000000E+37 NUMBER 3 /end CHARACTERISTIC
/begin CHARACTERISTIC ZFC_dBPFacNumFBCG6_CA "Bandpassverstärkungen für Schubbetrieb im 6. Gang" VAL_BLK 0xEBC1C Kwb_Wr32 30.0000000 OneToOne -15.0000000 15.0000000 FORMAT "%10.7" EXTENDED_LIMITS -1.00000000E+37 1.00000000E+37 NUMBER 3 /end CHARACTERISTIC
/begin CHARACTERISTIC ZFC_dSegFBCCaS_CA "Segmentwahl im Schubbetrieb" VAL_BLK 0xEBC28 Kwb_Wu16 255.9961 Per_Ratio 0.00 255.9961 FORMAT "%8.4" NUMBER 3 /end CHARACTERISTIC
/begin CHARACTERISTIC ZFC_nAvrgMax_C "#SSD Maximale Drehzahl für die Nullmengenkalibrierung" VALUE 0xEBC2E Kw_Ws16 5960.000 EngN 40.00000 6000.000 FORMAT "%8.3" EXTENDED_LIMITS -32768.00 32767.00 /end CHARACTERISTIC
/begin CHARACTERISTIC ZFC_nAvrgMin_C "#SSD Minimale Drehzahl für die Nullmengenkalibrierung" VALUE 0xEBC30 Kw_Ws16 5960.000 EngN 40.00000 6000.000 FORMAT "%8.3" EXTENDED_LIMITS -32768.00 32767.00 /end CHARACTERISTIC
/begin CHARACTERISTIC ZFC_nChngPRailMax_C "#SSD Maximale Drehzahl für die eine Raildruckanforderung der Nullmengenkalibrierung erfolgt" VALUE 0xEBC32 Kw_Ws16 5960.000 EngN 40.00000 6000.000 FORMAT "%8.3" EXTENDED_LIMITS -32768.00 32767.00 /end CHARACTERISTIC
/begin CHARACTERISTIC ZFC_nFBCThresMax_C "#SSD Obere Drehzahlschwelle für Berechnung der FBC-Bandpässe im Schubbetrieb" VALUE 0xEBC34 Kw_Ws16 5960.000 EngN 40.00000 6000.000 FORMAT "%8.3" EXTENDED_LIMITS -32768.00 32767.00 /end CHARACTERISTIC
/begin CHARACTERISTIC ZFC_nHyst_C "Hysteresewert Drehzahl für die Nullmengenkalibrierung" VALUE 0xEBC36 Kw_Ws16 5960.000 EngN 40.00000 6000.000 FORMAT "%8.3" EXTENDED_LIMITS -32768.00 32767.00 /end CHARACTERISTIC
/begin CHARACTERISTIC ZFC_numRatETClb_C "#SSD Anzahl der Ansteuerdauer-Kalibrierungen hintereinander" VALUE 0xEBC38 Kw_Wu8 255.0 OneToOne 0.00 255.0 FORMAT "%5.1" /end CHARACTERISTIC
/begin CHARACTERISTIC ZFC_numRatNVClb_C "#SSD Anzahl der Ansteuerspannungs-Kalibrierungen hintereinander" VALUE 0xEBC39 Kw_Wu8 255.0 OneToOne 0.00 255.0 FORMAT "%5.1" /end CHARACTERISTIC
/begin CHARACTERISTIC ZFC_phiSet_CUR "Ansteuerbeginn für Einspritzung der Nullmengenkalibrierung" CURVE 0xEBC54 Kl_Xs16_Ws16 1440.000 AngleCrS -720.0000 720.0000 FORMAT "%8.4" EXTENDED_LIMITS -768.0000 767.9766
 /begin AXIS_DESCR STD_AXIS Eng_nAvrg EngN 16 40.00000 6000.000 FORMAT "%8.3" EXTENDED_LIMITS -32768.00 32767.00 DEPOSIT ABSOLUTE /end AXIS_DESCR
/end CHARACTERISTIC
/begin CHARACTERISTIC ZFC_stClthSel_C "Bitmaske zur Freigabe des Kupplungssignals für die Kalibrierung" VALUE 0xEBC3A Kw_Wu8 255.0 OneToOne 0.00 255.0 FORMAT "%5.1" /end CHARACTERISTIC
/begin CHARACTERISTIC ZFC_stGearRls_CA "Gangabhängige freigabe der ZFC Kalibrierung" VAL_BLK 0xEBC3B Kwb_Wu8 1.000 OneToOne 0.00 1.000 FORMAT "%5.3" EXTENDED_LIMITS 0.00 255.0 NUMBER 7 /end CHARACTERISTIC
/begin CHARACTERISTIC ZFC_swtClbActvVal_C "Applikationswert für SW-Schalter der ZFC Kalibrierung" VALUE 0xEBC42 Kw_Wu8 1.000 OneToOne 0.00 1.000 FORMAT "%5.3" EXTENDED_LIMITS 0.00 255.0 /end CHARACTERISTIC
/begin CHARACTERISTIC ZFC_swtClbActvType_C "Typ des Softwareschalters für die ZFC Kalibrierung" VALUE 0xEBC43 Kw_Wu8 2.000 OneToOne 0.00 2.000 FORMAT "%5.3" EXTENDED_LIMITS 0.00 255.0 /end CHARACTERISTIC
/begin CHARACTERISTIC ZFC_tAirThres_C "Minimale Ansauglufttemperatur für die Nullmengenkalibrierung" VALUE 0xEBC44 Kw_Ws16 250.0000 Temp_Cels -50.14000 199.8600 FORMAT "%8.4" EXTENDED_LIMITS -3549.940 3003.560 /end CHARACTERISTIC
/begin CHARACTERISTIC ZFC_tEngThres_C "Minimale Motortemperatur für die Nullmengenkalibrierung" VALUE 0xEBC46 Kw_Ws16 250.0000 Temp_Cels -50.14000 199.8600 FORMAT "%8.4" EXTENDED_LIMITS -3549.940 3003.560 /end CHARACTERISTIC
/begin CHARACTERISTIC ZFC_tFuelThresMax_C "Maximale Kraftstofftemperatur für die Nullmengenkalibrierung" VALUE 0xEBC48 Kw_Ws16 250.0000 Temp_Cels -50.14000 199.8600 FORMAT "%8.4" EXTENDED_LIMITS -3549.940 3003.560 /end CHARACTERISTIC
/begin CHARACTERISTIC ZFC_tFuelThresMin_C "Minimale Kraftstofftemperatur für die Nullmengenkalibrierung" VALUE 0xEBC4A Kw_Ws16 250.0000 Temp_Cels -50.14000 199.8600 FORMAT "%8.4" EXTENDED_LIMITS -3549.940 3003.560 /end CHARACTERISTIC
/begin CHARACTERISTIC ZFC_tiCldCham_CUR "Zeit bis der Brennraum für die Nullmengenkalibrierung zu stark abgekühlt ist" CURVE 0xEBBC2 Kl_Xs16_Ws16 655140.0 Time_ms 0.00 655140.0 FORMAT "%8.1" EXTENDED_LIMITS -327680.0 327670.0
 /begin AXIS_DESCR STD_AXIS IATSCD_tAir Temp_Cels 12 -50.14000 199.8600 FORMAT "%8.4" EXTENDED_LIMITS -3549.940 3003.560 DEPOSIT ABSOLUTE /end AXIS_DESCR
/end CHARACTERISTIC
/begin CHARACTERISTIC ZFC_tiDelOvrRun_C "Verzögerung nach dem Einsetzen der Schubphase für die Nullmengenkalibrierung" VALUE 0xEBC4C Kw_Ws16 655140.0 Time_ms 0.00 655140.0 FORMAT "%8.1" EXTENDED_LIMITS -327680.0 327670.0 /end CHARACTERISTIC
/begin CHARACTERISTIC ZFC_tiDelpRailLim_C "Verzögerung zum Einschwingen des Raildrucks für die Nullmengenkalibrierung" VALUE 0xEBC4E Kw_Ws16 655140.0 Time_ms 0.00 655140.0 FORMAT "%8.1" EXTENDED_LIMITS -327680.0 327670.0 /end CHARACTERISTIC
/begin CHARACTERISTIC ZFC_tiHotCham_C "Zeit bis der Brennraum warm genug für die Nullmengenkalibrierung ist" VALUE 0xEBBF4 Kw_Ws16 655140.0 Time_ms 0.00 655140.0 FORMAT "%8.1" EXTENDED_LIMITS -327680.0 327670.0 /end CHARACTERISTIC
/begin CHARACTERISTIC ZFC_uBattMin_C "Minimale Batteriespannung für die Nullmengenkalibrierung" VALUE 0xEBC50 Kw_Ws16 640606.1 Volt_Batt 0.00 640606.1 FORMAT "%8.1" EXTENDED_LIMITS -640625.6 640606.1 /end CHARACTERISTIC
/begin MEASUREMENT StSys_nAvrgFlt_mp "engine speed after PT1 filter" SWORD EngN 1 100 -32768.00 32767.00 FORMAT "%8.2" ECU_ADDRESS 0x8FFCFC /end MEASUREMENT
/begin MEASUREMENT StSys_nThresStrtCutOut_mp "Startabwurfdrehzahl" SWORD EngN 1 100 -32768.00 32767.00 FORMAT "%8.2" ECU_ADDRESS 0x8FFCEA /end MEASUREMENT
/begin MEASUREMENT StSys_stNewStrt "Statusanzeige bei Neustart während eines aktiven Fahrzyklus" UBYTE OneToOne 1 100 0.00 255.0 FORMAT "%5.1" ECU_ADDRESS 0x7F8982 /end MEASUREMENT
/begin MEASUREMENT StSys_stStrt "Startzustand" UBYTE OneToOne 1 100 0.00 255.0 FORMAT "%5.1" ECU_ADDRESS 0x7F8984 /end MEASUREMENT
/begin MEASUREMENT StSys_stStrtCutOutMon "Zustand des Startabwurfs" UBYTE OneToOne 1 100 0.00 255.0 FORMAT "%5.1" ECU_ADDRESS 0x7F8985 /end MEASUREMENT
/begin MEASUREMENT StSys_stStrtTip "Zustände der Tip-Start Funktion" UWORD OneToOne 1 100 0.00 65535.00 FORMAT "%8.2" ECU_ADDRESS 0x7F904E /end MEASUREMENT
/begin MEASUREMENT StSys_stStrtTipOFF "Zustände der Tip-Start Abschaltung" UBYTE OneToOne 1 100 0.00 255.0 FORMAT "%5.1" ECU_ADDRESS 0x7F8986 /end MEASUREMENT
/begin MEASUREMENT StSys_stStrtTipON "Zustände der Tip-Start Einschaltung" UBYTE OneToOne 1 100 0.00 255.0 FORMAT "%5.1" ECU_ADDRESS 0x7F8987 /end MEASUREMENT
/begin MEASUREMENT StSys_stTrqShutOff "globales Interface fuer die Startmomentabschaltung" UBYTE OneToOne 1 100 0.00 255.0 FORMAT "%5.1" ECU_ADDRESS 0x7F8988 /end MEASUREMENT
/begin MEASUREMENT StSys_stTrqShutOffCond_mp "bitcodierter Zustand der Abschaltbedingungen der Startmomentenabschaltung" UWORD OneToOne 1 100 0.00 65535.00 FORMAT "%8.2" ECU_ADDRESS 0x8FFCFE /end MEASUREMENT
/begin MEASUREMENT StSys_stTrqShutOffErr_mp "status Fehlerursachen Start o. Kl.50" UWORD OneToOne 1 100 0.00 65535.00 FORMAT "%8.2" ECU_ADDRESS 0x8FFCFA /end MEASUREMENT
/begin MEASUREMENT StSys_tStrt_mp "Aus dem Motortemperaturfeld Eng_tFld ausgewählte Temperatur für den Startabwurf" SWORD Temp_Cels 1 100 -50.140 899.860 FORMAT "%8.3" ECU_ADDRESS 0x8FFCEC /end MEASUREMENT
/begin MEASUREMENT SWTmr_tiTmr16 "16-Bit Referenzzeit für Timer" UWORD Time_ms 1 100 0.00 655350.0 FORMAT "%8.1" ECU_ADDRESS 0x7F8772 /end MEASUREMENT
/begin MEASUREMENT SWTmr_tiTmr32 "32-Bit Referenzzeit für Timer" ULONG Time_ms 1 100 0.00 42949672950.0 FORMAT "%13.1" ECU_ADDRESS 0x7F8774 /end MEASUREMENT
/begin MEASUREMENT T15CD_stCondDebVal_mp "Bedingungen (Bitleiste) für Auswertung T15CD_ stDebVal" UBYTE OneToOne 1 100 0.00 255.0 FORMAT "%5.1" ECU_ADDRESS 0x8FFD00 /end MEASUREMENT
/begin MEASUREMENT T15CD_stDebVal "entprellter Wert der Klemme 15" UBYTE OneToOne 1 100 0.00 255.0 FORMAT "%5.1" ECU_ADDRESS 0x7F8989 /end MEASUREMENT
/begin MEASUREMENT T15CD_stDebWakeUpVal "entprellter Wake Up Signaleingang" UBYTE OneToOne 1 100 0.00 255.0 FORMAT "%5.1" ECU_ADDRESS 0x7F898A /end MEASUREMENT
/begin MEASUREMENT T15CD_stLogicT15_mp "Staatsmaschine für T15 in der neu ""Anpassung wakeup Konzept""" UBYTE OneToOne 1 100 0.00 255.0 FORMAT "%5.1" ECU_ADDRESS 0x8FFD01 /end MEASUREMENT
/begin MEASUREMENT T15CD_stWakeUp "Wake Up Zustand" UBYTE OneToOne 1 100 0.00 255.0 FORMAT "%5.1" ECU_ADDRESS 0x7F898B /end MEASUREMENT
/begin MEASUREMENT T15CD_stWakeUpRawVal_mp "Rohwert des Wake Up Signals aus der HWE" UBYTE OneToOne 1 100 0.00 255.0 FORMAT "%5.1" ECU_ADDRESS 0x6F8190 /end MEASUREMENT
/begin MEASUREMENT T50CD_stDebVal "entprellter Statuswert der Klemme 50" UBYTE OneToOne 1 100 0.00 255.0 FORMAT "%5.1" ECU_ADDRESS 0x7F898C /end MEASUREMENT
/begin MEASUREMENT T50CD_stRawVal "unentprellter Wert des Eingangssignals für Klemme 50" UBYTE OneToOne 1 100 0.00 255.0 FORMAT "%5.1" ECU_ADDRESS 0x7F898D /end MEASUREMENT
/begin MEASUREMENT T50CD_swtSig "T50 von Hardware oder CAN" UBYTE OneToOne 1 100 0.00 255.0 FORMAT "%5.1" ECU_ADDRESS 0x7F898E /end MEASUREMENT
/begin MEASUREMENT ThrVlv_rTVA "Stellgröße für Regelklappe (Stellerkoordinatorausgang)" SWORD Prc 1 100 -400.0000 399.9878 FORMAT "%8.4" ECU_ADDRESS 0x7F905A /end MEASUREMENT
/begin MEASUREMENT ThrVlv_rTVAByp_mp "Bypass-Label, Kopie von ThrVlv_rTVA" SWORD Prc 1 100 -400.0000 399.9878 FORMAT "%8.4" ECU_ADDRESS 0x8FFD02 /end MEASUREMENT
/begin MEASUREMENT TPUMon_ctUpDwnDeb_mp "Meßpunkt für den Entprellungszähler der TPUMon Zeitabweichung" UWORD OneToOne 1 100 0.00 65535.00 FORMAT "%8.2" ECU_ADDRESS 0x8FFD04 /end MEASUREMENT
/begin MEASUREMENT TPUMon_tiDiffMax_mp "Meßpunkt der maximalen Differenzen aus Timervergleich in den letzten 100 ms" SLONG TimeUSResolution 1 100 -2147483648.00 2147483647.00 FORMAT "%13.2" ECU_ADDRESS 0x8FFD08 /end MEASUREMENT
/begin MEASUREMENT TPUMon_tiDiffMin_mp "Meßpunkt der minimalen (negativer Wert) Differenzen aus Timervergleich in den letzten 100 ms" SLONG TimeUSResolution 1 100 -2147483648.00 2147483647.00 FORMAT "%13.2" ECU_ADDRESS 0x8FFD0C /end MEASUREMENT
/begin MEASUREMENT TPUMon_tiDiffSum_mp "Meßpunkt der Summe aller Differenzen aus Timervergleich in den letzten 100 ms" SLONG TimeUSResolution 1 100 -2147483648.00 2147483647.00 FORMAT "%13.2" ECU_ADDRESS 0x8FFD10 /end MEASUREMENT
/begin MEASUREMENT TVACD_rCnv_mp "Tastverhältnis basierend aus dem Ausgang des Abgasrückführreglers" SWORD DtyCyc 1 100 -327.6800 327.6700 FORMAT "%8.4" ECU_ADDRESS 0x8FFD14 /end MEASUREMENT
/begin MEASUREMENT TVACD_rOut "Tastverhältnis zür Endstufenansteuerung" SWORD DtyCyc 1 100 -327.6800 327.6700 FORMAT "%8.4" ECU_ADDRESS 0x7F9058 /end MEASUREMENT
/begin MEASUREMENT USAp_dDataVariant_u8 "Nummer der aktiven Datensatzvariante" UBYTE OneToOne 1 100 0.00 255.0 FORMAT "%5.1" ECU_ADDRESS 0x7FD5C6 /end MEASUREMENT
/begin MEASUREMENT USAp_stDataVariant_u8 "Statusflags der aktiven Datensatzvariante" UBYTE OneToOne 1 100 0.00 255.0 FORMAT "%5.1" ECU_ADDRESS 0x7FD5C7 /end MEASUREMENT
/begin MEASUREMENT UsrDa_stFDC "Status von FDC" UBYTE OneToOne 1 100 0.00 255.0 FORMAT "%5.1" ECU_ADDRESS 0x7F898F /end MEASUREMENT
/begin MEASUREMENT UsrDa_stRecFDC "FDC im Fahrzeug vorhanden / nicht vorhanden" UBYTE OneToOne 1 100 0.00 255.0 FORMAT "%5.1" ECU_ADDRESS 0x7F8990 /end MEASUREMENT
/begin MEASUREMENT VehDa_lInt_mp "Hilfszähler für Kilometerzähler VehDa_lSum über Integration Fahrgeschwindigkeit VSSCD_vRaw" SLONG Dist_20ms 1 100 -119304.647111 119304.647056 FORMAT "%13.6" ECU_ADDRESS 0x8FFD18 /end MEASUREMENT
/begin MEASUREMENT VehDa_lSum "Erfassung gefahrene Strecke" ULONG Length 1 100 0.00 4294967295.00 FORMAT "%13.2" ECU_ADDRESS 0x7F91E0 /end MEASUREMENT
/begin MEASUREMENT VehDa_nEngFilt_mp "vorgefilterte Motordrehzahl für v/n Verhältnis" SWORD EngN 1 100 -32768.00 32767.00 FORMAT "%8.2" ECU_ADDRESS 0x8FFD1C /end MEASUREMENT
/begin MEASUREMENT VehDa_rVn "Verhältnis von Fahrgeschwindigkeit zur Motordrehzahl" SWORD VelToN 1 100 0.00 0.1000000 FORMAT "%9.7" ECU_ADDRESS 0x7F906E /end MEASUREMENT
/begin MEASUREMENT VehDa_stTrqDem "Status der aktuellen Momentenanforderungen" UWORD OneToOne 1 100 0.00 65535.00 FORMAT "%8.2" ECU_ADDRESS 0x7F9070 /end MEASUREMENT
/begin MEASUREMENT VehDa_tiEngOn "Erfassung der aktuellen Betriebszeit" ULONG TimeEngOn 1 100 0.00 4294967295.00 FORMAT "%13.2" ECU_ADDRESS 0x7F91E4 /end MEASUREMENT
/begin MEASUREMENT VehMot_nMax "Grenzdrehzahl für Fahrzeugbewegung" SWORD EngN 1 100 -32768.00 32767.00 FORMAT "%8.2" ECU_ADDRESS 0x7F9072 /end MEASUREMENT
/begin MEASUREMENT VehMot_nMin "Leerlaufdrehzahl für Fahrzeugbewegung" SWORD EngN 1 100 -32768.00 32767.00 FORMAT "%8.2" ECU_ADDRESS 0x7F9074 /end MEASUREMENT
/begin MEASUREMENT VehMot_pwrAcsDes "Gesamtbedarf Leistung der Nebenaggregate in der Fahrzeugbewegung" SWORD Pwr 1 100 -308831.1 308821.7 FORMAT "%8.1" ECU_ADDRESS 0x7F9076 /end MEASUREMENT
/begin MEASUREMENT VehMot_pwrAcsLead "Leistungsvorhalt der Nebenaggregate in der Fahrzeugbewegung" SWORD Pwr 1 100 -308831.1 308821.7 FORMAT "%8.1" ECU_ADDRESS 0x7F9078 /end MEASUREMENT
/begin MEASUREMENT VESGov_trq "Momentenanforderung Arbeitsdrehzahlregler" SWORD Trq 1 100 -3276.800 3276.700 FORMAT "%8.3" ECU_ADDRESS 0x7F905C /end MEASUREMENT
/begin MEASUREMENT VSACD_rCnv_mp "Tastverhältnis basierend aus dem Ausgang der Drallniveausteuerung" SWORD DtyCyc 1 100 -327.6800 327.6700 FORMAT "%8.4" ECU_ADDRESS 0x8FFD20 /end MEASUREMENT
/begin MEASUREMENT VSACD_rOut "Tastverhältnis zür Endstufenansteuerung" SWORD DtyCyc 1 100 -327.6800 327.6700 FORMAT "%8.4" ECU_ADDRESS 0x7F905E /end MEASUREMENT
/begin MEASUREMENT VSA_rVSA "Stellgröße für Einlaßkanalabschaltung (Stellerkoordinatorausgang)" SWORD DtyCyc 1 100 -327.6800 327.6700 FORMAT "%8.4" ECU_ADDRESS 0x7F9060 /end MEASUREMENT
/begin MEASUREMENT VSA_rVSAByp_mp "Bypass-Label, copie of VSA_rVSA" SWORD Prc 1 100 -400.0000 399.9878 FORMAT "%8.4" ECU_ADDRESS 0x8FFD1E /end MEASUREMENT
/begin MEASUREMENT VSSCD_a "Fahrbeschleunigung" SWORD Acc 1 100 -32.76800 32.76700 FORMAT "%8.5" ECU_ADDRESS 0x7F9062 /end MEASUREMENT
/begin MEASUREMENT VSSCD_aRaw "Rohwert Fahrbeschleunigung" SWORD Acc 1 100 -32.76800 32.76700 FORMAT "%8.5" ECU_ADDRESS 0x7F9064 /end MEASUREMENT
/begin MEASUREMENT VSSCD_ctImp "Impulszähler Fahrgeschwindigkeit Impulssignal" UWORD OneToOne 1 100 0.00 65535.00 FORMAT "%8.2" ECU_ADDRESS 0x7F9066 /end MEASUREMENT
/begin MEASUREMENT VSSCD_rImp_mp "Tastverhältnis Eingangssignal Fahrgeschwindigkeit (FGG)" SWORD DtyCyc 1 100 -327.6800 327.6700 FORMAT "%8.4" ECU_ADDRESS 0x8FFD22 /end MEASUREMENT
/begin MEASUREMENT VSSCD_stInHW_mp "Statusflags Eingangssignal Fahrgeschwindigkeit (FGG)" UBYTE OneToOne 1 100 0.00 255.0 FORMAT "%5.1" ECU_ADDRESS 0x8FFD24 /end MEASUREMENT
/begin MEASUREMENT VSSCD_swtSig "Signaleingangsschalter Fahrgeschwindigkeit" UBYTE OneToOne 1 100 0.00 255.0 FORMAT "%5.1" ECU_ADDRESS 0x7F8991 /end MEASUREMENT
/begin MEASUREMENT VSSCD_tiPerAvrg "Mittlere Periodendauer zwischen zwei FGG-Impulsen" SLONG Time_PwmHigh 1 100 -214748364.800 214748364.700 FORMAT "%13.3" ECU_ADDRESS 0x7F91DC /end MEASUREMENT
/begin MEASUREMENT VSSCD_v "Fahrzeuggeschwindigkeit" SWORD Vel 1 100 -327.6800 327.6700 FORMAT "%8.4" ECU_ADDRESS 0x7F9068 /end MEASUREMENT
/begin MEASUREMENT VSSCD_vRaw "Rohwert Fahrgeschwindigkeit" SWORD Vel 1 100 -327.6800 327.6700 FORMAT "%8.4" ECU_ADDRESS 0x7F906A /end MEASUREMENT
/begin MEASUREMENT VSSCD_vSensVal "Vehicle speed sensed value" SWORD Vel 1 100 -327.6800 327.6700 FORMAT "%8.4" ECU_ADDRESS 0x7F906C /end MEASUREMENT
/begin MEASUREMENT WDCom_dChisteResponse_u32 "Antwortbeitrag des Befehlstests" UWORD OneToOne 1 100 0.00 65535.00 FORMAT "%8.2" ECU_ADDRESS 0x7FCCE4 /end MEASUREMENT
/begin MEASUREMENT WDCom_dErrorCountForCntler_u8 "Kopie des überwachungsmodul-internen Fehlerzählers für den Funktionsrechner" UBYTE OneToOne 1 100 0.00 255.0 FORMAT "%5.1" ECU_ADDRESS 0x7FCD26 /end MEASUREMENT
/begin MEASUREMENT WDCom_dErrorCountForWD_u8 "Fehlerzähler für das Überwachungsmodul" UBYTE OneToOne 1 100 0.00 255.0 FORMAT "%5.1" ECU_ADDRESS 0x7F9B9B /end MEASUREMENT
/begin MEASUREMENT WDCom_dRequest_u32 "Aktuelle Frage des Überwachungsmoduls" UWORD OneToOne 1 100 0.00 65535.00 FORMAT "%8.2" ECU_ADDRESS 0x7FCCEC /end MEASUREMENT
/begin MEASUREMENT WDCom_ErrorCntForSPI_u8 "Fehlerzähler für den SPI Handler" UBYTE OneToOne 1 100 0.00 255.0 FORMAT "%5.1" ECU_ADDRESS 0x8FFD25 /end MEASUREMENT
/begin MEASUREMENT WDCom_ErrorCntForUC_u8 "Kopie des Fehlerzählers des externen Watch Dog" UBYTE OneToOne 1 100 0.00 255.0 FORMAT "%5.1" ECU_ADDRESS 0x8FFD26 /end MEASUREMENT
/begin MEASUREMENT WDCom_ErrorCntForWD_u8 "Fehlerzähler für den externen Watch dog" UBYTE OneToOne 1 100 0.00 255.0 FORMAT "%5.1" ECU_ADDRESS 0x8FFD27 /end MEASUREMENT
/begin MEASUREMENT ZFC_dpRailLim_mp "Aktuelle max Raildruckabweichung für die Nullmengenkalibrierung" SWORD Pres_Rail 1 100 -3276.800 3276.700 FORMAT "%5.3" ECU_ADDRESS 0x8FFD2A /end MEASUREMENT
/begin MEASUREMENT ZFC_dpRail_mp "Raildruckabweichung zum Raildruck Kalibrierungspunkt" SWORD Pres_Rail 1 100 -3276.800 3276.700 FORMAT "%5.3" ECU_ADDRESS 0x6F8192 /end MEASUREMENT
/begin MEASUREMENT ZFC_numCylInj_mp "Aktuelle Zylindernummer für die Einspritzung der Nullmengenkalibrierung" UBYTE OneToOne 1 100 0.00 255.0 FORMAT "%5.1" ECU_ADDRESS 0x6F8196 /end MEASUREMENT
/begin MEASUREMENT ZFC_phiInj_mp "Ansteuerbeginng der Einspritzung für die Nullmengenkalibrierung" SWORD AngleCrS 1 100 -768.0000 767.9766 FORMAT "%8.4" ECU_ADDRESS 0x8FFD4E /end MEASUREMENT
/begin MEASUREMENT ZFC_pRailSetPoint_mp "Angeforderter Raildrucksollwert der Nullmengenkalibrierung" SWORD Pres_Rail 1 100 -3276.800 3276.700 FORMAT "%5.3" ECU_ADDRESS 0x8FFD2C /end MEASUREMENT
/begin MEASUREMENT ZFC_SigThres_mp "Aktuelle Signalschwelle für die Nullmengenkalibrierung" SWORD OneToOne 1 100 -32768.00 32767.00 FORMAT "%8.2" ECU_ADDRESS 0x8FFD4C /end MEASUREMENT
/begin MEASUREMENT ZFC_Sig_mp "Messwert der Kalibrierung" SLONG OneToOne 1 100 -2147483648.00 2147483647.00 FORMAT "%13.2" ARRAY_SIZE 6 ECU_ADDRESS 0x8FFD34 /end MEASUREMENT
/begin MEASUREMENT ZFC_stCldCham "Zustand des Brennraums für die Nullmengenkalibrierung" UBYTE OneToOne 1 100 0.00 255.0 FORMAT "%5.1" ECU_ADDRESS 0x7F8992 /end MEASUREMENT
/begin MEASUREMENT ZFC_stCmbCham_mp "Zustand der Erkennung kalter Brennraum für die Nullmengenkalibrierung" UBYTE OneToOne 1 100 0.00 255.0 FORMAT "%5.1" ECU_ADDRESS 0x8FFD28 /end MEASUREMENT
/begin MEASUREMENT ZFC_stDem_mp "Anforderungen der Nullmengenkalibrierung" UBYTE OneToOne 1 100 0.00 255.0 FORMAT "%5.1" ECU_ADDRESS 0x8FFD2E /end MEASUREMENT
/begin MEASUREMENT ZFC_stEvalSig_mp "Status der Auswertung des Signals der Nullmengenkalibrierung" UBYTE ZFC_EvalEngSpd_Rslt 1 100 0.00 2.00000000000 FORMAT "%13.11" ECU_ADDRESS 0x6F8195 /end MEASUREMENT
/begin MEASUREMENT ZFC_stInj_mp "Status der Einspritzprogrammierung der Nullmengenkalibrierung" UBYTE ZFC_Inj_State 1 100 0.00 64.0000000000 FORMAT "%13.10" ECU_ADDRESS 0x6F8197 /end MEASUREMENT
/begin MEASUREMENT ZFC_st_mp "Status der Nullmengenkalibrierung" UBYTE ZFC_State 1 100 1.00000000000 16.0000000000 FORMAT "%13.10" ECU_ADDRESS 0x6F8194 /end MEASUREMENT
/begin MEASUREMENT ZFC_swtClbActv "SW-Schalter für die Aktivierung der ZFC Kalibrierung" UBYTE OneToOne 1 100 0.00 255.0 FORMAT "%5.1" ECU_ADDRESS 0x7F8993 /end MEASUREMENT
/begin MEASUREMENT ZFC_tiET_mp "Ansteuerdauer für die Einspritzung der Nullmengenkalibrierung" SWORD InjTime_us 1 100 -32768.00 32767.00 FORMAT "%8.2" ECU_ADDRESS 0x6F8198 /end MEASUREMENT
/begin MEASUREMENT ZFC_vStopClb_mp "Minimale Fahrzeuggeschwindigkeit der aktuellen Ansteuerdauerkalibrierung" SWORD Vel 1 100 -327.6800 327.6700 FORMAT "%8.4" ECU_ADDRESS 0x8FFD30 /end MEASUREMENT
/begin MEASUREMENT Fak_ttansel "Ansaugluftfaktor E-Lüfterstrom" UWORD Def_f_uw_b512 0 0 0.0 511.9921 ECU_ADDRESS 0x7FD75E /begin FUNCTION_LIST BGCRENG /end FUNCTION_LIST /end MEASUREMENT
/begin MEASUREMENT Fak_tubel "Faktor Lüfterstrom aus Geschwindigkeit" UWORD Def_f_uw_b512 0 0 0.0 511.9921 ECU_ADDRESS 0x7FD760 /begin FUNCTION_LIST BGCRENG /end FUNCTION_LIST /end MEASUREMENT
/begin MEASUREMENT Fdib_ig "" SWORD Def_i_sw_q1 0 0 -32768.0000 32767.0000 ECU_ADDRESS 0x7FB534 /begin FUNCTION_LIST IMDGEN_1PR /end FUNCTION_LIST /end MEASUREMENT
/begin MEASUREMENT Gen_awnumm "Generatorkennfeldnummer" UBYTE Def_st_ub_q1 0 0 0.0 255.0000 ECU_ADDRESS 0x7FD792 /begin FUNCTION_LIST IMDGEN_1PR /end FUNCTION_LIST /end MEASUREMENT
/begin MEASUREMENT Gen_dfvorhs "DF-Signal Vorhersage" UBYTE Def_f_ub_b100 0 0 0.0 99.6093 ECU_ADDRESS 0x7FFB54 /begin FUNCTION_LIST BGLLGEN_1PR /end FUNCTION_LIST /end MEASUREMENT
/begin MEASUREMENT Gen_dts "Temperaturerhoehung im Generatorstator" SWORD Def_t_sw_q0p1 0 0 -3276.8000 3276.7000 ECU_ADDRESS 0x7FB536 /begin FUNCTION_LIST IMDGEN_1PR /end FUNCTION_LIST /end MEASUREMENT
/begin MEASUREMENT Gen_fbsak "BSD Uebertragungsfehler kodiert fuer FSPVDGEN" UBYTE Def_st_ub_q1 0 0 0.0 255.0000 ECU_ADDRESS 0x7FD777 /begin FUNCTION_LIST DGEN /end FUNCTION_LIST /end MEASUREMENT
/begin MEASUREMENT Gen_feta "Generatorwirkungsgrad Berechnnugsterm" ULONG Def_eta_ul_b8192 0 0 1.9073486328125e-6 5000.0000 ECU_ADDRESS 0x7FB52C /begin FUNCTION_LIST IMDGEN_1PR /end FUNCTION_LIST /end MEASUREMENT
/begin MEASUREMENT Gen_i_kaltun "DF korrektiert ueber Generatordrehzahl" UBYTE Def_i_ub_q1 0 0 0.0 255.0000 ECU_ADDRESS 0x7FB55E /begin FUNCTION_LIST IMDGEN_1PR /end FUNCTION_LIST /end MEASUREMENT
/begin MEASUREMENT Gen_nummer "Erkannte Generatornummer" UBYTE Def_st_ub_q1 0 0 0.0 255.0000 ECU_ADDRESS 0x7FB55F /begin FUNCTION_LIST IMDGEN_1PR /end FUNCTION_LIST /end MEASUREMENT
/begin MEASUREMENT Gen_rs "Statorwiderstand" UWORD Def_f_uw_b1 0 0 0.0 9.99984741210938e-1 ECU_ADDRESS 0x7FB54C /begin FUNCTION_LIST IMDGEN_1PR /end FUNCTION_LIST /end MEASUREMENT
/begin MEASUREMENT Gen_spv "Generatorstatorverlustleistung" UWORD Def_f_uw_b2048 0 0 0.0 2047.9687 ECU_ADDRESS 0x7FB54E /begin FUNCTION_LIST IMDGEN_1PR /end FUNCTION_LIST /end MEASUREMENT
/begin MEASUREMENT Gen_statroh "Generatorfehler kodiert fuer FSPVDGEN" UBYTE Def_st_ub_q1 0 0 0.0 255.0000 ECU_ADDRESS 0x7FD778 /begin FUNCTION_LIST DGEN /end FUNCTION_LIST /end MEASUREMENT
/begin MEASUREMENT Gen_sttemp "Generatorstarttemperatur" SWORD Def_t_sw_q0p1 0 0 -3276.8000 3276.7000 ECU_ADDRESS 0x7FB538 /begin FUNCTION_LIST IMDGEN_1PR /end FUNCTION_LIST /end MEASUREMENT
/begin MEASUREMENT Gen_tans "Generatoransauglufttemperatur" SWORD Def_t_sw_q0p1 0 0 -3276.8000 3276.7000 ECU_ADDRESS 0x7FB53A /begin FUNCTION_LIST IMDGEN_1PR /end FUNCTION_LIST /end MEASUREMENT
/begin MEASUREMENT Gen_tansend "Generatoransaugluftendwert" SWORD Def_t_sw_q0p1 0 0 -3276.8000 3276.7000 ECU_ADDRESS 0x7FB53C /begin FUNCTION_LIST IMDGEN_1PR /end FUNCTION_LIST /end MEASUREMENT
/begin MEASUREMENT Gen_teta "Wirkungsgrad Generator W*PI temperaturkompensiert" UWORD Def_f_uw_b32 0 0 0.0 31.9995 ECU_ADDRESS 0x7FB550 /begin FUNCTION_LIST IMDGEN_1PR /end FUNCTION_LIST /end MEASUREMENT
/begin MEASUREMENT Gen_weta "Wirkungsgrad Generator mit Omega*PI" UWORD Def_f_uw_b32 0 0 0.0 31.9995 ECU_ADDRESS 0x7FB552 /begin FUNCTION_LIST IMDGEN_1PR /end FUNCTION_LIST /end MEASUREMENT
/begin MEASUREMENT I_basis "Basis Strombedarf FZG mit SLP" UBYTE Def_i_ub_q1 0 0 0.0 255.0000 ECU_ADDRESS 0x7FB560 /begin FUNCTION_LIST IMDGEN_1PR /end FUNCTION_LIST /end MEASUREMENT
/begin MEASUREMENT I_craweng "Strombedarf Motor" SWORD Def_i_sw_q1 0 0 -10.0000 254.0000 ECU_ADDRESS 0x7FD75C /begin FUNCTION_LIST BGCRENG /end FUNCTION_LIST /end MEASUREMENT
/begin MEASUREMENT I_elu_vvt "Strom E-Lüfter und VVT-System" UWORD Def_i_uw_q0p0635 0 0 0.0 4095.9375 ECU_ADDRESS 0x7FD762 /begin FUNCTION_LIST BGCRENG /end FUNCTION_LIST /end MEASUREMENT
/begin MEASUREMENT I_eluefter "E-Lüfter Stromaufnahme" UWORD Def_i_uw_q0p0635 0 0 0.0 4095.9375 ECU_ADDRESS 0x7FD764 /begin FUNCTION_LIST BGCRENG /end FUNCTION_LIST /end MEASUREMENT
/begin MEASUREMENT I_elupwm "Lüfterstrom ohne Temperatur- und Geschwindigkeitseinfluss" UWORD Def_i_uw_q0p0635 0 0 0.0 64.0000 ECU_ADDRESS 0x7FD766 /begin FUNCTION_LIST BGCRENG /end FUNCTION_LIST /end MEASUREMENT
/begin MEASUREMENT I_eluvfzg "Lüfterstrom ohne Geschwindigkeitseinfluss" UWORD Def_i_uw_q0p0635 0 0 0.0 128.0000 ECU_ADDRESS 0x7FD768 /begin FUNCTION_LIST BGCRENG /end FUNCTION_LIST /end MEASUREMENT
/begin MEASUREMENT I_gen "Generatorstrom" UBYTE Def_i_ub_q1 0 0 0.0 255.0000 ECU_ADDRESS 0x7FB526 /begin FUNCTION_LIST IMDGEN_1PR /end FUNCTION_LIST /end MEASUREMENT
/begin MEASUREMENT I_gen_end "Generatorstrom gemessen / gerechnet" UBYTE Def_i_ub_q1 0 0 0.0 254.0000 ECU_ADDRESS 0x7FB561 /begin FUNCTION_LIST IMDGEN_1PR /end FUNCTION_LIST /end MEASUREMENT
/begin MEASUREMENT I_gen_g "Generatorstrom gesamt" UBYTE Def_i_ub_q1 0 0 0.0 255.0000 ECU_ADDRESS 0x7FB562 /begin FUNCTION_LIST IMDGEN_1PR /end FUNCTION_LIST /end MEASUREMENT
/begin MEASUREMENT I_gen_nafil "Generatorstrom nach Filter" UWORD Def_i_uw_q0p03125 0 0 0.0 256.0000 ECU_ADDRESS 0x7FB554 /begin FUNCTION_LIST IMDGEN_1PR /end FUNCTION_LIST /end MEASUREMENT
/begin MEASUREMENT I_gen_vorfil "Generatorstrom vor Filter" UWORD Def_i_uw_q0p03125 0 0 0.0 256.0000 ECU_ADDRESS 0x7FB556 /begin FUNCTION_LIST IMDGEN_1PR /end FUNCTION_LIST /end MEASUREMENT
/begin MEASUREMENT I_genmax "korrigiertes DF Signal ueber Temperatur, Generatordrehzahl, Generatorspannung" UBYTE Def_i_ub_q1 0 0 0.0 255.0000 ECU_ADDRESS 0x7FB527 /begin FUNCTION_LIST IMDGEN_1PR /end FUNCTION_LIST /end MEASUREMENT
/begin MEASUREMENT I_gle "Glühstrom" UWORD Def_i_uw_q0p0635 0 0 0.0 4095.9375 ECU_ADDRESS 0x7FD76A /begin FUNCTION_LIST BGCRENG /end FUNCTION_LIST /end MEASUREMENT
/begin MEASUREMENT I_gm "Generatormischstrom" UBYTE Def_i_ub_q1 0 0 0.0 255.0000 ECU_ADDRESS 0x7FB563 /begin FUNCTION_LIST IMDGEN_1PR /end FUNCTION_LIST /end MEASUREMENT
/begin MEASUREMENT I_gvor "Stromwert nach Überblendung" UBYTE Def_i_ub_q1 0 0 0.0 255.0000 ECU_ADDRESS 0x7FB564 /begin FUNCTION_LIST IMDGEN_1PR /end FUNCTION_LIST /end MEASUREMENT
/begin MEASUREMENT I_sls "berechnete Groesse Strombedarf Sekundärluftpumpe" UWORD Def_i_uw_q0p0635 0 0 0.0 255.0000 ECU_ADDRESS 0x7FD76C /begin FUNCTION_LIST BGCRENG /end FUNCTION_LIST /end MEASUREMENT
/begin MEASUREMENT Ibs1_errstat "" UWORD Def_st_uw_q1 0 0 0.0 65535.0000 ECU_ADDRESS 0x7FA904 /begin FUNCTION_LIST DIBS /end FUNCTION_LIST /end MEASUREMENT
/begin MEASUREMENT Ibs2_errstat "" UWORD Def_st_uw_q1 0 0 0.0 65535.0000 ECU_ADDRESS 0x7FA906 /begin FUNCTION_LIST DIBS /end FUNCTION_LIST /end MEASUREMENT
/begin MEASUREMENT Ibs3_errstat "" UWORD Def_st_uw_q1 0 0 0.0 65535.0000 ECU_ADDRESS 0x7FA908 /begin FUNCTION_LIST DIBS /end FUNCTION_LIST /end MEASUREMENT
/begin MEASUREMENT Ibsderrs1 "Fehlerzähler IBS BSD Kommunikation" UBYTE Def_dez_ub_q1 0 0 0.0 255.0000 ECU_ADDRESS 0x7FD77E /begin FUNCTION_LIST DIBS /end FUNCTION_LIST /end MEASUREMENT
/begin MEASUREMENT Ibsderrs2 "Fehlerzähler IBS EBSD Kommunikation" UWORD Def_dez_uw_q1 0 0 0.0 65535.0000 ECU_ADDRESS 0x7FD77C /begin FUNCTION_LIST DIBS /end FUNCTION_LIST /end MEASUREMENT
/begin MEASUREMENT Ibspreco2 "Vorteiler /10 fuer Ibsderrs2" UBYTE Def_dez_ub_q1 0 0 0.0 255.0000 ECU_ADDRESS 0x7FD77F /begin FUNCTION_LIST DIBS /end FUNCTION_LIST /end MEASUREMENT
/begin MEASUREMENT Ierrgrenz "Grenzertrregerstrom" UBYTE Def_i_ub_q0p125 0 0 0.0 31.8750 ECU_ADDRESS 0x7FB528 /begin FUNCTION_LIST IMDGEN_1PR /end FUNCTION_LIST /end MEASUREMENT
/begin MEASUREMENT Md_genfil "gefiltertes Generatormoment absolut" SWORD Def_m_sw_q0p1 0 0 -3276.8000 3276.7000 ECU_ADDRESS 0x7FB53E /begin FUNCTION_LIST IMDGEN_1PR /end FUNCTION_LIST /end MEASUREMENT
/begin MEASUREMENT Md_gennm "gefiltertes Generatormoment absolut Ausgang" SWORD Def_m_sw_q0p1 0 0 -3276.8000 3276.7000 ECU_ADDRESS 0x7FB51E /begin FUNCTION_LIST IMDGEN_1PR /end FUNCTION_LIST /end MEASUREMENT
/begin MEASUREMENT Md_gennmufi "Generatormoment absolut" SWORD Def_m_sw_q0p1 0 0 -3276.8000 3276.7000 ECU_ADDRESS 0x7FB540 /begin FUNCTION_LIST IMDGEN_1PR /end FUNCTION_LIST /end MEASUREMENT
/begin MEASUREMENT Md_genrel "relatives Generatormoment Ausgang" UWORD Def_f_uw_b100 0 0 0.0 99.9984 ECU_ADDRESS 0x7FB558 /begin FUNCTION_LIST IMDGEN_1PR /end FUNCTION_LIST /end MEASUREMENT
/begin MEASUREMENT Md_genvf "relatives Generatordrehmoment" UWORD Def_f_uw_b100 0 0 0.0 99.9984 ECU_ADDRESS 0x7FB524 /begin FUNCTION_LIST IMDGEN_1PR /end FUNCTION_LIST /end MEASUREMENT
/begin MEASUREMENT N_gen "Generatordrehzahl" SWORD Def_n_sw_q1p0 0 0 0.0 32767.0000 ECU_ADDRESS 0x7FB542 /begin FUNCTION_LIST IMDGEN_1PR /end FUNCTION_LIST /end MEASUREMENT
/begin MEASUREMENT N_gsllm "" SWORD Def_n_sw_q1p0 0 0 0.0 32767.0000 ECU_ADDRESS 0x7FFB52 /begin FUNCTION_LIST BGLLGEN_1PR /end FUNCTION_LIST /end MEASUREMENT
/begin MEASUREMENT N_idlgspec "Anforderung LL-Anhebung" UBYTE Def_st_ub_q1 0 0 0.0 255.0000 ECU_ADDRESS 0x7FFB51 /begin FUNCTION_LIST BGLLGEN_1PR /end FUNCTION_LIST /end MEASUREMENT
/begin MEASUREMENT Nkw_s "Motordrehzahl U/s" SWORD Def_n_sw_q1p0 0 0 -32768.0000 32767.0000 ECU_ADDRESS 0x7FB544 /begin FUNCTION_LIST IMDGEN_1PR /end FUNCTION_LIST /end MEASUREMENT
/begin MEASUREMENT Oz_diagtoens "Töns Diagnose Byte" UWORD Def_dez_uw_q1 0 0 0.0 65535.0000 ECU_ADDRESS 0x7FD782 /begin FUNCTION_LIST DQLT /end FUNCTION_LIST /end MEASUREMENT
/begin MEASUREMENT Oz_permerrz "" UBYTE Def_dez_ub_q1 0 0 0.0 255.0000 ECU_ADDRESS 0x7FD780 /begin FUNCTION_LIST DQLT /end FUNCTION_LIST /end MEASUREMENT
/begin MEASUREMENT P_gen_ab "elektrische Generatorleistung" ULONG Def_pwr_ul_q0p03125 0 0 0.0 4096.0000 ECU_ADDRESS 0x7FB530 /begin FUNCTION_LIST IMDGEN_1PR /end FUNCTION_LIST /end MEASUREMENT
/begin MEASUREMENT St_bgllgen0 "Statuswort" UBYTE Def_st_ub_q1 0 0 0.0 255.0000 ECU_ADDRESS 0x7FFB50 /begin FUNCTION_LIST BGLLGEN_1PR /end FUNCTION_LIST /end MEASUREMENT
/begin MEASUREMENT St_bgllgen0.B_hysllrah "" UBYTE Def_bit_ub_0 0 0 0.0 255.0 ECU_ADDRESS 0x7FFB50 /begin FUNCTION_LIST BGLLGEN_1PR /end FUNCTION_LIST BIT_MASK 0x1 /end MEASUREMENT
/begin MEASUREMENT St_dgen0 "Statuswort" UBYTE Def_st_ub_q1 0 0 0.0 255.0000 ECU_ADDRESS 0x7FD779 /begin FUNCTION_LIST DGEN /end FUNCTION_LIST /end MEASUREMENT
/begin MEASUREMENT St_dgen0.B_1stbsder "" UBYTE Def_bit_ub_0 0 0 0.0 255.0 ECU_ADDRESS 0x7FD779 /begin FUNCTION_LIST DGEN /end FUNCTION_LIST BIT_MASK 0x1 /end MEASUREMENT
/begin MEASUREMENT St_dgen0.B_genfprl "Bedingung Generatorfehler entprellt" UBYTE Def_bit_ub_2 0 0 0.0 255.0 ECU_ADDRESS 0x7FD779 /begin FUNCTION_LIST DGEN /end FUNCTION_LIST BIT_MASK 0x4 /end MEASUREMENT
/begin MEASUREMENT St_dgen0.B_gfbsupak "Generator Typ unplausibel^aus Fehlerspeicher" UBYTE Def_bit_ub_3 0 0 0.0 255.0 ECU_ADDRESS 0x7FD779 /begin FUNCTION_LIST DGEN /end FUNCTION_LIST BIT_MASK 0x8 /end MEASUREMENT
/begin MEASUREMENT St_dgen0.B_gfelak "Generatorfehler elektrisch aus Fehlerspeicher" UBYTE Def_bit_ub_4 0 0 0.0 255.0 ECU_ADDRESS 0x7FD779 /begin FUNCTION_LIST DGEN /end FUNCTION_LIST BIT_MASK 0x10 /end MEASUREMENT
/begin MEASUREMENT St_dgen0.B_gfhtak "Generatorfehler Uebertemperatur aus Fehlerspeicher" UBYTE Def_bit_ub_5 0 0 0.0 255.0 ECU_ADDRESS 0x7FD779 /begin FUNCTION_LIST DGEN /end FUNCTION_LIST BIT_MASK 0x20 /end MEASUREMENT
/begin MEASUREMENT St_dgen0.B_gfmeak "Generatorfehler mechanisch aus Fehlerspeicher" UBYTE Def_bit_ub_6 0 0 0.0 255.0 ECU_ADDRESS 0x7FD779 /begin FUNCTION_LIST DGEN /end FUNCTION_LIST BIT_MASK 0x40 /end MEASUREMENT
/begin MEASUREMENT St_dgen0.B_gfnobsak "Generator BSD Kommunikationsverlust aus Fehlerspeicher" UBYTE Def_bit_ub_7 0 0 0.0 255.0 ECU_ADDRESS 0x7FD779 /begin FUNCTION_LIST DGEN /end FUNCTION_LIST BIT_MASK 0x80 /end MEASUREMENT
/begin MEASUREMENT St_dgen0.B_kl61 "Bedingung Ladekontroll Laempchen an" UBYTE Def_bit_ub_1 0 0 0.0 255.0 ECU_ADDRESS 0x7FD779 /begin FUNCTION_LIST DGEN /end FUNCTION_LIST BIT_MASK 0x2 /end MEASUREMENT
/begin MEASUREMENT St_dibs0 "Statuswort" UBYTE Def_st_ub_q1 0 0 0.0 255.0000 ECU_ADDRESS 0x7FD77A /begin FUNCTION_LIST DIBS /end FUNCTION_LIST /end MEASUREMENT
/begin MEASUREMENT St_dibs0.B_dibloc1 "BSD Kommunikation zum IBS gestoert" UBYTE Def_bit_ub_0 0 0 0.0 255.0 ECU_ADDRESS 0x7FD77A /begin FUNCTION_LIST DIBS /end FUNCTION_LIST BIT_MASK 0x1 /end MEASUREMENT
/begin MEASUREMENT St_dibs0.B_dibloc2 "Fehler erweiterte BSD Kommunikation zum IBS" UBYTE Def_bit_ub_1 0 0 0.0 255.0 ECU_ADDRESS 0x7FD77A /begin FUNCTION_LIST DIBS /end FUNCTION_LIST BIT_MASK 0x2 /end MEASUREMENT
/begin MEASUREMENT St_dibs1 "Statuswort" UBYTE Def_st_ub_q1 0 0 0.0 255.0000 ECU_ADDRESS 0x7FA902 /begin FUNCTION_LIST DIBS /end FUNCTION_LIST /end MEASUREMENT
/begin MEASUREMENT St_dibs1.B_ifbsak "IBS Stromfehler" UBYTE Def_bit_ub_2 0 0 0.0 255.0 ECU_ADDRESS 0x7FA902 /begin FUNCTION_LIST DIBS /end FUNCTION_LIST BIT_MASK 0x4 /end MEASUREMENT
/begin MEASUREMENT St_dibs1.B_ifebsak "" UBYTE Def_bit_ub_3 0 0 0.0 255.0 ECU_ADDRESS 0x7FA902 /begin FUNCTION_LIST DIBS /end FUNCTION_LIST BIT_MASK 0x8 /end MEASUREMENT
/begin MEASUREMENT St_dibs1.B_ifuplak "IBS Temperaturfehler" UBYTE Def_bit_ub_4 0 0 0.0 255.0 ECU_ADDRESS 0x7FA902 /begin FUNCTION_LIST DIBS /end FUNCTION_LIST BIT_MASK 0x10 /end MEASUREMENT
/begin MEASUREMENT St_dibs2 "Statuswort" UBYTE Def_st_ub_q1 0 0 0.0 255.0000 ECU_ADDRESS 0x7FA903 /begin FUNCTION_LIST DIBS /end FUNCTION_LIST /end MEASUREMENT
/begin MEASUREMENT St_dibs2.B_ifisak "Fehler IBS Version unplausibel" UBYTE Def_bit_ub_0 0 0 0.0 255.0 ECU_ADDRESS 0x7FA903 /begin FUNCTION_LIST DIBS /end FUNCTION_LIST BIT_MASK 0x1 /end MEASUREMENT
/begin MEASUREMENT St_dibs2.B_ifsysak "Signal nv lave loc zur Flankenerkennung" UBYTE Def_bit_ub_5 0 0 0.0 255.0 ECU_ADDRESS 0x7FA903 /begin FUNCTION_LIST DIBS /end FUNCTION_LIST BIT_MASK 0x20 /end MEASUREMENT
/begin MEASUREMENT St_dibs2.B_iftempak "IBS KL15 Masseschluss" UBYTE Def_bit_ub_2 0 0 0.0 255.0 ECU_ADDRESS 0x7FA903 /begin FUNCTION_LIST DIBS /end FUNCTION_LIST BIT_MASK 0x4 /end MEASUREMENT
/begin MEASUREMENT St_dibs2.B_ifusak "IBS Spannungsfehler" UBYTE Def_bit_ub_1 0 0 0.0 255.0 ECU_ADDRESS 0x7FA903 /begin FUNCTION_LIST DIBS /end FUNCTION_LIST BIT_MASK 0x2 /end MEASUREMENT
/begin MEASUREMENT St_dibs2.B_ifwugdak "" UBYTE Def_bit_ub_3 0 0 0.0 255.0 ECU_ADDRESS 0x7FA903 /begin FUNCTION_LIST DIBS /end FUNCTION_LIST BIT_MASK 0x8 /end MEASUREMENT
/begin MEASUREMENT St_dibs2.B_ifwuplak "Signal nv lave loc zur Flankenerkennung" UBYTE Def_bit_ub_4 0 0 0.0 255.0 ECU_ADDRESS 0x7FA903 /begin FUNCTION_LIST DIBS /end FUNCTION_LIST BIT_MASK 0x10 /end MEASUREMENT
/begin MEASUREMENT St_dqlt0 "Statuswort" UBYTE Def_st_ub_q1 0 0 0.0 255.0000 ECU_ADDRESS 0x7FD78E /begin FUNCTION_LIST DQLT /end FUNCTION_LIST /end MEASUREMENT
/begin MEASUREMENT St_dqlt0.B_ozkttoens "Messfehler Öltemperatur" UBYTE Def_bit_ub_5 0 0 0.0 255.0 ECU_ADDRESS 0x7FD78E /begin FUNCTION_LIST DQLT /end FUNCTION_LIST BIT_MASK 0x20 /end MEASUREMENT
/begin MEASUREMENT St_dqlt0.B_ozlerr "Töns-Sensor verbaut" UBYTE Def_bit_ub_0 0 0 0.0 255.0 ECU_ADDRESS 0x7FD78E /begin FUNCTION_LIST DQLT /end FUNCTION_LIST BIT_MASK 0x1 /end MEASUREMENT
/begin MEASUREMENT St_dqlt0.B_ozqerr "Sensorfehler in FS eingetragen" UBYTE Def_bit_ub_1 0 0 0.0 255.0 ECU_ADDRESS 0x7FD78E /begin FUNCTION_LIST DQLT /end FUNCTION_LIST BIT_MASK 0x2 /end MEASUREMENT
/begin MEASUREMENT St_dqlt0.B_ozterr "Messfehler Ölniveau" UBYTE Def_bit_ub_2 0 0 0.0 255.0 ECU_ADDRESS 0x7FD78E /begin FUNCTION_LIST DQLT /end FUNCTION_LIST BIT_MASK 0x4 /end MEASUREMENT
/begin MEASUREMENT St_dqlt0.B_td_ogerr "Messfehler Ölzustand" UBYTE Def_bit_ub_3 0 0 0.0 255.0 ECU_ADDRESS 0x7FD78E /begin FUNCTION_LIST DQLT /end FUNCTION_LIST BIT_MASK 0x8 /end MEASUREMENT
/begin MEASUREMENT St_dqlt0.B_td_ogupl "QLT-Temic verbaut" UBYTE Def_bit_ub_4 0 0 0.0 255.0 ECU_ADDRESS 0x7FD78E /begin FUNCTION_LIST DQLT /end FUNCTION_LIST BIT_MASK 0x10 /end MEASUREMENT
/begin MEASUREMENT St_gen "Generatorstatus" UBYTE Def_st_ub_q1 0 0 0.0 255.0000 ECU_ADDRESS 0x7FD776 /begin FUNCTION_LIST DGEN /end FUNCTION_LIST /end MEASUREMENT
/begin MEASUREMENT St_genbsd "" UWORD Def_st_uw_q1 0 0 0.0 65535.0000 ECU_ADDRESS 0x7FD772 /begin FUNCTION_LIST DGEN /end FUNCTION_LIST /end MEASUREMENT
/begin MEASUREMENT St_gengen "" UWORD Def_st_uw_q1 0 0 0.0 65535.0000 ECU_ADDRESS 0x7FD774 /begin FUNCTION_LIST DGEN /end FUNCTION_LIST /end MEASUREMENT
/begin MEASUREMENT St_imdgen0 "Statuswort" UBYTE Def_st_ub_q1 0 0 0.0 255.0000 ECU_ADDRESS 0x7FB51C /begin FUNCTION_LIST IMDGEN_1PR /end FUNCTION_LIST /end MEASUREMENT
/begin MEASUREMENT St_imdgen0.B_firstemp "Bedingung Generatorstarttemperatur-Berechnung" UBYTE Def_bit_ub_0 0 0 0.0 255.0 ECU_ADDRESS 0x7FB51C /begin FUNCTION_LIST IMDGEN_1PR /end FUNCTION_LIST BIT_MASK 0x1 /end MEASUREMENT
/begin MEASUREMENT St_imdgen0.B_gene "Generatormoment enable/disable" UBYTE Def_bit_ub_1 0 0 0.0 255.0 ECU_ADDRESS 0x7FB51C /begin FUNCTION_LIST IMDGEN_1PR /end FUNCTION_LIST BIT_MASK 0x2 /end MEASUREMENT
/begin MEASUREMENT St_imdgen0.B_generken "" UBYTE Def_bit_ub_2 0 0 0.0 255.0 ECU_ADDRESS 0x7FB51C /begin FUNCTION_LIST IMDGEN_1PR /end FUNCTION_LIST BIT_MASK 0x4 /end MEASUREMENT
/begin MEASUREMENT St_imdgen_nv0 "Statuswort" UBYTE Def_st_ub_q1 0 0 0.0 255.0000 ECU_ADDRESS 0x7FB51D /begin FUNCTION_LIST IMDGEN_1PR /end FUNCTION_LIST /end MEASUREMENT
/begin MEASUREMENT St_imdgen_nv0.B_genfkupl "Generatortyp unplausibel" UBYTE Def_bit_ub_0 0 0 0.0 255.0 ECU_ADDRESS 0x7FB51D /begin FUNCTION_LIST IMDGEN_1PR /end FUNCTION_LIST BIT_MASK 0x1 /end MEASUREMENT
/begin MEASUREMENT St_imdgen_nv0.B_heizen "Bedingung Generator in Heizphase" UBYTE Def_bit_ub_1 0 0 0.0 255.0 ECU_ADDRESS 0x7FB51D /begin FUNCTION_LIST IMDGEN_1PR /end FUNCTION_LIST BIT_MASK 0x2 /end MEASUREMENT
/begin MEASUREMENT St_oz_o "Statuswort" UBYTE Def_st_ub_q1 0 0 0.0 255.0000 ECU_ADDRESS 0x7FD78F /begin FUNCTION_LIST DQLT /end FUNCTION_LIST /end MEASUREMENT
/begin MEASUREMENT St_oz_o.B_mol_sf "" UBYTE Def_bit_ub_1 0 0 0.0 255.0 ECU_ADDRESS 0x7FD78F /begin FUNCTION_LIST DQLT /end FUNCTION_LIST BIT_MASK 0x2 /end MEASUREMENT
/begin MEASUREMENT St_oz_o.B_oztemic "" UBYTE Def_bit_ub_0 0 0 0.0 255.0 ECU_ADDRESS 0x7FD78F /begin FUNCTION_LIST DQLT /end FUNCTION_LIST BIT_MASK 0x1 /end MEASUREMENT
/begin MEASUREMENT T_count_dibs1 "" UBYTE Def_i_ub_q1 0 0 0.0 255.0000 ECU_ADDRESS 0x7FA90A /begin FUNCTION_LIST DIBS /end FUNCTION_LIST /end MEASUREMENT
/begin MEASUREMENT T_count_dibs2 "" UBYTE Def_i_ub_q1 0 0 0.0 255.0000 ECU_ADDRESS 0x7FA90B /begin FUNCTION_LIST DIBS /end FUNCTION_LIST /end MEASUREMENT
/begin MEASUREMENT T_count_dibs3 "" UBYTE ident 0 0 0.0 255.0000 ECU_ADDRESS 0x7FA90C /begin FUNCTION_LIST DIBS /end FUNCTION_LIST /end MEASUREMENT
/begin MEASUREMENT T_count_dibs4 "" UBYTE ident 0 0 0.0 255.0000 ECU_ADDRESS 0x7FA90D /begin FUNCTION_LIST DIBS /end FUNCTION_LIST /end MEASUREMENT
/begin MEASUREMENT Tgen "Generatortemperatur" SWORD Def_t_sw_q0p1 0 0 -3276.8000 3276.7000 ECU_ADDRESS 0x7FB520 /begin FUNCTION_LIST IMDGEN_1PR /end FUNCTION_LIST /end MEASUREMENT
/begin MEASUREMENT Tgen_ab "Abstelltemperatur Generator" SWORD Def_t_sw_q0p1 0 0 -3276.8000 3276.7000 ECU_ADDRESS 0x7FD790 /begin FUNCTION_LIST IMDGEN_1PR /end FUNCTION_LIST /end MEASUREMENT
/begin MEASUREMENT Tgen_dt "Temperaturdifferenz zwischen Abstelltemperatur und Umgebungstemperatur" SWORD Def_t_sw_q0p1 0 0 -48.0000 384.0000 ECU_ADDRESS 0x7FB546 /begin FUNCTION_LIST IMDGEN_1PR /end FUNCTION_LIST /end MEASUREMENT
/begin MEASUREMENT Tgen_end "Generatortemperatur endgültig" SWORD Def_t_sw_q0p1 0 0 -3276.8000 3276.7000 ECU_ADDRESS 0x7FB522 /begin FUNCTION_LIST IMDGEN_1PR /end FUNCTION_LIST /end MEASUREMENT
/begin MEASUREMENT Tgen_exp "Delta Abkühltemperatur" SWORD Def_t_sw_q0p1 0 0 -48.0000 384.0000 ECU_ADDRESS 0x7FB548 /begin FUNCTION_LIST IMDGEN_1PR /end FUNCTION_LIST /end MEASUREMENT
/begin MEASUREMENT Tgen_fil "gefilterte Generatortemperatur" SWORD Def_t_sw_q0p1 0 0 -3276.8000 3276.7000 ECU_ADDRESS 0x7FB54A /begin FUNCTION_LIST IMDGEN_1PR /end FUNCTION_LIST /end MEASUREMENT
/begin MEASUREMENT Tst_countv "Testcounter-Wert" UWORD Def_st_uw_q1 0 0 0.0 65535.0000 ECU_ADDRESS 0x7FB55A /begin FUNCTION_LIST IMDGEN_1PR /end FUNCTION_LIST /end MEASUREMENT
/begin MEASUREMENT Tst_fil_out "Testfilter Ausgang" UWORD Def_t_uw_q0p075 0 0 0.0 768.0000 ECU_ADDRESS 0x7FB55C /begin FUNCTION_LIST IMDGEN_1PR /end FUNCTION_LIST /end MEASUREMENT
/begin MEASUREMENT Vvt_ib1_2 "Gesamtstrom VVT Bank1 bzw 4Zyl. und Bank2" UWORD Def_i_uw_q0p0635 0 0 0.0 4095.9375 ECU_ADDRESS 0x7FD76E /begin FUNCTION_LIST BGCRENG /end FUNCTION_LIST /end MEASUREMENT
/begin MEASUREMENT Vvt_iges "Strombedarf des gesamten VVT-Systems" UWORD Def_i_uw_q0p0635 0 0 0.0 192.0000 ECU_ADDRESS 0x7FD770 /begin FUNCTION_LIST BGCRENG /end FUNCTION_LIST /end MEASUREMENT
/begin FUNCTION stsys_strttip_msg "" /begin OUT_MEASUREMENT StSys_stStrtTip StSys_stStrtTipOFF StSys_stStrtTipON /end OUT_MEASUREMENT /end FUNCTION
/begin FUNCTION stsys_strttip_uic "" /end FUNCTION
/begin FUNCTION stsys_strt_msg "" /begin OUT_MEASUREMENT StSys_stNewStrt StSys_stStrt StSys_stStrtCutOutMon /end OUT_MEASUREMENT /end FUNCTION
/begin FUNCTION stsys_strt_uic "" /begin OUT_MEASUREMENT StSys_nThresStrtCutOut_mp StSys_tStrt_mp /end OUT_MEASUREMENT /end FUNCTION
/begin FUNCTION stsys_t50shutoff ""
 /begin DEF_CHARACTERISTIC StSys_DebTrqShutOffDef_C StSys_DebTrqShutOffOk_C StSys_nStarter_C StSys_tiEngageCutOut_C StSys_vThres_C /end DEF_CHARACTERISTIC
/end FUNCTION
/begin FUNCTION stsys_t50shutoff_uic "" /begin OUT_MEASUREMENT StSys_stTrqShutOffErr_mp /end OUT_MEASUREMENT /end FUNCTION
/begin FUNCTION stsys_trqshutoff "Startmomentabschaltung"
 /begin DEF_CHARACTERISTIC StSys_n2MsWhlLoLim_C StSys_n2MsWhlUpOfs_C StSys_tinFltPT1_C StSys_swtShutOff_C StSys_ti2MsWhlPrt_C StSys_tiStartOszilDef_C StSys_tiStartOszilOk_C /end DEF_CHARACTERISTIC
/end FUNCTION
/begin FUNCTION stsys_trqshutoff_msg "" /begin OUT_MEASUREMENT StSys_stTrqShutOff /end OUT_MEASUREMENT /end FUNCTION
/begin FUNCTION stsys_trqshutoff_uic "" /begin OUT_MEASUREMENT StSys_nAvrgFlt_mp StSys_stTrqShutOffCond_mp /end OUT_MEASUREMENT /end FUNCTION
/begin FUNCTION switches_base "" /end FUNCTION
/begin FUNCTION switches_proj "" /end FUNCTION
/begin FUNCTION switches_sys "" /end FUNCTION
/begin FUNCTION swtmr_inc10ms "" /end FUNCTION
/begin FUNCTION swtmr_inc10ms_uic "" /end FUNCTION
/begin FUNCTION swtmr_msg "" /begin OUT_MEASUREMENT SWTmr_tiTmr16 SWTmr_tiTmr32 /end OUT_MEASUREMENT /end FUNCTION
/begin FUNCTION system_const_base "" /end FUNCTION
/begin FUNCTION system_const_conf "" /end FUNCTION
/begin FUNCTION system_const_proj "" /end FUNCTION
/begin FUNCTION system_const_sys "" /end FUNCTION
/begin FUNCTION t15cd "Klemme 15 Komponententreiber"
 /begin DEF_CHARACTERISTIC T15CD_tiDebNeg_C T15CD_tiDebPos_C T15CD_DebNplDef_C T15CD_DebNplOk_C T15CD_numDioIn_C T15CD_stInvIn_C T15CD_tiDebWakeUp_C /end DEF_CHARACTERISTIC
/end FUNCTION
/begin FUNCTION t15cd_msg "" /begin OUT_MEASUREMENT T15CD_stDebVal T15CD_stDebWakeUpVal T15CD_stWakeUp /end OUT_MEASUREMENT /end FUNCTION
/begin FUNCTION t15cd_uic ""
 /begin OUT_MEASUREMENT T15CD_stCondDebVal_mp T15CD_stLogicT15_mp T15CD_stWakeUpRawVal_mp /end OUT_MEASUREMENT
/end FUNCTION
/begin FUNCTION t50cd "Komponententreiber Klemme 50"
 /begin DEF_CHARACTERISTIC T50CD_tiDebNeg_C T50CD_tiDebPos_C T50CD_stDflVal_C T50CD_stInv_C T50CD_swtSigVal_C /end DEF_CHARACTERISTIC
/end FUNCTION
/begin FUNCTION t50cd_msg "" /begin OUT_MEASUREMENT T50CD_stDebVal T50CD_stRawVal T50CD_swtSig /end OUT_MEASUREMENT /end FUNCTION
/begin FUNCTION t50cd_uic "" /end FUNCTION
/begin FUNCTION thrvlv_co "actuator coordinator for Throttle Valve" /end FUNCTION
/begin FUNCTION thrvlv_co_msg "" /begin OUT_MEASUREMENT ThrVlv_rTVA /end OUT_MEASUREMENT /end FUNCTION
/begin FUNCTION thrvlv_co_uic "" /begin DEF_CHARACTERISTIC ThrVlv_rTVA_Vector ThrVlv_rTVA_Channel /end DEF_CHARACTERISTIC /begin OUT_MEASUREMENT ThrVlv_rTVAByp_mp /end OUT_MEASUREMENT /end FUNCTION
/begin FUNCTION tpumon "Timer Überwachung"
 /begin DEF_CHARACTERISTIC TPUMon_ctDfctLim_C TPUMon_ctTPU_C TPUMon_tiDiffMaxLimit_C TPUMon_tiDiffMinLimit_C TPUMon_tiDiffSumLimit_C /end DEF_CHARACTERISTIC
/end FUNCTION
/begin FUNCTION tpumon_uic ""
 /begin OUT_MEASUREMENT TPUMon_ctUpDwnDeb_mp TPUMon_tiDiffMax_mp TPUMon_tiDiffMin_mp TPUMon_tiDiffSum_mp /end OUT_MEASUREMENT
/end FUNCTION
/begin FUNCTION tvacd "Drosselklappensteller Komponententreiber"
 /begin DEF_CHARACTERISTIC TVACD_DebExcTempDef_C TVACD_DebExcTempOk_C TVACD_DebNoLoadDef_C TVACD_DebNoLoadOk_C TVACD_DebShortCircBatDef_C TVACD_DebShortCircBatOk_C TVACD_DebShortCircGndDef_C TVACD_DebShortCircGndOk_C TVACD_tiDebTVADia1Def_C TVACD_tiDebTVADia1Ok_C TVACD_tiDebTVADia2Def_C TVACD_tiDebTVADia2Ok_C TVACD_tiDebTVADia3Def_C TVACD_tiDebTVADia3Ok_C TVACD_numDia_C TVACD_numPwmOut_C TVACD_stInvOut_C TVACD_tiPer_C TVACD_rCnv_CUR TVACD_rOutMax_C TVACD_rOutMin_C TVACD_rTst_C TVACD_stPwrStgActv_C TVACD_stPwrStgDia_C TVACD_swt_C TVACD_tiBtwTst_C TVACD_tiDiag1Max_C TVACD_tiDiag1Min_C TVACD_tiDiag2Max_C TVACD_tiDiag2Min_C TVACD_tiDiag3Max_C TVACD_tiDiag3Min_C /end DEF_CHARACTERISTIC
 /begin IN_MEASUREMENT ThrVlv_rTVA /end IN_MEASUREMENT
/end FUNCTION
/begin FUNCTION tvacd_msg "" /begin OUT_MEASUREMENT TVACD_rOut /end OUT_MEASUREMENT /end FUNCTION
/begin FUNCTION tvacd_uic "" /begin OUT_MEASUREMENT TVACD_rCnv_mp /end OUT_MEASUREMENT /end FUNCTION
/begin FUNCTION uaddr "" /begin DEF_CHARACTERISTIC UAddr_stCalibration_C Uaddr_stMeasurement_C /end DEF_CHARACTERISTIC /end FUNCTION
/begin FUNCTION usap "Datensatzvarianten Bezeichner" /begin DEF_CHARACTERISTIC USAp_dDataVariantIdInv_C USAp_dDataVariantId_C /end DEF_CHARACTERISTIC /begin OUT_MEASUREMENT USAp_dDataVariant_u8 USAp_stDataVariant_u8 /end OUT_MEASUREMENT /end FUNCTION
/begin FUNCTION usrda "Benutzergrößen" /begin DEF_CHARACTERISTIC UsrDa_swtFDC_C /end DEF_CHARACTERISTIC /end FUNCTION
/begin FUNCTION usrda_msg "" /begin OUT_MEASUREMENT UsrDa_stFDC UsrDa_stRecFDC /end OUT_MEASUREMENT /end FUNCTION
/begin FUNCTION usrda_uic "" /end FUNCTION
/begin FUNCTION vehda "Fahrzeuggrößen" /begin DEF_CHARACTERISTIC VehDa_rVnMax_C VehDa_tiNPT1_C VehDa_tiVnPT1_C /end DEF_CHARACTERISTIC /end FUNCTION
/begin FUNCTION vehda_lsum "Erfassung gefahrene Strecke" /end FUNCTION
/begin FUNCTION vehda_lsum_msg "" /begin OUT_MEASUREMENT VehDa_lSum /end OUT_MEASUREMENT /end FUNCTION
/begin FUNCTION vehda_lsum_uic "" /begin OUT_MEASUREMENT VehDa_lInt_mp /end OUT_MEASUREMENT /end FUNCTION
/begin FUNCTION vehda_msg "" /begin OUT_MEASUREMENT VehDa_rVn VehDa_stTrqDem /end OUT_MEASUREMENT /end FUNCTION
/begin FUNCTION vehda_tiengon "Erfassung der aktuellen Betriebszeit" /begin DEF_CHARACTERISTIC VehDa_lEepUpd_C VehDa_nMaxEepUpd_C VehDa_nMinEepUpd_C /end DEF_CHARACTERISTIC /end FUNCTION
/begin FUNCTION vehda_tiengon_msg "" /begin OUT_MEASUREMENT VehDa_tiEngOn /end OUT_MEASUREMENT /end FUNCTION
/begin FUNCTION vehda_tiengon_uic "" /end FUNCTION
/begin FUNCTION vehda_uic "" /begin OUT_MEASUREMENT VehDa_nEngFilt_mp /end OUT_MEASUREMENT /end FUNCTION
/begin FUNCTION vehmot "Fahrzeugbewegung" /end FUNCTION
/begin FUNCTION vehmot_msg "" /begin OUT_MEASUREMENT VehMot_nMax VehMot_nMin VehMot_pwrAcsDes VehMot_pwrAcsLead /end OUT_MEASUREMENT /end FUNCTION
/begin FUNCTION vesgov_governor "Arbeitsdrehzahlregler" /end FUNCTION
/begin FUNCTION vesgov_governor_msg "" /begin OUT_MEASUREMENT VESGov_trq /end OUT_MEASUREMENT /end FUNCTION
/begin FUNCTION vesgov_governor_uic "" /end FUNCTION
/begin FUNCTION vsacd "Drallniveausteller Komponententreiber"
 /begin DEF_CHARACTERISTIC VSACD_DebExcTempDef_C VSACD_DebExcTempOk_C VSACD_DebNoLoadDef_C VSACD_DebNoLoadOk_C VSACD_DebShortCircBatDef_C VSACD_DebShortCircBatOk_C VSACD_DebShortCircGndDef_C VSACD_DebShortCircGndOk_C VSACD_tiDebVSADia1Def_C VSACD_tiDebVSADia1Ok_C VSACD_tiDebVSADia2Def_C VSACD_tiDebVSADia2Ok_C VSACD_tiDebVSADia3Def_C VSACD_tiDebVSADia3Ok_C VSACD_tiDebVSADia4Def_C VSACD_tiDebVSADia4Ok_C VSACD_numDia_C VSACD_numPwmOut_C VSACD_stInvOut_C VSACD_tiPer_C VSACD_rCnv_CUR VSACD_rOutMax_C VSACD_rOutMin_C VSACD_rTst_C VSACD_stPwrStgActv_C VSACD_stPwrStgDia_C VSACD_swt_C VSACD_tiBtwTst_C VSACD_tiDiag1Max_C VSACD_tiDiag1Min_C VSACD_tiDiag2Max_C VSACD_tiDiag2Min_C VSACD_tiDiag3Max_C VSACD_tiDiag3Min_C VSACD_tiDiag4Max_C VSACD_tiDiag4Min_C /end DEF_CHARACTERISTIC
 /begin IN_MEASUREMENT VSA_rVSA /end IN_MEASUREMENT
/end FUNCTION
/begin FUNCTION vsacd_msg "" /begin OUT_MEASUREMENT VSACD_rOut /end OUT_MEASUREMENT /end FUNCTION
/begin FUNCTION vsacd_uic "" /begin OUT_MEASUREMENT VSACD_rCnv_mp /end OUT_MEASUREMENT /end FUNCTION
/begin FUNCTION vsacd_var "" /end FUNCTION
/begin FUNCTION vsacd_var_uic "" /end FUNCTION
/begin FUNCTION vsa_co "Stellerkoordinator für Drallnivieausteller" /end FUNCTION
/begin FUNCTION vsa_co_msg "" /begin OUT_MEASUREMENT VSA_rVSA /end OUT_MEASUREMENT /end FUNCTION
/begin FUNCTION vsa_co_uic "" /begin DEF_CHARACTERISTIC VSA_rVSA_Vector VSA_rVSA_Channel /end DEF_CHARACTERISTIC /begin OUT_MEASUREMENT VSA_rVSAByp_mp /end OUT_MEASUREMENT /end FUNCTION
/begin FUNCTION vsscd_co "Fahrgeschwindigkeitsgeber Komponententreiber"
 /begin DEF_CHARACTERISTIC VSSCD_DebCanSigDef_C VSSCD_DebCanSigOk_C VSSCD_DebMaxDef_C VSSCD_DebMaxOk_C VSSCD_DebNegPlaMonCond_C VSSCD_DebPlaMonCond_C VSSCD_DebPlaDef_C VSSCD_DebPlaOk_C VSSCD_DebSigDef_C VSSCD_DebSigOk_C VSSCD_nThresPla_C VSSCD_qThresPla_C VSSCD_swtSigVal_C VSSCD_swtSigType_C VSSCD_tiAPT1_C VSSCD_tiPerMax_C VSSCD_tiVPT1_C VSSCD_vDfl_C VSSCD_vMax_C VSSCD_vMin_C VSSCD_vThresPla_C /end DEF_CHARACTERISTIC
/end FUNCTION
/begin FUNCTION vsscd_co_distfac "" /begin DEF_CHARACTERISTIC VSSCD_ImpPerDist_C /end DEF_CHARACTERISTIC /end FUNCTION
/begin FUNCTION vsscd_co_distfac_uic "" /end FUNCTION
/begin FUNCTION vsscd_co_uic "" /begin OUT_MEASUREMENT VSSCD_rImp_mp VSSCD_stInHW_mp /end OUT_MEASUREMENT /end FUNCTION
/begin FUNCTION vsscd_co_var "" /end FUNCTION
/begin FUNCTION vsscd_co_var_msg "" /begin OUT_MEASUREMENT VSSCD_ctImp VSSCD_swtSig VSSCD_tiPerAvrg /end OUT_MEASUREMENT /end FUNCTION
/begin FUNCTION vsscd_co_var_uic "" /end FUNCTION
/begin FUNCTION vsscd_msg "" /begin OUT_MEASUREMENT VSSCD_a VSSCD_aRaw VSSCD_v VSSCD_vRaw VSSCD_vSensVal /end OUT_MEASUREMENT /end FUNCTION
/begin FUNCTION wdcom "Frage-Antwort-Kommunikation mit Überwachungsmodul" /begin DEF_CHARACTERISTIC Chiste_stEnaTst_C /end DEF_CHARACTERISTIC
 /begin OUT_MEASUREMENT WDCom_ErrorCntForSPI_u8 WDCom_ErrorCntForUC_u8 WDCom_ErrorCntForWD_u8 /end OUT_MEASUREMENT
/end FUNCTION
/begin FUNCTION wdcom_msg ""
 /begin OUT_MEASUREMENT WDCom_dChisteResponse_u32 WDCom_dErrorCountForCntler_u8 WDCom_dErrorCountForWD_u8 WDCom_dRequest_u32 /end OUT_MEASUREMENT
/end FUNCTION
/begin FUNCTION zfc_cldcmbcham "" /begin DEF_CHARACTERISTIC ZFC_tiCldCham_CUR ZFC_tiHotCham_C /end DEF_CHARACTERISTIC /begin IN_MEASUREMENT IATSCD_tAir /end IN_MEASUREMENT /end FUNCTION
/begin FUNCTION zfc_cldcmbcham_msg "" /begin OUT_MEASUREMENT ZFC_stCldCham /end OUT_MEASUREMENT /end FUNCTION
/begin FUNCTION zfc_cldcmbcham_uic "" /begin OUT_MEASUREMENT ZFC_stCmbCham_mp /end OUT_MEASUREMENT /end FUNCTION
/begin FUNCTION zfc_co ""
 /begin DEF_CHARACTERISTIC ZFC_dBPFacNumFBCG3_CA ZFC_dBPFacNumFBCG4_CA ZFC_dBPFacNumFBCG5_CA ZFC_dBPFacNumFBCG6_CA ZFC_dSegFBCCaS_CA ZFC_nAvrgMax_C ZFC_nAvrgMin_C ZFC_nChngPRailMax_C ZFC_nFBCThresMax_C ZFC_nHyst_C ZFC_numRatETClb_C ZFC_numRatNVClb_C ZFC_stClthSel_C ZFC_stGearRls_CA ZFC_swtClbActvVal_C ZFC_swtClbActvType_C ZFC_tAirThres_C ZFC_tEngThres_C ZFC_tFuelThresMax_C ZFC_tFuelThresMin_C ZFC_tiDelOvrRun_C ZFC_tiDelpRailLim_C ZFC_uBattMin_C /end DEF_CHARACTERISTIC
/end FUNCTION
/begin FUNCTION zfc_co_uic ""
 /begin OUT_MEASUREMENT ZFC_dpRailLim_mp ZFC_dpRail_mp ZFC_pRailSetPoint_mp ZFC_stDem_mp ZFC_st_mp ZFC_vStopClb_mp /end OUT_MEASUREMENT
/end FUNCTION
/begin FUNCTION zfc_evalengspd "" /begin OUT_MEASUREMENT ZFC_Sig_mp /end OUT_MEASUREMENT /end FUNCTION
/begin FUNCTION zfc_evalengspd_uic "" /begin OUT_MEASUREMENT ZFC_SigThres_mp ZFC_stEvalSig_mp /end OUT_MEASUREMENT /end FUNCTION
/begin FUNCTION zfc_inj "Einspritzberechnung der Nullmengenkalibrierung" /begin DEF_CHARACTERISTIC ZFC_phiSet_CUR /end DEF_CHARACTERISTIC /begin IN_MEASUREMENT Eng_nAvrg /end IN_MEASUREMENT /end FUNCTION
/begin FUNCTION zfc_inj_uic "" /begin OUT_MEASUREMENT ZFC_numCylInj_mp ZFC_phiInj_mp ZFC_stInj_mp ZFC_tiET_mp /end OUT_MEASUREMENT /end FUNCTION
/begin FUNCTION zfc_msg "" /begin OUT_MEASUREMENT ZFC_swtClbActv /end OUT_MEASUREMENT /end FUNCTION
/begin FUNCTION _pa_branchtab "" /end FUNCTION
/begin FUNCTION _ksd "Kundenspezifische Daten (mit #KSD gekennzeichnet)" /begin REF_CHARACTERISTIC /end REF_CHARACTERISTIC /end FUNCTION
/begin FUNCTION _ssd "Systemspezifische Daten (mit #SSD gekennzeichnet)"
 /begin REF_CHARACTERISTIC ACC_DebPlausTrqDesDef_C ACC_DebPlausTrqDesOk_C ACC_DebTrqInrDef_C ACC_DebTrqInrOk_C ACC_dtrqLimBrkDwn_C ACC_dtrqLimBrkUp_C ACC_dtrqLimDwn_C ACC_dtrqLimUp_C AccPed_drAPPUnFltLim_C AccPed_drLimDwn_C AccPed_drLimUp_C AccPed_facAcsWghMax_C AccPed_facAcsWghMin_C AccPed_facLIOvrBehWgh_C AccPed_nErr_C AccPed_nErr_CUR AccPed_nLim_C AccPed_nLimNMR_C AccPed_nSecCase_C AccPed_rErrValPlaus_C AccPed_rThPlaus_C AccPed_rThresPrp_C AccPed_rThresSfty_C AccPed_rZero_C AccPed_swtPlausCheck_C AccPed_swtRstCon_C AccPed_swtVehDynReqd_C AccPed_tiChkDebNeg_C AccPed_tiChkDebPos_C AccPed_tiPlausBrkDebPos_C AccPed_trqDes_Channel AccPed_trqDes_Vector AccPed_trqLIOvrBehOfsL_C AccPed_trqNMRMax_C AccPed_vLim_C ACC_PlausTrqTmrDead_C ACC_qOvrRunZeroYHigh_C ACC_qOvrRunZeroYLow_C ACC_swtBrkPressedDel_C ACC_swtTrqDesShutOff_C ACC_tiBrkPressedDel_C ACC_tiPT1_C ACCtl_nMin_C ACC_trqRedShft_CUR ACC_trqReplVal_C ADCMon_DebQueueDef_C ADCMon_DebRefVltgSRCDef_C ADCMon_DebTstImpDef_C ADCMon_nQueueMon_C ADCMon_tiQueueMon_C ADCMon_tiSendTstImp_C ADCMon_uRefSRCMax_C ADCMon_uRefSRCMin_C ADCMon_uTstImpSRCMax_C AFSCD_swtAirSysType_C AFSCD_swtAirSysVal_C AFS_swtChkDM_ANF_AFS_C AFS_swtChkSTWA_C AFS_swtdphiStrgGenSel_C AFS_trqDesMax_C AFS_trqDesMin_C AirCtl_mDesValAdd_Channel AirCtl_mDesValAdd_Vector AirCtl_mDesVal_Channel AirCtl_mDesVal_Vector AirCtl_rEGRAdd_Channel AirCtl_rEGRAdd_Vector AirCtl_rEGR_Channel AirCtl_rEGR_Vector AirCtl_rTVAAdd_Channel AirCtl_rTVAAdd_Vector AirCtl_rTVA_Channel AirCtl_rTVA_Vector Alt_pwrDes_Channel Alt_pwrDes_Vector AOHtCD_numDia_C AOHtCD_numDioIn_C AOHtCD_numPwmOut_C AOHt_nMin_C AOHt_rHtgOut_Channel AOHt_rHtgOut_Vector APPCD_DebPlaDef_C APPCD_DebPlaOk_C APPCD_DebSRCHighDef_C APPCD_DebSRCHighOk_C APPCD_DebSRCLowDef_C APPCD_DebSRCLowOk_C APPCD_drHealRmpUp_C APPCD_numAdcAPP1_C APPCD_numAdcAPP2_C APPCD_rLinAPP1_CUR APPCD_rLinAPP2_CUR APPCD_rPlaWinLowIdleXHigh_C APPCD_rPlaWinLowIdleXLow_C APPCD_rPlaWinParLoadXHigh_C APPCD_rPlaWinParLoadXLow_C APPCD_SSpMonAPP1_C APPCD_SSpMonAPP2_C APPCD_stCfgAccPed_C APPCD_uAPP1_SRCMax_C APPCD_uAPP1_SRCMin_C APPCD_uAPP2_SRCMax_C APPCD_uAPP2_SRCMin_C APPCD_uKickDownHighAPP1_C APPCD_uKickDownHighAPP2_C APPCD_uKickDownLowAPP1_C APPCD_uKickDownLowAPP2_C APPCD_uPlaWinFull_C APPCD_uPlaWinIdle_C APPCD_uPlaWinPar_C APSCD_numAdc_C APSCD_pDfl_C APSCD_pLin_CUR APSCD_uSRCMax_C APSCD_uSRCMin_C ASDdc_trq_Channel ASDdc_trq_Vector ASDrf_trqInr_Channel ASDrf_trqInr_Vector BattCD_numAdc_C Batt_uNrm_C BPACD_DebExcTempDef_C BPACD_DebNoLoadDef_C BPACD_DebShortCircBatDef_C BPACD_DebShortCircGndDef_C BPACD_numDia_C BPACD_numPwmOut_C BPACD_stPwrStgDia_C BPACD_tiBtwTst_C BPA_rBPACD_Channel BPA_rBPACD_Vector BPSCD_DebNplDef_C BPSCD_DebSigDef_C BPSCD_DebSRCHighDef_C BPSCD_DebSRCLowDef_C BPSCD_numAdc_C BPSCD_swtSigVal_C BPSCD_uSRCMax_C BPSCD_uSRCMin_C BrkCD_DebPlaDef_C BrkCD_DebPlaOk_C BrkCD_numDioInMn_C BrkCD_numDioInRed_C BrkCD_stMnSwtInvIn_C BrkCD_stRedSwtInvIn_C BrkCD_swtRedSwtPresent_C BrkCD_tiMnSwtDebNeg_C BrkCD_tiMnSwtDebPos_C BrkCD_tiRedSwtDebNeg_C BrkCD_tiRedSwtDebPos_C BypEtk_dNsyncStimuli16_C BypEtk_dNsyncStimuli32_C BypEtk_dNsyncStimuli64_C BypEtk_dNsyncStimuli8_C BypEtk_dTsyncStimuli16_C BypEtk_dTsyncStimuli32_C BypEtk_dTsyncStimuli64_C BypEtk_dTsyncStimuli8_C BypEtk_stAscet_C BypInt_adFunc_C BypInt_stAscet_C CaSCD_ctEdgOfs_C CaSCD_ctErrSync_C CaSCD_ctShftSync_C CaSCD_dSegSeries_C CaSCD_facPlausHigh_CUR CaSCD_facPlausLow_CUR CaSCD_nMinSpeed_C CaSCD_phiSegLen_C CaSCD_phiSegLenTolc_C CaSCD_phiSegOfs_C CaSCD_phiSpeedCalcTolc_C CaSCD_phiSpeedSegLen_C CaSCD_phiSpeedSegOfs_C CaSCD_stCalc_C CaSCD_stEdgeTrig_C CaSCD_stPinState_C CaSCD_stTPO_C CaSCD_tiPeriodRev1Max_C CaSCD_tiPeriodRev2Max_C CaSCD_tiTimOutOfs_C Chiste_stEnaTst_C CoDT_swtCoTypeType_C CoDT_swtCoTypeVal_C CoDT_trqMinInit_C CoEng_dtrqLimUp_C CoEng_dtrqLimUp1_C CoEng_ExtWaitMsk_C CoEng_ExtWaitMsk2_C CoEng_facAdjMax_C CoEng_nActrRelease_C CoEng_nShOffTstMax_C CoEng_nShOffTstMin_C CoEng_rhoFuel_C CoEng_stIRevShutOff_C CoEng_stRevShutOff_C CoEng_stShOffAddReqIRev_C CoEng_stShOffAddReqRev_C CoEng_stShOffAftRun_C CoEng_stShOffAirbFrnt_C CoEng_stShOffAirbRear_C CoEng_stShOffAirbSide_C CoEng_stShOffDblCtl_C CoEng_stShOffDiaReqFI_C CoEng_stShOffExtReq_C CoEng_stShOffFWOscDet_C CoEng_stShOffInit_C CoEng_stShOffInjMon_C CoEng_stShOffInjShCir_C CoEng_stShOffIRevSys1_C CoEng_stShOffIRevSys2_C CoEng_stShOffIRevVeh_C CoEng_stShOffIrrCmb_C CoEng_stShOffOvrSpd_C CoEng_stShOffPresMin_C CoEng_stShOffRevSys1_C CoEng_stShOffRevSys2_C CoEng_stShOffRevVeh_C CoEng_stShOffRlOvrBar_C CoEng_stShOffSV_C CoEng_stShOffTstSel_C CoEng_stSoftShOffAR_C CoEng_tiActrPrt_C CoEng_tiDlyT15_C CoEng_tiMinAftRun_C CoEng_tiOvrRunCoordDebPos_C CoEng_tiPwrStgDiaRdy_C CoEng_tiSoftShOff_CUR CoEng_trqOvrRunThres_C CoEng_trqSlpLim_Channel CoEng_trqSlpLim_Vector ConvCD_numDioIn_C CoVeh_trqPrpDes_Channel CoVeh_trqPrpDes_Vector CoVeh_trqPrpLead_Channel CoVeh_trqPrpLead_Vector CoVM_amMAX_C CoVM_swtPlausChkType_C CoVM_swtPlausChkVal_C CoVM_trqDecMax_C CoVM_trqIncMin_C CrCtl_stShutOffCodeMsk_C CrCtl_trqDes_Channel CrCtl_trqDes_Vector CrCtl_trqLead_Channel CrCtl_trqLead_Vector CrCtl_vTipStep_C CrSCD_ctGapIncs_C CrSCD_ctGaps_C CrSCD_ctIncs_C CrSCD_ctThresCtlMin_C CrSCD_ctTurns_C CrSCD_facGapPlausHigh_CUR CrSCD_facGapPlausLow_CUR CrSCD_facIncPlausHigh_CUR CrSCD_facIncPlausLow_CUR CrSCD_nFast_C CrSCD_nMax_C CrSCD_nMin_C CrSCD_nSlow_C CrSCD_nSlowHigh_C CrSCD_nThresCtlHigh_C CrSCD_nThresCtlLow_C CrSCD_numFBCSeg_C CrSCD_numShftMisf_C CrSCD_numTDCSeg_C CrSCD_phiGap2Zero_C CrSCD_phiIncCor_CUR CrSCD_phiSegLength_C CrSCD_phiSegPhase_C CrSCD_tiPlausCalcOff_C CrS_ctMaxInjStrt_C CrS_facSegTime_C CrS_facSegTimeMax_C CrS_facSegTimeMin_C CrS_phiSegLengthStrtSpd_C CrS_phiSegOfsStrtSpd_C CrS_phiSegOfsStrtSpdOld_C CTSCD_DebSigDef_C CTSCD_DebSRCHighDef_C CTSCD_DebSRCLowDef_C CTSCD_numAdc_C CTSCD_stSensIDWord_C DSM_DInDfp_ADCMon_C DSM_DInDfp_EngMCaS1_C DSM_DInDfp_EngMCrS1_C DSM_DInDfp_FrmMngParkConsumer_C DSM_DInDfp_InjVlvBnk1A_C DSM_DInDfp_InjVlvBnk1B_C DSM_DInDfp_InjVlvBnk2A_C DSM_DInDfp_InjVlvBnk2B_C DSM_DInDfp_InjVlvChipA_C DSM_DInDfp_InjVlvChipB_C DSM_DInDfp_InjVlvCyl1A_C DSM_DInDfp_InjVlvCyl1B_C DSM_DInDfp_InjVlvCyl2A_C DSM_DInDfp_InjVlvCyl2B_C DSM_DInDfp_InjVlvCyl3A_C DSM_DInDfp_InjVlvCyl3B_C DSM_DInDfp_InjVlvCyl4A_C DSM_DInDfp_InjVlvCyl4B_C DSM_DInDfp_InjVlvCyl5A_C DSM_DInDfp_InjVlvCyl5B_C DSM_DInDfp_InjVlvCyl6A_C DSM_DInDfp_InjVlvCyl6B_C DSM_DInDfp_InjVlvCyl7A_C DSM_DInDfp_InjVlvCyl7B_C DSM_DInDfp_InjVlvCyl8A_C DSM_DInDfp_InjVlvCyl8B_C DSM_DInDfp_MeUnCD_ADC_C DSM_DInDfp_MeUnCDNoLoad_C DSM_DInDfp_MeUnCDSCBat_C DSM_DInDfp_MeUnCDSCGnd_C DSM_DInDfp_MeUnCD_SigTst_C DSM_DInDfp_MSidCD_Comm_C DSM_DInDfp_MSidCD_Pin_C DSM_DInDfp_MSidCD_Select_C DSM_DInDfp_MSidCD_Sel_INI_C DSM_DInDfp_PCVCD_ADC_C DSM_DInDfp_PCVCDNoLoad_C DSM_DInDfp_PCVCDSCBat_C DSM_DInDfp_PCVCDSCGnd_C DSM_DInDfp_PCVCD_SigTst_C DSM_DInDfp_RailCD_C DSM_DInDfp_RailCD_PMonStrt_C DSM_DInDfp_RailCtlModeMeUnDiag_C DSM_DInDfp_RailCtlModePCVDiag_C DSM_DInDfp_RailMeUn0_C DSM_DInDfp_RailMeUn1_C DSM_DInDfp_RailMeUn2_C DSM_DInDfp_RailMeUn3_C DSM_DInDfp_RailMeUn4_C DSM_DInDfp_RailPCV0_C DSM_DInDfp_RailPCV1_C DSM_DInDfp_RailPCV2_C DSM_DInDfp_RailPCV3_C DSM_DInDfp_RailPCV4_C DSM_DInDfp_RailPCV5_C DSM_DInDfp_RTMMon_C DSM_DInDfp_TPUMon_C DSM_InhDfp_ACC_PlausTrqDes_C DSM_InhDfp_ACTrq_C DSM_InhDfp_ADCMon_C DSM_InhDfp_AFSCD_PlSetyDrft_C DSM_InhDfp_AFSCD_SRCAirTemp_C DSM_InhDfp_AFSCD_SRCBatt_C DSM_InhDfp_AFSCD_SRCCorrAirm_C DSM_InhDfp_AFSCD_SRCRawAirm_C DSM_InhDfp_AFSCD_SRCRefSigPer_C DSM_InhDfp_AirCtl_GovNegDev_C DSM_InhDfp_AirCtl_GovNegDev2_C DSM_InhDfp_AirCtl_GovPosDev_C DSM_InhDfp_AirCtl_GovPosDev2_C DSM_InhDfp_AltCD_C DSM_InhDfp_AOHtCD_AOHtDia1_C DSM_InhDfp_AOHtCD_C DSM_InhDfp_APP1_C DSM_InhDfp_APP2_C DSM_InhDfp_APSCD_C DSM_InhDfp_ARS_C DSM_InhDfp_BPACD_Max_C DSM_InhDfp_BPACD_Min_C DSM_InhDfp_BPACD_SigNpl_C DSM_InhDfp_BPSCD_C DSM_InhDfp_BrkCD_C DSM_InhDfp_CmbChbMisfireMul_C DSM_InhDfp_CmbChbMisfire1_C DSM_InhDfp_CmbChbMisfire2_C DSM_InhDfp_CmbChbMisfire3_C DSM_InhDfp_CmbChbMisfire4_C DSM_InhDfp_CmbChbMisfire5_C DSM_InhDfp_CmbChbMisfire6_C DSM_InhDfp_ConvCD_C DSM_InhDfp_CrCCDMFL_C DSM_InhDfp_CrCtl_vCrCtl_C DSM_InhDfp_CTSCD_C DSM_InhDfp_EATSCD_C DSM_InhDfp_EBTSCD_C DSM_InhDfp_EGRCD_Max_C DSM_InhDfp_EGRCD_Min_C DSM_InhDfp_EGRCD_SigNpl_C DSM_InhDfp_EngMCaS1_C DSM_InhDfp_EngMCrS1_C DSM_InhDfp_FanCD_C DSM_InhDfp_FanCD_FanCtlr1_C DSM_InhDfp_FBCqDvt_C DSM_InhDfp_FrmMngDMANFAFS_C DSM_InhDfp_FrmMngDRMANFSSG_C DSM_InhDfp_FrmMngLENKRADWINKEL_C DSM_InhDfp_FrmMngMILEAGE_RANGE_C DSM_InhDfp_FrmMngOPCRCTLACC_C DSM_InhDfp_FrmMngParkConsumer_C DSM_InhDfp_FrmMngSTAT_ARS_C DSM_InhDfp_FrmMngSTAT_DSC_C DSM_InhDfp_FrmMngSTAT_KOMBI_C DSM_InhDfp_FrmMngStOBDGbxMilOf_C DSM_InhDfp_FrmMngStOBDGbxMilOn_C DSM_InhDfp_FrmMngTERMINAL_C DSM_InhDfp_FrmMngTORQUE_DSC_C DSM_InhDfp_FrmMngTORQUE_GEARBX_C DSM_InhDfp_FrmMngTrq_ReqACC_C DSM_InhDfp_FrmMngWHEEL_SPEED_C DSM_InhDfp_FTSCD_C DSM_InhDfp_IATSCD_CATS_C DSM_InhDfp_ImmCtlImmCD_C DSM_InhDfp_ImmCtlImmEep_C DSM_InhDfp_ImmCtlMpl_C DSM_InhDfp_IndSys1_C DSM_InhDfp_IndSys2_C DSM_InhDfp_InjVCDActrChrg_C DSM_InhDfp_InjVCDActrVolt_C DSM_InhDfp_InjVCD_CY370Ampl_C DSM_InhDfp_InjVCDMonCab_C DSM_InhDfp_InjVCDMonSwt_C DSM_InhDfp_InjVCDShOffDCDC_C DSM_InhDfp_InjVCDUBuf_C DSM_InhDfp_InjVlvBnk1A_C DSM_InhDfp_InjVlvBnk1B_C DSM_InhDfp_InjVlvBnk2A_C DSM_InhDfp_InjVlvBnk2B_C DSM_InhDfp_InjVlvChipA_C DSM_InhDfp_InjVlvChipB_C DSM_InhDfp_InjVlvCyl1A_C DSM_InhDfp_InjVlvCyl1B_C DSM_InhDfp_InjVlvCyl1C_C DSM_InhDfp_InjVlvCyl2A_C DSM_InhDfp_InjVlvCyl2B_C DSM_InhDfp_InjVlvCyl2C_C DSM_InhDfp_InjVlvCyl3A_C DSM_InhDfp_InjVlvCyl3B_C DSM_InhDfp_InjVlvCyl3C_C DSM_InhDfp_InjVlvCyl4A_C DSM_InhDfp_InjVlvCyl4B_C DSM_InhDfp_InjVlvCyl4C_C DSM_InhDfp_InjVlvCyl5A_C DSM_InhDfp_InjVlvCyl5B_C DSM_InhDfp_InjVlvCyl5C_C DSM_InhDfp_InjVlvCyl6A_C DSM_InhDfp_InjVlvCyl6B_C DSM_InhDfp_InjVlvCyl6C_C DSM_InhDfp_InjVlvCyl7A_C DSM_InhDfp_InjVlvCyl7B_C DSM_InhDfp_InjVlvCyl7C_C DSM_InhDfp_InjVlvCyl8A_C DSM_InhDfp_InjVlvCyl8B_C DSM_InhDfp_InjVlvCyl8C_C DSM_InhDfp_MeUnCD_ADC_C DSM_InhDfp_MeUnCDNoLoad_C DSM_InhDfp_MeUnCDSCBat_C DSM_InhDfp_MeUnCDSCGnd_C DSM_InhDfp_MeUnCD_SigTst_C DSM_InhDfp_Montr_C DSM_InhDfp_MSidCD_Comm_C DSM_InhDfp_MSidCD_Pin_C DSM_InhDfp_MSidCD_Select_C DSM_InhDfp_MSidCD_Sel_INI_C DSM_InhDfp_OvRMonBrk_C DSM_InhDfp_PCR_GovDevNeg_C DSM_InhDfp_PCR_GovDevPos_C DSM_InhDfp_PCVCD_ADC_C DSM_InhDfp_PCVCDNoLoad_C DSM_InhDfp_PCVCDSCBat_C DSM_InhDfp_PCVCDSCGnd_C DSM_InhDfp_PCVCD_SigTst_C DSM_InhDfp_RailCD_C DSM_InhDfp_RailCDOfsTst_C DSM_InhDfp_RailCD_PMonStrt_C DSM_InhDfp_RailCtlModeMeUnDiag_C DSM_InhDfp_RailCtlModePCVDiag_C DSM_InhDfp_RailMeUn0_C DSM_InhDfp_RailMeUn1_C DSM_InhDfp_RailMeUn2_C DSM_InhDfp_RailMeUn3_C DSM_InhDfp_RailMeUn4_C DSM_InhDfp_RailPCV0_C DSM_InhDfp_RailPCV1_C DSM_InhDfp_RailPCV2_C DSM_InhDfp_RailPCV3_C DSM_InhDfp_RailPCV4_C DSM_InhDfp_RailPCV5_C DSM_InhDfp_RTMMon_C DSM_InhDfp_SOPTst_C DSM_InhDfp_SSpMon1_C DSM_InhDfp_SSpMon2_C DSM_InhDfp_SSpMon3_C DSM_InhDfp_SysLamp_C DSM_InhDfp_TGearbx_C DSM_InhDfp_TPUMon_C DSM_InhDfp_T15CD_C DSM_InhDfp_VSACD_Max_C DSM_InhDfp_VSACD_Min_C DSM_InhDfp_VSACD_SigNpl_C DSM_InhDfp_VSSCD1_C DSM_InhDfp_VSSCD2_C DSM_SdwDfp_APP2_C DSM_SdwDfp_FrmMngDRMANFSSG_C DSM_SdwDfp_FrmMngOPCRCTLACC_C DSM_SdwDfp_FrmMngTORQUE_DSC_C DSM_SdwDfp_FrmMngTORQUE_GEARBX_C DSM_SdwDfp_FrmMngTrq_ReqACC_C EATSCD_numAdc_C EBAFCD_numDiaOut_C EBAFCD_numDioOut_C EBFCD_numDiaOut_C EBFCD_numDioOut_C EBTSCD_DebSRCHighDef_C EBTSCD_DebSRCLowDef_C EBTSCD_dtRmpSlpDwn_C EBTSCD_dtRmpSlpUp_C EBTSCD_numAdc_C EBTSCD_OvrDebSRCHighDef_C EBTSCD_stSensIDWord_C EBTSCD_tDfl_C EBTSCD_tiTECUPT1_C EBTSCD_tLin_CUR EBTSCD_tOvrTemp_C EBTSCD_uSRCMax_C EBTSCD_uSRCMin_C ECU_vPrgThres_C EGPpCD_numDia_C EGPpCD_numDioOut_C EGRCD_DebExcTempDef_C EGRCD_DebNoLoadDef_C EGRCD_DebShortCircBatDef_C EGRCD_DebShortCircGndDef_C EGRCD_numDia_C EGRCD_numPwmOut_C EGRCD_stPwrStgDia_C EGRVlv_rEGR_Channel EGRVlv_rEGR_Vector EGRVlv_rEGR2_Channel EGRVlv_rEGR2_Vector EGSys_swtPresSel_C EGT_stTSync_Channel EGT_stTSync_Vector EngM_ctOfsCaSCrS_C EngM_ctPhWhlRev_C EngM_ctPostSync_C EngM_ctReSync_C EngM_ctSpdtoZero_C EngM_ctVerSync_C EngM_DebIncCaSErrSigDef_C EngM_DebIncCaSErrSigOK_C EngM_DebIncCaSNoSigDef_C EngM_DebIncCrSErrSigDef_C EngM_DebIncCrSErrSigOK_C EngM_DebIncOfsSigCaSCrSDef_C EngM_DebPhCrSErrSigDef_C EngM_dLimitCond_ASD_CA EngM_dLimitCond_Common_CA EngM_dLimitCond_FBC_CA EngM_dLimitCond_Joint_CA EngM_dLimitCond_LiGov_CA EngM_dLimitCond_Pilot_CA EngM_nLimitInj_C EngM_nLimitThresh_CA EngM_nLimitThreshHyst_CA EngM_nMaxStrtBackUp_C EngM_nMaxStrt_C EngM_nMinDiag_C EngM_nSwtCoMa_C EngM_numDiaOut_C EngM_numDioOut_C EngM_numLimitInj_C EngM_numPin_C EngM_nWaitIncSig_C EngM_phiDelayPhNoSig_C EngM_phiDelta_C EngM_phiDeltaExtSync_C EngM_phiFrstInjInt_C EngM_phiInt_C EngM_phiMax_C EngM_phiTDC_C EngM_stBackUpVar_C EngM_stEnaBackUp_C EngM_stSyncBefGap_C EngM_swtExitOfs_C EngM_swtFirSeqFBC_C EngM_swtNumCylType_C EngM_swtNumCylVal_C EngM_swtSyncViaCAN_C EngM_tiCpuTimeOut_C EngM_tiDiffInt_C EngM_tiWaitIncSig_C EngM_trqFrc_Channel EngM_trqFrc_Vector EngPrt_nOvrSpd_C EngPrt_qPrtLim_Channel EngPrt_qPrtLim_Vector EngPrt_trqNLim_Channel EngPrt_trqNLim_Vector EngPrt_trqPrtLim_Channel EngPrt_trqPrtLim_Vector ErLpCD_numDiaErrLmp_C ErLpCD_numDiaSysLmp_C ErLpCD_numDioOutErrLmp_C ErLpCD_numDioOutSysLmp_C ESS_nBattMin_C ETClb_DebETMaxDefect_C ETClb_DebETMaxOk_C ETClb_DebETMinDefect_C ETClb_DebETMinOk_C ETClb_numCyclMeas_C ETClb_numCyclStartEnergize_C ETClb_pRailSet_CA ETClb_SigThres_CA ETClb_tiET_MAX_CA ETClb_tiET_MIN_CA ETClb_volEffectiveMin_CA ExeMon_stEnaTst_C FanCD_DebShortCircGndDef_C FanCD_numDia_C FanCD_numPwmOut_C FanCD_tiBtwTst_C FanCD_tiFanCtlr2Max_C FanCD_tiFanCtlr2Min_C FanCD_tiFanCtlr3Max_C FanCD_tiFanCtlr3Min_C FBC_lrn_Channel FBC_lrn_Vector FBC_q_Channel FBC_q_Vector FlFCD_numDioIn_C FlMng_swtFullLdRglType_C FlMng_swtFullLdRglVal_C FlSys_nDeflateMax_C FlSys_nDeflateMin_C FlSys_pDeflate_C FlSys_rhoFl_C FlSys_rhoFl_CUR FlSys_swtTempSensCfgType_C FlSys_tiDeflateDel_C FMTC_trq2qBas_MAP FMTC_trq2qRgn1_MAP FMTC_trq2qRgn2_MAP FrmMng_aSideDef_C FrmMng_cnvAccmLimTrq_Offset_C FrmMng_cnvAccmLimTrq_Slope_C FrmMng_cnvACCtrq_Offset_C FrmMng_cnvACCtrq_Slope_C FrmMng_cnvAFStrq_Offset_C FrmMng_cnvAFStrq_Slope_C FrmMng_cnvAipEng_Offset_C FrmMng_cnvAipEng_Slope_C FrmMng_cnvAngAcpd_Offset_C FrmMng_cnvAngAcpd_Slope_C FrmMng_cnvARStrq_Offset_C FrmMng_cnvARStrq_Slope_C FrmMng_cnvAVA_DSC_Offset_C FrmMng_cnvAVA_DSC_Slope_C FrmMng_cnv_BattCls_Offset_C FrmMng_cnv_BattCls_Slope_C FrmMng_cnvDSCtrq_Offset_C FrmMng_cnvDSCtrq_Slope_C FrmMng_cnvFLLV_FUTA_Offset_C FrmMng_cnvFLLV_FUTA_Slope_C FrmMng_cnv_HiLimCurr_Offset_C FrmMng_cnv_HiLimCurr_Slope_C FrmMng_cnvIjvFu_Offset_C FrmMng_cnvIjvFu_Slope_C FrmMng_cnvKOMBIv_Offset_C FrmMng_cnvKOMBIv_Slope_C FrmMng_cnv_LoLimCurr_Offset_C FrmMng_cnv_LoLimCurr_Slope_C FrmMng_cnvnSetPoint_Slope_C FrmMng_cnvRpmEng_Offset_C FrmMng_cnvRpmEng_Slope_C FrmMng_cnvRqamFu_Offset_C FrmMng_cnvRqamFu_Slope_C FrmMng_cnvTempEng_Offset_C FrmMng_cnvTempEng_Slope_C FrmMng_cnvTEMP_EX_Offset_C FrmMng_cnvTEMP_EX_Slope_C FrmMng_cnvtOil_Offset_C FrmMng_cnvtOil_Slope_C FrmMng_cnvTrqAvl_Offset_C FrmMng_cnvTrqAvl_Slope_C FrmMng_cnvTrqDvch_Offset_C FrmMng_cnvTrqDvch_Slope_C FrmMng_cnvtrq_Offset_C FrmMng_cnvtrq_Slope_C FrmMng_cnvvMrk_Offset_C FrmMng_cnvvMrk_Slope_C FrmMng_cnvvPrgNo_Offset_C FrmMng_cnvvPrgNo_Slope_C FrmMng_cnvV_VEH_Offset_C FrmMng_cnvV_VEH_Slope_C FrmMng_cnv_ZrCurrLim_Offset_C FrmMng_cnv_ZrCurrLim_Slope_C FrmMng_ctDebAlvDMANFAFSDef_C FrmMng_ctDebCsDMANFAFSDef_C FrmMng_ctDebSigDMANFAFSDef_C FrmMng_ctDebToDMANFAFSDef_C FrmMng_ctDebToWHEEL_SPEEDDef_C FrmMng_DebACTrqDef_C FrmMng_DebAlvDMOMENT_ACCDef_C FrmMng_DebAlvOPCRCTLACCDef_C FrmMng_DebAlvSTAT_ARSDef_C FrmMng_DebAlvSTAT_KOMBIDef_C FrmMng_DebAlvTORQUE_DSCDef_C FrmMng_DebAlvTORQUE_GEARBXDef_C FrmMng_DebCsDMOMENT_ACCDef_C FrmMng_DebCsOPCRCTLACCDef_C FrmMng_DebCsTORQUE_DSCDef_C FrmMng_DebCsTORQUE_GEARBXDef_C FrmMng_DebSigDMOMENT_ACCDef_C FrmMng_DebSigMILEAGE_RANGEDef_C FrmMng_DebSigOPCRCTLACCDef_C FrmMng_DebSigSTAT_ARSDef_C FrmMng_DebSigSTAT_DSCDef_C FrmMng_DebSigSTAT_KOMBIDef_C FrmMng_DebSigTORQUE_DSCDef_C FrmMng_DebSigTORQUE_GEARBXDef_C FrmMng_DebToDMOMENT_ACCDef_C FrmMng_DebToMILEAGE_RANGEDef_C FrmMng_DebToOPCRCTLACCDef_C FrmMng_DebToSTAT_ARSDef_C FrmMng_DebToSTAT_DSCDef_C FrmMng_DebToSTAT_KOMBIDef_C FrmMng_DebToTORQUE_DSCDef_C FrmMng_DebToTORQUE_GEARBXDef_C FrmMng_dstGear_C FrmMng_dtrqOvrRunRmpDwn_C FrmMng_numCCAddLevlNum_C FrmMng_numCCbtnachNum_C FrmMng_numCCbttdfkNum_C FrmMng_numCCbttkntNum_C FrmMng_numCCGenDef2Num_C FrmMng_numCCNoCrCtlNum_C FrmMng_numCCOelLevlNum_C FrmMng_numCCOelVerbNum_C FrmMng_numCCOelVerlNum_C FrmMng_numCCOilPresNum_C FrmMng_numCCOvrTempNum_C FrmMng_numCCOvrTem2Num_C FrmMng_numCCPFltDefNum_C FrmMng_numCCpmerrNum_C FrmMng_numCCPreGlowNum_C FrmMng_numCCprioNum_C FrmMng_numCCruhverNum_C FrmMng_numCCStatMilLmpTstNum_C FrmMng_numCCStatMilNum_C FrmMng_numCCSysLampNum_C FrmMng_numInqyID_C FrmMng_stClCtrDEF_C FrmMng_stConvErr_C FrmMng_stT50Def_C FrmMng_swtDMOMENT_ACC_C FrmMng_swtDRMANFSSG_C FrmMng_tiCCAddLevlCycle_C FrmMng_tiCCbtnachCycle_C FrmMng_tiCCbttdfkCycle_C FrmMng_tiCCbttkntCycle_C FrmMng_tiCCGenDef2Cycle_C FrmMng_tiCCNoCrCtlCycle_C FrmMng_tiCCOelLevlCycle_C FrmMng_tiCCOelVerbCycle_C FrmMng_tiCCOelVerlCycle_C FrmMng_tiCCOilPresCycle_C FrmMng_tiCCOvrTempCycle_C FrmMng_tiCCOvrTem2Cycle_C FrmMng_tiCCPFltDefCycle_C FrmMng_tiCCpmerrCycle_C FrmMng_tiCCPreGlowCycle_C FrmMng_tiCCprioCycle_C FrmMng_tiCCruhverCycle_C FrmMng_tiCCStatMilCycle_C FrmMng_tiCCStatMilLmpTstCycle_C FrmMng_tiCCSysLampCycle_C FrmMng_tiCCTxDeb_C FrmMng_trqGearbxMaxSubs_C FTSCD_numAdc_C Gearbx_amMax_C Gearbx_nMin_MAP Gearbx_rTransR_C Gearbx_rTrans1_C Gearbx_rTrans2_C Gearbx_rTrans3_C Gearbx_rTrans4_C Gearbx_rTrans5_C Gearbx_rTrans6_C Gearbx_swtUnplausChk_C Gearbx_trqDecMax_C Gearbx_trqDecMax_CUR Gearbx_trqIncMin_C Gearbx_trqInMax_Channel Gearbx_trqInMax_Vector GearCD_numDioIn_C HPUn_nMin_C HPUn_pRailDvtOk_C HPUn_qBalLim_CUR HPUn_qFlTempLim_MAP HWEMon_DebComDef_C HWEMon_DebComOk_C HWEMon_DebComStepDown_C HWEMon_DebComStepUp_C HWEMon_numTrigRecovery_C IATSCD_DebSigDef_C IATSCD_DebSRCHighDef_C IATSCD_DebSRCLowDef_C IATSCD_numAdc_C IATSCD_numAdcCats_C IndSys_rVSAAdd_Channel IndSys_rVSAAdd_Vector IndSys_rVSA_Channel IndSys_rVSA_Vector InjCrv_DebLimDef_C InjCrv_DebLimOk_C InjCrv_numInjMaxSys_C InjCrv_phiMI1DesAdd_Channel InjCrv_phiMI1DesAdd_Vector InjCrv_phiMI1Des_Channel InjCrv_phiMI1Des_Vector InjCrv_phiMI1Max_MAP InjCrv_phiMI1Rgn_Channel InjCrv_phiMI1Rgn_Vector InjCrv_phiPiIMax_C InjCrv_phiPiI1DesAdd_Channel InjCrv_phiPiI1DesAdd_Vector InjCrv_phiPiI1Des_Channel InjCrv_phiPiI1Des_Vector InjCrv_phiPiI1Rgn_Channel InjCrv_phiPiI1Rgn_Vector InjCrv_phiPiI2DesAdd_Channel InjCrv_phiPiI2DesAdd_Vector InjCrv_phiPiI2Des_Channel InjCrv_phiPiI2Des_Vector InjCrv_phiPiI2Rgn_Channel InjCrv_phiPiI2Rgn_Vector InjCrv_phiPiI3DesAdd_Channel InjCrv_phiPiI3DesAdd_Vector InjCrv_phiPiI3Des_Channel InjCrv_phiPiI3Des_Vector InjCrv_phiPoI1DesAdd_Channel InjCrv_phiPoI1DesAdd_Vector InjCrv_phiPoI1Des_Channel InjCrv_phiPoI1Des_Vector InjCrv_phiPoI1Max_C InjCrv_phiPoI1Rgn_Channel InjCrv_phiPoI1Rgn_Vector InjCrv_phiPoI2_Channel InjCrv_phiPoI2Min_C InjCrv_phiPoI2Rgn_Channel InjCrv_phiPoI2Rgn_Vector InjCrv_phiPoI2_Vector InjCrv_qMI1DesAdd_Channel InjCrv_qMI1DesAdd_Vector InjCrv_qMI1Des_Channel InjCrv_qMI1Des_Vector InjCrv_qMI1Rgn_Channel InjCrv_qMI1Rgn_Vector InjCrv_qPiI1DesAdd_Channel InjCrv_qPiI1DesAdd_Vector InjCrv_qPiI1Des_Channel InjCrv_qPiI1Des_Vector InjCrv_qPiI1Rgn_Channel InjCrv_qPiI1Rgn_Vector InjCrv_qPiI1SetByp_Channel InjCrv_qPiI1SetByp_Vector InjCrv_qPiI2DesAdd_Channel InjCrv_qPiI2DesAdd_Vector InjCrv_qPiI2Des_Channel InjCrv_qPiI2Des_Vector InjCrv_qPiI2Rgn_Channel InjCrv_qPiI2Rgn_Vector InjCrv_qPiI2SetByp_Channel InjCrv_qPiI2SetByp_Vector InjCrv_qPiI3DesAdd_Channel InjCrv_qPiI3DesAdd_Vector InjCrv_qPiI3Des_Channel InjCrv_qPiI3Des_Vector InjCrv_qPoI1DesAdd_Channel InjCrv_qPoI1DesAdd_Vector InjCrv_qPoI1Des_Channel InjCrv_qPoI1Des_Vector InjCrv_qPoI1Rgn_Channel InjCrv_qPoI1Rgn_Vector InjCrv_qPoI2Des_Channel InjCrv_qPoI2Des_Vector InjCrv_qPoI2Eff_Channel InjCrv_qPoI2Eff_Vector InjCrv_qPoI2Rgn_Channel InjCrv_qPoI2Rgn_Vector InjCrv_stInjCharSetVal_Channel InjCrv_stInjCharSetVal_Vector InjCrv_stPiIRlsBypass_Channel InjCrv_stPiIRlsBypass_Vector InjCrv_tiPause_C InjCrv_tiPiIMax_C InjCrv_tiPiI1DesAdd_Channel InjCrv_tiPiI1DesAdd_Vector InjCrv_tiPiI1Des_Channel InjCrv_tiPiI1Des_Vector InjCrv_tiPiI1Rgn_Channel InjCrv_tiPiI1Rgn_Vector InjCrv_tiPiI2DesAdd_Channel InjCrv_tiPiI2DesAdd_Vector InjCrv_tiPiI2Des_Channel InjCrv_tiPiI2Des_Vector InjCrv_tiPiI2Rgn_Channel InjCrv_tiPiI2Rgn_Vector InjCrv_tiPoI2_Channel InjCrv_tiPoI2Max_MAP InjCrv_tiPoI2Min_C InjCrv_tiPoI2Rgn_Channel InjCrv_tiPoI2Rgn_Vector InjCrv_tiPoI2_Vector InjCtl_qCurr_Channel InjCtl_qCurr_Vector InjCtl_qLimErr_CUR InjCtl_qLimErr_MAP InjCtl_qRaw_Channel InjCtl_qRaw_Vector InjCtl_qSet_Channel InjCtl_qSet_Vector InjUn_nInjLock_C InjUn_phiTstShOffPathSet_C InjUn_tiTstShOffPathET_C InjVCD_ctThres_C InjVCD_ctThresShOffDCDCEv_C InjVCD_DebActrEnrgDef_C InjVCD_DebActrEnrgOK_C InjVCD_DebDCDCLowDef_C InjVCD_DebDCDCStartDef_C InjVCD_DebUBufSRCHighDef_C InjVCD_DebUBufSRCHighOk_C InjVCD_DebUBufSRCLowDef_C InjVCD_DebUBufSRCLowOk_C InjVCD_duInt_C InjVCD_facMonUThresHiPl_CA InjVCD_facMonUThresLoPl_CA InjVCD_facWActrChrgCorr_C InjVCD_facWActrCorr_C InjVCD_facWActrDisChCorr_C InjVCD_facWActrDvtMax_C InjVCD_facWActrDvtMin_C InjVCD_fPolar_C InjVCD_nClsEng_C InjVCD_nEngMonShCir_C InjVCD_nETMaxLim_C InjVCD_numCollTyp_C InjVCD_numCylTestBench_C InjVCD_numFacWValidMin_C InjVCD_numPolar_C InjVCD_numWValidMin_C InjVCD_pClsRailMax_C InjVCD_pRailMonShCirMax_C InjVCD_rCapUpTolc_C InjVCD_rClsVoltMin_C InjVCD_resCalcChrgShunt_C InjVCD_rMonShCirTiChrgUpTolc_C InjVCD_rTiChrgUpTolc_C InjVCD_rZFCETDif2_GMAP InjVCD_stCY370RcyTst_C InjVCD_swtEnaAgDiff_C InjVCD_swtEnaWActrCorr_C InjVCD_swtEvMgmt_C InjVCD_swtSelTempType_C InjVCD_swtSelTempVal_C InjVCD_swtShOffDCDCTst_C InjVCD_tActr_CUR InjVCD_tActrDfl_C InjVCD_tiClsLead_C InjVCD_tiClsMeasBeg_C InjVCD_tiClsMeasEnd_C InjVCD_tiClsMeasure_C InjVCD_tiET_MAP InjVCD_tiETMax_C InjVCD_tiETMinHigh_C InjVCD_tiETMinLow_C InjVCD_tiHoldMin_C InjVCD_tiLeadJit_C InjVCD_tiLeadPost1_C InjVCD_tiLeadPost2_C InjVCD_tiLeadPost3_C InjVCD_tiLeadPost4_C InjVCD_tiLeadPre1_C InjVCD_tiLeadPre2_C InjVCD_tiLeadPre3_C InjVCD_tiLeadPre4_C InjVCD_tiMI1ET_Channel InjVCD_tiMI1ET_Vector InjVCD_tiMi1ThresLo_C InjVCD_tiMonET_C InjVCD_tiMonLead_C InjVCD_tiMonThresHiPlaus_C InjVCD_tiMonThresLoPlaus_C InjVCD_tiPiI1ET_Channel InjVCD_tiPiI1ET_Vector InjVCD_tiPiI2ET_Channel InjVCD_tiPiI2ET_Vector InjVCD_tiPoI1ET_Channel InjVCD_tiPoI1ET_Vector InjVCD_tiPoI2ET_Channel InjVCD_tiPoI2ET_Vector InjVCD_tiPolarET_C InjVCD_tiPolarLead_C InjVCD_uActrLin_CUR InjVCD_uActrThrSRCHi_C InjVCD_uActrThrSRCLo_C InjVCD_uBufCLoLim_C InjVCD_uBufLin_CUR InjVCD_uBufSRCMax_C InjVCD_uBufSRCMin_C InjVCD_uChrgLin_CUR InjVCD_uChrgThrSRCHi_C InjVCD_uChrgThrSRCLo_C InjVCD_uCY370Lin_CUR InjVCD_uCY370ThrSRCHi_C InjVCD_uCY370ThrSRCLo_C InjVCD_uShOffBufThres_C InjVCD_wActrChrgDfl_C InjVCD_wActrDiffPlausMax_C InjVCD_wActrDiffPlausMin_C InjVCD_wActrDisChDfl_C InjVCD_wActrNom_CUR InjVCD_wActrPlausMax_C InjVCD_wActrPlausMin_C InjVlv_ctMonQckThres_C InjVlv_ctMonQckThresLo_C InjVlv_DebBnkA0Def_C InjVlv_DebBnkA0Ok_C InjVlv_DebBnkA1Def_C InjVlv_DebBnkA1Ok_C InjVlv_DebBnkA2Def_C InjVlv_DebBnkA2Ok_C InjVlv_DebBnkA3Def_C InjVlv_DebBnkA3Ok_C InjVlv_DebBnkB0Def_C InjVlv_DebBnkB0Ok_C InjVlv_DebBnkB1Def_C InjVlv_DebBnkB1Ok_C InjVlv_DebBnkB2Def_C InjVlv_DebBnkB2Ok_C InjVlv_DebBnkB3Def_C InjVlv_DebBnkB3Ok_C InjVlv_DebChipA0Def_C InjVlv_DebChipA0Ok_C InjVlv_DebChipA1Def_C InjVlv_DebChipA1Ok_C InjVlv_DebChipA2Def_C InjVlv_DebChipA2Ok_C InjVlv_DebChipA3Def_C InjVlv_DebChipA3Ok_C InjVlv_DebChipB0Def_C InjVlv_DebChipB0Ok_C InjVlv_DebChipB1Def_C InjVlv_DebChipB1Ok_C InjVlv_DebChipB2Def_C InjVlv_DebChipB2Ok_C InjVlv_DebChipB3Def_C InjVlv_DebChipB3Ok_C InjVlv_DebCylA0Def_C InjVlv_DebCylA0Ok_C InjVlv_DebCylA1Def_C InjVlv_DebCylA1Ok_C InjVlv_DebCylA2Def_C InjVlv_DebCylA2Ok_C InjVlv_DebCylA3Def_C InjVlv_DebCylA3Ok_C InjVlv_DebCylB0Def_C InjVlv_DebCylB0Ok_C InjVlv_DebCylB1Def_C InjVlv_DebCylB1Ok_C InjVlv_DebCylB2Def_C InjVlv_DebCylB2Ok_C InjVlv_DebCylB3Def_C InjVlv_DebCylB3Ok_C InjVlv_DebCylC0Def_C InjVlv_DebCylC0Ok_C InjVlv_DebCylC1Def_C InjVlv_DebCylC1Ok_C InjVlv_DebCylC2Def_C InjVlv_DebCylC2Ok_C InjVlv_DebCylC3Def_C InjVlv_DebCylC3Ok_C InjVlv_facNVCInPI_C InjVlv_facNVCMax_C InjVlv_facNVCMin_C InjVlv_facPCorQ_CUR InjVlv_facPCorTi_CUR InjVlv_facVoltCorUp_MAP InjVlv_iDCDC_CUR InjVlv_iMonDisChDwn_C InjVlv_nMonQckThresLo_C InjVlv_numClsVltgAdjMax_C InjVlv_numClsVltgAdjMin_C InjVlv_numInjChrgBal_MAP InjVlv_numNoLoadCylMax_C InjVlv_NVCIKi_C InjVlv_NVCIKiNeg_C InjVlv_NVCIKiPos_C InjVlv_NVCPKp_C InjVlv_NVCPKpNeg_C InjVlv_NVCPKpPos_C InjVlv_pCorBase_CUR InjVlv_pMin_C InjVlv_pMin_CUR InjVlv_pNVCMax_C InjVlv_pNVCMin_C InjVlv_pRailDfl_C InjVlv_qWvCorMax_C InjVlv_qWvCorMin_C InjVlv_rChrgBalPwrHys_C InjVlv_rChrgBalVltgHys_C InjVlv_stBufCInjLimYHigh_C InjVlv_stBufCInjLimYLow_C InjVlv_stErrMskPattern_C InjVlv_stErrMskSelect_C InjVlv_stMonQckEna_C InjVlv_stPWvCorMsk_C InjVlv_stQntAdj_MAP InjVlv_tActrDfl_C InjVlv_tiNVCDwnThres_C InjVlv_tiNVCUpThres_C InjVlv_tNVCEngMax_C InjVlv_tNVCEngMin_C InjVlv_uBufCInjLimXHigh_C InjVlv_uBufCInjLimXLow_C InjVlv_uDiffNVCSet_CUR InjVlv_uMonBattThres_C InjVlv_uNVCIWinNeg_C InjVlv_uNVCIWinPos_C InjVlv_uNVCPWinNeg_C InjVlv_uNVCPWinPos_C InjVlv_uNVCThres_C InjVlv_uOfs_C InjVlv_uSetBott_C InjVlv_uSetUpNVCActrMax_C InjVlv_uSetUpNVCActrMin_C InjVlv_uSetUpPress0_CUR InjVlv_uSetUpPress1_CUR InjVlv_uSetUpPress10_CUR InjVlv_uSetUpPress11_CUR InjVlv_uSetUpPress12_CUR InjVlv_uSetUpPress13_CUR InjVlv_uSetUpPress14_CUR InjVlv_uSetUpPress15_CUR InjVlv_uSetUpPress2_CUR InjVlv_uSetUpPress3_CUR InjVlv_uSetUpPress4_CUR InjVlv_uSetUpPress5_CUR InjVlv_uSetUpPress6_CUR InjVlv_uSetUpPress7_CUR InjVlv_uSetUpPress8_CUR InjVlv_uSetUpPress9_CUR InjVlv_volQntAdjLim_C InjVlv_wInj_CUR IVCtl_ChrgUpIKi_C IVCtl_ChrgUpIKiNeg_C IVCtl_ChrgUpIKiPos_C IVCtl_ChrgUpPKp_C IVCtl_ChrgUpPKpNeg_C IVCtl_ChrgUpPKpPos_C IVCtl_DisChDwnIKi_C IVCtl_DisChDwnIKiNeg_C IVCtl_DisChDwnIKiPos_C IVCtl_DisChDwnPKp_C IVCtl_DisChDwnPKpNeg_C IVCtl_DisChDwnPKpPos_C IVCtl_iChrgUpCls_C IVCtl_iChrgUp_CUR IVCtl_iChrgUpGovMax_C IVCtl_iChrgUpGovMin_C IVCtl_iChrgUpInitI_C IVCtl_iChrgUpMax_C IVCtl_iChrgUpMin_C IVCtl_iDisChDwnCls_C IVCtl_iDisChDwn_CUR IVCtl_iDisChDwnGovMax_C IVCtl_iDisChDwnGovMin_C IVCtl_iDisChDwnInitI_C IVCtl_iDisChDwnMax_C IVCtl_iDisChDwnMin_C IVCtl_IKi_C IVCtl_IKiNeg_C IVCtl_IKiPos_C IVCtl_PKp_C IVCtl_PKpNeg_C IVCtl_PKpPos_C IVCtl_tiChrgSetUp_CUR IVCtl_tiChrgUpIWinNeg_C IVCtl_tiChrgUpIWinPos_C IVCtl_tiChrgUpPse_C IVCtl_tiChrgUpPWinNeg_C IVCtl_tiChrgUpPWinPos_C IVCtl_tiDisChDwnIWinNeg_C IVCtl_tiDisChDwnIWinPos_C IVCtl_tiDisChDwnPse_C IVCtl_tiDisChDwnPWinNeg_C IVCtl_tiDisChDwnPWinPos_C IVCtl_tiDisChSetDwn_CUR IVCtl_uClsActrUp_C IVCtl_uIWinNeg_C IVCtl_uIWinPos_C IVCtl_uMaxSetUp_C IVCtl_uMinSetUp_C IVCtl_uPIMax_C IVCtl_uPIMin_C IVCtl_uPWinNeg_C IVCtl_uPWinPos_C IVCtl_uSetUpPreCtl_CUR IVCtl_uUpInitI_C LIGov_nDeltaSec_C LIGov_nDiffDelta_C LIGov_nLimHigh_C LIGov_nMSDiffMax_C LIGov_nRmpBaseDwn_C LIGov_nRmpCoEngDwn_C LIGov_nRmpGearbxDwn_C LIGov_nRmpHDCDwn_C LIGov_nRmpHDCUp_C LIGov_nRmpPwrMngDwn_C LIGov_nRmpSecDelta_C LIGov_nRmpSurgeDwn_C LIGov_nSetpoint_Channel LIGov_nSetpointTrm_C LIGov_nSetpointTrmLim_C LIGov_nSetpoint_Vector LIGov_trq_Channel LIGov_trq_Vector LSUCD_facPresCompLean_CUR LSUCD_facPresCompRich_CUR LSUCD_facUToRi_C LSUCD_rO2_CUR LSUCD_stHtDis_C LSUCD_stPumpCtlDis_C LSUCD_stPwrStgDia_C LSUCD_stRefPumpDis_C LSUCD_tiHtPer_C LSUCD_tRi_CUR LSUCD_uBattMaxHigh_C LSUCD_uBattMaxLow_C LSUCD_uBattNominal_C LSUCD_uO2Ref_C LSUCD_uRiOfs_C LSUCtl_dcycHtMin_C LSUCtl_dcycRmpUp_C LSUCtl_dcycStrt_CUR LSUCtl_tRiSetPoint_C LSU_rLmbdRec_CUR MemMon_numErrChkRam_C MemMon_numErrChkRom_C MemMon_tiHealChkRam_C MemMon_tiHealChkRom_C MeUnCD_dcycMax_C MeUnCD_dcycMin_C MeUnCD_dcycSetValLin_CUR MeUnCD_dcycTst_C MeUnCD_DebExcTempDef_C MeUnCD_DebExcTempOk_C MeUnCD_DebNoLoadDef_C MeUnCD_DebNoLoadOk_C MeUnCD_DebShortCircBatDef_C MeUnCD_DebShortCircBatOk_C MeUnCD_DebShortCircGndDef_C MeUnCD_DebShortCircGndOk_C MeUnCD_DebSRCHighDef_C MeUnCD_DebSRCHighOk_C MeUnCD_DebSRCLowDef_C MeUnCD_DebSRCLowOk_C MeUnCD_facIGovInit_CUR MeUnCD_facIGovMax_C MeUnCD_facIGovMin_C MeUnCD_IGovDKd_C MeUnCD_IGovIKi_C MeUnCD_IGovIKiNeg_C MeUnCD_IGovIKiPos_C MeUnCD_iIGovIWinNeg_C MeUnCD_iIGovIWinPos_C MeUnCD_iLin_CUR MeUnCD_nDiffMax_C MeUnCD_numAdc_C MeUnCD_numDia1_C MeUnCD_numDia2_C MeUnCD_numPwmOut_C MeUnCD_resCoil_C MeUnCD_stInvOut_C MeUnCD_stPwrStgDia_C MeUnCD_swt_C MeUnCD_tiBtwTst_C MeUnCD_tiFltPT1Init_C MeUnCD_tiFlt1PT1_C MeUnCD_tiFlt2PT1_C MeUnCD_tiIGovDT1_C MeUnCD_tiIGovInit_C MeUnCD_tiPer_CUR MeUnCD_uSRCMax_C MeUnCD_uSRCMin_C MeUn_iCnvFlowRate_CUR MeUn_iSet_Channel MeUn_iSetMin_C MeUn_iSet_Vector MeUn_pActrPrt_C MeUn_pFlowOfFl_C MRlyCD_ctTooEarlyThres_C MRlyCD_numDioOutMnRly_C MRlyCD_numDioOutPSOFF_C MRlyCD_stInvOut_C MRlyCD_tiNotOpen_C MSidCD_Comm_DebNplDef_C MSidCD_numECUS_C MSidCD_Select_DebNplDef_C MSidCD_Select_DebNplOk_C MSidCD_stErrInjOFF_C MSidCD_swtCanDeb_C MSidCD_swtMAIN_C MSidCD_tiCanDeb_C NetMng_CANFadeOutMaskA_C NetMng_CANFadeOutMaskB_C NetMng_ctBusOffRetriesA_C NetMng_ctBusOffRetriesB_C NetMng_ctInitRetryCanA_C NetMng_ctInitRetryCanB_C NetMng_FadeOutMaskA_C NetMng_FadeOutMaskB_C NetMng_SplyVltgHysYHigh_C NetMng_SplyVltgHysYLow_C NetMng_swtONWM_C NetMng_tiDebNegBusMonCanA_C NetMng_tiDebNegBusMonCanB_C NetMng_tiDebNegBusOffCanA_C NetMng_tiDebNegBusOffCanB_C NetMng_tiDebNegErrCanA_C NetMng_tiDebNegErrCanB_C NetMng_tiDebNegMonCanA_C NetMng_tiDebNegMonCanB_C NetMng_tiDebPosBusMonCanA_C NetMng_tiDebPosBusMonCanB_C NetMng_tiDebPosBusOffCanA_C NetMng_tiDebPosBusOffCanB_C NetMng_tiDebPosErrCanA_C NetMng_tiDebPosErrCanB_C NetMng_tiDebPosMonCanA_C NetMng_tiDebPosMonCanB_C NetMng_tiFadeoutLowBat_C NetMng_tiRecoverA_C NetMng_tiRecoverB_C NSC_numPrio_C NSC_st_C OPSCD_DebSRCLoDef_C OPSCD_numAdc_C OPSCD_numDia_C OPSCD_numDioOut_C OPSCD_uSRCMax_C OPSCD_uSRCMin_C OTSCD_DebNplDef_C OTSCD_DebSigDef_C OTSCD_DebSRCHighDef_C OTSCD_DebSRCLowDef_C OTSCD_numAdc_C OTSCD_uSRCMax_C OTSCD_uSRCMin_C OvRMon_ctEngSpdGrad_C OvRMon_DebETDef_C OvRMon_DebSigA0Def_C OvRMon_facInjEff_MAP OvRMon_nDiffMax_C OvRMon_nLIGovLim_C OvRMon_nSegMax_C OvRMon_nSegMin_C OvRMon_nStSysLim_C OvRMon_nThresNrml2Strt_C OvRMon_numBrkDioInMn_C OvRMon_numBrkDioInRed_C OvRMon_stBrkMnSwtInvIn_C OvRMon_stBrkRedSwtInvIn_C OvRMon_stDebCnt_C OvRMon_stIntrInit_C OvRMon_swtBrkRedSwtPresent_C OvRMon_swtBrkSigVal_C OvRMon_tiAPP1Flt_C OvRMon_tiASDdc_C OvRMon_tiBrkMnSwtDebPos_C OvRMon_tiBrkRedSwtDebPos_C OvRMon_tiCompAcsTemp_C OvRMon_tiCrCtlBrkRmp_C OvRMon_tiCrCtlConvRmp_C OvRMon_tiDebBrk_C OvRMon_tiDebConv_C OvRMon_tiDebT15_C OvRMon_tiErrAPP_C OvRMon_tiErrDblStorage_C OvRMon_tiLimET_CUR OvRMon_tiSegMin_C OvRMon_uAPPFull_C OvRMon_uAPP1Lim_C OvRMon_uPlaWinFull_C OvRMon_uPlaWinIdle_C PCR_dnSurgeSlpDwn_C PCR_dnSurgeSlpUp_C PCR_nCoStart_C PCR_nCoStrtHigh_C PCR_nLIGovBase_C PCR_nSurgeMon1_C PCR_nSurgeMon2_C PCR_pBGDevMaxOffset_C PCR_pBGDevMinOffset_C PCR_pDesAdd_Channel PCR_pDesAdd_Vector PCR_pDes_Channel PCR_pDes_Vector PCR_rBPACDAdd_Channel PCR_rBPACDAdd_Vector PCR_rBPACD_Channel PCR_rBPACD_Vector PCR_rSurgeHigh_MAP PCR_swtRelAbsType_C PCR_swtRelAbsVal_C PCR_tiCoStrt_CUR PCR_tiStrtDelayInit_C PCR_tiSurgeMonLIGov_C PCR_vSurgeLIGov_C PCVCD_dcycMax_C PCVCD_dcycMin_C PCVCD_dcycTst_C PCVCD_DebExcTempDef_C PCVCD_DebExcTempOk_C PCVCD_DebNoLoadDef_C PCVCD_DebNoLoadOk_C PCVCD_DebShortCircBatDef_C PCVCD_DebShortCircBatOk_C PCVCD_DebShortCircGndDef_C PCVCD_DebShortCircGndOk_C PCVCD_DebSRCHighDef_C PCVCD_DebSRCHighOk_C PCVCD_DebSRCLowDef_C PCVCD_DebSRCLowOk_C PCVCD_facIGovInit_CUR PCVCD_facIGovMax_C PCVCD_facIGovMin_C PCVCD_IGovDKd_C PCVCD_IGovIKi_C PCVCD_IGovIKiNeg_C PCVCD_IGovIKiPos_C PCVCD_iIGovIWinNeg_C PCVCD_iIGovIWinPos_C PCVCD_iLin_CUR PCVCD_numAdc_C PCVCD_numDia1_C PCVCD_numDia2_C PCVCD_numPwmOut_C PCVCD_resCoil_C PCVCD_stInvOut_C PCVCD_stPwrStgDia_C PCVCD_swt_C PCVCD_swtCtlStateType_C PCVCD_swtCtlStateVal_C PCVCD_tiBtwTst_C PCVCD_tiFltPT1Init_C PCVCD_tiFlt1PT1_C PCVCD_tiFlt2PT1_C PCVCD_tiIGovDT1_C PCVCD_tiIGovInit_C PCVCD_tiPer_C PCVCD_uSRCMax_C PCVCD_uSRCMin_C PCV_dvolLeak_CUR PCV_iCnvPress_CUR PCV_iSet_Channel PCV_iSetMin_C PCV_iSet_Vector PFLTCD_numAdc_C PFLTCD_numAdc2_C PFlt_dvol_Channel PFlt_dvol_Vector PFlt_resFlow_Channel PFlt_resFlow_Vector PFlt_st_Channel PFlt_stEngPOp_Channel PFlt_stEngPOp_Vector PFlt_st_Vector RailCD_DebSRCHighDef_C RailCD_DebSRCHighOk_C RailCD_DebSRCLowDef_C RailCD_DebSRCLowOk_C RAILCD_numAdc_C RAILCD_numAdc2_C RailCD_pLin_CUR RailCD_swtOfsTst_C RailCD_tiEvalDel_C RailCD_tiOfsTstAftRun_C RailCD_tiOfsTstStrt_C RailCD_uSRCMax_C RailCD_uSRCMin_C Rail_DebMeUn0MaxDef_C Rail_DebMeUn0MaxOk_C Rail_DebMeUn1MaxDef_C Rail_DebMeUn1MaxOk_C Rail_DebMeUn2MaxDef_C Rail_DebMeUn2MaxOk_C Rail_DebMeUn3MaxDef_C Rail_DebMeUn3MaxOk_C Rail_DebMeUn4MaxDef_C Rail_DebMeUn4MaxOk_C Rail_DebPCV0MaxDef_C Rail_DebPCV0MaxOk_C Rail_DebPCV1MaxDef_C Rail_DebPCV1MaxOk_C Rail_DebPCV2MaxDef_C Rail_DebPCV2MaxOk_C Rail_DebPCV3MaxDef_C Rail_DebPCV3MaxOk_C Rail_DebPCV4MaxDef_C Rail_DebPCV4MaxOk_C Rail_DebPCV5MaxDef_C Rail_DebPCV5MaxOk_C Rail_dpSetPointDec_C Rail_dpSetPointInc_MAP Rail_dvolMeUnCtlLoLim_C Rail_dvolMeUnCtlUpLim_CUR Rail_dvolMeUnSet_Channel Rail_dvolMeUnSetMin_C Rail_dvolMeUnSet_Vector Rail_dvolOff_C Rail_dvolPreCtlCor_Channel Rail_dvolPreCtlCor_Vector Rail_dvolPreCtlPoI1_MAP Rail_dvolPreCtlPoI2_MAP Rail_dvolRedOfsLim_C Rail_dvolStrt_C Rail_facLeakAged_C Rail_facOvrMeUnNegIncr_C Rail_facOvrPCVNegIncr_C Rail_nMonEnaMax_C Rail_nMonEnaMin_C Rail_nThresStrt_C Rail_numRevDel_C Rail_numRevPlaus_C Rail_pAbsDvtMax_C Rail_pMeUnDvtMax_C Rail_pMeUnDvtMax_CUR Rail_pMeUnDvtMin_CUR Rail_pMeUnPeakMax_C Rail_pMeUnPeakMin_CUR Rail_pNIPCVMax_MAP Rail_pNIPCVMin_MAP Rail_pOvrMeUnThresHigh_C Rail_pOvrMeUnThresLow_C Rail_pOvrPCVThresHigh_C Rail_pOvrPCVThresLow_C Rail_pPCVCloseOfs_CUR Rail_pPCVCtlLoLim_C Rail_pPCVCtlLoLimStrt_C Rail_pPCVCtlUpLim_C Rail_pPCVDvtMax_C Rail_pPCVDvtMax_CUR Rail_pPCVDvtMin_C Rail_pPCVPeakMax_C Rail_pPCVPeakMin_CUR Rail_pPCVRedOfs_CUR Rail_pPCVSet_Channel Rail_pPCVSetMax_C Rail_pPCVSetMin_C Rail_pPCVSet_Vector Rail_pPreCtlCor_Channel Rail_pPreCtlCor_Vector Rail_pSetMin_C Rail_pSetPoint_Channel Rail_pSetPointLimNFlTemp_C Rail_pSetPointMax_MAP Rail_pSetPointMinDef_C Rail_pSetPointMin_MAP Rail_pSetPointRed_C Rail_pSetPointRgn_Channel Rail_pSetPointRgn_Vector Rail_pSetPoint_Vector Rail_qMeUnLoIdle_C Rail_qMonEnaMax_C Rail_stMonMeUnRls_C Rail_stMonPCVRls_C Rail_stPreCtlMeUnSel_C Rail_stSetPointSel_C Rail_tiDeflate_C Rail_tiSetPointRedMin_C Rail_tiThresMonEna_C Rail_tMeUnLoIdle_C Rail_volInjVlvCtl_C RTMMon_dMaxCheckDef_C RTMMon_dMaxCheckOk_C RTMMon_dPlausCheckDef_C RTMMon_dPlausCheckOk_C RTMMon_tiNoPlausCheck_C Rtmo_adStart_cu32 Rtmo_stSampleTime_cu8 ShutCD_numDia_C ShutCD_numDioOut_C SOPTst_stRcyDem_C SOPTst_stShOffPathActv_C SSpMon_DebSRCHighSplyVltgDef1_C SSpMon_DebSRCHighSplyVltgDef2_C SSpMon_DebSRCHighSplyVltgDef3_C SSpMon_DebSRCHighSplyVltgOk1_C SSpMon_DebSRCHighSplyVltgOk2_C SSpMon_DebSRCHighSplyVltgOk3_C SSpMon_DebSRCLowSplyVltgDef1_C SSpMon_DebSRCLowSplyVltgDef2_C SSpMon_DebSRCLowSplyVltgDef3_C SSpMon_DebSRCLowSplyVltgOk1_C SSpMon_DebSRCLowSplyVltgOk2_C SSpMon_DebSRCLowSplyVltgOk3_C SSpMon_numDiaVltg1_C SSpMon_numDiaVltg2_C SSpMon_numDiaVltg3_C StrtCD_numDia_C StrtCD_numDioOut_C StSys_nAdjMax_C ThrVlv_rTVA_Channel ThrVlv_rTVA_Vector TPUMon_ctDfctLim_C TPUMon_tiDiffMaxLimit_C TPUMon_tiDiffMinLimit_C TPUMon_tiDiffSumLimit_C TVACD_numDia_C TVACD_numPwmOut_C T15CD_numDioIn_C T15CD_tiDebNeg_C T15CD_tiDebPos_C UAddr_stCalibration_C VehDa_lEepUpd_C VSACD_numDia_C VSACD_numPwmOut_C VSA_rVSA_Channel VSA_rVSA_Vector VSSCD_DebCanSigDef_C VSSCD_swtSigType_C VSSCD_swtSigVal_C ZFC_nAvrgMax_C ZFC_nAvrgMin_C ZFC_nChngPRailMax_C ZFC_nFBCThresMax_C ZFC_numRatETClb_C ZFC_numRatNVClb_C /end REF_CHARACTERISTIC
/end FUNCTION
/begin FUNCTION _k2rei "Applizierbare Diagnose Informationen" /begin DEF_CHARACTERISTIC K2REI_dCodInd_C K2REI_dDiaInd_C K2REI_dSGFam_C /end DEF_CHARACTERISTIC /end FUNCTION
/begin FUNCTION BGCRENG "BGCRENG" /end FUNCTION
/begin FUNCTION BGLLGEN_1PR "BGLLGEN_1PR" /end FUNCTION
/begin FUNCTION DGEN "DGEN" /end FUNCTION
/begin FUNCTION DIBS "DIBS" /end FUNCTION
/begin FUNCTION DQLT "DQLT" /end FUNCTION
/begin FUNCTION IMDGEN_1PR "IMDGEN_1PR" /end FUNCTION
/begin COMPU_METHOD Acc "Fahrzeugbeschleunigung" RAT_FUNC "%6.5" "m/s^2" COEFFS 0 1000 0 0 0 1 /end COMPU_METHOD
/begin COMPU_METHOD Def_bit_ub_0 "Def_bit_ub_0" TAB_VERB "%5.2" "-" COMPU_TAB_REF Def_bit_ub_0_VTAB /end COMPU_METHOD
/begin COMPU_METHOD Def_bit_ub_1 "Def_bit_ub_1" TAB_VERB "%5.2" "-" COMPU_TAB_REF Def_bit_ub_1_VTAB /end COMPU_METHOD
/begin COMPU_METHOD Def_bit_ub_2 "Def_bit_ub_2" TAB_VERB "%5.2" "-" COMPU_TAB_REF Def_bit_ub_2_VTAB /end COMPU_METHOD
/begin COMPU_METHOD Def_bit_ub_3 "Def_bit_ub_3" TAB_VERB "%5.2" "-" COMPU_TAB_REF Def_bit_ub_3_VTAB /end COMPU_METHOD
/begin COMPU_METHOD Def_bit_ub_4 "Def_bit_ub_4" TAB_VERB "%5.2" "-" COMPU_TAB_REF Def_bit_ub_4_VTAB /end COMPU_METHOD
/begin COMPU_METHOD Def_bit_ub_5 "Def_bit_ub_5" TAB_VERB "%5.2" "-" COMPU_TAB_REF Def_bit_ub_5_VTAB /end COMPU_METHOD
/begin COMPU_METHOD Def_bit_ub_6 "Def_bit_ub_6" TAB_VERB "%5.2" "-" COMPU_TAB_REF Def_bit_ub_6_VTAB /end COMPU_METHOD
/begin COMPU_METHOD Def_bit_ub_7 "Def_bit_ub_7" TAB_VERB "%5.2" "-" COMPU_TAB_REF Def_bit_ub_7_VTAB /end COMPU_METHOD
/begin COMPU_METHOD Def_dez_ub_q1 "Def_dez_ub_q1" RAT_FUNC "%3.0" "-" COEFFS 0 1 0 0 0 1 /end COMPU_METHOD
/begin COMPU_METHOD Def_dez_ul_q1 "Def_dez_ul_q1" RAT_FUNC "%7.0" "-" COEFFS 0 1 0 0 0 1 /end COMPU_METHOD
/begin COMPU_METHOD Def_dez_uw_q1 "Def_dez_uw_q1" RAT_FUNC "%5.0" "-" COEFFS 0 1 0 0 0 1 /end COMPU_METHOD
/begin COMPU_METHOD Def_eta_ul_b8192 "Def_eta_ul_b8192" RAT_FUNC "%14.6" "-" COEFFS 0 524288 0 0 0 1 /end COMPU_METHOD
/begin COMPU_METHOD Def_f_ub_b1 "Def_f_ub_b1" RAT_FUNC "%6.3" "-" COEFFS 0 256 0 0 0 1 /end COMPU_METHOD
/begin COMPU_METHOD Def_f_ub_b100 "Def_f_ub_b100" RAT_FUNC "%5.2" "%" COEFFS 0 256 0 0 0 100 /end COMPU_METHOD
/begin COMPU_METHOD Def_f_ub_b2 "Def_f_ub_b2" RAT_FUNC "%6.3" "-" COEFFS 0 256 0 0 0 2 /end COMPU_METHOD
/begin COMPU_METHOD Def_f_ub_b4 "Def_f_ub_b4" RAT_FUNC "%5.2" "-" COEFFS 0 256 0 0 0 4 /end COMPU_METHOD
/begin COMPU_METHOD Def_f_ub_b8 "Def_f_ub_b8" RAT_FUNC "%5.2" "-" COEFFS 0 256 0 0 0 8 /end COMPU_METHOD
/begin COMPU_METHOD Def_f_uw_b1 "Def_f_uw_b1" RAT_FUNC "%14.5" "-" COEFFS 0 65536 0 0 0 1 /end COMPU_METHOD
/begin COMPU_METHOD Def_f_uw_b100 "Def_f_uw_b100" RAT_FUNC "%8.3" "%" COEFFS 0 65536 0 0 0 100 /end COMPU_METHOD
/begin COMPU_METHOD Def_f_uw_b2 "Def_f_uw_b2" RAT_FUNC "%14.5" "-" COEFFS 0 65536 0 0 0 2 /end COMPU_METHOD
/begin COMPU_METHOD Def_f_uw_b2048 "Def_f_uw_b2048" RAT_FUNC "%7.2" "-" COEFFS 0 65536 0 0 0 2048 /end COMPU_METHOD
/begin COMPU_METHOD Def_f_uw_b32 "Def_f_uw_b32" RAT_FUNC "%9.4" "-" COEFFS 0 65536 0 0 0 32 /end COMPU_METHOD
/begin COMPU_METHOD Def_f_uw_b512 "Def_f_uw_b512" RAT_FUNC "%8.3" "-" COEFFS 0 65536 0 0 0 512 /end COMPU_METHOD
/begin COMPU_METHOD Def_f_uw_b64 "Def_f_uw_b64" RAT_FUNC "%9.4" "-" COEFFS 0 65536 0 0 0 64 /end COMPU_METHOD
/begin COMPU_METHOD Def_i_sw_q0p001 "Def_i_sw_q0p001" RAT_FUNC "%8.3" "A" COEFFS 0 1000 0 0 0 1 /end COMPU_METHOD
/begin COMPU_METHOD Def_i_sw_q1 "Def_i_sw_q1" RAT_FUNC "%8.3" "A" COEFFS 0 1 0 0 0 1 /end COMPU_METHOD
/begin COMPU_METHOD Def_i_ub_q0p125 "Def_i_ub_q0p125" RAT_FUNC "%6.3" "A" COEFFS 0 8 0 0 0 1 /end COMPU_METHOD
/begin COMPU_METHOD Def_i_ub_q1 "Def_i_ub_q1" RAT_FUNC "%6.3" "" COEFFS 0 1 0 0 0 1 /end COMPU_METHOD
/begin COMPU_METHOD Def_i_uw_q0p03125 "Def_i_uw_q0p03125" RAT_FUNC "%8.3" "A" COEFFS 0 65536 0 0 0 2048 /end COMPU_METHOD
/begin COMPU_METHOD Def_i_uw_q0p0635 "Def_i_uw_q0p0635" RAT_FUNC "%8.3" "A" COEFFS 0 65536 0 0 0 4096 /end COMPU_METHOD
/begin COMPU_METHOD Def_m_sw_q0p1 "Def_m_sw_q0p1" RAT_FUNC "%7.2" "Nm" COEFFS 0 10 0 0 0 1 /end COMPU_METHOD
/begin COMPU_METHOD Def_n_sw_q1p0 "Def_n_sw_q1p0" RAT_FUNC "%5.0" "Upm" COEFFS 0 1 0 0 0 1 /end COMPU_METHOD
/begin COMPU_METHOD Def_pwr_ul_q0p03125 "Def_pwr_ul_q0p03125" RAT_FUNC "%10.3" "-" COEFFS 0 65536 0 0 0 2048 /end COMPU_METHOD
/begin COMPU_METHOD Def_st_ub_q1 "Def_st_ub_q1" RAT_FUNC "%3.0" "-" COEFFS 0 1 0 0 0 1 /end COMPU_METHOD
/begin COMPU_METHOD Def_st_uw_q1 "Def_st_uw_q1" RAT_FUNC "%5.0" "-" COEFFS 0 1 0 0 0 1 /end COMPU_METHOD
/begin COMPU_METHOD Def_t_sw_q0p1 "Def_t_sw_q0p1" RAT_FUNC "%6.1" "°C" COEFFS 0 10 0 0 0 1 /end COMPU_METHOD
/begin COMPU_METHOD Def_t_uw_q0p075 "Def_t_uw_q0p075" RAT_FUNC "%7.2" "°C" COEFFS 0 1 0 0 0 0.75 /end COMPU_METHOD
/begin COMPU_METHOD Def_td_ub_q0p01 "Def_td_ub_q0p01" RAT_FUNC "%5.2" "s" COEFFS 0 100 0 0 0 1 /end COMPU_METHOD
/begin COMPU_METHOD Def_td_ub_q0p1 "Def_td_ub_q0p1" RAT_FUNC "%4.1" "s" COEFFS 0 10 0 0 0 1 /end COMPU_METHOD
/begin COMPU_METHOD Def_td_ub_q1 "Def_td_ub_q1" RAT_FUNC "%5.2" "s" COEFFS 0 1 0 0 0 1 /end COMPU_METHOD
/begin COMPU_METHOD Def_tv_ub_q0p390625 "Def_tv_ub_q0p390625" RAT_FUNC "%5.2" "%" COEFFS 0 256 0 0 0 100 /end COMPU_METHOD
/begin COMPU_METHOD Def_u_uw_q0p0942 "Def_u_uw_q0p0942" RAT_FUNC "%6.1" "V" COEFFS 0 1 0 0 0 0.0942 /end COMPU_METHOD
/begin COMPU_METHOD Def_u_uw_q0p1 "Def_u_uw_q0p1" RAT_FUNC "%8.3" "V" COEFFS 0 10 0 0 0 1 /end COMPU_METHOD
/begin COMPU_METHOD Def_v_uw_q1p0 "Def_v_uw_q1p0" RAT_FUNC "%5.0" "km/h" COEFFS 0 1 0 0 0 1 /end COMPU_METHOD
/begin COMPU_METHOD Identity "Identity" RAT_FUNC "%4.1" "-" COEFFS 0 1 0 0 0 1 /end COMPU_METHOD
/begin COMPU_METHOD ident "ident" RAT_FUNC "%4.1" "-" COEFFS 0 1 0 0 0 1 /end COMPU_METHOD
/begin COMPU_VTAB Def_bit_ub_0_VTAB "Def_bit_ub_0_VTAB" TAB_VERB 2 0 "FALSE" 1 "TRUE" /end COMPU_VTAB
/begin COMPU_VTAB Def_bit_ub_1_VTAB "Def_bit_ub_1_VTAB" TAB_VERB 2 0 "FALSE" 1 "TRUE" /end COMPU_VTAB
/begin COMPU_VTAB Def_bit_ub_2_VTAB "Def_bit_ub_2_VTAB" TAB_VERB 2 0 "FALSE" 1 "TRUE" /end COMPU_VTAB
/begin COMPU_VTAB Def_bit_ub_3_VTAB "Def_bit_ub_3_VTAB" TAB_VERB 2 0 "FALSE" 1 "TRUE" /end COMPU_VTAB
/begin COMPU_VTAB Def_bit_ub_4_VTAB "Def_bit_ub_4_VTAB" TAB_VERB 2 0 "FALSE" 1 "TRUE" /end COMPU_VTAB
/begin COMPU_VTAB Def_bit_ub_5_VTAB "Def_bit_ub_5_VTAB" TAB_VERB 2 0 "FALSE" 1 "TRUE" /end COMPU_VTAB
/begin COMPU_VTAB Def_bit_ub_6_VTAB "Def_bit_ub_6_VTAB" TAB_VERB 2 0 "FALSE" 1 "TRUE" /end COMPU_VTAB
/begin COMPU_VTAB Def_bit_ub_7_VTAB "Def_bit_ub_7_VTAB" TAB_VERB 2 0 "FALSE" 1 "TRUE" /end COMPU_VTAB
/begin COMPU_METHOD AngleCrS "Winkel Kurbelwelle" RAT_FUNC "%6.4" "deg CrS" COEFFS 0 42.6666666666667 0 0 0 1 /end COMPU_METHOD
/begin COMPU_METHOD Dist_20ms "Entfernung durch Aufsummierung Fahrgeschwindigkeit (Vel/VelSI) im 20 ms Raster" RAT_FUNC "%7.6" "m" COEFFS 0 18000 0 0 0 1 /end COMPU_METHOD
/begin COMPU_METHOD DtyCyc "Tastverhaeltnis" RAT_FUNC "%6.4" "%" COEFFS 0 100 0 0 0 1 /end COMPU_METHOD
/begin COMPU_METHOD EngN "Motordrehzahl" RAT_FUNC "%6.2" "rpm" COEFFS 0 1 0 0 0 1 /end COMPU_METHOD
/begin COMPU_METHOD InjMass "Einspritzmenge" RAT_FUNC "%6.4" "mg/hub" COEFFS 0 100 0 0 0 1 /end COMPU_METHOD
/begin COMPU_METHOD InjTime_us "Zeit in Microsekunden für das Einspritztiming" RAT_FUNC "%6.2" "us" COEFFS 0 1 0 0 0 1 /end COMPU_METHOD
/begin COMPU_METHOD Length "Länge in Meter" RAT_FUNC "%6.2" "m" COEFFS 0 1 0 0 0 1 /end COMPU_METHOD
/begin COMPU_METHOD NumPinDia "Verbale Umrechnung für Diagnose Signale" TAB_VERB "%6.3" "-" COMPU_TAB_REF NumPinDia /end COMPU_METHOD
/begin COMPU_VTAB NumPinDia "Verbale Umrechnung für Diagnose Signale" TAB_VERB 35 0 "CJ945_Diagnostic_Signal" 1 "AC_Compressor_DiaSig" 2 "Fuel_Pump_DiaSig" 3 "Starter_234" 4 "Oil_Pressure_Lamp_Switch_245" 5 "Engine_Bay_Air_Flaps_123" 6 "Glow_Relay_Diagnostic_Signal1" 7 "reserved Glow_Relay_Diagnostic_Signal2" 8 "Ebox_Fan_Actuator_Diagnostic_Signal_219" 9 "Shuttr_Actuator_Diagnostic_Signal_231" 10 "Twostage_TurboLoading_SW_DiaSig" 11 "DIO_OUT_DIAGNOSTIC_DUMMY_NOT_USED" 12 "1st_Pressure_Control_Valve_Diagnostic_Signal_172" 13 "2nd_Pressure_Control_Valve_Diagnostic_Signal_172" 14 "1st_Metering_Unit_Diagnostic_Signal_171" 15 "2nd_Metering_Unit_Diagnostic_Signal_171" 16 "Boost_Pressure_Actuator_Diagnostic_Signal_193" 17 "Boost_Pressure_Actuator_Diagnostic_Signal_193_2" 18 "EGR_Actuator_Diagnostic_Signal_194" 19 "EGR_Actuator_Diagnostic_Signal2" 20 "Variable_Swirl_Actuator_Diagnostic_Signal_195" 21 "Throttle_Valve_Diagnostic_Signal_196" 22 "Throttle_Valve2_Diagnostic_Signal_196" 23 "FAN_240" 24 "Add_On_Heater_244" 25 "EngM_Bearing_Actuator_Diagnostic_Signal_124" 26 "EngM_Bearing_Actuator_Diagnostic_Signal_121" 27 "Low pressure stage BPA_Diagnostic_Signal_117" 28 "PWM_DIAGNOSTIC_DUMMY_NOT_USED" 29 "1st_Sensor_Supply_Voltage_DiaSig" 30 "2nd_Sensor_Supply_Voltage_DiaSig" 31 "3rd_Sensor_Supply_Voltage_DiaSig" 32 "4th_Sensor_Supply_Voltage_DiaSig" 33 "5th_Sensor_Supply_Voltage_DiaSig" 34 "6th_Sensor_Supply_Voltage_DiaSig" /end COMPU_VTAB
/begin COMPU_METHOD NumPinDioIn "Verbale Umrechnung für Digitaleingang Signale" TAB_VERB "%6.3" "-" COMPU_TAB_REF NumPinDioIn /end COMPU_METHOD
/begin COMPU_VTAB NumPinDioIn "Verbale Umrechnung für Digitaleingang Signale" TAB_VERB 15 0 "Terminal_15_207" 1 "Main_Brake_Switch_236" 2 "Redundant_Brake_Switch_223" 3 "Clutch_Switch" 4 "Terminal_50_224" 5 "ECU_selection_Switch_251" 6 "FlFlt_Switch_211" 7 "Coolant-heater_212" 8 "Redundant_Terminal_15_209(118)" 9 "AC-compressor_overboost_213" 10 "Additive_tank_level_switch_235" 11 "Terminal_61_113" 12 "Lambda_Regeneration" 13 "OilLevelSensor_138" 14 "DIO_IN_DUMMY_NOT_USED" /end COMPU_VTAB
/begin COMPU_METHOD NumPinPwmOut "Verbale Umrechnung für PWM-Ausgang Signale" TAB_VERB "%6.3" "-" COMPU_TAB_REF NumPinPwmOut /end COMPU_METHOD
/begin COMPU_VTAB NumPinPwmOut "Verbale Umrechnung für PWM-Ausgang Signale" TAB_VERB 13 0 "Boost_Pressure_Actuator_193" 1 "EGR_Actuator_194" 2 "PCV_Actuator_172" 3 "MeUn_Actuator_171" 4 "Variable_Swirl_Actuator_195" 5 "Fan_Actuator_240" 6 "Add_On_Heater_244" 7 "EngM_Bearing_Actuator_124" 8 "EngM_Bearing_Actuator_121" 9 "Throttle Valve" 10 "LSU_Heater_PWMOutput" 11 "Low pressure stage BPA_117" 12 "PWM_DUMMY_NOT_USED" /end COMPU_VTAB
/begin COMPU_METHOD OneToOne "eins zu eins (physikalischer Wert ist gleich dem internen Wert)" RAT_FUNC "%6.2" "-" COEFFS 0 1 0 0 0 1 /end COMPU_METHOD
/begin COMPU_METHOD Period "Periodendauer" RAT_FUNC "%6.3" "ms" COEFFS 0 10 0 0 0 1 /end COMPU_METHOD
/begin COMPU_METHOD Per_Ratio "Umwandlung fuer Bereichsgewichtung" RAT_FUNC "%6.4" "-" COEFFS 0 256 0 0 0 1 /end COMPU_METHOD
/begin COMPU_METHOD Prc "Prozent, gleiche interne Auflösung wie Fact, aber Darstellung in Prozent (0...100%)" RAT_FUNC "%6.4" "%" COEFFS 0 81.92 0 0 0 1 /end COMPU_METHOD
/begin COMPU_METHOD Pres_Rail "Raildruck in hPa" RAT_FUNC "%4.3" "bar" COEFFS 0 10.000000 0 0 0 1 /end COMPU_METHOD
/begin COMPU_METHOD Pwr "Leistung" RAT_FUNC "%6.2" "W" COEFFS 0 0.10610329539459 0 0 0 1 /end COMPU_METHOD
/begin COMPU_METHOD Temp_Cels "Temperatur dargestellt in °C (gleiche interne Darstellung wie Temp_Kelv)" RAT_FUNC "%6.1" "deg C" COEFFS 0 10 2731.4 0 0 1 /end COMPU_METHOD
/begin COMPU_METHOD TimeDeb "Entprellzeit in Millisekunden für Libraryfunktion Debounce" RAT_FUNC "%6.1" "ms" COEFFS 0 0.1 0 0 0 1 /end COMPU_METHOD
/begin COMPU_METHOD TimeDelay_s "Zeitkonstante T1 (in s) für PT1, DT1, etc." RAT_FUNC "%9.3" "s" COEFFS 0 0 1 0 0.00023283064365387 0 /end COMPU_METHOD
/begin COMPU_METHOD TimeEngOn "Motorbetriebszeit in Sekunden" RAT_FUNC "%6.2" "s" COEFFS 0 1 0 0 0 1 /end COMPU_METHOD
/begin COMPU_METHOD TimeUSResolution "Zeit in Mikrosekunden für TPU Zeiten, Auflösung 1 us" RAT_FUNC "%6.2" "us" COEFFS 0 1 0 0 0 1 /end COMPU_METHOD
/begin COMPU_METHOD Time_ms "Zeit in ms für Fehlerentprellung (DSM) und SW-Timer" RAT_FUNC "%6.1" "ms" COEFFS 0 0.1 0 0 0 1 /end COMPU_METHOD
/begin COMPU_METHOD Time_PwmHigh "Periodenzeit von der HWE (Tio_PwmGetAvrg)" RAT_FUNC "%6.3" "us" COEFFS 0 10 0 0 0 1 /end COMPU_METHOD
/begin COMPU_METHOD Trq "Motormoment" RAT_FUNC "%6.3" "Nm" COEFFS 0 10 0 0 0 1 /end COMPU_METHOD
/begin COMPU_METHOD Vel "Fahrzeuggeschwindigkeit, gleiche interne Auflösung wie Vel_SI" RAT_FUNC "%6.4" "km/h" COEFFS 0 100 0 0 0 1 /end COMPU_METHOD
/begin COMPU_METHOD VelToN "Verhältnis Fahrzeuggeschwindigkeit zu Motordrehzahl v/n" RAT_FUNC "%8.7" "(km/h)/rpm" COEFFS 0 100000 0 0 0 1 /end COMPU_METHOD
/begin COMPU_METHOD volAdd_ml "Additivvolumen [ml]" RAT_FUNC "%6.3" "ml" COEFFS 0 10 0 0 0 1 /end COMPU_METHOD
/begin COMPU_METHOD volAdd_ml1 "Umrechnung mit Auflösung 0.0000152587890625 für die 32 bit Messages in AddPmp_AddMet" RAT_FUNC "%7.6" "ml" COEFFS 0 65536 0 0 0 1 /end COMPU_METHOD
/begin COMPU_METHOD Volt_Batt "Batteriespannung" RAT_FUNC "%6.1" "mV" COEFFS 0 0.05115 0 0 0 1 /end COMPU_METHOD
/begin COMPU_METHOD VSS_DistFac "Streckenfaktor für FGG" RAT_FUNC "%20.2" "Imp/m" COEFFS 0 0 1 0 2.77777777777778e-10 0 /end COMPU_METHOD
/begin COMPU_METHOD ZFC_EvalEngSpd_Rslt "Umrechnung für das Ergebniss der Drehzahlsignalauswertung" TAB_VERB "%6.3" "-" COMPU_TAB_REF ZFC_EvalEngSpd_Rslt /end COMPU_METHOD
/begin COMPU_VTAB ZFC_EvalEngSpd_Rslt "Umrechnung für das Ergebniss der Drehzahlsignalauswertung" TAB_VERB 3 0 "ZFC_ST_ALL_INJ_LOW" 1 "ZFC_ST_DES_INJ_MAX" 2 "ZFC_ST_ERR_INJ_MAX" /end COMPU_VTAB
/begin COMPU_METHOD ZFC_Inj_State "Umrechnung für die Ausgabe des Zustandsautomaten für die Einspritzung der Nullmengenkalibrierung" TAB_VERB "%6.3" "-" COMPU_TAB_REF ZFC_Inj_State /end COMPU_METHOD
/begin COMPU_VTAB ZFC_Inj_State "Umrechnung für die Ausgabe des Zustandsautomaten für die Einspritzung der Nullmengenkalibrierung" TAB_VERB 5 0 "ZFC_ST_INJ_IDLE" 16 "ZFC_ST_INJ_DEM" 32 "ZFC_ST_INJ_PROG" 48 "ZFC_ST_INJ_RES_OK" 64 "ZFC_ST_INJ_RES_NOK" /end COMPU_VTAB
/begin COMPU_METHOD ZFC_State "Umrechnung für Ausgabe des Nullmengenkalibrierung Statuses" TAB_VERB "%6.3" "-" COMPU_TAB_REF ZFC_State /end COMPU_METHOD
/begin COMPU_VTAB ZFC_State "Umrechnung für Ausgabe des Nullmengenkalibrierung Statuses" TAB_VERB 8 1 "ZFC_ST_BREAK" 2 "ZFC_ST_WAIT" 3 "ZFC_ST_START_OVRRUN" 4 "ZFC_ST_CHANGE_PRAIL" 5 "ZFC_ST_CHECK_PRAIL_AND_N" 6 "ZFC_ST_ETCLB" 7 "ZFC_ST_NVCLB" 16 "ZFC_ST_SUBS_FUNC" /end COMPU_VTAB
/begin RECORD_LAYOUT Kl_Xs16_Ws16 NO_AXIS_PTS_X 1 SWORD AXIS_PTS_X 2 SWORD INDEX_INCR DIRECT FNC_VALUES 3 SWORD COLUMN_DIR DIRECT /end RECORD_LAYOUT
/begin RECORD_LAYOUT Kwb_Wr32 FNC_VALUES 1 FLOAT32_IEEE COLUMN_DIR DIRECT /end RECORD_LAYOUT
/begin RECORD_LAYOUT Kwb_Wu16 FNC_VALUES 1 UWORD COLUMN_DIR DIRECT /end RECORD_LAYOUT
/begin RECORD_LAYOUT Kwb_Wu8 FNC_VALUES 1 UBYTE COLUMN_DIR DIRECT /end RECORD_LAYOUT
/begin RECORD_LAYOUT Kw_Ws16 FNC_VALUES 1 SWORD COLUMN_DIR DIRECT /end RECORD_LAYOUT
/begin RECORD_LAYOUT Kw_Ws32 FNC_VALUES 1 SLONG COLUMN_DIR DIRECT /end RECORD_LAYOUT
/begin RECORD_LAYOUT Kw_Wu16 FNC_VALUES 1 UWORD COLUMN_DIR DIRECT /end RECORD_LAYOUT
/begin RECORD_LAYOUT Kw_Wu32 FNC_VALUES 1 ULONG COLUMN_DIR DIRECT /end RECORD_LAYOUT
/begin RECORD_LAYOUT Kw_Wu8 FNC_VALUES 1 UBYTE COLUMN_DIR DIRECT /end RECORD_LAYOUT
/begin RECORD_LAYOUT TKF_SW_SW_UW NO_AXIS_PTS_X 1 UBYTE NO_AXIS_PTS_Y 2 UBYTE AXIS_PTS_X 3 SWORD INDEX_INCR DIRECT AXIS_PTS_Y 4 SWORD INDEX_INCR DIRECT FNC_VALUES 5 UWORD COLUMN_DIR DIRECT /end RECORD_LAYOUT
/begin RECORD_LAYOUT TKF_SW_UB_UB NO_AXIS_PTS_X 1 UBYTE NO_AXIS_PTS_Y 2 UBYTE AXIS_PTS_X 3 UBYTE INDEX_INCR DIRECT AXIS_PTS_Y 4 SWORD INDEX_INCR DIRECT FNC_VALUES 5 UBYTE COLUMN_DIR DIRECT /end RECORD_LAYOUT
/begin RECORD_LAYOUT TKF_SW_UW_UB NO_AXIS_PTS_X 1 UBYTE NO_AXIS_PTS_Y 2 UBYTE AXIS_PTS_X 3 UWORD INDEX_INCR DIRECT AXIS_PTS_Y 4 SWORD INDEX_INCR DIRECT FNC_VALUES 5 UBYTE COLUMN_DIR DIRECT /end RECORD_LAYOUT
/begin RECORD_LAYOUT TKF_UB_UB_UB NO_AXIS_PTS_X 1 UBYTE NO_AXIS_PTS_Y 2 UBYTE AXIS_PTS_X 3 UBYTE INDEX_INCR DIRECT AXIS_PTS_Y 4 UBYTE INDEX_INCR DIRECT FNC_VALUES 5 UBYTE COLUMN_DIR DIRECT /end RECORD_LAYOUT
/begin RECORD_LAYOUT TKF_UW_UB_UW NO_AXIS_PTS_X 1 UBYTE NO_AXIS_PTS_Y 2 UBYTE AXIS_PTS_X 3 UBYTE INDEX_INCR DIRECT AXIS_PTS_Y 4 UWORD INDEX_INCR DIRECT FNC_VALUES 5 UWORD COLUMN_DIR DIRECT /end RECORD_LAYOUT
/begin RECORD_LAYOUT TKL_SW_VV_UB NO_AXIS_PTS_X 1 UBYTE RESERVED 2 BYTE AXIS_PTS_X 3 SWORD INDEX_INCR DIRECT FNC_VALUES 4 UBYTE COLUMN_DIR DIRECT /end RECORD_LAYOUT
/begin RECORD_LAYOUT TKL_SW_VV_UW NO_AXIS_PTS_X 1 UBYTE RESERVED 2 BYTE AXIS_PTS_X 3 SWORD INDEX_INCR DIRECT FNC_VALUES 4 UWORD COLUMN_DIR DIRECT /end RECORD_LAYOUT
/begin RECORD_LAYOUT TKL_UB_VV_UB NO_AXIS_PTS_X 1 UBYTE RESERVED 2 BYTE AXIS_PTS_X 3 UBYTE INDEX_INCR DIRECT FNC_VALUES 4 UBYTE COLUMN_DIR DIRECT /end RECORD_LAYOUT
/begin RECORD_LAYOUT TKL_UW_VV_SW NO_AXIS_PTS_X 1 UBYTE RESERVED 2 BYTE AXIS_PTS_X 3 UWORD INDEX_INCR DIRECT FNC_VALUES 4 SWORD COLUMN_DIR DIRECT /end RECORD_LAYOUT
/begin RECORD_LAYOUT TKL_UW_VV_UB NO_AXIS_PTS_X 1 UBYTE RESERVED 2 BYTE AXIS_PTS_X 3 UWORD INDEX_INCR DIRECT FNC_VALUES 4 UBYTE COLUMN_DIR DIRECT /end RECORD_LAYOUT
/begin RECORD_LAYOUT TKL_UW_VV_UW NO_AXIS_PTS_X 1 UBYTE RESERVED 2 BYTE AXIS_PTS_X 3 UWORD INDEX_INCR DIRECT FNC_VALUES 4 UWORD COLUMN_DIR DIRECT /end RECORD_LAYOUT
/begin RECORD_LAYOUT TKW_VV_VV_SW FNC_VALUES 1 SWORD COLUMN_DIR DIRECT /end RECORD_LAYOUT
/begin RECORD_LAYOUT TKW_VV_VV_UB FNC_VALUES 1 UBYTE COLUMN_DIR DIRECT /end RECORD_LAYOUT
/begin RECORD_LAYOUT TKW_VV_VV_UL FNC_VALUES 1 ULONG COLUMN_DIR DIRECT /end RECORD_LAYOUT
/begin RECORD_LAYOUT TKW_VV_VV_UW FNC_VALUES 1 UWORD COLUMN_DIR DIRECT /end RECORD_LAYOUT
/end MODULE
/end PROJECT
