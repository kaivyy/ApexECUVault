ASAP2_VERSION 1 41
/begin PROJECT MSD85 "Spray Guided DI-System with Piezo Injectors for 8-Cylinder"
/begin HEADER "_default_HeaderComment" PROJECT_NO _91 /end HEADER
/begin MODULE _default_ModuleName "_default_ModuleLongIdentifier"
/begin MOD_COMMON "_default_ModCommonComment" DEPOSIT ABSOLUTE BYTE_ORDER MSB_LAST ALIGNMENT_BYTE 1 ALIGNMENT_WORD 2 ALIGNMENT_LONG 2 ALIGNMENT_FLOAT32_IEEE 2 ALIGNMENT_FLOAT64_IEEE 4 /end MOD_COMMON
/begin CHARACTERISTIC c_crk_cyl_lam_1 "factor for different distance between lambda sensor and cylinder individual exaust-valves" VALUE 0xa080baba _REC_VAL_20_s1 1440. _CNV_A_R_LINEAR_____112_CM -720. 720. DISPLAY_IDENTIFIER C_CRK_CYL_LAM_1 FORMAT "%4.0" /end CHARACTERISTIC
/begin CHARACTERISTIC c_crk_cyl_lam_2 "factor for different distance between lambda sensor and cylinder individual exaust-valves" VALUE 0xa080babb _REC_VAL_20_s1 1440. _CNV_A_R_LINEAR_____112_CM -720. 720. DISPLAY_IDENTIFIER C_CRK_CYL_LAM_2 FORMAT "%4.0" /end CHARACTERISTIC
/begin CHARACTERISTIC c_crk_cyl_lam_3 "factor for different distance between lambda sensor and cylinder individual exaust-valves" VALUE 0xa080babc _REC_VAL_20_s1 1440. _CNV_A_R_LINEAR_____112_CM -720. 720. DISPLAY_IDENTIFIER C_CRK_CYL_LAM_3 FORMAT "%4.0" /end CHARACTERISTIC
/begin CHARACTERISTIC c_crk_cyl_lam_4 "factor for different distance between lambda sensor and cylinder individual exaust-valves" VALUE 0xa080babd _REC_VAL_20_s1 1440. _CNV_A_R_LINEAR_____112_CM -720. 720. DISPLAY_IDENTIFIER C_CRK_CYL_LAM_4 FORMAT "%4.0" /end CHARACTERISTIC
/begin CHARACTERISTIC c_crk_cyl_lam_5 "factor for different distance between lambda sensor and cylinder individual exaust-valves" VALUE 0xa080babe _REC_VAL_20_s1 1440. _CNV_A_R_LINEAR_____112_CM -720. 720. DISPLAY_IDENTIFIER C_CRK_CYL_LAM_5 FORMAT "%4.0" /end CHARACTERISTIC
/begin CHARACTERISTIC c_crk_cyl_lam_0 "factor for different distance between lambda sensor and cylinder individual exaust-valves" VALUE 0xa080bab9 _REC_VAL_20_s1 1440. _CNV_A_R_LINEAR_____112_CM -720. 720. DISPLAY_IDENTIFIER C_CRK_CYL_LAM_0 FORMAT "%4.0" /end CHARACTERISTIC
/begin MEASUREMENT fac_cyl_lam_int[0] "unlimited output of the cylinder individual controller" SWORD _CNV_A_R_LINEAR_____113_CM 1 100. -50. 49.9984741210938 DISPLAY_IDENTIFIER FAC_CYL_LAM_INT[0] ECU_ADDRESS 0xd00005d0 FORMAT "%7.3" /end MEASUREMENT
/begin MEASUREMENT fac_cyl_lam_int[1] "unlimited output of the cylinder individual controller" SWORD _CNV_A_R_LINEAR_____113_CM 1 100. -50. 49.9984741210938 DISPLAY_IDENTIFIER FAC_CYL_LAM_INT[1] ECU_ADDRESS 0xd00005d2 FORMAT "%7.3" /end MEASUREMENT
/begin MEASUREMENT fac_cyl_lam_int[2] "unlimited output of the cylinder individual controller" SWORD _CNV_A_R_LINEAR_____113_CM 1 100. -50. 49.9984741210938 DISPLAY_IDENTIFIER FAC_CYL_LAM_INT[2] ECU_ADDRESS 0xd00005d4 FORMAT "%7.3" /end MEASUREMENT
/begin MEASUREMENT fac_cyl_lam_int[3] "unlimited output of the cylinder individual controller" SWORD _CNV_A_R_LINEAR_____113_CM 1 100. -50. 49.9984741210938 DISPLAY_IDENTIFIER FAC_CYL_LAM_INT[3] ECU_ADDRESS 0xd00005d6 FORMAT "%7.3" /end MEASUREMENT
/begin MEASUREMENT fac_cyl_lam_int[4] "unlimited output of the cylinder individual controller" SWORD _CNV_A_R_LINEAR_____113_CM 1 100. -50. 49.9984741210938 DISPLAY_IDENTIFIER FAC_CYL_LAM_INT[4] ECU_ADDRESS 0xd00005d8 FORMAT "%7.3" /end MEASUREMENT
/begin MEASUREMENT fac_cyl_lam_int[5] "unlimited output of the cylinder individual controller" SWORD _CNV_A_R_LINEAR_____113_CM 1 100. -50. 49.9984741210938 DISPLAY_IDENTIFIER FAC_CYL_LAM_INT[5] ECU_ADDRESS 0xd00005da FORMAT "%7.3" /end MEASUREMENT
/begin MEASUREMENT fac_cyl_lam_int[6] "unlimited output of the cylinder individual controller" SWORD _CNV_A_R_LINEAR_____113_CM 1 100. -50. 49.9984741210938 DISPLAY_IDENTIFIER FAC_CYL_LAM_INT[6] ECU_ADDRESS 0xd00005dc FORMAT "%7.3" /end MEASUREMENT
/begin MEASUREMENT fac_cyl_lam_int[7] "unlimited output of the cylinder individual controller" SWORD _CNV_A_R_LINEAR_____113_CM 1 100. -50. 49.9984741210938 DISPLAY_IDENTIFIER FAC_CYL_LAM_INT[7] ECU_ADDRESS 0xd00005de FORMAT "%7.3" /end MEASUREMENT
/begin MEASUREMENT fac_cyl_lam[0] "output of the cylinder individual controller, shifted by its mean value" SWORD _CNV_A_R_LINEAR_____113_CM 1 100. -50. 49.9984741210938 DISPLAY_IDENTIFIER FAC_CYL_LAM[0] ECU_ADDRESS 0xd000a57c FORMAT "%7.3" /end MEASUREMENT
/begin MEASUREMENT fac_cyl_lam[1] "output of the cylinder individual controller, shifted by its mean value" SWORD _CNV_A_R_LINEAR_____113_CM 1 100. -50. 49.9984741210938 DISPLAY_IDENTIFIER FAC_CYL_LAM[1] ECU_ADDRESS 0xd000a57e FORMAT "%7.3" /end MEASUREMENT
/begin MEASUREMENT fac_cyl_lam[2] "output of the cylinder individual controller, shifted by its mean value" SWORD _CNV_A_R_LINEAR_____113_CM 1 100. -50. 49.9984741210938 DISPLAY_IDENTIFIER FAC_CYL_LAM[2] ECU_ADDRESS 0xd000a580 FORMAT "%7.3" /end MEASUREMENT
/begin MEASUREMENT fac_cyl_lam[3] "output of the cylinder individual controller, shifted by its mean value" SWORD _CNV_A_R_LINEAR_____113_CM 1 100. -50. 49.9984741210938 DISPLAY_IDENTIFIER FAC_CYL_LAM[3] ECU_ADDRESS 0xd000a582 FORMAT "%7.3" /end MEASUREMENT
/begin MEASUREMENT fac_cyl_lam[4] "output of the cylinder individual controller, shifted by its mean value" SWORD _CNV_A_R_LINEAR_____113_CM 1 100. -50. 49.9984741210938 DISPLAY_IDENTIFIER FAC_CYL_LAM[4] ECU_ADDRESS 0xd000a584 FORMAT "%7.3" /end MEASUREMENT
/begin MEASUREMENT fac_cyl_lam[5] "output of the cylinder individual controller, shifted by its mean value" SWORD _CNV_A_R_LINEAR_____113_CM 1 100. -50. 49.9984741210938 DISPLAY_IDENTIFIER FAC_CYL_LAM[5] ECU_ADDRESS 0xd000a586 FORMAT "%7.3" /end MEASUREMENT
/begin MEASUREMENT fac_cyl_lam[6] "output of the cylinder individual controller, shifted by its mean value" SWORD _CNV_A_R_LINEAR_____113_CM 1 100. -50. 49.9984741210938 DISPLAY_IDENTIFIER FAC_CYL_LAM[6] ECU_ADDRESS 0xd000a588 FORMAT "%7.3" /end MEASUREMENT
/begin MEASUREMENT fac_cyl_lam[7] "output of the cylinder individual controller, shifted by its mean value" SWORD _CNV_A_R_LINEAR_____113_CM 1 100. -50. 49.9984741210938 DISPLAY_IDENTIFIER FAC_CYL_LAM[7] ECU_ADDRESS 0xd000a58a FORMAT "%7.3" /end MEASUREMENT
/begin MEASUREMENT delta_lamb_err_cyl_sel[0] "weighted estimation error" SWORD _CNV_A_R_LINEAR_____114_CM 1 100. -8. 7.99975586 DISPLAY_IDENTIFIER DELTA_LAMB_ERR_CYL_SEL[0] ECU_ADDRESS 0xd0000610 FORMAT "%7.4" /end MEASUREMENT
/begin MEASUREMENT delta_lamb_err_cyl_sel[1] "weighted estimation error" SWORD _CNV_A_R_LINEAR_____114_CM 1 100. -8. 7.99975586 DISPLAY_IDENTIFIER DELTA_LAMB_ERR_CYL_SEL[1] ECU_ADDRESS 0xd0000612 FORMAT "%7.4" /end MEASUREMENT
/begin MEASUREMENT delta_lamb_err_cyl_sel[2] "weighted estimation error" SWORD _CNV_A_R_LINEAR_____114_CM 1 100. -8. 7.99975586 DISPLAY_IDENTIFIER DELTA_LAMB_ERR_CYL_SEL[2] ECU_ADDRESS 0xd0000614 FORMAT "%7.4" /end MEASUREMENT
/begin MEASUREMENT delta_lamb_err_cyl_sel[3] "weighted estimation error" SWORD _CNV_A_R_LINEAR_____114_CM 1 100. -8. 7.99975586 DISPLAY_IDENTIFIER DELTA_LAMB_ERR_CYL_SEL[3] ECU_ADDRESS 0xd0000616 FORMAT "%7.4" /end MEASUREMENT
/begin MEASUREMENT delta_lamb_err_cyl_sel[4] "weighted estimation error" SWORD _CNV_A_R_LINEAR_____114_CM 1 100. -8. 7.99975586 DISPLAY_IDENTIFIER DELTA_LAMB_ERR_CYL_SEL[4] ECU_ADDRESS 0xd0000618 FORMAT "%7.4" /end MEASUREMENT
/begin MEASUREMENT delta_lamb_err_cyl_sel[5] "weighted estimation error" SWORD _CNV_A_R_LINEAR_____114_CM 1 100. -8. 7.99975586 DISPLAY_IDENTIFIER DELTA_LAMB_ERR_CYL_SEL[5] ECU_ADDRESS 0xd000061a FORMAT "%7.4" /end MEASUREMENT
/begin MEASUREMENT delta_lamb_err_cyl_sel[6] "weighted estimation error" SWORD _CNV_A_R_LINEAR_____114_CM 1 100. -8. 7.99975586 DISPLAY_IDENTIFIER DELTA_LAMB_ERR_CYL_SEL[6] ECU_ADDRESS 0xd000061c FORMAT "%7.4" /end MEASUREMENT
/begin MEASUREMENT delta_lamb_err_cyl_sel[7] "weighted estimation error" SWORD _CNV_A_R_LINEAR_____114_CM 1 100. -8. 7.99975586 DISPLAY_IDENTIFIER DELTA_LAMB_ERR_CYL_SEL[7] ECU_ADDRESS 0xd000061e FORMAT "%7.4" /end MEASUREMENT
/begin MEASUREMENT delta_lamb_dif_cyl[0] "control error for each cylinder" SWORD _CNV_A_R_LINEAR_____12_CM 1 100. -8. 7.99975586 DISPLAY_IDENTIFIER DELTA_LAMB_DIF_CYL[0] ECU_ADDRESS 0xd0000630 FORMAT "%7.4" /end MEASUREMENT
/begin MEASUREMENT delta_lamb_dif_cyl[1] "control error for each cylinder" SWORD _CNV_A_R_LINEAR_____12_CM 1 100. -8. 7.99975586 DISPLAY_IDENTIFIER DELTA_LAMB_DIF_CYL[1] ECU_ADDRESS 0xd0000632 FORMAT "%7.4" /end MEASUREMENT
/begin MEASUREMENT delta_lamb_dif_cyl[2] "control error for each cylinder" SWORD _CNV_A_R_LINEAR_____12_CM 1 100. -8. 7.99975586 DISPLAY_IDENTIFIER DELTA_LAMB_DIF_CYL[2] ECU_ADDRESS 0xd0000634 FORMAT "%7.4" /end MEASUREMENT
/begin MEASUREMENT delta_lamb_dif_cyl[3] "control error for each cylinder" SWORD _CNV_A_R_LINEAR_____12_CM 1 100. -8. 7.99975586 DISPLAY_IDENTIFIER DELTA_LAMB_DIF_CYL[3] ECU_ADDRESS 0xd0000636 FORMAT "%7.4" /end MEASUREMENT
/begin MEASUREMENT delta_lamb_dif_cyl[4] "control error for each cylinder" SWORD _CNV_A_R_LINEAR_____12_CM 1 100. -8. 7.99975586 DISPLAY_IDENTIFIER DELTA_LAMB_DIF_CYL[4] ECU_ADDRESS 0xd0000638 FORMAT "%7.4" /end MEASUREMENT
/begin MEASUREMENT delta_lamb_dif_cyl[5] "control error for each cylinder" SWORD _CNV_A_R_LINEAR_____12_CM 1 100. -8. 7.99975586 DISPLAY_IDENTIFIER DELTA_LAMB_DIF_CYL[5] ECU_ADDRESS 0xd000063a FORMAT "%7.4" /end MEASUREMENT
/begin MEASUREMENT delta_lamb_dif_cyl[6] "control error for each cylinder" SWORD _CNV_A_R_LINEAR_____12_CM 1 100. -8. 7.99975586 DISPLAY_IDENTIFIER DELTA_LAMB_DIF_CYL[6] ECU_ADDRESS 0xd000063c FORMAT "%7.4" /end MEASUREMENT
/begin MEASUREMENT delta_lamb_dif_cyl[7] "control error for each cylinder" SWORD _CNV_A_R_LINEAR_____12_CM 1 100. -8. 7.99975586 DISPLAY_IDENTIFIER DELTA_LAMB_DIF_CYL[7] ECU_ADDRESS 0xd000063e FORMAT "%7.4" /end MEASUREMENT
/begin MEASUREMENT vls_cyl_sel[0] "upstream oxygen sensor voltage (cylinder individual)" UWORD _CNV_A_R_LINEAR_____2_CM 1 100. 0. 4.9951171875 DISPLAY_IDENTIFIER VLS_CYL_SEL[0] ECU_ADDRESS 0xd0000650 FORMAT "%5.3" /end MEASUREMENT
/begin MEASUREMENT vls_cyl_sel[1] "upstream oxygen sensor voltage (cylinder individual)" UWORD _CNV_A_R_LINEAR_____2_CM 1 100. 0. 4.9951171875 DISPLAY_IDENTIFIER VLS_CYL_SEL[1] ECU_ADDRESS 0xd0000652 FORMAT "%5.3" /end MEASUREMENT
/begin MEASUREMENT vls_cyl_sel[2] "upstream oxygen sensor voltage (cylinder individual)" UWORD _CNV_A_R_LINEAR_____2_CM 1 100. 0. 4.9951171875 DISPLAY_IDENTIFIER VLS_CYL_SEL[2] ECU_ADDRESS 0xd0000654 FORMAT "%5.3" /end MEASUREMENT
/begin MEASUREMENT vls_cyl_sel[3] "upstream oxygen sensor voltage (cylinder individual)" UWORD _CNV_A_R_LINEAR_____2_CM 1 100. 0. 4.9951171875 DISPLAY_IDENTIFIER VLS_CYL_SEL[3] ECU_ADDRESS 0xd0000656 FORMAT "%5.3" /end MEASUREMENT
/begin MEASUREMENT vls_cyl_sel[4] "upstream oxygen sensor voltage (cylinder individual)" UWORD _CNV_A_R_LINEAR_____2_CM 1 100. 0. 4.9951171875 DISPLAY_IDENTIFIER VLS_CYL_SEL[4] ECU_ADDRESS 0xd0000658 FORMAT "%5.3" /end MEASUREMENT
/begin MEASUREMENT vls_cyl_sel[5] "upstream oxygen sensor voltage (cylinder individual)" UWORD _CNV_A_R_LINEAR_____2_CM 1 100. 0. 4.9951171875 DISPLAY_IDENTIFIER VLS_CYL_SEL[5] ECU_ADDRESS 0xd000065a FORMAT "%5.3" /end MEASUREMENT
/begin MEASUREMENT vls_cyl_sel[6] "upstream oxygen sensor voltage (cylinder individual)" UWORD _CNV_A_R_LINEAR_____2_CM 1 100. 0. 4.9951171875 DISPLAY_IDENTIFIER VLS_CYL_SEL[6] ECU_ADDRESS 0xd000065c FORMAT "%5.3" /end MEASUREMENT
/begin MEASUREMENT vls_cyl_sel[7] "upstream oxygen sensor voltage (cylinder individual)" UWORD _CNV_A_R_LINEAR_____2_CM 1 100. 0. 4.9951171875 DISPLAY_IDENTIFIER VLS_CYL_SEL[7] ECU_ADDRESS 0xd000065e FORMAT "%5.3" /end MEASUREMENT
/begin MEASUREMENT delta_lamb_cyl_sel_cq_2 "characteristic value of the estimated values" UWORD _CNV_A_R_LINEAR_____115_CM 1 100. 0. 7.9998779296875 DISPLAY_IDENTIFIER DELTA_LAMB_CYL_SEL_CQ[2] ECU_ADDRESS 0xd000a602 FORMAT "%6.4" /end MEASUREMENT
/begin MEASUREMENT lv_lam_cyl_act_2 "cylinder individual lambda control is active" UBYTE _CNV_S_2_RANGE__0___1_CM 1 100. 0. 1. DISPLAY_IDENTIFIER LV_LAM_CYL_ACT[2] ECU_ADDRESS 0xd00089aa BIT_MASK 0x1 /end MEASUREMENT
/begin MEASUREMENT cyl_lam_2.delta_lamb_av "signal value of the WRAF sensor, sampled with an appropriate resolution and shifted by its mean value" SWORD _CNV_A_R_LINEAR_____12_CM 1 100. -8. 7.99975586 DISPLAY_IDENTIFIER DELTA_LAMB_AV[2] ECU_ADDRESS 0xd00005b8 FORMAT "%7.4" /end MEASUREMENT
/begin MEASUREMENT cyl_lam_2.delta_lamb_mdl "estimated value of the WRAF sensor" SWORD _CNV_A_R_LINEAR_____12_CM 1 100. -8. 7.99975586 DISPLAY_IDENTIFIER DELTA_LAMB_MDL[2] ECU_ADDRESS 0xd00005ba FORMAT "%7.4" /end MEASUREMENT
/begin MEASUREMENT cyl_lam_2.delta_lamb_err_raw "difference between the measured and the estimated value of the WRAF sensor" SWORD _CNV_A_R_LINEAR_____12_CM 1 100. -8. 7.99975586 DISPLAY_IDENTIFIER DELTA_LAMB_ERR_RAW[2] ECU_ADDRESS 0xd00005bc FORMAT "%7.4" /end MEASUREMENT
/begin MEASUREMENT cyl_lam_2.delta_lamb_err "weighted estimation error" SWORD _CNV_A_R_LINEAR_____114_CM 1 100. -8. 7.99975586 DISPLAY_IDENTIFIER DELTA_LAMB_ERR[2] ECU_ADDRESS 0xd00005be FORMAT "%7.4" /end MEASUREMENT
/begin MEASUREMENT cyl_lam_2.delta_lamb_cyl_sel "reassembled signal, made of individual adjusted signals" SWORD _CNV_A_R_LINEAR_____12_CM 1 100. -8. 7.99975586 DISPLAY_IDENTIFIER DELTA_LAMB_CYL_SEL[2] ECU_ADDRESS 0xd00005c0 FORMAT "%7.4" /end MEASUREMENT
/begin MEASUREMENT cyl_lam_2.fac_t "time factor for the exponential function for the sensor model" UWORD _CNV_A_R_LINEAR_____116_CM 1 100. 0. 63.99902344 DISPLAY_IDENTIFIER FAC_T[2] ECU_ADDRESS 0xd00005c2 FORMAT "%7.4" /end MEASUREMENT
/begin MEASUREMENT cyl_lam_2.lv_lam_cyl_sel_seg_ref_cll "Segment based reference flag to close the control loop" UBYTE _CNV_S_2_RANGE__0___1_CM 1 100. 0. 1. DISPLAY_IDENTIFIER LV_LAM_CYL_SEL_SEG_REF_CLL[2] ECU_ADDRESS 0xd00005c4 BIT_MASK 0x1 /end MEASUREMENT
/begin CHARACTERISTIC c_cyl_lam_out_min "lower limit of the cylinder individual controller output" VALUE 0xa080bc38 _REC_VAL_20_s2 99.99847412109381 _CNV_A_R_LINEAR_____113_CM -50. 49.9984741210938 DISPLAY_IDENTIFIER C_CYL_LAM_OUT_MIN FORMAT "%7.3" /end CHARACTERISTIC
/begin CHARACTERISTIC c_cyl_lam_out_max "upper limit of the cylinder individual controller output" VALUE 0xa080bc36 _REC_VAL_20_s2 99.99847412109381 _CNV_A_R_LINEAR_____113_CM -50. 49.9984741210938 DISPLAY_IDENTIFIER C_CYL_LAM_OUT_MAX FORMAT "%7.3" /end CHARACTERISTIC
/begin CHARACTERISTIC c_cyl_lam_diag_min "lower diagnosis limit of the cylinder individual controller output" VALUE 0xa080bc34 _REC_VAL_20_s2 99.99847412109381 _CNV_A_R_LINEAR_____113_CM -50. 49.9984741210938 DISPLAY_IDENTIFIER C_CYL_LAM_DIAG_MIN FORMAT "%7.3" /end CHARACTERISTIC
/begin CHARACTERISTIC c_delta_lamb_cyl_sp "setpoint value" VALUE 0xa080bc40 _REC_VAL_20_s2 15.99975586 _CNV_A_R_LINEAR_____12_CM -8. 7.99975586 DISPLAY_IDENTIFIER C_DELTA_LAMB_CYL_SP FORMAT "%7.4" /end CHARACTERISTIC
/begin CHARACTERISTIC c_crlc_exv_fac_0 "exhaust-valve manifold-port correlation factor" VALUE 0xa080bad2 _REC_VAL_20_u2 1.99996948242188 _CNV_A_R_LINEAR_____9_CM 0. 1.99996948242188 DISPLAY_IDENTIFIER C_CRLC_EXV_FAC_0 FORMAT "%7.5" /end CHARACTERISTIC
/begin CHARACTERISTIC c_crlc_exv_fac_1 "exhaust-valve manifold-port correlation factor" VALUE 0xa080bad4 _REC_VAL_20_u2 1.99996948242188 _CNV_A_R_LINEAR_____9_CM 0. 1.99996948242188 DISPLAY_IDENTIFIER C_CRLC_EXV_FAC_1 FORMAT "%7.5" /end CHARACTERISTIC
/begin CHARACTERISTIC c_crlc_exv_fac_2 "exhaust-valve manifold-port correlation factor" VALUE 0xa080bad6 _REC_VAL_20_u2 1.99996948242188 _CNV_A_R_LINEAR_____9_CM 0. 1.99996948242188 DISPLAY_IDENTIFIER C_CRLC_EXV_FAC_2 FORMAT "%7.5" /end CHARACTERISTIC
/begin CHARACTERISTIC c_crlc_exv_fac_3 "exhaust-valve manifold-port correlation factor" VALUE 0xa080bad8 _REC_VAL_20_u2 1.99996948242188 _CNV_A_R_LINEAR_____9_CM 0. 1.99996948242188 DISPLAY_IDENTIFIER C_CRLC_EXV_FAC_3 FORMAT "%7.5" /end CHARACTERISTIC
/begin CHARACTERISTIC c_crlc_exv_fac_4 "exhaust-valve manifold-port correlation factor" VALUE 0xa080bada _REC_VAL_20_u2 1.99996948242188 _CNV_A_R_LINEAR_____9_CM 0. 1.99996948242188 DISPLAY_IDENTIFIER C_CRLC_EXV_FAC_4 FORMAT "%7.5" /end CHARACTERISTIC
/begin CHARACTERISTIC c_crlc_exv_fac_5 "exhaust-valve manifold-port correlation factor" VALUE 0xa080badc _REC_VAL_20_u2 1.99996948242188 _CNV_A_R_LINEAR_____9_CM 0. 1.99996948242188 DISPLAY_IDENTIFIER C_CRLC_EXV_FAC_5 FORMAT "%7.5" /end CHARACTERISTIC
/begin CHARACTERISTIC c_crlc_exv_fac_6 "exhaust-valve manifold-port correlation factor" VALUE 0xa080bade _REC_VAL_20_u2 1.99996948242188 _CNV_A_R_LINEAR_____9_CM 0. 1.99996948242188 DISPLAY_IDENTIFIER C_CRLC_EXV_FAC_6 FORMAT "%7.5" /end CHARACTERISTIC
/begin CHARACTERISTIC c_crlc_exv_fac_7 "exhaust-valve manifold-port correlation factor" VALUE 0xa080bae0 _REC_VAL_20_u2 1.99996948242188 _CNV_A_R_LINEAR_____9_CM 0. 1.99996948242188 DISPLAY_IDENTIFIER C_CRLC_EXV_FAC_7 FORMAT "%7.5" /end CHARACTERISTIC
/begin CHARACTERISTIC c_crk_cyl_lam_6 "factor for different distance between lambda sensor and cylinder individual exaust-valves" VALUE 0xa080babf _REC_VAL_20_s1 1440. _CNV_A_R_LINEAR_____112_CM -720. 720. DISPLAY_IDENTIFIER C_CRK_CYL_LAM_6 FORMAT "%4.0" /end CHARACTERISTIC
/begin CHARACTERISTIC c_crk_cyl_lam_7 "factor for different distance between lambda sensor and cylinder individual exaust-valves" VALUE 0xa080bac0 _REC_VAL_20_s1 1440. _CNV_A_R_LINEAR_____112_CM -720. 720. DISPLAY_IDENTIFIER C_CRK_CYL_LAM_7 FORMAT "%4.0" /end CHARACTERISTIC
/begin AXIS_PTS ldpm_fac_t_2_1_cybl "" 0xa08093d8 online_dummy _REC_AXS_20_u2 63.99902344 _CNV_A_R_LINEAR_____116_CM 16 0. 63.99902344 FORMAT "%7.4" /end AXIS_PTS
/begin AXIS_PTS ldpm_maf_1_cybl "" 0xa0809478 maf _REC_AXS_20_u2 1389. _CNV_A_R_LINEAR_____111_CM 8 0. 1389. FORMAT "%7.2" /end AXIS_PTS
/begin CHARACTERISTIC ip_exp_lamb_mdl_2 "exponential function for the sensor model" CURVE 0xa080a27c _REC_CUR_20_u2_u2 0.9999847412109381 _CNV_A_R_LINEAR_____89_CM 0. 0.9999847412109381 DISPLAY_IDENTIFIER IP_EXP_LAMB_MDL[2] FORMAT "%7.5"
 /begin AXIS_DESCR COM_AXIS online_dummy _CNV_A_R_LINEAR_____116_CM 16 0. 63.99902344 FORMAT "%7.4" AXIS_PTS_REF ldpm_fac_t_2_1_cybl /end AXIS_DESCR
/end CHARACTERISTIC
/begin CHARACTERISTIC ip_n1_fac_lamb_mdl_2 "N1 coefficient of the sensor model" CURVE 0xa080af5c _REC_CUR_20_u2_u2 0.9999847412109381 _CNV_A_R_LINEAR_____89_CM 0. 0.9999847412109381 DISPLAY_IDENTIFIER IP_N1_FAC_LAMB_MDL[2] FORMAT "%7.5"
 /begin AXIS_DESCR COM_AXIS online_dummy _CNV_A_R_LINEAR_____116_CM 16 0. 63.99902344 FORMAT "%7.4" AXIS_PTS_REF ldpm_fac_t_2_1_cybl /end AXIS_DESCR
/end CHARACTERISTIC
/begin CHARACTERISTIC ip_n2_fac_lamb_mdl_2 "N2 coefficient of the sensor model" CURVE 0xa080af9c _REC_CUR_20_u2_u2 0.9999847412109381 _CNV_A_R_LINEAR_____89_CM 0. 0.9999847412109381 DISPLAY_IDENTIFIER IP_N2_FAC_LAMB_MDL[2] FORMAT "%7.5"
 /begin AXIS_DESCR COM_AXIS online_dummy _CNV_A_R_LINEAR_____116_CM 16 0. 63.99902344 FORMAT "%7.4" AXIS_PTS_REF ldpm_fac_t_2_1_cybl /end AXIS_DESCR
/end CHARACTERISTIC
/begin CHARACTERISTIC ip_crk_syn_1 "phase displacement" MAP 0xa0809fbc _REC_MAP_20_u1_u2_u2 1440. _CNV_A_R_LINEAR_____112_CM 0. 1440. DISPLAY_IDENTIFIER IP_CRK_SYN[1] FORMAT "%4.0"
 /begin AXIS_DESCR COM_AXIS n _CNV_A_R_LINEAR_____14_CM 8 0. 8160. FORMAT "%4.0" AXIS_PTS_REF ldpm_n_1_cybl /end AXIS_DESCR
 /begin AXIS_DESCR COM_AXIS maf _CNV_A_R_LINEAR_____111_CM 8 0. 1389. FORMAT "%7.2" AXIS_PTS_REF ldpm_maf_1_cybl /end AXIS_DESCR
/end CHARACTERISTIC
/begin CHARACTERISTIC ip_crk_syn_2 "phase displacement" MAP 0xa0809ffc _REC_MAP_20_u1_u2_u2 1440. _CNV_A_R_LINEAR_____112_CM 0. 1440. DISPLAY_IDENTIFIER IP_CRK_SYN[2] FORMAT "%4.0"
 /begin AXIS_DESCR COM_AXIS n _CNV_A_R_LINEAR_____14_CM 8 0. 8160. FORMAT "%4.0" AXIS_PTS_REF ldpm_n_1_cybl /end AXIS_DESCR
 /begin AXIS_DESCR COM_AXIS maf _CNV_A_R_LINEAR_____111_CM 8 0. 1389. FORMAT "%7.2" AXIS_PTS_REF ldpm_maf_1_cybl /end AXIS_DESCR
/end CHARACTERISTIC
/begin CHARACTERISTIC ip_t1_lamb_cyl_sel_1 "time lag of the lambda sensor model specified for cylinder individual lambda control" MAP 0xa0815cbc _REC_MAP_20_u2_u2_u2 1.99996948242188 _CNV_A_R_LINEAR_____117_CM 0. 1.99996948242188 DISPLAY_IDENTIFIER IP_T1_LAMB_CYL_SEL[1] FORMAT "%7.5"
 /begin AXIS_DESCR COM_AXIS n _CNV_A_R_LINEAR_____14_CM 8 0. 8160. FORMAT "%4.0" AXIS_PTS_REF ldpm_n_1_cybl /end AXIS_DESCR
 /begin AXIS_DESCR COM_AXIS maf _CNV_A_R_LINEAR_____111_CM 8 0. 1389. FORMAT "%7.2" AXIS_PTS_REF ldpm_maf_1_cybl /end AXIS_DESCR
/end CHARACTERISTIC
/begin CHARACTERISTIC ip_t1_lamb_cyl_sel_2 "time lag of the lambda sensor model specified for cylinder individual lambda control" MAP 0xa0815d3c _REC_MAP_20_u2_u2_u2 1.99996948242188 _CNV_A_R_LINEAR_____117_CM 0. 1.99996948242188 DISPLAY_IDENTIFIER IP_T1_LAMB_CYL_SEL[2] FORMAT "%7.5"
 /begin AXIS_DESCR COM_AXIS n _CNV_A_R_LINEAR_____14_CM 8 0. 8160. FORMAT "%4.0" AXIS_PTS_REF ldpm_n_1_cybl /end AXIS_DESCR
 /begin AXIS_DESCR COM_AXIS maf _CNV_A_R_LINEAR_____111_CM 8 0. 1389. FORMAT "%7.2" AXIS_PTS_REF ldpm_maf_1_cybl /end AXIS_DESCR
/end CHARACTERISTIC
/begin MEASUREMENT lv_cyl_lam_lim_max_0 "status detection of upper limit outrun" UBYTE _CNV_A_R_LINEAR_____0_CM 1 100. 0. 1. DISPLAY_IDENTIFIER LV_CYL_LAM_LIM_MAX[0] ECU_ADDRESS 0xd000898b FORMAT "%3.0" BIT_MASK 0x1 /end MEASUREMENT
/begin MEASUREMENT lv_cyl_lam_lim_max_1 "status detection of upper limit outrun" UBYTE _CNV_A_R_LINEAR_____0_CM 1 100. 0. 1. DISPLAY_IDENTIFIER LV_CYL_LAM_LIM_MAX[1] ECU_ADDRESS 0xd000898c FORMAT "%3.0" BIT_MASK 0x1 /end MEASUREMENT
/begin MEASUREMENT lv_cyl_lam_lim_max_2 "status detection of upper limit outrun" UBYTE _CNV_A_R_LINEAR_____0_CM 1 100. 0. 1. DISPLAY_IDENTIFIER LV_CYL_LAM_LIM_MAX[2] ECU_ADDRESS 0xd000898d FORMAT "%3.0" BIT_MASK 0x1 /end MEASUREMENT
/begin MEASUREMENT lv_cyl_lam_lim_max_3 "status detection of upper limit outrun" UBYTE _CNV_A_R_LINEAR_____0_CM 1 100. 0. 1. DISPLAY_IDENTIFIER LV_CYL_LAM_LIM_MAX[3] ECU_ADDRESS 0xd0008995 FORMAT "%3.0" BIT_MASK 0x1 /end MEASUREMENT
/begin MEASUREMENT lv_cyl_lam_lim_max_4 "status detection of upper limit outrun" UBYTE _CNV_A_R_LINEAR_____0_CM 1 100. 0. 1. DISPLAY_IDENTIFIER LV_CYL_LAM_LIM_MAX[4] ECU_ADDRESS 0xd0008999 FORMAT "%3.0" BIT_MASK 0x1 /end MEASUREMENT
/begin MEASUREMENT lv_cyl_lam_lim_max_5 "status detection of upper limit outrun" UBYTE _CNV_A_R_LINEAR_____0_CM 1 100. 0. 1. DISPLAY_IDENTIFIER LV_CYL_LAM_LIM_MAX[5] ECU_ADDRESS 0xd000899d FORMAT "%3.0" BIT_MASK 0x1 /end MEASUREMENT
/begin MEASUREMENT lv_cyl_lam_lim_max_6 "status detection of upper limit outrun" UBYTE _CNV_A_R_LINEAR_____0_CM 1 100. 0. 1. DISPLAY_IDENTIFIER LV_CYL_LAM_LIM_MAX[6] ECU_ADDRESS 0xd00089a1 FORMAT "%3.0" BIT_MASK 0x1 /end MEASUREMENT
/begin MEASUREMENT lv_cyl_lam_lim_max_7 "status detection of upper limit outrun" UBYTE _CNV_A_R_LINEAR_____0_CM 1 100. 0. 1. DISPLAY_IDENTIFIER LV_CYL_LAM_LIM_MAX[7] ECU_ADDRESS 0xd00089a5 FORMAT "%3.0" BIT_MASK 0x1 /end MEASUREMENT
/begin MEASUREMENT lv_cyl_lam_lim_min_0 "status detection of lower limit outrun" UBYTE _CNV_A_R_LINEAR_____0_CM 1 100. 0. 1. DISPLAY_IDENTIFIER LV_CYL_LAM_LIM_MIN[0] ECU_ADDRESS 0xd0008988 FORMAT "%3.0" BIT_MASK 0x1 /end MEASUREMENT
/begin MEASUREMENT lv_cyl_lam_lim_min_1 "status detection of lower limit outrun" UBYTE _CNV_A_R_LINEAR_____0_CM 1 100. 0. 1. DISPLAY_IDENTIFIER LV_CYL_LAM_LIM_MIN[1] ECU_ADDRESS 0xd0008989 FORMAT "%3.0" BIT_MASK 0x1 /end MEASUREMENT
/begin MEASUREMENT lv_cyl_lam_lim_min_2 "status detection of lower limit outrun" UBYTE _CNV_A_R_LINEAR_____0_CM 1 100. 0. 1. DISPLAY_IDENTIFIER LV_CYL_LAM_LIM_MIN[2] ECU_ADDRESS 0xd000898a FORMAT "%3.0" BIT_MASK 0x1 /end MEASUREMENT
/begin MEASUREMENT lv_cyl_lam_lim_min_3 "status detection of lower limit outrun" UBYTE _CNV_A_R_LINEAR_____0_CM 1 100. 0. 1. DISPLAY_IDENTIFIER LV_CYL_LAM_LIM_MIN[3] ECU_ADDRESS 0xd0008994 FORMAT "%3.0" BIT_MASK 0x1 /end MEASUREMENT
/begin MEASUREMENT lv_cyl_lam_lim_min_4 "status detection of lower limit outrun" UBYTE _CNV_A_R_LINEAR_____0_CM 1 100. 0. 1. DISPLAY_IDENTIFIER LV_CYL_LAM_LIM_MIN[4] ECU_ADDRESS 0xd0008998 FORMAT "%3.0" BIT_MASK 0x1 /end MEASUREMENT
/begin MEASUREMENT lv_cyl_lam_lim_min_5 "status detection of lower limit outrun" UBYTE _CNV_A_R_LINEAR_____0_CM 1 100. 0. 1. DISPLAY_IDENTIFIER LV_CYL_LAM_LIM_MIN[5] ECU_ADDRESS 0xd000899c FORMAT "%3.0" BIT_MASK 0x1 /end MEASUREMENT
/begin MEASUREMENT lv_cyl_lam_lim_min_6 "status detection of lower limit outrun" UBYTE _CNV_A_R_LINEAR_____0_CM 1 100. 0. 1. DISPLAY_IDENTIFIER LV_CYL_LAM_LIM_MIN[6] ECU_ADDRESS 0xd00089a0 FORMAT "%3.0" BIT_MASK 0x1 /end MEASUREMENT
/begin MEASUREMENT lv_cyl_lam_diag_lim_max_1 "diagnosis status detection of upper limit outrun" UBYTE _CNV_A_R_LINEAR_____0_CM 1 100. 0. 1. DISPLAY_IDENTIFIER LV_CYL_LAM_DIAG_LIM_MAX[1] ECU_ADDRESS 0xd0008992 FORMAT "%3.0" BIT_MASK 0x1 /end MEASUREMENT
/begin MEASUREMENT lv_cyl_lam_diag_lim_max_2 "diagnosis status detection of upper limit outrun" UBYTE _CNV_A_R_LINEAR_____0_CM 1 100. 0. 1. DISPLAY_IDENTIFIER LV_CYL_LAM_DIAG_LIM_MAX[2] ECU_ADDRESS 0xd0008993 FORMAT "%3.0" BIT_MASK 0x1 /end MEASUREMENT
/begin MEASUREMENT lv_cyl_lam_diag_lim_max_3 "diagnosis status detection of upper limit outrun" UBYTE _CNV_A_R_LINEAR_____0_CM 1 100. 0. 1. DISPLAY_IDENTIFIER LV_CYL_LAM_DIAG_LIM_MAX[3] ECU_ADDRESS 0xd0008997 FORMAT "%3.0" BIT_MASK 0x1 /end MEASUREMENT
/begin MEASUREMENT lv_cyl_lam_diag_lim_max_4 "diagnosis status detection of upper limit outrun" UBYTE _CNV_A_R_LINEAR_____0_CM 1 100. 0. 1. DISPLAY_IDENTIFIER LV_CYL_LAM_DIAG_LIM_MAX[4] ECU_ADDRESS 0xd000899b FORMAT "%3.0" BIT_MASK 0x1 /end MEASUREMENT
/begin MEASUREMENT lv_cyl_lam_diag_lim_max_5 "diagnosis status detection of upper limit outrun" UBYTE _CNV_A_R_LINEAR_____0_CM 1 100. 0. 1. DISPLAY_IDENTIFIER LV_CYL_LAM_DIAG_LIM_MAX[5] ECU_ADDRESS 0xd000899f FORMAT "%3.0" BIT_MASK 0x1 /end MEASUREMENT
/begin MEASUREMENT lv_cyl_lam_diag_lim_max_6 "diagnosis status detection of upper limit outrun" UBYTE _CNV_A_R_LINEAR_____0_CM 1 100. 0. 1. DISPLAY_IDENTIFIER LV_CYL_LAM_DIAG_LIM_MAX[6] ECU_ADDRESS 0xd00089a3 FORMAT "%3.0" BIT_MASK 0x1 /end MEASUREMENT
/begin MEASUREMENT lv_cyl_lam_diag_lim_max_7 "diagnosis status detection of upper limit outrun" UBYTE _CNV_A_R_LINEAR_____0_CM 1 100. 0. 1. DISPLAY_IDENTIFIER LV_CYL_LAM_DIAG_LIM_MAX[7] ECU_ADDRESS 0xd00089a7 FORMAT "%3.0" BIT_MASK 0x1 /end MEASUREMENT
/begin MEASUREMENT lv_cyl_lam_diag_lim_min_0 "diagnosis status detection of lower limit outrun" UBYTE _CNV_A_R_LINEAR_____0_CM 1 100. 0. 1. DISPLAY_IDENTIFIER LV_CYL_LAM_DIAG_LIM_MIN[0] ECU_ADDRESS 0xd000898e FORMAT "%3.0" BIT_MASK 0x1 /end MEASUREMENT
/begin MEASUREMENT lv_cyl_lam_diag_lim_min_1 "diagnosis status detection of lower limit outrun" UBYTE _CNV_A_R_LINEAR_____0_CM 1 100. 0. 1. DISPLAY_IDENTIFIER LV_CYL_LAM_DIAG_LIM_MIN[1] ECU_ADDRESS 0xd000898f FORMAT "%3.0" BIT_MASK 0x1 /end MEASUREMENT
/begin MEASUREMENT lv_cyl_lam_diag_lim_min_2 "diagnosis status detection of lower limit outrun" UBYTE _CNV_A_R_LINEAR_____0_CM 1 100. 0. 1. DISPLAY_IDENTIFIER LV_CYL_LAM_DIAG_LIM_MIN[2] ECU_ADDRESS 0xd0008990 FORMAT "%3.0" BIT_MASK 0x1 /end MEASUREMENT
/begin MEASUREMENT lv_cyl_lam_diag_lim_min_3 "diagnosis status detection of lower limit outrun" UBYTE _CNV_A_R_LINEAR_____0_CM 1 100. 0. 1. DISPLAY_IDENTIFIER LV_CYL_LAM_DIAG_LIM_MIN[3] ECU_ADDRESS 0xd0008996 FORMAT "%3.0" BIT_MASK 0x1 /end MEASUREMENT
/begin MEASUREMENT lv_cyl_lam_diag_lim_min_4 "diagnosis status detection of lower limit outrun" UBYTE _CNV_A_R_LINEAR_____0_CM 1 100. 0. 1. DISPLAY_IDENTIFIER LV_CYL_LAM_DIAG_LIM_MIN[4] ECU_ADDRESS 0xd000899a FORMAT "%3.0" BIT_MASK 0x1 /end MEASUREMENT
/begin MEASUREMENT lv_cyl_lam_diag_lim_min_5 "diagnosis status detection of lower limit outrun" UBYTE _CNV_A_R_LINEAR_____0_CM 1 100. 0. 1. DISPLAY_IDENTIFIER LV_CYL_LAM_DIAG_LIM_MIN[5] ECU_ADDRESS 0xd000899e FORMAT "%3.0" BIT_MASK 0x1 /end MEASUREMENT
/begin MEASUREMENT lv_cyl_lam_diag_lim_min_6 "diagnosis status detection of lower limit outrun" UBYTE _CNV_A_R_LINEAR_____0_CM 1 100. 0. 1. DISPLAY_IDENTIFIER LV_CYL_LAM_DIAG_LIM_MIN[6] ECU_ADDRESS 0xd00089a2 FORMAT "%3.0" BIT_MASK 0x1 /end MEASUREMENT
/begin MEASUREMENT lv_cyl_lam_diag_lim_min_7 "diagnosis status detection of lower limit outrun" UBYTE _CNV_A_R_LINEAR_____0_CM 1 100. 0. 1. DISPLAY_IDENTIFIER LV_CYL_LAM_DIAG_LIM_MIN[7] ECU_ADDRESS 0xd00089a6 FORMAT "%3.0" BIT_MASK 0x1 /end MEASUREMENT
/begin CHARACTERISTIC c_cyl_lam_diag_max "upper diagnosis limit of the cylinder individual controller output" VALUE 0xa080bc32 _REC_VAL_20_s2 99.99847412109381 _CNV_A_R_LINEAR_____113_CM -50. 49.9984741210938 DISPLAY_IDENTIFIER C_CYL_LAM_DIAG_MAX FORMAT "%7.3" /end CHARACTERISTIC
/begin CHARACTERISTIC lc_adapt_cor_out "adaptation switch" VALUE 0xa080c536 _REC_VAL_20_u1 1. _CNV_A_R_LINEAR_____0_CM 0. 1. DISPLAY_IDENTIFIER LC_ADAPT_COR_OUT FORMAT "%1.0" /end CHARACTERISTIC
/begin AXIS_PTS ldp_t1_lamb_cyl_i_ip_fac_err "" 0xa0808ca4 online_dummy _REC_AXS_20_u2 1.99996948242188 _CNV_A_R_LINEAR_____117_CM 6 0. 1.99996948242188 FORMAT "%7.5" /end AXIS_PTS
/begin MEASUREMENT fac_lam_cyl_sel_adj[0] "adaptive correction factor" SWORD _CNV_A_R_LINEAR_____113_CM 1 100. -50. 49.9984741210938 DISPLAY_IDENTIFIER FAC_LAM_CYL_SEL_ADJ[0] ECU_ADDRESS 0xd000a59c FORMAT "%7.3" /end MEASUREMENT
/begin MEASUREMENT fac_lam_cyl_sel_adj[1] "adaptive correction factor" SWORD _CNV_A_R_LINEAR_____113_CM 1 100. -50. 49.9984741210938 DISPLAY_IDENTIFIER FAC_LAM_CYL_SEL_ADJ[1] ECU_ADDRESS 0xd000a59e FORMAT "%7.3" /end MEASUREMENT
/begin MEASUREMENT fac_lam_cyl_sel_adj[2] "adaptive correction factor" SWORD _CNV_A_R_LINEAR_____113_CM 1 100. -50. 49.9984741210938 DISPLAY_IDENTIFIER FAC_LAM_CYL_SEL_ADJ[2] ECU_ADDRESS 0xd000a5a0 FORMAT "%7.3" /end MEASUREMENT
/begin MEASUREMENT fac_lam_cyl_sel_adj[3] "adaptive correction factor" SWORD _CNV_A_R_LINEAR_____113_CM 1 100. -50. 49.9984741210938 DISPLAY_IDENTIFIER FAC_LAM_CYL_SEL_ADJ[3] ECU_ADDRESS 0xd000a5a2 FORMAT "%7.3" /end MEASUREMENT
/begin MEASUREMENT fac_lam_cyl_sel_adj[4] "adaptive correction factor" SWORD _CNV_A_R_LINEAR_____113_CM 1 100. -50. 49.9984741210938 DISPLAY_IDENTIFIER FAC_LAM_CYL_SEL_ADJ[4] ECU_ADDRESS 0xd000a5a4 FORMAT "%7.3" /end MEASUREMENT
/begin MEASUREMENT fac_lam_cyl_sel_adj[5] "adaptive correction factor" SWORD _CNV_A_R_LINEAR_____113_CM 1 100. -50. 49.9984741210938 DISPLAY_IDENTIFIER FAC_LAM_CYL_SEL_ADJ[5] ECU_ADDRESS 0xd000a5a6 FORMAT "%7.3" /end MEASUREMENT
/begin MEASUREMENT fac_lam_cyl_sel_adj[6] "adaptive correction factor" SWORD _CNV_A_R_LINEAR_____113_CM 1 100. -50. 49.9984741210938 DISPLAY_IDENTIFIER FAC_LAM_CYL_SEL_ADJ[6] ECU_ADDRESS 0xd000a5a8 FORMAT "%7.3" /end MEASUREMENT
/begin MEASUREMENT fac_lam_cyl_sel_adj[7] "adaptive correction factor" SWORD _CNV_A_R_LINEAR_____113_CM 1 100. -50. 49.9984741210938 DISPLAY_IDENTIFIER FAC_LAM_CYL_SEL_ADJ[7] ECU_ADDRESS 0xd000a5aa FORMAT "%7.3" /end MEASUREMENT
/begin MEASUREMENT fac_lam_cyl_sel_adj_cst[0] "adaptive correction factor under engine-cold condition" SWORD _CNV_A_R_LINEAR_____113_CM 1 100. -50. 49.9984741210938 DISPLAY_IDENTIFIER FAC_LAM_CYL_SEL_ADJ_CST[0] ECU_ADDRESS 0xd000a5ec FORMAT "%7.3" /end MEASUREMENT
/begin MEASUREMENT fac_lam_cyl_sel_adj_cst[1] "adaptive correction factor under engine-cold condition" SWORD _CNV_A_R_LINEAR_____113_CM 1 100. -50. 49.9984741210938 DISPLAY_IDENTIFIER FAC_LAM_CYL_SEL_ADJ_CST[1] ECU_ADDRESS 0xd000a5ee FORMAT "%7.3" /end MEASUREMENT
/begin MEASUREMENT fac_lam_cyl_sel_adj_cst[2] "adaptive correction factor under engine-cold condition" SWORD _CNV_A_R_LINEAR_____113_CM 1 100. -50. 49.9984741210938 DISPLAY_IDENTIFIER FAC_LAM_CYL_SEL_ADJ_CST[2] ECU_ADDRESS 0xd000a5f0 FORMAT "%7.3" /end MEASUREMENT
/begin MEASUREMENT fac_lam_cyl_sel_adj_cst[3] "adaptive correction factor under engine-cold condition" SWORD _CNV_A_R_LINEAR_____113_CM 1 100. -50. 49.9984741210938 DISPLAY_IDENTIFIER FAC_LAM_CYL_SEL_ADJ_CST[3] ECU_ADDRESS 0xd000a5f2 FORMAT "%7.3" /end MEASUREMENT
/begin MEASUREMENT fac_lam_cyl_sel_adj_cst[4] "adaptive correction factor under engine-cold condition" SWORD _CNV_A_R_LINEAR_____113_CM 1 100. -50. 49.9984741210938 DISPLAY_IDENTIFIER FAC_LAM_CYL_SEL_ADJ_CST[4] ECU_ADDRESS 0xd000a5f4 FORMAT "%7.3" /end MEASUREMENT
/begin MEASUREMENT fac_lam_cyl_sel_adj_cst[5] "adaptive correction factor under engine-cold condition" SWORD _CNV_A_R_LINEAR_____113_CM 1 100. -50. 49.9984741210938 DISPLAY_IDENTIFIER FAC_LAM_CYL_SEL_ADJ_CST[5] ECU_ADDRESS 0xd000a5f6 FORMAT "%7.3" /end MEASUREMENT
/begin MEASUREMENT fac_lam_cyl_sel_adj_cst[6] "adaptive correction factor under engine-cold condition" SWORD _CNV_A_R_LINEAR_____113_CM 1 100. -50. 49.9984741210938 DISPLAY_IDENTIFIER FAC_LAM_CYL_SEL_ADJ_CST[6] ECU_ADDRESS 0xd000a5f8 FORMAT "%7.3" /end MEASUREMENT
/begin MEASUREMENT fac_lam_cyl_sel_adj_cst[7] "adaptive correction factor under engine-cold condition" SWORD _CNV_A_R_LINEAR_____113_CM 1 100. -50. 49.9984741210938 DISPLAY_IDENTIFIER FAC_LAM_CYL_SEL_ADJ_CST[7] ECU_ADDRESS 0xd000a5fa FORMAT "%7.3" /end MEASUREMENT
/begin MEASUREMENT fac_lam_cyl_sel_adj_fil[0] "adaptation filter output" SWORD _CNV_A_R_LINEAR_____113_CM 1 100. -50. 49.9984741210938 DISPLAY_IDENTIFIER FAC_LAM_CYL_SEL_ADJ_FIL[0] ECU_ADDRESS 0xd0000660 FORMAT "%7.3" /end MEASUREMENT
/begin MEASUREMENT fac_lam_cyl_sel_adj_fil[1] "adaptation filter output" SWORD _CNV_A_R_LINEAR_____113_CM 1 100. -50. 49.9984741210938 DISPLAY_IDENTIFIER FAC_LAM_CYL_SEL_ADJ_FIL[1] ECU_ADDRESS 0xd0000662 FORMAT "%7.3" /end MEASUREMENT
/begin MEASUREMENT fac_lam_cyl_sel_adj_fil[2] "adaptation filter output" SWORD _CNV_A_R_LINEAR_____113_CM 1 100. -50. 49.9984741210938 DISPLAY_IDENTIFIER FAC_LAM_CYL_SEL_ADJ_FIL[2] ECU_ADDRESS 0xd0000664 FORMAT "%7.3" /end MEASUREMENT
/begin MEASUREMENT fac_lam_cyl_sel_adj_fil[3] "adaptation filter output" SWORD _CNV_A_R_LINEAR_____113_CM 1 100. -50. 49.9984741210938 DISPLAY_IDENTIFIER FAC_LAM_CYL_SEL_ADJ_FIL[3] ECU_ADDRESS 0xd0000666 FORMAT "%7.3" /end MEASUREMENT
/begin MEASUREMENT fac_lam_cyl_sel_adj_fil[4] "adaptation filter output" SWORD _CNV_A_R_LINEAR_____113_CM 1 100. -50. 49.9984741210938 DISPLAY_IDENTIFIER FAC_LAM_CYL_SEL_ADJ_FIL[4] ECU_ADDRESS 0xd0000668 FORMAT "%7.3" /end MEASUREMENT
/begin MEASUREMENT fac_lam_cyl_sel_adj_fil[5] "adaptation filter output" SWORD _CNV_A_R_LINEAR_____113_CM 1 100. -50. 49.9984741210938 DISPLAY_IDENTIFIER FAC_LAM_CYL_SEL_ADJ_FIL[5] ECU_ADDRESS 0xd000066a FORMAT "%7.3" /end MEASUREMENT
/begin MEASUREMENT fac_lam_cyl_sel_adj_fil[6] "adaptation filter output" SWORD _CNV_A_R_LINEAR_____113_CM 1 100. -50. 49.9984741210938 DISPLAY_IDENTIFIER FAC_LAM_CYL_SEL_ADJ_FIL[6] ECU_ADDRESS 0xd000066c FORMAT "%7.3" /end MEASUREMENT
/begin MEASUREMENT fac_lam_cyl_sel_adj_fil[7] "adaptation filter output" SWORD _CNV_A_R_LINEAR_____113_CM 1 100. -50. 49.9984741210938 DISPLAY_IDENTIFIER FAC_LAM_CYL_SEL_ADJ_FIL[7] ECU_ADDRESS 0xd000066e FORMAT "%7.3" /end MEASUREMENT
/begin MEASUREMENT fac_lam_cyl_sel_adj_cst_fil[0] "adaptation filter output under engine-cold condition" SWORD _CNV_A_R_LINEAR_____113_CM 1 100. -50. 49.9984741210938 DISPLAY_IDENTIFIER FAC_LAM_CYL_SEL_ADJ_CST_FIL[0] ECU_ADDRESS 0xd0000670 FORMAT "%7.3" /end MEASUREMENT
/begin MEASUREMENT fac_lam_cyl_sel_adj_cst_fil[1] "adaptation filter output under engine-cold condition" SWORD _CNV_A_R_LINEAR_____113_CM 1 100. -50. 49.9984741210938 DISPLAY_IDENTIFIER FAC_LAM_CYL_SEL_ADJ_CST_FIL[1] ECU_ADDRESS 0xd0000672 FORMAT "%7.3" /end MEASUREMENT
/begin MEASUREMENT fac_lam_cyl_sel_adj_cst_fil[2] "adaptation filter output under engine-cold condition" SWORD _CNV_A_R_LINEAR_____113_CM 1 100. -50. 49.9984741210938 DISPLAY_IDENTIFIER FAC_LAM_CYL_SEL_ADJ_CST_FIL[2] ECU_ADDRESS 0xd0000674 FORMAT "%7.3" /end MEASUREMENT
/begin MEASUREMENT fac_lam_cyl_sel_adj_cst_fil[3] "adaptation filter output under engine-cold condition" SWORD _CNV_A_R_LINEAR_____113_CM 1 100. -50. 49.9984741210938 DISPLAY_IDENTIFIER FAC_LAM_CYL_SEL_ADJ_CST_FIL[3] ECU_ADDRESS 0xd0000676 FORMAT "%7.3" /end MEASUREMENT
/begin MEASUREMENT fac_lam_cyl_sel_adj_cst_fil[4] "adaptation filter output under engine-cold condition" SWORD _CNV_A_R_LINEAR_____113_CM 1 100. -50. 49.9984741210938 DISPLAY_IDENTIFIER FAC_LAM_CYL_SEL_ADJ_CST_FIL[4] ECU_ADDRESS 0xd0000678 FORMAT "%7.3" /end MEASUREMENT
/begin MEASUREMENT fac_lam_cyl_sel_adj_cst_fil[5] "adaptation filter output under engine-cold condition" SWORD _CNV_A_R_LINEAR_____113_CM 1 100. -50. 49.9984741210938 DISPLAY_IDENTIFIER FAC_LAM_CYL_SEL_ADJ_CST_FIL[5] ECU_ADDRESS 0xd000067a FORMAT "%7.3" /end MEASUREMENT
/begin MEASUREMENT fac_lam_cyl_sel_adj_cst_fil[6] "adaptation filter output under engine-cold condition" SWORD _CNV_A_R_LINEAR_____113_CM 1 100. -50. 49.9984741210938 DISPLAY_IDENTIFIER FAC_LAM_CYL_SEL_ADJ_CST_FIL[6] ECU_ADDRESS 0xd000067c FORMAT "%7.3" /end MEASUREMENT
/begin MEASUREMENT fac_lam_cyl_sel_adj_cst_fil[7] "adaptation filter output under engine-cold condition" SWORD _CNV_A_R_LINEAR_____113_CM 1 100. -50. 49.9984741210938 DISPLAY_IDENTIFIER FAC_LAM_CYL_SEL_ADJ_CST_FIL[7] ECU_ADDRESS 0xd000067e FORMAT "%7.3" /end MEASUREMENT
/begin MEASUREMENT state_lam_cyl_sel_adj_2 "state of cylinder individual lambda control adaptation" UBYTE _CNV_S_7_RANGE_STAT_118_CM 1 100. 0. 6. DISPLAY_IDENTIFIER STATE_LAM_CYL_SEL_ADJ[2] ECU_ADDRESS 0xd0008987 /end MEASUREMENT
/begin CHARACTERISTIC c_t_lam_cyl_adj "time recurrence for adaptation update" VALUE 0xa080c1d7 _REC_VAL_20_u1 255. _CNV_A_R_LINEAR_____36_CM 0. 255. DISPLAY_IDENTIFIER C_T_LAM_CYL_ADJ FORMAT "%3.0" /end CHARACTERISTIC
/begin CHARACTERISTIC c_t_lam_cyl_adj_cst "time recurrence for adaptation update under engine cold condition" VALUE 0xa080c1d8 _REC_VAL_20_u1 255. _CNV_A_R_LINEAR_____36_CM 0. 255. DISPLAY_IDENTIFIER C_T_LAM_CYL_ADJ_CST FORMAT "%3.0" /end CHARACTERISTIC
/begin CHARACTERISTIC c_tco_lam_cyl_min "Minimum coolant temperature for the activation - nominal condition" VALUE 0xa080c2c5 _REC_VAL_20_u1 190.5 _CNV_A_R_LINEAR_____17_CM -48. 142.5 DISPLAY_IDENTIFIER C_TCO_LAM_CYL_MIN FORMAT "%6.2" /end CHARACTERISTIC
/begin CHARACTERISTIC c_tco_lam_cyl_cst_min "Minimum coolant temperature for the activation of CILC under cold condition" VALUE 0xa080c2c4 _REC_VAL_20_u1 190.5 _CNV_A_R_LINEAR_____17_CM -48. 142.5 DISPLAY_IDENTIFIER C_TCO_LAM_CYL_CST_MIN FORMAT "%6.2" /end CHARACTERISTIC
/begin CHARACTERISTIC c_tco_lam_cyl_cst_max "Maximum coolant temperature for the activation of CILC under cold condition" VALUE 0xa080c2c3 _REC_VAL_20_u1 190.5 _CNV_A_R_LINEAR_____17_CM -48. 142.5 DISPLAY_IDENTIFIER C_TCO_LAM_CYL_CST_MAX FORMAT "%6.2" /end CHARACTERISTIC
/begin CHARACTERISTIC c_crlc_lam_cyl_cst_fil "Correlation constant for the filter output under engine cold condition" VALUE 0xa080baf0 _REC_VAL_20_u2 0.9999847412109381 _CNV_A_R_LINEAR_____89_CM 0. 0.9999847412109381 DISPLAY_IDENTIFIER C_CRLC_LAM_CYL_CST_FIL FORMAT "%7.5" /end CHARACTERISTIC
/begin CHARACTERISTIC lc_lam_cyl_sel_opl "switch for open loop operation" VALUE 0xa080c5a1 _REC_VAL_20_u1 1. _CNV_A_R_LINEAR_____0_CM 0. 1. DISPLAY_IDENTIFIER LC_LAM_CYL_SEL_OPL FORMAT "%1.0" /end CHARACTERISTIC
/begin CHARACTERISTIC lc_fac_lam_cyl_sel_adj_cst_ena "Switch enabling the adaptation under engine cold condition ( =1)" VALUE 0xa080c56c _REC_VAL_20_u1 1. _CNV_A_R_LINEAR_____0_CM 0. 1. DISPLAY_IDENTIFIER LC_FAC_LAM_CYL_SEL_ADJ_CST_ENA FORMAT "%1.0" /end CHARACTERISTIC
/begin AXIS_PTS ldpm_fac_t_1_1_cybl "" 0xa08093b4 online_dummy _REC_AXS_20_u2 63.99902344 _CNV_A_R_LINEAR_____116_CM 16 0. 63.99902344 FORMAT "%7.4" /end AXIS_PTS
/begin AXIS_PTS ldpm_tco_1_cybl "" 0xa0809780 tco _REC_AXS_20_u1 190.5 _CNV_A_R_LINEAR_____17_CM 6 -48. 142.5 FORMAT "%6.2" /end AXIS_PTS
/begin CHARACTERISTIC ip_crlc_fac_lam_cyl_sel_adj "Weighting correlation factor of cylinder individual lambda adaptation part  achieved under nominal condition" CURVE 0xa080a050 _REC_CUR_20_u2_u1 0.9999847412109381 _CNV_A_R_LINEAR_____89_CM 0. 0.9999847412109381 DISPLAY_IDENTIFIER IP_CRLC_FAC_LAM_CYL_SEL_ADJ FORMAT "%7.5"
 /begin AXIS_DESCR COM_AXIS tco _CNV_A_R_LINEAR_____17_CM 6 -48. 142.5 FORMAT "%6.2" AXIS_PTS_REF ldpm_tco_1_cybl /end AXIS_DESCR
/end CHARACTERISTIC
/begin MEASUREMENT delta_lamb_cyl[0] "individual adjusted signal" SWORD _CNV_A_R_LINEAR_____12_CM 1 100. -8. 7.99975586 DISPLAY_IDENTIFIER DELTA_LAMB_CYL[0] ECU_ADDRESS 0xd0000620 FORMAT "%7.4" /end MEASUREMENT
/begin MEASUREMENT delta_lamb_cyl[1] "individual adjusted signal" SWORD _CNV_A_R_LINEAR_____12_CM 1 100. -8. 7.99975586 DISPLAY_IDENTIFIER DELTA_LAMB_CYL[1] ECU_ADDRESS 0xd0000622 FORMAT "%7.4" /end MEASUREMENT
/begin MEASUREMENT delta_lamb_cyl[2] "individual adjusted signal" SWORD _CNV_A_R_LINEAR_____12_CM 1 100. -8. 7.99975586 DISPLAY_IDENTIFIER DELTA_LAMB_CYL[2] ECU_ADDRESS 0xd0000624 FORMAT "%7.4" /end MEASUREMENT
/begin MEASUREMENT delta_lamb_cyl[3] "individual adjusted signal" SWORD _CNV_A_R_LINEAR_____12_CM 1 100. -8. 7.99975586 DISPLAY_IDENTIFIER DELTA_LAMB_CYL[3] ECU_ADDRESS 0xd0000626 FORMAT "%7.4" /end MEASUREMENT
/begin MEASUREMENT delta_lamb_cyl[4] "individual adjusted signal" SWORD _CNV_A_R_LINEAR_____12_CM 1 100. -8. 7.99975586 DISPLAY_IDENTIFIER DELTA_LAMB_CYL[4] ECU_ADDRESS 0xd0000628 FORMAT "%7.4" /end MEASUREMENT
/begin MEASUREMENT delta_lamb_cyl[5] "individual adjusted signal" SWORD _CNV_A_R_LINEAR_____12_CM 1 100. -8. 7.99975586 DISPLAY_IDENTIFIER DELTA_LAMB_CYL[5] ECU_ADDRESS 0xd000062a FORMAT "%7.4" /end MEASUREMENT
/begin MEASUREMENT delta_lamb_cyl[6] "individual adjusted signal" SWORD _CNV_A_R_LINEAR_____12_CM 1 100. -8. 7.99975586 DISPLAY_IDENTIFIER DELTA_LAMB_CYL[6] ECU_ADDRESS 0xd000062c FORMAT "%7.4" /end MEASUREMENT
/begin MEASUREMENT delta_lamb_cyl[7] "individual adjusted signal" SWORD _CNV_A_R_LINEAR_____12_CM 1 100. -8. 7.99975586 DISPLAY_IDENTIFIER DELTA_LAMB_CYL[7] ECU_ADDRESS 0xd000062e FORMAT "%7.4" /end MEASUREMENT
/begin MEASUREMENT lamb_cyl_sel[0] "Cylinder individual lambda value" UWORD _CNV_A_R_LINEAR_____119_CM 1 100. 0. 7.999755859375 DISPLAY_IDENTIFIER LAMB_CYL_SEL[0] ECU_ADDRESS 0xd0000640 FORMAT "%7.4" /end MEASUREMENT
/begin MEASUREMENT lamb_cyl_sel[1] "Cylinder individual lambda value" UWORD _CNV_A_R_LINEAR_____119_CM 1 100. 0. 7.999755859375 DISPLAY_IDENTIFIER LAMB_CYL_SEL[1] ECU_ADDRESS 0xd0000642 FORMAT "%7.4" /end MEASUREMENT
/begin MEASUREMENT lamb_cyl_sel[2] "Cylinder individual lambda value" UWORD _CNV_A_R_LINEAR_____119_CM 1 100. 0. 7.999755859375 DISPLAY_IDENTIFIER LAMB_CYL_SEL[2] ECU_ADDRESS 0xd0000644 FORMAT "%7.4" /end MEASUREMENT
/begin MEASUREMENT lamb_cyl_sel[3] "Cylinder individual lambda value" UWORD _CNV_A_R_LINEAR_____119_CM 1 100. 0. 7.999755859375 DISPLAY_IDENTIFIER LAMB_CYL_SEL[3] ECU_ADDRESS 0xd0000646 FORMAT "%7.4" /end MEASUREMENT
/begin MEASUREMENT lamb_cyl_sel[4] "Cylinder individual lambda value" UWORD _CNV_A_R_LINEAR_____119_CM 1 100. 0. 7.999755859375 DISPLAY_IDENTIFIER LAMB_CYL_SEL[4] ECU_ADDRESS 0xd0000648 FORMAT "%7.4" /end MEASUREMENT
/begin MEASUREMENT lamb_cyl_sel[5] "Cylinder individual lambda value" UWORD _CNV_A_R_LINEAR_____119_CM 1 100. 0. 7.999755859375 DISPLAY_IDENTIFIER LAMB_CYL_SEL[5] ECU_ADDRESS 0xd000064a FORMAT "%7.4" /end MEASUREMENT
/begin MEASUREMENT lamb_cyl_sel[6] "Cylinder individual lambda value" UWORD _CNV_A_R_LINEAR_____119_CM 1 100. 0. 7.999755859375 DISPLAY_IDENTIFIER LAMB_CYL_SEL[6] ECU_ADDRESS 0xd000064c FORMAT "%7.4" /end MEASUREMENT
/begin MEASUREMENT lamb_cyl_sel[7] "Cylinder individual lambda value" UWORD _CNV_A_R_LINEAR_____119_CM 1 100. 0. 7.999755859375 DISPLAY_IDENTIFIER LAMB_CYL_SEL[7] ECU_ADDRESS 0xd000064e FORMAT "%7.4" /end MEASUREMENT
/begin CHARACTERISTIC lc_lam_cyl_sel_err_rst "Switch enabling the reset of adaptation values in case of error ( =1)" VALUE 0xa080c5a0 _REC_VAL_20_u1 1. _CNV_A_R_LINEAR_____0_CM 0. 1. DISPLAY_IDENTIFIER LC_LAM_CYL_SEL_ERR_RST FORMAT "%1.0" /end CHARACTERISTIC
/begin CHARACTERISTIC lc_lamb_delta_mdl_hld "Calculation switch for the choice of the discretization method of the sensor model (0 means  zoh,  1 means foh)" VALUE 0xa080c5a2 _REC_VAL_20_u1 1. _CNV_A_R_LINEAR_____0_CM 0. 1. DISPLAY_IDENTIFIER LC_LAMB_DELTA_MDL_HLD FORMAT "%1.0" /end CHARACTERISTIC
/begin MEASUREMENT state_lam_cyl_sel_adj_1 "state of cylinder individual lambda control adaptation" UBYTE _CNV_S_7_RANGE_STAT_118_CM 1 100. 0. 6. DISPLAY_IDENTIFIER STATE_LAM_CYL_SEL_ADJ[1] ECU_ADDRESS 0xd0008985 /end MEASUREMENT
/begin MEASUREMENT ctr_t_lam_cyl_adj_2 "Timer of cylinder individual lambda control adaptation" UBYTE _CNV_A_R_LINEAR_____36_CM 1 100. 0. 255. DISPLAY_IDENTIFIER CTR_T_LAM_CYL_ADJ[2] ECU_ADDRESS 0xd0000717 FORMAT "%3.0" /end MEASUREMENT
/begin CHARACTERISTIC ip_exp_lamb_mdl_1 "exponential function for the sensor model" CURVE 0xa080a25c _REC_CUR_20_u2_u2 0.9999847412109381 _CNV_A_R_LINEAR_____89_CM 0. 0.9999847412109381 DISPLAY_IDENTIFIER IP_EXP_LAMB_MDL[1] FORMAT "%7.5"
 /begin AXIS_DESCR COM_AXIS online_dummy _CNV_A_R_LINEAR_____116_CM 16 0. 63.99902344 FORMAT "%7.4" AXIS_PTS_REF ldpm_fac_t_1_1_cybl /end AXIS_DESCR
/end CHARACTERISTIC
/begin CHARACTERISTIC ip_n1_fac_lamb_mdl_1 "N1 coefficient of the sensor model" CURVE 0xa080af3c _REC_CUR_20_u2_u2 0.9999847412109381 _CNV_A_R_LINEAR_____89_CM 0. 0.9999847412109381 DISPLAY_IDENTIFIER IP_N1_FAC_LAMB_MDL[1] FORMAT "%7.5"
 /begin AXIS_DESCR COM_AXIS online_dummy _CNV_A_R_LINEAR_____116_CM 16 0. 63.99902344 FORMAT "%7.4" AXIS_PTS_REF ldpm_fac_t_1_1_cybl /end AXIS_DESCR
/end CHARACTERISTIC
/begin CHARACTERISTIC ip_fac_err_lam_sel "weight coefficient" CURVE 0xa080a324 _REC_CUR_20_u2_u2 255.99609375 _CNV_A_R_LINEAR_____120_CM 0. 255.99609375 DISPLAY_IDENTIFIER IP_FAC_ERR_LAM_SEL FORMAT "%7.4"
 /begin AXIS_DESCR COM_AXIS online_dummy _CNV_A_R_LINEAR_____117_CM 6 0. 1.99996948242188 FORMAT "%7.5" AXIS_PTS_REF ldp_t1_lamb_cyl_i_ip_fac_err /end AXIS_DESCR
/end CHARACTERISTIC
/begin MEASUREMENT state_lam_cyl_sel_2 "state of cylinder individual lambda control" UBYTE _CNV_S_4_RANGE_STAT_121_CM 1 100. 0. 3. DISPLAY_IDENTIFIER STATE_LAM_CYL_SEL[2] ECU_ADDRESS 0xd0008986 /end MEASUREMENT
/begin MEASUREMENT state_lam_cyl_sel_1 "state of cylinder individual lambda control" UBYTE _CNV_S_4_RANGE_STAT_121_CM 1 100. 0. 3. DISPLAY_IDENTIFIER STATE_LAM_CYL_SEL[1] ECU_ADDRESS 0xd0008984 /end MEASUREMENT
/begin CHARACTERISTIC ip_n2_fac_lamb_mdl_1 "N2 coefficient of the sensor model" CURVE 0xa080af7c _REC_CUR_20_u2_u2 0.9999847412109381 _CNV_A_R_LINEAR_____89_CM 0. 0.9999847412109381 DISPLAY_IDENTIFIER IP_N2_FAC_LAMB_MDL[1] FORMAT "%7.5"
 /begin AXIS_DESCR COM_AXIS online_dummy _CNV_A_R_LINEAR_____116_CM 16 0. 63.99902344 FORMAT "%7.4" AXIS_PTS_REF ldpm_fac_t_1_1_cybl /end AXIS_DESCR
/end CHARACTERISTIC
/begin MEASUREMENT cyl_lam_1.delta_lamb_av "signal value of the WRAF sensor, sampled with an appropriate resolution and shifted by its mean value" SWORD _CNV_A_R_LINEAR_____12_CM 1 100. -8. 7.99975586 DISPLAY_IDENTIFIER DELTA_LAMB_AV[1] ECU_ADDRESS 0xd00005a0 FORMAT "%7.4" /end MEASUREMENT
/begin MEASUREMENT cyl_lam_1.delta_lamb_mdl "estimated value of the WRAF sensor" SWORD _CNV_A_R_LINEAR_____12_CM 1 100. -8. 7.99975586 DISPLAY_IDENTIFIER DELTA_LAMB_MDL[1] ECU_ADDRESS 0xd00005a2 FORMAT "%7.4" /end MEASUREMENT
/begin MEASUREMENT cyl_lam_1.delta_lamb_err_raw "difference between the measured and the estimated value of the WRAF sensor" SWORD _CNV_A_R_LINEAR_____12_CM 1 100. -8. 7.99975586 DISPLAY_IDENTIFIER DELTA_LAMB_ERR_RAW[1] ECU_ADDRESS 0xd00005a4 FORMAT "%7.4" /end MEASUREMENT
/begin MEASUREMENT cyl_lam_1.delta_lamb_err "weighted estimation error" SWORD _CNV_A_R_LINEAR_____114_CM 1 100. -8. 7.99975586 DISPLAY_IDENTIFIER DELTA_LAMB_ERR[1] ECU_ADDRESS 0xd00005a6 FORMAT "%7.4" /end MEASUREMENT
/begin MEASUREMENT cyl_lam_1.delta_lamb_cyl_sel "reassembled signal, made of individual adjusted signals" SWORD _CNV_A_R_LINEAR_____12_CM 1 100. -8. 7.99975586 DISPLAY_IDENTIFIER DELTA_LAMB_CYL_SEL[1] ECU_ADDRESS 0xd00005a8 FORMAT "%7.4" /end MEASUREMENT
/begin MEASUREMENT cyl_lam_1.fac_t "time factor for the exponential function for the sensor model" UWORD _CNV_A_R_LINEAR_____116_CM 1 100. 0. 63.99902344 DISPLAY_IDENTIFIER FAC_T[1] ECU_ADDRESS 0xd00005aa FORMAT "%7.4" /end MEASUREMENT
/begin MEASUREMENT cyl_lam_1.lv_lam_cyl_sel_seg_ref_cll "Segment based reference flag to close the control loop" UBYTE _CNV_S_2_RANGE__0___1_CM 1 100. 0. 1. DISPLAY_IDENTIFIER LV_LAM_CYL_SEL_SEG_REF_CLL[1] ECU_ADDRESS 0xd00005ac BIT_MASK 0x1 /end MEASUREMENT
/begin CHARACTERISTIC c_crlc_cyl_fil "correlation constant for the filter output" VALUE 0xa080baca _REC_VAL_20_u2 0.9999847412109381 _CNV_A_R_LINEAR_____89_CM 0. 0.9999847412109381 DISPLAY_IDENTIFIER C_CRLC_CYL_FIL FORMAT "%7.5" /end CHARACTERISTIC
/begin MEASUREMENT lv_cyl_lam_diag_lim_max_0 "diagnosis status detection of upper limit outrun" UBYTE _CNV_A_R_LINEAR_____0_CM 1 100. 0. 1. DISPLAY_IDENTIFIER LV_CYL_LAM_DIAG_LIM_MAX[0] ECU_ADDRESS 0xd0008991 FORMAT "%3.0" BIT_MASK 0x1 /end MEASUREMENT
/begin MEASUREMENT fac_cyl_lam_cor[0] "factor for the injection time correction of cylinder x" SWORD _CNV_A_R_LINEAR_____113_CM 1 100. -50. 49.9984741210938 DISPLAY_IDENTIFIER FAC_CYL_LAM_COR[0] ECU_ADDRESS 0xd000a58c FORMAT "%7.3" /end MEASUREMENT
/begin MEASUREMENT fac_cyl_lam_cor[1] "factor for the injection time correction of cylinder x" SWORD _CNV_A_R_LINEAR_____113_CM 1 100. -50. 49.9984741210938 DISPLAY_IDENTIFIER FAC_CYL_LAM_COR[1] ECU_ADDRESS 0xd000a58e FORMAT "%7.3" /end MEASUREMENT
/begin MEASUREMENT fac_cyl_lam_cor[2] "factor for the injection time correction of cylinder x" SWORD _CNV_A_R_LINEAR_____113_CM 1 100. -50. 49.9984741210938 DISPLAY_IDENTIFIER FAC_CYL_LAM_COR[2] ECU_ADDRESS 0xd000a590 FORMAT "%7.3" /end MEASUREMENT
/begin MEASUREMENT fac_cyl_lam_cor[3] "factor for the injection time correction of cylinder x" SWORD _CNV_A_R_LINEAR_____113_CM 1 100. -50. 49.9984741210938 DISPLAY_IDENTIFIER FAC_CYL_LAM_COR[3] ECU_ADDRESS 0xd000a592 FORMAT "%7.3" /end MEASUREMENT
/begin MEASUREMENT fac_cyl_lam_cor[4] "factor for the injection time correction of cylinder x" SWORD _CNV_A_R_LINEAR_____113_CM 1 100. -50. 49.9984741210938 DISPLAY_IDENTIFIER FAC_CYL_LAM_COR[4] ECU_ADDRESS 0xd000a594 FORMAT "%7.3" /end MEASUREMENT
/begin MEASUREMENT fac_cyl_lam_cor[5] "factor for the injection time correction of cylinder x" SWORD _CNV_A_R_LINEAR_____113_CM 1 100. -50. 49.9984741210938 DISPLAY_IDENTIFIER FAC_CYL_LAM_COR[5] ECU_ADDRESS 0xd000a596 FORMAT "%7.3" /end MEASUREMENT
/begin MEASUREMENT fac_cyl_lam_cor[6] "factor for the injection time correction of cylinder x" SWORD _CNV_A_R_LINEAR_____113_CM 1 100. -50. 49.9984741210938 DISPLAY_IDENTIFIER FAC_CYL_LAM_COR[6] ECU_ADDRESS 0xd000a598 FORMAT "%7.3" /end MEASUREMENT
/begin MEASUREMENT fac_cyl_lam_cor[7] "factor for the injection time correction of cylinder x" SWORD _CNV_A_R_LINEAR_____113_CM 1 100. -50. 49.9984741210938 DISPLAY_IDENTIFIER FAC_CYL_LAM_COR[7] ECU_ADDRESS 0xd000a59a FORMAT "%7.3" /end MEASUREMENT
/begin MEASUREMENT fac_cyl_lam_p[0] "Cylinder individual controller output - P component" SWORD _CNV_A_R_LINEAR_____113_CM 1 100. -50. 49.9984741210938 DISPLAY_IDENTIFIER FAC_CYL_LAM_P[0] ECU_ADDRESS 0xd00005e0 FORMAT "%7.3" /end MEASUREMENT
/begin MEASUREMENT fac_cyl_lam_p[1] "Cylinder individual controller output - P component" SWORD _CNV_A_R_LINEAR_____113_CM 1 100. -50. 49.9984741210938 DISPLAY_IDENTIFIER FAC_CYL_LAM_P[1] ECU_ADDRESS 0xd00005e2 FORMAT "%7.3" /end MEASUREMENT
/begin MEASUREMENT fac_cyl_lam_p[2] "Cylinder individual controller output - P component" SWORD _CNV_A_R_LINEAR_____113_CM 1 100. -50. 49.9984741210938 DISPLAY_IDENTIFIER FAC_CYL_LAM_P[2] ECU_ADDRESS 0xd00005e4 FORMAT "%7.3" /end MEASUREMENT
/begin MEASUREMENT fac_cyl_lam_p[3] "Cylinder individual controller output - P component" SWORD _CNV_A_R_LINEAR_____113_CM 1 100. -50. 49.9984741210938 DISPLAY_IDENTIFIER FAC_CYL_LAM_P[3] ECU_ADDRESS 0xd00005e6 FORMAT "%7.3" /end MEASUREMENT
/begin MEASUREMENT fac_cyl_lam_p[4] "Cylinder individual controller output - P component" SWORD _CNV_A_R_LINEAR_____113_CM 1 100. -50. 49.9984741210938 DISPLAY_IDENTIFIER FAC_CYL_LAM_P[4] ECU_ADDRESS 0xd00005e8 FORMAT "%7.3" /end MEASUREMENT
/begin MEASUREMENT fac_cyl_lam_p[5] "Cylinder individual controller output - P component" SWORD _CNV_A_R_LINEAR_____113_CM 1 100. -50. 49.9984741210938 DISPLAY_IDENTIFIER FAC_CYL_LAM_P[5] ECU_ADDRESS 0xd00005ea FORMAT "%7.3" /end MEASUREMENT
/begin MEASUREMENT fac_cyl_lam_p[6] "Cylinder individual controller output - P component" SWORD _CNV_A_R_LINEAR_____113_CM 1 100. -50. 49.9984741210938 DISPLAY_IDENTIFIER FAC_CYL_LAM_P[6] ECU_ADDRESS 0xd00005ec FORMAT "%7.3" /end MEASUREMENT
/begin MEASUREMENT fac_cyl_lam_p[7] "Cylinder individual controller output - P component" SWORD _CNV_A_R_LINEAR_____113_CM 1 100. -50. 49.9984741210938 DISPLAY_IDENTIFIER FAC_CYL_LAM_P[7] ECU_ADDRESS 0xd00005ee FORMAT "%7.3" /end MEASUREMENT
/begin MEASUREMENT fac_cyl_lam_i_mv_shift[0] "Cylinder individual controller output - I component, shifted by its mean value" SWORD _CNV_A_R_LINEAR_____113_CM 1 100. -50. 49.9984741210938 DISPLAY_IDENTIFIER FAC_CYL_LAM_I_MV_SHIFT[0] ECU_ADDRESS 0xd00005f0 FORMAT "%7.3" /end MEASUREMENT
/begin MEASUREMENT fac_cyl_lam_i_mv_shift[1] "Cylinder individual controller output - I component, shifted by its mean value" SWORD _CNV_A_R_LINEAR_____113_CM 1 100. -50. 49.9984741210938 DISPLAY_IDENTIFIER FAC_CYL_LAM_I_MV_SHIFT[1] ECU_ADDRESS 0xd00005f2 FORMAT "%7.3" /end MEASUREMENT
/begin MEASUREMENT fac_cyl_lam_i_mv_shift[2] "Cylinder individual controller output - I component, shifted by its mean value" SWORD _CNV_A_R_LINEAR_____113_CM 1 100. -50. 49.9984741210938 DISPLAY_IDENTIFIER FAC_CYL_LAM_I_MV_SHIFT[2] ECU_ADDRESS 0xd00005f4 FORMAT "%7.3" /end MEASUREMENT
/begin MEASUREMENT fac_cyl_lam_i_mv_shift[3] "Cylinder individual controller output - I component, shifted by its mean value" SWORD _CNV_A_R_LINEAR_____113_CM 1 100. -50. 49.9984741210938 DISPLAY_IDENTIFIER FAC_CYL_LAM_I_MV_SHIFT[3] ECU_ADDRESS 0xd00005f6 FORMAT "%7.3" /end MEASUREMENT
/begin MEASUREMENT fac_cyl_lam_i_mv_shift[4] "Cylinder individual controller output - I component, shifted by its mean value" SWORD _CNV_A_R_LINEAR_____113_CM 1 100. -50. 49.9984741210938 DISPLAY_IDENTIFIER FAC_CYL_LAM_I_MV_SHIFT[4] ECU_ADDRESS 0xd00005f8 FORMAT "%7.3" /end MEASUREMENT
/begin MEASUREMENT fac_cyl_lam_i_mv_shift[5] "Cylinder individual controller output - I component, shifted by its mean value" SWORD _CNV_A_R_LINEAR_____113_CM 1 100. -50. 49.9984741210938 DISPLAY_IDENTIFIER FAC_CYL_LAM_I_MV_SHIFT[5] ECU_ADDRESS 0xd00005fa FORMAT "%7.3" /end MEASUREMENT
/begin MEASUREMENT fac_cyl_lam_i_mv_shift[6] "Cylinder individual controller output - I component, shifted by its mean value" SWORD _CNV_A_R_LINEAR_____113_CM 1 100. -50. 49.9984741210938 DISPLAY_IDENTIFIER FAC_CYL_LAM_I_MV_SHIFT[6] ECU_ADDRESS 0xd00005fc FORMAT "%7.3" /end MEASUREMENT
/begin MEASUREMENT fac_cyl_lam_i_mv_shift[7] "Cylinder individual controller output - I component, shifted by its mean value" SWORD _CNV_A_R_LINEAR_____113_CM 1 100. -50. 49.9984741210938 DISPLAY_IDENTIFIER FAC_CYL_LAM_I_MV_SHIFT[7] ECU_ADDRESS 0xd00005fe FORMAT "%7.3" /end MEASUREMENT
/begin MEASUREMENT fac_cyl_lam_p_mv_shift[0] "Cylinder individual controller output - P component, shifted by its mean value" SWORD _CNV_A_R_LINEAR_____113_CM 1 100. -50. 49.9984741210938 DISPLAY_IDENTIFIER FAC_CYL_LAM_P_MV_SHIFT[0] ECU_ADDRESS 0xd0000600 FORMAT "%7.3" /end MEASUREMENT
/begin MEASUREMENT fac_cyl_lam_p_mv_shift[1] "Cylinder individual controller output - P component, shifted by its mean value" SWORD _CNV_A_R_LINEAR_____113_CM 1 100. -50. 49.9984741210938 DISPLAY_IDENTIFIER FAC_CYL_LAM_P_MV_SHIFT[1] ECU_ADDRESS 0xd0000602 FORMAT "%7.3" /end MEASUREMENT
/begin MEASUREMENT fac_cyl_lam_p_mv_shift[2] "Cylinder individual controller output - P component, shifted by its mean value" SWORD _CNV_A_R_LINEAR_____113_CM 1 100. -50. 49.9984741210938 DISPLAY_IDENTIFIER FAC_CYL_LAM_P_MV_SHIFT[2] ECU_ADDRESS 0xd0000604 FORMAT "%7.3" /end MEASUREMENT
/begin MEASUREMENT fac_cyl_lam_p_mv_shift[3] "Cylinder individual controller output - P component, shifted by its mean value" SWORD _CNV_A_R_LINEAR_____113_CM 1 100. -50. 49.9984741210938 DISPLAY_IDENTIFIER FAC_CYL_LAM_P_MV_SHIFT[3] ECU_ADDRESS 0xd0000606 FORMAT "%7.3" /end MEASUREMENT
/begin MEASUREMENT fac_cyl_lam_p_mv_shift[4] "Cylinder individual controller output - P component, shifted by its mean value" SWORD _CNV_A_R_LINEAR_____113_CM 1 100. -50. 49.9984741210938 DISPLAY_IDENTIFIER FAC_CYL_LAM_P_MV_SHIFT[4] ECU_ADDRESS 0xd0000608 FORMAT "%7.3" /end MEASUREMENT
/begin MEASUREMENT fac_cyl_lam_p_mv_shift[5] "Cylinder individual controller output - P component, shifted by its mean value" SWORD _CNV_A_R_LINEAR_____113_CM 1 100. -50. 49.9984741210938 DISPLAY_IDENTIFIER FAC_CYL_LAM_P_MV_SHIFT[5] ECU_ADDRESS 0xd000060a FORMAT "%7.3" /end MEASUREMENT
/begin MEASUREMENT fac_cyl_lam_p_mv_shift[6] "Cylinder individual controller output - P component, shifted by its mean value" SWORD _CNV_A_R_LINEAR_____113_CM 1 100. -50. 49.9984741210938 DISPLAY_IDENTIFIER FAC_CYL_LAM_P_MV_SHIFT[6] ECU_ADDRESS 0xd000060c FORMAT "%7.3" /end MEASUREMENT
/begin MEASUREMENT fac_cyl_lam_p_mv_shift[7] "Cylinder individual controller output - P component, shifted by its mean value" SWORD _CNV_A_R_LINEAR_____113_CM 1 100. -50. 49.9984741210938 DISPLAY_IDENTIFIER FAC_CYL_LAM_P_MV_SHIFT[7] ECU_ADDRESS 0xd000060e FORMAT "%7.3" /end MEASUREMENT
/begin MEASUREMENT fac_lam_cyl_sel_adj_l_rng[0] "Cylinder individual adaptation correction factor (low-range)" SWORD _CNV_A_R_LINEAR_____113_CM 1 100. -50. 49.9984741210938 DISPLAY_IDENTIFIER FAC_LAM_CYL_SEL_ADJ_L_RNG[0] ECU_ADDRESS 0xd000a5cc FORMAT "%7.3" /end MEASUREMENT
/begin MEASUREMENT fac_lam_cyl_sel_adj_l_rng[1] "Cylinder individual adaptation correction factor (low-range)" SWORD _CNV_A_R_LINEAR_____113_CM 1 100. -50. 49.9984741210938 DISPLAY_IDENTIFIER FAC_LAM_CYL_SEL_ADJ_L_RNG[1] ECU_ADDRESS 0xd000a5ce FORMAT "%7.3" /end MEASUREMENT
/begin MEASUREMENT fac_lam_cyl_sel_adj_l_rng[2] "Cylinder individual adaptation correction factor (low-range)" SWORD _CNV_A_R_LINEAR_____113_CM 1 100. -50. 49.9984741210938 DISPLAY_IDENTIFIER FAC_LAM_CYL_SEL_ADJ_L_RNG[2] ECU_ADDRESS 0xd000a5d0 FORMAT "%7.3" /end MEASUREMENT
/begin MEASUREMENT fac_lam_cyl_sel_adj_l_rng[3] "Cylinder individual adaptation correction factor (low-range)" SWORD _CNV_A_R_LINEAR_____113_CM 1 100. -50. 49.9984741210938 DISPLAY_IDENTIFIER FAC_LAM_CYL_SEL_ADJ_L_RNG[3] ECU_ADDRESS 0xd000a5d2 FORMAT "%7.3" /end MEASUREMENT
/begin MEASUREMENT fac_lam_cyl_sel_adj_l_rng[4] "Cylinder individual adaptation correction factor (low-range)" SWORD _CNV_A_R_LINEAR_____113_CM 1 100. -50. 49.9984741210938 DISPLAY_IDENTIFIER FAC_LAM_CYL_SEL_ADJ_L_RNG[4] ECU_ADDRESS 0xd000a5d4 FORMAT "%7.3" /end MEASUREMENT
/begin MEASUREMENT fac_lam_cyl_sel_adj_l_rng[5] "Cylinder individual adaptation correction factor (low-range)" SWORD _CNV_A_R_LINEAR_____113_CM 1 100. -50. 49.9984741210938 DISPLAY_IDENTIFIER FAC_LAM_CYL_SEL_ADJ_L_RNG[5] ECU_ADDRESS 0xd000a5d6 FORMAT "%7.3" /end MEASUREMENT
/begin MEASUREMENT fac_lam_cyl_sel_adj_l_rng[6] "Cylinder individual adaptation correction factor (low-range)" SWORD _CNV_A_R_LINEAR_____113_CM 1 100. -50. 49.9984741210938 DISPLAY_IDENTIFIER FAC_LAM_CYL_SEL_ADJ_L_RNG[6] ECU_ADDRESS 0xd000a5d8 FORMAT "%7.3" /end MEASUREMENT
/begin MEASUREMENT fac_lam_cyl_sel_adj_l_rng[7] "Cylinder individual adaptation correction factor (low-range)" SWORD _CNV_A_R_LINEAR_____113_CM 1 100. -50. 49.9984741210938 DISPLAY_IDENTIFIER FAC_LAM_CYL_SEL_ADJ_L_RNG[7] ECU_ADDRESS 0xd000a5da FORMAT "%7.3" /end MEASUREMENT
/begin MEASUREMENT fac_lam_cyl_sel_adj_h_rng[0] "Cylinder individual adaptation correction factor (high-range)" SWORD _CNV_A_R_LINEAR_____113_CM 1 100. -50. 49.9984741210938 DISPLAY_IDENTIFIER FAC_LAM_CYL_SEL_ADJ_H_RNG[0] ECU_ADDRESS 0xd000a5dc FORMAT "%7.3" /end MEASUREMENT
/begin MEASUREMENT fac_lam_cyl_sel_adj_h_rng[1] "Cylinder individual adaptation correction factor (high-range)" SWORD _CNV_A_R_LINEAR_____113_CM 1 100. -50. 49.9984741210938 DISPLAY_IDENTIFIER FAC_LAM_CYL_SEL_ADJ_H_RNG[1] ECU_ADDRESS 0xd000a5de FORMAT "%7.3" /end MEASUREMENT
/begin MEASUREMENT fac_lam_cyl_sel_adj_h_rng[2] "Cylinder individual adaptation correction factor (high-range)" SWORD _CNV_A_R_LINEAR_____113_CM 1 100. -50. 49.9984741210938 DISPLAY_IDENTIFIER FAC_LAM_CYL_SEL_ADJ_H_RNG[2] ECU_ADDRESS 0xd000a5e0 FORMAT "%7.3" /end MEASUREMENT
/begin MEASUREMENT fac_lam_cyl_sel_adj_h_rng[3] "Cylinder individual adaptation correction factor (high-range)" SWORD _CNV_A_R_LINEAR_____113_CM 1 100. -50. 49.9984741210938 DISPLAY_IDENTIFIER FAC_LAM_CYL_SEL_ADJ_H_RNG[3] ECU_ADDRESS 0xd000a5e2 FORMAT "%7.3" /end MEASUREMENT
/begin MEASUREMENT fac_lam_cyl_sel_adj_h_rng[4] "Cylinder individual adaptation correction factor (high-range)" SWORD _CNV_A_R_LINEAR_____113_CM 1 100. -50. 49.9984741210938 DISPLAY_IDENTIFIER FAC_LAM_CYL_SEL_ADJ_H_RNG[4] ECU_ADDRESS 0xd000a5e4 FORMAT "%7.3" /end MEASUREMENT
/begin MEASUREMENT fac_lam_cyl_sel_adj_h_rng[5] "Cylinder individual adaptation correction factor (high-range)" SWORD _CNV_A_R_LINEAR_____113_CM 1 100. -50. 49.9984741210938 DISPLAY_IDENTIFIER FAC_LAM_CYL_SEL_ADJ_H_RNG[5] ECU_ADDRESS 0xd000a5e6 FORMAT "%7.3" /end MEASUREMENT
/begin MEASUREMENT fac_lam_cyl_sel_adj_h_rng[6] "Cylinder individual adaptation correction factor (high-range)" SWORD _CNV_A_R_LINEAR_____113_CM 1 100. -50. 49.9984741210938 DISPLAY_IDENTIFIER FAC_LAM_CYL_SEL_ADJ_H_RNG[6] ECU_ADDRESS 0xd000a5e8 FORMAT "%7.3" /end MEASUREMENT
/begin MEASUREMENT fac_lam_cyl_sel_adj_h_rng[7] "Cylinder individual adaptation correction factor (high-range)" SWORD _CNV_A_R_LINEAR_____113_CM 1 100. -50. 49.9984741210938 DISPLAY_IDENTIFIER FAC_LAM_CYL_SEL_ADJ_H_RNG[7] ECU_ADDRESS 0xd000a5ea FORMAT "%7.3" /end MEASUREMENT
/begin CHARACTERISTIC c_n_max_fac_cyl_sel_adj_l_rng "Upper engine speed threshold for calculation of cylinder individual lambda adaptation (low-range)" VALUE 0xa080bf87 _REC_VAL_20_u1 8160. _CNV_A_R_LINEAR_____10_CM 0. 8160. DISPLAY_IDENTIFIER C_N_MAX_FAC_CYL_SEL_ADJ_L_RNG FORMAT "%4.0" /end CHARACTERISTIC
/begin CHARACTERISTIC c_n_min_fac_cyl_sel_adj_l_rng "Lower engine speed threshold for calculation of cylinder individual lambda adaptation (low-range)" VALUE 0xa080bf98 _REC_VAL_20_u1 8160. _CNV_A_R_LINEAR_____10_CM 0. 8160. DISPLAY_IDENTIFIER C_N_MIN_FAC_CYL_SEL_ADJ_L_RNG FORMAT "%4.0" /end CHARACTERISTIC
/begin CHARACTERISTIC c_n_min_fac_cyl_sel_adj_h_rng "Lower engine speed threshold for calculation of cylinder individual lambda adaptation (high-range)" VALUE 0xa080bf97 _REC_VAL_20_u1 8160. _CNV_A_R_LINEAR_____10_CM 0. 8160. DISPLAY_IDENTIFIER C_N_MIN_FAC_CYL_SEL_ADJ_H_RNG FORMAT "%4.0" /end CHARACTERISTIC
/begin CHARACTERISTIC c_n_max_fac_cyl_sel_adj_h_rng "Upper engine speed threshold for calculation of cylinder individual lambda adaptation (high-range)" VALUE 0xa080bf86 _REC_VAL_20_u1 8160. _CNV_A_R_LINEAR_____10_CM 0. 8160. DISPLAY_IDENTIFIER C_N_MAX_FAC_CYL_SEL_ADJ_H_RNG FORMAT "%4.0" /end CHARACTERISTIC
/begin CHARACTERISTIC c_mff_max_fac_cyl_sel_adj_l_rng "Upper fuel mass threshold for calculation of cylinder individual lambda adaptation (low-range)" VALUE 0xa080be86 _REC_VAL_20_u2 1389. _CNV_A_R_LINEAR_____111_CM 0. 1389. DISPLAY_IDENTIFIER C_MFF_MAX_FAC_CYL_SEL_ADJ_L_RNG FORMAT "%7.2" /end CHARACTERISTIC
/begin CHARACTERISTIC c_mff_min_fac_cyl_sel_adj_l_rng "Lower fuel mass threshold for calculation of cylinder individual lambda adaptation (low-range)" VALUE 0xa080be8e _REC_VAL_20_u2 1389. _CNV_A_R_LINEAR_____111_CM 0. 1389. DISPLAY_IDENTIFIER C_MFF_MIN_FAC_CYL_SEL_ADJ_L_RNG FORMAT "%7.2" /end CHARACTERISTIC
/begin CHARACTERISTIC c_mff_min_fac_cyl_sel_adj_h_rng "Lower fuel mass threshold for calculation of cylinder individual lambda adaptation (high-range)" VALUE 0xa080be8c _REC_VAL_20_u2 1389. _CNV_A_R_LINEAR_____111_CM 0. 1389. DISPLAY_IDENTIFIER C_MFF_MIN_FAC_CYL_SEL_ADJ_H_RNG FORMAT "%7.2" /end CHARACTERISTIC
/begin CHARACTERISTIC c_mff_sp_thd_cyl_sel_adj_l_rng "Maximum fuel mass threshold for consideration of the low range adaptation value in the injection correction" VALUE 0xa080bec0 _REC_VAL_20_u2 1389. _CNV_A_R_LINEAR_____111_CM 0. 1389. DISPLAY_IDENTIFIER C_MFF_SP_THD_CYL_SEL_ADJ_L_RNG FORMAT "%7.2" /end CHARACTERISTIC
/begin CHARACTERISTIC c_mff_sp_thd_cyl_sel_adj_h_rng "Minimum fuel mass threshold for consideration of the high range adaptation value in the injection correction" VALUE 0xa080bebe _REC_VAL_20_u2 1389. _CNV_A_R_LINEAR_____111_CM 0. 1389. DISPLAY_IDENTIFIER C_MFF_SP_THD_CYL_SEL_ADJ_H_RNG FORMAT "%7.2" /end CHARACTERISTIC
/begin CHARACTERISTIC lc_fac_lam_cyl_sel_adj_p_i_ena "Calculation switch for the choice of the adaptation method ( 0 -> I - component concerned; 1 -> PI concerned )" VALUE 0xa080c56d _REC_VAL_20_u1 1. _CNV_A_R_LINEAR_____0_CM 0. 1. DISPLAY_IDENTIFIER LC_FAC_LAM_CYL_SEL_ADJ_P_I_ENA FORMAT "%1.0" /end CHARACTERISTIC
/begin CHARACTERISTIC lc_fac_cyl_lam_p_swi "Calculation switch for the choice of the control structure ( 0 -> I - controller;  1-> PI controller )" VALUE 0xa080c56a _REC_VAL_20_u1 1. _CNV_A_R_LINEAR_____0_CM 0. 1. DISPLAY_IDENTIFIER LC_FAC_CYL_LAM_P_SWI FORMAT "%1.0" /end CHARACTERISTIC
/begin AXIS_PTS ldp_amp_ip_crk_delta_amp "Cranking injection time correction upon ambient pressure" 0xa08084fc amp _REC_AXS_20_u2 5434. _CNV_A_R_LINEAR_____27_CM 6 0. 5434. FORMAT "%7.2" /end AXIS_PTS
/begin CHARACTERISTIC ip_crk_delta_amp_cyl_lam "Phase shift deviation caused by elevation" CURVE 0xa0809fac _REC_CUR_20_u1_u2 1440. _CNV_A_R_CYBL_LINEA_122_CM -720. 720. DISPLAY_IDENTIFIER IP_CRK_DELTA_AMP_CYL_LAM FORMAT "%4.0"
 /begin AXIS_DESCR COM_AXIS amp _CNV_A_R_LINEAR_____27_CM 6 0. 5434. FORMAT "%7.2" AXIS_PTS_REF ldp_amp_ip_crk_delta_amp /end AXIS_DESCR
/end CHARACTERISTIC
/begin CHARACTERISTIC ip_fac_gain_p_lam_cyl_sel "Gain of cylinder individual controller (P - component)" MAP 0xa0814444 _REC_MAP_20_u2_u2_u2 63.99902344 _CNV_A_R_LINEAR_____123_CM 0. 63.99902344 DISPLAY_IDENTIFIER IP_FAC_GAIN_P_LAM_CYL_SEL FORMAT "%7.4"
 /begin AXIS_DESCR COM_AXIS n _CNV_A_R_LINEAR_____14_CM 8 0. 8160. FORMAT "%4.0" AXIS_PTS_REF ldpm_n_1_cybl /end AXIS_DESCR
 /begin AXIS_DESCR COM_AXIS maf _CNV_A_R_LINEAR_____111_CM 8 0. 1389. FORMAT "%7.2" AXIS_PTS_REF ldpm_maf_1_cybl /end AXIS_DESCR
/end CHARACTERISTIC
/begin CHARACTERISTIC ip_crlc_p_neut_rng "Dead zone for calculation of P - component" CURVE 0xa080a0b4 _REC_CUR_20_u2_u2 0.9999847412109381 _CNV_A_R_LINEAR_____89_CM 0. 0.9999847412109381 DISPLAY_IDENTIFIER IP_CRLC_P_NEUT_RNG FORMAT "%7.5"
 /begin AXIS_DESCR COM_AXIS online_dummy _CNV_A_R_CYBL_LINEA_124_CM 8 -8. 7.999756 FORMAT "%7.4" AXIS_PTS_REF ldp_delta_lamb_dif_cyl_x_p /end AXIS_DESCR
/end CHARACTERISTIC
/begin AXIS_PTS ldp_delta_lamb_dif_cyl_x_p "" 0xa0808538 online_dummy _REC_AXS_20_u2 15.999756 _CNV_A_R_CYBL_LINEA_124_CM 8 -8. 7.999756 FORMAT "%7.4" /end AXIS_PTS
/begin CHARACTERISTIC ip_crlc_fac_lam_cyl_adj_cst "Weighting correlation factor of cylinder individual lambda adaptation part  achieved under engine cold condition" CURVE 0xa080a044 _REC_CUR_20_u2_u1 0.9999847412109381 _CNV_A_R_LINEAR_____89_CM 0. 0.9999847412109381 DISPLAY_IDENTIFIER IP_CRLC_FAC_LAM_CYL_ADJ_CST FORMAT "%7.5"
 /begin AXIS_DESCR COM_AXIS tco _CNV_A_R_LINEAR_____17_CM 6 -48. 142.5 FORMAT "%6.2" AXIS_PTS_REF ldpm_tco_1_cybl /end AXIS_DESCR
/end CHARACTERISTIC
/begin CHARACTERISTIC ip_lamb_cyl "characteristic curve of the WRAF sensor" CURVE 0xa080adb0 _REC_CUR_20_u2_u2 7.999755859375 _CNV_A_R_LINEAR_____119_CM 0. 7.999755859375 DISPLAY_IDENTIFIER IP_LAMB_CYL FORMAT "%7.4"
 /begin AXIS_DESCR COM_AXIS online_dummy _CNV_A_R_LINEAR_____2_CM 16 0. 4.9951171875 FORMAT "%5.3" AXIS_PTS_REF ldp_vls_cyl_sel_x_ip_lamb_cyl /end AXIS_DESCR
/end CHARACTERISTIC
/begin AXIS_PTS ldp_vls_cyl_sel_x_ip_lamb_cyl "" 0xa0809180 online_dummy _REC_AXS_20_u2 4.9951171875 _CNV_A_R_LINEAR_____2_CM 16 0. 4.9951171875 FORMAT "%5.3" /end AXIS_PTS
/begin CHARACTERISTIC c_fac_cyl_lam_absv_dec "absolute dectrement constant to increase or decrease the cylinder individual injection correction" VALUE 0xa080bcb8 _REC_VAL_20_u2 49.99847412 _CNV_A_R_LINEAR_____125_CM 0. 49.99847412 DISPLAY_IDENTIFIER C_FAC_CYL_LAM_ABSV_DEC /end CHARACTERISTIC
/begin MEASUREMENT crk_cyl_lam[0] "value of phase displacement" UBYTE _CNV_A_R_LINEAR_____112_CM 1 100. 0. 1440. DISPLAY_IDENTIFIER CRK_CYL_LAM[0] ECU_ADDRESS 0xd000897c FORMAT "%4.0" /end MEASUREMENT
/begin MEASUREMENT crk_cyl_lam[1] "value of phase displacement" UBYTE _CNV_A_R_LINEAR_____112_CM 1 100. 0. 1440. DISPLAY_IDENTIFIER CRK_CYL_LAM[1] ECU_ADDRESS 0xd000897d FORMAT "%4.0" /end MEASUREMENT
/begin MEASUREMENT crk_cyl_lam[2] "value of phase displacement" UBYTE _CNV_A_R_LINEAR_____112_CM 1 100. 0. 1440. DISPLAY_IDENTIFIER CRK_CYL_LAM[2] ECU_ADDRESS 0xd000897e FORMAT "%4.0" /end MEASUREMENT
/begin MEASUREMENT crk_cyl_lam[3] "value of phase displacement" UBYTE _CNV_A_R_LINEAR_____112_CM 1 100. 0. 1440. DISPLAY_IDENTIFIER CRK_CYL_LAM[3] ECU_ADDRESS 0xd000897f FORMAT "%4.0" /end MEASUREMENT
/begin MEASUREMENT crk_cyl_lam[4] "value of phase displacement" UBYTE _CNV_A_R_LINEAR_____112_CM 1 100. 0. 1440. DISPLAY_IDENTIFIER CRK_CYL_LAM[4] ECU_ADDRESS 0xd0008980 FORMAT "%4.0" /end MEASUREMENT
/begin MEASUREMENT crk_cyl_lam[5] "value of phase displacement" UBYTE _CNV_A_R_LINEAR_____112_CM 1 100. 0. 1440. DISPLAY_IDENTIFIER CRK_CYL_LAM[5] ECU_ADDRESS 0xd0008981 FORMAT "%4.0" /end MEASUREMENT
/begin MEASUREMENT crk_cyl_lam[6] "value of phase displacement" UBYTE _CNV_A_R_LINEAR_____112_CM 1 100. 0. 1440. DISPLAY_IDENTIFIER CRK_CYL_LAM[6] ECU_ADDRESS 0xd0008982 FORMAT "%4.0" /end MEASUREMENT
/begin MEASUREMENT crk_cyl_lam[7] "value of phase displacement" UBYTE _CNV_A_R_LINEAR_____112_CM 1 100. 0. 1440. DISPLAY_IDENTIFIER CRK_CYL_LAM[7] ECU_ADDRESS 0xd0008983 FORMAT "%4.0" /end MEASUREMENT
/begin MEASUREMENT mff_sp_save_lam_cyl_sel_1 "Stored fuel mass setpoint at CILC deactivation moment" UWORD _CNV_A_R_LINEAR_____111_CM 1 100. 0. 1389. DISPLAY_IDENTIFIER MFF_SP_SAVE_LAM_CYL_SEL[1] ECU_ADDRESS 0xd00005b0 FORMAT "%7.2" /end MEASUREMENT
/begin MEASUREMENT mff_sp_save_lam_cyl_sel_2 "Stored fuel mass setpoint at CILC deactivation moment" UWORD _CNV_A_R_LINEAR_____111_CM 1 100. 0. 1389. DISPLAY_IDENTIFIER MFF_SP_SAVE_LAM_CYL_SEL[2] ECU_ADDRESS 0xd00005c8 FORMAT "%7.2" /end MEASUREMENT
/begin MEASUREMENT mff_delta_lam_cyl_sel_reac_2 "Absolute fuel mass difference at deactivation and reactivation interval" UWORD _CNV_A_R_LINEAR_____111_CM 1 100. 0. 1389. DISPLAY_IDENTIFIER MFF_DELTA_LAM_CYL_SEL_REAC[2] ECU_ADDRESS 0xd00005ca FORMAT "%7.2" /end MEASUREMENT
/begin MEASUREMENT mff_delta_lam_cyl_sel_reac_1 "Absolute fuel mass difference at deactivation and reactivation interval" UWORD _CNV_A_R_LINEAR_____111_CM 1 100. 0. 1389. DISPLAY_IDENTIFIER MFF_DELTA_LAM_CYL_SEL_REAC[1] ECU_ADDRESS 0xd00005b2 FORMAT "%7.2" /end MEASUREMENT
/begin MEASUREMENT fac_val_lam_cyl_sel_reac_2 "Valuated factor for internal states at reactivation moment" UWORD _CNV_A_R_LINEAR_____126_CM 1 100. 0. 0.9999847 DISPLAY_IDENTIFIER FAC_VAL_LAM_CYL_SEL_REAC[2] ECU_ADDRESS 0xd00005cc FORMAT "%7.5" /end MEASUREMENT
/begin MEASUREMENT fac_val_lam_cyl_sel_reac_1 "Valuated factor for internal states at reactivation moment" UWORD _CNV_A_R_LINEAR_____126_CM 1 100. 0. 0.9999847 DISPLAY_IDENTIFIER FAC_VAL_LAM_CYL_SEL_REAC[1] ECU_ADDRESS 0xd00005b4 FORMAT "%7.5" /end MEASUREMENT
/begin MEASUREMENT fac_cyl_lam_absv_sum_1 "Sum of the absolute cylinder individual controller outputs" UWORD _CNV_A_R_LINEAR_____125_CM 1 100. 0. 49.99847412 DISPLAY_IDENTIFIER FAC_CYL_LAM_ABSV_SUM[1] ECU_ADDRESS 0xd000a5fe /end MEASUREMENT
/begin MEASUREMENT fac_cyl_lam_absv_sum_2 "Sum of the absolute cylinder individual controller outputs" UWORD _CNV_A_R_LINEAR_____125_CM 1 100. 0. 49.99847412 DISPLAY_IDENTIFIER FAC_CYL_LAM_ABSV_SUM[2] ECU_ADDRESS 0xd000a604 /end MEASUREMENT
/begin CHARACTERISTIC c_mff_max_fac_cyl_sel_adj_h_rng "Upper fuel mass threshold for calculation of cylinder individual lambda adaptation (high-range)" VALUE 0xa080be84 _REC_VAL_20_u2 1389. _CNV_A_R_LINEAR_____111_CM 0. 1389. DISPLAY_IDENTIFIER C_MFF_MAX_FAC_CYL_SEL_ADJ_H_RNG FORMAT "%7.2" /end CHARACTERISTIC
/begin CHARACTERISTIC c_mff_lam_cyl_adj_cst_min "Lower fuel mass threshold for calculation of cylinder individual lambda adaptation (engine cold)" VALUE 0xa080be80 _REC_VAL_20_u2 1389. _CNV_A_R_LINEAR_____111_CM 0. 1389. DISPLAY_IDENTIFIER C_MFF_LAM_CYL_ADJ_CST_MIN FORMAT "%7.2" /end CHARACTERISTIC
/begin CHARACTERISTIC ip_crlc_cyl_lam "correlation characteristic for AFR equalisation" MAP 0xa08142e4 _REC_MAP_20_u2_u2_u2 7.9998779296875 _CNV_A_R_LINEAR_____127_CM 0. 7.9998779296875 DISPLAY_IDENTIFIER IP_CRLC_CYL_LAM FORMAT "%6.4"
 /begin AXIS_DESCR COM_AXIS n _CNV_A_R_LINEAR_____14_CM 8 0. 8160. FORMAT "%4.0" AXIS_PTS_REF ldpm_n_1_cybl /end AXIS_DESCR
 /begin AXIS_DESCR COM_AXIS maf _CNV_A_R_LINEAR_____111_CM 8 0. 1389. FORMAT "%7.2" AXIS_PTS_REF ldpm_maf_1_cybl /end AXIS_DESCR
/end CHARACTERISTIC
/begin CHARACTERISTIC ip_crlc_int_fast_cyl_lam "correlation characteristic for AFR equalisation" MAP 0xa0814364 _REC_MAP_20_u2_u2_u2 7.9998779296875 _CNV_A_R_LINEAR_____127_CM 0. 7.9998779296875 DISPLAY_IDENTIFIER IP_CRLC_INT_FAST_CYL_LAM FORMAT "%6.4"
 /begin AXIS_DESCR COM_AXIS n _CNV_A_R_LINEAR_____14_CM 8 0. 8160. FORMAT "%4.0" AXIS_PTS_REF ldpm_n_1_cybl /end AXIS_DESCR
 /begin AXIS_DESCR COM_AXIS maf _CNV_A_R_LINEAR_____111_CM 8 0. 1389. FORMAT "%7.2" AXIS_PTS_REF ldpm_maf_1_cybl /end AXIS_DESCR
/end CHARACTERISTIC
/begin CHARACTERISTIC ip_crlc_i_neut_rng "Dead zone for calculation of I - component" CURVE 0xa080a09c _REC_CUR_20_u2_u2 0.9999847412109381 _CNV_A_R_LINEAR_____89_CM 0. 0.9999847412109381 DISPLAY_IDENTIFIER IP_CRLC_I_NEUT_RNG FORMAT "%7.5"
 /begin AXIS_DESCR COM_AXIS online_dummy _CNV_A_R_CYBL_LINEA_124_CM 8 -8. 7.999756 FORMAT "%7.4" AXIS_PTS_REF ldp_delta_lamb_dif_cyl_x_i /end AXIS_DESCR
/end CHARACTERISTIC
/begin AXIS_PTS ldp_delta_lamb_dif_cyl_x_i "" 0xa0808524 online_dummy _REC_AXS_20_u2 15.999756 _CNV_A_R_CYBL_LINEA_124_CM 8 -8. 7.999756 FORMAT "%7.4" /end AXIS_PTS
/begin AXIS_PTS ldp_mff_delta_lam_cyl_i_ip_fac "" 0xa0808938 online_dummy _REC_AXS_20_u2 1389. _CNV_A_R_LINEAR_____111_CM 6 0. 1389. FORMAT "%7.2" /end AXIS_PTS
/begin MEASUREMENT delta_lamb_cyl_sel_cq_1 "characteristic value of the estimated values" UWORD _CNV_A_R_LINEAR_____115_CM 1 100. 0. 7.9998779296875 DISPLAY_IDENTIFIER DELTA_LAMB_CYL_SEL_CQ[1] ECU_ADDRESS 0xd000a5fc FORMAT "%6.4" /end MEASUREMENT
/begin MEASUREMENT delta_lamb_cyl_sel_cq_fil_1 "filter value of characteristic quantity of estimated cylinder individual lambda deviation" UWORD _CNV_A_R_LINEAR_____126_CM 1 100. 0. 0.9999847 DISPLAY_IDENTIFIER DELTA_LAMB_CYL_SEL_CQ_FIL[1] ECU_ADDRESS 0xd000a600 FORMAT "%7.5" /end MEASUREMENT
/begin MEASUREMENT delta_lamb_cyl_sel_cq_fil_2 "filter value of characteristic quantity of estimated cylinder individual lambda deviation" UWORD _CNV_A_R_LINEAR_____126_CM 1 100. 0. 0.9999847 DISPLAY_IDENTIFIER DELTA_LAMB_CYL_SEL_CQ_FIL[2] ECU_ADDRESS 0xd000a606 FORMAT "%7.5" /end MEASUREMENT
/begin MEASUREMENT lv_lam_cyl_act_1 "cylinder individual lambda control is active" UBYTE _CNV_S_2_RANGE__0___1_CM 1 100. 0. 1. DISPLAY_IDENTIFIER LV_LAM_CYL_ACT[1] ECU_ADDRESS 0xd00089a8 BIT_MASK 0x1 /end MEASUREMENT
/begin MEASUREMENT lv_lam_cyl_sel_ctl_drift_pred_1 "drift away behaviour of cylinder individual lambda control predicted" UBYTE _CNV_S_2_RANGE__0___1_CM 1 100. 0. 1. DISPLAY_IDENTIFIER LV_LAM_CYL_SEL_CTL_DRIFT_PRED[1] ECU_ADDRESS 0xd00089a9 BIT_MASK 0x1 /end MEASUREMENT
/begin MEASUREMENT lv_lam_cyl_sel_ctl_drift_pred_2 "drift away behaviour of cylinder individual lambda control predicted" UBYTE _CNV_S_2_RANGE__0___1_CM 1 100. 0. 1. DISPLAY_IDENTIFIER LV_LAM_CYL_SEL_CTL_DRIFT_PRED[2] ECU_ADDRESS 0xd00089ab BIT_MASK 0x1 /end MEASUREMENT
/begin CHARACTERISTIC c_crlc_delta_lamb_cyl_cq_fil "Filter correlation constant - characteristic quantity of estimated cylinder individual lambda deviation" VALUE 0xa080bacc _REC_VAL_20_u2 0.9999847412109381 _CNV_A_R_LINEAR_____89_CM 0. 0.9999847412109381 DISPLAY_IDENTIFIER C_CRLC_DELTA_LAMB_CYL_CQ_FIL FORMAT "%7.5" /end CHARACTERISTIC
/begin CHARACTERISTIC c_lamb_cyl_sel_cq_drift_thd "CQ-drift threshold for inhibition of cylinder individual lambda adaptation" VALUE 0xa080bdca _REC_VAL_20_u2 0.9999847412109381 _CNV_A_R_LINEAR_____89_CM 0. 0.9999847412109381 DISPLAY_IDENTIFIER C_LAMB_CYL_SEL_CQ_DRIFT_THD FORMAT "%7.5" /end CHARACTERISTIC
/begin CHARACTERISTIC c_mff_lam_cyl_adj_cst_max "Upper fuel mass threshold for calculation of cylinder individual lambda adaptation (engine cold)" VALUE 0xa080be7e _REC_VAL_20_u2 1389. _CNV_A_R_LINEAR_____111_CM 0. 1389. DISPLAY_IDENTIFIER C_MFF_LAM_CYL_ADJ_CST_MAX FORMAT "%7.2" /end CHARACTERISTIC
/begin CHARACTERISTIC c_mff_min_add_lam_cyl_sel_adj "Minimum value of cylinder individual fuel mass offset" VALUE 0xa080be8a _REC_VAL_20_s2 1389. _CNV_A_R_LINEAR_____128_CM -694.510597390707 694.4894026092931 DISPLAY_IDENTIFIER C_MFF_MIN_ADD_LAM_CYL_SEL_ADJ FORMAT "%7.2" /end CHARACTERISTIC
/begin CHARACTERISTIC c_mff_max_add_lam_cyl_sel_adj "Maximum value of cylinder individual fuel mass offset" VALUE 0xa080be82 _REC_VAL_20_s2 1389. _CNV_A_R_LINEAR_____128_CM -694.510597390707 694.4894026092931 DISPLAY_IDENTIFIER C_MFF_MAX_ADD_LAM_CYL_SEL_ADJ FORMAT "%7.2" /end CHARACTERISTIC
/begin AXIS_PTS ldpm_n_1_cybl "" 0xa0809568 n _REC_AXS_20_u2 8160. _CNV_A_R_LINEAR_____14_CM 8 0. 8160. FORMAT "%4.0" /end AXIS_PTS
/begin AXIS_PTS ldp_n_32_ip_fac_mff_add_cyl "" 0xa08089ee n_32 _REC_AXS_20_u1 8160. _CNV_A_R_LINEAR_____10_CM 6 0. 8160. FORMAT "%4.0" /end AXIS_PTS
/begin CHARACTERISTIC ip_fac_val_lam_cyl_sel_reac "MFF-difference- dependent factor for internal states at reactivation moment" CURVE 0xa080abfc _REC_CUR_20_u2_u2 0.9999847412109381 _CNV_A_R_LINEAR_____89_CM 0. 0.9999847412109381 DISPLAY_IDENTIFIER IP_FAC_VAL_LAM_CYL_SEL_REAC FORMAT "%7.5"
 /begin AXIS_DESCR COM_AXIS online_dummy _CNV_A_R_LINEAR_____111_CM 6 0. 1389. FORMAT "%7.2" AXIS_PTS_REF ldp_mff_delta_lam_cyl_i_ip_fac /end AXIS_DESCR
/end CHARACTERISTIC
/begin CHARACTERISTIC ip_fac_opp_lam_cyl_sel_adj "Cylindr individual lambda adaptation factor depending on operating point" MAP 0xa080a3dc _REC_MAP_20_u1_u2_u2 0.99609375 _CNV_A_R_LINEAR_____28_CM 0. 0.99609375 DISPLAY_IDENTIFIER IP_FAC_OPP_LAM_CYL_SEL_ADJ FORMAT "%5.3"
 /begin AXIS_DESCR COM_AXIS n _CNV_A_R_LINEAR_____14_CM 8 0. 8160. FORMAT "%4.0" AXIS_PTS_REF ldpm_n_1_cybl /end AXIS_DESCR
 /begin AXIS_DESCR COM_AXIS maf _CNV_A_R_LINEAR_____111_CM 8 0. 1389. FORMAT "%7.2" AXIS_PTS_REF ldpm_maf_1_cybl /end AXIS_DESCR
/end CHARACTERISTIC
/begin CHARACTERISTIC ip_fac_n_mff_add_cyl_lam_cor "Engine speed dependent factor for realization of cylinder indivudual fuel mass offset correction " CURVE 0xa080a3b4 _REC_CUR_20_u1_u1 0.99609375 _CNV_A_R_LINEAR_____28_CM 0. 0.99609375 DISPLAY_IDENTIFIER IP_FAC_N_MFF_ADD_CYL_LAM_COR FORMAT "%5.3"
 /begin AXIS_DESCR COM_AXIS n_32 _CNV_A_R_LINEAR_____10_CM 6 0. 8160. FORMAT "%4.0" AXIS_PTS_REF ldp_n_32_ip_fac_mff_add_cyl /end AXIS_DESCR
/end CHARACTERISTIC
/begin CHARACTERISTIC c_ctr_lamb_cyl_sel_cq_drift_thd "CQ-drift counter threshold for inhibition of cylinder individual lambda adaptation" VALUE 0xa080bba0 _REC_VAL_20_u2 65535. _CNV_A_R_LINEAR_____0_CM 0. 65535. DISPLAY_IDENTIFIER C_CTR_LAMB_CYL_SEL_CQ_DRIFT_THD FORMAT "%5.0" /end CHARACTERISTIC
/begin MEASUREMENT ctr_t_lam_cyl_adj_1 "Timer of cylinder individual lambda control adaptation" UBYTE _CNV_A_R_LINEAR_____36_CM 1 100. 0. 255. DISPLAY_IDENTIFIER CTR_T_LAM_CYL_ADJ[1] ECU_ADDRESS 0xd0000716 FORMAT "%3.0" /end MEASUREMENT
/begin MEASUREMENT ctr_lamb_cyl_sel_cq_drift_thd_1 "CILC - drift-away counter based on CQ value" UWORD _CNV_A_R_LINEAR_____0_CM 1 100. 0. 65535. DISPLAY_IDENTIFIER CTR_LAMB_CYL_SEL_CQ_DRIFT_THD[1] ECU_ADDRESS 0xd00005b6 FORMAT "%5.0" /end MEASUREMENT
/begin MEASUREMENT ctr_lamb_cyl_sel_cq_drift_thd_2 "CILC - drift-away counter based on CQ value" UWORD _CNV_A_R_LINEAR_____0_CM 1 100. 0. 65535. DISPLAY_IDENTIFIER CTR_LAMB_CYL_SEL_CQ_DRIFT_THD[2] ECU_ADDRESS 0xd00005ce FORMAT "%5.0" /end MEASUREMENT
/begin MEASUREMENT lv_cyl_lam_lim_min_7 "status detection of lower limit outrun" UBYTE _CNV_A_R_LINEAR_____0_CM 1 100. 0. 1. DISPLAY_IDENTIFIER LV_CYL_LAM_LIM_MIN[7] ECU_ADDRESS 0xd00089a4 FORMAT "%3.0" BIT_MASK 0x1 /end MEASUREMENT
/begin MEASUREMENT lv_lamb_cyl_sel_cq_drift_1 "drift away behaviour of cylinder individual lambda control detected - based on CQ value" UBYTE _CNV_S_2_RANGE__0___1_CM 1 100. 0. 1. DISPLAY_IDENTIFIER LV_LAMB_CYL_SEL_CQ_DRIFT[1] ECU_ADDRESS 0xd0000719 BIT_MASK 0x1 /end MEASUREMENT
/begin MEASUREMENT lv_lamb_cyl_sel_cq_drift_2 "drift away behaviour of cylinder individual lambda control detected - based on CQ value" UBYTE _CNV_S_2_RANGE__0___1_CM 1 100. 0. 1. DISPLAY_IDENTIFIER LV_LAMB_CYL_SEL_CQ_DRIFT[2] ECU_ADDRESS 0xd000071a BIT_MASK 0x1 /end MEASUREMENT
/begin CHARACTERISTIC ip_fac_wup_mff_add_cyl_lam "Temperature dependent factor for realization of cylinder indivudual fuel mass offset correction" CURVE 0xa080ac7c _REC_CUR_20_u1_u1 0.99609375 _CNV_A_R_LINEAR_____28_CM 0. 0.99609375 DISPLAY_IDENTIFIER IP_FAC_WUP_MFF_ADD_CYL_LAM FORMAT "%5.3"
 /begin AXIS_DESCR COM_AXIS tco _CNV_A_R_LINEAR_____17_CM 6 -48. 142.5 FORMAT "%6.2" AXIS_PTS_REF ldpm_tco_1_cybl /end AXIS_DESCR
/end CHARACTERISTIC
/begin MEASUREMENT mff_add_cyl_lam_cor[0] "Cylinder individual fuel mass offset correction" SWORD _CNV_A_R_LINEAR_____128_CM 1 100. -694.510597390707 694.4894026092931 DISPLAY_IDENTIFIER MFF_ADD_CYL_LAM_COR[0] ECU_ADDRESS 0xd000a5bc FORMAT "%7.2" /end MEASUREMENT
/begin MEASUREMENT mff_add_cyl_lam_cor[1] "Cylinder individual fuel mass offset correction" SWORD _CNV_A_R_LINEAR_____128_CM 1 100. -694.510597390707 694.4894026092931 DISPLAY_IDENTIFIER MFF_ADD_CYL_LAM_COR[1] ECU_ADDRESS 0xd000a5be FORMAT "%7.2" /end MEASUREMENT
/begin MEASUREMENT mff_add_cyl_lam_cor[2] "Cylinder individual fuel mass offset correction" SWORD _CNV_A_R_LINEAR_____128_CM 1 100. -694.510597390707 694.4894026092931 DISPLAY_IDENTIFIER MFF_ADD_CYL_LAM_COR[2] ECU_ADDRESS 0xd000a5c0 FORMAT "%7.2" /end MEASUREMENT
/begin MEASUREMENT mff_add_cyl_lam_cor[3] "Cylinder individual fuel mass offset correction" SWORD _CNV_A_R_LINEAR_____128_CM 1 100. -694.510597390707 694.4894026092931 DISPLAY_IDENTIFIER MFF_ADD_CYL_LAM_COR[3] ECU_ADDRESS 0xd000a5c2 FORMAT "%7.2" /end MEASUREMENT
/begin MEASUREMENT mff_add_cyl_lam_cor[4] "Cylinder individual fuel mass offset correction" SWORD _CNV_A_R_LINEAR_____128_CM 1 100. -694.510597390707 694.4894026092931 DISPLAY_IDENTIFIER MFF_ADD_CYL_LAM_COR[4] ECU_ADDRESS 0xd000a5c4 FORMAT "%7.2" /end MEASUREMENT
/begin MEASUREMENT mff_add_cyl_lam_cor[5] "Cylinder individual fuel mass offset correction" SWORD _CNV_A_R_LINEAR_____128_CM 1 100. -694.510597390707 694.4894026092931 DISPLAY_IDENTIFIER MFF_ADD_CYL_LAM_COR[5] ECU_ADDRESS 0xd000a5c6 FORMAT "%7.2" /end MEASUREMENT
/begin MEASUREMENT mff_add_cyl_lam_cor[6] "Cylinder individual fuel mass offset correction" SWORD _CNV_A_R_LINEAR_____128_CM 1 100. -694.510597390707 694.4894026092931 DISPLAY_IDENTIFIER MFF_ADD_CYL_LAM_COR[6] ECU_ADDRESS 0xd000a5c8 FORMAT "%7.2" /end MEASUREMENT
/begin MEASUREMENT mff_add_cyl_lam_cor[7] "Cylinder individual fuel mass offset correction" SWORD _CNV_A_R_LINEAR_____128_CM 1 100. -694.510597390707 694.4894026092931 DISPLAY_IDENTIFIER MFF_ADD_CYL_LAM_COR[7] ECU_ADDRESS 0xd000a5ca FORMAT "%7.2" /end MEASUREMENT
/begin MEASUREMENT mff_add_cyl_lam_cor_out[0] "Cylinder individual fuel mass offset correction - weighted output" SWORD _CNV_A_R_LINEAR_____128_CM 1 100. -694.510597390707 694.4894026092931 DISPLAY_IDENTIFIER MFF_ADD_CYL_LAM_COR_OUT[0] ECU_ADDRESS 0xd000a5ac FORMAT "%7.2" /end MEASUREMENT
/begin MEASUREMENT mff_add_cyl_lam_cor_out[1] "Cylinder individual fuel mass offset correction - weighted output" SWORD _CNV_A_R_LINEAR_____128_CM 1 100. -694.510597390707 694.4894026092931 DISPLAY_IDENTIFIER MFF_ADD_CYL_LAM_COR_OUT[1] ECU_ADDRESS 0xd000a5ae FORMAT "%7.2" /end MEASUREMENT
/begin MEASUREMENT mff_add_cyl_lam_cor_out[2] "Cylinder individual fuel mass offset correction - weighted output" SWORD _CNV_A_R_LINEAR_____128_CM 1 100. -694.510597390707 694.4894026092931 DISPLAY_IDENTIFIER MFF_ADD_CYL_LAM_COR_OUT[2] ECU_ADDRESS 0xd000a5b0 FORMAT "%7.2" /end MEASUREMENT
/begin MEASUREMENT mff_add_cyl_lam_cor_out[3] "Cylinder individual fuel mass offset correction - weighted output" SWORD _CNV_A_R_LINEAR_____128_CM 1 100. -694.510597390707 694.4894026092931 DISPLAY_IDENTIFIER MFF_ADD_CYL_LAM_COR_OUT[3] ECU_ADDRESS 0xd000a5b2 FORMAT "%7.2" /end MEASUREMENT
/begin MEASUREMENT mff_add_cyl_lam_cor_out[4] "Cylinder individual fuel mass offset correction - weighted output" SWORD _CNV_A_R_LINEAR_____128_CM 1 100. -694.510597390707 694.4894026092931 DISPLAY_IDENTIFIER MFF_ADD_CYL_LAM_COR_OUT[4] ECU_ADDRESS 0xd000a5b4 FORMAT "%7.2" /end MEASUREMENT
/begin MEASUREMENT mff_add_cyl_lam_cor_out[5] "Cylinder individual fuel mass offset correction - weighted output" SWORD _CNV_A_R_LINEAR_____128_CM 1 100. -694.510597390707 694.4894026092931 DISPLAY_IDENTIFIER MFF_ADD_CYL_LAM_COR_OUT[5] ECU_ADDRESS 0xd000a5b6 FORMAT "%7.2" /end MEASUREMENT
/begin MEASUREMENT mff_add_cyl_lam_cor_out[6] "Cylinder individual fuel mass offset correction - weighted output" SWORD _CNV_A_R_LINEAR_____128_CM 1 100. -694.510597390707 694.4894026092931 DISPLAY_IDENTIFIER MFF_ADD_CYL_LAM_COR_OUT[6] ECU_ADDRESS 0xd000a5b8 FORMAT "%7.2" /end MEASUREMENT
/begin MEASUREMENT mff_add_cyl_lam_cor_out[7] "Cylinder individual fuel mass offset correction - weighted output" SWORD _CNV_A_R_LINEAR_____128_CM 1 100. -694.510597390707 694.4894026092931 DISPLAY_IDENTIFIER MFF_ADD_CYL_LAM_COR_OUT[7] ECU_ADDRESS 0xd000a5ba FORMAT "%7.2" /end MEASUREMENT
/begin MEASUREMENT lv_lam_cyl_ena_2 "Activation of the cylinder individual lambda control is open" UBYTE _CNV_S_2_RANGE__0___1_CM 1 100. 0. 1. DISPLAY_IDENTIFIER LV_LAM_CYL_ENA[2] ECU_ADDRESS 0xd0008979 BIT_MASK 0x1 /end MEASUREMENT
/begin MEASUREMENT pha_shift_cam_ex_1 "variable phase shift (variable valve timing)" SBYTE _CNV_A_R_LINEAR_____112_CM 1 100. -720. 720. DISPLAY_IDENTIFIER PHA_SHIFT_CAM_EX[1] ECU_ADDRESS 0xd0008970 FORMAT "%6.1" /end MEASUREMENT
/begin MEASUREMENT pha_shift_cam_ex_2 "variable phase shift (variable valve timing)" SBYTE _CNV_A_R_LINEAR_____112_CM 1 100. -720. 720. DISPLAY_IDENTIFIER PHA_SHIFT_CAM_EX[2] ECU_ADDRESS 0xd0008973 FORMAT "%6.1" /end MEASUREMENT
/begin CHARACTERISTIC c_fac_mv_ls_up_dyn_lam_cyl_thd "CILC-specific threshold of limit-sensor" VALUE 0xa080bce6 _REC_VAL_20_u2 31.9990234375 _CNV_A_R_LINEAR_____129_CM 0. 31.9990234375 DISPLAY_IDENTIFIER C_FAC_MV_LS_UP_DYN_LAM_CYL_THD FORMAT "%7.4" /end CHARACTERISTIC
/begin CHARACTERISTIC c_cl_mmv_lam_cyl_max "max. canister load" VALUE 0xa080baa8 _REC_VAL_20_u2 7.9998779296875 _CNV_A_R_LINEAR_____115_CM 0. 7.9998779296875 DISPLAY_IDENTIFIER C_CL_MMV_LAM_CYL_MAX FORMAT "%6.4" /end CHARACTERISTIC
/begin CHARACTERISTIC c_teg_cat_up_mdl_lam_cyl_max "max. exhaust gas temperature; engine out-alternative value for sensor hexagon temperature" VALUE 0xa080c300 _REC_VAL_20_u2 2047. _CNV_A_R_LINEAR_____130_CM 0. 2047. DISPLAY_IDENTIFIER C_TEG_CAT_UP_MDL_LAM_CYL_MAX FORMAT "%9.4" /end CHARACTERISTIC
/begin MEASUREMENT lv_lam_cyl_ena_cyl_bal_dc_2 "Specific activation conditions for cylinder individual lambda control are fulfilled in DC (CYBL coordination)" UBYTE _CNV_S_2_RANGE__0___1_CM 1 100. 0. 1. DISPLAY_IDENTIFIER LV_LAM_CYL_ENA_CYL_BAL_DC[2] ECU_ADDRESS 0xd000897a BIT_MASK 0x1 /end MEASUREMENT
/begin CHARACTERISTIC c_wgpwm_max_lam_cyl_sel "Maximum threshold of waste gate signal for activation of cylinder individual lambda control" VALUE 0xa080c50c _REC_VAL_20_u2 99.99847412109381 _CNV_A_R_LINEAR_____8_CM 0. 99.99847412109381 DISPLAY_IDENTIFIER C_WGPWM_MAX_LAM_CYL_SEL /end CHARACTERISTIC
/begin AXIS_PTS ldpm_n_3_cybl "" 0xa0809644 n _REC_AXS_20_u2 8160. _CNV_A_R_LINEAR_____14_CM 6 0. 8160. FORMAT "%4.0" /end AXIS_PTS
/begin AXIS_PTS ldpm_n_4_cybl "" 0xa0809658 n _REC_AXS_20_u2 8160. _CNV_A_R_LINEAR_____14_CM 6 0. 8160. FORMAT "%4.0" /end AXIS_PTS
/begin CHARACTERISTIC c_amp_lam_cyl_min "Minimum ambient pressure for the activation" VALUE 0xa080ba8a _REC_VAL_20_u2 5434. _CNV_A_R_LINEAR_____27_CM 0. 5434. DISPLAY_IDENTIFIER C_AMP_LAM_CYL_MIN FORMAT "%7.2" /end CHARACTERISTIC
/begin CHARACTERISTIC clf_ls_cbk_ex_lam_cyl_sel_conf "Configuration pattern for allocation of physical cylinders to exhaust bank" VALUE 0xa080c510 _REC_VAL_20_u1 255. _CNV_A_R_LINEAR_____0_CM 0. 255. DISPLAY_IDENTIFIER CLF_LS_CBK_EX_LAM_CYL_SEL_CONF FORMAT "%3.0" /end CHARACTERISTIC
/begin MEASUREMENT lv_lam_cyl_ena_cyl_bal_dc_1 "Specific activation conditions for cylinder individual lambda control are fulfilled in DC (CYBL coordination)" UBYTE _CNV_S_2_RANGE__0___1_CM 1 100. 0. 1. DISPLAY_IDENTIFIER LV_LAM_CYL_ENA_CYL_BAL_DC[1] ECU_ADDRESS 0xd0008976 BIT_MASK 0x1 /end MEASUREMENT
/begin CHARACTERISTIC ip_mff_lam_cyl_max_eol "Maximum fuel mass/engine speed threshold for the activation of cylinder individual lambda at EOL" CURVE 0xa080af0c _REC_CUR_20_u2_u2 1389. _CNV_A_R_LINEAR_____111_CM 0. 1389. DISPLAY_IDENTIFIER IP_MFF_LAM_CYL_MAX_EOL FORMAT "%7.2"
 /begin AXIS_DESCR COM_AXIS n _CNV_A_R_LINEAR_____14_CM 6 0. 8160. FORMAT "%4.0" AXIS_PTS_REF ldpm_n_3_cybl /end AXIS_DESCR
/end CHARACTERISTIC
/begin CHARACTERISTIC ip_mff_lam_cyl_min_nom "Minimum fuel mass/engine speed threshold for the activation of cylinder individual lambda - nominal" CURVE 0xa080af30 _REC_CUR_20_u2_u2 1389. _CNV_A_R_LINEAR_____111_CM 0. 1389. DISPLAY_IDENTIFIER IP_MFF_LAM_CYL_MIN_NOM FORMAT "%7.2"
 /begin AXIS_DESCR COM_AXIS n _CNV_A_R_LINEAR_____14_CM 6 0. 8160. FORMAT "%4.0" AXIS_PTS_REF ldpm_n_4_cybl /end AXIS_DESCR
/end CHARACTERISTIC
/begin CHARACTERISTIC ip_mff_lam_cyl_min_eol "Minimum fuel mass/engine speed threshold for the activation of cylinder individual lambda at EOL" CURVE 0xa080af24 _REC_CUR_20_u2_u2 1389. _CNV_A_R_LINEAR_____111_CM 0. 1389. DISPLAY_IDENTIFIER IP_MFF_LAM_CYL_MIN_EOL FORMAT "%7.2"
 /begin AXIS_DESCR COM_AXIS n _CNV_A_R_LINEAR_____14_CM 6 0. 8160. FORMAT "%4.0" AXIS_PTS_REF ldpm_n_3_cybl /end AXIS_DESCR
/end CHARACTERISTIC
/begin CHARACTERISTIC ip_mff_lam_cyl_max_nom "Maximum fuel mass/engine speed threshold for the activation of cylinder individual lambda - nominal" CURVE 0xa080af18 _REC_CUR_20_u2_u2 1389. _CNV_A_R_LINEAR_____111_CM 0. 1389. DISPLAY_IDENTIFIER IP_MFF_LAM_CYL_MAX_NOM FORMAT "%7.2"
 /begin AXIS_DESCR COM_AXIS n _CNV_A_R_LINEAR_____14_CM 6 0. 8160. FORMAT "%4.0" AXIS_PTS_REF ldpm_n_4_cybl /end AXIS_DESCR
/end CHARACTERISTIC
/begin MEASUREMENT lf_ls_cbk_ex_lam_cyl_sel_conf "Logical variables data field for allocation of physical cylinders to exhaust bank" UBYTE _CNV_A_R_LINEAR_____0_CM 1 100. 0. 255. DISPLAY_IDENTIFIER LF_LS_CBK_EX_LAM_CYL_SEL_CONF ECU_ADDRESS 0xd0008971 FORMAT "%3.0" /end MEASUREMENT
/begin CHARACTERISTIC lc_lam_cyl_ena_cdn_man "Manual switch to enable the cylinder individual lambda control ignoring the conditions are fulfilled" VALUE 0xa080c59d _REC_VAL_20_u1 1. _CNV_A_R_LINEAR_____0_CM 0. 1. DISPLAY_IDENTIFIER LC_LAM_CYL_ENA_CDN_MAN FORMAT "%1.0" /end CHARACTERISTIC
/begin MEASUREMENT lv_lam_cyl_ena_1 "Activation of the cylinder individual lambda control is open" UBYTE _CNV_S_2_RANGE__0___1_CM 1 100. 0. 1. DISPLAY_IDENTIFIER LV_LAM_CYL_ENA[1] ECU_ADDRESS 0xd0008975 BIT_MASK 0x1 /end MEASUREMENT
/begin MEASUREMENT lv_lam_cyl_sel_ctl_fast_req "Fast cylinder individual lambda control requested" UBYTE _CNV_S_2_RANGE__0___1_CM 1 100. 0. 1. DISPLAY_IDENTIFIER LV_LAM_CYL_SEL_CTL_FAST_REQ ECU_ADDRESS 0xd0008977 BIT_MASK 0x1 /end MEASUREMENT
/begin MEASUREMENT lv_ls_cbk_lam_cyl_sel_conf_vld "Configuration pattern for allocation of physical cylinders to exhaust bank is valid (=1)" UBYTE _CNV_S_2_RANGE__0___1_CM 1 100. 0. 1. DISPLAY_IDENTIFIER LV_LS_CBK_LAM_CYL_SEL_CONF_VLD ECU_ADDRESS 0xd0000895 BIT_MASK 0x1 /end MEASUREMENT
/begin CHARACTERISTIC c_n_lam_cyl_max_nom "Maximum engine speed for the activation - nominal" VALUE 0xa080bf52 _REC_VAL_20_u2 8160. _CNV_A_R_LINEAR_____14_CM 0. 8160. DISPLAY_IDENTIFIER C_N_LAM_CYL_MAX_NOM FORMAT "%4.0" /end CHARACTERISTIC
/begin CHARACTERISTIC c_n_lam_cyl_max_eol "Maximum engine speed for the activation at EOL" VALUE 0xa080bf50 _REC_VAL_20_u2 8160. _CNV_A_R_LINEAR_____14_CM 0. 8160. DISPLAY_IDENTIFIER C_N_LAM_CYL_MAX_EOL FORMAT "%4.0" /end CHARACTERISTIC
/begin CHARACTERISTIC c_n_lam_cyl_min_eol "Minimum engine speed for the activation at EOL" VALUE 0xa080bf54 _REC_VAL_20_u2 8160. _CNV_A_R_LINEAR_____14_CM 0. 8160. DISPLAY_IDENTIFIER C_N_LAM_CYL_MIN_EOL FORMAT "%4.0" /end CHARACTERISTIC
/begin MEASUREMENT lv_mff_n_cdn_lam_cyl_ena_1 "Fuel mass- and engine speed condition for the activation of the cylinder individual lambda control fulfilled" UBYTE _CNV_S_2_RANGE__0___1_CM 1 100. 0. 1. DISPLAY_IDENTIFIER LV_MFF_N_CDN_LAM_CYL_ENA[1] ECU_ADDRESS 0xd0000894 BIT_MASK 0x1 /end MEASUREMENT
/begin MEASUREMENT lv_mff_n_cdn_lam_cyl_ena_2 "Fuel mass- and engine speed condition for the activation of the cylinder individual lambda control fulfilled" UBYTE _CNV_S_2_RANGE__0___1_CM 1 100. 0. 1. DISPLAY_IDENTIFIER LV_MFF_N_CDN_LAM_CYL_ENA[2] ECU_ADDRESS 0xd0000896 BIT_MASK 0x1 /end MEASUREMENT
/begin CHARACTERISTIC lc_lam_cyl_sel_ctl_fast_req_man "Manual switch for a fast cylinder individual lambda control (=1)" VALUE 0xa080c59f _REC_VAL_20_u1 1. _CNV_A_R_LINEAR_____0_CM 0. 1. DISPLAY_IDENTIFIER LC_LAM_CYL_SEL_CTL_FAST_REQ_MAN FORMAT "%1.0" /end CHARACTERISTIC
/begin CHARACTERISTIC lc_lam_cyl_sel_adj_ofs_rng_req "Manual request for calculation of cylinder individual lambda adaptation in the additive area (=1)" VALUE 0xa080c59e _REC_VAL_20_u1 1. _CNV_A_R_LINEAR_____0_CM 0. 1. DISPLAY_IDENTIFIER LC_LAM_CYL_SEL_ADJ_OFS_RNG_REQ FORMAT "%1.0" /end CHARACTERISTIC
/begin CHARACTERISTIC c_n_lam_cyl_min_nom "Minimum engine speed for the activation - nominal" VALUE 0xa080bf56 _REC_VAL_20_u2 8160. _CNV_A_R_LINEAR_____14_CM 0. 8160. DISPLAY_IDENTIFIER C_N_LAM_CYL_MIN_NOM FORMAT "%4.0" /end CHARACTERISTIC
/begin CHARACTERISTIC c_n_max_lam_cyl_sel_adj_add "Upper engine speed threshold for calculation of cylinder individual lambda adaptation in the additive area" VALUE 0xa080bf90 _REC_VAL_20_u2 8160. _CNV_A_R_LINEAR_____14_CM 0. 8160. DISPLAY_IDENTIFIER C_N_MAX_LAM_CYL_SEL_ADJ_ADD FORMAT "%4.0" /end CHARACTERISTIC
/begin CHARACTERISTIC c_mff_max_lam_cyl_sel_adj_add "Upper fuel mass threshold for calculation of cylinder individual lambda adaptation in the additive area" VALUE 0xa080be88 _REC_VAL_20_u2 1389. _CNV_A_R_LINEAR_____111_CM 0. 1389. DISPLAY_IDENTIFIER C_MFF_MAX_LAM_CYL_SEL_ADJ_ADD FORMAT "%7.2" /end CHARACTERISTIC
/begin MEASUREMENT state_cdn_lam_cyl_sel_adj_rng_1 "Condition-state of cylinder individual lambda adaptation" UBYTE _CNV_S_4_STATE_CDN__131_CM 1 100. 0. 3. DISPLAY_IDENTIFIER STATE_CDN_LAM_CYL_SEL_ADJ_RNG[1] ECU_ADDRESS 0xd0008972 /end MEASUREMENT
/begin MEASUREMENT state_cdn_lam_cyl_sel_adj_rng_2 "Condition-state of cylinder individual lambda adaptation" UBYTE _CNV_S_4_STATE_CDN__131_CM 1 100. 0. 3. DISPLAY_IDENTIFIER STATE_CDN_LAM_CYL_SEL_ADJ_RNG[2] ECU_ADDRESS 0xd0008974 /end MEASUREMENT
/begin CHARACTERISTIC ip_iga_bas_crk_cyl_lam "Basic ignition angle stored during calibration of IP_CRK_SYN" MAP 0xa0814f3c _REC_MAP_20_u2_u2_u2 180. _CNV_A_R_LINEAR_____132_CM -90. 90. DISPLAY_IDENTIFIER IP_IGA_BAS_CRK_CYL_LAM FORMAT "%8.4"
 /begin AXIS_DESCR COM_AXIS n _CNV_A_R_LINEAR_____14_CM 8 0. 8160. FORMAT "%4.0" AXIS_PTS_REF ldpm_n_1_cybl /end AXIS_DESCR
 /begin AXIS_DESCR COM_AXIS maf _CNV_A_R_LINEAR_____111_CM 8 0. 1389. FORMAT "%7.2" AXIS_PTS_REF ldpm_maf_1_cybl /end AXIS_DESCR
/end CHARACTERISTIC
/begin MEASUREMENT lv_lam_cyl_sel_adj_ofs_req_1 "Cylinder individual fuel mass offset correction requested" UBYTE _CNV_S_2_RANGE__0___1_CM 1 100. 0. 1. DISPLAY_IDENTIFIER LV_LAM_CYL_SEL_ADJ_OFS_REQ[1] ECU_ADDRESS 0xd0008978 BIT_MASK 0x1 /end MEASUREMENT
/begin MEASUREMENT lv_lam_cyl_sel_adj_ofs_req_2 "Cylinder individual fuel mass offset correction requested" UBYTE _CNV_S_2_RANGE__0___1_CM 1 100. 0. 1. DISPLAY_IDENTIFIER LV_LAM_CYL_SEL_ADJ_OFS_REQ[2] ECU_ADDRESS 0xd000897b BIT_MASK 0x1 /end MEASUREMENT
/begin MEASUREMENT lv_lam_cyl_sel_ldc[0] "Detection flag of limited dynamics for cylinder individual lambda control" UBYTE _CNV_S_2_RANGE__0___1_CM 1 100. 0. 1. DISPLAY_IDENTIFIER LV_LAM_CYL_SEL_LDC[1] ECU_ADDRESS 0xd00089ac /end MEASUREMENT
/begin MEASUREMENT lv_lam_cyl_sel_ldc[1] "Detection flag of limited dynamics for cylinder individual lambda control" UBYTE _CNV_S_2_RANGE__0___1_CM 1 100. 0. 1. DISPLAY_IDENTIFIER LV_LAM_CYL_SEL_LDC[2] ECU_ADDRESS 0xd00089ad /end MEASUREMENT
/begin MEASUREMENT fac_lam_mv_ofs_ldc_lam_cyl_sel[0] "Offset of lambda controller output mean value for detection of limited dynamics (cylinder individual lambda control)" SWORD _CNV_A_R_LINEAR_____113_CM 1 100. -50. 49.9984741210938 DISPLAY_IDENTIFIER FAC_LAM_MV_OFS_LDC_LAM_CYL_SEL[1] ECU_ADDRESS 0xd000071c FORMAT "%7.3" /end MEASUREMENT
/begin MEASUREMENT fac_lam_mv_ofs_ldc_lam_cyl_sel[1] "Offset of lambda controller output mean value for detection of limited dynamics (cylinder individual lambda control)" SWORD _CNV_A_R_LINEAR_____113_CM 1 100. -50. 49.9984741210938 DISPLAY_IDENTIFIER FAC_LAM_MV_OFS_LDC_LAM_CYL_SEL[2] ECU_ADDRESS 0xd000071e FORMAT "%7.3" /end MEASUREMENT
/begin MEASUREMENT maf_int_ldc_lam_cyl_sel[0] "Air mass flow integral during the time after limited dynamics was interrupted" UWORD _CNV_A_R_CYBL_LINEA_135_CM 1 100. 0. 1456.33 DISPLAY_IDENTIFIER MAF_INT_LDC_LAM_CYL_SEL[1] ECU_ADDRESS 0xd0000720 FORMAT "%7.2" /end MEASUREMENT
/begin MEASUREMENT maf_int_ldc_lam_cyl_sel[1] "Air mass flow integral during the time after limited dynamics was interrupted" UWORD _CNV_A_R_CYBL_LINEA_135_CM 1 100. 0. 1456.33 DISPLAY_IDENTIFIER MAF_INT_LDC_LAM_CYL_SEL[2] ECU_ADDRESS 0xd0000722 FORMAT "%7.2" /end MEASUREMENT
/begin MEASUREMENT maf_ofs_ldc_lam_cyl_sel "Offset of air mass flow for detection of limited dynamics for cylinder individual lambda control" SWORD _CNV_A_R_LINEAR_____128_CM 1 100. -694.510597390707 694.4894026092931 DISPLAY_IDENTIFIER MAF_OFS_LDC_LAM_CYL_SEL ECU_ADDRESS 0xd0000724 FORMAT "%7.2" /end MEASUREMENT
/begin MEASUREMENT n_ofs_ldc_lam_cyl_sel "Offset of engine speed for detection of limited dynamics for cylinder individual lambda control" SWORD _CNV_A_R_LINEAR_____14_CM 1 100. -8160. 8160. DISPLAY_IDENTIFIER N_OFS_LDC_LAM_CYL_SEL ECU_ADDRESS 0xd0000726 FORMAT "%6.0" /end MEASUREMENT
/begin CHARACTERISTIC c_n_dyw_ldc_lam_cyl_sel "Dynamic window of engine speed for detection of limited dynamics (cylinder individual lambda control)" VALUE 0xa080bf2c _REC_VAL_20_u2 8160. _CNV_A_R_LINEAR_____14_CM 0. 8160. DISPLAY_IDENTIFIER C_N_DYW_LDC_LAM_CYL_SEL FORMAT "%4.0" /end CHARACTERISTIC
/begin CHARACTERISTIC c_maf_dyw_ldc_lam_cyl_sel "Dynamic window of MAF for detection of limited dynamics (cylinder individual lambda control)" VALUE 0xa080be26 _REC_VAL_20_u2 1389. _CNV_A_R_LINEAR_____111_CM 0. 1389. DISPLAY_IDENTIFIER C_MAF_DYW_LDC_LAM_CYL_SEL FORMAT "%7.2" /end CHARACTERISTIC
/begin CHARACTERISTIC c_fac_lam_dyw_ldc_lam_cyl_sel "Dynamic window of lambda controller output for detection of limited dynamics (cylinder individual lambda control)" VALUE 0xa080bcd6 _REC_VAL_20_u2 49.99847412 _CNV_A_R_LINEAR_____125_CM 0. 49.99847412 DISPLAY_IDENTIFIER C_FAC_LAM_DYW_LDC_LAM_CYL_SEL /end CHARACTERISTIC
/begin CHARACTERISTIC c_maf_int_ldc_lam_cyl_sel "Threshold of air mass flow integral for detection of limited dynamics for cylinder individual lambda control" VALUE 0xa080be2c _REC_VAL_20_u2 1456.33 _CNV_A_R_CYBL_LINEA_135_CM 0. 1456.33 DISPLAY_IDENTIFIER C_MAF_INT_LDC_LAM_CYL_SEL FORMAT "%7.2" /end CHARACTERISTIC
/begin CHARACTERISTIC c_fac_l_lam_adj_dif_cyl_bal "lambda factor threshold for cylinder balancing lambda adaptation within limits at end of line" VALUE 0xa080bcd0 _REC_VAL_20_s2 99.99847412109381 _CNV_A_R_LINEAR_____113_CM -50. 49.9984741210938 DISPLAY_IDENTIFIER C_FAC_L_LAM_ADJ_DIF_CYL_BAL FORMAT "%7.3" /end CHARACTERISTIC
/begin CHARACTERISTIC c_fac_mff_lam_adj_dif_cyl_bal "Lambda additive threshold for cylinder balancing lambda adaptation within limits at end of line" VALUE 0xa080bce4 _REC_VAL_20_s2 99.99847412109381 _CNV_A_R_LINEAR_____113_CM -50. 49.9984741210938 DISPLAY_IDENTIFIER C_FAC_MFF_LAM_ADJ_DIF_CYL_BAL FORMAT "%7.3" /end CHARACTERISTIC
/begin CHARACTERISTIC c_t_min_cyl_bal_er_ad_dyn "Minimum time for cylinder balancing engine roughness adaptation within limits at end of line" VALUE 0xa080c214 _REC_VAL_20_u2 6553.5 _CNV_A_R_LINEAR_____4_CM 0. 6553.5 DISPLAY_IDENTIFIER C_T_MIN_CYL_BAL_ER_AD_DYN FORMAT "%6.1" /end CHARACTERISTIC
/begin CHARACTERISTIC c_t_max_cyl_bal_er_ad "maximum time for cylinder balancing engine roughness adaptation at end of line" VALUE 0xa080c1de _REC_VAL_20_u2 6553.5 _CNV_A_R_LINEAR_____4_CM 0. 6553.5 DISPLAY_IDENTIFIER C_T_MAX_CYL_BAL_ER_AD FORMAT "%6.1" /end CHARACTERISTIC
/begin CHARACTERISTIC c_t_dec_cyl_bal_er_ad_dyn "Time decrement value for cylinder balancing engine roughness adaptation within limits at end of line" VALUE 0xa080c158 _REC_VAL_20_u2 6553.5 _CNV_A_R_LINEAR_____4_CM 0. 6553.5 DISPLAY_IDENTIFIER C_T_DEC_CYL_BAL_ER_AD_DYN FORMAT "%6.1" /end CHARACTERISTIC
/begin CHARACTERISTIC c_t_min_cyl_bal_lam_sel_ad_cold "Minimum time for cylinder balancing cylinder selective lambda adaptation (cold) within limits at end of line" VALUE 0xa080c218 _REC_VAL_20_u2 6553.5 _CNV_A_R_LINEAR_____4_CM 0. 6553.5 DISPLAY_IDENTIFIER C_T_MIN_CYL_BAL_LAM_SEL_AD_COLD FORMAT "%6.1" /end CHARACTERISTIC
/begin CHARACTERISTIC c_t_dec_cyl_bal_lam_sel_cbk_ad "Time decrement value for cylinder balancing cylinder selectiv lambda adaptation within limits at end of line" VALUE 0xa080c15a _REC_VAL_20_u2 6553.5 _CNV_A_R_LINEAR_____4_CM 0. 6553.5 DISPLAY_IDENTIFIER C_T_DEC_CYL_BAL_LAM_SEL_CBK_AD FORMAT "%6.1" /end CHARACTERISTIC
/begin CHARACTERISTIC c_t_max_cyl_bal_lam_ad "Maximum time for cylinder balancing lambda adaptation at end of line" VALUE 0xa080c1e0 _REC_VAL_20_u2 1310.7 _CNV_A_R_LINEAR_____110_CM 0. 1310.7 DISPLAY_IDENTIFIER C_T_MAX_CYL_BAL_LAM_AD FORMAT "%7.2" /end CHARACTERISTIC
/begin CHARACTERISTIC c_ctr_min_cyl_bal_lam_ad_fac "Minimum counter value for cylinder balancing lambda adaptation (multiple) within limits at end of line" VALUE 0xa080bbb6 _REC_VAL_20_u2 65535. _CNV_A_R_LINEAR_____0_CM 0. 65535. DISPLAY_IDENTIFIER C_CTR_MIN_CYL_BAL_LAM_AD_FAC FORMAT "%5.0" /end CHARACTERISTIC
/begin CHARACTERISTIC c_ctr_min_cyl_bal_lam_ad_add "Minimum counter value for cylinder balancing lambda adaptation (additive) within limits at end of line" VALUE 0xa080bbb4 _REC_VAL_20_u2 65535. _CNV_A_R_LINEAR_____0_CM 0. 65535. DISPLAY_IDENTIFIER C_CTR_MIN_CYL_BAL_LAM_AD_ADD FORMAT "%5.0" /end CHARACTERISTIC
/begin CHARACTERISTIC c_ctr_dec_cyl_bal_lam_cbk_ad "Counter decrement value for cylinder balancing lambda adaptation within limits at end of line" VALUE 0xa080bb42 _REC_VAL_20_u2 65535. _CNV_A_R_LINEAR_____0_CM 0. 65535. DISPLAY_IDENTIFIER C_CTR_DEC_CYL_BAL_LAM_CBK_AD FORMAT "%5.0" /end CHARACTERISTIC
/begin CHARACTERISTIC lc_cyl_bal_ad_eol_rst "Manual switch for cylinder balancing adaptation reset at end of line" VALUE 0xa080c546 _REC_VAL_20_u1 1. _CNV_A_R_LINEAR_____0_CM 0. 1. DISPLAY_IDENTIFIER LC_CYL_BAL_AD_EOL_RST FORMAT "%1.0" /end CHARACTERISTIC
/begin MEASUREMENT lv_cyl_bal_lam_ad_eol "Flag for cylinder balancing lambda adaptation at end of line finished" UBYTE _CNV_S_2_RANGE__0___1_CM 1 100. 0. 1. DISPLAY_IDENTIFIER LV_CYL_BAL_LAM_AD_EOL ECU_ADDRESS 0xd0008cdc BIT_MASK 0x1 /end MEASUREMENT
/begin MEASUREMENT lv_cyl_bal_er_ad_fac_eol "Flag for cylinder balancing multiple engine roughness adaptation at end of line finished" UBYTE _CNV_S_2_RANGE__0___1_CM 1 100. 0. 1. DISPLAY_IDENTIFIER LV_CYL_BAL_ER_AD_FAC_EOL ECU_ADDRESS 0xd0008cdd BIT_MASK 0x1 /end MEASUREMENT
/begin MEASUREMENT lv_cyl_bal_er_ad_add_eol "Flag for cylinder balancing additive engine roughness adaptation at end of line finished" UBYTE _CNV_S_2_RANGE__0___1_CM 1 100. 0. 1. DISPLAY_IDENTIFIER LV_CYL_BAL_ER_AD_ADD_EOL ECU_ADDRESS 0xd0008cde BIT_MASK 0x1 /end MEASUREMENT
/begin MEASUREMENT lv_cyl_bal_lam_sel_ad_cold_eol "Flag for cylinder balancing cylinder selective lambda adaptation (cold) at end of line finished" UBYTE _CNV_S_2_RANGE__0___1_CM 1 100. 0. 1. DISPLAY_IDENTIFIER LV_CYL_BAL_LAM_SEL_AD_COLD_EOL ECU_ADDRESS 0xd0008cdf BIT_MASK 0x1 /end MEASUREMENT
/begin MEASUREMENT lv_cyl_bal_lam_sel_ad_hot_eol "Flag for cylinder balancing cylinder selective lambda adaptation (hot) at end of line finished" UBYTE _CNV_S_2_RANGE__0___1_CM 1 100. 0. 1. DISPLAY_IDENTIFIER LV_CYL_BAL_LAM_SEL_AD_HOT_EOL ECU_ADDRESS 0xd0008ce0 BIT_MASK 0x1 /end MEASUREMENT
/begin MEASUREMENT t_cyl_bal_er_ad "Time for cylinder balancing engine roughness adaptation at end of line" UWORD _CNV_A_R_LINEAR_____4_CM 1 100. 0. 6553.5 DISPLAY_IDENTIFIER T_CYL_BAL_ER_AD ECU_ADDRESS 0xd0000794 FORMAT "%6.1" /end MEASUREMENT
/begin MEASUREMENT t_cyl_bal_lam_sel_ad "Time for cylinder balancing cylinder selective lambda adaptation at end of line" UWORD _CNV_A_R_LINEAR_____4_CM 1 100. 0. 6553.5 DISPLAY_IDENTIFIER T_CYL_BAL_LAM_SEL_AD ECU_ADDRESS 0xd0000796 FORMAT "%6.1" /end MEASUREMENT
/begin MEASUREMENT t_cyl_bal_lam_ad "Time for cylinder balancing lambda adaptation at end of line" UWORD _CNV_A_R_LINEAR_____110_CM 1 100. 0. 1310.7 DISPLAY_IDENTIFIER T_CYL_BAL_LAM_AD ECU_ADDRESS 0xd0000798 FORMAT "%7.2" /end MEASUREMENT
/begin MEASUREMENT t_cyl_bal_er_ad_dyw "time for cylinder balancing engine roughness adaptation at end of line within limits" UWORD _CNV_A_R_LINEAR_____4_CM 1 100. 0. 6553.5 DISPLAY_IDENTIFIER T_CYL_BAL_ER_AD_DYW ECU_ADDRESS 0xd000079a FORMAT "%6.1" /end MEASUREMENT
/begin MEASUREMENT er_stnd_mmv_dif_bal_dyw "Dynamic window value for cylinder balancing engine roughness adaptation at end of line" SWORD _CNV_A_R_LINEAR_____140_CM 1 100. -325.78 325.770057983398 DISPLAY_IDENTIFIER ER_STND_MMV_DIF_BAL_DYW ECU_ADDRESS 0xd00007a4 FORMAT "%8.3" /end MEASUREMENT
/begin MEASUREMENT er_stnd_mmv_dif_bal_max_dyw "Maximum er_stnd_mmv_bal value for dynamic window calculation at end of line" SWORD _CNV_A_R_LINEAR_____140_CM 1 100. -325.78 325.770057983398 DISPLAY_IDENTIFIER ER_STND_MMV_DIF_BAL_MAX_DYW ECU_ADDRESS 0xd00007a6 FORMAT "%8.3" /end MEASUREMENT
/begin MEASUREMENT er_stnd_mmv_dif_bal_min_dyw "Minimum er_stnd_mmv_bal value for dynamic window calculation at end of line" SWORD _CNV_A_R_LINEAR_____140_CM 1 100. -325.78 325.770057983398 DISPLAY_IDENTIFIER ER_STND_MMV_DIF_BAL_MIN_DYW ECU_ADDRESS 0xd00007a8 FORMAT "%8.3" /end MEASUREMENT
/begin MEASUREMENT t_cyl_bal_lam_sel_cbk_ad[0] "Time for cylinder balancing cylinder selective lambda adaptation at end of line within limits" UWORD _CNV_A_R_LINEAR_____4_CM 1 100. 0. 6553.5 DISPLAY_IDENTIFIER T_CYL_BAL_LAM_SEL_CBK_AD[1] ECU_ADDRESS 0xd00007a0 FORMAT "%6.1" /end MEASUREMENT
/begin MEASUREMENT t_cyl_bal_lam_sel_cbk_ad[1] "Time for cylinder balancing cylinder selective lambda adaptation at end of line within limits" UWORD _CNV_A_R_LINEAR_____4_CM 1 100. 0. 6553.5 DISPLAY_IDENTIFIER T_CYL_BAL_LAM_SEL_CBK_AD[2] ECU_ADDRESS 0xd00007a2 FORMAT "%6.1" /end MEASUREMENT
/begin MEASUREMENT lv_state_cyl_bal_sel_chg_ad "Flag for cylinder balancing cylinder selective lambda adaptation to state adaptation requested" UBYTE _CNV_S_2_RANGE__0___1_CM 1 100. 0. 1. DISPLAY_IDENTIFIER LV_STATE_CYL_BAL_SEL_CHG_AD ECU_ADDRESS 0xd00007ac BIT_MASK 0x1 /end MEASUREMENT
/begin MEASUREMENT lv_state_cyl_bal_sel_chg_wait[0] "Flag for cylinder balancing cylinder selective lambda adaptation to state wait requested" UBYTE _CNV_S_2_RANGE__0___1_CM 1 100. 0. 1. DISPLAY_IDENTIFIER LV_STATE_CYL_BAL_SEL_CHG_WAIT[1] ECU_ADDRESS 0xd00007ae BIT_MASK 0x1 /end MEASUREMENT
/begin MEASUREMENT lv_state_cyl_bal_sel_chg_wait[1] "Flag for cylinder balancing cylinder selective lambda adaptation to state wait requested" UBYTE _CNV_S_2_RANGE__0___1_CM 1 100. 0. 1. DISPLAY_IDENTIFIER LV_STATE_CYL_BAL_SEL_CHG_WAIT[2] ECU_ADDRESS 0xd00007af BIT_MASK 0x1 /end MEASUREMENT
/begin MEASUREMENT lv_cyl_bal_lam_sel_ad_cold[0] "Flag for cylinder balancing cylinder selective lambda adaptation (cold) exhaust bank specific" UBYTE _CNV_S_2_RANGE__0___1_CM 1 100. 0. 1. DISPLAY_IDENTIFIER LV_CYL_BAL_LAM_SEL_AD_COLD[1] ECU_ADDRESS 0xd0008ce2 BIT_MASK 0x1 /end MEASUREMENT
/begin MEASUREMENT lv_cyl_bal_lam_sel_ad_cold[1] "Flag for cylinder balancing cylinder selective lambda adaptation (cold) exhaust bank specific" UBYTE _CNV_S_2_RANGE__0___1_CM 1 100. 0. 1. DISPLAY_IDENTIFIER LV_CYL_BAL_LAM_SEL_AD_COLD[2] ECU_ADDRESS 0xd0008ce3 BIT_MASK 0x1 /end MEASUREMENT
/begin MEASUREMENT ctr_cyl_bal_lam_cbk_ad[0] "Counter for cylinder balancing lambda adaptation at end of line within limits" UWORD _CNV_A_R_LINEAR_____0_CM 1 100. 0. 65535. DISPLAY_IDENTIFIER CTR_CYL_BAL_LAM_CBK_AD[1] ECU_ADDRESS 0xd000079c FORMAT "%5.0" /end MEASUREMENT
/begin MEASUREMENT ctr_cyl_bal_lam_cbk_ad[1] "Counter for cylinder balancing lambda adaptation at end of line within limits" UWORD _CNV_A_R_LINEAR_____0_CM 1 100. 0. 65535. DISPLAY_IDENTIFIER CTR_CYL_BAL_LAM_CBK_AD[2] ECU_ADDRESS 0xd000079e FORMAT "%5.0" /end MEASUREMENT
/begin MEASUREMENT lv_state_cyl_bal_lam_chg_ad "Flag for cylinder balancing lambda adaptation to state adaptation requested" UBYTE _CNV_S_2_RANGE__0___1_CM 1 100. 0. 1. DISPLAY_IDENTIFIER LV_STATE_CYL_BAL_LAM_CHG_AD ECU_ADDRESS 0xd00007ad BIT_MASK 0x1 /end MEASUREMENT
/begin MEASUREMENT lv_state_cyl_bal_lam_chg_wait[0] "Flag for cylinder balancing lambda adaptation to state wait requested" UBYTE _CNV_S_2_RANGE__0___1_CM 1 100. 0. 1. DISPLAY_IDENTIFIER LV_STATE_CYL_BAL_LAM_CHG_WAIT[1] ECU_ADDRESS 0xd00007b0 BIT_MASK 0x1 /end MEASUREMENT
/begin MEASUREMENT lv_state_cyl_bal_lam_chg_wait[1] "Flag for cylinder balancing lambda adaptation to state wait requested" UBYTE _CNV_S_2_RANGE__0___1_CM 1 100. 0. 1. DISPLAY_IDENTIFIER LV_STATE_CYL_BAL_LAM_CHG_WAIT[2] ECU_ADDRESS 0xd00007b1 BIT_MASK 0x1 /end MEASUREMENT
/begin MEASUREMENT lv_cyl_bal_lam_ad_fac[0] "Flag for cylinder balancing lambda adaptation (multiple) exhaust bank specific" UBYTE _CNV_S_2_RANGE__0___1_CM 1 100. 0. 1. DISPLAY_IDENTIFIER LV_CYL_BAL_LAM_AD_FAC[1] ECU_ADDRESS 0xd0008ce8 BIT_MASK 0x1 /end MEASUREMENT
/begin MEASUREMENT lv_cyl_bal_lam_ad_fac[1] "Flag for cylinder balancing lambda adaptation (multiple) exhaust bank specific" UBYTE _CNV_S_2_RANGE__0___1_CM 1 100. 0. 1. DISPLAY_IDENTIFIER LV_CYL_BAL_LAM_AD_FAC[2] ECU_ADDRESS 0xd0008ce9 BIT_MASK 0x1 /end MEASUREMENT
/begin MEASUREMENT lv_cyl_bal_lam_ad_add[0] "flag for cylinder balancing lambda adaptation (additive) exhaust bank specific" UBYTE _CNV_S_2_RANGE__0___1_CM 1 100. 0. 1. DISPLAY_IDENTIFIER LV_CYL_BAL_LAM_AD_ADD[1] ECU_ADDRESS 0xd0008cea BIT_MASK 0x1 /end MEASUREMENT
/begin MEASUREMENT lv_cyl_bal_lam_ad_add[1] "flag for cylinder balancing lambda adaptation (additive) exhaust bank specific" UBYTE _CNV_S_2_RANGE__0___1_CM 1 100. 0. 1. DISPLAY_IDENTIFIER LV_CYL_BAL_LAM_AD_ADD[2] ECU_ADDRESS 0xd0008ceb BIT_MASK 0x1 /end MEASUREMENT
/begin MEASUREMENT lv_cyl_bal_ad_wg_open_req_eol[0] "Flag for waste gate open requested for cylinder balancing adaptation at end of line" UBYTE _CNV_S_2_RANGE__0___1_CM 1 100. 0. 1. DISPLAY_IDENTIFIER LV_CYL_BAL_AD_WG_OPEN_REQ_EOL[1] ECU_ADDRESS 0xd0008cec BIT_MASK 0x1 /end MEASUREMENT
/begin MEASUREMENT lv_cyl_bal_ad_wg_open_req_eol[1] "Flag for waste gate open requested for cylinder balancing adaptation at end of line" UBYTE _CNV_S_2_RANGE__0___1_CM 1 100. 0. 1. DISPLAY_IDENTIFIER LV_CYL_BAL_AD_WG_OPEN_REQ_EOL[2] ECU_ADDRESS 0xd0008ced BIT_MASK 0x1 /end MEASUREMENT
/begin AXIS_PTS ldp_n_32_ip_er_stnd_mmv_dif_dyw "" 0xa08089e6 n_32 _REC_AXS_20_u1 8160. _CNV_A_R_LINEAR_____10_CM 6 0. 8160. FORMAT "%4.0" /end AXIS_PTS
/begin AXIS_PTS ldp_tco_st_ip_t_ast_max_wg_open "" 0xa0808e08 tco_st _REC_AXS_20_u1 190.5 _CNV_A_R_LINEAR_____17_CM 4 -48. 142.5 FORMAT "%6.2" /end AXIS_PTS
/begin CHARACTERISTIC c_t_min_cyl_bal_lam_sel_ad_hot "Minimum time for cylinder balancing cylinder selective lambda adaptation (hot) within limits at end of line" VALUE 0xa080c21a _REC_VAL_20_u2 6553.5 _CNV_A_R_LINEAR_____4_CM 0. 6553.5 DISPLAY_IDENTIFIER C_T_MIN_CYL_BAL_LAM_SEL_AD_HOT FORMAT "%6.1" /end CHARACTERISTIC
/begin CHARACTERISTIC c_tco_max_cyl_bal_wg_open "Maximum coolant temperature for cylinder balancing waste gate open request at end of line" VALUE 0xa080c2c8 _REC_VAL_20_u1 190.5 _CNV_A_R_LINEAR_____17_CM -48. 142.5 DISPLAY_IDENTIFIER C_TCO_MAX_CYL_BAL_WG_OPEN FORMAT "%6.2" /end CHARACTERISTIC
/begin MEASUREMENT state_cyl_bal_er_ad_eol "State of cylinder balancing engine roughness adaptation at end of line" UBYTE _CNV_S_3_RANGE_STAT_141_CM 1 100. 0. 2. DISPLAY_IDENTIFIER STATE_CYL_BAL_ER_AD_EOL ECU_ADDRESS 0xd00007b4 /end MEASUREMENT
/begin MEASUREMENT state_cyl_bal_lam_sel_ad_eol "State of cylinder balancing lambda adaptation at end of line" UBYTE _CNV_S_3_RANGE_STAT_141_CM 1 100. 0. 2. DISPLAY_IDENTIFIER STATE_CYL_BAL_LAM_SEL_AD_EOL ECU_ADDRESS 0xd00007b6 /end MEASUREMENT
/begin MEASUREMENT state_cyl_bal_lam_ad_eol "State of cylinder balancing cylinder selective lamda adaptation at end of line" UBYTE _CNV_S_3_RANGE_STAT_141_CM 1 100. 0. 2. DISPLAY_IDENTIFIER STATE_CYL_BAL_LAM_AD_EOL ECU_ADDRESS 0xd00007b5 /end MEASUREMENT
/begin CHARACTERISTIC c_cyl_bal_ad_eol_rst "reset of cylinder balancing adaptation readiness flags at end of line" VALUE 0xa080bc2c _REC_VAL_20_u1 7. _CNV_S_8_RANGE_C_CY_142_CM 0. 7. DISPLAY_IDENTIFIER C_CYL_BAL_AD_EOL_RST /end CHARACTERISTIC
/begin CHARACTERISTIC ip_er_stnd_mmv_dif_bal_dyw "Dynamic window threshold for cylinder balancing engine roughness adaptation within limits at end of line" CURVE 0xa080a250 _REC_CUR_20_u2_u1 651.5500579833979 _CNV_A_R_LINEAR_____143_CM -325.78 325.770057983398 DISPLAY_IDENTIFIER IP_ER_STND_MMV_DIF_BAL_DYW FORMAT "%8.3"
 /begin AXIS_DESCR COM_AXIS n_32 _CNV_A_R_LINEAR_____10_CM 6 0. 8160. FORMAT "%4.0" AXIS_PTS_REF ldp_n_32_ip_er_stnd_mmv_dif_dyw /end AXIS_DESCR
/end CHARACTERISTIC
/begin CHARACTERISTIC ip_t_ast_max_cyl_bal_wg_open "Maximum time after start for cylinder balancing waste gate open request at end of line" CURVE 0xa080b3e8 _REC_CUR_20_u2_u1 6553.5 _CNV_A_R_LINEAR_____4_CM 0. 6553.5 DISPLAY_IDENTIFIER IP_T_AST_MAX_CYL_BAL_WG_OPEN FORMAT "%6.1"
 /begin AXIS_DESCR COM_AXIS tco_st _CNV_A_R_LINEAR_____17_CM 4 -48. 142.5 FORMAT "%6.2" AXIS_PTS_REF ldp_tco_st_ip_t_ast_max_wg_open /end AXIS_DESCR
/end CHARACTERISTIC
/begin MEASUREMENT lv_cyl_bal_lam_sel_ad_rng_h[0] "Flag for cylinder balancing cylinder selective lambda adaptation (high range) exhaust bank specific" UBYTE _CNV_S_2_RANGE__0___1_CM 1 100. 0. 1. DISPLAY_IDENTIFIER LV_CYL_BAL_LAM_SEL_AD_RNG_H[0] ECU_ADDRESS 0xd0008ce6 BIT_MASK 0x1 /end MEASUREMENT
/begin MEASUREMENT lv_cyl_bal_lam_sel_ad_rng_h[1] "Flag for cylinder balancing cylinder selective lambda adaptation (high range) exhaust bank specific" UBYTE _CNV_S_2_RANGE__0___1_CM 1 100. 0. 1. DISPLAY_IDENTIFIER LV_CYL_BAL_LAM_SEL_AD_RNG_H[1] ECU_ADDRESS 0xd0008ce7 BIT_MASK 0x1 /end MEASUREMENT
/begin MEASUREMENT lv_cyl_bal_lam_sel_ad_rng_l[0] "Flag for cylinder balancing cylinder selective lambda adaptation (low range) exhaust bank specific" UBYTE _CNV_S_2_RANGE__0___1_CM 1 100. 0. 1. DISPLAY_IDENTIFIER LV_CYL_BAL_LAM_SEL_AD_RNG_L[0] ECU_ADDRESS 0xd0008ce4 BIT_MASK 0x1 /end MEASUREMENT
/begin MEASUREMENT lv_cyl_bal_lam_sel_ad_rng_l[1] "Flag for cylinder balancing cylinder selective lambda adaptation (low range) exhaust bank specific" UBYTE _CNV_S_2_RANGE__0___1_CM 1 100. 0. 1. DISPLAY_IDENTIFIER LV_CYL_BAL_LAM_SEL_AD_RNG_L[1] ECU_ADDRESS 0xd0008ce5 BIT_MASK 0x1 /end MEASUREMENT
/begin CHARACTERISTIC c_t_max_cyl_bal_lam_sel_ad_cold "Maximum time for cylinder balancing cylinder selective lambda adaptation (cold) at end of line" VALUE 0xa080c1e4 _REC_VAL_20_u2 6553.5 _CNV_A_R_LINEAR_____4_CM 0. 6553.5 DISPLAY_IDENTIFIER C_T_MAX_CYL_BAL_LAM_SEL_AD_COLD FORMAT "%6.1" /end CHARACTERISTIC
/begin CHARACTERISTIC c_t_max_cyl_bal_lam_sel_ad_hot "Maximum time for cylinder balancing cylinder selective lambda adaptation (hot) at end of line" VALUE 0xa080c1e6 _REC_VAL_20_u2 6553.5 _CNV_A_R_LINEAR_____4_CM 0. 6553.5 DISPLAY_IDENTIFIER C_T_MAX_CYL_BAL_LAM_SEL_AD_HOT FORMAT "%6.1" /end CHARACTERISTIC
/begin CHARACTERISTIC c_fac_cyl_lam_absv_sum_cyl_bal "Threshold for cylinder balancing cylinder selective lambda adaptation within limits at end of line" VALUE 0xa080bcc0 _REC_VAL_20_u2 49.99847412 _CNV_A_R_LINEAR_____125_CM 0. 49.99847412 DISPLAY_IDENTIFIER C_FAC_CYL_LAM_ABSV_SUM_CYL_BAL /end CHARACTERISTIC
/begin CHARACTERISTIC c_cyl_bal_lam_ad_eol_conf "Configuration of lambda adaptation correction values for cylinder balancing at end of line" VALUE 0xa080bc2e _REC_VAL_20_u1 3. _CNV_S_4_RANGE_C_CY_144_CM 0. 3. DISPLAY_IDENTIFIER C_CYL_BAL_LAM_AD_EOL_CONF /end CHARACTERISTIC
/begin CHARACTERISTIC c_cyl_bal_lam_sel_hot_eol_conf "Configuration of cylinder selectiv lambda adaptation correction values (hot) for cylinder balancing at end of line" VALUE 0xa080bc30 _REC_VAL_20_u1 3. _CNV_S_4_RANGE_C_CY_145_CM 0. 3. DISPLAY_IDENTIFIER C_CYL_BAL_LAM_SEL_HOT_EOL_CONF /end CHARACTERISTIC
/begin CHARACTERISTIC lc_cyl_bal_cord_eol_stop_man "Logical constant for manual stop (=1) of cylinder balancing coordination at end of line" VALUE 0xa080c548 _REC_VAL_20_u1 1. _CNV_A_R_LINEAR_____0_CM 0. 1. DISPLAY_IDENTIFIER LC_CYL_BAL_CORD_EOL_STOP_MAN FORMAT "%1.0" /end CHARACTERISTIC
/begin CHARACTERISTIC c_delta_crk_out_min "Lower limit of the adapted phase displacement" VALUE 0xa080bc3d _REC_VAL_20_s1 1440. _CNV_A_R_LINEAR_____112_CM -720. 720. DISPLAY_IDENTIFIER C_DELTA_CRK_OUT_MIN FORMAT "%4.0" /end CHARACTERISTIC
/begin CHARACTERISTIC c_delta_lamb_cyl_sel_cq_ad_thd "Adaptation-release threshold" VALUE 0xa080bc3e _REC_VAL_20_u2 0.9999847412109381 _CNV_A_R_LINEAR_____89_CM 0. 0.9999847412109381 DISPLAY_IDENTIFIER C_DELTA_LAMB_CYL_SEL_CQ_AD_THD FORMAT "%7.5" /end CHARACTERISTIC
/begin MEASUREMENT cyl_lam_psa_1.fac_cyl_lam_absv_sum_grd "Gradient of the CILC outputs absolute sum" SWORD _CNV_A_R_LINEAR_____113_CM 1 100. -50. 49.9984741210938 DISPLAY_IDENTIFIER FAC_CYL_LAM_ABSV_SUM_GRD[1] ECU_ADDRESS 0xd000a53c FORMAT "%7.3" /end MEASUREMENT
/begin MEASUREMENT cyl_lam_psa_1.fac_cyl_lam_absv_sum_pre "Sum of the absolute cylinder individual controller outputs - previous sample" UWORD _CNV_A_R_LINEAR_____125_CM 1 100. 0. 49.99847412 DISPLAY_IDENTIFIER FAC_CYL_LAM_ABSV_SUM_PRE[1] ECU_ADDRESS 0xd000a53e /end MEASUREMENT
/begin MEASUREMENT cyl_lam_psa_1.ctr_cq_mon_pha_shift_ad "Period of CQ monitoring" UWORD _CNV_A_R_LINEAR_____0_CM 1 100. 0. 65535. DISPLAY_IDENTIFIER CTR_CQ_MON_PHA_SHIFT_AD[1] ECU_ADDRESS 0xd000a546 FORMAT "%5.0" /end MEASUREMENT
/begin MEASUREMENT cyl_lam_psa_1.ctr_er_mon_pha_shift_ad "Period of engine roughness monitoring" UWORD _CNV_A_R_LINEAR_____0_CM 1 100. 0. 65535. DISPLAY_IDENTIFIER CTR_ER_MON_PHA_SHIFT_AD[1] ECU_ADDRESS 0xd000a548 FORMAT "%5.0" /end MEASUREMENT
/begin MEASUREMENT cyl_lam_psa_1.ctr_cq_max_osc "Duration of exceeded CQ limit" UWORD _CNV_A_R_LINEAR_____0_CM 1 100. 0. 65535. DISPLAY_IDENTIFIER CTR_CQ_MAX_OSC[1] ECU_ADDRESS 0xd000a54a FORMAT "%5.0" /end MEASUREMENT
/begin MEASUREMENT cyl_lam_psa_1.ctr_resp_lam_cyl_sel "Response time for adaptation result" UWORD _CNV_A_R_LINEAR_____0_CM 1 100. 0. 65535. DISPLAY_IDENTIFIER CTR_RESP_LAM_CYL_SEL[1] ECU_ADDRESS 0xd000a54c FORMAT "%5.0" /end MEASUREMENT
/begin MEASUREMENT cyl_lam_psa_1.delta_crk_cyl_lam "value of adapted phase displacement" SBYTE _CNV_A_R_LINEAR_____112_CM 1 100. -720. 720. DISPLAY_IDENTIFIER DELTA_CRK_CYL_LAM[1] ECU_ADDRESS 0xd000a54e FORMAT "%4.0" /end MEASUREMENT
/begin MEASUREMENT cyl_lam_psa_1.crk_cyl_lam_int "output of the integral-action" SBYTE _CNV_A_R_LINEAR_____112_CM 1 100. -720. 720. DISPLAY_IDENTIFIER CRK_CYL_LAM_INT[1] ECU_ADDRESS 0xd000a54f FORMAT "%4.0" /end MEASUREMENT
/begin MEASUREMENT cyl_lam_psa_1.crk_cyl_lam_delta_ini "Initial CRK - adaptation value" SBYTE _CNV_A_R_LINEAR_____112_CM 1 100. -720. 720. DISPLAY_IDENTIFIER CRK_CYL_LAM_DELTA_INI[1] ECU_ADDRESS 0xd000a550 FORMAT "%4.0" /end MEASUREMENT
/begin MEASUREMENT cyl_lam_psa_1.crk_chg_fac_pha_shift_ad "recursive change factor" UBYTE _CNV_A_R_LINEAR_____0_CM 1 100. 1. 120. DISPLAY_IDENTIFIER CRK_CHG_FAC_PHA_SHIFT_AD[1] ECU_ADDRESS 0xd000a552 FORMAT "%3.0" /end MEASUREMENT
/begin MEASUREMENT cyl_lam_psa_1.state_delta_crk_cyl_lam "Adaptation state" UBYTE _CNV_S_7_RANGE_STAT_538_CM 1 100. 0. 6. DISPLAY_IDENTIFIER STATE_DELTA_CRK_CYL_LAM[1] ECU_ADDRESS 0xd000a553 /end MEASUREMENT
/begin MEASUREMENT cyl_lam_psa_1.ctr_resp_cyc_lam_cyl_sel "Counter for evaluation of cylinder individual lambda control response" UBYTE _CNV_A_R_LINEAR_____0_CM 1 100. 0. 255. DISPLAY_IDENTIFIER CTR_RESP_CYC_LAM_CYL_SEL[1] ECU_ADDRESS 0xd000a554 FORMAT "%3.0" /end MEASUREMENT
/begin MEASUREMENT cyl_lam_psa_1.ctr_fac_cyl_lam_cor_dif_absv "Counter for improved cycles of cylinder individual lambda control response - FAC_CYL_LAM_COR based" UBYTE _CNV_A_R_LINEAR_____0_CM 1 100. 0. 255. DISPLAY_IDENTIFIER CTR_FAC_CYL_LAM_COR_DIF_ABSV[1] ECU_ADDRESS 0xd000a555 FORMAT "%3.0" /end MEASUREMENT
/begin MEASUREMENT cyl_lam_psa_1.ctr_cq_fil_fall "Counter for improved cycles of cylinder individual lambda control response - CQ based" UBYTE _CNV_A_R_LINEAR_____0_CM 1 100. 0. 255. DISPLAY_IDENTIFIER CTR_CQ_FIL_FALL[1] ECU_ADDRESS 0xd000a556 FORMAT "%3.0" /end MEASUREMENT
/begin MEASUREMENT cyl_lam_psa_1.lv_delta_crk_cyl_lam_err "error flag" UBYTE _CNV_S_2_RANGE__0___1_CM 1 100. 0. 1. DISPLAY_IDENTIFIER LV_DELTA_CRK_CYL_LAM_ERR[1] ECU_ADDRESS 0xd000a557 BIT_MASK 0x1 /end MEASUREMENT
/begin MEASUREMENT cyl_lam_psa_1.lv_fac_cyl_lam_cor_osc "Oscillation detected" UBYTE _CNV_S_2_RANGE__0___1_CM 1 100. 0. 1. DISPLAY_IDENTIFIER LV_FAC_CYL_LAM_COR_OSC[1] ECU_ADDRESS 0xd000a558 BIT_MASK 0x1 /end MEASUREMENT
/begin MEASUREMENT cyl_lam_psa_1.lv_fac_cyl_lam_cor_lim_osc "Alternating limitation detected" UBYTE _CNV_S_2_RANGE__0___1_CM 1 100. 0. 1. DISPLAY_IDENTIFIER LV_FAC_CYL_LAM_COR_LIM_OSC[1] ECU_ADDRESS 0xd000a559 BIT_MASK 0x1 /end MEASUREMENT
/begin MEASUREMENT cyl_lam_psa_1.lv_er_absv_sum_grd_rise "Unstable engine roughness detectedd" UBYTE _CNV_S_2_RANGE__0___1_CM 1 100. 0. 1. DISPLAY_IDENTIFIER LV_ER_ABSV_SUM_GRD_RISE[1] ECU_ADDRESS 0xd000a55a BIT_MASK 0x1 /end MEASUREMENT
/begin MEASUREMENT cyl_lam_psa_1.lv_state_delta_crk_wait "Waiting for adaptation response" UBYTE _CNV_S_2_RANGE__0___1_CM 1 100. 0. 1. DISPLAY_IDENTIFIER LV_STATE_DELTA_CRK_WAIT[1] ECU_ADDRESS 0xd000a55b BIT_MASK 0x1 /end MEASUREMENT
/begin MEASUREMENT cyl_lam_psa_1.er_stnd_mmv_dif_bal_absv_sum "Sum of the absolute difference of filtered normalized and average engine roughness value" UWORD _CNV_A_R_CYBL_LINEA_539_CM 1 100. 0. 325.770057983398 DISPLAY_IDENTIFIER ER_STND_MMV_DIF_BAL_ABSV_SUM[1] ECU_ADDRESS 0xd000a540 FORMAT "%8.3" /end MEASUREMENT
/begin MEASUREMENT cyl_lam_psa_1.er_stnd_mmv_dif_absv_sum_pre "Sum of the absolute difference of filtered normalized and average engine roughness value - previous sample" UWORD _CNV_A_R_CYBL_LINEA_539_CM 1 100. 0. 325.770057983398 DISPLAY_IDENTIFIER ER_STND_MMV_DIF_ABSV_SUM_PRE[1] ECU_ADDRESS 0xd000a542 FORMAT "%8.3" /end MEASUREMENT
/begin MEASUREMENT cyl_lam_psa_1.er_stnd_mmv_dif_absv_sum_grd "Gradient of the absolute difference of filtered normalized and average engine roughness value" SWORD _CNV_A_R_LINEAR_____140_CM 1 100. -325.78 325.770057983398 DISPLAY_IDENTIFIER ER_STND_MMV_DIF_ABSV_SUM_GRD[1] ECU_ADDRESS 0xd000a544 FORMAT "%8.3" /end MEASUREMENT
/begin MEASUREMENT cyl_lam_psa_2.fac_cyl_lam_absv_sum_grd "Gradient of the CILC outputs absolute sum" SWORD _CNV_A_R_LINEAR_____113_CM 1 100. -50. 49.9984741210938 DISPLAY_IDENTIFIER FAC_CYL_LAM_ABSV_SUM_GRD[2] ECU_ADDRESS 0xd000a55c FORMAT "%7.3" /end MEASUREMENT
/begin MEASUREMENT cyl_lam_psa_2.fac_cyl_lam_absv_sum_pre "Sum of the absolute cylinder individual controller outputs - previous sample" UWORD _CNV_A_R_LINEAR_____125_CM 1 100. 0. 49.99847412 DISPLAY_IDENTIFIER FAC_CYL_LAM_ABSV_SUM_PRE[2] ECU_ADDRESS 0xd000a55e /end MEASUREMENT
/begin MEASUREMENT cyl_lam_psa_2.ctr_cq_mon_pha_shift_ad "Period of CQ monitoring" UWORD _CNV_A_R_LINEAR_____0_CM 1 100. 0. 65535. DISPLAY_IDENTIFIER CTR_CQ_MON_PHA_SHIFT_AD[2] ECU_ADDRESS 0xd000a566 FORMAT "%5.0" /end MEASUREMENT
/begin MEASUREMENT cyl_lam_psa_2.ctr_er_mon_pha_shift_ad "Period of engine roughness monitoring" UWORD _CNV_A_R_LINEAR_____0_CM 1 100. 0. 65535. DISPLAY_IDENTIFIER CTR_ER_MON_PHA_SHIFT_AD[2] ECU_ADDRESS 0xd000a568 FORMAT "%5.0" /end MEASUREMENT
/begin MEASUREMENT cyl_lam_psa_2.ctr_cq_max_osc "Duration of exceeded CQ limit" UWORD _CNV_A_R_LINEAR_____0_CM 1 100. 0. 65535. DISPLAY_IDENTIFIER CTR_CQ_MAX_OSC[2] ECU_ADDRESS 0xd000a56a FORMAT "%5.0" /end MEASUREMENT
/begin MEASUREMENT cyl_lam_psa_2.ctr_resp_lam_cyl_sel "Response time for adaptation result" UWORD _CNV_A_R_LINEAR_____0_CM 1 100. 0. 65535. DISPLAY_IDENTIFIER CTR_RESP_LAM_CYL_SEL[2] ECU_ADDRESS 0xd000a56c FORMAT "%5.0" /end MEASUREMENT
/begin MEASUREMENT cyl_lam_psa_2.delta_crk_cyl_lam "value of adapted phase displacement" SBYTE _CNV_A_R_LINEAR_____112_CM 1 100. -720. 720. DISPLAY_IDENTIFIER DELTA_CRK_CYL_LAM[2] ECU_ADDRESS 0xd000a56e FORMAT "%4.0" /end MEASUREMENT
/begin MEASUREMENT cyl_lam_psa_2.crk_cyl_lam_int "output of the integral-action" SBYTE _CNV_A_R_LINEAR_____112_CM 1 100. -720. 720. DISPLAY_IDENTIFIER CRK_CYL_LAM_INT[2] ECU_ADDRESS 0xd000a56f FORMAT "%4.0" /end MEASUREMENT
/begin MEASUREMENT cyl_lam_psa_2.crk_cyl_lam_delta_ini "Initial CRK - adaptation value" SBYTE _CNV_A_R_LINEAR_____112_CM 1 100. -720. 720. DISPLAY_IDENTIFIER CRK_CYL_LAM_DELTA_INI[2] ECU_ADDRESS 0xd000a570 FORMAT "%4.0" /end MEASUREMENT
/begin MEASUREMENT cyl_lam_psa_2.crk_chg_fac_pha_shift_ad "recursive change factor" UBYTE _CNV_A_R_LINEAR_____0_CM 1 100. 1. 120. DISPLAY_IDENTIFIER CRK_CHG_FAC_PHA_SHIFT_AD[2] ECU_ADDRESS 0xd000a572 FORMAT "%3.0" /end MEASUREMENT
/begin MEASUREMENT cyl_lam_psa_2.state_delta_crk_cyl_lam "Adaptation state" UBYTE _CNV_S_7_RANGE_STAT_538_CM 1 100. 0. 6. DISPLAY_IDENTIFIER STATE_DELTA_CRK_CYL_LAM[2] ECU_ADDRESS 0xd000a573 /end MEASUREMENT
/begin MEASUREMENT cyl_lam_psa_2.ctr_resp_cyc_lam_cyl_sel "Counter for evaluation of cylinder individual lambda control response" UBYTE _CNV_A_R_LINEAR_____0_CM 1 100. 0. 255. DISPLAY_IDENTIFIER CTR_RESP_CYC_LAM_CYL_SEL[2] ECU_ADDRESS 0xd000a574 FORMAT "%3.0" /end MEASUREMENT
/begin MEASUREMENT cyl_lam_psa_2.ctr_fac_cyl_lam_cor_dif_absv "Counter for improved cycles of cylinder individual lambda control response - FAC_CYL_LAM_COR based" UBYTE _CNV_A_R_LINEAR_____0_CM 1 100. 0. 255. DISPLAY_IDENTIFIER CTR_FAC_CYL_LAM_COR_DIF_ABSV[2] ECU_ADDRESS 0xd000a575 FORMAT "%3.0" /end MEASUREMENT
/begin MEASUREMENT cyl_lam_psa_2.ctr_cq_fil_fall "Counter for improved cycles of cylinder individual lambda control response - CQ based" UBYTE _CNV_A_R_LINEAR_____0_CM 1 100. 0. 255. DISPLAY_IDENTIFIER CTR_CQ_FIL_FALL[2] ECU_ADDRESS 0xd000a576 FORMAT "%3.0" /end MEASUREMENT
/begin MEASUREMENT cyl_lam_psa_2.lv_delta_crk_cyl_lam_err "error flag" UBYTE _CNV_S_2_RANGE__0___1_CM 1 100. 0. 1. DISPLAY_IDENTIFIER LV_DELTA_CRK_CYL_LAM_ERR[2] ECU_ADDRESS 0xd000a577 BIT_MASK 0x1 /end MEASUREMENT
/begin MEASUREMENT cyl_lam_psa_2.lv_fac_cyl_lam_cor_osc "Oscillation detected" UBYTE _CNV_S_2_RANGE__0___1_CM 1 100. 0. 1. DISPLAY_IDENTIFIER LV_FAC_CYL_LAM_COR_OSC[2] ECU_ADDRESS 0xd000a578 BIT_MASK 0x1 /end MEASUREMENT
/begin MEASUREMENT cyl_lam_psa_2.lv_fac_cyl_lam_cor_lim_osc "Alternating limitation detected" UBYTE _CNV_S_2_RANGE__0___1_CM 1 100. 0. 1. DISPLAY_IDENTIFIER LV_FAC_CYL_LAM_COR_LIM_OSC[2] ECU_ADDRESS 0xd000a579 BIT_MASK 0x1 /end MEASUREMENT
/begin MEASUREMENT cyl_lam_psa_2.lv_er_absv_sum_grd_rise "Unstable engine roughness detectedd" UBYTE _CNV_S_2_RANGE__0___1_CM 1 100. 0. 1. DISPLAY_IDENTIFIER LV_ER_ABSV_SUM_GRD_RISE[2] ECU_ADDRESS 0xd000a57a BIT_MASK 0x1 /end MEASUREMENT
/begin MEASUREMENT cyl_lam_psa_2.lv_state_delta_crk_wait "Waiting for adaptation response" UBYTE _CNV_S_2_RANGE__0___1_CM 1 100. 0. 1. DISPLAY_IDENTIFIER LV_STATE_DELTA_CRK_WAIT[2] ECU_ADDRESS 0xd000a57b BIT_MASK 0x1 /end MEASUREMENT
/begin MEASUREMENT cyl_lam_psa_2.er_stnd_mmv_dif_bal_absv_sum "Sum of the absolute difference of filtered normalized and average engine roughness value" UWORD _CNV_A_R_CYBL_LINEA_539_CM 1 100. 0. 325.770057983398 DISPLAY_IDENTIFIER ER_STND_MMV_DIF_BAL_ABSV_SUM[2] ECU_ADDRESS 0xd000a560 FORMAT "%8.3" /end MEASUREMENT
/begin MEASUREMENT cyl_lam_psa_2.er_stnd_mmv_dif_absv_sum_pre "Sum of the absolute difference of filtered normalized and average engine roughness value - previous sample" UWORD _CNV_A_R_CYBL_LINEA_539_CM 1 100. 0. 325.770057983398 DISPLAY_IDENTIFIER ER_STND_MMV_DIF_ABSV_SUM_PRE[2] ECU_ADDRESS 0xd000a562 FORMAT "%8.3" /end MEASUREMENT
/begin MEASUREMENT cyl_lam_psa_2.er_stnd_mmv_dif_absv_sum_grd "Gradient of the absolute difference of filtered normalized and average engine roughness value" SWORD _CNV_A_R_LINEAR_____140_CM 1 100. -325.78 325.770057983398 DISPLAY_IDENTIFIER ER_STND_MMV_DIF_ABSV_SUM_GRD[2] ECU_ADDRESS 0xd000a564 FORMAT "%8.3" /end MEASUREMENT
/begin CHARACTERISTIC c_crk_cyl_lam_delta_ini "CRK - initial constant" VALUE 0xa080bac1 _REC_VAL_20_s1 1440. _CNV_A_R_LINEAR_____112_CM -720. 720. DISPLAY_IDENTIFIER C_CRK_CYL_LAM_DELTA_INI FORMAT "%4.0" /end CHARACTERISTIC
/begin CHARACTERISTIC c_ctr_cq_mon_pha_shift_ad_max "Maximum time of oscillation monitoring - CQ - based" VALUE 0xa080bb28 _REC_VAL_20_u2 65535. _CNV_A_R_LINEAR_____0_CM 0. 65535. DISPLAY_IDENTIFIER C_CTR_CQ_MON_PHA_SHIFT_AD_MAX FORMAT "%5.0" /end CHARACTERISTIC
/begin CHARACTERISTIC c_ctr_er_mon_pha_shift_ad_max "Maximum time for engine roughness monitoring" VALUE 0xa080bb8a _REC_VAL_20_u2 65535. _CNV_A_R_LINEAR_____0_CM 0. 65535. DISPLAY_IDENTIFIER C_CTR_ER_MON_PHA_SHIFT_AD_MAX FORMAT "%5.0" /end CHARACTERISTIC
/begin CHARACTERISTIC c_ctr_resp_min_lam_cyl_sel "Minimum response time for adaptation result" VALUE 0xa080bbbe _REC_VAL_20_u2 65535. _CNV_A_R_LINEAR_____0_CM 0. 65535. DISPLAY_IDENTIFIER C_CTR_RESP_MIN_LAM_CYL_SEL FORMAT "%5.0" /end CHARACTERISTIC
/begin CHARACTERISTIC c_ctr_er_resp_min_lam_cyl_sel "Minimum response time of engine roughness for evaluation of adaptation result" VALUE 0xa080bb8c _REC_VAL_20_u2 65535. _CNV_A_R_LINEAR_____0_CM 0. 65535. DISPLAY_IDENTIFIER C_CTR_ER_RESP_MIN_LAM_CYL_SEL FORMAT "%5.0" /end CHARACTERISTIC
/begin CHARACTERISTIC lc_crk_cyl_lam_delta_out "adaptation switch" VALUE 0xa080c53f _REC_VAL_20_u1 1. _CNV_A_R_LINEAR_____0_CM 0. 1. DISPLAY_IDENTIFIER LC_CRK_CYL_LAM_DELTA_OUT FORMAT "%1.0" /end CHARACTERISTIC
/begin CHARACTERISTIC lc_crk_delta_cq_swi "Adaptation via characteristic quantity" VALUE 0xa080c540 _REC_VAL_20_u1 1. _CNV_A_R_LINEAR_____0_CM 0. 1. DISPLAY_IDENTIFIER LC_CRK_DELTA_CQ_SWI FORMAT "%1.0" /end CHARACTERISTIC
/begin CHARACTERISTIC c_ctr_cq_min_pha_shift_ad "Minimum time of exceeded CQ limit to request the adaptation" VALUE 0xa080bb26 _REC_VAL_20_u2 65535. _CNV_A_R_LINEAR_____0_CM 0. 65535. DISPLAY_IDENTIFIER C_CTR_CQ_MIN_PHA_SHIFT_AD FORMAT "%5.0" /end CHARACTERISTIC
/begin CHARACTERISTIC c_crk_chg_fac_max "Upper limit of the CRK change factor" VALUE 0xa080bab7 _REC_VAL_20_u1 119. _CNV_A_R_LINEAR_____0_CM 1. 120. DISPLAY_IDENTIFIER C_CRK_CHG_FAC_MAX FORMAT "%3.0" /end CHARACTERISTIC
/begin CHARACTERISTIC c_delta_crk_out_max "Upper limit of the adapted phase displacement" VALUE 0xa080bc3c _REC_VAL_20_s1 1440. _CNV_A_R_LINEAR_____112_CM -720. 720. DISPLAY_IDENTIFIER C_DELTA_CRK_OUT_MAX FORMAT "%4.0" /end CHARACTERISTIC
/begin CHARACTERISTIC c_crk_chg_step "CRK change step" VALUE 0xa080bab8 _REC_VAL_20_s1 1440. _CNV_A_R_LINEAR_____112_CM -720. 720. DISPLAY_IDENTIFIER C_CRK_CHG_STEP FORMAT "%4.0" /end CHARACTERISTIC
/begin CHARACTERISTIC c_ctr_resp_cyc_min_lam_cyl_sel "Minimum number of response cycles to evaluate the adaptation result" VALUE 0xa080bbbd _REC_VAL_20_u1 255. _CNV_A_R_LINEAR_____0_CM 0. 255. DISPLAY_IDENTIFIER C_CTR_RESP_CYC_MIN_LAM_CYL_SEL FORMAT "%3.0" /end CHARACTERISTIC
/begin CHARACTERISTIC c_ctr_cq_fil_fall_min "Least number of improvement cycles to extend the waiting time for evaluation of adaptation result - CQ - based" VALUE 0xa080bb24 _REC_VAL_20_u1 255. _CNV_A_R_LINEAR_____0_CM 0. 255. DISPLAY_IDENTIFIER C_CTR_CQ_FIL_FALL_MIN FORMAT "%3.0" /end CHARACTERISTIC
/begin CHARACTERISTIC c_ctr_cq_fil_fall_ok "Minimum number of improved cycles to accept the adaptation value - CQ - based" VALUE 0xa080bb25 _REC_VAL_20_u1 255. _CNV_A_R_LINEAR_____0_CM 0. 255. DISPLAY_IDENTIFIER C_CTR_CQ_FIL_FALL_OK FORMAT "%3.0" /end CHARACTERISTIC
/begin CHARACTERISTIC c_crk_cyl_lam_ini_red "CRK - initial reduction factor" VALUE 0xa080bac2 _REC_VAL_20_u1 720. _CNV_A_R_LINEAR_____112_CM 0. 720. DISPLAY_IDENTIFIER C_CRK_CYL_LAM_INI_RED FORMAT "%3.0" /end CHARACTERISTIC
/begin CHARACTERISTIC c_nr_seg_ref_cbk_ex_2 "Segment number for identification of the first fired cylinder of exhaust bank 2" VALUE 0xa080c031 _REC_VAL_20_u1 7. _CNV_A_R_LINEAR_____0_CM 0. 7. DISPLAY_IDENTIFIER C_NR_SEG_REF_CBK_EX_2 FORMAT "%3.0" /end CHARACTERISTIC
/begin MEASUREMENT fac_cyl_lam_cor_save[0] "Value of the saved cylinder individual lambda controller output" SWORD _CNV_A_R_LINEAR_____113_CM 1 100. -50. 49.9984741210938 DISPLAY_IDENTIFIER FAC_CYL_LAM_COR_SAVE[0] ECU_ADDRESS 0xd0000728 FORMAT "%7.3" /end MEASUREMENT
/begin MEASUREMENT fac_cyl_lam_cor_save[1] "Value of the saved cylinder individual lambda controller output" SWORD _CNV_A_R_LINEAR_____113_CM 1 100. -50. 49.9984741210938 DISPLAY_IDENTIFIER FAC_CYL_LAM_COR_SAVE[1] ECU_ADDRESS 0xd000072a FORMAT "%7.3" /end MEASUREMENT
/begin MEASUREMENT fac_cyl_lam_cor_save[2] "Value of the saved cylinder individual lambda controller output" SWORD _CNV_A_R_LINEAR_____113_CM 1 100. -50. 49.9984741210938 DISPLAY_IDENTIFIER FAC_CYL_LAM_COR_SAVE[2] ECU_ADDRESS 0xd000072c FORMAT "%7.3" /end MEASUREMENT
/begin MEASUREMENT fac_cyl_lam_cor_save[3] "Value of the saved cylinder individual lambda controller output" SWORD _CNV_A_R_LINEAR_____113_CM 1 100. -50. 49.9984741210938 DISPLAY_IDENTIFIER FAC_CYL_LAM_COR_SAVE[3] ECU_ADDRESS 0xd000072e FORMAT "%7.3" /end MEASUREMENT
/begin MEASUREMENT fac_cyl_lam_cor_save[4] "Value of the saved cylinder individual lambda controller output" SWORD _CNV_A_R_LINEAR_____113_CM 1 100. -50. 49.9984741210938 DISPLAY_IDENTIFIER FAC_CYL_LAM_COR_SAVE[4] ECU_ADDRESS 0xd0000730 FORMAT "%7.3" /end MEASUREMENT
/begin MEASUREMENT fac_cyl_lam_cor_save[5] "Value of the saved cylinder individual lambda controller output" SWORD _CNV_A_R_LINEAR_____113_CM 1 100. -50. 49.9984741210938 DISPLAY_IDENTIFIER FAC_CYL_LAM_COR_SAVE[5] ECU_ADDRESS 0xd0000732 FORMAT "%7.3" /end MEASUREMENT
/begin MEASUREMENT fac_cyl_lam_cor_save[6] "Value of the saved cylinder individual lambda controller output" SWORD _CNV_A_R_LINEAR_____113_CM 1 100. -50. 49.9984741210938 DISPLAY_IDENTIFIER FAC_CYL_LAM_COR_SAVE[6] ECU_ADDRESS 0xd0000734 FORMAT "%7.3" /end MEASUREMENT
/begin MEASUREMENT fac_cyl_lam_cor_save[7] "Value of the saved cylinder individual lambda controller output" SWORD _CNV_A_R_LINEAR_____113_CM 1 100. -50. 49.9984741210938 DISPLAY_IDENTIFIER FAC_CYL_LAM_COR_SAVE[7] ECU_ADDRESS 0xd0000736 FORMAT "%7.3" /end MEASUREMENT
/begin MEASUREMENT lv_fac_cyl_lam_cor_osc_max_thd[0] "Flag indicating the upper limit of cylinder individual lambda control was reached - oscillation monitoring" UBYTE _CNV_S_2_RANGE__0___1_CM 1 100. 0. 1. DISPLAY_IDENTIFIER LV_FAC_CYL_LAM_COR_OSC_MAX_THD[0] ECU_ADDRESS 0xd0000750 BIT_MASK 0x1 /end MEASUREMENT
/begin MEASUREMENT lv_fac_cyl_lam_cor_osc_max_thd[1] "Flag indicating the upper limit of cylinder individual lambda control was reached - oscillation monitoring" UBYTE _CNV_S_2_RANGE__0___1_CM 1 100. 0. 1. DISPLAY_IDENTIFIER LV_FAC_CYL_LAM_COR_OSC_MAX_THD[1] ECU_ADDRESS 0xd0000751 BIT_MASK 0x1 /end MEASUREMENT
/begin MEASUREMENT lv_fac_cyl_lam_cor_osc_max_thd[2] "Flag indicating the upper limit of cylinder individual lambda control was reached - oscillation monitoring" UBYTE _CNV_S_2_RANGE__0___1_CM 1 100. 0. 1. DISPLAY_IDENTIFIER LV_FAC_CYL_LAM_COR_OSC_MAX_THD[2] ECU_ADDRESS 0xd0000752 BIT_MASK 0x1 /end MEASUREMENT
/begin MEASUREMENT lv_fac_cyl_lam_cor_osc_max_thd[3] "Flag indicating the upper limit of cylinder individual lambda control was reached - oscillation monitoring" UBYTE _CNV_S_2_RANGE__0___1_CM 1 100. 0. 1. DISPLAY_IDENTIFIER LV_FAC_CYL_LAM_COR_OSC_MAX_THD[3] ECU_ADDRESS 0xd0000753 BIT_MASK 0x1 /end MEASUREMENT
/begin MEASUREMENT lv_fac_cyl_lam_cor_osc_max_thd[4] "Flag indicating the upper limit of cylinder individual lambda control was reached - oscillation monitoring" UBYTE _CNV_S_2_RANGE__0___1_CM 1 100. 0. 1. DISPLAY_IDENTIFIER LV_FAC_CYL_LAM_COR_OSC_MAX_THD[4] ECU_ADDRESS 0xd0000754 BIT_MASK 0x1 /end MEASUREMENT
/begin MEASUREMENT lv_fac_cyl_lam_cor_osc_max_thd[5] "Flag indicating the upper limit of cylinder individual lambda control was reached - oscillation monitoring" UBYTE _CNV_S_2_RANGE__0___1_CM 1 100. 0. 1. DISPLAY_IDENTIFIER LV_FAC_CYL_LAM_COR_OSC_MAX_THD[5] ECU_ADDRESS 0xd0000755 BIT_MASK 0x1 /end MEASUREMENT
/begin MEASUREMENT lv_fac_cyl_lam_cor_osc_max_thd[6] "Flag indicating the upper limit of cylinder individual lambda control was reached - oscillation monitoring" UBYTE _CNV_S_2_RANGE__0___1_CM 1 100. 0. 1. DISPLAY_IDENTIFIER LV_FAC_CYL_LAM_COR_OSC_MAX_THD[6] ECU_ADDRESS 0xd0000756 BIT_MASK 0x1 /end MEASUREMENT
/begin MEASUREMENT lv_fac_cyl_lam_cor_osc_max_thd[7] "Flag indicating the upper limit of cylinder individual lambda control was reached - oscillation monitoring" UBYTE _CNV_S_2_RANGE__0___1_CM 1 100. 0. 1. DISPLAY_IDENTIFIER LV_FAC_CYL_LAM_COR_OSC_MAX_THD[7] ECU_ADDRESS 0xd0000757 BIT_MASK 0x1 /end MEASUREMENT
/begin MEASUREMENT lv_fac_cyl_lam_cor_osc_min_thd[0] "Flag indicating the lower limit of cylinder individual lambda control was reached - oscillation monitoring" UBYTE _CNV_S_2_RANGE__0___1_CM 1 100. 0. 1. DISPLAY_IDENTIFIER LV_FAC_CYL_LAM_COR_OSC_MIN_THD[0] ECU_ADDRESS 0xd0000758 BIT_MASK 0x1 /end MEASUREMENT
/begin MEASUREMENT lv_fac_cyl_lam_cor_osc_min_thd[1] "Flag indicating the lower limit of cylinder individual lambda control was reached - oscillation monitoring" UBYTE _CNV_S_2_RANGE__0___1_CM 1 100. 0. 1. DISPLAY_IDENTIFIER LV_FAC_CYL_LAM_COR_OSC_MIN_THD[1] ECU_ADDRESS 0xd0000759 BIT_MASK 0x1 /end MEASUREMENT
/begin MEASUREMENT lv_fac_cyl_lam_cor_osc_min_thd[2] "Flag indicating the lower limit of cylinder individual lambda control was reached - oscillation monitoring" UBYTE _CNV_S_2_RANGE__0___1_CM 1 100. 0. 1. DISPLAY_IDENTIFIER LV_FAC_CYL_LAM_COR_OSC_MIN_THD[2] ECU_ADDRESS 0xd000075a BIT_MASK 0x1 /end MEASUREMENT
/begin MEASUREMENT lv_fac_cyl_lam_cor_osc_min_thd[3] "Flag indicating the lower limit of cylinder individual lambda control was reached - oscillation monitoring" UBYTE _CNV_S_2_RANGE__0___1_CM 1 100. 0. 1. DISPLAY_IDENTIFIER LV_FAC_CYL_LAM_COR_OSC_MIN_THD[3] ECU_ADDRESS 0xd000075b BIT_MASK 0x1 /end MEASUREMENT
/begin MEASUREMENT lv_fac_cyl_lam_cor_osc_min_thd[4] "Flag indicating the lower limit of cylinder individual lambda control was reached - oscillation monitoring" UBYTE _CNV_S_2_RANGE__0___1_CM 1 100. 0. 1. DISPLAY_IDENTIFIER LV_FAC_CYL_LAM_COR_OSC_MIN_THD[4] ECU_ADDRESS 0xd000075c BIT_MASK 0x1 /end MEASUREMENT
/begin MEASUREMENT lv_fac_cyl_lam_cor_osc_min_thd[5] "Flag indicating the lower limit of cylinder individual lambda control was reached - oscillation monitoring" UBYTE _CNV_S_2_RANGE__0___1_CM 1 100. 0. 1. DISPLAY_IDENTIFIER LV_FAC_CYL_LAM_COR_OSC_MIN_THD[5] ECU_ADDRESS 0xd000075d BIT_MASK 0x1 /end MEASUREMENT
/begin MEASUREMENT lv_fac_cyl_lam_cor_osc_min_thd[6] "Flag indicating the lower limit of cylinder individual lambda control was reached - oscillation monitoring" UBYTE _CNV_S_2_RANGE__0___1_CM 1 100. 0. 1. DISPLAY_IDENTIFIER LV_FAC_CYL_LAM_COR_OSC_MIN_THD[6] ECU_ADDRESS 0xd000075e BIT_MASK 0x1 /end MEASUREMENT
/begin MEASUREMENT lv_fac_cyl_lam_cor_osc_min_thd[7] "Flag indicating the lower limit of cylinder individual lambda control was reached - oscillation monitoring" UBYTE _CNV_S_2_RANGE__0___1_CM 1 100. 0. 1. DISPLAY_IDENTIFIER LV_FAC_CYL_LAM_COR_OSC_MIN_THD[7] ECU_ADDRESS 0xd000075f BIT_MASK 0x1 /end MEASUREMENT
/begin CHARACTERISTIC c_ctr_sum_fac_cyl_lam_osc_max "Maximum time of oscillation monitoring - FAC_CYL_LAM_COR - based" VALUE 0xa080bbc8 _REC_VAL_20_u2 65535. _CNV_A_R_LINEAR_____0_CM 0. 65535. DISPLAY_IDENTIFIER C_CTR_SUM_FAC_CYL_LAM_OSC_MAX FORMAT "%5.0" /end CHARACTERISTIC
/begin CHARACTERISTIC c_ctr_fac_cyl_lam_dif_absv_min "Least number of improvement cycles to extend the waiting time for evaluation of adaptation result - FAC_CYL_LAM_COR - based" VALUE 0xa080bb8f _REC_VAL_20_u1 255. _CNV_A_R_LINEAR_____0_CM 0. 255. DISPLAY_IDENTIFIER C_CTR_FAC_CYL_LAM_DIF_ABSV_MIN FORMAT "%3.0" /end CHARACTERISTIC
/begin CHARACTERISTIC c_ctr_fac_cyl_lam_dif_absv_ok "Minimum number of improved cycles to accept the adaptation value - FAC_CYL_LAM_COR - based" VALUE 0xa080bb90 _REC_VAL_20_u1 255. _CNV_A_R_LINEAR_____0_CM 0. 255. DISPLAY_IDENTIFIER C_CTR_FAC_CYL_LAM_DIF_ABSV_OK FORMAT "%3.0" /end CHARACTERISTIC
/begin CHARACTERISTIC c_fac_cyl_lam_dif_absv_max "Maximum of allowed FAC_CYL_LAM_COR oscillation space" VALUE 0xa080bcc2 _REC_VAL_20_s2 99.99847412109381 _CNV_A_R_LINEAR_____113_CM -50. 49.9984741210938 DISPLAY_IDENTIFIER C_FAC_CYL_LAM_DIF_ABSV_MAX FORMAT "%7.3" /end CHARACTERISTIC
/begin CHARACTERISTIC c_er_absv_grd_rise_thd_crk_chg "Maximum limit of engine roughness gradient rise" VALUE 0xa080bc9c _REC_VAL_20_u2 325.770057983398 _CNV_A_R_CYBL_LINEA_539_CM 0. 325.770057983398 DISPLAY_IDENTIFIER C_ER_ABSV_GRD_RISE_THD_CRK_CHG FORMAT "%8.3" /end CHARACTERISTIC
/begin CHARACTERISTIC c_er_absv_grd_fall_thd_crk_chg "Threshold of engine roughness gradient drop for a safe adaption result" VALUE 0xa080bc9a _REC_VAL_20_s2 651.5500579833979 _CNV_A_R_LINEAR_____140_CM -325.78 325.770057983398 DISPLAY_IDENTIFIER C_ER_ABSV_GRD_FALL_THD_CRK_CHG FORMAT "%8.3" /end CHARACTERISTIC
/begin CHARACTERISTIC c_fac_cyl_lam_absv_grd_rise_thd "Maximum limit of CILC gradient rise" VALUE 0xa080bcbc _REC_VAL_20_u2 49.99847412 _CNV_A_R_LINEAR_____125_CM 0. 49.99847412 DISPLAY_IDENTIFIER C_FAC_CYL_LAM_ABSV_GRD_RISE_THD /end CHARACTERISTIC
/begin CHARACTERISTIC c_fac_cyl_lam_absv_grd_fall_thd "Threshold of CILC gradient drop for a safe adaption result" VALUE 0xa080bcba _REC_VAL_20_s2 99.99847412109381 _CNV_A_R_LINEAR_____113_CM -50. 49.9984741210938 DISPLAY_IDENTIFIER C_FAC_CYL_LAM_ABSV_GRD_FALL_THD FORMAT "%7.3" /end CHARACTERISTIC
/begin CHARACTERISTIC c_fac_cyl_lam_max_pha_shift_ad "Upper limit of  FAC_CYL_LAM_COR value to detect the oscillation" VALUE 0xa080bcc4 _REC_VAL_20_s2 99.99847412109381 _CNV_A_R_LINEAR_____113_CM -50. 49.9984741210938 DISPLAY_IDENTIFIER C_FAC_CYL_LAM_MAX_PHA_SHIFT_AD FORMAT "%7.3" /end CHARACTERISTIC
/begin CHARACTERISTIC c_fac_cyl_lam_min_pha_shift_ad "Lower limit of  FAC_CYL_LAM_COR value to detect the oscillation" VALUE 0xa080bcc6 _REC_VAL_20_s2 99.99847412109381 _CNV_A_R_LINEAR_____113_CM -50. 49.9984741210938 DISPLAY_IDENTIFIER C_FAC_CYL_LAM_MIN_PHA_SHIFT_AD FORMAT "%7.3" /end CHARACTERISTIC
/begin MEASUREMENT ctr_sum_fac_cyl_lam_cor_osc[0] "Duration of oscillation monitoring" UWORD _CNV_A_R_LINEAR_____0_CM 1 100. 0. 65535. DISPLAY_IDENTIFIER CTR_SUM_FAC_CYL_LAM_COR_OSC[0] ECU_ADDRESS 0xd0000738 FORMAT "%5.0" /end MEASUREMENT
/begin MEASUREMENT ctr_sum_fac_cyl_lam_cor_osc[1] "Duration of oscillation monitoring" UWORD _CNV_A_R_LINEAR_____0_CM 1 100. 0. 65535. DISPLAY_IDENTIFIER CTR_SUM_FAC_CYL_LAM_COR_OSC[1] ECU_ADDRESS 0xd000073a FORMAT "%5.0" /end MEASUREMENT
/begin MEASUREMENT ctr_sum_fac_cyl_lam_cor_osc[2] "Duration of oscillation monitoring" UWORD _CNV_A_R_LINEAR_____0_CM 1 100. 0. 65535. DISPLAY_IDENTIFIER CTR_SUM_FAC_CYL_LAM_COR_OSC[2] ECU_ADDRESS 0xd000073c FORMAT "%5.0" /end MEASUREMENT
/begin MEASUREMENT ctr_sum_fac_cyl_lam_cor_osc[3] "Duration of oscillation monitoring" UWORD _CNV_A_R_LINEAR_____0_CM 1 100. 0. 65535. DISPLAY_IDENTIFIER CTR_SUM_FAC_CYL_LAM_COR_OSC[3] ECU_ADDRESS 0xd000073e FORMAT "%5.0" /end MEASUREMENT
/begin MEASUREMENT ctr_sum_fac_cyl_lam_cor_osc[4] "Duration of oscillation monitoring" UWORD _CNV_A_R_LINEAR_____0_CM 1 100. 0. 65535. DISPLAY_IDENTIFIER CTR_SUM_FAC_CYL_LAM_COR_OSC[4] ECU_ADDRESS 0xd0000740 FORMAT "%5.0" /end MEASUREMENT
/begin MEASUREMENT ctr_sum_fac_cyl_lam_cor_osc[5] "Duration of oscillation monitoring" UWORD _CNV_A_R_LINEAR_____0_CM 1 100. 0. 65535. DISPLAY_IDENTIFIER CTR_SUM_FAC_CYL_LAM_COR_OSC[5] ECU_ADDRESS 0xd0000742 FORMAT "%5.0" /end MEASUREMENT
/begin MEASUREMENT ctr_sum_fac_cyl_lam_cor_osc[6] "Duration of oscillation monitoring" UWORD _CNV_A_R_LINEAR_____0_CM 1 100. 0. 65535. DISPLAY_IDENTIFIER CTR_SUM_FAC_CYL_LAM_COR_OSC[6] ECU_ADDRESS 0xd0000744 FORMAT "%5.0" /end MEASUREMENT
/begin MEASUREMENT ctr_sum_fac_cyl_lam_cor_osc[7] "Duration of oscillation monitoring" UWORD _CNV_A_R_LINEAR_____0_CM 1 100. 0. 65535. DISPLAY_IDENTIFIER CTR_SUM_FAC_CYL_LAM_COR_OSC[7] ECU_ADDRESS 0xd0000746 FORMAT "%5.0" /end MEASUREMENT
/begin MEASUREMENT lv_er_stnd_er_bal_act "Activation condition to enable cylinder balancing signal preparation calculation" UBYTE _CNV_S_2_RANGE__0___1_CM 1 100. 0. 1. DISPLAY_IDENTIFIER LV_ER_STND_ER_BAL_ACT ECU_ADDRESS 0xd0008cb4 BIT_MASK 0x1 /end MEASUREMENT
/begin MEASUREMENT lv_drv1_er_bal_act "Activation condition to enable cylinder balancing fade out calculation" UBYTE _CNV_S_2_RANGE__0___1_CM 1 100. 0. 1. DISPLAY_IDENTIFIER LV_DRV1_ER_BAL_ACT ECU_ADDRESS 0xd0008cb5 BIT_MASK 0x1 /end MEASUREMENT
/begin MEASUREMENT lv_ti_er_bal_act "Activation condition to enable cylinder balancing TI intervention calculation" UBYTE _CNV_S_2_RANGE__0___1_CM 1 100. 0. 1. DISPLAY_IDENTIFIER LV_TI_ER_BAL_ACT ECU_ADDRESS 0xd0008cb6 BIT_MASK 0x1 /end MEASUREMENT
/begin MEASUREMENT lv_ti_cyl_bal_er_act "Flag for cylinder balancing (TI intervention) via engine roughness activated" UBYTE _CNV_S_2_RANGE__0___1_CM 1 100. 0. 1. DISPLAY_IDENTIFIER LV_TI_CYL_BAL_ER_ACT ECU_ADDRESS 0xd0008cba BIT_MASK 0x1 /end MEASUREMENT
/begin MEASUREMENT lv_ti_cyl_bal_lam_act "Flag for cylinder balancing (TI intervention) via lambda sensor activated" UBYTE _CNV_S_2_RANGE__0___1_CM 1 100. 0. 1. DISPLAY_IDENTIFIER LV_TI_CYL_BAL_LAM_ACT ECU_ADDRESS 0xd0008cbb BIT_MASK 0x1 /end MEASUREMENT
/begin CHARACTERISTIC c_tqi_min_ti_er_bal "Minimum engine torque for cylinder balancing via TI intervention" VALUE 0xa080c3a8 _REC_VAL_20_s2 2047.96875 _CNV_A_R_LINEAR_____31_CM -1024. 1023.96875 DISPLAY_IDENTIFIER C_TQI_MIN_TI_ER_BAL FORMAT "%11.5" /end CHARACTERISTIC
/begin CHARACTERISTIC c_tqi_max_ti_er_bal "Maximum engine torque for cylinder balancing via TI intervention" VALUE 0xa080c3a6 _REC_VAL_20_s2 2047.96875 _CNV_A_R_LINEAR_____31_CM -1024. 1023.96875 DISPLAY_IDENTIFIER C_TQI_MAX_TI_ER_BAL FORMAT "%11.5" /end CHARACTERISTIC
/begin CHARACTERISTIC c_t_ast_min_ti_er_bal "Minimum time after engine start for cylinder balancing via TI intervention" VALUE 0xa080c13a _REC_VAL_20_u2 6553.5 _CNV_A_R_LINEAR_____4_CM 0. 6553.5 DISPLAY_IDENTIFIER C_T_AST_MIN_TI_ER_BAL FORMAT "%6.1" /end CHARACTERISTIC
/begin CHARACTERISTIC lc_ti_er_bal_stop_man "Logical constant for manual stop (=1) of all cylinder balancing functions (TI intervention)" VALUE 0xa080c602 _REC_VAL_20_u1 1. _CNV_A_R_LINEAR_____0_CM 0. 1. DISPLAY_IDENTIFIER LC_TI_ER_BAL_STOP_MAN FORMAT "%1.0" /end CHARACTERISTIC
/begin MEASUREMENT lv_mff_cor_er_bal_ena_ext "External condition to enable cylinder balancing manager calculations" UBYTE _CNV_S_2_RANGE__0___1_CM 1 100. 0. 1. DISPLAY_IDENTIFIER LV_MFF_COR_ER_BAL_ENA_EXT ECU_ADDRESS 0xd0008cb7 BIT_MASK 0x1 /end MEASUREMENT
/begin MEASUREMENT lv_mff_add_ad_er_bal_ena_ext "External condition to enable cylinder balancing additive adaptation manager calculations" UBYTE _CNV_S_2_RANGE__0___1_CM 1 100. 0. 1. DISPLAY_IDENTIFIER LV_MFF_ADD_AD_ER_BAL_ENA_EXT ECU_ADDRESS 0xd0008cb8 BIT_MASK 0x1 /end MEASUREMENT
/begin MEASUREMENT lv_mff_fac_ad_er_bal_ena_ext "External condition to enable cylinder balancing multiple adaptation manager calculations" UBYTE _CNV_S_2_RANGE__0___1_CM 1 100. 0. 1. DISPLAY_IDENTIFIER LV_MFF_FAC_AD_ER_BAL_ENA_EXT ECU_ADDRESS 0xd0008cb9 BIT_MASK 0x1 /end MEASUREMENT
/begin CHARACTERISTIC c_er_stnd_er_bal_act_man "Manual adjustment of activation conditions for cylinder balancing signal preparation" VALUE 0xa080bca0 _REC_VAL_20_u1 2. _CNV_S_3_CYBL_RANGE_798_CM 0. 2. DISPLAY_IDENTIFIER C_ER_STND_ER_BAL_ACT_MAN /end CHARACTERISTIC
/begin CHARACTERISTIC c_drv1_er_bal_act_man "Manual adjustment of activation conditions for cylinder balancing fade out" VALUE 0xa080bc51 _REC_VAL_20_u1 2. _CNV_S_3_CYBL_RANGE_798_CM 0. 2. DISPLAY_IDENTIFIER C_DRV1_ER_BAL_ACT_MAN /end CHARACTERISTIC
/begin CHARACTERISTIC c_ti_er_bal_act_man "Manual adjustment of activation conditions for cylinder balancing via TI intervention" VALUE 0xa080c320 _REC_VAL_20_u1 2. _CNV_S_3_CYBL_RANGE_798_CM 0. 2. DISPLAY_IDENTIFIER C_TI_ER_BAL_ACT_MAN /end CHARACTERISTIC
/begin MEASUREMENT lv_ti_er_bal_ena "Flag for cylinder balancing via TI intervention enabled" UBYTE _CNV_S_2_RANGE__0___1_CM 1 100. 0. 1. DISPLAY_IDENTIFIER LV_TI_ER_BAL_ENA ECU_ADDRESS 0xd000083c BIT_MASK 0x1 /end MEASUREMENT
/begin MEASUREMENT lv_fac_ti_er_bal_ena "Flag for multiple cylinder balancing TI correction active" UBYTE _CNV_S_2_RANGE__0___1_CM 1 100. 0. 1. DISPLAY_IDENTIFIER LV_FAC_TI_ER_BAL_ENA ECU_ADDRESS 0xd0008cc0 BIT_MASK 0x1 /end MEASUREMENT
/begin MEASUREMENT lv_fac_ti_ad_er_bal_ena "Flag for multiple cylinder balancing TI adaptation active" UBYTE _CNV_S_2_RANGE__0___1_CM 1 100. 0. 1. DISPLAY_IDENTIFIER LV_FAC_TI_AD_ER_BAL_ENA ECU_ADDRESS 0xd0008cc1 BIT_MASK 0x1 /end MEASUREMENT
/begin MEASUREMENT ctr_ti_er_bal_ena "Engine cycle counter to delay TI intervention at entry to state cylinder balancing" UWORD _CNV_A_R_LINEAR_____0_CM 1 100. 0. 65535. DISPLAY_IDENTIFIER CTR_TI_ER_BAL_ENA ECU_ADDRESS 0xd0000838 FORMAT "%5.0" /end MEASUREMENT
/begin MEASUREMENT lv_er_stnd_mmv_max_ti_er_bal "Flag for maximum ER_STND_MMV_BAL value for cylinder balancing via TI intervention" UBYTE _CNV_S_2_RANGE__0___1_CM 1 100. 0. 1. DISPLAY_IDENTIFIER LV_ER_STND_MMV_MAX_TI_ER_BAL ECU_ADDRESS 0xd000083d BIT_MASK 0x1 /end MEASUREMENT
/begin MEASUREMENT lv_er_std_mmv_max_ti_er_bal "Flag for maximum ER_STD_MMV_BAL value for cylinder balancing via TI intervention" UBYTE _CNV_S_2_RANGE__0___1_CM 1 100. 0. 1. DISPLAY_IDENTIFIER LV_ER_STD_MMV_MAX_TI_ER_BAL ECU_ADDRESS 0xd000083e BIT_MASK 0x1 /end MEASUREMENT
/begin CHARACTERISTIC c_tco_max_ti_er_bal "Maximum coolant temperature value for cylinder balancing via TI intervention" VALUE 0xa080c2cc _REC_VAL_20_u1 190.5 _CNV_A_R_LINEAR_____17_CM -48. 142.5 DISPLAY_IDENTIFIER C_TCO_MAX_TI_ER_BAL FORMAT "%6.2" /end CHARACTERISTIC
/begin CHARACTERISTIC c_tco_min_fac_ti_ad_er_bal "Minimum coolant temperature value for cylinder balancing multiple TI adaptation" VALUE 0xa080c2d3 _REC_VAL_20_u1 190.5 _CNV_A_R_LINEAR_____17_CM -48. 142.5 DISPLAY_IDENTIFIER C_TCO_MIN_FAC_TI_AD_ER_BAL FORMAT "%6.2" /end CHARACTERISTIC
/begin CHARACTERISTIC c_er_stnd_mmv_max_ti_er_bal "Maximum ER_STND_MMV_BAL value for cylinder balancing via TI intervention" VALUE 0xa080bca2 _REC_VAL_20_s2 651.5500579833979 _CNV_A_R_LINEAR_____140_CM -325.78 325.770057983398 DISPLAY_IDENTIFIER C_ER_STND_MMV_MAX_TI_ER_BAL FORMAT "%8.3" /end CHARACTERISTIC
/begin CHARACTERISTIC c_er_std_mmv_max_ti_er_bal "Maximum ER_STD_MMV_BAL value for cylinder balancing via TI intervention" VALUE 0xa080bc9e _REC_VAL_20_s2 651.5500579833979 _CNV_A_R_LINEAR_____140_CM -325.78 325.770057983398 DISPLAY_IDENTIFIER C_ER_STD_MMV_MAX_TI_ER_BAL FORMAT "%8.3" /end CHARACTERISTIC
/begin MEASUREMENT state_ti_er_bal "State of cylinder balancing via TI intervention" UBYTE _CNV_S_4_CYBL_RANGE_799_CM 1 100. 0. 3. DISPLAY_IDENTIFIER STATE_TI_ER_BAL ECU_ADDRESS 0xd0008cbc /end MEASUREMENT
/begin MEASUREMENT state_ctl_ti_er_bal "State of cylinder balancing control via TI intervention" UBYTE _CNV_S_5_CYBL_RANGE_800_CM 1 100. 0. 4. DISPLAY_IDENTIFIER STATE_CTL_TI_ER_BAL ECU_ADDRESS 0xd0008cbd /end MEASUREMENT
/begin CHARACTERISTIC c_tco_min_ti_er_bal "Minimum coolant temperature value for cylinder balancing via TI intervention" VALUE 0xa080c2dc _REC_VAL_20_u1 190.5 _CNV_A_R_LINEAR_____17_CM -48. 142.5 DISPLAY_IDENTIFIER C_TCO_MIN_TI_ER_BAL FORMAT "%6.2" /end CHARACTERISTIC
/begin CHARACTERISTIC c_mff_sp_max_fac_ti_er_bal "Maximum mass fuel flow setpoint for cylinder balancing multiple TI correction" VALUE 0xa080beac _REC_VAL_20_u2 1389. _CNV_A_R_LINEAR_____111_CM 0. 1389. DISPLAY_IDENTIFIER C_MFF_SP_MAX_FAC_TI_ER_BAL FORMAT "%7.2" /end CHARACTERISTIC
/begin CHARACTERISTIC c_mff_sp_min_fac_ti_ad_er_bal "Minimum mass fuel flow setpoint for cylinder balancing multiple TI adaptation" VALUE 0xa080beb6 _REC_VAL_20_u2 1389. _CNV_A_R_LINEAR_____111_CM 0. 1389. DISPLAY_IDENTIFIER C_MFF_SP_MIN_FAC_TI_AD_ER_BAL FORMAT "%7.2" /end CHARACTERISTIC
/begin CHARACTERISTIC c_mff_sp_max_fac_ti_ad_er_bal "Maximum mass fuel flow setpoint for cylinder balancing multiple TI adaptation" VALUE 0xa080beaa _REC_VAL_20_u2 1389. _CNV_A_R_LINEAR_____111_CM 0. 1389. DISPLAY_IDENTIFIER C_MFF_SP_MAX_FAC_TI_AD_ER_BAL FORMAT "%7.2" /end CHARACTERISTIC
/begin CHARACTERISTIC c_mff_sp_min_fac_ti_er_bal "Minimum mass fuel flow setpoint for cylinder balancing multiple TI correction" VALUE 0xa080beb8 _REC_VAL_20_u2 1389. _CNV_A_R_LINEAR_____111_CM 0. 1389. DISPLAY_IDENTIFIER C_MFF_SP_MIN_FAC_TI_ER_BAL FORMAT "%7.2" /end CHARACTERISTIC
/begin CHARACTERISTIC c_n_32_min_fac_ti_er_bal "Minimum engine speed for cylinder balancing multiple TI correction" VALUE 0xa080bf09 _REC_VAL_20_u1 8160. _CNV_A_R_LINEAR_____10_CM 0. 8160. DISPLAY_IDENTIFIER C_N_32_MIN_FAC_TI_ER_BAL FORMAT "%4.0" /end CHARACTERISTIC
/begin CHARACTERISTIC c_n_32_max_fac_ti_er_bal "Maximum engine speed for cylinder balancing multiple TI correction" VALUE 0xa080bf03 _REC_VAL_20_u1 8160. _CNV_A_R_LINEAR_____10_CM 0. 8160. DISPLAY_IDENTIFIER C_N_32_MAX_FAC_TI_ER_BAL FORMAT "%4.0" /end CHARACTERISTIC
/begin CHARACTERISTIC c_n_32_max_fac_ti_ad_er_bal "Maximum engine speed for cylinder balancing multiple TI adaptation" VALUE 0xa080bf02 _REC_VAL_20_u1 8160. _CNV_A_R_LINEAR_____10_CM 0. 8160. DISPLAY_IDENTIFIER C_N_32_MAX_FAC_TI_AD_ER_BAL FORMAT "%4.0" /end CHARACTERISTIC
/begin CHARACTERISTIC c_n_32_min_fac_ti_ad_er_bal "Minimum engine speed for cylinder balancing multiple TI adaptation" VALUE 0xa080bf08 _REC_VAL_20_u1 8160. _CNV_A_R_LINEAR_____10_CM 0. 8160. DISPLAY_IDENTIFIER C_N_32_MIN_FAC_TI_AD_ER_BAL FORMAT "%4.0" /end CHARACTERISTIC
/begin AXIS_PTS ldp_n_32_ip_ctr_ti_er_bal_ini "" 0xa08089e0 n_32 _REC_AXS_20_u1 8160. _CNV_A_R_LINEAR_____10_CM 4 0. 8160. FORMAT "%4.0" /end AXIS_PTS
/begin CHARACTERISTIC ip_ctr_ti_er_bal_ena_ini "Engine cycle counter start value to delay TI intervention at entry to state cylinder balancing" CURVE 0xa080a0fc _REC_CUR_20_u2_u1 65535. _CNV_A_R_LINEAR_____0_CM 0. 65535. DISPLAY_IDENTIFIER IP_CTR_TI_ER_BAL_ENA_INI FORMAT "%5.0"
 /begin AXIS_DESCR COM_AXIS n_32 _CNV_A_R_LINEAR_____10_CM 4 0. 8160. FORMAT "%4.0" AXIS_PTS_REF ldp_n_32_ip_ctr_ti_er_bal_ini /end AXIS_DESCR
/end CHARACTERISTIC
/begin MEASUREMENT lv_mff_add_ad_er_bal_ena "Flag for additive cylinder balancing MFF adaptation active" UBYTE _CNV_S_2_RANGE__0___1_CM 1 100. 0. 1. DISPLAY_IDENTIFIER LV_MFF_ADD_AD_ER_BAL_ENA ECU_ADDRESS 0xd0008cbf BIT_MASK 0x1 /end MEASUREMENT
/begin MEASUREMENT lv_mff_add_er_bal_ena "Flag for additive cylinder balancing MFF correction active" UBYTE _CNV_S_2_RANGE__0___1_CM 1 100. 0. 1. DISPLAY_IDENTIFIER LV_MFF_ADD_ER_BAL_ENA ECU_ADDRESS 0xd0008cbe BIT_MASK 0x1 /end MEASUREMENT
/begin CHARACTERISTIC lc_mff_add_er_bal_ena "Logical constant to enable additive MFF intervention out of idle" VALUE 0xa080c5ad _REC_VAL_20_u1 1. _CNV_A_R_LINEAR_____0_CM 0. 1. DISPLAY_IDENTIFIER LC_MFF_ADD_ER_BAL_ENA FORMAT "%1.0" /end CHARACTERISTIC
/begin CHARACTERISTIC c_mff_sp_max_mff_add_ad_er_bal "Maximum mass fuel flow setpoint for cylinder balancing additive MFF adaptation" VALUE 0xa080beae _REC_VAL_20_u2 1389. _CNV_A_R_LINEAR_____111_CM 0. 1389. DISPLAY_IDENTIFIER C_MFF_SP_MAX_MFF_ADD_AD_ER_BAL FORMAT "%7.2" /end CHARACTERISTIC
/begin CHARACTERISTIC c_mff_sp_max_mff_add_er_bal "Maximum mass fuel flow setpoint for cylinder balancing additive MFF correction" VALUE 0xa080beb0 _REC_VAL_20_u2 1389. _CNV_A_R_LINEAR_____111_CM 0. 1389. DISPLAY_IDENTIFIER C_MFF_SP_MAX_MFF_ADD_ER_BAL FORMAT "%7.2" /end CHARACTERISTIC
/begin CHARACTERISTIC c_mff_sp_min_mff_add_ad_er_bal "Minimum mass fuel flow setpoint for cylinder balancing additive MFF adaptation" VALUE 0xa080beba _REC_VAL_20_u2 1389. _CNV_A_R_LINEAR_____111_CM 0. 1389. DISPLAY_IDENTIFIER C_MFF_SP_MIN_MFF_ADD_AD_ER_BAL FORMAT "%7.2" /end CHARACTERISTIC
/begin CHARACTERISTIC c_mff_sp_min_mff_add_er_bal "Minimum mass fuel flow setpoint for cylinder balancing additive MFF correction" VALUE 0xa080bebc _REC_VAL_20_u2 1389. _CNV_A_R_LINEAR_____111_CM 0. 1389. DISPLAY_IDENTIFIER C_MFF_SP_MIN_MFF_ADD_ER_BAL FORMAT "%7.2" /end CHARACTERISTIC
/begin CHARACTERISTIC c_n_32_max_mff_add_ad_er_bal "Maximum engine speed for cylinder balancing additive MFF adaptation" VALUE 0xa080bf05 _REC_VAL_20_u1 8160. _CNV_A_R_LINEAR_____10_CM 0. 8160. DISPLAY_IDENTIFIER C_N_32_MAX_MFF_ADD_AD_ER_BAL FORMAT "%4.0" /end CHARACTERISTIC
/begin CHARACTERISTIC c_n_32_max_mff_add_er_bal "Maximum engine speed for cylinder balancing additive MFF correction" VALUE 0xa080bf06 _REC_VAL_20_u1 8160. _CNV_A_R_LINEAR_____10_CM 0. 8160. DISPLAY_IDENTIFIER C_N_32_MAX_MFF_ADD_ER_BAL FORMAT "%4.0" /end CHARACTERISTIC
/begin CHARACTERISTIC c_n_32_min_mff_add_ad_er_bal "Minimum engine speed for cylinder balancing additive MFF adaptation" VALUE 0xa080bf0b _REC_VAL_20_u1 8160. _CNV_A_R_LINEAR_____10_CM 0. 8160. DISPLAY_IDENTIFIER C_N_32_MIN_MFF_ADD_AD_ER_BAL FORMAT "%4.0" /end CHARACTERISTIC
/begin CHARACTERISTIC c_n_32_min_mff_add_er_bal "Minimum engine speed for cylinder balancing additive MFF correction" VALUE 0xa080bf0c _REC_VAL_20_u1 8160. _CNV_A_R_LINEAR_____10_CM 0. 8160. DISPLAY_IDENTIFIER C_N_32_MIN_MFF_ADD_ER_BAL FORMAT "%4.0" /end CHARACTERISTIC
/begin CHARACTERISTIC c_tco_min_mff_add_ad_er_bal "Minimum coolant temperature value for cylinder balancing additive MFF adaptation" VALUE 0xa080c2d8 _REC_VAL_20_u1 190.5 _CNV_A_R_LINEAR_____17_CM -48. 142.5 DISPLAY_IDENTIFIER C_TCO_MIN_MFF_ADD_AD_ER_BAL FORMAT "%6.2" /end CHARACTERISTIC
/begin COMPU_METHOD _CNV_A_R_LINEAR_____0_CM "" RAT_FUNC "%6.3" "-" COEFFS 0 1. 0. 0 0 1 /end COMPU_METHOD
/begin COMPU_METHOD _CNV_S_2_RANGE__0___1_CM "" TAB_VERB "%6.3" "-" COMPU_TAB_REF _CNV_S_2_RANGE__0___1 /end COMPU_METHOD
/begin COMPU_VTAB _CNV_S_2_RANGE__0___1 "" TAB_VERB 2 0 "0" 1 "1" /end COMPU_VTAB
/begin COMPU_METHOD _CNV_A_R_LINEAR_____2_CM "" RAT_FUNC "%6.3" "V" COEFFS 0 204.8 0. 0 0 1 /end COMPU_METHOD
/begin COMPU_METHOD _CNV_A_R_LINEAR_____4_CM "" RAT_FUNC "%6.3" "s" COEFFS 0 10. 0. 0 0 1 /end COMPU_METHOD
/begin COMPU_METHOD _CNV_A_R_LINEAR_____8_CM "" RAT_FUNC "%6.3" "%" COEFFS 0 655.3599999999997 0. 0 0 1 /end COMPU_METHOD
/begin COMPU_METHOD _CNV_A_R_LINEAR_____9_CM "" RAT_FUNC "%6.3" "-" COEFFS 0 32767.99999999992 0. 0 0 1 /end COMPU_METHOD
/begin COMPU_METHOD _CNV_A_R_LINEAR_____10_CM "" RAT_FUNC "%6.3" "rpm" COEFFS 0 3.125e-002 0. 0 0 1 /end COMPU_METHOD
/begin COMPU_METHOD _CNV_A_R_LINEAR_____12_CM "" RAT_FUNC "%6.3" "-" COEFFS 0 4095.999999839998 -1.280019205296412e-006 0 0 1 /end COMPU_METHOD
/begin COMPU_METHOD _CNV_A_R_LINEAR_____14_CM "" RAT_FUNC "%6.3" "rpm" COEFFS 0 1. 0. 0 0 1 /end COMPU_METHOD
/begin COMPU_METHOD _CNV_A_R_LINEAR_____17_CM "" RAT_FUNC "%6.3" "°C" COEFFS 0 1.333333333333333 64. 0 0 1 /end COMPU_METHOD
/begin COMPU_METHOD _CNV_A_R_LINEAR_____27_CM "" RAT_FUNC "%6.3" "hPa" COEFFS 0 12.06017666543982 0. 0 0 1 /end COMPU_METHOD
/begin COMPU_METHOD _CNV_A_R_LINEAR_____28_CM "" RAT_FUNC "%6.3" "-" COEFFS 0 256. 0. 0 0 1 /end COMPU_METHOD
/begin COMPU_METHOD _CNV_A_R_LINEAR_____31_CM "" RAT_FUNC "%6.3" "Nm" COEFFS 0 32. 0. 0 0 1 /end COMPU_METHOD
/begin COMPU_METHOD _CNV_A_R_LINEAR_____36_CM "" RAT_FUNC "%6.3" "s" COEFFS 0 1. 0. 0 0 1 /end COMPU_METHOD
/begin COMPU_METHOD _CNV_A_R_LINEAR_____89_CM "" RAT_FUNC "%6.3" "-" COEFFS 0 65535.99999999996 0. 0 0 1 /end COMPU_METHOD
/begin COMPU_METHOD _CNV_A_R_LINEAR_____110_CM "" RAT_FUNC "%6.3" "s" COEFFS 0 50. 0. 0 0 1 /end COMPU_METHOD
/begin COMPU_METHOD _CNV_A_R_LINEAR_____111_CM "" RAT_FUNC "%6.3" "mg/stk" COEFFS 0 47.18142548596112 0. 0 0 1 /end COMPU_METHOD
/begin COMPU_METHOD _CNV_A_R_LINEAR_____112_CM "" RAT_FUNC "%6.3" "°CRK" COEFFS 0 0.1666666666666667 0. 0 0 1 /end COMPU_METHOD
/begin COMPU_METHOD _CNV_A_R_LINEAR_____113_CM "" RAT_FUNC "%6.3" "%" COEFFS 0 655.3599999999997 -1.455191522836685e-011 0 0 1 /end COMPU_METHOD
/begin COMPU_METHOD _CNV_A_R_LINEAR_____114_CM "" RAT_FUNC "%6.3" "1/s" COEFFS 0 4095.999999839998 -1.280019205296412e-006 0 0 1 /end COMPU_METHOD
/begin COMPU_METHOD _CNV_A_R_LINEAR_____115_CM "" RAT_FUNC "%6.3" "-" COEFFS 0 8192. 0. 0 0 1 /end COMPU_METHOD
/begin COMPU_METHOD _CNV_A_R_LINEAR_____116_CM "" RAT_FUNC "%6.3" "-" COEFFS 0 1023.999999959999 0. 0 0 1 /end COMPU_METHOD
/begin COMPU_METHOD _CNV_A_R_LINEAR_____117_CM "" RAT_FUNC "%6.3" "s" COEFFS 0 32767.99999999992 0. 0 0 1 /end COMPU_METHOD
/begin COMPU_METHOD _CNV_S_7_RANGE_STAT_118_CM "" TAB_VERB "%6.3" "-" COMPU_TAB_REF _CNV_S_7_RANGE_STAT_118 /end COMPU_METHOD
/begin COMPU_VTAB _CNV_S_7_RANGE_STAT_118 "" TAB_VERB 7 0 "PAS" 1 "WAIT_ENG_COLD" 2 "ADJ_ENG_COLD" 3 "WAIT_ENG_NOM" 4 "ADJ_NOM_L_RNG" 5 "ADJ_NOM_H_RNG" 6 "ADJ_NOM_OFS" /end COMPU_VTAB
/begin COMPU_METHOD _CNV_A_R_LINEAR_____119_CM "" RAT_FUNC "%6.3" "-" COEFFS 0 4096. 0. 0 0 1 /end COMPU_METHOD
/begin COMPU_METHOD _CNV_A_R_LINEAR_____120_CM "" RAT_FUNC "%6.3" "1/s" COEFFS 0 256. 0. 0 0 1 /end COMPU_METHOD
/begin COMPU_METHOD _CNV_S_4_RANGE_STAT_121_CM "" TAB_VERB "%6.3" "-" COMPU_TAB_REF _CNV_S_4_RANGE_STAT_121 /end COMPU_METHOD
/begin COMPU_VTAB _CNV_S_4_RANGE_STAT_121 "" TAB_VERB 4 0 "PAS" 1 "OPL" 2 "WAIT" 3 "CLL" /end COMPU_VTAB
/begin COMPU_METHOD _CNV_A_R_CYBL_LINEA_122_CM "" RAT_FUNC "%6.3" "°CRK" COEFFS 0 0.1666666666666667 120. 0 0 1 /end COMPU_METHOD
/begin COMPU_METHOD _CNV_A_R_LINEAR_____123_CM "" RAT_FUNC "%6.3" "%" COEFFS 0 1023.999999959999 0. 0 0 1 /end COMPU_METHOD
/begin COMPU_METHOD _CNV_A_R_CYBL_LINEA_124_CM "" RAT_FUNC "%6.3" "-" COEFFS 0 4095.999963999451 32767.99971199561 0 0 1 /end COMPU_METHOD
/begin COMPU_METHOD _CNV_A_R_LINEAR_____125_CM "" RAT_FUNC "%6.3" "%" COEFFS 0 655.3600000143365 0. 0 0 1 /end COMPU_METHOD
/begin COMPU_METHOD _CNV_A_R_LINEAR_____126_CM "" RAT_FUNC "%6.3" "-" COEFFS 0 65536.00270084133 0. 0 0 1 /end COMPU_METHOD
/begin COMPU_METHOD _CNV_A_R_LINEAR_____127_CM "" RAT_FUNC "%6.3" "%" COEFFS 0 8192. 0. 0 0 1 /end COMPU_METHOD
/begin COMPU_METHOD _CNV_A_R_LINEAR_____128_CM "" RAT_FUNC "%6.3" "mg/stk" COEFFS 0 47.18142548596112 -1.455191522836685e-011 0 0 1 /end COMPU_METHOD
/begin COMPU_METHOD _CNV_A_R_LINEAR_____129_CM "" RAT_FUNC "%6.3" "-" COEFFS 0 1024. 0. 0 0 1 /end COMPU_METHOD
/begin COMPU_METHOD _CNV_A_R_LINEAR_____130_CM "" RAT_FUNC "%6.3" "°C" COEFFS 0 16. 0. 0 0 1 /end COMPU_METHOD
/begin COMPU_METHOD _CNV_S_4_STATE_CDN__131_CM "" TAB_VERB "%6.3" "" COMPU_TAB_REF _CNV_S_4_STATE_CDN__131 /end COMPU_METHOD
/begin COMPU_VTAB _CNV_S_4_STATE_CDN__131 "" TAB_VERB 4 0 "OUT_OF_RNG" 1 "LOW_RNG" 2 "HIGH_RNG" 3 "COLD_RNG" /end COMPU_VTAB
/begin COMPU_METHOD _CNV_A_R_LINEAR_____132_CM "" RAT_FUNC "%6.3" "°CRK" COEFFS 0 16. 1440. 0 0 1 /end COMPU_METHOD
/begin COMPU_METHOD _CNV_A_R_CYBL_LINEA_135_CM "" RAT_FUNC "%6.3" "g" COEFFS 0 45.00010299863355 0. 0 0 1 /end COMPU_METHOD
/begin COMPU_METHOD _CNV_A_R_LINEAR_____140_CM "" RAT_FUNC "%6.3" "1/s²" COEFFS 0 100.5832156670146 2.182787284255028e-011 0 0 1 /end COMPU_METHOD
/begin COMPU_METHOD _CNV_S_3_RANGE_STAT_141_CM "" TAB_VERB "%6.3" "-" COMPU_TAB_REF _CNV_S_3_RANGE_STAT_141 /end COMPU_METHOD
/begin COMPU_VTAB _CNV_S_3_RANGE_STAT_141 "" TAB_VERB 3 0 "Ready" 1 "Wait" 2 "Adaptation" /end COMPU_VTAB
/begin COMPU_METHOD _CNV_S_8_RANGE_C_CY_142_CM "" TAB_VERB "%6.3" "-" COMPU_TAB_REF _CNV_S_8_RANGE_C_CY_142 /end COMPU_METHOD
/begin COMPU_VTAB _CNV_S_8_RANGE_C_CY_142 "" TAB_VERB 8 0 "ZERO" 1 "ON" 2 "LAM_AD" 3 "SEL_COLD" 4 "SEL_HOT" 5 "ER_FAC" 6 "ER_ADD" 7 "WG_OPEN" /end COMPU_VTAB
/begin COMPU_METHOD _CNV_A_R_LINEAR_____143_CM "" RAT_FUNC "%6.3" "1/s²" COEFFS 0 100.5832156670146 32768.00000000002 0 0 1 /end COMPU_METHOD
/begin COMPU_METHOD _CNV_S_4_RANGE_C_CY_144_CM "" TAB_VERB "%6.3" "-" COMPU_TAB_REF _CNV_S_4_RANGE_C_CY_144 /end COMPU_METHOD
/begin COMPU_VTAB _CNV_S_4_RANGE_C_CY_144 "" TAB_VERB 4 0 "ZERO" 1 "ADD" 2 "FAC_L" 3 "ADD_FAC_L" /end COMPU_VTAB
/begin COMPU_METHOD _CNV_S_4_RANGE_C_CY_145_CM "" TAB_VERB "%6.3" "-" COMPU_TAB_REF _CNV_S_4_RANGE_C_CY_145 /end COMPU_METHOD
/begin COMPU_VTAB _CNV_S_4_RANGE_C_CY_145 "" TAB_VERB 4 0 "ZERO" 1 "LOW" 2 "HIGH" 3 "LOW_HIGH" /end COMPU_VTAB
/begin COMPU_METHOD _CNV_S_7_RANGE_STAT_538_CM "" TAB_VERB "%6.3" "-" COMPU_TAB_REF _CNV_S_7_RANGE_STAT_538 /end COMPU_METHOD
/begin COMPU_VTAB _CNV_S_7_RANGE_STAT_538 "" TAB_VERB 7 0 "AD_PAS" 1 "AD_ACT" 2 "AD_CDN" 3 "AD_INI" 4 "AD_DEC" 5 "AD_INC" 6 "AD_HOLD" /end COMPU_VTAB
/begin COMPU_METHOD _CNV_A_R_CYBL_LINEA_539_CM "" RAT_FUNC "%6.3" "1/s²" COEFFS 0 100.5832156670147 0. 0 0 1 /end COMPU_METHOD
/begin COMPU_METHOD _CNV_S_3_CYBL_RANGE_798_CM "" TAB_VERB "%6.3" "-" COMPU_TAB_REF _CNV_S_3_CYBL_RANGE_798 /end COMPU_METHOD
/begin COMPU_VTAB _CNV_S_3_CYBL_RANGE_798 "" TAB_VERB 3 0 "NEUTRAL" 1 "ENABLE" 2 "DISABLE" /end COMPU_VTAB
/begin COMPU_METHOD _CNV_S_4_CYBL_RANGE_799_CM "" TAB_VERB "%6.3" "-" COMPU_TAB_REF _CNV_S_4_CYBL_RANGE_799 /end COMPU_METHOD
/begin COMPU_VTAB _CNV_S_4_CYBL_RANGE_799 "" TAB_VERB 4 0 "Initialization" 1 "Lock" 2 "Wait" 3 "Cylinder Balancing" /end COMPU_VTAB
/begin COMPU_METHOD _CNV_S_5_CYBL_RANGE_800_CM "" TAB_VERB "%6.3" "-" COMPU_TAB_REF _CNV_S_5_CYBL_RANGE_800 /end COMPU_METHOD
/begin COMPU_VTAB _CNV_S_5_CYBL_RANGE_800 "" TAB_VERB 5 0 "Non" 1 "Additive" 2 "Additive AD" 3 "Multiple" 4 "Multiple AD" /end COMPU_VTAB
/begin RECORD_LAYOUT _REC_VAL_20_u1 FNC_VALUES 1 UBYTE COLUMN_DIR DIRECT /end RECORD_LAYOUT
/begin RECORD_LAYOUT _REC_VAL_20_u2 FNC_VALUES 1 UWORD COLUMN_DIR DIRECT /end RECORD_LAYOUT
/begin RECORD_LAYOUT _REC_AXS_20_u1 NO_AXIS_PTS_X 1 UBYTE AXIS_PTS_X 2 UBYTE INDEX_INCR DIRECT /end RECORD_LAYOUT
/begin RECORD_LAYOUT _REC_CUR_20_u1_u1 FNC_VALUES 1 UBYTE COLUMN_DIR DIRECT /end RECORD_LAYOUT
/begin RECORD_LAYOUT _REC_VAL_20_s2 FNC_VALUES 1 SWORD COLUMN_DIR DIRECT /end RECORD_LAYOUT
/begin RECORD_LAYOUT _REC_AXS_20_u2 NO_AXIS_PTS_X 1 UWORD AXIS_PTS_X 2 UWORD INDEX_INCR DIRECT /end RECORD_LAYOUT
/begin RECORD_LAYOUT _REC_CUR_20_u2_u1 FNC_VALUES 1 UWORD COLUMN_DIR DIRECT /end RECORD_LAYOUT
/begin RECORD_LAYOUT _REC_CUR_20_u2_u2 FNC_VALUES 1 UWORD COLUMN_DIR DIRECT /end RECORD_LAYOUT
/begin RECORD_LAYOUT _REC_VAL_20_s1 FNC_VALUES 1 SBYTE COLUMN_DIR DIRECT /end RECORD_LAYOUT
/begin RECORD_LAYOUT _REC_CUR_20_u1_u2 FNC_VALUES 1 UBYTE COLUMN_DIR DIRECT /end RECORD_LAYOUT
/begin RECORD_LAYOUT _REC_MAP_20_u2_u2_u2 FNC_VALUES 1 UWORD COLUMN_DIR DIRECT /end RECORD_LAYOUT
/begin RECORD_LAYOUT _REC_MAP_20_u1_u2_u2 FNC_VALUES 1 UBYTE COLUMN_DIR DIRECT /end RECORD_LAYOUT
/begin FUNCTION CYBL_Cyl_Bal_via_Lam_Sens "Cyl_Bal_via_Lam_Sens"
 /begin DEF_CHARACTERISTIC c_crk_cyl_lam_1 c_crk_cyl_lam_2 c_crk_cyl_lam_3 c_crk_cyl_lam_4 c_crk_cyl_lam_5 c_crk_cyl_lam_0 c_cyl_lam_out_min c_cyl_lam_out_max c_cyl_lam_diag_min c_delta_lamb_cyl_sp c_crlc_exv_fac_0 c_crlc_exv_fac_1 c_crlc_exv_fac_2 c_crlc_exv_fac_3 c_crlc_exv_fac_4 c_crlc_exv_fac_5 c_crlc_exv_fac_6 c_crlc_exv_fac_7 c_crk_cyl_lam_6 c_crk_cyl_lam_7 ldpm_fac_t_2_1_cybl ldpm_maf_1_cybl ip_exp_lamb_mdl_2 ip_n1_fac_lamb_mdl_2 ip_n2_fac_lamb_mdl_2 ip_crk_syn_1 ip_crk_syn_2 ip_t1_lamb_cyl_sel_1 ip_t1_lamb_cyl_sel_2 c_cyl_lam_diag_max lc_adapt_cor_out ldp_t1_lamb_cyl_i_ip_fac_err c_t_lam_cyl_adj c_t_lam_cyl_adj_cst c_tco_lam_cyl_min c_tco_lam_cyl_cst_min c_tco_lam_cyl_cst_max c_crlc_lam_cyl_cst_fil lc_lam_cyl_sel_opl lc_fac_lam_cyl_sel_adj_cst_ena ldpm_fac_t_1_1_cybl ldpm_tco_1_cybl ip_crlc_fac_lam_cyl_sel_adj lc_lam_cyl_sel_err_rst lc_lamb_delta_mdl_hld ip_exp_lamb_mdl_1 ip_n1_fac_lamb_mdl_1 ip_fac_err_lam_sel ip_n2_fac_lamb_mdl_1 c_crlc_cyl_fil c_n_max_fac_cyl_sel_adj_l_rng c_n_min_fac_cyl_sel_adj_l_rng c_n_min_fac_cyl_sel_adj_h_rng c_n_max_fac_cyl_sel_adj_h_rng c_mff_max_fac_cyl_sel_adj_l_rng c_mff_min_fac_cyl_sel_adj_l_rng c_mff_min_fac_cyl_sel_adj_h_rng c_mff_sp_thd_cyl_sel_adj_l_rng c_mff_sp_thd_cyl_sel_adj_h_rng lc_fac_lam_cyl_sel_adj_p_i_ena lc_fac_cyl_lam_p_swi ip_crk_delta_amp_cyl_lam ip_fac_gain_p_lam_cyl_sel ip_crlc_p_neut_rng ldp_delta_lamb_dif_cyl_x_p ip_crlc_fac_lam_cyl_adj_cst ip_lamb_cyl ldp_vls_cyl_sel_x_ip_lamb_cyl c_fac_cyl_lam_absv_dec c_mff_max_fac_cyl_sel_adj_h_rng c_mff_lam_cyl_adj_cst_min ip_crlc_cyl_lam ip_crlc_int_fast_cyl_lam ip_crlc_i_neut_rng ldp_delta_lamb_dif_cyl_x_i ldp_mff_delta_lam_cyl_i_ip_fac c_crlc_delta_lamb_cyl_cq_fil c_lamb_cyl_sel_cq_drift_thd c_mff_lam_cyl_adj_cst_max c_mff_min_add_lam_cyl_sel_adj c_mff_max_add_lam_cyl_sel_adj ldpm_n_1_cybl ldp_n_32_ip_fac_mff_add_cyl ip_fac_val_lam_cyl_sel_reac ip_fac_opp_lam_cyl_sel_adj ip_fac_n_mff_add_cyl_lam_cor c_ctr_lamb_cyl_sel_cq_drift_thd ip_fac_wup_mff_add_cyl_lam /end DEF_CHARACTERISTIC
 /begin OUT_MEASUREMENT fac_cyl_lam_int[0] fac_cyl_lam_int[1] fac_cyl_lam_int[2] fac_cyl_lam_int[3] fac_cyl_lam_int[4] fac_cyl_lam_int[5] fac_cyl_lam_int[6] fac_cyl_lam_int[7] fac_cyl_lam[0] fac_cyl_lam[1] fac_cyl_lam[2] fac_cyl_lam[3] fac_cyl_lam[4] fac_cyl_lam[5] fac_cyl_lam[6] fac_cyl_lam[7] delta_lamb_err_cyl_sel[0] delta_lamb_err_cyl_sel[1] delta_lamb_err_cyl_sel[2] delta_lamb_err_cyl_sel[3] delta_lamb_err_cyl_sel[4] delta_lamb_err_cyl_sel[5] delta_lamb_err_cyl_sel[6] delta_lamb_err_cyl_sel[7] delta_lamb_dif_cyl[0] delta_lamb_dif_cyl[1] delta_lamb_dif_cyl[2] delta_lamb_dif_cyl[3] delta_lamb_dif_cyl[4] delta_lamb_dif_cyl[5] delta_lamb_dif_cyl[6] delta_lamb_dif_cyl[7] vls_cyl_sel[0] vls_cyl_sel[1] vls_cyl_sel[2] vls_cyl_sel[3] vls_cyl_sel[4] vls_cyl_sel[5] vls_cyl_sel[6] vls_cyl_sel[7] delta_lamb_cyl_sel_cq_2 lv_lam_cyl_act_2 cyl_lam_2.delta_lamb_av cyl_lam_2.delta_lamb_mdl cyl_lam_2.delta_lamb_err_raw cyl_lam_2.delta_lamb_err cyl_lam_2.delta_lamb_cyl_sel cyl_lam_2.fac_t cyl_lam_2.lv_lam_cyl_sel_seg_ref_cll lv_cyl_lam_lim_max_0 lv_cyl_lam_lim_max_1 lv_cyl_lam_lim_max_2 lv_cyl_lam_lim_max_3 lv_cyl_lam_lim_max_4 lv_cyl_lam_lim_max_5 lv_cyl_lam_lim_max_6 lv_cyl_lam_lim_max_7 lv_cyl_lam_lim_min_0 lv_cyl_lam_lim_min_1 lv_cyl_lam_lim_min_2 lv_cyl_lam_lim_min_3 lv_cyl_lam_lim_min_4 lv_cyl_lam_lim_min_5 lv_cyl_lam_lim_min_6 lv_cyl_lam_diag_lim_max_1 lv_cyl_lam_diag_lim_max_2 lv_cyl_lam_diag_lim_max_3 lv_cyl_lam_diag_lim_max_4 lv_cyl_lam_diag_lim_max_5 lv_cyl_lam_diag_lim_max_6 lv_cyl_lam_diag_lim_max_7 lv_cyl_lam_diag_lim_min_0 lv_cyl_lam_diag_lim_min_1 lv_cyl_lam_diag_lim_min_2 lv_cyl_lam_diag_lim_min_3 lv_cyl_lam_diag_lim_min_4 lv_cyl_lam_diag_lim_min_5 lv_cyl_lam_diag_lim_min_6 lv_cyl_lam_diag_lim_min_7 fac_lam_cyl_sel_adj[0] fac_lam_cyl_sel_adj[1] fac_lam_cyl_sel_adj[2] fac_lam_cyl_sel_adj[3] fac_lam_cyl_sel_adj[4] fac_lam_cyl_sel_adj[5] fac_lam_cyl_sel_adj[6] fac_lam_cyl_sel_adj[7] fac_lam_cyl_sel_adj_cst[0] fac_lam_cyl_sel_adj_cst[1] fac_lam_cyl_sel_adj_cst[2] fac_lam_cyl_sel_adj_cst[3] fac_lam_cyl_sel_adj_cst[4] fac_lam_cyl_sel_adj_cst[5] fac_lam_cyl_sel_adj_cst[6] fac_lam_cyl_sel_adj_cst[7] fac_lam_cyl_sel_adj_fil[0] fac_lam_cyl_sel_adj_fil[1] fac_lam_cyl_sel_adj_fil[2] fac_lam_cyl_sel_adj_fil[3] fac_lam_cyl_sel_adj_fil[4] fac_lam_cyl_sel_adj_fil[5] fac_lam_cyl_sel_adj_fil[6] fac_lam_cyl_sel_adj_fil[7] fac_lam_cyl_sel_adj_cst_fil[0] fac_lam_cyl_sel_adj_cst_fil[1] fac_lam_cyl_sel_adj_cst_fil[2] fac_lam_cyl_sel_adj_cst_fil[3] fac_lam_cyl_sel_adj_cst_fil[4] fac_lam_cyl_sel_adj_cst_fil[5] fac_lam_cyl_sel_adj_cst_fil[6] fac_lam_cyl_sel_adj_cst_fil[7] state_lam_cyl_sel_adj_2 delta_lamb_cyl[0] delta_lamb_cyl[1] delta_lamb_cyl[2] delta_lamb_cyl[3] delta_lamb_cyl[4] delta_lamb_cyl[5] delta_lamb_cyl[6] delta_lamb_cyl[7] lamb_cyl_sel[0] lamb_cyl_sel[1] lamb_cyl_sel[2] lamb_cyl_sel[3] lamb_cyl_sel[4] lamb_cyl_sel[5] lamb_cyl_sel[6] lamb_cyl_sel[7] state_lam_cyl_sel_adj_1 ctr_t_lam_cyl_adj_2 state_lam_cyl_sel_2 state_lam_cyl_sel_1 cyl_lam_1.delta_lamb_av cyl_lam_1.delta_lamb_mdl cyl_lam_1.delta_lamb_err_raw cyl_lam_1.delta_lamb_err cyl_lam_1.delta_lamb_cyl_sel cyl_lam_1.fac_t cyl_lam_1.lv_lam_cyl_sel_seg_ref_cll lv_cyl_lam_diag_lim_max_0 fac_cyl_lam_cor[0] fac_cyl_lam_cor[1] fac_cyl_lam_cor[2] fac_cyl_lam_cor[3] fac_cyl_lam_cor[4] fac_cyl_lam_cor[5] fac_cyl_lam_cor[6] fac_cyl_lam_cor[7] fac_cyl_lam_p[0] fac_cyl_lam_p[1] fac_cyl_lam_p[2] fac_cyl_lam_p[3] fac_cyl_lam_p[4] fac_cyl_lam_p[5] fac_cyl_lam_p[6] fac_cyl_lam_p[7] fac_cyl_lam_i_mv_shift[0] fac_cyl_lam_i_mv_shift[1] fac_cyl_lam_i_mv_shift[2] fac_cyl_lam_i_mv_shift[3] fac_cyl_lam_i_mv_shift[4] fac_cyl_lam_i_mv_shift[5] fac_cyl_lam_i_mv_shift[6] fac_cyl_lam_i_mv_shift[7] fac_cyl_lam_p_mv_shift[0] fac_cyl_lam_p_mv_shift[1] fac_cyl_lam_p_mv_shift[2] fac_cyl_lam_p_mv_shift[3] fac_cyl_lam_p_mv_shift[4] fac_cyl_lam_p_mv_shift[5] fac_cyl_lam_p_mv_shift[6] fac_cyl_lam_p_mv_shift[7] fac_lam_cyl_sel_adj_l_rng[0] fac_lam_cyl_sel_adj_l_rng[1] fac_lam_cyl_sel_adj_l_rng[2] fac_lam_cyl_sel_adj_l_rng[3] fac_lam_cyl_sel_adj_l_rng[4] fac_lam_cyl_sel_adj_l_rng[5] fac_lam_cyl_sel_adj_l_rng[6] fac_lam_cyl_sel_adj_l_rng[7] fac_lam_cyl_sel_adj_h_rng[0] fac_lam_cyl_sel_adj_h_rng[1] fac_lam_cyl_sel_adj_h_rng[2] fac_lam_cyl_sel_adj_h_rng[3] fac_lam_cyl_sel_adj_h_rng[4] fac_lam_cyl_sel_adj_h_rng[5] fac_lam_cyl_sel_adj_h_rng[6] fac_lam_cyl_sel_adj_h_rng[7] crk_cyl_lam[0] crk_cyl_lam[1] crk_cyl_lam[2] crk_cyl_lam[3] crk_cyl_lam[4] crk_cyl_lam[5] crk_cyl_lam[6] crk_cyl_lam[7] mff_sp_save_lam_cyl_sel_1 mff_sp_save_lam_cyl_sel_2 mff_delta_lam_cyl_sel_reac_2 mff_delta_lam_cyl_sel_reac_1 fac_val_lam_cyl_sel_reac_2 fac_val_lam_cyl_sel_reac_1 fac_cyl_lam_absv_sum_1 fac_cyl_lam_absv_sum_2 delta_lamb_cyl_sel_cq_1 delta_lamb_cyl_sel_cq_fil_1 delta_lamb_cyl_sel_cq_fil_2 lv_lam_cyl_act_1 lv_lam_cyl_sel_ctl_drift_pred_1 lv_lam_cyl_sel_ctl_drift_pred_2 ctr_t_lam_cyl_adj_1 ctr_lamb_cyl_sel_cq_drift_thd_1 ctr_lamb_cyl_sel_cq_drift_thd_2 lv_cyl_lam_lim_min_7 lv_lamb_cyl_sel_cq_drift_1 lv_lamb_cyl_sel_cq_drift_2 mff_add_cyl_lam_cor[0] mff_add_cyl_lam_cor[1] mff_add_cyl_lam_cor[2] mff_add_cyl_lam_cor[3] mff_add_cyl_lam_cor[4] mff_add_cyl_lam_cor[5] mff_add_cyl_lam_cor[6] mff_add_cyl_lam_cor[7] mff_add_cyl_lam_cor_out[0] mff_add_cyl_lam_cor_out[1] mff_add_cyl_lam_cor_out[2] mff_add_cyl_lam_cor_out[3] mff_add_cyl_lam_cor_out[4] mff_add_cyl_lam_cor_out[5] mff_add_cyl_lam_cor_out[6] mff_add_cyl_lam_cor_out[7] /end OUT_MEASUREMENT
/end FUNCTION
/begin FUNCTION CYBL_CILC_AI "CILC_AI"
 /begin DEF_CHARACTERISTIC c_fac_mv_ls_up_dyn_lam_cyl_thd c_cl_mmv_lam_cyl_max c_teg_cat_up_mdl_lam_cyl_max c_wgpwm_max_lam_cyl_sel ldpm_n_3_cybl ldpm_n_4_cybl c_amp_lam_cyl_min clf_ls_cbk_ex_lam_cyl_sel_conf ip_mff_lam_cyl_max_eol ip_mff_lam_cyl_min_nom ip_mff_lam_cyl_min_eol ip_mff_lam_cyl_max_nom lc_lam_cyl_ena_cdn_man c_n_lam_cyl_max_nom c_n_lam_cyl_max_eol c_n_lam_cyl_min_eol lc_lam_cyl_sel_ctl_fast_req_man lc_lam_cyl_sel_adj_ofs_rng_req c_n_lam_cyl_min_nom c_n_max_lam_cyl_sel_adj_add c_mff_max_lam_cyl_sel_adj_add ip_iga_bas_crk_cyl_lam /end DEF_CHARACTERISTIC
 /begin OUT_MEASUREMENT lv_lam_cyl_ena_2 pha_shift_cam_ex_1 pha_shift_cam_ex_2 lv_lam_cyl_ena_cyl_bal_dc_2 lv_lam_cyl_ena_cyl_bal_dc_1 lf_ls_cbk_ex_lam_cyl_sel_conf lv_lam_cyl_ena_1 lv_lam_cyl_sel_ctl_fast_req lv_ls_cbk_lam_cyl_sel_conf_vld lv_mff_n_cdn_lam_cyl_ena_1 lv_mff_n_cdn_lam_cyl_ena_2 state_cdn_lam_cyl_sel_adj_rng_1 state_cdn_lam_cyl_sel_adj_rng_2 lv_lam_cyl_sel_adj_ofs_req_1 lv_lam_cyl_sel_adj_ofs_req_2 /end OUT_MEASUREMENT
/end FUNCTION
/begin FUNCTION CYBL_Phase_Shift_Adaptation "Phase_Shift_Adaptation"
 /begin DEF_CHARACTERISTIC c_delta_crk_out_min c_delta_lamb_cyl_sel_cq_ad_thd c_crk_cyl_lam_delta_ini c_ctr_cq_mon_pha_shift_ad_max c_ctr_er_mon_pha_shift_ad_max c_ctr_resp_min_lam_cyl_sel c_ctr_er_resp_min_lam_cyl_sel lc_crk_cyl_lam_delta_out lc_crk_delta_cq_swi c_ctr_cq_min_pha_shift_ad c_crk_chg_fac_max c_delta_crk_out_max c_crk_chg_step c_ctr_resp_cyc_min_lam_cyl_sel c_ctr_cq_fil_fall_min c_ctr_cq_fil_fall_ok c_crk_cyl_lam_ini_red c_nr_seg_ref_cbk_ex_2 c_ctr_sum_fac_cyl_lam_osc_max c_ctr_fac_cyl_lam_dif_absv_min c_ctr_fac_cyl_lam_dif_absv_ok c_fac_cyl_lam_dif_absv_max c_er_absv_grd_rise_thd_crk_chg c_er_absv_grd_fall_thd_crk_chg c_fac_cyl_lam_absv_grd_rise_thd c_fac_cyl_lam_absv_grd_fall_thd c_fac_cyl_lam_max_pha_shift_ad c_fac_cyl_lam_min_pha_shift_ad /end DEF_CHARACTERISTIC
 /begin OUT_MEASUREMENT cyl_lam_psa_1.fac_cyl_lam_absv_sum_grd cyl_lam_psa_1.fac_cyl_lam_absv_sum_pre cyl_lam_psa_1.ctr_cq_mon_pha_shift_ad cyl_lam_psa_1.ctr_er_mon_pha_shift_ad cyl_lam_psa_1.ctr_cq_max_osc cyl_lam_psa_1.ctr_resp_lam_cyl_sel cyl_lam_psa_1.delta_crk_cyl_lam cyl_lam_psa_1.crk_cyl_lam_int cyl_lam_psa_1.crk_cyl_lam_delta_ini cyl_lam_psa_1.crk_chg_fac_pha_shift_ad cyl_lam_psa_1.state_delta_crk_cyl_lam cyl_lam_psa_1.ctr_resp_cyc_lam_cyl_sel cyl_lam_psa_1.ctr_fac_cyl_lam_cor_dif_absv cyl_lam_psa_1.ctr_cq_fil_fall cyl_lam_psa_1.lv_delta_crk_cyl_lam_err cyl_lam_psa_1.lv_fac_cyl_lam_cor_osc cyl_lam_psa_1.lv_fac_cyl_lam_cor_lim_osc cyl_lam_psa_1.lv_er_absv_sum_grd_rise cyl_lam_psa_1.lv_state_delta_crk_wait cyl_lam_psa_1.er_stnd_mmv_dif_bal_absv_sum cyl_lam_psa_1.er_stnd_mmv_dif_absv_sum_pre cyl_lam_psa_1.er_stnd_mmv_dif_absv_sum_grd cyl_lam_psa_2.fac_cyl_lam_absv_sum_grd cyl_lam_psa_2.fac_cyl_lam_absv_sum_pre cyl_lam_psa_2.ctr_cq_mon_pha_shift_ad cyl_lam_psa_2.ctr_er_mon_pha_shift_ad cyl_lam_psa_2.ctr_cq_max_osc cyl_lam_psa_2.ctr_resp_lam_cyl_sel cyl_lam_psa_2.delta_crk_cyl_lam cyl_lam_psa_2.crk_cyl_lam_int cyl_lam_psa_2.crk_cyl_lam_delta_ini cyl_lam_psa_2.crk_chg_fac_pha_shift_ad cyl_lam_psa_2.state_delta_crk_cyl_lam cyl_lam_psa_2.ctr_resp_cyc_lam_cyl_sel cyl_lam_psa_2.ctr_fac_cyl_lam_cor_dif_absv cyl_lam_psa_2.ctr_cq_fil_fall cyl_lam_psa_2.lv_delta_crk_cyl_lam_err cyl_lam_psa_2.lv_fac_cyl_lam_cor_osc cyl_lam_psa_2.lv_fac_cyl_lam_cor_lim_osc cyl_lam_psa_2.lv_er_absv_sum_grd_rise cyl_lam_psa_2.lv_state_delta_crk_wait cyl_lam_psa_2.er_stnd_mmv_dif_bal_absv_sum cyl_lam_psa_2.er_stnd_mmv_dif_absv_sum_pre cyl_lam_psa_2.er_stnd_mmv_dif_absv_sum_grd fac_cyl_lam_cor_save[0] fac_cyl_lam_cor_save[1] fac_cyl_lam_cor_save[2] fac_cyl_lam_cor_save[3] fac_cyl_lam_cor_save[4] fac_cyl_lam_cor_save[5] fac_cyl_lam_cor_save[6] fac_cyl_lam_cor_save[7] lv_fac_cyl_lam_cor_osc_max_thd[0] lv_fac_cyl_lam_cor_osc_max_thd[1] lv_fac_cyl_lam_cor_osc_max_thd[2] lv_fac_cyl_lam_cor_osc_max_thd[3] lv_fac_cyl_lam_cor_osc_max_thd[4] lv_fac_cyl_lam_cor_osc_max_thd[5] lv_fac_cyl_lam_cor_osc_max_thd[6] lv_fac_cyl_lam_cor_osc_max_thd[7] lv_fac_cyl_lam_cor_osc_min_thd[0] lv_fac_cyl_lam_cor_osc_min_thd[1] lv_fac_cyl_lam_cor_osc_min_thd[2] lv_fac_cyl_lam_cor_osc_min_thd[3] lv_fac_cyl_lam_cor_osc_min_thd[4] lv_fac_cyl_lam_cor_osc_min_thd[5] lv_fac_cyl_lam_cor_osc_min_thd[6] lv_fac_cyl_lam_cor_osc_min_thd[7] ctr_sum_fac_cyl_lam_cor_osc[0] ctr_sum_fac_cyl_lam_cor_osc[1] ctr_sum_fac_cyl_lam_cor_osc[2] ctr_sum_fac_cyl_lam_cor_osc[3] ctr_sum_fac_cyl_lam_cor_osc[4] ctr_sum_fac_cyl_lam_cor_osc[5] ctr_sum_fac_cyl_lam_cor_osc[6] ctr_sum_fac_cyl_lam_cor_osc[7] /end OUT_MEASUREMENT
/end FUNCTION
/begin FUNCTION CYBL_Dect_of_Lim_Dyn_Cyl_Lam "Dect_of_Lim_Dyn_Cyl_Lam"
 /begin DEF_CHARACTERISTIC c_n_dyw_ldc_lam_cyl_sel c_maf_dyw_ldc_lam_cyl_sel c_fac_lam_dyw_ldc_lam_cyl_sel c_maf_int_ldc_lam_cyl_sel /end DEF_CHARACTERISTIC
 /begin OUT_MEASUREMENT lv_lam_cyl_sel_ldc[0] lv_lam_cyl_sel_ldc[1] fac_lam_mv_ofs_ldc_lam_cyl_sel[0] fac_lam_mv_ofs_ldc_lam_cyl_sel[1] maf_int_ldc_lam_cyl_sel[0] maf_int_ldc_lam_cyl_sel[1] maf_ofs_ldc_lam_cyl_sel n_ofs_ldc_lam_cyl_sel /end OUT_MEASUREMENT
/end FUNCTION
/begin FUNCTION C_9_CYBL "C_9_CYBL"
 /begin SUB_FUNCTION CYBL_Cyl_Bal_Manager CYBL_Cyl_Bal_Manager_AI CYBL_Cyl_Bal_Coord_at_EOL CYBL_Cyl_Bal_Coord_at_DC /end SUB_FUNCTION
/end FUNCTION
/begin FUNCTION CYBL_Cyl_Bal_Manager "Cyl_Bal_Manager"
 /begin DEF_CHARACTERISTIC c_tco_max_ti_er_bal c_tco_min_fac_ti_ad_er_bal c_er_stnd_mmv_max_ti_er_bal c_er_std_mmv_max_ti_er_bal c_tco_min_ti_er_bal c_mff_sp_max_fac_ti_er_bal c_mff_sp_min_fac_ti_ad_er_bal c_mff_sp_max_fac_ti_ad_er_bal c_mff_sp_min_fac_ti_er_bal c_n_32_min_fac_ti_er_bal c_n_32_max_fac_ti_er_bal c_n_32_max_fac_ti_ad_er_bal c_n_32_min_fac_ti_ad_er_bal ldp_n_32_ip_ctr_ti_er_bal_ini ip_ctr_ti_er_bal_ena_ini lc_mff_add_er_bal_ena c_mff_sp_max_mff_add_ad_er_bal c_mff_sp_max_mff_add_er_bal c_mff_sp_min_mff_add_ad_er_bal c_mff_sp_min_mff_add_er_bal c_n_32_max_mff_add_ad_er_bal c_n_32_max_mff_add_er_bal c_n_32_min_mff_add_ad_er_bal c_n_32_min_mff_add_er_bal c_tco_min_mff_add_ad_er_bal /end DEF_CHARACTERISTIC
 /begin OUT_MEASUREMENT lv_ti_er_bal_ena lv_fac_ti_er_bal_ena lv_fac_ti_ad_er_bal_ena ctr_ti_er_bal_ena lv_er_stnd_mmv_max_ti_er_bal lv_er_std_mmv_max_ti_er_bal state_ti_er_bal state_ctl_ti_er_bal lv_mff_add_ad_er_bal_ena lv_mff_add_er_bal_ena /end OUT_MEASUREMENT
/end FUNCTION
/begin FUNCTION CYBL_Cyl_Bal_Manager_AI "Cyl_Bal_Manager_AI"
 /begin DEF_CHARACTERISTIC c_tqi_min_ti_er_bal c_tqi_max_ti_er_bal c_t_ast_min_ti_er_bal lc_ti_er_bal_stop_man c_er_stnd_er_bal_act_man c_drv1_er_bal_act_man c_ti_er_bal_act_man /end DEF_CHARACTERISTIC
 /begin OUT_MEASUREMENT lv_er_stnd_er_bal_act lv_drv1_er_bal_act lv_ti_er_bal_act lv_ti_cyl_bal_er_act lv_ti_cyl_bal_lam_act lv_mff_cor_er_bal_ena_ext lv_mff_add_ad_er_bal_ena_ext lv_mff_fac_ad_er_bal_ena_ext /end OUT_MEASUREMENT
/end FUNCTION
/begin FUNCTION CYBL_Cyl_Bal_Coord_at_EOL "Cyl_Bal_Coord_at_EOL"
 /begin DEF_CHARACTERISTIC c_fac_l_lam_adj_dif_cyl_bal c_fac_mff_lam_adj_dif_cyl_bal c_t_min_cyl_bal_er_ad_dyn c_t_max_cyl_bal_er_ad c_t_dec_cyl_bal_er_ad_dyn c_t_min_cyl_bal_lam_sel_ad_cold c_t_dec_cyl_bal_lam_sel_cbk_ad c_t_max_cyl_bal_lam_ad c_ctr_min_cyl_bal_lam_ad_fac c_ctr_min_cyl_bal_lam_ad_add c_ctr_dec_cyl_bal_lam_cbk_ad lc_cyl_bal_ad_eol_rst ldp_n_32_ip_er_stnd_mmv_dif_dyw ldp_tco_st_ip_t_ast_max_wg_open c_t_min_cyl_bal_lam_sel_ad_hot c_tco_max_cyl_bal_wg_open c_cyl_bal_ad_eol_rst ip_er_stnd_mmv_dif_bal_dyw ip_t_ast_max_cyl_bal_wg_open c_t_max_cyl_bal_lam_sel_ad_cold c_t_max_cyl_bal_lam_sel_ad_hot c_fac_cyl_lam_absv_sum_cyl_bal c_cyl_bal_lam_ad_eol_conf c_cyl_bal_lam_sel_hot_eol_conf lc_cyl_bal_cord_eol_stop_man /end DEF_CHARACTERISTIC
 /begin OUT_MEASUREMENT lv_cyl_bal_lam_ad_eol lv_cyl_bal_er_ad_fac_eol lv_cyl_bal_er_ad_add_eol lv_cyl_bal_lam_sel_ad_cold_eol lv_cyl_bal_lam_sel_ad_hot_eol t_cyl_bal_er_ad t_cyl_bal_lam_sel_ad t_cyl_bal_lam_ad t_cyl_bal_er_ad_dyw er_stnd_mmv_dif_bal_dyw er_stnd_mmv_dif_bal_max_dyw er_stnd_mmv_dif_bal_min_dyw t_cyl_bal_lam_sel_cbk_ad[0] t_cyl_bal_lam_sel_cbk_ad[1] lv_state_cyl_bal_sel_chg_ad lv_state_cyl_bal_sel_chg_wait[0] lv_state_cyl_bal_sel_chg_wait[1] lv_cyl_bal_lam_sel_ad_cold[0] lv_cyl_bal_lam_sel_ad_cold[1] ctr_cyl_bal_lam_cbk_ad[0] ctr_cyl_bal_lam_cbk_ad[1] lv_state_cyl_bal_lam_chg_ad lv_state_cyl_bal_lam_chg_wait[0] lv_state_cyl_bal_lam_chg_wait[1] lv_cyl_bal_lam_ad_fac[0] lv_cyl_bal_lam_ad_fac[1] lv_cyl_bal_lam_ad_add[0] lv_cyl_bal_lam_ad_add[1] lv_cyl_bal_ad_wg_open_req_eol[0] lv_cyl_bal_ad_wg_open_req_eol[1] state_cyl_bal_er_ad_eol state_cyl_bal_lam_sel_ad_eol state_cyl_bal_lam_ad_eol lv_cyl_bal_lam_sel_ad_rng_h[0] lv_cyl_bal_lam_sel_ad_rng_h[1] lv_cyl_bal_lam_sel_ad_rng_l[0] lv_cyl_bal_lam_sel_ad_rng_l[1] /end OUT_MEASUREMENT
/end FUNCTION
/end MODULE
/end PROJECT
