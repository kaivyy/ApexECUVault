ASAP2_VERSION 1 41
/begin PROJECT MSD85 "Spray Guided DI-System with Piezo Injectors for 8-Cylinder"
/begin HEADER "_default_HeaderComment" PROJECT_NO _91 /end HEADER
/begin MODULE _default_ModuleName "_default_ModuleLongIdentifier"
/begin MOD_COMMON "_default_ModCommonComment" DEPOSIT ABSOLUTE BYTE_ORDER MSB_LAST ALIGNMENT_BYTE 1 ALIGNMENT_WORD 2 ALIGNMENT_LONG 2 ALIGNMENT_FLOAT32_IEEE 2 ALIGNMENT_FLOAT64_IEEE 4 /end MOD_COMMON
/begin AXIS_PTS ldpm_temp_ini_ls_up_1_egcp "" 0xa0801000 online_dummy _REC_AXS_20_u2 4095.9375 _CNV_A_R_EGCP_LINEA_299_CM 6 -2048. 2047.9375 FORMAT "%10.4" /end AXIS_PTS
/begin AXIS_PTS ldpm_maf_kgh_3_egcp "" 0xa0800f84 maf_kgh _REC_AXS_20_u2 2047.96875 _CNV_A_R_LINEAR_____215_CM 6 0. 2047.96875 FORMAT "%10.5" /end AXIS_PTS
/begin CHARACTERISTIC c_lshpwm_min_lsh_down "Minimum permitted heater effective voltage PWM for downstream LSH OBDII diagnosis " VALUE 0xa0801493 _REC_VAL_20_u1 99.609375 _CNV_A_R_LINEAR_____5_CM 0. 99.609375 DISPLAY_IDENTIFIER C_LSHPWM_MIN_LSH_DOWN FORMAT "%9.6" /end CHARACTERISTIC
/begin CHARACTERISTIC c_lshpwm_max_lsh_down "Maximum permitted heater effective voltage PWM for downstream LSH OBDII diagnosis " VALUE 0xa080148f _REC_VAL_20_u1 99.609375 _CNV_A_R_LINEAR_____5_CM 0. 99.609375 DISPLAY_IDENTIFIER C_LSHPWM_MAX_LSH_DOWN FORMAT "%9.6" /end CHARACTERISTIC
/begin CHARACTERISTIC c_temp_sp_obd_lsh_down "Set temperature for downstream LSH operation used to generate power integral" VALUE 0xa080160a _REC_VAL_20_u2 2047.9375 _CNV_A_R_LINEAR_____214_CM -273.15 1774.7875 DISPLAY_IDENTIFIER C_TEMP_SP_OBD_LSH_DOWN FORMAT "%9.4" /end CHARACTERISTIC
/begin AXIS_PTS ldp_r_it_ls_down_new_lsh_down "" 0xa0800e90 online_dummy _REC_AXS_20_u2 65535. _CNV_A_R_LINEAR_____318_CM 4 0. 65535. FORMAT "%5.0" /end AXIS_PTS
/begin CHARACTERISTIC ip_fac_maf_obd_lsh_down "Factor reflecting forced convection influence of cooling area, gas velocity and heat transfer coefficient" CURVE 0xa080113c _REC_CUR_20_u1_u2 15.9375 _CNV_A_R_EGCP_LINEA_319_CM 0. 15.9375 DISPLAY_IDENTIFIER IP_FAC_MAF_OBD_LSH_DOWN
 /begin AXIS_DESCR COM_AXIS maf_kgh _CNV_A_R_LINEAR_____215_CM 6 0. 2047.96875 FORMAT "%10.5" AXIS_PTS_REF ldpm_maf_kgh_3_egcp /end AXIS_DESCR
/end CHARACTERISTIC
/begin CHARACTERISTIC ip_r_it_thd_obd_lsh_down "Internal resistance threshold, when exceeded, heater is determined to be defective for current diagnosis cycle" CURVE 0xa08012cc _REC_CUR_20_u2_u2 65535. _CNV_A_R_LINEAR_____318_CM 0. 65535. DISPLAY_IDENTIFIER IP_R_IT_THD_OBD_LSH_DOWN FORMAT "%5.0"
 /begin AXIS_DESCR COM_AXIS online_dummy _CNV_A_R_LINEAR_____318_CM 4 0. 65535. FORMAT "%5.0" AXIS_PTS_REF ldp_r_it_ls_down_new_lsh_down /end AXIS_DESCR
/end CHARACTERISTIC
/begin MEASUREMENT lv_err_obd_lsh_down_2 "Boolean flag indicating that diagnosis has been completed" UBYTE _CNV_S_2_RANGE__0___1_CM 1 100. 0. 1. DISPLAY_IDENTIFIER LV_ERR_OBD_LSH_DOWN[2] ECU_ADDRESS 0xd0008011 BIT_MASK 0x1 /end MEASUREMENT
/begin MEASUREMENT lv_err_obd_lsh_down_1 "Boolean flag indicating that diagnosis has been completed" UBYTE _CNV_S_2_RANGE__0___1_CM 1 100. 0. 1. DISPLAY_IDENTIFIER LV_ERR_OBD_LSH_DOWN[1] ECU_ADDRESS 0xd0007ff6 BIT_MASK 0x1 /end MEASUREMENT
/begin CHARACTERISTIC c_teg_dyn_max_obd_lsh_down "Temperature threshold under which downstream LSH OBDII diagnosis activated" VALUE 0xa08015ec _REC_VAL_20_u2 2047.9375 _CNV_A_R_LINEAR_____214_CM -273.15 1774.7875 DISPLAY_IDENTIFIER C_TEG_DYN_MAX_OBD_LSH_DOWN FORMAT "%9.4" /end CHARACTERISTIC
/begin CHARACTERISTIC c_t_dly_obd_lsh_down "Minimum delay prior to checking status of OBDI heater / signal faults" VALUE 0xa080156c _REC_VAL_20_u1 255. _CNV_A_R_LINEAR_____36_CM 0. 255. DISPLAY_IDENTIFIER C_T_DLY_OBD_LSH_DOWN FORMAT "%3.0" /end CHARACTERISTIC
/begin CHARACTERISTIC c_t_dly_obd_lsh_down_eol "Minimum delay prior to checking status of OBDI heater / signal faults when EOL test required" VALUE 0xa080156d _REC_VAL_20_u1 255. _CNV_A_R_LINEAR_____36_CM 0. 255. DISPLAY_IDENTIFIER C_T_DLY_OBD_LSH_DOWN_EOL FORMAT "%3.0" /end CHARACTERISTIC
/begin CHARACTERISTIC c_pow_int_min_obd_lsh_down "Measure of minimum required cooling energy required at downstream sensor prior to checking Ri threshold" VALUE 0xa080151c _REC_VAL_20_u2 65535. _CNV_A_R_LINEAR_____320_CM 0. 65535. DISPLAY_IDENTIFIER C_POW_INT_MIN_OBD_LSH_DOWN FORMAT "%5.0" /end CHARACTERISTIC
/begin CHARACTERISTIC c_pow_int_min_obd_lsh_down_eol "Measure of minimum required cooling energy required at downstream sensor prior to checking Ri threshold when EOL test required" VALUE 0xa080151e _REC_VAL_20_u2 65535. _CNV_A_R_LINEAR_____320_CM 0. 65535. DISPLAY_IDENTIFIER C_POW_INT_MIN_OBD_LSH_DOWN_EOL FORMAT "%5.0" /end CHARACTERISTIC
/begin CHARACTERISTIC c_tcc_thd_err_obd_lsh_down "Fault detection threshold, when exceeded, heater is determined to be defective during driving cycle" VALUE 0xa08015d8 _REC_VAL_20_u2 1023. _CNV_A_R_LINEAR_____0_CM 0. 1023. DISPLAY_IDENTIFIER C_TCC_THD_ERR_OBD_LSH_DOWN FORMAT "%4.0" /end CHARACTERISTIC
/begin CHARACTERISTIC c_tcc_thd_err_obd_lsh_down_eol "Fault detection threshold, when exceeded, heater is determined to be defective during driving cycle when EOL test required" VALUE 0xa08015da _REC_VAL_20_u2 1023. _CNV_A_R_LINEAR_____0_CM 0. 1023. DISPLAY_IDENTIFIER C_TCC_THD_ERR_OBD_LSH_DOWN_EOL FORMAT "%4.0" /end CHARACTERISTIC
/begin CHARACTERISTIC c_tcc_thd_obd_lsh_down "Number of valid downstream LSH OBDII diagnosis cycles over which statistic evaluation to be carried out" VALUE 0xa08015de _REC_VAL_20_u2 1023. _CNV_A_R_LINEAR_____0_CM 0. 1023. DISPLAY_IDENTIFIER C_TCC_THD_OBD_LSH_DOWN FORMAT "%4.0" /end CHARACTERISTIC
/begin CHARACTERISTIC c_tcc_thd_obd_lsh_down_eol "Number of valid downstream LSH OBDII diagnosis cycles over which statistic evaluation to be carried out when EOL test required" VALUE 0xa08015e0 _REC_VAL_20_u2 1023. _CNV_A_R_LINEAR_____0_CM 0. 1023. DISPLAY_IDENTIFIER C_TCC_THD_OBD_LSH_DOWN_EOL FORMAT "%4.0" /end CHARACTERISTIC
/begin CHARACTERISTIC lc_diag_eol_end_lsh_down[0] "Locigal calibration data to enforce end of diagnosis when EOL test has passed" VALUE 0xa08016d0 _REC_VAL_20_u1 1. _CNV_A_R_LINEAR_____0_CM 0. 1. DISPLAY_IDENTIFIER LC_DIAG_EOL_END_LSH_DOWN[1] FORMAT "%1.0" /end CHARACTERISTIC
/begin CHARACTERISTIC lc_diag_eol_end_lsh_down[1] "Locigal calibration data to enforce end of diagnosis when EOL test has passed" VALUE 0xa08016d1 _REC_VAL_20_u1 1. _CNV_A_R_LINEAR_____0_CM 0. 1. DISPLAY_IDENTIFIER LC_DIAG_EOL_END_LSH_DOWN[2] FORMAT "%1.0" /end CHARACTERISTIC
/begin CHARACTERISTIC c_tco_min_obd2_lsh_down "TCO-threshold for OBD2 heater diagnosis downstream" VALUE 0xa08015e7 _REC_VAL_20_u1 190.5 _CNV_A_R_LINEAR_____17_CM -48. 142.5 DISPLAY_IDENTIFIER C_TCO_MIN_OBD2_LSH_DOWN FORMAT "%5.1" /end CHARACTERISTIC
/begin CHARACTERISTIC c_lshpwm_min_lsh_up "Minimum permitted heater effective voltage PWM for upstream LSH OBD2 diagnosis" VALUE 0xa0801494 _REC_VAL_20_u1 99.609375 _CNV_A_R_LINEAR_____5_CM 0. 99.609375 DISPLAY_IDENTIFIER C_LSHPWM_MIN_LSH_UP FORMAT "%9.6" /end CHARACTERISTIC
/begin CHARACTERISTIC c_ttip_min_obd_lsh_up "Lower diagnosis threshold for oxygen sensor ceramic temperature" VALUE 0xa0801620 _REC_VAL_20_s2 4095.9375 _CNV_A_R_LINEAR_____130_CM -2048. 2047.9375 DISPLAY_IDENTIFIER C_TTIP_MIN_OBD_LSH_UP FORMAT "%10.4" /end CHARACTERISTIC
/begin CHARACTERISTIC c_ttip_max_obd_lsh_up "Upper diagnosis threshold for oxygen sensor ceramic temperature" VALUE 0xa0801616 _REC_VAL_20_s2 4095.9375 _CNV_A_R_LINEAR_____130_CM -2048. 2047.9375 DISPLAY_IDENTIFIER C_TTIP_MAX_OBD_LSH_UP FORMAT "%10.4" /end CHARACTERISTIC
/begin CHARACTERISTIC c_tcc_thd_err_obd_lsh_up "Fault detection threshold, when exceeded, heater is determined to be defective during driving cycle" VALUE 0xa08015dc _REC_VAL_20_u2 65535. _CNV_A_R_LINEAR_____0_CM 0. 65535. DISPLAY_IDENTIFIER C_TCC_THD_ERR_OBD_LSH_UP FORMAT "%5.0" /end CHARACTERISTIC
/begin CHARACTERISTIC lc_obd_rep_lsh_up "Logical constant permitting dignosis to be repeated within onde driving cycle" VALUE 0xa0801717 _REC_VAL_20_u1 1. _CNV_A_R_LINEAR_____0_CM 0. 1. DISPLAY_IDENTIFIER LC_OBD_REP_LSH_UP FORMAT "%1.0" /end CHARACTERISTIC
/begin CHARACTERISTIC ip_t_dly_ls_up_ready_obd_lsh_up "Time threshold after heater management start where fault detected, if no full operative readiness observed" CURVE 0xa08012d4 _REC_CUR_20_u2_u2 6553.5 _CNV_A_R_LINEAR_____4_CM 0. 6553.5 DISPLAY_IDENTIFIER IP_T_DLY_LS_UP_READY_OBD_LSH_UP FORMAT "%6.1"
 /begin AXIS_DESCR COM_AXIS online_dummy _CNV_A_R_EGCP_LINEA_299_CM 6 -2048. 2047.9375 FORMAT "%10.4" AXIS_PTS_REF ldpm_temp_ini_ls_up_1_egcp /end AXIS_DESCR
/end CHARACTERISTIC
/begin CHARACTERISTIC lc_obd_lsh_up "Logical constant permitting dignosis to be carried out" VALUE 0xa0801716 _REC_VAL_20_u1 1. _CNV_A_R_LINEAR_____0_CM 0. 1. DISPLAY_IDENTIFIER LC_OBD_LSH_UP FORMAT "%1.0" /end CHARACTERISTIC
/begin CHARACTERISTIC c_t_dly_pow_ctl_obd_lsh_up "Minimum delay prior to checking status of OBD1 heater /signal faults" VALUE 0xa0801570 _REC_VAL_20_u2 6553.5 _CNV_A_R_LINEAR_____4_CM 0. 6553.5 DISPLAY_IDENTIFIER C_T_DLY_POW_CTL_OBD_LSH_UP FORMAT "%6.1" /end CHARACTERISTIC
/begin CHARACTERISTIC c_t_dly_ttip_mes_obd_lsh_up "Time delay after TTIP_ERR_MES symptom valid to set error flag" VALUE 0xa0801576 _REC_VAL_20_u2 6553.5 _CNV_A_R_LINEAR_____4_CM 0. 6553.5 DISPLAY_IDENTIFIER C_T_DLY_TTIP_MES_OBD_LSH_UP FORMAT "%6.1" /end CHARACTERISTIC
/begin CHARACTERISTIC c_t_dly_ttip_res_obd_lsh_up "Time delay to reset TTIP_ERR_MES timer" VALUE 0xa0801578 _REC_VAL_20_u2 6553.5 _CNV_A_R_LINEAR_____4_CM 0. 6553.5 DISPLAY_IDENTIFIER C_T_DLY_TTIP_RES_OBD_LSH_UP FORMAT "%6.1" /end CHARACTERISTIC
/begin CHARACTERISTIC c_teg_dyn_min_obd_lsh_up "Minimum exhaust temperature to activate oxygen sensor ceramic temperature diagnosis" VALUE 0xa08015f6 _REC_VAL_20_u2 2047.9375 _CNV_A_R_LINEAR_____214_CM -273.15 1774.7875 DISPLAY_IDENTIFIER C_TEG_DYN_MIN_OBD_LSH_UP FORMAT "%9.4" /end CHARACTERISTIC
/begin MEASUREMENT lv_err_obd_vld_lsh_up_1 "Boolean flag indicating the validation of correspondent symptom (transmitted to the error management)" UBYTE _CNV_S_2_RANGE__0___1_CM 1 100. 0. 1. DISPLAY_IDENTIFIER LV_ERR_OBD_VLD_LSH_UP[1] ECU_ADDRESS 0xd0007ff9 BIT_MASK 0x1 /end MEASUREMENT
/begin MEASUREMENT lv_err_obd_vld_lsh_up_2 "Boolean flag indicating the validation of correspondent symptom (transmitted to the error management)" UBYTE _CNV_S_2_RANGE__0___1_CM 1 100. 0. 1. DISPLAY_IDENTIFIER LV_ERR_OBD_VLD_LSH_UP[2] ECU_ADDRESS 0xd0008014 BIT_MASK 0x1 /end MEASUREMENT
/begin MEASUREMENT lv_err_ttip_mes_lsh_up_1 "Boolean flag indicating the validation of general tip temperature plausibility symptom" UBYTE _CNV_S_2_RANGE__0___1_CM 1 100. 0. 1. DISPLAY_IDENTIFIER LV_ERR_TTIP_MES_LSH_UP[1] ECU_ADDRESS 0xd0008000 BIT_MASK 0x1 /end MEASUREMENT
/begin MEASUREMENT lv_err_ttip_mes_lsh_up_2 "Boolean flag indicating the validation of general tip temperature plausibility symptom" UBYTE _CNV_S_2_RANGE__0___1_CM 1 100. 0. 1. DISPLAY_IDENTIFIER LV_ERR_TTIP_MES_LSH_UP[2] ECU_ADDRESS 0xd000801b BIT_MASK 0x1 /end MEASUREMENT
/begin CHARACTERISTIC c_tcc_err_inc_obd_lsh_up "Increment of heater fault counter in case that Ttip is below diagnostic threshold" VALUE 0xa08015d5 _REC_VAL_20_u1 255. _CNV_A_R_LINEAR_____0_CM 0. 255. DISPLAY_IDENTIFIER C_TCC_ERR_INC_OBD_LSH_UP FORMAT "%3.0" /end CHARACTERISTIC
/begin CHARACTERISTIC c_tcc_err_inc_obd_lsh_up_fast "Fast increment of heater fault counter in case that Ttip is below IP control activation limit" VALUE 0xa08015d6 _REC_VAL_20_u1 255. _CNV_A_R_LINEAR_____0_CM 0. 255. DISPLAY_IDENTIFIER C_TCC_ERR_INC_OBD_LSH_UP_FAST FORMAT "%3.0" /end CHARACTERISTIC
/begin MEASUREMENT egcp[0].egcp_struct_outdglshi0.lv_inh_diag_lsh_up "Inhibit flag for upstream oxygen sensor heater OBDI diagnosis" UBYTE _CNV_S_2_RANGE__0___1_CM 1 100. 0. 1. DISPLAY_IDENTIFIER LV_INH_DIAG_LSH_UP[1] ECU_ADDRESS 0xd00056d0 BIT_MASK 0x1 /end MEASUREMENT
/begin MEASUREMENT egcp[0].egcp_struct_outdglshd0.err_diag_lsh_down "raw value of error symptom for downstream heater diagnosis OBD I" UBYTE _CNV_A_R_LINEAR_____0_CM 1 100. 0. 7. DISPLAY_IDENTIFIER ERR_DIAG_LSH_DOWN[1] ECU_ADDRESS 0xd00056d2 FORMAT "%3.0" /end MEASUREMENT
/begin MEASUREMENT egcp[0].egcp_struct_outdglshd0.cdn_diag_lsh_down "Diagnosis condition for each symptom of downstream heater diagnosis OBD I" UBYTE _CNV_A_R_LINEAR_____0_CM 1 100. 0. 7. DISPLAY_IDENTIFIER CDN_DIAG_LSH_DOWN[1] ECU_ADDRESS 0xd00056d3 FORMAT "%3.0" /end MEASUREMENT
/begin MEASUREMENT egcp[0].egcp_struct_outdglshdi0.lv_inh_diag_lsh_down "Inhibit flag for downstream oxygen sensor heater OBDI diagnosis" UBYTE _CNV_S_2_RANGE__0___1_CM 1 100. 0. 1. DISPLAY_IDENTIFIER LV_INH_DIAG_LSH_DOWN[1] ECU_ADDRESS 0xd00056d4 BIT_MASK 0x1 /end MEASUREMENT
/begin MEASUREMENT egcp[0].egcp_struct_pladglsd2.maf_int_puc_not_ls_down_diag "MAF integral out of PUC in case of certain load threshold exceeded" UWORD _CNV_A_R_LINEAR_____314_CM 1 100. 0. 2912.66666666667 DISPLAY_IDENTIFIER MAF_INT_PUC_NOT_LS_DOWN_DIAG[1] ECU_ADDRESS 0xd00056d8 FORMAT "%7.2" /end MEASUREMENT
/begin MEASUREMENT egcp[0].egcp_struct_pladglsd2.maf_int_fl "integral of air mass flow  while FL active" UWORD _CNV_A_R_LINEAR_____287_CM 1 100. 0. 1820.41666666667 DISPLAY_IDENTIFIER MAF_INT_FL[1] ECU_ADDRESS 0xd00056da FORMAT "%7.2" /end MEASUREMENT
/begin MEASUREMENT egcp[0].egcp_struct_pladglsd2.vls_down_puc_ok "Last VLS_DOWN value satisfying PUC plausibility" UWORD _CNV_A_R_LINEAR_____2_CM 1 100. 0. 4.9951171875 DISPLAY_IDENTIFIER VLS_DOWN_PUC_OK[1] ECU_ADDRESS 0xd00056dc FORMAT "%5.3" /end MEASUREMENT
/begin MEASUREMENT egcp[0].egcp_struct_pladglsd2.vls_down_puc_err "Last VLS_DOWN value not plausible for PUC conditions" UWORD _CNV_A_R_LINEAR_____2_CM 1 100. 0. 4.9951171875 DISPLAY_IDENTIFIER VLS_DOWN_PUC_ERR[1] ECU_ADDRESS 0xd00056de FORMAT "%5.3" /end MEASUREMENT
/begin MEASUREMENT egcp[0].egcp_struct_pladglsd2.vls_down_puc_save "Mode 6 value describing last VLS_DOWN PUC plausibility result" UWORD _CNV_A_R_LINEAR_____2_CM 1 100. 0. 4.9951171875 DISPLAY_IDENTIFIER VLS_DOWN_PUC_SAVE[1] ECU_ADDRESS 0xd00056e0 FORMAT "%5.3" /end MEASUREMENT
/begin MEASUREMENT egcp[0].egcp_struct_pladglsd2.lv_err_plaus_ls_down "Boolean flag, error plausibility check on downstream oxygen sensor signal" UBYTE _CNV_S_2_RANGE__0___1_CM 1 100. 0. 1. DISPLAY_IDENTIFIER LV_ERR_PLAUS_LS_DOWN[1] ECU_ADDRESS 0xd00056e2 BIT_MASK 0x1 /end MEASUREMENT
/begin MEASUREMENT egcp[0].egcp_struct_pladglsd2.lv_diag_cdn_plaus_ls_down "Boolean flag, plausibility check on downstream oxygen sensor signal possible" UBYTE _CNV_S_2_RANGE__0___1_CM 1 100. 0. 1. DISPLAY_IDENTIFIER LV_DIAG_CDN_PLAUS_LS_DOWN[1] ECU_ADDRESS 0xd00056e3 BIT_MASK 0x1 /end MEASUREMENT
/begin MEASUREMENT egcp[0].egcp_struct_pladglsd2.lv_diag_puc_chg_ls_down "reminder flag for fuel cut off was active" UBYTE _CNV_S_2_RANGE__0___1_CM 1 100. 0. 1. DISPLAY_IDENTIFIER LV_DIAG_PUC_CHG_LS_DOWN[1] ECU_ADDRESS 0xd00056e4 BIT_MASK 0x1 /end MEASUREMENT
/begin MEASUREMENT egcp[0].egcp_struct_pladgspi0.ctr_err_save_diag_lsl_up_if "Number of communication errors during the WRAF sensor controller initialization " UBYTE _CNV_A_R_LINEAR_____0_CM 1 100. 0. 255. DISPLAY_IDENTIFIER CTR_ERR_SAVE_DIAG_LSL_UP_IF[1] ECU_ADDRESS 0xd00056e8 FORMAT "%3.0" /end MEASUREMENT
/begin MEASUREMENT egcp[0].egcp_struct_pladgspi0.ctr_delta_lsl_up_if "Increment of error counter since initialization respectively since last increment of error counter" UBYTE _CNV_A_R_LINEAR_____0_CM 1 100. 0. 255. DISPLAY_IDENTIFIER CTR_DELTA_LSL_UP_IF[1] ECU_ADDRESS 0xd00056e9 FORMAT "%3.0" /end MEASUREMENT
/begin MEASUREMENT egcp[0].egcp_struct_pladgspii0.lv_inh_diag_lsl_up_if "Inhibit diagnosis" UBYTE _CNV_S_2_RANGE__0___1_CM 1 100. 0. 1. DISPLAY_IDENTIFIER LV_INH_DIAG_LSL_UP_IF[1] ECU_ADDRESS 0xd00056ea BIT_MASK 0x1 /end MEASUREMENT
/begin MEASUREMENT egcp[0].egcp_struct_sigdglsd1.t_act_pls_diag_scg_ls_down "Delay time for final diagnosis activation " UWORD _CNV_A_R_LINEAR_____4_CM 1 100. 0. 6553.5 DISPLAY_IDENTIFIER T_ACT_PLS_DIAG_SCG_LS_DOWN[1] ECU_ADDRESS 0xd000577c FORMAT "%6.1" /end MEASUREMENT
/begin MEASUREMENT egcp[0].egcp_struct_sigdglsd1.t_act_pls_diag_oc_ls_down "Delay time for final diagnosis activation " UWORD _CNV_A_R_LINEAR_____4_CM 1 100. 0. 6553.5 DISPLAY_IDENTIFIER T_ACT_PLS_DIAG_OC_LS_DOWN[1] ECU_ADDRESS 0xd000577e FORMAT "%6.1" /end MEASUREMENT
/begin MEASUREMENT egcp[0].egcp_struct_sigdglsd1.t_cdn_diag_oc_ls_down "Detection time for status OC before diagnosis" UWORD _CNV_A_R_LINEAR_____4_CM 1 100. 0. 6553.5 DISPLAY_IDENTIFIER T_CDN_DIAG_OC_LS_DOWN[1] ECU_ADDRESS 0xd0005780 FORMAT "%6.1" /end MEASUREMENT
/begin MEASUREMENT egcp[0].egcp_struct_sigdglsd1.ctr_r_upd_diag_scg_ls_down "Value of handshake counter for last valid resistance value used for short circuit to ground diagnosis" UWORD _CNV_A_R_LINEAR_____0_CM 1 100. 0. 65535. DISPLAY_IDENTIFIER CTR_R_UPD_DIAG_SCG_LS_DOWN[1] ECU_ADDRESS 0xd0005782 FORMAT "%5.0" /end MEASUREMENT
/begin MEASUREMENT egcp[0].egcp_struct_sigdglsd1.ctr_r_upd_diag_oc_ls_down "Value of handshake counter for last valid resistance value used for diagnosis" UWORD _CNV_A_R_LINEAR_____0_CM 1 100. 0. 65535. DISPLAY_IDENTIFIER CTR_R_UPD_DIAG_OC_LS_DOWN[1] ECU_ADDRESS 0xd0005784 FORMAT "%5.0" /end MEASUREMENT
/begin MEASUREMENT egcp[0].egcp_struct_sigdglsd1.ctr_sym_diag_scg_ls_down "Detection time for SCG " UBYTE _CNV_A_R_LINEAR_____0_CM 1 100. 0. 255. DISPLAY_IDENTIFIER CTR_SYM_DIAG_SCG_LS_DOWN[1] ECU_ADDRESS 0xd0005786 FORMAT "%3.0" /end MEASUREMENT
/begin MEASUREMENT egcp[0].egcp_struct_sigdglsd1.lv_err_el_ls_down "Boolean error flag, electrical fault currently present on downstream oxygen sensor signal" UBYTE _CNV_S_2_RANGE__0___1_CM 1 100. 0. 1. DISPLAY_IDENTIFIER LV_ERR_EL_LS_DOWN[1] ECU_ADDRESS 0xd0005787 BIT_MASK 0x1 /end MEASUREMENT
/begin MEASUREMENT egcp[0].egcp_struct_sigdglsd1.lv_diag_act_req_ls_down "Request for starting the downstream sensor active plausibility check" UBYTE _CNV_S_2_RANGE__0___1_CM 1 100. 0. 1. DISPLAY_IDENTIFIER LV_DIAG_ACT_REQ_LS_DOWN[1] ECU_ADDRESS 0xd0005788 BIT_MASK 0x1 /end MEASUREMENT
/begin MEASUREMENT egcp[0].egcp_struct_sigdglsd1.lv_r_it_vld_diag_oc_ls_down "Valid conditions of resistance of downstream oxygen sensor open circuit diagnosis" UBYTE _CNV_S_2_RANGE__0___1_CM 1 100. 0. 1. DISPLAY_IDENTIFIER LV_R_IT_VLD_DIAG_OC_LS_DOWN[1] ECU_ADDRESS 0xd0005789 BIT_MASK 0x1 /end MEASUREMENT
/begin MEASUREMENT egcp[0].egcp_struct_sigdglsd1.lv_t_cdn_diag_oc_ls_down "Boolean error flag, short to plus fault currently present on downstream oxygen sensor signal" UBYTE _CNV_S_2_RANGE__0___1_CM 1 100. 0. 1. DISPLAY_IDENTIFIER LV_T_CDN_DIAG_OC_LS_DOWN[1] ECU_ADDRESS 0xd000578a BIT_MASK 0x1 /end MEASUREMENT
/begin MEASUREMENT egcp[0].egcp_struct_sigdglsdi1.lv_inh_diag_oc_ls_down "Boolean flag indicating project specific application conditions for downstream open line diagnosis not met" UBYTE _CNV_S_2_RANGE__0___1_CM 1 100. 0. 1. DISPLAY_IDENTIFIER LV_INH_DIAG_OC_LS_DOWN[1] ECU_ADDRESS 0xd000578c BIT_MASK 0x1 /end MEASUREMENT
/begin MEASUREMENT egcp[0].egcp_struct_sigdglsdi1.lv_inh_diag_puc_ls_down "Boolean flag indicating project specific application conditions for downstream PUC diagnosis not met" UBYTE _CNV_S_2_RANGE__0___1_CM 1 100. 0. 1. DISPLAY_IDENTIFIER LV_INH_DIAG_PUC_LS_DOWN[1] ECU_ADDRESS 0xd000578d BIT_MASK 0x1 /end MEASUREMENT
/begin MEASUREMENT egcp[0].egcp_struct_sigdglsdi1.lv_inh_diag_fl_ls_down "Boolean flag indicating project specific application conditions for downstream FL diagnosis not met" UBYTE _CNV_S_2_RANGE__0___1_CM 1 100. 0. 1. DISPLAY_IDENTIFIER LV_INH_DIAG_FL_LS_DOWN[1] ECU_ADDRESS 0xd000578e BIT_MASK 0x1 /end MEASUREMENT
/begin MEASUREMENT egcp[0].egcp_struct_sigdglsdi1.lv_inh_diag_scg_ls_down "Boolean flag indicating project specific application conditions for downstream SCG diagnosis not met" UBYTE _CNV_S_2_RANGE__0___1_CM 1 100. 0. 1. DISPLAY_IDENTIFIER LV_INH_DIAG_SCG_LS_DOWN[1] ECU_ADDRESS 0xd000578f BIT_MASK 0x1 /end MEASUREMENT
/begin MEASUREMENT egcp[0].egcp_struct_sigdglsdi1.lv_inh_diag_scp_ls_down "Boolean flag indicating project specific application conditions for downstream short to plus diagnosis not met" UBYTE _CNV_S_2_RANGE__0___1_CM 1 100. 0. 1. DISPLAY_IDENTIFIER LV_INH_DIAG_SCP_LS_DOWN[1] ECU_ADDRESS 0xd0005790 BIT_MASK 0x1 /end MEASUREMENT
/begin MEASUREMENT egcp[0].egcp_struct_sigdglsla0.t_dly_diag_el_lsl_up "Delay timer to start the electrical failure diagnosis " UWORD _CNV_A_R_LINEAR_____3_CM 1 100. 0. 655.35 DISPLAY_IDENTIFIER T_DLY_DIAG_EL_LSL_UP[1] ECU_ADDRESS 0xd0005794 FORMAT "%6.2" /end MEASUREMENT
/begin MEASUREMENT egcp[0].egcp_struct_sigdglsla0.ctr_iplsl_sym_diag_lsl_up "Error debounce counter" UWORD _CNV_A_R_LINEAR_____0_CM 1 100. 0. 65535. DISPLAY_IDENTIFIER CTR_IPLSL_SYM_DIAG_LSL_UP[1] ECU_ADDRESS 0xd0005796 FORMAT "%5.0" /end MEASUREMENT
/begin MEASUREMENT egcp[0].egcp_struct_sigdglsla0.iplsl_sym_diag_lsl_up "Symptoms of the WRAF sensor Pump Current Controller Diagnosis" UBYTE _CNV_S_5_EGCP_RANGE_338_CM 1 100. 0. 8. DISPLAY_IDENTIFIER IPLSL_SYM_DIAG_LSL_UP[1] ECU_ADDRESS 0xd0005798 /end MEASUREMENT
/begin MEASUREMENT egcp[0].egcp_struct_sigdglsla0.state_err_el_lsl_up "State to get visible the separate OBD-I failures" UBYTE _CNV_S_11_EGCP_RANGE_339_CM 1 100. 0. 10. DISPLAY_IDENTIFIER STATE_ERR_EL_LSL_UP[1] ECU_ADDRESS 0xd0005799 /end MEASUREMENT
/begin MEASUREMENT egcp[0].egcp_struct_sigdglsla0.lv_lsl_up_spi_com_inh "Inhibit bit for the SPI-communication" UBYTE _CNV_S_2_RANGE__0___1_CM 1 100. 0. 1. DISPLAY_IDENTIFIER LV_LSL_UP_SPI_COM_INH[1] ECU_ADDRESS 0xd000579a BIT_MASK 0x1 /end MEASUREMENT
/begin MEASUREMENT egcp[0].egcp_struct_sigdglsla0.lv_diag_iplsl_sym_lsl_up "Pump Current Controller in Limitation for too long time" UBYTE _CNV_S_2_RANGE__0___1_CM 1 100. 0. 1. DISPLAY_IDENTIFIER LV_DIAG_IPLSL_SYM_LSL_UP[1] ECU_ADDRESS 0xd000579b BIT_MASK 0x1 /end MEASUREMENT
/begin MEASUREMENT egcp[0].egcp_struct_sigdglsla0.lv_diag_iplsl_cdn_lsl_up "Conditions to run the WRAF sensor Pump Current Controller Diagnosis" UBYTE _CNV_S_2_RANGE__0___1_CM 1 100. 0. 1. DISPLAY_IDENTIFIER LV_DIAG_IPLSL_CDN_LSL_UP[1] ECU_ADDRESS 0xd000579c BIT_MASK 0x1 /end MEASUREMENT
/begin MEASUREMENT egcp[0].egcp_struct_sigdglsla0.lv_diag_act_el_lsl_up "Logical Value for diagnosis active (=1) or not (=0)" UBYTE _CNV_S_2_RANGE__0___1_CM 1 100. 0. 1. DISPLAY_IDENTIFIER LV_DIAG_ACT_EL_LSL_UP[1] ECU_ADDRESS 0xd000579d BIT_MASK 0x1 /end MEASUREMENT
/begin MEASUREMENT egcp[0].egcp_struct_sigdglslai0.lv_inh_diag_el_lsl_up "Deactivation of \"HW-Based Diagnosis\"" UBYTE _CNV_S_2_RANGE__0___1_CM 1 100. 0. 1. DISPLAY_IDENTIFIER LV_INH_DIAG_EL_LSL_UP[1] ECU_ADDRESS 0xd00057a0 BIT_MASK 0x1 /end MEASUREMENT
/begin MEASUREMENT egcp[0].egcp_struct_sigdglslai0.lv_iplsl_diag_inh_lsl_up "Deactivation of \"HW-Based Diagnosis with the CJ120\"" UBYTE _CNV_S_2_RANGE__0___1_CM 1 100. 0. 1. DISPLAY_IDENTIFIER LV_IPLSL_DIAG_INH_LSL_UP[1] ECU_ADDRESS 0xd00057a1 BIT_MASK 0x1 /end MEASUREMENT
/begin MEASUREMENT egcp[0].egcp_struct_pladgft0.lam_mmv_vls_dif_dly_ldc "Floating mean value for limited lambda deviation" SWORD _CNV_A_R_LINEAR_____113_CM 1 100. -50. 49.9984741210938 DISPLAY_IDENTIFIER LAM_MMV_VLS_DIF_DLY_LDC[1] ECU_ADDRESS 0xd00057a4 FORMAT "%7.3" /end MEASUREMENT
/begin MEASUREMENT egcp[0].egcp_struct_pladgft0.maf_int_vls_dif_dly_min "MAF integral for lower VLS_DIF_DLY deviation" UWORD _CNV_A_R_LINEAR_____287_CM 1 100. 0. 1820.41666666667 DISPLAY_IDENTIFIER MAF_INT_VLS_DIF_DLY_MIN[1] ECU_ADDRESS 0xd00057a6 FORMAT "%7.2" /end MEASUREMENT
/begin MEASUREMENT egcp[0].egcp_struct_pladgft0.maf_int_vls_dif_dly_max "MAF integral for upper VLS_DIF_DLY deviation" UWORD _CNV_A_R_LINEAR_____287_CM 1 100. 0. 1820.41666666667 DISPLAY_IDENTIFIER MAF_INT_VLS_DIF_DLY_MAX[1] ECU_ADDRESS 0xd00057a8 FORMAT "%7.2" /end MEASUREMENT
/begin MEASUREMENT egcp[0].egcp_struct_pladgft0.maf_int_vls_dif_dly_ldc "Integral of mass air flow since limited dynamic conditions fulfilled" UWORD _CNV_A_R_LINEAR_____340_CM 1 100. 0. 1389. DISPLAY_IDENTIFIER MAF_INT_VLS_DIF_DLY_LDC[1] ECU_ADDRESS 0xd00057aa FORMAT "%7.2" /end MEASUREMENT
/begin MEASUREMENT egcp[0].egcp_struct_pladgft0.maf_int_rst_vls_down_dif_diag "Integral to start a new diagnostic cycle and to set the end flag" UWORD _CNV_A_R_LINEAR_____287_CM 1 100. 0. 1820.41666666667 DISPLAY_IDENTIFIER MAF_INT_RST_VLS_DOWN_DIF_DIAG[1] ECU_ADDRESS 0xd00057ac FORMAT "%7.2" /end MEASUREMENT
/begin MEASUREMENT egcp[0].egcp_struct_pladgft0.t_sum_max_delta_i_lam "Total duration over C_LAMB_DELTA_I_MAX_DIAG" UWORD _CNV_A_R_LINEAR_____4_CM 1 100. 0. 6553.5 DISPLAY_IDENTIFIER T_SUM_MAX_DELTA_I_LAM[1] ECU_ADDRESS 0xd00057ae FORMAT "%6.1" /end MEASUREMENT
/begin MEASUREMENT egcp[0].egcp_struct_pladgft0.t_sum_min_delta_i_lam "Total duration over C_LAMB_DELTA_I_MIN_DIAG" UWORD _CNV_A_R_LINEAR_____4_CM 1 100. 0. 6553.5 DISPLAY_IDENTIFIER T_SUM_MIN_DELTA_I_LAM[1] ECU_ADDRESS 0xd00057b0 FORMAT "%6.1" /end MEASUREMENT
/begin MEASUREMENT egcp[0].egcp_struct_pladgft0.t_sum_end_diag_win_delta_i_lam "Time counter to set LV_END_DIAG_WIN_DELTA_I_LAM[i] for similar conditions window" UWORD _CNV_A_R_LINEAR_____4_CM 1 100. 0. 6553.5 DISPLAY_IDENTIFIER T_SUM_END_DIAG_WIN_DELTA_I_LAM[1] ECU_ADDRESS 0xd00057b2 FORMAT "%6.1" /end MEASUREMENT
/begin MEASUREMENT egcp[0].egcp_struct_pladgft0.t_sum_end_ready_delta_i_lam "Second time counter to set LV_END_DIAG_DELTA_I_LAM[i]" UWORD _CNV_A_R_LINEAR_____4_CM 1 100. 0. 6553.5 DISPLAY_IDENTIFIER T_SUM_END_READY_DELTA_I_LAM[1] ECU_ADDRESS 0xd00057b4 FORMAT "%6.1" /end MEASUREMENT
/begin MEASUREMENT egcp[0].egcp_struct_pladgft0.t_sum_rst_delta_i_lam "Time counter to reset T_SUM_MAX_DELTA_I_LAM[i] and T_SUM_MIN_DELTA_I_LAM[i]." UWORD _CNV_A_R_LINEAR_____4_CM 1 100. 0. 6553.5 DISPLAY_IDENTIFIER T_SUM_RST_DELTA_I_LAM[1] ECU_ADDRESS 0xd00057b6 FORMAT "%6.1" /end MEASUREMENT
/begin MEASUREMENT egcp[0].egcp_struct_pladgft0.lamb_delta_i_save_diag "I-share from trim controller  - to be transmitted to the Scan Tool mode06" SWORD _CNV_A_R_LINEAR_____24_CM 1 100. -0.125 0.125 DISPLAY_IDENTIFIER LAMB_DELTA_I_SAVE_DIAG[1] ECU_ADDRESS 0xd00057b8 FORMAT "%8.5" /end MEASUREMENT
/begin MEASUREMENT egcp[0].egcp_struct_pladgft0.err_sym_lam_adj "Symptoms of the lambda trim control errors" UBYTE _CNV_S_5_EGCP_RANGE_338_CM 1 100. 0. 8. DISPLAY_IDENTIFIER ERR_SYM_LAM_ADJ[1] ECU_ADDRESS 0xd00057ba /end MEASUREMENT
/begin MEASUREMENT egcp[0].egcp_struct_pladgft0.lv_vls_dif_dly_ldc "Status limited dynamic for the function \"Monitoring Trim Controller Deviation\"" UBYTE _CNV_S_2_RANGE__0___1_CM 1 100. 0. 1. DISPLAY_IDENTIFIER LV_VLS_DIF_DLY_LDC[1] ECU_ADDRESS 0xd00057bb BIT_MASK 0x1 /end MEASUREMENT
/begin MEASUREMENT egcp[0].egcp_struct_pladgft0.lv_vls_dif_dly_ldc_lam_mv "Status limited dynamic FAC_LAM_MV[i]" UBYTE _CNV_S_2_RANGE__0___1_CM 1 100. 0. 1. DISPLAY_IDENTIFIER LV_VLS_DIF_DLY_LDC_LAM_MV[1] ECU_ADDRESS 0xd00057bc BIT_MASK 0x1 /end MEASUREMENT
/begin MEASUREMENT egcp[0].egcp_struct_pladgft0.lv_end_diag_lam_adj "Diagnostic cycle for lambda trim control complete" UBYTE _CNV_S_2_RANGE__0___1_CM 1 100. 0. 1. DISPLAY_IDENTIFIER LV_END_DIAG_LAM_ADJ[1] ECU_ADDRESS 0xd00057bd BIT_MASK 0x1 /end MEASUREMENT
/begin MEASUREMENT egcp[0].egcp_struct_pladgft0.lv_err_lam_adj "Status diagnostic result of lambda trim control" UBYTE _CNV_S_2_RANGE__0___1_CM 1 100. 0. 1. DISPLAY_IDENTIFIER LV_ERR_LAM_ADJ[1] ECU_ADDRESS 0xd00057be BIT_MASK 0x1 /end MEASUREMENT
/begin MEASUREMENT egcp[0].egcp_struct_pladgft0.lv_end_diag_win_delta_i_lam "End of diagnosis cycle for similar conditions window" UBYTE _CNV_S_2_RANGE__0___1_CM 1 100. 0. 1. DISPLAY_IDENTIFIER LV_END_DIAG_WIN_DELTA_I_LAM[1] ECU_ADDRESS 0xd00057bf BIT_MASK 0x1 /end MEASUREMENT
/begin MEASUREMENT egcp[0].egcp_struct_pladgft0.lv_det_sym_eve_delta_i_lam "Bit for second time counter DELTA_I_LAM (T_SUM_END_READY_DELTA_I_LAM[i])" UBYTE _CNV_S_2_RANGE__0___1_CM 1 100. 0. 1. DISPLAY_IDENTIFIER LV_DET_SYM_EVE_DELTA_I_LAM[1] ECU_ADDRESS 0xd00057c0 BIT_MASK 0x1 /end MEASUREMENT
/begin MEASUREMENT egcp[0].egcp_struct_pladgfti0.lv_inh_diag_dly_lam "Inhibition condition for the dynamic fuel trim diagnosis" UBYTE _CNV_S_2_RANGE__0___1_CM 1 100. 0. 1. DISPLAY_IDENTIFIER LV_INH_DIAG_DLY_LAM[1] ECU_ADDRESS 0xd00057c4 BIT_MASK 0x1 /end MEASUREMENT
/begin MEASUREMENT egcp[0].egcp_struct_pladgfti0.lv_inh_diag_rbm_dly_lam "Inhibition of the dynamic fuel trim diagnosis due to failures" UBYTE _CNV_S_2_RANGE__0___1_CM 1 100. 0. 1. DISPLAY_IDENTIFIER LV_INH_DIAG_RBM_DLY_LAM[1] ECU_ADDRESS 0xd00057c5 BIT_MASK 0x1 /end MEASUREMENT
/begin MEASUREMENT egcp[0].egcp_struct_fctdglslh0.ttip_mes_ls_up_obd_lsh_up "Most current oxygen sensor temperature (Mode 6 information)" SWORD _CNV_A_R_LINEAR_____130_CM 1 100. -2048. 2047.9375 DISPLAY_IDENTIFIER TTIP_MES_LS_UP_OBD_LSH_UP[1] ECU_ADDRESS 0xd00057c8 FORMAT "%10.4" /end MEASUREMENT
/begin MEASUREMENT egcp[0].egcp_struct_fctdglslh0.tcc_end_diag_obd_lsh_up "Counter for end flag determination of TTIP_MES diagnosis" UWORD _CNV_A_R_LINEAR_____0_CM 1 100. 0. 65535. DISPLAY_IDENTIFIER TCC_END_DIAG_OBD_LSH_UP[1] ECU_ADDRESS 0xd00057ca FORMAT "%5.0" /end MEASUREMENT
/begin MEASUREMENT egcp[0].egcp_struct_fctdglslh0.tcc_err_obd_lsh_up "Number of diagnosis cycles in which temperature deviation exceeding limits present" UWORD _CNV_A_R_LINEAR_____0_CM 1 100. 0. 65535. DISPLAY_IDENTIFIER TCC_ERR_OBD_LSH_UP[1] ECU_ADDRESS 0xd00057cc FORMAT "%5.0" /end MEASUREMENT
/begin MEASUREMENT egcp[0].egcp_struct_fctdglslh0.state_sym_obd_lsl_lsh_up "Variable indicating status of each symptom, updated each recurrence & at diagnosis completion" UBYTE _CNV_S_4_EGCP_RANGE_341_CM 1 100. 0. 4. DISPLAY_IDENTIFIER STATE_SYM_OBD_LSL_LSH_UP[1] ECU_ADDRESS 0xd00057ce /end MEASUREMENT
/begin MEASUREMENT egcp[0].egcp_struct_fctdglslh0.lv_lamb_pls_req_diag_lsh_up "Boolean flag requesting exaggerated forced stimulation" UBYTE _CNV_S_2_RANGE__0___1_CM 1 100. 0. 1. DISPLAY_IDENTIFIER LV_LAMB_PLS_REQ_DIAG_LSH_UP[1] ECU_ADDRESS 0xd00057cf BIT_MASK 0x1 /end MEASUREMENT
/begin MEASUREMENT egcp[0].egcp_struct_fctdglslh0.lv_diag_obd_cdn_lsh_up "Boolean flag indicating that conditions for diagnosis met" UBYTE _CNV_S_2_RANGE__0___1_CM 1 100. 0. 1. DISPLAY_IDENTIFIER LV_DIAG_OBD_CDN_LSH_UP[1] ECU_ADDRESS 0xd00057d0 BIT_MASK 0x1 /end MEASUREMENT
/begin MEASUREMENT egcp[0].egcp_struct_fctdglslh0.lv_diag_obd_sym_lsh_up "Boolean flag indicating that fault is present and has been debounced" UBYTE _CNV_S_2_RANGE__0___1_CM 1 100. 0. 1. DISPLAY_IDENTIFIER LV_DIAG_OBD_SYM_LSH_UP[1] ECU_ADDRESS 0xd00057d1 BIT_MASK 0x1 /end MEASUREMENT
/begin MEASUREMENT egcp[0].egcp_struct_fctdglslh0.lv_diag_obd_end_lsh_up "Boolean flag indicating that diagnosis has been completed" UBYTE _CNV_S_2_RANGE__0___1_CM 1 100. 0. 1. DISPLAY_IDENTIFIER LV_DIAG_OBD_END_LSH_UP[1] ECU_ADDRESS 0xd00057d2 BIT_MASK 0x1 /end MEASUREMENT
/begin MEASUREMENT egcp[0].egcp_struct_fctdglshd1.r_it_thd_obd_lsh_down "Threshold for most current downstream oxygen sensor internal resistance used for diagnosis cycle, Mode 6 information" UWORD _CNV_A_R_LINEAR_____0_CM 1 100. 0. 65535. DISPLAY_IDENTIFIER R_IT_THD_OBD_LSH_DOWN[1] ECU_ADDRESS 0xd00057d4 FORMAT "%5.0" /end MEASUREMENT
/begin MEASUREMENT egcp[0].egcp_struct_fctdglshd1.r_it_obd_lsh_down "Most current downstream oxygen sensor internal resistance used for diagnosis cycle, Mode 6 information" UWORD _CNV_A_R_LINEAR_____0_CM 1 100. 0. 65535. DISPLAY_IDENTIFIER R_IT_OBD_LSH_DOWN[1] ECU_ADDRESS 0xd00057d6 FORMAT "%5.0" /end MEASUREMENT
/begin MEASUREMENT egcp[0].egcp_struct_fctdglshd1.r_it_l_mes_obd_lsh_down "Latest measured downstream oxygen sensor internal resistance value for no error case, mode 6 information" UWORD _CNV_A_R_LINEAR_____318_CM 1 100. 0. 65535. DISPLAY_IDENTIFIER R_IT_L_MES_OBD_LSH_DOWN[1] ECU_ADDRESS 0xd00057d8 FORMAT "%5.0" /end MEASUREMENT
/begin MEASUREMENT egcp[0].egcp_struct_fctdglshd1.r_it_l_ref_obd_lsh_down "Latest reference value for measured internal resistance downstream in no error case, mode 6 information" UWORD _CNV_A_R_LINEAR_____318_CM 1 100. 0. 65535. DISPLAY_IDENTIFIER R_IT_L_REF_OBD_LSH_DOWN[1] ECU_ADDRESS 0xd00057da FORMAT "%5.0" /end MEASUREMENT
/begin MEASUREMENT egcp[0].egcp_struct_fctdglshd1.r_it_h_mes_obd_lsh_down "Latest measured downstream oxygen sensor internal resistance value for error case, mode 6 information" UWORD _CNV_A_R_LINEAR_____318_CM 1 100. 0. 65535. DISPLAY_IDENTIFIER R_IT_H_MES_OBD_LSH_DOWN[1] ECU_ADDRESS 0xd00057dc FORMAT "%5.0" /end MEASUREMENT
/begin MEASUREMENT egcp[0].egcp_struct_fctdglshd1.r_it_h_ref_obd_lsh_down "Latest reference value for measured internal resistance downstream in error case, mode 6 information" UWORD _CNV_A_R_LINEAR_____318_CM 1 100. 0. 65535. DISPLAY_IDENTIFIER R_IT_H_REF_OBD_LSH_DOWN[1] ECU_ADDRESS 0xd00057de FORMAT "%5.0" /end MEASUREMENT
/begin MEASUREMENT egcp[0].egcp_struct_fctdglshd1.temp_dif_obd_lsh_down "Indicates difference in temperature between set operating temperature & exhaust gas at sensor location" UWORD _CNV_A_R_EGCP_LINEA_342_CM 1 100. 0. 2047. DISPLAY_IDENTIFIER TEMP_DIF_OBD_LSH_DOWN[1] ECU_ADDRESS 0xd00057e0 FORMAT "%4.0" /end MEASUREMENT
/begin MEASUREMENT egcp[0].egcp_struct_fctdglshd1.pow_int_obd_lsh_down "Integral indicates measure of cooling energy of exhaust gas at sensor location" UWORD _CNV_A_R_LINEAR_____320_CM 1 100. 0. 65535. DISPLAY_IDENTIFIER POW_INT_OBD_LSH_DOWN[1] ECU_ADDRESS 0xd00057e2 FORMAT "%5.0" /end MEASUREMENT
/begin MEASUREMENT egcp[0].egcp_struct_fctdglshd1.tcc_vld_obd_lsh_down "Number of completed valid diagnosis cycles" UWORD _CNV_A_R_LINEAR_____0_CM 1 100. 0. 1023. DISPLAY_IDENTIFIER TCC_VLD_OBD_LSH_DOWN[1] ECU_ADDRESS 0xd00057e4 FORMAT "%4.0" /end MEASUREMENT
/begin MEASUREMENT egcp[0].egcp_struct_fctdglshd1.tcc_err_obd_lsh_down "Number of faults detected during valid diagnosis cycles" UWORD _CNV_A_R_LINEAR_____0_CM 1 100. 0. 1023. DISPLAY_IDENTIFIER TCC_ERR_OBD_LSH_DOWN[1] ECU_ADDRESS 0xd00057e6 FORMAT "%4.0" /end MEASUREMENT
/begin MEASUREMENT egcp[0].egcp_struct_fctdglshd1.ctr_cycnr_r_it_obd_ls_down "Value of handshake counter for last valid resistance value used for diagnosis" UWORD _CNV_A_R_LINEAR_____0_CM 1 100. 0. 65535. DISPLAY_IDENTIFIER CTR_CYCNR_R_IT_OBD_LS_DOWN[1] ECU_ADDRESS 0xd00057e8 FORMAT "%5.0" /end MEASUREMENT
/begin MEASUREMENT egcp[0].egcp_struct_fctdglshd1.state_obd_lsh_down "Indicates current phase of oxygen sensor heater OBDII diagnosis" UBYTE _CNV_S_9_EGCP_RANGE_343_CM 1 100. 0. 8. DISPLAY_IDENTIFIER STATE_OBD_LSH_DOWN[1] ECU_ADDRESS 0xd00057ea /end MEASUREMENT
/begin MEASUREMENT egcp[0].egcp_struct_fctdglshdi1.lv_inh_diag_obd_lsh_down "Boolean inhibit flag for O2 sensor heater OBDII monitoring" UBYTE _CNV_S_2_RANGE__0___1_CM 1 100. 0. 1. DISPLAY_IDENTIFIER LV_INH_DIAG_OBD_LSH_DOWN[1] ECU_ADDRESS 0xd00057ec BIT_MASK 0x1 /end MEASUREMENT
/begin MEASUREMENT egcp[0].egcp_struct_fctdglshdi1.lv_inh_diag_rbm_obd_lsh_down "Flag to inhibit rate based monitoring for oxygen sensor heater OBDII diagnosis" UBYTE _CNV_S_2_RANGE__0___1_CM 1 100. 0. 1. DISPLAY_IDENTIFIER LV_INH_DIAG_RBM_OBD_LSH_DOWN[1] ECU_ADDRESS 0xd00057ed BIT_MASK 0x1 /end MEASUREMENT
/begin MEASUREMENT egcp[0].egcp_struct_fctdglshdi1.lv_diag_eol_req_obd_lsh_down "Flag for end of line oxygen sensor heater OBDII diagnosis" UBYTE _CNV_S_2_RANGE__0___1_CM 1 100. 0. 1. DISPLAY_IDENTIFIER LV_DIAG_EOL_REQ_OBD_LSH_DOWN ECU_ADDRESS 0xd00057ee BIT_MASK 0x1 /end MEASUREMENT
/begin MEASUREMENT egcp[0].egcp_struct_fctdglshdi1.state_rbm_obd_lsh_down "Interface of OBD_LSH_DOWN monitor with the Rate-Based Monitoring statistics" UBYTE _CNV_A_R_LINEAR_____0_CM 1 100. 0. 7. DISPLAY_IDENTIFIER STATE_RBM_OBD_LSH_DOWN[1] ECU_ADDRESS 0xd00057ef FORMAT "%1.0" /end MEASUREMENT
/begin MEASUREMENT egcp[0].egcp_struct_sigdglsl1.lv_err_ls_down "Final diagnostic of the downstream oxygen sensor" UBYTE _CNV_S_2_RANGE__0___1_CM 1 100. 0. 1. DISPLAY_IDENTIFIER LV_ERR_LS_DOWN[1] ECU_ADDRESS 0xd00057f0 BIT_MASK 0x1 /end MEASUREMENT
/begin MEASUREMENT egcp[0].egcp_struct_sigdglsl1.lv_err_ls_up "Final diagnostic of the upstream oxygen sensor" UBYTE _CNV_S_2_RANGE__0___1_CM 1 100. 0. 1. DISPLAY_IDENTIFIER LV_ERR_LS_UP[1] ECU_ADDRESS 0xd00057f1 BIT_MASK 0x1 /end MEASUREMENT
/begin MEASUREMENT egcp[0].egcp_struct_sigdglsl1.lv_ls_up_diag_end "Sum end bit of upstream oxygen sensor diagnosis functions" UBYTE _CNV_S_2_RANGE__0___1_CM 1 100. 0. 1. DISPLAY_IDENTIFIER LV_LS_UP_DIAG_END[1] ECU_ADDRESS 0xd00057f2 BIT_MASK 0x1 /end MEASUREMENT
/begin MEASUREMENT egcp[0].egcp_struct_sigdglsl1.lv_ls_up_obd_1_man_deac "Logical variable indicating manual deactivation of all OBD1 diagnosis for upstream oxygen sensor" UBYTE _CNV_S_2_RANGE__0___1_CM 1 100. 0. 1. DISPLAY_IDENTIFIER LV_LS_UP_OBD_1_MAN_DEAC[1] ECU_ADDRESS 0xd00057f3 BIT_MASK 0x1 /end MEASUREMENT
/begin MEASUREMENT egcp[0].egcp_struct_sigdglsl1.lv_ls_up_obd_2_man_deac "Logical variable indicating manual deactivation of all OBD2 diagnosis for upstream oxygen sensor" UBYTE _CNV_S_2_RANGE__0___1_CM 1 100. 0. 1. DISPLAY_IDENTIFIER LV_LS_UP_OBD_2_MAN_DEAC[1] ECU_ADDRESS 0xd00057f4 BIT_MASK 0x1 /end MEASUREMENT
/begin MEASUREMENT egcp[0].egcp_struct_sigdglsl1.lv_ls_down_diag_end "Collecting end flag for the diagnosis functions of the downstream oxygen sensor" UBYTE _CNV_S_2_RANGE__0___1_CM 1 100. 0. 1. DISPLAY_IDENTIFIER LV_LS_DOWN_DIAG_END[1] ECU_ADDRESS 0xd00057f5 BIT_MASK 0x1 /end MEASUREMENT
/begin MEASUREMENT egcp[0].egcp_struct_sigdglsl1.lv_ls_down_obd_1_man_deac "Logical variable indicating manual deactivation of all OBD1 diagnosis for downstream oxygen sensor" UBYTE _CNV_S_2_RANGE__0___1_CM 1 100. 0. 1. DISPLAY_IDENTIFIER LV_LS_DOWN_OBD_1_MAN_DEAC[1] ECU_ADDRESS 0xd00057f6 BIT_MASK 0x1 /end MEASUREMENT
/begin MEASUREMENT egcp[0].egcp_struct_sigdglsl1.lv_ls_down_obd_2_man_deac "Logical variable indicating manual deactivation of all OBD2 diagnosis for downstream oxygen sensor" UBYTE _CNV_S_2_RANGE__0___1_CM 1 100. 0. 1. DISPLAY_IDENTIFIER LV_LS_DOWN_OBD_2_MAN_DEAC[1] ECU_ADDRESS 0xd00057f7 BIT_MASK 0x1 /end MEASUREMENT
/begin MEASUREMENT egcp[0].egcp_struct_sigdglsd2.vls_down_tran_puc "Monitor sensor voltage on activating the trailing throttle fuel cut-off, Bank i" UWORD _CNV_A_R_LINEAR_____2_CM 1 100. 0. 4.9951171875 DISPLAY_IDENTIFIER VLS_DOWN_TRAN_PUC[1] ECU_ADDRESS 0xd0005840 FORMAT "%5.3" /end MEASUREMENT
/begin MEASUREMENT egcp[0].egcp_struct_sigdglsd2.vls_down_pue "Monitor sensor voltage at the time of leaving PUC, Bank i (i=1.2)" UWORD _CNV_A_R_LINEAR_____2_CM 1 100. 0. 4.9951171875 DISPLAY_IDENTIFIER VLS_DOWN_PUE[1] ECU_ADDRESS 0xd0005842 FORMAT "%5.3" /end MEASUREMENT
/begin MEASUREMENT egcp[0].egcp_struct_sigdglsd2.vls_dif_diag_pue_ls_down "difference of VLS_DOWN_i values from the beginning to the end of the MAF_INT_PUC_NOT_ACT calculation" UWORD _CNV_A_R_LINEAR_____2_CM 1 100. 0. 4.9951171875 DISPLAY_IDENTIFIER VLS_DIF_DIAG_PUE_LS_DOWN[1] ECU_ADDRESS 0xd0005844 FORMAT "%5.3" /end MEASUREMENT
/begin MEASUREMENT egcp[0].egcp_struct_sigdglsd2.vls_dif_save_diag_ls_down "Difference of VLS_DOWN_i values from the beginning to the end of the MAF_INT_PUC_NOT_ACT calculation for scantool" UWORD _CNV_A_R_LINEAR_____2_CM 1 100. 0. 4.9951171875 DISPLAY_IDENTIFIER VLS_DIF_SAVE_DIAG_LS_DOWN[1] ECU_ADDRESS 0xd0005846 FORMAT "%5.3" /end MEASUREMENT
/begin MEASUREMENT egcp[0].egcp_struct_sigdglsd2.vls_dif_min_diag_pue_ls_down "Minimum value of VLS_DIF_DIAG_PUE_LS_DOWN[i] until MAF threshold outside PUC is exceeded" UWORD _CNV_A_R_LINEAR_____2_CM 1 100. 0. 4.9951171875 DISPLAY_IDENTIFIER VLS_DIF_MIN_DIAG_PUE_LS_DOWN[1] ECU_ADDRESS 0xd0005848 FORMAT "%5.3" /end MEASUREMENT
/begin MEASUREMENT egcp[0].egcp_struct_sigdglsd2.vls_dif_max_diag_pue_ls_down "Maximum value of VLS_DIF_DIAG_PUE_LS_DOWN[i] until MAF threshold outside PUC is exceeded" UWORD _CNV_A_R_LINEAR_____2_CM 1 100. 0. 4.9951171875 DISPLAY_IDENTIFIER VLS_DIF_MAX_DIAG_PUE_LS_DOWN[1] ECU_ADDRESS 0xd000584a FORMAT "%5.3" /end MEASUREMENT
/begin MEASUREMENT egcp[0].egcp_struct_sigdglsd2.ctr_end_diag_pue_ls_down "Counter to set LV_END_DIAG_VLS_DOWN_PUE_i" UWORD _CNV_A_R_LINEAR_____0_CM 1 100. 0. 65535. DISPLAY_IDENTIFIER CTR_END_DIAG_PUE_LS_DOWN[1] ECU_ADDRESS 0xd000584c FORMAT "%5.0" /end MEASUREMENT
/begin MEASUREMENT egcp[0].egcp_struct_sigdglsd2.ctr_quo_sum_swt_ls_down "Sum of weighted CTR_SWT_ACT_LS_DOWN[NC_CBK_EX_NR], Bank i" UWORD _CNV_A_R_LINEAR_____28_CM 1 100. 0. 255.99609375 DISPLAY_IDENTIFIER CTR_QUO_SUM_SWT_LS_DOWN[1] ECU_ADDRESS 0xd000584e FORMAT "%10.6" /end MEASUREMENT
/begin MEASUREMENT egcp[0].egcp_struct_sigdglsd2.ctr_quo_swt_ls_down "Weighted value CTR_SWT_ACT_LS_DOWN[NC_CBK_EX_NR ]" UWORD _CNV_A_R_LINEAR_____28_CM 1 100. 0. 255.99609375 DISPLAY_IDENTIFIER CTR_QUO_SWT_LS_DOWN[1] ECU_ADDRESS 0xd0005850 FORMAT "%10.6" /end MEASUREMENT
/begin MEASUREMENT egcp[0].egcp_struct_sigdglsd2.ctr_quo_swt_rbm_ls_down "Weighted value of CTR_SWT_ACT_RBM_LS_DOWN[NC_CBK_EX_NR ] for RBM purpose" UWORD _CNV_A_R_LINEAR_____28_CM 1 100. 0. 255.99609375 DISPLAY_IDENTIFIER CTR_QUO_SWT_RBM_LS_DOWN[1] ECU_ADDRESS 0xd0005852 FORMAT "%10.6" /end MEASUREMENT
/begin MEASUREMENT egcp[0].egcp_struct_sigdglsd2.ctr_swt_act_ls_down "Cycle counter for switching time determination, Bank i" UBYTE _CNV_A_R_LINEAR_____23_CM 1 100. 0. 5100. DISPLAY_IDENTIFIER CTR_SWT_ACT_LS_DOWN[1] ECU_ADDRESS 0xd0005854 FORMAT "%4.0" /end MEASUREMENT
/begin MEASUREMENT egcp[0].egcp_struct_sigdglsd2.ctr_swt_act_rbm_ls_down "Cycle counter for RBM switching time determination, Bank i" UBYTE _CNV_A_R_LINEAR_____23_CM 1 100. 0. 5100. DISPLAY_IDENTIFIER CTR_SWT_ACT_RBM_LS_DOWN[1] ECU_ADDRESS 0xd0005855 FORMAT "%4.0" /end MEASUREMENT
/begin MEASUREMENT egcp[0].egcp_struct_sigdglsd2.ctr_swt_ls_down "Number of valid switching times from rich to lean" UBYTE _CNV_A_R_LINEAR_____0_CM 1 100. 0. 255. DISPLAY_IDENTIFIER CTR_SWT_LS_DOWN[1] ECU_ADDRESS 0xd0005856 FORMAT "%3.0" /end MEASUREMENT
/begin MEASUREMENT egcp[0].egcp_struct_sigdglsd2.ctr_cycnr_swt_ls_down "Average of weighted CTR_SWT_ACT_LS_DOWN[NC_CBK_EX_NR], Bank i" UBYTE _CNV_A_R_LINEAR_____103_CM 1 100. 0. 1.9921875 DISPLAY_IDENTIFIER CTR_CYCNR_SWT_LS_DOWN[1] ECU_ADDRESS 0xd0005857 FORMAT "%8.6" /end MEASUREMENT
/begin MEASUREMENT egcp[0].egcp_struct_sigdglsd2.ctr_save_swt_ls_down "Mean value of the ratio between the monitor sensor switching time and the threshold value for scantool" UBYTE _CNV_A_R_LINEAR_____103_CM 1 100. 0. 1.9921875 DISPLAY_IDENTIFIER CTR_SAVE_SWT_LS_DOWN[1] ECU_ADDRESS 0xd0005858 FORMAT "%8.6" /end MEASUREMENT
/begin MEASUREMENT egcp[0].egcp_struct_sigdglsd2.ctr_sym_diag_pue_ls_down "Counter for anti-bounce of LS_DOWN_PUE diagnosis" UBYTE _CNV_A_R_LINEAR_____0_CM 1 100. 0. 255. DISPLAY_IDENTIFIER CTR_SYM_DIAG_PUE_LS_DOWN[1] ECU_ADDRESS 0xd0005859 FORMAT "%3.0" /end MEASUREMENT
/begin MEASUREMENT egcp[0].egcp_struct_sigdglsd2.lv_diag_pue_vld_ls_down "Logical variable indicating validity of previous diagnostic cycle" UBYTE _CNV_S_2_RANGE__0___1_CM 1 100. 0. 1. DISPLAY_IDENTIFIER LV_DIAG_PUE_VLD_LS_DOWN[1] ECU_ADDRESS 0xd000585a BIT_MASK 0x1 /end MEASUREMENT
/begin MEASUREMENT egcp[0].egcp_struct_sigdglsd2.lv_diag_mpl_cdn_ls_down "Status of general activation conditions for diagnosis" UBYTE _CNV_S_2_RANGE__0___1_CM 1 100. 0. 1. DISPLAY_IDENTIFIER LV_DIAG_MPL_CDN_LS_DOWN[1] ECU_ADDRESS 0xd000585b BIT_MASK 0x1 /end MEASUREMENT
/begin MEASUREMENT egcp[0].egcp_struct_sigdglsd2.lv_swt_diag_vld_ls_down "Validity bit of the current switching time check" UBYTE _CNV_S_2_RANGE__0___1_CM 1 100. 0. 1. DISPLAY_IDENTIFIER LV_SWT_DIAG_VLD_LS_DOWN[1] ECU_ADDRESS 0xd000585c BIT_MASK 0x1 /end MEASUREMENT
/begin MEASUREMENT egcp[0].egcp_struct_sigdglsd2.lv_maf_int_puc_not_act_rst "Logical variable indicating that MAF_INT_PUC_NOT_ACT integral has been reset" UBYTE _CNV_S_2_RANGE__0___1_CM 1 100. 0. 1. DISPLAY_IDENTIFIER LV_MAF_INT_PUC_NOT_ACT_RST[1] ECU_ADDRESS 0xd000585d BIT_MASK 0x1 /end MEASUREMENT
/begin MEASUREMENT egcp[0].egcp_struct_pladglsi2.lv_lam_stop_sho_per_cdn "substitute to LV_LAM_STOP_SHO_PER in intechanged signal diagnosis" UBYTE _CNV_S_2_RANGE__0___1_CM 1 100. 0. 1. DISPLAY_IDENTIFIER LV_LAM_STOP_SHO_PER_CDN[1] ECU_ADDRESS 0xd0005860 BIT_MASK 0x1 /end MEASUREMENT
/begin MEASUREMENT egcp[0].egcp_struct_pladglsl1.lamb_sp_delta_ls_up_down "Increment of lambda setpoint" SWORD _CNV_A_R_EGCP_LINEA_350_CM 1 100. -32. 31.999023 DISPLAY_IDENTIFIER LAMB_SP_DELTA_LS_UP_DOWN[1] ECU_ADDRESS 0xd00058d4 FORMAT "%9.6" /end MEASUREMENT
/begin MEASUREMENT egcp[0].egcp_struct_pladglsl1.maf_int_diag_ls_up_down "Integral of air mass flow  while check is active" UWORD _CNV_A_R_LINEAR_____287_CM 1 100. 0. 1820.41666666667 DISPLAY_IDENTIFIER MAF_INT_DIAG_LS_UP_DOWN[1] ECU_ADDRESS 0xd00058d6 FORMAT "%7.2" /end MEASUREMENT
/begin MEASUREMENT egcp[0].egcp_struct_pladglsl1.lamb_sp_beg_diag_ls_up_down "Inicial value of lambda set point " UWORD _CNV_A_R_LINEAR_____129_CM 1 100. 0. 31.9990234375 DISPLAY_IDENTIFIER LAMB_SP_BEG_DIAG_LS_UP_DOWN[1] ECU_ADDRESS 0xd00058d8 FORMAT "%7.4" /end MEASUREMENT
/begin MEASUREMENT egcp[0].egcp_struct_pladglsl1.lamb_sp_diag_opl_ls_up_down "lambda setpoint requested by open-loop test for upstream and downstream lambda sensors" UWORD _CNV_A_R_LINEAR_____129_CM 1 100. 0. 31.9990234375 DISPLAY_IDENTIFIER LAMB_SP_DIAG_OPL_LS_UP_DOWN[1] ECU_ADDRESS 0xd00058da FORMAT "%7.4" /end MEASUREMENT
/begin MEASUREMENT egcp[0].egcp_struct_pladglsl1.t_diag_act_afr_ls_up_down "Timer for plauisibility test under rich AF conditions" UWORD _CNV_A_R_LINEAR_____4_CM 1 100. 0. 6553.5 DISPLAY_IDENTIFIER T_DIAG_ACT_AFR_LS_UP_DOWN[1] ECU_ADDRESS 0xd00058dc FORMAT "%6.1" /end MEASUREMENT
/begin MEASUREMENT egcp[0].egcp_struct_pladglsl1.t_diag_act_afl_ls_up_down "Timer for plauisibility test under lean AF conditions" UWORD _CNV_A_R_LINEAR_____4_CM 1 100. 0. 6553.5 DISPLAY_IDENTIFIER T_DIAG_ACT_AFL_LS_UP_DOWN[1] ECU_ADDRESS 0xd00058de FORMAT "%6.1" /end MEASUREMENT
/begin MEASUREMENT egcp[0].egcp_struct_pladglsl1.ctr_sum_rst_afr_chk_lsl_up "Reset counter for the rich active test" UWORD _CNV_A_R_LINEAR_____0_CM 1 100. 0. 65535. DISPLAY_IDENTIFIER CTR_SUM_RST_AFR_CHK_LSL_UP[1] ECU_ADDRESS 0xd00058e0 FORMAT "%5.0" /end MEASUREMENT
/begin MEASUREMENT egcp[0].egcp_struct_pladglsl1.ctr_sum_rst_afl_chk_lsl_up "Reset counter for the rich active test" UWORD _CNV_A_R_LINEAR_____0_CM 1 100. 0. 65535. DISPLAY_IDENTIFIER CTR_SUM_RST_AFL_CHK_LSL_UP[1] ECU_ADDRESS 0xd00058e2 FORMAT "%5.0" /end MEASUREMENT
/begin MEASUREMENT egcp[0].egcp_struct_pladglsl1.ctr_afr_chk_lsl_up "Debounce counter for the rich test" UWORD _CNV_A_R_LINEAR_____0_CM 1 100. 0. 65535. DISPLAY_IDENTIFIER CTR_AFR_CHK_LSL_UP[1] ECU_ADDRESS 0xd00058e4 FORMAT "%5.0" /end MEASUREMENT
/begin MEASUREMENT egcp[0].egcp_struct_pladglsl1.ctr_afl_chk_lsl_up "Debounce counter for the lean test" UWORD _CNV_A_R_LINEAR_____0_CM 1 100. 0. 65535. DISPLAY_IDENTIFIER CTR_AFL_CHK_LSL_UP[1] ECU_ADDRESS 0xd00058e6 FORMAT "%5.0" /end MEASUREMENT
/begin MEASUREMENT egcp[0].egcp_struct_pladglsl1.t_end_diag_act_ls_down "Timer for the end of the downstream sensor active test in the no failure case" UWORD _CNV_A_R_LINEAR_____4_CM 1 100. 0. 6553.5 DISPLAY_IDENTIFIER T_END_DIAG_ACT_LS_DOWN[1] ECU_ADDRESS 0xd00058e8 FORMAT "%6.1" /end MEASUREMENT
/begin MEASUREMENT egcp[0].egcp_struct_pladglsl1.t_afr_chk_ls_down "Debounce counter for the rich test" UWORD _CNV_A_R_LINEAR_____4_CM 1 100. 0. 6553.5 DISPLAY_IDENTIFIER T_AFR_CHK_LS_DOWN[1] ECU_ADDRESS 0xd00058ea FORMAT "%6.1" /end MEASUREMENT
/begin MEASUREMENT egcp[0].egcp_struct_pladglsl1.t_afl_chk_ls_down "Debounce counter for the lean test" UWORD _CNV_A_R_LINEAR_____4_CM 1 100. 0. 6553.5 DISPLAY_IDENTIFIER T_AFL_CHK_LS_DOWN[1] ECU_ADDRESS 0xd00058ec FORMAT "%6.1" /end MEASUREMENT
/begin MEASUREMENT egcp[0].egcp_struct_pladglsl1.state_diag_act_ls_up_down "State of check of downstream oxygen sensor signal for lambda sensor error manager" UBYTE _CNV_S_4_EGCP_RANGE_351_CM 1 100. 0. 3. DISPLAY_IDENTIFIER STATE_DIAG_ACT_LS_UP_DOWN[1] ECU_ADDRESS 0xd00058ee /end MEASUREMENT
/begin MEASUREMENT egcp[0].egcp_struct_pladglsl1.lv_diag_afl_cdn_ls_up_down "Boolean flag, condition to execute AFL active check of the oxygen sensors" UBYTE _CNV_S_2_RANGE__0___1_CM 1 100. 0. 1. DISPLAY_IDENTIFIER LV_DIAG_AFL_CDN_LS_UP_DOWN[1] ECU_ADDRESS 0xd00058ef BIT_MASK 0x1 /end MEASUREMENT
/begin MEASUREMENT egcp[0].egcp_struct_pladglsl1.lv_diag_afr_cdn_ls_up_down "Boolean flag, condition to execute AFR active check of the oxygen sensors" UBYTE _CNV_S_2_RANGE__0___1_CM 1 100. 0. 1. DISPLAY_IDENTIFIER LV_DIAG_AFR_CDN_LS_UP_DOWN[1] ECU_ADDRESS 0xd00058f0 BIT_MASK 0x1 /end MEASUREMENT
/begin MEASUREMENT egcp[0].egcp_struct_pladglsl1.lv_diag_act_end_ls_up_down "Boolean flag, end of active check of the oxygen sensors" UBYTE _CNV_S_2_RANGE__0___1_CM 1 100. 0. 1. DISPLAY_IDENTIFIER LV_DIAG_ACT_END_LS_UP_DOWN[1] ECU_ADDRESS 0xd00058f1 BIT_MASK 0x1 /end MEASUREMENT
/begin MEASUREMENT egcp[0].egcp_struct_pladglsl1.lv_lamb_sp_afr_req_diag_act "Trigger function to change lambda set point for AFR active plauisibility test" UBYTE _CNV_S_2_RANGE__0___1_CM 1 100. 0. 1. DISPLAY_IDENTIFIER LV_LAMB_SP_AFR_REQ_DIAG_ACT[1] ECU_ADDRESS 0xd00058f2 BIT_MASK 0x1 /end MEASUREMENT
/begin MEASUREMENT egcp[0].egcp_struct_pladglsl1.lv_lamb_sp_afl_req_diag_act "Trigger function to change lambda set point for AFL active plauisibility test" UBYTE _CNV_S_2_RANGE__0___1_CM 1 100. 0. 1. DISPLAY_IDENTIFIER LV_LAMB_SP_AFL_REQ_DIAG_ACT[1] ECU_ADDRESS 0xd00058f3 BIT_MASK 0x1 /end MEASUREMENT
/begin MEASUREMENT egcp[0].egcp_struct_pladglsl1.lv_diag_cyc_end_ls_down "End of cycle of active test of downstream sensor" UBYTE _CNV_S_2_RANGE__0___1_CM 1 100. 0. 1. DISPLAY_IDENTIFIER LV_DIAG_CYC_END_LS_DOWN[1] ECU_ADDRESS 0xd00058f4 BIT_MASK 0x1 /end MEASUREMENT
/begin MEASUREMENT egcp[0].egcp_struct_pladglsl1.lv_lam_di_req "Request disable close loop operation of the lambda controller" UBYTE _CNV_S_2_RANGE__0___1_CM 1 100. 0. 1. DISPLAY_IDENTIFIER LV_LAM_DI_REQ[1] ECU_ADDRESS 0xd00058f5 BIT_MASK 0x1 /end MEASUREMENT
/begin MEASUREMENT egcp[0].egcp_struct_pladglsl1.lv_diag_afr_end_ls_up_down "Boolean flag indicating the end of RICH active check" UBYTE _CNV_S_2_RANGE__0___1_CM 1 100. 0. 1. DISPLAY_IDENTIFIER LV_DIAG_AFR_END_LS_UP_DOWN[1] ECU_ADDRESS 0xd00058f6 BIT_MASK 0x1 /end MEASUREMENT
/begin MEASUREMENT egcp[0].egcp_struct_pladglsl1.lv_diag_afl_end_ls_up_down "Boolean flag indicating the end of LEAN active check" UBYTE _CNV_S_2_RANGE__0___1_CM 1 100. 0. 1. DISPLAY_IDENTIFIER LV_DIAG_AFL_END_LS_UP_DOWN[1] ECU_ADDRESS 0xd00058f7 BIT_MASK 0x1 /end MEASUREMENT
/begin MEASUREMENT egcp[0].egcp_struct_pladglsl1.lv_diag_afr_chk_sym_lsl_up "Debounced failure in the upstream sensor during the RICH active check " UBYTE _CNV_S_2_RANGE__0___1_CM 1 100. 0. 1. DISPLAY_IDENTIFIER LV_DIAG_AFR_CHK_SYM_LSL_UP[1] ECU_ADDRESS 0xd00058f8 BIT_MASK 0x1 /end MEASUREMENT
/begin MEASUREMENT egcp[0].egcp_struct_pladglsl1.lv_diag_afl_chk_sym_lsl_up "Debounced failure in the upstream sensor during the LEAN active check" UBYTE _CNV_S_2_RANGE__0___1_CM 1 100. 0. 1. DISPLAY_IDENTIFIER LV_DIAG_AFL_CHK_SYM_LSL_UP[1] ECU_ADDRESS 0xd00058f9 BIT_MASK 0x1 /end MEASUREMENT
/begin MEASUREMENT egcp[0].egcp_struct_pladglsl1.lv_diag_act_chk_cdn_lsl_up "Conditions to run active test of upstream sensor fulfilled" UBYTE _CNV_S_2_RANGE__0___1_CM 1 100. 0. 1. DISPLAY_IDENTIFIER LV_DIAG_ACT_CHK_CDN_LSL_UP[1] ECU_ADDRESS 0xd00058fa BIT_MASK 0x1 /end MEASUREMENT
/begin MEASUREMENT egcp[0].egcp_struct_pladglsl1.lv_diag_act_chk_end_lsl_up "End active test of upstream sensor" UBYTE _CNV_S_2_RANGE__0___1_CM 1 100. 0. 1. DISPLAY_IDENTIFIER LV_DIAG_ACT_CHK_END_LSL_UP[1] ECU_ADDRESS 0xd00058fb BIT_MASK 0x1 /end MEASUREMENT
/begin MEASUREMENT egcp[0].egcp_struct_pladglsl1.lv_diag_eol_end_ls_up_down "Boolean flag, end of active check of the oxygen sensors (EOL test)" UBYTE _CNV_S_2_RANGE__0___1_CM 1 100. 0. 1. DISPLAY_IDENTIFIER LV_DIAG_EOL_END_LS_UP_DOWN[1] ECU_ADDRESS 0xd00058fc BIT_MASK 0x1 /end MEASUREMENT
/begin MEASUREMENT egcp[0].egcp_struct_pladglsl1.lv_diag_eol_dc_ls_up_down "Flag indicating eol test was active in this driving cycle." UBYTE _CNV_S_2_RANGE__0___1_CM 1 100. 0. 1. DISPLAY_IDENTIFIER LV_DIAG_EOL_DC_LS_UP_DOWN[1] ECU_ADDRESS 0xd00058fd BIT_MASK 0x1 /end MEASUREMENT
/begin MEASUREMENT egcp[0].egcp_struct_pladglsl1.lv_sym_afl_chk_ls_down "Symptom of oxygen sensor downstream too lean in case of 2 bank system during end of line test or sensor interchanged test" UBYTE _CNV_S_2_RANGE__0___1_CM 1 100. 0. 1. DISPLAY_IDENTIFIER LV_SYM_AFL_CHK_LS_DOWN[1] ECU_ADDRESS 0xd00058fe BIT_MASK 0x1 /end MEASUREMENT
/begin MEASUREMENT egcp[0].egcp_struct_pladglsl1.lv_sym_afr_chk_ls_down "Symptom of oxygen sensor downstream too rich in case of 2 bank system during end of line test or sensor interchanged test" UBYTE _CNV_S_2_RANGE__0___1_CM 1 100. 0. 1. DISPLAY_IDENTIFIER LV_SYM_AFR_CHK_LS_DOWN[1] ECU_ADDRESS 0xd00058ff BIT_MASK 0x1 /end MEASUREMENT
/begin MEASUREMENT egcp[0].egcp_struct_pladglsl1.lv_diag_act_cdn_ls_up_down "Conditions to perform rich/lean check of open loop diag are fulfilled - not relevant for soft check" UBYTE _CNV_S_2_RANGE__0___1_CM 1 100. 0. 1. DISPLAY_IDENTIFIER LV_DIAG_ACT_CDN_LS_UP_DOWN[1] ECU_ADDRESS 0xd0005900 BIT_MASK 0x1 /end MEASUREMENT
/begin MEASUREMENT egcp[0].egcp_struct_sigdglsl4.t_vls_up_min_diag_oc_lsl_up "Timer for LSL signal under voltage" UWORD _CNV_A_R_LINEAR_____4_CM 1 100. 0. 6553.5 DISPLAY_IDENTIFIER T_VLS_UP_MIN_DIAG_OC_LSL_UP[1] ECU_ADDRESS 0xd0005918 FORMAT "%6.1" /end MEASUREMENT
/begin MEASUREMENT egcp[0].egcp_struct_sigdglsl4.t_wait_sym_obd_2_lsh_up "Waiting time to check if OBD2 upstream heater error is present (to distinguish OC on Vip from Vg)" UWORD _CNV_A_R_LINEAR_____4_CM 1 100. 0. 6553.5 DISPLAY_IDENTIFIER T_WAIT_SYM_OBD_2_LSH_UP[1] ECU_ADDRESS 0xd000591a FORMAT "%6.1" /end MEASUREMENT
/begin MEASUREMENT egcp[0].egcp_struct_sigdglsl4.t_vls_up_afs_diag_oc_lsl_up "Timer for lambda signal being in stoichiometric band while it shouldn't" UWORD _CNV_A_R_LINEAR_____4_CM 1 100. 0. 6553.5 DISPLAY_IDENTIFIER T_VLS_UP_AFS_DIAG_OC_LSL_UP[1] ECU_ADDRESS 0xd000591c FORMAT "%6.1" /end MEASUREMENT
/begin MEASUREMENT egcp[0].egcp_struct_sigdglsl4.t_diag_oc_rst_osc_di "Time to reactivate oscillator for upstream tip temperature measurement" UWORD _CNV_A_R_LINEAR_____4_CM 1 100. 0. 6553.5 DISPLAY_IDENTIFIER T_DIAG_OC_RST_OSC_DI[1] ECU_ADDRESS 0xd000591e FORMAT "%6.1" /end MEASUREMENT
/begin MEASUREMENT egcp[0].egcp_struct_sigdglsl4.t_diag_oc_rst_lamb_sp_req "Time to finish the active check for OC in VIP / VG" UWORD _CNV_A_R_LINEAR_____4_CM 1 100. 0. 6553.5 DISPLAY_IDENTIFIER T_DIAG_OC_RST_LAMB_SP_REQ[1] ECU_ADDRESS 0xd0005920 FORMAT "%6.1" /end MEASUREMENT
/begin MEASUREMENT egcp[0].egcp_struct_sigdglsl4.t_diag_oc_lsl_up "Timer to finish OC diagnosis in case of OBD2 upstream heater error symptom active and conditions for plausibility diagnosis fulfilled" UWORD _CNV_A_R_LINEAR_____4_CM 1 100. 0. 6553.5 DISPLAY_IDENTIFIER T_DIAG_OC_LSL_UP[1] ECU_ADDRESS 0xd0005922 FORMAT "%6.1" /end MEASUREMENT
/begin MEASUREMENT egcp[0].egcp_struct_sigdglsl4.lamb_sp_diag_oc_lsl_up "Requested lambda setpoint for active part of linear sensor open circuit check" UWORD _CNV_A_R_LINEAR_____129_CM 1 100. 0. 31.9990234375 DISPLAY_IDENTIFIER LAMB_SP_DIAG_OC_LSL_UP[1] ECU_ADDRESS 0xd0005924 FORMAT "%7.4" /end MEASUREMENT
/begin MEASUREMENT egcp[0].egcp_struct_sigdglsl4.lamb_sp_delta_oc_lsl_up "Lambda setpoint ramp increment for active part of linear sensor open circuit check" SWORD _CNV_A_R_EGCP_LINEA_350_CM 1 100. -32. 31.999023 DISPLAY_IDENTIFIER LAMB_SP_DELTA_OC_LSL_UP[1] ECU_ADDRESS 0xd0005926 FORMAT "%9.6" /end MEASUREMENT
/begin MEASUREMENT egcp[0].egcp_struct_sigdglsl4.state_diag_oc_lsl_up "Status of the LSL Open Circuit Diagnosis" UBYTE _CNV_S_3_EGCP_RANGE_352_CM 1 100. 0. 2. DISPLAY_IDENTIFIER STATE_DIAG_OC_LSL_UP[1] ECU_ADDRESS 0xd0005928 /end MEASUREMENT
/begin MEASUREMENT egcp[0].egcp_struct_sigdglsl4.lv_diag_oc_if_osc_di_lsl_up "Request stop oscillator used to determine sensor internal resistance " UBYTE _CNV_S_2_RANGE__0___1_CM 1 100. 0. 1. DISPLAY_IDENTIFIER LV_DIAG_OC_IF_OSC_DI_LSL_UP[1] ECU_ADDRESS 0xd0005929 BIT_MASK 0x1 /end MEASUREMENT
/begin MEASUREMENT egcp[0].egcp_struct_sigdglsl4.lv_vls_up_min_diag_oc_lsl_up "Bit indicating LSL undervoltage " UBYTE _CNV_S_2_RANGE__0___1_CM 1 100. 0. 1. DISPLAY_IDENTIFIER LV_VLS_UP_MIN_DIAG_OC_LSL_UP[1] ECU_ADDRESS 0xd000592a BIT_MASK 0x1 /end MEASUREMENT
/begin MEASUREMENT egcp[0].egcp_struct_sigdglsl4.lv_vls_up_afs_diag_oc_lsl_up "Bit indicating LSL stoichiometric voltage " UBYTE _CNV_S_2_RANGE__0___1_CM 1 100. 0. 1. DISPLAY_IDENTIFIER LV_VLS_UP_AFS_DIAG_OC_LSL_UP[1] ECU_ADDRESS 0xd000592b BIT_MASK 0x1 /end MEASUREMENT
/begin MEASUREMENT egcp[0].egcp_struct_sigdglsli4.lv_inh_diag_oc_lsl_up "Deactivation of \"Open Circuit Diagnosis\"" UBYTE _CNV_S_2_RANGE__0___1_CM 1 100. 0. 1. DISPLAY_IDENTIFIER LV_INH_DIAG_OC_LSL_UP[1] ECU_ADDRESS 0xd000592c BIT_MASK 0x1 /end MEASUREMENT
/begin MEASUREMENT egcp[1].egcp_struct_outdglshi0.lv_inh_diag_lsh_up "Inhibit flag for upstream oxygen sensor heater OBDI diagnosis" UBYTE _CNV_S_2_RANGE__0___1_CM 1 100. 0. 1. DISPLAY_IDENTIFIER LV_INH_DIAG_LSH_UP[2] ECU_ADDRESS 0xd0005a64 BIT_MASK 0x1 /end MEASUREMENT
/begin MEASUREMENT egcp[1].egcp_struct_outdglshd0.err_diag_lsh_down "raw value of error symptom for downstream heater diagnosis OBD I" UBYTE _CNV_A_R_LINEAR_____0_CM 1 100. 0. 7. DISPLAY_IDENTIFIER ERR_DIAG_LSH_DOWN[2] ECU_ADDRESS 0xd0005a66 FORMAT "%3.0" /end MEASUREMENT
/begin MEASUREMENT egcp[1].egcp_struct_outdglshd0.cdn_diag_lsh_down "Diagnosis condition for each symptom of downstream heater diagnosis OBD I" UBYTE _CNV_A_R_LINEAR_____0_CM 1 100. 0. 7. DISPLAY_IDENTIFIER CDN_DIAG_LSH_DOWN[2] ECU_ADDRESS 0xd0005a67 FORMAT "%3.0" /end MEASUREMENT
/begin MEASUREMENT egcp[1].egcp_struct_outdglshdi0.lv_inh_diag_lsh_down "Inhibit flag for downstream oxygen sensor heater OBDI diagnosis" UBYTE _CNV_S_2_RANGE__0___1_CM 1 100. 0. 1. DISPLAY_IDENTIFIER LV_INH_DIAG_LSH_DOWN[2] ECU_ADDRESS 0xd0005a68 BIT_MASK 0x1 /end MEASUREMENT
/begin MEASUREMENT egcp[1].egcp_struct_pladglsd2.maf_int_puc_not_ls_down_diag "MAF integral out of PUC in case of certain load threshold exceeded" UWORD _CNV_A_R_LINEAR_____314_CM 1 100. 0. 2912.66666666667 DISPLAY_IDENTIFIER MAF_INT_PUC_NOT_LS_DOWN_DIAG[2] ECU_ADDRESS 0xd0005a6c FORMAT "%7.2" /end MEASUREMENT
/begin MEASUREMENT egcp[1].egcp_struct_pladglsd2.maf_int_fl "integral of air mass flow  while FL active" UWORD _CNV_A_R_LINEAR_____287_CM 1 100. 0. 1820.41666666667 DISPLAY_IDENTIFIER MAF_INT_FL[2] ECU_ADDRESS 0xd0005a6e FORMAT "%7.2" /end MEASUREMENT
/begin MEASUREMENT egcp[1].egcp_struct_pladglsd2.vls_down_puc_ok "Last VLS_DOWN value satisfying PUC plausibility" UWORD _CNV_A_R_LINEAR_____2_CM 1 100. 0. 4.9951171875 DISPLAY_IDENTIFIER VLS_DOWN_PUC_OK[2] ECU_ADDRESS 0xd0005a70 FORMAT "%5.3" /end MEASUREMENT
/begin MEASUREMENT egcp[1].egcp_struct_pladglsd2.vls_down_puc_err "Last VLS_DOWN value not plausible for PUC conditions" UWORD _CNV_A_R_LINEAR_____2_CM 1 100. 0. 4.9951171875 DISPLAY_IDENTIFIER VLS_DOWN_PUC_ERR[2] ECU_ADDRESS 0xd0005a72 FORMAT "%5.3" /end MEASUREMENT
/begin MEASUREMENT egcp[1].egcp_struct_pladglsd2.vls_down_puc_save "Mode 6 value describing last VLS_DOWN PUC plausibility result" UWORD _CNV_A_R_LINEAR_____2_CM 1 100. 0. 4.9951171875 DISPLAY_IDENTIFIER VLS_DOWN_PUC_SAVE[2] ECU_ADDRESS 0xd0005a74 FORMAT "%5.3" /end MEASUREMENT
/begin MEASUREMENT egcp[1].egcp_struct_pladglsd2.lv_err_plaus_ls_down "Boolean flag, error plausibility check on downstream oxygen sensor signal" UBYTE _CNV_S_2_RANGE__0___1_CM 1 100. 0. 1. DISPLAY_IDENTIFIER LV_ERR_PLAUS_LS_DOWN[2] ECU_ADDRESS 0xd0005a76 BIT_MASK 0x1 /end MEASUREMENT
/begin MEASUREMENT egcp[1].egcp_struct_pladglsd2.lv_diag_cdn_plaus_ls_down "Boolean flag, plausibility check on downstream oxygen sensor signal possible" UBYTE _CNV_S_2_RANGE__0___1_CM 1 100. 0. 1. DISPLAY_IDENTIFIER LV_DIAG_CDN_PLAUS_LS_DOWN[2] ECU_ADDRESS 0xd0005a77 BIT_MASK 0x1 /end MEASUREMENT
/begin MEASUREMENT egcp[1].egcp_struct_pladglsd2.lv_diag_puc_chg_ls_down "reminder flag for fuel cut off was active" UBYTE _CNV_S_2_RANGE__0___1_CM 1 100. 0. 1. DISPLAY_IDENTIFIER LV_DIAG_PUC_CHG_LS_DOWN[2] ECU_ADDRESS 0xd0005a78 BIT_MASK 0x1 /end MEASUREMENT
/begin MEASUREMENT egcp[1].egcp_struct_pladgspi0.ctr_err_save_diag_lsl_up_if "Number of communication errors during the WRAF sensor controller initialization " UBYTE _CNV_A_R_LINEAR_____0_CM 1 100. 0. 255. DISPLAY_IDENTIFIER CTR_ERR_SAVE_DIAG_LSL_UP_IF[2] ECU_ADDRESS 0xd0005a7c FORMAT "%3.0" /end MEASUREMENT
/begin MEASUREMENT egcp[1].egcp_struct_pladgspi0.ctr_delta_lsl_up_if "Increment of error counter since initialization respectively since last increment of error counter" UBYTE _CNV_A_R_LINEAR_____0_CM 1 100. 0. 255. DISPLAY_IDENTIFIER CTR_DELTA_LSL_UP_IF[2] ECU_ADDRESS 0xd0005a7d FORMAT "%3.0" /end MEASUREMENT
/begin MEASUREMENT egcp[1].egcp_struct_pladgspii0.lv_inh_diag_lsl_up_if "Inhibit diagnosis" UBYTE _CNV_S_2_RANGE__0___1_CM 1 100. 0. 1. DISPLAY_IDENTIFIER LV_INH_DIAG_LSL_UP_IF[2] ECU_ADDRESS 0xd0005a7e BIT_MASK 0x1 /end MEASUREMENT
/begin MEASUREMENT egcp[1].egcp_struct_sigdglsd1.t_act_pls_diag_scg_ls_down "Delay time for final diagnosis activation " UWORD _CNV_A_R_LINEAR_____4_CM 1 100. 0. 6553.5 DISPLAY_IDENTIFIER T_ACT_PLS_DIAG_SCG_LS_DOWN[2] ECU_ADDRESS 0xd0005b10 FORMAT "%6.1" /end MEASUREMENT
/begin MEASUREMENT egcp[1].egcp_struct_sigdglsd1.t_act_pls_diag_oc_ls_down "Delay time for final diagnosis activation " UWORD _CNV_A_R_LINEAR_____4_CM 1 100. 0. 6553.5 DISPLAY_IDENTIFIER T_ACT_PLS_DIAG_OC_LS_DOWN[2] ECU_ADDRESS 0xd0005b12 FORMAT "%6.1" /end MEASUREMENT
/begin MEASUREMENT egcp[1].egcp_struct_sigdglsd1.t_cdn_diag_oc_ls_down "Detection time for status OC before diagnosis" UWORD _CNV_A_R_LINEAR_____4_CM 1 100. 0. 6553.5 DISPLAY_IDENTIFIER T_CDN_DIAG_OC_LS_DOWN[2] ECU_ADDRESS 0xd0005b14 FORMAT "%6.1" /end MEASUREMENT
/begin MEASUREMENT egcp[1].egcp_struct_sigdglsd1.ctr_r_upd_diag_scg_ls_down "Value of handshake counter for last valid resistance value used for short circuit to ground diagnosis" UWORD _CNV_A_R_LINEAR_____0_CM 1 100. 0. 65535. DISPLAY_IDENTIFIER CTR_R_UPD_DIAG_SCG_LS_DOWN[2] ECU_ADDRESS 0xd0005b16 FORMAT "%5.0" /end MEASUREMENT
/begin MEASUREMENT egcp[1].egcp_struct_sigdglsd1.ctr_r_upd_diag_oc_ls_down "Value of handshake counter for last valid resistance value used for diagnosis" UWORD _CNV_A_R_LINEAR_____0_CM 1 100. 0. 65535. DISPLAY_IDENTIFIER CTR_R_UPD_DIAG_OC_LS_DOWN[2] ECU_ADDRESS 0xd0005b18 FORMAT "%5.0" /end MEASUREMENT
/begin MEASUREMENT egcp[1].egcp_struct_sigdglsd1.ctr_sym_diag_scg_ls_down "Detection time for SCG " UBYTE _CNV_A_R_LINEAR_____0_CM 1 100. 0. 255. DISPLAY_IDENTIFIER CTR_SYM_DIAG_SCG_LS_DOWN[2] ECU_ADDRESS 0xd0005b1a FORMAT "%3.0" /end MEASUREMENT
/begin MEASUREMENT egcp[1].egcp_struct_sigdglsd1.lv_err_el_ls_down "Boolean error flag, electrical fault currently present on downstream oxygen sensor signal" UBYTE _CNV_S_2_RANGE__0___1_CM 1 100. 0. 1. DISPLAY_IDENTIFIER LV_ERR_EL_LS_DOWN[2] ECU_ADDRESS 0xd0005b1b BIT_MASK 0x1 /end MEASUREMENT
/begin MEASUREMENT egcp[1].egcp_struct_sigdglsd1.lv_diag_act_req_ls_down "Request for starting the downstream sensor active plausibility check" UBYTE _CNV_S_2_RANGE__0___1_CM 1 100. 0. 1. DISPLAY_IDENTIFIER LV_DIAG_ACT_REQ_LS_DOWN[2] ECU_ADDRESS 0xd0005b1c BIT_MASK 0x1 /end MEASUREMENT
/begin MEASUREMENT egcp[1].egcp_struct_sigdglsd1.lv_r_it_vld_diag_oc_ls_down "Valid conditions of resistance of downstream oxygen sensor open circuit diagnosis" UBYTE _CNV_S_2_RANGE__0___1_CM 1 100. 0. 1. DISPLAY_IDENTIFIER LV_R_IT_VLD_DIAG_OC_LS_DOWN[2] ECU_ADDRESS 0xd0005b1d BIT_MASK 0x1 /end MEASUREMENT
/begin MEASUREMENT egcp[1].egcp_struct_sigdglsd1.lv_t_cdn_diag_oc_ls_down "Boolean error flag, short to plus fault currently present on downstream oxygen sensor signal" UBYTE _CNV_S_2_RANGE__0___1_CM 1 100. 0. 1. DISPLAY_IDENTIFIER LV_T_CDN_DIAG_OC_LS_DOWN[2] ECU_ADDRESS 0xd0005b1e BIT_MASK 0x1 /end MEASUREMENT
/begin MEASUREMENT egcp[1].egcp_struct_sigdglsdi1.lv_inh_diag_oc_ls_down "Boolean flag indicating project specific application conditions for downstream open line diagnosis not met" UBYTE _CNV_S_2_RANGE__0___1_CM 1 100. 0. 1. DISPLAY_IDENTIFIER LV_INH_DIAG_OC_LS_DOWN[2] ECU_ADDRESS 0xd0005b20 BIT_MASK 0x1 /end MEASUREMENT
/begin MEASUREMENT egcp[1].egcp_struct_sigdglsdi1.lv_inh_diag_puc_ls_down "Boolean flag indicating project specific application conditions for downstream PUC diagnosis not met" UBYTE _CNV_S_2_RANGE__0___1_CM 1 100. 0. 1. DISPLAY_IDENTIFIER LV_INH_DIAG_PUC_LS_DOWN[2] ECU_ADDRESS 0xd0005b21 BIT_MASK 0x1 /end MEASUREMENT
/begin MEASUREMENT egcp[1].egcp_struct_sigdglsdi1.lv_inh_diag_fl_ls_down "Boolean flag indicating project specific application conditions for downstream FL diagnosis not met" UBYTE _CNV_S_2_RANGE__0___1_CM 1 100. 0. 1. DISPLAY_IDENTIFIER LV_INH_DIAG_FL_LS_DOWN[2] ECU_ADDRESS 0xd0005b22 BIT_MASK 0x1 /end MEASUREMENT
/begin MEASUREMENT egcp[1].egcp_struct_sigdglsdi1.lv_inh_diag_scg_ls_down "Boolean flag indicating project specific application conditions for downstream SCG diagnosis not met" UBYTE _CNV_S_2_RANGE__0___1_CM 1 100. 0. 1. DISPLAY_IDENTIFIER LV_INH_DIAG_SCG_LS_DOWN[2] ECU_ADDRESS 0xd0005b23 BIT_MASK 0x1 /end MEASUREMENT
/begin MEASUREMENT egcp[1].egcp_struct_sigdglsdi1.lv_inh_diag_scp_ls_down "Boolean flag indicating project specific application conditions for downstream short to plus diagnosis not met" UBYTE _CNV_S_2_RANGE__0___1_CM 1 100. 0. 1. DISPLAY_IDENTIFIER LV_INH_DIAG_SCP_LS_DOWN[2] ECU_ADDRESS 0xd0005b24 BIT_MASK 0x1 /end MEASUREMENT
/begin MEASUREMENT egcp[1].egcp_struct_sigdglsla0.t_dly_diag_el_lsl_up "Delay timer to start the electrical failure diagnosis " UWORD _CNV_A_R_LINEAR_____3_CM 1 100. 0. 655.35 DISPLAY_IDENTIFIER T_DLY_DIAG_EL_LSL_UP[2] ECU_ADDRESS 0xd0005b28 FORMAT "%6.2" /end MEASUREMENT
/begin MEASUREMENT egcp[1].egcp_struct_sigdglsla0.ctr_iplsl_sym_diag_lsl_up "Error debounce counter" UWORD _CNV_A_R_LINEAR_____0_CM 1 100. 0. 65535. DISPLAY_IDENTIFIER CTR_IPLSL_SYM_DIAG_LSL_UP[2] ECU_ADDRESS 0xd0005b2a FORMAT "%5.0" /end MEASUREMENT
/begin MEASUREMENT egcp[1].egcp_struct_sigdglsla0.iplsl_sym_diag_lsl_up "Symptoms of the WRAF sensor Pump Current Controller Diagnosis" UBYTE _CNV_S_5_EGCP_RANGE_338_CM 1 100. 0. 8. DISPLAY_IDENTIFIER IPLSL_SYM_DIAG_LSL_UP[2] ECU_ADDRESS 0xd0005b2c /end MEASUREMENT
/begin MEASUREMENT egcp[1].egcp_struct_sigdglsla0.state_err_el_lsl_up "State to get visible the separate OBD-I failures" UBYTE _CNV_S_11_EGCP_RANGE_339_CM 1 100. 0. 10. DISPLAY_IDENTIFIER STATE_ERR_EL_LSL_UP[2] ECU_ADDRESS 0xd0005b2d /end MEASUREMENT
/begin MEASUREMENT egcp[1].egcp_struct_sigdglsla0.lv_lsl_up_spi_com_inh "Inhibit bit for the SPI-communication" UBYTE _CNV_S_2_RANGE__0___1_CM 1 100. 0. 1. DISPLAY_IDENTIFIER LV_LSL_UP_SPI_COM_INH[2] ECU_ADDRESS 0xd0005b2e BIT_MASK 0x1 /end MEASUREMENT
/begin MEASUREMENT egcp[1].egcp_struct_sigdglsla0.lv_diag_iplsl_sym_lsl_up "Pump Current Controller in Limitation for too long time" UBYTE _CNV_S_2_RANGE__0___1_CM 1 100. 0. 1. DISPLAY_IDENTIFIER LV_DIAG_IPLSL_SYM_LSL_UP[2] ECU_ADDRESS 0xd0005b2f BIT_MASK 0x1 /end MEASUREMENT
/begin MEASUREMENT egcp[1].egcp_struct_sigdglsla0.lv_diag_iplsl_cdn_lsl_up "Conditions to run the WRAF sensor Pump Current Controller Diagnosis" UBYTE _CNV_S_2_RANGE__0___1_CM 1 100. 0. 1. DISPLAY_IDENTIFIER LV_DIAG_IPLSL_CDN_LSL_UP[2] ECU_ADDRESS 0xd0005b30 BIT_MASK 0x1 /end MEASUREMENT
/begin MEASUREMENT egcp[1].egcp_struct_sigdglsla0.lv_diag_act_el_lsl_up "Logical Value for diagnosis active (=1) or not (=0)" UBYTE _CNV_S_2_RANGE__0___1_CM 1 100. 0. 1. DISPLAY_IDENTIFIER LV_DIAG_ACT_EL_LSL_UP[2] ECU_ADDRESS 0xd0005b31 BIT_MASK 0x1 /end MEASUREMENT
/begin MEASUREMENT egcp[1].egcp_struct_sigdglslai0.lv_inh_diag_el_lsl_up "Deactivation of \"HW-Based Diagnosis\"" UBYTE _CNV_S_2_RANGE__0___1_CM 1 100. 0. 1. DISPLAY_IDENTIFIER LV_INH_DIAG_EL_LSL_UP[2] ECU_ADDRESS 0xd0005b34 BIT_MASK 0x1 /end MEASUREMENT
/begin MEASUREMENT egcp[1].egcp_struct_sigdglslai0.lv_iplsl_diag_inh_lsl_up "Deactivation of \"HW-Based Diagnosis with the CJ120\"" UBYTE _CNV_S_2_RANGE__0___1_CM 1 100. 0. 1. DISPLAY_IDENTIFIER LV_IPLSL_DIAG_INH_LSL_UP[2] ECU_ADDRESS 0xd0005b35 BIT_MASK 0x1 /end MEASUREMENT
/begin MEASUREMENT egcp[1].egcp_struct_pladgft0.lam_mmv_vls_dif_dly_ldc "Floating mean value for limited lambda deviation" SWORD _CNV_A_R_LINEAR_____113_CM 1 100. -50. 49.9984741210938 DISPLAY_IDENTIFIER LAM_MMV_VLS_DIF_DLY_LDC[2] ECU_ADDRESS 0xd0005b38 FORMAT "%7.3" /end MEASUREMENT
/begin MEASUREMENT egcp[1].egcp_struct_pladgft0.maf_int_vls_dif_dly_min "MAF integral for lower VLS_DIF_DLY deviation" UWORD _CNV_A_R_LINEAR_____287_CM 1 100. 0. 1820.41666666667 DISPLAY_IDENTIFIER MAF_INT_VLS_DIF_DLY_MIN[2] ECU_ADDRESS 0xd0005b3a FORMAT "%7.2" /end MEASUREMENT
/begin MEASUREMENT egcp[1].egcp_struct_pladgft0.maf_int_vls_dif_dly_max "MAF integral for upper VLS_DIF_DLY deviation" UWORD _CNV_A_R_LINEAR_____287_CM 1 100. 0. 1820.41666666667 DISPLAY_IDENTIFIER MAF_INT_VLS_DIF_DLY_MAX[2] ECU_ADDRESS 0xd0005b3c FORMAT "%7.2" /end MEASUREMENT
/begin MEASUREMENT egcp[1].egcp_struct_pladgft0.maf_int_vls_dif_dly_ldc "Integral of mass air flow since limited dynamic conditions fulfilled" UWORD _CNV_A_R_LINEAR_____340_CM 1 100. 0. 1389. DISPLAY_IDENTIFIER MAF_INT_VLS_DIF_DLY_LDC[2] ECU_ADDRESS 0xd0005b3e FORMAT "%7.2" /end MEASUREMENT
/begin MEASUREMENT egcp[1].egcp_struct_pladgft0.maf_int_rst_vls_down_dif_diag "Integral to start a new diagnostic cycle and to set the end flag" UWORD _CNV_A_R_LINEAR_____287_CM 1 100. 0. 1820.41666666667 DISPLAY_IDENTIFIER MAF_INT_RST_VLS_DOWN_DIF_DIAG[2] ECU_ADDRESS 0xd0005b40 FORMAT "%7.2" /end MEASUREMENT
/begin MEASUREMENT egcp[1].egcp_struct_pladgft0.t_sum_max_delta_i_lam "Total duration over C_LAMB_DELTA_I_MAX_DIAG" UWORD _CNV_A_R_LINEAR_____4_CM 1 100. 0. 6553.5 DISPLAY_IDENTIFIER T_SUM_MAX_DELTA_I_LAM[2] ECU_ADDRESS 0xd0005b42 FORMAT "%6.1" /end MEASUREMENT
/begin MEASUREMENT egcp[1].egcp_struct_pladgft0.t_sum_min_delta_i_lam "Total duration over C_LAMB_DELTA_I_MIN_DIAG" UWORD _CNV_A_R_LINEAR_____4_CM 1 100. 0. 6553.5 DISPLAY_IDENTIFIER T_SUM_MIN_DELTA_I_LAM[2] ECU_ADDRESS 0xd0005b44 FORMAT "%6.1" /end MEASUREMENT
/begin MEASUREMENT egcp[1].egcp_struct_pladgft0.t_sum_end_diag_win_delta_i_lam "Time counter to set LV_END_DIAG_WIN_DELTA_I_LAM[i] for similar conditions window" UWORD _CNV_A_R_LINEAR_____4_CM 1 100. 0. 6553.5 DISPLAY_IDENTIFIER T_SUM_END_DIAG_WIN_DELTA_I_LAM[2] ECU_ADDRESS 0xd0005b46 FORMAT "%6.1" /end MEASUREMENT
/begin MEASUREMENT egcp[1].egcp_struct_pladgft0.t_sum_end_ready_delta_i_lam "Second time counter to set LV_END_DIAG_DELTA_I_LAM[i]" UWORD _CNV_A_R_LINEAR_____4_CM 1 100. 0. 6553.5 DISPLAY_IDENTIFIER T_SUM_END_READY_DELTA_I_LAM[2] ECU_ADDRESS 0xd0005b48 FORMAT "%6.1" /end MEASUREMENT
/begin MEASUREMENT egcp[1].egcp_struct_pladgft0.t_sum_rst_delta_i_lam "Time counter to reset T_SUM_MAX_DELTA_I_LAM[i] and T_SUM_MIN_DELTA_I_LAM[i]." UWORD _CNV_A_R_LINEAR_____4_CM 1 100. 0. 6553.5 DISPLAY_IDENTIFIER T_SUM_RST_DELTA_I_LAM[2] ECU_ADDRESS 0xd0005b4a FORMAT "%6.1" /end MEASUREMENT
/begin MEASUREMENT egcp[1].egcp_struct_pladgft0.lamb_delta_i_save_diag "I-share from trim controller  - to be transmitted to the Scan Tool mode06" SWORD _CNV_A_R_LINEAR_____24_CM 1 100. -0.125 0.125 DISPLAY_IDENTIFIER LAMB_DELTA_I_SAVE_DIAG[2] ECU_ADDRESS 0xd0005b4c FORMAT "%8.5" /end MEASUREMENT
/begin MEASUREMENT egcp[1].egcp_struct_pladgft0.err_sym_lam_adj "Symptoms of the lambda trim control errors" UBYTE _CNV_S_5_EGCP_RANGE_338_CM 1 100. 0. 8. DISPLAY_IDENTIFIER ERR_SYM_LAM_ADJ[2] ECU_ADDRESS 0xd0005b4e /end MEASUREMENT
/begin MEASUREMENT egcp[1].egcp_struct_pladgft0.lv_vls_dif_dly_ldc "Status limited dynamic for the function \"Monitoring Trim Controller Deviation\"" UBYTE _CNV_S_2_RANGE__0___1_CM 1 100. 0. 1. DISPLAY_IDENTIFIER LV_VLS_DIF_DLY_LDC[2] ECU_ADDRESS 0xd0005b4f BIT_MASK 0x1 /end MEASUREMENT
/begin MEASUREMENT egcp[1].egcp_struct_pladgft0.lv_vls_dif_dly_ldc_lam_mv "Status limited dynamic FAC_LAM_MV[i]" UBYTE _CNV_S_2_RANGE__0___1_CM 1 100. 0. 1. DISPLAY_IDENTIFIER LV_VLS_DIF_DLY_LDC_LAM_MV[2] ECU_ADDRESS 0xd0005b50 BIT_MASK 0x1 /end MEASUREMENT
/begin MEASUREMENT egcp[1].egcp_struct_pladgft0.lv_end_diag_lam_adj "Diagnostic cycle for lambda trim control complete" UBYTE _CNV_S_2_RANGE__0___1_CM 1 100. 0. 1. DISPLAY_IDENTIFIER LV_END_DIAG_LAM_ADJ[2] ECU_ADDRESS 0xd0005b51 BIT_MASK 0x1 /end MEASUREMENT
/begin MEASUREMENT egcp[1].egcp_struct_pladgft0.lv_err_lam_adj "Status diagnostic result of lambda trim control" UBYTE _CNV_S_2_RANGE__0___1_CM 1 100. 0. 1. DISPLAY_IDENTIFIER LV_ERR_LAM_ADJ[2] ECU_ADDRESS 0xd0005b52 BIT_MASK 0x1 /end MEASUREMENT
/begin MEASUREMENT egcp[1].egcp_struct_pladgft0.lv_end_diag_win_delta_i_lam "End of diagnosis cycle for similar conditions window" UBYTE _CNV_S_2_RANGE__0___1_CM 1 100. 0. 1. DISPLAY_IDENTIFIER LV_END_DIAG_WIN_DELTA_I_LAM[2] ECU_ADDRESS 0xd0005b53 BIT_MASK 0x1 /end MEASUREMENT
/begin MEASUREMENT egcp[1].egcp_struct_pladgft0.lv_det_sym_eve_delta_i_lam "Bit for second time counter DELTA_I_LAM (T_SUM_END_READY_DELTA_I_LAM[i])" UBYTE _CNV_S_2_RANGE__0___1_CM 1 100. 0. 1. DISPLAY_IDENTIFIER LV_DET_SYM_EVE_DELTA_I_LAM[2] ECU_ADDRESS 0xd0005b54 BIT_MASK 0x1 /end MEASUREMENT
/begin MEASUREMENT egcp[1].egcp_struct_pladgfti0.lv_inh_diag_dly_lam "Inhibition condition for the dynamic fuel trim diagnosis" UBYTE _CNV_S_2_RANGE__0___1_CM 1 100. 0. 1. DISPLAY_IDENTIFIER LV_INH_DIAG_DLY_LAM[2] ECU_ADDRESS 0xd0005b58 BIT_MASK 0x1 /end MEASUREMENT
/begin MEASUREMENT egcp[1].egcp_struct_pladgfti0.lv_inh_diag_rbm_dly_lam "Inhibition of the dynamic fuel trim diagnosis due to failures" UBYTE _CNV_S_2_RANGE__0___1_CM 1 100. 0. 1. DISPLAY_IDENTIFIER LV_INH_DIAG_RBM_DLY_LAM[2] ECU_ADDRESS 0xd0005b59 BIT_MASK 0x1 /end MEASUREMENT
/begin MEASUREMENT egcp[1].egcp_struct_fctdglslh0.ttip_mes_ls_up_obd_lsh_up "Most current oxygen sensor temperature (Mode 6 information)" SWORD _CNV_A_R_LINEAR_____130_CM 1 100. -2048. 2047.9375 DISPLAY_IDENTIFIER TTIP_MES_LS_UP_OBD_LSH_UP[2] ECU_ADDRESS 0xd0005b5c FORMAT "%10.4" /end MEASUREMENT
/begin MEASUREMENT egcp[1].egcp_struct_fctdglslh0.tcc_end_diag_obd_lsh_up "Counter for end flag determination of TTIP_MES diagnosis" UWORD _CNV_A_R_LINEAR_____0_CM 1 100. 0. 65535. DISPLAY_IDENTIFIER TCC_END_DIAG_OBD_LSH_UP[2] ECU_ADDRESS 0xd0005b5e FORMAT "%5.0" /end MEASUREMENT
/begin MEASUREMENT egcp[1].egcp_struct_fctdglslh0.tcc_err_obd_lsh_up "Number of diagnosis cycles in which temperature deviation exceeding limits present" UWORD _CNV_A_R_LINEAR_____0_CM 1 100. 0. 65535. DISPLAY_IDENTIFIER TCC_ERR_OBD_LSH_UP[2] ECU_ADDRESS 0xd0005b60 FORMAT "%5.0" /end MEASUREMENT
/begin MEASUREMENT egcp[1].egcp_struct_fctdglslh0.state_sym_obd_lsl_lsh_up "Variable indicating status of each symptom, updated each recurrence & at diagnosis completion" UBYTE _CNV_S_4_EGCP_RANGE_341_CM 1 100. 0. 4. DISPLAY_IDENTIFIER STATE_SYM_OBD_LSL_LSH_UP[2] ECU_ADDRESS 0xd0005b62 /end MEASUREMENT
/begin MEASUREMENT egcp[1].egcp_struct_fctdglslh0.lv_lamb_pls_req_diag_lsh_up "Boolean flag requesting exaggerated forced stimulation" UBYTE _CNV_S_2_RANGE__0___1_CM 1 100. 0. 1. DISPLAY_IDENTIFIER LV_LAMB_PLS_REQ_DIAG_LSH_UP[2] ECU_ADDRESS 0xd0005b63 BIT_MASK 0x1 /end MEASUREMENT
/begin MEASUREMENT egcp[1].egcp_struct_fctdglslh0.lv_diag_obd_cdn_lsh_up "Boolean flag indicating that conditions for diagnosis met" UBYTE _CNV_S_2_RANGE__0___1_CM 1 100. 0. 1. DISPLAY_IDENTIFIER LV_DIAG_OBD_CDN_LSH_UP[2] ECU_ADDRESS 0xd0005b64 BIT_MASK 0x1 /end MEASUREMENT
/begin MEASUREMENT egcp[1].egcp_struct_fctdglslh0.lv_diag_obd_sym_lsh_up "Boolean flag indicating that fault is present and has been debounced" UBYTE _CNV_S_2_RANGE__0___1_CM 1 100. 0. 1. DISPLAY_IDENTIFIER LV_DIAG_OBD_SYM_LSH_UP[2] ECU_ADDRESS 0xd0005b65 BIT_MASK 0x1 /end MEASUREMENT
/begin MEASUREMENT egcp[1].egcp_struct_fctdglslh0.lv_diag_obd_end_lsh_up "Boolean flag indicating that diagnosis has been completed" UBYTE _CNV_S_2_RANGE__0___1_CM 1 100. 0. 1. DISPLAY_IDENTIFIER LV_DIAG_OBD_END_LSH_UP[2] ECU_ADDRESS 0xd0005b66 BIT_MASK 0x1 /end MEASUREMENT
/begin MEASUREMENT egcp[1].egcp_struct_fctdglshd1.r_it_thd_obd_lsh_down "Threshold for most current downstream oxygen sensor internal resistance used for diagnosis cycle, Mode 6 information" UWORD _CNV_A_R_LINEAR_____0_CM 1 100. 0. 65535. DISPLAY_IDENTIFIER R_IT_THD_OBD_LSH_DOWN[2] ECU_ADDRESS 0xd0005b68 FORMAT "%5.0" /end MEASUREMENT
/begin MEASUREMENT egcp[1].egcp_struct_fctdglshd1.r_it_obd_lsh_down "Most current downstream oxygen sensor internal resistance used for diagnosis cycle, Mode 6 information" UWORD _CNV_A_R_LINEAR_____0_CM 1 100. 0. 65535. DISPLAY_IDENTIFIER R_IT_OBD_LSH_DOWN[2] ECU_ADDRESS 0xd0005b6a FORMAT "%5.0" /end MEASUREMENT
/begin MEASUREMENT egcp[1].egcp_struct_fctdglshd1.r_it_l_mes_obd_lsh_down "Latest measured downstream oxygen sensor internal resistance value for no error case, mode 6 information" UWORD _CNV_A_R_LINEAR_____318_CM 1 100. 0. 65535. DISPLAY_IDENTIFIER R_IT_L_MES_OBD_LSH_DOWN[2] ECU_ADDRESS 0xd0005b6c FORMAT "%5.0" /end MEASUREMENT
/begin MEASUREMENT egcp[1].egcp_struct_fctdglshd1.r_it_l_ref_obd_lsh_down "Latest reference value for measured internal resistance downstream in no error case, mode 6 information" UWORD _CNV_A_R_LINEAR_____318_CM 1 100. 0. 65535. DISPLAY_IDENTIFIER R_IT_L_REF_OBD_LSH_DOWN[2] ECU_ADDRESS 0xd0005b6e FORMAT "%5.0" /end MEASUREMENT
/begin MEASUREMENT egcp[1].egcp_struct_fctdglshd1.r_it_h_mes_obd_lsh_down "Latest measured downstream oxygen sensor internal resistance value for error case, mode 6 information" UWORD _CNV_A_R_LINEAR_____318_CM 1 100. 0. 65535. DISPLAY_IDENTIFIER R_IT_H_MES_OBD_LSH_DOWN[2] ECU_ADDRESS 0xd0005b70 FORMAT "%5.0" /end MEASUREMENT
/begin MEASUREMENT egcp[1].egcp_struct_fctdglshd1.r_it_h_ref_obd_lsh_down "Latest reference value for measured internal resistance downstream in error case, mode 6 information" UWORD _CNV_A_R_LINEAR_____318_CM 1 100. 0. 65535. DISPLAY_IDENTIFIER R_IT_H_REF_OBD_LSH_DOWN[2] ECU_ADDRESS 0xd0005b72 FORMAT "%5.0" /end MEASUREMENT
/begin MEASUREMENT egcp[1].egcp_struct_fctdglshd1.temp_dif_obd_lsh_down "Indicates difference in temperature between set operating temperature & exhaust gas at sensor location" UWORD _CNV_A_R_EGCP_LINEA_342_CM 1 100. 0. 2047. DISPLAY_IDENTIFIER TEMP_DIF_OBD_LSH_DOWN[2] ECU_ADDRESS 0xd0005b74 FORMAT "%4.0" /end MEASUREMENT
/begin MEASUREMENT egcp[1].egcp_struct_fctdglshd1.pow_int_obd_lsh_down "Integral indicates measure of cooling energy of exhaust gas at sensor location" UWORD _CNV_A_R_LINEAR_____320_CM 1 100. 0. 65535. DISPLAY_IDENTIFIER POW_INT_OBD_LSH_DOWN[2] ECU_ADDRESS 0xd0005b76 FORMAT "%5.0" /end MEASUREMENT
/begin MEASUREMENT egcp[1].egcp_struct_fctdglshd1.tcc_vld_obd_lsh_down "Number of completed valid diagnosis cycles" UWORD _CNV_A_R_LINEAR_____0_CM 1 100. 0. 1023. DISPLAY_IDENTIFIER TCC_VLD_OBD_LSH_DOWN[2] ECU_ADDRESS 0xd0005b78 FORMAT "%4.0" /end MEASUREMENT
/begin MEASUREMENT egcp[1].egcp_struct_fctdglshd1.tcc_err_obd_lsh_down "Number of faults detected during valid diagnosis cycles" UWORD _CNV_A_R_LINEAR_____0_CM 1 100. 0. 1023. DISPLAY_IDENTIFIER TCC_ERR_OBD_LSH_DOWN[2] ECU_ADDRESS 0xd0005b7a FORMAT "%4.0" /end MEASUREMENT
/begin MEASUREMENT egcp[1].egcp_struct_fctdglshd1.ctr_cycnr_r_it_obd_ls_down "Value of handshake counter for last valid resistance value used for diagnosis" UWORD _CNV_A_R_LINEAR_____0_CM 1 100. 0. 65535. DISPLAY_IDENTIFIER CTR_CYCNR_R_IT_OBD_LS_DOWN[2] ECU_ADDRESS 0xd0005b7c FORMAT "%5.0" /end MEASUREMENT
/begin MEASUREMENT egcp[1].egcp_struct_fctdglshd1.state_obd_lsh_down "Indicates current phase of oxygen sensor heater OBDII diagnosis" UBYTE _CNV_S_9_EGCP_RANGE_343_CM 1 100. 0. 8. DISPLAY_IDENTIFIER STATE_OBD_LSH_DOWN[2] ECU_ADDRESS 0xd0005b7e /end MEASUREMENT
/begin MEASUREMENT egcp[1].egcp_struct_fctdglshdi1.lv_inh_diag_obd_lsh_down "Boolean inhibit flag for O2 sensor heater OBDII monitoring" UBYTE _CNV_S_2_RANGE__0___1_CM 1 100. 0. 1. DISPLAY_IDENTIFIER LV_INH_DIAG_OBD_LSH_DOWN[2] ECU_ADDRESS 0xd0005b80 BIT_MASK 0x1 /end MEASUREMENT
/begin MEASUREMENT egcp[1].egcp_struct_fctdglshdi1.lv_inh_diag_rbm_obd_lsh_down "Flag to inhibit rate based monitoring for oxygen sensor heater OBDII diagnosis" UBYTE _CNV_S_2_RANGE__0___1_CM 1 100. 0. 1. DISPLAY_IDENTIFIER LV_INH_DIAG_RBM_OBD_LSH_DOWN[2] ECU_ADDRESS 0xd0005b81 BIT_MASK 0x1 /end MEASUREMENT
/begin MEASUREMENT egcp[1].egcp_struct_fctdglshdi1.lv_diag_eol_req_obd_lsh_down "Flag for end of line oxygen sensor heater OBDII diagnosis" UBYTE _CNV_S_2_RANGE__0___1_CM 1 100. 0. 1. DISPLAY_IDENTIFIER LV_DIAG_EOL_REQ_OBD_LSH_DOWN ECU_ADDRESS 0xd0005b82 BIT_MASK 0x1 /end MEASUREMENT
/begin MEASUREMENT egcp[1].egcp_struct_fctdglshdi1.state_rbm_obd_lsh_down "Interface of OBD_LSH_DOWN monitor with the Rate-Based Monitoring statistics" UBYTE _CNV_A_R_LINEAR_____0_CM 1 100. 0. 7. DISPLAY_IDENTIFIER STATE_RBM_OBD_LSH_DOWN[2] ECU_ADDRESS 0xd0005b83 FORMAT "%1.0" /end MEASUREMENT
/begin MEASUREMENT egcp[1].egcp_struct_sigdglsl1.lv_err_ls_down "Final diagnostic of the downstream oxygen sensor" UBYTE _CNV_S_2_RANGE__0___1_CM 1 100. 0. 1. DISPLAY_IDENTIFIER LV_ERR_LS_DOWN[2] ECU_ADDRESS 0xd0005b84 BIT_MASK 0x1 /end MEASUREMENT
/begin MEASUREMENT egcp[1].egcp_struct_sigdglsl1.lv_err_ls_up "Final diagnostic of the upstream oxygen sensor" UBYTE _CNV_S_2_RANGE__0___1_CM 1 100. 0. 1. DISPLAY_IDENTIFIER LV_ERR_LS_UP[2] ECU_ADDRESS 0xd0005b85 BIT_MASK 0x1 /end MEASUREMENT
/begin MEASUREMENT egcp[1].egcp_struct_sigdglsl1.lv_ls_up_diag_end "Sum end bit of upstream oxygen sensor diagnosis functions" UBYTE _CNV_S_2_RANGE__0___1_CM 1 100. 0. 1. DISPLAY_IDENTIFIER LV_LS_UP_DIAG_END[2] ECU_ADDRESS 0xd0005b86 BIT_MASK 0x1 /end MEASUREMENT
/begin MEASUREMENT egcp[1].egcp_struct_sigdglsl1.lv_ls_up_obd_1_man_deac "Logical variable indicating manual deactivation of all OBD1 diagnosis for upstream oxygen sensor" UBYTE _CNV_S_2_RANGE__0___1_CM 1 100. 0. 1. DISPLAY_IDENTIFIER LV_LS_UP_OBD_1_MAN_DEAC[2] ECU_ADDRESS 0xd0005b87 BIT_MASK 0x1 /end MEASUREMENT
/begin MEASUREMENT egcp[1].egcp_struct_sigdglsl1.lv_ls_up_obd_2_man_deac "Logical variable indicating manual deactivation of all OBD2 diagnosis for upstream oxygen sensor" UBYTE _CNV_S_2_RANGE__0___1_CM 1 100. 0. 1. DISPLAY_IDENTIFIER LV_LS_UP_OBD_2_MAN_DEAC[2] ECU_ADDRESS 0xd0005b88 BIT_MASK 0x1 /end MEASUREMENT
/begin MEASUREMENT egcp[1].egcp_struct_sigdglsl1.lv_ls_down_diag_end "Collecting end flag for the diagnosis functions of the downstream oxygen sensor" UBYTE _CNV_S_2_RANGE__0___1_CM 1 100. 0. 1. DISPLAY_IDENTIFIER LV_LS_DOWN_DIAG_END[2] ECU_ADDRESS 0xd0005b89 BIT_MASK 0x1 /end MEASUREMENT
/begin MEASUREMENT egcp[1].egcp_struct_sigdglsl1.lv_ls_down_obd_1_man_deac "Logical variable indicating manual deactivation of all OBD1 diagnosis for downstream oxygen sensor" UBYTE _CNV_S_2_RANGE__0___1_CM 1 100. 0. 1. DISPLAY_IDENTIFIER LV_LS_DOWN_OBD_1_MAN_DEAC[2] ECU_ADDRESS 0xd0005b8a BIT_MASK 0x1 /end MEASUREMENT
/begin MEASUREMENT egcp[1].egcp_struct_sigdglsl1.lv_ls_down_obd_2_man_deac "Logical variable indicating manual deactivation of all OBD2 diagnosis for downstream oxygen sensor" UBYTE _CNV_S_2_RANGE__0___1_CM 1 100. 0. 1. DISPLAY_IDENTIFIER LV_LS_DOWN_OBD_2_MAN_DEAC[2] ECU_ADDRESS 0xd0005b8b BIT_MASK 0x1 /end MEASUREMENT
/begin MEASUREMENT egcp[1].egcp_struct_sigdglsd2.vls_down_tran_puc "Monitor sensor voltage on activating the trailing throttle fuel cut-off, Bank i" UWORD _CNV_A_R_LINEAR_____2_CM 1 100. 0. 4.9951171875 DISPLAY_IDENTIFIER VLS_DOWN_TRAN_PUC[2] ECU_ADDRESS 0xd0005bd4 FORMAT "%5.3" /end MEASUREMENT
/begin MEASUREMENT egcp[1].egcp_struct_sigdglsd2.vls_down_pue "Monitor sensor voltage at the time of leaving PUC, Bank i (i=1.2)" UWORD _CNV_A_R_LINEAR_____2_CM 1 100. 0. 4.9951171875 DISPLAY_IDENTIFIER VLS_DOWN_PUE[2] ECU_ADDRESS 0xd0005bd6 FORMAT "%5.3" /end MEASUREMENT
/begin MEASUREMENT egcp[1].egcp_struct_sigdglsd2.vls_dif_diag_pue_ls_down "difference of VLS_DOWN_i values from the beginning to the end of the MAF_INT_PUC_NOT_ACT calculation" UWORD _CNV_A_R_LINEAR_____2_CM 1 100. 0. 4.9951171875 DISPLAY_IDENTIFIER VLS_DIF_DIAG_PUE_LS_DOWN[2] ECU_ADDRESS 0xd0005bd8 FORMAT "%5.3" /end MEASUREMENT
/begin MEASUREMENT egcp[1].egcp_struct_sigdglsd2.vls_dif_save_diag_ls_down "Difference of VLS_DOWN_i values from the beginning to the end of the MAF_INT_PUC_NOT_ACT calculation for scantool" UWORD _CNV_A_R_LINEAR_____2_CM 1 100. 0. 4.9951171875 DISPLAY_IDENTIFIER VLS_DIF_SAVE_DIAG_LS_DOWN[2] ECU_ADDRESS 0xd0005bda FORMAT "%5.3" /end MEASUREMENT
/begin MEASUREMENT egcp[1].egcp_struct_sigdglsd2.vls_dif_min_diag_pue_ls_down "Minimum value of VLS_DIF_DIAG_PUE_LS_DOWN[i] until MAF threshold outside PUC is exceeded" UWORD _CNV_A_R_LINEAR_____2_CM 1 100. 0. 4.9951171875 DISPLAY_IDENTIFIER VLS_DIF_MIN_DIAG_PUE_LS_DOWN[2] ECU_ADDRESS 0xd0005bdc FORMAT "%5.3" /end MEASUREMENT
/begin MEASUREMENT egcp[1].egcp_struct_sigdglsd2.vls_dif_max_diag_pue_ls_down "Maximum value of VLS_DIF_DIAG_PUE_LS_DOWN[i] until MAF threshold outside PUC is exceeded" UWORD _CNV_A_R_LINEAR_____2_CM 1 100. 0. 4.9951171875 DISPLAY_IDENTIFIER VLS_DIF_MAX_DIAG_PUE_LS_DOWN[2] ECU_ADDRESS 0xd0005bde FORMAT "%5.3" /end MEASUREMENT
/begin MEASUREMENT egcp[1].egcp_struct_sigdglsd2.ctr_end_diag_pue_ls_down "Counter to set LV_END_DIAG_VLS_DOWN_PUE_i" UWORD _CNV_A_R_LINEAR_____0_CM 1 100. 0. 65535. DISPLAY_IDENTIFIER CTR_END_DIAG_PUE_LS_DOWN[2] ECU_ADDRESS 0xd0005be0 FORMAT "%5.0" /end MEASUREMENT
/begin MEASUREMENT egcp[1].egcp_struct_sigdglsd2.ctr_quo_sum_swt_ls_down "Sum of weighted CTR_SWT_ACT_LS_DOWN[NC_CBK_EX_NR], Bank i" UWORD _CNV_A_R_LINEAR_____28_CM 1 100. 0. 255.99609375 DISPLAY_IDENTIFIER CTR_QUO_SUM_SWT_LS_DOWN[2] ECU_ADDRESS 0xd0005be2 FORMAT "%10.6" /end MEASUREMENT
/begin MEASUREMENT egcp[1].egcp_struct_sigdglsd2.ctr_quo_swt_ls_down "Weighted value CTR_SWT_ACT_LS_DOWN[NC_CBK_EX_NR ]" UWORD _CNV_A_R_LINEAR_____28_CM 1 100. 0. 255.99609375 DISPLAY_IDENTIFIER CTR_QUO_SWT_LS_DOWN[2] ECU_ADDRESS 0xd0005be4 FORMAT "%10.6" /end MEASUREMENT
/begin MEASUREMENT egcp[1].egcp_struct_sigdglsd2.ctr_quo_swt_rbm_ls_down "Weighted value of CTR_SWT_ACT_RBM_LS_DOWN[NC_CBK_EX_NR ] for RBM purpose" UWORD _CNV_A_R_LINEAR_____28_CM 1 100. 0. 255.99609375 DISPLAY_IDENTIFIER CTR_QUO_SWT_RBM_LS_DOWN[2] ECU_ADDRESS 0xd0005be6 FORMAT "%10.6" /end MEASUREMENT
/begin MEASUREMENT egcp[1].egcp_struct_sigdglsd2.ctr_swt_act_ls_down "Cycle counter for switching time determination, Bank i" UBYTE _CNV_A_R_LINEAR_____23_CM 1 100. 0. 5100. DISPLAY_IDENTIFIER CTR_SWT_ACT_LS_DOWN[2] ECU_ADDRESS 0xd0005be8 FORMAT "%4.0" /end MEASUREMENT
/begin MEASUREMENT egcp[1].egcp_struct_sigdglsd2.ctr_swt_act_rbm_ls_down "Cycle counter for RBM switching time determination, Bank i" UBYTE _CNV_A_R_LINEAR_____23_CM 1 100. 0. 5100. DISPLAY_IDENTIFIER CTR_SWT_ACT_RBM_LS_DOWN[2] ECU_ADDRESS 0xd0005be9 FORMAT "%4.0" /end MEASUREMENT
/begin MEASUREMENT egcp[1].egcp_struct_sigdglsd2.ctr_swt_ls_down "Number of valid switching times from rich to lean" UBYTE _CNV_A_R_LINEAR_____0_CM 1 100. 0. 255. DISPLAY_IDENTIFIER CTR_SWT_LS_DOWN[2] ECU_ADDRESS 0xd0005bea FORMAT "%3.0" /end MEASUREMENT
/begin MEASUREMENT egcp[1].egcp_struct_sigdglsd2.ctr_cycnr_swt_ls_down "Average of weighted CTR_SWT_ACT_LS_DOWN[NC_CBK_EX_NR], Bank i" UBYTE _CNV_A_R_LINEAR_____103_CM 1 100. 0. 1.9921875 DISPLAY_IDENTIFIER CTR_CYCNR_SWT_LS_DOWN[2] ECU_ADDRESS 0xd0005beb FORMAT "%8.6" /end MEASUREMENT
/begin MEASUREMENT egcp[1].egcp_struct_sigdglsd2.ctr_save_swt_ls_down "Mean value of the ratio between the monitor sensor switching time and the threshold value for scantool" UBYTE _CNV_A_R_LINEAR_____103_CM 1 100. 0. 1.9921875 DISPLAY_IDENTIFIER CTR_SAVE_SWT_LS_DOWN[2] ECU_ADDRESS 0xd0005bec FORMAT "%8.6" /end MEASUREMENT
/begin MEASUREMENT egcp[1].egcp_struct_sigdglsd2.ctr_sym_diag_pue_ls_down "Counter for anti-bounce of LS_DOWN_PUE diagnosis" UBYTE _CNV_A_R_LINEAR_____0_CM 1 100. 0. 255. DISPLAY_IDENTIFIER CTR_SYM_DIAG_PUE_LS_DOWN[2] ECU_ADDRESS 0xd0005bed FORMAT "%3.0" /end MEASUREMENT
/begin MEASUREMENT egcp[1].egcp_struct_sigdglsd2.lv_diag_pue_vld_ls_down "Logical variable indicating validity of previous diagnostic cycle" UBYTE _CNV_S_2_RANGE__0___1_CM 1 100. 0. 1. DISPLAY_IDENTIFIER LV_DIAG_PUE_VLD_LS_DOWN[2] ECU_ADDRESS 0xd0005bee BIT_MASK 0x1 /end MEASUREMENT
/begin MEASUREMENT egcp[1].egcp_struct_sigdglsd2.lv_diag_mpl_cdn_ls_down "Status of general activation conditions for diagnosis" UBYTE _CNV_S_2_RANGE__0___1_CM 1 100. 0. 1. DISPLAY_IDENTIFIER LV_DIAG_MPL_CDN_LS_DOWN[2] ECU_ADDRESS 0xd0005bef BIT_MASK 0x1 /end MEASUREMENT
/begin MEASUREMENT egcp[1].egcp_struct_sigdglsd2.lv_swt_diag_vld_ls_down "Validity bit of the current switching time check" UBYTE _CNV_S_2_RANGE__0___1_CM 1 100. 0. 1. DISPLAY_IDENTIFIER LV_SWT_DIAG_VLD_LS_DOWN[2] ECU_ADDRESS 0xd0005bf0 BIT_MASK 0x1 /end MEASUREMENT
/begin MEASUREMENT egcp[1].egcp_struct_sigdglsd2.lv_maf_int_puc_not_act_rst "Logical variable indicating that MAF_INT_PUC_NOT_ACT integral has been reset" UBYTE _CNV_S_2_RANGE__0___1_CM 1 100. 0. 1. DISPLAY_IDENTIFIER LV_MAF_INT_PUC_NOT_ACT_RST[2] ECU_ADDRESS 0xd0005bf1 BIT_MASK 0x1 /end MEASUREMENT
/begin MEASUREMENT egcp[1].egcp_struct_pladglsi2.lv_lam_stop_sho_per_cdn "substitute to LV_LAM_STOP_SHO_PER in intechanged signal diagnosis" UBYTE _CNV_S_2_RANGE__0___1_CM 1 100. 0. 1. DISPLAY_IDENTIFIER LV_LAM_STOP_SHO_PER_CDN[2] ECU_ADDRESS 0xd0005bf4 BIT_MASK 0x1 /end MEASUREMENT
/begin MEASUREMENT egcp[1].egcp_struct_pladglsl1.lamb_sp_delta_ls_up_down "Increment of lambda setpoint" SWORD _CNV_A_R_EGCP_LINEA_350_CM 1 100. -32. 31.999023 DISPLAY_IDENTIFIER LAMB_SP_DELTA_LS_UP_DOWN[2] ECU_ADDRESS 0xd0005c68 FORMAT "%9.6" /end MEASUREMENT
/begin MEASUREMENT egcp[1].egcp_struct_pladglsl1.maf_int_diag_ls_up_down "Integral of air mass flow  while check is active" UWORD _CNV_A_R_LINEAR_____287_CM 1 100. 0. 1820.41666666667 DISPLAY_IDENTIFIER MAF_INT_DIAG_LS_UP_DOWN[2] ECU_ADDRESS 0xd0005c6a FORMAT "%7.2" /end MEASUREMENT
/begin MEASUREMENT egcp[1].egcp_struct_pladglsl1.lamb_sp_beg_diag_ls_up_down "Inicial value of lambda set point " UWORD _CNV_A_R_LINEAR_____129_CM 1 100. 0. 31.9990234375 DISPLAY_IDENTIFIER LAMB_SP_BEG_DIAG_LS_UP_DOWN[2] ECU_ADDRESS 0xd0005c6c FORMAT "%7.4" /end MEASUREMENT
/begin MEASUREMENT egcp[1].egcp_struct_pladglsl1.lamb_sp_diag_opl_ls_up_down "lambda setpoint requested by open-loop test for upstream and downstream lambda sensors" UWORD _CNV_A_R_LINEAR_____129_CM 1 100. 0. 31.9990234375 DISPLAY_IDENTIFIER LAMB_SP_DIAG_OPL_LS_UP_DOWN[2] ECU_ADDRESS 0xd0005c6e FORMAT "%7.4" /end MEASUREMENT
/begin MEASUREMENT egcp[1].egcp_struct_pladglsl1.t_diag_act_afr_ls_up_down "Timer for plauisibility test under rich AF conditions" UWORD _CNV_A_R_LINEAR_____4_CM 1 100. 0. 6553.5 DISPLAY_IDENTIFIER T_DIAG_ACT_AFR_LS_UP_DOWN[2] ECU_ADDRESS 0xd0005c70 FORMAT "%6.1" /end MEASUREMENT
/begin MEASUREMENT egcp[1].egcp_struct_pladglsl1.t_diag_act_afl_ls_up_down "Timer for plauisibility test under lean AF conditions" UWORD _CNV_A_R_LINEAR_____4_CM 1 100. 0. 6553.5 DISPLAY_IDENTIFIER T_DIAG_ACT_AFL_LS_UP_DOWN[2] ECU_ADDRESS 0xd0005c72 FORMAT "%6.1" /end MEASUREMENT
/begin MEASUREMENT egcp[1].egcp_struct_pladglsl1.ctr_sum_rst_afr_chk_lsl_up "Reset counter for the rich active test" UWORD _CNV_A_R_LINEAR_____0_CM 1 100. 0. 65535. DISPLAY_IDENTIFIER CTR_SUM_RST_AFR_CHK_LSL_UP[2] ECU_ADDRESS 0xd0005c74 FORMAT "%5.0" /end MEASUREMENT
/begin MEASUREMENT egcp[1].egcp_struct_pladglsl1.ctr_sum_rst_afl_chk_lsl_up "Reset counter for the rich active test" UWORD _CNV_A_R_LINEAR_____0_CM 1 100. 0. 65535. DISPLAY_IDENTIFIER CTR_SUM_RST_AFL_CHK_LSL_UP[2] ECU_ADDRESS 0xd0005c76 FORMAT "%5.0" /end MEASUREMENT
/begin MEASUREMENT egcp[1].egcp_struct_pladglsl1.ctr_afr_chk_lsl_up "Debounce counter for the rich test" UWORD _CNV_A_R_LINEAR_____0_CM 1 100. 0. 65535. DISPLAY_IDENTIFIER CTR_AFR_CHK_LSL_UP[2] ECU_ADDRESS 0xd0005c78 FORMAT "%5.0" /end MEASUREMENT
/begin MEASUREMENT egcp[1].egcp_struct_pladglsl1.ctr_afl_chk_lsl_up "Debounce counter for the lean test" UWORD _CNV_A_R_LINEAR_____0_CM 1 100. 0. 65535. DISPLAY_IDENTIFIER CTR_AFL_CHK_LSL_UP[2] ECU_ADDRESS 0xd0005c7a FORMAT "%5.0" /end MEASUREMENT
/begin MEASUREMENT egcp[1].egcp_struct_pladglsl1.t_end_diag_act_ls_down "Timer for the end of the downstream sensor active test in the no failure case" UWORD _CNV_A_R_LINEAR_____4_CM 1 100. 0. 6553.5 DISPLAY_IDENTIFIER T_END_DIAG_ACT_LS_DOWN[2] ECU_ADDRESS 0xd0005c7c FORMAT "%6.1" /end MEASUREMENT
/begin MEASUREMENT egcp[1].egcp_struct_pladglsl1.t_afr_chk_ls_down "Debounce counter for the rich test" UWORD _CNV_A_R_LINEAR_____4_CM 1 100. 0. 6553.5 DISPLAY_IDENTIFIER T_AFR_CHK_LS_DOWN[2] ECU_ADDRESS 0xd0005c7e FORMAT "%6.1" /end MEASUREMENT
/begin MEASUREMENT egcp[1].egcp_struct_pladglsl1.t_afl_chk_ls_down "Debounce counter for the lean test" UWORD _CNV_A_R_LINEAR_____4_CM 1 100. 0. 6553.5 DISPLAY_IDENTIFIER T_AFL_CHK_LS_DOWN[2] ECU_ADDRESS 0xd0005c80 FORMAT "%6.1" /end MEASUREMENT
/begin MEASUREMENT egcp[1].egcp_struct_pladglsl1.state_diag_act_ls_up_down "State of check of downstream oxygen sensor signal for lambda sensor error manager" UBYTE _CNV_S_4_EGCP_RANGE_351_CM 1 100. 0. 3. DISPLAY_IDENTIFIER STATE_DIAG_ACT_LS_UP_DOWN[2] ECU_ADDRESS 0xd0005c82 /end MEASUREMENT
/begin MEASUREMENT egcp[1].egcp_struct_pladglsl1.lv_diag_afl_cdn_ls_up_down "Boolean flag, condition to execute AFL active check of the oxygen sensors" UBYTE _CNV_S_2_RANGE__0___1_CM 1 100. 0. 1. DISPLAY_IDENTIFIER LV_DIAG_AFL_CDN_LS_UP_DOWN[2] ECU_ADDRESS 0xd0005c83 BIT_MASK 0x1 /end MEASUREMENT
/begin MEASUREMENT egcp[1].egcp_struct_pladglsl1.lv_diag_afr_cdn_ls_up_down "Boolean flag, condition to execute AFR active check of the oxygen sensors" UBYTE _CNV_S_2_RANGE__0___1_CM 1 100. 0. 1. DISPLAY_IDENTIFIER LV_DIAG_AFR_CDN_LS_UP_DOWN[2] ECU_ADDRESS 0xd0005c84 BIT_MASK 0x1 /end MEASUREMENT
/begin MEASUREMENT egcp[1].egcp_struct_pladglsl1.lv_diag_act_end_ls_up_down "Boolean flag, end of active check of the oxygen sensors" UBYTE _CNV_S_2_RANGE__0___1_CM 1 100. 0. 1. DISPLAY_IDENTIFIER LV_DIAG_ACT_END_LS_UP_DOWN[2] ECU_ADDRESS 0xd0005c85 BIT_MASK 0x1 /end MEASUREMENT
/begin MEASUREMENT egcp[1].egcp_struct_pladglsl1.lv_lamb_sp_afr_req_diag_act "Trigger function to change lambda set point for AFR active plauisibility test" UBYTE _CNV_S_2_RANGE__0___1_CM 1 100. 0. 1. DISPLAY_IDENTIFIER LV_LAMB_SP_AFR_REQ_DIAG_ACT[2] ECU_ADDRESS 0xd0005c86 BIT_MASK 0x1 /end MEASUREMENT
/begin MEASUREMENT egcp[1].egcp_struct_pladglsl1.lv_lamb_sp_afl_req_diag_act "Trigger function to change lambda set point for AFL active plauisibility test" UBYTE _CNV_S_2_RANGE__0___1_CM 1 100. 0. 1. DISPLAY_IDENTIFIER LV_LAMB_SP_AFL_REQ_DIAG_ACT[2] ECU_ADDRESS 0xd0005c87 BIT_MASK 0x1 /end MEASUREMENT
/begin MEASUREMENT egcp[1].egcp_struct_pladglsl1.lv_diag_cyc_end_ls_down "End of cycle of active test of downstream sensor" UBYTE _CNV_S_2_RANGE__0___1_CM 1 100. 0. 1. DISPLAY_IDENTIFIER LV_DIAG_CYC_END_LS_DOWN[2] ECU_ADDRESS 0xd0005c88 BIT_MASK 0x1 /end MEASUREMENT
/begin MEASUREMENT egcp[1].egcp_struct_pladglsl1.lv_lam_di_req "Request disable close loop operation of the lambda controller" UBYTE _CNV_S_2_RANGE__0___1_CM 1 100. 0. 1. DISPLAY_IDENTIFIER LV_LAM_DI_REQ[2] ECU_ADDRESS 0xd0005c89 BIT_MASK 0x1 /end MEASUREMENT
/begin MEASUREMENT egcp[1].egcp_struct_pladglsl1.lv_diag_afr_end_ls_up_down "Boolean flag indicating the end of RICH active check" UBYTE _CNV_S_2_RANGE__0___1_CM 1 100. 0. 1. DISPLAY_IDENTIFIER LV_DIAG_AFR_END_LS_UP_DOWN[2] ECU_ADDRESS 0xd0005c8a BIT_MASK 0x1 /end MEASUREMENT
/begin MEASUREMENT egcp[1].egcp_struct_pladglsl1.lv_diag_afl_end_ls_up_down "Boolean flag indicating the end of LEAN active check" UBYTE _CNV_S_2_RANGE__0___1_CM 1 100. 0. 1. DISPLAY_IDENTIFIER LV_DIAG_AFL_END_LS_UP_DOWN[2] ECU_ADDRESS 0xd0005c8b BIT_MASK 0x1 /end MEASUREMENT
/begin MEASUREMENT egcp[1].egcp_struct_pladglsl1.lv_diag_afr_chk_sym_lsl_up "Debounced failure in the upstream sensor during the RICH active check " UBYTE _CNV_S_2_RANGE__0___1_CM 1 100. 0. 1. DISPLAY_IDENTIFIER LV_DIAG_AFR_CHK_SYM_LSL_UP[2] ECU_ADDRESS 0xd0005c8c BIT_MASK 0x1 /end MEASUREMENT
/begin MEASUREMENT egcp[1].egcp_struct_pladglsl1.lv_diag_afl_chk_sym_lsl_up "Debounced failure in the upstream sensor during the LEAN active check" UBYTE _CNV_S_2_RANGE__0___1_CM 1 100. 0. 1. DISPLAY_IDENTIFIER LV_DIAG_AFL_CHK_SYM_LSL_UP[2] ECU_ADDRESS 0xd0005c8d BIT_MASK 0x1 /end MEASUREMENT
/begin MEASUREMENT egcp[1].egcp_struct_pladglsl1.lv_diag_act_chk_cdn_lsl_up "Conditions to run active test of upstream sensor fulfilled" UBYTE _CNV_S_2_RANGE__0___1_CM 1 100. 0. 1. DISPLAY_IDENTIFIER LV_DIAG_ACT_CHK_CDN_LSL_UP[2] ECU_ADDRESS 0xd0005c8e BIT_MASK 0x1 /end MEASUREMENT
/begin MEASUREMENT egcp[1].egcp_struct_pladglsl1.lv_diag_act_chk_end_lsl_up "End active test of upstream sensor" UBYTE _CNV_S_2_RANGE__0___1_CM 1 100. 0. 1. DISPLAY_IDENTIFIER LV_DIAG_ACT_CHK_END_LSL_UP[2] ECU_ADDRESS 0xd0005c8f BIT_MASK 0x1 /end MEASUREMENT
/begin MEASUREMENT egcp[1].egcp_struct_pladglsl1.lv_diag_eol_end_ls_up_down "Boolean flag, end of active check of the oxygen sensors (EOL test)" UBYTE _CNV_S_2_RANGE__0___1_CM 1 100. 0. 1. DISPLAY_IDENTIFIER LV_DIAG_EOL_END_LS_UP_DOWN[2] ECU_ADDRESS 0xd0005c90 BIT_MASK 0x1 /end MEASUREMENT
/begin MEASUREMENT egcp[1].egcp_struct_pladglsl1.lv_diag_eol_dc_ls_up_down "Flag indicating eol test was active in this driving cycle." UBYTE _CNV_S_2_RANGE__0___1_CM 1 100. 0. 1. DISPLAY_IDENTIFIER LV_DIAG_EOL_DC_LS_UP_DOWN[2] ECU_ADDRESS 0xd0005c91 BIT_MASK 0x1 /end MEASUREMENT
/begin MEASUREMENT egcp[1].egcp_struct_pladglsl1.lv_sym_afl_chk_ls_down "Symptom of oxygen sensor downstream too lean in case of 2 bank system during end of line test or sensor interchanged test" UBYTE _CNV_S_2_RANGE__0___1_CM 1 100. 0. 1. DISPLAY_IDENTIFIER LV_SYM_AFL_CHK_LS_DOWN[2] ECU_ADDRESS 0xd0005c92 BIT_MASK 0x1 /end MEASUREMENT
/begin MEASUREMENT egcp[1].egcp_struct_pladglsl1.lv_sym_afr_chk_ls_down "Symptom of oxygen sensor downstream too rich in case of 2 bank system during end of line test or sensor interchanged test" UBYTE _CNV_S_2_RANGE__0___1_CM 1 100. 0. 1. DISPLAY_IDENTIFIER LV_SYM_AFR_CHK_LS_DOWN[2] ECU_ADDRESS 0xd0005c93 BIT_MASK 0x1 /end MEASUREMENT
/begin MEASUREMENT egcp[1].egcp_struct_pladglsl1.lv_diag_act_cdn_ls_up_down "Conditions to perform rich/lean check of open loop diag are fulfilled - not relevant for soft check" UBYTE _CNV_S_2_RANGE__0___1_CM 1 100. 0. 1. DISPLAY_IDENTIFIER LV_DIAG_ACT_CDN_LS_UP_DOWN[2] ECU_ADDRESS 0xd0005c94 BIT_MASK 0x1 /end MEASUREMENT
/begin MEASUREMENT egcp[1].egcp_struct_sigdglsl4.t_vls_up_min_diag_oc_lsl_up "Timer for LSL signal under voltage" UWORD _CNV_A_R_LINEAR_____4_CM 1 100. 0. 6553.5 DISPLAY_IDENTIFIER T_VLS_UP_MIN_DIAG_OC_LSL_UP[2] ECU_ADDRESS 0xd0005cac FORMAT "%6.1" /end MEASUREMENT
/begin MEASUREMENT egcp[1].egcp_struct_sigdglsl4.t_wait_sym_obd_2_lsh_up "Waiting time to check if OBD2 upstream heater error is present (to distinguish OC on Vip from Vg)" UWORD _CNV_A_R_LINEAR_____4_CM 1 100. 0. 6553.5 DISPLAY_IDENTIFIER T_WAIT_SYM_OBD_2_LSH_UP[2] ECU_ADDRESS 0xd0005cae FORMAT "%6.1" /end MEASUREMENT
/begin MEASUREMENT egcp[1].egcp_struct_sigdglsl4.t_vls_up_afs_diag_oc_lsl_up "Timer for lambda signal being in stoichiometric band while it shouldn't" UWORD _CNV_A_R_LINEAR_____4_CM 1 100. 0. 6553.5 DISPLAY_IDENTIFIER T_VLS_UP_AFS_DIAG_OC_LSL_UP[2] ECU_ADDRESS 0xd0005cb0 FORMAT "%6.1" /end MEASUREMENT
/begin MEASUREMENT egcp[1].egcp_struct_sigdglsl4.t_diag_oc_rst_osc_di "Time to reactivate oscillator for upstream tip temperature measurement" UWORD _CNV_A_R_LINEAR_____4_CM 1 100. 0. 6553.5 DISPLAY_IDENTIFIER T_DIAG_OC_RST_OSC_DI[2] ECU_ADDRESS 0xd0005cb2 FORMAT "%6.1" /end MEASUREMENT
/begin MEASUREMENT egcp[1].egcp_struct_sigdglsl4.t_diag_oc_rst_lamb_sp_req "Time to finish the active check for OC in VIP / VG" UWORD _CNV_A_R_LINEAR_____4_CM 1 100. 0. 6553.5 DISPLAY_IDENTIFIER T_DIAG_OC_RST_LAMB_SP_REQ[2] ECU_ADDRESS 0xd0005cb4 FORMAT "%6.1" /end MEASUREMENT
/begin MEASUREMENT egcp[1].egcp_struct_sigdglsl4.t_diag_oc_lsl_up "Timer to finish OC diagnosis in case of OBD2 upstream heater error symptom active and conditions for plausibility diagnosis fulfilled" UWORD _CNV_A_R_LINEAR_____4_CM 1 100. 0. 6553.5 DISPLAY_IDENTIFIER T_DIAG_OC_LSL_UP[2] ECU_ADDRESS 0xd0005cb6 FORMAT "%6.1" /end MEASUREMENT
/begin MEASUREMENT egcp[1].egcp_struct_sigdglsl4.lamb_sp_diag_oc_lsl_up "Requested lambda setpoint for active part of linear sensor open circuit check" UWORD _CNV_A_R_LINEAR_____129_CM 1 100. 0. 31.9990234375 DISPLAY_IDENTIFIER LAMB_SP_DIAG_OC_LSL_UP[2] ECU_ADDRESS 0xd0005cb8 FORMAT "%7.4" /end MEASUREMENT
/begin MEASUREMENT egcp[1].egcp_struct_sigdglsl4.lamb_sp_delta_oc_lsl_up "Lambda setpoint ramp increment for active part of linear sensor open circuit check" SWORD _CNV_A_R_EGCP_LINEA_350_CM 1 100. -32. 31.999023 DISPLAY_IDENTIFIER LAMB_SP_DELTA_OC_LSL_UP[2] ECU_ADDRESS 0xd0005cba FORMAT "%9.6" /end MEASUREMENT
/begin MEASUREMENT egcp[1].egcp_struct_sigdglsl4.state_diag_oc_lsl_up "Status of the LSL Open Circuit Diagnosis" UBYTE _CNV_S_3_EGCP_RANGE_352_CM 1 100. 0. 2. DISPLAY_IDENTIFIER STATE_DIAG_OC_LSL_UP[2] ECU_ADDRESS 0xd0005cbc /end MEASUREMENT
/begin MEASUREMENT egcp[1].egcp_struct_sigdglsl4.lv_diag_oc_if_osc_di_lsl_up "Request stop oscillator used to determine sensor internal resistance " UBYTE _CNV_S_2_RANGE__0___1_CM 1 100. 0. 1. DISPLAY_IDENTIFIER LV_DIAG_OC_IF_OSC_DI_LSL_UP[2] ECU_ADDRESS 0xd0005cbd BIT_MASK 0x1 /end MEASUREMENT
/begin MEASUREMENT egcp[1].egcp_struct_sigdglsl4.lv_vls_up_min_diag_oc_lsl_up "Bit indicating LSL undervoltage " UBYTE _CNV_S_2_RANGE__0___1_CM 1 100. 0. 1. DISPLAY_IDENTIFIER LV_VLS_UP_MIN_DIAG_OC_LSL_UP[2] ECU_ADDRESS 0xd0005cbe BIT_MASK 0x1 /end MEASUREMENT
/begin MEASUREMENT egcp[1].egcp_struct_sigdglsl4.lv_vls_up_afs_diag_oc_lsl_up "Bit indicating LSL stoichiometric voltage " UBYTE _CNV_S_2_RANGE__0___1_CM 1 100. 0. 1. DISPLAY_IDENTIFIER LV_VLS_UP_AFS_DIAG_OC_LSL_UP[2] ECU_ADDRESS 0xd0005cbf BIT_MASK 0x1 /end MEASUREMENT
/begin MEASUREMENT egcp[1].egcp_struct_sigdglsli4.lv_inh_diag_oc_lsl_up "Deactivation of \"Open Circuit Diagnosis\"" UBYTE _CNV_S_2_RANGE__0___1_CM 1 100. 0. 1. DISPLAY_IDENTIFIER LV_INH_DIAG_OC_LSL_UP[2] ECU_ADDRESS 0xd0005cc0 BIT_MASK 0x1 /end MEASUREMENT
/begin CHARACTERISTIC c_lshpwm_max_diag_lsh_down "Maximum O2-Sensor heater duty cycle to perform the electrical diagnosis" VALUE 0xa080148c _REC_VAL_20_u1 99.609375 _CNV_A_R_LINEAR_____5_CM 0. 99.609375 DISPLAY_IDENTIFIER C_LSHPWM_MAX_DIAG_LSH_DOWN FORMAT "%9.6" /end CHARACTERISTIC
/begin CHARACTERISTIC c_lshpwm_min_diag_lsh_down "Minimum O2-Sensor heater duty cycle to perform the electrical diagnosis" VALUE 0xa0801490 _REC_VAL_20_u1 99.609375 _CNV_A_R_LINEAR_____5_CM 0. 99.609375 DISPLAY_IDENTIFIER C_LSHPWM_MIN_DIAG_LSH_DOWN FORMAT "%9.6" /end CHARACTERISTIC
/begin MEASUREMENT lv_err_lsh_down_1 "Error flag for downstream heater diagnosis OBD I after debouncing " UBYTE _CNV_S_2_RANGE__0___1_CM 1 100. 0. 1. DISPLAY_IDENTIFIER LV_ERR_LSH_DOWN[1] ECU_ADDRESS 0xd0007ff0 BIT_MASK 0x1 /end MEASUREMENT
/begin MEASUREMENT lv_err_lsh_down_2 "Error flag for downstream heater diagnosis OBD I after debouncing " UBYTE _CNV_S_2_RANGE__0___1_CM 1 100. 0. 1. DISPLAY_IDENTIFIER LV_ERR_LSH_DOWN[2] ECU_ADDRESS 0xd000800b BIT_MASK 0x1 /end MEASUREMENT
/begin CHARACTERISTIC c_teg_dyn_min_diag_lsh_down "Minimum exhaust gas temperature threshold to permit SCP to set fault during LSH power rise state" VALUE 0xa08015ee _REC_VAL_20_u2 2047.9375 _CNV_A_R_LINEAR_____214_CM -273.15 1774.7875 DISPLAY_IDENTIFIER C_TEG_DYN_MIN_DIAG_LSH_DOWN FORMAT "%9.4" /end CHARACTERISTIC
/begin CHARACTERISTIC c_abc_inc_lsh_down "Antibounce counter increment" VALUE 0xa0801375 _REC_VAL_20_u1 255. _CNV_A_R_LINEAR_____0_CM 0. 255. DISPLAY_IDENTIFIER C_ABC_INC_LSH_DOWN FORMAT "%3.0" /end CHARACTERISTIC
/begin CHARACTERISTIC c_abc_max_lsh_down "Maximum value for Antibounce counter" VALUE 0xa0801385 _REC_VAL_20_u1 254. _CNV_A_R_LINEAR_____0_CM 1. 255. DISPLAY_IDENTIFIER C_ABC_MAX_LSH_DOWN FORMAT "%3.0" /end CHARACTERISTIC
/begin CHARACTERISTIC c_lamb_delta_i_max_diag "Maximum limit of LAMB_DELTA_I_LAM_ADJ[i] + LAMB_DELTA_AD_LAM_ADJ[i]" VALUE 0xa0801452 _REC_VAL_20_s2 0.25 _CNV_A_R_LINEAR_____24_CM -0.125 0.125 DISPLAY_IDENTIFIER C_LAMB_DELTA_I_MAX_DIAG FORMAT "%8.5" /end CHARACTERISTIC
/begin CHARACTERISTIC c_lamb_delta_i_min_diag "Minimum limit of LAMB_DELTA_I_LAM_ADJ[i] + LAMB_DELTA_AD_LAM_ADJ[i]" VALUE 0xa0801454 _REC_VAL_20_s2 0.25 _CNV_A_R_LINEAR_____24_CM -0.125 0.125 DISPLAY_IDENTIFIER C_LAMB_DELTA_I_MIN_DIAG FORMAT "%8.5" /end CHARACTERISTIC
/begin CHARACTERISTIC c_maf_int_vls_dif_dly_min[0] "Maximum MAF integral of VLS_DIF_DLY deviation (rich side)" VALUE 0xa08014ce _REC_VAL_20_u2 1820.41666666667 _CNV_A_R_LINEAR_____287_CM 0. 1820.41666666667 DISPLAY_IDENTIFIER C_MAF_INT_VLS_DIF_DLY_MIN[1] FORMAT "%7.2" /end CHARACTERISTIC
/begin CHARACTERISTIC c_maf_int_vls_dif_dly_min[1] "Maximum MAF integral of VLS_DIF_DLY deviation (rich side)" VALUE 0xa08014d0 _REC_VAL_20_u2 1820.41666666667 _CNV_A_R_LINEAR_____287_CM 0. 1820.41666666667 DISPLAY_IDENTIFIER C_MAF_INT_VLS_DIF_DLY_MIN[2] FORMAT "%7.2" /end CHARACTERISTIC
/begin CHARACTERISTIC c_maf_int_vls_dif_dly_max[0] "Maximum MAF integral of VLS_DIF_DLY deviation (lean side)" VALUE 0xa08014ca _REC_VAL_20_u2 1820.41666666667 _CNV_A_R_LINEAR_____287_CM 0. 1820.41666666667 DISPLAY_IDENTIFIER C_MAF_INT_VLS_DIF_DLY_MAX[1] FORMAT "%7.2" /end CHARACTERISTIC
/begin CHARACTERISTIC c_maf_int_vls_dif_dly_max[1] "Maximum MAF integral of VLS_DIF_DLY deviation (lean side)" VALUE 0xa08014cc _REC_VAL_20_u2 1820.41666666667 _CNV_A_R_LINEAR_____287_CM 0. 1820.41666666667 DISPLAY_IDENTIFIER C_MAF_INT_VLS_DIF_DLY_MAX[2] FORMAT "%7.2" /end CHARACTERISTIC
/begin MEASUREMENT lv_vls_dif_dly_ldc_n "Status limited dynamic N" UBYTE _CNV_S_2_RANGE__0___1_CM 1 100. 0. 1. DISPLAY_IDENTIFIER LV_VLS_DIF_DLY_LDC_N ECU_ADDRESS 0xd0002309 BIT_MASK 0x1 /end MEASUREMENT
/begin MEASUREMENT lv_vls_dif_dly_ldc_maf "Status limited dynamic MAF" UBYTE _CNV_S_2_RANGE__0___1_CM 1 100. 0. 1. DISPLAY_IDENTIFIER LV_VLS_DIF_DLY_LDC_MAF ECU_ADDRESS 0xd0002308 BIT_MASK 0x1 /end MEASUREMENT
/begin MEASUREMENT n_mmv_vls_dif_dly_ldc "Floating mean value for limited engine speed" UWORD _CNV_A_R_LINEAR_____14_CM 1 100. 0. 8160. DISPLAY_IDENTIFIER N_MMV_VLS_DIF_DLY_LDC ECU_ADDRESS 0xd0002302 FORMAT "%4.0" /end MEASUREMENT
/begin MEASUREMENT maf_mmv_vls_dif_dly_ldc "Floating mean value for limited MAF" UWORD _CNV_A_R_LINEAR_____111_CM 1 100. 0. 1389. DISPLAY_IDENTIFIER MAF_MMV_VLS_DIF_DLY_LDC ECU_ADDRESS 0xd0002300 FORMAT "%7.2" /end MEASUREMENT
/begin CHARACTERISTIC c_n_ldc_vls_dif_dly "Threshold limited dynamic engine speed" VALUE 0xa0801504 _REC_VAL_20_u2 8160. _CNV_A_R_LINEAR_____14_CM 0. 8160. DISPLAY_IDENTIFIER C_N_LDC_VLS_DIF_DLY FORMAT "%4.0" /end CHARACTERISTIC
/begin CHARACTERISTIC c_maf_ldc_vls_dif_dly "Threshold limited dynamic engine MAF " VALUE 0xa08014e0 _REC_VAL_20_u2 1389. _CNV_A_R_LINEAR_____111_CM 0. 1389. DISPLAY_IDENTIFIER C_MAF_LDC_VLS_DIF_DLY FORMAT "%7.2" /end CHARACTERISTIC
/begin CHARACTERISTIC c_lam_mv_ldc_vls_dif_dly "Threshold limited dynamic lambda " VALUE 0xa0801436 _REC_VAL_20_u2 99.99847412109381 _CNV_A_R_LINEAR_____8_CM 0. 99.99847412109381 DISPLAY_IDENTIFIER C_LAM_MV_LDC_VLS_DIF_DLY /end CHARACTERISTIC
/begin CHARACTERISTIC c_n_crlc_ldc_vls_dif_dly "Correlation constant floating mean value calculation engine speed" VALUE 0xa0801502 _REC_VAL_20_u2 0.9999847412109381 _CNV_A_R_LINEAR_____89_CM 0. 0.9999847412109381 DISPLAY_IDENTIFIER C_N_CRLC_LDC_VLS_DIF_DLY FORMAT "%7.5" /end CHARACTERISTIC
/begin CHARACTERISTIC c_maf_crlc_ldc_vls_dif_dly "Correlation constant floating mean value calculation MAF" VALUE 0xa0801496 _REC_VAL_20_u2 0.9999847412109381 _CNV_A_R_LINEAR_____89_CM 0. 0.9999847412109381 DISPLAY_IDENTIFIER C_MAF_CRLC_LDC_VLS_DIF_DLY FORMAT "%7.5" /end CHARACTERISTIC
/begin CHARACTERISTIC c_lam_mv_crlc_ldc_vls_dif_dly "Correlation constant floating mean value calculation lambda" VALUE 0xa0801434 _REC_VAL_20_u2 0.9999847412109381 _CNV_A_R_LINEAR_____89_CM 0. 0.9999847412109381 DISPLAY_IDENTIFIER C_LAM_MV_CRLC_LDC_VLS_DIF_DLY FORMAT "%7.5" /end CHARACTERISTIC
/begin CHARACTERISTIC c_maf_int_min_vls_dif_dly_ldc[0] "Maximum value of the mass air flow integral after limited dynamic conditions were fulfilled" VALUE 0xa08014b2 _REC_VAL_20_u2 1389. _CNV_A_R_LINEAR_____340_CM 0. 1389. DISPLAY_IDENTIFIER C_MAF_INT_MIN_VLS_DIF_DLY_LDC[1] FORMAT "%7.2" /end CHARACTERISTIC
/begin CHARACTERISTIC c_maf_int_min_vls_dif_dly_ldc[1] "Maximum value of the mass air flow integral after limited dynamic conditions were fulfilled" VALUE 0xa08014b4 _REC_VAL_20_u2 1389. _CNV_A_R_LINEAR_____340_CM 0. 1389. DISPLAY_IDENTIFIER C_MAF_INT_MIN_VLS_DIF_DLY_LDC[2] FORMAT "%7.2" /end CHARACTERISTIC
/begin CHARACTERISTIC c_maf_int_rst_vls_down_dif_diag[0] "Threshold for integral to start a new diagnostic cycle and to set the end flag" VALUE 0xa08014c4 _REC_VAL_20_u2 1820.41666666667 _CNV_A_R_LINEAR_____287_CM 0. 1820.41666666667 DISPLAY_IDENTIFIER C_MAF_INT_RST_VLS_DOWN_DIF_DIAG[1] FORMAT "%7.2" /end CHARACTERISTIC
/begin CHARACTERISTIC c_maf_int_rst_vls_down_dif_diag[1] "Threshold for integral to start a new diagnostic cycle and to set the end flag" VALUE 0xa08014c6 _REC_VAL_20_u2 1820.41666666667 _CNV_A_R_LINEAR_____287_CM 0. 1820.41666666667 DISPLAY_IDENTIFIER C_MAF_INT_RST_VLS_DOWN_DIF_DIAG[2] FORMAT "%7.2" /end CHARACTERISTIC
/begin CHARACTERISTIC c_t_sum_max_max_delta_i_lam[0] "Duration of T_SUM_MAX_DELTA_I_LAM[i] to detect an error" VALUE 0xa08015ba _REC_VAL_20_u2 6553.5 _CNV_A_R_LINEAR_____4_CM 0. 6553.5 DISPLAY_IDENTIFIER C_T_SUM_MAX_MAX_DELTA_I_LAM[1] FORMAT "%6.1" /end CHARACTERISTIC
/begin CHARACTERISTIC c_t_sum_max_max_delta_i_lam[1] "Duration of T_SUM_MAX_DELTA_I_LAM[i] to detect an error" VALUE 0xa08015bc _REC_VAL_20_u2 6553.5 _CNV_A_R_LINEAR_____4_CM 0. 6553.5 DISPLAY_IDENTIFIER C_T_SUM_MAX_MAX_DELTA_I_LAM[2] FORMAT "%6.1" /end CHARACTERISTIC
/begin CHARACTERISTIC c_t_sum_min_max_delta_i_lam[0] "Duration of T_SUM_MIN_DELTA_I_LAM[i] to detect an error" VALUE 0xa08015be _REC_VAL_20_u2 6553.5 _CNV_A_R_LINEAR_____4_CM 0. 6553.5 DISPLAY_IDENTIFIER C_T_SUM_MIN_MAX_DELTA_I_LAM[1] FORMAT "%6.1" /end CHARACTERISTIC
/begin CHARACTERISTIC c_t_sum_min_max_delta_i_lam[1] "Duration of T_SUM_MIN_DELTA_I_LAM[i] to detect an error" VALUE 0xa08015c0 _REC_VAL_20_u2 6553.5 _CNV_A_R_LINEAR_____4_CM 0. 6553.5 DISPLAY_IDENTIFIER C_T_SUM_MIN_MAX_DELTA_I_LAM[2] FORMAT "%6.1" /end CHARACTERISTIC
/begin CHARACTERISTIC c_t_sum_rst_max_delta_i_lam[0] "Time counter to reset T_SUM_MIN/MAX_DELTA_I_LAM[i]" VALUE 0xa08015c6 _REC_VAL_20_u2 6553.5 _CNV_A_R_LINEAR_____4_CM 0. 6553.5 DISPLAY_IDENTIFIER C_T_SUM_RST_MAX_DELTA_I_LAM[1] FORMAT "%6.1" /end CHARACTERISTIC
/begin CHARACTERISTIC c_t_sum_rst_max_delta_i_lam[1] "Time counter to reset T_SUM_MIN/MAX_DELTA_I_LAM[i]" VALUE 0xa08015c8 _REC_VAL_20_u2 6553.5 _CNV_A_R_LINEAR_____4_CM 0. 6553.5 DISPLAY_IDENTIFIER C_T_SUM_RST_MAX_DELTA_I_LAM[2] FORMAT "%6.1" /end CHARACTERISTIC
/begin CHARACTERISTIC c_t_sum_max_err_delta_i_lam[0] "Time counter for maximum time of trim control over limit to set LV_END_DIAG_DELTA_I_LAM[i]" VALUE 0xa08015b6 _REC_VAL_20_u2 6553.5 _CNV_A_R_LINEAR_____4_CM 0. 6553.5 DISPLAY_IDENTIFIER C_T_SUM_MAX_ERR_DELTA_I_LAM[1] FORMAT "%6.1" /end CHARACTERISTIC
/begin CHARACTERISTIC c_t_sum_max_err_delta_i_lam[1] "Time counter for maximum time of trim control over limit to set LV_END_DIAG_DELTA_I_LAM[i]" VALUE 0xa08015b8 _REC_VAL_20_u2 6553.5 _CNV_A_R_LINEAR_____4_CM 0. 6553.5 DISPLAY_IDENTIFIER C_T_SUM_MAX_ERR_DELTA_I_LAM[2] FORMAT "%6.1" /end CHARACTERISTIC
/begin CHARACTERISTIC c_t_sum_ready_delta_i_lam[0] "Time counter for end of diagnosis" VALUE 0xa08015c2 _REC_VAL_20_u2 6553.5 _CNV_A_R_LINEAR_____4_CM 0. 6553.5 DISPLAY_IDENTIFIER C_T_SUM_READY_DELTA_I_LAM[1] FORMAT "%6.1" /end CHARACTERISTIC
/begin CHARACTERISTIC c_t_sum_ready_delta_i_lam[1] "Time counter for end of diagnosis" VALUE 0xa08015c4 _REC_VAL_20_u2 6553.5 _CNV_A_R_LINEAR_____4_CM 0. 6553.5 DISPLAY_IDENTIFIER C_T_SUM_READY_DELTA_I_LAM[2] FORMAT "%6.1" /end CHARACTERISTIC
/begin CHARACTERISTIC c_cat_diag_max_delta_i_lam[0] "Maximum threshold for catalyst diagnosis result to perform the diagnosis" VALUE 0xa080138e _REC_VAL_20_u1 1.9921875 _CNV_A_R_LINEAR_____103_CM 0. 1.9921875 DISPLAY_IDENTIFIER C_CAT_DIAG_MAX_DELTA_I_LAM[1] FORMAT "%8.6" /end CHARACTERISTIC
/begin CHARACTERISTIC c_cat_diag_max_delta_i_lam[1] "Maximum threshold for catalyst diagnosis result to perform the diagnosis" VALUE 0xa080138f _REC_VAL_20_u1 1.9921875 _CNV_A_R_LINEAR_____103_CM 0. 1.9921875 DISPLAY_IDENTIFIER C_CAT_DIAG_MAX_DELTA_I_LAM[2] FORMAT "%8.6" /end CHARACTERISTIC
/begin MEASUREMENT lv_err_delta_i_lam_2 "Trim controller limit error" UBYTE _CNV_S_2_RANGE__0___1_CM 1 100. 0. 1. DISPLAY_IDENTIFIER LV_ERR_DELTA_I_LAM_2 ECU_ADDRESS 0xd0008019 BIT_MASK 0x1 /end MEASUREMENT
/begin MEASUREMENT lv_err_delta_i_lam_1 "Trim controller limit error" UBYTE _CNV_S_2_RANGE__0___1_CM 1 100. 0. 1. DISPLAY_IDENTIFIER LV_ERR_DELTA_I_LAM_1 ECU_ADDRESS 0xd0007ffe BIT_MASK 0x1 /end MEASUREMENT
/begin MEASUREMENT lv_err_vls_down_dif_1 "Trim controller deviation error" UBYTE _CNV_S_2_RANGE__0___1_CM 1 100. 0. 1. DISPLAY_IDENTIFIER LV_ERR_VLS_DOWN_DIF_1 ECU_ADDRESS 0xd0007ff1 BIT_MASK 0x1 /end MEASUREMENT
/begin MEASUREMENT lv_err_vls_down_dif_2 "Trim controller deviation error" UBYTE _CNV_S_2_RANGE__0___1_CM 1 100. 0. 1. DISPLAY_IDENTIFIER LV_ERR_VLS_DOWN_DIF_2 ECU_ADDRESS 0xd000800c BIT_MASK 0x1 /end MEASUREMENT
/begin CHARACTERISTIC c_vls_down_max_diag_lam_adj[0] "Rich limit for VLS_DOWN for trim control diagnosis" VALUE 0xa0801672 _REC_VAL_20_u2 4.9951171875 _CNV_A_R_LINEAR_____2_CM 0. 4.9951171875 DISPLAY_IDENTIFIER C_VLS_DOWN_MAX_DIAG_LAM_ADJ[1] FORMAT "%5.3" /end CHARACTERISTIC
/begin CHARACTERISTIC c_vls_down_max_diag_lam_adj[1] "Rich limit for VLS_DOWN for trim control diagnosis" VALUE 0xa0801674 _REC_VAL_20_u2 4.9951171875 _CNV_A_R_LINEAR_____2_CM 0. 4.9951171875 DISPLAY_IDENTIFIER C_VLS_DOWN_MAX_DIAG_LAM_ADJ[2] FORMAT "%5.3" /end CHARACTERISTIC
/begin CHARACTERISTIC c_vls_down_min_diag_lam_adj[0] "Lean limit for VLS_DOWN for trim control diagnosis" VALUE 0xa0801676 _REC_VAL_20_u2 4.9951171875 _CNV_A_R_LINEAR_____2_CM 0. 4.9951171875 DISPLAY_IDENTIFIER C_VLS_DOWN_MIN_DIAG_LAM_ADJ[1] FORMAT "%5.3" /end CHARACTERISTIC
/begin CHARACTERISTIC c_vls_down_min_diag_lam_adj[1] "Lean limit for VLS_DOWN for trim control diagnosis" VALUE 0xa0801678 _REC_VAL_20_u2 4.9951171875 _CNV_A_R_LINEAR_____2_CM 0. 4.9951171875 DISPLAY_IDENTIFIER C_VLS_DOWN_MIN_DIAG_LAM_ADJ[2] FORMAT "%5.3" /end CHARACTERISTIC
/begin CHARACTERISTIC lc_inh_diag_dly_lam[0] "Manual inhibition of the dynamic fuel trim diagnosis (bank individual)" VALUE 0xa08016dc _REC_VAL_20_u1 1. _CNV_S_2_RANGE__0___1_CM 0. 1. DISPLAY_IDENTIFIER LC_INH_DIAG_DLY_LAM[1] /end CHARACTERISTIC
/begin CHARACTERISTIC lc_inh_diag_dly_lam[1] "Manual inhibition of the dynamic fuel trim diagnosis (bank individual)" VALUE 0xa08016dd _REC_VAL_20_u1 1. _CNV_S_2_RANGE__0___1_CM 0. 1. DISPLAY_IDENTIFIER LC_INH_DIAG_DLY_LAM[2] /end CHARACTERISTIC
/begin MEASUREMENT maf_int_sym_diag_chg_ls_up "MAF integral for detetction of interchanged upstream sensors" UWORD _CNV_A_R_LINEAR_____287_CM 1 100. 0. 1820.41666666667 DISPLAY_IDENTIFIER MAF_INT_SYM_DIAG_CHG_LS_UP ECU_ADDRESS 0xd00022fc FORMAT "%7.2" /end MEASUREMENT
/begin MEASUREMENT maf_int_end_diag_chg_ls_up "MAF integral for end of upstream interchanged sensors detection in no failure case" UWORD _CNV_A_R_LINEAR_____287_CM 1 100. 0. 1820.41666666667 DISPLAY_IDENTIFIER MAF_INT_END_DIAG_CHG_LS_UP ECU_ADDRESS 0xd00022f8 FORMAT "%7.2" /end MEASUREMENT
/begin CHARACTERISTIC c_maf_int_diag_chg_ls_up "Max. MAF integral value when  ERR_SYM_... ¹  \"NO_SYM\" " VALUE 0xa0801498 _REC_VAL_20_u2 1820.41666666667 _CNV_A_R_LINEAR_____287_CM 0. 1820.41666666667 DISPLAY_IDENTIFIER C_MAF_INT_DIAG_CHG_LS_UP FORMAT "%7.2" /end CHARACTERISTIC
/begin CHARACTERISTIC c_fac_lam_lim_max_chg_ls_up "Max. Threshold to detect a interchanged sensor" VALUE 0xa0801402 _REC_VAL_20_s2 99.99847412109381 _CNV_A_R_LINEAR_____113_CM -50. 49.9984741210938 DISPLAY_IDENTIFIER C_FAC_LAM_LIM_MAX_CHG_LS_UP FORMAT "%7.3" /end CHARACTERISTIC
/begin CHARACTERISTIC c_fac_lam_lim_min_chg_ls_up "Min. Threshold to detect a interchanged sensor" VALUE 0xa0801404 _REC_VAL_20_s2 99.99847412109381 _CNV_A_R_LINEAR_____113_CM -50. 49.9984741210938 DISPLAY_IDENTIFIER C_FAC_LAM_LIM_MIN_CHG_LS_UP FORMAT "%7.3" /end CHARACTERISTIC
/begin MEASUREMENT lv_err_chg_ls_up "Debounced error: upstream sensor of banks 1and 2 interchanged" UBYTE _CNV_S_2_RANGE__0___1_CM 1 100. 0. 1. DISPLAY_IDENTIFIER LV_ERR_CHG_LS_UP ECU_ADDRESS 0xd000801d BIT_MASK 0x1 /end MEASUREMENT
/begin CHARACTERISTIC c_fac_pos_chg_ls_up "Gain factor when MAF integral is increased" VALUE 0xa0801411 _REC_VAL_20_u1 1.9921875 _CNV_A_R_LINEAR_____103_CM 0. 1.9921875 DISPLAY_IDENTIFIER C_FAC_POS_CHG_LS_UP FORMAT "%8.6" /end CHARACTERISTIC
/begin CHARACTERISTIC c_fac_neg_chg_ls_up "Gain factor when MAF integral is decreased" VALUE 0xa0801410 _REC_VAL_20_u1 1.9921875 _CNV_A_R_LINEAR_____103_CM 0. 1.9921875 DISPLAY_IDENTIFIER C_FAC_NEG_CHG_LS_UP FORMAT "%8.6" /end CHARACTERISTIC
/begin CHARACTERISTIC c_maf_int_end_diag_chg_ls_up "Max. MAF integral value to have a valid diagnostic result" VALUE 0xa08014a2 _REC_VAL_20_u2 1820.41666666667 _CNV_A_R_LINEAR_____287_CM 0. 1820.41666666667 DISPLAY_IDENTIFIER C_MAF_INT_END_DIAG_CHG_LS_UP FORMAT "%7.2" /end CHARACTERISTIC
/begin MEASUREMENT lv_err_puc_ls_down_1 "Boolean error flag, PUC plausibility fault currently present on downstream oxygen sensor signal" UBYTE _CNV_S_2_RANGE__0___1_CM 1 100. 0. 1. DISPLAY_IDENTIFIER LV_ERR_PUC_LS_DOWN[1] ECU_ADDRESS 0xd0007feb BIT_MASK 0x1 /end MEASUREMENT
/begin MEASUREMENT lv_err_fl_ls_down_1 "Boolean error flag, FL plausibility fault currently present on downstream oxygen sensor signal" UBYTE _CNV_S_2_RANGE__0___1_CM 1 100. 0. 1. DISPLAY_IDENTIFIER LV_ERR_FL_LS_DOWN[1] ECU_ADDRESS 0xd0007fec BIT_MASK 0x1 /end MEASUREMENT
/begin CHARACTERISTIC c_maf_int_max_diag_fl_ls_down "Maximum threshold for MAF integral to end downstream FL signal plausibility" VALUE 0xa08014aa _REC_VAL_20_u2 1820.41666666667 _CNV_A_R_LINEAR_____287_CM 0. 1820.41666666667 DISPLAY_IDENTIFIER C_MAF_INT_MAX_DIAG_FL_LS_DOWN FORMAT "%7.2" /end CHARACTERISTIC
/begin CHARACTERISTIC c_maf_int_min_diag_puc_ls_down "Minimum threshold for MAF integral required to start downstream PUC signal plausibility" VALUE 0xa08014b0 _REC_VAL_20_u2 2912.666666666671 _CNV_A_R_LINEAR_____314_CM 0. 2912.66666666667 DISPLAY_IDENTIFIER C_MAF_INT_MIN_DIAG_PUC_LS_DOWN FORMAT "%7.2" /end CHARACTERISTIC
/begin CHARACTERISTIC c_maf_int_min_diag_fl_ls_down "Minimum threshold for MAF integral required to start downstream FL signal plausibility" VALUE 0xa08014ae _REC_VAL_20_u2 1820.41666666667 _CNV_A_R_LINEAR_____287_CM 0. 1820.41666666667 DISPLAY_IDENTIFIER C_MAF_INT_MIN_DIAG_FL_LS_DOWN FORMAT "%7.2" /end CHARACTERISTIC
/begin CHARACTERISTIC c_vls_min_diag_puc_ls_down "VLS voltage threshold for PUC fault detection" VALUE 0xa080168e _REC_VAL_20_u2 4.9951171875 _CNV_A_R_LINEAR_____2_CM 0. 4.9951171875 DISPLAY_IDENTIFIER C_VLS_MIN_DIAG_PUC_LS_DOWN FORMAT "%5.3" /end CHARACTERISTIC
/begin CHARACTERISTIC c_vls_max_diag_fl_ls_down "VLS voltage threshold for FL fault detection" VALUE 0xa080168c _REC_VAL_20_u2 4.9951171875 _CNV_A_R_LINEAR_____2_CM 0. 4.9951171875 DISPLAY_IDENTIFIER C_VLS_MAX_DIAG_FL_LS_DOWN FORMAT "%5.3" /end CHARACTERISTIC
/begin MEASUREMENT lv_err_fl_ls_down_2 "Boolean error flag, FL plausibility fault currently present on downstream oxygen sensor signal" UBYTE _CNV_S_2_RANGE__0___1_CM 1 100. 0. 1. DISPLAY_IDENTIFIER LV_ERR_FL_LS_DOWN[2] ECU_ADDRESS 0xd0008007 BIT_MASK 0x1 /end MEASUREMENT
/begin MEASUREMENT lv_err_puc_ls_down_2 "Boolean error flag, PUC plausibility fault currently present on downstream oxygen sensor signal" UBYTE _CNV_S_2_RANGE__0___1_CM 1 100. 0. 1. DISPLAY_IDENTIFIER LV_ERR_PUC_LS_DOWN[2] ECU_ADDRESS 0xd0008006 BIT_MASK 0x1 /end MEASUREMENT
/begin CHARACTERISTIC c_maf_int_max_diag_puc_ls_down "Maximum threshold for MAF integral to end downstream PUC signal plausibility" VALUE 0xa08014ac _REC_VAL_20_u2 2912.666666666671 _CNV_A_R_LINEAR_____314_CM 0. 2912.66666666667 DISPLAY_IDENTIFIER C_MAF_INT_MAX_DIAG_PUC_LS_DOWN FORMAT "%7.2" /end CHARACTERISTIC
/begin CHARACTERISTIC c_maf_int_puc_not_ls_down_diag "minimum threshold for MAF integral out of PUC required to start downstream PUC signal plausibility" VALUE 0xa08014bc _REC_VAL_20_u2 2912.666666666671 _CNV_A_R_LINEAR_____314_CM 0. 2912.66666666667 DISPLAY_IDENTIFIER C_MAF_INT_PUC_NOT_LS_DOWN_DIAG FORMAT "%7.2" /end CHARACTERISTIC
/begin CHARACTERISTIC c_fac_maf_int_ls_down_diag "factor for impact of fuel cut off phase to the sensor themperature" VALUE 0xa080140c _REC_VAL_20_u1 31.875 _CNV_A_R_EGCP_LINEA_355_CM 0. 31.875 DISPLAY_IDENTIFIER C_FAC_MAF_INT_LS_DOWN_DIAG /end CHARACTERISTIC
/begin CHARACTERISTIC c_maf_kgh_min_ls_down_diag "minimum MAF_KGH to start MAF integral" VALUE 0xa08014de _REC_VAL_20_u2 2047.96875 _CNV_A_R_LINEAR_____215_CM 0. 2047.96875 DISPLAY_IDENTIFIER C_MAF_KGH_MIN_LS_DOWN_DIAG FORMAT "%10.5" /end CHARACTERISTIC
/begin CHARACTERISTIC c_vls_up_min_maf_int_afr "Upstream minimum VLS to enable MAF_INT_AFR integration" VALUE 0xa08016bc _REC_VAL_20_u2 4.9951171875 _CNV_A_R_LINEAR_____2_CM 0. 4.9951171875 DISPLAY_IDENTIFIER C_VLS_UP_MIN_MAF_INT_AFR FORMAT "%5.3" /end CHARACTERISTIC
/begin CHARACTERISTIC c_vls_up_max_maf_int_afr "Upstream maximum VLS to enable MAF_INT_AFR integration" VALUE 0xa08016b6 _REC_VAL_20_u2 4.9951171875 _CNV_A_R_LINEAR_____2_CM 0. 4.9951171875 DISPLAY_IDENTIFIER C_VLS_UP_MAX_MAF_INT_AFR FORMAT "%5.3" /end CHARACTERISTIC
/begin CHARACTERISTIC lc_maf_int_fl_cdn_afr "Flag to indicate that upstream rich signal instead of LV_FL should enable the MAF_INT_FL integral" VALUE 0xa0801713 _REC_VAL_20_u1 1. _CNV_A_R_LINEAR_____0_CM 0. 1. DISPLAY_IDENTIFIER LC_MAF_INT_FL_CDN_AFR FORMAT "%1.0" /end CHARACTERISTIC
/begin MEASUREMENT lv_inh_diag_chg_ls_up "Inhibit diagnosis interchanged upstream sensors" UBYTE _CNV_S_2_RANGE__0___1_CM 1 100. 0. 1. DISPLAY_IDENTIFIER LV_INH_DIAG_CHG_LS_UP ECU_ADDRESS 0xd0007472 BIT_MASK 0x1 /end MEASUREMENT
/begin CHARACTERISTIC c_maf_int_diag_ls_up_down[0] "Minimum threshold for MAF integral required to start active test" VALUE 0xa080149a _REC_VAL_20_u2 1820.41666666667 _CNV_A_R_LINEAR_____287_CM 0. 1820.41666666667 DISPLAY_IDENTIFIER C_MAF_INT_DIAG_LS_UP_DOWN[1] FORMAT "%7.2" /end CHARACTERISTIC
/begin CHARACTERISTIC c_maf_int_diag_ls_up_down[1] "Minimum threshold for MAF integral required to start active test" VALUE 0xa080149c _REC_VAL_20_u2 1820.41666666667 _CNV_A_R_LINEAR_____287_CM 0. 1820.41666666667 DISPLAY_IDENTIFIER C_MAF_INT_DIAG_LS_UP_DOWN[2] FORMAT "%7.2" /end CHARACTERISTIC
/begin CHARACTERISTIC c_t_max_diag_afr_ls_up_down "Timer threshold for plausibility test under rich AF conditions" VALUE 0xa0801596 _REC_VAL_20_u2 6553.5 _CNV_A_R_LINEAR_____4_CM 0. 6553.5 DISPLAY_IDENTIFIER C_T_MAX_DIAG_AFR_LS_UP_DOWN FORMAT "%6.1" /end CHARACTERISTIC
/begin CHARACTERISTIC c_t_max_diag_afl_ls_up_down "Timer threshold for plausibility test under lean AF conditions" VALUE 0xa0801594 _REC_VAL_20_u2 6553.5 _CNV_A_R_LINEAR_____4_CM 0. 6553.5 DISPLAY_IDENTIFIER C_T_MAX_DIAG_AFL_LS_UP_DOWN FORMAT "%6.1" /end CHARACTERISTIC
/begin CHARACTERISTIC c_t_diag_eol_ls_up_down "Initialization of timer in case EOL to reduce the required minimum activity test time" VALUE 0xa0801540 _REC_VAL_20_u2 6553.5 _CNV_A_R_LINEAR_____4_CM 0. 6553.5 DISPLAY_IDENTIFIER C_T_DIAG_EOL_LS_UP_DOWN FORMAT "%6.1" /end CHARACTERISTIC
/begin CHARACTERISTIC c_maf_int_eol_diag_ls_up_down[0] "Initialization of MAF integral to reduce required minimum MAF value to start active test" VALUE 0xa08014a6 _REC_VAL_20_u2 1820.41666666667 _CNV_A_R_LINEAR_____287_CM 0. 1820.41666666667 DISPLAY_IDENTIFIER C_MAF_INT_EOL_DIAG_LS_UP_DOWN[1] FORMAT "%7.2" /end CHARACTERISTIC
/begin CHARACTERISTIC c_maf_int_eol_diag_ls_up_down[1] "Initialization of MAF integral to reduce required minimum MAF value to start active test" VALUE 0xa08014a8 _REC_VAL_20_u2 1820.41666666667 _CNV_A_R_LINEAR_____287_CM 0. 1820.41666666667 DISPLAY_IDENTIFIER C_MAF_INT_EOL_DIAG_LS_UP_DOWN[2] FORMAT "%7.2" /end CHARACTERISTIC
/begin CHARACTERISTIC c_lamb_afl_min_diag_ls_up_down "Min. lambda set point for lean fault detection " VALUE 0xa080143a _REC_VAL_20_u2 31.9990234375 _CNV_A_R_LINEAR_____129_CM 0. 31.9990234375 DISPLAY_IDENTIFIER C_LAMB_AFL_MIN_DIAG_LS_UP_DOWN FORMAT "%7.4" /end CHARACTERISTIC
/begin CHARACTERISTIC c_lamb_afl_max_diag_ls_up_down "Max. lambda set point for lean fault detection " VALUE 0xa0801438 _REC_VAL_20_u2 31.9990234375 _CNV_A_R_LINEAR_____129_CM 0. 31.9990234375 DISPLAY_IDENTIFIER C_LAMB_AFL_MAX_DIAG_LS_UP_DOWN FORMAT "%7.4" /end CHARACTERISTIC
/begin CHARACTERISTIC c_lamb_afr_min_diag_ls_up_down "Min. lambda set point for rich fault detection " VALUE 0xa0801444 _REC_VAL_20_u2 31.9990234375 _CNV_A_R_LINEAR_____129_CM 0. 31.9990234375 DISPLAY_IDENTIFIER C_LAMB_AFR_MIN_DIAG_LS_UP_DOWN FORMAT "%7.4" /end CHARACTERISTIC
/begin CHARACTERISTIC c_lamb_afr_max_diag_ls_up_down "Max. lambda set point for rich fault detection " VALUE 0xa0801442 _REC_VAL_20_u2 31.9990234375 _CNV_A_R_LINEAR_____129_CM 0. 31.9990234375 DISPLAY_IDENTIFIER C_LAMB_AFR_MAX_DIAG_LS_UP_DOWN FORMAT "%7.4" /end CHARACTERISTIC
/begin CHARACTERISTIC c_vls_afr_thd_diag_act_ls_down[0] "VLS voltage threshold for rich fault detection (downstream sensor)" VALUE 0xa0801656 _REC_VAL_20_u2 4.9951171875 _CNV_A_R_LINEAR_____2_CM 0. 4.9951171875 DISPLAY_IDENTIFIER C_VLS_AFR_THD_DIAG_ACT_LS_DOWN[1] FORMAT "%5.3" /end CHARACTERISTIC
/begin CHARACTERISTIC c_vls_afr_thd_diag_act_ls_down[1] "VLS voltage threshold for rich fault detection (downstream sensor)" VALUE 0xa0801658 _REC_VAL_20_u2 4.9951171875 _CNV_A_R_LINEAR_____2_CM 0. 4.9951171875 DISPLAY_IDENTIFIER C_VLS_AFR_THD_DIAG_ACT_LS_DOWN[2] FORMAT "%5.3" /end CHARACTERISTIC
/begin CHARACTERISTIC c_vls_afl_thd_diag_act_ls_down[0] "VLS voltage threshold for lean fault detection (downstream sensor)" VALUE 0xa0801650 _REC_VAL_20_u2 4.9951171875 _CNV_A_R_LINEAR_____2_CM 0. 4.9951171875 DISPLAY_IDENTIFIER C_VLS_AFL_THD_DIAG_ACT_LS_DOWN[1] FORMAT "%5.3" /end CHARACTERISTIC
/begin CHARACTERISTIC c_vls_afl_thd_diag_act_ls_down[1] "VLS voltage threshold for lean fault detection (downstream sensor)" VALUE 0xa0801652 _REC_VAL_20_u2 4.9951171875 _CNV_A_R_LINEAR_____2_CM 0. 4.9951171875 DISPLAY_IDENTIFIER C_VLS_AFL_THD_DIAG_ACT_LS_DOWN[2] FORMAT "%5.3" /end CHARACTERISTIC
/begin CHARACTERISTIC c_lamb_sp_afr_diag_ls_up_down "Lambda set point for rich fault detection " VALUE 0xa080146c _REC_VAL_20_u2 31.9990234375 _CNV_A_R_LINEAR_____129_CM 0. 31.9990234375 DISPLAY_IDENTIFIER C_LAMB_SP_AFR_DIAG_LS_UP_DOWN FORMAT "%7.4" /end CHARACTERISTIC
/begin CHARACTERISTIC c_lamb_sp_step_diag_ls_up_down "Number of recurrences to achieve the desired lambda set point" VALUE 0xa0801482 _REC_VAL_20_u1 254. _CNV_A_R_LINEAR_____0_CM 1. 255. DISPLAY_IDENTIFIER C_LAMB_SP_STEP_DIAG_LS_UP_DOWN FORMAT "%3.0" /end CHARACTERISTIC
/begin MEASUREMENT lv_err_chk_ls_down_2 "Debounced failure in the downstream sensor " UBYTE _CNV_S_2_RANGE__0___1_CM 1 100. 0. 1. DISPLAY_IDENTIFIER LV_ERR_CHK_LS_DOWN[2] ECU_ADDRESS 0xd0008015 BIT_MASK 0x1 /end MEASUREMENT
/begin CHARACTERISTIC lc_diag_auth_chk_ls_up_down "Boolean switch allowing the active test" VALUE 0xa08016cb _REC_VAL_20_u1 1. _CNV_A_R_LINEAR_____0_CM 0. 1. DISPLAY_IDENTIFIER LC_DIAG_AUTH_CHK_LS_UP_DOWN FORMAT "%1.0" /end CHARACTERISTIC
/begin CHARACTERISTIC c_abc_inc_chk_lsl_up "Increment for debounce algorithmus" VALUE 0xa080136c _REC_VAL_20_u1 255. _CNV_A_R_LINEAR_____0_CM 0. 255. DISPLAY_IDENTIFIER C_ABC_INC_CHK_LSL_UP FORMAT "%3.0" /end CHARACTERISTIC
/begin CHARACTERISTIC c_lamb_afr_thd_diag_act_lsl_up "Lambda value threshold for rich fault detection (upstream sensor)" VALUE 0xa080144a _REC_VAL_20_u2 31.9990234375 _CNV_A_R_LINEAR_____129_CM 0. 31.9990234375 DISPLAY_IDENTIFIER C_LAMB_AFR_THD_DIAG_ACT_LSL_UP FORMAT "%7.4" /end CHARACTERISTIC
/begin CHARACTERISTIC c_lamb_afl_thd_diag_act_lsl_up "Lambda value threshold for lean fault detection (upstream sensor)" VALUE 0xa0801440 _REC_VAL_20_u2 31.9990234375 _CNV_A_R_LINEAR_____129_CM 0. 31.9990234375 DISPLAY_IDENTIFIER C_LAMB_AFL_THD_DIAG_ACT_LSL_UP FORMAT "%7.4" /end CHARACTERISTIC
/begin CHARACTERISTIC c_ctr_sum_rst_afr_chk_lsl_up "Reset debounce counter for Richt test" VALUE 0xa08013d8 _REC_VAL_20_u2 65535. _CNV_A_R_LINEAR_____0_CM 0. 65535. DISPLAY_IDENTIFIER C_CTR_SUM_RST_AFR_CHK_LSL_UP FORMAT "%5.0" /end CHARACTERISTIC
/begin CHARACTERISTIC c_ctr_sum_rst_afl_chk_lsl_up "Reset debounce counter for Lean test" VALUE 0xa08013d6 _REC_VAL_20_u2 65535. _CNV_A_R_LINEAR_____0_CM 0. 65535. DISPLAY_IDENTIFIER C_CTR_SUM_RST_AFL_CHK_LSL_UP FORMAT "%5.0" /end CHARACTERISTIC
/begin CHARACTERISTIC c_abc_max_chk_lsl_up "Maximum value for debounce algorithmus" VALUE 0xa080137c _REC_VAL_20_u2 65535. _CNV_A_R_LINEAR_____0_CM 0. 65535. DISPLAY_IDENTIFIER C_ABC_MAX_CHK_LSL_UP FORMAT "%5.0" /end CHARACTERISTIC
/begin MEASUREMENT lv_err_chk_ls_down_1 "Debounced failure in the downstream sensor " UBYTE _CNV_S_2_RANGE__0___1_CM 1 100. 0. 1. DISPLAY_IDENTIFIER LV_ERR_CHK_LS_DOWN[1] ECU_ADDRESS 0xd0007ffa BIT_MASK 0x1 /end MEASUREMENT
/begin MEASUREMENT lv_err_chg_ls_down "Debounced failure of downstream lambda sensors interchanged " UBYTE _CNV_S_2_RANGE__0___1_CM 1 100. 0. 1. DISPLAY_IDENTIFIER LV_ERR_CHG_LS_DOWN ECU_ADDRESS 0xd0008002 BIT_MASK 0x1 /end MEASUREMENT
/begin CHARACTERISTIC c_t_max_chk_ls_down "Time to debounce the error" VALUE 0xa0801592 _REC_VAL_20_u2 6553.5 _CNV_A_R_LINEAR_____4_CM 0. 6553.5 DISPLAY_IDENTIFIER C_T_MAX_CHK_LS_DOWN FORMAT "%6.1" /end CHARACTERISTIC
/begin CHARACTERISTIC c_t_end_diag_act_ls_down[0] "Timer threshold for the end of the downstream sensor active test in the no failure case" VALUE 0xa080157c _REC_VAL_20_u2 6553.5 _CNV_A_R_LINEAR_____4_CM 0. 6553.5 DISPLAY_IDENTIFIER C_T_END_DIAG_ACT_LS_DOWN[1] FORMAT "%6.1" /end CHARACTERISTIC
/begin CHARACTERISTIC c_t_end_diag_act_ls_down[1] "Timer threshold for the end of the downstream sensor active test in the no failure case" VALUE 0xa080157e _REC_VAL_20_u2 6553.5 _CNV_A_R_LINEAR_____4_CM 0. 6553.5 DISPLAY_IDENTIFIER C_T_END_DIAG_ACT_LS_DOWN[2] FORMAT "%6.1" /end CHARACTERISTIC
/begin CHARACTERISTIC c_lamb_sp_afl_diag_ls_up_down "Lambda set point for lean fault detection " VALUE 0xa0801468 _REC_VAL_20_u2 31.9990234375 _CNV_A_R_LINEAR_____129_CM 0. 31.9990234375 DISPLAY_IDENTIFIER C_LAMB_SP_AFL_DIAG_LS_UP_DOWN FORMAT "%7.4" /end CHARACTERISTIC
/begin MEASUREMENT lv_inh_diag_chg_ls_down "Inhibit diagnosis interchanged downstream sensors" UBYTE _CNV_S_2_RANGE__0___1_CM 1 100. 0. 1. DISPLAY_IDENTIFIER LV_INH_DIAG_CHG_LS_DOWN ECU_ADDRESS 0xd0007468 BIT_MASK 0x1 /end MEASUREMENT
/begin CHARACTERISTIC lc_diag_chg_ls_down_inh "Manual inhibitation of symptom evaluation for downstream sensor interchanged error" VALUE 0xa08016cc _REC_VAL_20_u1 1. _CNV_A_R_LINEAR_____0_CM 0. 1. DISPLAY_IDENTIFIER LC_DIAG_CHG_LS_DOWN_INH FORMAT "%1.0" /end CHARACTERISTIC
/begin MEASUREMENT lv_err_lsl_up_if_1 "Present error in the CJ120 WRAF sensor controller" UBYTE _CNV_S_2_RANGE__0___1_CM 1 100. 0. 1. DISPLAY_IDENTIFIER LV_ERR_LSL_UP_IF[1] ECU_ADDRESS 0xd0007fed BIT_MASK 0x1 /end MEASUREMENT
/begin CHARACTERISTIC c_ctr_max_spi_com_lsl_up[0] "Max. allowed number of SPI comunication errors" VALUE 0xa08013c8 _REC_VAL_20_u1 255. _CNV_A_R_LINEAR_____0_CM 0. 255. DISPLAY_IDENTIFIER C_CTR_MAX_SPI_COM_LSL_UP[1] FORMAT "%3.0" /end CHARACTERISTIC
/begin CHARACTERISTIC c_ctr_max_spi_com_lsl_up[1] "Max. allowed number of SPI comunication errors" VALUE 0xa08013c9 _REC_VAL_20_u1 255. _CNV_A_R_LINEAR_____0_CM 0. 255. DISPLAY_IDENTIFIER C_CTR_MAX_SPI_COM_LSL_UP[2] FORMAT "%3.0" /end CHARACTERISTIC
/begin CHARACTERISTIC c_t_rst_max_diag_lsl_up_if[0] "Max. waiting time for the initialization of the WRAF sensor controller" VALUE 0xa08015b0 _REC_VAL_20_u2 655.35 _CNV_A_R_LINEAR_____3_CM 0. 655.35 DISPLAY_IDENTIFIER C_T_RST_MAX_DIAG_LSL_UP_IF[1] FORMAT "%6.2" /end CHARACTERISTIC
/begin CHARACTERISTIC c_t_rst_max_diag_lsl_up_if[1] "Max. waiting time for the initialization of the WRAF sensor controller" VALUE 0xa08015b2 _REC_VAL_20_u2 655.35 _CNV_A_R_LINEAR_____3_CM 0. 655.35 DISPLAY_IDENTIFIER C_T_RST_MAX_DIAG_LSL_UP_IF[2] FORMAT "%6.2" /end CHARACTERISTIC
/begin CHARACTERISTIC c_t_end_diag_lsl_up_if[0] "Time to diagnostic availability" VALUE 0xa0801582 _REC_VAL_20_u2 655.35 _CNV_A_R_LINEAR_____3_CM 0. 655.35 DISPLAY_IDENTIFIER C_T_END_DIAG_LSL_UP_IF[1] FORMAT "%6.2" /end CHARACTERISTIC
/begin CHARACTERISTIC c_t_end_diag_lsl_up_if[1] "Time to diagnostic availability" VALUE 0xa0801584 _REC_VAL_20_u2 655.35 _CNV_A_R_LINEAR_____3_CM 0. 655.35 DISPLAY_IDENTIFIER C_T_END_DIAG_LSL_UP_IF[2] FORMAT "%6.2" /end CHARACTERISTIC
/begin MEASUREMENT lv_err_lsl_up_if_2 "Present error in the CJ120 WRAF sensor controller" UBYTE _CNV_S_2_RANGE__0___1_CM 1 100. 0. 1. DISPLAY_IDENTIFIER LV_ERR_LSL_UP_IF[2] ECU_ADDRESS 0xd0008008 BIT_MASK 0x1 /end MEASUREMENT
/begin CHARACTERISTIC c_ctr_min_diag_scg_ls_down "Minimum duration required for continious low VLS_DOWN[i] detection" VALUE 0xa08013cc _REC_VAL_20_u1 255. _CNV_A_R_LINEAR_____0_CM 0. 255. DISPLAY_IDENTIFIER C_CTR_MIN_DIAG_SCG_LS_DOWN FORMAT "%3.0" /end CHARACTERISTIC
/begin CHARACTERISTIC c_maf_kgh_min_diag_scg_ls_down "Minimum MAF_KGH flow required for continious low VLS_DOWN[i] detection" VALUE 0xa08014da _REC_VAL_20_u2 2047.96875 _CNV_A_R_LINEAR_____215_CM 0. 2047.96875 DISPLAY_IDENTIFIER C_MAF_KGH_MIN_DIAG_SCG_LS_DOWN FORMAT "%10.5" /end CHARACTERISTIC
/begin CHARACTERISTIC c_vls_thd_diag_scp_ls_down "Oxygen sensor voltage threshold over which short to Vbatt present" VALUE 0xa08016a4 _REC_VAL_20_u2 4.9951171875 _CNV_A_R_LINEAR_____2_CM 0. 4.9951171875 DISPLAY_IDENTIFIER C_VLS_THD_DIAG_SCP_LS_DOWN FORMAT "%5.3" /end CHARACTERISTIC
/begin CHARACTERISTIC c_r_it_max_diag_scg_ls_down "Maximum resistance threshold oxygen sensor internal resistance during short to ground sensor" VALUE 0xa0801524 _REC_VAL_20_u2 65535. _CNV_A_R_LINEAR_____318_CM 0. 65535. DISPLAY_IDENTIFIER C_R_IT_MAX_DIAG_SCG_LS_DOWN FORMAT "%5.0" /end CHARACTERISTIC
/begin CHARACTERISTIC c_r_it_min_diag_oc_ls_down "Minimum resistance threshold oxygen sensor internal resistance during open circuit sensor" VALUE 0xa0801526 _REC_VAL_20_u2 65535. _CNV_A_R_LINEAR_____318_CM 0. 65535. DISPLAY_IDENTIFIER C_R_IT_MIN_DIAG_OC_LS_DOWN FORMAT "%5.0" /end CHARACTERISTIC
/begin CHARACTERISTIC c_t_cdn_diag_oc_ls_down "Minimum required duration where voltage lies outside of the limits for operable sensor to detect fault" VALUE 0xa0801534 _REC_VAL_20_u2 6553.5 _CNV_A_R_LINEAR_____4_CM 0. 6553.5 DISPLAY_IDENTIFIER C_T_CDN_DIAG_OC_LS_DOWN FORMAT "%6.1" /end CHARACTERISTIC
/begin CHARACTERISTIC c_t_dly_diag_oc_ls_down "Minimum required duration where voltage lies outside of the limits for operable sensor to detect fault" VALUE 0xa0801552 _REC_VAL_20_u2 6553.5 _CNV_A_R_LINEAR_____4_CM 0. 6553.5 DISPLAY_IDENTIFIER C_T_DLY_DIAG_OC_LS_DOWN FORMAT "%6.1" /end CHARACTERISTIC
/begin CHARACTERISTIC c_t_dly_diag_scg_ls_down "Minimum duration required for low VLS_DOWN[i] detection" VALUE 0xa0801556 _REC_VAL_20_u2 6553.5 _CNV_A_R_LINEAR_____4_CM 0. 6553.5 DISPLAY_IDENTIFIER C_T_DLY_DIAG_SCG_LS_DOWN FORMAT "%6.1" /end CHARACTERISTIC
/begin CHARACTERISTIC c_vls_thd_diag_scg_ls_down "Oxygen sensor voltage threshold under which short to GND may be present" VALUE 0xa08016a2 _REC_VAL_20_u2 4.9951171875 _CNV_A_R_LINEAR_____2_CM 0. 4.9951171875 DISPLAY_IDENTIFIER C_VLS_THD_DIAG_SCG_LS_DOWN FORMAT "%5.3" /end CHARACTERISTIC
/begin CHARACTERISTIC c_vls_afl_thd_diag_oc_ls_down "Oxygen sensor voltage-lean mixture threshold for diagnosis" VALUE 0xa0801654 _REC_VAL_20_u2 4.9951171875 _CNV_A_R_LINEAR_____2_CM 0. 4.9951171875 DISPLAY_IDENTIFIER C_VLS_AFL_THD_DIAG_OC_LS_DOWN FORMAT "%5.3" /end CHARACTERISTIC
/begin CHARACTERISTIC c_vls_afr_thd_diag_oc_ls_down "Oxygen sensor voltage-rich mixture threshold for diagnosis" VALUE 0xa080165a _REC_VAL_20_u2 4.9951171875 _CNV_A_R_LINEAR_____2_CM 0. 4.9951171875 DISPLAY_IDENTIFIER C_VLS_AFR_THD_DIAG_OC_LS_DOWN FORMAT "%5.3" /end CHARACTERISTIC
/begin MEASUREMENT lv_err_scp_ls_down_1 "Boolean error flag, short to plus fault currently present on downstream oxygen sensor signal" UBYTE _CNV_S_2_RANGE__0___1_CM 1 100. 0. 1. DISPLAY_IDENTIFIER LV_ERR_SCP_LS_DOWN[1] ECU_ADDRESS 0xd0007fe9 BIT_MASK 0x1 /end MEASUREMENT
/begin MEASUREMENT lv_err_scg_ls_down_1 "Boolean error flag, short to ground fault currently present on downstream oxygen sensor signal" UBYTE _CNV_S_2_RANGE__0___1_CM 1 100. 0. 1. DISPLAY_IDENTIFIER LV_ERR_SCG_LS_DOWN[1] ECU_ADDRESS 0xd0007fe8 BIT_MASK 0x1 /end MEASUREMENT
/begin MEASUREMENT lv_err_oc_ls_down_1 "Boolean error flag, open circuit fault currently present on downstream oxygen sensor signal" UBYTE _CNV_S_2_RANGE__0___1_CM 1 100. 0. 1. DISPLAY_IDENTIFIER LV_ERR_OC_LS_DOWN[1] ECU_ADDRESS 0xd0007fea BIT_MASK 0x1 /end MEASUREMENT
/begin MEASUREMENT lv_err_oc_ls_down_2 "Boolean error flag, open circuit fault currently present on downstream oxygen sensor signal" UBYTE _CNV_S_2_RANGE__0___1_CM 1 100. 0. 1. DISPLAY_IDENTIFIER LV_ERR_OC_LS_DOWN[2] ECU_ADDRESS 0xd0008005 BIT_MASK 0x1 /end MEASUREMENT
/begin MEASUREMENT lv_err_scg_ls_down_2 "Boolean error flag, short to ground fault currently present on downstream oxygen sensor signal" UBYTE _CNV_S_2_RANGE__0___1_CM 1 100. 0. 1. DISPLAY_IDENTIFIER LV_ERR_SCG_LS_DOWN[2] ECU_ADDRESS 0xd0008003 BIT_MASK 0x1 /end MEASUREMENT
/begin MEASUREMENT lv_err_scp_ls_down_2 "Boolean error flag, short to plus fault currently present on downstream oxygen sensor signal" UBYTE _CNV_S_2_RANGE__0___1_CM 1 100. 0. 1. DISPLAY_IDENTIFIER LV_ERR_SCP_LS_DOWN[2] ECU_ADDRESS 0xd0008004 BIT_MASK 0x1 /end MEASUREMENT
/begin CHARACTERISTIC c_teg_dyn_min_diag_oc_ls_down "Minimum requested exhaust gas temperature for diagnosis" VALUE 0xa08015f2 _REC_VAL_20_u2 2047.9375 _CNV_A_R_LINEAR_____214_CM -273.15 1774.7875 DISPLAY_IDENTIFIER C_TEG_DYN_MIN_DIAG_OC_LS_DOWN FORMAT "%9.4" /end CHARACTERISTIC
/begin CHARACTERISTIC lc_diag_act_chk_inh "Inhibition bit for the triggered active diagnosis" VALUE 0xa08016ca _REC_VAL_20_u1 1. _CNV_S_2_RANGE__0___1_CM 0. 1. DISPLAY_IDENTIFIER LC_DIAG_ACT_CHK_INH /end CHARACTERISTIC
/begin CHARACTERISTIC c_tco_min_diag_mpl_ls_down "Minimum coolant temperature for diagnosis of the monitor sensors" VALUE 0xa08015e3 _REC_VAL_20_u1 190.5 _CNV_A_R_LINEAR_____17_CM -48. 142.5 DISPLAY_IDENTIFIER C_TCO_MIN_DIAG_MPL_LS_DOWN FORMAT "%6.2" /end CHARACTERISTIC
/begin CHARACTERISTIC c_vs_min_diag_mpl_ls_down "Minimum vehicle speed for diagnosis of the monitor sensors" VALUE 0xa08016c6 _REC_VAL_20_u1 255. _CNV_A_R_LINEAR_____6_CM 0. 255. DISPLAY_IDENTIFIER C_VS_MIN_DIAG_MPL_LS_DOWN FORMAT "%3.0" /end CHARACTERISTIC
/begin CHARACTERISTIC c_vs_max_diag_mpl_ls_down "Maximum vehicle speed for diagnosis of the monitor sensors" VALUE 0xa08016c5 _REC_VAL_20_u1 255. _CNV_A_R_LINEAR_____6_CM 0. 255. DISPLAY_IDENTIFIER C_VS_MAX_DIAG_MPL_LS_DOWN FORMAT "%3.0" /end CHARACTERISTIC
/begin CHARACTERISTIC c_temp_cat_min_diag_mpl_ls_down "Catalyst temperature threshold for diagnosis of the monitor sensors" VALUE 0xa0801606 _REC_VAL_20_u2 2047.9375 _CNV_A_R_LINEAR_____214_CM -273.15 1774.7875 DISPLAY_IDENTIFIER C_TEMP_CAT_MIN_DIAG_MPL_LS_DOWN FORMAT "%9.4" /end CHARACTERISTIC
/begin MEASUREMENT maf_kgh_min_puc "Minimum value of MAF_KGH while switching time calculation" UWORD _CNV_A_R_LINEAR_____215_CM 1 100. 0. 2047.96875 DISPLAY_IDENTIFIER MAF_KGH_MIN_PUC ECU_ADDRESS 0xd00022fe FORMAT "%10.5" /end MEASUREMENT
/begin AXIS_PTS ldp_maf_kgh_ip_fac_ls_down "" 0xa0800e44 maf_kgh _REC_AXS_20_u2 2047.96875 _CNV_A_R_LINEAR_____215_CM 8 0. 2047.96875 FORMAT "%10.5" /end AXIS_PTS
/begin CHARACTERISTIC ip_fac_cycnr_max_ls_down_act "Weighting factor for CTR_SWT_ACT_LS_DOWN[NC_CBK_EX_NR]" CURVE 0xa0801134 _REC_CUR_20_u1_u2 5100. _CNV_A_R_LINEAR_____23_CM 0. 5100. DISPLAY_IDENTIFIER IP_FAC_CYCNR_MAX_LS_DOWN_ACT FORMAT "%4.0"
 /begin AXIS_DESCR COM_AXIS maf_kgh _CNV_A_R_LINEAR_____215_CM 8 0. 2047.96875 FORMAT "%10.5" AXIS_PTS_REF ldp_maf_kgh_ip_fac_ls_down /end AXIS_DESCR
/end CHARACTERISTIC
/begin CHARACTERISTIC c_maf_int_puc_diag_pue_ls_down "Threshold for activation of the diagnosis" VALUE 0xa08014b6 _REC_VAL_20_u2 2912.666666666671 _CNV_A_R_LINEAR_____314_CM 0. 2912.66666666667 DISPLAY_IDENTIFIER C_MAF_INT_PUC_DIAG_PUE_LS_DOWN FORMAT "%7.2" /end CHARACTERISTIC
/begin CHARACTERISTIC c_maf_int_diag_pue_ls_down "Threshold for start of the diagnosis" VALUE 0xa08014a0 _REC_VAL_20_u2 2912.666666666671 _CNV_A_R_LINEAR_____314_CM 0. 2912.66666666667 DISPLAY_IDENTIFIER C_MAF_INT_DIAG_PUE_LS_DOWN FORMAT "%7.2" /end CHARACTERISTIC
/begin CHARACTERISTIC c_ctr_swt_diag_ls_down "Condition for the start of the lambda sensor switching time check" VALUE 0xa08013da _REC_VAL_20_u1 255. _CNV_A_R_LINEAR_____0_CM 0. 255. DISPLAY_IDENTIFIER C_CTR_SWT_DIAG_LS_DOWN FORMAT "%3.0" /end CHARACTERISTIC
/begin CHARACTERISTIC c_ctr_sym_inc_diag_pue_ls_down "Counter increment for PUE_VLS_DOWN diagnosis" VALUE 0xa08013df _REC_VAL_20_u1 255. _CNV_A_R_LINEAR_____0_CM 0. 255. DISPLAY_IDENTIFIER C_CTR_SYM_INC_DIAG_PUE_LS_DOWN FORMAT "%3.0" /end CHARACTERISTIC
/begin CHARACTERISTIC c_ctr_sym_max_diag_pue_ls_down "Maximum value of  counter for PUE_VLS_DOWN diagnosis" VALUE 0xa08013e1 _REC_VAL_20_u1 255. _CNV_A_R_LINEAR_____0_CM 0. 255. DISPLAY_IDENTIFIER C_CTR_SYM_MAX_DIAG_PUE_LS_DOWN FORMAT "%3.0" /end CHARACTERISTIC
/begin CHARACTERISTIC c_vls_dif_min_diag_pue_ls_down "Threshold for VLS_DIF_DIAG_PUE_LS_DOWN[NC_CBK_EX_NR]" VALUE 0xa080165e _REC_VAL_20_u2 4.9951171875 _CNV_A_R_LINEAR_____2_CM 0. 4.9951171875 DISPLAY_IDENTIFIER C_VLS_DIF_MIN_DIAG_PUE_LS_DOWN FORMAT "%5.3" /end CHARACTERISTIC
/begin CHARACTERISTIC c_ctr_swt_ls_down "Diagnostic threshold for CTR_CYCNR_SWT_LS_DOWN[NC_CBK_EX_NR]" VALUE 0xa08013db _REC_VAL_20_u1 1.9921875 _CNV_A_R_LINEAR_____103_CM 0. 1.9921875 DISPLAY_IDENTIFIER C_CTR_SWT_LS_DOWN FORMAT "%8.6" /end CHARACTERISTIC
/begin CHARACTERISTIC c_maf_puc_max_diag_swt_ls_down "Mass air flow threshold for diagnosis of the switching times" VALUE 0xa08014ec _REC_VAL_20_u2 2047.96875 _CNV_A_R_LINEAR_____215_CM 0. 2047.96875 DISPLAY_IDENTIFIER C_MAF_PUC_MAX_DIAG_SWT_LS_DOWN FORMAT "%10.5" /end CHARACTERISTIC
/begin CHARACTERISTIC c_maf_puc_min_diag_swt_ls_down "Mass air flow threshold for diagnosis of the switching times" VALUE 0xa08014ee _REC_VAL_20_u2 2047.96875 _CNV_A_R_LINEAR_____215_CM 0. 2047.96875 DISPLAY_IDENTIFIER C_MAF_PUC_MIN_DIAG_SWT_LS_DOWN FORMAT "%10.5" /end CHARACTERISTIC
/begin CHARACTERISTIC c_fac_vls_max_diag_swt_ls_down "Reduction factor for start of switching time determination" VALUE 0xa080141a _REC_VAL_20_u1 0.99609375 _CNV_A_R_LINEAR_____28_CM 0. 0.99609375 DISPLAY_IDENTIFIER C_FAC_VLS_MAX_DIAG_SWT_LS_DOWN FORMAT "%5.3" /end CHARACTERISTIC
/begin CHARACTERISTIC c_vls_hys_diag_swt_ls_down "Monitor sensor voltage hysteresis" VALUE 0xa0801688 _REC_VAL_20_u2 4.9951171875 _CNV_A_R_LINEAR_____2_CM 0. 4.9951171875 DISPLAY_IDENTIFIER C_VLS_HYS_DIAG_SWT_LS_DOWN FORMAT "%5.3" /end CHARACTERISTIC
/begin CHARACTERISTIC c_vls_puc_min_diag_swt_ls_down "Voltage threshold for monitor sensor diagnosis" VALUE 0xa08016a0 _REC_VAL_20_u2 4.9951171875 _CNV_A_R_LINEAR_____2_CM 0. 4.9951171875 DISPLAY_IDENTIFIER C_VLS_PUC_MIN_DIAG_SWT_LS_DOWN FORMAT "%5.3" /end CHARACTERISTIC
/begin CHARACTERISTIC c_fac_vls_min_diag_swt_ls_down "Reduction factor for end of switching time determination" VALUE 0xa080141b _REC_VAL_20_u1 0.99609375 _CNV_A_R_LINEAR_____28_CM 0. 0.99609375 DISPLAY_IDENTIFIER C_FAC_VLS_MIN_DIAG_SWT_LS_DOWN FORMAT "%5.3" /end CHARACTERISTIC
/begin CHARACTERISTIC c_ctr_end_diag_pue_ls_down "Counter threshold for CTR_END_DIAG_PUE_LS_DOWN[NC_CBK_EX_NR]" VALUE 0xa08013b8 _REC_VAL_20_u2 65535. _CNV_A_R_LINEAR_____0_CM 0. 65535. DISPLAY_IDENTIFIER C_CTR_END_DIAG_PUE_LS_DOWN FORMAT "%5.0" /end CHARACTERISTIC
/begin MEASUREMENT lv_err_pue_ls_down_1 "Debounced diagnosis result of pull end plausibility" UBYTE _CNV_S_2_RANGE__0___1_CM 1 100. 0. 1. DISPLAY_IDENTIFIER LV_ERR_PUE_LS_DOWN[1] ECU_ADDRESS 0xd0007ff4 BIT_MASK 0x1 /end MEASUREMENT
/begin MEASUREMENT lv_err_pue_ls_down_2 "Debounced diagnosis result of pull end plausibility" UBYTE _CNV_S_2_RANGE__0___1_CM 1 100. 0. 1. DISPLAY_IDENTIFIER LV_ERR_PUE_LS_DOWN[2] ECU_ADDRESS 0xd000800f BIT_MASK 0x1 /end MEASUREMENT
/begin MEASUREMENT lv_err_swt_ls_down_1 "Error bit of the switching time diagnosis" UBYTE _CNV_S_2_RANGE__0___1_CM 1 100. 0. 1. DISPLAY_IDENTIFIER LV_ERR_SWT_LS_DOWN[1] ECU_ADDRESS 0xd0007ff5 BIT_MASK 0x1 /end MEASUREMENT
/begin MEASUREMENT lv_err_swt_ls_down_2 "Error bit of the switching time diagnosis" UBYTE _CNV_S_2_RANGE__0___1_CM 1 100. 0. 1. DISPLAY_IDENTIFIER LV_ERR_SWT_LS_DOWN[2] ECU_ADDRESS 0xd0008010 BIT_MASK 0x1 /end MEASUREMENT
/begin CHARACTERISTIC c_abc_max_scg_ls_down "Debounce counter maximum for short to ground electrical check" VALUE 0xa0801389 _REC_VAL_20_u1 255. _CNV_A_R_LINEAR_____0_CM 0. 255. DISPLAY_IDENTIFIER C_ABC_MAX_SCG_LS_DOWN FORMAT "%3.0" /end CHARACTERISTIC
/begin CHARACTERISTIC c_abc_inc_scg_ls_down "Debounce counter increment for short to ground electrical check" VALUE 0xa0801379 _REC_VAL_20_u1 255. _CNV_A_R_LINEAR_____0_CM 0. 255. DISPLAY_IDENTIFIER C_ABC_INC_SCG_LS_DOWN FORMAT "%3.0" /end CHARACTERISTIC
/begin CHARACTERISTIC c_abc_inc_oc_ls_down "Debounce counter increment for open line electrical check" VALUE 0xa0801377 _REC_VAL_20_u1 255. _CNV_A_R_LINEAR_____0_CM 0. 255. DISPLAY_IDENTIFIER C_ABC_INC_OC_LS_DOWN FORMAT "%3.0" /end CHARACTERISTIC
/begin CHARACTERISTIC c_abc_max_oc_ls_down "Debounce counter maximum for open line electrical check" VALUE 0xa0801387 _REC_VAL_20_u1 255. _CNV_A_R_LINEAR_____0_CM 0. 255. DISPLAY_IDENTIFIER C_ABC_MAX_OC_LS_DOWN FORMAT "%3.0" /end CHARACTERISTIC
/begin CHARACTERISTIC c_abc_max_scp_ls_down "Debounce counter maximum for short to plus electrical check" VALUE 0xa080138a _REC_VAL_20_u1 255. _CNV_A_R_LINEAR_____0_CM 0. 255. DISPLAY_IDENTIFIER C_ABC_MAX_SCP_LS_DOWN FORMAT "%3.0" /end CHARACTERISTIC
/begin CHARACTERISTIC c_abc_inc_scp_ls_down "Debounce counter increment  for short to plus electrical check" VALUE 0xa080137a _REC_VAL_20_u1 255. _CNV_A_R_LINEAR_____0_CM 0. 255. DISPLAY_IDENTIFIER C_ABC_INC_SCP_LS_DOWN FORMAT "%3.0" /end CHARACTERISTIC
/begin CHARACTERISTIC c_abc_inc_puc_ls_down "Debounce counter increment for PUC plausibility" VALUE 0xa0801378 _REC_VAL_20_u1 255. _CNV_A_R_LINEAR_____0_CM 0. 255. DISPLAY_IDENTIFIER C_ABC_INC_PUC_LS_DOWN FORMAT "%3.0" /end CHARACTERISTIC
/begin CHARACTERISTIC c_abc_inc_fl_ls_down "Debounce counter increment for FL plausibility" VALUE 0xa0801374 _REC_VAL_20_u1 255. _CNV_A_R_LINEAR_____0_CM 0. 255. DISPLAY_IDENTIFIER C_ABC_INC_FL_LS_DOWN FORMAT "%3.0" /end CHARACTERISTIC
/begin CHARACTERISTIC c_abc_max_puc_ls_down "Debounce counter maximum for PUC plausibility" VALUE 0xa0801388 _REC_VAL_20_u1 255. _CNV_A_R_LINEAR_____0_CM 0. 255. DISPLAY_IDENTIFIER C_ABC_MAX_PUC_LS_DOWN FORMAT "%3.0" /end CHARACTERISTIC
/begin CHARACTERISTIC c_abc_max_fl_ls_down "Debounce counter maximum for FL plausibility" VALUE 0xa0801384 _REC_VAL_20_u1 255. _CNV_A_R_LINEAR_____0_CM 0. 255. DISPLAY_IDENTIFIER C_ABC_MAX_FL_LS_DOWN FORMAT "%3.0" /end CHARACTERISTIC
/begin CHARACTERISTIC lc_err_dyn_vld_ls_up "Allow Sensor Dynamic Fault to be considered as Sensor Failure (stops closed loop AF control)" VALUE 0xa08016d5 _REC_VAL_20_u1 1. _CNV_A_R_LINEAR_____0_CM 0. 1. DISPLAY_IDENTIFIER LC_ERR_DYN_VLD_LS_UP FORMAT "%1.0" /end CHARACTERISTIC
/begin CHARACTERISTIC lc_ls_up_obd_1_man_deac[0] "Logical calibration data for manual deactivation of all OBD1 diagnosis for upstream oxygen sensor" VALUE 0xa08016fa _REC_VAL_20_u1 1. _CNV_A_R_LINEAR_____0_CM 0. 1. DISPLAY_IDENTIFIER LC_LS_UP_OBD_1_MAN_DEAC[1] FORMAT "%1.0" /end CHARACTERISTIC
/begin CHARACTERISTIC lc_ls_up_obd_1_man_deac[1] "Logical calibration data for manual deactivation of all OBD1 diagnosis for upstream oxygen sensor" VALUE 0xa08016fb _REC_VAL_20_u1 1. _CNV_A_R_LINEAR_____0_CM 0. 1. DISPLAY_IDENTIFIER LC_LS_UP_OBD_1_MAN_DEAC[2] FORMAT "%1.0" /end CHARACTERISTIC
/begin CHARACTERISTIC lc_ls_up_obd_2_man_deac[0] "Logical calibration data for manual deactivation of all OBD2 diagnosis for upstream oxygen sensor" VALUE 0xa08016fc _REC_VAL_20_u1 1. _CNV_A_R_LINEAR_____0_CM 0. 1. DISPLAY_IDENTIFIER LC_LS_UP_OBD_2_MAN_DEAC[1] FORMAT "%1.0" /end CHARACTERISTIC
/begin CHARACTERISTIC lc_ls_up_obd_2_man_deac[1] "Logical calibration data for manual deactivation of all OBD2 diagnosis for upstream oxygen sensor" VALUE 0xa08016fd _REC_VAL_20_u1 1. _CNV_A_R_LINEAR_____0_CM 0. 1. DISPLAY_IDENTIFIER LC_LS_UP_OBD_2_MAN_DEAC[2] FORMAT "%1.0" /end CHARACTERISTIC
/begin CHARACTERISTIC lc_ls_up_err[0] "Opportunity for manual setting of LV_ERR_LS_UP[i] = 1" VALUE 0xa08016f8 _REC_VAL_20_u1 1. _CNV_A_R_LINEAR_____0_CM 0. 1. DISPLAY_IDENTIFIER LC_LS_UP_ERR[1] FORMAT "%1.0" /end CHARACTERISTIC
/begin CHARACTERISTIC lc_ls_up_err[1] "Opportunity for manual setting of LV_ERR_LS_UP[i] = 1" VALUE 0xa08016f9 _REC_VAL_20_u1 1. _CNV_A_R_LINEAR_____0_CM 0. 1. DISPLAY_IDENTIFIER LC_LS_UP_ERR[2] FORMAT "%1.0" /end CHARACTERISTIC
/begin CHARACTERISTIC c_nr_end_diag_lsl_up[0] "Bit mask to select the consideration of a certain end flag for the final end flag" VALUE 0xa0801516 _REC_VAL_20_u2 65535. _CNV_A_R_LINEAR_____0_CM 0. 65535. DISPLAY_IDENTIFIER C_NR_END_DIAG_LSL_UP[1] FORMAT "%5.0" /end CHARACTERISTIC
/begin CHARACTERISTIC c_nr_end_diag_lsl_up[1] "Bit mask to select the consideration of a certain end flag for the final end flag" VALUE 0xa0801518 _REC_VAL_20_u2 65535. _CNV_A_R_LINEAR_____0_CM 0. 65535. DISPLAY_IDENTIFIER C_NR_END_DIAG_LSL_UP[2] FORMAT "%5.0" /end CHARACTERISTIC
/begin CHARACTERISTIC c_nr_end_diag_ls_down[0] "Bit mask to select the consideration of a certain end flag for the final end flag" VALUE 0xa0801512 _REC_VAL_20_u2 65535. _CNV_A_R_LINEAR_____0_CM 0. 65535. DISPLAY_IDENTIFIER C_NR_END_DIAG_LS_DOWN[1] FORMAT "%5.0" /end CHARACTERISTIC
/begin CHARACTERISTIC c_nr_end_diag_ls_down[1] "Bit mask to select the consideration of a certain end flag for the final end flag" VALUE 0xa0801514 _REC_VAL_20_u2 65535. _CNV_A_R_LINEAR_____0_CM 0. 65535. DISPLAY_IDENTIFIER C_NR_END_DIAG_LS_DOWN[2] FORMAT "%5.0" /end CHARACTERISTIC
/begin CHARACTERISTIC lc_ls_up_diag_act[0] "Activation bit for upstream oxygen sensor final diagnosis" VALUE 0xa08016f6 _REC_VAL_20_u1 1. _CNV_A_R_LINEAR_____0_CM 0. 1. DISPLAY_IDENTIFIER LC_LS_UP_DIAG_ACT[1] FORMAT "%1.0" /end CHARACTERISTIC
/begin CHARACTERISTIC lc_ls_up_diag_act[1] "Activation bit for upstream oxygen sensor final diagnosis" VALUE 0xa08016f7 _REC_VAL_20_u1 1. _CNV_A_R_LINEAR_____0_CM 0. 1. DISPLAY_IDENTIFIER LC_LS_UP_DIAG_ACT[2] FORMAT "%1.0" /end CHARACTERISTIC
/begin CHARACTERISTIC lc_ls_down_diag_act[0] "Activation bit for downstream oxygen sensor final diagnosis" VALUE 0xa08016ee _REC_VAL_20_u1 1. _CNV_A_R_LINEAR_____0_CM 0. 1. DISPLAY_IDENTIFIER LC_LS_DOWN_DIAG_ACT[1] FORMAT "%1.0" /end CHARACTERISTIC
/begin CHARACTERISTIC lc_ls_down_diag_act[1] "Activation bit for downstream oxygen sensor final diagnosis" VALUE 0xa08016ef _REC_VAL_20_u1 1. _CNV_A_R_LINEAR_____0_CM 0. 1. DISPLAY_IDENTIFIER LC_LS_DOWN_DIAG_ACT[2] FORMAT "%1.0" /end CHARACTERISTIC
/begin CHARACTERISTIC lc_ls_down_obd_1_man_deac[0] "Logical calibration data for manual deactivation of all OBD1 diagnosis for downstream oxygen sensor" VALUE 0xa08016f2 _REC_VAL_20_u1 1. _CNV_A_R_LINEAR_____0_CM 0. 1. DISPLAY_IDENTIFIER LC_LS_DOWN_OBD_1_MAN_DEAC[1] FORMAT "%1.0" /end CHARACTERISTIC
/begin CHARACTERISTIC lc_ls_down_obd_1_man_deac[1] "Logical calibration data for manual deactivation of all OBD1 diagnosis for downstream oxygen sensor" VALUE 0xa08016f3 _REC_VAL_20_u1 1. _CNV_A_R_LINEAR_____0_CM 0. 1. DISPLAY_IDENTIFIER LC_LS_DOWN_OBD_1_MAN_DEAC[2] FORMAT "%1.0" /end CHARACTERISTIC
/begin CHARACTERISTIC lc_ls_down_obd_2_man_deac[0] "Logical calibration data for manual deactivation of all OBD2 diagnosis for downstream oxygen sensor" VALUE 0xa08016f4 _REC_VAL_20_u1 1. _CNV_A_R_LINEAR_____0_CM 0. 1. DISPLAY_IDENTIFIER LC_LS_DOWN_OBD_2_MAN_DEAC[1] FORMAT "%1.0" /end CHARACTERISTIC
/begin CHARACTERISTIC lc_ls_down_obd_2_man_deac[1] "Logical calibration data for manual deactivation of all OBD2 diagnosis for downstream oxygen sensor" VALUE 0xa08016f5 _REC_VAL_20_u1 1. _CNV_A_R_LINEAR_____0_CM 0. 1. DISPLAY_IDENTIFIER LC_LS_DOWN_OBD_2_MAN_DEAC[2] FORMAT "%1.0" /end CHARACTERISTIC
/begin CHARACTERISTIC lc_ls_down_err[0] "Opportunity for manual setting of LV_ERR_LS_DOWN[i] = 1" VALUE 0xa08016f0 _REC_VAL_20_u1 1. _CNV_A_R_LINEAR_____0_CM 0. 1. DISPLAY_IDENTIFIER LC_LS_DOWN_ERR[1] FORMAT "%1.0" /end CHARACTERISTIC
/begin CHARACTERISTIC lc_ls_down_err[1] "Opportunity for manual setting of LV_ERR_LS_DOWN[i] = 1" VALUE 0xa08016f1 _REC_VAL_20_u1 1. _CNV_A_R_LINEAR_____0_CM 0. 1. DISPLAY_IDENTIFIER LC_LS_DOWN_ERR[2] FORMAT "%1.0" /end CHARACTERISTIC
/begin CHARACTERISTIC lc_err_chg_ls_up "Allow Sensor Interchanged Fault to be considered as Sensor Failure (stops closed loop AF control)" VALUE 0xa08016d4 _REC_VAL_20_u1 1. _CNV_A_R_LINEAR_____0_CM 0. 1. DISPLAY_IDENTIFIER LC_ERR_CHG_LS_UP FORMAT "%1.0" /end CHARACTERISTIC
/begin CHARACTERISTIC lc_err_chg_ls_down "Allow Sensor Interchanged Fault to be considered as Sensor Failure (in case of 1)" VALUE 0xa08016d3 _REC_VAL_20_u1 1. _CNV_A_R_LINEAR_____0_CM 0. 1. DISPLAY_IDENTIFIER LC_ERR_CHG_LS_DOWN FORMAT "%1.0" /end CHARACTERISTIC
/begin CHARACTERISTIC c_vls_up_diag_min_oc_lsl_up "LSL undervoltage threshold" VALUE 0xa08016b0 _REC_VAL_20_s2 319.9951171875 _CNV_A_R_LINEAR_____2_CM -160. 159.9951171875 DISPLAY_IDENTIFIER C_VLS_UP_DIAG_MIN_OC_LSL_UP FORMAT "%8.3" /end CHARACTERISTIC
/begin CHARACTERISTIC c_t_vls_up_min_diag_oc_lsl_up "Max time to debounce open circuit in VN or VG symptom" VALUE 0xa08015cc _REC_VAL_20_u2 6553.5 _CNV_A_R_LINEAR_____4_CM 0. 6553.5 DISPLAY_IDENTIFIER C_T_VLS_UP_MIN_DIAG_OC_LSL_UP FORMAT "%6.1" /end CHARACTERISTIC
/begin CHARACTERISTIC lc_diag_puc_end_man_lsl_up "Boolean switch to bypass activation of LV_DIAG_PUC_END_LSL_UP[i]" VALUE 0xa08016d2 _REC_VAL_20_u1 1. _CNV_A_R_LINEAR_____0_CM 0. 1. DISPLAY_IDENTIFIER LC_DIAG_PUC_END_MAN_LSL_UP FORMAT "%1.0" /end CHARACTERISTIC
/begin CHARACTERISTIC c_t_wait_sym_obd_2_lsh_up "Waiting time to check if OBD2 upstream heater error is present ( to distinguish OC on Vip from Vg)" VALUE 0xa08015d2 _REC_VAL_20_u2 6553.5 _CNV_A_R_LINEAR_____4_CM 0. 6553.5 DISPLAY_IDENTIFIER C_T_WAIT_SYM_OBD_2_LSH_UP FORMAT "%6.1" /end CHARACTERISTIC
/begin MEASUREMENT lv_err_oc_lsl_up_1 "Debounced open circuit failure detected" UBYTE _CNV_S_2_RANGE__0___1_CM 1 100. 0. 1. DISPLAY_IDENTIFIER LV_ERR_OC_LSL_UP[1] ECU_ADDRESS 0xd0007ffd BIT_MASK 0x1 /end MEASUREMENT
/begin MEASUREMENT lv_err_oc_lsl_up_2 "Debounced open circuit failure detected" UBYTE _CNV_S_2_RANGE__0___1_CM 1 100. 0. 1. DISPLAY_IDENTIFIER LV_ERR_OC_LSL_UP[2] ECU_ADDRESS 0xd0008018 BIT_MASK 0x1 /end MEASUREMENT
/begin CHARACTERISTIC c_vls_up_min_oc_afs_lsl_up "LSL stoichiometric voltage lower threshold" VALUE 0xa08016be _REC_VAL_20_s2 319.9951171875 _CNV_A_R_LINEAR_____2_CM -160. 159.9951171875 DISPLAY_IDENTIFIER C_VLS_UP_MIN_OC_AFS_LSL_UP FORMAT "%8.3" /end CHARACTERISTIC
/begin CHARACTERISTIC c_vls_up_max_oc_afs_lsl_up "LSL stoichiometric voltage upper threshold" VALUE 0xa08016b8 _REC_VAL_20_s2 319.9951171875 _CNV_A_R_LINEAR_____2_CM -160. 159.9951171875 DISPLAY_IDENTIFIER C_VLS_UP_MAX_OC_AFS_LSL_UP FORMAT "%8.3" /end CHARACTERISTIC
/begin CHARACTERISTIC c_t_diag_oc_rst_osc_di "Time to reactivate oscillator for upstream tip temperature measurement" VALUE 0xa0801544 _REC_VAL_20_u2 6553.5 _CNV_A_R_LINEAR_____4_CM 0. 6553.5 DISPLAY_IDENTIFIER C_T_DIAG_OC_RST_OSC_DI FORMAT "%6.1" /end CHARACTERISTIC
/begin CHARACTERISTIC c_t_diag_oc_lsl_up "Timer to finish OC diagnosis in case of OBD2 upstream heater error symptom active and conditions for plausibility diagnosis fulfilled" VALUE 0xa0801542 _REC_VAL_20_u2 6553.5 _CNV_A_R_LINEAR_____4_CM 0. 6553.5 DISPLAY_IDENTIFIER C_T_DIAG_OC_LSL_UP FORMAT "%6.1" /end CHARACTERISTIC
/begin CHARACTERISTIC c_lamb_sp_step_oc_chk_lsl_up "Number of recurrences to achieve the desired lambda set point during open-circuit check" VALUE 0xa0801483 _REC_VAL_20_u1 254. _CNV_A_R_LINEAR_____0_CM 1. 255. DISPLAY_IDENTIFIER C_LAMB_SP_STEP_OC_CHK_LSL_UP FORMAT "%3.0" /end CHARACTERISTIC
/begin CHARACTERISTIC c_lamb_sp_oc_chk_lsl_up "Lambda setpoint target for active test for open circuit in VG / VIP" VALUE 0xa0801480 _REC_VAL_20_u2 31.9990234375 _CNV_A_R_LINEAR_____129_CM 0. 31.9990234375 DISPLAY_IDENTIFIER C_LAMB_SP_OC_CHK_LSL_UP FORMAT "%7.4" /end CHARACTERISTIC
/begin CHARACTERISTIC c_lamb_sp_min_diag_oc_lsl_up "Lower end of blind region for lambda setpoint for active test for open circuit in VG / VIP" VALUE 0xa080147c _REC_VAL_20_u2 31.9990234375 _CNV_A_R_LINEAR_____129_CM 0. 31.9990234375 DISPLAY_IDENTIFIER C_LAMB_SP_MIN_DIAG_OC_LSL_UP FORMAT "%7.4" /end CHARACTERISTIC
/begin CHARACTERISTIC c_lamb_sp_max_diag_oc_lsl_up "Upper end of blind region for lambda setpoint for active test for open circuit in VG / VIP" VALUE 0xa0801476 _REC_VAL_20_u2 31.9990234375 _CNV_A_R_LINEAR_____129_CM 0. 31.9990234375 DISPLAY_IDENTIFIER C_LAMB_SP_MAX_DIAG_OC_LSL_UP FORMAT "%7.4" /end CHARACTERISTIC
/begin MEASUREMENT lv_err_el_lsl_up_1 "Debounced diagnosis value caused by an OBD-I error at the WRAF-Sensor" UBYTE _CNV_S_2_RANGE__0___1_CM 1 100. 0. 1. DISPLAY_IDENTIFIER LV_ERR_EL_LSL_UP[1] ECU_ADDRESS 0xd0007fee BIT_MASK 0x1 /end MEASUREMENT
/begin MEASUREMENT lv_err_el_lsl_up_2 "Debounced diagnosis value caused by an OBD-I error at the WRAF-Sensor" UBYTE _CNV_S_2_RANGE__0___1_CM 1 100. 0. 1. DISPLAY_IDENTIFIER LV_ERR_EL_LSL_UP[2] ECU_ADDRESS 0xd0008009 BIT_MASK 0x1 /end MEASUREMENT
/begin CHARACTERISTIC c_ctr_iplsl_sym_diag_lsl_up "Max. error debounce counter" VALUE 0xa08013c4 _REC_VAL_20_u2 65535. _CNV_A_R_LINEAR_____0_CM 0. 65535. DISPLAY_IDENTIFIER C_CTR_IPLSL_SYM_DIAG_LSL_UP FORMAT "%5.0" /end CHARACTERISTIC
/begin CHARACTERISTIC c_lamb_sp_afr_iplsl_diag_lsl_up "Max. rich lambda set point to activate the IP diagnosis" VALUE 0xa080146e _REC_VAL_20_u2 31.9990234375 _CNV_A_R_LINEAR_____129_CM 0. 31.9990234375 DISPLAY_IDENTIFIER C_LAMB_SP_AFR_IPLSL_DIAG_LSL_UP FORMAT "%7.4" /end CHARACTERISTIC
/begin CHARACTERISTIC c_lamb_sp_afl_iplsl_diag_lsl_up "Min. lean lambda set point to activate the IP diagnosis" VALUE 0xa080146a _REC_VAL_20_u2 31.9990234375 _CNV_A_R_LINEAR_____129_CM 0. 31.9990234375 DISPLAY_IDENTIFIER C_LAMB_SP_AFL_IPLSL_DIAG_LSL_UP FORMAT "%7.4" /end CHARACTERISTIC
/begin CHARACTERISTIC c_t_dly_diag_el_lsl_up "Time delay  to start the electrical failure diagnosis" VALUE 0xa080154e _REC_VAL_20_u2 655.35 _CNV_A_R_LINEAR_____3_CM 0. 655.35 DISPLAY_IDENTIFIER C_T_DLY_DIAG_EL_LSL_UP FORMAT "%6.2" /end CHARACTERISTIC
/begin CHARACTERISTIC lc_iplsl_sym_diag_lsl_up "Logical variable to force IPLSL symptom flag (only for test purpose)" VALUE 0xa08016eb _REC_VAL_20_u1 1. _CNV_A_R_LINEAR_____0_CM 0. 1. DISPLAY_IDENTIFIER LC_IPLSL_SYM_DIAG_LSL_UP FORMAT "%1.0" /end CHARACTERISTIC
/begin CHARACTERISTIC c_abc_inc_diag_el_lsl_up "Increment of OBD-I Diagnosis debouncer counter" VALUE 0xa0801370 _REC_VAL_20_u1 255. _CNV_A_R_LINEAR_____0_CM 0. 255. DISPLAY_IDENTIFIER C_ABC_INC_DIAG_EL_LSL_UP FORMAT "%3.0" /end CHARACTERISTIC
/begin CHARACTERISTIC c_abc_max_diag_el_lsl_up "Maximum threshold of OBD-I Diagnosis debouncer counter" VALUE 0xa0801380 _REC_VAL_20_u1 254. _CNV_A_R_LINEAR_____0_CM 1. 255. DISPLAY_IDENTIFIER C_ABC_MAX_DIAG_EL_LSL_UP FORMAT "%3.0" /end CHARACTERISTIC
/begin COMPU_METHOD _CNV_A_R_LINEAR_____0_CM "" RAT_FUNC "%6.3" "-" COEFFS 0 1. 0. 0 0 1 /end COMPU_METHOD
/begin COMPU_METHOD _CNV_S_2_RANGE__0___1_CM "" TAB_VERB "%6.3" "-" COMPU_TAB_REF _CNV_S_2_RANGE__0___1 /end COMPU_METHOD
/begin COMPU_VTAB _CNV_S_2_RANGE__0___1 "" TAB_VERB 2 0 "0" 1 "1" /end COMPU_VTAB
/begin COMPU_METHOD _CNV_A_R_LINEAR_____2_CM "" RAT_FUNC "%6.3" "V" COEFFS 0 204.8 0. 0 0 1 /end COMPU_METHOD
/begin COMPU_METHOD _CNV_A_R_LINEAR_____3_CM "" RAT_FUNC "%6.3" "s" COEFFS 0 100. 0. 0 0 1 /end COMPU_METHOD
/begin COMPU_METHOD _CNV_A_R_LINEAR_____4_CM "" RAT_FUNC "%6.3" "s" COEFFS 0 10. 0. 0 0 1 /end COMPU_METHOD
/begin COMPU_METHOD _CNV_A_R_LINEAR_____5_CM "" RAT_FUNC "%6.3" "%" COEFFS 0 2.56 0. 0 0 1 /end COMPU_METHOD
/begin COMPU_METHOD _CNV_A_R_LINEAR_____6_CM "" RAT_FUNC "%6.3" "km/h" COEFFS 0 1. 0. 0 0 1 /end COMPU_METHOD
/begin COMPU_METHOD _CNV_A_R_LINEAR_____8_CM "" RAT_FUNC "%6.3" "%" COEFFS 0 655.3599999999997 0. 0 0 1 /end COMPU_METHOD
/begin COMPU_METHOD _CNV_A_R_LINEAR_____14_CM "" RAT_FUNC "%6.3" "rpm" COEFFS 0 1. 0. 0 0 1 /end COMPU_METHOD
/begin COMPU_METHOD _CNV_A_R_LINEAR_____17_CM "" RAT_FUNC "%6.3" "°C" COEFFS 0 1.333333333333333 64. 0 0 1 /end COMPU_METHOD
/begin COMPU_METHOD _CNV_A_R_LINEAR_____23_CM "" RAT_FUNC "%6.3" "ms" COEFFS 0 5.e-002 0. 0 0 1 /end COMPU_METHOD
/begin COMPU_METHOD _CNV_A_R_LINEAR_____24_CM "" RAT_FUNC "%6.3" "-" COEFFS 0 16384. 0. 0 0 1 /end COMPU_METHOD
/begin COMPU_METHOD _CNV_A_R_LINEAR_____28_CM "" RAT_FUNC "%6.3" "-" COEFFS 0 256. 0. 0 0 1 /end COMPU_METHOD
/begin COMPU_METHOD _CNV_A_R_LINEAR_____36_CM "" RAT_FUNC "%6.3" "s" COEFFS 0 1. 0. 0 0 1 /end COMPU_METHOD
/begin COMPU_METHOD _CNV_A_R_LINEAR_____89_CM "" RAT_FUNC "%6.3" "-" COEFFS 0 65535.99999999996 0. 0 0 1 /end COMPU_METHOD
/begin COMPU_METHOD _CNV_A_R_LINEAR_____103_CM "" RAT_FUNC "%6.3" "-" COEFFS 0 128. 0. 0 0 1 /end COMPU_METHOD
/begin COMPU_METHOD _CNV_A_R_LINEAR_____111_CM "" RAT_FUNC "%6.3" "mg/stk" COEFFS 0 47.18142548596112 0. 0 0 1 /end COMPU_METHOD
/begin COMPU_METHOD _CNV_A_R_LINEAR_____113_CM "" RAT_FUNC "%6.3" "%" COEFFS 0 655.3599999999997 -1.455191522836685e-011 0 0 1 /end COMPU_METHOD
/begin COMPU_METHOD _CNV_A_R_LINEAR_____129_CM "" RAT_FUNC "%6.3" "-" COEFFS 0 1024. 0. 0 0 1 /end COMPU_METHOD
/begin COMPU_METHOD _CNV_A_R_LINEAR_____130_CM "" RAT_FUNC "%6.3" "°C" COEFFS 0 16. 0. 0 0 1 /end COMPU_METHOD
/begin COMPU_METHOD _CNV_A_R_LINEAR_____214_CM "" RAT_FUNC "%6.3" "°C" COEFFS 0 16. 4370.4 0 0 1 /end COMPU_METHOD
/begin COMPU_METHOD _CNV_A_R_LINEAR_____215_CM "" RAT_FUNC "%6.3" "kg/h" COEFFS 0 32. 0. 0 0 1 /end COMPU_METHOD
/begin COMPU_METHOD _CNV_A_R_LINEAR_____287_CM "" RAT_FUNC "%6.3" "g" COEFFS 0 35.99999999999994 0. 0 0 1 /end COMPU_METHOD
/begin COMPU_METHOD _CNV_A_R_EGCP_LINEA_299_CM "Battery voltage" RAT_FUNC "%6.3" "°C" COEFFS 0 16. 32768. 0 0 1 /end COMPU_METHOD
/begin COMPU_METHOD _CNV_A_R_LINEAR_____314_CM "" RAT_FUNC "%6.3" "g" COEFFS 0 22.49999999999997 0. 0 0 1 /end COMPU_METHOD
/begin COMPU_METHOD _CNV_A_R_LINEAR_____318_CM "" RAT_FUNC "%6.3" "Ohm" COEFFS 0 1. 0. 0 0 1 /end COMPU_METHOD
/begin COMPU_METHOD _CNV_A_R_EGCP_LINEA_319_CM "" RAT_FUNC "%6.3" "J/K" COEFFS 0 16. 0. 0 0 1 /end COMPU_METHOD
/begin COMPU_METHOD _CNV_A_R_LINEAR_____320_CM "" RAT_FUNC "%6.3" "J" COEFFS 0 1. 0. 0 0 1 /end COMPU_METHOD
/begin COMPU_METHOD _CNV_S_5_EGCP_RANGE_338_CM "" TAB_VERB "%6.3" "-" COMPU_TAB_REF _CNV_S_5_EGCP_RANGE_338 /end COMPU_METHOD
/begin COMPU_VTAB _CNV_S_5_EGCP_RANGE_338 "" TAB_VERB 5 0 "NO_SYM" 1 "SYM_0" 2 "SYM_1" 4 "SYM_2" 8 "SYM_3" /end COMPU_VTAB
/begin COMPU_METHOD _CNV_S_11_EGCP_RANGE_339_CM "" TAB_VERB "%6.3" "-" COMPU_TAB_REF _CNV_S_11_EGCP_RANGE_339 /end COMPU_METHOD
/begin COMPU_VTAB _CNV_S_11_EGCP_RANGE_339 "" TAB_VERB 11 0 "NO_FAULT" 1 "SCG_LINE_RCD" 2 "SCG_LINE_VIP" 3 "SCG_LINE_VG" 4 "SCG_LINE_VN" 5 "SCG" 6 "SCBAT_LINE_RCD" 7 "SCBAT_LINE_VIP" 8 "SCBAT_LINE_VG" 9 "SCBAT_LINE_VN" 10 "SCBAT" /end COMPU_VTAB
/begin COMPU_METHOD _CNV_A_R_LINEAR_____340_CM "" RAT_FUNC "%6.3" "g" COEFFS 0 47.18142548596112 0. 0 0 1 /end COMPU_METHOD
/begin COMPU_METHOD _CNV_S_4_EGCP_RANGE_341_CM "" TAB_VERB "%6.3" "-" COMPU_TAB_REF _CNV_S_4_EGCP_RANGE_341 /end COMPU_METHOD
/begin COMPU_VTAB _CNV_S_4_EGCP_RANGE_341 "" TAB_VERB 4 0 "NO_SYM" 1 "TTIP_ERR" 2 "READY_ERR" 4 "TTIP_MES_ERR" /end COMPU_VTAB
/begin COMPU_METHOD _CNV_A_R_EGCP_LINEA_342_CM "" RAT_FUNC "%6.3" "K" COEFFS 0 1. 0. 0 0 1 /end COMPU_METHOD
/begin COMPU_METHOD _CNV_S_9_EGCP_RANGE_343_CM "" TAB_VERB "%6.3" "-" COMPU_TAB_REF _CNV_S_9_EGCP_RANGE_343 /end COMPU_METHOD
/begin COMPU_VTAB _CNV_S_9_EGCP_RANGE_343 "" TAB_VERB 9 0 "DIAG_OFF" 1 "DIAG_INIT" 2 "LS_READY" 3 "OBD1_DLY" 4 "OBD1_CHK" 5 "TEG_THD" 6 "POW_INT" 7 "DIAG_ACT" 8 "DIAG_END" /end COMPU_VTAB
/begin COMPU_METHOD _CNV_A_R_EGCP_LINEA_350_CM "" RAT_FUNC "%6.3" "-" COEFFS 0 1024.000007000107 2.240034154965542e-004 0 0 1 /end COMPU_METHOD
/begin COMPU_METHOD _CNV_S_4_EGCP_RANGE_351_CM "" TAB_VERB "%6.3" "-" COMPU_TAB_REF _CNV_S_4_EGCP_RANGE_351 /end COMPU_METHOD
/begin COMPU_VTAB _CNV_S_4_EGCP_RANGE_351 "" TAB_VERB 4 0 "PASSIVE" 1 "RICH CHECK" 2 "LEAN CHECK" 3 "CHECK FINISHED" /end COMPU_VTAB
/begin COMPU_METHOD _CNV_S_3_EGCP_RANGE_352_CM "" TAB_VERB "%6.3" "-" COMPU_TAB_REF _CNV_S_3_EGCP_RANGE_352 /end COMPU_METHOD
/begin COMPU_VTAB _CNV_S_3_EGCP_RANGE_352 "" TAB_VERB 3 0 "PASSIVE" 1 "ACTIVE" 2 "END" /end COMPU_VTAB
/begin COMPU_METHOD _CNV_A_R_EGCP_LINEA_355_CM "" RAT_FUNC "%6.3" "-" COEFFS 0 8. 0. 0 0 1 /end COMPU_METHOD
/begin RECORD_LAYOUT _REC_VAL_20_u1 FNC_VALUES 1 UBYTE COLUMN_DIR DIRECT /end RECORD_LAYOUT
/begin RECORD_LAYOUT _REC_VAL_20_u2 FNC_VALUES 1 UWORD COLUMN_DIR DIRECT /end RECORD_LAYOUT
/begin RECORD_LAYOUT _REC_VAL_20_s2 FNC_VALUES 1 SWORD COLUMN_DIR DIRECT /end RECORD_LAYOUT
/begin RECORD_LAYOUT _REC_AXS_20_u2 NO_AXIS_PTS_X 1 UWORD AXIS_PTS_X 2 UWORD INDEX_INCR DIRECT /end RECORD_LAYOUT
/begin RECORD_LAYOUT _REC_CUR_20_u2_u2 FNC_VALUES 1 UWORD COLUMN_DIR DIRECT /end RECORD_LAYOUT
/begin RECORD_LAYOUT _REC_CUR_20_u1_u2 FNC_VALUES 1 UBYTE COLUMN_DIR DIRECT /end RECORD_LAYOUT
/begin FUNCTION EGCP_Downst_ls_sig_mon "_Downstream_ls_sig_mon"
 /begin DEF_CHARACTERISTIC c_ctr_min_diag_scg_ls_down c_maf_kgh_min_diag_scg_ls_down c_vls_thd_diag_scp_ls_down c_r_it_max_diag_scg_ls_down c_r_it_min_diag_oc_ls_down c_t_cdn_diag_oc_ls_down c_t_dly_diag_oc_ls_down c_t_dly_diag_scg_ls_down c_vls_thd_diag_scg_ls_down c_vls_afl_thd_diag_oc_ls_down c_vls_afr_thd_diag_oc_ls_down c_teg_dyn_min_diag_oc_ls_down lc_diag_act_chk_inh /end DEF_CHARACTERISTIC
 /begin OUT_MEASUREMENT egcp[0].egcp_struct_sigdglsd1.t_act_pls_diag_scg_ls_down egcp[0].egcp_struct_sigdglsd1.t_act_pls_diag_oc_ls_down egcp[0].egcp_struct_sigdglsd1.t_cdn_diag_oc_ls_down egcp[0].egcp_struct_sigdglsd1.ctr_r_upd_diag_scg_ls_down egcp[0].egcp_struct_sigdglsd1.ctr_r_upd_diag_oc_ls_down egcp[0].egcp_struct_sigdglsd1.ctr_sym_diag_scg_ls_down egcp[0].egcp_struct_sigdglsd1.lv_err_el_ls_down egcp[0].egcp_struct_sigdglsd1.lv_diag_act_req_ls_down egcp[0].egcp_struct_sigdglsd1.lv_r_it_vld_diag_oc_ls_down egcp[0].egcp_struct_sigdglsd1.lv_t_cdn_diag_oc_ls_down egcp[1].egcp_struct_sigdglsd1.t_act_pls_diag_scg_ls_down egcp[1].egcp_struct_sigdglsd1.t_act_pls_diag_oc_ls_down egcp[1].egcp_struct_sigdglsd1.t_cdn_diag_oc_ls_down egcp[1].egcp_struct_sigdglsd1.ctr_r_upd_diag_scg_ls_down egcp[1].egcp_struct_sigdglsd1.ctr_r_upd_diag_oc_ls_down egcp[1].egcp_struct_sigdglsd1.ctr_sym_diag_scg_ls_down egcp[1].egcp_struct_sigdglsd1.lv_err_el_ls_down egcp[1].egcp_struct_sigdglsd1.lv_diag_act_req_ls_down egcp[1].egcp_struct_sigdglsd1.lv_r_it_vld_diag_oc_ls_down egcp[1].egcp_struct_sigdglsd1.lv_t_cdn_diag_oc_ls_down lv_err_scp_ls_down_1 lv_err_scg_ls_down_1 lv_err_oc_ls_down_1 lv_err_oc_ls_down_2 lv_err_scg_ls_down_2 lv_err_scp_ls_down_2 /end OUT_MEASUREMENT
/end FUNCTION
/begin FUNCTION EGCP_Downst_ls_heat_OBDI_diag "_Downstream_ls_heat_OBDI_diag"
 /begin DEF_CHARACTERISTIC c_lshpwm_max_diag_lsh_down c_lshpwm_min_diag_lsh_down c_teg_dyn_min_diag_lsh_down c_abc_inc_lsh_down c_abc_max_lsh_down /end DEF_CHARACTERISTIC
 /begin OUT_MEASUREMENT egcp[0].egcp_struct_outdglshd0.err_diag_lsh_down egcp[0].egcp_struct_outdglshd0.cdn_diag_lsh_down egcp[1].egcp_struct_outdglshd0.err_diag_lsh_down egcp[1].egcp_struct_outdglshd0.cdn_diag_lsh_down lv_err_lsh_down_1 lv_err_lsh_down_2 /end OUT_MEASUREMENT
/end FUNCTION
/begin FUNCTION EGCP_Signal_plausibily_mon "_Signal_plausibily_mon"
 /begin DEF_CHARACTERISTIC c_maf_int_max_diag_fl_ls_down c_maf_int_min_diag_puc_ls_down c_maf_int_min_diag_fl_ls_down c_vls_min_diag_puc_ls_down c_vls_max_diag_fl_ls_down c_maf_int_max_diag_puc_ls_down c_maf_int_puc_not_ls_down_diag c_fac_maf_int_ls_down_diag c_maf_kgh_min_ls_down_diag c_vls_up_min_maf_int_afr c_vls_up_max_maf_int_afr lc_maf_int_fl_cdn_afr /end DEF_CHARACTERISTIC
 /begin OUT_MEASUREMENT egcp[0].egcp_struct_pladglsd2.maf_int_puc_not_ls_down_diag egcp[0].egcp_struct_pladglsd2.maf_int_fl egcp[0].egcp_struct_pladglsd2.vls_down_puc_ok egcp[0].egcp_struct_pladglsd2.vls_down_puc_err egcp[0].egcp_struct_pladglsd2.vls_down_puc_save egcp[0].egcp_struct_pladglsd2.lv_err_plaus_ls_down egcp[0].egcp_struct_pladglsd2.lv_diag_cdn_plaus_ls_down egcp[0].egcp_struct_pladglsd2.lv_diag_puc_chg_ls_down egcp[1].egcp_struct_pladglsd2.maf_int_puc_not_ls_down_diag egcp[1].egcp_struct_pladglsd2.maf_int_fl egcp[1].egcp_struct_pladglsd2.vls_down_puc_ok egcp[1].egcp_struct_pladglsd2.vls_down_puc_err egcp[1].egcp_struct_pladglsd2.vls_down_puc_save egcp[1].egcp_struct_pladglsd2.lv_err_plaus_ls_down egcp[1].egcp_struct_pladglsd2.lv_diag_cdn_plaus_ls_down egcp[1].egcp_struct_pladglsd2.lv_diag_puc_chg_ls_down lv_err_puc_ls_down_1 lv_err_fl_ls_down_1 lv_err_fl_ls_down_2 lv_err_puc_ls_down_2 /end OUT_MEASUREMENT
/end FUNCTION
/begin FUNCTION EGCP_HW_based_DIAG_ATIC42 "_HW_based_DIAG_ATIC42"
 /begin DEF_CHARACTERISTIC c_ctr_iplsl_sym_diag_lsl_up c_lamb_sp_afr_iplsl_diag_lsl_up c_lamb_sp_afl_iplsl_diag_lsl_up c_t_dly_diag_el_lsl_up lc_iplsl_sym_diag_lsl_up /end DEF_CHARACTERISTIC
 /begin OUT_MEASUREMENT egcp[0].egcp_struct_sigdglsla0.t_dly_diag_el_lsl_up egcp[0].egcp_struct_sigdglsla0.ctr_iplsl_sym_diag_lsl_up egcp[0].egcp_struct_sigdglsla0.iplsl_sym_diag_lsl_up egcp[0].egcp_struct_sigdglsla0.state_err_el_lsl_up egcp[0].egcp_struct_sigdglsla0.lv_lsl_up_spi_com_inh egcp[0].egcp_struct_sigdglsla0.lv_diag_iplsl_sym_lsl_up egcp[0].egcp_struct_sigdglsla0.lv_diag_iplsl_cdn_lsl_up egcp[0].egcp_struct_sigdglsla0.lv_diag_act_el_lsl_up egcp[1].egcp_struct_sigdglsla0.t_dly_diag_el_lsl_up egcp[1].egcp_struct_sigdglsla0.ctr_iplsl_sym_diag_lsl_up egcp[1].egcp_struct_sigdglsla0.iplsl_sym_diag_lsl_up egcp[1].egcp_struct_sigdglsla0.state_err_el_lsl_up egcp[1].egcp_struct_sigdglsla0.lv_lsl_up_spi_com_inh egcp[1].egcp_struct_sigdglsla0.lv_diag_iplsl_sym_lsl_up egcp[1].egcp_struct_sigdglsla0.lv_diag_iplsl_cdn_lsl_up egcp[1].egcp_struct_sigdglsla0.lv_diag_act_el_lsl_up lv_err_el_lsl_up_1 lv_err_el_lsl_up_2 /end OUT_MEASUREMENT
/end FUNCTION
/begin FUNCTION EGCP_WRAF_sensor_ctl_DIAG "_WRAF_sensor_controller_DIAG"
 /begin DEF_CHARACTERISTIC c_ctr_max_spi_com_lsl_up[0] c_ctr_max_spi_com_lsl_up[1] c_t_rst_max_diag_lsl_up_if[0] c_t_rst_max_diag_lsl_up_if[1] c_t_end_diag_lsl_up_if[0] c_t_end_diag_lsl_up_if[1] /end DEF_CHARACTERISTIC
 /begin OUT_MEASUREMENT egcp[0].egcp_struct_pladgspi0.ctr_err_save_diag_lsl_up_if egcp[0].egcp_struct_pladgspi0.ctr_delta_lsl_up_if egcp[1].egcp_struct_pladgspi0.ctr_err_save_diag_lsl_up_if egcp[1].egcp_struct_pladgspi0.ctr_delta_lsl_up_if lv_err_lsl_up_if_1 lv_err_lsl_up_if_2 /end OUT_MEASUREMENT
/end FUNCTION
/begin FUNCTION EGCP_A_I_WRAF_sens_electric_DIAG "_A_I_WRAF_sens_electric_DIAG" /begin DEF_CHARACTERISTIC c_abc_inc_diag_el_lsl_up c_abc_max_diag_el_lsl_up /end DEF_CHARACTERISTIC
 /begin OUT_MEASUREMENT egcp[0].egcp_struct_sigdglslai0.lv_inh_diag_el_lsl_up egcp[0].egcp_struct_sigdglslai0.lv_iplsl_diag_inh_lsl_up egcp[1].egcp_struct_sigdglslai0.lv_inh_diag_el_lsl_up egcp[1].egcp_struct_sigdglslai0.lv_iplsl_diag_inh_lsl_up /end OUT_MEASUREMENT
/end FUNCTION
/begin FUNCTION EGCP_A_I_WRAF_sens_ctl_DIAG "_A_I_WRAF_sens_controller_DIAG"
 /begin OUT_MEASUREMENT egcp[0].egcp_struct_pladgspii0.lv_inh_diag_lsl_up_if egcp[1].egcp_struct_pladgspii0.lv_inh_diag_lsl_up_if /end OUT_MEASUREMENT
/end FUNCTION
/begin FUNCTION EGCP_A_I_upst_ls_heat_OBDI_DIAG "_A_I_upst_ls_heat_OBDI_DIAG"
 /begin OUT_MEASUREMENT egcp[0].egcp_struct_outdglshi0.lv_inh_diag_lsh_up egcp[1].egcp_struct_outdglshi0.lv_inh_diag_lsh_up /end OUT_MEASUREMENT
/end FUNCTION
/begin FUNCTION EGCP_downst_ls_heat_OBDI_DIAG_AI "_downst_ls_heat_OBDI_DIAG_AI"
 /begin OUT_MEASUREMENT egcp[0].egcp_struct_outdglshdi0.lv_inh_diag_lsh_down egcp[1].egcp_struct_outdglshdi0.lv_inh_diag_lsh_down /end OUT_MEASUREMENT
/end FUNCTION
/begin FUNCTION EGCP_A_I_downst_ls_probe_DIAG "_A_I_downst_ls_probe_DIAG"
 /begin DEF_CHARACTERISTIC c_abc_max_scg_ls_down c_abc_inc_scg_ls_down c_abc_inc_oc_ls_down c_abc_max_oc_ls_down c_abc_max_scp_ls_down c_abc_inc_scp_ls_down c_abc_inc_puc_ls_down c_abc_inc_fl_ls_down c_abc_max_puc_ls_down c_abc_max_fl_ls_down /end DEF_CHARACTERISTIC
 /begin OUT_MEASUREMENT egcp[0].egcp_struct_sigdglsdi1.lv_inh_diag_oc_ls_down egcp[0].egcp_struct_sigdglsdi1.lv_inh_diag_puc_ls_down egcp[0].egcp_struct_sigdglsdi1.lv_inh_diag_fl_ls_down egcp[0].egcp_struct_sigdglsdi1.lv_inh_diag_scg_ls_down egcp[0].egcp_struct_sigdglsdi1.lv_inh_diag_scp_ls_down egcp[1].egcp_struct_sigdglsdi1.lv_inh_diag_oc_ls_down egcp[1].egcp_struct_sigdglsdi1.lv_inh_diag_puc_ls_down egcp[1].egcp_struct_sigdglsdi1.lv_inh_diag_fl_ls_down egcp[1].egcp_struct_sigdglsdi1.lv_inh_diag_scg_ls_down egcp[1].egcp_struct_sigdglsdi1.lv_inh_diag_scp_ls_down /end OUT_MEASUREMENT
/end FUNCTION
/begin FUNCTION EGCP_O2_sens_lin_OC_diag "O2_sens_lin_OC_diag"
 /begin DEF_CHARACTERISTIC c_vls_up_diag_min_oc_lsl_up c_t_vls_up_min_diag_oc_lsl_up lc_diag_puc_end_man_lsl_up c_t_wait_sym_obd_2_lsh_up c_vls_up_min_oc_afs_lsl_up c_vls_up_max_oc_afs_lsl_up c_t_diag_oc_rst_osc_di c_t_diag_oc_lsl_up c_lamb_sp_step_oc_chk_lsl_up c_lamb_sp_oc_chk_lsl_up c_lamb_sp_min_diag_oc_lsl_up c_lamb_sp_max_diag_oc_lsl_up /end DEF_CHARACTERISTIC
 /begin OUT_MEASUREMENT egcp[0].egcp_struct_sigdglsl4.t_vls_up_min_diag_oc_lsl_up egcp[0].egcp_struct_sigdglsl4.t_wait_sym_obd_2_lsh_up egcp[0].egcp_struct_sigdglsl4.t_vls_up_afs_diag_oc_lsl_up egcp[0].egcp_struct_sigdglsl4.t_diag_oc_rst_osc_di egcp[0].egcp_struct_sigdglsl4.t_diag_oc_rst_lamb_sp_req egcp[0].egcp_struct_sigdglsl4.t_diag_oc_lsl_up egcp[0].egcp_struct_sigdglsl4.lamb_sp_diag_oc_lsl_up egcp[0].egcp_struct_sigdglsl4.lamb_sp_delta_oc_lsl_up egcp[0].egcp_struct_sigdglsl4.state_diag_oc_lsl_up egcp[0].egcp_struct_sigdglsl4.lv_diag_oc_if_osc_di_lsl_up egcp[0].egcp_struct_sigdglsl4.lv_vls_up_min_diag_oc_lsl_up egcp[0].egcp_struct_sigdglsl4.lv_vls_up_afs_diag_oc_lsl_up egcp[1].egcp_struct_sigdglsl4.t_vls_up_min_diag_oc_lsl_up egcp[1].egcp_struct_sigdglsl4.t_wait_sym_obd_2_lsh_up egcp[1].egcp_struct_sigdglsl4.t_vls_up_afs_diag_oc_lsl_up egcp[1].egcp_struct_sigdglsl4.t_diag_oc_rst_osc_di egcp[1].egcp_struct_sigdglsl4.t_diag_oc_rst_lamb_sp_req egcp[1].egcp_struct_sigdglsl4.t_diag_oc_lsl_up egcp[1].egcp_struct_sigdglsl4.lamb_sp_diag_oc_lsl_up egcp[1].egcp_struct_sigdglsl4.lamb_sp_delta_oc_lsl_up egcp[1].egcp_struct_sigdglsl4.state_diag_oc_lsl_up egcp[1].egcp_struct_sigdglsl4.lv_diag_oc_if_osc_di_lsl_up egcp[1].egcp_struct_sigdglsl4.lv_vls_up_min_diag_oc_lsl_up egcp[1].egcp_struct_sigdglsl4.lv_vls_up_afs_diag_oc_lsl_up lv_err_oc_lsl_up_1 lv_err_oc_lsl_up_2 /end OUT_MEASUREMENT
/end FUNCTION
/begin FUNCTION EGCP_O2_sens_lin_OC_diag__AI "O2_sens_lin_OC_diag__AI"
 /begin OUT_MEASUREMENT egcp[0].egcp_struct_sigdglsli4.lv_inh_diag_oc_lsl_up egcp[1].egcp_struct_sigdglsli4.lv_inh_diag_oc_lsl_up /end OUT_MEASUREMENT
/end FUNCTION
/begin FUNCTION C_B_EGCP "C_B_EGCP"
 /begin SUB_FUNCTION EGCP_Dynamic_fuel_trim_diag EGCP_Dynamic_fuel_trim_diag_inci EGCP_O2_sensor_up_heater_diag EGCP_O2_sensor_down_heater_diag EGCP_O2_sensor_down_heat_diag_ai EGCP_O2_sensor_downstream_diag EGCP_O2_sensor_diag_management EGCP_O2_sensor_swap_sig_diag_ai EGCP_O2_sensor_swap_sig_diag EGCP_O2_sensor_probe_diag_plaus EGCP_O2_sensor_down_diag_inci EGCP_O2_sensor_up_heater_diag_ai EGCP_O2_sensor_diag_manag_inci EGCP_O2_sensor_probe_diag_inci EGCP_Down_O2_sensor_resist_inci EGCP_Linear_O2_sensor_hea_diag EGCP_Linear_O2_sens_hea_diag_AI EGCP_O2_sensor_plaus_diag EGCP_O2_sensor_dynamic_diag EGCP_O2_sensor_not_mount_diag EGCP_O2_sensor_PUC_plaus_diag EGCP_O2_sensor_activity_diag EGCP_WRAF_Controller_ofs_dg EGCP_WRAF_Controller_ofs_dg__AI EGCP_O2_sensor_plaus_diag_AI EGCP_O2_sensor_dynamic_diag_AI EGCP_O2_sensor_not_mount_diag_AI EGCP_O2_sensor_PUC_plaus_diag_AI EGCP_O2_sensor_activity_diag_AI EGCP_O2_down_diag_NOx_rgn EGCP_O2_down_diag_NOx_rgn_AI EGCP_O2_sensor_char_line_diag EGCP_O2_sensor_char_line_diag_AI EGCP_O2_sensor_diag_NOx_rgn EGCP_O2_sensor_diag_NOx_rgn_AI EGCP_O2_sensor_down_osci_diag /end SUB_FUNCTION
/end FUNCTION
/begin FUNCTION EGCP_Dynamic_fuel_trim_diag "Dynamic_fuel_trim_diag"
 /begin DEF_CHARACTERISTIC c_lamb_delta_i_max_diag c_lamb_delta_i_min_diag c_maf_int_vls_dif_dly_min[0] c_maf_int_vls_dif_dly_min[1] c_maf_int_vls_dif_dly_max[0] c_maf_int_vls_dif_dly_max[1] c_n_ldc_vls_dif_dly c_maf_ldc_vls_dif_dly c_lam_mv_ldc_vls_dif_dly c_n_crlc_ldc_vls_dif_dly c_maf_crlc_ldc_vls_dif_dly c_lam_mv_crlc_ldc_vls_dif_dly c_maf_int_min_vls_dif_dly_ldc[0] c_maf_int_min_vls_dif_dly_ldc[1] c_maf_int_rst_vls_down_dif_diag[0] c_maf_int_rst_vls_down_dif_diag[1] c_t_sum_max_max_delta_i_lam[0] c_t_sum_max_max_delta_i_lam[1] c_t_sum_min_max_delta_i_lam[0] c_t_sum_min_max_delta_i_lam[1] c_t_sum_rst_max_delta_i_lam[0] c_t_sum_rst_max_delta_i_lam[1] c_t_sum_max_err_delta_i_lam[0] c_t_sum_max_err_delta_i_lam[1] c_t_sum_ready_delta_i_lam[0] c_t_sum_ready_delta_i_lam[1] c_cat_diag_max_delta_i_lam[0] c_cat_diag_max_delta_i_lam[1] c_vls_down_max_diag_lam_adj[0] c_vls_down_max_diag_lam_adj[1] c_vls_down_min_diag_lam_adj[0] c_vls_down_min_diag_lam_adj[1] /end DEF_CHARACTERISTIC
 /begin OUT_MEASUREMENT egcp[0].egcp_struct_pladgft0.lam_mmv_vls_dif_dly_ldc egcp[0].egcp_struct_pladgft0.maf_int_vls_dif_dly_min egcp[0].egcp_struct_pladgft0.maf_int_vls_dif_dly_max egcp[0].egcp_struct_pladgft0.maf_int_vls_dif_dly_ldc egcp[0].egcp_struct_pladgft0.maf_int_rst_vls_down_dif_diag egcp[0].egcp_struct_pladgft0.t_sum_max_delta_i_lam egcp[0].egcp_struct_pladgft0.t_sum_min_delta_i_lam egcp[0].egcp_struct_pladgft0.t_sum_end_diag_win_delta_i_lam egcp[0].egcp_struct_pladgft0.t_sum_end_ready_delta_i_lam egcp[0].egcp_struct_pladgft0.t_sum_rst_delta_i_lam egcp[0].egcp_struct_pladgft0.lamb_delta_i_save_diag egcp[0].egcp_struct_pladgft0.err_sym_lam_adj egcp[0].egcp_struct_pladgft0.lv_vls_dif_dly_ldc egcp[0].egcp_struct_pladgft0.lv_vls_dif_dly_ldc_lam_mv egcp[0].egcp_struct_pladgft0.lv_end_diag_lam_adj egcp[0].egcp_struct_pladgft0.lv_err_lam_adj egcp[0].egcp_struct_pladgft0.lv_end_diag_win_delta_i_lam egcp[0].egcp_struct_pladgft0.lv_det_sym_eve_delta_i_lam egcp[1].egcp_struct_pladgft0.lam_mmv_vls_dif_dly_ldc egcp[1].egcp_struct_pladgft0.maf_int_vls_dif_dly_min egcp[1].egcp_struct_pladgft0.maf_int_vls_dif_dly_max egcp[1].egcp_struct_pladgft0.maf_int_vls_dif_dly_ldc egcp[1].egcp_struct_pladgft0.maf_int_rst_vls_down_dif_diag egcp[1].egcp_struct_pladgft0.t_sum_max_delta_i_lam egcp[1].egcp_struct_pladgft0.t_sum_min_delta_i_lam egcp[1].egcp_struct_pladgft0.t_sum_end_diag_win_delta_i_lam egcp[1].egcp_struct_pladgft0.t_sum_end_ready_delta_i_lam egcp[1].egcp_struct_pladgft0.t_sum_rst_delta_i_lam egcp[1].egcp_struct_pladgft0.lamb_delta_i_save_diag egcp[1].egcp_struct_pladgft0.err_sym_lam_adj egcp[1].egcp_struct_pladgft0.lv_vls_dif_dly_ldc egcp[1].egcp_struct_pladgft0.lv_vls_dif_dly_ldc_lam_mv egcp[1].egcp_struct_pladgft0.lv_end_diag_lam_adj egcp[1].egcp_struct_pladgft0.lv_err_lam_adj egcp[1].egcp_struct_pladgft0.lv_end_diag_win_delta_i_lam egcp[1].egcp_struct_pladgft0.lv_det_sym_eve_delta_i_lam lv_vls_dif_dly_ldc_n lv_vls_dif_dly_ldc_maf n_mmv_vls_dif_dly_ldc maf_mmv_vls_dif_dly_ldc lv_err_delta_i_lam_2 lv_err_delta_i_lam_1 lv_err_vls_down_dif_1 lv_err_vls_down_dif_2 /end OUT_MEASUREMENT
/end FUNCTION
/begin FUNCTION EGCP_Dynamic_fuel_trim_diag_inci "Dynamic_fuel_trim_diag_inci"
 /begin DEF_CHARACTERISTIC lc_inh_diag_dly_lam[0] lc_inh_diag_dly_lam[1] lc_diag_chg_ls_down_inh /end DEF_CHARACTERISTIC
 /begin OUT_MEASUREMENT egcp[0].egcp_struct_pladgfti0.lv_inh_diag_dly_lam egcp[0].egcp_struct_pladgfti0.lv_inh_diag_rbm_dly_lam egcp[1].egcp_struct_pladgfti0.lv_inh_diag_dly_lam egcp[1].egcp_struct_pladgfti0.lv_inh_diag_rbm_dly_lam lv_inh_diag_chg_ls_down /end OUT_MEASUREMENT
/end FUNCTION
/begin FUNCTION EGCP_O2_sensor_up_heater_diag "O2_sensor_up_heater_diag"
 /begin DEF_CHARACTERISTIC c_lshpwm_min_lsh_up c_ttip_min_obd_lsh_up c_ttip_max_obd_lsh_up c_tcc_thd_err_obd_lsh_up lc_obd_rep_lsh_up ip_t_dly_ls_up_ready_obd_lsh_up lc_obd_lsh_up c_t_dly_pow_ctl_obd_lsh_up c_t_dly_ttip_mes_obd_lsh_up c_t_dly_ttip_res_obd_lsh_up c_teg_dyn_min_obd_lsh_up c_tcc_err_inc_obd_lsh_up c_tcc_err_inc_obd_lsh_up_fast /end DEF_CHARACTERISTIC
 /begin OUT_MEASUREMENT egcp[0].egcp_struct_fctdglslh0.ttip_mes_ls_up_obd_lsh_up egcp[0].egcp_struct_fctdglslh0.tcc_end_diag_obd_lsh_up egcp[0].egcp_struct_fctdglslh0.tcc_err_obd_lsh_up egcp[0].egcp_struct_fctdglslh0.state_sym_obd_lsl_lsh_up egcp[0].egcp_struct_fctdglslh0.lv_lamb_pls_req_diag_lsh_up egcp[0].egcp_struct_fctdglslh0.lv_diag_obd_cdn_lsh_up egcp[0].egcp_struct_fctdglslh0.lv_diag_obd_sym_lsh_up egcp[0].egcp_struct_fctdglslh0.lv_diag_obd_end_lsh_up egcp[1].egcp_struct_fctdglslh0.ttip_mes_ls_up_obd_lsh_up egcp[1].egcp_struct_fctdglslh0.tcc_end_diag_obd_lsh_up egcp[1].egcp_struct_fctdglslh0.tcc_err_obd_lsh_up egcp[1].egcp_struct_fctdglslh0.state_sym_obd_lsl_lsh_up egcp[1].egcp_struct_fctdglslh0.lv_lamb_pls_req_diag_lsh_up egcp[1].egcp_struct_fctdglslh0.lv_diag_obd_cdn_lsh_up egcp[1].egcp_struct_fctdglslh0.lv_diag_obd_sym_lsh_up egcp[1].egcp_struct_fctdglslh0.lv_diag_obd_end_lsh_up /end OUT_MEASUREMENT
/end FUNCTION
/begin FUNCTION EGCP_O2_sensor_down_heater_diag "O2_sensor_down_heater_diag"
 /begin DEF_CHARACTERISTIC c_lshpwm_min_lsh_down c_lshpwm_max_lsh_down c_temp_sp_obd_lsh_down ldp_r_it_ls_down_new_lsh_down ip_fac_maf_obd_lsh_down ip_r_it_thd_obd_lsh_down c_teg_dyn_max_obd_lsh_down c_t_dly_obd_lsh_down c_t_dly_obd_lsh_down_eol c_pow_int_min_obd_lsh_down c_pow_int_min_obd_lsh_down_eol c_tcc_thd_err_obd_lsh_down c_tcc_thd_err_obd_lsh_down_eol c_tcc_thd_obd_lsh_down c_tcc_thd_obd_lsh_down_eol lc_diag_eol_end_lsh_down[0] lc_diag_eol_end_lsh_down[1] /end DEF_CHARACTERISTIC
 /begin OUT_MEASUREMENT lv_err_obd_lsh_down_2 lv_err_obd_lsh_down_1 egcp[0].egcp_struct_fctdglshd1.r_it_thd_obd_lsh_down egcp[0].egcp_struct_fctdglshd1.r_it_obd_lsh_down egcp[0].egcp_struct_fctdglshd1.r_it_l_mes_obd_lsh_down egcp[0].egcp_struct_fctdglshd1.r_it_l_ref_obd_lsh_down egcp[0].egcp_struct_fctdglshd1.r_it_h_mes_obd_lsh_down egcp[0].egcp_struct_fctdglshd1.r_it_h_ref_obd_lsh_down egcp[0].egcp_struct_fctdglshd1.temp_dif_obd_lsh_down egcp[0].egcp_struct_fctdglshd1.pow_int_obd_lsh_down egcp[0].egcp_struct_fctdglshd1.tcc_vld_obd_lsh_down egcp[0].egcp_struct_fctdglshd1.tcc_err_obd_lsh_down egcp[0].egcp_struct_fctdglshd1.ctr_cycnr_r_it_obd_ls_down egcp[0].egcp_struct_fctdglshd1.state_obd_lsh_down egcp[1].egcp_struct_fctdglshd1.r_it_thd_obd_lsh_down egcp[1].egcp_struct_fctdglshd1.r_it_obd_lsh_down egcp[1].egcp_struct_fctdglshd1.r_it_l_mes_obd_lsh_down egcp[1].egcp_struct_fctdglshd1.r_it_l_ref_obd_lsh_down egcp[1].egcp_struct_fctdglshd1.r_it_h_mes_obd_lsh_down egcp[1].egcp_struct_fctdglshd1.r_it_h_ref_obd_lsh_down egcp[1].egcp_struct_fctdglshd1.temp_dif_obd_lsh_down egcp[1].egcp_struct_fctdglshd1.pow_int_obd_lsh_down egcp[1].egcp_struct_fctdglshd1.tcc_vld_obd_lsh_down egcp[1].egcp_struct_fctdglshd1.tcc_err_obd_lsh_down egcp[1].egcp_struct_fctdglshd1.ctr_cycnr_r_it_obd_ls_down egcp[1].egcp_struct_fctdglshd1.state_obd_lsh_down /end OUT_MEASUREMENT
/end FUNCTION
/begin FUNCTION EGCP_O2_sensor_down_heat_diag_ai "O2_sensor_down_heater_diag" /begin DEF_CHARACTERISTIC c_tco_min_obd2_lsh_down /end DEF_CHARACTERISTIC
 /begin OUT_MEASUREMENT egcp[0].egcp_struct_fctdglshdi1.lv_inh_diag_obd_lsh_down egcp[0].egcp_struct_fctdglshdi1.lv_inh_diag_rbm_obd_lsh_down egcp[0].egcp_struct_fctdglshdi1.lv_diag_eol_req_obd_lsh_down egcp[0].egcp_struct_fctdglshdi1.state_rbm_obd_lsh_down egcp[1].egcp_struct_fctdglshdi1.lv_inh_diag_obd_lsh_down egcp[1].egcp_struct_fctdglshdi1.lv_inh_diag_rbm_obd_lsh_down egcp[1].egcp_struct_fctdglshdi1.lv_diag_eol_req_obd_lsh_down egcp[1].egcp_struct_fctdglshdi1.state_rbm_obd_lsh_down /end OUT_MEASUREMENT
/end FUNCTION
/begin FUNCTION EGCP_O2_sensor_downstream_diag "O2_sensor_down_heater_diag"
 /begin DEF_CHARACTERISTIC c_tco_min_diag_mpl_ls_down c_vs_min_diag_mpl_ls_down c_vs_max_diag_mpl_ls_down c_temp_cat_min_diag_mpl_ls_down ldp_maf_kgh_ip_fac_ls_down ip_fac_cycnr_max_ls_down_act c_maf_int_puc_diag_pue_ls_down c_maf_int_diag_pue_ls_down c_ctr_swt_diag_ls_down c_ctr_sym_inc_diag_pue_ls_down c_ctr_sym_max_diag_pue_ls_down c_vls_dif_min_diag_pue_ls_down c_ctr_swt_ls_down c_maf_puc_max_diag_swt_ls_down c_maf_puc_min_diag_swt_ls_down c_fac_vls_max_diag_swt_ls_down c_vls_hys_diag_swt_ls_down c_vls_puc_min_diag_swt_ls_down c_fac_vls_min_diag_swt_ls_down c_ctr_end_diag_pue_ls_down /end DEF_CHARACTERISTIC
 /begin OUT_MEASUREMENT egcp[0].egcp_struct_sigdglsd2.vls_down_tran_puc egcp[0].egcp_struct_sigdglsd2.vls_down_pue egcp[0].egcp_struct_sigdglsd2.vls_dif_diag_pue_ls_down egcp[0].egcp_struct_sigdglsd2.vls_dif_save_diag_ls_down egcp[0].egcp_struct_sigdglsd2.vls_dif_min_diag_pue_ls_down egcp[0].egcp_struct_sigdglsd2.vls_dif_max_diag_pue_ls_down egcp[0].egcp_struct_sigdglsd2.ctr_end_diag_pue_ls_down egcp[0].egcp_struct_sigdglsd2.ctr_quo_sum_swt_ls_down egcp[0].egcp_struct_sigdglsd2.ctr_quo_swt_ls_down egcp[0].egcp_struct_sigdglsd2.ctr_quo_swt_rbm_ls_down egcp[0].egcp_struct_sigdglsd2.ctr_swt_act_ls_down egcp[0].egcp_struct_sigdglsd2.ctr_swt_act_rbm_ls_down egcp[0].egcp_struct_sigdglsd2.ctr_swt_ls_down egcp[0].egcp_struct_sigdglsd2.ctr_cycnr_swt_ls_down egcp[0].egcp_struct_sigdglsd2.ctr_save_swt_ls_down egcp[0].egcp_struct_sigdglsd2.ctr_sym_diag_pue_ls_down egcp[0].egcp_struct_sigdglsd2.lv_diag_pue_vld_ls_down egcp[0].egcp_struct_sigdglsd2.lv_diag_mpl_cdn_ls_down egcp[0].egcp_struct_sigdglsd2.lv_swt_diag_vld_ls_down egcp[0].egcp_struct_sigdglsd2.lv_maf_int_puc_not_act_rst egcp[1].egcp_struct_sigdglsd2.vls_down_tran_puc egcp[1].egcp_struct_sigdglsd2.vls_down_pue egcp[1].egcp_struct_sigdglsd2.vls_dif_diag_pue_ls_down egcp[1].egcp_struct_sigdglsd2.vls_dif_save_diag_ls_down egcp[1].egcp_struct_sigdglsd2.vls_dif_min_diag_pue_ls_down egcp[1].egcp_struct_sigdglsd2.vls_dif_max_diag_pue_ls_down egcp[1].egcp_struct_sigdglsd2.ctr_end_diag_pue_ls_down egcp[1].egcp_struct_sigdglsd2.ctr_quo_sum_swt_ls_down egcp[1].egcp_struct_sigdglsd2.ctr_quo_swt_ls_down egcp[1].egcp_struct_sigdglsd2.ctr_quo_swt_rbm_ls_down egcp[1].egcp_struct_sigdglsd2.ctr_swt_act_ls_down egcp[1].egcp_struct_sigdglsd2.ctr_swt_act_rbm_ls_down egcp[1].egcp_struct_sigdglsd2.ctr_swt_ls_down egcp[1].egcp_struct_sigdglsd2.ctr_cycnr_swt_ls_down egcp[1].egcp_struct_sigdglsd2.ctr_save_swt_ls_down egcp[1].egcp_struct_sigdglsd2.ctr_sym_diag_pue_ls_down egcp[1].egcp_struct_sigdglsd2.lv_diag_pue_vld_ls_down egcp[1].egcp_struct_sigdglsd2.lv_diag_mpl_cdn_ls_down egcp[1].egcp_struct_sigdglsd2.lv_swt_diag_vld_ls_down egcp[1].egcp_struct_sigdglsd2.lv_maf_int_puc_not_act_rst maf_kgh_min_puc lv_err_pue_ls_down_1 lv_err_pue_ls_down_2 lv_err_swt_ls_down_1 lv_err_swt_ls_down_2 /end OUT_MEASUREMENT
/end FUNCTION
/begin FUNCTION EGCP_O2_sensor_diag_management "O2_sensor_diag_management"
 /begin DEF_CHARACTERISTIC lc_err_dyn_vld_ls_up lc_ls_up_obd_1_man_deac[0] lc_ls_up_obd_1_man_deac[1] lc_ls_up_obd_2_man_deac[0] lc_ls_up_obd_2_man_deac[1] lc_ls_up_err[0] lc_ls_up_err[1] c_nr_end_diag_lsl_up[0] c_nr_end_diag_lsl_up[1] c_nr_end_diag_ls_down[0] c_nr_end_diag_ls_down[1] lc_ls_up_diag_act[0] lc_ls_up_diag_act[1] lc_ls_down_diag_act[0] lc_ls_down_diag_act[1] lc_ls_down_obd_1_man_deac[0] lc_ls_down_obd_1_man_deac[1] lc_ls_down_obd_2_man_deac[0] lc_ls_down_obd_2_man_deac[1] lc_ls_down_err[0] lc_ls_down_err[1] lc_err_chg_ls_up lc_err_chg_ls_down /end DEF_CHARACTERISTIC
 /begin OUT_MEASUREMENT lv_err_obd_vld_lsh_up_1 lv_err_obd_vld_lsh_up_2 lv_err_ttip_mes_lsh_up_1 lv_err_ttip_mes_lsh_up_2 egcp[0].egcp_struct_sigdglsl1.lv_err_ls_down egcp[0].egcp_struct_sigdglsl1.lv_err_ls_up egcp[0].egcp_struct_sigdglsl1.lv_ls_up_diag_end egcp[0].egcp_struct_sigdglsl1.lv_ls_up_obd_1_man_deac egcp[0].egcp_struct_sigdglsl1.lv_ls_up_obd_2_man_deac egcp[0].egcp_struct_sigdglsl1.lv_ls_down_diag_end egcp[0].egcp_struct_sigdglsl1.lv_ls_down_obd_1_man_deac egcp[0].egcp_struct_sigdglsl1.lv_ls_down_obd_2_man_deac egcp[1].egcp_struct_sigdglsl1.lv_err_ls_down egcp[1].egcp_struct_sigdglsl1.lv_err_ls_up egcp[1].egcp_struct_sigdglsl1.lv_ls_up_diag_end egcp[1].egcp_struct_sigdglsl1.lv_ls_up_obd_1_man_deac egcp[1].egcp_struct_sigdglsl1.lv_ls_up_obd_2_man_deac egcp[1].egcp_struct_sigdglsl1.lv_ls_down_diag_end egcp[1].egcp_struct_sigdglsl1.lv_ls_down_obd_1_man_deac egcp[1].egcp_struct_sigdglsl1.lv_ls_down_obd_2_man_deac /end OUT_MEASUREMENT
/end FUNCTION
/begin FUNCTION EGCP_O2_sensor_swap_sig_diag_ai "O2_sensor_swap_sig_diag_ai"
 /begin OUT_MEASUREMENT egcp[0].egcp_struct_pladglsi2.lv_lam_stop_sho_per_cdn egcp[1].egcp_struct_pladglsi2.lv_lam_stop_sho_per_cdn lv_inh_diag_chg_ls_up /end OUT_MEASUREMENT
/end FUNCTION
/begin FUNCTION EGCP_O2_sensor_swap_sig_diag "O2_sensor_swap_sig_diag_ai"
 /begin DEF_CHARACTERISTIC c_maf_int_diag_chg_ls_up c_fac_lam_lim_max_chg_ls_up c_fac_lam_lim_min_chg_ls_up c_fac_pos_chg_ls_up c_fac_neg_chg_ls_up c_maf_int_end_diag_chg_ls_up /end DEF_CHARACTERISTIC
 /begin OUT_MEASUREMENT maf_int_sym_diag_chg_ls_up maf_int_end_diag_chg_ls_up lv_err_chg_ls_up /end OUT_MEASUREMENT
/end FUNCTION
/begin FUNCTION EGCP_O2_sensor_probe_diag_plaus "O2_sensor_probe_diag_plaus"
 /begin DEF_CHARACTERISTIC c_maf_int_diag_ls_up_down[0] c_maf_int_diag_ls_up_down[1] c_t_max_diag_afr_ls_up_down c_t_max_diag_afl_ls_up_down c_t_diag_eol_ls_up_down c_maf_int_eol_diag_ls_up_down[0] c_maf_int_eol_diag_ls_up_down[1] c_lamb_afl_min_diag_ls_up_down c_lamb_afl_max_diag_ls_up_down c_lamb_afr_min_diag_ls_up_down c_lamb_afr_max_diag_ls_up_down c_vls_afr_thd_diag_act_ls_down[0] c_vls_afr_thd_diag_act_ls_down[1] c_vls_afl_thd_diag_act_ls_down[0] c_vls_afl_thd_diag_act_ls_down[1] c_lamb_sp_afr_diag_ls_up_down c_lamb_sp_step_diag_ls_up_down lc_diag_auth_chk_ls_up_down c_abc_inc_chk_lsl_up c_lamb_afr_thd_diag_act_lsl_up c_lamb_afl_thd_diag_act_lsl_up c_ctr_sum_rst_afr_chk_lsl_up c_ctr_sum_rst_afl_chk_lsl_up c_abc_max_chk_lsl_up c_t_max_chk_ls_down c_t_end_diag_act_ls_down[0] c_t_end_diag_act_ls_down[1] c_lamb_sp_afl_diag_ls_up_down /end DEF_CHARACTERISTIC
 /begin OUT_MEASUREMENT egcp[0].egcp_struct_pladglsl1.lamb_sp_delta_ls_up_down egcp[0].egcp_struct_pladglsl1.maf_int_diag_ls_up_down egcp[0].egcp_struct_pladglsl1.lamb_sp_beg_diag_ls_up_down egcp[0].egcp_struct_pladglsl1.lamb_sp_diag_opl_ls_up_down egcp[0].egcp_struct_pladglsl1.t_diag_act_afr_ls_up_down egcp[0].egcp_struct_pladglsl1.t_diag_act_afl_ls_up_down egcp[0].egcp_struct_pladglsl1.ctr_sum_rst_afr_chk_lsl_up egcp[0].egcp_struct_pladglsl1.ctr_sum_rst_afl_chk_lsl_up egcp[0].egcp_struct_pladglsl1.ctr_afr_chk_lsl_up egcp[0].egcp_struct_pladglsl1.ctr_afl_chk_lsl_up egcp[0].egcp_struct_pladglsl1.t_end_diag_act_ls_down egcp[0].egcp_struct_pladglsl1.t_afr_chk_ls_down egcp[0].egcp_struct_pladglsl1.t_afl_chk_ls_down egcp[0].egcp_struct_pladglsl1.state_diag_act_ls_up_down egcp[0].egcp_struct_pladglsl1.lv_diag_afl_cdn_ls_up_down egcp[0].egcp_struct_pladglsl1.lv_diag_afr_cdn_ls_up_down egcp[0].egcp_struct_pladglsl1.lv_diag_act_end_ls_up_down egcp[0].egcp_struct_pladglsl1.lv_lamb_sp_afr_req_diag_act egcp[0].egcp_struct_pladglsl1.lv_lamb_sp_afl_req_diag_act egcp[0].egcp_struct_pladglsl1.lv_diag_cyc_end_ls_down egcp[0].egcp_struct_pladglsl1.lv_lam_di_req egcp[0].egcp_struct_pladglsl1.lv_diag_afr_end_ls_up_down egcp[0].egcp_struct_pladglsl1.lv_diag_afl_end_ls_up_down egcp[0].egcp_struct_pladglsl1.lv_diag_afr_chk_sym_lsl_up egcp[0].egcp_struct_pladglsl1.lv_diag_afl_chk_sym_lsl_up egcp[0].egcp_struct_pladglsl1.lv_diag_act_chk_cdn_lsl_up egcp[0].egcp_struct_pladglsl1.lv_diag_act_chk_end_lsl_up egcp[0].egcp_struct_pladglsl1.lv_diag_eol_end_ls_up_down egcp[0].egcp_struct_pladglsl1.lv_diag_eol_dc_ls_up_down egcp[0].egcp_struct_pladglsl1.lv_sym_afl_chk_ls_down egcp[0].egcp_struct_pladglsl1.lv_sym_afr_chk_ls_down egcp[0].egcp_struct_pladglsl1.lv_diag_act_cdn_ls_up_down egcp[1].egcp_struct_pladglsl1.lamb_sp_delta_ls_up_down egcp[1].egcp_struct_pladglsl1.maf_int_diag_ls_up_down egcp[1].egcp_struct_pladglsl1.lamb_sp_beg_diag_ls_up_down egcp[1].egcp_struct_pladglsl1.lamb_sp_diag_opl_ls_up_down egcp[1].egcp_struct_pladglsl1.t_diag_act_afr_ls_up_down egcp[1].egcp_struct_pladglsl1.t_diag_act_afl_ls_up_down egcp[1].egcp_struct_pladglsl1.ctr_sum_rst_afr_chk_lsl_up egcp[1].egcp_struct_pladglsl1.ctr_sum_rst_afl_chk_lsl_up egcp[1].egcp_struct_pladglsl1.ctr_afr_chk_lsl_up egcp[1].egcp_struct_pladglsl1.ctr_afl_chk_lsl_up egcp[1].egcp_struct_pladglsl1.t_end_diag_act_ls_down egcp[1].egcp_struct_pladglsl1.t_afr_chk_ls_down egcp[1].egcp_struct_pladglsl1.t_afl_chk_ls_down egcp[1].egcp_struct_pladglsl1.state_diag_act_ls_up_down egcp[1].egcp_struct_pladglsl1.lv_diag_afl_cdn_ls_up_down egcp[1].egcp_struct_pladglsl1.lv_diag_afr_cdn_ls_up_down egcp[1].egcp_struct_pladglsl1.lv_diag_act_end_ls_up_down egcp[1].egcp_struct_pladglsl1.lv_lamb_sp_afr_req_diag_act egcp[1].egcp_struct_pladglsl1.lv_lamb_sp_afl_req_diag_act egcp[1].egcp_struct_pladglsl1.lv_diag_cyc_end_ls_down egcp[1].egcp_struct_pladglsl1.lv_lam_di_req egcp[1].egcp_struct_pladglsl1.lv_diag_afr_end_ls_up_down egcp[1].egcp_struct_pladglsl1.lv_diag_afl_end_ls_up_down egcp[1].egcp_struct_pladglsl1.lv_diag_afr_chk_sym_lsl_up egcp[1].egcp_struct_pladglsl1.lv_diag_afl_chk_sym_lsl_up egcp[1].egcp_struct_pladglsl1.lv_diag_act_chk_cdn_lsl_up egcp[1].egcp_struct_pladglsl1.lv_diag_act_chk_end_lsl_up egcp[1].egcp_struct_pladglsl1.lv_diag_eol_end_ls_up_down egcp[1].egcp_struct_pladglsl1.lv_diag_eol_dc_ls_up_down egcp[1].egcp_struct_pladglsl1.lv_sym_afl_chk_ls_down egcp[1].egcp_struct_pladglsl1.lv_sym_afr_chk_ls_down egcp[1].egcp_struct_pladglsl1.lv_diag_act_cdn_ls_up_down lv_err_chk_ls_down_2 lv_err_chk_ls_down_1 lv_err_chg_ls_down /end OUT_MEASUREMENT
/end FUNCTION
/end MODULE
/end PROJECT
