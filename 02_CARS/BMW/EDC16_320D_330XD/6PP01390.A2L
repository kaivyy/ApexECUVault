ASAP2_VERSION 1 3
/begin PROJECT P390 "BMW DDE6.2 6-Zylinder VP0.1 11.11.2003 CAN12H"
/begin HEADER "" VERSION "VP01_6Z_CAN12H" PROJECT_NO P390 /end HEADER
/begin MODULE DIM ""
/begin MOD_COMMON "" BYTE_ORDER MSB_FIRST ALIGNMENT_BYTE 1 ALIGNMENT_WORD 2 ALIGNMENT_LONG 4 ALIGNMENT_FLOAT32_IEEE 4 /end MOD_COMMON
/begin CHARACTERISTIC CrSCD_numGlFilter_C "Wert Glitch Filter (MCy315)" VALUE 0xC04CF Kw_Wu8 3.000 OneToOne 0.00 3.000 FORMAT "%5.3" EXTENDED_LIMITS 0.00 255.0 /end CHARACTERISTIC
/begin CHARACTERISTIC CrSCD_numThresCtlHigh_C "obere Schwelle (MCy315)" VALUE 0xC04D0 Kw_Wu8 7.000 OneToOne 0.00 7.000 FORMAT "%5.3" EXTENDED_LIMITS 0.00 255.0 /end CHARACTERISTIC
/begin CHARACTERISTIC CrSCD_numThresCtlLow_C "untere Schwelle (MCy315)" VALUE 0xC04D1 Kw_Wu8 7.000 OneToOne 0.00 7.000 FORMAT "%5.3" EXTENDED_LIMITS 0.00 255.0 /end CHARACTERISTIC
/begin CHARACTERISTIC ExeMon_stEnaTst_C "#SSD Schalter zum Testen der Programmablaufkontrolle" VALUE 0xC2E20 Kw_Wu8 255.0 OneToOne 0.00 255.0 FORMAT "%5.1" /end CHARACTERISTIC
/begin CHARACTERISTIC LSUCD_stCJChpSel_C "Applikationskonstante zur Auswahl von CJ120 (=0) oder CJ125 (=1)" VALUE 0xE34F0 Kw_Wu16 1.000000 OneToOne 0.00 1.000000 FORMAT "%8.6" EXTENDED_LIMITS 0.00 65535.00 /end CHARACTERISTIC
/begin CHARACTERISTIC LSUCD_stRgnEna_C "Applikationskonstante zur Aktivierung oder Deaktivierung der Regeneration" VALUE 0xE34F2 Kw_Wu8 1.000 OneToOne 0.00 1.000 FORMAT "%5.3" EXTENDED_LIMITS 0.00 255.0 /end CHARACTERISTIC
/begin CHARACTERISTIC LSUCtl_tUpLim_C "Obere Widerstandsgrenze für eingeregelten Zustand" VALUE 0xE3778 Kw_Ws16 950.000 Temp_Cels -50.140 899.860 FORMAT "%8.3" EXTENDED_LIMITS -3549.940 3003.560 /end CHARACTERISTIC
/begin CHARACTERISTIC LSUCtl_tLowLim_C "Untere Widerstandsgrenze für eingeregelten Zustand" VALUE 0xE377A Kw_Ws16 950.000 Temp_Cels -50.140 899.860 FORMAT "%8.3" EXTENDED_LIMITS -3549.940 3003.560 /end CHARACTERISTIC
/begin CHARACTERISTIC LSUCtl_tRiSetPoint_C "#SSD Sollwert der LSU-Heizungsregelung" VALUE 0xE377C Kw_Ws16 950.000 Temp_Cels -50.140 899.860 FORMAT "%8.3" EXTENDED_LIMITS -3549.940 3003.560 /end CHARACTERISTIC
/begin CHARACTERISTIC LSUCtl_tHtCtlEna_C "Temperaturminimalwert für Freigabe der Regelung" VALUE 0xE377E Kw_Ws16 950.000 Temp_Cels -50.140 899.860 FORMAT "%8.3" EXTENDED_LIMITS -3549.940 3003.560 /end CHARACTERISTIC
/begin CHARACTERISTIC LSUCtl_nHtCtlEna_C "Mindestdrehzahl für Freigabe Aufheizrampe" VALUE 0xE3780 Kw_Ws16 32767.00 EngN 0.00 32767.00 FORMAT "%8.2" EXTENDED_LIMITS -32768.00 32767.00 /end CHARACTERISTIC
/begin CHARACTERISTIC LSUCtl_dcycHtMin_C "#SSD Tastverhältnis Heizeransteuerung vor Taupunktende (Vorwärmen)" VALUE 0xE3782 Kw_Ws16 100.0000 DtyCyc 0.00 100.0000 FORMAT "%8.4" EXTENDED_LIMITS -327.6800 327.6700 /end CHARACTERISTIC
/begin CHARACTERISTIC LSUCtl_tExcMax_C "Grenzwert zur Erkennung von ""obere Schwelle bleibend überschritten""" VALUE 0xE3784 Kw_Ws16 950.000 Temp_Cels -50.140 899.860 FORMAT "%8.3" EXTENDED_LIMITS -3549.940 3003.560 /end CHARACTERISTIC
/begin CHARACTERISTIC LSUCtl_tExcMin_C "Grenzwert zur Erkennung von ""untere Schwelle bleibend nicht erreicht""" VALUE 0xE3786 Kw_Ws16 950.000 Temp_Cels -50.140 899.860 FORMAT "%8.3" EXTENDED_LIMITS -3549.940 3003.560 /end CHARACTERISTIC
/begin CHARACTERISTIC LSUCtl_tiDelIniVal_C "Verzögerungszeit für die Erfassung der initialen Ansauglufttemperatur" VALUE 0xE3788 Kw_Wu16 655350.0 Time_ms 0.00 655350.0 FORMAT "%8.1" /end CHARACTERISTIC
/begin CHARACTERISTIC LSUCtl_dcycRmpUp_C "#SSD Anstiegsgeschwindigkeit Aufheizkurvenrampe" VALUE 0xE378C Kw_Wu32 655359.999847 RmpDtyCyc 0.00 655359.999847 FORMAT "%13.6" /end CHARACTERISTIC
/begin CHARACTERISTIC LSUCtl_dcycRmpDwn_C "Fallgeschwindigkeit Aufheizrampe" VALUE 0xE3790 Kw_Wu32 655359.999847 RmpDtyCyc 0.00 655359.999847 FORMAT "%13.6" /end CHARACTERISTIC
/begin CHARACTERISTIC LSUCtl_dcycStrt_CUR "#SSD Kennlinie Anfangsheizungs Tastverhältnis in Abhängigkeit von Ansauglufttemperatur bei Start" CURVE 0xE3794 Kl_Xs16_Ws16 100.0000 DtyCyc 0.00 100.0000 FORMAT "%8.4" EXTENDED_LIMITS -327.6800 327.6700
 /begin AXIS_DESCR STD_AXIS LSUCtl_tAirStrt_mp Temp_Cels 5 -50.1400 199.8600 FORMAT "%8.4" EXTENDED_LIMITS -3549.940 3003.560 DEPOSIT ABSOLUTE /end AXIS_DESCR
/end CHARACTERISTIC
/begin CHARACTERISTIC LSUCtl_tiDebRiExcMaxDef_C "Defekterkennungszeit bleibend obere Ri Schwelle überschritten" VALUE 0xE37AA Kw_Wu16 655350.0 Time_ms 0.00 655350.0 FORMAT "%8.1" /end CHARACTERISTIC
/begin CHARACTERISTIC LSUCtl_tiDebRiExcMaxOk_C "Heilungszeit bleibend obere Ri Schwelle überschritten" VALUE 0xE37AC Kw_Wu16 655350.0 Time_ms 0.00 655350.0 FORMAT "%8.1" /end CHARACTERISTIC
/begin CHARACTERISTIC LSUCtl_tiDebRiExcMinDef_C "Defekterkennungszeit bleibend untere Ri Schwelle unterschritten" VALUE 0xE37AE Kw_Wu16 655350.0 Time_ms 0.00 655350.0 FORMAT "%8.1" /end CHARACTERISTIC
/begin CHARACTERISTIC LSUCtl_tiDebRiExcMinOk_C "Heilungszeit bleibend untere Ri Schwelle unterschritten" VALUE 0xE37B0 Kw_Wu16 655350.0 Time_ms 0.00 655350.0 FORMAT "%8.1" /end CHARACTERISTIC
/begin CHARACTERISTIC LSUCtl_tiSens1HtDT1_C "Verzugszeit T1 des D-Gliedes der LSU Heizungsregelung Sensoren vor Katalysator" VALUE 0xE37B4 Kw_Wu32 4294.9673 TimeDelay_s 0.0000010000000 4294.9673 FORMAT "%9.4" /end CHARACTERISTIC
/begin CHARACTERISTIC LSUCtl_Sens1HtDT1Kd_C "Kd Parameter der Heizungsregelung für die Sensoren vor Katalysator" VALUE 0xE37B8 Kw_Ws32 6553.59999847 Kd_Temp_Kelv2Dcyc -3276.80000000 3276.79999847 FORMAT "%13.8" /end CHARACTERISTIC
/begin CHARACTERISTIC LSUCtl_Sens1HtIKi_C "Ki Parameter der Heizungsregelung für die Sensoren vor Katalysator (Kleinsignalbereich)" VALUE 0xE37BC Kw_Wu32 99999.9999767 Ki_Temp_Kelv2Dcyc 0.00 99999.9999767 FORMAT "%13.7" /end CHARACTERISTIC
/begin CHARACTERISTIC LSUCtl_Sens1HtIKiPos_C "Ki Parameter der Heizungsregelung für die Sensoren vor Katalysator (positiver Großsignalbereich)" VALUE 0xE37C0 Kw_Wu32 99999.9999767 Ki_Temp_Kelv2Dcyc 0.00 99999.9999767 FORMAT "%13.7" /end CHARACTERISTIC
/begin CHARACTERISTIC LSUCtl_Sens1HtIKiNeg_C "Ki Parameter der Heizungsregelung für die Sensoren vor Katalysator (negativer Großsignalbereich)" VALUE 0xE37C4 Kw_Wu32 99999.9999767 Ki_Temp_Kelv2Dcyc 0.00 99999.9999767 FORMAT "%13.7" /end CHARACTERISTIC
/begin CHARACTERISTIC LSUCtl_tSens1HtIWinPos_C "Obere Fenstergrenze des I-Anteils der LSU-Heizungsregelung (Sensoren vor Katalysator)" VALUE 0xE37C8 Kw_Ws16 6553.500 TempDiff_Cels -3276.800 3276.700 FORMAT "%8.3" /end CHARACTERISTIC
/begin CHARACTERISTIC LSUCtl_tSens1HtIWinNeg_C "Untere Fenstergrenze des I-Anteils der LSU-Heizungsregelung (Sensoren vor Katalysator)" VALUE 0xE37CA Kw_Ws16 6553.500 TempDiff_Cels -3276.800 3276.700 FORMAT "%8.3" /end CHARACTERISTIC
/begin CHARACTERISTIC LSUCtl_Sens1HtPKp_C "Kp Parameter der Heizungsregelung für die Sensoren vor Katalysator (Kleinsignalbereich)" VALUE 0xE37CC Kw_Wu32 6553.59999847 Kp_Temp_Kelv2Dcyc 0.00 6553.59999847 FORMAT "%13.8" /end CHARACTERISTIC
/begin CHARACTERISTIC LSUCtl_Sens1HtPKpPos_C "Kp Parameter der Heizungsregelung für die Sensoren vor Katalysator (positiver Großsignalbereich)" VALUE 0xE37D0 Kw_Wu32 6553.59999847 Kp_Temp_Kelv2Dcyc 0.00 6553.59999847 FORMAT "%13.8" /end CHARACTERISTIC
/begin CHARACTERISTIC LSUCtl_Sens1HtPKpNeg_C "Kp Parameter der Heizungsregelung für die Sensoren vor Katalysator (negativer Großsignalbereich)" VALUE 0xE37D4 Kw_Wu32 6553.59999847 Kp_Temp_Kelv2Dcyc 0.00 6553.59999847 FORMAT "%13.8" /end CHARACTERISTIC
/begin CHARACTERISTIC LSUCtl_tSens1HtPWinPos_C "Obere Fenstergrenze des P-Anteils der LSU-Heizungsregelung (Sensoren vor Katalysator)" VALUE 0xE37D8 Kw_Ws16 6553.500 TempDiff_Cels -3276.800 3276.700 FORMAT "%8.3" /end CHARACTERISTIC
/begin CHARACTERISTIC LSUCtl_tSens1HtPWinNeg_C "Untere Fenstergrenze des P-Anteils der LSU-Heizungsregelung (Sensoren vor Katalysator)" VALUE 0xE37DA Kw_Ws16 6553.500 TempDiff_Cels -3276.800 3276.700 FORMAT "%8.3" /end CHARACTERISTIC
/begin CHARACTERISTIC LSUCtl_tiSens2HtDT1_C "Verzugszeit T1 des D-Gliedes der LSU Heizungsregelung Sensoren nach Katalysator" VALUE 0xE37DC Kw_Wu32 4294.9673 TimeDelay_s 0.0000010000000 4294.9673 FORMAT "%9.4" /end CHARACTERISTIC
/begin CHARACTERISTIC LSUCtl_Sens2HtDT1Kd_C "Kd Parameter der Heizungsregelung für die Sensoren nach Katalysator" VALUE 0xE37E0 Kw_Ws32 6553.59999847 Kd_Temp_Kelv2Dcyc -3276.80000000 3276.79999847 FORMAT "%13.8" /end CHARACTERISTIC
/begin CHARACTERISTIC LSUCtl_Sens2HtIKi_C "Ki Parameter der Heizungsregelung für die Sensoren nach Katalysator (Kleinsignalbereich)" VALUE 0xE37E4 Kw_Wu32 99999.9999767 Ki_Temp_Kelv2Dcyc 0.00 99999.9999767 FORMAT "%13.7" /end CHARACTERISTIC
/begin CHARACTERISTIC LSUCtl_Sens2HtIKiPos_C "Ki Parameter der Heizungsregelung für die Sensoren nach Katalysator (positiver Großsignalbereich)" VALUE 0xE37E8 Kw_Wu32 99999.9999767 Ki_Temp_Kelv2Dcyc 0.00 99999.9999767 FORMAT "%13.7" /end CHARACTERISTIC
/begin CHARACTERISTIC LSUCtl_Sens2HtIKiNeg_C "Ki Parameter der Heizungsregelung für die Sensoren nach Katalysator (negativer Großsignalbereich)" VALUE 0xE37EC Kw_Wu32 99999.9999767 Ki_Temp_Kelv2Dcyc 0.00 99999.9999767 FORMAT "%13.7" /end CHARACTERISTIC
/begin CHARACTERISTIC LSUCtl_tSens2HtIWinPos_C "Obere Fenstergrenze des I-Anteils der LSU-Heizungsregelung (Sensoren nach Katalysator)" VALUE 0xE37F0 Kw_Ws16 6553.500 TempDiff_Cels -3276.800 3276.700 FORMAT "%8.3" /end CHARACTERISTIC
/begin CHARACTERISTIC LSUCtl_tSens2HtIWinNeg_C "Untere Fenstergrenze des I-Anteils der LSU-Heizungsregelung (Sensoren nach Katalysator)" VALUE 0xE37F2 Kw_Ws16 6553.500 TempDiff_Cels -3276.800 3276.700 FORMAT "%8.3" /end CHARACTERISTIC
/begin CHARACTERISTIC LSUCtl_Sens2HtPKp_C "Kp Parameter der Heizungsregelung für die Sensoren nach Katalysator (Kleinsignalbereich)" VALUE 0xE37F4 Kw_Wu32 6553.59999847 Kp_Temp_Kelv2Dcyc 0.00 6553.59999847 FORMAT "%13.8" /end CHARACTERISTIC
/begin CHARACTERISTIC LSUCtl_Sens2HtPKpPos_C "Kp Parameter der Heizungsregelung für die Sensoren nach Katalysator (positiver Großsignalbereich)" VALUE 0xE37F8 Kw_Wu32 6553.59999847 Kp_Temp_Kelv2Dcyc 0.00 6553.59999847 FORMAT "%13.8" /end CHARACTERISTIC
/begin CHARACTERISTIC LSUCtl_Sens2HtPKpNeg_C "Kp Parameter der Heizungsregelung für die Sensoren nach Katalysator (negativer Großsignalbereich)" VALUE 0xE37FC Kw_Wu32 6553.59999847 Kp_Temp_Kelv2Dcyc 0.00 6553.59999847 FORMAT "%13.8" /end CHARACTERISTIC
/begin CHARACTERISTIC LSUCtl_tSens2HtPWinPos_C "Obere Fenstergrenze des P-Anteils der LSU-Heizungsregelung (Sensoren nach Katalysator)" VALUE 0xE3800 Kw_Ws16 6553.500 TempDiff_Cels -3276.800 3276.700 FORMAT "%8.3" /end CHARACTERISTIC
/begin CHARACTERISTIC LSUCtl_tSens2HtPWinNeg_C "Untere Fenstergrenze des P-Anteils der LSU-Heizungsregelung (Sensoren nach Katalysator)" VALUE 0xE3802 Kw_Ws16 6553.500 TempDiff_Cels -3276.800 3276.700 FORMAT "%8.3" /end CHARACTERISTIC
/begin CHARACTERISTIC LSU_ctRgnEna_C "Zahl von Kalibrierungs-Zyklen, nach der Regeneration vorkommen soll" VALUE 0xE34C8 Kw_Wu8 255.0 OneToOne 0.00 255.0 FORMAT "%5.1" /end CHARACTERISTIC
/begin CHARACTERISTIC LSU_dcycMax_C "minimale Tastverhältnis-Änderung für Aktivierung Heizereinkopplungs-Diagnose" VALUE 0xE34F4 Kw_Ws16 655.3500 DtyCyc -327.6800 327.6700 FORMAT "%8.4" /end CHARACTERISTIC
/begin CHARACTERISTIC LSU_tiBattHighDebNeg_C "Entprellzeit (Übergang von high nach low) der Batteriespannungsüberwachung" VALUE 0xE34F6 Kw_Wu16 655350.0 TimeDeb 0.00 655350.0 FORMAT "%8.1" /end CHARACTERISTIC
/begin CHARACTERISTIC LSU_tiBattHighDebPos_C "Entprellzeit (Übergang von low nach high) der Batteriespannungsüberwachung" VALUE 0xE34F8 Kw_Wu16 655350.0 TimeDeb 0.00 655350.0 FORMAT "%8.1" /end CHARACTERISTIC
/begin CHARACTERISTIC LSU_DebDynErrDef_C "Zählerstand zur Defektentprellung Dynamikfehler" VALUE 0xE3534 Kw_Wu16 65535.00 OneToOne 0.00 65535.00 FORMAT "%8.2" /end CHARACTERISTIC
/begin CHARACTERISTIC LSU_DebDynErrOk_C "Zählerstand zur Heilungsentprellung Dynamikfehler" VALUE 0xE3536 Kw_Wu16 65535.00 OneToOne 0.00 65535.00 FORMAT "%8.2" /end CHARACTERISTIC
/begin CHARACTERISTIC LSU_DebO2ConcHighDef_C "Zählerstand zur Defektentprellung unplausibel hohe O2-Konzentration" VALUE 0xE3538 Kw_Wu16 65535.00 OneToOne 0.00 65535.00 FORMAT "%8.2" /end CHARACTERISTIC
/begin CHARACTERISTIC LSU_DebO2ConcHighOk_C "Zählerstand zur Heilungsentprellung unplausibel hohe O2-Konzentration" VALUE 0xE353A Kw_Wu16 65535.00 OneToOne 0.00 65535.00 FORMAT "%8.2" /end CHARACTERISTIC
/begin CHARACTERISTIC LSU_DebO2ConcLowDef_C "Zählerstand zur Defektentprellung unplausibel niedrige O2-Konzentration" VALUE 0xE353C Kw_Wu16 65535.00 OneToOne 0.00 65535.00 FORMAT "%8.2" /end CHARACTERISTIC
/begin CHARACTERISTIC LSU_DebO2ConcLowOk_C "Zählerstand zur Heilungsentprellung unplausibel niedrige O2-Konzentration" VALUE 0xE353E Kw_Wu16 65535.00 OneToOne 0.00 65535.00 FORMAT "%8.2" /end CHARACTERISTIC
/begin CHARACTERISTIC LSU_tiOvrRunDebNeg_C "Entprellzeit (Übergang von high nach low) der Schuberkennung" VALUE 0xE34FA Kw_Wu16 655350.0 TimeDeb 0.00 655350.0 FORMAT "%8.1" /end CHARACTERISTIC
/begin CHARACTERISTIC LSU_tiOvrRunDebPos_C "Entprellzeit (Übergang von low nach high) der Schuberkennung" VALUE 0xE34FC Kw_Wu16 655350.0 TimeDeb 0.00 655350.0 FORMAT "%8.1" /end CHARACTERISTIC
/begin CHARACTERISTIC LSU_mAirMaxClb1_C "upper air mass threshold for calibration/regeneration of  CJ120/125 (for operating point1)" VALUE 0xE34CA Kw_Ws16 6553.500 AirMassPerCyl -3276.800 3276.700 FORMAT "%8.3" /end CHARACTERISTIC
/begin CHARACTERISTIC LSU_mAirMaxClb2_C "upper air mass threshold for calibration/regeneration of CJ120/125 (for operating point2)" VALUE 0xE34CC Kw_Ws16 6553.500 AirMassPerCyl -3276.800 3276.700 FORMAT "%8.3" /end CHARACTERISTIC
/begin CHARACTERISTIC LSU_mAirMax_C "obere Luftmassen-Schwelle für Plausibilitätscheck (0 - Vollast, 1 - Teillast, 2 - Schub)" VAL_BLK 0xE3540 Kwb_Ws16 6553.500 AirMassPerCyl -3276.800 3276.700 FORMAT "%8.3" NUMBER 3 /end CHARACTERISTIC
/begin CHARACTERISTIC LSU_mAirMinClb1_C "lower air mass threshold for calibration/regeneration of CJ120/125 (for operating point1)" VALUE 0xE34CE Kw_Ws16 6553.500 AirMassPerCyl -3276.800 3276.700 FORMAT "%8.3" /end CHARACTERISTIC
/begin CHARACTERISTIC LSU_mAirMinClb2_C "lower air mass threshold for calibration/regeneration of  CJ120/125 (for operating point2)" VALUE 0xE34D0 Kw_Ws16 6553.500 AirMassPerCyl -3276.800 3276.700 FORMAT "%8.3" /end CHARACTERISTIC
/begin CHARACTERISTIC LSU_mAirMin_C "untere Luftmassenschwelle für Plausibilitäts-Check (0 - Vollast, 1 - Teillast, 2 - Schub)" VAL_BLK 0xE3546 Kwb_Ws16 6553.500 AirMassPerCyl -3276.800 3276.700 FORMAT "%8.3" NUMBER 3 /end CHARACTERISTIC
/begin CHARACTERISTIC LSU_nMaxClb1_C "upper engine speed  threshold for calibration/regeneration of  CJ120/125 (for operating point1)" VALUE 0xE34D2 Kw_Ws16 65535.00 EngN -32768.00 32767.00 FORMAT "%8.2" /end CHARACTERISTIC
/begin CHARACTERISTIC LSU_nMaxClb2_C "lower engine speed  threshold for calibration/regeneration of CJ120/125 (for operating point2)" VALUE 0xE34D4 Kw_Ws16 65535.00 EngN -32768.00 32767.00 FORMAT "%8.2" /end CHARACTERISTIC
/begin CHARACTERISTIC LSU_nMax_C "obere Drehzahlschwelle für Plausibilitäts-Check (0 - Vollast, 1 - Teillast, 2 - Schub)" VAL_BLK 0xE354C Kwb_Ws16 65535.00 EngN -32768.00 32767.00 FORMAT "%8.2" NUMBER 3 /end CHARACTERISTIC
/begin CHARACTERISTIC LSU_nMinChkDyn_C "minimale Drehzahl zur Aktivierung Dynamiküberwachung" VALUE 0xE3552 Kw_Ws16 65535.00 EngN -32768.00 32767.00 FORMAT "%8.2" /end CHARACTERISTIC
/begin CHARACTERISTIC LSU_nMinClb1_C "lower engine speed threshold for for calibration/regeneration of  CJ120/125 (for operating point1)" VALUE 0xE34D6 Kw_Ws16 65535.00 EngN -32768.00 32767.00 FORMAT "%8.2" /end CHARACTERISTIC
/begin CHARACTERISTIC LSU_nMinClb2_C "lower engine speed  threshold for for calibration/regeneration of  CJ120/125 (for operating point2)" VALUE 0xE34D8 Kw_Ws16 65535.00 EngN -32768.00 32767.00 FORMAT "%8.2" /end CHARACTERISTIC
/begin CHARACTERISTIC LSU_nMin_C "untere Drehzahlschwelle für Plausibilitäts-Check (0 - Vollast, 1 - Teillast, 2 - Schub)" VAL_BLK 0xE3554 Kwb_Ws16 65535.00 EngN -32768.00 32767.00 FORMAT "%8.2" NUMBER 3 /end CHARACTERISTIC
/begin CHARACTERISTIC LSU_qDiffMax_C "Toleranzband Einspritzmenge für Stationärerkennung" VALUE 0xE355A Kw_Ws16 655.3500 InjMass -327.6800 327.6700 FORMAT "%8.4" /end CHARACTERISTIC
/begin CHARACTERISTIC LSU_qMaxClb1_C "upper fuel quantity threshold for calibration/regeneration of  CJ120/125 (for operating point1)" VALUE 0xE34DA Kw_Ws16 655.3500 InjMass -327.6800 327.6700 FORMAT "%8.4" /end CHARACTERISTIC
/begin CHARACTERISTIC LSU_qMaxClb2_C "upper fuel quantity threshold for calibration/regeneration of CJ120/125 (for operating point2)" VALUE 0xE34DC Kw_Ws16 655.3500 InjMass -327.6800 327.6700 FORMAT "%8.4" /end CHARACTERISTIC
/begin CHARACTERISTIC LSU_qMax_C "obere Mengenschwelle für Plausibilitäts-Check (0 - Vollast, 1 - Teillast, 2 - Schub)" VAL_BLK 0xE355C Kwb_Ws16 655.3500 InjMass -327.6800 327.6700 FORMAT "%8.4" NUMBER 3 /end CHARACTERISTIC
/begin CHARACTERISTIC LSU_qMinClb1_C "lower fuel quantity threshold for calibration/regeneration of CJ120/125 (for operating point1)" VALUE 0xE34DE Kw_Ws16 655.3500 InjMass -327.6800 327.6700 FORMAT "%8.4" /end CHARACTERISTIC
/begin CHARACTERISTIC LSU_qMinClb2_C "lower fuel quantity threshold for calibration/regeneration of CJ120/125 (for operating point2)" VALUE 0xE34E0 Kw_Ws16 655.3500 InjMass -327.6800 327.6700 FORMAT "%8.4" /end CHARACTERISTIC
/begin CHARACTERISTIC LSU_qMin_C "untere Mengenschwelle für Plausibilitäts-Check (0 - Vollast, 1 - Teillast, 2 - Schub)" VAL_BLK 0xE3562 Kwb_Ws16 655.3500 InjMass -327.6800 327.6700 FORMAT "%8.4" NUMBER 3 /end CHARACTERISTIC
/begin CHARACTERISTIC LSU_qThresChkDyn_C "minimale Kraftstoffmenge für Aktivierung Dynamiküberwachung" VALUE 0xE3568 Kw_Ws16 655.3500 InjMass -327.6800 327.6700 FORMAT "%8.4" /end CHARACTERISTIC
/begin CHARACTERISTIC LSU_qThresOvrRun_C "Mengenschwelle zur Schuberkennung" VALUE 0xE356A Kw_Ws16 655.3500 InjMass -327.6800 327.6700 FORMAT "%8.4" /end CHARACTERISTIC
/begin CHARACTERISTIC LSU_rLmbdRec_CUR "#SSD Kennlinie für Kehrwert von Lambda" CURVE 0xE3502 Kl_Xs16_Ws16 65.53500 lambdaRecVal -32.76800 32.76700 FORMAT "%8.5"
 /begin AXIS_DESCR STD_AXIS LSU_rO2AdptLastLSU_mp O2 12 -0.3276800 0.3276700 FORMAT "%9.7" DEPOSIT ABSOLUTE /end AXIS_DESCR
/end CHARACTERISTIC
/begin CHARACTERISTIC LSU_rO2ConstVal_C "Mitte Toleranzband für Lambda-1-Erkennung" VALUE 0xE356C Kw_Ws16 0.6553500 O2 -0.3276800 0.3276700 FORMAT "%9.7" /end CHARACTERISTIC
/begin CHARACTERISTIC LSU_tiDvtFlt_C "Filterzeitkonstante Lambda-1-Erkennung" VALUE 0xE3570 Kw_Wu32 4294.9673 TimeDelay_s 0.0000010000000 4294.9673 FORMAT "%9.4" /end CHARACTERISTIC
/begin CHARACTERISTIC LSU_rO2Lmbd1Thres_C "Toleranzband für Lambda-1-Erkennung" VALUE 0xE3574 Kw_Ws16 0.6553500 O2 -0.3276800 0.3276700 FORMAT "%9.7" /end CHARACTERISTIC
/begin CHARACTERISTIC LSU_rO2MaxVar_C "Breite des Toleranzbands für O2-Stationärerkennung" VALUE 0xE3576 Kw_Ws16 0.6553500 O2 -0.3276800 0.3276700 FORMAT "%9.7" /end CHARACTERISTIC
/begin CHARACTERISTIC LSU_rO2Min_C "minimaler O2-Sollwert für Aktivierung der Lambda-1-Erkennung" VALUE 0xE3578 Kw_Ws16 0.6553500 O2 -0.3276800 0.3276700 FORMAT "%9.7" /end CHARACTERISTIC
/begin CHARACTERISTIC LSU_rO2NegDvt_C "negative O2-Toleranz (0 - Vollast, 1 - Teillast, 2 - Schub)" VAL_BLK 0xE357A Kwb_Ws16 0.6553500 O2 -0.3276800 0.3276700 FORMAT "%9.7" NUMBER 3 /end CHARACTERISTIC
/begin CHARACTERISTIC LSU_rO2PosDvt_C "positive O2-Toleranz (0 - Vollast, 1 - Teillast, 2 - Schub)" VAL_BLK 0xE3580 Kwb_Ws16 0.6553500 O2 -0.3276800 0.3276700 FORMAT "%9.7" NUMBER 3 /end CHARACTERISTIC
/begin CHARACTERISTIC LSU_stChpClbActv_C "Aktivierungsflags für O2- und Ri-Kalibrierung" VALUE 0xE34E2 Kw_Wu8 3.000 OneToOne 0.00 3.000 FORMAT "%5.3" EXTENDED_LIMITS 0.00 255.0 /end CHARACTERISTIC
/begin CHARACTERISTIC LSU_stEGTClbOff_C "Bitmaske zur Unterdrückung der CJ12x-Kalibrierung bei Regenerationsanforderung Abgasnachbehandlung" VALUE 0xE34E4 Kw_Wu32 4294967295.00 OneToOne 0.00 4294967295.00 FORMAT "%13.2" /end CHARACTERISTIC
/begin CHARACTERISTIC LSU_stMonActv_C "Aktivierungsflags für Diagnoseroutinen" VALUE 0xE3586 Kw_Wu16 65535.00 OneToOne 0.00 65535.00 FORMAT "%8.2" /end CHARACTERISTIC
/begin CHARACTERISTIC LSU_stMonMsk_C "Bitmaske zur Unterdrückung der Diagnosen im Fall einer Regenerationsanforderung der Abgasnachbehandlung" VALUE 0xE3588 Kw_Wu32 4294967295.00 OneToOne 0.00 4294967295.00 FORMAT "%13.2" /end CHARACTERISTIC
/begin CHARACTERISTIC LSU_stSelPlausChkSig_C "Auswahl O2-Signal für Plausibilisierung" VALUE 0xE358C Kw_Wu16 65535.00 OneToOne 0.00 65535.00 FORMAT "%8.2" /end CHARACTERISTIC
/begin CHARACTERISTIC LSU_swtVal_C "Freigabe oder Sperren der LSU-Funktionen" VALUE 0xE34FE Kw_Wu8 1.000 OneToOne 0.00 1.000 FORMAT "%5.3" EXTENDED_LIMITS 0.00 255.0 /end CHARACTERISTIC
/begin CHARACTERISTIC LSU_swtType_C "Datensatz oder EEPROM-Wert Freigabe LSU Funktion" VALUE 0xE34FF Kw_Wu8 0.00 OneToOne 2.000 2.000 FORMAT "%5.3" EXTENDED_LIMITS 0.00 255.0 /end CHARACTERISTIC
/begin CHARACTERISTIC LSU_ti1stClb_C "Zeitdauer von SG-Start bis zu erster Kalibrierung CJ120" VALUE 0xE34E8 Kw_Wu16 655.3500 Time_s 0.00 655.3500 FORMAT "%8.4" /end CHARACTERISTIC
/begin CHARACTERISTIC LSU_tiDvt1Flt_C "Filterzeitkonstante für Lambda-1-Erkennung" VALUE 0xE358E Kw_Wu16 655.3500 Time_s 0.00 655.3500 FORMAT "%8.4" /end CHARACTERISTIC
/begin CHARACTERISTIC LSU_tiO2CalcFlt_C "Filterzeitkonstante für berechneten O2-Wert" VAL_BLK 0xE3590 Kwb_Wu32 4294.9673 TimeDelay_s 0.0000010000000 4294.9673 FORMAT "%9.4" NUMBER 1 /end CHARACTERISTIC
/begin CHARACTERISTIC LSU_tiO2Eval_C "erforderliche Dauer für O2-Stationärerkennung" VALUE 0xE3594 Kw_Wu16 655.3500 Time_s 0.00 655.3500 FORMAT "%8.4" /end CHARACTERISTIC
/begin CHARACTERISTIC LSU_tiPerClb_C "Periodendauer CJ120-Kalibrierung" VALUE 0xE34EA Kw_Wu16 655.3500 Time_s 0.00 655.3500 FORMAT "%8.4" /end CHARACTERISTIC
/begin CHARACTERISTIC LSU_tiSwitch_CA "maximal zulässige Werte für Flankenzeit Last->Schub" VAL_BLK 0xE3596 Kwb_Wu16 655.3500 Time_s 0.00 655.3500 FORMAT "%8.4" NUMBER 1 /end CHARACTERISTIC
/begin CHARACTERISTIC LSU_tiWait1_CA "Zeitdauer für Stationärerkennung Dynamiküberwachung" VAL_BLK 0xE3598 Kwb_Wu16 655.3500 Time_s 0.00 655.3500 FORMAT "%8.4" NUMBER 1 /end CHARACTERISTIC
/begin CHARACTERISTIC LSU_tiWait2_CA "maximale Zeitdauer zum Erreichen der oberen O2-Schwelle in Dynamiküberwachung" VAL_BLK 0xE359A Kwb_Wu16 655.3500 Time_s 0.00 655.3500 FORMAT "%8.4" NUMBER 1 /end CHARACTERISTIC
/begin CHARACTERISTIC LSU_tiWait3_CA "maximale Zeitdauer zum Erreichen der oberen O2-Schwelle in Dynamiküberwachung" VAL_BLK 0xE359C Kwb_Wu16 655.3500 Time_s 0.00 655.3500 FORMAT "%8.4" NUMBER 1 /end CHARACTERISTIC
/begin CHARACTERISTIC LSU_uBattMin_C "minimale Batteriespannung" VALUE 0xE3500 Kw_Wu16 15992.18 Volt_Batt 0.00 15992.18 FORMAT "%8.2" EXTENDED_LIMITS 0.00 1281232. /end CHARACTERISTIC
/begin CHARACTERISTIC LSU_uMinClb_C "Minimalwert zur Erkennung einer niedrigen Batteriespannung" VALUE 0xE34EC Kw_Wu16 15992.18 Volt_Batt 0.00 15992.18 FORMAT "%8.2" EXTENDED_LIMITS 0.00 1281232. /end CHARACTERISTIC
/begin CHARACTERISTIC LSU_volMinFl_C "Minimales Kraftstoffvolumen im Tank" VALUE 0xE359E Kw_Ws16 300.0000 Fl_Half_L 0.00 300.0000 FORMAT "%8.4" EXTENDED_LIMITS -1638.400 1638.350 /end CHARACTERISTIC
/begin CHARACTERISTIC LubCD_ctInitDly_C "counter for delay after initialisation" VALUE 0xE3804 Kw_Wu16 65535.00 OneToOne 0.00 65535.00 FORMAT "%8.2" /end CHARACTERISTIC
/begin CHARACTERISTIC LubCD_ctTogErr_C "debounce counter for interface error" VALUE 0xE3806 Kw_Wu8 255.0 OneToOne 0.00 255.0 FORMAT "%5.1" /end CHARACTERISTIC
/begin CHARACTERISTIC LubCD_stLoadPwmInInv_C "PWM Input to be inverted" VALUE 0xE3807 Kw_Wu8 1.000 OneToOne 0.00 1.000 FORMAT "%5.3" EXTENDED_LIMITS 0.00 255.0 /end CHARACTERISTIC
/begin CHARACTERISTIC LubCD_swtTogVer_C "version of thermal oil niveau sensor" VALUE 0xE3808 Kw_Wu8 2.000 OneToOne 0.00 2.000 FORMAT "%5.3" EXTENDED_LIMITS 0.00 255.0 /end CHARACTERISTIC
/begin CHARACTERISTIC Lub_tiDebNplDef_C "NPL fault debouncing  time" VALUE 0xE380A Kw_Wu16 655350.0 Time_ms 0.00 655350.0 FORMAT "%8.1" /end CHARACTERISTIC
/begin CHARACTERISTIC Lub_tiDebNplOk_C "NPL fault Healing time" VALUE 0xE380C Kw_Wu16 655350.0 Time_ms 0.00 655350.0 FORMAT "%8.1" /end CHARACTERISTIC
/begin CHARACTERISTIC Lub_tiDebSigDef_C "SIG fault debouncing time" VALUE 0xE380E Kw_Wu16 655350.0 Time_ms 0.00 655350.0 FORMAT "%8.1" /end CHARACTERISTIC
/begin CHARACTERISTIC Lub_tiDebSigOk_C "SIG fault Healing   time" VALUE 0xE3810 Kw_Wu16 655350.0 Time_ms 0.00 655350.0 FORMAT "%8.1" /end CHARACTERISTIC
/begin CHARACTERISTIC MemMon_numErrChkRam_C "#SSD Fehlertoleranzschwelle für Doppelablage und zyklischen RAM-Test" VALUE 0xC304C Kw_Wu8 255.0 OneToOne 0.00 255.0 FORMAT "%5.1" /end CHARACTERISTIC
/begin CHARACTERISTIC MemMon_numErrChkRom_C "#SSD Fehlertoleranzschwelle für zyklischen ROM-Test" VALUE 0xC304D Kw_Wu8 255.0 OneToOne 0.00 255.0 FORMAT "%5.1" /end CHARACTERISTIC
/begin CHARACTERISTIC MemMon_tiHealChkRam_C "#SSD Heilungszeit für Fehler in der Doppelablage und im zyklischen RAM-Test" VALUE 0xC304E Kw_Wu8 10200. Time_ms_40ms 0.00 10200. FORMAT "%5.0" /end CHARACTERISTIC
/begin CHARACTERISTIC MemMon_tiHealChkRom_C "#SSD Heilungszeit für Fehler im zyklischen ROM-Test" VALUE 0xC304F Kw_Wu8 10200. Time_ms_40ms 0.00 10200. FORMAT "%5.0" /end CHARACTERISTIC
/begin CHARACTERISTIC MeUnCD_uSRCMin_C "#SSD Analogeingang, Signal Range Check Min-Spannungswert" VALUE 0xE3844 Kw_Ws16 5200.391 Volt 0.00 5200.391 FORMAT "%8.3" EXTENDED_LIMITS -160156.4 160151.5 /end CHARACTERISTIC
/begin CHARACTERISTIC MeUnCD_uSRCMax_C "#SSD Analogeingang, Signal Range Check Max-Spannungswert" VALUE 0xE3846 Kw_Ws16 5200.391 Volt 0.00 5200.391 FORMAT "%8.3" EXTENDED_LIMITS -160156.4 160151.5 /end CHARACTERISTIC
/begin CHARACTERISTIC MeUnCD_iLin_CUR "#SSD Analogeingang, Linearisierungskennlinie" CURVE 0xE3848 Kl_Xs16_Ws16 5000.000 Curr 0.00 5000.000 FORMAT "%8.3" EXTENDED_LIMITS -32768.00 32767.00
 /begin AXIS_DESCR STD_AXIS MeUnCD_uRawVal_mp Volt 2 0.00 5200.391 FORMAT "%8.3" EXTENDED_LIMITS -160156.4 160151.5 DEPOSIT ABSOLUTE /end AXIS_DESCR
/end CHARACTERISTIC
/begin CHARACTERISTIC MeUnCD_dcycMax_C "#SSD Max-Wert, Ausgangstastverhältnis" VALUE 0xE3852 Kw_Ws16 100.0000 DtyCyc 0.00 100.0000 FORMAT "%8.4" EXTENDED_LIMITS -327.6800 327.6700 /end CHARACTERISTIC
/begin CHARACTERISTIC MeUnCD_dcycMin_C "#SSD Min-Wert, Ausgangstastverhältnis" VALUE 0xE3854 Kw_Ws16 100.0000 DtyCyc 0.00 100.0000 FORMAT "%8.4" EXTENDED_LIMITS -327.6800 327.6700 /end CHARACTERISTIC
/begin CHARACTERISTIC MeUnCD_dcycSetValLin_CUR "#SSD Linearisierungskurve des Tastverhältnisses der  Zumesseinheit" CURVE 0xE3856 Kl_Xs16_Ws16 100.0000 DtyCyc 0.00 100.0000 FORMAT "%8.4" EXTENDED_LIMITS -327.6800 327.6700
 /begin AXIS_DESCR STD_AXIS MeUnCD_dcycSetVal_mp DtyCyc 4 -327.6800 327.6700 FORMAT "%8.4" DEPOSIT ABSOLUTE /end AXIS_DESCR
/end CHARACTERISTIC
/begin CHARACTERISTIC MeUnCD_dcycTst_C "#SSD Tastverhältnis, das im Fehlerfall zyklisch ausgegeben wird" VALUE 0xE3868 Kw_Ws16 100.0000 DtyCyc 0.00 100.0000 FORMAT "%8.4" EXTENDED_LIMITS -327.6800 327.6700 /end CHARACTERISTIC
/begin CHARACTERISTIC MeUnCD_DebExcTempDef_C "#SSD Fehlerentprellzeit Übertemperatur" VALUE 0xE386A Kw_Wu16 655350.0 Time_ms 0.00 655350.0 FORMAT "%8.1" /end CHARACTERISTIC
/begin CHARACTERISTIC MeUnCD_DebExcTempOk_C "#SSD Heilungsentprellzeit Übertemperatur" VALUE 0xE386C Kw_Wu16 655350.0 Time_ms 0.00 655350.0 FORMAT "%8.1" /end CHARACTERISTIC
/begin CHARACTERISTIC MeUnCD_DebNoLoadDef_C "#SSD Fehlerentprellzeit Leerlauf" VALUE 0xE386E Kw_Wu16 655350.0 Time_ms 0.00 655350.0 FORMAT "%8.1" /end CHARACTERISTIC
/begin CHARACTERISTIC MeUnCD_DebNoLoadOk_C "#SSD Heilungszeit Leerlauf" VALUE 0xE3870 Kw_Wu16 655350.0 Time_ms 0.00 655350.0 FORMAT "%8.1" /end CHARACTERISTIC
/begin CHARACTERISTIC MeUnCD_DebShortCircBatDef_C "#SSD Fehlerentprellzeit Kurzschluss Batterie" VALUE 0xE3872 Kw_Wu16 655350.0 Time_ms 0.00 655350.0 FORMAT "%8.1" /end CHARACTERISTIC
/begin CHARACTERISTIC MeUnCD_DebShortCircBatOk_C "#SSD Heilungsentprellzeit Kurzschluss Batterie" VALUE 0xE3874 Kw_Wu16 655350.0 Time_ms 0.00 655350.0 FORMAT "%8.1" /end CHARACTERISTIC
/begin CHARACTERISTIC MeUnCD_DebShortCircGndDef_C "#SSD Fehlerentprellzeit Kurzschluss Masse" VALUE 0xE3876 Kw_Wu16 655350.0 Time_ms 0.00 655350.0 FORMAT "%8.1" /end CHARACTERISTIC
/begin CHARACTERISTIC MeUnCD_DebShortCircGndOk_C "#SSD Heilungsentprellzeit Kurzschluss Masse" VALUE 0xE3878 Kw_Wu16 655350.0 Time_ms 0.00 655350.0 FORMAT "%8.1" /end CHARACTERISTIC
/begin CHARACTERISTIC MeUnCD_DebSRCHighDef_C "#SSD Fehlerentprellzeit für Analogeingang SRC-High Fehler" VALUE 0xE387A Kw_Wu16 655350.0 Time_ms 0.00 655350.0 FORMAT "%8.1" /end CHARACTERISTIC
/begin CHARACTERISTIC MeUnCD_DebSRCHighOk_C "#SSD Heilungsentprellzeit für Analogeingang SRC-High Fehler" VALUE 0xE387C Kw_Wu16 655350.0 Time_ms 0.00 655350.0 FORMAT "%8.1" /end CHARACTERISTIC
/begin CHARACTERISTIC MeUnCD_DebSRCLowDef_C "#SSD Fehlerentprellzeit Analogeingang SRC-Low Fehler" VALUE 0xE387E Kw_Wu16 655350.0 Time_ms 0.00 655350.0 FORMAT "%8.1" /end CHARACTERISTIC
/begin CHARACTERISTIC MeUnCD_DebSRCLowOk_C "#SSD Heilungsentprellzeit für Analogeingang SRC-Low Fehler" VALUE 0xE3880 Kw_Wu16 655350.0 Time_ms 0.00 655350.0 FORMAT "%8.1" /end CHARACTERISTIC
/begin CHARACTERISTIC MeUnCD_facIGovInit_CUR "#SSD Initialisierungsfaktor für I-Anteil des Stromreglers als Funktion der Systemtemperatur" CURVE 0xE3882 Kl_Xs16_Ws16 2.000000 Fact 0.00 2.000000 FORMAT "%8.6" EXTENDED_LIMITS -4.000000 3.999878
 /begin AXIS_DESCR STD_AXIS FlSys_t Temp_Cels 3 -50.14000 199.8600 FORMAT "%8.4" EXTENDED_LIMITS -3549.940 3003.560 DEPOSIT ABSOLUTE /end AXIS_DESCR
/end CHARACTERISTIC
/begin CHARACTERISTIC MeUnCD_facIGovMax_C "#SSD maximaler I-Anteil" VALUE 0xE3890 Kw_Ws16 1.000000 Fact 1.000000 2.000000 FORMAT "%8.6" EXTENDED_LIMITS -4.000000 3.999878 /end CHARACTERISTIC
/begin CHARACTERISTIC MeUnCD_facIGovMin_C "#SSD minimaler I-Anteil" VALUE 0xE3892 Kw_Ws16 0.5000000 Fact 0.5000000 1.000000 FORMAT "%8.6" EXTENDED_LIMITS -4.000000 3.999878 /end CHARACTERISTIC
/begin CHARACTERISTIC MeUnCD_tiFlt1PT1_C "#SSD PT1 Filter Zeitkonstante für Strom-Istwert" VALUE 0xE3894 Kw_Wu32 4294.9673 TimeDelay_s 0.0000010000000 4294.9673 FORMAT "%9.4" /end CHARACTERISTIC
/begin CHARACTERISTIC MeUnCD_tiFlt2PT1_C "#SSD PT1 Filter Zeitkonstante für Strom-Sollwert" VALUE 0xE3898 Kw_Wu32 4294.9673 TimeDelay_s 0.0000010000000 4294.9673 FORMAT "%9.4" /end CHARACTERISTIC
/begin CHARACTERISTIC MeUnCD_tiIGovDT1_C "#SSD DT1 Zeitkonstante" VALUE 0xE389C Kw_Wu32 4294.9673 TimeDelay_s 0.0000010000000 4294.9673 FORMAT "%9.4" /end CHARACTERISTIC
/begin CHARACTERISTIC MeUnCD_IGovDKd_C "#SSD DT1 Differenziationsfaktor" VALUE 0xE38A0 Kw_Ws32 65535.9999847 Kd -32768.0000000 32767.9999847 FORMAT "%13.7" /end CHARACTERISTIC
/begin CHARACTERISTIC MeUnCD_IGovIKi_C "#SSD I-Glied, Kleinsignalverstärkung" VALUE 0xE38A4 Kw_Wu32 122.070312472 Ki_curr2fact 0.00 122.070312472 FORMAT "%13.9" /end CHARACTERISTIC
/begin CHARACTERISTIC MeUnCD_IGovIKiPos_C "#SSD I-Glied, Verstärkung für positive Großsignale" VALUE 0xE38A8 Kw_Wu32 122.070312472 Ki_curr2fact 0.00 122.070312472 FORMAT "%13.9" /end CHARACTERISTIC
/begin CHARACTERISTIC MeUnCD_IGovIKiNeg_C "#SSD I-Glied, Verstärkung für negative Großsignale" VALUE 0xE38AC Kw_Wu32 122.070312472 Ki_curr2fact 0.00 122.070312472 FORMAT "%13.9" /end CHARACTERISTIC
/begin CHARACTERISTIC MeUnCD_iIGovIWinPos_C "#SSD I-Glied, Kleinsignalfenster positiv" VALUE 0xE38B0 Kw_Ws16 65535.00 Curr -32768.00 32767.00 FORMAT "%8.2" /end CHARACTERISTIC
/begin CHARACTERISTIC MeUnCD_iIGovIWinNeg_C "#SSD I-Glied, Kleinsignalfenster negativ" VALUE 0xE38B2 Kw_Ws16 65535.00 Curr -32768.00 32767.00 FORMAT "%8.2" /end CHARACTERISTIC
/begin CHARACTERISTIC MeUnCD_tiFltPT1Init_C "#SSD PT1 Filter Zeitkonstante während Initialisierungsphase des Stromreglers" VALUE 0xE38B4 Kw_Wu32 4294.9673 TimeDelay_s 0.0000010000000 4294.9673 FORMAT "%9.4" /end CHARACTERISTIC
/begin CHARACTERISTIC MeUnCD_nDiffMax_C "#SSD maximale Differenz zwischen gefilterter Drehzahl für Kennlinie und aktueller Drehzahl um neuen Drehzahlwert zu übernehmen" VALUE 0xE38B8 Kw_Ws16 6000.000 EngN 0.00 6000.000 FORMAT "%8.3" EXTENDED_LIMITS -32768.00 32767.00 /end CHARACTERISTIC
/begin CHARACTERISTIC MeUnCD_numAdc_C "#SSD Parameter für die Auswahl des Analogkanals für die Zumesseinheit" VALUE 0xE38BA Kw_Wu8 44.0000000000 NumPinAdc 0.00 44.0000000000 FORMAT "%13.10" /end CHARACTERISTIC
/begin CHARACTERISTIC MeUnCD_numDia1_C "#SSD Parameter für Zuordnung der Diagnose zur 1. Endstufe der Zumesseinheit" VALUE 0xE38BB Kw_Wu8 34.0000000000 NumPinDia 0.00 34.0000000000 FORMAT "%13.10" /end CHARACTERISTIC
/begin CHARACTERISTIC MeUnCD_numDia2_C "#SSD Parameter für Zuordnung der Diagnose zur 2. Endstufe der Zumesseinheit" VALUE 0xE38BC Kw_Wu8 34.0000000000 NumPinDia 0.00 34.0000000000 FORMAT "%13.10" /end CHARACTERISTIC
/begin CHARACTERISTIC MeUnCD_numPwmOut_C "#SSD Parameter für die Auswahl des Hardware-Pins für die Zumesseinheit" VALUE 0xE38BD Kw_Wu8 12.0000000000 NumPinPwmOut 0.00 12.0000000000 FORMAT "%13.10" /end CHARACTERISTIC
/begin CHARACTERISTIC MeUnCD_resCoil_C "#SSD Widerstandswert der Spule für die Zumesseinheit" VALUE 0xE38BE Kw_Ws16 5000.000 Resist_1 0.00 5000.000 FORMAT "%8.3" EXTENDED_LIMITS -32768.00 32767.00 /end CHARACTERISTIC
/begin CHARACTERISTIC MeUnCD_stInvOut_C "#SSD Invertierungsparameter der PWM Endstufe" VALUE 0xE38C0 Kw_Wu8 1.000 OneToOne 0.00 1.000 FORMAT "%5.3" EXTENDED_LIMITS 0.00 255.0 /end CHARACTERISTIC
/begin CHARACTERISTIC MeUnCD_stPwrStgDia_C "#SSD Statuswort zur Spezifikation des Abschaltverhaltens der Endstufenfehlerdiagnose Zumesseinheit" VALUE 0xE38C1 Kw_Wu8 255.0 OneToOne 0.00 255.0 FORMAT "%5.1" /end CHARACTERISTIC
/begin CHARACTERISTIC MeUnCD_swt_C "#SSD allgemeine Schalterfunktionen der Endstufe für die Zumesseinheit" VALUE 0xE38C2 Kw_Wu8 255.0 OneToOne 0.00 255.0 FORMAT "%5.1" /end CHARACTERISTIC
/begin CHARACTERISTIC MeUnCD_tiBtwTst_C "#SSD Zeitabstand, in dem im Fehlerfall die Endstufe getestet wird" VALUE 0xE38C4 Kw_Wu16 29990.00 Time_ms 10.00000 30000.00 FORMAT "%8.2" EXTENDED_LIMITS 0.00 655350.0 /end CHARACTERISTIC
/begin CHARACTERISTIC MeUnCD_tiIGovInit_C "#SSD maximale Zeitdauer der Initialisierungsphase" VALUE 0xE38C6 Kw_Wu16 655350.0 Time_ms 0.00 655350.0 FORMAT "%8.1" /end CHARACTERISTIC
/begin CHARACTERISTIC MeUnCD_tiPer_CUR "#SSD Kennlinie für Periodendauer der PWM-Endstufe" CURVE 0xE38C8 Kl_Xs16_Ws16 6.400000 Period 0.1000000 6.500000 FORMAT "%8.6" EXTENDED_LIMITS -3276.800 3276.700
 /begin AXIS_DESCR STD_AXIS MeUnCD_nDiffRef_mp EngN 30 -32768.00 32767.00 FORMAT "%8.2" DEPOSIT ABSOLUTE /end AXIS_DESCR
/end CHARACTERISTIC
/begin CHARACTERISTIC MeUnCD_tiDebSigDefSigTst_C "Fehlerentprellzeit fuer Fehlerpfad Dfp_MeUnCD_SigTst" VALUE 0xE3942 Kw_Wu16 655350.0 Time_ms 0.00 655350.0 FORMAT "%8.1" /end CHARACTERISTIC
/begin CHARACTERISTIC MeUnCD_tiDebSigOkSigTst_C "Heilungsentprellzeit fuer Fehlerpfad Dfp_MeUnCD_SigTst" VALUE 0xE3944 Kw_Wu16 655350.0 Time_ms 0.00 655350.0 FORMAT "%8.1" /end CHARACTERISTIC
/begin CHARACTERISTIC MeUn_iCnvFlowRate_CUR "#SSD Kennlinie zur Umrechnung von Volumenstrom nach Strom" CURVE 0xE3812 Kl_Xs16_Ws16 5000.000 Curr 0.00 5000.000 FORMAT "%8.3" EXTENDED_LIMITS -32768.00 32767.00
 /begin AXIS_DESCR STD_AXIS Rail_dvolMeUnSet Qp_mm3_sec 10 -10000.00 50000.00 FORMAT "%8.2" EXTENDED_LIMITS -327680.0 327670.0 DEPOSIT ABSOLUTE /end AXIS_DESCR
/end CHARACTERISTIC
/begin CHARACTERISTIC MeUn_iSetMin_C "#SSD Sollstrom bei elektrischer Abschaltung der Zumesseinheit" VALUE 0xE383C Kw_Ws16 65535.00 Curr -32768.00 32767.00 FORMAT "%8.2" /end CHARACTERISTIC
/begin CHARACTERISTIC MeUn_iSet_Vector "#SSD Bypass-Label für MeUn_iSet (Nicht verstellen!)" VALUE 0xC2DFA Kw_Wu8 255.0 OneToOne 0.00 255.0 FORMAT "%5.1" /end CHARACTERISTIC
/begin CHARACTERISTIC MeUn_iSet_Channel "#SSD Bypass-Label für MeUn_iSet, nicht editieren !" VALUE 0xC2DFB Kw_Wu8 255.0 OneToOne 0.00 255.0 FORMAT "%5.1" /end CHARACTERISTIC
/begin CHARACTERISTIC MeUn_pActrPrt_C "#SSD Raildruckschwelle für die Freigabe der Stellerschutzfunktion" VALUE 0xE383E Kw_Ws16 6553.500 Pres_Rail -3276.800 3276.700 FORMAT "%5.3" /end CHARACTERISTIC
/begin CHARACTERISTIC MeUn_pFlowOfFl_C "#SSD Raildruckschwelle zum Rückschalten auf Stellwertvorgabe der Hochdruckregelung" VALUE 0xE3840 Kw_Ws16 6553.500 Pres_Rail -3276.800 3276.700 FORMAT "%5.3" /end CHARACTERISTIC
/begin CHARACTERISTIC MRlyCD_ctTooEarlyThres_C "#SSD Schwelle die MRlyCD_ctTooEarly_mp überschreiten muß bis Fehler Hauptrelais öffnet zu früh gemeldet wird" VALUE 0xE3948 Kw_Wu8 255.0 OneToOne 0.00 255.0 FORMAT "%5.1" /end CHARACTERISTIC
/begin CHARACTERISTIC MRlyCD_numDioOutMnRly_C "#SSD application parameter for main relay" VALUE 0xE3949 Kw_Wu8 10.0000000000 NumPinDioOut 0.00 10.0000000000 FORMAT "%13.10" /end CHARACTERISTIC
/begin CHARACTERISTIC MRlyCD_numDioOutPSOFF_C "#SSD application parameter for CY310 PSOFF bit" VALUE 0xE394A Kw_Wu8 10.0000000000 NumPinDioOut 0.00 10.0000000000 FORMAT "%13.10" /end CHARACTERISTIC
/begin CHARACTERISTIC MRlyCD_stInvOut_C "#SSD Invertierungsparameter für Hauptrelais Ausgangssignal" VALUE 0xE394B Kw_Wu8 1.000 OneToOne 0.00 1.000 FORMAT "%5.3" EXTENDED_LIMITS 0.00 255.0 READ_ONLY /end CHARACTERISTIC
/begin CHARACTERISTIC MRlyCD_tiNotOpen_C "#SSD Zeit nach dem Öffnen des Hauptrelais bis Fehler Hauptrelais öffnet nicht rechtzeitig erkannt wird" VALUE 0xE394C Kw_Wu16 655350.0 Time_ms 0.00 655350.0 FORMAT "%8.1" /end CHARACTERISTIC
/begin CHARACTERISTIC MSidCD_Comm_DebNplDef_C "#SSD Fehlererkennungszeit Fehler Plausibilisierung privater CAN" VALUE 0xE394E Kw_Wu16 655350.0 Time_ms 0.00 655350.0 FORMAT "%8.1" /end CHARACTERISTIC
/begin CHARACTERISTIC MSidCD_Comm_DebNplOk_C "Heilungszeit SG-Auswahl, Fehler Plausibilisierung privater CAN" VALUE 0xE3950 Kw_Wu16 655350.0 Time_ms 0.00 655350.0 FORMAT "%8.1" /end CHARACTERISTIC
/begin CHARACTERISTIC MSidCD_numECUS_C "#SSD Anzahl der ECU in diesem system: 1 - 4 (Master/Slave)" VALUE 0xE3952 Kw_Wu8 3.000 OneToOne 1.000 4.000 FORMAT "%5.3" EXTENDED_LIMITS 0.00 255.0 /end CHARACTERISTIC
/begin CHARACTERISTIC MSidCD_Pin_DebSigDef_C "Defekterkennungszeit SG-Asuwahl, Pinfehler" VALUE 0xE3954 Kw_Wu16 655350.0 Time_ms 0.00 655350.0 FORMAT "%8.1" /end CHARACTERISTIC
/begin CHARACTERISTIC MSidCD_Pin_DebSigOk_C "Heilungszeit SG-Auswahl, Pinfehler" VALUE 0xE3956 Kw_Wu16 655350.0 Time_ms 0.00 655350.0 FORMAT "%8.1" /end CHARACTERISTIC
/begin CHARACTERISTIC MSidCD_Select_DebNplDef_C "#SSD Defekterkennungszeit ECU Selection (Botschaften nicht plausibel)" VALUE 0xE3958 Kw_Wu16 655350.0 Time_ms 0.00 655350.0 FORMAT "%8.1" /end CHARACTERISTIC
/begin CHARACTERISTIC MSidCD_Select_DebNplOk_C "#SSD Heilungszeit SG-Auswahl (Botschaften nicht plausibel)" VALUE 0xE395A Kw_Wu16 655350.0 Time_ms 0.00 655350.0 FORMAT "%8.1" /end CHARACTERISTIC
/begin CHARACTERISTIC MSidCD_Sel_INI_DebNplDef_C "Defekterkennungszeit SG-Auswahl (NeuLernen ist nicht erlaubt)" VALUE 0xE395C Kw_Wu16 655350.0 Time_ms 0.00 655350.0 FORMAT "%8.1" /end CHARACTERISTIC
/begin CHARACTERISTIC MSidCD_Sel_INI_DebNplOk_C "Heilungszeit SG-Auswahl (NeuLernen ist nicht erlaubt)" VALUE 0xE395E Kw_Wu16 655350.0 Time_ms 0.00 655350.0 FORMAT "%8.1" /end CHARACTERISTIC
/begin CHARACTERISTIC MSidCD_Sel_INI_DebSigDef_C "Defekterkennungszeit SG-Auswahl (1.Plaus. am Beginn jedes Fahrzyklus)" VALUE 0xE3960 Kw_Wu16 655350.0 Time_ms 0.00 655350.0 FORMAT "%8.1" /end CHARACTERISTIC
/begin CHARACTERISTIC MSidCD_Sel_INI_DebSigOk_C "Heilungszeit SG-Auswahl (1.Plaus. am Beginn des Fahrzyklus)" VALUE 0xE3962 Kw_Wu16 655350.0 Time_ms 0.00 655350.0 FORMAT "%8.1" /end CHARACTERISTIC
/begin CHARACTERISTIC MSidCD_stCANprivErrMsk_C "Maske für Auswahl Error-Stati Kommunikation priv. CAN" VALUE 0xE3964 Kw_Wu16 255.0000 OneToOne 0.00 255.0000 FORMAT "%8.4" EXTENDED_LIMITS 0.00 65535.00 /end CHARACTERISTIC
/begin CHARACTERISTIC MSidCD_stErrInjOFF_C "#SSD Maske für Abschaltung Einspritzung im Fehlerfall SG-Auswahl" VALUE 0xE3966 Kw_Wu8 255.0 OneToOne 0.00 255.0 FORMAT "%5.1" /end CHARACTERISTIC
/begin CHARACTERISTIC MSidCD_stInv_C "Schalter zur Invertierung des digitalen Eingangsignals" VALUE 0xE3967 Kw_Wu8 1.000 OneToOne 0.00 1.000 FORMAT "%5.3" EXTENDED_LIMITS 0.00 255.0 /end CHARACTERISTIC
/begin CHARACTERISTIC MSidCD_swtCanDeb_C "#SSD Entprellmodus Zustandsautomat priv. CAN" VALUE 0xE3968 Kw_Ws8 255.0 OneToOne -128.0 127.0 FORMAT "%5.1" /end CHARACTERISTIC
/begin CHARACTERISTIC MSidCD_swtLearn_C "Schalter Lern-Modus Neulernen SG-Auswahl" VALUE 0xE3969 Kw_Ws8 255.0 OneToOne -128.0 127.0 FORMAT "%5.1" /end CHARACTERISTIC
/begin CHARACTERISTIC MSidCD_swtMAIN_C "#SSD ID SG-Auswahl (Master/Slave/SINGLE)" VALUE 0xE396A Kw_Ws8 255.0 OneToOne -128.0 127.0 FORMAT "%5.1" /end CHARACTERISTIC
/begin CHARACTERISTIC MSidCD_tiCanDeb_C "#SSD Entprelltimer Status privater CAN" VALUE 0xE396C Kw_Wu16 655350.0 Time_ms 0.00 655350.0 FORMAT "%8.1" /end CHARACTERISTIC
/begin CHARACTERISTIC NetMng_CANFadeOutMaskA_C "#SSD CAN-Ausblendmaske CAN A" VALUE 0xE3970 Kw_Wu8 255.0 OneToOne 0.00 255.0 FORMAT "%5.1" /end CHARACTERISTIC
/begin CHARACTERISTIC NetMng_CANFadeOutMaskB_C "#SSD CAN-Ausblendmaske CAN B" VALUE 0xE3971 Kw_Wu8 255.0 OneToOne 0.00 255.0 FORMAT "%5.1" /end CHARACTERISTIC
/begin CHARACTERISTIC NetMng_CANFadeOutMaskC_C "CAN-Ausblendmaske CAN C" VALUE 0xE3972 Kw_Wu8 255.0 OneToOne 0.00 255.0 FORMAT "%5.1" /end CHARACTERISTIC
/begin CHARACTERISTIC NetMng_ctBusOffRetriesA_C "#SSD Zählergrenze für Recoveries nach Busoff CAN A" VALUE 0xE3973 Kw_Wu8 255.0 OneToOne 0.00 255.0 FORMAT "%5.1" /end CHARACTERISTIC
/begin CHARACTERISTIC NetMng_ctBusOffRetriesB_C "#SSD Zählergrenze für Recoveries nach Busoff CAN B" VALUE 0xE3974 Kw_Wu8 255.0 OneToOne 0.00 255.0 FORMAT "%5.1" /end CHARACTERISTIC
/begin CHARACTERISTIC NetMng_ctBusOffRetriesC_C "Zählergrenze für Recoveries nach Busoff CAN C" VALUE 0xE3975 Kw_Wu8 255.0 OneToOne 0.00 255.0 FORMAT "%5.1" /end CHARACTERISTIC
/begin CHARACTERISTIC NetMng_ctInitRetryCanA_C "#SSD Zählergrenze für Initretries CAN A" VALUE 0xE3976 Kw_Wu8 255.0 OneToOne 0.00 255.0 FORMAT "%5.1" /end CHARACTERISTIC
/begin CHARACTERISTIC NetMng_ctInitRetryCanB_C "#SSD Zählergrenze für Initretries CAN B" VALUE 0xE3977 Kw_Wu8 255.0 OneToOne 0.00 255.0 FORMAT "%5.1" /end CHARACTERISTIC
/begin CHARACTERISTIC NetMng_ctInitRetryCanC_C "Zählergrenze für Initretries CAN C" VALUE 0xE3978 Kw_Wu8 255.0 OneToOne 0.00 255.0 FORMAT "%5.1" /end CHARACTERISTIC
/begin CHARACTERISTIC NetMng_tiDebPosBusMonCanA_C "#SSD Entprellzeit CAN-Ausblendung ein Can A" VALUE 0xE397A Kw_Wu16 2000.000 TimeDeb 0.00 2000.000 FORMAT "%8.3" EXTENDED_LIMITS 0.00 655350.0 /end CHARACTERISTIC
/begin CHARACTERISTIC NetMng_tiDebNegBusMonCanA_C "#SSD Entprellzeit CAN-Ausblendung aus Can A" VALUE 0xE397C Kw_Wu16 2000.000 TimeDeb 0.00 2000.000 FORMAT "%8.3" EXTENDED_LIMITS 0.00 655350.0 /end CHARACTERISTIC
/begin CHARACTERISTIC NetMng_tiDebPosBusMonCanB_C "#SSD Entprellzeit CAN-Ausblendung ein Can B" VALUE 0xE397E Kw_Wu16 2000.000 TimeDeb 0.00 2000.000 FORMAT "%8.3" EXTENDED_LIMITS 0.00 655350.0 /end CHARACTERISTIC
/begin CHARACTERISTIC NetMng_tiDebNegBusMonCanB_C "#SSD Entprellzeit CAN-Ausblendung aus Can B" VALUE 0xE3980 Kw_Wu16 2000.000 TimeDeb 0.00 2000.000 FORMAT "%8.3" EXTENDED_LIMITS 0.00 655350.0 /end CHARACTERISTIC
/begin CHARACTERISTIC NetMng_tiDebPosBusMonCanC_C "Entprellzeit CAN-Ausblendung ein Can C" VALUE 0xE3982 Kw_Wu16 2000.000 TimeDeb 0.00 2000.000 FORMAT "%8.3" EXTENDED_LIMITS 0.00 655350.0 /end CHARACTERISTIC
/begin CHARACTERISTIC NetMng_tiDebNegBusMonCanC_C "Entprellzeit CAN-Ausblendung aus Can C" VALUE 0xE3984 Kw_Wu16 2000.000 TimeDeb 0.00 2000.000 FORMAT "%8.3" EXTENDED_LIMITS 0.00 655350.0 /end CHARACTERISTIC
/begin CHARACTERISTIC NetMng_tiDebPosBusOffCanA_C "#SSD Defektzeit Busoff Can A" VALUE 0xE3986 Kw_Wu16 2000.000 TimeDeb 0.00 2000.000 FORMAT "%8.3" EXTENDED_LIMITS 0.00 655350.0 /end CHARACTERISTIC
/begin CHARACTERISTIC NetMng_tiDebNegBusOffCanA_C "#SSD Heilzeit Busoff Can A" VALUE 0xE3988 Kw_Wu16 2000.000 TimeDeb 0.00 2000.000 FORMAT "%8.3" EXTENDED_LIMITS 0.00 655350.0 /end CHARACTERISTIC
/begin CHARACTERISTIC NetMng_tiDebPosBusOffCanB_C "#SSD Defektzeit Busoff Can B" VALUE 0xE398A Kw_Wu16 2000.000 TimeDeb 0.00 2000.000 FORMAT "%8.3" EXTENDED_LIMITS 0.00 655350.0 /end CHARACTERISTIC
/begin CHARACTERISTIC NetMng_tiDebNegBusOffCanB_C "#SSD Heilzeit Busoff Can B" VALUE 0xE398C Kw_Wu16 2000.000 TimeDeb 0.00 2000.000 FORMAT "%8.3" EXTENDED_LIMITS 0.00 655350.0 /end CHARACTERISTIC
/begin CHARACTERISTIC NetMng_tiDebPosBusOffCanC_C "Defektzeit Busoff Can C" VALUE 0xE398E Kw_Wu16 2000.000 TimeDeb 0.00 2000.000 FORMAT "%8.3" EXTENDED_LIMITS 0.00 655350.0 /end CHARACTERISTIC
/begin CHARACTERISTIC NetMng_tiDebNegBusOffCanC_C "Heilzeit Busoff Can C" VALUE 0xE3990 Kw_Wu16 2000.000 TimeDeb 0.00 2000.000 FORMAT "%8.3" EXTENDED_LIMITS 0.00 655350.0 /end CHARACTERISTIC
/begin CHARACTERISTIC NetMng_tiDebPosErrCanA_C "#SSD Defektzeit ""error active"" Can A" VALUE 0xE3992 Kw_Wu16 2000.000 TimeDeb 0.00 2000.000 FORMAT "%8.3" EXTENDED_LIMITS 0.00 655350.0 /end CHARACTERISTIC
/begin CHARACTERISTIC NetMng_tiDebNegErrCanA_C "#SSD Heilzeit ""error active"" Can A" VALUE 0xE3994 Kw_Wu16 2000.000 TimeDeb 0.00 2000.000 FORMAT "%8.3" EXTENDED_LIMITS 0.00 655350.0 /end CHARACTERISTIC
/begin CHARACTERISTIC NetMng_tiDebPosErrCanB_C "#SSD Defektzeit ""error active"" Can B" VALUE 0xE3996 Kw_Wu16 2000.000 TimeDeb 0.00 2000.000 FORMAT "%8.3" EXTENDED_LIMITS 0.00 655350.0 /end CHARACTERISTIC
/begin CHARACTERISTIC NetMng_tiDebNegErrCanB_C "#SSD Heilzeit ""error active"" Can B" VALUE 0xE3998 Kw_Wu16 2000.000 TimeDeb 0.00 2000.000 FORMAT "%8.3" EXTENDED_LIMITS 0.00 655350.0 /end CHARACTERISTIC
/begin CHARACTERISTIC NetMng_tiDebPosErrCanC_C "Defektzeit ""error active"" Can C" VALUE 0xE399A Kw_Wu16 2000.000 TimeDeb 0.00 2000.000 FORMAT "%8.3" EXTENDED_LIMITS 0.00 655350.0 /end CHARACTERISTIC
/begin CHARACTERISTIC NetMng_tiDebNegErrCanC_C "Heilzeit ""error active"" Can C" VALUE 0xE399C Kw_Wu16 2000.000 TimeDeb 0.00 2000.000 FORMAT "%8.3" EXTENDED_LIMITS 0.00 655350.0 /end CHARACTERISTIC
/begin CHARACTERISTIC NetMng_tiDebPosMonCanA_C "#SSD Entprellzeit Ausblendung für SW ein Can A" VALUE 0xE399E Kw_Wu16 2000.000 TimeDeb 0.00 2000.000 FORMAT "%8.3" EXTENDED_LIMITS 0.00 655350.0 /end CHARACTERISTIC
/begin CHARACTERISTIC NetMng_tiDebNegMonCanA_C "#SSD Entprellzeit Ausblendung für SW aus Can A" VALUE 0xE39A0 Kw_Wu16 2000.000 TimeDeb 0.00 2000.000 FORMAT "%8.3" EXTENDED_LIMITS 0.00 655350.0 /end CHARACTERISTIC
/begin CHARACTERISTIC NetMng_tiDebPosMonCanB_C "#SSD Entprellzeit Ausblendung für SW ein Can B" VALUE 0xE39A2 Kw_Wu16 2000.000 TimeDeb 0.00 2000.000 FORMAT "%8.3" EXTENDED_LIMITS 0.00 655350.0 /end CHARACTERISTIC
/begin CHARACTERISTIC NetMng_tiDebNegMonCanB_C "#SSD Entprellzeit Ausblendung für SW aus Can B" VALUE 0xE39A4 Kw_Wu16 2000.000 TimeDeb 0.00 2000.000 FORMAT "%8.3" EXTENDED_LIMITS 0.00 655350.0 /end CHARACTERISTIC
/begin CHARACTERISTIC NetMng_tiDebPosMonCanC_C "Entprellzeit Ausblendung für SW ein Can C" VALUE 0xE39A6 Kw_Wu16 2000.000 TimeDeb 0.00 2000.000 FORMAT "%8.3" EXTENDED_LIMITS 0.00 655350.0 /end CHARACTERISTIC
/begin CHARACTERISTIC NetMng_tiDebNegMonCanC_C "Entprellzeit Ausblendung für SW aus Can C" VALUE 0xE39A8 Kw_Wu16 2000.000 TimeDeb 0.00 2000.000 FORMAT "%8.3" EXTENDED_LIMITS 0.00 655350.0 /end CHARACTERISTIC
/begin CHARACTERISTIC NetMng_FadeOutMaskA_C "#SSD SW-Ausblendmaske CAN A" VALUE 0xE39AA Kw_Wu16 65535.00 OneToOne 0.00 65535.00 FORMAT "%8.2" /end CHARACTERISTIC
/begin CHARACTERISTIC NetMng_FadeOutMaskB_C "#SSD SW-Ausblendmaske CAN B" VALUE 0xE39AC Kw_Wu16 65535.00 OneToOne 0.00 65535.00 FORMAT "%8.2" /end CHARACTERISTIC
/begin CHARACTERISTIC NetMng_FadeOutMaskC_C "SW-Ausblendmaske CAN C" VALUE 0xE39AE Kw_Wu16 65535.00 OneToOne 0.00 65535.00 FORMAT "%8.2" /end CHARACTERISTIC
/begin CHARACTERISTIC NetMng_SplyVltgHysXLow_C "Untere Grenze Hysterese Versorgungsspannung" VALUE 0xE39B0 Kw_Ws16 13998.04 Volt_Batt 0.00 13998.04 FORMAT "%8.2" EXTENDED_LIMITS -640625.6 640606.1 /end CHARACTERISTIC
/begin CHARACTERISTIC NetMng_SplyVltgHysXHigh_C "Obere Grenze Hysterese Versorgungsspannung" VALUE 0xE39B2 Kw_Ws16 13998.04 Volt_Batt 0.00 13998.04 FORMAT "%8.2" EXTENDED_LIMITS -640625.6 640606.1 /end CHARACTERISTIC
/begin CHARACTERISTIC NetMng_SplyVltgHysYLow_C "#SSD Unterer Ausgangswert Hysterese Versorgungsspannung" VALUE 0xE39B4 Kw_Ws16 0.00 OneToOne 1.000000 1.000000 FORMAT "%8.6" EXTENDED_LIMITS -32768.00 32767.00 READ_ONLY /end CHARACTERISTIC
/begin CHARACTERISTIC NetMng_SplyVltgHysYHigh_C "#SSD Oberer Ausgangswert Hysterese Versorgungsspannung" VALUE 0xE39B6 Kw_Ws16 0.00 OneToOne 0.00 0.00 FORMAT "%8.2" EXTENDED_LIMITS -32768.00 32767.00 READ_ONLY /end CHARACTERISTIC
/begin CHARACTERISTIC NetMng_swtONWM_C "#SSD Enable/disable OSEK Netzwerkmanagement" VALUE 0xE396E Kw_Wu8 1.000 OneToOne 0.00 1.000 FORMAT "%5.3" EXTENDED_LIMITS 0.00 255.0 /end CHARACTERISTIC
/begin CHARACTERISTIC NetMng_tiFadeoutLowBat_C "#SSD Ausblendzeit nach Unterspannung Versorgung" VALUE 0xE39B8 Kw_Wu16 327670.0 Time_ms 0.00 327670.0 FORMAT "%8.1" EXTENDED_LIMITS 0.00 655350.0 /end CHARACTERISTIC
/begin CHARACTERISTIC NetMng_tiFadeoutMin_C "Ausblendzeit nach Initialisierung" VALUE 0xE39BA Kw_Wu16 327670.0 Time_ms 0.00 327670.0 FORMAT "%8.1" EXTENDED_LIMITS 0.00 655350.0 /end CHARACTERISTIC
/begin CHARACTERISTIC NetMng_tiRecoverA_C "#SSD Zeit zwischen den Recoveries Can A" VALUE 0xE39BC Kw_Wu16 327670.0 Time_ms 0.00 327670.0 FORMAT "%8.1" EXTENDED_LIMITS 0.00 655350.0 /end CHARACTERISTIC
/begin CHARACTERISTIC NetMng_tiRecoverB_C "#SSD Zeit zwischen den Recoveries Can B" VALUE 0xE39BE Kw_Wu16 327670.0 Time_ms 0.00 327670.0 FORMAT "%8.1" EXTENDED_LIMITS 0.00 655350.0 /end CHARACTERISTIC
/begin CHARACTERISTIC NetMng_tiRecoverC_C "Zeit zwischen den Recoveries Can C" VALUE 0xE39C0 Kw_Wu16 327670.0 Time_ms 0.00 327670.0 FORMAT "%8.1" EXTENDED_LIMITS 0.00 655350.0 /end CHARACTERISTIC
/begin CHARACTERISTIC NetMng_tiTimeoutDNMT_C "Timeout for Tester Present after Disable Normal Message Transmission" VALUE 0xE39C2 Kw_Wu16 16000.00 Time_ms 0.00 16000.00 FORMAT "%8.2" EXTENDED_LIMITS 0.00 655350.0 /end CHARACTERISTIC
/begin CHARACTERISTIC NSC_numPrio_C "#SSD Applikationswert für Testzwecke" VALUE 0xE39C4 Kw_Wu16 65535.00 OneToOne 0.00 65535.00 FORMAT "%8.2" /end CHARACTERISTIC
/begin CHARACTERISTIC NSC_st_C "#SSD Applikationswert für Testzwecke" VALUE 0xE39C8 Kw_Wu32 4294967295.00 OneToOne 0.00 4294967295.00 FORMAT "%13.2" /end CHARACTERISTIC
/begin CHARACTERISTIC OPSCD_uSRCMin_C "#SSD Threshold low value for SRC low error : Oil pressure sensor" VALUE 0xE39FC Kw_Ws16 5200.391 Volt 0.00 5200.391 FORMAT "%8.3" EXTENDED_LIMITS -160156.4 160151.5 /end CHARACTERISTIC
/begin CHARACTERISTIC OPSCD_uSRCMax_C "#SSD Threshold high value for SRC High error: Oil pressure sensor" VALUE 0xE39FE Kw_Ws16 5200.391 Volt 0.00 5200.391 FORMAT "%8.3" EXTENDED_LIMITS -160156.4 160151.5 /end CHARACTERISTIC
/begin CHARACTERISTIC OPSCD_pLin_CUR "Linearization curve : oil pressure sensor" CURVE 0xE3A00 Kl_Xs16_Ws16 1.000000 OneToOne 0.00 1.000000 FORMAT "%8.6" EXTENDED_LIMITS -32768.00 32767.00
 /begin AXIS_DESCR STD_AXIS OPSCD_uRaw_POEL_mp Volt 25 0.00 5200.391 FORMAT "%8.3" EXTENDED_LIMITS -160156.4 160151.5 DEPOSIT ABSOLUTE /end AXIS_DESCR
/end CHARACTERISTIC
/begin CHARACTERISTIC OPSCD_aMin_C "Geschwindugkeitsschwelle bei ABS - Bremsung" VALUE 0xE39CC Kw_Ws16 65.53500 Acc -32.76800 32.76700 FORMAT "%8.5" /end CHARACTERISTIC
/begin CHARACTERISTIC OPSCD_DebSRCHiDef_C "Error debounce for SRC-High error" VALUE 0xE3A66 Kw_Wu16 655350.0 Time_ms 0.00 655350.0 FORMAT "%8.1" /end CHARACTERISTIC
/begin CHARACTERISTIC OPSCD_DebSRCHiOk_C "Healing debounce for SRC-High error" VALUE 0xE3A68 Kw_Wu16 655350.0 Time_ms 0.00 655350.0 FORMAT "%8.1" /end CHARACTERISTIC
/begin CHARACTERISTIC OPSCD_DebSRCLoDef_C "#SSD Error debounce for SRC-Low error" VALUE 0xE3A6A Kw_Wu16 655350.0 Time_ms 0.00 655350.0 FORMAT "%8.1" /end CHARACTERISTIC
/begin CHARACTERISTIC OPSCD_DebSRCLoOk_C "Healing debounce for SRC-Low error" VALUE 0xE3A6C Kw_Wu16 655350.0 Time_ms 0.00 655350.0 FORMAT "%8.1" /end CHARACTERISTIC
/begin CHARACTERISTIC OPSCD_dtRmpSlpUp_C "Ramp slope up parameter" VALUE 0xE3A70 Kw_Wu32 65535999.9847 RmpPres 0.00 65535999.9847 FORMAT "%14.4" /end CHARACTERISTIC
/begin CHARACTERISTIC OPSCD_dtRmpSlpDwn_C "Ramp slope down parameter" VALUE 0xE3A74 Kw_Wu32 65535999.9847 RmpPres 0.00 65535999.9847 FORMAT "%14.4" /end CHARACTERISTIC
/begin CHARACTERISTIC OPSCD_LampDebExcTempDef_C "endstufen fehlerentprellung" VALUE 0xE39CE Kw_Wu16 655350.0 Time_ms 0.00 655350.0 FORMAT "%8.1" /end CHARACTERISTIC
/begin CHARACTERISTIC OPSCD_LampDebExcTempOk_C "Endstufen Fehlerentprellung" VALUE 0xE39D0 Kw_Wu16 655350.0 Time_ms 0.00 655350.0 FORMAT "%8.1" /end CHARACTERISTIC
/begin CHARACTERISTIC OPSCD_LampDebNoLoadDef_C "endstufen fehlerentprellung" VALUE 0xE39D2 Kw_Wu16 655350.0 Time_ms 0.00 655350.0 FORMAT "%8.1" /end CHARACTERISTIC
/begin CHARACTERISTIC OPSCD_LampDebNoLoadOk_C "Endstufen Fehlerentprellung" VALUE 0xE39D4 Kw_Wu16 655350.0 Time_ms 0.00 655350.0 FORMAT "%8.1" /end CHARACTERISTIC
/begin CHARACTERISTIC OPSCD_LampDebShortCircBatDef_C "endstufen fehlerentprellung" VALUE 0xE39D6 Kw_Wu16 655350.0 Time_ms 0.00 655350.0 FORMAT "%8.1" /end CHARACTERISTIC
/begin CHARACTERISTIC OPSCD_LampDebShortCircBatOk_C "Endstufen Fehlerentprellung" VALUE 0xE39D8 Kw_Wu16 655350.0 Time_ms 0.00 655350.0 FORMAT "%8.1" /end CHARACTERISTIC
/begin CHARACTERISTIC OPSCD_LampDebShortCircGndDef_C "Endstufen Fehlerentprellung" VALUE 0xE39DA Kw_Wu16 655350.0 Time_ms 0.00 655350.0 FORMAT "%8.1" /end CHARACTERISTIC
/begin CHARACTERISTIC OPSCD_LampDebShortCircGndOk_C "Endstufen Fehlerentprellung" VALUE 0xE39DC Kw_Wu16 655350.0 Time_ms 0.00 655350.0 FORMAT "%8.1" /end CHARACTERISTIC
/begin CHARACTERISTIC OPSCD_nStart1_C "Drehzahlschwelle bei Start" VALUE 0xE39DE Kw_Ws16 5960.000 EngN 40.00000 6000.000 FORMAT "%8.3" EXTENDED_LIMITS -32768.00 32767.00 /end CHARACTERISTIC
/begin CHARACTERISTIC OPSCD_nStart2_C "Drehzahlschwelle bei Start" VALUE 0xE39E0 Kw_Ws16 5960.000 EngN 40.00000 6000.000 FORMAT "%8.3" EXTENDED_LIMITS -32768.00 32767.00 /end CHARACTERISTIC
/begin CHARACTERISTIC OPSCD_numAdc_C "#SSD application parameter for Engine Oil Pressure input" VALUE 0xE3A78 Kw_Wu8 44.0000000000 NumPinAdc 0.00 44.0000000000 FORMAT "%13.10" /end CHARACTERISTIC
/begin CHARACTERISTIC OPSCD_numDia_C "#SSD application parameter for Oil Pressure Lamp Switch" VALUE 0xE39E2 Kw_Wu8 34.0000000000 NumPinDia 0.00 34.0000000000 FORMAT "%13.10" /end CHARACTERISTIC
/begin CHARACTERISTIC OPSCD_numDioOut_C "#SSD application parameter for DPF_Regeneration" VALUE 0xE39E3 Kw_Wu8 10.0000000000 NumPinDioOut 0.00 10.0000000000 FORMAT "%13.10" /end CHARACTERISTIC
/begin CHARACTERISTIC OPSCD_nZero_C "engine speed value threshold in starting case" VALUE 0xE39E4 Kw_Ws16 5960.000 EngN 40.00000 6000.000 FORMAT "%8.3" EXTENDED_LIMITS -32768.00 32767.00 /end CHARACTERISTIC
/begin CHARACTERISTIC OPSCD_stLampInvOut_C "Zustand der Öldrucklampe invertiert" VALUE 0xE39E6 Kw_Wu8 1.000 OneToOne 0.00 1.000 FORMAT "%5.3" EXTENDED_LIMITS 0.00 255.0 /end CHARACTERISTIC
/begin CHARACTERISTIC OPSCD_stPwrStgLampDia_C "Spezifikation des Abschaltverhaltens der Endstufendiagnose" VALUE 0xE39E7 Kw_Wu8 255.0 OneToOne 0.00 255.0 FORMAT "%5.1" /end CHARACTERISTIC
/begin CHARACTERISTIC OPSCD_swtBN2000_C "switch control  for selecting OPSCD_stInactive" VALUE 0xE39E8 Kw_Wu8 1.000 OneToOne 0.00 1.000 FORMAT "%5.3" EXTENDED_LIMITS 0.00 255.0 /end CHARACTERISTIC
/begin CHARACTERISTIC OPSCD_swtStart_C "Schalter - Drehzahlschwelle/ Drehzahlschwelle/Zeitschwelle" VALUE 0xE39E9 Kw_Wu8 1.000 OneToOne 0.00 1.000 FORMAT "%5.3" EXTENDED_LIMITS 0.00 255.0 /end CHARACTERISTIC
/begin CHARACTERISTIC OPSCD_tiABSDebNeg_C "Entprellzeit bei ABS-Bremsung pos. edge" VALUE 0xE39EA Kw_Wu16 655350.0 TimeDeb 0.00 655350.0 FORMAT "%8.1" /end CHARACTERISTIC
/begin CHARACTERISTIC OPSCD_tiABSDebPos_C "Entprellzeit bei ABS bremsung" VALUE 0xE39EC Kw_Wu16 655350.0 TimeDeb 0.00 655350.0 FORMAT "%8.1" /end CHARACTERISTIC
/begin CHARACTERISTIC OPSCD_tiDelayAftKL50_C "status word for timer (time threshold in debounce T50CD case)" VALUE 0xE39EE Kw_Wu16 30000.00 Time_ms 0.00 30000.00 FORMAT "%8.2" EXTENDED_LIMITS 0.00 655350.0 /end CHARACTERISTIC
/begin CHARACTERISTIC OPSCD_tiInactiv1_C "Abschaltzeit bei ABS bremsung" VALUE 0xE39F0 Kw_Wu16 655350.0 Time_ms 0.00 655350.0 FORMAT "%8.1" /end CHARACTERISTIC
/begin CHARACTERISTIC OPSCD_tiInactiv2_C "Abschaltzeit im Startfall" VALUE 0xE39F2 Kw_Wu16 655350.0 Time_ms 0.00 655350.0 FORMAT "%8.1" /end CHARACTERISTIC
/begin CHARACTERISTIC OPSCD_tipOELDebNeg_C "debounce time for negative edge of glow control unit feedback" VALUE 0xE39F4 Kw_Wu16 655350.0 TimeDeb 0.00 655350.0 FORMAT "%8.1" /end CHARACTERISTIC
/begin CHARACTERISTIC OPSCD_tipOELDebPos_C "debounce time for positive edge of glow control unit feedback" VALUE 0xE39F6 Kw_Wu16 655350.0 TimeDeb 0.00 655350.0 FORMAT "%8.1" /end CHARACTERISTIC
/begin CHARACTERISTIC OPSCD_tiStart1_C "Zeitschwelle im Startfall" VALUE 0xE39F8 Kw_Wu16 655350.0 Time_ms 0.00 655350.0 FORMAT "%8.1" /end CHARACTERISTIC
/begin CHARACTERISTIC OPSCD_stSensIDWord_C "ID-Word for transition stage for oil pressure" VALUE 0xE3A7A Kw_Wu16 65535.00 OneToOne 0.00 65535.00 FORMAT "%8.2" /end CHARACTERISTIC
/begin CHARACTERISTIC OPSCD_stPDfl_C "default value if error" VALUE 0xE3A7C Kw_Ws16 1.000000 OneToOne 0.00 1.000000 FORMAT "%8.6" EXTENDED_LIMITS -32768.00 32767.00 /end CHARACTERISTIC
/begin CHARACTERISTIC OPSCD_vMin_C "Geschwindigkeitsschwelle bei ABS Bremsung" VALUE 0xE39FA Kw_Ws16 655.3500 Vel -327.6800 327.6700 FORMAT "%8.4" /end CHARACTERISTIC
/begin CHARACTERISTIC OTSCD_uSRCMin_C "#SSD Minimalwert für SRC OTF-Sensor" VALUE 0xE3A80 Kw_Ws16 5200.391 Volt 0.00 5200.391 FORMAT "%8.3" EXTENDED_LIMITS -160156.4 160151.5 /end CHARACTERISTIC
/begin CHARACTERISTIC OTSCD_uSRCMax_C "#SSD Maximalwert für SRC OTF-Sensor" VALUE 0xE3A82 Kw_Ws16 5200.391 Volt 0.00 5200.391 FORMAT "%8.3" EXTENDED_LIMITS -160156.4 160151.5 /end CHARACTERISTIC
/begin CHARACTERISTIC OTSCD_tLin_CUR "Linearisierungskennlinie für OTF-Sensor" CURVE 0xE3A84 Kl_Xs16_Ws16 950.0000 Temp_Cels -50.1400 899.8600 FORMAT "%8.4" EXTENDED_LIMITS -3549.940 3003.560
 /begin AXIS_DESCR STD_AXIS OTSCD_uRaw Volt 2 0.00 5200.391 FORMAT "%8.3" EXTENDED_LIMITS -160156.4 160151.5 DEPOSIT ABSOLUTE /end AXIS_DESCR
/end CHARACTERISTIC
/begin CHARACTERISTIC OTSCD_DebNplDef_C "#SSD OTS Fehlerentprellzeit fuer Plausibilitaet" VALUE 0xE3A8E Kw_Wu16 655350.0 Time_ms 0.00 655350.0 FORMAT "%8.1" /end CHARACTERISTIC
/begin CHARACTERISTIC OTSCD_DebNplOk_C "OTS Heilungsentprellzeit fuer Plausibilitaet" VALUE 0xE3A90 Kw_Wu16 655350.0 Time_ms 0.00 655350.0 FORMAT "%8.1" /end CHARACTERISTIC
/begin CHARACTERISTIC OTSCD_DebSigDef_C "#SSD Fehlerentprellzeit für Öltemperatur Signal von CAN" VALUE 0xE3A92 Kw_Wu16 655350.0 Time_ms 0.00 655350.0 FORMAT "%8.1" /end CHARACTERISTIC
/begin CHARACTERISTIC OTSCD_DebSigOk_C "Heilungsentprellzeit für Öltemperatur Signal von CAN" VALUE 0xE3A94 Kw_Wu16 655350.0 Time_ms 0.00 655350.0 FORMAT "%8.1" /end CHARACTERISTIC
/begin CHARACTERISTIC OTSCD_DebSRCHighDef_C "#SSD OTS Fehlerentprellzeit fuer SRC-High" VALUE 0xE3A96 Kw_Wu16 655350.0 Time_ms 0.00 655350.0 FORMAT "%8.1" /end CHARACTERISTIC
/begin CHARACTERISTIC OTSCD_DebSRCHighOk_C "OTS Heilungsentprellzeit fuer SRC-High" VALUE 0xE3A98 Kw_Wu16 655350.0 Time_ms 0.00 655350.0 FORMAT "%8.1" /end CHARACTERISTIC
/begin CHARACTERISTIC OTSCD_DebSRCLowDef_C "#SSD OTS Fehlerentprellzeit fuer SRC-Low" VALUE 0xE3A9A Kw_Wu16 655350.0 Time_ms 0.00 655350.0 FORMAT "%8.1" /end CHARACTERISTIC
/begin CHARACTERISTIC OTSCD_DebSRCLowOk_C "OTS Heilungsentprellzeit fuer SRC-Low" VALUE 0xE3A9C Kw_Wu16 655350.0 Time_ms 0.00 655350.0 FORMAT "%8.1" /end CHARACTERISTIC
/begin CHARACTERISTIC OTSCD_numAdc_C "#SSD application paramter for engine oil temperature sensor" VALUE 0xE3A9E Kw_Wu8 44.0000000000 NumPinAdc 0.00 44.0000000000 FORMAT "%13.10" /end CHARACTERISTIC
/begin CHARACTERISTIC OTSCD_tiStrtOilClntPlaus_C "Zeit nach Start für Plausibilitätsprüfung OTF mit WTF" VALUE 0xE3AA0 Kw_Wu32 42949672.9500 Time_s 0.00 42949672.9500 FORMAT "%13.4" /end CHARACTERISTIC
/begin CHARACTERISTIC OTSCD_tiDelOilClntPlaus_C "Verzögerungszeit für Plausibilitätsprüfung OTF mit WTF" VALUE 0xE3AA4 Kw_Wu32 42949672.9500 Time_s 0.00 42949672.9500 FORMAT "%13.4" /end CHARACTERISTIC
/begin CHARACTERISTIC OTSCD_tThresOilClntPlaus_C "Schwelle für Plausibilitätsprüfung OTF mit WTF" VALUE 0xE3AA8 Kw_Ws16 950.000 Temp_Cels -50.140 899.860 FORMAT "%8.3" EXTENDED_LIMITS -3549.940 3003.560 /end CHARACTERISTIC
/begin CHARACTERISTIC OTSCD_tLimOilClntPlaus_C "Plausibilitaets-Fehlergrenze fuer die Oeltemperatur" VALUE 0xE3AAA Kw_Ws16 950.000 Temp_Cels -50.140 899.860 FORMAT "%8.3" EXTENDED_LIMITS -3549.940 3003.560 /end CHARACTERISTIC
/begin CHARACTERISTIC OTSCD_dtRmpSlpUp_C "Rampensteigung bei Heilung/Vorgabewert für OTF" VALUE 0xE3AAC Kw_Wu32 6553598.99749 RmpTemp 1.00097656250 6553599.99847 FORMAT "%13.5" EXTENDED_LIMITS 0.00 6553599.99847 /end CHARACTERISTIC
/begin CHARACTERISTIC OTSCD_dtRmpSlpDwn_C "Rampensteigung bei Heilung/Vorgabewert für OTF" VALUE 0xE3AB0 Kw_Wu32 6553598.99749 RmpTemp 1.00097656250 6553599.99847 FORMAT "%13.5" EXTENDED_LIMITS 0.00 6553599.99847 /end CHARACTERISTIC
/begin CHARACTERISTIC OTSCD_swtSigVal_C "Schalterwert, Signal von ADC/CAN" VALUE 0xE3AB4 Kw_Wu8 1.000 OneToOne 0.00 1.000 FORMAT "%5.3" EXTENDED_LIMITS 0.00 255.0 /end CHARACTERISTIC
/begin CHARACTERISTIC OTSCD_stSensIDWord_C "Geberkennwort OTF-Sensor" VALUE 0xE3AB6 Kw_Wu16 65535.00 OneToOne 0.00 65535.00 FORMAT "%8.2" /end CHARACTERISTIC
/begin CHARACTERISTIC OTSCD_tDfl_C "Öltemperatur Vorgabewert" VALUE 0xE3AB8 Kw_Ws16 950.0000 Temp_Cels -50.1400 899.8600 FORMAT "%8.4" EXTENDED_LIMITS -3549.940 3003.560 /end CHARACTERISTIC
/begin CHARACTERISTIC OvRMon_ctEngSpdGrad_C "#SSD Zähler zum Erkennen eines positiven Drehzahlgradients" VALUE 0xC2E22 Kw_Wu16 65535.00 OneToOne 0.00 65535.00 FORMAT "%8.2" /end CHARACTERISTIC
/begin CHARACTERISTIC OvRMon_DebETDef_C "#SSD Defekt Entprellzeit wenn Ansteuerdauer größer Grenzwert" VALUE 0xC2E24 Kw_Wu16 65535.00 OneToOne 0.00 65535.00 FORMAT "%8.2" /end CHARACTERISTIC
/begin CHARACTERISTIC OvRMon_DebBrkPlaDef_C "error debounce time for plaus error" VALUE 0xE3ABC Kw_Wu16 655350.0 Time_ms 0.00 655350.0 FORMAT "%8.1" /end CHARACTERISTIC
/begin CHARACTERISTIC OvRMon_DebBrkPlaOk_C "healing  debounce time for plaus error" VALUE 0xE3ABE Kw_Wu16 655350.0 Time_ms 0.00 655350.0 FORMAT "%8.1" /end CHARACTERISTIC
/begin CHARACTERISTIC OvRMon_DebBrkSigDef_C "Error debounce time for CAN Msg. Sig error" VALUE 0xE3AC0 Kw_Wu16 655350.0 Time_ms 0.00 655350.0 FORMAT "%8.1" /end CHARACTERISTIC
/begin CHARACTERISTIC OvRMon_DebBrkSigOk_C "Healing debounce time for CAN Msg. Sig error" VALUE 0xE3AC2 Kw_Wu16 655350.0 Time_ms 0.00 655350.0 FORMAT "%8.1" /end CHARACTERISTIC
/begin CHARACTERISTIC OvRMon_DebSigA0Def_C "#SSD Defekterkennungszeit für Drehzahlplausibilisierung in Schubüberwachung" VALUE 0xC2E5C Kw_Wu16 655350.0 TimeDeb 0.00 655350.0 FORMAT "%8.1" /end CHARACTERISTIC
/begin CHARACTERISTIC OvRMon_facInjEff_MAP "#SSD Wirkungsfaktorkennfeld in der Schubüberwachung" MAP 0xC2E6C Kf_Xs16_Ys16_Ws16 1.000000 Fact 0.00 1.000000 FORMAT "%8.6" EXTENDED_LIMITS -4.000000 3.999878
 /begin AXIS_DESCR STD_AXIS Eng_nAvrg EngN 16 0.00 6000.000 FORMAT "%8.3" EXTENDED_LIMITS -32768.00 32767.00 DEPOSIT ABSOLUTE /end AXIS_DESCR
 /begin AXIS_DESCR STD_AXIS OvRMon_phiInjAct_mp AngleCrS 12 -720.0000 720.0000 FORMAT "%8.4" EXTENDED_LIMITS -768.0000 767.9766 DEPOSIT ABSOLUTE /end AXIS_DESCR
/end CHARACTERISTIC
/begin CHARACTERISTIC OvRMon_tiBrkMnSwtDebNeg_C "debounce time for falling edge of main brake switch" VALUE 0xE3AC4 Kw_Wu16 655350.0 TimeDeb 0.00 655350.0 FORMAT "%8.1" /end CHARACTERISTIC
/begin CHARACTERISTIC OvRMon_tiBrkMnSwtDebPos_C "#SSD debounce time for rising edge of main brake switch" VALUE 0xE3AC6 Kw_Wu16 655350.0 TimeDeb 0.00 655350.0 FORMAT "%8.1" /end CHARACTERISTIC
/begin CHARACTERISTIC OvRMon_nDiffMax_C "#SSD Maximal zulässige Abweichung der Drehzahlen Ebene1 - Ebene 2" VALUE 0xC2E5E Kw_Ws16 5960.000 EngN 40.00000 6000.000 FORMAT "%8.3" EXTENDED_LIMITS -32768.00 32767.00 /end CHARACTERISTIC
/begin CHARACTERISTIC OvRMon_nLIGovLim_C "#SSD Grenze Kurbelwellen Drehzahl für aktive Leerlaufregler Überwachung" VALUE 0xC2E26 Kw_Ws16 6000.000 EngN 0.00 6000.000 FORMAT "%8.3" EXTENDED_LIMITS -32768.00 32767.00 /end CHARACTERISTIC
/begin CHARACTERISTIC OvRMon_nSegMax_C "#SSD Ersatzwert für Segmentdrehzahl bei Unterschreitung der Mindestsegmentdauer" VALUE 0xC2E60 Kw_Ws16 5960.000 EngN 40.00000 6000.000 FORMAT "%8.3" EXTENDED_LIMITS -32768.00 32767.00 /end CHARACTERISTIC
/begin CHARACTERISTIC OvRMon_nSegMin_C "#SSD Mindestdrehzahl zur Aktivierung der Drehzahlplausibilisierung" VALUE 0xC2E62 Kw_Ws16 5960.000 EngN 40.00000 6000.000 FORMAT "%8.3" EXTENDED_LIMITS -32768.00 32767.00 /end CHARACTERISTIC
/begin CHARACTERISTIC OvRMon_nStSysLim_C "#SSD Grenze Kurbelwellen Drehzahl für aktive Startsystem Überwachung" VALUE 0xC2E28 Kw_Ws16 6000.000 EngN 0.00 6000.000 FORMAT "%8.3" EXTENDED_LIMITS -32768.00 32767.00 /end CHARACTERISTIC
/begin CHARACTERISTIC OvRMon_nThresNrml2Strt_C "#SSD Grenze Kurbelwellen Drehzahl inaktive Startsystem Überwachung" VALUE 0xC2E2A Kw_Ws16 6000.000 EngN 0.00 6000.000 FORMAT "%8.3" EXTENDED_LIMITS -32768.00 32767.00 /end CHARACTERISTIC
/begin CHARACTERISTIC OvRMon_numBrkDioInMn_C "#SSD Application parameter for main Brake switch" VALUE 0xE3AC8 Kw_Wu8 14.0000000000 NumPinDioIn 0.00 14.0000000000 FORMAT "%13.10" /end CHARACTERISTIC
/begin CHARACTERISTIC OvRMon_numBrkDioInRed_C "#SSD Application parameter for Redundant  Brake switch" VALUE 0xE3AC9 Kw_Wu8 14.0000000000 NumPinDioIn 0.00 14.0000000000 FORMAT "%13.10" /end CHARACTERISTIC
/begin CHARACTERISTIC OvRMon_tiBrkRedSwtDebNeg_C "debounce time for falling edge of redundant brake switch" VALUE 0xE3ACA Kw_Wu16 655350.0 TimeDeb 0.00 655350.0 FORMAT "%8.1" /end CHARACTERISTIC
/begin CHARACTERISTIC OvRMon_tiBrkRedSwtDebPos_C "#SSD debounce time for rising edge of redundant brake switch" VALUE 0xE3ACC Kw_Wu16 655350.0 TimeDeb 0.00 655350.0 FORMAT "%8.1" /end CHARACTERISTIC
/begin CHARACTERISTIC OvRMon_stBrkDflVal_C "default brake information" VALUE 0xE3ACE Kw_Wu8 3.000 OneToOne 0.00 3.000 FORMAT "%5.3" EXTENDED_LIMITS 0.00 255.0 /end CHARACTERISTIC
/begin CHARACTERISTIC OvRMon_stBrkMnSwtInvIn_C "#SSD main brake switch invert information. 1=inverted , 0=not inverted" VALUE 0xE3ACF Kw_Wu8 1.000 OneToOne 0.00 1.000 FORMAT "%5.3" EXTENDED_LIMITS 0.00 255.0 /end CHARACTERISTIC
/begin CHARACTERISTIC OvRMon_stBrkRedSwtInvIn_C "#SSD redundant brake switch invert information. 1=inverted , 0=not inverted" VALUE 0xE3AD0 Kw_Wu8 1.000 OneToOne 0.00 1.000 FORMAT "%5.3" EXTENDED_LIMITS 0.00 255.0 /end CHARACTERISTIC
/begin CHARACTERISTIC OvRMon_stDebCnt_C "#SSD Schrittweite Entprellzähler: Die ersten 2 Bit legen die Aufwärts Schrittweite fest, die zweiten 2 Bit die Abwärts Schrittweite" VALUE 0xC2E2C Kw_Wu8 15.00 OneToOne 0.00 15.00 FORMAT "%5.2" EXTENDED_LIMITS 0.00 255.0 /end CHARACTERISTIC
/begin CHARACTERISTIC OvRMon_stIntrInit_C "#SSD Kennung für Interruptstatus" VALUE 0xC2E64 Kw_Wu8 255.0 OneToOne 0.00 255.0 FORMAT "%5.1" /end CHARACTERISTIC
/begin CHARACTERISTIC OvRMon_swtBrkRedSwtPresent_C "#SSD redundant brake switch  information" VALUE 0xE3AD1 Kw_Wu8 1.000 OneToOne 0.00 1.000 FORMAT "%5.3" EXTENDED_LIMITS 0.00 255.0 /end CHARACTERISTIC
/begin CHARACTERISTIC OvRMon_swtBrkSigVal_C "#SSD switch value , signal of HW DIO/CAN (1=CAN , 0= DIO)" VALUE 0xE3AD2 Kw_Wu8 3.000 OneToOne 0.00 3.000 FORMAT "%5.3" EXTENDED_LIMITS 0.00 255.0 /end CHARACTERISTIC
/begin CHARACTERISTIC OvRMon_tiAPP1Flt_C "#SSD Wartezeit Fahrpedalfilterung, Führungsformung in der Schubüberwachung" VALUE 0xC2E2E Kw_Wu16 655350.0 TimeDeb 0.00 655350.0 FORMAT "%8.1" /end CHARACTERISTIC
/begin CHARACTERISTIC OvRMon_tiASDdc_C "#SSD Wartezeit Eingriff Störungsregler aktiv" VALUE 0xC2E30 Kw_Wu16 655350.0 TimeDeb 0.00 655350.0 FORMAT "%8.1" /end CHARACTERISTIC
/begin CHARACTERISTIC OvRMon_tiCompAcsTemp_C "#SSD Wartezeit Kompensation Nebenaggregate in der Schubüberwachung" VALUE 0xC2E32 Kw_Wu16 655350.0 TimeDeb 0.00 655350.0 FORMAT "%8.1" /end CHARACTERISTIC
/begin CHARACTERISTIC OvRMon_tiCrCtlBrkRmp_C "#SSD Wartezeit Fahrgeschwindigkeitsregler-Ausschaltrampe nach Bremse in der Schubüberwachung" VALUE 0xC2E34 Kw_Wu16 655350.0 TimeDeb 0.00 655350.0 FORMAT "%8.1" /end CHARACTERISTIC
/begin CHARACTERISTIC OvRMon_tiCrCtlConvRmp_C "#SSD Wartezeit Fahrgeschwindigkeitsregler-Ausschaltrampe nach Kupplung in der Schubüberwachung" VALUE 0xC2E36 Kw_Wu16 655350.0 TimeDeb 0.00 655350.0 FORMAT "%8.1" /end CHARACTERISTIC
/begin CHARACTERISTIC OvRMon_tiDebBrk_C "#SSD Entprellzeit für redundante Erfassung des Bremssignals" VALUE 0xC2E58 Kw_Wu8 10200. Time_ms_40ms 0.00 10200. FORMAT "%5.0" /end CHARACTERISTIC
/begin CHARACTERISTIC OvRMon_tiDebConv_C "#SSD Entprellzeit für redundante Erfassung des Kupplungssignals" VALUE 0xC2E59 Kw_Wu8 10200. Time_ms_40ms 0.00 10200. FORMAT "%5.0" /end CHARACTERISTIC
/begin CHARACTERISTIC OvRMon_tiDebT15_C "#SSD Entprellzeit für redundante Erfassung der Klemme 15" VALUE 0xC2E5A Kw_Wu8 10200. Time_ms_40ms 0.00 10200. FORMAT "%5.0" /end CHARACTERISTIC
/begin CHARACTERISTIC OvRMon_tiEngSpdRlsBrkRmp_C "Entprellzeit des Bremssignals im Falle der allgemeinen Drehzahlanforderung" VALUE 0xC2E38 Kw_Wu16 655350.0 TimeDeb 0.00 655350.0 FORMAT "%8.1" /end CHARACTERISTIC
/begin CHARACTERISTIC OvRMon_tiErrAPP_C "#SSD Fehlerentprellzeit für Fahrpedalüberwachung" VALUE 0xC2E50 Kw_Wu8 10200. Time_ms_40ms 0.00 10200. FORMAT "%5.0" /end CHARACTERISTIC
/begin CHARACTERISTIC OvRMon_tiErrDblStorage_C "#SSD Entprellzeit für Fehler in der Doppelablage" VALUE 0xC2E3A Kw_Wu8 5100. Time_ms_20ms 0.00 5100. FORMAT "%5.0" /end CHARACTERISTIC
/begin CHARACTERISTIC OvRMon_tiLimET_CUR "#SSD Zulässige mittlere momentwirksame Ansteuerdauer in der Schubüberwachung" CURVE 0xC2E3C Kl_Xs16_Ws16 5000.000 InjTime_us 0.00 5000.000 FORMAT "%8.3" EXTENDED_LIMITS -32768.00 32767.00
 /begin AXIS_DESCR STD_AXIS OvRMon_nAvrg EngN 4 0.00 6000.000 FORMAT "%8.3" EXTENDED_LIMITS -32768.00 32767.00 DEPOSIT ABSOLUTE /end AXIS_DESCR
/end CHARACTERISTIC
/begin CHARACTERISTIC OvRMon_tiSegMin_C "#SSD Mindestsegmentdauer für Übernahme der Segmentdrehzahl aus Systemzeit" VALUE 0xC2E68 Kw_Wu32 4294967295.00 TimeUSResolution 0.00 4294967295.00 FORMAT "%13.2" /end CHARACTERISTIC
/begin CHARACTERISTIC OvRMon_uAPP1Lim_C "#SSD Spannungsgrenze für Überwachung Pedalwertgeber, Leergasschwelle der Überwachung" VALUE 0xC2E4E Kw_Ws16 5200.391 Volt 0.00 5200.391 FORMAT "%8.3" EXTENDED_LIMITS -160156.4 160151.5 /end CHARACTERISTIC
/begin CHARACTERISTIC OvRMon_uAPPFull_C "#SSD Spannungsgrenze für Fahrpedal im Volllastbereich" VALUE 0xC2E52 Kw_Ws16 5200.391 Volt 0.00 5200.391 FORMAT "%8.3" EXTENDED_LIMITS -160156.4 160151.5 /end CHARACTERISTIC
/begin CHARACTERISTIC OvRMon_uPlaWinFull_C "#SSD Plausibilitätsfenster für Fahrpedal im Volllastbereich" VALUE 0xC2E54 Kw_Ws16 5200.391 Volt 0.00 5200.391 FORMAT "%8.3" EXTENDED_LIMITS -160156.4 160151.5 /end CHARACTERISTIC
/begin CHARACTERISTIC OvRMon_uPlaWinIdle_C "#SSD Plausibilitätsfenster für Fahpedal im Leerlaufbereich" VALUE 0xC2E56 Kw_Ws16 5200.391 Volt 0.00 5200.391 FORMAT "%8.3" EXTENDED_LIMITS -160156.4 160151.5 /end CHARACTERISTIC
/begin CHARACTERISTIC OxiCCD_uSRCMinTPre_C "Minimalwert SRC-Überwachung von OxiCCD_uRawTempPre" VALUE 0xE3AD4 Kw_Ws16 5200.391 Volt 0.00 5200.391 FORMAT "%8.3" EXTENDED_LIMITS -160156.4 160151.5 /end CHARACTERISTIC
/begin CHARACTERISTIC OxiCCD_uSRCMaxTPre_C "Maximalwert SRC-Überwachung von OxiCCD_uRawTempPre" VALUE 0xE3AD6 Kw_Ws16 5200.391 Volt 0.00 5200.391 FORMAT "%8.3" EXTENDED_LIMITS -160156.4 160151.5 /end CHARACTERISTIC
/begin CHARACTERISTIC OxiCCD_tLinPre_CUR "Linearisierungskennlinie für OxiCCD_uRawTempPre" CURVE 0xE3AD8 Kl_Xs16_Ws16 950.000 Temp_Cels -50.140 899.860 FORMAT "%8.3" EXTENDED_LIMITS -3549.940 3003.560
 /begin AXIS_DESCR STD_AXIS OxiCCD_uRawTempPre Volt 16 0.00 160151.5 FORMAT "%8.1" EXTENDED_LIMITS -160156.4 160151.5 DEPOSIT ABSOLUTE /end AXIS_DESCR
/end CHARACTERISTIC
/begin CHARACTERISTIC OxiCCD_DebSRCHighDefTPre_C "Entprellzeit für Fehlererkennung SRC-high-Fehler für Dfp_OxiCCDTPre" VALUE 0xE3B1A Kw_Wu16 655350.0 Time_ms 0.00 655350.0 FORMAT "%8.1" /end CHARACTERISTIC
/begin CHARACTERISTIC OxiCCD_DebSRCHighOkTPre_C "Entprellzeit für Fehlerheilung SRC-high-Fehler für Dfp_OxiCCDTPre" VALUE 0xE3B1C Kw_Wu16 655350.0 Time_ms 0.00 655350.0 FORMAT "%8.1" /end CHARACTERISTIC
/begin CHARACTERISTIC OxiCCD_DebSRCLowDefTPre_C "Entprellzeit für Fehlererkennung SRC-low-Fehler für Dfp_OxiCCDTPre" VALUE 0xE3B1E Kw_Wu16 655350.0 Time_ms 0.00 655350.0 FORMAT "%8.1" /end CHARACTERISTIC
/begin CHARACTERISTIC OxiCCD_DebSRCLowOkTPre_C "Entprellzeit für Fehlerheilung SRC-low-Fehler für Dfp_OxiCCDTPre" VALUE 0xE3B20 Kw_Wu16 655350.0 Time_ms 0.00 655350.0 FORMAT "%8.1" /end CHARACTERISTIC
/begin CHARACTERISTIC OxiCCD_numTempPreADC_C "Zahl zur Auswahl des ADC-Kanals" VALUE 0xE3B22 Kw_Wu8 44.0000000000 NumPinAdc 0.00 44.0000000000 FORMAT "%13.10" /end CHARACTERISTIC
/begin CHARACTERISTIC OxiCCD_dtRmpSlpUpPre_C "Rampensteigung aufwärts für Komponententreiber Temperatur vor Oxidationskatalysator" VALUE 0xE3B24 Kw_Wu32 6553598.99749 RmpTemp 1.00097656250 6553599.99847 FORMAT "%13.5" EXTENDED_LIMITS 0.00 6553599.99847 /end CHARACTERISTIC
/begin CHARACTERISTIC OxiCCD_dtRmpSlpDwnPre_C "Rampensteigung abwärts für Komponententreiber Temperatur vor Oxidationskatalysator" VALUE 0xE3B28 Kw_Wu32 6553598.99749 RmpTemp 1.00097656250 6553599.99847 FORMAT "%13.5" EXTENDED_LIMITS 0.00 6553599.99847 /end CHARACTERISTIC
/begin CHARACTERISTIC OxiCCD_stSensIDWordTPre_C "Sensor ID Word für Übergangsbedingungen Temperatursensor vor Oxidationskatalysator" VALUE 0xE3B2C Kw_Wu16 65535.00 OneToOne 0.00 65535.00 FORMAT "%8.2" /end CHARACTERISTIC
/begin CHARACTERISTIC OxiCCD_tDflPre_C "Ersatzwert Temperatur vor Oxidationskatalysator im Fehlerfall" VALUE 0xE3B2E Kw_Ws16 950.000 Temp_Cels -50.140 899.860 FORMAT "%8.3" EXTENDED_LIMITS -3549.940 3003.560 /end CHARACTERISTIC
/begin CHARACTERISTIC PCBS_lCalcDistance_CUR "Curve for calculation of rest distance" CURVE 0xE3B30 Kl_Xs16_Ws16 35000.00 km_sw_q10 -5000.000 30000.00 FORMAT "%8.2" EXTENDED_LIMITS -327680.0 327670.0
 /begin AXIS_DESCR STD_AXIS PFlt_mAshOil mSoot_g 8 0.00 15.00000 FORMAT "%8.5" EXTENDED_LIMITS -327.6800 327.6700 DEPOSIT ABSOLUTE /end AXIS_DESCR
/end CHARACTERISTIC
/begin CHARACTERISTIC PCR_tiDT1DesCld_C "Verzögerungszeitkonstante der dynamischen Sollwertbildung bei kaltem Motor" VALUE 0xE52E4 Kw_Wu32 4294.9663 TimeDelay_s 0.0010000001 4294.9673 FORMAT "%9.4" EXTENDED_LIMITS 0.0000010000000 4294.9673 /end CHARACTERISTIC
/begin CHARACTERISTIC PCR_DKdDesCld_C "Kleinsignalverstärkung der dynamischen Sollwertbildung bei kaltem Motor" VALUE 0xE52E8 Kw_Ws32 65535.9999847 Kd -32768.0000000 32767.9999847 FORMAT "%13.7" /end CHARACTERISTIC
/begin CHARACTERISTIC PCR_DKdPosDesCld_C "Positive Großsignalverstärkung der dynamischen Sollwertbildung bei kaltem Motor" VALUE 0xE52EC Kw_Ws32 65535.9999847 Kd -32768.0000000 32767.9999847 FORMAT "%13.7" /end CHARACTERISTIC
/begin CHARACTERISTIC PCR_DKdNegDesCld_C "Negative Großsignalverstärkung der dynamischen Sollwertbildung bei kaltem Motor" VALUE 0xE52F0 Kw_Ws32 65535.9999847 Kd -32768.0000000 32767.9999847 FORMAT "%13.7" /end CHARACTERISTIC
/begin CHARACTERISTIC PCR_dpDWinPosDesCld_C "Positive Kleinsignalgrenze bei kaltem Motor" VALUE 0xE52F4 Kw_Ws16 65535.00 Pres_hPa -32768.00 32767.00 FORMAT "%8.2" /end CHARACTERISTIC
/begin CHARACTERISTIC PCR_dpDWinNegDesCld_C "Negative Kleinsignalgrenze bei kaltem Motor" VALUE 0xE52F6 Kw_Ws16 65535.00 Pres_hPa -32768.00 32767.00 FORMAT "%8.2" /end CHARACTERISTIC
/begin CHARACTERISTIC PCR_dnSurgeHigh_CUR "Higher limit for hysteresis to monitor rate of change of Eng_nAvrg for Anti-Surge LIGov" CURVE 0xE5220 Kl_Xs16_Ws16 3000.000 dn_dZ20 0.00 3000.000 FORMAT "%8.3" EXTENDED_LIMITS -327680.0 327670.0
 /begin AXIS_DESCR STD_AXIS Eng_nAvrg EngN 5 0.00 6000.000 FORMAT "%8.3" EXTENDED_LIMITS -32768.00 32767.00 DEPOSIT ABSOLUTE /end AXIS_DESCR
/end CHARACTERISTIC
/begin CHARACTERISTIC PCR_dnSurgeLow_CUR "Lower limit for hysteresis to monitor rate of change of Eng_nAvrg for Anti-Surge LIGov" CURVE 0xE5236 Kl_Xs16_Ws16 3000.000 dn_dZ20 0.00 3000.000 FORMAT "%8.3" EXTENDED_LIMITS -327680.0 327670.0
 /begin AXIS_DESCR STD_AXIS Eng_nAvrg EngN 5 0.00 6000.000 FORMAT "%8.3" EXTENDED_LIMITS -32768.00 32767.00 DEPOSIT ABSOLUTE /end AXIS_DESCR
/end CHARACTERISTIC
/begin CHARACTERISTIC PCR_dpSlpLimDwn_C "Down slope" VALUE 0xE52F8 Kw_Wu32 65535949.9817 RmpPres_hPa 50.0030517578 65535999.9847 FORMAT "%13.4" EXTENDED_LIMITS 0.00 65535999.9847 /end CHARACTERISTIC
/begin CHARACTERISTIC PCR_dpSlpLimUp_C "Up slope" VALUE 0xE52FC Kw_Wu32 65535949.9817 RmpPres_hPa 50.0030517578 65535999.9847 FORMAT "%13.4" EXTENDED_LIMITS 0.00 65535999.9847 /end CHARACTERISTIC
/begin CHARACTERISTIC PCR_dqDes_C "Application constant for derivative of desired fuel quantity" VALUE 0xE5300 Kw_Ws16 200.0000 InjMassPerSec_20ms 0.00 200.0000 FORMAT "%8.4" EXTENDED_LIMITS -16384.00 16383.50 /end CHARACTERISTIC
/begin CHARACTERISTIC PCR_drAPP1UnFlt_C "Application constant for ratio of Accelerator pedal 1 position unfiltered value" VALUE 0xE5302 Kw_Ws16 100.0977 PrcPerSec 0.00 100.0977 FORMAT "%8.4" EXTENDED_LIMITS -20000.00 19999.39 /end CHARACTERISTIC
/begin CHARACTERISTIC PCR_tiDT1qDes_C "Time delay factor for the DT1 filter for desired fuel quantity" VALUE 0xE5304 Kw_Wu32 4294.9663 TimeDelay_s 0.0010000001 4294.9673 FORMAT "%9.4" EXTENDED_LIMITS 0.0000010000000 4294.9673 /end CHARACTERISTIC
/begin CHARACTERISTIC PCR_DKdqDes_C "Differential factor for DT1 filter for desired fuel quantity" VALUE 0xE5308 Kw_Ws32 10.0000000000 Kd 0.00 10.0000000000 FORMAT "%13.10" EXTENDED_LIMITS -32768.0000000 32767.9999847 /end CHARACTERISTIC
/begin CHARACTERISTIC PCR_tiDT1rAPP1_C "time delay for DT1 filter for Accelerator pedal 1 position" VALUE 0xE530C Kw_Wu32 4294.9663 TimeDelay_s 0.0010000001 4294.9673 FORMAT "%9.4" EXTENDED_LIMITS 0.0000010000000 4294.9673 /end CHARACTERISTIC
/begin CHARACTERISTIC PCR_DKdrAPP1_C "Derivative factor for DT1 Filter for Accelerator pedal 1 position" VALUE 0xE5310 Kw_Ws32 10.0000000000 Kd 0.00 10.0000000000 FORMAT "%13.10" EXTENDED_LIMITS -32768.0000000 32767.9999847 /end CHARACTERISTIC
/begin CHARACTERISTIC PCR_facATRgn_CUR "Kennlinie für lufttemperaturabhängigen Korrekturwert bei Regenerationsbetrieb" CURVE 0xE5314 Kl_Xs16_Ws16 3.000000 Fact 0.00 3.000000 FORMAT "%8.6" EXTENDED_LIMITS -4.000000 3.999878
 /begin AXIS_DESCR STD_AXIS IATSCD_tAir Temp_Cels 6 -50.14000 199.8600 FORMAT "%8.4" EXTENDED_LIMITS -3549.940 3003.560 DEPOSIT ABSOLUTE /end AXIS_DESCR
/end CHARACTERISTIC
/begin CHARACTERISTIC PCR_facBPCtlBasCorr_CUR "Correcting factor of boost pressure control value according to particle filter soot mass" CURVE 0xE3B54 Kl_Xs16_Ws16 5.000000 Fact 0.00 5.000000 FORMAT "%8.6" EXTENDED_LIMITS -4.000000 3.999878
 /begin AXIS_DESCR STD_AXIS PFlt_mSot mSoot_g 8 0.00 300.0000 FORMAT "%8.4" EXTENDED_LIMITS -327.6800 327.6700 DEPOSIT ABSOLUTE /end AXIS_DESCR
/end CHARACTERISTIC
/begin CHARACTERISTIC PCR_facBPCtlBasRgn1Corr_CUR "correcting factor of boost pressure control value for regeneration according to particle filter soot mass" CURVE 0xE3B76 Kl_Xs16_Ws16 5.000000 Fact 0.00 5.000000 FORMAT "%8.6" EXTENDED_LIMITS -4.000000 3.999878
 /begin AXIS_DESCR STD_AXIS PFlt_mSot mSoot_g 8 0.00 300.0000 FORMAT "%8.4" EXTENDED_LIMITS -327.6800 327.6700 DEPOSIT ABSOLUTE /end AXIS_DESCR
/end CHARACTERISTIC
/begin CHARACTERISTIC PCR_facCtlAPRgn_MAP "Offset on boost pressure regeneration control value according to intake air pressure" MAP 0xE3B98 Kf_Xs16_Ys16_Ws16 5.000000 Fact 0.00 5.000000 FORMAT "%8.6" EXTENDED_LIMITS -4.000000 3.999878
 /begin AXIS_DESCR STD_AXIS Eng_nAvrg EngN 10 0.00 8000.000 FORMAT "%8.3" EXTENDED_LIMITS -32768.00 32767.00 DEPOSIT ABSOLUTE /end AXIS_DESCR
 /begin AXIS_DESCR STD_AXIS APSCD_pVal Pres_hPa 12 0.00 3500.000 FORMAT "%8.3" EXTENDED_LIMITS -32768.00 32767.00 DEPOSIT ABSOLUTE /end AXIS_DESCR
/end CHARACTERISTIC
/begin CHARACTERISTIC PCR_facCtlAP_MAP "Kennfeld für atmosphärendruckabhängige Korrektur für Steuerung" MAP 0xE3CB8 Kf_Xs16_Ys16_Ws16 5.000000 Fact 0.00 5.000000 FORMAT "%8.6" EXTENDED_LIMITS -4.000000 3.999878
 /begin AXIS_DESCR STD_AXIS Eng_nAvrg EngN 10 0.00 8000.000 FORMAT "%8.3" EXTENDED_LIMITS -32768.00 32767.00 DEPOSIT ABSOLUTE /end AXIS_DESCR
 /begin AXIS_DESCR STD_AXIS APSCD_pVal Pres_hPa 12 0.00 3500.000 FORMAT "%8.3" EXTENDED_LIMITS -32768.00 32767.00 DEPOSIT ABSOLUTE /end AXIS_DESCR
/end CHARACTERISTIC
/begin CHARACTERISTIC PCR_facCtlATRgn_CUR "Kennlinie für lufttemperaturabhängingen Korrekturfaktor für Ladedruckregelung bei Regenerationsbetrieb" CURVE 0xE3DD8 Kl_Xs16_Ws16 3.000000 Fact 0.00 3.000000 FORMAT "%8.6" EXTENDED_LIMITS -4.000000 3.999878
 /begin AXIS_DESCR STD_AXIS IATSCD_tAir Temp_Cels 6 -50.1400 199.8600 FORMAT "%8.4" EXTENDED_LIMITS -3549.940 3003.560 DEPOSIT ABSOLUTE /end AXIS_DESCR
/end CHARACTERISTIC
/begin CHARACTERISTIC PCR_facCtlIAT_CUR "Kennlinie für lufttemperaturabhängigen Korrekturfaktor für Ladedrucksteuerung" CURVE 0xE3DF2 Kl_Xs16_Ws16 3.000000 Fact 0.00 3.000000 FORMAT "%8.6" EXTENDED_LIMITS -4.000000 3.999878
 /begin AXIS_DESCR STD_AXIS IATSCD_tAir Temp_Cels 6 -50.1400 199.8600 FORMAT "%8.4" EXTENDED_LIMITS -3549.940 3003.560 DEPOSIT ABSOLUTE /end AXIS_DESCR
/end CHARACTERISTIC
/begin CHARACTERISTIC PCR_facCtQ_MAP "Kennfeld für Kühlwassertemperaturkorrekturfaktor de Sollwertberechnung" MAP 0xE532E Kf_Xs16_Ys16_Ws16 7.999878 Fact -4.000000 3.999878 FORMAT "%8.6"
 /begin AXIS_DESCR STD_AXIS CTSCD_tClnt Temp_Cels 2 -50.1400 199.8600 FORMAT "%8.4" EXTENDED_LIMITS -3549.940 3003.560 DEPOSIT ABSOLUTE /end AXIS_DESCR
 /begin AXIS_DESCR STD_AXIS PCR_qDes InjMass 2 0.00 200.0000 FORMAT "%8.4" EXTENDED_LIMITS -327.6800 327.6700 DEPOSIT ABSOLUTE /end AXIS_DESCR
/end CHARACTERISTIC
/begin CHARACTERISTIC PCR_facIAT_CUR "Lufttemperaturabhängiger Faktor für Sollwertbildung" CURVE 0xE5342 Kl_Xs16_Ws16 3.000000 Fact 0.00 3.000000 FORMAT "%8.6" EXTENDED_LIMITS -4.000000 3.999878
 /begin AXIS_DESCR STD_AXIS CTSCD_tClnt Temp_Cels 6 -50.14000 199.8600 FORMAT "%8.4" EXTENDED_LIMITS -3549.940 3003.560 DEPOSIT ABSOLUTE /end AXIS_DESCR
/end CHARACTERISTIC
/begin CHARACTERISTIC PCR_facN_CUR "Gewichtungsfaktor über Drehzahl für Athmosphärendruckkorrektur" CURVE 0xE535C Kl_Xs16_Ws16 1.000000 Fact 0.00 1.000000 FORMAT "%8.6" EXTENDED_LIMITS -4.000000 3.999878
 /begin AXIS_DESCR STD_AXIS Eng_nAvrg EngN 6 0.00 6000.000 FORMAT "%8.3" EXTENDED_LIMITS -32768.00 32767.00 DEPOSIT ABSOLUTE /end AXIS_DESCR
/end CHARACTERISTIC
/begin CHARACTERISTIC PCR_nLIGovBase_C "#SSD LL-Solldrehzahl bei Anti-Surge inaktiv" VALUE 0xE524C Kw_Ws16 6000.000 EngN 0.00 6000.000 FORMAT "%8.3" EXTENDED_LIMITS -32768.00 32767.00 /end CHARACTERISTIC
/begin CHARACTERISTIC PCR_nLimMax_C "Upper threshold for engine speed." VALUE 0xE5376 Kw_Ws16 6000.000 EngN 0.00 6000.000 FORMAT "%8.3" EXTENDED_LIMITS -32768.00 32767.00 /end CHARACTERISTIC
/begin CHARACTERISTIC PCR_nLimMin_C "Lower threshold for engine speed." VALUE 0xE5378 Kw_Ws16 6000.000 EngN 0.00 6000.000 FORMAT "%8.3" EXTENDED_LIMITS -32768.00 32767.00 /end CHARACTERISTIC
/begin CHARACTERISTIC PCR_nSetPointLIGov_C "LIGov set point for Anti_Surge" VALUE 0xE524E Kw_Ws16 6000.000 EngN 0.00 6000.000 FORMAT "%8.3" EXTENDED_LIMITS -32768.00 32767.00 /end CHARACTERISTIC
/begin CHARACTERISTIC PCR_nSurgeMon1_C "#SSD Schwelle Low Überwachung Anti-Surge  LIGov/ PCR_nSetpoint" VALUE 0xE5250 Kw_Ws16 6000.000 EngN 0.00 6000.000 FORMAT "%8.3" EXTENDED_LIMITS -32768.00 32767.00 /end CHARACTERISTIC
/begin CHARACTERISTIC PCR_nSurgeMon2_C "#SSD Schwelle High Überwachung Anti-Surge  LIGov/ PCR_nSetpoint" VALUE 0xE5252 Kw_Ws16 6000.000 EngN 0.00 6000.000 FORMAT "%8.3" EXTENDED_LIMITS -32768.00 32767.00 /end CHARACTERISTIC
/begin CHARACTERISTIC PCR_pAPQCmpnRgn_MAP "Kennfeld für atmosphärendruckabhängigen Korrekturwert bei Regenerationsbetrieb" MAP 0xE537A Kf_Xs16_Ys16_Ws16 4400.000 Pres_hPa -400.0000 4000.000 FORMAT "%8.3" EXTENDED_LIMITS -32768.00 32767.00
 /begin AXIS_DESCR STD_AXIS APSCD_pVal Pres_hPa 6 0.00 4000.000 FORMAT "%8.3" EXTENDED_LIMITS -32768.00 32767.00 DEPOSIT ABSOLUTE /end AXIS_DESCR
 /begin AXIS_DESCR STD_AXIS PCR_qDes InjMass 6 0.00 200.0000 FORMAT "%8.4" EXTENDED_LIMITS -327.6800 327.6700 DEPOSIT ABSOLUTE /end AXIS_DESCR
/end CHARACTERISTIC
/begin CHARACTERISTIC PCR_pAPQCmpn_MAP "Kennfeld für atmosphärendruckabhängige Kompensation für Sollwertberechnung" MAP 0xE53DE Kf_Xs16_Ys16_Ws16 8000.000 Pres_hPa -4000.000 4000.000 FORMAT "%8.3" EXTENDED_LIMITS -32768.00 32767.00
 /begin AXIS_DESCR STD_AXIS APSCD_pVal Pres_hPa 6 0.00 4000.000 FORMAT "%8.3" EXTENDED_LIMITS -32768.00 32767.00 DEPOSIT ABSOLUTE /end AXIS_DESCR
 /begin AXIS_DESCR STD_AXIS PCR_qDes InjMass 6 0.00 200.0000 FORMAT "%8.4" EXTENDED_LIMITS -327.6800 327.6700 DEPOSIT ABSOLUTE /end AXIS_DESCR
/end CHARACTERISTIC
/begin CHARACTERISTIC PCR_pBDesBasFDC_MAP "base desired boost pressure map for sport mode" MAP 0xE5442 Kf_Xs16_Ys16_Ws16 4000.000 Pres_hPa 0.00 4000.000 FORMAT "%8.3" EXTENDED_LIMITS -32768.00 32767.00
 /begin AXIS_DESCR STD_AXIS Eng_nAvrg EngN 16 0.00 8000.000 FORMAT "%8.3" EXTENDED_LIMITS -32768.00 32767.00 DEPOSIT ABSOLUTE /end AXIS_DESCR
 /begin AXIS_DESCR STD_AXIS PCR_qDes InjMass 16 0.00 200.0000 FORMAT "%8.4" EXTENDED_LIMITS -327.6800 327.6700 DEPOSIT ABSOLUTE /end AXIS_DESCR
/end CHARACTERISTIC
/begin CHARACTERISTIC PCR_pBDesBasRgn1_MAP "Erstes Regenerationskennfeld zur Ermittlung des Ladedruckbasissollwerts" MAP 0xE5686 Kf_Xs16_Ys16_Ws16 4000.000 Pres_hPa 0.00 4000.000 FORMAT "%8.3" EXTENDED_LIMITS -32768.00 32767.00
 /begin AXIS_DESCR STD_AXIS Eng_nAvrg EngN 16 0.00 8000.000 FORMAT "%8.3" EXTENDED_LIMITS -32768.00 32767.00 DEPOSIT ABSOLUTE /end AXIS_DESCR
 /begin AXIS_DESCR STD_AXIS PCR_qDes InjMass 16 0.00 200.0000 FORMAT "%8.4" EXTENDED_LIMITS -327.6800 327.6700 DEPOSIT ABSOLUTE /end AXIS_DESCR
/end CHARACTERISTIC
/begin CHARACTERISTIC PCR_pBDesBasRgn2_MAP "Zweites Regenerationskennfeld zur Ermittlung des Ladedruckbasissollwerts" MAP 0xE58CA Kf_Xs16_Ys16_Ws16 4000.000 Pres_hPa 0.00 4000.000 FORMAT "%8.3" EXTENDED_LIMITS -32768.00 32767.00
 /begin AXIS_DESCR STD_AXIS Eng_nAvrg EngN 16 0.00 8000.000 FORMAT "%8.3" EXTENDED_LIMITS -32768.00 32767.00 DEPOSIT ABSOLUTE /end AXIS_DESCR
 /begin AXIS_DESCR STD_AXIS PCR_qDes InjMass 16 0.00 200.0000 FORMAT "%8.4" EXTENDED_LIMITS -327.6800 327.6700 DEPOSIT ABSOLUTE /end AXIS_DESCR
/end CHARACTERISTIC
/begin CHARACTERISTIC PCR_pDesAdd_Vector "#SSD Bypass-Label für additiven Bypass von PCR_pBDes (Nicht verstellen!)" VALUE 0xC2DFC Kw_Wu8 255.0 OneToOne 0.00 255.0 FORMAT "%5.1" /end CHARACTERISTIC
/begin CHARACTERISTIC PCR_pDesAdd_Channel "#SSD Bypass-Label für additiven Bypass von PCR_pBDes (Nicht verstellen!)" VALUE 0xC2DFD Kw_Wu8 255.0 OneToOne 0.00 255.0 FORMAT "%5.1" /end CHARACTERISTIC
/begin CHARACTERISTIC PCR_pDesBas_MAP "Kennfeld für die Grundwertbestimmung des Ladedruckbasissollwerts" MAP 0xE5B0E Kf_Xs16_Ys16_Ws16 4000.000 Pres_hPa 0.00 4000.000 FORMAT "%8.3" EXTENDED_LIMITS -32768.00 32767.00
 /begin AXIS_DESCR STD_AXIS Eng_nAvrg EngN 16 0.00 8000.000 FORMAT "%8.3" EXTENDED_LIMITS -32768.00 32767.00 DEPOSIT ABSOLUTE /end AXIS_DESCR
 /begin AXIS_DESCR STD_AXIS PCR_qDes InjMass 16 0.00 200.0000 FORMAT "%8.4" EXTENDED_LIMITS -327.6800 327.6700 DEPOSIT ABSOLUTE /end AXIS_DESCR
/end CHARACTERISTIC
/begin CHARACTERISTIC PCR_pDesMaxAP_MAP "Größter erlaubter Ladedrucksollwert in Abhängigkeit vom Luftdruck" MAP 0xE5D52 Kf_Xs16_Ys16_Ws16 4000.000 Pres_hPa 0.00 4000.000 FORMAT "%8.3" EXTENDED_LIMITS -32768.00 32767.00
 /begin AXIS_DESCR STD_AXIS Eng_nAvrg EngN 16 0.00 8000.000 FORMAT "%8.3" EXTENDED_LIMITS -32768.00 32767.00 DEPOSIT ABSOLUTE /end AXIS_DESCR
 /begin AXIS_DESCR STD_AXIS APSCD_pVal Pres_hPa 16 0.00 4000.000 FORMAT "%8.3" EXTENDED_LIMITS -32768.00 32767.00 DEPOSIT ABSOLUTE /end AXIS_DESCR
/end CHARACTERISTIC
/begin CHARACTERISTIC PCR_pDesMax_C "Größter erlaubter Ladedrucksollwert" VALUE 0xE5F96 Kw_Ws16 4000.000 Pres_hPa 0.00 4000.000 FORMAT "%8.3" EXTENDED_LIMITS -32768.00 32767.00 /end CHARACTERISTIC
/begin CHARACTERISTIC PCR_pDesMin_C "Kleinster erlaubter Ladedrucksollwert" VALUE 0xE5F98 Kw_Ws16 4000.000 Pres_hPa 0.00 4000.000 FORMAT "%8.3" EXTENDED_LIMITS -32768.00 32767.00 /end CHARACTERISTIC
/begin CHARACTERISTIC PCR_pDes_Vector "#SSD Bypass-Label für PCR_pBDes (Nicht verstellen!)" VALUE 0xC2DFE Kw_Wu8 255.0 OneToOne 0.00 255.0 FORMAT "%5.1" /end CHARACTERISTIC
/begin CHARACTERISTIC PCR_pDes_Channel "#SSD Bypass-Label für PCR_pBDes (Nicht verstellen!)" VALUE 0xC2DFF Kw_Wu8 255.0 OneToOne 0.00 255.0 FORMAT "%5.1" /end CHARACTERISTIC
/begin CHARACTERISTIC PCR_pNQCtCmpn_MAP "Kennfeld für Kühlwassertemperaturkorrekturwert für Sollwertberechnung" MAP 0xE5F9A Kf_Xs16_Ys16_Ws16 4000.000 Pres_hPa 0.00 4000.000 FORMAT "%8.3" EXTENDED_LIMITS -32768.00 32767.00
 /begin AXIS_DESCR STD_AXIS Eng_nAvrg EngN 2 0.00 8000.000 FORMAT "%8.3" EXTENDED_LIMITS -32768.00 32767.00 DEPOSIT ABSOLUTE /end AXIS_DESCR
 /begin AXIS_DESCR STD_AXIS PCR_qDes InjMass 2 0.00 200.0000 FORMAT "%8.4" EXTENDED_LIMITS -327.6800 327.6700 DEPOSIT ABSOLUTE /end AXIS_DESCR
/end CHARACTERISTIC
/begin CHARACTERISTIC PCR_qSurgeHigh_CUR "Higher quantity limit for hysteresis of Anti-Surge LIGov" CURVE 0xE5254 Kl_Xs16_Ws16 100.0000 InjMass 0.00 100.0000 FORMAT "%8.4" EXTENDED_LIMITS -327.6800 327.6700
 /begin AXIS_DESCR STD_AXIS Eng_nAvrg EngN 5 0.00 6000.000 FORMAT "%8.3" EXTENDED_LIMITS -32768.00 32767.00 DEPOSIT ABSOLUTE /end AXIS_DESCR
/end CHARACTERISTIC
/begin CHARACTERISTIC PCR_qSurgeLow_CUR "Lower quantity limit for hysteresis of Anti-Surge LIGov" CURVE 0xE526A Kl_Xs16_Ws16 100.0000 InjMass 0.00 100.0000 FORMAT "%8.4" EXTENDED_LIMITS -327.6800 327.6700
 /begin AXIS_DESCR STD_AXIS Eng_nAvrg EngN 5 0.00 6000.000 FORMAT "%8.3" EXTENDED_LIMITS -32768.00 32767.00 DEPOSIT ABSOLUTE /end AXIS_DESCR
/end CHARACTERISTIC
/begin CHARACTERISTIC PCR_rBPCtlBasUp_C "Ramp up slope for dynamic adjustment" VALUE 0xE3E0C Kw_Wu32 300.000049174 RmpPrc -100.000016391 200.000032783 FORMAT "%13.9" EXTENDED_LIMITS 0.00 799999.999814 /end CHARACTERISTIC
/begin CHARACTERISTIC PCR_rBPCtlBasDwn_C "Ramp down slope for dynamic adjustment" VALUE 0xE3E10 Kw_Wu32 300.000049174 RmpPrc -100.000016391 200.000032783 FORMAT "%13.9" EXTENDED_LIMITS 0.00 799999.999814 /end CHARACTERISTIC
/begin CHARACTERISTIC PCR_rBPCtlBasAirCtlOff_MAP "Map to calculate VGT lift ratio in %" MAP 0xE3E14 Kf_Xs16_Ys16_Ws16 300.0000 Prc -100.0000 200.0000 FORMAT "%8.4" EXTENDED_LIMITS -400.0000 399.9878
 /begin AXIS_DESCR STD_AXIS Eng_nAvrg EngN 16 0.00 6000.000 FORMAT "%8.3" EXTENDED_LIMITS -32768.00 32767.00 DEPOSIT ABSOLUTE /end AXIS_DESCR
 /begin AXIS_DESCR STD_AXIS PCR_qCtl_mp InjMassCyc 16 0.00 327.6700 FORMAT "%8.4" EXTENDED_LIMITS -327.6800 327.6700 DEPOSIT ABSOLUTE /end AXIS_DESCR
/end CHARACTERISTIC
/begin CHARACTERISTIC PCR_rBPCtlBasCorr_MAP "Base correction value according to particle filter soot mass" MAP 0xE4058 Kf_Xs16_Ys16_Ws16 300.0000 Prc -100.0000 200.0000 FORMAT "%8.4" EXTENDED_LIMITS -400.0000 399.9878
 /begin AXIS_DESCR STD_AXIS Eng_nAvrg EngN 16 0.00 8000.000 FORMAT "%8.3" EXTENDED_LIMITS -32768.00 32767.00 DEPOSIT ABSOLUTE /end AXIS_DESCR
 /begin AXIS_DESCR STD_AXIS PCR_qCtl_mp InjMassCyc 10 0.00 300.0000 FORMAT "%8.4" EXTENDED_LIMITS -327.6800 327.6700 DEPOSIT ABSOLUTE /end AXIS_DESCR
/end CHARACTERISTIC
/begin CHARACTERISTIC PCR_rBPCtlBasFDC_MAP "map for Calculation of the base control value" MAP 0xE41D0 Kf_Xs16_Ys16_Ws16 300.0000 Prc -100.0000 200.0000 FORMAT "%8.4" EXTENDED_LIMITS -400.0000 399.9878
 /begin AXIS_DESCR STD_AXIS Eng_nAvrg EngN 16 0.00 6000.000 FORMAT "%8.3" EXTENDED_LIMITS -32768.00 32767.00 DEPOSIT ABSOLUTE /end AXIS_DESCR
 /begin AXIS_DESCR STD_AXIS PCR_qCtl_mp InjMassCyc 16 0.00 327.6700 FORMAT "%8.4" EXTENDED_LIMITS -327.6800 327.6700 DEPOSIT ABSOLUTE /end AXIS_DESCR
/end CHARACTERISTIC
/begin CHARACTERISTIC PCR_rBPCtlBasRgn1Corr_MAP "Map to determine offset on boost pressure control value for regeneration according to particle filter soot mass" MAP 0xE4414 Kf_Xs16_Ys16_Ws16 300.0000 Prc -100.0000 200.0000 FORMAT "%8.4" EXTENDED_LIMITS -400.0000 399.9878
 /begin AXIS_DESCR STD_AXIS Eng_nAvrg EngN 16 0.00 8000.000 FORMAT "%8.3" EXTENDED_LIMITS -32768.00 32767.00 DEPOSIT ABSOLUTE /end AXIS_DESCR
 /begin AXIS_DESCR STD_AXIS PCR_qCtl_mp InjMassCyc 10 0.00 300.0000 FORMAT "%8.4" EXTENDED_LIMITS -327.6800 327.6700 DEPOSIT ABSOLUTE /end AXIS_DESCR
/end CHARACTERISTIC
/begin CHARACTERISTIC PCR_rBPCtlBasRgn1_MAP "Basiskennfeld 1 für Regenerationsbetrieb" MAP 0xE458C Kf_Xs16_Ys16_Ws16 300.0000 Prc -100.0000 200.0000 FORMAT "%8.4" EXTENDED_LIMITS -400.0000 399.9878
 /begin AXIS_DESCR STD_AXIS Eng_nAvrg EngN 16 0.00 6000.000 FORMAT "%8.3" EXTENDED_LIMITS -32768.00 32767.00 DEPOSIT ABSOLUTE /end AXIS_DESCR
 /begin AXIS_DESCR STD_AXIS PCR_qCtl_mp InjMassCyc 16 0.00 327.6700 FORMAT "%8.4" EXTENDED_LIMITS -327.6800 327.6700 DEPOSIT ABSOLUTE /end AXIS_DESCR
/end CHARACTERISTIC
/begin CHARACTERISTIC PCR_rBPCtlBasRgn2_MAP "Basiskennfeld 2 für Regenerationsbetrieb" MAP 0xE47D0 Kf_Xs16_Ys16_Ws16 300.0000 Prc -100.0000 200.0000 FORMAT "%8.4" EXTENDED_LIMITS -400.0000 399.9878
 /begin AXIS_DESCR STD_AXIS Eng_nAvrg EngN 16 0.00 6000.000 FORMAT "%8.3" EXTENDED_LIMITS -32768.00 32767.00 DEPOSIT ABSOLUTE /end AXIS_DESCR
 /begin AXIS_DESCR STD_AXIS PCR_qCtl_mp InjMassCyc 16 0.00 327.6700 FORMAT "%8.4" EXTENDED_LIMITS -327.6800 327.6700 DEPOSIT ABSOLUTE /end AXIS_DESCR
/end CHARACTERISTIC
/begin CHARACTERISTIC PCR_rCtlAPCmpnRgn_MAP "Kennfeld für Atmosphärendruckabhängigen Korrekturwert" MAP 0xE4A14 Kf_Xs16_Ys16_Ws16 200.0000 Prc -100.0000 100.0000 FORMAT "%8.4" EXTENDED_LIMITS -400.0000 399.9878
 /begin AXIS_DESCR STD_AXIS Eng_nAvrg EngN 8 0.00 6000.000 FORMAT "%8.3" EXTENDED_LIMITS -32768.00 32767.00 DEPOSIT ABSOLUTE /end AXIS_DESCR
 /begin AXIS_DESCR STD_AXIS PCR_qCtl_mp InjMassCyc 16 0.00 327.6700 FORMAT "%8.4" EXTENDED_LIMITS -327.6800 327.6700 DEPOSIT ABSOLUTE /end AXIS_DESCR
/end CHARACTERISTIC
/begin CHARACTERISTIC PCR_rCtlAPCor_MAP "Kennfeld für atmosphärendruckabhängigen Korrekturwert für Ladedrucksteuerung" MAP 0xE4B48 Kf_Xs16_Ys16_Ws16 200.0000 Prc -100.0000 100.0000 FORMAT "%8.4" EXTENDED_LIMITS -400.0000 399.9878
 /begin AXIS_DESCR STD_AXIS Eng_nAvrg EngN 10 0.00 6000.000 FORMAT "%8.3" EXTENDED_LIMITS -32768.00 32767.00 DEPOSIT ABSOLUTE /end AXIS_DESCR
 /begin AXIS_DESCR STD_AXIS PCR_qCtl_mp InjMassCyc 8 0.00 327.6700 FORMAT "%8.4" EXTENDED_LIMITS -327.6800 327.6700 DEPOSIT ABSOLUTE /end AXIS_DESCR
/end CHARACTERISTIC
/begin CHARACTERISTIC PCR_rCtlATCmpnRgn_MAP "Kennfeld für lufttemperaturabhängige Korrektur im Regenerationsbetrieb" MAP 0xE4C10 Kf_Xs16_Ys16_Ws16 200.0000 Prc -100.0000 100.0000 FORMAT "%8.4" EXTENDED_LIMITS -400.0000 399.9878
 /begin AXIS_DESCR STD_AXIS Eng_nAvrg EngN 8 0.00 6000.000 FORMAT "%8.3" EXTENDED_LIMITS -32768.00 32767.00 DEPOSIT ABSOLUTE /end AXIS_DESCR
 /begin AXIS_DESCR STD_AXIS PCR_qCtl_mp InjMassCyc 8 0.00 327.6700 FORMAT "%8.4" EXTENDED_LIMITS -327.6800 327.6700 DEPOSIT ABSOLUTE /end AXIS_DESCR
/end CHARACTERISTIC
/begin CHARACTERISTIC PCR_rCtlATCmpn_MAP "Kennfeld für lufttemperaturabhängige Korrektur" MAP 0xE4CB4 Kf_Xs16_Ys16_Ws16 200.0000 Prc -100.0000 100.0000 FORMAT "%8.4" EXTENDED_LIMITS -400.0000 399.9878
 /begin AXIS_DESCR STD_AXIS Eng_nAvrg EngN 10 0.00 6000.000 FORMAT "%8.3" EXTENDED_LIMITS -32768.00 32767.00 DEPOSIT ABSOLUTE /end AXIS_DESCR
 /begin AXIS_DESCR STD_AXIS PCR_qCtl_mp InjMassCyc 8 0.00 327.6700 FORMAT "%8.4" EXTENDED_LIMITS -327.6800 327.6700 DEPOSIT ABSOLUTE /end AXIS_DESCR
/end CHARACTERISTIC
/begin CHARACTERISTIC PCR_rCtlBas_MAP "Basissteuerkennfeld für Ladedruck" MAP 0xE4D7C Kf_Xs16_Ys16_Ws16 300.0000 Prc -100.0000 200.0000 FORMAT "%8.4" EXTENDED_LIMITS -400.0000 399.9878
 /begin AXIS_DESCR STD_AXIS Eng_nAvrg EngN 16 0.00 6000.000 FORMAT "%8.3" EXTENDED_LIMITS -32768.00 32767.00 DEPOSIT ABSOLUTE /end AXIS_DESCR
 /begin AXIS_DESCR STD_AXIS PCR_qCtl_mp InjMassCyc 16 0.00 327.6700 FORMAT "%8.4" EXTENDED_LIMITS -327.6800 327.6700 DEPOSIT ABSOLUTE /end AXIS_DESCR
/end CHARACTERISTIC
/begin CHARACTERISTIC PCR_rCtlInit_C "Initialisierungswert für Steuersignal" VALUE 0xE4FC0 Kw_Ws16 50.00000 Prc 0.00 50.00000 FORMAT "%8.5" EXTENDED_LIMITS -400.0000 399.9878 /end CHARACTERISTIC
/begin CHARACTERISTIC PCR_dnSurgeSlpUp_C "#SSD Schrittweite Rampe bei Erhöhung LIGov Soldrehzahl  for Anti-Surge LIGov" VALUE 0xE5280 Kw_Wu32 65535999.9847 RmpEngN 0.00 65535999.9847 FORMAT "%13.4" /end CHARACTERISTIC
/begin CHARACTERISTIC PCR_dnSurgeSlpDwn_C "#SSD Rampe Down LL-SollDrehzahlanhebung aus Anti-Surge" VALUE 0xE5284 Kw_Wu32 65535999.9847 RmpEngN 0.00 65535999.9847 FORMAT "%13.4" /end CHARACTERISTIC
/begin CHARACTERISTIC PCR_rSurgeCtlVal_MAP "boost pressure control value for Anti-Surge LIGov" MAP 0xE4FC2 Kf_Xs16_Ys16_Ws16 100.0000 Prc 0.00 100.0000 FORMAT "%8.4" EXTENDED_LIMITS -400.0000 399.9878
 /begin AXIS_DESCR STD_AXIS Eng_nAvrg EngN 16 0.00 6000.000 FORMAT "%8.3" EXTENDED_LIMITS -32768.00 32767.00 DEPOSIT ABSOLUTE /end AXIS_DESCR
 /begin AXIS_DESCR STD_AXIS PCR_qCtl_mp InjMassCyc 16 0.00 327.6700 FORMAT "%8.4" EXTENDED_LIMITS -327.6800 327.6700 DEPOSIT ABSOLUTE /end AXIS_DESCR
/end CHARACTERISTIC
/begin CHARACTERISTIC PCR_rSurgeHigh_MAP "#SSD Hystereseschwelle oben Druckverhältnis Anti-Surge LIGov" MAP 0xE5288 Kf_Xs16_Ys16_Ws16 100.0000 Prc 0.00 100.0000 FORMAT "%8.4" EXTENDED_LIMITS -400.0000 399.9878
 /begin AXIS_DESCR STD_AXIS Eng_nAvrg EngN 6 0.00 6000.000 FORMAT "%8.3" EXTENDED_LIMITS -32768.00 32767.00 DEPOSIT ABSOLUTE /end AXIS_DESCR
 /begin AXIS_DESCR STD_AXIS AFSCD_dmAirPerTime AirMassPerTime 3 0.00 2000.000 FORMAT "%8.3" EXTENDED_LIMITS -3276.800 3276.700 DEPOSIT ABSOLUTE /end AXIS_DESCR
/end CHARACTERISTIC
/begin CHARACTERISTIC PCR_rSurgeOfs_CUR "Lower ATL pressure ratio limit for hysteresis of Anti-Surge LIGov" CURVE 0xE52C2 Kl_Xs16_Ws16 280.0049 Prc 0.00 280.0049 FORMAT "%8.4" EXTENDED_LIMITS -400.0000 399.9878
 /begin AXIS_DESCR STD_AXIS Eng_nAvrg EngN 5 0.00 6000.000 FORMAT "%8.3" EXTENDED_LIMITS -32768.00 32767.00 DEPOSIT ABSOLUTE /end AXIS_DESCR
/end CHARACTERISTIC
/begin CHARACTERISTIC PCR_stCtlVal1_C "Maske für Regenerationswert 1" VALUE 0xE5208 Kw_Wu32 4294967295.00 OneToOne 0.00 4294967295.00 FORMAT "%13.2" /end CHARACTERISTIC
/begin CHARACTERISTIC PCR_stCtlVal2_C "Maske für Regenerationswert 2" VALUE 0xE520C Kw_Wu32 4294967295.00 OneToOne 0.00 4294967295.00 FORMAT "%13.2" /end CHARACTERISTIC
/begin CHARACTERISTIC PCR_stRgnMsk1_C "applizierbare Bitmaske für erstes Regenerationskennfeld" VALUE 0xE5FB0 Kw_Wu32 4294967295.00 OneToOne 0.00 4294967295.00 FORMAT "%13.2" /end CHARACTERISTIC
/begin CHARACTERISTIC PCR_stRgnMsk2_C "applizierbare Bitmaske für zweites Regenerationskennfeld" VALUE 0xE5FB4 Kw_Wu32 4294967295.00 OneToOne 0.00 4294967295.00 FORMAT "%13.2" /end CHARACTERISTIC
/begin CHARACTERISTIC PCR_tiSurgePT1_C "Time constant of PT1 delay element of PCR_SurgePT1" VALUE 0xE52D8 Kw_Wu32 4294.8273 TimeDelay_s 0.14000154 4294.9673 FORMAT "%9.4" EXTENDED_LIMITS 0.0000010000000 4294.9673 /end CHARACTERISTIC
/begin CHARACTERISTIC PCR_swtOffStat1_C "Switch to disable the effect of PCR_stSurge1" VALUE 0xE52DC Kw_Wu8 1.000 OneToOne 0.00 1.000 FORMAT "%5.3" EXTENDED_LIMITS 0.00 255.0 /end CHARACTERISTIC
/begin CHARACTERISTIC PCR_swtQntCtlVal_C "Schalterwert zur Auswahl der für Steuerung verwendeten Einspritzmenge" VALUE 0xE5210 Kw_Wu8 4.000 OneToOne 1.000 5.000 FORMAT "%5.3" EXTENDED_LIMITS 0.00 255.0 /end CHARACTERISTIC
/begin CHARACTERISTIC PCR_swtQntCtlType_C "Schaltertyp zur Auswahl der für Steuerung verwendeten Einspritzmenge" VALUE 0xE5211 Kw_Wu8 1.000 OneToOne 1.000 2.000 FORMAT "%5.3" EXTENDED_LIMITS 0.00 255.0 /end CHARACTERISTIC
/begin CHARACTERISTIC PCR_swtQntDesVal_C "Schalterwert für Mengeneingangswunsch bei der Sollwertberechnung" VALUE 0xE5FB8 Kw_Wu8 4.000 OneToOne 1.000 5.000 FORMAT "%5.3" EXTENDED_LIMITS 0.00 255.0 /end CHARACTERISTIC
/begin CHARACTERISTIC PCR_swtQntDesType_C "Schaltertyp für Mengeneingangswunsch bei der Sollwertberechnung" VALUE 0xE5FB9 Kw_Wu8 1.000 OneToOne 1.000 2.000 FORMAT "%5.3" EXTENDED_LIMITS 0.00 255.0 /end CHARACTERISTIC
/begin CHARACTERISTIC PCR_swtSlpLimInputType_C "Switch for selection of Slope limitation type" VALUE 0xE5FBA Kw_Wu8 255.0 OneToOne 0.00 255.0 FORMAT "%5.1" /end CHARACTERISTIC
/begin CHARACTERISTIC PCR_tClntThres_C "Kühlwassertemperaturschwelle zur Parametersatzumschaltung bei der Berechnung des dyn. Anteils" VALUE 0xE5FBC Kw_Ws16 950.000 Temp_Cels -50.140 899.860 FORMAT "%8.3" EXTENDED_LIMITS -3549.940 3003.560 /end CHARACTERISTIC
/begin CHARACTERISTIC PCR_tiBDesSlpLim_C "Time duration for which desired boost pressure value is through the ramp." VALUE 0xE5FBE Kw_Wu16 655.3500 Time_s 0.00 655.3500 FORMAT "%8.4" /end CHARACTERISTIC
/begin CHARACTERISTIC PCR_tiRmpCtl_C "Ramplaufzeit für Umschaltung der Korrekturwerte" VAL_BLK 0xE5214 Kwb_Wu32 65.535999984741210 EGTRmp 0.000000015258789066052715 65.536000000000001 FORMAT "%19.16" NUMBER 3 /end CHARACTERISTIC
/begin CHARACTERISTIC PCR_tiRmpMswt_C "Rampenlaufzeit für Mehrfachumschalter" VAL_BLK 0xE5FC0 Kwb_Wu32 65.535999984741210 EGTRmp 0.000000015258789066052715 65.536000000000001 FORMAT "%19.16" NUMBER 3 /end CHARACTERISTIC
/begin CHARACTERISTIC PCR_tiSurgeMonLIGov_C "#SSD Überwachungszeit Drehzahlanhebung Anti-Surge" VALUE 0xE52DE Kw_Wu16 655350.0 Time_ms 0.00 655350.0 FORMAT "%8.1" /end CHARACTERISTIC
/begin CHARACTERISTIC PCR_vSurgeLIGov_C "#SSD Schwelle Geschwindigkeit Anti-Surge/ Laderpumpen LIGov" VALUE 0xE52E0 Kw_Ws16 300.0000 Vel 0.00 300.0000 FORMAT "%8.4" EXTENDED_LIMITS -327.6800 327.6700 /end CHARACTERISTIC
/begin CHARACTERISTIC PCR_tiDT1DesWrm_C "Verzögerungszeitkonstante der dynamischen Sollwertbildung bei warmem Motor" VALUE 0xE5FCC Kw_Wu32 4294.9663 TimeDelay_s 0.0010000001 4294.9673 FORMAT "%9.4" EXTENDED_LIMITS 0.0000010000000 4294.9673 /end CHARACTERISTIC
/begin CHARACTERISTIC PCR_DKdDesWrm_C "Kleinsignalverstärkung der dynamischen Sollwertbildung bei warmem Motor" VALUE 0xE5FD0 Kw_Ws32 65535.9999847 Kd -32768.0000000 32767.9999847 FORMAT "%13.7" /end CHARACTERISTIC
/begin CHARACTERISTIC PCR_DKdPosDesWrm_C "Positive Großsignalverstärkung der dynamischen Sollwertbildung bei warmem Motor" VALUE 0xE5FD4 Kw_Ws32 65535.9999847 Kd -32768.0000000 32767.9999847 FORMAT "%13.7" /end CHARACTERISTIC
/begin CHARACTERISTIC PCR_DKdNegDesWrm_C "Negative Großsignalverstärkung der dynamischen Sollwertbildung bei warmem Motor" VALUE 0xE5FD8 Kw_Ws32 65535.9999847 Kd -32768.0000000 32767.9999847 FORMAT "%13.7" /end CHARACTERISTIC
/begin CHARACTERISTIC PCR_dpDWinPosDesWrm_C "Positive Kleinsignalgrenze bei warmem Motor" VALUE 0xE5FDC Kw_Ws16 65535.00 Pres_hPa -32768.00 32767.00 FORMAT "%8.2" /end CHARACTERISTIC
/begin CHARACTERISTIC PCR_dpDWinNegDesWrm_C "Negative Kleinsignalgrenze bei warmem Motor" VALUE 0xE5FDE Kw_Ws16 65535.00 Pres_hPa -32768.00 32767.00 FORMAT "%8.2" /end CHARACTERISTIC
/begin MEASUREMENT ctHigh "" UWORD OneToOne 1 100 0.00 65535.00 FORMAT "%8.2" ECU_ADDRESS 0x7FC246 /end MEASUREMENT
/begin MEASUREMENT ctLow "" UWORD OneToOne 1 100 0.00 65535.00 FORMAT "%8.2" ECU_ADDRESS 0x7FC248 /end MEASUREMENT
/begin MEASUREMENT LSUCtl_dcycDT1_mp "DT1 Anteil der Heizungsregler Tastverhältnisanforderung" SWORD DtyCyc 1 100 -327.6800 327.6700 FORMAT "%8.4" ARRAY_SIZE 1 ECU_ADDRESS 0x8FF8DA /end MEASUREMENT
/begin MEASUREMENT LSUCtl_dcycHt "Heizertastverhältnis Anforderung durch Ri Regelung" SWORD DtyCyc 1 100 -327.6800 327.6700 FORMAT "%8.4" ARRAY_SIZE 1 ECU_ADDRESS 0x7F8F00 /end MEASUREMENT
/begin MEASUREMENT LSUCtl_dcycHtIniRamp "Startwert für Aufheizkurven Rampe" SWORD DtyCyc 1 100 -327.6800 327.6700 FORMAT "%8.4" ECU_ADDRESS 0x7F8F02 /end MEASUREMENT
/begin MEASUREMENT LSUCtl_dcycHtStrt "Tastverhältnisvorgabe Heizung durch Aufheizstrategie" SWORD DtyCyc 1 100 -327.6800 327.6700 FORMAT "%8.4" ARRAY_SIZE 1 ECU_ADDRESS 0x7F8F04 /end MEASUREMENT
/begin MEASUREMENT LSUCtl_dcycPI_mp "Tastverhältnisforderung aus dem P I Regelglied" SWORD DtyCyc 1 100 -327.6800 327.6700 FORMAT "%8.4" ARRAY_SIZE 1 ECU_ADDRESS 0x8FF8DC /end MEASUREMENT
/begin MEASUREMENT LSUCtl_stHtCtl "Statusbits Zustand Heizungsregelung" UBYTE OneToOne 1 100 0.00 255.0 FORMAT "%5.1" ARRAY_SIZE 1 ECU_ADDRESS 0x7F8907 /end MEASUREMENT
/begin MEASUREMENT LSUCtl_stHtDisable "High level Diagnose Anforderung Heizungsregelungsabschaltung (0 = nicht abgeschaltet, >0 Ausgang = 0 %)" UBYTE OneToOne 1 100 0.00 255.0 FORMAT "%5.1" ARRAY_SIZE 1 ECU_ADDRESS 0x7F8908 /end MEASUREMENT
/begin MEASUREMENT LSUCtl_stRmp_mp "Ansteuerstatus für geschaltete Rampe" UBYTE OneToOne 1 100 0.00 255.0 FORMAT "%5.1" ARRAY_SIZE 1 ECU_ADDRESS 0x8FF8DE /end MEASUREMENT
/begin MEASUREMENT LSUCtl_stSCUNEna "Message um Test für Erkennung von Kurzschluss nach Vbat bei UNI freizugeben" UBYTE OneToOne 1 100 0.00 255.0 FORMAT "%5.1" ARRAY_SIZE 1 ECU_ADDRESS 0x7F8909 /end MEASUREMENT
/begin MEASUREMENT LSUCtl_tAirStrt_mp "Ansauglufttemperatur nach Zündung an (mit Verzögerung erfasst!)" SWORD Temp_Cels 1 100 -50.140 899.860 FORMAT "%8.3" ECU_ADDRESS 0x8FF8E0 /end MEASUREMENT
/begin MEASUREMENT LSUCtl_tDvt_mp "Regelabweichung Ri-Äquivalenztemperatur" SWORD TempDiff_Cels 1 100 -3276.800 3276.700 FORMAT "%8.3" ARRAY_SIZE 1 ECU_ADDRESS 0x8FF8E2 /end MEASUREMENT
/begin MEASUREMENT LSU_bpPlausSetPoint_mp "Bitposition für Zugriff auf LSU_stO2Err(_mp)" UBYTE OneToOne 1 100 0.00 255.0 FORMAT "%5.1" ECU_ADDRESS 0x8FF89C /end MEASUREMENT
/begin MEASUREMENT LSU_qStrt_mp "anfängliche Kraftstoffmenge in Dynamik-Überwachung" SWORD InjMass 1 100 -327.6800 327.6700 FORMAT "%8.4" ECU_ADDRESS 0x8FF89E /end MEASUREMENT
/begin MEASUREMENT LSU_rLmbd "Lambda" SWORD lambda 1 100 -32.76800 32.76700 FORMAT "%8.5" ARRAY_SIZE 1 ECU_ADDRESS 0x7F8F06 /end MEASUREMENT
/begin MEASUREMENT LSU_rLmbdRec "Kehrwert von Lambda" SWORD lambdaRecVal 1 100 -32.76800 32.76700 FORMAT "%8.5" ARRAY_SIZE 1 ECU_ADDRESS 0x7F8F08 /end MEASUREMENT
/begin MEASUREMENT LSU_rO2ActVal "Aktuell von Plausibilisierung verwendete O2-Konzentration" SWORD O2 1 100 -0.3276800 0.3276700 FORMAT "%9.7" ARRAY_SIZE 1 ECU_ADDRESS 0x7F8F0A /end MEASUREMENT
/begin MEASUREMENT LSU_rO2Adpt "Adaptierte Sauerstoffkonzentration die an externe Module übertragen wird" SWORD O2 1 100 -0.3276800 0.3276700 FORMAT "%9.7" ARRAY_SIZE 1 ECU_ADDRESS 0x7F8F0C /end MEASUREMENT
/begin MEASUREMENT LSU_rO2AdptLastLSU_mp "Adaptierte Sauerstoffkonzentration des Sensors mit der höchsten Nummer" SWORD O2 1 100 -0.3276800 0.3276700 FORMAT "%9.7" ECU_ADDRESS 0x8FF88A /end MEASUREMENT
/begin MEASUREMENT LSU_rO2Calc_mp "aktuelle O2-Konzentration aus Luftmasse und Einspritzmenge" SWORD O2 1 100 -0.3276800 0.3276700 FORMAT "%9.7" ECU_ADDRESS 0x8FF8A0 /end MEASUREMENT
/begin MEASUREMENT LSU_rO2DiffCmpChk "O2-Unterscheid eines Sondenpaars" SWORD O2 1 100 -0.3276800 0.3276700 FORMAT "%9.7" ECU_ADDRESS 0x7FF330 /end MEASUREMENT
/begin MEASUREMENT LSU_rO2DvtNeg_mp "Minustoleranz für Plausibilisierung O2-Signal LSU" SWORD O2 1 100 -0.3276800 0.3276700 FORMAT "%9.7" ECU_ADDRESS 0x8FF8A2 /end MEASUREMENT
/begin MEASUREMENT LSU_rO2DvtPos_mp "Plustoleranz für Plausibilisierung O2-Signal LSU" SWORD O2 1 100 -0.3276800 0.3276700 FORMAT "%9.7" ECU_ADDRESS 0x8FF8A4 /end MEASUREMENT
/begin MEASUREMENT LSU_rO2Lmbd1Thres "Message: Toleranzband für Lambda-1-Erkennung" SWORD O2 1 100 -0.3276800 0.3276700 FORMAT "%9.7" ECU_ADDRESS 0x7F8F0E /end MEASUREMENT
/begin MEASUREMENT LSU_rO2MaxDiff "Maximum O2 difference between selected LSU" SWORD O2 1 100 -0.3276800 0.3276700 FORMAT "%9.7" ECU_ADDRESS 0x7FF330 /end MEASUREMENT
/begin MEASUREMENT LSU_rO2MaxVal "Oberer Grenzwert der Plausibilisierung" SWORD O2 1 100 -0.3276800 0.3276700 FORMAT "%9.7" ARRAY_SIZE 1 ECU_ADDRESS 0x7F8F10 /end MEASUREMENT
/begin MEASUREMENT LSU_rO2MinVal "Unterer Grenzwert der Plausibilisierung" SWORD O2 1 100 -0.3276800 0.3276700 FORMAT "%9.7" ARRAY_SIZE 1 ECU_ADDRESS 0x7F8F12 /end MEASUREMENT
/begin MEASUREMENT LSU_rO2RawFlt "Gefilterte O2Raw-Sauerstoffkonzentration in Lambda-1-Erkennung" SWORD O2 1 100 -0.3276800 0.3276700 FORMAT "%9.7" ARRAY_SIZE 1 ECU_ADDRESS 0x7F8F14 /end MEASUREMENT
/begin MEASUREMENT LSU_rO2Stat_mp "gefilterte O2-Konzentration aus Luftmasse und Einspritzmenge" SWORD O2 1 100 -0.3276800 0.3276700 FORMAT "%9.7" ARRAY_SIZE 1 ECU_ADDRESS 0x8FF88C /end MEASUREMENT
/begin MEASUREMENT LSU_rO2Thres1_mp "untere O2-Schwelle für Messung der Anstiegszeit" SWORD O2 1 100 -0.3276800 0.3276700 FORMAT "%9.7" ARRAY_SIZE 1 ECU_ADDRESS 0x8FF88E /end MEASUREMENT
/begin MEASUREMENT LSU_rO2Thres2_mp "obere O2-Schwelle für Messung der Anstiegszeit" SWORD O2 1 100 -0.3276800 0.3276700 FORMAT "%9.7" ARRAY_SIZE 1 ECU_ADDRESS 0x8FF890 /end MEASUREMENT
/begin MEASUREMENT LSU_stChkDyn_mp "Nummer der zuletzt erreichten O2-Schwelle" UBYTE OneToOne 1 100 0.00 255.0 FORMAT "%5.1" ARRAY_SIZE 1 ECU_ADDRESS 0x8FF892 /end MEASUREMENT
/begin MEASUREMENT LSU_stClbDisable "Disable-Signal für CJ120-Kalibrierung" UBYTE OneToOne 1 100 0.00 255.0 FORMAT "%5.1" ECU_ADDRESS 0x7F890A /end MEASUREMENT
/begin MEASUREMENT LSU_stClbTrg_mp "CJ125-Kalibrierung bzw. Pumpstromumkehr ist freigegeben" UBYTE OneToOne 1 100 0.00 255.0 FORMAT "%5.1" ECU_ADDRESS 0x8FF886 /end MEASUREMENT
/begin MEASUREMENT LSU_stConstPOp "Statusmessage konstanter Betriebspunkt" UBYTE OneToOne 1 100 0.00 255.0 FORMAT "%5.1" ECU_ADDRESS 0x7F890B /end MEASUREMENT
/begin MEASUREMENT LSU_stNotOpPoint1_mp "Messen des Punktes für Status des Betriebsgebiets 1" UBYTE OneToOne 1 100 0.00 255.0 FORMAT "%5.1" ECU_ADDRESS 0x8FF887 /end MEASUREMENT
/begin MEASUREMENT LSU_stNotOpPoint2_mp "Messen des Punktes für Status des Betriebsgebiets 2" UBYTE OneToOne 1 100 0.00 255.0 FORMAT "%5.1" ECU_ADDRESS 0x8FF888 /end MEASUREMENT
/begin MEASUREMENT LSU_stO2Chk_mp "Bitfeld :: Teildiagnosen durchgeführt" UWORD OneToOne 1 100 0.00 65535.00 FORMAT "%8.2" ARRAY_SIZE 1 ECU_ADDRESS 0x8FF894 /end MEASUREMENT
/begin MEASUREMENT LSU_stO2Err_mp "Statuswort :: Diagnoseergebnisse" UWORD OneToOne 1 100 0.00 65535.00 FORMAT "%8.2" ARRAY_SIZE 1 ECU_ADDRESS 0x8FF896 /end MEASUREMENT
/begin MEASUREMENT LSU_stPlausChkCon_mp "Statuswort Zustand der Voraussetzungen für Plausibilitätscheck" UBYTE OneToOne 1 100 0.00 255.0 FORMAT "%5.1" ECU_ADDRESS 0x8FF898 /end MEASUREMENT
/begin MEASUREMENT LSU_stPlausChk_mp "Statuswort Zustand Plausibilitäts-Check" UBYTE OneToOne 1 100 0.00 255.0 FORMAT "%5.1" ARRAY_SIZE 1 ECU_ADDRESS 0x8FF899 /end MEASUREMENT
/begin MEASUREMENT LSU_stStrtClb "Hilfsvariable für Kalibrierungs-Scheduler" UBYTE OneToOne 1 100 0.00 255.0 FORMAT "%5.1" ECU_ADDRESS 0x7F890C /end MEASUREMENT
/begin MEASUREMENT LSU_stTmrClbPerRun "Status des Kalibrier-Timers" UBYTE OneToOne 1 100 0.00 255.0 FORMAT "%5.1" ECU_ADDRESS 0x7F890D /end MEASUREMENT
/begin MEASUREMENT LSU_tiState1_mp "Timervariable: Kraftstoffmenge liegt innerhalb Toleranzband" UWORD Time_s 1 100 0.00 655.3500 FORMAT "%8.4" ARRAY_SIZE 1 ECU_ADDRESS 0x8FF89A /end MEASUREMENT
/begin MEASUREMENT LSU_tiState2 "Message: Anstiegszeit O2-Signal beim Übergang Last-Schub (Dynamiküberwachung)" UWORD Time_s 1 100 0.00 655.3500 FORMAT "%8.4" ARRAY_SIZE 1 ECU_ADDRESS 0x7F8F16 /end MEASUREMENT
/begin MEASUREMENT LSU_tiState3 "Message: Zeitdauer bis zum Erreichen des Schubs (Kraftstoffmenge kleiner als Schwellwert)" UWORD Time_s 1 100 0.00 655.3500 FORMAT "%8.4" ARRAY_SIZE 1 ECU_ADDRESS 0x7F8F18 /end MEASUREMENT
/begin MEASUREMENT LSU_tiSwitch "Message: Maximal zulässiger Wert für O2-Flankenzeit Last -> Schub" UWORD Time_s 1 100 0.00 655.3500 FORMAT "%8.4" ARRAY_SIZE 1 ECU_ADDRESS 0x7F8F1A /end MEASUREMENT
/begin MEASUREMENT LSU_tiWait3 "Message: maximale Zeitdauer zum erreichen der oberen O2-Schwelle in Dynamiküberwachung" UWORD Time_s 1 100 0.00 655.3500 FORMAT "%8.4" ARRAY_SIZE 1 ECU_ADDRESS 0x7F8F1C /end MEASUREMENT
/begin MEASUREMENT LubCD_ctHigh "" UWORD OneToOne 1 100 0.00 65535.00 FORMAT "%8.2" ECU_ADDRESS 0x7F8F28 /end MEASUREMENT
/begin MEASUREMENT LubCD_ctLow "" UWORD OneToOne 1 100 0.00 65535.00 FORMAT "%8.2" ECU_ADDRESS 0x7F8F2A /end MEASUREMENT
/begin MEASUREMENT LubCD_ctTog "Counter für fallende Flanken" UBYTE OneToOne 1 100 0.00 255.0 FORMAT "%5.1" ECU_ADDRESS 0x7F891F /end MEASUREMENT
/begin MEASUREMENT LubCD_dioIn "" UBYTE OneToOne 1 100 0.00 255.0 FORMAT "%5.1" ECU_ADDRESS 0x7F8920 /end MEASUREMENT
/begin MEASUREMENT LubCD_st "Status LubCD" UBYTE OneToOne 1 100 0.00 255.0 FORMAT "%5.1" ECU_ADDRESS 0x7F8921 /end MEASUREMENT
/begin MEASUREMENT LubCD_stErr_mp "error status" UBYTE OneToOne 1 100 0.00 255.0 FORMAT "%5.1" ECU_ADDRESS 0x8FF8E4 /end MEASUREMENT
/begin MEASUREMENT LubCD_stOelTog "condition oil niveau not valid" UBYTE OneToOne 1 100 0.00 255.0 FORMAT "%5.1" ECU_ADDRESS 0x7F8922 /end MEASUREMENT
/begin MEASUREMENT LubCD_stTOel "Öltemperatur ist valid" UBYTE OneToOne 1 100 0.00 255.0 FORMAT "%5.1" ECU_ADDRESS 0x7F8923 /end MEASUREMENT
/begin MEASUREMENT LubCD_stTog "condition oil niveau valid" UBYTE OneToOne 1 100 0.00 255.0 FORMAT "%5.1" ECU_ADDRESS 0x7F8924 /end MEASUREMENT
/begin MEASUREMENT LubCD_tiHigh_mp "Hightime" UWORD Period_ms 1 100 0.00 6553.500 FORMAT "%8.3" ECU_ADDRESS 0x8FF8E6 /end MEASUREMENT
/begin MEASUREMENT LubCD_tiLow_mp "Lowtime" UWORD Period_ms 1 100 0.00 6553.500 FORMAT "%8.3" ECU_ADDRESS 0x8FF8E8 /end MEASUREMENT
/begin MEASUREMENT LubCD_titk "Periodendauer für Ölniveau" UWORD Period_ms 1 100 0.00 6553.500 FORMAT "%8.3" ECU_ADDRESS 0x7F8F2C /end MEASUREMENT
/begin MEASUREMENT LubCD_titr "Periodendauer Öltemperatur Referenzsignal" UWORD Period_ms 1 100 0.00 6553.500 FORMAT "%8.3" ECU_ADDRESS 0x7F8F2E /end MEASUREMENT
/begin MEASUREMENT LubCD_titv "Periodendauer für Öltemperatur" UWORD Period_ms 1 100 0.00 6553.500 FORMAT "%8.3" ECU_ADDRESS 0x7F8F30 /end MEASUREMENT
/begin MEASUREMENT LubCD_Tog_icnt "" UWORD OneToOne 1 100 0.00 65535.00 FORMAT "%8.2" ECU_ADDRESS 0x7F8F26 /end MEASUREMENT
/begin MEASUREMENT LubCD_Tog_uplcnt "" UBYTE OneToOne 1 100 0.00 255.0 FORMAT "%5.1" ECU_ADDRESS 0x7F891E /end MEASUREMENT
/begin MEASUREMENT MemMon_ctErrChkRam "Fehlerzähler für Doppelablage und zyklischen RAM-Test" UBYTE OneToOne 1 100 0.00 255.0 FORMAT "%5.1" ECU_ADDRESS 0x7F9B4B /end MEASUREMENT
/begin MEASUREMENT MemMon_ctErrChkRom "Fehlerzähler für zyklischen ROM-Test" UBYTE OneToOne 1 100 0.00 255.0 FORMAT "%5.1" ECU_ADDRESS 0x7F9B4C /end MEASUREMENT
/begin MEASUREMENT MemMon_ctHealChkRam "Heilungszähler für Doppelablage und zyklischen RAM-Test" UBYTE Time_ms_40ms 1 100 0.00 10200. FORMAT "%5.0" ECU_ADDRESS 0x7F9B4D /end MEASUREMENT
/begin MEASUREMENT MemMon_ctHealChkRom "Heilungszähler für zyklischen ROM-Test" UBYTE Time_ms_40ms 1 100 0.00 10200. FORMAT "%5.0" ECU_ADDRESS 0x7F9B4E /end MEASUREMENT
/begin MEASUREMENT MemMon_st "Status der Speicherüberwachung" UBYTE OneToOne 1 100 0.00 255.0 FORMAT "%5.1" ECU_ADDRESS 0x7F9B4A /end MEASUREMENT
/begin MEASUREMENT MeUnCD_dcycDT1_mp "Sollwert Tastverhältnis mit DT1-Anteil" SWORD DtyCyc 1 100 -327.6800 327.6700 FORMAT "%8.4" ECU_ADDRESS 0x8FF8EC /end MEASUREMENT
/begin MEASUREMENT MeUnCD_dcycOut_mp "Ausgangstastverhältnis" SWORD DtyCyc 1 100 -327.6800 327.6700 FORMAT "%8.4" ECU_ADDRESS 0x6F812A /end MEASUREMENT
/begin MEASUREMENT MeUnCD_dcycSetValLin_mp "linearisierter Sollwert der Zumesseinheit" SWORD DtyCyc 1 100 -327.6800 327.6700 FORMAT "%8.4" ECU_ADDRESS 0x8FF8EE /end MEASUREMENT
/begin MEASUREMENT MeUnCD_dcycSetVal_mp "Sollwert Tastverhältnis für Zumesseinheit" SWORD DtyCyc 1 100 -327.6800 327.6700 FORMAT "%8.4" ECU_ADDRESS 0x8FF8F0 /end MEASUREMENT
/begin MEASUREMENT MeUnCD_facIGov_mp "Zumesseinheit-Stromregelung I-Anteil" SWORD Fact 1 100 -4.000000 3.999878 FORMAT "%8.6" ECU_ADDRESS 0x8FF8F2 /end MEASUREMENT
/begin MEASUREMENT MeUnCD_iActFlt_mp "Zumesseinheit-Stromregelung gefilterter Strom-Istwert" SWORD Curr 1 100 -32768.00 32767.00 FORMAT "%8.2" ECU_ADDRESS 0x6F812C /end MEASUREMENT
/begin MEASUREMENT MeUnCD_iDvt_mp "Zumesseinheit-Stromregelung Regelabweichung" SWORD Curr 1 100 -32768.00 32767.00 FORMAT "%8.2" ECU_ADDRESS 0x8FF8F4 /end MEASUREMENT
/begin MEASUREMENT MeUnCD_iGovActVal "Analogeingang Strom-Istwert" SWORD Curr 1 100 -32768.00 32767.00 FORMAT "%8.2" ECU_ADDRESS 0x7F8F34 /end MEASUREMENT
/begin MEASUREMENT MeUnCD_iSetFlt "Zumesseinheit-Stromregelung gefilterter Strom-Sollwert" SWORD Curr 1 100 -32768.00 32767.00 FORMAT "%8.2" ECU_ADDRESS 0x7F8F36 /end MEASUREMENT
/begin MEASUREMENT MeUnCD_nDiffRef_mp "gefilterte Drehzahl für Kennlinie" SWORD EngN 1 100 -32768.00 32767.00 FORMAT "%8.2" ECU_ADDRESS 0x8FF8F6 /end MEASUREMENT
/begin MEASUREMENT MeUnCD_tiPer_mp "Periodendauer der PWM-Endstufe" SWORD Period 1 100 -3276.800 3276.700 FORMAT "%8.3" ECU_ADDRESS 0x8FF8F8 /end MEASUREMENT
/begin MEASUREMENT MeUnCD_uRawVal_mp "Analogeingang Spannungsrohwert" SWORD Volt 1 100 -160156.4 160151.5 FORMAT "%8.1" ECU_ADDRESS 0x8FF8FA /end MEASUREMENT
/begin MEASUREMENT MeUn_iSet_mp "Sollstrom für die Zumesseinheit" SWORD Curr 1 100 -32768.00 32767.00 FORMAT "%8.2" ECU_ADDRESS 0x6F8128 /end MEASUREMENT
/begin MEASUREMENT MeUn_stActrCtl_mp "Zustand der Stellwertsteuerung für die Zumesseinheit" UBYTE OneToOne 1 100 0.00 255.0 FORMAT "%5.1" ECU_ADDRESS 0x8FF8EA /end MEASUREMENT
/begin MEASUREMENT MRlyCD_ctTooEarlyInit_mp "Fehlerzähler ""Hauptrelais öffnet zu früh"",Zählerwert nach SG Ini." UBYTE OneToOne 1 100 0.00 255.0 FORMAT "%5.1" ECU_ADDRESS 0x8FF8FC /end MEASUREMENT
/begin MEASUREMENT MRlyCD_ctTooEarly_mp "Fehlerzähler für ""Hauptrelais öffnet zu früh"" Fehler" UBYTE OneToOne 1 100 0.00 255.0 FORMAT "%5.1" ECU_ADDRESS 0x8FF8FD /end MEASUREMENT
/begin MEASUREMENT MRlyCD_stMon "aktueller Zustand der Hauptrelaisüberwachung" UBYTE OneToOne 1 100 0.00 255.0 FORMAT "%5.1" ECU_ADDRESS 0x7F8925 /end MEASUREMENT
/begin MEASUREMENT MRlyCD_stPrevOpening "Bedingung / Grund für das Öffnen des Hauptrelais während letztem Steuergerätelauf" UBYTE OneToOne 1 100 0.00 255.0 FORMAT "%5.1" ECU_ADDRESS 0x7F8926 /end MEASUREMENT
/begin MEASUREMENT MSidCD_numECUS "Anzahl der ECU in diesem system: 1 - 4 (Master/Slave)" UBYTE OneToOne 1 100 0.00 255.0 FORMAT "%5.1" ECU_ADDRESS 0x7F8927 /end MEASUREMENT
/begin MEASUREMENT MSidCD_stCANpriv_mp "Status Plausibilisierung über priv. CAN (entprellt)" UBYTE OneToOne 1 100 0.00 255.0 FORMAT "%5.1" ECU_ADDRESS 0x8FF8FE /end MEASUREMENT
/begin MEASUREMENT MSidCD_stECUCANpriv_mp "Status privater CAN (nicht entprellt)" UWORD OneToOne 1 100 0.00 65535.00 FORMAT "%8.2" ECU_ADDRESS 0x8FF900 /end MEASUREMENT
/begin MEASUREMENT MSidCD_stECUCANPtHelp_mp "Olda privater CAN Fehler-Status Senden um Empfangen" UWORD OneToOne 1 100 0.00 65535.00 FORMAT "%8.2" ECU_ADDRESS 0x8FF902 /end MEASUREMENT
/begin MEASUREMENT MSidCD_stECULearned_mp "Status SG-Auswahl gelernt (EEPROM-info)" UBYTE OneToOne 1 100 0.00 255.0 FORMAT "%5.1" ECU_ADDRESS 0x8FF904 /end MEASUREMENT
/begin MEASUREMENT MSidCD_stECULTmp_mp "Status SG-Auswahl vorläufig gelernt" UBYTE OneToOne 1 100 0.00 255.0 FORMAT "%5.1" ECU_ADDRESS 0x8FF905 /end MEASUREMENT
/begin MEASUREMENT MSidCD_stECUPlaus_mp "Status Plausibilisierung SG-Auswahl" UBYTE OneToOne 1 100 0.00 255.0 FORMAT "%5.1" ECU_ADDRESS 0x8FF906 /end MEASUREMENT
/begin MEASUREMENT MSidCD_stECUSelect_mp "Zusammenfassung Stati SG-Auswahl" UBYTE OneToOne 1 100 0.00 255.0 FORMAT "%5.1" ECU_ADDRESS 0x8FF907 /end MEASUREMENT
/begin MEASUREMENT MSidCD_stECUStatus_mp "Zustandsautomat SG-Auswahl" UBYTE OneToOne 1 100 0.00 255.0 FORMAT "%5.1" ECU_ADDRESS 0x8FF908 /end MEASUREMENT
/begin MEASUREMENT MSidCD_stErrEcuPinComm_mp "State of ECU pin error" UBYTE OneToOne 1 100 0.00 255.0 FORMAT "%5.1" ECU_ADDRESS 0x8FF909 /end MEASUREMENT
/begin MEASUREMENT MSidCD_stErrECUSelect_mp "Errorflag SG-Auswahl nicht plausibel" UBYTE OneToOne 1 100 0.00 255.0 FORMAT "%5.1" ECU_ADDRESS 0x8FF90A /end MEASUREMENT
/begin MEASUREMENT MSidCD_stInjOffECU "Einspritzverbot durch SG-Auswahl" UBYTE OneToOne 1 100 0.00 255.0 FORMAT "%5.1" ECU_ADDRESS 0x7F8928 /end MEASUREMENT
/begin MEASUREMENT MSidCD_stSetEEPROM_mp "Status EEPROM (Schreiben) Lernen (SG-Auswahl)" UBYTE OneToOne 1 100 0.00 255.0 FORMAT "%5.1" ECU_ADDRESS 0x8FF90B /end MEASUREMENT
/begin MEASUREMENT MSidCD_swtECUinfo_mp "Input SG-Auswahl Info-EEPROM" UBYTE OneToOne 1 100 0.00 255.0 FORMAT "%5.1" ECU_ADDRESS 0x8FF90C /end MEASUREMENT
/begin MEASUREMENT MSidCD_swtECUnum_mp "storing EEPROM-info" UBYTE OneToOne 1 100 0.00 255.0 FORMAT "%5.1" ECU_ADDRESS 0x8FF90D /end MEASUREMENT
/begin MEASUREMENT MSidCD_swtMAIN "Typ der ECU: Single ECU=0xFF, Master Slave - Master: 0, Master Slave - Slave: 1,2,3 or 4" SBYTE OneToOne 1 100 -128.0 127.0 FORMAT "%5.1" ECU_ADDRESS 0x7F892A /end MEASUREMENT
/begin MEASUREMENT MSidCD_swtMasterHW_mp "Info SG-Auswahl (plausibilisiert)" SBYTE OneToOne 1 100 -128.0 127.0 FORMAT "%5.1" ECU_ADDRESS 0x8FF90E /end MEASUREMENT
/begin MEASUREMENT MSidCD_swtPinDrive_mp "Status SGA-Pin Rohwert" SBYTE OneToOne 1 100 -128.0 127.0 FORMAT "%5.1" ECU_ADDRESS 0x8FF90F /end MEASUREMENT
/begin MEASUREMENT MSidCD_swtPinECU_mp "Input HW-Pin" SBYTE OneToOne 1 100 -128.0 127.0 FORMAT "%5.1" ECU_ADDRESS 0x8FF910 /end MEASUREMENT
/begin MEASUREMENT NetMng_stCANBus "Status der CAN Controller" ULONG OneToOne 1 100 0.00 4294967295.00 FORMAT "%13.2" ECU_ADDRESS 0x7F91B0 /end MEASUREMENT
/begin MEASUREMENT NetMng_stDfpCanA_mp "" UBYTE OneToOne 1 100 0.00 255.0 FORMAT "%5.1" ECU_ADDRESS 0x8FF911 /end MEASUREMENT
/begin MEASUREMENT NetMng_stDfpCanB_mp "" UBYTE OneToOne 1 100 0.00 255.0 FORMAT "%5.1" ECU_ADDRESS 0x8FF912 /end MEASUREMENT
/begin MEASUREMENT NetMng_stDfpCanC_mp "" UBYTE OneToOne 1 100 0.00 255.0 FORMAT "%5.1" ECU_ADDRESS 0x8FF913 /end MEASUREMENT
/begin MEASUREMENT NetMng_stDfpMaskPtCan_mp "" UBYTE OneToOne 1 100 0.00 255.0 FORMAT "%5.1" ECU_ADDRESS 0x8FF914 /end MEASUREMENT
/begin MEASUREMENT NetMng_stDisableMsg "disable message by diagnosis" UBYTE OneToOne 1 100 0.00 255.0 FORMAT "%5.1" ECU_ADDRESS 0x7F892B /end MEASUREMENT
/begin MEASUREMENT NetMng_stFadeOut "Status der CAN Ausblendung" UWORD OneToOne 1 100 0.00 65535.00 FORMAT "%8.2" ECU_ADDRESS 0x7F8F3A /end MEASUREMENT
/begin MEASUREMENT NetMng_stONWM "Aktueller Zustand des OSEK Netzwerkmanagements" UWORD OneToOne 1 100 0.00 65535.00 FORMAT "%8.2" ECU_ADDRESS 0x7F8F3C /end MEASUREMENT
/begin MEASUREMENT NSC_numPrio "Prioritätszahl des Regenerationsanforderungslevel des NOx-Specherkat" UWORD OneToOne 1 100 0.00 65535.00 FORMAT "%8.2" ECU_ADDRESS 0x7F8F38 /end MEASUREMENT
/begin MEASUREMENT NSC_st "von NOx-Speicherkatalysator angeforderter Regenerationsstatus" ULONG OneToOne 1 100 0.00 4294967295.00 FORMAT "%13.2" ECU_ADDRESS 0x7F91AC /end MEASUREMENT
/begin MEASUREMENT OPSCD_stInactive_mp "Status Abschaltung (Nachlauf,  ABS-Bremsung, Startfall)" UWORD OneToOne 1 100 0.00 65535.00 FORMAT "%8.2" ECU_ADDRESS 0x8FF918 /end MEASUREMENT
/begin MEASUREMENT OPSCD_stLampRun_mp "Meßpunkt für Laufzeitmessung" UWORD OneToOne 1 100 0.00 65535.00 FORMAT "%8.2" ECU_ADDRESS 0x8FF91A /end MEASUREMENT
/begin MEASUREMENT OPSCD_stpOEL "oil pressure sensor signal" UBYTE OneToOne 1 100 0.00 255.0 FORMAT "%5.1" ECU_ADDRESS 0x7F892D /end MEASUREMENT
/begin MEASUREMENT OPSCD_stSigOut "Ausgangssignal Öldruckschalter" UBYTE OneToOne 1 100 0.00 255.0 FORMAT "%5.1" ECU_ADDRESS 0x7F892C /end MEASUREMENT
/begin MEASUREMENT OPSCD_tiDelayAftKL50_mp "Timer output if engine state is start and T50CD debounce state is positive transition" UWORD Time_ms 1 100 0.00 655350.0 FORMAT "%8.1" ECU_ADDRESS 0x8FF91C /end MEASUREMENT
/begin MEASUREMENT OPSCD_uRaw_POEL_mp "Voltage raw value of the oil pressure sensor" SWORD Volt 1 100 -160156.4 160151.5 FORMAT "%8.1" ECU_ADDRESS 0x8FF916 /end MEASUREMENT
/begin MEASUREMENT OTSCD_stPlaus "status der Plausibilitaetspruefung OTF/WTF" UBYTE OneToOne 1 100 0.00 255.0 FORMAT "%5.1" ECU_ADDRESS 0x7F892E /end MEASUREMENT
/begin MEASUREMENT OTSCD_swtSig "Signalquelle Schalter ADC/CAN" UBYTE OneToOne 1 100 0.00 255.0 FORMAT "%5.1" ECU_ADDRESS 0x7F892F /end MEASUREMENT
/begin MEASUREMENT OTSCD_tEngOil "Motoröltemperatur" SWORD Temp_Cels 1 100 -50.140 899.860 FORMAT "%8.3" ECU_ADDRESS 0x7F8F3E /end MEASUREMENT
/begin MEASUREMENT OTSCD_tEngOilLin "linearisierter Wert aus HWK vorm Aufruf der Übergangsfunktion" SWORD Temp_Cels 1 100 -50.140 899.860 FORMAT "%8.3" ECU_ADDRESS 0x7F8F40 /end MEASUREMENT
/begin MEASUREMENT OTSCD_uRaw "Rohwert des OTF-Sensors" SWORD Volt 1 100 -160156.4 160151.5 FORMAT "%8.1" ECU_ADDRESS 0x7F8F42 /end MEASUREMENT
/begin MEASUREMENT OvRMon_ct10MS "In der 10ms Scheibe inkrementierter Zähler, welcher zur Zeitlichen Steuerung von OvRMon_Co verwendet wird." UWORD OneToOne 1 100 0.00 65535.00 FORMAT "%8.2" ECU_ADDRESS 0x7F9B60 /end MEASUREMENT
/begin MEASUREMENT OvRMon_ctDebET_mp "Entprellzähler der Schubüberwachung" UWORD OneToOne 1 100 0.00 65535.00 FORMAT "%8.2" ECU_ADDRESS 0x6F8136 /end MEASUREMENT
/begin MEASUREMENT OvRMon_nAvrg "Redundante mittlere Drehzahl in der Schubüberwachung" SWORD EngN 1 100 -32768.00 32767.00 FORMAT "%8.2" ECU_ADDRESS 0x7F9B86 /end MEASUREMENT
/begin MEASUREMENT OvRMon_nSeg_mp "Mittlere Segmentdrehzahl in der Schubüberwachung" SWORD EngN 1 100 -32768.00 32767.00 FORMAT "%8.2" ECU_ADDRESS 0x8FF930 /end MEASUREMENT
/begin MEASUREMENT OvRMon_phiInjAct_mp "Winkel der zuletzt bearbeiteten Einspritzung" SWORD AngleCrS 1 100 -768.0000 767.9766 FORMAT "%8.4" ECU_ADDRESS 0x8FF934 /end MEASUREMENT
/begin MEASUREMENT OvRMon_stAPPDiff_mp "Status der Fahrpedalüberwachung" UBYTE OneToOne 1 100 0.00 255.0 FORMAT "%5.1" ECU_ADDRESS 0x8FF91E /end MEASUREMENT
/begin MEASUREMENT OvRMon_stBrkDeb_mp "state information" UBYTE OneToOne 1 100 0.00 255.0 FORMAT "%5.1" ECU_ADDRESS 0x6F812E /end MEASUREMENT
/begin MEASUREMENT OvRMon_stBrkFreeze_mp "freeze status of brake plausibility" UBYTE OneToOne 1 100 0.00 255.0 FORMAT "%5.1" ECU_ADDRESS 0x6F812F /end MEASUREMENT
/begin MEASUREMENT OvRMon_stBrkMnSwtDebVal "Brake main switch debounced logical value" UBYTE OneToOne 1 100 0.00 255.0 FORMAT "%5.1" ECU_ADDRESS 0x7F8930 /end MEASUREMENT
/begin MEASUREMENT OvRMon_stBrkMnSwtLastDebVal "Last debounced logical value of Brake main switch" UBYTE OneToOne 1 100 0.00 255.0 FORMAT "%5.1" ECU_ADDRESS 0x7F8931 /end MEASUREMENT
/begin MEASUREMENT OvRMon_stBrkMnSwtLogVal_mp "main brake switch undebounced logical value" UBYTE OneToOne 1 100 0.00 255.0 FORMAT "%5.1" ECU_ADDRESS 0x6F8130 /end MEASUREMENT
/begin MEASUREMENT OvRMon_stBrkMnSwtRawVal "Brake main switch undebounced raw value" UBYTE OneToOne 1 100 0.00 255.0 FORMAT "%5.1" ECU_ADDRESS 0x7F8932 /end MEASUREMENT
/begin MEASUREMENT OvRMon_stBrkPressed "Brake state in a bit coded form whether Surely pressed or May have been pressed" UBYTE OneToOne 1 100 0.00 255.0 FORMAT "%5.1" ECU_ADDRESS 0x7F8933 /end MEASUREMENT
/begin MEASUREMENT OvRMon_stBrkPressed_mp "Meldung Bremse betätigt in der Schubüberwachung" UBYTE OneToOne 1 100 0.00 255.0 FORMAT "%5.1" ECU_ADDRESS 0x8FF924 /end MEASUREMENT
/begin MEASUREMENT OvRMon_stBrkRedSwtDebVal "Brake redundant switch debounced logical value" UBYTE OneToOne 1 100 0.00 255.0 FORMAT "%5.1" ECU_ADDRESS 0x7F8934 /end MEASUREMENT
/begin MEASUREMENT OvRMon_stBrkRedSwtLastDebVal "Last debounced logical value of Brake redundant switch" UBYTE OneToOne 1 100 0.00 255.0 FORMAT "%5.1" ECU_ADDRESS 0x7F8935 /end MEASUREMENT
/begin MEASUREMENT OvRMon_stBrkRedSwtLogVal_mp "redundant  brake switch undebounced logical value" UBYTE OneToOne 1 100 0.00 255.0 FORMAT "%5.1" ECU_ADDRESS 0x6F8131 /end MEASUREMENT
/begin MEASUREMENT OvRMon_stBrkRedSwtPresent "Brake redundant switch present" UBYTE OneToOne 1 100 0.00 255.0 FORMAT "%5.1" ECU_ADDRESS 0x7F8936 /end MEASUREMENT
/begin MEASUREMENT OvRMon_stBrkRedSwtRawVal "Brake redundant switch undebounced raw value" UBYTE OneToOne 1 100 0.00 255.0 FORMAT "%5.1" ECU_ADDRESS 0x7F8937 /end MEASUREMENT
/begin MEASUREMENT OvRMon_stDCS_mp "Status DCS-Eingriff in der Schubüberwachung" UBYTE OneToOne 1 100 0.00 255.0 FORMAT "%5.1" ECU_ADDRESS 0x8FF925 /end MEASUREMENT
/begin MEASUREMENT OvRMon_stEngSpdRls_mp "redundante Erfassung der Drehzahlanforderungsfreigabe in der Überwachungsebene 2" UBYTE OneToOne 1 100 0.00 255.0 FORMAT "%5.1" ECU_ADDRESS 0x8FF926 /end MEASUREMENT
/begin MEASUREMENT OvRMon_stGrip_mp "redundante Kraftschlusserfassung in der Überwachungsebene 2" UBYTE OneToOne 1 100 0.00 255.0 FORMAT "%5.1" ECU_ADDRESS 0x8FF927 /end MEASUREMENT
/begin MEASUREMENT OvRMon_stIntr "Interrupt-Status der operativen Ebene" UBYTE OneToOne 1 100 0.00 255.0 FORMAT "%5.1" ECU_ADDRESS 0x7FC46C /end MEASUREMENT
/begin MEASUREMENT OvRMon_stIntrInactv_mp "Status der Interruptkennung" UBYTE OneToOne 1 100 0.00 255.0 FORMAT "%5.1" ECU_ADDRESS 0x8FF932 /end MEASUREMENT
/begin MEASUREMENT OvRMon_stOvR "Freigabestatus der Schubüberwachung zur Übertragung vom Master zum Slave" UBYTE OneToOne 1 100 0.00 255.0 FORMAT "%5.1" ECU_ADDRESS 0x7F8938 /end MEASUREMENT
/begin MEASUREMENT OvRMon_stRls_mp "Status aller Freigabe Bits für die Schubüberwachung" UWORD OneToOne 1 100 0.00 65535.00 FORMAT "%8.2" ECU_ADDRESS 0x8FF928 /end MEASUREMENT
/begin MEASUREMENT OvRMon_stRun_mp "Status" UWORD OneToOne 1 100 0.00 65535.00 FORMAT "%8.2" ECU_ADDRESS 0x6F8132 /end MEASUREMENT
/begin MEASUREMENT OvRMon_stT15DebVal_mp "Entprelltes Klemme 15 Signal der Schubüberwachung" UBYTE OneToOne 1 100 0.00 255.0 FORMAT "%5.1" ECU_ADDRESS 0x8FF92A /end MEASUREMENT
/begin MEASUREMENT OvRMon_stTSCInc_mp "Status erhöhender Eingriff Getriebesteuerung in der Schubüberwachung" UBYTE OneToOne 1 100 0.00 255.0 FORMAT "%5.1" ECU_ADDRESS 0x8FF92B /end MEASUREMENT
/begin MEASUREMENT OvRMon_swtBrkSig "Brake signal source switch DIO/CAN" UBYTE OneToOne 1 100 0.00 255.0 FORMAT "%5.1" ECU_ADDRESS 0x7F893A /end MEASUREMENT
/begin MEASUREMENT OvRMon_tiDebBrkTmrPlaus_mp "current debounce time for plausibility check" UWORD Time_ms 1 100 0.00 655350.0 FORMAT "%8.1" ECU_ADDRESS 0x6F8134 /end MEASUREMENT
/begin MEASUREMENT OvRMon_tiInjAct_mp "Ansteuerdauer der zuletzt bearbeiteten Einspritzung" UWORD InjTime_us 1 100 0.00 65535.00 FORMAT "%8.2" ECU_ADDRESS 0x8FF936 /end MEASUREMENT
/begin MEASUREMENT OvRMon_tiIntrSysAct "Systemzeit vom aktuellen Main-Interrupt" ULONG OneToOne 1 100 0.00 4294967295.00 FORMAT "%13.2" ECU_ADDRESS 0x7FC464 /end MEASUREMENT
/begin MEASUREMENT OvRMon_tiIntrSysLst "Systemzeit vom vorhergehenden Main-Interrupt" ULONG OneToOne 1 100 0.00 4294967295.00 FORMAT "%13.2" ECU_ADDRESS 0x7FC468 /end MEASUREMENT
/begin MEASUREMENT OvRMon_tiLimET_mp "Obergrenze der Ansteuerdauer der Schubüberwachung" SWORD InjTime_us 1 100 -32768.00 32767.00 FORMAT "%8.2" ECU_ADDRESS 0x8FF92C /end MEASUREMENT
/begin MEASUREMENT OvRMon_tiTDCAvrg "Mittlere momentwirksame Ansteuerdauer pro Zylinder in der Schubüberwachung" UWORD InjTime_us 1 100 0.00 65535.00 FORMAT "%8.2" ECU_ADDRESS 0x7FC470 /end MEASUREMENT
/begin MEASUREMENT OvRMon_tiTDCAvrgCpl "Komplement der mittleren momentwirksamen Ansteuerdauer pro Zylinder in der Schubüberwachung" UWORD InjTime_us 1 100 0.00 65535.00 FORMAT "%8.2" ECU_ADDRESS 0x7FC472 /end MEASUREMENT
/begin MEASUREMENT OvRMon_tiTDCSumET_mp "Summe der momentwirksamen Ansteuerdauern eines Zylinders" UWORD InjTime_us 1 100 0.00 65535.00 FORMAT "%8.2" ECU_ADDRESS 0x8FF938 /end MEASUREMENT
/begin MEASUREMENT OvRMon_uRawAPP1_mp "APP1 - Fahrpedalrohwert über OvRMon eingelesen" SWORD Volt 1 100 -160156.4 160151.5 FORMAT "%8.1" ECU_ADDRESS 0x8FF92E /end MEASUREMENT
/begin MEASUREMENT OvRMon_uRegAPP1_mp "ADC-Registerwert der Position von Fahrpedal 1" SWORD Volt 1 100 -160156.4 160151.5 FORMAT "%8.1" ECU_ADDRESS 0x8FF920 /end MEASUREMENT
/begin MEASUREMENT OvRMon_uRegAPP2_mp "ADC-Registerwert der Position von Fahrpedal 2" SWORD Volt 1 100 -160156.4 160151.5 FORMAT "%8.1" ECU_ADDRESS 0x8FF922 /end MEASUREMENT
/begin MEASUREMENT OxiCCD_tLinPre "linearisierter Wert Abgastemperatur vor Oxidationskatalysator" SWORD Temp_Cels 1 100 -50.140 899.860 FORMAT "%8.3" ECU_ADDRESS 0x7F8F44 /end MEASUREMENT
/begin MEASUREMENT OxiCCD_tPre "Abgastemperatur vor Oxidationskatalysator" SWORD Temp_Cels 1 100 -50.140 899.860 FORMAT "%8.3" ECU_ADDRESS 0x7F8F46 /end MEASUREMENT
/begin MEASUREMENT OxiCCD_uRawTempPre "Abgastemperatur vor Oxidationskatalysator Rohwert" SWORD Volt 1 100 0.00 5000.000 FORMAT "%8.3" ECU_ADDRESS 0x7F8F48 /end MEASUREMENT
/begin MEASUREMENT PCBS_dAvaiDiag_mp "measure point for availability for reset CBS message with diagnose" UBYTE OneToOne 1 100 0.00 255.0 FORMAT "%5.1" ECU_ADDRESS 0x8FF93C /end MEASUREMENT
/begin MEASUREMENT PCBS_dAvaiDMEChg_mp "measure point for availability after DME change" UBYTE OneToOne 1 100 0.00 255.0 FORMAT "%5.1" ECU_ADDRESS 0x8FF93D /end MEASUREMENT
/begin MEASUREMENT PCBS_dAvaiOut "availability (CAN: AVAI_BOS_MESS)" UBYTE OneToOne 1 100 0.00 255.0 FORMAT "%5.1" ECU_ADDRESS 0x7F893B /end MEASUREMENT
/begin MEASUREMENT PCBS_dAvai_mp "availability befor DME change calculation" UBYTE OneToOne 1 100 0.00 255.0 FORMAT "%5.1" ECU_ADDRESS 0x8FF93E /end MEASUREMENT
/begin MEASUREMENT PCBS_lDistanceDMEChg_mp "kilometer value to reduce the output value" SWORD km_sw_q10 1 100 -327680.0 327670.0 FORMAT "%8.1" ECU_ADDRESS 0x8FF940 /end MEASUREMENT
/begin MEASUREMENT PCBS_lDistanceOut "Available rest distance" SWORD km_sw_q10 1 100 -327680.0 327670.0 FORMAT "%8.1" ECU_ADDRESS 0x7F8F4A /end MEASUREMENT
/begin MEASUREMENT PCBS_lDistance_mp "rest kilometer value befor DME change calculation" SWORD km_sw_q10 1 100 -327680.0 327670.0 FORMAT "%8.1" ECU_ADDRESS 0x8FF944 /end MEASUREMENT
/begin MEASUREMENT PCBS_lMaxDistance_mp "maximum of the curve PCBS_lCalcDistance_CUR" SWORD km_sw_q10 1 100 -327680.0 327670.0 FORMAT "%8.1" ECU_ADDRESS 0x8FF946 /end MEASUREMENT
/begin MEASUREMENT PCBS_stCBSMsg "state for CBS message" UBYTE OneToOne 1 100 0.00 255.0 FORMAT "%5.1" ECU_ADDRESS 0x7F893C /end MEASUREMENT
/begin MEASUREMENT PCBS_stCntChgCAN_mp "measure point for service value after CBS reset by CAN" UBYTE OneToOne 1 100 0.00 255.0 FORMAT "%5.1" ECU_ADDRESS 0x8FF948 /end MEASUREMENT
/begin MEASUREMENT PCBS_stCntChgDIAG_mp "measure point for service value after CBS reset by diagnose" UBYTE OneToOne 1 100 0.00 255.0 FORMAT "%5.1" ECU_ADDRESS 0x8FF949 /end MEASUREMENT
/begin MEASUREMENT PCBS_stCntChg_mp "measure point for service value after CBS reset" UBYTE OneToOne 1 100 0.00 255.0 FORMAT "%5.1" ECU_ADDRESS 0x8FF94A /end MEASUREMENT
/begin MEASUREMENT PCBS_stCntDiag_mp "measure point service counter for reset CBS message with diagnose" UBYTE OneToOne 1 100 0.00 255.0 FORMAT "%5.1" ECU_ADDRESS 0x8FF94B /end MEASUREMENT
/begin MEASUREMENT PCBS_stCntValOut "service counter value" UBYTE OneToOne 1 100 0.00 255.0 FORMAT "%5.1" ECU_ADDRESS 0x7F893D /end MEASUREMENT
/begin MEASUREMENT PCBS_stCntVal_mp "measure point for service counter value after CBS reset" UBYTE OneToOne 1 100 0.00 255.0 FORMAT "%5.1" ECU_ADDRESS 0x8FF94C /end MEASUREMENT
/begin MEASUREMENT PCBS_stDMEChg_mp "measure point for availability for reset CBS message with diagnose" UBYTE OneToOne 1 100 0.00 255.0 FORMAT "%5.1" ECU_ADDRESS 0x8FF94D /end MEASUREMENT
/begin MEASUREMENT PCBS_stDMEIni_mp "measure point for CBS function init" UBYTE OneToOne 1 100 0.00 255.0 FORMAT "%5.1" ECU_ADDRESS 0x8FF94E /end MEASUREMENT
/begin MEASUREMENT PCBS_stIDMsg "ID for CBS message" UWORD OneToOne 1 100 0.00 65535.00 FORMAT "%8.2" ECU_ADDRESS 0x7F8F4C /end MEASUREMENT
/begin MEASUREMENT PCBS_stPFltChgCAN_mp "measure point which shows if particulate filter were changed by CAN" UBYTE OneToOne 1 100 0.00 255.0 FORMAT "%5.1" ECU_ADDRESS 0x8FF94F /end MEASUREMENT
/begin MEASUREMENT PCBS_stPFltChgDIAG_mp "measure point which shows if particulate filter were changed by diagnose" UBYTE OneToOne 1 100 0.00 255.0 FORMAT "%5.1" ECU_ADDRESS 0x8FF950 /end MEASUREMENT
/begin MEASUREMENT PCBS_stPFltChg_mp "measure point which shows if particulate filter were changed" UBYTE OneToOne 1 100 0.00 255.0 FORMAT "%5.1" ECU_ADDRESS 0x8FF951 /end MEASUREMENT
/begin MEASUREMENT PCBS_stResetDiag_mp "measure point for reset CBS message for PFlt with diagnose" UBYTE OneToOne 1 100 0.00 255.0 FORMAT "%5.1" ECU_ADDRESS 0x8FF952 /end MEASUREMENT
/begin MEASUREMENT PCBS_stUnit "unit of mearurement for CBS" UBYTE OneToOne 1 100 0.00 255.0 FORMAT "%5.1" ECU_ADDRESS 0x7F893E /end MEASUREMENT
/begin MEASUREMENT PCR_bpMap_mp "Calculation of the correction factor based on atmospheric factor" UBYTE OneToOne 1 100 0.00 255.0 FORMAT "%5.1" ECU_ADDRESS 0x8FF984 /end MEASUREMENT
/begin MEASUREMENT PCR_dnAvrgNeg_mp "Rate of change of engine speed in negative direction" SWORD dn_dZ20 1 100 -327680.0 327670.0 FORMAT "%8.1" ECU_ADDRESS 0x8FF970 /end MEASUREMENT
/begin MEASUREMENT PCR_dnSurgeHigh_mp "Higher limit for hysteresis to monitor rate of change of Eng_nAvrg for Anti-Surge LIGov" SWORD dn_dZ20 1 100 -327680.0 327670.0 FORMAT "%8.1" ECU_ADDRESS 0x8FF972 /end MEASUREMENT
/begin MEASUREMENT PCR_dnSurgeLow_mp "Lower limit for hysteresis to monitor rate of change of Eng_nAvrg for Anti-Surge LIGov" SWORD dn_dZ20 1 100 -327680.0 327670.0 FORMAT "%8.1" ECU_ADDRESS 0x8FF974 /end MEASUREMENT
/begin MEASUREMENT PCR_dqDes_mp "Einspritzmengen-Änderung" SWORD InjMassPerSec_20ms 1 100 -16384.00 16383.50 FORMAT "%8.2" ECU_ADDRESS 0x8FF986 /end MEASUREMENT
/begin MEASUREMENT PCR_drAPP1UnFlt_mp "Measuring point for ratio of Accelerator pedal 1 position - Unfiltered value" SWORD PrcPerSec 1 100 -20000.00 19999.39 FORMAT "%8.2" ECU_ADDRESS 0x8FF988 /end MEASUREMENT
/begin MEASUREMENT PCR_facATRgn_mp "lufttemperaturabhängigerKorrekturfactor bei Regenerationsbetrieb" SWORD Fact 1 100 -4.000000 3.999878 FORMAT "%8.6" ECU_ADDRESS 0x8FF98A /end MEASUREMENT
/begin MEASUREMENT PCR_facAT_mp "Lufttemperaturabhängiger Faktor für Sollwertberechnung" SWORD Fact 1 100 -4.000000 3.999878 FORMAT "%8.6" ECU_ADDRESS 0x8FF98C /end MEASUREMENT
/begin MEASUREMENT PCR_facCtQ_mp "Kühltemperaturabhängiger Faktor für Sollwertberechnung" SWORD Fact 1 100 -4.000000 3.999878 FORMAT "%8.6" ECU_ADDRESS 0x8FF98E /end MEASUREMENT
/begin MEASUREMENT PCR_facN_mp "Faktor für Berücksichtigung der Drehzahl DesValCalc" SWORD Fact 1 100 -4.000000 3.999878 FORMAT "%8.6" ECU_ADDRESS 0x8FF990 /end MEASUREMENT
/begin MEASUREMENT PCR_nSetPointSurge "Set Point for Anti-Surge LIGov" SWORD EngN 1 100 -32768.00 32767.00 FORMAT "%8.2" ECU_ADDRESS 0x7F8F50 /end MEASUREMENT
/begin MEASUREMENT PCR_pAPQCmpnRgn_mp "atmosphärendruckabhängigen Korrekturwert bei Regenerationsbetrieb" SWORD Pres 1 100 -32768.00 32767.00 FORMAT "%9.2" ECU_ADDRESS 0x8FF992 /end MEASUREMENT
/begin MEASUREMENT PCR_pAPQCmpn_mp "luftdruckabhängige Kompensation für Sollwertbildung" SWORD Pres 1 100 -32768.00 32767.00 FORMAT "%9.2" ECU_ADDRESS 0x8FF994 /end MEASUREMENT
/begin MEASUREMENT PCR_pBasMAP_mp "stationärer Ladedrucksollwert aus Basiskennfeld" SWORD Pres 1 100 -32768.00 32767.00 FORMAT "%9.2" ECU_ADDRESS 0x8FF996 /end MEASUREMENT
/begin MEASUREMENT PCR_pBDesAPCorrRgn1_mp "in Abhängigkeit des atmosphärendruck korrigierter Sollwert aus erstem Regenerationskennfeld" SWORD Pres 1 100 -32768.00 32767.00 FORMAT "%9.2" ECU_ADDRESS 0x8FF998 /end MEASUREMENT
/begin MEASUREMENT PCR_pBDesAPCorrRgn2_mp "in Abhängigkeit des atmosphärendrucks korrigierter Sollwert aus zweitem Regenerationskennfeld" SWORD Pres 1 100 -32768.00 32767.00 FORMAT "%9.2" ECU_ADDRESS 0x8FF99A /end MEASUREMENT
/begin MEASUREMENT PCR_pBDesAPCorr_mp "Luftdruckabhängige Korrektur des Ladedrucksollwerts" SWORD Pres 1 100 -32768.00 32767.00 FORMAT "%9.2" ECU_ADDRESS 0x8FF99C /end MEASUREMENT
/begin MEASUREMENT PCR_pBDesATCorrRgn1_mp "korrigierter Ladedrucksollwert aus Regenerationskennfeld 1" SWORD Pres 1 100 -32768.00 32767.00 FORMAT "%9.2" ECU_ADDRESS 0x8FF99E /end MEASUREMENT
/begin MEASUREMENT PCR_pBDesATCorrRgn2_mp "korriegerter Ladedrucksollwert aus zweitem Regenerationskennfeld 2" SWORD Pres 1 100 -32768.00 32767.00 FORMAT "%9.2" ECU_ADDRESS 0x8FF9A0 /end MEASUREMENT
/begin MEASUREMENT PCR_pBDesATCorr_mp "Bezüglich Lufttemperatur korrigierter Ladedrucksollwert" SWORD Pres 1 100 -32768.00 32767.00 FORMAT "%9.2" ECU_ADDRESS 0x8FF9A2 /end MEASUREMENT
/begin MEASUREMENT PCR_pBDesCtCorr_mp "Kühltemperaturkorrigierter Wert des Ladedrucksollwerts" SWORD Pres 1 100 -32768.00 32767.00 FORMAT "%9.2" ECU_ADDRESS 0x8FF9A4 /end MEASUREMENT
/begin MEASUREMENT PCR_pBDesDyn_mp "Dynamischer Teil des Ladedrucksollwerts" SWORD Pres_hPa 1 100 -32768.00 32767.00 FORMAT "%8.2" ECU_ADDRESS 0x8FF9A6 /end MEASUREMENT
/begin MEASUREMENT PCR_pBDesMaxAP_mp "Größter erlaubter Ladedrucksollwert in Abhängigkeit vom Luftdruck" SWORD Pres 1 100 -32768.00 32767.00 FORMAT "%9.2" ECU_ADDRESS 0x8FF9A8 /end MEASUREMENT
/begin MEASUREMENT PCR_pBDesNCorr_mp "Boost press. value corr. by eng. spd. fac." SWORD Pres 1 100 -32768.00 32767.00 FORMAT "%9.2" ECU_ADDRESS 0x8FF9AA /end MEASUREMENT
/begin MEASUREMENT PCR_pBDesRaw2_mp "Unlimited desired boost pressure with rampcontrol." SWORD Pres_hPa 1 100 -32768.00 32767.00 FORMAT "%8.2" ECU_ADDRESS 0x8FF9AC /end MEASUREMENT
/begin MEASUREMENT PCR_pBDesRaw_mp "Unbegrenzter Ladedrucksollwert mit Vorsteuerung" SWORD Pres_hPa 1 100 -32768.00 32767.00 FORMAT "%8.2" ECU_ADDRESS 0x8FF9AE /end MEASUREMENT
/begin MEASUREMENT PCR_pBDesStat_mp "Stationärer Teil des Ladedrucksollwerts" SWORD Pres 1 100 -32768.00 32767.00 FORMAT "%9.2" ECU_ADDRESS 0x8FF9B0 /end MEASUREMENT
/begin MEASUREMENT PCR_pBDes_mp "gewälter unbegrenzerter Ladedrucksollwert" SWORD Pres 1 100 -32768.00 32767.00 FORMAT "%9.2" ECU_ADDRESS 0x8FF9B2 /end MEASUREMENT
/begin MEASUREMENT PCR_pDesByp_mp "Bypass-Label, Kopie von PCR_pBDes" SWORD Pres_hPa 1 100 -32768.00 32767.00 FORMAT "%8.2" ECU_ADDRESS 0x8FF9B4 /end MEASUREMENT
/begin MEASUREMENT PCR_pDesVal "Ladedrucksollwert" SWORD Pres_hPa 1 100 -32768.00 32767.00 FORMAT "%8.2" ECU_ADDRESS 0x7F8F56 /end MEASUREMENT
/begin MEASUREMENT PCR_pNQCtCmpn_mp "Korrekturwert für Kühlwassertemperaturkorrektur für Sollwertberechnung" SWORD Pres 1 100 -32768.00 32767.00 FORMAT "%9.2" ECU_ADDRESS 0x8FF9B6 /end MEASUREMENT
/begin MEASUREMENT PCR_pRgnMAP1_mp "stationärer Ladedrucksollwert aus erstem Regenerationskennfeld" SWORD Pres 1 100 -32768.00 32767.00 FORMAT "%9.2" ECU_ADDRESS 0x8FF9B8 /end MEASUREMENT
/begin MEASUREMENT PCR_pRgnMAP2_mp "stationärer Ladedrucksollwert aus zweitem Regenerationskennfeld" SWORD Pres 1 100 -32768.00 32767.00 FORMAT "%9.2" ECU_ADDRESS 0x8FF9BA /end MEASUREMENT
/begin MEASUREMENT PCR_qCtlFrmMngTrqInr_mp "Controlled quantity based on FrmMng_trqInr and FMTC_etaCurr" SWORD InjMass 1 100 -327.6800 327.6700 FORMAT "%8.4" ECU_ADDRESS 0x8FF954 /end MEASUREMENT
/begin MEASUREMENT PCR_qCtl_mp "für die Ladedruck Steuerung begrenzte Einspritzmenge" SWORD InjMassCyc 1 100 -327.6800 327.6700 FORMAT "%8.4" ECU_ADDRESS 0x8FF956 /end MEASUREMENT
/begin MEASUREMENT PCR_qDes "Einspritzmenge für Sollwertbildung" SWORD InjMass 1 100 -327.6800 327.6700 FORMAT "%8.4" ECU_ADDRESS 0x7F8F58 /end MEASUREMENT
/begin MEASUREMENT PCR_qDesFrmMngTrqInr_mp "Desired quantity based on FrmMng_trqInr and FMTC_etaCurr" SWORD InjMassCyc 1 100 -327.6800 327.6700 FORMAT "%8.4" ECU_ADDRESS 0x8FF9BC /end MEASUREMENT
/begin MEASUREMENT PCR_qSurgeHigh_mp "Higher quantity limit for hysteresis of Anti-Surge LIGov" SWORD InjMass 1 100 -327.6800 327.6700 FORMAT "%8.4" ECU_ADDRESS 0x8FF976 /end MEASUREMENT
/begin MEASUREMENT PCR_qSurgeLow_mp "Lower quantity limit for hysteresis of Anti-Surge LIGov" SWORD InjMass 1 100 -327.6800 327.6700 FORMAT "%8.4" ECU_ADDRESS 0x8FF978 /end MEASUREMENT
/begin MEASUREMENT PCR_rBalGvnrDiff "Tastverhältnis Gleichstellungsregler" SWORD Prc 1 100 -400.0000 399.9878 FORMAT "%8.4" ECU_ADDRESS 0x7F8F68 /end MEASUREMENT
/begin MEASUREMENT PCR_rBPCtlAPCorrRgn_mp "in Abhängigkeit des Atmosphärendruckskorrigierter Steuerwert bei Regenerationsbetrieb" SWORD Prc 1 100 -400.0000 399.9878 FORMAT "%8.4" ECU_ADDRESS 0x8FF958 /end MEASUREMENT
/begin MEASUREMENT PCR_rBPCtlAPCorr_mp "in Abhängigkeit des Atmosphärendrucks korrigierter Steuerwert" SWORD Prc 1 100 -400.0000 399.9878 FORMAT "%8.4" ECU_ADDRESS 0x8FF95A /end MEASUREMENT
/begin MEASUREMENT PCR_rBPCtlATCorrRgn_mp "Lufttemperaturabhängige Korrektur im Regenerationsbetrieb" SWORD Prc 1 100 -400.0000 399.9878 FORMAT "%8.4" ECU_ADDRESS 0x8FF95C /end MEASUREMENT
/begin MEASUREMENT PCR_rBPCtlATCorr_mp "Lufttemperaturabhängige Korrektur" SWORD Prc 1 100 -400.0000 399.9878 FORMAT "%8.4" ECU_ADDRESS 0x8FF95E /end MEASUREMENT
/begin MEASUREMENT PCR_rBPCtlBasCorr_mp "Corrected value in normal operation" SWORD Prc 1 100 -400.0000 399.9878 FORMAT "%8.4" ECU_ADDRESS 0x8FF960 /end MEASUREMENT
/begin MEASUREMENT PCR_rBPCtlBasRgn1Corr_mp "Corrected value for particle filter soot mass" SWORD Prc 1 100 -400.0000 399.9878 FORMAT "%8.4" ECU_ADDRESS 0x8FF962 /end MEASUREMENT
/begin MEASUREMENT PCR_rBPCtlBasRgn1_mp "Basisregenerationswert 1" SWORD Prc 1 100 -400.0000 399.9878 FORMAT "%8.4" ECU_ADDRESS 0x8FF964 /end MEASUREMENT
/begin MEASUREMENT PCR_rBPCtlBasRgn2_mp "Basisregenerationswert 2" SWORD Prc 1 100 -400.0000 399.9878 FORMAT "%8.4" ECU_ADDRESS 0x8FF966 /end MEASUREMENT
/begin MEASUREMENT PCR_rBPCtlBas_mp "Basissteuerwert für Ladedruck" SWORD Prc 1 100 -400.0000 399.9878 FORMAT "%8.4" ECU_ADDRESS 0x8FF968 /end MEASUREMENT
/begin MEASUREMENT PCR_rCtlSurgeBas_mp "boost pressure control value for Anti-Surge LIGov" SWORD Prc 1 100 -400.0000 399.9878 FORMAT "%8.4" ECU_ADDRESS 0x8FF96A /end MEASUREMENT
/begin MEASUREMENT PCR_rCtlVal "Ladedruck Steueranteil der Stellgrösse" SWORD Prc 1 100 -400.0000 399.9878 FORMAT "%8.4" ECU_ADDRESS 0x7F8F6A /end MEASUREMENT
/begin MEASUREMENT PCR_rCtlVal1_mp "coolant temperature corrected value of desired boost pressure control" SWORD Prc 1 100 -400.0000 399.9878 FORMAT "%8.4" ECU_ADDRESS 0x8FF96C /end MEASUREMENT
/begin MEASUREMENT PCR_rCtlVal2_mp "air pressure corrected value of desired boost pressure control" SWORD Prc 1 100 -400.0000 399.9878 FORMAT "%8.4" ECU_ADDRESS 0x8FF96E /end MEASUREMENT
/begin MEASUREMENT PCR_rSurgeHysHigh_mp "Higher ATL pressure ratio limit for hysteresis of Anti-Surge LIGov" SWORD Prc 1 100 -400.0000 399.9878 FORMAT "%8.4" ECU_ADDRESS 0x8FF97A /end MEASUREMENT
/begin MEASUREMENT PCR_rSurgeHysLow_mp "Lower ATL pressure ratio limit for hysteresis of Anti-Surge LIGov" SWORD Prc 1 100 -400.0000 399.9878 FORMAT "%8.4" ECU_ADDRESS 0x8FF97C /end MEASUREMENT
/begin MEASUREMENT PCR_rSurgeLIGov_mp "ALT Pressure ratio for Anti-Surge LIGov" SWORD Prc 1 100 -400.0000 399.9878 FORMAT "%8.4" ECU_ADDRESS 0x8FF97E /end MEASUREMENT
/begin MEASUREMENT PCR_stBDesLogic_mp "Status bits based on which raw or ramped unlimited desired boost pressure selection is made." UBYTE OneToOne 1 100 0.00 255.0 FORMAT "%5.1" ECU_ADDRESS 0x8FF9BE /end MEASUREMENT
/begin MEASUREMENT PCR_stCmpEnd_mp "Calculation of the correction factor based on atmospheric factor" UBYTE OneToOne 1 100 0.00 255.0 FORMAT "%5.1" ECU_ADDRESS 0x8FF9BF /end MEASUREMENT
/begin MEASUREMENT PCR_stSurge1 "Anti-Surge LIGov status1" UBYTE OneToOne 1 100 0.00 255.0 FORMAT "%5.1" ECU_ADDRESS 0x7F8942 /end MEASUREMENT
/begin MEASUREMENT PCR_stSurge1_mp "Anti-Surge LIGov status1 without engine speed monitoring" UBYTE OneToOne 1 100 0.00 255.0 FORMAT "%5.1" ECU_ADDRESS 0x8FF980 /end MEASUREMENT
/begin MEASUREMENT PCR_stSurge2 "Anti-Surge LIGov status2" UBYTE OneToOne 1 100 0.00 255.0 FORMAT "%5.1" ECU_ADDRESS 0x7F8943 /end MEASUREMENT
/begin MEASUREMENT PCR_stSurgePre1_mp "Pre1 status of  Anti-Surge LIGov" UBYTE OneToOne 1 100 0.00 255.0 FORMAT "%5.1" ECU_ADDRESS 0x8FF981 /end MEASUREMENT
/begin MEASUREMENT PCR_stSurgePre2_mp "Pre2 status of  Anti-Surge LIGov" UBYTE OneToOne 1 100 0.00 255.0 FORMAT "%5.1" ECU_ADDRESS 0x8FF982 /end MEASUREMENT
/begin MEASUREMENT PCR_swtQntCtl "Schalter zur Auswahl der für Steuerung verwendeten Einspritzmenge" UBYTE OneToOne 1 100 0.00 255.0 FORMAT "%5.1" ECU_ADDRESS 0x7F8947 /end MEASUREMENT
/begin MEASUREMENT PCR_swtQntDes "Schalter für Mengeneingangswunsch bei der Sollwertberechnung" UBYTE OneToOne 1 100 0.00 255.0 FORMAT "%5.1" ECU_ADDRESS 0x7F8948 /end MEASUREMENT
/begin FUNCTION lsuctl "Regelung zur Lambdaerfassung"
 /begin DEF_CHARACTERISTIC LSUCtl_tUpLim_C LSUCtl_tLowLim_C LSUCtl_tRiSetPoint_C LSUCtl_tHtCtlEna_C LSUCtl_nHtCtlEna_C LSUCtl_dcycHtMin_C LSUCtl_tExcMax_C LSUCtl_tExcMin_C LSUCtl_tiDelIniVal_C LSUCtl_dcycRmpUp_C LSUCtl_dcycRmpDwn_C LSUCtl_dcycStrt_CUR LSUCtl_tiDebRiExcMaxDef_C LSUCtl_tiDebRiExcMaxOk_C LSUCtl_tiDebRiExcMinDef_C LSUCtl_tiDebRiExcMinOk_C LSUCtl_tiSens1HtDT1_C LSUCtl_Sens1HtDT1Kd_C LSUCtl_Sens1HtIKi_C LSUCtl_Sens1HtIKiPos_C LSUCtl_Sens1HtIKiNeg_C LSUCtl_tSens1HtIWinPos_C LSUCtl_tSens1HtIWinNeg_C LSUCtl_Sens1HtPKp_C LSUCtl_Sens1HtPKpPos_C LSUCtl_Sens1HtPKpNeg_C LSUCtl_tSens1HtPWinPos_C LSUCtl_tSens1HtPWinNeg_C LSUCtl_tiSens2HtDT1_C LSUCtl_Sens2HtDT1Kd_C LSUCtl_Sens2HtIKi_C LSUCtl_Sens2HtIKiPos_C LSUCtl_Sens2HtIKiNeg_C LSUCtl_tSens2HtIWinPos_C LSUCtl_tSens2HtIWinNeg_C LSUCtl_Sens2HtPKp_C LSUCtl_Sens2HtPKpPos_C LSUCtl_Sens2HtPKpNeg_C LSUCtl_tSens2HtPWinPos_C LSUCtl_tSens2HtPWinNeg_C /end DEF_CHARACTERISTIC
 /begin OUT_MEASUREMENT LSUCtl_dcycDT1_mp LSUCtl_dcycPI_mp LSUCtl_stRmp_mp LSUCtl_tAirStrt_mp LSUCtl_tDvt_mp /end OUT_MEASUREMENT
/end FUNCTION
/begin FUNCTION lsuctl_msg ""
 /begin OUT_MEASUREMENT LSUCtl_dcycHt LSUCtl_dcycHtIniRamp LSUCtl_dcycHtStrt LSUCtl_stHtCtl LSUCtl_stHtDisable LSUCtl_stSCUNEna /end OUT_MEASUREMENT
/end FUNCTION
/begin FUNCTION lsu_clbsched "Lambda-Sensor Universal-Kalibrierungs-Scheduler"
 /begin DEF_CHARACTERISTIC LSU_ctRgnEna_C LSU_mAirMaxClb1_C LSU_mAirMaxClb2_C LSU_mAirMinClb1_C LSU_mAirMinClb2_C LSU_nMaxClb1_C LSU_nMaxClb2_C LSU_nMinClb1_C LSU_nMinClb2_C LSU_qMaxClb1_C LSU_qMaxClb2_C LSU_qMinClb1_C LSU_qMinClb2_C LSU_stChpClbActv_C LSU_stEGTClbOff_C LSU_ti1stClb_C LSU_tiPerClb_C LSU_uMinClb_C /end DEF_CHARACTERISTIC
 /begin OUT_MEASUREMENT LSU_stClbTrg_mp LSU_stNotOpPoint1_mp LSU_stNotOpPoint2_mp /end OUT_MEASUREMENT
/end FUNCTION
/begin FUNCTION lsu_clbsched_msg "" /begin OUT_MEASUREMENT LSU_stClbDisable LSU_stStrtClb LSU_stTmrClbPerRun /end OUT_MEASUREMENT /end FUNCTION
/begin FUNCTION lsu_conf ""
 /begin DEF_CHARACTERISTIC LSUCD_stCJChpSel_C LSUCD_stRgnEna_C LSU_dcycMax_C LSU_tiBattHighDebNeg_C LSU_tiBattHighDebPos_C LSU_tiOvrRunDebNeg_C LSU_tiOvrRunDebPos_C LSU_swtVal_C LSU_swtType_C LSU_uBattMin_C /end DEF_CHARACTERISTIC
/end FUNCTION
/begin FUNCTION lsu_lmbdcalc "Berechnung Lambda und 1/Lambda" /begin DEF_CHARACTERISTIC LSU_rLmbdRec_CUR /end DEF_CHARACTERISTIC /begin OUT_MEASUREMENT LSU_rO2AdptLastLSU_mp /end OUT_MEASUREMENT /end FUNCTION
/begin FUNCTION lsu_lmbdcalc_msg "" /end FUNCTION
/begin FUNCTION lsu_lmbdcalc_msg_var "" /begin OUT_MEASUREMENT LSU_rLmbd LSU_rLmbdRec LSU_rO2Adpt /end OUT_MEASUREMENT /end FUNCTION
/begin FUNCTION lsu_lmbdcalc_uic "" /end FUNCTION
/begin FUNCTION lsu_mon "Lambda-Sensor Universal-Diagnosefunktion"
 /begin DEF_CHARACTERISTIC LSU_DebDynErrDef_C LSU_DebDynErrOk_C LSU_DebO2ConcHighDef_C LSU_DebO2ConcHighOk_C LSU_DebO2ConcLowDef_C LSU_DebO2ConcLowOk_C LSU_mAirMax_C LSU_mAirMin_C LSU_nMax_C LSU_nMinChkDyn_C LSU_nMin_C LSU_qDiffMax_C LSU_qMax_C LSU_qMin_C LSU_qThresChkDyn_C LSU_qThresOvrRun_C LSU_rO2ConstVal_C LSU_tiDvtFlt_C LSU_rO2Lmbd1Thres_C LSU_rO2MaxVar_C LSU_rO2Min_C LSU_rO2NegDvt_C LSU_rO2PosDvt_C LSU_stMonActv_C LSU_stMonMsk_C LSU_stSelPlausChkSig_C LSU_tiDvt1Flt_C LSU_tiO2CalcFlt_C LSU_tiO2Eval_C LSU_tiSwitch_CA LSU_tiWait1_CA LSU_tiWait2_CA LSU_tiWait3_CA LSU_volMinFl_C /end DEF_CHARACTERISTIC
 /begin OUT_MEASUREMENT LSU_rO2Stat_mp LSU_rO2Thres1_mp LSU_rO2Thres2_mp LSU_stChkDyn_mp LSU_stO2Chk_mp LSU_stO2Err_mp LSU_stPlausChkCon_mp LSU_stPlausChk_mp LSU_tiState1_mp /end OUT_MEASUREMENT
/end FUNCTION
/begin FUNCTION lsu_mon_msg ""
 /begin OUT_MEASUREMENT LSU_rO2ActVal LSU_rO2DiffCmpChk LSU_rO2Lmbd1Thres LSU_rO2MaxDiff LSU_rO2MaxVal LSU_rO2MinVal LSU_rO2RawFlt LSU_stConstPOp LSU_tiState2 LSU_tiState3 LSU_tiSwitch LSU_tiWait3 /end OUT_MEASUREMENT
/end FUNCTION
/begin FUNCTION lsu_mon_uic ""
 /begin OUT_MEASUREMENT LSU_bpPlausSetPoint_mp LSU_qStrt_mp LSU_rO2Calc_mp LSU_rO2DvtNeg_mp LSU_rO2DvtPos_mp /end OUT_MEASUREMENT
/end FUNCTION
/begin FUNCTION lubcd_co ""
 /begin DEF_CHARACTERISTIC LubCD_ctInitDly_C LubCD_ctTogErr_C LubCD_stLoadPwmInInv_C LubCD_swtTogVer_C Lub_tiDebNplDef_C Lub_tiDebNplOk_C Lub_tiDebSigDef_C Lub_tiDebSigOk_C /end DEF_CHARACTERISTIC
/end FUNCTION
/begin FUNCTION lubcd_co_msg ""
 /begin OUT_MEASUREMENT ctHigh ctLow LubCD_ctHigh LubCD_ctLow LubCD_ctTog LubCD_dioIn LubCD_st LubCD_stOelTog LubCD_stTOel LubCD_stTog LubCD_titk LubCD_titr LubCD_titv LubCD_Tog_icnt LubCD_Tog_uplcnt /end OUT_MEASUREMENT
/end FUNCTION
/begin FUNCTION lubcd_co_uic "" /begin OUT_MEASUREMENT LubCD_stErr_mp LubCD_tiHigh_mp LubCD_tiLow_mp /end OUT_MEASUREMENT /end FUNCTION
/begin FUNCTION mcy315_conf ""
 /begin DEF_CHARACTERISTIC CrSCD_numGlFilter_C CrSCD_numThresCtlHigh_C CrSCD_numThresCtlLow_C /end DEF_CHARACTERISTIC
/end FUNCTION
/begin FUNCTION memmon "Überwachung des Speichers"
 /begin DEF_CHARACTERISTIC MemMon_numErrChkRam_C MemMon_numErrChkRom_C MemMon_tiHealChkRam_C MemMon_tiHealChkRom_C /end DEF_CHARACTERISTIC
/end FUNCTION
/begin FUNCTION memmon_msg ""
 /begin OUT_MEASUREMENT MemMon_ctErrChkRam MemMon_ctErrChkRom MemMon_ctHealChkRam MemMon_ctHealChkRom MemMon_st /end OUT_MEASUREMENT
/end FUNCTION
/begin FUNCTION meuncd_co "Zumeßeinheit"
 /begin DEF_CHARACTERISTIC MeUnCD_uSRCMin_C MeUnCD_uSRCMax_C MeUnCD_iLin_CUR MeUnCD_dcycMax_C MeUnCD_dcycMin_C MeUnCD_dcycSetValLin_CUR MeUnCD_dcycTst_C MeUnCD_DebExcTempDef_C MeUnCD_DebExcTempOk_C MeUnCD_DebNoLoadDef_C MeUnCD_DebNoLoadOk_C MeUnCD_DebShortCircBatDef_C MeUnCD_DebShortCircBatOk_C MeUnCD_DebShortCircGndDef_C MeUnCD_DebShortCircGndOk_C MeUnCD_DebSRCHighDef_C MeUnCD_DebSRCHighOk_C MeUnCD_DebSRCLowDef_C MeUnCD_DebSRCLowOk_C MeUnCD_facIGovInit_CUR MeUnCD_facIGovMax_C MeUnCD_facIGovMin_C MeUnCD_tiFlt1PT1_C MeUnCD_tiFlt2PT1_C MeUnCD_tiIGovDT1_C MeUnCD_IGovDKd_C MeUnCD_IGovIKi_C MeUnCD_IGovIKiPos_C MeUnCD_IGovIKiNeg_C MeUnCD_iIGovIWinPos_C MeUnCD_iIGovIWinNeg_C MeUnCD_tiFltPT1Init_C MeUnCD_nDiffMax_C MeUnCD_numAdc_C MeUnCD_numDia1_C MeUnCD_numDia2_C MeUnCD_numPwmOut_C MeUnCD_resCoil_C MeUnCD_stInvOut_C MeUnCD_stPwrStgDia_C MeUnCD_swt_C MeUnCD_tiBtwTst_C MeUnCD_tiIGovInit_C MeUnCD_tiPer_CUR MeUnCD_tiDebSigDefSigTst_C MeUnCD_tiDebSigOkSigTst_C /end DEF_CHARACTERISTIC
 /begin IN_MEASUREMENT FlSys_t MeUnCD_dcycSetVal_mp MeUnCD_nDiffRef_mp MeUnCD_uRawVal_mp /end IN_MEASUREMENT
/end FUNCTION
/begin FUNCTION meuncd_co_msg "" /begin OUT_MEASUREMENT MeUnCD_iGovActVal MeUnCD_iSetFlt /end OUT_MEASUREMENT /end FUNCTION
/begin FUNCTION meuncd_co_uic ""
 /begin OUT_MEASUREMENT MeUnCD_dcycDT1_mp MeUnCD_dcycOut_mp MeUnCD_dcycSetValLin_mp MeUnCD_dcycSetVal_mp MeUnCD_facIGov_mp MeUnCD_iActFlt_mp MeUnCD_iDvt_mp MeUnCD_nDiffRef_mp MeUnCD_tiPer_mp MeUnCD_uRawVal_mp /end OUT_MEASUREMENT
/end FUNCTION
/begin FUNCTION meun_setcurr "Berechnung elektrischer Sollstrom für die Zumesseinheit"
 /begin DEF_CHARACTERISTIC MeUn_iCnvFlowRate_CUR MeUn_iSetMin_C MeUn_pActrPrt_C MeUn_pFlowOfFl_C /end DEF_CHARACTERISTIC
 /begin IN_MEASUREMENT Rail_dvolMeUnSet /end IN_MEASUREMENT
/end FUNCTION
/begin FUNCTION meun_setcurr_uic "" /begin DEF_CHARACTERISTIC MeUn_iSet_Vector MeUn_iSet_Channel /end DEF_CHARACTERISTIC /begin OUT_MEASUREMENT MeUn_iSet_mp MeUn_stActrCtl_mp /end OUT_MEASUREMENT /end FUNCTION
/begin FUNCTION models "" /end FUNCTION
/begin FUNCTION mrlycd "Hauptrelais Komponententreiber"
 /begin DEF_CHARACTERISTIC MRlyCD_ctTooEarlyThres_C MRlyCD_numDioOutMnRly_C MRlyCD_numDioOutPSOFF_C MRlyCD_stInvOut_C MRlyCD_tiNotOpen_C /end DEF_CHARACTERISTIC
/end FUNCTION
/begin FUNCTION mrlycd_msg "" /begin OUT_MEASUREMENT MRlyCD_stMon MRlyCD_stPrevOpening /end OUT_MEASUREMENT /end FUNCTION
/begin FUNCTION mrlycd_uic "" /begin OUT_MEASUREMENT MRlyCD_ctTooEarlyInit_mp MRlyCD_ctTooEarly_mp /end OUT_MEASUREMENT /end FUNCTION
/begin FUNCTION msid "Master-Slave-Erkennung (Steuergeräteauswahl)"
 /begin DEF_CHARACTERISTIC MSidCD_Comm_DebNplDef_C MSidCD_Comm_DebNplOk_C MSidCD_numECUS_C MSidCD_Pin_DebSigDef_C MSidCD_Pin_DebSigOk_C MSidCD_Select_DebNplDef_C MSidCD_Select_DebNplOk_C MSidCD_Sel_INI_DebNplDef_C MSidCD_Sel_INI_DebNplOk_C MSidCD_Sel_INI_DebSigDef_C MSidCD_Sel_INI_DebSigOk_C MSidCD_stCANprivErrMsk_C MSidCD_stErrInjOFF_C MSidCD_stInv_C MSidCD_swtCanDeb_C MSidCD_swtLearn_C MSidCD_swtMAIN_C MSidCD_tiCanDeb_C /end DEF_CHARACTERISTIC
/end FUNCTION
/begin FUNCTION msid_msg "" /begin OUT_MEASUREMENT MSidCD_numECUS MSidCD_stInjOffECU MSidCD_swtMAIN /end OUT_MEASUREMENT /end FUNCTION
/begin FUNCTION msid_uic ""
 /begin OUT_MEASUREMENT MSidCD_stCANpriv_mp MSidCD_stECUCANpriv_mp MSidCD_stECUCANPtHelp_mp MSidCD_stECULearned_mp MSidCD_stECULTmp_mp MSidCD_stECUPlaus_mp MSidCD_stECUSelect_mp MSidCD_stECUStatus_mp MSidCD_stErrEcuPinComm_mp MSidCD_stErrECUSelect_mp MSidCD_stSetEEPROM_mp MSidCD_swtECUinfo_mp MSidCD_swtECUnum_mp MSidCD_swtMasterHW_mp MSidCD_swtPinDrive_mp MSidCD_swtPinECU_mp /end OUT_MEASUREMENT
/end FUNCTION
/begin FUNCTION netmng "Netzwerk Manager" /begin DEF_CHARACTERISTIC NetMng_swtONWM_C /end DEF_CHARACTERISTIC /end FUNCTION
/begin FUNCTION netmng_errhndl "Fehlerhandler"
 /begin DEF_CHARACTERISTIC NetMng_CANFadeOutMaskA_C NetMng_CANFadeOutMaskB_C NetMng_CANFadeOutMaskC_C NetMng_ctBusOffRetriesA_C NetMng_ctBusOffRetriesB_C NetMng_ctBusOffRetriesC_C NetMng_ctInitRetryCanA_C NetMng_ctInitRetryCanB_C NetMng_ctInitRetryCanC_C NetMng_tiDebPosBusMonCanA_C NetMng_tiDebNegBusMonCanA_C NetMng_tiDebPosBusMonCanB_C NetMng_tiDebNegBusMonCanB_C NetMng_tiDebPosBusMonCanC_C NetMng_tiDebNegBusMonCanC_C NetMng_tiDebPosBusOffCanA_C NetMng_tiDebNegBusOffCanA_C NetMng_tiDebPosBusOffCanB_C NetMng_tiDebNegBusOffCanB_C NetMng_tiDebPosBusOffCanC_C NetMng_tiDebNegBusOffCanC_C NetMng_tiDebPosErrCanA_C NetMng_tiDebNegErrCanA_C NetMng_tiDebPosErrCanB_C NetMng_tiDebNegErrCanB_C NetMng_tiDebPosErrCanC_C NetMng_tiDebNegErrCanC_C NetMng_tiDebPosMonCanA_C NetMng_tiDebNegMonCanA_C NetMng_tiDebPosMonCanB_C NetMng_tiDebNegMonCanB_C NetMng_tiDebPosMonCanC_C NetMng_tiDebNegMonCanC_C NetMng_FadeOutMaskA_C NetMng_FadeOutMaskB_C NetMng_FadeOutMaskC_C NetMng_SplyVltgHysXLow_C NetMng_SplyVltgHysXHigh_C NetMng_SplyVltgHysYLow_C NetMng_SplyVltgHysYHigh_C NetMng_tiFadeoutLowBat_C NetMng_tiFadeoutMin_C NetMng_tiRecoverA_C NetMng_tiRecoverB_C NetMng_tiRecoverC_C NetMng_tiTimeoutDNMT_C /end DEF_CHARACTERISTIC
/end FUNCTION
/begin FUNCTION netmng_msg ""
 /begin OUT_MEASUREMENT NetMng_stCANBus NetMng_stDisableMsg NetMng_stFadeOut NetMng_stONWM /end OUT_MEASUREMENT
/end FUNCTION
/begin FUNCTION netmng_uic ""
 /begin OUT_MEASUREMENT NetMng_stDfpCanA_mp NetMng_stDfpCanB_mp NetMng_stDfpCanC_mp NetMng_stDfpMaskPtCan_mp /end OUT_MEASUREMENT
/end FUNCTION
/begin FUNCTION nsc_corgn "coordinator for NOx cat regeneration" /begin DEF_CHARACTERISTIC NSC_numPrio_C NSC_st_C /end DEF_CHARACTERISTIC /end FUNCTION
/begin FUNCTION nsc_corgn_msg "" /begin OUT_MEASUREMENT NSC_numPrio NSC_st /end OUT_MEASUREMENT /end FUNCTION
/begin FUNCTION nsc_corgn_uic "" /end FUNCTION
/begin FUNCTION nvclb_calibration "" /end FUNCTION
/begin FUNCTION nvclb_calibration_uic "" /end FUNCTION
/begin FUNCTION opscd "Öldruckerfassung"
 /begin DEF_CHARACTERISTIC OPSCD_aMin_C OPSCD_LampDebExcTempDef_C OPSCD_LampDebExcTempOk_C OPSCD_LampDebNoLoadDef_C OPSCD_LampDebNoLoadOk_C OPSCD_LampDebShortCircBatDef_C OPSCD_LampDebShortCircBatOk_C OPSCD_LampDebShortCircGndDef_C OPSCD_LampDebShortCircGndOk_C OPSCD_nStart1_C OPSCD_nStart2_C OPSCD_numDia_C OPSCD_numDioOut_C OPSCD_nZero_C OPSCD_stLampInvOut_C OPSCD_stPwrStgLampDia_C OPSCD_swtBN2000_C OPSCD_swtStart_C OPSCD_tiABSDebNeg_C OPSCD_tiABSDebPos_C OPSCD_tiDelayAftKL50_C OPSCD_tiInactiv1_C OPSCD_tiInactiv2_C OPSCD_tipOELDebNeg_C OPSCD_tipOELDebPos_C OPSCD_tiStart1_C OPSCD_vMin_C /end DEF_CHARACTERISTIC
/end FUNCTION
/begin FUNCTION opscd_anain ""
 /begin DEF_CHARACTERISTIC OPSCD_uSRCMin_C OPSCD_uSRCMax_C OPSCD_pLin_CUR OPSCD_DebSRCHiDef_C OPSCD_DebSRCHiOk_C OPSCD_DebSRCLoDef_C OPSCD_DebSRCLoOk_C OPSCD_dtRmpSlpUp_C OPSCD_dtRmpSlpDwn_C OPSCD_numAdc_C OPSCD_stSensIDWord_C OPSCD_stPDfl_C /end DEF_CHARACTERISTIC
 /begin IN_MEASUREMENT OPSCD_uRaw_POEL_mp /end IN_MEASUREMENT
/end FUNCTION
/begin FUNCTION opscd_anain_msg "" /begin OUT_MEASUREMENT OPSCD_stpOEL /end OUT_MEASUREMENT /end FUNCTION
/begin FUNCTION opscd_anain_uic "" /begin OUT_MEASUREMENT OPSCD_uRaw_POEL_mp /end OUT_MEASUREMENT /end FUNCTION
/begin FUNCTION opscd_msg "" /begin OUT_MEASUREMENT OPSCD_stSigOut /end OUT_MEASUREMENT /end FUNCTION
/begin FUNCTION opscd_uic ""
 /begin OUT_MEASUREMENT OPSCD_stInactive_mp OPSCD_stLampRun_mp OPSCD_tiDelayAftKL50_mp /end OUT_MEASUREMENT
/end FUNCTION
/begin FUNCTION otscd_co "Öltemperaturfühler"
 /begin DEF_CHARACTERISTIC OTSCD_uSRCMin_C OTSCD_uSRCMax_C OTSCD_tLin_CUR OTSCD_DebNplDef_C OTSCD_DebNplOk_C OTSCD_DebSigDef_C OTSCD_DebSigOk_C OTSCD_DebSRCHighDef_C OTSCD_DebSRCHighOk_C OTSCD_DebSRCLowDef_C OTSCD_DebSRCLowOk_C OTSCD_numAdc_C OTSCD_tiStrtOilClntPlaus_C OTSCD_tiDelOilClntPlaus_C OTSCD_tThresOilClntPlaus_C OTSCD_tLimOilClntPlaus_C OTSCD_dtRmpSlpUp_C OTSCD_dtRmpSlpDwn_C OTSCD_swtSigVal_C OTSCD_stSensIDWord_C OTSCD_tDfl_C /end DEF_CHARACTERISTIC
 /begin IN_MEASUREMENT OTSCD_uRaw /end IN_MEASUREMENT
/end FUNCTION
/begin FUNCTION otscd_co_msg ""
 /begin OUT_MEASUREMENT OTSCD_stPlaus OTSCD_swtSig OTSCD_tEngOil OTSCD_tEngOilLin OTSCD_uRaw /end OUT_MEASUREMENT
/end FUNCTION
/begin FUNCTION otscd_co_uic "" /end FUNCTION
/begin FUNCTION ovrmon_10msctr "Zähler zur zeitlichen Koordination der Schubüberwachung" /end FUNCTION
/begin FUNCTION ovrmon_10msctr_msg "" /begin OUT_MEASUREMENT OvRMon_ct10MS /end OUT_MEASUREMENT /end FUNCTION
/begin FUNCTION ovrmon_10msctr_uic "" /end FUNCTION
/begin FUNCTION ovrmon_accped ""
 /begin DEF_CHARACTERISTIC OvRMon_tiErrAPP_C OvRMon_uAPPFull_C OvRMon_uPlaWinFull_C OvRMon_uPlaWinIdle_C /end DEF_CHARACTERISTIC
/end FUNCTION
/begin FUNCTION ovrmon_accped_uic "" /begin OUT_MEASUREMENT OvRMon_stAPPDiff_mp OvRMon_uRegAPP1_mp OvRMon_uRegAPP2_mp /end OUT_MEASUREMENT /end FUNCTION
/begin FUNCTION ovrmon_brk "Funktionsüberwachung der Bremssignal"
 /begin DEF_CHARACTERISTIC OvRMon_DebBrkPlaDef_C OvRMon_DebBrkPlaOk_C OvRMon_DebBrkSigDef_C OvRMon_DebBrkSigOk_C OvRMon_tiBrkMnSwtDebNeg_C OvRMon_tiBrkMnSwtDebPos_C OvRMon_numBrkDioInMn_C OvRMon_numBrkDioInRed_C OvRMon_tiBrkRedSwtDebNeg_C OvRMon_tiBrkRedSwtDebPos_C OvRMon_stBrkDflVal_C OvRMon_stBrkMnSwtInvIn_C OvRMon_stBrkRedSwtInvIn_C OvRMon_swtBrkRedSwtPresent_C OvRMon_swtBrkSigVal_C /end DEF_CHARACTERISTIC
/end FUNCTION
/begin FUNCTION ovrmon_brksens "" /begin DEF_CHARACTERISTIC OvRMon_tiDebBrk_C /end DEF_CHARACTERISTIC /end FUNCTION
/begin FUNCTION ovrmon_brksens_uic "" /end FUNCTION
/begin FUNCTION ovrmon_brk_msg ""
 /begin OUT_MEASUREMENT OvRMon_stBrkMnSwtDebVal OvRMon_stBrkMnSwtLastDebVal OvRMon_stBrkMnSwtRawVal OvRMon_stBrkPressed OvRMon_stBrkRedSwtDebVal OvRMon_stBrkRedSwtLastDebVal OvRMon_stBrkRedSwtPresent OvRMon_stBrkRedSwtRawVal OvRMon_swtBrkSig /end OUT_MEASUREMENT
/end FUNCTION
/begin FUNCTION ovrmon_brk_uic ""
 /begin OUT_MEASUREMENT OvRMon_stBrkDeb_mp OvRMon_stBrkFreeze_mp OvRMon_stBrkMnSwtLogVal_mp OvRMon_stBrkRedSwtLogVal_mp OvRMon_stRun_mp OvRMon_tiDebBrkTmrPlaus_mp /end OUT_MEASUREMENT
/end FUNCTION
/begin FUNCTION ovrmon_co "Funktionsüberwachung auf Systemebene Koordination"
 /begin DEF_CHARACTERISTIC ExeMon_stEnaTst_C OvRMon_ctEngSpdGrad_C OvRMon_DebETDef_C OvRMon_nLIGovLim_C OvRMon_nStSysLim_C OvRMon_nThresNrml2Strt_C OvRMon_stDebCnt_C OvRMon_tiAPP1Flt_C OvRMon_tiASDdc_C OvRMon_tiCompAcsTemp_C OvRMon_tiCrCtlBrkRmp_C OvRMon_tiCrCtlConvRmp_C OvRMon_tiEngSpdRlsBrkRmp_C OvRMon_tiErrDblStorage_C OvRMon_tiLimET_CUR OvRMon_uAPP1Lim_C /end DEF_CHARACTERISTIC
 /begin IN_MEASUREMENT OvRMon_nAvrg /end IN_MEASUREMENT
/end FUNCTION
/begin FUNCTION ovrmon_convsens "" /begin DEF_CHARACTERISTIC OvRMon_tiDebConv_C /end DEF_CHARACTERISTIC /end FUNCTION
/begin FUNCTION ovrmon_convsens_uic "" /end FUNCTION
/begin FUNCTION ovrmon_co_uic ""
 /begin OUT_MEASUREMENT OvRMon_ctDebET_mp OvRMon_stBrkPressed_mp OvRMon_stDCS_mp OvRMon_stEngSpdRls_mp OvRMon_stGrip_mp OvRMon_stRls_mp OvRMon_stT15DebVal_mp OvRMon_stTSCInc_mp OvRMon_tiLimET_mp OvRMon_uRawAPP1_mp /end OUT_MEASUREMENT
/end FUNCTION
/begin FUNCTION ovrmon_dcsdem "" /end FUNCTION
/begin FUNCTION ovrmon_dcsdem_uic "" /end FUNCTION
/begin FUNCTION ovrmon_engspdrlssens "" /end FUNCTION
/begin FUNCTION ovrmon_engspdrlssens_uic "" /end FUNCTION
/begin FUNCTION ovrmon_engspdsens "Drehzahlüberwachung für die Schubüberwachung"
 /begin DEF_CHARACTERISTIC OvRMon_DebSigA0Def_C OvRMon_nDiffMax_C OvRMon_nSegMax_C OvRMon_nSegMin_C OvRMon_stIntrInit_C OvRMon_tiSegMin_C /end DEF_CHARACTERISTIC
/end FUNCTION
/begin FUNCTION ovrmon_engspdsens_msg ""
 /begin OUT_MEASUREMENT OvRMon_nAvrg OvRMon_stIntr OvRMon_tiIntrSysAct OvRMon_tiIntrSysLst /end OUT_MEASUREMENT
/end FUNCTION
/begin FUNCTION ovrmon_engspdsens_uic "" /begin OUT_MEASUREMENT OvRMon_nSeg_mp OvRMon_stIntrInactv_mp /end OUT_MEASUREMENT /end FUNCTION
/begin FUNCTION ovrmon_gearbxdem "Signalerfassung der Getriebesteuerung" /end FUNCTION
/begin FUNCTION ovrmon_gearbxdem_uic "" /end FUNCTION
/begin FUNCTION ovrmon_getsuminj "Berechnung des Drehmoments zur Schubüberwachung" /begin DEF_CHARACTERISTIC OvRMon_facInjEff_MAP /end DEF_CHARACTERISTIC /begin IN_MEASUREMENT Eng_nAvrg OvRMon_phiInjAct_mp /end IN_MEASUREMENT /end FUNCTION
/begin FUNCTION ovrmon_getsuminj_msg "" /begin OUT_MEASUREMENT OvRMon_tiTDCAvrg OvRMon_tiTDCAvrgCpl /end OUT_MEASUREMENT /end FUNCTION
/begin FUNCTION ovrmon_getsuminj_uic ""
 /begin OUT_MEASUREMENT OvRMon_phiInjAct_mp OvRMon_tiInjAct_mp OvRMon_tiTDCSumET_mp /end OUT_MEASUREMENT
/end FUNCTION
/begin FUNCTION ovrmon_gripsens "" /end FUNCTION
/begin FUNCTION ovrmon_gripsens_uic "" /end FUNCTION
/begin FUNCTION ovrmon_msg "" /begin OUT_MEASUREMENT OvRMon_stOvR /end OUT_MEASUREMENT /end FUNCTION
/begin FUNCTION ovrmon_t15sens "" /begin DEF_CHARACTERISTIC OvRMon_tiDebT15_C /end DEF_CHARACTERISTIC /end FUNCTION
/begin FUNCTION ovrmon_t15sens_uic "" /end FUNCTION
/begin FUNCTION oxiccd_gettemppre "Abgastemperatur vor Oxidationskatalysator"
 /begin DEF_CHARACTERISTIC OxiCCD_uSRCMinTPre_C OxiCCD_uSRCMaxTPre_C OxiCCD_tLinPre_CUR OxiCCD_DebSRCHighDefTPre_C OxiCCD_DebSRCHighOkTPre_C OxiCCD_DebSRCLowDefTPre_C OxiCCD_DebSRCLowOkTPre_C OxiCCD_numTempPreADC_C OxiCCD_dtRmpSlpUpPre_C OxiCCD_dtRmpSlpDwnPre_C OxiCCD_stSensIDWordTPre_C OxiCCD_tDflPre_C /end DEF_CHARACTERISTIC
 /begin IN_MEASUREMENT OxiCCD_uRawTempPre /end IN_MEASUREMENT
/end FUNCTION
/begin FUNCTION oxiccd_gettemppre_msg "" /begin OUT_MEASUREMENT OxiCCD_tLinPre OxiCCD_tPre OxiCCD_uRawTempPre /end OUT_MEASUREMENT /end FUNCTION
/begin FUNCTION oxiccd_gettemppre_uic "" /end FUNCTION
/begin FUNCTION pcbs_calccbs "" /begin DEF_CHARACTERISTIC PCBS_lCalcDistance_CUR /end DEF_CHARACTERISTIC /begin IN_MEASUREMENT PFlt_mAshOil /end IN_MEASUREMENT /end FUNCTION
/begin FUNCTION pcbs_calccbs_msg ""
 /begin OUT_MEASUREMENT PCBS_dAvaiOut PCBS_lDistanceOut PCBS_stCBSMsg PCBS_stCntValOut PCBS_stIDMsg PCBS_stUnit /end OUT_MEASUREMENT
/end FUNCTION
/begin FUNCTION pcbs_calccbs_uic ""
 /begin OUT_MEASUREMENT PCBS_dAvaiDiag_mp PCBS_dAvaiDMEChg_mp PCBS_dAvai_mp PCBS_lDistanceDMEChg_mp PCBS_lDistance_mp PCBS_lMaxDistance_mp PCBS_stCntChgCAN_mp PCBS_stCntChgDIAG_mp PCBS_stCntChg_mp PCBS_stCntDiag_mp PCBS_stCntVal_mp PCBS_stDMEChg_mp PCBS_stDMEIni_mp PCBS_stPFltChgCAN_mp PCBS_stPFltChgDIAG_mp PCBS_stPFltChg_mp PCBS_stResetDiag_mp /end OUT_MEASUREMENT
/end FUNCTION
/begin FUNCTION pcr_balgvnr "Gleichstellungsregler" /end FUNCTION
/begin FUNCTION pcr_balgvnr_msg "" /begin OUT_MEASUREMENT PCR_rBalGvnrDiff /end OUT_MEASUREMENT /end FUNCTION
/begin FUNCTION pcr_balgvnr_uic "" /end FUNCTION
/begin FUNCTION pcr_ctlvalcalc "Ladedruck-Steuerung"
 /begin DEF_CHARACTERISTIC PCR_facBPCtlBasCorr_CUR PCR_facBPCtlBasRgn1Corr_CUR PCR_facCtlAPRgn_MAP PCR_facCtlAP_MAP PCR_facCtlATRgn_CUR PCR_facCtlIAT_CUR PCR_rBPCtlBasUp_C PCR_rBPCtlBasDwn_C PCR_rBPCtlBasAirCtlOff_MAP PCR_rBPCtlBasCorr_MAP PCR_rBPCtlBasFDC_MAP PCR_rBPCtlBasRgn1Corr_MAP PCR_rBPCtlBasRgn1_MAP PCR_rBPCtlBasRgn2_MAP PCR_rCtlAPCmpnRgn_MAP PCR_rCtlAPCor_MAP PCR_rCtlATCmpnRgn_MAP PCR_rCtlATCmpn_MAP PCR_rCtlBas_MAP PCR_rCtlInit_C PCR_rSurgeCtlVal_MAP PCR_stCtlVal1_C PCR_stCtlVal2_C PCR_swtQntCtlVal_C PCR_swtQntCtlType_C PCR_tiRmpCtl_C /end DEF_CHARACTERISTIC
 /begin IN_MEASUREMENT APSCD_pVal Eng_nAvrg IATSCD_tAir PCR_qCtl_mp PFlt_mSot /end IN_MEASUREMENT
/end FUNCTION
/begin FUNCTION pcr_ctlvalcalc_msg "" /begin OUT_MEASUREMENT PCR_rCtlVal PCR_swtQntCtl /end OUT_MEASUREMENT /end FUNCTION
/begin FUNCTION pcr_ctlvalcalc_uic ""
 /begin OUT_MEASUREMENT PCR_qCtlFrmMngTrqInr_mp PCR_qCtl_mp PCR_rBPCtlAPCorrRgn_mp PCR_rBPCtlAPCorr_mp PCR_rBPCtlATCorrRgn_mp PCR_rBPCtlATCorr_mp PCR_rBPCtlBasCorr_mp PCR_rBPCtlBasRgn1Corr_mp PCR_rBPCtlBasRgn1_mp PCR_rBPCtlBasRgn2_mp PCR_rBPCtlBas_mp PCR_rCtlSurgeBas_mp PCR_rCtlVal1_mp PCR_rCtlVal2_mp /end OUT_MEASUREMENT
/end FUNCTION
/begin FUNCTION pcr_ctlvalcalc_var ""
 /begin DEF_CHARACTERISTIC PCR_dnSurgeHigh_CUR PCR_dnSurgeLow_CUR PCR_nLIGovBase_C PCR_nSetPointLIGov_C PCR_nSurgeMon1_C PCR_nSurgeMon2_C PCR_qSurgeHigh_CUR PCR_qSurgeLow_CUR PCR_dnSurgeSlpUp_C PCR_dnSurgeSlpDwn_C PCR_rSurgeHigh_MAP PCR_rSurgeOfs_CUR PCR_tiSurgePT1_C PCR_swtOffStat1_C PCR_tiSurgeMonLIGov_C PCR_vSurgeLIGov_C /end DEF_CHARACTERISTIC
 /begin IN_MEASUREMENT AFSCD_dmAirPerTime Eng_nAvrg /end IN_MEASUREMENT
/end FUNCTION
/begin FUNCTION pcr_ctlvalcalc_var_msg "" /begin OUT_MEASUREMENT PCR_nSetPointSurge PCR_stSurge1 PCR_stSurge2 /end OUT_MEASUREMENT /end FUNCTION
/begin FUNCTION pcr_ctlvalcalc_var_uic ""
 /begin OUT_MEASUREMENT PCR_dnAvrgNeg_mp PCR_dnSurgeHigh_mp PCR_dnSurgeLow_mp PCR_qSurgeHigh_mp PCR_qSurgeLow_mp PCR_rSurgeHysHigh_mp PCR_rSurgeHysLow_mp PCR_rSurgeLIGov_mp PCR_stSurge1_mp PCR_stSurgePre1_mp PCR_stSurgePre2_mp /end OUT_MEASUREMENT
/end FUNCTION
/begin FUNCTION pcr_desvalcalc "Ladedruck Sollwertbildung"
 /begin DEF_CHARACTERISTIC PCR_tiDT1DesCld_C PCR_DKdDesCld_C PCR_DKdPosDesCld_C PCR_DKdNegDesCld_C PCR_dpDWinPosDesCld_C PCR_dpDWinNegDesCld_C PCR_dpSlpLimDwn_C PCR_dpSlpLimUp_C PCR_dqDes_C PCR_drAPP1UnFlt_C PCR_tiDT1qDes_C PCR_DKdqDes_C PCR_tiDT1rAPP1_C PCR_DKdrAPP1_C PCR_facATRgn_CUR PCR_facCtQ_MAP PCR_facIAT_CUR PCR_facN_CUR PCR_nLimMax_C PCR_nLimMin_C PCR_pAPQCmpnRgn_MAP PCR_pAPQCmpn_MAP PCR_pBDesBasFDC_MAP PCR_pBDesBasRgn1_MAP PCR_pBDesBasRgn2_MAP PCR_pDesBas_MAP PCR_pDesMaxAP_MAP PCR_pDesMax_C PCR_pDesMin_C PCR_pNQCtCmpn_MAP PCR_stRgnMsk1_C PCR_stRgnMsk2_C PCR_swtQntDesVal_C PCR_swtQntDesType_C PCR_swtSlpLimInputType_C PCR_tClntThres_C PCR_tiBDesSlpLim_C PCR_tiRmpMswt_C PCR_tiDT1DesWrm_C PCR_DKdDesWrm_C PCR_DKdPosDesWrm_C PCR_DKdNegDesWrm_C PCR_dpDWinPosDesWrm_C PCR_dpDWinNegDesWrm_C /end DEF_CHARACTERISTIC
 /begin IN_MEASUREMENT APSCD_pVal CTSCD_tClnt Eng_nAvrg IATSCD_tAir PCR_qDes /end IN_MEASUREMENT
/end FUNCTION
/begin FUNCTION pcr_desvalcalc_msg "" /begin OUT_MEASUREMENT PCR_pDesVal PCR_qDes PCR_swtQntDes /end OUT_MEASUREMENT /end FUNCTION
/begin FUNCTION pcr_desvalcalc_uic ""
 /begin DEF_CHARACTERISTIC PCR_pDesAdd_Vector PCR_pDesAdd_Channel PCR_pDes_Vector PCR_pDes_Channel /end DEF_CHARACTERISTIC
 /begin OUT_MEASUREMENT PCR_bpMap_mp PCR_dqDes_mp PCR_drAPP1UnFlt_mp PCR_facATRgn_mp PCR_facAT_mp PCR_facCtQ_mp PCR_facN_mp PCR_pAPQCmpnRgn_mp PCR_pAPQCmpn_mp PCR_pBasMAP_mp PCR_pBDesAPCorrRgn1_mp PCR_pBDesAPCorrRgn2_mp PCR_pBDesAPCorr_mp PCR_pBDesATCorrRgn1_mp PCR_pBDesATCorrRgn2_mp PCR_pBDesATCorr_mp PCR_pBDesCtCorr_mp PCR_pBDesDyn_mp PCR_pBDesMaxAP_mp PCR_pBDesNCorr_mp PCR_pBDesRaw2_mp PCR_pBDesRaw_mp PCR_pBDesStat_mp PCR_pBDes_mp PCR_pDesByp_mp PCR_pNQCtCmpn_mp PCR_pRgnMAP1_mp PCR_pRgnMAP2_mp PCR_qDesFrmMngTrqInr_mp PCR_stBDesLogic_mp PCR_stCmpEnd_mp /end OUT_MEASUREMENT
/end FUNCTION
/begin COMPU_METHOD Acc "Fahrzeugbeschleunigung" RAT_FUNC "%6.5" "m/s^2" COEFFS 0 1000 0 0 0 1 /end COMPU_METHOD
/begin COMPU_METHOD AirMassPerCyl "Luftmasse pro Zylinder" RAT_FUNC "%6.3" "mg/Hub" COEFFS 0 10 0 0 0 1 /end COMPU_METHOD
/begin COMPU_METHOD AirMassPerTime "Luftmasse pro Zeit" RAT_FUNC "%6.3" "Kg/h" COEFFS 0 10 0 0 0 1 /end COMPU_METHOD
/begin COMPU_METHOD AngleCrS "Winkel Kurbelwelle" RAT_FUNC "%6.4" "deg CrS" COEFFS 0 42.6666666666667 0 0 0 1 /end COMPU_METHOD
/begin COMPU_METHOD Curr "Strom" RAT_FUNC "%6.2" "mA" COEFFS 0 1 0 0 0 1 /end COMPU_METHOD
/begin COMPU_METHOD dn_dZ20 "Motorbeschleunigung pro Zeit (dn/dt) (im 20 ms Raster)" RAT_FUNC "%6.1" "rmp/s" COEFFS 0 0.1 0 0 0 1 /end COMPU_METHOD
/begin COMPU_METHOD DtyCyc "Tastverhaeltnis" RAT_FUNC "%6.4" "%" COEFFS 0 100 0 0 0 1 /end COMPU_METHOD
/begin COMPU_METHOD EGTRmp "Zeitrampe verwendet von EGT Lib Funktionen" RAT_FUNC "%6.3" "s" COEFFS 0 0 1 0 0.0152587890625 0 /end COMPU_METHOD
/begin COMPU_METHOD EngN "Motordrehzahl" RAT_FUNC "%6.2" "rpm" COEFFS 0 1 0 0 0 1 /end COMPU_METHOD
/begin COMPU_METHOD Fact "Faktor mit Auflösung 1 / 8192, hauptsächlich für einen Faktorenbereich 0...1 verwendet" RAT_FUNC "%6.5" "-" COEFFS 0 8192 0 0 0 1 /end COMPU_METHOD
/begin COMPU_METHOD Fl_Half_L "Kraftstoffverbrauchsintegral" RAT_FUNC "%6.4" "l" COEFFS 0 20 0 0 0 1 /end COMPU_METHOD
/begin COMPU_METHOD InjMass "Einspritzmenge" RAT_FUNC "%6.4" "mg/hub" COEFFS 0 100 0 0 0 1 /end COMPU_METHOD
/begin COMPU_METHOD InjMassCyc "Einspritzmenge pro Zyklus (mg/Zyklus)" RAT_FUNC "%6.4" "mg/cyc" COEFFS 0 100 0 0 0 1 /end COMPU_METHOD
/begin COMPU_METHOD InjMassPerSec_20ms "Einspritzmengenänderung pro Sekunde für 20ms-Tasks" RAT_FUNC "%6.3" "mg/hub/s" COEFFS 0 2 0 0 0 1 /end COMPU_METHOD
/begin COMPU_METHOD InjTime_us "Zeit in Microsekunden für das Einspritztiming" RAT_FUNC "%6.2" "us" COEFFS 0 1 0 0 0 1 /end COMPU_METHOD
/begin COMPU_METHOD Kd "Differentialverstärkung Kd (gleiche Einheit/Umrechnungsformel an Ein- und Ausgang)" RAT_FUNC "%7.6" "1/1" COEFFS 0 65536 0 0 0 1 /end COMPU_METHOD
/begin COMPU_METHOD Kd_Temp_Kelv2Dcyc "Differentialverstärkung Kd (Temperatur zu Tastverhältnis)" RAT_FUNC "%8.7" "%/(K)" COEFFS 0 655360 0 0 0 1 /end COMPU_METHOD
/begin COMPU_METHOD Ki_curr2fact "Integralverstärkung (Strom Curr zu Faktor Fact)" RAT_FUNC "%10.9" "1/mA*s" COEFFS 0 35184372.088832 0 0 0 1 /end COMPU_METHOD
/begin COMPU_METHOD Ki_Temp_Kelv2Dcyc "Integralverstärkung (Temperatur zu Tastverhältnis)" RAT_FUNC "%7.6" "%/(K)" COEFFS 0 42949.67296 0 0 0 1 /end COMPU_METHOD
/begin COMPU_METHOD km_sw_q10 "K3 Umwandlungen" RAT_FUNC "%6.1" "-" COEFFS 0 0.1 0 0 0 1 /end COMPU_METHOD
/begin COMPU_METHOD Kp_Temp_Kelv2Dcyc "Proportionalverstärkung (Temperatur zu Tastverhältnis)" RAT_FUNC "%8.7" "%/(K)" COEFFS 0 655360 0 0 0 1 /end COMPU_METHOD
/begin COMPU_METHOD lambda "Lambda" RAT_FUNC "%6.5" "-" COEFFS 0 1000 0 0 0 1 /end COMPU_METHOD
/begin COMPU_METHOD lambdaRecVal "Reziproker Lambda Wert" RAT_FUNC "%6.5" "-" COEFFS 0 1000 0 0 0 1 /end COMPU_METHOD
/begin COMPU_METHOD mSoot_g "Rußmasse [g]" RAT_FUNC "%6.4" "g" COEFFS 0 100 0 0 0 1 /end COMPU_METHOD
/begin COMPU_METHOD NumPinAdc "verbale Umrechnung für ADC Signale" TAB_VERB "%6.3" "-" COMPU_TAB_REF NumPinAdc /end COMPU_METHOD
/begin COMPU_VTAB NumPinAdc "verbale Umrechnung für ADC Signale" TAB_VERB 45 0 "Water_Temperature_Sensor_182" 1 "Intake_Air_Temperature_Sensor_157" 2 "Charge_Air_Temperature_Sensor_183" 3 "Exhaust_Temperature_Sensor_2_134" 4 "Exhaust_Temperature_Sensor_1_158" 5 "1st_APP_Sensor_252" 6 "2nd_APP_Sensor_239" 7 "ADC_REF" 8 "Boost_Pressure_Sensor_154" 9 "Atmospheric_Pressure_Sensor" 10 "Battery_Voltage_Sensor" 11 "Rail_Pressure_Sensor_156" 12 "Rail_Pressure_Peak_Value_156" 13 "Booster_Voltage_Sensor" 14 "Current_MeUn_Sensor" 15 "Current_PCV_Sensor" 16 "Voltage_Bank_1" 17 "Voltage_Bank_2" 18 "Pressure_Upstream_Particle_Filter_159" 19 "Engine_Oil_Pressure_110" 20 "Temperature_ECU_PCB" 21 "Voltage_Lambda_Ua" 22 "Voltage_Lambda_Ri" 23 "ADC_DUMMY_A_NOT_USED" 24 "ADC_DUMMY_NOT_USED" 25 "Charge_Actuator_Event_0" 26 "Voltage_Piezo_Actuator_Bank_2_Event_0" 27 "Voltage_Piezo_Actuator_Bank_1_Event_0" 28 "Charge_Actuator_Event_1" 29 "Voltage_Piezo_Actuator_Bank_2_Event_1" 30 "Voltage_Piezo_Actuator_Bank_1_Event_1" 31 "Charge_Actuator_Event_2" 32 "Voltage_Piezo_Actuator_Bank_2_Event_2" 33 "Voltage_Piezo_Actuator_Bank_1_Event_2" 34 "Charge_Actuator_Event_3" 35 "Voltage_Piezo_Actuator_Bank_2_Event_3" 36 "Voltage_Piezo_Actuator_Bank_1_Event_3" 37 "Charge_Actuator_Event_4" 38 "Voltage_Piezo_Actuator_Bank_2_Event_4" 39 "Voltage_Piezo_Actuator_Bank_1_Event_4" 40 "Charge_Actuator_Event_5" 41 "Voltage_Piezo_Actuator_Bank_2_Event_5" 42 "Voltage_Piezo_Actuator_Bank_1_Event_5" 43 "Booster_Voltage_Piezo" 44 "Piezo_Voltage" /end COMPU_VTAB
/begin COMPU_METHOD NumPinDia "Verbale Umrechnung für Diagnose Signale" TAB_VERB "%6.3" "-" COMPU_TAB_REF NumPinDia /end COMPU_METHOD
/begin COMPU_VTAB NumPinDia "Verbale Umrechnung für Diagnose Signale" TAB_VERB 35 0 "CJ945_Diagnostic_Signal" 1 "AC_Compressor_DiaSig" 2 "Fuel_Pump_DiaSig" 3 "Starter_234" 4 "Oil_Pressure_Lamp_Switch_245" 5 "Engine_Bay_Air_Flaps_123" 6 "Glow_Relay_Diagnostic_Signal1" 7 "reserved Glow_Relay_Diagnostic_Signal2" 8 "Ebox_Fan_Actuator_Diagnostic_Signal_219" 9 "Shuttr_Actuator_Diagnostic_Signal_231" 10 "Twostage_TurboLoading_SW_DiaSig" 11 "DIO_OUT_DIAGNOSTIC_DUMMY_NOT_USED" 12 "1st_Pressure_Control_Valve_Diagnostic_Signal_172" 13 "2nd_Pressure_Control_Valve_Diagnostic_Signal_172" 14 "1st_Metering_Unit_Diagnostic_Signal_171" 15 "2nd_Metering_Unit_Diagnostic_Signal_171" 16 "Boost_Pressure_Actuator_Diagnostic_Signal_193" 17 "Boost_Pressure_Actuator_Diagnostic_Signal_193_2" 18 "EGR_Actuator_Diagnostic_Signal_194" 19 "EGR_Actuator_Diagnostic_Signal2" 20 "Variable_Swirl_Actuator_Diagnostic_Signal_195" 21 "Throttle_Valve_Diagnostic_Signal_196" 22 "Throttle_Valve2_Diagnostic_Signal_196" 23 "FAN_240" 24 "Add_On_Heater_244" 25 "EngM_Bearing_Actuator_Diagnostic_Signal_124" 26 "EngM_Bearing_Actuator_Diagnostic_Signal_121" 27 "Low pressure stage BPA_Diagnostic_Signal_117" 28 "PWM_DIAGNOSTIC_DUMMY_NOT_USED" 29 "1st_Sensor_Supply_Voltage_DiaSig" 30 "2nd_Sensor_Supply_Voltage_DiaSig" 31 "3rd_Sensor_Supply_Voltage_DiaSig" 32 "4th_Sensor_Supply_Voltage_DiaSig" 33 "5th_Sensor_Supply_Voltage_DiaSig" 34 "6th_Sensor_Supply_Voltage_DiaSig" /end COMPU_VTAB
/begin COMPU_METHOD NumPinDioIn "Verbale Umrechnung für Digitaleingang Signale" TAB_VERB "%6.3" "-" COMPU_TAB_REF NumPinDioIn /end COMPU_METHOD
/begin COMPU_VTAB NumPinDioIn "Verbale Umrechnung für Digitaleingang Signale" TAB_VERB 15 0 "Terminal_15_207" 1 "Main_Brake_Switch_236" 2 "Redundant_Brake_Switch_223" 3 "Clutch_Switch" 4 "Terminal_50_224" 5 "ECU_selection_Switch_251" 6 "FlFlt_Switch_211" 7 "Coolant-heater_212" 8 "Redundant_Terminal_15_209(118)" 9 "AC-compressor_overboost_213" 10 "Additive_tank_level_switch_235" 11 "Terminal_61_113" 12 "Lambda_Regeneration" 13 "OilLevelSensor_138" 14 "DIO_IN_DUMMY_NOT_USED" /end COMPU_VTAB
/begin COMPU_METHOD NumPinDioOut "Verbale Umrechnung für Digitalausgang Signale" TAB_VERB "%6.3" "-" COMPU_TAB_REF NumPinDioOut /end COMPU_METHOD
/begin COMPU_VTAB NumPinDioOut "Verbale Umrechnung für Digitalausgang Signale" TAB_VERB 11 0 "Main_Relay_220(144)" 1 "AC_Compressor" 2 "Fuel_Pump_232" 3 "Starter_234" 4 "OPS_Lamp_245" 5 "EBAF_123" 6 "Ebox_Fan_Actuator_219" 7 "Shuttr_Actuator_231" 8 "STATREG_PSOFF_Bit" 9 "Twostage_TurboLoading_120" 10 "DIO_OUT_DUMMY_NOT_USED" /end COMPU_VTAB
/begin COMPU_METHOD NumPinPwmOut "Verbale Umrechnung für PWM-Ausgang Signale" TAB_VERB "%6.3" "-" COMPU_TAB_REF NumPinPwmOut /end COMPU_METHOD
/begin COMPU_VTAB NumPinPwmOut "Verbale Umrechnung für PWM-Ausgang Signale" TAB_VERB 13 0 "Boost_Pressure_Actuator_193" 1 "EGR_Actuator_194" 2 "PCV_Actuator_172" 3 "MeUn_Actuator_171" 4 "Variable_Swirl_Actuator_195" 5 "Fan_Actuator_240" 6 "Add_On_Heater_244" 7 "EngM_Bearing_Actuator_124" 8 "EngM_Bearing_Actuator_121" 9 "Throttle Valve" 10 "LSU_Heater_PWMOutput" 11 "Low pressure stage BPA_117" 12 "PWM_DUMMY_NOT_USED" /end COMPU_VTAB
/begin COMPU_METHOD O2 "Sauerstoffkonzentration" RAT_FUNC "%8.7" "-" COEFFS 0 100000 0 0 0 1 /end COMPU_METHOD
/begin COMPU_METHOD OneToOne "eins zu eins (physikalischer Wert ist gleich dem internen Wert)" RAT_FUNC "%6.2" "-" COEFFS 0 1 0 0 0 1 /end COMPU_METHOD
/begin COMPU_METHOD Period "Periodendauer" RAT_FUNC "%6.3" "ms" COEFFS 0 10 0 0 0 1 /end COMPU_METHOD
/begin COMPU_METHOD Period_ms "Periodendauer in ms" RAT_FUNC "%6.3" "ms" COEFFS 0 10 0 0 0 1 /end COMPU_METHOD
/begin COMPU_METHOD Prc "Prozent, gleiche interne Auflösung wie Fact, aber Darstellung in Prozent (0...100%)" RAT_FUNC "%6.4" "%" COEFFS 0 81.92 0 0 0 1 /end COMPU_METHOD
/begin COMPU_METHOD PrcPerSec "Prozentänderung pro Sekunde für 20ms-Tasks" RAT_FUNC "%6.3" "%/s" COEFFS 0 1.6384 0 0 0 1 /end COMPU_METHOD
/begin COMPU_METHOD Pres "Druck (angezeigt in [kPa])" RAT_FUNC "%7.2" "hPa" COEFFS 0 1.000000 0 0 0 1 /end COMPU_METHOD
/begin COMPU_METHOD Pres_hPa "Druck (angezeigt in [hPa])" RAT_FUNC "%6.2" "hPa" COEFFS 0 1 0 0 0 1 /end COMPU_METHOD
/begin COMPU_METHOD Pres_Rail "Raildruck in hPa" RAT_FUNC "%4.3" "bar" COEFFS 0 10.000000 0 0 0 1 /end COMPU_METHOD
/begin COMPU_METHOD Qp_mm3_sec "Umrechnung für Volumenstrom" RAT_FUNC "%6.1" "mm3/s" COEFFS 0 0.1 0 0 0 1 /end COMPU_METHOD
/begin COMPU_METHOD Resist_1 "1. Widerstandsvariante" RAT_FUNC "%6.2" "mOhm" COEFFS 0 1 0 0 0 1 /end COMPU_METHOD
/begin COMPU_METHOD Rk "conversion formula for gas constant" RAT_FUNC "%6.5" "kJ/(kg*K)" COEFFS 0 1000 0 0 0 1 /end COMPU_METHOD
/begin COMPU_METHOD RmpDtyCyc "Rampengradient für Tastverhältnis" RAT_FUNC "%6.5" "%/s" COEFFS 0 6553.6 0 0 0 1 /end COMPU_METHOD
/begin COMPU_METHOD RmpEngN "Rampengradient für Motordrehzahl" RAT_FUNC "%6.4" "rpm/s" COEFFS 0 65.536 0 0 0 1 /end COMPU_METHOD
/begin COMPU_METHOD RmpPrc "Prozent Rampengradient" RAT_FUNC "%6.5" "%/s" COEFFS 0 5368.70912 0 0 0 1 /end COMPU_METHOD
/begin COMPU_METHOD RmpPres "Rampengradient für Druck" RAT_FUNC "%7.3" "hPa/s" COEFFS 0 65.536000 0 0 0 1 /end COMPU_METHOD
/begin COMPU_METHOD RmpPres_hPa "Rampengradient für Druck angezeigt in [hPa/s]" RAT_FUNC "%6.4" "hPa/s" COEFFS 0 65.536 0 0 0 1 /end COMPU_METHOD
/begin COMPU_METHOD RmpTemp "Rampengradient für Temperatur" RAT_FUNC "%6.4" "deg C/s" COEFFS 0 655.36 0 0 0 1 /end COMPU_METHOD
/begin COMPU_METHOD TempDiff_Cels "difference/offset temperature displayed in degree celcius" RAT_FUNC "%6.3" "deg C" COEFFS 0 10 0 0 0 1 /end COMPU_METHOD
/begin COMPU_METHOD TempDiff_Kelv "Offsettemperatur dargestellt in [K]" RAT_FUNC "%6.3" "deg C" COEFFS 0 10 0 0 0 1 /end COMPU_METHOD
/begin COMPU_METHOD Temp_Cels "Temperatur dargestellt in °C (gleiche interne Darstellung wie Temp_Kelv)" RAT_FUNC "%6.1" "deg C" COEFFS 0 10 2731.4 0 0 1 /end COMPU_METHOD
/begin COMPU_METHOD TimeDeb "Entprellzeit in Millisekunden für Libraryfunktion Debounce" RAT_FUNC "%6.1" "ms" COEFFS 0 0.1 0 0 0 1 /end COMPU_METHOD
/begin COMPU_METHOD TimeDelay_s "Zeitkonstante T1 (in s) für PT1, DT1, etc." RAT_FUNC "%9.3" "s" COEFFS 0 0 1 0 0.00023283064365387 0 /end COMPU_METHOD
/begin COMPU_METHOD TimeUSResolution "Zeit in Mikrosekunden für TPU Zeiten, Auflösung 1 us" RAT_FUNC "%6.2" "us" COEFFS 0 1 0 0 0 1 /end COMPU_METHOD
/begin COMPU_METHOD Time_ms "Zeit in ms für Fehlerentprellung (DSM) und SW-Timer" RAT_FUNC "%6.1" "ms" COEFFS 0 0.1 0 0 0 1 /end COMPU_METHOD
/begin COMPU_METHOD Time_ms_20ms "Zeitzähler im 20 ms Raster, dargestellt in ms" RAT_FUNC "%6.1" "ms" COEFFS 0 0.05 0 0 0 1 /end COMPU_METHOD
/begin COMPU_METHOD Time_ms_40ms "Aktuelle Zaehler in 40 ms Takt" RAT_FUNC "%6.1" "ms" COEFFS 0 0.025 0 0 0 1 /end COMPU_METHOD
/begin COMPU_METHOD Time_s "Zeit in s für Fehlerentprellung (DSM) und SW-Timer" RAT_FUNC "%6.4" "s" COEFFS 0 100 0 0 0 1 /end COMPU_METHOD
/begin COMPU_METHOD Vel "Fahrzeuggeschwindigkeit, gleiche interne Auflösung wie Vel_SI" RAT_FUNC "%6.4" "km/h" COEFFS 0 100 0 0 0 1 /end COMPU_METHOD
/begin COMPU_METHOD Volt "Spannung in V (von ADC)" RAT_FUNC "%6.2" "mV" COEFFS 0 0.2046 0 0 0 1 /end COMPU_METHOD
/begin COMPU_METHOD Volt_Batt "Batteriespannung" RAT_FUNC "%6.1" "mV" COEFFS 0 0.05115 0 0 0 1 /end COMPU_METHOD
/begin RECORD_LAYOUT Kf_Xs16_Ys16_Ws16 NO_AXIS_PTS_X 1 SWORD NO_AXIS_PTS_Y 2 SWORD AXIS_PTS_X 3 SWORD INDEX_INCR DIRECT AXIS_PTS_Y 4 SWORD INDEX_INCR DIRECT FNC_VALUES 5 SWORD COLUMN_DIR DIRECT /end RECORD_LAYOUT
/begin RECORD_LAYOUT Kl_Xs16_Ws16 NO_AXIS_PTS_X 1 SWORD AXIS_PTS_X 2 SWORD INDEX_INCR DIRECT FNC_VALUES 3 SWORD COLUMN_DIR DIRECT /end RECORD_LAYOUT
/begin RECORD_LAYOUT Kwb_Ws16 FNC_VALUES 1 SWORD COLUMN_DIR DIRECT /end RECORD_LAYOUT
/begin RECORD_LAYOUT Kwb_Wu16 FNC_VALUES 1 UWORD COLUMN_DIR DIRECT /end RECORD_LAYOUT
/begin RECORD_LAYOUT Kwb_Wu32 FNC_VALUES 1 ULONG COLUMN_DIR DIRECT /end RECORD_LAYOUT
/begin RECORD_LAYOUT Kw_Ws16 FNC_VALUES 1 SWORD COLUMN_DIR DIRECT /end RECORD_LAYOUT
/begin RECORD_LAYOUT Kw_Ws32 FNC_VALUES 1 SLONG COLUMN_DIR DIRECT /end RECORD_LAYOUT
/begin RECORD_LAYOUT Kw_Ws8 FNC_VALUES 1 SBYTE COLUMN_DIR DIRECT /end RECORD_LAYOUT
/begin RECORD_LAYOUT Kw_Wu16 FNC_VALUES 1 UWORD COLUMN_DIR DIRECT /end RECORD_LAYOUT
/begin RECORD_LAYOUT Kw_Wu32 FNC_VALUES 1 ULONG COLUMN_DIR DIRECT /end RECORD_LAYOUT
/begin RECORD_LAYOUT Kw_Wu8 FNC_VALUES 1 UBYTE COLUMN_DIR DIRECT /end RECORD_LAYOUT
/end MODULE
/end PROJECT
