/* Erstellt von DAMOS++ V1.19-8 */
ASAP2_VERSION 1 3
/begin PROJECT _725D601B "725D601B"
/begin HEADER "" VERSION "_725D601B" PROJECT_NO _725D601B /end HEADER
/begin MODULE DIM ""
/begin MOD_PAR "725D601B" VERSION "ME921" CUSTOMER_NO "11" USER "GS/EAA1" PHONE_NO "" CPU_TYPE "GoldenOak" ECU "ME921"
 /begin MEMORY_SEGMENT Pst8000 "" CODE EPROM INTERN 0x8000 0x68000 -1 -1 -1 -1 -1 /begin IF_DATA ETK ADDRESS_MAPPING 0x8000 0x8000 0x68000 /end IF_DATA /begin IF_DATA ASAP1B_CCP ADDRESS_MAPPING 0x8000 0x8000 0x68000 /end IF_DATA /begin IF_DATA ASAP1B_KWP2000 ADDRESS_MAPPING 0x8000 0x8000 0x68000 /end IF_DATA /end MEMORY_SEGMENT
 /begin MEMORY_SEGMENT PstF00000 "" CODE EPROM EXTERN 0xF00000 0xC0000 -1 -1 -1 -1 -1 /begin IF_DATA ETK ADDRESS_MAPPING 0xF00000 0xF00000 0xC0000 /end IF_DATA /begin IF_DATA ASAP1B_CCP ADDRESS_MAPPING 0xF00000 0xF00000 0xC0000 /end IF_DATA /begin IF_DATA ASAP1B_KWP2000 ADDRESS_MAPPING 0xF00000 0xF00000 0xC0000 /end IF_DATA /end MEMORY_SEGMENT
 /begin MEMORY_SEGMENT DstFC0000 "" DATA EPROM INTERN 0xFC0000 0x20000 -1 -1 -1 -1 -1 /begin IF_DATA ETK ADDRESS_MAPPING 0xFC0000 0x5C0000 0x20000 /end IF_DATA /begin IF_DATA ASAP1B_CCP ADDRESS_MAPPING 0xFC0000 0x1C0000 0x20000 /end IF_DATA /begin IF_DATA ASAP1B_KWP2000 ADDRESS_MAPPING 0xFC0000 0x1C0000 0x20000 /end IF_DATA /end MEMORY_SEGMENT
 /begin MEMORY_SEGMENT ExtRam5E0000 "" VARIABLES RAM EXTERN 0x5E0000 0x10000 -1 -1 -1 -1 -1 /* AsapMLXFm - CCP_V2_1 */ /begin IF_DATA ETK ADDRESS_MAPPING 0x5E0000 0x5E0000 0x10000 /end IF_DATA /* AsapMLXFm - KWP2000 */ /end MEMORY_SEGMENT
 /begin MEMORY_SEGMENT Ram3F9800 "" VARIABLES RAM INTERN 0x3F9800 0x6800 -1 -1 -1 -1 -1 /end MEMORY_SEGMENT
 /begin MEMORY_SEGMENT Ram400000 "" VARIABLES RAM INTERN 0x400000 0x8000 -1 -1 -1 -1 -1 /end MEMORY_SEGMENT
 SYSTEM_CONSTANT "ACTIV" "1"
 SYSTEM_CONSTANT "DPS_AKRE" "0"
 SYSTEM_CONSTANT "DPS_ANSKE" "0"
 SYSTEM_CONSTANT "DPS_ANWSE" "0"
 SYSTEM_CONSTANT "DPS_ANWSE2" "1"
 SYSTEM_CONSTANT "DPS_DHDMTE" "0"
 SYSTEM_CONSTANT "DPS_DMMVE" "0"
 SYSTEM_CONSTANT "DPS_DPMEE" "0"
 SYSTEM_CONSTANT "DPS_ELS" "0"
 SYSTEM_CONSTANT "DPS_ENWSE" "0"
 SYSTEM_CONSTANT "DPS_ENWSE2" "1"
 SYSTEM_CONSTANT "DPS_ETS" "0"
 SYSTEM_CONSTANT "DPS_EV1E" "0"
 SYSTEM_CONSTANT "DPS_EV2E" "1"
 SYSTEM_CONSTANT "DPS_EV3E" "2"
 SYSTEM_CONSTANT "DPS_EV4E" "3"
 SYSTEM_CONSTANT "DPS_EV5E" "4"
 SYSTEM_CONSTANT "DPS_EV6E" "5"
 SYSTEM_CONSTANT "DPS_EV7E" "6"
 SYSTEM_CONSTANT "DPS_EV8E" "7"
 SYSTEM_CONSTANT "DPS_GLFE" "0"
 SYSTEM_CONSTANT "DPS_KOSE" "0"
 SYSTEM_CONSTANT "DPS_KPE" "0"
 SYSTEM_CONSTANT "DPS_MLE" "0"
 SYSTEM_CONSTANT "DPS_SLPE" "0"
 SYSTEM_CONSTANT "DPS_TEVE" "0"
 SYSTEM_CONSTANT "DPS_VVTE" "0"
 SYSTEM_CONSTANT "SWOFFDL_REQUEST_MASK" "16383"
 SYSTEM_CONSTANT "SYNWS1" "4"
 SYSTEM_CONSTANT "SY_2SG" "0"
 SYSTEM_CONSTANT "SY_2SLS" "0"
 SYSTEM_CONSTANT "SY_2TEV" "0"
 SYSTEM_CONSTANT "SY_AAU" "0"
 SYSTEM_CONSTANT "SY_AAV" "0"
 SYSTEM_CONSTANT "SY_ABGY" "0"
 SYSTEM_CONSTANT "SY_ABGYVBP" "0"
 SYSTEM_CONSTANT "SY_ABMZND" "0"
 SYSTEM_CONSTANT "SY_ACCSSRY" "0"
 SYSTEM_CONSTANT "SY_ADRLAY" "1"
 SYSTEM_CONSTANT "SY_AGR" "0"
 SYSTEM_CONSTANT "SY_AGRKOMP" "0"
 SYSTEM_CONSTANT "SY_AGR_DSS" "0"
 SYSTEM_CONSTANT "SY_AIRBAG" "1"
 SYSTEM_CONSTANT "SY_ANNWSYN" "4"
 SYSTEM_CONSTANT "SY_ANSKL" "1"
 SYSTEM_CONSTANT "SY_ASG" "0"
 SYSTEM_CONSTANT "SY_ASR" "1"
 SYSTEM_CONSTANT "SY_ASTNVK" "0"
 SYSTEM_CONSTANT "SY_ASTNVK2" "0"
 SYSTEM_CONSTANT "SY_ATR" "0"
 SYSTEM_CONSTANT "SY_AVS" "0"
 SYSTEM_CONSTANT "SY_BATTORT" "0"
 SYSTEM_CONSTANT "SY_BATTSG" "0"
 SYSTEM_CONSTANT "SY_BDE" "0"
 SYSTEM_CONSTANT "SY_BIOS" "380"
 SYSTEM_CONSTANT "SY_BIRE" "0"
 SYSTEM_CONSTANT "SY_BLOOP" "0"
 SYSTEM_CONSTANT "SY_C95ANZ" "2"
 SYSTEM_CONSTANT "SY_CAN" "0"
 SYSTEM_CONSTANT "SY_CARBPROT" "2"
 SYSTEM_CONSTANT "SY_CC195" "2"
 SYSTEM_CONSTANT "SY_CC196" "0"
 SYSTEM_CONSTANT "SY_CDCSIZE" "4"
 SYSTEM_CONSTANT "SY_CDKSIZE" "1"
 SYSTEM_CONSTANT "SY_CDTSIZE" "1"
 SYSTEM_CONSTANT "SY_CFCEO" "1"
 SYSTEM_CONSTANT "SY_CJ110" "0"
 SYSTEM_CONSTANT "SY_CJ120" "0"
 SYSTEM_CONSTANT "SY_CJ125" "2"
 SYSTEM_CONSTANT "SY_CJ830" "0"
 SYSTEM_CONSTANT "SY_CJ840" "0"
 SYSTEM_CONSTANT "SY_CJ940" "2"
 SYSTEM_CONSTANT "SY_CJ945" "0"
 SYSTEM_CONSTANT "SY_CKBI" "0"
 SYSTEM_CONSTANT "SY_CLASIZE" "1"
 SYSTEM_CONSTANT "SY_CONFSL" "1"
 SYSTEM_CONSTANT "SY_CPUPM" "0"
 SYSTEM_CONSTANT "SY_CSBVAR" "0"
 SYSTEM_CONSTANT "SY_CY310" "1"
 SYSTEM_CONSTANT "SY_CY315" "0"
 SYSTEM_CONSTANT "SY_DATIO" "1"
 SYSTEM_CONSTANT "SY_DCV" "0"
 SYSTEM_CONSTANT "SY_DDYLSU" "0"
 SYSTEM_CONSTANT "SY_DEGFE" "1"
 SYSTEM_CONSTANT "SY_DELFCMS" "0"
 SYSTEM_CONSTANT "SY_DFPANZ" "255"
 SYSTEM_CONSTANT "SY_DFPMENV" "4"
 SYSTEM_CONSTANT "SY_DFPMFFR" "0"
 SYSTEM_CONSTANT "SY_DFPMTIM" "2"
 SYSTEM_CONSTANT "SY_DFPMVAR" "3"
 SYSTEM_CONSTANT "SY_DFPNL" "3"
 SYSTEM_CONSTANT "SY_DGANZ" "1"
 SYSTEM_CONSTANT "SY_DGIND" "0"
 SYSTEM_CONSTANT "SY_DHELSU" "0"
 SYSTEM_CONSTANT "SY_DISA" "1"
 SYSTEM_CONSTANT "SY_DKAT" "2"
 SYSTEM_CONSTANT "SY_DKATEF" "0"
 SYSTEM_CONSTANT "SY_DKATLRS" "0"
 SYSTEM_CONSTANT "SY_DKATSP" "1"
 SYSTEM_CONSTANT "SY_DKATSPF" "0"
 SYSTEM_CONSTANT "SY_DKATTH" "0"
 SYSTEM_CONSTANT "SY_DLCKD" "10"
 SYSTEM_CONSTANT "SY_DLCPEN" "20"
 SYSTEM_CONSTANT "SY_DLDP" "0"
 SYSTEM_CONSTANT "SY_DLSFHV" "0"
 SYSTEM_CONSTANT "SY_DLSFV" "0"
 SYSTEM_CONSTANT "SY_DLSHV" "0"
 SYSTEM_CONSTANT "SY_DLSU" "0"
 SYSTEM_CONSTANT "SY_DLSUV" "1"
 SYSTEM_CONSTANT "SY_DLSUVBK" "1"
 SYSTEM_CONSTANT "SY_DMDZAG" "1"
 SYSTEM_CONSTANT "SY_DMTL" "1"
 SYSTEM_CONSTANT "SY_DMTLKSH" "0"
 SYSTEM_CONSTANT "SY_DNWKW" "0"
 SYSTEM_CONSTANT "SY_DOPZW" "0"
 SYSTEM_CONSTANT "SY_DPCS" "41"
 SYSTEM_CONSTANT "SY_DSL10MS" "0"
 SYSTEM_CONSTANT "SY_DSL2MS" "0"
 SYSTEM_CONSTANT "SY_DSM" "0"
 SYSTEM_CONSTANT "SY_DSU" "1"
 SYSTEM_CONSTANT "SY_DTES" "6"
 SYSTEM_CONSTANT "SY_DVEADA" "0"
 SYSTEM_CONSTANT "SY_DVEVES" "0"
 SYSTEM_CONSTANT "SY_DZKDMD" "1"
 SYSTEM_CONSTANT "SY_EGAS" "1"
 SYSTEM_CONSTANT "SY_EGFE" "9"
 SYSTEM_CONSTANT "SY_ELKUP" "0"
 SYSTEM_CONSTANT "SY_ENVBLOK" "3"
 SYSTEM_CONSTANT "SY_ERCOS_TIMER_INPUT_SEL" "5"
 SYSTEM_CONSTANT "SY_ESTZ" "0"
 SYSTEM_CONSTANT "SY_ETKBYP" "1"
 SYSTEM_CONSTANT "SY_ETKTYP" "1"
 SYSTEM_CONSTANT "SY_EXHDEVE" "0"
 SYSTEM_CONSTANT "SY_F1GETR" "0"
 SYSTEM_CONSTANT "SY_FACLADP" "1"
 SYSTEM_CONSTANT "SY_FCMDISP" "1"
 SYSTEM_CONSTANT "SY_FCMIRD" "0"
 SYSTEM_CONSTANT "SY_FCMSIZE" "11"
 SYSTEM_CONSTANT "SY_FFESIZE" "0"
 SYSTEM_CONSTANT "SY_FFTSIZE" "4"
 SYSTEM_CONSTANT "SY_FFXSIZE" "11"
 SYSTEM_CONSTANT "SY_FGRRK" "0"
 SYSTEM_CONSTANT "SY_FKAT" "0"
 SYSTEM_CONSTANT "SY_FKAT2" "0"
 SYSTEM_CONSTANT "SY_FLC" "2"
 SYSTEM_CONSTANT "SY_GAP" "2"
 SYSTEM_CONSTANT "SY_GENMX" "2"
 SYSTEM_CONSTANT "SY_GRDWOF" "0"
 SYSTEM_CONSTANT "SY_GRDWRT" "54"
 SYSTEM_CONSTANT "SY_HDP" "0"
 SYSTEM_CONSTANT "SY_HKAT" "1"
 SYSTEM_CONSTANT "SY_HKAT2" "1"
 SYSTEM_CONSTANT "SY_HLCCARB" "4"
 SYSTEM_CONSTANT "SY_HLSHFET" "1"
 SYSTEM_CONSTANT "SY_IGNMX" "255"
 SYSTEM_CONSTANT "SY_INGASOS" "10"
 SYSTEM_CONSTANT "SY_INI_OBD" "0"
 SYSTEM_CONSTANT "SY_KOPWM" "0"
 SYSTEM_CONSTANT "SY_KS1" "0"
 SYSTEM_CONSTANT "SY_KS2" "1"
 SYSTEM_CONSTANT "SY_KS3" "4"
 SYSTEM_CONSTANT "SY_KS4" "5"
 SYSTEM_CONSTANT "SY_LAMBTS" "1"
 SYSTEM_CONSTANT "SY_LAYER" "0"
 SYSTEM_CONSTANT "SY_LBK" "0"
 SYSTEM_CONSTANT "SY_LECK" "0"
 SYSTEM_CONSTANT "SY_LOWRA" "0"
 SYSTEM_CONSTANT "SY_LRFKEF" "0"
 SYSTEM_CONSTANT "SY_LRSEZ" "0"
 SYSTEM_CONSTANT "SY_LS" "0"
 SYSTEM_CONSTANT "SY_LSFNHK" "1"
 SYSTEM_CONSTANT "SY_LSFNHK2" "1"
 SYSTEM_CONSTANT "SY_LSFNVK" "0"
 SYSTEM_CONSTANT "SY_LSFNVK2" "0"
 SYSTEM_CONSTANT "SY_LSHV" "0"
 SYSTEM_CONSTANT "SY_LSUGR" "0"
 SYSTEM_CONSTANT "SY_LSUIKR" "0"
 SYSTEM_CONSTANT "SY_LSUIKR2" "0"
 SYSTEM_CONSTANT "SY_LSUMRS" "0"
 SYSTEM_CONSTANT "SY_LSUSTA" "0"
 SYSTEM_CONSTANT "SY_M1I00A" "191"
 SYSTEM_CONSTANT "SY_M1I00B" "159"
 SYSTEM_CONSTANT "SY_M1I00C" "232"
 SYSTEM_CONSTANT "SY_M1I00D" "145"
 SYSTEM_CONSTANT "SY_M1I20A" "128"
 SYSTEM_CONSTANT "SY_M1I20B" "0"
 SYSTEM_CONSTANT "SY_M1I20C" "17"
 SYSTEM_CONSTANT "SY_M1I20D" "0"
 SYSTEM_CONSTANT "SY_M2I00A" "127"
 SYSTEM_CONSTANT "SY_M2I00B" "152"
 SYSTEM_CONSTANT "SY_M2I00C" "0"
 SYSTEM_CONSTANT "SY_M2I00D" "0"
 SYSTEM_CONSTANT "SY_M5IH00A" "195"
 SYSTEM_CONSTANT "SY_M5IH00B" "0"
 SYSTEM_CONSTANT "SY_M5IH00C" "0"
 SYSTEM_CONSTANT "SY_M5IH00D" "0"
 SYSTEM_CONSTANT "SY_M5IH20A" "0"
 SYSTEM_CONSTANT "SY_M5IH20B" "0"
 SYSTEM_CONSTANT "SY_M5IH20C" "0"
 SYSTEM_CONSTANT "SY_M5IH20D" "0"
 SYSTEM_CONSTANT "SY_M5IH40A" "0"
 SYSTEM_CONSTANT "SY_M5IH40B" "0"
 SYSTEM_CONSTANT "SY_M5IH40C" "0"
 SYSTEM_CONSTANT "SY_M5IH40D" "0"
 SYSTEM_CONSTANT "SY_M5IH60A" "0"
 SYSTEM_CONSTANT "SY_M5IH60B" "0"
 SYSTEM_CONSTANT "SY_M5IH60C" "0"
 SYSTEM_CONSTANT "SY_M5IH60D" "0"
 SYSTEM_CONSTANT "SY_M5IH80A" "0"
 SYSTEM_CONSTANT "SY_M5IH80B" "0"
 SYSTEM_CONSTANT "SY_M5IH80C" "0"
 SYSTEM_CONSTANT "SY_M5IH80D" "0"
 SYSTEM_CONSTANT "SY_M5IV00A" "0"
 SYSTEM_CONSTANT "SY_M5IV00B" "0"
 SYSTEM_CONSTANT "SY_M5IV00C" "0"
 SYSTEM_CONSTANT "SY_M5IV00D" "1"
 SYSTEM_CONSTANT "SY_M5IV20A" "0"
 SYSTEM_CONSTANT "SY_M5IV20B" "0"
 SYSTEM_CONSTANT "SY_M5IV20C" "0"
 SYSTEM_CONSTANT "SY_M5IV20D" "1"
 SYSTEM_CONSTANT "SY_M5IV40A" "0"
 SYSTEM_CONSTANT "SY_M5IV40B" "0"
 SYSTEM_CONSTANT "SY_M5IV40C" "0"
 SYSTEM_CONSTANT "SY_M5IV40D" "1"
 SYSTEM_CONSTANT "SY_M5IV60A" "0"
 SYSTEM_CONSTANT "SY_M5IV60B" "0"
 SYSTEM_CONSTANT "SY_M5IV60C" "0"
 SYSTEM_CONSTANT "SY_M5IV60D" "1"
 SYSTEM_CONSTANT "SY_M5IV80A" "240"
 SYSTEM_CONSTANT "SY_M5IV80B" "0"
 SYSTEM_CONSTANT "SY_M5IV80C" "0"
 SYSTEM_CONSTANT "SY_M5IV80D" "0"
 SYSTEM_CONSTANT "SY_M6I00A" "168"
 SYSTEM_CONSTANT "SY_M6I00B" "128"
 SYSTEM_CONSTANT "SY_M6I00C" "0"
 SYSTEM_CONSTANT "SY_M6I00D" "0"
 SYSTEM_CONSTANT "SY_M7VAR" "0"
 SYSTEM_CONSTANT "SY_M8I00B" "128"
 SYSTEM_CONSTANT "SY_M8I00C" "0"
 SYSTEM_CONSTANT "SY_M8I00D" "0"
 SYSTEM_CONSTANT "SY_M8I00E" "0"
 SYSTEM_CONSTANT "SY_M9I00A" "252"
 SYSTEM_CONSTANT "SY_M9I00B" "0"
 SYSTEM_CONSTANT "SY_M9I00C" "0"
 SYSTEM_CONSTANT "SY_M9I00D" "0"
 SYSTEM_CONSTANT "SY_MKAT" "0"
 SYSTEM_CONSTANT "SY_MKAT2" "0"
 SYSTEM_CONSTANT "SY_MLSUBQF" "130"
 SYSTEM_CONSTANT "SY_NLDG" "1"
 SYSTEM_CONSTANT "SY_NOHK" "0"
 SYSTEM_CONSTANT "SY_NOXKAT" "0"
 SYSTEM_CONSTANT "SY_NVRAMBK" "1"
 SYSTEM_CONSTANT "SY_NWACED1" "1"
 SYSTEM_CONSTANT "SY_NWACED2" "1"
 SYSTEM_CONSTANT "SY_NWACED3" "1"
 SYSTEM_CONSTANT "SY_NWACED4" "1"
 SYSTEM_CONSTANT "SY_NWGA" "2"
 SYSTEM_CONSTANT "SY_NWGA2" "4"
 SYSTEM_CONSTANT "SY_NWGE" "1"
 SYSTEM_CONSTANT "SY_NWGE2" "3"
 SYSTEM_CONSTANT "SY_NWS" "2"
 SYSTEM_CONSTANT "SY_NWSA" "2"
 SYSTEM_CONSTANT "SY_NWVAR" "4"
 SYSTEM_CONSTANT "SY_NWZUHW1" "1"
 SYSTEM_CONSTANT "SY_NWZUHW2" "2"
 SYSTEM_CONSTANT "SY_NWZUHW3" "3"
 SYSTEM_CONSTANT "SY_NWZUHW4" "4"
 SYSTEM_CONSTANT "SY_ODT_100MS" "10"
 SYSTEM_CONSTANT "SY_ODT_10MS" "5"
 SYSTEM_CONSTANT "SY_ODT_SYN" "2"
 SYSTEM_CONSTANT "SY_OVERSIZ" "2"
 SYSTEM_CONSTANT "SY_OZ" "1"
 SYSTEM_CONSTANT "SY_PBRPW" "1"
 SYSTEM_CONSTANT "SY_PGRAD" "4"
 SYSTEM_CONSTANT "SY_PGRAD2" "4"
 SYSTEM_CONSTANT "SY_PGRAD3" "4"
 SYSTEM_CONSTANT "SY_PGRAD4" "4"
 SYSTEM_CONSTANT "SY_PGTPO" "1"
 SYSTEM_CONSTANT "SY_PHTWIN" "0"
 SYSTEM_CONSTANT "SY_PORTERW" "0"
 SYSTEM_CONSTANT "SY_PREDRV" "1"
 SYSTEM_CONSTANT "SY_PTCAN" "1"
 SYSTEM_CONSTANT "SY_RASFAKM" "160"
 SYSTEM_CONSTANT "SY_RASNMAX" "138"
 SYSTEM_CONSTANT "SY_RASNMIN" "75"
 SYSTEM_CONSTANT "SY_RDE" "0"
 SYSTEM_CONSTANT "SY_RDYTLDX" "0"
 SYSTEM_CONSTANT "SY_REDMX" "8"
 SYSTEM_CONSTANT "SY_RLTEST" "50"
 SYSTEM_CONSTANT "SY_RTMESS" "0"
 SYSTEM_CONSTANT "SY_SALSU" "0"
 SYSTEM_CONSTANT "SY_SCHICHT" "0"
 SYSTEM_CONSTANT "SY_SEGL" "90"
 SYSTEM_CONSTANT "SY_SGANZ" "1"
 SYSTEM_CONSTANT "SY_SLPANZ" "1"
 SYSTEM_CONSTANT "SY_SLS" "1"
 SYSTEM_CONSTANT "SY_SLWG" "0"
 SYSTEM_CONSTANT "SY_STA" "1"
 SYSTEM_CONSTANT "SY_STERBTS" "1"
 SYSTEM_CONSTANT "SY_STEREO" "1"
 SYSTEM_CONSTANT "SY_STERHK" "1"
 SYSTEM_CONSTANT "SY_STERSY" "1"
 SYSTEM_CONSTANT "SY_STERVK" "1"
 SYSTEM_CONSTANT "SY_STETLR" "1"
 SYSTEM_CONSTANT "SY_STK" "0"
 SYSTEM_CONSTANT "SY_SU" "0"
 SYSTEM_CONSTANT "SY_SWE_B" "0"
 SYSTEM_CONSTANT "SY_SWE_C" "1"
 SYSTEM_CONSTANT "SY_SWE_K" "0"
 SYSTEM_CONSTANT "SY_SWE_S" "0"
 SYSTEM_CONSTANT "SY_TABST" "1"
 SYSTEM_CONSTANT "SY_TEBF" "0"
 SYSTEM_CONSTANT "SY_TEETH" "60"
 SYSTEM_CONSTANT "SY_TFA" "0"
 SYSTEM_CONSTANT "SY_TFAOPL" "0"
 SYSTEM_CONSTANT "SY_TFBA" "0"
 SYSTEM_CONSTANT "SY_TFMA" "1"
 SYSTEM_CONSTANT "SY_TFMAP" "0"
 SYSTEM_CONSTANT "SY_TFMHST" "1"
 SYSTEM_CONSTANT "SY_TFMO" "1"
 SYSTEM_CONSTANT "SY_TFNS" "0"
 SYSTEM_CONSTANT "SY_TFRK" "0"
 SYSTEM_CONSTANT "SY_TFUMG" "1"
 SYSTEM_CONSTANT "SY_TFVA" "0"
 SYSTEM_CONSTANT "SY_TFWL" "0"
 SYSTEM_CONSTANT "SY_TGET" "1"
 SYSTEM_CONSTANT "SY_TKAT" "0"
 SYSTEM_CONSTANT "SY_TLDLHV" "1"
 SYSTEM_CONSTANT "SY_TLE6232" "0"
 SYSTEM_CONSTANT "SY_TLR" "0"
 SYSTEM_CONSTANT "SY_TMKR" "0"
 SYSTEM_CONSTANT "SY_TN" "1"
 SYSTEM_CONSTANT "SY_TRLX" "0"
 SYSTEM_CONSTANT "SY_TSFSIZE" "1"
 SYSTEM_CONSTANT "SY_TURBO" "0"
 SYSTEM_CONSTANT "SY_TVVR" "0"
 SYSTEM_CONSTANT "SY_TWDKS" "0"
 SYSTEM_CONSTANT "SY_TWSLP" "1"
 SYSTEM_CONSTANT "SY_UB13V" "138"
 SYSTEM_CONSTANT "SY_UBDEDIS" "74"
 SYSTEM_CONSTANT "SY_UBDEEN" "86"
 SYSTEM_CONSTANT "SY_UBOKDIS" "63"
 SYSTEM_CONSTANT "SY_UBOKEN" "74"
 SYSTEM_CONSTANT "SY_UBR" "0"
 SYSTEM_CONSTANT "SY_UBSQ_W" "965"
 SYSTEM_CONSTANT "SY_UMALS" "0"
 SYSTEM_CONSTANT "SY_USBUS" "0"
 SYSTEM_CONSTANT "SY_USBUSIC" "0"
 SYSTEM_CONSTANT "SY_USOFF" "205"
 SYSTEM_CONSTANT "SY_VS" "0"
 SYSTEM_CONSTANT "SY_VVT" "2"
 SYSTEM_CONSTANT "SY_VVTINT" "0"
 SYSTEM_CONSTANT "SY_WFS" "1"
 SYSTEM_CONSTANT "SY_WMAX" "72"
 SYSTEM_CONSTANT "SY_WMIN" "-32"
 SYSTEM_CONSTANT "SY_WNBM" "6"
 SYSTEM_CONSTANT "SY_ZAS" "0"
 SYSTEM_CONSTANT "SY_ZKANZ" "8"
 SYSTEM_CONSTANT "SY_ZMS" "0"
 SYSTEM_CONSTANT "SY_ZNDAUS" "1"
 SYSTEM_CONSTANT "SY_ZWCALC" "0"
 SYSTEM_CONSTANT "SY_ZYLG" "8"
 SYSTEM_CONSTANT "SY_ZYLZA" "8"
 SYSTEM_CONSTANT "SY_ZYLZG" "8"
 SYSTEM_CONSTANT "SY_ZZBANK" "90" /end MOD_PAR
/begin MOD_COMMON "" BYTE_ORDER MSB_FIRST ALIGNMENT_BYTE 1 ALIGNMENT_WORD 2 ALIGNMENT_LONG 2 ALIGNMENT_FLOAT32_IEEE 4 /end MOD_COMMON
/* --- AgI-Objekt f¸r CCP (ASAP V1.21), Stand 1.0 31.7.98 --- */
/begin IF_DATA ASAP1B_CCP
 /begin SOURCE "time synchronous event channel - 10 ms" 4 1 /begin QP_BLOB 0 LENGTH 5 CAN_ID_FIXED 0x7A0 RASTER 0 /end QP_BLOB /end SOURCE
 /begin SOURCE "time synchronous event channel - 100 ms" 5 1 /begin QP_BLOB 1 LENGTH 10 CAN_ID_FIXED 0x7A1 RASTER 1 /end QP_BLOB /end SOURCE
 /begin SOURCE "segment synchronous event channel" 103 1 /begin QP_BLOB 2 LENGTH 2 CAN_ID_FIXED 0x7A2 RASTER 2 /end QP_BLOB /end SOURCE
 /begin RASTER "time synchronous event channel - 10 ms" "10_ms" 0 4 1 /end RASTER
 /begin RASTER "time synchronous event channel - 100 ms" "100_ms" 1 5 1 /end RASTER
 /begin RASTER "segment synchronous event channel" "seg_sync" 2 103 1 /end RASTER
 /begin SEED_KEY /* seed&key dll for CAL privilege */ "" /* seed&key dll for DAQ privilege */ "" /* seed&key dll for PGM privilege */ "" /end SEED_KEY
 /begin TP_BLOB /* CCP version */ 0x201 /* Blob version */ 0x202 /* CAN msg ID - send */ 0x7BC /* CAN msg ID - recv */ 0x7BD /* station address */ 0x12ED /* byte order */ 1
  /begin CAN_PARAM /* crystal frequency */ 0x1F4 /* timing register 0 */ 0x41 /* timing register 1 */ 0x25 /end CAN_PARAM
  DAQ_MODE BURST CONSISTENCY ODT ADDRESS_EXTENSION ODT
  /begin CHECKSUM_PARAM /* algorithm */ 0xC001 /* limit */ 0xFFFFFFFF CHECKSUM_CALCULATION ACTIVE_PAGE /end CHECKSUM_PARAM
  /begin DEFINED_PAGES 1 "reference page" /* address ext. */ 0x1 /* base address */ 0x1C0000 /* page length */ 0x1FFFF ROM /end DEFINED_PAGES
  OPTIONAL_CMD 0xC /* SELECT_CAL_PAGE */ OPTIONAL_CMD 0xD /* BUILD_CHKSUM */ OPTIONAL_CMD 0xE /* MOVE */ OPTIONAL_CMD 0x11 /* GET_ACTIVE_CAL_PAGE */ OPTIONAL_CMD 0x19 /* SET_S_STATUS */ OPTIONAL_CMD 0xD /* GET_S_STATUS */ OPTIONAL_CMD 0x12 /* GET_SEED */ OPTIONAL_CMD 0x13 /* UNLOCK */ /end TP_BLOB
/end IF_DATA
/* --- Default-AgI-Objekt */ /* --- AgI-Objekt f¸r ETK (ASAP V1.3B0), Stand 1.0 16.7.98 --- */
/begin IF_DATA ETK
 /begin TP_BLOB /*version:*/ 0x1000001 /*pba:*/ 0x0 /*reset_cfg:*/ 0x40001800
  /begin DISTAB_CFG /*dsptab:*/ 0xD /*dat_mod:*/ 0x1 /*rfg:*/ 0x1 /*trgsegad:*/ 0x5E0000 /*trg_cfg:*/ 0x1020100 TRG_MOD /*Id:*/ 0x0 /*trg_mod:*/ 0xFF 0x0 0x0 0x0 /end DISTAB_CFG
  CODE_CHK /*prg_data:*/ 0x5C0210 /*prg_length:*/ 0xC /*prg_eram:*/ 0x5E01DC /*prg_length:*/ 0xC ETK_CFG 0x2 0xc2 0x3d 0xff 0xef 0x3e 0xdf 0xef 0x3d 0xff 0xfb 0xfe 0xff 0xff 0xfe 0xff 0xff 0xff 0xff 0xff 0x3 0x60 0x5 0xff /* EMU_RAM start_addr length CS offset >>>>> (multiple) */ /* EMU_DATA start_addr length CS offset >>>>> (multiple) */ /* EMU_CODE start_addr length CS offset >>>>> (multiple) */ /* RESERVED start_addr length CS offset >>>>> (multiple) */ RESERVED /*start_addr:*/ 0x5C0250 0x618 EXTERN -1 -1 -1 -1 -1 ETK_MAILBOX /*pattern:*/ 0x55555555 /*page_ecu:*/ DATA /*ecu_adr:*/ 0x560000 /*..length:*/ 0x8000 /*page_am:*/ EXRAM /*am_adr:*/ 0x5E1000 /*..length:*/ 0x7000 /end TP_BLOB
 /begin SOURCE "Synchro" 103 1 QP_BLOB 1 0x38 0x5C0250 0x5E0094 0x5E0080 0 0 0 /end SOURCE
 /begin SOURCE "10ms" 4 1 QP_BLOB 2 0x58 0x5C0338 0x5E00CC 0x5E0084 10 0 0 /end SOURCE
 /begin SOURCE "100ms" 5 1 QP_BLOB 3 0x58 0x5C04A0 0x5E0124 0x5E0088 100 0 0 /end SOURCE
 /begin SOURCE "Bypass_Synchro" 103 1 QP_BLOB 4 0x30 0x5C0608 0x5E017C 0x5E008C 0 0x30 0x5C0798 /end SOURCE
 /begin SOURCE "Bypass_10ms" 4 1 QP_BLOB 5 0x30 0x5C06D0 0x5E01AC 0x5E0090 10 0x30 0x5C0800 /end SOURCE
/end IF_DATA
/begin IF_DATA ASAP1B_KWP2000
 /begin SOURCE "timeslot" 0 0 QP_BLOB 0 BLOCKMODE 0xF0 0 20 /end SOURCE
 /begin TP_BLOB /* Blob version */ 0x100 /* ECU address on k line */ 0x12 /* requ. tester address */ 0xF1 /* ECU stimulation mode */ WuP /* byte order */ MSB_FIRST 1 /* project base address */ 0x0 SERAM /* SERAM_A */ 0x1C0000 /* SERAM_O */ 0x1C0000 /* SERAM_U */ 0x1DFFFE /* SERAM_E */ 0x1DFFFE /* Flash address */ 0x000000 /* RAM address */ 0x000000 /* Data Read */ 1 /* Code Verify */ 0 /* Code Read */ 0 /* Load mode */ 1 /begin CHECKSUM 0x010201 1 1 RequestRoutineResults RNC_RESULT 0x23 /end CHECKSUM
  /begin FLASH_COPY NOFLASHBACK 3 RequestRoutineResults RAM_InitByECU 0x86 COPY_FRAME 1 RNC_RESULT 0x23 0xFB 0xFC /end FLASH_COPY
  BAUD_DEF /* BaudRate */ 10400 /* DiagMode */ 0x86 0x14 BAUD_DEF /* BaudRate */ 20800 /* DiagMode */ 0x86 0x34 TIME_DEF 0x0005 0x0000 0x0032 0x000F 0x1388 0x0002 TIME_DEF 0x0005 0x0000 0x0032 0x0014 0x1388 0x0003 TIME_DEF 0x0014 0x000A 0x0032 0x0014 0x1388 0x0004 TIME_DEF 0x0014 0x0019 0x0032 0x001E 0x1388 0x0005 /end TP_BLOB
/end IF_DATA
/begin CHARACTERISTIC A0 "‹bertragungsfunktionskoeffizient" VALUE 0xFC8F1E KwSw 0.1249981 fak_sw_b0p0625 -0.06250000 0.06249809 FORMAT "%10.8" /end CHARACTERISTIC
/begin CHARACTERISTIC A1 "‹bertragungsfunktionskoeffizient" VALUE 0xFC8F20 KwSw 0.1249981 fak_sw_b0p0625 -0.06250000 0.06249809 FORMAT "%10.8" /end CHARACTERISTIC
/begin CHARACTERISTIC A2 "‹bertragungsfunktionskoeffizient" VALUE 0xFC8F22 KwSw 0.1249981 fak_sw_b0p0625 -0.06250000 0.06249809 FORMAT "%10.8" /end CHARACTERISTIC
/begin CHARACTERISTIC ABOLRAR "Schwelle Anzahl Starts mit Benzin im ÷l f¸r reduzierte LRA" VALUE 0xFD2268 KwUb 255.0 dez 0.00 255.0 FORMAT "%5.1" /end CHARACTERISTIC
/begin CHARACTERISTIC ABOMX "max. Anzahl Start-Z‰hler f¸r Erkennung Benzin im ÷l" VALUE 0xFD2269 KwUb 255.0 dez 0.00 255.0 FORMAT "%5.1" /end CHARACTERISTIC
/begin CHARACTERISTIC ATMTANS "Temperaturkorrektur der Abgas-Modell-Temperatur" CURVE 0xFCFC79 KlAUbSstUbWSb 1275. temp_q5 -640.0 635.0 FORMAT "%5.1"
 /begin AXIS_DESCR STD_AXIS tatu temp_ub_q0p75_o48 3 -48.00 143.3 FORMAT "%5.1" DEPOSIT ABSOLUTE /end AXIS_DESCR
/end CHARACTERISTIC
/begin CHARACTERISTIC AWALEMX "max. Drehwinkel nach Motorstop" VALUE 0xFC1D86 KwWU16 180.0000 kw_q0p1 0.00 180.0000 FORMAT "%8.4" /end CHARACTERISTIC
/begin CHARACTERISTIC B1 "‹bertragungsfunktionskoeffizient" VALUE 0xFC8F24 KwSw 3.999939 fak_sw_b2 -2.000000 1.999939 FORMAT "%8.6" /end CHARACTERISTIC
/begin CHARACTERISTIC B2 "‹bertragungsfunktionskoeffizient" VALUE 0xFC8F26 KwSw 3.999939 fak_sw_b2 -2.000000 1.999939 FORMAT "%8.6" /end CHARACTERISTIC
/begin CHARACTERISTIC BFGRO "Obere Schwelle f¸r Beschleunigung im FGR-Betrieb" VALUE 0xFC223A KwSb 55.34 bfzg_sb_q0p217 -27.78 27.56 FORMAT "%5.2" /end CHARACTERISTIC
/begin CHARACTERISTIC BFGRU "Untere Schwelle f¸r Beschleunigung im FGR-Betrieb" VALUE 0xFC223B KwSb 55.34 bfzg_sb_q0p217 -27.78 27.56 FORMAT "%5.2" /end CHARACTERISTIC
/begin CHARACTERISTIC BTRKHTMS "Kennline zur Freigabe B_trkh" CURVE 0xFD27FE KlAUbSstUbWUb 255.0 dez 0.00 255.0 FORMAT "%5.1"
 /begin AXIS_DESCR STD_AXIS tmst temp_ub_q0p75_o48 8 -48.00 143.3 FORMAT "%5.1" DEPOSIT ABSOLUTE /end AXIS_DESCR
/end CHARACTERISTIC
/begin CHARACTERISTIC CWAKR "Codewort f¸r Abgasklappensteuerung" VALUE 0xFD53FA KwWU8 255.0 dez 0.00 255.0 FORMAT "%5.1" /end CHARACTERISTIC
/begin CHARACTERISTIC CWARMD "Codewort Antiruckelfunktion" VALUE 0xFC8EE2 KwUb 255.0 dez 0.00 255.0 FORMAT "%5.1" /end CHARACTERISTIC
/begin CHARACTERISTIC CWATBEG "Codewort ATBEG ist aktiv" VALUE 0xFC6882 KwWU8 2.000 dez 0.00 2.000 FORMAT "%5.3" /end CHARACTERISTIC
/begin CHARACTERISTIC CWATM "Codewort f¸r Abgastemperaturmodell" VALUE 0xFCFA4A KwUb 255.0 dez 0.00 255.0 FORMAT "%5.1" /end CHARACTERISTIC
/begin CHARACTERISTIC CWBBFGR "Codewort f¸r BBFGR" VALUE 0xFC223C KwUb 255.0 dez 0.00 255.0 FORMAT "%5.1" /end CHARACTERISTIC
/begin CHARACTERISTIC CWBFGROF "Codewort f¸r BBFGR bei externen Abschalt-Anforderungen" VALUE 0xFC223D KwUb 255.0 dez 0.00 255.0 FORMAT "%5.1" /end CHARACTERISTIC
/begin CHARACTERISTIC CWDKNOLU "" VALUE 0xFCFA38 KwUb 255.0 dez 0.00 255.0 FORMAT "%5.1" /end CHARACTERISTIC
/begin CHARACTERISTIC CWDLRIKL "" VALUE 0xFC1E06 KwUb 255.0 dez 0.00 255.0 FORMAT "%5.1" /end CHARACTERISTIC
/begin CHARACTERISTIC CWEVAB "Codewort zur Abschaltung von Einspritzventilen" VALUE 0xFD1440 KwUb 255.0 dez 0.00 255.0 FORMAT "%5.1" /end CHARACTERISTIC
/begin CHARACTERISTIC CWGETSL "Codewort Berechnung des Schlupfes Abh‰ngig von Getriebeart" VALUE 0xFC8EE3 KwUb 255.0 dez 0.00 255.0 FORMAT "%5.1" /end CHARACTERISTIC
/begin CHARACTERISTIC CWIHAADP "Codewort Aktivierung der Hinterachsadaption" VALUE 0xFC207E KwUb 255.0 dez 0.00 255.0 FORMAT "%5.1" /end CHARACTERISTIC
/begin CHARACTERISTIC CWKHZ "Codewort f¸r Katheizsteuerung" VALUE 0xFD280F KwUb 255.0 dez 0.00 255.0 FORMAT "%5.1" /end CHARACTERISTIC
/begin CHARACTERISTIC CWKHZ2 "Codewort f¸r Katheizsteuerung" VALUE 0xFD2810 KwUb 255.0 dez 0.00 255.0 FORMAT "%5.1" /end CHARACTERISTIC
/begin CHARACTERISTIC CWNVRAMBK "Codewort NVRAM-Backup aktiviert" VALUE 0xFCC9D2 KwUb 255.0 DEZ 0.00 255.0 FORMAT "%5.1" /end CHARACTERISTIC
/begin CHARACTERISTIC DANTGESWNV "Schwelle Aktivierung D-Anteil (Geschwindigkeit) im unverst‰rkten Bereich" VALUE 0xFC1EB8 KwSw 1599.976 relDK_q0p02441 -800.0000 799.9756 FORMAT "%8.4" /end CHARACTERISTIC
/begin CHARACTERISTIC DANTGESWV "Schwelle Aktivierung D-Anteil (Geschwindigkeit) im verst‰rkten Bereich" VALUE 0xFC1EBA KwSw 1599.976 relDK_q0p02441 -800.0000 799.9756 FORMAT "%8.4" /end CHARACTERISTIC
/begin CHARACTERISTIC DANTSCHWNV "Schwelle Aktivierung D-Anteil (Abweichung) im unverst‰rkten Bereich" VALUE 0xFC1EBC KwSw 1599.976 relDK_q0p02441 -800.0000 799.9756 FORMAT "%8.4" /end CHARACTERISTIC
/begin CHARACTERISTIC DANTSCHWV "Schwelle Aktivierung D-Anteil (Abweichung) im verst‰rkten Bereich" VALUE 0xFC1EBE KwSw 1599.976 relDK_q0p02441 -800.0000 799.9756 FORMAT "%8.4" /end CHARACTERISTIC
/begin CHARACTERISTIC DKLAGERT "zul‰ssige Fehlerzeit f¸r DK-Soll-/Istvergleich" VALUE 0xFC1E07 KwUb 5.100 t20msxs_ub_b5p1 0.00 5.100 FORMAT "%5.3" /end CHARACTERISTIC
/begin CHARACTERISTIC DLRDWDKSS1 "DLR, obere Grenze zur Parameterumschaltung" VALUE 0xFC1EC0 KwSw 99.99847 relDK_q0p00152 -50.00000 49.99847 FORMAT "%8.5" /end CHARACTERISTIC
/begin CHARACTERISTIC DLRDWDKSS2 "DLR, untere Grenze zur Parameterumschaltung" VALUE 0xFC1EC2 KwSw 99.99847 relDK_q0p00152 -50.00000 49.99847 FORMAT "%8.5" /end CHARACTERISTIC
/begin CHARACTERISTIC DLRHAFTMN "min. notwendiger I-Anteil im Haftreibunsfall" VALUE 0xFCFA40 KwSw 100.0000 rel_q0p1957 -100.0000 0.00 FORMAT "%8.4" /end CHARACTERISTIC
/begin CHARACTERISTIC DLRHAFTST "max. Sollwertgradient zur Aktivierung der Haftreibunsroutine" VALUE 0xFCFA42 KwSw 99.99847 relDK_q0p00152 -50.00000 49.99847 FORMAT "%8.5" /end CHARACTERISTIC
/begin CHARACTERISTIC DLRIAMAXA "maximal zul‰ssiger I-Anteil" VALUE 0xFC1EC4 KwUw 100.0000 rel_q0p1957 0.00 100.0000 FORMAT "%8.4" /end CHARACTERISTIC
/begin CHARACTERISTIC DLRIKLPAR "DLR, I-Klein Parameter" VALUE 0xFC1E08 KwUb 15.94 relDK_q0p0625 0.00 15.94 FORMAT "%5.2" /end CHARACTERISTIC
/begin CHARACTERISTIC DLRININI "I-Anteil bei Inititialisierung der NLP-Funktion" VALUE 0xFC1EC6 KwUw 100.0000 rel_q0p1957 0.00 100.0000 FORMAT "%8.4" /end CHARACTERISTIC
/begin CHARACTERISTIC DLRKDONLP0 "DLR, D-Parameter ¸ber NLP" VALUE 0xFC1E09 KwUb 1020. relDK_q4 0.00 1020. FORMAT "%5.0" /end CHARACTERISTIC
/begin CHARACTERISTIC DLRKDUNLP0 "DLR, D-Parameter unter NLP (schwach)" VALUE 0xFC1E0A KwUb 1020. relDK_q4 0.00 1020. FORMAT "%5.0" /end CHARACTERISTIC
/begin CHARACTERISTIC DLRKDUNLP1 "DLR, D-Parameter unter NLP (mittel)" VALUE 0xFC1E0B KwUb 1020. relDK_q4 0.00 1020. FORMAT "%5.0" /end CHARACTERISTIC
/begin CHARACTERISTIC DLRKDUNLP2 "DLR, D-Parameter unter NLP (stark)" VALUE 0xFC1E0C KwUb 1020. relDK_q4 0.00 1020. FORMAT "%5.0" /end CHARACTERISTIC
/begin CHARACTERISTIC DLRKDUNLP3 "DLR, D-Parameter unter NLP (unverst‰rktes Poti)" VALUE 0xFC1E0D KwUb 1020. relDK_q4 0.00 1020. FORMAT "%5.0" /end CHARACTERISTIC
/begin CHARACTERISTIC DLRKIONLP0 "I-Anteil als f(abs(dwdkdlr_w)), ¸ber NLP" VAL_BLK 0xFC1E0E KwbUb 15.94 relDK_q0p0625 0.00 15.94 FORMAT "%5.2" NUMBER 32 /end CHARACTERISTIC
/begin CHARACTERISTIC DLRKIUNLP0 "I-Anteil als f(abs(dwdkdlr_w)), unter NLP (schwach)" VAL_BLK 0xFC1E2E KwbUb 15.94 relDK_q0p0625 0.00 15.94 FORMAT "%5.2" NUMBER 32 /end CHARACTERISTIC
/begin CHARACTERISTIC DLRKIUNLP1 "I-Anteil als f(abs(dwdkdlr_w)), unter NLP (mittel)" VAL_BLK 0xFC1E4E KwbUb 15.94 relDK_q0p0625 0.00 15.94 FORMAT "%5.2" NUMBER 32 /end CHARACTERISTIC
/begin CHARACTERISTIC DLRKIUNLP2 "I-Anteil als f(abs(dwdkdlr_w)), unter NLP (stark)" VAL_BLK 0xFC1E6E KwbUb 15.94 relDK_q0p0625 0.00 15.94 FORMAT "%5.2" NUMBER 32 /end CHARACTERISTIC
/begin CHARACTERISTIC DLRKIUNLP3 "I-Anteil als f(abs(dwdkdlr_w)), unter NLP (stark)" VAL_BLK 0xFC1E8E KwbUb 15.94 relDK_q0p0625 0.00 15.94 FORMAT "%5.2" NUMBER 32 /end CHARACTERISTIC
/begin CHARACTERISTIC DLRKPONLP0 "DLR, P-Parameter ¸ber NLP" VALUE 0xFC1EAE KwUb 255.0 relDK_q1 0.00 255.0 FORMAT "%5.1" /end CHARACTERISTIC
/begin CHARACTERISTIC DLRKPUNLP0 "DLR, P-Parameter unter NLP (schwach)" VALUE 0xFC1EAF KwUb 255.0 relDK_q1 0.00 255.0 FORMAT "%5.1" /end CHARACTERISTIC
/begin CHARACTERISTIC DLRKPUNLP1 "DLR, P-Parameter unter NLP (mittel)" VALUE 0xFC1EB0 KwUb 255.0 relDK_q1 0.00 255.0 FORMAT "%5.1" /end CHARACTERISTIC
/begin CHARACTERISTIC DLRKPUNLP2 "DLR, P-Parameter unter NLP (stark)" VALUE 0xFC1EB1 KwUb 255.0 relDK_q1 0.00 255.0 FORMAT "%5.1" /end CHARACTERISTIC
/begin CHARACTERISTIC DLRKPUNLP3 "DLR, P-Parameter unter NLP (unverst‰rktes Poti)" VALUE 0xFC1EB2 KwUb 255.0 relDK_q1 0.00 255.0 FORMAT "%5.1" /end CHARACTERISTIC
/begin CHARACTERISTIC DLRKREIS "DLR, Faktor Kreisverst‰rkung" VALUE 0xFCFA39 KwUb 1.992 fak_ub_b2 0.00 1.992 FORMAT "%5.3" /end CHARACTERISTIC
/begin CHARACTERISTIC DLRKREISST "DLR, Faktor Kreisverst‰rkung zur Zeit des Motorstarts" VALUE 0xFCFA3A KwUb 1.992 fak_ub_b2 0.00 1.992 FORMAT "%5.3" /end CHARACTERISTIC
/begin CHARACTERISTIC DLRNLPD "Unsch‰rfebereich f¸r DK-Notluftposition" VALUE 0xFC1EC8 KwUw 100.0000 relDK_uw_b100 0.00 100.0000 FORMAT "%8.4" /end CHARACTERISTIC
/begin CHARACTERISTIC DLRPID0T "Fehlerzeit f¸r DLR-Stellbereich im Anschlag zur erweiterten Stellertauscherkenng" VALUE 0xFC1ECA KwUw 655.3500 t10msxs_uw_b655p35 0.00 655.3500 FORMAT "%8.4" /end CHARACTERISTIC
/begin CHARACTERISTIC DLRPID1T "zul‰ssige Fehlerzeit 1 f¸r DLR-Stellbereich am Anschlag" VALUE 0xFC1ECC KwUw 655.3500 t10msxs_uw_b655p35 0.00 655.3500 FORMAT "%8.4" /end CHARACTERISTIC
/begin CHARACTERISTIC DLRPID2T "zul‰ssige Fehlerzeit 2 f¸r DLR-Stellbereich am Anschlag" VALUE 0xFC1ECE KwUw 655.3500 t10msxs_uw_b655p35 0.00 655.3500 FORMAT "%8.4" /end CHARACTERISTIC
/begin CHARACTERISTIC DLRPIDMAX "max. zul‰ssiges PWM-Tastverh‰ltnis f¸r DLR" VALUE 0xFC1ED0 KwUw 99.99847 rel_uw_b100 0.00 99.99847 FORMAT "%8.5" /end CHARACTERISTIC
/begin CHARACTERISTIC DLRPIDMIN "min. zul‰ssiges PWM-Tastverh‰ltnis f¸r DLR" VALUE 0xFC1ED2 KwUw 99.99847 rel_uw_b100 0.00 99.99847 FORMAT "%8.5" /end CHARACTERISTIC
/begin CHARACTERISTIC DLRUBSOLL "DLR, Batterie Normalspannung" VALUE 0xFCFA3B KwUb 24.02 spg_ubatt 0.00 24.02 FORMAT "%5.2" /end CHARACTERISTIC
/begin CHARACTERISTIC DLRUMABAND "Unsicherheitsband bei Sprung aus UMA-Bereich" VALUE 0xFC1ED4 KwUw 4.882813 relDK_q0p02441 0.00 4.882813 FORMAT "%8.6" /end CHARACTERISTIC
/begin CHARACTERISTIC DLRUMAIINI "Vorladewert I-Anteil bei Sprung aus UMA-Bereich" VALUE 0xFC1ED6 KwSw 12824.85 rel_q0p1957 -6412.524 6412.329 FORMAT "%8.3" /end CHARACTERISTIC
/begin CHARACTERISTIC DNANSKL "Hysteresis Motordrehzahl f¸r Schaltbedingung Ansaugklappe" VALUE 0xFD536F KwUb 10200. nmot_ub_q40 0.00 10200. FORMAT "%5.0" /end CHARACTERISTIC
/begin CHARACTERISTIC DNFILO "obere Schwelle f¸r Gradient des Filterausgangs ndfil" VALUE 0xFC8F28 KwSw 8191.750 nmot_sw_q0p25 0.00 8191.750 FORMAT "%8.3" /end CHARACTERISTIC
/begin CHARACTERISTIC DTAANSKL "Hysteresis Ansauglufttemperatur f¸r Schaltbedingung Ansaugklappe" VALUE 0xFD5370 KwUb 191.3 temp_ub_b191p25 0.00 191.3 FORMAT "%5.1" /end CHARACTERISTIC
/begin CHARACTERISTIC DTATB "Temperaturhysterese f¸r Bauteileschutz" VALUE 0xFC687A KwWU16 1279.980 temp_uw_q0p0195 0.00 1279.980 FORMAT "%8.3" /end CHARACTERISTIC
/begin CHARACTERISTIC DTKATMN "Hysterese Katalysatortemperaturregelschwelle f¸r Kat warmhalten" VALUE 0xFD2811 KwUb 1275. temp_ub_q5_o50 -50.00 1225. FORMAT "%5.0" /end CHARACTERISTIC
/begin CHARACTERISTIC DTKH "Betrag Differenztemperatur (tans-tmst) f¸r Katheizen" VALUE 0xFD2812 KwUb 191.3 temp_ub_b191p25 0.00 191.3 FORMAT "%5.1" /end CHARACTERISTIC
/begin CHARACTERISTIC DTMABKH "Temperaturdifferenz zwischen Abstellen und Neustart f¸r Freigabe Katheizen" VALUE 0xFD2813 KwUb 191.3 temp_ub_b191p25 0.00 191.3 FORMAT "%5.1" /end CHARACTERISTIC
/begin CHARACTERISTIC DTMOTAKR "Temperaturhysterese f¸r motortemperaturabh‰ngige Abgasklappenansteuerung" VALUE 0xFD53FB KwWU8 191.3 temp_ub_b191p25 0.00 191.3 FORMAT "%5.1" /end CHARACTERISTIC
/begin CHARACTERISTIC DTUMTAT "Offset Ansauglufttemperatur -> Umgebungstemperatur" VALUE 0xFCFA4B KwUb 191.3 temp_ub_b191p25 0.00 191.3 FORMAT "%5.1" /end CHARACTERISTIC
/begin CHARACTERISTIC DVAQUGMX "Max. zul. Geschw.differenz bei Aquaplaningerkennung f¸r groﬂe Geschw." VALUE 0xFC2246 KwUw 511.9922 vfzg_uw_b512 0.00 511.9922 FORMAT "%8.4" /end CHARACTERISTIC
/begin CHARACTERISTIC DVAQUKMX "Max. zul. Geschw.differenz bei Aquaplaningerkennung f¸r kleine Geschw." VALUE 0xFC2248 KwUw 511.9922 vfzg_uw_b512 0.00 511.9922 FORMAT "%8.4" /end CHARACTERISTIC
/begin CHARACTERISTIC DVEEST "Zeit f¸r Heilungsversuch der DV-E-Endstufe" VALUE 0xFC1EB3 KwUb 2.550 t10msxs_ub_b2p55 0.00 2.550 FORMAT "%5.3" /end CHARACTERISTIC
/begin CHARACTERISTIC DVFGREO "Delta-Geschw. f¸r obere FGR-Einschaltgeschwindigkeit" VALUE 0xFC224A KwUw 511.9922 vfzg_uw_b512 0.00 511.9922 FORMAT "%8.4" /end CHARACTERISTIC
/begin CHARACTERISTIC DVFGREU "Delta-Geschw. f¸r untere FGR-Einschaltgeschwindigkeit" VALUE 0xFC224C KwUw 511.9922 vfzg_uw_b512 0.00 511.9922 FORMAT "%8.4" /end CHARACTERISTIC
/begin CHARACTERISTIC DVFZAR "Hysterese fuer Geschwindigkeitsschwelle bei AR" VALUE 0xFC8EE4 KwUb 318.8 vfzg_ub_q1p25 0.00 318.8 FORMAT "%5.1" /end CHARACTERISTIC
/begin CHARACTERISTIC DVIVZMX "Max. zul. Abweichung zw. Istgeschw. und Zielgeschw. bei FGR-Konstantfahrt" VALUE 0xFC224E KwUw 511.9922 vfzg_uw_b512 0.00 511.9922 FORMAT "%8.4" /end CHARACTERISTIC
/begin CHARACTERISTIC DVZVIMX "Max. zul. Abweichung zw. Zielgeschw. und Istgeschw. bei FGR-Konstantfahrt" VALUE 0xFC2250 KwUw 511.9922 vfzg_uw_b512 0.00 511.9922 FORMAT "%8.4" /end CHARACTERISTIC
/begin CHARACTERISTIC DWDKSBAMX "max. Soll-/Ist-DK-Winkel-Abweichung als f(dwdks)" CURVE 0xFC1ED8 KlAUwSstUwWUw 100.0000 relDK_uw_b100 0.00 100.0000 FORMAT "%8.4"
 /begin AXIS_DESCR STD_AXIS gwdk_kge relDK_q0p00152 5 0.00 99.99847 FORMAT "%8.5" DEPOSIT ABSOLUTE /end AXIS_DESCR
/end CHARACTERISTIC
/begin CHARACTERISTIC DWDKSIKLS "Schwelle zur Aktivierung des I-Kleinanteils" VALUE 0xFC1EEE KwSw 1599.976 relDK_q0p02441 -800.0000 799.9756 FORMAT "%8.4" /end CHARACTERISTIC
/begin CHARACTERISTIC DWPEDAKR "Delta f¸r Hystherese Ansteuerung Abgasklappe" VALUE 0xFD53FC KwWU8 99.61 rel_ub_b99p6 0.00 99.61 FORMAT "%5.2" /end CHARACTERISTIC
/begin CHARACTERISTIC FATMRML "Faktor fuer die Aufteilung Abgas-/Abgas-Rohrwandtemperatur" CURVE 0xFCFA4C GklWUb 0.9961 fak_ub_b1 0.00 0.9961
 /begin AXIS_DESCR COM_AXIS ml_w m_uw_b6553p5 7 0.00 6553.500 FORMAT "%8.3" AXIS_PTS_REF SML07TMUW /end AXIS_DESCR
/end CHARACTERISTIC
/begin CHARACTERISTIC FATMRML2 "Faktor fuer die Aufteilung Abgas-/Abgas-Rohrwandtemperatur Bank2" CURVE 0xFCFA53 GklWUb 0.9961 fak_ub_b1 0.00 0.9961
 /begin AXIS_DESCR COM_AXIS ml_w m_uw_b6553p5 7 0.00 6553.500 FORMAT "%8.3" AXIS_PTS_REF SML07TMUW /end AXIS_DESCR
/end CHARACTERISTIC
/begin CHARACTERISTIC FHOKH "minimaler Hˆhenfaktor f¸r Katheizen" VALUE 0xFD2834 KwUw 3.999939 fak_uw_b4 0.00 3.999939 FORMAT "%8.6" /end CHARACTERISTIC
/begin CHARACTERISTIC FKHABMN "Schwelle Abregelfaktor Katheizen" VALUE 0xFD2814 KwUb 0.9961 fak_ub_b1 0.00 0.9961 /end CHARACTERISTIC
/begin CHARACTERISTIC FKHLA "Wichtungsfaktor Lambda-Soll f¸r Katheizen" CURVE 0xFD2836 KlAUwSstUwWUw 0.9999847 fak_uw_b1 0.00 0.9999847 FORMAT "%9.7"
 /begin AXIS_DESCR STD_AXIS imlpr_w fak_uw_b1 8 0.00 0.9999847 FORMAT "%9.7" DEPOSIT ABSOLUTE /end AXIS_DESCR
/end CHARACTERISTIC
/begin CHARACTERISTIC FKHMD "Wichtungsfaktor Drehmomentreserve f¸r Katheizen" CURVE 0xFD2858 KlAUwSstUwWUw 0.9999847 fak_uw_b1 0.00 0.9999847 FORMAT "%9.7"
 /begin AXIS_DESCR STD_AXIS imlpr_w fak_uw_b1 8 0.00 0.9999847 FORMAT "%9.7" DEPOSIT ABSOLUTE /end AXIS_DESCR
/end CHARACTERISTIC
/begin CHARACTERISTIC FLRAG "Verst‰rkung Lastregler bei AT" CURVE 0xFD340C FklWUb 15.94 fak_ub_b16 0.00 15.94 FORMAT "%5.2"
 /begin AXIS_DESCR FIX_AXIS gangi dez 6 1.000 6.000 FORMAT "%5.3" FIX_AXIS_PAR 1 0 6 /end AXIS_DESCR
/end CHARACTERISTIC
/begin CHARACTERISTIC FLRAWG "Verst‰rkung Lastregler bei AT, WK geschlossen" CURVE 0xFD3412 FklWUb 15.94 fak_ub_b16 0.00 15.94 FORMAT "%5.2"
 /begin AXIS_DESCR FIX_AXIS gangi dez 6 1.000 6.000 FORMAT "%5.3" FIX_AXIS_PAR 1 0 6 /end AXIS_DESCR
/end CHARACTERISTIC
/begin CHARACTERISTIC FLRHG "Verst‰rkung Lastregler" CURVE 0xFD3418 FklWUb 15.94 fak_ub_b16 0.00 15.94 FORMAT "%5.2"
 /begin AXIS_DESCR FIX_AXIS gangi dez 6 1.000 6.000 FORMAT "%5.3" FIX_AXIS_PAR 1 0 6 /end AXIS_DESCR
/end CHARACTERISTIC
/begin CHARACTERISTIC FNSKHLL "Faktor f¸r Drehzahlanhebung direkt nach Start" CURVE 0xFD2815 KlAUbSstUbWUb 1.992 fak_ub_b2 0.00 1.992 FORMAT "%5.3" /begin AXIS_DESCR STD_AXIS imlpr fak_ub_b1 5 0.00 0.9961 DEPOSIT ABSOLUTE /end AXIS_DESCR /end CHARACTERISTIC
/begin CHARACTERISTIC FRARAG "Verst‰rkungsfaktor bei AT" CURVE 0xFD341E FklWUb 3.113 fak_ub_b3p125 0.00 3.113 FORMAT "%5.3"
 /begin AXIS_DESCR FIX_AXIS gangi dez 6 1.000 6.000 FORMAT "%5.3" FIX_AXIS_PAR 1 0 6 /end AXIS_DESCR
/end CHARACTERISTIC
/begin CHARACTERISTIC FRARAWG "Verst‰rkungsfaktor bei AT, WK geschlossen" CURVE 0xFD3424 FklWUb 3.113 fak_ub_b3p125 0.00 3.113 FORMAT "%5.3"
 /begin AXIS_DESCR FIX_AXIS gangi dez 6 1.000 6.000 FORMAT "%5.3" FIX_AXIS_PAR 1 0 6 /end AXIS_DESCR
/end CHARACTERISTIC
/begin CHARACTERISTIC FRARHG "Verst‰rkungsfaktor" CURVE 0xFD342A FklWUb 3.113 fak_ub_b3p125 0.00 3.113 FORMAT "%5.3"
 /begin AXIS_DESCR FIX_AXIS gangi dez 6 1.000 6.000 FORMAT "%5.3" FIX_AXIS_PAR 1 0 6 /end AXIS_DESCR
/end CHARACTERISTIC
/begin CHARACTERISTIC FTABGATB "" CURVE 0xFC6696 KlAxU8SstxU16WU16 1.999969 fak_uw_b2 0.00 1.999969 FORMAT "%8.6"
 /begin AXIS_DESCR STD_AXIS tabgm_w temp_uw_q0p0195_o50 4 -50.00000 1229.980 FORMAT "%8.3" DEPOSIT ABSOLUTE /end AXIS_DESCR
/end CHARACTERISTIC
/begin CHARACTERISTIC FTABGMSA "Reduktionsfaktor der Abgastemperatur im Schubbetrieb" VALUE 0xFCFA5A KwUb 0.9961 fak_ub_b1 0.00 0.9961 /end CHARACTERISTIC
/begin CHARACTERISTIC FTABGMSA2 "Reduktionsfaktor der Abgastemperatur im Schubbetrieb, Bank2" VALUE 0xFCFA5B KwUb 0.9961 fak_ub_b1 0.00 0.9961 /end CHARACTERISTIC
/begin CHARACTERISTIC FTIKATATB "" CURVE 0xFC66A8 KlAxU8SstxU16WU16 1.999969 fak_uw_b2 0.00 1.999969 FORMAT "%8.6"
 /begin AXIS_DESCR STD_AXIS tikatm_w temp_uw_q0p0195_o50 4 -50.00000 1229.980 FORMAT "%8.3" DEPOSIT ABSOLUTE /end AXIS_DESCR
/end CHARACTERISTIC
/begin CHARACTERISTIC FTKATATB "Faktor Bauteileschutz abh‰ngig von model. Kattemperatur" CURVE 0xFC66BA KlAxU8SstxU16WU16 1.999969 fak_uw_b2 0.00 1.999969 FORMAT "%8.6"
 /begin AXIS_DESCR STD_AXIS tkatm_w temp_uw_q0p0195_o50 4 -50.00000 1229.980 FORMAT "%8.3" DEPOSIT ABSOLUTE /end AXIS_DESCR
/end CHARACTERISTIC
/begin CHARACTERISTIC FTMLAKH "tmot-Korrektur der Lambda-Bewertung bei Katheizen" CURVE 0xFD2820 KlAUbSstUbWUb 0.9961 fak_ub_b1 0.00 0.9961
 /begin AXIS_DESCR STD_AXIS tmot temp_ub_q0p75_o48 4 -48.00 143.3 FORMAT "%5.1" DEPOSIT ABSOLUTE /end AXIS_DESCR
/end CHARACTERISTIC
/begin CHARACTERISTIC FWMABGW "Faktor f¸r W‰rmemengen bei Wiederholstart f¸r Taupunktende Abgas vor Vorkat" VALUE 0xFCFA5C KwUb 0.9961 fak_ub_b1 0.00 0.9961 /end CHARACTERISTIC
/begin CHARACTERISTIC FWMABGW2 "Faktor f¸r W‰rmemengen bei Wiederholstart Abgas Bank2" VALUE 0xFCFA5D KwUb 0.9961 fak_ub_b1 0.00 0.9961 /end CHARACTERISTIC
/begin CHARACTERISTIC FWMKATW "Faktor f¸r W‰rmemengen bei Wiederholstart f¸r Taupunktende hinter Hauptkat" VALUE 0xFCFA5E KwUb 0.9961 fak_ub_b1 0.00 0.9961 /end CHARACTERISTIC
/begin CHARACTERISTIC FWMKATW2 "Faktor f¸r W‰rmemengen bei Wiederholstart f¸r Taupunktende hinter Hauptkat Bank2" VALUE 0xFCFA5F KwUb 0.9961 fak_ub_b1 0.00 0.9961 /end CHARACTERISTIC
/begin CHARACTERISTIC GAFGRO "Max. zul. Gang bei FGR-Betrieb" VALUE 0xFC223E KwUb 255.0 dez 0.00 255.0 FORMAT "%5.1" /end CHARACTERISTIC
/begin CHARACTERISTIC GAFGRU "Min. zul. Gang bei FGR-Betrieb" VALUE 0xFC223F KwUb 255.0 dez 0.00 255.0 FORMAT "%5.1" /end CHARACTERISTIC
/begin CHARACTERISTIC GAP_TOOTH "Differenz L¸cke SW-Benchmark in Z‰hnen" VALUE 0xFC1D92 KwWU8 120.0 dez 0.00 120.0 FORMAT "%5.1" /end CHARACTERISTIC
/begin CHARACTERISTIC IHASTD "Standard HA-‹bersetzung" VALUE 0xFC207F KwUb 4.980 fak_q0p0195 0.00 4.980 FORMAT "%5.3" /end CHARACTERISTIC
/begin CHARACTERISTIC IKURUN "Schwelle Erkennung Kupplung rutscht negativ" CURVE 0xFC20AA GklWSw 511.9922 qnv_sw_q0p0078 -256.0000 255.9922 FORMAT "%8.4"
 /begin AXIS_DESCR COM_AXIS gangi dez 7 0.00 255.0 FORMAT "%5.1" AXIS_PTS_REF SGA07MDUB /end AXIS_DESCR
/end CHARACTERISTIC
/begin CHARACTERISTIC IKURUP "Schwelle Erkennung Kupplung rutscht positiv" CURVE 0xFC20B8 GklWSw 511.9922 qnv_sw_q0p0078 -256.0000 255.9922 FORMAT "%8.4"
 /begin AXIS_DESCR COM_AXIS gangi dez 7 0.00 255.0 FORMAT "%5.1" AXIS_PTS_REF SGA07MDUB /end AXIS_DESCR
/end CHARACTERISTIC
/begin CHARACTERISTIC IMLATWS "Luftmassen-Schwelle f¸r Kat-Heizen nach Wiederholstart" VALUE 0xFD287A KwUw 23.30133 m_uw_b23p3 0.00 23.30133 FORMAT "%8.5" /end CHARACTERISTIC
/begin CHARACTERISTIC IMLKHMX "max. Verh‰ltnisfaktor psum_w/mlsu f¸r Einschaltung Katheizen" VALUE 0xFD2829 KwUb 0.9961 fak_ub_b1 0.00 0.9961 /end CHARACTERISTIC
/begin CHARACTERISTIC IMLKHTMS "imlpr-Schwelle f¸r ‹bergang auf Lambda-Katheizen" CURVE 0xFC827E KlAUbSstUbWUb 0.9961 fak_ub_b1 0.00 0.9961
 /begin AXIS_DESCR STD_AXIS tmst temp_ub_q0p75_o48 8 -48.00 143.3 FORMAT "%5.1" DEPOSIT ABSOLUTE /end AXIS_DESCR
/end CHARACTERISTIC
/begin CHARACTERISTIC IMLKS "Schwelle f¸r integrierten Luftmassenstrom f¸r Erkennung Benzin im ÷l" VALUE 0xFD226A KwUb 23.21 m_ub_b23p3 0.00 23.21 FORMAT "%5.2" /end CHARACTERISTIC
/begin CHARACTERISTIC IMTUMTAT "Schwelle integrierte Luftmasse f¸r Bestimmung Umgebungstemperatur aus TANS" VALUE 0xFCFA60 KwUb 23.21 m_ub_b23p3 0.00 23.21 FORMAT "%5.2" /end CHARACTERISTIC
/begin CHARACTERISTIC KATMEXML "Exotherme Temperatur im KAT tkatm" CURVE 0xFCFA61 GklWSb 1275. temp_q5 -640.0 635.0 FORMAT "%5.1"
 /begin AXIS_DESCR COM_AXIS ml_w m_uw_b6553p5 7 0.00 6553.500 FORMAT "%8.3" AXIS_PTS_REF SML07TMUW /end AXIS_DESCR
/end CHARACTERISTIC
/begin CHARACTERISTIC KATMEXML2 "Exotherme Temperatur im Kat, Bank 2" CURVE 0xFCFA68 GklWSb 1275. temp_q5 -640.0 635.0 FORMAT "%5.1"
 /begin AXIS_DESCR COM_AXIS ml_w m_uw_b6553p5 7 0.00 6553.500 FORMAT "%8.3" AXIS_PTS_REF SML07TMUW /end AXIS_DESCR
/end CHARACTERISTIC
/begin CHARACTERISTIC KATMIEXML "Exotherme Temperatur im KAT tikatm" CURVE 0xFCFA6F GklWSb 1275. temp_q5 -640.0 635.0 FORMAT "%5.1"
 /begin AXIS_DESCR COM_AXIS ml_w m_uw_b6553p5 7 0.00 6553.500 FORMAT "%8.3" AXIS_PTS_REF SML07TMUW /end AXIS_DESCR
/end CHARACTERISTIC
/begin CHARACTERISTIC KATMIEXML2 "Exotherme Temperatur im KAT tikatm, Bank 2" CURVE 0xFCFA76 GklWSb 1275. temp_q5 -640.0 635.0 FORMAT "%5.1"
 /begin AXIS_DESCR COM_AXIS ml_w m_uw_b6553p5 7 0.00 6553.500 FORMAT "%8.3" AXIS_PTS_REF SML07TMUW /end AXIS_DESCR
/end CHARACTERISTIC
/begin CHARACTERISTIC KDLRIDDVE "Identifizierung des DLR-Parametersatzes zu DV-E-Typ" VALUE 0xFCFA3C KwUb 255.0 dez 0.00 255.0 FORMAT "%5.1" /end CHARACTERISTIC
/begin CHARACTERISTIC KFAKR_GANG "Kennfeld f¸r Abgasklappenansteuerung in Abh. von gangi und nmot" MAP 0xFD538E KfAxU8AyU8SstxU8SstyU8WU8 99.61 rel_ub_b99p6 0.00 99.61 FORMAT "%5.2"
 /begin AXIS_DESCR STD_AXIS gangi dez 7 0.00 255.0 FORMAT "%5.1" DEPOSIT ABSOLUTE /end AXIS_DESCR
 /begin AXIS_DESCR STD_AXIS nmot nmot_ub_q40 12 0.00 10200. FORMAT "%5.0" DEPOSIT ABSOLUTE /end AXIS_DESCR
/end CHARACTERISTIC
/begin CHARACTERISTIC KFATMABKA "Faktor f¸r Abgastemperaturabnahme = f(Abstellzeit,Umgebungstemperatur)" MAP 0xFCFA7D GkfWUb 0.9961 fak_ub_b1 0.00 0.9961
 /begin AXIS_DESCR COM_AXIS tabstatm_w t1sxs_uw_q1 6 0.00 65535.00 FORMAT "%8.2" AXIS_PTS_REF STS06TMUW /end AXIS_DESCR
 /begin AXIS_DESCR COM_AXIS tatu temp_ub_q0p75_o48 5 -48.00 143.3 FORMAT "%5.1" AXIS_PTS_REF STU05TMUB /end AXIS_DESCR
/end CHARACTERISTIC
/begin CHARACTERISTIC KFATMABKA2 "Faktor f¸r Abgastemperaturabnahme = f(Abstellzeit,Umgebungstemperatur), Bank2" MAP 0xFCFA9B GkfWUb 0.9961 fak_ub_b1 0.00 0.9961
 /begin AXIS_DESCR COM_AXIS tabstatm_w t1sxs_uw_q1 6 0.00 65535.00 FORMAT "%8.2" AXIS_PTS_REF STS06TMUW /end AXIS_DESCR
 /begin AXIS_DESCR COM_AXIS tatu temp_ub_q0p75_o48 5 -48.00 143.3 FORMAT "%5.1" AXIS_PTS_REF STU05TMUB /end AXIS_DESCR
/end CHARACTERISTIC
/begin CHARACTERISTIC KFATMABKK "Faktor f¸r Abnahme der Katalysatortemperatur = f(Abstellzeit,Umg.temp.)" MAP 0xFCFAB9 GkfWUb 0.9961 fak_ub_b1 0.00 0.9961
 /begin AXIS_DESCR COM_AXIS tabstatm_w t1sxs_uw_q1 6 0.00 65535.00 FORMAT "%8.2" AXIS_PTS_REF STS06TMUW /end AXIS_DESCR
 /begin AXIS_DESCR COM_AXIS tatu temp_ub_q0p75_o48 5 -48.00 143.3 FORMAT "%5.1" AXIS_PTS_REF STU05TMUB /end AXIS_DESCR
/end CHARACTERISTIC
/begin CHARACTERISTIC KFATMABKK2 "Faktor f¸r Abnahme der Katalysatortemperatur = f(Abstellzeit,Umg.temp.), Bank2" MAP 0xFCFAD7 GkfWUb 0.9961 fak_ub_b1 0.00 0.9961
 /begin AXIS_DESCR COM_AXIS tabstatm_w t1sxs_uw_q1 6 0.00 65535.00 FORMAT "%8.2" AXIS_PTS_REF STS06TMUW /end AXIS_DESCR
 /begin AXIS_DESCR COM_AXIS tatu temp_ub_q0p75_o48 5 -48.00 143.3 FORMAT "%5.1" AXIS_PTS_REF STU05TMUB /end AXIS_DESCR
/end CHARACTERISTIC
/begin CHARACTERISTIC KFATMLA "Kennfeld Abgastemperatur-Korrektur = f(Lambda)" MAP 0xFCFAF5 GkfWSb 1275. temp_q5 -640.0 635.0 FORMAT "%5.1"
 /begin AXIS_DESCR COM_AXIS ml_w m_uw_b6553p5 6 0.00 6553.500 FORMAT "%8.3" AXIS_PTS_REF SML06TMUW /end AXIS_DESCR
 /begin AXIS_DESCR COM_AXIS lamsbg_w fak_uw_b16 6 0.00 15.99976 FORMAT "%8.5" AXIS_PTS_REF SLX06TMUW /end AXIS_DESCR
/end CHARACTERISTIC
/begin CHARACTERISTIC KFATMLA2 "Kennfeld Abgastemperatur-Korrektur = f(lambda) Bank2" MAP 0xFCFB19 GkfWSb 1275. temp_q5 -640.0 635.0 FORMAT "%5.1"
 /begin AXIS_DESCR COM_AXIS ml_w m_uw_b6553p5 6 0.00 6553.500 FORMAT "%8.3" AXIS_PTS_REF SML06TMUW /end AXIS_DESCR
 /begin AXIS_DESCR COM_AXIS lamsbg2_w fak_uw_b16 6 0.00 15.99976 FORMAT "%8.5" AXIS_PTS_REF SLY06TMUW /end AXIS_DESCR
/end CHARACTERISTIC
/begin CHARACTERISTIC KFATMZW "Kennfeld Abgastemperatur-Korrektur = f(Z¸ndwinkelverstellung)" MAP 0xFCFB3D GkfWSb 1275. temp_q5 -640.0 635.0 FORMAT "%5.1"
 /begin AXIS_DESCR COM_AXIS ml_w m_uw_b6553p5 6 0.00 6553.500 FORMAT "%8.3" AXIS_PTS_REF SML06TMUW /end AXIS_DESCR
 /begin AXIS_DESCR COM_AXIS etazwimt rel_ub_b127p5 6 0.00 127.5 FORMAT "%5.1" AXIS_PTS_REF SEZ06TMUB /end AXIS_DESCR
/end CHARACTERISTIC
/begin CHARACTERISTIC KFATMZW2 "Kennfeld Abgastemperatur-Korrektur = f(Z¸ndwinkel) Bank2" MAP 0xFCFB61 GkfWSb 1275. temp_q5 -640.0 635.0 FORMAT "%5.1"
 /begin AXIS_DESCR COM_AXIS ml_w m_uw_b6553p5 6 0.00 6553.500 FORMAT "%8.3" AXIS_PTS_REF SML06TMUW /end AXIS_DESCR
 /begin AXIS_DESCR COM_AXIS etazwimt rel_ub_b127p5 6 0.00 127.5 FORMAT "%5.1" AXIS_PTS_REF SEZ06TMUB /end AXIS_DESCR
/end CHARACTERISTIC
/begin CHARACTERISTIC KFDMDARO "Obere Schwelle f¸r Momenteneingriff" MAP 0xFD3430 GkfWSw 199.9969 rel_sw_b100 -100.0000 99.99695 FORMAT "%8.4"
 /begin AXIS_DESCR COM_AXIS gangi dez 8 0.00 255.0 FORMAT "%5.1" AXIS_PTS_REF SGA08MDUB /end AXIS_DESCR
 /begin AXIS_DESCR COM_AXIS mkar_w rel_sw_b100 8 -100.0000 99.99695 FORMAT "%8.4" AXIS_PTS_REF SMK08MDSW /end AXIS_DESCR
/end CHARACTERISTIC
/begin CHARACTERISTIC KFDMDARU "Untere Schwelle f¸r Momenteneingriff" MAP 0xFD34B0 GkfWSw 199.9969 rel_sw_b100 -100.0000 99.99695 FORMAT "%8.4"
 /begin AXIS_DESCR COM_AXIS gangi dez 8 0.00 255.0 FORMAT "%5.1" AXIS_PTS_REF SGA08MDUB /end AXIS_DESCR
 /begin AXIS_DESCR COM_AXIS mkar_w rel_sw_b100 8 -100.0000 99.99695 FORMAT "%8.4" AXIS_PTS_REF SMK08MDSW /end AXIS_DESCR
/end CHARACTERISTIC
/begin CHARACTERISTIC KFLATBNOTL "" MAP 0xFC5FCA KfAxU8AyU8SstxU16SstyU16WU16 1.999969 fak_uw_b2 0.00 1.999969 FORMAT "%8.6"
 /begin AXIS_DESCR STD_AXIS nmot_tmp nmot_uw_q0p25 16 0.00 16383.75 FORMAT "%8.2" DEPOSIT ABSOLUTE /end AXIS_DESCR
 /begin AXIS_DESCR STD_AXIS rl_tmp rel_uw_q0p0234 16 0.00 1535.977 FORMAT "%8.3" DEPOSIT ABSOLUTE /end AXIS_DESCR
/end CHARACTERISTIC
/begin CHARACTERISTIC KFLATBTL1 "" MAP 0xFC620E KfAxU8AyU8SstxU16SstyU16WU16 1.999969 fak_uw_b2 0.00 1.999969 FORMAT "%8.6"
 /begin AXIS_DESCR STD_AXIS nmot_tmp nmot_uw_q0p25 16 0.00 16383.75 FORMAT "%8.2" DEPOSIT ABSOLUTE /end AXIS_DESCR
 /begin AXIS_DESCR STD_AXIS rl_tmp rel_uw_q0p0234 16 0.00 1535.977 FORMAT "%8.3" DEPOSIT ABSOLUTE /end AXIS_DESCR
/end CHARACTERISTIC
/begin CHARACTERISTIC KFLATBTL2 "" MAP 0xFC6452 KfAxU8AyU8SstxU16SstyU16WU16 1.999969 fak_uw_b2 0.00 1.999969 FORMAT "%8.6"
 /begin AXIS_DESCR STD_AXIS nmot_tmp nmot_uw_q0p25 16 0.00 16383.75 FORMAT "%8.2" DEPOSIT ABSOLUTE /end AXIS_DESCR
 /begin AXIS_DESCR STD_AXIS rl_tmp rel_uw_q0p0234 16 0.00 1535.977 FORMAT "%8.3" DEPOSIT ABSOLUTE /end AXIS_DESCR
/end CHARACTERISTIC
/begin CHARACTERISTIC KFMLSUS "Sollwert Luftmassen-Integral f¸r motorisches Katheizen" MAP 0xFC81A0 KfAxU8AyU8SstxU8SstyU16WU16 1491.285 m_ub_b5p8 0.00 1491.285 FORMAT "%8.3"
 /begin AXIS_DESCR STD_AXIS tmst temp_ub_q0p75_o48 12 -48.00 143.3 FORMAT "%5.1" DEPOSIT ABSOLUTE /end AXIS_DESCR
 /begin AXIS_DESCR STD_AXIS fcoschmn_w fak_uw_b2 8 0.00 1.999969 FORMAT "%8.6" DEPOSIT ABSOLUTE /end AXIS_DESCR
/end CHARACTERISTIC
/begin CHARACTERISTIC KFNFSKHM "Leerlaufsolldrehzahl bei Katheizen mit eingelegter Fahrstufe" MAP 0xFC8160 GkfWU8 2550. nmot_ub_q10 0.00 2550. FORMAT "%5.0"
 /begin AXIS_DESCR COM_AXIS tmot temp_ub_q0p75_o48 8 -48.00 143.3 FORMAT "%5.1" AXIS_PTS_REF STM08BBUB /end AXIS_DESCR
 /begin AXIS_DESCR COM_AXIS frhol_w fak_uw_b2 4 0.00 1.999969 FORMAT "%8.6" AXIS_PTS_REF SFR04BBUW /end AXIS_DESCR
/end CHARACTERISTIC
/begin CHARACTERISTIC KFNLLKHM "Leerlaufsolldrehzahl bei Kat.-Heizung" MAP 0xFC8180 GkfWU8 2550. nmot_ub_q10 0.00 2550. FORMAT "%5.0"
 /begin AXIS_DESCR COM_AXIS tmot temp_ub_q0p75_o48 8 -48.00 143.3 FORMAT "%5.1" AXIS_PTS_REF STM08BBUB /end AXIS_DESCR
 /begin AXIS_DESCR COM_AXIS frhol_w fak_uw_b2 4 0.00 1.999969 FORMAT "%8.6" AXIS_PTS_REF SFR04BBUW /end AXIS_DESCR
/end CHARACTERISTIC
/begin CHARACTERISTIC KFTATM "Kennfeld Abgastemperatur   f(nmot,rl)" MAP 0xFCFB85 KfAxUbAyUbSstxUbSstyUbWUb 1275. temp_ub_q5_o50 -50.00 1225. FORMAT "%5.0"
 /begin AXIS_DESCR STD_AXIS nmot nmot_ub_q40 8 0.00 10200. FORMAT "%5.0" DEPOSIT ABSOLUTE /end AXIS_DESCR
 /begin AXIS_DESCR STD_AXIS rl rel_ub_q0p75 8 0.00 191.3 FORMAT "%5.1" DEPOSIT ABSOLUTE /end AXIS_DESCR
/end CHARACTERISTIC
/begin CHARACTERISTIC KFTATM2 "Kennfeld Abgastemperatur f(nmot,rl) Bank2" MAP 0xFCFBD7 KfAxUbAyUbSstxUbSstyUbWUb 1275. temp_ub_q5_o50 -50.00 1225. FORMAT "%5.0"
 /begin AXIS_DESCR STD_AXIS nmot nmot_ub_q40 8 0.00 10200. FORMAT "%5.0" DEPOSIT ABSOLUTE /end AXIS_DESCR
 /begin AXIS_DESCR STD_AXIS rl rel_ub_q0p75 8 0.00 191.3 FORMAT "%5.1" DEPOSIT ABSOLUTE /end AXIS_DESCR
/end CHARACTERISTIC
/begin CHARACTERISTIC KFTEVP "Kennfeld Periodendauer TEV" MAP 0xFD46AA KfAxUbAyUbSstxUbSstyUbWUb 127.5 t500usxms_ub_q0p5 0.00 127.5 FORMAT "%5.1"
 /begin AXIS_DESCR STD_AXIS nmot nmot_ub_q40 5 0.00 10200. FORMAT "%5.0" DEPOSIT ABSOLUTE /end AXIS_DESCR
 /begin AXIS_DESCR STD_AXIS tateroh rel_ub_b99p6 9 0.00 99.61 FORMAT "%5.2" DEPOSIT ABSOLUTE /end AXIS_DESCR
/end CHARACTERISTIC
/begin CHARACTERISTIC KFTVTEV "Kennfeld Verzugszeit Tankentl¸ftungsventil" MAP 0xFD46E8 KfAxUwAyUwSstxUwSstyUwWUw 127.5000 t500usxms_ub_q0p5 0.00 127.5000 FORMAT "%8.4"
 /begin AXIS_DESCR STD_AXIS ub_w spg_ubatt 6 0.00 6173.397 FORMAT "%8.3" DEPOSIT ABSOLUTE /end AXIS_DESCR
 /begin AXIS_DESCR STD_AXIS dps_uw p_q0p039s32768 6 -1280.00 1279.96 FORMAT "%7.2" DEPOSIT ABSOLUTE /end AXIS_DESCR
/end CHARACTERISTIC
/begin CHARACTERISTIC KFWMABG "Kennfeld f¸r W‰rmemengen-Schwellwert Taupunktende Abgas" MAP 0xFCFC80 GkfWUw 29825.71 q_q0p4551 0.00 29825.71 FORMAT "%8.2"
 /begin AXIS_DESCR COM_AXIS tabgmst temp_ub_q5_o50 7 -50.00 1225. FORMAT "%5.0" AXIS_PTS_REF ST107TMUB /end AXIS_DESCR
 /begin AXIS_DESCR COM_AXIS tmst temp_ub_q0p75_o48 5 -48.00 143.3 FORMAT "%5.1" AXIS_PTS_REF STM05TMUB /end AXIS_DESCR
/end CHARACTERISTIC
/begin CHARACTERISTIC KFWMABG2 "Kennfeld f¸r W‰rmemengen-Schwellwert Taupunktende Abgas Bank2" MAP 0xFCFCC6 GkfWUw 29825.71 q_q0p4551 0.00 29825.71 FORMAT "%8.2"
 /begin AXIS_DESCR COM_AXIS tabgmst2 temp_ub_q5_o50 7 -50.00 1225. FORMAT "%5.0" AXIS_PTS_REF ST207TMUB /end AXIS_DESCR
 /begin AXIS_DESCR COM_AXIS tmst temp_ub_q0p75_o48 5 -48.00 143.3 FORMAT "%5.1" AXIS_PTS_REF STM05TMUB /end AXIS_DESCR
/end CHARACTERISTIC
/begin CHARACTERISTIC KFWMKAT "Kennfeld f¸r W‰rmemengen-Schwellwert Taupunktende hinter Kat" MAP 0xFCFD0C GkfWUw 29825.71 q_q0p4551 0.00 29825.71 FORMAT "%8.2"
 /begin AXIS_DESCR COM_AXIS tkatmst temp_ub_q5_o50 7 -50.00 1225. FORMAT "%5.0" AXIS_PTS_REF ST307TMUB /end AXIS_DESCR
 /begin AXIS_DESCR COM_AXIS tmst temp_ub_q0p75_o48 5 -48.00 143.3 FORMAT "%5.1" AXIS_PTS_REF STM05TMUB /end AXIS_DESCR
/end CHARACTERISTIC
/begin CHARACTERISTIC KFWMKAT2 "Kennfeld f¸r W‰rmemengen-Schwellwert Taupunktende hinter Kat Bank2" MAP 0xFCFD52 GkfWUw 29825.71 q_q0p4551 0.00 29825.71 FORMAT "%8.2"
 /begin AXIS_DESCR COM_AXIS tkatmst2 temp_ub_q5_o50 7 -50.00 1225. FORMAT "%5.0" AXIS_PTS_REF ST407TMUB /end AXIS_DESCR
 /begin AXIS_DESCR COM_AXIS tmst temp_ub_q0p75_o48 5 -48.00 143.3 FORMAT "%5.1" AXIS_PTS_REF STM05TMUB /end AXIS_DESCR
/end CHARACTERISTIC
/begin CHARACTERISTIC KFZWATBNOT "" MAP 0xFD1442 KfAxUwAyUwSstxUwSstyUwWSw 191.2500 zw_sb_q0p75 -96.00000 95.25000 FORMAT "%8.5"
 /begin AXIS_DESCR STD_AXIS nmot_tmp nmot_uw_q0p25 16 0.00 16383.75 FORMAT "%8.2" DEPOSIT ABSOLUTE /end AXIS_DESCR
 /begin AXIS_DESCR STD_AXIS rl_tmp rel_uw_q0p0234 12 0.00 1535.977 FORMAT "%8.3" DEPOSIT ABSOLUTE /end AXIS_DESCR
/end CHARACTERISTIC
/begin CHARACTERISTIC KFZWATBTL1 "" MAP 0xFD15FE KfAxUwAyUwSstxUwSstyUwWSw 191.2500 zw_sb_q0p75 -96.00000 95.25000 FORMAT "%8.5"
 /begin AXIS_DESCR STD_AXIS nmot_tmp nmot_uw_q0p25 16 0.00 16383.75 FORMAT "%8.2" DEPOSIT ABSOLUTE /end AXIS_DESCR
 /begin AXIS_DESCR STD_AXIS rl_tmp rel_uw_q0p0234 12 0.00 1535.977 FORMAT "%8.3" DEPOSIT ABSOLUTE /end AXIS_DESCR
/end CHARACTERISTIC
/begin CHARACTERISTIC KFZWATBTL2 "" MAP 0xFD17BA KfAxUwAyUwSstxUwSstyUwWSw 191.2500 zw_sb_q0p75 -96.00000 95.25000 FORMAT "%8.5"
 /begin AXIS_DESCR STD_AXIS nmot_tmp nmot_uw_q0p25 16 0.00 16383.75 FORMAT "%8.2" DEPOSIT ABSOLUTE /end AXIS_DESCR
 /begin AXIS_DESCR STD_AXIS rl_tmp rel_uw_q0p0234 12 0.00 1535.977 FORMAT "%8.3" DEPOSIT ABSOLUTE /end AXIS_DESCR
/end CHARACTERISTIC
/begin CHARACTERISTIC KFZWDLATB "Faktor Delta Lambda aus Abstand zum Grenzz¸ndwinkel" MAP 0xFD1976 KfAxUwAyUwSstxSwSstyUwWUw 1.999969 fak_uw_b2 0.00 1.999969 FORMAT "%8.6"
 /begin AXIS_DESCR STD_AXIS zwoutm_tmp zw_sb_q0p75 8 -96.00000 95.25000 FORMAT "%8.5" DEPOSIT ABSOLUTE /end AXIS_DESCR
 /begin AXIS_DESCR STD_AXIS nmot_tmp nmot_uw_q0p25 8 0.00 16383.75 FORMAT "%8.2" DEPOSIT ABSOLUTE /end AXIS_DESCR
/end CHARACTERISTIC
/begin CHARACTERISTIC KIFZGAG "Integratorverst‰rkung des Fahrzeugmodells bei AT" CURVE 0xFD3530 FklWUw 4863.926 fak_uw_b4864 0.00 4863.926 FORMAT "%8.3"
 /begin AXIS_DESCR FIX_AXIS gangi dez 6 1.000 6.000 FORMAT "%5.3" FIX_AXIS_PAR 1 0 6 /end AXIS_DESCR
/end CHARACTERISTIC
/begin CHARACTERISTIC KIFZGAWG "Integratorverst‰rkung des Fahrzeugmodells bei AT, geschlossene WK" CURVE 0xFD353C FklWUw 4863.926 fak_uw_b4864 0.00 4863.926 FORMAT "%8.3"
 /begin AXIS_DESCR FIX_AXIS gangi dez 6 1.000 6.000 FORMAT "%5.3" FIX_AXIS_PAR 1 0 6 /end AXIS_DESCR
/end CHARACTERISTIC
/begin CHARACTERISTIC KIFZGHG "Integratorverst‰rkung des Fahrzeugmodells bei Handschalter" CURVE 0xFD3548 FklWUw 4863.926 fak_uw_b4864 0.00 4863.926 FORMAT "%8.3"
 /begin AXIS_DESCR FIX_AXIS gangi dez 6 1.000 6.000 FORMAT "%5.3" FIX_AXIS_PAR 1 0 6 /end AXIS_DESCR
/end CHARACTERISTIC
/begin CHARACTERISTIC KLALETM "Kennlinie f¸r R¸ckdreh Zahnzeiten" CURVE 0xFC1D7E KlAxU8SstxU8WU8 255.000 t1ms_ub_b255 0.00 255.000
 /begin AXIS_DESCR STD_AXIS tmot temp_ub_q0p75_o48 3 -48.00 143.3 FORMAT "%5.1" DEPOSIT ABSOLUTE /end AXIS_DESCR
/end CHARACTERISTIC
/begin CHARACTERISTIC KLATMILAE "Exotherme Temperaturabnahme bei Anfettung tikatm" CURVE 0xFCFC29 GklWUb 1.992 fak_ub_b2 0.00 1.992 FORMAT "%5.3"
 /begin AXIS_DESCR COM_AXIS lamsbg_w fak_uw_b16 6 0.00 15.99976 FORMAT "%8.5" AXIS_PTS_REF SLX06TMUW /end AXIS_DESCR
/end CHARACTERISTIC
/begin CHARACTERISTIC KLATMILAE2 "Exotherme Temperaturabnahme bei Anfettung tikatm, Bank 2" CURVE 0xFCFC2F GklWUb 1.992 fak_ub_b2 0.00 1.992 FORMAT "%5.3"
 /begin AXIS_DESCR COM_AXIS lamsbg2_w fak_uw_b16 6 0.00 15.99976 FORMAT "%8.5" AXIS_PTS_REF SLY06TMUW /end AXIS_DESCR
/end CHARACTERISTIC
/begin CHARACTERISTIC KLATMIZWE "Exotherme Temperaturabnahme im Kat bei sp‰terem Z¸ndwinkel tikatm" CURVE 0xFCFC35 GklWUb 1.992 fak_ub_b2 0.00 1.992 FORMAT "%5.3"
 /begin AXIS_DESCR COM_AXIS etazwimt rel_ub_b127p5 6 0.00 127.5 FORMAT "%5.1" AXIS_PTS_REF SEZ06TMUB /end AXIS_DESCR
/end CHARACTERISTIC
/begin CHARACTERISTIC KLATMIZWE2 "Exotherme Temperaturabnahme im Kat bei sp‰terem Z¸ndwinkel tikatm, Bank2" CURVE 0xFCFC3B GklWUb 1.992 fak_ub_b2 0.00 1.992 FORMAT "%5.3"
 /begin AXIS_DESCR COM_AXIS etazwimt rel_ub_b127p5 6 0.00 127.5 FORMAT "%5.1" AXIS_PTS_REF SEZ06TMUB /end AXIS_DESCR
/end CHARACTERISTIC
/begin CHARACTERISTIC KLATMLAE "Exotherme Temperaturabnahme bei Anfettung" CURVE 0xFCFC41 GklWUb 1.992 fak_ub_b2 0.00 1.992 FORMAT "%5.3"
 /begin AXIS_DESCR COM_AXIS lamsbg_w fak_uw_b16 6 0.00 15.99976 FORMAT "%8.5" AXIS_PTS_REF SLX06TMUW /end AXIS_DESCR
/end CHARACTERISTIC
/begin CHARACTERISTIC KLATMLAE2 "Exotherme Temperaturabnahme bei Anfettung, Bank 2" CURVE 0xFCFC47 GklWUb 1.992 fak_ub_b2 0.00 1.992 FORMAT "%5.3"
 /begin AXIS_DESCR COM_AXIS lamsbg2_w fak_uw_b16 6 0.00 15.99976 FORMAT "%8.5" AXIS_PTS_REF SLY06TMUW /end AXIS_DESCR
/end CHARACTERISTIC
/begin CHARACTERISTIC KLATMZWE "Exotherme Temperaturabnahme im Kat bei sp‰terem Z¸ndwinkel tkatm" CURVE 0xFCFC4D GklWUb 1.992 fak_ub_b2 0.00 1.992 FORMAT "%5.3"
 /begin AXIS_DESCR COM_AXIS etazwimt rel_ub_b127p5 6 0.00 127.5 FORMAT "%5.1" AXIS_PTS_REF SEZ06TMUB /end AXIS_DESCR
/end CHARACTERISTIC
/begin CHARACTERISTIC KLATMZWE2 "Exotherme Temperaturabnahme im Kat bei sp‰terem Z¸ndwinkel, Bank 2" CURVE 0xFCFC53 GklWUb 1.992 fak_ub_b2 0.00 1.992 FORMAT "%5.3"
 /begin AXIS_DESCR COM_AXIS etazwimt rel_ub_b127p5 6 0.00 127.5 FORMAT "%5.1" AXIS_PTS_REF SEZ06TMUB /end AXIS_DESCR
/end CHARACTERISTIC
/begin CHARACTERISTIC KLGANGSL "Kennlinie f¸r gangabh‰ngigen rel. Schlupf" CURVE 0xFC8F2A FklWUw 99.99847 rel_uw_b100 0.00 99.99847 FORMAT "%8.5"
 /begin AXIS_DESCR FIX_AXIS gangi dez 6 1.000 6.000 FORMAT "%5.3" FIX_AXIS_PAR 1 0 6 /end AXIS_DESCR
/end CHARACTERISTIC
/begin CHARACTERISTIC KLLATBNOV "" CURVE 0xFC66CC KlAxU8SstxU16WU16 1.999969 fak_uw_b2 0.00 1.999969 FORMAT "%8.6"
 /begin AXIS_DESCR STD_AXIS nmot_tmp nmot_uw_q0p25 16 0.00 16383.75 FORMAT "%8.2" DEPOSIT ABSOLUTE /end AXIS_DESCR
/end CHARACTERISTIC
/begin CHARACTERISTIC KLLATBVL "Lambda Bauteileschutz f¸r Vollast" CURVE 0xFC670E KlAxU8SstxU16WU16 1.999969 fak_uw_b2 0.00 1.999969 FORMAT "%8.6"
 /begin AXIS_DESCR STD_AXIS nmot_tmp nmot_uw_q0p25 16 0.00 16383.75 FORMAT "%8.2" DEPOSIT ABSOLUTE /end AXIS_DESCR
/end CHARACTERISTIC
/begin CHARACTERISTIC KLLATBVLT "" CURVE 0xFC6750 KlAxU8SstxU16WU16 1.999969 fak_uw_b2 0.00 1.999969 FORMAT "%8.6"
 /begin AXIS_DESCR STD_AXIS nmot_tmp nmot_uw_q0p25 16 0.00 16383.75 FORMAT "%8.2" DEPOSIT ABSOLUTE /end AXIS_DESCR
/end CHARACTERISTIC
/begin CHARACTERISTIC KLTVARSL "Kennlinie f¸r gangabh‰ngige Verzugszeit bei Schlupf" CURVE 0xFC8EE5 FklWUb 2.550 t10msxs_ub_b2p55 0.00 2.550 FORMAT "%5.3"
 /begin AXIS_DESCR FIX_AXIS gangi dez 6 1.000 6.000 FORMAT "%5.3" FIX_AXIS_PAR 1 0 6 /end AXIS_DESCR
/end CHARACTERISTIC
/begin CHARACTERISTIC KLZKDLATB "Zeitkonstante f¸r Filter Delta Lambda" CURVE 0xFC6792 KlAxU8SstxU16WU16 6553.4999985 zk100msxs_uw_b6553 0.10000152590 6553.6000000 FORMAT "%12.7"
 /begin AXIS_DESCR STD_AXIS nmot_tmp nmot_uw_q0p25 8 0.00 16383.75 FORMAT "%8.2" DEPOSIT ABSOLUTE /end AXIS_DESCR
/end CHARACTERISTIC
/begin CHARACTERISTIC KLZWATBNOV "" CURVE 0xFC67B4 KlAxU8SstxU16WS16 191.2500 zw_sb_q0p75 -96.00000 95.25000 FORMAT "%8.5"
 /begin AXIS_DESCR STD_AXIS nmot_tmp nmot_uw_q0p25 16 0.2500000 16383.75 FORMAT "%8.2" DEPOSIT ABSOLUTE /end AXIS_DESCR
/end CHARACTERISTIC
/begin CHARACTERISTIC KLZWATBVL "Grenzz¸ndwinkel f¸r Vollast" CURVE 0xFC67F6 KlAxU8SstxU16WS16 191.2500 zw_sb_q0p75 -96.00000 95.25000 FORMAT "%8.5"
 /begin AXIS_DESCR STD_AXIS nmot_tmp nmot_uw_q0p25 16 0.2500000 16383.75 FORMAT "%8.2" DEPOSIT ABSOLUTE /end AXIS_DESCR
/end CHARACTERISTIC
/begin CHARACTERISTIC KLZWATBVLT "" CURVE 0xFC6838 KlAxU8SstxU16WS16 191.2500 zw_sb_q0p75 -96.00000 95.25000 FORMAT "%8.5"
 /begin AXIS_DESCR STD_AXIS nmot_tmp nmot_uw_q0p25 16 0.2500000 16383.75 FORMAT "%8.2" DEPOSIT ABSOLUTE /end AXIS_DESCR
/end CHARACTERISTIC
/begin CHARACTERISTIC KTNDMRKH "Int.-Konstante f¸r Anforderung Drehmomentenreserve Katheizen" VALUE 0xFD287C KwUw 0.9999847 fak_uw_b1 0.00 0.9999847 FORMAT "%9.7" /end CHARACTERISTIC
/begin CHARACTERISTIC MAXWPEDPWS "Maximal Fahrpedalwinkel f¸r DV-E-Powersave-Funktion" VALUE 0xFC1EB4 KwUb 100.0 relPED_ub_b100 0.00 100.0 FORMAT "%5.1" /end CHARACTERISTIC
/begin CHARACTERISTIC MLKHMX "max. Luftmasse f¸r Katheizen" VALUE 0xFD282A KwUb 1020. m_ub_b1020 0.00 1020. FORMAT "%5.0" /end CHARACTERISTIC
/begin CHARACTERISTIC MSTPKTU "Kennlinie Massenstrom-Schwelle f¸r Verzˆgerung Taupunktende hinter Kat" CURVE 0xFCFD98 KlAUbSstUbWUw 6553.500 m_uw_b6553p5 0.00 6553.500 FORMAT "%8.3"
 /begin AXIS_DESCR STD_AXIS tatu temp_ub_q0p75_o48 4 -48.00 143.3 FORMAT "%5.1" DEPOSIT ABSOLUTE /end AXIS_DESCR
/end CHARACTERISTIC
/begin CHARACTERISTIC MXANZEKPVL "max. Anzahl EKP Vorl‰ufe" VALUE 0xFD5382 KwUb 255.0 dez 0.00 255.0 FORMAT "%5.1" /end CHARACTERISTIC
/begin CHARACTERISTIC NALEMIN "Drehzahl,untehalb der der Zahnint. aktiviert wird" VALUE 0xFC1D88 KwWU16 1000.000 nmot_uw_q0p25 0.00 1000.000 FORMAT "%8.3" /end CHARACTERISTIC
/begin CHARACTERISTIC NARAO "obere Drehzahlschwelle f¸r AR aktiv" VALUE 0xFC8EEB KwUb 10200. nmot_ub_q40 0.00 10200. FORMAT "%5.0" /end CHARACTERISTIC
/begin CHARACTERISTIC NARASTG "Drehzahlschwelle in hoeherem Gang fuer AR aktiv" CURVE 0xFC8EEC FklWUb 10200. nmot_ub_q40 0.00 10200. FORMAT "%5.0"
 /begin AXIS_DESCR FIX_AXIS gangi dez 6 1.000 6.000 FORMAT "%5.3" FIX_AXIS_PAR 1 0 6 /end AXIS_DESCR
/end CHARACTERISTIC
/begin CHARACTERISTIC NARLL "Drehzahlschwelle f¸r AR im Leerlauf" VALUE 0xFC8EF2 KwUb 10200. nmot_ub_q40 0.00 10200. FORMAT "%5.0" /end CHARACTERISTIC
/begin CHARACTERISTIC NDFILOG "Schwelle f¸r Filterausgang ndfil" CURVE 0xFC8F36 FklWUw 16383.75 nmot_uw_q0p25 0.00 16383.75 FORMAT "%8.2"
 /begin AXIS_DESCR FIX_AXIS gangi dez 6 1.000 6.000 FORMAT "%5.3" FIX_AXIS_PAR 1 0 6 /end AXIS_DESCR
/end CHARACTERISTIC
/begin CHARACTERISTIC NDIFFOG "Schwelle Drehzahldifferenz zum Auslˆsen Ini der AR beim Verzˆgern" CURVE 0xFD3554 FklWSw 16383.75 nmot_sw_q0p25 -8192.000 8191.750 FORMAT "%8.3"
 /begin AXIS_DESCR FIX_AXIS gangi dez 6 1.000 6.000 FORMAT "%5.3" FIX_AXIS_PAR 1 0 6 /end AXIS_DESCR
/end CHARACTERISTIC
/begin CHARACTERISTIC NFGRMAX "Max. zul. Drehzahl bei FGR-Betrieb" VALUE 0xFC2240 KwUb 10200. nmot_ub_q40 0.00 10200. FORMAT "%5.0" /end CHARACTERISTIC
/begin CHARACTERISTIC NGANGMIN "Schwelle fuer Gangerkennung, Mindestwert PLausibilitaetstest" VALUE 0xFC2080 KwUw 16383.75 nmot_uw_q0p25 0.00 16383.75 FORMAT "%8.2" /end CHARACTERISTIC
/begin CHARACTERISTIC NLLKT "Leerlaufsolldrehzahl bei Kurztest Sekund‰rluftdiagnose" VALUE 0xFD282B KwUb 2550. nmot_ub_q10 0.00 2550. FORMAT "%5.0" /end CHARACTERISTIC
/begin CHARACTERISTIC NMNANSKL "obere Schaltschwelle der Motordrehzahl f¸r Ansteuerung Ansaugklappe" VALUE 0xFD5371 KwUb 10200. nmot_ub_q40 0.00 10200. FORMAT "%5.0" /end CHARACTERISTIC
/begin CHARACTERISTIC NMXSKA "Maximaldrehzahl bei unbekannter Drosselklappenposition -> Ev-Abschaltung" VALUE 0xFC5FC8 KwUb 10200. nmot_ub_q40 0.00 10200. FORMAT "%5.0" /end CHARACTERISTIC
/begin CHARACTERISTIC NTUMTAT "Schwelle Drehzahl f¸r Bestimmung Umgebungstemperatur aus TANS" VALUE 0xFCFC59 KwUb 10200. nmot_ub_q40 0.00 10200. FORMAT "%5.0" /end CHARACTERISTIC
/begin CHARACTERISTIC NUEMAX "Motor¸berdrehzahlgrenzwert" VALUE 0xFC1D94 KwUw 16383.75 nmot_uw_q0p25 0.00 16383.75 FORMAT "%8.2" /end CHARACTERISTIC
/begin CHARACTERISTIC NVG "Faktor zur Berechnung Initialisierungsdrehzahl" CURVE 0xFD3560 FklWUw 511.9922 qnv_uw_b512 0.00 511.9922 FORMAT "%8.4"
 /begin AXIS_DESCR FIX_AXIS gangi dez 6 1.000 6.000 FORMAT "%5.3" FIX_AXIS_PAR 1 0 6 /end AXIS_DESCR
/end CHARACTERISTIC
/begin CHARACTERISTIC NVIHA2G "Mittlerer nmot/vfzg-Quotient vom Gang 2 f¸r HA-Adaption" VALUE 0xFC2082 KwUw 511.9922 qnv_uw_b512 0.00 511.9922 FORMAT "%8.4" /end CHARACTERISTIC
/begin CHARACTERISTIC NVIHAADAP1 "unterer nmot/vfzg-Quotient vom Gang 2 f¸r HA-Adaption" VALUE 0xFC2084 KwUw 511.9922 qnv_uw_b512 0.00 511.9922 FORMAT "%8.4" /end CHARACTERISTIC
/begin CHARACTERISTIC NVIHAADAP2 "oberer nmot/vfzg-Quotient vom Gang 2 f¸r HA-Adaption" VALUE 0xFC2086 KwUw 511.9922 qnv_uw_b512 0.00 511.9922 FORMAT "%8.4" /end CHARACTERISTIC
/begin CHARACTERISTIC NVMNG "Minimales Drehzahl/Geschwindigkeits-Verh‰ltnis" CURVE 0xFD356C FklWUw 511.9922 qnv_uw_b512 0.00 511.9922 FORMAT "%8.4"
 /begin AXIS_DESCR FIX_AXIS gangi dez 6 1.000 6.000 FORMAT "%5.3" FIX_AXIS_PAR 1 0 6 /end AXIS_DESCR
/end CHARACTERISTIC
/begin CHARACTERISTIC NVMXG "Maximales Drehzahl/Geschwindigkeits-Verh‰ltnis" CURVE 0xFD3578 FklWUw 511.9922 qnv_uw_b512 0.00 511.9922 FORMAT "%8.4"
 /begin AXIS_DESCR FIX_AXIS gangi dez 6 1.000 6.000 FORMAT "%5.3" FIX_AXIS_PAR 1 0 6 /end AXIS_DESCR
/end CHARACTERISTIC
/begin CHARACTERISTIC NVQUOT1O "Gangerkennung n/v 1 Gang oben" VALUE 0xFC2088 KwUw 511.9922 qnv_uw_b512 0.00 511.9922 FORMAT "%8.4" /end CHARACTERISTIC
/begin CHARACTERISTIC NVQUOT1U "Gangerekennung n/v 1 Gang unten" VALUE 0xFC208A KwUw 511.9922 qnv_uw_b512 0.00 511.9922 FORMAT "%8.4" /end CHARACTERISTIC
/begin CHARACTERISTIC NVQUOT2O "Gangerkennung n/v 2 Gang oben" VALUE 0xFC208C KwUw 511.9922 qnv_uw_b512 0.00 511.9922 FORMAT "%8.4" /end CHARACTERISTIC
/begin CHARACTERISTIC NVQUOT2U "Gangerkennung n/v 2 Gang unten" VALUE 0xFC208E KwUw 511.9922 qnv_uw_b512 0.00 511.9922 FORMAT "%8.4" /end CHARACTERISTIC
/begin CHARACTERISTIC NVQUOT3O "Gangerkennung n/v 3 Gang oben" VALUE 0xFC2090 KwUw 511.9922 qnv_uw_b512 0.00 511.9922 FORMAT "%8.4" /end CHARACTERISTIC
/begin CHARACTERISTIC NVQUOT3U "Gangerkennung n/v 3 Gang unten" VALUE 0xFC2092 KwUw 511.9922 qnv_uw_b512 0.00 511.9922 FORMAT "%8.4" /end CHARACTERISTIC
/begin CHARACTERISTIC NVQUOT4O "Gangerkennung n/v 4 Gang oben" VALUE 0xFC2094 KwUw 511.9922 qnv_uw_b512 0.00 511.9922 FORMAT "%8.4" /end CHARACTERISTIC
/begin CHARACTERISTIC NVQUOT4U "Gangerkennung n/v 4 Gang unten" VALUE 0xFC2096 KwUw 511.9922 qnv_uw_b512 0.00 511.9922 FORMAT "%8.4" /end CHARACTERISTIC
/begin CHARACTERISTIC NVQUOT5O "Gangerkennung n/v 5 Gang oben" VALUE 0xFC2098 KwUw 511.9922 qnv_uw_b512 0.00 511.9922 FORMAT "%8.4" /end CHARACTERISTIC
/begin CHARACTERISTIC NVQUOT5U "Gangerkennung n/v 5 Gang unten" VALUE 0xFC209A KwUw 511.9922 qnv_uw_b512 0.00 511.9922 FORMAT "%8.4" /end CHARACTERISTIC
/begin CHARACTERISTIC NVQUOT6O "Gangerkennung n/v 6 Gang oben" VALUE 0xFC209C KwUw 511.9922 qnv_uw_b512 0.00 511.9922 FORMAT "%8.4" /end CHARACTERISTIC
/begin CHARACTERISTIC NVQUOT6U "Gangerkennung n/v 6 Gang unten" VALUE 0xFC209E KwUw 511.9922 qnv_uw_b512 0.00 511.9922 FORMAT "%8.4" /end CHARACTERISTIC
/begin CHARACTERISTIC PEKP "Fˆrderleistung EKP" VALUE 0xFD5388 KwUw 65535.00 vol_q1ml 0.00 65535.00 FORMAT "%8.2" /end CHARACTERISTIC
/begin CHARACTERISTIC RALEMAX "Begrenzungswinkel f¸r max R¸ckdrehen" VALUE 0xFC1D8A KwWU16 360.0000 kw_q0p1 0.00 360.0000 FORMAT "%8.4" /end CHARACTERISTIC
/begin CHARACTERISTIC RDUNDEF "Winkelbereich in dem keine Plausibilisierung des R¸ckdrehverdachts mˆglich ist" VALUE 0xFC1D8C KwWS16 180.0000 kw_q0p1 0.00 180.0000 FORMAT "%8.4" /end CHARACTERISTIC
/begin CHARACTERISTIC REDABM "Ev-Abschaltmuster f¸r Momentenreduzierung" MAP 0xFC5F88 FkfNoShNoOffWUb 255.0 dez 0.00 255.0 FORMAT "%5.1"
 /begin AXIS_DESCR FIX_AXIS evrbgn_one dez 8 0.00 7.000 FORMAT "%5.3" FIX_AXIS_PAR 0 0 8 /end AXIS_DESCR
 /begin AXIS_DESCR FIX_AXIS redsol_one dez 8 0.00 7.000 FORMAT "%5.3" FIX_AXIS_PAR 0 0 8 /end AXIS_DESCR
/end CHARACTERISTIC
/begin AXIS_PTS SEZ06TMUB "St¸tzstellenverteilung, Z¸ndwinkelwirkungsgrad" 0xFCF7F8 etazwimt SstAUbSstUb 127.5 rel_ub_b127p5 6 0.00 127.5 FORMAT "%5.1" DEPOSIT ABSOLUTE /end AXIS_PTS
/begin AXIS_PTS SFR04BBUW "St¸tzstellenverteilung Luftdichte f(Ansauglufttemp., Hˆhe) 16-Bit" 0xFC1326 frhol_w SstAU8SstU16 1.999969 fak_uw_b2 4 0.00 1.999969 FORMAT "%8.6" DEPOSIT ABSOLUTE /end AXIS_PTS
/begin AXIS_PTS SGA07MDUB "Gruppenst¸tzstelle Gangabh‰ngig" 0xFCF7FF gangi SstAUbSstUb 255.0 dez 7 0.00 255.0 FORMAT "%5.1" DEPOSIT ABSOLUTE /end AXIS_PTS
/begin AXIS_PTS SGA08MDUB "St¸tzstellenverteilung Ist Gang 8 Sst." 0xFCF807 gangi SstAUbSstUb 255.0 dez 8 0.00 255.0 FORMAT "%5.1" DEPOSIT ABSOLUTE /end AXIS_PTS
/begin AXIS_PTS SLX06TMUW "St¸tzstellenverteilung, Lambdasoll" 0xFCF8B8 lamsbg_w SstAUwSstUw 15.99976 fak_uw_b16 6 0.00 15.99976 FORMAT "%8.5" DEPOSIT ABSOLUTE /end AXIS_PTS
/begin AXIS_PTS SLY06TMUW "St¸tzstellenverteilung, Lambdasoll Bank2" 0xFCF8C6 lamsbg2_w SstAUwSstUw 15.99976 fak_uw_b16 6 0.00 15.99976 FORMAT "%8.5" DEPOSIT ABSOLUTE /end AXIS_PTS
/begin AXIS_PTS SMK08MDSW "Antiruckelmoment-abh‰ngige St¸tzstellen (Anzahl =8)" 0xFD3584 mkar_w SstASwSstSw 199.9969 rel_sw_b100 8 -100.0000 99.99695 FORMAT "%8.4" DEPOSIT ABSOLUTE /end AXIS_PTS
/begin AXIS_PTS SML06TMUW "St¸tzstellenverteilung, Luftmasse, 6 St¸tzstellen" 0xFCF8D4 ml_w SstAUwSstUw 6553.500 m_uw_b6553p5 6 0.00 6553.500 FORMAT "%8.3" DEPOSIT ABSOLUTE /end AXIS_PTS
/begin AXIS_PTS SML07TMUW "St¸tzstellenverteilung, Luftmasse, 7 St¸tzstellen" 0xFCF8E2 ml_w SstAUwSstUw 6553.500 m_uw_b6553p5 7 0.00 6553.500 FORMAT "%8.3" DEPOSIT ABSOLUTE /end AXIS_PTS
/begin AXIS_PTS ST107TMUB "St¸tzstellenverteilung, Starttemperatur an Sonde vorne" 0xFCF847 tabgmst SstAUbSstUb 1275. temp_ub_q5_o50 7 -50.00 1225. FORMAT "%5.0" DEPOSIT ABSOLUTE /end AXIS_PTS
/begin AXIS_PTS ST207TMUB "St¸tzstellenverteilung, Starttemperatur an Sonde vorne, Bank2" 0xFCF84F tabgmst2 SstAUbSstUb 1275. temp_ub_q5_o50 7 -50.00 1225. FORMAT "%5.0" DEPOSIT ABSOLUTE /end AXIS_PTS
/begin AXIS_PTS ST307TMUB "St¸tzstellenverteilung, Starttemperatur an Sonde hinten" 0xFCF857 tkatmst SstAUbSstUb 1275. temp_ub_q5_o50 7 -50.00 1225. FORMAT "%5.0" DEPOSIT ABSOLUTE /end AXIS_PTS
/begin AXIS_PTS ST407TMUB "St¸tzstellenverteilung, Starttemperatur an Sonde hinten, Bank2" 0xFCF85F tkatmst2 SstAUbSstUb 1275. temp_ub_q5_o50 7 -50.00 1225. FORMAT "%5.0" DEPOSIT ABSOLUTE /end AXIS_PTS
/begin AXIS_PTS STM05TMUB "St¸tzstellenverteilung, Motorstarttemperatur" 0xFCF912 tmst SstAUwSstUw 191.3 temp_ub_q0p75_o48 5 -48.00 143.3 FORMAT "%5.1" DEPOSIT ABSOLUTE /end AXIS_PTS
/begin AXIS_PTS STM08BBUB "St¸tzstellenverteilung Motortemperatur, 8 Sst." 0xFC136F tmot SstAU8SstU8 191.3 temp_ub_q0p75_o48 8 -48.00 143.3 FORMAT "%5.1" DEPOSIT ABSOLUTE /end AXIS_PTS
/begin AXIS_PTS STS06TMUW "St¸tzstellenverteilung, Abgasmassenfluﬂ" 0xFCFDA6 tabstatm_w SstAUwSstUw 65535.00 t1sxs_uw_q1 6 0.00 65535.00 FORMAT "%8.2" DEPOSIT ABSOLUTE /end AXIS_PTS
/begin AXIS_PTS STU05TMUB "St¸tzstellenverteilung, Ersatz-Umgebungstemperatur" 0xFCFC5A tatu SstAUbSstUb 191.3 temp_ub_q0p75_o48 5 -48.00 143.3 FORMAT "%5.1" DEPOSIT ABSOLUTE /end AXIS_PTS
/begin CHARACTERISTIC TAANSKLE "Ersatzwert bei Fehler Ansauglufttemperatur f¸r Schaltbedingung Ansaugklappe" VALUE 0xFD5372 KwUb 191.3 temp_ub_q0p75_o48 -48.00 143.3 FORMAT "%5.1" /end CHARACTERISTIC
/begin CHARACTERISTIC TAANSKTU "Schwelle Ansauglufttemperatur f¸r Schaltbedingung Ansaugklappe" CURVE 0xFD5373 KlAUbSstUbWUb 191.3 temp_ub_q0p75_o48 -48.00 143.3 FORMAT "%5.1"
 /begin AXIS_DESCR STD_AXIS tumg temp_ub_q0p75_o48 6 -48.00 143.3 FORMAT "%5.1" DEPOSIT ABSOLUTE /end AXIS_DESCR
/end CHARACTERISTIC
/begin CHARACTERISTIC TABGATB "Abgastemperaturschwelle f¸r Bauteileschutz" VALUE 0xFC687C KwWU16 1279.980 temp_uw_q0p0195_o50 -50.00000 1229.980 FORMAT "%8.3" /end CHARACTERISTIC
/begin CHARACTERISTIC TABGMEX "Abgastemperatur unterhalb der Kat-Anspringtemperatur" VALUE 0xFCFC60 KwUb 1275. temp_ub_q5_o50 -50.00 1225. FORMAT "%5.0" /end CHARACTERISTIC
/begin CHARACTERISTIC TABSTKH "Mindestabstellzeit f¸r Freigabe Kat-Heizen" VALUE 0xFD287E KwUw 65535.00 t1sxs_uw_b65535 0.00 65535.00 FORMAT "%8.2" /end CHARACTERISTIC
/begin CHARACTERISTIC TABSTKHX "Mindestabstellzeit f¸r Reset imlatmw_w-ACCU" VALUE 0xFD2880 KwUw 65535.00 t1sxs_uw_b65535 0.00 65535.00 FORMAT "%8.2" /end CHARACTERISTIC
/begin CHARACTERISTIC TAHRLSUMX "Max. Tastverh‰ltnis zur Ansteuerung der Sondenheizung der LSU" VALUE 0xFC1F90 KwUw 199.9969 rel_uw_b200 0.00 199.9969 FORMAT "%8.4" /end CHARACTERISTIC
/begin CHARACTERISTIC TAREIN "Sperrzeit f¸r Antiruckelfunktion" VALUE 0xFC8EF3 KwUb 2.550 t10msxs_ub_b2p55 0.00 2.550 FORMAT "%5.3" /end CHARACTERISTIC
/begin CHARACTERISTIC TASTBFA "Modell-Temperatur vor Vorkatalysator Startwert bei B_faatm Anforderung" VALUE 0xFCFC61 KwUb 1275. temp_ub_q5_o50 -50.00 1225. FORMAT "%5.0" /end CHARACTERISTIC
/begin CHARACTERISTIC TATEGRDO "Obere Schwelle Tastverh‰ltnis TEV zur Erkennung eines neg. Gradienten tatesoll" VALUE 0xFCC9DD KwUb 99.61 rel_ub_b99p6 0.00 99.61 FORMAT "%5.2" /end CHARACTERISTIC
/begin CHARACTERISTIC TATEGRDU "Untere Schwelle Tastverh‰ltnis TEV zur Erkennung eines neg. Gradienten tatesoll" VALUE 0xFCC9DE KwUb 99.61 rel_ub_b99p6 0.00 99.61 FORMAT "%5.2" /end CHARACTERISTIC
/begin CHARACTERISTIC TATMKH "Abgastemperaturkorrektur bei Kat-Heizen aktiv" VALUE 0xFCFC62 KwUb 1275. temp_q5 0.00 1275. FORMAT "%5.0" /end CHARACTERISTIC
/begin CHARACTERISTIC TATMKH2 "Abgastemperaturkorrektur bei Kat-Heizen aktiv Bank2" VALUE 0xFCFC63 KwUb 1275. temp_q5 0.00 1275. FORMAT "%5.0" /end CHARACTERISTIC
/begin CHARACTERISTIC TATMKW "Abgastemperaturkorrektur bei Kat warmhalten aktiv" VALUE 0xFCFC64 KwUb 1275. temp_q5 0.00 1275. FORMAT "%5.0" /end CHARACTERISTIC
/begin CHARACTERISTIC TATMRTPK "Zeitverzˆgerung zum R¸cksetzten des W‰rmemengen Integrators iwmatmk" VALUE 0xFCFDB4 KwUw 13107.00 t_q0p2 0.00 13107.00 FORMAT "%8.2" /end CHARACTERISTIC
/begin CHARACTERISTIC TATMRTPK2 "Zeitverzˆgerung zum R¸cksetzten des W‰rmemengen Integrators iwmatmk, Bank2" VALUE 0xFCFDB6 KwUw 13107.00 t_q0p2 0.00 13107.00 FORMAT "%8.2" /end CHARACTERISTIC
/begin CHARACTERISTIC TATMSA "Abgastemperatur bei Schubabschneiden" VALUE 0xFCFC65 KwUb 1275. temp_ub_q5_o50 -50.00 1225. FORMAT "%5.0" /end CHARACTERISTIC
/begin CHARACTERISTIC TATMSAE "exotherme Temperaturerhˆhung im Schub" VALUE 0xFCFC66 KwUb 1275. temp_ub_q5_o50 -50.00 1225. FORMAT "%5.0" /end CHARACTERISTIC
/begin CHARACTERISTIC TATMSAE2 "exotherme Temperaturerhˆhung im Schub Bank 2" VALUE 0xFCFC67 KwUb 1275. temp_ub_q5_o50 -50.00 1225. FORMAT "%5.0" /end CHARACTERISTIC
/begin CHARACTERISTIC TATMSTI "Initialisierungswert f¸r tabgm, tkatm Startwert bei Powerfail" VALUE 0xFCFC68 KwUb 1275. temp_ub_q5_o50 -50.00 1225. FORMAT "%5.0" /end CHARACTERISTIC
/begin CHARACTERISTIC TATMTMOT "Motortemperatur warmer Motor , f¸r Temperaturkorrektur beim Kaltstart" VALUE 0xFCFC69 KwUb 191.3 temp_ub_q0p75_o48 -48.00 143.3 FORMAT "%5.1" /end CHARACTERISTIC
/begin CHARACTERISTIC TATMTP "Abgastaupunkttemperatur" VALUE 0xFCFC6A KwUb 1275. temp_ub_q5_o50 -50.00 1225. FORMAT "%5.0" /end CHARACTERISTIC
/begin CHARACTERISTIC TATMTRKH "Abgastemperaturkorrektur bei Thermoreaktor-Katheizen" VALUE 0xFCFC6B KwUb 1275. temp_q5 0.00 1275. FORMAT "%5.0" /end CHARACTERISTIC
/begin CHARACTERISTIC TATMTRKH2 "Abgastemperaturkorrektur bei Thermoreaktor-Katheizen Bank 2" VALUE 0xFCFC6C KwUb 1275. temp_q5 0.00 1275. FORMAT "%5.0" /end CHARACTERISTIC
/begin CHARACTERISTIC TATMWMK "Temperaturoffset  f¸r W‰rmemengenberechnung" VALUE 0xFCFC6D KwSb 1275. temp_q5 -640.0 635.0 FORMAT "%5.1" /end CHARACTERISTIC
/begin CHARACTERISTIC TDKLAGDE "Zeitdelta f¸r Fehlerz‰hlerlˆschung bei DK-Soll-/Istvergleich" VALUE 0xFC1EB5 KwUb 5.100 t20msxs_ub_b5p1 0.00 5.100 FORMAT "%5.3" /end CHARACTERISTIC
/begin CHARACTERISTIC TDLRHAFTMX "Verweildauer f¸r Aktivierung der Haftreibungsroutine" VALUE 0xFCFA3D KwUb 12.75 t50msxs_q0p05 0.00 12.75 FORMAT "%5.2" /end CHARACTERISTIC
/begin CHARACTERISTIC TDLRPIDC "Zeitdelta zur Fehlerzeitdecrementierung bei DLR-Stellbereichs¸berwachung" VALUE 0xFC1EF0 KwUw 655.3500 t10msxs_uw_b655p35 0.00 655.3500 FORMAT "%8.4" /end CHARACTERISTIC
/begin CHARACTERISTIC TDVIVZ "Toleranzzeit bei zu groﬂer Abweichung zw. Istgeschw. und Zielgeschw." VALUE 0xFC2252 KwUw 1310.680 t20msxs_uw_q0p02 0.02000000 1310.700 FORMAT "%8.3" /end CHARACTERISTIC
/begin CHARACTERISTIC TDVZVI "Toleranzzeit bei zu groﬂer Abweichung zw. Zielgeschw. und Istgeschw." VALUE 0xFC2254 KwUw 1310.680 t20msxs_uw_q0p02 0.02000000 1310.700 FORMAT "%8.3" /end CHARACTERISTIC
/begin CHARACTERISTIC TEVPMN1 "Minimale Ansteuerzeit f¸r TEV Schwelle 1" VALUE 0xFCC9DF KwUb 127.5 t500usxms_ub_q0p5 0.00 127.5 FORMAT "%5.1" /end CHARACTERISTIC
/begin CHARACTERISTIC TEVPMN2 "Minimale Ansteuerzeit f¸r TEV Schwelle 2" VALUE 0xFCC9E0 KwUb 127.5 t500usxms_ub_q0p5 0.00 127.5 FORMAT "%5.1" /end CHARACTERISTIC
/begin CHARACTERISTIC TFARSL "Filterzeit f¸r relativen Schlupf f¸r ARMD" VALUE 0xFC8F42 KwUw 655.34999985 zk10msxs_uw_b655 0.010000152590 655.36000000 FORMAT "%12.8" /end CHARACTERISTIC
/begin CHARACTERISTIC TFGRAQU "Toleranzzeit f¸r Aquaplaningerkennung im FGR-Betrieb" VALUE 0xFC2241 KwUb 5.080 t20msxs_ub_b5p1 0.02000 5.100 FORMAT "%5.3" /end CHARACTERISTIC
/begin CHARACTERISTIC TFGRASCOF "Zeit f¸r FGR-Abschaltung bei aktivem Brems-Eingriff" VALUE 0xFC2256 KwUw 1310.700 t20msxs_uw_q0p02 0.00 1310.700 FORMAT "%8.3" /end CHARACTERISTIC
/begin CHARACTERISTIC TFGRBREOF "Zeit f¸r FGR-Abschaltung bei aktivem Brems-Eingriff" VALUE 0xFC2258 KwUw 1310.700 t20msxs_uw_q0p02 0.00 1310.700 FORMAT "%8.3" /end CHARACTERISTIC
/begin CHARACTERISTIC TFGRDSCOF "Zeit f¸r FGR-Abschaltung bei aktivem DSC-Eingriff" VALUE 0xFC225A KwUw 1310.700 t20msxs_uw_q0p02 0.00 1310.700 FORMAT "%8.3" /end CHARACTERISTIC
/begin CHARACTERISTIC TFGRUEOB "Toleranzzeit f¸r ‹berschreiten der oberen Beschleunigungsschwelle im FGR-Betrieb" VALUE 0xFC2242 KwUb 5.080 t20msxs_ub_b5p1 0.02000 5.100 FORMAT "%5.3" /end CHARACTERISTIC
/begin CHARACTERISTIC TFGRUM "Toleranzzeit f¸r Erkennung FGR-Betrieb in der Funktions¸berwachung" VALUE 0xFC2243 KwUb 5.080 t20msxs_ub_b5p1 0.02000 5.100 FORMAT "%5.3" /end CHARACTERISTIC
/begin CHARACTERISTIC TFGRUNUB "Toleranzzeit f¸r Unterschreiten der unteren Beschl.schwelle im FGR-Betrieb" VALUE 0xFC2244 KwUb 5.080 t20msxs_ub_b5p1 0.02000 5.100 FORMAT "%5.3" /end CHARACTERISTIC
/begin CHARACTERISTIC TIKATATB "" VALUE 0xFC687E KwWU16 1279.980 temp_uw_q0p0195_o50 -50.00000 1229.980 FORMAT "%8.3" /end CHARACTERISTIC
/begin CHARACTERISTIC TIKATMOE "Temperaturkorrektur im Kat ohne Exotherme tikatm" VALUE 0xFCFC6E KwSb 1275. temp_q5 -640.0 635.0 FORMAT "%5.1" /end CHARACTERISTIC
/begin CHARACTERISTIC TKATATB "Kat-Temperaturschwelle f¸r Bauteileschutz" VALUE 0xFC6880 KwWU16 1279.980 temp_uw_q0p0195_o50 -50.00000 1229.980 FORMAT "%8.3" /end CHARACTERISTIC
/begin CHARACTERISTIC TKATMN "Katalysatortemperaturregelschwelle f¸r Kat warmhalten" VALUE 0xFD282C KwUb 1275. temp_ub_q5_o50 -50.00 1225. FORMAT "%5.0" /end CHARACTERISTIC
/begin CHARACTERISTIC TKATMOE "Temperaturkorrektur Kat ohne Exotherme tkatm" VALUE 0xFCFC6F KwSb 1275. temp_q5 -640.0 635.0 FORMAT "%5.1" /end CHARACTERISTIC
/begin CHARACTERISTIC TKATMTPMN "minimale Abgastemperatur hinter HK, bei der Wasser im Leerlauf noch verdampft" VALUE 0xFCFDB8 KwUw 1279.980 temp_uw_q0p0195_o50 -50.00000 1229.980 FORMAT "%8.3" /end CHARACTERISTIC
/begin CHARACTERISTIC TKATW "Katalysatortemperaturschwelle f¸r Kat warmhalten" VALUE 0xFD282D KwUb 1275. temp_ub_q5_o50 -50.00 1225. FORMAT "%5.0" /end CHARACTERISTIC
/begin CHARACTERISTIC TKHABB "Entprellzeit f¸r Abbruchbedingungen der Funktion Katheizen" VALUE 0xFD282E KwUb 25.50 t100msxs_ub_b25p5 0.00 25.50 FORMAT "%5.2" /end CHARACTERISTIC
/begin CHARACTERISTIC TKHFSAB "Entprellzeit f¸r Umschaltung auf Katheizdrehzahl bei Fahrstufe" VALUE 0xFD282F KwUb 25.50 t100msxs_ub_b25p5 0.00 25.50 FORMAT "%5.2" /end CHARACTERISTIC
/begin CHARACTERISTIC TKHLL "Abbruchzeit Katheizen Leerlauf" VALUE 0xFD2882 KwUw 6553.500 t100msxs_uw_b6553p5 0.00 6553.500 FORMAT "%8.3" /end CHARACTERISTIC
/begin CHARACTERISTIC TKHLLAB "Entprellzeit f¸r Ende Katheizdrehzahl im LL" VALUE 0xFD2830 KwUb 25.50 t100msxs_ub_b25p5 0.00 25.50 FORMAT "%5.2" /end CHARACTERISTIC
/begin CHARACTERISTIC TKHLLMX "Maximale Zeit f¸r angehobene Katheiz-Drehzahl" VALUE 0xFD2884 KwUw 655.3500 t10msxs_uw_b655p35 0.00 655.3500 FORMAT "%8.4" /end CHARACTERISTIC
/begin CHARACTERISTIC TKHMX "Maximale Einschaltdauer der Funktion Katheizen" VALUE 0xFD2886 KwUw 655.3500 t10msxs_uw_b655p35 0.00 655.3500 FORMAT "%8.4" /end CHARACTERISTIC
/begin CHARACTERISTIC TKHNAB "Zeitdauer Absteuern Katheizdrehzahl" VALUE 0xFD2888 KwUw 6553.500 t100msxs_uw_b6553p5 0.00 6553.500 FORMAT "%8.3" /end CHARACTERISTIC
/begin CHARACTERISTIC TKSTBFA "Modell-Temperatur hinter Hauptkat Startwert bei B_faatm Anforderun" VALUE 0xFCFC70 KwUb 1275. temp_ub_q5_o50 -50.00 1225. FORMAT "%5.0" /end CHARACTERISTIC
/begin CHARACTERISTIC TMAR "Untere tmot-Schwelle f¸r AR-Freigabe" VALUE 0xFC8EF4 KwUb 191.3 temp_ub_q0p75_o48 -48.00 143.3 FORMAT "%5.1" /end CHARACTERISTIC
/begin CHARACTERISTIC TMLAST "Sperrzeit bis zum Auslˆsen des Ini der AR beim Verzˆgern" VALUE 0xFC8EF5 KwUb 2.550 t10msxs_ub_b2p55 0.00 2.550 FORMAT "%5.3" /end CHARACTERISTIC
/begin CHARACTERISTIC TMNTEVZU "Minimale Zeit bis TEV nach Ansteuerung schlieﬂt" VALUE 0xFCC9E1 KwUb 0.1245 t_tev0p0005 0.00 0.1245 FORMAT "%6.4" /end CHARACTERISTIC
/begin CHARACTERISTIC TMOTAKR "Temperaturschwelle f¸r motortemperaturabh‰ngige Abgasklappenansteuerung" VALUE 0xFD53FD KwWU8 191.3 temp_ub_q0p75_o48 -48.00 143.3 FORMAT "%5.1" /end CHARACTERISTIC
/begin CHARACTERISTIC TMSKS "Motortemperaturschwelle f¸r Erkennung Benzin im ÷l" VALUE 0xFD226B KwUb 191.3 temp_ub_q0p75_o48 -48.00 143.3 FORMAT "%5.1" /end CHARACTERISTIC
/begin CHARACTERISTIC TMSLOF "Motortemperaturschwelle f¸r Sperre Sekund‰rluft" VALUE 0xFD2831 KwUb 191.3 temp_ub_q0p75_o48 -48.00 143.3 FORMAT "%5.1" /end CHARACTERISTIC
/begin CHARACTERISTIC TNLATM "Minimale SG-Nachlaufzeit f¸r ATM - Abstellzeit" VALUE 0xFCFDBA KwUw 65535.00 t1sxs_uw_q1 0.00 65535.00 FORMAT "%8.2" /end CHARACTERISTIC
/begin CHARACTERISTIC TNLATMTM "bei tmot > Schwellert  SG-Nachlauf-Anforderung B_nlatm = 1" VALUE 0xFCFC71 KwUb 191.3 temp_ub_q0p75_o48 -48.00 143.3 FORMAT "%5.1" /end CHARACTERISTIC
/begin CHARACTERISTIC TNLATMTU "bei tumg (tatu -ATM) > Schwellwert SG-Nachlauf-Anforderung" VALUE 0xFCFC72 KwUb 191.3 temp_ub_q0p75_o48 -48.00 143.3 FORMAT "%5.1" /end CHARACTERISTIC
/begin CHARACTERISTIC TNSDMRKH "Zeit nach Start f¸r Drehmomentenreserve Katheizen" VALUE 0xFD288A KwUw 655.3500 t10msxs_uw_b655p35 0.00 655.3500 FORMAT "%8.4" /end CHARACTERISTIC
/begin CHARACTERISTIC TPDVL "Abstellzeit-Differenz in der ein Pumpenvorlauf durchgef¸hrt wird" VALUE 0xFD538A KwUw 65535.00 t1sxs_uw_q1 0.00 65535.00 FORMAT "%8.2" /end CHARACTERISTIC
/begin CHARACTERISTIC TPHRLSU "Periodendauer f¸r die Heizertaktung der LSU" VALUE 0xFCFA48 KwUw 1.048560 t100msxs_q16Em6 0.00 1.048560 FORMAT "%8.6" /end CHARACTERISTIC
/begin CHARACTERISTIC TPWRSV "Wartezeit bis DV-E Powersave aktiv wird" VALUE 0xFC1EF2 KwUw 655.3500 t10msxs_uw_b655p35 0.00 655.3500 FORMAT "%8.4" /end CHARACTERISTIC
/begin CHARACTERISTIC TSTAPVL "Zeit f¸r EKP Aktivierung bei Startautomatik" VALUE 0xFD5383 KwUb 5.100 t20msxs_ub_b5p1 0.00 5.100 FORMAT "%5.3" /end CHARACTERISTIC
/begin CHARACTERISTIC TUMTAIT "Initialisierungswert Umgebungstemperatur aus TANS" VALUE 0xFCFC73 KwUb 191.3 temp_ub_q0p75_o48 -48.00 143.3 FORMAT "%5.1" /end CHARACTERISTIC
/begin CHARACTERISTIC TVARDASHG "Verzˆgerungszeit f¸r AR wieder inaktiv nach Dashpot gangabh‰ngig" CURVE 0xFC8EF6 FklWUb 2.550 t10msxs_ub_b2p55 0.00 2.550 FORMAT "%5.3"
 /begin AXIS_DESCR FIX_AXIS gangi dez 8 0.00 7.000 FORMAT "%5.3" FIX_AXIS_PAR 0 0 8 /end AXIS_DESCR
/end CHARACTERISTIC
/begin CHARACTERISTIC TVARKUPPLG "Verzˆgerungszeit f¸r AR wieder inaktiv nach Kupplung gangabh‰ngig" CURVE 0xFC8EFE FklWUb 2.550 t10msxs_ub_b2p55 0.00 2.550 FORMAT "%5.3"
 /begin AXIS_DESCR FIX_AXIS gangi dez 8 0.00 7.000 FORMAT "%5.3" FIX_AXIS_PAR 0 0 8 /end AXIS_DESCR
/end CHARACTERISTIC
/begin CHARACTERISTIC TVARLSDG "Verzˆgerungszeit f¸r AR wieder inaktiv nach Lastschlag gangabh‰ngig" CURVE 0xFC8F06 FklWUb 2.550 t10msxs_ub_b2p55 0.00 2.550 FORMAT "%5.3"
 /begin AXIS_DESCR FIX_AXIS gangi dez 8 0.00 7.000 FORMAT "%5.3" FIX_AXIS_PAR 0 0 8 /end AXIS_DESCR
/end CHARACTERISTIC
/begin CHARACTERISTIC TVARS "Verzoegerungszeit fuer AR wieder inaktiv" VALUE 0xFC8F0E KwUb 2.550 t10msxs_ub_b2p55 0.00 2.550 FORMAT "%5.3" /end CHARACTERISTIC
/begin CHARACTERISTIC TVKUPAR "Verzˆgerungszeit Kupplung f¸r Antiruckelfunktion" VALUE 0xFC8F0F KwUb 5.100 t20msxs_ub_b5p1 0.00 5.100 FORMAT "%5.3" /end CHARACTERISTIC
/begin CHARACTERISTIC TVKUPHS "Verzˆgerungszeit Kupplungsschalter beim Hochschalten" CURVE 0xFC8F10 FklWUb 2.550 t10msxs_ub_b2p55 0.00 2.550 FORMAT "%5.3"
 /begin AXIS_DESCR FIX_AXIS gangi dez 6 1.000 6.000 FORMAT "%5.3" FIX_AXIS_PAR 1 0 6 /end AXIS_DESCR
/end CHARACTERISTIC
/begin CHARACTERISTIC TVKUPRS "Verzˆgerungszeit Kupplungsschalter beim Runterschalten" CURVE 0xFC8F16 FklWUb 2.550 t10msxs_ub_b2p55 0.00 2.550 FORMAT "%5.3"
 /begin AXIS_DESCR FIX_AXIS gangi dez 6 1.000 6.000 FORMAT "%5.3" FIX_AXIS_PAR 1 0 6 /end AXIS_DESCR
/end CHARACTERISTIC
/begin CHARACTERISTIC TVKURU "Verzˆgerung der Differenzbildung um x Sekunden" VALUE 0xFC20A8 KwUb 0.08000 t20msxs_ub_b5p1 0.02000 0.1000 /end CHARACTERISTIC
/begin CHARACTERISTIC TVSTAKR "Verzˆgerungszeit f¸r Ansteuerung Abgasklappe nach Start" VALUE 0xFD53F8 KwWU16 655.3500 t10msxs_uw_b655p35 0.00 655.3500 FORMAT "%8.4" /end CHARACTERISTIC
/begin CHARACTERISTIC TWPEDBR "Entprellzeit f¸r Plausibilisierung Fahrpedalwert mit Bremspedal" VALUE 0xFC20C8 KwUb 2.550 t10msxs_ub_b2p55 0.00 2.550 FORMAT "%5.3" /end CHARACTERISTIC
/begin CHARACTERISTIC TZMIN "Zeitfenster f¸r Zahnerkennung nach UBatt-Einbruch" VALUE 0xFD5384 KwUb 5.100 t20msxs_ub_b5p1 0.00 5.100 FORMAT "%5.3" /end CHARACTERISTIC
/begin CHARACTERISTIC TZSPINI "Sperrzeit fuer Filterinitialisierung" VALUE 0xFC8F1C KwUb 2.550 t10msxs_ub_b2p55 0.00 2.550 FORMAT "%5.3" /end CHARACTERISTIC
/begin CHARACTERISTIC TZZMX "Zeitfenster f¸r Zahnerkennung" VALUE 0xFD5385 KwUb 5.100 t20msxs_ub_b5p1 0.00 5.100 FORMAT "%5.3" /end CHARACTERISTIC
/begin CHARACTERISTIC UBALSUMX "Batteriespannungsschwelle f¸r Abschalten der Sondenheizung LSU" VALUE 0xFC1F8E KwUb 25.50 spg_q0p1 0.00 25.50 FORMAT "%5.2" /end CHARACTERISTIC
/begin CHARACTERISTIC UBSTS "Schwelle zur Erkennung UBatt-Einbruch im Start" VALUE 0xFD5386 KwUb 25.50 spg_q0p1 0.00 25.50 FORMAT "%5.2" /end CHARACTERISTIC
/begin CHARACTERISTIC UDKNLPTOL "zul‰ssige Potispannungs-Toleranz des NLP" VALUE 0xFC1EF4 KwUw 79.99878 spg_uw_q0p001222 0.00 79.99878 FORMAT "%8.5" /end CHARACTERISTIC
/begin CHARACTERISTIC UPWGKDO "Oberer Hysterese-Schaltpunkt zur Kick-Down-Erkennung aus Potispannung" VALUE 0xFC20A4 KwUb 4.980 spg_ub_b5 0.00 4.980 FORMAT "%5.3" /end CHARACTERISTIC
/begin CHARACTERISTIC UPWGKDU "Unterer Hysterese-Schaltpunkt zur Kick-Down-Erkennung aus Potispannung" VALUE 0xFC20A5 KwUb 4.980 spg_ub_b5 0.00 4.980 FORMAT "%5.3" /end CHARACTERISTIC
/begin CHARACTERISTIC VARAU "minimale Fahrzeuggeschwindigkeit f¸r ARA - Funktion" VALUE 0xFC8F1D KwUb 317.5 fak_ub_b318p75 0.00 317.5 FORMAT "%5.1" /end CHARACTERISTIC
/begin CHARACTERISTIC VBGFGRAQ "Geschwindigkeit Bereichsgrenze bei Aquaplaningerkennung" VALUE 0xFC225C KwUw 511.9922 vfzg_uw_b512 0.00 511.9922 FORMAT "%8.4" /end CHARACTERISTIC
/begin CHARACTERISTIC VFGRMAX "Maximal zul‰ssige Geschwindigkeit im FGR-Betrieb" VALUE 0xFC225E KwUw 511.9922 vfzg_uw_b512 0.00 511.9922 FORMAT "%8.4" /end CHARACTERISTIC
/begin CHARACTERISTIC VFGRMIN "Minimal zul‰ssige Geschwindigkeit im FGR-Betrieb" VALUE 0xFC2260 KwUw 511.9922 vfzg_uw_b512 0.00 511.9922 FORMAT "%8.4" /end CHARACTERISTIC
/begin CHARACTERISTIC VKSTPV "Fˆrdervolumen EKP Vorlauf" VALUE 0xFD538C KwUw 65535.00 vol_q1ml 0.00 65535.00 FORMAT "%8.2" /end CHARACTERISTIC
/begin CHARACTERISTIC VMINAKR "minimale Fahrzeuggeschwindigkeit f¸r Impuls-Ausgabe" VALUE 0xFD53FE KwWU8 318.8 vfzg_ub_q1p25 0.00 318.8 FORMAT "%5.1" /end CHARACTERISTIC
/begin CHARACTERISTIC VMINAKR2 "Geschwindigkeitsschwelle f¸r Abgasklappenansteuerung bei Kaltstart" VALUE 0xFD53FF KwWU8 318.8 vfzg_ub_q1p25 0.00 318.8 FORMAT "%5.1" /end CHARACTERISTIC
/begin CHARACTERISTIC VMNANSKL "minimale Fahrzeuggeschwindigkeit f¸r Ansteuerung Ansaugklappe" VALUE 0xFD5380 KwUb 318.8 vfzg_ub_q1p25 0.00 318.8 FORMAT "%5.1" /end CHARACTERISTIC
/begin CHARACTERISTIC VREGLMAXKM "Maximal zul‰ssige Sollgeschwindigkeit f¸r FGR (f¸r Kilometertacho)" VALUE 0xFC2262 KwUw 511.9922 vfzg_uw_b512 0.00 511.9922 FORMAT "%8.4" /end CHARACTERISTIC
/begin CHARACTERISTIC VREGLMAXMI "Maximal zul‰ssige Sollgeschwindigkeit f¸r FGR (f¸r Milentacho)" VALUE 0xFC2264 KwUw 511.9922 vfzg_uw_b512 0.00 511.9922 FORMAT "%8.4" /end CHARACTERISTIC
/begin CHARACTERISTIC VREGLMINKM "Minimal zul‰ssige Sollgeschwindigkeit f¸r FGR (f¸r Kilometertacho)" VALUE 0xFC2266 KwUw 511.9922 vfzg_uw_b512 0.00 511.9922 FORMAT "%8.4" /end CHARACTERISTIC
/begin CHARACTERISTIC VREGLMINMI "Minimal zul‰ssige Sollgeschwindigkeit f¸r FGR (f¸r Milentacho)" VALUE 0xFC2268 KwUw 511.9922 vfzg_uw_b512 0.00 511.9922 FORMAT "%8.4" /end CHARACTERISTIC
/begin CHARACTERISTIC VTUMTAT "Schwelle Fahrzeuggeschwindigkeit f¸r TANS -> Umgebungstemperatur" VALUE 0xFCFC74 KwUb 318.8 vfzg_ub_q1p25 0.00 318.8 FORMAT "%5.1" /end CHARACTERISTIC
/begin CHARACTERISTIC W360_ALE_IMPL "" VALUE 0xFC1D8E KwWU16 360.0000 kw_q0p1 0.00 360.0000 FORMAT "%8.4" READ_ONLY /end CHARACTERISTIC
/begin CHARACTERISTIC W720_ALE_IMPL "" VALUE 0xFC1D90 KwWU16 719.9000 kw_q0p1 0.1000000 720.0000 FORMAT "%8.4" READ_ONLY /end CHARACTERISTIC
/begin CHARACTERISTIC WDKBEWS "Schwelle zur DK-Bewegungserkennung (I-Klein)" VALUE 0xFC1EF6 KwSw 1599.976 relDK_q0p02441 -800.0000 799.9756 FORMAT "%8.4" /end CHARACTERISTIC
/begin CHARACTERISTIC WDKNLPTOL "zul‰ssige DK-Winkel-Toleranz des NLP" VALUE 0xFC1EF8 KwUw 100.0000 relDK_uw_b100 0.00 100.0000 FORMAT "%8.4" /end CHARACTERISTIC
/begin CHARACTERISTIC WDKREIB "Haftreibungsanteil der DK f¸r I-Klein" VALUE 0xFC1EB6 KwUb 0.9961 fak_ub_b1 0.00 0.9961 /end CHARACTERISTIC
/begin CHARACTERISTIC WDKSAPNOL "DK-Sollwert bei Applikationshilfe DK-Notluftfahren" VALUE 0xFC1EFA KwUw 99.99847 relDK_q0p00152 0.00 99.99847 FORMAT "%8.5" /end CHARACTERISTIC
/begin CHARACTERISTIC WDKSTFEIN "Schwelle zur Stationarit‰tserkennung (verst‰rkter Bereich)" VALUE 0xFC1EFC KwSw 1599.976 relDK_q0p02441 -800.0000 799.9756 FORMAT "%8.4" /end CHARACTERISTIC
/begin CHARACTERISTIC WDKSTGROB "Schwelle zur Stationarit‰tserkennung (unverst‰rkter Bereich)" VALUE 0xFC1EFE KwSw 1599.976 relDK_q0p02441 -800.0000 799.9756 FORMAT "%8.4" /end CHARACTERISTIC
/begin CHARACTERISTIC WMABGKH "Faktor f¸r W‰rmemengenkorrektur bei Katheizen f¸r Taupunktende" VALUE 0xFCFC75 KwUb 1.000 fak_ub_b2 0.00 1.000 FORMAT "%5.3" /end CHARACTERISTIC
/begin CHARACTERISTIC WMABGKH2 "Faktor f¸r W‰rmemengenkorrektur bei Katheizen f¸r Taupunktende Bank2" VALUE 0xFCFC76 KwUb 1.000 fak_ub_b2 0.00 1.000 FORMAT "%5.3" /end CHARACTERISTIC
/begin CHARACTERISTIC WMKATKH "Faktor f¸r W‰rmemengenkorrektur bei Katheizen f¸r Taupunktende hinter Kat" VALUE 0xFCFC77 KwUb 1.000 fak_ub_b2 0.00 1.000 FORMAT "%5.3" /end CHARACTERISTIC
/begin CHARACTERISTIC WMKATKH2 "Faktor f¸r W‰rmemengenkorrektur bei Katheizen f¸r Taupunktende hinter Kat, Bank2" VALUE 0xFCFC78 KwUb 1.000 fak_ub_b2 0.00 1.000 FORMAT "%5.3" /end CHARACTERISTIC
/begin CHARACTERISTIC WPEDFMX "Fahrpedalschwelle f¸r PWG-Bremspedal Plausibilisierung" VALUE 0xFC20CA KwUw 100.0000 relPED_uw_b100 0.00 100.0000 FORMAT "%8.4" /end CHARACTERISTIC
/begin CHARACTERISTIC WPEDU "Untere Schwelle Pedalwert f¸r Antiruckelfunktion" VALUE 0xFC8F44 KwUw 100.0000 relPED_uw_b100 0.00 100.0000 FORMAT "%8.4" /end CHARACTERISTIC
/begin CHARACTERISTIC WPKDMN "Minimaler Pedalwert f¸r Kick-Down-Erkennung" VALUE 0xFC20A6 KwUw 100.0000 relPED_uw_b100 0.00 100.0000 FORMAT "%8.4" /end CHARACTERISTIC
/begin CHARACTERISTIC ZATMAML "Zeitkonstante fuer Abgastemperaturmodell" CURVE 0xFCFDBC GklWUw 13106.800000 zk200msxs_uw_b13107 0.20000000000 13107.000000 FORMAT "%12.6"
 /begin AXIS_DESCR COM_AXIS ml_w m_uw_b6553p5 7 0.00 6553.500 FORMAT "%8.3" AXIS_PTS_REF SML07TMUW /end AXIS_DESCR
/end CHARACTERISTIC
/begin CHARACTERISTIC ZATMAML2 "Zeitkonstante fuer Abgastemperaturmodell Bank2" CURVE 0xFCFDCA GklWUw 13106.800000 zk200msxs_uw_b13107 0.20000000000 13107.000000 FORMAT "%12.6"
 /begin AXIS_DESCR COM_AXIS ml_w m_uw_b6553p5 7 0.00 6553.500 FORMAT "%8.3" AXIS_PTS_REF SML07TMUW /end AXIS_DESCR
/end CHARACTERISTIC
/begin CHARACTERISTIC ZATMIKML "Zeitkonstante fuer Katalysatortemperaturmodell - Temperatur im Kat tikatm" CURVE 0xFCFDD8 GklWUw 13106.800000 zk200msxs_uw_b13107 0.20000000000 13107.000000 FORMAT "%12.6"
 /begin AXIS_DESCR COM_AXIS ml_w m_uw_b6553p5 7 0.00 6553.500 FORMAT "%8.3" AXIS_PTS_REF SML07TMUW /end AXIS_DESCR
/end CHARACTERISTIC
/begin CHARACTERISTIC ZATMIKML2 "Zeitkonstante fuer Katalysatortemperaturmodell - Temperatur im Kat Bank 2" CURVE 0xFCFDE6 GklWUw 13106.800000 zk200msxs_uw_b13107 0.20000000000 13107.000000 FORMAT "%12.6"
 /begin AXIS_DESCR COM_AXIS ml_w m_uw_b6553p5 7 0.00 6553.500 FORMAT "%8.3" AXIS_PTS_REF SML07TMUW /end AXIS_DESCR
/end CHARACTERISTIC
/begin CHARACTERISTIC ZATMKML "Zeitkonstante fuer Katalysatortemperaturmodell - Kat-Temperatur tkatm" CURVE 0xFCFDF4 GklWUw 13106.800000 zk200msxs_uw_b13107 0.20000000000 13107.000000 FORMAT "%12.6"
 /begin AXIS_DESCR COM_AXIS ml_w m_uw_b6553p5 7 0.00 6553.500 FORMAT "%8.3" AXIS_PTS_REF SML07TMUW /end AXIS_DESCR
/end CHARACTERISTIC
/begin CHARACTERISTIC ZATMKML2 "Zeitkonstante fuer Katalysatortemperaturmodell - Kat-Temperatur Bank2" CURVE 0xFCFE02 GklWUw 13106.800000 zk200msxs_uw_b13107 0.20000000000 13107.000000 FORMAT "%12.6"
 /begin AXIS_DESCR COM_AXIS ml_w m_uw_b6553p5 7 0.00 6553.500 FORMAT "%8.3" AXIS_PTS_REF SML07TMUW /end AXIS_DESCR
/end CHARACTERISTIC
/begin CHARACTERISTIC ZATMRML "Zeitkonstante fuer Abgastemperaturmodell - Rohrwandtemperatur" CURVE 0xFCFE10 GklWUw 13106.800000 zk200msxs_uw_b13107 0.20000000000 13107.000000 FORMAT "%12.6"
 /begin AXIS_DESCR COM_AXIS ml_w m_uw_b6553p5 7 0.00 6553.500 FORMAT "%8.3" AXIS_PTS_REF SML07TMUW /end AXIS_DESCR
/end CHARACTERISTIC
/begin CHARACTERISTIC ZATMRML2 "Zeitkonstante fuer Abgastemperaturmodell - Rohrwandtemperatur Bank2" CURVE 0xFCFE1E GklWUw 13106.800000 zk200msxs_uw_b13107 0.20000000000 13107.000000 FORMAT "%12.6"
 /begin AXIS_DESCR COM_AXIS ml_w m_uw_b6553p5 7 0.00 6553.500 FORMAT "%8.3" AXIS_PTS_REF SML07TMUW /end AXIS_DESCR
/end CHARACTERISTIC
/begin CHARACTERISTIC ZATMSAML "Zeitkonstante fuer Abgastemperaturmodell w‰hrend Schub" CURVE 0xFCFE2C KlAUwSstUwWUw 13106.800000 zk200msxs_uw_b13107 0.20000000000 13107.000000 FORMAT "%12.6"
 /begin AXIS_DESCR STD_AXIS ml_w m_uw_b6553p5 7 0.00 6553.500 FORMAT "%8.3" DEPOSIT ABSOLUTE /end AXIS_DESCR
/end CHARACTERISTIC
/begin CHARACTERISTIC ZATMSAML2 "Zeitkonstante fuer Abgastemperaturmodell w‰hrend Schub, Bank2" CURVE 0xFCFE4A KlAUwSstUwWUw 13106.800000 zk200msxs_uw_b13107 0.20000000000 13107.000000 FORMAT "%12.6"
 /begin AXIS_DESCR STD_AXIS ml_w m_uw_b6553p5 7 0.00 6553.500 FORMAT "%8.3" DEPOSIT ABSOLUTE /end AXIS_DESCR
/end CHARACTERISTIC
/begin CHARACTERISTIC ZKHABB "Zeitkonstante f¸r Abbruch-Tiefpass Katheizen" VALUE 0xFD2832 KwUb 25.4996 zk100msxs_ub_b25p5 0.100392 25.6000 FORMAT "%7.4" /end CHARACTERISTIC
/begin CHARACTERISTIC ZKIHAADP "Zeitkonstante zum lernen der HA-Adaption" VALUE 0xFC20A0 KwUw 13106.800000 zk200msxs_uw_b13107 0.20000000000 13107.000000 FORMAT "%12.6" /end CHARACTERISTIC
/begin CHARACTERISTIC ZKLAMKH "Zeitkonstante Lambda-Motor-Soll bei Katheizen" VALUE 0xFC8290 KwUw 655.34999985 zk10msxs_uw_b655 0.010000152590 655.36000000 FORMAT "%12.8" /end CHARACTERISTIC
/begin CHARACTERISTIC ZKNVQUOT "Zeitkonstante f¸r Filterung Drehzahl/Geschwindigkeits-Quotient" VALUE 0xFC20A2 KwUw 1310.6999997 zk20msxs_uw_b1310p72 0.020000305180 1310.7200000 FORMAT "%12.7" /end CHARACTERISTIC
/begin CHARACTERISTIC ZKUBDLR "DLR, Zeitkonstante f¸r Filterung von Ubatt" VALUE 0xFCFA3E KwUb 0.4980 fak_ub_b0p5 0.00 0.4980 /end CHARACTERISTIC
/begin CHARACTERISTIC ZKURU "Zeitkonstante Filterung Differenz nmot zu vfzg -Quotient" VALUE 0xFC20C6 KwUw 1309.9800107 zk20msxs_uw_b1310 0.019989318685 1310.0000000 FORMAT "%12.7" /end CHARACTERISTIC
/begin CHARACTERISTIC ZKWDKSPT1 "Zeitkonstante f¸r Pr‰diktion DK-Winkel aus Sollwert" VALUE 0xFC1EB7 KwUb 0.6973 fak_q0p00273 0.00 0.6973 /end CHARACTERISTIC
/begin MEASUREMENT abmf "Festeinspritzausblendmuster" UBYTE dez 1 100 0 255 FORMAT "%5.1" ECU_ADDRESS 0x403BBF /end MEASUREMENT
/begin MEASUREMENT abo "Anzahl Starts mit Benzin im ÷l" UBYTE dez 1 100 0 255 FORMAT "%5.1" ECU_ADDRESS 0x3FE171 /end MEASUREMENT
/begin MEASUREMENT AKRLokBits1 "" UBYTE dez 1 100 0 255 FORMAT "%5.1" ECU_ADDRESS 0x403708 /end MEASUREMENT
/begin MEASUREMENT ALEBits1_10msSwOff "" UBYTE dez 1 100 0 255 FORMAT "%5.1" ECU_ADDRESS 0x403882 /end MEASUREMENT
/begin MEASUREMENT ALEBits_10msSwOff "" UBYTE dez 1 100 0 255 FORMAT "%5.1" ECU_ADDRESS 0x3FE040 /end MEASUREMENT
/begin MEASUREMENT ALEBits_tooth_int "" UBYTE dez 1 100 0 255 FORMAT "%5.1" ECU_ADDRESS 0x403883 /end MEASUREMENT
/begin MEASUREMENT anzeab "Anzahl Segmente Ev-Abschaltung f¸r Notlauf Phasensuche" UBYTE dez 1 100 0 255 FORMAT "%5.1" ECU_ADDRESS 0x403BC0 /end MEASUREMENT
/begin MEASUREMENT anznmax "Anzahl NMAX-‹berschreitungen" UBYTE dez 1 100 0 255 FORMAT "%5.1" ECU_ADDRESS 0x3FE902 /end MEASUREMENT
/begin MEASUREMENT anzpbr_w "Anzahl Ereignisse PWG-Bremspedal Plausibilisierung" UWORD dez 1 100 0 65535 FORMAT "%8.2" ECU_ADDRESS 0x3FE91A /end MEASUREMENT
/begin MEASUREMENT AS_dimdk "" UBYTE B_TRUE 1 100 0 1 BIT_MASK 0x1 FORMAT "%13.11" ECU_ADDRESS 0x3FBF7F /end MEASUREMENT
/begin MEASUREMENT ATMbits "" UBYTE dez 1 100 0 255 FORMAT "%5.1" ECU_ADDRESS 0x3FE06A /end MEASUREMENT
/begin MEASUREMENT BBFGRlokBits "" UBYTE dez 1 100 0 255 FORMAT "%5.1" ECU_ADDRESS 0x403BB4 /end MEASUREMENT
/begin MEASUREMENT BBHWONOFbits "" UBYTE dez 1 100 0 255 FORMAT "%5.1" ECU_ADDRESS 0x3FE964 /end MEASUREMENT
/begin MEASUREMENT BBKHZlokBits "" UWORD dez 1 100 0 65535 FORMAT "%8.2" ECU_ADDRESS 0x402FEA /end MEASUREMENT
/begin MEASUREMENT bblowenctr "" UBYTE dez 1 100 0 255 FORMAT "%5.1" ECU_ADDRESS 0x3FCD32 /end MEASUREMENT
/begin MEASUREMENT bblowinctr "" UBYTE dez 1 100 0 255 FORMAT "%5.1" ECU_ADDRESS 0x3FCD33 /end MEASUREMENT
/begin MEASUREMENT bblowmactr "" UWORD dez 1 100 0 65535 FORMAT "%8.2" ECU_ADDRESS 0x3FCD30 /end MEASUREMENT
/begin MEASUREMENT bmlosctr_w "Z‰hler (Word) Neusynchronisationen durch L¸ckenverlust" UWORD dez 1 100 0 65535 FORMAT "%8.2" ECU_ADDRESS 0x3FE1A0 /end MEASUREMENT
/begin MEASUREMENT B_abor "Bedigung Anzahl Starts mit Benzin im ÷l f¸r reduzierte LRA" UBYTE B_TRUE 1 100 0 1 BIT_MASK 0x1 FORMAT "%13.11" ECU_ADDRESS 0x3FC0ED /end MEASUREMENT
/begin MEASUREMENT B_akr "Bedingung Abgasklappe mit Resonator" UBYTE B_TRUE 1 100 0 1 BIT_MASK 0x1 FORMAT "%13.11" ECU_ADDRESS 0x3FC37C /end MEASUREMENT
/begin MEASUREMENT B_akrtemp "" UBYTE B_TRUE 1 100 0 1 BIT_MASK 0x1 FORMAT "%13.11" ECU_ADDRESS 0x403708 /end MEASUREMENT
/begin MEASUREMENT B_ale "Bedingung Motorabstellposition erkannt" UBYTE B_TRUE 1 100 0 1 BIT_MASK 0x1 FORMAT "%13.11" ECU_ADDRESS 0x3FE040 /end MEASUREMENT
/begin MEASUREMENT B_alechk "Bedingung R¸ckdrehen erkannt" UBYTE B_TRUE 1 100 0 1 BIT_MASK 0x4 FORMAT "%13.11" ECU_ADDRESS 0x403883 /end MEASUREMENT
/begin MEASUREMENT B_aleundef "R¸ckdreherkennung im undefiniertem Bereich" UBYTE B_TRUE 1 100 0 1 FORMAT "%13.11" ECU_ADDRESS 0x3FE041 /end MEASUREMENT
/begin MEASUREMENT B_anskl "Bedingung Ansteuerung Ansaugklappe" UBYTE B_TRUE 1 100 0 1 BIT_MASK 0x1 FORMAT "%13.11" ECU_ADDRESS 0x3FC37A /end MEASUREMENT
/begin MEASUREMENT B_apnoluv "Verriegelungsbit: Applikationshilfe DK-Notluftfahren" UBYTE B_TRUE 1 100 0 1 BIT_MASK 0x1 FORMAT "%13.11" ECU_ADDRESS 0x3FBF80 /end MEASUREMENT
/begin MEASUREMENT B_appnolu "Bedingung: DK-Notluftfahren durch Applikation angefordert" UBYTE B_TRUE 1 100 0 1 BIT_MASK 0x1 FORMAT "%13.11" ECU_ADDRESS 0x3FBF81 /end MEASUREMENT
/begin MEASUREMENT B_ar "Antiruckeleingriff aktiv" UBYTE B_TRUE 1 100 0 1 BIT_MASK 0x1 FORMAT "%13.11" ECU_ADDRESS 0x3FC240 /end MEASUREMENT
/begin MEASUREMENT B_aren "Bedingung AR-Freigabe" UBYTE B_TRUE 1 100 0 1 BIT_MASK 0x1 FORMAT "%13.11" ECU_ADDRESS 0x3FC241 /end MEASUREMENT
/begin MEASUREMENT B_argf "Bedingung Gangfenster Antiruckel" UBYTE B_TRUE 1 100 0 1 BIT_MASK 0x1 FORMAT "%13.11" ECU_ADDRESS 0x3FC242 /end MEASUREMENT
/begin MEASUREMENT B_atbeg "Bedingung Abgastemperaturbegrenzung" UBYTE B_TRUE 1 100 0 1 FORMAT "%13.11" ECU_ADDRESS 0x4037BE /end MEASUREMENT
/begin MEASUREMENT B_atbegl "Bedingung Abgastemperaturbegrenzung aktiv (mit Lambdaregelung)" UBYTE B_TRUE 1 100 0 1 FORMAT "%13.11" ECU_ADDRESS 0x4038EE /end MEASUREMENT
/begin MEASUREMENT B_atmrtpk "Bedingung Integrator iwmatmk f¸r Taupunkt hinter Kat wird zur¸ckgesetzt" UBYTE B_TRUE 1 100 0 1 BIT_MASK 0x20 FORMAT "%13.11" ECU_ADDRESS 0x402990 /end MEASUREMENT
/begin MEASUREMENT B_atmrtpk2 "Bedingung Integrator iwmatmk f¸r Taupunkt hinter Kat wird zur¸ckgesetzt, Bank2" UBYTE B_TRUE 1 100 0 1 BIT_MASK 0x40 FORMAT "%13.11" ECU_ADDRESS 0x402990 /end MEASUREMENT
/begin MEASUREMENT B_atmst "Bedingung Startwert tabgmst,tkatmst berechnet" UBYTE B_TRUE 1 100 0 1 BIT_MASK 0x2 FORMAT "%13.11" ECU_ADDRESS 0x402990 /end MEASUREMENT
/begin MEASUREMENT B_atmst2 "Bedingung Startwert tabgmst, tkatmst berechnet Bank2" UBYTE B_TRUE 1 100 0 1 BIT_MASK 0x4 FORMAT "%13.11" ECU_ADDRESS 0x402990 /end MEASUREMENT
/begin MEASUREMENT B_atmtpa "Bedingung Taupunkt vor Kat ueberschritten" UBYTE B_TRUE 1 100 0 1 BIT_MASK 0x1 FORMAT "%13.11" ECU_ADDRESS 0x3FBFD3 /end MEASUREMENT
/begin MEASUREMENT B_atmtpa2 "Bedingung Taupunkt2 vor Kat ueberschritten" UBYTE B_TRUE 1 100 0 1 BIT_MASK 0x1 FORMAT "%13.11" ECU_ADDRESS 0x3FBFD4 /end MEASUREMENT
/begin MEASUREMENT B_atmtpf "Bedingung Taupunkt vor Kat ¸berschritten (last trip)" UBYTE B_TRUE 1 100 0 1 BIT_MASK 0x4 FORMAT "%13.11" ECU_ADDRESS 0x3FE06A /end MEASUREMENT
/begin MEASUREMENT B_atmtpf2 "Bedingung Taupunkt vor Kat ¸berschritten (last trip) Bank2" UBYTE B_TRUE 1 100 0 1 BIT_MASK 0x8 FORMAT "%13.11" ECU_ADDRESS 0x3FE06A /end MEASUREMENT
/begin MEASUREMENT B_atmtpk "Bedingung Taupunkt hinter Kat ueberschritten" UBYTE B_TRUE 1 100 0 1 BIT_MASK 0x1 FORMAT "%13.11" ECU_ADDRESS 0x3FBFD5 /end MEASUREMENT
/begin MEASUREMENT B_atmtpk2 "Bedingung Taupunkt2 hinter Kat ueberschritten" UBYTE B_TRUE 1 100 0 1 BIT_MASK 0x1 FORMAT "%13.11" ECU_ADDRESS 0x3FBFD6 /end MEASUREMENT
/begin MEASUREMENT B_atmtpl "Bedingung Taupunkt hinter Kat ¸berschritten (last trip)" UBYTE B_TRUE 1 100 0 1 BIT_MASK 0x1 FORMAT "%13.11" ECU_ADDRESS 0x3FE06A /end MEASUREMENT
/begin MEASUREMENT B_atmtpl2 "Bedingung Taupunkt hinter Kat ¸berschritten (last trip) Bank2" UBYTE B_TRUE 1 100 0 1 BIT_MASK 0x2 FORMAT "%13.11" ECU_ADDRESS 0x3FE06A /end MEASUREMENT
/begin MEASUREMENT B_dcdisfr "Bedingung: Disable DV-E-Endstufe durch den Funktionsrechner" UBYTE B_TRUE 1 100 0 1 BIT_MASK 0x1 FORMAT "%13.11" ECU_ADDRESS 0x3FBF82 /end MEASUREMENT
/begin MEASUREMENT B_dkbew "Bedingung: DK hat sich bewegt" UBYTE B_TRUE 1 100 0 1 BIT_MASK 0x1 FORMAT "%13.11" ECU_ADDRESS 0x3FBF83 /end MEASUREMENT
/begin MEASUREMENT B_dkuevab "Bedingung Ev-Abschaltung bei unplausibler DK" UBYTE B_TRUE 1 100 0 1 BIT_MASK 0x1 FORMAT "%13.11" ECU_ADDRESS 0x3FC080 /end MEASUREMENT
/begin MEASUREMENT B_dlrbe "Bedingung: DLR-Stellbereich wurde ¸berschritten" UBYTE B_TRUE 1 100 0 1 BIT_MASK 0x1 FORMAT "%13.11" ECU_ADDRESS 0x3FBF84 /end MEASUREMENT
/begin MEASUREMENT B_dlrikla "Bedingung: DLR, I-Klein aktiv" UBYTE B_TRUE 1 100 0 1 BIT_MASK 0x1 FORMAT "%13.11" ECU_ADDRESS 0x3FBF85 /end MEASUREMENT
/begin MEASUREMENT B_dlriklst "Bedingung: Erster Durchlauf I-Klein nach Start" UBYTE B_TRUE 1 100 0 1 BIT_MASK 0x1 FORMAT "%13.11" ECU_ADDRESS 0x3FBF86 /end MEASUREMENT
/begin MEASUREMENT B_dlrparc "Bedingung: Sollgrˆﬂensprung steht an" UBYTE B_TRUE 1 100 0 1 BIT_MASK 0x1 FORMAT "%13.11" ECU_ADDRESS 0x3FBF87 /end MEASUREMENT
/begin MEASUREMENT B_dlrpide "Bedingung: Fehler, DLR-Stellbereich am Anschlag" UBYTE B_TRUE 1 100 0 1 BIT_MASK 0x1 FORMAT "%13.11" ECU_ADDRESS 0x3FBF88 /end MEASUREMENT
/begin MEASUREMENT B_dlrspid "Bedingung: DLR, Vorzeichen der Summe der PID-Anteile, =1: positiv, =0: negativ" UBYTE B_TRUE 1 100 0 1 BIT_MASK 0x1 FORMAT "%13.11" ECU_ADDRESS 0x3FBF89 /end MEASUREMENT
/begin MEASUREMENT B_dlrumzu "Bedingung: NLP-Umladen zugelassen" UBYTE B_TRUE 1 100 0 1 BIT_MASK 0x1 FORMAT "%13.11" ECU_ADDRESS 0x3FBF8A /end MEASUREMENT
/begin MEASUREMENT B_dmdstop "Ev-Abschaltung aktiv --> Aussetzerekennung sperren" UBYTE B_TRUE 1 100 0 1 BIT_MASK 0x1 FORMAT "%13.11" ECU_ADDRESS 0x3FC07B /end MEASUREMENT
/begin MEASUREMENT B_dveese "Bedingung: DV-E-Endstufen-Fehler" UBYTE B_TRUE 1 100 0 1 BIT_MASK 0x1 FORMAT "%13.11" ECU_ADDRESS 0x3FBF8B /end MEASUREMENT
/begin MEASUREMENT B_dveesh "Bedingung: DV-E-Enstufen-Heilung" UBYTE B_TRUE 1 100 0 1 BIT_MASK 0x1 FORMAT "%13.11" ECU_ADDRESS 0x3FBF8C /end MEASUREMENT
/begin MEASUREMENT B_dvete "Bedingung: Erweiterte Stellertauscherkennung" UBYTE B_TRUE 1 100 0 1 BIT_MASK 0x1 FORMAT "%13.11" ECU_ADDRESS 0x3FBF8D /end MEASUREMENT
/begin MEASUREMENT B_eepwf "Bedingung Powerfail EEPROM" UBYTE B_TRUE 1 100 0 1 BIT_MASK 0x1 FORMAT "%13.11" ECU_ADDRESS 0x3FC331 /end MEASUREMENT
/begin MEASUREMENT B_ekp "Freigabe der EKP-Versorgung" UBYTE B_TRUE 1 100 0 1 BIT_MASK 0x1 FORMAT "%13.11" ECU_ADDRESS 0x3FC37B /end MEASUREMENT
/begin MEASUREMENT B_ekpd "Bedingung EKP Dauerbetrieb" UBYTE B_TRUE 1 100 0 1 BIT_MASK 0x1 FORMAT "%13.11" ECU_ADDRESS 0x403D51 /end MEASUREMENT
/begin MEASUREMENT B_ekps "Bedingung schnelle Aktivierung der EKP beim Start" UBYTE B_TRUE 1 100 0 1 BIT_MASK 0x1 FORMAT "%13.11" ECU_ADDRESS 0x403D52 /end MEASUREMENT
/begin MEASUREMENT B_ekpsl "Bedingung schneller EKP-Vorlauf gesperrt" UBYTE B_TRUE 1 100 0 1 BIT_MASK 0x2 FORMAT "%13.11" ECU_ADDRESS 0x403D52 /end MEASUREMENT
/begin MEASUREMENT B_ekpvl "Bedingung EKP-Vorlauf" UBYTE B_TRUE 1 100 0 1 BIT_MASK 0x2 FORMAT "%13.11" ECU_ADDRESS 0x403D51 /end MEASUREMENT
/begin MEASUREMENT B_ekpvla "Bedingung EKP Vorlauf angefordert" UBYTE B_TRUE 1 100 0 1 BIT_MASK 0x4 FORMAT "%13.11" ECU_ADDRESS 0x403D51 /end MEASUREMENT
/begin MEASUREMENT B_enabale "Bedingung: Freigabe zur Berechnung der Motorabstellposition" UBYTE B_TRUE 1 100 0 1 FORMAT "%13.11" ECU_ADDRESS 0x403884 /end MEASUREMENT
/begin MEASUREMENT B_enabint "Bedingung Zahninterrupt f¸r ALE aktiviert" UBYTE B_TRUE 1 100 0 1 FORMAT "%13.11" ECU_ADDRESS 0x403885 /end MEASUREMENT
/begin MEASUREMENT B_engstop "Bedingung Motor steht l‰nger als 100ms" UBYTE B_TRUE 1 100 0 1 BIT_MASK 0x4 FORMAT "%13.11" ECU_ADDRESS 0x403882 /end MEASUREMENT
/begin MEASUREMENT B_evabu "Bedingung Ev-Abschaltung durch ‹berwachungsfunktionen" UBYTE B_TRUE 1 100 0 1 BIT_MASK 0x1 FORMAT "%13.11" ECU_ADDRESS 0x3FC081 /end MEASUREMENT
/begin MEASUREMENT B_evasel "Status alle f¸r DASE relevant. lokalen Einspritzventile d. SG werden angesteuert" UBYTE B_TRUE 1 100 0 1 BIT_MASK 0x1 FORMAT "%13.11" ECU_ADDRESS 0x3FC083 /end MEASUREMENT
/begin MEASUREMENT B_fbm "Bedingung Bezugsmarkenfehler => mindestens 1 Zahn zuviel oder zuwenig erkannt" UBYTE B_TRUE 1 100 0 1 BIT_MASK 0x1 FORMAT "%13.11" ECU_ADDRESS 0x3FC110 /end MEASUREMENT
/begin MEASUREMENT B_fbstabgm "Bedingung: Faktor Bauteileschutz ¸ber Abgastemperaturmodell" UBYTE B_TRUE 1 100 0 1 FORMAT "%13.11" ECU_ADDRESS 0x4037BF /end MEASUREMENT
/begin MEASUREMENT B_fgrab "FGR-/ACC-Abschaltung aus der Funktion" UBYTE B_TRUE 1 100 0 1 BIT_MASK 0x1 FORMAT "%13.11" ECU_ADDRESS 0x3FC054 /end MEASUREMENT
/begin MEASUREMENT B_fgraext "Bedingung: FGR-Abschaltung durch externe Anforderung ASC/DSC" UBYTE B_TRUE 1 100 0 1 BIT_MASK 0x8 FORMAT "%13.11" ECU_ADDRESS 0x403BB4 /end MEASUREMENT
/begin MEASUREMENT B_fgrai "Bedingung FGR-Abschaltung irreversibel" UBYTE B_TRUE 1 100 0 1 BIT_MASK 0x1 FORMAT "%13.11" ECU_ADDRESS 0x3FC055 /end MEASUREMENT
/begin MEASUREMENT B_fgral "Bedingung FGR-Abschaltung langsam" UBYTE B_TRUE 1 100 0 1 BIT_MASK 0x1 FORMAT "%13.11" ECU_ADDRESS 0x3FC056 /end MEASUREMENT
/begin MEASUREMENT B_fgrars "Bedingung: FGR-Abschaltung reversibel schnell" UBYTE B_TRUE 1 100 0 1 BIT_MASK 0x2 FORMAT "%13.11" ECU_ADDRESS 0x403BB4 /end MEASUREMENT
/begin MEASUREMENT B_fgras "Bedingung: FGR-Abschaltung schnell" UBYTE B_TRUE 1 100 0 1 BIT_MASK 0x1 FORMAT "%13.11" ECU_ADDRESS 0x3FC057 /end MEASUREMENT
/begin MEASUREMENT B_fgrenv "Bedingung FGR-Regelung aktiv (Enable) vorl‰ufig" UBYTE B_TRUE 1 100 0 1 BIT_MASK 0x1 FORMAT "%13.11" ECU_ADDRESS 0x3FC058 /end MEASUREMENT
/begin MEASUREMENT B_fgres "Bedingung FGR-Einschaltung" UBYTE B_TRUE 1 100 0 1 BIT_MASK 0x4 FORMAT "%13.11" ECU_ADDRESS 0x403BB4 /end MEASUREMENT
/begin MEASUREMENT B_fgresv "Bedingung FGR-Einschaltgeschwindigkeit erreicht" UBYTE B_TRUE 1 100 0 1 BIT_MASK 0x1 FORMAT "%13.11" ECU_ADDRESS 0x3FC059 /end MEASUREMENT
/begin MEASUREMENT B_fophsnl "Evabschaltung ¸ber feste Abschaltmuster ohne Notlauf Phasensuche" UBYTE B_TRUE 1 100 0 1 BIT_MASK 0x1 FORMAT "%13.11" ECU_ADDRESS 0x3FC07C /end MEASUREMENT
/begin MEASUREMENT B_frdph "Bed. Transition 'to_Fixred' aktiviert durch Notlauf-Phasensuche" UBYTE B_TRUE 1 100 0 1 BIT_MASK 0x1 FORMAT "%13.11" ECU_ADDRESS 0x3FC07D /end MEASUREMENT
/begin MEASUREMENT B_gangsl "Bedingung Schlupf erkannt" UBYTE B_TRUE 1 100 0 1 BIT_MASK 0x1 FORMAT "%13.11" ECU_ADDRESS 0x3FC243 /end MEASUREMENT
/begin MEASUREMENT B_gfen "Bedingung Gangfenster" UBYTE B_TRUE 1 100 0 1 BIT_MASK 0x1 FORMAT "%13.11" ECU_ADDRESS 0x3FC244 /end MEASUREMENT
/begin MEASUREMENT B_gwhs "Bedingung Gangwechsel bei Handschalter" UBYTE B_TRUE 1 100 0 1 BIT_MASK 0x1 FORMAT "%13.11" ECU_ADDRESS 0x3FC025 /end MEASUREMENT
/begin MEASUREMENT B_hpnmot "Bedingung Hochpunkt Drehzahlschwingung" UBYTE B_TRUE 1 100 0 1 BIT_MASK 0x1 FORMAT "%13.11" ECU_ADDRESS 0x3FC245 /end MEASUREMENT
/begin MEASUREMENT B_hrlsaus "Bedingung Ausschalten der Heizungsregelung" UBYTE B_TRUE 1 100 0 1 BIT_MASK 0x1 FORMAT "%13.11" ECU_ADDRESS 0x3FBFD2 /end MEASUREMENT
/begin MEASUREMENT B_hwpwf "Bedingung Neuinitialisierung NVRAM durch Datenverlust im NVRAM" UBYTE B_TRUE 1 100 0 1 BIT_MASK 0x1 FORMAT "%13.11" ECU_ADDRESS 0x403808 /end MEASUREMENT
/begin MEASUREMENT B_iklrest "Bedingung: Retriggerung I-Klein" UBYTE B_TRUE 1 100 0 1 BIT_MASK 0x1 FORMAT "%13.11" ECU_ADDRESS 0x3FBF8E /end MEASUREMENT
/begin MEASUREMENT B_iklstar "Bedingung: I-Klein soll starten" UBYTE B_TRUE 1 100 0 1 BIT_MASK 0x1 FORMAT "%13.11" ECU_ADDRESS 0x3FBF8F /end MEASUREMENT
/begin MEASUREMENT B_imlprini "Initialisierung imlpr/imlpr_w" UWORD B_TRUE 1 100 0 1 BIT_MASK 0x200 FORMAT "%13.11" ECU_ADDRESS 0x402FEA /end MEASUREMENT
/begin MEASUREMENT B_iniar "Bedingung Initialisierung der AR-Funktion" UBYTE B_TRUE 1 100 0 1 BIT_MASK 0x1 FORMAT "%13.11" ECU_ADDRESS 0x3FC246 /end MEASUREMENT
/begin MEASUREMENT B_iniar1 "Bedingung Initialisierung ARMD vorl‰ufig" UBYTE B_TRUE 1 100 0 1 BIT_MASK 0x1 FORMAT "%13.11" ECU_ADDRESS 0x3FC247 /end MEASUREMENT
/begin MEASUREMENT B_iniarv "Bedingung Initialisierung der Filterfunktion verzˆgert" UBYTE B_TRUE 1 100 0 1 BIT_MASK 0x1 FORMAT "%13.11" ECU_ADDRESS 0x3FC248 /end MEASUREMENT
/begin MEASUREMENT B_kd "Bedingung Kick-Down" UBYTE B_TRUE 1 100 0 1 BIT_MASK 0x1 FORMAT "%13.11" ECU_ADDRESS 0x3FC026 /end MEASUREMENT
/begin MEASUREMENT B_kh "Bedingung Kat-Heizung" UBYTE B_TRUE 1 100 0 1 BIT_MASK 0x1 FORMAT "%13.11" ECU_ADDRESS 0x3FC199 /end MEASUREMENT
/begin MEASUREMENT B_kha "Anforderung Katheizen" UBYTE B_TRUE 1 100 0 1 BIT_MASK 0x1 FORMAT "%13.11" ECU_ADDRESS 0x3FC19A /end MEASUREMENT
/begin MEASUREMENT B_khab "Bedingung Katheizen Abbruch" UBYTE B_TRUE 1 100 0 1 BIT_MASK 0x1 FORMAT "%13.11" ECU_ADDRESS 0x3FC19B /end MEASUREMENT
/begin MEASUREMENT B_khares "Bedingung R¸cksetzen von Bit B_kha" UWORD B_TRUE 1 100 0 1 BIT_MASK 0x40 FORMAT "%13.11" ECU_ADDRESS 0x402FEA /end MEASUREMENT
/begin MEASUREMENT B_khaset "Bedingung Setzen von Bit B_kha" UWORD B_TRUE 1 100 0 1 BIT_MASK 0x20 FORMAT "%13.11" ECU_ADDRESS 0x402FEA /end MEASUREMENT
/begin MEASUREMENT B_kherr "Fehler bedingte Sperrbedingung f¸r Bit B_kh" UWORD B_TRUE 1 100 0 1 BIT_MASK 0x100 FORMAT "%13.11" ECU_ADDRESS 0x402FEA /end MEASUREMENT
/begin MEASUREMENT B_khll "Bedingung Katheizen Leerlauf (Abbruchbedingung)" UWORD B_TRUE 1 100 0 1 BIT_MASK 0x4 FORMAT "%13.11" ECU_ADDRESS 0x402FEA /end MEASUREMENT
/begin MEASUREMENT B_khlle "Bedingung Leerlauf w‰hrend Katheizen verlassen" UWORD B_TRUE 1 100 0 1 BIT_MASK 0x1 FORMAT "%13.11" ECU_ADDRESS 0x402FEA /end MEASUREMENT
/begin MEASUREMENT B_khllmx "Bedingung max. Katheitzeit im Leerlauf erreicht" UWORD B_TRUE 1 100 0 1 BIT_MASK 0x2 FORMAT "%13.11" ECU_ADDRESS 0x402FEA /end MEASUREMENT
/begin MEASUREMENT B_khn "Bedingung Katheiz-Drehzahl" UBYTE B_TRUE 1 100 0 1 BIT_MASK 0x1 FORMAT "%13.11" ECU_ADDRESS 0x3FC19C /end MEASUREMENT
/begin MEASUREMENT B_khno "" UBYTE B_TRUE 1 100 0 1 BIT_MASK 0x1 FORMAT "%13.11" ECU_ADDRESS 0x3FC19D /end MEASUREMENT
/begin MEASUREMENT B_khres "Bedingung R¸cksetzen von Bit B_kh" UWORD B_TRUE 1 100 0 1 BIT_MASK 0x10 FORMAT "%13.11" ECU_ADDRESS 0x402FEA /end MEASUREMENT
/begin MEASUREMENT B_khset "Bedingung Setzen von Bit B_kh" UWORD B_TRUE 1 100 0 1 BIT_MASK 0x8 FORMAT "%13.11" ECU_ADDRESS 0x402FEA /end MEASUREMENT
/begin MEASUREMENT B_khstc "von Temperaturen oder Abstellzeit abh‰ngige Freigabe Kat-Heizen" UWORD B_TRUE 1 100 0 1 BIT_MASK 0x400 FORMAT "%13.11" ECU_ADDRESS 0x402FEA /end MEASUREMENT
/begin MEASUREMENT B_kupgw "Bedingung Kupplung bet‰tigt bis erkannter Gangwechsel" UBYTE B_TRUE 1 100 0 1 BIT_MASK 0x1 FORMAT "%13.11" ECU_ADDRESS 0x3FC249 /end MEASUREMENT
/begin MEASUREMENT B_kupplar "Bedingung Kupplung bet‰tigt (Kupplungsschalter oder aus Modell)" UBYTE B_TRUE 1 100 0 1 BIT_MASK 0x1 FORMAT "%13.11" ECU_ADDRESS 0x3FC24A /end MEASUREMENT
/begin MEASUREMENT B_kurn "Bedingung Kupplung rutscht negativ" UBYTE B_TRUE 1 100 0 1 BIT_MASK 0x1 FORMAT "%13.11" ECU_ADDRESS 0x3FC027 /end MEASUREMENT
/begin MEASUREMENT B_kurp "Bedingung Kupplung rutscht positiv" UBYTE B_TRUE 1 100 0 1 BIT_MASK 0x1 FORMAT "%13.11" ECU_ADDRESS 0x3FC028 /end MEASUREMENT
/begin MEASUREMENT B_kw "Bedingung Kat warmhalten" UBYTE B_TRUE 1 100 0 1 BIT_MASK 0x1 FORMAT "%13.11" ECU_ADDRESS 0x3FC19E /end MEASUREMENT
/begin MEASUREMENT B_mlsu "Bedingung mslu nicht grˆﬂer 0" UWORD B_TRUE 1 100 0 1 BIT_MASK 0x80 FORMAT "%13.11" ECU_ADDRESS 0x402FEA /end MEASUREMENT
/begin MEASUREMENT B_msmntpk "Massenstrom kleiner als Schwellwert NRKTPKTU, Verzˆgerung von B_atmtpk" UBYTE B_TRUE 1 100 0 1 BIT_MASK 0x8 FORMAT "%13.11" ECU_ADDRESS 0x402990 /end MEASUREMENT
/begin MEASUREMENT B_msmntpk2 "Massenstrom kleiner als Schwellwert NRKTPKTU, Verzˆgerung von B_atmtpk, Bank2" UBYTE B_TRUE 1 100 0 1 BIT_MASK 0x10 FORMAT "%13.11" ECU_ADDRESS 0x402990 /end MEASUREMENT
/begin MEASUREMENT B_nlphea "Ev-Abschaltung f¸r Notlauf Phasensynchronisation aktiv" UBYTE B_TRUE 1 100 0 1 BIT_MASK 0x1 FORMAT "%13.11" ECU_ADDRESS 0x3FC07E /end MEASUREMENT
/begin MEASUREMENT B_nlpheai "Ev-Abschaltung f¸r Notlauf Phasensynchronisation aktiv AEVAB intern" UBYTE B_TRUE 1 100 0 1 BIT_MASK 0x1 FORMAT "%13.11" ECU_ADDRESS 0x3FC07F /end MEASUREMENT
/begin MEASUREMENT B_nlpne "Bedingung: Bei gefordertem DK-Notluftfahren wurde NLP nicht erreicht" UBYTE B_TRUE 1 100 0 1 BIT_MASK 0x1 FORMAT "%13.11" ECU_ADDRESS 0x3FBF90 /end MEASUREMENT
/begin MEASUREMENT B_nocampos "Position der Nockenwelle konnte nicht ermittelt werden" UBYTE B_TRUE 1 100 0 1 BIT_MASK 0x1 FORMAT "%13.11" ECU_ADDRESS 0x3FC111 /end MEASUREMENT
/begin MEASUREMENT B_outofsyn "Nockenwellenposition ausserhalb des zul‰ssigen Synchronisationsbereichs" UBYTE B_TRUE 1 100 0 1 BIT_MASK 0x1 FORMAT "%13.11" ECU_ADDRESS 0x3FC112 /end MEASUREMENT
/begin MEASUREMENT B_pwf "Bedingung Powerfail" UBYTE B_TRUE 1 100 0 1 BIT_MASK 0x1 FORMAT "%13.11" ECU_ADDRESS 0x3FC332 /end MEASUREMENT
/begin MEASUREMENT B_pwfPat "Bedingung Neuinitialisierung NVRAM angefordert durch SW" UBYTE B_TRUE 1 100 0 1 BIT_MASK 0x1 FORMAT "%13.11" ECU_ADDRESS 0x403809 /end MEASUREMENT
/begin MEASUREMENT B_pwrsv "Bedingung: DV-E-powersave ist aktiv" UBYTE B_TRUE 1 100 0 1 BIT_MASK 0x1 FORMAT "%13.11" ECU_ADDRESS 0x3FBF91 /end MEASUREMENT
/begin MEASUREMENT B_ralectr "Bedingung letzte Zahnzeit > TRD" UBYTE B_TRUE 1 100 0 1 FORMAT "%13.11" ECU_ADDRESS 0x403886 /end MEASUREMENT
/begin MEASUREMENT B_raleok "Bedingung letzter Zahn liegt im plausiblen R¸ckdrehbereich" UBYTE B_TRUE 1 100 0 1 FORMAT "%13.11" ECU_ADDRESS 0x403887 /end MEASUREMENT
/begin MEASUREMENT B_recRes5v "Bedingung Recovery nach vorangegangenem 5V-Reset" UBYTE B_TRUE 1 100 0 1 BIT_MASK 0x1 FORMAT "%13.11" ECU_ADDRESS 0x3FCD34 /end MEASUREMENT
/begin MEASUREMENT B_recSta "Bedingung Starter ansteuern nach vorangegangenem 5V-Reset" UBYTE B_TRUE 1 100 0 1 BIT_MASK 0x1 FORMAT "%13.11" ECU_ADDRESS 0x3FCD35 /end MEASUREMENT
/begin MEASUREMENT B_restore "Wiederherstellung von NVRAM aus Flash angefordert" UBYTE B_TRUE 1 100 0 1 BIT_MASK 0x1 FORMAT "%13.11" ECU_ADDRESS 0x40380A /end MEASUREMENT
/begin MEASUREMENT B_restoreok "" UBYTE B_TRUE 1 100 0 1 BIT_MASK 0x1 FORMAT "%13.11" ECU_ADDRESS 0x40380B /end MEASUREMENT
/begin MEASUREMENT B_rqnvrbup "Bedingung NVRAM-Backup-Request" UBYTE B_TRUE 1 100 0 1 BIT_MASK 0x1 FORMAT "%13.11" ECU_ADDRESS 0x3FE964 /end MEASUREMENT
/begin MEASUREMENT B_rrdet "Bedingung R¸ckdrehen erkannt" UBYTE B_TRUE 1 100 0 1 BIT_MASK 0x8 FORMAT "%13.11" ECU_ADDRESS 0x403883 /end MEASUREMENT
/begin MEASUREMENT B_skaevab "Bedingung Ev-Abschaltung durch Sicherheitskraftstoffabschaltung aktiv" UBYTE B_TRUE 1 100 0 1 BIT_MASK 0x1 FORMAT "%13.11" ECU_ADDRESS 0x3FC082 /end MEASUREMENT
/begin MEASUREMENT B_stndnl "Bedingung Beginn SG-Nachlauf oder Startende (1->0)" UBYTE B_TRUE 1 100 0 1 BIT_MASK 0x1 FORMAT "%13.11" ECU_ADDRESS 0x402990 /end MEASUREMENT
/begin MEASUREMENT B_strtint "Bedingung Start Zahninterrupt (Initialisierung)" SBYTE B_TRUE 1 100 0 1 FORMAT "%13.11" ECU_ADDRESS 0x403888 /end MEASUREMENT
/begin MEASUREMENT B_strtswof "Bedingung Nachlaufphase beginnt" UBYTE B_TRUE 1 100 0 1 FORMAT "%13.11" ECU_ADDRESS 0x403889 /end MEASUREMENT
/begin MEASUREMENT B_tabgatb "Bedingung Abgastemperatur f¸r Bauteileschutz ¸berschritten" UBYTE B_TRUE 1 100 0 1 FORMAT "%13.11" ECU_ADDRESS 0x4038EF /end MEASUREMENT
/begin MEASUREMENT B_tevtstp "Bedingung Stop f¸r TEV Timer" UBYTE B_TRUE 1 100 0 1 BIT_MASK 0x1 FORMAT "%13.11" ECU_ADDRESS 0x3FC33F /end MEASUREMENT
/begin MEASUREMENT B_tikatatb "" UBYTE B_TRUE 1 100 0 1 FORMAT "%13.11" ECU_ADDRESS 0x4038F0 /end MEASUREMENT
/begin MEASUREMENT B_tkatatb "Bedingung Katalysatortemperatur f¸r Bauteileschutz ¸berschritten" UBYTE B_TRUE 1 100 0 1 FORMAT "%13.11" ECU_ADDRESS 0x4038F1 /end MEASUREMENT
/begin MEASUREMENT B_tooth "Bedingung Zahnerkennung" UBYTE B_TRUE 1 100 0 1 BIT_MASK 0x4 FORMAT "%13.11" ECU_ADDRESS 0x403D52 /end MEASUREMENT
/begin MEASUREMENT B_tpnmot "Bedingung Tiefpunkt Drehzahlschwingung" UBYTE B_TRUE 1 100 0 1 BIT_MASK 0x1 FORMAT "%13.11" ECU_ADDRESS 0x3FC24B /end MEASUREMENT
/begin MEASUREMENT B_trkh "Bedingung Katheizen, Thermoreaktor wirksam" UBYTE B_TRUE 1 100 0 1 BIT_MASK 0x1 FORMAT "%13.11" ECU_ADDRESS 0x3FC19F /end MEASUREMENT
/begin MEASUREMENT B_ubdve "Bedingung: Batteriespannung f¸r DV-E-Ansteuerung i.O." UBYTE B_TRUE 1 100 0 1 BIT_MASK 0x1 FORMAT "%13.11" ECU_ADDRESS 0x3FBF92 /end MEASUREMENT
/begin MEASUREMENT B_ubpvg "Bedingung Batteriespannung ausreichend f¸r 5V-Potiversorgung" UBYTE B_TRUE 1 100 0 1 BIT_MASK 0x1 FORMAT "%13.11" ECU_ADDRESS 0x3FBF93 /end MEASUREMENT
/begin MEASUREMENT B_ub_ok "Batteriespannung o.k." UBYTE B_TRUE 1 100 0 1 BIT_MASK 0x1 FORMAT "%13.11" ECU_ADDRESS 0x3FBF94 /end MEASUREMENT
/begin MEASUREMENT B_undef "Bedingung R¸ckdreherkennung im undef. Bereich (Zwischenspeicher)" UBYTE B_TRUE 1 100 0 1 FORMAT "%13.11" ECU_ADDRESS 0x40388A /end MEASUREMENT
/begin MEASUREMENT B_wdapwf "Bedingung Neuinitialisierung NVRAM angefordert nach WDA-Abschaltung" UBYTE B_TRUE 1 100 0 1 BIT_MASK 0x1 FORMAT "%13.11" ECU_ADDRESS 0x3FCD36 /end MEASUREMENT
/begin MEASUREMENT B_wdksauf "Bedingung: DLR, Sollsprung in Richtung AUF" UBYTE B_TRUE 1 100 0 1 BIT_MASK 0x1 FORMAT "%13.11" ECU_ADDRESS 0x3FBF95 /end MEASUREMENT
/begin MEASUREMENT B_wdksive "Bedingung: Fehler im Vergleich DK-Winkel-Sollwert/-Istwert" UBYTE B_TRUE 1 100 0 1 BIT_MASK 0x1 FORMAT "%13.11" ECU_ADDRESS 0x3FBF96 /end MEASUREMENT
/begin MEASUREMENT CO_GAP "Winkel zur L¸ckenkorrekturerkennung" UWORD kw_q0p1 1 100 0 1440 FORMAT "%8.3" ECU_ADDRESS 0x40440A /end MEASUREMENT
/begin MEASUREMENT CO_WAS "Winkel zur L¸ckenerkennung" UWORD kw_q0p1 1 100 0 720 FORMAT "%8.4" ECU_ADDRESS 0x40440C /end MEASUREMENT
/begin MEASUREMENT CO_WNBM "Winkel pro Zahn" UBYTE kw_q0p1 1 100 0 25.5 FORMAT "%5.2" ECU_ADDRESS 0x40388B /end MEASUREMENT
/begin MEASUREMENT dekpub "Differenz der Batteriespannung zwischen zwei Messungen bis EKP-Dauerbetrieb" UBYTE spg_q0p1 1 100 0 25.5 FORMAT "%5.2" ECU_ADDRESS 0x403704 /end MEASUREMENT
/begin MEASUREMENT Disa_spg "DISA Spannung" UWORD spg_uw_b5 1 100 0 319.995 FORMAT "%8.4" ECU_ADDRESS 0x403D88 /end MEASUREMENT
/begin MEASUREMENT dklagerc "Fehlerz‰hler DK-Lage¸berwachung" UBYTE t20msxs_ub_b5p1 1 100 0 5.1 FORMAT "%5.3" ECU_ADDRESS 0x403B36 /end MEASUREMENT
/begin MEASUREMENT dlatb2_w "Delta Lambda f¸r Bauteileschutz f¸r Bank 2, gefiltert" UWORD fak_uw_b2 1 100 0 1.99997 FORMAT "%8.6" ECU_ADDRESS 0x404640 /end MEASUREMENT
/begin MEASUREMENT dlatbnf2_w "Delta Lambda f¸r Bauteileschutz f¸r Bank 2, ungefiltert" UWORD fak_uw_b2 1 100 0 1.99997 FORMAT "%8.6" ECU_ADDRESS 0x404642 /end MEASUREMENT
/begin MEASUREMENT dlatbnf_w "Delta Lambda f¸r Bauteileschutz f¸r Bank 1, ungefiltert" UWORD fak_uw_b2 1 100 0 1.99997 FORMAT "%8.6" ECU_ADDRESS 0x404644 /end MEASUREMENT
/begin MEASUREMENT dlatb_w "Delta Lambda f¸r Bauteileschutz f¸r Bank 1, gefiltert" UWORD fak_uw_b2 1 100 0 1.99997 FORMAT "%8.6" ECU_ADDRESS 0x404646 /end MEASUREMENT
/begin MEASUREMENT dlrd "DLR, D-Parameter" UBYTE relDK_q4 1 100 0 1020 FORMAT "%5.0" ECU_ADDRESS 0x3FC3A5 /end MEASUREMENT
/begin MEASUREMENT dlrhaftak "Zeitz‰hler Haftreibungsroutine" SWORD rel_q0p1957 1 100 -6412.52 6412.33 FORMAT "%8.3" ECU_ADDRESS 0x402988 /end MEASUREMENT
/begin MEASUREMENT dlri "DLR, I-Parameter" UBYTE relDK_q0p0625 1 100 0 15.9375 FORMAT "%5.2" ECU_ADDRESS 0x3FC3A6 /end MEASUREMENT
/begin MEASUREMENT dlriamax "DLR, maximal mˆglicher I-Anteil" UWORD rel_q0p1957 1 100 0 12824.9 FORMAT "%8.2" ECU_ADDRESS 0x3FC3E6 /end MEASUREMENT
/begin MEASUREMENT dlriant_w "DLR, I-Anteil, highword von dlriant_l" SWORD rel_sw_q0p1953 1 100 -6400 6399.8 FORMAT "%8.3" ECU_ADDRESS 0x403DC8 /end MEASUREMENT
/begin MEASUREMENT dlrihaftc "DLR, Z‰hler f¸r DV-E in Haftreibung" UBYTE t50msxs_q0p05 1 100 0 12.75 FORMAT "%5.2" ECU_ADDRESS 0x402986 /end MEASUREMENT
/begin MEASUREMENT dlriklst_w "Vorladewert I-Kleinanteil" SWORD rel_q0p1957 1 100 -6412.52 6412.33 FORMAT "%8.3" ECU_ADDRESS 0x403DCA /end MEASUREMENT
/begin MEASUREMENT dlrikl_w "DLR, I-Kleinanteil" SWORD rel_q0p1957 1 100 -6412.52 6412.33 FORMAT "%8.3" ECU_ADDRESS 0x3FC3E8 /end MEASUREMENT
/begin MEASUREMENT dlrini_w "I-Anteil bei Initialisierung der NLP-Function" UWORD rel_q0p1957 1 100 0 12824.9 FORMAT "%8.2" ECU_ADDRESS 0x403DCC /end MEASUREMENT
/begin MEASUREMENT dlrkomp "DLR, Faktor Kreisverst‰rkung" UBYTE fak_ub_b2 1 100 0 1.99219 FORMAT "%5.3" ECU_ADDRESS 0x3FC3A7 /end MEASUREMENT
/begin MEASUREMENT dlrndif_w "Istwert aktuell - Istwert letzter f¸r D-Anteil des DLR" SWORD relDK_q0p02441 1 100 -800 799.976 FORMAT "%8.4" ECU_ADDRESS 0x3FC3EA /end MEASUREMENT
/begin MEASUREMENT dlrp "DLR, P-Parameter" UBYTE relDK_q1 1 100 0 255 FORMAT "%5.1" ECU_ADDRESS 0x3FC3A8 /end MEASUREMENT
/begin MEASUREMENT dlrpidc "Fehlerz‰hler DLR-Stellbereichs¸berwachung" UWORD t10msxs_uw_b655p35 1 100 0 655.35 FORMAT "%8.4" ECU_ADDRESS 0x403DCE /end MEASUREMENT
/begin MEASUREMENT dlrspid_w "DLR f¸r DV-E: Summe der PID-Anteile" UWORD rel_uw_b100 1 100 0 99.9985 FORMAT "%8.5" ECU_ADDRESS 0x3FC3EC /end MEASUREMENT
/begin MEASUREMENT dmar_w "Delta Drehmoment antiruckel" SWORD rel_sw_b100 1 100 -100 99.9969 FORMAT "%8.4" ECU_ADDRESS 0x404156 /end MEASUREMENT
/begin MEASUREMENT dmdevab "Ev-Abschaltmuster der Aussetzererkennung das auf dem aktuellen SG umgesetzt wird" UBYTE dez 1 100 0 255 FORMAT "%5.1" ECU_ADDRESS 0x403BC1 /end MEASUREMENT
/begin MEASUREMENT dnvquotf_w "Gefilterte Differenz Drehzahl/Geschwindigkeitsquotient" SWORD qnv_sw_q0p0078 1 100 -256 255.992 FORMAT "%8.4" ECU_ADDRESS 0x403ED0 /end MEASUREMENT
/begin MEASUREMENT dnvquot_w "Differenz Drehzahl/Geschwindigkeitsquotient" SWORD qnv_sw_q0p0078 1 100 -256 255.992 FORMAT "%8.4" ECU_ADDRESS 0x403ED2 /end MEASUREMENT
/begin MEASUREMENT dpwrsvc "Zeitz‰hler DV-E-Powersave" UWORD t10msxs_uw_b655p35 1 100 0 655.35 FORMAT "%8.4" ECU_ADDRESS 0x403DD0 /end MEASUREMENT
/begin MEASUREMENT dveesc "Entprellz‰hler f¸r DV-E-Endstufe" UBYTE t10msxs_ub_b2p55 1 100 0 2.55 FORMAT "%5.3" ECU_ADDRESS 0x403B37 /end MEASUREMENT
/begin MEASUREMENT dvra_w "relativer Schlupf der beiden Achsen" UWORD rel_uw_b100 1 100 0 99.9985 FORMAT "%8.5" ECU_ADDRESS 0x404158 /end MEASUREMENT
/begin MEASUREMENT dwdkdlr_w "Differenz-DK-Winkel Sollwert - Istwert (wdkdlr_w - wdkba_w)" SWORD relDK_q0p02441 1 100 -800 799.976 FORMAT "%8.4" ECU_ADDRESS 0x3FC3EE /end MEASUREMENT
/begin MEASUREMENT dzwatb "Differenz aus gemitteltem Istz¸ndwinkel und Grenzz¸ndwinkel f¸r Bank 1" UBYTE zw_ub_q0p75 1 100 0 191.25 FORMAT "%5.1" ECU_ADDRESS 0x4038F2 /end MEASUREMENT
/begin MEASUREMENT dzwatb2 "Differenz aus gemitteltem Istz¸ndwinkel und Grenzz¸ndwinkel f¸r Bank 2" UBYTE zw_ub_q0p75 1 100 0 191.25 FORMAT "%5.1" ECU_ADDRESS 0x4038F3 /end MEASUREMENT
/begin MEASUREMENT eeeExitStatus "" UBYTE dez 1 100 0 255 FORMAT "%5.1" ECU_ADDRESS 0x3FE292 /end MEASUREMENT
/begin MEASUREMENT eevx "EV Fehlerbyte" UBYTE dez 1 100 0 255 FORMAT "%5.1" ECU_ADDRESS 0x402D3C /end MEASUREMENT
/begin MEASUREMENT erdrcamctr "Anzahl der Fehlermeldungen die vom Hardware Treiber der NW gemeldet wurden" UBYTE dez 1 100 0 255 FORMAT "%5.1" ECU_ADDRESS 0x40390F /end MEASUREMENT
/begin MEASUREMENT erdrrevctr "Anzahl der Fehlermeldungen die vom Hardware Treiber der KW gemeldet wurden" UBYTE dez 1 100 0 255 FORMAT "%5.1" ECU_ADDRESS 0x403910 /end MEASUREMENT
/begin MEASUREMENT erdrsynctr "Anzahl der Fehlermeldungen die vom HWT f¸r Synchronisation gemeldet werden" UBYTE dez 1 100 0 255 FORMAT "%5.1" ECU_ADDRESS 0x403911 /end MEASUREMENT
/begin MEASUREMENT esst_smk08mdsw "" ULONG dez 1 100 0 4.29497e+009 FORMAT "%13.2" ECU_ADDRESS 0x404AE4 /end MEASUREMENT
/begin MEASUREMENT esst_sts06tmuw "" ULONG dez 1 100 0 4.29497e+009 FORMAT "%13.2" ECU_ADDRESS 0x404A50 /end MEASUREMENT
/begin MEASUREMENT esst_stu05tmub "" ULONG dez 1 100 0 4.29497e+009 FORMAT "%13.2" ECU_ADDRESS 0x404A54 /end MEASUREMENT
/begin MEASUREMENT etazwimt "Ist_Z¸ndwinkelwirkungsgrad f¸r ATM gemittelt (200 ms)" UBYTE rel_ub_b127p5 1 100 0 127.5 FORMAT "%5.1" ECU_ADDRESS 0x402991 /end MEASUREMENT
/begin MEASUREMENT evrbgn_one "Ev Nr -1 bei Beginn der Ev-Abschaltung zur Adressierung von REDABM" UBYTE dez 1 100 0 255 FORMAT "%5.1" ECU_ADDRESS 0x403BC2 /end MEASUREMENT
/begin MEASUREMENT evz_aus "Einspritzausblendmuster" UBYTE dez 1 100 0 255 FORMAT "%5.1" ECU_ADDRESS 0x403BC3 /end MEASUREMENT
/begin MEASUREMENT evz_austot "Einspritzausblendmuster total" UBYTE dez 1 100 0 255 FORMAT "%5.1" ECU_ADDRESS 0x403BC8 /end MEASUREMENT
/begin MEASUREMENT fakatb2_w "Multiplikative Gemischanfettung Bank 2" UWORD fak_uw_b16 1 100 0 15.9998 FORMAT "%8.5" ECU_ADDRESS 0x404648 /end MEASUREMENT
/begin MEASUREMENT fakatb_w "Multiplikative Gemischanfettung Bank 1" UWORD fak_uw_b16 1 100 0 15.9998 FORMAT "%8.5" ECU_ADDRESS 0x40464A /end MEASUREMENT
/begin MEASUREMENT fakiha "Faktor Hinterachsuebersetzung" UBYTE fak_q0p01 1 100 0 2.55 FORMAT "%5.3" ECU_ADDRESS 0x3FE0A9 /end MEASUREMENT
/begin MEASUREMENT fdar "Verst‰rkungsfaktor des AR-Eingriffs" UBYTE fak_ub_b3p125 1 100 0 3.11279 FORMAT "%5.3" ECU_ADDRESS 0x403CB6 /end MEASUREMENT
/begin MEASUREMENT fevab "festes Muster EV-Abschaltung" UBYTE dez 1 100 0 255 FORMAT "%5.1" ECU_ADDRESS 0x402D3D /end MEASUREMENT
/begin MEASUREMENT fevabe "Ausblendmuster aus erkannten Fehlern" UBYTE dez 1 100 0 255 FORMAT "%5.1" ECU_ADDRESS 0x402D3E /end MEASUREMENT
/begin MEASUREMENT fhost_w "Korrekturfaktor Hˆhe bei Start(word)" UWORD fak_uw_b4 1 100 0 3.99994 FORMAT "%8.6" ECU_ADDRESS 0x402FEC /end MEASUREMENT
/begin MEASUREMENT fkhab "Faktor Katheizen zur Abregelung" UBYTE fak_ub_b1 1 100 0 0.996094 ECU_ADDRESS 0x403C2F /end MEASUREMENT
/begin MEASUREMENT fkhnab "Leerlaufdrehzahl-Absteuerfaktor" UBYTE fak_ub_b1 1 100 0 0.996094 ECU_ADDRESS 0x403C30 /end MEASUREMENT
/begin MEASUREMENT flakh "Faktor Lambda-Steuerung bei Katheizen" UBYTE fak_ub_b1 1 100 0 0.996094 ECU_ADDRESS 0x403C31 /end MEASUREMENT
/begin MEASUREMENT flamkh "Faktor Aufregelung Lambda-Motor-Soll bei Katheizen" UBYTE fak_ub_b1 1 100 0 0.996094 ECU_ADDRESS 0x403C32 /end MEASUREMENT
/begin MEASUREMENT flrar "Verst‰rkungsfaktor zum Nachbilden der externen Last" UBYTE fak_ub_b16 1 100 0 15.9375 FORMAT "%5.2" ECU_ADDRESS 0x403CB7 /end MEASUREMENT
/begin MEASUREMENT fmdkh "Faktor Steuerung Drehmomentreserve f¸r Katheizen" UBYTE fak_ub_b1 1 100 0 0.996094 ECU_ADDRESS 0x403C33 /end MEASUREMENT
/begin MEASUREMENT fmdkhtns_w "Zeitsteuerung Drehmomentenreserve f¸r Katheizen nach Start" UWORD fak_uw_b1 1 100 0 0.999985 FORMAT "%9.7" ECU_ADDRESS 0x4040EA /end MEASUREMENT
/begin MEASUREMENT fubkor_w "U_bat Tastverh‰ltnis-Korrekturfaktor in %HRLSU" UWORD fak_uw_b2 1 100 0 1.99997 FORMAT "%8.6" ECU_ADDRESS 0x403E0C /end MEASUREMENT
/begin MEASUREMENT gangi "Ist-Gang" UBYTE dez 1 100 0 255 FORMAT "%5.1" ECU_ADDRESS 0x403BA2 /end MEASUREMENT
/begin MEASUREMENT gwdkdlr_w "ƒnderung des Drosselklappen-Sollwinkels, Betrag f¸r Kennlinieneingang" SWORD relDK_q0p00152 1 100 -50 49.9985 FORMAT "%8.5" ECU_ADDRESS 0x3FC3F0 /end MEASUREMENT
/begin MEASUREMENT gwdk_kge "ƒnderung des Drosselklappen-Sollwinkels, Betrag f¸r Kennlinieneingang" UWORD relDK_q0p00152 1 100 0 99.9985 FORMAT "%8.5" ECU_ADDRESS 0x403DD2 /end MEASUREMENT
/begin MEASUREMENT iha "Hinterachs-‹bersetzung" UBYTE fak_q0p0195 1 100 0 4.98047 FORMAT "%5.3" ECU_ADDRESS 0x402BB6 /end MEASUREMENT
/begin MEASUREMENT imlatm "integr. Luftmassenfluss ab Motorstart bis Max.wert" UBYTE m_ub_b23p3 1 100 0 23.2107 FORMAT "%5.2" ECU_ADDRESS 0x402992 /end MEASUREMENT
/begin MEASUREMENT imlatmw_w "Dauer-RAM integr. Luftmassenfluss bei Abstellen" UWORD m_uw_b23p3 1 100 0 23.3013 FORMAT "%8.5" ECU_ADDRESS 0x3FE1C0 /end MEASUREMENT
/begin MEASUREMENT imlatm_w "integr. Luftmassenfluss ab Startende bis max. Wert, (Word)" UWORD m_uw_b23p3 1 100 0 23.3013 FORMAT "%8.5" ECU_ADDRESS 0x4029B0 /end MEASUREMENT
/begin MEASUREMENT imlbbo "Integrator Luftmasse f¸r Erkennung Benzin im ÷l" UBYTE m_ub_b23p3 1 100 0 23.2107 FORMAT "%5.2" ECU_ADDRESS 0x402DE6 /end MEASUREMENT
/begin MEASUREMENT imlbbo_w "" UWORD m_uw_b23p3 1 100 0 23.3013 FORMAT "%8.5" ECU_ADDRESS 0x402DE8 /end MEASUREMENT
/begin MEASUREMENT imlpr "Relatives Luftmassenintegral bei Katheizung" UBYTE fak_ub_b1 1 100 0 0.996094 ECU_ADDRESS 0x403C34 /end MEASUREMENT
/begin MEASUREMENT imlpr_w "Relatives Luftmassenintegral bei Katheizung (word)" UWORD fak_uw_b1 1 100 0 0.999985 FORMAT "%9.7" ECU_ADDRESS 0x4040EC /end MEASUREMENT
/begin MEASUREMENT iwmatm2_w "W‰rmemenge f¸r Kondenswasser-Taupunktende Abgas/Kat (word) bank2" UWORD q_q0p4551 1 100 0 29825.7 FORMAT "%8.2" ECU_ADDRESS 0x4029B2 /end MEASUREMENT
/begin MEASUREMENT iwmatmk2_w "W‰rmemenge f¸r Kondenswasser-Taupunktende Kat (word), Bank2" UWORD q_q0p4551 1 100 0 29825.7 FORMAT "%8.2" ECU_ADDRESS 0x4029B4 /end MEASUREMENT
/begin MEASUREMENT iwmatmk_w "W‰rmemenge f¸r Kondenswasser-Taupunktende Kat (word)" UWORD q_q0p4551 1 100 0 29825.7 FORMAT "%8.2" ECU_ADDRESS 0x4029B6 /end MEASUREMENT
/begin MEASUREMENT iwmatm_w "W‰rmemenge f¸r Kondenswasser-Taupunktende Abgas/Kat (word)" UWORD q_q0p4551 1 100 0 29825.7 FORMAT "%8.2" ECU_ADDRESS 0x4029B8 /end MEASUREMENT
/begin MEASUREMENT kftevp "" UBYTE t500usxms_ub_q0p5 1 100 0 127.5 FORMAT "%5.1" ECU_ADDRESS 0x403D06 /end MEASUREMENT
/begin MEASUREMENT kifz_w "Verst‰rkung des Fahrzeugmodells" UWORD fak_uw_b4864 1 100 0 4863.93 FORMAT "%8.3" ECU_ADDRESS 0x40415A /end MEASUREMENT
/begin MEASUREMENT kmstnmax "Bezugspunkt beim Auftreten der ‹berdrehzahl" UWORD km_uw_q10 1 100 0 655350 FORMAT "%8.1" ECU_ADDRESS 0x3FE8FE /end MEASUREMENT
/begin MEASUREMENT kmstpbr_w "Bezugspunkt beim Auftreten der PWG-Bremspedal Plausibilisierung" UWORD km_uw_q10 1 100 0 655350 FORMAT "%8.1" ECU_ADDRESS 0x3FE91C /end MEASUREMENT
/begin MEASUREMENT lamatb2_w "Lambda Abgastemperatur-Begrenzung Bank2" UWORD fak_uw_b16 1 100 0 15.9998 FORMAT "%8.5" ECU_ADDRESS 0x40464C /end MEASUREMENT
/begin MEASUREMENT lamatb_w "Lambda Abgastemperatur-Begrenzung Bank1" UWORD fak_uw_b16 1 100 0 15.9998 FORMAT "%8.5" ECU_ADDRESS 0x40464E /end MEASUREMENT
/begin MEASUREMENT latb_w "Lambda f¸r Bauteileschutz aus Station‰rkennfeld" UWORD fak_uw_b2 1 100 0 1.99997 FORMAT "%8.6" ECU_ADDRESS 0x404650 /end MEASUREMENT
/begin MEASUREMENT mdbes_w "Beschleunigungsmoment" SWORD rel_sw_b100 1 100 -100 99.9969 FORMAT "%8.4" ECU_ADDRESS 0x40415C /end MEASUREMENT
/begin MEASUREMENT mkar_w "Berechnetes Kupplungsmoment f¸r Antiruckelfunktion" SWORD rel_sw_b100 1 100 -100 99.9969 FORMAT "%8.4" ECU_ADDRESS 0x40415E /end MEASUREMENT
/begin MEASUREMENT mlast_w "gesch‰tztes Lastmoment" SWORD rel_sw_b100 1 100 -100 99.9969 FORMAT "%8.4" ECU_ADDRESS 0x404160 /end MEASUREMENT
/begin MEASUREMENT mlsu_w "Soll-Luftmasse f¸r Katheizen" UWORD m_ub_b5p8 1 100 0 1491.29 FORMAT "%8.3" ECU_ADDRESS 0x402FEE /end MEASUREMENT
/begin MEASUREMENT ndar_w "Differenzdrehzahl f¸r Momenteneingriff" SWORD nmot_sw_q0p25 1 100 -8192 8191.75 FORMAT "%8.3" ECU_ADDRESS 0x404162 /end MEASUREMENT
/begin MEASUREMENT ndfibet_w "Betrag der gefilterten Differenzdrehzahl" UWORD nmot_uw_q0p25 1 100 0 16383.8 FORMAT "%8.2" ECU_ADDRESS 0x404164 /end MEASUREMENT
/begin MEASUREMENT ndfil_w "gefilterte Differenzdrehzahl" SWORD nmot_sw_q0p25 1 100 -8192 8191.75 FORMAT "%8.3" ECU_ADDRESS 0x404166 /end MEASUREMENT
/begin MEASUREMENT ndiffog_w "Schwelle Drehzahldifferenz zum Resetieren der AR beim Verzˆgern" SWORD nmot_sw_q0p25 1 100 -8192 8191.75 FORMAT "%8.3" ECU_ADDRESS 0x404168 /end MEASUREMENT
/begin MEASUREMENT ndiff_w "Differenzdrehzahl f¸r LFR-HS-Verst‰rkungen" SWORD nmot_sw_q0p25 1 100 -8192 8191.75 FORMAT "%8.3" ECU_ADDRESS 0x40416A /end MEASUREMENT
/begin MEASUREMENT nfskh "Leerlaufdrehzahl Fahrstufe bei Katheizen" UBYTE nmot_ub_q10 1 100 0 2550 FORMAT "%5.0" ECU_ADDRESS 0x403C35 /end MEASUREMENT
/begin MEASUREMENT nllkh "Leerlaufdrehzahl bei Katheizen" UBYTE nmot_ub_q10 1 100 0 2550 FORMAT "%5.0" ECU_ADDRESS 0x403C36 /end MEASUREMENT
/begin MEASUREMENT nmaxvk_w "vorgekommene Maximaldrehzahl" UWORD nmot_uw_q0p15625 1 100 0 10239.8 FORMAT "%8.2" ECU_ADDRESS 0x3FE900 /end MEASUREMENT
/begin MEASUREMENT nmodiv_w "Drehzahl f¸r Initialisierung ARMD berechnet aus Geschwindigkeit" UWORD nmot_uw_q0p25 1 100 0 16383.8 FORMAT "%8.2" ECU_ADDRESS 0x40416C /end MEASUREMENT
/begin MEASUREMENT nmod_w "Motordrehzahl aus Modell" UWORD nmot_uw_q0p25 1 100 0 16383.8 FORMAT "%8.2" ECU_ADDRESS 0x40416E /end MEASUREMENT
/begin MEASUREMENT nmotk1_w "Motordrehzahl 1 Synchro vorher" UWORD nmot_uw_q0p25 1 100 0 16383.8 FORMAT "%8.2" ECU_ADDRESS 0x404170 /end MEASUREMENT
/begin MEASUREMENT nmotk2_w "Motordrehzahl 2 Synchros vorher" UWORD nmot_uw_q0p25 1 100 0 16383.8 FORMAT "%8.2" ECU_ADDRESS 0x404172 /end MEASUREMENT
/begin MEASUREMENT nmot_tmp "Motordrehzahl" UWORD nmot_uw_q0p25 1 100 0 16383.8 FORMAT "%8.2" ECU_ADDRESS 0x404652 /end MEASUREMENT
/begin MEASUREMENT nvquotr_w "roher Quotient Motordrehzahl nmot / Fahrgeschwindigkeit vfzg" UWORD qnv_uw_b512 1 100 0 511.992 FORMAT "%8.4" ECU_ADDRESS 0x403ECC /end MEASUREMENT
/begin MEASUREMENT nvquot_w "Quotient Motordrehzahl nmot / Fahrgeschwindigkeit vfzg" UWORD qnv_uw_b512 1 100 0 511.992 FORMAT "%8.4" ECU_ADDRESS 0x403ECE /end MEASUREMENT
/begin MEASUREMENT ottstamp_l "Berechnungsgrˆsse letzte Zahnzeit absolut" SLONG t_q0p0001_ms 1 100 -107374 107374 FORMAT "%13.6" ECU_ADDRESS 0x4049E0 /end MEASUREMENT
/begin MEASUREMENT recRes5vSr "" UBYTE dez 1 100 0 255 FORMAT "%5.1" ECU_ADDRESS 0x3FCD38 /end MEASUREMENT
/begin MEASUREMENT recRes5vSt "" UBYTE dez 1 100 0 255 FORMAT "%5.1" ECU_ADDRESS 0x3FCD37 /end MEASUREMENT
/begin MEASUREMENT recWDASt "Information Ursache f¸r WDA-Abschaltung" UBYTE dez 1 100 0 255 FORMAT "%5.1" ECU_ADDRESS 0x3FCD39 /end MEASUREMENT
/begin MEASUREMENT redsolr "Realisierte Reduzierstufe" UBYTE dez 1 100 0 255 FORMAT "%5.1" ECU_ADDRESS 0x403BC4 /end MEASUREMENT
/begin MEASUREMENT redsol_one "Berechnete Soll-Reduzierstufe - 1 zur Adress. von REDABM" UBYTE dez 1 100 0 255 FORMAT "%5.1" ECU_ADDRESS 0x403BC5 /end MEASUREMENT
/begin MEASUREMENT res5vctr_w "" UWORD dez 1 100 0 65535 FORMAT "%8.2" ECU_ADDRESS 0x3FDE98 /end MEASUREMENT
/begin MEASUREMENT res5vsta_l "" ULONG dez 1 100 0 4.29497e+009 FORMAT "%13.2" ECU_ADDRESS 0x3FDE9C /end MEASUREMENT
/begin MEASUREMENT res5vsts_l "" ULONG dez 1 100 0 4.29497e+009 FORMAT "%13.2" ECU_ADDRESS 0x3FDEA0 /end MEASUREMENT
/begin MEASUREMENT rl_tmp "Relative F¸llung" UWORD rel_uw_q0p0234 1 100 0 1535.98 FORMAT "%8.3" ECU_ADDRESS 0x404654 /end MEASUREMENT
/begin MEASUREMENT stateaevab "Nr des aktiven Zustandes in AEVAB" UBYTE dez 1 100 0 255 FORMAT "%5.1" ECU_ADDRESS 0x403BC6 /end MEASUREMENT
/begin MEASUREMENT tabgm "Abgastemperatur vor Kat aus Modell" UBYTE temp_ub_q5_o50 1 100 -50 1225 FORMAT "%5.0" ECU_ADDRESS 0x402993 /end MEASUREMENT
/begin MEASUREMENT tabgm2 "Abgastemperatur vor Kat aus Modell Bank2" UBYTE temp_ub_q5_o50 1 100 -50 1225 FORMAT "%5.0" ECU_ADDRESS 0x402994 /end MEASUREMENT
/begin MEASUREMENT tabgm2_w "Abgastemperatur vor Kat aus Modell (Word) Bank2" UWORD temp_uw_q0p0195_o50 1 100 -50 1229.98 FORMAT "%8.3" ECU_ADDRESS 0x4029BA /end MEASUREMENT
/begin MEASUREMENT tabgmab "Abgastemperatur beim Abstellen des Motors" UBYTE temp_ub_q5_o50 1 100 -50 1225 FORMAT "%5.0" ECU_ADDRESS 0x3FE06B /end MEASUREMENT
/begin MEASUREMENT tabgmab2 "Abgastemperatur beim Abstellen des Motors (Modell) Bank2" UBYTE temp_ub_q5_o50 1 100 -50 1225 FORMAT "%5.0" ECU_ADDRESS 0x3FE06C /end MEASUREMENT
/begin MEASUREMENT tabgmst "Abgastemperatur bei Motorstart" UBYTE temp_ub_q5_o50 1 100 -50 1225 FORMAT "%5.0" ECU_ADDRESS 0x402995 /end MEASUREMENT
/begin MEASUREMENT tabgmst2 "Abgastemperatur bei Motorstart Bank2" UBYTE temp_ub_q5_o50 1 100 -50 1225 FORMAT "%5.0" ECU_ADDRESS 0x402996 /end MEASUREMENT
/begin MEASUREMENT tabgm_w "Abgastemperatur vor Kat aus Modell (Word)" UWORD temp_uw_q0p0195_o50 1 100 -50 1229.98 FORMAT "%8.3" ECU_ADDRESS 0x4029BC /end MEASUREMENT
/begin MEASUREMENT tabstatm_w "Abstellzeit im SG-Nachlauf f¸r ATM" UWORD t1sxs_uw_q1 1 100 0 65535 FORMAT "%8.2" ECU_ADDRESS 0x4029BE /end MEASUREMENT
/begin MEASUREMENT tabstmx_w "Abstellzeit Maximumabfrage f¸r ATM" UWORD t1sxs_uw_q1 1 100 0 65535 FORMAT "%8.2" ECU_ADDRESS 0x3FE074 /end MEASUREMENT
/begin MEASUREMENT tahrlsu2_w "Tastverh‰ltnis f¸r Lambdasondenheizung, Bank 2" UWORD rel_uw_b200 1 100 0 199.997 FORMAT "%8.4" ECU_ADDRESS 0x403E0E /end MEASUREMENT
/begin MEASUREMENT tahrlsu_w "Tastverh‰ltnis f¸r Lambdasondenheizung" UWORD rel_uw_b200 1 100 0 199.997 FORMAT "%8.4" ECU_ADDRESS 0x403E10 /end MEASUREMENT
/begin MEASUREMENT tanskhst "Ansaugluft - Temperatur bei start" UBYTE temp_ub_q0p75_o48 1 100 -48 143.25 FORMAT "%5.1" ECU_ADDRESS 0x402FE8 /end MEASUREMENT
/begin MEASUREMENT tateist "aktuelles Ist-Tastverh‰ltnis Tankentl¸ftungsventil" UBYTE rel_ub_b99p6 1 100 0 99.6094 FORMAT "%5.2" ECU_ADDRESS 0x403D07 /end MEASUREMENT
/begin MEASUREMENT tatemxfq "max Tastverh‰ltnis TEV ˆffnet" UBYTE rel_ub_b99p6 1 100 0 99.6094 FORMAT "%5.2" ECU_ADDRESS 0x403D08 /end MEASUREMENT
/begin MEASUREMENT tateout "ausgegebenes Tastverh‰ltnis f¸r Tankentl¸ftungsventil" UBYTE rel_ub_b99p6 1 100 0 99.6094 FORMAT "%5.2" ECU_ADDRESS 0x403D09 /end MEASUREMENT
/begin MEASUREMENT tateroh "Rohwert Tastverh‰ltnis TEV" UBYTE rel_ub_b99p6 1 100 0 99.6094 FORMAT "%5.2" ECU_ADDRESS 0x403D0A /end MEASUREMENT
/begin MEASUREMENT tatesoll "gew¸nschtes Soll-Tastverh‰ltnis Tankentl¸ftungsventil" UBYTE rel_ub_b99p6 1 100 0 99.6094 FORMAT "%5.2" ECU_ADDRESS 0x403D0B /end MEASUREMENT
/begin MEASUREMENT tatmaml "Ausgang aus PT1-Glied Abgastemperatur-Einfluﬂ auf tabgm" UBYTE temp_ub_q5_o50 1 100 -50 1225 FORMAT "%5.0" ECU_ADDRESS 0x402997 /end MEASUREMENT
/begin MEASUREMENT tatmaml2 "Ausgang aus PT1-Glied Abgastemperatur-Einfluﬂ auf tabgm, Bank2" UBYTE temp_ub_q5_o50 1 100 -50 1225 FORMAT "%5.0" ECU_ADDRESS 0x402998 /end MEASUREMENT
/begin MEASUREMENT tatmkf "Abgastemperatur vor Kat aus Kennfeld KFTATM" UBYTE temp_ub_q5_o50 1 100 -50 1225 FORMAT "%5.0" ECU_ADDRESS 0x402999 /end MEASUREMENT
/begin MEASUREMENT tatmkf2 "Abgastemperatur vor Kat aus Kennfeld KFTATM Bank2" UBYTE temp_ub_q5_o50 1 100 -50 1225 FORMAT "%5.0" ECU_ADDRESS 0x40299A /end MEASUREMENT
/begin MEASUREMENT tatmrml "Ausgang aus PT1-Glied Rohrwandtemperatur-Einfluﬂ auf tabgm" UBYTE temp_ub_q5_o50 1 100 -50 1225 FORMAT "%5.0" ECU_ADDRESS 0x40299B /end MEASUREMENT
/begin MEASUREMENT tatmrml2 "Ausgang aus PT1-Glied Rohrwandtemperatur-Einfluﬂ auf tabgm, Bank2" UBYTE temp_ub_q5_o50 1 100 -50 1225 FORMAT "%5.0" ECU_ADDRESS 0x40299C /end MEASUREMENT
/begin MEASUREMENT tatmsam "Abgastemperatur station‰r im Schubbetrieb" UBYTE temp_ub_q5_o50 1 100 -50 1225 FORMAT "%5.0" ECU_ADDRESS 0x40299D /end MEASUREMENT
/begin MEASUREMENT tatmsam2 "Abgastemperatur station‰r im Schubbetrieb, Bank2" UBYTE temp_ub_q5_o50 1 100 -50 1225 FORMAT "%5.0" ECU_ADDRESS 0x40299E /end MEASUREMENT
/begin MEASUREMENT tatmsta "Abgastemperatur vor Kat aus Modell station‰r" UBYTE temp_ub_q5_o50 1 100 -50 1225 FORMAT "%5.0" ECU_ADDRESS 0x40299F /end MEASUREMENT
/begin MEASUREMENT tatmsta2 "Abgastemperatur vor Kat aus Modell station‰r Bank2" UBYTE temp_ub_q5_o50 1 100 -50 1225 FORMAT "%5.0" ECU_ADDRESS 0x4029A0 /end MEASUREMENT
/begin MEASUREMENT tatu "Ansaugluft- oder Umgebungstemperatur" UBYTE temp_ub_q0p75_o48 1 100 -48 143.25 FORMAT "%5.1" ECU_ADDRESS 0x4029A1 /end MEASUREMENT
/begin MEASUREMENT tekpvabt_w "rel. Zeitpunkt an dem zuletzt ein Pumpenvorlauf durchgef¸hrt wurde" UWORD t1sxs_uw_q1 1 100 0 65535 FORMAT "%8.2" ECU_ADDRESS 0x3FE388 /end MEASUREMENT
/begin MEASUREMENT temp_klt_l "Zahnzeit aus KLALETM mit der Temperatur zum Beginn der Nachlaufphase" SLONG t_q0p0001_ms 1 100 -214748 214748 FORMAT "%13.6" ECU_ADDRESS 0x4049E4 /end MEASUREMENT
/begin MEASUREMENT temp_tn1_l "Ringpuffervariable, letzte Zahnzeit" SLONG t_q0p0001_ms 1 100 -214748 214748 FORMAT "%13.6" ECU_ADDRESS 0x4049E8 /end MEASUREMENT
/begin MEASUREMENT temp_tn2_l "Ringpuffervariable, vorletzte Zahnzeit" SLONG t_q0p0001_ms 1 100 -214748 214748 FORMAT "%13.6" ECU_ADDRESS 0x4049EC /end MEASUREMENT
/begin MEASUREMENT temp_tn_l "Ringpuffervariable, aktuelle Zahnzeit" SLONG t_q0p0001_ms 1 100 -214748 214748 FORMAT "%13.6" ECU_ADDRESS 0x4049F0 /end MEASUREMENT
/begin MEASUREMENT temp_w1 "Zwischenwerte f¸r Plausibilisierung" SWORD kw_q0p1 1 100 0 412 FORMAT "%8.4" ECU_ADDRESS 0x40440E /end MEASUREMENT
/begin MEASUREMENT temp_w2 "Zwischenwerte f¸r Plausibilisierung" SWORD kw_q0p1 1 100 -3276.8 3276.7 FORMAT "%8.3" ECU_ADDRESS 0x404410 /end MEASUREMENT
/begin MEASUREMENT temp_w3 "Zwischenwerte f¸r Plausibilisierung" SWORD kw_q0p1 1 100 -3276.8 3276.7 FORMAT "%8.3" ECU_ADDRESS 0x404412 /end MEASUREMENT
/begin MEASUREMENT temp_w4 "Zwischenwerte f¸r Plausibilisierung" SWORD kw_q0p1 1 100 -3276.8 3276.7 FORMAT "%8.3" ECU_ADDRESS 0x404414 /end MEASUREMENT
/begin MEASUREMENT tevper "Periodendauer bei Ansteuerung Tankentl¸ftungsventil" UBYTE t500usxms_ub_q0p5 1 100 0 127.5 FORMAT "%5.1" ECU_ADDRESS 0x4035D8 /end MEASUREMENT
/begin MEASUREMENT texkor "Korrektur der exothermen Temperaturerhˆhung im Kat texom_w" UBYTE fak_ub_b2 1 100 0 1.99219 FORMAT "%5.3" ECU_ADDRESS 0x4029A2 /end MEASUREMENT
/begin MEASUREMENT texkor2 "Korrektur der exothermen Temperaturerhˆhung im Kat texom2_w, Bank2" UBYTE fak_ub_b2 1 100 0 1.99219 FORMAT "%5.3" ECU_ADDRESS 0x4029A3 /end MEASUREMENT
/begin MEASUREMENT texml "Exotherme Temperaturerhˆhung im Kat f¸r tkatm aus Kennlinie" SBYTE temp_q5 1 100 -640 635 FORMAT "%5.1" ECU_ADDRESS 0x4029A4 /end MEASUREMENT
/begin MEASUREMENT texml2 "Exotherme Temperaturerhˆhung im Kat f¸r tkatm aus Kennlinie, Bank2" SBYTE temp_q5 1 100 -640 635 FORMAT "%5.1" ECU_ADDRESS 0x4029A5 /end MEASUREMENT
/begin MEASUREMENT texoikm2_w "Exotherme Temperaturerhˆhung im Kat  f¸r tikatm, Bank2" SWORD temp_q0p0195 1 100 -640 639.98 FORMAT "%8.4" ECU_ADDRESS 0x4029C0 /end MEASUREMENT
/begin MEASUREMENT texoikm_w "Exotherme Temperaturerhˆhung im Kat f¸r tikatm" SWORD temp_q0p0195 1 100 -640 639.98 FORMAT "%8.4" ECU_ADDRESS 0x4029C2 /end MEASUREMENT
/begin MEASUREMENT texom2_w "Exotherme Temperaturerhˆhung im Kat  f¸r tkatm2, Bank2" SWORD temp_q0p0195 1 100 -640 639.98 FORMAT "%8.4" ECU_ADDRESS 0x4029C4 /end MEASUREMENT
/begin MEASUREMENT texom_w "Exotherme Temperaturerhˆhung im Kat f¸r tkatm" SWORD temp_q0p0195 1 100 -640 639.98 FORMAT "%8.4" ECU_ADDRESS 0x4029C6 /end MEASUREMENT
/begin MEASUREMENT tiexkor "Korrektur der exothermen Temperaturerhˆhung im Kat texoikm_w" UBYTE fak_ub_b2 1 100 0 1.99219 FORMAT "%5.3" ECU_ADDRESS 0x4029A6 /end MEASUREMENT
/begin MEASUREMENT tiexkor2 "Korrektur der exothermen Temperaturerhˆhung im Kat texoikm2_w, Bank2" UBYTE fak_ub_b2 1 100 0 1.99219 FORMAT "%5.3" ECU_ADDRESS 0x4029A7 /end MEASUREMENT
/begin MEASUREMENT tiexml "Exotherme Temperaturerhˆhung im Kat f¸r tikatm aus Kennlinie" SBYTE temp_q5 1 100 -640 635 FORMAT "%5.1" ECU_ADDRESS 0x4029A8 /end MEASUREMENT
/begin MEASUREMENT tiexml2 "Exotherme Temperaturerhˆhung im Kat f¸r tikatm aus Kennlinie, Bank2" SBYTE temp_q5 1 100 -640 635 FORMAT "%5.1" ECU_ADDRESS 0x4029A9 /end MEASUREMENT
/begin MEASUREMENT tikatm "Abgastemperatur im Katalysator aus Modell" UBYTE temp_ub_q5_o50 1 100 -50 1225 FORMAT "%5.0" ECU_ADDRESS 0x4029AA /end MEASUREMENT
/begin MEASUREMENT tikatm2 "Abgastemperatur im Katalysator aus Modell Bank 2" UBYTE temp_ub_q5_o50 1 100 -50 1225 FORMAT "%5.0" ECU_ADDRESS 0x4029AB /end MEASUREMENT
/begin MEASUREMENT tikatm2_w "Abgastemperatur im Katalysator aus Modell Bank 2" UWORD temp_uw_q0p0195_o50 1 100 -50 1229.98 FORMAT "%8.3" ECU_ADDRESS 0x4029C8 /end MEASUREMENT
/begin MEASUREMENT tikatm_w "Abgastemperatur im Katalysator aus Modell" UWORD temp_uw_q0p0195_o50 1 100 -50 1229.98 FORMAT "%8.3" ECU_ADDRESS 0x4029CA /end MEASUREMENT
/begin MEASUREMENT tirq1ofd_w "" UWORD dez 1 100 0 65535 FORMAT "%8.2" ECU_ADDRESS 0x3F9DBC /end MEASUREMENT
/begin MEASUREMENT tkatm "Katalysatortemperatur aus Modell" UBYTE temp_ub_q5_o50 1 100 -50 1225 FORMAT "%5.0" ECU_ADDRESS 0x4029AC /end MEASUREMENT
/begin MEASUREMENT tkatm2 "Katalysatortemperatur aus Modell,  Bank2" UBYTE temp_ub_q5_o50 1 100 -50 1225 FORMAT "%5.0" ECU_ADDRESS 0x4029AD /end MEASUREMENT
/begin MEASUREMENT tkatm2_w "Katalysatortemperatur aus Modell (Word) Bank2" UWORD temp_uw_q0p0195_o50 1 100 -50 1229.98 FORMAT "%8.3" ECU_ADDRESS 0x4029CC /end MEASUREMENT
/begin MEASUREMENT tkatmab "Abgastemperatur hinter Kat beim Abstellen des Motors (Modell)" UBYTE temp_ub_q5_o50 1 100 -50 1225 FORMAT "%5.0" ECU_ADDRESS 0x3FE06D /end MEASUREMENT
/begin MEASUREMENT tkatmab2 "Abgastemperatur hinter Kat beim Abstellen des Motors (Modell) Bank2" UBYTE temp_ub_q5_o50 1 100 -50 1225 FORMAT "%5.0" ECU_ADDRESS 0x3FE06E /end MEASUREMENT
/begin MEASUREMENT tkatmst "Katalysatortemperatur Modell Startwert = f(Abstellwert, Abstellzeit)" UBYTE temp_ub_q5_o50 1 100 -50 1225 FORMAT "%5.0" ECU_ADDRESS 0x4029AE /end MEASUREMENT
/begin MEASUREMENT tkatmst2 "Katalysatortemperatur Modell Startwert = f(Abstellwert,Abstellzeit) Bank2" UBYTE temp_ub_q5_o50 1 100 -50 1225 FORMAT "%5.0" ECU_ADDRESS 0x4029AF /end MEASUREMENT
/begin MEASUREMENT tkatm_w "Katalysatortemperatur aus Modell (Word)" UWORD temp_uw_q0p0195_o50 1 100 -50 1229.98 FORMAT "%8.3" ECU_ADDRESS 0x4029CE /end MEASUREMENT
/begin MEASUREMENT tkhnab_ctr "" UWORD t100msxs_uw_b6553p5 1 100 0 6553.5 FORMAT "%8.3" ECU_ADDRESS 0x4040EE /end MEASUREMENT
/begin MEASUREMENT tmcorctr_w "Z‰hler L¸ckenkorrektur bei fehlendem Zahn" UWORD dez 1 100 0 65535 FORMAT "%8.2" ECU_ADDRESS 0x404678 /end MEASUREMENT
/begin MEASUREMENT tmlastz "Abw‰rtsz‰hler zum Resetieren der AR beim Verzˆgern" UBYTE t10msxs_ub_b2p55 1 100 0 2.55 FORMAT "%5.3" ECU_ADDRESS 0x403CB8 /end MEASUREMENT
/begin MEASUREMENT tnmst1z "Verzˆgerungszeit Kupplungsschalter beim Hochschalten" UBYTE t10msxs_ub_b2p55 1 100 0 2.55 FORMAT "%5.3" ECU_ADDRESS 0x403CB9 /end MEASUREMENT
/begin MEASUREMENT tnmst2z "Verzˆgerungszeit Kupplungsschalter beim Runterschalten" UBYTE t10msxs_ub_b2p55 1 100 0 2.55 FORMAT "%5.3" ECU_ADDRESS 0x403CBA /end MEASUREMENT
/begin MEASUREMENT tooth10ms "Z‰hlvariable; f¸r die Abfrage, ob der letzte Zahnint l‰nger als 100ms her ist" UBYTE dez 1 100 0 127 FORMAT "%5.1" ECU_ADDRESS 0x40388C /end MEASUREMENT
/begin MEASUREMENT toothtim_l "Zahnzeit" SLONG t_q0p0001_ms 1 100 -214748 214748 FORMAT "%13.6" ECU_ADDRESS 0x4049F4 /end MEASUREMENT
/begin MEASUREMENT tpcorctr_w "Z‰hler L¸ckenkorrektur bei einem zus‰tzlichen Zahn" UWORD dez 1 100 0 65535 FORMAT "%8.2" ECU_ADDRESS 0x40467A /end MEASUREMENT
/begin MEASUREMENT tphrlsu_w "Periodendauer f¸r die Heizertaktung der LSU" UWORD t100msxs_q16Em6 1 100 0 1.04856 FORMAT "%8.6" ECU_ADDRESS 0x40298E /end MEASUREMENT
/begin MEASUREMENT ttevein "aktuelle Einschaltdauer TEV" UWORD t128ms_uw 1 100 0 127.998 FORMAT "%8.4" ECU_ADDRESS 0x404300 /end MEASUREMENT
/begin MEASUREMENT tteveroh "TEV-Soll-Ansteuerzeit" UWORD t128ms_uw 1 100 0 127.998 FORMAT "%8.4" ECU_ADDRESS 0x404302 /end MEASUREMENT
/begin MEASUREMENT ttstamp_l "Berechnungsgrˆsse aktuelle Zahnzeit absolut" SLONG t_q0p0001_ms 1 100 -107374 107374 FORMAT "%13.6" ECU_ADDRESS 0x4049F8 /end MEASUREMENT
/begin MEASUREMENT ttstmpmx_l "‹berlauf Zahnzeit Ausgabe aus HW-Treiber" ULONG t_q0p0001_ms 1 100 0 214748 FORMAT "%13.6" ECU_ADDRESS 0x4049FC /end MEASUREMENT
/begin MEASUREMENT tvarsl_ctr "" UBYTE t10msxs_ub_b2p55 1 100 0 2.55 FORMAT "%5.3" ECU_ADDRESS 0x403CBB /end MEASUREMENT
/begin MEASUREMENT tvrnr "Verzˆgerungszeit bis zum wirklichen Ev-Abschaltende" UBYTE dez 1 100 0 255 FORMAT "%5.1" ECU_ADDRESS 0x403BC7 /end MEASUREMENT
/begin MEASUREMENT tvtevptu "Verzugszeit von TEV  (druck-, batteriespannung- und temperaturabh‰ngig)" UBYTE t500usxms_ub_q0p5 1 100 0 127.5 FORMAT "%5.1" ECU_ADDRESS 0x403D0C /end MEASUREMENT
/begin MEASUREMENT tzarni "Zeitz‰hler AR nach Initialisierung" UBYTE t10msxs_ub_b2p55 1 100 0 2.55 FORMAT "%5.3" ECU_ADDRESS 0x403CBC /end MEASUREMENT
/begin MEASUREMENT uddss_w "Spannung Differenzdrucksensor Saugrohr" UWORD spg_uw_q0p00488 1 100 0 319.995 FORMAT "%8.4" ECU_ADDRESS 0x404372 /end MEASUREMENT
/begin MEASUREMENT udkp1v_w "Verst‰rkte Spannung DK-Poti 1" UWORD spg_uw_q0p00488 1 100 0 319.995 FORMAT "%8.4" ECU_ADDRESS 0x403D8A /end MEASUREMENT
/begin MEASUREMENT udkp1_w "Spannung DK-Poti 1" UWORD spg_uw_q0p001222 1 100 0 79.9988 FORMAT "%8.5" ECU_ADDRESS 0x403D8C /end MEASUREMENT
/begin MEASUREMENT udkp2_w "Spannung DK-Poti 2" UWORD spg_uw_q0p001222 1 100 0 79.9988 FORMAT "%8.5" ECU_ADDRESS 0x403D8E /end MEASUREMENT
/begin MEASUREMENT udsu_w "Spannung Umgebungsdrucksensor (word 10-Bit von ADC)" UWORD spg_uw_b5 1 100 0 319.995 FORMAT "%8.4" ECU_ADDRESS 0x402802 /end MEASUREMENT
/begin MEASUREMENT uhsh "Spannung an der Heizerendstufe hinter Kat" UBYTE spg_ub_b5 1 100 0 4.98047 FORMAT "%5.3" ECU_ADDRESS 0x403AD1 /end MEASUREMENT
/begin MEASUREMENT uhsh2 "Spannung an der Heizerendstufe 2 hinter Kat" UBYTE spg_ub_b5 1 100 0 4.98047 FORMAT "%5.3" ECU_ADDRESS 0x403AD2 /end MEASUREMENT
/begin MEASUREMENT upwg1_w "Spannung PWG-Poti 1 (Word)" UWORD spg_uw_q0p00488 1 100 0 319.995 FORMAT "%8.4" ECU_ADDRESS 0x403D90 /end MEASUREMENT
/begin MEASUREMENT upwg2_w "Spannung PWG-Poti 2 (Word)" UWORD spg_uw_q0p00488 1 100 0 319.995 FORMAT "%8.4" ECU_ADDRESS 0x403D92 /end MEASUREMENT
/begin MEASUREMENT urinlsu2_w "widerstandsproportionale Spannung des CJ120 der Nernstzelle LSU2 (ADC-Wert)" UWORD spg_uw_q0p00488 1 100 0 319.995 FORMAT "%8.4" ECU_ADDRESS 0x403D94 /end MEASUREMENT
/begin MEASUREMENT urinlsu_w "widerstandsproportionale Spannung des CJ120 der Nernstzelle LSU (ADC-Wert)" UWORD spg_uw_q0p00488 1 100 0 319.995 FORMAT "%8.4" ECU_ADDRESS 0x403D96 /end MEASUREMENT
/begin MEASUREMENT uthk "Spannung Abgastemperatursensor hinter Kat" UBYTE spg_ub_b5 1 100 0 4.98047 FORMAT "%5.3" ECU_ADDRESS 0x403AD3 /end MEASUREMENT
/begin MEASUREMENT uthk2 "Spannung Abgastemperatursensor hinter Kat Bank 2" UBYTE spg_ub_b5 1 100 0 4.98047 FORMAT "%5.3" ECU_ADDRESS 0x403AD4 /end MEASUREMENT
/begin MEASUREMENT uulsuv2_w "Sondenspannung vor Kat einer Breitbandlambdasonde Bank2 (ADC-Wert)" UWORD spg_uw_q0p00488 1 100 0 319.995 FORMAT "%8.4" ECU_ADDRESS 0x403D98 /end MEASUREMENT
/begin MEASUREMENT uulsuv_w "Sondenspannung vor Kat einer Breitbandlambdasonde (ADC-Wert)" UWORD spg_uw_q0p00488 1 100 0 319.995 FORMAT "%8.4" ECU_ADDRESS 0x403D9A /end MEASUREMENT
/begin MEASUREMENT uuptes_w "ADC-Spannung Pumpenstrom Tankdiagnose" UWORD spg_uw_b5 1 100 0 319.995 FORMAT "%8.4" ECU_ADDRESS 0x403D9C /end MEASUREMENT
/begin MEASUREMENT uzkw_w "Kurbelwellen-Umdrehungsz‰hler" UWORD dez 1 100 0 65535 FORMAT "%8.2" ECU_ADDRESS 0x40467C /end MEASUREMENT
/begin MEASUREMENT vfzgtemp_w "Fahrzeuggeschwindigkeit Tempor‰r" UWORD vfzg_uw_b512 1 100 0 511.992 FORMAT "%8.4" ECU_ADDRESS 0x4044D4 /end MEASUREMENT
/begin MEASUREMENT vham_w "mittlere Geschwindigkeit der R‰der an der Hinterachse" UWORD vfzg_uw_q0p0625 1 100 0 4095.94 FORMAT "%8.3" ECU_ADDRESS 0x404174 /end MEASUREMENT
/begin MEASUREMENT vkst_w "Gefˆrdertes Kraftstoffvolumen" UWORD vol_q1ml 1 100 0 65535 FORMAT "%8.2" ECU_ADDRESS 0x403706 /end MEASUREMENT
/begin MEASUREMENT vreglmax_w "Maximal zul‰ssige Sollgeschwindigkeit f¸r FGR" UWORD vfzg_uw_b512 1 100 0 511.992 FORMAT "%8.4" ECU_ADDRESS 0x402C00 /end MEASUREMENT
/begin MEASUREMENT vreglmin_w "Minimal zul‰ssige Sollgeschwindigkeit f¸r FGR" UWORD vfzg_uw_b512 1 100 0 511.992 FORMAT "%8.4" ECU_ADDRESS 0x402C02 /end MEASUREMENT
/begin MEASUREMENT vvam_w "mittlere Geschwindigkeit der R‰der an der Vorderachse" UWORD vfzg_uw_q0p0625 1 100 0 4095.94 FORMAT "%8.3" ECU_ADDRESS 0x404176 /end MEASUREMENT
/begin MEASUREMENT wdkdlra_w "Alter Sollwert DK-Winkel in 12 Bit-Auflˆsung" UWORD relDK_q0p02441 1 100 0 1599.98 FORMAT "%8.3" ECU_ADDRESS 0x403DD4 /end MEASUREMENT
/begin MEASUREMENT wdkdlr_w "Sollwert DK-Winkel in 12 Bit-Auflˆsung" UWORD relDK_q0p02441 1 100 0 1599.98 FORMAT "%8.3" ECU_ADDRESS 0x3FC3F2 /end MEASUREMENT
/begin MEASUREMENT wdksfi_w "aus wdks_w pr‰dizierter DK-Winkel" SWORD relDK_q0p02441 1 100 -800 799.976 FORMAT "%8.4" ECU_ADDRESS 0x403DD6 /end MEASUREMENT
/begin MEASUREMENT wkwalerr_w "unkorrigierter Auslaufwinkel" SWORD kw_q0p1 1 100 -3276.8 3276.7 FORMAT "%8.3" ECU_ADDRESS 0x404416 /end MEASUREMENT
/begin MEASUREMENT wkwale_w "Kurbelwellenwinkel im Arbeitsspiel ohne L¸ckenkorrektur" SWORD kw_q0p1 1 100 -720 1440 FORMAT "%8.3" ECU_ADDRESS 0x404418 /end MEASUREMENT
/begin MEASUREMENT wkwalkor_w "Winkel inklusive L¸cke bei Start ALE" UWORD kw_q0p1 1 100 0 720 FORMAT "%8.4" ECU_ADDRESS 0x40441A /end MEASUREMENT
/begin MEASUREMENT wkwalold_w "Kurbelwinkel zum Zeitpunkt B_ale  = 1" SWORD kw_q0p1 1 100 -3276.8 3276.7 FORMAT "%8.3" ECU_ADDRESS 0x40441C /end MEASUREMENT
/begin MEASUREMENT wkwaskor_w "korrigierter Auslaufwinkel" SWORD kw_q0p1 1 100 -3276.8 3276.7 FORMAT "%8.3" ECU_ADDRESS 0x40441E /end MEASUREMENT
/begin MEASUREMENT wkwrale_w "Winkel Kurbelwelle beim ersten r¸ckdrehenden Zahn (word)" SWORD kw_q0p1 1 100 -720 1440 FORMAT "%8.3" ECU_ADDRESS 0x404420 /end MEASUREMENT
/begin MEASUREMENT wkwstop_w "Motorabstellposition im Arbeitsspiel mit L¸ckenkorrektur" UWORD kw_q0p1 1 100 0 1000 FORMAT "%8.3" ECU_ADDRESS 0x3FE03E /end MEASUREMENT
/begin MEASUREMENT wtans "A/D-Wert f¸r Ansauglufttemperatur tans" UBYTE spg_ub_b5 1 100 0 4.98047 FORMAT "%5.3" ECU_ADDRESS 0x403AD5 /end MEASUREMENT
/begin MEASUREMENT wtka "A/D-Wert f¸r TKA (Temperatur K¸hlerausgang)" UBYTE spg_ub_b5 1 100 0 4.98047 FORMAT "%5.3" ECU_ADDRESS 0x403AD6 /end MEASUREMENT
/begin MEASUREMENT wtmot "A/D-Wert f¸r tmot" UBYTE spg_ub_b5 1 100 0 4.98047 FORMAT "%5.3" ECU_ADDRESS 0x403AD7 /end MEASUREMENT
/begin MEASUREMENT wtsg "Wert Temperatur Steuerger‰t" UBYTE spg_ub_b5 1 100 0 4.98047 FORMAT "%5.3" ECU_ADDRESS 0x403AD8 /end MEASUREMENT
/begin MEASUREMENT wub "Batteriespannung; vom AD-Wandler erfaﬂter Wert" UBYTE spg_ubatt 1 100 0 24.021 FORMAT "%5.2" ECU_ADDRESS 0x402800 /end MEASUREMENT
/begin MEASUREMENT zekpvl "Z‰hler Anzahl EKP-Vorl‰ufe" UBYTE dez 1 100 0 255 FORMAT "%5.1" ECU_ADDRESS 0x403705 /end MEASUREMENT
/begin MEASUREMENT zwatb "Grenzz¸ndwinkel" SBYTE zw_sb_q0p75 1 100 -96 95.25 FORMAT "%5.2" ECU_ADDRESS 0x4038F4 /end MEASUREMENT
/begin MEASUREMENT zwmatm "Z‰hler f¸r ATM-Wiederholstart und Faktor f¸r W‰rmemengen-Schwellen" UBYTE dez 1 100 0 255 FORMAT "%5.1" ECU_ADDRESS 0x3FE06F /end MEASUREMENT
/begin MEASUREMENT zwmatm2 "Z‰hler f¸r ATM-Wiederholstart und Faktor f¸r W‰rmemengen-Schwellen Bank2" UBYTE dez 1 100 0 255 FORMAT "%5.1" ECU_ADDRESS 0x3FE070 /end MEASUREMENT
/begin MEASUREMENT zwmatmf "Z‰hler f¸r ATM-Wiederholstart und Faktor f¸r W‰rmemengen-Schwellwert upstream" UBYTE dez 1 100 0 255 FORMAT "%5.1" ECU_ADDRESS 0x3FE071 /end MEASUREMENT
/begin MEASUREMENT zwmatmf2 "Z‰hler f¸r ATM-Wiederholst.und Faktor f¸r W‰rmemengen-Schwellw. upstream Bank2" UBYTE dez 1 100 0 255 FORMAT "%5.1" ECU_ADDRESS 0x3FE072 /end MEASUREMENT
/begin MEASUREMENT zwoutm "Mittelwert der Z¸ndwinkel-Ausgabe" SBYTE zw_sb_q0p75 1 100 -96 95.25 FORMAT "%5.2" ECU_ADDRESS 0x4038F5 /end MEASUREMENT
/begin MEASUREMENT zwoutm2 "Mittler Istz¸ndwinkel f¸r Bank 2" SBYTE zw_sb_q0p75 1 100 -96 95.25 FORMAT "%5.2" ECU_ADDRESS 0x4038F6 /end MEASUREMENT
/begin MEASUREMENT zwoutm_tmp "" SWORD zw_sb_q0p75 1 100 -24576 24575.3 FORMAT "%8.2" ECU_ADDRESS 0x404656 /end MEASUREMENT
/begin FUNCTION AANSKL "2.10      Ansteuerung Ansaugklappe" /begin DEF_CHARACTERISTIC DNANSKL DTAANSKL NMNANSKL TAANSKLE TAANSKTU VMNANSKL /end DEF_CHARACTERISTIC /begin IN_MEASUREMENT B_ansklet B_btanskl B_vl nmot tans tumg vfzg /end IN_MEASUREMENT /begin OUT_MEASUREMENT B_anskl /end OUT_MEASUREMENT /end FUNCTION
/begin FUNCTION ADCIN "" /begin IN_MEASUREMENT B_adcc_um /end IN_MEASUREMENT
 /begin OUT_MEASUREMENT Disa_spg uddss_w udkp1v_w udkp1_w udkp2_w udsu_w uhsh uhsh2 upwg1_w upwg2_w urinlsu2_w urinlsu_w uthk uthk2 uulsuv2_w uulsuv_w uuptes_w wtans wtka wtmot wtsg wub /end OUT_MEASUREMENT
/end FUNCTION
/begin FUNCTION ADVE "3.110     Ansteuerung der DV-E mit dem DLR"
 /begin DEF_CHARACTERISTIC CWDKNOLU CWDLRIKL DANTGESWNV DANTGESWV DANTSCHWNV DANTSCHWV DKLAGERT DLRDWDKSS1 DLRDWDKSS2 DLRHAFTMN DLRHAFTST DLRIAMAXA DLRIKLPAR DLRININI DLRKDONLP0 DLRKDUNLP0 DLRKDUNLP1 DLRKDUNLP2 DLRKDUNLP3 DLRKIONLP0 DLRKIUNLP0 DLRKIUNLP1 DLRKIUNLP2 DLRKIUNLP3 DLRKPONLP0 DLRKPUNLP0 DLRKPUNLP1 DLRKPUNLP2 DLRKPUNLP3 DLRKREIS DLRKREISST DLRNLPD DLRPID0T DLRPID1T DLRPID2T DLRPIDMAX DLRPIDMIN DLRUBSOLL DLRUMABAND DLRUMAIINI DVEEST DWDKSBAMX DWDKSIKLS KDLRIDDVE MAXWPEDPWS TDKLAGDE TDLRHAFTMX TDLRPIDC TPWRSV UDKNLPTOL WDKBEWS WDKNLPTOL WDKREIB WDKSAPNOL WDKSTFEIN WDKSTGROB ZKUBDLR ZKWDKSPT1 /end DEF_CHARACTERISTIC
 /begin IN_MEASUREMENT B_dcdisr B_dkaden B_dknolu B_dknot B_dkp1e B_dkp2e B_dkpiu B_dlrien B_i_ska_um B_kl15 B_lrnerf B_lrnrdy B_nmot B_pwf B_st B_stend B_wdk1v B_wdk2sel ES_sfmdk nmot tans tmot ub udknlp1 udknlp2 udkp1_w udkp2_w wdkada_w wdkba_w wdknlp_w wdks_w wped /end IN_MEASUREMENT
 /begin OUT_MEASUREMENT AS_dimdk B_apnoluv B_appnolu B_dcdisfr B_dlrbe B_dlrparc B_dlrpide B_dlrspid B_dlrumzu B_dveese B_dveesh B_dvete B_nlpne B_pwrsv B_ubdve B_ubpvg B_ub_ok B_wdksive dklagerc dlrspid_w dpwrsvc /end OUT_MEASUREMENT
 /begin LOC_MEASUREMENT B_dkbew B_dlrikla B_dlriklst B_iklrest B_iklstar B_wdksauf dlrd dlrhaftak dlri dlriamax dlriant_w dlrihaftc dlriklst_w dlrikl_w dlrini_w dlrkomp dlrndif_w dlrp dlrpidc dveesc dwdkdlr_w gwdkdlr_w gwdk_kge wdkdlra_w wdkdlr_w wdksfi_w /end LOC_MEASUREMENT
/end FUNCTION
/begin FUNCTION AEKP "18.20     Ausgabe EKP-Ansteuerung" /begin DEF_CHARACTERISTIC MXANZEKPVL PEKP TPDVL TSTAPVL TZMIN TZZMX UBSTS VKSTPV /end DEF_CHARACTERISTIC
 /begin IN_MEASUREMENT B_airbag B_bt B_btekp B_ekpet B_estart B_nmot B_sta tabst_w trmin_w ubsq zzkwas_w /end IN_MEASUREMENT
 /begin OUT_MEASUREMENT B_ekp /end OUT_MEASUREMENT
 /begin LOC_MEASUREMENT B_ekpd B_ekps B_ekpsl B_ekpvl B_ekpvla B_tooth dekpub tekpvabt_w vkst_w zekpvl /end LOC_MEASUREMENT
/end FUNCTION
/begin FUNCTION AEVAB "6.80      Ausgabe Einspritzung Ev-Ausblendung" /begin DEF_CHARACTERISTIC CWEVAB REDABM /end DEF_CHARACTERISTIC
 /begin IN_MEASUREMENT anzeausb B_dkuevab B_faevz B_phsnl devoff flgstinj_w flgtiab redsol zyleausb zzyl /end IN_MEASUREMENT
 /begin OUT_MEASUREMENT abmf B_dmdstop B_nlphea eevx evz_aus fevab stateaevab /end OUT_MEASUREMENT
 /begin LOC_MEASUREMENT anzeab B_fophsnl B_frdph B_nlpheai dmdevab evrbgn_one fevabe redsolr redsol_one tvrnr /end LOC_MEASUREMENT
/end FUNCTION
/begin FUNCTION AEVABU "1.11      Ausgabe EV-Abschaltung durch ‹berwachungsfunktionen bei EGAS" /begin DEF_CHARACTERISTIC NMXSKA /end DEF_CHARACTERISTIC /begin IN_MEASUREMENT B_dknolu B_dkpu B_i_ska_um B_nmaxd nmot /end IN_MEASUREMENT /begin OUT_MEASUREMENT B_dkuevab B_evabu B_skaevab /end OUT_MEASUREMENT /end FUNCTION
/begin FUNCTION AEVABZK "4.10      Ausgabe Ev-Abschaltung %MDRED + Komplettabschaltung durch ‹berwachungsfunktionen"
 /begin IN_MEASUREMENT B_ausc_act B_dmdstop B_dveada B_evabu B_mstpssg B_nlph B_wdaactiv evz_aus /end IN_MEASUREMENT
 /begin OUT_MEASUREMENT B_evasel evz_austot /end OUT_MEASUREMENT
/end FUNCTION
/begin FUNCTION AKR "2.60      Ansteuerung Abgasklappe (f¸r Resonator)"
 /begin DEF_CHARACTERISTIC CWAKR DTMOTAKR DWPEDAKR KFAKR_GANG TMOTAKR TVSTAKR VMINAKR VMINAKR2 /end DEF_CHARACTERISTIC
 /begin IN_MEASUREMENT B_bt B_btakr B_btakrst B_kh B_stend gangi nmot tmot tnst_w vfzg wpedvf /end IN_MEASUREMENT
 /begin OUT_MEASUREMENT B_akr /end OUT_MEASUREMENT
 /begin LOC_MEASUREMENT AKRLokBits1 B_akrtemp /end LOC_MEASUREMENT
/end FUNCTION
/begin FUNCTION ALE "7.20      Auslauferkennung"
 /begin DEF_CHARACTERISTIC AWALEMX GAP_TOOTH KLALETM NALEMIN RALEMAX RDUNDEF W360_ALE_IMPL W720_ALE_IMPL /end DEF_CHARACTERISTIC
 /begin REF_CHARACTERISTIC CWALE /end REF_CHARACTERISTIC
 /begin IN_MEASUREMENT B_bm B_nlale B_nldg B_nmot B_phsnlinv B_pwf B_stend B_zprel nmot_w tmot /end IN_MEASUREMENT
 /begin OUT_MEASUREMENT ALEBits1_10msSwOff ALEBits_10msSwOff ALEBits_tooth_int B_ale B_aleundef wkwstop_w /end OUT_MEASUREMENT
 /begin LOC_MEASUREMENT B_alechk B_enabale B_enabint B_engstop B_ralectr B_raleok B_rrdet B_strtint B_strtswof B_undef CO_GAP CO_WAS CO_WNBM ottstamp_l temp_klt_l temp_tn1_l temp_tn2_l temp_tn_l temp_w1 temp_w2 temp_w3 temp_w4 tooth10ms toothtim_l ttstamp_l ttstmpmx_l wkwalerr_w wkwale_w wkwalkor_w wkwalold_w wkwaskor_w wkwrale_w /end LOC_MEASUREMENT
/end FUNCTION
/begin FUNCTION ALSU "2.40      Ausgabefunktion LSU" /begin DEF_CHARACTERISTIC TAHRLSUMX TPHRLSU UBALSUMX /end DEF_CHARACTERISTIC /begin IN_MEASUREMENT B_nmot prhrlsu2_w prhrlsu_w ubsq /end IN_MEASUREMENT /begin OUT_MEASUREMENT B_hrlsaus tahrlsu2_w tahrlsu_w tphrlsu_w /end OUT_MEASUREMENT /begin LOC_MEASUREMENT fubkor_w /end LOC_MEASUREMENT /end FUNCTION
/begin FUNCTION AMUENE "3.20      Abspeicherung von Motor¸berdrehzahlereignissen" /begin DEF_CHARACTERISTIC NUEMAX /end DEF_CHARACTERISTIC /begin IN_MEASUREMENT B_eemrdy B_eepwf kmstand nmot_w /end IN_MEASUREMENT /begin OUT_MEASUREMENT anznmax kmstnmax nmaxvk_w /end OUT_MEASUREMENT /end FUNCTION
/begin FUNCTION ARMD "22.40     Momentenbasierte Antiruckelfunktion"
 /begin DEF_CHARACTERISTIC A0 A1 A2 B1 B2 CWARMD CWGETSL DNFILO DVFZAR FLRAG FLRAWG FLRHG FRARAG FRARAWG FRARHG KFDMDARO KFDMDARU KIFZGAG KIFZGAWG KIFZGHG KLGANGSL KLTVARSL NARAO NARASTG NARLL NDFILOG NDIFFOG NVG NVMNG NVMXG SMK08MDSW TAREIN TFARSL TMAR TMLAST TVARDASHG TVARKUPPLG TVARLSDG TVARS TVKUPAR TVKUPHS TVKUPRS TZSPINI VARAU WPEDU /end DEF_CHARACTERISTIC
 /begin REF_CHARACTERISTIC SGA08MDUB /end REF_CHARACTERISTIC
 /begin IN_MEASUREMENT B_autget B_brems B_dash B_gwhs B_kuppl B_kupplmod B_ll B_lsd B_mdein B_sa B_stend B_wk codget esst_sga08mdub gangi mdverl_w mifa_w misolv_w nmot nmot_w nvquot_w stssgkpl tmot vfzg vfzg_w vrad_lh vrad_lv vrad_rh vrad_rv wped_w /end IN_MEASUREMENT
 /begin OUT_MEASUREMENT B_ar dmar_w esst_smk08mdsw nmotk1_w nmotk2_w tmlastz tnmst1z tnmst2z /end OUT_MEASUREMENT
 /begin LOC_MEASUREMENT B_aren B_argf B_gangsl B_gfen B_hpnmot B_iniar B_iniar1 B_iniarv B_kupgw B_kupplar B_tpnmot dvra_w fdar flrar kifz_w mdbes_w mkar_w mlast_w ndar_w ndfibet_w ndfil_w ndiffog_w ndiff_w nmodiv_w nmod_w tvarsl_ctr tzarni vham_w vvam_w /end LOC_MEASUREMENT
/end FUNCTION
/begin FUNCTION ATBEG "1.80      Abgastemperaturbegrenzung (BMW)"
 /begin DEF_CHARACTERISTIC CWATBEG DTATB FTABGATB FTIKATATB FTKATATB KFLATBNOTL KFLATBTL1 KFLATBTL2 KFZWATBNOT KFZWATBTL1 KFZWATBTL2 KFZWDLATB KLLATBNOV KLLATBVL KLLATBVLT KLZKDLATB KLZWATBNOV KLZWATBVL KLZWATBVLT TABGATB TIKATATB TKATATB /end DEF_CHARACTERISTIC
 /begin IN_MEASUREMENT B_dash B_fil B_gsaf B_vl B_zwdyn dpsfak E_vvt_zw lamfa_w nmot_w rl_w tabgm_w tikatm_w tkatm_w zwoutzyl /end IN_MEASUREMENT
 /begin OUT_MEASUREMENT B_atbeg B_atbegl fakatb2_w fakatb_w lamatb2_w lamatb_w /end OUT_MEASUREMENT
 /begin LOC_MEASUREMENT B_fbstabgm B_tabgatb B_tikatatb B_tkatatb dlatb2_w dlatbnf2_w dlatbnf_w dlatb_w dzwatb dzwatb2 latb_w nmot_tmp rl_tmp zwatb zwoutm zwoutm2 zwoutm_tmp /end LOC_MEASUREMENT
/end FUNCTION
/begin FUNCTION ATD "1.10      Ansteuerung TD-Signal (segmentsynchron)" /end FUNCTION
/begin FUNCTION ATEV "6.110     Ansteuerung Tankentl¸ftungsventil (Periodendauer)" /begin DEF_CHARACTERISTIC KFTEVP KFTVTEV TATEGRDO TATEGRDU TEVPMN1 TEVPMN2 TMNTEVZU /end DEF_CHARACTERISTIC /begin REF_CHARACTERISTIC CWTEACFG FMTEVEIN /end REF_CHARACTERISTIC
 /begin IN_MEASUREMENT B_dtes B_evloc B_tevcheck B_tevtini dpssol_w dps_uw dps_w msteo_w mstesoll_w nmot pu tadtea tans tefreq ub ub_w /end IN_MEASUREMENT
 /begin OUT_MEASUREMENT B_tevtstp tateist tateout tatesoll tevper ttevein /end OUT_MEASUREMENT
 /begin LOC_MEASUREMENT kftevp tatemxfq tateroh tteveroh tvtevptu /end LOC_MEASUREMENT
/end FUNCTION
/begin FUNCTION ATM "50.20     Abgastemperaturmodell"
 /begin DEF_CHARACTERISTIC ATMTANS CWATM DTUMTAT FATMRML FATMRML2 FTABGMSA FTABGMSA2 FWMABGW FWMABGW2 FWMKATW FWMKATW2 IMTUMTAT KATMEXML KATMEXML2 KATMIEXML KATMIEXML2 KFATMABKA KFATMABKA2 KFATMABKK KFATMABKK2 KFATMLA KFATMLA2 KFATMZW KFATMZW2 KFTATM KFTATM2 KFWMABG KFWMABG2 KFWMKAT KFWMKAT2 KLATMILAE KLATMILAE2 KLATMIZWE KLATMIZWE2 KLATMLAE KLATMLAE2 KLATMZWE KLATMZWE2 MSTPKTU NTUMTAT STS06TMUW STU05TMUB TABGMEX TASTBFA TATMKH TATMKH2 TATMKW TATMRTPK TATMRTPK2 TATMSA TATMSAE TATMSAE2 TATMSTI TATMTMOT TATMTP TATMTRKH TATMTRKH2 TATMWMK TIKATMOE TKATMOE TKATMTPMN TKSTBFA TNLATM TNLATMTM TNLATMTU TUMTAIT VTUMTAT WMABGKH WMABGKH2 WMKATKH WMKATKH2 ZATMAML ZATMAML2 ZATMIKML ZATMIKML2 ZATMKML ZATMKML2 ZATMRML ZATMRML2 ZATMSAML ZATMSAML2 /end DEF_CHARACTERISTIC
 /begin REF_CHARACTERISTIC SEZ06TMUB SLX06TMUW SLY06TMUW SML06TMUW SML07TMUW ST107TMUB ST207TMUB ST307TMUB ST407TMUB STM05TMUB /end REF_CHARACTERISTIC
 /begin IN_MEASUREMENT B_abstgp B_faatm B_kh B_kw B_nachlend B_nlatm B_nmot B_pwf B_sa B_st B_stend B_tfu B_trkh B_uhrrmin B_uhrrsec esst_sez06tmub esst_slx06tmuw esst_sly06tmuw esst_sml06tmuw esst_sml07tmuw esst_st107tmub esst_st207tmub esst_st307tmub esst_st407tmub esst_stm05tmub etazwist lamsbg2_w lamsbg_w ml ml_w msabg2_w msabg_w nmot rl tabst_w tans tmot tmst tumg vfzg /end IN_MEASUREMENT
 /begin OUT_MEASUREMENT ATMbits B_atmtpa B_atmtpa2 B_atmtpf B_atmtpf2 B_atmtpk B_atmtpk2 B_atmtpl B_atmtpl2 esst_sts06tmuw esst_stu05tmub etazwimt imlatm imlatm_w iwmatm2_w iwmatmk2_w iwmatmk_w iwmatm_w tabgm tabgm2 tabgm2_w tabgmab tabgmab2 tabgmst tabgmst2 tabgm_w tatu tikatm tikatm2 tikatm2_w tikatm_w tkatm tkatm2 tkatm2_w tkatmab tkatmab2 tkatmst tkatmst2 tkatm_w zwmatm zwmatm2 zwmatmf zwmatmf2 /end OUT_MEASUREMENT
 /begin LOC_MEASUREMENT B_atmrtpk B_atmrtpk2 B_atmst B_atmst2 B_msmntpk B_msmntpk2 B_stndnl tabstatm_w tabstmx_w tatmaml tatmaml2 tatmkf tatmkf2 tatmrml tatmrml2 tatmsam tatmsam2 tatmsta tatmsta2 texkor texkor2 texml texml2 texoikm2_w texoikm_w texom2_w texom_w tiexkor tiexkor2 tiexml tiexml2 /end LOC_MEASUREMENT
/end FUNCTION
/begin FUNCTION AVVT "1.20      Ansteuerung VVT Enable" /begin IN_MEASUREMENT tavvtout_w vvtper_w /end IN_MEASUREMENT /end FUNCTION
/begin FUNCTION BBBO "2.20      Betriebsbereich Erkennung Benzin im ÷l" /begin DEF_CHARACTERISTIC ABOLRAR ABOMX IMLKS TMSKS /end DEF_CHARACTERISTIC /begin IN_MEASUREMENT B_clradbbo B_pwf B_stend ml_w tmst /end IN_MEASUREMENT /begin OUT_MEASUREMENT abo B_abor imlbbo imlbbo_w /end OUT_MEASUREMENT /end FUNCTION
/begin FUNCTION BBFEWNE "1.20      Aufbereitung der Fehlermeldungen des Hardwaretreibers von KW u. NW" /begin IN_MEASUREMENT B_bm B_nmot inisynmon zzyl /end IN_MEASUREMENT
 /begin OUT_MEASUREMENT bmlosctr_w B_fbm B_nocampos B_outofsyn erdrcamctr erdrrevctr erdrsynctr tmcorctr_w tpcorctr_w uzkw_w /end OUT_MEASUREMENT
/end FUNCTION
/begin FUNCTION BBFGR "Ein- und Ausschaltbedingungen Fahrgeschwindigkeitsregler"
 /begin DEF_CHARACTERISTIC BFGRO BFGRU CWBBFGR CWBFGROF DVAQUGMX DVAQUKMX DVFGREO DVFGREU DVIVZMX DVZVIMX GAFGRO GAFGRU NFGRMAX TDVIVZ TDVZVI TFGRAQU TFGRASCOF TFGRBREOF TFGRDSCOF TFGRUEOB TFGRUM TFGRUNUB VBGFGRAQ VFGRMAX VFGRMIN VREGLMAXKM VREGLMAXMI VREGLMINKM VREGLMINMI /end DEF_CHARACTERISTIC
 /begin REF_CHARACTERISTIC TFGRARLG /end REF_CHARACTERISTIC
 /begin IN_MEASUREMENT bfzglfgr B_asc_reg B_asr B_asrext B_brems B_dknolu B_dknot B_dkpiu B_dsc_reg B_evfzgv1 B_fgr B_fgrabz B_fgrat B_fgren B_fgrhe B_fgrhsa B_fgrkf B_fgrtb2 B_fgrtbe B_fgrtse B_fgrtv2 B_fgrtve B_fgrtwa B_fgr_um B_gwhs B_km B_kuppl B_msrext B_pwgnotfr codget gangi nmot vfgrrf_w vfgr_w vziel_w /end IN_MEASUREMENT
 /begin OUT_MEASUREMENT B_fgrab B_fgrai B_fgral B_fgras B_fgrenv B_fgresv vreglmax_w vreglmin_w /end OUT_MEASUREMENT
 /begin LOC_MEASUREMENT BBFGRlokBits B_fgraext B_fgrars B_fgres /end LOC_MEASUREMENT
/end FUNCTION
/begin FUNCTION BBGANG "16.50     Betriebsbereich Gang"
 /begin DEF_CHARACTERISTIC CWIHAADP IHASTD NGANGMIN NVIHA2G NVIHAADAP1 NVIHAADAP2 NVQUOT1O NVQUOT1U NVQUOT2O NVQUOT2U NVQUOT3O NVQUOT3U NVQUOT4O NVQUOT4U NVQUOT5O NVQUOT5U NVQUOT6O NVQUOT6U ZKIHAADP ZKNVQUOT /end DEF_CHARACTERISTIC
 /begin IN_MEASUREMENT B_brems B_clradiha B_evfzgv1 B_kuppl B_pwf B_sa B_vnull codget gangauti nmot_w vfzgv1f_w vfzg_w /end IN_MEASUREMENT
 /begin OUT_MEASUREMENT B_gwhs fakiha gangi iha nvquotr_w nvquot_w /end OUT_MEASUREMENT
 /begin LOC_MEASUREMENT vfzgtemp_w /end LOC_MEASUREMENT
/end FUNCTION
/begin FUNCTION BBHWONOF "1.60      Betriebsbereich SG HW Startup und abschalten" /begin DEF_CHARACTERISTIC CWNVRAMBK /end DEF_CHARACTERISTIC /begin REF_CHARACTERISTIC CWPWF /end REF_CHARACTERISTIC /begin IN_MEASUREMENT B_wdapwf /end IN_MEASUREMENT
 /begin OUT_MEASUREMENT B_eepwf B_hwpwf B_pwf B_pwfPat B_restore B_restoreok B_rqnvrbup eeeExitStatus /end OUT_MEASUREMENT
 /begin LOC_MEASUREMENT BBHWONOFbits /end LOC_MEASUREMENT
/end FUNCTION
/begin FUNCTION BBKD "1.10      Berechnung der Kick-Down-Information" /begin DEF_CHARACTERISTIC UPWGKDO UPWGKDU WPKDMN /end DEF_CHARACTERISTIC /begin IN_MEASUREMENT B_pwgnotfr upwgej_w wped_w /end IN_MEASUREMENT /begin OUT_MEASUREMENT B_kd /end OUT_MEASUREMENT /end FUNCTION
/begin FUNCTION BBKHZ "29.70     Betriebsbereich motorisches Katheizen"
 /begin DEF_CHARACTERISTIC BTRKHTMS CWKHZ CWKHZ2 DTKATMN DTKH DTMABKH FHOKH FKHABMN FKHLA FKHMD FNSKHLL FTMLAKH IMLATWS IMLKHMX IMLKHTMS KFMLSUS KFNFSKHM KFNLLKHM KTNDMRKH MLKHMX NLLKT TABSTKH TABSTKHX TKATMN TKATW TKHABB TKHFSAB TKHLL TKHLLAB TKHLLMX TKHMX TKHNAB TMSLOF TNSDMRKH ZKHABB ZKLAMKH /end DEF_CHARACTERISTIC
 /begin REF_CHARACTERISTIC CWSLS2 SFR04BBUW STM08BBUB /end REF_CHARACTERISTIC
 /begin IN_MEASUREMENT B_bkvleer B_dsla B_dvvtobd B_fa B_fasla B_fs B_hag B_ll B_lmsslof B_msloff B_nmot B_pwf B_slkhof B_slpoff B_slsfz B_st B_stend B_wst esst_sfr04bbuw esst_stm08bbub fcoschmn_w fho_w frhol_w imlatm_w ml tabst_w tans tkatm tmot tmotab tmst tnst_w /end IN_MEASUREMENT
 /begin OUT_MEASUREMENT B_kh B_kha B_khab B_khn B_khno B_kw B_trkh fhost_w fkhab fkhnab flakh flamkh fmdkh imlpr imlpr_w nfskh nllkh /end OUT_MEASUREMENT
 /begin LOC_MEASUREMENT BBKHZlokBits B_imlprini B_khares B_khaset B_kherr B_khll B_khlle B_khllmx B_khres B_khset B_khstc B_mlsu fmdkhtns_w imlatmw_w mlsu_w tanskhst tkhnab_ctr /end LOC_MEASUREMENT
/end FUNCTION
/begin FUNCTION BBKURU "1.10      Betriebsbereich Erkennung Kupplung rutscht" /begin DEF_CHARACTERISTIC IKURUN IKURUP TVKURU ZKURU /end DEF_CHARACTERISTIC /begin REF_CHARACTERISTIC SGA07MDUB /end REF_CHARACTERISTIC /begin IN_MEASUREMENT B_kuppl esst_sga07mdub gangi nvquot_w /end IN_MEASUREMENT /begin OUT_MEASUREMENT B_kurn B_kurp dnvquotf_w dnvquot_w /end OUT_MEASUREMENT /end FUNCTION
/begin FUNCTION BBLOWBAT "1.40      Betriebsbereich Spannungseinbruch unter 5V" /begin IN_MEASUREMENT B_stares5v /end IN_MEASUREMENT /begin OUT_MEASUREMENT res5vctr_w res5vsta_l res5vsts_l tirq1ofd_w /end OUT_MEASUREMENT /begin LOC_MEASUREMENT bblowenctr bblowinctr bblowmactr /end LOC_MEASUREMENT /end FUNCTION
/begin FUNCTION BBPEDBR "1.30      Plausibilisierung Fahrpedalwert/Bremspedal; Dokumentation" /begin DEF_CHARACTERISTIC TWPEDBR WPEDFMX /end DEF_CHARACTERISTIC /begin IN_MEASUREMENT B_bl B_br B_eemrdy B_eepwf B_nmot kmstand wped_w /end IN_MEASUREMENT /begin OUT_MEASUREMENT anzpbr_w kmstpbr_w /end OUT_MEASUREMENT /end FUNCTION
/begin FUNCTION BBRCVRY "1.40      System Recovery nach Reset"
 /begin OUT_MEASUREMENT B_recRes5v B_recSta B_wdapwf recRes5vSr recRes5vSt recWDASt /end OUT_MEASUREMENT
/end FUNCTION
/begin COMPU_METHOD bfzg_sb_q0p217 "" RAT_FUNC "%6.3" "m/s^2" COEFFS 0 1 0 0 0 0.217 /end COMPU_METHOD
/begin COMPU_METHOD B_TRUE "boolsche Zust‰nde, positive Logik" TAB_VERB "%6.3" "" COMPU_TAB_REF B_TRUE /end COMPU_METHOD
/begin COMPU_VTAB B_TRUE "boolsche Zust‰nde, positive Logik" TAB_VERB 2 0 "----" 1 "TRUE" /end COMPU_VTAB
/begin COMPU_METHOD DEZ "1 : 1 Umrechnug (dez/hex)" RAT_FUNC "%6.2" "" COEFFS 0 1 0 0 0 1 /end COMPU_METHOD
/begin COMPU_METHOD dez "1 : 1 Umrechnug (dez/hex)" RAT_FUNC "%6.2" "" COEFFS 0 1 0 0 0 1 /end COMPU_METHOD
/begin COMPU_METHOD fak_q0p00273 "" RAT_FUNC "%6.4" "-" COEFFS 0 256 0 0 0 0.7 /end COMPU_METHOD
/begin COMPU_METHOD fak_q0p01 "" RAT_FUNC "%6.4" "" COEFFS 0 100 0 0 0 1 /end COMPU_METHOD
/begin COMPU_METHOD fak_q0p0195 "" RAT_FUNC "%6.4" "-" COEFFS 0 256 0 0 0 5 /end COMPU_METHOD
/begin COMPU_METHOD fak_sw_b0p0625 "" RAT_FUNC "%8.7" "-" COEFFS 0 65536 0 0 0 0.125 /end COMPU_METHOD
/begin COMPU_METHOD fak_sw_b2 "" RAT_FUNC "%7.6" "-" COEFFS 0 65536 0 0 0 4 /end COMPU_METHOD
/begin COMPU_METHOD fak_ub_b0p5 "" RAT_FUNC "%6.4" "-" COEFFS 0 256 0 0 0 0.5 /end COMPU_METHOD
/begin COMPU_METHOD fak_ub_b1 "" RAT_FUNC "%6.4" "-" COEFFS 0 256 0 0 0 1 /end COMPU_METHOD
/begin COMPU_METHOD fak_ub_b16 "" RAT_FUNC "%6.4" "-" COEFFS 0 256 0 0 0 16 /end COMPU_METHOD
/begin COMPU_METHOD fak_ub_b2 "" RAT_FUNC "%6.4" "-" COEFFS 0 256 0 0 0 2 /end COMPU_METHOD
/begin COMPU_METHOD fak_ub_b318p75 "" RAT_FUNC "%6.2" "-" COEFFS 0 256 0 0 0 318.75 /end COMPU_METHOD
/begin COMPU_METHOD fak_ub_b3p125 "" RAT_FUNC "%6.4" "%/1/min" COEFFS 0 2048 0 0 0 25 /end COMPU_METHOD
/begin COMPU_METHOD fak_uw_b1 "" RAT_FUNC "%7.6" "-" COEFFS 0 65536 0 0 0 1 /end COMPU_METHOD
/begin COMPU_METHOD fak_uw_b16 "" RAT_FUNC "%6.5" "-" COEFFS 0 65536 0 0 0 16 /end COMPU_METHOD
/begin COMPU_METHOD fak_uw_b2 "" RAT_FUNC "%7.6" "-" COEFFS 0 65536 0 0 0 2 /end COMPU_METHOD
/begin COMPU_METHOD fak_uw_b4 "" RAT_FUNC "%7.6" "-" COEFFS 0 65536 0 0 0 4 /end COMPU_METHOD
/begin COMPU_METHOD fak_uw_b4864 "" RAT_FUNC "%6.4" "-" COEFFS 0 65536 0 0 0 4864 /end COMPU_METHOD
/begin COMPU_METHOD km_uw_q10 "" RAT_FUNC "%6.1" "km" COEFFS 0 1 0 0 0 10 /end COMPU_METHOD
/begin COMPU_METHOD kw_q0p1 "" RAT_FUNC "%6.3" "Grad KW" COEFFS 0 10 0 0 0 1 /end COMPU_METHOD
/begin COMPU_METHOD m_ub_b1020 "" RAT_FUNC "%6.2" "kg/h" COEFFS 0 1 0 0 0 4 /end COMPU_METHOD
/begin COMPU_METHOD m_ub_b23p3 "" RAT_FUNC "%6.3" "kg" COEFFS 0 2812.5 0 0 0 256 /end COMPU_METHOD
/begin COMPU_METHOD m_ub_b5p8 "" RAT_FUNC "%6.4" "kg" COEFFS 0 5625 0 0 0 128 /end COMPU_METHOD
/begin COMPU_METHOD m_uw_b23p3 "" RAT_FUNC "%6.5" "kg" COEFFS 0 2812.5 0 0 0 1 /end COMPU_METHOD
/begin COMPU_METHOD m_uw_b6553p5 "" RAT_FUNC "%6.3" "kg/h" COEFFS 0 1 0 0 0 0.1 /end COMPU_METHOD
/begin COMPU_METHOD nmot_sw_q0p25 "" RAT_FUNC "%6.3" "1/min" COEFFS 0 1 0 0 0 0.25 /end COMPU_METHOD
/begin COMPU_METHOD nmot_ub_q10 "" RAT_FUNC "%6.1" "1/min" COEFFS 0 1 0 0 0 10 /end COMPU_METHOD
/begin COMPU_METHOD nmot_ub_q40 "" RAT_FUNC "%6.1" "1/min" COEFFS 0 1 0 0 0 40 /end COMPU_METHOD
/begin COMPU_METHOD nmot_uw_q0p15625 "" RAT_FUNC "%6.3" "1/min" COEFFS 0 6.4 0 0 0 1 /end COMPU_METHOD
/begin COMPU_METHOD nmot_uw_q0p25 "" RAT_FUNC "%6.3" "1/min" COEFFS 0 1 0 0 0 0.25 /end COMPU_METHOD
/begin COMPU_METHOD p_q0p039s32768 "" RAT_FUNC "%7.1" "hPa" COEFFS 0 256 327680 0 0 10 /end COMPU_METHOD
/begin COMPU_METHOD qnv_sw_q0p0078 "" RAT_FUNC "%6.4" "(1/min) / (km/h)" COEFFS 0 65536 0 0 0 512 /end COMPU_METHOD
/begin COMPU_METHOD qnv_uw_b512 "" RAT_FUNC "%6.4" "(1/min) / (km/h)" COEFFS 0 65536 0 0 0 512 /end COMPU_METHOD
/begin COMPU_METHOD q_q0p4551 "" RAT_FUNC "%6.3" "kJ" COEFFS 0 36000 0 0 0 16384 /end COMPU_METHOD
/begin COMPU_METHOD relDK_q0p00152 "" RAT_FUNC "%6.4" "%DK" COEFFS 0 65536 0 0 0 100 /end COMPU_METHOD
/begin COMPU_METHOD relDK_q0p02441 "" RAT_FUNC "%6.4" "%DK" COEFFS 0 65536 0 0 0 1600 /end COMPU_METHOD
/begin COMPU_METHOD relDK_q0p0625 "" RAT_FUNC "%6.4" "%PWM/%DK" COEFFS 0 16 0 0 0 1 /end COMPU_METHOD
/begin COMPU_METHOD relDK_q1 "" RAT_FUNC "%6.2" "%PWM/%DK" COEFFS 0 1 0 0 0 1 /end COMPU_METHOD
/begin COMPU_METHOD relDK_q4 "" RAT_FUNC "%6.2" "%" COEFFS 0 1 0 0 0 4 /end COMPU_METHOD
/begin COMPU_METHOD relDK_uw_b100 "" RAT_FUNC "%6.4" "%DK" COEFFS 0 65535 0 0 0 100 /end COMPU_METHOD
/begin COMPU_METHOD relPED_ub_b100 "" RAT_FUNC "%6.3" "%PED" COEFFS 0 255 0 0 0 100 /end COMPU_METHOD
/begin COMPU_METHOD relPED_uw_b100 "" RAT_FUNC "%6.4" "%PED" COEFFS 0 65535 0 0 0 100 /end COMPU_METHOD
/begin COMPU_METHOD rel_q0p1957 "" RAT_FUNC "%6.3" "%" COEFFS 0 511 0 0 0 100 /end COMPU_METHOD
/begin COMPU_METHOD rel_sw_b100 "" RAT_FUNC "%6.4" "%" COEFFS 0 32768 0 0 0 100 /end COMPU_METHOD
/begin COMPU_METHOD rel_sw_q0p1953 "" RAT_FUNC "%6.3" "%" COEFFS 0 65536 0 0 0 12800 /end COMPU_METHOD
/begin COMPU_METHOD rel_ub_b127p5 "" RAT_FUNC "%6.3" "%" COEFFS 0 2 0 0 0 1 /end COMPU_METHOD
/begin COMPU_METHOD rel_ub_b99p6 "" RAT_FUNC "%6.3" "%" COEFFS 0 256 0 0 0 100 /end COMPU_METHOD
/begin COMPU_METHOD rel_ub_q0p75 "" RAT_FUNC "%6.3" "%" COEFFS 0 1 0 0 0 0.75 /end COMPU_METHOD
/begin COMPU_METHOD rel_uw_b100 "" RAT_FUNC "%6.4" "%" COEFFS 0 65536 0 0 0 100 /end COMPU_METHOD
/begin COMPU_METHOD rel_uw_b200 "" RAT_FUNC "%6.4" "%" COEFFS 0 65536 0 0 0 200 /end COMPU_METHOD
/begin COMPU_METHOD rel_uw_q0p0234 "" RAT_FUNC "%6.4" "%" COEFFS 0 32 0 0 0 0.75 /end COMPU_METHOD
/begin COMPU_METHOD spg_q0p1 "" RAT_FUNC "%6.3" "V" COEFFS 0 1 0 0 0 0.1 /end COMPU_METHOD
/begin COMPU_METHOD spg_ubatt "" RAT_FUNC "%6.3" "V" COEFFS 0 1 0 0 0 0.0942 /end COMPU_METHOD
/begin COMPU_METHOD spg_ub_b5 "" RAT_FUNC "%6.4" "V" COEFFS 0 256 0 0 0 5 /end COMPU_METHOD
/begin COMPU_METHOD spg_uw_b5 "" RAT_FUNC "%6.4" "V" COEFFS 0 1024 0 0 0 5 /end COMPU_METHOD
/begin COMPU_METHOD spg_uw_q0p001222 "" RAT_FUNC "%6.4" "V" COEFFS 0 65536 0 0 0 80 /end COMPU_METHOD
/begin COMPU_METHOD spg_uw_q0p00488 "" RAT_FUNC "%6.4" "V" COEFFS 0 1024 0 0 0 5 /end COMPU_METHOD
/begin COMPU_METHOD t100msxs_q16Em6 "" RAT_FUNC "%7.6" "s" COEFFS 0 1 0 0 0 1.6e-005 /end COMPU_METHOD
/begin COMPU_METHOD t100msxs_ub_b25p5 "" RAT_FUNC "%6.3" "s" COEFFS 0 1 0 0 0 0.1 /end COMPU_METHOD
/begin COMPU_METHOD t100msxs_uw_b6553p5 "" RAT_FUNC "%6.3" "s" COEFFS 0 1 0 0 0 0.1 /end COMPU_METHOD
/begin COMPU_METHOD t10msxs_ub_b2p55 "" RAT_FUNC "%6.4" "s" COEFFS 0 1 0 0 0 0.01 /end COMPU_METHOD
/begin COMPU_METHOD t10msxs_uw_b655p35 "" RAT_FUNC "%6.4" "s" COEFFS 0 1 0 0 0 0.01 /end COMPU_METHOD
/begin COMPU_METHOD t128ms_uw "" RAT_FUNC "%6.4" "ms" COEFFS 0 512 0 0 0 1 /end COMPU_METHOD
/begin COMPU_METHOD t1ms_ub_b255 "" RAT_FUNC "%7.3" "ms" COEFFS 0 1 0 0 0 1 /end COMPU_METHOD
/begin COMPU_METHOD t1sxs_uw_b65535 "" RAT_FUNC "%6.2" "s" COEFFS 0 1 0 0 0 1 /end COMPU_METHOD
/begin COMPU_METHOD t1sxs_uw_q1 "" RAT_FUNC "%6.2" "s" COEFFS 0 1 0 0 0 1 /end COMPU_METHOD
/begin COMPU_METHOD t20msxs_ub_b5p1 "" RAT_FUNC "%6.4" "s" COEFFS 0 1 0 0 0 0.02 /end COMPU_METHOD
/begin COMPU_METHOD t20msxs_uw_q0p02 "" RAT_FUNC "%6.4" "s" COEFFS 0 1 0 0 0 0.02 /end COMPU_METHOD
/begin COMPU_METHOD t500usxms_ub_q0p5 "" RAT_FUNC "%6.3" "ms" COEFFS 0 1 0 0 0 0.5 /end COMPU_METHOD
/begin COMPU_METHOD t50msxs_q0p05 "" RAT_FUNC "%6.4" "s" COEFFS 0 1 0 0 0 0.05 /end COMPU_METHOD
/begin COMPU_METHOD temp_q0p0195 "" RAT_FUNC "%6.4" "Grad C" COEFFS 0 256 0 0 0 5 /end COMPU_METHOD
/begin COMPU_METHOD temp_q5 "" RAT_FUNC "%6.2" "Grad C" COEFFS 0 1 0 0 0 5 /end COMPU_METHOD
/begin COMPU_METHOD temp_ub_b191p25 "" RAT_FUNC "%6.3" "Grad C" COEFFS 0 1 0 0 0 0.75 /end COMPU_METHOD
/begin COMPU_METHOD temp_ub_q0p75_o48 "" RAT_FUNC "%6.2" "Grad C" COEFFS 0 1 48 0 0 0.75 /end COMPU_METHOD
/begin COMPU_METHOD temp_ub_q5_o50 "" RAT_FUNC "%6.2" "Grad C" COEFFS 0 1 50 0 0 5 /end COMPU_METHOD
/begin COMPU_METHOD temp_uw_q0p0195 "" RAT_FUNC "%6.4" "Grad C" COEFFS 0 256 0 0 0 5 /end COMPU_METHOD
/begin COMPU_METHOD temp_uw_q0p0195_o50 "" RAT_FUNC "%6.2" "Grad C" COEFFS 0 256 12800 0 0 5 /end COMPU_METHOD
/begin COMPU_METHOD t_q0p0001_ms "" RAT_FUNC "%7.6" "ms" COEFFS 0 1 0 0 0 0.0001 /end COMPU_METHOD
/begin COMPU_METHOD t_q0p2 "" RAT_FUNC "%6.3" "s" COEFFS 0 10 0 0 0 2 /end COMPU_METHOD
/begin COMPU_METHOD t_tev0p0005 "" RAT_FUNC "%6.5" "s" COEFFS 0 2048 0 0 0 1 /end COMPU_METHOD
/begin COMPU_METHOD vfzg_ub_q1p25 "" RAT_FUNC "%6.2" "km/h" COEFFS 0 1 0 0 0 1.25 /end COMPU_METHOD
/begin COMPU_METHOD vfzg_uw_b512 "" RAT_FUNC "%6.4" "km/h" COEFFS 0 65536 0 0 0 512 /end COMPU_METHOD
/begin COMPU_METHOD vfzg_uw_q0p0625 "" RAT_FUNC "%6.4" "km/h" COEFFS 0 1 0 0 0 0.0625 /end COMPU_METHOD
/begin COMPU_METHOD vol_q1ml "" RAT_FUNC "%6.2" "ml" COEFFS 0 1 0 0 0 1 /end COMPU_METHOD
/begin COMPU_METHOD zk100msxs_ub_b25p5 "" RAT_FUNC "%6.3" "s" COEFFS 0 0 256 0 10 0 /end COMPU_METHOD
/begin COMPU_METHOD zk100msxs_uw_b6553 "" RAT_FUNC "%6.1" "s" COEFFS 0 0 65536 0 10 0 /end COMPU_METHOD
/begin COMPU_METHOD zk10msxs_uw_b655 "" RAT_FUNC "%6.2" "s" COEFFS 0 0 65536 0 100 0 /end COMPU_METHOD
/begin COMPU_METHOD zk200msxs_uw_b13107 "" RAT_FUNC "%6.0" "s" COEFFS 0 0 13107 0 1 0 /end COMPU_METHOD
/begin COMPU_METHOD zk20msxs_uw_b1310 "" RAT_FUNC "%6.1" "s" COEFFS 0 0 1310 0 1 0 /end COMPU_METHOD
/begin COMPU_METHOD zk20msxs_uw_b1310p72 "" RAT_FUNC "%6.1" "s" COEFFS 0 0 32768 0 25 0 /end COMPU_METHOD
/begin COMPU_METHOD zw_sb_q0p75 "" RAT_FUNC "%6.3" "Grad KW" COEFFS 0 255 0 0 0 191.25 /end COMPU_METHOD
/begin COMPU_METHOD zw_ub_q0p75 "" RAT_FUNC "%6.3" "Grad KW" COEFFS 0 255 0 0 0 191.25 /end COMPU_METHOD
/begin RECORD_LAYOUT FkfNoShNoOffWUb FNC_VALUES 1 UBYTE COLUMN_DIR DIRECT /end RECORD_LAYOUT
/begin RECORD_LAYOUT FklWSw FNC_VALUES 1 SWORD COLUMN_DIR DIRECT /end RECORD_LAYOUT
/begin RECORD_LAYOUT FklWUb FNC_VALUES 1 UBYTE COLUMN_DIR DIRECT /end RECORD_LAYOUT
/begin RECORD_LAYOUT FklWUw FNC_VALUES 1 UWORD COLUMN_DIR DIRECT /end RECORD_LAYOUT
/begin RECORD_LAYOUT GkfWSb FNC_VALUES 1 SBYTE COLUMN_DIR DIRECT /end RECORD_LAYOUT
/begin RECORD_LAYOUT GkfWSw FNC_VALUES 1 SWORD COLUMN_DIR DIRECT /end RECORD_LAYOUT
/begin RECORD_LAYOUT GkfWU8 FNC_VALUES 1 UBYTE COLUMN_DIR DIRECT /end RECORD_LAYOUT
/begin RECORD_LAYOUT GkfWUb FNC_VALUES 1 UBYTE COLUMN_DIR DIRECT /end RECORD_LAYOUT
/begin RECORD_LAYOUT GkfWUw FNC_VALUES 1 UWORD COLUMN_DIR DIRECT /end RECORD_LAYOUT
/begin RECORD_LAYOUT GklWSb FNC_VALUES 1 SBYTE COLUMN_DIR DIRECT /end RECORD_LAYOUT
/begin RECORD_LAYOUT GklWSw FNC_VALUES 1 SWORD COLUMN_DIR DIRECT /end RECORD_LAYOUT
/begin RECORD_LAYOUT GklWUb FNC_VALUES 1 UBYTE COLUMN_DIR DIRECT /end RECORD_LAYOUT
/begin RECORD_LAYOUT GklWUw FNC_VALUES 1 UWORD COLUMN_DIR DIRECT /end RECORD_LAYOUT
/begin RECORD_LAYOUT KfAxU8AyU8SstxU16SstyU16WU16 NO_AXIS_PTS_X 1 UWORD NO_AXIS_PTS_Y 2 UWORD AXIS_PTS_X 3 UWORD INDEX_INCR DIRECT AXIS_PTS_Y 4 UWORD INDEX_INCR DIRECT FNC_VALUES 5 UWORD COLUMN_DIR DIRECT /end RECORD_LAYOUT
/begin RECORD_LAYOUT KfAxU8AyU8SstxU8SstyU16WU16 NO_AXIS_PTS_X 1 UBYTE NO_AXIS_PTS_Y 2 UBYTE AXIS_PTS_X 3 UBYTE INDEX_INCR DIRECT AXIS_PTS_Y 4 UWORD INDEX_INCR DIRECT FNC_VALUES 5 UWORD COLUMN_DIR DIRECT /end RECORD_LAYOUT
/begin RECORD_LAYOUT KfAxU8AyU8SstxU8SstyU8WU8 NO_AXIS_PTS_X 1 UBYTE NO_AXIS_PTS_Y 2 UBYTE AXIS_PTS_X 3 UBYTE INDEX_INCR DIRECT AXIS_PTS_Y 4 UBYTE INDEX_INCR DIRECT FNC_VALUES 5 UBYTE COLUMN_DIR DIRECT /end RECORD_LAYOUT
/begin RECORD_LAYOUT KfAxUbAyUbSstxUbSstyUbWUb NO_AXIS_PTS_X 1 UBYTE NO_AXIS_PTS_Y 2 UBYTE AXIS_PTS_X 3 UBYTE INDEX_INCR DIRECT AXIS_PTS_Y 4 UBYTE INDEX_INCR DIRECT FNC_VALUES 5 UBYTE COLUMN_DIR DIRECT /end RECORD_LAYOUT
/begin RECORD_LAYOUT KfAxUwAyUwSstxSwSstyUwWUw NO_AXIS_PTS_X 1 UWORD NO_AXIS_PTS_Y 2 UWORD AXIS_PTS_X 3 SWORD INDEX_INCR DIRECT AXIS_PTS_Y 4 UWORD INDEX_INCR DIRECT FNC_VALUES 5 UWORD COLUMN_DIR DIRECT /end RECORD_LAYOUT
/begin RECORD_LAYOUT KfAxUwAyUwSstxUwSstyUwWSw NO_AXIS_PTS_X 1 UWORD NO_AXIS_PTS_Y 2 UWORD AXIS_PTS_X 3 UWORD INDEX_INCR DIRECT AXIS_PTS_Y 4 UWORD INDEX_INCR DIRECT FNC_VALUES 5 SWORD COLUMN_DIR DIRECT /end RECORD_LAYOUT
/begin RECORD_LAYOUT KfAxUwAyUwSstxUwSstyUwWUw NO_AXIS_PTS_X 1 UWORD NO_AXIS_PTS_Y 2 UWORD AXIS_PTS_X 3 UWORD INDEX_INCR DIRECT AXIS_PTS_Y 4 UWORD INDEX_INCR DIRECT FNC_VALUES 5 UWORD COLUMN_DIR DIRECT /end RECORD_LAYOUT
/begin RECORD_LAYOUT KlAUbSstUbWSb NO_AXIS_PTS_X 1 UBYTE AXIS_PTS_X 2 UBYTE INDEX_INCR DIRECT FNC_VALUES 3 SBYTE COLUMN_DIR DIRECT /end RECORD_LAYOUT
/begin RECORD_LAYOUT KlAUbSstUbWUb NO_AXIS_PTS_X 1 UBYTE AXIS_PTS_X 2 UBYTE INDEX_INCR DIRECT FNC_VALUES 3 UBYTE COLUMN_DIR DIRECT /end RECORD_LAYOUT
/begin RECORD_LAYOUT KlAUbSstUbWUw NO_AXIS_PTS_X 1 UBYTE AXIS_PTS_X 2 UBYTE INDEX_INCR DIRECT FNC_VALUES 3 UWORD COLUMN_DIR DIRECT /end RECORD_LAYOUT
/begin RECORD_LAYOUT KlAUwSstUwWUw NO_AXIS_PTS_X 1 UWORD AXIS_PTS_X 2 UWORD INDEX_INCR DIRECT FNC_VALUES 3 UWORD COLUMN_DIR DIRECT /end RECORD_LAYOUT
/begin RECORD_LAYOUT KlAxU8SstxU16WS16 NO_AXIS_PTS_X 1 UWORD AXIS_PTS_X 2 UWORD INDEX_INCR DIRECT FNC_VALUES 3 SWORD COLUMN_DIR DIRECT /end RECORD_LAYOUT
/begin RECORD_LAYOUT KlAxU8SstxU16WU16 NO_AXIS_PTS_X 1 UWORD AXIS_PTS_X 2 UWORD INDEX_INCR DIRECT FNC_VALUES 3 UWORD COLUMN_DIR DIRECT /end RECORD_LAYOUT
/begin RECORD_LAYOUT KlAxU8SstxU8WU8 NO_AXIS_PTS_X 1 UBYTE AXIS_PTS_X 2 UBYTE INDEX_INCR DIRECT FNC_VALUES 3 UBYTE COLUMN_DIR DIRECT /end RECORD_LAYOUT
/begin RECORD_LAYOUT KwbUb FNC_VALUES 1 UBYTE COLUMN_DIR DIRECT /end RECORD_LAYOUT
/begin RECORD_LAYOUT KwSb FNC_VALUES 1 SBYTE COLUMN_DIR DIRECT /end RECORD_LAYOUT
/begin RECORD_LAYOUT KwSw FNC_VALUES 1 SWORD COLUMN_DIR DIRECT /end RECORD_LAYOUT
/begin RECORD_LAYOUT KwUb FNC_VALUES 1 UBYTE COLUMN_DIR DIRECT /end RECORD_LAYOUT
/begin RECORD_LAYOUT KwUw FNC_VALUES 1 UWORD COLUMN_DIR DIRECT /end RECORD_LAYOUT
/begin RECORD_LAYOUT KwWS16 FNC_VALUES 1 SWORD COLUMN_DIR DIRECT /end RECORD_LAYOUT
/begin RECORD_LAYOUT KwWU16 FNC_VALUES 1 UWORD COLUMN_DIR DIRECT /end RECORD_LAYOUT
/begin RECORD_LAYOUT KwWU8 FNC_VALUES 1 UBYTE COLUMN_DIR DIRECT /end RECORD_LAYOUT
/begin RECORD_LAYOUT SstASwSstSw NO_AXIS_PTS_X 1 SWORD AXIS_PTS_X 2 SWORD INDEX_INCR DIRECT /end RECORD_LAYOUT
/begin RECORD_LAYOUT SstAU8SstU16 NO_AXIS_PTS_X 1 UWORD AXIS_PTS_X 2 UWORD INDEX_INCR DIRECT /end RECORD_LAYOUT
/begin RECORD_LAYOUT SstAU8SstU8 NO_AXIS_PTS_X 1 UBYTE AXIS_PTS_X 2 UBYTE INDEX_INCR DIRECT /end RECORD_LAYOUT
/begin RECORD_LAYOUT SstAUbSstUb NO_AXIS_PTS_X 1 UBYTE AXIS_PTS_X 2 UBYTE INDEX_INCR DIRECT /end RECORD_LAYOUT
/begin RECORD_LAYOUT SstAUwSstUw NO_AXIS_PTS_X 1 UWORD AXIS_PTS_X 2 UWORD INDEX_INCR DIRECT /end RECORD_LAYOUT
/end MODULE
/end PROJECT
