ASAP2_VERSION 1 31
/begin PROJECT MS45 "BMW Motorsteuerung R6"
/begin HEADER "_default_HeaderComment" PROJECT_NO _57 /end HEADER
/begin MODULE _default_ModuleName "_default_ModuleLongIdentifier"
/begin MOD_COMMON "_default_ModCommonComment" DEPOSIT ABSOLUTE BYTE_ORDER MSB_FIRST ALIGNMENT_BYTE 1 ALIGNMENT_WORD 2 ALIGNMENT_LONG 4 ALIGNMENT_FLOAT32_IEEE 4 ALIGNMENT_FLOAT64_IEEE 8 /end MOD_COMMON
/begin MEASUREMENT tq_add_ch "torque reserve for catalyst heating" SWORD _CNV_A_R_LINEAR_____55_CM 1 100. -1024. 1023.96875 DISPLAY_IDENTIFIER TQ_ADD_CH ECU_ADDRESS 0x3fd896 BYTE_ORDER MSB_LAST FORMAT "%6.2" /end MEASUREMENT
/begin MEASUREMENT iga_ch_bas "latest desired IGA for catalyst heating" UBYTE _CNV_A_R_LINEAR_____203_CM 1 100. -35.625 60. DISPLAY_IDENTIFIER IGA_CH_BAS ECU_ADDRESS 0x3fe7e6 FORMAT "%5.1" /end MEASUREMENT
/begin MEASUREMENT iga_dif_ch_bas "difference IGA_REF_COR - IGA_CH_BAS" UBYTE _CNV_A_R_LINEAR_____204_CM 1 100. 0. -95.625 DISPLAY_IDENTIFIER IGA_DIF_CH_BAS ECU_ADDRESS 0x3fe7e7 FORMAT "%5.1" /end MEASUREMENT
/begin MEASUREMENT eff_iga_ch_bas "IGA efficiency with IGA_CH_BAS" UWORD _CNV_A_R_LINEAR_____20_CM 1 100. 0. 1.99996948 DISPLAY_IDENTIFIER EFF_IGA_CH_BAS ECU_ADDRESS 0x3fd898 BYTE_ORDER MSB_LAST FORMAT "%7.5" /end MEASUREMENT
/begin MEASUREMENT tq_add_ch_bas "maximum torque reserve for catalyst heating" SWORD _CNV_A_R_LINEAR_____55_CM 1 100. -1024. 1023.96875 DISPLAY_IDENTIFIER TQ_ADD_CH_BAS ECU_ADDRESS 0x3fd89a BYTE_ORDER MSB_LAST FORMAT "%8.2" /end MEASUREMENT
/begin MEASUREMENT fac_red_tq_add_ch "reduction of TQ_ADD_CH_BAS" UBYTE _CNV_A_R_LINEAR_____29_CM 1 100. 0. 0.99610001 DISPLAY_IDENTIFIER FAC_RED_TQ_ADD_CH ECU_ADDRESS 0x3fe7eb FORMAT "%5.3" /end MEASUREMENT
/begin MEASUREMENT fac_deac_ch_dri "interpolation factor concerning 'drive train engaged'" UBYTE _CNV_A_R_LINEAR_____29_CM 1 100. 0. 0.99610001 DISPLAY_IDENTIFIER FAC_DEAC_CH_DRI ECU_ADDRESS 0x3fe7ec FORMAT "%5.3" /end MEASUREMENT
/begin MEASUREMENT tq_add_ch_red "unfiltered torque reserve for catalyst heating" SWORD _CNV_A_R_LINEAR_____55_CM 1 100. -1024. 1023.96875 DISPLAY_IDENTIFIER TQ_ADD_CH_RED ECU_ADDRESS 0x3fd89c BYTE_ORDER MSB_LAST FORMAT "%8.2" /end MEASUREMENT
/begin CHARACTERISTIC ip_fac_iga_ch_tco "interpolation factor latest IGA" CURVE 0xffe40b72 _REC_CUR_20_u1_u1 0.99610001 _CNV_A_R_LINEAR_____29_CM 0. 0.99610001 DISPLAY_IDENTIFIER IP_FAC_IGA_CH_TCO FORMAT "%5.3"
 /begin AXIS_DESCR COM_AXIS tco _CNV_A_R_LINEAR_____11_CM 8 -48. 142.5 FORMAT "%6.2" AXIS_PTS_REF ldp_tco__fac_iga_ch_tco /end AXIS_DESCR
/end CHARACTERISTIC
/begin CHARACTERISTIC ip_iga_ch_cold_is_alter "latest IGA cold engine, first idle phases and alternator switched on" CURVE 0xffe40c8d _REC_CUR_20_u1_u1 95.625 _CNV_A_R_LINEAR_____203_CM -35.625 60. DISPLAY_IDENTIFIER IP_IGA_CH_COLD_IS_ALTER FORMAT "%5.1"
 /begin AXIS_DESCR COM_AXIS n_32 _CNV_A_R_LINEAR_____15_CM 8 0. 8160. FORMAT "%4.0" AXIS_PTS_REF ldpm_n_32_2_iga /end AXIS_DESCR
/end CHARACTERISTIC
/begin CHARACTERISTIC ip_iga_ch_cold_is "latest IGA cold engine, first idle phases and alternator switched off" CURVE 0xffe40c85 _REC_CUR_20_u1_u1 95.625 _CNV_A_R_LINEAR_____203_CM -35.625 60. DISPLAY_IDENTIFIER IP_IGA_CH_COLD_IS FORMAT "%5.1"
 /begin AXIS_DESCR COM_AXIS n_32 _CNV_A_R_LINEAR_____15_CM 8 0. 8160. FORMAT "%4.0" AXIS_PTS_REF ldpm_n_32_2_iga /end AXIS_DESCR
/end CHARACTERISTIC
/begin CHARACTERISTIC ip_iga_ch_hot_is_alter "latest IGA warm engine, first idle phases and alternator switched on" CURVE 0xffe40c9d _REC_CUR_20_u1_u1 95.625 _CNV_A_R_LINEAR_____203_CM -35.625 60. DISPLAY_IDENTIFIER IP_IGA_CH_HOT_IS_ALTER FORMAT "%5.1"
 /begin AXIS_DESCR COM_AXIS n_32 _CNV_A_R_LINEAR_____15_CM 8 0. 8160. FORMAT "%4.0" AXIS_PTS_REF ldpm_n_32_2_iga /end AXIS_DESCR
/end CHARACTERISTIC
/begin CHARACTERISTIC ip_iga_ch_hot_is "latest IGA warm engine, first idle phases and alternator switched off" CURVE 0xffe40c95 _REC_CUR_20_u1_u1 95.625 _CNV_A_R_LINEAR_____203_CM -35.625 60. DISPLAY_IDENTIFIER IP_IGA_CH_HOT_IS FORMAT "%5.1"
 /begin AXIS_DESCR COM_AXIS n_32 _CNV_A_R_LINEAR_____15_CM 8 0. 8160. FORMAT "%4.0" AXIS_PTS_REF ldpm_n_32_2_iga /end AXIS_DESCR
/end CHARACTERISTIC
/begin CHARACTERISTIC ip_fac_red_ch_mt "reduction map manual transmission vehicle, valid in later idle phases and part load" MAP 0xffe4566a _REC_MAP_20_u1_u2_u1 0.99610001 _CNV_A_R_LINEAR_____29_CM 0. 0.99610001 DISPLAY_IDENTIFIER IP_FAC_RED_CH_MT FORMAT "%5.3"
 /begin AXIS_DESCR COM_AXIS t_ast _CNV_A_R_LINEAR_____24_CM 8 0. 6553.5 FORMAT "%6.1" AXIS_PTS_REF ldpm_t_ast_1_iga /end AXIS_DESCR
 /begin AXIS_DESCR COM_AXIS tco_st _CNV_A_R_LINEAR_____11_CM 8 -48. 142.5 FORMAT "%5.1" AXIS_PTS_REF ldpm_tco_st_1_iga /end AXIS_DESCR
/end CHARACTERISTIC
/begin CHARACTERISTIC ip_fac_red_ch_ctr_km "reduction map depending on km counter" CURVE 0xffe40bcd _REC_CUR_20_u1_u2 0.99610001 _CNV_A_R_LINEAR_____29_CM 0. 0.99610001 DISPLAY_IDENTIFIER IP_FAC_RED_CH_CTR_KM FORMAT "%5.3"
 /begin AXIS_DESCR COM_AXIS ctr_km_can _CNV_A_R_LINEAR_____88_CM 4 0. 655350. FORMAT "%7.0" AXIS_PTS_REF ldpm_ctr_km_can_1 /end AXIS_DESCR
/end CHARACTERISTIC
/begin CHARACTERISTIC ip_fac_red_ch_at "reduction map automatic transmission vehicle, valid in later idle phases and part load" MAP 0xffe455aa _REC_MAP_20_u1_u2_u1 0.99610001 _CNV_A_R_LINEAR_____29_CM 0. 0.99610001 DISPLAY_IDENTIFIER IP_FAC_RED_CH_AT FORMAT "%5.3"
 /begin AXIS_DESCR COM_AXIS t_ast _CNV_A_R_LINEAR_____24_CM 8 0. 6553.5 FORMAT "%6.1" AXIS_PTS_REF ldpm_t_ast_1_iga /end AXIS_DESCR
 /begin AXIS_DESCR COM_AXIS tco_st _CNV_A_R_LINEAR_____11_CM 8 -48. 142.5 FORMAT "%5.1" AXIS_PTS_REF ldpm_tco_st_1_iga /end AXIS_DESCR
/end CHARACTERISTIC
/begin CHARACTERISTIC ip_fac_red_ch_is "reduction map drive train not engaged, valid in first idle phases" MAP 0xffe455ea _REC_MAP_20_u1_u2_u1 0.99610001 _CNV_A_R_LINEAR_____29_CM 0. 0.99610001 DISPLAY_IDENTIFIER IP_FAC_RED_CH_IS FORMAT "%5.3"
 /begin AXIS_DESCR COM_AXIS t_ast _CNV_A_R_LINEAR_____24_CM 8 0. 6553.5 FORMAT "%6.1" AXIS_PTS_REF ldpm_t_ast_1_iga /end AXIS_DESCR
 /begin AXIS_DESCR COM_AXIS tco_st _CNV_A_R_LINEAR_____11_CM 8 -48. 142.5 FORMAT "%5.1" AXIS_PTS_REF ldpm_tco_st_1_iga /end AXIS_DESCR
/end CHARACTERISTIC
/begin CHARACTERISTIC ip_fac_red_ch_is_dri "reduction map drive train engaged, valid in first idle phases" MAP 0xffe4562a _REC_MAP_20_u1_u2_u1 0.99610001 _CNV_A_R_LINEAR_____29_CM 0. 0.99610001 DISPLAY_IDENTIFIER IP_FAC_RED_CH_IS_DRI FORMAT "%5.3"
 /begin AXIS_DESCR COM_AXIS t_ast _CNV_A_R_LINEAR_____24_CM 8 0. 6553.5 FORMAT "%6.1" AXIS_PTS_REF ldpm_t_ast_1_iga /end AXIS_DESCR
 /begin AXIS_DESCR COM_AXIS tco_st _CNV_A_R_LINEAR_____11_CM 8 -48. 142.5 FORMAT "%5.1" AXIS_PTS_REF ldpm_tco_st_1_iga /end AXIS_DESCR
/end CHARACTERISTIC
/begin CHARACTERISTIC ip_crlc_tq_add_ch "correlation constant" CURVE 0xffe40aeb _REC_CUR_20_u1_u2 0.99610001 _CNV_A_R_LINEAR_____29_CM 0. 0.99610001 DISPLAY_IDENTIFIER IP_CRLC_TQ_ADD_CH FORMAT "%5.3"
 /begin AXIS_DESCR COM_AXIS fac_tq_req_clu _CNV_A_R_LINEAR_____20_CM 4 0. 1.99996948 FORMAT "%7.5" AXIS_PTS_REF ldp_fac_tq_req_clu__crlc_tq_add /end AXIS_DESCR
/end CHARACTERISTIC
/begin CHARACTERISTIC c_t_deac_ch_tq_add "duration of deactivation ramp" VALUE 0xffe418f4 _REC_VAL_20_u2 655.34 _CNV_A_R_LINEAR_____4_CM 1.e-002 655.35 DISPLAY_IDENTIFIER C_T_DEAC_CH_TQ_ADD FORMAT "%5.2" /end CHARACTERISTIC
/begin AXIS_PTS ldp_tco__fac_iga_ch_tco "" 0xffe481b9 tco _REC_AXS_20_u1 190.5 _CNV_A_R_LINEAR_____11_CM 8 -48. 142.5 DISPLAY_IDENTIFIER LDP_TCO__FAC_IGA_CH_TCO FORMAT "%6.2" /end AXIS_PTS
/begin AXIS_PTS ldpm_n_32_1_iga "" 0xffe48470 n_32 _REC_AXS_20_u1 8160. _CNV_A_R_LINEAR_____15_CM 8 0. 8160. DISPLAY_IDENTIFIER LDPM_N_32_1_IGA FORMAT "%4.0" /end AXIS_PTS
/begin AXIS_PTS ldpm_t_ast_1_iga "" 0xffe51ce0 t_ast _REC_AXS_20_u2 6553.5 _CNV_A_R_LINEAR_____24_CM 8 0. 6553.5 DISPLAY_IDENTIFIER LDPM_T_AST_1_IGA FORMAT "%6.1" /end AXIS_PTS
/begin AXIS_PTS ldpm_tco_st_1_iga "" 0xffe48692 tco_st _REC_AXS_20_u1 190.5 _CNV_A_R_LINEAR_____11_CM 8 -48. 142.5 DISPLAY_IDENTIFIER LDPM_TCO_ST_1_IGA FORMAT "%5.1" /end AXIS_PTS
/begin AXIS_PTS ldp_fac_tq_req_clu__crlc_tq_add "" 0xffe50bac fac_tq_req_clu _REC_AXS_20_u2 1.99996948 _CNV_A_R_LINEAR_____20_CM 4 0. 1.99996948 DISPLAY_IDENTIFIER LDP_FAC_TQ_REQ_CLU__CRLC_TQ_ADD FORMAT "%7.5" /end AXIS_PTS
/begin AXIS_PTS ldpm_n_32_2_iga "" 0xffe48498 n_32 _REC_AXS_20_u1 8160. _CNV_A_R_LINEAR_____15_CM 8 0. 8160. DISPLAY_IDENTIFIER LDPM_N_32_2_IGA FORMAT "%4.0" /end AXIS_PTS
/begin AXIS_PTS ldpm_maf_hb_1_iga "" 0xffe483f0 maf _REC_AXS_20_u1 1389. _CNV_A_R_LINEAR_____27_CM 8 0. 1389. DISPLAY_IDENTIFIER LDPM_MAF_HB_1_IGA FORMAT "%4.0" /end AXIS_PTS
/begin MEASUREMENT fac_deac_ch "deactivation ramp at function termination" UBYTE _CNV_A_R_LINEAR_____29_CM 1 100. 0. 0.99610001 DISPLAY_IDENTIFIER FAC_DEAC_CH ECU_ADDRESS 0x3fe7ea FORMAT "%5.3" /end MEASUREMENT
/begin MEASUREMENT fac_deac_ch_is "ramp from IS(_ALTER) to PL during idling" UBYTE _CNV_A_R_LINEAR_____29_CM 1 100. 0. 0.99610001 DISPLAY_IDENTIFIER FAC_DEAC_CH_IS ECU_ADDRESS 0x3fe7e9 FORMAT "%5.3" /end MEASUREMENT
/begin MEASUREMENT fac_ch_is_alter "ramp after change of B_genoff" UBYTE _CNV_A_R_LINEAR_____29_CM 1 100. 0. 0.99610001 DISPLAY_IDENTIFIER FAC_CH_IS_ALTER ECU_ADDRESS 0x3fe7e8 FORMAT "%5.3" /end MEASUREMENT
/begin CHARACTERISTIC c_t_dri_ch "duration of ramp LV_DRI change" VALUE 0xffe41942 _REC_VAL_20_u2 655.35 _CNV_A_R_LINEAR_____4_CM 0. 655.35 DISPLAY_IDENTIFIER C_T_DRI_CH FORMAT "%6.2" /end CHARACTERISTIC
/begin CHARACTERISTIC c_t_ch_is_alter "duration of ramp IGA_CH_BAS_IS to / _IS_ALTER" VALUE 0xffe418e6 _REC_VAL_20_u2 655.35 _CNV_A_R_LINEAR_____4_CM 0. 655.35 DISPLAY_IDENTIFIER C_T_CH_IS_ALTER FORMAT "%6.2" /end CHARACTERISTIC
/begin CHARACTERISTIC c_t_deac_ch_is "duration of ramp IGA_CH_BAS_IS to / _PL during idle phase" VALUE 0xffe418f2 _REC_VAL_20_u2 655.35 _CNV_A_R_LINEAR_____4_CM 0. 655.35 DISPLAY_IDENTIFIER C_T_DEAC_CH_IS FORMAT "%6.2" /end CHARACTERISTIC
/begin CHARACTERISTIC ip_iga_ch_hot_pl "latest IGA warm engine, later idle phases and part load" MAP 0xffe46380 _REC_MAP_20_u1_u1_u1 95.625 _CNV_A_R_LINEAR_____203_CM -35.625 60. DISPLAY_IDENTIFIER IP_IGA_CH_HOT_PL FORMAT "%5.1"
 /begin AXIS_DESCR COM_AXIS n_32 _CNV_A_R_LINEAR_____15_CM 8 0. 8160. FORMAT "%4.0" AXIS_PTS_REF ldpm_n_32_1_iga /end AXIS_DESCR
 /begin AXIS_DESCR COM_AXIS maf _CNV_A_R_LINEAR_____27_CM 8 0. 1389. FORMAT "%4.0" AXIS_PTS_REF ldpm_maf_hb_1_iga /end AXIS_DESCR
/end CHARACTERISTIC
/begin CHARACTERISTIC ip_iga_ch_hot_pl_wout_cat "latest IGA warm engine, later idle phases and part load, vehicle variant without catalytic converter" MAP 0xffe463c0 _REC_MAP_20_u1_u1_u1 95.625 _CNV_A_R_LINEAR_____203_CM -35.625 60. DISPLAY_IDENTIFIER IP_IGA_CH_HOT_PL_WOUT_CAT FORMAT "%5.1"
 /begin AXIS_DESCR COM_AXIS n_32 _CNV_A_R_LINEAR_____15_CM 8 0. 8160. FORMAT "%4.0" AXIS_PTS_REF ldpm_n_32_1_iga /end AXIS_DESCR
 /begin AXIS_DESCR COM_AXIS maf _CNV_A_R_LINEAR_____27_CM 8 0. 1389. FORMAT "%4.0" AXIS_PTS_REF ldpm_maf_hb_1_iga /end AXIS_DESCR
/end CHARACTERISTIC
/begin CHARACTERISTIC ip_iga_ch_cold_pl "latest IGA cold engine, later idle phases and part load" MAP 0xffe46300 _REC_MAP_20_u1_u1_u1 95.625 _CNV_A_R_LINEAR_____203_CM -35.625 60. DISPLAY_IDENTIFIER IP_IGA_CH_COLD_PL FORMAT "%5.1"
 /begin AXIS_DESCR COM_AXIS n_32 _CNV_A_R_LINEAR_____15_CM 8 0. 8160. FORMAT "%4.0" AXIS_PTS_REF ldpm_n_32_1_iga /end AXIS_DESCR
 /begin AXIS_DESCR COM_AXIS maf _CNV_A_R_LINEAR_____27_CM 8 0. 1389. FORMAT "%4.0" AXIS_PTS_REF ldpm_maf_hb_1_iga /end AXIS_DESCR
/end CHARACTERISTIC
/begin CHARACTERISTIC ip_iga_ch_cold_pl_wout_cat "latest IGA cold engine, later idle phases and part load, vehicle variant without catalytic converter" MAP 0xffe46340 _REC_MAP_20_u1_u1_u1 95.625 _CNV_A_R_LINEAR_____203_CM -35.625 60. DISPLAY_IDENTIFIER IP_IGA_CH_COLD_PL_WOUT_CAT FORMAT "%5.1"
 /begin AXIS_DESCR COM_AXIS n_32 _CNV_A_R_LINEAR_____15_CM 8 0. 8160. FORMAT "%4.0" AXIS_PTS_REF ldpm_n_32_1_iga /end AXIS_DESCR
 /begin AXIS_DESCR COM_AXIS maf _CNV_A_R_LINEAR_____27_CM 8 0. 1389. FORMAT "%4.0" AXIS_PTS_REF ldpm_maf_hb_1_iga /end AXIS_DESCR
/end CHARACTERISTIC
/begin MEASUREMENT iga_bas_temp_cor "additive temperature correction of IGA_BAS_IVVT" SBYTE _CNV_A_R_LINEAR_____82_CM 1 100. -48. 47.625 DISPLAY_IDENTIFIER IGA_BAS_TEMP_COR ECU_ADDRESS 0x3fe7f8 FORMAT "%5.1" /end MEASUREMENT
/begin CHARACTERISTIC ip_iga_bas_temp_cor__tco__tia "Maximum ignition angle correction for temperature effects" MAP 0xffe462dc _REC_MAP_20_u1_u1_u1 95.625 _CNV_A_R_LINEAR_____205_CM -48. 47.625 DISPLAY_IDENTIFIER IP_IGA_BAS_TEMP_COR__TCO__TIA FORMAT "%5.1"
 /begin AXIS_DESCR COM_AXIS tco _CNV_A_R_LINEAR_____11_CM 6 -48. 142.5 FORMAT "%5.1" AXIS_PTS_REF ldp_tco__iga_bas_temp_cor /end AXIS_DESCR
 /begin AXIS_DESCR COM_AXIS tia _CNV_A_R_LINEAR_____11_CM 6 -48. 142.5 FORMAT "%5.1" AXIS_PTS_REF ldp_tia__iga_bas_temp_cor /end AXIS_DESCR
/end CHARACTERISTIC
/begin CHARACTERISTIC ip_fac_iga_pos__n_32__maf "Weighting factor on ignition angle correction for temperature effects" MAP 0xffe452c2 _REC_MAP_20_u1_u1_u1 0.9960940000000002 _CNV_A_R_LINEAR_____50_CM 0. 0.996094 DISPLAY_IDENTIFIER IP_FAC_IGA_POS__N_32__MAF FORMAT "%5.3"
 /begin AXIS_DESCR COM_AXIS n_32 _CNV_A_R_LINEAR_____15_CM 8 0. 8160. FORMAT "%4.0" AXIS_PTS_REF ldpm_n_32_fac_iga_pos_neg /end AXIS_DESCR
 /begin AXIS_DESCR COM_AXIS maf _CNV_A_R_LINEAR_____27_CM 6 0. 1389. FORMAT "%4.0" AXIS_PTS_REF ldp_maf_fac_iga_pos_neg /end AXIS_DESCR
/end CHARACTERISTIC
/begin CHARACTERISTIC ip_fac_iga_neg__n_32__maf "Weighting factor on ignition angle correction for temperature effects" MAP 0xffe45292 _REC_MAP_20_u1_u1_u1 0.9960940000000002 _CNV_A_R_LINEAR_____50_CM 0. 0.996094 DISPLAY_IDENTIFIER IP_FAC_IGA_NEG__N_32__MAF FORMAT "%5.3"
 /begin AXIS_DESCR COM_AXIS n_32 _CNV_A_R_LINEAR_____15_CM 8 0. 8160. FORMAT "%4.0" AXIS_PTS_REF ldpm_n_32_fac_iga_pos_neg /end AXIS_DESCR
 /begin AXIS_DESCR COM_AXIS maf _CNV_A_R_LINEAR_____27_CM 6 0. 1389. FORMAT "%4.0" AXIS_PTS_REF ldp_maf_fac_iga_pos_neg /end AXIS_DESCR
/end CHARACTERISTIC
/begin AXIS_PTS ldp_tco__iga_bas_temp_cor "" 0xffe411b8 tco _REC_AXS_20_u1 190.5 _CNV_A_R_LINEAR_____11_CM 6 -48. 142.5 DISPLAY_IDENTIFIER LDP_TCO__IGA_BAS_TEMP_COR FORMAT "%5.1" /end AXIS_PTS
/begin AXIS_PTS ldp_tia__iga_bas_temp_cor "" 0xffe4126d tia _REC_AXS_20_u1 28.575 _CNV_A_R_LINEAR_____11_CM 6 -48. 142.5 DISPLAY_IDENTIFIER LDP_TIA__IGA_BAS_TEMP_COR FORMAT "%5.1" /end AXIS_PTS
/begin AXIS_PTS ldpm_n_32_fac_iga_pos_neg "" 0xffe4851d n_32 _REC_AXS_20_u1 8160. _CNV_A_R_LINEAR_____15_CM 8 0. 8160. DISPLAY_IDENTIFIER LDPM_N_32_FAC_IGA_POS_NEG FORMAT "%4.0" /end AXIS_PTS
/begin AXIS_PTS ldp_maf_fac_iga_pos_neg "" 0xffe41065 maf _REC_AXS_20_u1 1389. _CNV_A_R_LINEAR_____27_CM 6 0. 1389. DISPLAY_IDENTIFIER LDP_MAF_FAC_IGA_POS_NEG FORMAT "%4.0" /end AXIS_PTS
/begin CHARACTERISTIC ip_iga_ref__n__maf "Basic reference ignition angle at max. spread" MAP 0xffe46600 _REC_MAP_20_u1_u1_u2 4.78125 _CNV_A_R_LINEAR_____203_CM -35.625 60. DISPLAY_IDENTIFIER IP_IGA_REF FORMAT "%5.1"
 /begin AXIS_DESCR COM_AXIS n_32 _CNV_A_R_LINEAR_____15_CM 16 0. 8160. FORMAT "%4.0" AXIS_PTS_REF ldpm_n_32_100 /end AXIS_DESCR
 /begin AXIS_DESCR COM_AXIS maf _CNV_A_R_LINEAR_____108_CM 12 0. 1389. FORMAT "%7.2" AXIS_PTS_REF ldpm_maf_100 /end AXIS_DESCR
/end CHARACTERISTIC
/begin CHARACTERISTIC ip_iga_ref_lamb__lamb_sp "additive lambda setpoint correction of IGA_REF" CURVE 0xffe40ccb _REC_CUR_20_u1_u2 95.625 _CNV_A_R_LINEAR_____205_CM -48. 47.625 DISPLAY_IDENTIFIER IP_IGA_REF_LAMB__LAMB_SP FORMAT "%5.1"
 /begin AXIS_DESCR COM_AXIS lamb_sp _CNV_A_R_LINEAR_____206_CM 8 0. 31.99902344 FORMAT "%7.4" AXIS_PTS_REF ldp_lamb_sp_iga_ref_lamb /end AXIS_DESCR
/end CHARACTERISTIC
/begin MEASUREMENT iga_ref_cor "corrected reference ignition angle" UBYTE _CNV_A_R_LINEAR_____203_CM 1 100. -35.625 60. DISPLAY_IDENTIFIER IGA_REF_COR ECU_ADDRESS 0x3fe813 FORMAT "%5.1" /end MEASUREMENT
/begin MEASUREMENT iga_ref_temp_cor "additive temperature correction of IGA_REF" SBYTE _CNV_A_R_LINEAR_____82_CM 1 100. -48. 47.625 DISPLAY_IDENTIFIER IGA_REF_TEMP_COR ECU_ADDRESS 0x3fe816 FORMAT "%5.1" /end MEASUREMENT
/begin MEASUREMENT iga_ref_vvt_cor "additive valve timing correction of IGA_REF" SBYTE _CNV_A_R_LINEAR_____82_CM 1 100. -48. 47.625 DISPLAY_IDENTIFIER IGA_REF_VVT_COR ECU_ADDRESS 0x3fe815 FORMAT "%5.1" /end MEASUREMENT
/begin MEASUREMENT iga_ref_egr_cor "additive EGR correction of IGA_REF" SBYTE _CNV_A_R_LINEAR_____82_CM 1 100. -48. 47.625 DISPLAY_IDENTIFIER IGA_REF_EGR_COR ECU_ADDRESS 0x3fe814 FORMAT "%5.1" /end MEASUREMENT
/begin CHARACTERISTIC ip_iga_ref_temp__n__maf "Max. reference ignition angle adjustment due to temperature influence" MAP 0xffe467d0 _REC_MAP_20_u1_u1_u1 95.625 _CNV_A_R_LINEAR_____205_CM -48. 47.625 DISPLAY_IDENTIFIER IP_IGA_REF_TEMP__N__MAF FORMAT "%5.1"
 /begin AXIS_DESCR COM_AXIS n_32 _CNV_A_R_LINEAR_____15_CM 8 0. 8160. FORMAT "%4.0" AXIS_PTS_REF ldp_n_iga_ref_temp /end AXIS_DESCR
 /begin AXIS_DESCR COM_AXIS maf _CNV_A_R_LINEAR_____27_CM 6 0. 1389. FORMAT "%4.0" AXIS_PTS_REF ldp_maf_iga_ref_temp /end AXIS_DESCR
/end CHARACTERISTIC
/begin CHARACTERISTIC ip_iga_ref_vvt__n__maf "basis for additive valve timing correction of IGA_REF" MAP 0xffe46824 _REC_MAP_20_u1_u1_u1 95.625 _CNV_A_R_LINEAR_____205_CM -48. 47.625 DISPLAY_IDENTIFIER IP_IGA_REF_VVT__N__MAF FORMAT "%5.1"
 /begin AXIS_DESCR COM_AXIS n_32 _CNV_A_R_LINEAR_____15_CM 16 0. 8160. FORMAT "%4.0" AXIS_PTS_REF ldp_n__iga_ref_vvt /end AXIS_DESCR
 /begin AXIS_DESCR COM_AXIS maf _CNV_A_R_LINEAR_____27_CM 12 0. 1389. FORMAT "%4.0" AXIS_PTS_REF ldp_maf__iga_ref_vvt /end AXIS_DESCR
/end CHARACTERISTIC
/begin CHARACTERISTIC ip_iga_ref_temp_fac__tia__tco "Correction factor for reference IGA temperature correction" MAP 0xffe46800 _REC_MAP_20_u1_u1_u1 1.9921875 _CNV_A_R_LINEAR_____209_CM -1. 0.9921875 DISPLAY_IDENTIFIER IP_IGA_REF_TEMP_FAC FORMAT "%5.3"
 /begin AXIS_DESCR COM_AXIS tia _CNV_A_R_LINEAR_____11_CM 6 -48. 142.5 FORMAT "%5.1" AXIS_PTS_REF ldp_tia__iga_ref_temp_fac /end AXIS_DESCR
 /begin AXIS_DESCR COM_AXIS tco _CNV_A_R_LINEAR_____11_CM 6 -48. 142.5 FORMAT "%5.1" AXIS_PTS_REF ldp_tco__iga_ref_temp_fac /end AXIS_DESCR
/end CHARACTERISTIC
/begin CHARACTERISTIC ip_iga_ref_egr_fac__n__maf "factor for EGR correction of IGA_REF" MAP 0xffe466c0 _REC_MAP_20_u1_u1_u2 1.9921875 _CNV_A_R_LINEAR_____117_CM 0. 1.9921875 DISPLAY_IDENTIFIER IP_IGA_REF_EGR_FAC FORMAT "%5.3"
 /begin AXIS_DESCR COM_AXIS n_32 _CNV_A_R_LINEAR_____15_CM 12 0. 8160. FORMAT "%4.0" AXIS_PTS_REF ldpm_n_32_ip_egr_ratio /end AXIS_DESCR
 /begin AXIS_DESCR COM_AXIS maf _CNV_A_R_LINEAR_____108_CM 12 0. 1389. FORMAT "%7.2" AXIS_PTS_REF ldpm_maf_ip_egr_ratio /end AXIS_DESCR
/end CHARACTERISTIC
/begin CHARACTERISTIC ip_iga_ref_egr "basis for EGR correection of IGA_REF" CURVE 0xffe40cc5 _REC_CUR_20_u1_u2 95.625 _CNV_A_R_LINEAR_____205_CM -48. 47.625 DISPLAY_IDENTIFIER IP_IGA_REF_EGR FORMAT "%5.1"
 /begin AXIS_DESCR COM_AXIS egr_ratio_cor _CNV_A_R_LINEAR_____8_CM 6 0. 99.99847412 AXIS_PTS_REF ldp_egr_ratio_cor__iga_ref_egr /end AXIS_DESCR
/end CHARACTERISTIC
/begin CHARACTERISTIC ip_fac_iga_ref_port "port flap position correction of IGA_REF" CURVE 0xffe40b8a _REC_CUR_20_u1_u2 0.9960940000000002 _CNV_A_R_LINEAR_____50_CM 0. 0.996094 DISPLAY_IDENTIFIER IP_FAC_IGA_REF_PORT FORMAT "%5.3"
 /begin AXIS_DESCR COM_AXIS port_av _CNV_A_R_LINEAR_____210_CM 8 0. 99.99847412 AXIS_PTS_REF ldp_port_av__fac_iga_bas_port /end AXIS_DESCR
/end CHARACTERISTIC
/begin CHARACTERISTIC ip_fac_iga_ref_egr_lamb "factor for EGR_RATIO list of data points" MAP 0xffe452f2 _REC_MAP_20_u1_u1_u2 0.9960940000000002 _CNV_A_R_LINEAR_____50_CM 0. 0.996094 DISPLAY_IDENTIFIER IP_FAC_IGA_REF_EGR_LAMB FORMAT "%5.3"
 /begin AXIS_DESCR COM_AXIS n_32 _CNV_A_R_LINEAR_____15_CM 12 0. 8160. FORMAT "%4.0" AXIS_PTS_REF ldpm_n_32_ip_egr_ratio /end AXIS_DESCR
 /begin AXIS_DESCR COM_AXIS maf _CNV_A_R_LINEAR_____108_CM 12 0. 1389. FORMAT "%7.2" AXIS_PTS_REF ldpm_maf_ip_egr_ratio /end AXIS_DESCR
/end CHARACTERISTIC
/begin CHARACTERISTIC ip_iga_ref_port "basic map for additive port flap position correction of IGA_REF" MAP 0xffe46790 _REC_MAP_20_u1_u1_u2 95.625 _CNV_A_R_LINEAR_____205_CM -48. 47.625 DISPLAY_IDENTIFIER IP_IGA_REF_PORT FORMAT "%5.1"
 /begin AXIS_DESCR COM_AXIS n_32 _CNV_A_R_LINEAR_____15_CM 8 0. 8160. FORMAT "%4.0" AXIS_PTS_REF ldp_n_32__iga_bas_port /end AXIS_DESCR
 /begin AXIS_DESCR COM_AXIS maf _CNV_A_R_LINEAR_____108_CM 8 0. 1389. FORMAT "%7.2" AXIS_PTS_REF ldp_maf__iga_ref_port /end AXIS_DESCR
/end CHARACTERISTIC
/begin AXIS_PTS ldp_lamb_sp_iga_ref_lamb "" 0xffe50ca0 lamb_sp _REC_AXS_20_u2 31.99902344 _CNV_A_R_LINEAR_____206_CM 8 0. 31.99902344 DISPLAY_IDENTIFIER LDP_LAMB_SP_IGA_REF_LAMB FORMAT "%7.4" /end AXIS_PTS
/begin AXIS_PTS ldp_n_iga_ref_temp "" 0xffe48147 n_32 _REC_AXS_20_u1 8160. _CNV_A_R_LINEAR_____15_CM 8 0. 8160. DISPLAY_IDENTIFIER LDP_N_IGA_REF_TEMP FORMAT "%4.0" /end AXIS_PTS
/begin AXIS_PTS ldp_maf_iga_ref_temp "" 0xffe41071 maf _REC_AXS_20_u1 1389. _CNV_A_R_LINEAR_____27_CM 6 0. 1389. DISPLAY_IDENTIFIER LDP_MAF_IGA_REF_TEMP FORMAT "%4.0" /end AXIS_PTS
/begin AXIS_PTS ldp_tia__iga_ref_temp_fac "" 0xffe41274 tia _REC_AXS_20_u1 190.5 _CNV_A_R_LINEAR_____11_CM 6 -48. 142.5 DISPLAY_IDENTIFIER LDP_TIA__IGA_REF_TEMP_FAC FORMAT "%5.1" /end AXIS_PTS
/begin AXIS_PTS ldp_n__iga_ref_vvt "" 0xffe48106 n_32 _REC_AXS_20_u1 8160. _CNV_A_R_LINEAR_____15_CM 16 0. 8160. DISPLAY_IDENTIFIER LDP_N__IGA_REF_VVT FORMAT "%4.0" /end AXIS_PTS
/begin AXIS_PTS ldp_tco__iga_ref_temp_fac "" 0xffe411bf tco _REC_AXS_20_u1 190.5 _CNV_A_R_LINEAR_____11_CM 6 -48. 142.5 DISPLAY_IDENTIFIER LDP_TCO__IGA_REF_TEMP_FAC FORMAT "%5.1" /end AXIS_PTS
/begin AXIS_PTS ldp_maf__iga_ref_vvt "" 0xffe47fa7 maf _REC_AXS_20_u1 1389. _CNV_A_R_LINEAR_____27_CM 12 0. 1389. DISPLAY_IDENTIFIER LDP_MAF__IGA_REF_VVT FORMAT "%4.0" /end AXIS_PTS
/begin AXIS_PTS ldp_egr_ratio_cor__iga_ref_egr "" 0xffe50b62 egr_ratio_cor _REC_AXS_20_u2 99.99847412 _CNV_A_R_LINEAR_____8_CM 6 0. 99.99847412 DISPLAY_IDENTIFIER LDP_EGR_RATIO_COR__IGA_REF_EGR /end AXIS_PTS
/begin AXIS_PTS ldp_maf__iga_ref_port "" 0xffe50cb2 maf _REC_AXS_20_u2 1389. _CNV_A_R_LINEAR_____108_CM 8 0. 1389. DISPLAY_IDENTIFIER LDP_MAF__IGA_REF_PORT FORMAT "%7.2" /end AXIS_PTS
/begin AXIS_PTS ldp_n_32__iga_bas_port "" 0xffe48027 n_32 _REC_AXS_20_u1 8160. _CNV_A_R_LINEAR_____15_CM 8 0. 8160. DISPLAY_IDENTIFIER LDP_N_32__IGA_BAS_PORT FORMAT "%4.0" /end AXIS_PTS
/begin AXIS_PTS ldp_port_av__fac_iga_bas_port "" 0xffe51190 port_av _REC_AXS_20_u2 99.99847412 _CNV_A_R_LINEAR_____210_CM 8 0. 99.99847412 DISPLAY_IDENTIFIER LDP_PORT_AV__FAC_IGA_BAS_PORT /end AXIS_PTS
/begin MEASUREMENT egr_ratio_cor "Corrected EGR ratio" UWORD _CNV_A_R_LINEAR_____8_CM 1 100. 0. 99.99847412 DISPLAY_IDENTIFIER EGR_RATIO_COR ECU_ADDRESS 0x3fd8a8 BYTE_ORDER MSB_LAST /end MEASUREMENT
/begin MEASUREMENT iga_ref_lamb_cor "additive Lambda correction of IGA_REF" SBYTE _CNV_A_R_LINEAR_____82_CM 1 100. -48. 47.625 DISPLAY_IDENTIFIER IGA_REF_LAMB_COR ECU_ADDRESS 0x3fe817 FORMAT "%5.1" /end MEASUREMENT
/begin MEASUREMENT iga_ref_port_cor "additive port-flap correction of IGA_REF" SBYTE _CNV_A_R_LINEAR_____82_CM 1 100. -48. 47.625 DISPLAY_IDENTIFIER IGA_REF_PORT_COR ECU_ADDRESS 0x3fe818 FORMAT "%5.1" /end MEASUREMENT
/begin MEASUREMENT iga_min_teg "minimum ignition angle" UBYTE _CNV_A_R_LINEAR_____203_CM 1 100. -35.625 60. DISPLAY_IDENTIFIER IGA_MIN_TEG ECU_ADDRESS 0x3fe821 FORMAT "%5.1" /end MEASUREMENT
/begin MEASUREMENT iga_dif_min_teg "Difference of minimum ignition angle with reference one - TEG correction included" UBYTE _CNV_A_R_LINEAR_____204_CM 1 100. 0. -95.625 DISPLAY_IDENTIFIER IGA_DIF_MIN_TEG ECU_ADDRESS 0x3fe822 FORMAT "%5.1" /end MEASUREMENT
/begin MEASUREMENT eff_iga_min_teg "Ignition efficiency minimum ignition angle with TEG correction" UWORD _CNV_A_R_LINEAR_____20_CM 1 100. 0. 1.99996948 DISPLAY_IDENTIFIER EFF_IGA_MIN_TEG ECU_ADDRESS 0x3fd8b6 BYTE_ORDER MSB_LAST FORMAT "%7.5" /end MEASUREMENT
/begin CHARACTERISTIC c_teg_max_iga_hys "Hysterisis on exhaust gas temperature for spark retard control" VALUE 0xffe41a52 _REC_VAL_20_u2 2047. _CNV_A_R_LINEAR_____6_CM 0. 2047. DISPLAY_IDENTIFIER C_TEG_MAX_IGA_HYS FORMAT "%7.2" /end CHARACTERISTIC
/begin CHARACTERISTIC c_teg_max_iga "Maximum allowable exhaust gas temperature for spark retard control" VALUE 0xffe41a50 _REC_VAL_20_u2 2047. _CNV_A_R_LINEAR_____6_CM 0. 2047. DISPLAY_IDENTIFIER C_TEG_MAX_IGA FORMAT "%7.2" /end CHARACTERISTIC
/begin CHARACTERISTIC ip_iga_dif_min_teg__teg "Minimum ignition angle versus exhaust gas temperature" CURVE 0xffe46510 _REC_CUR_20_u1_u2 -95.625 _CNV_A_R_LINEAR_____204_CM 0. -95.625 DISPLAY_IDENTIFIER IP_IGA_DIF_MIN_TEG__TEG FORMAT "%5.1"
 /begin AXIS_DESCR COM_AXIS teg_dyn_hys _CNV_A_R_LINEAR_____6_CM 16 0. 2047. FORMAT "%7.2" AXIS_PTS_REF ldp_teg_dyn_hys /end AXIS_DESCR
/end CHARACTERISTIC
/begin MEASUREMENT teg_dyn_hys "Temperature of exhaust gas with hysterisis for IGA_MIN limitation" UWORD _CNV_A_R_LINEAR_____6_CM 1 100. 0. 2047. DISPLAY_IDENTIFIER TEG_DYN_HYS ECU_ADDRESS 0x3fd8ba BYTE_ORDER MSB_LAST FORMAT "%7.2" /end MEASUREMENT
/begin MEASUREMENT teg_cat_up_mdl_max "Maximal temperature of exhaust gas between all cylinder bank" UWORD _CNV_A_R_LINEAR_____6_CM 1 100. 0. 2047. DISPLAY_IDENTIFIER TEG_CAT_UP_MDL_MAX ECU_ADDRESS 0x3fd8b8 BYTE_ORDER MSB_LAST FORMAT "%7.2" /end MEASUREMENT
/begin AXIS_PTS ldp_teg_dyn_hys "" 0xffe512fc teg_dyn_hys _REC_AXS_20_u2 2047. _CNV_A_R_LINEAR_____6_CM 16 0. 2047. DISPLAY_IDENTIFIER LDP_TEG_DYN_HYS FORMAT "%7.2" /end AXIS_PTS
/begin CHARACTERISTIC id_pat_ind__nr_pat "Cylinder shut-off patterns" CURVE 0xffe48b1a _REC_CUR_20_u2_u1 65535. _CNV_A_R_LINEAR_____0_CM 0. 65535. DISPLAY_IDENTIFIER ID_PAT_IND__NR_PAT FORMAT "%5.0"
 /begin AXIS_DESCR COM_AXIS online_dummy _CNV_A_R_LINEAR_____0_CM 7 0. 255. FORMAT "%3.0" AXIS_PTS_REF ldp_nr_pat__pat_ind /end AXIS_DESCR
/end CHARACTERISTIC
/begin MEASUREMENT lv_scc "Logical value for single cylinder cut off" UBYTE _CNV_S_2_RANGE______2_CM 1 100. 0. 1. DISPLAY_IDENTIFIER LV_SCC ECU_ADDRESS 0x3fe8c2 /end MEASUREMENT
/begin MEASUREMENT inh_cyc_iv "Shut off request for cylinder x (individual)" UBYTE _CNV_A_R_LINEAR_____0_CM 1 100. 0. 255. DISPLAY_IDENTIFIER INH_CYC_IV ECU_ADDRESS 0x3fe8bf FORMAT "%3.0" /end MEASUREMENT
/begin MEASUREMENT inh_iv_igk "Shut off sequence of IGK (off) " UBYTE _CNV_A_R_LINEAR_____0_CM 1 100. 0. 255. DISPLAY_IDENTIFIER INH_IV_IGK ECU_ADDRESS 0x3fe8c3 FORMAT "%3.0" /end MEASUREMENT
/begin MEASUREMENT inh_swi_iv "Shut off sequence of coordinated pattern " UWORD _CNV_A_R_LINEAR_____0_CM 1 100. 0. 65535. DISPLAY_IDENTIFIER INH_SWI_IV ECU_ADDRESS 0x3fda36 BYTE_ORDER MSB_LAST FORMAT "%5.0" /end MEASUREMENT
/begin MEASUREMENT lv_inj_cut "All cylinders are shut off" UBYTE _CNV_S_2_RANGE______2_CM 1 100. 0. 1. DISPLAY_IDENTIFIER LV_INJ_CUT ECU_ADDRESS 0x3fe8c1 BIT_MASK 0x1 /end MEASUREMENT
/begin MEASUREMENT lv_ind_fcut "At least 1 Cyl. is shut off" UBYTE _CNV_S_2_RANGE______21_CM 1 100. 0. 1. DISPLAY_IDENTIFIER LV_IND_FCUT ECU_ADDRESS 0x3fe8c0 BIT_MASK 0x1 /end MEASUREMENT
/begin MEASUREMENT inh_iv_fcut "Shut off sequence of pull fuel cut off " UBYTE _CNV_A_R_LINEAR_____0_CM 1 100. 0. 255. DISPLAY_IDENTIFIER INH_IV_FCUT ECU_ADDRESS 0x3fe8c4 FORMAT "%3.0" /end MEASUREMENT
/begin AXIS_PTS ldp_nr_pat__pat_ind "" 0xffe4114a online_dummy _REC_AXS_20_u1 255. _CNV_A_R_LINEAR_____0_CM 7 0. 255. DISPLAY_IDENTIFIER LDP_NR_PAT__PAT_IND FORMAT "%3.0" /end AXIS_PTS
/begin MEASUREMENT inh_iv "" UWORD _CNV_A_R_LINEAR_____0_CM 1 100. 0. 65535. DISPLAY_IDENTIFIER INH_IV ECU_ADDRESS 0x3fda34 BYTE_ORDER MSB_LAST FORMAT "%5.0" /end MEASUREMENT
/begin MEASUREMENT inh_iv_mon_cut_off "Shut off sequence of monitoring" UBYTE _CNV_A_R_LINEAR_____0_CM 1 100. 0. 255. DISPLAY_IDENTIFIER INH_IV_MON_CUT_OFF ECU_ADDRESS 0x3febf9 FORMAT "%3.0" /end MEASUREMENT
/begin MEASUREMENT inh_iv_kwp "shut off request for cylinder x ------ 0=enabled / 1=disabled" UBYTE _CNV_A_R_LINEAR_____0_CM 1 100. 0. 63. ECU_ADDRESS 0x3fedfd FORMAT "%2.0" /end MEASUREMENT
/begin AXIS_PTS ldpm_ctr_km_can_1 "" 0xffe517a4 ctr_km_can _REC_AXS_20_u2 655350. _CNV_A_R_LINEAR_____88_CM 4 0. 655350. DISPLAY_IDENTIFIER LDPM_CTR_KM_CAN_1 FORMAT "%7.0" /end AXIS_PTS
/begin CHARACTERISTIC c_cycnr_ad2_dec_knk "Cycle counter for adjustment into retard direction" VALUE 0xffe415a6 _REC_VAL_20_u2 65535. _CNV_A_R_LINEAR_____250_CM 0. 65535. DISPLAY_IDENTIFIER C_CYCNR_AD2_DEC_KNK FORMAT "%5.0" /end CHARACTERISTIC
/begin CHARACTERISTIC ip_maf_min_knk__n__tco "Air-mass Threshold Release KNK" MAP 0xffe46c78 _REC_MAP_20_u1_u1_u1 1389. _CNV_A_R_LINEAR_____27_CM 0. 1389. DISPLAY_IDENTIFIER IP_MAF_MIN_KNK FORMAT "%4.0"
 /begin AXIS_DESCR COM_AXIS n_32 _CNV_A_R_LINEAR_____15_CM 8 0. 8160. FORMAT "%4.0" AXIS_PTS_REF ldpm_n_3_9 /end AXIS_DESCR
 /begin AXIS_DESCR COM_AXIS tco _CNV_A_R_LINEAR_____11_CM 4 -48. 142.5 FORMAT "%3.0" AXIS_PTS_REF ldp_tco__maf_min_knk /end AXIS_DESCR
/end CHARACTERISTIC
/begin CHARACTERISTIC id_iga_ad1_knk_size__n__maf "Table for the definition of the size and the LDP division of Adaptation table circuit 1" MAP 0xffe440e0 _REC_MAP_20_u1_u1_u1 48. _CNV_A_R_LINEAR_____205_CM -48. 0. DISPLAY_IDENTIFIER ID_IGA_AD1_KNK_SIZE FORMAT "%6.2"
 /begin AXIS_DESCR COM_AXIS n_knk _CNV_A_R_LINEAR_____15_CM 8 0. 8160. FORMAT "%4.0" AXIS_PTS_REF ldpm_n_iga_ad /end AXIS_DESCR
 /begin AXIS_DESCR COM_AXIS maf_knk _CNV_A_R_LINEAR_____27_CM 6 0. 1389. FORMAT "%7.2" AXIS_PTS_REF ldpm_maf_iga_ad /end AXIS_DESCR
/end CHARACTERISTIC
/begin CHARACTERISTIC id_iga_dec_knk_1__n "Spark retard at recognised knocking, Intensity 1" CURVE 0xffe40a5d _REC_CUR_20_u1_u1 47.25 _CNV_A_R_LINEAR_____138_CM 0.375 47.625 DISPLAY_IDENTIFIER ID_IGA_DEC_KNK_1 FORMAT "%4.1"
 /begin AXIS_DESCR COM_AXIS n_knk _CNV_A_R_LINEAR_____15_CM 3 0. 8160. FORMAT "%4.0" AXIS_PTS_REF ldpm_n_4_9 /end AXIS_DESCR
/end CHARACTERISTIC
/begin CHARACTERISTIC id_iga_dec_knk_2__n "Spark retard at recognised knocking, Intensity 2" CURVE 0xffe40a60 _REC_CUR_20_u1_u1 47.25 _CNV_A_R_LINEAR_____138_CM 0.375 47.625 DISPLAY_IDENTIFIER ID_IGA_DEC_KNK_2 FORMAT "%4.1"
 /begin AXIS_DESCR COM_AXIS n_knk _CNV_A_R_LINEAR_____15_CM 3 0. 8160. FORMAT "%4.0" AXIS_PTS_REF ldpm_n_4_9 /end AXIS_DESCR
/end CHARACTERISTIC
/begin CHARACTERISTIC id_maf_min_ad_knk__n "Air-mass Threshold for Knock Adaptation" CURVE 0xffe40a63 _REC_CUR_20_u1_u1 1389. _CNV_A_R_LINEAR_____27_CM 0. 1389. DISPLAY_IDENTIFIER ID_MAF_MIN_AD_KNK__N FORMAT "%4.0"
 /begin AXIS_DESCR COM_AXIS n_knk _CNV_A_R_LINEAR_____15_CM 8 0. 8160. FORMAT "%4.0" AXIS_PTS_REF ldpm_n_iga_ad /end AXIS_DESCR
/end CHARACTERISTIC
/begin CHARACTERISTIC id_n_grd_max_knk__n "Speed Gradient for dynamic identification" CURVE 0xffe40a6b _REC_CUR_20_u1_u1 4064. _CNV_A_R_LINEAR_____51_CM 0. 4064. DISPLAY_IDENTIFIER ID_N_GRD_MAX_KNK__N FORMAT "%4.0"
 /begin AXIS_DESCR COM_AXIS n_knk _CNV_A_R_LINEAR_____15_CM 8 0. 8160. FORMAT "%4.0" AXIS_PTS_REF ldpm_n_iga_ad /end AXIS_DESCR
/end CHARACTERISTIC
/begin CHARACTERISTIC ip_iga_inc_knk__n "Re-set Increment KNK" CURVE 0xffe41c4a _REC_CUR_20_u2_u1 47.99707032000001 _CNV_A_R_LINEAR_____251_CM 1.46484e-003 47.99853516 DISPLAY_IDENTIFIER IP_IGA_INC_KNK FORMAT "%8.5"
 /begin AXIS_DESCR COM_AXIS n_knk _CNV_A_R_LINEAR_____15_CM 4 0. 8160. FORMAT "%4.0" AXIS_PTS_REF ldpm_n_fil_frq_knk /end AXIS_DESCR
/end CHARACTERISTIC
/begin MEASUREMENT iga_ad1_knk[0] "Actual Adaptation value for Cyl. x (Adaptation circuit 1)" UBYTE _CNV_A_R_LINEAR_____205_CM 1 100. -48. 0. DISPLAY_IDENTIFIER IGA_AD1_KNK_0 ECU_ADDRESS 0x3fd8ec FORMAT "%5.1" /end MEASUREMENT
/begin MEASUREMENT iga_ad1_knk[1] "Actual Adaptation value for Cyl. x (Adaptation circuit 1)" UBYTE _CNV_A_R_LINEAR_____205_CM 1 100. -48. 0. DISPLAY_IDENTIFIER IGA_AD1_KNK_1 ECU_ADDRESS 0x3fd8ee FORMAT "%5.1" /end MEASUREMENT
/begin MEASUREMENT iga_ad1_knk[2] "Actual Adaptation value for Cyl. x (Adaptation circuit 1)" UBYTE _CNV_A_R_LINEAR_____205_CM 1 100. -48. 0. DISPLAY_IDENTIFIER IGA_AD1_KNK_2 ECU_ADDRESS 0x3fd8f0 FORMAT "%5.1" /end MEASUREMENT
/begin MEASUREMENT iga_ad1_knk[3] "Actual Adaptation value for Cyl. x (Adaptation circuit 1)" UBYTE _CNV_A_R_LINEAR_____205_CM 1 100. -48. 0. DISPLAY_IDENTIFIER IGA_AD1_KNK_3 ECU_ADDRESS 0x3fd8f2 FORMAT "%5.1" /end MEASUREMENT
/begin MEASUREMENT iga_ad1_knk[4] "Actual Adaptation value for Cyl. x (Adaptation circuit 1)" UBYTE _CNV_A_R_LINEAR_____205_CM 1 100. -48. 0. DISPLAY_IDENTIFIER IGA_AD1_KNK_4 ECU_ADDRESS 0x3fd8f4 FORMAT "%5.1" /end MEASUREMENT
/begin MEASUREMENT iga_ad1_knk[5] "Actual Adaptation value for Cyl. x (Adaptation circuit 1)" UBYTE _CNV_A_R_LINEAR_____205_CM 1 100. -48. 0. DISPLAY_IDENTIFIER IGA_AD1_KNK_5 ECU_ADDRESS 0x3fd8f6 FORMAT "%5.1" /end MEASUREMENT
/begin MEASUREMENT iga_ad2_knk "Adaptation spark retard due to Adaptation circuit 2" UBYTE _CNV_A_R_LINEAR_____205_CM 1 100. -48. 0. DISPLAY_IDENTIFIER IGA_AD2_KNK ECU_ADDRESS 0x3fe85c FORMAT "%4.1" /end MEASUREMENT
/begin MEASUREMENT iga_knk[0] "Spark retard through knock control without Adaptation(cylinder individual)" UBYTE _CNV_A_R_LINEAR_____205_CM 1 100. -48. 0. DISPLAY_IDENTIFIER IGA_KNK_0 ECU_ADDRESS 0x3fd8e0 FORMAT "%7.3" /end MEASUREMENT
/begin MEASUREMENT iga_knk[1] "Spark retard through knock control without Adaptation(cylinder individual)" UBYTE _CNV_A_R_LINEAR_____205_CM 1 100. -48. 0. DISPLAY_IDENTIFIER IGA_KNK_1 ECU_ADDRESS 0x3fd8e2 FORMAT "%7.3" /end MEASUREMENT
/begin MEASUREMENT iga_knk[2] "Spark retard through knock control without Adaptation(cylinder individual)" UBYTE _CNV_A_R_LINEAR_____205_CM 1 100. -48. 0. DISPLAY_IDENTIFIER IGA_KNK_2 ECU_ADDRESS 0x3fd8e4 FORMAT "%7.3" /end MEASUREMENT
/begin MEASUREMENT iga_knk[3] "Spark retard through knock control without Adaptation(cylinder individual)" UBYTE _CNV_A_R_LINEAR_____205_CM 1 100. -48. 0. DISPLAY_IDENTIFIER IGA_KNK_3 ECU_ADDRESS 0x3fd8e6 FORMAT "%7.3" /end MEASUREMENT
/begin MEASUREMENT iga_knk[4] "Spark retard through knock control without Adaptation(cylinder individual)" UBYTE _CNV_A_R_LINEAR_____205_CM 1 100. -48. 0. DISPLAY_IDENTIFIER IGA_KNK_4 ECU_ADDRESS 0x3fd8e8 FORMAT "%7.3" /end MEASUREMENT
/begin MEASUREMENT iga_knk[5] "Spark retard through knock control without Adaptation(cylinder individual)" UBYTE _CNV_A_R_LINEAR_____205_CM 1 100. -48. 0. DISPLAY_IDENTIFIER IGA_KNK_5 ECU_ADDRESS 0x3fd8ea FORMAT "%7.3" /end MEASUREMENT
/begin MEASUREMENT knk_thd[0] "Knock Threshold cylinder x" UBYTE _CNV_A_R_LINEAR_____44_CM 1 100. 0. 4.998 DISPLAY_IDENTIFIER KNK_THD_0 ECU_ADDRESS 0x3fe85e FORMAT "%6.4" /end MEASUREMENT
/begin MEASUREMENT knk_thd[1] "Knock Threshold cylinder x" UBYTE _CNV_A_R_LINEAR_____44_CM 1 100. 0. 4.998 DISPLAY_IDENTIFIER KNK_THD_1 ECU_ADDRESS 0x3fe85f FORMAT "%6.4" /end MEASUREMENT
/begin MEASUREMENT knk_thd[2] "Knock Threshold cylinder x" UBYTE _CNV_A_R_LINEAR_____44_CM 1 100. 0. 4.998 DISPLAY_IDENTIFIER KNK_THD_2 ECU_ADDRESS 0x3fe860 FORMAT "%6.4" /end MEASUREMENT
/begin MEASUREMENT knk_thd[3] "Knock Threshold cylinder x" UBYTE _CNV_A_R_LINEAR_____44_CM 1 100. 0. 4.998 DISPLAY_IDENTIFIER KNK_THD_3 ECU_ADDRESS 0x3fe861 FORMAT "%6.4" /end MEASUREMENT
/begin MEASUREMENT knk_thd[4] "Knock Threshold cylinder x" UBYTE _CNV_A_R_LINEAR_____44_CM 1 100. 0. 4.998 DISPLAY_IDENTIFIER KNK_THD_4 ECU_ADDRESS 0x3fe862 FORMAT "%6.4" /end MEASUREMENT
/begin MEASUREMENT knk_thd[5] "Knock Threshold cylinder x" UBYTE _CNV_A_R_LINEAR_____44_CM 1 100. 0. 4.998 DISPLAY_IDENTIFIER KNK_THD_5 ECU_ADDRESS 0x3fe863 FORMAT "%6.4" /end MEASUREMENT
/begin MEASUREMENT knks_cmd_fil[0] "Knock Filter Frequency and Reference Filter Frequency Cyl.x" UBYTE _CNV_A_R_LINEAR_____0_CM 1 100. 0. 63. DISPLAY_IDENTIFIER KNKS_CMD_FIL_0 ECU_ADDRESS 0x3fe844 FORMAT "%2.0" /end MEASUREMENT
/begin MEASUREMENT knks_cmd_fil[1] "Knock Filter Frequency and Reference Filter Frequency Cyl.x" UBYTE _CNV_A_R_LINEAR_____0_CM 1 100. 0. 63. DISPLAY_IDENTIFIER KNKS_CMD_FIL_1 ECU_ADDRESS 0x3fe845 FORMAT "%2.0" /end MEASUREMENT
/begin MEASUREMENT knks_cmd_fil[2] "Knock Filter Frequency and Reference Filter Frequency Cyl.x" UBYTE _CNV_A_R_LINEAR_____0_CM 1 100. 0. 63. DISPLAY_IDENTIFIER KNKS_CMD_FIL_2 ECU_ADDRESS 0x3fe846 FORMAT "%2.0" /end MEASUREMENT
/begin MEASUREMENT knks_cmd_fil[3] "Knock Filter Frequency and Reference Filter Frequency Cyl.x" UBYTE _CNV_A_R_LINEAR_____0_CM 1 100. 0. 63. DISPLAY_IDENTIFIER KNKS_CMD_FIL_3 ECU_ADDRESS 0x3fe847 FORMAT "%2.0" /end MEASUREMENT
/begin MEASUREMENT knks_cmd_fil[4] "Knock Filter Frequency and Reference Filter Frequency Cyl.x" UBYTE _CNV_A_R_LINEAR_____0_CM 1 100. 0. 63. DISPLAY_IDENTIFIER KNKS_CMD_FIL_4 ECU_ADDRESS 0x3fe848 FORMAT "%2.0" /end MEASUREMENT
/begin MEASUREMENT knks_cmd_fil[5] "Knock Filter Frequency and Reference Filter Frequency Cyl.x" UBYTE _CNV_A_R_LINEAR_____0_CM 1 100. 0. 63. DISPLAY_IDENTIFIER KNKS_CMD_FIL_5 ECU_ADDRESS 0x3fe849 FORMAT "%2.0" /end MEASUREMENT
/begin MEASUREMENT knkwb[0] "Beginning of Measurement Window Cyl.x" UWORD _CNV_A_R_LINEAR_____82_CM 1 100. 0. 108. DISPLAY_IDENTIFIER KNKWB_0 ECU_ADDRESS 0x3fd8c8 BYTE_ORDER MSB_LAST FORMAT "%5.1" /end MEASUREMENT
/begin MEASUREMENT knkwb[1] "Beginning of Measurement Window Cyl.x" UWORD _CNV_A_R_LINEAR_____82_CM 1 100. 0. 108. DISPLAY_IDENTIFIER KNKWB_1 ECU_ADDRESS 0x3fd8ca BYTE_ORDER MSB_LAST FORMAT "%5.1" /end MEASUREMENT
/begin MEASUREMENT knkwb[2] "Beginning of Measurement Window Cyl.x" UWORD _CNV_A_R_LINEAR_____82_CM 1 100. 0. 108. DISPLAY_IDENTIFIER KNKWB_2 ECU_ADDRESS 0x3fd8cc BYTE_ORDER MSB_LAST FORMAT "%5.1" /end MEASUREMENT
/begin MEASUREMENT knkwb[3] "Beginning of Measurement Window Cyl.x" UWORD _CNV_A_R_LINEAR_____82_CM 1 100. 0. 108. DISPLAY_IDENTIFIER KNKWB_3 ECU_ADDRESS 0x3fd8ce BYTE_ORDER MSB_LAST FORMAT "%5.1" /end MEASUREMENT
/begin MEASUREMENT knkwb[4] "Beginning of Measurement Window Cyl.x" UWORD _CNV_A_R_LINEAR_____82_CM 1 100. 0. 108. DISPLAY_IDENTIFIER KNKWB_4 ECU_ADDRESS 0x3fd8d0 BYTE_ORDER MSB_LAST FORMAT "%5.1" /end MEASUREMENT
/begin MEASUREMENT knkwb[5] "Beginning of Measurement Window Cyl.x" UWORD _CNV_A_R_LINEAR_____82_CM 1 100. 0. 108. DISPLAY_IDENTIFIER KNKWB_5 ECU_ADDRESS 0x3fd8d2 BYTE_ORDER MSB_LAST FORMAT "%5.1" /end MEASUREMENT
/begin MEASUREMENT knkwe[0] "End of Measurement Window Cyl.x" UWORD _CNV_A_R_LINEAR_____82_CM 1 100. 0.375 114. DISPLAY_IDENTIFIER KNKWE_0 ECU_ADDRESS 0x3fd8d4 BYTE_ORDER MSB_LAST FORMAT "%5.1" /end MEASUREMENT
/begin MEASUREMENT knkwe[1] "End of Measurement Window Cyl.x" UWORD _CNV_A_R_LINEAR_____82_CM 1 100. 0.375 114. DISPLAY_IDENTIFIER KNKWE_1 ECU_ADDRESS 0x3fd8d6 BYTE_ORDER MSB_LAST FORMAT "%5.1" /end MEASUREMENT
/begin MEASUREMENT knkwe[2] "End of Measurement Window Cyl.x" UWORD _CNV_A_R_LINEAR_____82_CM 1 100. 0.375 114. DISPLAY_IDENTIFIER KNKWE_2 ECU_ADDRESS 0x3fd8d8 BYTE_ORDER MSB_LAST FORMAT "%5.1" /end MEASUREMENT
/begin MEASUREMENT knkwe[3] "End of Measurement Window Cyl.x" UWORD _CNV_A_R_LINEAR_____82_CM 1 100. 0.375 114. DISPLAY_IDENTIFIER KNKWE_3 ECU_ADDRESS 0x3fd8da BYTE_ORDER MSB_LAST FORMAT "%5.1" /end MEASUREMENT
/begin MEASUREMENT knkwe[4] "End of Measurement Window Cyl.x" UWORD _CNV_A_R_LINEAR_____82_CM 1 100. 0.375 114. DISPLAY_IDENTIFIER KNKWE_4 ECU_ADDRESS 0x3fd8dc BYTE_ORDER MSB_LAST FORMAT "%5.1" /end MEASUREMENT
/begin MEASUREMENT knkwe[5] "End of Measurement Window Cyl.x" UWORD _CNV_A_R_LINEAR_____82_CM 1 100. 0.375 114. DISPLAY_IDENTIFIER KNKWE_5 ECU_ADDRESS 0x3fd8de BYTE_ORDER MSB_LAST FORMAT "%5.1" /end MEASUREMENT
/begin MEASUREMENT lv_knk_ad1_ena "Knock Adaptation circuit 1 enabled" UBYTE _CNV_S_2_RANGE______21_CM 1 100. 0. 1. DISPLAY_IDENTIFIER LV_KNK_AD1_ENA ECU_ADDRESS 0x3fe865 BIT_MASK 0x1 /end MEASUREMENT
/begin MEASUREMENT lv_knk_ad2_ena "Knock Adaptation circuit 2 enabled" UBYTE _CNV_S_2_RANGE______21_CM 1 100. 0. 1. DISPLAY_IDENTIFIER LV_KNK_AD2_ENA ECU_ADDRESS 0x3fe879 BIT_MASK 0x1 /end MEASUREMENT
/begin MEASUREMENT lv_knk_ctl_ena "Boolean for knock control enabled" UBYTE _CNV_S_2_RANGE______21_CM 1 100. 0. 1. DISPLAY_IDENTIFIER LV_KNK_CTL_ENA ECU_ADDRESS 0x3fe864 BIT_MASK 0x1 /end MEASUREMENT
/begin MEASUREMENT lv_knk_tra_maf "Logical variable for Load Dynamic Function active or passive" UBYTE _CNV_S_2_RANGE______21_CM 1 100. 0. 1. DISPLAY_IDENTIFIER LV_KNK_TRA_MAF ECU_ADDRESS 0x3fe878 BIT_MASK 0x1 /end MEASUREMENT
/begin MEASUREMENT maf_knk "Mass air flow with hysteresis" UBYTE _CNV_A_R_LINEAR_____27_CM 1 100. 0. 1389. DISPLAY_IDENTIFIER MAF_KNK ECU_ADDRESS 0x3fe83c FORMAT "%7.2" /end MEASUREMENT
/begin MEASUREMENT n_knk "Engine speed with hysteresis" UBYTE _CNV_A_R_LINEAR_____15_CM 1 100. 0. 8160. DISPLAY_IDENTIFIER N_KNK ECU_ADDRESS 0x3fe867 FORMAT "%4.0" /end MEASUREMENT
/begin MEASUREMENT nl[0] "Floating mean value of the noise signal" UWORD _CNV_A_R_LINEAR_____252_CM 1 100. 0. 4.99992371 DISPLAY_IDENTIFIER NL_0 ECU_ADDRESS 0x3fd8bc BYTE_ORDER MSB_LAST FORMAT "%7.5" /end MEASUREMENT
/begin MEASUREMENT nl[1] "Floating mean value of the noise signal" UWORD _CNV_A_R_LINEAR_____252_CM 1 100. 0. 4.99992371 DISPLAY_IDENTIFIER NL_1 ECU_ADDRESS 0x3fd8be BYTE_ORDER MSB_LAST FORMAT "%7.5" /end MEASUREMENT
/begin MEASUREMENT nl[2] "Floating mean value of the noise signal" UWORD _CNV_A_R_LINEAR_____252_CM 1 100. 0. 4.99992371 DISPLAY_IDENTIFIER NL_2 ECU_ADDRESS 0x3fd8c0 BYTE_ORDER MSB_LAST FORMAT "%7.5" /end MEASUREMENT
/begin MEASUREMENT nl[3] "Floating mean value of the noise signal" UWORD _CNV_A_R_LINEAR_____252_CM 1 100. 0. 4.99992371 DISPLAY_IDENTIFIER NL_3 ECU_ADDRESS 0x3fd8c2 BYTE_ORDER MSB_LAST FORMAT "%7.5" /end MEASUREMENT
/begin MEASUREMENT nl[4] "Floating mean value of the noise signal" UWORD _CNV_A_R_LINEAR_____252_CM 1 100. 0. 4.99992371 DISPLAY_IDENTIFIER NL_4 ECU_ADDRESS 0x3fd8c4 BYTE_ORDER MSB_LAST FORMAT "%7.5" /end MEASUREMENT
/begin MEASUREMENT nl[5] "Floating mean value of the noise signal" UWORD _CNV_A_R_LINEAR_____252_CM 1 100. 0. 4.99992371 DISPLAY_IDENTIFIER NL_5 ECU_ADDRESS 0x3fd8c6 BYTE_ORDER MSB_LAST FORMAT "%7.5" /end MEASUREMENT
/begin CHARACTERISTIC c_cycnr_ad2_inc_knk "Cycle counter for adjustment into advance direction" VALUE 0xffe415a8 _REC_VAL_20_u2 65535. _CNV_A_R_LINEAR_____250_CM 0. 65535. DISPLAY_IDENTIFIER C_CYCNR_AD2_INC_KNK FORMAT "%5.0" /end CHARACTERISTIC
/begin CHARACTERISTIC c_fac_tra_knk "correction factor for load dynamic active" VALUE 0xffe4074c _REC_VAL_20_u1 6.96875 _CNV_A_R_LINEAR_____236_CM 1. 7.96875 DISPLAY_IDENTIFIER C_FAC_TRA_KNK FORMAT "%5.3" /end CHARACTERISTIC
/begin CHARACTERISTIC c_iga_ad1_fac_dec_knk "Factor to control the speed of knock Adaptation circuit 1 in retard direction" VALUE 0xffe4075e _REC_VAL_20_u1 0.9960940000000002 _CNV_A_R_LINEAR_____50_CM 0. 0.996094 DISPLAY_IDENTIFIER C_IGA_AD1_FAC_DEC_KNK FORMAT "%5.3" /end CHARACTERISTIC
/begin CHARACTERISTIC c_iga_ad1_fac_fast_knk "factor for fast knock Adaptation" VALUE 0xffe4075f _REC_VAL_20_u1 3.984375 _CNV_A_R_LINEAR_____253_CM 0. 3.984375 DISPLAY_IDENTIFIER C_IGA_AD1_FAC_FAST_KNK FORMAT "%5.3" /end CHARACTERISTIC
/begin CHARACTERISTIC c_iga_ad1_fac_inc_knk "Factor to control the speed of knock Adaptation circuit 1 in advance direction" VALUE 0xffe40760 _REC_VAL_20_u1 0.9960940000000002 _CNV_A_R_LINEAR_____50_CM 0. 0.996094 DISPLAY_IDENTIFIER C_IGA_AD1_FAC_INC_KNK FORMAT "%5.3" /end CHARACTERISTIC
/begin CHARACTERISTIC c_iga_ad1_inc_knk "Increment of adapted retardation values during post operating phase" VALUE 0xffe40761 _REC_VAL_20_u1 48. _CNV_A_R_LINEAR_____82_CM 0. 48. DISPLAY_IDENTIFIER C_IGA_AD1_INC_KNK FORMAT "%4.1" /end CHARACTERISTIC
/begin CHARACTERISTIC c_iga_ad1_lgrd_neg_knk "Change limitation in retard direction for Adaptation circuit 1 while crossing from one operating point to another" VALUE 0xffe40762 _REC_VAL_20_u1 11.90625 _CNV_A_R_LINEAR_____254_CM 9.375e-002 12. DISPLAY_IDENTIFIER C_IGA_AD1_LGRD_NEG_KNK /end CHARACTERISTIC
/begin CHARACTERISTIC c_iga_ad1_lgrd_pos_knk "Change limitation in advance direction for Adaptation circuit 1 while crossing from one operating point to another" VALUE 0xffe40763 _REC_VAL_20_u1 11.90625 _CNV_A_R_LINEAR_____254_CM 9.375e-002 12. DISPLAY_IDENTIFIER C_IGA_AD1_LGRD_POS_KNK /end CHARACTERISTIC
/begin CHARACTERISTIC c_iga_ad1_thd_dec_knk "" VALUE 0xffe40385 _REC_VAL_20_s1 24. _CNV_A_R_LINEAR_____82_CM -12. 12. DISPLAY_IDENTIFIER C_IGA_AD1_THD_DEC_KNK FORMAT "%3.1" /end CHARACTERISTIC
/begin CHARACTERISTIC c_iga_ad1_thd_fast_knk "" VALUE 0xffe40764 _REC_VAL_20_u1 23.625 _CNV_A_R_LINEAR_____82_CM 0.375 24. DISPLAY_IDENTIFIER C_IGA_AD1_THD_FAST_KNK FORMAT "%3.1" /end CHARACTERISTIC
/begin CHARACTERISTIC c_iga_ad2_max_knk "maximum threshold of IGA_AD2_KNK in retard direction" VALUE 0xffe40766 _REC_VAL_20_u1 48. _CNV_A_R_LINEAR_____205_CM -48. 0. DISPLAY_IDENTIFIER C_IGA_AD2_MAX_KNK FORMAT "%4.1" /end CHARACTERISTIC
/begin CHARACTERISTIC c_iga_ad2_thd_dec_knk "Threshold for adjustment of adaptive ignition angle into retard direction" VALUE 0xffe40767 _REC_VAL_20_u1 48. _CNV_A_R_LINEAR_____205_CM -48. 0. DISPLAY_IDENTIFIER C_IGA_AD2_THD_DEC_KNK FORMAT "%4.1" /end CHARACTERISTIC
/begin CHARACTERISTIC c_iga_ad2_thd_inc_knk "Threshold for adjustment of adaptive ignition angle into advance direction" VALUE 0xffe40768 _REC_VAL_20_u1 48. _CNV_A_R_LINEAR_____205_CM -48. 0. DISPLAY_IDENTIFIER C_IGA_AD2_THD_INC_KNK FORMAT "%4.1" /end CHARACTERISTIC
/begin CHARACTERISTIC c_iga_dif_min_max_knk "Control excursion limit valid for spark advance and spark retard " VALUE 0xffe4076f _REC_VAL_20_u1 48. _CNV_A_R_LINEAR_____82_CM 0. 48. DISPLAY_IDENTIFIER C_IGA_DIF_MIN_MAX_KNK FORMAT "%4.1" /end CHARACTERISTIC
/begin CHARACTERISTIC c_iga_lgrd_3 "gradient limitation when  underspending knock load threshold" VALUE 0xffe41674 _REC_VAL_20_u2 47.625 _CNV_A_R_LINEAR_____255_CM 0.375 48. DISPLAY_IDENTIFIER C_IGA_LGRD_3 /end CHARACTERISTIC
/begin CHARACTERISTIC c_maf_iga_hys_knk "Air-Mass Hysteresis for Knock Control" VALUE 0xffe40790 _REC_VAL_20_u1 1389. _CNV_A_R_LINEAR_____27_CM 0. 1389. DISPLAY_IDENTIFIER C_MAF_IGA_HYS_KNK FORMAT "%4.0" /end CHARACTERISTIC
/begin CHARACTERISTIC c_n_iga_hys_knk "Speed Hysteresis for Knock Control" VALUE 0xffe407e2 _REC_VAL_20_u1 8160. _CNV_A_R_LINEAR_____15_CM 0. 8160. DISPLAY_IDENTIFIER C_N_IGA_HYS_KNK FORMAT "%4.0" /end CHARACTERISTIC
/begin CHARACTERISTIC c_nl_crlc "Averaging Constant for Noise Value Calculation" VALUE 0xffe40807 _REC_VAL_20_u1 0.9960940000000002 _CNV_A_R_LINEAR_____50_CM 0. 0.996094 DISPLAY_IDENTIFIER C_NL_CRLC FORMAT "%5.3" /end CHARACTERISTIC
/begin CHARACTERISTIC c_nl_crlc_tra "Averaging Constant for Noise Value Calculation for Transient Case" VALUE 0xffe40808 _REC_VAL_20_u1 0.9960940000000002 _CNV_A_R_LINEAR_____50_CM 0. 0.996094 DISPLAY_IDENTIFIER C_NL_CRLC_TRA FORMAT "%5.3" /end CHARACTERISTIC
/begin CHARACTERISTIC c_swi_ad_knk "calculation of Adaptation circuit 1 and 2 enabled" VALUE 0xffe40857 _REC_VAL_20_u1 1. _CNV_A_R_LINEAR_____0_CM 0. 1. DISPLAY_IDENTIFIER C_SWI_AD_KNK FORMAT "%2.0" /end CHARACTERISTIC
/begin MEASUREMENT lv_knk_tra_n "Logical variable for Engine Speed Dynamic Function active or passive" UBYTE _CNV_S_2_RANGE______21_CM 1 100. 0. 1. DISPLAY_IDENTIFIER LV_KNK_TRA_N ECU_ADDRESS 0x3fe877 BIT_MASK 0x1 /end MEASUREMENT
/begin MEASUREMENT iga_adj_knk[0] "Total spark retard through knock control with Adaptation (cylinder individual)" UBYTE _CNV_A_R_LINEAR_____205_CM 1 100. -48. 0. DISPLAY_IDENTIFIER IGA_ADJ_KNK_0_ ECU_ADDRESS 0x3fe856 FORMAT "%5.1" /end MEASUREMENT
/begin MEASUREMENT iga_adj_knk[1] "Total spark retard through knock control with Adaptation (cylinder individual)" UBYTE _CNV_A_R_LINEAR_____205_CM 1 100. -48. 0. DISPLAY_IDENTIFIER IGA_ADJ_KNK_1_ ECU_ADDRESS 0x3fe857 FORMAT "%5.1" /end MEASUREMENT
/begin MEASUREMENT iga_adj_knk[2] "Total spark retard through knock control with Adaptation (cylinder individual)" UBYTE _CNV_A_R_LINEAR_____205_CM 1 100. -48. 0. DISPLAY_IDENTIFIER IGA_ADJ_KNK_2_ ECU_ADDRESS 0x3fe858 FORMAT "%5.1" /end MEASUREMENT
/begin MEASUREMENT iga_adj_knk[3] "Total spark retard through knock control with Adaptation (cylinder individual)" UBYTE _CNV_A_R_LINEAR_____205_CM 1 100. -48. 0. DISPLAY_IDENTIFIER IGA_ADJ_KNK_3_ ECU_ADDRESS 0x3fe859 FORMAT "%5.1" /end MEASUREMENT
/begin MEASUREMENT iga_adj_knk[4] "Total spark retard through knock control with Adaptation (cylinder individual)" UBYTE _CNV_A_R_LINEAR_____205_CM 1 100. -48. 0. DISPLAY_IDENTIFIER IGA_ADJ_KNK_4_ ECU_ADDRESS 0x3fe85a FORMAT "%5.1" /end MEASUREMENT
/begin MEASUREMENT iga_adj_knk[5] "Total spark retard through knock control with Adaptation (cylinder individual)" UBYTE _CNV_A_R_LINEAR_____205_CM 1 100. -48. 0. DISPLAY_IDENTIFIER IGA_ADJ_KNK_5_ ECU_ADDRESS 0x3fe85b FORMAT "%5.1" /end MEASUREMENT
/begin MEASUREMENT iga_adj_max_knk "Total spark retard through knock control with Adaptation (cylinder individual)" UBYTE _CNV_A_R_LINEAR_____203_CM 1 100. -35.625 60. DISPLAY_IDENTIFIER IGA_ADJ_MAX_KNK ECU_ADDRESS 0x3fe868 FORMAT "%5.1" /end MEASUREMENT
/begin MEASUREMENT dly_iga_adj_knk_diag "inhibition time for knock Adaptation" UBYTE _CNV_A_R_LINEAR_____24_CM 1 100. 0. 25.5 DISPLAY_IDENTIFIER DLY_IGA_ADJ_KNK_DIAG ECU_ADDRESS 0x3fe86a FORMAT "%4.1" /end MEASUREMENT
/begin MEASUREMENT iga_mv_adj_knk "meanvalue of actual retard adjustment with Adaptation values" UBYTE _CNV_A_R_LINEAR_____205_CM 1 100. -48. 0. DISPLAY_IDENTIFIER IGA_MV_ADJ_KNK ECU_ADDRESS 0x3fe85d FORMAT "%4.1" /end MEASUREMENT
/begin MEASUREMENT cyl_id_knk "cylinder number for knock control" UBYTE _CNV_A_R_LINEAR_____0_CM 1 100. 0. 255. DISPLAY_IDENTIFIER CYL_ID_KNK ECU_ADDRESS 0x3fe83d FORMAT "%3.0" /end MEASUREMENT
/begin MEASUREMENT lv_knk "Logical variable for recognition of knock" UBYTE _CNV_S_2_RANGE______21_CM 1 100. 0. 1. DISPLAY_IDENTIFIER LV_KNK ECU_ADDRESS 0x3fe866 BIT_MASK 0x1 /end MEASUREMENT
/begin MEASUREMENT iga_mv_knk "meanvalue of actual retard adjustment without Adaptation values" UBYTE _CNV_A_R_LINEAR_____205_CM 1 100. -48. 0. DISPLAY_IDENTIFIER IGA_MV_KNK ECU_ADDRESS 0x3fe86b FORMAT "%4.1" /end MEASUREMENT
/begin MEASUREMENT fac_iga_max_knk "Weighting factor for the max. spark retard against coolant" UBYTE _CNV_A_R_LINEAR_____50_CM 1 100. 0. 0.996094 DISPLAY_IDENTIFIER FAC_IGA_MAX_KNK ECU_ADDRESS 0x3fe869 FORMAT "%5.3" /end MEASUREMENT
/begin MEASUREMENT knks_cmd_gain[0] "Amplification precontrol Cyl.x" UBYTE _CNV_A_R_LINEAR_____0_CM 1 100. 0. 63. DISPLAY_IDENTIFIER KNKS_CMD_GAIN_0 ECU_ADDRESS 0x3fe850 FORMAT "%2.0" /end MEASUREMENT
/begin MEASUREMENT knks_cmd_gain[1] "Amplification precontrol Cyl.x" UBYTE _CNV_A_R_LINEAR_____0_CM 1 100. 0. 63. DISPLAY_IDENTIFIER KNKS_CMD_GAIN_1 ECU_ADDRESS 0x3fe851 FORMAT "%2.0" /end MEASUREMENT
/begin MEASUREMENT knks_cmd_gain[2] "Amplification precontrol Cyl.x" UBYTE _CNV_A_R_LINEAR_____0_CM 1 100. 0. 63. DISPLAY_IDENTIFIER KNKS_CMD_GAIN_2 ECU_ADDRESS 0x3fe852 FORMAT "%2.0" /end MEASUREMENT
/begin MEASUREMENT knks_cmd_gain[3] "Amplification precontrol Cyl.x" UBYTE _CNV_A_R_LINEAR_____0_CM 1 100. 0. 63. DISPLAY_IDENTIFIER KNKS_CMD_GAIN_3 ECU_ADDRESS 0x3fe853 FORMAT "%2.0" /end MEASUREMENT
/begin MEASUREMENT knks_cmd_gain[4] "Amplification precontrol Cyl.x" UBYTE _CNV_A_R_LINEAR_____0_CM 1 100. 0. 63. DISPLAY_IDENTIFIER KNKS_CMD_GAIN_4 ECU_ADDRESS 0x3fe854 FORMAT "%2.0" /end MEASUREMENT
/begin MEASUREMENT knks_cmd_gain[5] "Amplification precontrol Cyl.x" UBYTE _CNV_A_R_LINEAR_____0_CM 1 100. 0. 63. DISPLAY_IDENTIFIER KNKS_CMD_GAIN_5 ECU_ADDRESS 0x3fe855 FORMAT "%2.0" /end MEASUREMENT
/begin MEASUREMENT knks_cmd_int[0] "Integration time constant Cyl.x" UBYTE _CNV_A_R_LINEAR_____0_CM 1 100. 0. 31. DISPLAY_IDENTIFIER KNKS_CMD_INT_0 ECU_ADDRESS 0x3fe84a FORMAT "%2.0" /end MEASUREMENT
/begin MEASUREMENT knks_cmd_int[1] "Integration time constant Cyl.x" UBYTE _CNV_A_R_LINEAR_____0_CM 1 100. 0. 31. DISPLAY_IDENTIFIER KNKS_CMD_INT_1 ECU_ADDRESS 0x3fe84b FORMAT "%2.0" /end MEASUREMENT
/begin MEASUREMENT knks_cmd_int[2] "Integration time constant Cyl.x" UBYTE _CNV_A_R_LINEAR_____0_CM 1 100. 0. 31. DISPLAY_IDENTIFIER KNKS_CMD_INT_2 ECU_ADDRESS 0x3fe84c FORMAT "%2.0" /end MEASUREMENT
/begin MEASUREMENT knks_cmd_int[3] "Integration time constant Cyl.x" UBYTE _CNV_A_R_LINEAR_____0_CM 1 100. 0. 31. DISPLAY_IDENTIFIER KNKS_CMD_INT_3 ECU_ADDRESS 0x3fe84d FORMAT "%2.0" /end MEASUREMENT
/begin MEASUREMENT knks_cmd_int[4] "Integration time constant Cyl.x" UBYTE _CNV_A_R_LINEAR_____0_CM 1 100. 0. 31. DISPLAY_IDENTIFIER KNKS_CMD_INT_4 ECU_ADDRESS 0x3fe84e FORMAT "%2.0" /end MEASUREMENT
/begin MEASUREMENT knks_cmd_int[5] "Integration time constant Cyl.x" UBYTE _CNV_A_R_LINEAR_____0_CM 1 100. 0. 31. DISPLAY_IDENTIFIER KNKS_CMD_INT_5 ECU_ADDRESS 0x3fe84f FORMAT "%2.0" /end MEASUREMENT
/begin CHARACTERISTIC ip_fac_ad_knk_tco__tco "Weighting factor Adaptation circuit 1 an 2 via coolant temperature" CURVE 0xffe40b1b _REC_CUR_20_u1_u1 0.9960940000000002 _CNV_A_R_LINEAR_____50_CM 0. 0.996094 DISPLAY_IDENTIFIER IP_FAC_AD_KNK_TCO__TCO FORMAT "%5.3"
 /begin AXIS_DESCR COM_AXIS tco _CNV_A_R_LINEAR_____11_CM 2 -48. 142.5 FORMAT "%6.2" AXIS_PTS_REF ldp_tco__fac_ad_knk_tco /end AXIS_DESCR
/end CHARACTERISTIC
/begin MEASUREMENT iga_ad1_ad2_knk[0] "Adaptation value for Cyl. x (Adaptation circuit 1 and 2)" UBYTE _CNV_A_R_LINEAR_____205_CM 1 100. -48. 0. DISPLAY_IDENTIFIER IGA_AD1_AD2_KNK_0_ ECU_ADDRESS 0x3fd8f8 FORMAT "%5.1" /end MEASUREMENT
/begin MEASUREMENT iga_ad1_ad2_knk[1] "Adaptation value for Cyl. x (Adaptation circuit 1 and 2)" UBYTE _CNV_A_R_LINEAR_____205_CM 1 100. -48. 0. DISPLAY_IDENTIFIER IGA_AD1_AD2_KNK_1_ ECU_ADDRESS 0x3fd8fa FORMAT "%5.1" /end MEASUREMENT
/begin MEASUREMENT iga_ad1_ad2_knk[2] "Adaptation value for Cyl. x (Adaptation circuit 1 and 2)" UBYTE _CNV_A_R_LINEAR_____205_CM 1 100. -48. 0. DISPLAY_IDENTIFIER IGA_AD1_AD2_KNK_2_ ECU_ADDRESS 0x3fd8fc FORMAT "%5.1" /end MEASUREMENT
/begin MEASUREMENT iga_ad1_ad2_knk[3] "Adaptation value for Cyl. x (Adaptation circuit 1 and 2)" UBYTE _CNV_A_R_LINEAR_____205_CM 1 100. -48. 0. DISPLAY_IDENTIFIER IGA_AD1_AD2_KNK_3_ ECU_ADDRESS 0x3fd8fe FORMAT "%5.1" /end MEASUREMENT
/begin MEASUREMENT iga_ad1_ad2_knk[4] "Adaptation value for Cyl. x (Adaptation circuit 1 and 2)" UBYTE _CNV_A_R_LINEAR_____205_CM 1 100. -48. 0. DISPLAY_IDENTIFIER IGA_AD1_AD2_KNK_4_ ECU_ADDRESS 0x3fd900 FORMAT "%5.1" /end MEASUREMENT
/begin MEASUREMENT iga_ad1_ad2_knk[5] "Adaptation value for Cyl. x (Adaptation circuit 1 and 2)" UBYTE _CNV_A_R_LINEAR_____205_CM 1 100. -48. 0. DISPLAY_IDENTIFIER IGA_AD1_AD2_KNK_5_ ECU_ADDRESS 0x3fd902 FORMAT "%5.1" /end MEASUREMENT
/begin CHARACTERISTIC id_cycnr_fac_tra_knk__n "Cycle counter during which the Load Dynamic Function stays active after triggering" CURVE 0xffe40a1f _REC_CUR_20_u1_u1 255. _CNV_A_R_LINEAR_____0_CM 0. 255. DISPLAY_IDENTIFIER ID_CYCNR_FAC_TRA_KNK FORMAT "%3.0"
 /begin AXIS_DESCR COM_AXIS n_knk _CNV_A_R_LINEAR_____15_CM 4 0. 8160. FORMAT "%4.0" AXIS_PTS_REF ldpm_n_6_4 /end AXIS_DESCR
/end CHARACTERISTIC
/begin CHARACTERISTIC ip_knkwb_1__n__maf "Beginning of Measurement Window Cyl.2" MAP 0xffe4bcf2 _REC_MAP_20_u2_u1_u1 108. _CNV_A_R_LINEAR_____82_CM 0. 108. DISPLAY_IDENTIFIER IP_KNKWB_1__N__MAF FORMAT "%5.1"
 /begin AXIS_DESCR COM_AXIS n_knk _CNV_A_R_LINEAR_____15_CM 10 0. 8160. FORMAT "%4.0" AXIS_PTS_REF ldpm_n_knkwb /end AXIS_DESCR
 /begin AXIS_DESCR COM_AXIS maf_knk _CNV_A_R_LINEAR_____27_CM 4 0. 1389. FORMAT "%4.0" AXIS_PTS_REF ldpm_maf_knkwb /end AXIS_DESCR
/end CHARACTERISTIC
/begin CHARACTERISTIC ip_gain_knk_1__n__maf "Amplification precontrol Cyl.2" MAP 0xffe45b1c _REC_MAP_20_u1_u1_u1 63. _CNV_A_R_LINEAR_____0_CM 0. 63. DISPLAY_IDENTIFIER IP_GAIN_KNK_1__N__MAF FORMAT "%2.0"
 /begin AXIS_DESCR COM_AXIS n_knk _CNV_A_R_LINEAR_____15_CM 16 0. 8160. FORMAT "%4.0" AXIS_PTS_REF ldpm_n_2_9 /end AXIS_DESCR
 /begin AXIS_DESCR COM_AXIS maf_knk _CNV_A_R_LINEAR_____27_CM 4 0. 1389. FORMAT "%4.0" AXIS_PTS_REF ldpm_maf_1_9 /end AXIS_DESCR
/end CHARACTERISTIC
/begin CHARACTERISTIC ip_fac_thd_knk_0__n__maf "Knock Factor Table Cyl. 1" MAP 0xffe4573c _REC_MAP_20_u1_u1_u1 7.96875 _CNV_A_R_LINEAR_____236_CM 0. 7.96875 DISPLAY_IDENTIFIER IP_FAC_THD_KNK_0__N__MAF FORMAT "%4.2"
 /begin AXIS_DESCR COM_AXIS n_knk _CNV_A_R_LINEAR_____15_CM 16 0. 8160. FORMAT "%4.0" AXIS_PTS_REF ldpm_n_2_9 /end AXIS_DESCR
 /begin AXIS_DESCR COM_AXIS maf_knk _CNV_A_R_LINEAR_____27_CM 4 0. 1389. FORMAT "%4.0" AXIS_PTS_REF ldpm_maf_1_9 /end AXIS_DESCR
/end CHARACTERISTIC
/begin CHARACTERISTIC ip_fac_thd_knk_1__n__maf "Knock Factor Table Cyl. 2" MAP 0xffe4577c _REC_MAP_20_u1_u1_u1 7.96875 _CNV_A_R_LINEAR_____236_CM 0. 7.96875 DISPLAY_IDENTIFIER IP_FAC_THD_KNK_1__N__MAF FORMAT "%4.2"
 /begin AXIS_DESCR COM_AXIS n_knk _CNV_A_R_LINEAR_____15_CM 16 0. 8160. FORMAT "%4.0" AXIS_PTS_REF ldpm_n_2_9 /end AXIS_DESCR
 /begin AXIS_DESCR COM_AXIS maf_knk _CNV_A_R_LINEAR_____27_CM 4 0. 1389. FORMAT "%4.0" AXIS_PTS_REF ldpm_maf_1_9 /end AXIS_DESCR
/end CHARACTERISTIC
/begin CHARACTERISTIC ip_fac_thd_knk_2__n__maf "Knock Factor Table Cyl. 3" MAP 0xffe457bc _REC_MAP_20_u1_u1_u1 7.96875 _CNV_A_R_LINEAR_____236_CM 0. 7.96875 DISPLAY_IDENTIFIER IP_FAC_THD_KNK_2__N__MAF FORMAT "%4.2"
 /begin AXIS_DESCR COM_AXIS n_knk _CNV_A_R_LINEAR_____15_CM 16 0. 8160. FORMAT "%4.0" AXIS_PTS_REF ldpm_n_2_9 /end AXIS_DESCR
 /begin AXIS_DESCR COM_AXIS maf_knk _CNV_A_R_LINEAR_____27_CM 4 0. 1389. FORMAT "%4.0" AXIS_PTS_REF ldpm_maf_1_9 /end AXIS_DESCR
/end CHARACTERISTIC
/begin CHARACTERISTIC ip_fac_thd_knk_3__n__maf "Knock Factor Table Cyl. 4" MAP 0xffe457fc _REC_MAP_20_u1_u1_u1 7.96875 _CNV_A_R_LINEAR_____236_CM 0. 7.96875 DISPLAY_IDENTIFIER IP_FAC_THD_KNK_3__N__MAF FORMAT "%4.2"
 /begin AXIS_DESCR COM_AXIS n_knk _CNV_A_R_LINEAR_____15_CM 16 0. 8160. FORMAT "%4.0" AXIS_PTS_REF ldpm_n_2_9 /end AXIS_DESCR
 /begin AXIS_DESCR COM_AXIS maf_knk _CNV_A_R_LINEAR_____27_CM 4 0. 1389. FORMAT "%4.0" AXIS_PTS_REF ldpm_maf_1_9 /end AXIS_DESCR
/end CHARACTERISTIC
/begin CHARACTERISTIC ip_fac_thd_knk_4__n__maf "Knock Factor Table Cyl. 5" MAP 0xffe4583c _REC_MAP_20_u1_u1_u1 7.96875 _CNV_A_R_LINEAR_____236_CM 0. 7.96875 DISPLAY_IDENTIFIER IP_FAC_THD_KNK_4__N__MAF FORMAT "%4.2"
 /begin AXIS_DESCR COM_AXIS n_knk _CNV_A_R_LINEAR_____15_CM 16 0. 8160. FORMAT "%4.0" AXIS_PTS_REF ldpm_n_2_9 /end AXIS_DESCR
 /begin AXIS_DESCR COM_AXIS maf_knk _CNV_A_R_LINEAR_____27_CM 4 0. 1389. FORMAT "%4.0" AXIS_PTS_REF ldpm_maf_1_9 /end AXIS_DESCR
/end CHARACTERISTIC
/begin CHARACTERISTIC ip_fac_thd_knk_5__n__maf "Knock Factor Table Cyl. 6" MAP 0xffe4587c _REC_MAP_20_u1_u1_u1 7.96875 _CNV_A_R_LINEAR_____236_CM 0. 7.96875 DISPLAY_IDENTIFIER IP_FAC_THD_KNK_5__N__MAF FORMAT "%4.2"
 /begin AXIS_DESCR COM_AXIS n_knk _CNV_A_R_LINEAR_____15_CM 16 0. 8160. FORMAT "%4.0" AXIS_PTS_REF ldpm_n_2_9 /end AXIS_DESCR
 /begin AXIS_DESCR COM_AXIS maf_knk _CNV_A_R_LINEAR_____27_CM 4 0. 1389. FORMAT "%4.0" AXIS_PTS_REF ldpm_maf_1_9 /end AXIS_DESCR
/end CHARACTERISTIC
/begin CHARACTERISTIC ip_knk_thd_add__n "Knock summand" CURVE 0xffe46b04 _REC_CUR_20_u1_u1 5.1 _CNV_A_R_LINEAR_____256_CM -2.56 2.54 DISPLAY_IDENTIFIER IP_KNK_THD_ADD__N FORMAT "%4.2"
 /begin AXIS_DESCR COM_AXIS n_knk _CNV_A_R_LINEAR_____15_CM 16 0. 8160. FORMAT "%4.0" AXIS_PTS_REF ldpm_n_2_9 /end AXIS_DESCR
/end CHARACTERISTIC
/begin CHARACTERISTIC c_nl_min "Minimum noise value" VALUE 0xffe4080a _REC_VAL_20_u1 4.998 _CNV_A_R_LINEAR_____44_CM 0. 4.998 DISPLAY_IDENTIFIER C_NL_MIN FORMAT "%5.3" /end CHARACTERISTIC
/begin CHARACTERISTIC id_maf_dif_tra_knk__n "Throttle Position Gradient for Load Dynamik Recognition" CURVE 0xffe4051e _REC_CUR_20_s2_u1 1388.978806 _CNV_A_R_LINEAR_____257_CM -694.5 694.478806 DISPLAY_IDENTIFIER ID_MAF_DIF_TRA_KNK__N FORMAT "%7.2"
 /begin AXIS_DESCR COM_AXIS n_knk _CNV_A_R_LINEAR_____15_CM 4 0. 8160. FORMAT "%4.0" AXIS_PTS_REF ldpm_n_6_4 /end AXIS_DESCR
/end CHARACTERISTIC
/begin CHARACTERISTIC ip_iga_bas_max_knk__n__maf "Maximum value for spark retard" MAP 0xffe4601c _REC_MAP_20_u1_u1_u1 95.625 _CNV_A_R_LINEAR_____203_CM -35.625 60. DISPLAY_IDENTIFIER IP_IGA_BAS_MAX_KNK__N__MAF FORMAT "%5.1"
 /begin AXIS_DESCR COM_AXIS n_32 _CNV_A_R_LINEAR_____15_CM 8 0. 8160. FORMAT "%4.0" AXIS_PTS_REF ldpm_n_iga_max_knk /end AXIS_DESCR
 /begin AXIS_DESCR COM_AXIS maf _CNV_A_R_LINEAR_____27_CM 8 0. 1389. FORMAT "%4.0" AXIS_PTS_REF ldpm_maf_iga_max_knk /end AXIS_DESCR
/end CHARACTERISTIC
/begin CHARACTERISTIC ip_iga_ofs_max_knk__n__maf "Maximum value for spark retard" MAP 0xffe465c0 _REC_MAP_20_u1_u1_u1 95.625 _CNV_A_R_LINEAR_____205_CM -48. 47.625 DISPLAY_IDENTIFIER IP_IGA_OFS_MAX_KNK__N__MAF FORMAT "%5.1"
 /begin AXIS_DESCR COM_AXIS n_32 _CNV_A_R_LINEAR_____15_CM 8 0. 8160. FORMAT "%4.0" AXIS_PTS_REF ldpm_n_iga_max_knk /end AXIS_DESCR
 /begin AXIS_DESCR COM_AXIS maf _CNV_A_R_LINEAR_____27_CM 8 0. 1389. FORMAT "%4.0" AXIS_PTS_REF ldpm_maf_iga_max_knk /end AXIS_DESCR
/end CHARACTERISTIC
/begin CHARACTERISTIC ip_fac_iga_max_knk__tco__tia "Weighting factor for the max. spark retard against coolant" MAP 0xffe451f2 _REC_MAP_20_u1_u1_u1 0.9960940000000002 _CNV_A_R_LINEAR_____50_CM 0. 0.996094 DISPLAY_IDENTIFIER IP_FAC_IGA_MAX_KNK__TCO__TIA FORMAT "%5.3"
 /begin AXIS_DESCR COM_AXIS tco _CNV_A_R_LINEAR_____11_CM 4 -48. 142.5 FORMAT "%5.1" AXIS_PTS_REF ldp_tco__fac_iga_max_knk /end AXIS_DESCR
 /begin AXIS_DESCR COM_AXIS tia _CNV_A_R_LINEAR_____11_CM 4 -48. 142.5 FORMAT "%5.1" AXIS_PTS_REF ldp_tia__fac_iga_max_knk /end AXIS_DESCR
/end CHARACTERISTIC
/begin CHARACTERISTIC c_iga_ad1_thd_inc_knk "" VALUE 0xffe40765 _REC_VAL_20_u1 23.625 _CNV_A_R_LINEAR_____205_CM -24. -0.375 DISPLAY_IDENTIFIER C_IGA_AD1_THD_INC_KNK FORMAT "%3.1" /end CHARACTERISTIC
/begin CHARACTERISTIC c_tco_ad1_min_knk "minimum TCO threshold for knock adaptation circuit 1" VALUE 0xffe408e6 _REC_VAL_20_u1 190.5 _CNV_A_R_LINEAR_____11_CM -48. 142.5 DISPLAY_IDENTIFIER C_TCO_AD1_MIN_KNK FORMAT "%5.1" /end CHARACTERISTIC
/begin CHARACTERISTIC c_tco_ad2_min_knk "minimum TCO threshold for knock adaptation circuit 2" VALUE 0xffe408e8 _REC_VAL_20_u1 190.5 _CNV_A_R_LINEAR_____11_CM -48. 142.5 DISPLAY_IDENTIFIER C_TCO_AD2_MIN_KNK FORMAT "%5.1" /end CHARACTERISTIC
/begin CHARACTERISTIC c_tco_ad1_max_knk "maximum TCO threshold for knock adaptation circuit 1" VALUE 0xffe408e5 _REC_VAL_20_u1 190.5 _CNV_A_R_LINEAR_____11_CM -48. 142.5 DISPLAY_IDENTIFIER C_TCO_AD1_MAX_KNK FORMAT "%5.1" /end CHARACTERISTIC
/begin CHARACTERISTIC c_tco_ad2_max_knk "maximum TCO threshold for knock adaptation circuit 2" VALUE 0xffe408e7 _REC_VAL_20_u1 190.5 _CNV_A_R_LINEAR_____11_CM -48. 142.5 DISPLAY_IDENTIFIER C_TCO_AD2_MAX_KNK FORMAT "%5.1" /end CHARACTERISTIC
/begin AXIS_PTS ldp_tco__maf_min_knk "" 0xffe411d9 tco _REC_AXS_20_u1 190.5 _CNV_A_R_LINEAR_____11_CM 4 -48. 142.5 DISPLAY_IDENTIFIER LDP_TCO__MAF_MIN_KNK FORMAT "%3.0" /end AXIS_PTS
/begin AXIS_PTS ldpm_n_3_9 "" 0xffe4857e n_32 _REC_AXS_20_u1 8160. _CNV_A_R_LINEAR_____15_CM 8 0. 8160. DISPLAY_IDENTIFIER LDPM_N_3_9 FORMAT "%4.0" /end AXIS_PTS
/begin AXIS_PTS ldpm_n_4_9 "" 0xffe413ed n_knk _REC_AXS_20_u1 8160. _CNV_A_R_LINEAR_____15_CM 3 0. 8160. DISPLAY_IDENTIFIER LDPM_N_4_9 FORMAT "%4.0" /end AXIS_PTS
/begin AXIS_PTS ldp_tco__fac_ad_knk_tco "" 0xffe411ab tco _REC_AXS_20_u1 190.5 _CNV_A_R_LINEAR_____11_CM 2 -48. 142.5 DISPLAY_IDENTIFIER LDP_TCO__FAC_AD_KNK_TCO FORMAT "%6.2" /end AXIS_PTS
/begin AXIS_PTS ldpm_n_6_4 "" 0xffe413f1 n_knk _REC_AXS_20_u1 8160. _CNV_A_R_LINEAR_____15_CM 4 0. 8160. DISPLAY_IDENTIFIER LDPM_N_6_4 FORMAT "%4.0" /end AXIS_PTS
/begin AXIS_PTS ldpm_n_iga_max_knk "" 0xffe485a2 n_32 _REC_AXS_20_u1 8160. _CNV_A_R_LINEAR_____15_CM 8 0. 8160. DISPLAY_IDENTIFIER LDPM_N_IGA_MAX_KNK FORMAT "%4.0" /end AXIS_PTS
/begin AXIS_PTS ldpm_maf_iga_max_knk "" 0xffe48426 maf _REC_AXS_20_u1 1389. _CNV_A_R_LINEAR_____27_CM 8 0. 1389. DISPLAY_IDENTIFIER LDPM_MAF_IGA_MAX_KNK FORMAT "%4.0" /end AXIS_PTS
/begin AXIS_PTS ldp_tco__fac_iga_max_knk "" 0xffe411ae tco _REC_AXS_20_u1 190.5 _CNV_A_R_LINEAR_____11_CM 4 -48. 142.5 DISPLAY_IDENTIFIER LDP_TCO__FAC_IGA_MAX_KNK FORMAT "%5.1" /end AXIS_PTS
/begin AXIS_PTS ldp_tia__fac_iga_max_knk "" 0xffe41263 tia _REC_AXS_20_u1 190.5 _CNV_A_R_LINEAR_____11_CM 4 -48. 142.5 DISPLAY_IDENTIFIER LDP_TIA__FAC_IGA_MAX_KNK FORMAT "%5.1" /end AXIS_PTS
/begin CHARACTERISTIC c_knk_thd_max "Maximum knock threshold" VALUE 0xffe40782 _REC_VAL_20_u1 4.998 _CNV_A_R_LINEAR_____44_CM 0. 4.998 DISPLAY_IDENTIFIER C_KNK_THD_MAX FORMAT "%4.2" /end CHARACTERISTIC
/begin CHARACTERISTIC iga_ad1_knk_5__n__maf "" MAP 0x3fef46 _REC_MAP_20_u1_u1_u1 48. _CNV_A_R_LINEAR_____205_CM -48. 0. READ_ONLY DISPLAY_IDENTIFIER IGA_AD1_KNK_5__N__MAF FORMAT "%6.2" MAX_REFRESH 4 100
 /begin AXIS_DESCR COM_AXIS n_knk _CNV_A_R_LINEAR_____15_CM 8 0. 8160. FORMAT "%4.0" AXIS_PTS_REF ldpm_n_iga_ad /end AXIS_DESCR
 /begin AXIS_DESCR COM_AXIS maf_knk _CNV_A_R_LINEAR_____27_CM 6 0. 1389. FORMAT "%7.2" AXIS_PTS_REF ldpm_maf_iga_ad /end AXIS_DESCR
/end CHARACTERISTIC
/begin CHARACTERISTIC iga_ad1_knk_4__n__maf "" MAP 0x3fef16 _REC_MAP_20_u1_u1_u1 48. _CNV_A_R_LINEAR_____205_CM -48. 0. READ_ONLY DISPLAY_IDENTIFIER IGA_AD1_KNK_4__N__MAF FORMAT "%6.2" MAX_REFRESH 4 100
 /begin AXIS_DESCR COM_AXIS n_knk _CNV_A_R_LINEAR_____15_CM 8 0. 8160. FORMAT "%4.0" AXIS_PTS_REF ldpm_n_iga_ad /end AXIS_DESCR
 /begin AXIS_DESCR COM_AXIS maf_knk _CNV_A_R_LINEAR_____27_CM 6 0. 1389. FORMAT "%7.2" AXIS_PTS_REF ldpm_maf_iga_ad /end AXIS_DESCR
/end CHARACTERISTIC
/begin CHARACTERISTIC iga_ad1_knk_3__n__maf "" MAP 0x3feee6 _REC_MAP_20_u1_u1_u1 48. _CNV_A_R_LINEAR_____205_CM -48. 0. READ_ONLY DISPLAY_IDENTIFIER IGA_AD1_KNK_3__N__MAF FORMAT "%6.2" MAX_REFRESH 4 100
 /begin AXIS_DESCR COM_AXIS n_knk _CNV_A_R_LINEAR_____15_CM 8 0. 8160. FORMAT "%4.0" AXIS_PTS_REF ldpm_n_iga_ad /end AXIS_DESCR
 /begin AXIS_DESCR COM_AXIS maf_knk _CNV_A_R_LINEAR_____27_CM 6 0. 1389. FORMAT "%7.2" AXIS_PTS_REF ldpm_maf_iga_ad /end AXIS_DESCR
/end CHARACTERISTIC
/begin CHARACTERISTIC iga_ad1_knk_2__n__maf "" MAP 0x3feeb6 _REC_MAP_20_u1_u1_u1 48. _CNV_A_R_LINEAR_____205_CM -48. 0. READ_ONLY DISPLAY_IDENTIFIER IGA_AD1_KNK_2__N__MAF FORMAT "%6.2" MAX_REFRESH 4 100
 /begin AXIS_DESCR COM_AXIS n_knk _CNV_A_R_LINEAR_____15_CM 8 0. 8160. FORMAT "%4.0" AXIS_PTS_REF ldpm_n_iga_ad /end AXIS_DESCR
 /begin AXIS_DESCR COM_AXIS maf_knk _CNV_A_R_LINEAR_____27_CM 6 0. 1389. FORMAT "%7.2" AXIS_PTS_REF ldpm_maf_iga_ad /end AXIS_DESCR
/end CHARACTERISTIC
/begin AXIS_PTS ldpm_n_iga_ad "" 0xffe48599 n_knk _REC_AXS_20_u1 8160. _CNV_A_R_LINEAR_____15_CM 8 0. 8160. DISPLAY_IDENTIFIER LDPM_N_IGA_AD FORMAT "%4.0" /end AXIS_PTS
/begin CHARACTERISTIC iga_ad1_knk_1__n__maf "" MAP 0x3fee86 _REC_MAP_20_u1_u1_u1 48. _CNV_A_R_LINEAR_____205_CM -48. 0. READ_ONLY DISPLAY_IDENTIFIER IGA_AD1_KNK_1__N__MAF FORMAT "%6.2" MAX_REFRESH 4 100
 /begin AXIS_DESCR COM_AXIS n_knk _CNV_A_R_LINEAR_____15_CM 8 0. 8160. FORMAT "%4.0" AXIS_PTS_REF ldpm_n_iga_ad /end AXIS_DESCR
 /begin AXIS_DESCR COM_AXIS maf_knk _CNV_A_R_LINEAR_____27_CM 6 0. 1389. FORMAT "%7.2" AXIS_PTS_REF ldpm_maf_iga_ad /end AXIS_DESCR
/end CHARACTERISTIC
/begin CHARACTERISTIC iga_ad1_knk_0__n__maf "" MAP 0x3fee56 _REC_MAP_20_u1_u1_u1 48. _CNV_A_R_LINEAR_____205_CM -48. 0. READ_ONLY DISPLAY_IDENTIFIER IGA_AD1_KNK_0__N__MAF FORMAT "%6.2" MAX_REFRESH 4 100
 /begin AXIS_DESCR COM_AXIS n_knk _CNV_A_R_LINEAR_____15_CM 8 0. 8160. FORMAT "%4.0" AXIS_PTS_REF ldpm_n_iga_ad /end AXIS_DESCR
 /begin AXIS_DESCR COM_AXIS maf_knk _CNV_A_R_LINEAR_____27_CM 6 0. 1389. FORMAT "%7.2" AXIS_PTS_REF ldpm_maf_iga_ad /end AXIS_DESCR
/end CHARACTERISTIC
/begin AXIS_PTS ldpm_maf_iga_ad "" 0xffe41372 maf_knk _REC_AXS_20_u1 1389. _CNV_A_R_LINEAR_____27_CM 6 0. 1389. DISPLAY_IDENTIFIER LDPM_MAF_IGA_AD FORMAT "%7.2" /end AXIS_PTS
/begin AXIS_PTS ldpm_n_2_9 "" 0xffe4844e n_knk _REC_AXS_20_u1 8160. _CNV_A_R_LINEAR_____15_CM 16 0. 8160. DISPLAY_IDENTIFIER LDPM_N_2_9 FORMAT "%4.0" /end AXIS_PTS
/begin AXIS_PTS ldpm_n_knkwb "" 0xffe485ab n_knk _REC_AXS_20_u1 8160. _CNV_A_R_LINEAR_____15_CM 10 0. 8160. DISPLAY_IDENTIFIER LDPM_N_KNKWB FORMAT "%4.0" /end AXIS_PTS
/begin AXIS_PTS ldpm_maf_knkwb "" 0xffe41379 maf_knk _REC_AXS_20_u1 1389. _CNV_A_R_LINEAR_____27_CM 4 0. 1389. DISPLAY_IDENTIFIER LDPM_MAF_KNKWB FORMAT "%4.0" /end AXIS_PTS
/begin AXIS_PTS ldpm_n_fil_frq_knk "" 0xffe413fd n_knk _REC_AXS_20_u1 8160. _CNV_A_R_LINEAR_____15_CM 4 0. 8160. DISPLAY_IDENTIFIER LDPM_N_FIL_FRQ_KNK FORMAT "%4.0" /end AXIS_PTS
/begin AXIS_PTS ldpm_maf_1_9 "" 0xffe4135f maf_knk _REC_AXS_20_u1 69.45 _CNV_A_R_LINEAR_____27_CM 4 0. 1389. DISPLAY_IDENTIFIER LDPM_MAF_1_9 FORMAT "%4.0" /end AXIS_PTS
/begin CHARACTERISTIC c_maf_min_knk_ad2 "min. mass air for Adaptation circuit 2" VALUE 0xffe40794 _REC_VAL_20_u1 416.7 _CNV_A_R_LINEAR_____27_CM 0. 1389. DISPLAY_IDENTIFIER C_MAF_MIN_KNK_AD2 FORMAT "%4.0" /end CHARACTERISTIC
/begin MEASUREMENT knk_ctl_dis "knock control disabled due to malfunctions" UBYTE _CNV_S_2_RANGE______21_CM 1 100. 0. 1. DISPLAY_IDENTIFIER KNK_CTL_DIS ECU_ADDRESS 0x3fe87d /end MEASUREMENT
/begin MEASUREMENT lv_knk_ad_rd_ena "reading from Adaptation table enabled" UBYTE _CNV_S_2_RANGE______21_CM 1 100. 0. 1. DISPLAY_IDENTIFIER LV_KNK_AD_RD_ENA ECU_ADDRESS 0x3fe880 /end MEASUREMENT
/begin MEASUREMENT knk_ad1_dis "Adaptation circuit 1 disabled" UBYTE _CNV_S_2_RANGE______21_CM 1 100. 0. 1. DISPLAY_IDENTIFIER KNK_AD1_DIS ECU_ADDRESS 0x3fe87e /end MEASUREMENT
/begin MEASUREMENT knk_ad2_dis "Adaptation circuit 2 disabled" UBYTE _CNV_S_2_RANGE______21_CM 1 100. 0. 1. DISPLAY_IDENTIFIER KNK_AD2_DIS ECU_ADDRESS 0x3fe87f /end MEASUREMENT
/begin CHARACTERISTIC c_tco_ad_min_ron "Bottom limit TCO" VALUE 0xffe408eb _REC_VAL_20_u1 190.5 _CNV_A_R_LINEAR_____11_CM -48. 142.5 DISPLAY_IDENTIFIER C_TCO_AD_MIN_RON FORMAT "%5.1" /end CHARACTERISTIC
/begin CHARACTERISTIC c_cycnr_ad_rtd_knk "Number of combustion cycles for  RON adjustment" VALUE 0xffe415aa _REC_VAL_20_u2 65535. _CNV_A_R_LINEAR_____258_CM 0. 65535. DISPLAY_IDENTIFIER C_CYCNR_AD_RTD_KNK FORMAT "%5.0" /end CHARACTERISTIC
/begin CHARACTERISTIC c_iga_min_ad "MIN limit IGA for RON adjustment" VALUE 0xffe40773 _REC_VAL_20_u1 48. _CNV_A_R_LINEAR_____205_CM -48. 0. DISPLAY_IDENTIFIER C_IGA_MIN_AD FORMAT "%5.1" /end CHARACTERISTIC
/begin CHARACTERISTIC c_iga_max_ad "MAX limit IGA for RON adjustment" VALUE 0xffe40772 _REC_VAL_20_u1 48. _CNV_A_R_LINEAR_____205_CM -48. 0. DISPLAY_IDENTIFIER C_IGA_MAX_AD FORMAT "%5.1" /end CHARACTERISTIC
/begin CHARACTERISTIC c_cycnr_fac_ron "Adjustment value for RON incrementation  " VALUE 0xffe406db _REC_VAL_20_u1 254. _CNV_A_R_LINEAR_____0_CM 1. 255. DISPLAY_IDENTIFIER C_CYCNR_FAC_RON FORMAT "%3.0" /end CHARACTERISTIC
/begin CHARACTERISTIC c_tco_fac_ron_min "TCO-Threshold RON Factor  changing after initialisation cold" VALUE 0xffe40900 _REC_VAL_20_u1 190.5 _CNV_A_R_LINEAR_____11_CM -48. 142.5 DISPLAY_IDENTIFIER C_TCO_FAC_RON_MIN FORMAT "%5.1" /end CHARACTERISTIC
/begin CHARACTERISTIC c_tco_fac_ron_max "TCO-Threshold RON Factor  changing after initialisation hot" VALUE 0xffe408ff _REC_VAL_20_u1 190.5 _CNV_A_R_LINEAR_____11_CM -48. 142.5 DISPLAY_IDENTIFIER C_TCO_FAC_RON_MAX FORMAT "%5.1" /end CHARACTERISTIC
/begin CHARACTERISTIC c_fac_ron_ad_cold "Factor moving to ® RON_98 after ECU initialisation" VALUE 0xffe40745 _REC_VAL_20_u1 1.99220002 _CNV_A_R_LINEAR_____39_CM 0. 1.99220002 DISPLAY_IDENTIFIER C_FAC_RON_AD_COLD FORMAT "%5.3" /end CHARACTERISTIC
/begin CHARACTERISTIC c_fac_ron_ad_hot "Factor moving to ® RON_91 after ECU initialisation" VALUE 0xffe40746 _REC_VAL_20_u1 1.99220002 _CNV_A_R_LINEAR_____39_CM 0. 1.99220002 DISPLAY_IDENTIFIER C_FAC_RON_AD_HOT FORMAT "%5.3" /end CHARACTERISTIC
/begin CHARACTERISTIC id_maf_min_knk_ad_2__n_32 "MAF-theshold for activation  RON-Adaptation" CURVE 0xffe4414c _REC_CUR_20_u1_u1 1389. _CNV_A_R_LINEAR_____27_CM 0. 1389. DISPLAY_IDENTIFIER ID_MAF_MIN_KNK_AD_2__N_32 FORMAT "%4.0"
 /begin AXIS_DESCR COM_AXIS n_32 _CNV_A_R_LINEAR_____15_CM 16 0. 8160. FORMAT "%4.0" AXIS_PTS_REF ldp_n_32__maf_min_knk_ad_2 /end AXIS_DESCR
/end CHARACTERISTIC
/begin CHARACTERISTIC ip_fac_ron_inc__n_32 "RON-factor increment " CURVE 0xffe41c3c _REC_CUR_20_u2_u1 0.99998474 _CNV_A_R_LINEAR_____37_CM 0. 0.99998474 DISPLAY_IDENTIFIER IP_FAC_RON_INC__N FORMAT "%7.5"
 /begin AXIS_DESCR COM_AXIS n_32 _CNV_A_R_LINEAR_____15_CM 4 0. 8160. FORMAT "%4.0" AXIS_PTS_REF ldpm_n_32_3_iga /end AXIS_DESCR
/end CHARACTERISTIC
/begin CHARACTERISTIC ip_fac_ron_dec__n_32 "RON factor decrement" CURVE 0xffe41c34 _REC_CUR_20_u2_u1 0.99998474 _CNV_A_R_LINEAR_____37_CM 0. 0.99998474 DISPLAY_IDENTIFIER IP_FAC_RON_DEC__N FORMAT "%7.5"
 /begin AXIS_DESCR COM_AXIS n_32 _CNV_A_R_LINEAR_____15_CM 4 0. 8160. FORMAT "%4.0" AXIS_PTS_REF ldpm_n_32_3_iga /end AXIS_DESCR
/end CHARACTERISTIC
/begin CHARACTERISTIC ip_fac_ron_ad_max__tia__tco "Threshold for RON Factor = 1 recognition for the whole  driving cycle" MAP 0xffe456ea _REC_MAP_20_u1_u1_u1 0.9960940000000002 _CNV_A_R_LINEAR_____50_CM 0. 0.996094 DISPLAY_IDENTIFIER IP_FAC_RON_AD_MAX__TIA__TCO FORMAT "%5.3"
 /begin AXIS_DESCR COM_AXIS tia _CNV_A_R_LINEAR_____11_CM 4 -48. 142.5 FORMAT "%5.1" AXIS_PTS_REF ldp_tia__ip_fac_ron_ad_max /end AXIS_DESCR
 /begin AXIS_DESCR COM_AXIS tco _CNV_A_R_LINEAR_____11_CM 4 -48. 142.5 FORMAT "%5.1" AXIS_PTS_REF ldp_tco__ip_fac_ron_ad_max /end AXIS_DESCR
/end CHARACTERISTIC
/begin MEASUREMENT fac_ron_ad "Adaptive RON factor" UWORD _CNV_A_R_LINEAR_____37_CM 1 100. 0. 0.99998474 DISPLAY_IDENTIFIER FAC_RON_AD ECU_ADDRESS 0x3fd90c BYTE_ORDER MSB_LAST FORMAT "%7.5" /end MEASUREMENT
/begin MEASUREMENT lv_fac_ron_ad_act "Adaptive RON factor" UBYTE _CNV_S_2_RANGE______2_CM 1 100. 0. 1. DISPLAY_IDENTIFIER LV_FAC_RON_AD_ACT ECU_ADDRESS 0x3fe881 /end MEASUREMENT
/begin AXIS_PTS ldp_n_32__maf_min_knk_ad_2 "" 0xffe48077 n_32 _REC_AXS_20_u1 8160. _CNV_A_R_LINEAR_____15_CM 16 0. 8160. DISPLAY_IDENTIFIER LDP_N_32__MAF_MIN_KNK_AD_2 FORMAT "%4.0" /end AXIS_PTS
/begin AXIS_PTS ldp_tia__ip_fac_ron_ad_max "" 0xffe4127b tia _REC_AXS_20_u1 190.5 _CNV_A_R_LINEAR_____11_CM 4 -48. 142.5 DISPLAY_IDENTIFIER LDP_TIA__IP_FAC_RON_AD_MAX FORMAT "%5.1" /end AXIS_PTS
/begin AXIS_PTS ldp_tco__ip_fac_ron_ad_max "" 0xffe411c6 tco _REC_AXS_20_u1 190.5 _CNV_A_R_LINEAR_____11_CM 4 -48. 142.5 DISPLAY_IDENTIFIER LDP_TCO__IP_FAC_RON_AD_MAX FORMAT "%5.1" /end AXIS_PTS
/begin AXIS_PTS ldpm_n_32_3_iga "" 0xffe4139c n_32 _REC_AXS_20_u1 8160. _CNV_A_R_LINEAR_____15_CM 4 0. 8160. DISPLAY_IDENTIFIER LDPM_N_32_3_IGA FORMAT "%4.0" /end AXIS_PTS
/begin MEASUREMENT iga_tra_knk "Spark retard till high TPS_GRD or MAP_DRV1 applied to engnie" UBYTE _CNV_A_R_LINEAR_____205_CM 1 100. -48. 0. DISPLAY_IDENTIFIER IGA_TRA_KNK ECU_ADDRESS 0x3fe883 FORMAT "%5.1" /end MEASUREMENT
/begin MEASUREMENT iga_tra_knk_inter "Spark retard till high TPS_GRD or MAP_DRV1 intermediate" UBYTE _CNV_A_R_LINEAR_____205_CM 1 100. -48. 0. DISPLAY_IDENTIFIER IGA_TRA_KNK_INTER ECU_ADDRESS 0x3fe886 FORMAT "%5.1" /end MEASUREMENT
/begin MEASUREMENT lv_iga_tra_knk "Flag for instationary correction avtive" UBYTE _CNV_S_2_RANGE______2_CM 1 100. 0. 1. DISPLAY_IDENTIFIER LV_IGA_TRA_KNK ECU_ADDRESS 0x3fe884 /end MEASUREMENT
/begin MEASUREMENT ctr_cyc_iga_tra_knk_dly "Cycle counter for delay period before ignition intervention" UBYTE _CNV_A_R_LINEAR_____0_CM 1 100. 0. 255. DISPLAY_IDENTIFIER CTR_CYC_IGA_TRA_KNK_DLY ECU_ADDRESS 0x3fe887 FORMAT "%3.0" /end MEASUREMENT
/begin MEASUREMENT ctr_cyc_iga_tra_knk_act "Cycle counter during active ignition intervention" UBYTE _CNV_A_R_LINEAR_____0_CM 1 100. 0. 255. DISPLAY_IDENTIFIER CTR_CYC_IGA_TRA_KNK_ACT ECU_ADDRESS 0x3fe888 FORMAT "%3.0" /end MEASUREMENT
/begin MEASUREMENT ctr_cyc_iga_tra_knk_wait "Cycle counter for delay time before follow up ignition intervention" UBYTE _CNV_A_R_LINEAR_____0_CM 1 100. 0. 255. DISPLAY_IDENTIFIER CTR_CYC_IGA_TRA_KNK_WAIT ECU_ADDRESS 0x3fe889 FORMAT "%3.0" /end MEASUREMENT
/begin MEASUREMENT state_iga_tra_knk "State of ignition angle intervention for knock prevention" UBYTE _CNV_S_6_STATE_IGA__259_CM 1 100. 0. 5. DISPLAY_IDENTIFIER STATE_IGA_TRA_KNK ECU_ADDRESS 0x3fe88a /end MEASUREMENT
/begin CHARACTERISTIC id_tps_grd_iga_tra_knk "TPS_GRD-threshold for activation of the IGA retard adjustment" CURVE 0xffe40aa7 _REC_CUR_20_u1_u1 2987.5 _CNV_A_R_LINEAR_____52_CM 0. 2987.5 DISPLAY_IDENTIFIER ID_TPS_GRD_IGA_TRA_KNK FORMAT "%6.1"
 /begin AXIS_DESCR COM_AXIS n_32 _CNV_A_R_LINEAR_____15_CM 4 0. 8160. FORMAT "%4.0" AXIS_PTS_REF ldpm_n_32_7 /end AXIS_DESCR
/end CHARACTERISTIC
/begin CHARACTERISTIC id_map_drv1_iga_tra_knk "MAP_DRV1-threshold for activation of the IGA retard adjustment" CURVE 0xffe40526 _REC_CUR_20_s2_u1 165.8 _CNV_A_R_LINEAR_____260_CM -82.90000000000001 82.90000000000001 DISPLAY_IDENTIFIER ID_MAP_DRV1_IGA_TRA_KNK FORMAT "%7.3"
 /begin AXIS_DESCR COM_AXIS n_32 _CNV_A_R_LINEAR_____15_CM 4 0. 8160. FORMAT "%4.0" AXIS_PTS_REF ldpm_n_32_7 /end AXIS_DESCR
/end CHARACTERISTIC
/begin CHARACTERISTIC ip_iga_tra_knk "Ignition adjustment angle in retard direction" MAP 0xffe46944 _REC_MAP_20_u1_u1_u1 48. _CNV_A_R_LINEAR_____205_CM -48. 0. DISPLAY_IDENTIFIER IP_IGA_TRA_KNK FORMAT "%5.1"
 /begin AXIS_DESCR COM_AXIS maf _CNV_A_R_LINEAR_____27_CM 4 0. 1389. FORMAT "%4.0" AXIS_PTS_REF ldp_maf_iga__iga_tra_knk /end AXIS_DESCR
 /begin AXIS_DESCR COM_AXIS n_32 _CNV_A_R_LINEAR_____15_CM 4 0. 8160. FORMAT "%4.0" AXIS_PTS_REF ldpm_n_32_7 /end AXIS_DESCR
/end CHARACTERISTIC
/begin CHARACTERISTIC ip_fac_iga_tra "TIA correction factor" MAP 0xffe45382 _REC_MAP_20_u1_u1_u1 0.99610001 _CNV_A_R_LINEAR_____29_CM 0. 0.99610001 DISPLAY_IDENTIFIER IP_FAC_IGA_TRA FORMAT "%5.3"
 /begin AXIS_DESCR COM_AXIS tia _CNV_A_R_LINEAR_____11_CM 4 -48. 142.5 FORMAT "%5.1" AXIS_PTS_REF ldp_tia_fac_iga_tra /end AXIS_DESCR
 /begin AXIS_DESCR COM_AXIS fac_ron_ad _CNV_A_R_LINEAR_____29_CM 3 0. 0.99610001 FORMAT "%5.3" AXIS_PTS_REF ldp_fac_ron_ad_fac_iga_tra /end AXIS_DESCR
/end CHARACTERISTIC
/begin CHARACTERISTIC ip_fac_iga_tra_gear_mt "GEAR/VS correction factor" MAP 0xffe453b2 _REC_MAP_20_u1_u1_u1 0.99610001 _CNV_A_R_LINEAR_____29_CM 0. 0.99610001 DISPLAY_IDENTIFIER IP_FAC_IGA_TRA_GEAR_MT FORMAT "%5.3"
 /begin AXIS_DESCR COM_AXIS vs _CNV_A_R_LINEAR_____23_CM 6 0. 255. FORMAT "%3.0" AXIS_PTS_REF ldp_vs_fac_iga_tra_gear_mt /end AXIS_DESCR
 /begin AXIS_DESCR COM_AXIS gear _CNV_A_R_LINEAR_____0_CM 6 0. 7. FORMAT "%2.0" AXIS_PTS_REF ldpm_gear_1 /end AXIS_DESCR
/end CHARACTERISTIC
/begin CHARACTERISTIC ip_fac_iga_tra_gear_at "GEAR/VS correction factor" MAP 0xffe4538e _REC_MAP_20_u1_u1_u1 0.99610001 _CNV_A_R_LINEAR_____29_CM 0. 0.99610001 DISPLAY_IDENTIFIER IP_FAC_IGA_TRA_GEAR_AT FORMAT "%5.3"
 /begin AXIS_DESCR COM_AXIS vs _CNV_A_R_LINEAR_____23_CM 6 0. 255. FORMAT "%3.0" AXIS_PTS_REF ldp_vs_fac_iga_tra_gear_at /end AXIS_DESCR
 /begin AXIS_DESCR COM_AXIS gear _CNV_A_R_LINEAR_____0_CM 6 0. 7. FORMAT "%2.0" AXIS_PTS_REF ldpm_gear_1 /end AXIS_DESCR
/end CHARACTERISTIC
/begin CHARACTERISTIC id_cyc_iga_tra_knk_dly "Delay after the load dynamics has been triggered initially" CURVE 0xffe40a17 _REC_CUR_20_u1_u1 255. _CNV_A_R_LINEAR_____0_CM 0. 255. DISPLAY_IDENTIFIER ID_CYC_IGA_TRA_KNK_DLY FORMAT "%3.0"
 /begin AXIS_DESCR COM_AXIS n_32 _CNV_A_R_LINEAR_____15_CM 4 0. 8160. FORMAT "%4.0" AXIS_PTS_REF ldpm_n_32_7 /end AXIS_DESCR
/end CHARACTERISTIC
/begin CHARACTERISTIC ip_iga_tra_inc "IGA limitation gradient for controlled reset of the ignition angle adjustment IP_IGA_TRA_KNK__N__MAF" CURVE 0xffe41c52 _REC_CUR_20_u2_u1 47.99707032000001 _CNV_A_R_LINEAR_____261_CM 1.46484e-003 47.99853516 DISPLAY_IDENTIFIER IP_IGA_TRA_INC
 /begin AXIS_DESCR COM_AXIS n_32 _CNV_A_R_LINEAR_____15_CM 4 0. 8160. FORMAT "%4.0" AXIS_PTS_REF ldpm_n_32_7 /end AXIS_DESCR
/end CHARACTERISTIC
/begin CHARACTERISTIC id_cyc_iga_tra_knk_act "Number of cycles for ignition angle adjustment active" CURVE 0xffe40a13 _REC_CUR_20_u1_u1 255. _CNV_A_R_LINEAR_____0_CM 0. 255. DISPLAY_IDENTIFIER ID_CYC_IGA_TRA_KNK_ACT FORMAT "%3.0"
 /begin AXIS_DESCR COM_AXIS n_32 _CNV_A_R_LINEAR_____15_CM 4 0. 8160. FORMAT "%4.0" AXIS_PTS_REF ldpm_n_32_7 /end AXIS_DESCR
/end CHARACTERISTIC
/begin CHARACTERISTIC id_cyc_iga_tra_knk_wait "Delay between two ignition angle interventions due to load dynamics" CURVE 0xffe40a1b _REC_CUR_20_u1_u1 255. _CNV_A_R_LINEAR_____0_CM 0. 255. DISPLAY_IDENTIFIER ID_CYC_IGA_TRA_KNK_WAIT FORMAT "%3.0"
 /begin AXIS_DESCR COM_AXIS n_32 _CNV_A_R_LINEAR_____15_CM 4 0. 8160. FORMAT "%4.0" AXIS_PTS_REF ldpm_n_32_7 /end AXIS_DESCR
/end CHARACTERISTIC
/begin CHARACTERISTIC c_n_min_iga_tra_cs "Engine speed threshold for load dynamics IGA" VALUE 0xffe4182a _REC_VAL_20_u2 8160. _CNV_A_R_LINEAR_____10_CM 0. 8160. DISPLAY_IDENTIFIER C_N_MIN_IGA_TRA_CS FORMAT "%4.0" /end CHARACTERISTIC
/begin AXIS_PTS ldp_maf_iga__iga_tra_knk "" 0xffe4106c maf _REC_AXS_20_u1 1389. _CNV_A_R_LINEAR_____27_CM 4 0. 1389. DISPLAY_IDENTIFIER LDP_MAF_IGA__IGA_TRA_KNK FORMAT "%4.0" /end AXIS_PTS
/begin AXIS_PTS ldpm_n_32_7 "" 0xffe413ad n_32 _REC_AXS_20_u1 8160. _CNV_A_R_LINEAR_____15_CM 4 0. 8160. DISPLAY_IDENTIFIER LDPM_N_32_7 FORMAT "%4.0" /end AXIS_PTS
/begin AXIS_PTS ldp_fac_ron_ad_fac_iga_tra "" 0xffe41028 fac_ron_ad _REC_AXS_20_u1 0.99610001 _CNV_A_R_LINEAR_____29_CM 3 0. 0.99610001 DISPLAY_IDENTIFIER LDP_FAC_RON_AD_FAC_IGA_TRA FORMAT "%5.3" /end AXIS_PTS
/begin AXIS_PTS ldp_tia_fac_iga_tra "" 0xffe41280 tia _REC_AXS_20_u1 190.5 _CNV_A_R_LINEAR_____11_CM 4 -48. 142.5 DISPLAY_IDENTIFIER LDP_TIA_FAC_IGA_TRA FORMAT "%5.1" /end AXIS_PTS
/begin AXIS_PTS ldpm_gear_1 "" 0xffe41350 gear _REC_AXS_20_u1 7. _CNV_A_R_LINEAR_____0_CM 6 0. 7. DISPLAY_IDENTIFIER LDPM_GEAR_1 FORMAT "%2.0" /end AXIS_PTS
/begin AXIS_PTS ldp_vs_fac_iga_tra_gear_mt "" 0xffe41314 vs _REC_AXS_20_u1 255. _CNV_A_R_LINEAR_____23_CM 6 0. 255. DISPLAY_IDENTIFIER LDP_VS_FAC_IGA_TRA_GEAR_MT FORMAT "%3.0" /end AXIS_PTS
/begin AXIS_PTS ldp_vs_fac_iga_tra_gear_at "" 0xffe4130d vs _REC_AXS_20_u1 255. _CNV_A_R_LINEAR_____23_CM 6 0. 255. DISPLAY_IDENTIFIER LDP_VS_FAC_IGA_TRA_GEAR_AT FORMAT "%3.0" /end AXIS_PTS
/begin MEASUREMENT lamb_ch "Lambda catalyst heating" UWORD _CNV_A_R_LINEAR_____206_CM 1 100. 0. 31.99902344 DISPLAY_IDENTIFIER LAMB_CH ECU_ADDRESS 0x3fd35c BYTE_ORDER MSB_LAST FORMAT "%7.4" /end MEASUREMENT
/begin MEASUREMENT lamb_afl_ch "Lambda catalyst heating with lean strategy" UWORD _CNV_A_R_LINEAR_____206_CM 1 100. 0. 31.99902344 DISPLAY_IDENTIFIER LAMB_AFL_CH ECU_ADDRESS 0x3fd35e BYTE_ORDER MSB_LAST FORMAT "%7.4" /end MEASUREMENT
/begin CHARACTERISTIC ip_lamb_add_afl_ch "additive correction of the basic lambda heating correction" MAP 0xffe4c302 _REC_MAP_20_u2_u2_u1 63.99902344 _CNV_A_R_LINEAR_____277_CM -32. 31.99902344 DISPLAY_IDENTIFIER IP_LAMB_ADD_AFL_CH FORMAT "%8.4"
 /begin AXIS_DESCR COM_AXIS t_ast _CNV_A_R_LINEAR_____24_CM 8 0. 6553.5 FORMAT "%5.1" AXIS_PTS_REF ldp_t_ast__lamb_add_afl_ch /end AXIS_DESCR
 /begin AXIS_DESCR COM_AXIS tco _CNV_A_R_LINEAR_____11_CM 8 -48. 142.5 FORMAT "%5.1" AXIS_PTS_REF ldp_tco__lamb_add_afl_ch /end AXIS_DESCR
/end CHARACTERISTIC
/begin CHARACTERISTIC ip_lamb_ch_rgl "basic lambda correction for lean catalyst heating" MAP 0xffe4c682 _REC_MAP_20_u2_u2_u1 31.99902344 _CNV_A_R_LINEAR_____206_CM 0. 31.99902344 DISPLAY_IDENTIFIER IP_LAMB_CH_RGL FORMAT "%7.4"
 /begin AXIS_DESCR COM_AXIS tqi_req_slow _CNV_A_R_LINEAR_____187_CM 8 -1024. 1023.96875 FORMAT "%6.2" AXIS_PTS_REF ldp_tqi_req_slow__lamb_ch_rgl /end AXIS_DESCR
 /begin AXIS_DESCR COM_AXIS n_32 _CNV_A_R_LINEAR_____15_CM 8 0. 8160. FORMAT "%4.0" AXIS_PTS_REF ldp_n_32__lamb_ch_rgl /end AXIS_DESCR
/end CHARACTERISTIC
/begin CHARACTERISTIC ip_lamb_ch_is "basic lambda correction for lean catalyst heating during idle" MAP 0xffe4c602 _REC_MAP_20_u2_u2_u1 31.99902344 _CNV_A_R_LINEAR_____206_CM 0. 31.99902344 DISPLAY_IDENTIFIER IP_LAMB_CH_IS FORMAT "%7.4"
 /begin AXIS_DESCR COM_AXIS tqi_req_slow _CNV_A_R_LINEAR_____187_CM 8 -1024. 1023.96875 FORMAT "%6.2" AXIS_PTS_REF ldp_tqi_req_slow__lamb_ch_is /end AXIS_DESCR
 /begin AXIS_DESCR COM_AXIS n_32 _CNV_A_R_LINEAR_____15_CM 8 0. 8160. FORMAT "%4.0" AXIS_PTS_REF ldp_n_32__lamb_ch_is /end AXIS_DESCR
/end CHARACTERISTIC
/begin AXIS_PTS ldp_tco__lamb_add_afl_ch "" 0xffe481cb tco _REC_AXS_20_u1 190.5 _CNV_A_R_LINEAR_____11_CM 8 -48. 142.5 DISPLAY_IDENTIFIER LDP_TCO__LAMB_ADD_AFL_CH FORMAT "%5.1" /end AXIS_PTS
/begin AXIS_PTS ldp_t_ast__lamb_add_afl_ch "" 0xffe5128e t_ast _REC_AXS_20_u2 983.025 _CNV_A_R_LINEAR_____24_CM 8 0. 6553.5 DISPLAY_IDENTIFIER LDP_T_AST__LAMB_ADD_AFL_CH FORMAT "%5.1" /end AXIS_PTS
/begin AXIS_PTS ldp_tqi_req_slow__lamb_ch_rgl "" 0xffe514ca tqi_req_slow _REC_AXS_20_u2 2047.96875 _CNV_A_R_LINEAR_____187_CM 8 -1024. 1023.96875 DISPLAY_IDENTIFIER LDP_TQI_REQ_SLOW__LAMB_CH_RGL FORMAT "%6.2" /end AXIS_PTS
/begin AXIS_PTS ldp_n_32__lamb_ch_rgl "" 0xffe48042 n_32 _REC_AXS_20_u1 8160. _CNV_A_R_LINEAR_____15_CM 8 0. 8160. DISPLAY_IDENTIFIER LDP_N_32__LAMB_CH_RGL FORMAT "%4.0" /end AXIS_PTS
/begin AXIS_PTS ldp_tqi_req_slow__lamb_ch_is "" 0xffe514b8 tqi_req_slow _REC_AXS_20_u2 2047.96875 _CNV_A_R_LINEAR_____187_CM 8 -1024. 1023.96875 DISPLAY_IDENTIFIER LDP_TQI_REQ_SLOW__LAMB_CH_IS FORMAT "%6.2" /end AXIS_PTS
/begin AXIS_PTS ldp_n_32__lamb_ch_is "" 0xffe48039 n_32 _REC_AXS_20_u1 8160. _CNV_A_R_LINEAR_____15_CM 8 0. 8160. DISPLAY_IDENTIFIER LDP_N_32__LAMB_CH_IS FORMAT "%4.0" /end AXIS_PTS
/begin MEASUREMENT lam_bank_1.lsh_down.lshpwm_down "" UBYTE _CNV_A_R_LINEAR_____9_CM 1 100. 0. 99.609375 DISPLAY_IDENTIFIER LSHPWM_DOWN_1 ECU_ADDRESS 0x3fc408 FORMAT "%4.1" /end MEASUREMENT
/begin MEASUREMENT lam_bank_1.lsh_down.t_lsh_down "Timer to determine the duration of heating phase" UBYTE _CNV_A_R_LINEAR_____30_CM 1 100. 0. 255. DISPLAY_IDENTIFIER T_LSH_DOWN_1 ECU_ADDRESS 0x3fc409 FORMAT "%3.0" /end MEASUREMENT
/begin MEASUREMENT lam_bank_1.lsh_down.v_efc_lsh_down "Effective value of heater voltage" UBYTE _CNV_A_R_LINEAR_____34_CM 1 100. 0. 25.8984 DISPLAY_IDENTIFIER V_EFC_LSH_DOWN_1 ECU_ADDRESS 0x3fc40a FORMAT "%3.1" /end MEASUREMENT
/begin MEASUREMENT lam_bank_1.lsh_down.t_lsh_down_tol "Timer to determine the duration of high voltage phases" UBYTE _CNV_A_R_LINEAR_____30_CM 1 100. 0. 255. DISPLAY_IDENTIFIER T_LSH_DOWN_TOL_1 ECU_ADDRESS 0x3fc40b FORMAT "%3.0" /end MEASUREMENT
/begin MEASUREMENT lam_bank_1.lsh_down.t_lsh_down_lim "Timer to determine the duration of heating phases after a high voltage phase" UBYTE _CNV_A_R_LINEAR_____30_CM 1 100. 0. 255. DISPLAY_IDENTIFIER T_LSH_DOWN_LIM_1 ECU_ADDRESS 0x3fc40c FORMAT "%3.0" /end MEASUREMENT
/begin MEASUREMENT lam_bank_1.lsh_down.state_lsh_down "Heating state recognition" ULONG _CNV_S_6_STATE_LSH__336_CM 1 100. 0. 5. DISPLAY_IDENTIFIER STATE_LSH_DOWN_1 ECU_ADDRESS 0x3fc404 BYTE_ORDER MSB_LAST /end MEASUREMENT
/begin MEASUREMENT lam_bank_1.inj_iv_cut.lv_scc "Logical value for single cylinder cut off, cylinder bank 1/2" UBYTE _CNV_S_2_RANGE______2_CM 1 100. 0. 1. DISPLAY_IDENTIFIER LV_SCC_1 ECU_ADDRESS 0x3fc27c /end MEASUREMENT
/begin MEASUREMENT lam_bank_1.lamb_sp.lamb_bas_cor "lambda output for TQI_SP_MAF calculation" UWORD _CNV_A_R_LINEAR_____206_CM 1 100. 0. 31.99902344 DISPLAY_IDENTIFIER LAMB_BAS_COR_1 ECU_ADDRESS 0x3fc32c BYTE_ORDER MSB_LAST FORMAT "%7.4" /end MEASUREMENT
/begin MEASUREMENT lam_bank_1.lamb_sp.lamb_sp "lambda setpoint" UWORD _CNV_A_R_LINEAR_____206_CM 1 100. 0. 31.99902344 DISPLAY_IDENTIFIER LAMB_SP_1 ECU_ADDRESS 0x3fc330 BYTE_ORDER MSB_LAST FORMAT "%7.4" /end MEASUREMENT
/begin MEASUREMENT lam_bank_1.lamb_sp.lamb_sp_bas "lambda feedback for basic torque calculation" UWORD _CNV_A_R_LINEAR_____206_CM 1 100. 0. 31.99902344 DISPLAY_IDENTIFIER LAMB_SP_BAS_1 ECU_ADDRESS 0x3fc332 BYTE_ORDER MSB_LAST FORMAT "%7.4" /end MEASUREMENT
/begin MEASUREMENT lam_bank_1.lamb_sp.lamb_bas_cor_1_h_res "lambda setpoint used for lambda = 1 detection" ULONG _CNV_A_R_LINEAR_____282_CM 1 100. 0. 32. DISPLAY_IDENTIFIER LAMB_BAS_COR_1_H_RES_1 ECU_ADDRESS 0x3fc318 BYTE_ORDER MSB_LAST FORMAT "%8.5" /end MEASUREMENT
/begin MEASUREMENT lam_bank_1.lamb_sp.lamb_sp_h_res "lambda setpoint with high resolution" ULONG _CNV_A_R_LINEAR_____282_CM 1 100. 0. 32. DISPLAY_IDENTIFIER LAMB_SP_H_RES_1 ECU_ADDRESS 0x3fc328 BYTE_ORDER MSB_LAST FORMAT "%8.5" /end MEASUREMENT
/begin MEASUREMENT lam_bank_1.lamb_sp.lv_lamb_sp_1 "boolean to inicate if lambda setpoint is identical to 1" UBYTE _CNV_S_2_RANGE______2_CM 1 100. 0. 1. DISPLAY_IDENTIFIER LV_LAMB_SP_1_1 ECU_ADDRESS 0x3fc334 /end MEASUREMENT
/begin MEASUREMENT lam_bank_2.lsh_down.lshpwm_down "" UBYTE _CNV_A_R_LINEAR_____9_CM 1 100. 0. 99.609375 DISPLAY_IDENTIFIER LSHPWM_DOWN_2 ECU_ADDRESS 0x3fc8c0 FORMAT "%4.1" /end MEASUREMENT
/begin MEASUREMENT lam_bank_2.lsh_down.t_lsh_down "Timer to determine the duration of heating phase" UBYTE _CNV_A_R_LINEAR_____30_CM 1 100. 0. 255. DISPLAY_IDENTIFIER T_LSH_DOWN_2 ECU_ADDRESS 0x3fc8c1 FORMAT "%3.0" /end MEASUREMENT
/begin MEASUREMENT lam_bank_2.lsh_down.v_efc_lsh_down "Effective value of heater voltage" UBYTE _CNV_A_R_LINEAR_____34_CM 1 100. 0. 25.8984 DISPLAY_IDENTIFIER V_EFC_LSH_DOWN_2 ECU_ADDRESS 0x3fc8c2 FORMAT "%3.1" /end MEASUREMENT
/begin MEASUREMENT lam_bank_2.lsh_down.t_lsh_down_tol "Timer to determine the duration of high voltage phases" UBYTE _CNV_A_R_LINEAR_____30_CM 1 100. 0. 255. DISPLAY_IDENTIFIER T_LSH_DOWN_TOL_2 ECU_ADDRESS 0x3fc8c3 FORMAT "%3.0" /end MEASUREMENT
/begin MEASUREMENT lam_bank_2.lsh_down.t_lsh_down_lim "Timer to determine the duration of heating phases after a high voltage phase" UBYTE _CNV_A_R_LINEAR_____30_CM 1 100. 0. 255. DISPLAY_IDENTIFIER T_LSH_DOWN_LIM_2 ECU_ADDRESS 0x3fc8c4 FORMAT "%3.0" /end MEASUREMENT
/begin MEASUREMENT lam_bank_2.lsh_down.state_lsh_down "Heating state recognition" ULONG _CNV_S_6_STATE_LSH__336_CM 1 100. 0. 5. DISPLAY_IDENTIFIER STATE_LSH_DOWN_2 ECU_ADDRESS 0x3fc8bc BYTE_ORDER MSB_LAST /end MEASUREMENT
/begin MEASUREMENT lam_bank_2.inj_iv_cut.lv_scc "Logical value for single cylinder cut off, cylinder bank 1/2" UBYTE _CNV_S_2_RANGE______2_CM 1 100. 0. 1. DISPLAY_IDENTIFIER LV_SCC_2 ECU_ADDRESS 0x3fc734 /end MEASUREMENT
/begin MEASUREMENT lam_bank_2.lamb_sp.lamb_bas_cor "lambda output for TQI_SP_MAF calculation" UWORD _CNV_A_R_LINEAR_____206_CM 1 100. 0. 31.99902344 DISPLAY_IDENTIFIER LAMB_BAS_COR_2 ECU_ADDRESS 0x3fc7e4 BYTE_ORDER MSB_LAST FORMAT "%7.4" /end MEASUREMENT
/begin MEASUREMENT lam_bank_2.lamb_sp.lamb_sp "lambda setpoint" UWORD _CNV_A_R_LINEAR_____206_CM 1 100. 0. 31.99902344 DISPLAY_IDENTIFIER LAMB_SP_2 ECU_ADDRESS 0x3fc7e8 BYTE_ORDER MSB_LAST FORMAT "%7.4" /end MEASUREMENT
/begin MEASUREMENT lam_bank_2.lamb_sp.lamb_sp_bas "lambda feedback for basic torque calculation" UWORD _CNV_A_R_LINEAR_____206_CM 1 100. 0. 31.99902344 DISPLAY_IDENTIFIER LAMB_SP_BAS_2 ECU_ADDRESS 0x3fc7ea BYTE_ORDER MSB_LAST FORMAT "%7.4" /end MEASUREMENT
/begin MEASUREMENT lam_bank_2.lamb_sp.lamb_bas_cor_1_h_res "lambda setpoint used for lambda = 1 detection" ULONG _CNV_A_R_LINEAR_____282_CM 1 100. 0. 32. DISPLAY_IDENTIFIER LAMB_BAS_COR_1_H_RES_2 ECU_ADDRESS 0x3fc7d0 BYTE_ORDER MSB_LAST FORMAT "%8.5" /end MEASUREMENT
/begin MEASUREMENT lam_bank_2.lamb_sp.lamb_sp_h_res "lambda setpoint with high resolution" ULONG _CNV_A_R_LINEAR_____282_CM 1 100. 0. 32. DISPLAY_IDENTIFIER LAMB_SP_H_RES_2 ECU_ADDRESS 0x3fc7e0 BYTE_ORDER MSB_LAST FORMAT "%8.5" /end MEASUREMENT
/begin MEASUREMENT lam_bank_2.lamb_sp.lv_lamb_sp_1 "boolean to inicate if lambda setpoint is identical to 1" UBYTE _CNV_S_2_RANGE______2_CM 1 100. 0. 1. DISPLAY_IDENTIFIER LV_LAMB_SP_1_2 ECU_ADDRESS 0x3fc7ec /end MEASUREMENT
/begin MEASUREMENT lamb_fl "Lambda Requirement for Full Load Enrichment" UWORD _CNV_A_R_LINEAR_____206_CM 1 100. 0. 31.99902344 DISPLAY_IDENTIFIER LAMB_FL ECU_ADDRESS 0x3fd360 BYTE_ORDER MSB_LAST FORMAT "%7.4" /end MEASUREMENT
/begin CHARACTERISTIC c_lamb_fl_pas "Passive value for full load enrichment" VALUE 0xffe416b4 _REC_VAL_20_u2 31.99902344 _CNV_A_R_LINEAR_____206_CM 0. 31.99902344 DISPLAY_IDENTIFIER C_LAMB_FL_PAS FORMAT "%7.4" /end CHARACTERISTIC
/begin CHARACTERISTIC ip_lamb_fl__n "Lambda full load enrichment" CURVE 0xffe4c782 _REC_CUR_20_u2_u1 31.99902344 _CNV_A_R_LINEAR_____206_CM 0. 31.99902344 DISPLAY_IDENTIFIER IP_LAMB_FL__N FORMAT "%7.4"
 /begin AXIS_DESCR COM_AXIS n_32 _CNV_A_R_LINEAR_____15_CM 12 0. 8160. FORMAT "%4.0" AXIS_PTS_REF ldp_n__lamb_fl /end AXIS_DESCR
/end CHARACTERISTIC
/begin AXIS_PTS ldp_n__lamb_fl "" 0xffe48117 n_32 _REC_AXS_20_u1 8160. _CNV_A_R_LINEAR_____15_CM 12 0. 8160. DISPLAY_IDENTIFIER LDP_N__LAMB_FL FORMAT "%4.0" /end AXIS_PTS
/begin CHARACTERISTIC c_lamb_sp_1_hys "Hysteresis for lambda = 1 detection" VALUE 0xffe416de _REC_VAL_20_u2 31.99902344 _CNV_A_R_LINEAR_____206_CM 0. 31.99902344 DISPLAY_IDENTIFIER C_LAMB_SP_1_HYS FORMAT "%7.4" /end CHARACTERISTIC
/begin CHARACTERISTIC c_lamb_sp_ofs_as "manual lambda setpoint for application" VALUE 0xffe416ee _REC_VAL_20_u2 31.999023 _CNV_A_R_LINEAR_____351_CM -16. 15.999023 DISPLAY_IDENTIFIER C_LAMB_SP_OFS_AS FORMAT "%8.4" /end CHARACTERISTIC
/begin CHARACTERISTIC lc_lamb_sp_man_act "Logical variable switch to manual lambda setpoint" VALUE 0xffe40f95 _REC_VAL_20_u1 1. _CNV_S_2_RANGE______21_CM 0. 1. DISPLAY_IDENTIFIER LC_LAMB_SP_MAN_ACT /end CHARACTERISTIC
/begin MEASUREMENT lamb_bas_cor "Corrected basic lambda mean value" UWORD _CNV_A_R_LINEAR_____206_CM 1 100. 0. 31.99902344 DISPLAY_IDENTIFIER LAMB_BAS_COR ECU_ADDRESS 0x3fd4c2 BYTE_ORDER MSB_LAST FORMAT "%7.4" /end MEASUREMENT
/begin CHARACTERISTIC c_lamb_bas_cor_min "Minimum value for lambda setpoint" VALUE 0xffe416ac _REC_VAL_20_u2 31.99902344 _CNV_A_R_LINEAR_____206_CM 0. 31.99902344 DISPLAY_IDENTIFIER C_LAMB_BAS_COR_MIN FORMAT "%7.4" /end CHARACTERISTIC
/begin CHARACTERISTIC c_lamb_sp_man "manual lambda setpoint" VALUE 0xffe416e8 _REC_VAL_20_u2 31.99902344 _CNV_A_R_LINEAR_____206_CM 0. 31.99902344 DISPLAY_IDENTIFIER C_LAMB_SP_MAN FORMAT "%7.4" /end CHARACTERISTIC
/begin MEASUREMENT lamb_sp "lambda setpoint" UWORD _CNV_A_R_LINEAR_____206_CM 1 100. 0. 31.99902344 DISPLAY_IDENTIFIER LAMB_SP ECU_ADDRESS 0x3fd4c0 BYTE_ORDER MSB_LAST FORMAT "%7.4" /end MEASUREMENT
/begin MEASUREMENT lamb_sp_bas "-mean value of LAMB_SP_BAS_i" UWORD _CNV_A_R_LINEAR_____206_CM 1 100. 0. 31.99902344 DISPLAY_IDENTIFIER LAMB_SP_BAS ECU_ADDRESS 0x3fd4c4 BYTE_ORDER MSB_LAST FORMAT "%7.4" /end MEASUREMENT
/begin CHARACTERISTIC c_v_efc_lsh_down_tol "voltage threshold to the higher voltage range of the heater" VALUE 0xffe40993 _REC_VAL_20_u1 25.8984 _CNV_A_R_LINEAR_____34_CM 0. 25.8984 DISPLAY_IDENTIFIER C_V_EFC_LSH_DOWN_TOL FORMAT "%3.1" /end CHARACTERISTIC
/begin CHARACTERISTIC c_v_efc_lsh_down_max "maximum allowed heater voltage " VALUE 0xffe40991 _REC_VAL_20_u1 25.8984 _CNV_A_R_LINEAR_____34_CM 0. 25.8984 DISPLAY_IDENTIFIER C_V_EFC_LSH_DOWN_MAX FORMAT "%3.1" /end CHARACTERISTIC
/begin CHARACTERISTIC c_v_efc_lsh_down_prot "heater voltage in the case of overvoltage conditions" VALUE 0xffe40992 _REC_VAL_20_u1 25.8984 _CNV_A_R_LINEAR_____34_CM 0. 25.8984 DISPLAY_IDENTIFIER C_V_EFC_LSH_DOWN_PROT FORMAT "%3.1" /end CHARACTERISTIC
/begin CHARACTERISTIC c_t_lsh_down_tol "maximum of the tolerable heating time with in a higher voltage range " VALUE 0xffe4089f _REC_VAL_20_u1 255. _CNV_A_R_LINEAR_____30_CM 0. 255. DISPLAY_IDENTIFIER C_T_LSH_DOWN_TOL FORMAT "%3.0" /end CHARACTERISTIC
/begin CHARACTERISTIC c_v_efc_lsh_down_lim "limited voltage range of the heater" VALUE 0xffe40990 _REC_VAL_20_u1 25.8984 _CNV_A_R_LINEAR_____34_CM 0. 25.8984 DISPLAY_IDENTIFIER C_V_EFC_LSH_DOWN_LIM FORMAT "%3.1" /end CHARACTERISTIC
/begin CHARACTERISTIC c_v_efc_lsh_down_as "Additive correction to effective heater voltage" VALUE 0xffe4039e _REC_VAL_20_s1 26. _CNV_A_R_LINEAR_____326_CM -13.05 12.95 DISPLAY_IDENTIFIER C_V_EFC_LSH_DOWN_AS FORMAT "%5.1" /end CHARACTERISTIC
/begin CHARACTERISTIC ip_v_efc_lsh_down_ctl "Heater voltage effective value after completion of the heating phase" MAP 0xffe47ecf _REC_MAP_20_u1_u1_u2 25.8984 _CNV_A_R_LINEAR_____34_CM 0. 25.8984 DISPLAY_IDENTIFIER IP_V_EFC_LSH_DOWN_CTL FORMAT "%3.1"
 /begin AXIS_DESCR COM_AXIS n_32 _CNV_A_R_LINEAR_____15_CM 6 0. 8160. FORMAT "%4.0" AXIS_PTS_REF ldp_n_32_ip_v_efc_lsh_down_ctl /end AXIS_DESCR
 /begin AXIS_DESCR COM_AXIS online_dummy _CNV_A_R_LINEAR_____6_CM 6 0. 2047. FORMAT "%7.2" AXIS_PTS_REF ldpm_teg_cat_down_mdl_1_egcp /end AXIS_DESCR
/end CHARACTERISTIC
/begin CHARACTERISTIC ip_v_efc_lsh_down_ini "Initial heater voltage value" CURVE 0xffe40ebf _REC_CUR_20_u1_u2 25.8984 _CNV_A_R_LINEAR_____34_CM 0. 25.8984 DISPLAY_IDENTIFIER IP_V_EFC_LSH_DOWN_INI FORMAT "%3.1"
 /begin AXIS_DESCR COM_AXIS online_dummy _CNV_A_R_LINEAR_____368_CM 6 -2048. 2047.938 FORMAT "%8.2" AXIS_PTS_REF ldpm_temp_ls_down_ini_1_egcp /end AXIS_DESCR
/end CHARACTERISTIC
/begin CHARACTERISTIC ip_t_lsh_down_temp_thd "Duration until critical water splash sensor temperature reached" CURVE 0xffe40e34 _REC_CUR_20_u1_u2 255. _CNV_A_R_LINEAR_____30_CM 0. 255. DISPLAY_IDENTIFIER IP_T_LSH_DOWN_TEMP_THD FORMAT "%3.0"
 /begin AXIS_DESCR COM_AXIS online_dummy _CNV_A_R_LINEAR_____368_CM 6 -2048. 2047.938 FORMAT "%8.2" AXIS_PTS_REF ldpm_temp_ls_down_ini_1_egcp /end AXIS_DESCR
/end CHARACTERISTIC
/begin CHARACTERISTIC ip_fac_v_efc_down_teg "Coorection factor for the assumtion of the heat transfer exclusive for bank 2" CURVE 0xffe40c57 _REC_CUR_20_u1_u1 3.984375 _CNV_A_R_LINEAR_____129_CM 0. 3.984375 DISPLAY_IDENTIFIER IP_FAC_V_EFC_DOWN_TEG FORMAT "%4.2"
 /begin AXIS_DESCR COM_AXIS vs _CNV_A_R_LINEAR_____23_CM 6 0. 255. FORMAT "%3.0" AXIS_PTS_REF ldp_vs_ip_fac_v_efc_down_teg /end AXIS_DESCR
/end CHARACTERISTIC
/begin CHARACTERISTIC c_dec_v_efc_down "Heater voltage decrement to lower temperature" VALUE 0xffe406e2 _REC_VAL_20_u1 25.8984 _CNV_A_R_LINEAR_____34_CM 0. 25.8984 DISPLAY_IDENTIFIER C_DEC_V_EFC_DOWN FORMAT "%3.1" /end CHARACTERISTIC
/begin CHARACTERISTIC c_inc_v_efc_down "Heater voltage increment to raise temperature" VALUE 0xffe40779 _REC_VAL_20_u1 25.8984 _CNV_A_R_LINEAR_____34_CM 0. 25.8984 DISPLAY_IDENTIFIER C_INC_V_EFC_DOWN FORMAT "%3.1" /end CHARACTERISTIC
/begin CHARACTERISTIC c_v_efc_down_red "Reduced heater voltage during danger of water splash damage" VALUE 0xffe4098f _REC_VAL_20_u1 25.8984 _CNV_A_R_LINEAR_____34_CM 0. 25.8984 DISPLAY_IDENTIFIER C_V_EFC_DOWN_RED FORMAT "%3.1" /end CHARACTERISTIC
/begin CHARACTERISTIC c_t_lsh_down_lim "time after a heating phase with a higher voltage range" VALUE 0xffe4089d _REC_VAL_20_u1 255. _CNV_A_R_LINEAR_____30_CM 0. 255. DISPLAY_IDENTIFIER C_T_LSH_DOWN_LIM FORMAT "%3.0" /end CHARACTERISTIC
/begin CHARACTERISTIC c_t_lsh_down_rise "Duration of open loop heating in PREHEATING" VALUE 0xffe4089e _REC_VAL_20_u1 255. _CNV_A_R_LINEAR_____30_CM 0. 255. DISPLAY_IDENTIFIER C_T_LSH_DOWN_RISE FORMAT "%3.0" /end CHARACTERISTIC
/begin CHARACTERISTIC c_vb_prot_down_max "maximum battery voltage threshold for the detection of overvoltage" VALUE 0xffe409c3 _REC_VAL_20_u1 25.8984 _CNV_A_R_LINEAR_____34_CM 0. 25.8984 DISPLAY_IDENTIFIER C_VB_PROT_DOWN_MAX FORMAT "%3.1" /end CHARACTERISTIC
/begin CHARACTERISTIC c_v_efc_lsh_down_step "Additional effective heater voltage step on transition from LSH_POW_RED to LSH_POW_RISE" VALUE 0xffe4039f _REC_VAL_20_s1 26. _CNV_A_R_LINEAR_____326_CM -13.05 12.95 DISPLAY_IDENTIFIER C_V_EFC_LSH_DOWN_STEP FORMAT "%5.1" /end CHARACTERISTIC
/begin CHARACTERISTIC c_t_lshpwm_down_fast_vb_cor "Additional effective heater voltage step on transition from LSH_POW_RED to LSH_POW_RISE" VALUE 0xffe408a3 _REC_VAL_20_u1 2.55 _CNV_A_R_LINEAR_____4_CM 0. 2.55 DISPLAY_IDENTIFIER C_T_LSHPWM_DOWN_FAST_VB_COR FORMAT "%4.2" /end CHARACTERISTIC
/begin CHARACTERISTIC c_fac_v_efc_lsh_down_as "Multiplicative correction factor to effective heater voltage" VALUE 0xffe4074d _REC_VAL_20_u1 1.9921875 _CNV_A_R_LINEAR_____117_CM 0. 1.9921875 DISPLAY_IDENTIFIER C_FAC_V_EFC_LSH_DOWN_AS FORMAT "%5.3" /end CHARACTERISTIC
/begin AXIS_PTS ldpm_teg_cat_down_mdl_1_egcp "" 0xffe51d5a online_dummy _REC_AXS_20_u2 2047. _CNV_A_R_LINEAR_____6_CM 6 0. 2047. DISPLAY_IDENTIFIER LDPM_TEG_CAT_DOWN_MDL_1_EGCP FORMAT "%7.2" /end AXIS_PTS
/begin AXIS_PTS ldpm_temp_ls_down_ini_1_egcp "" 0xffe51e10 online_dummy _REC_AXS_20_u2 4095.938 _CNV_A_R_LINEAR_____368_CM 6 -2048. 2047.938 DISPLAY_IDENTIFIER LDPM_TEMP_LS_DOWN_INI_1_EGCP FORMAT "%8.2" /end AXIS_PTS
/begin AXIS_PTS ldp_n_32_ip_v_efc_lsh_down_ctl "" 0xffe41114 n_32 _REC_AXS_20_u1 8160. _CNV_A_R_LINEAR_____15_CM 6 0. 8160. DISPLAY_IDENTIFIER LDP_N_32_IP_V_EFC_LSH_DOWN_CTL FORMAT "%4.0" /end AXIS_PTS
/begin AXIS_PTS ldp_vs_ip_fac_v_efc_down_teg "" 0xffe41322 vs _REC_AXS_20_u1 255. _CNV_A_R_LINEAR_____23_CM 6 0. 255. DISPLAY_IDENTIFIER LDP_VS_IP_FAC_V_EFC_DOWN_TEG FORMAT "%3.0" /end AXIS_PTS
/begin CHARACTERISTIC c_mff_sp_man "manual setpoint for fuel mass in homogeneous mode" VALUE 0xffe417da _REC_VAL_20_u2 1389. _CNV_A_R_LINEAR_____108_CM 0. 1389. DISPLAY_IDENTIFIER C_MFF_SP_MAN FORMAT "%7.2" /end CHARACTERISTIC
/begin CHARACTERISTIC c_mff_sp_hom_ofs_as "additive mass fuel offset value for application" VALUE 0xffe417d8 _REC_VAL_20_u2 1389. _CNV_A_R_LINEAR_____108_CM 0. 1389. DISPLAY_IDENTIFIER C_MFF_SP_HOM_OFS_AS FORMAT "%7.2" /end CHARACTERISTIC
/begin MEASUREMENT mff_sp_clc_1 "Calculated mass fuel flow setpoint for homogenious charge" UWORD _CNV_A_R_LINEAR_____108_CM 1 100. 0. 1389. DISPLAY_IDENTIFIER MFF_SP_CLC_1 ECU_ADDRESS 0x3fd920 BYTE_ORDER MSB_LAST FORMAT "%7.2" /end MEASUREMENT
/begin MEASUREMENT mff_sp_clc_2 "Calculated mass fuel flow setpoint for homogenious charge" UWORD _CNV_A_R_LINEAR_____108_CM 1 100. 0. 1389. DISPLAY_IDENTIFIER MFF_SP_CLC_2 ECU_ADDRESS 0x3fd922 BYTE_ORDER MSB_LAST FORMAT "%7.2" /end MEASUREMENT
/begin MEASUREMENT mff_sp_hom_eng_1 "Calculated mass fuel flow output for canister purge" UWORD _CNV_A_R_LINEAR_____108_CM 1 100. 0. 1389. DISPLAY_IDENTIFIER MFF_SP_HOM_ENG_1 ECU_ADDRESS 0x3fd91c BYTE_ORDER MSB_LAST FORMAT "%7.2" /end MEASUREMENT
/begin MEASUREMENT mff_sp_hom_eng_2 "Calculated mass fuel flow output for canister purge" UWORD _CNV_A_R_LINEAR_____108_CM 1 100. 0. 1389. DISPLAY_IDENTIFIER MFF_SP_HOM_ENG_2 ECU_ADDRESS 0x3fd91e BYTE_ORDER MSB_LAST FORMAT "%7.2" /end MEASUREMENT
/begin CHARACTERISTIC ip_mff_cor_2 "Operating point correction of the basic injection fuel nass" MAP 0xffe4d2aa _REC_MAP_20_u2_u2_u2 1.99996948 _CNV_A_R_LINEAR_____20_CM 0. 1.99996948 DISPLAY_IDENTIFIER IP_MFF_COR_2 FORMAT "%7.5"
 /begin AXIS_DESCR COM_AXIS maf _CNV_A_R_LINEAR_____108_CM 12 0. 1389. FORMAT "%7.2" AXIS_PTS_REF ldp_maf__mff_cor_2 /end AXIS_DESCR
 /begin AXIS_DESCR COM_AXIS n _CNV_A_R_LINEAR_____10_CM 16 0. 8160. FORMAT "%4.0" AXIS_PTS_REF ldp_n__mff_cor_2 /end AXIS_DESCR
/end CHARACTERISTIC
/begin CHARACTERISTIC ip_mff_cor_1 "Operating point correction of the basic injection fuel nass" MAP 0xffe4d12a _REC_MAP_20_u2_u2_u2 1.99996948 _CNV_A_R_LINEAR_____20_CM 0. 1.99996948 DISPLAY_IDENTIFIER IP_MFF_COR_1 FORMAT "%7.5"
 /begin AXIS_DESCR COM_AXIS maf _CNV_A_R_LINEAR_____108_CM 12 0. 1389. FORMAT "%7.2" AXIS_PTS_REF ldp_maf__mff_cor_1 /end AXIS_DESCR
 /begin AXIS_DESCR COM_AXIS n _CNV_A_R_LINEAR_____10_CM 16 0. 8160. FORMAT "%4.0" AXIS_PTS_REF ldp_n__mff_cor_1 /end AXIS_DESCR
/end CHARACTERISTIC
/begin CHARACTERISTIC lc_mff_sp_hom_man_act "switch for manual setpoint for fuel mass in homogeneous mode" VALUE 0xffe40faa _REC_VAL_20_u1 1. _CNV_S_2_RANGE______21_CM 0. 1. DISPLAY_IDENTIFIER LC_MFF_SP_HOM_MAN_ACT /end CHARACTERISTIC
/begin MEASUREMENT mff_sp_hom[0] "Mass fuel flow setpoint for homogeneous charge (output)" UWORD _CNV_A_R_LINEAR_____108_CM 1 100. 0. 1389. DISPLAY_IDENTIFIER MFF_SP_HOM_1 ECU_ADDRESS 0x3fd918 BYTE_ORDER MSB_LAST FORMAT "%7.2" /end MEASUREMENT
/begin MEASUREMENT mff_sp_hom[1] "Mass fuel flow setpoint for homogeneous charge (output)" UWORD _CNV_A_R_LINEAR_____108_CM 1 100. 0. 1389. DISPLAY_IDENTIFIER MFF_SP_HOM_2 ECU_ADDRESS 0x3fd91a BYTE_ORDER MSB_LAST FORMAT "%7.2" /end MEASUREMENT
/begin AXIS_PTS ldp_maf__mff_cor_1 "" 0xffe50cc4 maf _REC_AXS_20_u2 138.9 _CNV_A_R_LINEAR_____108_CM 12 0. 1389. DISPLAY_IDENTIFIER LDP_MAF__MFF_COR_1 FORMAT "%7.2" /end AXIS_PTS
/begin AXIS_PTS ldp_maf__mff_cor_2 "" 0xffe50cde maf _REC_AXS_20_u2 138.9 _CNV_A_R_LINEAR_____108_CM 12 0. 1389. DISPLAY_IDENTIFIER LDP_MAF__MFF_COR_2 FORMAT "%7.2" /end AXIS_PTS
/begin AXIS_PTS ldp_n__mff_cor_1 "" 0xffe50fc0 n _REC_AXS_20_u2 816. _CNV_A_R_LINEAR_____10_CM 16 0. 8160. DISPLAY_IDENTIFIER LDP_N__MFF_COR_1 FORMAT "%4.0" /end AXIS_PTS
/begin AXIS_PTS ldp_n__mff_cor_2 "" 0xffe50fe2 n _REC_AXS_20_u2 816. _CNV_A_R_LINEAR_____10_CM 16 0. 8160. DISPLAY_IDENTIFIER LDP_N__MFF_COR_2 FORMAT "%4.0" /end AXIS_PTS
/begin CHARACTERISTIC c_mff_fac "Constannt for stoichiometric air/fuel ratio (=1/14.7)" VALUE 0xffe417d6 _REC_VAL_20_u2 0.125 _CNV_A_R_LINEAR_____404_CM 0. 0.125 DISPLAY_IDENTIFIER C_MFF_FAC FORMAT "%7.5" /end CHARACTERISTIC
/begin MEASUREMENT mff_bas "Basic injection fuel mass flow (homogenious charge)" UWORD _CNV_A_R_LINEAR_____108_CM 1 100. 0. 1389. DISPLAY_IDENTIFIER MFF_BAS ECU_ADDRESS 0x3fd916 BYTE_ORDER MSB_LAST FORMAT "%7.2" /end MEASUREMENT
/begin AXIS_PTS ldpm_n_tooth__eoi_st "" 0xffe51c3a n_tooth _REC_AXS_20_u2 816. _CNV_A_R_LINEAR_____10_CM 4 0. 8160. DISPLAY_IDENTIFIER LDPM_N_TOOTH__EOI_ST FORMAT "%4.0" /end AXIS_PTS
/begin AXIS_PTS ldpm_tco__eoi_tco "" 0xffe48624 tco _REC_AXS_20_u1 19.05 _CNV_A_R_LINEAR_____11_CM 8 -48. 142.5 DISPLAY_IDENTIFIER LDPM_TCO__EOI_TCO FORMAT "%5.1" /end AXIS_PTS
/begin CHARACTERISTIC ip_eoi_h_prs_cst "Basic map end of injection at high pressure cold start" MAP 0xffe4ad8a _REC_MAP_20_u2_u1_u2 720. _CNV_A_R_LINEAR_____82_CM 0. 720. DISPLAY_IDENTIFIER IP_EOI_H_PRS_CST FORMAT "%6.2"
 /begin AXIS_DESCR COM_AXIS tco _CNV_A_R_LINEAR_____11_CM 8 -48. 142.5 FORMAT "%5.1" AXIS_PTS_REF ldpm_tco__eoi_tco /end AXIS_DESCR
 /begin AXIS_DESCR COM_AXIS n_tooth _CNV_A_R_LINEAR_____10_CM 4 0. 8160. FORMAT "%4.0" AXIS_PTS_REF ldpm_n_tooth__eoi_st /end AXIS_DESCR
/end CHARACTERISTIC
/begin CHARACTERISTIC ip_eoi_l_prs_cst "Basic map end of injection at low pressure cold start" MAP 0xffe4adca _REC_MAP_20_u2_u1_u2 720. _CNV_A_R_LINEAR_____82_CM 0. 720. DISPLAY_IDENTIFIER IP_EOI_L_PRS_CST FORMAT "%6.2"
 /begin AXIS_DESCR COM_AXIS tco _CNV_A_R_LINEAR_____11_CM 8 -48. 142.5 FORMAT "%5.1" AXIS_PTS_REF ldpm_tco__eoi_tco /end AXIS_DESCR
 /begin AXIS_DESCR COM_AXIS n_tooth _CNV_A_R_LINEAR_____10_CM 4 0. 8160. FORMAT "%4.0" AXIS_PTS_REF ldpm_n_tooth__eoi_st /end AXIS_DESCR
/end CHARACTERISTIC
/begin MEASUREMENT inh_iv_amt "Shut off sequence of AMT transmission" UBYTE _CNV_A_R_LINEAR_____0_CM 1 100. 0. 255. DISPLAY_IDENTIFIER INH_IV_AMT ECU_ADDRESS 0x3fe9f6 FORMAT "%3.0" /end MEASUREMENT
/begin MEASUREMENT ti_hom_2 "fuel injection time for homogeneous mode" UWORD _CNV_A_R_LINEAR_____165_CM 1 100. 0. 262.14 DISPLAY_IDENTIFIER TI_HOM_2 ECU_ADDRESS 0x3fd932 BYTE_ORDER MSB_LAST FORMAT "%7.3" /end MEASUREMENT
/begin CHARACTERISTIC c_ti_hom_man "manual setpoint for injection time in homogeneous mode" VALUE 0xffe41a7e _REC_VAL_20_u2 262.14 _CNV_A_R_LINEAR_____165_CM 0. 262.14 DISPLAY_IDENTIFIER C_TI_HOM_MAN FORMAT "%7.3" /end CHARACTERISTIC
/begin CHARACTERISTIC lc_ti_hom_man_act "switch for manual setpoint for injection time in homogeneous mode" VALUE 0xffe40fe4 _REC_VAL_20_u1 1. _CNV_S_2_RANGE______21_CM 0. 1. DISPLAY_IDENTIFIER LC_TI_HOM_MAN_ACT /end CHARACTERISTIC
/begin MEASUREMENT ti_hom_1 "fuel injection time for homogeneous mode" UWORD _CNV_A_R_LINEAR_____165_CM 1 100. 0. 262.14 DISPLAY_IDENTIFIER TI_HOM_1 ECU_ADDRESS 0x3fd930 BYTE_ORDER MSB_LAST FORMAT "%7.3" /end MEASUREMENT
/begin MEASUREMENT lv_ti_lim_min "boolean variable for injection time limitation" UBYTE _CNV_S_2_RANGE______2_CM 1 100. 0. 1. DISPLAY_IDENTIFIER LV_TI_LIM_MIN ECU_ADDRESS 0x3fe897 /end MEASUREMENT
/begin MEASUREMENT fac_ti_prs[0] "factor  for correction of fuel injection time due to a change of pressure decrease at the injector" UWORD _CNV_A_R_LINEAR_____491_CM 1 100. 0. 15.99975586 DISPLAY_IDENTIFIER FAC_TI_PRS_1 ECU_ADDRESS 0x3fd934 BYTE_ORDER MSB_LAST /end MEASUREMENT
/begin MEASUREMENT fac_ti_prs[1] "factor  for correction of fuel injection time due to a change of pressure decrease at the injector" UWORD _CNV_A_R_LINEAR_____491_CM 1 100. 0. 15.99975586 DISPLAY_IDENTIFIER FAC_TI_PRS_2 ECU_ADDRESS 0x3fd936 BYTE_ORDER MSB_LAST /end MEASUREMENT
/begin MEASUREMENT prs_inj_mv[0] "mean cylinder pressure during injection " UWORD _CNV_A_R_LINEAR_____199_CM 1 100. 0. 173888. DISPLAY_IDENTIFIER PRS_INJ_MV_1 ECU_ADDRESS 0x3fd938 BYTE_ORDER MSB_LAST FORMAT "%6.0" /end MEASUREMENT
/begin MEASUREMENT prs_inj_mv[1] "mean cylinder pressure during injection " UWORD _CNV_A_R_LINEAR_____199_CM 1 100. 0. 173888. DISPLAY_IDENTIFIER PRS_INJ_MV_2 ECU_ADDRESS 0x3fd93a BYTE_ORDER MSB_LAST FORMAT "%6.0" /end MEASUREMENT
/begin MEASUREMENT prs_dec_inj[0] "pressure decrease at the injector " UWORD _CNV_A_R_LINEAR_____199_CM 1 100. 0. 173888. DISPLAY_IDENTIFIER PRS_DEC_INJ_1 ECU_ADDRESS 0x3fd940 BYTE_ORDER MSB_LAST FORMAT "%6.0" /end MEASUREMENT
/begin MEASUREMENT prs_dec_inj[1] "pressure decrease at the injector " UWORD _CNV_A_R_LINEAR_____199_CM 1 100. 0. 173888. DISPLAY_IDENTIFIER PRS_DEC_INJ_2 ECU_ADDRESS 0x3fd942 BYTE_ORDER MSB_LAST FORMAT "%6.0" /end MEASUREMENT
/begin MEASUREMENT ti_stnd_hom[0] "fuel injection time without fuel pressure correction for homogeneous mode" UWORD _CNV_A_R_LINEAR_____165_CM 1 100. 0. 262.14 DISPLAY_IDENTIFIER TI_STND_HOM_1 ECU_ADDRESS 0x3fd944 BYTE_ORDER MSB_LAST FORMAT "%7.3" /end MEASUREMENT
/begin MEASUREMENT ti_stnd_hom[1] "fuel injection time without fuel pressure correction for homogeneous mode" UWORD _CNV_A_R_LINEAR_____165_CM 1 100. 0. 262.14 DISPLAY_IDENTIFIER TI_STND_HOM_2 ECU_ADDRESS 0x3fd946 BYTE_ORDER MSB_LAST FORMAT "%7.3" /end MEASUREMENT
/begin MEASUREMENT ti_hom_clc[0] "calculated fuel injection time for homogeneous mode" UWORD _CNV_A_R_LINEAR_____165_CM 1 100. 0. 262.14 DISPLAY_IDENTIFIER TI_HOM_CLC_1 ECU_ADDRESS 0x3fd948 BYTE_ORDER MSB_LAST FORMAT "%7.3" /end MEASUREMENT
/begin MEASUREMENT ti_hom_clc[1] "calculated fuel injection time for homogeneous mode" UWORD _CNV_A_R_LINEAR_____165_CM 1 100. 0. 262.14 DISPLAY_IDENTIFIER TI_HOM_CLC_2 ECU_ADDRESS 0x3fd94a BYTE_ORDER MSB_LAST FORMAT "%7.3" /end MEASUREMENT
/begin MEASUREMENT crk_inj[0] "rough value for injection angle (EOI-SOI) " UWORD _CNV_A_R_LINEAR_____82_CM 1 100. 0. 600. DISPLAY_IDENTIFIER CRK_INJ_1 ECU_ADDRESS 0x3fd93c BYTE_ORDER MSB_LAST FORMAT "%5.1" /end MEASUREMENT
/begin MEASUREMENT crk_inj[1] "rough value for injection angle (EOI-SOI) " UWORD _CNV_A_R_LINEAR_____82_CM 1 100. 0. 600. DISPLAY_IDENTIFIER CRK_INJ_2 ECU_ADDRESS 0x3fd93e BYTE_ORDER MSB_LAST FORMAT "%5.1" /end MEASUREMENT
/begin MEASUREMENT ti_st_amp "Injection correction at start upon AMP " UBYTE _CNV_A_R_LINEAR_____39_CM 1 100. 0. 1.99220002 DISPLAY_IDENTIFIER TI_ST_AMP ECU_ADDRESS 0x3fe894 FORMAT "%5.3" /end MEASUREMENT
/begin CHARACTERISTIC ip_ti_st_amp_fac__amp "Cranking injection time correction upon ambient pressure" CURVE 0xffe40e87 _REC_CUR_20_u1_u2 9.9610001e-002 _CNV_A_R_LINEAR_____39_CM 0. 1.99220002 DISPLAY_IDENTIFIER IP_TI_ST_AMP_FAC__AMP FORMAT "%5.3"
 /begin AXIS_DESCR COM_AXIS amp_mes _CNV_A_R_LINEAR_____49_CM 6 0. 5434. FORMAT "%7.2" AXIS_PTS_REF ldp_amp_mes_ti_st_amp_fac /end AXIS_DESCR
/end CHARACTERISTIC
/begin AXIS_PTS ldp_amp_mes_ti_st_amp_fac "" 0xffe509ec amp_mes _REC_AXS_20_u2 5434. _CNV_A_R_LINEAR_____49_CM 6 0. 5434. DISPLAY_IDENTIFIER LDP_AMP_MES_TI_ST_AMP_FAC FORMAT "%7.2" /end AXIS_PTS
/begin MEASUREMENT ti_cast "Cold post start injection time correction" UWORD _CNV_A_R_LINEAR_____127_CM 1 100. 0. 4. DISPLAY_IDENTIFIER TI_CAST ECU_ADDRESS 0x3fd9ac BYTE_ORDER MSB_LAST FORMAT "%6.4" /end MEASUREMENT
/begin CHARACTERISTIC ip_mff_lgrd_ast "Injection time change limitation after Start" CURVE 0xffe4d45a _REC_CUR_20_u2_u1 1389. _CNV_A_R_LINEAR_____108_CM 0. 1389. DISPLAY_IDENTIFIER IP_MFF_LGRD_AST FORMAT "%7.2"
 /begin AXIS_DESCR COM_AXIS tco _CNV_A_R_LINEAR_____11_CM 8 -48. 142.5 FORMAT "%5.1" AXIS_PTS_REF ldp_tco__mff_lgrd_ast /end AXIS_DESCR
/end CHARACTERISTIC
/begin CHARACTERISTIC ip_ti_deac_cast__cyc_cast__tco "Deactivation factor of post start enrichment" MAP 0xffe47abf _REC_MAP_20_u1_u2_u1 9.960940000000002e-002 _CNV_A_R_LINEAR_____50_CM 0. 0.996094 DISPLAY_IDENTIFIER IP_TI_DEAC_CAST__CYC_CAST__TCO FORMAT "%5.3"
 /begin AXIS_DESCR COM_AXIS cyc_cast _CNV_A_R_LINEAR_____0_CM 8 0. 65535. FORMAT "%5.0" AXIS_PTS_REF ldp_cyc_cast_ip_ti_deac_cast /end AXIS_DESCR
 /begin AXIS_DESCR COM_AXIS tco _CNV_A_R_LINEAR_____11_CM 10 -48. 142.5 FORMAT "%5.1" AXIS_PTS_REF ldpm_tco__mff_deac_cst /end AXIS_DESCR
/end CHARACTERISTIC
/begin MEASUREMENT lv_ast_end "logical bit for \"After-start end\"" UBYTE _CNV_S_2_RANGE______2_CM 1 100. 0. 1. DISPLAY_IDENTIFIER LV_AST_END ECU_ADDRESS 0x3fe8b2 BIT_MASK 0x1 /end MEASUREMENT
/begin AXIS_PTS ldp_tco__mff_lgrd_ast "" 0xffe481dd tco _REC_AXS_20_u1 190.5 _CNV_A_R_LINEAR_____11_CM 8 -48. 142.5 DISPLAY_IDENTIFIER LDP_TCO__MFF_LGRD_AST FORMAT "%5.1" /end AXIS_PTS
/begin AXIS_PTS ldp_cyc_cast_ip_ti_deac_cast "" 0xffe50ae6 cyc_cast _REC_AXS_20_u2 65535. _CNV_A_R_LINEAR_____0_CM 8 0. 65535. DISPLAY_IDENTIFIER LDP_CYC_CAST_IP_TI_DEAC_CAST FORMAT "%5.0" /end AXIS_PTS
/begin AXIS_PTS ldp_tia_ip_ti_cast "" 0xffe412a1 tia _REC_AXS_20_u1 28.575 _CNV_A_R_LINEAR_____11_CM 2 -48. 142.5 DISPLAY_IDENTIFIER LDP_TIA_IP_TI_CAST FORMAT "%5.1" /end AXIS_PTS
/begin AXIS_PTS ldp_fac_cor_ti_cast "" 0xffe41023 online_dummy _REC_AXS_20_u1 0.298830003 _CNV_A_R_LINEAR_____39_CM 4 0. 1.99220002 DISPLAY_IDENTIFIER LDP_FAC_COR_TI_CAST FORMAT "%5.3" /end AXIS_PTS
/begin AXIS_PTS ldp_map__ti_cast_fac_map "" 0xffe50ee0 map _REC_AXS_20_u2 815.1 _CNV_A_R_LINEAR_____49_CM 6 0. 5434. DISPLAY_IDENTIFIER LDP_MAP__TI_CAST_FAC_MAP FORMAT "%7.2" /end AXIS_PTS
/begin CHARACTERISTIC ip_ti_cast__tia__tco "Initialization value of post start enrichment factor" MAP 0xffe47a83 _REC_MAP_20_u1_u1_u1 0.3984375 _CNV_A_R_LINEAR_____129_CM 0. 3.984375 DISPLAY_IDENTIFIER IP_TI_CAST__TIA__TCO FORMAT "%4.2"
 /begin AXIS_DESCR COM_AXIS tia _CNV_A_R_LINEAR_____11_CM 2 -48. 142.5 FORMAT "%5.1" AXIS_PTS_REF ldp_tia_ip_ti_cast /end AXIS_DESCR
 /begin AXIS_DESCR COM_AXIS tco _CNV_A_R_LINEAR_____11_CM 10 -48. 142.5 FORMAT "%5.1" AXIS_PTS_REF ldpm_tco__mff_deac_cst /end AXIS_DESCR
/end CHARACTERISTIC
/begin AXIS_PTS ldpm_tco__mff_deac_cst "" 0xffe48648 tco _REC_AXS_20_u1 19.05 _CNV_A_R_LINEAR_____11_CM 10 -48. 142.5 DISPLAY_IDENTIFIER LDPM_TCO__MFF_DEAC_CST FORMAT "%5.1" /end AXIS_PTS
/begin CHARACTERISTIC ip_ti_cast_fac_tco "" MAP 0xffe47a97 _REC_MAP_20_u1_u1_u1 0.199220002 _CNV_A_R_LINEAR_____39_CM 0. 1.99220002 DISPLAY_IDENTIFIER IP_TI_CAST_FAC_TCO FORMAT "%5.3"
 /begin AXIS_DESCR COM_AXIS online_dummy _CNV_A_R_LINEAR_____39_CM 4 0. 1.99220002 FORMAT "%5.3" AXIS_PTS_REF ldp_fac_cor_ti_cast /end AXIS_DESCR
 /begin AXIS_DESCR COM_AXIS tco _CNV_A_R_LINEAR_____11_CM 10 -48. 142.5 FORMAT "%5.1" AXIS_PTS_REF ldpm_tco__mff_deac_cst /end AXIS_DESCR
/end CHARACTERISTIC
/begin CHARACTERISTIC ip_ti_cast_fac_map "" CURVE 0xffe40e7e _REC_CUR_20_u1_u2 9.960940000000002e-002 _CNV_A_R_LINEAR_____50_CM 0. 0.996094 DISPLAY_IDENTIFIER IP_TI_CAST_FAC_MAP FORMAT "%5.3"
 /begin AXIS_DESCR COM_AXIS map _CNV_A_R_LINEAR_____49_CM 6 0. 5434. FORMAT "%7.2" AXIS_PTS_REF ldp_map__ti_cast_fac_map /end AXIS_DESCR
/end CHARACTERISTIC
/begin MEASUREMENT mff_sp "Mass fuel flow setpoint after combustion selection" UWORD _CNV_A_R_LINEAR_____108_CM 1 100. 0. 1389. DISPLAY_IDENTIFIER MFF_SP ECU_ADDRESS 0x3fd9b4 BYTE_ORDER MSB_LAST FORMAT "%7.2" /end MEASUREMENT
/begin MEASUREMENT ti_add_dly "Injector dead time correction" SWORD _CNV_A_R_LINEAR_____165_CM 1 100. -131.072 131.068 DISPLAY_IDENTIFIER TI_ADD_DLY ECU_ADDRESS 0x3fd9b6 BYTE_ORDER MSB_LAST FORMAT "%8.3" /end MEASUREMENT
/begin CHARACTERISTIC ip_ti_add_dly "Injector dead time correction" MAP 0xffe4f3ae _REC_MAP_20_u2_u1_u2 26.214 _CNV_A_R_LINEAR_____360_CM -131.072 131.068 DISPLAY_IDENTIFIER IP_TI_ADD_DLY FORMAT "%6.2"
 /begin AXIS_DESCR COM_AXIS vb _CNV_A_R_LINEAR_____34_CM 8 0. 25.8984 FORMAT "%3.1" AXIS_PTS_REF ldp_vb__ti_add_dly /end AXIS_DESCR
 /begin AXIS_DESCR COM_AXIS fup _CNV_A_R_LINEAR_____199_CM 6 0. 173888. FORMAT "%6.0" AXIS_PTS_REF ldp_fup_map_dif__ti_add_dly /end AXIS_DESCR
/end CHARACTERISTIC
/begin AXIS_PTS ldp_vb__ti_add_dly "" 0xffe4831a vb _REC_AXS_20_u1 3.107808 _CNV_A_R_LINEAR_____34_CM 8 0. 25.8984 DISPLAY_IDENTIFIER LDP_VB__TI_ADD_DLY FORMAT "%3.1" /end AXIS_PTS
/begin AXIS_PTS ldp_fup_map_dif__ti_add_dly "Injector dead time correction" 0xffe50bde fup _REC_AXS_20_u2 17388.8 _CNV_A_R_LINEAR_____199_CM 6 0. 173888. DISPLAY_IDENTIFIER LDP_FUP_MAP_DIF__TI_ADD_DLY FORMAT "%6.0" /end AXIS_PTS
/begin MEASUREMENT tib "Basic injection time - equivalent to MFF_BAS (interface to wall film compensation function)" UWORD _CNV_A_R_LINEAR_____165_CM 1 100. 0. 262.14 DISPLAY_IDENTIFIER TIB ECU_ADDRESS 0x3fd9c6 BYTE_ORDER MSB_LAST FORMAT "%7.3" /end MEASUREMENT
/begin MEASUREMENT mff_add_wf "Fuel mass flow for wall film compensation - equivalent to TI_ADD_WF (interface to total injection formula)" SWORD _CNV_A_R_LINEAR_____257_CM 1 100. -694.5 694.478806 DISPLAY_IDENTIFIER MFF_ADD_WF ECU_ADDRESS 0x3fd9c4 BYTE_ORDER MSB_LAST FORMAT "%7.2" /end MEASUREMENT
/begin MEASUREMENT ti_add_reac[0] "Reactivation fuel feed injection time correction" UWORD _CNV_A_R_LINEAR_____165_CM 1 100. 0. 262.14 DISPLAY_IDENTIFIER TI_ADD_REAC_0 ECU_ADDRESS 0x3fd9b8 BYTE_ORDER MSB_LAST FORMAT "%7.3" /end MEASUREMENT
/begin MEASUREMENT ti_add_reac[1] "Reactivation fuel feed injection time correction" UWORD _CNV_A_R_LINEAR_____165_CM 1 100. 0. 262.14 DISPLAY_IDENTIFIER TI_ADD_REAC_1 ECU_ADDRESS 0x3fd9ba BYTE_ORDER MSB_LAST FORMAT "%7.3" /end MEASUREMENT
/begin MEASUREMENT ti_add_reac[2] "Reactivation fuel feed injection time correction" UWORD _CNV_A_R_LINEAR_____165_CM 1 100. 0. 262.14 DISPLAY_IDENTIFIER TI_ADD_REAC_2 ECU_ADDRESS 0x3fd9bc BYTE_ORDER MSB_LAST FORMAT "%7.3" /end MEASUREMENT
/begin MEASUREMENT ti_add_reac[3] "Reactivation fuel feed injection time correction" UWORD _CNV_A_R_LINEAR_____165_CM 1 100. 0. 262.14 DISPLAY_IDENTIFIER TI_ADD_REAC_3 ECU_ADDRESS 0x3fd9be BYTE_ORDER MSB_LAST FORMAT "%7.3" /end MEASUREMENT
/begin MEASUREMENT ti_add_reac[4] "Reactivation fuel feed injection time correction" UWORD _CNV_A_R_LINEAR_____165_CM 1 100. 0. 262.14 DISPLAY_IDENTIFIER TI_ADD_REAC_4 ECU_ADDRESS 0x3fd9c0 BYTE_ORDER MSB_LAST FORMAT "%7.3" /end MEASUREMENT
/begin MEASUREMENT ti_add_reac[5] "Reactivation fuel feed injection time correction" UWORD _CNV_A_R_LINEAR_____165_CM 1 100. 0. 262.14 DISPLAY_IDENTIFIER TI_ADD_REAC_5 ECU_ADDRESS 0x3fd9c2 BYTE_ORDER MSB_LAST FORMAT "%7.3" /end MEASUREMENT
/begin CHARACTERISTIC c_eoi_lim "Latest possible EOI" VALUE 0xffe415e4 _REC_VAL_20_u2 720. _CNV_A_R_LINEAR_____82_CM 0. 720. DISPLAY_IDENTIFIER C_EOI_LIM FORMAT "%6.2" /end CHARACTERISTIC
/begin MEASUREMENT soi_hom "start of injection for homogeneous combustion mode" UWORD _CNV_A_R_LINEAR_____82_CM 1 100. 0. 720. DISPLAY_IDENTIFIER SOI_HOM ECU_ADDRESS 0x3fd9c8 BYTE_ORDER MSB_LAST FORMAT "%6.2" /end MEASUREMENT
/begin MEASUREMENT eoi_hom_clc "calculated end of injection for homogeneous combustion mode" UWORD _CNV_A_R_LINEAR_____82_CM 1 100. 0. 720. DISPLAY_IDENTIFIER EOI_HOM_CLC ECU_ADDRESS 0x3fd9e8 BYTE_ORDER MSB_LAST FORMAT "%6.2" /end MEASUREMENT
/begin MEASUREMENT eoi_tco "Temperature correction for end of injection" UWORD _CNV_A_R_LINEAR_____82_CM 1 100. 0. 720. DISPLAY_IDENTIFIER EOI_TCO ECU_ADDRESS 0x3fd9ea BYTE_ORDER MSB_LAST FORMAT "%6.2" /end MEASUREMENT
/begin MEASUREMENT ti_hom_max_cst "Maximum injection time to fulfill required C_SOI_MIN_CST_H_PRS / C_SOI_MIN_CST_L_PRS" UWORD _CNV_A_R_LINEAR_____165_CM 1 100. 0. 262.14 DISPLAY_IDENTIFIER TI_HOM_MAX_CST ECU_ADDRESS 0x3fd9ca BYTE_ORDER MSB_LAST FORMAT "%7.3" /end MEASUREMENT
/begin CHARACTERISTIC lc_eoi_hom_man "switch for using the manual setpoint for EOI" VALUE 0xffe40f61 _REC_VAL_20_u1 1. _CNV_S_2_RANGE______21_CM 0. 1. DISPLAY_IDENTIFIER LC_EOI_HOM_MAN /end CHARACTERISTIC
/begin CHARACTERISTIC c_eoi_hom_man "manual setpoint for EOI" VALUE 0xffe415e2 _REC_VAL_20_u2 720. _CNV_A_R_LINEAR_____82_CM 0. 720. DISPLAY_IDENTIFIER C_EOI_HOM_MAN FORMAT "%6.2" /end CHARACTERISTIC
/begin CHARACTERISTIC c_soi_min_cst_l_prs "minimum start of injection angle during low pressure start" VALUE 0xffe418b2 _REC_VAL_20_u2 720. _CNV_A_R_LINEAR_____82_CM 0. 720. DISPLAY_IDENTIFIER C_SOI_MIN_CST_L_PRS FORMAT "%6.2" /end CHARACTERISTIC
/begin CHARACTERISTIC c_soi_min_cst_h_prs "minimum start of injection angle during high pressure start" VALUE 0xffe418b0 _REC_VAL_20_u2 720. _CNV_A_R_LINEAR_____82_CM 0. 720. DISPLAY_IDENTIFIER C_SOI_MIN_CST_H_PRS FORMAT "%6.2" /end CHARACTERISTIC
/begin CHARACTERISTIC ip_eoi_tco "Coolant temperature correction EOI" CURVE 0xffe4ae1a _REC_CUR_20_u2_u1 720. _CNV_A_R_LINEAR_____82_CM 0. 720. DISPLAY_IDENTIFIER IP_EOI_TCO FORMAT "%6.2"
 /begin AXIS_DESCR COM_AXIS tco _CNV_A_R_LINEAR_____11_CM 8 -48. 142.5 FORMAT "%5.1" AXIS_PTS_REF ldpm_tco__eoi_tco /end AXIS_DESCR
/end CHARACTERISTIC
/begin MEASUREMENT eoi_bas "Basic map end of injection versus engine speed and injection time" UWORD _CNV_A_R_LINEAR_____82_CM 1 100. 0. 720. DISPLAY_IDENTIFIER EOI_BAS ECU_ADDRESS 0x3fd9e6 BYTE_ORDER MSB_LAST FORMAT "%6.2" /end MEASUREMENT
/begin CHARACTERISTIC c_eoi_as "EOI-correction of application system" VALUE 0xffe40400 _REC_VAL_20_s2 1440. _CNV_A_R_LINEAR_____82_CM -720. 720. DISPLAY_IDENTIFIER C_EOI_AS FORMAT "%6.1" /end CHARACTERISTIC
/begin CHARACTERISTIC lc_eoi_cor_ivvt_vvl "switch to activate (1) or deactivate (0) the EOI-correction for inlet-CWM-position and variable valve lift" VALUE 0xffe40f60 _REC_VAL_20_u1 1. _CNV_A_R_LINEAR_____0_CM 0. 1. DISPLAY_IDENTIFIER LC_EOI_COR_IVVT_VVL FORMAT "%2.0" /end CHARACTERISTIC
/begin CHARACTERISTIC ip_cam_op_in_vvl__vlft_av "inlet valve opening angle vs. actual inlet valve lift" CURVE 0xffe49090 _REC_CUR_20_u2_u2 1535.9765625 _CNV_A_R_LINEAR_____396_CM -768. 767.9765625 DISPLAY_IDENTIFIER IP_CAM_OP_IN_VVL__VLFT_AV FORMAT "%7.2"
 /begin AXIS_DESCR COM_AXIS online_dummy _CNV_A_R_LINEAR_____494_CM 6 0. 65.535 AXIS_PTS_REF ldp_vlft_av__cam_op_in_vvl /end AXIS_DESCR
/end CHARACTERISTIC
/begin MEASUREMENT eoi_lim "latest possible EOI" UWORD _CNV_A_R_LINEAR_____82_CM 1 100. 0. 720. DISPLAY_IDENTIFIER EOI_LIM ECU_ADDRESS 0x3fd9cc BYTE_ORDER MSB_LAST FORMAT "%6.2" /end MEASUREMENT
/begin MEASUREMENT cam_op_in_vvl "actual value inlet valve opening angle" SWORD _CNV_A_R_LINEAR_____228_CM 1 100. -768. 767.9765625 DISPLAY_IDENTIFIER CAM_OP_IN_VVL ECU_ADDRESS 0x3fd9ee BYTE_ORDER MSB_LAST FORMAT "%7.2" /end MEASUREMENT
/begin MEASUREMENT eoi_ivvt_vvl "Correction for inlet-CAM-position and inlet valve opening angle" UWORD _CNV_A_R_LINEAR_____82_CM 1 100. 0. 720. DISPLAY_IDENTIFIER EOI_IVVT_VVL ECU_ADDRESS 0x3fd9f0 BYTE_ORDER MSB_LAST FORMAT "%6.2" /end MEASUREMENT
/begin AXIS_PTS ldp_vlft_av__cam_op_in_vvl "" 0xffe51650 online_dummy _REC_AXS_20_u2 65.535 _CNV_A_R_LINEAR_____494_CM 6 0. 65.535 DISPLAY_IDENTIFIER LDP_VLFT_AV__CAM_OP_IN_VVL /end AXIS_PTS
/begin CHARACTERISTIC ip_eoi_bas "Basic map end of injection" MAP 0xffe4ac52 _REC_MAP_20_u2_u1_u2 720. _CNV_A_R_LINEAR_____82_CM 0. 720. DISPLAY_IDENTIFIER IP_EOI_BAS FORMAT "%6.2"
 /begin AXIS_DESCR COM_AXIS n_32 _CNV_A_R_LINEAR_____15_CM 12 0. 8160. FORMAT "%4.0" AXIS_PTS_REF ldp_n_32__eoi_bas /end AXIS_DESCR
 /begin AXIS_DESCR COM_AXIS ti_hom_1 _CNV_A_R_LINEAR_____165_CM 10 0. 262.14 FORMAT "%7.3" AXIS_PTS_REF ldp_ti_hom__eoi_bas /end AXIS_DESCR
/end CHARACTERISTIC
/begin CHARACTERISTIC ip_eoi_bas_is "Basic map end of injection" MAP 0xffe4ad42 _REC_MAP_20_u2_u1_u2 720. _CNV_A_R_LINEAR_____82_CM 0. 720. DISPLAY_IDENTIFIER IP_EOI_BAS_IS FORMAT "%6.2"
 /begin AXIS_DESCR COM_AXIS n_32 _CNV_A_R_LINEAR_____15_CM 6 0. 8160. FORMAT "%4.0" AXIS_PTS_REF ldp_n_32__eoi_bas_is /end AXIS_DESCR
 /begin AXIS_DESCR COM_AXIS ti_hom_1 _CNV_A_R_LINEAR_____165_CM 6 0. 262.14 FORMAT "%7.3" AXIS_PTS_REF ldp_ti_hom__eoi_bas_is /end AXIS_DESCR
/end CHARACTERISTIC
/begin AXIS_PTS ldp_n_32__eoi_bas "" 0xffe47fee n_32 _REC_AXS_20_u1 816. _CNV_A_R_LINEAR_____15_CM 12 0. 8160. DISPLAY_IDENTIFIER LDP_N_32__EOI_BAS FORMAT "%4.0" /end AXIS_PTS
/begin AXIS_PTS ldp_n_32__eoi_bas_is "" 0xffe4108b n_32 _REC_AXS_20_u1 816. _CNV_A_R_LINEAR_____15_CM 6 0. 8160. DISPLAY_IDENTIFIER LDP_N_32__EOI_BAS_IS FORMAT "%4.0" /end AXIS_PTS
/begin AXIS_PTS ldp_ti_hom__eoi_bas "" 0xffe51364 ti_hom_1 _REC_AXS_20_u2 26.214 _CNV_A_R_LINEAR_____165_CM 10 0. 262.14 DISPLAY_IDENTIFIER LDP_TI_HOM__EOI_BAS FORMAT "%7.3" /end AXIS_PTS
/begin AXIS_PTS ldp_ti_hom__eoi_bas_is "" 0xffe5137a ti_hom_1 _REC_AXS_20_u2 26.214 _CNV_A_R_LINEAR_____165_CM 6 0. 262.14 DISPLAY_IDENTIFIER LDP_TI_HOM__EOI_BAS_IS FORMAT "%7.3" /end AXIS_PTS
/begin CHARACTERISTIC ip_ti_wup__n__maf "TI warm up correction" MAP 0xffe47dcb _REC_MAP_20_u1_u1_u1 0.1494141 _CNV_A_R_LINEAR_____50_CM 0. 0.996094 DISPLAY_IDENTIFIER IP_TI_WUP__N__MAF FORMAT "%5.3"
 /begin AXIS_DESCR COM_AXIS maf _CNV_A_R_LINEAR_____27_CM 8 0. 1389. FORMAT "%4.0" AXIS_PTS_REF ldpm_maf_hb__ti_wup /end AXIS_DESCR
 /begin AXIS_DESCR COM_AXIS n_32 _CNV_A_R_LINEAR_____15_CM 8 0. 8160. FORMAT "%4.0" AXIS_PTS_REF ldpm_n_32__ti_wup /end AXIS_DESCR
/end CHARACTERISTIC
/begin MEASUREMENT ti_wup_1 "Warm-up enrichment part, intermediate value" UWORD _CNV_A_R_LINEAR_____127_CM 1 100. 0. 4. DISPLAY_IDENTIFIER TI_WUP_1 ECU_ADDRESS 0x3fda14 BYTE_ORDER MSB_LAST FORMAT "%6.4" /end MEASUREMENT
/begin MEASUREMENT ti_wup "Warm-up injection time correction" UWORD _CNV_A_R_LINEAR_____127_CM 1 100. 0. 4. DISPLAY_IDENTIFIER TI_WUP ECU_ADDRESS 0x3fda12 BYTE_ORDER MSB_LAST FORMAT "%6.4" /end MEASUREMENT
/begin MEASUREMENT ti_temp "Warm-up enrichment part, intermediate, permanent part" UWORD _CNV_A_R_LINEAR_____127_CM 1 100. 0. 4. DISPLAY_IDENTIFIER TI_TEMP ECU_ADDRESS 0x3fda16 BYTE_ORDER MSB_LAST FORMAT "%6.4" /end MEASUREMENT
/begin CHARACTERISTIC ip_ti_tco_wup__tco__tco_st "TCO/TCO_ST-dependent warm up correction" MAP 0xffe47d73 _REC_MAP_20_u1_u1_u1 0.199220002 _CNV_A_R_LINEAR_____39_CM 0. 1.99220002 DISPLAY_IDENTIFIER IP_TI_TCO_WUP__TCO__TCO_ST FORMAT "%5.3"
 /begin AXIS_DESCR COM_AXIS tco_st _CNV_A_R_LINEAR_____11_CM 3 -48. 142.5 FORMAT "%5.1" AXIS_PTS_REF ldp_tco_st__ti_tco_wup /end AXIS_DESCR
 /begin AXIS_DESCR COM_AXIS tco _CNV_A_R_LINEAR_____11_CM 8 -48. 142.5 FORMAT "%5.1" AXIS_PTS_REF ldpm_tco__ti_wup /end AXIS_DESCR
/end CHARACTERISTIC
/begin CHARACTERISTIC ip_ti_vo_wup__tco__vo "TCO/VO dependent warm up correction" MAP 0xffe47d8b _REC_MAP_20_u1_u1_u1 0.1 _CNV_A_R_LINEAR_____117_CM 0.5 1.5 DISPLAY_IDENTIFIER IP_TI_VO_WUP__TCO__VO FORMAT "%5.3"
 /begin AXIS_DESCR COM_AXIS vo _CNV_A_R_LINEAR_____82_CM 8 0. 95.625 FORMAT "%5.2" AXIS_PTS_REF ldp_vo__ti_vo_wup /end AXIS_DESCR
 /begin AXIS_DESCR COM_AXIS tco _CNV_A_R_LINEAR_____11_CM 8 -48. 142.5 FORMAT "%5.1" AXIS_PTS_REF ldpm_tco__ti_wup /end AXIS_DESCR
/end CHARACTERISTIC
/begin CHARACTERISTIC ip_ti_fac_n_map "Injection time weighting for temperature influence f(operating point)" MAP 0xffe47b0f _REC_MAP_20_u1_u2_u1 9.9610001e-002 _CNV_A_R_LINEAR_____29_CM 0. 0.99610001 DISPLAY_IDENTIFIER IP_TI_FAC_N_MAP FORMAT "%5.3"
 /begin AXIS_DESCR COM_AXIS map _CNV_A_R_LINEAR_____49_CM 8 0. 5434. FORMAT "%7.2" AXIS_PTS_REF ldp_map__ti_fac_n_map /end AXIS_DESCR
 /begin AXIS_DESCR COM_AXIS n_32 _CNV_A_R_LINEAR_____15_CM 8 0. 8160. FORMAT "%4.0" AXIS_PTS_REF ldp_n_32__ti_fac_n_map /end AXIS_DESCR
/end CHARACTERISTIC
/begin CHARACTERISTIC ip_ti_fac_tia_toil "Injection time weighting for temperature influence f(TIA, TOIL)" MAP 0xffe47c4f _REC_MAP_20_u1_u1_u1 0.199220002 _CNV_A_R_LINEAR_____39_CM 0. 1.99220002 DISPLAY_IDENTIFIER IP_TI_FAC_TIA_TOIL FORMAT "%5.3"
 /begin AXIS_DESCR COM_AXIS tia _CNV_A_R_LINEAR_____11_CM 6 -48. 142.5 FORMAT "%5.1" AXIS_PTS_REF ldp_tia_ti_fac_tia_toil /end AXIS_DESCR
 /begin AXIS_DESCR COM_AXIS toil _CNV_A_R_LINEAR_____14_CM 6 -40. 160. FORMAT "%3.0" AXIS_PTS_REF ldp_toil_ti_fac_tia_toil /end AXIS_DESCR
/end CHARACTERISTIC
/begin CHARACTERISTIC ip_ti_fac_tco "Injection time weighting for temperature influence f(coolant temperature)" CURVE 0xffe40e84 _REC_CUR_20_u1_u1 9.9610001e-002 _CNV_A_R_LINEAR_____29_CM 0. 0.99610001 DISPLAY_IDENTIFIER IP_TI_FAC_TCO FORMAT "%5.3"
 /begin AXIS_DESCR COM_AXIS tco _CNV_A_R_LINEAR_____11_CM 3 -48. 142.5 FORMAT "%5.1" AXIS_PTS_REF ldp_tco__ti_fac_tco /end AXIS_DESCR
/end CHARACTERISTIC
/begin AXIS_PTS ldpm_maf_hb__ti_wup "" 0xffe48402 maf _REC_AXS_20_u1 1389. _CNV_A_R_LINEAR_____27_CM 8 0. 1389. DISPLAY_IDENTIFIER LDPM_MAF_HB__TI_WUP FORMAT "%4.0" /end AXIS_PTS
/begin AXIS_PTS ldpm_tco__ti_wup "" 0xffe48665 tco _REC_AXS_20_u1 190.5 _CNV_A_R_LINEAR_____11_CM 8 -48. 142.5 DISPLAY_IDENTIFIER LDPM_TCO__TI_WUP FORMAT "%5.1" /end AXIS_PTS
/begin AXIS_PTS ldp_tco_st__ti_tco_wup "" 0xffe41223 tco_st _REC_AXS_20_u1 190.5 _CNV_A_R_LINEAR_____11_CM 3 -48. 142.5 DISPLAY_IDENTIFIER LDP_TCO_ST__TI_TCO_WUP FORMAT "%5.1" /end AXIS_PTS
/begin AXIS_PTS ldp_vo__ti_vo_wup "" 0xffe4832c vo _REC_AXS_20_u1 95.625 _CNV_A_R_LINEAR_____82_CM 8 0. 95.625 DISPLAY_IDENTIFIER LDP_VO__TI_VO_WUP FORMAT "%5.2" /end AXIS_PTS
/begin AXIS_PTS ldpm_n_32__ti_wup "" 0xffe484f5 n_32 _REC_AXS_20_u1 8160. _CNV_A_R_LINEAR_____15_CM 8 0. 8160. DISPLAY_IDENTIFIER LDPM_N_32__TI_WUP FORMAT "%4.0" /end AXIS_PTS
/begin AXIS_PTS ldp_map_dif__fac_ti_vo_wup "" 0xffe50f00 online_dummy _REC_AXS_20_u2 5434. _CNV_A_R_LINEAR_____49_CM 8 0. 5434. DISPLAY_IDENTIFIER LDP_MAP_DIF__FAC_TI_VO_WUP FORMAT "%7.2" /end AXIS_PTS
/begin AXIS_PTS ldp_map__ti_fac_n_map "" 0xffe50eee map _REC_AXS_20_u2 5434. _CNV_A_R_LINEAR_____49_CM 8 0. 5434. DISPLAY_IDENTIFIER LDP_MAP__TI_FAC_N_MAP FORMAT "%7.2" /end AXIS_PTS
/begin AXIS_PTS ldp_n_32__ti_fac_n_map "" 0xffe48091 n_32 _REC_AXS_20_u1 8160. _CNV_A_R_LINEAR_____15_CM 8 0. 8160. DISPLAY_IDENTIFIER LDP_N_32__TI_FAC_N_MAP FORMAT "%4.0" /end AXIS_PTS
/begin AXIS_PTS ldp_toil_ti_fac_tia_toil "" 0xffe412cf toil _REC_AXS_20_u1 200. _CNV_A_R_LINEAR_____14_CM 6 -40. 160. DISPLAY_IDENTIFIER LDP_TOIL_TI_FAC_TIA_TOIL FORMAT "%3.0" /end AXIS_PTS
/begin AXIS_PTS ldp_tia_ti_fac_tia_toil "" 0xffe412ab tia _REC_AXS_20_u1 190.5 _CNV_A_R_LINEAR_____11_CM 6 -48. 142.5 DISPLAY_IDENTIFIER LDP_TIA_TI_FAC_TIA_TOIL FORMAT "%5.1" /end AXIS_PTS
/begin AXIS_PTS ldp_tco__ti_fac_tco "" 0xffe411fa tco _REC_AXS_20_u1 190.5 _CNV_A_R_LINEAR_____11_CM 3 -48. 142.5 DISPLAY_IDENTIFIER LDP_TCO__TI_FAC_TCO FORMAT "%5.1" /end AXIS_PTS
/begin CHARACTERISTIC ip_fac_ti_vo_wup "Factor map for TCO/VO dependent warm up correction" MAP 0xffe458bc _REC_MAP_20_u1_u2_u1 0.199220002 _CNV_A_R_LINEAR_____39_CM 0. 1.99220002 DISPLAY_IDENTIFIER IP_FAC_TI_VO_WUP FORMAT "%5.3"
 /begin AXIS_DESCR COM_AXIS online_dummy _CNV_A_R_LINEAR_____49_CM 8 0. 5434. FORMAT "%7.2" AXIS_PTS_REF ldp_map_dif__fac_ti_vo_wup /end AXIS_DESCR
 /begin AXIS_DESCR COM_AXIS n_32 _CNV_A_R_LINEAR_____15_CM 8 0. 8160. FORMAT "%4.0" AXIS_PTS_REF ldpm_n_32__ti_wup /end AXIS_DESCR
/end CHARACTERISTIC
/begin CHARACTERISTIC ip_fac_ti_tco_wup "warm up basic factor" CURVE 0xffe40c27 _REC_CUR_20_u1_u1 0.199220002 _CNV_A_R_LINEAR_____39_CM 0. 1.99220002 DISPLAY_IDENTIFIER IP_FAC_TI_TCO_WUP FORMAT "%5.3"
 /begin AXIS_DESCR COM_AXIS tco _CNV_A_R_LINEAR_____11_CM 8 -48. 142.5 FORMAT "%5.1" AXIS_PTS_REF ldpm_tco__ti_wup /end AXIS_DESCR
/end CHARACTERISTIC
/begin AXIS_PTS ldpm_n_32_100 "" 0xffe4845f n_32 _REC_AXS_20_u1 8160. _CNV_A_R_LINEAR_____15_CM 16 0. 8160. DISPLAY_IDENTIFIER LDPM_N_32_100 FORMAT "%4.0" /end AXIS_PTS
/begin AXIS_PTS ldpm_maf_100 "" 0xffe518ac maf _REC_AXS_20_u2 1389. _CNV_A_R_LINEAR_____108_CM 12 0. 1389. DISPLAY_IDENTIFIER LDPM_MAF_100 FORMAT "%7.2" /end AXIS_PTS
/begin CHARACTERISTIC c_fac_wf_puc "transposition factor for PUC" VALUE 0xffe40755 _REC_VAL_20_u1 0.9960940000000002 _CNV_A_R_LINEAR_____50_CM 0. 0.996094 DISPLAY_IDENTIFIER C_FAC_WF_PUC FORMAT "%5.3" /end CHARACTERISTIC
/begin CHARACTERISTIC c_ti_crlc_fast_wf_is "fast correlation constant for idle speed" VALUE 0xffe41a7c _REC_VAL_20_u2 0.99998474 _CNV_A_R_LINEAR_____37_CM 0. 0.99998474 DISPLAY_IDENTIFIER C_TI_CRLC_FAST_WF_IS FORMAT "%7.6" /end CHARACTERISTIC
/begin MEASUREMENT seg_ctr_wf "wall film segment counter running down after engine start" UWORD _CNV_A_R_LINEAR_____185_CM 1 100. 0. 65535. DISPLAY_IDENTIFIER SEG_CTR_WF ECU_ADDRESS 0x3fda28 BYTE_ORDER MSB_LAST FORMAT "%5.0" /end MEASUREMENT
/begin CHARACTERISTIC ip_seg_ctr_fac_wf__seg_ctr_wf "number of segments depending factor for first tip in" CURVE 0xffe40df2 _REC_CUR_20_u1_u2 0.9960940000000002 _CNV_A_R_LINEAR_____50_CM 0. 0.996094 DISPLAY_IDENTIFIER IP_SEG_CTR_FAC_WF__SEG_CTR_WF FORMAT "%5.3"
 /begin AXIS_DESCR COM_AXIS seg_ctr_wf _CNV_A_R_LINEAR_____185_CM 4 0. 65535. FORMAT "%5.0" AXIS_PTS_REF ldp_seg_ctr_fac_wf /end AXIS_DESCR
/end CHARACTERISTIC
/begin CHARACTERISTIC ip_ti_dif_wf_thd__tco "threshold for suppressing small variations of tib" CURVE 0xffe41cd0 _REC_CUR_20_u2_u1 262.14 _CNV_A_R_LINEAR_____165_CM 0. 262.14 DISPLAY_IDENTIFIER IP_TI_DIF_WF_THD__TCO FORMAT "%7.3"
 /begin AXIS_DESCR COM_AXIS tco _CNV_A_R_LINEAR_____11_CM 4 -48. 142.5 FORMAT "%5.1" AXIS_PTS_REF ldp_tco_ti_wf_thd /end AXIS_DESCR
/end CHARACTERISTIC
/begin CHARACTERISTIC ip_ti_fac_neg_fast_wf__n__maf "load correction fast wall film negative" MAP 0xffe47b4f _REC_MAP_20_u1_u1_u1 1.9921875 _CNV_A_R_LINEAR_____117_CM 0. 1.9921875 DISPLAY_IDENTIFIER IP_TI_FAC_NEG_FAST_WF__N__MAF FORMAT "%5.3"
 /begin AXIS_DESCR COM_AXIS n_32 _CNV_A_R_LINEAR_____15_CM 8 0. 8160. FORMAT "%4.0" AXIS_PTS_REF ldpm_n_29 /end AXIS_DESCR
 /begin AXIS_DESCR COM_AXIS maf _CNV_A_R_LINEAR_____27_CM 8 0. 1389. FORMAT "%4.0" AXIS_PTS_REF ldpm_maf_6 /end AXIS_DESCR
/end CHARACTERISTIC
/begin CHARACTERISTIC ip_ti_fac_neg_slow_wf__n__maf "load correction slow wall film negative" MAP 0xffe47b8f _REC_MAP_20_u1_u1_u1 1.9921875 _CNV_A_R_LINEAR_____117_CM 0. 1.9921875 DISPLAY_IDENTIFIER IP_TI_FAC_NEG_SLOW_WF__N__MAF FORMAT "%5.3"
 /begin AXIS_DESCR COM_AXIS n_32 _CNV_A_R_LINEAR_____15_CM 8 0. 8160. FORMAT "%4.0" AXIS_PTS_REF ldpm_n_29 /end AXIS_DESCR
 /begin AXIS_DESCR COM_AXIS maf _CNV_A_R_LINEAR_____27_CM 8 0. 1389. FORMAT "%4.0" AXIS_PTS_REF ldpm_maf_6 /end AXIS_DESCR
/end CHARACTERISTIC
/begin CHARACTERISTIC ip_ti_fac_pos_slow_wf__n__maf "load correction slow wall film positive" MAP 0xffe47c0f _REC_MAP_20_u1_u1_u1 1.9921875 _CNV_A_R_LINEAR_____117_CM 0. 1.9921875 DISPLAY_IDENTIFIER IP_TI_FAC_POS_SLOW_WF__N__MAF FORMAT "%5.3"
 /begin AXIS_DESCR COM_AXIS n_32 _CNV_A_R_LINEAR_____15_CM 8 0. 8160. FORMAT "%4.0" AXIS_PTS_REF ldpm_n_29 /end AXIS_DESCR
 /begin AXIS_DESCR COM_AXIS maf _CNV_A_R_LINEAR_____27_CM 8 0. 1389. FORMAT "%4.0" AXIS_PTS_REF ldpm_maf_6 /end AXIS_DESCR
/end CHARACTERISTIC
/begin CHARACTERISTIC ip_ti_fast_wf_thd__tib "threshold for fast wall film correction" CURVE 0xffe41cd8 _REC_CUR_20_u2_u2 262.14 _CNV_A_R_LINEAR_____165_CM 0. 262.14 DISPLAY_IDENTIFIER IP_TI_FAST_WF_THD__TIB FORMAT "%7.3"
 /begin AXIS_DESCR COM_AXIS tib _CNV_A_R_LINEAR_____165_CM 4 0. 262.14 FORMAT "%7.3" AXIS_PTS_REF ldpm_tib_ti_wf_thd /end AXIS_DESCR
/end CHARACTERISTIC
/begin CHARACTERISTIC ip_ti_slow_wf_thd__tib "threshold for slow wall film correction" CURVE 0xffe41ce0 _REC_CUR_20_u2_u2 262.14 _CNV_A_R_LINEAR_____165_CM 0. 262.14 DISPLAY_IDENTIFIER IP_TI_SLOW_WF_THD__TIB FORMAT "%7.3"
 /begin AXIS_DESCR COM_AXIS tib _CNV_A_R_LINEAR_____165_CM 4 0. 262.14 FORMAT "%7.3" AXIS_PTS_REF ldpm_tib_ti_wf_thd /end AXIS_DESCR
/end CHARACTERISTIC
/begin CHARACTERISTIC ip_ti_tco_neg_fast_wf__n__tco "fast negative wall film factor" MAP 0xffe47c73 _REC_MAP_20_u1_u1_u1 127.5 _CNV_A_R_LINEAR_____441_CM 0. 127.5 DISPLAY_IDENTIFIER IP_TI_TCO_NEG_FAST_WF__N__TCO FORMAT "%5.1"
 /begin AXIS_DESCR COM_AXIS n_32 _CNV_A_R_LINEAR_____15_CM 8 0. 8160. FORMAT "%4.0" AXIS_PTS_REF ldpm_n_29 /end AXIS_DESCR
 /begin AXIS_DESCR COM_AXIS tco _CNV_A_R_LINEAR_____11_CM 8 -48. 142.5 FORMAT "%5.1" AXIS_PTS_REF ldpm_tco_15 /end AXIS_DESCR
/end CHARACTERISTIC
/begin CHARACTERISTIC ip_ti_tco_neg_slow_wf__n__tco "total negativewall film factor" MAP 0xffe47cb3 _REC_MAP_20_u1_u1_u1 510. _CNV_A_R_LINEAR_____541_CM 0. 510. DISPLAY_IDENTIFIER IP_TI_TCO_NEG_SLOW_WF__N__TCO FORMAT "%5.1"
 /begin AXIS_DESCR COM_AXIS n_32 _CNV_A_R_LINEAR_____15_CM 8 0. 8160. FORMAT "%4.0" AXIS_PTS_REF ldpm_n_29 /end AXIS_DESCR
 /begin AXIS_DESCR COM_AXIS tco _CNV_A_R_LINEAR_____11_CM 8 -48. 142.5 FORMAT "%5.1" AXIS_PTS_REF ldpm_tco_15 /end AXIS_DESCR
/end CHARACTERISTIC
/begin CHARACTERISTIC ip_ti_tco_pos_fast_wf__n__tco "fast positive wall film factor" MAP 0xffe47cf3 _REC_MAP_20_u1_u1_u1 127.5 _CNV_A_R_LINEAR_____441_CM 0. 127.5 DISPLAY_IDENTIFIER IP_TI_TCO_POS_FAST_WF__N__TCO FORMAT "%5.1"
 /begin AXIS_DESCR COM_AXIS n_32 _CNV_A_R_LINEAR_____15_CM 8 0. 8160. FORMAT "%4.0" AXIS_PTS_REF ldpm_n_29 /end AXIS_DESCR
 /begin AXIS_DESCR COM_AXIS tco _CNV_A_R_LINEAR_____11_CM 8 -48. 142.5 FORMAT "%5.1" AXIS_PTS_REF ldpm_tco_15 /end AXIS_DESCR
/end CHARACTERISTIC
/begin CHARACTERISTIC ip_ti_tco_pos_slow_wf__n__tco "total positive wall film factor" MAP 0xffe47d33 _REC_MAP_20_u1_u1_u1 510. _CNV_A_R_LINEAR_____541_CM 0. 510. DISPLAY_IDENTIFIER IP_TI_TCO_POS_SLOW_WF__N__TCO FORMAT "%5.1"
 /begin AXIS_DESCR COM_AXIS n_32 _CNV_A_R_LINEAR_____15_CM 8 0. 8160. FORMAT "%4.0" AXIS_PTS_REF ldpm_n_29 /end AXIS_DESCR
 /begin AXIS_DESCR COM_AXIS tco _CNV_A_R_LINEAR_____11_CM 8 -48. 142.5 FORMAT "%5.1" AXIS_PTS_REF ldpm_tco_15 /end AXIS_DESCR
/end CHARACTERISTIC
/begin CHARACTERISTIC ip_ti_tco_st_fac_wf__tco_st "TCO_ST depending factor for first tip in" CURVE 0xffe40e95 _REC_CUR_20_u1_u1 0.9960940000000002 _CNV_A_R_LINEAR_____50_CM 0. 0.996094 DISPLAY_IDENTIFIER IP_TI_TCO_ST_FAC_WF__TCO_ST FORMAT "%5.3"
 /begin AXIS_DESCR COM_AXIS tco_st _CNV_A_R_LINEAR_____11_CM 4 -48. 142.5 FORMAT "%5.1" AXIS_PTS_REF ldp_tco_st_ti_fac_wf /end AXIS_DESCR
/end CHARACTERISTIC
/begin CHARACTERISTIC ip_ti_vo_fast_wf__vo "VO-dependent wall film amount correction factor for fast compensation" CURVE 0xffe40e99 _REC_CUR_20_u1_u1 1.99220002 _CNV_A_R_LINEAR_____39_CM 0. 1.99220002 DISPLAY_IDENTIFIER IP_TI_VO_FAST_WF__VO FORMAT "%5.3"
 /begin AXIS_DESCR COM_AXIS vo _CNV_A_R_LINEAR_____82_CM 8 0. 95.625 FORMAT "%4.1" AXIS_PTS_REF ldpm_vo_1 /end AXIS_DESCR
/end CHARACTERISTIC
/begin MEASUREMENT ti_add_wf "Total amount of wall film compensation" SWORD _CNV_A_R_LINEAR_____165_CM 1 100. -131.072 131.068 DISPLAY_IDENTIFIER TI_ADD_WF ECU_ADDRESS 0x3fda18 BYTE_ORDER MSB_LAST /end MEASUREMENT
/begin MEASUREMENT ti_fast_wf_post_thd "Fast term of wall film compensation" SWORD _CNV_A_R_LINEAR_____165_CM 1 100. -131.072 131.068 DISPLAY_IDENTIFIER TI_FAST_WF_POST_THD ECU_ADDRESS 0x3fda2c BYTE_ORDER MSB_LAST FORMAT "%8.3" /end MEASUREMENT
/begin CHARACTERISTIC c_fac_wf_pu "transposition factor for PU" VALUE 0xffe40754 _REC_VAL_20_u1 0.9960940000000002 _CNV_A_R_LINEAR_____50_CM 0. 0.996094 DISPLAY_IDENTIFIER C_FAC_WF_PU FORMAT "%5.3" /end CHARACTERISTIC
/begin CHARACTERISTIC ip_ti_fac_pos_fast_wf__n__maf "load correction fast wall film positive" MAP 0xffe47bcf _REC_MAP_20_u1_u1_u1 1.9921875 _CNV_A_R_LINEAR_____117_CM 0. 1.9921875 DISPLAY_IDENTIFIER IP_TI_FAC_POS_FAST_WF__N__MAF FORMAT "%5.3"
 /begin AXIS_DESCR COM_AXIS n_32 _CNV_A_R_LINEAR_____15_CM 8 0. 8160. FORMAT "%4.0" AXIS_PTS_REF ldpm_n_29 /end AXIS_DESCR
 /begin AXIS_DESCR COM_AXIS maf _CNV_A_R_LINEAR_____27_CM 8 0. 1389. FORMAT "%4.0" AXIS_PTS_REF ldpm_maf_6 /end AXIS_DESCR
/end CHARACTERISTIC
/begin CHARACTERISTIC c_seg_ctr_wf_ini "initial value for number of segments after start with increased pos. wall film compensation" VALUE 0xffe418a8 _REC_VAL_20_u2 65535. _CNV_A_R_LINEAR_____0_CM 0. 65535. DISPLAY_IDENTIFIER C_SEG_CTR_WF_INI FORMAT "%5.0" /end CHARACTERISTIC
/begin AXIS_PTS ldp_seg_ctr_fac_wf "" 0xffe51276 seg_ctr_wf _REC_AXS_20_u2 65535. _CNV_A_R_LINEAR_____185_CM 4 0. 65535. DISPLAY_IDENTIFIER LDP_SEG_CTR_FAC_WF FORMAT "%5.0" /end AXIS_PTS
/begin AXIS_PTS ldp_tco_st_ti_fac_wf "" 0xffe41238 tco_st _REC_AXS_20_u1 190.5 _CNV_A_R_LINEAR_____11_CM 4 -48. 142.5 DISPLAY_IDENTIFIER LDP_TCO_ST_TI_FAC_WF FORMAT "%5.1" /end AXIS_PTS
/begin AXIS_PTS ldp_tco_ti_wf_thd "" 0xffe41244 tco _REC_AXS_20_u1 28.575 _CNV_A_R_LINEAR_____11_CM 4 -48. 142.5 DISPLAY_IDENTIFIER LDP_TCO_TI_WF_THD FORMAT "%5.1" /end AXIS_PTS
/begin AXIS_PTS ldpm_maf_6 "" 0xffe483e7 maf _REC_AXS_20_u1 1389. _CNV_A_R_LINEAR_____27_CM 8 0. 1389. DISPLAY_IDENTIFIER LDPM_MAF_6 FORMAT "%4.0" /end AXIS_PTS
/begin AXIS_PTS ldpm_n_29 "" 0xffe48445 n_32 _REC_AXS_20_u1 8160. _CNV_A_R_LINEAR_____15_CM 8 0. 8160. DISPLAY_IDENTIFIER LDPM_N_29 FORMAT "%4.0" /end AXIS_PTS
/begin AXIS_PTS ldpm_tib_ti_wf_thd "" 0xffe51e5e tib _REC_AXS_20_u2 262.14 _CNV_A_R_LINEAR_____165_CM 4 0. 262.14 DISPLAY_IDENTIFIER LDPM_TIB_TI_WF_THD FORMAT "%7.3" /end AXIS_PTS
/begin AXIS_PTS ldpm_vo_1 "" 0xffe48713 vo _REC_AXS_20_u1 95.625 _CNV_A_R_LINEAR_____82_CM 8 0. 95.625 DISPLAY_IDENTIFIER LDPM_VO_1 FORMAT "%4.1" /end AXIS_PTS
/begin MEASUREMENT ti_slow_wf_post_thd "Slow term of wall film compensation" SWORD _CNV_A_R_LINEAR_____165_CM 1 100. -131.072 131.068 DISPLAY_IDENTIFIER TI_SLOW_WF_POST_THD ECU_ADDRESS 0x3fda30 BYTE_ORDER MSB_LAST FORMAT "%8.3" /end MEASUREMENT
/begin MEASUREMENT ti_maf_sp_wf "Air mass flow setpoint term of wall film compensation" SWORD _CNV_A_R_LINEAR_____165_CM 1 100. -131.072 131.068 DISPLAY_IDENTIFIER TI_MAF_SP_WF ECU_ADDRESS 0x3fda2e BYTE_ORDER MSB_LAST FORMAT "%8.3" /end MEASUREMENT
/begin CHARACTERISTIC ip_ti_vo_slow_wf__vo "VO-dependent wall film amount correction factor for slow compensation" CURVE 0xffe40ea9 _REC_CUR_20_u1_u1 1.99220002 _CNV_A_R_LINEAR_____39_CM 0. 1.99220002 DISPLAY_IDENTIFIER IP_TI_VO_SLOW_WF__VO FORMAT "%5.3"
 /begin AXIS_DESCR COM_AXIS vo _CNV_A_R_LINEAR_____82_CM 8 0. 95.625 FORMAT "%4.1" AXIS_PTS_REF ldpm_vo_1 /end AXIS_DESCR
/end CHARACTERISTIC
/begin CHARACTERISTIC ip_ti_vo_maf_sp_wf__vo "VO-dependent wall film amount correction factor for air mass flow setpoint triggered compensation" CURVE 0xffe40ea1 _REC_CUR_20_u1_u1 1.99220002 _CNV_A_R_LINEAR_____39_CM 0. 1.99220002 DISPLAY_IDENTIFIER IP_TI_VO_MAF_SP_WF__VO FORMAT "%5.3"
 /begin AXIS_DESCR COM_AXIS vo _CNV_A_R_LINEAR_____82_CM 8 0. 95.625 FORMAT "%4.1" AXIS_PTS_REF ldpm_vo_1 /end AXIS_DESCR
/end CHARACTERISTIC
/begin AXIS_PTS ldp_maf_sp_tqi "" 0xffe50ec4 maf_sp_tqi _REC_AXS_20_u2 1389. _CNV_A_R_LINEAR_____108_CM 8 0. 1389. DISPLAY_IDENTIFIER LDP_MAF_SP_TQI FORMAT "%7.2" /end AXIS_PTS
/begin CHARACTERISTIC ip_ti_cor_maf_sp_wf "injection correction due to air mass flow setpoint triggered wallfilm" MAP 0xffe4f40e _REC_MAP_20_u2_u1_u2 262.14 _CNV_A_R_LINEAR_____360_CM -131.072 131.068 DISPLAY_IDENTIFIER IP_TI_COR_MAF_SP_WF FORMAT "%6.2"
 /begin AXIS_DESCR COM_AXIS n_32 _CNV_A_R_LINEAR_____15_CM 8 0. 8160. FORMAT "%4.0" AXIS_PTS_REF ldpm_n_29 /end AXIS_DESCR
 /begin AXIS_DESCR COM_AXIS maf_sp_tqi _CNV_A_R_LINEAR_____108_CM 8 0. 1389. FORMAT "%7.2" AXIS_PTS_REF ldp_maf_sp_tqi /end AXIS_DESCR
/end CHARACTERISTIC
/begin CHARACTERISTIC ip_fac_ti_cor_maf_sp_wf_pos "coolant temperature correction for air mass flow setpoint triggered wallfilm - positive (MAF_SP increasing)" CURVE 0xffe40c1f _REC_CUR_20_u1_u1 1.99220002 _CNV_A_R_LINEAR_____39_CM 0. 1.99220002 DISPLAY_IDENTIFIER IP_FAC_TI_COR_MAF_SP_WF_POS FORMAT "%5.3"
 /begin AXIS_DESCR COM_AXIS tco _CNV_A_R_LINEAR_____11_CM 8 -48. 142.5 FORMAT "%5.1" AXIS_PTS_REF ldpm_tco_15 /end AXIS_DESCR
/end CHARACTERISTIC
/begin CHARACTERISTIC ip_fac_ti_cor_maf_sp_wf_neg "coolant temperature correction for air mass flow setpoint triggered wallfilm - negative (MAF_SP decreasing)" CURVE 0xffe40c17 _REC_CUR_20_u1_u1 1.99220002 _CNV_A_R_LINEAR_____39_CM 0. 1.99220002 DISPLAY_IDENTIFIER IP_FAC_TI_COR_MAF_SP_WF_NEG FORMAT "%5.3"
 /begin AXIS_DESCR COM_AXIS tco _CNV_A_R_LINEAR_____11_CM 8 -48. 142.5 FORMAT "%5.1" AXIS_PTS_REF ldpm_tco_15 /end AXIS_DESCR
/end CHARACTERISTIC
/begin CHARACTERISTIC ip_crlc_pos_maf_sp_wf "correlation constant for air mass flow setpoint triggered wallfilm - positive (MAF_SP increasing)" MAP 0xffe49194 _REC_MAP_20_u2_u1_u1 0.99998474 _CNV_A_R_LINEAR_____37_CM 0. 0.99998474 DISPLAY_IDENTIFIER IP_CRLC_POS_MAF_SP_WF FORMAT "%7.6"
 /begin AXIS_DESCR COM_AXIS n_32 _CNV_A_R_LINEAR_____15_CM 8 0. 8160. FORMAT "%4.0" AXIS_PTS_REF ldpm_n_29 /end AXIS_DESCR
 /begin AXIS_DESCR COM_AXIS tco _CNV_A_R_LINEAR_____11_CM 3 -48. 142.5 FORMAT "%5.1" AXIS_PTS_REF ldpm_tco_16 /end AXIS_DESCR
/end CHARACTERISTIC
/begin CHARACTERISTIC ip_crlc_neg_maf_sp_wf "correlation constant for air mass flow setpoint triggered wallfilm - negative (MAF_SP decreasing)" MAP 0xffe49164 _REC_MAP_20_u2_u1_u1 0.99998474 _CNV_A_R_LINEAR_____37_CM 0. 0.99998474 DISPLAY_IDENTIFIER IP_CRLC_NEG_MAF_SP_WF FORMAT "%7.6"
 /begin AXIS_DESCR COM_AXIS n_32 _CNV_A_R_LINEAR_____15_CM 8 0. 8160. FORMAT "%4.0" AXIS_PTS_REF ldpm_n_29 /end AXIS_DESCR
 /begin AXIS_DESCR COM_AXIS tco _CNV_A_R_LINEAR_____11_CM 3 -48. 142.5 FORMAT "%5.1" AXIS_PTS_REF ldpm_tco_16 /end AXIS_DESCR
/end CHARACTERISTIC
/begin CHARACTERISTIC ip_fac_ti_wf "temperature correction for total wallfilm" MAP 0xffe458fc _REC_MAP_20_u1_u1_u1 1.99220002 _CNV_A_R_LINEAR_____39_CM 0. 1.99220002 DISPLAY_IDENTIFIER IP_FAC_TI_WF FORMAT "%5.3"
 /begin AXIS_DESCR COM_AXIS tco _CNV_A_R_LINEAR_____11_CM 4 -48. 142.5 FORMAT "%5.1" AXIS_PTS_REF ldp_tco__fac_ti_wf /end AXIS_DESCR
 /begin AXIS_DESCR COM_AXIS tia _CNV_A_R_LINEAR_____11_CM 4 -48. 142.5 FORMAT "%5.1" AXIS_PTS_REF ldp_tia__fac_ti_wf /end AXIS_DESCR
/end CHARACTERISTIC
/begin CHARACTERISTIC c_t_ti_tra_pas "time before activation of wall film correction" VALUE 0xffe41a16 _REC_VAL_20_u2 655.35 _CNV_A_R_LINEAR_____4_CM 0. 655.35 DISPLAY_IDENTIFIER C_T_TI_TRA_PAS FORMAT "%6.2" /end CHARACTERISTIC
/begin CHARACTERISTIC c_thd_maf_sp_wf "activation treshold for air mass flow setpoint triggered wallfilm" VALUE 0xffe41a6e _REC_VAL_20_u2 1389. _CNV_A_R_LINEAR_____108_CM 0. 1389. DISPLAY_IDENTIFIER C_THD_MAF_SP_WF FORMAT "%7.2" /end CHARACTERISTIC
/begin AXIS_PTS ldp_tia__fac_ti_wf "" 0xffe41268 tia _REC_AXS_20_u1 190.5 _CNV_A_R_LINEAR_____11_CM 4 -48. 142.5 DISPLAY_IDENTIFIER LDP_TIA__FAC_TI_WF FORMAT "%5.1" /end AXIS_PTS
/begin AXIS_PTS ldp_tco__fac_ti_wf "" 0xffe411b3 tco _REC_AXS_20_u1 190.5 _CNV_A_R_LINEAR_____11_CM 4 -48. 142.5 DISPLAY_IDENTIFIER LDP_TCO__FAC_TI_WF FORMAT "%5.1" /end AXIS_PTS
/begin AXIS_PTS ldpm_tco_15 "" 0xffe485ed tco _REC_AXS_20_u1 190.5 _CNV_A_R_LINEAR_____11_CM 8 -48. 142.5 DISPLAY_IDENTIFIER LDPM_TCO_15 FORMAT "%5.1" /end AXIS_PTS
/begin AXIS_PTS ldpm_tco_16 "" 0xffe41422 tco _REC_AXS_20_u1 190.5 _CNV_A_R_LINEAR_____11_CM 3 -48. 142.5 DISPLAY_IDENTIFIER LDPM_TCO_16 FORMAT "%5.1" /end AXIS_PTS
/begin CHARACTERISTIC ip_ti_crlc_pos_slow_wf__n__tco "slow positive correlation constant" MAP 0xffe4f51e _REC_MAP_20_u2_u1_u1 0.99998474 _CNV_A_R_LINEAR_____37_CM 0. 0.99998474 DISPLAY_IDENTIFIER IP_TI_CRLC_POS_SLOW_WF__N__TCO FORMAT "%7.6"
 /begin AXIS_DESCR COM_AXIS n_32 _CNV_A_R_LINEAR_____15_CM 8 0. 8160. FORMAT "%4.0" AXIS_PTS_REF ldpm_n_29 /end AXIS_DESCR
 /begin AXIS_DESCR COM_AXIS tco _CNV_A_R_LINEAR_____11_CM 3 -48. 142.5 FORMAT "%5.1" AXIS_PTS_REF ldpm_tco_16 /end AXIS_DESCR
/end CHARACTERISTIC
/begin CHARACTERISTIC ip_ti_crlc_neg_slow_wf__n__tco "slow negative correlation constant" MAP 0xffe4f4be _REC_MAP_20_u2_u1_u1 0.99998474 _CNV_A_R_LINEAR_____37_CM 0. 0.99998474 DISPLAY_IDENTIFIER IP_TI_CRLC_NEG_SLOW_WF__N__TCO FORMAT "%7.6"
 /begin AXIS_DESCR COM_AXIS n_32 _CNV_A_R_LINEAR_____15_CM 8 0. 8160. FORMAT "%4.0" AXIS_PTS_REF ldpm_n_29 /end AXIS_DESCR
 /begin AXIS_DESCR COM_AXIS tco _CNV_A_R_LINEAR_____11_CM 3 -48. 142.5 FORMAT "%5.1" AXIS_PTS_REF ldpm_tco_16 /end AXIS_DESCR
/end CHARACTERISTIC
/begin CHARACTERISTIC ip_ti_crlc_pos_fast_wf__n__tco "fast positive correlation constant" MAP 0xffe4f4ee _REC_MAP_20_u2_u1_u1 0.99998474 _CNV_A_R_LINEAR_____37_CM 0. 0.99998474 DISPLAY_IDENTIFIER IP_TI_CRLC_POS_FAST_WF__N__TCO FORMAT "%7.6"
 /begin AXIS_DESCR COM_AXIS n_32 _CNV_A_R_LINEAR_____15_CM 8 0. 8160. FORMAT "%4.0" AXIS_PTS_REF ldpm_n_29 /end AXIS_DESCR
 /begin AXIS_DESCR COM_AXIS tco _CNV_A_R_LINEAR_____11_CM 3 -48. 142.5 FORMAT "%5.1" AXIS_PTS_REF ldpm_tco_16 /end AXIS_DESCR
/end CHARACTERISTIC
/begin CHARACTERISTIC ip_ti_crlc_neg_fast_wf__n__tco "fast negative correlation constant" MAP 0xffe4f48e _REC_MAP_20_u2_u1_u1 0.99998474 _CNV_A_R_LINEAR_____37_CM 0. 0.99998474 DISPLAY_IDENTIFIER IP_TI_CRLC_NEG_FAST_WF__N__TCO FORMAT "%7.6"
 /begin AXIS_DESCR COM_AXIS n_32 _CNV_A_R_LINEAR_____15_CM 8 0. 8160. FORMAT "%4.0" AXIS_PTS_REF ldpm_n_29 /end AXIS_DESCR
 /begin AXIS_DESCR COM_AXIS tco _CNV_A_R_LINEAR_____11_CM 3 -48. 142.5 FORMAT "%5.1" AXIS_PTS_REF ldpm_tco_16 /end AXIS_DESCR
/end CHARACTERISTIC
/begin AXIS_PTS ldpm_n_32_ip_egr_ratio "" 0xffe48538 n_32 _REC_AXS_20_u1 8160. _CNV_A_R_LINEAR_____15_CM 12 0. 8160. DISPLAY_IDENTIFIER LDPM_N_32_IP_EGR_RATIO FORMAT "%4.0" /end AXIS_PTS
/begin AXIS_PTS ldpm_maf_ip_egr_ratio "" 0xffe51976 maf _REC_AXS_20_u2 1389. _CNV_A_R_LINEAR_____108_CM 12 0. 1389. DISPLAY_IDENTIFIER LDPM_MAF_IP_EGR_RATIO FORMAT "%7.2" /end AXIS_PTS
/begin MEASUREMENT eoi_hom "end of injection for homogeneous combustion mode" UWORD _CNV_A_R_LINEAR_____82_CM 1 100. 0. 720. DISPLAY_IDENTIFIER EOI_HOM ECU_ADDRESS 0x3fb392 BYTE_ORDER MSB_LAST FORMAT "%6.2" /end MEASUREMENT
/begin CHARACTERISTIC id_fil_frq_knk_1__n "Knock Filter Frequency and Reference Filter Frequency Cyl.2" CURVE 0xffe40a49 _REC_CUR_20_u1_u1 63. _CNV_A_R_LINEAR_____0_CM 0. 63. DISPLAY_IDENTIFIER ID_FIL_FRQ_KNK_1 FORMAT "%2.0"
 /begin AXIS_DESCR COM_AXIS n_knk _CNV_A_R_LINEAR_____15_CM 4 0. 8160. FORMAT "%4.0" AXIS_PTS_REF ldpm_n_fil_frq_knk /end AXIS_DESCR
/end CHARACTERISTIC
/begin CHARACTERISTIC id_fil_frq_knk_2__n "Knock Filter Frequency and Reference Filter Frequency Cyl.3" CURVE 0xffe40a4d _REC_CUR_20_u1_u1 63. _CNV_A_R_LINEAR_____0_CM 0. 63. DISPLAY_IDENTIFIER ID_FIL_FRQ_KNK_2 FORMAT "%2.0"
 /begin AXIS_DESCR COM_AXIS n_knk _CNV_A_R_LINEAR_____15_CM 4 0. 8160. FORMAT "%4.0" AXIS_PTS_REF ldpm_n_fil_frq_knk /end AXIS_DESCR
/end CHARACTERISTIC
/begin CHARACTERISTIC id_fil_frq_knk_3__n "Knock Filter Frequency and Reference Filter Frequency Cyl.4" CURVE 0xffe40a51 _REC_CUR_20_u1_u1 63. _CNV_A_R_LINEAR_____0_CM 0. 63. DISPLAY_IDENTIFIER ID_FIL_FRQ_KNK_3 FORMAT "%2.0"
 /begin AXIS_DESCR COM_AXIS n_knk _CNV_A_R_LINEAR_____15_CM 4 0. 8160. FORMAT "%4.0" AXIS_PTS_REF ldpm_n_fil_frq_knk /end AXIS_DESCR
/end CHARACTERISTIC
/begin MEASUREMENT knks[0] "" UWORD _CNV_A_R_LINEAR_____252_CM 1 100. 0. 4.99992371 DISPLAY_IDENTIFIER KNKS_0 ECU_ADDRESS 0x3fb398 BYTE_ORDER MSB_LAST FORMAT "%7.5" /end MEASUREMENT
/begin MEASUREMENT knks[1] "" UWORD _CNV_A_R_LINEAR_____252_CM 1 100. 0. 4.99992371 DISPLAY_IDENTIFIER KNKS_1 ECU_ADDRESS 0x3fb39a BYTE_ORDER MSB_LAST FORMAT "%7.5" /end MEASUREMENT
/begin MEASUREMENT knks[2] "" UWORD _CNV_A_R_LINEAR_____252_CM 1 100. 0. 4.99992371 DISPLAY_IDENTIFIER KNKS_2 ECU_ADDRESS 0x3fb39c BYTE_ORDER MSB_LAST FORMAT "%7.5" /end MEASUREMENT
/begin MEASUREMENT knks[3] "" UWORD _CNV_A_R_LINEAR_____252_CM 1 100. 0. 4.99992371 DISPLAY_IDENTIFIER KNKS_3 ECU_ADDRESS 0x3fb39e BYTE_ORDER MSB_LAST FORMAT "%7.5" /end MEASUREMENT
/begin MEASUREMENT knks[4] "" UWORD _CNV_A_R_LINEAR_____252_CM 1 100. 0. 4.99992371 DISPLAY_IDENTIFIER KNKS_4 ECU_ADDRESS 0x3fb3a0 BYTE_ORDER MSB_LAST FORMAT "%7.5" /end MEASUREMENT
/begin MEASUREMENT knks[5] "" UWORD _CNV_A_R_LINEAR_____252_CM 1 100. 0. 4.99992371 DISPLAY_IDENTIFIER KNKS_5 ECU_ADDRESS 0x3fb3a2 BYTE_ORDER MSB_LAST FORMAT "%7.5" /end MEASUREMENT
/begin CHARACTERISTIC id_fil_frq_knk_0__n "Knock Filter Frequency and Reference Filter Frequency Cyl.1" CURVE 0xffe40a45 _REC_CUR_20_u1_u1 63. _CNV_A_R_LINEAR_____0_CM 0. 63. DISPLAY_IDENTIFIER ID_FIL_FRQ_KNK_0 FORMAT "%2.0"
 /begin AXIS_DESCR COM_AXIS n_knk _CNV_A_R_LINEAR_____15_CM 4 0. 8160. FORMAT "%4.0" AXIS_PTS_REF ldpm_n_fil_frq_knk /end AXIS_DESCR
/end CHARACTERISTIC
/begin CHARACTERISTIC id_fil_frq_knk_4__n "Knock Filter Frequency and Reference Filter Frequency Cyl.5" CURVE 0xffe40a55 _REC_CUR_20_u1_u1 63. _CNV_A_R_LINEAR_____0_CM 0. 63. DISPLAY_IDENTIFIER ID_FIL_FRQ_KNK_4 FORMAT "%2.0"
 /begin AXIS_DESCR COM_AXIS n_knk _CNV_A_R_LINEAR_____15_CM 4 0. 8160. FORMAT "%4.0" AXIS_PTS_REF ldpm_n_fil_frq_knk /end AXIS_DESCR
/end CHARACTERISTIC
/begin CHARACTERISTIC id_fil_frq_knk_5__n "Knock Filter Frequency and Reference Filter Frequency Cyl.6" CURVE 0xffe40a59 _REC_CUR_20_u1_u1 63. _CNV_A_R_LINEAR_____0_CM 0. 63. DISPLAY_IDENTIFIER ID_FIL_FRQ_KNK_5 FORMAT "%2.0"
 /begin AXIS_DESCR COM_AXIS n_knk _CNV_A_R_LINEAR_____15_CM 4 0. 8160. FORMAT "%4.0" AXIS_PTS_REF ldpm_n_fil_frq_knk /end AXIS_DESCR
/end CHARACTERISTIC
/begin CHARACTERISTIC ip_knkwb_2__n__maf "Beginning of Measurement Window Cyl.3" MAP 0xffe4bd42 _REC_MAP_20_u2_u1_u1 108. _CNV_A_R_LINEAR_____82_CM 0. 108. DISPLAY_IDENTIFIER IP_KNKWB_2__N__MAF FORMAT "%5.1"
 /begin AXIS_DESCR COM_AXIS n_knk _CNV_A_R_LINEAR_____15_CM 10 0. 8160. FORMAT "%4.0" AXIS_PTS_REF ldpm_n_knkwb /end AXIS_DESCR
 /begin AXIS_DESCR COM_AXIS maf_knk _CNV_A_R_LINEAR_____27_CM 4 0. 1389. FORMAT "%4.0" AXIS_PTS_REF ldpm_maf_knkwb /end AXIS_DESCR
/end CHARACTERISTIC
/begin CHARACTERISTIC ip_knkwb_3__n__maf "Beginning of Measurement Window Cyl.4" MAP 0xffe4bd92 _REC_MAP_20_u2_u1_u1 108. _CNV_A_R_LINEAR_____82_CM 0. 108. DISPLAY_IDENTIFIER IP_KNKWB_3__N__MAF FORMAT "%5.1"
 /begin AXIS_DESCR COM_AXIS n_knk _CNV_A_R_LINEAR_____15_CM 10 0. 8160. FORMAT "%4.0" AXIS_PTS_REF ldpm_n_knkwb /end AXIS_DESCR
 /begin AXIS_DESCR COM_AXIS maf_knk _CNV_A_R_LINEAR_____27_CM 4 0. 1389. FORMAT "%4.0" AXIS_PTS_REF ldpm_maf_knkwb /end AXIS_DESCR
/end CHARACTERISTIC
/begin CHARACTERISTIC ip_knkwb_4__n__maf "Beginning of Measurement Window Cyl.5" MAP 0xffe4bde2 _REC_MAP_20_u2_u1_u1 108. _CNV_A_R_LINEAR_____82_CM 0. 108. DISPLAY_IDENTIFIER IP_KNKWB_4__N__MAF FORMAT "%5.1"
 /begin AXIS_DESCR COM_AXIS n_knk _CNV_A_R_LINEAR_____15_CM 10 0. 8160. FORMAT "%4.0" AXIS_PTS_REF ldpm_n_knkwb /end AXIS_DESCR
 /begin AXIS_DESCR COM_AXIS maf_knk _CNV_A_R_LINEAR_____27_CM 4 0. 1389. FORMAT "%4.0" AXIS_PTS_REF ldpm_maf_knkwb /end AXIS_DESCR
/end CHARACTERISTIC
/begin CHARACTERISTIC ip_knkwb_5__n__maf "Beginning of Measurement Window Cyl.6" MAP 0xffe4be32 _REC_MAP_20_u2_u1_u1 108. _CNV_A_R_LINEAR_____82_CM 0. 108. DISPLAY_IDENTIFIER IP_KNKWB_5__N__MAF FORMAT "%5.1"
 /begin AXIS_DESCR COM_AXIS n_knk _CNV_A_R_LINEAR_____15_CM 10 0. 8160. FORMAT "%4.0" AXIS_PTS_REF ldpm_n_knkwb /end AXIS_DESCR
 /begin AXIS_DESCR COM_AXIS maf_knk _CNV_A_R_LINEAR_____27_CM 4 0. 1389. FORMAT "%4.0" AXIS_PTS_REF ldpm_maf_knkwb /end AXIS_DESCR
/end CHARACTERISTIC
/begin CHARACTERISTIC ip_knkwe_0__n__maf "End of Measurement Window Cyl.1" MAP 0xffe4be82 _REC_MAP_20_u2_u1_u1 113.625 _CNV_A_R_LINEAR_____82_CM 0.375 114. DISPLAY_IDENTIFIER IP_KNKWE_0__N__MAF FORMAT "%5.1"
 /begin AXIS_DESCR COM_AXIS n_knk _CNV_A_R_LINEAR_____15_CM 10 0. 8160. FORMAT "%4.0" AXIS_PTS_REF ldpm_n_knkwb /end AXIS_DESCR
 /begin AXIS_DESCR COM_AXIS maf_knk _CNV_A_R_LINEAR_____27_CM 4 0. 1389. FORMAT "%4.0" AXIS_PTS_REF ldpm_maf_knkwb /end AXIS_DESCR
/end CHARACTERISTIC
/begin CHARACTERISTIC ip_knkwe_1__n__maf "End of Measurement Window Cyl.2" MAP 0xffe4bed2 _REC_MAP_20_u2_u1_u1 113.625 _CNV_A_R_LINEAR_____82_CM 0.375 114. DISPLAY_IDENTIFIER IP_KNKWE_1__N__MAF FORMAT "%5.1"
 /begin AXIS_DESCR COM_AXIS n_knk _CNV_A_R_LINEAR_____15_CM 10 0. 8160. FORMAT "%4.0" AXIS_PTS_REF ldpm_n_knkwb /end AXIS_DESCR
 /begin AXIS_DESCR COM_AXIS maf_knk _CNV_A_R_LINEAR_____27_CM 4 0. 1389. FORMAT "%4.0" AXIS_PTS_REF ldpm_maf_knkwb /end AXIS_DESCR
/end CHARACTERISTIC
/begin CHARACTERISTIC ip_knkwe_2__n__maf "End of Measurement Window Cyl.3" MAP 0xffe4bf22 _REC_MAP_20_u2_u1_u1 113.625 _CNV_A_R_LINEAR_____82_CM 0.375 114. DISPLAY_IDENTIFIER IP_KNKWE_2__N__MAF FORMAT "%5.1"
 /begin AXIS_DESCR COM_AXIS n_knk _CNV_A_R_LINEAR_____15_CM 10 0. 8160. FORMAT "%4.0" AXIS_PTS_REF ldpm_n_knkwb /end AXIS_DESCR
 /begin AXIS_DESCR COM_AXIS maf_knk _CNV_A_R_LINEAR_____27_CM 4 0. 1389. FORMAT "%4.0" AXIS_PTS_REF ldpm_maf_knkwb /end AXIS_DESCR
/end CHARACTERISTIC
/begin CHARACTERISTIC ip_knkwe_3__n__maf "End of Measurement Window Cyl.4" MAP 0xffe4bf72 _REC_MAP_20_u2_u1_u1 113.625 _CNV_A_R_LINEAR_____82_CM 0.375 114. DISPLAY_IDENTIFIER IP_KNKWE_3__N__MAF FORMAT "%5.1"
 /begin AXIS_DESCR COM_AXIS n_knk _CNV_A_R_LINEAR_____15_CM 10 0. 8160. FORMAT "%4.0" AXIS_PTS_REF ldpm_n_knkwb /end AXIS_DESCR
 /begin AXIS_DESCR COM_AXIS maf_knk _CNV_A_R_LINEAR_____27_CM 4 0. 1389. FORMAT "%4.0" AXIS_PTS_REF ldpm_maf_knkwb /end AXIS_DESCR
/end CHARACTERISTIC
/begin CHARACTERISTIC ip_knkwe_4__n__maf "End of Measurement Window Cyl.5" MAP 0xffe4bfc2 _REC_MAP_20_u2_u1_u1 113.625 _CNV_A_R_LINEAR_____82_CM 0.375 114. DISPLAY_IDENTIFIER IP_KNKWE_4__N__MAF FORMAT "%5.1"
 /begin AXIS_DESCR COM_AXIS n_knk _CNV_A_R_LINEAR_____15_CM 10 0. 8160. FORMAT "%4.0" AXIS_PTS_REF ldpm_n_knkwb /end AXIS_DESCR
 /begin AXIS_DESCR COM_AXIS maf_knk _CNV_A_R_LINEAR_____27_CM 4 0. 1389. FORMAT "%4.0" AXIS_PTS_REF ldpm_maf_knkwb /end AXIS_DESCR
/end CHARACTERISTIC
/begin CHARACTERISTIC ip_knkwe_5__n__maf "End of Measurement Window Cyl.6" MAP 0xffe4c012 _REC_MAP_20_u2_u1_u1 113.625 _CNV_A_R_LINEAR_____82_CM 0.375 114. DISPLAY_IDENTIFIER IP_KNKWE_5__N__MAF FORMAT "%5.1"
 /begin AXIS_DESCR COM_AXIS n_knk _CNV_A_R_LINEAR_____15_CM 10 0. 8160. FORMAT "%4.0" AXIS_PTS_REF ldpm_n_knkwb /end AXIS_DESCR
 /begin AXIS_DESCR COM_AXIS maf_knk _CNV_A_R_LINEAR_____27_CM 4 0. 1389. FORMAT "%4.0" AXIS_PTS_REF ldpm_maf_knkwb /end AXIS_DESCR
/end CHARACTERISTIC
/begin CHARACTERISTIC ip_gain_knk_0__n__maf "Amplification precontrol Cyl.1" MAP 0xffe45adc _REC_MAP_20_u1_u1_u1 63. _CNV_A_R_LINEAR_____0_CM 0. 63. DISPLAY_IDENTIFIER IP_GAIN_KNK_0__N__MAF FORMAT "%2.0"
 /begin AXIS_DESCR COM_AXIS n_knk _CNV_A_R_LINEAR_____15_CM 16 0. 8160. FORMAT "%4.0" AXIS_PTS_REF ldpm_n_2_9 /end AXIS_DESCR
 /begin AXIS_DESCR COM_AXIS maf_knk _CNV_A_R_LINEAR_____27_CM 4 0. 1389. FORMAT "%4.0" AXIS_PTS_REF ldpm_maf_1_9 /end AXIS_DESCR
/end CHARACTERISTIC
/begin CHARACTERISTIC ip_gain_knk_2__n__maf "Amplification precontrol Cyl.3" MAP 0xffe45b5c _REC_MAP_20_u1_u1_u1 63. _CNV_A_R_LINEAR_____0_CM 0. 63. DISPLAY_IDENTIFIER IP_GAIN_KNK_2__N__MAF FORMAT "%2.0"
 /begin AXIS_DESCR COM_AXIS n_knk _CNV_A_R_LINEAR_____15_CM 16 0. 8160. FORMAT "%4.0" AXIS_PTS_REF ldpm_n_2_9 /end AXIS_DESCR
 /begin AXIS_DESCR COM_AXIS maf_knk _CNV_A_R_LINEAR_____27_CM 4 0. 1389. FORMAT "%4.0" AXIS_PTS_REF ldpm_maf_1_9 /end AXIS_DESCR
/end CHARACTERISTIC
/begin CHARACTERISTIC ip_gain_knk_3__n__maf "Amplification precontrol Cyl.4" MAP 0xffe45b9c _REC_MAP_20_u1_u1_u1 63. _CNV_A_R_LINEAR_____0_CM 0. 63. DISPLAY_IDENTIFIER IP_GAIN_KNK_3__N__MAF FORMAT "%2.0"
 /begin AXIS_DESCR COM_AXIS n_knk _CNV_A_R_LINEAR_____15_CM 16 0. 8160. FORMAT "%4.0" AXIS_PTS_REF ldpm_n_2_9 /end AXIS_DESCR
 /begin AXIS_DESCR COM_AXIS maf_knk _CNV_A_R_LINEAR_____27_CM 4 0. 1389. FORMAT "%4.0" AXIS_PTS_REF ldpm_maf_1_9 /end AXIS_DESCR
/end CHARACTERISTIC
/begin CHARACTERISTIC ip_gain_knk_4__n__maf "Amplification precontrol Cyl.5" MAP 0xffe45bdc _REC_MAP_20_u1_u1_u1 63. _CNV_A_R_LINEAR_____0_CM 0. 63. DISPLAY_IDENTIFIER IP_GAIN_KNK_4__N__MAF FORMAT "%2.0"
 /begin AXIS_DESCR COM_AXIS n_knk _CNV_A_R_LINEAR_____15_CM 16 0. 8160. FORMAT "%4.0" AXIS_PTS_REF ldpm_n_2_9 /end AXIS_DESCR
 /begin AXIS_DESCR COM_AXIS maf_knk _CNV_A_R_LINEAR_____27_CM 4 0. 1389. FORMAT "%4.0" AXIS_PTS_REF ldpm_maf_1_9 /end AXIS_DESCR
/end CHARACTERISTIC
/begin CHARACTERISTIC ip_gain_knk_5__n__maf "Amplification precontrol Cyl.6" MAP 0xffe45c1c _REC_MAP_20_u1_u1_u1 63. _CNV_A_R_LINEAR_____0_CM 0. 63. DISPLAY_IDENTIFIER IP_GAIN_KNK_5__N__MAF FORMAT "%2.0"
 /begin AXIS_DESCR COM_AXIS n_knk _CNV_A_R_LINEAR_____15_CM 16 0. 8160. FORMAT "%4.0" AXIS_PTS_REF ldpm_n_2_9 /end AXIS_DESCR
 /begin AXIS_DESCR COM_AXIS maf_knk _CNV_A_R_LINEAR_____27_CM 4 0. 1389. FORMAT "%4.0" AXIS_PTS_REF ldpm_maf_1_9 /end AXIS_DESCR
/end CHARACTERISTIC
/begin CHARACTERISTIC ip_itc_knk_0__n__maf "Integration time constant Cyl.1" MAP 0xffe46954 _REC_MAP_20_u1_u1_u1 31. _CNV_A_R_LINEAR_____0_CM 0. 31. DISPLAY_IDENTIFIER IP_ITC_KNK_0__N__MAF FORMAT "%2.0"
 /begin AXIS_DESCR COM_AXIS n_knk _CNV_A_R_LINEAR_____15_CM 16 0. 8160. FORMAT "%4.0" AXIS_PTS_REF ldpm_n_2_9 /end AXIS_DESCR
 /begin AXIS_DESCR COM_AXIS maf_knk _CNV_A_R_LINEAR_____27_CM 4 0. 1389. FORMAT "%4.0" AXIS_PTS_REF ldpm_maf_1_9 /end AXIS_DESCR
/end CHARACTERISTIC
/begin CHARACTERISTIC ip_itc_knk_1__n__maf "Integration time constant Cyl.2" MAP 0xffe46994 _REC_MAP_20_u1_u1_u1 31. _CNV_A_R_LINEAR_____0_CM 0. 31. DISPLAY_IDENTIFIER IP_ITC_KNK_1__N__MAF FORMAT "%2.0"
 /begin AXIS_DESCR COM_AXIS n_knk _CNV_A_R_LINEAR_____15_CM 16 0. 8160. FORMAT "%4.0" AXIS_PTS_REF ldpm_n_2_9 /end AXIS_DESCR
 /begin AXIS_DESCR COM_AXIS maf_knk _CNV_A_R_LINEAR_____27_CM 4 0. 1389. FORMAT "%4.0" AXIS_PTS_REF ldpm_maf_1_9 /end AXIS_DESCR
/end CHARACTERISTIC
/begin CHARACTERISTIC ip_itc_knk_2__n__maf "Integration time constant Cyl.3" MAP 0xffe469d4 _REC_MAP_20_u1_u1_u1 31. _CNV_A_R_LINEAR_____0_CM 0. 31. DISPLAY_IDENTIFIER IP_ITC_KNK_2__N__MAF FORMAT "%2.0"
 /begin AXIS_DESCR COM_AXIS n_knk _CNV_A_R_LINEAR_____15_CM 16 0. 8160. FORMAT "%4.0" AXIS_PTS_REF ldpm_n_2_9 /end AXIS_DESCR
 /begin AXIS_DESCR COM_AXIS maf_knk _CNV_A_R_LINEAR_____27_CM 4 0. 1389. FORMAT "%4.0" AXIS_PTS_REF ldpm_maf_1_9 /end AXIS_DESCR
/end CHARACTERISTIC
/begin CHARACTERISTIC ip_itc_knk_3__n__maf "Integration time constant Cyl.4" MAP 0xffe46a14 _REC_MAP_20_u1_u1_u1 31. _CNV_A_R_LINEAR_____0_CM 0. 31. DISPLAY_IDENTIFIER IP_ITC_KNK_3__N__MAF FORMAT "%2.0"
 /begin AXIS_DESCR COM_AXIS n_knk _CNV_A_R_LINEAR_____15_CM 16 0. 8160. FORMAT "%4.0" AXIS_PTS_REF ldpm_n_2_9 /end AXIS_DESCR
 /begin AXIS_DESCR COM_AXIS maf_knk _CNV_A_R_LINEAR_____27_CM 4 0. 1389. FORMAT "%4.0" AXIS_PTS_REF ldpm_maf_1_9 /end AXIS_DESCR
/end CHARACTERISTIC
/begin CHARACTERISTIC ip_itc_knk_4__n__maf "Integration time constant Cyl.5" MAP 0xffe46a54 _REC_MAP_20_u1_u1_u1 31. _CNV_A_R_LINEAR_____0_CM 0. 31. DISPLAY_IDENTIFIER IP_ITC_KNK_4__N__MAF FORMAT "%2.0"
 /begin AXIS_DESCR COM_AXIS n_knk _CNV_A_R_LINEAR_____15_CM 16 0. 8160. FORMAT "%4.0" AXIS_PTS_REF ldpm_n_2_9 /end AXIS_DESCR
 /begin AXIS_DESCR COM_AXIS maf_knk _CNV_A_R_LINEAR_____27_CM 4 0. 1389. FORMAT "%4.0" AXIS_PTS_REF ldpm_maf_1_9 /end AXIS_DESCR
/end CHARACTERISTIC
/begin CHARACTERISTIC ip_itc_knk_5__n__maf "Integration time constant Cyl.6" MAP 0xffe46a94 _REC_MAP_20_u1_u1_u1 31. _CNV_A_R_LINEAR_____0_CM 0. 31. DISPLAY_IDENTIFIER IP_ITC_KNK_5__N__MAF FORMAT "%2.0"
 /begin AXIS_DESCR COM_AXIS n_knk _CNV_A_R_LINEAR_____15_CM 16 0. 8160. FORMAT "%4.0" AXIS_PTS_REF ldpm_n_2_9 /end AXIS_DESCR
 /begin AXIS_DESCR COM_AXIS maf_knk _CNV_A_R_LINEAR_____27_CM 4 0. 1389. FORMAT "%4.0" AXIS_PTS_REF ldpm_maf_1_9 /end AXIS_DESCR
/end CHARACTERISTIC
/begin CHARACTERISTIC ip_knkwb_0__n__maf "Beginning of Measurement Window Cyl.1" MAP 0xffe4bca2 _REC_MAP_20_u2_u1_u1 108. _CNV_A_R_LINEAR_____82_CM 0. 108. DISPLAY_IDENTIFIER IP_KNKWB_0__N__MAF FORMAT "%5.1"
 /begin AXIS_DESCR COM_AXIS n_knk _CNV_A_R_LINEAR_____15_CM 10 0. 8160. FORMAT "%4.0" AXIS_PTS_REF ldpm_n_knkwb /end AXIS_DESCR
 /begin AXIS_DESCR COM_AXIS maf_knk _CNV_A_R_LINEAR_____27_CM 4 0. 1389. FORMAT "%4.0" AXIS_PTS_REF ldpm_maf_knkwb /end AXIS_DESCR
/end CHARACTERISTIC
/begin CHARACTERISTIC c_vls_down_mmv_hys_min "Minimum hysteresis for the computation of the thresholds VLS_DOWN_TOL_i and VLS_DOWN_BOL_i" VALUE 0xffe41b64 _REC_VAL_20_u2 1. _CNV_A_R_LINEAR_____296_CM 0. 1. DISPLAY_IDENTIFIER C_VLS_DOWN_MMV_HYS_MIN FORMAT "%7.5" /end CHARACTERISTIC
/begin CHARACTERISTIC c_vls_down_ini_min "Lower initialisation value for VLS_DOWN_TOL_i. VLS_DOWN_MMV_MIN_i" VALUE 0xffe41b56 _REC_VAL_20_u2 4.99511719 _CNV_A_R_LINEAR_____3_CM 0. 4.99511719 DISPLAY_IDENTIFIER C_VLS_DOWN_INI_MIN FORMAT "%5.3" /end CHARACTERISTIC
/begin CHARACTERISTIC c_vls_down_ini_max "Upper initialisation value for VLS_DOWN_BOL_i. VLS_DOWN_MMV_MAX_i" VALUE 0xffe41b54 _REC_VAL_20_u2 4.99511719 _CNV_A_R_LINEAR_____3_CM 0. 4.99511719 DISPLAY_IDENTIFIER C_VLS_DOWN_INI_MAX FORMAT "%5.3" /end CHARACTERISTIC
/begin CHARACTERISTIC c_vls_down_crlc "Filter constant for determination of VLS_DOWN_MMV_xxx_i values when respective threshold passed" VALUE 0xffe41b4c _REC_VAL_20_u2 0.99998474 _CNV_A_R_LINEAR_____632_CM 0. 0.99998474 DISPLAY_IDENTIFIER C_VLS_DOWN_CRLC FORMAT "%7.5" /end CHARACTERISTIC
/begin CHARACTERISTIC c_vls_down_crlc_off "Filter constant for determination of VLS_DOWN_MMV_xxx_i values when respective threshold not passed" VALUE 0xffe41b4e _REC_VAL_20_u2 0.99998474 _CNV_A_R_LINEAR_____632_CM 0. 0.99998474 DISPLAY_IDENTIFIER C_VLS_DOWN_CRLC_OFF FORMAT "%7.5" /end CHARACTERISTIC
/begin CHARACTERISTIC c_fac_vls_down_mmv_hys "Multiplicative factor governing amplitude of hysteresis" VALUE 0xffe40751 _REC_VAL_20_u1 0.99610001 _CNV_A_R_LINEAR_____633_CM 0. 0.99610001 DISPLAY_IDENTIFIER C_FAC_VLS_DOWN_MMV_HYS FORMAT "%5.3" /end CHARACTERISTIC
/begin CHARACTERISTIC c_t_dly_puc_end_vls_down "Delay between completion of engine state PUC and computation of VLS_DOWN_MMV_xxx_i" VALUE 0xffe4088f _REC_VAL_20_u1 25.5 _CNV_A_R_LINEAR_____24_CM 0. 25.5 DISPLAY_IDENTIFIER C_T_DLY_PUC_END_VLS_DOWN FORMAT "%4.1" /end CHARACTERISTIC
/begin COMPU_METHOD _CNV_A_R_LINEAR_____0_CM "" RAT_FUNC "%6.3" "-" COEFFS 0 1. 0. 0 0 1 /end COMPU_METHOD
/begin COMPU_METHOD _CNV_S_2_RANGE______2_CM "" TAB_VERB "%6.3" "[-]" COMPU_TAB_REF _CNV_S_2_RANGE______2 /end COMPU_METHOD
/begin COMPU_VTAB _CNV_S_2_RANGE______2 "" TAB_VERB 2 0 "0" 1 "1" /end COMPU_VTAB
/begin COMPU_METHOD _CNV_A_R_LINEAR_____3_CM "" RAT_FUNC "%6.3" "V" COEFFS 0 204.7999998974999 0. 0 0 1 /end COMPU_METHOD
/begin COMPU_METHOD _CNV_A_R_LINEAR_____4_CM "" RAT_FUNC "%6.3" "s" COEFFS 0 100. 0. 0 0 1 /end COMPU_METHOD
/begin COMPU_METHOD _CNV_A_R_LINEAR_____6_CM "" RAT_FUNC "%6.3" "°C" COEFFS 0 16. 0. 0 0 1 /end COMPU_METHOD
/begin COMPU_METHOD _CNV_A_R_LINEAR_____8_CM "" RAT_FUNC "%6.3" "%" COEFFS 0 655.3600000071681 0. 0 0 1 /end COMPU_METHOD
/begin COMPU_METHOD _CNV_A_R_LINEAR_____9_CM "" RAT_FUNC "%6.3" "%" COEFFS 0 2.56 0. 0 0 1 /end COMPU_METHOD
/begin COMPU_METHOD _CNV_A_R_LINEAR_____10_CM "" RAT_FUNC "%6.3" "rpm" COEFFS 0 1. 0. 0 0 1 /end COMPU_METHOD
/begin COMPU_METHOD _CNV_A_R_LINEAR_____11_CM "" RAT_FUNC "%6.3" "°C" COEFFS 0 1.333333333333333 64. 0 0 1 /end COMPU_METHOD
/begin COMPU_METHOD _CNV_A_R_LINEAR_____14_CM "" RAT_FUNC "%6.3" "°C" COEFFS 0 1. 40. 0 0 1 /end COMPU_METHOD
/begin COMPU_METHOD _CNV_A_R_LINEAR_____15_CM "" RAT_FUNC "%6.3" "rpm" COEFFS 0 3.125e-002 0. 0 0 1 /end COMPU_METHOD
/begin COMPU_METHOD _CNV_A_R_LINEAR_____20_CM "" RAT_FUNC "%6.3" "-" COEFFS 0 32768.00003968061 0. 0 0 1 /end COMPU_METHOD
/begin COMPU_METHOD _CNV_S_2_RANGE______21_CM "" TAB_VERB "%6.3" "-" COMPU_TAB_REF _CNV_S_2_RANGE______21 /end COMPU_METHOD
/begin COMPU_VTAB _CNV_S_2_RANGE______21 "" TAB_VERB 2 0 "0" 1 "1" /end COMPU_VTAB
/begin COMPU_METHOD _CNV_A_R_LINEAR_____23_CM "" RAT_FUNC "%6.3" "km/h" COEFFS 0 1. 0. 0 0 1 /end COMPU_METHOD
/begin COMPU_METHOD _CNV_A_R_LINEAR_____24_CM "" RAT_FUNC "%6.3" "s" COEFFS 0 10. 0. 0 0 1 /end COMPU_METHOD
/begin COMPU_METHOD _CNV_A_R_LINEAR_____27_CM "" RAT_FUNC "%6.3" "mg/stk" COEFFS 0 0.183585313174946 0. 0 0 1 /end COMPU_METHOD
/begin COMPU_METHOD _CNV_A_R_LINEAR_____29_CM "" RAT_FUNC "%6.3" "-" COEFFS 0 255.9983911655618 0. 0 0 1 /end COMPU_METHOD
/begin COMPU_METHOD _CNV_A_R_LINEAR_____30_CM "" RAT_FUNC "%6.3" "s" COEFFS 0 1. 0. 0 0 1 /end COMPU_METHOD
/begin COMPU_METHOD _CNV_A_R_LINEAR_____34_CM "" RAT_FUNC "%6.3" "V" COEFFS 0 9.846168103048838 0. 0 0 1 /end COMPU_METHOD
/begin COMPU_METHOD _CNV_A_R_LINEAR_____37_CM "" RAT_FUNC "%6.3" "-" COEFFS 0 65536.00007936121 0. 0 0 1 /end COMPU_METHOD
/begin COMPU_METHOD _CNV_A_R_LINEAR_____39_CM "" RAT_FUNC "%6.3" "-" COEFFS 0 127.9991955827809 0. 0 0 1 /end COMPU_METHOD
/begin COMPU_METHOD _CNV_A_R_LINEAR_____44_CM "" RAT_FUNC "%6.3" "V" COEFFS 0 51.0204081632653 0. 0 0 1 /end COMPU_METHOD
/begin COMPU_METHOD _CNV_A_R_LINEAR_____49_CM "" RAT_FUNC "%6.3" "hPa" COEFFS 0 12.06017666543982 0. 0 0 1 /end COMPU_METHOD
/begin COMPU_METHOD _CNV_A_R_LINEAR_____50_CM "" RAT_FUNC "%6.3" "[-]" COEFFS 0 255.9999357490357 0. 0 0 1 /end COMPU_METHOD
/begin COMPU_METHOD _CNV_A_R_LINEAR_____51_CM "" RAT_FUNC "%6.3" "rpm/s" COEFFS 0 3.125e-002 0. 0 0 1 /end COMPU_METHOD
/begin COMPU_METHOD _CNV_A_R_LINEAR_____52_CM "" RAT_FUNC "%6.3" "°TPS/s" COEFFS 0 8.535564853556485e-002 0. 0 0 1 /end COMPU_METHOD
/begin COMPU_METHOD _CNV_A_R_LINEAR_____55_CM "" RAT_FUNC "%6.3" "Nm" COEFFS 0 32. 0. 0 0 1 /end COMPU_METHOD
/begin COMPU_METHOD _CNV_A_R_LINEAR_____82_CM "" RAT_FUNC "%6.3" "°CRK" COEFFS 0 2.666666666666667 0. 0 0 1 /end COMPU_METHOD
/begin COMPU_METHOD _CNV_A_R_LINEAR_____88_CM "" RAT_FUNC "%6.3" "km" COEFFS 0 0.1 0. 0 0 1 /end COMPU_METHOD
/begin COMPU_METHOD _CNV_A_R_LINEAR_____108_CM "" RAT_FUNC "%6.3" "mg/stk" COEFFS 0 47.18142548596112 0. 0 0 1 /end COMPU_METHOD
/begin COMPU_METHOD _CNV_A_R_LINEAR_____117_CM "" RAT_FUNC "%6.3" "-" COEFFS 0 128. 0. 0 0 1 /end COMPU_METHOD
/begin COMPU_METHOD _CNV_A_R_LINEAR_____127_CM "" RAT_FUNC "%6.3" "-" COEFFS 0 16383.75 0. 0 0 1 /end COMPU_METHOD
/begin COMPU_METHOD _CNV_A_R_LINEAR_____129_CM "" RAT_FUNC "%6.3" "[-]" COEFFS 0 64. 0. 0 0 1 /end COMPU_METHOD
/begin COMPU_METHOD _CNV_A_R_LINEAR_____138_CM "" RAT_FUNC "%6.3" "-" COEFFS 0 2.666666666666667 0. 0 0 1 /end COMPU_METHOD
/begin COMPU_METHOD _CNV_A_R_LINEAR_____165_CM "" RAT_FUNC "%6.3" "ms" COEFFS 0 250. 0. 0 0 1 /end COMPU_METHOD
/begin COMPU_METHOD _CNV_A_R_LINEAR_____185_CM "" RAT_FUNC "%6.3" "Seg" COEFFS 0 1. 0. 0 0 1 /end COMPU_METHOD
/begin COMPU_METHOD _CNV_A_R_LINEAR_____187_CM "" RAT_FUNC "%6.3" "Nm" COEFFS 0 32. 32768. 0 0 1 /end COMPU_METHOD
/begin COMPU_METHOD _CNV_A_R_LINEAR_____199_CM "" RAT_FUNC "%6.3" "hPa" COEFFS 0 0.3768805207949945 0. 0 0 1 /end COMPU_METHOD
/begin COMPU_METHOD _CNV_A_R_LINEAR_____203_CM "" RAT_FUNC "%6.3" "°CRK" COEFFS 0 2.666666666666667 95. 0 0 1 /end COMPU_METHOD
/begin COMPU_METHOD _CNV_A_R_LINEAR_____204_CM "" RAT_FUNC "%6.3" "°CRK" COEFFS 0 -2.666666666666667 0. 0 0 1 /end COMPU_METHOD
/begin COMPU_METHOD _CNV_A_R_LINEAR_____205_CM "" RAT_FUNC "%6.3" "°CRK" COEFFS 0 2.666666666666667 128. 0 0 1 /end COMPU_METHOD
/begin COMPU_METHOD _CNV_A_R_LINEAR_____206_CM "" RAT_FUNC "%6.3" "-" COEFFS 0 1023.999999919998 0. 0 0 1 /end COMPU_METHOD
/begin COMPU_METHOD _CNV_A_R_LINEAR_____209_CM "" RAT_FUNC "%6.3" "-" COEFFS 0 128. 128. 0 0 1 /end COMPU_METHOD
/begin COMPU_METHOD _CNV_A_R_LINEAR_____210_CM "" RAT_FUNC "%6.3" "°PORT" COEFFS 0 655.3600000071681 0. 0 0 1 /end COMPU_METHOD
/begin COMPU_METHOD _CNV_A_R_LINEAR_____228_CM "" RAT_FUNC "%6.3" "°CRK" COEFFS 0 42.66666666666666 0. 0 0 1 /end COMPU_METHOD
/begin COMPU_METHOD _CNV_A_R_LINEAR_____236_CM "" RAT_FUNC "%6.3" "-" COEFFS 0 32. 0. 0 0 1 /end COMPU_METHOD
/begin COMPU_METHOD _CNV_A_R_LINEAR_____250_CM "" RAT_FUNC "%6.3" "°CRK" COEFFS 0 1. 0. 0 0 1 /end COMPU_METHOD
/begin COMPU_METHOD _CNV_A_R_LINEAR_____251_CM "" RAT_FUNC "%6.3" "-" COEFFS 0 682.6666665599934 2.560156259323598e-006 0 0 1 /end COMPU_METHOD
/begin COMPU_METHOD _CNV_A_R_LINEAR_____252_CM "" RAT_FUNC "%6.3" "V" COEFFS 0 13107.19998965744 0. 0 0 1 /end COMPU_METHOD
/begin COMPU_METHOD _CNV_A_R_LINEAR_____253_CM "" RAT_FUNC "%6.3" "°CRK/wcyc" COEFFS 0 64. 0. 0 0 1 /end COMPU_METHOD
/begin COMPU_METHOD _CNV_A_R_LINEAR_____254_CM "" RAT_FUNC "%6.3" "°CRK/wcyc" COEFFS 0 10.66666666666667 0. 0 0 1 /end COMPU_METHOD
/begin COMPU_METHOD _CNV_A_R_LINEAR_____255_CM "" RAT_FUNC "%6.3" "°CRK" COEFFS 0 682.6456692913386 7.874015748029706e-003 0 0 1 /end COMPU_METHOD
/begin COMPU_METHOD _CNV_A_R_LINEAR_____256_CM "" RAT_FUNC "%6.3" "V" COEFFS 0 50. 128. 0 0 1 /end COMPU_METHOD
/begin COMPU_METHOD _CNV_A_R_LINEAR_____257_CM "" RAT_FUNC "%6.3" "mg/stk" COEFFS 0 47.18214541280769 -1.080506262951531e-005 0 0 1 /end COMPU_METHOD
/begin COMPU_METHOD _CNV_A_R_LINEAR_____258_CM "" RAT_FUNC "%6.3" "*wcyc" COEFFS 0 1. 0. 0 0 1 /end COMPU_METHOD
/begin COMPU_METHOD _CNV_S_6_STATE_IGA__259_CM "" TAB_VERB "%6.3" "[-]" COMPU_TAB_REF _CNV_S_6_STATE_IGA__259 /end COMPU_METHOD
/begin COMPU_VTAB _CNV_S_6_STATE_IGA__259 "" TAB_VERB 6 0 "INIT" 1 "TRIGGER" 2 "DELAY" 3 "ACTIVE" 4 "RAMP" 5 "WAIT" /end COMPU_VTAB
/begin COMPU_METHOD _CNV_A_R_LINEAR_____260_CM "" RAT_FUNC "%6.3" "hPa/ms" COEFFS 0 395.2653799758745 -0.5 0 0 1 /end COMPU_METHOD
/begin COMPU_METHOD _CNV_A_R_LINEAR_____261_CM "" RAT_FUNC "%6.3" "°CRK/wcyc" COEFFS 0 682.6666665599934 2.560156259323598e-006 0 0 1 /end COMPU_METHOD
/begin COMPU_METHOD _CNV_A_R_LINEAR_____277_CM "" RAT_FUNC "%6.3" "[-]" COEFFS 0 1023.999999959999 32767.99999871998 0 0 1 /end COMPU_METHOD
/begin COMPU_METHOD _CNV_A_R_LINEAR_____282_CM "" RAT_FUNC "%6.3" "-" COEFFS 0 16383.96875 0. 0 0 1 /end COMPU_METHOD
/begin COMPU_METHOD _CNV_A_R_LINEAR_____296_CM "" RAT_FUNC "%6.3" "V" COEFFS 0 13107. 0. 0 0 1 /end COMPU_METHOD
/begin COMPU_METHOD _CNV_A_R_LINEAR_____326_CM "" RAT_FUNC "%6.3" "V" COEFFS 0 9.807692307692308 -9.615384615372591e-003 0 0 1 /end COMPU_METHOD
/begin COMPU_METHOD _CNV_S_6_STATE_LSH__336_CM "" TAB_VERB "%6.3" "[-]" COMPU_TAB_REF _CNV_S_6_STATE_LSH__336 /end COMPU_METHOD
/begin COMPU_VTAB _CNV_S_6_STATE_LSH__336 "" TAB_VERB 6 0 "LSH_OFF_DOWN" 1 "PREHEATING_DOWN" 2 "LSH_POW_RED_DOWN" 3 "HEATING_GRD_DOWN" 4 "HEATING_DOWN" 5 "VB_PROTECTION_DOWN" /end COMPU_VTAB
/begin COMPU_METHOD _CNV_A_R_LINEAR_____351_CM "" RAT_FUNC "%6.3" "[-]" COEFFS 0 1024.000014000427 16384.00022400684 0 0 1 /end COMPU_METHOD
/begin COMPU_METHOD _CNV_A_R_LINEAR_____360_CM "" RAT_FUNC "%6.3" "ms" COEFFS 0 250. 32768. 0 0 1 /end COMPU_METHOD
/begin COMPU_METHOD _CNV_A_R_LINEAR_____368_CM "" RAT_FUNC "%6.3" "°C" COEFFS 0 15.99999804684544 32767.99599993945 0 0 1 /end COMPU_METHOD
/begin COMPU_METHOD _CNV_A_R_LINEAR_____396_CM "" RAT_FUNC "%6.3" "°CRK" COEFFS 0 42.66666666666666 32768. 0 0 1 /end COMPU_METHOD
/begin COMPU_METHOD _CNV_A_R_LINEAR_____404_CM "" RAT_FUNC "%6.3" "-" COEFFS 0 524280. 0. 0 0 1 /end COMPU_METHOD
/begin COMPU_METHOD _CNV_A_R_LINEAR_____441_CM "" RAT_FUNC "%6.3" "-" COEFFS 0 2. 0. 0 0 1 /end COMPU_METHOD
/begin COMPU_METHOD _CNV_A_R_LINEAR_____491_CM "" RAT_FUNC "%6.3" "-" COEFFS 0 4095.999999839998 0. 0 0 1 /end COMPU_METHOD
/begin COMPU_METHOD _CNV_A_R_LINEAR_____494_CM "" RAT_FUNC "%6.3" "mm" COEFFS 0 1000. 0. 0 0 1 /end COMPU_METHOD
/begin COMPU_METHOD _CNV_A_R_LINEAR_____541_CM "" RAT_FUNC "%6.3" "-" COEFFS 0 0.5 0. 0 0 1 /end COMPU_METHOD
/begin COMPU_METHOD _CNV_A_R_LINEAR_____632_CM "" RAT_FUNC "%6.3" "V" COEFFS 0 65536.00007936121 0. 0 0 1 /end COMPU_METHOD
/begin COMPU_METHOD _CNV_A_R_LINEAR_____633_CM "" RAT_FUNC "%6.3" "V" COEFFS 0 255.9983911655618 0. 0 0 1 /end COMPU_METHOD
/begin RECORD_LAYOUT _REC_VAL_20_u1 FNC_VALUES 1 UBYTE COLUMN_DIR DIRECT /end RECORD_LAYOUT
/begin RECORD_LAYOUT _REC_VAL_20_u2 FNC_VALUES 1 UWORD COLUMN_DIR DIRECT /end RECORD_LAYOUT
/begin RECORD_LAYOUT _REC_CUR_20_u2_u1 FNC_VALUES 1 UWORD COLUMN_DIR DIRECT /end RECORD_LAYOUT
/begin RECORD_LAYOUT _REC_AXS_20_u1 NO_AXIS_PTS_X 1 UBYTE AXIS_PTS_X 2 UBYTE INDEX_INCR DIRECT /end RECORD_LAYOUT
/begin RECORD_LAYOUT _REC_MAP_20_u1_u1_u1 FNC_VALUES 1 UBYTE COLUMN_DIR DIRECT /end RECORD_LAYOUT
/begin RECORD_LAYOUT _REC_CUR_20_u1_u1 FNC_VALUES 1 UBYTE COLUMN_DIR DIRECT /end RECORD_LAYOUT
/begin RECORD_LAYOUT _REC_AXS_20_u2 NO_AXIS_PTS_X 1 UWORD AXIS_PTS_X 2 UWORD INDEX_INCR DIRECT /end RECORD_LAYOUT
/begin RECORD_LAYOUT _REC_MAP_20_u1_u1_u2 FNC_VALUES 1 UBYTE COLUMN_DIR DIRECT /end RECORD_LAYOUT
/begin RECORD_LAYOUT _REC_MAP_20_u2_u2_u1 FNC_VALUES 1 UWORD COLUMN_DIR DIRECT /end RECORD_LAYOUT
/begin RECORD_LAYOUT _REC_CUR_20_u1_u2 FNC_VALUES 1 UBYTE COLUMN_DIR DIRECT /end RECORD_LAYOUT
/begin RECORD_LAYOUT _REC_MAP_20_u2_u1_u1 FNC_VALUES 1 UWORD COLUMN_DIR DIRECT /end RECORD_LAYOUT
/begin RECORD_LAYOUT _REC_CUR_20_u2_u2 FNC_VALUES 1 UWORD COLUMN_DIR DIRECT /end RECORD_LAYOUT
/begin RECORD_LAYOUT _REC_VAL_20_s1 FNC_VALUES 1 SBYTE COLUMN_DIR DIRECT /end RECORD_LAYOUT
/begin RECORD_LAYOUT _REC_VAL_20_s2 FNC_VALUES 1 SWORD COLUMN_DIR DIRECT /end RECORD_LAYOUT
/begin RECORD_LAYOUT _REC_MAP_20_u2_u1_u2 FNC_VALUES 1 UWORD COLUMN_DIR DIRECT /end RECORD_LAYOUT
/begin RECORD_LAYOUT _REC_MAP_20_u2_u2_u2 FNC_VALUES 1 UWORD COLUMN_DIR DIRECT /end RECORD_LAYOUT
/begin RECORD_LAYOUT _REC_MAP_20_u1_u2_u1 FNC_VALUES 1 UBYTE COLUMN_DIR DIRECT /end RECORD_LAYOUT
/begin RECORD_LAYOUT _REC_CUR_20_s2_u1 FNC_VALUES 1 SWORD COLUMN_DIR DIRECT /end RECORD_LAYOUT
/begin FUNCTION IGA_KnockControl "_KnockControl"
 /begin DEF_CHARACTERISTIC c_cycnr_ad2_dec_knk ip_maf_min_knk__n__tco id_iga_ad1_knk_size__n__maf id_iga_dec_knk_1__n id_iga_dec_knk_2__n id_maf_min_ad_knk__n id_n_grd_max_knk__n ip_iga_inc_knk__n c_cycnr_ad2_inc_knk c_fac_tra_knk c_iga_ad1_fac_dec_knk c_iga_ad1_fac_fast_knk c_iga_ad1_fac_inc_knk c_iga_ad1_inc_knk c_iga_ad1_lgrd_neg_knk c_iga_ad1_lgrd_pos_knk c_iga_ad1_thd_dec_knk c_iga_ad1_thd_fast_knk c_iga_ad2_max_knk c_iga_ad2_thd_dec_knk c_iga_ad2_thd_inc_knk c_iga_dif_min_max_knk c_iga_lgrd_3 c_maf_iga_hys_knk c_n_iga_hys_knk c_nl_crlc c_nl_crlc_tra c_swi_ad_knk ip_fac_ad_knk_tco__tco id_cycnr_fac_tra_knk__n ip_knkwb_1__n__maf ip_gain_knk_1__n__maf ip_fac_thd_knk_0__n__maf ip_fac_thd_knk_1__n__maf ip_fac_thd_knk_2__n__maf ip_fac_thd_knk_3__n__maf ip_fac_thd_knk_4__n__maf ip_fac_thd_knk_5__n__maf ip_knk_thd_add__n c_nl_min id_maf_dif_tra_knk__n ip_iga_bas_max_knk__n__maf ip_iga_ofs_max_knk__n__maf ip_fac_iga_max_knk__tco__tia c_iga_ad1_thd_inc_knk c_tco_ad1_min_knk c_tco_ad2_min_knk c_tco_ad1_max_knk c_tco_ad2_max_knk ldp_tco__maf_min_knk ldpm_n_3_9 ldp_tco__fac_ad_knk_tco c_knk_thd_max iga_ad1_knk_5__n__maf iga_ad1_knk_4__n__maf iga_ad1_knk_3__n__maf iga_ad1_knk_2__n__maf ldpm_n_iga_ad iga_ad1_knk_1__n__maf iga_ad1_knk_0__n__maf ldpm_maf_iga_ad ldpm_n_knkwb ldpm_maf_knkwb ldpm_n_fil_frq_knk c_maf_min_knk_ad2 id_fil_frq_knk_1__n id_fil_frq_knk_2__n id_fil_frq_knk_3__n id_fil_frq_knk_0__n id_fil_frq_knk_4__n id_fil_frq_knk_5__n ip_knkwb_2__n__maf ip_knkwb_3__n__maf ip_knkwb_4__n__maf ip_knkwb_5__n__maf ip_knkwe_0__n__maf ip_knkwe_1__n__maf ip_knkwe_2__n__maf ip_knkwe_3__n__maf ip_knkwe_4__n__maf ip_knkwe_5__n__maf ip_gain_knk_0__n__maf ip_gain_knk_2__n__maf ip_gain_knk_3__n__maf ip_gain_knk_4__n__maf ip_gain_knk_5__n__maf ip_itc_knk_0__n__maf ip_itc_knk_1__n__maf ip_itc_knk_2__n__maf ip_itc_knk_3__n__maf ip_itc_knk_4__n__maf ip_itc_knk_5__n__maf ip_knkwb_0__n__maf /end DEF_CHARACTERISTIC
 /begin OUT_MEASUREMENT iga_ad1_knk[0] iga_ad1_knk[1] iga_ad1_knk[2] iga_ad1_knk[3] iga_ad1_knk[4] iga_ad1_knk[5] iga_ad2_knk iga_knk[0] iga_knk[1] iga_knk[2] iga_knk[3] iga_knk[4] iga_knk[5] knk_thd[0] knk_thd[1] knk_thd[2] knk_thd[3] knk_thd[4] knk_thd[5] knks_cmd_fil[0] knks_cmd_fil[1] knks_cmd_fil[2] knks_cmd_fil[3] knks_cmd_fil[4] knks_cmd_fil[5] knkwb[0] knkwb[1] knkwb[2] knkwb[3] knkwb[4] knkwb[5] knkwe[0] knkwe[1] knkwe[2] knkwe[3] knkwe[4] knkwe[5] lv_knk_ad1_ena lv_knk_ad2_ena lv_knk_ctl_ena lv_knk_tra_maf maf_knk n_knk nl[0] nl[1] nl[2] nl[3] nl[4] nl[5] lv_knk_tra_n iga_adj_knk[0] iga_adj_knk[1] iga_adj_knk[2] iga_adj_knk[3] iga_adj_knk[4] iga_adj_knk[5] iga_adj_max_knk dly_iga_adj_knk_diag iga_mv_adj_knk cyl_id_knk lv_knk iga_mv_knk fac_iga_max_knk knks_cmd_gain[0] knks_cmd_gain[1] knks_cmd_gain[2] knks_cmd_gain[3] knks_cmd_gain[4] knks_cmd_gain[5] knks_cmd_int[0] knks_cmd_int[1] knks_cmd_int[2] knks_cmd_int[3] knks_cmd_int[4] knks_cmd_int[5] iga_ad1_ad2_knk[0] iga_ad1_ad2_knk[1] iga_ad1_ad2_knk[2] iga_ad1_ad2_knk[3] iga_ad1_ad2_knk[4] iga_ad1_ad2_knk[5] knk_ctl_dis lv_knk_ad_rd_ena knk_ad1_dis knk_ad2_dis knks[0] knks[1] knks[2] knks[3] knks[4] knks[5] /end OUT_MEASUREMENT
/end FUNCTION
/begin FUNCTION IGA_Ignition_angle_for_stratifie "_Ignition angle for stratified mode" /end FUNCTION
/begin FUNCTION IGA_Corrected_Reference_Ignition "_Corrected Reference Ignition Angle"
 /begin DEF_CHARACTERISTIC ip_iga_ref__n__maf ip_iga_ref_lamb__lamb_sp ip_iga_ref_temp__n__maf ip_iga_ref_vvt__n__maf ip_iga_ref_temp_fac__tia__tco ip_iga_ref_egr_fac__n__maf ip_iga_ref_egr ip_fac_iga_ref_port ip_fac_iga_ref_egr_lamb ip_iga_ref_port /end DEF_CHARACTERISTIC
 /begin OUT_MEASUREMENT iga_ref_cor iga_ref_temp_cor iga_ref_vvt_cor iga_ref_egr_cor egr_ratio_cor iga_ref_lamb_cor iga_ref_port_cor /end OUT_MEASUREMENT
/end FUNCTION
/begin FUNCTION IGA_Ignition_angle_correction_du "_Ignition angle correction due to EGR" /end FUNCTION
/begin FUNCTION IGA_Temperature_Correction "_Temperature Correction"
 /begin DEF_CHARACTERISTIC ip_iga_bas_temp_cor__tco__tia ip_fac_iga_pos__n_32__maf ip_fac_iga_neg__n_32__maf /end DEF_CHARACTERISTIC
 /begin OUT_MEASUREMENT iga_bas_temp_cor /end OUT_MEASUREMENT
/end FUNCTION
/begin FUNCTION IGA_Minimum_IGA_limitation_for_e "_Minimum IGA limitation for exhaust gas temperature protection" /begin DEF_CHARACTERISTIC c_teg_max_iga_hys c_teg_max_iga ip_iga_dif_min_teg__teg /end DEF_CHARACTERISTIC
 /begin OUT_MEASUREMENT iga_min_teg iga_dif_min_teg eff_iga_min_teg teg_dyn_hys teg_cat_up_mdl_max /end OUT_MEASUREMENT
/end FUNCTION
/begin FUNCTION IGA_Catalyst_heating_correction "_Catalyst heating correction"
 /begin DEF_CHARACTERISTIC ip_fac_iga_ch_tco ip_iga_ch_cold_is_alter ip_iga_ch_cold_is ip_iga_ch_hot_is_alter ip_iga_ch_hot_is ip_fac_red_ch_mt ip_fac_red_ch_ctr_km ip_fac_red_ch_at ip_fac_red_ch_is ip_fac_red_ch_is_dri ip_crlc_tq_add_ch c_t_deac_ch_tq_add c_t_dri_ch c_t_ch_is_alter c_t_deac_ch_is ip_iga_ch_hot_pl ip_iga_ch_hot_pl_wout_cat ip_iga_ch_cold_pl ip_iga_ch_cold_pl_wout_cat /end DEF_CHARACTERISTIC
 /begin OUT_MEASUREMENT tq_add_ch iga_ch_bas iga_dif_ch_bas eff_iga_ch_bas tq_add_ch_bas fac_red_tq_add_ch fac_deac_ch_dri tq_add_ch_red fac_deac_ch fac_deac_ch_is fac_ch_is_alter /end OUT_MEASUREMENT
/end FUNCTION
/begin FUNCTION IGA_RON_Adaptation "_RON Adaptation"
 /begin DEF_CHARACTERISTIC c_tco_ad_min_ron c_cycnr_ad_rtd_knk c_iga_min_ad c_iga_max_ad c_cycnr_fac_ron c_tco_fac_ron_min c_tco_fac_ron_max c_fac_ron_ad_cold c_fac_ron_ad_hot id_maf_min_knk_ad_2__n_32 ip_fac_ron_inc__n_32 ip_fac_ron_dec__n_32 ip_fac_ron_ad_max__tia__tco /end DEF_CHARACTERISTIC
 /begin OUT_MEASUREMENT fac_ron_ad lv_fac_ron_ad_act /end OUT_MEASUREMENT
/end FUNCTION
/begin FUNCTION IGA_Load_dynamics_correction "_Load dynamics correction"
 /begin DEF_CHARACTERISTIC id_tps_grd_iga_tra_knk id_map_drv1_iga_tra_knk ip_iga_tra_knk ip_fac_iga_tra ip_fac_iga_tra_gear_mt ip_fac_iga_tra_gear_at id_cyc_iga_tra_knk_dly ip_iga_tra_inc id_cyc_iga_tra_knk_act id_cyc_iga_tra_knk_wait c_n_min_iga_tra_cs /end DEF_CHARACTERISTIC
 /begin OUT_MEASUREMENT iga_tra_knk iga_tra_knk_inter lv_iga_tra_knk ctr_cyc_iga_tra_knk_dly ctr_cyc_iga_tra_knk_act ctr_cyc_iga_tra_knk_wait state_iga_tra_knk /end OUT_MEASUREMENT
/end FUNCTION
/begin FUNCTION INJ_Injection "INJ"
 /begin SUB_FUNCTION INJ_General_Calculation_of_Fuel_ INJ_Injection_phase INJ_Start_injection_time_for_sta INJ_Injector_dead_time_correctio INJ_Cold_post_start_correction INJ_Warm_up_correction INJ_Catalyst_heating_correction INJ_High_torque_request_enrichme INJ_Wall_film_correction_TI_ADD_ INJ_Cylinder_shut_off INJ_Downstream_oxygen_sensor_sig INJ_Downstream_oxygen_sensor_hea INJ_Injection_fuel_setpoint_for_ INJ_Injection_pressure_correctio INJ_Lambda_coordination INJ_Lambda_Catalyst_overheating_ INJ_Conversion_MFF_to_TI INJ_Basic_lambda_setpoint INJ_Ambient_pressure_correction INJ_Injection_phase_for_stratifi INJ_Lambda_setpoint_for_catalyst INJ_Injection_press_correction_s INJ_Injection_setpoint_for_strat INJ_Mass_Fuel_Flow_Setpoint_for_ INJ_LAMB_RATIO_calculation INJ_Catalyst_heating_with_second INJ_Injection_Time_Correction_by INJ_Transformation_layer_for_bas INJ_Injection_mode_management INJ_Exhaust_Gas_temperature_mode INJ_Detection_of_dew_point INJ_Cylinder_individual_injectio INJ_Catalyst_enrichment_function INJ_Application_incidences_for_c INJ_Application_Incidences_for_L INJ_Limited_dynamic_for_dynamic_ INJ_Application_for_upstream_oxy INJ_Lambda_Adaptation INJ_WRAF_Sensor_Gain_Adaptation_ INJ_Lambda_stimulation_for_a_lam INJ_Calculation_of_limited_dynam INJ_Operability_detection_for_th INJ_Signal_acquisition_and_compe INJ_Linear_lambda_control INJ_Forced_stimulation_for_a_lam INJ_Upstream_oxygen_sensor_heate INJ_Downstream_fuel_trim_regulat INJ_Lambda_controller_for_a_cont INJ_Application_Incidences_Coord INJ_Coordination_of_the_Injectio INJ_Cylinder_individual_Lambda_C INJ_Application_Incidences_for_t INJ_Start_Pre_Injection INJ_Application_incidences_for_d INJ_Application_Incidences_for_D INJ_MFF_Split_Up_for_DUI_at_Stra INJ_Application_Incidences_Lambd INJ_Application_Incidences_downs INJ_Injection_Phase_for_Stratifi INJ_Application_Incidences_Downs INJ_Restart_function INJ_Detection_of_limited_dynamic INJ_Injection_Pressure_Correctio INJ_Fuel_mass_setpoint_and_pre_i INJ_Injection_at_restart_fuel_fe INJ_Application_incidence_exhaus INJ_Basic_Lambda_Setpoint_includ INJ_Lambda_Setpoint_for_Single_C INJ_Application_incidences_for_i INJ_Application_incidences_for_s INJ_Downstream_oxygen_sensor_ope INJ_Conditioning_of_catalyst_O2_ INJ_Application_Incidences_for_c INJ_Downstream_oxygen_sensor_int INJ_Application_Incidences_for_W INJ_Inhibition_Conditions_for_OB INJ_Application_specific_conditi /end SUB_FUNCTION
/end FUNCTION
/begin FUNCTION INJ_General_Calculation_of_Fuel_ "_General Calculation of Fuel Inj Time"
 /begin DEF_CHARACTERISTIC c_mff_fac ip_ti_st_amp_fac__amp ip_ti_deac_cast__cyc_cast__tco ip_ti_cast__tia__tco ip_ti_add_dly /end DEF_CHARACTERISTIC
 /begin OUT_MEASUREMENT mff_bas ti_cast lv_ast_end mff_sp ti_add_dly /end OUT_MEASUREMENT
/end FUNCTION
/begin FUNCTION INJ_Injection_phase "_Injection phase"
 /begin DEF_CHARACTERISTIC ip_eoi_h_prs_cst ip_eoi_l_prs_cst c_eoi_lim lc_eoi_hom_man c_eoi_hom_man c_soi_min_cst_l_prs c_soi_min_cst_h_prs ip_eoi_tco c_eoi_as lc_eoi_cor_ivvt_vvl ip_cam_op_in_vvl__vlft_av ip_eoi_bas ip_eoi_bas_is /end DEF_CHARACTERISTIC
 /begin OUT_MEASUREMENT soi_hom eoi_hom_clc eoi_tco ti_hom_max_cst eoi_bas eoi_lim cam_op_in_vvl eoi_ivvt_vvl eoi_hom /end OUT_MEASUREMENT
/end FUNCTION
/begin FUNCTION INJ_Start_injection_time_for_sta "_Start injection time for start injection amount" /end FUNCTION
/begin FUNCTION INJ_Injector_dead_time_correctio "_Injector dead time correction" /end FUNCTION
/begin FUNCTION INJ_Cold_post_start_correction "_Cold post start correction" /begin DEF_CHARACTERISTIC ip_ti_cast_fac_tco ip_ti_cast_fac_map /end DEF_CHARACTERISTIC /end FUNCTION
/begin FUNCTION INJ_Warm_up_correction "_Warm up correction"
 /begin DEF_CHARACTERISTIC ip_ti_wup__n__maf ip_ti_tco_wup__tco__tco_st ip_ti_vo_wup__tco__vo ip_ti_fac_n_map ip_ti_fac_tia_toil ip_ti_fac_tco ip_fac_ti_vo_wup ip_fac_ti_tco_wup /end DEF_CHARACTERISTIC
 /begin OUT_MEASUREMENT ti_wup_1 ti_wup ti_temp /end OUT_MEASUREMENT
/end FUNCTION
/begin FUNCTION INJ_Catalyst_heating_correction "_Catalyst heating correction" /begin DEF_CHARACTERISTIC ip_lamb_add_afl_ch ip_lamb_ch_rgl ip_lamb_ch_is /end DEF_CHARACTERISTIC /begin OUT_MEASUREMENT lamb_ch lamb_afl_ch /end OUT_MEASUREMENT /end FUNCTION
/begin FUNCTION INJ_High_torque_request_enrichme "_High torque request enrichment" /begin DEF_CHARACTERISTIC c_lamb_fl_pas ip_lamb_fl__n /end DEF_CHARACTERISTIC /begin OUT_MEASUREMENT lamb_fl /end OUT_MEASUREMENT /end FUNCTION
/begin FUNCTION INJ_Wall_film_correction_TI_ADD_ "_Wall film correction TI_ADD_WF"
 /begin DEF_CHARACTERISTIC c_fac_wf_puc c_ti_crlc_fast_wf_is ip_seg_ctr_fac_wf__seg_ctr_wf ip_ti_dif_wf_thd__tco ip_ti_fac_neg_fast_wf__n__maf ip_ti_fac_neg_slow_wf__n__maf ip_ti_fac_pos_slow_wf__n__maf ip_ti_fast_wf_thd__tib ip_ti_slow_wf_thd__tib ip_ti_tco_neg_fast_wf__n__tco ip_ti_tco_neg_slow_wf__n__tco ip_ti_tco_pos_fast_wf__n__tco ip_ti_tco_pos_slow_wf__n__tco ip_ti_tco_st_fac_wf__tco_st ip_ti_vo_fast_wf__vo c_fac_wf_pu ip_ti_fac_pos_fast_wf__n__maf c_seg_ctr_wf_ini ip_ti_vo_slow_wf__vo ip_ti_vo_maf_sp_wf__vo ip_ti_cor_maf_sp_wf ip_fac_ti_cor_maf_sp_wf_pos ip_fac_ti_cor_maf_sp_wf_neg ip_crlc_pos_maf_sp_wf ip_crlc_neg_maf_sp_wf ip_fac_ti_wf c_t_ti_tra_pas c_thd_maf_sp_wf ip_ti_crlc_pos_slow_wf__n__tco ip_ti_crlc_neg_slow_wf__n__tco ip_ti_crlc_pos_fast_wf__n__tco ip_ti_crlc_neg_fast_wf__n__tco /end DEF_CHARACTERISTIC
 /begin OUT_MEASUREMENT tib mff_add_wf ti_add_reac[0] ti_add_reac[1] ti_add_reac[2] ti_add_reac[3] ti_add_reac[4] ti_add_reac[5] seg_ctr_wf ti_add_wf ti_fast_wf_post_thd ti_slow_wf_post_thd ti_maf_sp_wf /end OUT_MEASUREMENT
/end FUNCTION
/begin FUNCTION INJ_Cylinder_shut_off "_Cylinder shut off" /begin DEF_CHARACTERISTIC id_pat_ind__nr_pat /end DEF_CHARACTERISTIC
 /begin OUT_MEASUREMENT lv_scc inh_cyc_iv inh_iv_igk inh_swi_iv lv_inj_cut lv_ind_fcut inh_iv_fcut inh_iv inh_iv_mon_cut_off inh_iv_kwp lam_bank_1.inj_iv_cut.lv_scc lam_bank_2.inj_iv_cut.lv_scc inh_iv_amt /end OUT_MEASUREMENT
/end FUNCTION
/begin FUNCTION INJ_Downstream_oxygen_sensor_sig "_Downstream oxygen sensor signal voltage"
 /begin DEF_CHARACTERISTIC c_vls_down_mmv_hys_min c_vls_down_ini_min c_vls_down_ini_max c_vls_down_crlc c_vls_down_crlc_off c_fac_vls_down_mmv_hys c_t_dly_puc_end_vls_down /end DEF_CHARACTERISTIC
/end FUNCTION
/begin FUNCTION INJ_Downstream_oxygen_sensor_hea "_Downstream oxygen sensor heater managment LSH_DOWN"
 /begin DEF_CHARACTERISTIC c_v_efc_lsh_down_tol c_v_efc_lsh_down_max c_v_efc_lsh_down_prot c_t_lsh_down_tol c_v_efc_lsh_down_lim c_v_efc_lsh_down_as ip_v_efc_lsh_down_ctl ip_v_efc_lsh_down_ini ip_t_lsh_down_temp_thd ip_fac_v_efc_down_teg c_dec_v_efc_down c_inc_v_efc_down c_v_efc_down_red c_t_lsh_down_lim c_t_lsh_down_rise c_vb_prot_down_max c_v_efc_lsh_down_step c_t_lshpwm_down_fast_vb_cor c_fac_v_efc_lsh_down_as /end DEF_CHARACTERISTIC
 /begin OUT_MEASUREMENT lam_bank_1.lsh_down.lshpwm_down lam_bank_1.lsh_down.t_lsh_down lam_bank_1.lsh_down.v_efc_lsh_down lam_bank_1.lsh_down.t_lsh_down_tol lam_bank_1.lsh_down.t_lsh_down_lim lam_bank_1.lsh_down.state_lsh_down lam_bank_2.lsh_down.lshpwm_down lam_bank_2.lsh_down.t_lsh_down lam_bank_2.lsh_down.v_efc_lsh_down lam_bank_2.lsh_down.t_lsh_down_tol lam_bank_2.lsh_down.t_lsh_down_lim lam_bank_2.lsh_down.state_lsh_down /end OUT_MEASUREMENT
/end FUNCTION
/begin FUNCTION INJ_Injection_fuel_setpoint_for_ "_Injection fuel setpoint for homogeneous mode"
 /begin DEF_CHARACTERISTIC c_mff_sp_man c_mff_sp_hom_ofs_as ip_mff_cor_2 ip_mff_cor_1 lc_mff_sp_hom_man_act ip_mff_lgrd_ast /end DEF_CHARACTERISTIC
 /begin OUT_MEASUREMENT mff_sp_clc_1 mff_sp_clc_2 mff_sp_hom_eng_1 mff_sp_hom_eng_2 mff_sp_hom[0] mff_sp_hom[1] ti_st_amp /end OUT_MEASUREMENT
/end FUNCTION
/begin FUNCTION INJ_Injection_pressure_correctio "_Injection pressure correction" /begin DEF_CHARACTERISTIC c_ti_hom_man lc_ti_hom_man_act /end DEF_CHARACTERISTIC
 /begin OUT_MEASUREMENT ti_hom_2 ti_hom_1 lv_ti_lim_min fac_ti_prs[0] fac_ti_prs[1] prs_inj_mv[0] prs_inj_mv[1] prs_dec_inj[0] prs_dec_inj[1] ti_stnd_hom[0] ti_stnd_hom[1] ti_hom_clc[0] ti_hom_clc[1] crk_inj[0] crk_inj[1] /end OUT_MEASUREMENT
/end FUNCTION
/begin FUNCTION INJ_Lambda_coordination "_Lambda coordination"
 /begin DEF_CHARACTERISTIC c_lamb_sp_1_hys c_lamb_sp_ofs_as lc_lamb_sp_man_act c_lamb_bas_cor_min c_lamb_sp_man /end DEF_CHARACTERISTIC
 /begin OUT_MEASUREMENT lam_bank_1.lamb_sp.lamb_bas_cor lam_bank_1.lamb_sp.lamb_sp lam_bank_1.lamb_sp.lamb_sp_bas lam_bank_1.lamb_sp.lamb_bas_cor_1_h_res lam_bank_1.lamb_sp.lamb_sp_h_res lam_bank_1.lamb_sp.lv_lamb_sp_1 lam_bank_2.lamb_sp.lamb_bas_cor lam_bank_2.lamb_sp.lamb_sp lam_bank_2.lamb_sp.lamb_sp_bas lam_bank_2.lamb_sp.lamb_bas_cor_1_h_res lam_bank_2.lamb_sp.lamb_sp_h_res lam_bank_2.lamb_sp.lv_lamb_sp_1 lamb_bas_cor lamb_sp lamb_sp_bas /end OUT_MEASUREMENT
/end FUNCTION
/end MODULE
/end PROJECT
