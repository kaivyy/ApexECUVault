ASAP2_VERSION 1 41
/begin PROJECT MSD70 "Spray Guided DI-System with Piezo Injectors for 6-Cylinder"
/begin HEADER "_default_HeaderComment" PROJECT_NO _0B /end HEADER
/begin MODULE _default_ModuleName "_default_ModuleLongIdentifier"
/begin MOD_COMMON "_default_ModCommonComment" DEPOSIT ABSOLUTE BYTE_ORDER MSB_LAST ALIGNMENT_BYTE 1 ALIGNMENT_WORD 2 ALIGNMENT_LONG 2 ALIGNMENT_FLOAT32_IEEE 2 ALIGNMENT_FLOAT64_IEEE 4 /end MOD_COMMON
/begin MEASUREMENT lv_asr_plaus "Logical variable plausibility ASR" UBYTE _CNV_S_2_RANGE__0___1_CM 1 100. 0. 1. DISPLAY_IDENTIFIER LV_ASR_PLAUS ECU_ADDRESS 0xd0003700 BIT_MASK 0x1 /end MEASUREMENT
/begin MEASUREMENT lv_msr_plaus "Logical variable plausibility MSR" UBYTE _CNV_S_2_RANGE__0___1_CM 1 100. 0. 1. DISPLAY_IDENTIFIER LV_MSR_PLAUS ECU_ADDRESS 0xd0003701 BIT_MASK 0x1 /end MEASUREMENT
/begin MEASUREMENT iga_av_h_rng_s[0] "Ignition angle applied on cylinder CYL in stratified cumbustion" SWORD _CNV_A_R_LINEAR_____166_CM 1 100. -90. 90. DISPLAY_IDENTIFIER IGA_AV_H_RNG_S[0] ECU_ADDRESS 0xd00050ec FORMAT "%8.4" /end MEASUREMENT
/begin MEASUREMENT iga_av_h_rng_s[1] "Ignition angle applied on cylinder CYL in stratified cumbustion" SWORD _CNV_A_R_LINEAR_____166_CM 1 100. -90. 90. DISPLAY_IDENTIFIER IGA_AV_H_RNG_S[1] ECU_ADDRESS 0xd00050ee FORMAT "%8.4" /end MEASUREMENT
/begin MEASUREMENT iga_av_h_rng_s[2] "Ignition angle applied on cylinder CYL in stratified cumbustion" SWORD _CNV_A_R_LINEAR_____166_CM 1 100. -90. 90. DISPLAY_IDENTIFIER IGA_AV_H_RNG_S[2] ECU_ADDRESS 0xd00050f0 FORMAT "%8.4" /end MEASUREMENT
/begin MEASUREMENT iga_av_h_rng_s[3] "Ignition angle applied on cylinder CYL in stratified cumbustion" SWORD _CNV_A_R_LINEAR_____166_CM 1 100. -90. 90. DISPLAY_IDENTIFIER IGA_AV_H_RNG_S[3] ECU_ADDRESS 0xd00050f2 FORMAT "%8.4" /end MEASUREMENT
/begin MEASUREMENT iga_av_h_rng_s[4] "Ignition angle applied on cylinder CYL in stratified cumbustion" SWORD _CNV_A_R_LINEAR_____166_CM 1 100. -90. 90. DISPLAY_IDENTIFIER IGA_AV_H_RNG_S[4] ECU_ADDRESS 0xd00050f4 FORMAT "%8.4" /end MEASUREMENT
/begin MEASUREMENT iga_av_h_rng_s[5] "Ignition angle applied on cylinder CYL in stratified cumbustion" SWORD _CNV_A_R_LINEAR_____166_CM 1 100. -90. 90. DISPLAY_IDENTIFIER IGA_AV_H_RNG_S[5] ECU_ADDRESS 0xd00050f6 FORMAT "%8.4" /end MEASUREMENT
/begin MEASUREMENT iga_igc_s[0] "Ignition angle applied on cylinder CYL in stratified cumbustion" UBYTE _CNV_A_R_LINEAR_____167_CM 1 100. -35.625 60. DISPLAY_IDENTIFIER IGA_IGC_S[0] ECU_ADDRESS 0xd0003d1a FORMAT "%5.1" /end MEASUREMENT
/begin MEASUREMENT iga_igc_s[1] "Ignition angle applied on cylinder CYL in stratified cumbustion" UBYTE _CNV_A_R_LINEAR_____167_CM 1 100. -35.625 60. DISPLAY_IDENTIFIER IGA_IGC_S[1] ECU_ADDRESS 0xd0003d1b FORMAT "%5.1" /end MEASUREMENT
/begin MEASUREMENT iga_igc_s[2] "Ignition angle applied on cylinder CYL in stratified cumbustion" UBYTE _CNV_A_R_LINEAR_____167_CM 1 100. -35.625 60. DISPLAY_IDENTIFIER IGA_IGC_S[2] ECU_ADDRESS 0xd0003d1c FORMAT "%5.1" /end MEASUREMENT
/begin MEASUREMENT iga_igc_s[3] "Ignition angle applied on cylinder CYL in stratified cumbustion" UBYTE _CNV_A_R_LINEAR_____167_CM 1 100. -35.625 60. DISPLAY_IDENTIFIER IGA_IGC_S[3] ECU_ADDRESS 0xd0003d1d FORMAT "%5.1" /end MEASUREMENT
/begin MEASUREMENT iga_igc_s[4] "Ignition angle applied on cylinder CYL in stratified cumbustion" UBYTE _CNV_A_R_LINEAR_____167_CM 1 100. -35.625 60. DISPLAY_IDENTIFIER IGA_IGC_S[4] ECU_ADDRESS 0xd0003d1e FORMAT "%5.1" /end MEASUREMENT
/begin MEASUREMENT iga_igc_s[5] "Ignition angle applied on cylinder CYL in stratified cumbustion" UBYTE _CNV_A_R_LINEAR_____167_CM 1 100. -35.625 60. DISPLAY_IDENTIFIER IGA_IGC_S[5] ECU_ADDRESS 0xd0003d1f FORMAT "%5.1" /end MEASUREMENT
/begin MEASUREMENT lam_bank_1.lam_up.bf.lv_lscl "activation flag of lambda control" ULONG _CNV_S_2_RANGE______75_CM 1 100. 0. 1. DISPLAY_IDENTIFIER LV_LSCL_1 ECU_ADDRESS 0xd0005608 BIT_MASK 0x1 /end MEASUREMENT
/begin MEASUREMENT lam_bank_1.lam_up.bf.lv_lam_cor_lim_intr "the sum output signal is limited under non-stationary operating conditions (threshold exceeded)						" ULONG _CNV_S_2_RANGE______75_CM 1 100. 0. 1. DISPLAY_IDENTIFIER LV_LAM_COR_LIM_INTR_1 ECU_ADDRESS 0xd0005608 BIT_MASK 0x2 /end MEASUREMENT
/begin MEASUREMENT lam_bank_1.lam_up.ti_lam_cor "controller output signal in consideration of the canister purge function and lambda adaptation" SWORD _CNV_A_R_LINEAR_____110_CM 1 100. -50. 49.9984741210938 DISPLAY_IDENTIFIER TI_LAM_COR_1 ECU_ADDRESS 0xd000560e FORMAT "%6.2" /end MEASUREMENT
/begin MEASUREMENT lam_bank_1.lam_up.ti_lam_fac "limited lambda controller oiutput plus pre control correction" SWORD _CNV_A_R_LINEAR_____110_CM 1 100. -50. 49.9984741210938 DISPLAY_IDENTIFIER TI_LAM_FAC_1 ECU_ADDRESS 0xd0005612 FORMAT "%6.2" /end MEASUREMENT
/begin MEASUREMENT lam_bank_1.lam_up.lamb_dif "controller difference" SWORD _CNV_A_R_LINEAR_____200_CM 1 100. -1. 0.99996948 DISPLAY_IDENTIFIER LAMB_DIF_1 ECU_ADDRESS 0xd000560a FORMAT "%8.5" /end MEASUREMENT
/begin MEASUREMENT lam_bank_1.lam_up.lamb "Lambda signal value of the WRAF sensor of exhast bank" UWORD _CNV_A_R_LINEAR_____122_CM 1 100. 0. 31.9990234375 DISPLAY_IDENTIFIER LAMB_1 ECU_ADDRESS 0xd000560c FORMAT "%7.4" /end MEASUREMENT
/begin MEASUREMENT lam_bank_1.lam_ad.mff_ad_fac_mmv_rel "Relative Multiplicative adaptive factor" SWORD _CNV_A_R_LINEAR_____110_CM 1 100. -50. 49.9984741210938 DISPLAY_IDENTIFIER MFF_AD_FAC_MMV_REL[1] ECU_ADDRESS 0xd00055f0 FORMAT "%7.3" /end MEASUREMENT
/begin MEASUREMENT lam_bank_1.lam_ad.mff_ad_add_mmv_rel_quo "Relative lambda adaptation offset quotient" SWORD _CNV_A_R_LINEAR_____201_CM 1 100. -100. 99.9969482421875 DISPLAY_IDENTIFIER MFF_AD_ADD_MMV_REL_QUO_1 ECU_ADDRESS 0xd00055f2 FORMAT "%8.3" /end MEASUREMENT
/begin MEASUREMENT lam_bank_1.lam_ad.mff_ad_add_mmv_rel "Relative additive adaptive factor" SWORD _CNV_A_R_LINEAR_____202_CM 1 100. -694.510597390707 694.4894026092931 DISPLAY_IDENTIFIER MFF_AD_ADD_MMV_REL[1] ECU_ADDRESS 0xd00055ee FORMAT "%7.2" /end MEASUREMENT
/begin MEASUREMENT lam_bank_1.lam_dly.lam_mv "sum of the controller output from the I-and I2-share" SWORD _CNV_A_R_LINEAR_____110_CM 1 100. -50. 49.9984741210938 DISPLAY_IDENTIFIER LAM_MV_1 ECU_ADDRESS 0xd0005600 FORMAT "%6.2" /end MEASUREMENT
/begin MEASUREMENT lam_bank_1.lam_dly.lam_mv_lpf_cp "mean value of the controller output, used by canister purge" SWORD _CNV_A_R_LINEAR_____110_CM 1 100. -50. 49.9984741210938 DISPLAY_IDENTIFIER LAM_MV_LPF_CP_1 ECU_ADDRESS 0xd0005602 FORMAT "%6.2" /end MEASUREMENT
/begin MEASUREMENT lam_bank_1.lam_dly.lamb_sp_fil "output signal of the lambda-sensor model" UWORD _CNV_A_R_LINEAR_____122_CM 1 100. 0. 31.9990234375 DISPLAY_IDENTIFIER LAMB_SP_FIL_1 ECU_ADDRESS 0xd0005604 FORMAT "%7.4" /end MEASUREMENT
/begin MEASUREMENT lam_bank_1.lam_dly.lamb_sp_fil_s_cp "output signal of the lambda-sensor model in stratified mode, used by canister purge" UWORD _CNV_A_R_LINEAR_____122_CM 1 100. 0. 31.9990234375 DISPLAY_IDENTIFIER LAMB_SP_FIL_S_CP_1 ECU_ADDRESS 0xd0005606 FORMAT "%7.4" /end MEASUREMENT
/begin MEASUREMENT lam_bank_1.lam_dly.delta_lamb_i_ad_h_res "adaptation value of trim control (i share moving mean value of lambda shift)" SWORD _CNV_A_R_LINEAR_____203_CM 1 100. -0.125 0.124996 DISPLAY_IDENTIFIER DELTA_LAMB_I_AD_H_RES_1 ECU_ADDRESS 0xd00055fc FORMAT "%8.6" /end MEASUREMENT
/begin MEASUREMENT lam_bank_1.lam_dly.delta_lamb_i_h_res "i share from trim control" SWORD _CNV_A_R_LINEAR_____203_CM 1 100. -0.125 0.124996 DISPLAY_IDENTIFIER DELTA_LAMB_I_H_RES_1 ECU_ADDRESS 0xd00055fa FORMAT "%8.6" /end MEASUREMENT
/begin MEASUREMENT lam_bank_1.lam_dly.bf.lv_delta_lamb "" ULONG _CNV_S_2_RANGE______75_CM 1 100. 0. 1. DISPLAY_IDENTIFIER LV_DELTA_LAMB_1 ECU_ADDRESS 0xd00055f8 BIT_MASK 0x1 /end MEASUREMENT
/begin MEASUREMENT lam_bank_1.lam_dly.vls_dif_dly "sum of the controller output from the I-and I2-share" SWORD _CNV_A_R_LINEAR_____110_CM 1 100. -50. 49.9984741210938 DISPLAY_IDENTIFIER VLS_DIF_DLY_1 ECU_ADDRESS 0xd00055fe FORMAT "%6.2" /end MEASUREMENT
/begin MEASUREMENT lam_bank_1.ls_act_chk_pl.bf.lv_req_lamb_sp_ls_act_test "Lambda coordination request to change set point for active plausibility test" ULONG _CNV_S_2_RANGE______75_CM 1 100. 0. 1. DISPLAY_IDENTIFIER LV_REQ_LAMB_SP_LS_ACT_TEST_1 ECU_ADDRESS 0xd0005638 BIT_MASK 0x1 /end MEASUREMENT
/begin MEASUREMENT lam_bank_1.ls_act_chk_pl.bf.lv_temp_dew_ls_up "flag indicating that dew point is passed at lambda sensor up catalyst" ULONG _CNV_S_2_RANGE______75_CM 1 100. 0. 1. DISPLAY_IDENTIFIER LV_TEMP_DEW_LS_UP[1] ECU_ADDRESS 0xd0005638 BIT_MASK 0x2 /end MEASUREMENT
/begin MEASUREMENT lam_bank_1.ls_act_chk_pl.bf.lv_temp_dew_ls_down "flag indicating that dew point is passed at lambda sensor down catalyst" ULONG _CNV_S_2_RANGE______75_CM 1 100. 0. 1. DISPLAY_IDENTIFIER LV_TEMP_DEW_LS_DOWN[1] ECU_ADDRESS 0xd0005638 BIT_MASK 0x4 /end MEASUREMENT
/begin MEASUREMENT lam_bank_1.ls_act_chk_pl.bf.lv_inh_win_det_delta_i_lam "Flag to inhibit window calculation" ULONG _CNV_S_2_RANGE______75_CM 1 100. 0. 1. DISPLAY_IDENTIFIER LV_INH_WIN_DET_DELTA_I_LAM[1] ECU_ADDRESS 0xd0005638 BIT_MASK 0x8 /end MEASUREMENT
/begin MEASUREMENT lam_bank_1.ls_act_chk_pl.lamb_sp_beg_ls_act_test "Inicial value of lambda set point" UWORD _CNV_A_R_LINEAR_____122_CM 1 100. 0. 31.9990234375 DISPLAY_IDENTIFIER LAMB_SP_BEG_LS_ACT_TEST_1 ECU_ADDRESS 0xd0005640 /end MEASUREMENT
/begin MEASUREMENT lam_bank_1.ls_act_chk_pl.lamb_sp_ls_act_test "Lambda set point for active plausibility test" UWORD _CNV_A_R_LINEAR_____122_CM 1 100. 0. 31.9990234375 DISPLAY_IDENTIFIER LAMB_SP_LS_ACT_TEST_1 ECU_ADDRESS 0xd000563a /end MEASUREMENT
/begin MEASUREMENT lam_bank_1.ls_act_chk_pl.teg_dyn_ls_up "Exhaust gas temperature at the lambda sensor upstream catalyst" UWORD _CNV_A_R_LINEAR_____204_CM 1 100. -273.15 1774.7875 DISPLAY_IDENTIFIER TEG_DYN_LS_UP[1] ECU_ADDRESS 0xd0005644 FORMAT "%9.4" /end MEASUREMENT
/begin MEASUREMENT lam_bank_1.ls_act_chk_pl.teg_dyn_ls_down "Exhaust gas temperature at the lambda sensor downstream catalyst" UWORD _CNV_A_R_LINEAR_____204_CM 1 100. -273.15 1774.7875 DISPLAY_IDENTIFIER TEG_DYN_LS_DOWN[1] ECU_ADDRESS 0xd0005646 FORMAT "%9.4" /end MEASUREMENT
/begin MEASUREMENT lam_bank_1.ls_ready.bf.lv_up_ls "Logical variable for operative readiness of upstream oxygen sensor" ULONG _CNV_S_2_RANGE______75_CM 1 100. 0. 1. DISPLAY_IDENTIFIER LV_UP_LS_1 ECU_ADDRESS 0xd0005620 BIT_MASK 0x1 /end MEASUREMENT
/begin MEASUREMENT lam_bank_1.lam_sti_afl.ctr_vls_afl_cyc "counter indicating the number of air fuel cycles since last activation of forced lambda stimulation" UWORD _CNV_A_R_LINEAR_____0_CM 1 100. 0. 65535. DISPLAY_IDENTIFIER CTR_VLS_AFL_CYC_1 ECU_ADDRESS 0xd0005656 FORMAT "%5.0" /end MEASUREMENT
/begin MEASUREMENT lam_bank_1.ls_down.vls_down "Downstream sensor voltage measured" UWORD _CNV_A_R_LINEAR_____2_CM 1 100. 0. 4.9951171875 DISPLAY_IDENTIFIER VLS_DOWN_1 ECU_ADDRESS 0xd000561c FORMAT "%5.3" /end MEASUREMENT
/begin MEASUREMENT lam_bank_1.ls_down_rdy.bf.lv_down_ls "Logical variable for operative readiness of downstream oxygen sensor(s)" ULONG _CNV_S_2_RANGE______75_CM 1 100. 0. 1. DISPLAY_IDENTIFIER LV_DOWN_LS_1 ECU_ADDRESS 0xd000561e BIT_MASK 0x1 /end MEASUREMENT
/begin MEASUREMENT lam_bank_1.lsh_down.state_lsh_down "Present heater state of downstream sensors" UBYTE _CNV_S_6_STATE_LSH__205_CM 1 100. 0. 5. DISPLAY_IDENTIFIER STATE_LSH_DOWN_1 ECU_ADDRESS 0xd0005616 /end MEASUREMENT
/begin MEASUREMENT lam_bank_1.lsh_up.state_lsh_up "Present heater state of upstream sensors" UBYTE _CNV_S_7_STATE_LSH__206_CM 1 100. 0. 6. DISPLAY_IDENTIFIER STATE_LSH_UP_1 ECU_ADDRESS 0xd0005619 /end MEASUREMENT
/begin MEASUREMENT lam_bank_2.lam_up.bf.lv_lscl "activation flag of lambda control" ULONG _CNV_S_2_RANGE______75_CM 1 100. 0. 1. DISPLAY_IDENTIFIER LV_LSCL_2 ECU_ADDRESS 0xd00056a0 BIT_MASK 0x1 /end MEASUREMENT
/begin MEASUREMENT lam_bank_2.lam_up.bf.lv_lam_cor_lim_intr "the sum output signal is limited under non-stationary operating conditions (threshold exceeded)						" ULONG _CNV_S_2_RANGE______75_CM 1 100. 0. 1. DISPLAY_IDENTIFIER LV_LAM_COR_LIM_INTR_2 ECU_ADDRESS 0xd00056a0 BIT_MASK 0x2 /end MEASUREMENT
/begin MEASUREMENT lam_bank_2.lam_up.ti_lam_cor "controller output signal in consideration of the canister purge function and lambda adaptation" SWORD _CNV_A_R_LINEAR_____110_CM 1 100. -50. 49.9984741210938 DISPLAY_IDENTIFIER TI_LAM_COR_2 ECU_ADDRESS 0xd00056a6 FORMAT "%6.2" /end MEASUREMENT
/begin MEASUREMENT lam_bank_2.lam_up.ti_lam_fac "limited lambda controller oiutput plus pre control correction" SWORD _CNV_A_R_LINEAR_____110_CM 1 100. -50. 49.9984741210938 DISPLAY_IDENTIFIER TI_LAM_FAC_2 ECU_ADDRESS 0xd00056aa FORMAT "%6.2" /end MEASUREMENT
/begin MEASUREMENT lam_bank_2.lam_up.lamb_dif "controller difference" SWORD _CNV_A_R_LINEAR_____200_CM 1 100. -1. 0.99996948 DISPLAY_IDENTIFIER LAMB_DIF_2 ECU_ADDRESS 0xd00056a2 FORMAT "%8.5" /end MEASUREMENT
/begin MEASUREMENT lam_bank_2.lam_up.lamb "Lambda signal value of the WRAF sensor of exhast bank" UWORD _CNV_A_R_LINEAR_____122_CM 1 100. 0. 31.9990234375 DISPLAY_IDENTIFIER LAMB_2 ECU_ADDRESS 0xd00056a4 FORMAT "%7.4" /end MEASUREMENT
/begin MEASUREMENT lam_bank_2.lam_ad.mff_ad_fac_mmv_rel "Relative Multiplicative adaptive factor" SWORD _CNV_A_R_LINEAR_____110_CM 1 100. -50. 49.9984741210938 DISPLAY_IDENTIFIER MFF_AD_FAC_MMV_REL[2] ECU_ADDRESS 0xd0005688 FORMAT "%7.3" /end MEASUREMENT
/begin MEASUREMENT lam_bank_2.lam_ad.mff_ad_add_mmv_rel_quo "Relative lambda adaptation offset quotient" SWORD _CNV_A_R_LINEAR_____201_CM 1 100. -100. 99.9969482421875 DISPLAY_IDENTIFIER MFF_AD_ADD_MMV_REL_QUO_2 ECU_ADDRESS 0xd000568a FORMAT "%8.3" /end MEASUREMENT
/begin MEASUREMENT lam_bank_2.lam_ad.mff_ad_add_mmv_rel "Relative additive adaptive factor" SWORD _CNV_A_R_LINEAR_____202_CM 1 100. -694.510597390707 694.4894026092931 DISPLAY_IDENTIFIER MFF_AD_ADD_MMV_REL[2] ECU_ADDRESS 0xd0005686 FORMAT "%7.2" /end MEASUREMENT
/begin MEASUREMENT lam_bank_2.lam_dly.lam_mv "sum of the controller output from the I-and I2-share" SWORD _CNV_A_R_LINEAR_____110_CM 1 100. -50. 49.9984741210938 DISPLAY_IDENTIFIER LAM_MV_2 ECU_ADDRESS 0xd0005698 FORMAT "%6.2" /end MEASUREMENT
/begin MEASUREMENT lam_bank_2.lam_dly.lam_mv_lpf_cp "mean value of the controller output, used by canister purge" SWORD _CNV_A_R_LINEAR_____110_CM 1 100. -50. 49.9984741210938 DISPLAY_IDENTIFIER LAM_MV_LPF_CP_2 ECU_ADDRESS 0xd000569a FORMAT "%6.2" /end MEASUREMENT
/begin MEASUREMENT lam_bank_2.lam_dly.lamb_sp_fil "output signal of the lambda-sensor model" UWORD _CNV_A_R_LINEAR_____122_CM 1 100. 0. 31.9990234375 DISPLAY_IDENTIFIER LAMB_SP_FIL_2 ECU_ADDRESS 0xd000569c FORMAT "%7.4" /end MEASUREMENT
/begin MEASUREMENT lam_bank_2.lam_dly.lamb_sp_fil_s_cp "output signal of the lambda-sensor model in stratified mode, used by canister purge" UWORD _CNV_A_R_LINEAR_____122_CM 1 100. 0. 31.9990234375 DISPLAY_IDENTIFIER LAMB_SP_FIL_S_CP_2 ECU_ADDRESS 0xd000569e FORMAT "%7.4" /end MEASUREMENT
/begin MEASUREMENT lam_bank_2.lam_dly.delta_lamb_i_ad_h_res "adaptation value of trim control (i share moving mean value of lambda shift)" SWORD _CNV_A_R_LINEAR_____203_CM 1 100. -0.125 0.124996 DISPLAY_IDENTIFIER DELTA_LAMB_I_AD_H_RES_2 ECU_ADDRESS 0xd0005694 FORMAT "%8.6" /end MEASUREMENT
/begin MEASUREMENT lam_bank_2.lam_dly.delta_lamb_i_h_res "i share from trim control" SWORD _CNV_A_R_LINEAR_____203_CM 1 100. -0.125 0.124996 DISPLAY_IDENTIFIER DELTA_LAMB_I_H_RES_2 ECU_ADDRESS 0xd0005692 FORMAT "%8.6" /end MEASUREMENT
/begin MEASUREMENT lam_bank_2.lam_dly.bf.lv_delta_lamb "" ULONG _CNV_S_2_RANGE______75_CM 1 100. 0. 1. DISPLAY_IDENTIFIER LV_DELTA_LAMB_2 ECU_ADDRESS 0xd0005690 BIT_MASK 0x1 /end MEASUREMENT
/begin MEASUREMENT lam_bank_2.lam_dly.vls_dif_dly "sum of the controller output from the I-and I2-share" SWORD _CNV_A_R_LINEAR_____110_CM 1 100. -50. 49.9984741210938 DISPLAY_IDENTIFIER VLS_DIF_DLY_2 ECU_ADDRESS 0xd0005696 FORMAT "%6.2" /end MEASUREMENT
/begin MEASUREMENT lam_bank_2.ls_act_chk_pl.bf.lv_req_lamb_sp_ls_act_test "Lambda coordination request to change set point for active plausibility test" ULONG _CNV_S_2_RANGE______75_CM 1 100. 0. 1. DISPLAY_IDENTIFIER LV_REQ_LAMB_SP_LS_ACT_TEST_2 ECU_ADDRESS 0xd00056d0 BIT_MASK 0x1 /end MEASUREMENT
/begin MEASUREMENT lam_bank_2.ls_act_chk_pl.bf.lv_temp_dew_ls_up "flag indicating that dew point is passed at lambda sensor up catalyst" ULONG _CNV_S_2_RANGE______75_CM 1 100. 0. 1. DISPLAY_IDENTIFIER LV_TEMP_DEW_LS_UP[2] ECU_ADDRESS 0xd00056d0 BIT_MASK 0x2 /end MEASUREMENT
/begin MEASUREMENT lam_bank_2.ls_act_chk_pl.bf.lv_temp_dew_ls_down "flag indicating that dew point is passed at lambda sensor down catalyst" ULONG _CNV_S_2_RANGE______75_CM 1 100. 0. 1. DISPLAY_IDENTIFIER LV_TEMP_DEW_LS_DOWN[2] ECU_ADDRESS 0xd00056d0 BIT_MASK 0x4 /end MEASUREMENT
/begin MEASUREMENT lam_bank_2.ls_act_chk_pl.bf.lv_inh_win_det_delta_i_lam "Flag to inhibit window calculation" ULONG _CNV_S_2_RANGE______75_CM 1 100. 0. 1. DISPLAY_IDENTIFIER LV_INH_WIN_DET_DELTA_I_LAM[2] ECU_ADDRESS 0xd00056d0 BIT_MASK 0x8 /end MEASUREMENT
/begin MEASUREMENT lam_bank_2.ls_act_chk_pl.lamb_sp_beg_ls_act_test "Inicial value of lambda set point" UWORD _CNV_A_R_LINEAR_____122_CM 1 100. 0. 31.9990234375 DISPLAY_IDENTIFIER LAMB_SP_BEG_LS_ACT_TEST_2 ECU_ADDRESS 0xd00056d8 /end MEASUREMENT
/begin MEASUREMENT lam_bank_2.ls_act_chk_pl.lamb_sp_ls_act_test "Lambda set point for active plausibility test" UWORD _CNV_A_R_LINEAR_____122_CM 1 100. 0. 31.9990234375 DISPLAY_IDENTIFIER LAMB_SP_LS_ACT_TEST_2 ECU_ADDRESS 0xd00056d2 /end MEASUREMENT
/begin MEASUREMENT lam_bank_2.ls_act_chk_pl.teg_dyn_ls_up "Exhaust gas temperature at the lambda sensor upstream catalyst" UWORD _CNV_A_R_LINEAR_____204_CM 1 100. -273.15 1774.7875 DISPLAY_IDENTIFIER TEG_DYN_LS_UP[2] ECU_ADDRESS 0xd00056dc FORMAT "%9.4" /end MEASUREMENT
/begin MEASUREMENT lam_bank_2.ls_act_chk_pl.teg_dyn_ls_down "Exhaust gas temperature at the lambda sensor downstream catalyst" UWORD _CNV_A_R_LINEAR_____204_CM 1 100. -273.15 1774.7875 DISPLAY_IDENTIFIER TEG_DYN_LS_DOWN[2] ECU_ADDRESS 0xd00056de FORMAT "%9.4" /end MEASUREMENT
/begin MEASUREMENT lam_bank_2.ls_ready.bf.lv_up_ls "Logical variable for operative readiness of upstream oxygen sensor" ULONG _CNV_S_2_RANGE______75_CM 1 100. 0. 1. DISPLAY_IDENTIFIER LV_UP_LS_2 ECU_ADDRESS 0xd00056b8 BIT_MASK 0x1 /end MEASUREMENT
/begin MEASUREMENT lam_bank_2.lam_sti_afl.ctr_vls_afl_cyc "counter indicating the number of air fuel cycles since last activation of forced lambda stimulation" UWORD _CNV_A_R_LINEAR_____0_CM 1 100. 0. 65535. DISPLAY_IDENTIFIER CTR_VLS_AFL_CYC_2 ECU_ADDRESS 0xd00056ee FORMAT "%5.0" /end MEASUREMENT
/begin MEASUREMENT lam_bank_2.ls_down.vls_down "Downstream sensor voltage measured" UWORD _CNV_A_R_LINEAR_____2_CM 1 100. 0. 4.9951171875 DISPLAY_IDENTIFIER VLS_DOWN_2 ECU_ADDRESS 0xd00056b4 FORMAT "%5.3" /end MEASUREMENT
/begin MEASUREMENT lam_bank_2.ls_down_rdy.bf.lv_down_ls "Logical variable for operative readiness of downstream oxygen sensor(s)" ULONG _CNV_S_2_RANGE______75_CM 1 100. 0. 1. DISPLAY_IDENTIFIER LV_DOWN_LS_2 ECU_ADDRESS 0xd00056b6 BIT_MASK 0x1 /end MEASUREMENT
/begin MEASUREMENT lam_bank_2.lsh_down.state_lsh_down "Present heater state of downstream sensors" UBYTE _CNV_S_6_STATE_LSH__205_CM 1 100. 0. 5. DISPLAY_IDENTIFIER STATE_LSH_DOWN_2 ECU_ADDRESS 0xd00056ae /end MEASUREMENT
/begin MEASUREMENT lam_bank_2.lsh_up.state_lsh_up "Present heater state of upstream sensors" UBYTE _CNV_S_7_STATE_LSH__206_CM 1 100. 0. 6. DISPLAY_IDENTIFIER STATE_LSH_UP_2 ECU_ADDRESS 0xd00056b1 /end MEASUREMENT
/begin MEASUREMENT lv_amt_disable "logical variable for disabling AMT intervention due to EMS error" UBYTE _CNV_S_2_RANGE__0___1_CM 1 100. 0. 1. DISPLAY_IDENTIFIER LV_AMT_DISABLE ECU_ADDRESS 0xd0003efd BIT_MASK 0x1 /end MEASUREMENT
/begin MEASUREMENT lv_amt_disable_can "logical variable for disabling GS intervention due to CAN error" UBYTE _CNV_S_2_RANGE__0___1_CM 1 100. 0. 1. DISPLAY_IDENTIFIER LV_AMT_DISABLE_CAN ECU_ADDRESS 0xd0003efe BIT_MASK 0x1 /end MEASUREMENT
/begin MEASUREMENT lv_amt_ena_dec "logical variable for decreased torque intervention due to gear shift" UBYTE _CNV_S_2_RANGE__0___1_CM 1 100. 0. 1. DISPLAY_IDENTIFIER LV_AMT_ENA_DEC ECU_ADDRESS 0xd0003eff BIT_MASK 0x1 /end MEASUREMENT
/begin MEASUREMENT lv_amt_ena_inc "logical variable for increased torque intervention due to gear shift" UBYTE _CNV_S_2_RANGE__0___1_CM 1 100. 0. 1. DISPLAY_IDENTIFIER LV_AMT_ENA_INC ECU_ADDRESS 0xd0003f00 BIT_MASK 0x1 /end MEASUREMENT
/begin MEASUREMENT lv_amt_ena "logical variable for gear shift intervention enabling" UBYTE _CNV_S_2_RANGE__0___1_CM 1 100. 0. 1. DISPLAY_IDENTIFIER LV_AMT_ENA ECU_ADDRESS 0xc0000d16 BIT_MASK 0x1 /end MEASUREMENT
/begin MEASUREMENT tqi_amt_fast_dec_req "torque decrement for fast torque intervention during gear shift" SWORD _CNV_A_R_LINEAR_____30_CM 1 100. -1024. 1023.96875 DISPLAY_IDENTIFIER TQI_AMT_FAST_DEC_REQ ECU_ADDRESS 0xd0005354 FORMAT "%8.2" /end MEASUREMENT
/begin MEASUREMENT tqi_amt_fast_dec_req_1 "Torque decrement for fast torque intervention during gear shift" SWORD _CNV_A_R_LINEAR_____30_CM 1 100. -1024. 1023.96875 DISPLAY_IDENTIFIER TQI_AMT_FAST_DEC_REQ_1 ECU_ADDRESS 0xd000535c FORMAT "%8.2" /end MEASUREMENT
/begin MEASUREMENT tqi_amt_slow_dec_req "torque decrement for slow torque intervention during gear shift" SWORD _CNV_A_R_LINEAR_____30_CM 1 100. -1024. 1023.96875 DISPLAY_IDENTIFIER TQI_AMT_SLOW_DEC_REQ ECU_ADDRESS 0xd0005356 FORMAT "%8.2" /end MEASUREMENT
/begin MEASUREMENT tqi_amt_slow_dec_req_1 "torque decrement for slow torque intervention during gear shift" SWORD _CNV_A_R_LINEAR_____30_CM 1 100. -1024. 1023.96875 DISPLAY_IDENTIFIER TQI_AMT_SLOW_DEC_REQ_1 ECU_ADDRESS 0xd000535e FORMAT "%8.2" /end MEASUREMENT
/begin MEASUREMENT tqi_amt_fast_inc_req "torque increase for fast torque intervention during gear shift" SWORD _CNV_A_R_LINEAR_____30_CM 1 100. -1024. 1023.96875 DISPLAY_IDENTIFIER TQI_AMT_FAST_INC_REQ ECU_ADDRESS 0xd0005358 FORMAT "%8.2" /end MEASUREMENT
/begin MEASUREMENT tqi_amt_fast_inc_req_1 "Torque increase for fast torque intervention during gear shift" SWORD _CNV_A_R_LINEAR_____30_CM 1 100. -1024. 1023.96875 DISPLAY_IDENTIFIER TQI_AMT_FAST_INC_REQ_1 ECU_ADDRESS 0xd0005360 FORMAT "%8.2" /end MEASUREMENT
/begin MEASUREMENT tqi_amt_slow_inc_req "torque increase for slow torque intervention during gear shift" SWORD _CNV_A_R_LINEAR_____30_CM 1 100. -1024. 1023.96875 DISPLAY_IDENTIFIER TQI_AMT_SLOW_INC_REQ ECU_ADDRESS 0xd000535a FORMAT "%8.2" /end MEASUREMENT
/begin MEASUREMENT tqi_amt_slow_inc_req_1 "Torque increase for slow torque intervention during gear shift" SWORD _CNV_A_R_LINEAR_____30_CM 1 100. -1024. 1023.96875 DISPLAY_IDENTIFIER TQI_AMT_SLOW_INC_REQ_1 ECU_ADDRESS 0xd0005362 FORMAT "%8.2" /end MEASUREMENT
/begin MEASUREMENT tqi_amt_fast_dec "torque decrement for fast torque intervention during gear shift" SWORD _CNV_A_R_LINEAR_____30_CM 1 100. -1024. 1023.96875 DISPLAY_IDENTIFIER TQI_AMT_FAST_DEC ECU_ADDRESS 0xd0005364 FORMAT "%8.2" /end MEASUREMENT
/begin MEASUREMENT tqi_amt_slow_dec "torque decrement for slow torque intervention during gear shift" SWORD _CNV_A_R_LINEAR_____30_CM 1 100. -1024. 1023.96875 DISPLAY_IDENTIFIER TQI_AMT_SLOW_DEC ECU_ADDRESS 0xd0005366 FORMAT "%8.2" /end MEASUREMENT
/begin MEASUREMENT lv_amt_dec_act "logical variable for torque intervention due to gear shift" UBYTE _CNV_S_2_RANGE__0___1_CM 1 100. 0. 1. DISPLAY_IDENTIFIER LV_AMT_DEC_ACT ECU_ADDRESS 0xd0003f01 BIT_MASK 0x1 /end MEASUREMENT
/begin MEASUREMENT tqi_amt_fast_inc "torque increase for fast torque intervention during gear shift" SWORD _CNV_A_R_LINEAR_____30_CM 1 100. -1024. 1023.96875 DISPLAY_IDENTIFIER TQI_AMT_FAST_INC ECU_ADDRESS 0xd0005368 FORMAT "%8.2" /end MEASUREMENT
/begin MEASUREMENT tqi_amt_slow_inc "torque increase for slow torque intervention during gear shift" SWORD _CNV_A_R_LINEAR_____30_CM 1 100. -1024. 1023.96875 DISPLAY_IDENTIFIER TQI_AMT_SLOW_INC ECU_ADDRESS 0xd000536a FORMAT "%8.2" /end MEASUREMENT
/begin MEASUREMENT lv_amt_dec_lih "logical variable for torque intervention LIH due to gear shift" UBYTE _CNV_S_2_RANGE__0___1_CM 1 100. 0. 1. DISPLAY_IDENTIFIER LV_AMT_DEC_LIH ECU_ADDRESS 0xc0000d17 BIT_MASK 0x1 /end MEASUREMENT
/begin MEASUREMENT lv_amt_inc_act "logical variable for torque intervention due to gear shift" UBYTE _CNV_S_2_RANGE__0___1_CM 1 100. 0. 1. DISPLAY_IDENTIFIER LV_AMT_INC_ACT ECU_ADDRESS 0xd0003f02 BIT_MASK 0x1 /end MEASUREMENT
/begin MEASUREMENT lv_amt_inc_lih "logical variable for torque intervention LIH due to gear shift" UBYTE _CNV_S_2_RANGE__0___1_CM 1 100. 0. 1. DISPLAY_IDENTIFIER LV_AMT_INC_LIH ECU_ADDRESS 0xd0003f03 BIT_MASK 0x1 /end MEASUREMENT
/begin CHARACTERISTIC c_lgrd_lih_amt_dec "limiting gradient for AMT emergency ramp function (default  0.6 Nm/10ms)" VALUE 0xa102951a _REC_VAL_20_u2 1023.96875 _CNV_A_R_LINEAR_____165_CM 0. 1023.96875 DISPLAY_IDENTIFIER C_LGRD_LIH_AMT_DEC FORMAT "%7.2" /end CHARACTERISTIC
/begin CHARACTERISTIC c_lgrd_lih_amt_inc "limiting gradient for AMT emergency ramp function (default  0.6 Nm/10ms)" VALUE 0xa102951c _REC_VAL_20_u2 1023.96875 _CNV_A_R_LINEAR_____165_CM 0. 1023.96875 DISPLAY_IDENTIFIER C_LGRD_LIH_AMT_INC FORMAT "%7.2" /end CHARACTERISTIC
/begin CHARACTERISTIC c_t_dly_lih_amt_dec "delay time for activation of AMT emergency ramp function (default 0s)" VALUE 0xa1029866 _REC_VAL_20_u1 2.55 _CNV_A_R_LINEAR_____3_CM 0. 2.55 DISPLAY_IDENTIFIER C_T_DLY_LIH_AMT_DEC FORMAT "%4.2" /end CHARACTERISTIC
/begin CHARACTERISTIC c_t_dly_lih_amt_inc "delay time for activation of AMT emergency ramp function (default 0s)" VALUE 0xa1029867 _REC_VAL_20_u1 2.55 _CNV_A_R_LINEAR_____3_CM 0. 2.55 DISPLAY_IDENTIFIER C_T_DLY_LIH_AMT_INC FORMAT "%4.2" /end CHARACTERISTIC
/begin CHARACTERISTIC c_amt_ena_inc_dec "Enable switch AMT intervention" VALUE 0xa102919d _REC_VAL_20_u1 3. _CNV_S_4_STATE_AMT__164_CM 0. 3. DISPLAY_IDENTIFIER C_AMT_ENA_INC_DEC /end CHARACTERISTIC
/begin MEASUREMENT state_tq_amt_plaus "Bitwise coded State for AMT intervention state" UBYTE _CNV_A_R_LINEAR_____0_CM 1 100. 0. 255. DISPLAY_IDENTIFIER STATE_TQ_AMT_PLAUS ECU_ADDRESS 0xd0003efc FORMAT "%3.0" /end MEASUREMENT
/begin MEASUREMENT t_amt_inc_lih_ctr "Delay time" UBYTE _CNV_A_R_LINEAR_____3_CM 1 100. 0. 2.55 DISPLAY_IDENTIFIER T_AMT_INC_LIH_CTR ECU_ADDRESS 0xc0000d15 FORMAT "%4.2" /end MEASUREMENT
/begin MEASUREMENT t_amt_dec_lih_ctr "Delay time" UBYTE _CNV_A_R_LINEAR_____3_CM 1 100. 0. 2.55 DISPLAY_IDENTIFIER T_AMT_DEC_LIH_CTR ECU_ADDRESS 0xc0000d14 FORMAT "%4.2" /end MEASUREMENT
/begin CHARACTERISTIC c_tq_amt_fast_inh_fcut "threshold for inhibiting FCUT during AMT intervention" VALUE 0xa1029aea _REC_VAL_20_s2 2047.96875 _CNV_A_R_LINEAR_____30_CM -1024. 1023.96875 DISPLAY_IDENTIFIER C_TQ_AMT_FAST_INH_FCUT FORMAT "%8.2" /end CHARACTERISTIC
/begin CHARACTERISTIC c_tq_amt_slow_inh_fcut "threshold for inhibiting FCUT during AMT intervention" VALUE 0xa1029aec _REC_VAL_20_s2 2047.96875 _CNV_A_R_LINEAR_____30_CM -1024. 1023.96875 DISPLAY_IDENTIFIER C_TQ_AMT_SLOW_INH_FCUT FORMAT "%8.2" /end CHARACTERISTIC
/begin MEASUREMENT lv_inh_fcut_amt "Logical variable inhibiting FCUT during AMT-intervention" UBYTE _CNV_S_2_RANGE__0___1_CM 1 100. 0. 1. DISPLAY_IDENTIFIER LV_INH_FCUT_AMT ECU_ADDRESS 0xd0003f04 BIT_MASK 0x1 /end MEASUREMENT
/begin MEASUREMENT lv_ars_disable "logical variable for disabling ARS intervention due to EMS error" UBYTE _CNV_S_2_RANGE__0___1_CM 1 100. 0. 1. DISPLAY_IDENTIFIER LV_ARS_DISABLE ECU_ADDRESS 0xd0003ef5 BIT_MASK 0x1 /end MEASUREMENT
/begin MEASUREMENT lv_ars_disable_can "logical variable for disabling ARS intervention due to CAN error" UBYTE _CNV_S_2_RANGE__0___1_CM 1 100. 0. 1. DISPLAY_IDENTIFIER LV_ARS_DISABLE_CAN ECU_ADDRESS 0xd0003ef6 BIT_MASK 0x1 /end MEASUREMENT
/begin MEASUREMENT lv_ars_ena "logical variable for ASR intervention enabling" UBYTE _CNV_S_2_RANGE__0___1_CM 1 100. 0. 1. DISPLAY_IDENTIFIER LV_ARS_ENA ECU_ADDRESS 0xd0003ef7 BIT_MASK 0x1 /end MEASUREMENT
/begin MEASUREMENT lv_tq_max_ars "logical variable indicating maximum torque request - ARS" UBYTE _CNV_S_2_RANGE__0___1_CM 1 100. 0. 1. DISPLAY_IDENTIFIER LV_TQ_MAX_ARS ECU_ADDRESS 0xd0003ef8 BIT_MASK 0x1 /end MEASUREMENT
/begin MEASUREMENT tq_loss_ars_sp_max "ARS target torque loss - maximum (considering offset)" SWORD _CNV_A_R_LINEAR_____30_CM 1 100. -1024. 1023.96875 DISPLAY_IDENTIFIER TQ_LOSS_ARS_SP_MAX ECU_ADDRESS 0xd0005344 FORMAT "%8.2" /end MEASUREMENT
/begin MEASUREMENT tq_loss_ars_sp_max_1 "ARS target torque loss - maximum" SWORD _CNV_A_R_LINEAR_____30_CM 1 100. -1024. 1023.96875 DISPLAY_IDENTIFIER TQ_LOSS_ARS_SP_MAX_1 ECU_ADDRESS 0xd0005342 FORMAT "%8.2" /end MEASUREMENT
/begin MEASUREMENT tq_loss_ars_av_max_1 "ARS actual value of torque loss - maximum" SWORD _CNV_A_R_LINEAR_____30_CM 1 100. -1024. 1023.96875 DISPLAY_IDENTIFIER TQ_LOSS_ARS_AV_MAX_1 ECU_ADDRESS 0xd0005346 FORMAT "%8.2" /end MEASUREMENT
/begin MEASUREMENT t_dly_tq_max_ars "Delay time for activation of LV_TQ_MAX_ARS" UWORD _CNV_A_R_LINEAR_____3_CM 1 100. 0. 655.35 DISPLAY_IDENTIFIER T_DLY_TQ_MAX_ARS ECU_ADDRESS 0xd0005340 FORMAT "%6.2" /end MEASUREMENT
/begin MEASUREMENT tq_loss_ars "torque loss ARS for torque loss calculation" SWORD _CNV_A_R_LINEAR_____30_CM 1 100. -1024. 1023.96875 DISPLAY_IDENTIFIER TQ_LOSS_ARS ECU_ADDRESS 0xd000534a FORMAT "%8.2" /end MEASUREMENT
/begin MEASUREMENT tq_loss_ars_av_max "ARS actual value of torque loss - maximum (considering offset)" SWORD _CNV_A_R_LINEAR_____30_CM 1 100. -1024. 1023.96875 DISPLAY_IDENTIFIER TQ_LOSS_ARS_AV_MAX ECU_ADDRESS 0xd0005348 FORMAT "%8.2" /end MEASUREMENT
/begin MEASUREMENT tq_loss_ars_grd "Torque loss gradient - ARS" SWORD _CNV_A_R_LINEAR_____30_CM 1 100. -1024. 1023.96875 DISPLAY_IDENTIFIER TQ_LOSS_ARS_GRD ECU_ADDRESS 0xd000534e FORMAT "%8.2" /end MEASUREMENT
/begin MEASUREMENT tq_loss_ars_dif "Difference torque loss TQ_LOSS_ARS_SP_CAN - TQ_LOSS_ARS_AV_CAN" SWORD _CNV_A_R_LINEAR_____30_CM 1 100. -1024. 1023.96875 DISPLAY_IDENTIFIER TQ_LOSS_ARS_DIF ECU_ADDRESS 0xd0005350 FORMAT "%8.2" /end MEASUREMENT
/begin CHARACTERISTIC ip_tq_loss_ars_sp_max "ARS target torque loss - maximum" MAP 0xa1028b50 _REC_MAP_20_u2_u2_u2 2047.96875 _CNV_A_R_LINEAR_____65_CM -1024. 1023.96875 DISPLAY_IDENTIFIER IP_TQ_LOSS_ARS_SP_MAX FORMAT "%6.2"
 /begin AXIS_DESCR COM_AXIS ac_veh_trv_tcs _CNV_A_R_LINEAR_____272_CM 8 -51.175 51.175 FORMAT "%7.4" AXIS_PTS_REF ldpm_ac_veh_trv_tcs /end AXIS_DESCR
 /begin AXIS_DESCR COM_AXIS vs_fil _CNV_A_R_LINEAR_____66_CM 8 0. 511.99218 FORMAT "%7.3" AXIS_PTS_REF ldpm_vs_fil /end AXIS_DESCR
/end CHARACTERISTIC
/begin CHARACTERISTIC ip_tq_loss_ars_av_max "ARS Actual value of torque loss - maximum" MAP 0xa1028a50 _REC_MAP_20_u2_u2_u2 2047.96875 _CNV_A_R_LINEAR_____65_CM -1024. 1023.96875 DISPLAY_IDENTIFIER IP_TQ_LOSS_ARS_AV_MAX FORMAT "%6.2"
 /begin AXIS_DESCR COM_AXIS ac_veh_trv_tcs _CNV_A_R_LINEAR_____272_CM 8 -51.175 51.175 FORMAT "%7.4" AXIS_PTS_REF ldpm_ac_veh_trv_tcs /end AXIS_DESCR
 /begin AXIS_DESCR COM_AXIS vs_fil _CNV_A_R_LINEAR_____66_CM 8 0. 511.99218 FORMAT "%7.3" AXIS_PTS_REF ldpm_vs_fil /end AXIS_DESCR
/end CHARACTERISTIC
/begin CHARACTERISTIC ip_tq_loss_ars_sp_can_max "ARS torque loss depending on torque loss (SP) via CAN and engine speed" MAP 0xa1028ad0 _REC_MAP_20_u2_u2_u1 2047.96875 _CNV_A_R_LINEAR_____65_CM -1024. 1023.96875 DISPLAY_IDENTIFIER IP_TQ_LOSS_ARS_SP_CAN_MAX FORMAT "%6.2"
 /begin AXIS_DESCR COM_AXIS tq_loss_ars_sp_can _CNV_A_R_LINEAR_____65_CM 8 -1024. 1023.96875 FORMAT "%6.2" AXIS_PTS_REF ldp_tq_loss_ars_sp_can_max /end AXIS_DESCR
 /begin AXIS_DESCR COM_AXIS n_32 _CNV_A_R_LINEAR_____9_CM 8 0. 8160. FORMAT "%4.0" AXIS_PTS_REF ldpm_n_32__tq_loss_ars /end AXIS_DESCR
/end CHARACTERISTIC
/begin CHARACTERISTIC ip_tq_loss_ars_av_can_max "ARS torque loss depending on torque loss (AV) via CAN and engine speed" MAP 0xa10289d0 _REC_MAP_20_u2_u2_u1 2047.96875 _CNV_A_R_LINEAR_____65_CM -1024. 1023.96875 DISPLAY_IDENTIFIER IP_TQ_LOSS_ARS_AV_CAN_MAX FORMAT "%6.2"
 /begin AXIS_DESCR COM_AXIS tq_loss_ars_av_can _CNV_A_R_LINEAR_____65_CM 8 -1024. 1023.96875 FORMAT "%6.2" AXIS_PTS_REF ldp_tq_loss_ars_av_can_max /end AXIS_DESCR
 /begin AXIS_DESCR COM_AXIS n_32 _CNV_A_R_LINEAR_____9_CM 8 0. 8160. FORMAT "%4.0" AXIS_PTS_REF ldpm_n_32__tq_loss_ars /end AXIS_DESCR
/end CHARACTERISTIC
/begin CHARACTERISTIC c_fac_tq_loss_ars_grd "ARS torque loss gradient - correction factor" VALUE 0xa10293b8 _REC_VAL_20_u2 0.9999847412109381 _CNV_A_R_LINEAR_____68_CM 0. 0.9999847412109381 DISPLAY_IDENTIFIER C_FAC_TQ_LOSS_ARS_GRD FORMAT "%7.6" /end CHARACTERISTIC
/begin CHARACTERISTIC c_fac_tq_loss_ars_dif "ARS torque loss actual value - correction factor" VALUE 0xa10293b6 _REC_VAL_20_u2 0.9999847412109381 _CNV_A_R_LINEAR_____68_CM 0. 0.9999847412109381 DISPLAY_IDENTIFIER C_FAC_TQ_LOSS_ARS_DIF FORMAT "%7.6" /end CHARACTERISTIC
/begin CHARACTERISTIC c_t_dly_tq_max_ars "Time delay for activating LV_TQ_MAX_ARS" VALUE 0xa102987c _REC_VAL_20_u2 655.35 _CNV_A_R_LINEAR_____3_CM 0. 655.35 DISPLAY_IDENTIFIER C_T_DLY_TQ_MAX_ARS FORMAT "%6.2" /end CHARACTERISTIC
/begin CHARACTERISTIC c_tq_loss_ars_sp_ofs "Offset for TQ_LOSS_ARS_SP" VALUE 0xa1029b14 _REC_VAL_20_s2 2047.96875 _CNV_A_R_LINEAR_____30_CM -1024. 1023.96875 DISPLAY_IDENTIFIER C_TQ_LOSS_ARS_SP_OFS FORMAT "%8.2" /end CHARACTERISTIC
/begin CHARACTERISTIC c_tq_loss_ars_av_ofs "Offset for TQ_LOSS_ARS_AV" VALUE 0xa1029b12 _REC_VAL_20_s2 2047.96875 _CNV_A_R_LINEAR_____30_CM -1024. 1023.96875 DISPLAY_IDENTIFIER C_TQ_LOSS_ARS_AV_OFS FORMAT "%8.2" /end CHARACTERISTIC
/begin CHARACTERISTIC c_v_max_ars_diag "filtered vehicle speed threshold for diagnosis" VALUE 0xa1029b76 _REC_VAL_20_u2 511.99218 _CNV_A_R_LINEAR_____66_CM 0. 511.99218 DISPLAY_IDENTIFIER C_V_MAX_ARS_DIAG FORMAT "%7.3" /end CHARACTERISTIC
/begin CHARACTERISTIC c_n_max_ars_diag "engine speed threshold for diagnosis" VALUE 0xa1029610 _REC_VAL_20_u1 8160. _CNV_A_R_LINEAR_____9_CM 0. 8160. DISPLAY_IDENTIFIER C_N_MAX_ARS_DIAG FORMAT "%4.0" /end CHARACTERISTIC
/begin AXIS_PTS ldpm_ac_veh_trv_tcs "" 0xa10218d8 ac_veh_trv_tcs _REC_AXS_20_u2 102.35 _CNV_A_R_LINEAR_____272_CM 8 -51.175 51.175 FORMAT "%7.4" /end AXIS_PTS
/begin AXIS_PTS ldpm_vs_fil "" 0xa10223c0 vs_fil _REC_AXS_20_u2 511.99218 _CNV_A_R_LINEAR_____66_CM 8 0. 511.99218 FORMAT "%7.3" /end AXIS_PTS
/begin AXIS_PTS ldpm_n_32__tq_loss_ars "" 0xa1021e3c n_32 _REC_AXS_20_u1 8160. _CNV_A_R_LINEAR_____9_CM 8 0. 8160. FORMAT "%4.0" /end AXIS_PTS
/begin AXIS_PTS ldp_tq_loss_ars_sp_can_max "" 0xa1021564 tq_loss_ars_sp_can _REC_AXS_20_u2 2047.96875 _CNV_A_R_LINEAR_____65_CM 8 -1024. 1023.96875 FORMAT "%6.2" /end AXIS_PTS
/begin AXIS_PTS ldp_tq_loss_ars_av_can_max "" 0xa1021540 tq_loss_ars_av_can _REC_AXS_20_u2 2047.96875 _CNV_A_R_LINEAR_____65_CM 8 -1024. 1023.96875 FORMAT "%6.2" /end AXIS_PTS
/begin MEASUREMENT state_tq_ars_plaus "Bitwise coded State for ARS intervention state" UBYTE _CNV_A_R_LINEAR_____0_CM 1 100. 0. 255. DISPLAY_IDENTIFIER STATE_TQ_ARS_PLAUS ECU_ADDRESS 0xd0003ef4 FORMAT "%3.0" /end MEASUREMENT
/begin MEASUREMENT lv_tq_loss_ars_is_ad_inh "flag for inhibition of IS-control adaptations due to torque losses ARS" UBYTE _CNV_S_2_RANGE__0___1_CM 1 100. 0. 1. DISPLAY_IDENTIFIER LV_TQ_LOSS_ARS_IS_AD_INH ECU_ADDRESS 0xd0003ef9 BIT_MASK 0x1 /end MEASUREMENT
/begin CHARACTERISTIC c_tq_loss_ars_ad "threshold torque losses PSTE for inhibition of IS-control adaptations" VALUE 0xa1029b10 _REC_VAL_20_s2 2047.96875 _CNV_A_R_LINEAR_____30_CM -1024. 1023.96875 DISPLAY_IDENTIFIER C_TQ_LOSS_ARS_AD FORMAT "%8.2" /end CHARACTERISTIC
/begin CHARACTERISTIC c_t_ars_dly_ad "threshold torque losses PSTE for inhibition of IS-control adaptations" VALUE 0xa10297f8 _REC_VAL_20_u1 2.55 _CNV_A_R_LINEAR_____3_CM 0. 2.55 DISPLAY_IDENTIFIER C_T_ARS_DLY_AD FORMAT "%4.2" /end CHARACTERISTIC
/begin MEASUREMENT lv_asr_ena "Logical variable for ASR intervention enabling" UBYTE _CNV_S_2_RANGE__0___1_CM 1 100. 0. 1. DISPLAY_IDENTIFIER LV_ASR_ENA ECU_ADDRESS 0xc0000d78 BIT_MASK 0x1 /end MEASUREMENT
/begin MEASUREMENT lv_msr_ena "Logical variable for MSR intervention enabling" UBYTE _CNV_S_2_RANGE__0___1_CM 1 100. 0. 1. DISPLAY_IDENTIFIER LV_MSR_ENA ECU_ADDRESS 0xc0000d79 BIT_MASK 0x1 /end MEASUREMENT
/begin MEASUREMENT tqi_msr_fast_req "fast torque intervention due to MSR previous limp home check" SWORD _CNV_A_R_LINEAR_____30_CM 1 100. -1024. 1023.96875 DISPLAY_IDENTIFIER TQI_MSR_FAST_REQ ECU_ADDRESS 0xc0000d70 FORMAT "%8.2" /end MEASUREMENT
/begin MEASUREMENT tqi_msr_slow_req "slow torque intervention due to MSR previous limp home check" SWORD _CNV_A_R_LINEAR_____30_CM 1 100. -1024. 1023.96875 DISPLAY_IDENTIFIER TQI_MSR_SLOW_REQ ECU_ADDRESS 0xc0000d72 FORMAT "%8.2" /end MEASUREMENT
/begin MEASUREMENT sf_tqd "Status flag driving toque at clutch" UBYTE _CNV_A_R_LINEAR_____0_CM 1 100. 0. 3. DISPLAY_IDENTIFIER SF_TQD ECU_ADDRESS 0xd0003edc FORMAT "%2.0" /end MEASUREMENT
/begin MEASUREMENT lv_tcs_disable "Logical variable for disabling TCS intervention due to EMS error" UBYTE _CNV_S_2_RANGE__0___1_CM 1 100. 0. 1. DISPLAY_IDENTIFIER LV_TCS_DISABLE ECU_ADDRESS 0xd0003ee1 BIT_MASK 0x1 /end MEASUREMENT
/begin MEASUREMENT tqi_asr_slow "torque decrement for slow torque intervention during TCS" SWORD _CNV_A_R_LINEAR_____30_CM 1 100. -1024. 1023.96875 DISPLAY_IDENTIFIER TQI_ASR_SLOW ECU_ADDRESS 0xd0005332 FORMAT "%8.2" /end MEASUREMENT
/begin CHARACTERISTIC c_lgrd_lih_asr "Limiting gradient for ASR emergency ramp function (default 0.6 Nm/10ms)" VALUE 0xa102951e _REC_VAL_20_u2 1023.96875 _CNV_A_R_LINEAR_____165_CM 0. 1023.96875 DISPLAY_IDENTIFIER C_LGRD_LIH_ASR FORMAT "%7.2" /end CHARACTERISTIC
/begin CHARACTERISTIC c_t_dly_lih_asr "Delay time for activation of ASR emergency ramp function (default 0 s)" VALUE 0xa1029868 _REC_VAL_20_u1 2.55 _CNV_A_R_LINEAR_____3_CM 0. 2.55 DISPLAY_IDENTIFIER C_T_DLY_LIH_ASR FORMAT "%4.2" /end CHARACTERISTIC
/begin MEASUREMENT tqi_asr_fast_req "fast torque intervention due to ASR" SWORD _CNV_A_R_LINEAR_____30_CM 1 100. -1024. 1023.96875 DISPLAY_IDENTIFIER TQI_ASR_FAST_REQ ECU_ADDRESS 0xc0000d6c FORMAT "%8.2" /end MEASUREMENT
/begin MEASUREMENT tqi_asr_fast_req_1 "Torque decrement for fast torque intervention during TCS" SWORD _CNV_A_R_LINEAR_____30_CM 1 100. -1024. 1023.96875 DISPLAY_IDENTIFIER TQI_ASR_FAST_REQ_1 ECU_ADDRESS 0xd0005328 FORMAT "%8.2" /end MEASUREMENT
/begin MEASUREMENT tqi_asr_slow_req "slow torque intervention due to ASR" SWORD _CNV_A_R_LINEAR_____30_CM 1 100. -1024. 1023.96875 DISPLAY_IDENTIFIER TQI_ASR_SLOW_REQ ECU_ADDRESS 0xc0000d6e FORMAT "%8.2" /end MEASUREMENT
/begin MEASUREMENT tqi_msr_fast_req_1 "Torque increase for fast torque intervention during TCS" SWORD _CNV_A_R_LINEAR_____30_CM 1 100. -1024. 1023.96875 DISPLAY_IDENTIFIER TQI_MSR_FAST_REQ_1 ECU_ADDRESS 0xd000532c FORMAT "%8.2" /end MEASUREMENT
/begin MEASUREMENT tqi_asr_slow_req_1 "torque decrement for slow torque intervention during TCS" SWORD _CNV_A_R_LINEAR_____30_CM 1 100. -1024. 1023.96875 DISPLAY_IDENTIFIER TQI_ASR_SLOW_REQ_1 ECU_ADDRESS 0xd000532a FORMAT "%8.2" /end MEASUREMENT
/begin MEASUREMENT tqi_msr_slow_req_1 "Torque increase for slow torque intervention during gear shift" SWORD _CNV_A_R_LINEAR_____30_CM 1 100. -1024. 1023.96875 DISPLAY_IDENTIFIER TQI_MSR_SLOW_REQ_1 ECU_ADDRESS 0xd000532e FORMAT "%8.2" /end MEASUREMENT
/begin MEASUREMENT tqi_asr_fast "torque decrement for fast torque intervention during TCS" SWORD _CNV_A_R_LINEAR_____30_CM 1 100. -1024. 1023.96875 DISPLAY_IDENTIFIER TQI_ASR_FAST ECU_ADDRESS 0xd0005330 FORMAT "%8.2" /end MEASUREMENT
/begin MEASUREMENT tqi_msr_fast "fast torque intervention due to MSR" SWORD _CNV_A_R_LINEAR_____30_CM 1 100. -1024. 1023.96875 DISPLAY_IDENTIFIER TQI_MSR_FAST ECU_ADDRESS 0xd0005334 FORMAT "%8.2" /end MEASUREMENT
/begin MEASUREMENT tqi_msr_slow "slow torque intervention due to MSR" SWORD _CNV_A_R_LINEAR_____30_CM 1 100. -1024. 1023.96875 DISPLAY_IDENTIFIER TQI_MSR_SLOW ECU_ADDRESS 0xd0005336 FORMAT "%8.2" /end MEASUREMENT
/begin MEASUREMENT lv_msr_lih "Logical variable fortorque intervention limp home due toMSR" UBYTE _CNV_S_2_RANGE__0___1_CM 1 100. 0. 1. DISPLAY_IDENTIFIER LV_MSR_LIH ECU_ADDRESS 0xd0003ee0 BIT_MASK 0x1 /end MEASUREMENT
/begin MEASUREMENT lv_msr_act "Logical variable fortorque intervention due to MSR" UBYTE _CNV_S_2_RANGE__0___1_CM 1 100. 0. 1. DISPLAY_IDENTIFIER LV_MSR_ACT ECU_ADDRESS 0xd0003edf BIT_MASK 0x1 /end MEASUREMENT
/begin CHARACTERISTIC c_t_dly_lih_msr "Delay time for activation of MSR emergency ramp function (default 0 s)" VALUE 0xa102986d _REC_VAL_20_u1 2.55 _CNV_A_R_LINEAR_____3_CM 0. 2.55 DISPLAY_IDENTIFIER C_T_DLY_LIH_MSR FORMAT "%4.2" /end CHARACTERISTIC
/begin MEASUREMENT lv_asr_act "Logical variable fortorque intervention due to ASR" UBYTE _CNV_S_2_RANGE__0___1_CM 1 100. 0. 1. DISPLAY_IDENTIFIER LV_ASR_ACT ECU_ADDRESS 0xd0003ede BIT_MASK 0x1 /end MEASUREMENT
/begin CHARACTERISTIC lc_msr_disable "logical constant to disable MSR interventions" VALUE 0xa1029d7e _REC_VAL_20_u1 1. _CNV_S_2_RANGE______75_CM 0. 1. DISPLAY_IDENTIFIER LC_MSR_DISABLE /end CHARACTERISTIC
/begin MEASUREMENT lv_tcs_ena "Logical variable for basically TCS intervention enabling" UBYTE _CNV_S_2_RANGE__0___1_CM 1 100. 0. 1. DISPLAY_IDENTIFIER LV_TCS_ENA ECU_ADDRESS 0xc0000d76 BIT_MASK 0x1 /end MEASUREMENT
/begin MEASUREMENT lv_tcs_disable_can "logical variable for disabling TCS intervention due to EMS CAN error" UBYTE _CNV_S_2_RANGE__0___1_CM 1 100. 0. 1. DISPLAY_IDENTIFIER LV_TCS_DISABLE_CAN ECU_ADDRESS 0xd0003ee2 BIT_MASK 0x1 /end MEASUREMENT
/begin MEASUREMENT lv_asr_lih "logical variable for torque intervention LIH due to TCS" UBYTE _CNV_S_2_RANGE__0___1_CM 1 100. 0. 1. DISPLAY_IDENTIFIER LV_ASR_LIH ECU_ADDRESS 0xc0000d77 BIT_MASK 0x1 /end MEASUREMENT
/begin MEASUREMENT t_asr_lih_ctr "Delay time" UBYTE _CNV_A_R_LINEAR_____3_CM 1 100. 0. 2.55 DISPLAY_IDENTIFIER T_ASR_LIH_CTR ECU_ADDRESS 0xc0000d74 FORMAT "%4.2" /end MEASUREMENT
/begin MEASUREMENT t_msr_lih_ctr "Delay time" UBYTE _CNV_A_R_LINEAR_____3_CM 1 100. 0. 2.55 DISPLAY_IDENTIFIER T_MSR_LIH_CTR ECU_ADDRESS 0xc0000d75 FORMAT "%4.2" /end MEASUREMENT
/begin CHARACTERISTIC c_lgrd_lih_msr "Limiting gradient for MSR emergency ramp function (default 0.6 Nm/10ms)" VALUE 0xa1029528 _REC_VAL_20_u2 1023.96875 _CNV_A_R_LINEAR_____165_CM 0. 1023.96875 DISPLAY_IDENTIFIER C_LGRD_LIH_MSR FORMAT "%7.2" /end CHARACTERISTIC
/begin CHARACTERISTIC c_tq_max_msr "limiting torque for MSR" VALUE 0xa1029b24 _REC_VAL_20_u2 2047.96875 _CNV_A_R_LINEAR_____65_CM -1024. 1023.96875 DISPLAY_IDENTIFIER C_TQ_MAX_MSR FORMAT "%6.2" /end CHARACTERISTIC
/begin CHARACTERISTIC lc_asr_disable "logical constant to disable ASR interventions" VALUE 0xa1029d0d _REC_VAL_20_u1 1. _CNV_S_2_RANGE______75_CM 0. 1. DISPLAY_IDENTIFIER LC_ASR_DISABLE /end CHARACTERISTIC
/begin MEASUREMENT state_tq_tcs_plaus "Bitwise coded State for TCS intervention state" UBYTE _CNV_A_R_LINEAR_____0_CM 1 100. 0. 255. DISPLAY_IDENTIFIER STATE_TQ_TCS_PLAUS ECU_ADDRESS 0xd0003edd FORMAT "%3.0" /end MEASUREMENT
/begin MEASUREMENT lv_tqi_bol_set "Logical variable it is set if  TQI_SP  falls below TQI_BOL" UBYTE _CNV_S_2_RANGE__0___1_CM 1 100. 0. 1. DISPLAY_IDENTIFIER LV_TQI_BOL_SET ECU_ADDRESS 0xd0003ebc BIT_MASK 0x1 /end MEASUREMENT
/begin CHARACTERISTIC c_tqi_bol_set_hys "Hysteresis for recognition bottom level indicated engine torque" VALUE 0xa1029b3a _REC_VAL_20_u2 1023.96875 _CNV_A_R_LINEAR_____30_CM 0. 1023.96875 DISPLAY_IDENTIFIER C_TQI_BOL_SET_HYS FORMAT "%7.2" /end CHARACTERISTIC
/begin MEASUREMENT tqi_bol "Indicated engine torque bottom level at minimum load and maximum spark retard for engine run free of misfire " SWORD _CNV_A_R_LINEAR_____30_CM 1 100. -1024. 1023.96875 DISPLAY_IDENTIFIER TQI_BOL ECU_ADDRESS 0xc0000d9c FORMAT "%8.2" /end MEASUREMENT
/begin MEASUREMENT ti_add[0] "Total cylinder balancing additive correction value" SWORD _CNV_A_R_LINEAR_____233_CM 1 100. -32.768 32.767 DISPLAY_IDENTIFIER TI_ADD_0 ECU_ADDRESS 0xd0004bc8 FORMAT "%7.3" /end MEASUREMENT
/begin MEASUREMENT ti_add[1] "Total cylinder balancing additive correction value" SWORD _CNV_A_R_LINEAR_____233_CM 1 100. -32.768 32.767 DISPLAY_IDENTIFIER TI_ADD_1 ECU_ADDRESS 0xd0004bca FORMAT "%7.3" /end MEASUREMENT
/begin MEASUREMENT ti_add[2] "Total cylinder balancing additive correction value" SWORD _CNV_A_R_LINEAR_____233_CM 1 100. -32.768 32.767 DISPLAY_IDENTIFIER TI_ADD_2 ECU_ADDRESS 0xd0004bcc FORMAT "%7.3" /end MEASUREMENT
/begin MEASUREMENT ti_add[3] "Total cylinder balancing additive correction value" SWORD _CNV_A_R_LINEAR_____233_CM 1 100. -32.768 32.767 DISPLAY_IDENTIFIER TI_ADD_3 ECU_ADDRESS 0xd0004bce FORMAT "%7.3" /end MEASUREMENT
/begin MEASUREMENT ti_add[4] "Total cylinder balancing additive correction value" SWORD _CNV_A_R_LINEAR_____233_CM 1 100. -32.768 32.767 DISPLAY_IDENTIFIER TI_ADD_4 ECU_ADDRESS 0xd0004bd0 FORMAT "%7.3" /end MEASUREMENT
/begin MEASUREMENT ti_add[5] "Total cylinder balancing additive correction value" SWORD _CNV_A_R_LINEAR_____233_CM 1 100. -32.768 32.767 DISPLAY_IDENTIFIER TI_ADD_5 ECU_ADDRESS 0xd0004bd2 FORMAT "%7.3" /end MEASUREMENT
/begin MEASUREMENT ti_fac[0] "Total cylinder balancing multiple correction factor" UWORD _CNV_A_R_LINEAR_____8_CM 1 100. 0. 1.99996948242188 DISPLAY_IDENTIFIER TI_FAC_0 ECU_ADDRESS 0xd0004bd4 FORMAT "%7.5" /end MEASUREMENT
/begin MEASUREMENT ti_fac[1] "Total cylinder balancing multiple correction factor" UWORD _CNV_A_R_LINEAR_____8_CM 1 100. 0. 1.99996948242188 DISPLAY_IDENTIFIER TI_FAC_1 ECU_ADDRESS 0xd0004bd6 FORMAT "%7.5" /end MEASUREMENT
/begin MEASUREMENT ti_fac[2] "Total cylinder balancing multiple correction factor" UWORD _CNV_A_R_LINEAR_____8_CM 1 100. 0. 1.99996948242188 DISPLAY_IDENTIFIER TI_FAC_2 ECU_ADDRESS 0xd0004bd8 FORMAT "%7.5" /end MEASUREMENT
/begin MEASUREMENT ti_fac[3] "Total cylinder balancing multiple correction factor" UWORD _CNV_A_R_LINEAR_____8_CM 1 100. 0. 1.99996948242188 DISPLAY_IDENTIFIER TI_FAC_3 ECU_ADDRESS 0xd0004bda FORMAT "%7.5" /end MEASUREMENT
/begin MEASUREMENT ti_fac[4] "Total cylinder balancing multiple correction factor" UWORD _CNV_A_R_LINEAR_____8_CM 1 100. 0. 1.99996948242188 DISPLAY_IDENTIFIER TI_FAC_4 ECU_ADDRESS 0xd0004bdc FORMAT "%7.5" /end MEASUREMENT
/begin MEASUREMENT ti_fac[5] "Total cylinder balancing multiple correction factor" UWORD _CNV_A_R_LINEAR_____8_CM 1 100. 0. 1.99996948242188 DISPLAY_IDENTIFIER TI_FAC_5 ECU_ADDRESS 0xd0004bde FORMAT "%7.5" /end MEASUREMENT
/begin AXIS_PTS ldpm_n_32_2_evac "" 0xa1005384 n_32 _REC_AXS_20_u1 8160. _CNV_A_R_LINEAR_____9_CM 12 0. 8160. FORMAT "%4.0" /end AXIS_PTS
/begin AXIS_PTS ldpm_maf_2_evac "" 0xa1005300 NO_INPUT_QUANTITY _REC_AXS_20_u1 1389. _CNV_A_R_LINEAR_____14_CM 12 0. 1389. FORMAT "%4.0" /end AXIS_PTS
/begin AXIS_PTS ldpm_n_32_1_evac "" 0xa100537a n_32 _REC_AXS_20_u1 8160. _CNV_A_R_LINEAR_____9_CM 6 0. 8160. FORMAT "%4.0" /end AXIS_PTS
/begin AXIS_PTS ldpm_amp_1_evac "" 0xa10052e8 amp _REC_AXS_20_u2 5434. _CNV_A_R_LINEAR_____26_CM 6 0. 5434. FORMAT "%7.2" /end AXIS_PTS
/begin AXIS_PTS ldpm_n_32_3_evac "" 0xa1005394 n_32 _REC_AXS_20_u1 8160. _CNV_A_R_LINEAR_____9_CM 8 0. 8160. FORMAT "%4.0" /end AXIS_PTS
/begin AXIS_PTS ldpm_vb_1_evac "" 0xa1005404 vb _REC_AXS_20_u1 26. _CNV_A_R_LINEAR_____36_CM 8 0. 26. FORMAT "%4.1" /end AXIS_PTS
/begin AXIS_PTS ldpm_prs_cps_1_evac "" 0xa10053b0 prs_cps _REC_AXS_20_u2 5434. _CNV_A_R_EVAC_LINEA_294_CM 16 -2717.04 2716.96 FORMAT "%8.2" /end AXIS_PTS
/begin AXIS_PTS ldpm_map_1_evac "" 0xa100536c map _REC_AXS_20_u2 5434. _CNV_A_R_LINEAR_____26_CM 6 0. 5434. FORMAT "%7.2" /end AXIS_PTS
/begin AXIS_PTS ldpm_tia_1_evac "" 0xa10053d2 tia _REC_AXS_20_u1 190.5 _CNV_A_R_LINEAR_____16_CM 3 -48. 142.5 FORMAT "%6.2" /end AXIS_PTS
/begin AXIS_PTS ldpm_tqi_sp_s_2_evac "" 0xa10053d8 tqi_sp _REC_AXS_20_u2 1023.96875 _CNV_A_R_LINEAR_____30_CM 6 0. 1023.96875 FORMAT "%7.2" /end AXIS_PTS
/begin AXIS_PTS ldpm_maf_cyl_1_evac "" 0xa1005310 maf_cyl _REC_AXS_20_u2 2047.96875 _CNV_A_R_LINEAR_____207_CM 6 0. 2047.96875 FORMAT "%10.5" /end AXIS_PTS
/begin MEASUREMENT state_t_sdl_cp "state of time control function" UBYTE _CNV_S_9_STATE_T_SD_295_CM 1 100. 0. 8. DISPLAY_IDENTIFIER STATE_T_SDL_CP ECU_ADDRESS 0xd0002eae /end MEASUREMENT
/begin MEASUREMENT t_cp "time of actual CP time range " UWORD _CNV_A_R_LINEAR_____4_CM 1 100. 0. 6553.5 DISPLAY_IDENTIFIER T_CP ECU_ADDRESS 0xc0001f52 FORMAT "%6.1" /end MEASUREMENT
/begin MEASUREMENT lv_cp_ena "logical value for enabled canister purge" UBYTE _CNV_S_2_RANGE__0___1_CM 1 100. 0. 1. DISPLAY_IDENTIFIER LV_CP_ENA ECU_ADDRESS 0xd0002e8b BIT_MASK 0x1 /end MEASUREMENT
/begin CHARACTERISTIC c_cl_mmv_t_bol "time management CL bottom limit" VALUE 0xa1006096 _REC_VAL_20_u2 1.99996948242188 _CNV_A_R_LINEAR_____8_CM 0. 1.99996948242188 DISPLAY_IDENTIFIER C_CL_MMV_T_BOL FORMAT "%7.5" /end CHARACTERISTIC
/begin CHARACTERISTIC c_cl_mmv_t_tol "time management CL top limit" VALUE 0xa1006098 _REC_VAL_20_u2 1.99996948242188 _CNV_A_R_LINEAR_____8_CM 0. 1.99996948242188 DISPLAY_IDENTIFIER C_CL_MMV_T_TOL FORMAT "%7.5" /end CHARACTERISTIC
/begin AXIS_PTS ldp_cl_mmv_ip_t_max_cp "" 0xa1005224 cl_mmv _REC_AXS_20_u2 1.99996948242188 _CNV_A_R_LINEAR_____8_CM 6 0. 1.99996948242188 FORMAT "%7.5" /end AXIS_PTS
/begin MEASUREMENT t_ad "Time out for adaption phase" UWORD _CNV_A_R_LINEAR_____4_CM 1 100. 0. 6553.5 DISPLAY_IDENTIFIER T_AD ECU_ADDRESS 0xc0001f4e FORMAT "%6.1" /end MEASUREMENT
/begin MEASUREMENT t_max_ad "Maximum adaption time; used to disable CP ehwn canister is detected empty" UWORD _CNV_A_R_LINEAR_____4_CM 1 100. 0. 6553.5 DISPLAY_IDENTIFIER T_MAX_AD ECU_ADDRESS 0xc0001f62 FORMAT "%6.1" /end MEASUREMENT
/begin MEASUREMENT lv_lam_ad_ena "lambda adaptation enabled" UBYTE _CNV_S_2_RANGE__0___1_CM 1 100. 0. 1. DISPLAY_IDENTIFIER LV_LAM_AD_ENA ECU_ADDRESS 0xd0002e99 BIT_MASK 0x1 /end MEASUREMENT
/begin MEASUREMENT ctr_lam_ad_sdl_cp "" UBYTE _CNV_A_R_LINEAR_____0_CM 1 100. 0. 255. DISPLAY_IDENTIFIER CTR_LAM_AD_SDL_CP ECU_ADDRESS 0xc0001f73 FORMAT "%3.0" /end MEASUREMENT
/begin CHARACTERISTIC c_state_man_sdl_cp "selection of manual scheduling mode" VALUE 0xa1006136 _REC_VAL_20_u1 3. _CNV_S_4_STATE_MAN__296_CM 0. 3. DISPLAY_IDENTIFIER C_STATE_MAN_SDL_CP /end CHARACTERISTIC
/begin CHARACTERISTIC lc_mff_ad_ena_pas "switch to enable lambda adaption while cp passive" VALUE 0xa10061bb _REC_VAL_20_u1 1. _CNV_A_R_LINEAR_____0_CM 0. 1. DISPLAY_IDENTIFIER LC_MFF_AD_ENA_PAS FORMAT "%1.0" /end CHARACTERISTIC
/begin CHARACTERISTIC lc_cp_ena_wait_lam "switch to permanently enable canister purge in WAIT_LAM" VALUE 0xa10061a3 _REC_VAL_20_u1 1. _CNV_A_R_LINEAR_____0_CM 0. 1. DISPLAY_IDENTIFIER LC_CP_ENA_WAIT_LAM FORMAT "%1.0" /end CHARACTERISTIC
/begin CHARACTERISTIC lc_cl_cp_dyn_end_ena "switch to enable end of CP phase when reaching low canister load" VALUE 0xa1006198 _REC_VAL_20_u1 1. _CNV_A_R_LINEAR_____0_CM 0. 1. DISPLAY_IDENTIFIER LC_CL_CP_DYN_END_ENA FORMAT "%1.0" /end CHARACTERISTIC
/begin CHARACTERISTIC lc_lam_lim_ad_ena "switch to enable forced lambda adaption " VALUE 0xa10061b7 _REC_VAL_20_u1 1. _CNV_A_R_LINEAR_____0_CM 0. 1. DISPLAY_IDENTIFIER LC_LAM_LIM_AD_ENA FORMAT "%1.0" /end CHARACTERISTIC
/begin CHARACTERISTIC lc_sdl_lam_ad_cdn_off "switch to ignore LV_LAM_AD_CDN" VALUE 0xa10061be _REC_VAL_20_u1 1. _CNV_A_R_LINEAR_____0_CM 0. 1. DISPLAY_IDENTIFIER LC_SDL_LAM_AD_CDN_OFF FORMAT "%1.0" /end CHARACTERISTIC
/begin CHARACTERISTIC c_t_2_cp "duration of purge phase" VALUE 0xa100613a _REC_VAL_20_u2 6553.400000000001 _CNV_A_R_LINEAR_____4_CM 0.1 6553.5 DISPLAY_IDENTIFIER C_T_2_CP FORMAT "%6.1" /end CHARACTERISTIC
/begin CHARACTERISTIC c_t_di_cp "Disable time of purge phase when canister detected empty" VALUE 0xa1006146 _REC_VAL_20_u2 6553.400000000001 _CNV_A_R_LINEAR_____4_CM 0.1 6553.5 DISPLAY_IDENTIFIER C_T_DI_CP FORMAT "%6.1" /end CHARACTERISTIC
/begin CHARACTERISTIC c_t_mff_ad_max "time out for adaptation phase" VALUE 0xa1006170 _REC_VAL_20_u2 6553.400000000001 _CNV_A_R_LINEAR_____4_CM 0.1 6553.5 DISPLAY_IDENTIFIER C_T_MFF_AD_MAX FORMAT "%6.1" /end CHARACTERISTIC
/begin CHARACTERISTIC id_t_lam_ad_thd[0] "array[NC_NR_CP_LAM_AD elements] for start time of fixed lambda adaptation slices" VALUE 0xa1006190 _REC_VAL_20_u2 6553.400000000001 _CNV_A_R_LINEAR_____4_CM 0.1 6553.5 DISPLAY_IDENTIFIER ID_T_LAM_AD_THD[0] FORMAT "%6.1" /end CHARACTERISTIC
/begin CHARACTERISTIC id_t_lam_ad_thd[1] "array[NC_NR_CP_LAM_AD elements] for start time of fixed lambda adaptation slices" VALUE 0xa1006192 _REC_VAL_20_u2 6553.400000000001 _CNV_A_R_LINEAR_____4_CM 0.1 6553.5 DISPLAY_IDENTIFIER ID_T_LAM_AD_THD[1] FORMAT "%6.1" /end CHARACTERISTIC
/begin CHARACTERISTIC id_t_lam_ad_thd[2] "array[NC_NR_CP_LAM_AD elements] for start time of fixed lambda adaptation slices" VALUE 0xa1006194 _REC_VAL_20_u2 6553.400000000001 _CNV_A_R_LINEAR_____4_CM 0.1 6553.5 DISPLAY_IDENTIFIER ID_T_LAM_AD_THD[2] FORMAT "%6.1" /end CHARACTERISTIC
/begin CHARACTERISTIC id_t_lam_ad_thd[3] "array[NC_NR_CP_LAM_AD elements] for start time of fixed lambda adaptation slices" VALUE 0xa1006196 _REC_VAL_20_u2 6553.400000000001 _CNV_A_R_LINEAR_____4_CM 0.1 6553.5 DISPLAY_IDENTIFIER ID_T_LAM_AD_THD[3] FORMAT "%6.1" /end CHARACTERISTIC
/begin CHARACTERISTIC id_dur_lam_ad[0] "array[NC_NR_CP_LAM_AD elements] for duration of fixed lambda adaptation slices" VALUE 0xa1006188 _REC_VAL_20_u2 6553.400000000001 _CNV_A_R_LINEAR_____4_CM 0.1 6553.5 DISPLAY_IDENTIFIER ID_DUR_LAM_AD[0] FORMAT "%6.1" /end CHARACTERISTIC
/begin CHARACTERISTIC id_dur_lam_ad[1] "array[NC_NR_CP_LAM_AD elements] for duration of fixed lambda adaptation slices" VALUE 0xa100618a _REC_VAL_20_u2 6553.400000000001 _CNV_A_R_LINEAR_____4_CM 0.1 6553.5 DISPLAY_IDENTIFIER ID_DUR_LAM_AD[1] FORMAT "%6.1" /end CHARACTERISTIC
/begin CHARACTERISTIC id_dur_lam_ad[2] "array[NC_NR_CP_LAM_AD elements] for duration of fixed lambda adaptation slices" VALUE 0xa100618c _REC_VAL_20_u2 6553.400000000001 _CNV_A_R_LINEAR_____4_CM 0.1 6553.5 DISPLAY_IDENTIFIER ID_DUR_LAM_AD[2] FORMAT "%6.1" /end CHARACTERISTIC
/begin CHARACTERISTIC id_dur_lam_ad[3] "array[NC_NR_CP_LAM_AD elements] for duration of fixed lambda adaptation slices" VALUE 0xa100618e _REC_VAL_20_u2 6553.400000000001 _CNV_A_R_LINEAR_____4_CM 0.1 6553.5 DISPLAY_IDENTIFIER ID_DUR_LAM_AD[3] FORMAT "%6.1" /end CHARACTERISTIC
/begin CHARACTERISTIC ip_t_max_cp "duration of maximum purge versus canister load" CURVE 0xa1006054 _REC_CUR_20_u2_u2 6553.400000000001 _CNV_A_R_LINEAR_____4_CM 0.1 6553.5 DISPLAY_IDENTIFIER IP_T_MAX_CP FORMAT "%6.1"
 /begin AXIS_DESCR COM_AXIS cl_mmv _CNV_A_R_LINEAR_____8_CM 6 0. 1.99996948242188 FORMAT "%7.5" AXIS_PTS_REF ldp_cl_mmv_ip_t_max_cp /end AXIS_DESCR
/end CHARACTERISTIC
/begin CHARACTERISTIC c_t_sdl_ext_req "Time for external request" VALUE 0xa1006172 _REC_VAL_20_u2 6553.400000000001 _CNV_A_R_LINEAR_____4_CM 0.1 6553.5 DISPLAY_IDENTIFIER C_T_SDL_EXT_REQ FORMAT "%6.1" /end CHARACTERISTIC
/begin CHARACTERISTIC c_cl_mmv_t_wait_lam "CL threshold to switch off CP during WAIT_LAM" VALUE 0xa100609a _REC_VAL_20_u2 1.99996948242188 _CNV_A_R_LINEAR_____8_CM 0. 1.99996948242188 DISPLAY_IDENTIFIER C_CL_MMV_T_WAIT_LAM FORMAT "%7.5" /end CHARACTERISTIC
/begin CHARACTERISTIC c_tco_dyn_t_ctl "Minimum temperature for activation of dynamic time control between EVAP and lambda adaptation" VALUE 0xa100617c _REC_VAL_20_u1 190.5 _CNV_A_R_LINEAR_____16_CM -48. 142.5 DISPLAY_IDENTIFIER C_TCO_DYN_T_CTL FORMAT "%6.2" /end CHARACTERISTIC
/begin MEASUREMENT lv_cp_ramp_open_act "Logical value for active RAMP_OPEN operation" UBYTE _CNV_S_2_RANGE__0___1_CM 1 100. 0. 1. DISPLAY_IDENTIFIER LV_CP_RAMP_OPEN_ACT ECU_ADDRESS 0xd0002e8d BIT_MASK 0x1 /end MEASUREMENT
/begin MEASUREMENT lv_cl_clc_vld "Actual CL value usable for intelligent MIN_PURGE" UBYTE _CNV_S_2_RANGE__0___1_CM 1 100. 0. 1. DISPLAY_IDENTIFIER LV_CL_CLC_VLD ECU_ADDRESS 0xd0002e79 BIT_MASK 0x1 /end MEASUREMENT
/begin MEASUREMENT flow_ctl_cps "Flow setpoint through the CPS" UWORD _CNV_A_R_LINEAR_____147_CM 1 100. 0. 7.9998779296875 DISPLAY_IDENTIFIER FLOW_CTL_CPS ECU_ADDRESS 0xc0001e7c FORMAT "%6.4" /end MEASUREMENT
/begin MEASUREMENT flow_tar_cps "Flow setpoint through the CPS, target flow setpoint to be reached after ramping" UWORD _CNV_A_R_LINEAR_____147_CM 1 100. 0. 7.9998779296875 DISPLAY_IDENTIFIER FLOW_TAR_CPS ECU_ADDRESS 0xc0001e88 FORMAT "%6.4" /end MEASUREMENT
/begin MEASUREMENT flow_open_cps "Setpoint value for the flow through CPS during RAMP_OPEN_FAST" UWORD _CNV_A_R_LINEAR_____147_CM 1 100. 0. 7.9998779296875 DISPLAY_IDENTIFIER FLOW_OPEN_CPS ECU_ADDRESS 0xc0001e86 FORMAT "%6.4" /end MEASUREMENT
/begin MEASUREMENT lv_t_dly_req_cp "Logical value for enabled lambda adaptation" UBYTE _CNV_S_2_RANGE__0___1_CM 1 100. 0. 1. DISPLAY_IDENTIFIER LV_T_DLY_REQ_CP ECU_ADDRESS 0xc0001f8b BIT_MASK 0x1 /end MEASUREMENT
/begin MEASUREMENT t_dly_max_cp "Time counter between the end of a MAX_PURGE and a new RAMP_OPEN request" UWORD _CNV_A_R_LINEAR_____4_CM 1 100. 0. 6553.5 DISPLAY_IDENTIFIER T_DLY_MAX_CP ECU_ADDRESS 0xc0001f5e FORMAT "%6.1" /end MEASUREMENT
/begin CHARACTERISTIC c_t_dly_cp_purge_tube "Time at the start of WAIT_RAMP_OPEN where in the purge tube may be purged itself " VALUE 0xa1006158 _REC_VAL_20_u2 6553.5 _CNV_A_R_LINEAR_____4_CM 0. 6553.5 DISPLAY_IDENTIFIER C_T_DLY_CP_PURGE_TUBE FORMAT "%6.1" /end CHARACTERISTIC
/begin CHARACTERISTIC c_t_di_max_cp "Maximum time for disabling Max_purge operation" VALUE 0xa1006148 _REC_VAL_20_u2 6553.5 _CNV_A_R_LINEAR_____4_CM 0. 6553.5 DISPLAY_IDENTIFIER C_T_DI_MAX_CP FORMAT "%6.1" /end CHARACTERISTIC
/begin CHARACTERISTIC lc_lam_lin_cps "Type of O2 sensor" VALUE 0xa10061b8 _REC_VAL_20_u1 1. _CNV_A_R_LINEAR_____0_CM 0. 1. DISPLAY_IDENTIFIER LC_LAM_LIN_CPS FORMAT "%1.0" /end CHARACTERISTIC
/begin AXIS_PTS ldp_n_32_id_flow_inc_nr_cp "" 0xa1005296 n_32 _REC_AXS_20_u1 8160. _CNV_A_R_LINEAR_____9_CM 4 0. 8160. FORMAT "%4.0" /end AXIS_PTS
/begin MEASUREMENT state_cll_deac_cp "Deactivation states of NORMAL_PURGE" UBYTE _CNV_S_4_STATE_CLL__300_CM 1 100. 0. 3. DISPLAY_IDENTIFIER STATE_CLL_DEAC_CP ECU_ADDRESS 0xd0002eaa /end MEASUREMENT
/begin MEASUREMENT state_lock_cp "Deactivation states of NORMAL_PURGE" UBYTE _CNV_S_3_STATE_LOCK_301_CM 1 100. 0. 2. DISPLAY_IDENTIFIER STATE_LOCK_CP ECU_ADDRESS 0xd0002eac /end MEASUREMENT
/begin MEASUREMENT lv_cp_cdn_ramp_open "Logical value for active RAMP_OPEN operation" UBYTE _CNV_S_2_RANGE__0___1_CM 1 100. 0. 1. DISPLAY_IDENTIFIER LV_CP_CDN_RAMP_OPEN ECU_ADDRESS 0xd0002e81 BIT_MASK 0x1 /end MEASUREMENT
/begin MEASUREMENT lv_cp_cdn_ramp_open_fast "Logical value for active RAMP_OPEN operation" UBYTE _CNV_S_2_RANGE__0___1_CM 1 100. 0. 1. DISPLAY_IDENTIFIER LV_CP_CDN_RAMP_OPEN_FAST ECU_ADDRESS 0xc0001f7d BIT_MASK 0x1 /end MEASUREMENT
/begin MEASUREMENT lv_cl_clc_avl "" UBYTE _CNV_S_2_RANGE__0___1_CM 1 100. 0. 1. DISPLAY_IDENTIFIER LV_CL_CLC_AVL ECU_ADDRESS 0xd0002e78 BIT_MASK 0x1 /end MEASUREMENT
/begin MEASUREMENT flow_sp_cps "Flow setpoint through the CPS" UWORD _CNV_A_R_LINEAR_____147_CM 1 100. 0. 7.9998779296875 DISPLAY_IDENTIFIER FLOW_SP_CPS ECU_ADDRESS 0xd00026bc FORMAT "%6.4" /end MEASUREMENT
/begin MEASUREMENT flow_cor_cps "Corrected flow setpoint through the CPS" UWORD _CNV_A_R_LINEAR_____147_CM 1 100. 0. 7.9998779296875 DISPLAY_IDENTIFIER FLOW_COR_CPS ECU_ADDRESS 0xd00026ae FORMAT "%6.4" /end MEASUREMENT
/begin MEASUREMENT flow_cps "Flow through the CPS" UWORD _CNV_A_R_LINEAR_____147_CM 1 100. 0. 7.9998779296875 DISPLAY_IDENTIFIER FLOW_CPS ECU_ADDRESS 0xd00026b0 FORMAT "%6.4" /end MEASUREMENT
/begin MEASUREMENT flow_dly_cp "Filtered value of FLOW_CPS (Padé Filter)" UWORD _CNV_A_R_LINEAR_____147_CM 1 100. 0. 7.9998779296875 DISPLAY_IDENTIFIER FLOW_DLY_CP ECU_ADDRESS 0xd00026b4 FORMAT "%6.4" /end MEASUREMENT
/begin MEASUREMENT flow_dly_mmv_cp "Moving mean value of FLOW_CPS_DLY" UWORD _CNV_A_R_LINEAR_____147_CM 1 100. 0. 7.9998779296875 DISPLAY_IDENTIFIER FLOW_DLY_MMV_CP ECU_ADDRESS 0xd00026b6 FORMAT "%6.4" /end MEASUREMENT
/begin MEASUREMENT flow_dly_old_2_cp "Old value of FLOW_CPS_DLY for Padé Filter calculation for FLOW_CPS_DLY" UWORD _CNV_A_R_LINEAR_____147_CM 1 100. 0. 7.9998779296875 DISPLAY_IDENTIFIER FLOW_DLY_OLD_2_CP ECU_ADDRESS 0xc0001e80 FORMAT "%6.4" /end MEASUREMENT
/begin MEASUREMENT flow_cps_old_1 "Old value of FLOW_CPS for Padé Filter calculation for FLOW_CPS_DLY" UWORD _CNV_A_R_LINEAR_____147_CM 1 100. 0. 7.9998779296875 DISPLAY_IDENTIFIER FLOW_CPS_OLD_1 ECU_ADDRESS 0xc0001e78 FORMAT "%6.4" /end MEASUREMENT
/begin MEASUREMENT flow_cps_old_2 "Old value of FLOW_CPS for Padé Filter calculation for FLOW_CPS_DLY" UWORD _CNV_A_R_LINEAR_____147_CM 1 100. 0. 7.9998779296875 DISPLAY_IDENTIFIER FLOW_CPS_OLD_2 ECU_ADDRESS 0xc0001e7a FORMAT "%6.4" /end MEASUREMENT
/begin MEASUREMENT fac_tia_amp_cp "Flow correction versus air temperature and ambient pressure" UBYTE _CNV_A_R_LINEAR_____100_CM 1 100. 0. 1.9921875 DISPLAY_IDENTIFIER FAC_TIA_AMP_CP ECU_ADDRESS 0xc0001f77 FORMAT "%8.6" /end MEASUREMENT
/begin MEASUREMENT flow_fac_cp "Flow correction versus air temperature and ambient pressure" UWORD _CNV_A_R_LINEAR_____23_CM 1 100. 0. 3.99993896484375 DISPLAY_IDENTIFIER FLOW_FAC_CP ECU_ADDRESS 0xc0001e82 FORMAT "%7.5" /end MEASUREMENT
/begin MEASUREMENT maf_cps "Air flow from the CPS to the cylinder" UWORD _CNV_A_R_LINEAR_____147_CM 1 100. 0. 7.9998779296875 DISPLAY_IDENTIFIER MAF_CPS ECU_ADDRESS 0xc0001e96 FORMAT "%6.4" /end MEASUREMENT
/begin MEASUREMENT maf_cp "MAF_THR + MAF_CPS" UWORD _CNV_A_R_LINEAR_____207_CM 1 100. 0. 2047.96875 DISPLAY_IDENTIFIER MAF_CP ECU_ADDRESS 0xc0001e90 FORMAT "%10.5" /end MEASUREMENT
/begin MEASUREMENT maf_dly_mmv_cp "Moving mean value of flow_cps_dly " UWORD _CNV_A_R_LINEAR_____207_CM 1 100. 0. 2047.96875 DISPLAY_IDENTIFIER MAF_DLY_MMV_CP ECU_ADDRESS 0xd00026be FORMAT "%10.5" /end MEASUREMENT
/begin MEASUREMENT maf_cp_old_1 "Old value of maf_tot_cp" UWORD _CNV_A_R_LINEAR_____207_CM 1 100. 0. 2047.96875 DISPLAY_IDENTIFIER MAF_CP_OLD_1 ECU_ADDRESS 0xc0001e92 FORMAT "%10.5" /end MEASUREMENT
/begin MEASUREMENT maf_cp_old_2 "Old value of maf_tot_cp" UWORD _CNV_A_R_LINEAR_____207_CM 1 100. 0. 2047.96875 DISPLAY_IDENTIFIER MAF_CP_OLD_2 ECU_ADDRESS 0xc0001e94 FORMAT "%10.5" /end MEASUREMENT
/begin MEASUREMENT maf_dly_old_2_cp "Old value of maf_tot_cp_dly for pade filter" UWORD _CNV_A_R_LINEAR_____207_CM 1 100. 0. 2047.96875 DISPLAY_IDENTIFIER MAF_DLY_OLD_2_CP ECU_ADDRESS 0xc0001e9a FORMAT "%10.5" /end MEASUREMENT
/begin CHARACTERISTIC c_flow_cps_as "flow_sp_cps correction of application system" VALUE 0xa10060f4 _REC_VAL_20_u2 7.9998779296875 _CNV_A_R_LINEAR_____147_CM 0. 7.9998779296875 DISPLAY_IDENTIFIER C_FLOW_CPS_AS FORMAT "%6.4" /end CHARACTERISTIC
/begin CHARACTERISTIC c_flow_cps_sp_purge_tube "Flow setpoint for tube purging in WAIT_RAMP_OPEN" VALUE 0xa10060fa _REC_VAL_20_u2 7.9998779296875 _CNV_A_R_LINEAR_____147_CM 0. 7.9998779296875 DISPLAY_IDENTIFIER C_FLOW_CPS_SP_PURGE_TUBE FORMAT "%6.4" /end CHARACTERISTIC
/begin CHARACTERISTIC c_flow_cps_grd_purge_tube "Flow gradient for tube purging in WAIT_RAMP_OPEN" VALUE 0xa10060f6 _REC_VAL_20_u2 7.9998779296875 _CNV_A_R_LINEAR_____147_CM 0. 7.9998779296875 DISPLAY_IDENTIFIER C_FLOW_CPS_GRD_PURGE_TUBE FORMAT "%6.4" /end CHARACTERISTIC
/begin CHARACTERISTIC c_t_di_ramp_open_cp "Maximum time for disabling ramp_open operation" VALUE 0xa100614c _REC_VAL_20_u2 6553.5 _CNV_A_R_LINEAR_____4_CM 0. 6553.5 DISPLAY_IDENTIFIER C_T_DI_RAMP_OPEN_CP FORMAT "%6.1" /end CHARACTERISTIC
/begin CHARACTERISTIC c_t_di_ramp_fast_cp "Maximum time for disabling ramp_open operation" VALUE 0xa100614a _REC_VAL_20_u2 6553.5 _CNV_A_R_LINEAR_____4_CM 0. 6553.5 DISPLAY_IDENTIFIER C_T_DI_RAMP_FAST_CP FORMAT "%6.1" /end CHARACTERISTIC
/begin CHARACTERISTIC c_maf_dly_crlc_cp "Correlation constant for MAF_TOT_CP_DLY-filter" VALUE 0xa1006110 _REC_VAL_20_u2 0.9999847412109381 _CNV_A_R_LINEAR_____68_CM 0. 0.9999847412109381 DISPLAY_IDENTIFIER C_MAF_DLY_CRLC_CP FORMAT "%7.5" /end CHARACTERISTIC
/begin CHARACTERISTIC c_flow_dly_crlc_cp "Correlation constant for FLOW_CPS_DLY-filter" VALUE 0xa10060fc _REC_VAL_20_u2 0.9999847412109381 _CNV_A_R_LINEAR_____68_CM 0. 0.9999847412109381 DISPLAY_IDENTIFIER C_FLOW_DLY_CRLC_CP FORMAT "%7.5" /end CHARACTERISTIC
/begin CHARACTERISTIC c_fac_dec_cor_cmu_cp "Correlation factor for closing ramp speed when combustion commutation requested" VALUE 0xa10060d4 _REC_VAL_20_u2 3.99993896484375 _CNV_A_R_LINEAR_____23_CM 0. 3.99993896484375 DISPLAY_IDENTIFIER C_FAC_DEC_COR_CMU_CP FORMAT "%7.5" /end CHARACTERISTIC
/begin CHARACTERISTIC c_fac_dec_cor_1_cp "Cor. fac. for closing ramp speed when high closing speed requested from OBD manag" VALUE 0xa10060d0 _REC_VAL_20_u2 3.99993896484375 _CNV_A_R_LINEAR_____23_CM 0. 3.99993896484375 DISPLAY_IDENTIFIER C_FAC_DEC_COR_1_CP FORMAT "%7.5" /end CHARACTERISTIC
/begin CHARACTERISTIC c_fac_dec_cor_2_cp "Cor. fac. for closing ramp speed when medium closing speed requested from OBD manag" VALUE 0xa10060d2 _REC_VAL_20_u2 3.99993896484375 _CNV_A_R_LINEAR_____23_CM 0. 3.99993896484375 DISPLAY_IDENTIFIER C_FAC_DEC_COR_2_CP FORMAT "%7.5" /end CHARACTERISTIC
/begin CHARACTERISTIC lc_pq_sp_cp_hom_afl "Use lambda setpoint for fuel_cps calculation during homogeneous lean burn combustion" VALUE 0xa10061bc _REC_VAL_20_u1 1. _CNV_A_R_LINEAR_____0_CM 0. 1. DISPLAY_IDENTIFIER LC_PQ_SP_CP_HOM_AFL FORMAT "%1.0" /end CHARACTERISTIC
/begin CHARACTERISTIC lc_cp_tran_open_max_ena "Enable transition fron RAMP_OPEN to MAX_PURGE if flow target reached" VALUE 0xa10061ac _REC_VAL_20_u1 1. _CNV_A_R_LINEAR_____0_CM 0. 1. DISPLAY_IDENTIFIER LC_CP_TRAN_OPEN_MAX_ENA FORMAT "%1.0" /end CHARACTERISTIC
/begin CHARACTERISTIC lc_flow_cps_as "FLOW_CPS_AS activation" VALUE 0xa10061b2 _REC_VAL_20_u1 1. _CNV_A_R_LINEAR_____0_CM 0. 1. DISPLAY_IDENTIFIER LC_FLOW_CPS_AS FORMAT "%1.0" /end CHARACTERISTIC
/begin CHARACTERISTIC lc_cp_tran_deac_cll "Mode selection at end of RO with empty canister // =0: MAX_PURGE //  =1: MIN_PURGE" VALUE 0xa10061ab _REC_VAL_20_u1 1. _CNV_A_R_LINEAR_____0_CM 0. 1. DISPLAY_IDENTIFIER LC_CP_TRAN_DEAC_CLL FORMAT "%1.0" /end CHARACTERISTIC
/begin CHARACTERISTIC lc_cp_tra_min_ramp_open_dis "Mode selection at end of RO with empty canister // =0: MAX_PURGE //  =1: MIN_PURGE" VALUE 0xa10061a8 _REC_VAL_20_u1 1. _CNV_A_R_LINEAR_____0_CM 0. 1. DISPLAY_IDENTIFIER LC_CP_TRA_MIN_RAMP_OPEN_DIS FORMAT "%1.0" /end CHARACTERISTIC
/begin CHARACTERISTIC lc_cp_tra_min_purge_dft_ena "Mode selection at end of RO with empty canister // =0: MAX_PURGE //  =1: MIN_PURGE" VALUE 0xa10061a7 _REC_VAL_20_u1 1. _CNV_A_R_LINEAR_____0_CM 0. 1. DISPLAY_IDENTIFIER LC_CP_TRA_MIN_PURGE_DFT_ENA FORMAT "%1.0" /end CHARACTERISTIC
/begin CHARACTERISTIC lc_cp_tra_opl_cdn_not "Mode selection at end of RO with empty canister // =0: MAX_PURGE //  =1: MIN_PURGE" VALUE 0xa10061aa _REC_VAL_20_u1 1. _CNV_A_R_LINEAR_____0_CM 0. 1. DISPLAY_IDENTIFIER LC_CP_TRA_OPL_CDN_NOT FORMAT "%1.0" /end CHARACTERISTIC
/begin CHARACTERISTIC lc_cp_tra_opl_cdn_cll_not "Mode selection at end of RO with empty canister // =0: MAX_PURGE //  =1: MIN_PURGE" VALUE 0xa10061a9 _REC_VAL_20_u1 1. _CNV_A_R_LINEAR_____0_CM 0. 1. DISPLAY_IDENTIFIER LC_CP_TRA_OPL_CDN_CLL_NOT FORMAT "%1.0" /end CHARACTERISTIC
/begin CHARACTERISTIC c_state_mod_sel_cp "" VALUE 0xa1006137 _REC_VAL_20_u1 3. _CNV_S_4_STATE_MOD__302_CM 0. 3. DISPLAY_IDENTIFIER C_STATE_MOD_SEL_CP /end CHARACTERISTIC
/begin MEASUREMENT maf_dly_cp "Filtrered  value of maf_tot_cp ( pade filter)" UWORD _CNV_A_R_LINEAR_____207_CM 1 100. 0. 2047.96875 DISPLAY_IDENTIFIER MAF_DLY_CP ECU_ADDRESS 0xc0001e98 FORMAT "%10.5" /end MEASUREMENT
/begin MEASUREMENT lv_cp_act_req "" UBYTE _CNV_S_2_RANGE__0___1_CM 1 100. 0. 1. DISPLAY_IDENTIFIER LV_CP_ACT_REQ ECU_ADDRESS 0xd0002e7e BIT_MASK 0x1 /end MEASUREMENT
/begin MEASUREMENT lv_state_mem_cp_cll "logical value for end of  MAX_PURGE operation" UBYTE _CNV_S_2_RANGE__0___1_CM 1 100. 0. 1. DISPLAY_IDENTIFIER LV_STATE_MEM_CP_CLL ECU_ADDRESS 0xd0002e9c BIT_MASK 0x1 /end MEASUREMENT
/begin MEASUREMENT t_dly_cp_open "Canister load check counter in stratified  mode  " UWORD _CNV_A_R_LINEAR_____4_CM 1 100. 0. 6553.5 DISPLAY_IDENTIFIER T_DLY_CP_OPEN ECU_ADDRESS 0xc0001f58 FORMAT "%6.1" /end MEASUREMENT
/begin MEASUREMENT t_di_cp "Time counter limit to perform a CL learning during stratified " UWORD _CNV_A_R_LINEAR_____4_CM 1 100. 0. 6553.5 DISPLAY_IDENTIFIER T_DI_CP ECU_ADDRESS 0xc0001f54 FORMAT "%6.1" /end MEASUREMENT
/begin CHARACTERISTIC c_t_dly_max_cp "Time between two MAX_PURGE operations for RAMP_OPEN_FAST activation" VALUE 0xa100615e _REC_VAL_20_u2 6553.5 _CNV_A_R_LINEAR_____4_CM 0. 6553.5 DISPLAY_IDENTIFIER C_T_DLY_MAX_CP FORMAT "%6.1" /end CHARACTERISTIC
/begin CHARACTERISTIC c_crlc_pq_sp_cp "Correlation constant to calculate PQ_SP_CP" VALUE 0xa10060c6 _REC_VAL_20_u2 0.9999847412109381 _CNV_A_R_LINEAR_____68_CM 0. 0.9999847412109381 DISPLAY_IDENTIFIER C_CRLC_PQ_SP_CP FORMAT "%7.5" /end CHARACTERISTIC
/begin MEASUREMENT lv_cp_cll "" UBYTE _CNV_S_2_RANGE__0___1_CM 1 100. 0. 1. DISPLAY_IDENTIFIER LV_CP_CLL ECU_ADDRESS 0xd0002e82 BIT_MASK 0x1 /end MEASUREMENT
/begin MEASUREMENT lv_dly_gas_cp "" UBYTE _CNV_S_2_RANGE__0___1_CM 1 100. 0. 1. DISPLAY_IDENTIFIER LV_DLY_GAS_CP ECU_ADDRESS 0xc0001f83 BIT_MASK 0x1 /end MEASUREMENT
/begin CHARACTERISTIC lc_cp_tra_max_min_cdn_ena "Mode selection at end of RO with empty canister // =0: MAX_PURGE //  =1: MIN_PURGE" VALUE 0xa10061a6 _REC_VAL_20_u1 1. _CNV_A_R_LINEAR_____0_CM 0. 1. DISPLAY_IDENTIFIER LC_CP_TRA_MAX_MIN_CDN_ENA FORMAT "%1.0" /end CHARACTERISTIC
/begin CHARACTERISTIC lc_cp_flow_lim_open_fast "Enable old calculation of flow_open_cps" VALUE 0xa10061a4 _REC_VAL_20_u1 1. _CNV_A_R_LINEAR_____0_CM 0. 1. DISPLAY_IDENTIFIER LC_CP_FLOW_LIM_OPEN_FAST FORMAT "%1.0" /end CHARACTERISTIC
/begin AXIS_PTS ldp_cl_ip_flow_fac "" 0xa10051e0 cl _REC_AXS_20_u2 1.99996948242188 _CNV_A_R_LINEAR_____8_CM 6 0. 1.99996948242188 FORMAT "%7.5" /end AXIS_PTS
/begin CHARACTERISTIC ip_flow_inc_cp "Increment value for ramp increase of REL_FLOW_CPS" CURVE 0xa1005878 _REC_CUR_20_u2_u2 7.9998779296875 _CNV_A_R_LINEAR_____113_CM 0. 7.9998779296875 DISPLAY_IDENTIFIER IP_FLOW_INC_CP FORMAT "%6.4"
 /begin AXIS_DESCR COM_AXIS maf_cyl _CNV_A_R_LINEAR_____207_CM 6 0. 2047.96875 FORMAT "%10.5" AXIS_PTS_REF ldpm_maf_cyl_1_evac /end AXIS_DESCR
/end CHARACTERISTIC
/begin CHARACTERISTIC ip_flow_fac_cp "Correction factor for ramp increase of REL_FLOW_CPS" CURVE 0xa100586c _REC_CUR_20_u2_u2 3.99993896484375 _CNV_A_R_LINEAR_____23_CM 0. 3.99993896484375 DISPLAY_IDENTIFIER IP_FLOW_FAC_CP FORMAT "%7.5"
 /begin AXIS_DESCR COM_AXIS cl _CNV_A_R_LINEAR_____8_CM 6 0. 1.99996948242188 FORMAT "%7.5" AXIS_PTS_REF ldp_cl_ip_flow_fac /end AXIS_DESCR
/end CHARACTERISTIC
/begin CHARACTERISTIC ip_flow_inc_fast_cp "Increment value for ramp increase of REL_FLOW_CPS" CURVE 0xa1005884 _REC_CUR_20_u2_u2 7.9998779296875 _CNV_A_R_LINEAR_____113_CM 0. 7.9998779296875 DISPLAY_IDENTIFIER IP_FLOW_INC_FAST_CP FORMAT "%6.4"
 /begin AXIS_DESCR COM_AXIS maf_cyl _CNV_A_R_LINEAR_____207_CM 6 0. 2047.96875 FORMAT "%10.5" AXIS_PTS_REF ldpm_maf_cyl_1_evac /end AXIS_DESCR
/end CHARACTERISTIC
/begin CHARACTERISTIC ip_flow_dec_cp "Decrement value for ramp decrease of REL_FLOW_CPS" CURVE 0xa1005860 _REC_CUR_20_u2_u2 7.9998779296875 _CNV_A_R_LINEAR_____113_CM 0. 7.9998779296875 DISPLAY_IDENTIFIER IP_FLOW_DEC_CP FORMAT "%6.4"
 /begin AXIS_DESCR COM_AXIS maf_cyl _CNV_A_R_LINEAR_____207_CM 6 0. 2047.96875 FORMAT "%10.5" AXIS_PTS_REF ldpm_maf_cyl_1_evac /end AXIS_DESCR
/end CHARACTERISTIC
/begin MEASUREMENT pq_cp_sp "CP forced PQ setpoint in stratified mode " UWORD _CNV_A_R_LINEAR_____68_CM 1 100. 0. 0.9999847412109381 DISPLAY_IDENTIFIER PQ_CP_SP ECU_ADDRESS 0xd00026cc FORMAT "%7.5" /end MEASUREMENT
/begin CHARACTERISTIC id_flow_inc_nr_cp "Increment number for FLOW_CTL_CPS calculation in RO & ROF" CURVE 0xa100540e _REC_CUR_20_u1_u1 254. _CNV_A_R_LINEAR_____0_CM 1. 255. DISPLAY_IDENTIFIER ID_FLOW_INC_NR_CP FORMAT "%3.0"
 /begin AXIS_DESCR COM_AXIS n_32 _CNV_A_R_LINEAR_____9_CM 4 0. 8160. FORMAT "%4.0" AXIS_PTS_REF ldp_n_32_id_flow_inc_nr_cp /end AXIS_DESCR
/end CHARACTERISTIC
/begin CHARACTERISTIC c_cl_mmv_pq "cl_mmv threshold to force PQ in max_purge during strat or lean burn modes" VALUE 0xa1006092 _REC_VAL_20_u2 1.99996948242188 _CNV_A_R_LINEAR_____8_CM 0. 1.99996948242188 DISPLAY_IDENTIFIER C_CL_MMV_PQ FORMAT "%7.5" /end CHARACTERISTIC
/begin MEASUREMENT flow_tot_cps "Total of FLOW_CPS during emission cycle" ULONG _CNV_A_R_EVAC_LINEA_303_CM 1 100. 0. 1456. DISPLAY_IDENTIFIER FLOW_TOT_CPS ECU_ADDRESS 0xc0001f68 FORMAT "%11.6" /end MEASUREMENT
/begin MEASUREMENT cl_mmv_clc_end "Canister load at the end of NORMAL_PURGE_MAX_PURGE operation" UWORD _CNV_A_R_LINEAR_____8_CM 1 100. 0. 1.99996948242188 DISPLAY_IDENTIFIER CL_MMV_CLC_END ECU_ADDRESS 0xd000269e FORMAT "%7.5" /end MEASUREMENT
/begin CHARACTERISTIC ip_fac_amp_cp "Correction factor for ambient pressure" CURVE 0xa10055a8 _REC_CUR_20_u1_u2 1.9921875 _CNV_A_R_LINEAR_____100_CM 0. 1.9921875 DISPLAY_IDENTIFIER IP_FAC_AMP_CP FORMAT "%8.6"
 /begin AXIS_DESCR COM_AXIS amp _CNV_A_R_LINEAR_____26_CM 6 0. 5434. FORMAT "%7.2" AXIS_PTS_REF ldpm_amp_1_evac /end AXIS_DESCR
/end CHARACTERISTIC
/begin CHARACTERISTIC ip_fac_tia_cp "Correction factor for intake air temperature" CURVE 0xa1005670 _REC_CUR_20_u1_u1 1.9921875 _CNV_A_R_LINEAR_____100_CM 0. 1.9921875 DISPLAY_IDENTIFIER IP_FAC_TIA_CP FORMAT "%8.6"
 /begin AXIS_DESCR COM_AXIS tia _CNV_A_R_LINEAR_____16_CM 6 -48. 142.5 FORMAT "%6.2" AXIS_PTS_REF ldp_tia_thr_ip_fac_tia_cp /end AXIS_DESCR
/end CHARACTERISTIC
/begin CHARACTERISTIC ip_flow_cps_dec "Increment value for ramp increase of REL_FLOW_CPS" CURVE 0xa1005698 _REC_CUR_20_u2_u2 7.9998779296875 _CNV_A_R_LINEAR_____113_CM 0. 7.9998779296875 DISPLAY_IDENTIFIER IP_FLOW_CPS_DEC FORMAT "%6.4"
 /begin AXIS_DESCR COM_AXIS maf_cyl _CNV_A_R_LINEAR_____207_CM 6 0. 2047.96875 FORMAT "%10.5" AXIS_PTS_REF ldpm_maf_cyl_1_evac /end AXIS_DESCR
/end CHARACTERISTIC
/begin CHARACTERISTIC ip_flow_cps_inc "Increment value for ramp increase of REL_FLOW_CPS" CURVE 0xa1005854 _REC_CUR_20_u2_u2 7.9998779296875 _CNV_A_R_LINEAR_____113_CM 0. 7.9998779296875 DISPLAY_IDENTIFIER IP_FLOW_CPS_INC FORMAT "%6.4"
 /begin AXIS_DESCR COM_AXIS maf_cyl _CNV_A_R_LINEAR_____207_CM 6 0. 2047.96875 FORMAT "%10.5" AXIS_PTS_REF ldpm_maf_cyl_1_evac /end AXIS_DESCR
/end CHARACTERISTIC
/begin CHARACTERISTIC c_cl_mmv_req "CL_MMV limit value to give priority to purge canister" VALUE 0xa1006094 _REC_VAL_20_u2 1.99996948242188 _CNV_A_R_LINEAR_____8_CM 0. 1.99996948242188 DISPLAY_IDENTIFIER C_CL_MMV_REQ FORMAT "%7.5" /end CHARACTERISTIC
/begin CHARACTERISTIC c_cl_cat_diag "Limit on canister load CL value to go back in stratified " VALUE 0xa100607e _REC_VAL_20_u2 1.99996948242188 _CNV_A_R_LINEAR_____8_CM 0. 1.99996948242188 DISPLAY_IDENTIFIER C_CL_CAT_DIAG FORMAT "%7.5" /end CHARACTERISTIC
/begin CHARACTERISTIC c_t_lock_cp "Delay to set lv_t_dly_req_cp" VALUE 0xa100616c _REC_VAL_20_u2 1310.68 _CNV_A_R_LINEAR_____107_CM 2.e-002 1310.7 DISPLAY_IDENTIFIER C_T_LOCK_CP FORMAT "%7.2" /end CHARACTERISTIC
/begin MEASUREMENT t_lock_cp "Time counter limit to perform a CL learning during stratified " UWORD _CNV_A_R_LINEAR_____107_CM 1 100. 0. 1310.7 DISPLAY_IDENTIFIER T_LOCK_CP ECU_ADDRESS 0xc0001f60 FORMAT "%7.2" /end MEASUREMENT
/begin CHARACTERISTIC c_t_dly_req_cp "Time for CPS closing for transition MIN_PURGE --> NORMAL_PURGE_RAMP_OPEN" VALUE 0xa1006166 _REC_VAL_20_u2 65535. _CNV_A_R_LINEAR_____35_CM 0. 65535. DISPLAY_IDENTIFIER C_T_DLY_REQ_CP FORMAT "%5.0" /end CHARACTERISTIC
/begin CHARACTERISTIC ip_pq_cp_sp "Forced PQ during stratified mode for RO and MAX purge" MAP 0xa1005c74 _REC_MAP_20_u2_u1_u2 0.9999847412109381 _CNV_A_R_LINEAR_____68_CM 0. 0.9999847412109381 DISPLAY_IDENTIFIER IP_PQ_CP_SP FORMAT "%7.5"
 /begin AXIS_DESCR COM_AXIS n_32 _CNV_A_R_LINEAR_____9_CM 6 0. 8160. FORMAT "%4.0" AXIS_PTS_REF ldpm_n_32_1_evac /end AXIS_DESCR
 /begin AXIS_DESCR COM_AXIS tqi_sp _CNV_A_R_LINEAR_____30_CM 6 0. 1023.96875 FORMAT "%7.2" AXIS_PTS_REF ldpm_tqi_sp_s_2_evac /end AXIS_DESCR
/end CHARACTERISTIC
/begin AXIS_PTS ldp_tia_thr_ip_fac_tia_cp "" 0xa10052e0 tia _REC_AXS_20_u1 190.5 _CNV_A_R_LINEAR_____16_CM 6 -48. 142.5 FORMAT "%6.2" /end AXIS_PTS
/begin MEASUREMENT flow_grd_cps "Flow gradient" UWORD _CNV_A_R_LINEAR_____147_CM 1 100. 0. 7.9998779296875 DISPLAY_IDENTIFIER FLOW_GRD_CPS ECU_ADDRESS 0xc0001e84 FORMAT "%6.4" /end MEASUREMENT
/begin MEASUREMENT flow_ctl_cps_di "Flow through the CPS for disabled NORMAL_PURGE operation" UWORD _CNV_A_R_LINEAR_____147_CM 1 100. 0. 7.9998779296875 DISPLAY_IDENTIFIER FLOW_CTL_CPS_DI ECU_ADDRESS 0xc0001e7e FORMAT "%6.4" /end MEASUREMENT
/begin MEASUREMENT state_cp "State of evaporative emission control function" UBYTE _CNV_S_12_STATE_CP_R_304_CM 1 100. 0. 11. DISPLAY_IDENTIFIER STATE_CP ECU_ADDRESS 0xd0002eab /end MEASUREMENT
/begin MEASUREMENT t_dly_cp "Canister load check counter in stratified  mode  " UWORD _CNV_A_R_LINEAR_____4_CM 1 100. 0. 6553.5 DISPLAY_IDENTIFIER T_DLY_CP ECU_ADDRESS 0xc0001f56 FORMAT "%6.1" /end MEASUREMENT
/begin MEASUREMENT t_dly_cl_mdl "Canister load check counter in stratified  mode  " UWORD _CNV_A_R_LINEAR_____4_CM 1 100. 0. 6553.5 DISPLAY_IDENTIFIER T_DLY_CL_MDL ECU_ADDRESS 0xd00026d2 FORMAT "%6.1" /end MEASUREMENT
/begin CHARACTERISTIC c_t_dly_cp "Time between two MAX_PURGE operations for RAMP_OPEN_FAST activation" VALUE 0xa1006152 _REC_VAL_20_u2 6553.5 _CNV_A_R_LINEAR_____4_CM 0. 6553.5 DISPLAY_IDENTIFIER C_T_DLY_CP FORMAT "%6.1" /end CHARACTERISTIC
/begin CHARACTERISTIC c_t_dly_cl_mdl "Time between two MAX_PURGE operations for RAMP_OPEN_FAST activation" VALUE 0xa100614e _REC_VAL_20_u2 6553.5 _CNV_A_R_LINEAR_____4_CM 0. 6553.5 DISPLAY_IDENTIFIER C_T_DLY_CL_MDL FORMAT "%6.1" /end CHARACTERISTIC
/begin CHARACTERISTIC c_t_start_purge_tube "Time between two MAX_PURGE operations for RAMP_OPEN_FAST activation" VALUE 0xa1006176 _REC_VAL_20_u2 6553.5 _CNV_A_R_LINEAR_____4_CM 0. 6553.5 DISPLAY_IDENTIFIER C_T_START_PURGE_TUBE FORMAT "%6.1" /end CHARACTERISTIC
/begin CHARACTERISTIC c_flow_cps_grd_purge_tube_close "flow_ctl_cps initialization value " VALUE 0xa10060f8 _REC_VAL_20_u2 7.9998779296875 _CNV_A_R_LINEAR_____147_CM 0. 7.9998779296875 DISPLAY_IDENTIFIER C_FLOW_CPS_GRD_PURGE_TUBE_CLOSE FORMAT "%6.4" /end CHARACTERISTIC
/begin AXIS_PTS ldpm_maf_kgh_cor_ip_t_dly_cp "" 0xa100535c maf_kgh_fg_pred_cor_cp _REC_AXS_20_u2 2047.96875 _CNV_A_R_LINEAR_____207_CM 6 0. 2047.96875 FORMAT "%10.5" /end AXIS_PTS
/begin CHARACTERISTIC ip_t_dly_cp "Time delay for MAF_CYL (delay time (s)/time recurrence (0.1s))" CURVE 0xa100603c _REC_CUR_20_u2_u2 63.99902344 _CNV_A_R_LINEAR_____114_CM 0. 63.99902344 DISPLAY_IDENTIFIER IP_T_DLY_CP FORMAT "%7.4"
 /begin AXIS_DESCR COM_AXIS maf_kgh_fg_pred_cor_cp _CNV_A_R_LINEAR_____207_CM 6 0. 2047.96875 FORMAT "%10.5" AXIS_PTS_REF ldpm_maf_kgh_cor_ip_t_dly_cp /end AXIS_DESCR
/end CHARACTERISTIC
/begin CHARACTERISTIC ip_t_dly_cp_2 "Time delay for MAF_CYL (delay time (s)/time recurrence (0.1s))" CURVE 0xa1006048 _REC_CUR_20_u2_u2 63.99902344 _CNV_A_R_LINEAR_____114_CM 0. 63.99902344 DISPLAY_IDENTIFIER IP_T_DLY_CP_2 FORMAT "%7.4"
 /begin AXIS_DESCR COM_AXIS maf_kgh_fg_pred_cor_cp _CNV_A_R_LINEAR_____207_CM 6 0. 2047.96875 FORMAT "%10.5" AXIS_PTS_REF ldpm_maf_kgh_cor_ip_t_dly_cp /end AXIS_DESCR
/end CHARACTERISTIC
/begin CHARACTERISTIC ip_flow_max_open_cps "Maximum limit for REL_FLOW_CPS value" MAP 0xa10059b0 _REC_MAP_20_u2_u1_u1 7.9998779296875 _CNV_A_R_LINEAR_____147_CM 0. 7.9998779296875 DISPLAY_IDENTIFIER IP_FLOW_MAX_OPEN_CPS FORMAT "%6.4"
 /begin AXIS_DESCR COM_AXIS n_32 _CNV_A_R_LINEAR_____9_CM 12 0. 8160. FORMAT "%4.0" AXIS_PTS_REF ldpm_n_32_2_evac /end AXIS_DESCR
 /begin AXIS_DESCR COM_AXIS NO_INPUT_QUANTITY _CNV_A_R_LINEAR_____14_CM 12 0. 1389. FORMAT "%4.0" AXIS_PTS_REF ldpm_maf_2_evac /end AXIS_DESCR
/end CHARACTERISTIC
/begin CHARACTERISTIC ip_flow_max_open_cps_2 "Maximum limit for REL_FLOW_CPS value" MAP 0xa1005ad0 _REC_MAP_20_u2_u1_u1 7.9998779296875 _CNV_A_R_LINEAR_____147_CM 0. 7.9998779296875 DISPLAY_IDENTIFIER IP_FLOW_MAX_OPEN_CPS_2 FORMAT "%6.4"
 /begin AXIS_DESCR COM_AXIS n_32 _CNV_A_R_LINEAR_____9_CM 12 0. 8160. FORMAT "%4.0" AXIS_PTS_REF ldpm_n_32_2_evac /end AXIS_DESCR
 /begin AXIS_DESCR COM_AXIS NO_INPUT_QUANTITY _CNV_A_R_LINEAR_____14_CM 12 0. 1389. FORMAT "%4.0" AXIS_PTS_REF ldpm_maf_2_evac /end AXIS_DESCR
/end CHARACTERISTIC
/begin CHARACTERISTIC c_flow_ini_cps "flow_ctl_cps initialization value " VALUE 0xa10060fe _REC_VAL_20_u2 7.9998779296875 _CNV_A_R_LINEAR_____147_CM 0. 7.9998779296875 DISPLAY_IDENTIFIER C_FLOW_INI_CPS FORMAT "%6.4" /end CHARACTERISTIC
/begin CHARACTERISTIC c_mff_max_cps_di "" VALUE 0xa1006114 _REC_VAL_20_u2 7.9998779296875 _CNV_A_R_LINEAR_____147_CM 0. 7.9998779296875 DISPLAY_IDENTIFIER C_MFF_MAX_CPS_DI FORMAT "%6.4" /end CHARACTERISTIC
/begin MEASUREMENT tqi_add_cp "CP torque gain " SWORD _CNV_A_R_LINEAR_____30_CM 1 100. -1024. 1023.96875 DISPLAY_IDENTIFIER TQI_ADD_CP ECU_ADDRESS 0xd00026d8 FORMAT "%11.5" /end MEASUREMENT
/begin MEASUREMENT mff_cps "" UWORD _CNV_A_R_LINEAR_____108_CM 1 100. 0. 1389. DISPLAY_IDENTIFIER MFF_CPS ECU_ADDRESS 0xc0001f42 FORMAT "%7.2" /end MEASUREMENT
/begin MEASUREMENT mff_buf_cp "fuel flow from the CPS to the cylinder" UWORD _CNV_A_R_LINEAR_____147_CM 1 100. 0. 7.9998779296875 DISPLAY_IDENTIFIER MFF_BUF_CP ECU_ADDRESS 0xd00026c6 FORMAT "%6.4" /end MEASUREMENT
/begin MEASUREMENT mff_tot_cp "total of FUEL_CPS during emission cycle" ULONG _CNV_A_R_EVAC_LINEA_303_CM 1 100. 0. 1456. DISPLAY_IDENTIFIER MFF_TOT_CP ECU_ADDRESS 0xc0001f6c FORMAT "%11.6" /end MEASUREMENT
/begin CHARACTERISTIC ip_crlc_mff_buf_cp "ratio for FUEL_CPS calculation" CURVE 0xa100559c _REC_CUR_20_u1_u2 0.99609375 _CNV_A_R_LINEAR_____27_CM 0. 0.99609375 DISPLAY_IDENTIFIER IP_CRLC_MFF_BUF_CP FORMAT "%5.3"
 /begin AXIS_DESCR COM_AXIS maf_cyl _CNV_A_R_LINEAR_____207_CM 6 0. 2047.96875 FORMAT "%10.5" AXIS_PTS_REF ldpm_maf_cyl_1_evac /end AXIS_DESCR
/end CHARACTERISTIC
/begin MEASUREMENT mff_add_buf[0] "array of FUEL_FLOW_ADD_AD_CP values(20 values) " UWORD _CNV_A_R_LINEAR_____68_CM 1 100. 0. 0.9999847412109381 DISPLAY_IDENTIFIER MFF_ADD_BUF[0] ECU_ADDRESS 0xc0001ea0 FORMAT "%7.5" /end MEASUREMENT
/begin MEASUREMENT mff_add_buf[1] "array of FUEL_FLOW_ADD_AD_CP values(20 values) " UWORD _CNV_A_R_LINEAR_____68_CM 1 100. 0. 0.9999847412109381 DISPLAY_IDENTIFIER MFF_ADD_BUF[1] ECU_ADDRESS 0xc0001ea2 FORMAT "%7.5" /end MEASUREMENT
/begin MEASUREMENT mff_add_buf[2] "array of FUEL_FLOW_ADD_AD_CP values(20 values) " UWORD _CNV_A_R_LINEAR_____68_CM 1 100. 0. 0.9999847412109381 DISPLAY_IDENTIFIER MFF_ADD_BUF[2] ECU_ADDRESS 0xc0001ea4 FORMAT "%7.5" /end MEASUREMENT
/begin MEASUREMENT mff_add_buf[3] "array of FUEL_FLOW_ADD_AD_CP values(20 values) " UWORD _CNV_A_R_LINEAR_____68_CM 1 100. 0. 0.9999847412109381 DISPLAY_IDENTIFIER MFF_ADD_BUF[3] ECU_ADDRESS 0xc0001ea6 FORMAT "%7.5" /end MEASUREMENT
/begin MEASUREMENT mff_add_buf[4] "array of FUEL_FLOW_ADD_AD_CP values(20 values) " UWORD _CNV_A_R_LINEAR_____68_CM 1 100. 0. 0.9999847412109381 DISPLAY_IDENTIFIER MFF_ADD_BUF[4] ECU_ADDRESS 0xc0001ea8 FORMAT "%7.5" /end MEASUREMENT
/begin MEASUREMENT mff_add_buf[5] "array of FUEL_FLOW_ADD_AD_CP values(20 values) " UWORD _CNV_A_R_LINEAR_____68_CM 1 100. 0. 0.9999847412109381 DISPLAY_IDENTIFIER MFF_ADD_BUF[5] ECU_ADDRESS 0xc0001eaa FORMAT "%7.5" /end MEASUREMENT
/begin MEASUREMENT mff_add_buf[6] "array of FUEL_FLOW_ADD_AD_CP values(20 values) " UWORD _CNV_A_R_LINEAR_____68_CM 1 100. 0. 0.9999847412109381 DISPLAY_IDENTIFIER MFF_ADD_BUF[6] ECU_ADDRESS 0xc0001eac FORMAT "%7.5" /end MEASUREMENT
/begin MEASUREMENT mff_add_buf[7] "array of FUEL_FLOW_ADD_AD_CP values(20 values) " UWORD _CNV_A_R_LINEAR_____68_CM 1 100. 0. 0.9999847412109381 DISPLAY_IDENTIFIER MFF_ADD_BUF[7] ECU_ADDRESS 0xc0001eae FORMAT "%7.5" /end MEASUREMENT
/begin MEASUREMENT mff_add_buf[8] "array of FUEL_FLOW_ADD_AD_CP values(20 values) " UWORD _CNV_A_R_LINEAR_____68_CM 1 100. 0. 0.9999847412109381 DISPLAY_IDENTIFIER MFF_ADD_BUF[8] ECU_ADDRESS 0xc0001eb0 FORMAT "%7.5" /end MEASUREMENT
/begin MEASUREMENT mff_add_buf[9] "array of FUEL_FLOW_ADD_AD_CP values(20 values) " UWORD _CNV_A_R_LINEAR_____68_CM 1 100. 0. 0.9999847412109381 DISPLAY_IDENTIFIER MFF_ADD_BUF[9] ECU_ADDRESS 0xc0001eb2 FORMAT "%7.5" /end MEASUREMENT
/begin MEASUREMENT mff_add_buf[10] "array of FUEL_FLOW_ADD_AD_CP values(20 values) " UWORD _CNV_A_R_LINEAR_____68_CM 1 100. 0. 0.9999847412109381 DISPLAY_IDENTIFIER MFF_ADD_BUF[10] ECU_ADDRESS 0xc0001eb4 FORMAT "%7.5" /end MEASUREMENT
/begin MEASUREMENT mff_add_buf[11] "array of FUEL_FLOW_ADD_AD_CP values(20 values) " UWORD _CNV_A_R_LINEAR_____68_CM 1 100. 0. 0.9999847412109381 DISPLAY_IDENTIFIER MFF_ADD_BUF[11] ECU_ADDRESS 0xc0001eb6 FORMAT "%7.5" /end MEASUREMENT
/begin MEASUREMENT mff_add_buf[12] "array of FUEL_FLOW_ADD_AD_CP values(20 values) " UWORD _CNV_A_R_LINEAR_____68_CM 1 100. 0. 0.9999847412109381 DISPLAY_IDENTIFIER MFF_ADD_BUF[12] ECU_ADDRESS 0xc0001eb8 FORMAT "%7.5" /end MEASUREMENT
/begin MEASUREMENT mff_add_buf[13] "array of FUEL_FLOW_ADD_AD_CP values(20 values) " UWORD _CNV_A_R_LINEAR_____68_CM 1 100. 0. 0.9999847412109381 DISPLAY_IDENTIFIER MFF_ADD_BUF[13] ECU_ADDRESS 0xc0001eba FORMAT "%7.5" /end MEASUREMENT
/begin MEASUREMENT mff_add_buf[14] "array of FUEL_FLOW_ADD_AD_CP values(20 values) " UWORD _CNV_A_R_LINEAR_____68_CM 1 100. 0. 0.9999847412109381 DISPLAY_IDENTIFIER MFF_ADD_BUF[14] ECU_ADDRESS 0xc0001ebc FORMAT "%7.5" /end MEASUREMENT
/begin MEASUREMENT mff_add_buf[15] "array of FUEL_FLOW_ADD_AD_CP values(20 values) " UWORD _CNV_A_R_LINEAR_____68_CM 1 100. 0. 0.9999847412109381 DISPLAY_IDENTIFIER MFF_ADD_BUF[15] ECU_ADDRESS 0xc0001ebe FORMAT "%7.5" /end MEASUREMENT
/begin MEASUREMENT mff_add_buf[16] "array of FUEL_FLOW_ADD_AD_CP values(20 values) " UWORD _CNV_A_R_LINEAR_____68_CM 1 100. 0. 0.9999847412109381 DISPLAY_IDENTIFIER MFF_ADD_BUF[16] ECU_ADDRESS 0xc0001ec0 FORMAT "%7.5" /end MEASUREMENT
/begin MEASUREMENT mff_add_buf[17] "array of FUEL_FLOW_ADD_AD_CP values(20 values) " UWORD _CNV_A_R_LINEAR_____68_CM 1 100. 0. 0.9999847412109381 DISPLAY_IDENTIFIER MFF_ADD_BUF[17] ECU_ADDRESS 0xc0001ec2 FORMAT "%7.5" /end MEASUREMENT
/begin MEASUREMENT mff_add_buf[18] "array of FUEL_FLOW_ADD_AD_CP values(20 values) " UWORD _CNV_A_R_LINEAR_____68_CM 1 100. 0. 0.9999847412109381 DISPLAY_IDENTIFIER MFF_ADD_BUF[18] ECU_ADDRESS 0xc0001ec4 FORMAT "%7.5" /end MEASUREMENT
/begin MEASUREMENT mff_add_buf[19] "array of FUEL_FLOW_ADD_AD_CP values(20 values) " UWORD _CNV_A_R_LINEAR_____68_CM 1 100. 0. 0.9999847412109381 DISPLAY_IDENTIFIER MFF_ADD_BUF[19] ECU_ADDRESS 0xc0001ec6 FORMAT "%7.5" /end MEASUREMENT
/begin MEASUREMENT mff_add_buf[20] "array of FUEL_FLOW_ADD_AD_CP values(20 values) " UWORD _CNV_A_R_LINEAR_____68_CM 1 100. 0. 0.9999847412109381 DISPLAY_IDENTIFIER MFF_ADD_BUF[20] ECU_ADDRESS 0xc0001ec8 FORMAT "%7.5" /end MEASUREMENT
/begin MEASUREMENT mff_add_buf[21] "array of FUEL_FLOW_ADD_AD_CP values(20 values) " UWORD _CNV_A_R_LINEAR_____68_CM 1 100. 0. 0.9999847412109381 DISPLAY_IDENTIFIER MFF_ADD_BUF[21] ECU_ADDRESS 0xc0001eca FORMAT "%7.5" /end MEASUREMENT
/begin MEASUREMENT mff_add_buf[22] "array of FUEL_FLOW_ADD_AD_CP values(20 values) " UWORD _CNV_A_R_LINEAR_____68_CM 1 100. 0. 0.9999847412109381 DISPLAY_IDENTIFIER MFF_ADD_BUF[22] ECU_ADDRESS 0xc0001ecc FORMAT "%7.5" /end MEASUREMENT
/begin MEASUREMENT mff_add_buf[23] "array of FUEL_FLOW_ADD_AD_CP values(20 values) " UWORD _CNV_A_R_LINEAR_____68_CM 1 100. 0. 0.9999847412109381 DISPLAY_IDENTIFIER MFF_ADD_BUF[23] ECU_ADDRESS 0xc0001ece FORMAT "%7.5" /end MEASUREMENT
/begin MEASUREMENT mff_add_buf[24] "array of FUEL_FLOW_ADD_AD_CP values(20 values) " UWORD _CNV_A_R_LINEAR_____68_CM 1 100. 0. 0.9999847412109381 DISPLAY_IDENTIFIER MFF_ADD_BUF[24] ECU_ADDRESS 0xc0001ed0 FORMAT "%7.5" /end MEASUREMENT
/begin MEASUREMENT mff_add_buf[25] "array of FUEL_FLOW_ADD_AD_CP values(20 values) " UWORD _CNV_A_R_LINEAR_____68_CM 1 100. 0. 0.9999847412109381 DISPLAY_IDENTIFIER MFF_ADD_BUF[25] ECU_ADDRESS 0xc0001ed2 FORMAT "%7.5" /end MEASUREMENT
/begin MEASUREMENT mff_add_buf[26] "array of FUEL_FLOW_ADD_AD_CP values(20 values) " UWORD _CNV_A_R_LINEAR_____68_CM 1 100. 0. 0.9999847412109381 DISPLAY_IDENTIFIER MFF_ADD_BUF[26] ECU_ADDRESS 0xc0001ed4 FORMAT "%7.5" /end MEASUREMENT
/begin MEASUREMENT mff_add_buf[27] "array of FUEL_FLOW_ADD_AD_CP values(20 values) " UWORD _CNV_A_R_LINEAR_____68_CM 1 100. 0. 0.9999847412109381 DISPLAY_IDENTIFIER MFF_ADD_BUF[27] ECU_ADDRESS 0xc0001ed6 FORMAT "%7.5" /end MEASUREMENT
/begin MEASUREMENT mff_add_buf[28] "array of FUEL_FLOW_ADD_AD_CP values(20 values) " UWORD _CNV_A_R_LINEAR_____68_CM 1 100. 0. 0.9999847412109381 DISPLAY_IDENTIFIER MFF_ADD_BUF[28] ECU_ADDRESS 0xc0001ed8 FORMAT "%7.5" /end MEASUREMENT
/begin MEASUREMENT mff_add_buf[29] "array of FUEL_FLOW_ADD_AD_CP values(20 values) " UWORD _CNV_A_R_LINEAR_____68_CM 1 100. 0. 0.9999847412109381 DISPLAY_IDENTIFIER MFF_ADD_BUF[29] ECU_ADDRESS 0xc0001eda FORMAT "%7.5" /end MEASUREMENT
/begin MEASUREMENT mff_add_buf[30] "array of FUEL_FLOW_ADD_AD_CP values(20 values) " UWORD _CNV_A_R_LINEAR_____68_CM 1 100. 0. 0.9999847412109381 DISPLAY_IDENTIFIER MFF_ADD_BUF[30] ECU_ADDRESS 0xc0001edc FORMAT "%7.5" /end MEASUREMENT
/begin MEASUREMENT mff_add_buf[31] "array of FUEL_FLOW_ADD_AD_CP values(20 values) " UWORD _CNV_A_R_LINEAR_____68_CM 1 100. 0. 0.9999847412109381 DISPLAY_IDENTIFIER MFF_ADD_BUF[31] ECU_ADDRESS 0xc0001ede FORMAT "%7.5" /end MEASUREMENT
/begin MEASUREMENT mff_add_buf[32] "array of FUEL_FLOW_ADD_AD_CP values(20 values) " UWORD _CNV_A_R_LINEAR_____68_CM 1 100. 0. 0.9999847412109381 DISPLAY_IDENTIFIER MFF_ADD_BUF[32] ECU_ADDRESS 0xc0001ee0 FORMAT "%7.5" /end MEASUREMENT
/begin MEASUREMENT mff_add_buf[33] "array of FUEL_FLOW_ADD_AD_CP values(20 values) " UWORD _CNV_A_R_LINEAR_____68_CM 1 100. 0. 0.9999847412109381 DISPLAY_IDENTIFIER MFF_ADD_BUF[33] ECU_ADDRESS 0xc0001ee2 FORMAT "%7.5" /end MEASUREMENT
/begin MEASUREMENT mff_add_buf[34] "array of FUEL_FLOW_ADD_AD_CP values(20 values) " UWORD _CNV_A_R_LINEAR_____68_CM 1 100. 0. 0.9999847412109381 DISPLAY_IDENTIFIER MFF_ADD_BUF[34] ECU_ADDRESS 0xc0001ee4 FORMAT "%7.5" /end MEASUREMENT
/begin MEASUREMENT mff_add_buf[35] "array of FUEL_FLOW_ADD_AD_CP values(20 values) " UWORD _CNV_A_R_LINEAR_____68_CM 1 100. 0. 0.9999847412109381 DISPLAY_IDENTIFIER MFF_ADD_BUF[35] ECU_ADDRESS 0xc0001ee6 FORMAT "%7.5" /end MEASUREMENT
/begin MEASUREMENT mff_add_buf[36] "array of FUEL_FLOW_ADD_AD_CP values(20 values) " UWORD _CNV_A_R_LINEAR_____68_CM 1 100. 0. 0.9999847412109381 DISPLAY_IDENTIFIER MFF_ADD_BUF[36] ECU_ADDRESS 0xc0001ee8 FORMAT "%7.5" /end MEASUREMENT
/begin MEASUREMENT mff_add_buf[37] "array of FUEL_FLOW_ADD_AD_CP values(20 values) " UWORD _CNV_A_R_LINEAR_____68_CM 1 100. 0. 0.9999847412109381 DISPLAY_IDENTIFIER MFF_ADD_BUF[37] ECU_ADDRESS 0xc0001eea FORMAT "%7.5" /end MEASUREMENT
/begin MEASUREMENT mff_add_buf[38] "array of FUEL_FLOW_ADD_AD_CP values(20 values) " UWORD _CNV_A_R_LINEAR_____68_CM 1 100. 0. 0.9999847412109381 DISPLAY_IDENTIFIER MFF_ADD_BUF[38] ECU_ADDRESS 0xc0001eec FORMAT "%7.5" /end MEASUREMENT
/begin MEASUREMENT mff_add_buf[39] "array of FUEL_FLOW_ADD_AD_CP values(20 values) " UWORD _CNV_A_R_LINEAR_____68_CM 1 100. 0. 0.9999847412109381 DISPLAY_IDENTIFIER MFF_ADD_BUF[39] ECU_ADDRESS 0xc0001eee FORMAT "%7.5" /end MEASUREMENT
/begin MEASUREMENT mff_add_buf[40] "array of FUEL_FLOW_ADD_AD_CP values(20 values) " UWORD _CNV_A_R_LINEAR_____68_CM 1 100. 0. 0.9999847412109381 DISPLAY_IDENTIFIER MFF_ADD_BUF[40] ECU_ADDRESS 0xc0001ef0 FORMAT "%7.5" /end MEASUREMENT
/begin MEASUREMENT mff_add_buf[41] "array of FUEL_FLOW_ADD_AD_CP values(20 values) " UWORD _CNV_A_R_LINEAR_____68_CM 1 100. 0. 0.9999847412109381 DISPLAY_IDENTIFIER MFF_ADD_BUF[41] ECU_ADDRESS 0xc0001ef2 FORMAT "%7.5" /end MEASUREMENT
/begin MEASUREMENT mff_add_buf[42] "array of FUEL_FLOW_ADD_AD_CP values(20 values) " UWORD _CNV_A_R_LINEAR_____68_CM 1 100. 0. 0.9999847412109381 DISPLAY_IDENTIFIER MFF_ADD_BUF[42] ECU_ADDRESS 0xc0001ef4 FORMAT "%7.5" /end MEASUREMENT
/begin MEASUREMENT mff_add_buf[43] "array of FUEL_FLOW_ADD_AD_CP values(20 values) " UWORD _CNV_A_R_LINEAR_____68_CM 1 100. 0. 0.9999847412109381 DISPLAY_IDENTIFIER MFF_ADD_BUF[43] ECU_ADDRESS 0xc0001ef6 FORMAT "%7.5" /end MEASUREMENT
/begin MEASUREMENT mff_add_buf[44] "array of FUEL_FLOW_ADD_AD_CP values(20 values) " UWORD _CNV_A_R_LINEAR_____68_CM 1 100. 0. 0.9999847412109381 DISPLAY_IDENTIFIER MFF_ADD_BUF[44] ECU_ADDRESS 0xc0001ef8 FORMAT "%7.5" /end MEASUREMENT
/begin MEASUREMENT mff_add_buf[45] "array of FUEL_FLOW_ADD_AD_CP values(20 values) " UWORD _CNV_A_R_LINEAR_____68_CM 1 100. 0. 0.9999847412109381 DISPLAY_IDENTIFIER MFF_ADD_BUF[45] ECU_ADDRESS 0xc0001efa FORMAT "%7.5" /end MEASUREMENT
/begin MEASUREMENT mff_add_buf[46] "array of FUEL_FLOW_ADD_AD_CP values(20 values) " UWORD _CNV_A_R_LINEAR_____68_CM 1 100. 0. 0.9999847412109381 DISPLAY_IDENTIFIER MFF_ADD_BUF[46] ECU_ADDRESS 0xc0001efc FORMAT "%7.5" /end MEASUREMENT
/begin MEASUREMENT mff_add_buf[47] "array of FUEL_FLOW_ADD_AD_CP values(20 values) " UWORD _CNV_A_R_LINEAR_____68_CM 1 100. 0. 0.9999847412109381 DISPLAY_IDENTIFIER MFF_ADD_BUF[47] ECU_ADDRESS 0xc0001efe FORMAT "%7.5" /end MEASUREMENT
/begin MEASUREMENT mff_add_buf[48] "array of FUEL_FLOW_ADD_AD_CP values(20 values) " UWORD _CNV_A_R_LINEAR_____68_CM 1 100. 0. 0.9999847412109381 DISPLAY_IDENTIFIER MFF_ADD_BUF[48] ECU_ADDRESS 0xc0001f00 FORMAT "%7.5" /end MEASUREMENT
/begin MEASUREMENT mff_add_buf[49] "array of FUEL_FLOW_ADD_AD_CP values(20 values) " UWORD _CNV_A_R_LINEAR_____68_CM 1 100. 0. 0.9999847412109381 DISPLAY_IDENTIFIER MFF_ADD_BUF[49] ECU_ADDRESS 0xc0001f02 FORMAT "%7.5" /end MEASUREMENT
/begin MEASUREMENT mff_add_buf[50] "array of FUEL_FLOW_ADD_AD_CP values(20 values) " UWORD _CNV_A_R_LINEAR_____68_CM 1 100. 0. 0.9999847412109381 DISPLAY_IDENTIFIER MFF_ADD_BUF[50] ECU_ADDRESS 0xc0001f04 FORMAT "%7.5" /end MEASUREMENT
/begin MEASUREMENT mff_add_buf[51] "array of FUEL_FLOW_ADD_AD_CP values(20 values) " UWORD _CNV_A_R_LINEAR_____68_CM 1 100. 0. 0.9999847412109381 DISPLAY_IDENTIFIER MFF_ADD_BUF[51] ECU_ADDRESS 0xc0001f06 FORMAT "%7.5" /end MEASUREMENT
/begin MEASUREMENT mff_add_buf[52] "array of FUEL_FLOW_ADD_AD_CP values(20 values) " UWORD _CNV_A_R_LINEAR_____68_CM 1 100. 0. 0.9999847412109381 DISPLAY_IDENTIFIER MFF_ADD_BUF[52] ECU_ADDRESS 0xc0001f08 FORMAT "%7.5" /end MEASUREMENT
/begin MEASUREMENT mff_add_buf[53] "array of FUEL_FLOW_ADD_AD_CP values(20 values) " UWORD _CNV_A_R_LINEAR_____68_CM 1 100. 0. 0.9999847412109381 DISPLAY_IDENTIFIER MFF_ADD_BUF[53] ECU_ADDRESS 0xc0001f0a FORMAT "%7.5" /end MEASUREMENT
/begin MEASUREMENT mff_add_buf[54] "array of FUEL_FLOW_ADD_AD_CP values(20 values) " UWORD _CNV_A_R_LINEAR_____68_CM 1 100. 0. 0.9999847412109381 DISPLAY_IDENTIFIER MFF_ADD_BUF[54] ECU_ADDRESS 0xc0001f0c FORMAT "%7.5" /end MEASUREMENT
/begin MEASUREMENT mff_add_buf[55] "array of FUEL_FLOW_ADD_AD_CP values(20 values) " UWORD _CNV_A_R_LINEAR_____68_CM 1 100. 0. 0.9999847412109381 DISPLAY_IDENTIFIER MFF_ADD_BUF[55] ECU_ADDRESS 0xc0001f0e FORMAT "%7.5" /end MEASUREMENT
/begin MEASUREMENT mff_add_buf[56] "array of FUEL_FLOW_ADD_AD_CP values(20 values) " UWORD _CNV_A_R_LINEAR_____68_CM 1 100. 0. 0.9999847412109381 DISPLAY_IDENTIFIER MFF_ADD_BUF[56] ECU_ADDRESS 0xc0001f10 FORMAT "%7.5" /end MEASUREMENT
/begin MEASUREMENT mff_add_buf[57] "array of FUEL_FLOW_ADD_AD_CP values(20 values) " UWORD _CNV_A_R_LINEAR_____68_CM 1 100. 0. 0.9999847412109381 DISPLAY_IDENTIFIER MFF_ADD_BUF[57] ECU_ADDRESS 0xc0001f12 FORMAT "%7.5" /end MEASUREMENT
/begin MEASUREMENT mff_add_buf[58] "array of FUEL_FLOW_ADD_AD_CP values(20 values) " UWORD _CNV_A_R_LINEAR_____68_CM 1 100. 0. 0.9999847412109381 DISPLAY_IDENTIFIER MFF_ADD_BUF[58] ECU_ADDRESS 0xc0001f14 FORMAT "%7.5" /end MEASUREMENT
/begin MEASUREMENT mff_add_buf[59] "array of FUEL_FLOW_ADD_AD_CP values(20 values) " UWORD _CNV_A_R_LINEAR_____68_CM 1 100. 0. 0.9999847412109381 DISPLAY_IDENTIFIER MFF_ADD_BUF[59] ECU_ADDRESS 0xc0001f16 FORMAT "%7.5" /end MEASUREMENT
/begin MEASUREMENT mff_add_buf[60] "array of FUEL_FLOW_ADD_AD_CP values(20 values) " UWORD _CNV_A_R_LINEAR_____68_CM 1 100. 0. 0.9999847412109381 DISPLAY_IDENTIFIER MFF_ADD_BUF[60] ECU_ADDRESS 0xc0001f18 FORMAT "%7.5" /end MEASUREMENT
/begin MEASUREMENT mff_add_buf[61] "array of FUEL_FLOW_ADD_AD_CP values(20 values) " UWORD _CNV_A_R_LINEAR_____68_CM 1 100. 0. 0.9999847412109381 DISPLAY_IDENTIFIER MFF_ADD_BUF[61] ECU_ADDRESS 0xc0001f1a FORMAT "%7.5" /end MEASUREMENT
/begin MEASUREMENT mff_add_buf[62] "array of FUEL_FLOW_ADD_AD_CP values(20 values) " UWORD _CNV_A_R_LINEAR_____68_CM 1 100. 0. 0.9999847412109381 DISPLAY_IDENTIFIER MFF_ADD_BUF[62] ECU_ADDRESS 0xc0001f1c FORMAT "%7.5" /end MEASUREMENT
/begin MEASUREMENT mff_add_buf[63] "array of FUEL_FLOW_ADD_AD_CP values(20 values) " UWORD _CNV_A_R_LINEAR_____68_CM 1 100. 0. 0.9999847412109381 DISPLAY_IDENTIFIER MFF_ADD_BUF[63] ECU_ADDRESS 0xc0001f1e FORMAT "%7.5" /end MEASUREMENT
/begin MEASUREMENT mff_add_buf[64] "array of FUEL_FLOW_ADD_AD_CP values(20 values) " UWORD _CNV_A_R_LINEAR_____68_CM 1 100. 0. 0.9999847412109381 DISPLAY_IDENTIFIER MFF_ADD_BUF[64] ECU_ADDRESS 0xc0001f20 FORMAT "%7.5" /end MEASUREMENT
/begin MEASUREMENT mff_add_buf[65] "array of FUEL_FLOW_ADD_AD_CP values(20 values) " UWORD _CNV_A_R_LINEAR_____68_CM 1 100. 0. 0.9999847412109381 DISPLAY_IDENTIFIER MFF_ADD_BUF[65] ECU_ADDRESS 0xc0001f22 FORMAT "%7.5" /end MEASUREMENT
/begin MEASUREMENT mff_add_buf[66] "array of FUEL_FLOW_ADD_AD_CP values(20 values) " UWORD _CNV_A_R_LINEAR_____68_CM 1 100. 0. 0.9999847412109381 DISPLAY_IDENTIFIER MFF_ADD_BUF[66] ECU_ADDRESS 0xc0001f24 FORMAT "%7.5" /end MEASUREMENT
/begin MEASUREMENT mff_add_buf[67] "array of FUEL_FLOW_ADD_AD_CP values(20 values) " UWORD _CNV_A_R_LINEAR_____68_CM 1 100. 0. 0.9999847412109381 DISPLAY_IDENTIFIER MFF_ADD_BUF[67] ECU_ADDRESS 0xc0001f26 FORMAT "%7.5" /end MEASUREMENT
/begin MEASUREMENT mff_add_buf[68] "array of FUEL_FLOW_ADD_AD_CP values(20 values) " UWORD _CNV_A_R_LINEAR_____68_CM 1 100. 0. 0.9999847412109381 DISPLAY_IDENTIFIER MFF_ADD_BUF[68] ECU_ADDRESS 0xc0001f28 FORMAT "%7.5" /end MEASUREMENT
/begin MEASUREMENT mff_add_buf[69] "array of FUEL_FLOW_ADD_AD_CP values(20 values) " UWORD _CNV_A_R_LINEAR_____68_CM 1 100. 0. 0.9999847412109381 DISPLAY_IDENTIFIER MFF_ADD_BUF[69] ECU_ADDRESS 0xc0001f2a FORMAT "%7.5" /end MEASUREMENT
/begin MEASUREMENT mff_add_buf[70] "array of FUEL_FLOW_ADD_AD_CP values(20 values) " UWORD _CNV_A_R_LINEAR_____68_CM 1 100. 0. 0.9999847412109381 DISPLAY_IDENTIFIER MFF_ADD_BUF[70] ECU_ADDRESS 0xc0001f2c FORMAT "%7.5" /end MEASUREMENT
/begin MEASUREMENT mff_add_buf[71] "array of FUEL_FLOW_ADD_AD_CP values(20 values) " UWORD _CNV_A_R_LINEAR_____68_CM 1 100. 0. 0.9999847412109381 DISPLAY_IDENTIFIER MFF_ADD_BUF[71] ECU_ADDRESS 0xc0001f2e FORMAT "%7.5" /end MEASUREMENT
/begin MEASUREMENT mff_add_buf[72] "array of FUEL_FLOW_ADD_AD_CP values(20 values) " UWORD _CNV_A_R_LINEAR_____68_CM 1 100. 0. 0.9999847412109381 DISPLAY_IDENTIFIER MFF_ADD_BUF[72] ECU_ADDRESS 0xc0001f30 FORMAT "%7.5" /end MEASUREMENT
/begin MEASUREMENT mff_add_buf[73] "array of FUEL_FLOW_ADD_AD_CP values(20 values) " UWORD _CNV_A_R_LINEAR_____68_CM 1 100. 0. 0.9999847412109381 DISPLAY_IDENTIFIER MFF_ADD_BUF[73] ECU_ADDRESS 0xc0001f32 FORMAT "%7.5" /end MEASUREMENT
/begin MEASUREMENT mff_add_buf[74] "array of FUEL_FLOW_ADD_AD_CP values(20 values) " UWORD _CNV_A_R_LINEAR_____68_CM 1 100. 0. 0.9999847412109381 DISPLAY_IDENTIFIER MFF_ADD_BUF[74] ECU_ADDRESS 0xc0001f34 FORMAT "%7.5" /end MEASUREMENT
/begin MEASUREMENT mff_add_buf[75] "array of FUEL_FLOW_ADD_AD_CP values(20 values) " UWORD _CNV_A_R_LINEAR_____68_CM 1 100. 0. 0.9999847412109381 DISPLAY_IDENTIFIER MFF_ADD_BUF[75] ECU_ADDRESS 0xc0001f36 FORMAT "%7.5" /end MEASUREMENT
/begin MEASUREMENT mff_add_buf[76] "array of FUEL_FLOW_ADD_AD_CP values(20 values) " UWORD _CNV_A_R_LINEAR_____68_CM 1 100. 0. 0.9999847412109381 DISPLAY_IDENTIFIER MFF_ADD_BUF[76] ECU_ADDRESS 0xc0001f38 FORMAT "%7.5" /end MEASUREMENT
/begin MEASUREMENT mff_add_buf[77] "array of FUEL_FLOW_ADD_AD_CP values(20 values) " UWORD _CNV_A_R_LINEAR_____68_CM 1 100. 0. 0.9999847412109381 DISPLAY_IDENTIFIER MFF_ADD_BUF[77] ECU_ADDRESS 0xc0001f3a FORMAT "%7.5" /end MEASUREMENT
/begin MEASUREMENT mff_add_buf[78] "array of FUEL_FLOW_ADD_AD_CP values(20 values) " UWORD _CNV_A_R_LINEAR_____68_CM 1 100. 0. 0.9999847412109381 DISPLAY_IDENTIFIER MFF_ADD_BUF[78] ECU_ADDRESS 0xc0001f3c FORMAT "%7.5" /end MEASUREMENT
/begin MEASUREMENT mff_add_buf[79] "array of FUEL_FLOW_ADD_AD_CP values(20 values) " UWORD _CNV_A_R_LINEAR_____68_CM 1 100. 0. 0.9999847412109381 DISPLAY_IDENTIFIER MFF_ADD_BUF[79] ECU_ADDRESS 0xc0001f3e FORMAT "%7.5" /end MEASUREMENT
/begin MEASUREMENT buf_inp_cp "array of FUEL_FLOW_ADD_AD_CP values(20 values) " UWORD _CNV_A_R_LINEAR_____68_CM 1 100. 0. 0.9999847412109381 DISPLAY_IDENTIFIER BUF_INP_CP ECU_ADDRESS 0xc0001e54 FORMAT "%7.5" /end MEASUREMENT
/begin MEASUREMENT buf_out_cp "array of FUEL_FLOW_ADD_AD_CP values(20 values) " UWORD _CNV_A_R_LINEAR_____147_CM 1 100. 0. 7.9998779296875 DISPLAY_IDENTIFIER BUF_OUT_CP ECU_ADDRESS 0xc0001e56 FORMAT "%6.4" /end MEASUREMENT
/begin CHARACTERISTIC ip_mff_dly_cp "delay for FUEL_CPS calculation" CURVE 0xa1005c60 _REC_CUR_20_u1_u2 255. _CNV_A_R_LINEAR_____0_CM 0. 255. DISPLAY_IDENTIFIER IP_MFF_DLY_CP FORMAT "%3.0"
 /begin AXIS_DESCR COM_AXIS maf_cyl _CNV_A_R_LINEAR_____207_CM 6 0. 2047.96875 FORMAT "%10.5" AXIS_PTS_REF ldpm_maf_cyl_1_evac_mff_dly_cp /end AXIS_DESCR
/end CHARACTERISTIC
/begin CHARACTERISTIC lc_flow_cps_cal "Choice of  recurence for fuel_flow_add_ad_cp calculation" VALUE 0xa10061b3 _REC_VAL_20_u1 1. _CNV_A_R_LINEAR_____0_CM 0. 1. DISPLAY_IDENTIFIER LC_FLOW_CPS_CAL FORMAT "%1.0" /end CHARACTERISTIC
/begin MEASUREMENT maf_kgh_fg_pred_cor_cp "predicted fresh gas out of manifold corrected by MAP & TIA" UWORD _CNV_A_R_LINEAR_____207_CM 1 100. 0. 2047.96875 DISPLAY_IDENTIFIER MAF_KGH_FG_PRED_COR_CP ECU_ADDRESS 0xd00026c0 FORMAT "%10.5" /end MEASUREMENT
/begin CHARACTERISTIC ip_maf_kgh_pred_cor_map_tia "Correction factor for MAF_KGH_FG_PRED (MAP and TIA)" MAP 0xa1005c18 _REC_MAP_20_u2_u2_u1 7.9998779296875 _CNV_A_R_LINEAR_____113_CM 0. 7.9998779296875 DISPLAY_IDENTIFIER IP_MAF_KGH_PRED_COR_MAP_TIA FORMAT "%6.4"
 /begin AXIS_DESCR COM_AXIS map _CNV_A_R_LINEAR_____26_CM 6 0. 5434. FORMAT "%7.2" AXIS_PTS_REF ldpm_map_1_evac /end AXIS_DESCR
 /begin AXIS_DESCR COM_AXIS tia _CNV_A_R_LINEAR_____16_CM 3 -48. 142.5 FORMAT "%6.2" AXIS_PTS_REF ldpm_tia_1_evac /end AXIS_DESCR
/end CHARACTERISTIC
/begin CHARACTERISTIC ip_maf_kgh_pred_cor_map_tia_2 "Correction factor for MAF_KGF_FG_PRED (MAP and TIA) with of STATE_OP_ENG_CP  = 1" MAP 0xa1005c3c _REC_MAP_20_u2_u2_u1 7.9998779296875 _CNV_A_R_LINEAR_____113_CM 0. 7.9998779296875 DISPLAY_IDENTIFIER IP_MAF_KGH_PRED_COR_MAP_TIA_2 FORMAT "%6.4"
 /begin AXIS_DESCR COM_AXIS map _CNV_A_R_LINEAR_____26_CM 6 0. 5434. FORMAT "%7.2" AXIS_PTS_REF ldpm_map_1_evac /end AXIS_DESCR
 /begin AXIS_DESCR COM_AXIS tia _CNV_A_R_LINEAR_____16_CM 3 -48. 142.5 FORMAT "%6.2" AXIS_PTS_REF ldpm_tia_1_evac /end AXIS_DESCR
/end CHARACTERISTIC
/begin CHARACTERISTIC lc_maf_cor_act_cp "Choice of  recurence for fuel_flow_add_ad_cp calculation" VALUE 0xa10061ba _REC_VAL_20_u1 1. _CNV_A_R_LINEAR_____0_CM 0. 1. DISPLAY_IDENTIFIER LC_MAF_COR_ACT_CP FORMAT "%1.0" /end CHARACTERISTIC
/begin AXIS_PTS ldpm_maf_cyl_1_evac_mff_dly_cp "" 0xa1005320 maf_cyl _REC_AXS_20_u2 2047.96875 _CNV_A_R_LINEAR_____207_CM 6 0. 2047.96875 FORMAT "%10.5" /end AXIS_PTS
/begin AXIS_PTS ldpm_maf_kgh_clc_ip_idx_step_cp "" 0xa1005340 maf_kgh_fg_pred_cor_cp _REC_AXS_20_u2 2047.96875 _CNV_A_R_LINEAR_____207_CM 12 0. 2047.96875 FORMAT "%10.5" /end AXIS_PTS
/begin CHARACTERISTIC ip_mff_dly_cp_2 "delay for FUEL_CPS calculation" CURVE 0xa1005c66 _REC_CUR_20_u1_u2 255. _CNV_A_R_LINEAR_____0_CM 0. 255. DISPLAY_IDENTIFIER IP_MFF_DLY_CP_2 FORMAT "%3.0"
 /begin AXIS_DESCR COM_AXIS maf_cyl _CNV_A_R_LINEAR_____207_CM 6 0. 2047.96875 FORMAT "%10.5" AXIS_PTS_REF ldpm_maf_cyl_1_evac_mff_dly_cp /end AXIS_DESCR
/end CHARACTERISTIC
/begin CHARACTERISTIC ip_idx_step_cp "" CURVE 0xa1005bf0 _REC_CUR_20_u1_u2 255. _CNV_A_R_LINEAR_____0_CM 0. 255. DISPLAY_IDENTIFIER IP_IDX_STEP_CP FORMAT "%3.0"
 /begin AXIS_DESCR COM_AXIS maf_kgh_fg_pred_cor_cp _CNV_A_R_LINEAR_____207_CM 12 0. 2047.96875 FORMAT "%10.5" AXIS_PTS_REF ldpm_maf_kgh_clc_ip_idx_step_cp /end AXIS_DESCR
/end CHARACTERISTIC
/begin CHARACTERISTIC ip_idx_step_cp_2 "" CURVE 0xa1005bfc _REC_CUR_20_u1_u2 255. _CNV_A_R_LINEAR_____0_CM 0. 255. DISPLAY_IDENTIFIER IP_IDX_STEP_CP_2 FORMAT "%3.0"
 /begin AXIS_DESCR COM_AXIS maf_kgh_fg_pred_cor_cp _CNV_A_R_LINEAR_____207_CM 12 0. 2047.96875 FORMAT "%10.5" AXIS_PTS_REF ldpm_maf_kgh_clc_ip_idx_step_cp /end AXIS_DESCR
/end CHARACTERISTIC
/begin MEASUREMENT mff_add_lam_cp "additive correction of the mass fuel flow injection with active canister purge" UWORD _CNV_A_R_LINEAR_____108_CM 1 100. 0. 1389. DISPLAY_IDENTIFIER MFF_ADD_LAM_CP ECU_ADDRESS 0xd00026c4 FORMAT "%7.2" /end MEASUREMENT
/begin MEASUREMENT cppwm_cps "corrected PWM signal for CPS opening" UBYTE _CNV_A_R_LINEAR_____5_CM 1 100. 0. 99.609375 DISPLAY_IDENTIFIER CPPWM_CPS ECU_ADDRESS 0xd0002ea0 FORMAT "%9.6" /end MEASUREMENT
/begin MEASUREMENT lv_frq_1_cps "logical value for CPS PWM frequency" UBYTE _CNV_S_2_RANGE__0___1_CM 1 100. 0. 1. DISPLAY_IDENTIFIER LV_FRQ_1_CPS ECU_ADDRESS 0xc0001f87 BIT_MASK 0x1 /end MEASUREMENT
/begin MEASUREMENT cppwm "PWM signal for CPS opening" UBYTE _CNV_A_R_LINEAR_____5_CM 1 100. 0. 99.609375 DISPLAY_IDENTIFIER CPPWM ECU_ADDRESS 0xc0001f71 FORMAT "%9.6" /end MEASUREMENT
/begin CHARACTERISTIC c_n_frq_1_cps "threshold on engine speed to shift CPS frequency output" VALUE 0xa100611e _REC_VAL_20_u1 8160. _CNV_A_R_LINEAR_____9_CM 0. 8160. DISPLAY_IDENTIFIER C_N_FRQ_1_CPS FORMAT "%4.0" /end CHARACTERISTIC
/begin CHARACTERISTIC c_n_frq_2_cps "second threshold on engine speed to shift CPS frequency output" VALUE 0xa100611f _REC_VAL_20_u1 8160. _CNV_A_R_LINEAR_____9_CM 0. 8160. DISPLAY_IDENTIFIER C_N_FRQ_2_CPS FORMAT "%4.0" /end CHARACTERISTIC
/begin CHARACTERISTIC c_n_frq_hys_cps "hysteresis threshold on engine speed to shift CPS frequency output" VALUE 0xa1006120 _REC_VAL_20_u1 8160. _CNV_A_R_LINEAR_____9_CM 0. 8160. DISPLAY_IDENTIFIER C_N_FRQ_HYS_CPS FORMAT "%4.0" /end CHARACTERISTIC
/begin CHARACTERISTIC c_cppwm_frq_1_cps "threshold on CPPWM to shift CPS output frequency" VALUE 0xa10060a9 _REC_VAL_20_u1 99.609375 _CNV_A_R_LINEAR_____5_CM 0. 99.609375 DISPLAY_IDENTIFIER C_CPPWM_FRQ_1_CPS FORMAT "%9.6" /end CHARACTERISTIC
/begin CHARACTERISTIC c_cppwm_frq_2_cps "threshold on CPPWM to shift CPS output frequency" VALUE 0xa10060ab _REC_VAL_20_u1 99.609375 _CNV_A_R_LINEAR_____5_CM 0. 99.609375 DISPLAY_IDENTIFIER C_CPPWM_FRQ_2_CPS FORMAT "%9.6" /end CHARACTERISTIC
/begin CHARACTERISTIC c_cppwm_frq_hys_cps "hysteresis threshold on CPPWM to shift CPS frequency output" VALUE 0xa10060ac _REC_VAL_20_u1 99.609375 _CNV_A_R_LINEAR_____5_CM 0. 99.609375 DISPLAY_IDENTIFIER C_CPPWM_FRQ_HYS_CPS FORMAT "%9.6" /end CHARACTERISTIC
/begin CHARACTERISTIC lc_cppwm_lim_diag "selection of diagnosis limit values on CPPWM_CPS" VALUE 0xa10061ae _REC_VAL_20_u1 1. _CNV_A_R_LINEAR_____0_CM 0. 1. DISPLAY_IDENTIFIER LC_CPPWM_LIM_DIAG FORMAT "%1.0" /end CHARACTERISTIC
/begin CHARACTERISTIC lc_cppwm_as " CPPWM_CPS_AS activation" VALUE 0xa10061ad _REC_VAL_20_u1 1. _CNV_A_R_LINEAR_____0_CM 0. 1. DISPLAY_IDENTIFIER LC_CPPWM_AS FORMAT "%1.0" /end CHARACTERISTIC
/begin MEASUREMENT lv_cp_close_act "lagical value for CPS valve closed" UBYTE _CNV_S_2_RANGE__0___1_CM 1 100. 0. 1. DISPLAY_IDENTIFIER LV_CP_CLOSE_ACT ECU_ADDRESS 0xd0002e86 BIT_MASK 0x1 /end MEASUREMENT
/begin CHARACTERISTIC c_cppwm_max_frq_1_lim_cp "cppwm_cps maximum limit to assure diagnosis with frequency 1" VALUE 0xa10060b4 _REC_VAL_20_u1 99.609375 _CNV_A_R_LINEAR_____5_CM 0. 99.609375 DISPLAY_IDENTIFIER C_CPPWM_MAX_FRQ_1_LIM_CP FORMAT "%9.6" /end CHARACTERISTIC
/begin CHARACTERISTIC c_cppwm_max_frq_2_lim_cp "cppwm_cps maximum limit to assure diagnosis with frequency 2" VALUE 0xa10060b5 _REC_VAL_20_u1 99.609375 _CNV_A_R_LINEAR_____5_CM 0. 99.609375 DISPLAY_IDENTIFIER C_CPPWM_MAX_FRQ_2_LIM_CP FORMAT "%9.6" /end CHARACTERISTIC
/begin CHARACTERISTIC c_cppwm_min_frq_1_lim_cp "cppwm_cps minimum limit to assure diagnosis with frequency 1" VALUE 0xa10060b9 _REC_VAL_20_u1 99.609375 _CNV_A_R_LINEAR_____5_CM 0. 99.609375 DISPLAY_IDENTIFIER C_CPPWM_MIN_FRQ_1_LIM_CP FORMAT "%9.6" /end CHARACTERISTIC
/begin CHARACTERISTIC c_cppwm_min_frq_2_lim_cp "cppwm_cps minimum limit to assure diagnosis with frequency 2" VALUE 0xa10060ba _REC_VAL_20_u1 99.609375 _CNV_A_R_LINEAR_____5_CM 0. 99.609375 DISPLAY_IDENTIFIER C_CPPWM_MIN_FRQ_2_LIM_CP FORMAT "%9.6" /end CHARACTERISTIC
/begin AXIS_PTS ldp_cppwm_ip_cppwm_cor_frq "" 0xa1005240 cppwm _REC_AXS_20_u1 99.609375 _CNV_A_R_LINEAR_____5_CM 8 0. 99.609375 FORMAT "%9.6" /end AXIS_PTS
/begin CHARACTERISTIC ip_cppwm_cor_frq "PWM correction following frequency value" CURVE 0xa100555c _REC_CUR_20_u1_u1 1.9921875 _CNV_A_R_LINEAR_____100_CM 0. 1.9921875 DISPLAY_IDENTIFIER IP_CPPWM_COR_FRQ FORMAT "%8.6"
 /begin AXIS_DESCR COM_AXIS cppwm _CNV_A_R_LINEAR_____5_CM 8 0. 99.609375 FORMAT "%9.6" AXIS_PTS_REF ldp_cppwm_ip_cppwm_cor_frq /end AXIS_DESCR
/end CHARACTERISTIC
/begin AXIS_PTS ldp_flow_cor_cps_ip_cppwm "" 0xa1005264 flow_cor_cps _REC_AXS_20_u2 7.9998779296875 _CNV_A_R_LINEAR_____147_CM 16 0. 7.9998779296875 FORMAT "%6.4" /end AXIS_PTS
/begin CHARACTERISTIC c_cppwm_frq_1 "first CPS output frequency" VALUE 0xa10060a8 _REC_VAL_20_u1 255. _CNV_A_R_LINEAR_____305_CM 0. 255. DISPLAY_IDENTIFIER C_CPPWM_FRQ_1 FORMAT "%3.0" /end CHARACTERISTIC
/begin CHARACTERISTIC c_cppwm_frq_2 "second CPS output frequency" VALUE 0xa10060aa _REC_VAL_20_u1 255. _CNV_A_R_LINEAR_____305_CM 0. 255. DISPLAY_IDENTIFIER C_CPPWM_FRQ_2 FORMAT "%3.0" /end CHARACTERISTIC
/begin CHARACTERISTIC c_cppwm_as "application system value for CPS opening" VALUE 0xa100609f _REC_VAL_20_s1 199.609375 _CNV_A_R_EVAC_LINEA_306_CM -100. 99.609375 DISPLAY_IDENTIFIER C_CPPWM_AS FORMAT "%7.4" /end CHARACTERISTIC
/begin CHARACTERISTIC ip_cppwm_vb_add_1 "additive VB correction for CPPWM and frequency 1" CURVE 0xa100556c _REC_CUR_20_u1_u1 99.609375 _CNV_A_R_EVAC_LINEA_307_CM -50. 49.609375 DISPLAY_IDENTIFIER IP_CPPWM_VB_ADD_1 FORMAT "%5.1"
 /begin AXIS_DESCR COM_AXIS vb _CNV_A_R_LINEAR_____36_CM 8 0. 26. FORMAT "%4.1" AXIS_PTS_REF ldpm_vb_1_evac /end AXIS_DESCR
/end CHARACTERISTIC
/begin CHARACTERISTIC ip_cppwm_vb_add_2 "additive VB correction for CPPWM  and frequency 2" CURVE 0xa1005574 _REC_CUR_20_u1_u1 99.609375 _CNV_A_R_EVAC_LINEA_307_CM -50. 49.609375 DISPLAY_IDENTIFIER IP_CPPWM_VB_ADD_2 FORMAT "%5.1"
 /begin AXIS_DESCR COM_AXIS vb _CNV_A_R_LINEAR_____36_CM 8 0. 26. FORMAT "%4.1" AXIS_PTS_REF ldpm_vb_1_evac /end AXIS_DESCR
/end CHARACTERISTIC
/begin CHARACTERISTIC ip_cppwm "CPS valve characteristic" MAP 0xa100545c _REC_MAP_20_u1_u2_u2 99.609375 _CNV_A_R_LINEAR_____5_CM 0. 99.609375 DISPLAY_IDENTIFIER IP_CPPWM FORMAT "%9.6"
 /begin AXIS_DESCR COM_AXIS flow_cor_cps _CNV_A_R_LINEAR_____147_CM 16 0. 7.9998779296875 FORMAT "%6.4" AXIS_PTS_REF ldp_flow_cor_cps_ip_cppwm /end AXIS_DESCR
 /begin AXIS_DESCR COM_AXIS prs_cps _CNV_A_R_EVAC_LINEA_294_CM 16 -2717.04 2716.96 FORMAT "%8.2" AXIS_PTS_REF ldpm_prs_cps_1_evac /end AXIS_DESCR
/end CHARACTERISTIC
/begin CHARACTERISTIC ip_cppwm_vb_fac "multiplicate VB correction for CPPWM" CURVE 0xa100557c _REC_CUR_20_u1_u1 1.9921875 _CNV_A_R_LINEAR_____100_CM 0. 1.9921875 DISPLAY_IDENTIFIER IP_CPPWM_VB_FAC FORMAT "%8.6"
 /begin AXIS_DESCR COM_AXIS vb _CNV_A_R_LINEAR_____36_CM 8 0. 26. FORMAT "%4.1" AXIS_PTS_REF ldpm_vb_1_evac /end AXIS_DESCR
/end CHARACTERISTIC
/begin AXIS_PTS ldp_prs_cps_ip_cppwm_vb_fac "" 0xa10052b4 prs_cps _REC_AXS_20_u2 5434. _CNV_A_R_EVAC_LINEA_294_CM 6 -2717.04 2716.96 FORMAT "%8.2" /end AXIS_PTS
/begin CHARACTERISTIC ip_cppwm_vb_fac_prs_cps "multiplicate VB correction for CPPWM" CURVE 0xa1005584 _REC_CUR_20_u1_u2 3.984375 _CNV_A_R_LINEAR_____283_CM 0. 3.984375 DISPLAY_IDENTIFIER IP_CPPWM_VB_FAC_PRS_CPS FORMAT "%8.6"
 /begin AXIS_DESCR COM_AXIS prs_cps _CNV_A_R_EVAC_LINEA_294_CM 6 -2717.04 2716.96 FORMAT "%8.2" AXIS_PTS_REF ldp_prs_cps_ip_cppwm_vb_fac /end AXIS_DESCR
/end CHARACTERISTIC
/begin MEASUREMENT frq_req_cp "CPS output frequency" UBYTE _CNV_A_R_LINEAR_____305_CM 1 100. 0. 255. DISPLAY_IDENTIFIER FRQ_REQ_CP ECU_ADDRESS 0xd0002ea6 FORMAT "%3.0" /end MEASUREMENT
/begin MEASUREMENT flow_max_cps "Maximum setpoint value for the flow through the CPS" UWORD _CNV_A_R_LINEAR_____147_CM 1 100. 0. 7.9998779296875 DISPLAY_IDENTIFIER FLOW_MAX_CPS ECU_ADDRESS 0xd00026b8 FORMAT "%6.4" /end MEASUREMENT
/begin MEASUREMENT mff_kgh_max_cp "fuel flow max from ACF" UWORD _CNV_A_R_LINEAR_____147_CM 1 100. 0. 7.9998779296875 DISPLAY_IDENTIFIER MFF_KGH_MAX_CP ECU_ADDRESS 0xc0001f44 FORMAT "%6.4" /end MEASUREMENT
/begin MEASUREMENT ratio_fuel_sp_max_purge "setpoint value for the relative part of fluel from CPS compared to total fuel in cylinder for normal operation" UWORD _CNV_A_R_LINEAR_____68_CM 1 100. 0. 0.9999847412109381 DISPLAY_IDENTIFIER RATIO_FUEL_SP_MAX_PURGE ECU_ADDRESS 0xc0001f4c FORMAT "%7.5" /end MEASUREMENT
/begin MEASUREMENT mff_max_cp "Maximim limit on the fuel flow mass" UWORD _CNV_A_R_LINEAR_____147_CM 1 100. 0. 7.9998779296875 DISPLAY_IDENTIFIER MFF_MAX_CP ECU_ADDRESS 0xd00026ca FORMAT "%6.4" /end MEASUREMENT
/begin AXIS_PTS ldp_cl_mmv_ip_fac_flow_min "" 0xa1005214 cl_mmv _REC_AXS_20_u2 1.99996948242188 _CNV_A_R_LINEAR_____8_CM 6 0. 1.99996948242188 FORMAT "%7.5" /end AXIS_PTS
/begin CHARACTERISTIC ip_fac_flow_sp_min_purge "weighting factor for the CL deviation from the worstcase CL" CURVE 0xa10055c8 _REC_CUR_20_u2_u2 0.9999847412109381 _CNV_A_R_LINEAR_____68_CM 0. 0.9999847412109381 DISPLAY_IDENTIFIER IP_FAC_FLOW_SP_MIN_PURGE FORMAT "%7.5"
 /begin AXIS_DESCR COM_AXIS cl_mmv _CNV_A_R_LINEAR_____8_CM 6 0. 1.99996948242188 FORMAT "%7.5" AXIS_PTS_REF ldp_cl_mmv_ip_fac_flow_min /end AXIS_DESCR
/end CHARACTERISTIC
/begin CHARACTERISTIC c_cl_max_min_purge "on this worst case CL is based the base calibration of MIN_PURGE flow se setpoint" VALUE 0xa1006088 _REC_VAL_20_u2 1.99996948242188 _CNV_A_R_LINEAR_____8_CM 0. 1.99996948242188 DISPLAY_IDENTIFIER C_CL_MAX_MIN_PURGE FORMAT "%7.5" /end CHARACTERISTIC
/begin CHARACTERISTIC c_fac_flow_sp_min_purge_max "maximum correction of MIN_PURGE flow setpoint" VALUE 0xa10060d6 _REC_VAL_20_u2 3.99993896484375 _CNV_A_R_LINEAR_____23_CM 0. 3.99993896484375 DISPLAY_IDENTIFIER C_FAC_FLOW_SP_MIN_PURGE_MAX FORMAT "%7.5" /end CHARACTERISTIC
/begin CHARACTERISTIC c_mff_min_cp "Min limit on mass fuel flow" VALUE 0xa1006116 _REC_VAL_20_u2 1389. _CNV_A_R_LINEAR_____108_CM 0. 1389. DISPLAY_IDENTIFIER C_MFF_MIN_CP FORMAT "%7.2" /end CHARACTERISTIC
/begin CHARACTERISTIC lc_fac_flow_sp_min_purge "switch to activate / deactiate \"intelligent MIN_PURGE\"" VALUE 0xa10061b0 _REC_VAL_20_u1 1. _CNV_A_R_LINEAR_____0_CM 0. 1. DISPLAY_IDENTIFIER LC_FAC_FLOW_SP_MIN_PURGE FORMAT "%1.0" /end CHARACTERISTIC
/begin MEASUREMENT fac_flow_sp_min_purge "correction factor for the flow setpoint in MIN_PURGE when CL_MMV known" UWORD _CNV_A_R_LINEAR_____23_CM 1 100. 0. 3.99993896484375 DISPLAY_IDENTIFIER FAC_FLOW_SP_MIN_PURGE ECU_ADDRESS 0xc0001e6e FORMAT "%7.5" /end MEASUREMENT
/begin MEASUREMENT flow_cps_sp_min_purge "setpoint value for the flow through the CPS for MIN_PURGE mode" UWORD _CNV_A_R_LINEAR_____147_CM 1 100. 0. 7.9998779296875 DISPLAY_IDENTIFIER FLOW_CPS_SP_MIN_PURGE ECU_ADDRESS 0xd00026b2 FORMAT "%6.4" /end MEASUREMENT
/begin MEASUREMENT flow_max_phy_cps "Physical limit: flow at 100% opened valve" UWORD _CNV_A_R_LINEAR_____147_CM 1 100. 0. 7.9998779296875 DISPLAY_IDENTIFIER FLOW_MAX_PHY_CPS ECU_ADDRESS 0xd00026ba FORMAT "%6.4" /end MEASUREMENT
/begin CHARACTERISTIC ip_ratio_fuel_max_cp_cor "correction factor for MFF_MAX_CP" CURVE 0xa1005cbc _REC_CUR_20_u1_u1 0.99609375 _CNV_A_R_LINEAR_____27_CM 0. 0.99609375 DISPLAY_IDENTIFIER IP_RATIO_FUEL_MAX_CP_COR FORMAT "%5.3"
 /begin AXIS_DESCR COM_AXIS tco _CNV_A_R_LINEAR_____16_CM 5 -48. 142.5 FORMAT "%6.2" AXIS_PTS_REF ldp_tco_ip_ratio_fuel_max_cp /end AXIS_DESCR
/end CHARACTERISTIC
/begin CHARACTERISTIC ip_flow_cps "FLOW_CPS for fully opened CPS (CPPWM=100%)" CURVE 0xa1005678 _REC_CUR_20_u2_u2 7.9998779296875 _CNV_A_R_LINEAR_____147_CM 0. 7.9998779296875 DISPLAY_IDENTIFIER IP_FLOW_CPS FORMAT "%6.4"
 /begin AXIS_DESCR COM_AXIS prs_cps _CNV_A_R_EVAC_LINEA_294_CM 16 -2717.04 2716.96 FORMAT "%8.2" AXIS_PTS_REF ldpm_prs_cps_1_evac /end AXIS_DESCR
/end CHARACTERISTIC
/begin AXIS_PTS ldp_tco_ip_ratio_fuel_max_cp "" 0xa10052d2 tco _REC_AXS_20_u1 190.5 _CNV_A_R_LINEAR_____16_CM 5 -48. 142.5 FORMAT "%6.2" /end AXIS_PTS
/begin CHARACTERISTIC ip_flow_max_cps "flow setpoint for MAX_PURGE" MAP 0xa1005890 _REC_MAP_20_u2_u1_u1 7.9998779296875 _CNV_A_R_LINEAR_____147_CM 0. 7.9998779296875 DISPLAY_IDENTIFIER IP_FLOW_MAX_CPS FORMAT "%6.4"
 /begin AXIS_DESCR COM_AXIS n_32 _CNV_A_R_LINEAR_____9_CM 12 0. 8160. FORMAT "%4.0" AXIS_PTS_REF ldpm_n_32_2_evac /end AXIS_DESCR
 /begin AXIS_DESCR COM_AXIS NO_INPUT_QUANTITY _CNV_A_R_LINEAR_____14_CM 12 0. 1389. FORMAT "%4.0" AXIS_PTS_REF ldpm_maf_2_evac /end AXIS_DESCR
/end CHARACTERISTIC
/begin CHARACTERISTIC ip_flow_cps_eng_mod_0 "flow setpoint for MIN_PURGE / homogeneous stoiciometric operation" MAP 0xa10056a4 _REC_MAP_20_u2_u1_u1 7.9998779296875 _CNV_A_R_LINEAR_____147_CM 0. 7.9998779296875 DISPLAY_IDENTIFIER IP_FLOW_CPS_ENG_MOD_0 FORMAT "%6.4"
 /begin AXIS_DESCR COM_AXIS n_32 _CNV_A_R_LINEAR_____9_CM 12 0. 8160. FORMAT "%4.0" AXIS_PTS_REF ldpm_n_32_2_evac /end AXIS_DESCR
 /begin AXIS_DESCR COM_AXIS NO_INPUT_QUANTITY _CNV_A_R_LINEAR_____14_CM 12 0. 1389. FORMAT "%4.0" AXIS_PTS_REF ldpm_maf_2_evac /end AXIS_DESCR
/end CHARACTERISTIC
/begin CHARACTERISTIC ip_flow_cps_eng_mod_1 "flow setpoint for MIN_PURGE / homogeneous lean operation" MAP 0xa10057c4 _REC_MAP_20_u2_u1_u2 7.9998779296875 _CNV_A_R_LINEAR_____147_CM 0. 7.9998779296875 DISPLAY_IDENTIFIER IP_FLOW_CPS_ENG_MOD_1 FORMAT "%6.4"
 /begin AXIS_DESCR COM_AXIS n_32 _CNV_A_R_LINEAR_____9_CM 6 0. 8160. FORMAT "%4.0" AXIS_PTS_REF ldpm_n_32_1_evac /end AXIS_DESCR
 /begin AXIS_DESCR COM_AXIS tqi_sp _CNV_A_R_LINEAR_____30_CM 6 0. 1023.96875 FORMAT "%7.2" AXIS_PTS_REF ldpm_tqi_sp_s_2_evac /end AXIS_DESCR
/end CHARACTERISTIC
/begin CHARACTERISTIC ip_flow_cps_eng_mod_2 "flow setpoint for MIN_PURGE / homogeneous lean operation" MAP 0xa100580c _REC_MAP_20_u2_u1_u2 7.9998779296875 _CNV_A_R_LINEAR_____147_CM 0. 7.9998779296875 DISPLAY_IDENTIFIER IP_FLOW_CPS_ENG_MOD_2 FORMAT "%6.4"
 /begin AXIS_DESCR COM_AXIS n_32 _CNV_A_R_LINEAR_____9_CM 6 0. 8160. FORMAT "%4.0" AXIS_PTS_REF ldpm_n_32_1_evac /end AXIS_DESCR
 /begin AXIS_DESCR COM_AXIS tqi_sp _CNV_A_R_LINEAR_____30_CM 6 0. 1023.96875 FORMAT "%7.2" AXIS_PTS_REF ldpm_tqi_sp_s_2_evac /end AXIS_DESCR
/end CHARACTERISTIC
/begin CHARACTERISTIC ip_ratio_fuel_max_cp_mod_0 "maximum fuel flow through the CPS / homogeneous stoiciometric operation" MAP 0xa1005cc4 _REC_MAP_20_u2_u1_u1 0.9999847412109381 _CNV_A_R_LINEAR_____68_CM 0. 0.9999847412109381 DISPLAY_IDENTIFIER IP_RATIO_FUEL_MAX_CP_MOD_0 FORMAT "%7.5"
 /begin AXIS_DESCR COM_AXIS n_32 _CNV_A_R_LINEAR_____9_CM 12 0. 8160. FORMAT "%4.0" AXIS_PTS_REF ldpm_n_32_2_evac /end AXIS_DESCR
 /begin AXIS_DESCR COM_AXIS NO_INPUT_QUANTITY _CNV_A_R_LINEAR_____14_CM 12 0. 1389. FORMAT "%4.0" AXIS_PTS_REF ldpm_maf_2_evac /end AXIS_DESCR
/end CHARACTERISTIC
/begin AXIS_PTS ldpm_tqi_sp_s_ip_ratio_fuel_max "" 0xa10053e8 tqi_sp _REC_AXS_20_u2 1023.96875 _CNV_A_R_LINEAR_____30_CM 12 0. 1023.96875 FORMAT "%7.2" /end AXIS_PTS
/begin CHARACTERISTIC ip_ratio_fuel_max_cp_mod_1 "maximum fuel flow through the CPS / homogeneous lean operation" MAP 0xa1005de4 _REC_MAP_20_u2_u1_u2 0.9999847412109381 _CNV_A_R_LINEAR_____68_CM 0. 0.9999847412109381 DISPLAY_IDENTIFIER IP_RATIO_FUEL_MAX_CP_MOD_1 FORMAT "%7.5"
 /begin AXIS_DESCR COM_AXIS n_32 _CNV_A_R_LINEAR_____9_CM 12 0. 8160. FORMAT "%4.0" AXIS_PTS_REF ldpm_n_32_2_evac /end AXIS_DESCR
 /begin AXIS_DESCR COM_AXIS tqi_sp _CNV_A_R_LINEAR_____30_CM 12 0. 1023.96875 FORMAT "%7.2" AXIS_PTS_REF ldpm_tqi_sp_s_ip_ratio_fuel_max /end AXIS_DESCR
/end CHARACTERISTIC
/begin CHARACTERISTIC ip_ratio_fuel_max_cp_mod_2 "maximum fuel flow through the CPS / homogeneous lean operation" MAP 0xa1005f04 _REC_MAP_20_u2_u1_u2 0.9999847412109381 _CNV_A_R_LINEAR_____68_CM 0. 0.9999847412109381 DISPLAY_IDENTIFIER IP_RATIO_FUEL_MAX_CP_MOD_2 FORMAT "%7.5"
 /begin AXIS_DESCR COM_AXIS n_32 _CNV_A_R_LINEAR_____9_CM 12 0. 8160. FORMAT "%4.0" AXIS_PTS_REF ldpm_n_32_2_evac /end AXIS_DESCR
 /begin AXIS_DESCR COM_AXIS tqi_sp _CNV_A_R_LINEAR_____30_CM 12 0. 1023.96875 FORMAT "%7.2" AXIS_PTS_REF ldpm_tqi_sp_s_ip_ratio_fuel_max /end AXIS_DESCR
/end CHARACTERISTIC
/begin MEASUREMENT lv_inh_cp_cll "Logical value for NO_PURGE authorization by projectspecific conditions " UBYTE _CNV_S_2_RANGE__0___1_CM 1 100. 0. 1. DISPLAY_IDENTIFIER LV_INH_CP_CLL ECU_ADDRESS 0xd0002e94 BIT_MASK 0x1 /end MEASUREMENT
/begin MEASUREMENT lv_cp_dyw_ext "Logical value for NO_PURGE authorization by projectspecific conditions " UBYTE _CNV_S_2_RANGE__0___1_CM 1 100. 0. 1. DISPLAY_IDENTIFIER LV_CP_DYW_EXT ECU_ADDRESS 0xd0002e8a BIT_MASK 0x1 /end MEASUREMENT
/begin MEASUREMENT lv_inh_lam_ad_sdl "Flag collecting project specific reasons to inhibit LAM_AD via time control / permanently enable LAM_AD" UBYTE _CNV_S_2_RANGE__0___1_CM 1 100. 0. 1. DISPLAY_IDENTIFIER LV_INH_LAM_AD_SDL ECU_ADDRESS 0xd0002e98 BIT_MASK 0x1 /end MEASUREMENT
/begin MEASUREMENT lv_cp_close_1 "Logical value for NO_PURGE authorization by projectspecific conditions " UBYTE _CNV_S_2_RANGE__0___1_CM 1 100. 0. 1. DISPLAY_IDENTIFIER LV_CP_CLOSE_1 ECU_ADDRESS 0xd0002e83 BIT_MASK 0x1 /end MEASUREMENT
/begin MEASUREMENT lv_cp_close_2 "Logical value for NO_PURGE authorization by projectspecific conditions " UBYTE _CNV_S_2_RANGE__0___1_CM 1 100. 0. 1. DISPLAY_IDENTIFIER LV_CP_CLOSE_2 ECU_ADDRESS 0xd0002e84 BIT_MASK 0x1 /end MEASUREMENT
/begin MEASUREMENT lv_cp_close_3 "Logical value for NO_PURGE authorization by projectspecific conditions " UBYTE _CNV_S_2_RANGE__0___1_CM 1 100. 0. 1. DISPLAY_IDENTIFIER LV_CP_CLOSE_3 ECU_ADDRESS 0xd0002e85 BIT_MASK 0x1 /end MEASUREMENT
/begin MEASUREMENT lv_inh_cp "Logical value for NO_PURGE authorization by projectspecific conditions " UBYTE _CNV_S_2_RANGE__0___1_CM 1 100. 0. 1. DISPLAY_IDENTIFIER LV_INH_CP ECU_ADDRESS 0xd0002e93 BIT_MASK 0x1 /end MEASUREMENT
/begin MEASUREMENT lv_inh_cp_fast "Logical value for NO_PURGE authorization by projectspecific conditions " UBYTE _CNV_S_2_RANGE__0___1_CM 1 100. 0. 1. DISPLAY_IDENTIFIER LV_INH_CP_FAST ECU_ADDRESS 0xd0002e95 BIT_MASK 0x1 /end MEASUREMENT
/begin MEASUREMENT lv_inh_cp_sdl "Flag collecting project specific reasons to inhibit CP via time control / permanently enable CP" UBYTE _CNV_S_2_RANGE__0___1_CM 1 100. 0. 1. DISPLAY_IDENTIFIER LV_INH_CP_SDL ECU_ADDRESS 0xd0002e96 BIT_MASK 0x1 /end MEASUREMENT
/begin MEASUREMENT lv_t_sdl_ext_req "Flag collecting project specific reasons to temporarilly disabling CP and lambda adaptation" UBYTE _CNV_S_2_RANGE__0___1_CM 1 100. 0. 1. DISPLAY_IDENTIFIER LV_T_SDL_EXT_REQ ECU_ADDRESS 0xd0002e9d BIT_MASK 0x1 /end MEASUREMENT
/begin AXIS_PTS ldpm_maf_ip_rel_flow_max_cps "" 0xa1005330 NO_INPUT_QUANTITY _REC_AXS_20_u1 1389. _CNV_A_R_LINEAR_____14_CM 12 0. 1389. FORMAT "%4.0" /end AXIS_PTS
/begin AXIS_PTS ldpm_n_32_ip_rel_flow_max_cps "" 0xa10053a0 n_32 _REC_AXS_20_u1 8160. _CNV_A_R_LINEAR_____9_CM 12 0. 8160. FORMAT "%4.0" /end AXIS_PTS
/begin MEASUREMENT lv_cps_ad_inh "CPS adaptation inhibited" UBYTE _CNV_S_2_RANGE__0___1_CM 1 100. 0. 1. DISPLAY_IDENTIFIER LV_CPS_AD_INH ECU_ADDRESS 0xd0002e8f /end MEASUREMENT
/begin MEASUREMENT prs_cps_ext "Pressure difference envirionment over CP line" SWORD _CNV_A_R_LINEAR_____309_CM 1 100. -2717.04 2716.96 DISPLAY_IDENTIFIER PRS_CPS_EXT ECU_ADDRESS 0xd00026d0 FORMAT "%8.2" /end MEASUREMENT
/begin MEASUREMENT t_dly_cp_opm_av "" UWORD _CNV_A_R_LINEAR_____4_CM 1 100. 0. 6553.5 DISPLAY_IDENTIFIER T_DLY_CP_OPM_AV ECU_ADDRESS 0xc0001f5a FORMAT "%6.1" /end MEASUREMENT
/begin MEASUREMENT fac_flow_cor_cp_ext "External factor to modify absolute flow" UBYTE _CNV_A_R_LINEAR_____283_CM 1 100. 0. 3.984375 DISPLAY_IDENTIFIER FAC_FLOW_COR_CP_EXT ECU_ADDRESS 0xd0002ea3 FORMAT "%8.6" /end MEASUREMENT
/begin MEASUREMENT fac_flow_cor_cp_min_purge "" UBYTE _CNV_A_R_LINEAR_____283_CM 1 100. 0. 3.984375 DISPLAY_IDENTIFIER FAC_FLOW_COR_CP_MIN_PURGE ECU_ADDRESS 0xd0002ea4 FORMAT "%8.6" /end MEASUREMENT
/begin MEASUREMENT state_opm_eng_cp "activation conditions for evaporative emission control function" UBYTE _CNV_S_3_STATE_OPM__310_CM 1 100. 0. 2. DISPLAY_IDENTIFIER STATE_OPM_ENG_CP ECU_ADDRESS 0xd0002ead /end MEASUREMENT
/begin CHARACTERISTIC ip_fac_rel_flow_cps_wout_cat "Factor for CP_MIN_PURGE" MAP 0xa10055e0 _REC_MAP_20_u1_u1_u1 3.984375 _CNV_A_R_LINEAR_____283_CM 0. 3.984375 DISPLAY_IDENTIFIER IP_FAC_REL_FLOW_CPS_WOUT_CAT FORMAT "%8.6"
 /begin AXIS_DESCR COM_AXIS n_32 _CNV_A_R_LINEAR_____9_CM 12 0. 8160. FORMAT "%4.0" AXIS_PTS_REF ldpm_n_32_ip_rel_flow_max_cps /end AXIS_DESCR
 /begin AXIS_DESCR COM_AXIS NO_INPUT_QUANTITY _CNV_A_R_LINEAR_____14_CM 12 0. 1389. FORMAT "%4.0" AXIS_PTS_REF ldpm_maf_ip_rel_flow_max_cps /end AXIS_DESCR
/end CHARACTERISTIC
/begin CHARACTERISTIC id_state_opm_eng_cp "" CURVE 0xa1022ee4 _REC_CUR_20_u1_u1 2. _CNV_S_3_STATE_OPM__310_CM 0. 2. DISPLAY_IDENTIFIER ID_STATE_OPM_ENG_CP
 /begin AXIS_DESCR COM_AXIS opm_av _CNV_A_R_LINEAR_____0_CM 8 0. 8. FORMAT "%1.0" AXIS_PTS_REF ldpm_opm_av /end AXIS_DESCR
/end CHARACTERISTIC
/begin CHARACTERISTIC c_t_dly_cp_lamb_ch "Delay time after LAMB_CH has finished to enable NO_PURGE" VALUE 0xa1006154 _REC_VAL_20_u1 25.5 _CNV_A_R_LINEAR_____4_CM 0. 25.5 DISPLAY_IDENTIFIER C_T_DLY_CP_LAMB_CH FORMAT "%4.1" /end CHARACTERISTIC
/begin CHARACTERISTIC c_t_dly_cp_opm_eng "Delay time after LAMB_CH has finished to enable NO_PURGE" VALUE 0xa1006156 _REC_VAL_20_u2 6553.5 _CNV_A_R_LINEAR_____4_CM 0. 6553.5 DISPLAY_IDENTIFIER C_T_DLY_CP_OPM_ENG FORMAT "%6.1" /end CHARACTERISTIC
/begin AXIS_PTS ldp_cl_mdl_slop_0_ip_cl_slop "" 0xa10051f0 NO_INPUT_QUANTITY _REC_AXS_20_u2 1.99996948242188 _CNV_A_R_LINEAR_____8_CM 8 0. 1.99996948242188 FORMAT "%7.5" /end AXIS_PTS
/begin AXIS_PTS ldp_cl_mdl_slop_int_ip_cl_value "" 0xa1005204 cl_mdl_slop_int _REC_AXS_20_u2 1.99996948242188 _CNV_A_R_LINEAR_____8_CM 6 0. 1.99996948242188 FORMAT "%7.5" /end AXIS_PTS
/begin MEASUREMENT fac_iga_opm_sel "Ignition interpolation factor for operation switch manager" UBYTE _CNV_A_R_LINEAR_____27_CM 1 100. 0. 0.99609375 DISPLAY_IDENTIFIER FAC_IGA_OPM_SEL ECU_ADDRESS 0xd000389c FORMAT "%5.3" /end MEASUREMENT
/begin MEASUREMENT lv_iga_st_opm_sel "condition for IGA_ST operation mode, 1 =  OPM_1 , 0 = OPM_2" UBYTE _CNV_S_2_RANGE__0___1_CM 1 100. 0. 1. DISPLAY_IDENTIFIER LV_IGA_ST_OPM_SEL ECU_ADDRESS 0xd00038ab BIT_MASK 0x1 /end MEASUREMENT
/begin MEASUREMENT iga_add_cmb_ctl[0] "corrected basic ignition angle due to combustion function" SBYTE _CNV_A_R_LINEAR_____168_CM 1 100. -48. 47.625 DISPLAY_IDENTIFIER IGA_ADD_CMB_CTL[0] ECU_ADDRESS 0xd00038a0 FORMAT "%5.1" /end MEASUREMENT
/begin MEASUREMENT iga_add_cmb_ctl[1] "corrected basic ignition angle due to combustion function" SBYTE _CNV_A_R_LINEAR_____168_CM 1 100. -48. 47.625 DISPLAY_IDENTIFIER IGA_ADD_CMB_CTL[1] ECU_ADDRESS 0xd00038a1 FORMAT "%5.1" /end MEASUREMENT
/begin MEASUREMENT iga_add_cmb_ctl[2] "corrected basic ignition angle due to combustion function" SBYTE _CNV_A_R_LINEAR_____168_CM 1 100. -48. 47.625 DISPLAY_IDENTIFIER IGA_ADD_CMB_CTL[2] ECU_ADDRESS 0xd00038a2 FORMAT "%5.1" /end MEASUREMENT
/begin MEASUREMENT iga_add_cmb_ctl[3] "corrected basic ignition angle due to combustion function" SBYTE _CNV_A_R_LINEAR_____168_CM 1 100. -48. 47.625 DISPLAY_IDENTIFIER IGA_ADD_CMB_CTL[3] ECU_ADDRESS 0xd00038a3 FORMAT "%5.1" /end MEASUREMENT
/begin MEASUREMENT iga_add_cmb_ctl[4] "corrected basic ignition angle due to combustion function" SBYTE _CNV_A_R_LINEAR_____168_CM 1 100. -48. 47.625 DISPLAY_IDENTIFIER IGA_ADD_CMB_CTL[4] ECU_ADDRESS 0xd00038a4 FORMAT "%5.1" /end MEASUREMENT
/begin MEASUREMENT iga_add_cmb_ctl[5] "corrected basic ignition angle due to combustion function" SBYTE _CNV_A_R_LINEAR_____168_CM 1 100. -48. 47.625 DISPLAY_IDENTIFIER IGA_ADD_CMB_CTL[5] ECU_ADDRESS 0xd00038a5 FORMAT "%5.1" /end MEASUREMENT
/begin MEASUREMENT iga_av_h_rng_s_1[0] "Ignition angle applied on cylinder CYL in stratified cumbustion" SWORD _CNV_A_R_LINEAR_____166_CM 1 100. -90. 90. DISPLAY_IDENTIFIER IGA_AV_H_RNG_S_1[0] ECU_ADDRESS 0xd0004c9c FORMAT "%8.4" /end MEASUREMENT
/begin MEASUREMENT iga_av_h_rng_s_1[1] "Ignition angle applied on cylinder CYL in stratified cumbustion" SWORD _CNV_A_R_LINEAR_____166_CM 1 100. -90. 90. DISPLAY_IDENTIFIER IGA_AV_H_RNG_S_1[1] ECU_ADDRESS 0xd0004c9e FORMAT "%8.4" /end MEASUREMENT
/begin MEASUREMENT iga_av_h_rng_s_1[2] "Ignition angle applied on cylinder CYL in stratified cumbustion" SWORD _CNV_A_R_LINEAR_____166_CM 1 100. -90. 90. DISPLAY_IDENTIFIER IGA_AV_H_RNG_S_1[2] ECU_ADDRESS 0xd0004ca0 FORMAT "%8.4" /end MEASUREMENT
/begin MEASUREMENT iga_av_h_rng_s_1[3] "Ignition angle applied on cylinder CYL in stratified cumbustion" SWORD _CNV_A_R_LINEAR_____166_CM 1 100. -90. 90. DISPLAY_IDENTIFIER IGA_AV_H_RNG_S_1[3] ECU_ADDRESS 0xd0004ca2 FORMAT "%8.4" /end MEASUREMENT
/begin MEASUREMENT iga_av_h_rng_s_1[4] "Ignition angle applied on cylinder CYL in stratified cumbustion" SWORD _CNV_A_R_LINEAR_____166_CM 1 100. -90. 90. DISPLAY_IDENTIFIER IGA_AV_H_RNG_S_1[4] ECU_ADDRESS 0xd0004ca4 FORMAT "%8.4" /end MEASUREMENT
/begin MEASUREMENT iga_av_h_rng_s_1[5] "Ignition angle applied on cylinder CYL in stratified cumbustion" SWORD _CNV_A_R_LINEAR_____166_CM 1 100. -90. 90. DISPLAY_IDENTIFIER IGA_AV_H_RNG_S_1[5] ECU_ADDRESS 0xd0004ca6 FORMAT "%8.4" /end MEASUREMENT
/begin MEASUREMENT iga_ref_lamb_cor "Additive lambda correction of IGA_REF" SBYTE _CNV_A_R_LINEAR_____168_CM 1 100. -48. 47.625 DISPLAY_IDENTIFIER IGA_REF_LAMB_COR ECU_ADDRESS 0xd00038a9 FORMAT "%5.1" /end MEASUREMENT
/begin MEASUREMENT iga_ref_temp_cor "Additive temperature correction of IGA_REF" SBYTE _CNV_A_R_LINEAR_____168_CM 1 100. -48. 47.625 DISPLAY_IDENTIFIER IGA_REF_TEMP_COR ECU_ADDRESS 0xd00038aa FORMAT "%5.1" /end MEASUREMENT
/begin MEASUREMENT iga_av_h_rng_homs[0] "Ignition angle applied on cylinder CYL in stratified cumbustion" SWORD _CNV_A_R_LINEAR_____166_CM 1 100. -90. 90. DISPLAY_IDENTIFIER IGA_AV_H_RNG_HOMS[0] ECU_ADDRESS 0xd0004ca8 FORMAT "%8.4" /end MEASUREMENT
/begin MEASUREMENT iga_av_h_rng_homs[1] "Ignition angle applied on cylinder CYL in stratified cumbustion" SWORD _CNV_A_R_LINEAR_____166_CM 1 100. -90. 90. DISPLAY_IDENTIFIER IGA_AV_H_RNG_HOMS[1] ECU_ADDRESS 0xd0004caa FORMAT "%8.4" /end MEASUREMENT
/begin MEASUREMENT iga_av_h_rng_homs[2] "Ignition angle applied on cylinder CYL in stratified cumbustion" SWORD _CNV_A_R_LINEAR_____166_CM 1 100. -90. 90. DISPLAY_IDENTIFIER IGA_AV_H_RNG_HOMS[2] ECU_ADDRESS 0xd0004cac FORMAT "%8.4" /end MEASUREMENT
/begin MEASUREMENT iga_av_h_rng_homs[3] "Ignition angle applied on cylinder CYL in stratified cumbustion" SWORD _CNV_A_R_LINEAR_____166_CM 1 100. -90. 90. DISPLAY_IDENTIFIER IGA_AV_H_RNG_HOMS[3] ECU_ADDRESS 0xd0004cae FORMAT "%8.4" /end MEASUREMENT
/begin MEASUREMENT iga_av_h_rng_homs[4] "Ignition angle applied on cylinder CYL in stratified cumbustion" SWORD _CNV_A_R_LINEAR_____166_CM 1 100. -90. 90. DISPLAY_IDENTIFIER IGA_AV_H_RNG_HOMS[4] ECU_ADDRESS 0xd0004cb0 FORMAT "%8.4" /end MEASUREMENT
/begin MEASUREMENT iga_av_h_rng_homs[5] "Ignition angle applied on cylinder CYL in stratified cumbustion" SWORD _CNV_A_R_LINEAR_____166_CM 1 100. -90. 90. DISPLAY_IDENTIFIER IGA_AV_H_RNG_HOMS[5] ECU_ADDRESS 0xd0004cb2 FORMAT "%8.4" /end MEASUREMENT
/begin MEASUREMENT iga_bas_cor "corrected basic ignition angle" UBYTE _CNV_A_R_LINEAR_____167_CM 1 100. -35.625 60. DISPLAY_IDENTIFIER IGA_BAS_COR ECU_ADDRESS 0xd000389d FORMAT "%5.1" /end MEASUREMENT
/begin MEASUREMENT iga_bas_cor_1 "corrected basic ignition angle,bank 1" UBYTE _CNV_A_R_LINEAR_____167_CM 1 100. -35.625 60. DISPLAY_IDENTIFIER IGA_BAS_COR_1 ECU_ADDRESS 0xd000389e FORMAT "%5.1" /end MEASUREMENT
/begin MEASUREMENT iga_bas_cor_2 "corrected basic ignition angle,bank 2" UBYTE _CNV_A_R_LINEAR_____167_CM 1 100. -35.625 60. DISPLAY_IDENTIFIER IGA_BAS_COR_2 ECU_ADDRESS 0xd000389f FORMAT "%5.1" /end MEASUREMENT
/begin MEASUREMENT iga_ref_cor "Corrected reference ignition angle" UBYTE _CNV_A_R_LINEAR_____167_CM 1 100. -35.625 60. DISPLAY_IDENTIFIER IGA_REF_COR ECU_ADDRESS 0xd00038a6 FORMAT "%5.1" /end MEASUREMENT
/begin MEASUREMENT iga_ref_cor_1 "Corrected reference ignition angle,bank 1" UBYTE _CNV_A_R_LINEAR_____167_CM 1 100. -35.625 60. DISPLAY_IDENTIFIER IGA_REF_COR_1 ECU_ADDRESS 0xd00038a7 FORMAT "%5.1" /end MEASUREMENT
/begin MEASUREMENT iga_ref_cor_2 "Corrected reference ignition angle,bank 2" UBYTE _CNV_A_R_LINEAR_____167_CM 1 100. -35.625 60. DISPLAY_IDENTIFIER IGA_REF_COR_2 ECU_ADDRESS 0xd00038a8 FORMAT "%5.1" /end MEASUREMENT
/begin MEASUREMENT lv_tldv_req "Flag indicating the activation requirement for the diagnosis" UBYTE _CNV_S_2_RANGE__0___1_CM 1 100. 0. 1. DISPLAY_IDENTIFIER LV_TLDV_REQ ECU_ADDRESS 0xd0003393 BIT_MASK 0x1 /end MEASUREMENT
/begin MEASUREMENT lv_fac_lam_diagcp "logical value for flag for lambda control to set initialize controller output" UBYTE _CNV_S_2_RANGE__0___1_CM 1 100. 0. 1. DISPLAY_IDENTIFIER LV_FAC_LAM_DIAGCP ECU_ADDRESS 0xd0003396 BIT_MASK 0x1 /end MEASUREMENT
/begin MEASUREMENT lv_diagcp_cps_act "flag indicating EVAM taking the control on flow setpoint" UBYTE _CNV_S_2_RANGE__0___1_CM 1 100. 0. 1. DISPLAY_IDENTIFIER LV_DIAGCP_CPS_ACT ECU_ADDRESS 0xd000338f BIT_MASK 0x1 /end MEASUREMENT
/begin MEASUREMENT lv_err_mec_open_cps "Boolean for CPS stuck in open position (after debounce)" UBYTE _CNV_S_2_RANGE__0___1_CM 1 100. 0. 1. DISPLAY_IDENTIFIER LV_ERR_MEC_OPEN_CPS ECU_ADDRESS 0xd0003392 BIT_MASK 0x1 /end MEASUREMENT
/begin MEASUREMENT flow_sp_cps_evap "setpoint for flow CPS at evacuation. Flow setpoint through the CPS during functional check CPS (interface to EVAC AGGR" UWORD _CNV_A_R_LINEAR_____147_CM 1 100. 0. 7.9998779296875 DISPLAY_IDENTIFIER FLOW_SP_CPS_EVAP ECU_ADDRESS 0xd00040f6 FORMAT "%7.4" /end MEASUREMENT
/begin MEASUREMENT cl_mmv_norm_purge_end "Canister load at the end of MAX_PURGE operation" UWORD _CNV_A_R_LINEAR_____8_CM 1 100. 0. 1.99996948242188 DISPLAY_IDENTIFIER CL_MMV_NORM_PURGE_END ECU_ADDRESS 0xd00040f4 FORMAT "%7.5" /end MEASUREMENT
/begin MEASUREMENT lv_cp_new_ramp_open_mem "locally memorised version of LV_CP_NEW_RAMP_OPEN" UBYTE _CNV_S_2_RANGE__0___1_CM 1 100. 0. 1. DISPLAY_IDENTIFIER LV_CP_NEW_RAMP_OPEN_MEM ECU_ADDRESS 0xd000338e BIT_MASK 0x1 /end MEASUREMENT
/begin MEASUREMENT lv_cl_mmv "Interface flag to functional check cps" UBYTE _CNV_S_2_RANGE__0___1_CM 1 100. 0. 1. DISPLAY_IDENTIFIER LV_CL_MMV ECU_ADDRESS 0xd000338d BIT_MASK 0x1 /end MEASUREMENT
/begin MEASUREMENT lv_err_el_sov "Boolean for error currently present on canister shutoff valve command signal" UBYTE _CNV_S_2_RANGE__0___1_CM 1 100. 0. 1. DISPLAY_IDENTIFIER LV_ERR_EL_SOV ECU_ADDRESS 0xd0003390 BIT_MASK 0x1 /end MEASUREMENT
/begin MEASUREMENT lv_err_mec_close_sov "Boolean for error currently present due to canister shut off valve stuck in closed position" UBYTE _CNV_S_2_RANGE__0___1_CM 1 100. 0. 1. DISPLAY_IDENTIFIER LV_ERR_MEC_CLOSE_SOV ECU_ADDRESS 0xd0003391 BIT_MASK 0x1 /end MEASUREMENT
/begin MEASUREMENT lv_err_cps "Flag indicating failure on canister purge valve" UBYTE _CNV_S_2_RANGE__0___1_CM 1 100. 0. 1. DISPLAY_IDENTIFIER LV_ERR_CPS ECU_ADDRESS 0xd0003394 BIT_MASK 0x1 /end MEASUREMENT
/begin MEASUREMENT lv_cl_calc_avl "interface flag to cat.diag.: cl known" UBYTE _CNV_S_2_RANGE__0___1_CM 1 100. 0. 1. DISPLAY_IDENTIFIER LV_CL_CALC_AVL ECU_ADDRESS 0xd0003395 BIT_MASK 0x1 /end MEASUREMENT
/begin MEASUREMENT state_cp_mem_ad "locally memorised version of STATE_CP" UBYTE _CNV_S_9_RANGE_STAT_457_CM 1 100. 0. 11. DISPLAY_IDENTIFIER STATE_CP_MEM_AD ECU_ADDRESS 0xd000338c /end MEASUREMENT
/begin CHARACTERISTIC c_t_dly_purge_diagcps "Delay time for activating DIAGCPS-diagnosis (step2) after LV CL MMV 0-->1" VALUE 0xa1006164 _REC_VAL_20_u2 1310.7 _CNV_A_R_LINEAR_____107_CM 0. 1310.7 DISPLAY_IDENTIFIER C_T_DLY_PURGE_DIAGCPS FORMAT "%7.2" /end CHARACTERISTIC
/begin MEASUREMENT lv_lih_coc_on "limp home cooling circuit - engine overtemperature - request to transmission" UBYTE _CNV_S_2_RANGE__0___1_CM 1 100. 0. 1. DISPLAY_IDENTIFIER LV_LIH_COC_ON ECU_ADDRESS 0xd000388e BIT_MASK 0x1 /end MEASUREMENT
/begin MEASUREMENT n_rel_cwp_sp "setpoint of EWAPU sent via bsd-component driver" UBYTE _CNV_A_R_LINEAR_____0_CM 1 100. 0. 255. DISPLAY_IDENTIFIER N_REL_CWP_SP ECU_ADDRESS 0xd000388a FORMAT "%3.0" /end MEASUREMENT
/begin MEASUREMENT lv_temp_eng_warn_1 "1: activate yellow warning lamp for TCO overtemperature (Check-Control-Messages in BN vehicles)" UBYTE _CNV_S_2_RANGE__0___1_CM 1 100. 0. 1. DISPLAY_IDENTIFIER LV_TEMP_ENG_WARN_1 ECU_ADDRESS 0xd000388f BIT_MASK 0x1 /end MEASUREMENT
/begin MEASUREMENT lv_temp_eng_warn_2 "1: activate red warning lamp for TCO overtemperature (Check-Control-Messages in BN vehicles)" UBYTE _CNV_S_2_RANGE__0___1_CM 1 100. 0. 1. DISPLAY_IDENTIFIER LV_TEMP_ENG_WARN_2 ECU_ADDRESS 0xd0003890 BIT_MASK 0x1 /end MEASUREMENT
/begin MEASUREMENT ectpwm_clc "PWM for ECT from BMW, for MSx70 specific solution of ECT functionality" UWORD _CNV_A_R_LINEAR_____7_CM 1 100. 0. 99.99847412109381 DISPLAY_IDENTIFIER ECTPWM_CLC ECU_ADDRESS 0xd0004c94 FORMAT "%5.2" /end MEASUREMENT
/begin MEASUREMENT n_perc_ecf "percentage value of electronic fan speed setpoint" UBYTE _CNV_A_R_LINEAR_____5_CM 1 100. 0. 99.609375 DISPLAY_IDENTIFIER N_PERC_ECF ECU_ADDRESS 0xd0003888 FORMAT "%5.2" /end MEASUREMENT
/begin MEASUREMENT load_thd_fl "load threshold for full load recognition" UWORD _CNV_A_R_LINEAR_____23_CM 1 100. 0. 3.99993896484375 DISPLAY_IDENTIFIER LOAD_THD_FL ECU_ADDRESS 0xd0002c36 FORMAT "%7.5" /end MEASUREMENT
/begin MEASUREMENT maf_sp_tqi "MAF setpoint for torque interventions" UWORD _CNV_A_R_LINEAR_____108_CM 1 100. 0. 1389. DISPLAY_IDENTIFIER MAF_SP_TQI ECU_ADDRESS 0xd0002c3e FORMAT "%6.2" /end MEASUREMENT
/begin MEASUREMENT tq_req_clu "requested torque at clutch" SWORD _CNV_A_R_LINEAR_____30_CM 1 100. -1024. 1023.96875 DISPLAY_IDENTIFIER TQ_REQ_CLU ECU_ADDRESS 0xd0002c38 FORMAT "%11.5" /end MEASUREMENT
/begin MEASUREMENT tqi_sp "Torque setpoint fast path" SWORD _CNV_A_R_LINEAR_____30_CM 1 100. -1024. 1023.96875 DISPLAY_IDENTIFIER TQI_SP ECU_ADDRESS 0xd0002c3a FORMAT "%11.5" /end MEASUREMENT
/begin MEASUREMENT tqi_ems "Torque " SWORD _CNV_A_R_LINEAR_____30_CM 1 100. -1024. 1023.96875 DISPLAY_IDENTIFIER TQI_EMS ECU_ADDRESS 0xd0002c40 FORMAT "%6.2" /end MEASUREMENT
/begin MEASUREMENT tq_add_max "maximum torque reserve at clutch" SWORD _CNV_A_R_LINEAR_____30_CM 1 100. -1024. 1023.96875 DISPLAY_IDENTIFIER TQ_ADD_MAX ECU_ADDRESS 0xd0002c42 FORMAT "%6.2" /end MEASUREMENT
/begin MEASUREMENT tqi_add_max "maximum indicated torque reserve" SWORD _CNV_A_R_LINEAR_____30_CM 1 100. -1024. 1023.96875 DISPLAY_IDENTIFIER TQI_ADD_MAX ECU_ADDRESS 0xd0002c44 FORMAT "%6.2" /end MEASUREMENT
/begin MEASUREMENT tqi_add_max_tol "maximum indicated torque reserve top level" SWORD _CNV_A_R_LINEAR_____30_CM 1 100. -1024. 1023.96875 DISPLAY_IDENTIFIER TQI_ADD_MAX_TOL ECU_ADDRESS 0xd0002c46 FORMAT "%6.2" /end MEASUREMENT
/begin MEASUREMENT maf_add_max "Maximum possible engine load for catalyst heating - mg/Stk" UWORD _CNV_A_R_LINEAR_____108_CM 1 100. 0. 1389. DISPLAY_IDENTIFIER MAF_ADD_MAX ECU_ADDRESS 0xd0002c34 FORMAT "%7.2" /end MEASUREMENT
/begin MEASUREMENT eff_iga_min_add_max "Minimum possible ignition efficiency for catalyst heating" UWORD _CNV_A_R_LINEAR_____8_CM 1 100. 0. 1.99996948242188 DISPLAY_IDENTIFIER EFF_IGA_MIN_ADD_MAX ECU_ADDRESS 0xd0002c30 FORMAT "%7.5" /end MEASUREMENT
/begin MEASUREMENT tqi_fast "Indicated engine torque fast request" SWORD _CNV_A_R_LINEAR_____30_CM 1 100. -1024. 1023.96875 DISPLAY_IDENTIFIER TQI_FAST ECU_ADDRESS 0xd0002c48 FORMAT "%6.2" /end MEASUREMENT
/begin MEASUREMENT tqi_req_fast "limited torque request for fast path" SWORD _CNV_A_R_LINEAR_____30_CM 1 100. -1024. 1023.96875 DISPLAY_IDENTIFIER TQI_REQ_FAST ECU_ADDRESS 0xd0002c4a FORMAT "%6.2" /end MEASUREMENT
/begin MEASUREMENT tqi_req_fast_dtm "Indicated torque request fast" SWORD _CNV_A_R_LINEAR_____30_CM 1 100. -1024. 1023.96875 DISPLAY_IDENTIFIER TQI_REQ_FAST_DTM ECU_ADDRESS 0xd0002c4c FORMAT "%8.2" /end MEASUREMENT
/begin MEASUREMENT tqi_req_fast_dtm_can "Indicated torque request fast for torque calculation CAN" SWORD _CNV_A_R_LINEAR_____30_CM 1 100. -1024. 1023.96875 DISPLAY_IDENTIFIER TQI_REQ_FAST_DTM_CAN ECU_ADDRESS 0xd0002c4e FORMAT "%8.2" /end MEASUREMENT
/begin MEASUREMENT tqi_req_fast_sel "Fast indicated engine torque request selected" SWORD _CNV_A_R_LINEAR_____30_CM 1 100. -1024. 1023.96875 DISPLAY_IDENTIFIER TQI_REQ_FAST_SEL ECU_ADDRESS 0xd0002c50 FORMAT "%6.2" /end MEASUREMENT
/begin MEASUREMENT tqi_req_slow_dtm "Indicated torque request slow" SWORD _CNV_A_R_LINEAR_____30_CM 1 100. -1024. 1023.96875 DISPLAY_IDENTIFIER TQI_REQ_SLOW_DTM ECU_ADDRESS 0xd0002c52 FORMAT "%8.2" /end MEASUREMENT
/begin MEASUREMENT tqi_req_slow_sel "Slow indicated engine torque request selected" SWORD _CNV_A_R_LINEAR_____30_CM 1 100. -1024. 1023.96875 DISPLAY_IDENTIFIER TQI_REQ_SLOW_SEL ECU_ADDRESS 0xd0002c54 FORMAT "%6.2" /end MEASUREMENT
/begin MEASUREMENT tqi_req_tra_fast "Requested indicated torque for fast path" SWORD _CNV_A_R_LINEAR_____30_CM 1 100. -1024. 1023.96875 DISPLAY_IDENTIFIER TQI_REQ_TRA_FAST ECU_ADDRESS 0xd0002c56 FORMAT "%8.2" /end MEASUREMENT
/begin MEASUREMENT tqi_sp_can "Setpoint indicated engine torque for CAN calculations" SWORD _CNV_A_R_LINEAR_____30_CM 1 100. -1024. 1023.96875 DISPLAY_IDENTIFIER TQI_SP_CAN ECU_ADDRESS 0xd0002c58 FORMAT "%6.2" /end MEASUREMENT
/begin MEASUREMENT tqi_req_slow "limited torque request for slow path" SWORD _CNV_A_R_LINEAR_____30_CM 1 100. -1024. 1023.96875 DISPLAY_IDENTIFIER TQI_REQ_SLOW ECU_ADDRESS 0xd0002c5a FORMAT "%6.2" /end MEASUREMENT
/begin MEASUREMENT state_tq_intv_fast "Fast external torque intervention" UBYTE _CNV_S_8_RANGE_STAT_463_CM 1 100. 0. 7. DISPLAY_IDENTIFIER STATE_TQ_INTV_FAST ECU_ADDRESS 0xd0002fb0 /end MEASUREMENT
/begin MEASUREMENT state_tq_intv_slow "Air path external torque intervention" UBYTE _CNV_S_8_RANGE_STAT_463_CM 1 100. 0. 7. DISPLAY_IDENTIFIER STATE_TQ_INTV_SLOW ECU_ADDRESS 0xd0002fb1 /end MEASUREMENT
/begin MEASUREMENT tq_req_ipm "Torque request for IPM" SWORD _CNV_A_R_LINEAR_____464_CM 1 100. -3276.8 3276.7 DISPLAY_IDENTIFIER TQ_REQ_IPM ECU_ADDRESS 0xd0002c5c FORMAT "%6.0" /end MEASUREMENT
/begin AXIS_PTS ldpm_opm_av "" 0xa102218c opm_av _REC_AXS_20_u1 8. _CNV_A_R_LINEAR_____0_CM 8 0. 8. FORMAT "%1.0" /end AXIS_PTS
/begin CHARACTERISTIC c_mff_ref "reference MFF for conversion mg /stk to %" VALUE 0xa1029578 _REC_VAL_20_u2 694.5 _CNV_A_R_LINEAR_____219_CM 0. 694.5 DISPLAY_IDENTIFIER C_MFF_REF FORMAT "%6.2" /end CHARACTERISTIC
/begin MEASUREMENT fup_sp_ext "Fuel pressure setpoint BMW" UWORD _CNV_A_R_LINEAR_____152_CM 1 100. 0. 347776. DISPLAY_IDENTIFIER FUP_SP_EXT ECU_ADDRESS 0xd0004cf0 FORMAT "%6.0" /end MEASUREMENT
/begin MEASUREMENT lv_fup_sp_ext_req "bit, indicating if external fuel pressure setpoint is requested" UBYTE _CNV_S_2_RANGE__0___1_CM 1 100. 0. 1. DISPLAY_IDENTIFIER LV_FUP_SP_EXT_REQ ECU_ADDRESS 0xd00038ec BIT_MASK 0x1 /end MEASUREMENT
/begin MEASUREMENT fup_h_sp_s_ext "Fuel pressure setpoint for stratified mode, high range" UWORD _CNV_A_R_LINEAR_____152_CM 1 100. 0. 347776. DISPLAY_IDENTIFIER FUP_H_SP_S_EXT ECU_ADDRESS 0xd0004cf2 FORMAT "%6.0" /end MEASUREMENT
/begin MEASUREMENT efppwm_can "Pump speed of the electrical fuel pump as 8 bit PWM signal" UBYTE _CNV_A_R_LINEAR_____5_CM 1 100. 0. 99.609375 DISPLAY_IDENTIFIER EFPPWM_CAN ECU_ADDRESS 0xd00038f1 FORMAT "%4.1" /end MEASUREMENT
/begin MEASUREMENT vff_efp "Required amount of fuel" UBYTE _CNV_A_R_LINEAR_____154_CM 1 100. 0. 255. DISPLAY_IDENTIFIER VFF_EFP ECU_ADDRESS 0xd00038f0 FORMAT "%4.0" /end MEASUREMENT
/begin MEASUREMENT lv_di_ad_ref_cam_ivvt[0] "Adaptation of inlet camschaft reference position: 0 = enabled, 1 = disabled" UBYTE _CNV_S_2_RANGE__0___1_CM 1 100. 0. 1. DISPLAY_IDENTIFIER LV_DI_AD_REF_CAM_IVVT_IN ECU_ADDRESS 0xd00038dc BIT_MASK 0x1 /end MEASUREMENT
/begin MEASUREMENT lv_di_ad_ref_cam_ivvt[1] "Adaptation of inlet camschaft reference position: 0 = enabled, 1 = disabled" UBYTE _CNV_S_2_RANGE__0___1_CM 1 100. 0. 1. DISPLAY_IDENTIFIER LV_DI_AD_REF_CAM_IVVT_EX ECU_ADDRESS 0xd00038dd BIT_MASK 0x1 /end MEASUREMENT
/begin MEASUREMENT cam_ex[0] "Actual position exhaust CAM VVTI" UBYTE _CNV_A_R_LINEAR_____567_CM 1 100. -40. -135.625 DISPLAY_IDENTIFIER CAM_EX[1] ECU_ADDRESS 0xd00038e0 FORMAT "%8.3" /end MEASUREMENT
/begin MEASUREMENT cam_in[0] "Actual position inlet CAM VVTI" UBYTE _CNV_A_R_LINEAR_____568_CM 1 100. 60. 155.625 DISPLAY_IDENTIFIER CAM_IN[1] ECU_ADDRESS 0xd00038e1 FORMAT "%8.3" /end MEASUREMENT
/begin MEASUREMENT lv_cam_lock_ivvt_in[0] "VVT on intake camshaft in locked position at engine start" UBYTE _CNV_S_2_RANGE__0___1_CM 1 100. 0. 1. DISPLAY_IDENTIFIER LV_CAM_LOCK_IVVT_IN[1] ECU_ADDRESS 0xd00038de BIT_MASK 0x1 /end MEASUREMENT
/begin MEASUREMENT lv_cam_lock_ivvt_ex[0] "VVT on exhaust camshaft in locked position at engine start" UBYTE _CNV_S_2_RANGE__0___1_CM 1 100. 0. 1. DISPLAY_IDENTIFIER LV_CAM_LOCK_IVVT_EX[1] ECU_ADDRESS 0xd00038df BIT_MASK 0x1 /end MEASUREMENT
/begin CHARACTERISTIC lc_not_adj_cam_ivvt_ex[0] "Exhaust camshaft: 0 = with adjustement; 1 = without adjustement" VALUE 0xa1029d82 _REC_VAL_20_u1 1. _CNV_A_R_LINEAR_____0_CM 0. 1. DISPLAY_IDENTIFIER LC_NOT_ADJ_CAM_IVVT_EX[0] FORMAT "%2.0" /end CHARACTERISTIC
/begin CHARACTERISTIC lc_not_adj_cam_ivvt_in[0] "Inlet camshaft: 0 = with adjustement; 1 = without adjustement" VALUE 0xa1029d83 _REC_VAL_20_u1 1. _CNV_A_R_LINEAR_____0_CM 0. 1. DISPLAY_IDENTIFIER LC_NOT_ADJ_CAM_IVVT_IN[0] FORMAT "%2.0" /end CHARACTERISTIC
/begin CHARACTERISTIC c_cam_ini_in "valve spread angle inlet camshafts with IVVT passive" VALUE 0xa10291af _REC_VAL_20_u1 95.625 _CNV_A_R_LINEAR_____568_CM 60. 155.625 DISPLAY_IDENTIFIER C_CAM_INI_IN FORMAT "%5.1" /end CHARACTERISTIC
/begin CHARACTERISTIC c_cam_ini_ex "valve spread angle exhaust camshaft  with IVVT passive" VALUE 0xa10291ae _REC_VAL_20_u1 -95.625 _CNV_A_R_LINEAR_____567_CM -40. -135.625 DISPLAY_IDENTIFIER C_CAM_INI_EX FORMAT "%5.1" /end CHARACTERISTIC
/begin MEASUREMENT cam_sp_ivvt_in "Inlet CAM setpoint for VVTI" UBYTE _CNV_A_R_LINEAR_____568_CM 1 100. 60. 155.625 DISPLAY_IDENTIFIER CAM_SP_IVVT_IN ECU_ADDRESS 0xd00038e2 FORMAT "%5.1" /end MEASUREMENT
/begin MEASUREMENT cam_sp_ivvt_ex "Exhaust CAM setpoint for VVTI" UBYTE _CNV_A_R_LINEAR_____567_CM 1 100. -40. -135.625 DISPLAY_IDENTIFIER CAM_SP_IVVT_EX ECU_ADDRESS 0xd00038e3 FORMAT "%5.1" /end MEASUREMENT
/begin MEASUREMENT cam_sp_ref_in "Inlet camshaft target spread at reference conditions (warm engine)" SWORD _CNV_A_R_LINEAR_____482_CM 1 100. -768. 767.9765625 DISPLAY_IDENTIFIER CAM_SP_REF_IN ECU_ADDRESS 0xd0004cec FORMAT "%7.2" /end MEASUREMENT
/begin MEASUREMENT cam_sp_ref_ex "Exhaust camshaft target spread at reference conditions (warm engine)" SWORD _CNV_A_R_LINEAR_____482_CM 1 100. -768. 767.9765625 DISPLAY_IDENTIFIER CAM_SP_REF_EX ECU_ADDRESS 0xd0004cee FORMAT "%7.2" /end MEASUREMENT
/begin MEASUREMENT lv_lam_lim_lam_ad_1 "Request for forced lambda adaptation" UBYTE _CNV_S_2_RANGE__0___1_CM 1 100. 0. 1. DISPLAY_IDENTIFIER LV_LAM_LIM_LAM_AD[1] ECU_ADDRESS 0xd000383c /end MEASUREMENT
/begin MEASUREMENT lv_lam_lim_lam_ad_2 "Request for forced lambda adaptation" UBYTE _CNV_S_2_RANGE__0___1_CM 1 100. 0. 1. DISPLAY_IDENTIFIER LV_LAM_LIM_LAM_AD[2] ECU_ADDRESS 0xd000383d /end MEASUREMENT
/begin MEASUREMENT lv_vb_cdn_obd_1 "Boolean for battery voltage conditionf fulfilled for OBD-I diagnosis" UBYTE _CNV_S_2_RANGE__0___1_CM 1 100. 0. 1. DISPLAY_IDENTIFIER LV_VB_CDN_OBD_1 ECU_ADDRESS 0xd00038cc /end MEASUREMENT
/begin MEASUREMENT lv_vb_cdn_obd_2 "Boolean for battery voltage conditionf fulfilled for OBD-II diagnosis" UBYTE _CNV_S_2_RANGE__0___1_CM 1 100. 0. 1. DISPLAY_IDENTIFIER LV_VB_CDN_OBD_2 ECU_ADDRESS 0xd00038cd /end MEASUREMENT
/begin MEASUREMENT tqi_req_tra "Indicated torque request after transient torque function" SWORD _CNV_A_R_LINEAR_____30_CM 1 100. -1024. 1023.96875 DISPLAY_IDENTIFIER TQI_REQ_TRA ECU_ADDRESS 0xd0004b54 FORMAT "%6.2" /end MEASUREMENT
/begin MEASUREMENT lv_act_aj "LV anti-jerk function active" UBYTE _CNV_S_2_RANGE__0___1_CM 1 100. 0. 1. DISPLAY_IDENTIFIER LV_ACT_AJ ECU_ADDRESS 0xd00037e4 BIT_MASK 0x1 /end MEASUREMENT
/begin MEASUREMENT tco_ex "tco_2 adaptation" UBYTE _CNV_A_R_LINEAR_____16_CM 1 100. -48. 142.5 DISPLAY_IDENTIFIER TCO_EX ECU_ADDRESS 0xd0003894 FORMAT "%6.2" /end MEASUREMENT
/begin MEASUREMENT ecfpwm_ecf "electric fan control pulse width modulation" UBYTE _CNV_A_R_LINEAR_____5_CM 1 100. 0. 99.609375 DISPLAY_IDENTIFIER ECFPWM_ECF ECU_ADDRESS 0xd0003896 FORMAT "%9.6" /end MEASUREMENT
/begin MEASUREMENT tco_ex_mes "tco_2_mes adaptation" UBYTE _CNV_A_R_LINEAR_____16_CM 1 100. -48. 142.5 DISPLAY_IDENTIFIER TCO_EX_MES ECU_ADDRESS 0xd0003895 FORMAT "%6.2" /end MEASUREMENT
/begin MEASUREMENT v_tco_ex "v_tco_2 adaptation" UWORD _CNV_A_R_LINEAR_____218_CM 1 100. 0. 4.995 DISPLAY_IDENTIFIER V_TCO_EX ECU_ADDRESS 0xd0004c98 FORMAT "%5.3" /end MEASUREMENT
/begin MEASUREMENT lv_err_tco_ex "adaptation of tco_2 diagnosis to ERRM" UBYTE _CNV_S_2_RANGE__0___1_CM 1 100. 0. 1. DISPLAY_IDENTIFIER LV_ERR_TCO_EX ECU_ADDRESS 0xd0003898 BIT_MASK 0x1 /end MEASUREMENT
/begin MEASUREMENT lv_err_ect_mec "Boolean for electronic controlled thermostat mechanical error" UBYTE _CNV_S_2_RANGE__0___1_CM 1 100. 0. 1. DISPLAY_IDENTIFIER LV_ERR_ECT_MEC ECU_ADDRESS 0xd0003899 BIT_MASK 0x1 /end MEASUREMENT
/begin MEASUREMENT lamb_min "minimum value lambda in multiple-branched exhaust gas lines" UWORD _CNV_A_R_LINEAR_____122_CM 1 100. 0. 31.9990234375 DISPLAY_IDENTIFIER LAMB_MIN ECU_ADDRESS 0xd0004c1c FORMAT "%7.4" /end MEASUREMENT
/begin MEASUREMENT lv_lamb_puls_dyn_diag "Request forced stimulation parameters specific for the WRAF sensor dynmaic" UBYTE _CNV_S_2_RANGE__0___1_CM 1 100. 0. 1. DISPLAY_IDENTIFIER LV_LAMB_PULS_DYN_DIAG ECU_ADDRESS 0xd0003840 /end MEASUREMENT
/begin MEASUREMENT lv_err_ls_up_dyn_vld_1 "Boolean flag indicating the validation of correspondent symptom" UBYTE _CNV_S_2_RANGE__0___1_CM 1 100. 0. 1. DISPLAY_IDENTIFIER LV_ERR_LS_UP_DYN_VLD_1 ECU_ADDRESS 0xd0003841 BIT_MASK 0x1 /end MEASUREMENT
/begin MEASUREMENT lv_err_ls_up_dyn_vld_2 "Boolean flag indicating the validation of correspondent symptom" UBYTE _CNV_S_2_RANGE__0___1_CM 1 100. 0. 1. DISPLAY_IDENTIFIER LV_ERR_LS_UP_DYN_VLD_2 ECU_ADDRESS 0xd0003843 BIT_MASK 0x1 /end MEASUREMENT
/begin MEASUREMENT lamb_mv "mean value lambda in multiple-branched exhaust gas lines" UWORD _CNV_A_R_LINEAR_____122_CM 1 100. 0. 31.9990234375 DISPLAY_IDENTIFIER LAMB_MV ECU_ADDRESS 0xd0004c1e FORMAT "%7.4" /end MEASUREMENT
/begin MEASUREMENT lv_lsl_ofs_puls_1 "Request" UBYTE _CNV_S_2_RANGE__0___1_CM 1 100. 0. 1. DISPLAY_IDENTIFIER LV_LSL_OFS_PULS_1 ECU_ADDRESS 0xd0003842 BIT_MASK 0x1 /end MEASUREMENT
/begin MEASUREMENT lv_lsl_ofs_puls_2 "Request" UBYTE _CNV_S_2_RANGE__0___1_CM 1 100. 0. 1. DISPLAY_IDENTIFIER LV_LSL_OFS_PULS_2 ECU_ADDRESS 0xd0003844 BIT_MASK 0x1 /end MEASUREMENT
/begin MEASUREMENT vls_down_min_dc[0] "Min Voltage Value in a DC" UWORD _CNV_A_R_LINEAR_____218_CM 1 100. 0. 4.995 DISPLAY_IDENTIFIER VLS_DOWN_MIN_DC[1] ECU_ADDRESS 0xd0004c20 FORMAT "%5.3" /end MEASUREMENT
/begin MEASUREMENT vls_down_min_dc[1] "Min Voltage Value in a DC" UWORD _CNV_A_R_LINEAR_____218_CM 1 100. 0. 4.995 DISPLAY_IDENTIFIER VLS_DOWN_MIN_DC[2] ECU_ADDRESS 0xd0004c22 FORMAT "%5.3" /end MEASUREMENT
/begin MEASUREMENT vls_down_max_dc[0] "Max Voltage Value in a DC" UWORD _CNV_A_R_LINEAR_____218_CM 1 100. 0. 4.995 DISPLAY_IDENTIFIER VLS_DOWN_MAX_DC[1] ECU_ADDRESS 0xd0004c24 FORMAT "%5.3" /end MEASUREMENT
/begin MEASUREMENT vls_down_max_dc[1] "Max Voltage Value in a DC" UWORD _CNV_A_R_LINEAR_____218_CM 1 100. 0. 4.995 DISPLAY_IDENTIFIER VLS_DOWN_MAX_DC[2] ECU_ADDRESS 0xd0004c26 FORMAT "%5.3" /end MEASUREMENT
/begin MEASUREMENT delta_lamb_sp_o2l_mdl[0] "Lambda set point shift of catalyst o2 loading condition function" SWORD _CNV_A_R_LINEAR_____23_CM 1 100. -0.125 0.125 DISPLAY_IDENTIFIER DELTA_LAMB_SP_O2L_MDL[0] ECU_ADDRESS 0xd0004c28 FORMAT "%8.5" /end MEASUREMENT
/begin MEASUREMENT delta_lamb_sp_o2l_mdl[1] "Lambda set point shift of catalyst o2 loading condition function" SWORD _CNV_A_R_LINEAR_____23_CM 1 100. -0.125 0.125 DISPLAY_IDENTIFIER DELTA_LAMB_SP_O2L_MDL[1] ECU_ADDRESS 0xd0004c2a FORMAT "%8.5" /end MEASUREMENT
/begin MEASUREMENT cat_diag_mod_6[0] "Cat. Diag. value for OBD Scantools Mod 6 output" UBYTE _CNV_A_R_LINEAR_____283_CM 1 100. 0. 1.984375 DISPLAY_IDENTIFIER CAT_DIAG_MOD_6[0] ECU_ADDRESS 0xd0003848 FORMAT "%8.6" /end MEASUREMENT
/begin MEASUREMENT cat_diag_mod_6[1] "Cat. Diag. value for OBD Scantools Mod 6 output" UBYTE _CNV_A_R_LINEAR_____283_CM 1 100. 0. 1.984375 DISPLAY_IDENTIFIER CAT_DIAG_MOD_6[1] ECU_ADDRESS 0xd0003849 FORMAT "%8.6" /end MEASUREMENT
/begin MEASUREMENT lamb_puls_so2p[0] "Delta lambda to pass to the lambda stimulation coordination routine" SBYTE _CNV_A_R_LINEAR_____122_CM 1 100. -0.125 0.1240234375 DISPLAY_IDENTIFIER LAMB_PULS_SO2P[0] ECU_ADDRESS 0xd000384c FORMAT "%7.4" /end MEASUREMENT
/begin MEASUREMENT lamb_puls_so2p[1] "Delta lambda to pass to the lambda stimulation coordination routine" SBYTE _CNV_A_R_LINEAR_____122_CM 1 100. -0.125 0.1240234375 DISPLAY_IDENTIFIER LAMB_PULS_SO2P[1] ECU_ADDRESS 0xd000384d FORMAT "%7.4" /end MEASUREMENT
/begin MEASUREMENT lv_lam_adj_rng_vld_cat_diag_1 "Boolean flag indicating Trim Ctr P-Share is inside a calibrateable window" UBYTE _CNV_S_2_RANGE__0___1_CM 1 100. 0. 1. DISPLAY_IDENTIFIER LV_LAM_ADJ_RNG_VLD_CAT_DIAG_1 ECU_ADDRESS 0xd0003853 /end MEASUREMENT
/begin MEASUREMENT lv_lam_adj_rng_vld_cat_diag_2 "Boolean flag indicating Trim Ctr P-Share is inside a calibrateable window" UBYTE _CNV_S_2_RANGE__0___1_CM 1 100. 0. 1. DISPLAY_IDENTIFIER LV_LAM_ADJ_RNG_VLD_CAT_DIAG_2 ECU_ADDRESS 0xd0003857 /end MEASUREMENT
/begin MEASUREMENT lv_mff_ad_end "logical value indicating temporary end of lambda adaptation" UBYTE _CNV_S_2_RANGE__0___1_CM 1 100. 0. 1. DISPLAY_IDENTIFIER LV_MFF_AD_END ECU_ADDRESS 0xd0003818 BIT_MASK 0x1 /end MEASUREMENT
/begin MEASUREMENT lv_mff_ad_cdn "flag for time scheduler indicating good conditions for lambda adaptation" UBYTE _CNV_S_2_RANGE__0___1_CM 1 100. 0. 1. DISPLAY_IDENTIFIER LV_MFF_AD_CDN ECU_ADDRESS 0xd0003819 BIT_MASK 0x1 /end MEASUREMENT
/begin MEASUREMENT vls_cyl[0] "upstream oxygen sensor acquisition (cylinder individual)" UWORD _CNV_A_R_LINEAR_____2_CM 1 100. 0. 4.9951171875 DISPLAY_IDENTIFIER VLS_CYL_0 ECU_ADDRESS 0xd0004c00 FORMAT "%5.3" /end MEASUREMENT
/begin MEASUREMENT vls_cyl[1] "upstream oxygen sensor acquisition (cylinder individual)" UWORD _CNV_A_R_LINEAR_____2_CM 1 100. 0. 4.9951171875 DISPLAY_IDENTIFIER VLS_CYL_1 ECU_ADDRESS 0xd0004c02 FORMAT "%5.3" /end MEASUREMENT
/begin MEASUREMENT vls_cyl[2] "upstream oxygen sensor acquisition (cylinder individual)" UWORD _CNV_A_R_LINEAR_____2_CM 1 100. 0. 4.9951171875 DISPLAY_IDENTIFIER VLS_CYL_2 ECU_ADDRESS 0xd0004c04 FORMAT "%5.3" /end MEASUREMENT
/begin MEASUREMENT vls_cyl[3] "upstream oxygen sensor acquisition (cylinder individual)" UWORD _CNV_A_R_LINEAR_____2_CM 1 100. 0. 4.9951171875 DISPLAY_IDENTIFIER VLS_CYL_3 ECU_ADDRESS 0xd0004c06 FORMAT "%5.3" /end MEASUREMENT
/begin MEASUREMENT vls_cyl[4] "upstream oxygen sensor acquisition (cylinder individual)" UWORD _CNV_A_R_LINEAR_____2_CM 1 100. 0. 4.9951171875 DISPLAY_IDENTIFIER VLS_CYL_4 ECU_ADDRESS 0xd0004c08 FORMAT "%5.3" /end MEASUREMENT
/begin MEASUREMENT vls_cyl[5] "upstream oxygen sensor acquisition (cylinder individual)" UWORD _CNV_A_R_LINEAR_____2_CM 1 100. 0. 4.9951171875 DISPLAY_IDENTIFIER VLS_CYL_5 ECU_ADDRESS 0xd0004c0a FORMAT "%5.3" /end MEASUREMENT
/begin MEASUREMENT vls_cyl_trig[0] "cylinder selective update counter for trigger event" UBYTE _CNV_A_R_LINEAR_____0_CM 1 100. 0. 255. DISPLAY_IDENTIFIER VLS_CYL_TRIG_0 ECU_ADDRESS 0xd000381c FORMAT "%3.0" /end MEASUREMENT
/begin MEASUREMENT vls_cyl_trig[1] "cylinder selective update counter for trigger event" UBYTE _CNV_A_R_LINEAR_____0_CM 1 100. 0. 255. DISPLAY_IDENTIFIER VLS_CYL_TRIG_1 ECU_ADDRESS 0xd000381d FORMAT "%3.0" /end MEASUREMENT
/begin MEASUREMENT vls_cyl_trig[2] "cylinder selective update counter for trigger event" UBYTE _CNV_A_R_LINEAR_____0_CM 1 100. 0. 255. DISPLAY_IDENTIFIER VLS_CYL_TRIG_2 ECU_ADDRESS 0xd000381e FORMAT "%3.0" /end MEASUREMENT
/begin MEASUREMENT vls_cyl_trig[3] "cylinder selective update counter for trigger event" UBYTE _CNV_A_R_LINEAR_____0_CM 1 100. 0. 255. DISPLAY_IDENTIFIER VLS_CYL_TRIG_3 ECU_ADDRESS 0xd000381f FORMAT "%3.0" /end MEASUREMENT
/begin MEASUREMENT vls_cyl_trig[4] "cylinder selective update counter for trigger event" UBYTE _CNV_A_R_LINEAR_____0_CM 1 100. 0. 255. DISPLAY_IDENTIFIER VLS_CYL_TRIG_4 ECU_ADDRESS 0xd0003820 FORMAT "%3.0" /end MEASUREMENT
/begin MEASUREMENT vls_cyl_trig[5] "cylinder selective update counter for trigger event" UBYTE _CNV_A_R_LINEAR_____0_CM 1 100. 0. 255. DISPLAY_IDENTIFIER VLS_CYL_TRIG_5 ECU_ADDRESS 0xd0003821 FORMAT "%3.0" /end MEASUREMENT
/begin CHARACTERISTIC lc_fac_lam_ad_out_bal_man "Manual adjustment off full mass set point factor for cylinder balancing" VALUE 0xa1029d34 _REC_VAL_20_u1 1. _CNV_A_R_LINEAR_____0_CM 0. 1. DISPLAY_IDENTIFIER LC_FAC_LAM_AD_OUT_BAL_MAN FORMAT "%1.0" /end CHARACTERISTIC
/begin MEASUREMENT fac_ad_lam_bal[0] "Multiple fuel mass setpoint factor for cylinder balancing" SWORD _CNV_A_R_LINEAR_____110_CM 1 100. -50. 49.9984741210938 DISPLAY_IDENTIFIER FAC_AD_LAM_BAL[1] ECU_ADDRESS 0xd0004c0c FORMAT "%7.3" /end MEASUREMENT
/begin MEASUREMENT fac_ad_lam_bal[1] "Multiple fuel mass setpoint factor for cylinder balancing" SWORD _CNV_A_R_LINEAR_____110_CM 1 100. -50. 49.9984741210938 DISPLAY_IDENTIFIER FAC_AD_LAM_BAL[2] ECU_ADDRESS 0xd0004c0e FORMAT "%7.3" /end MEASUREMENT
/begin MEASUREMENT mff_add_ad_lam_bal[0] "Additive fuel mass setpoint factor for cylinder balancing" SWORD _CNV_A_R_LINEAR_____192_CM 1 100. -694.5 694.478806 DISPLAY_IDENTIFIER MFF_ADD_AD_LAM_BAL[0] ECU_ADDRESS 0xd0004c10 FORMAT "%7.2" /end MEASUREMENT
/begin MEASUREMENT mff_add_ad_lam_bal[1] "Additive fuel mass setpoint factor for cylinder balancing" SWORD _CNV_A_R_LINEAR_____192_CM 1 100. -694.5 694.478806 DISPLAY_IDENTIFIER MFF_ADD_AD_LAM_BAL[1] ECU_ADDRESS 0xd0004c12 FORMAT "%7.2" /end MEASUREMENT
/begin MEASUREMENT fac_lam_mv "mean value of lambda controller output bank 1 and bank 2" SWORD _CNV_A_R_LINEAR_____110_CM 1 100. -50. 49.9984741210938 DISPLAY_IDENTIFIER FAC_LAM_MV ECU_ADDRESS 0xd0004c14 FORMAT "%7.3" /end MEASUREMENT
/begin MEASUREMENT amp_mdl "Ambient pressure (modelled)" UWORD _CNV_A_R_LINEAR_____131_CM 1 100. 0. 5434.25976563 DISPLAY_IDENTIFIER AMP_MDL ECU_ADDRESS 0xd0004cb8 FORMAT "%7.2" /end MEASUREMENT
/begin MEASUREMENT amp "Ambient pressure (measured or adapted)" UWORD _CNV_A_R_LINEAR_____131_CM 1 100. 0. 5434.25976563 DISPLAY_IDENTIFIER AMP ECU_ADDRESS 0xd0004cb4 FORMAT "%7.2" /end MEASUREMENT
/begin MEASUREMENT amp_ad "Ambient pressure (adapted)" UWORD _CNV_A_R_LINEAR_____131_CM 1 100. 0. 5434.25976563 DISPLAY_IDENTIFIER AMP_AD ECU_ADDRESS 0xd0004cb6 FORMAT "%7.2" /end MEASUREMENT
/begin MEASUREMENT maf_int_pue "air mass flow integral during not pull cut off phase" UWORD _CNV_A_R_LINEAR_____329_CM 1 100. 0. 2912.66666666667 DISPLAY_IDENTIFIER MAF_INT_PUE ECU_ADDRESS 0xd0004cbc FORMAT "%7.2" /end MEASUREMENT
/begin MEASUREMENT maf_int_puc "air mass flow integral during pull cut off phase" UWORD _CNV_A_R_LINEAR_____329_CM 1 100. 0. 2912.66666666667 DISPLAY_IDENTIFIER MAF_INT_PUC ECU_ADDRESS 0xd0004cba FORMAT "%7.2" /end MEASUREMENT
/begin MEASUREMENT pv "global degree of activation of the accelerator pedal (high resolution)" UWORD _CNV_A_R_CPULOAD__0_461_CM 1 100. 0. 99.90234375 DISPLAY_IDENTIFIER PV ECU_ADDRESS 0xd0004c40 FORMAT "%5.2" /end MEASUREMENT
/begin MEASUREMENT cam_raw_ex[0] "Actual raw position (no second edge adaption compensated) exhaust CAM VVTI" UBYTE _CNV_A_R_LINEAR_____567_CM 1 100. -40. -135.625 DISPLAY_IDENTIFIER CAM_RAW_EX[1] ECU_ADDRESS 0xd00038e5 FORMAT "%8.3" /end MEASUREMENT
/begin MEASUREMENT cam_raw_in[0] "Actual raw position (no second edge adaption compensated) inlet CAM VVTI" UBYTE _CNV_A_R_LINEAR_____568_CM 1 100. 60. 155.625 DISPLAY_IDENTIFIER CAM_RAW_IN[1] ECU_ADDRESS 0xd00038e6 FORMAT "%8.3" /end MEASUREMENT
/begin MEASUREMENT cam_ex_park[0] "Last valid CAM position before engine stop (exhaust CAM VVTI)" UBYTE _CNV_A_R_LINEAR_____567_CM 1 100. -40. -135.625 DISPLAY_IDENTIFIER CAM_EX_PARK[1] ECU_ADDRESS 0xd00038e7 FORMAT "%8.3" /end MEASUREMENT
/begin MEASUREMENT cam_in_park[0] "Last valid CAM position before engine stop (inlet CAM VVTI)" UBYTE _CNV_A_R_LINEAR_____568_CM 1 100. 60. 155.625 DISPLAY_IDENTIFIER CAM_IN_PARK[1] ECU_ADDRESS 0xd00038e8 FORMAT "%8.3" /end MEASUREMENT
/begin MEASUREMENT lv_ldm_disable_can "Logical variable for disabling LDM intervention due to CAN error" UBYTE _CNV_S_2_RANGE__0___1_CM 1 100. 0. 1. DISPLAY_IDENTIFIER LV_LDM_DISABLE_CAN ECU_ADDRESS 0xd0003eee BIT_MASK 0x1 /end MEASUREMENT
/begin MEASUREMENT state_tq_ldm_plaus "Bitwise coded state for LDM intervention state" UBYTE _CNV_A_R_LINEAR_____0_CM 1 100. 0. 255. DISPLAY_IDENTIFIER STATE_TQ_LDM_PLAUS ECU_ADDRESS 0xd0003eec FORMAT "%3.0" /end MEASUREMENT
/begin MEASUREMENT tq_wheel_ldm_req "Torque increase for torque intervention during LDM" SWORD _CNV_A_R_LINEAR_____60_CM 1 100. -32768. 32767. DISPLAY_IDENTIFIER TQ_WHEEL_LDM_REQ ECU_ADDRESS 0xc0000d3c FORMAT "%6.0" /end MEASUREMENT
/begin MEASUREMENT tq_sp_wheel "Torque increase for fast torque intervention during LDM" SWORD _CNV_A_R_LINEAR_____60_CM 1 100. -32768. 32767. DISPLAY_IDENTIFIER TQ_SP_WHEEL ECU_ADDRESS 0xd000533c FORMAT "%6.0" /end MEASUREMENT
/begin MEASUREMENT lv_ldm_ena "Logical variable for increased torque intervention due to LDM" UBYTE _CNV_S_2_RANGE__0___1_CM 1 100. 0. 1. DISPLAY_IDENTIFIER LV_LDM_ENA ECU_ADDRESS 0xd0003eef BIT_MASK 0x1 /end MEASUREMENT
/begin MEASUREMENT lv_ldm_act "Logical variable for torque intervention due to LDM" UBYTE _CNV_S_2_RANGE__0___1_CM 1 100. 0. 1. DISPLAY_IDENTIFIER LV_LDM_ACT ECU_ADDRESS 0xd0003eed BIT_MASK 0x1 /end MEASUREMENT
/begin MEASUREMENT lv_ldm_lih "Logical variable for torque intervention LIH due to LDM" UBYTE _CNV_S_2_RANGE__0___1_CM 1 100. 0. 1. DISPLAY_IDENTIFIER LV_LDM_LIH ECU_ADDRESS 0xd0003ef1 BIT_MASK 0x1 /end MEASUREMENT
/begin MEASUREMENT t_ldm_lih_ctr "Time counter delay time" UBYTE _CNV_A_R_LINEAR_____3_CM 1 100. 0. 2.55 DISPLAY_IDENTIFIER T_LDM_LIH_CTR ECU_ADDRESS 0xc0000d44 FORMAT "%4.2" /end MEASUREMENT
/begin CHARACTERISTIC c_lgrd_lih_ldm "Limiting gradient for LDM emergency ramp function" VALUE 0xa1029526 _REC_VAL_20_u2 1023.96875 _CNV_A_R_LINEAR_____165_CM 0. 1023.96875 DISPLAY_IDENTIFIER C_LGRD_LIH_LDM FORMAT "%7.2" /end CHARACTERISTIC
/begin CHARACTERISTIC c_t_dly_lih_ldm "Delay time for activation of LDM emergency ramp function" VALUE 0xa102986c _REC_VAL_20_u1 2.55 _CNV_A_R_LINEAR_____3_CM 0. 2.55 DISPLAY_IDENTIFIER C_T_DLY_LIH_LDM FORMAT "%4.2" /end CHARACTERISTIC
/begin MEASUREMENT lv_ldm_puc_inh "Logical variable for PUC-inhibit due to LDM" UBYTE _CNV_S_2_RANGE__0___1_CM 1 100. 0. 1. DISPLAY_IDENTIFIER LV_LDM_PUC_INH ECU_ADDRESS 0xd0003ef0 BIT_MASK 0x1 /end MEASUREMENT
/begin CHARACTERISTIC c_state_di_puc_act "State disable IS/PU/PUC engine states" VALUE 0xa10297ad _REC_VAL_20_u1 3. _CNV_A_R_LINEAR_____0_CM 0. 3. DISPLAY_IDENTIFIER C_STATE_DI_PUC_ACT FORMAT "%1.0" /end CHARACTERISTIC
/begin MEASUREMENT inh_iv_cst "Start cycle counter starting with the first injection" UBYTE _CNV_A_R_LINEAR_____0_CM 1 100. 0. 255. DISPLAY_IDENTIFIER INH_IV_CST ECU_ADDRESS 0xd00037f8 FORMAT "%3.0" /end MEASUREMENT
/begin MEASUREMENT lv_warm_rst "warm reset during ECU-run has occured" UBYTE _CNV_S_2_RANGE__0___1_CM 1 100. 0. 1. DISPLAY_IDENTIFIER LV_WARM_RST ECU_ADDRESS 0xd0003e7c BIT_MASK 0x1 /end MEASUREMENT
/begin MEASUREMENT lv_rst_det "warm reset during current ECU-lifetime has occured" UBYTE _CNV_S_2_RANGE__0___1_CM 1 100. 0. 1. DISPLAY_IDENTIFIER LV_RST_DET ECU_ADDRESS 0xd00018bc BIT_MASK 0x1 /end MEASUREMENT
/begin MEASUREMENT rst_det "reset status (reasons for atypical reset)" UBYTE _CNV_A_R_LINEAR_____0_CM 1 100. 0. 255. DISPLAY_IDENTIFIER RST_DET ECU_ADDRESS 0xd00018bd FORMAT "%3.0" /end MEASUREMENT
/begin MEASUREMENT rst_ctr "warm reset counter (atypical warm resets since last power-up)" UBYTE _CNV_A_R_LINEAR_____0_CM 1 100. 0. 255. DISPLAY_IDENTIFIER RST_CTR ECU_ADDRESS 0xd00018be FORMAT "%3.0" /end MEASUREMENT
/begin MEASUREMENT rst_info.rst_lprc_reset_address "reset interface caller address" ULONG _CNV_A_R_LINEAR_____50_CM 1 100. 0. 4294967295. DISPLAY_IDENTIFIER RST_LPRC_RESET_ADDRESS ECU_ADDRESS 0xd00018ac /end MEASUREMENT
/begin MEASUREMENT rst_info.rst_sw_status "SW reset status info" ULONG _CNV_A_R_LINEAR_____50_CM 1 100. 0. 4294967295. DISPLAY_IDENTIFIER RST_SW_STATUS ECU_ADDRESS 0xd00018b0 /end MEASUREMENT
/begin MEASUREMENT rst_info.rst_hw_status "HW reset status info" UWORD _CNV_A_R_LINEAR_____50_CM 1 100. 0. 65535. DISPLAY_IDENTIFIER RST_HW_STATUS ECU_ADDRESS 0xd00018b4 /end MEASUREMENT
/begin MEASUREMENT lv_err_warm_rst "warm reset error flag" UBYTE _CNV_S_2_RANGE__0___1_CM 1 100. 0. 1. DISPLAY_IDENTIFIER LV_ERR_WARM_RST ECU_ADDRESS 0xd00034ca BIT_MASK 0x1 /end MEASUREMENT
/begin MEASUREMENT cpu_load_max_rst_det "max CPU load since last FMY clear" UWORD _CNV_A_R_CPULOAD__0_461_CM 1 100. 0. 100. DISPLAY_IDENTIFIER CPU_LOAD_MAX_RST_DET ECU_ADDRESS 0xd00018b8 FORMAT "%3.1" /end MEASUREMENT
/begin MEASUREMENT n_max_rst_det "engine speed at max CPU load" UWORD _CNV_A_R_LINEAR_____13_CM 1 100. 0. 8160. DISPLAY_IDENTIFIER N_MAX_RST_DET ECU_ADDRESS 0xd00018ba FORMAT "%4.0" /end MEASUREMENT
/begin MEASUREMENT cpu_load_rst_det "CPU load at reset" UWORD _CNV_A_R_CPULOAD__0_461_CM 1 100. 0. 100. DISPLAY_IDENTIFIER CPU_LOAD_RST_DET ECU_ADDRESS 0xd0005270 FORMAT "%3.1" /end MEASUREMENT
/begin MEASUREMENT n_rst_det "engine speed at reset" UWORD _CNV_A_R_LINEAR_____13_CM 1 100. 0. 8160. DISPLAY_IDENTIFIER N_RST_DET ECU_ADDRESS 0xd0005272 FORMAT "%4.0" /end MEASUREMENT
/begin MEASUREMENT dist_rst_det "Distance accumulation at reset [100m]" ULONG _CNV_A_R_LINEAR_____446_CM 1 100. 0. 429496729500. DISPLAY_IDENTIFIER DIST_RST_DET ECU_ADDRESS 0xd00057f8 FORMAT "%13.0" /end MEASUREMENT
/begin CHARACTERISTIC lc_warm_rst_ena "Logical constant for enabling Warm reset detection" VALUE 0xa1029e1a _REC_VAL_20_u1 1. _CNV_A_R_LINEAR_____0_CM 0. 1. DISPLAY_IDENTIFIER LC_WARM_RST_ENA FORMAT "%2.0" /end CHARACTERISTIC
/begin MEASUREMENT lv_tqi_req_can_inh "general flag for inhibition of external torque requests" UBYTE _CNV_S_2_RANGE__0___1_CM 1 100. 0. 1. DISPLAY_IDENTIFIER LV_TQI_REQ_CAN_INH ECU_ADDRESS 0xd0003f24 BIT_MASK 0x1 /end MEASUREMENT
/begin COMPU_METHOD _CNV_A_R_LINEAR_____0_CM "" RAT_FUNC "%6.3" "-" COEFFS 0 1. 0. 0 0 1 /end COMPU_METHOD
/begin COMPU_METHOD _CNV_S_2_RANGE__0___1_CM "" TAB_VERB "%6.3" "-" COMPU_TAB_REF _CNV_S_2_RANGE__0___1 /end COMPU_METHOD
/begin COMPU_VTAB _CNV_S_2_RANGE__0___1 "" TAB_VERB 2 0 "0" 1 "1" /end COMPU_VTAB
/begin COMPU_METHOD _CNV_A_R_LINEAR_____2_CM "" RAT_FUNC "%6.3" "V" COEFFS 0 204.8 0. 0 0 1 /end COMPU_METHOD
/begin COMPU_METHOD _CNV_A_R_LINEAR_____3_CM "" RAT_FUNC "%6.3" "s" COEFFS 0 100. 0. 0 0 1 /end COMPU_METHOD
/begin COMPU_METHOD _CNV_A_R_LINEAR_____4_CM "" RAT_FUNC "%6.3" "s" COEFFS 0 10. 0. 0 0 1 /end COMPU_METHOD
/begin COMPU_METHOD _CNV_A_R_LINEAR_____5_CM "" RAT_FUNC "%6.3" "%" COEFFS 0 2.56 0. 0 0 1 /end COMPU_METHOD
/begin COMPU_METHOD _CNV_A_R_LINEAR_____7_CM "" RAT_FUNC "%6.3" "%" COEFFS 0 655.3599999999997 0. 0 0 1 /end COMPU_METHOD
/begin COMPU_METHOD _CNV_A_R_LINEAR_____8_CM "" RAT_FUNC "%6.3" "-" COEFFS 0 32767.99999999992 0. 0 0 1 /end COMPU_METHOD
/begin COMPU_METHOD _CNV_A_R_LINEAR_____9_CM "" RAT_FUNC "%6.3" "rpm" COEFFS 0 3.125e-002 0. 0 0 1 /end COMPU_METHOD
/begin COMPU_METHOD _CNV_A_R_LINEAR_____13_CM "" RAT_FUNC "%6.3" "rpm" COEFFS 0 1. 0. 0 0 1 /end COMPU_METHOD
/begin COMPU_METHOD _CNV_A_R_LINEAR_____14_CM "" RAT_FUNC "%6.3" "mg/stk" COEFFS 0 0.183585313174946 0. 0 0 1 /end COMPU_METHOD
/begin COMPU_METHOD _CNV_A_R_LINEAR_____16_CM "" RAT_FUNC "%6.3" "°C" COEFFS 0 1.333333333333333 64. 0 0 1 /end COMPU_METHOD
/begin COMPU_METHOD _CNV_A_R_LINEAR_____23_CM "" RAT_FUNC "%6.3" "-" COEFFS 0 16384. 0. 0 0 1 /end COMPU_METHOD
/begin COMPU_METHOD _CNV_A_R_LINEAR_____26_CM "" RAT_FUNC "%6.3" "hPa" COEFFS 0 12.06017666543982 0. 0 0 1 /end COMPU_METHOD
/begin COMPU_METHOD _CNV_A_R_LINEAR_____27_CM "" RAT_FUNC "%6.3" "-" COEFFS 0 256. 0. 0 0 1 /end COMPU_METHOD
/begin COMPU_METHOD _CNV_A_R_LINEAR_____30_CM "" RAT_FUNC "%6.3" "Nm" COEFFS 0 32. 0. 0 0 1 /end COMPU_METHOD
/begin COMPU_METHOD _CNV_A_R_LINEAR_____35_CM "" RAT_FUNC "%6.3" "s" COEFFS 0 1. 0. 0 0 1 /end COMPU_METHOD
/begin COMPU_METHOD _CNV_A_R_LINEAR_____36_CM "" RAT_FUNC "%6.3" "V" COEFFS 0 9.807692307692308 0. 0 0 1 /end COMPU_METHOD
/begin COMPU_METHOD _CNV_A_R_LINEAR_____50_CM "" RAT_FUNC "%6.3" "" COEFFS 0 1. 0. 0 0 1 /end COMPU_METHOD
/begin COMPU_METHOD _CNV_A_R_LINEAR_____60_CM "" RAT_FUNC "%6.3" "Nm" COEFFS 0 1. 0. 0 0 1 /end COMPU_METHOD
/begin COMPU_METHOD _CNV_A_R_LINEAR_____65_CM "" RAT_FUNC "%6.3" "Nm" COEFFS 0 32. 32768. 0 0 1 /end COMPU_METHOD
/begin COMPU_METHOD _CNV_A_R_LINEAR_____66_CM "" RAT_FUNC "%6.3" "km/h" COEFFS 0 128.0000018750286 0. 0 0 1 /end COMPU_METHOD
/begin COMPU_METHOD _CNV_A_R_LINEAR_____68_CM "" RAT_FUNC "%6.3" "-" COEFFS 0 65535.99999999996 0. 0 0 1 /end COMPU_METHOD
/begin COMPU_METHOD _CNV_S_2_RANGE______75_CM "" TAB_VERB "%6.3" "" COMPU_TAB_REF _CNV_S_2_RANGE______75 /end COMPU_METHOD
/begin COMPU_VTAB _CNV_S_2_RANGE______75 "" TAB_VERB 2 0 "0" 1 "1" /end COMPU_VTAB
/begin COMPU_METHOD _CNV_A_R_LINEAR_____100_CM "" RAT_FUNC "%6.3" "-" COEFFS 0 128. 0. 0 0 1 /end COMPU_METHOD
/begin COMPU_METHOD _CNV_A_R_LINEAR_____107_CM "" RAT_FUNC "%6.3" "s" COEFFS 0 50. 0. 0 0 1 /end COMPU_METHOD
/begin COMPU_METHOD _CNV_A_R_LINEAR_____108_CM "" RAT_FUNC "%6.3" "mg/stk" COEFFS 0 47.18142548596112 0. 0 0 1 /end COMPU_METHOD
/begin COMPU_METHOD _CNV_A_R_LINEAR_____110_CM "" RAT_FUNC "%6.3" "%" COEFFS 0 655.3599999999997 -1.455191522836685e-011 0 0 1 /end COMPU_METHOD
/begin COMPU_METHOD _CNV_A_R_LINEAR_____113_CM "" RAT_FUNC "%6.3" "-" COEFFS 0 8192. 0. 0 0 1 /end COMPU_METHOD
/begin COMPU_METHOD _CNV_A_R_LINEAR_____114_CM "" RAT_FUNC "%6.3" "-" COEFFS 0 1023.999999959999 0. 0 0 1 /end COMPU_METHOD
/begin COMPU_METHOD _CNV_A_R_LINEAR_____122_CM "" RAT_FUNC "%6.3" "-" COEFFS 0 1024. 0. 0 0 1 /end COMPU_METHOD
/begin COMPU_METHOD _CNV_A_R_LINEAR_____131_CM "" RAT_FUNC "%6.3" "hPa" COEFFS 0 12.05960017121163 0. 0 0 1 /end COMPU_METHOD
/begin COMPU_METHOD _CNV_A_R_LINEAR_____147_CM "" RAT_FUNC "%6.3" "kg/h" COEFFS 0 8192. 0. 0 0 1 /end COMPU_METHOD
/begin COMPU_METHOD _CNV_A_R_LINEAR_____152_CM "" RAT_FUNC "%6.3" "hPa" COEFFS 0 0.1884402603974972 0. 0 0 1 /end COMPU_METHOD
/begin COMPU_METHOD _CNV_A_R_LINEAR_____154_CM "" RAT_FUNC "%6.3" "l/h" COEFFS 0 1. 0. 0 0 1 /end COMPU_METHOD
/begin COMPU_METHOD _CNV_S_4_STATE_AMT__164_CM "" TAB_VERB "%6.3" "" COMPU_TAB_REF _CNV_S_4_STATE_AMT__164 /end COMPU_METHOD
/begin COMPU_VTAB _CNV_S_4_STATE_AMT__164 "" TAB_VERB 4 0 "NO" 1 "DEC" 2 "INC" 3 "DEC_INC" /end COMPU_VTAB
/begin COMPU_METHOD _CNV_A_R_LINEAR_____165_CM "" RAT_FUNC "%6.3" "Nm/10ms" COEFFS 0 32. 0. 0 0 1 /end COMPU_METHOD
/begin COMPU_METHOD _CNV_A_R_LINEAR_____166_CM "" RAT_FUNC "%6.3" "°CRK" COEFFS 0 16. 0. 0 0 1 /end COMPU_METHOD
/begin COMPU_METHOD _CNV_A_R_LINEAR_____167_CM "" RAT_FUNC "%6.3" "°CRK" COEFFS 0 2.666666666666667 95. 0 0 1 /end COMPU_METHOD
/begin COMPU_METHOD _CNV_A_R_LINEAR_____168_CM "" RAT_FUNC "%6.3" "°CRK" COEFFS 0 2.666666666666667 0. 0 0 1 /end COMPU_METHOD
/begin COMPU_METHOD _CNV_A_R_LINEAR_____192_CM "" RAT_FUNC "%6.3" "mg/stk" COEFFS 0 47.18214541280769 -1.080506262951531e-005 0 0 1 /end COMPU_METHOD
/begin COMPU_METHOD _CNV_A_R_LINEAR_____200_CM "" RAT_FUNC "%6.3" "-" COEFFS 0 32768.00003968061 3.96806062781252e-005 0 0 1 /end COMPU_METHOD
/begin COMPU_METHOD _CNV_A_R_LINEAR_____201_CM "" RAT_FUNC "%6.3" "%" COEFFS 0 327.68 0. 0 0 1 /end COMPU_METHOD
/begin COMPU_METHOD _CNV_A_R_LINEAR_____202_CM "" RAT_FUNC "%6.3" "mg/stk" COEFFS 0 47.18142548596112 -1.455191522836685e-011 0 0 1 /end COMPU_METHOD
/begin COMPU_METHOD _CNV_A_R_LINEAR_____203_CM "" RAT_FUNC "%6.3" "-" COEFFS 0 262144.1943071089 2.428838861669647e-002 0 0 1 /end COMPU_METHOD
/begin COMPU_METHOD _CNV_A_R_LINEAR_____204_CM "" RAT_FUNC "%6.3" "°C" COEFFS 0 16. 4370.4 0 0 1 /end COMPU_METHOD
/begin COMPU_METHOD _CNV_S_6_STATE_LSH__205_CM "" TAB_VERB "%6.3" "" COMPU_TAB_REF _CNV_S_6_STATE_LSH__205 /end COMPU_METHOD
/begin COMPU_VTAB _CNV_S_6_STATE_LSH__205 "" TAB_VERB 6 0 "LSH_OFF_DOWN" 1 "PREHEATING_DOWN" 2 "LSH_POW_RED_DOWN" 3 "HEATING_GRD_DOWN" 4 "HEATING_DOWN" 5 "VB_PROTECTION_DOWN" /end COMPU_VTAB
/begin COMPU_METHOD _CNV_S_7_STATE_LSH__206_CM "" TAB_VERB "%6.3" "" COMPU_TAB_REF _CNV_S_7_STATE_LSH__206 /end COMPU_METHOD
/begin COMPU_VTAB _CNV_S_7_STATE_LSH__206 "" TAB_VERB 7 0 "LSH_OFF" 1 "LSH_POW_RISE" 2 "LSH_POW_RED" 3 "LSH_POW_FALL" 4 "LSH_POW_CTL" 5 "LSH_VB_PROT" 6 "LSH_TEMP_PROT" /end COMPU_VTAB
/begin COMPU_METHOD _CNV_A_R_LINEAR_____207_CM "" RAT_FUNC "%6.3" "kg/h" COEFFS 0 32. 0. 0 0 1 /end COMPU_METHOD
/begin COMPU_METHOD _CNV_A_R_LINEAR_____218_CM "" RAT_FUNC "%6.3" "V" COEFFS 0 204.8048048048048 0. 0 0 1 /end COMPU_METHOD
/begin COMPU_METHOD _CNV_A_R_LINEAR_____219_CM "" RAT_FUNC "%6.3" "mg/stk" COEFFS 0 47.18070554355651 0. 0 0 1 /end COMPU_METHOD
/begin COMPU_METHOD _CNV_A_R_LINEAR_____233_CM "" RAT_FUNC "%6.3" "ms" COEFFS 0 1000. 0. 0 0 1 /end COMPU_METHOD
/begin COMPU_METHOD _CNV_A_R_LINEAR_____272_CM "" RAT_FUNC "%6.3" "m/s²" COEFFS 0 640. 32768. 0 0 1 /end COMPU_METHOD
/begin COMPU_METHOD _CNV_A_R_LINEAR_____283_CM "" RAT_FUNC "%6.3" "-" COEFFS 0 64. 0. 0 0 1 /end COMPU_METHOD
/begin COMPU_METHOD _CNV_A_R_EVAC_LINEA_294_CM "" RAT_FUNC "%6.3" "hPa" COEFFS 0 12.06017666543982 32767.98240706662 0 0 1 /end COMPU_METHOD
/begin COMPU_METHOD _CNV_S_9_STATE_T_SD_295_CM "" TAB_VERB "%6.3" "-" COMPU_TAB_REF _CNV_S_9_STATE_T_SD_295 /end COMPU_METHOD
/begin COMPU_VTAB _CNV_S_9_STATE_T_SD_295 "" TAB_VERB 9 0 "PASSIVE" 1 "CP_FIXED" 2 "LAM_FIXED" 3 "WAIT_LAM" 4 "LAM_DYN" 5 "CP_DYN" 6 "WAIT_CP" 7 "OFF_CP" 8 "EXT_REQ" /end COMPU_VTAB
/begin COMPU_METHOD _CNV_S_4_STATE_MAN__296_CM "" TAB_VERB "%6.3" "-" COMPU_TAB_REF _CNV_S_4_STATE_MAN__296 /end COMPU_METHOD
/begin COMPU_VTAB _CNV_S_4_STATE_MAN__296 "" TAB_VERB 4 0 "AUTOMATIC" 1 "SDL_NONE" 2 "SDL_CP" 3 "LAM_AD" /end COMPU_VTAB
/begin COMPU_METHOD _CNV_S_4_STATE_CLL__300_CM "" TAB_VERB "%6.3" "-" COMPU_TAB_REF _CNV_S_4_STATE_CLL__300 /end COMPU_METHOD
/begin COMPU_VTAB _CNV_S_4_STATE_CLL__300 "" TAB_VERB 4 0 "CP_NO_DEAC" 1 "RAMP_OPEN_DEAC" 2 "MAX_PURGE_DEAC" 3 "RAMP_OPEN_FAST_DEAC" /end COMPU_VTAB
/begin COMPU_METHOD _CNV_S_3_STATE_LOCK_301_CM "" TAB_VERB "%6.3" "-" COMPU_TAB_REF _CNV_S_3_STATE_LOCK_301 /end COMPU_METHOD
/begin COMPU_VTAB _CNV_S_3_STATE_LOCK_301 "" TAB_VERB 3 0 "UNLOCKED" 1 "NO_PURGE_LOCKED" 2 "MIN_PURGE_LOCKED" /end COMPU_VTAB
/begin COMPU_METHOD _CNV_S_4_STATE_MOD__302_CM "" TAB_VERB "%6.3" "-" COMPU_TAB_REF _CNV_S_4_STATE_MOD__302 /end COMPU_METHOD
/begin COMPU_VTAB _CNV_S_4_STATE_MOD__302 "" TAB_VERB 4 0 "NO_PURGE" 1 "MIN_PURGE" 2 "MAX_PURGE" 3 "RAMP_CLOSE" /end COMPU_VTAB
/begin COMPU_METHOD _CNV_A_R_EVAC_LINEA_303_CM "" RAT_FUNC "%6.3" "g" COEFFS 0 2949840.175137362 0. 0 0 1 /end COMPU_METHOD
/begin COMPU_METHOD _CNV_S_12_STATE_CP_R_304_CM "" TAB_VERB "%6.3" "-" COMPU_TAB_REF _CNV_S_12_STATE_CP_R_304 /end COMPU_METHOD
/begin COMPU_VTAB _CNV_S_12_STATE_CP_R_304 "" TAB_VERB 12 0 "CP_NOT_ACT" 1 "NO_PURGE" 2 "RAMP_TO_NO_PURGE" 3 "WAIT_RAMP_OPEN" 4 "MIN_PURGE" 5 "UNUSED" 6 "UNUSED" 7 "UNUSED" 8 "RAMP_OPEN" 9 "RAMP_OPEN_FAST" 10 "MAX_PURGE" 11 "RAMP_CLOSE" /end COMPU_VTAB
/begin COMPU_METHOD _CNV_A_R_LINEAR_____305_CM "" RAT_FUNC "%6.3" "Hz" COEFFS 0 1. 0. 0 0 1 /end COMPU_METHOD
/begin COMPU_METHOD _CNV_A_R_EVAC_LINEA_306_CM "" RAT_FUNC "%6.3" "%" COEFFS 0 1.277495107632094 -0.2504892367905995 0 0 1 /end COMPU_METHOD
/begin COMPU_METHOD _CNV_A_R_EVAC_LINEA_307_CM "" RAT_FUNC "%6.3" "%" COEFFS 0 2.56 128. 0 0 1 /end COMPU_METHOD
/begin COMPU_METHOD _CNV_A_R_LINEAR_____309_CM "" RAT_FUNC "%6.3" "hPa" COEFFS 0 12.06017666543982 -1.759293338545831e-002 0 0 1 /end COMPU_METHOD
/begin COMPU_METHOD _CNV_S_3_STATE_OPM__310_CM "" TAB_VERB "%6.3" "-" COMPU_TAB_REF _CNV_S_3_STATE_OPM__310 /end COMPU_METHOD
/begin COMPU_VTAB _CNV_S_3_STATE_OPM__310 "" TAB_VERB 3 0 "ENG_MODE_0" 1 "ENG_MODE_1" 2 "ENG_MODE_2" /end COMPU_VTAB
/begin COMPU_METHOD _CNV_A_R_LINEAR_____329_CM "" RAT_FUNC "%6.3" "g" COEFFS 0 22.49999999999997 0. 0 0 1 /end COMPU_METHOD
/begin COMPU_METHOD _CNV_A_R_LINEAR_____446_CM "" RAT_FUNC "%6.3" "m" COEFFS 0 1.e-002 0. 0 0 1 /end COMPU_METHOD
/begin COMPU_METHOD _CNV_S_9_RANGE_STAT_457_CM "" TAB_VERB "%6.3" "" COMPU_TAB_REF _CNV_S_9_RANGE_STAT_457 /end COMPU_METHOD
/begin COMPU_VTAB _CNV_S_9_RANGE_STAT_457 "" TAB_VERB 9 0 "CP_NOT_ACT" 1 "NO_PURGE" 2 "RAMP_TO_NO_PURGE" 3 "WAIT_RAMP_OPEN" 4 "MIN_PURGE" 8 "RAMP_OPEN" 9 "RAMP_OPEN_FAST" 10 "MAX_PURGE" 11 "RAMP_CLOSE" /end COMPU_VTAB
/begin COMPU_METHOD _CNV_A_R_CPULOAD__0_461_CM "" RAT_FUNC "%6.3" "%" COEFFS 0 10.24 0. 0 0 1 /end COMPU_METHOD
/begin COMPU_METHOD _CNV_S_8_RANGE_STAT_463_CM "" TAB_VERB "%6.3" "-" COMPU_TAB_REF _CNV_S_8_RANGE_STAT_463 /end COMPU_METHOD
/begin COMPU_VTAB _CNV_S_8_RANGE_STAT_463 "" TAB_VERB 8 0 "no" 1 "ASR" 2 "MSR" 3 "GS_DEC" 4 "GS_INC" 5 "AMT_DEC" 6 "AMT_INC" 7 "DCC" /end COMPU_VTAB
/begin COMPU_METHOD _CNV_A_R_LINEAR_____464_CM "" RAT_FUNC "%6.3" "Nm" COEFFS 0 10. 0. 0 0 1 /end COMPU_METHOD
/begin COMPU_METHOD _CNV_A_R_LINEAR_____482_CM "" RAT_FUNC "%6.3" "°CRK" COEFFS 0 42.66666666666666 0. 0 0 1 /end COMPU_METHOD
/begin COMPU_METHOD _CNV_A_R_LINEAR_____567_CM "" RAT_FUNC "%6.3" "°CRK" COEFFS 0 -2.666666666666667 -106.6666666666667 0 0 1 /end COMPU_METHOD
/begin COMPU_METHOD _CNV_A_R_LINEAR_____568_CM "" RAT_FUNC "%6.3" "°CRK" COEFFS 0 2.666666666666667 -160. 0 0 1 /end COMPU_METHOD
/begin RECORD_LAYOUT _REC_VAL_20_u1 FNC_VALUES 1 UBYTE COLUMN_DIR DIRECT /end RECORD_LAYOUT
/begin RECORD_LAYOUT _REC_VAL_20_u2 FNC_VALUES 1 UWORD COLUMN_DIR DIRECT /end RECORD_LAYOUT
/begin RECORD_LAYOUT _REC_AXS_20_u1 NO_AXIS_PTS_X 1 UBYTE AXIS_PTS_X 2 UBYTE INDEX_INCR DIRECT /end RECORD_LAYOUT
/begin RECORD_LAYOUT _REC_MAP_20_u2_u1_u1 FNC_VALUES 1 UWORD COLUMN_DIR DIRECT /end RECORD_LAYOUT
/begin RECORD_LAYOUT _REC_CUR_20_u1_u1 FNC_VALUES 1 UBYTE COLUMN_DIR DIRECT /end RECORD_LAYOUT
/begin RECORD_LAYOUT _REC_VAL_20_s2 FNC_VALUES 1 SWORD COLUMN_DIR DIRECT /end RECORD_LAYOUT
/begin RECORD_LAYOUT _REC_MAP_20_u2_u2_u1 FNC_VALUES 1 UWORD COLUMN_DIR DIRECT /end RECORD_LAYOUT
/begin RECORD_LAYOUT _REC_AXS_20_u2 NO_AXIS_PTS_X 1 UWORD AXIS_PTS_X 2 UWORD INDEX_INCR DIRECT /end RECORD_LAYOUT
/begin RECORD_LAYOUT _REC_CUR_20_u2_u2 FNC_VALUES 1 UWORD COLUMN_DIR DIRECT /end RECORD_LAYOUT
/begin RECORD_LAYOUT _REC_VAL_20_s1 FNC_VALUES 1 SBYTE COLUMN_DIR DIRECT /end RECORD_LAYOUT
/begin RECORD_LAYOUT _REC_MAP_20_u2_u1_u2 FNC_VALUES 1 UWORD COLUMN_DIR DIRECT /end RECORD_LAYOUT
/begin RECORD_LAYOUT _REC_CUR_20_u1_u2 FNC_VALUES 1 UBYTE COLUMN_DIR DIRECT /end RECORD_LAYOUT
/begin RECORD_LAYOUT _REC_MAP_20_u2_u2_u2 FNC_VALUES 1 UWORD COLUMN_DIR DIRECT /end RECORD_LAYOUT
/begin RECORD_LAYOUT _REC_MAP_20_u1_u2_u2 FNC_VALUES 1 UBYTE COLUMN_DIR DIRECT /end RECORD_LAYOUT
/begin RECORD_LAYOUT _REC_MAP_20_u1_u1_u1 FNC_VALUES 1 UBYTE COLUMN_DIR DIRECT /end RECORD_LAYOUT
/begin FUNCTION TQM_Torque_request_for_AMT_intervention "_Torque request for AMT intervention"
 /begin DEF_CHARACTERISTIC c_lgrd_lih_amt_dec c_lgrd_lih_amt_inc c_t_dly_lih_amt_dec c_t_dly_lih_amt_inc c_amt_ena_inc_dec c_tq_amt_fast_inh_fcut c_tq_amt_slow_inh_fcut /end DEF_CHARACTERISTIC
 /begin OUT_MEASUREMENT lv_amt_disable lv_amt_disable_can lv_amt_ena_dec lv_amt_ena_inc lv_amt_ena tqi_amt_fast_dec_req tqi_amt_fast_dec_req_1 tqi_amt_slow_dec_req tqi_amt_slow_dec_req_1 tqi_amt_fast_inc_req tqi_amt_fast_inc_req_1 tqi_amt_slow_inc_req tqi_amt_slow_inc_req_1 tqi_amt_fast_dec tqi_amt_slow_dec lv_amt_dec_act tqi_amt_fast_inc tqi_amt_slow_inc lv_amt_dec_lih lv_amt_inc_act lv_amt_inc_lih state_tq_amt_plaus t_amt_inc_lih_ctr t_amt_dec_lih_ctr lv_inh_fcut_amt /end OUT_MEASUREMENT
/end FUNCTION
/begin FUNCTION TQM_Minimum_indicated_engine_torque_at_trailing_throttle "_Minimum indicated engine torque at trailing throttle" /begin DEF_CHARACTERISTIC c_tqi_bol_set_hys /end DEF_CHARACTERISTIC /begin OUT_MEASUREMENT lv_tqi_bol_set tqi_bol /end OUT_MEASUREMENT /end FUNCTION
/begin FUNCTION TQM_Torque_Request_for_Traction_Control_TCS "_Torque Request for Traction Control TCS"
 /begin DEF_CHARACTERISTIC c_lgrd_lih_asr c_t_dly_lih_asr c_t_dly_lih_msr lc_msr_disable c_lgrd_lih_msr c_tq_max_msr lc_asr_disable /end DEF_CHARACTERISTIC
 /begin OUT_MEASUREMENT lv_asr_plaus lv_msr_plaus lv_asr_ena lv_msr_ena tqi_msr_fast_req tqi_msr_slow_req sf_tqd lv_tcs_disable tqi_asr_slow tqi_asr_fast_req tqi_asr_fast_req_1 tqi_asr_slow_req tqi_msr_fast_req_1 tqi_asr_slow_req_1 tqi_msr_slow_req_1 tqi_asr_fast tqi_msr_fast tqi_msr_slow lv_msr_lih lv_msr_act lv_asr_act lv_tcs_ena lv_tcs_disable_can lv_asr_lih t_asr_lih_ctr t_msr_lih_ctr state_tq_tcs_plaus /end OUT_MEASUREMENT
/end FUNCTION
/begin FUNCTION TQM_Torque_Loss___Anti_Roll_Stabilisation "_Torque Loss - Anti-Roll-Stabilisation"
 /begin DEF_CHARACTERISTIC ip_tq_loss_ars_sp_max ip_tq_loss_ars_av_max ip_tq_loss_ars_sp_can_max ip_tq_loss_ars_av_can_max c_fac_tq_loss_ars_grd c_fac_tq_loss_ars_dif c_t_dly_tq_max_ars c_tq_loss_ars_sp_ofs c_tq_loss_ars_av_ofs c_v_max_ars_diag c_n_max_ars_diag c_tq_loss_ars_ad c_t_ars_dly_ad /end DEF_CHARACTERISTIC
 /begin OUT_MEASUREMENT lv_ars_disable lv_ars_disable_can lv_ars_ena lv_tq_max_ars tq_loss_ars_sp_max tq_loss_ars_sp_max_1 tq_loss_ars_av_max_1 t_dly_tq_max_ars tq_loss_ars tq_loss_ars_av_max tq_loss_ars_grd tq_loss_ars_dif state_tq_ars_plaus lv_tq_loss_ars_is_ad_inh /end OUT_MEASUREMENT
/end FUNCTION
/begin FUNCTION TQM_TQ_Based_CH_For_Desulf "_TQ_Based_CH_For_Desulf" /end FUNCTION
/begin FUNCTION TQM_Torque_Request_for_LDM "_Torque Request for LDM" /begin DEF_CHARACTERISTIC c_lgrd_lih_ldm c_t_dly_lih_ldm c_state_di_puc_act /end DEF_CHARACTERISTIC
 /begin OUT_MEASUREMENT lv_ldm_disable_can state_tq_ldm_plaus tq_wheel_ldm_req tq_sp_wheel lv_ldm_ena lv_ldm_act lv_ldm_lih t_ldm_lih_ctr lv_ldm_puc_inh /end OUT_MEASUREMENT
/end FUNCTION
/begin FUNCTION TQM_General_Flag_for_inhibition_of_external_torque_request "_General Flag for inhibition of external torque request" /begin OUT_MEASUREMENT lv_tqi_req_can_inh /end OUT_MEASUREMENT /end FUNCTION
/begin FUNCTION AGGR_TQSP_adaption ""
 /begin OUT_MEASUREMENT load_thd_fl maf_sp_tqi tq_req_clu tqi_sp tqi_ems tq_add_max tqi_add_max tqi_add_max_tol maf_add_max eff_iga_min_add_max tqi_fast tqi_req_fast tqi_req_fast_dtm tqi_req_fast_dtm_can tqi_req_fast_sel tqi_req_slow_dtm tqi_req_slow_sel tqi_req_tra_fast tqi_sp_can tqi_req_slow state_tq_intv_fast state_tq_intv_slow tq_req_ipm /end OUT_MEASUREMENT
/end FUNCTION
/begin FUNCTION AGGR_IGSP_adaption ""
 /begin OUT_MEASUREMENT iga_av_h_rng_s[0] iga_av_h_rng_s[1] iga_av_h_rng_s[2] iga_av_h_rng_s[3] iga_av_h_rng_s[4] iga_av_h_rng_s[5] iga_igc_s[0] iga_igc_s[1] iga_igc_s[2] iga_igc_s[3] iga_igc_s[4] iga_igc_s[5] fac_iga_opm_sel lv_iga_st_opm_sel iga_add_cmb_ctl[0] iga_add_cmb_ctl[1] iga_add_cmb_ctl[2] iga_add_cmb_ctl[3] iga_add_cmb_ctl[4] iga_add_cmb_ctl[5] iga_av_h_rng_s_1[0] iga_av_h_rng_s_1[1] iga_av_h_rng_s_1[2] iga_av_h_rng_s_1[3] iga_av_h_rng_s_1[4] iga_av_h_rng_s_1[5] iga_ref_lamb_cor iga_ref_temp_cor iga_av_h_rng_homs[0] iga_av_h_rng_homs[1] iga_av_h_rng_homs[2] iga_av_h_rng_homs[3] iga_av_h_rng_homs[4] iga_av_h_rng_homs[5] iga_bas_cor iga_bas_cor_1 iga_bas_cor_2 iga_ref_cor iga_ref_cor_1 iga_ref_cor_2 /end OUT_MEASUREMENT
/end FUNCTION
/begin FUNCTION AGGR_PWSL_adaption "" /begin OUT_MEASUREMENT lv_vb_cdn_obd_1 lv_vb_cdn_obd_2 /end OUT_MEASUREMENT /end FUNCTION
/begin FUNCTION AGGR_VVTI_adaption ""
 /begin DEF_CHARACTERISTIC lc_not_adj_cam_ivvt_ex[0] lc_not_adj_cam_ivvt_in[0] c_cam_ini_in c_cam_ini_ex /end DEF_CHARACTERISTIC
 /begin OUT_MEASUREMENT lv_di_ad_ref_cam_ivvt[0] lv_di_ad_ref_cam_ivvt[1] cam_ex[0] cam_in[0] lv_cam_lock_ivvt_in[0] lv_cam_lock_ivvt_ex[0] cam_sp_ivvt_in cam_sp_ivvt_ex cam_sp_ref_in cam_sp_ref_ex cam_raw_ex[0] cam_raw_in[0] cam_ex_park[0] cam_in_park[0] /end OUT_MEASUREMENT
/end FUNCTION
/begin FUNCTION AGGR_LACO_adaption "" /begin DEF_CHARACTERISTIC c_mff_ref lc_fac_lam_ad_out_bal_man /end DEF_CHARACTERISTIC
 /begin OUT_MEASUREMENT lam_bank_1.lam_up.bf.lv_lscl lam_bank_1.lam_up.bf.lv_lam_cor_lim_intr lam_bank_1.lam_up.ti_lam_cor lam_bank_1.lam_up.ti_lam_fac lam_bank_1.lam_up.lamb_dif lam_bank_1.lam_ad.mff_ad_fac_mmv_rel lam_bank_1.lam_ad.mff_ad_add_mmv_rel_quo lam_bank_1.lam_ad.mff_ad_add_mmv_rel lam_bank_1.lam_dly.lam_mv lam_bank_1.lam_dly.lam_mv_lpf_cp lam_bank_1.lam_dly.lamb_sp_fil lam_bank_1.lam_dly.lamb_sp_fil_s_cp lam_bank_1.lam_dly.delta_lamb_i_ad_h_res lam_bank_1.lam_dly.delta_lamb_i_h_res lam_bank_1.lam_dly.bf.lv_delta_lamb lam_bank_1.lam_dly.vls_dif_dly lam_bank_2.lam_up.bf.lv_lscl lam_bank_2.lam_up.bf.lv_lam_cor_lim_intr lam_bank_2.lam_up.ti_lam_cor lam_bank_2.lam_up.ti_lam_fac lam_bank_2.lam_up.lamb_dif lam_bank_2.lam_ad.mff_ad_fac_mmv_rel lam_bank_2.lam_ad.mff_ad_add_mmv_rel_quo lam_bank_2.lam_ad.mff_ad_add_mmv_rel lam_bank_2.lam_dly.lam_mv lam_bank_2.lam_dly.lam_mv_lpf_cp lam_bank_2.lam_dly.lamb_sp_fil lam_bank_2.lam_dly.lamb_sp_fil_s_cp lam_bank_2.lam_dly.delta_lamb_i_ad_h_res lam_bank_2.lam_dly.delta_lamb_i_h_res lam_bank_2.lam_dly.bf.lv_delta_lamb lam_bank_2.lam_dly.vls_dif_dly lv_mff_ad_end lv_mff_ad_cdn vls_cyl[0] vls_cyl[1] vls_cyl[2] vls_cyl[3] vls_cyl[4] vls_cyl[5] vls_cyl_trig[0] vls_cyl_trig[1] vls_cyl_trig[2] vls_cyl_trig[3] vls_cyl_trig[4] vls_cyl_trig[5] fac_ad_lam_bal[0] fac_ad_lam_bal[1] mff_add_ad_lam_bal[0] mff_add_ad_lam_bal[1] fac_lam_mv /end OUT_MEASUREMENT
/end FUNCTION
/begin FUNCTION AGGR_EGCP_adaption ""
 /begin OUT_MEASUREMENT lam_bank_1.lam_up.lamb lam_bank_1.ls_act_chk_pl.bf.lv_req_lamb_sp_ls_act_test lam_bank_1.ls_act_chk_pl.bf.lv_temp_dew_ls_up lam_bank_1.ls_act_chk_pl.bf.lv_temp_dew_ls_down lam_bank_1.ls_act_chk_pl.bf.lv_inh_win_det_delta_i_lam lam_bank_1.ls_act_chk_pl.lamb_sp_beg_ls_act_test lam_bank_1.ls_act_chk_pl.lamb_sp_ls_act_test lam_bank_1.ls_act_chk_pl.teg_dyn_ls_up lam_bank_1.ls_act_chk_pl.teg_dyn_ls_down lam_bank_1.ls_ready.bf.lv_up_ls lam_bank_1.lam_sti_afl.ctr_vls_afl_cyc lam_bank_1.ls_down.vls_down lam_bank_1.ls_down_rdy.bf.lv_down_ls lam_bank_1.lsh_down.state_lsh_down lam_bank_1.lsh_up.state_lsh_up lam_bank_2.lam_up.lamb lam_bank_2.ls_act_chk_pl.bf.lv_req_lamb_sp_ls_act_test lam_bank_2.ls_act_chk_pl.bf.lv_temp_dew_ls_up lam_bank_2.ls_act_chk_pl.bf.lv_temp_dew_ls_down lam_bank_2.ls_act_chk_pl.bf.lv_inh_win_det_delta_i_lam lam_bank_2.ls_act_chk_pl.lamb_sp_beg_ls_act_test lam_bank_2.ls_act_chk_pl.lamb_sp_ls_act_test lam_bank_2.ls_act_chk_pl.teg_dyn_ls_up lam_bank_2.ls_act_chk_pl.teg_dyn_ls_down lam_bank_2.ls_ready.bf.lv_up_ls lam_bank_2.lam_sti_afl.ctr_vls_afl_cyc lam_bank_2.ls_down.vls_down lam_bank_2.ls_down_rdy.bf.lv_down_ls lam_bank_2.lsh_down.state_lsh_down lam_bank_2.lsh_up.state_lsh_up lamb_min lv_lamb_puls_dyn_diag lv_err_ls_up_dyn_vld_1 lv_err_ls_up_dyn_vld_2 lamb_mv lv_lsl_ofs_puls_1 lv_lsl_ofs_puls_2 vls_down_min_dc[0] vls_down_min_dc[1] vls_down_max_dc[0] vls_down_max_dc[1] /end OUT_MEASUREMENT
/end FUNCTION
/begin FUNCTION AGGR_AFMO_adaption "" /begin OUT_MEASUREMENT lv_lam_lim_lam_ad_1 lv_lam_lim_lam_ad_2 /end OUT_MEASUREMENT /end FUNCTION
/begin FUNCTION AGGR_DRVB_adaptation "" /begin OUT_MEASUREMENT tqi_req_tra lv_act_aj /end OUT_MEASUREMENT /end FUNCTION
/begin FUNCTION AGGR_EGRC_adaption "" /end FUNCTION
/begin FUNCTION AGGR_ENTE_adaptation ""
 /begin OUT_MEASUREMENT lv_lih_coc_on n_rel_cwp_sp lv_temp_eng_warn_1 lv_temp_eng_warn_2 ectpwm_clc n_perc_ecf tco_ex ecfpwm_ecf tco_ex_mes v_tco_ex lv_err_tco_ex lv_err_ect_mec /end OUT_MEASUREMENT
/end FUNCTION
/begin FUNCTION AGGR_EVAM_adaptation "" /begin DEF_CHARACTERISTIC c_t_dly_purge_diagcps /end DEF_CHARACTERISTIC
 /begin OUT_MEASUREMENT lv_tldv_req lv_fac_lam_diagcp lv_diagcp_cps_act lv_err_mec_open_cps flow_sp_cps_evap cl_mmv_norm_purge_end lv_cp_new_ramp_open_mem lv_cl_mmv lv_err_el_sov lv_err_mec_close_sov lv_err_cps lv_cl_calc_avl state_cp_mem_ad /end OUT_MEASUREMENT
/end FUNCTION
/begin FUNCTION AGGR_FUSL_adaptation ""
 /begin OUT_MEASUREMENT fup_sp_ext lv_fup_sp_ext_req fup_h_sp_s_ext efppwm_can vff_efp /end OUT_MEASUREMENT
/end FUNCTION
/begin FUNCTION AGGR_DRRQ_adaption "" /begin OUT_MEASUREMENT pv /end OUT_MEASUREMENT /end FUNCTION
/begin FUNCTION AGGR_INSY_adaption "" /begin OUT_MEASUREMENT amp_mdl amp amp_ad maf_int_pue maf_int_puc /end OUT_MEASUREMENT /end FUNCTION
/begin FUNCTION AGGR_CYBL_adaption ""
 /begin OUT_MEASUREMENT ti_add[0] ti_add[1] ti_add[2] ti_add[3] ti_add[4] ti_add[5] ti_fac[0] ti_fac[1] ti_fac[2] ti_fac[3] ti_fac[4] ti_fac[5] /end OUT_MEASUREMENT
/end FUNCTION
/begin FUNCTION AGGR_INJR_adaptation "" /begin OUT_MEASUREMENT inh_iv_cst /end OUT_MEASUREMENT /end FUNCTION
/begin FUNCTION C_0_RST "C_0_RST" /begin SUB_FUNCTION RST_Warm_reset_data /end SUB_FUNCTION /end FUNCTION
/begin FUNCTION RST_Warm_reset_data "_Warm reset data" /begin DEF_CHARACTERISTIC lc_warm_rst_ena /end DEF_CHARACTERISTIC
 /begin OUT_MEASUREMENT lv_warm_rst lv_rst_det rst_det rst_ctr rst_info.rst_lprc_reset_address rst_info.rst_sw_status rst_info.rst_hw_status lv_err_warm_rst cpu_load_max_rst_det n_max_rst_det cpu_load_rst_det n_rst_det dist_rst_det /end OUT_MEASUREMENT
/end FUNCTION
/begin FUNCTION AGGR_EGTR_adaption ""
 /begin OUT_MEASUREMENT delta_lamb_sp_o2l_mdl[0] delta_lamb_sp_o2l_mdl[1] cat_diag_mod_6[0] cat_diag_mod_6[1] lamb_puls_so2p[0] lamb_puls_so2p[1] lv_lam_adj_rng_vld_cat_diag_1 lv_lam_adj_rng_vld_cat_diag_2 /end OUT_MEASUREMENT
/end FUNCTION
/begin FUNCTION C_9_EVAC "C_9_EVAC"
 /begin DEF_CHARACTERISTIC ldpm_n_32_2_evac ldpm_maf_2_evac ldpm_n_32_1_evac ldpm_amp_1_evac ldpm_n_32_3_evac ldpm_vb_1_evac ldpm_prs_cps_1_evac ldpm_map_1_evac ldpm_tia_1_evac ldpm_tqi_sp_s_2_evac ldpm_maf_cyl_1_evac ldp_n_32_id_flow_inc_nr_cp ldpm_maf_kgh_cor_ip_t_dly_cp ldpm_tqi_sp_s_ip_ratio_fuel_max ldp_cl_mdl_slop_0_ip_cl_slop ldp_cl_mdl_slop_int_ip_cl_value /end DEF_CHARACTERISTIC
 /begin SUB_FUNCTION EVAC_Time_control_lambda_CP EVAC_emission_control EVAC_Injection_calculation EVAC_CP_valve_control EVAC_emission_control_A_I EVAC_Flow_setpoints EVAC_lambda_CL_calculation EVAC_Canister_Load_Model EVAC_CP_valve_adaptation /end SUB_FUNCTION
/end FUNCTION
/begin FUNCTION EVAC_Time_control_lambda_CP "Time_control_lambda_adaptation_CP"
 /begin DEF_CHARACTERISTIC c_cl_mmv_t_bol c_cl_mmv_t_tol ldp_cl_mmv_ip_t_max_cp c_state_man_sdl_cp lc_mff_ad_ena_pas lc_cp_ena_wait_lam lc_cl_cp_dyn_end_ena lc_lam_lim_ad_ena lc_sdl_lam_ad_cdn_off c_t_2_cp c_t_di_cp c_t_mff_ad_max id_t_lam_ad_thd[0] id_t_lam_ad_thd[1] id_t_lam_ad_thd[2] id_t_lam_ad_thd[3] id_dur_lam_ad[0] id_dur_lam_ad[1] id_dur_lam_ad[2] id_dur_lam_ad[3] ip_t_max_cp c_t_sdl_ext_req c_cl_mmv_t_wait_lam c_tco_dyn_t_ctl /end DEF_CHARACTERISTIC
 /begin OUT_MEASUREMENT state_t_sdl_cp t_cp lv_cp_ena t_ad t_max_ad lv_lam_ad_ena ctr_lam_ad_sdl_cp /end OUT_MEASUREMENT
/end FUNCTION
/begin FUNCTION EVAC_emission_control "Evaporative_emission_control"
 /begin DEF_CHARACTERISTIC c_t_dly_cp_purge_tube c_t_di_max_cp lc_lam_lin_cps c_flow_cps_as c_flow_cps_sp_purge_tube c_flow_cps_grd_purge_tube c_t_di_ramp_open_cp c_t_di_ramp_fast_cp c_maf_dly_crlc_cp c_flow_dly_crlc_cp c_fac_dec_cor_cmu_cp c_fac_dec_cor_1_cp c_fac_dec_cor_2_cp lc_pq_sp_cp_hom_afl lc_cp_tran_open_max_ena lc_flow_cps_as lc_cp_tran_deac_cll lc_cp_tra_min_ramp_open_dis lc_cp_tra_min_purge_dft_ena lc_cp_tra_opl_cdn_not lc_cp_tra_opl_cdn_cll_not c_state_mod_sel_cp c_t_dly_max_cp c_crlc_pq_sp_cp lc_cp_tra_max_min_cdn_ena lc_cp_flow_lim_open_fast ldp_cl_ip_flow_fac ip_flow_inc_cp ip_flow_fac_cp ip_flow_inc_fast_cp ip_flow_dec_cp id_flow_inc_nr_cp c_cl_mmv_pq ip_fac_amp_cp ip_fac_tia_cp ip_flow_cps_dec ip_flow_cps_inc c_cl_mmv_req c_cl_cat_diag c_t_lock_cp c_t_dly_req_cp ip_pq_cp_sp c_t_dly_cp c_t_dly_cl_mdl c_t_start_purge_tube c_flow_cps_grd_purge_tube_close ip_t_dly_cp ip_t_dly_cp_2 ip_flow_max_open_cps ip_flow_max_open_cps_2 c_flow_ini_cps c_mff_max_cps_di /end DEF_CHARACTERISTIC
 /begin OUT_MEASUREMENT lv_cp_ramp_open_act lv_cl_clc_vld flow_ctl_cps flow_tar_cps flow_open_cps lv_t_dly_req_cp t_dly_max_cp state_cll_deac_cp state_lock_cp lv_cp_cdn_ramp_open lv_cp_cdn_ramp_open_fast lv_cl_clc_avl lv_cp_act_req lv_state_mem_cp_cll t_dly_cp_open t_di_cp lv_cp_cll lv_dly_gas_cp pq_cp_sp cl_mmv_clc_end t_lock_cp flow_grd_cps flow_ctl_cps_di state_cp t_dly_cp t_dly_cl_mdl /end OUT_MEASUREMENT
/end FUNCTION
/begin FUNCTION EVAC_Injection_calculation "Evaporative_emission_flow_calculation"
 /begin DEF_CHARACTERISTIC ldp_tia_thr_ip_fac_tia_cp ip_crlc_mff_buf_cp ip_mff_dly_cp lc_flow_cps_cal ip_maf_kgh_pred_cor_map_tia ip_maf_kgh_pred_cor_map_tia_2 lc_maf_cor_act_cp ldpm_maf_cyl_1_evac_mff_dly_cp ldpm_maf_kgh_clc_ip_idx_step_cp ip_mff_dly_cp_2 ip_idx_step_cp ip_idx_step_cp_2 /end DEF_CHARACTERISTIC
 /begin OUT_MEASUREMENT flow_sp_cps flow_cor_cps flow_cps flow_dly_cp flow_dly_mmv_cp flow_dly_old_2_cp flow_cps_old_1 flow_cps_old_2 fac_tia_amp_cp flow_fac_cp maf_cps maf_cp maf_dly_mmv_cp maf_cp_old_1 maf_cp_old_2 maf_dly_old_2_cp maf_dly_cp flow_tot_cps tqi_add_cp mff_cps mff_buf_cp mff_tot_cp mff_add_buf[0] mff_add_buf[1] mff_add_buf[2] mff_add_buf[3] mff_add_buf[4] mff_add_buf[5] mff_add_buf[6] mff_add_buf[7] mff_add_buf[8] mff_add_buf[9] mff_add_buf[10] mff_add_buf[11] mff_add_buf[12] mff_add_buf[13] mff_add_buf[14] mff_add_buf[15] mff_add_buf[16] mff_add_buf[17] mff_add_buf[18] mff_add_buf[19] mff_add_buf[20] mff_add_buf[21] mff_add_buf[22] mff_add_buf[23] mff_add_buf[24] mff_add_buf[25] mff_add_buf[26] mff_add_buf[27] mff_add_buf[28] mff_add_buf[29] mff_add_buf[30] mff_add_buf[31] mff_add_buf[32] mff_add_buf[33] mff_add_buf[34] mff_add_buf[35] mff_add_buf[36] mff_add_buf[37] mff_add_buf[38] mff_add_buf[39] mff_add_buf[40] mff_add_buf[41] mff_add_buf[42] mff_add_buf[43] mff_add_buf[44] mff_add_buf[45] mff_add_buf[46] mff_add_buf[47] mff_add_buf[48] mff_add_buf[49] mff_add_buf[50] mff_add_buf[51] mff_add_buf[52] mff_add_buf[53] mff_add_buf[54] mff_add_buf[55] mff_add_buf[56] mff_add_buf[57] mff_add_buf[58] mff_add_buf[59] mff_add_buf[60] mff_add_buf[61] mff_add_buf[62] mff_add_buf[63] mff_add_buf[64] mff_add_buf[65] mff_add_buf[66] mff_add_buf[67] mff_add_buf[68] mff_add_buf[69] mff_add_buf[70] mff_add_buf[71] mff_add_buf[72] mff_add_buf[73] mff_add_buf[74] mff_add_buf[75] mff_add_buf[76] mff_add_buf[77] mff_add_buf[78] mff_add_buf[79] buf_inp_cp buf_out_cp maf_kgh_fg_pred_cor_cp mff_add_lam_cp /end OUT_MEASUREMENT
/end FUNCTION
/begin FUNCTION EVAC_CP_valve_control "Canister_purge_valve_control"
 /begin DEF_CHARACTERISTIC c_n_frq_1_cps c_n_frq_2_cps c_n_frq_hys_cps c_cppwm_frq_1_cps c_cppwm_frq_2_cps c_cppwm_frq_hys_cps lc_cppwm_lim_diag lc_cppwm_as c_cppwm_max_frq_1_lim_cp c_cppwm_max_frq_2_lim_cp c_cppwm_min_frq_1_lim_cp c_cppwm_min_frq_2_lim_cp ldp_cppwm_ip_cppwm_cor_frq ip_cppwm_cor_frq ldp_flow_cor_cps_ip_cppwm c_cppwm_frq_1 c_cppwm_frq_2 c_cppwm_as ip_cppwm_vb_add_1 ip_cppwm_vb_add_2 ip_cppwm ip_cppwm_vb_fac ldp_prs_cps_ip_cppwm_vb_fac ip_cppwm_vb_fac_prs_cps /end DEF_CHARACTERISTIC
 /begin OUT_MEASUREMENT cppwm_cps lv_frq_1_cps cppwm lv_cp_close_act frq_req_cp /end OUT_MEASUREMENT
/end FUNCTION
/begin FUNCTION EVAC_emission_control_A_I "Evaporative_emission_control_A_I"
 /begin DEF_CHARACTERISTIC ldpm_maf_ip_rel_flow_max_cps ip_fac_rel_flow_cps_wout_cat id_state_opm_eng_cp c_t_dly_cp_lamb_ch c_t_dly_cp_opm_eng /end DEF_CHARACTERISTIC
 /begin OUT_MEASUREMENT lv_inh_cp_cll lv_cp_dyw_ext lv_inh_lam_ad_sdl lv_cp_close_1 lv_cp_close_2 lv_cp_close_3 lv_inh_cp lv_inh_cp_fast lv_inh_cp_sdl lv_t_sdl_ext_req lv_cps_ad_inh prs_cps_ext t_dly_cp_opm_av fac_flow_cor_cp_ext fac_flow_cor_cp_min_purge state_opm_eng_cp /end OUT_MEASUREMENT
/end FUNCTION
/begin FUNCTION EVAC_Flow_setpoints ""
 /begin DEF_CHARACTERISTIC ldp_cl_mmv_ip_fac_flow_min ip_fac_flow_sp_min_purge c_cl_max_min_purge c_fac_flow_sp_min_purge_max c_mff_min_cp lc_fac_flow_sp_min_purge ip_ratio_fuel_max_cp_cor ip_flow_cps ldp_tco_ip_ratio_fuel_max_cp ip_flow_max_cps ip_flow_cps_eng_mod_0 ip_flow_cps_eng_mod_1 ip_flow_cps_eng_mod_2 ip_ratio_fuel_max_cp_mod_0 ip_ratio_fuel_max_cp_mod_1 ip_ratio_fuel_max_cp_mod_2 /end DEF_CHARACTERISTIC
 /begin OUT_MEASUREMENT flow_max_cps mff_kgh_max_cp ratio_fuel_sp_max_purge mff_max_cp fac_flow_sp_min_purge flow_cps_sp_min_purge flow_max_phy_cps /end OUT_MEASUREMENT
/end FUNCTION
/end MODULE
/end PROJECT
