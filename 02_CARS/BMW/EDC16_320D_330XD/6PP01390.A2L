ASAP2_VERSION 1 3
/begin PROJECT P390 "BMW DDE6.2 6-Zylinder VP0.1 11.11.2003 CAN12H"
/begin HEADER "" VERSION "VP01_6Z_CAN12H" PROJECT_NO P390 /end HEADER
/begin MODULE DIM ""
/begin MOD_COMMON "" BYTE_ORDER MSB_FIRST ALIGNMENT_BYTE 1 ALIGNMENT_WORD 2 ALIGNMENT_LONG 4 ALIGNMENT_FLOAT32_IEEE 4 /end MOD_COMMON
/begin CHARACTERISTIC EBAFCD_DebExcTempDef_C "Defect time for EXC_TEMP error" VALUE 0xCC9F4 Kw_Wu16 655350.0 Time_ms 0.00 655350.0 FORMAT "%8.1" /end CHARACTERISTIC
/begin CHARACTERISTIC EBAFCD_DebExcTempOk_C "Healing time for EXC_TEMP error" VALUE 0xCC9F6 Kw_Wu16 655350.0 Time_ms 0.00 655350.0 FORMAT "%8.1" /end CHARACTERISTIC
/begin CHARACTERISTIC EBAFCD_DebNoLoadDef_C "Defect time for NO_LOAD error" VALUE 0xCC9F8 Kw_Wu16 655350.0 Time_ms 0.00 655350.0 FORMAT "%8.1" /end CHARACTERISTIC
/begin CHARACTERISTIC EBAFCD_DebNoLoadOk_C "Healing time for NO_LOAD error" VALUE 0xCC9FA Kw_Wu16 655350.0 Time_ms 0.00 655350.0 FORMAT "%8.1" /end CHARACTERISTIC
/begin CHARACTERISTIC EBAFCD_DebShortCircBatDef_C "Defect time for SHORT_CIRC_BAT error" VALUE 0xCC9FC Kw_Wu16 655350.0 Time_ms 0.00 655350.0 FORMAT "%8.1" /end CHARACTERISTIC
/begin CHARACTERISTIC EBAFCD_DebShortCircBatOk_C "Healing time for SHORT_CIRC_BAT error" VALUE 0xCC9FE Kw_Wu16 655350.0 Time_ms 0.00 655350.0 FORMAT "%8.1" /end CHARACTERISTIC
/begin CHARACTERISTIC EBAFCD_DebShortCircGndDef_C "Defect time for SHORT_CIRC_GND error" VALUE 0xCCA00 Kw_Wu16 655350.0 Time_ms 0.00 655350.0 FORMAT "%8.1" /end CHARACTERISTIC
/begin CHARACTERISTIC EBAFCD_DebShortCircGndOk_C "Healing time for SHORT_CIRC_GND error" VALUE 0xCCA02 Kw_Wu16 655350.0 Time_ms 0.00 655350.0 FORMAT "%8.1" /end CHARACTERISTIC
/begin CHARACTERISTIC EBAFCD_InvSigOut_C "status word for (non)/inverting output EBAFCD_stSigOut" VALUE 0xCCA04 Kw_Wu8 255.0 OneToOne 0.00 255.0 FORMAT "%5.1" /end CHARACTERISTIC
/begin CHARACTERISTIC EBAFCD_nFan_C "minimum rpm of fan to disable outout" VALUE 0xCCA06 Kw_Ws16 6000.092 FanSpd -3000.092 3000.000 FORMAT "%8.3" /end CHARACTERISTIC
/begin CHARACTERISTIC EBAFCD_numDiaOut_C "#SSD Request of test of power stage from tester" VALUE 0xCCA08 Kw_Wu8 34.0000000000 NumPinDia 0.00 34.0000000000 FORMAT "%13.10" /end CHARACTERISTIC
/begin CHARACTERISTIC EBAFCD_numDioOut_C "#SSD Selection of power stage" VALUE 0xCCA09 Kw_Wu8 10.0000000000 NumPinDioOut 0.00 10.0000000000 FORMAT "%13.10" /end CHARACTERISTIC
/begin CHARACTERISTIC EBAFCD_tClntTrMin_C "threshold low engine protection pressure hysteresis" VALUE 0xCCA0A Kw_Ws16 950.000 Temp_Cels -50.140 899.860 FORMAT "%8.3" EXTENDED_LIMITS -3549.940 3003.560 /end CHARACTERISTIC
/begin CHARACTERISTIC EBAFCD_tClntTrMax_C "threshold high engine protection pressure hysteresis" VALUE 0xCCA0C Kw_Ws16 950.000 Temp_Cels -50.140 899.860 FORMAT "%8.3" EXTENDED_LIMITS -3549.940 3003.560 /end CHARACTERISTIC
/begin CHARACTERISTIC EBAFCD_sttClntTrOff_C "engine protection off" VALUE 0xCCA0E Kw_Ws16 65535.00 OneToOne -32768.00 32767.00 FORMAT "%8.2" READ_ONLY /end CHARACTERISTIC
/begin CHARACTERISTIC EBAFCD_sttClntTrOn_C "engine protection on" VALUE 0xCCA10 Kw_Ws16 65535.00 OneToOne -32768.00 32767.00 FORMAT "%8.2" READ_ONLY /end CHARACTERISTIC
/begin CHARACTERISTIC EBAFCD_tClntMin_C "threshold low engine protection pressure hysteresis" VALUE 0xCCA12 Kw_Ws16 950.000 Temp_Cels -50.140 899.860 FORMAT "%8.3" EXTENDED_LIMITS -3549.940 3003.560 /end CHARACTERISTIC
/begin CHARACTERISTIC EBAFCD_tClntMax_C "threshold high engine protection pressure hysteresis" VALUE 0xCCA14 Kw_Ws16 950.000 Temp_Cels -50.140 899.860 FORMAT "%8.3" EXTENDED_LIMITS -3549.940 3003.560 /end CHARACTERISTIC
/begin CHARACTERISTIC EBAFCD_sttClntOff_C "engine protection off" VALUE 0xCCA16 Kw_Ws16 65535.00 OneToOne -32768.00 32767.00 FORMAT "%8.2" READ_ONLY /end CHARACTERISTIC
/begin CHARACTERISTIC EBAFCD_sttClntOn_C "engine protection on" VALUE 0xCCA18 Kw_Ws16 65535.00 OneToOne -32768.00 32767.00 FORMAT "%8.2" READ_ONLY /end CHARACTERISTIC
/begin CHARACTERISTIC EBFCD_DebExcTempDef_C "time for final defect of excess temperature defect" VALUE 0xCCA1A Kw_Wu16 655350.0 Time_ms 0.00 655350.0 FORMAT "%8.1" /end CHARACTERISTIC
/begin CHARACTERISTIC EBFCD_DebExcTempOk_C "time for healing of excess temperature defect" VALUE 0xCCA1C Kw_Wu16 655350.0 Time_ms 0.00 655350.0 FORMAT "%8.1" /end CHARACTERISTIC
/begin CHARACTERISTIC EBFCD_DebNoLoadDef_C "time for final defect of no load" VALUE 0xCCA1E Kw_Wu16 655350.0 Time_ms 0.00 655350.0 FORMAT "%8.1" /end CHARACTERISTIC
/begin CHARACTERISTIC EBFCD_DebNoLoadOk_C "time for healing of no load defect" VALUE 0xCCA20 Kw_Wu16 655350.0 Time_ms 0.00 655350.0 FORMAT "%8.1" /end CHARACTERISTIC
/begin CHARACTERISTIC EBFCD_DebShortCircBatDef_C "time for final defect for short circuit to battery" VALUE 0xCCA22 Kw_Wu16 655350.0 Time_ms 0.00 655350.0 FORMAT "%8.1" /end CHARACTERISTIC
/begin CHARACTERISTIC EBFCD_DebShortCircBatOk_C "time for healing of short circuit to battery" VALUE 0xCCA24 Kw_Wu16 655350.0 Time_ms 0.00 655350.0 FORMAT "%8.1" /end CHARACTERISTIC
/begin CHARACTERISTIC EBFCD_DebShortCircGndDef_C "time for final defect of short circuit to ground" VALUE 0xCCA26 Kw_Wu16 655350.0 Time_ms 0.00 655350.0 FORMAT "%8.1" /end CHARACTERISTIC
/begin CHARACTERISTIC EBFCD_DebShortCircGndOk_C "time for final defect of short circuit to ground" VALUE 0xCCA28 Kw_Wu16 655350.0 Time_ms 0.00 655350.0 FORMAT "%8.1" /end CHARACTERISTIC
/begin CHARACTERISTIC EBFCD_numDiaOut_C "#SSD application parameter for EBFCD diagnostic signal" VALUE 0xCCA2A Kw_Wu8 34.0000000000 NumPinDia 0.00 34.0000000000 FORMAT "%13.10" /end CHARACTERISTIC
/begin CHARACTERISTIC EBFCD_numDioOut_C "#SSD application parameter for fan output signal" VALUE 0xCCA2B Kw_Wu8 10.0000000000 NumPinDioOut 0.00 10.0000000000 FORMAT "%13.10" /end CHARACTERISTIC
/begin CHARACTERISTIC EBFCD_stDigInvOut_C "Digital output signal invert information" VALUE 0xCCA2C Kw_Wu8 1.000 OneToOne 0.00 1.000 FORMAT "%5.3" EXTENDED_LIMITS 0.00 255.0 /end CHARACTERISTIC
/begin CHARACTERISTIC EBFCD_stSigOutErr_C "Default value if error occurs" VALUE 0xCCA2D Kw_Wu8 1.000 OneToOne 0.00 1.000 FORMAT "%5.3" EXTENDED_LIMITS 0.00 255.0 /end CHARACTERISTIC
/begin CHARACTERISTIC EBFCD_swtOnOff_C "Switch for switching the functionality ON/OFF" VALUE 0xCCA2E Kw_Wu8 1.000 OneToOne 0.00 1.000 FORMAT "%5.3" EXTENDED_LIMITS 0.00 255.0 /end CHARACTERISTIC
/begin CHARACTERISTIC EBFCD_tECUXLow_C "Minimum value for the input of the hysteresis" VALUE 0xCCA30 Kw_Ws16 250.0000 Temp_Cels -50.1400 199.8600 FORMAT "%8.4" EXTENDED_LIMITS -3549.940 3003.560 /end CHARACTERISTIC
/begin CHARACTERISTIC EBFCD_tECUXHigh_C "Maximum value for the input of the hysteresis" VALUE 0xCCA32 Kw_Ws16 250.0000 Temp_Cels -50.1400 199.8600 FORMAT "%8.4" EXTENDED_LIMITS -3549.940 3003.560 /end CHARACTERISTIC
/begin CHARACTERISTIC EBFCD_stECUYLow_C "Minimum value for the output of the hysteresis" VALUE 0xCCA34 Kw_Ws16 1.000000 OneToOne 0.00 1.000000 FORMAT "%8.6" EXTENDED_LIMITS -32768.00 32767.00 /end CHARACTERISTIC
/begin CHARACTERISTIC EBFCD_stECUYHigh_C "Maximum value for the output of the hysteresis" VALUE 0xCCA36 Kw_Ws16 1.000000 OneToOne 0.00 1.000000 FORMAT "%8.6" EXTENDED_LIMITS -32768.00 32767.00 /end CHARACTERISTIC
/begin CHARACTERISTIC EBTSCD_uSRCMin_C "#SSD min. value of SRC" VALUE 0xCCA38 Kw_Ws16 5200.391 Volt 0.00 5200.391 FORMAT "%8.3" EXTENDED_LIMITS -160156.4 160151.5 /end CHARACTERISTIC
/begin CHARACTERISTIC EBTSCD_uSRCMax_C "#SSD max. value of SRC" VALUE 0xCCA3A Kw_Ws16 5200.391 Volt 0.00 5200.391 FORMAT "%8.3" EXTENDED_LIMITS -160156.4 160151.5 /end CHARACTERISTIC
/begin CHARACTERISTIC EBTSCD_tLin_CUR "#SSD curve for linearisation in EBTSCD" CURVE 0xCCA3C Kl_Xs16_Ws16 250.0000 Temp_Cels -50.14000 199.8600 FORMAT "%8.4" EXTENDED_LIMITS -3549.940 3003.560
 /begin AXIS_DESCR STD_AXIS EBTSCD_uRawTECU_mp Volt 5 0.00 5200.391 FORMAT "%8.3" EXTENDED_LIMITS -160156.4 160151.5 DEPOSIT ABSOLUTE /end AXIS_DESCR
/end CHARACTERISTIC
/begin CHARACTERISTIC EBTSCD_OvrDebSRCHighDef_C "#SSD Error debounce time for Over temperature error" VALUE 0xCCA52 Kw_Wu16 655350.0 Time_ms 0.00 655350.0 FORMAT "%8.1" /end CHARACTERISTIC
/begin CHARACTERISTIC EBTSCD_OvrDebSRCHighOk_C "Healing debounce time for over temperature  error" VALUE 0xCCA54 Kw_Wu16 655350.0 Time_ms 0.00 655350.0 FORMAT "%8.1" /end CHARACTERISTIC
/begin CHARACTERISTIC EBTSCD_DebSRCHighDef_C "#SSD Error debounce time for SRC-High error" VALUE 0xCCA56 Kw_Wu16 655350.0 Time_ms 0.00 655350.0 FORMAT "%8.1" /end CHARACTERISTIC
/begin CHARACTERISTIC EBTSCD_DebSRCHighOk_C "Healing debounce time for SRC-High error" VALUE 0xCCA58 Kw_Wu16 655350.0 Time_ms 0.00 655350.0 FORMAT "%8.1" /end CHARACTERISTIC
/begin CHARACTERISTIC EBTSCD_DebSRCLowDef_C "#SSD Error debounce time for SRC-Low error" VALUE 0xCCA5A Kw_Wu16 655350.0 Time_ms 0.00 655350.0 FORMAT "%8.1" /end CHARACTERISTIC
/begin CHARACTERISTIC EBTSCD_DebSRCLowOk_C "Healing debounce time for SRC-Low error" VALUE 0xCCA5C Kw_Wu16 655350.0 Time_ms 0.00 655350.0 FORMAT "%8.1" /end CHARACTERISTIC
/begin CHARACTERISTIC EBTSCD_numAdc_C "#SSD application parameter for ECU temperature" VALUE 0xCCA5E Kw_Wu8 44.0000000000 NumPinAdc 0.00 44.0000000000 FORMAT "%13.10" /end CHARACTERISTIC
/begin CHARACTERISTIC EBTSCD_dtRmpSlpUp_C "#SSD ramp slope up" VALUE 0xCCA60 Kw_Wu32 6553598.99749 RmpTemp 1.00097656250 6553599.99847 FORMAT "%13.5" EXTENDED_LIMITS 0.00 6553599.99847 /end CHARACTERISTIC
/begin CHARACTERISTIC EBTSCD_dtRmpSlpDwn_C "#SSD ramp slope down" VALUE 0xCCA64 Kw_Wu32 6553598.99749 RmpTemp 1.00097656250 6553599.99847 FORMAT "%13.5" EXTENDED_LIMITS 0.00 6553599.99847 /end CHARACTERISTIC
/begin CHARACTERISTIC EBTSCD_tiTECUPT1_C "#SSD Time constant of PT1 delay element" VALUE 0xCCA68 Kw_Wu32 4294.9663 TimeDelay_s 0.0010000001 4294.9673 FORMAT "%9.4" EXTENDED_LIMITS 0.0000010000000 4294.9673 /end CHARACTERISTIC
/begin CHARACTERISTIC EBTSCD_tOvrTemp_C "#SSD over temperature threshold" VALUE 0xCCA6C Kw_Ws16 250.0000 Temp_Cels -50.1400 199.8600 FORMAT "%8.4" EXTENDED_LIMITS -3549.940 3003.560 /end CHARACTERISTIC
/begin CHARACTERISTIC EBTSCD_stSensIDWord_C "#SSD ID-Word for transition stage" VALUE 0xCCA6E Kw_Wu16 65535.00 OneToOne 0.00 65535.00 FORMAT "%8.2" /end CHARACTERISTIC
/begin CHARACTERISTIC EBTSCD_tDfl_C "#SSD default value if error occurs" VALUE 0xCCA70 Kw_Ws16 250.0000 Temp_Cels -50.14000 199.8600 FORMAT "%8.4" EXTENDED_LIMITS -3549.940 3003.560 /end CHARACTERISTIC
/begin CHARACTERISTIC ECU_vPrgThres_C "#SSD obere Geschwindigkeitsgrenze für die FLASH Programmierung" VALUE 0xCCA74 Kw_Ws16 327.6700 Vel 0.00 327.6700 FORMAT "%8.4" EXTENDED_LIMITS -327.6800 327.6700 /end CHARACTERISTIC
/begin CHARACTERISTIC EEPCD_stMILDfl_C "Vorgabezewert fr MIL von EEPCD defekt" VALUE 0xCCA76 Kw_Wu8 1.000 OneToOne 0.00 1.000 FORMAT "%5.3" EXTENDED_LIMITS 0.00 255.0 /end CHARACTERISTIC
/begin CHARACTERISTIC EepInit_AirCtlTrm_C "Trimmwert Sollwertbildung AGR" VALUE 0xCCA78 Kw_Ws16 3276.700 AirMassPerCyl 0.00 3276.700 FORMAT "%8.3" EXTENDED_LIMITS -3276.800 3276.700 /end CHARACTERISTIC
/begin CHARACTERISTIC EGPpCD_numDia_C "#SSD Application parameter for Exhaust gas pressure pump actuator diagnostic signal" VALUE 0xCCB9C Kw_Wu8 34.0000000000 NumPinDia 0.00 34.0000000000 FORMAT "%13.10" /end CHARACTERISTIC
/begin CHARACTERISTIC EGPpCD_numDioOut_C "#SSD Application parameter for Exhaust gas pressure pump actuator output pin" VALUE 0xCCB9D Kw_Wu8 10.0000000000 NumPinDioOut 0.00 10.0000000000 FORMAT "%13.10" /end CHARACTERISTIC
/begin CHARACTERISTIC EGPpCD_stInvOut_C "Digital output invert information for Exhaust gas pressure pump actuator" VALUE 0xCCB9E Kw_Wu8 1.000 OneToOne 0.00 1.000 FORMAT "%5.3" EXTENDED_LIMITS 0.00 255.0 /end CHARACTERISTIC
/begin CHARACTERISTIC EGPpCD_stPwrStgActv_C "Status word for deactivation of the powerstage diagnostics" VALUE 0xCCB9F Kw_Wu8 255.0 OneToOne 0.00 255.0 FORMAT "%5.1" /end CHARACTERISTIC
/begin CHARACTERISTIC EGPpCD_tiDebExcTempDef_C "Debounce duration for excess temperature error detection" VALUE 0xCCBA0 Kw_Wu16 655350.0 Time_ms 0.00 655350.0 FORMAT "%8.1" /end CHARACTERISTIC
/begin CHARACTERISTIC EGPpCD_tiDebExcTempOk_C "Debounce duration for excess temperature error healing" VALUE 0xCCBA2 Kw_Wu16 655350.0 Time_ms 0.00 655350.0 FORMAT "%8.1" /end CHARACTERISTIC
/begin CHARACTERISTIC EGPpCD_tiDebNoLoadDef_C "Debounce duration for no load error detection" VALUE 0xCCBA4 Kw_Wu16 655350.0 Time_ms 0.00 655350.0 FORMAT "%8.1" /end CHARACTERISTIC
/begin CHARACTERISTIC EGPpCD_tiDebNoLoadOk_C "Debounce duration for no load error healing" VALUE 0xCCBA6 Kw_Wu16 655350.0 Time_ms 0.00 655350.0 FORMAT "%8.1" /end CHARACTERISTIC
/begin CHARACTERISTIC EGPpCD_tiDebShortCircBatDef_C "Debounce duration for short circuit to battery error detection" VALUE 0xCCBA8 Kw_Wu16 655350.0 Time_ms 0.00 655350.0 FORMAT "%8.1" /end CHARACTERISTIC
/begin CHARACTERISTIC EGPpCD_tiDebShortCircBatOk_C "Debounce duration for short circuit to battery error healing" VALUE 0xCCBAA Kw_Wu16 655350.0 Time_ms 0.00 655350.0 FORMAT "%8.1" /end CHARACTERISTIC
/begin CHARACTERISTIC EGPpCD_tiDebShortCircGndDef_C "Debounce duration for short circuit to ground error detection" VALUE 0xCCBAC Kw_Wu16 655350.0 Time_ms 0.00 655350.0 FORMAT "%8.1" /end CHARACTERISTIC
/begin CHARACTERISTIC EGPpCD_tiDebShortCircGndOk_C "Debounce duration for short circuit to ground error healing" VALUE 0xCCBAE Kw_Wu16 655350.0 Time_ms 0.00 655350.0 FORMAT "%8.1" /end CHARACTERISTIC
/begin CHARACTERISTIC EGPp_facGeoSil2_C "Geometric factor silencer" VALUE 0xCCA98 Kw_Ws16 100.0000 Fact1 0.00 100.0000 FORMAT "%8.4" EXTENDED_LIMITS -256.0000 255.9922 /end CHARACTERISTIC
/begin CHARACTERISTIC EGPp_facGeoSil_C "geometrischer Faktor Schalldämpfer" VALUE 0xCCA9A Kw_Ws16 100.0000 Fact1 0.00 100.0000 FORMAT "%8.4" EXTENDED_LIMITS -256.0000 255.9922 /end CHARACTERISTIC
/begin CHARACTERISTIC EGPp_facPow_CUR "Potenzfunktion für Abgasvolumenstrom" CURVE 0xCCA9C Kl_Xs16_Ws16 250.0000 Fact1 0.00 250.0000 FORMAT "%8.4" EXTENDED_LIMITS -256.0000 255.9922 READ_ONLY
 /begin AXIS_DESCR STD_AXIS EGPp_dvolSil_mp CubMtrPerHr 11 0.00 3200.000 FORMAT "%8.3" EXTENDED_LIMITS -3276.800 3276.700 DEPOSIT ABSOLUTE /end AXIS_DESCR
/end CHARACTERISTIC
/begin CHARACTERISTIC EGPp_facRhoEta_CUR "temperaturabhängiger Dichte- und Viskositätsfaktor" CURVE 0xCCACA Kl_Xs16_Ws16 4.000000 Fact 0.00 4.000000 FORMAT "%8.6" EXTENDED_LIMITS -4.000000 3.999878 READ_ONLY
 /begin AXIS_DESCR STD_AXIS PFlt_tPstSim Temp_Cels 9 -50.140 899.860 FORMAT "%8.3" EXTENDED_LIMITS -3549.940 3003.560 DEPOSIT ABSOLUTE /end AXIS_DESCR
/end CHARACTERISTIC
/begin CHARACTERISTIC EGPp_pPstPFlt_MAP "Druckabfallkennfeld" MAP 0xCCAF0 Kf_Xs16_Ys16_Ws16 3500.0000 Pres_hPa 0.00 3500.0000 FORMAT "%8.4" EXTENDED_LIMITS -32768.00 32767.00
 /begin AXIS_DESCR STD_AXIS Eng_nAvrg EngN 8 0.00 8000.000 FORMAT "%8.3" EXTENDED_LIMITS -32768.00 32767.00 DEPOSIT ABSOLUTE /end AXIS_DESCR
 /begin AXIS_DESCR STD_AXIS InjCtl_qSetUnBal InjMassCyc 8 0.00 200.0000 FORMAT "%8.4" EXTENDED_LIMITS -327.6800 327.6700 DEPOSIT ABSOLUTE /end AXIS_DESCR
/end CHARACTERISTIC
/begin CHARACTERISTIC EGPp_tiPresFltPT1_C "PT1 Filterzeit für die Druckmodellierung im Abgasrohr" VALUE 0xCCB94 Kw_Wu32 4294.9673 TimeDelay_s 0.0000010000000 4294.9673 FORMAT "%9.4" /end CHARACTERISTIC
/begin CHARACTERISTIC EGPp_stFlap_MAP "Exhaust Gas Pump status calculation map" MAP 0xCCA80 Kf_Xs16_Ys16_Ws16 1.000000 OneToOne 0.00 1.000000 FORMAT "%8.6" EXTENDED_LIMITS -32768.00 32767.00
 /begin AXIS_DESCR STD_AXIS Eng_nAvrg EngN 2 40.00000 6000.000 FORMAT "%8.3" EXTENDED_LIMITS -32768.00 32767.00 DEPOSIT ABSOLUTE /end AXIS_DESCR
 /begin AXIS_DESCR STD_AXIS InjCtl_qCurr InjMassCyc 2 0.00 200.0000 FORMAT "%8.4" EXTENDED_LIMITS -327.6800 327.6700 DEPOSIT ABSOLUTE /end AXIS_DESCR
/end CHARACTERISTIC
/begin CHARACTERISTIC EGPp_swtPresCalc_C "Schalter für Druckberechnung (0-Kennfeld, 1- Simulation)" VALUE 0xCCB98 Kw_Wu8 1.000 OneToOne 0.00 1.000 FORMAT "%5.3" EXTENDED_LIMITS 0.00 255.0 /end CHARACTERISTIC
/begin CHARACTERISTIC EGPp_tiStartDelay_C "Time threshold for engine start status" VALUE 0xCCA94 Kw_Ws16 9000.000 Time_ms 1000.000 10000.00 FORMAT "%8.2" EXTENDED_LIMITS -327680.0 327670.0 /end CHARACTERISTIC
/begin CHARACTERISTIC EGRCD_DebExcTempDef_C "#SSD Fehlerentprellzeit für Übertemperatur" VALUE 0xCCBB0 Kw_Wu16 655350.0 Time_ms 0.00 655350.0 FORMAT "%8.1" /end CHARACTERISTIC
/begin CHARACTERISTIC EGRCD_DebExcTempOk_C "Heilungsentprellzeit für Übertemperatur" VALUE 0xCCBB2 Kw_Wu16 655350.0 Time_ms 0.00 655350.0 FORMAT "%8.1" /end CHARACTERISTIC
/begin CHARACTERISTIC EGRCD_DebNoLoadDef_C "#SSD Fehlerentprellzeit für Lastabfall" VALUE 0xCCBB4 Kw_Wu16 655350.0 Time_ms 0.00 655350.0 FORMAT "%8.1" /end CHARACTERISTIC
/begin CHARACTERISTIC EGRCD_DebNoLoadOk_C "Heilungsentprellzeit für Lastabfall" VALUE 0xCCBB6 Kw_Wu16 655350.0 Time_ms 0.00 655350.0 FORMAT "%8.1" /end CHARACTERISTIC
/begin CHARACTERISTIC EGRCD_DebShortCircBatDef_C "#SSD Fehlerentprellzeit für Kurzschluß nach Batteriespannung" VALUE 0xCCBB8 Kw_Wu16 655350.0 Time_ms 0.00 655350.0 FORMAT "%8.1" /end CHARACTERISTIC
/begin CHARACTERISTIC EGRCD_DebShortCircBatOk_C "Heilungsentprellzeit für Kurzschluß nach Batteriespannung" VALUE 0xCCBBA Kw_Wu16 655350.0 Time_ms 0.00 655350.0 FORMAT "%8.1" /end CHARACTERISTIC
/begin CHARACTERISTIC EGRCD_DebShortCircGndDef_C "#SSD Fehlerentprellzeit für Kurzschluß nach Masse" VALUE 0xCCBBC Kw_Wu16 655350.0 Time_ms 0.00 655350.0 FORMAT "%8.1" /end CHARACTERISTIC
/begin CHARACTERISTIC EGRCD_DebShortCircGndOk_C "Heilungsentprellzeit für Kurzschluß nach Masse" VALUE 0xCCBBE Kw_Wu16 655350.0 Time_ms 0.00 655350.0 FORMAT "%8.1" /end CHARACTERISTIC
/begin CHARACTERISTIC EGRCD_numDia_C "#SSD Applikationsparameter fuer Diagnose Signal :EGR-Steller" VALUE 0xCCBC0 Kw_Wu8 34.0000000000 NumPinDia 0.00 34.0000000000 FORMAT "%13.10" /end CHARACTERISTIC
/begin CHARACTERISTIC EGRCD_numPwmOut_C "#SSD Applikationsparameter fuer EGR-Steller" VALUE 0xCCBC1 Kw_Wu8 12.0000000000 NumPinPwmOut 0.00 12.0000000000 FORMAT "%13.10" /end CHARACTERISTIC
/begin CHARACTERISTIC EGRCD_stInvOut_C "Invertierungsparameter für das Signal der Abgasrückführstellerendstufe" VALUE 0xCCBC2 Kw_Wu8 1.000 OneToOne 0.00 1.000 FORMAT "%5.3" EXTENDED_LIMITS 0.00 255.0 /end CHARACTERISTIC
/begin CHARACTERISTIC EGRCD_tiPer_C "Periodendauer Abgasrückführsteller" VALUE 0xCCBC4 Kw_Ws16 6553.500 Period -3276.800 3276.700 FORMAT "%8.3" /end CHARACTERISTIC
/begin CHARACTERISTIC EGRCD_rCnv_MAP "Kennfeld zur konvertierung in Tastverhältnis" MAP 0xCCBC6 Kf_Xs16_Ys16_Ws16 100.0000 DtyCyc 0.00 100.0000 FORMAT "%8.4" EXTENDED_LIMITS -327.6800 327.6700
 /begin AXIS_DESCR STD_AXIS Eng_nAvrg EngN 8 0.00 8000.000 FORMAT "%8.3" EXTENDED_LIMITS -32768.00 32767.00 DEPOSIT ABSOLUTE /end AXIS_DESCR
 /begin AXIS_DESCR STD_AXIS EGRVlv_rEGR Prc 8 -400.0000 399.9878 FORMAT "%8.4" DEPOSIT ABSOLUTE /end AXIS_DESCR
/end CHARACTERISTIC
/begin CHARACTERISTIC EGRCD_rOutMax_C "Maximal auszugebendes Tastverhältnis" VALUE 0xCCC6A Kw_Ws16 655.3500 DtyCyc -327.6800 327.6700 FORMAT "%8.4" /end CHARACTERISTIC
/begin CHARACTERISTIC EGRCD_rOutMin_C "Minimal auszugebendes Tastverhältnis" VALUE 0xCCC6C Kw_Ws16 655.3500 DtyCyc -327.6800 327.6700 FORMAT "%8.4" /end CHARACTERISTIC
/begin CHARACTERISTIC EGRCD_rTst_C "Tastverhältnis, dass im Fehlerfall zyklisch ausgegeben wird" VALUE 0xCCC6E Kw_Ws16 100.0000 DtyCyc 0.00 100.0000 FORMAT "%8.4" EXTENDED_LIMITS -327.6800 327.6700 /end CHARACTERISTIC
/begin CHARACTERISTIC EGRCD_stPwrStgActv_C "Aktivierung der Abschaltbedingungen der Endstufe" VALUE 0xCCC70 Kw_Wu8 255.0 OneToOne 0.00 255.0 FORMAT "%5.1" /end CHARACTERISTIC
/begin CHARACTERISTIC EGRCD_stPwrStgDia_C "#SSD Aktivierung der Abschaltbedingungen der Endstufendiagnose" VALUE 0xCCC71 Kw_Wu8 255.0 OneToOne 0.00 255.0 FORMAT "%5.1" /end CHARACTERISTIC
/begin CHARACTERISTIC EGRCD_swt_C "Schalter Batteriesspannungskorrektur (0 = AUS, 1 = EIN)" VALUE 0xCCC72 Kw_Wu8 255.0 OneToOne 0.00 255.0 FORMAT "%5.1" /end CHARACTERISTIC
/begin CHARACTERISTIC EGRCD_tiBtwTst_C "Zeitabstand, in dem im Fehlerfall die Endstufe getestet wird" VALUE 0xCCC74 Kw_Wu16 29980.00 Time_ms 20.00000 30000.00 FORMAT "%8.2" EXTENDED_LIMITS 0.00 655350.0 /end CHARACTERISTIC
/begin CHARACTERISTIC EGRVlv_rEGR2_Vector "#SSD Bypass-Label for exhaust gas recirculation coordinator2" VALUE 0xC2D4E Kw_Wu8 255.0 OneToOne 0.00 255.0 FORMAT "%5.1" /end CHARACTERISTIC
/begin CHARACTERISTIC EGRVlv_rEGR2_Channel "#SSD Bypass-Label for exhaust gas recirculation coordinator2" VALUE 0xC2D4F Kw_Wu8 255.0 OneToOne 0.00 255.0 FORMAT "%5.1" /end CHARACTERISTIC
/begin CHARACTERISTIC EGRVlv_rEGR_Vector "#SSD Bypass-Label für EGRVlv_rEGR" VALUE 0xC2D50 Kw_Wu8 255.0 OneToOne 0.00 255.0 FORMAT "%5.1" /end CHARACTERISTIC
/begin CHARACTERISTIC EGRVlv_rEGR_Channel "#SSD Bypass-Label für EGRVlv_rEGR" VALUE 0xC2D51 Kw_Wu8 255.0 OneToOne 0.00 255.0 FORMAT "%5.1" /end CHARACTERISTIC
/begin CHARACTERISTIC EGSys_AlpFreeCnvtTube_C "Wärmeübertragungskoeffizient am Abgasrohr aufgrund freier Konvektion" VAL_BLK 0xCD560 Kwb_Ws16 999.9000 ThermalCoEff 0.1000000 1000.000 FORMAT "%8.3" EXTENDED_LIMITS -3276.800 3276.700 NUMBER 2 /end CHARACTERISTIC
/begin CHARACTERISTIC EGSys_CalValFl_C "Unterer Heizwert Kraftstoff" VALUE 0xCD350 Kw_Wu16 65535.00 Calory 0.00 65535.00 FORMAT "%8.2" /end CHARACTERISTIC
/begin CHARACTERISTIC EGSys_cndHtEG_CUR "Wärmeleitfähigkeit Abgas (nicht applizierbar)" CURVE 0xCCE84 Kl_Xs16_Ws16 1.000000 Fact 0.00 1.000000 FORMAT "%8.6" EXTENDED_LIMITS -4.000000 3.999878 READ_ONLY
 /begin AXIS_DESCR STD_AXIS EGSys_tEGLSUInpCrv0_mp Temp_Cels 8 -50.140 899.860 FORMAT "%8.3" EXTENDED_LIMITS -3549.940 3003.560 DEPOSIT ABSOLUTE /end AXIS_DESCR
/end CHARACTERISTIC
/begin CHARACTERISTIC EGSys_cpChrg_C "Wärmekapazität Turbolader" VALUE 0xCD48C Kw_Ws16 3000.000 HeatCapacity 0.00 3000.000 FORMAT "%8.3" EXTENDED_LIMITS -3276.800 3276.700 /end CHARACTERISTIC
/begin CHARACTERISTIC EGSys_cpEG_MAP "Wärmekapazität Abgas (nicht applizierbar)" MAP 0xCCEA6 Kf_Xs16_Ys16_Ws16 2.000000 SpecificHeat 0.00 2.000000 FORMAT "%8.6" EXTENDED_LIMITS -3.276800 3.276700 READ_ONLY
 /begin AXIS_DESCR STD_AXIS EGSys_tEGLSUInpCrv0_mp Temp_Cels 6 -50.140 899.860 FORMAT "%8.3" EXTENDED_LIMITS -3549.940 3003.560 DEPOSIT ABSOLUTE /end AXIS_DESCR
 /begin AXIS_DESCR STD_AXIS EGSys_rLmbdAprx lambda 6 -30.00000 30.00000 FORMAT "%8.5" EXTENDED_LIMITS -32.76800 32.76700 DEPOSIT ABSOLUTE /end AXIS_DESCR
/end CHARACTERISTIC
/begin CHARACTERISTIC EGSys_cpNSC_C "Wärmekapazität NSC" VALUE 0xCD2A0 Kw_Ws16 2999.900 HeatCapacity 0.1000000 3000.000 FORMAT "%8.3" EXTENDED_LIMITS -3276.800 3276.700 /end CHARACTERISTIC
/begin CHARACTERISTIC EGSys_cpOxiCat_C "Wärmekapazität Oxidationskatalysator" VALUE 0xCD352 Kw_Ws16 2999.900 HeatCapacity 0.1000000 3000.000 FORMAT "%8.3" EXTENDED_LIMITS -3276.800 3276.700 /end CHARACTERISTIC
/begin CHARACTERISTIC EGSys_cpTube_C "Wärmekapazität Abgasrohr" VAL_BLK 0xCD564 Kwb_Ws16 2999.900 HeatCapacity 0.1000000 3000.000 FORMAT "%8.3" EXTENDED_LIMITS -3276.800 3276.700 NUMBER 2 /end CHARACTERISTIC
/begin CHARACTERISTIC EGSys_dmAir_MAP "Kennfeld zur Ermittlung Luftmassenstrom im Auslegungspunkt (zur Temperaturkorrektur)" MAP 0xCCF60 Kf_Xs16_Ys16_Ws16 1000.000 AirMassPerTime 0.00 1000.000 FORMAT "%8.3" EXTENDED_LIMITS -3276.800 3276.700
 /begin AXIS_DESCR STD_AXIS Eng_nAvrg EngN 8 0.00 8000.000 FORMAT "%8.3" EXTENDED_LIMITS -32768.00 32767.00 DEPOSIT ABSOLUTE /end AXIS_DESCR
 /begin AXIS_DESCR STD_AXIS InjCtl_qCurr InjMassCyc 8 0.00 100.0000 FORMAT "%8.4" EXTENDED_LIMITS -327.6800 327.6700 DEPOSIT ABSOLUTE /end AXIS_DESCR
/end CHARACTERISTIC
/begin CHARACTERISTIC EGSys_dmEGMinVal_C "Kleinstwert Abgasmassenstrom für thermische Modellierung" VALUE 0xCCF0A Kw_Ws16 1000.000 AirMassPerTime 0.00 1000.000 FORMAT "%8.3" EXTENDED_LIMITS -3276.800 3276.700 /end CHARACTERISTIC
/begin CHARACTERISTIC EGSys_dmPlsThresLSU_C "Minimaler Massenstrom für gültigen Gasstoß" VAL_BLK 0xCCC78 Kwb_Ws16 1000.000 AirMassPerTime 0.00 1000.000 FORMAT "%8.3" EXTENDED_LIMITS -3276.800 3276.700 NUMBER 1 /end CHARACTERISTIC
/begin CHARACTERISTIC EGSys_dpExhGas_MAP "Kennfeld für Abgasgegendruck" MAP 0xCCD8C Kf_Xs16_Ys16_Ws16 65535.00 Pres_hPa -32768.00 32767.00 FORMAT "%8.2"
 /begin AXIS_DESCR STD_AXIS Eng_nAvrg EngN 10 -32768.00 32767.00 FORMAT "%8.2" DEPOSIT ABSOLUTE /end AXIS_DESCR
 /begin AXIS_DESCR STD_AXIS InjCtl_qSetUnBal InjMassCyc 10 -327.6800 327.6700 FORMAT "%8.4" DEPOSIT ABSOLUTE /end AXIS_DESCR
/end CHARACTERISTIC
/begin CHARACTERISTIC EGSys_etaChrg_MAP "Kennfeld Gesamtwirkungsgrad Turbolader" MAP 0xCD48E Kf_Xs16_Ys16_Ws16 0.9998779 Fact 0.0001220703 1.000000 FORMAT "%8.6" EXTENDED_LIMITS -4.000000 3.999878
 /begin AXIS_DESCR STD_AXIS AFSCD_dmAirPerTime AirMassPerTime 8 0.00 1000.000 FORMAT "%8.3" EXTENDED_LIMITS -3276.800 3276.700 DEPOSIT ABSOLUTE /end AXIS_DESCR
 /begin AXIS_DESCR STD_AXIS EGSys_rPresCmpr_mp Fact 8 0.00 8.000000 FORMAT "%8.6" EXTENDED_LIMITS -4.000000 3.999878 DEPOSIT ABSOLUTE /end AXIS_DESCR
/end CHARACTERISTIC
/begin CHARACTERISTIC EGSys_facAirMass_CUR "Kennlinie zur Luftmassenabhängigen Temperaturkorrektur" CURVE 0xCD004 Kl_Xs16_Ws16 2.000000 Fact 0.00 2.000000 FORMAT "%8.6" EXTENDED_LIMITS -4.000000 3.999878
 /begin AXIS_DESCR STD_AXIS EGSys_rAirPerTime_mp Fact 8 0.00 8.000000 FORMAT "%8.6" EXTENDED_LIMITS -4.000000 3.999878 DEPOSIT ABSOLUTE /end AXIS_DESCR
/end CHARACTERISTIC
/begin CHARACTERISTIC EGSys_facCldStrtLSU_C "Faktor für Schwellwerterhöhung bei wiederholtem Kaltstart" VAL_BLK 0xCCC7A Kwb_Ws16 1.000000 Fact 0.00 1.000000 FORMAT "%8.6" EXTENDED_LIMITS -4.000000 3.999878 NUMBER 1 /end CHARACTERISTIC
/begin CHARACTERISTIC EGSys_facCorrCldEng_CUR "Kennlinie zur Abgastemperatur-Korrektur beim kaltem Motor" CURVE 0xCD026 Kl_Xs16_Ws16 2.000000 Fact 0.00 2.000000 FORMAT "%8.6" EXTENDED_LIMITS -4.000000 3.999878
 /begin AXIS_DESCR STD_AXIS EGSys_tDiffCldEng_mp TempDiff_Cels 8 -3276.800 3276.700 FORMAT "%8.3" DEPOSIT ABSOLUTE /end AXIS_DESCR
/end CHARACTERISTIC
/begin CHARACTERISTIC EGSys_facIAT_CUR "Kennlinie zur ansauglufttemperaturabhängigen Korrektur der Abgastemperatur" CURVE 0xCD048 Kl_Xs16_Ws16 2.000000 Fact 0.00 2.000000 FORMAT "%8.6" EXTENDED_LIMITS -4.000000 3.999878
 /begin AXIS_DESCR STD_AXIS EGSys_tDiffIAT_mp TempDiff_Cels 8 -3276.800 3276.700 FORMAT "%8.3" DEPOSIT ABSOLUTE /end AXIS_DESCR
/end CHARACTERISTIC
/begin CHARACTERISTIC EGSys_facPlsLSU_C "Faktor für Abnahme der Wärmeschwelle bei gültigem Gasstoß" VAL_BLK 0xCCC7C Kwb_Ws16 1.000000 Fact 0.00 1.000000 FORMAT "%8.6" EXTENDED_LIMITS -4.000000 3.999878 NUMBER 1 /end CHARACTERISTIC
/begin CHARACTERISTIC EGSys_facPlsThresLSU_C "minimaler Wärmemengenschwellwert zur Aktivierung der Gasstoß-Erkennung" VAL_BLK 0xCCC7E Kwb_Ws16 1.000000 Fact 0.00 1.000000 FORMAT "%8.6" EXTENDED_LIMITS -4.000000 3.999878 NUMBER 1 /end CHARACTERISTIC
/begin CHARACTERISTIC EGSys_facStrtDlv_CUR "Kennlinie zur Förderbeginnabhängigen Temperaturkorrektur" CURVE 0xCD06A Kl_Xs16_Ws16 2.000000 Fact 0.00 2.000000 FORMAT "%8.6" EXTENDED_LIMITS -4.000000 3.999878
 /begin AXIS_DESCR STD_AXIS EGSys_phiDiffStrt_mp AngleCrS 8 -49.99219 49.99219 FORMAT "%8.5" EXTENDED_LIMITS -768.0000 767.9766 DEPOSIT ABSOLUTE /end AXIS_DESCR
/end CHARACTERISTIC
/begin CHARACTERISTIC EGSys_facTempClg_CUR "Abkühlkennlinie abgasführende Bauteile" CURVE 0xCD424 Kl_Xs16_Ws16 2.000000 Fact 0.00 2.000000 FORMAT "%8.6" EXTENDED_LIMITS -4.000000 3.999878
 /begin AXIS_DESCR STD_AXIS EGSys_rTimeTrb_mp Fact1 8 0.00 8.000000 FORMAT "%8.6" EXTENDED_LIMITS -256.0000 255.9922 DEPOSIT ABSOLUTE /end AXIS_DESCR
/end CHARACTERISTIC
/begin CHARACTERISTIC EGSys_facTempCmb_CUR "Temperaturabhängiger Faktor zur Korrektur der im Oxidationskatalysator abreagierenden Kraftstoffmasse" CURVE 0xCD354 Kl_Xs16_Ws16 2.000000 Fact 0.00 2.000000 FORMAT "%8.6" EXTENDED_LIMITS -4.000000 3.999878
 /begin AXIS_DESCR STD_AXIS EGSys_tAvrgOxiCat_mp Temp_Cels 8 -50.140 899.860 FORMAT "%8.3" EXTENDED_LIMITS -3549.940 3003.560 DEPOSIT ABSOLUTE /end AXIS_DESCR
/end CHARACTERISTIC
/begin CHARACTERISTIC EGSys_facTimeClg_CUR "inverse Abkühlkennlinie Motor" CURVE 0xCD446 Kl_Xs16_Ws16 255.0000 Fact1 0.00 255.0000 FORMAT "%8.4" EXTENDED_LIMITS -256.0000 255.9922
 /begin AXIS_DESCR STD_AXIS EGSys_rTempClnt_mp Fact 8 0.00 3.900024 FORMAT "%8.6" EXTENDED_LIMITS -4.000000 3.999878 DEPOSIT ABSOLUTE /end AXIS_DESCR
/end CHARACTERISTIC
/begin CHARACTERISTIC EGSys_lDiamTube_C "Durchmesser Abgasrohr" VAL_BLK 0xCD568 Kwb_Ws16 99.99219 Length1 0.007812500 100.0000 FORMAT "%8.4" EXTENDED_LIMITS -256.0000 255.9922 NUMBER 2 /end CHARACTERISTIC
/begin CHARACTERISTIC EGSys_lLngthTube_C "Länge Abgasrohr" VAL_BLK 0xCD56C Kwb_Ws16 99.99219 Length1 0.007812500 100.0000 FORMAT "%8.4" EXTENDED_LIMITS -256.0000 255.9922 NUMBER 2 /end CHARACTERISTIC
/begin CHARACTERISTIC EGSys_tiPT1NSC_C "Feste thermische Zeitkonstante zur NSC-Modellierung" VALUE 0xCD2A4 Kw_Wu32 4294.9663 TimeDelay_s 0.0010000001 4294.9673 FORMAT "%9.4" EXTENDED_LIMITS 0.0000010000000 4294.9673 /end CHARACTERISTIC
/begin CHARACTERISTIC EGSys_numECU_C "Anzahl der Steuergeräte" VALUE 0xCCF0C Kw_Wu8 254.0 OneToOne 1.000 255.0 FORMAT "%5.1" EXTENDED_LIMITS 0.00 255.0 /end CHARACTERISTIC
/begin CHARACTERISTIC EGSys_numMaxCldStrt_C "Maximale Anzahl der zu zählenden Kaltstarts" VAL_BLK 0xCCC80 Kwb_Wu8 10.00 OneToOne 0.00 10.00 FORMAT "%5.2" EXTENDED_LIMITS 0.00 255.0 NUMBER 1 /end CHARACTERISTIC
/begin CHARACTERISTIC EGSys_numRdPosLSU2_C "Leseindex im Temperaturarray für Abgastemperatur(en) am Sensoreinbauort (im Fehlerfall)" VAL_BLK 0xCCF0D Kwb_Wu8 12.00 OneToOne 0.00 12.00 FORMAT "%5.2" EXTENDED_LIMITS 0.00 255.0 NUMBER 1 /end CHARACTERISTIC
/begin CHARACTERISTIC EGSys_numRdPosLSUWall_C "Leseindex der Rohrwandtemperatur im Temperaturarray" VAL_BLK 0xCCF0E Kwb_Wu8 14.00 OneToOne 0.00 14.00 FORMAT "%5.2" EXTENDED_LIMITS 0.00 255.0 NUMBER 1 /end CHARACTERISTIC
/begin CHARACTERISTIC EGSys_numRdPosLSU_C "Leseindex im Temperaturarray für Abgastemperatur(en) am Sensoreinbauort" VAL_BLK 0xCCF0F Kwb_Wu8 12.00 OneToOne 0.00 12.00 FORMAT "%5.2" EXTENDED_LIMITS 0.00 255.0 NUMBER 1 /end CHARACTERISTIC
/begin CHARACTERISTIC EGSys_numRdPosNSC2_C "Leseindex im Temperaturarray für NSC Einlaßtemperatur (im Fehlerfall)" VALUE 0xCCF10 Kw_Wu8 12.00 OneToOne 0.00 12.00 FORMAT "%5.2" EXTENDED_LIMITS 0.00 255.0 /end CHARACTERISTIC
/begin CHARACTERISTIC EGSys_numRdPosNSC_C "Leseindex im Temperaturarray für NSC Einlaßtemperatur" VALUE 0xCCF11 Kw_Wu8 12.00 OneToOne 0.00 12.00 FORMAT "%5.2" EXTENDED_LIMITS 0.00 255.0 /end CHARACTERISTIC
/begin CHARACTERISTIC EGSys_numRdPosOxiCat2_C "Leseindex im Temperaturarray für Oxydations-Katalysator-Einlaßtemperatur (im Fehlerfall)" VALUE 0xCCF12 Kw_Wu8 12.00 OneToOne 0.00 12.00 FORMAT "%5.2" EXTENDED_LIMITS 0.00 255.0 /end CHARACTERISTIC
/begin CHARACTERISTIC EGSys_numRdPosOxiCat_C "Leseindex im Temperaturarray für Oxydations-Katalysator-Einlaßtemperatur" VALUE 0xCCF13 Kw_Wu8 12.00 OneToOne 0.00 12.00 FORMAT "%5.2" EXTENDED_LIMITS 0.00 255.0 /end CHARACTERISTIC
/begin CHARACTERISTIC EGSys_numRdPosTrbn2_C "Leseindex im Temperaturarray für Turbineneinlaßtemperatur (im Fehlerfall)" VALUE 0xCCF14 Kw_Wu8 12.00 OneToOne 0.00 12.00 FORMAT "%5.2" EXTENDED_LIMITS 0.00 255.0 /end CHARACTERISTIC
/begin CHARACTERISTIC EGSys_numRdPosTrbn_C "Leseindex im Temperaturarray für Turbineneinlaßtemperatur" VALUE 0xCCF15 Kw_Wu8 12.00 OneToOne 0.00 12.00 FORMAT "%5.2" EXTENDED_LIMITS 0.00 255.0 /end CHARACTERISTIC
/begin CHARACTERISTIC EGSys_numRdPosTube2_C "Leseindex im Temperaturarray für Rohr-Einlaßtemperaturen (im Fehlerfall)" VAL_BLK 0xCCF16 Kwb_Wu8 12.00 OneToOne 0.00 12.00 FORMAT "%5.2" EXTENDED_LIMITS 0.00 255.0 NUMBER 2 /end CHARACTERISTIC
/begin CHARACTERISTIC EGSys_numRdPosTube_C "Leseindex im Temperaturarray für Rohr-Einlaßtemperaturen" VAL_BLK 0xCCF18 Kwb_Wu8 12.00 OneToOne 0.00 12.00 FORMAT "%5.2" EXTENDED_LIMITS 0.00 255.0 NUMBER 2 /end CHARACTERISTIC
/begin CHARACTERISTIC EGSys_NuTubeEnv_CUR "Nusselt-Zahl Abgasrohr-Aussenumströmung (nicht applizierbar)" CURVE 0xCD570 Kl_Xs16_Ws16 5309.000 OneToOne 0.00 5309.000 FORMAT "%8.3" EXTENDED_LIMITS -32768.00 32767.00 READ_ONLY
 /begin AXIS_DESCR STD_AXIS EGSys_ReTubeEnvInpCrv_mp OneToOne 8 0.00 3750.000 FORMAT "%8.3" EXTENDED_LIMITS -32768.00 32767.00 DEPOSIT ABSOLUTE /end AXIS_DESCR
/end CHARACTERISTIC
/begin CHARACTERISTIC EGSys_NuTube_CUR "Nusselt-Zahl für Abgasrohrdurchströmung (nicht applizierbar)" CURVE 0xCD592 Kl_Xs16_Ws16 1130.000 OneToOne 0.00 1130.000 FORMAT "%8.3" EXTENDED_LIMITS -32768.00 32767.00 READ_ONLY
 /begin AXIS_DESCR STD_AXIS EGSys_ReTubeInpCrv_mp ReynoldsNum 8 0.00 800000.0 FORMAT "%8.1" EXTENDED_LIMITS -3276800. 3276700. DEPOSIT ABSOLUTE /end AXIS_DESCR
/end CHARACTERISTIC
/begin CHARACTERISTIC EGSys_tiPT1OxiCat_C "Feste thermische Zeitkonstante zur Oxidationskatalysator-Modellierung" VALUE 0xCD378 Kw_Wu32 4294.9663 TimeDelay_s 0.0010000001 4294.9673 FORMAT "%9.4" EXTENDED_LIMITS 0.0000010000000 4294.9673 /end CHARACTERISTIC
/begin CHARACTERISTIC EGSys_pConstVal_C "Normdruck" VALUE 0xCCE80 Kw_Ws16 65535.00 Pres_hPa -32768.00 32767.00 FORMAT "%8.2" READ_ONLY /end CHARACTERISTIC
/begin CHARACTERISTIC EGSys_phiStrtDlv_MAP "Kennfeld zur Ermittlung Förderbeginn MI1 im Auslegungspunkt (zur Temperaturkorrektur)" MAP 0xCD08C Kf_Xs16_Ys16_Ws16 99.98437 AngleCrS -49.99219 49.99219 FORMAT "%8.5" EXTENDED_LIMITS -768.0000 767.9766
 /begin AXIS_DESCR STD_AXIS Eng_nAvrg EngN 8 0.00 8000.000 FORMAT "%8.3" EXTENDED_LIMITS -32768.00 32767.00 DEPOSIT ABSOLUTE /end AXIS_DESCR
 /begin AXIS_DESCR STD_AXIS InjCtl_qCurr InjMassCyc 8 0.00 100.0000 FORMAT "%8.4" EXTENDED_LIMITS -327.6800 327.6700 DEPOSIT ABSOLUTE /end AXIS_DESCR
/end CHARACTERISTIC
/begin CHARACTERISTIC EGSys_tiChrgPT1_C "Feste thermische Zeitkonstante Turbolader" VALUE 0xCD534 Kw_Wu32 4294.9663 TimeDelay_s 0.0010000001 4294.9673 FORMAT "%9.4" EXTENDED_LIMITS 0.0000010000000 4294.9673 /end CHARACTERISTIC
/begin CHARACTERISTIC EGSys_pValDfl_C "Vorgabewert Umgebungsdruck für Turboladermodell" VALUE 0xCD538 Kw_Ws16 3000.000 Pres_hPa 500.0000 3500.000 FORMAT "%8.3" EXTENDED_LIMITS -32768.00 32767.00 /end CHARACTERISTIC
/begin CHARACTERISTIC EGSys_rSqTube_C "Anteil der vom Fahrtwind beaufschlagten Oberfläche Abgasrohr" VAL_BLK 0xCD5B4 Kwb_Ws16 3.800049 Fact 0.09997559 3.900024 FORMAT "%8.6" EXTENDED_LIMITS -4.000000 3.999878 NUMBER 2 /end CHARACTERISTIC
/begin CHARACTERISTIC EGSys_rTempAdbt_CUR "Kennlinie für die adiabatische Zustandänderung der Temperatur (nicht applizierbar)" CURVE 0xCD53A Kl_Xs16_Ws16 0.4000244 Fact 1.000000 1.400024 FORMAT "%8.6" EXTENDED_LIMITS -4.000000 3.999878 READ_ONLY
 /begin AXIS_DESCR STD_AXIS EGSys_rPresCmpr_mp Fact 8 1.000000 8.000000 FORMAT "%8.6" EXTENDED_LIMITS -4.000000 3.999878 DEPOSIT ABSOLUTE /end AXIS_DESCR
/end CHARACTERISTIC
/begin CHARACTERISTIC EGSys_swtDewDetShOff_C "Umschalter für Ersatzfunktion (Zeitapplikation)" VAL_BLK 0xCCC81 Kwb_Wu8 10.00 OneToOne 0.00 10.00 FORMAT "%5.2" EXTENDED_LIMITS 0.00 255.0 NUMBER 1 /end CHARACTERISTIC
/begin CHARACTERISTIC EGSys_swtPresSel_C "#SSD Auswahl, ob Atmosphaerendruck (=1) oder Druck vor Partikelfilter (=0)" VALUE 0xCCE82 Kw_Wu8 1.000 OneToOne 0.00 1.000 FORMAT "%5.3" EXTENDED_LIMITS 0.00 255.0 /end CHARACTERISTIC
/begin CHARACTERISTIC EGSys_swtTAirSens_C "Umschalter für Umgebungstemperatursensor" VALUE 0xCD468 Kw_Wu8 1.000 OneToOne 0.00 1.000 FORMAT "%5.3" EXTENDED_LIMITS 0.00 255.0 /end CHARACTERISTIC
/begin CHARACTERISTIC EGSys_swtTimeChrg_C "Schalter zur Verwendung fester oder variabler thermischer Zeitkonstante für Turbolader" VALUE 0xCD55C Kw_Wu8 1.000 OneToOne 0.00 1.000 FORMAT "%5.3" EXTENDED_LIMITS 0.00 255.0 /end CHARACTERISTIC
/begin CHARACTERISTIC EGSys_swtTimeNSC_C "Schalter zur Verwendung fester oder variabler thermischer Zeitkonstante für NSC" VALUE 0xCD2A8 Kw_Wu8 1.000 OneToOne 0.00 1.000 FORMAT "%5.3" EXTENDED_LIMITS 0.00 255.0 /end CHARACTERISTIC
/begin CHARACTERISTIC EGSys_swtTimeOxiCat_C "Schalter zur Verwendung fester oder variabler thermischer Zeitkonstante für Oxidationskatalysator" VALUE 0xCD37C Kw_Wu8 1.000 OneToOne 0.00 1.000 FORMAT "%5.3" EXTENDED_LIMITS 0.00 255.0 /end CHARACTERISTIC
/begin CHARACTERISTIC EGSys_tEGPstTrbnDfl_C "Ersatzwert Turbinentemperatur im Fehlerfall" VALUE 0xCD55E Kw_Ws16 950.000 Temp_Cels -50.140 899.860 FORMAT "%8.3" EXTENDED_LIMITS -3549.940 3003.560 /end CHARACTERISTIC
/begin CHARACTERISTIC EGSys_tEGTubeDfl_C "Ersatzwert Abgastemperatur im Abgasrohr" VAL_BLK 0xCD5B8 Kwb_Ws16 950.000 Temp_Cels -50.140 899.860 FORMAT "%8.3" EXTENDED_LIMITS -3549.940 3003.560 NUMBER 2 /end CHARACTERISTIC
/begin CHARACTERISTIC EGSys_tEngStat_C "Kühlmitteltemperatur (bzw Motortemperatur) betriebswarmer Motor unter normalen Bendingungen" VALUE 0xCD130 Kw_Ws16 950.000 Temp_Cels -50.140 899.860 FORMAT "%8.3" EXTENDED_LIMITS -3549.940 3003.560 /end CHARACTERISTIC
/begin CHARACTERISTIC EGSys_tExcClntDfl_C "Ersatzwert für Motor-Übertemperatur" VALUE 0xCCF5E Kw_Ws16 1095.000 TempDiff_Cels -45.00000 1050.000 FORMAT "%8.3" EXTENDED_LIMITS -3276.800 3276.700 /end CHARACTERISTIC
/begin CHARACTERISTIC EGSys_tIAT_MAP "Kennfeld Ansauglufttemperatur im Auslegungspunkt zur Korrektur der stationären Krümmeraustrittstemperatur" MAP 0xCD132 Kf_Xs16_Ys16_Ws16 950.000 Temp_Cels -50.140 899.860 FORMAT "%8.3" EXTENDED_LIMITS -3549.940 3003.560
 /begin AXIS_DESCR STD_AXIS Eng_nAvrg EngN 8 0.00 8000.000 FORMAT "%8.3" EXTENDED_LIMITS -32768.00 32767.00 DEPOSIT ABSOLUTE /end AXIS_DESCR
 /begin AXIS_DESCR STD_AXIS InjCtl_qCurr InjMassCyc 8 0.00 100.0000 FORMAT "%8.4" EXTENDED_LIMITS -327.6800 327.6700 DEPOSIT ABSOLUTE /end AXIS_DESCR
/end CHARACTERISTIC
/begin CHARACTERISTIC EGSys_tiDebLSU0_C "Entprellzeit Heizungsfreigabe Lambdasonde 0" VAL_BLK 0xCCC82 Kwb_Wu16 20.00000 Time_s 0.00 20.00000 FORMAT "%8.5" EXTENDED_LIMITS 0.00 655.3500 NUMBER 1 /end CHARACTERISTIC
/begin CHARACTERISTIC EGSys_tiDebNrmTransOk_C "Entprellzeit zur Verzögerung der Berechnungen nach Start bis gültige Temperaturen anliegen" VALUE 0xCCC84 Kw_Ws16 1000.000 TimeDeb 0.00 1000.000 FORMAT "%8.3" EXTENDED_LIMITS -327680.0 327670.0 /end CHARACTERISTIC
/begin CHARACTERISTIC EGSys_tiHaValClnt_C "Abkühl-Halbwertszeit Motor" VALUE 0xCD46C Kw_Wu32 42949672.9500 Time_s 0.00 42949672.9500 FORMAT "%13.4" /end CHARACTERISTIC
/begin CHARACTERISTIC EGSys_tiHaValNSC_C "Abkühl-Halbwertszeit NSC" VALUE 0xCD470 Kw_Wu32 42949672.9500 Time_s 0.00 42949672.9500 FORMAT "%13.4" /end CHARACTERISTIC
/begin CHARACTERISTIC EGSys_tiHaValOxiCat_C "Abkühl-Halbwertszeit Oxidationskatalysator" VALUE 0xCD474 Kw_Wu32 42949672.9500 Time_s 0.00 42949672.9500 FORMAT "%13.4" /end CHARACTERISTIC
/begin CHARACTERISTIC EGSys_tiHaValTrb_C "Abkühlen der Halbzeit-Periode turbocharge" VALUE 0xCD478 Kw_Wu32 42949672.9500 Time_s 0.00 42949672.9500 FORMAT "%13.4" /end CHARACTERISTIC
/begin CHARACTERISTIC EGSys_tiHaValTube_C "Abkühl-Halbwertszeit Abgasrohr" VAL_BLK 0xCD47C Kwb_Wu32 42949672.9500 Time_s 0.00 42949672.9500 FORMAT "%13.4" NUMBER 2 /end CHARACTERISTIC
/begin CHARACTERISTIC EGSys_tiHtgDelLSU_C "Verzögerung der Heizungsfreigabe im Fehlerfall" VAL_BLK 0xCCC88 Kwb_Wu32 42949672.9500 Time_s 0.00 42949672.9500 FORMAT "%13.4" NUMBER 1 /end CHARACTERISTIC
/begin CHARACTERISTIC EGSys_tIntegIni_C "Temperaturschwellwert für die Aktivierung des Wärmemengenintegrators" VAL_BLK 0xCCC8C Kwb_Ws16 250.0000 Temp_Cels -50.1400 199.8600 FORMAT "%8.4" EXTENDED_LIMITS -3549.940 3003.560 NUMBER 1 /end CHARACTERISTIC
/begin CHARACTERISTIC EGSys_tiOfsClg_C "Abkühlzeitkorrektur Motor wg. Stauwärmeeffekten" VALUE 0xCD484 Kw_Wu32 42949672.9500 Time_s 0.00 42949672.9500 FORMAT "%13.4" /end CHARACTERISTIC
/begin CHARACTERISTIC EGSys_tiPlsLSU_C "Minimale Dauer für gültigen Gaspuls" VAL_BLK 0xCCC8E Kwb_Wu16 20.00000 Time_s 0.00 20.00000 FORMAT "%8.5" EXTENDED_LIMITS 0.00 655.3500 NUMBER 1 /end CHARACTERISTIC
/begin CHARACTERISTIC EGSys_tManfDfl_C "Vorgabewert Abgaskrümmertemperatur im Fehlerfall" VALUE 0xCD1D6 Kw_Ws16 950.000 Temp_Cels -50.140 899.860 FORMAT "%8.3" EXTENDED_LIMITS -3549.940 3003.560 /end CHARACTERISTIC
/begin CHARACTERISTIC EGSys_tManfStat_MAP "Kennfeld zur Ermittlung der stationären Abgaskrümmertemperatur" MAP 0xCD1D8 Kf_Xs16_Ys16_Ws16 950.000 Temp_Cels -50.140 899.860 FORMAT "%8.3" EXTENDED_LIMITS -3549.940 3003.560
 /begin AXIS_DESCR STD_AXIS Eng_nAvrg EngN 10 0.00 8000.000 FORMAT "%8.3" EXTENDED_LIMITS -32768.00 32767.00 DEPOSIT ABSOLUTE /end AXIS_DESCR
 /begin AXIS_DESCR STD_AXIS InjCtl_qCurr InjMassCyc 8 0.00 100.0000 FORMAT "%8.4" EXTENDED_LIMITS -327.6800 327.6700 DEPOSIT ABSOLUTE /end AXIS_DESCR
/end CHARACTERISTIC
/begin CHARACTERISTIC EGSys_tNSCDfl_C "Ersatzwert für NSC Temperatur" VALUE 0xCD2AA Kw_Ws16 950.000 Temp_Cels -50.140 899.860 FORMAT "%8.3" EXTENDED_LIMITS -3549.940 3003.560 /end CHARACTERISTIC
/begin CHARACTERISTIC EGSys_tNSCExoIncr_MAP "Kennfeld für Temperaturerhöhung im NSC aufgrund chemischer Reaktionen" MAP 0xCD2AC Kf_Xs16_Ys16_Ws16 1095.000 TempDiff_Cels -45.00000 1050.000 FORMAT "%8.3" EXTENDED_LIMITS -3276.800 3276.700
 /begin AXIS_DESCR STD_AXIS EGSys_tAvrgNSC_mp Temp_Cels 8 -50.140 899.860 FORMAT "%8.3" EXTENDED_LIMITS -3549.940 3003.560 DEPOSIT ABSOLUTE /end AXIS_DESCR
 /begin AXIS_DESCR STD_AXIS EGSys_rLmbdAprx lambda 8 -30.00000 30.00000 FORMAT "%8.5" EXTENDED_LIMITS -32.76800 32.76700 DEPOSIT ABSOLUTE /end AXIS_DESCR
/end CHARACTERISTIC
/begin CHARACTERISTIC EGSys_tOxiCatDfl_C "Ersatzwert Oxidationskatalysatortemperatur" VALUE 0xCD37E Kw_Ws16 950.000 Temp_Cels -50.140 899.860 FORMAT "%8.3" EXTENDED_LIMITS -3549.940 3003.560 /end CHARACTERISTIC
/begin CHARACTERISTIC EGSys_tOxiCatExoIncr_MAP "Kennfeld für Tempertaturerhöhung im Oxidationskatalysator aufgrund chemischer Reaktionen" MAP 0xCD380 Kf_Xs16_Ys16_Ws16 1095.000 TempDiff_Cels -45.00000 1050.000 FORMAT "%8.3" EXTENDED_LIMITS -3276.800 3276.700
 /begin AXIS_DESCR STD_AXIS EGSys_tAvrgOxiCat_mp Temp_Cels 8 -50.140 899.860 FORMAT "%8.3" EXTENDED_LIMITS -3549.940 3003.560 DEPOSIT ABSOLUTE /end AXIS_DESCR
 /begin AXIS_DESCR STD_AXIS EGSys_rLmbdAprx lambda 8 -30.00000 30.00000 FORMAT "%8.5" EXTENDED_LIMITS -32.76800 32.76700 DEPOSIT ABSOLUTE /end AXIS_DESCR
/end CHARACTERISTIC
/begin CHARACTERISTIC EGSys_tStrtCsRepl_C "Ersatzwert für Initialisierungstemperaturen der abgasführen den Bauteile im Fehlerfall" VALUE 0xCD488 Kw_Ws16 950.000 Temp_Cels -50.140 899.860 FORMAT "%8.3" EXTENDED_LIMITS -3549.940 3003.560 /end CHARACTERISTIC
/begin CHARACTERISTIC EGSys_tThresLSUAct_C "Temperaturschwellwert für reversible TPE" VAL_BLK 0xCCC90 Kwb_Ws16 250.0000 Temp_Cels -50.1400 199.8600 FORMAT "%8.4" EXTENDED_LIMITS -3549.940 3003.560 NUMBER 1 /end CHARACTERISTIC
/begin CHARACTERISTIC EGSys_tTubeDfl_C "Ersatzwert Abgasrohr-Temperatur" VAL_BLK 0xCD5BC Kwb_Ws16 950.000 Temp_Cels -50.140 899.860 FORMAT "%8.3" EXTENDED_LIMITS -3549.940 3003.560 NUMBER 2 /end CHARACTERISTIC
/begin CHARACTERISTIC EGSys_tTubeIKi_C "I-Verstärkung Integrator zur Abgasrohr-Temperaturmodellierung" VALUE 0xCD5C0 Kw_Wu32 4.00003045797 Ki_Kelv_Sec 0.00 4.00003045797 FORMAT "%13.11" EXTENDED_LIMITS 0.00 9999999.99767 /end CHARACTERISTIC
/begin CHARACTERISTIC EGSys_tTubeIKiPos_C "I-Verstärkung Integrator Abgasrohr-Temperaturmodellierung für pos. Großsignalbereich" VALUE 0xCD5C4 Kw_Wu32 4.00003045797 Ki_Kelv_Sec 0.00 4.00003045797 FORMAT "%13.11" EXTENDED_LIMITS 0.00 9999999.99767 /end CHARACTERISTIC
/begin CHARACTERISTIC EGSys_tTubeIKiNeg_C "I-Verstärkung Integrator Abgasrohr-Temperaturmodellierung für neg. Großsignalbereich" VALUE 0xCD5C8 Kw_Wu32 4.00003045797 Ki_Kelv_Sec 0.00 4.00003045797 FORMAT "%13.11" EXTENDED_LIMITS 0.00 9999999.99767 /end CHARACTERISTIC
/begin CHARACTERISTIC EGSys_tTubeIWinPos_C "Obere Kleinstwertgrenze Integrator zur Abgasrohr-Temperaturmodellierung" VALUE 0xCD5CC Kw_Ws16 65535.00 OneToOne -32768.00 32767.00 FORMAT "%8.2" READ_ONLY /end CHARACTERISTIC
/begin CHARACTERISTIC EGSys_tTubeIWinNeg_C "Untere Kleinstwertgrenze Integrator zur Abgasrohr-Temperaturmodellierung" VALUE 0xCD5CE Kw_Ws16 65535.00 OneToOne -32768.00 32767.00 FORMAT "%8.2" READ_ONLY /end CHARACTERISTIC
/begin CHARACTERISTIC EGSys_tWtEquiv_C "äquivalente Wassertemperatur beim Verdampfen" VAL_BLK 0xCCC92 Kwb_Ws16 950.000 Temp_Cels -50.140 899.860 FORMAT "%8.3" EXTENDED_LIMITS -3549.940 3003.560 NUMBER 1 /end CHARACTERISTIC
/begin CHARACTERISTIC EGSys_vscDynEG_CUR "Dynamische Viskosität Abgas (nicht applizierbar)" CURVE 0xCCF1A Kl_Xs16_Ws16 0.9998779 Fact 0.0001220703 1.000000 FORMAT "%8.6" EXTENDED_LIMITS -4.000000 3.999878 READ_ONLY
 /begin AXIS_DESCR STD_AXIS EGSys_tEGLSUInpCrv0_mp Temp_Cels 8 -50.140 899.860 FORMAT "%8.3" EXTENDED_LIMITS -3549.940 3003.560 DEPOSIT ABSOLUTE /end AXIS_DESCR
/end CHARACTERISTIC
/begin CHARACTERISTIC EGSys_vscKinEG_CUR "Kinematische Viskosität Abgas (nicht applizierbar)" CURVE 0xCCF3C Kl_Xs16_Ws16 0.9998779 Fact 0.0001220703 1.000000 FORMAT "%8.6" EXTENDED_LIMITS -4.000000 3.999878 READ_ONLY
 /begin AXIS_DESCR STD_AXIS EGSys_tEGLSUInpCrv0_mp Temp_Cels 8 -50.140 899.860 FORMAT "%8.3" EXTENDED_LIMITS -3549.940 3003.560 DEPOSIT ABSOLUTE /end AXIS_DESCR
/end CHARACTERISTIC
/begin CHARACTERISTIC EGSys_wLSUIKi_C "Verstärkung des Integrators" VAL_BLK 0xCCC94 Kwb_Ws16 5.000000 OneToOne 0.00 5.000000 FORMAT "%8.6" EXTENDED_LIMITS -32768.00 32767.00 NUMBER 1 /end CHARACTERISTIC
/begin CHARACTERISTIC EGSys_wThresLSU0_MAP "Wärmeschwellen Grundkennfeld Lambdasonde 0" MAP 0xCCC96 Kf_Xs16_Ys16_Ws16 6000.000 Energy 0.00 6000.000 FORMAT "%8.3" EXTENDED_LIMITS -32768.00 32767.00
 /begin AXIS_DESCR STD_AXIS EGSys_tEGLSUInpCrv0_mp Temp_Cels 10 -50.140 899.860 FORMAT "%8.3" EXTENDED_LIMITS -3549.940 3003.560 DEPOSIT ABSOLUTE /end AXIS_DESCR
 /begin AXIS_DESCR STD_AXIS Eng_tEng Temp_Cels 10 -50.140 899.860 FORMAT "%8.3" EXTENDED_LIMITS -3549.940 3003.560 DEPOSIT ABSOLUTE /end AXIS_DESCR
/end CHARACTERISTIC
/begin CHARACTERISTIC EGT_facKiAMPT_MAP "Grundwert I-Anteil des Reglereingriffs über Luftmasse" MAP 0xCD5E4 Kf_Xs16_Ys16_Ws16 0.06000046 Ki_Temp2EGTFact 0.00 0.06000046 FORMAT "%10.8" EXTENDED_LIMITS -0.03814697 0.03814581
 /begin AXIS_DESCR STD_AXIS Eng_nAvrg EngN 8 0.00 6000.000 FORMAT "%8.3" EXTENDED_LIMITS -32768.00 32767.00 DEPOSIT ABSOLUTE /end AXIS_DESCR
 /begin AXIS_DESCR STD_AXIS InjCtl_qSetUnBal InjMassCyc 8 0.00 327.6700 FORMAT "%8.4" EXTENDED_LIMITS -327.6800 327.6700 DEPOSIT ABSOLUTE /end AXIS_DESCR
/end CHARACTERISTIC
/begin CHARACTERISTIC EGT_facKiInrTempGvnr_C "Korrekturfaktor des I-Anteils bei Großsignalverstärkung des inneren Reglers" VALUE 0xCD688 Kw_Wu32 4.00000000000 Fact1 0.00 4.00000000000 FORMAT "%13.11" EXTENDED_LIMITS 0.00 33554431.9922 /end CHARACTERISTIC
/begin CHARACTERISTIC EGT_facKiOutrTempGvnr_C "Korrekturfaktor des I-Anteils bei Großsignalvertsärkung des äußeren Reglers" VALUE 0xCD68C Kw_Wu32 4.00000000000 Fact1 0.00 4.00000000000 FORMAT "%13.11" EXTENDED_LIMITS 0.00 33554431.9922 /end CHARACTERISTIC
/begin CHARACTERISTIC EGT_facKiQntPoI1_MAP "Grundwert I-Anteil des äußeren Reglers bei Eingriff über Einspritzung" MAP 0xCD690 Kf_Xs16_Ys16_Ws16 0.06000046 Ki_Temp2EGTFact 0.00 0.06000046 FORMAT "%10.8" EXTENDED_LIMITS -0.03814697 0.03814581
 /begin AXIS_DESCR STD_AXIS Eng_nAvrg EngN 8 0.00 6000.000 FORMAT "%8.3" EXTENDED_LIMITS -32768.00 32767.00 DEPOSIT ABSOLUTE /end AXIS_DESCR
 /begin AXIS_DESCR STD_AXIS InjCtl_qSetUnBal InjMassCyc 8 0.00 327.6700 FORMAT "%8.4" EXTENDED_LIMITS -327.6800 327.6700 DEPOSIT ABSOLUTE /end AXIS_DESCR
/end CHARACTERISTIC
/begin CHARACTERISTIC EGT_facKiQntPoI2_MAP "Grundwert I-Anteil des inneren Reglers bei Eingriff über Einspritzung" MAP 0xCD734 Kf_Xs16_Ys16_Ws16 0.06000046 Ki_Temp2EGTFact 0.00 0.06000046 FORMAT "%10.8" EXTENDED_LIMITS -0.03814697 0.03814581
 /begin AXIS_DESCR STD_AXIS Eng_nAvrg EngN 8 0.00 6000.000 FORMAT "%8.3" EXTENDED_LIMITS -32768.00 32767.00 DEPOSIT ABSOLUTE /end AXIS_DESCR
 /begin AXIS_DESCR STD_AXIS InjCtl_qSetUnBal InjMassCyc 8 0.00 327.6700 FORMAT "%8.4" EXTENDED_LIMITS -327.6800 327.6700 DEPOSIT ABSOLUTE /end AXIS_DESCR
/end CHARACTERISTIC
/begin CHARACTERISTIC EGT_facKiTempInrCor_MAP "Grundwert I-Anteil des inneren Reglers bei Eingriff über Temperatursollwert" MAP 0xCD7D8 Kf_Xs16_Ys16_Ws16 0.06000046 Ki_Temp2EGTFact 0.00 0.06000046 FORMAT "%10.8" EXTENDED_LIMITS -0.03814697 0.03814581
 /begin AXIS_DESCR STD_AXIS Eng_nAvrg EngN 8 0.00 6000.000 FORMAT "%8.3" EXTENDED_LIMITS -32768.00 32767.00 DEPOSIT ABSOLUTE /end AXIS_DESCR
 /begin AXIS_DESCR STD_AXIS InjCtl_qSetUnBal InjMassCyc 8 0.00 327.6700 FORMAT "%8.4" EXTENDED_LIMITS -327.6800 327.6700 DEPOSIT ABSOLUTE /end AXIS_DESCR
/end CHARACTERISTIC
/begin CHARACTERISTIC EGT_facKpAMPT_MAP "Grundwert P-Anteil des inneren Reglers bei Eingriff über Luftmasse" MAP 0xCD87C Kf_Xs16_Ys16_Ws16 0.06000000 Kp_Temp2EGTFact 0.00 0.06000000 FORMAT "%10.8" EXTENDED_LIMITS -0.6400000 0.6399805
 /begin AXIS_DESCR STD_AXIS Eng_nAvrg EngN 8 0.00 6000.000 FORMAT "%8.3" EXTENDED_LIMITS -32768.00 32767.00 DEPOSIT ABSOLUTE /end AXIS_DESCR
 /begin AXIS_DESCR STD_AXIS InjCtl_qSetUnBal InjMassCyc 8 0.00 327.6700 FORMAT "%8.4" EXTENDED_LIMITS -327.6800 327.6700 DEPOSIT ABSOLUTE /end AXIS_DESCR
/end CHARACTERISTIC
/begin CHARACTERISTIC EGT_facKpInrTempGvnr_C "Korrekturfaktor P-Anteil bei Großsignalverstärkung des inneren Reglers" VALUE 0xCD920 Kw_Ws32 4.00000000000 Fact1 0.00 4.00000000000 FORMAT "%13.11" EXTENDED_LIMITS -16777216.0000 16777215.9922 /end CHARACTERISTIC
/begin CHARACTERISTIC EGT_facKpOutrTempGvnr_C "Korrekturfaktor P-Anteil bei Großsignalverstärkung des äußeren Reglers" VALUE 0xCD924 Kw_Ws32 4.00000000000 Fact1 0.00 4.00000000000 FORMAT "%13.11" EXTENDED_LIMITS -16777216.0000 16777215.9922 /end CHARACTERISTIC
/begin CHARACTERISTIC EGT_facKpQntPoI1_MAP "Grundwert P-Anteil des äußeren Reglers bei Eingriff über Einspritzung" MAP 0xCD928 Kf_Xs16_Ys16_Ws16 0.06000000 Kp_Temp2EGTFact 0.00 0.06000000 FORMAT "%10.8" EXTENDED_LIMITS -0.6400000 0.6399805
 /begin AXIS_DESCR STD_AXIS Eng_nAvrg EngN 8 0.00 6000.000 FORMAT "%8.3" EXTENDED_LIMITS -32768.00 32767.00 DEPOSIT ABSOLUTE /end AXIS_DESCR
 /begin AXIS_DESCR STD_AXIS InjCtl_qSetUnBal InjMassCyc 8 0.00 327.6700 FORMAT "%8.4" EXTENDED_LIMITS -327.6800 327.6700 DEPOSIT ABSOLUTE /end AXIS_DESCR
/end CHARACTERISTIC
/begin CHARACTERISTIC EGT_facKpQntPoI2_MAP "Grundwert P-Anteil des inneren Reglers bei Eingriff über Einspritzung" MAP 0xCD9CC Kf_Xs16_Ys16_Ws16 0.06000000 Kp_Temp2EGTFact 0.00 0.06000000 FORMAT "%10.8" EXTENDED_LIMITS -0.6400000 0.6399805
 /begin AXIS_DESCR STD_AXIS Eng_nAvrg EngN 8 0.00 6000.000 FORMAT "%8.3" EXTENDED_LIMITS -32768.00 32767.00 DEPOSIT ABSOLUTE /end AXIS_DESCR
 /begin AXIS_DESCR STD_AXIS InjCtl_qSetUnBal InjMassCyc 8 0.00 327.6700 FORMAT "%8.4" EXTENDED_LIMITS -327.6800 327.6700 DEPOSIT ABSOLUTE /end AXIS_DESCR
/end CHARACTERISTIC
/begin CHARACTERISTIC EGT_facKpTempInrCor_MAP "Grundwert P-Anteil des inneren Reglers bei Eingriff über Temperatursollwert" MAP 0xCDA70 Kf_Xs16_Ys16_Ws16 0.06000000 Kp_Temp2EGTFact 0.00 0.06000000 FORMAT "%10.8" EXTENDED_LIMITS -0.6400000 0.6399805
 /begin AXIS_DESCR STD_AXIS Eng_nAvrg EngN 8 0.00 6000.000 FORMAT "%8.3" EXTENDED_LIMITS -32768.00 32767.00 DEPOSIT ABSOLUTE /end AXIS_DESCR
 /begin AXIS_DESCR STD_AXIS InjCtl_qSetUnBal InjMassCyc 8 0.00 327.6700 FORMAT "%8.4" EXTENDED_LIMITS -327.6800 327.6700 DEPOSIT ABSOLUTE /end AXIS_DESCR
/end CHARACTERISTIC
/begin CHARACTERISTIC EGT_facQntPoI2Rmp_CUR "Anpassung Rampenwert an PoI2" CURVE 0xCF278 Kl_Xs16_Ws16 1.000000 EGTSwt_S16 0.00 1.000000 FORMAT "%8.6" EXTENDED_LIMITS -2.000000 1.999939
 /begin AXIS_DESCR STD_AXIS EGT_facRmp_mp EGTSwt_S16 3 0.00 1.000000 FORMAT "%8.6" EXTENDED_LIMITS -2.000000 1.999939 DEPOSIT ABSOLUTE /end AXIS_DESCR
/end CHARACTERISTIC
/begin CHARACTERISTIC EGT_mAirDesTempGvnrMnl_C "Manueller Defaultwert für Luftmassensollwertkorektur" VALUE 0xCF286 Kw_Ws16 10000.00 AirMassPerCyl -5000.000 5000.000 FORMAT "%8.3" EXTENDED_LIMITS -3276.800 3276.700 /end CHARACTERISTIC
/begin CHARACTERISTIC EGT_mAirLmbd_CUR "Luftmassenkorrektur über Lambdawert" CURVE 0xCF288 Kl_Xs16_Ws16 10000.00 AirMassPerCyl -5000.000 5000.000 FORMAT "%8.3" EXTENDED_LIMITS -3276.800 3276.700
 /begin AXIS_DESCR STD_AXIS PFlt_rLmbd lambda 8 0.00 7.000000 FORMAT "%8.6" EXTENDED_LIMITS -32.76800 32.76700 DEPOSIT ABSOLUTE /end AXIS_DESCR
/end CHARACTERISTIC
/begin CHARACTERISTIC EGT_mAirTempGvnrMax_MAP "Maximal mögliche Luftmassensollwertkorrektur" MAP 0xCDB14 Kf_Xs16_Ys16_Ws16 5000.000 AirMassPerCyl 0.00 5000.000 FORMAT "%8.3" EXTENDED_LIMITS -3276.800 3276.700
 /begin AXIS_DESCR STD_AXIS Eng_nAvrg EngN 16 0.00 6000.000 FORMAT "%8.3" EXTENDED_LIMITS -32768.00 32767.00 DEPOSIT ABSOLUTE /end AXIS_DESCR
 /begin AXIS_DESCR STD_AXIS InjCtl_qSetUnBal InjMassCyc 16 0.00 327.6700 FORMAT "%8.4" EXTENDED_LIMITS -327.6800 327.6700 DEPOSIT ABSOLUTE /end AXIS_DESCR
/end CHARACTERISTIC
/begin CHARACTERISTIC EGT_mAirTempGvnrMin_MAP "Minimal mögliche Luftmassensollwertkorrektur" MAP 0xCDD58 Kf_Xs16_Ys16_Ws16 5000.000 AirMassPerCyl -5000.000 0.00 FORMAT "%8.3" EXTENDED_LIMITS -3276.800 3276.700
 /begin AXIS_DESCR STD_AXIS Eng_nAvrg EngN 16 0.00 6000.000 FORMAT "%8.3" EXTENDED_LIMITS -32768.00 32767.00 DEPOSIT ABSOLUTE /end AXIS_DESCR
 /begin AXIS_DESCR STD_AXIS InjCtl_qSetUnBal InjMassCyc 16 0.00 327.6700 FORMAT "%8.4" EXTENDED_LIMITS -327.6800 327.6700 DEPOSIT ABSOLUTE /end AXIS_DESCR
/end CHARACTERISTIC
/begin CHARACTERISTIC EGT_phiPoI1TempGvnr_MAP "Additive Winkelkorrektur der verzögerten Nacheinspritzung" MAP 0xCF2AA Kf_Xs16_Ys16_Ws16 399.9844 AngleCrS -199.9922 199.9922 FORMAT "%8.4" EXTENDED_LIMITS -768.0000 767.9766
 /begin AXIS_DESCR STD_AXIS Eng_nAvrg EngN 8 0.00 6000.000 FORMAT "%8.3" EXTENDED_LIMITS -32768.00 32767.00 DEPOSIT ABSOLUTE /end AXIS_DESCR
 /begin AXIS_DESCR STD_AXIS InjCtl_qSetUnBal InjMassCyc 8 0.00 327.6700 FORMAT "%8.4" EXTENDED_LIMITS -327.6800 327.6700 DEPOSIT ABSOLUTE /end AXIS_DESCR
/end CHARACTERISTIC
/begin CHARACTERISTIC EGT_qHCQntPoI1_CUR "Einspritzmengenkorrektur für HC-Dosierventil" CURVE 0xCF34E Kl_Xs16_Ws16 400.0000 InjMassInj -200.0000 200.0000 FORMAT "%8.4" EXTENDED_LIMITS -327.6800 327.6700
 /begin AXIS_DESCR STD_AXIS EGT_qPoI1OutrTempGvnr InjMassInj 1 -200.0000 200.0000 FORMAT "%8.4" EXTENDED_LIMITS -327.6800 327.6700 DEPOSIT ABSOLUTE /end AXIS_DESCR
/end CHARACTERISTIC
/begin CHARACTERISTIC EGT_qPoI1Min_C "Minimalwert der angelagerten Nacheinspritzung" VALUE 0xCDF9C Kw_Ws16 327.6700 InjMassInj 0.00 327.6700 FORMAT "%8.4" EXTENDED_LIMITS -327.6800 327.6700 /end CHARACTERISTIC
/begin CHARACTERISTIC EGT_qPoI1TempGvnrMax_MAP "Maximal mögliche Korrektur der angelagerten Nacheinspritzung" MAP 0xCDF9E Kf_Xs16_Ys16_Ws16 200.0000 InjMassInj 0.00 200.0000 FORMAT "%8.4" EXTENDED_LIMITS -327.6800 327.6700
 /begin AXIS_DESCR STD_AXIS Eng_nAvrg EngN 16 0.00 6000.000 FORMAT "%8.3" EXTENDED_LIMITS -32768.00 32767.00 DEPOSIT ABSOLUTE /end AXIS_DESCR
 /begin AXIS_DESCR STD_AXIS InjCtl_qSetUnBal InjMassCyc 16 0.00 327.6700 FORMAT "%8.4" EXTENDED_LIMITS -327.6800 327.6700 DEPOSIT ABSOLUTE /end AXIS_DESCR
/end CHARACTERISTIC
/begin CHARACTERISTIC EGT_qPoI1TempGvnrMin_MAP "Minimal mögliche Korrektur der angelagerten Nacheinspritzung" MAP 0xCE1E2 Kf_Xs16_Ys16_Ws16 200.0000 InjMassInj -200.0000 0.00 FORMAT "%8.4" EXTENDED_LIMITS -327.6800 327.6700
 /begin AXIS_DESCR STD_AXIS Eng_nAvrg EngN 16 0.00 6000.000 FORMAT "%8.3" EXTENDED_LIMITS -32768.00 32767.00 DEPOSIT ABSOLUTE /end AXIS_DESCR
 /begin AXIS_DESCR STD_AXIS InjCtl_qSetUnBal InjMassCyc 16 0.00 327.6700 FORMAT "%8.4" EXTENDED_LIMITS -327.6800 327.6700 DEPOSIT ABSOLUTE /end AXIS_DESCR
/end CHARACTERISTIC
/begin CHARACTERISTIC EGT_qPoI1TempGvnrMnl_C "Manueller Defaultwert der angelagerten Nacheinspritzung" VALUE 0xCF354 Kw_Ws16 400.0000 InjMassInj -200.0000 200.0000 FORMAT "%8.4" EXTENDED_LIMITS -327.6800 327.6700 /end CHARACTERISTIC
/begin CHARACTERISTIC EGT_qPoI2Min_C "Minimalwert der angelagerten Nacheinspritzung" VALUE 0xCE426 Kw_Ws16 327.6700 InjMassInj 0.00 327.6700 FORMAT "%8.4" EXTENDED_LIMITS -327.6800 327.6700 /end CHARACTERISTIC
/begin CHARACTERISTIC EGT_qPoI2TempGvnrMax_MAP "Maximal mögliche Korrekturmenge der angelagerten Nacheinspritzung" MAP 0xCE428 Kf_Xs16_Ys16_Ws16 200.0000 InjMassInj 0.00 200.0000 FORMAT "%8.4" EXTENDED_LIMITS -327.6800 327.6700
 /begin AXIS_DESCR STD_AXIS Eng_nAvrg EngN 16 0.00 6000.000 FORMAT "%8.3" EXTENDED_LIMITS -32768.00 32767.00 DEPOSIT ABSOLUTE /end AXIS_DESCR
 /begin AXIS_DESCR STD_AXIS InjCtl_qSetUnBal InjMassCyc 16 0.00 327.6700 FORMAT "%8.4" EXTENDED_LIMITS -327.6800 327.6700 DEPOSIT ABSOLUTE /end AXIS_DESCR
/end CHARACTERISTIC
/begin CHARACTERISTIC EGT_qPoI2TempGvnrMin_MAP "Minimal mögliche Korrekturmenge der angelagerten Nacheinspritzung" MAP 0xCE66C Kf_Xs16_Ys16_Ws16 200.0000 InjMassInj -200.0000 0.00 FORMAT "%8.4" EXTENDED_LIMITS -327.6800 327.6700
 /begin AXIS_DESCR STD_AXIS Eng_nAvrg EngN 16 0.00 6000.000 FORMAT "%8.3" EXTENDED_LIMITS -32768.00 32767.00 DEPOSIT ABSOLUTE /end AXIS_DESCR
 /begin AXIS_DESCR STD_AXIS InjCtl_qSetUnBal InjMassCyc 16 0.00 327.6700 FORMAT "%8.4" EXTENDED_LIMITS -327.6800 327.6700 DEPOSIT ABSOLUTE /end AXIS_DESCR
/end CHARACTERISTIC
/begin CHARACTERISTIC EGT_qPoI2TempGvnrMnl_C "Manueller Defaultwert der angelagerten Nacheinspritzung" VALUE 0xCF356 Kw_Ws16 400.0000 InjMassInj -200.0000 200.0000 FORMAT "%8.4" EXTENDED_LIMITS -327.6800 327.6700 /end CHARACTERISTIC
/begin CHARACTERISTIC EGT_rInrDvtThres_C "Schwelle für Großsignalverstärkung des inneren Reglers" VALUE 0xCE8B0 Kw_Ws16 6.000000 EGTFact -3.000000 3.000000 FORMAT "%8.6" EXTENDED_LIMITS -32.76800 32.76700 /end CHARACTERISTIC
/begin CHARACTERISTIC EGT_rOutrDvtThres_C "Schwelle für Großsignalverstärkung des äußeren Regelkreises" VALUE 0xCE8B2 Kw_Ws16 6.000000 EGTFact -3.000000 3.000000 FORMAT "%8.6" EXTENDED_LIMITS -32.76800 32.76700 /end CHARACTERISTIC
/begin CHARACTERISTIC EGT_stMskClsThrVlv_C "Bitmaske Anforderung maximale Androsselung" VALUE 0xCE8B4 Kw_Wu32 2147483647.00 OneToOne 0.00 2147483647.00 FORMAT "%13.2" EXTENDED_LIMITS 0.00 4294967295.00 /end CHARACTERISTIC
/begin CHARACTERISTIC EGT_stMskInrTempGvnr_C "Maske Aktivierung innerer Regelkreis" VALUE 0xCF25C Kw_Wu32 2147483647.00 OneToOne 0.00 2147483647.00 FORMAT "%13.2" EXTENDED_LIMITS 0.00 4294967295.00 /end CHARACTERISTIC
/begin CHARACTERISTIC EGT_stMskOutrTempGvnr_C "Maske Aktivierung äußerer Regelkreis" VALUE 0xCF260 Kw_Wu32 2147483647.00 OneToOne 0.00 2147483647.00 FORMAT "%13.2" EXTENDED_LIMITS 0.00 4294967295.00 /end CHARACTERISTIC
/begin CHARACTERISTIC EGT_stRgnLckMsk_C "Maske zur Blockierung und Aktivierung der Regenerationsmaßnahmen" VALUE 0xCD5D0 Kw_Wu32 2147483647.00 OneToOne 0.00 2147483647.00 FORMAT "%13.2" EXTENDED_LIMITS 0.00 4294967295.00 /end CHARACTERISTIC
/begin CHARACTERISTIC EGT_stTSync_Vector "#SSD Konfigurationslabel für Bypass" VALUE 0xC2D52 Kw_Wu8 255.0 OneToOne 0.00 255.0 FORMAT "%5.1" /end CHARACTERISTIC
/begin CHARACTERISTIC EGT_stTSync_Channel "#SSD Konfigurationslabels für Bypass" VALUE 0xC2D53 Kw_Wu8 255.0 OneToOne 0.00 255.0 FORMAT "%5.1" /end CHARACTERISTIC
/begin CHARACTERISTIC EGT_swtBiTrbTempGvnr_C "Bi-Turbo Schalter" VALUE 0xCE8B8 Kw_Wu8 1.000 OneToOne 0.00 1.000 FORMAT "%5.3" EXTENDED_LIMITS 0.00 255.0 /end CHARACTERISTIC
/begin CHARACTERISTIC EGT_swtInrTempOutr_C "Innerer Regelkreis aktiv" VALUE 0xCE8B9 Kw_Wu8 1.000 OneToOne 0.00 1.000 FORMAT "%5.3" EXTENDED_LIMITS 0.00 255.0 /end CHARACTERISTIC
/begin CHARACTERISTIC EGT_swtQntPoI1HC_C "Umschaltung angelagerte Nacheinspritzung / HC Dosierventil" VALUE 0xCF358 Kw_Wu8 1.000 OneToOne 0.00 1.000 FORMAT "%5.3" EXTENDED_LIMITS 0.00 255.0 /end CHARACTERISTIC
/begin CHARACTERISTIC EGT_swtRgnLckRst_C "Schalter zum Rücksetzen der Verriegelung der Regenerationsmaßnahmen bei kritischer Ölverdünnungszeit" VALUE 0xCD5D4 Kw_Wu8 1.000 OneToOne 0.00 1.000 FORMAT "%5.3" EXTENDED_LIMITS 0.00 255.0 /end CHARACTERISTIC
/begin CHARACTERISTIC EGT_swtServiceVal_C "Serviceschalter zur Rücksetzung nach Ölwechsel" VALUE 0xCD5D5 Kw_Wu8 1.000 OneToOne 0.00 1.000 FORMAT "%5.3" EXTENDED_LIMITS 0.00 255.0 /end CHARACTERISTIC
/begin CHARACTERISTIC EGT_swtTempInrDes_C "Schalter für kundenspezifischen Sollwert (innerer Regelkreis)" VALUE 0xCED48 Kw_Wu8 1.000 OneToOne 0.00 1.000 FORMAT "%5.3" EXTENDED_LIMITS 0.00 255.0 /end CHARACTERISTIC
/begin CHARACTERISTIC EGT_swtTempOutrDes_C "Schalter für kundenspezifischen Sollwert (äußerer Regelkreis)" VALUE 0xCED49 Kw_Wu8 1.000 OneToOne 0.00 1.000 FORMAT "%5.3" EXTENDED_LIMITS 0.00 255.0 /end CHARACTERISTIC
/begin CHARACTERISTIC EGT_swtTempTurbPre_C "Schalter für Umschaltung Temperatur vor Turbine" VALUE 0xCED4A Kw_Wu8 1.000 OneToOne 0.00 1.000 FORMAT "%5.3" EXTENDED_LIMITS 0.00 255.0 /end CHARACTERISTIC
/begin CHARACTERISTIC EGT_tiHiLoTempGvnr_C "Entprellzeit der Aktivierungsschwellen (high -> low) der Reglerkreise" VALUE 0xCF264 Kw_Wu16 30.00000 Time_s 0.00 30.00000 FORMAT "%8.5" EXTENDED_LIMITS 0.00 655.3500 /end CHARACTERISTIC
/begin CHARACTERISTIC EGT_tiLoHiTempGvnr_C "Entprellzeit für Aktivierungsschwellen (low -> high) der Reglerkreise" VALUE 0xCF266 Kw_Wu16 30.00000 Time_s 0.00 30.00000 FORMAT "%8.5" EXTENDED_LIMITS 0.00 655.3500 /end CHARACTERISTIC
/begin CHARACTERISTIC EGT_tInrCorTempGvnrMax_MAP "Maximal erlaubte Sollwertkorrektur des inneren Regelkreises" MAP 0xCE8BA Kf_Xs16_Ys16_Ws16 1600.000 TempDiff_Cels -100.0000 1500.000 FORMAT "%8.3" EXTENDED_LIMITS -3276.800 3276.700
 /begin AXIS_DESCR STD_AXIS Eng_nAvrg EngN 16 0.00 6000.000 FORMAT "%8.3" EXTENDED_LIMITS -32768.00 32767.00 DEPOSIT ABSOLUTE /end AXIS_DESCR
 /begin AXIS_DESCR STD_AXIS InjCtl_qSetUnBal InjMassCyc 16 0.00 327.6700 FORMAT "%8.4" EXTENDED_LIMITS -327.6800 327.6700 DEPOSIT ABSOLUTE /end AXIS_DESCR
/end CHARACTERISTIC
/begin CHARACTERISTIC EGT_tInrCorTempGvnrMin_MAP "Minimal erlaubte Sollwertkorrektur des inneren Regelkreises" MAP 0xCEAFE Kf_Xs16_Ys16_Ws16 1500.000 TempDiff_Cels -1500.000 0.00 FORMAT "%8.3" EXTENDED_LIMITS -3276.800 3276.700
 /begin AXIS_DESCR STD_AXIS Eng_nAvrg EngN 16 0.00 6000.000 FORMAT "%8.3" EXTENDED_LIMITS -32768.00 32767.00 DEPOSIT ABSOLUTE /end AXIS_DESCR
 /begin AXIS_DESCR STD_AXIS InjCtl_qSetUnBal InjMassCyc 16 0.00 327.6700 FORMAT "%8.4" EXTENDED_LIMITS -327.6800 327.6700 DEPOSIT ABSOLUTE /end AXIS_DESCR
/end CHARACTERISTIC
/begin CHARACTERISTIC EGT_tInrDesTempTurb_CUR "Sollwertkorrektur des inneren Regelkreises in Abhängigkeit der Temperatur vor Turbolader" CURVE 0xCED4C Kl_Xs16_Ws16 1600.000 TempDiff_Cels -100.0000 1500.000 FORMAT "%8.3" EXTENDED_LIMITS -3276.800 3276.700
 /begin AXIS_DESCR STD_AXIS PFlt_tTurbPre Temp_Cels 8 -50.140 899.860 FORMAT "%8.3" EXTENDED_LIMITS -3549.940 3003.560 DEPOSIT ABSOLUTE /end AXIS_DESCR
/end CHARACTERISTIC
/begin CHARACTERISTIC EGT_tInrDes_MAP "Grundwert der Solltemperatur des inneren Regelkreises" MAP 0xCED6E Kf_Xs16_Ys16_Ws16 950.000 Temp_Cels -50.140 899.860 FORMAT "%8.3" EXTENDED_LIMITS -3549.940 3003.560
 /begin AXIS_DESCR STD_AXIS Eng_nAvrg EngN 16 0.00 6000.000 FORMAT "%8.3" EXTENDED_LIMITS -32768.00 32767.00 DEPOSIT ABSOLUTE /end AXIS_DESCR
 /begin AXIS_DESCR STD_AXIS InjCtl_qSetUnBal InjMassCyc 16 0.00 327.6700 FORMAT "%8.4" EXTENDED_LIMITS -327.6800 327.6700 DEPOSIT ABSOLUTE /end AXIS_DESCR
/end CHARACTERISTIC
/begin CHARACTERISTIC EGT_tInrThresDwn_C "Untere Temperaturschwelle des inneren Regelkreises" VALUE 0xCF268 Kw_Ws16 950.000 Temp_Cels -50.140 899.860 FORMAT "%8.3" EXTENDED_LIMITS -3549.940 3003.560 /end CHARACTERISTIC
/begin CHARACTERISTIC EGT_tInrThresUp_C "Obere Temperaturschwelle des inneren Regelkreises" VALUE 0xCF26A Kw_Ws16 950.000 Temp_Cels -50.140 899.860 FORMAT "%8.3" EXTENDED_LIMITS -3549.940 3003.560 /end CHARACTERISTIC
/begin CHARACTERISTIC EGT_tiPoI1TThres_C "Wartezeit für Freigabe PoI1" VALUE 0xCED44 Kw_Wu32 100.000000000 Time_s 0.00 100.000000000 FORMAT "%13.9" EXTENDED_LIMITS 0.00 42949672.9500 /end CHARACTERISTIC
/begin CHARACTERISTIC EGT_tiPoI2TempGvnr_MAP "Additive angle correction of the close post injection" MAP 0xCF35A Kf_Xs16_Ys16_Ws16 18000.00 InjTime_us -13000.00 5000.00 FORMAT "%8.2" EXTENDED_LIMITS -32768.00 32767.00
 /begin AXIS_DESCR STD_AXIS Eng_nAvrg EngN 8 0.00 6000.000 FORMAT "%8.3" EXTENDED_LIMITS -32768.00 32767.00 DEPOSIT ABSOLUTE /end AXIS_DESCR
 /begin AXIS_DESCR STD_AXIS InjCtl_qSetUnBal InjMassCyc 8 0.00 327.6700 FORMAT "%8.4" EXTENDED_LIMITS -327.6800 327.6700 DEPOSIT ABSOLUTE /end AXIS_DESCR
/end CHARACTERISTIC
/begin CHARACTERISTIC EGT_tiPoIHiLoTempGvnr_C "Entprellzeit für Nacheinspritzung (high -> low)" VALUE 0xCF26C Kw_Wu16 30.00000 Time_s 0.00 30.00000 FORMAT "%8.5" EXTENDED_LIMITS 0.00 655.3500 /end CHARACTERISTIC
/begin CHARACTERISTIC EGT_tiPoILoHiTempGvnr_C "Entprellzeit für Nacheinspritzung (low -> high)" VALUE 0xCF26E Kw_Wu16 30.00000 Time_s 0.00 30.00000 FORMAT "%8.5" EXTENDED_LIMITS 0.00 655.3500 /end CHARACTERISTIC
/begin CHARACTERISTIC EGT_tiRgnOilDilMax_C "Maximalschwelle für kritische Ölverdünnungszeit" VALUE 0xCD5D8 Kw_Wu32 500.000000000 Time_s 0.00 500.000000000 FORMAT "%13.9" EXTENDED_LIMITS 0.00 42949672.9500 /end CHARACTERISTIC
/begin CHARACTERISTIC EGT_tiRgnOilDilSubs_C "EEPROM Ersatzwert für kritische Ölverdünnungszeit" VALUE 0xCD5DC Kw_Wu32 500.000000000 Time_s 0.00 500.000000000 FORMAT "%13.9" EXTENDED_LIMITS 0.00 42949672.9500 /end CHARACTERISTIC
/begin CHARACTERISTIC EGT_tiRmpSlpMax_C "Maximale Rampenlaufzeit für EGT-Mehrfachschalter" VALUE 0xCD5E0 Kw_Wu32 15.391030303030304 TimeEGTRmp 0.99296969696969695 16.384000000000000 FORMAT "%19.16" EXTENDED_LIMITS 0.000000015258789066052715 65.536000000000001 /end CHARACTERISTIC
/begin CHARACTERISTIC EGT_tiRmpSlpTempGvnr_C "Rampenzeit für Temperaturregler" VALUE 0xCF400 Kw_Wu32 31.775030303030302 TimeEGTRmp 0.99296969696969695 32.768000000000001 FORMAT "%19.16" EXTENDED_LIMITS 0.000000015258789066052715 65.536000000000001 /end CHARACTERISTIC
/begin CHARACTERISTIC EGT_tOutrDesMflO2_CUR "Sollwertkorrektur des äußeren Regelkreises in Abhängigkeit des Sauerstoffmasssenstromes" CURVE 0xCEFB2 Kl_Xs16_Ws16 1600.000 TempDiff_Cels -100.0000 1500.000 FORMAT "%8.3" EXTENDED_LIMITS -3276.800 3276.700
 /begin AXIS_DESCR STD_AXIS PFlt_dmO2Aprx AirMassPerTime 8 0.00 300.0000 FORMAT "%8.4" EXTENDED_LIMITS -3276.800 3276.700 DEPOSIT ABSOLUTE /end AXIS_DESCR
/end CHARACTERISTIC
/begin CHARACTERISTIC EGT_tOutrDesMsSot_CUR "Sollwertkorrektur des äußeren Regelkreises in Abhängigkeit der Rußmassenbeladung des Partikelfilters" CURVE 0xCEFD4 Kl_Xs16_Ws16 1600.000 TempDiff_Cels -100.0000 1500.000 FORMAT "%8.3" EXTENDED_LIMITS -3276.800 3276.700
 /begin AXIS_DESCR STD_AXIS PFlt_mSot mSoot_g 8 0.00 300.0000 FORMAT "%8.4" EXTENDED_LIMITS -327.6800 327.6700 DEPOSIT ABSOLUTE /end AXIS_DESCR
/end CHARACTERISTIC
/begin CHARACTERISTIC EGT_tOutrDesTempPst_CUR "Sollwertkorrektur in Abhängigkeit der Temperatur unterhalb Oxidationskatalysator" CURVE 0xCEFF6 Kl_Xs16_Ws16 1600.000 TempDiff_Cels -100.0000 1500.000 FORMAT "%8.3" EXTENDED_LIMITS -3276.800 3276.700
 /begin AXIS_DESCR STD_AXIS PFlt_tOxiPst Temp_Cels 8 -50.140 899.860 FORMAT "%8.3" EXTENDED_LIMITS -3549.940 3003.560 DEPOSIT ABSOLUTE /end AXIS_DESCR
/end CHARACTERISTIC
/begin CHARACTERISTIC EGT_tOutrDes_MAP "Grundsollwert des äußeren Regelkreises" MAP 0xCF018 Kf_Xs16_Ys16_Ws16 950.000 Temp_Cels -50.140 899.860 FORMAT "%8.3" EXTENDED_LIMITS -3549.940 3003.560
 /begin AXIS_DESCR STD_AXIS Eng_nAvrg EngN 16 0.00 6000.000 FORMAT "%8.3" EXTENDED_LIMITS -32768.00 32767.00 DEPOSIT ABSOLUTE /end AXIS_DESCR
 /begin AXIS_DESCR STD_AXIS InjCtl_qSetUnBal InjMassCyc 16 0.00 327.6700 FORMAT "%8.4" EXTENDED_LIMITS -327.6800 327.6700 DEPOSIT ABSOLUTE /end AXIS_DESCR
/end CHARACTERISTIC
/begin CHARACTERISTIC EGT_tOutrThresDwn_C "Untere Temperaturschwelle des äußeren Regelkreises" VALUE 0xCF270 Kw_Ws16 950.000 Temp_Cels -50.140 899.860 FORMAT "%8.3" EXTENDED_LIMITS -3549.940 3003.560 /end CHARACTERISTIC
/begin CHARACTERISTIC EGT_tOutrThresUp_C "Obere Temperaturschwelle des äußeren Regelkreises" VALUE 0xCF272 Kw_Ws16 950.000 Temp_Cels -50.140 899.860 FORMAT "%8.3" EXTENDED_LIMITS -3549.940 3003.560 /end CHARACTERISTIC
/begin CHARACTERISTIC EGT_tOxiPreThresBrn_C "Untere Schwelle Temperatur vor Oxidationskatalysator des äußeren Regelkreises" VALUE 0xCF274 Kw_Ws16 950.000 Temp_Cels -50.140 899.860 FORMAT "%8.3" EXTENDED_LIMITS -3549.940 3003.560 /end CHARACTERISTIC
/begin CHARACTERISTIC EngM_ctOfsCaSCrS_C "#SSD Anzahl von Interrupts mit CaS/CrS Verdrehung (> EngM_phiDelta_C) im WAIT_PHASE State bis Verdreherkennung" VALUE 0xCF490 Kw_Wu8 255.0 default 0.00 255.0 FORMAT "%5.1" /end CHARACTERISTIC
/begin CHARACTERISTIC EngM_ctPhWhlRev_C "#SSD Anzahl von Phasenradumdrehungen bis zum Abbruch der Plausibilitätsprüfung" VALUE 0xCF491 Kw_Wu8 255.0 default 0.00 255.0 FORMAT "%5.1" /end CHARACTERISTIC
/begin CHARACTERISTIC EngM_ctPostSync_C "#SSD Anzahl statischer Interrupts bis zum Verlassen des Zustands POST" VALUE 0xCF492 Kw_Wu8 255.0 default 0.00 255.0 FORMAT "%5.1" /end CHARACTERISTIC
/begin CHARACTERISTIC EngM_ctReSync_C "#SSD Max. Anzahl von Versuchen das System umzusynchronisieren" VALUE 0xCF493 Kw_Wu8 255.0 default 0.00 255.0 FORMAT "%5.1" /end CHARACTERISTIC
/begin CHARACTERISTIC EngM_ctSpdtoZero_C "#SSD Anzahl Timeoutinterrupts bis Motordrehzahl  = Null" VALUE 0xCF4B8 Kw_Wu16 65535.00 OneToOne 0.00 65535.00 FORMAT "%8.2" /end CHARACTERISTIC
/begin CHARACTERISTIC EngM_ctVerSync_C "#SSD Anzahl der MAIN, PILOT, UPDATE, SEGMENT  Interrupts zur Plausibilisierung der Nockenwelle mit der Kurbelwelle" VALUE 0xCF494 Kw_Wu8 255.0 default 0.00 255.0 FORMAT "%5.1" /end CHARACTERISTIC
/begin CHARACTERISTIC EngM_tiDebEngMntCtlDia1Def_C "" VALUE 0xCF4CC Kw_Wu16 655350.0 Time_ms 0.00 655350.0 FORMAT "%8.1" /end CHARACTERISTIC
/begin CHARACTERISTIC EngM_tiDebEngMntCtlDia1Ok_C "" VALUE 0xCF4CE Kw_Wu16 655350.0 Time_ms 0.00 655350.0 FORMAT "%8.1" /end CHARACTERISTIC
/begin CHARACTERISTIC EngM_tiDebEngMntCtlDia2Def_C "" VALUE 0xCF4D0 Kw_Wu16 655350.0 Time_ms 0.00 655350.0 FORMAT "%8.1" /end CHARACTERISTIC
/begin CHARACTERISTIC EngM_tiDebEngMntCtlDia2Ok_C "" VALUE 0xCF4D2 Kw_Wu16 655350.0 Time_ms 0.00 655350.0 FORMAT "%8.1" /end CHARACTERISTIC
/begin CHARACTERISTIC EngM_tiDebEngMntCtlDia3Def_C "" VALUE 0xCF4D4 Kw_Wu16 655350.0 Time_ms 0.00 655350.0 FORMAT "%8.1" /end CHARACTERISTIC
/begin CHARACTERISTIC EngM_tiDebEngMntCtlDia3Ok_C "" VALUE 0xCF4D6 Kw_Wu16 655350.0 Time_ms 0.00 655350.0 FORMAT "%8.1" /end CHARACTERISTIC
/begin CHARACTERISTIC EngM_tiDebEngMntCtlDia4Def_C "" VALUE 0xCF4D8 Kw_Wu16 655350.0 Time_ms 0.00 655350.0 FORMAT "%8.1" /end CHARACTERISTIC
/begin CHARACTERISTIC EngM_tiDebEngMntCtlDia4Ok_C "" VALUE 0xCF4DA Kw_Wu16 655350.0 Time_ms 0.00 655350.0 FORMAT "%8.1" /end CHARACTERISTIC
/begin CHARACTERISTIC EngM_tiDebEngMntCtlDia5Def_C "" VALUE 0xCF4DC Kw_Wu16 655350.0 Time_ms 0.00 655350.0 FORMAT "%8.1" /end CHARACTERISTIC
/begin CHARACTERISTIC EngM_tiDebEngMntCtlDia5Ok_C "" VALUE 0xCF4DE Kw_Wu16 655350.0 Time_ms 0.00 655350.0 FORMAT "%8.1" /end CHARACTERISTIC
/begin CHARACTERISTIC EngM_tiDebEngMntCtlDia6Def_C "" VALUE 0xCF4E0 Kw_Wu16 655350.0 Time_ms 0.00 655350.0 FORMAT "%8.1" /end CHARACTERISTIC
/begin CHARACTERISTIC EngM_tiDebEngMntCtlDia6Ok_C "" VALUE 0xCF4E2 Kw_Wu16 655350.0 Time_ms 0.00 655350.0 FORMAT "%8.1" /end CHARACTERISTIC
/begin CHARACTERISTIC EngM_DebExcTemp1Def_C "" VALUE 0xCF4E4 Kw_Wu16 655350.0 Time_ms 0.00 655350.0 FORMAT "%8.1" /end CHARACTERISTIC
/begin CHARACTERISTIC EngM_DebExcTemp1Ok_C "" VALUE 0xCF4E6 Kw_Wu16 655350.0 Time_ms 0.00 655350.0 FORMAT "%8.1" /end CHARACTERISTIC
/begin CHARACTERISTIC EngM_DebExcTempDef_C "time for final defect detection  of excess temperature error" VALUE 0xCF4E8 Kw_Wu16 655350.0 Time_ms 0.00 655350.0 FORMAT "%8.1" /end CHARACTERISTIC
/begin CHARACTERISTIC EngM_DebExcTempOk_C "time for healing the excess temperature error" VALUE 0xCF4EA Kw_Wu16 655350.0 Time_ms 0.00 655350.0 FORMAT "%8.1" /end CHARACTERISTIC
/begin CHARACTERISTIC EngM_DebIncCaSErrSigDef_C "#SSD Inkrementdefektentprellung  für Nockenwellen-Signalstörung" VALUE 0xCF4BA Kw_Wu16 65535.00 OneToOne 0.00 65535.00 FORMAT "%8.2" /end CHARACTERISTIC
/begin CHARACTERISTIC EngM_DebIncCaSErrSigOK_C "#SSD Inkrementheilungsentprellung bis NW-Position gueltig" VALUE 0xCF4BC Kw_Wu16 65535.00 OneToOne 0.00 65535.00 FORMAT "%8.2" /end CHARACTERISTIC
/begin CHARACTERISTIC EngM_DebIncCaSNoSigDef_C "#SSD Inkrementdefektentprellung für Nockenwellen-Signalausfall" VALUE 0xCF4BE Kw_Wu16 65535.00 OneToOne 0.00 65535.00 FORMAT "%8.2" /end CHARACTERISTIC
/begin CHARACTERISTIC EngM_DebIncCrSErrSigDef_C "#SSD Inkrementdefektentprellung für gestörtes Kurbelwellen-Signal" VALUE 0xCF4C0 Kw_Wu16 65535.00 OneToOne 0.00 65535.00 FORMAT "%8.2" /end CHARACTERISTIC
/begin CHARACTERISTIC EngM_DebIncCrSErrSigOK_C "#SSD Inkrementheilungsprellung für gestörtes Kurbelwellen-Signal" VALUE 0xCF4C2 Kw_Wu16 65535.00 OneToOne 0.00 65535.00 FORMAT "%8.2" /end CHARACTERISTIC
/begin CHARACTERISTIC EngM_DebIncOfsSigCaSCrSDef_C "#SSD Inkremententprellung zur Unterdrückung doppelter Fehlereinträge von Signal Störung / Verdrehung" VALUE 0xCF4C4 Kw_Wu16 65535.00 OneToOne 0.00 65535.00 FORMAT "%8.2" /end CHARACTERISTIC
/begin CHARACTERISTIC EngM_DebNoLoad1Def_C "" VALUE 0xCF4EC Kw_Wu16 655350.0 Time_ms 0.00 655350.0 FORMAT "%8.1" /end CHARACTERISTIC
/begin CHARACTERISTIC EngM_DebNoLoad1Ok_C "" VALUE 0xCF4EE Kw_Wu16 655350.0 Time_ms 0.00 655350.0 FORMAT "%8.1" /end CHARACTERISTIC
/begin CHARACTERISTIC EngM_DebNoLoadDef_C "time for final defect of no load error" VALUE 0xCF4F0 Kw_Wu16 655350.0 Time_ms 0.00 655350.0 FORMAT "%8.1" /end CHARACTERISTIC
/begin CHARACTERISTIC EngM_DebNoLoadOk_C "time for healing the no load error" VALUE 0xCF4F2 Kw_Wu16 655350.0 Time_ms 0.00 655350.0 FORMAT "%8.1" /end CHARACTERISTIC
/begin CHARACTERISTIC EngM_DebPhCrSErrSigDef_C "#SSD Entprellung des Kurbelwellensignalausfalls über die Anzahl von Nockenwellenzaehnen" VALUE 0xCF4C6 Kw_Wu16 65535.00 OneToOne 0.00 65535.00 FORMAT "%8.2" /end CHARACTERISTIC
/begin CHARACTERISTIC EngM_DebShortCircBat1Def_C "" VALUE 0xCF4F4 Kw_Wu16 655350.0 Time_ms 0.00 655350.0 FORMAT "%8.1" /end CHARACTERISTIC
/begin CHARACTERISTIC EngM_DebShortCircBat1Ok_C "" VALUE 0xCF4F6 Kw_Wu16 655350.0 Time_ms 0.00 655350.0 FORMAT "%8.1" /end CHARACTERISTIC
/begin CHARACTERISTIC EngM_DebShortCircBatDef_C "time for final  maximum defect detection" VALUE 0xCF4F8 Kw_Wu16 655350.0 Time_ms 0.00 655350.0 FORMAT "%8.1" /end CHARACTERISTIC
/begin CHARACTERISTIC EngM_DebShortCircBatOk_C "time for healing maximum error" VALUE 0xCF4FA Kw_Wu16 655350.0 Time_ms 0.00 655350.0 FORMAT "%8.1" /end CHARACTERISTIC
/begin CHARACTERISTIC EngM_DebShortCircGnd1Def_C "" VALUE 0xCF4FC Kw_Wu16 655350.0 Time_ms 0.00 655350.0 FORMAT "%8.1" /end CHARACTERISTIC
/begin CHARACTERISTIC EngM_DebShortCircGnd1Ok_C "" VALUE 0xCF4FE Kw_Wu16 655350.0 Time_ms 0.00 655350.0 FORMAT "%8.1" /end CHARACTERISTIC
/begin CHARACTERISTIC EngM_DebShortCircGndDef_C "time for final defect detection for short circuit to ground" VALUE 0xCF500 Kw_Wu16 655350.0 Time_ms 0.00 655350.0 FORMAT "%8.1" /end CHARACTERISTIC
/begin CHARACTERISTIC EngM_DebShortCircGndOk_C "time for healing the short circuit to ground error" VALUE 0xCF502 Kw_Wu16 655350.0 Time_ms 0.00 655350.0 FORMAT "%8.1" /end CHARACTERISTIC
/begin CHARACTERISTIC EngM_dLimitCond_ASD_CA "#SSD Abschrankbedingung fuer die ASD-Task" VAL_BLK 0xCF468 Kwb_Wu8 255.0 OneToOne 0.00 255.0 FORMAT "%5.1" NUMBER 3 /end CHARACTERISTIC
/begin CHARACTERISTIC EngM_dLimitCond_Common_CA "#SSD Abschrankbedingung fuer die Common-Task" VAL_BLK 0xCF46B Kwb_Wu8 255.0 OneToOne 0.00 255.0 FORMAT "%5.1" NUMBER 3 /end CHARACTERISTIC
/begin CHARACTERISTIC EngM_dLimitCond_FBC_CA "#SSD Abschrankbedingung fuer die FBC-Task" VAL_BLK 0xCF46E Kwb_Wu8 255.0 OneToOne 0.00 255.0 FORMAT "%5.1" NUMBER 3 /end CHARACTERISTIC
/begin CHARACTERISTIC EngM_dLimitCond_Joint_CA "#SSD Abschrankbedingung fuer die Joint-Task" VAL_BLK 0xCF471 Kwb_Wu8 255.0 OneToOne 0.00 255.0 FORMAT "%5.1" NUMBER 3 /end CHARACTERISTIC
/begin CHARACTERISTIC EngM_dLimitCond_LiGov_CA "#SSD Abschrankbedingung fuer die LiGov-Task" VAL_BLK 0xCF474 Kwb_Wu8 255.0 OneToOne 0.00 255.0 FORMAT "%5.1" NUMBER 3 /end CHARACTERISTIC
/begin CHARACTERISTIC EngM_dLimitCond_Pilot_CA "#SSD Abschrankbedingung fuer die Pilot-Task" VAL_BLK 0xCF477 Kwb_Wu8 255.0 OneToOne 0.00 255.0 FORMAT "%5.1" NUMBER 3 /end CHARACTERISTIC
/begin CHARACTERISTIC EngM_dtrqFrcPDiffUp_C "Negative Rampensteigung für Umschaltung auf Drehmomentverlust bei erkanntem Systemfehler" VALUE 0xCF774 Kw_Wu32 6553649.99847 RmpTrq -50.0000000000 6553599.99847 FORMAT "%13.5" EXTENDED_LIMITS 0.00 6553599.99847 /end CHARACTERISTIC
/begin CHARACTERISTIC EngM_dtrqFrcPDiffDwn_C "Negative Rampensteigung für Umschaltung auf Drehmomentverlust bei geheiltem Systemfehler" VALUE 0xCF778 Kw_Wu32 6553649.99847 RmpTrq -50.0000000000 6553599.99847 FORMAT "%13.5" EXTENDED_LIMITS 0.00 6553599.99847 /end CHARACTERISTIC
/begin CHARACTERISTIC EngM_facT1Reliabl_C "Multiplikationsfaktor für Zuverlässigkeitsbestimmung der Reibmomentenadaption" VALUE 0xCF9E8 Kw_Wu8 255.0 OneToOne 0.00 255.0 FORMAT "%5.1" /end CHARACTERISTIC
/begin CHARACTERISTIC EngM_facTrqFrcPDiff_CUR "Faktor zur Korrektur Momentenverlust aufgrund Differenzdruck über Partikelfilter nach Einbau eines Partikelfilters" CURVE 0xCF77C Kl_Xs16_Ws16 512.0000 Fact1 -256.0000 256.0000 FORMAT "%8.4" EXTENDED_LIMITS -256.0000 255.9922
 /begin AXIS_DESCR STD_AXIS Eng_nAvrg EngN 8 0.00 5000.000 FORMAT "%8.3" EXTENDED_LIMITS -32768.00 32767.00 DEPOSIT ABSOLUTE /end AXIS_DESCR
/end CHARACTERISTIC
/begin CHARACTERISTIC EngM_tiFltACoff_C "Adaptionsfilterzeitkonstante für Zustand ""Klima aus"" der Reibmomentenadaption" VALUE 0xCF9EC Kw_Wu32 4294.9673 TimeDelay_s 0.0000010000000 4294.9673 FORMAT "%9.4" /end CHARACTERISTIC
/begin CHARACTERISTIC EngM_tiFltACon_C "Adaptionsfilterzeitkonstante für Zustand ""Klima an"" der Reibmomentenadaption" VALUE 0xCF9F0 Kw_Wu32 4294.9673 TimeDelay_s 0.0000010000000 4294.9673 FORMAT "%9.4" /end CHARACTERISTIC
/begin CHARACTERISTIC EngM_HldCurr_MAP "" MAP 0xCF504 Kf_Xs16_Ys16_Ws16 655.3500 DtyCyc -327.6800 327.6700 FORMAT "%8.4"
 /begin AXIS_DESCR STD_AXIS BattCD_u Volt_Batt 6 0.00 28602.15 FORMAT "%8.2" EXTENDED_LIMITS -640625.6 640606.1 DEPOSIT ABSOLUTE /end AXIS_DESCR
 /begin AXIS_DESCR STD_AXIS Eng_tEng Temp_Cels 15 -50.14000 199.8600 FORMAT "%8.4" EXTENDED_LIMITS -3549.940 3003.560 DEPOSIT ABSOLUTE /end AXIS_DESCR
/end CHARACTERISTIC
/begin CHARACTERISTIC EngM_nAvrgHysDelta_C "speed threshold for calculating Hysterisis lower limit" VALUE 0xCF5E6 Kw_Ws16 6000.000 EngN 0.00 6000.000 FORMAT "%8.3" EXTENDED_LIMITS -32768.00 32767.00 /end CHARACTERISTIC
/begin CHARACTERISTIC EngM_nAvrgHysHigh_CUR "curve for max. cutout speed = f ( engine-temp. )" CURVE 0xCF5E8 Kl_Xs16_Ws16 6000.000 EngN 0.00 6000.000 FORMAT "%8.3" EXTENDED_LIMITS -32768.00 32767.00
 /begin AXIS_DESCR STD_AXIS Eng_tEng Temp_Cels 25 -50.14000 199.8600 FORMAT "%8.4" EXTENDED_LIMITS -3549.940 3003.560 DEPOSIT ABSOLUTE /end AXIS_DESCR
/end CHARACTERISTIC
/begin CHARACTERISTIC EngM_nAvrgLim_C "Engine speed limiting  value" VALUE 0xCF64E Kw_Ws16 6000.000 EngN 0.00 6000.000 FORMAT "%8.3" EXTENDED_LIMITS -32768.00 32767.00 /end CHARACTERISTIC
/begin CHARACTERISTIC EngM_nLimitInj_C "#SSD Drehzahlschwelle zur Abschrankung der Mengen- und Ansteuerbeginnberechnung" VALUE 0xCF47A Kw_Wu16 6000.000 EngN 0.00 6000.000 FORMAT "%8.3" EXTENDED_LIMITS 0.00 65535.00 /end CHARACTERISTIC
/begin CHARACTERISTIC EngM_nLimitThreshHyst_CA "#SSD Hysteresebreite der Abschrankdrehzahl" VAL_BLK 0xCF47C Kwb_Wu16 600.0000 EngN 0.00 600.0000 FORMAT "%8.4" EXTENDED_LIMITS 0.00 65535.00 NUMBER 3 /end CHARACTERISTIC
/begin CHARACTERISTIC EngM_nLimitThresh_CA "#SSD Drehzahlschwellen zur Taskabschrankung" VAL_BLK 0xCF482 Kwb_Wu16 6000.000 EngN 0.00 6000.000 FORMAT "%8.3" EXTENDED_LIMITS 0.00 65535.00 NUMBER 3 /end CHARACTERISTIC
/begin CHARACTERISTIC EngM_nLISetDiffOffs_C "Maximale zulässige Leerlaufreglerabweichung für Reibmomentenadaption" VALUE 0xCF9F4 Kw_Wu16 50.00000 EngN 0.00 50.00000 FORMAT "%8.5" EXTENDED_LIMITS 0.00 65535.00 /end CHARACTERISTIC
/begin CHARACTERISTIC EngM_nMaxStrtBackUp_C "#SSD Max. Drehzahl für Start nur mit Nockenwellensignal" VALUE 0xCF4C8 Kw_Ws16 300.0000 EngN 900.0000 1200.000 FORMAT "%8.3" EXTENDED_LIMITS -32768.00 32767.00 /end CHARACTERISTIC
/begin CHARACTERISTIC EngM_nMaxStrt_C "#SSD Motordrehzahl unterhalb dieser Schwelle; Einspritzung für redundanten Start mit Kurbelwelle ist erlaubt" VALUE 0xCF496 Kw_Ws16 65535.00 EngN -32768.00 32767.00 FORMAT "%8.2" /end CHARACTERISTIC
/begin CHARACTERISTIC EngM_nMinDiag_C "#SSD Nockenwellendiagnose ab minimale Motordrehzahl" VALUE 0xC048C Kw_Ws16 480.0000 EngN 20.00000 500.0000 FORMAT "%8.4" EXTENDED_LIMITS -32768.00 32767.00 /end CHARACTERISTIC
/begin CHARACTERISTIC EngM_nSwtCoMa_C "#SSD Schwellendrehzahl für die Umschaltung der Aufrufreihenfolge von Common- und MainInj-Task" VALUE 0xCF488 Kw_Wu16 6000.000 EngN 0.00 6000.000 FORMAT "%8.3" EXTENDED_LIMITS 0.00 65535.00 /end CHARACTERISTIC
/begin CHARACTERISTIC EngM_numDiaOut1_C "" VALUE 0xCF650 Kw_Wu8 34.0000000000 NumPinDia 0.00 34.0000000000 FORMAT "%13.10" /end CHARACTERISTIC
/begin CHARACTERISTIC EngM_numDiaOut2_C "" VALUE 0xCF651 Kw_Wu8 34.0000000000 NumPinDia 0.00 34.0000000000 FORMAT "%13.10" /end CHARACTERISTIC
/begin CHARACTERISTIC EngM_numLimitInj_C "#SSD Berechnungshäufigkeit bei aktiver Abschrankung der Mengen- und Ansteuerbeginnberechnung" VALUE 0xCF48A Kw_Wu8 9.000 OneToOne 1.000 10.00 FORMAT "%5.2" EXTENDED_LIMITS 0.00 255.0 /end CHARACTERISTIC
/begin CHARACTERISTIC EngM_numPin_C "#SSD Zuordnungstabelle phyikalischer Zylinder zu SG-Endstufe (SG-Pin)" VAL_BLK 0xC0470 Kwb_Wu8 255.0 OneToOne 0.00 255.0 FORMAT "%5.1" NUMBER 6 /end CHARACTERISTIC
/begin CHARACTERISTIC EngM_numPwmOut1_C "" VALUE 0xCF652 Kw_Wu8 12.0000000000 NumPinPwmOut 0.00 12.0000000000 FORMAT "%13.10" /end CHARACTERISTIC
/begin CHARACTERISTIC EngM_numPwmOut2_C "" VALUE 0xCF653 Kw_Wu8 12.0000000000 NumPinPwmOut 0.00 12.0000000000 FORMAT "%13.10" /end CHARACTERISTIC
/begin CHARACTERISTIC EngM_numTrqFrc_C "Parameter für die Auswahl einer Motortemperatur aus dem Temperaturfeld Eng_tFld für die Reibmomentenberechnung" VALUE 0xCF79E Kw_Wu8 2.00000000000 EngTempFldSel 0.00 2.00000000000 FORMAT "%13.11" /end CHARACTERISTIC
/begin CHARACTERISTIC EngM_nWaitIncSig_C "#SSD Inkrementdrehzahl ab der das Signal im Start ausgeblendet wird" VALUE 0xCF498 Kw_Ws16 6000.000 EngN 0.00 6000.000 FORMAT "%8.3" EXTENDED_LIMITS -32768.00 32767.00 /end CHARACTERISTIC
/begin CHARACTERISTIC EngM_phiDelayPhNoSig_C "#SSD Winkelverzoegerung für die Erkennung kein Nockenwellensignal" VALUE 0xCF49A Kw_Ws16 720.0000 AngleCrS 0.00 720.0000 FORMAT "%8.4" EXTENDED_LIMITS -768.0000 767.9766 /end CHARACTERISTIC
/begin CHARACTERISTIC EngM_phiDeltaExtSync_C "#SSD Toleranz zwischen Kurbelwelle und Nockenwelle bei freigeschalteten CAN-Synchronisation" VALUE 0xCF49C Kw_Ws16 720.0000 AngleCrS 0.00 720.0000 FORMAT "%8.4" EXTENDED_LIMITS -768.0000 767.9766 /end CHARACTERISTIC
/begin CHARACTERISTIC EngM_phiDelta_C "#SSD Toleranz zwischen Kurbelwelle und Nockenwelle" VALUE 0xCF49E Kw_Ws16 720.0000 AngleCrS 0.00 720.0000 FORMAT "%8.4" EXTENDED_LIMITS -768.0000 767.9766 /end CHARACTERISTIC
/begin CHARACTERISTIC EngM_phiFrstInjInt_C "#SSD Position des ersten Interrupts vor OT zur Berechnung der ersten Einspritzung" VALUE 0xCF4A0 Kw_Ws16 0.00 AngleCrS 739.9922 739.9922 FORMAT "%8.4" EXTENDED_LIMITS -768.0000 767.9766 /end CHARACTERISTIC
/begin CHARACTERISTIC EngM_phiInt_C "#SSD Positionen der stat. Interrupts vor jedem OT" VAL_BLK 0xCF4A2 Kwb_Ws16 720.0000 AngleCrS 0.00 720.0000 FORMAT "%8.4" EXTENDED_LIMITS -768.0000 767.9766 NUMBER 5 /end CHARACTERISTIC
/begin CHARACTERISTIC EngM_phiMax_C "#SSD Max. physikalischer Winkel im System" VALUE 0xC0478 Kw_Ws32 360.000000000 AngleCrS 360.000000000 720.000000000 FORMAT "%13.9" EXTENDED_LIMITS -50331648.0000 50331647.9766 /end CHARACTERISTIC
/begin CHARACTERISTIC EngM_phiTDC_C "#SSD Vektor der OT-Winkel aller Zylinder" VAL_BLK 0xC047C Kwb_Ws16 720.0000 AngleCrS 0.00 720.0000 FORMAT "%8.4" EXTENDED_LIMITS -768.0000 767.9766 NUMBER 6 /end CHARACTERISTIC
/begin CHARACTERISTIC EngM_stInvOut1_C "" VALUE 0xCF654 Kw_Wu8 1.000 OneToOne 0.00 1.000 FORMAT "%5.3" EXTENDED_LIMITS 0.00 255.0 /end CHARACTERISTIC
/begin CHARACTERISTIC EngM_tiPer1_C "" VALUE 0xCF656 Kw_Ws16 6553.500 Period -3276.800 3276.700 FORMAT "%8.3" /end CHARACTERISTIC
/begin CHARACTERISTIC EngM_stInvOut2_C "" VALUE 0xCF658 Kw_Wu8 1.000 OneToOne 0.00 1.000 FORMAT "%5.3" EXTENDED_LIMITS 0.00 255.0 /end CHARACTERISTIC
/begin CHARACTERISTIC EngM_tiPer2_C "" VALUE 0xCF65A Kw_Ws16 6553.500 Period -3276.800 3276.700 FORMAT "%8.3" /end CHARACTERISTIC
/begin CHARACTERISTIC EngM_RetCurr_MAP "" MAP 0xCF65C Kf_Xs16_Ys16_Ws16 655.3500 DtyCyc -327.6800 327.6700 FORMAT "%8.4"
 /begin AXIS_DESCR STD_AXIS BattCD_u Volt_Batt 6 0.00 28602.15 FORMAT "%8.2" EXTENDED_LIMITS -640625.6 640606.1 DEPOSIT ABSOLUTE /end AXIS_DESCR
 /begin AXIS_DESCR STD_AXIS Eng_tEng Temp_Cels 15 -50.14000 199.8600 FORMAT "%8.4" EXTENDED_LIMITS -3549.940 3003.560 DEPOSIT ABSOLUTE /end AXIS_DESCR
/end CHARACTERISTIC
/begin CHARACTERISTIC EngM_rTst1_C "" VALUE 0xCF73E Kw_Ws16 100.0000 DtyCyc 0.00 100.0000 FORMAT "%8.4" EXTENDED_LIMITS -327.6800 327.6700 /end CHARACTERISTIC
/begin CHARACTERISTIC EngM_rTst_C "" VALUE 0xCF740 Kw_Ws16 100.0000 DtyCyc 0.00 100.0000 FORMAT "%8.4" EXTENDED_LIMITS -327.6800 327.6700 /end CHARACTERISTIC
/begin CHARACTERISTIC EngM_stBackUpVar_C "#SSD Variante: 0->Wechsel in BU-mode erfolgt bei einen Timeout von CrSCD  1->Wechsel erfolgt sobald Fehlerpf. CrS1 gesetzt ist" VALUE 0xCF4CA Kw_Wu8 1.000 OneToOne 0.00 1.000 FORMAT "%5.3" EXTENDED_LIMITS 0.00 255.0 /end CHARACTERISTIC
/begin CHARACTERISTIC EngM_stChkPN_C "Auswahlschalter:  Abfrage P/N-Status für Adaptionsfreigabe" VALUE 0xCF9F6 Kw_Wu8 1.000 OneToOne 0.00 1.000 FORMAT "%5.3" EXTENDED_LIMITS 0.00 255.0 /end CHARACTERISTIC
/begin CHARACTERISTIC EngM_stDigInvOut_C "Digital output signal invert information for EngM_EngMntCtl" VALUE 0xCF742 Kw_Wu8 1.000 OneToOne 0.00 1.000 FORMAT "%5.3" EXTENDED_LIMITS 0.00 255.0 /end CHARACTERISTIC
/begin CHARACTERISTIC EngM_stEnaBackUp_C "#SSD Schalter zur Aktivierung des Betriebsmodus nur mit Nockenwellensignal" VALUE 0xCF4CB Kw_Wu8 1.000 OneToOne 0.00 1.000 FORMAT "%5.3" EXTENDED_LIMITS 0.00 255.0 /end CHARACTERISTIC
/begin CHARACTERISTIC EngM_stOutHard_C "Hard control Bearing" VALUE 0xCF743 Kw_Wu8 1.000 OneToOne 0.00 1.000 FORMAT "%5.3" EXTENDED_LIMITS 0.00 255.0 /end CHARACTERISTIC
/begin CHARACTERISTIC EngM_stOutSoft_C "soft control Bearing" VALUE 0xCF744 Kw_Wu8 1.000 OneToOne 0.00 1.000 FORMAT "%5.3" EXTENDED_LIMITS 0.00 255.0 /end CHARACTERISTIC
/begin CHARACTERISTIC EngM_stSyncBefGap_C "#SSD Synchronisation ohne  Luecke" VALUE 0xCF4AC Kw_Wu8 1.000 OneToOne 0.00 1.000 FORMAT "%5.3" EXTENDED_LIMITS 0.00 255.0 /end CHARACTERISTIC
/begin CHARACTERISTIC EngM_swtExitOfs_C "#SSD Aussprungbedingung aus dem SYNC_OFFSET State" VALUE 0xCF4AD Kw_Wu8 255.0 default 0.00 255.0 FORMAT "%5.1" /end CHARACTERISTIC
/begin CHARACTERISTIC EngM_swtFirSeqFBC_C "#SSD Schalter zur Auswahl der FBC Zählweise" VALUE 0xCF4AE Kw_Wu8 1.000 default 0.00 1.000 FORMAT "%5.3" EXTENDED_LIMITS 0.00 255.0 /end CHARACTERISTIC
/begin CHARACTERISTIC EngM_swtNumCylVal_C "#SSD Zylinderanzahl, bei Applikation nicht verändern" VALUE 0xCF48B Kw_Wu8 0.00 OneToOne 6.000 6.000 FORMAT "%5.3" EXTENDED_LIMITS 0.00 255.0 /end CHARACTERISTIC
/begin CHARACTERISTIC EngM_swtNumCylType_C "#SSD Sw-Schaltertyp für Zylinderanzahl" VALUE 0xCF48C Kw_Wu8 0.00 OneToOne 0.00 0.00 FORMAT "%5.2" EXTENDED_LIMITS 0.00 255.0 /end CHARACTERISTIC
/begin CHARACTERISTIC EngM_swtSyncViaCAN_C "#SSD Ein-, Ausschalten 1/0 der Master-Slave Synchronisation via CAN" VALUE 0xCF4AF Kw_Wu8 1.000 OneToOne 0.00 1.000 FORMAT "%5.3" EXTENDED_LIMITS 0.00 255.0 /end CHARACTERISTIC
/begin CHARACTERISTIC EngM_tAdptMin_C "Minimalmotortemperatur für Reibmomentenadaption" VALUE 0xCF9F8 Kw_Wu16 950.000 Temp_Cels -50.140 899.860 FORMAT "%8.3" EXTENDED_LIMITS -273.1400 6280.360 /end CHARACTERISTIC
/begin CHARACTERISTIC EngM_tEngMax_C "" VALUE 0xCF746 Kw_Ws16 250.0000 Temp_Cels -50.1400 199.8600 FORMAT "%8.4" EXTENDED_LIMITS -3549.940 3003.560 /end CHARACTERISTIC
/begin CHARACTERISTIC EngM_tEngMin_C "" VALUE 0xCF748 Kw_Ws16 250.00000 Temp_Cels -50.14000 199.86000 FORMAT "%8.5" EXTENDED_LIMITS -3549.940 3003.560 /end CHARACTERISTIC
/begin CHARACTERISTIC EngM_tiBtwTst1_C "" VALUE 0xCF74A Kw_Wu16 29980.00 Time_ms 20.00000 30000.00 FORMAT "%8.2" EXTENDED_LIMITS 0.00 655350.0 /end CHARACTERISTIC
/begin CHARACTERISTIC EngM_tiBtwTst_C "" VALUE 0xCF74C Kw_Wu16 29980.00 Time_ms 20.00000 30000.00 FORMAT "%8.2" EXTENDED_LIMITS 0.00 655350.0 /end CHARACTERISTIC
/begin CHARACTERISTIC EngM_tiCpuTimeOut_C "#SSD CPU timeout Periode" VALUE 0xC0488 Kw_Wu32 100000.000000 TimeDT 0.00 100000.000000 FORMAT "%13.6" EXTENDED_LIMITS 0.00 4294967295.00 /end CHARACTERISTIC
/begin CHARACTERISTIC EngM_tiDiag1Max_C "" VALUE 0xCF74E Kw_Wu16 655350.0 Time_ms 0.00 655350.0 FORMAT "%8.1" /end CHARACTERISTIC
/begin CHARACTERISTIC EngM_tiDiag1Min_C "" VALUE 0xCF750 Kw_Wu16 655350.0 Time_ms 0.00 655350.0 FORMAT "%8.1" /end CHARACTERISTIC
/begin CHARACTERISTIC EngM_tiDiag2Max_C "" VALUE 0xCF752 Kw_Wu16 655350.0 Time_ms 0.00 655350.0 FORMAT "%8.1" /end CHARACTERISTIC
/begin CHARACTERISTIC EngM_tiDiag2Min_C "" VALUE 0xCF754 Kw_Wu16 655350.0 Time_ms 0.00 655350.0 FORMAT "%8.1" /end CHARACTERISTIC
/begin CHARACTERISTIC EngM_tiDiag3Max_C "" VALUE 0xCF756 Kw_Wu16 655350.0 Time_ms 0.00 655350.0 FORMAT "%8.1" /end CHARACTERISTIC
/begin CHARACTERISTIC EngM_tiDiag3Min_C "" VALUE 0xCF758 Kw_Wu16 655350.0 Time_ms 0.00 655350.0 FORMAT "%8.1" /end CHARACTERISTIC
/begin CHARACTERISTIC EngM_tiDiag4Max_C "" VALUE 0xCF75A Kw_Wu16 655350.0 Time_ms 0.00 655350.0 FORMAT "%8.1" /end CHARACTERISTIC
/begin CHARACTERISTIC EngM_tiDiag4Min_C "" VALUE 0xCF75C Kw_Wu16 655350.0 Time_ms 0.00 655350.0 FORMAT "%8.1" /end CHARACTERISTIC
/begin CHARACTERISTIC EngM_tiDiag5Max_C "" VALUE 0xCF75E Kw_Wu16 655350.0 Time_ms 0.00 655350.0 FORMAT "%8.1" /end CHARACTERISTIC
/begin CHARACTERISTIC EngM_tiDiag5Min_C "" VALUE 0xCF760 Kw_Wu16 655350.0 Time_ms 0.00 655350.0 FORMAT "%8.1" /end CHARACTERISTIC
/begin CHARACTERISTIC EngM_tiDiag6Max_C "" VALUE 0xCF762 Kw_Wu16 655350.0 Time_ms 0.00 655350.0 FORMAT "%8.1" /end CHARACTERISTIC
/begin CHARACTERISTIC EngM_tiDiag6Min_C "" VALUE 0xCF764 Kw_Wu16 655350.0 Time_ms 0.00 655350.0 FORMAT "%8.1" /end CHARACTERISTIC
/begin CHARACTERISTIC EngM_tiDiffInt_C "#SSD Minimaler Abstand swischen zwei stat. Interrupts" VALUE 0xCF4B0 Kw_Wu32 1228361874.73 TimeSys_us 0.00 1228361874.73 FORMAT "%13.2" /end CHARACTERISTIC
/begin CHARACTERISTIC EngM_tiEngMntCtl_C "" VALUE 0xCF766 Kw_Wu16 655.3500 Time_s 0.00 655.3500 FORMAT "%8.4" /end CHARACTERISTIC
/begin CHARACTERISTIC EngM_tiHardAftrGear_C "time after which the ramp is activated for gear state" VALUE 0xCF768 Kw_Wu16 655.3500 Time_s 0.00 655.3500 FORMAT "%8.4" /end CHARACTERISTIC
/begin CHARACTERISTIC EngM_tiRelAdpt_C "Entprellzeit für Übergang NO_ADAPT --> ADAPT der Reibmomentenadaption" VALUE 0xCF9FA Kw_Wu16 655350.0 TimeDeb 0.00 655350.0 FORMAT "%8.1" /end CHARACTERISTIC
/begin CHARACTERISTIC EngM_tiSoftAftrStrt_C "time after which the ramp is activated for engine state" VALUE 0xCF76A Kw_Wu16 655.3500 Time_s 0.00 655.3500 FORMAT "%8.4" /end CHARACTERISTIC
/begin CHARACTERISTIC EngM_tiWaitIncSig_C "#SSD Zeit zum Ausblenden des Inkrementsignals im Start" VALUE 0xCF4B4 Kw_Wu16 20000.00 Time_ms 0.00 20000.00 FORMAT "%8.2" EXTENDED_LIMITS 0.00 655350.0 /end CHARACTERISTIC
/begin CHARACTERISTIC EngM_trqFrcPDiffMin_C "untere Begrenzung Momentenverlust aufgrund Differenzdruck über Partikelfilter" VALUE 0xCF7A0 Kw_Ws16 600.0000 Trq -300.0000 300.0000 FORMAT "%8.4" EXTENDED_LIMITS -3276.800 3276.700 /end CHARACTERISTIC
/begin CHARACTERISTIC EngM_trqFrc_Vector "#SSD Bypass Label für EngM_trqFrc (nicht verändern !)" VALUE 0xC2D54 Kw_Wu8 255.0 OneToOne 0.00 255.0 FORMAT "%5.1" /end CHARACTERISTIC
/begin CHARACTERISTIC EngM_trqFrc_Channel "#SSD Bypass Label for EngM_trqFrc (nicht verändern !)" VALUE 0xC2D55 Kw_Wu8 255.0 OneToOne 0.00 255.0 FORMAT "%5.1" /end CHARACTERISTIC
/begin CHARACTERISTIC EngM_trqFrc_MAP "Schleppkennfeld, Reibkennfeld" MAP 0xCF7A2 Kf_Xs16_Ys16_Ws16 6553.500 Trq -3276.800 3276.700 FORMAT "%8.3"
 /begin AXIS_DESCR STD_AXIS Eng_nAvrg EngN 16 0.00 32767.00 FORMAT "%8.2" EXTENDED_LIMITS -32768.00 32767.00 DEPOSIT ABSOLUTE /end AXIS_DESCR
 /begin AXIS_DESCR STD_AXIS EngM_tTrqFrc_mp Temp_Cels 16 -50.140 899.860 FORMAT "%8.3" EXTENDED_LIMITS -3549.940 3003.560 DEPOSIT ABSOLUTE /end AXIS_DESCR
/end CHARACTERISTIC
/begin CHARACTERISTIC EngM_uBattMax_C "" VALUE 0xCF76C Kw_Ws16 5200.391 Volt 0.00 5200.391 FORMAT "%8.3" EXTENDED_LIMITS -160156.4 160151.5 /end CHARACTERISTIC
/begin CHARACTERISTIC EngM_uBattMin_C "" VALUE 0xCF76E Kw_Ws16 5200.391 Volt 0.00 5200.391 FORMAT "%8.3" EXTENDED_LIMITS -160156.4 160151.5 /end CHARACTERISTIC
/begin CHARACTERISTIC EngM_vLimRefuse_C "Schwellgeschwindigkeit für Zustandsübergang REFUSE_ADAPT --> NO_ADAPT der Reibmomentenadaption" VALUE 0xCF9FC Kw_Wu16 655.3500 Vel 0.00 655.3500 FORMAT "%8.4" /end CHARACTERISTIC
/begin CHARACTERISTIC EngM_vThresAdpt_C "vehicle speed threshold for release of adaption" VALUE 0xCF9FE Kw_Wu16 655.3500 Vel 0.00 655.3500 FORMAT "%8.4" /end CHARACTERISTIC
/begin CHARACTERISTIC EngM_vVSSCDHysHigh_C "high threshold for vechile speed hysteresis" VALUE 0xCF770 Kw_Ws16 300.0000 Vel 0.00 300.0000 FORMAT "%8.4" EXTENDED_LIMITS -327.6800 327.6700 /end CHARACTERISTIC
/begin CHARACTERISTIC EngM_vVSSCDHysLow_C "low threshold for vechile speed hysteresis" VALUE 0xCF772 Kw_Ws16 300.0000 Vel 0.00 300.0000 FORMAT "%8.4" EXTENDED_LIMITS -327.6800 327.6700 /end CHARACTERISTIC
/begin CHARACTERISTIC EngPrt_dTrqLimUp_C "ramp slope up" VALUE 0xCFA00 Kw_Wu32 6553594.99817 RmpTrq 5.00030517578 6553599.99847 FORMAT "%13.5" EXTENDED_LIMITS 0.00 6553599.99847 /end CHARACTERISTIC
/begin CHARACTERISTIC EngPrt_dTrqLimDown_C "ramp slope down" VALUE 0xCFA04 Kw_Wu32 6553594.99817 RmpTrq 5.00030517578 6553599.99847 FORMAT "%13.5" EXTENDED_LIMITS 0.00 6553599.99847 /end CHARACTERISTIC
/begin CHARACTERISTIC EngPrt_facAPSPrv_MAP "Kennfeld für Überhitzungsschutz in Abhängigkeit des Atmosphärendrucks" MAP 0xCFA08 Kf_Xs16_Ys16_Ws16 3.999878 Fact 0.00 3.999878 FORMAT "%8.6" EXTENDED_LIMITS -4.000000 3.999878
 /begin AXIS_DESCR STD_AXIS APSCD_pVal Pres_hPa 9 -32768.00 32767.00 FORMAT "%8.2" DEPOSIT ABSOLUTE /end AXIS_DESCR
 /begin AXIS_DESCR STD_AXIS Eng_nAvrg EngN 9 0.00 32767.00 FORMAT "%8.2" EXTENDED_LIMITS -32768.00 32767.00 DEPOSIT ABSOLUTE /end AXIS_DESCR
/end CHARACTERISTIC
/begin CHARACTERISTIC EngPrt_facOvhtPrv_MAP "Map for overheating prevention factor of engine" MAP 0xCFAD2 Kf_Xs16_Ys16_Ws16 3.999878 Fact 0.00 3.999878 FORMAT "%8.6" EXTENDED_LIMITS -4.000000 3.999878
 /begin AXIS_DESCR STD_AXIS Eng_tEng Temp_Cels 7 -50.140 899.860 FORMAT "%8.3" EXTENDED_LIMITS -3549.940 3003.560 DEPOSIT ABSOLUTE /end AXIS_DESCR
 /begin AXIS_DESCR STD_AXIS VSSCD_v Vel 7 0.00 327.6700 FORMAT "%8.4" EXTENDED_LIMITS -327.6800 327.6700 DEPOSIT ABSOLUTE /end AXIS_DESCR
/end CHARACTERISTIC
/begin CHARACTERISTIC EngPrt_nOvrSpd_C "#SSD Schwelle für Überdrehzahlerkennung" VALUE 0xCFB54 Kw_Ws16 6000.000 EngN 0.00 6000.000 FORMAT "%8.3" EXTENDED_LIMITS -32768.00 32767.00 /end CHARACTERISTIC
/begin CHARACTERISTIC EngPrt_nTrqShutOff_C "threshold value of engine speed for fly wheel oscillation detection" VALUE 0xCFDB8 Kw_Ws16 6000.000 EngN 0.00 6000.000 FORMAT "%8.3" EXTENDED_LIMITS -32768.00 32767.00 /end CHARACTERISTIC
/begin CHARACTERISTIC EngPrt_pAPSPrvDfl_C "Default-Wert bei Ausfall des Atmosphärendrucksensors" VALUE 0xCFB56 Kw_Ws16 3500.000 Pres_hPa 0.00 3500.000 FORMAT "%8.3" EXTENDED_LIMITS -32768.00 32767.00 /end CHARACTERISTIC
/begin CHARACTERISTIC EngPrt_qOvhtPrv_MAP "Kennfeld Überhitzungsschutz" MAP 0xCFDBE Kf_Xs16_Ys16_Ws16 327.6700 InjMass 0.00 327.6700 FORMAT "%8.4" EXTENDED_LIMITS -327.6800 327.6700
 /begin AXIS_DESCR STD_AXIS Eng_tEng Temp_Cels 2 -50.140 899.860 FORMAT "%8.3" EXTENDED_LIMITS -3549.940 3003.560 DEPOSIT ABSOLUTE /end AXIS_DESCR
 /begin AXIS_DESCR STD_AXIS VSSCD_v Vel 3 0.00 327.6700 FORMAT "%8.4" EXTENDED_LIMITS -327.6800 327.6700 DEPOSIT ABSOLUTE /end AXIS_DESCR
/end CHARACTERISTIC
/begin CHARACTERISTIC EngPrt_qPrtLim_Vector "#SSD Bypass Label, nicht ändern!" VALUE 0xC2D56 Kw_Wu8 255.0 OneToOne 0.00 255.0 FORMAT "%5.1" /end CHARACTERISTIC
/begin CHARACTERISTIC EngPrt_qPrtLim_Channel "#SSD Bypass Label, nicht ändern!" VALUE 0xC2D57 Kw_Wu8 255.0 OneToOne 0.00 255.0 FORMAT "%5.1" /end CHARACTERISTIC
/begin CHARACTERISTIC EngPrt_dtrqUpCBLim_C "Positiv rampensteigung fuer Drehmomentbegrenzung bei Verdichterbypass oeffnen" VALUE 0xCFB58 Kw_Wu32 6553594.99817 RmpTrq 5.00030517578 6553599.99847 FORMAT "%13.5" EXTENDED_LIMITS 0.00 6553599.99847 /end CHARACTERISTIC
/begin CHARACTERISTIC EngPrt_dtrqDwnCBLim_C "Negativ rampensteigung fuer Drehmomentbegrenzung bei Verdichterbypass oeffnen" VALUE 0xCFB5C Kw_Wu32 6553594.99817 RmpTrq 5.00030517578 6553599.99847 FORMAT "%13.5" EXTENDED_LIMITS 0.00 6553599.99847 /end CHARACTERISTIC
/begin CHARACTERISTIC EngPrt_dtrqUpNLim_C "Rampenanstieg von Ersatzkennlinie auf Normalkennlinie der Motordrehzahlbegrenzung" VALUE 0xCFB60 Kw_Wu32 6553594.99817 RmpTrq 5.00030517578 6553599.99847 FORMAT "%13.5" EXTENDED_LIMITS 0.00 6553599.99847 /end CHARACTERISTIC
/begin CHARACTERISTIC EngPrt_dtrqDwnNLim_C "Rampenanstieg von Normalkennlinie zur Ersatzkennlinie der Motordrehzahlbegrenzung" VALUE 0xCFB64 Kw_Wu32 6553594.99817 RmpTrq 5.00030517578 6553599.99847 FORMAT "%13.5" EXTENDED_LIMITS 0.00 6553599.99847 /end CHARACTERISTIC
/begin CHARACTERISTIC EngPrt_rVnDAMax_C "Maximum v/n Verhältnis" VALUE 0xCFB68 Kw_Ws16 0.3276700 VelToN 0.00 0.3276700 FORMAT "%9.7" EXTENDED_LIMITS -0.3276800 0.3276700 /end CHARACTERISTIC
/begin CHARACTERISTIC EngPrt_rVnDAMin_C "Minimum v/n Verhältnis" VALUE 0xCFB6A Kw_Ws16 0.3276700 VelToN 0.00 0.3276700 FORMAT "%9.7" EXTENDED_LIMITS -0.3276800 0.3276700 /end CHARACTERISTIC
/begin CHARACTERISTIC EngPrt_rVnTrqMax_C "Maximum v/n Verhältnis" VALUE 0xCFB6C Kw_Ws16 0.3276700 VelToN 0.00 0.3276700 FORMAT "%9.7" EXTENDED_LIMITS -0.3276800 0.3276700 /end CHARACTERISTIC
/begin CHARACTERISTIC EngPrt_rVnTrqMin_C "Minimum v/n Verhältnis" VALUE 0xCFB6E Kw_Ws16 0.3276700 VelToN 0.00 0.3276700 FORMAT "%9.7" EXTENDED_LIMITS -0.3276800 0.3276700 /end CHARACTERISTIC
/begin CHARACTERISTIC EngPrt_swtTrqGear_CUR "applizierbare Gänge: Wert = 0 nicht aktiv; Wert = 1 aktiv" CURVE 0xCFB70 Kl_Xs16_Ws16 32767.00 OneToOne 0.00 32767.00 FORMAT "%8.2" EXTENDED_LIMITS -32768.00 32767.00
 /begin AXIS_DESCR STD_AXIS Gearbx_stGear OneToOne 8 -1.000 127.0 FORMAT "%5.1" EXTENDED_LIMITS -128.0 127.0 DEPOSIT ABSOLUTE /end AXIS_DESCR
/end CHARACTERISTIC
/begin CHARACTERISTIC EngPrt_trqCBLim1_CUR "Drehmomentbegrenzung bei geoeffnetem Verdichterbypass" CURVE 0xCFB92 Kl_Xs16_Ws16 3276.700 Trq 0.00 3276.700 FORMAT "%8.3" EXTENDED_LIMITS -3276.800 3276.700
 /begin AXIS_DESCR STD_AXIS Eng_nAvrg EngN 20 0.00 32767.00 FORMAT "%8.2" EXTENDED_LIMITS -32768.00 32767.00 DEPOSIT ABSOLUTE /end AXIS_DESCR
/end CHARACTERISTIC
/begin CHARACTERISTIC EngPrt_trqCBLim_CUR "Drehmomentbegrenzung bei geoeffnetem Verdichterbypass" CURVE 0xCFBE4 Kl_Xs16_Ws16 3276.700 Trq 0.00 3276.700 FORMAT "%8.3" EXTENDED_LIMITS -3276.800 3276.700
 /begin AXIS_DESCR STD_AXIS Eng_nAvrg EngN 20 0.00 32767.00 FORMAT "%8.2" EXTENDED_LIMITS -32768.00 32767.00 DEPOSIT ABSOLUTE /end AXIS_DESCR
/end CHARACTERISTIC
/begin CHARACTERISTIC EngPrt_trqLim1_CUR "Momentenbegrenzungskurve für AT mit geschlossener Wandlerkupplung und aktueller Gang muß in EngPrt_swtTrqGear_CUR 1 sein." CURVE 0xCFC36 Kl_Xs16_Ws16 3276.700 Trq 0.00 3276.700 FORMAT "%8.3" EXTENDED_LIMITS -3276.800 3276.700
 /begin AXIS_DESCR STD_AXIS Eng_nAvrg EngN 21 0.00 32767.00 FORMAT "%8.2" EXTENDED_LIMITS -32768.00 32767.00 DEPOSIT ABSOLUTE /end AXIS_DESCR
/end CHARACTERISTIC
/begin CHARACTERISTIC EngPrt_trqLimDA_CUR "Anfahrdrehmomentenbegrenzungskennlinie" CURVE 0xCFC8C Kl_Xs16_Ws16 3276.700 Trq 0.00 3276.700 FORMAT "%8.3" EXTENDED_LIMITS -3276.800 3276.700
 /begin AXIS_DESCR STD_AXIS Eng_nAvrg EngN 21 0.00 32767.00 FORMAT "%8.2" EXTENDED_LIMITS -32768.00 32767.00 DEPOSIT ABSOLUTE /end AXIS_DESCR
/end CHARACTERISTIC
/begin CHARACTERISTIC EngPrt_trqLim_CUR "Kennlinie die Drehmomentbegrenzung (je nach Application inneres oder äußeres Motormoment)" CURVE 0xCFCE2 Kl_Xs16_Ws16 3276.700 Trq 0.00 3276.700 FORMAT "%8.3" EXTENDED_LIMITS -3276.800 3276.700
 /begin AXIS_DESCR STD_AXIS Eng_nAvrg EngN 21 0.00 32767.00 FORMAT "%8.2" EXTENDED_LIMITS -32768.00 32767.00 DEPOSIT ABSOLUTE /end AXIS_DESCR
/end CHARACTERISTIC
/begin CHARACTERISTIC EngPrt_trqNLimSpr_CUR "Kennlinie für Motordrehzahlbegrenzung bei Systemfehler (als Begrenzungsmoment)" CURVE 0xCFD38 Kl_Xs16_Ws16 3276.700 Trq 0.00 3276.700 FORMAT "%8.3" EXTENDED_LIMITS -3276.800 3276.700
 /begin AXIS_DESCR STD_AXIS Eng_nAvrg EngN 10 0.00 32767.00 FORMAT "%8.2" EXTENDED_LIMITS -32768.00 32767.00 DEPOSIT ABSOLUTE /end AXIS_DESCR
/end CHARACTERISTIC
/begin CHARACTERISTIC EngPrt_trqNLim_CUR "Kennlinie für Drehzahlbegrenzung im Normalbetrieb (inneres Motormoment)" CURVE 0xCFD62 Kl_Xs16_Ws16 3276.700 Trq 0.00 3276.700 FORMAT "%8.3" EXTENDED_LIMITS -3276.800 3276.700
 /begin AXIS_DESCR STD_AXIS Eng_nAvrg EngN 21 0.00 32767.00 FORMAT "%8.2" EXTENDED_LIMITS -32768.00 32767.00 DEPOSIT ABSOLUTE /end AXIS_DESCR
/end CHARACTERISTIC
/begin CHARACTERISTIC EngPrt_trqNLim_Vector "#SSD Bypass Label, nicht ändern!" VALUE 0xC2D58 Kw_Wu8 255.0 OneToOne 0.00 255.0 FORMAT "%5.1" /end CHARACTERISTIC
/begin CHARACTERISTIC EngPrt_trqNLim_Channel "#SSD Bypass Label, nicht ändern!" VALUE 0xC2D59 Kw_Wu8 255.0 OneToOne 0.00 255.0 FORMAT "%5.1" /end CHARACTERISTIC
/begin CHARACTERISTIC EngPrt_trqPrtLim_Vector "#SSD Bypass Label, nicht ändern!" VALUE 0xC2D5A Kw_Wu8 255.0 OneToOne 0.00 255.0 FORMAT "%5.1" /end CHARACTERISTIC
/begin CHARACTERISTIC EngPrt_trqPrtLim_Channel "#SSD Bypass Label, nicht ändern!" VALUE 0xC2D5B Kw_Wu8 255.0 OneToOne 0.00 255.0 FORMAT "%5.1" /end CHARACTERISTIC
/begin CHARACTERISTIC Eng_ctEngSpdDiffCalc_C "Anzahl der Drehzahlwerte zur Mittelung" VALUE 0xCF404 Kw_Wu8 4.000 OneToOne 1.000 5.000 FORMAT "%5.3" EXTENDED_LIMITS 0.00 255.0 /end CHARACTERISTIC
/begin CHARACTERISTIC Eng_tiOvrTemp2_C "Zeitverzögerung Übertemperatur 2" VALUE 0xCF464 Kw_Ws16 655.3500 Time_s -327.6800 327.6700 FORMAT "%8.4" /end CHARACTERISTIC
/begin CHARACTERISTIC Eng_tiOvrTemp_C "Zeitverzögerung Übertemperatur 1" VALUE 0xCF466 Kw_Ws16 655.3500 Time_s -327.6800 327.6700 FORMAT "%8.4" /end CHARACTERISTIC
/begin CHARACTERISTIC Eng_tOvrHi2_C "high hysteresis limit for setting of overheat status" VALUE 0xCF406 Kw_Ws16 250.0000 Temp_Cels -50.14000 199.8600 FORMAT "%8.4" EXTENDED_LIMITS -3549.940 3003.560 /end CHARACTERISTIC
/begin CHARACTERISTIC Eng_tOvrHi_C "Obere Hystereseschwelle für Erkennung Übertemperatur" VALUE 0xCF408 Kw_Ws16 250.0000 Temp_Cels -50.14000 199.8600 FORMAT "%8.4" EXTENDED_LIMITS -3549.940 3003.560 /end CHARACTERISTIC
/begin CHARACTERISTIC Eng_tOvrLo2_C "low hysteresis limit for setting of overheat status" VALUE 0xCF40A Kw_Ws16 250.0000 Temp_Cels -50.14000 199.8600 FORMAT "%8.4" EXTENDED_LIMITS -3549.940 3003.560 /end CHARACTERISTIC
/begin CHARACTERISTIC Eng_tOvrLo_C "Untere Hystereseschwelle für Erkennung Übertemperatur" VALUE 0xCF40C Kw_Ws16 250.0000 Temp_Cels -50.14000 199.8600 FORMAT "%8.4" EXTENDED_LIMITS -3549.940 3003.560 /end CHARACTERISTIC
/begin CHARACTERISTIC Eng_trqSpd_CUR "Drehmomentkennlinie" CURVE 0xCF40E Kl_Xs16_Ws16 3276.700 Trq 0.00 3276.700 FORMAT "%8.3" EXTENDED_LIMITS -3276.800 3276.700
 /begin AXIS_DESCR STD_AXIS Eng_nAvrg EngN 21 0.00 6000.000 FORMAT "%8.3" EXTENDED_LIMITS -32768.00 32767.00 DEPOSIT ABSOLUTE /end AXIS_DESCR
/end CHARACTERISTIC
/begin CHARACTERISTIC EngPrt_tiFWOscDetDebDef_C "Debounce time for fly wheel oscillation defect detection" VALUE 0xCFDBA Kw_Wu16 2000.000 TimeDeb 0.00 2000.000 FORMAT "%8.3" EXTENDED_LIMITS 0.00 655350.0 /end CHARACTERISTIC
/begin CHARACTERISTIC EngPrt_tiFWOscDetDebOk_C "Debounce time for fly wheel oscillation defect healing" VALUE 0xCFDBC Kw_Wu16 2000.000 TimeDeb 0.00 2000.000 FORMAT "%8.3" EXTENDED_LIMITS 0.00 655350.0 /end CHARACTERISTIC
/begin MEASUREMENT EBAFCD_stSigOut "source of activation for electrical power stage of EBAFCD output" UBYTE OneToOne 1 100 0.00 255.0 FORMAT "%5.1" ECU_ADDRESS 0x7F881A /end MEASUREMENT
/begin MEASUREMENT EBAFCD_st_mp "Status of Engine Bay Air Flap" UBYTE OneToOne 1 100 0.00 255.0 FORMAT "%5.1" ECU_ADDRESS 0x8FEC48 /end MEASUREMENT
/begin MEASUREMENT EBFCD_stOut "status output of EBFCD" UBYTE OneToOne 1 100 0.00 255.0 FORMAT "%5.1" ECU_ADDRESS 0x7F881B /end MEASUREMENT
/begin MEASUREMENT EBFCD_st_mp "Status of output of EBFCD" UBYTE OneToOne 1 100 0.00 255.0 FORMAT "%5.1" ECU_ADDRESS 0x8FEC49 /end MEASUREMENT
/begin MEASUREMENT EBTSCD_tCIntLin "ECU temperature linearized value" SWORD Temp_Cels 1 100 -50.140 899.860 FORMAT "%8.3" ECU_ADDRESS 0x7F8B96 /end MEASUREMENT
/begin MEASUREMENT EBTSCD_tECU "ECU temperature current value" SWORD Temp_Cels 1 100 -50.140 899.860 FORMAT "%8.3" ECU_ADDRESS 0x7F8B98 /end MEASUREMENT
/begin MEASUREMENT EBTSCD_uRawTECU_mp "Raw sensor voltage" SWORD Volt 1 100 -160156.4 160151.5 FORMAT "%8.1" ECU_ADDRESS 0x8FEC4A /end MEASUREMENT
/begin MEASUREMENT EEPCD_stErrSet "Allgemeiner Fehlerzustand bei der Aktivierung einer Konfiguration" UBYTE OneToOne 1 100 0.00 255.0 FORMAT "%5.1" ECU_ADDRESS 0x7F881C /end MEASUREMENT
/begin MEASUREMENT EEPCD_stMIL "Variant manager default status of MIL lamp" UBYTE OneToOne 1 100 0.00 255.0 FORMAT "%5.1" ECU_ADDRESS 0x7F881D /end MEASUREMENT
/begin MEASUREMENT EGPpCD_stActrOut "status of exhaust gas pressure pipe actuator" UBYTE OneToOne 1 100 0.00 255.0 FORMAT "%5.1" ECU_ADDRESS 0x7F881E /end MEASUREMENT
/begin MEASUREMENT EGPp_dvolSil_mp "Abgasvolumenstrom nach Partikelfilter" SWORD CubMtrPerHr 1 100 -3276.800 3276.700 FORMAT "%8.3" ECU_ADDRESS 0x8FEC4C /end MEASUREMENT
/begin MEASUREMENT EGPp_pPstPFlt "Druckabfall des Abgassystems nach Partikelfilter" SWORD Pres_hPa 1 100 -32768.00 32767.00 FORMAT "%8.2" ECU_ADDRESS 0x7F8B9C /end MEASUREMENT
/begin MEASUREMENT EGPp_pPstPFltMap_mp "Druckabfall nach Partikelfilter aus Kennfeldberechnung" SWORD Pres_hPa 1 100 -32768.00 32767.00 FORMAT "%8.2" ECU_ADDRESS 0x8FEC4E /end MEASUREMENT
/begin MEASUREMENT EGPp_pPstPFltSim_mp "Druckabfall nach Partikelfilter aus Simulation" SWORD Pres_hPa 1 100 -32768.00 32767.00 FORMAT "%8.2" ECU_ADDRESS 0x8FEC50 /end MEASUREMENT
/begin MEASUREMENT EGPp_stLogicOut "Status of Exhaust gas pressure pump" UBYTE OneToOne 1 100 0.00 255.0 FORMAT "%5.1" ECU_ADDRESS 0x7F881F /end MEASUREMENT
/begin MEASUREMENT EGRCD_rCnv_mp "Tastverhältnis  basierend auf dem Ausgang des Abgasrückführreglers" SWORD DtyCyc 1 100 -327.6800 327.6700 FORMAT "%8.4" ECU_ADDRESS 0x8FEC52 /end MEASUREMENT
/begin MEASUREMENT EGRCD_rOut "Tastverhältnis zür Endstufenansteuerung" SWORD DtyCyc 1 100 -327.6800 327.6700 FORMAT "%8.4" ECU_ADDRESS 0x7F8B9E /end MEASUREMENT
/begin MEASUREMENT EGRVlv_rEGR "Ansteuertastverhältnis für ARF-Ventil" SWORD Prc 1 100 -400.0000 399.9878 FORMAT "%8.4" ECU_ADDRESS 0x7F8BA0 /end MEASUREMENT
/begin MEASUREMENT EGRVlv_rEGR2 "Sollwert für Abgasrückführung Coordinator 2" SWORD Prc 1 100 -400.0000 399.9878 FORMAT "%8.4" ECU_ADDRESS 0x7F8BA2 /end MEASUREMENT
/begin MEASUREMENT EGRVlv_rEGR2Byp_mp "measuringpoint2 to be able to read value by ASCET before bypass" SWORD Prc 1 100 -400.0000 399.9878 FORMAT "%8.4" ECU_ADDRESS 0x8FEC54 /end MEASUREMENT
/begin MEASUREMENT EGRVlv_rEGRByp_mp "Bypass-Label, Kopie von EGRVlv_rEGR" SWORD Prc 1 100 -400.0000 399.9878 FORMAT "%8.4" ECU_ADDRESS 0x8FEC56 /end MEASUREMENT
/begin MEASUREMENT EGSys_AlpEGTube_mp "Wärmeübertragungskoeffizient zwischen Abgas und Abgasrohr" SWORD ThermalCoEff 1 100 -3276.800 3276.700 FORMAT "%8.3" ARRAY_SIZE 2 ECU_ADDRESS 0x8FECE0 /end MEASUREMENT
/begin MEASUREMENT EGSys_AlpTubeEnv_mp "Wärmeübertragungskoeffizient zwischen Abgasrohr und Umgebung" SWORD ThermalCoEff 1 100 -3276.800 3276.700 FORMAT "%8.3" ARRAY_SIZE 2 ECU_ADDRESS 0x8FECE4 /end MEASUREMENT
/begin MEASUREMENT EGSys_cndHtEGi_mp "Wärmeleitfähigkeit Abgas im Rohr" SWORD Fact 1 100 -4.000000 3.999878 FORMAT "%8.6" ARRAY_SIZE 2 ECU_ADDRESS 0x8FECE8 /end MEASUREMENT
/begin MEASUREMENT EGSys_cndHtEGo_mp "Wärmeleitfähigkeit Luft ausserhalb des Rohres" SWORD Fact 1 100 -4.000000 3.999878 FORMAT "%8.6" ARRAY_SIZE 2 ECU_ADDRESS 0x8FECEC /end MEASUREMENT
/begin MEASUREMENT EGSys_cpEGLSU_mp "Spezifische Wärmekapazität des Abgases" SWORD SpecificHeat 1 100 -3.276800 3.276700 FORMAT "%8.6" ARRAY_SIZE 1 ECU_ADDRESS 0x8FEC58 /end MEASUREMENT
/begin MEASUREMENT EGSys_cpEGNSC_mp "Spezifische Wärmekapazität Abgas im NSC" SWORD SpecificHeat 1 100 -3.276800 3.276700 FORMAT "%8.6" ECU_ADDRESS 0x8FECA4 /end MEASUREMENT
/begin MEASUREMENT EGSys_cpEGOxiCat_mp "Spezifische Wärmekapazität Abgas im Oxidationskatalysator" SWORD SpecificHeat 1 100 -3.276800 3.276700 FORMAT "%8.6" ECU_ADDRESS 0x8FECAC /end MEASUREMENT
/begin MEASUREMENT EGSys_cpEGTrbn_mp "Spezifische Wärmekapazität Abgas in Turbine" SWORD SpecificHeat 1 100 -3.276800 3.276700 FORMAT "%8.6" ECU_ADDRESS 0x8FECD4 /end MEASUREMENT
/begin MEASUREMENT EGSys_cpEGTube_mp "Spezifsche Wärmekapazität Abgas im Abgasrohr" SWORD SpecificHeat 1 100 -3.276800 3.276700 FORMAT "%8.6" ARRAY_SIZE 2 ECU_ADDRESS 0x8FECF0 /end MEASUREMENT
/begin MEASUREMENT EGSys_ctCldStrtLSU_mp "Zähler für wiederholte Kaltstarts" UBYTE OneToOne 1 100 0.00 255.0 FORMAT "%5.1" ARRAY_SIZE 1 ECU_ADDRESS 0x8FEC5A /end MEASUREMENT
/begin MEASUREMENT EGSys_dmEG "näherungsweiser Abgasmassenstrom" SWORD AirMassPerTime 1 100 -3276.800 3276.700 FORMAT "%8.3" ECU_ADDRESS 0x7F8BA4 /end MEASUREMENT
/begin MEASUREMENT EGSys_dtTube_mp "Temperaturänderung Abgasrohr" SWORD Temp_Kelv_Sec 1 100 -327.6800 327.6700 FORMAT "%8.4" ARRAY_SIZE 2 ECU_ADDRESS 0x8FECF4 /end MEASUREMENT
/begin MEASUREMENT EGSys_dwFlCmb_mp "Wärmestrom durch spät nacheingespritzte Kraftstoffmenge" SLONG Pwr1 1 100 -214748364.800 214748364.700 FORMAT "%13.3" ECU_ADDRESS 0x8FECB0 /end MEASUREMENT
/begin MEASUREMENT EGSys_dwLSU_mp "Abgaswärmestrom an Sondenposition" SWORD Pwr_kW_Sec 1 100 -327.6800 327.6700 FORMAT "%8.4" ARRAY_SIZE 1 ECU_ADDRESS 0x8FEC5C /end MEASUREMENT
/begin MEASUREMENT EGSys_dwTubeIn_mp "Eintretender Wärmestrom Abgasrohr" SLONG Pwr1 1 100 -214748364.800 214748364.700 FORMAT "%13.3" ARRAY_SIZE 2 ECU_ADDRESS 0x8FECF8 /end MEASUREMENT
/begin MEASUREMENT EGSys_dwTubeOut_mp "Austretender Wärmestrom Abgasrohr" SLONG Pwr1 1 100 -214748364.800 214748364.700 FORMAT "%13.3" ARRAY_SIZE 2 ECU_ADDRESS 0x8FED00 /end MEASUREMENT
/begin MEASUREMENT EGSys_dwTube_mp "Wärmeänderung Abgasrohr" SLONG Pwr1 1 100 -214748364.800 214748364.700 FORMAT "%13.3" ARRAY_SIZE 2 ECU_ADDRESS 0x8FED08 /end MEASUREMENT
/begin MEASUREMENT EGSys_etaChrg_mp "Gesamtwirkungsgrad Turbolader" SWORD Fact 1 100 -4.000000 3.999878 FORMAT "%8.6" ECU_ADDRESS 0x8FECD6 /end MEASUREMENT
/begin MEASUREMENT EGSys_facAirMass_mp "Luftmassen-Korrekturfaktor für stationäre Abgaskrümmertemperatur" SWORD Fact 1 100 -4.000000 3.999878 FORMAT "%8.6" ECU_ADDRESS 0x8FEC92 /end MEASUREMENT
/begin MEASUREMENT EGSys_facPT1Chrg_mp "Variabler Faktor für thermische Zeitkonstante Lader" SWORD Fact_PT1 1 100 -256.0000 255.9922 FORMAT "%8.4" ECU_ADDRESS 0x8FECD8 /end MEASUREMENT
/begin MEASUREMENT EGSys_facStrtDlv_mp "Förderbeginn-Korrekturfaktor für stationäre Abgaskrümmertemperatur" SWORD Fact 1 100 -4.000000 3.999878 FORMAT "%8.6" ECU_ADDRESS 0x8FEC94 /end MEASUREMENT
/begin MEASUREMENT EGSys_NuTubeEnv_mp "Nusselt-Zahl Aussenumströmung Abgasrohr" SWORD OneToOne 1 100 -32768.00 32767.00 FORMAT "%8.2" ARRAY_SIZE 2 ECU_ADDRESS 0x8FED10 /end MEASUREMENT
/begin MEASUREMENT EGSys_NuTube_mp "Nusselt-Zahl im Abgasrohr" SWORD OneToOne 1 100 -32768.00 32767.00 FORMAT "%8.2" ARRAY_SIZE 2 ECU_ADDRESS 0x8FED14 /end MEASUREMENT
/begin MEASUREMENT EGSys_pExhGas "Abgasgegendruck" SWORD Pres_hPa 1 100 -32768.00 32767.00 FORMAT "%8.2" ARRAY_SIZE 1 ECU_ADDRESS 0x7F8BA6 /end MEASUREMENT
/begin MEASUREMENT EGSys_phiDiffStrt_mp "Differenz zwischen Förderbeginn im Auslegungspunkt und aktuellem Wert" SWORD AngleCrS 1 100 -768.0000 767.9766 FORMAT "%8.4" ECU_ADDRESS 0x8FEC96 /end MEASUREMENT
/begin MEASUREMENT EGSys_pwrCmpr_mp "Verdichterleistung" SWORD Pwr 1 100 -308831.1 308821.7 FORMAT "%8.1" ECU_ADDRESS 0x8FECDA /end MEASUREMENT
/begin MEASUREMENT EGSys_qMIStd "Vor- und haupteingespritzte Kraftstoffmenge (im Brennraum verbrannt)" SWORD InjMassCyc 1 100 -327.6800 327.6700 FORMAT "%8.4" ECU_ADDRESS 0x7F8BA8 /end MEASUREMENT
/begin MEASUREMENT EGSys_qPoIRgn "Spät nacheingespritzte Kraftstoffmenge (nicht im Brennraum verbrannt)" SWORD InjMassInj 1 100 -327.6800 327.6700 FORMAT "%8.4" ECU_ADDRESS 0x7F8BAA /end MEASUREMENT
/begin MEASUREMENT EGSys_rAirPerTime_mp "Verhältnis Luftmassenstrom im Auslegungspunkt zu aktuellem Wert" SWORD Fact 1 100 -4.000000 3.999878 FORMAT "%8.6" ECU_ADDRESS 0x8FEC98 /end MEASUREMENT
/begin MEASUREMENT EGSys_ReTubeEnvInpCrv_mp "Messpunkt Eingangswert Kurve EGSys_NuTubeEnv_CUR" SWORD OneToOne 1 100 -32768.00 32767.00 FORMAT "%8.2" ECU_ADDRESS 0x8FED18 /end MEASUREMENT
/begin MEASUREMENT EGSys_ReTubeEnv_mp "Reynolds-Zahl Aussenumströmung Abgasrohr" SWORD OneToOne 1 100 -32768.00 32767.00 FORMAT "%8.2" ARRAY_SIZE 2 ECU_ADDRESS 0x8FED1A /end MEASUREMENT
/begin MEASUREMENT EGSys_ReTubeInpCrv_mp "Messpunkt Eingang Kurve EGSys_NuTube_CUR" SWORD ReynoldsNum 1 100 -3276800. 3276700. FORMAT "%8.0" ECU_ADDRESS 0x8FED1E /end MEASUREMENT
/begin MEASUREMENT EGSys_ReTube_mp "Reynolds-Zahl im Abgasrohr" SWORD ReynoldsNum 1 100 -3276800. 3276700. FORMAT "%8.0" ARRAY_SIZE 2 ECU_ADDRESS 0x8FED20 /end MEASUREMENT
/begin MEASUREMENT EGSys_rLmbdAprx "näherungsweiser Lambda-Wert" SWORD lambda 1 100 -32.76800 32.76700 FORMAT "%8.5" ECU_ADDRESS 0x7F8BAC /end MEASUREMENT
/begin MEASUREMENT EGSys_rPresCmpr_mp "Verdichterdruckverhältnis" SWORD Fact 1 100 -4.000000 3.999878 FORMAT "%8.6" ECU_ADDRESS 0x8FECDC /end MEASUREMENT
/begin MEASUREMENT EGSys_rTempClnt_mp "Verhältnis Motorübertemperatur Motorstart / -stop" SWORD Fact 1 100 -4.000000 3.999878 FORMAT "%8.6" ECU_ADDRESS 0x8FECC0 /end MEASUREMENT
/begin MEASUREMENT EGSys_rTimeNSC_mp "Verhältnis Standzeit zu Halbwertszeit NSC" SWORD Fact1 1 100 -256.0000 255.9922 FORMAT "%8.4" ECU_ADDRESS 0x8FECC2 /end MEASUREMENT
/begin MEASUREMENT EGSys_rTimeOxiCat_mp "Verhältnis Standzeit zu Halbwertszeit Oxidationskatalysator" SWORD Fact1 1 100 -256.0000 255.9922 FORMAT "%8.4" ECU_ADDRESS 0x8FECC4 /end MEASUREMENT
/begin MEASUREMENT EGSys_rTimeTrb_mp "Verhältnis-Stillstand-Zeit / Halbzeit-Periode turbocharger" SWORD Fact1 1 100 -256.0000 255.9922 FORMAT "%8.4" ECU_ADDRESS 0x8FECC6 /end MEASUREMENT
/begin MEASUREMENT EGSys_rTimeTube_mp "Verhältnis Standzeit zu Halbwertszeit Abgasrohr" SWORD Fact1 1 100 -256.0000 255.9922 FORMAT "%8.4" ARRAY_SIZE 2 ECU_ADDRESS 0x8FECBC /end MEASUREMENT
/begin MEASUREMENT EGSys_sqTube_mp "Oberfläche Abgasrohr" SWORD Area 1 100 -4.000000 3.999878 FORMAT "%8.6" ARRAY_SIZE 2 ECU_ADDRESS 0x8FED24 /end MEASUREMENT
/begin MEASUREMENT EGSys_stHtgLSU "Statusbit Freigabe Sensor-Heizung" UBYTE OneToOne 1 100 0.00 255.0 FORMAT "%5.1" ARRAY_SIZE 1 ECU_ADDRESS 0x7F8820 /end MEASUREMENT
/begin MEASUREMENT EGSys_stHtgLSULstTrp_mp "Status der Taupunktfreigabe des letzten Fahrzyklus" UBYTE OneToOne 1 100 0.00 255.0 FORMAT "%5.1" ARRAY_SIZE 1 ECU_ADDRESS 0x8FEC5E /end MEASUREMENT
/begin MEASUREMENT EGSys_stHtgThresLSUHit_mp "Statusmessage für Überschreiten des Wärmemengenschwellwertes" UBYTE OneToOne 1 100 0.00 255.0 FORMAT "%5.1" ARRAY_SIZE 1 ECU_ADDRESS 0x8FEC5F /end MEASUREMENT
/begin MEASUREMENT EGSys_stIntegIni_mp "Status Integrator Initialisierung" UBYTE OneToOne 1 100 0.00 255.0 FORMAT "%5.1" ARRAY_SIZE 1 ECU_ADDRESS 0x8FEC60 /end MEASUREMENT
/begin MEASUREMENT EGSys_stPlsLSU_mp "Status-Bit gültiger Gaspuls" UBYTE OneToOne 1 100 0.00 255.0 FORMAT "%5.1" ARRAY_SIZE 1 ECU_ADDRESS 0x8FEC61 /end MEASUREMENT
/begin MEASUREMENT EGSys_tAvrgEGTrbn_mp "Mittlere Abgastemperatur in Turbine" SWORD Temp_Cels 1 100 -50.140 899.860 FORMAT "%8.3" ECU_ADDRESS 0x8FECDE /end MEASUREMENT
/begin MEASUREMENT EGSys_tAvrgEGTube_mp "Mittlere Abgastemperatur im Abgasrohr" SWORD Temp_Cels 1 100 -50.140 899.860 FORMAT "%8.3" ARRAY_SIZE 2 ECU_ADDRESS 0x8FED28 /end MEASUREMENT
/begin MEASUREMENT EGSys_tAvrgNSC_mp "Mittlere Temperatur NSC" SWORD Temp_Cels 1 100 -50.140 899.860 FORMAT "%8.3" ECU_ADDRESS 0x8FECA6 /end MEASUREMENT
/begin MEASUREMENT EGSys_tAvrgOxiCat_mp "Mittlere Temperatur Oxidationskatalysator" SWORD Temp_Cels 1 100 -50.140 899.860 FORMAT "%8.3" ECU_ADDRESS 0x8FECB4 /end MEASUREMENT
/begin MEASUREMENT EGSys_tCorrIAT_mp "Temperaturoffset aufgrund Schwankungen der Ansauglufttemperatur" SWORD TempDiff_Cels 1 100 -3276.800 3276.700 FORMAT "%8.3" ECU_ADDRESS 0x8FEC9A /end MEASUREMENT
/begin MEASUREMENT EGSys_tCorrManf_mp "Temperaturoffset Krümmer bei kaltem Motor" SWORD TempDiff_Cels 1 100 -3276.800 3276.700 FORMAT "%8.3" ECU_ADDRESS 0x8FEC9C /end MEASUREMENT
/begin MEASUREMENT EGSys_tDiffCldEng_mp "Abweichung aktuelle Motortemperatur von stationärem Wert" SWORD TempDiff_Cels 1 100 -3276.800 3276.700 FORMAT "%8.3" ECU_ADDRESS 0x8FEC9E /end MEASUREMENT
/begin MEASUREMENT EGSys_tDiffEGTube_mp "Temperaturdifferenz Abgas / Abgasrohr" SWORD TempDiff_Cels 1 100 -3276.800 3276.700 FORMAT "%8.3" ARRAY_SIZE 2 ECU_ADDRESS 0x8FED2C /end MEASUREMENT
/begin MEASUREMENT EGSys_tDiffIAT_mp "Differenz zwischen Ansaulglufttemperatur im Auslegungspunkt und aktuellem Wert" SWORD TempDiff_Cels 1 100 -3276.800 3276.700 FORMAT "%8.3" ECU_ADDRESS 0x8FECA0 /end MEASUREMENT
/begin MEASUREMENT EGSys_tDiffTubeEnv_mp "Temperaturdifferenz Abgasrohr / Umgebung" SWORD TempDiff_Cels 1 100 -3276.800 3276.700 FORMAT "%8.3" ARRAY_SIZE 2 ECU_ADDRESS 0x8FED30 /end MEASUREMENT
/begin MEASUREMENT EGSys_tEGLSU "Abgas-Temperatur an Sensor-Position" SWORD Temp_Cels 1 100 -50.140 899.860 FORMAT "%8.3" ARRAY_SIZE 1 ECU_ADDRESS 0x7F8BAE /end MEASUREMENT
/begin MEASUREMENT EGSys_tEGLSUInpCrv0_mp "Messpunkt Eingang der Kennlinien" SWORD Temp_Cels 1 100 -50.140 899.860 FORMAT "%8.3" ECU_ADDRESS 0x8FEC6C /end MEASUREMENT
/begin MEASUREMENT EGSys_tEGLSUInpCrv1_mp "Messpunkt Eingang des Kennfeldes EGSys_wTresLSU1_MAP" SWORD Temp_Cels 1 100 -50.140 899.860 FORMAT "%8.3" ECU_ADDRESS 0x8FEC6E /end MEASUREMENT
/begin MEASUREMENT EGSys_tEGLSUInpCrv2_mp "Messpunkt Eingang des Kennfeldes EGSys_wTresLSU2_MAP" SWORD Temp_Cels 1 100 -50.140 899.860 FORMAT "%8.3" ECU_ADDRESS 0x8FEC70 /end MEASUREMENT
/begin MEASUREMENT EGSys_tEGLSUInpCrv3_mp "Messpunkt Eingang des Kennfeldes EGSys_wTresLSU3_MAP" SWORD Temp_Cels 1 100 -50.140 899.860 FORMAT "%8.3" ECU_ADDRESS 0x8FEC72 /end MEASUREMENT
/begin MEASUREMENT EGSys_tEGPreNSC "Abgastemperatur am NSC-Eintritt" SWORD Temp_Cels 1 100 -50.140 899.860 FORMAT "%8.3" ECU_ADDRESS 0x7F8BB0 /end MEASUREMENT
/begin MEASUREMENT EGSys_tEGPreOxiCat "Abgastemperatur am Oxidationskatalysator-Eintritt" SWORD Temp_Cels 1 100 -50.140 899.860 FORMAT "%8.3" ECU_ADDRESS 0x7F8BB2 /end MEASUREMENT
/begin MEASUREMENT EGSys_tEGPreTrbn "Abgas-Temperatur vor Turbine" SWORD Temp_Cels 1 100 -50.140 899.860 FORMAT "%8.3" ECU_ADDRESS 0x7F8BB4 /end MEASUREMENT
/begin MEASUREMENT EGSys_tEGPreTube "Abgastemperatur am Abgasrohr-Eintritt" SWORD Temp_Cels 1 100 -50.140 899.860 FORMAT "%8.3" ARRAY_SIZE 2 ECU_ADDRESS 0x7F9104 /end MEASUREMENT
/begin MEASUREMENT EGSys_tEGPstTrbn "Abgas-Temperatur nach Turbolader" SWORD Temp_Cels 1 100 -50.140 899.860 FORMAT "%8.3" ECU_ADDRESS 0x7F8BB6 /end MEASUREMENT
/begin MEASUREMENT EGSys_tEGPstTube "Abgastemperatur am Abgasrohr-Auslass" SWORD Temp_Cels 1 100 -50.140 899.860 FORMAT "%8.3" ARRAY_SIZE 2 ECU_ADDRESS 0x7F9108 /end MEASUREMENT
/begin MEASUREMENT EGSys_tExcClntStrtCs_mp "Motorübertemperatur bei Motorstart" SWORD TempDiff_Cels 1 100 -3276.800 3276.700 FORMAT "%8.3" ECU_ADDRESS 0x8FECC8 /end MEASUREMENT
/begin MEASUREMENT EGSys_tiClg_mp "Abkühlzeit" ULONG Time_s 1 100 0.00 42949672.9500 FORMAT "%13.4" ECU_ADDRESS 0x8FECCC /end MEASUREMENT
/begin MEASUREMENT EGSys_tIncrPoI_mp "Temperaturerhöhung im Oxidationskatalysator aufgrund später Nacheinspritzung" SWORD TempDiff_Cels 1 100 -3276.800 3276.700 FORMAT "%8.3" ECU_ADDRESS 0x8FECB6 /end MEASUREMENT
/begin MEASUREMENT EGSys_tiRefClg_mp "Referenz-Abkühlzeit aus Motor-Abkühlung" ULONG Time_s 1 100 0.00 42949672.9500 FORMAT "%13.4" ECU_ADDRESS 0x8FECD0 /end MEASUREMENT
/begin MEASUREMENT EGSys_tManfStat "stationäre Abgastemperatur im Abgaskrümmer" SWORD Temp_Cels 1 100 -50.140 899.860 FORMAT "%8.3" ECU_ADDRESS 0x7F8BB8 /end MEASUREMENT
/begin MEASUREMENT EGSys_tManfStat_mp "stationäre Abgastemperatur im Abgaskrümmer ohne Korrekturen" SWORD Temp_Cels 1 100 -50.140 899.860 FORMAT "%8.3" ECU_ADDRESS 0x8FECA2 /end MEASUREMENT
/begin MEASUREMENT EGSys_tMem_mp "Zwischenspeicher für Temperaturen" SWORD Temp_Cels 1 100 -50.140 899.860 FORMAT "%8.3" ARRAY_SIZE 14 ECU_ADDRESS 0x8FEC74 /end MEASUREMENT
/begin MEASUREMENT EGSys_tMidEGTube_mp "Mittlere Temperatur zwischen Abgas und Abgasrohrwand" SWORD Temp_Cels 1 100 -50.140 899.860 FORMAT "%8.3" ARRAY_SIZE 2 ECU_ADDRESS 0x8FED34 /end MEASUREMENT
/begin MEASUREMENT EGSys_tMidTubeEnv_mp "Mittlere Temperatur zwischen Abgasrohr und Umgebung" SWORD Temp_Cels 1 100 -50.140 899.860 FORMAT "%8.3" ARRAY_SIZE 2 ECU_ADDRESS 0x8FED38 /end MEASUREMENT
/begin MEASUREMENT EGSys_tNSC "Temperatur NSC (Austritt)" SWORD Temp_Cels 1 100 -50.140 899.860 FORMAT "%8.3" ECU_ADDRESS 0x7F8BBA /end MEASUREMENT
/begin MEASUREMENT EGSys_tNSCExoIncr_mp "Temperaturerhöhung im NSC durch chemische Reaktionen" SWORD TempDiff_Cels 1 100 -3276.800 3276.700 FORMAT "%8.3" ECU_ADDRESS 0x8FECA8 /end MEASUREMENT
/begin MEASUREMENT EGSys_tNSCStat_mp "Stationäre Temperatur NSC" SWORD Temp_Cels 1 100 -50.140 899.860 FORMAT "%8.3" ECU_ADDRESS 0x8FECAA /end MEASUREMENT
/begin MEASUREMENT EGSys_tNSCStrtCs "Temperatur NSC bei Motorstart" SWORD Temp_Cels 1 100 -50.140 899.860 FORMAT "%8.3" ECU_ADDRESS 0x7F8BBC /end MEASUREMENT
/begin MEASUREMENT EGSys_tOxiCat "Temperatur Oxidationskatalysator (Austritt)" SWORD Temp_Cels 1 100 -50.140 899.860 FORMAT "%8.3" ECU_ADDRESS 0x7F8BBE /end MEASUREMENT
/begin MEASUREMENT EGSys_tOxiCatExoIncr_mp "Temperaturerhöhung im Oxidationskatalysator durch chemische Reaktionen" SWORD TempDiff_Cels 1 100 -3276.800 3276.700 FORMAT "%8.3" ECU_ADDRESS 0x8FECB8 /end MEASUREMENT
/begin MEASUREMENT EGSys_tOxiCatStat_mp "Stationäre Temperatur Oxidationskatalysator" SWORD Temp_Cels 1 100 -50.140 899.860 FORMAT "%8.3" ECU_ADDRESS 0x8FECBA /end MEASUREMENT
/begin MEASUREMENT EGSys_tOxiCatStrtCs "Temperatur Oxidationskatalysator bei Motorstart" SWORD Temp_Cels 1 100 -50.140 899.860 FORMAT "%8.3" ECU_ADDRESS 0x7F8BC0 /end MEASUREMENT
/begin MEASUREMENT EGSys_tShOffTExcClnt_mp "Motorübertemperature bei Motorstop" SWORD TempDiff_Cels 1 100 -3276.800 3276.700 FORMAT "%8.3" ECU_ADDRESS 0x8FEC90 /end MEASUREMENT
/begin MEASUREMENT EGSys_tTrbStrtCs "Turbocharger Temperatur an Maschinenanfang" SWORD Temp_Cels 1 100 -50.140 899.860 FORMAT "%8.3" ECU_ADDRESS 0x7F8BC2 /end MEASUREMENT
/begin MEASUREMENT EGSys_tTube "Wandtemperatur Abgasrohr" SWORD Temp_Cels 1 100 -50.140 899.860 FORMAT "%8.3" ARRAY_SIZE 2 ECU_ADDRESS 0x7F910C /end MEASUREMENT
/begin MEASUREMENT EGSys_tTubeStrtCs "Temperatur Abgasrohr bei Motorstart" SWORD Temp_Cels 1 100 -50.140 899.860 FORMAT "%8.3" ARRAY_SIZE 2 ECU_ADDRESS 0x7F9110 /end MEASUREMENT
/begin MEASUREMENT EGSys_tWallLSU "Wandtemperatur am Sondeneinbauort" SWORD Temp_Cels 1 100 -50.140 899.860 FORMAT "%8.3" ARRAY_SIZE 1 ECU_ADDRESS 0x7F8BC4 /end MEASUREMENT
/begin MEASUREMENT EGSys_wLSU_mp " integrierte Wärmemenge an Sensor-Position." SWORD Energy 1 100 -32768.00 32767.00 FORMAT "%8.2" ARRAY_SIZE 1 ECU_ADDRESS 0x8FEC62 /end MEASUREMENT
/begin MEASUREMENT EGSys_wThresLSUAct_mp "aktueller Wärmeschwellwert an Sensorposition." SWORD Energy 1 100 -32768.00 32767.00 FORMAT "%8.2" ARRAY_SIZE 1 ECU_ADDRESS 0x8FEC64 /end MEASUREMENT
/begin MEASUREMENT EGSys_wThresLSUNoPls_mp "Hitzeschwelle ohne gültigen Gaspuls." SWORD Energy 1 100 -32768.00 32767.00 FORMAT "%8.2" ARRAY_SIZE 1 ECU_ADDRESS 0x8FEC66 /end MEASUREMENT
/begin MEASUREMENT EGSys_wThresLSUPls_mp "Hitzeschwelle für gültigen Gaspuls" SWORD Energy 1 100 -32768.00 32767.00 FORMAT "%8.2" ARRAY_SIZE 1 ECU_ADDRESS 0x8FEC68 /end MEASUREMENT
/begin MEASUREMENT EGSys_wThresLSU_mp "Grundlegender Wert-Hitzeschwelle-Sensor" SWORD Energy 1 100 -32768.00 32767.00 FORMAT "%8.2" ARRAY_SIZE 1 ECU_ADDRESS 0x8FEC6A /end MEASUREMENT
/begin MEASUREMENT EGT_facRmpVal "Zentraler Rampenwert (drehzahlsynchron)" SWORD EGTSwt_S16 1 100 -2.000000 1.999939 FORMAT "%8.6" ECU_ADDRESS 0x7F8BC6 /end MEASUREMENT
/begin MEASUREMENT EGT_facRmpValTempGvnr_mp "aktueller Rampenwert des EGT Temperaturreglers" ULONG EGTSwt 1 100 0.00 262.143999939 FORMAT "%13.9" ECU_ADDRESS 0x8FED78 /end MEASUREMENT
/begin MEASUREMENT EGT_facRmp_mp "Rampenwert für Umwandlung 32bit -> 16bit" SWORD EGTSwt_S16 1 100 -2.000000 1.999939 FORMAT "%8.6" ECU_ADDRESS 0x8FED7C /end MEASUREMENT
/begin MEASUREMENT EGT_mAirDesInrTempGvnr "Additive Luftmassensollwertkorrektur" SWORD AirMassPerCyl 1 100 -3276.800 3276.700 FORMAT "%8.3" ECU_ADDRESS 0x7F8BC8 /end MEASUREMENT
/begin MEASUREMENT EGT_mAirDesTempGvnr "Temperaturreglerkorrektur für den Luftmassensollwert" SWORD AirMassPerCyl 1 100 -3276.800 3276.700 FORMAT "%8.3" ECU_ADDRESS 0x7F8BCA /end MEASUREMENT
/begin MEASUREMENT EGT_mAirLmbdTempGvnr_mp "Luftmassenkorrektur durch Lambda" SWORD AirMassPerCyl 1 100 -3276.800 3276.700 FORMAT "%8.3" ECU_ADDRESS 0x8FED7E /end MEASUREMENT
/begin MEASUREMENT EGT_mAirTempGvnrMin_mp "Minimal mögliche Luftmassensollwertkorrektur" SWORD AirMassPerCyl 1 100 -3276.800 3276.700 FORMAT "%8.3" ECU_ADDRESS 0x8FED4C /end MEASUREMENT
/begin MEASUREMENT EGT_mAirTempGvnrRng_mp "Korrekturbereich der Luftmassensollwertkorrektur" SWORD AirMassPerCyl 1 100 -3276.800 3276.700 FORMAT "%8.3" ECU_ADDRESS 0x8FED4E /end MEASUREMENT
/begin MEASUREMENT EGT_phiPoI1TempGvnr "Additive Winkelkorrektur der verzögerten Nacheinspritzung" SWORD AngleCrS 1 100 -768.0000 767.9766 FORMAT "%8.4" ECU_ADDRESS 0x7F8BCC /end MEASUREMENT
/begin MEASUREMENT EGT_qHCTempGvnr "Additive Einpritzmengenkorrektur des HC-Dosierventils" SWORD InjMassInj 1 100 -327.6800 327.6700 FORMAT "%8.4" ECU_ADDRESS 0x7F8BCE /end MEASUREMENT
/begin MEASUREMENT EGT_qPoI1Min_mp "Minimal erlaubte Korrektur der angelagerten Nacheinspritzung" SWORD InjMassInj 1 100 -327.6800 327.6700 FORMAT "%8.4" ECU_ADDRESS 0x8FED50 /end MEASUREMENT
/begin MEASUREMENT EGT_qPoI1OutrTempGvnr "Additive Korrektur der angelagerten Nacheinspritzung" SWORD InjMassInj 1 100 -327.6800 327.6700 FORMAT "%8.4" ECU_ADDRESS 0x7F8BD0 /end MEASUREMENT
/begin MEASUREMENT EGT_qPoI1Rng_mp "Korrekturbereich der angelagerten Nacheinspritzung" SWORD InjMassInj 1 100 -327.6800 327.6700 FORMAT "%8.4" ECU_ADDRESS 0x8FED52 /end MEASUREMENT
/begin MEASUREMENT EGT_qPoI1TempGvnr "EGT Temperaturregler PoI1 Menge während einer Regeneration" SWORD InjMassInj 1 100 -327.6800 327.6700 FORMAT "%8.4" ECU_ADDRESS 0x7F8BD2 /end MEASUREMENT
/begin MEASUREMENT EGT_qPoI2InrTempGvnr "Additive fortgeschrittene Nacheinspritzmengenkorrektur" SWORD InjMassInj 1 100 -327.6800 327.6700 FORMAT "%8.4" ECU_ADDRESS 0x7F8BD4 /end MEASUREMENT
/begin MEASUREMENT EGT_qPoI2Min_mp "Minimal erlaubte Korrekturmenge der angelagerten Nacheinspritzung" SWORD InjMassInj 1 100 -327.6800 327.6700 FORMAT "%8.4" ECU_ADDRESS 0x8FED54 /end MEASUREMENT
/begin MEASUREMENT EGT_qPoI2Rng_mp "Korrekturbereich der Einpritzmengenkorrektur" SWORD InjMassInj 1 100 -327.6800 327.6700 FORMAT "%8.4" ECU_ADDRESS 0x8FED56 /end MEASUREMENT
/begin MEASUREMENT EGT_qPoI2TempGvnr "EGT Temperaturreglerkorrektur der angelagerten Nacheinspritzung 2 während einer Partikelfilterregeneration" SWORD InjMassInj 1 100 -327.6800 327.6700 FORMAT "%8.4" ECU_ADDRESS 0x7F8BD6 /end MEASUREMENT
/begin MEASUREMENT EGT_rIInrTempGvnr_mp "Reglerausgang des inneren Regelkreises: I-Anteil" SWORD EGTFact 1 100 -32.76800 32.76700 FORMAT "%8.5" ECU_ADDRESS 0x8FED58 /end MEASUREMENT
/begin MEASUREMENT EGT_rInrTempGvnr_mp "Reglerausgang des inneren Regelkreises" SWORD EGTFact 1 100 -32.76800 32.76700 FORMAT "%8.5" ECU_ADDRESS 0x8FED5A /end MEASUREMENT
/begin MEASUREMENT EGT_rIOutrTempGvnr_mp "Reglerausgang der äußeren Regelkreises: I-Anteil" SWORD EGTFact 1 100 -32.76800 32.76700 FORMAT "%8.5" ECU_ADDRESS 0x8FED5C /end MEASUREMENT
/begin MEASUREMENT EGT_rOutrTempGvnr_mp "Regelerausgang des äußeren Regelkreises" SWORD EGTFact 1 100 -32.76800 32.76700 FORMAT "%8.5" ECU_ADDRESS 0x8FED5E /end MEASUREMENT
/begin MEASUREMENT EGT_rPInrTempGvnr_mp "Regelerausgnag des inneren Regelkreises: P-Anteil" SWORD EGTFact 1 100 -32.76800 32.76700 FORMAT "%8.5" ECU_ADDRESS 0x8FED60 /end MEASUREMENT
/begin MEASUREMENT EGT_rPOutrTempGvnr_mp "Reglerausgang des äußeren Regelkreises: P-Anteil" SWORD EGTFact 1 100 -32.76800 32.76700 FORMAT "%8.5" ECU_ADDRESS 0x8FED62 /end MEASUREMENT
/begin MEASUREMENT EGT_rStyInrTempGvnr_mp "Modellierten stationärer Reglerausgang des inneren Regelkreises" SWORD EGTFact 1 100 -32.76800 32.76700 FORMAT "%8.5" ECU_ADDRESS 0x8FED64 /end MEASUREMENT
/begin MEASUREMENT EGT_rStyOutrTempGvnr_mp "Modellierter stationärer Reglerausgang des äußeren Regelkreises" SWORD EGTFact 1 100 -32.76800 32.76700 FORMAT "%8.5" ECU_ADDRESS 0x8FED66 /end MEASUREMENT
/begin MEASUREMENT EGT_st "Regenerationsanforderung für Abgasnachbehandlung (drehzahlsynchron)" ULONG OneToOne 1 100 0.00 4294967295.00 FORMAT "%13.2" ECU_ADDRESS 0x7F9114 /end MEASUREMENT
/begin MEASUREMENT EGT_stClsThrVlv_mp "Maximale Androsselung aktiv" UBYTE OneToOne 1 100 0.00 255.0 FORMAT "%5.1" ECU_ADDRESS 0x8FED68 /end MEASUREMENT
/begin MEASUREMENT EGT_stCoRgn "Innerer Zustand des Regenerationskoordinator (drehzahlsynchron)" UBYTE OneToOne 1 100 0.00 255.0 FORMAT "%5.1" ECU_ADDRESS 0x7F8821 /end MEASUREMENT
/begin MEASUREMENT EGT_stCoRgnOld_mp "Alter Wert für den inneren Zustand des Regenerationkoordinators" UBYTE OneToOne 1 100 0.00 255.0 FORMAT "%5.1" ECU_ADDRESS 0x8FED3C /end MEASUREMENT
/begin MEASUREMENT EGT_stCoRgnTSync "Innerer Zustand des Regenerationskoordinator (zeitsynchron)" UBYTE OneToOne 1 100 0.00 255.0 FORMAT "%5.1" ECU_ADDRESS 0x7F8822 /end MEASUREMENT
/begin MEASUREMENT EGT_stDel "Verzögerte Regenerationsanforderung für Abgasnachbehandlung (drehzahl synchron)" UBYTE OneToOne 1 100 0.00 255.0 FORMAT "%5.1" ECU_ADDRESS 0x7F9118 /end MEASUREMENT
/begin MEASUREMENT EGT_stLck "Status EGT_stTSync-Kopiervorgang (drehzahlsynchron)" UBYTE OneToOne 1 100 0.00 255.0 FORMAT "%5.1" ECU_ADDRESS 0x7F8823 /end MEASUREMENT
/begin MEASUREMENT EGT_stRgnOilDil_mp "Status Bit Bedingungen erfüllt für Ölverdünnung" UBYTE OneToOne 1 100 0.00 255.0 FORMAT "%5.1" ECU_ADDRESS 0x8FED3D /end MEASUREMENT
/begin MEASUREMENT EGT_stTempGvnr "Status des Abgastemperaturreglers" UWORD OneToOne 1 100 0.00 65535.00 FORMAT "%8.2" ECU_ADDRESS 0x7F8BD8 /end MEASUREMENT
/begin MEASUREMENT EGT_stTSync "Regenerationsanforderung für Abgasnachbehandlung (zeitsynchron)" ULONG OneToOne 1 100 0.00 4294967295.00 FORMAT "%13.2" ECU_ADDRESS 0x7F911C /end MEASUREMENT
/begin MEASUREMENT EGT_stTSyncDes_mp "Regeneration demand for exhaust gas treatment for state machine" ULONG OneToOne 1 100 0.00 4294967295.00 FORMAT "%13.2" ECU_ADDRESS 0x8FED40 /end MEASUREMENT
/begin MEASUREMENT EGT_stTSyncLck "Status Kopieren der Regenerationsanforderung (zeit-synchron)" UBYTE OneToOne 1 100 0.00 255.0 FORMAT "%5.1" ECU_ADDRESS 0x7F8824 /end MEASUREMENT
/begin MEASUREMENT EGT_swtRgnLck_mp "Schalter zur Unterdrückung der Regenerationsmaßnahmen" UBYTE OneToOne 1 100 0.00 255.0 FORMAT "%5.1" ECU_ADDRESS 0x8FED44 /end MEASUREMENT
/begin MEASUREMENT EGT_tInrCorMax_mp "Maximal erlaubte Korrektur des inneren Regelkreises" SWORD TempDiff_Cels 1 100 -3276.800 3276.700 FORMAT "%8.3" ECU_ADDRESS 0x8FED6A /end MEASUREMENT
/begin MEASUREMENT EGT_tInrCorRng_mp "Korrekturbereich der Sollwertkorrektur des inneren Regelkreises" SWORD TempDiff_Cels 1 100 -3276.800 3276.700 FORMAT "%8.3" ECU_ADDRESS 0x8FED6C /end MEASUREMENT
/begin MEASUREMENT EGT_tInrDesCorTempGvnr "Solllwertkorrektur der inneren Kaskade" SWORD TempDiff_Cels 1 100 -3276.800 3276.700 FORMAT "%8.3" ECU_ADDRESS 0x7F8BDE /end MEASUREMENT
/begin MEASUREMENT EGT_tInrDesTempGvnr "Sollwert für den inneren Abgastemperaturregelkreis" SWORD Temp_Cels 1 100 -50.140 899.860 FORMAT "%8.3" ECU_ADDRESS 0x7F8BE2 /end MEASUREMENT
/begin MEASUREMENT EGT_tInrDvtTempGvnr_mp "Reglerabweichung des inneren Regelkreises" SWORD TempDiff_Cels 1 100 -3276.800 3276.700 FORMAT "%8.3" ECU_ADDRESS 0x8FED6E /end MEASUREMENT
/begin MEASUREMENT EGT_tInrTempGvnr "Aktueller Wert des inneren Abgastemperaturreglers" SWORD Temp_Cels 1 100 -50.140 899.860 FORMAT "%8.3" ECU_ADDRESS 0x7F8BE4 /end MEASUREMENT
/begin MEASUREMENT EGT_tiPoI1ActvCnt_mp "Wartezeit aktive PoI1" ULONG Time_s 1 100 0.00 42949672.9500 FORMAT "%13.4" ECU_ADDRESS 0x8FED70 /end MEASUREMENT
/begin MEASUREMENT EGT_tiPoI2TempGvnr "Additive close point injection time correction" SWORD InjTime_us 1 100 -32768.00 32767.00 FORMAT "%8.2" ECU_ADDRESS 0x7F8BEC /end MEASUREMENT
/begin MEASUREMENT EGT_tiRgn "Zeit seit letzter Änderung von EGT_st (drehzahlsynchron)" ULONG Time_s 1 100 0.00 42949672.9500 FORMAT "%13.4" ECU_ADDRESS 0x7F9120 /end MEASUREMENT
/begin MEASUREMENT EGT_tiRgnOilDil "Kritische Zeit für Ölverdünnung" ULONG Time_s 1 100 0.00 42949672.9500 FORMAT "%13.4" ECU_ADDRESS 0x7F9124 /end MEASUREMENT
/begin MEASUREMENT EGT_tiRgnTSync "Zeit seit letzter Änderung von EGT_st (zeitsynchron)" ULONG Time_s 1 100 0.00 42949672.9500 FORMAT "%13.4" ECU_ADDRESS 0x7F9128 /end MEASUREMENT
/begin MEASUREMENT EGT_tiRgnTSyncPre_mp "Gesamtzeit seit letzter EGT-Statusänderung" ULONG Time_s 1 100 0.00 42949672.9500 FORMAT "%13.4" ECU_ADDRESS 0x8FED48 /end MEASUREMENT
/begin MEASUREMENT EGT_tiRmpSlpMax "Maximale Rampenlaufzeit für EGT-Mehrfachschalter" ULONG TimeEGTRmp 1 100 0.000000015258789066052715 65.536000000000001 FORMAT "%19.16" ECU_ADDRESS 0x7F912C /end MEASUREMENT
/begin MEASUREMENT EGT_tOutrDesTempGvnr "Sollwert des äußeren Abgastemperaturregelkreises" SWORD Temp_Cels 1 100 -50.140 899.860 FORMAT "%8.3" ECU_ADDRESS 0x7F8BE8 /end MEASUREMENT
/begin MEASUREMENT EGT_tOutrDvtTempGvnr_mp "Reglerabweichung des äußeren Regelkreises" SWORD TempDiff_Cels 1 100 -3276.800 3276.700 FORMAT "%8.3" ECU_ADDRESS 0x8FED74 /end MEASUREMENT
/begin MEASUREMENT EGT_tOutrTempGvnr "Aktueller Wert des äußeren Abgastemperaturregelkreises" SWORD Temp_Cels 1 100 -50.140 899.860 FORMAT "%8.3" ECU_ADDRESS 0x7F8BEA /end MEASUREMENT
/begin MEASUREMENT EngMon_stShOffIrrCmb "Abschaltbotschaft an Abschaltkoordinator auf Grund irregulärer Verbrennung" UBYTE OneToOne 1 100 0.00 255.0 FORMAT "%5.1" ECU_ADDRESS 0x7F8838 /end MEASUREMENT
/begin MEASUREMENT EngM_ctIncErrSigDiagCaSDef_mp "Inkrementezaehlerstand zur Erkennung gestörtes Nockenwellensignal" UWORD OneToOne 1 100 0.00 65535.00 FORMAT "%8.2" ECU_ADDRESS 0x8FED98 /end MEASUREMENT
/begin MEASUREMENT EngM_ctIncErrSigDiagCaSOk_mp "Inkrementezaehlerstand zur Erkennung gestörtes Nockenwellensignal geheilt" UWORD OneToOne 1 100 0.00 65535.00 FORMAT "%8.2" ECU_ADDRESS 0x8FED9A /end MEASUREMENT
/begin MEASUREMENT EngM_ctIncErrSigDiagCrSDef_mp "Inkrementezaehlerstand zur Erkennung eines gestörten Kurbelwellensignal" UWORD OneToOne 1 100 0.00 65535.00 FORMAT "%8.2" ECU_ADDRESS 0x8FED9C /end MEASUREMENT
/begin MEASUREMENT EngM_ctIncErrSigDiagCrSOK_mp "Inkrementezaehlerstand zur Erkennung Kurbelwellensignal ohne Störungen" UWORD OneToOne 1 100 0.00 65535.00 FORMAT "%8.2" ECU_ADDRESS 0x8FED9E /end MEASUREMENT
/begin MEASUREMENT EngM_ctIncErrSigDiagmaxCaSDef_mp "maximaler Inkrementezaehlerstand bei Erkennung gestörtes Nockenwellensignal" UWORD OneToOne 1 100 0.00 65535.00 FORMAT "%8.2" ECU_ADDRESS 0x8FEDA0 /end MEASUREMENT
/begin MEASUREMENT EngM_ctIncErrSigDiagmaxCaSOk_mp "maximaler Inkrementezaehlerstand bei Erkennung gestörtes Nockenwellensignal geheilt" UWORD OneToOne 1 100 0.00 65535.00 FORMAT "%8.2" ECU_ADDRESS 0x8FEDA2 /end MEASUREMENT
/begin MEASUREMENT EngM_ctIncErrSigDiagmaxCrSDef_mp "maximeler Inkrementezaehlerstand bei Erkennung gestörtes Kurbelwellensignal" UWORD OneToOne 1 100 0.00 65535.00 FORMAT "%8.2" ECU_ADDRESS 0x8FEDA4 /end MEASUREMENT
/begin MEASUREMENT EngM_ctIncNoSigDiagCaS_mp "Inkrementezaehlerstand zur Erkennung ausgefallenes Nockenwellensignal" UWORD OneToOne 1 100 0.00 65535.00 FORMAT "%8.2" ECU_ADDRESS 0x8FEDA6 /end MEASUREMENT
/begin MEASUREMENT EngM_ctIncNoSigDiagmaxCaS_mp "maximaler Inkrementezaehlerstand bei Erkennung ausgefallenes Nockenwellensignal" UWORD OneToOne 1 100 0.00 65535.00 FORMAT "%8.2" ECU_ADDRESS 0x8FEDA8 /end MEASUREMENT
/begin MEASUREMENT EngM_ctIntOvrLoad_mp "Anzahl der statischen Interrupts, bei denen der zeitliche Abstand zu kurz ist" UBYTE OneToOne 1 100 0.00 255.0 FORMAT "%5.1" ECU_ADDRESS 0x8FED84 /end MEASUREMENT
/begin MEASUREMENT EngM_ctPhErrSigDiagCrSDef_mp "Anzahl Nockenwellenzaehne zur Erkennung eines gestörten Kurbelwellensignal" UWORD OneToOne 1 100 0.00 65535.00 FORMAT "%8.2" ECU_ADDRESS 0x8FEDAA /end MEASUREMENT
/begin MEASUREMENT EngM_ctPhErrSigDiagmaxCrSDef_mp "maximale Anzahl Nockenwellenzaehne bei Erkennung ausgefallenes Kurbelwellensignal" UWORD OneToOne 1 100 0.00 65535.00 FORMAT "%8.2" ECU_ADDRESS 0x8FEDAC /end MEASUREMENT
/begin MEASUREMENT EngM_ctPostSync_mp "Interruptzähler im State EngM_stSync = 64 (Post-Synchron)" UBYTE OneToOne 1 100 0.00 255.0 FORMAT "%5.1" ECU_ADDRESS 0x8FED85 /end MEASUREMENT
/begin MEASUREMENT EngM_ctReSync_mp "Resynchronisationszähler, wird bei jeder Resynchronisation inkrementiert" UBYTE OneToOne 1 100 0.00 255.0 FORMAT "%5.1" ECU_ADDRESS 0x8FED86 /end MEASUREMENT
/begin MEASUREMENT EngM_ctSpdtoZero_mp "Zähler Timeoutinterrupts bis Motordrehzahl  = Null" ULONG OneToOne 1 100 0.00 4294967295.00 FORMAT "%13.2" ECU_ADDRESS 0x8FEDB0 /end MEASUREMENT
/begin MEASUREMENT EngM_ctVerSync_mp "Verif.zähler der Sync; Anzahl der MAIN, PILOT, UPDATE, SEGMENT Interrupts zur Plaus. der NW mit der KW" UBYTE OneToOne 1 100 0.00 255.0 FORMAT "%5.1" ECU_ADDRESS 0x8FED87 /end MEASUREMENT
/begin MEASUREMENT EngM_nAvrgHysHigh_mp "engine speed hysteresis higher limit" SWORD EngN 1 100 -32768.00 32767.00 FORMAT "%8.2" ECU_ADDRESS 0x8FEDB4 /end MEASUREMENT
/begin MEASUREMENT EngM_nAvrgHysLow_mp "engine speed hysteresis lower limit" SWORD EngN 1 100 -32768.00 32767.00 FORMAT "%8.2" ECU_ADDRESS 0x8FEDB6 /end MEASUREMENT
/begin MEASUREMENT EngM_nDyn "dynamische Drehzahl" SWORD EngN 1 100 -32768.00 32767.00 FORMAT "%8.2" ECU_ADDRESS 0x7F8BFC /end MEASUREMENT
/begin MEASUREMENT EngM_nLISetDiff_mp "Betrag Leerlaufreglerabweichung" SWORD EngN 1 100 -32768.00 32767.00 FORMAT "%8.2" ECU_ADDRESS 0x8FEDC8 /end MEASUREMENT
/begin MEASUREMENT EngM_numCyl "Zylinderanzahl" UBYTE OneToOne 1 100 0.00 255.0 FORMAT "%5.1" ECU_ADDRESS 0x7F8827 /end MEASUREMENT
/begin MEASUREMENT EngM_numInt "Interreupt-Klasse" UBYTE OneToOne 1 100 0.00 255.0 FORMAT "%5.1" ECU_ADDRESS 0x7F8829 /end MEASUREMENT
/begin MEASUREMENT EngM_numLastTDC "Vorhergehender Zünd-OT" UBYTE OneToOne 1 100 0.00 255.0 FORMAT "%5.1" ECU_ADDRESS 0x7F882A /end MEASUREMENT
/begin MEASUREMENT EngM_numRevCnt_mp "Zähler der Kurbelwellenumdrehungen" UWORD OneToOne 1 100 0.00 65535.00 FORMAT "%8.2" ECU_ADDRESS 0x8FED88 /end MEASUREMENT
/begin MEASUREMENT EngM_numSyncTDC "Zylindernummer an dem die Synchronisation erkannt wurde" UBYTE OneToOne 1 100 0.00 255.0 FORMAT "%5.1" ECU_ADDRESS 0x7F882B /end MEASUREMENT
/begin MEASUREMENT EngM_numTDC "Aktueller Zünd-OT" UBYTE OneToOne 1 100 0.00 255.0 FORMAT "%5.1" ECU_ADDRESS 0x7F882C /end MEASUREMENT
/begin MEASUREMENT EngM_phiDiffTDC "Winkel zwischen TDC1 und dem in der Zündreihenfolge nächsten TDC auf diesem Steuergerät" SWORD AngleCrS 1 100 -768.0000 767.9766 FORMAT "%8.4" ECU_ADDRESS 0x7F8BFE /end MEASUREMENT
/begin MEASUREMENT EngM_phiInt "aktuelle Interrupt-Position" SWORD AngleCrS 1 100 -768.0000 767.9766 FORMAT "%8.4" ECU_ADDRESS 0x7F8C00 /end MEASUREMENT
/begin MEASUREMENT EngM_phiIntExt "aktuelle Interrupt-Position, extern vom Master zum Slave über CAN" SWORD AngleCrS 1 100 -768.0000 767.9766 FORMAT "%8.4" ECU_ADDRESS 0x7F8C02 /end MEASUREMENT
/begin MEASUREMENT EngM_phiIntExtCorr_mp "aktuelle Winkelposition an der Masterseite nach der Korrektur im Slave-Steuergerät" SWORD AngleCrS 1 100 -768.0000 767.9766 FORMAT "%8.4" ECU_ADDRESS 0x8FED8A /end MEASUREMENT
/begin MEASUREMENT EngM_phiTDC "OT-Position der aktuellen Zumessung" SWORD AngleCrS 1 100 -768.0000 767.9766 FORMAT "%8.4" ECU_ADDRESS 0x7F8C06 /end MEASUREMENT
/begin MEASUREMENT EngM_rCurrProf_mp "" SWORD DtyCyc 1 100 -327.6800 327.6700 FORMAT "%8.4" ECU_ADDRESS 0x8FEDB8 /end MEASUREMENT
/begin MEASUREMENT EngM_SchedDelta_mp "Sprungweite in der Schedule-Tabelle" UBYTE OneToOne 1 100 0.00 255.0 FORMAT "%5.1" ECU_ADDRESS 0x8FED8C /end MEASUREMENT
/begin MEASUREMENT EngM_SchedIndex_mp "Anzahl der abgearbeiteten Anweisungen der Schedule-Sequenz" UBYTE OneToOne 1 100 0.00 255.0 FORMAT "%5.1" ECU_ADDRESS 0x8FED8D /end MEASUREMENT
/begin MEASUREMENT EngM_SchedLimitInt_mp "Nummer des Abschrankintervalls" UBYTE OneToOne 1 100 0.00 255.0 FORMAT "%5.1" ECU_ADDRESS 0x8FED8E /end MEASUREMENT
/begin MEASUREMENT EngM_SchedSegID_mp "Nummer des Segments vor dem Interrupt" UBYTE OneToOne 1 100 0.00 255.0 FORMAT "%5.1" ECU_ADDRESS 0x8FED8F /end MEASUREMENT
/begin MEASUREMENT EngM_stAdpt "Zustand Reibmomentenadaption" UBYTE OneToOne 1 100 0.00 255.0 FORMAT "%5.1" ECU_ADDRESS 0x7F882D /end MEASUREMENT
/begin MEASUREMENT EngM_stCaSExt "Statusinformation CaSCD_stPhaseSig_mp vom Mastersteuergeraet über CAN" UWORD OneToOne 1 100 0.00 65535.00 FORMAT "%8.2" ECU_ADDRESS 0x7F8C08 /end MEASUREMENT
/begin MEASUREMENT EngM_stCaSVerifyDiag "Statusinformation der Diagnose aus den VERIFY Zustand" UBYTE OneToOne 1 100 0.00 255.0 FORMAT "%5.1" ECU_ADDRESS 0x7F882E /end MEASUREMENT
/begin MEASUREMENT EngM_stEngMntCtl_mp "status of error bit values" UBYTE OneToOne 1 100 0.00 255.0 FORMAT "%5.1" ECU_ADDRESS 0x8FEDBA /end MEASUREMENT
/begin MEASUREMENT EngM_stErrCanExt "CAN-Errorstatus der Botschaft MS_PHI_SNYC extern vom Master mit: EngM_phiIntExt, EngM_stNextExt" UBYTE OneToOne 1 100 0.00 255.0 FORMAT "%5.1" ECU_ADDRESS 0x7F882F /end MEASUREMENT
/begin MEASUREMENT EngM_stEvent "Interruptereignis" UBYTE OneToOne 1 100 0.00 255.0 FORMAT "%5.1" ECU_ADDRESS 0x7F8830 /end MEASUREMENT
/begin MEASUREMENT EngM_stEventEnable_mp "n-synchrone Interrupts freigegeben" UWORD OneToOne 1 100 0.00 65535.00 FORMAT "%8.2" ECU_ADDRESS 0x8FED90 /end MEASUREMENT
/begin MEASUREMENT EngM_stEventServed_mp "Aktuell bediente Interrupts" UWORD OneToOne 1 100 0.00 65535.00 FORMAT "%8.2" ECU_ADDRESS 0x8FED92 /end MEASUREMENT
/begin MEASUREMENT EngM_stGbxRel_mp "Status Freigabebedingung: Antriebsstrang offen" UBYTE OneToOne 1 100 0.00 255.0 FORMAT "%5.1" ECU_ADDRESS 0x8FEDCA /end MEASUREMENT
/begin MEASUREMENT EngM_stGenRel_mp "Status generelle Freigabebedingungen für Reibmomentenadaption" UBYTE OneToOne 1 100 0.00 255.0 FORMAT "%5.1" ECU_ADDRESS 0x8FEDCB /end MEASUREMENT
/begin MEASUREMENT EngM_stInjCharSetVal "Zeigt den Zustand der erlaubten Einspritzungen" UBYTE OneToOne 1 100 0.00 255.0 FORMAT "%5.1" ECU_ADDRESS 0x7F8831 /end MEASUREMENT
/begin MEASUREMENT EngM_stNDiffRng_mp "Status Leerlaufreglerabweichung innerhalb zulässiger Schwellwerte" UBYTE OneToOne 1 100 0.00 255.0 FORMAT "%5.1" ECU_ADDRESS 0x8FEDCC /end MEASUREMENT
/begin MEASUREMENT EngM_stNext "Meta-Status der KW- und NW-Ereignisverwaltung (Motorpositions-Management), ohne Interim-Zustände" UBYTE OneToOne 1 100 0.00 255.0 FORMAT "%5.1" ECU_ADDRESS 0x7F8832 /end MEASUREMENT
/begin MEASUREMENT EngM_stNextExt "Meta-Status der KW- und NW-Ereignisverwaltung, ohne Interim-Zustände, extern vom Master zum Slave über CAN" UBYTE OneToOne 1 100 0.00 255.0 FORMAT "%5.1" ECU_ADDRESS 0x7F8833 /end MEASUREMENT
/begin MEASUREMENT EngM_stOut "state of engine bearing depending on engine speed, engine temperature and gear state" UBYTE OneToOne 1 100 0.00 255.0 FORMAT "%5.1" ECU_ADDRESS 0x7F8834 /end MEASUREMENT
/begin MEASUREMENT EngM_stReliablAdpt "Zuverlässigkeitsstatus des adaptierten Verlustmoments" UBYTE OneToOne 1 100 0.00 255.0 FORMAT "%5.1" ECU_ADDRESS 0x7F8835 /end MEASUREMENT
/begin MEASUREMENT EngM_stSpd "Status der Motordrehzahl" UBYTE OneToOne 1 100 0.00 255.0 FORMAT "%5.1" ECU_ADDRESS 0x7F8836 /end MEASUREMENT
/begin MEASUREMENT EngM_stSync "Meta-Status der KW- und NW-Ereignisverwaltung (Motorpositions-Management)" UBYTE OneToOne 1 100 0.00 255.0 FORMAT "%5.1" ECU_ADDRESS 0x7F8837 /end MEASUREMENT
/begin MEASUREMENT EngM_stTrqFrcPDiffErr_mp "Statusmesspunkt für Ersatzdrehmomentverlust im Systemfehlerefall" UBYTE OneToOne 1 100 0.00 255.0 FORMAT "%5.1" ECU_ADDRESS 0x8FEDBC /end MEASUREMENT
/begin MEASUREMENT EngM_tiDiffInt_mp "Differenz zwischen zwei statische interrupts" ULONG TimeSys_us 1 100 0.00 1228361874.73 FORMAT "%13.2" ECU_ADDRESS 0x8FED94 /end MEASUREMENT
/begin MEASUREMENT EngM_tiSeg "Segmentzeit" UWORD TimeDT 1 100 0.00 65535.00 FORMAT "%8.2" ECU_ADDRESS 0x7F8C0A /end MEASUREMENT
/begin MEASUREMENT EngM_tiSegLimAvrg "gemittelte beschränkte Segmentzeit" UWORD TimeDT 1 100 0.00 65535.00 FORMAT "%8.2" ECU_ADDRESS 0x7F8C0C /end MEASUREMENT
/begin MEASUREMENT EngM_tiSegTwo "Dauer der vergangenen beiden Segmente" UWORD TimeDT 1 100 0.00 65535.00 FORMAT "%8.2" ECU_ADDRESS 0x7F8C0E /end MEASUREMENT
/begin MEASUREMENT EngM_trqDiffAdpt "Adaptiertes Differenzmoment" SWORD Trq 1 100 -3276.800 3276.700 FORMAT "%8.3" ECU_ADDRESS 0x7F8C10 /end MEASUREMENT
/begin MEASUREMENT EngM_trqFltACoff_mp "Adaptionsfilter-Ausgang für Zustand ""Klima Kompressor aus""" SWORD Trq 1 100 -3276.800 3276.700 FORMAT "%8.3" ECU_ADDRESS 0x8FEDCE /end MEASUREMENT
/begin MEASUREMENT EngM_trqFltACon_mp "Adaptionsfilter-Ausgang für Zustand ""Klimakompressor an""" SWORD Trq 1 100 -3276.800 3276.700 FORMAT "%8.3" ECU_ADDRESS 0x8FEDD0 /end MEASUREMENT
/begin MEASUREMENT EngM_trqFrc "aktuelles Reibmoment" SWORD Trq 1 100 -3276.800 3276.700 FORMAT "%8.3" ECU_ADDRESS 0x7F8C12 /end MEASUREMENT
/begin MEASUREMENT EngM_trqFrcPDiffLim_mp "limitierter Momentenverlust aufgrund Differenzdruck über Partikelfilter" SWORD Trq 1 100 -3276.800 3276.700 FORMAT "%8.3" ECU_ADDRESS 0x8FEDBE /end MEASUREMENT
/begin MEASUREMENT EngM_trqFrcPDiffRaw_mp "Rohwert des Momentenverlustes aufgrund Differenzdruck über Partikelfilter" SWORD Trq 1 100 -3276.800 3276.700 FORMAT "%8.3" ECU_ADDRESS 0x8FEDC0 /end MEASUREMENT
/begin MEASUREMENT EngM_trqFrcPDiff_mp "Momentenverlust aufgrund Differenzdruck über Partikelfilter" SWORD Trq 1 100 -3276.800 3276.700 FORMAT "%8.3" ECU_ADDRESS 0x8FEDC2 /end MEASUREMENT
/begin MEASUREMENT EngM_trqFrcT_mp "ausgewählte Temperature zur Berechnung Reibmoment" SWORD Trq 1 100 -3276.800 3276.700 FORMAT "%8.3" ECU_ADDRESS 0x8FEDC4 /end MEASUREMENT
/begin MEASUREMENT EngM_trqLossAdpt "Adaptiertes Gesamtverlustmoment des Motors" SWORD Trq 1 100 -3276.800 3276.700 FORMAT "%8.3" ECU_ADDRESS 0x7F8C14 /end MEASUREMENT
/begin MEASUREMENT EngM_trqLossCompl_mp "komplettes Motor-Verlustmoment" SWORD Trq 1 100 -3276.800 3276.700 FORMAT "%8.3" ECU_ADDRESS 0x8FEDD2 /end MEASUREMENT
/begin MEASUREMENT EngM_trqLossDiff_mp "Differenzverlustmoment der Reibmomenten-Adaption" SWORD Trq 1 100 -3276.800 3276.700 FORMAT "%8.3" ECU_ADDRESS 0x8FEDD4 /end MEASUREMENT
/begin MEASUREMENT EngM_tTrqFrc_mp "Ausgewählte Temperatur für die Reibmomentenberechnung" SWORD Temp_Cels 1 100 -50.140 899.860 FORMAT "%8.3" ECU_ADDRESS 0x8FEDC6 /end MEASUREMENT
/begin MEASUREMENT EngPrt_facPrtLim "Motorschutzbegrenzungsfaktor" SWORD Fact 1 100 -4.000000 3.999878 FORMAT "%8.6" ECU_ADDRESS 0x7F8C16 /end MEASUREMENT
/begin MEASUREMENT EngPrt_qPrtLim "Begrenzungmenge zum thermischen Motorschutz" SWORD InjMass 1 100 -327.6800 327.6700 FORMAT "%8.4" ECU_ADDRESS 0x7F8C18 /end MEASUREMENT
/begin MEASUREMENT EngPrt_stFWOscDet "Status of fly wheel oscillation detection" UBYTE OneToOne 1 100 0.00 255.0 FORMAT "%5.1" ECU_ADDRESS 0x7F8839 /end MEASUREMENT
/begin MEASUREMENT EngPrt_stOvrSpd "Überdrehzahl-Status" UBYTE OneToOne 1 100 0.00 255.0 FORMAT "%5.1" ECU_ADDRESS 0x7F883A /end MEASUREMENT
/begin MEASUREMENT EngPrt_stTrqRampSwitch_mp "status of rampswitch" UWORD OneToOne 1 100 0.00 65535.00 FORMAT "%8.2" ECU_ADDRESS 0x8FEDD6 /end MEASUREMENT
/begin MEASUREMENT EngPrt_trqLim "Begrenzungsmoment zum Schutz vor zu hohem Drehmoment (als inneres Motormoment)" SWORD Trq 1 100 -3276.800 3276.700 FORMAT "%8.3" ECU_ADDRESS 0x7F8C1A /end MEASUREMENT
/begin MEASUREMENT EngPrt_trqLimPrvLim_mp "" SWORD Trq 1 100 -3276.800 3276.700 FORMAT "%8.3" ECU_ADDRESS 0x8FEDD8 /end MEASUREMENT
/begin MEASUREMENT EngPrt_trqNLim "Begrenzungsmoment zum Schutz vor zu hoher Drehzahl (als inneres Motormoment)" SWORD Trq 1 100 -3276.800 3276.700 FORMAT "%8.3" ECU_ADDRESS 0x7F8C1C /end MEASUREMENT
/begin MEASUREMENT EngPrt_trqOvhtPrv "Begrenzungsmoment für Überhitzungsschutz" SWORD Trq 1 100 -3276.800 3276.700 FORMAT "%8.3" ECU_ADDRESS 0x7F8C1E /end MEASUREMENT
/begin MEASUREMENT EngPrt_trqPrtLim "resultierendes Begrenzungsmoment für Motormechanikschutz (inneres Motormoment)" SWORD Trq 1 100 -3276.800 3276.700 FORMAT "%8.3" ECU_ADDRESS 0x7F8C20 /end MEASUREMENT
/begin MEASUREMENT EngPrt_trqRamLim1_mp "Ausgang der Sekunde rampswitch" SWORD Trq 1 100 -3276.800 3276.700 FORMAT "%8.3" ECU_ADDRESS 0x8FEDDA /end MEASUREMENT
/begin MEASUREMENT EngPrt_trqRamLim_mp "Ausgang von erstem rampswitch" SWORD Trq 1 100 -3276.800 3276.700 FORMAT "%8.3" ECU_ADDRESS 0x8FEDDC /end MEASUREMENT
/begin MEASUREMENT Eng_dnAvrg "gemittelte Drehzahländerung pro Sekunde" SWORD dn_dZ20 1 100 -327680.0 327670.0 FORMAT "%8.1" ECU_ADDRESS 0x7F8C22 /end MEASUREMENT
/begin MEASUREMENT Eng_nAvrg "mittlere Motordrehzahl" SWORD EngN 1 100 -32768.00 32767.00 FORMAT "%8.2" ECU_ADDRESS 0x7F8C24 /end MEASUREMENT
/begin MEASUREMENT Eng_nCurr "aktuelle Motordrehzahl" SWORD EngN 1 100 -32768.00 32767.00 FORMAT "%8.2" ECU_ADDRESS 0x7F8C26 /end MEASUREMENT
/begin MEASUREMENT Eng_stOvrTemp "Status Übertemperatur" UBYTE OneToOne 1 100 0.00 255.0 FORMAT "%5.1" ECU_ADDRESS 0x7F883B /end MEASUREMENT
/begin MEASUREMENT Eng_stOvrTemp2 "Status Übertemperatur 2" UBYTE OneToOne 1 100 0.00 255.0 FORMAT "%5.1" ECU_ADDRESS 0x7F883C /end MEASUREMENT
/begin MEASUREMENT Eng_stOvrTemp_mp "Status Übertemperatur" UBYTE OneToOne 1 100 0.00 255.0 FORMAT "%5.1" ECU_ADDRESS 0x8FED80 /end MEASUREMENT
/begin MEASUREMENT Eng_tEng "Motortemperatur" SWORD Temp_Cels 1 100 -50.140 899.860 FORMAT "%8.3" ECU_ADDRESS 0x7F8C28 /end MEASUREMENT
/begin MEASUREMENT Eng_tFld "Motortemperatur-Feld" SWORD Temp_Cels 1 100 -50.140 899.860 FORMAT "%8.3" ARRAY_SIZE 3 ECU_ADDRESS 0x7F91F4 /end MEASUREMENT
/begin MEASUREMENT Eng_trqCrvMax "maximales Moment des Momentenintervalls (über Drehzahl)" SWORD Trq 1 100 -3276.800 3276.700 FORMAT "%8.3" ECU_ADDRESS 0x7F8C2E /end MEASUREMENT
/begin MEASUREMENT Eng_tStrt "Motortemperatur beim Start" SWORD Temp_Cels 1 100 -50.140 899.860 FORMAT "%8.3" ECU_ADDRESS 0x7F8C2A /end MEASUREMENT
/begin FUNCTION ebafcd "Abluftklappensteuerung Komponententreiber"
 /begin DEF_CHARACTERISTIC EBAFCD_DebExcTempDef_C EBAFCD_DebExcTempOk_C EBAFCD_DebNoLoadDef_C EBAFCD_DebNoLoadOk_C EBAFCD_DebShortCircBatDef_C EBAFCD_DebShortCircBatOk_C EBAFCD_DebShortCircGndDef_C EBAFCD_DebShortCircGndOk_C EBAFCD_InvSigOut_C EBAFCD_nFan_C EBAFCD_numDiaOut_C EBAFCD_numDioOut_C EBAFCD_tClntTrMin_C EBAFCD_tClntTrMax_C EBAFCD_sttClntTrOff_C EBAFCD_sttClntTrOn_C EBAFCD_tClntMin_C EBAFCD_tClntMax_C EBAFCD_sttClntOff_C EBAFCD_sttClntOn_C /end DEF_CHARACTERISTIC
/end FUNCTION
/begin FUNCTION ebafcd_msg "" /begin OUT_MEASUREMENT EBAFCD_stSigOut /end OUT_MEASUREMENT /end FUNCTION
/begin FUNCTION ebafcd_uic "" /begin OUT_MEASUREMENT EBAFCD_st_mp /end OUT_MEASUREMENT /end FUNCTION
/begin FUNCTION ebfcd_actoutebox "E-Box Cooler Fan component driver"
 /begin DEF_CHARACTERISTIC EBFCD_DebExcTempDef_C EBFCD_DebExcTempOk_C EBFCD_DebNoLoadDef_C EBFCD_DebNoLoadOk_C EBFCD_DebShortCircBatDef_C EBFCD_DebShortCircBatOk_C EBFCD_DebShortCircGndDef_C EBFCD_DebShortCircGndOk_C EBFCD_numDiaOut_C EBFCD_numDioOut_C EBFCD_stDigInvOut_C EBFCD_stSigOutErr_C EBFCD_swtOnOff_C EBFCD_tECUXLow_C EBFCD_tECUXHigh_C EBFCD_stECUYLow_C EBFCD_stECUYHigh_C /end DEF_CHARACTERISTIC
/end FUNCTION
/begin FUNCTION ebfcd_actoutebox_msg "" /begin OUT_MEASUREMENT EBFCD_stOut /end OUT_MEASUREMENT /end FUNCTION
/begin FUNCTION ebfcd_actoutebox_uic "" /begin OUT_MEASUREMENT EBFCD_st_mp /end OUT_MEASUREMENT /end FUNCTION
/begin FUNCTION ebtscd_gettempebox "ECU Temperature sensor component driver"
 /begin DEF_CHARACTERISTIC EBTSCD_uSRCMin_C EBTSCD_uSRCMax_C EBTSCD_tLin_CUR EBTSCD_OvrDebSRCHighDef_C EBTSCD_OvrDebSRCHighOk_C EBTSCD_DebSRCHighDef_C EBTSCD_DebSRCHighOk_C EBTSCD_DebSRCLowDef_C EBTSCD_DebSRCLowOk_C EBTSCD_numAdc_C EBTSCD_dtRmpSlpUp_C EBTSCD_dtRmpSlpDwn_C EBTSCD_tiTECUPT1_C EBTSCD_tOvrTemp_C EBTSCD_stSensIDWord_C EBTSCD_tDfl_C /end DEF_CHARACTERISTIC
 /begin IN_MEASUREMENT EBTSCD_uRawTECU_mp /end IN_MEASUREMENT
/end FUNCTION
/begin FUNCTION ebtscd_gettempebox_msg "" /begin OUT_MEASUREMENT EBTSCD_tCIntLin EBTSCD_tECU /end OUT_MEASUREMENT /end FUNCTION
/begin FUNCTION ebtscd_gettempebox_uic "" /begin OUT_MEASUREMENT EBTSCD_uRawTECU_mp /end OUT_MEASUREMENT /end FUNCTION
/begin FUNCTION ecu "" /begin DEF_CHARACTERISTIC ECU_vPrgThres_C /end DEF_CHARACTERISTIC /end FUNCTION
/begin FUNCTION eepcd "Komponenten Treiber für EEPROM Zugriffe" /begin DEF_CHARACTERISTIC EEPCD_stMILDfl_C /end DEF_CHARACTERISTIC /end FUNCTION
/begin FUNCTION eepcd_msg "" /begin OUT_MEASUREMENT EEPCD_stErrSet EEPCD_stMIL /end OUT_MEASUREMENT /end FUNCTION
/begin FUNCTION eepinit "EEPROM Erstinitialisierung" /begin DEF_CHARACTERISTIC EepInit_AirCtlTrm_C /end DEF_CHARACTERISTIC /end FUNCTION
/begin FUNCTION eepinit_develop "ließt Bloecke vom EEPROM und schreibt ein Byte an waelbare Positionen" /begin DEF_CHARACTERISTIC /end DEF_CHARACTERISTIC /begin OUT_MEASUREMENT /end OUT_MEASUREMENT /end FUNCTION
/begin FUNCTION egppcd_actrout "Exhaust Gas pressure Pump Component Driver"
 /begin DEF_CHARACTERISTIC EGPpCD_numDia_C EGPpCD_numDioOut_C EGPpCD_stInvOut_C EGPpCD_stPwrStgActv_C EGPpCD_tiDebExcTempDef_C EGPpCD_tiDebExcTempOk_C EGPpCD_tiDebNoLoadDef_C EGPpCD_tiDebNoLoadOk_C EGPpCD_tiDebShortCircBatDef_C EGPpCD_tiDebShortCircBatOk_C EGPpCD_tiDebShortCircGndDef_C EGPpCD_tiDebShortCircGndOk_C /end DEF_CHARACTERISTIC
/end FUNCTION
/begin FUNCTION egppcd_actrout_msg "" /begin OUT_MEASUREMENT EGPpCD_stActrOut /end OUT_MEASUREMENT /end FUNCTION
/begin FUNCTION egppcd_actrout_uic "" /end FUNCTION
/begin FUNCTION egpp_logic "Calculates the status of the Exhaust gas pressure pump" /begin DEF_CHARACTERISTIC EGPp_stFlap_MAP EGPp_tiStartDelay_C /end DEF_CHARACTERISTIC /begin IN_MEASUREMENT Eng_nAvrg InjCtl_qCurr /end IN_MEASUREMENT /end FUNCTION
/begin FUNCTION egpp_logic_msg "" /begin OUT_MEASUREMENT EGPp_stLogicOut /end OUT_MEASUREMENT /end FUNCTION
/begin FUNCTION egpp_logic_uic "" /end FUNCTION
/begin FUNCTION egpp_prescalc "Berechnung des Abgasdruckes"
 /begin DEF_CHARACTERISTIC EGPp_facGeoSil2_C EGPp_facGeoSil_C EGPp_facPow_CUR EGPp_facRhoEta_CUR EGPp_pPstPFlt_MAP EGPp_tiPresFltPT1_C EGPp_swtPresCalc_C /end DEF_CHARACTERISTIC
 /begin IN_MEASUREMENT EGPp_dvolSil_mp Eng_nAvrg InjCtl_qSetUnBal PFlt_tPstSim /end IN_MEASUREMENT
/end FUNCTION
/begin FUNCTION egpp_prescalc_msg "" /begin OUT_MEASUREMENT EGPp_pPstPFlt /end OUT_MEASUREMENT /end FUNCTION
/begin FUNCTION egpp_prescalc_uic "" /begin OUT_MEASUREMENT EGPp_dvolSil_mp EGPp_pPstPFltMap_mp EGPp_pPstPFltSim_mp /end OUT_MEASUREMENT /end FUNCTION
/begin FUNCTION egrcd "Komponententreiber Abgasrückführsteller"
 /begin DEF_CHARACTERISTIC EGRCD_DebExcTempDef_C EGRCD_DebExcTempOk_C EGRCD_DebNoLoadDef_C EGRCD_DebNoLoadOk_C EGRCD_DebShortCircBatDef_C EGRCD_DebShortCircBatOk_C EGRCD_DebShortCircGndDef_C EGRCD_DebShortCircGndOk_C EGRCD_numDia_C EGRCD_numPwmOut_C EGRCD_stInvOut_C EGRCD_tiPer_C EGRCD_rCnv_MAP EGRCD_rOutMax_C EGRCD_rOutMin_C EGRCD_rTst_C EGRCD_stPwrStgActv_C EGRCD_stPwrStgDia_C EGRCD_swt_C EGRCD_tiBtwTst_C /end DEF_CHARACTERISTIC
 /begin IN_MEASUREMENT EGRVlv_rEGR Eng_nAvrg /end IN_MEASUREMENT
/end FUNCTION
/begin FUNCTION egrcd_msg "" /begin OUT_MEASUREMENT EGRCD_rOut /end OUT_MEASUREMENT /end FUNCTION
/begin FUNCTION egrcd_uic "" /begin OUT_MEASUREMENT EGRCD_rCnv_mp /end OUT_MEASUREMENT /end FUNCTION
/begin FUNCTION egrvlv_co "Stellerkoordinator Abgasrückführung" /end FUNCTION
/begin FUNCTION egrvlv_co_msg "" /begin OUT_MEASUREMENT EGRVlv_rEGR EGRVlv_rEGR2 /end OUT_MEASUREMENT /end FUNCTION
/begin FUNCTION egrvlv_co_uic ""
 /begin DEF_CHARACTERISTIC EGRVlv_rEGR2_Vector EGRVlv_rEGR2_Channel EGRVlv_rEGR_Vector EGRVlv_rEGR_Channel /end DEF_CHARACTERISTIC
 /begin OUT_MEASUREMENT EGRVlv_rEGR2Byp_mp EGRVlv_rEGRByp_mp /end OUT_MEASUREMENT
/end FUNCTION
/begin FUNCTION egsys_dewdet "Taupunktbestimmungslogik"
 /begin DEF_CHARACTERISTIC EGSys_dmPlsThresLSU_C EGSys_facCldStrtLSU_C EGSys_facPlsLSU_C EGSys_facPlsThresLSU_C EGSys_numMaxCldStrt_C EGSys_swtDewDetShOff_C EGSys_tiDebLSU0_C EGSys_tiDebNrmTransOk_C EGSys_tiHtgDelLSU_C EGSys_tIntegIni_C EGSys_tiPlsLSU_C EGSys_tThresLSUAct_C EGSys_tWtEquiv_C EGSys_wLSUIKi_C EGSys_wThresLSU0_MAP /end DEF_CHARACTERISTIC
 /begin IN_MEASUREMENT EGSys_tEGLSUInpCrv0_mp Eng_tEng /end IN_MEASUREMENT
 /begin OUT_MEASUREMENT EGSys_cpEGLSU_mp EGSys_ctCldStrtLSU_mp EGSys_dwLSU_mp EGSys_stHtgLSULstTrp_mp EGSys_stHtgThresLSUHit_mp EGSys_stIntegIni_mp EGSys_stPlsLSU_mp EGSys_wLSU_mp EGSys_wThresLSUAct_mp EGSys_wThresLSUNoPls_mp EGSys_wThresLSUPls_mp EGSys_wThresLSU_mp /end OUT_MEASUREMENT
/end FUNCTION
/begin FUNCTION egsys_dewdet_msg "" /begin OUT_MEASUREMENT EGSys_stHtgLSU /end OUT_MEASUREMENT /end FUNCTION
/begin FUNCTION egsys_dewdet_uic "" /end FUNCTION
/begin FUNCTION egsys_mdlbackpres "Berechnung des Abgasgegendrucks" /begin DEF_CHARACTERISTIC EGSys_dpExhGas_MAP EGSys_pConstVal_C EGSys_swtPresSel_C /end DEF_CHARACTERISTIC /begin IN_MEASUREMENT Eng_nAvrg InjCtl_qSetUnBal /end IN_MEASUREMENT /end FUNCTION
/begin FUNCTION egsys_mdlbackpres_msg "" /begin OUT_MEASUREMENT EGSys_pExhGas /end OUT_MEASUREMENT /end FUNCTION
/begin FUNCTION egsys_mdlbackpres_uic "" /end FUNCTION
/begin FUNCTION egsys_tegco "Schnittstellenkoordinator für Abgastemperaturmodell"
 /begin DEF_CHARACTERISTIC EGSys_cndHtEG_CUR EGSys_cpEG_MAP EGSys_dmEGMinVal_C EGSys_numECU_C EGSys_numRdPosLSU2_C EGSys_numRdPosLSUWall_C EGSys_numRdPosLSU_C EGSys_numRdPosNSC2_C EGSys_numRdPosNSC_C EGSys_numRdPosOxiCat2_C EGSys_numRdPosOxiCat_C EGSys_numRdPosTrbn2_C EGSys_numRdPosTrbn_C EGSys_numRdPosTube2_C EGSys_numRdPosTube_C EGSys_vscDynEG_CUR EGSys_vscKinEG_CUR /end DEF_CHARACTERISTIC
 /begin IN_MEASUREMENT EGSys_rLmbdAprx /end IN_MEASUREMENT
 /begin OUT_MEASUREMENT EGSys_tEGLSUInpCrv0_mp EGSys_tEGLSUInpCrv1_mp EGSys_tEGLSUInpCrv2_mp EGSys_tEGLSUInpCrv3_mp EGSys_tMem_mp /end OUT_MEASUREMENT
/end FUNCTION
/begin FUNCTION egsys_tegco_msg ""
 /begin OUT_MEASUREMENT EGSys_dmEG EGSys_qMIStd EGSys_qPoIRgn EGSys_rLmbdAprx EGSys_tEGLSU EGSys_tEGPreNSC EGSys_tEGPreOxiCat EGSys_tEGPreTrbn EGSys_tEGPreTube EGSys_tWallLSU /end OUT_MEASUREMENT
/end FUNCTION
/begin FUNCTION egsys_tegco_uic "" /begin OUT_MEASUREMENT EGSys_tShOffTExcClnt_mp /end OUT_MEASUREMENT /end FUNCTION
/begin FUNCTION egsys_tegco_var "" /begin DEF_CHARACTERISTIC EGSys_tExcClntDfl_C /end DEF_CHARACTERISTIC /end FUNCTION
/begin FUNCTION egsys_tegmod "Abgastemperaturmodell"
 /begin DEF_CHARACTERISTIC EGSys_dmAir_MAP EGSys_facAirMass_CUR EGSys_facCorrCldEng_CUR EGSys_facIAT_CUR EGSys_facStrtDlv_CUR EGSys_phiStrtDlv_MAP EGSys_tEngStat_C EGSys_tIAT_MAP EGSys_tManfDfl_C EGSys_tManfStat_MAP /end DEF_CHARACTERISTIC
 /begin IN_MEASUREMENT EGSys_phiDiffStrt_mp EGSys_rAirPerTime_mp EGSys_tDiffCldEng_mp EGSys_tDiffIAT_mp Eng_nAvrg InjCtl_qCurr /end IN_MEASUREMENT
/end FUNCTION
/begin FUNCTION egsys_tegmod_msg "" /begin OUT_MEASUREMENT EGSys_tManfStat /end OUT_MEASUREMENT /end FUNCTION
/begin FUNCTION egsys_tegmod_uic ""
 /begin OUT_MEASUREMENT EGSys_facAirMass_mp EGSys_facStrtDlv_mp EGSys_phiDiffStrt_mp EGSys_rAirPerTime_mp EGSys_tCorrIAT_mp EGSys_tCorrManf_mp EGSys_tDiffCldEng_mp EGSys_tDiffIAT_mp EGSys_tManfStat_mp /end OUT_MEASUREMENT
/end FUNCTION
/begin FUNCTION egsys_tnscmod "Temperaturmodell für NOx-Speicherkatalysator"
 /begin DEF_CHARACTERISTIC EGSys_cpNSC_C EGSys_tiPT1NSC_C EGSys_swtTimeNSC_C EGSys_tNSCDfl_C EGSys_tNSCExoIncr_MAP /end DEF_CHARACTERISTIC
 /begin IN_MEASUREMENT EGSys_rLmbdAprx EGSys_tAvrgNSC_mp /end IN_MEASUREMENT
/end FUNCTION
/begin FUNCTION egsys_tnscmod_msg "" /begin OUT_MEASUREMENT EGSys_tNSC /end OUT_MEASUREMENT /end FUNCTION
/begin FUNCTION egsys_tnscmod_uic ""
 /begin OUT_MEASUREMENT EGSys_cpEGNSC_mp EGSys_tAvrgNSC_mp EGSys_tNSCExoIncr_mp EGSys_tNSCStat_mp /end OUT_MEASUREMENT
/end FUNCTION
/begin FUNCTION egsys_toxicatmod "Temperaturmodel für Oxidationskatalysator"
 /begin DEF_CHARACTERISTIC EGSys_CalValFl_C EGSys_cpOxiCat_C EGSys_facTempCmb_CUR EGSys_tiPT1OxiCat_C EGSys_swtTimeOxiCat_C EGSys_tOxiCatDfl_C EGSys_tOxiCatExoIncr_MAP /end DEF_CHARACTERISTIC
 /begin IN_MEASUREMENT EGSys_rLmbdAprx EGSys_tAvrgOxiCat_mp /end IN_MEASUREMENT
/end FUNCTION
/begin FUNCTION egsys_toxicatmod_msg "" /begin OUT_MEASUREMENT EGSys_tOxiCat /end OUT_MEASUREMENT /end FUNCTION
/begin FUNCTION egsys_toxicatmod_uic ""
 /begin OUT_MEASUREMENT EGSys_cpEGOxiCat_mp EGSys_dwFlCmb_mp EGSys_tAvrgOxiCat_mp EGSys_tIncrPoI_mp EGSys_tOxiCatExoIncr_mp EGSys_tOxiCatStat_mp /end OUT_MEASUREMENT
/end FUNCTION
/begin FUNCTION egsys_tstrtcalc "Temperaturmodell für Fahrzeugstillstand"
 /begin DEF_CHARACTERISTIC EGSys_facTempClg_CUR EGSys_facTimeClg_CUR EGSys_swtTAirSens_C EGSys_tiHaValClnt_C EGSys_tiHaValNSC_C EGSys_tiHaValOxiCat_C EGSys_tiHaValTrb_C EGSys_tiHaValTube_C EGSys_tiOfsClg_C EGSys_tStrtCsRepl_C /end DEF_CHARACTERISTIC
 /begin IN_MEASUREMENT EGSys_rTempClnt_mp EGSys_rTimeTrb_mp /end IN_MEASUREMENT
 /begin OUT_MEASUREMENT EGSys_rTimeTube_mp /end OUT_MEASUREMENT
/end FUNCTION
/begin FUNCTION egsys_tstrtcalc_msg ""
 /begin OUT_MEASUREMENT EGSys_tNSCStrtCs EGSys_tOxiCatStrtCs EGSys_tTrbStrtCs EGSys_tTubeStrtCs /end OUT_MEASUREMENT
/end FUNCTION
/begin FUNCTION egsys_tstrtcalc_uic ""
 /begin OUT_MEASUREMENT EGSys_rTempClnt_mp EGSys_rTimeNSC_mp EGSys_rTimeOxiCat_mp EGSys_rTimeTrb_mp EGSys_tExcClntStrtCs_mp EGSys_tiClg_mp EGSys_tiRefClg_mp /end OUT_MEASUREMENT
/end FUNCTION
/begin FUNCTION egsys_ttrbmod ""
 /begin DEF_CHARACTERISTIC EGSys_cpChrg_C EGSys_etaChrg_MAP EGSys_tiChrgPT1_C EGSys_pValDfl_C EGSys_rTempAdbt_CUR EGSys_swtTimeChrg_C EGSys_tEGPstTrbnDfl_C /end DEF_CHARACTERISTIC
 /begin IN_MEASUREMENT AFSCD_dmAirPerTime EGSys_rPresCmpr_mp /end IN_MEASUREMENT
/end FUNCTION
/begin FUNCTION egsys_ttrbmod_msg "" /begin OUT_MEASUREMENT EGSys_tEGPstTrbn /end OUT_MEASUREMENT /end FUNCTION
/begin FUNCTION egsys_ttrbmod_uic ""
 /begin OUT_MEASUREMENT EGSys_cpEGTrbn_mp EGSys_etaChrg_mp EGSys_facPT1Chrg_mp EGSys_pwrCmpr_mp EGSys_rPresCmpr_mp EGSys_tAvrgEGTrbn_mp /end OUT_MEASUREMENT
/end FUNCTION
/begin FUNCTION egsys_ttubemod "Temperaturmodell für Abgasrohr"
 /begin DEF_CHARACTERISTIC EGSys_AlpFreeCnvtTube_C EGSys_cpTube_C EGSys_lDiamTube_C EGSys_lLngthTube_C EGSys_NuTubeEnv_CUR EGSys_NuTube_CUR EGSys_rSqTube_C EGSys_tEGTubeDfl_C EGSys_tTubeDfl_C EGSys_tTubeIKi_C EGSys_tTubeIKiPos_C EGSys_tTubeIKiNeg_C EGSys_tTubeIWinPos_C EGSys_tTubeIWinNeg_C /end DEF_CHARACTERISTIC
 /begin OUT_MEASUREMENT EGSys_AlpEGTube_mp EGSys_AlpTubeEnv_mp EGSys_cndHtEGi_mp EGSys_cndHtEGo_mp EGSys_cpEGTube_mp EGSys_dtTube_mp EGSys_dwTubeIn_mp EGSys_dwTubeOut_mp EGSys_dwTube_mp EGSys_NuTubeEnv_mp EGSys_NuTube_mp EGSys_ReTubeEnvInpCrv_mp EGSys_ReTubeEnv_mp EGSys_ReTubeInpCrv_mp EGSys_ReTube_mp EGSys_sqTube_mp EGSys_tAvrgEGTube_mp EGSys_tDiffEGTube_mp EGSys_tDiffTubeEnv_mp EGSys_tMidEGTube_mp EGSys_tMidTubeEnv_mp /end OUT_MEASUREMENT
/end FUNCTION
/begin FUNCTION egsys_ttubemod_msg "" /begin OUT_MEASUREMENT EGSys_tEGPstTube EGSys_tTube /end OUT_MEASUREMENT /end FUNCTION
/begin FUNCTION egsys_ttubemod_uic "" /end FUNCTION
/begin FUNCTION egt_corgntsync "Regenerationskoordinator Abgasnachbehandlung (zeitsynchron)"
 /begin DEF_CHARACTERISTIC EGT_stRgnLckMsk_C EGT_swtRgnLckRst_C EGT_swtServiceVal_C EGT_tiRgnOilDilMax_C EGT_tiRgnOilDilSubs_C EGT_tiRmpSlpMax_C /end DEF_CHARACTERISTIC
/end FUNCTION
/begin FUNCTION egt_corgntsync_msg ""
 /begin OUT_MEASUREMENT EGT_stCoRgnTSync EGT_stDel EGT_stTSync EGT_stTSyncLck EGT_tiRgnOilDil EGT_tiRgnTSync EGT_tiRmpSlpMax /end OUT_MEASUREMENT
/end FUNCTION
/begin FUNCTION egt_corgntsync_uic "" /begin DEF_CHARACTERISTIC EGT_stTSync_Vector EGT_stTSync_Channel /end DEF_CHARACTERISTIC
 /begin OUT_MEASUREMENT EGT_stCoRgnOld_mp EGT_stRgnOilDil_mp EGT_stTSyncDes_mp EGT_swtRgnLck_mp EGT_tiRgnTSyncPre_mp /end OUT_MEASUREMENT
/end FUNCTION
/begin FUNCTION egt_corgn_msg "" /begin OUT_MEASUREMENT EGT_facRmpVal EGT_st EGT_stCoRgn EGT_stLck EGT_tiRgn /end OUT_MEASUREMENT /end FUNCTION
/begin FUNCTION egt_corgn_uic "" /end FUNCTION
/begin FUNCTION egt_tempgvnr "EGT temperature governor"
 /begin DEF_CHARACTERISTIC EGT_facKiAMPT_MAP EGT_facKiInrTempGvnr_C EGT_facKiOutrTempGvnr_C EGT_facKiQntPoI1_MAP EGT_facKiQntPoI2_MAP EGT_facKiTempInrCor_MAP EGT_facKpAMPT_MAP EGT_facKpInrTempGvnr_C EGT_facKpOutrTempGvnr_C EGT_facKpQntPoI1_MAP EGT_facKpQntPoI2_MAP EGT_facKpTempInrCor_MAP EGT_mAirTempGvnrMax_MAP EGT_mAirTempGvnrMin_MAP EGT_qPoI1Min_C EGT_qPoI1TempGvnrMax_MAP EGT_qPoI1TempGvnrMin_MAP EGT_qPoI2Min_C EGT_qPoI2TempGvnrMax_MAP EGT_qPoI2TempGvnrMin_MAP EGT_rInrDvtThres_C EGT_rOutrDvtThres_C EGT_stMskClsThrVlv_C EGT_swtBiTrbTempGvnr_C EGT_swtInrTempOutr_C EGT_tInrCorTempGvnrMax_MAP EGT_tInrCorTempGvnrMin_MAP EGT_tiPoI1TThres_C /end DEF_CHARACTERISTIC
 /begin IN_MEASUREMENT Eng_nAvrg InjCtl_qSetUnBal /end IN_MEASUREMENT
/end FUNCTION
/begin FUNCTION egt_tempgvnrdesval "Sollwertbildung des Abgastemperaturreglers"
 /begin DEF_CHARACTERISTIC EGT_swtTempInrDes_C EGT_swtTempOutrDes_C EGT_swtTempTurbPre_C EGT_tInrDesTempTurb_CUR EGT_tInrDes_MAP EGT_tOutrDesMflO2_CUR EGT_tOutrDesMsSot_CUR EGT_tOutrDesTempPst_CUR EGT_tOutrDes_MAP /end DEF_CHARACTERISTIC
 /begin IN_MEASUREMENT Eng_nAvrg InjCtl_qSetUnBal PFlt_dmO2Aprx PFlt_mSot PFlt_tOxiPst PFlt_tTurbPre /end IN_MEASUREMENT
/end FUNCTION
/begin FUNCTION egt_tempgvnrdesval_msg ""
 /begin OUT_MEASUREMENT EGT_tInrDesTempGvnr EGT_tInrTempGvnr EGT_tOutrDesTempGvnr EGT_tOutrTempGvnr /end OUT_MEASUREMENT
/end FUNCTION
/begin FUNCTION egt_tempgvnrdesval_uic "" /end FUNCTION
/begin FUNCTION egt_tempgvnrmonitor "Überwachung des Abgastemperaturreglers"
 /begin DEF_CHARACTERISTIC EGT_stMskInrTempGvnr_C EGT_stMskOutrTempGvnr_C EGT_tiHiLoTempGvnr_C EGT_tiLoHiTempGvnr_C EGT_tInrThresDwn_C EGT_tInrThresUp_C EGT_tiPoIHiLoTempGvnr_C EGT_tiPoILoHiTempGvnr_C EGT_tOutrThresDwn_C EGT_tOutrThresUp_C EGT_tOxiPreThresBrn_C /end DEF_CHARACTERISTIC
/end FUNCTION
/begin FUNCTION egt_tempgvnrmonitor_msg "" /begin OUT_MEASUREMENT EGT_stTempGvnr /end OUT_MEASUREMENT /end FUNCTION
/begin FUNCTION egt_tempgvnrmonitor_uic "" /end FUNCTION
/begin FUNCTION egt_tempgvnroutval "Ausgabeschnittstelle der Abgastemperaturregelung"
 /begin DEF_CHARACTERISTIC EGT_facQntPoI2Rmp_CUR EGT_mAirDesTempGvnrMnl_C EGT_mAirLmbd_CUR EGT_phiPoI1TempGvnr_MAP EGT_qHCQntPoI1_CUR EGT_qPoI1TempGvnrMnl_C EGT_qPoI2TempGvnrMnl_C EGT_swtQntPoI1HC_C EGT_tiPoI2TempGvnr_MAP EGT_tiRmpSlpTempGvnr_C /end DEF_CHARACTERISTIC
 /begin IN_MEASUREMENT EGT_facRmp_mp EGT_qPoI1OutrTempGvnr Eng_nAvrg InjCtl_qSetUnBal PFlt_rLmbd /end IN_MEASUREMENT
/end FUNCTION
/begin FUNCTION egt_tempgvnroutval_msg ""
 /begin OUT_MEASUREMENT EGT_mAirDesTempGvnr EGT_phiPoI1TempGvnr EGT_qHCTempGvnr EGT_qPoI1TempGvnr EGT_qPoI2TempGvnr EGT_tiPoI2TempGvnr /end OUT_MEASUREMENT
/end FUNCTION
/begin FUNCTION egt_tempgvnroutval_uic ""
 /begin OUT_MEASUREMENT EGT_facRmpValTempGvnr_mp EGT_facRmp_mp EGT_mAirLmbdTempGvnr_mp /end OUT_MEASUREMENT
/end FUNCTION
/begin FUNCTION egt_tempgvnr_msg ""
 /begin OUT_MEASUREMENT EGT_mAirDesInrTempGvnr EGT_qPoI1OutrTempGvnr EGT_qPoI2InrTempGvnr EGT_tInrDesCorTempGvnr /end OUT_MEASUREMENT
/end FUNCTION
/begin FUNCTION egt_tempgvnr_uic ""
 /begin OUT_MEASUREMENT EGT_mAirTempGvnrMin_mp EGT_mAirTempGvnrRng_mp EGT_qPoI1Min_mp EGT_qPoI1Rng_mp EGT_qPoI2Min_mp EGT_qPoI2Rng_mp EGT_rIInrTempGvnr_mp EGT_rInrTempGvnr_mp EGT_rIOutrTempGvnr_mp EGT_rOutrTempGvnr_mp EGT_rPInrTempGvnr_mp EGT_rPOutrTempGvnr_mp EGT_rStyInrTempGvnr_mp EGT_rStyOutrTempGvnr_mp EGT_stClsThrVlv_mp EGT_tInrCorMax_mp EGT_tInrCorRng_mp EGT_tInrDvtTempGvnr_mp EGT_tiPoI1ActvCnt_mp EGT_tOutrDvtTempGvnr_mp /end OUT_MEASUREMENT
/end FUNCTION
/begin FUNCTION eng "Motor"
 /begin DEF_CHARACTERISTIC Eng_ctEngSpdDiffCalc_C Eng_tOvrHi2_C Eng_tOvrHi_C Eng_tOvrLo2_C Eng_tOvrLo_C Eng_trqSpd_CUR /end DEF_CHARACTERISTIC
 /begin IN_MEASUREMENT Eng_nAvrg /end IN_MEASUREMENT
/end FUNCTION
/begin FUNCTION engm "Motormechanik"
 /begin DEF_CHARACTERISTIC EngM_dLimitCond_ASD_CA EngM_dLimitCond_Common_CA EngM_dLimitCond_FBC_CA EngM_dLimitCond_Joint_CA EngM_dLimitCond_LiGov_CA EngM_dLimitCond_Pilot_CA EngM_nLimitInj_C EngM_nLimitThreshHyst_CA EngM_nLimitThresh_CA EngM_nSwtCoMa_C EngM_numLimitInj_C EngM_swtNumCylVal_C EngM_swtNumCylType_C /end DEF_CHARACTERISTIC
/end FUNCTION
/begin FUNCTION engmon_irrcmb "Verbrennungserkennung mit Lambdasonde" /end FUNCTION
/begin FUNCTION engmon_irrcmb_msg "" /begin OUT_MEASUREMENT EngMon_stShOffIrrCmb /end OUT_MEASUREMENT /end FUNCTION
/begin FUNCTION engmon_irrcmb_uic "" /end FUNCTION
/begin FUNCTION engm_ang ""
 /begin DEF_CHARACTERISTIC EngM_ctOfsCaSCrS_C EngM_ctPhWhlRev_C EngM_ctPostSync_C EngM_ctReSync_C EngM_ctVerSync_C EngM_nMaxStrt_C EngM_numPin_C EngM_nWaitIncSig_C EngM_phiDelayPhNoSig_C EngM_phiDeltaExtSync_C EngM_phiDelta_C EngM_phiFrstInjInt_C EngM_phiInt_C EngM_phiMax_C EngM_phiTDC_C EngM_stSyncBefGap_C EngM_swtExitOfs_C EngM_swtFirSeqFBC_C EngM_swtSyncViaCAN_C EngM_tiCpuTimeOut_C EngM_tiDiffInt_C EngM_tiWaitIncSig_C /end DEF_CHARACTERISTIC
/end FUNCTION
/begin FUNCTION engm_angdiag "Diagnose des Kurbelwellen- und Nockenwellensignals"
 /begin DEF_CHARACTERISTIC EngM_ctSpdtoZero_C EngM_DebIncCaSErrSigDef_C EngM_DebIncCaSErrSigOK_C EngM_DebIncCaSNoSigDef_C EngM_DebIncCrSErrSigDef_C EngM_DebIncCrSErrSigOK_C EngM_DebIncOfsSigCaSCrSDef_C EngM_DebPhCrSErrSigDef_C EngM_nMinDiag_C /end DEF_CHARACTERISTIC
/end FUNCTION
/begin FUNCTION engm_angdiag_uic ""
 /begin OUT_MEASUREMENT EngM_ctIncErrSigDiagCaSDef_mp EngM_ctIncErrSigDiagCaSOk_mp EngM_ctIncErrSigDiagCrSDef_mp EngM_ctIncErrSigDiagCrSOK_mp EngM_ctIncErrSigDiagmaxCaSDef_mp EngM_ctIncErrSigDiagmaxCaSOk_mp EngM_ctIncErrSigDiagmaxCrSDef_mp EngM_ctIncNoSigDiagCaS_mp EngM_ctIncNoSigDiagmaxCaS_mp EngM_ctPhErrSigDiagCrSDef_mp EngM_ctPhErrSigDiagmaxCrSDef_mp EngM_ctSpdtoZero_mp /end OUT_MEASUREMENT
/end FUNCTION
/begin FUNCTION engm_ang_msg ""
 /begin OUT_MEASUREMENT EngM_nDyn EngM_numInt EngM_numLastTDC EngM_numSyncTDC EngM_numTDC EngM_phiDiffTDC EngM_phiInt EngM_phiIntExt EngM_phiTDC EngM_stCaSExt EngM_stCaSVerifyDiag EngM_stErrCanExt EngM_stEvent EngM_stInjCharSetVal EngM_stNext EngM_stNextExt EngM_stSync EngM_tiSeg EngM_tiSegLimAvrg EngM_tiSegTwo /end OUT_MEASUREMENT
/end FUNCTION
/begin FUNCTION engm_ang_uic ""
 /begin OUT_MEASUREMENT EngM_ctIntOvrLoad_mp EngM_ctPostSync_mp EngM_ctReSync_mp EngM_ctVerSync_mp EngM_numRevCnt_mp EngM_phiIntExtCorr_mp EngM_SchedDelta_mp EngM_SchedIndex_mp EngM_SchedLimitInt_mp EngM_SchedSegID_mp EngM_stEventEnable_mp EngM_stEventServed_mp EngM_tiDiffInt_mp /end OUT_MEASUREMENT
/end FUNCTION
/begin FUNCTION engm_backup "Start und Betrieb des Motors nur mit Nockenwellensignal"
 /begin DEF_CHARACTERISTIC EngM_nMaxStrtBackUp_C EngM_stBackUpVar_C EngM_stEnaBackUp_C /end DEF_CHARACTERISTIC
/end FUNCTION
/begin FUNCTION engm_backup_uic "" /end FUNCTION
/begin FUNCTION engm_engmntctl "Motorlagersteuerung"
 /begin DEF_CHARACTERISTIC EngM_tiDebEngMntCtlDia1Def_C EngM_tiDebEngMntCtlDia1Ok_C EngM_tiDebEngMntCtlDia2Def_C EngM_tiDebEngMntCtlDia2Ok_C EngM_tiDebEngMntCtlDia3Def_C EngM_tiDebEngMntCtlDia3Ok_C EngM_tiDebEngMntCtlDia4Def_C EngM_tiDebEngMntCtlDia4Ok_C EngM_tiDebEngMntCtlDia5Def_C EngM_tiDebEngMntCtlDia5Ok_C EngM_tiDebEngMntCtlDia6Def_C EngM_tiDebEngMntCtlDia6Ok_C EngM_DebExcTemp1Def_C EngM_DebExcTemp1Ok_C EngM_DebExcTempDef_C EngM_DebExcTempOk_C EngM_DebNoLoad1Def_C EngM_DebNoLoad1Ok_C EngM_DebNoLoadDef_C EngM_DebNoLoadOk_C EngM_DebShortCircBat1Def_C EngM_DebShortCircBat1Ok_C EngM_DebShortCircBatDef_C EngM_DebShortCircBatOk_C EngM_DebShortCircGnd1Def_C EngM_DebShortCircGnd1Ok_C EngM_DebShortCircGndDef_C EngM_DebShortCircGndOk_C EngM_HldCurr_MAP EngM_nAvrgHysDelta_C EngM_nAvrgHysHigh_CUR EngM_nAvrgLim_C EngM_numDiaOut1_C EngM_numDiaOut2_C EngM_numPwmOut1_C EngM_numPwmOut2_C EngM_stInvOut1_C EngM_tiPer1_C EngM_stInvOut2_C EngM_tiPer2_C EngM_RetCurr_MAP EngM_rTst1_C EngM_rTst_C EngM_stDigInvOut_C EngM_stOutHard_C EngM_stOutSoft_C EngM_tEngMax_C EngM_tEngMin_C EngM_tiBtwTst1_C EngM_tiBtwTst_C EngM_tiDiag1Max_C EngM_tiDiag1Min_C EngM_tiDiag2Max_C EngM_tiDiag2Min_C EngM_tiDiag3Max_C EngM_tiDiag3Min_C EngM_tiDiag4Max_C EngM_tiDiag4Min_C EngM_tiDiag5Max_C EngM_tiDiag5Min_C EngM_tiDiag6Max_C EngM_tiDiag6Min_C EngM_tiEngMntCtl_C EngM_tiHardAftrGear_C EngM_tiSoftAftrStrt_C EngM_uBattMax_C EngM_uBattMin_C EngM_vVSSCDHysHigh_C EngM_vVSSCDHysLow_C /end DEF_CHARACTERISTIC
 /begin IN_MEASUREMENT BattCD_u Eng_tEng /end IN_MEASUREMENT
/end FUNCTION
/begin FUNCTION engm_engmntctl_msg "" /begin OUT_MEASUREMENT EngM_stOut /end OUT_MEASUREMENT /end FUNCTION
/begin FUNCTION engm_engmntctl_uic ""
 /begin OUT_MEASUREMENT EngM_nAvrgHysHigh_mp EngM_nAvrgHysLow_mp EngM_rCurrProf_mp EngM_stEngMntCtl_mp /end OUT_MEASUREMENT
/end FUNCTION
/begin FUNCTION engm_msg "" /begin OUT_MEASUREMENT EngM_numCyl EngM_stSpd /end OUT_MEASUREMENT /end FUNCTION
/begin FUNCTION engm_soptst "" /end FUNCTION
/begin FUNCTION engm_trqfrc "aktuelles Reibmoment"
 /begin DEF_CHARACTERISTIC EngM_dtrqFrcPDiffUp_C EngM_dtrqFrcPDiffDwn_C EngM_facTrqFrcPDiff_CUR EngM_numTrqFrc_C EngM_trqFrcPDiffMin_C EngM_trqFrc_MAP /end DEF_CHARACTERISTIC
 /begin IN_MEASUREMENT EngM_tTrqFrc_mp Eng_nAvrg /end IN_MEASUREMENT
/end FUNCTION
/begin FUNCTION engm_trqfrcadpt "Reibmomentenadaption"
 /begin DEF_CHARACTERISTIC EngM_facT1Reliabl_C EngM_tiFltACoff_C EngM_tiFltACon_C EngM_nLISetDiffOffs_C EngM_stChkPN_C EngM_tAdptMin_C EngM_tiRelAdpt_C EngM_vLimRefuse_C EngM_vThresAdpt_C /end DEF_CHARACTERISTIC
/end FUNCTION
/begin FUNCTION engm_trqfrcadpt_msg ""
 /begin OUT_MEASUREMENT EngM_stAdpt EngM_stReliablAdpt EngM_trqDiffAdpt EngM_trqLossAdpt /end OUT_MEASUREMENT
/end FUNCTION
/begin FUNCTION engm_trqfrcadpt_uic ""
 /begin OUT_MEASUREMENT EngM_nLISetDiff_mp EngM_stGbxRel_mp EngM_stGenRel_mp EngM_stNDiffRng_mp EngM_trqFltACoff_mp EngM_trqFltACon_mp EngM_trqLossCompl_mp EngM_trqLossDiff_mp /end OUT_MEASUREMENT
/end FUNCTION
/begin FUNCTION engm_trqfrc_msg "" /begin OUT_MEASUREMENT EngM_trqFrc /end OUT_MEASUREMENT /end FUNCTION
/begin FUNCTION engm_trqfrc_uic "" /begin DEF_CHARACTERISTIC EngM_trqFrc_Vector EngM_trqFrc_Channel /end DEF_CHARACTERISTIC
 /begin OUT_MEASUREMENT EngM_stTrqFrcPDiffErr_mp EngM_trqFrcPDiffLim_mp EngM_trqFrcPDiffRaw_mp EngM_trqFrcPDiff_mp EngM_trqFrcT_mp EngM_tTrqFrc_mp /end OUT_MEASUREMENT
/end FUNCTION
/begin FUNCTION engm_uic "" /end FUNCTION
/begin FUNCTION engprt "Motormechanikschutz"
 /begin DEF_CHARACTERISTIC EngPrt_dTrqLimUp_C EngPrt_dTrqLimDown_C EngPrt_facAPSPrv_MAP EngPrt_facOvhtPrv_MAP EngPrt_nOvrSpd_C EngPrt_pAPSPrvDfl_C EngPrt_dtrqUpCBLim_C EngPrt_dtrqDwnCBLim_C EngPrt_dtrqUpNLim_C EngPrt_dtrqDwnNLim_C EngPrt_rVnDAMax_C EngPrt_rVnDAMin_C EngPrt_rVnTrqMax_C EngPrt_rVnTrqMin_C EngPrt_swtTrqGear_CUR EngPrt_trqCBLim1_CUR EngPrt_trqCBLim_CUR EngPrt_trqLim1_CUR EngPrt_trqLimDA_CUR EngPrt_trqLim_CUR EngPrt_trqNLimSpr_CUR EngPrt_trqNLim_CUR /end DEF_CHARACTERISTIC
 /begin IN_MEASUREMENT APSCD_pVal Eng_nAvrg Eng_tEng Gearbx_stGear VSSCD_v /end IN_MEASUREMENT
/end FUNCTION
/begin FUNCTION engprt_fwoscdet ""
 /begin DEF_CHARACTERISTIC EngPrt_nTrqShutOff_C EngPrt_tiFWOscDetDebDef_C EngPrt_tiFWOscDetDebOk_C /end DEF_CHARACTERISTIC
/end FUNCTION
/begin FUNCTION engprt_fwoscdet_msg "" /begin OUT_MEASUREMENT EngPrt_stFWOscDet /end OUT_MEASUREMENT /end FUNCTION
/begin FUNCTION engprt_fwoscdet_uic "" /end FUNCTION
/begin FUNCTION engprt_msg ""
 /begin OUT_MEASUREMENT EngPrt_facPrtLim EngPrt_stOvrSpd EngPrt_trqLim EngPrt_trqNLim EngPrt_trqOvhtPrv EngPrt_trqPrtLim /end OUT_MEASUREMENT
/end FUNCTION
/begin FUNCTION engprt_prtlim_var_uic "" /end FUNCTION
/begin FUNCTION engprt_qprtlim "Begrenzungmenge zum thermischen Motorschutz" /begin DEF_CHARACTERISTIC EngPrt_qOvhtPrv_MAP /end DEF_CHARACTERISTIC /begin IN_MEASUREMENT Eng_tEng VSSCD_v /end IN_MEASUREMENT /end FUNCTION
/begin FUNCTION engprt_qprtlim_msg "" /begin OUT_MEASUREMENT EngPrt_qPrtLim /end OUT_MEASUREMENT /end FUNCTION
/begin FUNCTION engprt_qprtlim_uic "" /begin DEF_CHARACTERISTIC EngPrt_qPrtLim_Vector EngPrt_qPrtLim_Channel /end DEF_CHARACTERISTIC /end FUNCTION
/begin FUNCTION engprt_uic ""
 /begin DEF_CHARACTERISTIC EngPrt_trqNLim_Vector EngPrt_trqNLim_Channel EngPrt_trqPrtLim_Vector EngPrt_trqPrtLim_Channel /end DEF_CHARACTERISTIC
 /begin OUT_MEASUREMENT EngPrt_stTrqRampSwitch_mp EngPrt_trqLimPrvLim_mp EngPrt_trqRamLim1_mp EngPrt_trqRamLim_mp /end OUT_MEASUREMENT
/end FUNCTION
/begin FUNCTION engprt_var_msg "" /end FUNCTION
/begin FUNCTION eng_msg ""
 /begin OUT_MEASUREMENT Eng_dnAvrg Eng_nAvrg Eng_nCurr Eng_stOvrTemp Eng_stOvrTemp2 Eng_trqCrvMax /end OUT_MEASUREMENT
/end FUNCTION
/begin FUNCTION eng_teng "Motortemperatur" /begin DEF_CHARACTERISTIC Eng_tiOvrTemp2_C Eng_tiOvrTemp_C /end DEF_CHARACTERISTIC /end FUNCTION
/begin FUNCTION eng_teng_msg "" /begin OUT_MEASUREMENT Eng_tEng Eng_tFld Eng_tStrt /end OUT_MEASUREMENT /end FUNCTION
/begin FUNCTION eng_teng_uic "" /begin OUT_MEASUREMENT Eng_stOvrTemp_mp /end OUT_MEASUREMENT /end FUNCTION
/begin COMPU_METHOD AirMassPerCyl "Luftmasse pro Zylinder" RAT_FUNC "%6.3" "mg/Hub" COEFFS 0 10 0 0 0 1 /end COMPU_METHOD
/begin COMPU_METHOD AirMassPerTime "Luftmasse pro Zeit" RAT_FUNC "%6.3" "Kg/h" COEFFS 0 10 0 0 0 1 /end COMPU_METHOD
/begin COMPU_METHOD AngleCrS "Winkel Kurbelwelle" RAT_FUNC "%6.4" "deg CrS" COEFFS 0 42.6666666666667 0 0 0 1 /end COMPU_METHOD
/begin COMPU_METHOD Area "Flaeche mit hoher Aufloesung" RAT_FUNC "%6.5" "m*m" COEFFS 0 8192 0 0 0 1 /end COMPU_METHOD
/begin COMPU_METHOD Calory "Heizwert" RAT_FUNC "%6.2" "J/g" COEFFS 0 1 0 0 0 1 /end COMPU_METHOD
/begin COMPU_METHOD CubMtrPerHr "Volumsstrom in m^3/h" RAT_FUNC "%6.3" "m^3/h" COEFFS 0 10 0 0 0 1 /end COMPU_METHOD
/begin COMPU_METHOD dn_dZ20 "Motorbeschleunigung pro Zeit (dn/dt) (im 20 ms Raster)" RAT_FUNC "%6.1" "rmp/s" COEFFS 0 0.1 0 0 0 1 /end COMPU_METHOD
/begin COMPU_METHOD DtyCyc "Tastverhaeltnis" RAT_FUNC "%6.4" "%" COEFFS 0 100 0 0 0 1 /end COMPU_METHOD
/begin COMPU_METHOD EGTFact "Umrechnung für EGT_TempGvnr Ausgabeschnittstellen und Messpunkte" RAT_FUNC "%6.5" "-" COEFFS 0 1000 0 0 0 1 /end COMPU_METHOD
/begin COMPU_METHOD EGTSwt "Umrechnung für EGT Rampenschalter (1 / 1000*2^14 )" RAT_FUNC "%10.9" "-" COEFFS 0 16384000 0 0 0 1 /end COMPU_METHOD
/begin COMPU_METHOD EGTSwt_S16 "Faktor (0...1) für sint16 Type mit 0.000061 Auflösung" RAT_FUNC "%7.6" "-" COEFFS 0 16384 0 0 0 1 /end COMPU_METHOD
/begin COMPU_METHOD Energy "Energie in Jouls" RAT_FUNC "%6.2" "kJ" COEFFS 0 1 0 0 0 1 /end COMPU_METHOD
/begin COMPU_METHOD EngN "Motordrehzahl" RAT_FUNC "%6.2" "rpm" COEFFS 0 1 0 0 0 1 /end COMPU_METHOD
/begin COMPU_METHOD EngTempFldSel "Verbale Umrechnung für Auswahl aus dem Motortemperatur-Feld Eng_tFld" TAB_VERB "%6.3" "-" COMPU_TAB_REF EngTempFldSel /end COMPU_METHOD
/begin COMPU_VTAB EngTempFldSel "Verbale Umrechnung für Auswahl aus dem Motortemperatur-Feld Eng_tFld" TAB_VERB 3 0 "Coolant_Temperature" 1 "Oil_Temperature" 2 "Eng_tEng" /end COMPU_VTAB
/begin COMPU_METHOD Fact "Faktor mit Auflösung 1 / 8192, hauptsächlich für einen Faktorenbereich 0...1 verwendet" RAT_FUNC "%6.5" "-" COEFFS 0 8192 0 0 0 1 /end COMPU_METHOD
/begin COMPU_METHOD Fact1 "Faktor mit Auflösung 0,01 (100 mal höherer Bereich als Fact)" RAT_FUNC "%6.4" "-" COEFFS 0 128 0 0 0 1 /end COMPU_METHOD
/begin COMPU_METHOD FactLow "Faktor mit Auflösung 1/1024, hauptsächlich für einen Faktorenbereich 1...50 verwendet" RAT_FUNC "%6.5" "-" COEFFS 0 8192 0 0 0 1 /end COMPU_METHOD
/begin COMPU_METHOD Fact_PT1 "Faktor um die Zeitkonstante eines PT1 filters festzulegen (Taupunktermittlung)" RAT_FUNC "%6.4" "W/K" COEFFS 0 128 0 0 0 1 /end COMPU_METHOD
/begin COMPU_METHOD FanSpd "(MAXSINT16 / FANSPD_MAX) * phys" RAT_FUNC "%6.3" "1/min" COEFFS 0 10.9223333333333 0 0 0 1 /end COMPU_METHOD
/begin COMPU_METHOD Frequency_PA "Frequenz" RAT_FUNC "%6.2" "Hz" COEFFS 0 1 0 0 0 1 /end COMPU_METHOD
/begin COMPU_METHOD HeatCapacity "Waermekapazitaet einer Substanz" RAT_FUNC "%6.3" "J/K" COEFFS 0 10 0 0 0 1 /end COMPU_METHOD
/begin COMPU_METHOD InjMass "Einspritzmenge" RAT_FUNC "%6.4" "mg/hub" COEFFS 0 100 0 0 0 1 /end COMPU_METHOD
/begin COMPU_METHOD InjMassCorr "Korrektureinspritzmenge" RAT_FUNC "%6.5" "mg/hub" COEFFS 0 1000 0 0 0 1 /end COMPU_METHOD
/begin COMPU_METHOD InjMassCyc "Einspritzmenge pro Zyklus (mg/Zyklus)" RAT_FUNC "%6.4" "mg/cyc" COEFFS 0 100 0 0 0 1 /end COMPU_METHOD
/begin COMPU_METHOD InjMassInj "Einspritzmenge pro Einspritzung (mg/Einspritzung)" RAT_FUNC "%6.4" "mg/inj" COEFFS 0 100 0 0 0 1 /end COMPU_METHOD
/begin COMPU_METHOD InjTime_us "Zeit in Microsekunden für das Einspritztiming" RAT_FUNC "%6.2" "us" COEFFS 0 1 0 0 0 1 /end COMPU_METHOD
/begin COMPU_METHOD Ki_Kelv_Sec "Verstärkungskonstante für Integrator für zeitliche Ableitung der Temperatur" RAT_FUNC "%6.4" "1/s" COEFFS 0 429.4967296 0 0 0 1 /end COMPU_METHOD
/begin COMPU_METHOD Ki_Temp2EGTFact "Umrechnung für die Integrator Verstärkung des PI Reglers im EGT_TempGvnr [1/K]" RAT_FUNC "%8.7" "1/(K*s)" COEFFS 0 858993.4592 0 0 0 1 /end COMPU_METHOD
/begin COMPU_METHOD Kp_Temp2EGTFact "Umrechnung für die Proportional Verstärkung des PI Reglers im EGT_TempGvnr [1/K]" RAT_FUNC "%7.6" "1/K" COEFFS 0 51200 0 0 0 1 /end COMPU_METHOD
/begin COMPU_METHOD lambda "Lambda" RAT_FUNC "%6.5" "-" COEFFS 0 1000 0 0 0 1 /end COMPU_METHOD
/begin COMPU_METHOD Length1 "Abstand in Meter" RAT_FUNC "%6.4" "m" COEFFS 0 128 0 0 0 1 /end COMPU_METHOD
/begin COMPU_METHOD mSoot_g "Rußmasse [g]" RAT_FUNC "%6.4" "g" COEFFS 0 100 0 0 0 1 /end COMPU_METHOD
/begin COMPU_METHOD NumPinAdc "verbale Umrechnung für ADC Signale" TAB_VERB "%6.3" "-" COMPU_TAB_REF NumPinAdc /end COMPU_METHOD
/begin COMPU_VTAB NumPinAdc "verbale Umrechnung für ADC Signale" TAB_VERB 45 0 "Water_Temperature_Sensor_182" 1 "Intake_Air_Temperature_Sensor_157" 2 "Charge_Air_Temperature_Sensor_183" 3 "Exhaust_Temperature_Sensor_2_134" 4 "Exhaust_Temperature_Sensor_1_158" 5 "1st_APP_Sensor_252" 6 "2nd_APP_Sensor_239" 7 "ADC_REF" 8 "Boost_Pressure_Sensor_154" 9 "Atmospheric_Pressure_Sensor" 10 "Battery_Voltage_Sensor" 11 "Rail_Pressure_Sensor_156" 12 "Rail_Pressure_Peak_Value_156" 13 "Booster_Voltage_Sensor" 14 "Current_MeUn_Sensor" 15 "Current_PCV_Sensor" 16 "Voltage_Bank_1" 17 "Voltage_Bank_2" 18 "Pressure_Upstream_Particle_Filter_159" 19 "Engine_Oil_Pressure_110" 20 "Temperature_ECU_PCB" 21 "Voltage_Lambda_Ua" 22 "Voltage_Lambda_Ri" 23 "ADC_DUMMY_A_NOT_USED" 24 "ADC_DUMMY_NOT_USED" 25 "Charge_Actuator_Event_0" 26 "Voltage_Piezo_Actuator_Bank_2_Event_0" 27 "Voltage_Piezo_Actuator_Bank_1_Event_0" 28 "Charge_Actuator_Event_1" 29 "Voltage_Piezo_Actuator_Bank_2_Event_1" 30 "Voltage_Piezo_Actuator_Bank_1_Event_1" 31 "Charge_Actuator_Event_2" 32 "Voltage_Piezo_Actuator_Bank_2_Event_2" 33 "Voltage_Piezo_Actuator_Bank_1_Event_2" 34 "Charge_Actuator_Event_3" 35 "Voltage_Piezo_Actuator_Bank_2_Event_3" 36 "Voltage_Piezo_Actuator_Bank_1_Event_3" 37 "Charge_Actuator_Event_4" 38 "Voltage_Piezo_Actuator_Bank_2_Event_4" 39 "Voltage_Piezo_Actuator_Bank_1_Event_4" 40 "Charge_Actuator_Event_5" 41 "Voltage_Piezo_Actuator_Bank_2_Event_5" 42 "Voltage_Piezo_Actuator_Bank_1_Event_5" 43 "Booster_Voltage_Piezo" 44 "Piezo_Voltage" /end COMPU_VTAB
/begin COMPU_METHOD NumPinDia "Verbale Umrechnung für Diagnose Signale" TAB_VERB "%6.3" "-" COMPU_TAB_REF NumPinDia /end COMPU_METHOD
/begin COMPU_VTAB NumPinDia "Verbale Umrechnung für Diagnose Signale" TAB_VERB 35 0 "CJ945_Diagnostic_Signal" 1 "AC_Compressor_DiaSig" 2 "Fuel_Pump_DiaSig" 3 "Starter_234" 4 "Oil_Pressure_Lamp_Switch_245" 5 "Engine_Bay_Air_Flaps_123" 6 "Glow_Relay_Diagnostic_Signal1" 7 "reserved Glow_Relay_Diagnostic_Signal2" 8 "Ebox_Fan_Actuator_Diagnostic_Signal_219" 9 "Shuttr_Actuator_Diagnostic_Signal_231" 10 "Twostage_TurboLoading_SW_DiaSig" 11 "DIO_OUT_DIAGNOSTIC_DUMMY_NOT_USED" 12 "1st_Pressure_Control_Valve_Diagnostic_Signal_172" 13 "2nd_Pressure_Control_Valve_Diagnostic_Signal_172" 14 "1st_Metering_Unit_Diagnostic_Signal_171" 15 "2nd_Metering_Unit_Diagnostic_Signal_171" 16 "Boost_Pressure_Actuator_Diagnostic_Signal_193" 17 "Boost_Pressure_Actuator_Diagnostic_Signal_193_2" 18 "EGR_Actuator_Diagnostic_Signal_194" 19 "EGR_Actuator_Diagnostic_Signal2" 20 "Variable_Swirl_Actuator_Diagnostic_Signal_195" 21 "Throttle_Valve_Diagnostic_Signal_196" 22 "Throttle_Valve2_Diagnostic_Signal_196" 23 "FAN_240" 24 "Add_On_Heater_244" 25 "EngM_Bearing_Actuator_Diagnostic_Signal_124" 26 "EngM_Bearing_Actuator_Diagnostic_Signal_121" 27 "Low pressure stage BPA_Diagnostic_Signal_117" 28 "PWM_DIAGNOSTIC_DUMMY_NOT_USED" 29 "1st_Sensor_Supply_Voltage_DiaSig" 30 "2nd_Sensor_Supply_Voltage_DiaSig" 31 "3rd_Sensor_Supply_Voltage_DiaSig" 32 "4th_Sensor_Supply_Voltage_DiaSig" 33 "5th_Sensor_Supply_Voltage_DiaSig" 34 "6th_Sensor_Supply_Voltage_DiaSig" /end COMPU_VTAB
/begin COMPU_METHOD NumPinDioOut "Verbale Umrechnung für Digitalausgang Signale" TAB_VERB "%6.3" "-" COMPU_TAB_REF NumPinDioOut /end COMPU_METHOD
/begin COMPU_VTAB NumPinDioOut "Verbale Umrechnung für Digitalausgang Signale" TAB_VERB 11 0 "Main_Relay_220(144)" 1 "AC_Compressor" 2 "Fuel_Pump_232" 3 "Starter_234" 4 "OPS_Lamp_245" 5 "EBAF_123" 6 "Ebox_Fan_Actuator_219" 7 "Shuttr_Actuator_231" 8 "STATREG_PSOFF_Bit" 9 "Twostage_TurboLoading_120" 10 "DIO_OUT_DUMMY_NOT_USED" /end COMPU_VTAB
/begin COMPU_METHOD NumPinPwmOut "Verbale Umrechnung für PWM-Ausgang Signale" TAB_VERB "%6.3" "-" COMPU_TAB_REF NumPinPwmOut /end COMPU_METHOD
/begin COMPU_VTAB NumPinPwmOut "Verbale Umrechnung für PWM-Ausgang Signale" TAB_VERB 13 0 "Boost_Pressure_Actuator_193" 1 "EGR_Actuator_194" 2 "PCV_Actuator_172" 3 "MeUn_Actuator_171" 4 "Variable_Swirl_Actuator_195" 5 "Fan_Actuator_240" 6 "Add_On_Heater_244" 7 "EngM_Bearing_Actuator_124" 8 "EngM_Bearing_Actuator_121" 9 "Throttle Valve" 10 "LSU_Heater_PWMOutput" 11 "Low pressure stage BPA_117" 12 "PWM_DUMMY_NOT_USED" /end COMPU_VTAB
/begin COMPU_METHOD OneToOne "eins zu eins (physikalischer Wert ist gleich dem internen Wert)" RAT_FUNC "%6.2" "-" COEFFS 0 1 0 0 0 1 /end COMPU_METHOD
/begin COMPU_METHOD Period "Periodendauer" RAT_FUNC "%6.3" "ms" COEFFS 0 10 0 0 0 1 /end COMPU_METHOD
/begin COMPU_METHOD Prc "Prozent, gleiche interne Auflösung wie Fact, aber Darstellung in Prozent (0...100%)" RAT_FUNC "%6.4" "%" COEFFS 0 81.92 0 0 0 1 /end COMPU_METHOD
/begin COMPU_METHOD Pres_hPa "Druck (angezeigt in [hPa])" RAT_FUNC "%6.2" "hPa" COEFFS 0 1 0 0 0 1 /end COMPU_METHOD
/begin COMPU_METHOD Pwr "Leistung" RAT_FUNC "%6.2" "W" COEFFS 0 0.10610329539459 0 0 0 1 /end COMPU_METHOD
/begin COMPU_METHOD Pwr1 "Leistung mit Hoher Aufloesung" RAT_FUNC "%6.3" "W" COEFFS 0 10 0 0 0 1 /end COMPU_METHOD
/begin COMPU_METHOD Pwr_kW_Sec "Leistungsaenderungsrate in kW/s" RAT_FUNC "%6.4" "kW/s" COEFFS 0 100 0 0 0 1 /end COMPU_METHOD
/begin COMPU_METHOD ReynoldsNum "Reynolds Nummer um den thermischen Koeffizienten zu bestimmen" RAT_FUNC "%6.0" "-" COEFFS 0 0.01 0 0 0 1 /end COMPU_METHOD
/begin COMPU_METHOD RmpTemp "Rampengradient für Temperatur" RAT_FUNC "%6.4" "deg C/s" COEFFS 0 655.36 0 0 0 1 /end COMPU_METHOD
/begin COMPU_METHOD RmpTrq "Rampengradient für Motormoment" RAT_FUNC "%6.4" "Nm/s" COEFFS 0 655.36 0 0 0 1 /end COMPU_METHOD
/begin COMPU_METHOD SpecificHeat "spezifische Waermekapazitaet einer Substanz" RAT_FUNC "%7.6" "J/g/K" COEFFS 0 10000 0 0 0 1 /end COMPU_METHOD
/begin COMPU_METHOD TempDiff_Cels "difference/offset temperature displayed in degree celcius" RAT_FUNC "%6.3" "deg C" COEFFS 0 10 0 0 0 1 /end COMPU_METHOD
/begin COMPU_METHOD Temp_Cels "Temperatur dargestellt in °C (gleiche interne Darstellung wie Temp_Kelv)" RAT_FUNC "%6.1" "deg C" COEFFS 0 10 2731.4 0 0 1 /end COMPU_METHOD
/begin COMPU_METHOD Temp_Kelv_Sec "Temperaturaenderungsrate" RAT_FUNC "%6.4" "K/s" COEFFS 0 100 0 0 0 1 /end COMPU_METHOD
/begin COMPU_METHOD ThermalCoEff "Waermekoeffiziens einer Substanz" RAT_FUNC "%6.3" "W/m/m/K" COEFFS 0 10 0 0 0 1 /end COMPU_METHOD
/begin COMPU_METHOD TimeDeb "Entprellzeit in Millisekunden für Libraryfunktion Debounce" RAT_FUNC "%6.1" "ms" COEFFS 0 0.1 0 0 0 1 /end COMPU_METHOD
/begin COMPU_METHOD TimeDelay_s "Zeitkonstante T1 (in s) für PT1, DT1, etc." RAT_FUNC "%9.3" "s" COEFFS 0 0 1 0 0.00023283064365387 0 /end COMPU_METHOD
/begin COMPU_METHOD TimeDT "Abtastzeit (in us) für Library Regler, Filter, etc." RAT_FUNC "%6.2" "us" COEFFS 0 1 0 0 0 1 /end COMPU_METHOD
/begin COMPU_METHOD TimeEGTRmp "Umrechnung  Zeit in Rampensteigung,  Verwendet in EGT-Bibliothek" RAT_FUNC "%6.3" "s" COEFFS 0 0 1 0 0.0152587890625 0 /end COMPU_METHOD
/begin COMPU_METHOD TimeSys_us "Zeit in [us] mit Systemzeit-Auflösung" RAT_FUNC "%6.3" "us" COEFFS 0 3.4965 0 0 0 1 /end COMPU_METHOD
/begin COMPU_METHOD Time_ms "Zeit in ms für Fehlerentprellung (DSM) und SW-Timer" RAT_FUNC "%6.1" "ms" COEFFS 0 0.1 0 0 0 1 /end COMPU_METHOD
/begin COMPU_METHOD Time_s "Zeit in s für Fehlerentprellung (DSM) und SW-Timer" RAT_FUNC "%6.4" "s" COEFFS 0 100 0 0 0 1 /end COMPU_METHOD
/begin COMPU_METHOD Trq "Motormoment" RAT_FUNC "%6.3" "Nm" COEFFS 0 10 0 0 0 1 /end COMPU_METHOD
/begin COMPU_METHOD Vel "Fahrzeuggeschwindigkeit, gleiche interne Auflösung wie Vel_SI" RAT_FUNC "%6.4" "km/h" COEFFS 0 100 0 0 0 1 /end COMPU_METHOD
/begin COMPU_METHOD VelToN "Verhältnis Fahrzeuggeschwindigkeit zu Motordrehzahl v/n" RAT_FUNC "%8.7" "(km/h)/rpm" COEFFS 0 100000 0 0 0 1 /end COMPU_METHOD
/begin COMPU_METHOD Volt "Spannung in V (von ADC)" RAT_FUNC "%6.2" "mV" COEFFS 0 0.2046 0 0 0 1 /end COMPU_METHOD
/begin COMPU_METHOD Volt_Batt "Batteriespannung" RAT_FUNC "%6.1" "mV" COEFFS 0 0.05115 0 0 0 1 /end COMPU_METHOD
/begin COMPU_METHOD default "" RAT_FUNC "%6.2" "-" COEFFS 0 1 0 0 0 1 /end COMPU_METHOD
/begin RECORD_LAYOUT Kf_Xs16_Ys16_Ws16 NO_AXIS_PTS_X 1 SWORD NO_AXIS_PTS_Y 2 SWORD AXIS_PTS_X 3 SWORD INDEX_INCR DIRECT AXIS_PTS_Y 4 SWORD INDEX_INCR DIRECT FNC_VALUES 5 SWORD COLUMN_DIR DIRECT /end RECORD_LAYOUT
/begin RECORD_LAYOUT Kl_Xs16_Ws16 NO_AXIS_PTS_X 1 SWORD AXIS_PTS_X 2 SWORD INDEX_INCR DIRECT FNC_VALUES 3 SWORD COLUMN_DIR DIRECT /end RECORD_LAYOUT
/begin RECORD_LAYOUT Kwb_Ws16 FNC_VALUES 1 SWORD COLUMN_DIR DIRECT /end RECORD_LAYOUT
/begin RECORD_LAYOUT Kwb_Wu16 FNC_VALUES 1 UWORD COLUMN_DIR DIRECT /end RECORD_LAYOUT
/begin RECORD_LAYOUT Kwb_Wu32 FNC_VALUES 1 ULONG COLUMN_DIR DIRECT /end RECORD_LAYOUT
/begin RECORD_LAYOUT Kwb_Wu8 FNC_VALUES 1 UBYTE COLUMN_DIR DIRECT /end RECORD_LAYOUT
/begin RECORD_LAYOUT Kw_Ws16 FNC_VALUES 1 SWORD COLUMN_DIR DIRECT /end RECORD_LAYOUT
/begin RECORD_LAYOUT Kw_Ws32 FNC_VALUES 1 SLONG COLUMN_DIR DIRECT /end RECORD_LAYOUT
/begin RECORD_LAYOUT Kw_Wu16 FNC_VALUES 1 UWORD COLUMN_DIR DIRECT /end RECORD_LAYOUT
/begin RECORD_LAYOUT Kw_Wu32 FNC_VALUES 1 ULONG COLUMN_DIR DIRECT /end RECORD_LAYOUT
/begin RECORD_LAYOUT Kw_Wu8 FNC_VALUES 1 UBYTE COLUMN_DIR DIRECT /end RECORD_LAYOUT
/end MODULE
/end PROJECT
