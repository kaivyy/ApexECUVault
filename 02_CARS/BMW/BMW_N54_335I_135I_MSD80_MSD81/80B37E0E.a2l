ASAP2_VERSION 1 41
/begin PROJECT MSD70 "Spray Guided DI-System with Piezo Injectors for 6-Cylinder"
/begin HEADER "_default_HeaderComment" PROJECT_NO _0B /end HEADER
/begin MODULE _default_ModuleName "_default_ModuleLongIdentifier"
/begin MOD_COMMON "_default_ModCommonComment" DEPOSIT ABSOLUTE BYTE_ORDER MSB_LAST ALIGNMENT_BYTE 1 ALIGNMENT_WORD 2 ALIGNMENT_LONG 2 ALIGNMENT_FLOAT32_IEEE 2 ALIGNMENT_FLOAT64_IEEE 4 /end MOD_COMMON
/begin MEASUREMENT fmy_stat_alter_bn_bat.err_info_stat.lv_ready "Readiness flag related to diagnosis XX" UWORD _CNV_S_2_RANGE__0___1_CM 1 100. 0. 1. DISPLAY_IDENTIFIER LV_READY_ALTER_BN_BAT ECU_ADDRESS 0xd00041a6 BIT_MASK 0x10 /end MEASUREMENT
/begin MEASUREMENT fmy_stat_alter_bn_bat.err_info_stat.lv_end_diag "End of diagnosis XX" UWORD _CNV_S_2_RANGE__0___1_CM 1 100. 0. 1. DISPLAY_IDENTIFIER LV_END_DIAG_ALTER_BN_BAT ECU_ADDRESS 0xd00041a6 BIT_MASK 0x20 /end MEASUREMENT
/begin MEASUREMENT fmy_stat_alter_bn_bat.err_info_stat.lv_cdn_diag "Diagnosis condition to start symptom detection (set to 1 when condition is fulfilled)" UWORD _CNV_S_2_RANGE__0___1_CM 1 100. 0. 1. DISPLAY_IDENTIFIER LV_CDN_DIAG_ALTER_BN_BAT ECU_ADDRESS 0xd00041a6 BIT_MASK 0x40 /end MEASUREMENT
/begin MEASUREMENT fmy_stat_alter_bn_bat.err_info_stat.err_sym "For each symptom: status of failure (set to 1 when failure symptom is detected)" UWORD _CNV_S_16_RANGE_ERR__485_CM 1 100. 0. 15. DISPLAY_IDENTIFIER ERR_SYM_ALTER_BN_BAT ECU_ADDRESS 0xd00041a6 BIT_MASK 0x780 /end MEASUREMENT
/begin MEASUREMENT fmy_stat_vim_1_el.ctr_abc "anti-bounce counter for diagnosis XX" UBYTE _CNV_A_R_LINEAR_____0_CM 1 100. 0. 255. DISPLAY_IDENTIFIER CTR_ABC_VIM_1_EL ECU_ADDRESS 0xd000463c FORMAT "%3.0" /end MEASUREMENT
/begin MEASUREMENT fmy_stat_vim_1_el.ctr_end_diag "Counter for the end of diagnosis XX generation" UBYTE _CNV_A_R_LINEAR_____0_CM 1 100. 0. 255. DISPLAY_IDENTIFIER CTR_ABC_END_DIAG_VIM_1_EL ECU_ADDRESS 0xd000463d FORMAT "%3.0" /end MEASUREMENT
/begin MEASUREMENT fmy_stat_vim_1_el.err_info_stat.lv_err_mem "Failure is stored in dynamic memory (2nd layer)" UWORD _CNV_S_2_RANGE__0___1_CM 1 100. 0. 1. DISPLAY_IDENTIFIER LV_ERR_MEM_VIM_1_EL ECU_ADDRESS 0xd000463e BIT_MASK 0x8 /end MEASUREMENT
/begin MEASUREMENT fmy_stat_vim_1_el.err_info_stat.lv_ready "Readiness flag related to diagnosis XX" UWORD _CNV_S_2_RANGE__0___1_CM 1 100. 0. 1. DISPLAY_IDENTIFIER LV_READY_VIM_1_EL ECU_ADDRESS 0xd000463e BIT_MASK 0x10 /end MEASUREMENT
/begin MEASUREMENT fmy_stat_vim_1_el.err_info_stat.lv_end_diag "End of diagnosis XX" UWORD _CNV_S_2_RANGE__0___1_CM 1 100. 0. 1. DISPLAY_IDENTIFIER LV_END_DIAG_VIM_1_EL ECU_ADDRESS 0xd000463e BIT_MASK 0x20 /end MEASUREMENT
/begin MEASUREMENT fmy_stat_vim_1_el.err_info_stat.lv_cdn_diag "Diagnosis condition to start symptom detection (set to 1 when condition is fulfilled)" UWORD _CNV_S_2_RANGE__0___1_CM 1 100. 0. 1. DISPLAY_IDENTIFIER LV_CDN_DIAG_VIM_1_EL ECU_ADDRESS 0xd000463e BIT_MASK 0x40 /end MEASUREMENT
/begin MEASUREMENT fmy_stat_vim_1_el.err_info_stat.err_sym "For each symptom: status of failure (set to 1 when failure symptom is detected)" UWORD _CNV_S_16_RANGE_ERR__485_CM 1 100. 0. 15. DISPLAY_IDENTIFIER ERR_SYM_VIM_1_EL ECU_ADDRESS 0xd000463e BIT_MASK 0x780 /end MEASUREMENT
/begin MEASUREMENT fmy_stat_vim_2_el.ctr_abc "anti-bounce counter for diagnosis XX" UBYTE _CNV_A_R_LINEAR_____0_CM 1 100. 0. 255. DISPLAY_IDENTIFIER CTR_ABC_VIM_2_EL ECU_ADDRESS 0xd0004640 FORMAT "%3.0" /end MEASUREMENT
/begin MEASUREMENT fmy_stat_vim_2_el.ctr_end_diag "Counter for the end of diagnosis XX generation" UBYTE _CNV_A_R_LINEAR_____0_CM 1 100. 0. 255. DISPLAY_IDENTIFIER CTR_ABC_END_DIAG_VIM_2_EL ECU_ADDRESS 0xd0004641 FORMAT "%3.0" /end MEASUREMENT
/begin MEASUREMENT fmy_stat_vim_2_el.err_info_stat.lv_err_mem "Failure is stored in dynamic memory (2nd layer)" UWORD _CNV_S_2_RANGE__0___1_CM 1 100. 0. 1. DISPLAY_IDENTIFIER LV_ERR_MEM_VIM_2_EL ECU_ADDRESS 0xd0004642 BIT_MASK 0x8 /end MEASUREMENT
/begin MEASUREMENT fmy_stat_vim_2_el.err_info_stat.lv_ready "Readiness flag related to diagnosis XX" UWORD _CNV_S_2_RANGE__0___1_CM 1 100. 0. 1. DISPLAY_IDENTIFIER LV_READY_VIM_2_EL ECU_ADDRESS 0xd0004642 BIT_MASK 0x10 /end MEASUREMENT
/begin MEASUREMENT fmy_stat_vim_2_el.err_info_stat.lv_end_diag "End of diagnosis XX" UWORD _CNV_S_2_RANGE__0___1_CM 1 100. 0. 1. DISPLAY_IDENTIFIER LV_END_DIAG_VIM_2_EL ECU_ADDRESS 0xd0004642 BIT_MASK 0x20 /end MEASUREMENT
/begin MEASUREMENT fmy_stat_vim_2_el.err_info_stat.lv_cdn_diag "Diagnosis condition to start symptom detection (set to 1 when condition is fulfilled)" UWORD _CNV_S_2_RANGE__0___1_CM 1 100. 0. 1. DISPLAY_IDENTIFIER LV_CDN_DIAG_VIM_2_EL ECU_ADDRESS 0xd0004642 BIT_MASK 0x40 /end MEASUREMENT
/begin MEASUREMENT fmy_stat_vim_2_el.err_info_stat.err_sym "For each symptom: status of failure (set to 1 when failure symptom is detected)" UWORD _CNV_S_16_RANGE_ERR__485_CM 1 100. 0. 15. DISPLAY_IDENTIFIER ERR_SYM_VIM_2_EL ECU_ADDRESS 0xd0004642 BIT_MASK 0x780 /end MEASUREMENT
/begin MEASUREMENT fmy_stat_vimpwm_1_fb.ctr_abc "anti-bounce counter for diagnosis XX" UBYTE _CNV_A_R_LINEAR_____0_CM 1 100. 0. 255. DISPLAY_IDENTIFIER CTR_ABC_VIMPWM_1_FB ECU_ADDRESS 0xd0004648 FORMAT "%3.0" /end MEASUREMENT
/begin MEASUREMENT fmy_stat_vimpwm_1_fb.ctr_end_diag "Counter for the end of diagnosis XX generation" UBYTE _CNV_A_R_LINEAR_____0_CM 1 100. 0. 255. DISPLAY_IDENTIFIER CTR_ABC_END_DIAG_VIMPWM_1_FB ECU_ADDRESS 0xd0004649 FORMAT "%3.0" /end MEASUREMENT
/begin MEASUREMENT fmy_stat_vimpwm_1_fb.err_info_stat.lv_err_mem "Failure is stored in dynamic memory (2nd layer)" UWORD _CNV_S_2_RANGE__0___1_CM 1 100. 0. 1. DISPLAY_IDENTIFIER LV_ERR_MEM_VIMPWM_1_FB ECU_ADDRESS 0xd000464a BIT_MASK 0x8 /end MEASUREMENT
/begin MEASUREMENT fmy_stat_vimpwm_1_fb.err_info_stat.lv_ready "Readiness flag related to diagnosis XX" UWORD _CNV_S_2_RANGE__0___1_CM 1 100. 0. 1. DISPLAY_IDENTIFIER LV_READY_VIMPWM_1_FB ECU_ADDRESS 0xd000464a BIT_MASK 0x10 /end MEASUREMENT
/begin MEASUREMENT fmy_stat_vimpwm_1_fb.err_info_stat.lv_end_diag "End of diagnosis XX" UWORD _CNV_S_2_RANGE__0___1_CM 1 100. 0. 1. DISPLAY_IDENTIFIER LV_END_DIAG_VIMPWM_1_FB ECU_ADDRESS 0xd000464a BIT_MASK 0x20 /end MEASUREMENT
/begin MEASUREMENT fmy_stat_vimpwm_1_fb.err_info_stat.lv_cdn_diag "Diagnosis condition to start symptom detection (set to 1 when condition is fulfilled)" UWORD _CNV_S_2_RANGE__0___1_CM 1 100. 0. 1. DISPLAY_IDENTIFIER LV_CDN_DIAG_VIMPWM_1_FB ECU_ADDRESS 0xd000464a BIT_MASK 0x40 /end MEASUREMENT
/begin MEASUREMENT fmy_stat_vimpwm_1_fb.err_info_stat.err_sym "For each symptom: status of failure (set to 1 when failure symptom is detected)" UWORD _CNV_S_16_RANGE_ERR__485_CM 1 100. 0. 15. DISPLAY_IDENTIFIER ERR_SYM_VIMPWM_1_FB ECU_ADDRESS 0xd000464a BIT_MASK 0x780 /end MEASUREMENT
/begin MEASUREMENT fmy_stat_vimpwm_2_fb.ctr_abc "anti-bounce counter for diagnosis XX" UBYTE _CNV_A_R_LINEAR_____0_CM 1 100. 0. 255. DISPLAY_IDENTIFIER CTR_ABC_VIMPWM_2_FB ECU_ADDRESS 0xd000464c FORMAT "%3.0" /end MEASUREMENT
/begin MEASUREMENT fmy_stat_vimpwm_2_fb.ctr_end_diag "Counter for the end of diagnosis XX generation" UBYTE _CNV_A_R_LINEAR_____0_CM 1 100. 0. 255. DISPLAY_IDENTIFIER CTR_ABC_END_DIAG_VIMPWM_2_FB ECU_ADDRESS 0xd000464d FORMAT "%3.0" /end MEASUREMENT
/begin MEASUREMENT fmy_stat_vimpwm_2_fb.err_info_stat.lv_err_mem "Failure is stored in dynamic memory (2nd layer)" UWORD _CNV_S_2_RANGE__0___1_CM 1 100. 0. 1. DISPLAY_IDENTIFIER LV_ERR_MEM_VIMPWM_2_FB ECU_ADDRESS 0xd000464e BIT_MASK 0x8 /end MEASUREMENT
/begin MEASUREMENT fmy_stat_vimpwm_2_fb.err_info_stat.lv_ready "Readiness flag related to diagnosis XX" UWORD _CNV_S_2_RANGE__0___1_CM 1 100. 0. 1. DISPLAY_IDENTIFIER LV_READY_VIMPWM_2_FB ECU_ADDRESS 0xd000464e BIT_MASK 0x10 /end MEASUREMENT
/begin MEASUREMENT fmy_stat_vimpwm_2_fb.err_info_stat.lv_end_diag "End of diagnosis XX" UWORD _CNV_S_2_RANGE__0___1_CM 1 100. 0. 1. DISPLAY_IDENTIFIER LV_END_DIAG_VIMPWM_2_FB ECU_ADDRESS 0xd000464e BIT_MASK 0x20 /end MEASUREMENT
/begin MEASUREMENT fmy_stat_vimpwm_2_fb.err_info_stat.lv_cdn_diag "Diagnosis condition to start symptom detection (set to 1 when condition is fulfilled)" UWORD _CNV_S_2_RANGE__0___1_CM 1 100. 0. 1. DISPLAY_IDENTIFIER LV_CDN_DIAG_VIMPWM_2_FB ECU_ADDRESS 0xd000464e BIT_MASK 0x40 /end MEASUREMENT
/begin MEASUREMENT fmy_stat_vimpwm_2_fb.err_info_stat.err_sym "For each symptom: status of failure (set to 1 when failure symptom is detected)" UWORD _CNV_S_16_RANGE_ERR__485_CM 1 100. 0. 15. DISPLAY_IDENTIFIER ERR_SYM_VIMPWM_2_FB ECU_ADDRESS 0xd000464e BIT_MASK 0x780 /end MEASUREMENT
/begin MEASUREMENT fmy_stat_t_es.ctr_abc "anti-bounce counter for diagnosis XX" UBYTE _CNV_A_R_LINEAR_____0_CM 1 100. 0. 255. DISPLAY_IDENTIFIER CTR_ABC_T_ES ECU_ADDRESS 0xd000456c FORMAT "%3.0" /end MEASUREMENT
/begin MEASUREMENT fmy_stat_t_es.ctr_end_diag "Counter for the end of diagnosis XX generation" UBYTE _CNV_A_R_LINEAR_____0_CM 1 100. 0. 255. DISPLAY_IDENTIFIER CTR_ABC_END_DIAG_T_ES ECU_ADDRESS 0xd000456d FORMAT "%3.0" /end MEASUREMENT
/begin MEASUREMENT fmy_stat_t_es.err_info_stat.lv_err_mem "Failure is stored in dynamic memory (2nd layer)" UWORD _CNV_S_2_RANGE__0___1_CM 1 100. 0. 1. DISPLAY_IDENTIFIER LV_ERR_MEM_T_ES ECU_ADDRESS 0xd000456e BIT_MASK 0x8 /end MEASUREMENT
/begin MEASUREMENT fmy_stat_t_es.err_info_stat.lv_ready "Readiness flag related to diagnosis XX" UWORD _CNV_S_2_RANGE__0___1_CM 1 100. 0. 1. DISPLAY_IDENTIFIER LV_READY_T_ES ECU_ADDRESS 0xd000456e BIT_MASK 0x10 /end MEASUREMENT
/begin MEASUREMENT fmy_stat_t_es.err_info_stat.lv_end_diag "End of diagnosis XX" UWORD _CNV_S_2_RANGE__0___1_CM 1 100. 0. 1. DISPLAY_IDENTIFIER LV_END_DIAG_T_ES ECU_ADDRESS 0xd000456e BIT_MASK 0x20 /end MEASUREMENT
/begin MEASUREMENT fmy_stat_t_es.err_info_stat.lv_cdn_diag "Diagnosis condition to start symptom detection (set to 1 when condition is fulfilled)" UWORD _CNV_S_2_RANGE__0___1_CM 1 100. 0. 1. DISPLAY_IDENTIFIER LV_CDN_DIAG_T_ES ECU_ADDRESS 0xd000456e BIT_MASK 0x40 /end MEASUREMENT
/begin MEASUREMENT fmy_stat_t_es.err_info_stat.err_sym "For each symptom: status of failure (set to 1 when failure symptom is detected)" UWORD _CNV_S_16_RANGE_ERR__485_CM 1 100. 0. 15. DISPLAY_IDENTIFIER ERR_SYM_T_ES ECU_ADDRESS 0xd000456e BIT_MASK 0x780 /end MEASUREMENT
/begin MEASUREMENT fmy_stat_map_dip_plaus.ctr_abc "anti-bounce counter for diagnosis XX" UBYTE _CNV_A_R_LINEAR_____0_CM 1 100. 0. 255. DISPLAY_IDENTIFIER CTR_ABC_MAP_DIP_PLAUS ECU_ADDRESS 0xd00043fc FORMAT "%3.0" /end MEASUREMENT
/begin MEASUREMENT fmy_stat_map_dip_plaus.ctr_end_diag "Counter for the end of diagnosis XX generation" UBYTE _CNV_A_R_LINEAR_____0_CM 1 100. 0. 255. DISPLAY_IDENTIFIER CTR_ABC_END_DIAG_MAP_DIP_PLAUS ECU_ADDRESS 0xd00043fd FORMAT "%3.0" /end MEASUREMENT
/begin MEASUREMENT fmy_stat_map_dip_plaus.err_info_stat.lv_err_mem "Failure is stored in dynamic memory (2nd layer)" UWORD _CNV_S_2_RANGE__0___1_CM 1 100. 0. 1. DISPLAY_IDENTIFIER LV_ERR_MEM_MAP_DIP_PLAUS ECU_ADDRESS 0xd00043fe BIT_MASK 0x8 /end MEASUREMENT
/begin MEASUREMENT fmy_stat_map_dip_plaus.err_info_stat.lv_ready "Readiness flag related to diagnosis XX" UWORD _CNV_S_2_RANGE__0___1_CM 1 100. 0. 1. DISPLAY_IDENTIFIER LV_READY_MAP_DIP_PLAUS ECU_ADDRESS 0xd00043fe BIT_MASK 0x10 /end MEASUREMENT
/begin MEASUREMENT fmy_stat_map_dip_plaus.err_info_stat.lv_end_diag "End of diagnosis XX" UWORD _CNV_S_2_RANGE__0___1_CM 1 100. 0. 1. DISPLAY_IDENTIFIER LV_END_DIAG_MAP_DIP_PLAUS ECU_ADDRESS 0xd00043fe BIT_MASK 0x20 /end MEASUREMENT
/begin MEASUREMENT fmy_stat_map_dip_plaus.err_info_stat.lv_cdn_diag "Diagnosis condition to start symptom detection (set to 1 when condition is fulfilled)" UWORD _CNV_S_2_RANGE__0___1_CM 1 100. 0. 1. DISPLAY_IDENTIFIER LV_CDN_DIAG_MAP_DIP_PLAUS ECU_ADDRESS 0xd00043fe BIT_MASK 0x40 /end MEASUREMENT
/begin MEASUREMENT fmy_stat_map_dip_plaus.err_info_stat.err_sym "For each symptom: status of failure (set to 1 when failure symptom is detected)" UWORD _CNV_S_16_RANGE_ERR__485_CM 1 100. 0. 15. DISPLAY_IDENTIFIER ERR_SYM_MAP_DIP_PLAUS ECU_ADDRESS 0xd00043fe BIT_MASK 0x780 /end MEASUREMENT
/begin MEASUREMENT fmy_stat_toil_level.ctr_abc "anti-bounce counter for diagnosis XX" UBYTE _CNV_A_R_LINEAR_____0_CM 1 100. 0. 255. DISPLAY_IDENTIFIER CTR_ABC_TOIL_LEVEL ECU_ADDRESS 0xd00045b0 FORMAT "%3.0" /end MEASUREMENT
/begin MEASUREMENT fmy_stat_toil_level.ctr_end_diag "Counter for the end of diagnosis XX generation" UBYTE _CNV_A_R_LINEAR_____0_CM 1 100. 0. 255. DISPLAY_IDENTIFIER CTR_ABC_END_DIAG_TOIL_LEVEL ECU_ADDRESS 0xd00045b1 FORMAT "%3.0" /end MEASUREMENT
/begin MEASUREMENT fmy_stat_toil_level.err_info_stat.lv_err_mem "Failure is stored in dynamic memory (2nd layer)" UWORD _CNV_S_2_RANGE__0___1_CM 1 100. 0. 1. DISPLAY_IDENTIFIER LV_ERR_MEM_TOIL_LEVEL ECU_ADDRESS 0xd00045b2 BIT_MASK 0x8 /end MEASUREMENT
/begin MEASUREMENT fmy_stat_toil_level.err_info_stat.lv_ready "Readiness flag related to diagnosis XX" UWORD _CNV_S_2_RANGE__0___1_CM 1 100. 0. 1. DISPLAY_IDENTIFIER LV_READY_TOIL_LEVEL ECU_ADDRESS 0xd00045b2 BIT_MASK 0x10 /end MEASUREMENT
/begin MEASUREMENT fmy_stat_toil_level.err_info_stat.lv_end_diag "End of diagnosis XX" UWORD _CNV_S_2_RANGE__0___1_CM 1 100. 0. 1. DISPLAY_IDENTIFIER LV_END_DIAG_TOIL_LEVEL ECU_ADDRESS 0xd00045b2 BIT_MASK 0x20 /end MEASUREMENT
/begin MEASUREMENT fmy_stat_toil_level.err_info_stat.lv_cdn_diag "Diagnosis condition to start symptom detection (set to 1 when condition is fulfilled)" UWORD _CNV_S_2_RANGE__0___1_CM 1 100. 0. 1. DISPLAY_IDENTIFIER LV_CDN_DIAG_TOIL_LEVEL ECU_ADDRESS 0xd00045b2 BIT_MASK 0x40 /end MEASUREMENT
/begin MEASUREMENT fmy_stat_toil_level.err_info_stat.err_sym "For each symptom: status of failure (set to 1 when failure symptom is detected)" UWORD _CNV_S_16_RANGE_ERR__485_CM 1 100. 0. 15. DISPLAY_IDENTIFIER ERR_SYM_TOIL_LEVEL ECU_ADDRESS 0xd00045b2 BIT_MASK 0x780 /end MEASUREMENT
/begin MEASUREMENT fmy_stat_vim_plaus.ctr_abc "anti-bounce counter for diagnosis XX" UBYTE _CNV_A_R_LINEAR_____0_CM 1 100. 0. 255. DISPLAY_IDENTIFIER CTR_ABC_VIM_PLAUS ECU_ADDRESS 0xd0004644 FORMAT "%3.0" /end MEASUREMENT
/begin MEASUREMENT fmy_stat_vim_plaus.ctr_end_diag "Counter for the end of diagnosis XX generation" UBYTE _CNV_A_R_LINEAR_____0_CM 1 100. 0. 255. DISPLAY_IDENTIFIER CTR_ABC_END_DIAG_VIM_PLAUS ECU_ADDRESS 0xd0004645 FORMAT "%3.0" /end MEASUREMENT
/begin MEASUREMENT fmy_stat_vim_plaus.err_info_stat.lv_err_mem "Failure is stored in dynamic memory (2nd layer)" UWORD _CNV_S_2_RANGE__0___1_CM 1 100. 0. 1. DISPLAY_IDENTIFIER LV_ERR_MEM_VIM_PLAUS ECU_ADDRESS 0xd0004646 BIT_MASK 0x8 /end MEASUREMENT
/begin MEASUREMENT fmy_stat_vim_plaus.err_info_stat.lv_ready "Readiness flag related to diagnosis XX" UWORD _CNV_S_2_RANGE__0___1_CM 1 100. 0. 1. DISPLAY_IDENTIFIER LV_READY_VIM_PLAUS ECU_ADDRESS 0xd0004646 BIT_MASK 0x10 /end MEASUREMENT
/begin MEASUREMENT fmy_stat_vim_plaus.err_info_stat.lv_end_diag "End of diagnosis XX" UWORD _CNV_S_2_RANGE__0___1_CM 1 100. 0. 1. DISPLAY_IDENTIFIER LV_END_DIAG_VIM_PLAUS ECU_ADDRESS 0xd0004646 BIT_MASK 0x20 /end MEASUREMENT
/begin MEASUREMENT fmy_stat_vim_plaus.err_info_stat.lv_cdn_diag "Diagnosis condition to start symptom detection (set to 1 when condition is fulfilled)" UWORD _CNV_S_2_RANGE__0___1_CM 1 100. 0. 1. DISPLAY_IDENTIFIER LV_CDN_DIAG_VIM_PLAUS ECU_ADDRESS 0xd0004646 BIT_MASK 0x40 /end MEASUREMENT
/begin MEASUREMENT fmy_stat_vim_plaus.err_info_stat.err_sym "For each symptom: status of failure (set to 1 when failure symptom is detected)" UWORD _CNV_S_16_RANGE_ERR__485_CM 1 100. 0. 15. DISPLAY_IDENTIFIER ERR_SYM_VIM_PLAUS ECU_ADDRESS 0xd0004646 BIT_MASK 0x780 /end MEASUREMENT
/begin MEASUREMENT fmy_stat_alter_bn_rgn.ctr_abc "anti-bounce counter for diagnosis XX" UBYTE _CNV_A_R_LINEAR_____0_CM 1 100. 0. 255. DISPLAY_IDENTIFIER CTR_ABC_ALTER_BN_RGN ECU_ADDRESS 0xd00041a8 FORMAT "%3.0" /end MEASUREMENT
/begin MEASUREMENT fmy_stat_alter_bn_rgn.ctr_end_diag "Counter for the end of diagnosis XX generation" UBYTE _CNV_A_R_LINEAR_____0_CM 1 100. 0. 255. DISPLAY_IDENTIFIER CTR_ABC_END_DIAG_ALTER_BN_RGN ECU_ADDRESS 0xd00041a9 FORMAT "%3.0" /end MEASUREMENT
/begin MEASUREMENT fmy_stat_alter_bn_rgn.err_info_stat.lv_err_mem "Failure is stored in dynamic memory (2nd layer)" UWORD _CNV_S_2_RANGE__0___1_CM 1 100. 0. 1. DISPLAY_IDENTIFIER LV_ERR_MEM_ALTER_BN_RGN ECU_ADDRESS 0xd00041aa BIT_MASK 0x8 /end MEASUREMENT
/begin MEASUREMENT fmy_stat_alter_bn_rgn.err_info_stat.lv_ready "Readiness flag related to diagnosis XX" UWORD _CNV_S_2_RANGE__0___1_CM 1 100. 0. 1. DISPLAY_IDENTIFIER LV_READY_ALTER_BN_RGN ECU_ADDRESS 0xd00041aa BIT_MASK 0x10 /end MEASUREMENT
/begin MEASUREMENT fmy_stat_alter_bn_rgn.err_info_stat.lv_end_diag "End of diagnosis XX" UWORD _CNV_S_2_RANGE__0___1_CM 1 100. 0. 1. DISPLAY_IDENTIFIER LV_END_DIAG_ALTER_BN_RGN ECU_ADDRESS 0xd00041aa BIT_MASK 0x20 /end MEASUREMENT
/begin MEASUREMENT fmy_stat_alter_bn_rgn.err_info_stat.lv_cdn_diag "Diagnosis condition to start symptom detection (set to 1 when condition is fulfilled)" UWORD _CNV_S_2_RANGE__0___1_CM 1 100. 0. 1. DISPLAY_IDENTIFIER LV_CDN_DIAG_ALTER_BN_RGN ECU_ADDRESS 0xd00041aa BIT_MASK 0x40 /end MEASUREMENT
/begin MEASUREMENT fmy_stat_alter_bn_rgn.err_info_stat.err_sym "For each symptom: status of failure (set to 1 when failure symptom is detected)" UWORD _CNV_S_16_RANGE_ERR__485_CM 1 100. 0. 15. DISPLAY_IDENTIFIER ERR_SYM_ALTER_BN_RGN ECU_ADDRESS 0xd00041aa BIT_MASK 0x780 /end MEASUREMENT
/begin MEASUREMENT fmy_stat_per_cam_in_1.ctr_abc "anti-bounce counter for diagnosis XX" UBYTE _CNV_A_R_LINEAR_____0_CM 1 100. 0. 255. DISPLAY_IDENTIFIER CTR_ABC_PER_CAM_IN_1 ECU_ADDRESS 0xd0004490 FORMAT "%3.0" /end MEASUREMENT
/begin MEASUREMENT fmy_stat_per_cam_in_1.ctr_end_diag "Counter for the end of diagnosis XX generation" UBYTE _CNV_A_R_LINEAR_____0_CM 1 100. 0. 255. DISPLAY_IDENTIFIER CTR_ABC_END_DIAG_PER_CAM_IN_1 ECU_ADDRESS 0xd0004491 FORMAT "%3.0" /end MEASUREMENT
/begin MEASUREMENT fmy_stat_per_cam_in_1.err_info_stat.lv_err_mem "Failure is stored in dynamic memory (2nd layer)" UWORD _CNV_S_2_RANGE__0___1_CM 1 100. 0. 1. DISPLAY_IDENTIFIER LV_ERR_MEM_PER_CAM_IN_1 ECU_ADDRESS 0xd0004492 BIT_MASK 0x8 /end MEASUREMENT
/begin MEASUREMENT fmy_stat_per_cam_in_1.err_info_stat.lv_ready "Readiness flag related to diagnosis XX" UWORD _CNV_S_2_RANGE__0___1_CM 1 100. 0. 1. DISPLAY_IDENTIFIER LV_READY_PER_CAM_IN_1 ECU_ADDRESS 0xd0004492 BIT_MASK 0x10 /end MEASUREMENT
/begin MEASUREMENT fmy_stat_per_cam_in_1.err_info_stat.lv_end_diag "End of diagnosis XX" UWORD _CNV_S_2_RANGE__0___1_CM 1 100. 0. 1. DISPLAY_IDENTIFIER LV_END_DIAG_PER_CAM_IN_1 ECU_ADDRESS 0xd0004492 BIT_MASK 0x20 /end MEASUREMENT
/begin MEASUREMENT fmy_stat_per_cam_in_1.err_info_stat.lv_cdn_diag "Diagnosis condition to start symptom detection (set to 1 when condition is fulfilled)" UWORD _CNV_S_2_RANGE__0___1_CM 1 100. 0. 1. DISPLAY_IDENTIFIER LV_CDN_DIAG_PER_CAM_IN_1 ECU_ADDRESS 0xd0004492 BIT_MASK 0x40 /end MEASUREMENT
/begin MEASUREMENT fmy_stat_per_cam_in_1.err_info_stat.err_sym "For each symptom: status of failure (set to 1 when failure symptom is detected)" UWORD _CNV_S_16_RANGE_ERR__485_CM 1 100. 0. 15. DISPLAY_IDENTIFIER ERR_SYM_PER_CAM_IN_1 ECU_ADDRESS 0xd0004492 BIT_MASK 0x780 /end MEASUREMENT
/begin MEASUREMENT fmy_stat_per_cam_ex_1.ctr_abc "anti-bounce counter for diagnosis XX" UBYTE _CNV_A_R_LINEAR_____0_CM 1 100. 0. 255. DISPLAY_IDENTIFIER CTR_ABC_PER_CAM_EX_1 ECU_ADDRESS 0xd000448c FORMAT "%3.0" /end MEASUREMENT
/begin MEASUREMENT fmy_stat_per_cam_ex_1.ctr_end_diag "Counter for the end of diagnosis XX generation" UBYTE _CNV_A_R_LINEAR_____0_CM 1 100. 0. 255. DISPLAY_IDENTIFIER CTR_ABC_END_DIAG_PER_CAM_EX_1 ECU_ADDRESS 0xd000448d FORMAT "%3.0" /end MEASUREMENT
/begin MEASUREMENT fmy_stat_per_cam_ex_1.err_info_stat.lv_err_mem "Failure is stored in dynamic memory (2nd layer)" UWORD _CNV_S_2_RANGE__0___1_CM 1 100. 0. 1. DISPLAY_IDENTIFIER LV_ERR_MEM_PER_CAM_EX_1 ECU_ADDRESS 0xd000448e BIT_MASK 0x8 /end MEASUREMENT
/begin MEASUREMENT fmy_stat_per_cam_ex_1.err_info_stat.lv_ready "Readiness flag related to diagnosis XX" UWORD _CNV_S_2_RANGE__0___1_CM 1 100. 0. 1. DISPLAY_IDENTIFIER LV_READY_PER_CAM_EX_1 ECU_ADDRESS 0xd000448e BIT_MASK 0x10 /end MEASUREMENT
/begin MEASUREMENT fmy_stat_per_cam_ex_1.err_info_stat.lv_end_diag "End of diagnosis XX" UWORD _CNV_S_2_RANGE__0___1_CM 1 100. 0. 1. DISPLAY_IDENTIFIER LV_END_DIAG_PER_CAM_EX_1 ECU_ADDRESS 0xd000448e BIT_MASK 0x20 /end MEASUREMENT
/begin MEASUREMENT fmy_stat_per_cam_ex_1.err_info_stat.lv_cdn_diag "Diagnosis condition to start symptom detection (set to 1 when condition is fulfilled)" UWORD _CNV_S_2_RANGE__0___1_CM 1 100. 0. 1. DISPLAY_IDENTIFIER LV_CDN_DIAG_PER_CAM_EX_1 ECU_ADDRESS 0xd000448e BIT_MASK 0x40 /end MEASUREMENT
/begin MEASUREMENT fmy_stat_per_cam_ex_1.err_info_stat.err_sym "For each symptom: status of failure (set to 1 when failure symptom is detected)" UWORD _CNV_S_16_RANGE_ERR__485_CM 1 100. 0. 15. DISPLAY_IDENTIFIER ERR_SYM_PER_CAM_EX_1 ECU_ADDRESS 0xd000448e BIT_MASK 0x780 /end MEASUREMENT
/begin MEASUREMENT fmy_stat_syn_cam_in_1.ctr_abc "anti-bounce counter for diagnosis XX" UBYTE _CNV_A_R_LINEAR_____0_CM 1 100. 0. 255. DISPLAY_IDENTIFIER CTR_ABC_SYN_CAM_IN_1 ECU_ADDRESS 0xd0004560 FORMAT "%3.0" /end MEASUREMENT
/begin MEASUREMENT fmy_stat_syn_cam_in_1.ctr_end_diag "Counter for the end of diagnosis XX generation" UBYTE _CNV_A_R_LINEAR_____0_CM 1 100. 0. 255. DISPLAY_IDENTIFIER CTR_ABC_END_DIAG_SYN_CAM_IN_1 ECU_ADDRESS 0xd0004561 FORMAT "%3.0" /end MEASUREMENT
/begin MEASUREMENT fmy_stat_syn_cam_in_1.err_info_stat.lv_err_mem "Failure is stored in dynamic memory (2nd layer)" UWORD _CNV_S_2_RANGE__0___1_CM 1 100. 0. 1. DISPLAY_IDENTIFIER LV_ERR_MEM_SYN_CAM_IN_1 ECU_ADDRESS 0xd0004562 BIT_MASK 0x8 /end MEASUREMENT
/begin MEASUREMENT fmy_stat_syn_cam_in_1.err_info_stat.lv_ready "Readiness flag related to diagnosis XX" UWORD _CNV_S_2_RANGE__0___1_CM 1 100. 0. 1. DISPLAY_IDENTIFIER LV_READY_SYN_CAM_IN_1 ECU_ADDRESS 0xd0004562 BIT_MASK 0x10 /end MEASUREMENT
/begin MEASUREMENT fmy_stat_syn_cam_in_1.err_info_stat.lv_end_diag "End of diagnosis XX" UWORD _CNV_S_2_RANGE__0___1_CM 1 100. 0. 1. DISPLAY_IDENTIFIER LV_END_DIAG_SYN_CAM_IN_1 ECU_ADDRESS 0xd0004562 BIT_MASK 0x20 /end MEASUREMENT
/begin MEASUREMENT fmy_stat_syn_cam_in_1.err_info_stat.lv_cdn_diag "Diagnosis condition to start symptom detection (set to 1 when condition is fulfilled)" UWORD _CNV_S_2_RANGE__0___1_CM 1 100. 0. 1. DISPLAY_IDENTIFIER LV_CDN_DIAG_SYN_CAM_IN_1 ECU_ADDRESS 0xd0004562 BIT_MASK 0x40 /end MEASUREMENT
/begin MEASUREMENT fmy_stat_syn_cam_in_1.err_info_stat.err_sym "For each symptom: status of failure (set to 1 when failure symptom is detected)" UWORD _CNV_S_16_RANGE_ERR__485_CM 1 100. 0. 15. DISPLAY_IDENTIFIER ERR_SYM_SYN_CAM_IN_1 ECU_ADDRESS 0xd0004562 BIT_MASK 0x780 /end MEASUREMENT
/begin MEASUREMENT fmy_stat_syn_cam_ex_1.ctr_abc "anti-bounce counter for diagnosis XX" UBYTE _CNV_A_R_LINEAR_____0_CM 1 100. 0. 255. DISPLAY_IDENTIFIER CTR_ABC_SYN_CAM_EX_1 ECU_ADDRESS 0xd000455c FORMAT "%3.0" /end MEASUREMENT
/begin MEASUREMENT fmy_stat_syn_cam_ex_1.ctr_end_diag "Counter for the end of diagnosis XX generation" UBYTE _CNV_A_R_LINEAR_____0_CM 1 100. 0. 255. DISPLAY_IDENTIFIER CTR_ABC_END_DIAG_SYN_CAM_EX_1 ECU_ADDRESS 0xd000455d FORMAT "%3.0" /end MEASUREMENT
/begin MEASUREMENT fmy_stat_syn_cam_ex_1.err_info_stat.lv_err_mem "Failure is stored in dynamic memory (2nd layer)" UWORD _CNV_S_2_RANGE__0___1_CM 1 100. 0. 1. DISPLAY_IDENTIFIER LV_ERR_MEM_SYN_CAM_EX_1 ECU_ADDRESS 0xd000455e BIT_MASK 0x8 /end MEASUREMENT
/begin MEASUREMENT fmy_stat_syn_cam_ex_1.err_info_stat.lv_ready "Readiness flag related to diagnosis XX" UWORD _CNV_S_2_RANGE__0___1_CM 1 100. 0. 1. DISPLAY_IDENTIFIER LV_READY_SYN_CAM_EX_1 ECU_ADDRESS 0xd000455e BIT_MASK 0x10 /end MEASUREMENT
/begin MEASUREMENT fmy_stat_syn_cam_ex_1.err_info_stat.lv_end_diag "End of diagnosis XX" UWORD _CNV_S_2_RANGE__0___1_CM 1 100. 0. 1. DISPLAY_IDENTIFIER LV_END_DIAG_SYN_CAM_EX_1 ECU_ADDRESS 0xd000455e BIT_MASK 0x20 /end MEASUREMENT
/begin MEASUREMENT fmy_stat_syn_cam_ex_1.err_info_stat.lv_cdn_diag "Diagnosis condition to start symptom detection (set to 1 when condition is fulfilled)" UWORD _CNV_S_2_RANGE__0___1_CM 1 100. 0. 1. DISPLAY_IDENTIFIER LV_CDN_DIAG_SYN_CAM_EX_1 ECU_ADDRESS 0xd000455e BIT_MASK 0x40 /end MEASUREMENT
/begin MEASUREMENT fmy_stat_syn_cam_ex_1.err_info_stat.err_sym "For each symptom: status of failure (set to 1 when failure symptom is detected)" UWORD _CNV_S_16_RANGE_ERR__485_CM 1 100. 0. 15. DISPLAY_IDENTIFIER ERR_SYM_SYN_CAM_EX_1 ECU_ADDRESS 0xd000455e BIT_MASK 0x780 /end MEASUREMENT
/begin MEASUREMENT fmy_stat_ref_crk_cam_in_1.ctr_abc "anti-bounce counter for diagnosis XX" UBYTE _CNV_A_R_LINEAR_____0_CM 1 100. 0. 255. DISPLAY_IDENTIFIER CTR_ABC_REF_CRK_CAM_IN_1 ECU_ADDRESS 0xd00044e0 FORMAT "%3.0" /end MEASUREMENT
/begin MEASUREMENT fmy_stat_ref_crk_cam_in_1.ctr_end_diag "Counter for the end of diagnosis XX generation" UBYTE _CNV_A_R_LINEAR_____0_CM 1 100. 0. 255. DISPLAY_IDENTIFIER CTR_ABC_END_DIAG_REF_CRK_CAM_IN_1 ECU_ADDRESS 0xd00044e1 FORMAT "%3.0" /end MEASUREMENT
/begin MEASUREMENT fmy_stat_ref_crk_cam_in_1.err_info_stat.lv_err_mem "Failure is stored in dynamic memory (2nd layer)" UWORD _CNV_S_2_RANGE__0___1_CM 1 100. 0. 1. DISPLAY_IDENTIFIER LV_ERR_MEM_REF_CRK_CAM_IN_1 ECU_ADDRESS 0xd00044e2 BIT_MASK 0x8 /end MEASUREMENT
/begin MEASUREMENT fmy_stat_ref_crk_cam_in_1.err_info_stat.lv_ready "Readiness flag related to diagnosis XX" UWORD _CNV_S_2_RANGE__0___1_CM 1 100. 0. 1. DISPLAY_IDENTIFIER LV_READY_REF_CRK_CAM_IN_1 ECU_ADDRESS 0xd00044e2 BIT_MASK 0x10 /end MEASUREMENT
/begin MEASUREMENT fmy_stat_ref_crk_cam_in_1.err_info_stat.lv_end_diag "End of diagnosis XX" UWORD _CNV_S_2_RANGE__0___1_CM 1 100. 0. 1. DISPLAY_IDENTIFIER LV_END_DIAG_REF_CRK_CAM_IN_1 ECU_ADDRESS 0xd00044e2 BIT_MASK 0x20 /end MEASUREMENT
/begin MEASUREMENT fmy_stat_ref_crk_cam_in_1.err_info_stat.lv_cdn_diag "Diagnosis condition to start symptom detection (set to 1 when condition is fulfilled)" UWORD _CNV_S_2_RANGE__0___1_CM 1 100. 0. 1. DISPLAY_IDENTIFIER LV_CDN_DIAG_REF_CRK_CAM_IN_1 ECU_ADDRESS 0xd00044e2 BIT_MASK 0x40 /end MEASUREMENT
/begin MEASUREMENT fmy_stat_ref_crk_cam_in_1.err_info_stat.err_sym "For each symptom: status of failure (set to 1 when failure symptom is detected)" UWORD _CNV_S_16_RANGE_ERR__485_CM 1 100. 0. 15. DISPLAY_IDENTIFIER ERR_SYM_REF_CRK_CAM_IN_1 ECU_ADDRESS 0xd00044e2 BIT_MASK 0x780 /end MEASUREMENT
/begin MEASUREMENT fmy_stat_ref_crk_cam_ex_1.ctr_abc "anti-bounce counter for diagnosis XX" UBYTE _CNV_A_R_LINEAR_____0_CM 1 100. 0. 255. DISPLAY_IDENTIFIER CTR_ABC_REF_CRK_CAM_EX_1 ECU_ADDRESS 0xd00044dc FORMAT "%3.0" /end MEASUREMENT
/begin MEASUREMENT fmy_stat_ref_crk_cam_ex_1.ctr_end_diag "Counter for the end of diagnosis XX generation" UBYTE _CNV_A_R_LINEAR_____0_CM 1 100. 0. 255. DISPLAY_IDENTIFIER CTR_ABC_END_DIAG_REF_CRK_CAM_EX_1 ECU_ADDRESS 0xd00044dd FORMAT "%3.0" /end MEASUREMENT
/begin MEASUREMENT fmy_stat_ref_crk_cam_ex_1.err_info_stat.lv_err_mem "Failure is stored in dynamic memory (2nd layer)" UWORD _CNV_S_2_RANGE__0___1_CM 1 100. 0. 1. DISPLAY_IDENTIFIER LV_ERR_MEM_REF_CRK_CAM_EX_1 ECU_ADDRESS 0xd00044de BIT_MASK 0x8 /end MEASUREMENT
/begin MEASUREMENT fmy_stat_ref_crk_cam_ex_1.err_info_stat.lv_ready "Readiness flag related to diagnosis XX" UWORD _CNV_S_2_RANGE__0___1_CM 1 100. 0. 1. DISPLAY_IDENTIFIER LV_READY_REF_CRK_CAM_EX_1 ECU_ADDRESS 0xd00044de BIT_MASK 0x10 /end MEASUREMENT
/begin MEASUREMENT fmy_stat_ref_crk_cam_ex_1.err_info_stat.lv_end_diag "End of diagnosis XX" UWORD _CNV_S_2_RANGE__0___1_CM 1 100. 0. 1. DISPLAY_IDENTIFIER LV_END_DIAG_REF_CRK_CAM_EX_1 ECU_ADDRESS 0xd00044de BIT_MASK 0x20 /end MEASUREMENT
/begin MEASUREMENT fmy_stat_ref_crk_cam_ex_1.err_info_stat.lv_cdn_diag "Diagnosis condition to start symptom detection (set to 1 when condition is fulfilled)" UWORD _CNV_S_2_RANGE__0___1_CM 1 100. 0. 1. DISPLAY_IDENTIFIER LV_CDN_DIAG_REF_CRK_CAM_EX_1 ECU_ADDRESS 0xd00044de BIT_MASK 0x40 /end MEASUREMENT
/begin MEASUREMENT fmy_stat_ref_crk_cam_ex_1.err_info_stat.err_sym "For each symptom: status of failure (set to 1 when failure symptom is detected)" UWORD _CNV_S_16_RANGE_ERR__485_CM 1 100. 0. 15. DISPLAY_IDENTIFIER ERR_SYM_REF_CRK_CAM_EX_1 ECU_ADDRESS 0xd00044de BIT_MASK 0x780 /end MEASUREMENT
/begin MEASUREMENT fmy_stat_crk_tooth.ctr_abc "anti-bounce counter for diagnosis XX" UBYTE _CNV_A_R_LINEAR_____0_CM 1 100. 0. 255. DISPLAY_IDENTIFIER CTR_ABC_CRK_TOOTH ECU_ADDRESS 0xd0004278 FORMAT "%3.0" /end MEASUREMENT
/begin MEASUREMENT fmy_stat_crk_tooth.ctr_end_diag "Counter for the end of diagnosis XX generation" UBYTE _CNV_A_R_LINEAR_____0_CM 1 100. 0. 255. DISPLAY_IDENTIFIER CTR_ABC_END_DIAG_CRK_TOOTH ECU_ADDRESS 0xd0004279 FORMAT "%3.0" /end MEASUREMENT
/begin MEASUREMENT fmy_stat_crk_tooth.err_info_stat.lv_err_mem "Failure is stored in dynamic memory (2nd layer)" UWORD _CNV_S_2_RANGE__0___1_CM 1 100. 0. 1. DISPLAY_IDENTIFIER LV_ERR_MEM_CRK_TOOTH ECU_ADDRESS 0xd000427a BIT_MASK 0x8 /end MEASUREMENT
/begin MEASUREMENT fmy_stat_crk_tooth.err_info_stat.lv_ready "Readiness flag related to diagnosis XX" UWORD _CNV_S_2_RANGE__0___1_CM 1 100. 0. 1. DISPLAY_IDENTIFIER LV_READY_CRK_TOOTH ECU_ADDRESS 0xd000427a BIT_MASK 0x10 /end MEASUREMENT
/begin MEASUREMENT fmy_stat_crk_tooth.err_info_stat.lv_end_diag "End of diagnosis XX" UWORD _CNV_S_2_RANGE__0___1_CM 1 100. 0. 1. DISPLAY_IDENTIFIER LV_END_DIAG_CRK_TOOTH ECU_ADDRESS 0xd000427a BIT_MASK 0x20 /end MEASUREMENT
/begin MEASUREMENT fmy_stat_crk_tooth.err_info_stat.lv_cdn_diag "Diagnosis condition to start symptom detection (set to 1 when condition is fulfilled)" UWORD _CNV_S_2_RANGE__0___1_CM 1 100. 0. 1. DISPLAY_IDENTIFIER LV_CDN_DIAG_CRK_TOOTH ECU_ADDRESS 0xd000427a BIT_MASK 0x40 /end MEASUREMENT
/begin MEASUREMENT fmy_stat_crk_tooth.err_info_stat.err_sym "For each symptom: status of failure (set to 1 when failure symptom is detected)" UWORD _CNV_S_16_RANGE_ERR__485_CM 1 100. 0. 15. DISPLAY_IDENTIFIER ERR_SYM_CRK_TOOTH ECU_ADDRESS 0xd000427a BIT_MASK 0x780 /end MEASUREMENT
/begin MEASUREMENT fmy_stat_crk_tooth_per.ctr_abc "anti-bounce counter for diagnosis XX" UBYTE _CNV_A_R_LINEAR_____0_CM 1 100. 0. 255. DISPLAY_IDENTIFIER CTR_ABC_CRK_TOOTH_PER ECU_ADDRESS 0xd000427c FORMAT "%3.0" /end MEASUREMENT
/begin MEASUREMENT fmy_stat_crk_tooth_per.ctr_end_diag "Counter for the end of diagnosis XX generation" UBYTE _CNV_A_R_LINEAR_____0_CM 1 100. 0. 255. DISPLAY_IDENTIFIER CTR_ABC_END_DIAG_CRK_TOOTH_PER ECU_ADDRESS 0xd000427d FORMAT "%3.0" /end MEASUREMENT
/begin MEASUREMENT fmy_stat_crk_tooth_per.err_info_stat.lv_err_mem "Failure is stored in dynamic memory (2nd layer)" UWORD _CNV_S_2_RANGE__0___1_CM 1 100. 0. 1. DISPLAY_IDENTIFIER LV_ERR_MEM_CRK_TOOTH_PER ECU_ADDRESS 0xd000427e BIT_MASK 0x8 /end MEASUREMENT
/begin MEASUREMENT fmy_stat_crk_tooth_per.err_info_stat.lv_ready "Readiness flag related to diagnosis XX" UWORD _CNV_S_2_RANGE__0___1_CM 1 100. 0. 1. DISPLAY_IDENTIFIER LV_READY_CRK_TOOTH_PER ECU_ADDRESS 0xd000427e BIT_MASK 0x10 /end MEASUREMENT
/begin MEASUREMENT fmy_stat_crk_tooth_per.err_info_stat.lv_end_diag "End of diagnosis XX" UWORD _CNV_S_2_RANGE__0___1_CM 1 100. 0. 1. DISPLAY_IDENTIFIER LV_END_DIAG_CRK_TOOTH_PER ECU_ADDRESS 0xd000427e BIT_MASK 0x20 /end MEASUREMENT
/begin MEASUREMENT fmy_stat_crk_tooth_per.err_info_stat.lv_cdn_diag "Diagnosis condition to start symptom detection (set to 1 when condition is fulfilled)" UWORD _CNV_S_2_RANGE__0___1_CM 1 100. 0. 1. DISPLAY_IDENTIFIER LV_CDN_DIAG_CRK_TOOTH_PER ECU_ADDRESS 0xd000427e BIT_MASK 0x40 /end MEASUREMENT
/begin MEASUREMENT fmy_stat_crk_tooth_per.err_info_stat.err_sym "For each symptom: status of failure (set to 1 when failure symptom is detected)" UWORD _CNV_S_16_RANGE_ERR__485_CM 1 100. 0. 15. DISPLAY_IDENTIFIER ERR_SYM_CRK_TOOTH_PER ECU_ADDRESS 0xd000427e BIT_MASK 0x780 /end MEASUREMENT
/begin MEASUREMENT fmy_stat_crk_syn.ctr_abc "anti-bounce counter for diagnosis XX" UBYTE _CNV_A_R_LINEAR_____0_CM 1 100. 0. 255. DISPLAY_IDENTIFIER CTR_ABC_CRK_SYN ECU_ADDRESS 0xd0004274 FORMAT "%3.0" /end MEASUREMENT
/begin MEASUREMENT fmy_stat_crk_syn.ctr_end_diag "Counter for the end of diagnosis XX generation" UBYTE _CNV_A_R_LINEAR_____0_CM 1 100. 0. 255. DISPLAY_IDENTIFIER CTR_ABC_END_DIAG_CRK_SYN ECU_ADDRESS 0xd0004275 FORMAT "%3.0" /end MEASUREMENT
/begin MEASUREMENT fmy_stat_crk_syn.err_info_stat.lv_err_mem "Failure is stored in dynamic memory (2nd layer)" UWORD _CNV_S_2_RANGE__0___1_CM 1 100. 0. 1. DISPLAY_IDENTIFIER LV_ERR_MEM_CRK_SYN ECU_ADDRESS 0xd0004276 BIT_MASK 0x8 /end MEASUREMENT
/begin MEASUREMENT fmy_stat_crk_syn.err_info_stat.lv_ready "Readiness flag related to diagnosis XX" UWORD _CNV_S_2_RANGE__0___1_CM 1 100. 0. 1. DISPLAY_IDENTIFIER LV_READY_CRK_SYN ECU_ADDRESS 0xd0004276 BIT_MASK 0x10 /end MEASUREMENT
/begin MEASUREMENT fmy_stat_crk_syn.err_info_stat.lv_end_diag "End of diagnosis XX" UWORD _CNV_S_2_RANGE__0___1_CM 1 100. 0. 1. DISPLAY_IDENTIFIER LV_END_DIAG_CRK_SYN ECU_ADDRESS 0xd0004276 BIT_MASK 0x20 /end MEASUREMENT
/begin MEASUREMENT fmy_stat_crk_syn.err_info_stat.lv_cdn_diag "Diagnosis condition to start symptom detection (set to 1 when condition is fulfilled)" UWORD _CNV_S_2_RANGE__0___1_CM 1 100. 0. 1. DISPLAY_IDENTIFIER LV_CDN_DIAG_CRK_SYN ECU_ADDRESS 0xd0004276 BIT_MASK 0x40 /end MEASUREMENT
/begin MEASUREMENT fmy_stat_crk_syn.err_info_stat.err_sym "For each symptom: status of failure (set to 1 when failure symptom is detected)" UWORD _CNV_S_16_RANGE_ERR__485_CM 1 100. 0. 15. DISPLAY_IDENTIFIER ERR_SYM_CRK_SYN ECU_ADDRESS 0xd0004276 BIT_MASK 0x780 /end MEASUREMENT
/begin MEASUREMENT fmy_stat_crk_plaus.ctr_abc "anti-bounce counter for diagnosis XX" UBYTE _CNV_A_R_LINEAR_____0_CM 1 100. 0. 255. DISPLAY_IDENTIFIER CTR_ABC_CRK_PLAUS ECU_ADDRESS 0xd0004270 FORMAT "%3.0" /end MEASUREMENT
/begin MEASUREMENT fmy_stat_crk_plaus.ctr_end_diag "Counter for the end of diagnosis XX generation" UBYTE _CNV_A_R_LINEAR_____0_CM 1 100. 0. 255. DISPLAY_IDENTIFIER CTR_ABC_END_DIAG_CRK_PLAUS ECU_ADDRESS 0xd0004271 FORMAT "%3.0" /end MEASUREMENT
/begin MEASUREMENT fmy_stat_crk_plaus.err_info_stat.lv_err_mem "Failure is stored in dynamic memory (2nd layer)" UWORD _CNV_S_2_RANGE__0___1_CM 1 100. 0. 1. DISPLAY_IDENTIFIER LV_ERR_MEM_CRK_PLAUS ECU_ADDRESS 0xd0004272 BIT_MASK 0x8 /end MEASUREMENT
/begin MEASUREMENT fmy_stat_crk_plaus.err_info_stat.lv_ready "Readiness flag related to diagnosis XX" UWORD _CNV_S_2_RANGE__0___1_CM 1 100. 0. 1. DISPLAY_IDENTIFIER LV_READY_CRK_PLAUS ECU_ADDRESS 0xd0004272 BIT_MASK 0x10 /end MEASUREMENT
/begin MEASUREMENT fmy_stat_crk_plaus.err_info_stat.lv_end_diag "End of diagnosis XX" UWORD _CNV_S_2_RANGE__0___1_CM 1 100. 0. 1. DISPLAY_IDENTIFIER LV_END_DIAG_CRK_PLAUS ECU_ADDRESS 0xd0004272 BIT_MASK 0x20 /end MEASUREMENT
/begin MEASUREMENT fmy_stat_crk_plaus.err_info_stat.lv_cdn_diag "Diagnosis condition to start symptom detection (set to 1 when condition is fulfilled)" UWORD _CNV_S_2_RANGE__0___1_CM 1 100. 0. 1. DISPLAY_IDENTIFIER LV_CDN_DIAG_CRK_PLAUS ECU_ADDRESS 0xd0004272 BIT_MASK 0x40 /end MEASUREMENT
/begin MEASUREMENT fmy_stat_crk_plaus.err_info_stat.err_sym "For each symptom: status of failure (set to 1 when failure symptom is detected)" UWORD _CNV_S_16_RANGE_ERR__485_CM 1 100. 0. 15. DISPLAY_IDENTIFIER ERR_SYM_CRK_PLAUS ECU_ADDRESS 0xd0004272 BIT_MASK 0x780 /end MEASUREMENT
/begin MEASUREMENT fmy_stat_plaus_cam_in_1.ctr_abc "anti-bounce counter for diagnosis XX" UBYTE _CNV_A_R_LINEAR_____0_CM 1 100. 0. 255. DISPLAY_IDENTIFIER CTR_ABC_PLAUS_CAM_IN_1 ECU_ADDRESS 0xd0004498 FORMAT "%3.0" /end MEASUREMENT
/begin MEASUREMENT fmy_stat_plaus_cam_in_1.ctr_end_diag "Counter for the end of diagnosis XX generation" UBYTE _CNV_A_R_LINEAR_____0_CM 1 100. 0. 255. DISPLAY_IDENTIFIER CTR_ABC_END_DIAG_PLAUS_CAM_IN_1 ECU_ADDRESS 0xd0004499 FORMAT "%3.0" /end MEASUREMENT
/begin MEASUREMENT fmy_stat_plaus_cam_in_1.err_info_stat.lv_err_mem "Failure is stored in dynamic memory (2nd layer)" UWORD _CNV_S_2_RANGE__0___1_CM 1 100. 0. 1. DISPLAY_IDENTIFIER LV_ERR_MEM_PLAUS_CAM_IN_1 ECU_ADDRESS 0xd000449a BIT_MASK 0x8 /end MEASUREMENT
/begin MEASUREMENT fmy_stat_plaus_cam_in_1.err_info_stat.lv_ready "Readiness flag related to diagnosis XX" UWORD _CNV_S_2_RANGE__0___1_CM 1 100. 0. 1. DISPLAY_IDENTIFIER LV_READY_PLAUS_CAM_IN_1 ECU_ADDRESS 0xd000449a BIT_MASK 0x10 /end MEASUREMENT
/begin MEASUREMENT fmy_stat_plaus_cam_in_1.err_info_stat.lv_end_diag "End of diagnosis XX" UWORD _CNV_S_2_RANGE__0___1_CM 1 100. 0. 1. DISPLAY_IDENTIFIER LV_END_DIAG_PLAUS_CAM_IN_1 ECU_ADDRESS 0xd000449a BIT_MASK 0x20 /end MEASUREMENT
/begin MEASUREMENT fmy_stat_plaus_cam_in_1.err_info_stat.lv_cdn_diag "Diagnosis condition to start symptom detection (set to 1 when condition is fulfilled)" UWORD _CNV_S_2_RANGE__0___1_CM 1 100. 0. 1. DISPLAY_IDENTIFIER LV_CDN_DIAG_PLAUS_CAM_IN_1 ECU_ADDRESS 0xd000449a BIT_MASK 0x40 /end MEASUREMENT
/begin MEASUREMENT fmy_stat_plaus_cam_in_1.err_info_stat.err_sym "For each symptom: status of failure (set to 1 when failure symptom is detected)" UWORD _CNV_S_16_RANGE_ERR__485_CM 1 100. 0. 15. DISPLAY_IDENTIFIER ERR_SYM_PLAUS_CAM_IN_1 ECU_ADDRESS 0xd000449a BIT_MASK 0x780 /end MEASUREMENT
/begin MEASUREMENT fmy_stat_plaus_cam_ex_1.ctr_abc "anti-bounce counter for diagnosis XX" UBYTE _CNV_A_R_LINEAR_____0_CM 1 100. 0. 255. DISPLAY_IDENTIFIER CTR_ABC_PLAUS_CAM_EX_1 ECU_ADDRESS 0xd0004494 FORMAT "%3.0" /end MEASUREMENT
/begin MEASUREMENT fmy_stat_plaus_cam_ex_1.ctr_end_diag "Counter for the end of diagnosis XX generation" UBYTE _CNV_A_R_LINEAR_____0_CM 1 100. 0. 255. DISPLAY_IDENTIFIER CTR_ABC_END_DIAG_PLAUS_CAM_EX_1 ECU_ADDRESS 0xd0004495 FORMAT "%3.0" /end MEASUREMENT
/begin MEASUREMENT fmy_stat_plaus_cam_ex_1.err_info_stat.lv_err_mem "Failure is stored in dynamic memory (2nd layer)" UWORD _CNV_S_2_RANGE__0___1_CM 1 100. 0. 1. DISPLAY_IDENTIFIER LV_ERR_MEM_PLAUS_CAM_EX_1 ECU_ADDRESS 0xd0004496 BIT_MASK 0x8 /end MEASUREMENT
/begin MEASUREMENT fmy_stat_plaus_cam_ex_1.err_info_stat.lv_ready "Readiness flag related to diagnosis XX" UWORD _CNV_S_2_RANGE__0___1_CM 1 100. 0. 1. DISPLAY_IDENTIFIER LV_READY_PLAUS_CAM_EX_1 ECU_ADDRESS 0xd0004496 BIT_MASK 0x10 /end MEASUREMENT
/begin MEASUREMENT fmy_stat_plaus_cam_ex_1.err_info_stat.lv_end_diag "End of diagnosis XX" UWORD _CNV_S_2_RANGE__0___1_CM 1 100. 0. 1. DISPLAY_IDENTIFIER LV_END_DIAG_PLAUS_CAM_EX_1 ECU_ADDRESS 0xd0004496 BIT_MASK 0x20 /end MEASUREMENT
/begin MEASUREMENT fmy_stat_plaus_cam_ex_1.err_info_stat.lv_cdn_diag "Diagnosis condition to start symptom detection (set to 1 when condition is fulfilled)" UWORD _CNV_S_2_RANGE__0___1_CM 1 100. 0. 1. DISPLAY_IDENTIFIER LV_CDN_DIAG_PLAUS_CAM_EX_1 ECU_ADDRESS 0xd0004496 BIT_MASK 0x40 /end MEASUREMENT
/begin MEASUREMENT fmy_stat_plaus_cam_ex_1.err_info_stat.err_sym "For each symptom: status of failure (set to 1 when failure symptom is detected)" UWORD _CNV_S_16_RANGE_ERR__485_CM 1 100. 0. 15. DISPLAY_IDENTIFIER ERR_SYM_PLAUS_CAM_EX_1 ECU_ADDRESS 0xd0004496 BIT_MASK 0x780 /end MEASUREMENT
/begin MEASUREMENT fmy_stat_syn_crk_cam_in_1.ctr_abc "anti-bounce counter for diagnosis XX" UBYTE _CNV_A_R_LINEAR_____0_CM 1 100. 0. 255. DISPLAY_IDENTIFIER CTR_ABC_SYN_CRK_CAM_IN_1 ECU_ADDRESS 0xd0004568 FORMAT "%3.0" /end MEASUREMENT
/begin MEASUREMENT fmy_stat_syn_crk_cam_in_1.ctr_end_diag "Counter for the end of diagnosis XX generation" UBYTE _CNV_A_R_LINEAR_____0_CM 1 100. 0. 255. DISPLAY_IDENTIFIER CTR_ABC_END_DIAG_SYN_CRK_CAM_IN_1 ECU_ADDRESS 0xd0004569 FORMAT "%3.0" /end MEASUREMENT
/begin MEASUREMENT fmy_stat_syn_crk_cam_in_1.err_info_stat.lv_err_mem "Failure is stored in dynamic memory (2nd layer)" UWORD _CNV_S_2_RANGE__0___1_CM 1 100. 0. 1. DISPLAY_IDENTIFIER LV_ERR_MEM_SYN_CRK_CAM_IN_1 ECU_ADDRESS 0xd000456a BIT_MASK 0x8 /end MEASUREMENT
/begin MEASUREMENT fmy_stat_syn_crk_cam_in_1.err_info_stat.lv_ready "Readiness flag related to diagnosis XX" UWORD _CNV_S_2_RANGE__0___1_CM 1 100. 0. 1. DISPLAY_IDENTIFIER LV_READY_SYN_CRK_CAM_IN_1 ECU_ADDRESS 0xd000456a BIT_MASK 0x10 /end MEASUREMENT
/begin MEASUREMENT fmy_stat_syn_crk_cam_in_1.err_info_stat.lv_end_diag "End of diagnosis XX" UWORD _CNV_S_2_RANGE__0___1_CM 1 100. 0. 1. DISPLAY_IDENTIFIER LV_END_DIAG_SYN_CRK_CAM_IN_1 ECU_ADDRESS 0xd000456a BIT_MASK 0x20 /end MEASUREMENT
/begin MEASUREMENT fmy_stat_syn_crk_cam_in_1.err_info_stat.lv_cdn_diag "Diagnosis condition to start symptom detection (set to 1 when condition is fulfilled)" UWORD _CNV_S_2_RANGE__0___1_CM 1 100. 0. 1. DISPLAY_IDENTIFIER LV_CDN_DIAG_SYN_CRK_CAM_IN_1 ECU_ADDRESS 0xd000456a BIT_MASK 0x40 /end MEASUREMENT
/begin MEASUREMENT fmy_stat_syn_crk_cam_in_1.err_info_stat.err_sym "For each symptom: status of failure (set to 1 when failure symptom is detected)" UWORD _CNV_S_16_RANGE_ERR__485_CM 1 100. 0. 15. DISPLAY_IDENTIFIER ERR_SYM_SYN_CRK_CAM_IN_1 ECU_ADDRESS 0xd000456a BIT_MASK 0x780 /end MEASUREMENT
/begin MEASUREMENT fmy_stat_syn_crk_cam_ex_1.ctr_abc "anti-bounce counter for diagnosis XX" UBYTE _CNV_A_R_LINEAR_____0_CM 1 100. 0. 255. DISPLAY_IDENTIFIER CTR_ABC_SYN_CRK_CAM_EX_1 ECU_ADDRESS 0xd0004564 FORMAT "%3.0" /end MEASUREMENT
/begin MEASUREMENT fmy_stat_syn_crk_cam_ex_1.ctr_end_diag "Counter for the end of diagnosis XX generation" UBYTE _CNV_A_R_LINEAR_____0_CM 1 100. 0. 255. DISPLAY_IDENTIFIER CTR_ABC_END_DIAG_SYN_CRK_CAM_EX_1 ECU_ADDRESS 0xd0004565 FORMAT "%3.0" /end MEASUREMENT
/begin MEASUREMENT fmy_stat_syn_crk_cam_ex_1.err_info_stat.lv_err_mem "Failure is stored in dynamic memory (2nd layer)" UWORD _CNV_S_2_RANGE__0___1_CM 1 100. 0. 1. DISPLAY_IDENTIFIER LV_ERR_MEM_SYN_CRK_CAM_EX_1 ECU_ADDRESS 0xd0004566 BIT_MASK 0x8 /end MEASUREMENT
/begin MEASUREMENT fmy_stat_syn_crk_cam_ex_1.err_info_stat.lv_ready "Readiness flag related to diagnosis XX" UWORD _CNV_S_2_RANGE__0___1_CM 1 100. 0. 1. DISPLAY_IDENTIFIER LV_READY_SYN_CRK_CAM_EX_1 ECU_ADDRESS 0xd0004566 BIT_MASK 0x10 /end MEASUREMENT
/begin MEASUREMENT fmy_stat_syn_crk_cam_ex_1.err_info_stat.lv_end_diag "End of diagnosis XX" UWORD _CNV_S_2_RANGE__0___1_CM 1 100. 0. 1. DISPLAY_IDENTIFIER LV_END_DIAG_SYN_CRK_CAM_EX_1 ECU_ADDRESS 0xd0004566 BIT_MASK 0x20 /end MEASUREMENT
/begin MEASUREMENT fmy_stat_syn_crk_cam_ex_1.err_info_stat.lv_cdn_diag "Diagnosis condition to start symptom detection (set to 1 when condition is fulfilled)" UWORD _CNV_S_2_RANGE__0___1_CM 1 100. 0. 1. DISPLAY_IDENTIFIER LV_CDN_DIAG_SYN_CRK_CAM_EX_1 ECU_ADDRESS 0xd0004566 BIT_MASK 0x40 /end MEASUREMENT
/begin MEASUREMENT fmy_stat_syn_crk_cam_ex_1.err_info_stat.err_sym "For each symptom: status of failure (set to 1 when failure symptom is detected)" UWORD _CNV_S_16_RANGE_ERR__485_CM 1 100. 0. 15. DISPLAY_IDENTIFIER ERR_SYM_SYN_CRK_CAM_EX_1 ECU_ADDRESS 0xd0004566 BIT_MASK 0x780 /end MEASUREMENT
/begin MEASUREMENT fmy_stat_can_boff_B.ctr_abc "anti-bounce counter for diagnosis XX" UBYTE _CNV_A_R_LINEAR_____0_CM 1 100. 0. 255. DISPLAY_IDENTIFIER CTR_ABC_CAN_BOFF_B ECU_ADDRESS 0xd000423c FORMAT "%3.0" /end MEASUREMENT
/begin MEASUREMENT fmy_stat_can_boff_B.ctr_end_diag "Counter for the end of diagnosis XX generation" UBYTE _CNV_A_R_LINEAR_____0_CM 1 100. 0. 255. DISPLAY_IDENTIFIER CTR_ABC_END_DIAG_CAN_BOFF_B ECU_ADDRESS 0xd000423d FORMAT "%3.0" /end MEASUREMENT
/begin MEASUREMENT fmy_stat_can_boff_B.err_info_stat.lv_err_mem "Failure is stored in dynamic memory (2nd layer)" UWORD _CNV_S_2_RANGE__0___1_CM 1 100. 0. 1. DISPLAY_IDENTIFIER LV_ERR_MEM_CAN_BOFF_B ECU_ADDRESS 0xd000423e BIT_MASK 0x8 /end MEASUREMENT
/begin MEASUREMENT fmy_stat_can_boff_B.err_info_stat.lv_ready "Readiness flag related to diagnosis XX" UWORD _CNV_S_2_RANGE__0___1_CM 1 100. 0. 1. DISPLAY_IDENTIFIER LV_READY_CAN_BOFF_B ECU_ADDRESS 0xd000423e BIT_MASK 0x10 /end MEASUREMENT
/begin MEASUREMENT fmy_stat_can_boff_B.err_info_stat.lv_end_diag "End of diagnosis XX" UWORD _CNV_S_2_RANGE__0___1_CM 1 100. 0. 1. DISPLAY_IDENTIFIER LV_END_DIAG_CAN_BOFF_B ECU_ADDRESS 0xd000423e BIT_MASK 0x20 /end MEASUREMENT
/begin MEASUREMENT fmy_stat_can_boff_B.err_info_stat.lv_cdn_diag "Diagnosis condition to start symptom detection (set to 1 when condition is fulfilled)" UWORD _CNV_S_2_RANGE__0___1_CM 1 100. 0. 1. DISPLAY_IDENTIFIER LV_CDN_DIAG_CAN_BOFF_B ECU_ADDRESS 0xd000423e BIT_MASK 0x40 /end MEASUREMENT
/begin MEASUREMENT fmy_stat_can_boff_B.err_info_stat.err_sym "For each symptom: status of failure (set to 1 when failure symptom is detected)" UWORD _CNV_S_16_RANGE_ERR__485_CM 1 100. 0. 15. DISPLAY_IDENTIFIER ERR_SYM_CAN_BOFF_B ECU_ADDRESS 0xd000423e BIT_MASK 0x780 /end MEASUREMENT
/begin MEASUREMENT fmy_stat_can_boff_C.ctr_abc "anti-bounce counter for diagnosis XX" UBYTE _CNV_A_R_LINEAR_____0_CM 1 100. 0. 255. DISPLAY_IDENTIFIER CTR_ABC_CAN_BOFF_C ECU_ADDRESS 0xd0004240 FORMAT "%3.0" /end MEASUREMENT
/begin MEASUREMENT fmy_stat_can_boff_C.ctr_end_diag "Counter for the end of diagnosis XX generation" UBYTE _CNV_A_R_LINEAR_____0_CM 1 100. 0. 255. DISPLAY_IDENTIFIER CTR_ABC_END_DIAG_CAN_BOFF_C ECU_ADDRESS 0xd0004241 FORMAT "%3.0" /end MEASUREMENT
/begin MEASUREMENT fmy_stat_can_boff_C.err_info_stat.lv_err_mem "Failure is stored in dynamic memory (2nd layer)" UWORD _CNV_S_2_RANGE__0___1_CM 1 100. 0. 1. DISPLAY_IDENTIFIER LV_ERR_MEM_CAN_BOFF_C ECU_ADDRESS 0xd0004242 BIT_MASK 0x8 /end MEASUREMENT
/begin MEASUREMENT fmy_stat_can_boff_C.err_info_stat.lv_ready "Readiness flag related to diagnosis XX" UWORD _CNV_S_2_RANGE__0___1_CM 1 100. 0. 1. DISPLAY_IDENTIFIER LV_READY_CAN_BOFF_C ECU_ADDRESS 0xd0004242 BIT_MASK 0x10 /end MEASUREMENT
/begin MEASUREMENT fmy_stat_can_boff_C.err_info_stat.lv_end_diag "End of diagnosis XX" UWORD _CNV_S_2_RANGE__0___1_CM 1 100. 0. 1. DISPLAY_IDENTIFIER LV_END_DIAG_CAN_BOFF_C ECU_ADDRESS 0xd0004242 BIT_MASK 0x20 /end MEASUREMENT
/begin MEASUREMENT fmy_stat_can_boff_C.err_info_stat.lv_cdn_diag "Diagnosis condition to start symptom detection (set to 1 when condition is fulfilled)" UWORD _CNV_S_2_RANGE__0___1_CM 1 100. 0. 1. DISPLAY_IDENTIFIER LV_CDN_DIAG_CAN_BOFF_C ECU_ADDRESS 0xd0004242 BIT_MASK 0x40 /end MEASUREMENT
/begin MEASUREMENT fmy_stat_can_boff_C.err_info_stat.err_sym "For each symptom: status of failure (set to 1 when failure symptom is detected)" UWORD _CNV_S_16_RANGE_ERR__485_CM 1 100. 0. 15. DISPLAY_IDENTIFIER ERR_SYM_CAN_BOFF_C ECU_ADDRESS 0xd0004242 BIT_MASK 0x780 /end MEASUREMENT
/begin MEASUREMENT fmy_stat_rly_main.ctr_abc "anti-bounce counter for diagnosis XX" UBYTE _CNV_A_R_LINEAR_____0_CM 1 100. 0. 255. DISPLAY_IDENTIFIER CTR_ABC_RLY_MAIN ECU_ADDRESS 0xd00044f8 FORMAT "%3.0" /end MEASUREMENT
/begin MEASUREMENT fmy_stat_rly_main.ctr_end_diag "Counter for the end of diagnosis XX generation" UBYTE _CNV_A_R_LINEAR_____0_CM 1 100. 0. 255. DISPLAY_IDENTIFIER CTR_ABC_END_DIAG_RLY_MAIN ECU_ADDRESS 0xd00044f9 FORMAT "%3.0" /end MEASUREMENT
/begin MEASUREMENT fmy_stat_rly_main.err_info_stat.lv_err_mem "Failure is stored in dynamic memory (2nd layer)" UWORD _CNV_S_2_RANGE__0___1_CM 1 100. 0. 1. DISPLAY_IDENTIFIER LV_ERR_MEM_RLY_MAIN ECU_ADDRESS 0xd00044fa BIT_MASK 0x8 /end MEASUREMENT
/begin MEASUREMENT fmy_stat_rly_main.err_info_stat.lv_ready "Readiness flag related to diagnosis XX" UWORD _CNV_S_2_RANGE__0___1_CM 1 100. 0. 1. DISPLAY_IDENTIFIER LV_READY_RLY_MAIN ECU_ADDRESS 0xd00044fa BIT_MASK 0x10 /end MEASUREMENT
/begin MEASUREMENT fmy_stat_rly_main.err_info_stat.lv_end_diag "End of diagnosis XX" UWORD _CNV_S_2_RANGE__0___1_CM 1 100. 0. 1. DISPLAY_IDENTIFIER LV_END_DIAG_RLY_MAIN ECU_ADDRESS 0xd00044fa BIT_MASK 0x20 /end MEASUREMENT
/begin MEASUREMENT fmy_stat_rly_main.err_info_stat.lv_cdn_diag "Diagnosis condition to start symptom detection (set to 1 when condition is fulfilled)" UWORD _CNV_S_2_RANGE__0___1_CM 1 100. 0. 1. DISPLAY_IDENTIFIER LV_CDN_DIAG_RLY_MAIN ECU_ADDRESS 0xd00044fa BIT_MASK 0x40 /end MEASUREMENT
/begin MEASUREMENT fmy_stat_rly_main.err_info_stat.err_sym "For each symptom: status of failure (set to 1 when failure symptom is detected)" UWORD _CNV_S_16_RANGE_ERR__485_CM 1 100. 0. 15. DISPLAY_IDENTIFIER ERR_SYM_RLY_MAIN ECU_ADDRESS 0xd00044fa BIT_MASK 0x780 /end MEASUREMENT
/begin MEASUREMENT fmy_stat_rly_main_dly.ctr_abc "anti-bounce counter for diagnosis XX" UBYTE _CNV_A_R_LINEAR_____0_CM 1 100. 0. 255. DISPLAY_IDENTIFIER CTR_ABC_RLY_MAIN_DLY ECU_ADDRESS 0xd00044fc FORMAT "%3.0" /end MEASUREMENT
/begin MEASUREMENT fmy_stat_rly_main_dly.ctr_end_diag "Counter for the end of diagnosis XX generation" UBYTE _CNV_A_R_LINEAR_____0_CM 1 100. 0. 255. DISPLAY_IDENTIFIER CTR_ABC_END_DIAG_RLY_MAIN_DLY ECU_ADDRESS 0xd00044fd FORMAT "%3.0" /end MEASUREMENT
/begin MEASUREMENT fmy_stat_rly_main_dly.err_info_stat.lv_err_mem "Failure is stored in dynamic memory (2nd layer)" UWORD _CNV_S_2_RANGE__0___1_CM 1 100. 0. 1. DISPLAY_IDENTIFIER LV_ERR_MEM_RLY_MAIN_DLY ECU_ADDRESS 0xd00044fe BIT_MASK 0x8 /end MEASUREMENT
/begin MEASUREMENT fmy_stat_rly_main_dly.err_info_stat.lv_ready "Readiness flag related to diagnosis XX" UWORD _CNV_S_2_RANGE__0___1_CM 1 100. 0. 1. DISPLAY_IDENTIFIER LV_READY_RLY_MAIN_DLY ECU_ADDRESS 0xd00044fe BIT_MASK 0x10 /end MEASUREMENT
/begin MEASUREMENT fmy_stat_rly_main_dly.err_info_stat.lv_end_diag "End of diagnosis XX" UWORD _CNV_S_2_RANGE__0___1_CM 1 100. 0. 1. DISPLAY_IDENTIFIER LV_END_DIAG_RLY_MAIN_DLY ECU_ADDRESS 0xd00044fe BIT_MASK 0x20 /end MEASUREMENT
/begin MEASUREMENT fmy_stat_rly_main_dly.err_info_stat.lv_cdn_diag "Diagnosis condition to start symptom detection (set to 1 when condition is fulfilled)" UWORD _CNV_S_2_RANGE__0___1_CM 1 100. 0. 1. DISPLAY_IDENTIFIER LV_CDN_DIAG_RLY_MAIN_DLY ECU_ADDRESS 0xd00044fe BIT_MASK 0x40 /end MEASUREMENT
/begin MEASUREMENT fmy_stat_rly_main_dly.err_info_stat.err_sym "For each symptom: status of failure (set to 1 when failure symptom is detected)" UWORD _CNV_S_16_RANGE_ERR__485_CM 1 100. 0. 15. DISPLAY_IDENTIFIER ERR_SYM_RLY_MAIN_DLY ECU_ADDRESS 0xd00044fe BIT_MASK 0x780 /end MEASUREMENT
/begin MEASUREMENT fmy_stat_rly_accout.ctr_abc "anti-bounce counter for diagnosis XX" UBYTE _CNV_A_R_LINEAR_____0_CM 1 100. 0. 255. DISPLAY_IDENTIFIER CTR_ABC_RLY_ACCOUT ECU_ADDRESS 0xd00044ec FORMAT "%3.0" /end MEASUREMENT
/begin MEASUREMENT fmy_stat_rly_accout.ctr_end_diag "Counter for the end of diagnosis XX generation" UBYTE _CNV_A_R_LINEAR_____0_CM 1 100. 0. 255. DISPLAY_IDENTIFIER CTR_ABC_END_DIAG_RLY_ACCOUT ECU_ADDRESS 0xd00044ed FORMAT "%3.0" /end MEASUREMENT
/begin MEASUREMENT fmy_stat_rly_accout.err_info_stat.lv_err_mem "Failure is stored in dynamic memory (2nd layer)" UWORD _CNV_S_2_RANGE__0___1_CM 1 100. 0. 1. DISPLAY_IDENTIFIER LV_ERR_MEM_RLY_ACCOUT ECU_ADDRESS 0xd00044ee BIT_MASK 0x8 /end MEASUREMENT
/begin MEASUREMENT fmy_stat_rly_accout.err_info_stat.lv_ready "Readiness flag related to diagnosis XX" UWORD _CNV_S_2_RANGE__0___1_CM 1 100. 0. 1. DISPLAY_IDENTIFIER LV_READY_RLY_ACCOUT ECU_ADDRESS 0xd00044ee BIT_MASK 0x10 /end MEASUREMENT
/begin MEASUREMENT fmy_stat_rly_accout.err_info_stat.lv_end_diag "End of diagnosis XX" UWORD _CNV_S_2_RANGE__0___1_CM 1 100. 0. 1. DISPLAY_IDENTIFIER LV_END_DIAG_RLY_ACCOUT ECU_ADDRESS 0xd00044ee BIT_MASK 0x20 /end MEASUREMENT
/begin MEASUREMENT fmy_stat_rly_accout.err_info_stat.lv_cdn_diag "Diagnosis condition to start symptom detection (set to 1 when condition is fulfilled)" UWORD _CNV_S_2_RANGE__0___1_CM 1 100. 0. 1. DISPLAY_IDENTIFIER LV_CDN_DIAG_RLY_ACCOUT ECU_ADDRESS 0xd00044ee BIT_MASK 0x40 /end MEASUREMENT
/begin MEASUREMENT fmy_stat_rly_accout.err_info_stat.err_sym "For each symptom: status of failure (set to 1 when failure symptom is detected)" UWORD _CNV_S_16_RANGE_ERR__485_CM 1 100. 0. 15. DISPLAY_IDENTIFIER ERR_SYM_RLY_ACCOUT ECU_ADDRESS 0xd00044ee BIT_MASK 0x780 /end MEASUREMENT
/begin MEASUREMENT fmy_stat_isc.ctr_abc "anti-bounce counter for diagnosis XX" UBYTE _CNV_A_R_LINEAR_____0_CM 1 100. 0. 255. DISPLAY_IDENTIFIER CTR_ABC_ISC ECU_ADDRESS 0xd00043a4 FORMAT "%3.0" /end MEASUREMENT
/begin MEASUREMENT fmy_stat_isc.ctr_end_diag "Counter for the end of diagnosis XX generation" UBYTE _CNV_A_R_LINEAR_____0_CM 1 100. 0. 255. DISPLAY_IDENTIFIER CTR_ABC_END_DIAG_ISC ECU_ADDRESS 0xd00043a5 FORMAT "%3.0" /end MEASUREMENT
/begin MEASUREMENT fmy_stat_isc.err_info_stat.lv_err_mem "Failure is stored in dynamic memory (2nd layer)" UWORD _CNV_S_2_RANGE__0___1_CM 1 100. 0. 1. DISPLAY_IDENTIFIER LV_ERR_MEM_ISC ECU_ADDRESS 0xd00043a6 BIT_MASK 0x8 /end MEASUREMENT
/begin MEASUREMENT fmy_stat_isc.err_info_stat.lv_ready "Readiness flag related to diagnosis XX" UWORD _CNV_S_2_RANGE__0___1_CM 1 100. 0. 1. DISPLAY_IDENTIFIER LV_READY_ISC ECU_ADDRESS 0xd00043a6 BIT_MASK 0x10 /end MEASUREMENT
/begin MEASUREMENT fmy_stat_isc.err_info_stat.lv_end_diag "End of diagnosis XX" UWORD _CNV_S_2_RANGE__0___1_CM 1 100. 0. 1. DISPLAY_IDENTIFIER LV_END_DIAG_ISC ECU_ADDRESS 0xd00043a6 BIT_MASK 0x20 /end MEASUREMENT
/begin MEASUREMENT fmy_stat_isc.err_info_stat.lv_cdn_diag "Diagnosis condition to start symptom detection (set to 1 when condition is fulfilled)" UWORD _CNV_S_2_RANGE__0___1_CM 1 100. 0. 1. DISPLAY_IDENTIFIER LV_CDN_DIAG_ISC ECU_ADDRESS 0xd00043a6 BIT_MASK 0x40 /end MEASUREMENT
/begin MEASUREMENT fmy_stat_isc.err_info_stat.err_sym "For each symptom: status of failure (set to 1 when failure symptom is detected)" UWORD _CNV_S_16_RANGE_ERR__485_CM 1 100. 0. 15. DISPLAY_IDENTIFIER ERR_SYM_ISC ECU_ADDRESS 0xd00043a6 BIT_MASK 0x780 /end MEASUREMENT
/begin MEASUREMENT fmy_stat_im_bls_plaus.ctr_abc "anti-bounce counter for diagnosis XX" UBYTE _CNV_A_R_LINEAR_____0_CM 1 100. 0. 255. DISPLAY_IDENTIFIER CTR_ABC_IM_BLS_PLAUS ECU_ADDRESS 0xd0004390 FORMAT "%3.0" /end MEASUREMENT
/begin MEASUREMENT fmy_stat_im_bls_plaus.ctr_end_diag "Counter for the end of diagnosis XX generation" UBYTE _CNV_A_R_LINEAR_____0_CM 1 100. 0. 255. DISPLAY_IDENTIFIER CTR_ABC_END_DIAG_IM_BLS_PLAUS ECU_ADDRESS 0xd0004391 FORMAT "%3.0" /end MEASUREMENT
/begin MEASUREMENT fmy_stat_im_bls_plaus.err_info_stat.lv_err_mem "Failure is stored in dynamic memory (2nd layer)" UWORD _CNV_S_2_RANGE__0___1_CM 1 100. 0. 1. DISPLAY_IDENTIFIER LV_ERR_MEM_IM_BLS_PLAUS ECU_ADDRESS 0xd0004392 BIT_MASK 0x8 /end MEASUREMENT
/begin MEASUREMENT fmy_stat_im_bls_plaus.err_info_stat.lv_ready "Readiness flag related to diagnosis XX" UWORD _CNV_S_2_RANGE__0___1_CM 1 100. 0. 1. DISPLAY_IDENTIFIER LV_READY_IM_BLS_PLAUS ECU_ADDRESS 0xd0004392 BIT_MASK 0x10 /end MEASUREMENT
/begin MEASUREMENT fmy_stat_im_bls_plaus.err_info_stat.lv_end_diag "End of diagnosis XX" UWORD _CNV_S_2_RANGE__0___1_CM 1 100. 0. 1. DISPLAY_IDENTIFIER LV_END_DIAG_IM_BLS_PLAUS ECU_ADDRESS 0xd0004392 BIT_MASK 0x20 /end MEASUREMENT
/begin MEASUREMENT fmy_stat_im_bls_plaus.err_info_stat.lv_cdn_diag "Diagnosis condition to start symptom detection (set to 1 when condition is fulfilled)" UWORD _CNV_S_2_RANGE__0___1_CM 1 100. 0. 1. DISPLAY_IDENTIFIER LV_CDN_DIAG_IM_BLS_PLAUS ECU_ADDRESS 0xd0004392 BIT_MASK 0x40 /end MEASUREMENT
/begin MEASUREMENT fmy_stat_im_bls_plaus.err_info_stat.err_sym "For each symptom: status of failure (set to 1 when failure symptom is detected)" UWORD _CNV_S_16_RANGE_ERR__485_CM 1 100. 0. 15. DISPLAY_IDENTIFIER ERR_SYM_IM_BLS_PLAUS ECU_ADDRESS 0xd0004392 BIT_MASK 0x780 /end MEASUREMENT
/begin MEASUREMENT fmy_stat_im_bts_plaus.ctr_abc "anti-bounce counter for diagnosis XX" UBYTE _CNV_A_R_LINEAR_____0_CM 1 100. 0. 255. DISPLAY_IDENTIFIER CTR_ABC_IM_BTS_PLAUS ECU_ADDRESS 0xd0004394 FORMAT "%3.0" /end MEASUREMENT
/begin MEASUREMENT fmy_stat_im_bts_plaus.ctr_end_diag "Counter for the end of diagnosis XX generation" UBYTE _CNV_A_R_LINEAR_____0_CM 1 100. 0. 255. DISPLAY_IDENTIFIER CTR_ABC_END_DIAG_IM_BTS_PLAUS ECU_ADDRESS 0xd0004395 FORMAT "%3.0" /end MEASUREMENT
/begin MEASUREMENT fmy_stat_im_bts_plaus.err_info_stat.lv_err_mem "Failure is stored in dynamic memory (2nd layer)" UWORD _CNV_S_2_RANGE__0___1_CM 1 100. 0. 1. DISPLAY_IDENTIFIER LV_ERR_MEM_IM_BTS_PLAUS ECU_ADDRESS 0xd0004396 BIT_MASK 0x8 /end MEASUREMENT
/begin MEASUREMENT fmy_stat_im_bts_plaus.err_info_stat.lv_ready "Readiness flag related to diagnosis XX" UWORD _CNV_S_2_RANGE__0___1_CM 1 100. 0. 1. DISPLAY_IDENTIFIER LV_READY_IM_BTS_PLAUS ECU_ADDRESS 0xd0004396 BIT_MASK 0x10 /end MEASUREMENT
/begin MEASUREMENT fmy_stat_im_bts_plaus.err_info_stat.lv_end_diag "End of diagnosis XX" UWORD _CNV_S_2_RANGE__0___1_CM 1 100. 0. 1. DISPLAY_IDENTIFIER LV_END_DIAG_IM_BTS_PLAUS ECU_ADDRESS 0xd0004396 BIT_MASK 0x20 /end MEASUREMENT
/begin MEASUREMENT fmy_stat_im_bts_plaus.err_info_stat.lv_cdn_diag "Diagnosis condition to start symptom detection (set to 1 when condition is fulfilled)" UWORD _CNV_S_2_RANGE__0___1_CM 1 100. 0. 1. DISPLAY_IDENTIFIER LV_CDN_DIAG_IM_BTS_PLAUS ECU_ADDRESS 0xd0004396 BIT_MASK 0x40 /end MEASUREMENT
/begin MEASUREMENT fmy_stat_im_bts_plaus.err_info_stat.err_sym "For each symptom: status of failure (set to 1 when failure symptom is detected)" UWORD _CNV_S_16_RANGE_ERR__485_CM 1 100. 0. 15. DISPLAY_IDENTIFIER ERR_SYM_IM_BTS_PLAUS ECU_ADDRESS 0xd0004396 BIT_MASK 0x780 /end MEASUREMENT
/begin MEASUREMENT fmy_stat_msw_tog.ctr_abc "anti-bounce counter for diagnosis XX" UBYTE _CNV_A_R_LINEAR_____0_CM 1 100. 0. 255. DISPLAY_IDENTIFIER CTR_ABC_MSW_TOG ECU_ADDRESS 0xd000443c FORMAT "%3.0" /end MEASUREMENT
/begin MEASUREMENT fmy_stat_msw_tog.ctr_end_diag "Counter for the end of diagnosis XX generation" UBYTE _CNV_A_R_LINEAR_____0_CM 1 100. 0. 255. DISPLAY_IDENTIFIER CTR_ABC_END_DIAG_MSW_TOG ECU_ADDRESS 0xd000443d FORMAT "%3.0" /end MEASUREMENT
/begin MEASUREMENT fmy_stat_msw_tog.err_info_stat.lv_err_mem "Failure is stored in dynamic memory (2nd layer)" UWORD _CNV_S_2_RANGE__0___1_CM 1 100. 0. 1. DISPLAY_IDENTIFIER LV_ERR_MEM_MSW_TOG ECU_ADDRESS 0xd000443e BIT_MASK 0x8 /end MEASUREMENT
/begin MEASUREMENT fmy_stat_msw_tog.err_info_stat.lv_ready "Readiness flag related to diagnosis XX" UWORD _CNV_S_2_RANGE__0___1_CM 1 100. 0. 1. DISPLAY_IDENTIFIER LV_READY_MSW_TOG ECU_ADDRESS 0xd000443e BIT_MASK 0x10 /end MEASUREMENT
/begin MEASUREMENT fmy_stat_msw_tog.err_info_stat.lv_end_diag "End of diagnosis XX" UWORD _CNV_S_2_RANGE__0___1_CM 1 100. 0. 1. DISPLAY_IDENTIFIER LV_END_DIAG_MSW_TOG ECU_ADDRESS 0xd000443e BIT_MASK 0x20 /end MEASUREMENT
/begin MEASUREMENT fmy_stat_msw_tog.err_info_stat.lv_cdn_diag "Diagnosis condition to start symptom detection (set to 1 when condition is fulfilled)" UWORD _CNV_S_2_RANGE__0___1_CM 1 100. 0. 1. DISPLAY_IDENTIFIER LV_CDN_DIAG_MSW_TOG ECU_ADDRESS 0xd000443e BIT_MASK 0x40 /end MEASUREMENT
/begin MEASUREMENT fmy_stat_msw_tog.err_info_stat.err_sym "For each symptom: status of failure (set to 1 when failure symptom is detected)" UWORD _CNV_S_16_RANGE_ERR__485_CM 1 100. 0. 15. DISPLAY_IDENTIFIER ERR_SYM_MSW_TOG ECU_ADDRESS 0xd000443e BIT_MASK 0x780 /end MEASUREMENT
/begin MEASUREMENT fmy_stat_msw_2.ctr_abc "anti-bounce counter for diagnosis XX" UBYTE _CNV_A_R_LINEAR_____0_CM 1 100. 0. 255. DISPLAY_IDENTIFIER CTR_ABC_MSW_2 ECU_ADDRESS 0xd0004434 FORMAT "%3.0" /end MEASUREMENT
/begin MEASUREMENT fmy_stat_msw_2.ctr_end_diag "Counter for the end of diagnosis XX generation" UBYTE _CNV_A_R_LINEAR_____0_CM 1 100. 0. 255. DISPLAY_IDENTIFIER CTR_ABC_END_DIAG_MSW_2 ECU_ADDRESS 0xd0004435 FORMAT "%3.0" /end MEASUREMENT
/begin MEASUREMENT fmy_stat_msw_2.err_info_stat.lv_err_mem "Failure is stored in dynamic memory (2nd layer)" UWORD _CNV_S_2_RANGE__0___1_CM 1 100. 0. 1. DISPLAY_IDENTIFIER LV_ERR_MEM_MSW_2 ECU_ADDRESS 0xd0004436 BIT_MASK 0x8 /end MEASUREMENT
/begin MEASUREMENT fmy_stat_msw_2.err_info_stat.lv_ready "Readiness flag related to diagnosis XX" UWORD _CNV_S_2_RANGE__0___1_CM 1 100. 0. 1. DISPLAY_IDENTIFIER LV_READY_MSW_2 ECU_ADDRESS 0xd0004436 BIT_MASK 0x10 /end MEASUREMENT
/begin MEASUREMENT fmy_stat_msw_2.err_info_stat.lv_end_diag "End of diagnosis XX" UWORD _CNV_S_2_RANGE__0___1_CM 1 100. 0. 1. DISPLAY_IDENTIFIER LV_END_DIAG_MSW_2 ECU_ADDRESS 0xd0004436 BIT_MASK 0x20 /end MEASUREMENT
/begin MEASUREMENT fmy_stat_msw_2.err_info_stat.lv_cdn_diag "Diagnosis condition to start symptom detection (set to 1 when condition is fulfilled)" UWORD _CNV_S_2_RANGE__0___1_CM 1 100. 0. 1. DISPLAY_IDENTIFIER LV_CDN_DIAG_MSW_2 ECU_ADDRESS 0xd0004436 BIT_MASK 0x40 /end MEASUREMENT
/begin MEASUREMENT fmy_stat_msw_2.err_info_stat.err_sym "For each symptom: status of failure (set to 1 when failure symptom is detected)" UWORD _CNV_S_16_RANGE_ERR__485_CM 1 100. 0. 15. DISPLAY_IDENTIFIER ERR_SYM_MSW_2 ECU_ADDRESS 0xd0004436 BIT_MASK 0x780 /end MEASUREMENT
/begin MEASUREMENT fmy_stat_msw_3.ctr_abc "anti-bounce counter for diagnosis XX" UBYTE _CNV_A_R_LINEAR_____0_CM 1 100. 0. 255. DISPLAY_IDENTIFIER CTR_ABC_MSW_3 ECU_ADDRESS 0xd0004438 FORMAT "%3.0" /end MEASUREMENT
/begin MEASUREMENT fmy_stat_msw_3.ctr_end_diag "Counter for the end of diagnosis XX generation" UBYTE _CNV_A_R_LINEAR_____0_CM 1 100. 0. 255. DISPLAY_IDENTIFIER CTR_ABC_END_DIAG_MSW_3 ECU_ADDRESS 0xd0004439 FORMAT "%3.0" /end MEASUREMENT
/begin MEASUREMENT fmy_stat_msw_3.err_info_stat.lv_err_mem "Failure is stored in dynamic memory (2nd layer)" UWORD _CNV_S_2_RANGE__0___1_CM 1 100. 0. 1. DISPLAY_IDENTIFIER LV_ERR_MEM_MSW_3 ECU_ADDRESS 0xd000443a BIT_MASK 0x8 /end MEASUREMENT
/begin MEASUREMENT fmy_stat_msw_3.err_info_stat.lv_ready "Readiness flag related to diagnosis XX" UWORD _CNV_S_2_RANGE__0___1_CM 1 100. 0. 1. DISPLAY_IDENTIFIER LV_READY_MSW_3 ECU_ADDRESS 0xd000443a BIT_MASK 0x10 /end MEASUREMENT
/begin MEASUREMENT fmy_stat_msw_3.err_info_stat.lv_end_diag "End of diagnosis XX" UWORD _CNV_S_2_RANGE__0___1_CM 1 100. 0. 1. DISPLAY_IDENTIFIER LV_END_DIAG_MSW_3 ECU_ADDRESS 0xd000443a BIT_MASK 0x20 /end MEASUREMENT
/begin MEASUREMENT fmy_stat_msw_3.err_info_stat.lv_cdn_diag "Diagnosis condition to start symptom detection (set to 1 when condition is fulfilled)" UWORD _CNV_S_2_RANGE__0___1_CM 1 100. 0. 1. DISPLAY_IDENTIFIER LV_CDN_DIAG_MSW_3 ECU_ADDRESS 0xd000443a BIT_MASK 0x40 /end MEASUREMENT
/begin MEASUREMENT fmy_stat_msw_3.err_info_stat.err_sym "For each symptom: status of failure (set to 1 when failure symptom is detected)" UWORD _CNV_S_16_RANGE_ERR__485_CM 1 100. 0. 15. DISPLAY_IDENTIFIER ERR_SYM_MSW_3 ECU_ADDRESS 0xd000443a BIT_MASK 0x780 /end MEASUREMENT
/begin MEASUREMENT fmy_stat_mis_0.ctr_abc "anti-bounce counter for diagnosis XX" UBYTE _CNV_A_R_LINEAR_____0_CM 1 100. 0. 255. DISPLAY_IDENTIFIER CTR_ABC_MIS_0 ECU_ADDRESS 0xd0004414 FORMAT "%3.0" /end MEASUREMENT
/begin MEASUREMENT fmy_stat_mis_0.ctr_end_diag "Counter for the end of diagnosis XX generation" UBYTE _CNV_A_R_LINEAR_____0_CM 1 100. 0. 255. DISPLAY_IDENTIFIER CTR_ABC_END_DIAG_MIS_0 ECU_ADDRESS 0xd0004415 FORMAT "%3.0" /end MEASUREMENT
/begin MEASUREMENT fmy_stat_mis_0.err_info_stat.lv_err_mem "Failure is stored in dynamic memory (2nd layer)" UWORD _CNV_S_2_RANGE__0___1_CM 1 100. 0. 1. DISPLAY_IDENTIFIER LV_ERR_MEM_MIS_0 ECU_ADDRESS 0xd0004416 BIT_MASK 0x8 /end MEASUREMENT
/begin MEASUREMENT fmy_stat_mis_0.err_info_stat.lv_ready "Readiness flag related to diagnosis XX" UWORD _CNV_S_2_RANGE__0___1_CM 1 100. 0. 1. DISPLAY_IDENTIFIER LV_READY_MIS_0 ECU_ADDRESS 0xd0004416 BIT_MASK 0x10 /end MEASUREMENT
/begin MEASUREMENT fmy_stat_mis_0.err_info_stat.lv_end_diag "End of diagnosis XX" UWORD _CNV_S_2_RANGE__0___1_CM 1 100. 0. 1. DISPLAY_IDENTIFIER LV_END_DIAG_MIS_0 ECU_ADDRESS 0xd0004416 BIT_MASK 0x20 /end MEASUREMENT
/begin MEASUREMENT fmy_stat_mis_0.err_info_stat.lv_cdn_diag "Diagnosis condition to start symptom detection (set to 1 when condition is fulfilled)" UWORD _CNV_S_2_RANGE__0___1_CM 1 100. 0. 1. DISPLAY_IDENTIFIER LV_CDN_DIAG_MIS_0 ECU_ADDRESS 0xd0004416 BIT_MASK 0x40 /end MEASUREMENT
/begin MEASUREMENT fmy_stat_mis_0.err_info_stat.err_sym "For each symptom: status of failure (set to 1 when failure symptom is detected)" UWORD _CNV_S_16_RANGE_ERR__485_CM 1 100. 0. 15. DISPLAY_IDENTIFIER ERR_SYM_MIS_0 ECU_ADDRESS 0xd0004416 BIT_MASK 0x780 /end MEASUREMENT
/begin MEASUREMENT fmy_stat_mis_1.ctr_abc "anti-bounce counter for diagnosis XX" UBYTE _CNV_A_R_LINEAR_____0_CM 1 100. 0. 255. DISPLAY_IDENTIFIER CTR_ABC_MIS_1 ECU_ADDRESS 0xd0004418 FORMAT "%3.0" /end MEASUREMENT
/begin MEASUREMENT fmy_stat_mis_1.ctr_end_diag "Counter for the end of diagnosis XX generation" UBYTE _CNV_A_R_LINEAR_____0_CM 1 100. 0. 255. DISPLAY_IDENTIFIER CTR_ABC_END_DIAG_MIS_1 ECU_ADDRESS 0xd0004419 FORMAT "%3.0" /end MEASUREMENT
/begin MEASUREMENT fmy_stat_mis_1.err_info_stat.lv_err_mem "Failure is stored in dynamic memory (2nd layer)" UWORD _CNV_S_2_RANGE__0___1_CM 1 100. 0. 1. DISPLAY_IDENTIFIER LV_ERR_MEM_MIS_1 ECU_ADDRESS 0xd000441a BIT_MASK 0x8 /end MEASUREMENT
/begin MEASUREMENT fmy_stat_mis_1.err_info_stat.lv_ready "Readiness flag related to diagnosis XX" UWORD _CNV_S_2_RANGE__0___1_CM 1 100. 0. 1. DISPLAY_IDENTIFIER LV_READY_MIS_1 ECU_ADDRESS 0xd000441a BIT_MASK 0x10 /end MEASUREMENT
/begin MEASUREMENT fmy_stat_mis_1.err_info_stat.lv_end_diag "End of diagnosis XX" UWORD _CNV_S_2_RANGE__0___1_CM 1 100. 0. 1. DISPLAY_IDENTIFIER LV_END_DIAG_MIS_1 ECU_ADDRESS 0xd000441a BIT_MASK 0x20 /end MEASUREMENT
/begin MEASUREMENT fmy_stat_mis_1.err_info_stat.lv_cdn_diag "Diagnosis condition to start symptom detection (set to 1 when condition is fulfilled)" UWORD _CNV_S_2_RANGE__0___1_CM 1 100. 0. 1. DISPLAY_IDENTIFIER LV_CDN_DIAG_MIS_1 ECU_ADDRESS 0xd000441a BIT_MASK 0x40 /end MEASUREMENT
/begin MEASUREMENT fmy_stat_mis_1.err_info_stat.err_sym "For each symptom: status of failure (set to 1 when failure symptom is detected)" UWORD _CNV_S_16_RANGE_ERR__485_CM 1 100. 0. 15. DISPLAY_IDENTIFIER ERR_SYM_MIS_1 ECU_ADDRESS 0xd000441a BIT_MASK 0x780 /end MEASUREMENT
/begin MEASUREMENT fmy_stat_mis_2.ctr_abc "anti-bounce counter for diagnosis XX" UBYTE _CNV_A_R_LINEAR_____0_CM 1 100. 0. 255. DISPLAY_IDENTIFIER CTR_ABC_MIS_2 ECU_ADDRESS 0xd000441c FORMAT "%3.0" /end MEASUREMENT
/begin MEASUREMENT fmy_stat_mis_2.ctr_end_diag "Counter for the end of diagnosis XX generation" UBYTE _CNV_A_R_LINEAR_____0_CM 1 100. 0. 255. DISPLAY_IDENTIFIER CTR_ABC_END_DIAG_MIS_2 ECU_ADDRESS 0xd000441d FORMAT "%3.0" /end MEASUREMENT
/begin MEASUREMENT fmy_stat_mis_2.err_info_stat.lv_err_mem "Failure is stored in dynamic memory (2nd layer)" UWORD _CNV_S_2_RANGE__0___1_CM 1 100. 0. 1. DISPLAY_IDENTIFIER LV_ERR_MEM_MIS_2 ECU_ADDRESS 0xd000441e BIT_MASK 0x8 /end MEASUREMENT
/begin MEASUREMENT fmy_stat_mis_2.err_info_stat.lv_ready "Readiness flag related to diagnosis XX" UWORD _CNV_S_2_RANGE__0___1_CM 1 100. 0. 1. DISPLAY_IDENTIFIER LV_READY_MIS_2 ECU_ADDRESS 0xd000441e BIT_MASK 0x10 /end MEASUREMENT
/begin MEASUREMENT fmy_stat_mis_2.err_info_stat.lv_end_diag "End of diagnosis XX" UWORD _CNV_S_2_RANGE__0___1_CM 1 100. 0. 1. DISPLAY_IDENTIFIER LV_END_DIAG_MIS_2 ECU_ADDRESS 0xd000441e BIT_MASK 0x20 /end MEASUREMENT
/begin MEASUREMENT fmy_stat_mis_2.err_info_stat.lv_cdn_diag "Diagnosis condition to start symptom detection (set to 1 when condition is fulfilled)" UWORD _CNV_S_2_RANGE__0___1_CM 1 100. 0. 1. DISPLAY_IDENTIFIER LV_CDN_DIAG_MIS_2 ECU_ADDRESS 0xd000441e BIT_MASK 0x40 /end MEASUREMENT
/begin MEASUREMENT fmy_stat_mis_2.err_info_stat.err_sym "For each symptom: status of failure (set to 1 when failure symptom is detected)" UWORD _CNV_S_16_RANGE_ERR__485_CM 1 100. 0. 15. DISPLAY_IDENTIFIER ERR_SYM_MIS_2 ECU_ADDRESS 0xd000441e BIT_MASK 0x780 /end MEASUREMENT
/begin MEASUREMENT fmy_stat_mis_3.ctr_abc "anti-bounce counter for diagnosis XX" UBYTE _CNV_A_R_LINEAR_____0_CM 1 100. 0. 255. DISPLAY_IDENTIFIER CTR_ABC_MIS_3 ECU_ADDRESS 0xd0004420 FORMAT "%3.0" /end MEASUREMENT
/begin MEASUREMENT fmy_stat_mis_3.ctr_end_diag "Counter for the end of diagnosis XX generation" UBYTE _CNV_A_R_LINEAR_____0_CM 1 100. 0. 255. DISPLAY_IDENTIFIER CTR_ABC_END_DIAG_MIS_3 ECU_ADDRESS 0xd0004421 FORMAT "%3.0" /end MEASUREMENT
/begin MEASUREMENT fmy_stat_mis_3.err_info_stat.lv_err_mem "Failure is stored in dynamic memory (2nd layer)" UWORD _CNV_S_2_RANGE__0___1_CM 1 100. 0. 1. DISPLAY_IDENTIFIER LV_ERR_MEM_MIS_3 ECU_ADDRESS 0xd0004422 BIT_MASK 0x8 /end MEASUREMENT
/begin MEASUREMENT fmy_stat_mis_3.err_info_stat.lv_ready "Readiness flag related to diagnosis XX" UWORD _CNV_S_2_RANGE__0___1_CM 1 100. 0. 1. DISPLAY_IDENTIFIER LV_READY_MIS_3 ECU_ADDRESS 0xd0004422 BIT_MASK 0x10 /end MEASUREMENT
/begin MEASUREMENT fmy_stat_mis_3.err_info_stat.lv_end_diag "End of diagnosis XX" UWORD _CNV_S_2_RANGE__0___1_CM 1 100. 0. 1. DISPLAY_IDENTIFIER LV_END_DIAG_MIS_3 ECU_ADDRESS 0xd0004422 BIT_MASK 0x20 /end MEASUREMENT
/begin MEASUREMENT fmy_stat_mis_3.err_info_stat.lv_cdn_diag "Diagnosis condition to start symptom detection (set to 1 when condition is fulfilled)" UWORD _CNV_S_2_RANGE__0___1_CM 1 100. 0. 1. DISPLAY_IDENTIFIER LV_CDN_DIAG_MIS_3 ECU_ADDRESS 0xd0004422 BIT_MASK 0x40 /end MEASUREMENT
/begin MEASUREMENT fmy_stat_mis_3.err_info_stat.err_sym "For each symptom: status of failure (set to 1 when failure symptom is detected)" UWORD _CNV_S_16_RANGE_ERR__485_CM 1 100. 0. 15. DISPLAY_IDENTIFIER ERR_SYM_MIS_3 ECU_ADDRESS 0xd0004422 BIT_MASK 0x780 /end MEASUREMENT
/begin MEASUREMENT fmy_stat_mis_4.ctr_abc "anti-bounce counter for diagnosis XX" UBYTE _CNV_A_R_LINEAR_____0_CM 1 100. 0. 255. DISPLAY_IDENTIFIER CTR_ABC_MIS_4 ECU_ADDRESS 0xd0004424 FORMAT "%3.0" /end MEASUREMENT
/begin MEASUREMENT fmy_stat_mis_4.ctr_end_diag "Counter for the end of diagnosis XX generation" UBYTE _CNV_A_R_LINEAR_____0_CM 1 100. 0. 255. DISPLAY_IDENTIFIER CTR_ABC_END_DIAG_MIS_4 ECU_ADDRESS 0xd0004425 FORMAT "%3.0" /end MEASUREMENT
/begin MEASUREMENT fmy_stat_mis_4.err_info_stat.lv_err_mem "Failure is stored in dynamic memory (2nd layer)" UWORD _CNV_S_2_RANGE__0___1_CM 1 100. 0. 1. DISPLAY_IDENTIFIER LV_ERR_MEM_MIS_4 ECU_ADDRESS 0xd0004426 BIT_MASK 0x8 /end MEASUREMENT
/begin MEASUREMENT fmy_stat_mis_4.err_info_stat.lv_ready "Readiness flag related to diagnosis XX" UWORD _CNV_S_2_RANGE__0___1_CM 1 100. 0. 1. DISPLAY_IDENTIFIER LV_READY_MIS_4 ECU_ADDRESS 0xd0004426 BIT_MASK 0x10 /end MEASUREMENT
/begin MEASUREMENT fmy_stat_mis_4.err_info_stat.lv_end_diag "End of diagnosis XX" UWORD _CNV_S_2_RANGE__0___1_CM 1 100. 0. 1. DISPLAY_IDENTIFIER LV_END_DIAG_MIS_4 ECU_ADDRESS 0xd0004426 BIT_MASK 0x20 /end MEASUREMENT
/begin MEASUREMENT fmy_stat_mis_4.err_info_stat.lv_cdn_diag "Diagnosis condition to start symptom detection (set to 1 when condition is fulfilled)" UWORD _CNV_S_2_RANGE__0___1_CM 1 100. 0. 1. DISPLAY_IDENTIFIER LV_CDN_DIAG_MIS_4 ECU_ADDRESS 0xd0004426 BIT_MASK 0x40 /end MEASUREMENT
/begin MEASUREMENT fmy_stat_mis_4.err_info_stat.err_sym "For each symptom: status of failure (set to 1 when failure symptom is detected)" UWORD _CNV_S_16_RANGE_ERR__485_CM 1 100. 0. 15. DISPLAY_IDENTIFIER ERR_SYM_MIS_4 ECU_ADDRESS 0xd0004426 BIT_MASK 0x780 /end MEASUREMENT
/begin MEASUREMENT fmy_stat_mis_5.ctr_abc "anti-bounce counter for diagnosis XX" UBYTE _CNV_A_R_LINEAR_____0_CM 1 100. 0. 255. DISPLAY_IDENTIFIER CTR_ABC_MIS_5 ECU_ADDRESS 0xd0004428 FORMAT "%3.0" /end MEASUREMENT
/begin MEASUREMENT fmy_stat_mis_5.ctr_end_diag "Counter for the end of diagnosis XX generation" UBYTE _CNV_A_R_LINEAR_____0_CM 1 100. 0. 255. DISPLAY_IDENTIFIER CTR_ABC_END_DIAG_MIS_5 ECU_ADDRESS 0xd0004429 FORMAT "%3.0" /end MEASUREMENT
/begin MEASUREMENT fmy_stat_mis_5.err_info_stat.lv_err_mem "Failure is stored in dynamic memory (2nd layer)" UWORD _CNV_S_2_RANGE__0___1_CM 1 100. 0. 1. DISPLAY_IDENTIFIER LV_ERR_MEM_MIS_5 ECU_ADDRESS 0xd000442a BIT_MASK 0x8 /end MEASUREMENT
/begin MEASUREMENT fmy_stat_mis_5.err_info_stat.lv_ready "Readiness flag related to diagnosis XX" UWORD _CNV_S_2_RANGE__0___1_CM 1 100. 0. 1. DISPLAY_IDENTIFIER LV_READY_MIS_5 ECU_ADDRESS 0xd000442a BIT_MASK 0x10 /end MEASUREMENT
/begin MEASUREMENT fmy_stat_mis_5.err_info_stat.lv_end_diag "End of diagnosis XX" UWORD _CNV_S_2_RANGE__0___1_CM 1 100. 0. 1. DISPLAY_IDENTIFIER LV_END_DIAG_MIS_5 ECU_ADDRESS 0xd000442a BIT_MASK 0x20 /end MEASUREMENT
/begin MEASUREMENT fmy_stat_mis_5.err_info_stat.lv_cdn_diag "Diagnosis condition to start symptom detection (set to 1 when condition is fulfilled)" UWORD _CNV_S_2_RANGE__0___1_CM 1 100. 0. 1. DISPLAY_IDENTIFIER LV_CDN_DIAG_MIS_5 ECU_ADDRESS 0xd000442a BIT_MASK 0x40 /end MEASUREMENT
/begin MEASUREMENT fmy_stat_mis_5.err_info_stat.err_sym "For each symptom: status of failure (set to 1 when failure symptom is detected)" UWORD _CNV_S_16_RANGE_ERR__485_CM 1 100. 0. 15. DISPLAY_IDENTIFIER ERR_SYM_MIS_5 ECU_ADDRESS 0xd000442a BIT_MASK 0x780 /end MEASUREMENT
/begin MEASUREMENT fmy_stat_mis_mpl.ctr_abc "anti-bounce counter for diagnosis XX" UBYTE _CNV_A_R_LINEAR_____0_CM 1 100. 0. 255. DISPLAY_IDENTIFIER CTR_ABC_MIS_MPL ECU_ADDRESS 0xd0004430 FORMAT "%3.0" /end MEASUREMENT
/begin MEASUREMENT fmy_stat_mis_mpl.ctr_end_diag "Counter for the end of diagnosis XX generation" UBYTE _CNV_A_R_LINEAR_____0_CM 1 100. 0. 255. DISPLAY_IDENTIFIER CTR_ABC_END_DIAG_MIS_MPL ECU_ADDRESS 0xd0004431 FORMAT "%3.0" /end MEASUREMENT
/begin MEASUREMENT fmy_stat_mis_mpl.err_info_stat.lv_err_mem "Failure is stored in dynamic memory (2nd layer)" UWORD _CNV_S_2_RANGE__0___1_CM 1 100. 0. 1. DISPLAY_IDENTIFIER LV_ERR_MEM_MIS_MPL ECU_ADDRESS 0xd0004432 BIT_MASK 0x8 /end MEASUREMENT
/begin MEASUREMENT fmy_stat_mis_mpl.err_info_stat.lv_ready "Readiness flag related to diagnosis XX" UWORD _CNV_S_2_RANGE__0___1_CM 1 100. 0. 1. DISPLAY_IDENTIFIER LV_READY_MIS_MPL ECU_ADDRESS 0xd0004432 BIT_MASK 0x10 /end MEASUREMENT
/begin MEASUREMENT fmy_stat_mis_mpl.err_info_stat.lv_end_diag "End of diagnosis XX" UWORD _CNV_S_2_RANGE__0___1_CM 1 100. 0. 1. DISPLAY_IDENTIFIER LV_END_DIAG_MIS_MPL ECU_ADDRESS 0xd0004432 BIT_MASK 0x20 /end MEASUREMENT
/begin MEASUREMENT fmy_stat_mis_mpl.err_info_stat.lv_cdn_diag "Diagnosis condition to start symptom detection (set to 1 when condition is fulfilled)" UWORD _CNV_S_2_RANGE__0___1_CM 1 100. 0. 1. DISPLAY_IDENTIFIER LV_CDN_DIAG_MIS_MPL ECU_ADDRESS 0xd0004432 BIT_MASK 0x40 /end MEASUREMENT
/begin MEASUREMENT fmy_stat_mis_mpl.err_info_stat.err_sym "For each symptom: status of failure (set to 1 when failure symptom is detected)" UWORD _CNV_S_16_RANGE_ERR__485_CM 1 100. 0. 15. DISPLAY_IDENTIFIER ERR_SYM_MIS_MPL ECU_ADDRESS 0xd0004432 BIT_MASK 0x780 /end MEASUREMENT
/begin MEASUREMENT fmy_stat_mis_ftl_l.ctr_abc "anti-bounce counter for diagnosis XX" UBYTE _CNV_A_R_LINEAR_____0_CM 1 100. 0. 255. DISPLAY_IDENTIFIER CTR_ABC_MIS_FTL_L ECU_ADDRESS 0xd000442c FORMAT "%3.0" /end MEASUREMENT
/begin MEASUREMENT fmy_stat_mis_ftl_l.ctr_end_diag "Counter for the end of diagnosis XX generation" UBYTE _CNV_A_R_LINEAR_____0_CM 1 100. 0. 255. DISPLAY_IDENTIFIER CTR_ABC_END_DIAG_MIS_FTL_L ECU_ADDRESS 0xd000442d FORMAT "%3.0" /end MEASUREMENT
/begin MEASUREMENT fmy_stat_mis_ftl_l.err_info_stat.lv_err_mem "Failure is stored in dynamic memory (2nd layer)" UWORD _CNV_S_2_RANGE__0___1_CM 1 100. 0. 1. DISPLAY_IDENTIFIER LV_ERR_MEM_MIS_FTL_L ECU_ADDRESS 0xd000442e BIT_MASK 0x8 /end MEASUREMENT
/begin MEASUREMENT fmy_stat_mis_ftl_l.err_info_stat.lv_ready "Readiness flag related to diagnosis XX" UWORD _CNV_S_2_RANGE__0___1_CM 1 100. 0. 1. DISPLAY_IDENTIFIER LV_READY_MIS_FTL_L ECU_ADDRESS 0xd000442e BIT_MASK 0x10 /end MEASUREMENT
/begin MEASUREMENT fmy_stat_mis_ftl_l.err_info_stat.lv_end_diag "End of diagnosis XX" UWORD _CNV_S_2_RANGE__0___1_CM 1 100. 0. 1. DISPLAY_IDENTIFIER LV_END_DIAG_MIS_FTL_L ECU_ADDRESS 0xd000442e BIT_MASK 0x20 /end MEASUREMENT
/begin MEASUREMENT fmy_stat_mis_ftl_l.err_info_stat.lv_cdn_diag "Diagnosis condition to start symptom detection (set to 1 when condition is fulfilled)" UWORD _CNV_S_2_RANGE__0___1_CM 1 100. 0. 1. DISPLAY_IDENTIFIER LV_CDN_DIAG_MIS_FTL_L ECU_ADDRESS 0xd000442e BIT_MASK 0x40 /end MEASUREMENT
/begin MEASUREMENT fmy_stat_mis_ftl_l.err_info_stat.err_sym "For each symptom: status of failure (set to 1 when failure symptom is detected)" UWORD _CNV_S_16_RANGE_ERR__485_CM 1 100. 0. 15. DISPLAY_IDENTIFIER ERR_SYM_MIS_FTL_L ECU_ADDRESS 0xd000442e BIT_MASK 0x780 /end MEASUREMENT
/begin MEASUREMENT fmy_stat_fsd_1.ctr_abc "anti-bounce counter for diagnosis XX" UBYTE _CNV_A_R_LINEAR_____0_CM 1 100. 0. 255. DISPLAY_IDENTIFIER CTR_ABC_FSD_1 ECU_ADDRESS 0xd0004318 FORMAT "%3.0" /end MEASUREMENT
/begin MEASUREMENT fmy_stat_fsd_1.ctr_end_diag "Counter for the end of diagnosis XX generation" UBYTE _CNV_A_R_LINEAR_____0_CM 1 100. 0. 255. DISPLAY_IDENTIFIER CTR_ABC_END_DIAG_FSD_1 ECU_ADDRESS 0xd0004319 FORMAT "%3.0" /end MEASUREMENT
/begin MEASUREMENT fmy_stat_fsd_1.err_info_stat.lv_err_mem "Failure is stored in dynamic memory (2nd layer)" UWORD _CNV_S_2_RANGE__0___1_CM 1 100. 0. 1. DISPLAY_IDENTIFIER LV_ERR_MEM_FSD_1 ECU_ADDRESS 0xd000431a BIT_MASK 0x8 /end MEASUREMENT
/begin MEASUREMENT fmy_stat_fsd_1.err_info_stat.lv_ready "Readiness flag related to diagnosis XX" UWORD _CNV_S_2_RANGE__0___1_CM 1 100. 0. 1. DISPLAY_IDENTIFIER LV_READY_FSD_1 ECU_ADDRESS 0xd000431a BIT_MASK 0x10 /end MEASUREMENT
/begin MEASUREMENT fmy_stat_fsd_1.err_info_stat.lv_end_diag "End of diagnosis XX" UWORD _CNV_S_2_RANGE__0___1_CM 1 100. 0. 1. DISPLAY_IDENTIFIER LV_END_DIAG_FSD_1 ECU_ADDRESS 0xd000431a BIT_MASK 0x20 /end MEASUREMENT
/begin MEASUREMENT fmy_stat_fsd_1.err_info_stat.lv_cdn_diag "Diagnosis condition to start symptom detection (set to 1 when condition is fulfilled)" UWORD _CNV_S_2_RANGE__0___1_CM 1 100. 0. 1. DISPLAY_IDENTIFIER LV_CDN_DIAG_FSD_1 ECU_ADDRESS 0xd000431a BIT_MASK 0x40 /end MEASUREMENT
/begin MEASUREMENT fmy_stat_fsd_1.err_info_stat.err_sym "For each symptom: status of failure (set to 1 when failure symptom is detected)" UWORD _CNV_S_16_RANGE_ERR__485_CM 1 100. 0. 15. DISPLAY_IDENTIFIER ERR_SYM_FSD_1 ECU_ADDRESS 0xd000431a BIT_MASK 0x780 /end MEASUREMENT
/begin MEASUREMENT fmy_stat_fsd_2.ctr_abc "anti-bounce counter for diagnosis XX" UBYTE _CNV_A_R_LINEAR_____0_CM 1 100. 0. 255. DISPLAY_IDENTIFIER CTR_ABC_FSD_2 ECU_ADDRESS 0xd000431c FORMAT "%3.0" /end MEASUREMENT
/begin MEASUREMENT fmy_stat_fsd_2.ctr_end_diag "Counter for the end of diagnosis XX generation" UBYTE _CNV_A_R_LINEAR_____0_CM 1 100. 0. 255. DISPLAY_IDENTIFIER CTR_ABC_END_DIAG_FSD_2 ECU_ADDRESS 0xd000431d FORMAT "%3.0" /end MEASUREMENT
/begin MEASUREMENT fmy_stat_fsd_2.err_info_stat.lv_err_mem "Failure is stored in dynamic memory (2nd layer)" UWORD _CNV_S_2_RANGE__0___1_CM 1 100. 0. 1. DISPLAY_IDENTIFIER LV_ERR_MEM_FSD_2 ECU_ADDRESS 0xd000431e BIT_MASK 0x8 /end MEASUREMENT
/begin MEASUREMENT fmy_stat_fsd_2.err_info_stat.lv_ready "Readiness flag related to diagnosis XX" UWORD _CNV_S_2_RANGE__0___1_CM 1 100. 0. 1. DISPLAY_IDENTIFIER LV_READY_FSD_2 ECU_ADDRESS 0xd000431e BIT_MASK 0x10 /end MEASUREMENT
/begin MEASUREMENT fmy_stat_fsd_2.err_info_stat.lv_end_diag "End of diagnosis XX" UWORD _CNV_S_2_RANGE__0___1_CM 1 100. 0. 1. DISPLAY_IDENTIFIER LV_END_DIAG_FSD_2 ECU_ADDRESS 0xd000431e BIT_MASK 0x20 /end MEASUREMENT
/begin MEASUREMENT fmy_stat_fsd_2.err_info_stat.lv_cdn_diag "Diagnosis condition to start symptom detection (set to 1 when condition is fulfilled)" UWORD _CNV_S_2_RANGE__0___1_CM 1 100. 0. 1. DISPLAY_IDENTIFIER LV_CDN_DIAG_FSD_2 ECU_ADDRESS 0xd000431e BIT_MASK 0x40 /end MEASUREMENT
/begin MEASUREMENT fmy_stat_fsd_2.err_info_stat.err_sym "For each symptom: status of failure (set to 1 when failure symptom is detected)" UWORD _CNV_S_16_RANGE_ERR__485_CM 1 100. 0. 15. DISPLAY_IDENTIFIER ERR_SYM_FSD_2 ECU_ADDRESS 0xd000431e BIT_MASK 0x780 /end MEASUREMENT
/begin MEASUREMENT fmy_stat_ef.ctr_abc "anti-bounce counter for diagnosis XX" UBYTE _CNV_A_R_LINEAR_____0_CM 1 100. 0. 255. DISPLAY_IDENTIFIER CTR_ABC_EF ECU_ADDRESS 0xd00042f0 FORMAT "%3.0" /end MEASUREMENT
/begin MEASUREMENT fmy_stat_ef.ctr_end_diag "Counter for the end of diagnosis XX generation" UBYTE _CNV_A_R_LINEAR_____0_CM 1 100. 0. 255. DISPLAY_IDENTIFIER CTR_ABC_END_DIAG_EF ECU_ADDRESS 0xd00042f1 FORMAT "%3.0" /end MEASUREMENT
/begin MEASUREMENT fmy_stat_ef.err_info_stat.lv_err_mem "Failure is stored in dynamic memory (2nd layer)" UWORD _CNV_S_2_RANGE__0___1_CM 1 100. 0. 1. DISPLAY_IDENTIFIER LV_ERR_MEM_EF ECU_ADDRESS 0xd00042f2 BIT_MASK 0x8 /end MEASUREMENT
/begin MEASUREMENT fmy_stat_ef.err_info_stat.lv_ready "Readiness flag related to diagnosis XX" UWORD _CNV_S_2_RANGE__0___1_CM 1 100. 0. 1. DISPLAY_IDENTIFIER LV_READY_EF ECU_ADDRESS 0xd00042f2 BIT_MASK 0x10 /end MEASUREMENT
/begin MEASUREMENT fmy_stat_ef.err_info_stat.lv_end_diag "End of diagnosis XX" UWORD _CNV_S_2_RANGE__0___1_CM 1 100. 0. 1. DISPLAY_IDENTIFIER LV_END_DIAG_EF ECU_ADDRESS 0xd00042f2 BIT_MASK 0x20 /end MEASUREMENT
/begin MEASUREMENT fmy_stat_ef.err_info_stat.lv_cdn_diag "Diagnosis condition to start symptom detection (set to 1 when condition is fulfilled)" UWORD _CNV_S_2_RANGE__0___1_CM 1 100. 0. 1. DISPLAY_IDENTIFIER LV_CDN_DIAG_EF ECU_ADDRESS 0xd00042f2 BIT_MASK 0x40 /end MEASUREMENT
/begin MEASUREMENT fmy_stat_ef.err_info_stat.err_sym "For each symptom: status of failure (set to 1 when failure symptom is detected)" UWORD _CNV_S_16_RANGE_ERR__485_CM 1 100. 0. 15. DISPLAY_IDENTIFIER ERR_SYM_EF ECU_ADDRESS 0xd00042f2 BIT_MASK 0x780 /end MEASUREMENT
/begin MEASUREMENT fmy_stat_tecu.ctr_abc "anti-bounce counter for diagnosis XX" UBYTE _CNV_A_R_LINEAR_____0_CM 1 100. 0. 255. DISPLAY_IDENTIFIER CTR_ABC_TECU ECU_ADDRESS 0xd0004598 FORMAT "%3.0" /end MEASUREMENT
/begin MEASUREMENT fmy_stat_tecu.ctr_end_diag "Counter for the end of diagnosis XX generation" UBYTE _CNV_A_R_LINEAR_____0_CM 1 100. 0. 255. DISPLAY_IDENTIFIER CTR_ABC_END_DIAG_TECU ECU_ADDRESS 0xd0004599 FORMAT "%3.0" /end MEASUREMENT
/begin MEASUREMENT fmy_stat_tecu.err_info_stat.lv_err_mem "Failure is stored in dynamic memory (2nd layer)" UWORD _CNV_S_2_RANGE__0___1_CM 1 100. 0. 1. DISPLAY_IDENTIFIER LV_ERR_MEM_TECU ECU_ADDRESS 0xd000459a BIT_MASK 0x8 /end MEASUREMENT
/begin MEASUREMENT fmy_stat_tecu.err_info_stat.lv_ready "Readiness flag related to diagnosis XX" UWORD _CNV_S_2_RANGE__0___1_CM 1 100. 0. 1. DISPLAY_IDENTIFIER LV_READY_TECU ECU_ADDRESS 0xd000459a BIT_MASK 0x10 /end MEASUREMENT
/begin MEASUREMENT fmy_stat_tecu.err_info_stat.lv_end_diag "End of diagnosis XX" UWORD _CNV_S_2_RANGE__0___1_CM 1 100. 0. 1. DISPLAY_IDENTIFIER LV_END_DIAG_TECU ECU_ADDRESS 0xd000459a BIT_MASK 0x20 /end MEASUREMENT
/begin MEASUREMENT fmy_stat_tecu.err_info_stat.lv_cdn_diag "Diagnosis condition to start symptom detection (set to 1 when condition is fulfilled)" UWORD _CNV_S_2_RANGE__0___1_CM 1 100. 0. 1. DISPLAY_IDENTIFIER LV_CDN_DIAG_TECU ECU_ADDRESS 0xd000459a BIT_MASK 0x40 /end MEASUREMENT
/begin MEASUREMENT fmy_stat_tecu.err_info_stat.err_sym "For each symptom: status of failure (set to 1 when failure symptom is detected)" UWORD _CNV_S_16_RANGE_ERR__485_CM 1 100. 0. 15. DISPLAY_IDENTIFIER ERR_SYM_TECU ECU_ADDRESS 0xd000459a BIT_MASK 0x780 /end MEASUREMENT
/begin MEASUREMENT fmy_stat_ebox_cfa.ctr_abc "anti-bounce counter for diagnosis XX" UBYTE _CNV_A_R_LINEAR_____0_CM 1 100. 0. 255. DISPLAY_IDENTIFIER CTR_ABC_EBOX_CFA ECU_ADDRESS 0xd00042cc FORMAT "%3.0" /end MEASUREMENT
/begin MEASUREMENT fmy_stat_ebox_cfa.ctr_end_diag "Counter for the end of diagnosis XX generation" UBYTE _CNV_A_R_LINEAR_____0_CM 1 100. 0. 255. DISPLAY_IDENTIFIER CTR_ABC_END_DIAG_EBOX_CFA ECU_ADDRESS 0xd00042cd FORMAT "%3.0" /end MEASUREMENT
/begin MEASUREMENT fmy_stat_ebox_cfa.err_info_stat.lv_err_mem "Failure is stored in dynamic memory (2nd layer)" UWORD _CNV_S_2_RANGE__0___1_CM 1 100. 0. 1. DISPLAY_IDENTIFIER LV_ERR_MEM_EBOX_CFA ECU_ADDRESS 0xd00042ce BIT_MASK 0x8 /end MEASUREMENT
/begin MEASUREMENT fmy_stat_ebox_cfa.err_info_stat.lv_ready "Readiness flag related to diagnosis XX" UWORD _CNV_S_2_RANGE__0___1_CM 1 100. 0. 1. DISPLAY_IDENTIFIER LV_READY_EBOX_CFA ECU_ADDRESS 0xd00042ce BIT_MASK 0x10 /end MEASUREMENT
/begin MEASUREMENT fmy_stat_ebox_cfa.err_info_stat.lv_end_diag "End of diagnosis XX" UWORD _CNV_S_2_RANGE__0___1_CM 1 100. 0. 1. DISPLAY_IDENTIFIER LV_END_DIAG_EBOX_CFA ECU_ADDRESS 0xd00042ce BIT_MASK 0x20 /end MEASUREMENT
/begin MEASUREMENT fmy_stat_ebox_cfa.err_info_stat.lv_cdn_diag "Diagnosis condition to start symptom detection (set to 1 when condition is fulfilled)" UWORD _CNV_S_2_RANGE__0___1_CM 1 100. 0. 1. DISPLAY_IDENTIFIER LV_CDN_DIAG_EBOX_CFA ECU_ADDRESS 0xd00042ce BIT_MASK 0x40 /end MEASUREMENT
/begin MEASUREMENT fmy_stat_ebox_cfa.err_info_stat.err_sym "For each symptom: status of failure (set to 1 when failure symptom is detected)" UWORD _CNV_S_16_RANGE_ERR__485_CM 1 100. 0. 15. DISPLAY_IDENTIFIER ERR_SYM_EBOX_CFA ECU_ADDRESS 0xd00042ce BIT_MASK 0x780 /end MEASUREMENT
/begin MEASUREMENT fmy_stat_ecu_ram.ctr_abc "anti-bounce counter for diagnosis XX" UBYTE _CNV_A_R_LINEAR_____0_CM 1 100. 0. 255. DISPLAY_IDENTIFIER CTR_ABC_ECU_RAM ECU_ADDRESS 0xd00042ec FORMAT "%3.0" /end MEASUREMENT
/begin MEASUREMENT fmy_stat_ecu_ram.ctr_end_diag "Counter for the end of diagnosis XX generation" UBYTE _CNV_A_R_LINEAR_____0_CM 1 100. 0. 255. DISPLAY_IDENTIFIER CTR_ABC_END_DIAG_ECU_RAM ECU_ADDRESS 0xd00042ed FORMAT "%3.0" /end MEASUREMENT
/begin MEASUREMENT fmy_stat_ecu_ram.err_info_stat.lv_err_mem "Failure is stored in dynamic memory (2nd layer)" UWORD _CNV_S_2_RANGE__0___1_CM 1 100. 0. 1. DISPLAY_IDENTIFIER LV_ERR_MEM_ECU_RAM ECU_ADDRESS 0xd00042ee BIT_MASK 0x8 /end MEASUREMENT
/begin MEASUREMENT fmy_stat_ecu_ram.err_info_stat.lv_ready "Readiness flag related to diagnosis XX" UWORD _CNV_S_2_RANGE__0___1_CM 1 100. 0. 1. DISPLAY_IDENTIFIER LV_READY_ECU_RAM ECU_ADDRESS 0xd00042ee BIT_MASK 0x10 /end MEASUREMENT
/begin MEASUREMENT fmy_stat_ecu_ram.err_info_stat.lv_end_diag "End of diagnosis XX" UWORD _CNV_S_2_RANGE__0___1_CM 1 100. 0. 1. DISPLAY_IDENTIFIER LV_END_DIAG_ECU_RAM ECU_ADDRESS 0xd00042ee BIT_MASK 0x20 /end MEASUREMENT
/begin MEASUREMENT fmy_stat_ecu_ram.err_info_stat.lv_cdn_diag "Diagnosis condition to start symptom detection (set to 1 when condition is fulfilled)" UWORD _CNV_S_2_RANGE__0___1_CM 1 100. 0. 1. DISPLAY_IDENTIFIER LV_CDN_DIAG_ECU_RAM ECU_ADDRESS 0xd00042ee BIT_MASK 0x40 /end MEASUREMENT
/begin MEASUREMENT fmy_stat_ecu_ram.err_info_stat.err_sym "For each symptom: status of failure (set to 1 when failure symptom is detected)" UWORD _CNV_S_16_RANGE_ERR__485_CM 1 100. 0. 15. DISPLAY_IDENTIFIER ERR_SYM_ECU_RAM ECU_ADDRESS 0xd00042ee BIT_MASK 0x780 /end MEASUREMENT
/begin MEASUREMENT fmy_stat_tqi_lim.ctr_abc "anti-bounce counter for diagnosis XX" UBYTE _CNV_A_R_LINEAR_____0_CM 1 100. 0. 255. DISPLAY_IDENTIFIER CTR_ABC_TQI_LIM ECU_ADDRESS 0xd000461c FORMAT "%3.0" /end MEASUREMENT
/begin MEASUREMENT fmy_stat_tqi_lim.ctr_end_diag "Counter for the end of diagnosis XX generation" UBYTE _CNV_A_R_LINEAR_____0_CM 1 100. 0. 255. DISPLAY_IDENTIFIER CTR_ABC_END_DIAG_TQI_LIM ECU_ADDRESS 0xd000461d FORMAT "%3.0" /end MEASUREMENT
/begin MEASUREMENT fmy_stat_tqi_lim.err_info_stat.lv_err_mem "Failure is stored in dynamic memory (2nd layer)" UWORD _CNV_S_2_RANGE__0___1_CM 1 100. 0. 1. DISPLAY_IDENTIFIER LV_ERR_MEM_TQI_LIM ECU_ADDRESS 0xd000461e BIT_MASK 0x8 /end MEASUREMENT
/begin MEASUREMENT fmy_stat_tqi_lim.err_info_stat.lv_ready "Readiness flag related to diagnosis XX" UWORD _CNV_S_2_RANGE__0___1_CM 1 100. 0. 1. DISPLAY_IDENTIFIER LV_READY_TQI_LIM ECU_ADDRESS 0xd000461e BIT_MASK 0x10 /end MEASUREMENT
/begin MEASUREMENT fmy_stat_tqi_lim.err_info_stat.lv_end_diag "End of diagnosis XX" UWORD _CNV_S_2_RANGE__0___1_CM 1 100. 0. 1. DISPLAY_IDENTIFIER LV_END_DIAG_TQI_LIM ECU_ADDRESS 0xd000461e BIT_MASK 0x20 /end MEASUREMENT
/begin MEASUREMENT fmy_stat_tqi_lim.err_info_stat.lv_cdn_diag "Diagnosis condition to start symptom detection (set to 1 when condition is fulfilled)" UWORD _CNV_S_2_RANGE__0___1_CM 1 100. 0. 1. DISPLAY_IDENTIFIER LV_CDN_DIAG_TQI_LIM ECU_ADDRESS 0xd000461e BIT_MASK 0x40 /end MEASUREMENT
/begin MEASUREMENT fmy_stat_tqi_lim.err_info_stat.err_sym "For each symptom: status of failure (set to 1 when failure symptom is detected)" UWORD _CNV_S_16_RANGE_ERR__485_CM 1 100. 0. 15. DISPLAY_IDENTIFIER ERR_SYM_TQI_LIM ECU_ADDRESS 0xd000461e BIT_MASK 0x780 /end MEASUREMENT
/begin MEASUREMENT fmy_stat_obd2_lsh_down_1.ctr_abc "anti-bounce counter for diagnosis XX" UBYTE _CNV_A_R_LINEAR_____0_CM 1 100. 0. 255. DISPLAY_IDENTIFIER CTR_ABC_OBD2_LSH_DOWN_1 ECU_ADDRESS 0xd0004460 FORMAT "%3.0" /end MEASUREMENT
/begin MEASUREMENT fmy_stat_obd2_lsh_down_1.ctr_end_diag "Counter for the end of diagnosis XX generation" UBYTE _CNV_A_R_LINEAR_____0_CM 1 100. 0. 255. DISPLAY_IDENTIFIER CTR_ABC_END_DIAG_OBD2_LSH_DOWN_1 ECU_ADDRESS 0xd0004461 FORMAT "%3.0" /end MEASUREMENT
/begin MEASUREMENT fmy_stat_obd2_lsh_down_1.err_info_stat.lv_err_mem "Failure is stored in dynamic memory (2nd layer)" UWORD _CNV_S_2_RANGE__0___1_CM 1 100. 0. 1. DISPLAY_IDENTIFIER LV_ERR_MEM_OBD2_LSH_DOWN_1 ECU_ADDRESS 0xd0004462 BIT_MASK 0x8 /end MEASUREMENT
/begin MEASUREMENT fmy_stat_obd2_lsh_down_1.err_info_stat.lv_ready "Readiness flag related to diagnosis XX" UWORD _CNV_S_2_RANGE__0___1_CM 1 100. 0. 1. DISPLAY_IDENTIFIER LV_READY_OBD2_LSH_DOWN_1 ECU_ADDRESS 0xd0004462 BIT_MASK 0x10 /end MEASUREMENT
/begin MEASUREMENT fmy_stat_obd2_lsh_down_1.err_info_stat.lv_end_diag "End of diagnosis XX" UWORD _CNV_S_2_RANGE__0___1_CM 1 100. 0. 1. DISPLAY_IDENTIFIER LV_END_DIAG_OBD2_LSH_DOWN_1 ECU_ADDRESS 0xd0004462 BIT_MASK 0x20 /end MEASUREMENT
/begin MEASUREMENT fmy_stat_obd2_lsh_down_1.err_info_stat.lv_cdn_diag "Diagnosis condition to start symptom detection (set to 1 when condition is fulfilled)" UWORD _CNV_S_2_RANGE__0___1_CM 1 100. 0. 1. DISPLAY_IDENTIFIER LV_CDN_DIAG_OBD2_LSH_DOWN_1 ECU_ADDRESS 0xd0004462 BIT_MASK 0x40 /end MEASUREMENT
/begin MEASUREMENT fmy_stat_obd2_lsh_down_1.err_info_stat.err_sym "For each symptom: status of failure (set to 1 when failure symptom is detected)" UWORD _CNV_S_16_RANGE_ERR__485_CM 1 100. 0. 15. DISPLAY_IDENTIFIER ERR_SYM_OBD2_LSH_DOWN_1 ECU_ADDRESS 0xd0004462 BIT_MASK 0x780 /end MEASUREMENT
/begin MEASUREMENT fmy_stat_obd2_lsh_down_2.ctr_abc "anti-bounce counter for diagnosis XX" UBYTE _CNV_A_R_LINEAR_____0_CM 1 100. 0. 255. DISPLAY_IDENTIFIER CTR_ABC_OBD2_LSH_DOWN_2 ECU_ADDRESS 0xd0004464 FORMAT "%3.0" /end MEASUREMENT
/begin MEASUREMENT fmy_stat_obd2_lsh_down_2.ctr_end_diag "Counter for the end of diagnosis XX generation" UBYTE _CNV_A_R_LINEAR_____0_CM 1 100. 0. 255. DISPLAY_IDENTIFIER CTR_ABC_END_DIAG_OBD2_LSH_DOWN_2 ECU_ADDRESS 0xd0004465 FORMAT "%3.0" /end MEASUREMENT
/begin MEASUREMENT fmy_stat_obd2_lsh_down_2.err_info_stat.lv_err_mem "Failure is stored in dynamic memory (2nd layer)" UWORD _CNV_S_2_RANGE__0___1_CM 1 100. 0. 1. DISPLAY_IDENTIFIER LV_ERR_MEM_OBD2_LSH_DOWN_2 ECU_ADDRESS 0xd0004466 BIT_MASK 0x8 /end MEASUREMENT
/begin MEASUREMENT fmy_stat_obd2_lsh_down_2.err_info_stat.lv_ready "Readiness flag related to diagnosis XX" UWORD _CNV_S_2_RANGE__0___1_CM 1 100. 0. 1. DISPLAY_IDENTIFIER LV_READY_OBD2_LSH_DOWN_2 ECU_ADDRESS 0xd0004466 BIT_MASK 0x10 /end MEASUREMENT
/begin MEASUREMENT fmy_stat_obd2_lsh_down_2.err_info_stat.lv_end_diag "End of diagnosis XX" UWORD _CNV_S_2_RANGE__0___1_CM 1 100. 0. 1. DISPLAY_IDENTIFIER LV_END_DIAG_OBD2_LSH_DOWN_2 ECU_ADDRESS 0xd0004466 BIT_MASK 0x20 /end MEASUREMENT
/begin MEASUREMENT fmy_stat_obd2_lsh_down_2.err_info_stat.lv_cdn_diag "Diagnosis condition to start symptom detection (set to 1 when condition is fulfilled)" UWORD _CNV_S_2_RANGE__0___1_CM 1 100. 0. 1. DISPLAY_IDENTIFIER LV_CDN_DIAG_OBD2_LSH_DOWN_2 ECU_ADDRESS 0xd0004466 BIT_MASK 0x40 /end MEASUREMENT
/begin MEASUREMENT fmy_stat_obd2_lsh_down_2.err_info_stat.err_sym "For each symptom: status of failure (set to 1 when failure symptom is detected)" UWORD _CNV_S_16_RANGE_ERR__485_CM 1 100. 0. 15. DISPLAY_IDENTIFIER ERR_SYM_OBD2_LSH_DOWN_2 ECU_ADDRESS 0xd0004466 BIT_MASK 0x780 /end MEASUREMENT
/begin MEASUREMENT fmy_stat_dmtls.ctr_abc "anti-bounce counter for diagnosis XX" UBYTE _CNV_A_R_LINEAR_____0_CM 1 100. 0. 255. DISPLAY_IDENTIFIER CTR_ABC_DMTLS ECU_ADDRESS 0xd00042bc FORMAT "%3.0" /end MEASUREMENT
/begin MEASUREMENT fmy_stat_dmtls.ctr_end_diag "Counter for the end of diagnosis XX generation" UBYTE _CNV_A_R_LINEAR_____0_CM 1 100. 0. 255. DISPLAY_IDENTIFIER CTR_ABC_END_DIAG_DMTLS ECU_ADDRESS 0xd00042bd FORMAT "%3.0" /end MEASUREMENT
/begin MEASUREMENT fmy_stat_dmtls.err_info_stat.lv_err_mem "Failure is stored in dynamic memory (2nd layer)" UWORD _CNV_S_2_RANGE__0___1_CM 1 100. 0. 1. DISPLAY_IDENTIFIER LV_ERR_MEM_DMTLS ECU_ADDRESS 0xd00042be BIT_MASK 0x8 /end MEASUREMENT
/begin MEASUREMENT fmy_stat_dmtls.err_info_stat.lv_ready "Readiness flag related to diagnosis XX" UWORD _CNV_S_2_RANGE__0___1_CM 1 100. 0. 1. DISPLAY_IDENTIFIER LV_READY_DMTLS ECU_ADDRESS 0xd00042be BIT_MASK 0x10 /end MEASUREMENT
/begin MEASUREMENT fmy_stat_dmtls.err_info_stat.lv_end_diag "End of diagnosis XX" UWORD _CNV_S_2_RANGE__0___1_CM 1 100. 0. 1. DISPLAY_IDENTIFIER LV_END_DIAG_DMTLS ECU_ADDRESS 0xd00042be BIT_MASK 0x20 /end MEASUREMENT
/begin MEASUREMENT fmy_stat_dmtls.err_info_stat.lv_cdn_diag "Diagnosis condition to start symptom detection (set to 1 when condition is fulfilled)" UWORD _CNV_S_2_RANGE__0___1_CM 1 100. 0. 1. DISPLAY_IDENTIFIER LV_CDN_DIAG_DMTLS ECU_ADDRESS 0xd00042be BIT_MASK 0x40 /end MEASUREMENT
/begin MEASUREMENT fmy_stat_dmtls.err_info_stat.err_sym "For each symptom: status of failure (set to 1 when failure symptom is detected)" UWORD _CNV_S_16_RANGE_ERR__485_CM 1 100. 0. 15. DISPLAY_IDENTIFIER ERR_SYM_DMTLS ECU_ADDRESS 0xd00042be BIT_MASK 0x780 /end MEASUREMENT
/begin MEASUREMENT fmy_stat_dmtl_pump.ctr_abc "anti-bounce counter for diagnosis XX" UBYTE _CNV_A_R_LINEAR_____0_CM 1 100. 0. 255. DISPLAY_IDENTIFIER CTR_ABC_DMTL_PUMP ECU_ADDRESS 0xd00042b0 FORMAT "%3.0" /end MEASUREMENT
/begin MEASUREMENT fmy_stat_dmtl_pump.ctr_end_diag "Counter for the end of diagnosis XX generation" UBYTE _CNV_A_R_LINEAR_____0_CM 1 100. 0. 255. DISPLAY_IDENTIFIER CTR_ABC_END_DIAG_DMTL_PUMP ECU_ADDRESS 0xd00042b1 FORMAT "%3.0" /end MEASUREMENT
/begin MEASUREMENT fmy_stat_dmtl_pump.err_info_stat.lv_err_mem "Failure is stored in dynamic memory (2nd layer)" UWORD _CNV_S_2_RANGE__0___1_CM 1 100. 0. 1. DISPLAY_IDENTIFIER LV_ERR_MEM_DMTL_PUMP ECU_ADDRESS 0xd00042b2 BIT_MASK 0x8 /end MEASUREMENT
/begin MEASUREMENT fmy_stat_dmtl_pump.err_info_stat.lv_ready "Readiness flag related to diagnosis XX" UWORD _CNV_S_2_RANGE__0___1_CM 1 100. 0. 1. DISPLAY_IDENTIFIER LV_READY_DMTL_PUMP ECU_ADDRESS 0xd00042b2 BIT_MASK 0x10 /end MEASUREMENT
/begin MEASUREMENT fmy_stat_dmtl_pump.err_info_stat.lv_end_diag "End of diagnosis XX" UWORD _CNV_S_2_RANGE__0___1_CM 1 100. 0. 1. DISPLAY_IDENTIFIER LV_END_DIAG_DMTL_PUMP ECU_ADDRESS 0xd00042b2 BIT_MASK 0x20 /end MEASUREMENT
/begin MEASUREMENT fmy_stat_dmtl_pump.err_info_stat.lv_cdn_diag "Diagnosis condition to start symptom detection (set to 1 when condition is fulfilled)" UWORD _CNV_S_2_RANGE__0___1_CM 1 100. 0. 1. DISPLAY_IDENTIFIER LV_CDN_DIAG_DMTL_PUMP ECU_ADDRESS 0xd00042b2 BIT_MASK 0x40 /end MEASUREMENT
/begin MEASUREMENT fmy_stat_dmtl_pump.err_info_stat.err_sym "For each symptom: status of failure (set to 1 when failure symptom is detected)" UWORD _CNV_S_16_RANGE_ERR__485_CM 1 100. 0. 15. DISPLAY_IDENTIFIER ERR_SYM_DMTL_PUMP ECU_ADDRESS 0xd00042b2 BIT_MASK 0x780 /end MEASUREMENT
/begin MEASUREMENT fmy_stat_dmtlm.ctr_abc "anti-bounce counter for diagnosis XX" UBYTE _CNV_A_R_LINEAR_____0_CM 1 100. 0. 255. DISPLAY_IDENTIFIER CTR_ABC_DMTLM ECU_ADDRESS 0xd00042b8 FORMAT "%3.0" /end MEASUREMENT
/begin MEASUREMENT fmy_stat_dmtlm.ctr_end_diag "Counter for the end of diagnosis XX generation" UBYTE _CNV_A_R_LINEAR_____0_CM 1 100. 0. 255. DISPLAY_IDENTIFIER CTR_ABC_END_DIAG_DMTLM ECU_ADDRESS 0xd00042b9 FORMAT "%3.0" /end MEASUREMENT
/begin MEASUREMENT fmy_stat_dmtlm.err_info_stat.lv_err_mem "Failure is stored in dynamic memory (2nd layer)" UWORD _CNV_S_2_RANGE__0___1_CM 1 100. 0. 1. DISPLAY_IDENTIFIER LV_ERR_MEM_DMTLM ECU_ADDRESS 0xd00042ba BIT_MASK 0x8 /end MEASUREMENT
/begin MEASUREMENT fmy_stat_dmtlm.err_info_stat.lv_ready "Readiness flag related to diagnosis XX" UWORD _CNV_S_2_RANGE__0___1_CM 1 100. 0. 1. DISPLAY_IDENTIFIER LV_READY_DMTLM ECU_ADDRESS 0xd00042ba BIT_MASK 0x10 /end MEASUREMENT
/begin MEASUREMENT fmy_stat_dmtlm.err_info_stat.lv_end_diag "End of diagnosis XX" UWORD _CNV_S_2_RANGE__0___1_CM 1 100. 0. 1. DISPLAY_IDENTIFIER LV_END_DIAG_DMTLM ECU_ADDRESS 0xd00042ba BIT_MASK 0x20 /end MEASUREMENT
/begin MEASUREMENT fmy_stat_dmtlm.err_info_stat.lv_cdn_diag "Diagnosis condition to start symptom detection (set to 1 when condition is fulfilled)" UWORD _CNV_S_2_RANGE__0___1_CM 1 100. 0. 1. DISPLAY_IDENTIFIER LV_CDN_DIAG_DMTLM ECU_ADDRESS 0xd00042ba BIT_MASK 0x40 /end MEASUREMENT
/begin MEASUREMENT fmy_stat_dmtlm.err_info_stat.err_sym "For each symptom: status of failure (set to 1 when failure symptom is detected)" UWORD _CNV_S_16_RANGE_ERR__485_CM 1 100. 0. 15. DISPLAY_IDENTIFIER ERR_SYM_DMTLM ECU_ADDRESS 0xd00042ba BIT_MASK 0x780 /end MEASUREMENT
/begin MEASUREMENT fmy_stat_rough_leak.ctr_abc "anti-bounce counter for diagnosis XX" UBYTE _CNV_A_R_LINEAR_____0_CM 1 100. 0. 255. DISPLAY_IDENTIFIER CTR_ABC_ROUGH_LEAK ECU_ADDRESS 0xd0004508 FORMAT "%3.0" /end MEASUREMENT
/begin MEASUREMENT fmy_stat_rough_leak.ctr_end_diag "Counter for the end of diagnosis XX generation" UBYTE _CNV_A_R_LINEAR_____0_CM 1 100. 0. 255. DISPLAY_IDENTIFIER CTR_ABC_END_DIAG_ROUGH_LEAK ECU_ADDRESS 0xd0004509 FORMAT "%3.0" /end MEASUREMENT
/begin MEASUREMENT fmy_stat_rough_leak.err_info_stat.lv_err_mem "Failure is stored in dynamic memory (2nd layer)" UWORD _CNV_S_2_RANGE__0___1_CM 1 100. 0. 1. DISPLAY_IDENTIFIER LV_ERR_MEM_ROUGH_LEAK ECU_ADDRESS 0xd000450a BIT_MASK 0x8 /end MEASUREMENT
/begin MEASUREMENT fmy_stat_rough_leak.err_info_stat.lv_ready "Readiness flag related to diagnosis XX" UWORD _CNV_S_2_RANGE__0___1_CM 1 100. 0. 1. DISPLAY_IDENTIFIER LV_READY_ROUGH_LEAK ECU_ADDRESS 0xd000450a BIT_MASK 0x10 /end MEASUREMENT
/begin MEASUREMENT fmy_stat_rough_leak.err_info_stat.lv_end_diag "End of diagnosis XX" UWORD _CNV_S_2_RANGE__0___1_CM 1 100. 0. 1. DISPLAY_IDENTIFIER LV_END_DIAG_ROUGH_LEAK ECU_ADDRESS 0xd000450a BIT_MASK 0x20 /end MEASUREMENT
/begin MEASUREMENT fmy_stat_rough_leak.err_info_stat.lv_cdn_diag "Diagnosis condition to start symptom detection (set to 1 when condition is fulfilled)" UWORD _CNV_S_2_RANGE__0___1_CM 1 100. 0. 1. DISPLAY_IDENTIFIER LV_CDN_DIAG_ROUGH_LEAK ECU_ADDRESS 0xd000450a BIT_MASK 0x40 /end MEASUREMENT
/begin MEASUREMENT fmy_stat_rough_leak.err_info_stat.err_sym "For each symptom: status of failure (set to 1 when failure symptom is detected)" UWORD _CNV_S_16_RANGE_ERR__485_CM 1 100. 0. 15. DISPLAY_IDENTIFIER ERR_SYM_ROUGH_LEAK ECU_ADDRESS 0xd000450a BIT_MASK 0x780 /end MEASUREMENT
/begin MEASUREMENT fmy_stat_small_leak.ctr_abc "anti-bounce counter for diagnosis XX" UBYTE _CNV_A_R_LINEAR_____0_CM 1 100. 0. 255. DISPLAY_IDENTIFIER CTR_ABC_SMALL_LEAK ECU_ADDRESS 0xd0004540 FORMAT "%3.0" /end MEASUREMENT
/begin MEASUREMENT fmy_stat_small_leak.ctr_end_diag "Counter for the end of diagnosis XX generation" UBYTE _CNV_A_R_LINEAR_____0_CM 1 100. 0. 255. DISPLAY_IDENTIFIER CTR_ABC_END_DIAG_SMALL_LEAK ECU_ADDRESS 0xd0004541 FORMAT "%3.0" /end MEASUREMENT
/begin MEASUREMENT fmy_stat_small_leak.err_info_stat.lv_err_mem "Failure is stored in dynamic memory (2nd layer)" UWORD _CNV_S_2_RANGE__0___1_CM 1 100. 0. 1. DISPLAY_IDENTIFIER LV_ERR_MEM_SMALL_LEAK ECU_ADDRESS 0xd0004542 BIT_MASK 0x8 /end MEASUREMENT
/begin MEASUREMENT fmy_stat_small_leak.err_info_stat.lv_ready "Readiness flag related to diagnosis XX" UWORD _CNV_S_2_RANGE__0___1_CM 1 100. 0. 1. DISPLAY_IDENTIFIER LV_READY_SMALL_LEAK ECU_ADDRESS 0xd0004542 BIT_MASK 0x10 /end MEASUREMENT
/begin MEASUREMENT fmy_stat_small_leak.err_info_stat.lv_end_diag "End of diagnosis XX" UWORD _CNV_S_2_RANGE__0___1_CM 1 100. 0. 1. DISPLAY_IDENTIFIER LV_END_DIAG_SMALL_LEAK ECU_ADDRESS 0xd0004542 BIT_MASK 0x20 /end MEASUREMENT
/begin MEASUREMENT fmy_stat_small_leak.err_info_stat.lv_cdn_diag "Diagnosis condition to start symptom detection (set to 1 when condition is fulfilled)" UWORD _CNV_S_2_RANGE__0___1_CM 1 100. 0. 1. DISPLAY_IDENTIFIER LV_CDN_DIAG_SMALL_LEAK ECU_ADDRESS 0xd0004542 BIT_MASK 0x40 /end MEASUREMENT
/begin MEASUREMENT fmy_stat_small_leak.err_info_stat.err_sym "For each symptom: status of failure (set to 1 when failure symptom is detected)" UWORD _CNV_S_16_RANGE_ERR__485_CM 1 100. 0. 15. DISPLAY_IDENTIFIER ERR_SYM_SMALL_LEAK ECU_ADDRESS 0xd0004542 BIT_MASK 0x780 /end MEASUREMENT
/begin MEASUREMENT fmy_stat_chk_fuc.ctr_abc "anti-bounce counter for diagnosis XX" UBYTE _CNV_A_R_LINEAR_____0_CM 1 100. 0. 255. DISPLAY_IDENTIFIER CTR_ABC_CHK_FUC ECU_ADDRESS 0xd000425c FORMAT "%3.0" /end MEASUREMENT
/begin MEASUREMENT fmy_stat_chk_fuc.ctr_end_diag "Counter for the end of diagnosis XX generation" UBYTE _CNV_A_R_LINEAR_____0_CM 1 100. 0. 255. DISPLAY_IDENTIFIER CTR_ABC_END_DIAG_CHK_FUC ECU_ADDRESS 0xd000425d FORMAT "%3.0" /end MEASUREMENT
/begin MEASUREMENT fmy_stat_chk_fuc.err_info_stat.lv_err_mem "Failure is stored in dynamic memory (2nd layer)" UWORD _CNV_S_2_RANGE__0___1_CM 1 100. 0. 1. DISPLAY_IDENTIFIER LV_ERR_MEM_CHK_FUC ECU_ADDRESS 0xd000425e BIT_MASK 0x8 /end MEASUREMENT
/begin MEASUREMENT fmy_stat_chk_fuc.err_info_stat.lv_ready "Readiness flag related to diagnosis XX" UWORD _CNV_S_2_RANGE__0___1_CM 1 100. 0. 1. DISPLAY_IDENTIFIER LV_READY_CHK_FUC ECU_ADDRESS 0xd000425e BIT_MASK 0x10 /end MEASUREMENT
/begin MEASUREMENT fmy_stat_chk_fuc.err_info_stat.lv_end_diag "End of diagnosis XX" UWORD _CNV_S_2_RANGE__0___1_CM 1 100. 0. 1. DISPLAY_IDENTIFIER LV_END_DIAG_CHK_FUC ECU_ADDRESS 0xd000425e BIT_MASK 0x20 /end MEASUREMENT
/begin MEASUREMENT fmy_stat_chk_fuc.err_info_stat.lv_cdn_diag "Diagnosis condition to start symptom detection (set to 1 when condition is fulfilled)" UWORD _CNV_S_2_RANGE__0___1_CM 1 100. 0. 1. DISPLAY_IDENTIFIER LV_CDN_DIAG_CHK_FUC ECU_ADDRESS 0xd000425e BIT_MASK 0x40 /end MEASUREMENT
/begin MEASUREMENT fmy_stat_chk_fuc.err_info_stat.err_sym "For each symptom: status of failure (set to 1 when failure symptom is detected)" UWORD _CNV_S_16_RANGE_ERR__485_CM 1 100. 0. 15. DISPLAY_IDENTIFIER ERR_SYM_CHK_FUC ECU_ADDRESS 0xd000425e BIT_MASK 0x780 /end MEASUREMENT
/begin MEASUREMENT fmy_stat_sof.ctr_abc "anti-bounce counter for diagnosis XX" UBYTE _CNV_A_R_LINEAR_____0_CM 1 100. 0. 255. DISPLAY_IDENTIFIER CTR_ABC_SOF ECU_ADDRESS 0xd0004544 FORMAT "%3.0" /end MEASUREMENT
/begin MEASUREMENT fmy_stat_sof.ctr_end_diag "Counter for the end of diagnosis XX generation" UBYTE _CNV_A_R_LINEAR_____0_CM 1 100. 0. 255. DISPLAY_IDENTIFIER CTR_ABC_END_DIAG_SOF ECU_ADDRESS 0xd0004545 FORMAT "%3.0" /end MEASUREMENT
/begin MEASUREMENT fmy_stat_sof.err_info_stat.lv_err_mem "Failure is stored in dynamic memory (2nd layer)" UWORD _CNV_S_2_RANGE__0___1_CM 1 100. 0. 1. DISPLAY_IDENTIFIER LV_ERR_MEM_SOF ECU_ADDRESS 0xd0004546 BIT_MASK 0x8 /end MEASUREMENT
/begin MEASUREMENT fmy_stat_sof.err_info_stat.lv_ready "Readiness flag related to diagnosis XX" UWORD _CNV_S_2_RANGE__0___1_CM 1 100. 0. 1. DISPLAY_IDENTIFIER LV_READY_SOF ECU_ADDRESS 0xd0004546 BIT_MASK 0x10 /end MEASUREMENT
/begin MEASUREMENT fmy_stat_sof.err_info_stat.lv_end_diag "End of diagnosis XX" UWORD _CNV_S_2_RANGE__0___1_CM 1 100. 0. 1. DISPLAY_IDENTIFIER LV_END_DIAG_SOF ECU_ADDRESS 0xd0004546 BIT_MASK 0x20 /end MEASUREMENT
/begin MEASUREMENT fmy_stat_sof.err_info_stat.lv_cdn_diag "Diagnosis condition to start symptom detection (set to 1 when condition is fulfilled)" UWORD _CNV_S_2_RANGE__0___1_CM 1 100. 0. 1. DISPLAY_IDENTIFIER LV_CDN_DIAG_SOF ECU_ADDRESS 0xd0004546 BIT_MASK 0x40 /end MEASUREMENT
/begin MEASUREMENT fmy_stat_sof.err_info_stat.err_sym "For each symptom: status of failure (set to 1 when failure symptom is detected)" UWORD _CNV_S_16_RANGE_ERR__485_CM 1 100. 0. 15. DISPLAY_IDENTIFIER ERR_SYM_SOF ECU_ADDRESS 0xd0004546 BIT_MASK 0x780 /end MEASUREMENT
/begin MEASUREMENT fmy_stat_sof_req.ctr_abc "anti-bounce counter for diagnosis XX" UBYTE _CNV_A_R_LINEAR_____0_CM 1 100. 0. 255. DISPLAY_IDENTIFIER CTR_ABC_SOF_REQ ECU_ADDRESS 0xd0004548 FORMAT "%3.0" /end MEASUREMENT
/begin MEASUREMENT fmy_stat_sof_req.ctr_end_diag "Counter for the end of diagnosis XX generation" UBYTE _CNV_A_R_LINEAR_____0_CM 1 100. 0. 255. DISPLAY_IDENTIFIER CTR_ABC_END_DIAG_SOF_REQ ECU_ADDRESS 0xd0004549 FORMAT "%3.0" /end MEASUREMENT
/begin MEASUREMENT fmy_stat_sof_req.err_info_stat.lv_err_mem "Failure is stored in dynamic memory (2nd layer)" UWORD _CNV_S_2_RANGE__0___1_CM 1 100. 0. 1. DISPLAY_IDENTIFIER LV_ERR_MEM_SOF_REQ ECU_ADDRESS 0xd000454a BIT_MASK 0x8 /end MEASUREMENT
/begin MEASUREMENT fmy_stat_sof_req.err_info_stat.lv_ready "Readiness flag related to diagnosis XX" UWORD _CNV_S_2_RANGE__0___1_CM 1 100. 0. 1. DISPLAY_IDENTIFIER LV_READY_SOF_REQ ECU_ADDRESS 0xd000454a BIT_MASK 0x10 /end MEASUREMENT
/begin MEASUREMENT fmy_stat_sof_req.err_info_stat.lv_end_diag "End of diagnosis XX" UWORD _CNV_S_2_RANGE__0___1_CM 1 100. 0. 1. DISPLAY_IDENTIFIER LV_END_DIAG_SOF_REQ ECU_ADDRESS 0xd000454a BIT_MASK 0x20 /end MEASUREMENT
/begin MEASUREMENT fmy_stat_sof_req.err_info_stat.lv_cdn_diag "Diagnosis condition to start symptom detection (set to 1 when condition is fulfilled)" UWORD _CNV_S_2_RANGE__0___1_CM 1 100. 0. 1. DISPLAY_IDENTIFIER LV_CDN_DIAG_SOF_REQ ECU_ADDRESS 0xd000454a BIT_MASK 0x40 /end MEASUREMENT
/begin MEASUREMENT fmy_stat_sof_req.err_info_stat.err_sym "For each symptom: status of failure (set to 1 when failure symptom is detected)" UWORD _CNV_S_16_RANGE_ERR__485_CM 1 100. 0. 15. DISPLAY_IDENTIFIER ERR_SYM_SOF_REQ ECU_ADDRESS 0xd000454a BIT_MASK 0x780 /end MEASUREMENT
/begin MEASUREMENT fmy_stat_rly_crcv_heat.ctr_abc "anti-bounce counter for diagnosis XX" UBYTE _CNV_A_R_LINEAR_____0_CM 1 100. 0. 255. DISPLAY_IDENTIFIER CTR_ABC_RLY_CRCV_HEAT ECU_ADDRESS 0xd00044f0 FORMAT "%3.0" /end MEASUREMENT
/begin MEASUREMENT fmy_stat_rly_crcv_heat.ctr_end_diag "Counter for the end of diagnosis XX generation" UBYTE _CNV_A_R_LINEAR_____0_CM 1 100. 0. 255. DISPLAY_IDENTIFIER CTR_ABC_END_DIAG_RLY_CRCV_HEAT ECU_ADDRESS 0xd00044f1 FORMAT "%3.0" /end MEASUREMENT
/begin MEASUREMENT fmy_stat_rly_crcv_heat.err_info_stat.lv_err_mem "Failure is stored in dynamic memory (2nd layer)" UWORD _CNV_S_2_RANGE__0___1_CM 1 100. 0. 1. DISPLAY_IDENTIFIER LV_ERR_MEM_RLY_CRCV_HEAT ECU_ADDRESS 0xd00044f2 BIT_MASK 0x8 /end MEASUREMENT
/begin MEASUREMENT fmy_stat_rly_crcv_heat.err_info_stat.lv_ready "Readiness flag related to diagnosis XX" UWORD _CNV_S_2_RANGE__0___1_CM 1 100. 0. 1. DISPLAY_IDENTIFIER LV_READY_RLY_CRCV_HEAT ECU_ADDRESS 0xd00044f2 BIT_MASK 0x10 /end MEASUREMENT
/begin MEASUREMENT fmy_stat_rly_crcv_heat.err_info_stat.lv_end_diag "End of diagnosis XX" UWORD _CNV_S_2_RANGE__0___1_CM 1 100. 0. 1. DISPLAY_IDENTIFIER LV_END_DIAG_RLY_CRCV_HEAT ECU_ADDRESS 0xd00044f2 BIT_MASK 0x20 /end MEASUREMENT
/begin MEASUREMENT fmy_stat_rly_crcv_heat.err_info_stat.lv_cdn_diag "Diagnosis condition to start symptom detection (set to 1 when condition is fulfilled)" UWORD _CNV_S_2_RANGE__0___1_CM 1 100. 0. 1. DISPLAY_IDENTIFIER LV_CDN_DIAG_RLY_CRCV_HEAT ECU_ADDRESS 0xd00044f2 BIT_MASK 0x40 /end MEASUREMENT
/begin MEASUREMENT fmy_stat_rly_crcv_heat.err_info_stat.err_sym "For each symptom: status of failure (set to 1 when failure symptom is detected)" UWORD _CNV_S_16_RANGE_ERR__485_CM 1 100. 0. 15. DISPLAY_IDENTIFIER ERR_SYM_RLY_CRCV_HEAT ECU_ADDRESS 0xd00044f2 BIT_MASK 0x780 /end MEASUREMENT
/begin MEASUREMENT fmy_stat_rly_st.ctr_abc "anti-bounce counter for diagnosis XX" UBYTE _CNV_A_R_LINEAR_____0_CM 1 100. 0. 255. DISPLAY_IDENTIFIER CTR_ABC_RLY_ST ECU_ADDRESS 0xd0004500 FORMAT "%3.0" /end MEASUREMENT
/begin MEASUREMENT fmy_stat_rly_st.ctr_end_diag "Counter for the end of diagnosis XX generation" UBYTE _CNV_A_R_LINEAR_____0_CM 1 100. 0. 255. DISPLAY_IDENTIFIER CTR_ABC_END_DIAG_RLY_ST ECU_ADDRESS 0xd0004501 FORMAT "%3.0" /end MEASUREMENT
/begin MEASUREMENT fmy_stat_rly_st.err_info_stat.lv_err_mem "Failure is stored in dynamic memory (2nd layer)" UWORD _CNV_S_2_RANGE__0___1_CM 1 100. 0. 1. DISPLAY_IDENTIFIER LV_ERR_MEM_RLY_ST ECU_ADDRESS 0xd0004502 BIT_MASK 0x8 /end MEASUREMENT
/begin MEASUREMENT fmy_stat_rly_st.err_info_stat.lv_ready "Readiness flag related to diagnosis XX" UWORD _CNV_S_2_RANGE__0___1_CM 1 100. 0. 1. DISPLAY_IDENTIFIER LV_READY_RLY_ST ECU_ADDRESS 0xd0004502 BIT_MASK 0x10 /end MEASUREMENT
/begin MEASUREMENT fmy_stat_rly_st.err_info_stat.lv_end_diag "End of diagnosis XX" UWORD _CNV_S_2_RANGE__0___1_CM 1 100. 0. 1. DISPLAY_IDENTIFIER LV_END_DIAG_RLY_ST ECU_ADDRESS 0xd0004502 BIT_MASK 0x20 /end MEASUREMENT
/begin MEASUREMENT fmy_stat_rly_st.err_info_stat.lv_cdn_diag "Diagnosis condition to start symptom detection (set to 1 when condition is fulfilled)" UWORD _CNV_S_2_RANGE__0___1_CM 1 100. 0. 1. DISPLAY_IDENTIFIER LV_CDN_DIAG_RLY_ST ECU_ADDRESS 0xd0004502 BIT_MASK 0x40 /end MEASUREMENT
/begin MEASUREMENT fmy_stat_rly_st.err_info_stat.err_sym "For each symptom: status of failure (set to 1 when failure symptom is detected)" UWORD _CNV_S_16_RANGE_ERR__485_CM 1 100. 0. 15. DISPLAY_IDENTIFIER ERR_SYM_RLY_ST ECU_ADDRESS 0xd0004502 BIT_MASK 0x780 /end MEASUREMENT
/begin MEASUREMENT fmy_stat_bsd.ctr_abc "anti-bounce counter for diagnosis XX" UBYTE _CNV_A_R_LINEAR_____0_CM 1 100. 0. 255. DISPLAY_IDENTIFIER CTR_ABC_BSD ECU_ADDRESS 0xd0004238 FORMAT "%3.0" /end MEASUREMENT
/begin MEASUREMENT fmy_stat_bsd.ctr_end_diag "Counter for the end of diagnosis XX generation" UBYTE _CNV_A_R_LINEAR_____0_CM 1 100. 0. 255. DISPLAY_IDENTIFIER CTR_ABC_END_DIAG_BSD ECU_ADDRESS 0xd0004239 FORMAT "%3.0" /end MEASUREMENT
/begin MEASUREMENT fmy_stat_bsd.err_info_stat.lv_err_mem "Failure is stored in dynamic memory (2nd layer)" UWORD _CNV_S_2_RANGE__0___1_CM 1 100. 0. 1. DISPLAY_IDENTIFIER LV_ERR_MEM_BSD ECU_ADDRESS 0xd000423a BIT_MASK 0x8 /end MEASUREMENT
/begin MEASUREMENT fmy_stat_bsd.err_info_stat.lv_ready "Readiness flag related to diagnosis XX" UWORD _CNV_S_2_RANGE__0___1_CM 1 100. 0. 1. DISPLAY_IDENTIFIER LV_READY_BSD ECU_ADDRESS 0xd000423a BIT_MASK 0x10 /end MEASUREMENT
/begin MEASUREMENT fmy_stat_bsd.err_info_stat.lv_end_diag "End of diagnosis XX" UWORD _CNV_S_2_RANGE__0___1_CM 1 100. 0. 1. DISPLAY_IDENTIFIER LV_END_DIAG_BSD ECU_ADDRESS 0xd000423a BIT_MASK 0x20 /end MEASUREMENT
/begin MEASUREMENT fmy_stat_bsd.err_info_stat.lv_cdn_diag "Diagnosis condition to start symptom detection (set to 1 when condition is fulfilled)" UWORD _CNV_S_2_RANGE__0___1_CM 1 100. 0. 1. DISPLAY_IDENTIFIER LV_CDN_DIAG_BSD ECU_ADDRESS 0xd000423a BIT_MASK 0x40 /end MEASUREMENT
/begin MEASUREMENT fmy_stat_bsd.err_info_stat.err_sym "For each symptom: status of failure (set to 1 when failure symptom is detected)" UWORD _CNV_S_16_RANGE_ERR__485_CM 1 100. 0. 15. DISPLAY_IDENTIFIER ERR_SYM_BSD ECU_ADDRESS 0xd000423a BIT_MASK 0x780 /end MEASUREMENT
/begin MEASUREMENT fmy_stat_poil_swi.ctr_abc "anti-bounce counter for diagnosis XX" UBYTE _CNV_A_R_LINEAR_____0_CM 1 100. 0. 255. DISPLAY_IDENTIFIER CTR_ABC_POIL_SWI ECU_ADDRESS 0xd00044a0 FORMAT "%3.0" /end MEASUREMENT
/begin MEASUREMENT fmy_stat_poil_swi.ctr_end_diag "Counter for the end of diagnosis XX generation" UBYTE _CNV_A_R_LINEAR_____0_CM 1 100. 0. 255. DISPLAY_IDENTIFIER CTR_ABC_END_DIAG_POIL_SWI ECU_ADDRESS 0xd00044a1 FORMAT "%3.0" /end MEASUREMENT
/begin MEASUREMENT fmy_stat_poil_swi.err_info_stat.lv_err_mem "Failure is stored in dynamic memory (2nd layer)" UWORD _CNV_S_2_RANGE__0___1_CM 1 100. 0. 1. DISPLAY_IDENTIFIER LV_ERR_MEM_POIL_SWI ECU_ADDRESS 0xd00044a2 BIT_MASK 0x8 /end MEASUREMENT
/begin MEASUREMENT fmy_stat_poil_swi.err_info_stat.lv_ready "Readiness flag related to diagnosis XX" UWORD _CNV_S_2_RANGE__0___1_CM 1 100. 0. 1. DISPLAY_IDENTIFIER LV_READY_POIL_SWI ECU_ADDRESS 0xd00044a2 BIT_MASK 0x10 /end MEASUREMENT
/begin MEASUREMENT fmy_stat_poil_swi.err_info_stat.lv_end_diag "End of diagnosis XX" UWORD _CNV_S_2_RANGE__0___1_CM 1 100. 0. 1. DISPLAY_IDENTIFIER LV_END_DIAG_POIL_SWI ECU_ADDRESS 0xd00044a2 BIT_MASK 0x20 /end MEASUREMENT
/begin MEASUREMENT fmy_stat_poil_swi.err_info_stat.lv_cdn_diag "Diagnosis condition to start symptom detection (set to 1 when condition is fulfilled)" UWORD _CNV_S_2_RANGE__0___1_CM 1 100. 0. 1. DISPLAY_IDENTIFIER LV_CDN_DIAG_POIL_SWI ECU_ADDRESS 0xd00044a2 BIT_MASK 0x40 /end MEASUREMENT
/begin MEASUREMENT fmy_stat_poil_swi.err_info_stat.err_sym "For each symptom: status of failure (set to 1 when failure symptom is detected)" UWORD _CNV_S_16_RANGE_ERR__485_CM 1 100. 0. 15. DISPLAY_IDENTIFIER ERR_SYM_POIL_SWI ECU_ADDRESS 0xd00044a2 BIT_MASK 0x780 /end MEASUREMENT
/begin MEASUREMENT fmy_stat_tout_efp_can.ctr_abc "anti-bounce counter for diagnosis XX" UBYTE _CNV_A_R_LINEAR_____0_CM 1 100. 0. 255. DISPLAY_IDENTIFIER CTR_ABC_TOUT_EFP_CAN ECU_ADDRESS 0xd00045c4 FORMAT "%3.0" /end MEASUREMENT
/begin MEASUREMENT fmy_stat_tout_efp_can.ctr_end_diag "Counter for the end of diagnosis XX generation" UBYTE _CNV_A_R_LINEAR_____0_CM 1 100. 0. 255. DISPLAY_IDENTIFIER CTR_ABC_END_DIAG_TOUT_EFP_CAN ECU_ADDRESS 0xd00045c5 FORMAT "%3.0" /end MEASUREMENT
/begin MEASUREMENT fmy_stat_tout_efp_can.err_info_stat.lv_err_mem "Failure is stored in dynamic memory (2nd layer)" UWORD _CNV_S_2_RANGE__0___1_CM 1 100. 0. 1. DISPLAY_IDENTIFIER LV_ERR_MEM_TOUT_EFP_CAN ECU_ADDRESS 0xd00045c6 BIT_MASK 0x8 /end MEASUREMENT
/begin MEASUREMENT fmy_stat_tout_efp_can.err_info_stat.lv_ready "Readiness flag related to diagnosis XX" UWORD _CNV_S_2_RANGE__0___1_CM 1 100. 0. 1. DISPLAY_IDENTIFIER LV_READY_TOUT_EFP_CAN ECU_ADDRESS 0xd00045c6 BIT_MASK 0x10 /end MEASUREMENT
/begin MEASUREMENT fmy_stat_tout_efp_can.err_info_stat.lv_end_diag "End of diagnosis XX" UWORD _CNV_S_2_RANGE__0___1_CM 1 100. 0. 1. DISPLAY_IDENTIFIER LV_END_DIAG_TOUT_EFP_CAN ECU_ADDRESS 0xd00045c6 BIT_MASK 0x20 /end MEASUREMENT
/begin MEASUREMENT fmy_stat_tout_efp_can.err_info_stat.lv_cdn_diag "Diagnosis condition to start symptom detection (set to 1 when condition is fulfilled)" UWORD _CNV_S_2_RANGE__0___1_CM 1 100. 0. 1. DISPLAY_IDENTIFIER LV_CDN_DIAG_TOUT_EFP_CAN ECU_ADDRESS 0xd00045c6 BIT_MASK 0x40 /end MEASUREMENT
/begin MEASUREMENT fmy_stat_tout_efp_can.err_info_stat.err_sym "For each symptom: status of failure (set to 1 when failure symptom is detected)" UWORD _CNV_S_16_RANGE_ERR__485_CM 1 100. 0. 15. DISPLAY_IDENTIFIER ERR_SYM_TOUT_EFP_CAN ECU_ADDRESS 0xd00045c6 BIT_MASK 0x780 /end MEASUREMENT
/begin MEASUREMENT fmy_stat_diagcps.ctr_abc "anti-bounce counter for diagnosis XX" UBYTE _CNV_A_R_LINEAR_____0_CM 1 100. 0. 255. DISPLAY_IDENTIFIER CTR_ABC_DIAGCPS ECU_ADDRESS 0xd00042ac FORMAT "%3.0" /end MEASUREMENT
/begin MEASUREMENT fmy_stat_diagcps.ctr_end_diag "Counter for the end of diagnosis XX generation" UBYTE _CNV_A_R_LINEAR_____0_CM 1 100. 0. 255. DISPLAY_IDENTIFIER CTR_ABC_END_DIAG_DIAGCPS ECU_ADDRESS 0xd00042ad FORMAT "%3.0" /end MEASUREMENT
/begin MEASUREMENT fmy_stat_diagcps.err_info_stat.lv_err_mem "Failure is stored in dynamic memory (2nd layer)" UWORD _CNV_S_2_RANGE__0___1_CM 1 100. 0. 1. DISPLAY_IDENTIFIER LV_ERR_MEM_DIAGCPS ECU_ADDRESS 0xd00042ae BIT_MASK 0x8 /end MEASUREMENT
/begin MEASUREMENT fmy_stat_diagcps.err_info_stat.lv_ready "Readiness flag related to diagnosis XX" UWORD _CNV_S_2_RANGE__0___1_CM 1 100. 0. 1. DISPLAY_IDENTIFIER LV_READY_DIAGCPS ECU_ADDRESS 0xd00042ae BIT_MASK 0x10 /end MEASUREMENT
/begin MEASUREMENT fmy_stat_diagcps.err_info_stat.lv_end_diag "End of diagnosis XX" UWORD _CNV_S_2_RANGE__0___1_CM 1 100. 0. 1. DISPLAY_IDENTIFIER LV_END_DIAG_DIAGCPS ECU_ADDRESS 0xd00042ae BIT_MASK 0x20 /end MEASUREMENT
/begin MEASUREMENT fmy_stat_diagcps.err_info_stat.lv_cdn_diag "Diagnosis condition to start symptom detection (set to 1 when condition is fulfilled)" UWORD _CNV_S_2_RANGE__0___1_CM 1 100. 0. 1. DISPLAY_IDENTIFIER LV_CDN_DIAG_DIAGCPS ECU_ADDRESS 0xd00042ae BIT_MASK 0x40 /end MEASUREMENT
/begin MEASUREMENT fmy_stat_diagcps.err_info_stat.err_sym "For each symptom: status of failure (set to 1 when failure symptom is detected)" UWORD _CNV_S_16_RANGE_ERR__485_CM 1 100. 0. 15. DISPLAY_IDENTIFIER ERR_SYM_DIAGCPS ECU_ADDRESS 0xd00042ae BIT_MASK 0x780 /end MEASUREMENT
/begin MEASUREMENT fmy_stat_dcc.ctr_abc "anti-bounce counter for diagnosis XX" UBYTE _CNV_A_R_LINEAR_____0_CM 1 100. 0. 255. DISPLAY_IDENTIFIER CTR_ABC_DCC ECU_ADDRESS 0xd00042a0 FORMAT "%3.0" /end MEASUREMENT
/begin MEASUREMENT fmy_stat_dcc.ctr_end_diag "Counter for the end of diagnosis XX generation" UBYTE _CNV_A_R_LINEAR_____0_CM 1 100. 0. 255. DISPLAY_IDENTIFIER CTR_ABC_END_DIAG_DCC ECU_ADDRESS 0xd00042a1 FORMAT "%3.0" /end MEASUREMENT
/begin MEASUREMENT fmy_stat_dcc.err_info_stat.lv_err_mem "Failure is stored in dynamic memory (2nd layer)" UWORD _CNV_S_2_RANGE__0___1_CM 1 100. 0. 1. DISPLAY_IDENTIFIER LV_ERR_MEM_DCC ECU_ADDRESS 0xd00042a2 BIT_MASK 0x8 /end MEASUREMENT
/begin MEASUREMENT fmy_stat_dcc.err_info_stat.lv_ready "Readiness flag related to diagnosis XX" UWORD _CNV_S_2_RANGE__0___1_CM 1 100. 0. 1. DISPLAY_IDENTIFIER LV_READY_DCC ECU_ADDRESS 0xd00042a2 BIT_MASK 0x10 /end MEASUREMENT
/begin MEASUREMENT fmy_stat_dcc.err_info_stat.lv_end_diag "End of diagnosis XX" UWORD _CNV_S_2_RANGE__0___1_CM 1 100. 0. 1. DISPLAY_IDENTIFIER LV_END_DIAG_DCC ECU_ADDRESS 0xd00042a2 BIT_MASK 0x20 /end MEASUREMENT
/begin MEASUREMENT fmy_stat_dcc.err_info_stat.lv_cdn_diag "Diagnosis condition to start symptom detection (set to 1 when condition is fulfilled)" UWORD _CNV_S_2_RANGE__0___1_CM 1 100. 0. 1. DISPLAY_IDENTIFIER LV_CDN_DIAG_DCC ECU_ADDRESS 0xd00042a2 BIT_MASK 0x40 /end MEASUREMENT
/begin MEASUREMENT fmy_stat_dcc.err_info_stat.err_sym "For each symptom: status of failure (set to 1 when failure symptom is detected)" UWORD _CNV_S_16_RANGE_ERR__485_CM 1 100. 0. 15. DISPLAY_IDENTIFIER ERR_SYM_DCC ECU_ADDRESS 0xd00042a2 BIT_MASK 0x780 /end MEASUREMENT
/begin MEASUREMENT fmy_stat_ldm.ctr_abc "anti-bounce counter for diagnosis XX" UBYTE _CNV_A_R_LINEAR_____0_CM 1 100. 0. 255. DISPLAY_IDENTIFIER CTR_ABC_LDM ECU_ADDRESS 0xd00043cc FORMAT "%3.0" /end MEASUREMENT
/begin MEASUREMENT fmy_stat_ldm.ctr_end_diag "Counter for the end of diagnosis XX generation" UBYTE _CNV_A_R_LINEAR_____0_CM 1 100. 0. 255. DISPLAY_IDENTIFIER CTR_ABC_END_DIAG_LDM ECU_ADDRESS 0xd00043cd FORMAT "%3.0" /end MEASUREMENT
/begin MEASUREMENT fmy_stat_ldm.err_info_stat.lv_err_mem "Failure is stored in dynamic memory (2nd layer)" UWORD _CNV_S_2_RANGE__0___1_CM 1 100. 0. 1. DISPLAY_IDENTIFIER LV_ERR_MEM_LDM ECU_ADDRESS 0xd00043ce BIT_MASK 0x8 /end MEASUREMENT
/begin MEASUREMENT fmy_stat_ldm.err_info_stat.lv_ready "Readiness flag related to diagnosis XX" UWORD _CNV_S_2_RANGE__0___1_CM 1 100. 0. 1. DISPLAY_IDENTIFIER LV_READY_LDM ECU_ADDRESS 0xd00043ce BIT_MASK 0x10 /end MEASUREMENT
/begin MEASUREMENT fmy_stat_ldm.err_info_stat.lv_end_diag "End of diagnosis XX" UWORD _CNV_S_2_RANGE__0___1_CM 1 100. 0. 1. DISPLAY_IDENTIFIER LV_END_DIAG_LDM ECU_ADDRESS 0xd00043ce BIT_MASK 0x20 /end MEASUREMENT
/begin MEASUREMENT fmy_stat_ldm.err_info_stat.lv_cdn_diag "Diagnosis condition to start symptom detection (set to 1 when condition is fulfilled)" UWORD _CNV_S_2_RANGE__0___1_CM 1 100. 0. 1. DISPLAY_IDENTIFIER LV_CDN_DIAG_LDM ECU_ADDRESS 0xd00043ce BIT_MASK 0x40 /end MEASUREMENT
/begin MEASUREMENT fmy_stat_ldm.err_info_stat.err_sym "For each symptom: status of failure (set to 1 when failure symptom is detected)" UWORD _CNV_S_16_RANGE_ERR__485_CM 1 100. 0. 15. DISPLAY_IDENTIFIER ERR_SYM_LDM ECU_ADDRESS 0xd00043ce BIT_MASK 0x780 /end MEASUREMENT
/begin MEASUREMENT fmy_stat_dmtlh.ctr_abc "anti-bounce counter for diagnosis XX" UBYTE _CNV_A_R_LINEAR_____0_CM 1 100. 0. 255. DISPLAY_IDENTIFIER CTR_ABC_DMTLH ECU_ADDRESS 0xd00042b4 FORMAT "%3.0" /end MEASUREMENT
/begin MEASUREMENT fmy_stat_dmtlh.ctr_end_diag "Counter for the end of diagnosis XX generation" UBYTE _CNV_A_R_LINEAR_____0_CM 1 100. 0. 255. DISPLAY_IDENTIFIER CTR_ABC_END_DIAG_DMTLH ECU_ADDRESS 0xd00042b5 FORMAT "%3.0" /end MEASUREMENT
/begin MEASUREMENT fmy_stat_dmtlh.err_info_stat.lv_err_mem "Failure is stored in dynamic memory (2nd layer)" UWORD _CNV_S_2_RANGE__0___1_CM 1 100. 0. 1. DISPLAY_IDENTIFIER LV_ERR_MEM_DMTLH ECU_ADDRESS 0xd00042b6 BIT_MASK 0x8 /end MEASUREMENT
/begin MEASUREMENT fmy_stat_dmtlh.err_info_stat.lv_ready "Readiness flag related to diagnosis XX" UWORD _CNV_S_2_RANGE__0___1_CM 1 100. 0. 1. DISPLAY_IDENTIFIER LV_READY_DMTLH ECU_ADDRESS 0xd00042b6 BIT_MASK 0x10 /end MEASUREMENT
/begin MEASUREMENT fmy_stat_dmtlh.err_info_stat.lv_end_diag "End of diagnosis XX" UWORD _CNV_S_2_RANGE__0___1_CM 1 100. 0. 1. DISPLAY_IDENTIFIER LV_END_DIAG_DMTLH ECU_ADDRESS 0xd00042b6 BIT_MASK 0x20 /end MEASUREMENT
/begin MEASUREMENT fmy_stat_dmtlh.err_info_stat.lv_cdn_diag "Diagnosis condition to start symptom detection (set to 1 when condition is fulfilled)" UWORD _CNV_S_2_RANGE__0___1_CM 1 100. 0. 1. DISPLAY_IDENTIFIER LV_CDN_DIAG_DMTLH ECU_ADDRESS 0xd00042b6 BIT_MASK 0x40 /end MEASUREMENT
/begin MEASUREMENT fmy_stat_dmtlh.err_info_stat.err_sym "For each symptom: status of failure (set to 1 when failure symptom is detected)" UWORD _CNV_S_16_RANGE_ERR__485_CM 1 100. 0. 15. DISPLAY_IDENTIFIER ERR_SYM_DMTLH ECU_ADDRESS 0xd00042b6 BIT_MASK 0x780 /end MEASUREMENT
/begin MEASUREMENT fmy_stat_cs.ctr_abc "anti-bounce counter for diagnosis XX" UBYTE _CNV_A_R_LINEAR_____0_CM 1 100. 0. 255. DISPLAY_IDENTIFIER CTR_ABC_CS ECU_ADDRESS 0xd0004284 FORMAT "%3.0" /end MEASUREMENT
/begin MEASUREMENT fmy_stat_cs.ctr_end_diag "Counter for the end of diagnosis XX generation" UBYTE _CNV_A_R_LINEAR_____0_CM 1 100. 0. 255. DISPLAY_IDENTIFIER CTR_ABC_END_DIAG_CS ECU_ADDRESS 0xd0004285 FORMAT "%3.0" /end MEASUREMENT
/begin MEASUREMENT fmy_stat_cs.err_info_stat.lv_err_mem "Failure is stored in dynamic memory (2nd layer)" UWORD _CNV_S_2_RANGE__0___1_CM 1 100. 0. 1. DISPLAY_IDENTIFIER LV_ERR_MEM_CS ECU_ADDRESS 0xd0004286 BIT_MASK 0x8 /end MEASUREMENT
/begin MEASUREMENT fmy_stat_cs.err_info_stat.lv_ready "Readiness flag related to diagnosis XX" UWORD _CNV_S_2_RANGE__0___1_CM 1 100. 0. 1. DISPLAY_IDENTIFIER LV_READY_CS ECU_ADDRESS 0xd0004286 BIT_MASK 0x10 /end MEASUREMENT
/begin MEASUREMENT fmy_stat_cs.err_info_stat.lv_end_diag "End of diagnosis XX" UWORD _CNV_S_2_RANGE__0___1_CM 1 100. 0. 1. DISPLAY_IDENTIFIER LV_END_DIAG_CS ECU_ADDRESS 0xd0004286 BIT_MASK 0x20 /end MEASUREMENT
/begin MEASUREMENT fmy_stat_cs.err_info_stat.lv_cdn_diag "Diagnosis condition to start symptom detection (set to 1 when condition is fulfilled)" UWORD _CNV_S_2_RANGE__0___1_CM 1 100. 0. 1. DISPLAY_IDENTIFIER LV_CDN_DIAG_CS ECU_ADDRESS 0xd0004286 BIT_MASK 0x40 /end MEASUREMENT
/begin MEASUREMENT fmy_stat_cs.err_info_stat.err_sym "For each symptom: status of failure (set to 1 when failure symptom is detected)" UWORD _CNV_S_16_RANGE_ERR__485_CM 1 100. 0. 15. DISPLAY_IDENTIFIER ERR_SYM_CS ECU_ADDRESS 0xd0004286 BIT_MASK 0x780 /end MEASUREMENT
/begin MEASUREMENT fmy_stat_spi_mps.ctr_abc "anti-bounce counter for diagnosis XX" UBYTE _CNV_A_R_LINEAR_____0_CM 1 100. 0. 255. DISPLAY_IDENTIFIER CTR_ABC_SPI_MPS ECU_ADDRESS 0xd0004550 FORMAT "%3.0" /end MEASUREMENT
/begin MEASUREMENT fmy_stat_spi_mps.ctr_end_diag "Counter for the end of diagnosis XX generation" UBYTE _CNV_A_R_LINEAR_____0_CM 1 100. 0. 255. DISPLAY_IDENTIFIER CTR_ABC_END_DIAG_SPI_MPS ECU_ADDRESS 0xd0004551 FORMAT "%3.0" /end MEASUREMENT
/begin MEASUREMENT fmy_stat_spi_mps.err_info_stat.lv_err_mem "Failure is stored in dynamic memory (2nd layer)" UWORD _CNV_S_2_RANGE__0___1_CM 1 100. 0. 1. DISPLAY_IDENTIFIER LV_ERR_MEM_SPI_MPS ECU_ADDRESS 0xd0004552 BIT_MASK 0x8 /end MEASUREMENT
/begin MEASUREMENT fmy_stat_spi_mps.err_info_stat.lv_ready "Readiness flag related to diagnosis XX" UWORD _CNV_S_2_RANGE__0___1_CM 1 100. 0. 1. DISPLAY_IDENTIFIER LV_READY_SPI_MPS ECU_ADDRESS 0xd0004552 BIT_MASK 0x10 /end MEASUREMENT
/begin MEASUREMENT fmy_stat_spi_mps.err_info_stat.lv_end_diag "End of diagnosis XX" UWORD _CNV_S_2_RANGE__0___1_CM 1 100. 0. 1. DISPLAY_IDENTIFIER LV_END_DIAG_SPI_MPS ECU_ADDRESS 0xd0004552 BIT_MASK 0x20 /end MEASUREMENT
/begin MEASUREMENT fmy_stat_spi_mps.err_info_stat.lv_cdn_diag "Diagnosis condition to start symptom detection (set to 1 when condition is fulfilled)" UWORD _CNV_S_2_RANGE__0___1_CM 1 100. 0. 1. DISPLAY_IDENTIFIER LV_CDN_DIAG_SPI_MPS ECU_ADDRESS 0xd0004552 BIT_MASK 0x40 /end MEASUREMENT
/begin MEASUREMENT fmy_stat_spi_mps.err_info_stat.err_sym "For each symptom: status of failure (set to 1 when failure symptom is detected)" UWORD _CNV_S_16_RANGE_ERR__485_CM 1 100. 0. 15. DISPLAY_IDENTIFIER ERR_SYM_SPI_MPS ECU_ADDRESS 0xd0004552 BIT_MASK 0x780 /end MEASUREMENT
/begin MEASUREMENT fmy_stat_spi_knk.ctr_abc "anti-bounce counter for diagnosis XX" UBYTE _CNV_A_R_LINEAR_____0_CM 1 100. 0. 255. DISPLAY_IDENTIFIER CTR_ABC_SPI_KNK ECU_ADDRESS 0xd000454c FORMAT "%3.0" /end MEASUREMENT
/begin MEASUREMENT fmy_stat_spi_knk.ctr_end_diag "Counter for the end of diagnosis XX generation" UBYTE _CNV_A_R_LINEAR_____0_CM 1 100. 0. 255. DISPLAY_IDENTIFIER CTR_ABC_END_DIAG_SPI_KNK ECU_ADDRESS 0xd000454d FORMAT "%3.0" /end MEASUREMENT
/begin MEASUREMENT fmy_stat_spi_knk.err_info_stat.lv_err_mem "Failure is stored in dynamic memory (2nd layer)" UWORD _CNV_S_2_RANGE__0___1_CM 1 100. 0. 1. DISPLAY_IDENTIFIER LV_ERR_MEM_SPI_KNK ECU_ADDRESS 0xd000454e BIT_MASK 0x8 /end MEASUREMENT
/begin MEASUREMENT fmy_stat_spi_knk.err_info_stat.lv_ready "Readiness flag related to diagnosis XX" UWORD _CNV_S_2_RANGE__0___1_CM 1 100. 0. 1. DISPLAY_IDENTIFIER LV_READY_SPI_KNK ECU_ADDRESS 0xd000454e BIT_MASK 0x10 /end MEASUREMENT
/begin MEASUREMENT fmy_stat_spi_knk.err_info_stat.lv_end_diag "End of diagnosis XX" UWORD _CNV_S_2_RANGE__0___1_CM 1 100. 0. 1. DISPLAY_IDENTIFIER LV_END_DIAG_SPI_KNK ECU_ADDRESS 0xd000454e BIT_MASK 0x20 /end MEASUREMENT
/begin MEASUREMENT fmy_stat_spi_knk.err_info_stat.lv_cdn_diag "Diagnosis condition to start symptom detection (set to 1 when condition is fulfilled)" UWORD _CNV_S_2_RANGE__0___1_CM 1 100. 0. 1. DISPLAY_IDENTIFIER LV_CDN_DIAG_SPI_KNK ECU_ADDRESS 0xd000454e BIT_MASK 0x40 /end MEASUREMENT
/begin MEASUREMENT fmy_stat_spi_knk.err_info_stat.err_sym "For each symptom: status of failure (set to 1 when failure symptom is detected)" UWORD _CNV_S_16_RANGE_ERR__485_CM 1 100. 0. 15. DISPLAY_IDENTIFIER ERR_SYM_SPI_KNK ECU_ADDRESS 0xd000454e BIT_MASK 0x780 /end MEASUREMENT
/begin MEASUREMENT fmy_stat_bn_tq_dcc.ctr_abc "anti-bounce counter for diagnosis XX" UBYTE _CNV_A_R_LINEAR_____0_CM 1 100. 0. 255. DISPLAY_IDENTIFIER CTR_ABC_BN_TQ_DCC ECU_ADDRESS 0xd000421c FORMAT "%3.0" /end MEASUREMENT
/begin MEASUREMENT fmy_stat_bn_tq_dcc.ctr_end_diag "Counter for the end of diagnosis XX generation" UBYTE _CNV_A_R_LINEAR_____0_CM 1 100. 0. 255. DISPLAY_IDENTIFIER CTR_ABC_END_DIAG_BN_TQ_DCC ECU_ADDRESS 0xd000421d FORMAT "%3.0" /end MEASUREMENT
/begin MEASUREMENT fmy_stat_bn_tq_dcc.err_info_stat.lv_err_mem "Failure is stored in dynamic memory (2nd layer)" UWORD _CNV_S_2_RANGE__0___1_CM 1 100. 0. 1. DISPLAY_IDENTIFIER LV_ERR_MEM_BN_TQ_DCC ECU_ADDRESS 0xd000421e BIT_MASK 0x8 /end MEASUREMENT
/begin MEASUREMENT fmy_stat_bn_tq_dcc.err_info_stat.lv_ready "Readiness flag related to diagnosis XX" UWORD _CNV_S_2_RANGE__0___1_CM 1 100. 0. 1. DISPLAY_IDENTIFIER LV_READY_BN_TQ_DCC ECU_ADDRESS 0xd000421e BIT_MASK 0x10 /end MEASUREMENT
/begin MEASUREMENT fmy_stat_bn_tq_dcc.err_info_stat.lv_end_diag "End of diagnosis XX" UWORD _CNV_S_2_RANGE__0___1_CM 1 100. 0. 1. DISPLAY_IDENTIFIER LV_END_DIAG_BN_TQ_DCC ECU_ADDRESS 0xd000421e BIT_MASK 0x20 /end MEASUREMENT
/begin MEASUREMENT fmy_stat_bn_tq_dcc.err_info_stat.lv_cdn_diag "Diagnosis condition to start symptom detection (set to 1 when condition is fulfilled)" UWORD _CNV_S_2_RANGE__0___1_CM 1 100. 0. 1. DISPLAY_IDENTIFIER LV_CDN_DIAG_BN_TQ_DCC ECU_ADDRESS 0xd000421e BIT_MASK 0x40 /end MEASUREMENT
/begin MEASUREMENT fmy_stat_bn_tq_dcc.err_info_stat.err_sym "For each symptom: status of failure (set to 1 when failure symptom is detected)" UWORD _CNV_S_16_RANGE_ERR__485_CM 1 100. 0. 15. DISPLAY_IDENTIFIER ERR_SYM_BN_TQ_DCC ECU_ADDRESS 0xd000421e BIT_MASK 0x780 /end MEASUREMENT
/begin MEASUREMENT fmy_stat_bn_tq_pste_2.ctr_abc "anti-bounce counter for diagnosis XX" UBYTE _CNV_A_R_LINEAR_____0_CM 1 100. 0. 255. DISPLAY_IDENTIFIER CTR_ABC_BN_TQ_PSTE_2 ECU_ADDRESS 0xd0004224 FORMAT "%3.0" /end MEASUREMENT
/begin MEASUREMENT fmy_stat_bn_tq_pste_2.ctr_end_diag "Counter for the end of diagnosis XX generation" UBYTE _CNV_A_R_LINEAR_____0_CM 1 100. 0. 255. DISPLAY_IDENTIFIER CTR_ABC_END_DIAG_BN_TQ_PSTE_2 ECU_ADDRESS 0xd0004225 FORMAT "%3.0" /end MEASUREMENT
/begin MEASUREMENT fmy_stat_bn_tq_pste_2.err_info_stat.lv_err_mem "Failure is stored in dynamic memory (2nd layer)" UWORD _CNV_S_2_RANGE__0___1_CM 1 100. 0. 1. DISPLAY_IDENTIFIER LV_ERR_MEM_BN_TQ_PSTE_2 ECU_ADDRESS 0xd0004226 BIT_MASK 0x8 /end MEASUREMENT
/begin MEASUREMENT fmy_stat_bn_tq_pste_2.err_info_stat.lv_ready "Readiness flag related to diagnosis XX" UWORD _CNV_S_2_RANGE__0___1_CM 1 100. 0. 1. DISPLAY_IDENTIFIER LV_READY_BN_TQ_PSTE_2 ECU_ADDRESS 0xd0004226 BIT_MASK 0x10 /end MEASUREMENT
/begin MEASUREMENT fmy_stat_bn_tq_pste_2.err_info_stat.lv_end_diag "End of diagnosis XX" UWORD _CNV_S_2_RANGE__0___1_CM 1 100. 0. 1. DISPLAY_IDENTIFIER LV_END_DIAG_BN_TQ_PSTE_2 ECU_ADDRESS 0xd0004226 BIT_MASK 0x20 /end MEASUREMENT
/begin MEASUREMENT fmy_stat_bn_tq_pste_2.err_info_stat.lv_cdn_diag "Diagnosis condition to start symptom detection (set to 1 when condition is fulfilled)" UWORD _CNV_S_2_RANGE__0___1_CM 1 100. 0. 1. DISPLAY_IDENTIFIER LV_CDN_DIAG_BN_TQ_PSTE_2 ECU_ADDRESS 0xd0004226 BIT_MASK 0x40 /end MEASUREMENT
/begin MEASUREMENT fmy_stat_bn_tq_pste_2.err_info_stat.err_sym "For each symptom: status of failure (set to 1 when failure symptom is detected)" UWORD _CNV_S_16_RANGE_ERR__485_CM 1 100. 0. 15. DISPLAY_IDENTIFIER ERR_SYM_BN_TQ_PSTE_2 ECU_ADDRESS 0xd0004226 BIT_MASK 0x780 /end MEASUREMENT
/begin MEASUREMENT fmy_stat_bn_ars.ctr_abc "anti-bounce counter for diagnosis XX" UBYTE _CNV_A_R_LINEAR_____0_CM 1 100. 0. 255. DISPLAY_IDENTIFIER CTR_ABC_BN_ARS ECU_ADDRESS 0xd00041cc FORMAT "%3.0" /end MEASUREMENT
/begin MEASUREMENT fmy_stat_bn_ars.ctr_end_diag "Counter for the end of diagnosis XX generation" UBYTE _CNV_A_R_LINEAR_____0_CM 1 100. 0. 255. DISPLAY_IDENTIFIER CTR_ABC_END_DIAG_BN_ARS ECU_ADDRESS 0xd00041cd FORMAT "%3.0" /end MEASUREMENT
/begin MEASUREMENT fmy_stat_bn_ars.err_info_stat.lv_err_mem "Failure is stored in dynamic memory (2nd layer)" UWORD _CNV_S_2_RANGE__0___1_CM 1 100. 0. 1. DISPLAY_IDENTIFIER LV_ERR_MEM_BN_ARS ECU_ADDRESS 0xd00041ce BIT_MASK 0x8 /end MEASUREMENT
/begin MEASUREMENT fmy_stat_bn_ars.err_info_stat.lv_ready "Readiness flag related to diagnosis XX" UWORD _CNV_S_2_RANGE__0___1_CM 1 100. 0. 1. DISPLAY_IDENTIFIER LV_READY_BN_ARS ECU_ADDRESS 0xd00041ce BIT_MASK 0x10 /end MEASUREMENT
/begin MEASUREMENT fmy_stat_bn_ars.err_info_stat.lv_end_diag "End of diagnosis XX" UWORD _CNV_S_2_RANGE__0___1_CM 1 100. 0. 1. DISPLAY_IDENTIFIER LV_END_DIAG_BN_ARS ECU_ADDRESS 0xd00041ce BIT_MASK 0x20 /end MEASUREMENT
/begin MEASUREMENT fmy_stat_bn_ars.err_info_stat.lv_cdn_diag "Diagnosis condition to start symptom detection (set to 1 when condition is fulfilled)" UWORD _CNV_S_2_RANGE__0___1_CM 1 100. 0. 1. DISPLAY_IDENTIFIER LV_CDN_DIAG_BN_ARS ECU_ADDRESS 0xd00041ce BIT_MASK 0x40 /end MEASUREMENT
/begin MEASUREMENT fmy_stat_bn_ars.err_info_stat.err_sym "For each symptom: status of failure (set to 1 when failure symptom is detected)" UWORD _CNV_S_16_RANGE_ERR__485_CM 1 100. 0. 15. DISPLAY_IDENTIFIER ERR_SYM_BN_ARS ECU_ADDRESS 0xd00041ce BIT_MASK 0x780 /end MEASUREMENT
/begin MEASUREMENT fmy_stat_bn_cas.ctr_abc "anti-bounce counter for diagnosis XX" UBYTE _CNV_A_R_LINEAR_____0_CM 1 100. 0. 255. DISPLAY_IDENTIFIER CTR_ABC_BN_CAS ECU_ADDRESS 0xd00041d0 FORMAT "%3.0" /end MEASUREMENT
/begin MEASUREMENT fmy_stat_bn_cas.ctr_end_diag "Counter for the end of diagnosis XX generation" UBYTE _CNV_A_R_LINEAR_____0_CM 1 100. 0. 255. DISPLAY_IDENTIFIER CTR_ABC_END_DIAG_BN_CAS ECU_ADDRESS 0xd00041d1 FORMAT "%3.0" /end MEASUREMENT
/begin MEASUREMENT fmy_stat_bn_cas.err_info_stat.lv_err_mem "Failure is stored in dynamic memory (2nd layer)" UWORD _CNV_S_2_RANGE__0___1_CM 1 100. 0. 1. DISPLAY_IDENTIFIER LV_ERR_MEM_BN_CAS ECU_ADDRESS 0xd00041d2 BIT_MASK 0x8 /end MEASUREMENT
/begin MEASUREMENT fmy_stat_bn_cas.err_info_stat.lv_ready "Readiness flag related to diagnosis XX" UWORD _CNV_S_2_RANGE__0___1_CM 1 100. 0. 1. DISPLAY_IDENTIFIER LV_READY_BN_CAS ECU_ADDRESS 0xd00041d2 BIT_MASK 0x10 /end MEASUREMENT
/begin MEASUREMENT fmy_stat_bn_cas.err_info_stat.lv_end_diag "End of diagnosis XX" UWORD _CNV_S_2_RANGE__0___1_CM 1 100. 0. 1. DISPLAY_IDENTIFIER LV_END_DIAG_BN_CAS ECU_ADDRESS 0xd00041d2 BIT_MASK 0x20 /end MEASUREMENT
/begin MEASUREMENT fmy_stat_bn_cas.err_info_stat.lv_cdn_diag "Diagnosis condition to start symptom detection (set to 1 when condition is fulfilled)" UWORD _CNV_S_2_RANGE__0___1_CM 1 100. 0. 1. DISPLAY_IDENTIFIER LV_CDN_DIAG_BN_CAS ECU_ADDRESS 0xd00041d2 BIT_MASK 0x40 /end MEASUREMENT
/begin MEASUREMENT fmy_stat_bn_cas.err_info_stat.err_sym "For each symptom: status of failure (set to 1 when failure symptom is detected)" UWORD _CNV_S_16_RANGE_ERR__485_CM 1 100. 0. 15. DISPLAY_IDENTIFIER ERR_SYM_BN_CAS ECU_ADDRESS 0xd00041d2 BIT_MASK 0x780 /end MEASUREMENT
/begin MEASUREMENT fmy_stat_bn_tq_tcs.ctr_abc "anti-bounce counter for diagnosis XX" UBYTE _CNV_A_R_LINEAR_____0_CM 1 100. 0. 255. DISPLAY_IDENTIFIER CTR_ABC_BN_TQ_TCS ECU_ADDRESS 0xd0004228 FORMAT "%3.0" /end MEASUREMENT
/begin MEASUREMENT fmy_stat_bn_tq_tcs.ctr_end_diag "Counter for the end of diagnosis XX generation" UBYTE _CNV_A_R_LINEAR_____0_CM 1 100. 0. 255. DISPLAY_IDENTIFIER CTR_ABC_END_DIAG_BN_TQ_TCS ECU_ADDRESS 0xd0004229 FORMAT "%3.0" /end MEASUREMENT
/begin MEASUREMENT fmy_stat_bn_tq_tcs.err_info_stat.lv_err_mem "Failure is stored in dynamic memory (2nd layer)" UWORD _CNV_S_2_RANGE__0___1_CM 1 100. 0. 1. DISPLAY_IDENTIFIER LV_ERR_MEM_BN_TQ_TCS ECU_ADDRESS 0xd000422a BIT_MASK 0x8 /end MEASUREMENT
/begin MEASUREMENT fmy_stat_bn_tq_tcs.err_info_stat.lv_ready "Readiness flag related to diagnosis XX" UWORD _CNV_S_2_RANGE__0___1_CM 1 100. 0. 1. DISPLAY_IDENTIFIER LV_READY_BN_TQ_TCS ECU_ADDRESS 0xd000422a BIT_MASK 0x10 /end MEASUREMENT
/begin MEASUREMENT fmy_stat_bn_tq_tcs.err_info_stat.lv_end_diag "End of diagnosis XX" UWORD _CNV_S_2_RANGE__0___1_CM 1 100. 0. 1. DISPLAY_IDENTIFIER LV_END_DIAG_BN_TQ_TCS ECU_ADDRESS 0xd000422a BIT_MASK 0x20 /end MEASUREMENT
/begin MEASUREMENT fmy_stat_bn_tq_tcs.err_info_stat.lv_cdn_diag "Diagnosis condition to start symptom detection (set to 1 when condition is fulfilled)" UWORD _CNV_S_2_RANGE__0___1_CM 1 100. 0. 1. DISPLAY_IDENTIFIER LV_CDN_DIAG_BN_TQ_TCS ECU_ADDRESS 0xd000422a BIT_MASK 0x40 /end MEASUREMENT
/begin MEASUREMENT fmy_stat_bn_tq_tcs.err_info_stat.err_sym "For each symptom: status of failure (set to 1 when failure symptom is detected)" UWORD _CNV_S_16_RANGE_ERR__485_CM 1 100. 0. 15. DISPLAY_IDENTIFIER ERR_SYM_BN_TQ_TCS ECU_ADDRESS 0xd000422a BIT_MASK 0x780 /end MEASUREMENT
/begin MEASUREMENT fmy_stat_bn_vs_tcs.ctr_abc "anti-bounce counter for diagnosis XX" UBYTE _CNV_A_R_LINEAR_____0_CM 1 100. 0. 255. DISPLAY_IDENTIFIER CTR_ABC_BN_VS_TCS ECU_ADDRESS 0xd0004234 FORMAT "%3.0" /end MEASUREMENT
/begin MEASUREMENT fmy_stat_bn_vs_tcs.ctr_end_diag "Counter for the end of diagnosis XX generation" UBYTE _CNV_A_R_LINEAR_____0_CM 1 100. 0. 255. DISPLAY_IDENTIFIER CTR_ABC_END_DIAG_BN_VS_TCS ECU_ADDRESS 0xd0004235 FORMAT "%3.0" /end MEASUREMENT
/begin MEASUREMENT fmy_stat_bn_vs_tcs.err_info_stat.lv_err_mem "Failure is stored in dynamic memory (2nd layer)" UWORD _CNV_S_2_RANGE__0___1_CM 1 100. 0. 1. DISPLAY_IDENTIFIER LV_ERR_MEM_BN_VS_TCS ECU_ADDRESS 0xd0004236 BIT_MASK 0x8 /end MEASUREMENT
/begin MEASUREMENT fmy_stat_bn_vs_tcs.err_info_stat.lv_ready "Readiness flag related to diagnosis XX" UWORD _CNV_S_2_RANGE__0___1_CM 1 100. 0. 1. DISPLAY_IDENTIFIER LV_READY_BN_VS_TCS ECU_ADDRESS 0xd0004236 BIT_MASK 0x10 /end MEASUREMENT
/begin MEASUREMENT fmy_stat_bn_vs_tcs.err_info_stat.lv_end_diag "End of diagnosis XX" UWORD _CNV_S_2_RANGE__0___1_CM 1 100. 0. 1. DISPLAY_IDENTIFIER LV_END_DIAG_BN_VS_TCS ECU_ADDRESS 0xd0004236 BIT_MASK 0x20 /end MEASUREMENT
/begin MEASUREMENT fmy_stat_bn_vs_tcs.err_info_stat.lv_cdn_diag "Diagnosis condition to start symptom detection (set to 1 when condition is fulfilled)" UWORD _CNV_S_2_RANGE__0___1_CM 1 100. 0. 1. DISPLAY_IDENTIFIER LV_CDN_DIAG_BN_VS_TCS ECU_ADDRESS 0xd0004236 BIT_MASK 0x40 /end MEASUREMENT
/begin MEASUREMENT fmy_stat_bn_vs_tcs.err_info_stat.err_sym "For each symptom: status of failure (set to 1 when failure symptom is detected)" UWORD _CNV_S_16_RANGE_ERR__485_CM 1 100. 0. 15. DISPLAY_IDENTIFIER ERR_SYM_BN_VS_TCS ECU_ADDRESS 0xd0004236 BIT_MASK 0x780 /end MEASUREMENT
/begin MEASUREMENT fmy_stat_bn_tcs.ctr_abc "anti-bounce counter for diagnosis XX" UBYTE _CNV_A_R_LINEAR_____0_CM 1 100. 0. 255. DISPLAY_IDENTIFIER CTR_ABC_BN_TCS ECU_ADDRESS 0xd0004214 FORMAT "%3.0" /end MEASUREMENT
/begin MEASUREMENT fmy_stat_bn_tcs.ctr_end_diag "Counter for the end of diagnosis XX generation" UBYTE _CNV_A_R_LINEAR_____0_CM 1 100. 0. 255. DISPLAY_IDENTIFIER CTR_ABC_END_DIAG_BN_TCS ECU_ADDRESS 0xd0004215 FORMAT "%3.0" /end MEASUREMENT
/begin MEASUREMENT fmy_stat_bn_tcs.err_info_stat.lv_err_mem "Failure is stored in dynamic memory (2nd layer)" UWORD _CNV_S_2_RANGE__0___1_CM 1 100. 0. 1. DISPLAY_IDENTIFIER LV_ERR_MEM_BN_TCS ECU_ADDRESS 0xd0004216 BIT_MASK 0x8 /end MEASUREMENT
/begin MEASUREMENT fmy_stat_bn_tcs.err_info_stat.lv_ready "Readiness flag related to diagnosis XX" UWORD _CNV_S_2_RANGE__0___1_CM 1 100. 0. 1. DISPLAY_IDENTIFIER LV_READY_BN_TCS ECU_ADDRESS 0xd0004216 BIT_MASK 0x10 /end MEASUREMENT
/begin MEASUREMENT fmy_stat_bn_tcs.err_info_stat.lv_end_diag "End of diagnosis XX" UWORD _CNV_S_2_RANGE__0___1_CM 1 100. 0. 1. DISPLAY_IDENTIFIER LV_END_DIAG_BN_TCS ECU_ADDRESS 0xd0004216 BIT_MASK 0x20 /end MEASUREMENT
/begin MEASUREMENT fmy_stat_bn_tcs.err_info_stat.lv_cdn_diag "Diagnosis condition to start symptom detection (set to 1 when condition is fulfilled)" UWORD _CNV_S_2_RANGE__0___1_CM 1 100. 0. 1. DISPLAY_IDENTIFIER LV_CDN_DIAG_BN_TCS ECU_ADDRESS 0xd0004216 BIT_MASK 0x40 /end MEASUREMENT
/begin MEASUREMENT fmy_stat_bn_tcs.err_info_stat.err_sym "For each symptom: status of failure (set to 1 when failure symptom is detected)" UWORD _CNV_S_16_RANGE_ERR__485_CM 1 100. 0. 15. DISPLAY_IDENTIFIER ERR_SYM_BN_TCS ECU_ADDRESS 0xd0004216 BIT_MASK 0x780 /end MEASUREMENT
/begin MEASUREMENT fmy_stat_bn_tq_etcu.ctr_abc "anti-bounce counter for diagnosis XX" UBYTE _CNV_A_R_LINEAR_____0_CM 1 100. 0. 255. DISPLAY_IDENTIFIER CTR_ABC_BN_TQ_ETCU ECU_ADDRESS 0xd0004220 FORMAT "%3.0" /end MEASUREMENT
/begin MEASUREMENT fmy_stat_bn_tq_etcu.ctr_end_diag "Counter for the end of diagnosis XX generation" UBYTE _CNV_A_R_LINEAR_____0_CM 1 100. 0. 255. DISPLAY_IDENTIFIER CTR_ABC_END_DIAG_BN_TQ_ETCU ECU_ADDRESS 0xd0004221 FORMAT "%3.0" /end MEASUREMENT
/begin MEASUREMENT fmy_stat_bn_tq_etcu.err_info_stat.lv_err_mem "Failure is stored in dynamic memory (2nd layer)" UWORD _CNV_S_2_RANGE__0___1_CM 1 100. 0. 1. DISPLAY_IDENTIFIER LV_ERR_MEM_BN_TQ_ETCU ECU_ADDRESS 0xd0004222 BIT_MASK 0x8 /end MEASUREMENT
/begin MEASUREMENT fmy_stat_bn_tq_etcu.err_info_stat.lv_ready "Readiness flag related to diagnosis XX" UWORD _CNV_S_2_RANGE__0___1_CM 1 100. 0. 1. DISPLAY_IDENTIFIER LV_READY_BN_TQ_ETCU ECU_ADDRESS 0xd0004222 BIT_MASK 0x10 /end MEASUREMENT
/begin MEASUREMENT fmy_stat_bn_tq_etcu.err_info_stat.lv_end_diag "End of diagnosis XX" UWORD _CNV_S_2_RANGE__0___1_CM 1 100. 0. 1. DISPLAY_IDENTIFIER LV_END_DIAG_BN_TQ_ETCU ECU_ADDRESS 0xd0004222 BIT_MASK 0x20 /end MEASUREMENT
/begin MEASUREMENT fmy_stat_bn_tq_etcu.err_info_stat.lv_cdn_diag "Diagnosis condition to start symptom detection (set to 1 when condition is fulfilled)" UWORD _CNV_S_2_RANGE__0___1_CM 1 100. 0. 1. DISPLAY_IDENTIFIER LV_CDN_DIAG_BN_TQ_ETCU ECU_ADDRESS 0xd0004222 BIT_MASK 0x40 /end MEASUREMENT
/begin MEASUREMENT fmy_stat_bn_tq_etcu.err_info_stat.err_sym "For each symptom: status of failure (set to 1 when failure symptom is detected)" UWORD _CNV_S_16_RANGE_ERR__485_CM 1 100. 0. 15. DISPLAY_IDENTIFIER ERR_SYM_BN_TQ_ETCU ECU_ADDRESS 0xd0004222 BIT_MASK 0x780 /end MEASUREMENT
/begin MEASUREMENT fmy_stat_bn_etcu.ctr_abc "anti-bounce counter for diagnosis XX" UBYTE _CNV_A_R_LINEAR_____0_CM 1 100. 0. 255. DISPLAY_IDENTIFIER CTR_ABC_BN_ETCU ECU_ADDRESS 0xd00041dc FORMAT "%3.0" /end MEASUREMENT
/begin MEASUREMENT fmy_stat_bn_etcu.ctr_end_diag "Counter for the end of diagnosis XX generation" UBYTE _CNV_A_R_LINEAR_____0_CM 1 100. 0. 255. DISPLAY_IDENTIFIER CTR_ABC_END_DIAG_BN_ETCU ECU_ADDRESS 0xd00041dd FORMAT "%3.0" /end MEASUREMENT
/begin MEASUREMENT fmy_stat_bn_etcu.err_info_stat.lv_err_mem "Failure is stored in dynamic memory (2nd layer)" UWORD _CNV_S_2_RANGE__0___1_CM 1 100. 0. 1. DISPLAY_IDENTIFIER LV_ERR_MEM_BN_ETCU ECU_ADDRESS 0xd00041de BIT_MASK 0x8 /end MEASUREMENT
/begin MEASUREMENT fmy_stat_bn_etcu.err_info_stat.lv_ready "Readiness flag related to diagnosis XX" UWORD _CNV_S_2_RANGE__0___1_CM 1 100. 0. 1. DISPLAY_IDENTIFIER LV_READY_BN_ETCU ECU_ADDRESS 0xd00041de BIT_MASK 0x10 /end MEASUREMENT
/begin MEASUREMENT fmy_stat_bn_etcu.err_info_stat.lv_end_diag "End of diagnosis XX" UWORD _CNV_S_2_RANGE__0___1_CM 1 100. 0. 1. DISPLAY_IDENTIFIER LV_END_DIAG_BN_ETCU ECU_ADDRESS 0xd00041de BIT_MASK 0x20 /end MEASUREMENT
/begin MEASUREMENT fmy_stat_bn_etcu.err_info_stat.lv_cdn_diag "Diagnosis condition to start symptom detection (set to 1 when condition is fulfilled)" UWORD _CNV_S_2_RANGE__0___1_CM 1 100. 0. 1. DISPLAY_IDENTIFIER LV_CDN_DIAG_BN_ETCU ECU_ADDRESS 0xd00041de BIT_MASK 0x40 /end MEASUREMENT
/begin MEASUREMENT fmy_stat_bn_etcu.err_info_stat.err_sym "For each symptom: status of failure (set to 1 when failure symptom is detected)" UWORD _CNV_S_16_RANGE_ERR__485_CM 1 100. 0. 15. DISPLAY_IDENTIFIER ERR_SYM_BN_ETCU ECU_ADDRESS 0xd00041de BIT_MASK 0x780 /end MEASUREMENT
/begin MEASUREMENT fmy_stat_bn_etcu_2.ctr_abc "anti-bounce counter for diagnosis XX" UBYTE _CNV_A_R_LINEAR_____0_CM 1 100. 0. 255. DISPLAY_IDENTIFIER CTR_ABC_BN_ETCU_2 ECU_ADDRESS 0xd00041e0 FORMAT "%3.0" /end MEASUREMENT
/begin MEASUREMENT fmy_stat_bn_etcu_2.ctr_end_diag "Counter for the end of diagnosis XX generation" UBYTE _CNV_A_R_LINEAR_____0_CM 1 100. 0. 255. DISPLAY_IDENTIFIER CTR_ABC_END_DIAG_BN_ETCU_2 ECU_ADDRESS 0xd00041e1 FORMAT "%3.0" /end MEASUREMENT
/begin MEASUREMENT fmy_stat_bn_etcu_2.err_info_stat.lv_err_mem "Failure is stored in dynamic memory (2nd layer)" UWORD _CNV_S_2_RANGE__0___1_CM 1 100. 0. 1. DISPLAY_IDENTIFIER LV_ERR_MEM_BN_ETCU_2 ECU_ADDRESS 0xd00041e2 BIT_MASK 0x8 /end MEASUREMENT
/begin MEASUREMENT fmy_stat_bn_etcu_2.err_info_stat.lv_ready "Readiness flag related to diagnosis XX" UWORD _CNV_S_2_RANGE__0___1_CM 1 100. 0. 1. DISPLAY_IDENTIFIER LV_READY_BN_ETCU_2 ECU_ADDRESS 0xd00041e2 BIT_MASK 0x10 /end MEASUREMENT
/begin MEASUREMENT fmy_stat_bn_etcu_2.err_info_stat.lv_end_diag "End of diagnosis XX" UWORD _CNV_S_2_RANGE__0___1_CM 1 100. 0. 1. DISPLAY_IDENTIFIER LV_END_DIAG_BN_ETCU_2 ECU_ADDRESS 0xd00041e2 BIT_MASK 0x20 /end MEASUREMENT
/begin MEASUREMENT fmy_stat_bn_etcu_2.err_info_stat.lv_cdn_diag "Diagnosis condition to start symptom detection (set to 1 when condition is fulfilled)" UWORD _CNV_S_2_RANGE__0___1_CM 1 100. 0. 1. DISPLAY_IDENTIFIER LV_CDN_DIAG_BN_ETCU_2 ECU_ADDRESS 0xd00041e2 BIT_MASK 0x40 /end MEASUREMENT
/begin MEASUREMENT fmy_stat_bn_etcu_2.err_info_stat.err_sym "For each symptom: status of failure (set to 1 when failure symptom is detected)" UWORD _CNV_S_16_RANGE_ERR__485_CM 1 100. 0. 15. DISPLAY_IDENTIFIER ERR_SYM_BN_ETCU_2 ECU_ADDRESS 0xd00041e2 BIT_MASK 0x780 /end MEASUREMENT
/begin MEASUREMENT fmy_stat_bn_etcu_disp.ctr_abc "anti-bounce counter for diagnosis XX" UBYTE _CNV_A_R_LINEAR_____0_CM 1 100. 0. 255. DISPLAY_IDENTIFIER CTR_ABC_BN_ETCU_DISP ECU_ADDRESS 0xd00041e4 FORMAT "%3.0" /end MEASUREMENT
/begin MEASUREMENT fmy_stat_bn_etcu_disp.ctr_end_diag "Counter for the end of diagnosis XX generation" UBYTE _CNV_A_R_LINEAR_____0_CM 1 100. 0. 255. DISPLAY_IDENTIFIER CTR_ABC_END_DIAG_BN_ETCU_DISP ECU_ADDRESS 0xd00041e5 FORMAT "%3.0" /end MEASUREMENT
/begin MEASUREMENT fmy_stat_bn_etcu_disp.err_info_stat.lv_err_mem "Failure is stored in dynamic memory (2nd layer)" UWORD _CNV_S_2_RANGE__0___1_CM 1 100. 0. 1. DISPLAY_IDENTIFIER LV_ERR_MEM_BN_ETCU_DISP ECU_ADDRESS 0xd00041e6 BIT_MASK 0x8 /end MEASUREMENT
/begin MEASUREMENT fmy_stat_bn_etcu_disp.err_info_stat.lv_ready "Readiness flag related to diagnosis XX" UWORD _CNV_S_2_RANGE__0___1_CM 1 100. 0. 1. DISPLAY_IDENTIFIER LV_READY_BN_ETCU_DISP ECU_ADDRESS 0xd00041e6 BIT_MASK 0x10 /end MEASUREMENT
/begin MEASUREMENT fmy_stat_bn_etcu_disp.err_info_stat.lv_end_diag "End of diagnosis XX" UWORD _CNV_S_2_RANGE__0___1_CM 1 100. 0. 1. DISPLAY_IDENTIFIER LV_END_DIAG_BN_ETCU_DISP ECU_ADDRESS 0xd00041e6 BIT_MASK 0x20 /end MEASUREMENT
/begin MEASUREMENT fmy_stat_bn_etcu_disp.err_info_stat.lv_cdn_diag "Diagnosis condition to start symptom detection (set to 1 when condition is fulfilled)" UWORD _CNV_S_2_RANGE__0___1_CM 1 100. 0. 1. DISPLAY_IDENTIFIER LV_CDN_DIAG_BN_ETCU_DISP ECU_ADDRESS 0xd00041e6 BIT_MASK 0x40 /end MEASUREMENT
/begin MEASUREMENT fmy_stat_bn_etcu_disp.err_info_stat.err_sym "For each symptom: status of failure (set to 1 when failure symptom is detected)" UWORD _CNV_S_16_RANGE_ERR__485_CM 1 100. 0. 15. DISPLAY_IDENTIFIER ERR_SYM_BN_ETCU_DISP ECU_ADDRESS 0xd00041e6 BIT_MASK 0x780 /end MEASUREMENT
/begin MEASUREMENT fmy_stat_bn_tq_amt.ctr_abc "anti-bounce counter for diagnosis XX" UBYTE _CNV_A_R_LINEAR_____0_CM 1 100. 0. 255. DISPLAY_IDENTIFIER CTR_ABC_BN_TQ_AMT ECU_ADDRESS 0xd0004218 FORMAT "%3.0" /end MEASUREMENT
/begin MEASUREMENT fmy_stat_bn_tq_amt.ctr_end_diag "Counter for the end of diagnosis XX generation" UBYTE _CNV_A_R_LINEAR_____0_CM 1 100. 0. 255. DISPLAY_IDENTIFIER CTR_ABC_END_DIAG_BN_TQ_AMT ECU_ADDRESS 0xd0004219 FORMAT "%3.0" /end MEASUREMENT
/begin MEASUREMENT fmy_stat_bn_tq_amt.err_info_stat.lv_err_mem "Failure is stored in dynamic memory (2nd layer)" UWORD _CNV_S_2_RANGE__0___1_CM 1 100. 0. 1. DISPLAY_IDENTIFIER LV_ERR_MEM_BN_TQ_AMT ECU_ADDRESS 0xd000421a BIT_MASK 0x8 /end MEASUREMENT
/begin MEASUREMENT fmy_stat_bn_tq_amt.err_info_stat.lv_ready "Readiness flag related to diagnosis XX" UWORD _CNV_S_2_RANGE__0___1_CM 1 100. 0. 1. DISPLAY_IDENTIFIER LV_READY_BN_TQ_AMT ECU_ADDRESS 0xd000421a BIT_MASK 0x10 /end MEASUREMENT
/begin MEASUREMENT fmy_stat_bn_tq_amt.err_info_stat.lv_end_diag "End of diagnosis XX" UWORD _CNV_S_2_RANGE__0___1_CM 1 100. 0. 1. DISPLAY_IDENTIFIER LV_END_DIAG_BN_TQ_AMT ECU_ADDRESS 0xd000421a BIT_MASK 0x20 /end MEASUREMENT
/begin MEASUREMENT fmy_stat_bn_tq_amt.err_info_stat.lv_cdn_diag "Diagnosis condition to start symptom detection (set to 1 when condition is fulfilled)" UWORD _CNV_S_2_RANGE__0___1_CM 1 100. 0. 1. DISPLAY_IDENTIFIER LV_CDN_DIAG_BN_TQ_AMT ECU_ADDRESS 0xd000421a BIT_MASK 0x40 /end MEASUREMENT
/begin MEASUREMENT fmy_stat_bn_tq_amt.err_info_stat.err_sym "For each symptom: status of failure (set to 1 when failure symptom is detected)" UWORD _CNV_S_16_RANGE_ERR__485_CM 1 100. 0. 15. DISPLAY_IDENTIFIER ERR_SYM_BN_TQ_AMT ECU_ADDRESS 0xd000421a BIT_MASK 0x780 /end MEASUREMENT
/begin MEASUREMENT fmy_stat_bn_acc.ctr_abc "anti-bounce counter for diagnosis XX" UBYTE _CNV_A_R_LINEAR_____0_CM 1 100. 0. 255. DISPLAY_IDENTIFIER CTR_ABC_BN_ACC ECU_ADDRESS 0xd00041c4 FORMAT "%3.0" /end MEASUREMENT
/begin MEASUREMENT fmy_stat_bn_acc.ctr_end_diag "Counter for the end of diagnosis XX generation" UBYTE _CNV_A_R_LINEAR_____0_CM 1 100. 0. 255. DISPLAY_IDENTIFIER CTR_ABC_END_DIAG_BN_ACC ECU_ADDRESS 0xd00041c5 FORMAT "%3.0" /end MEASUREMENT
/begin MEASUREMENT fmy_stat_bn_acc.err_info_stat.lv_err_mem "Failure is stored in dynamic memory (2nd layer)" UWORD _CNV_S_2_RANGE__0___1_CM 1 100. 0. 1. DISPLAY_IDENTIFIER LV_ERR_MEM_BN_ACC ECU_ADDRESS 0xd00041c6 BIT_MASK 0x8 /end MEASUREMENT
/begin MEASUREMENT fmy_stat_bn_acc.err_info_stat.lv_ready "Readiness flag related to diagnosis XX" UWORD _CNV_S_2_RANGE__0___1_CM 1 100. 0. 1. DISPLAY_IDENTIFIER LV_READY_BN_ACC ECU_ADDRESS 0xd00041c6 BIT_MASK 0x10 /end MEASUREMENT
/begin MEASUREMENT fmy_stat_bn_acc.err_info_stat.lv_end_diag "End of diagnosis XX" UWORD _CNV_S_2_RANGE__0___1_CM 1 100. 0. 1. DISPLAY_IDENTIFIER LV_END_DIAG_BN_ACC ECU_ADDRESS 0xd00041c6 BIT_MASK 0x20 /end MEASUREMENT
/begin MEASUREMENT fmy_stat_bn_acc.err_info_stat.lv_cdn_diag "Diagnosis condition to start symptom detection (set to 1 when condition is fulfilled)" UWORD _CNV_S_2_RANGE__0___1_CM 1 100. 0. 1. DISPLAY_IDENTIFIER LV_CDN_DIAG_BN_ACC ECU_ADDRESS 0xd00041c6 BIT_MASK 0x40 /end MEASUREMENT
/begin MEASUREMENT fmy_stat_bn_acc.err_info_stat.err_sym "For each symptom: status of failure (set to 1 when failure symptom is detected)" UWORD _CNV_S_16_RANGE_ERR__485_CM 1 100. 0. 15. DISPLAY_IDENTIFIER ERR_SYM_BN_ACC ECU_ADDRESS 0xd00041c6 BIT_MASK 0x780 /end MEASUREMENT
/begin MEASUREMENT fmy_stat_bn_t_icl.ctr_abc "anti-bounce counter for diagnosis XX" UBYTE _CNV_A_R_LINEAR_____0_CM 1 100. 0. 255. DISPLAY_IDENTIFIER CTR_ABC_BN_T_ICL ECU_ADDRESS 0xd0004210 FORMAT "%3.0" /end MEASUREMENT
/begin MEASUREMENT fmy_stat_bn_t_icl.ctr_end_diag "Counter for the end of diagnosis XX generation" UBYTE _CNV_A_R_LINEAR_____0_CM 1 100. 0. 255. DISPLAY_IDENTIFIER CTR_ABC_END_DIAG_BN_T_ICL ECU_ADDRESS 0xd0004211 FORMAT "%3.0" /end MEASUREMENT
/begin MEASUREMENT fmy_stat_bn_t_icl.err_info_stat.lv_err_mem "Failure is stored in dynamic memory (2nd layer)" UWORD _CNV_S_2_RANGE__0___1_CM 1 100. 0. 1. DISPLAY_IDENTIFIER LV_ERR_MEM_BN_T_ICL ECU_ADDRESS 0xd0004212 BIT_MASK 0x8 /end MEASUREMENT
/begin MEASUREMENT fmy_stat_bn_t_icl.err_info_stat.lv_ready "Readiness flag related to diagnosis XX" UWORD _CNV_S_2_RANGE__0___1_CM 1 100. 0. 1. DISPLAY_IDENTIFIER LV_READY_BN_T_ICL ECU_ADDRESS 0xd0004212 BIT_MASK 0x10 /end MEASUREMENT
/begin MEASUREMENT fmy_stat_bn_t_icl.err_info_stat.lv_end_diag "End of diagnosis XX" UWORD _CNV_S_2_RANGE__0___1_CM 1 100. 0. 1. DISPLAY_IDENTIFIER LV_END_DIAG_BN_T_ICL ECU_ADDRESS 0xd0004212 BIT_MASK 0x20 /end MEASUREMENT
/begin MEASUREMENT fmy_stat_bn_t_icl.err_info_stat.lv_cdn_diag "Diagnosis condition to start symptom detection (set to 1 when condition is fulfilled)" UWORD _CNV_S_2_RANGE__0___1_CM 1 100. 0. 1. DISPLAY_IDENTIFIER LV_CDN_DIAG_BN_T_ICL ECU_ADDRESS 0xd0004212 BIT_MASK 0x40 /end MEASUREMENT
/begin MEASUREMENT fmy_stat_bn_t_icl.err_info_stat.err_sym "For each symptom: status of failure (set to 1 when failure symptom is detected)" UWORD _CNV_S_16_RANGE_ERR__485_CM 1 100. 0. 15. DISPLAY_IDENTIFIER ERR_SYM_BN_T_ICL ECU_ADDRESS 0xd0004212 BIT_MASK 0x780 /end MEASUREMENT
/begin MEASUREMENT fmy_stat_bn_veh_mod.ctr_abc "anti-bounce counter for diagnosis XX" UBYTE _CNV_A_R_LINEAR_____0_CM 1 100. 0. 255. DISPLAY_IDENTIFIER CTR_ABC_BN_VEH_MOD ECU_ADDRESS 0xd0004230 FORMAT "%3.0" /end MEASUREMENT
/begin MEASUREMENT fmy_stat_bn_veh_mod.ctr_end_diag "Counter for the end of diagnosis XX generation" UBYTE _CNV_A_R_LINEAR_____0_CM 1 100. 0. 255. DISPLAY_IDENTIFIER CTR_ABC_END_DIAG_BN_VEH_MOD ECU_ADDRESS 0xd0004231 FORMAT "%3.0" /end MEASUREMENT
/begin MEASUREMENT fmy_stat_bn_veh_mod.err_info_stat.lv_err_mem "Failure is stored in dynamic memory (2nd layer)" UWORD _CNV_S_2_RANGE__0___1_CM 1 100. 0. 1. DISPLAY_IDENTIFIER LV_ERR_MEM_BN_VEH_MOD ECU_ADDRESS 0xd0004232 BIT_MASK 0x8 /end MEASUREMENT
/begin MEASUREMENT fmy_stat_bn_veh_mod.err_info_stat.lv_ready "Readiness flag related to diagnosis XX" UWORD _CNV_S_2_RANGE__0___1_CM 1 100. 0. 1. DISPLAY_IDENTIFIER LV_READY_BN_VEH_MOD ECU_ADDRESS 0xd0004232 BIT_MASK 0x10 /end MEASUREMENT
/begin MEASUREMENT fmy_stat_bn_veh_mod.err_info_stat.lv_end_diag "End of diagnosis XX" UWORD _CNV_S_2_RANGE__0___1_CM 1 100. 0. 1. DISPLAY_IDENTIFIER LV_END_DIAG_BN_VEH_MOD ECU_ADDRESS 0xd0004232 BIT_MASK 0x20 /end MEASUREMENT
/begin MEASUREMENT fmy_stat_bn_veh_mod.err_info_stat.lv_cdn_diag "Diagnosis condition to start symptom detection (set to 1 when condition is fulfilled)" UWORD _CNV_S_2_RANGE__0___1_CM 1 100. 0. 1. DISPLAY_IDENTIFIER LV_CDN_DIAG_BN_VEH_MOD ECU_ADDRESS 0xd0004232 BIT_MASK 0x40 /end MEASUREMENT
/begin MEASUREMENT fmy_stat_bn_veh_mod.err_info_stat.err_sym "For each symptom: status of failure (set to 1 when failure symptom is detected)" UWORD _CNV_S_16_RANGE_ERR__485_CM 1 100. 0. 15. DISPLAY_IDENTIFIER ERR_SYM_BN_VEH_MOD ECU_ADDRESS 0xd0004232 BIT_MASK 0x780 /end MEASUREMENT
/begin MEASUREMENT fmy_stat_bn_km_icl.ctr_abc "anti-bounce counter for diagnosis XX" UBYTE _CNV_A_R_LINEAR_____0_CM 1 100. 0. 255. DISPLAY_IDENTIFIER CTR_ABC_BN_KM_ICL ECU_ADDRESS 0xd00041f4 FORMAT "%3.0" /end MEASUREMENT
/begin MEASUREMENT fmy_stat_bn_km_icl.ctr_end_diag "Counter for the end of diagnosis XX generation" UBYTE _CNV_A_R_LINEAR_____0_CM 1 100. 0. 255. DISPLAY_IDENTIFIER CTR_ABC_END_DIAG_BN_KM_ICL ECU_ADDRESS 0xd00041f5 FORMAT "%3.0" /end MEASUREMENT
/begin MEASUREMENT fmy_stat_bn_km_icl.err_info_stat.lv_err_mem "Failure is stored in dynamic memory (2nd layer)" UWORD _CNV_S_2_RANGE__0___1_CM 1 100. 0. 1. DISPLAY_IDENTIFIER LV_ERR_MEM_BN_KM_ICL ECU_ADDRESS 0xd00041f6 BIT_MASK 0x8 /end MEASUREMENT
/begin MEASUREMENT fmy_stat_bn_km_icl.err_info_stat.lv_ready "Readiness flag related to diagnosis XX" UWORD _CNV_S_2_RANGE__0___1_CM 1 100. 0. 1. DISPLAY_IDENTIFIER LV_READY_BN_KM_ICL ECU_ADDRESS 0xd00041f6 BIT_MASK 0x10 /end MEASUREMENT
/begin MEASUREMENT fmy_stat_bn_km_icl.err_info_stat.lv_end_diag "End of diagnosis XX" UWORD _CNV_S_2_RANGE__0___1_CM 1 100. 0. 1. DISPLAY_IDENTIFIER LV_END_DIAG_BN_KM_ICL ECU_ADDRESS 0xd00041f6 BIT_MASK 0x20 /end MEASUREMENT
/begin MEASUREMENT fmy_stat_bn_km_icl.err_info_stat.lv_cdn_diag "Diagnosis condition to start symptom detection (set to 1 when condition is fulfilled)" UWORD _CNV_S_2_RANGE__0___1_CM 1 100. 0. 1. DISPLAY_IDENTIFIER LV_CDN_DIAG_BN_KM_ICL ECU_ADDRESS 0xd00041f6 BIT_MASK 0x40 /end MEASUREMENT
/begin MEASUREMENT fmy_stat_bn_km_icl.err_info_stat.err_sym "For each symptom: status of failure (set to 1 when failure symptom is detected)" UWORD _CNV_S_16_RANGE_ERR__485_CM 1 100. 0. 15. DISPLAY_IDENTIFIER ERR_SYM_BN_KM_ICL ECU_ADDRESS 0xd00041f6 BIT_MASK 0x780 /end MEASUREMENT
/begin MEASUREMENT fmy_stat_bn_icl.ctr_abc "anti-bounce counter for diagnosis XX" UBYTE _CNV_A_R_LINEAR_____0_CM 1 100. 0. 255. DISPLAY_IDENTIFIER CTR_ABC_BN_ICL ECU_ADDRESS 0xd00041f0 FORMAT "%3.0" /end MEASUREMENT
/begin MEASUREMENT fmy_stat_bn_icl.ctr_end_diag "Counter for the end of diagnosis XX generation" UBYTE _CNV_A_R_LINEAR_____0_CM 1 100. 0. 255. DISPLAY_IDENTIFIER CTR_ABC_END_DIAG_BN_ICL ECU_ADDRESS 0xd00041f1 FORMAT "%3.0" /end MEASUREMENT
/begin MEASUREMENT fmy_stat_bn_icl.err_info_stat.lv_err_mem "Failure is stored in dynamic memory (2nd layer)" UWORD _CNV_S_2_RANGE__0___1_CM 1 100. 0. 1. DISPLAY_IDENTIFIER LV_ERR_MEM_BN_ICL ECU_ADDRESS 0xd00041f2 BIT_MASK 0x8 /end MEASUREMENT
/begin MEASUREMENT fmy_stat_bn_icl.err_info_stat.lv_ready "Readiness flag related to diagnosis XX" UWORD _CNV_S_2_RANGE__0___1_CM 1 100. 0. 1. DISPLAY_IDENTIFIER LV_READY_BN_ICL ECU_ADDRESS 0xd00041f2 BIT_MASK 0x10 /end MEASUREMENT
/begin MEASUREMENT fmy_stat_bn_icl.err_info_stat.lv_end_diag "End of diagnosis XX" UWORD _CNV_S_2_RANGE__0___1_CM 1 100. 0. 1. DISPLAY_IDENTIFIER LV_END_DIAG_BN_ICL ECU_ADDRESS 0xd00041f2 BIT_MASK 0x20 /end MEASUREMENT
/begin MEASUREMENT fmy_stat_bn_icl.err_info_stat.lv_cdn_diag "Diagnosis condition to start symptom detection (set to 1 when condition is fulfilled)" UWORD _CNV_S_2_RANGE__0___1_CM 1 100. 0. 1. DISPLAY_IDENTIFIER LV_CDN_DIAG_BN_ICL ECU_ADDRESS 0xd00041f2 BIT_MASK 0x40 /end MEASUREMENT
/begin MEASUREMENT fmy_stat_bn_icl.err_info_stat.err_sym "For each symptom: status of failure (set to 1 when failure symptom is detected)" UWORD _CNV_S_16_RANGE_ERR__485_CM 1 100. 0. 15. DISPLAY_IDENTIFIER ERR_SYM_BN_ICL ECU_ADDRESS 0xd00041f2 BIT_MASK 0x780 /end MEASUREMENT
/begin MEASUREMENT fmy_stat_bn_pow_vb.ctr_abc "anti-bounce counter for diagnosis XX" UBYTE _CNV_A_R_LINEAR_____0_CM 1 100. 0. 255. DISPLAY_IDENTIFIER CTR_ABC_BN_POW_VB ECU_ADDRESS 0xd0004208 FORMAT "%3.0" /end MEASUREMENT
/begin MEASUREMENT fmy_stat_bn_pow_vb.ctr_end_diag "Counter for the end of diagnosis XX generation" UBYTE _CNV_A_R_LINEAR_____0_CM 1 100. 0. 255. DISPLAY_IDENTIFIER CTR_ABC_END_DIAG_BN_POW_VB ECU_ADDRESS 0xd0004209 FORMAT "%3.0" /end MEASUREMENT
/begin MEASUREMENT fmy_stat_bn_pow_vb.err_info_stat.lv_err_mem "Failure is stored in dynamic memory (2nd layer)" UWORD _CNV_S_2_RANGE__0___1_CM 1 100. 0. 1. DISPLAY_IDENTIFIER LV_ERR_MEM_BN_POW_VB ECU_ADDRESS 0xd000420a BIT_MASK 0x8 /end MEASUREMENT
/begin MEASUREMENT fmy_stat_bn_pow_vb.err_info_stat.lv_ready "Readiness flag related to diagnosis XX" UWORD _CNV_S_2_RANGE__0___1_CM 1 100. 0. 1. DISPLAY_IDENTIFIER LV_READY_BN_POW_VB ECU_ADDRESS 0xd000420a BIT_MASK 0x10 /end MEASUREMENT
/begin MEASUREMENT fmy_stat_bn_pow_vb.err_info_stat.lv_end_diag "End of diagnosis XX" UWORD _CNV_S_2_RANGE__0___1_CM 1 100. 0. 1. DISPLAY_IDENTIFIER LV_END_DIAG_BN_POW_VB ECU_ADDRESS 0xd000420a BIT_MASK 0x20 /end MEASUREMENT
/begin MEASUREMENT fmy_stat_bn_pow_vb.err_info_stat.lv_cdn_diag "Diagnosis condition to start symptom detection (set to 1 when condition is fulfilled)" UWORD _CNV_S_2_RANGE__0___1_CM 1 100. 0. 1. DISPLAY_IDENTIFIER LV_CDN_DIAG_BN_POW_VB ECU_ADDRESS 0xd000420a BIT_MASK 0x40 /end MEASUREMENT
/begin MEASUREMENT fmy_stat_bn_pow_vb.err_info_stat.err_sym "For each symptom: status of failure (set to 1 when failure symptom is detected)" UWORD _CNV_S_16_RANGE_ERR__485_CM 1 100. 0. 15. DISPLAY_IDENTIFIER ERR_SYM_BN_POW_VB ECU_ADDRESS 0xd000420a BIT_MASK 0x780 /end MEASUREMENT
/begin MEASUREMENT fmy_stat_bn_pow_gen.ctr_abc "anti-bounce counter for diagnosis XX" UBYTE _CNV_A_R_LINEAR_____0_CM 1 100. 0. 255. DISPLAY_IDENTIFIER CTR_ABC_BN_POW_GEN ECU_ADDRESS 0xd0004204 FORMAT "%3.0" /end MEASUREMENT
/begin MEASUREMENT fmy_stat_bn_pow_gen.ctr_end_diag "Counter for the end of diagnosis XX generation" UBYTE _CNV_A_R_LINEAR_____0_CM 1 100. 0. 255. DISPLAY_IDENTIFIER CTR_ABC_END_DIAG_BN_POW_GEN ECU_ADDRESS 0xd0004205 FORMAT "%3.0" /end MEASUREMENT
/begin MEASUREMENT fmy_stat_bn_pow_gen.err_info_stat.lv_err_mem "Failure is stored in dynamic memory (2nd layer)" UWORD _CNV_S_2_RANGE__0___1_CM 1 100. 0. 1. DISPLAY_IDENTIFIER LV_ERR_MEM_BN_POW_GEN ECU_ADDRESS 0xd0004206 BIT_MASK 0x8 /end MEASUREMENT
/begin MEASUREMENT fmy_stat_bn_pow_gen.err_info_stat.lv_ready "Readiness flag related to diagnosis XX" UWORD _CNV_S_2_RANGE__0___1_CM 1 100. 0. 1. DISPLAY_IDENTIFIER LV_READY_BN_POW_GEN ECU_ADDRESS 0xd0004206 BIT_MASK 0x10 /end MEASUREMENT
/begin MEASUREMENT fmy_stat_bn_pow_gen.err_info_stat.lv_end_diag "End of diagnosis XX" UWORD _CNV_S_2_RANGE__0___1_CM 1 100. 0. 1. DISPLAY_IDENTIFIER LV_END_DIAG_BN_POW_GEN ECU_ADDRESS 0xd0004206 BIT_MASK 0x20 /end MEASUREMENT
/begin MEASUREMENT fmy_stat_bn_pow_gen.err_info_stat.lv_cdn_diag "Diagnosis condition to start symptom detection (set to 1 when condition is fulfilled)" UWORD _CNV_S_2_RANGE__0___1_CM 1 100. 0. 1. DISPLAY_IDENTIFIER LV_CDN_DIAG_BN_POW_GEN ECU_ADDRESS 0xd0004206 BIT_MASK 0x40 /end MEASUREMENT
/begin MEASUREMENT fmy_stat_bn_pow_gen.err_info_stat.err_sym "For each symptom: status of failure (set to 1 when failure symptom is detected)" UWORD _CNV_S_16_RANGE_ERR__485_CM 1 100. 0. 15. DISPLAY_IDENTIFIER ERR_SYM_BN_POW_GEN ECU_ADDRESS 0xd0004206 BIT_MASK 0x780 /end MEASUREMENT
/begin MEASUREMENT fmy_stat_bn_msw.ctr_abc "anti-bounce counter for diagnosis XX" UBYTE _CNV_A_R_LINEAR_____0_CM 1 100. 0. 255. DISPLAY_IDENTIFIER CTR_ABC_BN_MSW ECU_ADDRESS 0xd0004200 FORMAT "%3.0" /end MEASUREMENT
/begin MEASUREMENT fmy_stat_bn_msw.ctr_end_diag "Counter for the end of diagnosis XX generation" UBYTE _CNV_A_R_LINEAR_____0_CM 1 100. 0. 255. DISPLAY_IDENTIFIER CTR_ABC_END_DIAG_BN_MSW ECU_ADDRESS 0xd0004201 FORMAT "%3.0" /end MEASUREMENT
/begin MEASUREMENT fmy_stat_bn_msw.err_info_stat.lv_err_mem "Failure is stored in dynamic memory (2nd layer)" UWORD _CNV_S_2_RANGE__0___1_CM 1 100. 0. 1. DISPLAY_IDENTIFIER LV_ERR_MEM_BN_MSW ECU_ADDRESS 0xd0004202 BIT_MASK 0x8 /end MEASUREMENT
/begin MEASUREMENT fmy_stat_bn_msw.err_info_stat.lv_ready "Readiness flag related to diagnosis XX" UWORD _CNV_S_2_RANGE__0___1_CM 1 100. 0. 1. DISPLAY_IDENTIFIER LV_READY_BN_MSW ECU_ADDRESS 0xd0004202 BIT_MASK 0x10 /end MEASUREMENT
/begin MEASUREMENT fmy_stat_bn_msw.err_info_stat.lv_end_diag "End of diagnosis XX" UWORD _CNV_S_2_RANGE__0___1_CM 1 100. 0. 1. DISPLAY_IDENTIFIER LV_END_DIAG_BN_MSW ECU_ADDRESS 0xd0004202 BIT_MASK 0x20 /end MEASUREMENT
/begin MEASUREMENT fmy_stat_bn_msw.err_info_stat.lv_cdn_diag "Diagnosis condition to start symptom detection (set to 1 when condition is fulfilled)" UWORD _CNV_S_2_RANGE__0___1_CM 1 100. 0. 1. DISPLAY_IDENTIFIER LV_CDN_DIAG_BN_MSW ECU_ADDRESS 0xd0004202 BIT_MASK 0x40 /end MEASUREMENT
/begin MEASUREMENT fmy_stat_bn_msw.err_info_stat.err_sym "For each symptom: status of failure (set to 1 when failure symptom is detected)" UWORD _CNV_S_16_RANGE_ERR__485_CM 1 100. 0. 15. DISPLAY_IDENTIFIER ERR_SYM_BN_MSW ECU_ADDRESS 0xd0004202 BIT_MASK 0x780 /end MEASUREMENT
/begin MEASUREMENT fmy_stat_bn_ang_pste.ctr_abc "anti-bounce counter for diagnosis XX" UBYTE _CNV_A_R_LINEAR_____0_CM 1 100. 0. 255. DISPLAY_IDENTIFIER CTR_ABC_BN_ANG_PSTE ECU_ADDRESS 0xd00041c8 FORMAT "%3.0" /end MEASUREMENT
/begin MEASUREMENT fmy_stat_bn_ang_pste.ctr_end_diag "Counter for the end of diagnosis XX generation" UBYTE _CNV_A_R_LINEAR_____0_CM 1 100. 0. 255. DISPLAY_IDENTIFIER CTR_ABC_END_DIAG_BN_ANG_PSTE ECU_ADDRESS 0xd00041c9 FORMAT "%3.0" /end MEASUREMENT
/begin MEASUREMENT fmy_stat_bn_ang_pste.err_info_stat.lv_err_mem "Failure is stored in dynamic memory (2nd layer)" UWORD _CNV_S_2_RANGE__0___1_CM 1 100. 0. 1. DISPLAY_IDENTIFIER LV_ERR_MEM_BN_ANG_PSTE ECU_ADDRESS 0xd00041ca BIT_MASK 0x8 /end MEASUREMENT
/begin MEASUREMENT fmy_stat_bn_ang_pste.err_info_stat.lv_ready "Readiness flag related to diagnosis XX" UWORD _CNV_S_2_RANGE__0___1_CM 1 100. 0. 1. DISPLAY_IDENTIFIER LV_READY_BN_ANG_PSTE ECU_ADDRESS 0xd00041ca BIT_MASK 0x10 /end MEASUREMENT
/begin MEASUREMENT fmy_stat_bn_ang_pste.err_info_stat.lv_end_diag "End of diagnosis XX" UWORD _CNV_S_2_RANGE__0___1_CM 1 100. 0. 1. DISPLAY_IDENTIFIER LV_END_DIAG_BN_ANG_PSTE ECU_ADDRESS 0xd00041ca BIT_MASK 0x20 /end MEASUREMENT
/begin MEASUREMENT fmy_stat_bn_ang_pste.err_info_stat.lv_cdn_diag "Diagnosis condition to start symptom detection (set to 1 when condition is fulfilled)" UWORD _CNV_S_2_RANGE__0___1_CM 1 100. 0. 1. DISPLAY_IDENTIFIER LV_CDN_DIAG_BN_ANG_PSTE ECU_ADDRESS 0xd00041ca BIT_MASK 0x40 /end MEASUREMENT
/begin MEASUREMENT fmy_stat_bn_ang_pste.err_info_stat.err_sym "For each symptom: status of failure (set to 1 when failure symptom is detected)" UWORD _CNV_S_16_RANGE_ERR__485_CM 1 100. 0. 15. DISPLAY_IDENTIFIER ERR_SYM_BN_ANG_PSTE ECU_ADDRESS 0xd00041ca BIT_MASK 0x780 /end MEASUREMENT
/begin MEASUREMENT fmy_stat_bn_gear_rev.ctr_abc "anti-bounce counter for diagnosis XX" UBYTE _CNV_A_R_LINEAR_____0_CM 1 100. 0. 255. DISPLAY_IDENTIFIER CTR_ABC_BN_GEAR_REV ECU_ADDRESS 0xd00041e8 FORMAT "%3.0" /end MEASUREMENT
/begin MEASUREMENT fmy_stat_bn_gear_rev.ctr_end_diag "Counter for the end of diagnosis XX generation" UBYTE _CNV_A_R_LINEAR_____0_CM 1 100. 0. 255. DISPLAY_IDENTIFIER CTR_ABC_END_DIAG_BN_GEAR_REV ECU_ADDRESS 0xd00041e9 FORMAT "%3.0" /end MEASUREMENT
/begin MEASUREMENT fmy_stat_bn_gear_rev.err_info_stat.lv_err_mem "Failure is stored in dynamic memory (2nd layer)" UWORD _CNV_S_2_RANGE__0___1_CM 1 100. 0. 1. DISPLAY_IDENTIFIER LV_ERR_MEM_BN_GEAR_REV ECU_ADDRESS 0xd00041ea BIT_MASK 0x8 /end MEASUREMENT
/begin MEASUREMENT fmy_stat_bn_gear_rev.err_info_stat.lv_ready "Readiness flag related to diagnosis XX" UWORD _CNV_S_2_RANGE__0___1_CM 1 100. 0. 1. DISPLAY_IDENTIFIER LV_READY_BN_GEAR_REV ECU_ADDRESS 0xd00041ea BIT_MASK 0x10 /end MEASUREMENT
/begin MEASUREMENT fmy_stat_bn_gear_rev.err_info_stat.lv_end_diag "End of diagnosis XX" UWORD _CNV_S_2_RANGE__0___1_CM 1 100. 0. 1. DISPLAY_IDENTIFIER LV_END_DIAG_BN_GEAR_REV ECU_ADDRESS 0xd00041ea BIT_MASK 0x20 /end MEASUREMENT
/begin MEASUREMENT fmy_stat_bn_gear_rev.err_info_stat.lv_cdn_diag "Diagnosis condition to start symptom detection (set to 1 when condition is fulfilled)" UWORD _CNV_S_2_RANGE__0___1_CM 1 100. 0. 1. DISPLAY_IDENTIFIER LV_CDN_DIAG_BN_GEAR_REV ECU_ADDRESS 0xd00041ea BIT_MASK 0x40 /end MEASUREMENT
/begin MEASUREMENT fmy_stat_bn_gear_rev.err_info_stat.err_sym "For each symptom: status of failure (set to 1 when failure symptom is detected)" UWORD _CNV_S_16_RANGE_ERR__485_CM 1 100. 0. 15. DISPLAY_IDENTIFIER ERR_SYM_BN_GEAR_REV ECU_ADDRESS 0xd00041ea BIT_MASK 0x780 /end MEASUREMENT
/begin MEASUREMENT fmy_stat_bn_ltg_hdlp_l.ctr_abc "anti-bounce counter for diagnosis XX" UBYTE _CNV_A_R_LINEAR_____0_CM 1 100. 0. 255. DISPLAY_IDENTIFIER CTR_ABC_BN_LTG_HDLP_L ECU_ADDRESS 0xd00041fc FORMAT "%3.0" /end MEASUREMENT
/begin MEASUREMENT fmy_stat_bn_ltg_hdlp_l.ctr_end_diag "Counter for the end of diagnosis XX generation" UBYTE _CNV_A_R_LINEAR_____0_CM 1 100. 0. 255. DISPLAY_IDENTIFIER CTR_ABC_END_DIAG_BN_LTG_HDLP_L ECU_ADDRESS 0xd00041fd FORMAT "%3.0" /end MEASUREMENT
/begin MEASUREMENT fmy_stat_bn_ltg_hdlp_l.err_info_stat.lv_err_mem "Failure is stored in dynamic memory (2nd layer)" UWORD _CNV_S_2_RANGE__0___1_CM 1 100. 0. 1. DISPLAY_IDENTIFIER LV_ERR_MEM_BN_LTG_HDLP_L ECU_ADDRESS 0xd00041fe BIT_MASK 0x8 /end MEASUREMENT
/begin MEASUREMENT fmy_stat_bn_ltg_hdlp_l.err_info_stat.lv_ready "Readiness flag related to diagnosis XX" UWORD _CNV_S_2_RANGE__0___1_CM 1 100. 0. 1. DISPLAY_IDENTIFIER LV_READY_BN_LTG_HDLP_L ECU_ADDRESS 0xd00041fe BIT_MASK 0x10 /end MEASUREMENT
/begin MEASUREMENT fmy_stat_bn_ltg_hdlp_l.err_info_stat.lv_end_diag "End of diagnosis XX" UWORD _CNV_S_2_RANGE__0___1_CM 1 100. 0. 1. DISPLAY_IDENTIFIER LV_END_DIAG_BN_LTG_HDLP_L ECU_ADDRESS 0xd00041fe BIT_MASK 0x20 /end MEASUREMENT
/begin MEASUREMENT fmy_stat_bn_ltg_hdlp_l.err_info_stat.lv_cdn_diag "Diagnosis condition to start symptom detection (set to 1 when condition is fulfilled)" UWORD _CNV_S_2_RANGE__0___1_CM 1 100. 0. 1. DISPLAY_IDENTIFIER LV_CDN_DIAG_BN_LTG_HDLP_L ECU_ADDRESS 0xd00041fe BIT_MASK 0x40 /end MEASUREMENT
/begin MEASUREMENT fmy_stat_bn_ltg_hdlp_l.err_info_stat.err_sym "For each symptom: status of failure (set to 1 when failure symptom is detected)" UWORD _CNV_S_16_RANGE_ERR__485_CM 1 100. 0. 15. DISPLAY_IDENTIFIER ERR_SYM_BN_LTG_HDLP_L ECU_ADDRESS 0xd00041fe BIT_MASK 0x780 /end MEASUREMENT
/begin MEASUREMENT fmy_stat_bn_ldm.ctr_abc "anti-bounce counter for diagnosis XX" UBYTE _CNV_A_R_LINEAR_____0_CM 1 100. 0. 255. DISPLAY_IDENTIFIER CTR_ABC_BN_LDM ECU_ADDRESS 0xd00041f8 FORMAT "%3.0" /end MEASUREMENT
/begin MEASUREMENT fmy_stat_bn_ldm.ctr_end_diag "Counter for the end of diagnosis XX generation" UBYTE _CNV_A_R_LINEAR_____0_CM 1 100. 0. 255. DISPLAY_IDENTIFIER CTR_ABC_END_DIAG_BN_LDM ECU_ADDRESS 0xd00041f9 FORMAT "%3.0" /end MEASUREMENT
/begin MEASUREMENT fmy_stat_bn_ldm.err_info_stat.lv_err_mem "Failure is stored in dynamic memory (2nd layer)" UWORD _CNV_S_2_RANGE__0___1_CM 1 100. 0. 1. DISPLAY_IDENTIFIER LV_ERR_MEM_BN_LDM ECU_ADDRESS 0xd00041fa BIT_MASK 0x8 /end MEASUREMENT
/begin MEASUREMENT fmy_stat_bn_ldm.err_info_stat.lv_ready "Readiness flag related to diagnosis XX" UWORD _CNV_S_2_RANGE__0___1_CM 1 100. 0. 1. DISPLAY_IDENTIFIER LV_READY_BN_LDM ECU_ADDRESS 0xd00041fa BIT_MASK 0x10 /end MEASUREMENT
/begin MEASUREMENT fmy_stat_bn_ldm.err_info_stat.lv_end_diag "End of diagnosis XX" UWORD _CNV_S_2_RANGE__0___1_CM 1 100. 0. 1. DISPLAY_IDENTIFIER LV_END_DIAG_BN_LDM ECU_ADDRESS 0xd00041fa BIT_MASK 0x20 /end MEASUREMENT
/begin MEASUREMENT fmy_stat_bn_ldm.err_info_stat.lv_cdn_diag "Diagnosis condition to start symptom detection (set to 1 when condition is fulfilled)" UWORD _CNV_S_2_RANGE__0___1_CM 1 100. 0. 1. DISPLAY_IDENTIFIER LV_CDN_DIAG_BN_LDM ECU_ADDRESS 0xd00041fa BIT_MASK 0x40 /end MEASUREMENT
/begin MEASUREMENT fmy_stat_bn_ldm.err_info_stat.err_sym "For each symptom: status of failure (set to 1 when failure symptom is detected)" UWORD _CNV_S_16_RANGE_ERR__485_CM 1 100. 0. 15. DISPLAY_IDENTIFIER ERR_SYM_BN_LDM ECU_ADDRESS 0xd00041fa BIT_MASK 0x780 /end MEASUREMENT
/begin MEASUREMENT fmy_stat_bn_trl.ctr_abc "anti-bounce counter for diagnosis XX" UBYTE _CNV_A_R_LINEAR_____0_CM 1 100. 0. 255. DISPLAY_IDENTIFIER CTR_ABC_BN_TRL ECU_ADDRESS 0xd000422c FORMAT "%3.0" /end MEASUREMENT
/begin MEASUREMENT fmy_stat_bn_trl.ctr_end_diag "Counter for the end of diagnosis XX generation" UBYTE _CNV_A_R_LINEAR_____0_CM 1 100. 0. 255. DISPLAY_IDENTIFIER CTR_ABC_END_DIAG_BN_TRL ECU_ADDRESS 0xd000422d FORMAT "%3.0" /end MEASUREMENT
/begin MEASUREMENT fmy_stat_bn_trl.err_info_stat.lv_err_mem "Failure is stored in dynamic memory (2nd layer)" UWORD _CNV_S_2_RANGE__0___1_CM 1 100. 0. 1. DISPLAY_IDENTIFIER LV_ERR_MEM_BN_TRL ECU_ADDRESS 0xd000422e BIT_MASK 0x8 /end MEASUREMENT
/begin MEASUREMENT fmy_stat_bn_trl.err_info_stat.lv_ready "Readiness flag related to diagnosis XX" UWORD _CNV_S_2_RANGE__0___1_CM 1 100. 0. 1. DISPLAY_IDENTIFIER LV_READY_BN_TRL ECU_ADDRESS 0xd000422e BIT_MASK 0x10 /end MEASUREMENT
/begin MEASUREMENT fmy_stat_bn_trl.err_info_stat.lv_end_diag "End of diagnosis XX" UWORD _CNV_S_2_RANGE__0___1_CM 1 100. 0. 1. DISPLAY_IDENTIFIER LV_END_DIAG_BN_TRL ECU_ADDRESS 0xd000422e BIT_MASK 0x20 /end MEASUREMENT
/begin MEASUREMENT fmy_stat_bn_trl.err_info_stat.lv_cdn_diag "Diagnosis condition to start symptom detection (set to 1 when condition is fulfilled)" UWORD _CNV_S_2_RANGE__0___1_CM 1 100. 0. 1. DISPLAY_IDENTIFIER LV_CDN_DIAG_BN_TRL ECU_ADDRESS 0xd000422e BIT_MASK 0x40 /end MEASUREMENT
/begin MEASUREMENT fmy_stat_bn_trl.err_info_stat.err_sym "For each symptom: status of failure (set to 1 when failure symptom is detected)" UWORD _CNV_S_16_RANGE_ERR__485_CM 1 100. 0. 15. DISPLAY_IDENTIFIER ERR_SYM_BN_TRL ECU_ADDRESS 0xd000422e BIT_MASK 0x780 /end MEASUREMENT
/begin MEASUREMENT fmy_stat_bn_hiv.ctr_abc "anti-bounce counter for diagnosis XX" UBYTE _CNV_A_R_LINEAR_____0_CM 1 100. 0. 255. DISPLAY_IDENTIFIER CTR_ABC_BN_HIV ECU_ADDRESS 0xd00041ec FORMAT "%3.0" /end MEASUREMENT
/begin MEASUREMENT fmy_stat_bn_hiv.ctr_end_diag "Counter for the end of diagnosis XX generation" UBYTE _CNV_A_R_LINEAR_____0_CM 1 100. 0. 255. DISPLAY_IDENTIFIER CTR_ABC_END_DIAG_BN_HIV ECU_ADDRESS 0xd00041ed FORMAT "%3.0" /end MEASUREMENT
/begin MEASUREMENT fmy_stat_bn_hiv.err_info_stat.lv_err_mem "Failure is stored in dynamic memory (2nd layer)" UWORD _CNV_S_2_RANGE__0___1_CM 1 100. 0. 1. DISPLAY_IDENTIFIER LV_ERR_MEM_BN_HIV ECU_ADDRESS 0xd00041ee BIT_MASK 0x8 /end MEASUREMENT
/begin MEASUREMENT fmy_stat_bn_hiv.err_info_stat.lv_ready "Readiness flag related to diagnosis XX" UWORD _CNV_S_2_RANGE__0___1_CM 1 100. 0. 1. DISPLAY_IDENTIFIER LV_READY_BN_HIV ECU_ADDRESS 0xd00041ee BIT_MASK 0x10 /end MEASUREMENT
/begin MEASUREMENT fmy_stat_bn_hiv.err_info_stat.lv_end_diag "End of diagnosis XX" UWORD _CNV_S_2_RANGE__0___1_CM 1 100. 0. 1. DISPLAY_IDENTIFIER LV_END_DIAG_BN_HIV ECU_ADDRESS 0xd00041ee BIT_MASK 0x20 /end MEASUREMENT
/begin MEASUREMENT fmy_stat_bn_hiv.err_info_stat.lv_cdn_diag "Diagnosis condition to start symptom detection (set to 1 when condition is fulfilled)" UWORD _CNV_S_2_RANGE__0___1_CM 1 100. 0. 1. DISPLAY_IDENTIFIER LV_CDN_DIAG_BN_HIV ECU_ADDRESS 0xd00041ee BIT_MASK 0x40 /end MEASUREMENT
/begin MEASUREMENT fmy_stat_bn_hiv.err_info_stat.err_sym "For each symptom: status of failure (set to 1 when failure symptom is detected)" UWORD _CNV_S_16_RANGE_ERR__485_CM 1 100. 0. 15. DISPLAY_IDENTIFIER ERR_SYM_BN_HIV ECU_ADDRESS 0xd00041ee BIT_MASK 0x780 /end MEASUREMENT
/begin MEASUREMENT fmy_stat_bn_t_clk.ctr_abc "anti-bounce counter for diagnosis XX" UBYTE _CNV_A_R_LINEAR_____0_CM 1 100. 0. 255. DISPLAY_IDENTIFIER CTR_ABC_BN_T_CLK ECU_ADDRESS 0xd000420c FORMAT "%3.0" /end MEASUREMENT
/begin MEASUREMENT fmy_stat_bn_t_clk.ctr_end_diag "Counter for the end of diagnosis XX generation" UBYTE _CNV_A_R_LINEAR_____0_CM 1 100. 0. 255. DISPLAY_IDENTIFIER CTR_ABC_END_DIAG_BN_T_CLK ECU_ADDRESS 0xd000420d FORMAT "%3.0" /end MEASUREMENT
/begin MEASUREMENT fmy_stat_bn_t_clk.err_info_stat.lv_err_mem "Failure is stored in dynamic memory (2nd layer)" UWORD _CNV_S_2_RANGE__0___1_CM 1 100. 0. 1. DISPLAY_IDENTIFIER LV_ERR_MEM_BN_T_CLK ECU_ADDRESS 0xd000420e BIT_MASK 0x8 /end MEASUREMENT
/begin COMPU_METHOD _CNV_A_R_LINEAR_____0_CM "" RAT_FUNC "%6.3" "-" COEFFS 0 1. 0. 0 0 1 /end COMPU_METHOD
/begin COMPU_METHOD _CNV_S_2_RANGE__0___1_CM "" TAB_VERB "%6.3" "-" COMPU_TAB_REF _CNV_S_2_RANGE__0___1 /end COMPU_METHOD
/begin COMPU_VTAB _CNV_S_2_RANGE__0___1 "" TAB_VERB 2 0 "0" 1 "1" /end COMPU_VTAB
/begin COMPU_METHOD _CNV_S_16_RANGE_ERR__485_CM "" TAB_VERB "%6.3" "-" COMPU_TAB_REF _CNV_S_16_RANGE_ERR__485 /end COMPU_METHOD
/begin COMPU_VTAB _CNV_S_16_RANGE_ERR__485 "" TAB_VERB 16 0 "NO_SYM" 1 "SYM_0" 2 "SYM_1" 3 "SYM_0, SYM_1" 4 "SYM_2" 5 "SYM_0, SYM_2" 6 "SYM_1, SYM_2" 7 "SYM_0, SYM_1, SYM_2" 8 "SYM_3" 9 "SYM_0, SYM_3" 10 "SYM_1, SYM_3" 11 "SYM_0, SYM_1,SYM_3" 12 "SYM_2, SYM_3" 13 "SYM_0, SYM_2, SYM_3" 14 "SYM_1, SYM_2, SYM_3" 15 "SYM_0, SYM_1, SYM_2, SYM_3" /end COMPU_VTAB
/begin FUNCTION ERRM_Table_of_Failures "Table_of_Failures"
 /begin OUT_MEASUREMENT fmy_stat_alter_bn_bat.err_info_stat.lv_ready fmy_stat_alter_bn_bat.err_info_stat.lv_end_diag fmy_stat_alter_bn_bat.err_info_stat.lv_cdn_diag fmy_stat_alter_bn_bat.err_info_stat.err_sym fmy_stat_vim_1_el.ctr_abc fmy_stat_vim_1_el.ctr_end_diag fmy_stat_vim_1_el.err_info_stat.lv_err_mem fmy_stat_vim_1_el.err_info_stat.lv_ready fmy_stat_vim_1_el.err_info_stat.lv_end_diag fmy_stat_vim_1_el.err_info_stat.lv_cdn_diag fmy_stat_vim_1_el.err_info_stat.err_sym fmy_stat_vim_2_el.ctr_abc fmy_stat_vim_2_el.ctr_end_diag fmy_stat_vim_2_el.err_info_stat.lv_err_mem fmy_stat_vim_2_el.err_info_stat.lv_ready fmy_stat_vim_2_el.err_info_stat.lv_end_diag fmy_stat_vim_2_el.err_info_stat.lv_cdn_diag fmy_stat_vim_2_el.err_info_stat.err_sym fmy_stat_vimpwm_1_fb.ctr_abc fmy_stat_vimpwm_1_fb.ctr_end_diag fmy_stat_vimpwm_1_fb.err_info_stat.lv_err_mem fmy_stat_vimpwm_1_fb.err_info_stat.lv_ready fmy_stat_vimpwm_1_fb.err_info_stat.lv_end_diag fmy_stat_vimpwm_1_fb.err_info_stat.lv_cdn_diag fmy_stat_vimpwm_1_fb.err_info_stat.err_sym fmy_stat_vimpwm_2_fb.ctr_abc fmy_stat_vimpwm_2_fb.ctr_end_diag fmy_stat_vimpwm_2_fb.err_info_stat.lv_err_mem fmy_stat_vimpwm_2_fb.err_info_stat.lv_ready fmy_stat_vimpwm_2_fb.err_info_stat.lv_end_diag fmy_stat_vimpwm_2_fb.err_info_stat.lv_cdn_diag fmy_stat_vimpwm_2_fb.err_info_stat.err_sym fmy_stat_t_es.ctr_abc fmy_stat_t_es.ctr_end_diag fmy_stat_t_es.err_info_stat.lv_err_mem fmy_stat_t_es.err_info_stat.lv_ready fmy_stat_t_es.err_info_stat.lv_end_diag fmy_stat_t_es.err_info_stat.lv_cdn_diag fmy_stat_t_es.err_info_stat.err_sym fmy_stat_map_dip_plaus.ctr_abc fmy_stat_map_dip_plaus.ctr_end_diag fmy_stat_map_dip_plaus.err_info_stat.lv_err_mem fmy_stat_map_dip_plaus.err_info_stat.lv_ready fmy_stat_map_dip_plaus.err_info_stat.lv_end_diag fmy_stat_map_dip_plaus.err_info_stat.lv_cdn_diag fmy_stat_map_dip_plaus.err_info_stat.err_sym fmy_stat_toil_level.ctr_abc fmy_stat_toil_level.ctr_end_diag fmy_stat_toil_level.err_info_stat.lv_err_mem fmy_stat_toil_level.err_info_stat.lv_ready fmy_stat_toil_level.err_info_stat.lv_end_diag fmy_stat_toil_level.err_info_stat.lv_cdn_diag fmy_stat_toil_level.err_info_stat.err_sym fmy_stat_vim_plaus.ctr_abc fmy_stat_vim_plaus.ctr_end_diag fmy_stat_vim_plaus.err_info_stat.lv_err_mem fmy_stat_vim_plaus.err_info_stat.lv_ready fmy_stat_vim_plaus.err_info_stat.lv_end_diag fmy_stat_vim_plaus.err_info_stat.lv_cdn_diag fmy_stat_vim_plaus.err_info_stat.err_sym fmy_stat_alter_bn_rgn.ctr_abc fmy_stat_alter_bn_rgn.ctr_end_diag fmy_stat_alter_bn_rgn.err_info_stat.lv_err_mem fmy_stat_alter_bn_rgn.err_info_stat.lv_ready fmy_stat_alter_bn_rgn.err_info_stat.lv_end_diag fmy_stat_alter_bn_rgn.err_info_stat.lv_cdn_diag fmy_stat_alter_bn_rgn.err_info_stat.err_sym fmy_stat_per_cam_in_1.ctr_abc fmy_stat_per_cam_in_1.ctr_end_diag fmy_stat_per_cam_in_1.err_info_stat.lv_err_mem fmy_stat_per_cam_in_1.err_info_stat.lv_ready fmy_stat_per_cam_in_1.err_info_stat.lv_end_diag fmy_stat_per_cam_in_1.err_info_stat.lv_cdn_diag fmy_stat_per_cam_in_1.err_info_stat.err_sym fmy_stat_per_cam_ex_1.ctr_abc fmy_stat_per_cam_ex_1.ctr_end_diag fmy_stat_per_cam_ex_1.err_info_stat.lv_err_mem fmy_stat_per_cam_ex_1.err_info_stat.lv_ready fmy_stat_per_cam_ex_1.err_info_stat.lv_end_diag fmy_stat_per_cam_ex_1.err_info_stat.lv_cdn_diag fmy_stat_per_cam_ex_1.err_info_stat.err_sym fmy_stat_syn_cam_in_1.ctr_abc fmy_stat_syn_cam_in_1.ctr_end_diag fmy_stat_syn_cam_in_1.err_info_stat.lv_err_mem fmy_stat_syn_cam_in_1.err_info_stat.lv_ready fmy_stat_syn_cam_in_1.err_info_stat.lv_end_diag fmy_stat_syn_cam_in_1.err_info_stat.lv_cdn_diag fmy_stat_syn_cam_in_1.err_info_stat.err_sym fmy_stat_syn_cam_ex_1.ctr_abc fmy_stat_syn_cam_ex_1.ctr_end_diag fmy_stat_syn_cam_ex_1.err_info_stat.lv_err_mem fmy_stat_syn_cam_ex_1.err_info_stat.lv_ready fmy_stat_syn_cam_ex_1.err_info_stat.lv_end_diag fmy_stat_syn_cam_ex_1.err_info_stat.lv_cdn_diag fmy_stat_syn_cam_ex_1.err_info_stat.err_sym fmy_stat_ref_crk_cam_in_1.ctr_abc fmy_stat_ref_crk_cam_in_1.ctr_end_diag fmy_stat_ref_crk_cam_in_1.err_info_stat.lv_err_mem fmy_stat_ref_crk_cam_in_1.err_info_stat.lv_ready fmy_stat_ref_crk_cam_in_1.err_info_stat.lv_end_diag fmy_stat_ref_crk_cam_in_1.err_info_stat.lv_cdn_diag fmy_stat_ref_crk_cam_in_1.err_info_stat.err_sym fmy_stat_ref_crk_cam_ex_1.ctr_abc fmy_stat_ref_crk_cam_ex_1.ctr_end_diag fmy_stat_ref_crk_cam_ex_1.err_info_stat.lv_err_mem fmy_stat_ref_crk_cam_ex_1.err_info_stat.lv_ready fmy_stat_ref_crk_cam_ex_1.err_info_stat.lv_end_diag fmy_stat_ref_crk_cam_ex_1.err_info_stat.lv_cdn_diag fmy_stat_ref_crk_cam_ex_1.err_info_stat.err_sym fmy_stat_crk_tooth.ctr_abc fmy_stat_crk_tooth.ctr_end_diag fmy_stat_crk_tooth.err_info_stat.lv_err_mem fmy_stat_crk_tooth.err_info_stat.lv_ready fmy_stat_crk_tooth.err_info_stat.lv_end_diag fmy_stat_crk_tooth.err_info_stat.lv_cdn_diag fmy_stat_crk_tooth.err_info_stat.err_sym fmy_stat_crk_tooth_per.ctr_abc fmy_stat_crk_tooth_per.ctr_end_diag fmy_stat_crk_tooth_per.err_info_stat.lv_err_mem fmy_stat_crk_tooth_per.err_info_stat.lv_ready fmy_stat_crk_tooth_per.err_info_stat.lv_end_diag fmy_stat_crk_tooth_per.err_info_stat.lv_cdn_diag fmy_stat_crk_tooth_per.err_info_stat.err_sym fmy_stat_crk_syn.ctr_abc fmy_stat_crk_syn.ctr_end_diag fmy_stat_crk_syn.err_info_stat.lv_err_mem fmy_stat_crk_syn.err_info_stat.lv_ready fmy_stat_crk_syn.err_info_stat.lv_end_diag fmy_stat_crk_syn.err_info_stat.lv_cdn_diag fmy_stat_crk_syn.err_info_stat.err_sym fmy_stat_crk_plaus.ctr_abc fmy_stat_crk_plaus.ctr_end_diag fmy_stat_crk_plaus.err_info_stat.lv_err_mem fmy_stat_crk_plaus.err_info_stat.lv_ready fmy_stat_crk_plaus.err_info_stat.lv_end_diag fmy_stat_crk_plaus.err_info_stat.lv_cdn_diag fmy_stat_crk_plaus.err_info_stat.err_sym fmy_stat_plaus_cam_in_1.ctr_abc fmy_stat_plaus_cam_in_1.ctr_end_diag fmy_stat_plaus_cam_in_1.err_info_stat.lv_err_mem fmy_stat_plaus_cam_in_1.err_info_stat.lv_ready fmy_stat_plaus_cam_in_1.err_info_stat.lv_end_diag fmy_stat_plaus_cam_in_1.err_info_stat.lv_cdn_diag fmy_stat_plaus_cam_in_1.err_info_stat.err_sym fmy_stat_plaus_cam_ex_1.ctr_abc fmy_stat_plaus_cam_ex_1.ctr_end_diag fmy_stat_plaus_cam_ex_1.err_info_stat.lv_err_mem fmy_stat_plaus_cam_ex_1.err_info_stat.lv_ready fmy_stat_plaus_cam_ex_1.err_info_stat.lv_end_diag fmy_stat_plaus_cam_ex_1.err_info_stat.lv_cdn_diag fmy_stat_plaus_cam_ex_1.err_info_stat.err_sym fmy_stat_syn_crk_cam_in_1.ctr_abc fmy_stat_syn_crk_cam_in_1.ctr_end_diag fmy_stat_syn_crk_cam_in_1.err_info_stat.lv_err_mem fmy_stat_syn_crk_cam_in_1.err_info_stat.lv_ready fmy_stat_syn_crk_cam_in_1.err_info_stat.lv_end_diag fmy_stat_syn_crk_cam_in_1.err_info_stat.lv_cdn_diag fmy_stat_syn_crk_cam_in_1.err_info_stat.err_sym fmy_stat_syn_crk_cam_ex_1.ctr_abc fmy_stat_syn_crk_cam_ex_1.ctr_end_diag fmy_stat_syn_crk_cam_ex_1.err_info_stat.lv_err_mem fmy_stat_syn_crk_cam_ex_1.err_info_stat.lv_ready fmy_stat_syn_crk_cam_ex_1.err_info_stat.lv_end_diag fmy_stat_syn_crk_cam_ex_1.err_info_stat.lv_cdn_diag fmy_stat_syn_crk_cam_ex_1.err_info_stat.err_sym fmy_stat_can_boff_B.ctr_abc fmy_stat_can_boff_B.ctr_end_diag fmy_stat_can_boff_B.err_info_stat.lv_err_mem fmy_stat_can_boff_B.err_info_stat.lv_ready fmy_stat_can_boff_B.err_info_stat.lv_end_diag fmy_stat_can_boff_B.err_info_stat.lv_cdn_diag fmy_stat_can_boff_B.err_info_stat.err_sym fmy_stat_can_boff_C.ctr_abc fmy_stat_can_boff_C.ctr_end_diag fmy_stat_can_boff_C.err_info_stat.lv_err_mem fmy_stat_can_boff_C.err_info_stat.lv_ready fmy_stat_can_boff_C.err_info_stat.lv_end_diag fmy_stat_can_boff_C.err_info_stat.lv_cdn_diag fmy_stat_can_boff_C.err_info_stat.err_sym fmy_stat_rly_main.ctr_abc fmy_stat_rly_main.ctr_end_diag fmy_stat_rly_main.err_info_stat.lv_err_mem fmy_stat_rly_main.err_info_stat.lv_ready fmy_stat_rly_main.err_info_stat.lv_end_diag fmy_stat_rly_main.err_info_stat.lv_cdn_diag fmy_stat_rly_main.err_info_stat.err_sym fmy_stat_rly_main_dly.ctr_abc fmy_stat_rly_main_dly.ctr_end_diag fmy_stat_rly_main_dly.err_info_stat.lv_err_mem fmy_stat_rly_main_dly.err_info_stat.lv_ready fmy_stat_rly_main_dly.err_info_stat.lv_end_diag fmy_stat_rly_main_dly.err_info_stat.lv_cdn_diag fmy_stat_rly_main_dly.err_info_stat.err_sym fmy_stat_rly_accout.ctr_abc fmy_stat_rly_accout.ctr_end_diag fmy_stat_rly_accout.err_info_stat.lv_err_mem fmy_stat_rly_accout.err_info_stat.lv_ready fmy_stat_rly_accout.err_info_stat.lv_end_diag fmy_stat_rly_accout.err_info_stat.lv_cdn_diag fmy_stat_rly_accout.err_info_stat.err_sym fmy_stat_isc.ctr_abc fmy_stat_isc.ctr_end_diag fmy_stat_isc.err_info_stat.lv_err_mem fmy_stat_isc.err_info_stat.lv_ready fmy_stat_isc.err_info_stat.lv_end_diag fmy_stat_isc.err_info_stat.lv_cdn_diag fmy_stat_isc.err_info_stat.err_sym fmy_stat_im_bls_plaus.ctr_abc fmy_stat_im_bls_plaus.ctr_end_diag fmy_stat_im_bls_plaus.err_info_stat.lv_err_mem fmy_stat_im_bls_plaus.err_info_stat.lv_ready fmy_stat_im_bls_plaus.err_info_stat.lv_end_diag fmy_stat_im_bls_plaus.err_info_stat.lv_cdn_diag fmy_stat_im_bls_plaus.err_info_stat.err_sym fmy_stat_im_bts_plaus.ctr_abc fmy_stat_im_bts_plaus.ctr_end_diag fmy_stat_im_bts_plaus.err_info_stat.lv_err_mem fmy_stat_im_bts_plaus.err_info_stat.lv_ready fmy_stat_im_bts_plaus.err_info_stat.lv_end_diag fmy_stat_im_bts_plaus.err_info_stat.lv_cdn_diag fmy_stat_im_bts_plaus.err_info_stat.err_sym fmy_stat_msw_tog.ctr_abc fmy_stat_msw_tog.ctr_end_diag fmy_stat_msw_tog.err_info_stat.lv_err_mem fmy_stat_msw_tog.err_info_stat.lv_ready fmy_stat_msw_tog.err_info_stat.lv_end_diag fmy_stat_msw_tog.err_info_stat.lv_cdn_diag fmy_stat_msw_tog.err_info_stat.err_sym fmy_stat_msw_2.ctr_abc fmy_stat_msw_2.ctr_end_diag fmy_stat_msw_2.err_info_stat.lv_err_mem fmy_stat_msw_2.err_info_stat.lv_ready fmy_stat_msw_2.err_info_stat.lv_end_diag fmy_stat_msw_2.err_info_stat.lv_cdn_diag fmy_stat_msw_2.err_info_stat.err_sym fmy_stat_msw_3.ctr_abc fmy_stat_msw_3.ctr_end_diag fmy_stat_msw_3.err_info_stat.lv_err_mem fmy_stat_msw_3.err_info_stat.lv_ready fmy_stat_msw_3.err_info_stat.lv_end_diag fmy_stat_msw_3.err_info_stat.lv_cdn_diag fmy_stat_msw_3.err_info_stat.err_sym fmy_stat_mis_0.ctr_abc fmy_stat_mis_0.ctr_end_diag fmy_stat_mis_0.err_info_stat.lv_err_mem fmy_stat_mis_0.err_info_stat.lv_ready fmy_stat_mis_0.err_info_stat.lv_end_diag fmy_stat_mis_0.err_info_stat.lv_cdn_diag fmy_stat_mis_0.err_info_stat.err_sym fmy_stat_mis_1.ctr_abc fmy_stat_mis_1.ctr_end_diag fmy_stat_mis_1.err_info_stat.lv_err_mem fmy_stat_mis_1.err_info_stat.lv_ready fmy_stat_mis_1.err_info_stat.lv_end_diag fmy_stat_mis_1.err_info_stat.lv_cdn_diag fmy_stat_mis_1.err_info_stat.err_sym fmy_stat_mis_2.ctr_abc fmy_stat_mis_2.ctr_end_diag fmy_stat_mis_2.err_info_stat.lv_err_mem fmy_stat_mis_2.err_info_stat.lv_ready fmy_stat_mis_2.err_info_stat.lv_end_diag fmy_stat_mis_2.err_info_stat.lv_cdn_diag fmy_stat_mis_2.err_info_stat.err_sym fmy_stat_mis_3.ctr_abc fmy_stat_mis_3.ctr_end_diag fmy_stat_mis_3.err_info_stat.lv_err_mem fmy_stat_mis_3.err_info_stat.lv_ready fmy_stat_mis_3.err_info_stat.lv_end_diag fmy_stat_mis_3.err_info_stat.lv_cdn_diag fmy_stat_mis_3.err_info_stat.err_sym fmy_stat_mis_4.ctr_abc fmy_stat_mis_4.ctr_end_diag fmy_stat_mis_4.err_info_stat.lv_err_mem fmy_stat_mis_4.err_info_stat.lv_ready fmy_stat_mis_4.err_info_stat.lv_end_diag fmy_stat_mis_4.err_info_stat.lv_cdn_diag fmy_stat_mis_4.err_info_stat.err_sym fmy_stat_mis_5.ctr_abc fmy_stat_mis_5.ctr_end_diag fmy_stat_mis_5.err_info_stat.lv_err_mem fmy_stat_mis_5.err_info_stat.lv_ready fmy_stat_mis_5.err_info_stat.lv_end_diag fmy_stat_mis_5.err_info_stat.lv_cdn_diag fmy_stat_mis_5.err_info_stat.err_sym fmy_stat_mis_mpl.ctr_abc fmy_stat_mis_mpl.ctr_end_diag fmy_stat_mis_mpl.err_info_stat.lv_err_mem fmy_stat_mis_mpl.err_info_stat.lv_ready fmy_stat_mis_mpl.err_info_stat.lv_end_diag fmy_stat_mis_mpl.err_info_stat.lv_cdn_diag fmy_stat_mis_mpl.err_info_stat.err_sym fmy_stat_mis_ftl_l.ctr_abc fmy_stat_mis_ftl_l.ctr_end_diag fmy_stat_mis_ftl_l.err_info_stat.lv_err_mem fmy_stat_mis_ftl_l.err_info_stat.lv_ready fmy_stat_mis_ftl_l.err_info_stat.lv_end_diag fmy_stat_mis_ftl_l.err_info_stat.lv_cdn_diag fmy_stat_mis_ftl_l.err_info_stat.err_sym fmy_stat_fsd_1.ctr_abc fmy_stat_fsd_1.ctr_end_diag fmy_stat_fsd_1.err_info_stat.lv_err_mem fmy_stat_fsd_1.err_info_stat.lv_ready fmy_stat_fsd_1.err_info_stat.lv_end_diag fmy_stat_fsd_1.err_info_stat.lv_cdn_diag fmy_stat_fsd_1.err_info_stat.err_sym fmy_stat_fsd_2.ctr_abc fmy_stat_fsd_2.ctr_end_diag fmy_stat_fsd_2.err_info_stat.lv_err_mem fmy_stat_fsd_2.err_info_stat.lv_ready fmy_stat_fsd_2.err_info_stat.lv_end_diag fmy_stat_fsd_2.err_info_stat.lv_cdn_diag fmy_stat_fsd_2.err_info_stat.err_sym fmy_stat_ef.ctr_abc fmy_stat_ef.ctr_end_diag fmy_stat_ef.err_info_stat.lv_err_mem fmy_stat_ef.err_info_stat.lv_ready fmy_stat_ef.err_info_stat.lv_end_diag fmy_stat_ef.err_info_stat.lv_cdn_diag fmy_stat_ef.err_info_stat.err_sym fmy_stat_tecu.ctr_abc fmy_stat_tecu.ctr_end_diag fmy_stat_tecu.err_info_stat.lv_err_mem fmy_stat_tecu.err_info_stat.lv_ready fmy_stat_tecu.err_info_stat.lv_end_diag fmy_stat_tecu.err_info_stat.lv_cdn_diag fmy_stat_tecu.err_info_stat.err_sym fmy_stat_ebox_cfa.ctr_abc fmy_stat_ebox_cfa.ctr_end_diag fmy_stat_ebox_cfa.err_info_stat.lv_err_mem fmy_stat_ebox_cfa.err_info_stat.lv_ready fmy_stat_ebox_cfa.err_info_stat.lv_end_diag fmy_stat_ebox_cfa.err_info_stat.lv_cdn_diag fmy_stat_ebox_cfa.err_info_stat.err_sym fmy_stat_ecu_ram.ctr_abc fmy_stat_ecu_ram.ctr_end_diag fmy_stat_ecu_ram.err_info_stat.lv_err_mem fmy_stat_ecu_ram.err_info_stat.lv_ready fmy_stat_ecu_ram.err_info_stat.lv_end_diag fmy_stat_ecu_ram.err_info_stat.lv_cdn_diag fmy_stat_ecu_ram.err_info_stat.err_sym fmy_stat_tqi_lim.ctr_abc fmy_stat_tqi_lim.ctr_end_diag fmy_stat_tqi_lim.err_info_stat.lv_err_mem fmy_stat_tqi_lim.err_info_stat.lv_ready fmy_stat_tqi_lim.err_info_stat.lv_end_diag fmy_stat_tqi_lim.err_info_stat.lv_cdn_diag fmy_stat_tqi_lim.err_info_stat.err_sym fmy_stat_obd2_lsh_down_1.ctr_abc fmy_stat_obd2_lsh_down_1.ctr_end_diag fmy_stat_obd2_lsh_down_1.err_info_stat.lv_err_mem fmy_stat_obd2_lsh_down_1.err_info_stat.lv_ready fmy_stat_obd2_lsh_down_1.err_info_stat.lv_end_diag fmy_stat_obd2_lsh_down_1.err_info_stat.lv_cdn_diag fmy_stat_obd2_lsh_down_1.err_info_stat.err_sym fmy_stat_obd2_lsh_down_2.ctr_abc fmy_stat_obd2_lsh_down_2.ctr_end_diag fmy_stat_obd2_lsh_down_2.err_info_stat.lv_err_mem fmy_stat_obd2_lsh_down_2.err_info_stat.lv_ready fmy_stat_obd2_lsh_down_2.err_info_stat.lv_end_diag fmy_stat_obd2_lsh_down_2.err_info_stat.lv_cdn_diag fmy_stat_obd2_lsh_down_2.err_info_stat.err_sym fmy_stat_dmtls.ctr_abc fmy_stat_dmtls.ctr_end_diag fmy_stat_dmtls.err_info_stat.lv_err_mem fmy_stat_dmtls.err_info_stat.lv_ready fmy_stat_dmtls.err_info_stat.lv_end_diag fmy_stat_dmtls.err_info_stat.lv_cdn_diag fmy_stat_dmtls.err_info_stat.err_sym fmy_stat_dmtl_pump.ctr_abc fmy_stat_dmtl_pump.ctr_end_diag fmy_stat_dmtl_pump.err_info_stat.lv_err_mem fmy_stat_dmtl_pump.err_info_stat.lv_ready fmy_stat_dmtl_pump.err_info_stat.lv_end_diag fmy_stat_dmtl_pump.err_info_stat.lv_cdn_diag fmy_stat_dmtl_pump.err_info_stat.err_sym fmy_stat_dmtlm.ctr_abc fmy_stat_dmtlm.ctr_end_diag fmy_stat_dmtlm.err_info_stat.lv_err_mem fmy_stat_dmtlm.err_info_stat.lv_ready fmy_stat_dmtlm.err_info_stat.lv_end_diag fmy_stat_dmtlm.err_info_stat.lv_cdn_diag fmy_stat_dmtlm.err_info_stat.err_sym fmy_stat_rough_leak.ctr_abc fmy_stat_rough_leak.ctr_end_diag fmy_stat_rough_leak.err_info_stat.lv_err_mem fmy_stat_rough_leak.err_info_stat.lv_ready fmy_stat_rough_leak.err_info_stat.lv_end_diag fmy_stat_rough_leak.err_info_stat.lv_cdn_diag fmy_stat_rough_leak.err_info_stat.err_sym fmy_stat_small_leak.ctr_abc fmy_stat_small_leak.ctr_end_diag fmy_stat_small_leak.err_info_stat.lv_err_mem fmy_stat_small_leak.err_info_stat.lv_ready fmy_stat_small_leak.err_info_stat.lv_end_diag fmy_stat_small_leak.err_info_stat.lv_cdn_diag fmy_stat_small_leak.err_info_stat.err_sym fmy_stat_chk_fuc.ctr_abc fmy_stat_chk_fuc.ctr_end_diag fmy_stat_chk_fuc.err_info_stat.lv_err_mem fmy_stat_chk_fuc.err_info_stat.lv_ready fmy_stat_chk_fuc.err_info_stat.lv_end_diag fmy_stat_chk_fuc.err_info_stat.lv_cdn_diag fmy_stat_chk_fuc.err_info_stat.err_sym fmy_stat_sof.ctr_abc fmy_stat_sof.ctr_end_diag fmy_stat_sof.err_info_stat.lv_err_mem fmy_stat_sof.err_info_stat.lv_ready fmy_stat_sof.err_info_stat.lv_end_diag fmy_stat_sof.err_info_stat.lv_cdn_diag fmy_stat_sof.err_info_stat.err_sym fmy_stat_sof_req.ctr_abc fmy_stat_sof_req.ctr_end_diag fmy_stat_sof_req.err_info_stat.lv_err_mem fmy_stat_sof_req.err_info_stat.lv_ready fmy_stat_sof_req.err_info_stat.lv_end_diag fmy_stat_sof_req.err_info_stat.lv_cdn_diag fmy_stat_sof_req.err_info_stat.err_sym fmy_stat_rly_crcv_heat.ctr_abc fmy_stat_rly_crcv_heat.ctr_end_diag fmy_stat_rly_crcv_heat.err_info_stat.lv_err_mem fmy_stat_rly_crcv_heat.err_info_stat.lv_ready fmy_stat_rly_crcv_heat.err_info_stat.lv_end_diag fmy_stat_rly_crcv_heat.err_info_stat.lv_cdn_diag fmy_stat_rly_crcv_heat.err_info_stat.err_sym fmy_stat_rly_st.ctr_abc fmy_stat_rly_st.ctr_end_diag fmy_stat_rly_st.err_info_stat.lv_err_mem fmy_stat_rly_st.err_info_stat.lv_ready fmy_stat_rly_st.err_info_stat.lv_end_diag fmy_stat_rly_st.err_info_stat.lv_cdn_diag fmy_stat_rly_st.err_info_stat.err_sym fmy_stat_bsd.ctr_abc fmy_stat_bsd.ctr_end_diag fmy_stat_bsd.err_info_stat.lv_err_mem fmy_stat_bsd.err_info_stat.lv_ready fmy_stat_bsd.err_info_stat.lv_end_diag fmy_stat_bsd.err_info_stat.lv_cdn_diag fmy_stat_bsd.err_info_stat.err_sym fmy_stat_poil_swi.ctr_abc fmy_stat_poil_swi.ctr_end_diag fmy_stat_poil_swi.err_info_stat.lv_err_mem fmy_stat_poil_swi.err_info_stat.lv_ready fmy_stat_poil_swi.err_info_stat.lv_end_diag fmy_stat_poil_swi.err_info_stat.lv_cdn_diag fmy_stat_poil_swi.err_info_stat.err_sym fmy_stat_tout_efp_can.ctr_abc fmy_stat_tout_efp_can.ctr_end_diag fmy_stat_tout_efp_can.err_info_stat.lv_err_mem fmy_stat_tout_efp_can.err_info_stat.lv_ready fmy_stat_tout_efp_can.err_info_stat.lv_end_diag fmy_stat_tout_efp_can.err_info_stat.lv_cdn_diag fmy_stat_tout_efp_can.err_info_stat.err_sym fmy_stat_diagcps.ctr_abc fmy_stat_diagcps.ctr_end_diag fmy_stat_diagcps.err_info_stat.lv_err_mem fmy_stat_diagcps.err_info_stat.lv_ready fmy_stat_diagcps.err_info_stat.lv_end_diag fmy_stat_diagcps.err_info_stat.lv_cdn_diag fmy_stat_diagcps.err_info_stat.err_sym fmy_stat_dcc.ctr_abc fmy_stat_dcc.ctr_end_diag fmy_stat_dcc.err_info_stat.lv_err_mem fmy_stat_dcc.err_info_stat.lv_ready fmy_stat_dcc.err_info_stat.lv_end_diag fmy_stat_dcc.err_info_stat.lv_cdn_diag fmy_stat_dcc.err_info_stat.err_sym fmy_stat_ldm.ctr_abc fmy_stat_ldm.ctr_end_diag fmy_stat_ldm.err_info_stat.lv_err_mem fmy_stat_ldm.err_info_stat.lv_ready fmy_stat_ldm.err_info_stat.lv_end_diag fmy_stat_ldm.err_info_stat.lv_cdn_diag fmy_stat_ldm.err_info_stat.err_sym fmy_stat_dmtlh.ctr_abc fmy_stat_dmtlh.ctr_end_diag fmy_stat_dmtlh.err_info_stat.lv_err_mem fmy_stat_dmtlh.err_info_stat.lv_ready fmy_stat_dmtlh.err_info_stat.lv_end_diag fmy_stat_dmtlh.err_info_stat.lv_cdn_diag fmy_stat_dmtlh.err_info_stat.err_sym fmy_stat_cs.ctr_abc fmy_stat_cs.ctr_end_diag fmy_stat_cs.err_info_stat.lv_err_mem fmy_stat_cs.err_info_stat.lv_ready fmy_stat_cs.err_info_stat.lv_end_diag fmy_stat_cs.err_info_stat.lv_cdn_diag fmy_stat_cs.err_info_stat.err_sym fmy_stat_spi_mps.ctr_abc fmy_stat_spi_mps.ctr_end_diag fmy_stat_spi_mps.err_info_stat.lv_err_mem fmy_stat_spi_mps.err_info_stat.lv_ready fmy_stat_spi_mps.err_info_stat.lv_end_diag fmy_stat_spi_mps.err_info_stat.lv_cdn_diag fmy_stat_spi_mps.err_info_stat.err_sym fmy_stat_spi_knk.ctr_abc fmy_stat_spi_knk.ctr_end_diag fmy_stat_spi_knk.err_info_stat.lv_err_mem fmy_stat_spi_knk.err_info_stat.lv_ready fmy_stat_spi_knk.err_info_stat.lv_end_diag fmy_stat_spi_knk.err_info_stat.lv_cdn_diag fmy_stat_spi_knk.err_info_stat.err_sym fmy_stat_bn_tq_dcc.ctr_abc fmy_stat_bn_tq_dcc.ctr_end_diag fmy_stat_bn_tq_dcc.err_info_stat.lv_err_mem fmy_stat_bn_tq_dcc.err_info_stat.lv_ready fmy_stat_bn_tq_dcc.err_info_stat.lv_end_diag fmy_stat_bn_tq_dcc.err_info_stat.lv_cdn_diag fmy_stat_bn_tq_dcc.err_info_stat.err_sym fmy_stat_bn_tq_pste_2.ctr_abc fmy_stat_bn_tq_pste_2.ctr_end_diag fmy_stat_bn_tq_pste_2.err_info_stat.lv_err_mem fmy_stat_bn_tq_pste_2.err_info_stat.lv_ready fmy_stat_bn_tq_pste_2.err_info_stat.lv_end_diag fmy_stat_bn_tq_pste_2.err_info_stat.lv_cdn_diag fmy_stat_bn_tq_pste_2.err_info_stat.err_sym fmy_stat_bn_ars.ctr_abc fmy_stat_bn_ars.ctr_end_diag fmy_stat_bn_ars.err_info_stat.lv_err_mem fmy_stat_bn_ars.err_info_stat.lv_ready fmy_stat_bn_ars.err_info_stat.lv_end_diag fmy_stat_bn_ars.err_info_stat.lv_cdn_diag fmy_stat_bn_ars.err_info_stat.err_sym fmy_stat_bn_cas.ctr_abc fmy_stat_bn_cas.ctr_end_diag fmy_stat_bn_cas.err_info_stat.lv_err_mem fmy_stat_bn_cas.err_info_stat.lv_ready fmy_stat_bn_cas.err_info_stat.lv_end_diag fmy_stat_bn_cas.err_info_stat.lv_cdn_diag fmy_stat_bn_cas.err_info_stat.err_sym fmy_stat_bn_tq_tcs.ctr_abc fmy_stat_bn_tq_tcs.ctr_end_diag fmy_stat_bn_tq_tcs.err_info_stat.lv_err_mem fmy_stat_bn_tq_tcs.err_info_stat.lv_ready fmy_stat_bn_tq_tcs.err_info_stat.lv_end_diag fmy_stat_bn_tq_tcs.err_info_stat.lv_cdn_diag fmy_stat_bn_tq_tcs.err_info_stat.err_sym fmy_stat_bn_vs_tcs.ctr_abc fmy_stat_bn_vs_tcs.ctr_end_diag fmy_stat_bn_vs_tcs.err_info_stat.lv_err_mem fmy_stat_bn_vs_tcs.err_info_stat.lv_ready fmy_stat_bn_vs_tcs.err_info_stat.lv_end_diag fmy_stat_bn_vs_tcs.err_info_stat.lv_cdn_diag fmy_stat_bn_vs_tcs.err_info_stat.err_sym fmy_stat_bn_tcs.ctr_abc fmy_stat_bn_tcs.ctr_end_diag fmy_stat_bn_tcs.err_info_stat.lv_err_mem fmy_stat_bn_tcs.err_info_stat.lv_ready fmy_stat_bn_tcs.err_info_stat.lv_end_diag fmy_stat_bn_tcs.err_info_stat.lv_cdn_diag fmy_stat_bn_tcs.err_info_stat.err_sym fmy_stat_bn_tq_etcu.ctr_abc fmy_stat_bn_tq_etcu.ctr_end_diag fmy_stat_bn_tq_etcu.err_info_stat.lv_err_mem fmy_stat_bn_tq_etcu.err_info_stat.lv_ready fmy_stat_bn_tq_etcu.err_info_stat.lv_end_diag fmy_stat_bn_tq_etcu.err_info_stat.lv_cdn_diag fmy_stat_bn_tq_etcu.err_info_stat.err_sym fmy_stat_bn_etcu.ctr_abc fmy_stat_bn_etcu.ctr_end_diag fmy_stat_bn_etcu.err_info_stat.lv_err_mem fmy_stat_bn_etcu.err_info_stat.lv_ready fmy_stat_bn_etcu.err_info_stat.lv_end_diag fmy_stat_bn_etcu.err_info_stat.lv_cdn_diag fmy_stat_bn_etcu.err_info_stat.err_sym fmy_stat_bn_etcu_2.ctr_abc fmy_stat_bn_etcu_2.ctr_end_diag fmy_stat_bn_etcu_2.err_info_stat.lv_err_mem fmy_stat_bn_etcu_2.err_info_stat.lv_ready fmy_stat_bn_etcu_2.err_info_stat.lv_end_diag fmy_stat_bn_etcu_2.err_info_stat.lv_cdn_diag fmy_stat_bn_etcu_2.err_info_stat.err_sym fmy_stat_bn_etcu_disp.ctr_abc fmy_stat_bn_etcu_disp.ctr_end_diag fmy_stat_bn_etcu_disp.err_info_stat.lv_err_mem fmy_stat_bn_etcu_disp.err_info_stat.lv_ready fmy_stat_bn_etcu_disp.err_info_stat.lv_end_diag fmy_stat_bn_etcu_disp.err_info_stat.lv_cdn_diag fmy_stat_bn_etcu_disp.err_info_stat.err_sym fmy_stat_bn_tq_amt.ctr_abc fmy_stat_bn_tq_amt.ctr_end_diag fmy_stat_bn_tq_amt.err_info_stat.lv_err_mem fmy_stat_bn_tq_amt.err_info_stat.lv_ready fmy_stat_bn_tq_amt.err_info_stat.lv_end_diag fmy_stat_bn_tq_amt.err_info_stat.lv_cdn_diag fmy_stat_bn_tq_amt.err_info_stat.err_sym fmy_stat_bn_acc.ctr_abc fmy_stat_bn_acc.ctr_end_diag fmy_stat_bn_acc.err_info_stat.lv_err_mem fmy_stat_bn_acc.err_info_stat.lv_ready fmy_stat_bn_acc.err_info_stat.lv_end_diag fmy_stat_bn_acc.err_info_stat.lv_cdn_diag fmy_stat_bn_acc.err_info_stat.err_sym fmy_stat_bn_t_icl.ctr_abc fmy_stat_bn_t_icl.ctr_end_diag fmy_stat_bn_t_icl.err_info_stat.lv_err_mem fmy_stat_bn_t_icl.err_info_stat.lv_ready fmy_stat_bn_t_icl.err_info_stat.lv_end_diag fmy_stat_bn_t_icl.err_info_stat.lv_cdn_diag fmy_stat_bn_t_icl.err_info_stat.err_sym fmy_stat_bn_veh_mod.ctr_abc fmy_stat_bn_veh_mod.ctr_end_diag fmy_stat_bn_veh_mod.err_info_stat.lv_err_mem fmy_stat_bn_veh_mod.err_info_stat.lv_ready fmy_stat_bn_veh_mod.err_info_stat.lv_end_diag fmy_stat_bn_veh_mod.err_info_stat.lv_cdn_diag fmy_stat_bn_veh_mod.err_info_stat.err_sym fmy_stat_bn_km_icl.ctr_abc fmy_stat_bn_km_icl.ctr_end_diag fmy_stat_bn_km_icl.err_info_stat.lv_err_mem fmy_stat_bn_km_icl.err_info_stat.lv_ready fmy_stat_bn_km_icl.err_info_stat.lv_end_diag fmy_stat_bn_km_icl.err_info_stat.lv_cdn_diag fmy_stat_bn_km_icl.err_info_stat.err_sym fmy_stat_bn_icl.ctr_abc fmy_stat_bn_icl.ctr_end_diag fmy_stat_bn_icl.err_info_stat.lv_err_mem fmy_stat_bn_icl.err_info_stat.lv_ready fmy_stat_bn_icl.err_info_stat.lv_end_diag fmy_stat_bn_icl.err_info_stat.lv_cdn_diag fmy_stat_bn_icl.err_info_stat.err_sym fmy_stat_bn_pow_vb.ctr_abc fmy_stat_bn_pow_vb.ctr_end_diag fmy_stat_bn_pow_vb.err_info_stat.lv_err_mem fmy_stat_bn_pow_vb.err_info_stat.lv_ready fmy_stat_bn_pow_vb.err_info_stat.lv_end_diag fmy_stat_bn_pow_vb.err_info_stat.lv_cdn_diag fmy_stat_bn_pow_vb.err_info_stat.err_sym fmy_stat_bn_pow_gen.ctr_abc fmy_stat_bn_pow_gen.ctr_end_diag fmy_stat_bn_pow_gen.err_info_stat.lv_err_mem fmy_stat_bn_pow_gen.err_info_stat.lv_ready fmy_stat_bn_pow_gen.err_info_stat.lv_end_diag fmy_stat_bn_pow_gen.err_info_stat.lv_cdn_diag fmy_stat_bn_pow_gen.err_info_stat.err_sym fmy_stat_bn_msw.ctr_abc fmy_stat_bn_msw.ctr_end_diag fmy_stat_bn_msw.err_info_stat.lv_err_mem fmy_stat_bn_msw.err_info_stat.lv_ready fmy_stat_bn_msw.err_info_stat.lv_end_diag fmy_stat_bn_msw.err_info_stat.lv_cdn_diag fmy_stat_bn_msw.err_info_stat.err_sym fmy_stat_bn_ang_pste.ctr_abc fmy_stat_bn_ang_pste.ctr_end_diag fmy_stat_bn_ang_pste.err_info_stat.lv_err_mem fmy_stat_bn_ang_pste.err_info_stat.lv_ready fmy_stat_bn_ang_pste.err_info_stat.lv_end_diag fmy_stat_bn_ang_pste.err_info_stat.lv_cdn_diag fmy_stat_bn_ang_pste.err_info_stat.err_sym fmy_stat_bn_gear_rev.ctr_abc fmy_stat_bn_gear_rev.ctr_end_diag fmy_stat_bn_gear_rev.err_info_stat.lv_err_mem fmy_stat_bn_gear_rev.err_info_stat.lv_ready fmy_stat_bn_gear_rev.err_info_stat.lv_end_diag fmy_stat_bn_gear_rev.err_info_stat.lv_cdn_diag fmy_stat_bn_gear_rev.err_info_stat.err_sym fmy_stat_bn_ltg_hdlp_l.ctr_abc fmy_stat_bn_ltg_hdlp_l.ctr_end_diag fmy_stat_bn_ltg_hdlp_l.err_info_stat.lv_err_mem fmy_stat_bn_ltg_hdlp_l.err_info_stat.lv_ready fmy_stat_bn_ltg_hdlp_l.err_info_stat.lv_end_diag fmy_stat_bn_ltg_hdlp_l.err_info_stat.lv_cdn_diag fmy_stat_bn_ltg_hdlp_l.err_info_stat.err_sym fmy_stat_bn_ldm.ctr_abc fmy_stat_bn_ldm.ctr_end_diag fmy_stat_bn_ldm.err_info_stat.lv_err_mem fmy_stat_bn_ldm.err_info_stat.lv_ready fmy_stat_bn_ldm.err_info_stat.lv_end_diag fmy_stat_bn_ldm.err_info_stat.lv_cdn_diag fmy_stat_bn_ldm.err_info_stat.err_sym fmy_stat_bn_trl.ctr_abc fmy_stat_bn_trl.ctr_end_diag fmy_stat_bn_trl.err_info_stat.lv_err_mem fmy_stat_bn_trl.err_info_stat.lv_ready fmy_stat_bn_trl.err_info_stat.lv_end_diag fmy_stat_bn_trl.err_info_stat.lv_cdn_diag fmy_stat_bn_trl.err_info_stat.err_sym fmy_stat_bn_hiv.ctr_abc fmy_stat_bn_hiv.ctr_end_diag fmy_stat_bn_hiv.err_info_stat.lv_err_mem fmy_stat_bn_hiv.err_info_stat.lv_ready fmy_stat_bn_hiv.err_info_stat.lv_end_diag fmy_stat_bn_hiv.err_info_stat.lv_cdn_diag fmy_stat_bn_hiv.err_info_stat.err_sym fmy_stat_bn_t_clk.ctr_abc fmy_stat_bn_t_clk.ctr_end_diag fmy_stat_bn_t_clk.err_info_stat.lv_err_mem /end OUT_MEASUREMENT
/end FUNCTION
/end MODULE
/end PROJECT
