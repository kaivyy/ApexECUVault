ASAP2_VERSION 1 30
/begin PROJECT MSS65-inj "Generiert am 14.10.05 um 11:34:36"
/begin HEADER "" VERSION "R341" /end HEADER
/begin MODULE _MSS65-inj "Generiert am 14.10.05 um 11:34:36"
/begin MOD_COMMON "" BYTE_ORDER MSB_FIRST ALIGNMENT_BYTE 1 ALIGNMENT_WORD 2 ALIGNMENT_LONG 4 ALIGNMENT_FLOAT32_IEEE 4 ALIGNMENT_FLOAT64_IEEE 8 /end MOD_COMMON
/begin CHARACTERISTIC K_DATENKENNUNG_1 "Datenkennsatzkennung Nr. 1" VAL_BLK 0x70262 TKW_VV_VV_UB 100.0 FORMULA_0419 0.0 255.0 NUMBER 5 /end CHARACTERISTIC
/begin CHARACTERISTIC K_DATENKENNUNG_2 "Datenkennsatzkennung Nr. 2" VAL_BLK 0x70273 TKW_VV_VV_UB 100.0 FORMULA_0419 0.0 255.0 NUMBER 5 /end CHARACTERISTIC
/begin CHARACTERISTIC K_DATENKENNUNG_3 "Datenkennsatzkennung Nr. 3" VAL_BLK 0x70284 TKW_VV_VV_UB 100.0 FORMULA_0419 0.0 255.0 NUMBER 5 /end CHARACTERISTIC
/begin CHARACTERISTIC K_NW_CONFIG "Konfigurationsparameter fuer NW-Synchronisation" VALUE 0x74F7A TKW_VV_VV_UB 100.0 FORMULA_0992 0.0 255.0 /end CHARACTERISTIC
/begin CHARACTERISTIC K_NW_IO "Anzahl NW-Impulse fuer erneute NW-Synchronisation" VALUE 0x74F7B TKW_VV_VV_UB 100.0 FORMULA_0003 0.0 255.0 /end CHARACTERISTIC
/begin CHARACTERISTIC K_NW_IO_ASP "nach x korrekten Arbeitsspielen kein Rueckschalten in 360°-Mode" VALUE 0x74F84 TKW_VV_VV_UW 100.0 FORMULA_0010 2.0 65535.0 /end CHARACTERISTIC
/begin CHARACTERISTIC K_NW_MFMAX "Obergrenze NW-Messfenster" VAL_BLK 0x74F7F TKW_VV_VV_UB 100.0 FORMULA_0003 0.0 255.0 NUMBER 2 /end CHARACTERISTIC
/begin CHARACTERISTIC K_NW_MFMIN "Untergrenze NW-Messfenster" VAL_BLK 0x74F7D TKW_VV_VV_UB 100.0 FORMULA_0003 0.0 255.0 NUMBER 2 /end CHARACTERISTIC
/begin CHARACTERISTIC K_NW_NIO "Schwelle fehlende/falsche NW-Impulse fuer NW-Desynchronisation" VALUE 0x74F81 TKW_VV_VV_UB 100.0 FORMULA_0003 0.0 255.0 /end CHARACTERISTIC
/begin CHARACTERISTIC K_NW_NIO_INC "Inkremente fuer NW-Fehlerzaehler" VALUE 0x74F82 TKW_VV_VV_UB 100.0 FORMULA_0003 0.0 255.0 /end CHARACTERISTIC
/begin CHARACTERISTIC K_NW_SYNC_ION_IO "Anzahl guter Verbrennungen fuer NW-Synchronisation ueber Ionenstrom" VALUE 0x74F7C TKW_VV_VV_UB 100.0 FORMULA_0003 0.0 255.0 /end CHARACTERISTIC
/begin CHARACTERISTIC K_PUMG_AEBEGR "Gradientenschwelle Sensorerfassung" VALUE 0x76306 TKW_VV_VV_UW 100.0 FORMULA_1051 0.0 40959.375 FORMAT "%4.1" /end CHARACTERISTIC
/begin CHARACTERISTIC K_PUMG_DIAG_MAX "Obere Grenze Umgebungsdruck" VALUE 0x762FE TKW_VV_VV_SW 100.0 FORMULA_0971 400.0 1200.0 /end CHARACTERISTIC
/begin CHARACTERISTIC K_PUMG_DIAG_MIN "Unter Grenze Umgebungsdruck" VALUE 0x762FC TKW_VV_VV_SW 100.0 FORMULA_0971 400.0 1200.0 /end CHARACTERISTIC
/begin CHARACTERISTIC K_PUMG_ERSATZ "Ersatzwert Umgebungsdruck" VALUE 0x76300 TKW_VV_VV_SW 100.0 FORMULA_0971 400.0 1200.0 /end CHARACTERISTIC
/begin CHARACTERISTIC K_PUMG_MAX_E2 "max. Umgebungsdruck" VALUE 0x79CC0 TKW_VV_VV_SW 100.0 FORMULA_0075 400.0 1350.0 FORMAT "%4.1" /end CHARACTERISTIC
/begin CHARACTERISTIC K_PUMG_MAX_NEG_GRAD_E2 "Gradientenschwelle Ebene 2" VALUE 0x79CC2 TKW_VV_VV_SW 100.0 FORMULA_1051 -20480.0 0.0 FORMAT "%4.1" /end CHARACTERISTIC
/begin CHARACTERISTIC K_PUMG_MAX_POS_GRAD_E2 "Gradientenschwelle Ebene 2" VALUE 0x79CC4 TKW_VV_VV_SW 100.0 FORMULA_1051 0.0 20479.375 FORMAT "%4.1" /end CHARACTERISTIC
/begin CHARACTERISTIC K_PUMG_MIN_E2 "min. Umgebungsdruck" VALUE 0x79CBE TKW_VV_VV_SW 100.0 FORMULA_0075 250.0 1200.0 FORMAT "%4.1" /end CHARACTERISTIC
/begin CHARACTERISTIC K_PUMG_OBD_ABW "max. zulaessige Abweichung von pumg zu pumg-Filterwert" VALUE 0x76310 TKW_VV_VV_SW 100.0 FORMULA_1053 0.0 1000.0 FORMAT "%5.2" /end CHARACTERISTIC
/begin CHARACTERISTIC K_PUMG_OBD_CFG "Schalter Funktion - Ausgang" VALUE 0x76318 TKW_VV_VV_UB 100.0 FORMULA_1054 0.0 255.0 /end CHARACTERISTIC
/begin CHARACTERISTIC K_PUMG_OBD_FPLAU_ABW_MAX "tolerierte fplau-Abweichung bei pumg-Modellberechnung" VALUE 0x7632A TKW_VV_VV_SW 100.0 FORMULA_0706 -200.0 200.0 FORMAT "%4.1" /end CHARACTERISTIC
/begin CHARACTERISTIC K_PUMG_OBD_FPLAU_ABW_MAX_T "tolerierte Zeit der fplau-Abweichung" VALUE 0x7632C TKW_VV_VV_UW 100.0 FORMULA_0071 0.0 6553.5 FORMAT "%4.1" /end CHARACTERISTIC
/begin CHARACTERISTIC K_PUMG_OBD_MIN_MESS "Mindestanzahl Modellwerte bei VL fuer Integralbildung" VALUE 0x76316 TKW_VV_VV_UW 100.0 FORMULA_0010 0.0 65535.0 /end CHARACTERISTIC
/begin CHARACTERISTIC K_PUMG_OBD_ML_MS "Zeitdauer von ZUST_ML nach ZUST_MS_A fuer Init" VALUE 0x76328 TKW_VV_VV_UB 100.0 FORMULA_1056 0.0 4.25 /end CHARACTERISTIC
/begin CHARACTERISTIC K_PUMG_OBD_MODEL_DELTA_MAX "max. zulaessige pumg-Modellwertabweichung" VALUE 0x76314 TKW_VV_VV_SW 100.0 FORMULA_0075 0.0 200.0 FORMAT "%4.1" /end CHARACTERISTIC
/begin CHARACTERISTIC K_PUMG_OBD_N_MAX "N-Max-Begrenzung pumg-Modellbewertung" VALUE 0x7631A TKW_VV_VV_SW 100.0 FORMULA_0006 0.0 10000.0 /end CHARACTERISTIC
/begin CHARACTERISTIC K_PUMG_OBD_N_MIN "Mindest-N fuer pumg-Modellbewertung" VALUE 0x7631C TKW_VV_VV_SW 100.0 FORMULA_0006 0.0 10000.0 /end CHARACTERISTIC
/begin CHARACTERISTIC K_PUMG_OBD_PUMG_TAU "Zeitkonstante fuer pumg-Filterwert Gradienten-Check" VALUE 0x7630A TKW_VV_VV_UW 100.0 FORMULA_1052 0.1000000014901161 6553.5 FORMAT "%5.2" /end CHARACTERISTIC
/begin CHARACTERISTIC K_PUMG_OBD_PWG_MIN "Mindest-pwg_soll fuer pumg-Modellbewertung" VALUE 0x76320 TKW_VV_VV_SW 100.0 FORMULA_0001 -10.0 120.0 FORMAT "%4.1" /end CHARACTERISTIC
/begin CHARACTERISTIC K_PUMG_OBD_TAN_MAX "Hoechst-tan fuer pumg-Modellbewertung" VALUE 0x76324 TKW_VV_VV_SW 100.0 FORMULA_0023 -50.0 170.0 FORMAT "%4.1" /end CHARACTERISTIC
/begin CHARACTERISTIC K_PUMG_OBD_TAN_MIN "Mindest-tan fuer pumg-Modellbewertung" VALUE 0x76326 TKW_VV_VV_SW 100.0 FORMULA_0023 -50.0 170.0 FORMAT "%4.1" /end CHARACTERISTIC
/begin CHARACTERISTIC K_PUMG_OBD_TIME_ML_MIN "Mindest-time_ml fuer Gradienten- bzw. Modellueberw." VALUE 0x7630C TKW_VV_VV_UL 100.0 FORMULA_0147 0.0 655.0 FORMAT "%5.2" /end CHARACTERISTIC
/begin CHARACTERISTIC K_PUMG_OBD_TUMG_MIN "Mindest-tumg fuer pumg-Modellbewertung" VALUE 0x7631E TKW_VV_VV_SW 100.0 FORMULA_0023 -50.0 170.0 FORMAT "%4.1" /end CHARACTERISTIC
/begin CHARACTERISTIC K_PUMG_OBD_V_MAX "v-max-Begrenzung fuer pumg-Modellbewertung" VALUE 0x76322 TKW_VV_VV_SW 100.0 FORMULA_0076 -80.0 360.0 FORMAT "%4.1" /end CHARACTERISTIC
/begin CHARACTERISTIC K_PUMG_OBD_ZV_DELTA_MAX "max. Umgebungsdruckdifferenz von Stop bis Start" VALUE 0x76312 TKW_VV_VV_SW 100.0 FORMULA_0075 0.0 200.0 FORMAT "%4.1" /end CHARACTERISTIC
/begin CHARACTERISTIC K_PUMG_RBM_HEILUNG_CFG "Schalter RBM Heilung bei PUMG_OBD_IO_ZYKLUSVERGLEICH" VALUE 0x76319 TKW_VV_VV_UB 100.0 FORMULA_1055 0.0 255.0 /end CHARACTERISTIC
/begin CHARACTERISTIC K_PUMG_SENSOR_OFFSET "Offset des Drucksensors" VALUE 0x76304 TKW_VV_VV_SW 100.0 FORMULA_0973 0.0 625.0 FORMAT "%6.3" /end CHARACTERISTIC
/begin CHARACTERISTIC K_PUMG_SENSOR_STEIGUNG "Steigung des Drucksensors" VALUE 0x76302 TKW_VV_VV_UW 100.0 FORMULA_0975 0.0 275.0 FORMAT "%6.3" /end CHARACTERISTIC
/begin CHARACTERISTIC K_PUMG_TAU "Filterkonstante fuer die Umgebungsdruckerfassung" VALUE 0x76308 TKW_VV_VV_UB 100.0 FORMULA_0679 0.1004000008106232 25.60000038146973 /end CHARACTERISTIC
/begin CHARACTERISTIC K_TANZYL_CFG "Definition der Quelle und Ausgabe von tanzyl" VALUE 0x770F4 TKW_VV_VV_UB 100.0 FORMULA_1123 0.0 255.0 /end CHARACTERISTIC
/begin CHARACTERISTIC K_TANZYL_MR_TAU "Filterkonstante fuer Motorraumtemperatur" VALUE 0x770F6 TKW_VV_VV_UW 100.0 FORMULA_1052 0.1000000014901161 6553.5 FORMAT "%5.2" /end CHARACTERISTIC
/begin CHARACTERISTIC K_TKSM_CFG "Definition der Quelle von tksm" VALUE 0x788AC TKW_VV_VV_UB 100.0 FORMULA_1199 0.0 255.0 /end CHARACTERISTIC
/begin CHARACTERISTIC K_TKSM_MR_TAU "Filterkonstante fuer Motorraumtemperatur" VALUE 0x788AE TKW_VV_VV_UW 100.0 FORMULA_1052 0.1000000014901161 6553.5 FORMAT "%5.2" /end CHARACTERISTIC
/begin CHARACTERISTIC K_TPU_KW_N_MIN "Unterdrehzahl." VALUE 0x78932 TKW_VV_VV_UW 100.0 FORMULA_0418 4.0 10000.0 /end CHARACTERISTIC
/begin CHARACTERISTIC K_TPU_KW_SYNC_ZAHN "KW Interruptzahn zur NW Sync." VALUE 0x78934 TKW_VV_VV_UB 100.0 FORMULA_0003 0.0 59.0 /end CHARACTERISTIC
/begin CHARACTERISTIC K_TZ_DIAG_MAX_BESTR "Schwelle fuer Fehlereintrag" VALUE 0x78935 TKW_VV_VV_UB 100.0 FORMULA_1200 0.0 255.0 /end CHARACTERISTIC
/begin CHARACTERISTIC K_VAN_ANSCHL_DELTA "Abstand Soll-Anschlag " VALUE 0x78986 TKW_VV_VV_SW 100.0 FORMULA_0102 -80.0 80.0 FORMAT "%4.1" /end CHARACTERISTIC
/begin CHARACTERISTIC K_VAN_ANSCHL_HYS "Hysterese Anschlag anfahren" VALUE 0x78988 TKW_VV_VV_SW 100.0 FORMULA_0102 -80.0 80.0 FORMAT "%4.1" /end CHARACTERISTIC
/begin CHARACTERISTIC K_VAN_ANSCHL_I_A1 "Ventilstrom am Anschlag max. Spr." VALUE 0x7898C TKW_VV_VV_SW 100.0 FORMULA_1207 -1000.0 3000.0 /end CHARACTERISTIC
/begin CHARACTERISTIC K_VAN_ANSCHL_I_A2 "Ventilstrom am Anschlag max. Spr." VALUE 0x78990 TKW_VV_VV_SW 100.0 FORMULA_1207 -1000.0 3000.0 /end CHARACTERISTIC
/begin CHARACTERISTIC K_VAN_ANSCHL_I_E1 "Ventilstrom am Anschlag max. Spr." VALUE 0x7898A TKW_VV_VV_SW 100.0 FORMULA_1207 -1000.0 3000.0 /end CHARACTERISTIC
/begin CHARACTERISTIC K_VAN_ANSCHL_I_E2 "Ventilstrom am Anschlag max. Spr." VALUE 0x7898E TKW_VV_VV_SW 100.0 FORMULA_1207 -1000.0 3000.0 /end CHARACTERISTIC
/begin CHARACTERISTIC K_VAN_ANSCHL_I_RAMPE "Strom-Rampe zum Anschlag anfahren" VALUE 0x78992 TKW_VV_VV_SW 100.0 FORMULA_1219 -1000.0 3000.0 /end CHARACTERISTIC
/begin CHARACTERISTIC K_VAN_ANSCHL_I_START_MAX "Max. Strom Beginn Anschlag anfahren" VALUE 0x78994 TKW_VV_VV_SW 100.0 FORMULA_1207 -1000.0 3000.0 /end CHARACTERISTIC
/begin CHARACTERISTIC K_VAN_ANSCHL_T "Dauer Anschlag lernen" VALUE 0x78996 TKW_VV_VV_UB 100.0 FORMULA_0306 0.0 2.549999952316284 /end CHARACTERISTIC
/begin CHARACTERISTIC K_VAN_BEGR_AB_FAKT_E "Abregelzeit Min-Begrenzung" VALUE 0x78997 TKW_VV_VV_UB 100.0 FORMULA_1220 164.0 0.6431000232696533 /end CHARACTERISTIC
/begin CHARACTERISTIC K_VAN_CFG_A1 "Konfig Vanos Steller/Geberrad" VALUE 0x78999 TKW_VV_VV_UB 100.0 FORMULA_1221 0.0 255.0 /end CHARACTERISTIC
/begin CHARACTERISTIC K_VAN_CFG_A2 "Konfig Vanos Steller/Geberrad" VALUE 0x7899B TKW_VV_VV_UB 100.0 FORMULA_1221 0.0 255.0 /end CHARACTERISTIC
/begin CHARACTERISTIC K_VAN_CFG_E1 "Konfig Vanos Steller/Geberrad" VALUE 0x78998 TKW_VV_VV_UB 100.0 FORMULA_1221 0.0 255.0 /end CHARACTERISTIC
/begin CHARACTERISTIC K_VAN_CFG_E2 "Konfig Vanos Steller/Geberrad" VALUE 0x7899A TKW_VV_VV_UB 100.0 FORMULA_1221 0.0 255.0 /end CHARACTERISTIC
/begin CHARACTERISTIC K_VAN_D_XD_TAU_Auslass "Gradient Regelabweichung Filterzeit" VALUE 0x789A4 TKW_VV_VV_UB 100.0 FORMULA_0658 1.009999960660934e-002 2.559999942779541 /end CHARACTERISTIC
/begin CHARACTERISTIC K_VAN_D_XD_TAU_Einlass "Gradient Regelabweichung Filterzeit" VALUE 0x789A3 TKW_VV_VV_UB 100.0 FORMULA_0658 1.009999960660934e-002 2.559999942779541 /end CHARACTERISTIC
/begin CHARACTERISTIC K_VAN_DRUCK_CNT "Anzahl Frühverstellungen Druckerk." VALUE 0x789A2 TKW_VV_VV_UB 100.0 FORMULA_0003 0.0 10.0 /end CHARACTERISTIC
/begin CHARACTERISTIC K_VAN_DRUCK_SOLL_OFFSET_E "Soll-Offset auf van_druck_start_e" VALUE 0x789A0 TKW_VV_VV_SW 100.0 FORMULA_0102 -80.0 80.0 FORMAT "%4.1" /end CHARACTERISTIC
/begin CHARACTERISTIC K_VAN_DRUCK_VERSTELL_E "min. Frühverstellung Druckerkennung" VALUE 0x7899E TKW_VV_VV_SW 100.0 FORMULA_0102 -80.0 80.0 FORMAT "%4.1" /end CHARACTERISTIC
/begin CHARACTERISTIC K_VAN_DSV_ABFALL_DLY "Abfalldauer Druckspeicherventil" VALUE 0x78962 TKW_VV_VV_UB 100.0 FORMULA_0461 0.0 25.5 /end CHARACTERISTIC
/begin CHARACTERISTIC K_VAN_DSV_CFG "Konfig Vanos Druckspeicherventil" VALUE 0x78963 TKW_VV_VV_UB 100.0 FORMULA_1236 0.0 255.0 /end CHARACTERISTIC
/begin CHARACTERISTIC K_VAN_DSV_N_AUS "Ausschaltschwelle DSV im Start" VALUE 0x78964 TKW_VV_VV_SW 100.0 FORMULA_0006 0.0 10000.0 /end CHARACTERISTIC
/begin CHARACTERISTIC K_VAN_DSV_N_EIN "Einschaltschwelle DSV im Start" VALUE 0x78966 TKW_VV_VV_SW 100.0 FORMULA_0006 0.0 10000.0 /end CHARACTERISTIC
/begin CHARACTERISTIC K_VAN_DSV_PEAK_TIME "Anzugszeit DSV" VALUE 0x78968 TKW_VV_VV_UB 100.0 FORMULA_0461 0.0 25.5 /end CHARACTERISTIC
/begin CHARACTERISTIC K_VAN_ERR_CFG "Ersatz-Sollwert bei Fehler" VALUE 0x7899C TKW_VV_VV_UB 100.0 FORMULA_1222 0.0 255.0 /end CHARACTERISTIC
/begin CHARACTERISTIC K_VAN_EXD_GUETE_TAU "Ventilguete Aenderung pro Messung" VALUE 0x789BA TKW_VV_VV_UB 100.0 FORMULA_1223 0.0 0.9959999918937683 /end CHARACTERISTIC
/begin CHARACTERISTIC K_VAN_EXD_I_MAX_Auslass "Prüflauf Ventilstrom max. Spr." VALUE 0x789A8 TKW_VV_VV_SW 100.0 FORMULA_1207 -1000.0 3000.0 /end CHARACTERISTIC
/begin CHARACTERISTIC K_VAN_EXD_I_MAX_Einlass "Prüflauf Ventilstrom max. Spr." VALUE 0x789A6 TKW_VV_VV_SW 100.0 FORMULA_1207 -1000.0 3000.0 /end CHARACTERISTIC
/begin CHARACTERISTIC K_VAN_EXD_I_MIN_Auslass "Prüflauf Ventilstrom min. Spr." VALUE 0x789AC TKW_VV_VV_SW 100.0 FORMULA_1207 -1000.0 3000.0 /end CHARACTERISTIC
/begin CHARACTERISTIC K_VAN_EXD_I_MIN_Einlass "Prüflauf Ventilstrom min. Spr." VALUE 0x789AA TKW_VV_VV_SW 100.0 FORMULA_1207 -1000.0 3000.0 /end CHARACTERISTIC
/begin CHARACTERISTIC K_VAN_EXD_N_SOLL "Van Prueflauf LLR-Sollwert" VALUE 0x789AE TKW_VV_VV_SW 100.0 FORMULA_0006 0.0 10000.0 /end CHARACTERISTIC
/begin CHARACTERISTIC K_VAN_EXD_SPR_MAX_MIN_Auslass "kleinste gelernte MaxSpr für min-Prüfen" VALUE 0x789B2 TKW_VV_VV_SW 100.0 FORMULA_0102 50.0 160.0 FORMAT "%4.1" /end CHARACTERISTIC
/begin CHARACTERISTIC K_VAN_EXD_SPR_MAX_MIN_Einlass "kleinste gelernte MaxSpr für min-Prüfen" VALUE 0x789B0 TKW_VV_VV_SW 100.0 FORMULA_0102 50.0 160.0 FORMAT "%4.1" /end CHARACTERISTIC
/begin CHARACTERISTIC K_VAN_EXD_T_ANSCHL "Dauer Anschlag prüfen" VALUE 0x789B4 TKW_VV_VV_UB 100.0 FORMULA_0306 0.0 2.549999952316284 /end CHARACTERISTIC
/begin CHARACTERISTIC K_VAN_EXD_T_GUETE "Dauer Ventil-Guete messen" VALUE 0x789B6 TKW_VV_VV_UW 100.0 FORMULA_0021 0.0 655.0 FORMAT "%5.2" /end CHARACTERISTIC
/begin CHARACTERISTIC K_VAN_EXD_TMOT_MIN "Min. Temp.für Prüflauf" VALUE 0x789B8 TKW_VV_VV_SW 100.0 FORMULA_0023 -50.0 170.0 FORMAT "%4.1" /end CHARACTERISTIC
/begin CHARACTERISTIC K_VAN_EXD_VERST_SOLL_MAX_Auslass "grosse Spr bei Verstellzeitmessung" VALUE 0x789BE TKW_VV_VV_SW 100.0 FORMULA_0102 50.0 160.0 FORMAT "%4.1" /end CHARACTERISTIC
/begin CHARACTERISTIC K_VAN_EXD_VERST_SOLL_MAX_Einlass "grosse Spr bei Verstellzeitmessung" VALUE 0x789BC TKW_VV_VV_SW 100.0 FORMULA_0102 50.0 160.0 FORMAT "%4.1" /end CHARACTERISTIC
/begin CHARACTERISTIC K_VAN_EXD_VERST_SOLL_MIN_Auslass "kleine Spr bei Verstellzeitmessung" VALUE 0x789C2 TKW_VV_VV_SW 100.0 FORMULA_0102 50.0 160.0 FORMAT "%4.1" /end CHARACTERISTIC
/begin CHARACTERISTIC K_VAN_EXD_VERST_SOLL_MIN_Einlass "kleine Spr bei Verstellzeitmessung" VALUE 0x789C0 TKW_VV_VV_SW 100.0 FORMULA_0102 50.0 160.0 FORMAT "%4.1" /end CHARACTERISTIC
/begin CHARACTERISTIC K_VAN_EXD_VERST_TMAX "Timeout Verstellzeitmessung" VALUE 0x789C4 TKW_VV_VV_UB 100.0 FORMULA_0306 0.0 2.549999952316284 /end CHARACTERISTIC
/begin CHARACTERISTIC K_VAN_EXD_VERST_TOL "Abweichung Verstellmessung Ende" VALUE 0x789C6 TKW_VV_VV_SW 100.0 FORMULA_0102 -80.0 80.0 FORMAT "%4.1" /end CHARACTERISTIC
/begin CHARACTERISTIC K_VAN_EXD_VERST_TOL_START "Abweichung Verstellmessung Start" VALUE 0x789C8 TKW_VV_VV_SW 100.0 FORMULA_0102 -80.0 80.0 FORMAT "%4.1" /end CHARACTERISTIC
/begin CHARACTERISTIC K_VAN_FILTR_AMPL "Amplitude Sollwertwackeln gegen Filtration" VALUE 0x789CA TKW_VV_VV_SW 100.0 FORMULA_0102 -80.0 80.0 FORMAT "%4.1" /end CHARACTERISTIC
/begin CHARACTERISTIC K_VAN_FILTR_DAUER "max. Dauer ohne Sollaenderung" VALUE 0x789CC TKW_VV_VV_UW 100.0 FORMULA_0071 0.0 6553.5 FORMAT "%4.1" /end CHARACTERISTIC
/begin CHARACTERISTIC K_VAN_FILTR_PERIOD "Periodendauer eines Wackelzyklus" VALUE 0x789CE TKW_VV_VV_UB 100.0 FORMULA_0461 0.0 25.5 /end CHARACTERISTIC
/begin CHARACTERISTIC K_VAN_FILTR_SOLL_DELTA "Max. Sollwert-Änderung ohne Filtration" VALUE 0x789D0 TKW_VV_VV_SW 100.0 FORMULA_0102 -80.0 80.0 FORMAT "%4.1" /end CHARACTERISTIC
/begin CHARACTERISTIC K_VAN_FILTR_T_ML_MIN "Min. Motorlaufzeit für Filtrationsoffset" VALUE 0x789D2 TKW_VV_VV_UW 100.0 FORMULA_0021 0.0 655.0 FORMAT "%5.2" /end CHARACTERISTIC
/begin CHARACTERISTIC K_VAN_FILTR_TV_PRUEF "Pruefzeitpunkt Filtrationserkennung" VALUE 0x789D4 TKW_VV_VV_UB 100.0 FORMULA_1224 0.0 99.60929870605469 /end CHARACTERISTIC
/begin CHARACTERISTIC K_VAN_FREQU_ANSCHL "PWM-Frequenz Ventile am Anschlag" VALUE 0x789E6 TKW_VV_VV_UW 100.0 FORMULA_1202 16.0 400.0 FORMAT "%4.1" /end CHARACTERISTIC
/begin CHARACTERISTIC K_VAN_FREQU_SPUEL_MIN "min. PWM-Frequenz Ventile spuelen" VALUE 0x789E2 TKW_VV_VV_UW 100.0 FORMULA_1202 16.0 400.0 FORMAT "%4.1" /end CHARACTERISTIC
/begin CHARACTERISTIC K_VAN_FREQU_STAND "PWM-Frequenz Ventile Motor steht" VALUE 0x789E4 TKW_VV_VV_UW 100.0 FORMULA_1202 16.0 400.0 FORMAT "%4.1" /end CHARACTERISTIC
/begin CHARACTERISTIC K_VAN_FREQU_WICHT "Wichtung Ventilguete PWM-Frequenz" VALUE 0x789E8 TKW_VV_VV_UB 100.0 FORMULA_0638 0.0 1.99210000038147 /end CHARACTERISTIC
/begin CHARACTERISTIC K_VAN_GUETE_CFG "Auswahl Ventilgueteberechnung" VALUE 0x789D5 TKW_VV_VV_UB 100.0 FORMULA_1225 0.0 255.0 /end CHARACTERISTIC
/begin CHARACTERISTIC K_VAN_GUETE_DAUER "Dauer Ventilgueteadaption" VALUE 0x789D6 TKW_VV_VV_UW 100.0 FORMULA_0071 0.0 6553.5 FORMAT "%4.1" /end CHARACTERISTIC
/begin CHARACTERISTIC K_VAN_GUETE_INIT "Ruecksetz-Wert der Ventilguete" VALUE 0x789D8 TKW_VV_VV_UW 100.0 FORMULA_0024 0.0 1.999899983406067 FORMAT "%7.4" /end CHARACTERISTIC
/begin CHARACTERISTIC K_VAN_GUETE_PAUSE "Pause zwischen Ventilgueteadaption" VALUE 0x789DA TKW_VV_VV_UW 100.0 FORMULA_1206 0.0 109.0 FORMAT "%4.1" /end CHARACTERISTIC
/begin CHARACTERISTIC K_VAN_GUETE_RESET "Pumpen-Pauli's INCA-RESET Knopf" VALUE 0x789DC TKW_VV_VV_UB 100.0 FORMULA_1226 0.0 255.0 /end CHARACTERISTIC
/begin CHARACTERISTIC K_VAN_GUETE_RESET_MIN "Min. zulaessige Guete ohne Reset" VALUE 0x789DE TKW_VV_VV_UW 100.0 FORMULA_0024 0.0 1.999899983406067 FORMAT "%7.4" /end CHARACTERISTIC
/begin CHARACTERISTIC K_VAN_GUETE_RESET_ZEIT "Dauer schlechter Ventilguete bis Reset" VALUE 0x789E0 TKW_VV_VV_UW 100.0 FORMULA_0071 0.0 6553.5 FORMAT "%4.1" /end CHARACTERISTIC
/begin CHARACTERISTIC K_VAN_GUETE_TAU "Ventilguete Aenderung pro Messung" VALUE 0x789E9 TKW_VV_VV_UB 100.0 FORMULA_1223 0.0 0.9959999918937683 /end CHARACTERISTIC
/begin CHARACTERISTIC K_VAN_GUETE_TMOT "Minimaltemp fuer Gueteberechnung" VALUE 0x789EA TKW_VV_VV_SW 100.0 FORMULA_0023 -50.0 170.0 FORMAT "%4.1" /end CHARACTERISTIC
/begin CHARACTERISTIC K_VAN_GUETE_TOEL "Minimaltemp fuer Gueteberechnung" VALUE 0x789EC TKW_VV_VV_SW 100.0 FORMULA_0023 -50.0 170.0 FORMAT "%4.1" /end CHARACTERISTIC
/begin CHARACTERISTIC K_VAN_I_I_MAX "Regler I Anteil Maxwert" VALUE 0x789EE TKW_VV_VV_SW 100.0 FORMULA_1207 -1000.0 3000.0 /end CHARACTERISTIC
/begin CHARACTERISTIC K_VAN_I_I_MIN "Regler I Anteil Minwert" VALUE 0x789F0 TKW_VV_VV_SW 100.0 FORMULA_1207 -1000.0 3000.0 /end CHARACTERISTIC
/begin CHARACTERISTIC K_VAN_I_MAX "Ventilstrom Maxwert" VALUE 0x789F2 TKW_VV_VV_SW 100.0 FORMULA_1207 -1000.0 3000.0 /end CHARACTERISTIC
/begin CHARACTERISTIC K_VAN_INVERT_A1 "Norm: Stromlos => max.Spr" VALUE 0x789F7 TKW_VV_VV_UB 100.0 FORMULA_1227 0.0 255.0 /end CHARACTERISTIC
/begin CHARACTERISTIC K_VAN_INVERT_A2 "Norm: Stromlos => max.Spr" VALUE 0x789F9 TKW_VV_VV_UB 100.0 FORMULA_1227 0.0 255.0 /end CHARACTERISTIC
/begin CHARACTERISTIC K_VAN_INVERT_E1 "Norm: Stromlos => max.Spr" VALUE 0x789F6 TKW_VV_VV_UB 100.0 FORMULA_1227 0.0 255.0 /end CHARACTERISTIC
/begin CHARACTERISTIC K_VAN_INVERT_E2 "Norm: Stromlos => max.Spr" VALUE 0x789F8 TKW_VV_VV_UB 100.0 FORMULA_1227 0.0 255.0 /end CHARACTERISTIC
/begin CHARACTERISTIC K_VAN_KP_XD_KORR_Auslass "Korrektur van_i_p bei xd<0" VALUE 0x789FF TKW_VV_VV_UB 100.0 FORMULA_0638 0.0 1.99210000038147 /end CHARACTERISTIC
/begin CHARACTERISTIC K_VAN_KP_XD_KORR_Einlass "Korrektur van_i_p bei xd<0" VALUE 0x789FE TKW_VV_VV_UB 100.0 FORMULA_0638 0.0 1.99210000038147 /end CHARACTERISTIC
/begin CHARACTERISTIC K_VAN_KW_SPR_MAX_A1 "KW-Zahn bei max Spreizung" VALUE 0x789FB TKW_VV_VV_SB 100.0 FORMULA_1228 -60.0 60.0 /end CHARACTERISTIC
/begin CHARACTERISTIC K_VAN_KW_SPR_MAX_A2 "KW-Zahn bei max Spreizung" VALUE 0x789FD TKW_VV_VV_SB 100.0 FORMULA_1228 -60.0 60.0 /end CHARACTERISTIC
/begin CHARACTERISTIC K_VAN_KW_SPR_MAX_E1 "KW-Zahn bei max Spreizung" VALUE 0x789FA TKW_VV_VV_SB 100.0 FORMULA_1228 -60.0 60.0 /end CHARACTERISTIC
/begin CHARACTERISTIC K_VAN_KW_SPR_MAX_E2 "KW-Zahn bei max Spreizung" VALUE 0x789FC TKW_VV_VV_SB 100.0 FORMULA_1228 -60.0 60.0 /end CHARACTERISTIC
/begin CHARACTERISTIC K_VAN_N_OFF "VanosRegler Abschaltdrehzahl" VALUE 0x78A04 TKW_VV_VV_SW 100.0 FORMULA_0006 0.0 10000.0 /end CHARACTERISTIC
/begin CHARACTERISTIC K_VAN_N_OFFSET_MAX_A "AVanos n korr tabg max" VALUE 0x78A00 TKW_VV_VV_SW 100.0 FORMULA_0006 0.0 10000.0 /end CHARACTERISTIC
/begin CHARACTERISTIC K_VAN_N_OFFSET_MIN_A "AVanos n korr tabg min" VALUE 0x78A02 TKW_VV_VV_SW 100.0 FORMULA_0006 0.0 10000.0 /end CHARACTERISTIC
/begin CHARACTERISTIC K_VAN_N_ON "VanosRegler Einschaltdrehzahl" VALUE 0x78A06 TKW_VV_VV_SW 100.0 FORMULA_0006 0.0 10000.0 /end CHARACTERISTIC
/begin CHARACTERISTIC K_VAN_R_TK "Temperaturkoeffizient Spulenwiderstand" VALUE 0x78A0E TKW_VV_VV_SW 100.0 FORMULA_1231 0.0 327.6700134277344 FORMAT "%5.2" /end CHARACTERISTIC
/begin CHARACTERISTIC K_VAN_R20 "Spulenwiderstand bei 20Grad" VALUE 0x78A0C TKW_VV_VV_SW 100.0 FORMULA_1212 -32.76800155639648 32.76699829101563 FORMAT "%6.3" /end CHARACTERISTIC
/begin CHARACTERISTIC K_VAN_RAD_CFG "Auslass-Geberrad Geometrie" VALUE 0x78A08 TKW_VV_VV_UB 100.0 FORMULA_1229 0.0 255.0 /end CHARACTERISTIC
/begin CHARACTERISTIC K_VAN_RAD_MAX "max. Anzahl NW-Zaehne" VALUE 0x78A0A TKW_VV_VV_UB 100.0 FORMULA_1230 0.0 255.0 /end CHARACTERISTIC
/begin CHARACTERISTIC K_VAN_RAD_MIN "min. Anzahl NW-Zaehne" VALUE 0x78A09 TKW_VV_VV_UB 100.0 FORMULA_1230 0.0 255.0 /end CHARACTERISTIC
/begin CHARACTERISTIC K_VAN_SMG_DAUER_MAX "max. SMG-Schaltungsdauer" VALUE 0x78A1A TKW_VV_VV_UB 100.0 FORMULA_0306 0.0 2.549999952316284 /end CHARACTERISTIC
/begin CHARACTERISTIC K_VAN_SMG_DR_REL "vorgest. dr_rel bei SMG-Schaltung" VALUE 0x78A18 TKW_VV_VV_SW 100.0 FORMULA_0106 0.0 199.9938049316406 FORMAT "%5.2" /end CHARACTERISTIC
/begin CHARACTERISTIC K_VAN_SMG_MD_ABBR "Abbruch-Wunschmoment SMG-Schaltung" VALUE 0x78A12 TKW_VV_VV_SW 100.0 FORMULA_0001 0.0 100.0 FORMAT "%4.1" /end CHARACTERISTIC
/begin CHARACTERISTIC K_VAN_SMG_MD_MIN "Min. Wunschmoment SMG-Schaltung" VALUE 0x78A10 TKW_VV_VV_SW 100.0 FORMULA_0001 0.0 100.0 FORMAT "%4.1" /end CHARACTERISTIC
/begin CHARACTERISTIC K_VAN_SMG_N_ABBR "Abbruch Zieldrehzahl SMG-Schaltung" VALUE 0x78A16 TKW_VV_VV_SW 100.0 FORMULA_0006 0.0 10000.0 /end CHARACTERISTIC
/begin CHARACTERISTIC K_VAN_SMG_N_MIN "min. Zieldrehzahl SMG-Schaltung" VALUE 0x78A14 TKW_VV_VV_SW 100.0 FORMULA_0006 0.0 10000.0 /end CHARACTERISTIC
/begin CHARACTERISTIC K_VAN_SMG_T_AUFREG "max. Aufregelzeit der Kupplung" VALUE 0x78A1B TKW_VV_VV_UB 100.0 FORMULA_0306 0.0 2.549999952316284 /end CHARACTERISTIC
/begin CHARACTERISTIC K_VAN_SOLL_ABSTELL_Auslass "Sollpos nach KL15 aus" VALUE 0x78A20 TKW_VV_VV_SW 100.0 FORMULA_0102 50.0 160.0 FORMAT "%4.1" /end CHARACTERISTIC
/begin CHARACTERISTIC K_VAN_SOLL_ABSTELL_Einlass "Sollpos nach KL15 aus" VALUE 0x78A1E TKW_VV_VV_SW 100.0 FORMULA_0102 50.0 160.0 FORMAT "%4.1" /end CHARACTERISTIC
/begin CHARACTERISTIC K_VAN_SOLL_CFG "Sollwert Eingangsgroesse" VALUE 0x78A1C TKW_VV_VV_UB 100.0 FORMULA_1232 0.0 255.0 /end CHARACTERISTIC
/begin CHARACTERISTIC K_VAN_SOLL_ERSATZ_Auslass "Soll-Ersatzwert" VALUE 0x78A24 TKW_VV_VV_SW 100.0 FORMULA_0102 50.0 160.0 FORMAT "%4.1" /end CHARACTERISTIC
/begin CHARACTERISTIC K_VAN_SOLL_ERSATZ_Einlass "Soll-Ersatzwert" VALUE 0x78A22 TKW_VV_VV_SW 100.0 FORMULA_0102 50.0 160.0 FORMAT "%4.1" /end CHARACTERISTIC
/begin CHARACTERISTIC K_VAN_SOLL_MAX_Auslass "max. Sollwert" VALUE 0x78A28 TKW_VV_VV_SW 100.0 FORMULA_0102 50.0 160.0 FORMAT "%4.1" /end CHARACTERISTIC
/begin CHARACTERISTIC K_VAN_SOLL_MAX_Einlass "max. Sollwert" VALUE 0x78A26 TKW_VV_VV_SW 100.0 FORMULA_0102 50.0 160.0 FORMAT "%4.1" /end CHARACTERISTIC
/begin CHARACTERISTIC K_VAN_SOLL_MIN_Auslass "min. Sollwert" VALUE 0x78A2C TKW_VV_VV_SW 100.0 FORMULA_0102 50.0 160.0 FORMAT "%4.1" /end CHARACTERISTIC
/begin CHARACTERISTIC K_VAN_SOLL_MIN_Einlass "min. Sollwert" VALUE 0x78A2A TKW_VV_VV_SW 100.0 FORMULA_0102 50.0 160.0 FORMAT "%4.1" /end CHARACTERISTIC
/begin CHARACTERISTIC K_VAN_SOLL_OFFSET_Auslass "Sollpositionsoffset" VALUE 0x78A30 TKW_VV_VV_SW 100.0 FORMULA_0102 -80.0 80.0 FORMAT "%4.1" /end CHARACTERISTIC
/begin CHARACTERISTIC K_VAN_SOLL_OFFSET_Einlass "Sollpositionsoffset" VALUE 0x78A2E TKW_VV_VV_SW 100.0 FORMULA_0102 -80.0 80.0 FORMAT "%4.1" /end CHARACTERISTIC
/begin CHARACTERISTIC K_VAN_SPR_MAX_Auslass "Maximale Spreizung am Anschlag" VALUE 0x78A34 TKW_VV_VV_SW 100.0 FORMULA_0102 50.0 160.0 FORMAT "%4.1" /end CHARACTERISTIC
/begin CHARACTERISTIC K_VAN_SPR_MAX_Einlass "Maximale Spreizung am Anschlag" VALUE 0x78A32 TKW_VV_VV_SW 100.0 FORMULA_0102 50.0 160.0 FORMAT "%4.1" /end CHARACTERISTIC
/begin CHARACTERISTIC K_VAN_SPR_MAX_TOL_Auslass "Max. Abweichung Spreizung Anschlag" VALUE 0x78A38 TKW_VV_VV_SW 100.0 FORMULA_0102 -80.0 80.0 FORMAT "%4.1" /end CHARACTERISTIC
/begin CHARACTERISTIC K_VAN_SPR_MAX_TOL_Einlass "Max. Abweichung Spreizung Anschlag" VALUE 0x78A36 TKW_VV_VV_SW 100.0 FORMULA_0102 -80.0 80.0 FORMAT "%4.1" /end CHARACTERISTIC
/begin CHARACTERISTIC K_VAN_SPR_MIN_Auslass "Minimale Spreizung am Anschlag" VALUE 0x78A3C TKW_VV_VV_SW 100.0 FORMULA_0102 50.0 160.0 FORMAT "%4.1" /end CHARACTERISTIC
/begin CHARACTERISTIC K_VAN_SPR_MIN_Einlass "Minimale Spreizung am Anschlag" VALUE 0x78A3A TKW_VV_VV_SW 100.0 FORMULA_0102 50.0 160.0 FORMAT "%4.1" /end CHARACTERISTIC
/begin CHARACTERISTIC K_VAN_SPR_OFFSET_A1 "KW-Zahnflanke zu max Spreizung" VALUE 0x78A40 TKW_VV_VV_SW 100.0 FORMULA_0102 -80.0 80.0 FORMAT "%4.1" /end CHARACTERISTIC
/begin CHARACTERISTIC K_VAN_SPR_OFFSET_A2 "KW-Zahnflanke zu max Spreizung" VALUE 0x78A44 TKW_VV_VV_SW 100.0 FORMULA_0102 -80.0 80.0 FORMAT "%4.1" /end CHARACTERISTIC
/begin CHARACTERISTIC K_VAN_SPR_OFFSET_E1 "KW-Zahnflanke zu max Spreizung" VALUE 0x78A3E TKW_VV_VV_SW 100.0 FORMULA_0102 -80.0 80.0 FORMAT "%4.1" /end CHARACTERISTIC
/begin CHARACTERISTIC K_VAN_SPR_OFFSET_E2 "KW-Zahnflanke zu max Spreizung" VALUE 0x78A42 TKW_VV_VV_SW 100.0 FORMULA_0102 -80.0 80.0 FORMAT "%4.1" /end CHARACTERISTIC
/begin CHARACTERISTIC K_VAN_START_I_MAX_AUSLASS "Ventilstrom im Start " VALUE 0x789F4 TKW_VV_VV_SW 100.0 FORMULA_1207 -1000.0 3000.0 /end CHARACTERISTIC
/begin CHARACTERISTIC K_VAN_SZ_Auslass "Steuerzeit Nockenwelle" VALUE 0x78A48 TKW_VV_VV_SW 100.0 FORMULA_0102 -80.0 350.0 FORMAT "%4.1" /end CHARACTERISTIC
/begin CHARACTERISTIC K_VAN_SZ_Einlass "Steuerzeit Nockenwelle" VALUE 0x78A46 TKW_VV_VV_SW 100.0 FORMULA_0102 -80.0 350.0 FORMAT "%4.1" /end CHARACTERISTIC
/begin CHARACTERISTIC K_VAN_TMOT_BEGR_E "Temp.-Schwelle Frühbegrenzung" VALUE 0x78A4A TKW_VV_VV_SW 100.0 FORMULA_0023 -50.0 170.0 FORMAT "%4.1" /end CHARACTERISTIC
/begin CHARACTERISTIC K_VAN_TV_MCS_A1 "max. Ventil Tastverhaeltnis" VALUE 0x78A4E TKW_VV_VV_SW 100.0 FORMULA_0107 0.0 100.0 FORMAT "%4.1" /end CHARACTERISTIC
/begin CHARACTERISTIC K_VAN_TV_MCS_A2 "max. Ventil Tastverhaeltnis" VALUE 0x78A52 TKW_VV_VV_SW 100.0 FORMULA_0107 0.0 100.0 FORMAT "%4.1" /end CHARACTERISTIC
/begin CHARACTERISTIC K_VAN_TV_MCS_E1 "max. Ventil Tastverhaeltnis" VALUE 0x78A4C TKW_VV_VV_SW 100.0 FORMULA_0107 0.0 100.0 FORMAT "%4.1" /end CHARACTERISTIC
/begin CHARACTERISTIC K_VAN_TV_MCS_E2 "max. Ventil Tastverhaeltnis" VALUE 0x78A50 TKW_VV_VV_SW 100.0 FORMULA_0107 0.0 100.0 FORMAT "%4.1" /end CHARACTERISTIC
/begin CHARACTERISTIC K_VAN_UB_ERS "Ersatzwert bei Fehler" VALUE 0x78A54 TKW_VV_VV_SW 100.0 FORMULA_0008 0.0 28.0 FORMAT "%4.1" /end CHARACTERISTIC
/begin CHARACTERISTIC K_VAN_UNL_D_I_Auslass "Startwert Delta zum I-Anteil" VALUE 0x78A60 TKW_VV_VV_SW 100.0 FORMULA_1207 -1000.0 3000.0 /end CHARACTERISTIC
/begin CHARACTERISTIC K_VAN_UNL_D_I_Einlass "Startwert Delta zum I-Anteil" VALUE 0x78A5E TKW_VV_VV_SW 100.0 FORMULA_1207 -1000.0 3000.0 /end CHARACTERISTIC
/begin CHARACTERISTIC K_VAN_UNL_I_DYN_Auslass "max. Dynamik TV zum Entriegeln" VALUE 0x78A64 TKW_VV_VV_SW 100.0 FORMULA_1233 -1000.0 3000.0 /end CHARACTERISTIC
/begin CHARACTERISTIC K_VAN_UNL_I_DYN_Einlass "max. Dynamik TV zum Entriegeln" VALUE 0x78A62 TKW_VV_VV_SW 100.0 FORMULA_1233 -1000.0 3000.0 /end CHARACTERISTIC
/begin CHARACTERISTIC K_VAN_UNL_N_MIN_Auslass "min n bei von selbst entriegelt" VALUE 0x78A58 TKW_VV_VV_SW 100.0 FORMULA_0006 0.0 10000.0 /end CHARACTERISTIC
/begin CHARACTERISTIC K_VAN_UNL_N_MIN_Einlass "min n bei von selbst entriegelt" VALUE 0x78A56 TKW_VV_VV_SW 100.0 FORMULA_0006 0.0 10000.0 /end CHARACTERISTIC
/begin CHARACTERISTIC K_VAN_UNLOCK_SPR_Auslass "Pos ab der entriegelt sein muss" VALUE 0x78A5C TKW_VV_VV_SW 100.0 FORMULA_0102 50.0 160.0 FORMAT "%4.1" /end CHARACTERISTIC
/begin CHARACTERISTIC K_VAN_UNLOCK_SPR_Einlass "Pos ab der entriegelt sein muss" VALUE 0x78A5A TKW_VV_VV_SW 100.0 FORMULA_0102 50.0 160.0 FORMAT "%4.1" /end CHARACTERISTIC
/begin CHARACTERISTIC K_VAN_XD_EINGEREGELT "Max. Regelabweichung bei B_VAN_EINGEREGELT" VALUE 0x78A6A TKW_VV_VV_SW 100.0 FORMULA_0102 -80.0 80.0 FORMAT "%4.1" /end CHARACTERISTIC
/begin CHARACTERISTIC K_VAN_XD_FILT_ED_Auslass "Max. gef. Regelabweichung" VALUE 0x78A68 TKW_VV_VV_SW 100.0 FORMULA_0102 -80.0 80.0 FORMAT "%4.1" /end CHARACTERISTIC
/begin CHARACTERISTIC K_VAN_XD_FILT_ED_Einlass "Max. gef. Regelabweichung" VALUE 0x78A66 TKW_VV_VV_SW 100.0 FORMULA_0102 -80.0 80.0 FORMAT "%4.1" /end CHARACTERISTIC
/begin CHARACTERISTIC K_VAN_XD_REG_MIN "Min. Regelabweichung für ungefilterte Regelung" VALUE 0x78A6E TKW_VV_VV_SW 100.0 FORMULA_0102 -80.0 80.0 FORMAT "%4.1" /end CHARACTERISTIC
/begin CHARACTERISTIC K_VAN_XD_SK "Abweichung kleine Spreizung Notprogramm" VALUE 0x78A6C TKW_VV_VV_SW 100.0 FORMULA_0102 -80.0 80.0 FORMAT "%4.1" /end CHARACTERISTIC
/begin CHARACTERISTIC K_VERS_DATEN "Datenversion" VALUE 0x70254 TKW_VV_VV_UW 100.0 FORMULA_0010 0.0 65535.0 /end CHARACTERISTIC
/begin CHARACTERISTIC K_VERS_NAME "Applikateur" VALUE 0x70253 TKW_VV_VV_UB 100.0 FORMULA_0420 0.0 255.0 /end CHARACTERISTIC
/begin CHARACTERISTIC K_VERS_PROG "Programmversion" VALUE 0x70250 TKW_VV_VV_UW 100.0 FORMULA_0010 0.0 65535.0 /end CHARACTERISTIC
/begin CHARACTERISTIC K_VERS_PROZ "Prozessorkennung" VALUE 0x70252 TKW_VV_VV_UB 100.0 FORMULA_0422 0.0 255.0 /end CHARACTERISTIC
/begin CHARACTERISTIC K_WF_ASP_START "Anzahl ASP im START" VALUE 0x79604 TKW_VV_VV_UW 100.0 FORMULA_1240 0.0 1279.0 /end CHARACTERISTIC
/begin CHARACTERISTIC K_WF_IST_PLAU_MAX "max. plausibler WF-Wert" VALUE 0x79606 TKW_VV_VV_UW 100.0 FORMULA_0534 0.0 2000.0 FORMAT "%5.2" /end CHARACTERISTIC
/begin CHARACTERISTIC K_WF_MKS_AUS_HYS "Hysterese-Faktor f. WF-Deaktivierung" VALUE 0x79602 TKW_VV_VV_UW 100.0 FORMULA_0073 0.0 4.0 FORMAT "%6.3" /end CHARACTERISTIC
/begin CHARACTERISTIC K_WF_MKS_TI_CFG "Einrechnung WF-MKS" VALUE 0x795FE TKW_VV_VV_UB 100.0 FORMULA_0003 0.0 1.0 /end CHARACTERISTIC
/begin CHARACTERISTIC K_WF_SOLL_CFG "Auswahl - Ermittlung wf_soll_grund" VALUE 0x79608 TKW_VV_VV_UB 100.0 FORMULA_1241 0.0 2.0 /end CHARACTERISTIC
/begin CHARACTERISTIC K_WF_SOLL_START_PSAU "appl. PSAU-Wert im Start" VALUE 0x79600 TKW_VV_VV_SW 100.0 FORMULA_0075 0.0 2000.0 FORMAT "%4.1" /end CHARACTERISTIC
/begin CHARACTERISTIC K_WF_SOLL_START_PSAU_CFG "Schaler f. realen o. appl. PSAU" VALUE 0x795FF TKW_VV_VV_UB 100.0 FORMULA_0003 0.0 1.0 /end CHARACTERISTIC
/begin CHARACTERISTIC K_ZUST_MD_HYST_LL_TL "MD Hysterese f. Uebergang TL --> LL" VALUE 0x79C80 TKW_VV_VV_SW 100.0 FORMULA_0001 0.0 100.0 FORMAT "%4.1" /end CHARACTERISTIC
/begin CHARACTERISTIC K_ZUST_MD_HYST_TL_VL "MD Hysterese f. Uebergang TL --> VL" VALUE 0x79C82 TKW_VV_VV_SW 100.0 FORMULA_0001 0.0 100.0 FORMAT "%4.1" /end CHARACTERISTIC
/begin CHARACTERISTIC K_ZUST_MD_LL_TL "Momentenschwelle f. Uebergang LL --> TL" VALUE 0x79C7E TKW_VV_VV_SW 100.0 FORMULA_0001 0.0 100.0 FORMAT "%4.1" /end CHARACTERISTIC
/begin CHARACTERISTIC K_ZUST_N_PS_LL "Drehzahlschwelle f. Uebergang PRESYNC --> LL" VALUE 0x79C7C TKW_VV_VV_SW 100.0 FORMULA_0006 0.0 3000.0 /end CHARACTERISTIC
/begin CHARACTERISTIC K_ZUST_NL_TIMOUT_INJ "Timeoutueberwachung fuer INJ" VALUE 0x79C86 TKW_VV_VV_UW 100.0 FORMULA_1244 0.0 40000.0 FORMAT "%5.2" /end CHARACTERISTIC
/begin CHARACTERISTIC K_ZUST_POWER "Konfiguration Powertaster" VALUE 0x79C7A TKW_VV_VV_UB 100.0 FORMULA_1243 0.0 255.0 /end CHARACTERISTIC
/begin CHARACTERISTIC K_ZUST_T_NL "Nachlaufzeit" VALUE 0x79C84 TKW_VV_VV_UW 100.0 FORMULA_0021 0.0 655.0 FORMAT "%5.2" /end CHARACTERISTIC
/begin CHARACTERISTIC KF_PUMG_OBD_P_STAU_KOMP "pumg-Staudruckkompensation" MAP 0x76622 TKF_SW_SW_SW 100.0 FORMULA_0075 -500.0 500.0 FORMAT "%4.1" /begin AXIS_DESCR STD_AXIS n FORMULA_0006 4 0.0 10000.0 MAX_GRAD 0.0 /end AXIS_DESCR
 /begin AXIS_DESCR STD_AXIS v_hinten FORMULA_0076 4 -80.0 360.0 MAX_GRAD 0.0 FORMAT "%4.1" /end AXIS_DESCR
/end CHARACTERISTIC
/begin CHARACTERISTIC KF_PUMG_OBD_RF_MAX_P400 "tumg_obd-Kennfeld tmot-ml-Offset" MAP 0x7632E TKF_SW_SW_SW 100.0 FORMULA_0007 0.0 2.0 FORMAT "%6.3" /begin AXIS_DESCR STD_AXIS n FORMULA_0006 20 0.0 10000.0 MAX_GRAD 0.0 /end AXIS_DESCR
 /begin AXIS_DESCR STD_AXIS tan FORMULA_0023 8 -50.0 170.0 MAX_GRAD 0.0 FORMAT "%4.1" /end AXIS_DESCR
/end CHARACTERISTIC
/begin CHARACTERISTIC KF_PUMG_OBD_RF_MAX_P500 "tumg_obd-Kennfeld tmot-ml-Offset" MAP 0x764A8 TKF_SW_SW_SW 100.0 FORMULA_0007 0.0 2.0 FORMAT "%6.3" /begin AXIS_DESCR STD_AXIS n FORMULA_0006 20 0.0 10000.0 MAX_GRAD 0.0 /end AXIS_DESCR
 /begin AXIS_DESCR STD_AXIS tan FORMULA_0023 8 -50.0 170.0 MAX_GRAD 0.0 FORMAT "%4.1" /end AXIS_DESCR
/end CHARACTERISTIC
/begin CHARACTERISTIC KF_TANZYL_RATIO "Faktor Luftmassenstrom fuer TANZYL-Modell" MAP 0x77160 TKF_SW_SW_UW 100.0 FORMULA_0199 0.0 2.0 FORMAT "%7.4" /begin AXIS_DESCR STD_AXIS n FORMULA_0006 6 0.0 10000.0 MAX_GRAD 0.0 /end AXIS_DESCR
 /begin AXIS_DESCR STD_AXIS md_rf_soll_pt_roh FORMULA_0007 6 0.0 2.0 MAX_GRAD 0.0 FORMAT "%6.3" /end AXIS_DESCR
/end CHARACTERISTIC
/begin CHARACTERISTIC KF_VAN_I_VORST_A "Vorsteuerung Ventilstrom Auslass" MAP 0x78C0C TKF_SW_SW_SW 100.0 FORMULA_1207 -1000.0 3000.0 /begin AXIS_DESCR STD_AXIS n FORMULA_0006 6 0.0 10000.0 MAX_GRAD 0.0 /end AXIS_DESCR
 /begin AXIS_DESCR STD_AXIS toel FORMULA_0023 6 -50.0 170.0 MAX_GRAD 0.0 FORMAT "%4.1" /end AXIS_DESCR
/end CHARACTERISTIC
/begin CHARACTERISTIC KF_VAN_I_VORST_E "Vorsteuerung Ventilstrom Einlass" MAP 0x78BAA TKF_SW_SW_SW 100.0 FORMULA_1207 -1000.0 3000.0 /begin AXIS_DESCR STD_AXIS n FORMULA_0006 6 0.0 10000.0 MAX_GRAD 0.0 /end AXIS_DESCR
 /begin AXIS_DESCR STD_AXIS toel FORMULA_0023 6 -50.0 170.0 MAX_GRAD 0.0 FORMAT "%4.1" /end AXIS_DESCR
/end CHARACTERISTIC
/begin CHARACTERISTIC KF_VAN_KH_SOLL_A "Katheizkennfeld Vanos Sollwert" MAP 0x78FE2 TKF_SW_SW_SW 100.0 FORMULA_0102 50.0 160.0 FORMAT "%4.1" /begin AXIS_DESCR STD_AXIS n FORMULA_0006 16 0.0 10000.0 MAX_GRAD 0.0 /end AXIS_DESCR
 /begin AXIS_DESCR STD_AXIS dr_rel FORMULA_0106 12 0.0 199.9938049316406 MAX_GRAD 0.0 FORMAT "%5.2" /end AXIS_DESCR
/end CHARACTERISTIC
/begin CHARACTERISTIC KF_VAN_KH_SOLL_DMAX_A "Aenderungsbegrenzung Sollwert Katheizen" MAP 0x7944A TKF_SW_SW_SW 100.0 FORMULA_1214 -80.0 80.0 FORMAT "%4.1" /begin AXIS_DESCR STD_AXIS n FORMULA_0006 6 0.0 10000.0 MAX_GRAD 0.0 /end AXIS_DESCR
 /begin AXIS_DESCR STD_AXIS dr_rel FORMULA_0106 6 0.0 199.9938049316406 MAX_GRAD 0.0 FORMAT "%5.2" /end AXIS_DESCR
/end CHARACTERISTIC
/begin CHARACTERISTIC KF_VAN_KH_SOLL_DMAX_E "Aenderungsbegrenzung Sollwert Katheizen" MAP 0x794AC TKF_SW_SW_SW 100.0 FORMULA_1214 -80.0 80.0 FORMAT "%4.1" /begin AXIS_DESCR STD_AXIS n FORMULA_0006 6 0.0 10000.0 MAX_GRAD 0.0 /end AXIS_DESCR
 /begin AXIS_DESCR STD_AXIS dr_rel FORMULA_0106 6 0.0 199.9938049316406 MAX_GRAD 0.0 FORMAT "%5.2" /end AXIS_DESCR
/end CHARACTERISTIC
/begin CHARACTERISTIC KF_VAN_KH_SOLL_E "Katheizkennfeld Vanos Sollwert" MAP 0x7919C TKF_SW_SW_SW 100.0 FORMULA_0102 50.0 160.0 FORMAT "%4.1" /begin AXIS_DESCR STD_AXIS n FORMULA_0006 16 0.0 10000.0 MAX_GRAD 0.0 /end AXIS_DESCR
 /begin AXIS_DESCR STD_AXIS dr_rel FORMULA_0106 12 0.0 199.9938049316406 MAX_GRAD 0.0 FORMAT "%5.2" /end AXIS_DESCR
/end CHARACTERISTIC
/begin CHARACTERISTIC KF_VAN_SOLL_A "Grundkennfeld Vanos Sollwert" MAP 0x78C6E TKF_SW_SW_SW 100.0 FORMULA_0102 50.0 160.0 FORMAT "%4.1" /begin AXIS_DESCR STD_AXIS n FORMULA_0006 16 0.0 10000.0 MAX_GRAD 0.0 /end AXIS_DESCR
 /begin AXIS_DESCR STD_AXIS dr_rel FORMULA_0106 12 0.0 199.9938049316406 MAX_GRAD 0.0 FORMAT "%5.2" /end AXIS_DESCR
/end CHARACTERISTIC
/begin CHARACTERISTIC KF_VAN_SOLL_BEGR_A "Min-Begrenzung Kaltstart Auslass" MAP 0x79356 TKF_SW_SW_SW 100.0 FORMULA_0102 50.0 160.0 FORMAT "%4.1" /begin AXIS_DESCR STD_AXIS n FORMULA_0006 5 0.0 10000.0 MAX_GRAD 0.0 /end AXIS_DESCR
 /begin AXIS_DESCR STD_AXIS pumg FORMULA_0075 3 400.0 1200.0 MAX_GRAD 0.0 FORMAT "%4.1" /end AXIS_DESCR
/end CHARACTERISTIC
/begin CHARACTERISTIC KF_VAN_SOLL_DMAX_A "Aenderungsbegrenzung Sollwert" MAP 0x79386 TKF_SW_SW_SW 100.0 FORMULA_1214 -80.0 80.0 FORMAT "%4.1" /begin AXIS_DESCR STD_AXIS n FORMULA_0006 6 0.0 10000.0 MAX_GRAD 0.0 /end AXIS_DESCR
 /begin AXIS_DESCR STD_AXIS dr_rel FORMULA_0106 6 0.0 199.9938049316406 MAX_GRAD 0.0 FORMAT "%5.2" /end AXIS_DESCR
/end CHARACTERISTIC
/begin CHARACTERISTIC KF_VAN_SOLL_DMAX_E "Aenderungsbegrenzung Sollwert" MAP 0x793E8 TKF_SW_SW_SW 100.0 FORMULA_1214 -80.0 80.0 FORMAT "%4.1" /begin AXIS_DESCR STD_AXIS n FORMULA_0006 6 0.0 10000.0 MAX_GRAD 0.0 /end AXIS_DESCR
 /begin AXIS_DESCR STD_AXIS dr_rel FORMULA_0106 6 0.0 199.9938049316406 MAX_GRAD 0.0 FORMAT "%5.2" /end AXIS_DESCR
/end CHARACTERISTIC
/begin CHARACTERISTIC KF_VAN_SOLL_E "Grundkennfeld Vanos Sollwert" MAP 0x78E28 TKF_SW_SW_SW 100.0 FORMULA_0102 50.0 160.0 FORMAT "%4.1" /begin AXIS_DESCR STD_AXIS n FORMULA_0006 16 0.0 10000.0 MAX_GRAD 0.0 /end AXIS_DESCR
 /begin AXIS_DESCR STD_AXIS dr_rel FORMULA_0106 12 0.0 199.9938049316406 MAX_GRAD 0.0 FORMAT "%5.2" /end AXIS_DESCR
/end CHARACTERISTIC
/begin CHARACTERISTIC KF_VAN_XD_TAU "Filterzeitkonstante Regelabweichung" MAP 0x7950E TKF_SW_SW_SW 100.0 FORMULA_1052 0.2001000046730042 6553.5 FORMAT "%5.2" /begin AXIS_DESCR STD_AXIS n FORMULA_0006 3 0.0 10000.0 MAX_GRAD 0.0 /end AXIS_DESCR
 /begin AXIS_DESCR STD_AXIS tmot FORMULA_0023 4 -50.0 170.0 MAX_GRAD 0.0 FORMAT "%4.1" /end AXIS_DESCR
/end CHARACTERISTIC
/begin CHARACTERISTIC KF_WF_ASP_NEG "Anzahl ASP f. WF-Abbau" MAP 0x79778 TKF_SW_SW_UW 100.0 FORMULA_1240 0.0 1279.0
 /begin AXIS_DESCR STD_AXIS tsgrw FORMULA_0023 6 -50.0 170.0 MAX_GRAD 0.0 FORMAT "%4.1" /end AXIS_DESCR
 /begin AXIS_DESCR STD_AXIS n FORMULA_0006 5 0.0 10000.0 MAX_GRAD 0.0 /end AXIS_DESCR
/end CHARACTERISTIC
/begin CHARACTERISTIC KF_WF_ASP_POS "Anzahl ASP f. WF-Aufbau" MAP 0x79724 TKF_SW_SW_UW 100.0 FORMULA_1240 0.0 1279.0
 /begin AXIS_DESCR STD_AXIS tsgrw FORMULA_0023 6 -50.0 170.0 MAX_GRAD 0.0 FORMAT "%4.1" /end AXIS_DESCR
 /begin AXIS_DESCR STD_AXIS n FORMULA_0006 5 0.0 10000.0 MAX_GRAD 0.0 /end AXIS_DESCR
/end CHARACTERISTIC
/begin CHARACTERISTIC KF_WF_MKS_AKTIV_NEG "Aktivschwelle f. neg. WF" MAP 0x79820 TKF_SW_SW_UW 100.0 FORMULA_0534 0.0 512.0 FORMAT "%5.2"
 /begin AXIS_DESCR STD_AXIS tsgrw FORMULA_0023 6 -50.0 170.0 MAX_GRAD 0.0 FORMAT "%4.1" /end AXIS_DESCR
 /begin AXIS_DESCR STD_AXIS n FORMULA_0006 5 0.0 10000.0 MAX_GRAD 0.0 /end AXIS_DESCR
/end CHARACTERISTIC
/begin CHARACTERISTIC KF_WF_MKS_AKTIV_POS "Aktivschwelle f. pos. WF" MAP 0x797CC TKF_SW_SW_UW 100.0 FORMULA_0534 0.0 512.0 FORMAT "%5.2"
 /begin AXIS_DESCR STD_AXIS tsgrw FORMULA_0023 6 -50.0 170.0 MAX_GRAD 0.0 FORMAT "%4.1" /end AXIS_DESCR
 /begin AXIS_DESCR STD_AXIS n FORMULA_0006 5 0.0 10000.0 MAX_GRAD 0.0 /end AXIS_DESCR
/end CHARACTERISTIC
/begin CHARACTERISTIC KF_WF_MKS_BEGR_NEG "min. WF-MKS" MAP 0x79BDA TKF_SW_SW_UW 100.0 FORMULA_0073 0.0 4.0 FORMAT "%6.3"
 /begin AXIS_DESCR STD_AXIS tsgrw FORMULA_0023 7 -50.0 170.0 MAX_GRAD 0.0 FORMAT "%4.1" /end AXIS_DESCR
 /begin AXIS_DESCR STD_AXIS ti_nw_asp_cnt FORMULA_0010 4 0.0 32767.0 MAX_GRAD 0.0 /end AXIS_DESCR
/end CHARACTERISTIC
/begin CHARACTERISTIC KF_WF_MKS_BEGR_POS "max. WF-MKS" MAP 0x79B8A TKF_SW_SW_UW 100.0 FORMULA_0073 0.0 4.0 FORMAT "%6.3"
 /begin AXIS_DESCR STD_AXIS tsgrw FORMULA_0023 7 -50.0 170.0 MAX_GRAD 0.0 FORMAT "%4.1" /end AXIS_DESCR
 /begin AXIS_DESCR STD_AXIS ti_nw_asp_cnt FORMULA_0010 4 0.0 32767.0 MAX_GRAD 0.0 /end AXIS_DESCR
/end CHARACTERISTIC
/begin CHARACTERISTIC KF_WF_MKS_START_MAX "max. benoetigte MKS im START" MAP 0x79916 TKF_SW_SW_UW 100.0 FORMULA_0534 0.0 2000.0 FORMAT "%5.2"
 /begin AXIS_DESCR STD_AXIS time_ms FORMULA_0597 3 0.0 546.1165771484375 MAX_GRAD 0.0 FORMAT "%5.2" /end AXIS_DESCR
 /begin AXIS_DESCR STD_AXIS tsgrw FORMULA_0023 7 -50.0 170.0 MAX_GRAD 0.0 FORMAT "%4.1" /end AXIS_DESCR
/end CHARACTERISTIC
/begin CHARACTERISTIC KF_WF_OELV_ETA "Kraftstoffeintrag ins Oel u. Nachstartverhalten" MAP 0x796B4 TKF_SW_SW_UW 100.0 FORMULA_0199 0.0 1.0 FORMAT "%7.4"
 /begin AXIS_DESCR STD_AXIS tsgrw FORMULA_0023 7 -50.0 170.0 MAX_GRAD 0.0 FORMAT "%4.1" /end AXIS_DESCR
 /begin AXIS_DESCR STD_AXIS time_ml FORMULA_0021 6 0.0 327.0 MAX_GRAD 0.0 FORMAT "%5.2" /end AXIS_DESCR
/end CHARACTERISTIC
/begin CHARACTERISTIC KF_WF_PSAU_WICHT "wf_psau-Wichtungskennfeld" MAP 0x79956 TKF_SW_SW_UW 100.0 FORMULA_0073 0.0 4.0 FORMAT "%6.3"
 /begin AXIS_DESCR STD_AXIS tsgrw FORMULA_0023 7 -50.0 170.0 MAX_GRAD 0.0 FORMAT "%4.1" /end AXIS_DESCR
 /begin AXIS_DESCR STD_AXIS n FORMULA_0006 4 0.0 10000.0 MAX_GRAD 0.0 /end AXIS_DESCR
/end CHARACTERISTIC
/begin CHARACTERISTIC KF_WF_SOLL_F_SA "WF-Wichtungsfaktor ueber B_ZUST_SA-Dauer" MAP 0x79C2A TKF_SW_SW_UW 100.0 FORMULA_0073 0.0 1.0 FORMAT "%6.3" /begin AXIS_DESCR STD_AXIS n FORMULA_0006 7 0.0 10000.0 MAX_GRAD 0.0 /end AXIS_DESCR
 /begin AXIS_DESCR STD_AXIS time_sa FORMULA_0021 4 0.0 327.0 MAX_GRAD 0.0 FORMAT "%5.2" /end AXIS_DESCR
/end CHARACTERISTIC
/begin CHARACTERISTIC KF_WF_SOLL_F_VAN "WF-Korrekturfaktor Ventilueberschneidung" MAP 0x79874 TKF_SW_SW_UW 100.0 FORMULA_0073 0.0 4.0 FORMAT "%6.3"
 /begin AXIS_DESCR STD_AXIS van_vo_filt FORMULA_0102 8 -80.0 80.0 MAX_GRAD 0.0 FORMAT "%4.1" /end AXIS_DESCR
 /begin AXIS_DESCR STD_AXIS tsgrw_m FORMULA_0023 8 -50.0 170.0 MAX_GRAD 0.0 FORMAT "%4.1" /end AXIS_DESCR
/end CHARACTERISTIC
/begin CHARACTERISTIC KF_WF_SOLL_GRUND "SOLL-Grundwandfilmmasse" MAP 0x799A6 TKF_SW_SW_UW 100.0 FORMULA_0534 0.0 2000.0 FORMAT "%5.2"
 /begin AXIS_DESCR STD_AXIS psau FORMULA_0075 10 0.0 2000.0 MAX_GRAD 0.0 FORMAT "%4.1" /end AXIS_DESCR
 /begin AXIS_DESCR STD_AXIS tsgrw FORMULA_0023 10 -50.0 170.0 MAX_GRAD 0.0 FORMAT "%4.1" /end AXIS_DESCR
/end CHARACTERISTIC
/begin CHARACTERISTIC KF_WF_SOLL_GRUND_DR_REL "SOLL-Grundwandfilmmasse - DR_REL" MAP 0x79A98 TKF_SW_SW_UW 100.0 FORMULA_0534 0.0 2000.0 FORMAT "%5.2"
 /begin AXIS_DESCR STD_AXIS dr_rel FORMULA_0106 10 0.0 199.9938049316406 MAX_GRAD 0.0 FORMAT "%5.2" /end AXIS_DESCR
 /begin AXIS_DESCR STD_AXIS tsgrw FORMULA_0023 10 -50.0 170.0 MAX_GRAD 0.0 FORMAT "%4.1" /end AXIS_DESCR
/end CHARACTERISTIC
/begin CHARACTERISTIC KL_TANZYL_ABREG "Abregung ueber Zeit" CURVE 0x77112 TKL_UW_VV_UW 100.0 FORMULA_0199 0.0 2.0 FORMAT "%7.4"
 /begin AXIS_DESCR STD_AXIS time_ms FORMULA_0597 6 0.0 1092.25 MAX_GRAD 0.0 FORMAT "%5.2" /end AXIS_DESCR
/end CHARACTERISTIC
/begin CHARACTERISTIC KL_TANZYL_ML_GES_TAU "Luftmassenstrom zu tau" CURVE 0x770F8 TKL_SW_VV_UW 100.0 FORMULA_1052 0.1000000014901161 6553.5 FORMAT "%5.2"
 /begin AXIS_DESCR STD_AXIS ml_ges FORMULA_0103 6 -100.0 1400.0 MAX_GRAD 0.0 FORMAT "%4.1" /end AXIS_DESCR
/end CHARACTERISTIC
/begin CHARACTERISTIC KL_TANZYL_MR_ABREG "Abregung ueber Temperatur Motorraum" CURVE 0x7712C TKL_UW_VV_UW 100.0 FORMULA_0199 0.0 2.0 FORMAT "%7.4"
 /begin AXIS_DESCR STD_AXIS time_ms FORMULA_0597 6 0.0 1092.25 MAX_GRAD 0.0 FORMAT "%5.2" /end AXIS_DESCR
/end CHARACTERISTIC
/begin CHARACTERISTIC KL_TANZYL_MR_TUMG_KAL "Wichtung von Differenz tm - tumg" CURVE 0x77146 TKL_SW_VV_UW 100.0 FORMULA_0199 0.0 2.0 FORMAT "%7.4"
 /begin AXIS_DESCR STD_AXIS tumg FORMULA_0023 6 -50.0 170.0 MAX_GRAD 0.0 FORMAT "%4.1" /end AXIS_DESCR
/end CHARACTERISTIC
/begin CHARACTERISTIC KL_TKSM_ABREG "Abregung ueber Zeit" CURVE 0x788E4 TKL_UW_VV_UW 100.0 FORMULA_0199 0.0 2.0 FORMAT "%7.4"
 /begin AXIS_DESCR STD_AXIS time_ms FORMULA_0597 6 0.0 1092.25 MAX_GRAD 0.0 FORMAT "%5.2" /end AXIS_DESCR
/end CHARACTERISTIC
/begin CHARACTERISTIC KL_TKSM_MR_ABREG "Abregung ueber Temperatur Motorraum" CURVE 0x788FE TKL_UW_VV_UW 100.0 FORMULA_0199 0.0 2.0 FORMAT "%7.4"
 /begin AXIS_DESCR STD_AXIS time_ms FORMULA_0597 6 0.0 1092.25 MAX_GRAD 0.0 FORMAT "%5.2" /end AXIS_DESCR
/end CHARACTERISTIC
/begin CHARACTERISTIC KL_TKSM_MR_TUMG_KAL "Wichtung von Differenz tm - tumg" CURVE 0x78918 TKL_SW_VV_UW 100.0 FORMULA_0199 0.0 2.0 FORMAT "%7.4"
 /begin AXIS_DESCR STD_AXIS tumg FORMULA_0023 6 -50.0 170.0 MAX_GRAD 0.0 FORMAT "%4.1" /end AXIS_DESCR
/end CHARACTERISTIC
/begin CHARACTERISTIC KL_TKSM_Q_MOT_RATIO "Faktor Kraftstoffverbrauch fuer TKSM-Modell" CURVE 0x788CA TKL_SW_VV_UW 100.0 FORMULA_0199 0.0 2.0 FORMAT "%7.4"
 /begin AXIS_DESCR STD_AXIS kva_q_mot FORMULA_0746 6 0.0 256.0 MAX_GRAD 0.0 FORMAT "%4.1" /end AXIS_DESCR
/end CHARACTERISTIC
/begin CHARACTERISTIC KL_TKSM_Q_MOT_TAU "Kraftstoffverbrauch zu tau" CURVE 0x788B0 TKL_SW_VV_UW 100.0 FORMULA_1052 0.1000000014901161 6553.5 FORMAT "%5.2"
 /begin AXIS_DESCR STD_AXIS kva_q_mot FORMULA_0746 6 0.0 256.0 MAX_GRAD 0.0 FORMAT "%4.1" /end AXIS_DESCR
/end CHARACTERISTIC
/begin CHARACTERISTIC KL_VAN_DSV_HOLD_TV "Halte-Tastverhaeltnis DSV" CURVE 0x7896A TKL_SW_VV_SW 100.0 FORMULA_1235 0.0 100.0 FORMAT "%4.1"
 /begin AXIS_DESCR STD_AXIS ub FORMULA_0008 3 0.0 28.0 MAX_GRAD 0.0 FORMAT "%4.1" /end AXIS_DESCR
/end CHARACTERISTIC
/begin CHARACTERISTIC KL_VAN_DSV_PEAK_TV "Peak-Tastverhaeltnis DSV" CURVE 0x78978 TKL_SW_VV_SW 100.0 FORMULA_1235 0.0 100.0 FORMAT "%4.1"
 /begin AXIS_DESCR STD_AXIS ub FORMULA_0008 3 0.0 28.0 MAX_GRAD 0.0 FORMAT "%4.1" /end AXIS_DESCR
/end CHARACTERISTIC
/begin CHARACTERISTIC KL_VAN_FILTR_XD_WICHT "Gewicht Regl-Abw. Vent.Guete" CURVE 0x78A82 TKL_SW_VV_UB 100.0 FORMULA_0638 0.0 1.99210000038147
 /begin AXIS_DESCR STD_AXIS tumg FORMULA_0023 4 -50.0 170.0 MAX_GRAD 0.0 FORMAT "%4.1" /end AXIS_DESCR
/end CHARACTERISTIC
/begin CHARACTERISTIC KL_VAN_FREQU_ML "PWM-Frequenz Ventile Motor läuft" CURVE 0x78A70 TKL_SW_VV_UW 100.0 FORMULA_1202 16.0 400.0 FORMAT "%4.1"
 /begin AXIS_DESCR STD_AXIS tmot FORMULA_0023 4 -50.0 170.0 MAX_GRAD 0.0 FORMAT "%4.1" /end AXIS_DESCR
/end CHARACTERISTIC
/begin CHARACTERISTIC KL_VAN_KD_A "Regler D Faktor" CURVE 0x78A9E TKL_SW_VV_SW 100.0 FORMULA_1209 -32.0 31.99900054931641 FORMAT "%7.4" /begin AXIS_DESCR STD_AXIS n FORMULA_0006 5 0.0 10000.0 MAX_GRAD 0.0 /end AXIS_DESCR /end CHARACTERISTIC
/begin CHARACTERISTIC KL_VAN_KD_E "Regler D Faktor" CURVE 0x78AB4 TKL_SW_VV_SW 100.0 FORMULA_1209 -32.0 31.99900054931641 FORMAT "%7.4" /begin AXIS_DESCR STD_AXIS n FORMULA_0006 5 0.0 10000.0 MAX_GRAD 0.0 /end AXIS_DESCR /end CHARACTERISTIC
/begin CHARACTERISTIC KL_VAN_KI_A "Regler I Faktor" CURVE 0x78ACA TKL_SW_VV_SW 100.0 FORMULA_1210 -500.0 499.9847106933594 FORMAT "%5.2"
 /begin AXIS_DESCR STD_AXIS van_xd FORMULA_0102 5 -80.0 80.0 MAX_GRAD 0.0 FORMAT "%4.1" /end AXIS_DESCR
/end CHARACTERISTIC
/begin CHARACTERISTIC KL_VAN_KI_E "Regler I Faktor" CURVE 0x78AE0 TKL_SW_VV_SW 100.0 FORMULA_1210 -500.0 499.9847106933594 FORMAT "%5.2"
 /begin AXIS_DESCR STD_AXIS van_xd FORMULA_0102 5 -80.0 80.0 MAX_GRAD 0.0 FORMAT "%4.1" /end AXIS_DESCR
/end CHARACTERISTIC
/begin CHARACTERISTIC KL_VAN_KP_A "Regler P Faktor" CURVE 0x78AF6 TKL_SW_VV_SW 100.0 FORMULA_1211 -1280.0 1279.9609375 FORMAT "%5.2" /begin AXIS_DESCR STD_AXIS n FORMULA_0006 5 0.0 10000.0 MAX_GRAD 0.0 /end AXIS_DESCR /end CHARACTERISTIC
/begin CHARACTERISTIC KL_VAN_KP_E "Regler P Faktor" CURVE 0x78B0C TKL_SW_VV_SW 100.0 FORMULA_1211 -1280.0 1279.9609375 FORMAT "%5.2" /begin AXIS_DESCR STD_AXIS n FORMULA_0006 5 0.0 10000.0 MAX_GRAD 0.0 /end AXIS_DESCR /end CHARACTERISTIC
/begin CHARACTERISTIC KL_VAN_REG_FAKT_TMOT "Regler Korrekturfaktor" CURVE 0x78A90 TKL_SW_VV_UB 100.0 FORMULA_0638 0.0 1.99210000038147
 /begin AXIS_DESCR STD_AXIS tmot FORMULA_0023 4 -50.0 170.0 MAX_GRAD 0.0 FORMAT "%4.1" /end AXIS_DESCR
/end CHARACTERISTIC
/begin CHARACTERISTIC KL_VAN_SOLL_BEGR_E "Min-Begrenzung Kaltstart Einlass" CURVE 0x78B22 TKL_SW_VV_SW 100.0 FORMULA_0102 50.0 160.0 FORMAT "%4.1" /begin AXIS_DESCR STD_AXIS n FORMULA_0006 5 0.0 10000.0 MAX_GRAD 0.0 /end AXIS_DESCR /end CHARACTERISTIC
/begin CHARACTERISTIC KL_VAN_SOLL_DMAX_WL_A "Aenderungsbegr. in Ueberschneidung bei Warmlauf" CURVE 0x78B52 TKL_SW_VV_SW 100.0 FORMULA_1214 0.0 80.0 FORMAT "%4.1"
 /begin AXIS_DESCR STD_AXIS toel FORMULA_0023 4 -50.0 170.0 MAX_GRAD 0.0 FORMAT "%4.1" /end AXIS_DESCR
/end CHARACTERISTIC
/begin CHARACTERISTIC KL_VAN_SOLL_DMAX_WL_E "Aenderungsbegr. in Ueberschneidung bei Warmlauf" CURVE 0x78B64 TKL_SW_VV_SW 100.0 FORMULA_1214 0.0 80.0 FORMAT "%4.1"
 /begin AXIS_DESCR STD_AXIS toel FORMULA_0023 4 -50.0 170.0 MAX_GRAD 0.0 FORMAT "%4.1" /end AXIS_DESCR
/end CHARACTERISTIC
/begin CHARACTERISTIC KL_VAN_T_DRUCK_E "Druckerkennungszeit ohne Fehlereintrag" CURVE 0x78B76 TKL_SW_VV_UW 100.0 FORMULA_0071 0.0 6553.5 FORMAT "%4.1"
 /begin AXIS_DESCR STD_AXIS tmot_start FORMULA_0023 4 -50.0 170.0 MAX_GRAD 0.0 FORMAT "%4.1" /end AXIS_DESCR
/end CHARACTERISTIC
/begin CHARACTERISTIC KL_VAN_T_SOLL_BEGR_E "Min-Begrenzungsdauer Kaltstart" CURVE 0x78B38 TKL_SW_VV_SW 100.0 FORMULA_0921 -327.6799926757813 327.6700134277344
 /begin AXIS_DESCR STD_AXIS tan_start FORMULA_0023 6 -50.0 170.0 MAX_GRAD 0.0 FORMAT "%4.1" /end AXIS_DESCR
/end CHARACTERISTIC
/begin CHARACTERISTIC KL_VAN_T_START_DLY "Reglerfreigabe nach Motor Start" CURVE 0x78B88 TKL_SW_VV_UW 100.0 FORMULA_0021 0.0 655.0 FORMAT "%5.2"
 /begin AXIS_DESCR STD_AXIS tmot_start FORMULA_0023 8 -50.0 170.0 MAX_GRAD 0.0 FORMAT "%4.1" /end AXIS_DESCR
/end CHARACTERISTIC
/begin CHARACTERISTIC KL_WF_ASP_NEG_START "Anzahl ASP f. WF-Abbau (seq.START)" CURVE 0x79666 TKL_SW_VV_UW 100.0 FORMULA_1240 0.0 1279.0
 /begin AXIS_DESCR STD_AXIS tsgrw FORMULA_0023 6 -50.0 170.0 MAX_GRAD 0.0 FORMAT "%4.1" /end AXIS_DESCR
/end CHARACTERISTIC
/begin CHARACTERISTIC KL_WF_ASP_POS_START "Anzahl ASP f. WF-Aufbau (seq.START)" CURVE 0x7964C TKL_SW_VV_UW 100.0 FORMULA_1240 0.0 1279.0
 /begin AXIS_DESCR STD_AXIS tsgrw FORMULA_0023 6 -50.0 170.0 MAX_GRAD 0.0 FORMAT "%4.1" /end AXIS_DESCR
/end CHARACTERISTIC
/begin CHARACTERISTIC KL_WF_DMKS_T1_MS "Abdampfzeitkonstante bei stehenden Motor" CURVE 0x7960A TKL_SW_VV_UW 100.0 FORMULA_0593 0.0 65535.0
 /begin AXIS_DESCR STD_AXIS tsgrw FORMULA_0023 5 -50.0 170.0 MAX_GRAD 0.0 FORMAT "%4.1" /end AXIS_DESCR
/end CHARACTERISTIC
/begin CHARACTERISTIC KL_WF_MKS_BEGR_NEG_WICHT "Wichtungsfaktor f. neg. WF-MKS-Begrenzung" CURVE 0x79680 TKL_SW_VV_UW 100.0 FORMULA_0073 0.0 4.0 FORMAT "%6.3"
 /begin AXIS_DESCR STD_AXIS tsgrw FORMULA_0023 7 -50.0 170.0 MAX_GRAD 0.0 FORMAT "%4.1" /end AXIS_DESCR
/end CHARACTERISTIC
/begin CHARACTERISTIC KL_WF_SOLL_F_LAM "WF-Korrekturfaktor Lambda" CURVE 0x79636 TKL_UW_VV_UW 100.0 FORMULA_0073 0.0 4.0 FORMAT "%6.3"
 /begin AXIS_DESCR STD_AXIS lam_soll FORMULA_0025 5 0.0 3.999000072479248 MAX_GRAD 0.0 FORMAT "%6.3" /end AXIS_DESCR
/end CHARACTERISTIC
/begin CHARACTERISTIC KL_WF_SOLL_F_PUMG "WF-Korrekturfaktor Hoehe/Umgebungsdruck" CURVE 0x7969E TKL_SW_VV_UW 100.0 FORMULA_0073 0.0 4.0 FORMAT "%6.3"
 /begin AXIS_DESCR STD_AXIS pumg FORMULA_0075 5 400.0 1200.0 MAX_GRAD 0.0 FORMAT "%4.1" /end AXIS_DESCR
/end CHARACTERISTIC
/begin CHARACTERISTIC KL_WF_SOLL_F_TI_PHI_ENDE "WF-Korrekturfaktor Einspritzende" CURVE 0x79620 TKL_SW_VV_UW 100.0 FORMULA_0073 0.0 4.0 FORMAT "%6.3"
 /begin AXIS_DESCR STD_AXIS ti_phi_ende FORMULA_0102 5 -72.0 1440.0 MAX_GRAD 0.0 FORMAT "%4.1" /end AXIS_DESCR
/end CHARACTERISTIC
/begin CHARACTERISTIC KL_ZUST_MD_TL_VL "md_rel fuer Uebergang TL -> VL" CURVE 0x79C96 TKL_SW_VV_SW 100.0 FORMULA_0001 0.0 100.0 FORMAT "%4.1" /begin AXIS_DESCR STD_AXIS n FORMULA_0006 6 0.0 10000.0 MAX_GRAD 0.0 /end AXIS_DESCR /end CHARACTERISTIC
/begin CHARACTERISTIC KL_ZUST_N_ST_LL "Drehzahlschwelle fuer Start Exit" CURVE 0x79C88 TKL_SW_VV_SW 100.0 FORMULA_0006 0.0 10000.0
 /begin AXIS_DESCR STD_AXIS tmot FORMULA_0023 3 -50.0 170.0 MAX_GRAD 0.0 FORMAT "%4.1" /end AXIS_DESCR
/end CHARACTERISTIC
/begin MEASUREMENT B_VAN_ANSCHL_ANF_A1 "Anschlag anfahren" UBYTE FORMULA_0204 0 0 0.0 255.0 READ_WRITE BIT_MASK 0x10 ECU_ADDRESS 0x3FD433 /end MEASUREMENT
/begin MEASUREMENT B_VAN_ANSCHL_ANF_A2 "Anschlag anfahren" UBYTE FORMULA_0204 0 0 0.0 255.0 READ_WRITE BIT_MASK 0x10 ECU_ADDRESS 0x3FD435 /end MEASUREMENT
/begin MEASUREMENT B_VAN_ANSCHL_ANF_E1 "Anschlag anfahren" UBYTE FORMULA_0204 0 0 0.0 255.0 READ_WRITE BIT_MASK 0x10 ECU_ADDRESS 0x3FD432 /end MEASUREMENT
/begin MEASUREMENT B_VAN_ANSCHL_ANF_E2 "Anschlag anfahren" UBYTE FORMULA_0204 0 0 0.0 255.0 READ_WRITE BIT_MASK 0x10 ECU_ADDRESS 0x3FD434 /end MEASUREMENT
/begin MEASUREMENT B_VAN_ANSCHL_DC_A1 "Anschlag im DrivingCycle gelernt" UBYTE FORMULA_0205 0 0 0.0 255.0 READ_WRITE BIT_MASK 0x20 ECU_ADDRESS 0x3FD433 /end MEASUREMENT
/begin MEASUREMENT B_VAN_ANSCHL_DC_A2 "Anschlag im DrivingCycle gelernt" UBYTE FORMULA_0205 0 0 0.0 255.0 READ_WRITE BIT_MASK 0x20 ECU_ADDRESS 0x3FD435 /end MEASUREMENT
/begin MEASUREMENT B_VAN_ANSCHL_DC_E1 "Anschlag im DrivingCycle gelernt" UBYTE FORMULA_0205 0 0 0.0 255.0 READ_WRITE BIT_MASK 0x20 ECU_ADDRESS 0x3FD432 /end MEASUREMENT
/begin MEASUREMENT B_VAN_ANSCHL_DC_E2 "Anschlag im DrivingCycle gelernt" UBYTE FORMULA_0205 0 0 0.0 255.0 READ_WRITE BIT_MASK 0x20 ECU_ADDRESS 0x3FD434 /end MEASUREMENT
/begin MEASUREMENT B_VAN_DRUCK "Druck erkannt" UBYTE FORMULA_1204 0 0 0.0 255.0 READ_WRITE BIT_MASK 0x1 ECU_ADDRESS 0x3FD330 /end MEASUREMENT
/begin MEASUREMENT B_VAN_DRUCK_SPAET_A1 "Druckerkennung Sollwert spaet" UBYTE FORMULA_0206 0 0 0.0 255.0 READ_WRITE BIT_MASK 0x40 ECU_ADDRESS 0x3FD433 /end MEASUREMENT
/begin MEASUREMENT B_VAN_DRUCK_SPAET_A2 "Druckerkennung Sollwert spaet" UBYTE FORMULA_0206 0 0 0.0 255.0 READ_WRITE BIT_MASK 0x40 ECU_ADDRESS 0x3FD435 /end MEASUREMENT
/begin MEASUREMENT B_VAN_DRUCK_SPAET_E1 "Druckerkennung Sollwert spaet" UBYTE FORMULA_0206 0 0 0.0 255.0 READ_WRITE BIT_MASK 0x40 ECU_ADDRESS 0x3FD432 /end MEASUREMENT
/begin MEASUREMENT B_VAN_DRUCK_SPAET_E2 "Druckerkennung Sollwert spaet" UBYTE FORMULA_0206 0 0 0.0 255.0 READ_WRITE BIT_MASK 0x40 ECU_ADDRESS 0x3FD434 /end MEASUREMENT
/begin MEASUREMENT B_VAN_EINGER_A1 "Vanos eingeregelt" UBYTE FORMULA_0201 0 0 0.0 255.0 READ_WRITE BIT_MASK 0x2 ECU_ADDRESS 0x3FD436 /end MEASUREMENT
/begin MEASUREMENT B_VAN_EINGER_A2 "Vanos eingeregelt" UBYTE FORMULA_0203 0 0 0.0 255.0 READ_WRITE BIT_MASK 0x8 ECU_ADDRESS 0x3FD436 /end MEASUREMENT
/begin MEASUREMENT B_VAN_EINGER_BANK1 "Vanos eingeregelt" UBYTE FORMULA_1215 0 0.0 0.0 255.0 READ_WRITE BIT_MASK 0x3 ECU_ADDRESS 0x3FD436 /end MEASUREMENT
/begin MEASUREMENT B_VAN_EINGER_BANK2 "Vanos eingeregelt" UBYTE FORMULA_1216 0 0.0 0.0 255.0 READ_WRITE BIT_MASK 0xC ECU_ADDRESS 0x3FD436 /end MEASUREMENT
/begin MEASUREMENT B_VAN_EINGER_E1 "Vanos eingeregelt" UBYTE FORMULA_0200 0 0 0.0 255.0 READ_WRITE BIT_MASK 0x1 ECU_ADDRESS 0x3FD436 /end MEASUREMENT
/begin MEASUREMENT B_VAN_EINGER_E2 "Vanos eingeregelt" UBYTE FORMULA_0202 0 0 0.0 255.0 READ_WRITE BIT_MASK 0x4 ECU_ADDRESS 0x3FD436 /end MEASUREMENT
/begin MEASUREMENT B_VAN_EXD_PRUEF_I_A1 "Stromvorgabe ueber Diagnose" UBYTE FORMULA_0203 0 0 0.0 255.0 READ_WRITE BIT_MASK 0x8 ECU_ADDRESS 0x3FD433 /end MEASUREMENT
/begin MEASUREMENT B_VAN_EXD_PRUEF_I_A2 "Stromvorgabe ueber Diagnose" UBYTE FORMULA_0203 0 0 0.0 255.0 READ_WRITE BIT_MASK 0x8 ECU_ADDRESS 0x3FD435 /end MEASUREMENT
/begin MEASUREMENT B_VAN_EXD_PRUEF_I_E1 "Stromvorgabe ueber Diagnose" UBYTE FORMULA_0203 0 0 0.0 255.0 READ_WRITE BIT_MASK 0x8 ECU_ADDRESS 0x3FD432 /end MEASUREMENT
/begin MEASUREMENT B_VAN_EXD_PRUEF_I_E2 "Stromvorgabe ueber Diagnose" UBYTE FORMULA_0203 0 0 0.0 255.0 READ_WRITE BIT_MASK 0x8 ECU_ADDRESS 0x3FD434 /end MEASUREMENT
/begin MEASUREMENT B_VAN_FILTR_A1 "Filtration erkannt" UBYTE FORMULA_0200 0 0 0.0 255.0 READ_WRITE BIT_MASK 0x1 ECU_ADDRESS 0x3FD433 /end MEASUREMENT
/begin MEASUREMENT B_VAN_FILTR_A2 "Filtration erkannt" UBYTE FORMULA_0200 0 0 0.0 255.0 READ_WRITE BIT_MASK 0x1 ECU_ADDRESS 0x3FD435 /end MEASUREMENT
/begin MEASUREMENT B_VAN_FILTR_E1 "Filtration erkannt" UBYTE FORMULA_0200 0 0 0.0 255.0 READ_WRITE BIT_MASK 0x1 ECU_ADDRESS 0x3FD432 /end MEASUREMENT
/begin MEASUREMENT B_VAN_FILTR_E2 "Filtration erkannt" UBYTE FORMULA_0200 0 0 0.0 255.0 READ_WRITE BIT_MASK 0x1 ECU_ADDRESS 0x3FD434 /end MEASUREMENT
/begin MEASUREMENT B_VAN_GUETE "Guetemessung aktiv" UBYTE FORMULA_1205 0 0 0.0 255.0 READ_WRITE BIT_MASK 0x2 ECU_ADDRESS 0x3FD330 /end MEASUREMENT
/begin MEASUREMENT B_VAN_KS_AUS_A1 "Ventil Kurzschlussabschaltung" UBYTE FORMULA_0201 0 0 0.0 255.0 READ_WRITE BIT_MASK 0x2 ECU_ADDRESS 0x3FD433 /end MEASUREMENT
/begin MEASUREMENT B_VAN_KS_AUS_A2 "Ventil Kurzschlussabschaltung" UBYTE FORMULA_0201 0 0 0.0 255.0 READ_WRITE BIT_MASK 0x2 ECU_ADDRESS 0x3FD435 /end MEASUREMENT
/begin MEASUREMENT B_VAN_KS_AUS_E1 "Ventil Kurzschlussabschaltung" UBYTE FORMULA_0201 0 0 0.0 255.0 READ_WRITE BIT_MASK 0x2 ECU_ADDRESS 0x3FD432 /end MEASUREMENT
/begin MEASUREMENT B_VAN_KS_AUS_E2 "Ventil Kurzschlussabschaltung" UBYTE FORMULA_0201 0 0 0.0 255.0 READ_WRITE BIT_MASK 0x2 ECU_ADDRESS 0x3FD434 /end MEASUREMENT
/begin MEASUREMENT B_VAN_REG_FREI_A1 "Lageregler Freigabe" UBYTE FORMULA_0202 0 0 0.0 255.0 READ_WRITE BIT_MASK 0x4 ECU_ADDRESS 0x3FD433 /end MEASUREMENT
/begin MEASUREMENT B_VAN_REG_FREI_A2 "Lageregler Freigabe" UBYTE FORMULA_0202 0 0 0.0 255.0 READ_WRITE BIT_MASK 0x4 ECU_ADDRESS 0x3FD435 /end MEASUREMENT
/begin MEASUREMENT B_VAN_REG_FREI_E1 "Lageregler Freigabe" UBYTE FORMULA_0202 0 0 0.0 255.0 READ_WRITE BIT_MASK 0x4 ECU_ADDRESS 0x3FD432 /end MEASUREMENT
/begin MEASUREMENT B_VAN_REG_FREI_E2 "Lageregler Freigabe" UBYTE FORMULA_0202 0 0 0.0 255.0 READ_WRITE BIT_MASK 0x4 ECU_ADDRESS 0x3FD434 /end MEASUREMENT
/begin MEASUREMENT cana_estat "Error-Status-Register" UWORD FORMULA_USER1 0 0.0 0.0 65535.0 READ_WRITE ECU_ADDRESS 0x3070A0 /end MEASUREMENT
/begin MEASUREMENT canb_estat "Error-Status-Register" UWORD FORMULA_USER1 0 0.0 0.0 65535.0 READ_WRITE ECU_ADDRESS 0x3074A0 /end MEASUREMENT
/begin MEASUREMENT n_van_b1 "Einlass Nockenwellen-Drehzahl" SWORD FORMULA_0006 0 0.0 0.0 10000.0 READ_WRITE ECU_ADDRESS 0x3FD480 /end MEASUREMENT
/begin MEASUREMENT n_van_b2 "Einlass Nockenwellen-Drehzahl" SWORD FORMULA_0006 0 0.0 0.0 10000.0 READ_WRITE ECU_ADDRESS 0x3FD482 /end MEASUREMENT
/begin MEASUREMENT pumg_ad "Eingelesener Spannungswert fuer Umgebungsdruck" SWORD FORMULA_0114 0 0.0 0.0 1023.0 READ_WRITE ECU_ADDRESS 0x3FCC2E /end MEASUREMENT
/begin MEASUREMENT pumg_e2 "Umgebungsdruck Ebene 2" SWORD FORMULA_0075 0 0.0 400.0 1200.0 READ_WRITE ECU_ADDRESS 0x3FD5E0 /end MEASUREMENT
/begin MEASUREMENT pumg_obd_filter "gradientenbasierter vorheriger Messwert" SWORD FORMULA_0075 0 0.0 400.0 1200.0 READ_WRITE ECU_ADDRESS 0x3FCC32 /end MEASUREMENT
/begin MEASUREMENT pumg_obd_fplau_abw_max_t "Zeit der fplau-Abweichung fuer pumg_modell-Berechnung" UWORD FORMULA_0071 0 0.0 0.0 6553.5 READ_WRITE ECU_ADDRESS 0x3FCC48 /end MEASUREMENT
/begin MEASUREMENT pumg_obd_modell "pumg-Modellwert" SWORD FORMULA_0075 0 0.0 400.0 1200.0 READ_WRITE ECU_ADDRESS 0x3FCC3A /end MEASUREMENT
/begin MEASUREMENT pumg_obd_modell_freigabe "OBD-Status pumg" UBYTE FORMULA_1049 0 0.0 0.0 255.0 READ_WRITE ECU_ADDRESS 0x3FCC38 /end MEASUREMENT
/begin MEASUREMENT pumg_obd_modell_integral "pumg-Modellwertintegral" SLONG FORMULA_1050 0 0.0 400.0 120000.0 READ_WRITE ECU_ADDRESS 0x3FCC40 /end MEASUREMENT
/begin MEASUREMENT pumg_obd_modell_integral_cnt "pumg-Modellwertintegral-COUNTER" UWORD FORMULA_0010 0 0.0 0.0 65535.0 READ_WRITE ECU_ADDRESS 0x3FCC44 /end MEASUREMENT
/begin MEASUREMENT pumg_obd_modell_mw "pumg-Modellmittelwert" SWORD FORMULA_0075 0 0.0 400.0 1200.0 READ_WRITE ECU_ADDRESS 0x3FCC3C /end MEASUREMENT
/begin MEASUREMENT pumg_obd_rf "resultierende rf aus KF_PUMG_OBD_RF_MAX_P400/P500" SWORD FORMULA_0007 0 0.0 0.0 2.0 READ_WRITE ECU_ADDRESS 0x3FCC46 /end MEASUREMENT
/begin MEASUREMENT pumg_roh "Ungefilterter Messwert" SWORD FORMULA_0075 0 0.0 400.0 1200.0 READ_WRITE ECU_ADDRESS 0x3FCC30 /end MEASUREMENT
/begin MEASUREMENT qadca_qasr0 "qadca_qasr0, Statusregister0" UWORD FORMULA_USER1 0 0.0 0.0 65535.0 READ_WRITE ECU_ADDRESS 0x304810 /end MEASUREMENT
/begin MEASUREMENT qadca_qasr1 "qadca_qasr1, Statusregister1" UWORD FORMULA_USER1 0 0.0 0.0 65535.0 READ_WRITE ECU_ADDRESS 0x304812 /end MEASUREMENT
/begin MEASUREMENT qadcb_qasr0 "qadcb_qasr0, Statusregister0" UWORD FORMULA_USER1 0 0.0 0.0 65535.0 READ_WRITE ECU_ADDRESS 0x304C10 /end MEASUREMENT
/begin MEASUREMENT qadcb_qasr1 "qadcb_qasr1, Statusregister1" UWORD FORMULA_USER1 0 0.0 0.0 65535.0 READ_WRITE ECU_ADDRESS 0x304C12 /end MEASUREMENT
/begin MEASUREMENT sys_sypcr "Watchdog-Register" ULONG FORMULA_USER1 0 0.0 0.0 4294967295.0 READ_WRITE ECU_ADDRESS 0x2FC004 /end MEASUREMENT
/begin MEASUREMENT tanzyl_abreg "Abregung ueber Zeit" UWORD FORMULA_0199 0 0.0 0.0 2.0 READ_WRITE ECU_ADDRESS 0x3FCED8 /end MEASUREMENT
/begin MEASUREMENT tanzyl_loc "Lokale Ansaugtemperatur im Zylinder Modell gefiltert" SWORD FORMULA_0023 0 0.0 -50.0 170.0 READ_WRITE ECU_ADDRESS 0x3FCECE /end MEASUREMENT
/begin MEASUREMENT tanzyl_ml_ges_tau "Temperatur tau TANZYL-Modell" UWORD FORMULA_1052 0 0.0 0.1000000014901161 6553.5 READ_WRITE ECU_ADDRESS 0x3FCED0 /end MEASUREMENT
/begin MEASUREMENT tanzyl_mr "Temperatur Motorraum TANZYL-Modell" SWORD FORMULA_0023 0 0.0 -50.0 170.0 READ_WRITE ECU_ADDRESS 0x3FCEC8 /end MEASUREMENT
/begin MEASUREMENT tanzyl_mr_abreg "Abregung ueber Temperatur Motorraum" UWORD FORMULA_0199 0 0.0 0.0 2.0 READ_WRITE ECU_ADDRESS 0x3FCED6 /end MEASUREMENT
/begin MEASUREMENT tanzyl_mr_off "Offset Motorraumtemperatur bei Start" SWORD FORMULA_0074 0 0.0 -1000.0 1000.0 READ_WRITE ECU_ADDRESS 0x3FCEDE /end MEASUREMENT
/begin MEASUREMENT tanzyl_mr_stat "Motorraumtemperatur Zielwert" SWORD FORMULA_0023 0 0.0 -50.0 170.0 READ_WRITE ECU_ADDRESS 0x3FCEDC /end MEASUREMENT
/begin MEASUREMENT tanzyl_mr_tumg_delta "Temperaturdifferenz Motorraum zu Umgebung" SWORD FORMULA_0023 0 0.0 -50.0 170.0 READ_WRITE ECU_ADDRESS 0x3FCECA /end MEASUREMENT
/begin MEASUREMENT tanzyl_mr_tumg_kal "Wichtung von Differenz tm - tumg" UWORD FORMULA_0199 0 0.0 0.0 2.0 READ_WRITE ECU_ADDRESS 0x3FCED4 /end MEASUREMENT
/begin MEASUREMENT tanzyl_ratio "Faktor Luftmassenstrom fuer TANZYL-Modell" UWORD FORMULA_0199 0 0.0 0.0 2.0 READ_WRITE ECU_ADDRESS 0x3FCED2 /end MEASUREMENT
/begin MEASUREMENT tanzyl_raw "Ansaugtemperatur im Zylinder Modell ungefiltert" SWORD FORMULA_0023 0 0.0 -50.0 170.0 READ_WRITE ECU_ADDRESS 0x3FCECC /end MEASUREMENT
/begin MEASUREMENT tanzyl_st "Status Modell Ansaugtemperatur im Zylinder" UBYTE FORMULA_1122 0 0.0 0.0 2.0 READ_WRITE ECU_ADDRESS 0x3FCEDA /end MEASUREMENT
/begin MEASUREMENT tksm_abreg "Abregung ueber Zeit" UWORD FORMULA_0199 0 0.0 0.0 2.0 READ_WRITE ECU_ADDRESS 0x3FD290 /end MEASUREMENT
/begin MEASUREMENT tksm_loc "Lokale Kraftstofftemperatur Modell gefiltert" SWORD FORMULA_0023 0 0.0 -50.0 170.0 READ_WRITE ECU_ADDRESS 0x3FD286 /end MEASUREMENT
/begin MEASUREMENT tksm_mr "Temperatur Motorraum TKSM-Modell" SWORD FORMULA_0023 0 0.0 -50.0 170.0 READ_WRITE ECU_ADDRESS 0x3FD280 /end MEASUREMENT
/begin MEASUREMENT tksm_mr_abreg "Abregung ueber Temperatur Motorraum" UWORD FORMULA_0199 0 0.0 0.0 2.0 READ_WRITE ECU_ADDRESS 0x3FD28E /end MEASUREMENT
/begin MEASUREMENT tksm_mr_off "Offset Motorraumtemperatur bei Start" SWORD FORMULA_0074 0 0.0 -1000.0 1000.0 READ_WRITE ECU_ADDRESS 0x3FD296 /end MEASUREMENT
/begin MEASUREMENT tksm_mr_stat "Motorraumtemperatur Zielwert" SWORD FORMULA_0023 0 0.0 -50.0 170.0 READ_WRITE ECU_ADDRESS 0x3FD294 /end MEASUREMENT
/begin MEASUREMENT tksm_mr_tumg_delta "Temperaturdifferenz Motorraum zu Umgebung" SWORD FORMULA_0023 0 0.0 -50.0 170.0 READ_WRITE ECU_ADDRESS 0x3FD282 /end MEASUREMENT
/begin MEASUREMENT tksm_mr_tumg_kal "Wichtung von Differenz tm - tumg" UWORD FORMULA_0199 0 0.0 0.0 2.0 READ_WRITE ECU_ADDRESS 0x3FD28C /end MEASUREMENT
/begin MEASUREMENT tksm_q_mot_ratio "Faktor Kraftstoffverbrauch fuer TKSM-Modell" UWORD FORMULA_0199 0 0.0 0.0 2.0 READ_WRITE ECU_ADDRESS 0x3FD28A /end MEASUREMENT
/begin MEASUREMENT tksm_q_mot_tau "Temperatur tau TKSM-Modell" UWORD FORMULA_1052 0 0.0 0.1000000014901161 6553.5 READ_WRITE ECU_ADDRESS 0x3FD288 /end MEASUREMENT
/begin MEASUREMENT tksm_raw "Kraftstofftemperatur Modell ungefiltert" SWORD FORMULA_0023 0 0.0 -50.0 170.0 READ_WRITE ECU_ADDRESS 0x3FD284 /end MEASUREMENT
/begin MEASUREMENT tksm_st "Status Modell Kraftstofftemperatur" UBYTE FORMULA_1122 0 0.0 0.0 2.0 READ_WRITE ECU_ADDRESS 0x3FD292 /end MEASUREMENT
/begin MEASUREMENT tpu_a.CFSR01 "Channel Funktion Selection Register 0,1." ULONG FORMULA_0000 0 0.0 0.0 4294967295.0 READ_WRITE ECU_ADDRESS 0x30400C /end MEASUREMENT
/begin MEASUREMENT tpu_a.CFSR23 "Channel Funktion Selection Register 2,3." ULONG FORMULA_0000 0 0.0 0.0 4294967295.0 READ_WRITE ECU_ADDRESS 0x304010 /end MEASUREMENT
/begin MEASUREMENT tpu_a.CIER "Channel Interrupt Enable Register." UWORD FORMULA_0010 0 0.0 0.0 65535.0 READ_WRITE ECU_ADDRESS 0x30400A /end MEASUREMENT
/begin MEASUREMENT tpu_a.CISR "Channel Interrupt Status Register." UWORD FORMULA_0010 0 0.0 0.0 65535.0 READ_WRITE ECU_ADDRESS 0x304020 /end MEASUREMENT
/begin MEASUREMENT tpu_a.CPR "Channel Priority Register 0,1." ULONG FORMULA_0000 0 0.0 0.0 4294967295.0 READ_WRITE ECU_ADDRESS 0x30401C /end MEASUREMENT
/begin MEASUREMENT tpu_a.HSQR "Host Sequence Register 0,1." ULONG FORMULA_0000 0 0.0 0.0 4294967295.0 READ_WRITE ECU_ADDRESS 0x304014 /end MEASUREMENT
/begin MEASUREMENT tpu_a.HSRR "Host Service Request Register 0,1." ULONG FORMULA_0000 0 0.0 0.0 4294967295.0 READ_WRITE ECU_ADDRESS 0x304018 /end MEASUREMENT
/begin MEASUREMENT tpu_a.TICR "TPU3 Interrupt Configuration Register." UWORD FORMULA_0010 0 0.0 0.0 65535.0 READ_WRITE ECU_ADDRESS 0x304008 /end MEASUREMENT
/begin MEASUREMENT tpu_a.TPUMCR "TPU3 Module Configuration Register." UWORD FORMULA_0010 0 0.0 0.0 65535.0 READ_WRITE ECU_ADDRESS 0x304000 /end MEASUREMENT
/begin MEASUREMENT tpu_a.TPUMCR2 "TPU Module Configuration Register 2." UWORD FORMULA_0010 0 0.0 0.0 65535.0 READ_WRITE ECU_ADDRESS 0x304028 /end MEASUREMENT
/begin MEASUREMENT tpu_a.TPUMCR3 "TPU Module Configuration Register 3." UWORD FORMULA_0010 0 0.0 0.0 65535.0 READ_WRITE ECU_ADDRESS 0x30402A /end MEASUREMENT
/begin MEASUREMENT tpu_a_htu "Hight-Time-Updater." UWORD FORMULA_KW9 0 0.0 0.0 2394.403076171875 READ_WRITE ECU_ADDRESS 0x304110 /end MEASUREMENT
/begin MEASUREMENT tpu_a_kw_cnt_720 "720° Zahnzaehler." UWORD FORMULA_KW1 0 0.0 0.0 119.0 READ_WRITE BIT_MASK 0xFF00 ECU_ADDRESS 0x30410C /end MEASUREMENT
/begin MEASUREMENT tpu_a_kw_cnt_cor "Feinaufloesung vom Zahnzaehler." UWORD FORMULA_KW6 0 0.0 0.0 42747.69140625 READ_WRITE BIT_MASK 0xFF00 ECU_ADDRESS 0x30410A /end MEASUREMENT
/begin MEASUREMENT tpu_a_kw_count "Kurbelwellenposition." UWORD FORMULA_KW10 0 0.0 0.0 719.989013671875 READ_WRITE ECU_ADDRESS 0x304112 /end MEASUREMENT
/begin MEASUREMENT tpu_a_kw_irq "Interrupt request." UWORD FORMULA_KW1 0 0.0 0.0 255.0 READ_WRITE BIT_MASK 0xFF00 ECU_ADDRESS 0x304100 /end MEASUREMENT
/begin MEASUREMENT tpu_a_kw_irq_ack "Interruptquittierung." UWORD FORMULA_KW1 0 0.0 0.0 255.0 READ_WRITE BIT_MASK 0xFF00 ECU_ADDRESS 0x304102 /end MEASUREMENT
/begin MEASUREMENT tpu_a_kw_irq_zahn "Interruptzahn." UWORD FORMULA_KW4 0 0.0 0.0 119.0 READ_WRITE BIT_MASK 0xFF ECU_ADDRESS 0x304102 /end MEASUREMENT
/begin MEASUREMENT tpu_a_kw_last_event_time "Zeitpunkt vom letzten Ereignis." ULONG FORMULA_KW8 0 0.0 0.0 2396.745 READ_WRITE BIT_MASK 0xFFFFFF ECU_ADDRESS 0x30411C /end MEASUREMENT
/begin MEASUREMENT tpu_a_kw_last_period_high "8 msb der letzten Periode." UWORD FORMULA_KW12 0 0.0 0.0 255.0 READ_WRITE BIT_MASK 0xFF00 ECU_ADDRESS 0x304116 /end MEASUREMENT
/begin MEASUREMENT tpu_a_kw_last_period_low "16 lsb der letzten Periode." UWORD FORMULA_KW11 0 0.0 0.0 9.362099647521973 READ_WRITE ECU_ADDRESS 0x304114 /end MEASUREMENT
/begin MEASUREMENT tpu_a_kw_last_trans_time "Zeitpunkt letzter Zahnflanke." ULONG FORMULA_KW8 0 0.0 0.0 2396.745 READ_WRITE BIT_MASK 0xFFFFFF ECU_ADDRESS 0x3041DA /end MEASUREMENT
/begin MEASUREMENT tpu_a_kw_link "Link-Vektor." UWORD FORMULA_KW4 0 0.0 0.0 65535.0 READ_WRITE ECU_ADDRESS 0x304106 /end MEASUREMENT
/begin MEASUREMENT tpu_a_kw_max_teeth_unsync "Max Anzahl Flanken zur Lueckensuche." UWORD FORMULA_KW1 0 0.0 0.0 127.0 READ_WRITE BIT_MASK 0xFF00 ECU_ADDRESS 0x30410A /end MEASUREMENT
/begin MEASUREMENT tpu_a_kw_next_segm_tooth "Naechster Segmentzahn." UWORD FORMULA_KW4 0 0.0 0.0 119.0 READ_WRITE BIT_MASK 0xFF ECU_ADDRESS 0x30410A /end MEASUREMENT
/begin MEASUREMENT tpu_a_kw_norm_period "normierte Periode." ULONG FORMULA_KW13 0 0.0 0.0 2396.745 READ_WRITE BIT_MASK 0xFFFFFF00 ECU_ADDRESS 0x30411A /end MEASUREMENT
/begin MEASUREMENT tpu_a_kw_prev_period "Vorhergehende Periode." ULONG FORMULA_KW8 0 0.0 0.0 2396.745 READ_WRITE BIT_MASK 0xFFFFFF ECU_ADDRESS 0x304116 /end MEASUREMENT
/begin MEASUREMENT tpu_a_kw_segm_length "Segmentlaenge." UWORD FORMULA_KW4 0 0.0 0.0 119.0 READ_WRITE BIT_MASK 0xFF ECU_ADDRESS 0x304108 /end MEASUREMENT
/begin MEASUREMENT tpu_a_kw_segm_start "Segmentstart." UWORD FORMULA_KW1 0 0.0 0.0 119.0 READ_WRITE BIT_MASK 0xFF00 ECU_ADDRESS 0x304108 /end MEASUREMENT
/begin MEASUREMENT tpu_a_kw_segm_zeit "Segmentzeitpunkt." ULONG FORMULA_KW8 0 0.0 0.0 2396.745 READ_WRITE BIT_MASK 0xFFFFFF ECU_ADDRESS 0x30410C /end MEASUREMENT
/begin MEASUREMENT tpu_a_kw_state "Zustand." UWORD FORMULA_KW3 0 0.0 0.0 15.0 READ_WRITE BIT_MASK 0xF ECU_ADDRESS 0x304100 /end MEASUREMENT
/begin MEASUREMENT tpu_a_kw_time_out "Unterdrehzahl." UWORD FORMULA_KW5 0 0.0 4.0 10000.0 READ_WRITE ECU_ADDRESS 0x304104 /end MEASUREMENT
/begin MEASUREMENT tpu_a_kw_wait_teeth "Zahnentprellung vor Lueckensuche." UWORD FORMULA_KW4 0 0.0 0.0 127.0 READ_WRITE BIT_MASK 0xFF ECU_ADDRESS 0x30410A /end MEASUREMENT
/begin MEASUREMENT tpu_a_pram "Parameter RAM." UWORD FORMULA_0010 0 0.0 0.0 65535.0 READ_WRITE ARRAY_SIZE 128 ECU_ADDRESS 0x304100 MATRIX_DIM 128 1 1 /end MEASUREMENT
/begin MEASUREMENT tpu_atp_angle_etrig7 "TPU ATP next trigger angle." UWORD FORMULA_ATP1 0 0.0 0.0 719.989013671875 READ_WRITE ECU_ADDRESS 0x3045F0 /end MEASUREMENT
/begin MEASUREMENT tpu_atp_cnt_etrig7 "TPU ATP counter." UWORD FORMULA_ATP3 0 0.0 0.0 65535.0 READ_WRITE ECU_ADDRESS 0x3045F6 /end MEASUREMENT
/begin MEASUREMENT tpu_atp_period_etrig7 "TPU ATP angle period." UWORD FORMULA_ATP1 0 0.0 0.0 719.989013671875 READ_WRITE ECU_ADDRESS 0x3045F2 /end MEASUREMENT
/begin MEASUREMENT tpu_atp_time_etrig7 "TPU ATP trigger time." UWORD FORMULA_ATP2 0 0.0 0.0 9.362099647521973 READ_WRITE ECU_ADDRESS 0x3045F4 /end MEASUREMENT
/begin MEASUREMENT tpu_b.CFSR01 "Channel Funktion Selection Register 0,1." ULONG FORMULA_0000 0 0.0 0.0 4294967295.0 READ_WRITE ECU_ADDRESS 0x30440C /end MEASUREMENT
/begin MEASUREMENT tpu_b.CFSR23 "Channel Funktion Selection Register 2,3." ULONG FORMULA_0000 0 0.0 0.0 4294967295.0 READ_WRITE ECU_ADDRESS 0x304410 /end MEASUREMENT
/begin MEASUREMENT tpu_b.CIER "Channel Interrupt Enable Register." UWORD FORMULA_0010 0 0.0 0.0 65535.0 READ_WRITE ECU_ADDRESS 0x30440A /end MEASUREMENT
/begin MEASUREMENT tpu_b.CISR "Channel Interrupt Status Register." UWORD FORMULA_0010 0 0.0 0.0 65535.0 READ_WRITE ECU_ADDRESS 0x304420 /end MEASUREMENT
/begin MEASUREMENT tpu_b.CPR "Channel Priority Register 0,1." ULONG FORMULA_0000 0 0.0 0.0 4294967295.0 READ_WRITE ECU_ADDRESS 0x30441C /end MEASUREMENT
/begin MEASUREMENT tpu_b.HSQR "Host Sequence Register 0,1." ULONG FORMULA_0000 0 0.0 0.0 4294967295.0 READ_WRITE ECU_ADDRESS 0x304414 /end MEASUREMENT
/begin MEASUREMENT tpu_b.HSRR "Host Service Request Register 0,1." ULONG FORMULA_0000 0 0.0 0.0 4294967295.0 READ_WRITE ECU_ADDRESS 0x304418 /end MEASUREMENT
/begin MEASUREMENT tpu_b.TICR "TPU3 Interrupt Configuration Register." UWORD FORMULA_0010 0 0.0 0.0 65535.0 READ_WRITE ECU_ADDRESS 0x304408 /end MEASUREMENT
/begin MEASUREMENT tpu_b.TPUMCR "TPU3 Module Configuration Register." UWORD FORMULA_0010 0 0.0 0.0 65535.0 READ_WRITE ECU_ADDRESS 0x304400 /end MEASUREMENT
/begin MEASUREMENT tpu_b.TPUMCR2 "TPU Module Configuration Register 2." UWORD FORMULA_0010 0 0.0 0.0 65535.0 READ_WRITE ECU_ADDRESS 0x304428 /end MEASUREMENT
/begin MEASUREMENT tpu_b.TPUMCR3 "TPU Module Configuration Register 3." UWORD FORMULA_0010 0 0.0 0.0 65535.0 READ_WRITE ECU_ADDRESS 0x30442A /end MEASUREMENT
/begin MEASUREMENT tpu_b_htu "Hight-Time-Updater." UWORD FORMULA_KW9 0 0.0 0.0 2394.403076171875 READ_WRITE ECU_ADDRESS 0x304510 /end MEASUREMENT
/begin MEASUREMENT tpu_b_kw_cnt_720 "720° Zahnzaehler." UWORD FORMULA_KW1 0 0.0 0.0 119.0 READ_WRITE BIT_MASK 0xFF00 ECU_ADDRESS 0x30450C /end MEASUREMENT
/begin MEASUREMENT tpu_b_kw_cnt_cor "Feinaufloesung vom Zahnzaehler." UWORD FORMULA_KW6 0 0.0 0.0 42747.69140625 READ_WRITE BIT_MASK 0xFF00 ECU_ADDRESS 0x30450A /end MEASUREMENT
/begin MEASUREMENT tpu_b_kw_count "Kurbelwellenposition." UWORD FORMULA_KW10 0 0.0 0.0 719.989013671875 READ_WRITE ECU_ADDRESS 0x304512 /end MEASUREMENT
/begin MEASUREMENT tpu_b_kw_irq "Interrupt request." UWORD FORMULA_KW1 0 0.0 0.0 255.0 READ_WRITE BIT_MASK 0xFF00 ECU_ADDRESS 0x304500 /end MEASUREMENT
/begin MEASUREMENT tpu_b_kw_irq_ack "Interruptquittierung." UWORD FORMULA_KW1 0 0.0 0.0 255.0 READ_WRITE BIT_MASK 0xFF00 ECU_ADDRESS 0x304502 /end MEASUREMENT
/begin MEASUREMENT tpu_b_kw_irq_zahn "Interruptzahn." UWORD FORMULA_KW4 0 0.0 0.0 119.0 READ_WRITE BIT_MASK 0xFF ECU_ADDRESS 0x304502 /end MEASUREMENT
/begin MEASUREMENT tpu_b_kw_last_event_time "Zeitpunkt vom letzten Ereignis." ULONG FORMULA_KW8 0 0.0 0.0 2396.745 READ_WRITE BIT_MASK 0xFFFFFF ECU_ADDRESS 0x30451C /end MEASUREMENT
/begin MEASUREMENT tpu_b_kw_last_period_high "8 msb der letzten Periode." UWORD FORMULA_KW12 0 0.0 0.0 255.0 READ_WRITE BIT_MASK 0xFF00 ECU_ADDRESS 0x304516 /end MEASUREMENT
/begin MEASUREMENT tpu_b_kw_last_period_low "16 lsb der letzten Periode." UWORD FORMULA_KW11 0 0.0 0.0 9.362099647521973 READ_WRITE ECU_ADDRESS 0x304514 /end MEASUREMENT
/begin MEASUREMENT tpu_b_kw_last_trans_time "Zeitpunkt letzter Zahnflanke." ULONG FORMULA_KW8 0 0.0 0.0 2396.745 READ_WRITE BIT_MASK 0xFFFFFF ECU_ADDRESS 0x3045DA /end MEASUREMENT
/begin MEASUREMENT tpu_b_kw_link "Link-Vektor." UWORD FORMULA_KW4 0 0.0 0.0 65535.0 READ_WRITE ECU_ADDRESS 0x304506 /end MEASUREMENT
/begin MEASUREMENT tpu_b_kw_max_teeth_unsync "Max Anzahl Flanken zur Lueckensuche." UWORD FORMULA_KW1 0 0.0 0.0 127.0 READ_WRITE BIT_MASK 0xFF00 ECU_ADDRESS 0x30450A /end MEASUREMENT
/begin MEASUREMENT tpu_b_kw_next_segm_tooth "Naechster Segmentzahn." UWORD FORMULA_KW4 0 0.0 0.0 119.0 READ_WRITE BIT_MASK 0xFF ECU_ADDRESS 0x30450A /end MEASUREMENT
/begin MEASUREMENT tpu_b_kw_norm_period "normierte Periode." ULONG FORMULA_KW13 0 0.0 0.0 2396.745 READ_WRITE BIT_MASK 0xFFFFFF00 ECU_ADDRESS 0x30451A /end MEASUREMENT
/begin MEASUREMENT tpu_b_kw_nw_lev "A-NW Pegel bei IRQ-Zahn." UWORD FORMULA_KW2 0 0.0 0.0 3.0 READ_WRITE BIT_MASK 0xC0 ECU_ADDRESS 0x304500 /end MEASUREMENT
/begin MEASUREMENT tpu_b_kw_prev_period "Vorhergehende Periode." ULONG FORMULA_KW8 0 0.0 0.0 2396.745 READ_WRITE BIT_MASK 0xFFFFFF ECU_ADDRESS 0x304516 /end MEASUREMENT
/begin MEASUREMENT tpu_b_kw_segm_length "Segmentlaenge." UWORD FORMULA_KW4 0 0.0 0.0 119.0 READ_WRITE BIT_MASK 0xFF ECU_ADDRESS 0x304508 /end MEASUREMENT
/begin MEASUREMENT tpu_b_kw_segm_start "Segmentstart." UWORD FORMULA_KW1 0 0.0 0.0 119.0 READ_WRITE BIT_MASK 0xFF00 ECU_ADDRESS 0x304508 /end MEASUREMENT
/begin MEASUREMENT tpu_b_kw_segm_zeit "Segmentzeitpunkt." ULONG FORMULA_KW8 0 0.0 0.0 2396.745 READ_WRITE BIT_MASK 0xFFFFFF ECU_ADDRESS 0x30450C /end MEASUREMENT
/begin MEASUREMENT tpu_b_kw_state "Zustand." UWORD FORMULA_KW3 0 0.0 0.0 15.0 READ_WRITE BIT_MASK 0xF ECU_ADDRESS 0x304500 /end MEASUREMENT
/begin MEASUREMENT tpu_b_kw_time_out "Unterdrehzahl." UWORD FORMULA_KW5 0 0.0 4.0 10000.0 READ_WRITE ECU_ADDRESS 0x304504 /end MEASUREMENT
/begin MEASUREMENT tpu_b_kw_wait_teeth "Zahnentprellung vor Lueckensuche." UWORD FORMULA_KW4 0 0.0 0.0 127.0 READ_WRITE BIT_MASK 0xFF ECU_ADDRESS 0x30450A /end MEASUREMENT
/begin MEASUREMENT tpu_b_pram "Parameter RAM." UWORD FORMULA_0010 0 0.0 0.0 65535.0 READ_WRITE ARRAY_SIZE 128 ECU_ADDRESS 0x304500 MATRIX_DIM 128 1 1 /end MEASUREMENT
/begin MEASUREMENT tpu_bank "aktuelle Bank" UBYTE FORMULA_0408 0 0.0 1.0 2.0 READ_WRITE ECU_ADDRESS 0x3FD29E /end MEASUREMENT
/begin MEASUREMENT tpu_code_status "TPU MicroCode Status." UWORD FORMULA_0010 0 0.0 0.0 65535.0 READ_WRITE ECU_ADDRESS 0x3FD298 /end MEASUREMENT
/begin MEASUREMENT tpu_dio_config_kw_gap "TPU DIO config." UWORD FORMULA_DIO1 0 0.0 0.0 511.0 READ_WRITE BIT_MASK 0x1FF ECU_ADDRESS 0x3045D0 /end MEASUREMENT
/begin MEASUREMENT tpu_dio_irq_cnt_kw_gap "TPU DIO interrupt counter." UWORD FORMULA_DIO2 0 0.0 0.0 65535.0 READ_WRITE ECU_ADDRESS 0x3045D2 /end MEASUREMENT
/begin MEASUREMENT tpu_dio_pin_level_kw_gap "TPU DIO pin level." UWORD FORMULA_DIO2 0 0 0.0 255.0 READ_WRITE BIT_MASK 0x1 ECU_ADDRESS 0x3045D0 /end MEASUREMENT
/begin MEASUREMENT tpu_dio_pulse_time_kw_gap "TPU DIO pulse time." UWORD FORMULA_DIO3 0 0.0 0.0 9.362099647521973 READ_WRITE BIT_MASK 0x7FFF ECU_ADDRESS 0x3045D2 /end MEASUREMENT
/begin MEASUREMENT tpu_idx_a "Segmentindex auf TPU" UBYTE FORMULA_0003 0 0.0 0.0 5.0 READ_WRITE ECU_ADDRESS 0x3FD2A2 /end MEASUREMENT
/begin MEASUREMENT tpu_idx_b "Segmentindex auf TPU" UBYTE FORMULA_0003 0 0.0 0.0 5.0 READ_WRITE ECU_ADDRESS 0x3FD2A3 /end MEASUREMENT
/begin MEASUREMENT tpu_index "Segmentindex fuer den Gesamtmotor" UBYTE FORMULA_0003 0 0.0 0.0 11.0 READ_WRITE ECU_ADDRESS 0x3FD2A0 /end MEASUREMENT
/begin MEASUREMENT tpu_inj_copy_time_zyl1 "TPU INJ copy time." ULONG FORMULA_INJ3 0 0.0 0.0 40.0 READ_WRITE BIT_MASK 0x3FFFFF ECU_ADDRESS 0x30412C /end MEASUREMENT
/begin MEASUREMENT tpu_inj_copy_time_zyl10 "TPU INJ copy time." ULONG FORMULA_INJ3 0 0.0 0.0 40.0 READ_WRITE BIT_MASK 0x3FFFFF ECU_ADDRESS 0x3041BC /end MEASUREMENT
/begin MEASUREMENT tpu_inj_copy_time_zyl2 "TPU INJ copy time." ULONG FORMULA_INJ3 0 0.0 0.0 40.0 READ_WRITE BIT_MASK 0x3FFFFF ECU_ADDRESS 0x30413C /end MEASUREMENT
/begin MEASUREMENT tpu_inj_copy_time_zyl3 "TPU INJ copy time." ULONG FORMULA_INJ3 0 0.0 0.0 40.0 READ_WRITE BIT_MASK 0x3FFFFF ECU_ADDRESS 0x30414C /end MEASUREMENT
/begin MEASUREMENT tpu_inj_copy_time_zyl4 "TPU INJ copy time." ULONG FORMULA_INJ3 0 0.0 0.0 40.0 READ_WRITE BIT_MASK 0x3FFFFF ECU_ADDRESS 0x30415C /end MEASUREMENT
/begin MEASUREMENT tpu_inj_copy_time_zyl5 "TPU INJ copy time." ULONG FORMULA_INJ3 0 0.0 0.0 40.0 READ_WRITE BIT_MASK 0x3FFFFF ECU_ADDRESS 0x30416C /end MEASUREMENT
/begin MEASUREMENT tpu_inj_copy_time_zyl6 "TPU INJ copy time." ULONG FORMULA_INJ3 0 0.0 0.0 40.0 READ_WRITE BIT_MASK 0x3FFFFF ECU_ADDRESS 0x30417C /end MEASUREMENT
/begin MEASUREMENT tpu_inj_copy_time_zyl7 "TPU INJ copy time." ULONG FORMULA_INJ3 0 0.0 0.0 40.0 READ_WRITE BIT_MASK 0x3FFFFF ECU_ADDRESS 0x30418C /end MEASUREMENT
/begin MEASUREMENT tpu_inj_copy_time_zyl8 "TPU INJ copy time." ULONG FORMULA_INJ3 0 0.0 0.0 40.0 READ_WRITE BIT_MASK 0x3FFFFF ECU_ADDRESS 0x30419C /end MEASUREMENT
/begin MEASUREMENT tpu_inj_copy_time_zyl9 "TPU INJ copy time." ULONG FORMULA_INJ3 0 0.0 0.0 40.0 READ_WRITE BIT_MASK 0x3FFFFF ECU_ADDRESS 0x3041AC /end MEASUREMENT
/begin MEASUREMENT tpu_inj_demand_time_zyl1 "TPU INJ demand time." ULONG FORMULA_INJ10 0 0.0 0.0 40.0 READ_WRITE BIT_MASK 0xFFFFFF ECU_ADDRESS 0x304120 /end MEASUREMENT
/begin MEASUREMENT tpu_inj_demand_time_zyl10 "TPU INJ demand time." ULONG FORMULA_INJ10 0 0.0 0.0 40.0 READ_WRITE BIT_MASK 0xFFFFFF ECU_ADDRESS 0x3041B0 /end MEASUREMENT
/begin MEASUREMENT tpu_inj_demand_time_zyl2 "TPU INJ demand time." ULONG FORMULA_INJ10 0 0.0 0.0 40.0 READ_WRITE BIT_MASK 0xFFFFFF ECU_ADDRESS 0x304130 /end MEASUREMENT
/begin MEASUREMENT tpu_inj_demand_time_zyl3 "TPU INJ demand time." ULONG FORMULA_INJ10 0 0.0 0.0 40.0 READ_WRITE BIT_MASK 0xFFFFFF ECU_ADDRESS 0x304140 /end MEASUREMENT
/begin MEASUREMENT tpu_inj_demand_time_zyl4 "TPU INJ demand time." ULONG FORMULA_INJ10 0 0.0 0.0 40.0 READ_WRITE BIT_MASK 0xFFFFFF ECU_ADDRESS 0x304150 /end MEASUREMENT
/begin MEASUREMENT tpu_inj_demand_time_zyl5 "TPU INJ demand time." ULONG FORMULA_INJ10 0 0.0 0.0 40.0 READ_WRITE BIT_MASK 0xFFFFFF ECU_ADDRESS 0x304160 /end MEASUREMENT
/begin MEASUREMENT tpu_inj_demand_time_zyl6 "TPU INJ demand time." ULONG FORMULA_INJ10 0 0.0 0.0 40.0 READ_WRITE BIT_MASK 0xFFFFFF ECU_ADDRESS 0x304170 /end MEASUREMENT
/begin MEASUREMENT tpu_inj_demand_time_zyl7 "TPU INJ demand time." ULONG FORMULA_INJ10 0 0.0 0.0 40.0 READ_WRITE BIT_MASK 0xFFFFFF ECU_ADDRESS 0x304180 /end MEASUREMENT
/begin MEASUREMENT tpu_inj_demand_time_zyl8 "TPU INJ demand time." ULONG FORMULA_INJ10 0 0.0 0.0 40.0 READ_WRITE BIT_MASK 0xFFFFFF ECU_ADDRESS 0x304190 /end MEASUREMENT
/begin MEASUREMENT tpu_inj_demand_time_zyl9 "TPU INJ demand time." ULONG FORMULA_INJ10 0 0.0 0.0 40.0 READ_WRITE BIT_MASK 0xFFFFFF ECU_ADDRESS 0x3041A0 /end MEASUREMENT
/begin MEASUREMENT tpu_inj_end_angle_b1 "TPU INJ end angle." UWORD FORMULA_INJ1 0 0.0 0.0 719.989013671875 READ_WRITE ECU_ADDRESS 0x3041E0 /end MEASUREMENT
/begin MEASUREMENT tpu_inj_end_angle_b2 "TPU INJ end angle." UWORD FORMULA_INJ1 0 0.0 0.0 719.989013671875 READ_WRITE ECU_ADDRESS 0x3041F0 /end MEASUREMENT
/begin MEASUREMENT tpu_inj_end_angle_zyl1 "TPU INJ end angle." UWORD FORMULA_INJ1 0 0.0 0.0 719.989013671875 READ_WRITE ECU_ADDRESS 0x304124 /end MEASUREMENT
/begin MEASUREMENT tpu_inj_end_angle_zyl10 "TPU INJ end angle." UWORD FORMULA_INJ1 0 0.0 0.0 719.989013671875 READ_WRITE ECU_ADDRESS 0x3041B4 /end MEASUREMENT
/begin MEASUREMENT tpu_inj_end_angle_zyl2 "TPU INJ end angle." UWORD FORMULA_INJ1 0 0.0 0.0 719.989013671875 READ_WRITE ECU_ADDRESS 0x304134 /end MEASUREMENT
/begin MEASUREMENT tpu_inj_end_angle_zyl3 "TPU INJ end angle." UWORD FORMULA_INJ1 0 0.0 0.0 719.989013671875 READ_WRITE ECU_ADDRESS 0x304144 /end MEASUREMENT
/begin MEASUREMENT tpu_inj_end_angle_zyl4 "TPU INJ end angle." UWORD FORMULA_INJ1 0 0.0 0.0 719.989013671875 READ_WRITE ECU_ADDRESS 0x304154 /end MEASUREMENT
/begin MEASUREMENT tpu_inj_end_angle_zyl5 "TPU INJ end angle." UWORD FORMULA_INJ1 0 0.0 0.0 719.989013671875 READ_WRITE ECU_ADDRESS 0x304164 /end MEASUREMENT
/begin MEASUREMENT tpu_inj_end_angle_zyl6 "TPU INJ end angle." UWORD FORMULA_INJ1 0 0.0 0.0 719.989013671875 READ_WRITE ECU_ADDRESS 0x304174 /end MEASUREMENT
/begin MEASUREMENT tpu_inj_end_angle_zyl7 "TPU INJ end angle." UWORD FORMULA_INJ1 0 0.0 0.0 719.989013671875 READ_WRITE ECU_ADDRESS 0x304184 /end MEASUREMENT
/begin MEASUREMENT tpu_inj_end_angle_zyl8 "TPU INJ end angle." UWORD FORMULA_INJ1 0 0.0 0.0 719.989013671875 READ_WRITE ECU_ADDRESS 0x304194 /end MEASUREMENT
/begin MEASUREMENT tpu_inj_end_angle_zyl9 "TPU INJ end angle." UWORD FORMULA_INJ1 0 0.0 0.0 719.989013671875 READ_WRITE ECU_ADDRESS 0x3041A4 /end MEASUREMENT
/begin MEASUREMENT tpu_inj_first_zyl1 "TPU INJ first." UWORD FORMULA_INJ6 0 0 0.0 255.0 READ_WRITE BIT_MASK 0x4000 ECU_ADDRESS 0x30412A /end MEASUREMENT
/begin MEASUREMENT tpu_inj_first_zyl10 "TPU INJ first." UWORD FORMULA_INJ6 0 0 0.0 255.0 READ_WRITE BIT_MASK 0x4000 ECU_ADDRESS 0x3041BA /end MEASUREMENT
/begin MEASUREMENT tpu_inj_first_zyl2 "TPU INJ first." UWORD FORMULA_INJ6 0 0 0.0 255.0 READ_WRITE BIT_MASK 0x4000 ECU_ADDRESS 0x30413A /end MEASUREMENT
/begin MEASUREMENT tpu_inj_first_zyl3 "TPU INJ first." UWORD FORMULA_INJ6 0 0 0.0 255.0 READ_WRITE BIT_MASK 0x4000 ECU_ADDRESS 0x30414A /end MEASUREMENT
/begin MEASUREMENT tpu_inj_first_zyl4 "TPU INJ first." UWORD FORMULA_INJ6 0 0 0.0 255.0 READ_WRITE BIT_MASK 0x4000 ECU_ADDRESS 0x30415A /end MEASUREMENT
/begin MEASUREMENT tpu_inj_first_zyl5 "TPU INJ first." UWORD FORMULA_INJ6 0 0 0.0 255.0 READ_WRITE BIT_MASK 0x4000 ECU_ADDRESS 0x30416A /end MEASUREMENT
/begin MEASUREMENT tpu_inj_first_zyl6 "TPU INJ first." UWORD FORMULA_INJ6 0 0 0.0 255.0 READ_WRITE BIT_MASK 0x4000 ECU_ADDRESS 0x30417A /end MEASUREMENT
/begin MEASUREMENT tpu_inj_first_zyl7 "TPU INJ first." UWORD FORMULA_INJ6 0 0 0.0 255.0 READ_WRITE BIT_MASK 0x4000 ECU_ADDRESS 0x30418A /end MEASUREMENT
/begin MEASUREMENT tpu_inj_first_zyl8 "TPU INJ first." UWORD FORMULA_INJ6 0 0 0.0 255.0 READ_WRITE BIT_MASK 0x4000 ECU_ADDRESS 0x30419A /end MEASUREMENT
/begin MEASUREMENT tpu_inj_first_zyl9 "TPU INJ first." UWORD FORMULA_INJ6 0 0 0.0 255.0 READ_WRITE BIT_MASK 0x4000 ECU_ADDRESS 0x3041AA /end MEASUREMENT
/begin MEASUREMENT tpu_inj_main_zyl1 "TPU INJ main." UWORD FORMULA_INJ5 0 0 0.0 255.0 READ_WRITE BIT_MASK 0x8000 ECU_ADDRESS 0x30412A /end MEASUREMENT
/begin MEASUREMENT tpu_inj_main_zyl10 "TPU INJ main." UWORD FORMULA_INJ5 0 0 0.0 255.0 READ_WRITE BIT_MASK 0x8000 ECU_ADDRESS 0x3041BA /end MEASUREMENT
/begin MEASUREMENT tpu_inj_main_zyl2 "TPU INJ main." UWORD FORMULA_INJ5 0 0 0.0 255.0 READ_WRITE BIT_MASK 0x8000 ECU_ADDRESS 0x30413A /end MEASUREMENT
/begin MEASUREMENT tpu_inj_main_zyl3 "TPU INJ main." UWORD FORMULA_INJ5 0 0 0.0 255.0 READ_WRITE BIT_MASK 0x8000 ECU_ADDRESS 0x30414A /end MEASUREMENT
/begin MEASUREMENT tpu_inj_main_zyl4 "TPU INJ main." UWORD FORMULA_INJ5 0 0 0.0 255.0 READ_WRITE BIT_MASK 0x8000 ECU_ADDRESS 0x30415A /end MEASUREMENT
/begin MEASUREMENT tpu_inj_main_zyl5 "TPU INJ main." UWORD FORMULA_INJ5 0 0 0.0 255.0 READ_WRITE BIT_MASK 0x8000 ECU_ADDRESS 0x30416A /end MEASUREMENT
/begin MEASUREMENT tpu_inj_main_zyl6 "TPU INJ main." UWORD FORMULA_INJ5 0 0 0.0 255.0 READ_WRITE BIT_MASK 0x8000 ECU_ADDRESS 0x30417A /end MEASUREMENT
/begin MEASUREMENT tpu_inj_main_zyl7 "TPU INJ main." UWORD FORMULA_INJ5 0 0 0.0 255.0 READ_WRITE BIT_MASK 0x8000 ECU_ADDRESS 0x30418A /end MEASUREMENT
/begin MEASUREMENT tpu_inj_main_zyl8 "TPU INJ main." UWORD FORMULA_INJ5 0 0 0.0 255.0 READ_WRITE BIT_MASK 0x8000 ECU_ADDRESS 0x30419A /end MEASUREMENT
/begin MEASUREMENT tpu_inj_main_zyl9 "TPU INJ main." UWORD FORMULA_INJ5 0 0 0.0 255.0 READ_WRITE BIT_MASK 0x8000 ECU_ADDRESS 0x3041AA /end MEASUREMENT
/begin MEASUREMENT tpu_inj_min_off_time_b1 "TPU INJ min off time." UWORD FORMULA_INJ2 0 0.0 0.0 9.362099647521973 READ_WRITE ECU_ADDRESS 0x3041E8 /end MEASUREMENT
/begin MEASUREMENT tpu_inj_min_off_time_b2 "TPU INJ min off time." UWORD FORMULA_INJ2 0 0.0 0.0 9.362099647521973 READ_WRITE ECU_ADDRESS 0x3041F8 /end MEASUREMENT
/begin MEASUREMENT tpu_inj_min_off_zyl1 "TPU INJ min off." UWORD FORMULA_INJ7 0 0 0.0 255.0 READ_WRITE BIT_MASK 0x80 ECU_ADDRESS 0x30412C /end MEASUREMENT
/begin MEASUREMENT tpu_inj_min_off_zyl10 "TPU INJ min off." UWORD FORMULA_INJ7 0 0 0.0 255.0 READ_WRITE BIT_MASK 0x80 ECU_ADDRESS 0x3041BC /end MEASUREMENT
/begin MEASUREMENT tpu_inj_min_off_zyl2 "TPU INJ min off." UWORD FORMULA_INJ7 0 0 0.0 255.0 READ_WRITE BIT_MASK 0x80 ECU_ADDRESS 0x30413C /end MEASUREMENT
/begin MEASUREMENT tpu_inj_min_off_zyl3 "TPU INJ min off." UWORD FORMULA_INJ7 0 0 0.0 255.0 READ_WRITE BIT_MASK 0x80 ECU_ADDRESS 0x30414C /end MEASUREMENT
/begin MEASUREMENT tpu_inj_min_off_zyl4 "TPU INJ min off." UWORD FORMULA_INJ7 0 0 0.0 255.0 READ_WRITE BIT_MASK 0x80 ECU_ADDRESS 0x30415C /end MEASUREMENT
/begin MEASUREMENT tpu_inj_min_off_zyl5 "TPU INJ min off." UWORD FORMULA_INJ7 0 0 0.0 255.0 READ_WRITE BIT_MASK 0x80 ECU_ADDRESS 0x30416C /end MEASUREMENT
/begin MEASUREMENT tpu_inj_min_off_zyl6 "TPU INJ min off." UWORD FORMULA_INJ7 0 0 0.0 255.0 READ_WRITE BIT_MASK 0x80 ECU_ADDRESS 0x30417C /end MEASUREMENT
/begin MEASUREMENT tpu_inj_min_off_zyl7 "TPU INJ min off." UWORD FORMULA_INJ7 0 0 0.0 255.0 READ_WRITE BIT_MASK 0x80 ECU_ADDRESS 0x30418C /end MEASUREMENT
/begin MEASUREMENT tpu_inj_min_off_zyl8 "TPU INJ min off." UWORD FORMULA_INJ7 0 0 0.0 255.0 READ_WRITE BIT_MASK 0x80 ECU_ADDRESS 0x30419C /end MEASUREMENT
/begin MEASUREMENT tpu_inj_min_off_zyl9 "TPU INJ min off." UWORD FORMULA_INJ7 0 0 0.0 255.0 READ_WRITE BIT_MASK 0x80 ECU_ADDRESS 0x3041AC /end MEASUREMENT
/begin MEASUREMENT tpu_inj_min_time_b1 "TPU INJ min time." UWORD FORMULA_INJ2 0 0.0 0.0 9.362099647521973 READ_WRITE ECU_ADDRESS 0x3041E4 /end MEASUREMENT
/begin MEASUREMENT tpu_inj_min_time_b2 "TPU INJ min time." UWORD FORMULA_INJ2 0 0.0 0.0 9.362099647521973 READ_WRITE ECU_ADDRESS 0x3041F4 /end MEASUREMENT
/begin MEASUREMENT tpu_inj_miss_zyl1 "TPU INJ miss." UWORD FORMULA_INJ8 0 0 0.0 255.0 READ_WRITE BIT_MASK 0x40 ECU_ADDRESS 0x30412C /end MEASUREMENT
/begin MEASUREMENT tpu_inj_miss_zyl10 "TPU INJ miss." UWORD FORMULA_INJ8 0 0 0.0 255.0 READ_WRITE BIT_MASK 0x40 ECU_ADDRESS 0x3041BC /end MEASUREMENT
/begin MEASUREMENT tpu_inj_miss_zyl2 "TPU INJ miss." UWORD FORMULA_INJ8 0 0 0.0 255.0 READ_WRITE BIT_MASK 0x40 ECU_ADDRESS 0x30413C /end MEASUREMENT
/begin MEASUREMENT tpu_inj_miss_zyl3 "TPU INJ miss." UWORD FORMULA_INJ8 0 0 0.0 255.0 READ_WRITE BIT_MASK 0x40 ECU_ADDRESS 0x30414C /end MEASUREMENT
/begin MEASUREMENT tpu_inj_miss_zyl4 "TPU INJ miss." UWORD FORMULA_INJ8 0 0 0.0 255.0 READ_WRITE BIT_MASK 0x40 ECU_ADDRESS 0x30415C /end MEASUREMENT
/begin MEASUREMENT tpu_inj_miss_zyl5 "TPU INJ miss." UWORD FORMULA_INJ8 0 0 0.0 255.0 READ_WRITE BIT_MASK 0x40 ECU_ADDRESS 0x30416C /end MEASUREMENT
/begin MEASUREMENT tpu_inj_miss_zyl6 "TPU INJ miss." UWORD FORMULA_INJ8 0 0 0.0 255.0 READ_WRITE BIT_MASK 0x40 ECU_ADDRESS 0x30417C /end MEASUREMENT
/begin MEASUREMENT tpu_inj_miss_zyl7 "TPU INJ miss." UWORD FORMULA_INJ8 0 0 0.0 255.0 READ_WRITE BIT_MASK 0x40 ECU_ADDRESS 0x30418C /end MEASUREMENT
/begin MEASUREMENT tpu_inj_miss_zyl8 "TPU INJ miss." UWORD FORMULA_INJ8 0 0 0.0 255.0 READ_WRITE BIT_MASK 0x40 ECU_ADDRESS 0x30419C /end MEASUREMENT
/begin MEASUREMENT tpu_inj_miss_zyl9 "TPU INJ miss." UWORD FORMULA_INJ8 0 0 0.0 255.0 READ_WRITE BIT_MASK 0x40 ECU_ADDRESS 0x3041AC /end MEASUREMENT
/begin MEASUREMENT tpu_inj_offset_time_b1 "TPU INJ offset time." UWORD FORMULA_INJ2 0 0.0 0.0 9.362099647521973 READ_WRITE ECU_ADDRESS 0x3041E6 /end MEASUREMENT
/begin MEASUREMENT tpu_inj_offset_time_b2 "TPU INJ offset time." UWORD FORMULA_INJ2 0 0.0 0.0 9.362099647521973 READ_WRITE ECU_ADDRESS 0x3041F6 /end MEASUREMENT
/begin MEASUREMENT tpu_inj_out_time_high_zyl1 "TPU INJ out time high." UWORD FORMULA_INJ9 0 0.0 0.0 40.0 READ_WRITE BIT_MASK 0xFF00 ECU_ADDRESS 0x30412C /end MEASUREMENT
/begin MEASUREMENT tpu_inj_out_time_high_zyl10 "TPU INJ out time high." UWORD FORMULA_INJ9 0 0.0 0.0 40.0 READ_WRITE BIT_MASK 0xFF00 ECU_ADDRESS 0x3041BC /end MEASUREMENT
/begin MEASUREMENT tpu_inj_out_time_high_zyl2 "TPU INJ out time high." UWORD FORMULA_INJ9 0 0.0 0.0 40.0 READ_WRITE BIT_MASK 0xFF00 ECU_ADDRESS 0x30413C /end MEASUREMENT
/begin MEASUREMENT tpu_inj_out_time_high_zyl3 "TPU INJ out time high." UWORD FORMULA_INJ9 0 0.0 0.0 40.0 READ_WRITE BIT_MASK 0xFF00 ECU_ADDRESS 0x30414C /end MEASUREMENT
/begin MEASUREMENT tpu_inj_out_time_high_zyl4 "TPU INJ out time high." UWORD FORMULA_INJ9 0 0.0 0.0 40.0 READ_WRITE BIT_MASK 0xFF00 ECU_ADDRESS 0x30415C /end MEASUREMENT
/begin MEASUREMENT tpu_inj_out_time_high_zyl5 "TPU INJ out time high." UWORD FORMULA_INJ9 0 0.0 0.0 40.0 READ_WRITE BIT_MASK 0xFF00 ECU_ADDRESS 0x30416C /end MEASUREMENT
/begin MEASUREMENT tpu_inj_out_time_high_zyl6 "TPU INJ out time high." UWORD FORMULA_INJ9 0 0.0 0.0 40.0 READ_WRITE BIT_MASK 0xFF00 ECU_ADDRESS 0x30417C /end MEASUREMENT
/begin MEASUREMENT tpu_inj_out_time_high_zyl7 "TPU INJ out time high." UWORD FORMULA_INJ9 0 0.0 0.0 40.0 READ_WRITE BIT_MASK 0xFF00 ECU_ADDRESS 0x30418C /end MEASUREMENT
/begin MEASUREMENT tpu_inj_out_time_high_zyl8 "TPU INJ out time high." UWORD FORMULA_INJ9 0 0.0 0.0 40.0 READ_WRITE BIT_MASK 0xFF00 ECU_ADDRESS 0x30419C /end MEASUREMENT
/begin MEASUREMENT tpu_inj_out_time_high_zyl9 "TPU INJ out time high." UWORD FORMULA_INJ9 0 0.0 0.0 40.0 READ_WRITE BIT_MASK 0xFF00 ECU_ADDRESS 0x3041AC /end MEASUREMENT
/begin MEASUREMENT tpu_inj_out_time_low_zyl1 "TPU INJ out time low." UWORD FORMULA_INJ3 0 0.0 0.0 40.0 READ_WRITE BIT_MASK 0x3FFF ECU_ADDRESS 0x30412A /end MEASUREMENT
/begin MEASUREMENT tpu_inj_out_time_low_zyl10 "TPU INJ out time low." UWORD FORMULA_INJ3 0 0.0 0.0 40.0 READ_WRITE BIT_MASK 0x3FFF ECU_ADDRESS 0x3041BA /end MEASUREMENT
/begin MEASUREMENT tpu_inj_out_time_low_zyl2 "TPU INJ out time low." UWORD FORMULA_INJ3 0 0.0 0.0 40.0 READ_WRITE BIT_MASK 0x3FFF ECU_ADDRESS 0x30413A /end MEASUREMENT
/begin MEASUREMENT tpu_inj_out_time_low_zyl3 "TPU INJ out time low." UWORD FORMULA_INJ3 0 0.0 0.0 40.0 READ_WRITE BIT_MASK 0x3FFF ECU_ADDRESS 0x30414A /end MEASUREMENT
/begin MEASUREMENT tpu_inj_out_time_low_zyl4 "TPU INJ out time low." UWORD FORMULA_INJ3 0 0.0 0.0 40.0 READ_WRITE BIT_MASK 0x3FFF ECU_ADDRESS 0x30415A /end MEASUREMENT
/begin MEASUREMENT tpu_inj_out_time_low_zyl5 "TPU INJ out time low." UWORD FORMULA_INJ3 0 0.0 0.0 40.0 READ_WRITE BIT_MASK 0x3FFF ECU_ADDRESS 0x30416A /end MEASUREMENT
/begin MEASUREMENT tpu_inj_out_time_low_zyl6 "TPU INJ out time low." UWORD FORMULA_INJ3 0 0.0 0.0 40.0 READ_WRITE BIT_MASK 0x3FFF ECU_ADDRESS 0x30417A /end MEASUREMENT
/begin MEASUREMENT tpu_inj_out_time_low_zyl7 "TPU INJ out time low." UWORD FORMULA_INJ3 0 0.0 0.0 40.0 READ_WRITE BIT_MASK 0x3FFF ECU_ADDRESS 0x30418A /end MEASUREMENT
/begin MEASUREMENT tpu_inj_out_time_low_zyl8 "TPU INJ out time low." UWORD FORMULA_INJ3 0 0.0 0.0 40.0 READ_WRITE BIT_MASK 0x3FFF ECU_ADDRESS 0x30419A /end MEASUREMENT
/begin MEASUREMENT tpu_inj_out_time_low_zyl9 "TPU INJ out time low." UWORD FORMULA_INJ3 0 0.0 0.0 40.0 READ_WRITE BIT_MASK 0x3FFF ECU_ADDRESS 0x3041AA /end MEASUREMENT
/begin MEASUREMENT tpu_inj_phase_angle_b1 "TPU INJ phase angle." UWORD FORMULA_INJ1 0 0.0 0.0 719.989013671875 READ_WRITE ECU_ADDRESS 0x3041E2 /end MEASUREMENT
/begin MEASUREMENT tpu_inj_phase_angle_b2 "TPU INJ phase angle." UWORD FORMULA_INJ1 0 0.0 0.0 719.989013671875 READ_WRITE ECU_ADDRESS 0x3041F2 /end MEASUREMENT
/begin MEASUREMENT tpu_inj_start_time_high_zyl1 "TPU INJ start time high." UWORD FORMULA_INJ11 0 0.0 0.0 2396.7451171875 READ_WRITE BIT_MASK 0xFF00 ECU_ADDRESS 0x304126 /end MEASUREMENT
/begin MEASUREMENT tpu_inj_start_time_high_zyl10 "TPU INJ start time high." UWORD FORMULA_INJ11 0 0.0 0.0 2396.7451171875 READ_WRITE BIT_MASK 0xFF00 ECU_ADDRESS 0x3041B6 /end MEASUREMENT
/begin MEASUREMENT tpu_inj_start_time_high_zyl2 "TPU INJ start time high." UWORD FORMULA_INJ11 0 0.0 0.0 2396.7451171875 READ_WRITE BIT_MASK 0xFF00 ECU_ADDRESS 0x304136 /end MEASUREMENT
/begin MEASUREMENT tpu_kw_irq_a "Letzte KW Interruptart." UBYTE FORMULA_0409 0 0.0 0.0 255.0 READ_WRITE ECU_ADDRESS 0x3FD2A6 /end MEASUREMENT
/begin MEASUREMENT tpu_kw_irq_b "Letzte KW Interruptart." UBYTE FORMULA_0409 0 0.0 0.0 255.0 READ_WRITE ECU_ADDRESS 0x3FD2A7 /end MEASUREMENT
/begin MEASUREMENT tpu_kw_irq_cnt_a "TPU Interruptzaehler." UBYTE FORMULA_0003 0 0.0 0.0 255.0 READ_WRITE ECU_ADDRESS 0x3FD2AA /end MEASUREMENT
/begin MEASUREMENT tpu_kw_irq_cnt_b "TPU Interruptzaehler." UBYTE FORMULA_0003 0 0.0 0.0 255.0 READ_WRITE ECU_ADDRESS 0x3FD2AB /end MEASUREMENT
/begin MEASUREMENT tpu_kw_irq_error_a "Fehlerinterrupt." UBYTE FORMULA_0414 0 0 0.0 255.0 READ_WRITE BIT_MASK 0x8 ECU_ADDRESS 0x3FD2A6 /end MEASUREMENT
/begin MEASUREMENT tpu_kw_irq_error_b "Fehlerinterrupt." UBYTE FORMULA_0414 0 0 0.0 255.0 READ_WRITE BIT_MASK 0x8 ECU_ADDRESS 0x3FD2A7 /end MEASUREMENT
/begin MEASUREMENT tpu_kw_irq_info_a "Infointerrupt (+/- ein Zahn)." UBYTE FORMULA_0417 0 0 0.0 255.0 READ_WRITE BIT_MASK 0x1 ECU_ADDRESS 0x3FD2A6 /end MEASUREMENT
/begin MEASUREMENT tpu_kw_irq_info_b "Infointerrupt (+/- ein Zahn)." UBYTE FORMULA_0417 0 0 0.0 255.0 READ_WRITE BIT_MASK 0x1 ECU_ADDRESS 0x3FD2A7 /end MEASUREMENT
/begin MEASUREMENT tpu_kw_irq_mess_a "Messfensterinterrupt (LU)." UBYTE FORMULA_0412 0 0 0.0 255.0 READ_WRITE BIT_MASK 0x20 ECU_ADDRESS 0x3FD2A6 /end MEASUREMENT
/begin MEASUREMENT tpu_kw_irq_mess_b "Messfensterinterrupt (LU)." UBYTE FORMULA_0412 0 0 0.0 255.0 READ_WRITE BIT_MASK 0x20 ECU_ADDRESS 0x3FD2A7 /end MEASUREMENT
/begin MEASUREMENT tpu_kw_irq_n_min_a "Unterdrehzahlinterrupt." UBYTE FORMULA_0413 0 0 0.0 255.0 READ_WRITE BIT_MASK 0x10 ECU_ADDRESS 0x3FD2A6 /end MEASUREMENT
/begin MEASUREMENT tpu_kw_irq_n_min_b "Unterdrehzahlinterrupt." UBYTE FORMULA_0413 0 0 0.0 255.0 READ_WRITE BIT_MASK 0x10 ECU_ADDRESS 0x3FD2A7 /end MEASUREMENT
/begin MEASUREMENT tpu_kw_irq_pre_sync_a "Pre-Sync-Interrupt (Start Lueckensuche)." UBYTE FORMULA_0415 0 0 0.0 255.0 READ_WRITE BIT_MASK 0x4 ECU_ADDRESS 0x3FD2A6 /end MEASUREMENT
/begin MEASUREMENT tpu_kw_irq_pre_sync_b "Pre-Sync-Interrupt (Start Lueckensuche)." UBYTE FORMULA_0415 0 0 0.0 255.0 READ_WRITE BIT_MASK 0x4 ECU_ADDRESS 0x3FD2A7 /end MEASUREMENT
/begin MEASUREMENT tpu_kw_irq_segm_a "Segmentinterrupt." UBYTE FORMULA_0411 0 0 0.0 255.0 READ_WRITE BIT_MASK 0x40 ECU_ADDRESS 0x3FD2A6 /end MEASUREMENT
/begin MEASUREMENT tpu_kw_irq_segm_b "Segmentinterrupt." UBYTE FORMULA_0411 0 0 0.0 255.0 READ_WRITE BIT_MASK 0x40 ECU_ADDRESS 0x3FD2A7 /end MEASUREMENT
/begin MEASUREMENT tpu_kw_irq_segm_cnt_a "Anzahl Segmentinterrupts." UBYTE FORMULA_0003 0 0.0 0.0 255.0 READ_WRITE ECU_ADDRESS 0x3FD2AC /end MEASUREMENT
/begin MEASUREMENT tpu_kw_irq_segm_cnt_b "Anzahl Segmentinterrupts." UBYTE FORMULA_0003 0 0.0 0.0 255.0 READ_WRITE ECU_ADDRESS 0x3FD2AD /end MEASUREMENT
/begin MEASUREMENT tpu_kw_irq_sync_a "Sync-Interrupt (Luecke gefunden)." UBYTE FORMULA_0416 0 0 0.0 255.0 READ_WRITE BIT_MASK 0x2 ECU_ADDRESS 0x3FD2A6 /end MEASUREMENT
/begin MEASUREMENT tpu_kw_irq_sync_b "Sync-Interrupt (Luecke gefunden)." UBYTE FORMULA_0416 0 0 0.0 255.0 READ_WRITE BIT_MASK 0x2 ECU_ADDRESS 0x3FD2A7 /end MEASUREMENT
/begin MEASUREMENT tpu_kw_irq_tooth_a "Zahninterrupt." UBYTE FORMULA_0410 0 0 0.0 255.0 READ_WRITE BIT_MASK 0x80 ECU_ADDRESS 0x3FD2A6 /end MEASUREMENT
/begin MEASUREMENT tpu_kw_irq_tooth_b "Zahninterrupt." UBYTE FORMULA_0410 0 0 0.0 255.0 READ_WRITE BIT_MASK 0x80 ECU_ADDRESS 0x3FD2A7 /end MEASUREMENT
/begin MEASUREMENT tpu_kw_irq_tooth_cnt_a "Zahninterruptzaehler." UBYTE FORMULA_0003 0 0.0 0.0 255.0 READ_WRITE ECU_ADDRESS 0x3FD2AE /end MEASUREMENT
/begin MEASUREMENT tpu_kw_irq_tooth_cnt_b "Zahninterruptzaehler." UBYTE FORMULA_0003 0 0.0 0.0 255.0 READ_WRITE ECU_ADDRESS 0x3FD2AF /end MEASUREMENT
/begin MEASUREMENT tpu_kw_irq_zahn_a "Zahnnummer TPU bei Eintritt in ISR." UBYTE FORMULA_0003 0 0.0 0.0 255.0 READ_WRITE ECU_ADDRESS 0x3FD2A8 /end MEASUREMENT
/begin MEASUREMENT tpu_kw_irq_zahn_b "Zahnnummer TPU bei Eintritt in ISR." UBYTE FORMULA_0003 0 0.0 0.0 255.0 READ_WRITE ECU_ADDRESS 0x3FD2A9 /end MEASUREMENT
/begin MEASUREMENT tpu_kw_nw_sync_cnt_a "Umsynchronisationszaehler" UBYTE FORMULA_0003 0 0.0 0.0 255.0 READ_WRITE ECU_ADDRESS 0x3FD2A4 /end MEASUREMENT
/begin MEASUREMENT tpu_kw_nw_sync_cnt_b "Umsynchronisationszaehler" UBYTE FORMULA_0003 0 0.0 0.0 255.0 READ_WRITE ECU_ADDRESS 0x3FD2A5 /end MEASUREMENT
/begin MEASUREMENT tpu_kw_rot "Rotation." UBYTE FORMULA_0003 0 0.0 0.0 1.0 READ_WRITE ECU_ADDRESS 0x3FD2A1 /end MEASUREMENT
/begin MEASUREMENT tpu_nw_pos_b1 "Position des NW-Impulses" UBYTE FORMULA_0003 0 0.0 0.0 255.0 READ_WRITE ECU_ADDRESS 0x3FC8C0 /end MEASUREMENT
/begin MEASUREMENT tpu_nw_pos_b2 "Position des NW-Impulses" UBYTE FORMULA_0003 0 0.0 0.0 255.0 READ_WRITE ECU_ADDRESS 0x3FC8C1 /end MEASUREMENT
/begin MEASUREMENT tpu_st_a "Status TPU Synchronisation" UBYTE FORMULA_0407 0 0.0 0.0 255.0 READ_WRITE ECU_ADDRESS 0x3FD29A /end MEASUREMENT
/begin MEASUREMENT tpu_st_b "Status TPU Synchronisation" UBYTE FORMULA_0407 0 0.0 0.0 255.0 READ_WRITE ECU_ADDRESS 0x3FD29B /end MEASUREMENT
/begin MEASUREMENT tpu_zyl "aktueller Zylinder" UBYTE FORMULA_0408 0 0.0 1.0 12.0 READ_WRITE ECU_ADDRESS 0x3FD29C /end MEASUREMENT
/begin MEASUREMENT tpu_zyl_bank "aktueller Zylinder der Bank" UBYTE FORMULA_0408 0 0.0 1.0 2.0 READ_WRITE ECU_ADDRESS 0x3FD29F /end MEASUREMENT
/begin MEASUREMENT tpu_zyl_p2 "zwei Zylinder in der Zukunft" UBYTE FORMULA_0408 0 0.0 1.0 12.0 READ_WRITE ECU_ADDRESS 0x3FD29D /end MEASUREMENT
/begin MEASUREMENT tz_diag_tr_ctr_zyl1 "Zaehler fuer Bestromungsueberwachung der Treiber" UBYTE FORMULA_1200 0 0.0 0.0 255.0 READ_WRITE ECU_ADDRESS 0x3FD2B0 /end MEASUREMENT
/begin MEASUREMENT tz_diag_tr_ctr_zyl10 "Zaehler fuer Bestromungsueberwachung der Treiber" UBYTE FORMULA_1200 0 0.0 0.0 255.0 READ_WRITE ECU_ADDRESS 0x3FD2B9 /end MEASUREMENT
/begin MEASUREMENT tz_diag_tr_ctr_zyl2 "Zaehler fuer Bestromungsueberwachung der Treiber" UBYTE FORMULA_1200 0 0.0 0.0 255.0 READ_WRITE ECU_ADDRESS 0x3FD2B1 /end MEASUREMENT
/begin MEASUREMENT tz_diag_tr_ctr_zyl3 "Zaehler fuer Bestromungsueberwachung der Treiber" UBYTE FORMULA_1200 0 0.0 0.0 255.0 READ_WRITE ECU_ADDRESS 0x3FD2B2 /end MEASUREMENT
/begin MEASUREMENT tz_diag_tr_ctr_zyl4 "Zaehler fuer Bestromungsueberwachung der Treiber" UBYTE FORMULA_1200 0 0.0 0.0 255.0 READ_WRITE ECU_ADDRESS 0x3FD2B3 /end MEASUREMENT
/begin MEASUREMENT tz_diag_tr_ctr_zyl5 "Zaehler fuer Bestromungsueberwachung der Treiber" UBYTE FORMULA_1200 0 0.0 0.0 255.0 READ_WRITE ECU_ADDRESS 0x3FD2B4 /end MEASUREMENT
/begin MEASUREMENT tz_diag_tr_ctr_zyl6 "Zaehler fuer Bestromungsueberwachung der Treiber" UBYTE FORMULA_1200 0 0.0 0.0 255.0 READ_WRITE ECU_ADDRESS 0x3FD2B5 /end MEASUREMENT
/begin MEASUREMENT tz_diag_tr_ctr_zyl7 "Zaehler fuer Bestromungsueberwachung der Treiber" UBYTE FORMULA_1200 0 0.0 0.0 255.0 READ_WRITE ECU_ADDRESS 0x3FD2B6 /end MEASUREMENT
/begin MEASUREMENT tz_diag_tr_ctr_zyl8 "Zaehler fuer Bestromungsueberwachung der Treiber" UBYTE FORMULA_1200 0 0.0 0.0 255.0 READ_WRITE ECU_ADDRESS 0x3FD2B7 /end MEASUREMENT
/begin MEASUREMENT tz_diag_tr_ctr_zyl9 "Zaehler fuer Bestromungsueberwachung der Treiber" UBYTE FORMULA_1200 0 0.0 0.0 255.0 READ_WRITE ECU_ADDRESS 0x3FD2B8 /end MEASUREMENT
/begin MEASUREMENT van_anschl_t_A1 "Dauer Anschlag lernen" UBYTE FORMULA_0306 0 0.0 0.0 2.549999952316284 READ_WRITE ECU_ADDRESS 0x3FD2D5 /end MEASUREMENT
/begin MEASUREMENT van_anschl_t_A2 "Dauer Anschlag lernen" UBYTE FORMULA_0306 0 0.0 0.0 2.549999952316284 READ_WRITE ECU_ADDRESS 0x3FD2D7 /end MEASUREMENT
/begin MEASUREMENT van_anschl_t_E1 "Dauer Anschlag lernen" UBYTE FORMULA_0306 0 0.0 0.0 2.549999952316284 READ_WRITE ECU_ADDRESS 0x3FD2D4 /end MEASUREMENT
/begin MEASUREMENT van_anschl_t_E2 "Dauer Anschlag lernen" UBYTE FORMULA_0306 0 0.0 0.0 2.549999952316284 READ_WRITE ECU_ADDRESS 0x3FD2D6 /end MEASUREMENT
/begin MEASUREMENT van_begr_faktor "Gewichtungsfaktor Min-Begr." SWORD FORMULA_0025 0 0.0 0.0 1.999899983406067 READ_WRITE ECU_ADDRESS 0x3FD2D8 /end MEASUREMENT
/begin MEASUREMENT van_d_xd_A1 "Gradient Regelabweichung" SWORD FORMULA_1201 0 0.0 -32768.0 32767.0 READ_WRITE ECU_ADDRESS 0x3FD2E6 /end MEASUREMENT
/begin MEASUREMENT van_d_xd_A2 "Gradient Regelabweichung" SWORD FORMULA_1201 0 0.0 -32768.0 32767.0 READ_WRITE ECU_ADDRESS 0x3FD2EA /end MEASUREMENT
/begin MEASUREMENT van_d_xd_E1 "Gradient Regelabweichung" SWORD FORMULA_1201 0 0.0 -32768.0 32767.0 READ_WRITE ECU_ADDRESS 0x3FD2E4 /end MEASUREMENT
/begin MEASUREMENT van_d_xd_E2 "Gradient Regelabweichung" SWORD FORMULA_1201 0 0.0 -32768.0 32767.0 READ_WRITE ECU_ADDRESS 0x3FD2E8 /end MEASUREMENT
/begin MEASUREMENT van_d_xd_filt_A1 "gefilterter Gradient Regelabweichung" SWORD FORMULA_1201 0 0.0 -32768.0 32767.0 READ_WRITE ECU_ADDRESS 0x3FD2EE /end MEASUREMENT
/begin MEASUREMENT van_d_xd_filt_A2 "gefilterter Gradient Regelabweichung" SWORD FORMULA_1201 0 0.0 -32768.0 32767.0 READ_WRITE ECU_ADDRESS 0x3FD2F2 /end MEASUREMENT
/begin MEASUREMENT van_d_xd_filt_E1 "gefilterter Gradient Regelabweichung" SWORD FORMULA_1201 0 0.0 -32768.0 32767.0 READ_WRITE ECU_ADDRESS 0x3FD2EC /end MEASUREMENT
/begin MEASUREMENT van_d_xd_filt_E2 "gefilterter Gradient Regelabweichung" SWORD FORMULA_1201 0 0.0 -32768.0 32767.0 READ_WRITE ECU_ADDRESS 0x3FD2F0 /end MEASUREMENT
/begin MEASUREMENT van_druck_cnt_b1 "Anzahl erkannter Frühverstellungen" UBYTE FORMULA_0003 0 0.0 0.0 10.0 READ_WRITE ECU_ADDRESS 0x3FD2DA /end MEASUREMENT
/begin MEASUREMENT van_druck_cnt_b2 "Anzahl erkannter Frühverstellungen" UBYTE FORMULA_0003 0 0.0 0.0 10.0 READ_WRITE ECU_ADDRESS 0x3FD2DB /end MEASUREMENT
/begin MEASUREMENT van_druck_start_e_b1 "Istpos bei Ablauf van_t_start_dly" SWORD FORMULA_0102 0 0.0 50.0 160.0 READ_WRITE ECU_ADDRESS 0x3FD2E0 /end MEASUREMENT
/begin MEASUREMENT van_druck_start_e_b2 "Istpos bei Ablauf van_t_start_dly" SWORD FORMULA_0102 0 0.0 50.0 160.0 READ_WRITE ECU_ADDRESS 0x3FD2E2 /end MEASUREMENT
/begin MEASUREMENT van_druck_time "Motorlaufzeit ohne Druck" UWORD FORMULA_0071 0 0.0 0.0 6553.5 READ_WRITE ECU_ADDRESS 0x3FD2DC /end MEASUREMENT
/begin MEASUREMENT van_druck_timeout "max. Druckerkennungszeit ohne Fehler" UWORD FORMULA_0071 0 0.0 0.0 6553.5 READ_WRITE ECU_ADDRESS 0x3FD2DE /end MEASUREMENT
/begin MEASUREMENT van_dsv_exd_st "Status externe Ansteuerung" UBYTE FORMULA_0630 0 0.0 0.0 255.0 READ_WRITE ECU_ADDRESS 0x3FD2CA /end MEASUREMENT
/begin MEASUREMENT van_dsv_exd_timeout "Timeout externe Ansteuerung" UBYTE FORMULA_0461 0 0.0 0.0 25.5 READ_WRITE ECU_ADDRESS 0x3FD2CB /end MEASUREMENT
/begin MEASUREMENT van_dsv_peak_time "Zeit der Peak-Phase DSV" UBYTE FORMULA_0461 0 0.0 0.0 25.5 READ_WRITE ECU_ADDRESS 0x3FD2CC /end MEASUREMENT
/begin MEASUREMENT van_dsv_st "Status Vanos Druckspeicherventil" UBYTE FORMULA_1234 0 0.0 0.0 255.0 READ_WRITE ECU_ADDRESS 0x3FD2CD /end MEASUREMENT
/begin MEASUREMENT van_dsv_timer "Zeitzaehler DSV" UBYTE FORMULA_0461 0 0.0 0.0 25.5 READ_WRITE ECU_ADDRESS 0x3FD2CE /end MEASUREMENT
/begin MEASUREMENT van_dsv_tv "Druckspeicherventil Tastverhaeltnis" SWORD FORMULA_1235 0 0.0 0.0 100.0 READ_WRITE ECU_ADDRESS 0x3FD2D0 /end MEASUREMENT
/begin MEASUREMENT van_exd_anschl_max_A1 "Prüflauf Max-Anschlag" SWORD FORMULA_0102 0 0.0 50.0 160.0 READ_WRITE ECU_ADDRESS 0x3FD2F6 /end MEASUREMENT
/begin MEASUREMENT van_exd_anschl_max_A2 "Prüflauf Max-Anschlag" SWORD FORMULA_0102 0 0.0 50.0 160.0 READ_WRITE ECU_ADDRESS 0x3FD2FA /end MEASUREMENT
/begin MEASUREMENT van_exd_anschl_max_E1 "Prüflauf Max-Anschlag" SWORD FORMULA_0102 0 0.0 50.0 160.0 READ_WRITE ECU_ADDRESS 0x3FD2F4 /end MEASUREMENT
/begin MEASUREMENT van_exd_anschl_max_E2 "Prüflauf Max-Anschlag" SWORD FORMULA_0102 0 0.0 50.0 160.0 READ_WRITE ECU_ADDRESS 0x3FD2F8 /end MEASUREMENT
/begin MEASUREMENT van_exd_anschl_min_A1 "Prüflauf Min-Anschlag" SWORD FORMULA_0102 0 0.0 50.0 160.0 READ_WRITE ECU_ADDRESS 0x3FD2FE /end MEASUREMENT
/begin MEASUREMENT van_exd_anschl_min_A2 "Prüflauf Min-Anschlag" SWORD FORMULA_0102 0 0.0 50.0 160.0 READ_WRITE ECU_ADDRESS 0x3FD302 /end MEASUREMENT
/begin MEASUREMENT van_exd_anschl_min_E1 "Prüflauf Min-Anschlag" SWORD FORMULA_0102 0 0.0 50.0 160.0 READ_WRITE ECU_ADDRESS 0x3FD2FC /end MEASUREMENT
/begin MEASUREMENT van_exd_anschl_min_E2 "Prüflauf Min-Anschlag" SWORD FORMULA_0102 0 0.0 50.0 160.0 READ_WRITE ECU_ADDRESS 0x3FD300 /end MEASUREMENT
/begin MEASUREMENT van_exd_frequ_A1 "PWM-Frequenz vom Tester" UWORD FORMULA_1202 0 0.0 16.0 400.0 READ_WRITE ECU_ADDRESS 0x3FD306 /end MEASUREMENT
/begin MEASUREMENT van_exd_frequ_A2 "PWM-Frequenz vom Tester" UWORD FORMULA_1202 0 0.0 16.0 400.0 READ_WRITE ECU_ADDRESS 0x3FD30A /end MEASUREMENT
/begin MEASUREMENT van_exd_frequ_E1 "PWM-Frequenz vom Tester" UWORD FORMULA_1202 0 0.0 16.0 400.0 READ_WRITE ECU_ADDRESS 0x3FD304 /end MEASUREMENT
/begin MEASUREMENT van_exd_frequ_E2 "PWM-Frequenz vom Tester" UWORD FORMULA_1202 0 0.0 16.0 400.0 READ_WRITE ECU_ADDRESS 0x3FD308 /end MEASUREMENT
/begin MEASUREMENT van_exd_pruef "Prüflauf Status" UBYTE FORMULA_1203 0 0.0 0.0 255.0 READ_WRITE ECU_ADDRESS 0x3FD314 /end MEASUREMENT
/begin MEASUREMENT van_exd_soll_A1 "Sollwert vom Tester" SWORD FORMULA_0102 0 0.0 50.0 160.0 READ_WRITE ECU_ADDRESS 0x3FD30E /end MEASUREMENT
/begin MEASUREMENT van_exd_soll_A2 "Sollwert vom Tester" SWORD FORMULA_0102 0 0.0 50.0 160.0 READ_WRITE ECU_ADDRESS 0x3FD312 /end MEASUREMENT
/begin MEASUREMENT van_exd_soll_E1 "Sollwert vom Tester" SWORD FORMULA_0102 0 0.0 50.0 160.0 READ_WRITE ECU_ADDRESS 0x3FD30C /end MEASUREMENT
/begin MEASUREMENT van_exd_soll_E2 "Sollwert vom Tester" SWORD FORMULA_0102 0 0.0 50.0 160.0 READ_WRITE ECU_ADDRESS 0x3FD310 /end MEASUREMENT
/begin MEASUREMENT van_exd_soll_timeout_A1 "Sollwert vom Tester Timeout" UBYTE FORMULA_0461 0 0.0 0.0 25.5 READ_WRITE ECU_ADDRESS 0x3FD32D /end MEASUREMENT
/begin MEASUREMENT van_exd_soll_timeout_A2 "Sollwert vom Tester Timeout" UBYTE FORMULA_0461 0 0.0 0.0 25.5 READ_WRITE ECU_ADDRESS 0x3FD32F /end MEASUREMENT
/begin MEASUREMENT van_exd_soll_timeout_E1 "Sollwert vom Tester Timeout" UBYTE FORMULA_0461 0 0.0 0.0 25.5 READ_WRITE ECU_ADDRESS 0x3FD32C /end MEASUREMENT
/begin MEASUREMENT van_exd_soll_timeout_E2 "Sollwert vom Tester Timeout" UBYTE FORMULA_0461 0 0.0 0.0 25.5 READ_WRITE ECU_ADDRESS 0x3FD32E /end MEASUREMENT
/begin MEASUREMENT van_exd_t "Timer Prueflauf" UWORD FORMULA_0021 0 0.0 0.0 655.0 READ_WRITE ECU_ADDRESS 0x3FD31E /end MEASUREMENT
/begin MEASUREMENT van_exd_t_verst_gross_A1 "Verstellzeit zu grosser Spreizung" UBYTE FORMULA_0306 0 0.0 0.0 2.549999952316284 READ_WRITE ECU_ADDRESS 0x3FD31A /end MEASUREMENT
/begin MEASUREMENT van_exd_t_verst_gross_A2 "Verstellzeit zu grosser Spreizung" UBYTE FORMULA_0306 0 0.0 0.0 2.549999952316284 READ_WRITE ECU_ADDRESS 0x3FD31C /end MEASUREMENT
/begin MEASUREMENT van_exd_t_verst_gross_E1 "Verstellzeit zu grosser Spreizung" UBYTE FORMULA_0306 0 0.0 0.0 2.549999952316284 READ_WRITE ECU_ADDRESS 0x3FD319 /end MEASUREMENT
/begin MEASUREMENT van_exd_t_verst_gross_E2 "Verstellzeit zu grosser Spreizung" UBYTE FORMULA_0306 0 0.0 0.0 2.549999952316284 READ_WRITE ECU_ADDRESS 0x3FD31B /end MEASUREMENT
/begin MEASUREMENT van_exd_t_verst_klein_A1 "Verstellzeit zu kleiner Spreizung" UBYTE FORMULA_0306 0 0.0 0.0 2.549999952316284 READ_WRITE ECU_ADDRESS 0x3FD316 /end MEASUREMENT
/begin MEASUREMENT van_exd_t_verst_klein_A2 "Verstellzeit zu kleiner Spreizung" UBYTE FORMULA_0306 0 0.0 0.0 2.549999952316284 READ_WRITE ECU_ADDRESS 0x3FD318 /end MEASUREMENT
/begin MEASUREMENT van_exd_t_verst_klein_E1 "Verstellzeit zu kleiner Spreizung" UBYTE FORMULA_0306 0 0.0 0.0 2.549999952316284 READ_WRITE ECU_ADDRESS 0x3FD315 /end MEASUREMENT
/begin MEASUREMENT van_exd_t_verst_klein_E2 "Verstellzeit zu kleiner Spreizung" UBYTE FORMULA_0306 0 0.0 0.0 2.549999952316284 READ_WRITE ECU_ADDRESS 0x3FD317 /end MEASUREMENT
/begin MEASUREMENT van_exd_tv_A1 "Ventil Tastverhaeltnis vom Tester" SWORD FORMULA_0107 0 0.0 0.0 100.0 READ_WRITE ECU_ADDRESS 0x3FD322 /end MEASUREMENT
/begin MEASUREMENT van_exd_tv_A2 "Ventil Tastverhaeltnis vom Tester" SWORD FORMULA_0107 0 0.0 0.0 100.0 READ_WRITE ECU_ADDRESS 0x3FD326 /end MEASUREMENT
/begin MEASUREMENT van_exd_tv_E1 "Ventil Tastverhaeltnis vom Tester" SWORD FORMULA_0107 0 0.0 0.0 100.0 READ_WRITE ECU_ADDRESS 0x3FD320 /end MEASUREMENT
/begin MEASUREMENT van_exd_tv_E2 "Ventil Tastverhaeltnis vom Tester" SWORD FORMULA_0107 0 0.0 0.0 100.0 READ_WRITE ECU_ADDRESS 0x3FD324 /end MEASUREMENT
/begin MEASUREMENT van_exd_tv_timeout_A1 "Tastverhaeltnis vom Tester" UBYTE FORMULA_0461 0 0.0 0.0 25.5 READ_WRITE ECU_ADDRESS 0x3FD329 /end MEASUREMENT
/begin MEASUREMENT van_exd_tv_timeout_A2 "Tastverhaeltnis vom Tester" UBYTE FORMULA_0461 0 0.0 0.0 25.5 READ_WRITE ECU_ADDRESS 0x3FD32B /end MEASUREMENT
/begin MEASUREMENT van_exd_tv_timeout_E1 "Tastverhaeltnis vom Tester" UBYTE FORMULA_0461 0 0.0 0.0 25.5 READ_WRITE ECU_ADDRESS 0x3FD328 /end MEASUREMENT
/begin MEASUREMENT van_exd_tv_timeout_E2 "Tastverhaeltnis vom Tester" UBYTE FORMULA_0461 0 0.0 0.0 25.5 READ_WRITE ECU_ADDRESS 0x3FD32A /end MEASUREMENT
/begin MEASUREMENT van_filtr_dauer_A1 "Dauer ohne Sollwertaenderung" UWORD FORMULA_0071 0 0.0 0.0 6553.5 READ_WRITE ECU_ADDRESS 0x3FD334 /end MEASUREMENT
/begin MEASUREMENT van_filtr_dauer_A2 "Dauer ohne Sollwertaenderung" UWORD FORMULA_0071 0 0.0 0.0 6553.5 READ_WRITE ECU_ADDRESS 0x3FD338 /end MEASUREMENT
/begin MEASUREMENT van_filtr_dauer_E1 "Dauer ohne Sollwertaenderung" UWORD FORMULA_0071 0 0.0 0.0 6553.5 READ_WRITE ECU_ADDRESS 0x3FD332 /end MEASUREMENT
/begin MEASUREMENT van_filtr_dauer_E2 "Dauer ohne Sollwertaenderung" UWORD FORMULA_0071 0 0.0 0.0 6553.5 READ_WRITE ECU_ADDRESS 0x3FD336 /end MEASUREMENT
/begin MEASUREMENT van_filtr_fgen "Timer fuer Soll-Offset-Generator" UBYTE FORMULA_0461 0 0.0 0.0 25.5 READ_WRITE ECU_ADDRESS 0x3FD33A /end MEASUREMENT
/begin MEASUREMENT van_fitr_xd_wicht "Gewicht Regl-Abw. Vent.Guete" UBYTE FORMULA_0638 0 0.0 0.0 1.99210000038147 READ_WRITE ECU_ADDRESS 0x3FD33B /end MEASUREMENT
/begin MEASUREMENT van_flags "Steuerflags" UBYTE FORMULA_0037 0 0.0 0.0 255.0 READ_WRITE ECU_ADDRESS 0x3FD330 /end MEASUREMENT
/begin MEASUREMENT van_fpos_A1 "Feinposition" SWORD FORMULA_0102 0 0.0 -80.0 80.0 READ_WRITE ECU_ADDRESS 0x3FD354 /end MEASUREMENT
/begin MEASUREMENT van_fpos_A2 "Feinposition" SWORD FORMULA_0102 0 0.0 -80.0 80.0 READ_WRITE ECU_ADDRESS 0x3FD358 /end MEASUREMENT
/begin MEASUREMENT van_fpos_E1 "Feinposition" SWORD FORMULA_0102 0 0.0 -80.0 80.0 READ_WRITE ECU_ADDRESS 0x3FD352 /end MEASUREMENT
/begin MEASUREMENT van_fpos_E2 "Feinposition" SWORD FORMULA_0102 0 0.0 -80.0 80.0 READ_WRITE ECU_ADDRESS 0x3FD356 /end MEASUREMENT
/begin MEASUREMENT van_frequ_A1 "Ausgegebene PWM-Frequenz" UWORD FORMULA_1202 0 0.0 16.0 400.0 READ_WRITE ECU_ADDRESS 0x3FD33E /end MEASUREMENT
/begin MEASUREMENT van_frequ_A2 "Ausgegebene PWM-Frequenz" UWORD FORMULA_1202 0 0.0 16.0 400.0 READ_WRITE ECU_ADDRESS 0x3FD342 /end MEASUREMENT
/begin MEASUREMENT van_frequ_dyn_A1 "Frequenz bei aktiver Regelung" UWORD FORMULA_1202 0 0.0 16.0 400.0 READ_WRITE ECU_ADDRESS 0x3FD348 /end MEASUREMENT
/begin MEASUREMENT van_frequ_dyn_A2 "Frequenz bei aktiver Regelung" UWORD FORMULA_1202 0 0.0 16.0 400.0 READ_WRITE ECU_ADDRESS 0x3FD34C /end MEASUREMENT
/begin MEASUREMENT van_frequ_dyn_E1 "Frequenz bei aktiver Regelung" UWORD FORMULA_1202 0 0.0 16.0 400.0 READ_WRITE ECU_ADDRESS 0x3FD346 /end MEASUREMENT
/begin MEASUREMENT van_frequ_dyn_E2 "Frequenz bei aktiver Regelung" UWORD FORMULA_1202 0 0.0 16.0 400.0 READ_WRITE ECU_ADDRESS 0x3FD34A /end MEASUREMENT
/begin MEASUREMENT van_frequ_E1 "Ausgegebene PWM-Frequenz" UWORD FORMULA_1202 0 0.0 16.0 400.0 READ_WRITE ECU_ADDRESS 0x3FD33C /end MEASUREMENT
/begin MEASUREMENT van_frequ_E2 "Ausgegebene PWM-Frequenz" UWORD FORMULA_1202 0 0.0 16.0 400.0 READ_WRITE ECU_ADDRESS 0x3FD340 /end MEASUREMENT
/begin MEASUREMENT van_frequ_fakt_A1 "GueteFaktor auf frequ_stat" UBYTE FORMULA_0638 0 0.0 0.0 1.99210000038147 READ_WRITE ECU_ADDRESS 0x3FD34F /end MEASUREMENT
/begin MEASUREMENT van_frequ_fakt_A2 "GueteFaktor auf frequ_stat" UBYTE FORMULA_0638 0 0.0 0.0 1.99210000038147 READ_WRITE ECU_ADDRESS 0x3FD351 /end MEASUREMENT
/begin MEASUREMENT van_frequ_fakt_E1 "GueteFaktor auf frequ_stat" UBYTE FORMULA_0638 0 0.0 0.0 1.99210000038147 READ_WRITE ECU_ADDRESS 0x3FD34E /end MEASUREMENT
/begin MEASUREMENT van_frequ_fakt_E2 "GueteFaktor auf frequ_stat" UBYTE FORMULA_0638 0 0.0 0.0 1.99210000038147 READ_WRITE ECU_ADDRESS 0x3FD350 /end MEASUREMENT
/begin MEASUREMENT van_frequ_stat "max. Frequenz bei guete=1" UWORD FORMULA_1202 0 0.0 16.0 400.0 READ_WRITE ECU_ADDRESS 0x3FD344 /end MEASUREMENT
/begin MEASUREMENT van_gpos_A1 "Grobposition" SWORD FORMULA_0102 0 0.0 -80.0 80.0 READ_WRITE ECU_ADDRESS 0x3FD35E /end MEASUREMENT
/begin MEASUREMENT van_gpos_A2 "Grobposition" SWORD FORMULA_0102 0 0.0 -80.0 80.0 READ_WRITE ECU_ADDRESS 0x3FD362 /end MEASUREMENT
/begin MEASUREMENT van_gpos_E1 "Grobposition" SWORD FORMULA_0102 0 0.0 -80.0 80.0 READ_WRITE ECU_ADDRESS 0x3FD35C /end MEASUREMENT
/begin MEASUREMENT van_gpos_E2 "Grobposition" SWORD FORMULA_0102 0 0.0 -80.0 80.0 READ_WRITE ECU_ADDRESS 0x3FD360 /end MEASUREMENT
/begin MEASUREMENT van_guete_dauer "Dauer Ventilgueteadaption" UWORD FORMULA_0071 0 0.0 0.0 6553.5 READ_WRITE ECU_ADDRESS 0x3FD364 /end MEASUREMENT
/begin MEASUREMENT van_guete_pause "Pause zwischen Ventilgueteadaption" UWORD FORMULA_1206 0 0.0 0.0 109.0 READ_WRITE ECU_ADDRESS 0x3FD366 /end MEASUREMENT
/begin MEASUREMENT van_guete_reset_zeit "Dauer mit schlechter Ventilguete" UWORD FORMULA_0071 0 0.0 0.0 6553.5 READ_WRITE ECU_ADDRESS 0x3FD368 /end MEASUREMENT
/begin MEASUREMENT van_guete_roh_A1 "Ventil-Guete ungefilt" UWORD FORMULA_0024 0 0.0 0.0 1.999899983406067 READ_WRITE ECU_ADDRESS 0x3FD36C /end MEASUREMENT
/begin MEASUREMENT van_guete_roh_A2 "Ventil-Guete ungefilt" UWORD FORMULA_0024 0 0.0 0.0 1.999899983406067 READ_WRITE ECU_ADDRESS 0x3FD370 /end MEASUREMENT
/begin MEASUREMENT van_guete_roh_E1 "Ventil-Guete ungefilt" UWORD FORMULA_0024 0 0.0 0.0 1.999899983406067 READ_WRITE ECU_ADDRESS 0x3FD36A /end MEASUREMENT
/begin MEASUREMENT van_guete_roh_E2 "Ventil-Guete ungefilt" UWORD FORMULA_0024 0 0.0 0.0 1.999899983406067 READ_WRITE ECU_ADDRESS 0x3FD36E /end MEASUREMENT
/begin MEASUREMENT van_i_A1 "Ventil Sollstrom" SWORD FORMULA_1207 0 0.0 -1000.0 3000.0 READ_WRITE ECU_ADDRESS 0x3FD374 /end MEASUREMENT
/begin MEASUREMENT van_i_A2 "Ventil Sollstrom" SWORD FORMULA_1207 0 0.0 -1000.0 3000.0 READ_WRITE ECU_ADDRESS 0x3FD378 /end MEASUREMENT
/begin MEASUREMENT van_i_d_A1 "D-Anteil Regler Ventilstrom" SWORD FORMULA_1207 0 0.0 -1000.0 3000.0 READ_WRITE ECU_ADDRESS 0x3FD37C /end MEASUREMENT
/begin MEASUREMENT van_i_d_A2 "D-Anteil Regler Ventilstrom" SWORD FORMULA_1207 0 0.0 -1000.0 3000.0 READ_WRITE ECU_ADDRESS 0x3FD380 /end MEASUREMENT
/begin MEASUREMENT van_i_d_E1 "D-Anteil Regler Ventilstrom" SWORD FORMULA_1207 0 0.0 -1000.0 3000.0 READ_WRITE ECU_ADDRESS 0x3FD37A /end MEASUREMENT
/begin MEASUREMENT van_i_d_E2 "D-Anteil Regler Ventilstrom" SWORD FORMULA_1207 0 0.0 -1000.0 3000.0 READ_WRITE ECU_ADDRESS 0x3FD37E /end MEASUREMENT
/begin MEASUREMENT van_i_E1 "Ventil Sollstrom" SWORD FORMULA_1207 0 0.0 -1000.0 3000.0 READ_WRITE ECU_ADDRESS 0x3FD372 /end MEASUREMENT
/begin MEASUREMENT van_i_E2 "Ventil Sollstrom" SWORD FORMULA_1207 0 0.0 -1000.0 3000.0 READ_WRITE ECU_ADDRESS 0x3FD376 /end MEASUREMENT
/begin MEASUREMENT van_i_i_A1 "I-Anteil Regler Ventilstrom" SLONG FORMULA_1208 0 0.0 -1000.0 3000.0 READ_WRITE ECU_ADDRESS 0x3FD388 /end MEASUREMENT
/begin MEASUREMENT van_i_i_A2 "I-Anteil Regler Ventilstrom" SLONG FORMULA_1208 0 0.0 -1000.0 3000.0 READ_WRITE ECU_ADDRESS 0x3FD390 /end MEASUREMENT
/begin MEASUREMENT van_i_i_E1 "I-Anteil Regler Ventilstrom" SLONG FORMULA_1208 0 0.0 -1000.0 3000.0 READ_WRITE ECU_ADDRESS 0x3FD384 /end MEASUREMENT
/begin MEASUREMENT van_i_i_E2 "I-Anteil Regler Ventilstrom" SLONG FORMULA_1208 0 0.0 -1000.0 3000.0 READ_WRITE ECU_ADDRESS 0x3FD38C /end MEASUREMENT
/begin MEASUREMENT van_i_p_A1 "P-Anteil Regler Ventilstrom" SWORD FORMULA_1207 0 0.0 -1000.0 3000.0 READ_WRITE ECU_ADDRESS 0x3FD396 /end MEASUREMENT
/begin MEASUREMENT van_i_p_A2 "P-Anteil Regler Ventilstrom" SWORD FORMULA_1207 0 0.0 -1000.0 3000.0 READ_WRITE ECU_ADDRESS 0x3FD39A /end MEASUREMENT
/begin MEASUREMENT van_i_p_E1 "P-Anteil Regler Ventilstrom" SWORD FORMULA_1207 0 0.0 -1000.0 3000.0 READ_WRITE ECU_ADDRESS 0x3FD394 /end MEASUREMENT
/begin MEASUREMENT van_i_p_E2 "P-Anteil Regler Ventilstrom" SWORD FORMULA_1207 0 0.0 -1000.0 3000.0 READ_WRITE ECU_ADDRESS 0x3FD398 /end MEASUREMENT
/begin MEASUREMENT van_i_vorst_Auslass "Vorsteuerung Ventilstrom" SWORD FORMULA_1207 0 0.0 -1000.0 3000.0 READ_WRITE ECU_ADDRESS 0x3FD39E /end MEASUREMENT
/begin MEASUREMENT van_i_vorst_Einlass "Vorsteuerung Ventilstrom" SWORD FORMULA_1207 0 0.0 -1000.0 3000.0 READ_WRITE ECU_ADDRESS 0x3FD39C /end MEASUREMENT
/begin MEASUREMENT van_imp_cnt_A1 "Impulszahler fuer Abriss-Erkennung" SBYTE FORMULA_0003 0 0.0 0.0 7.0 READ_WRITE ECU_ADDRESS 0x3FD3A1 /end MEASUREMENT
/begin MEASUREMENT van_imp_cnt_A2 "Impulszahler fuer Abriss-Erkennung" SBYTE FORMULA_0003 0 0.0 0.0 7.0 READ_WRITE ECU_ADDRESS 0x3FD3A3 /end MEASUREMENT
/begin MEASUREMENT van_imp_cnt_E1 "Impulszahler fuer Abriss-Erkennung" SBYTE FORMULA_0003 0 0.0 0.0 7.0 READ_WRITE ECU_ADDRESS 0x3FD3A0 /end MEASUREMENT
/begin MEASUREMENT van_imp_cnt_E2 "Impulszahler fuer Abriss-Erkennung" SBYTE FORMULA_0003 0 0.0 0.0 7.0 READ_WRITE ECU_ADDRESS 0x3FD3A2 /end MEASUREMENT
/begin MEASUREMENT van_ist_kh_start_A1 "Istposition zu Beginn KH" SWORD FORMULA_0102 0 0.0 50.0 160.0 READ_WRITE ECU_ADDRESS 0x3FD3A6 /end MEASUREMENT
/begin MEASUREMENT van_ist_kh_start_A2 "Istposition zu Beginn KH" SWORD FORMULA_0102 0 0.0 50.0 160.0 READ_WRITE ECU_ADDRESS 0x3FD3AA /end MEASUREMENT
/begin MEASUREMENT van_ist_kh_start_E1 "Istposition zu Beginn KH" SWORD FORMULA_0102 0 0.0 50.0 160.0 READ_WRITE ECU_ADDRESS 0x3FD3A4 /end MEASUREMENT
/begin MEASUREMENT van_ist_kh_start_E2 "Istposition zu Beginn KH" SWORD FORMULA_0102 0 0.0 50.0 160.0 READ_WRITE ECU_ADDRESS 0x3FD3A8 /end MEASUREMENT
/begin MEASUREMENT van_ist_oeff_A1 "Ventil Oeffnen vor ZOT" SWORD FORMULA_0102 0 0.0 -80.0 80.0 READ_WRITE ECU_ADDRESS 0x3FD3AE /end MEASUREMENT
/begin MEASUREMENT van_ist_oeff_A2 "Ventil Oeffnen vor ZOT" SWORD FORMULA_0102 0 0.0 -80.0 80.0 READ_WRITE ECU_ADDRESS 0x3FD3B2 /end MEASUREMENT
/begin MEASUREMENT van_ist_oeff_E1 "Ventil Oeffnen vor ZOT" SWORD FORMULA_0102 0 0.0 -80.0 80.0 READ_WRITE ECU_ADDRESS 0x3FD3AC /end MEASUREMENT
/begin MEASUREMENT van_ist_oeff_E2 "Ventil Oeffnen vor ZOT" SWORD FORMULA_0102 0 0.0 -80.0 80.0 READ_WRITE ECU_ADDRESS 0x3FD3B0 /end MEASUREMENT
/begin MEASUREMENT van_ist_schl_A1 "Ventil Schliessen vor ZOT" SWORD FORMULA_0102 0 0.0 -80.0 550.0 READ_WRITE ECU_ADDRESS 0x3FD3EE /end MEASUREMENT
/begin MEASUREMENT van_ist_schl_A2 "Ventil Schliessen vor ZOT" SWORD FORMULA_0102 0 0.0 -80.0 550.0 READ_WRITE ECU_ADDRESS 0x3FD3F2 /end MEASUREMENT
/begin MEASUREMENT van_ist_schl_E1 "Ventil Schliessen vor ZOT" SWORD FORMULA_0102 0 0.0 -80.0 550.0 READ_WRITE ECU_ADDRESS 0x3FD3EC /end MEASUREMENT
/begin MEASUREMENT van_ist_schl_E2 "Ventil Schliessen vor ZOT" SWORD FORMULA_0102 0 0.0 -80.0 550.0 READ_WRITE ECU_ADDRESS 0x3FD3F0 /end MEASUREMENT
/begin MEASUREMENT van_kd_Auslass "Vanos-Regler d-Faktor" SWORD FORMULA_1209 0 0.0 -32.0 31.99900054931641 READ_WRITE ECU_ADDRESS 0x3FD3FE /end MEASUREMENT
/begin MEASUREMENT van_kd_Einlass "Vanos-Regler d-Faktor" SWORD FORMULA_1209 0 0.0 -32.0 31.99900054931641 READ_WRITE ECU_ADDRESS 0x3FD3FC /end MEASUREMENT
/begin MEASUREMENT van_kh_soll_A1 "Kennfeld Katheiz Soll" SWORD FORMULA_0102 0 0.0 50.0 160.0 READ_WRITE ECU_ADDRESS 0x3FD3F6 /end MEASUREMENT
/begin MEASUREMENT van_kh_soll_A2 "Kennfeld Katheiz Soll" SWORD FORMULA_0102 0 0.0 50.0 160.0 READ_WRITE ECU_ADDRESS 0x3FD3FA /end MEASUREMENT
/begin MEASUREMENT van_kh_soll_E1 "Kennfeld Katheiz Soll" SWORD FORMULA_0102 0 0.0 50.0 160.0 READ_WRITE ECU_ADDRESS 0x3FD3F4 /end MEASUREMENT
/begin MEASUREMENT van_kh_soll_E2 "Kennfeld Katheiz Soll" SWORD FORMULA_0102 0 0.0 50.0 160.0 READ_WRITE ECU_ADDRESS 0x3FD3F8 /end MEASUREMENT
/begin MEASUREMENT van_ki_A1 "Vanos-Regler I-Faktor" SWORD FORMULA_1210 0 0.0 -500.0 499.9847106933594 READ_WRITE ECU_ADDRESS 0x3FD402 /end MEASUREMENT
/begin MEASUREMENT van_ki_A2 "Vanos-Regler I-Faktor" SWORD FORMULA_1210 0 0.0 -500.0 499.9847106933594 READ_WRITE ECU_ADDRESS 0x3FD406 /end MEASUREMENT
/begin MEASUREMENT van_ki_E1 "Vanos-Regler I-Faktor" SWORD FORMULA_1210 0 0.0 -500.0 499.9847106933594 READ_WRITE ECU_ADDRESS 0x3FD400 /end MEASUREMENT
/begin MEASUREMENT van_ki_E2 "Vanos-Regler I-Faktor" SWORD FORMULA_1210 0 0.0 -500.0 499.9847106933594 READ_WRITE ECU_ADDRESS 0x3FD404 /end MEASUREMENT
/begin MEASUREMENT van_kp_Auslass "Vanos-Regler P-Faktor" SWORD FORMULA_1211 0 0.0 -1280.0 1279.9609375 READ_WRITE ECU_ADDRESS 0x3FD40A /end MEASUREMENT
/begin MEASUREMENT van_kp_Einlass "Vanos-Regler P-Faktor" SWORD FORMULA_1211 0 0.0 -1280.0 1279.9609375 READ_WRITE ECU_ADDRESS 0x3FD408 /end MEASUREMENT
/begin MEASUREMENT van_n_korr_a_b1 "n * tabg_lw_verh_wurzel" SWORD FORMULA_0006 0 0.0 0.0 10000.0 READ_WRITE ECU_ADDRESS 0x3FD40C /end MEASUREMENT
/begin MEASUREMENT van_n_korr_a_b2 "n * tabg_lw_verh_wurzel" SWORD FORMULA_0006 0 0.0 0.0 10000.0 READ_WRITE ECU_ADDRESS 0x3FD40E /end MEASUREMENT
/begin MEASUREMENT van_r "Spulenwiderstand Ventil" SWORD FORMULA_1212 0 0.0 -32.76800155639648 32.76699829101563 READ_WRITE ECU_ADDRESS 0x3FD410 /end MEASUREMENT
/begin MEASUREMENT van_reg_fakt_tmot "Reglerkorrekturfaktor ueber tmot" UBYTE FORMULA_0638 0 0.0 0.0 1.99210000038147 READ_WRITE ECU_ADDRESS 0x3FD35A /end MEASUREMENT
/begin MEASUREMENT van_smg_dauer "SMG Eingriffsdauer" UBYTE FORMULA_0306 0 0.0 0.0 2.549999952316284 READ_WRITE ECU_ADDRESS 0x3FD413 /end MEASUREMENT
/begin MEASUREMENT van_smg_st "Sollwert SMG-Schaltung" UBYTE FORMULA_1213 0 0.0 0.0 255.0 READ_WRITE ECU_ADDRESS 0x3FD412 /end MEASUREMENT
/begin MEASUREMENT van_soll_dmax_A1 "max. Sollwertaenderung" SWORD FORMULA_1214 0 0.0 0.0 80.0 READ_WRITE ECU_ADDRESS 0x3FD428 /end MEASUREMENT
/begin MEASUREMENT van_soll_dmax_A2 "max. Sollwertaenderung" SWORD FORMULA_1214 0 0.0 0.0 80.0 READ_WRITE ECU_ADDRESS 0x3FD42C /end MEASUREMENT
/begin MEASUREMENT van_soll_dmax_E1 "max. Sollwertaenderung" SWORD FORMULA_1214 0 0.0 0.0 80.0 READ_WRITE ECU_ADDRESS 0x3FD426 /end MEASUREMENT
/begin MEASUREMENT van_soll_dmax_E2 "max. Sollwertaenderung" SWORD FORMULA_1214 0 0.0 0.0 80.0 READ_WRITE ECU_ADDRESS 0x3FD42A /end MEASUREMENT
/begin MEASUREMENT van_soll_dmax_wl_Auslass "max Gradient in Ueberschneidung im WL" SWORD FORMULA_1214 0 0.0 0.0 80.0 READ_WRITE ECU_ADDRESS 0x3FD430 /end MEASUREMENT
/begin MEASUREMENT van_soll_dmax_wl_Einlass "max Gradient in Ueberschneidung im WL" SWORD FORMULA_1214 0 0.0 0.0 80.0 READ_WRITE ECU_ADDRESS 0x3FD42E /end MEASUREMENT
/begin MEASUREMENT van_soll_filtr_offs "Sollwert-Offset gegen Filtration" SWORD FORMULA_0102 0 0.0 -80.0 80.0 READ_WRITE ECU_ADDRESS 0x3FD414 /end MEASUREMENT
/begin MEASUREMENT van_soll_old_A1 "Alter Sollwert Aenderungserkennung" SWORD FORMULA_0102 0 0.0 50.0 160.0 READ_WRITE ECU_ADDRESS 0x3FD418 /end MEASUREMENT
/begin MEASUREMENT van_soll_old_A2 "Alter Sollwert Aenderungserkennung" SWORD FORMULA_0102 0 0.0 50.0 160.0 READ_WRITE ECU_ADDRESS 0x3FD41C /end MEASUREMENT
/begin MEASUREMENT van_soll_old_E1 "Alter Sollwert Aenderungserkennung" SWORD FORMULA_0102 0 0.0 50.0 160.0 READ_WRITE ECU_ADDRESS 0x3FD416 /end MEASUREMENT
/begin MEASUREMENT van_soll_old_E2 "Alter Sollwert Aenderungserkennung" SWORD FORMULA_0102 0 0.0 50.0 160.0 READ_WRITE ECU_ADDRESS 0x3FD41A /end MEASUREMENT
/begin MEASUREMENT van_soll_stat_A1 "Sollwert ohne Filtrationsmodulation" SWORD FORMULA_0102 0 0.0 50.0 160.0 READ_WRITE ECU_ADDRESS 0x3FD420 /end MEASUREMENT
/begin MEASUREMENT van_soll_stat_A2 "Sollwert ohne Filtrationsmodulation" SWORD FORMULA_0102 0 0.0 50.0 160.0 READ_WRITE ECU_ADDRESS 0x3FD424 /end MEASUREMENT
/begin MEASUREMENT van_soll_stat_E1 "Sollwert ohne Filtrationsmodulation" SWORD FORMULA_0102 0 0.0 50.0 160.0 READ_WRITE ECU_ADDRESS 0x3FD41E /end MEASUREMENT
/begin MEASUREMENT van_soll_stat_E2 "Sollwert ohne Filtrationsmodulation" SWORD FORMULA_0102 0 0.0 50.0 160.0 READ_WRITE ECU_ADDRESS 0x3FD422 /end MEASUREMENT
/begin MEASUREMENT van_st_A1 "Status Vanos" UBYTE FORMULA_0003 0 0.0 0.0 255.0 READ_WRITE ECU_ADDRESS 0x3FD433 /end MEASUREMENT
/begin MEASUREMENT van_st_A2 "Status Vanos" UBYTE FORMULA_0003 0 0.0 0.0 255.0 READ_WRITE ECU_ADDRESS 0x3FD435 /end MEASUREMENT
/begin MEASUREMENT van_st_E1 "Status Vanos" UBYTE FORMULA_0003 0 0.0 0.0 255.0 READ_WRITE ECU_ADDRESS 0x3FD432 /end MEASUREMENT
/begin MEASUREMENT van_st_E2 "Status Vanos" UBYTE FORMULA_0003 0 0.0 0.0 255.0 READ_WRITE ECU_ADDRESS 0x3FD434 /end MEASUREMENT
/begin MEASUREMENT van_st_eingeregelt "Vanos eingeregelt" UBYTE FORMULA_0003 0 0.0 0.0 255.0 READ_WRITE ECU_ADDRESS 0x3FD436 /end MEASUREMENT
/begin MEASUREMENT van_st_geber_A1 "Geberstatus" UBYTE FORMULA_1217 0 0.0 0.0 255.0 READ_WRITE ECU_ADDRESS 0x3FD438 /end MEASUREMENT
/begin MEASUREMENT van_st_geber_A2 "Geberstatus" UBYTE FORMULA_1217 0 0.0 0.0 255.0 READ_WRITE ECU_ADDRESS 0x3FD43A /end MEASUREMENT
/begin MEASUREMENT van_st_geber_E1 "Geberstatus" UBYTE FORMULA_1217 0 0.0 0.0 255.0 READ_WRITE ECU_ADDRESS 0x3FD437 /end MEASUREMENT
/begin MEASUREMENT van_st_geber_E2 "Geberstatus" UBYTE FORMULA_1217 0 0.0 0.0 255.0 READ_WRITE ECU_ADDRESS 0x3FD439 /end MEASUREMENT
/begin MEASUREMENT van_st_unlock_A1 "Entriegelungs-Status" UBYTE FORMULA_1218 0 0.0 0.0 255.0 READ_WRITE ECU_ADDRESS 0x3FD43C /end MEASUREMENT
/begin MEASUREMENT van_st_unlock_A2 "Entriegelungs-Status" UBYTE FORMULA_1218 0 0.0 0.0 255.0 READ_WRITE ECU_ADDRESS 0x3FD43E /end MEASUREMENT
/begin MEASUREMENT van_st_unlock_E1 "Entriegelungs-Status" UBYTE FORMULA_1218 0 0.0 0.0 255.0 READ_WRITE ECU_ADDRESS 0x3FD43B /end MEASUREMENT
/begin MEASUREMENT van_st_unlock_E2 "Entriegelungs-Status" UBYTE FORMULA_1218 0 0.0 0.0 255.0 READ_WRITE ECU_ADDRESS 0x3FD43D /end MEASUREMENT
/begin MEASUREMENT van_t_soll_begr "Dauer Sollwert Min-Begrenzung" UWORD FORMULA_0644 0 0.0 0.0 655.3499755859375 READ_WRITE ECU_ADDRESS 0x3FD440 /end MEASUREMENT
/begin MEASUREMENT van_t_start_dly "Reglerfreigabe nach Motor Start" UWORD FORMULA_0021 0 0.0 0.0 655.0 READ_WRITE ECU_ADDRESS 0x3FD442 /end MEASUREMENT
/begin MEASUREMENT van_tb_imp_A1 "Timerstand bei ZahnInterrupt" ULONG FORMULA_0072 0 0.0 0.0 4294967295.0 READ_WRITE ECU_ADDRESS 0x3FD448 /end MEASUREMENT
/begin MEASUREMENT van_tb_imp_A2 "Timerstand bei ZahnInterrupt" ULONG FORMULA_0072 0 0.0 0.0 4294967295.0 READ_WRITE ECU_ADDRESS 0x3FD450 /end MEASUREMENT
/begin MEASUREMENT van_tb_imp_E1 "Timerstand bei ZahnInterrupt" ULONG FORMULA_0072 0 0.0 0.0 4294967295.0 READ_WRITE ECU_ADDRESS 0x3FD444 /end MEASUREMENT
/begin MEASUREMENT van_tb_imp_E2 "Timerstand bei ZahnInterrupt" ULONG FORMULA_0072 0 0.0 0.0 4294967295.0 READ_WRITE ECU_ADDRESS 0x3FD44C /end MEASUREMENT
/begin MEASUREMENT van_tv_A1 "Ventil Tastverhaeltnis" SWORD FORMULA_0107 0 0.0 0.0 100.0 READ_WRITE ECU_ADDRESS 0x3FD456 /end MEASUREMENT
/begin MEASUREMENT van_tv_A2 "Ventil Tastverhaeltnis" SWORD FORMULA_0107 0 0.0 0.0 100.0 READ_WRITE ECU_ADDRESS 0x3FD45A /end MEASUREMENT
/begin MEASUREMENT van_tv_E1 "Ventil Tastverhaeltnis" SWORD FORMULA_0107 0 0.0 0.0 100.0 READ_WRITE ECU_ADDRESS 0x3FD454 /end MEASUREMENT
/begin MEASUREMENT van_tv_E2 "Ventil Tastverhaeltnis" SWORD FORMULA_0107 0 0.0 0.0 100.0 READ_WRITE ECU_ADDRESS 0x3FD458 /end MEASUREMENT
/begin MEASUREMENT van_vo_filt_b1 "Ventil_Ueberschneidung" SWORD FORMULA_0102 0 0.0 -80.0 80.0 READ_WRITE ECU_ADDRESS 0x3FD45C /end MEASUREMENT
/begin MEASUREMENT van_vo_filt_b2 "Ventil_Ueberschneidung" SWORD FORMULA_0102 0 0.0 -80.0 80.0 READ_WRITE ECU_ADDRESS 0x3FD45E /end MEASUREMENT
/begin MEASUREMENT van_xd_A1 "Regeldifferenz" SWORD FORMULA_0102 0 0.0 -80.0 80.0 READ_WRITE ECU_ADDRESS 0x3FD462 /end MEASUREMENT
/begin MEASUREMENT van_xd_A2 "Regeldifferenz" SWORD FORMULA_0102 0 0.0 -80.0 80.0 READ_WRITE ECU_ADDRESS 0x3FD466 /end MEASUREMENT
/begin MEASUREMENT van_xd_E1 "Regeldifferenz" SWORD FORMULA_0102 0 0.0 -80.0 80.0 READ_WRITE ECU_ADDRESS 0x3FD460 /end MEASUREMENT
/begin MEASUREMENT van_xd_E2 "Regeldifferenz" SWORD FORMULA_0102 0 0.0 -80.0 80.0 READ_WRITE ECU_ADDRESS 0x3FD464 /end MEASUREMENT
/begin MEASUREMENT van_xd_filt_A1 "Gefilterte Regeldifferenz" SWORD FORMULA_0102 0 0.0 -80.0 80.0 READ_WRITE ECU_ADDRESS 0x3FD46A /end MEASUREMENT
/begin MEASUREMENT van_xd_filt_A2 "Gefilterte Regeldifferenz" SWORD FORMULA_0102 0 0.0 -80.0 80.0 READ_WRITE ECU_ADDRESS 0x3FD46E /end MEASUREMENT
/begin MEASUREMENT van_xd_filt_E1 "Gefilterte Regeldifferenz" SWORD FORMULA_0102 0 0.0 -80.0 80.0 READ_WRITE ECU_ADDRESS 0x3FD468 /end MEASUREMENT
/begin MEASUREMENT van_xd_filt_E2 "Gefilterte Regeldifferenz" SWORD FORMULA_0102 0 0.0 -80.0 80.0 READ_WRITE ECU_ADDRESS 0x3FD46C /end MEASUREMENT
/begin MEASUREMENT van_xd_tau "Filterzeitkonstante Regeldifferenz" UWORD FORMULA_1052 0 0.0 0.1000000014901161 6553.5 READ_WRITE ECU_ADDRESS 0x3FD478 /end MEASUREMENT
/begin MEASUREMENT van_zahn_cnt_b1 "Zahnzaehler fuer n-Messung" SBYTE FORMULA_0003 0 0.0 0.0 6.0 READ_WRITE ECU_ADDRESS 0x3FD47A /end MEASUREMENT
/begin MEASUREMENT van_zahn_cnt_b2 "Zahnzaehler fuer n-Messung" SBYTE FORMULA_0003 0 0.0 0.0 6.0 READ_WRITE ECU_ADDRESS 0x3FD47B /end MEASUREMENT
/begin MEASUREMENT van_zahn_ctr5ms_b1 "5ms-Ctr fuer n-Messung" SWORD FORMULA_0010 0 0.0 0.0 6.0 READ_WRITE ECU_ADDRESS 0x3FD47C /end MEASUREMENT
/begin MEASUREMENT van_zahn_ctr5ms_b2 "5ms-Ctr fuer n-Messung" SWORD FORMULA_0010 0 0.0 0.0 6.0 READ_WRITE ECU_ADDRESS 0x3FD47E /end MEASUREMENT
/begin MEASUREMENT vers_index "Programmindex" UBYTE FORMULA_0003 0 0.0 0.0 255.0 READ_WRITE ECU_ADDRESS 0x3FD4A4 /end MEASUREMENT
/begin MEASUREMENT vers_name "Applikateur der Ref-Page" UBYTE FORMULA_0420 0 0.0 0.0 255.0 READ_WRITE ECU_ADDRESS 0x3FD4A5 /end MEASUREMENT
/begin MEASUREMENT vers_prog "Programmversion" UWORD FORMULA_0010 0 0.0 0.0 65535.0 READ_WRITE ECU_ADDRESS 0x3FD4A2 /end MEASUREMENT
/begin MEASUREMENT vers_sg "verbautes Steuergeraet" UBYTE FORMULA_0421 0 0.0 0.0 255.0 READ_WRITE ECU_ADDRESS 0x3FD4A6 /end MEASUREMENT
/begin MEASUREMENT wf_asp_cnt "ASP-Counter f. WF-Auf-/Abbau" UWORD FORMULA_1240 0 0.0 0.0 1279.0 READ_WRITE ECU_ADDRESS 0x3FD566 /end MEASUREMENT
/begin MEASUREMENT wf_b1.soll "SOLL-Wandfilmmasse" UWORD FORMULA_0534 0 0.0 0.0 2000.0 READ_WRITE ECU_ADDRESS 0x3FD4CC /end MEASUREMENT
/begin MEASUREMENT wf_b1.soll_f_lam "WF-Korrekturfaktor Lambda" UWORD FORMULA_0073 0 0.0 0.0 4.0 READ_WRITE ECU_ADDRESS 0x3FD4D2 /end MEASUREMENT
/begin MEASUREMENT wf_b1.soll_f_ti "WF-Korrekturfaktor TI-Ende" UWORD FORMULA_0073 0 0.0 0.0 4.0 READ_WRITE ECU_ADDRESS 0x3FD4CE /end MEASUREMENT
/begin MEASUREMENT wf_b1.soll_f_van "WF-Korrekturfaktor Ventilueberschneidung" UWORD FORMULA_0073 0 0.0 0.0 4.0 READ_WRITE ECU_ADDRESS 0x3FD4D0 /end MEASUREMENT
/begin MEASUREMENT wf_b1.soll_grund "Grundwandfilmmasse" UWORD FORMULA_0534 0 0.0 0.0 2000.0 READ_WRITE ECU_ADDRESS 0x3FD4CA /end MEASUREMENT
/begin MEASUREMENT wf_b2.soll "SOLL-Wandfilmmasse" UWORD FORMULA_0534 0 0.0 0.0 2000.0 READ_WRITE ECU_ADDRESS 0x3FD4D8 /end MEASUREMENT
/begin MEASUREMENT wf_b2.soll_f_lam "WF-Korrekturfaktor Lambda" UWORD FORMULA_0073 0 0.0 0.0 4.0 READ_WRITE ECU_ADDRESS 0x3FD4DE /end MEASUREMENT
/begin MEASUREMENT wf_b2.soll_f_ti "WF-Korrekturfaktor TI-Ende" UWORD FORMULA_0073 0 0.0 0.0 4.0 READ_WRITE ECU_ADDRESS 0x3FD4DA /end MEASUREMENT
/begin MEASUREMENT wf_b2.soll_f_van "WF-Korrekturfaktor Ventilueberschneidung" UWORD FORMULA_0073 0 0.0 0.0 4.0 READ_WRITE ECU_ADDRESS 0x3FD4DC /end MEASUREMENT
/begin MEASUREMENT wf_b2.soll_grund "Grundwandfilmmasse" UWORD FORMULA_0534 0 0.0 0.0 2000.0 READ_WRITE ECU_ADDRESS 0x3FD4D6 /end MEASUREMENT
/begin MEASUREMENT wf_bank "BANK" UWORD FORMULA_0010 0 0.0 0.0 65535.0 READ_WRITE ECU_ADDRESS 0x3FD4C8 /end MEASUREMENT
/begin MEASUREMENT wf_dmks_t1 "wf_dmks_t1_ms/dt" UWORD FORMULA_0754 0 0.0 0.0 255.9960021972656 READ_WRITE ECU_ADDRESS 0x3FD4E6 /end MEASUREMENT
/begin MEASUREMENT wf_ist_eta_zyl1 "eta-korr. Wandfilmistmenge" UWORD FORMULA_0534 0 0.0 0.0 2000.0 READ_WRITE ECU_ADDRESS 0x3FD568 /end MEASUREMENT
/begin MEASUREMENT wf_ist_eta_zyl10 "eta-korr. Wandfilmistmenge" UWORD FORMULA_0534 0 0.0 0.0 2000.0 READ_WRITE ECU_ADDRESS 0x3FD57A /end MEASUREMENT
/begin MEASUREMENT wf_ist_eta_zyl2 "eta-korr. Wandfilmistmenge" UWORD FORMULA_0534 0 0.0 0.0 2000.0 READ_WRITE ECU_ADDRESS 0x3FD56A /end MEASUREMENT
/begin MEASUREMENT wf_ist_eta_zyl3 "eta-korr. Wandfilmistmenge" UWORD FORMULA_0534 0 0.0 0.0 2000.0 READ_WRITE ECU_ADDRESS 0x3FD56C /end MEASUREMENT
/begin MEASUREMENT wf_ist_eta_zyl4 "eta-korr. Wandfilmistmenge" UWORD FORMULA_0534 0 0.0 0.0 2000.0 READ_WRITE ECU_ADDRESS 0x3FD56E /end MEASUREMENT
/begin MEASUREMENT wf_ist_eta_zyl5 "eta-korr. Wandfilmistmenge" UWORD FORMULA_0534 0 0.0 0.0 2000.0 READ_WRITE ECU_ADDRESS 0x3FD570 /end MEASUREMENT
/begin MEASUREMENT wf_ist_eta_zyl6 "eta-korr. Wandfilmistmenge" UWORD FORMULA_0534 0 0.0 0.0 2000.0 READ_WRITE ECU_ADDRESS 0x3FD572 /end MEASUREMENT
/begin MEASUREMENT wf_ist_eta_zyl7 "eta-korr. Wandfilmistmenge" UWORD FORMULA_0534 0 0.0 0.0 2000.0 READ_WRITE ECU_ADDRESS 0x3FD574 /end MEASUREMENT
/begin MEASUREMENT wf_ist_eta_zyl8 "eta-korr. Wandfilmistmenge" UWORD FORMULA_0534 0 0.0 0.0 2000.0 READ_WRITE ECU_ADDRESS 0x3FD576 /end MEASUREMENT
/begin MEASUREMENT wf_ist_eta_zyl9 "eta-korr. Wandfilmistmenge" UWORD FORMULA_0534 0 0.0 0.0 2000.0 READ_WRITE ECU_ADDRESS 0x3FD578 /end MEASUREMENT
/begin MEASUREMENT wf_ist_start_zyl1 "Wandfilmrueckstand vor START" UWORD FORMULA_0534 0 0.0 0.0 2000.0 READ_WRITE ECU_ADDRESS 0x3FD4EA /end MEASUREMENT
/begin MEASUREMENT wf_ist_start_zyl10 "Wandfilmrueckstand vor START" UWORD FORMULA_0534 0 0.0 0.0 2000.0 READ_WRITE ECU_ADDRESS 0x3FD4FC /end MEASUREMENT
/begin MEASUREMENT wf_ist_start_zyl2 "Wandfilmrueckstand vor START" UWORD FORMULA_0534 0 0.0 0.0 2000.0 READ_WRITE ECU_ADDRESS 0x3FD4EC /end MEASUREMENT
/begin MEASUREMENT wf_ist_start_zyl3 "Wandfilmrueckstand vor START" UWORD FORMULA_0534 0 0.0 0.0 2000.0 READ_WRITE ECU_ADDRESS 0x3FD4EE /end MEASUREMENT
/begin MEASUREMENT wf_ist_start_zyl4 "Wandfilmrueckstand vor START" UWORD FORMULA_0534 0 0.0 0.0 2000.0 READ_WRITE ECU_ADDRESS 0x3FD4F0 /end MEASUREMENT
/begin MEASUREMENT wf_ist_start_zyl5 "Wandfilmrueckstand vor START" UWORD FORMULA_0534 0 0.0 0.0 2000.0 READ_WRITE ECU_ADDRESS 0x3FD4F2 /end MEASUREMENT
/begin MEASUREMENT wf_ist_start_zyl6 "Wandfilmrueckstand vor START" UWORD FORMULA_0534 0 0.0 0.0 2000.0 READ_WRITE ECU_ADDRESS 0x3FD4F4 /end MEASUREMENT
/begin MEASUREMENT wf_ist_start_zyl7 "Wandfilmrueckstand vor START" UWORD FORMULA_0534 0 0.0 0.0 2000.0 READ_WRITE ECU_ADDRESS 0x3FD4F6 /end MEASUREMENT
/begin MEASUREMENT wf_ist_start_zyl8 "Wandfilmrueckstand vor START" UWORD FORMULA_0534 0 0.0 0.0 2000.0 READ_WRITE ECU_ADDRESS 0x3FD4F8 /end MEASUREMENT
/begin MEASUREMENT wf_ist_start_zyl9 "Wandfilmrueckstand vor START" UWORD FORMULA_0534 0 0.0 0.0 2000.0 READ_WRITE ECU_ADDRESS 0x3FD4FA /end MEASUREMENT
/begin MEASUREMENT wf_lam_soll_offs_b1 "OFFSET-lam_soll abhaengig vom wf" SWORD FORMULA_0025 0 0.0 -2.0 1.999899983406067 READ_WRITE ECU_ADDRESS 0x3FD592 /end MEASUREMENT
/begin MEASUREMENT wf_lam_soll_offs_b2 "OFFSET-lam_soll abhaengig vom wf" SWORD FORMULA_0025 0 0.0 -2.0 1.999899983406067 READ_WRITE ECU_ADDRESS 0x3FD594 /end MEASUREMENT
/begin MEASUREMENT wf_mks_begr_neg_b1 "min. Schwelle fuer Wandfilmbegrenzung" SWORD FORMULA_0534 0 0.0 -1024.0 1023.0 READ_WRITE ECU_ADDRESS 0x3FD59E /end MEASUREMENT
/begin MEASUREMENT wf_mks_begr_neg_b2 "min. Schwelle fuer Wandfilmbegrenzung" SWORD FORMULA_0534 0 0.0 -1024.0 1023.0 READ_WRITE ECU_ADDRESS 0x3FD5A0 /end MEASUREMENT
/begin MEASUREMENT wf_mks_begr_pos_b1 "max. Schwelle fuer Wandfilmbegrenzung" SWORD FORMULA_0534 0 0.0 -1024.0 1023.0 READ_WRITE ECU_ADDRESS 0x3FD59A /end MEASUREMENT
/begin MEASUREMENT wf_mks_begr_pos_b2 "max. Schwelle fuer Wandfilmbegrenzung" SWORD FORMULA_0534 0 0.0 -1024.0 1023.0 READ_WRITE ECU_ADDRESS 0x3FD59C /end MEASUREMENT
/begin MEASUREMENT wf_mks_begr_zyl1 "begr. wf_mks_roh" SWORD FORMULA_0534 0 0.0 -1024.0 1023.0 READ_WRITE ECU_ADDRESS 0x3FD53C /end MEASUREMENT
/begin MEASUREMENT wf_mks_begr_zyl10 "begr. wf_mks_roh" SWORD FORMULA_0534 0 0.0 -1024.0 1023.0 READ_WRITE ECU_ADDRESS 0x3FD54E /end MEASUREMENT
/begin MEASUREMENT wf_mks_begr_zyl2 "begr. wf_mks_roh" SWORD FORMULA_0534 0 0.0 -1024.0 1023.0 READ_WRITE ECU_ADDRESS 0x3FD53E /end MEASUREMENT
/begin MEASUREMENT wf_mks_begr_zyl3 "begr. wf_mks_roh" SWORD FORMULA_0534 0 0.0 -1024.0 1023.0 READ_WRITE ECU_ADDRESS 0x3FD540 /end MEASUREMENT
/begin MEASUREMENT wf_mks_begr_zyl4 "begr. wf_mks_roh" SWORD FORMULA_0534 0 0.0 -1024.0 1023.0 READ_WRITE ECU_ADDRESS 0x3FD542 /end MEASUREMENT
/begin MEASUREMENT wf_mks_begr_zyl5 "begr. wf_mks_roh" SWORD FORMULA_0534 0 0.0 -1024.0 1023.0 READ_WRITE ECU_ADDRESS 0x3FD544 /end MEASUREMENT
/begin MEASUREMENT wf_mks_begr_zyl6 "begr. wf_mks_roh" SWORD FORMULA_0534 0 0.0 -1024.0 1023.0 READ_WRITE ECU_ADDRESS 0x3FD546 /end MEASUREMENT
/begin MEASUREMENT wf_mks_begr_zyl7 "begr. wf_mks_roh" SWORD FORMULA_0534 0 0.0 -1024.0 1023.0 READ_WRITE ECU_ADDRESS 0x3FD548 /end MEASUREMENT
/begin MEASUREMENT wf_mks_begr_zyl8 "begr. wf_mks_roh" SWORD FORMULA_0534 0 0.0 -1024.0 1023.0 READ_WRITE ECU_ADDRESS 0x3FD54A /end MEASUREMENT
/begin MEASUREMENT wf_mks_begr_zyl9 "begr. wf_mks_roh" SWORD FORMULA_0534 0 0.0 -1024.0 1023.0 READ_WRITE ECU_ADDRESS 0x3FD54C /end MEASUREMENT
/begin MEASUREMENT wf_mks_dif_zyl1 "Dif. aus SOLL-IST-WF" SWORD FORMULA_0534 0 0.0 -1024.0 1023.0 READ_WRITE ECU_ADDRESS 0x3FD512 /end MEASUREMENT
/begin MEASUREMENT wf_mks_dif_zyl10 "Dif. aus SOLL-IST-WF" SWORD FORMULA_0534 0 0.0 -1024.0 1023.0 READ_WRITE ECU_ADDRESS 0x3FD524 /end MEASUREMENT
/begin MEASUREMENT wf_mks_dif_zyl2 "Dif. aus SOLL-IST-WF" SWORD FORMULA_0534 0 0.0 -1024.0 1023.0 READ_WRITE ECU_ADDRESS 0x3FD514 /end MEASUREMENT
/begin MEASUREMENT wf_mks_dif_zyl3 "Dif. aus SOLL-IST-WF" SWORD FORMULA_0534 0 0.0 -1024.0 1023.0 READ_WRITE ECU_ADDRESS 0x3FD516 /end MEASUREMENT
/begin MEASUREMENT wf_mks_dif_zyl4 "Dif. aus SOLL-IST-WF" SWORD FORMULA_0534 0 0.0 -1024.0 1023.0 READ_WRITE ECU_ADDRESS 0x3FD518 /end MEASUREMENT
/begin MEASUREMENT wf_mks_dif_zyl5 "Dif. aus SOLL-IST-WF" SWORD FORMULA_0534 0 0.0 -1024.0 1023.0 READ_WRITE ECU_ADDRESS 0x3FD51A /end MEASUREMENT
/begin MEASUREMENT wf_mks_dif_zyl6 "Dif. aus SOLL-IST-WF" SWORD FORMULA_0534 0 0.0 -1024.0 1023.0 READ_WRITE ECU_ADDRESS 0x3FD51C /end MEASUREMENT
/begin MEASUREMENT wf_mks_dif_zyl7 "Dif. aus SOLL-IST-WF" SWORD FORMULA_0534 0 0.0 -1024.0 1023.0 READ_WRITE ECU_ADDRESS 0x3FD51E /end MEASUREMENT
/begin MEASUREMENT wf_mks_dif_zyl8 "Dif. aus SOLL-IST-WF" SWORD FORMULA_0534 0 0.0 -1024.0 1023.0 READ_WRITE ECU_ADDRESS 0x3FD520 /end MEASUREMENT
/begin MEASUREMENT wf_mks_dif_zyl9 "Dif. aus SOLL-IST-WF" SWORD FORMULA_0534 0 0.0 -1024.0 1023.0 READ_WRITE ECU_ADDRESS 0x3FD522 /end MEASUREMENT
/begin MEASUREMENT wf_mks_roh_zyl1 "benoetigte MKS aus WF" SWORD FORMULA_0534 0 0.0 -1024.0 1023.0 READ_WRITE ECU_ADDRESS 0x3FD526 /end MEASUREMENT
/begin MEASUREMENT wf_mks_roh_zyl10 "benoetigte MKS aus WF" SWORD FORMULA_0534 0 0.0 -1024.0 1023.0 READ_WRITE ECU_ADDRESS 0x3FD538 /end MEASUREMENT
/begin MEASUREMENT wf_mks_roh_zyl2 "benoetigte MKS aus WF" SWORD FORMULA_0534 0 0.0 -1024.0 1023.0 READ_WRITE ECU_ADDRESS 0x3FD528 /end MEASUREMENT
/begin MEASUREMENT wf_mks_roh_zyl3 "benoetigte MKS aus WF" SWORD FORMULA_0534 0 0.0 -1024.0 1023.0 READ_WRITE ECU_ADDRESS 0x3FD52A /end MEASUREMENT
/begin MEASUREMENT wf_mks_roh_zyl4 "benoetigte MKS aus WF" SWORD FORMULA_0534 0 0.0 -1024.0 1023.0 READ_WRITE ECU_ADDRESS 0x3FD52C /end MEASUREMENT
/begin MEASUREMENT wf_mks_roh_zyl5 "benoetigte MKS aus WF" SWORD FORMULA_0534 0 0.0 -1024.0 1023.0 READ_WRITE ECU_ADDRESS 0x3FD52E /end MEASUREMENT
/begin MEASUREMENT wf_mks_roh_zyl6 "benoetigte MKS aus WF" SWORD FORMULA_0534 0 0.0 -1024.0 1023.0 READ_WRITE ECU_ADDRESS 0x3FD530 /end MEASUREMENT
/begin MEASUREMENT wf_mks_roh_zyl7 "benoetigte MKS aus WF" SWORD FORMULA_0534 0 0.0 -1024.0 1023.0 READ_WRITE ECU_ADDRESS 0x3FD532 /end MEASUREMENT
/begin MEASUREMENT wf_mks_roh_zyl8 "benoetigte MKS aus WF" SWORD FORMULA_0534 0 0.0 -1024.0 1023.0 READ_WRITE ECU_ADDRESS 0x3FD534 /end MEASUREMENT
/begin MEASUREMENT wf_mks_roh_zyl9 "benoetigte MKS aus WF" SWORD FORMULA_0534 0 0.0 -1024.0 1023.0 READ_WRITE ECU_ADDRESS 0x3FD536 /end MEASUREMENT
/begin MEASUREMENT wf_mks_st "WF-Aktiv-Status" UWORD FORMULA_0080 0 0.0 0.0 65535.0 READ_WRITE ECU_ADDRESS 0x3FD4E4 /end MEASUREMENT
/begin MEASUREMENT wf_mks_start_max "max. benoetigte MKS im START" UWORD FORMULA_0534 0 0.0 0.0 2000.0 READ_WRITE ECU_ADDRESS 0x3FD5A4 /end MEASUREMENT
/begin MEASUREMENT wf_mks_start_zyl1 "Kraftstoffmasse im START" UWORD FORMULA_0534 0 0.0 0.0 2000.0 READ_WRITE ECU_ADDRESS 0x3FD4FE /end MEASUREMENT
/begin MEASUREMENT wf_mks_start_zyl10 "Kraftstoffmasse im START" UWORD FORMULA_0534 0 0.0 0.0 2000.0 READ_WRITE ECU_ADDRESS 0x3FD510 /end MEASUREMENT
/begin MEASUREMENT wf_mks_start_zyl2 "Kraftstoffmasse im START" UWORD FORMULA_0534 0 0.0 0.0 2000.0 READ_WRITE ECU_ADDRESS 0x3FD500 /end MEASUREMENT
/begin MEASUREMENT wf_mks_start_zyl3 "Kraftstoffmasse im START" UWORD FORMULA_0534 0 0.0 0.0 2000.0 READ_WRITE ECU_ADDRESS 0x3FD502 /end MEASUREMENT
/begin MEASUREMENT wf_mks_start_zyl4 "Kraftstoffmasse im START" UWORD FORMULA_0534 0 0.0 0.0 2000.0 READ_WRITE ECU_ADDRESS 0x3FD504 /end MEASUREMENT
/begin MEASUREMENT wf_mks_start_zyl5 "Kraftstoffmasse im START" UWORD FORMULA_0534 0 0.0 0.0 2000.0 READ_WRITE ECU_ADDRESS 0x3FD506 /end MEASUREMENT
/begin MEASUREMENT wf_mks_start_zyl6 "Kraftstoffmasse im START" UWORD FORMULA_0534 0 0.0 0.0 2000.0 READ_WRITE ECU_ADDRESS 0x3FD508 /end MEASUREMENT
/begin MEASUREMENT wf_mks_start_zyl7 "Kraftstoffmasse im START" UWORD FORMULA_0534 0 0.0 0.0 2000.0 READ_WRITE ECU_ADDRESS 0x3FD50A /end MEASUREMENT
/begin MEASUREMENT wf_mks_start_zyl8 "Kraftstoffmasse im START" UWORD FORMULA_0534 0 0.0 0.0 2000.0 READ_WRITE ECU_ADDRESS 0x3FD50C /end MEASUREMENT
/begin MEASUREMENT wf_mks_start_zyl9 "Kraftstoffmasse im START" UWORD FORMULA_0534 0 0.0 0.0 2000.0 READ_WRITE ECU_ADDRESS 0x3FD50E /end MEASUREMENT
/begin MEASUREMENT wf_mks_tau "Filterkonstante" UWORD FORMULA_0762 0 0.0 0.0 7.999800205230713 READ_WRITE ECU_ADDRESS 0x3FD4E8 /end MEASUREMENT
/begin MEASUREMENT wf_mks_zyl_offs "OFFSET auf wf_mks_begr" UWORD FORMULA_0534 0 0.0 0.0 2000.0 READ_WRITE ECU_ADDRESS 0x3FD53A /end MEASUREMENT
/begin MEASUREMENT wf_mks_zyl1 "MKS aus Wandfilmmodell" SWORD FORMULA_0111 0 0.0 -512.0 511.0 READ_WRITE ECU_ADDRESS 0x3FD550 /end MEASUREMENT
/begin MEASUREMENT wf_mks_zyl10 "MKS aus Wandfilmmodell" SWORD FORMULA_0111 0 0.0 -512.0 511.0 READ_WRITE ECU_ADDRESS 0x3FD562 /end MEASUREMENT
/begin MEASUREMENT wf_mks_zyl2 "MKS aus Wandfilmmodell" SWORD FORMULA_0111 0 0.0 -512.0 511.0 READ_WRITE ECU_ADDRESS 0x3FD552 /end MEASUREMENT
/begin MEASUREMENT wf_mks_zyl3 "MKS aus Wandfilmmodell" SWORD FORMULA_0111 0 0.0 -512.0 511.0 READ_WRITE ECU_ADDRESS 0x3FD554 /end MEASUREMENT
/begin MEASUREMENT wf_mks_zyl4 "MKS aus Wandfilmmodell" SWORD FORMULA_0111 0 0.0 -512.0 511.0 READ_WRITE ECU_ADDRESS 0x3FD556 /end MEASUREMENT
/begin MEASUREMENT wf_mks_zyl5 "MKS aus Wandfilmmodell" SWORD FORMULA_0111 0 0.0 -512.0 511.0 READ_WRITE ECU_ADDRESS 0x3FD558 /end MEASUREMENT
/begin MEASUREMENT wf_mks_zyl6 "MKS aus Wandfilmmodell" SWORD FORMULA_0111 0 0.0 -512.0 511.0 READ_WRITE ECU_ADDRESS 0x3FD55A /end MEASUREMENT
/begin MEASUREMENT wf_mks_zyl7 "MKS aus Wandfilmmodell" SWORD FORMULA_0111 0 0.0 -512.0 511.0 READ_WRITE ECU_ADDRESS 0x3FD55C /end MEASUREMENT
/begin MEASUREMENT wf_mks_zyl8 "MKS aus Wandfilmmodell" SWORD FORMULA_0111 0 0.0 -512.0 511.0 READ_WRITE ECU_ADDRESS 0x3FD55E /end MEASUREMENT
/begin MEASUREMENT wf_mks_zyl9 "MKS aus Wandfilmmodell" SWORD FORMULA_0111 0 0.0 -512.0 511.0 READ_WRITE ECU_ADDRESS 0x3FD560 /end MEASUREMENT
/begin MEASUREMENT wf_oelv_eta_f "Kraftstoffeintrag ins Oel" UWORD FORMULA_0199 0 0.0 0.0 1.0 READ_WRITE ECU_ADDRESS 0x3FD57C /end MEASUREMENT
/begin MEASUREMENT wf_oelv_zyl1 "Kraftstoffeintrag ins Oel" UWORD FORMULA_0534 0 0.0 0.0 2000.0 READ_WRITE ECU_ADDRESS 0x3FD57E /end MEASUREMENT
/begin MEASUREMENT wf_oelv_zyl10 "Kraftstoffeintrag ins Oel" UWORD FORMULA_0534 0 0.0 0.0 2000.0 READ_WRITE ECU_ADDRESS 0x3FD590 /end MEASUREMENT
/begin MEASUREMENT wf_oelv_zyl2 "Kraftstoffeintrag ins Oel" UWORD FORMULA_0534 0 0.0 0.0 2000.0 READ_WRITE ECU_ADDRESS 0x3FD580 /end MEASUREMENT
/begin MEASUREMENT wf_oelv_zyl3 "Kraftstoffeintrag ins Oel" UWORD FORMULA_0534 0 0.0 0.0 2000.0 READ_WRITE ECU_ADDRESS 0x3FD582 /end MEASUREMENT
/begin MEASUREMENT wf_oelv_zyl4 "Kraftstoffeintrag ins Oel" UWORD FORMULA_0534 0 0.0 0.0 2000.0 READ_WRITE ECU_ADDRESS 0x3FD584 /end MEASUREMENT
/begin MEASUREMENT wf_oelv_zyl5 "Kraftstoffeintrag ins Oel" UWORD FORMULA_0534 0 0.0 0.0 2000.0 READ_WRITE ECU_ADDRESS 0x3FD586 /end MEASUREMENT
/begin MEASUREMENT wf_oelv_zyl6 "Kraftstoffeintrag ins Oel" UWORD FORMULA_0534 0 0.0 0.0 2000.0 READ_WRITE ECU_ADDRESS 0x3FD588 /end MEASUREMENT
/begin MEASUREMENT wf_oelv_zyl7 "Kraftstoffeintrag ins Oel" UWORD FORMULA_0534 0 0.0 0.0 2000.0 READ_WRITE ECU_ADDRESS 0x3FD58A /end MEASUREMENT
/begin MEASUREMENT wf_oelv_zyl8 "Kraftstoffeintrag ins Oel" UWORD FORMULA_0534 0 0.0 0.0 2000.0 READ_WRITE ECU_ADDRESS 0x3FD58C /end MEASUREMENT
/begin MEASUREMENT wf_oelv_zyl9 "Kraftstoffeintrag ins Oel" UWORD FORMULA_0534 0 0.0 0.0 2000.0 READ_WRITE ECU_ADDRESS 0x3FD58E /end MEASUREMENT
/begin MEASUREMENT wf_psau_b1 "Saugrohrdruck fuer WF" SWORD FORMULA_0075 0 0.0 0.0 2000.0 READ_WRITE ECU_ADDRESS 0x3FD596 /end MEASUREMENT
/begin MEASUREMENT wf_psau_b2 "Saugrohrdruck fuer WF" SWORD FORMULA_0075 0 0.0 0.0 2000.0 READ_WRITE ECU_ADDRESS 0x3FD598 /end MEASUREMENT
/begin MEASUREMENT wf_soll_f_pumg "WF-Korrekturfaktor Hoehe/Umgebungsdruck" UWORD FORMULA_0073 0 0.0 0.0 4.0 READ_WRITE ECU_ADDRESS 0x3FD5A6 /end MEASUREMENT
/begin MEASUREMENT wf_start_seq_cnt "Segmentcounter f. sequentiellen WF-START" UWORD FORMULA_1239 0 0.0 0.0 12.0 READ_WRITE ECU_ADDRESS 0x3FD564 /end MEASUREMENT
/begin MEASUREMENT wf_start_st "Status-simultan/sequentieller WF-START" UWORD FORMULA_0080 0 0.0 0.0 65535.0 READ_WRITE ECU_ADDRESS 0x3FD4E2 /end MEASUREMENT
/begin MEASUREMENT wf_zyl_aktiv_st "WF-Ausgabe-Status" UWORD FORMULA_0010 0 0.0 0.0 65535.0 READ_WRITE ECU_ADDRESS 0x3FD5A2 /end MEASUREMENT
/begin MEASUREMENT zust_exd_st "Zustandsstatus fuer externe Ansteuerung Diagnose" UBYTE FORMULA_1242 0 0.0 0.0 255.0 READ_WRITE ECU_ADDRESS 0x3FD5AA /end MEASUREMENT
/begin COMPU_METHOD FORMULA_0000 "FORMULA_0000" RAT_FUNC "%7.0" "-" COEFFS 0 1 0 0 0 1 /end COMPU_METHOD
/begin COMPU_METHOD FORMULA_0001 "FORMULA_0001" RAT_FUNC "%6.1" "%" COEFFS 0 10.0 0.0 0 0.0 1.0 /end COMPU_METHOD
/begin COMPU_METHOD FORMULA_0003 "FORMULA_0003" RAT_FUNC "%3.0" "-" COEFFS 0 1 0 0 0 1 /end COMPU_METHOD
/begin COMPU_METHOD FORMULA_0006 "FORMULA_0006" RAT_FUNC "%5.0" "Upm" COEFFS 0 1 0 0 0 1 /end COMPU_METHOD
/begin COMPU_METHOD FORMULA_0007 "FORMULA_0007" RAT_FUNC "%8.3" "-" COEFFS 0 10000.0 0.0 0 0.0 1.0 /end COMPU_METHOD
/begin COMPU_METHOD FORMULA_0008 "FORMULA_0008" RAT_FUNC "%6.1" "V" COEFFS 0 10.0 0.0 0 0.0 1.0 /end COMPU_METHOD
/begin COMPU_METHOD FORMULA_0010 "FORMULA_0010" RAT_FUNC "%5.0" "-" COEFFS 0 1 0 0 0 1 /end COMPU_METHOD
/begin COMPU_METHOD FORMULA_0021 "FORMULA_0021" RAT_FUNC "%7.2" "s" COEFFS 0 100.0 0.0 0 0.0 1.0 /end COMPU_METHOD
/begin COMPU_METHOD FORMULA_0023 "FORMULA_0023" RAT_FUNC "%6.1" "°C" COEFFS 0 10.0 2732.0 0 0.0 1.0 /end COMPU_METHOD
/begin COMPU_METHOD FORMULA_0024 "FORMULA_0024" RAT_FUNC "%9.4" "-" COEFFS 0 32768.0 0.0 0 0.0 1.0 /end COMPU_METHOD
/begin COMPU_METHOD FORMULA_0025 "FORMULA_0025" RAT_FUNC "%8.3" "-" COEFFS 0 16384.0 0.0 0 0.0 1.0 /end COMPU_METHOD
/begin COMPU_METHOD FORMULA_0037 "FORMULA_0037" RAT_FUNC "%5.2" "-" COEFFS 0 1 0 0 0 1 /end COMPU_METHOD
/begin COMPU_METHOD FORMULA_0071 "FORMULA_0071" RAT_FUNC "%6.1" "s" COEFFS 0 10.0 0.0 0 0.0 1.0 /end COMPU_METHOD
/begin COMPU_METHOD FORMULA_0072 "FORMULA_0072" RAT_FUNC "%7.0" "us" COEFFS 0 1 0 0 0 1 /end COMPU_METHOD
/begin COMPU_METHOD FORMULA_0073 "FORMULA_0073" RAT_FUNC "%8.3" "-" COEFFS 0 1024.0 0.0 0 0.0 1.0 /end COMPU_METHOD
/begin COMPU_METHOD FORMULA_0074 "FORMULA_0074" RAT_FUNC "%6.1" "Kelvin" COEFFS 0 10.0 0.0 0 0.0 1.0 /end COMPU_METHOD
/begin COMPU_METHOD FORMULA_0075 "FORMULA_0075" RAT_FUNC "%6.1" "mbar" COEFFS 0 16.0 0.0 0 0.0 1.0 /end COMPU_METHOD
/begin COMPU_METHOD FORMULA_0076 "FORMULA_0076" RAT_FUNC "%6.1" "km/h" COEFFS 0 16.0 0.0 0 0.0 1.0 /end COMPU_METHOD
/begin COMPU_METHOD FORMULA_0080 "FORMULA_0080" RAT_FUNC "%7.2" "-" COEFFS 0 1 0 0 0 1 /end COMPU_METHOD
/begin COMPU_METHOD FORMULA_0102 "FORMULA_0102" RAT_FUNC "%6.1" "°KW" COEFFS 0 10.0 0.0 0 0.0 1.0 /end COMPU_METHOD
/begin COMPU_METHOD FORMULA_0103 "FORMULA_0103" RAT_FUNC "%6.1" "kg/h" COEFFS 0 10.0 0.0 0 0.0 1.0 /end COMPU_METHOD
/begin COMPU_METHOD FORMULA_0106 "FORMULA_0106" RAT_FUNC "%7.2" "%" COEFFS 0 163.84 0.0 0 0.0 1.0 /end COMPU_METHOD
/begin COMPU_METHOD FORMULA_0107 "FORMULA_0107" RAT_FUNC "%6.1" "%" COEFFS 0 10.24 0.0 0 0.0 1.0 /end COMPU_METHOD
/begin COMPU_METHOD FORMULA_0111 "FORMULA_0111" RAT_FUNC "%7.2" "mg" COEFFS 0 64.0 0.0 0 0.0 1.0 /end COMPU_METHOD
/begin COMPU_METHOD FORMULA_0114 "FORMULA_0114" RAT_FUNC "%5.0" "digit" COEFFS 0 1 0 0 0 1 /end COMPU_METHOD
/begin COMPU_METHOD FORMULA_0147 "FORMULA_0147" RAT_FUNC "%9.2" "s" COEFFS 0 100.0 0.0 0 0.0 1.0 /end COMPU_METHOD
/begin COMPU_METHOD FORMULA_0199 "FORMULA_0199" RAT_FUNC "%9.4" "-" COEFFS 0 16384.0 0.0 0 0.0 1.0 /end COMPU_METHOD
/begin COMPU_METHOD FORMULA_0200 "FORMULA_0200" TAB_VERB "%5.2" "-" COMPU_TAB_REF FORMULA_0200_VTAB /end COMPU_METHOD
/begin COMPU_METHOD FORMULA_0201 "FORMULA_0201" TAB_VERB "%5.2" "-" COMPU_TAB_REF FORMULA_0201_VTAB /end COMPU_METHOD
/begin COMPU_METHOD FORMULA_0202 "FORMULA_0202" TAB_VERB "%5.2" "-" COMPU_TAB_REF FORMULA_0202_VTAB /end COMPU_METHOD
/begin COMPU_METHOD FORMULA_0203 "FORMULA_0203" TAB_VERB "%5.2" "-" COMPU_TAB_REF FORMULA_0203_VTAB /end COMPU_METHOD
/begin COMPU_METHOD FORMULA_0204 "FORMULA_0204" TAB_VERB "%5.2" "-" COMPU_TAB_REF FORMULA_0204_VTAB /end COMPU_METHOD
/begin COMPU_METHOD FORMULA_0205 "FORMULA_0205" TAB_VERB "%5.2" "-" COMPU_TAB_REF FORMULA_0205_VTAB /end COMPU_METHOD
/begin COMPU_METHOD FORMULA_0206 "FORMULA_0206" TAB_VERB "%5.2" "-" COMPU_TAB_REF FORMULA_0206_VTAB /end COMPU_METHOD
/begin COMPU_METHOD FORMULA_0306 "FORMULA_0306" RAT_FUNC "%5.2" "s" COEFFS 0 100.0 0.0 0 0.0 1.0 /end COMPU_METHOD
/begin COMPU_METHOD FORMULA_0407 "FORMULA_0407" TAB_VERB "%3.0" "-" COMPU_TAB_REF FORMULA_0407_VTAB /end COMPU_METHOD
/begin COMPU_METHOD FORMULA_0408 "FORMULA_0408" RAT_FUNC "%3.0" "-" COEFFS 0 1.0 -1.0 0 0.0 1.0 /end COMPU_METHOD
/begin COMPU_METHOD FORMULA_0409 "FORMULA_0409" TAB_VERB "%3.0" "-" COMPU_TAB_REF FORMULA_0409_VTAB /end COMPU_METHOD
/begin COMPU_METHOD FORMULA_0410 "FORMULA_0410" TAB_VERB "%3.0" "-" COMPU_TAB_REF FORMULA_0410_VTAB /end COMPU_METHOD
/begin COMPU_METHOD FORMULA_0411 "FORMULA_0411" TAB_VERB "%3.0" "-" COMPU_TAB_REF FORMULA_0411_VTAB /end COMPU_METHOD
/begin COMPU_METHOD FORMULA_0412 "FORMULA_0412" TAB_VERB "%3.0" "-" COMPU_TAB_REF FORMULA_0412_VTAB /end COMPU_METHOD
/begin COMPU_METHOD FORMULA_0413 "FORMULA_0413" TAB_VERB "%3.0" "-" COMPU_TAB_REF FORMULA_0413_VTAB /end COMPU_METHOD
/begin COMPU_METHOD FORMULA_0414 "FORMULA_0414" TAB_VERB "%3.0" "-" COMPU_TAB_REF FORMULA_0414_VTAB /end COMPU_METHOD
/begin COMPU_METHOD FORMULA_0415 "FORMULA_0415" TAB_VERB "%3.0" "-" COMPU_TAB_REF FORMULA_0415_VTAB /end COMPU_METHOD
/begin COMPU_METHOD FORMULA_0416 "FORMULA_0416" TAB_VERB "%3.0" "-" COMPU_TAB_REF FORMULA_0416_VTAB /end COMPU_METHOD
/begin COMPU_METHOD FORMULA_0417 "FORMULA_0417" TAB_VERB "%3.0" "-" COMPU_TAB_REF FORMULA_0417_VTAB /end COMPU_METHOD
/begin COMPU_METHOD FORMULA_0418 "FORMULA_0418" RAT_FUNC "%5.0" "Upm" COEFFS 0 0 27344 0 1 0 /end COMPU_METHOD
/begin COMPU_METHOD FORMULA_0419 "FORMULA_0419" TAB_VERB "%3.0" "-" COMPU_TAB_REF FORMULA_0419_VTAB /end COMPU_METHOD
/begin COMPU_METHOD FORMULA_0420 "FORMULA_0420" TAB_VERB "%5.2" "-" COMPU_TAB_REF FORMULA_0420_VTAB /end COMPU_METHOD
/begin COMPU_METHOD FORMULA_0421 "FORMULA_0421" TAB_VERB "%5.2" "-" COMPU_TAB_REF FORMULA_0421_VTAB /end COMPU_METHOD
/begin COMPU_METHOD FORMULA_0422 "FORMULA_0422" TAB_VERB "%5.2" "-" COMPU_TAB_REF FORMULA_0422_VTAB /end COMPU_METHOD
/begin COMPU_METHOD FORMULA_0461 "FORMULA_0461" RAT_FUNC "%4.1" "s" COEFFS 0 10.0 0.0 0 0.0 1.0 /end COMPU_METHOD
/begin COMPU_METHOD FORMULA_0534 "FORMULA_0534" RAT_FUNC "%7.2" "mg" COEFFS 0 32.0 0.0 0 0.0 1.0 /end COMPU_METHOD
/begin COMPU_METHOD FORMULA_0593 "FORMULA_0593" RAT_FUNC "%5.0" "s" COEFFS 0 1 0 0 0 1 /end COMPU_METHOD
/begin COMPU_METHOD FORMULA_0597 "FORMULA_0597" RAT_FUNC "%7.2" "min" COEFFS 0 60.0 0.0 0 0.0 1.0 /end COMPU_METHOD
/begin COMPU_METHOD FORMULA_0630 "FORMULA_0630" TAB_VERB "%5.2" "-" COMPU_TAB_REF FORMULA_0630_VTAB /end COMPU_METHOD
/begin COMPU_METHOD FORMULA_0638 "FORMULA_0638" RAT_FUNC "%5.2" "" COEFFS 0 128.0 0.0 0 0.0 1.0 /end COMPU_METHOD
/begin COMPU_METHOD FORMULA_0644 "FORMULA_0644" RAT_FUNC "%6.1" "s" COEFFS 0 100.0 0.0 0 0.0 1.0 /end COMPU_METHOD
/begin COMPU_METHOD FORMULA_0658 "FORMULA_0658" RAT_FUNC "%5.2" "s" COEFFS 0 0 2.56 0 1 0 /end COMPU_METHOD
/begin COMPU_METHOD FORMULA_0679 "FORMULA_0679" RAT_FUNC "%5.2" "s" COEFFS 0 0 25.6 0 1 0 /end COMPU_METHOD
/begin COMPU_METHOD FORMULA_0706 "FORMULA_0706" RAT_FUNC "%6.1" "%" COEFFS 0 100.0 0.0 0 0.0 1.0 /end COMPU_METHOD
/begin COMPU_METHOD FORMULA_0746 "FORMULA_0746" RAT_FUNC "%6.1" "l/h" COEFFS 0 8.0 0.0 0 0.0 1.0 /end COMPU_METHOD
/begin COMPU_METHOD FORMULA_0754 "FORMULA_0754" RAT_FUNC "%7.2" "-" COEFFS 0 256.0 0.0 0 0.0 1.0 /end COMPU_METHOD
/begin COMPU_METHOD FORMULA_0762 "FORMULA_0762" RAT_FUNC "%8.3" "-" COEFFS 0 8192.0 0.0 0 0.0 1.0 /end COMPU_METHOD
/begin COMPU_METHOD FORMULA_0921 "FORMULA_0921" RAT_FUNC "%5.0" "s" COEFFS 0 100.0 0.0 0 0.0 1.0 /end COMPU_METHOD
/begin COMPU_METHOD FORMULA_0971 "FORMULA_0971" RAT_FUNC "%5.0" "mbar" COEFFS 0 16.0 0.0 0 0.0 1.0 /end COMPU_METHOD
/begin COMPU_METHOD FORMULA_0973 "FORMULA_0973" RAT_FUNC "%8.3" "mbar" COEFFS 0 16.0 0.0 0 0.0 1.0 /end COMPU_METHOD
/begin COMPU_METHOD FORMULA_0975 "FORMULA_0975" RAT_FUNC "%8.3" "mbar/V" COEFFS 0 80.0 0.0 0 0.0 1.0 /end COMPU_METHOD
/begin COMPU_METHOD FORMULA_0992 "FORMULA_0992" TAB_VERB "%3.0" "-" COMPU_TAB_REF FORMULA_0992_VTAB /end COMPU_METHOD
/begin COMPU_METHOD FORMULA_1049 "FORMULA_1049" TAB_VERB "%3.0" "-" COMPU_TAB_REF FORMULA_1049_VTAB /end COMPU_METHOD
/begin COMPU_METHOD FORMULA_1050 "FORMULA_1050" RAT_FUNC "%8.1" "mbar" COEFFS 0 16.0 0.0 0 0.0 1.0 /end COMPU_METHOD
/begin COMPU_METHOD FORMULA_1051 "FORMULA_1051" RAT_FUNC "%6.1" "mbar/s" COEFFS 0 1.6 0.0 0 0.0 1.0 /end COMPU_METHOD
/begin COMPU_METHOD FORMULA_1052 "FORMULA_1052" RAT_FUNC "%7.2" "s" COEFFS 0 0 6553.5 0 1 0 /end COMPU_METHOD
/begin COMPU_METHOD FORMULA_1053 "FORMULA_1053" RAT_FUNC "%7.2" "mbar" COEFFS 0 16.0 0.0 0 0.0 1.0 /end COMPU_METHOD
/begin COMPU_METHOD FORMULA_1054 "FORMULA_1054" TAB_VERB "%3.0" "-" COMPU_TAB_REF FORMULA_1054_VTAB /end COMPU_METHOD
/begin COMPU_METHOD FORMULA_1055 "FORMULA_1055" TAB_VERB "%3.0" "-" COMPU_TAB_REF FORMULA_1055_VTAB /end COMPU_METHOD
/begin COMPU_METHOD FORMULA_1056 "FORMULA_1056" RAT_FUNC "%5.2" "min" COEFFS 0 60.0 0.0 0 0.0 1.0 /end COMPU_METHOD
/begin COMPU_METHOD FORMULA_1122 "FORMULA_1122" TAB_VERB "%3.0" "-" COMPU_TAB_REF FORMULA_1122_VTAB /end COMPU_METHOD
/begin COMPU_METHOD FORMULA_1123 "FORMULA_1123" TAB_VERB "%3.0" "-" COMPU_TAB_REF FORMULA_1123_VTAB /end COMPU_METHOD
/begin COMPU_METHOD FORMULA_1199 "FORMULA_1199" TAB_VERB "%3.0" "-" COMPU_TAB_REF FORMULA_1199_VTAB /end COMPU_METHOD
/begin COMPU_METHOD FORMULA_1200 "FORMULA_1200" RAT_FUNC "%3.0" "seg" COEFFS 0 0.5 0.0 0 0.0 1.0 /end COMPU_METHOD
/begin COMPU_METHOD FORMULA_1201 "FORMULA_1201" RAT_FUNC "%5.0" "°KW/s" COEFFS 0 1 0 0 0 1 /end COMPU_METHOD
/begin COMPU_METHOD FORMULA_1202 "FORMULA_1202" RAT_FUNC "%6.1" "Hz" COEFFS 0 0 1000000 0 1 0 /end COMPU_METHOD
/begin COMPU_METHOD FORMULA_1203 "FORMULA_1203" TAB_VERB "%5.2" "-" COMPU_TAB_REF FORMULA_1203_VTAB /end COMPU_METHOD
/begin COMPU_METHOD FORMULA_1204 "FORMULA_1204" TAB_VERB "%5.2" "-" COMPU_TAB_REF FORMULA_1204_VTAB /end COMPU_METHOD
/begin COMPU_METHOD FORMULA_1205 "FORMULA_1205" TAB_VERB "%5.2" "-" COMPU_TAB_REF FORMULA_1205_VTAB /end COMPU_METHOD
/begin COMPU_METHOD FORMULA_1206 "FORMULA_1206" RAT_FUNC "%6.1" "min" COEFFS 0 600.0 0.0 0 0.0 1.0 /end COMPU_METHOD
/begin COMPU_METHOD FORMULA_1207 "FORMULA_1207" RAT_FUNC "%5.0" "mA" COEFFS 0 1 0 0 0 1 /end COMPU_METHOD
/begin COMPU_METHOD FORMULA_1208 "FORMULA_1208" RAT_FUNC "%7.0" "mA" COEFFS 0 65536.0 0.0 0 0.0 1.0 /end COMPU_METHOD
/begin COMPU_METHOD FORMULA_1209 "FORMULA_1209" RAT_FUNC "%9.4" "mA*s/°KW" COEFFS 0 1024.0 0.0 0 0.0 1.0 /end COMPU_METHOD
/begin COMPU_METHOD FORMULA_1210 "FORMULA_1210" RAT_FUNC "%7.2" "mA/°KW*s" COEFFS 0 65.536 0.0 0 0.0 1.0 /end COMPU_METHOD
/begin COMPU_METHOD FORMULA_1211 "FORMULA_1211" RAT_FUNC "%7.2" "mA/°KW" COEFFS 0 25.6 0.0 0 0.0 1.0 /end COMPU_METHOD
/begin COMPU_METHOD FORMULA_1212 "FORMULA_1212" RAT_FUNC "%8.3" "Ohm" COEFFS 0 1000.0 0.0 0 0.0 1.0 /end COMPU_METHOD
/begin COMPU_METHOD FORMULA_1213 "FORMULA_1213" TAB_VERB "%5.2" "-" COMPU_TAB_REF FORMULA_1213_VTAB /end COMPU_METHOD
/begin COMPU_METHOD FORMULA_1214 "FORMULA_1214" RAT_FUNC "%6.1" "°KW/10ms" COEFFS 0 10.0 0.0 0 0.0 1.0 /end COMPU_METHOD
/begin COMPU_METHOD FORMULA_1215 "FORMULA_1215" TAB_VERB "%5.2" "-" COMPU_TAB_REF FORMULA_1215_VTAB /end COMPU_METHOD
/begin COMPU_METHOD FORMULA_1216 "FORMULA_1216" TAB_VERB "%5.2" "-" COMPU_TAB_REF FORMULA_1216_VTAB /end COMPU_METHOD
/begin COMPU_METHOD FORMULA_1217 "FORMULA_1217" TAB_VERB "%5.2" "-" COMPU_TAB_REF FORMULA_1217_VTAB /end COMPU_METHOD
/begin COMPU_METHOD FORMULA_1218 "FORMULA_1218" TAB_VERB "%5.2" "-" COMPU_TAB_REF FORMULA_1218_VTAB /end COMPU_METHOD
/begin COMPU_METHOD FORMULA_1219 "FORMULA_1219" RAT_FUNC "%5.0" "mA/10ms" COEFFS 0 1 0 0 0 1 /end COMPU_METHOD
/begin COMPU_METHOD FORMULA_1220 "FORMULA_1220" RAT_FUNC "%5.2" "s" COEFFS 0 0 164 0 1 0 /end COMPU_METHOD
/begin COMPU_METHOD FORMULA_1221 "FORMULA_1221" TAB_VERB "%5.2" "-" COMPU_TAB_REF FORMULA_1221_VTAB /end COMPU_METHOD
/begin COMPU_METHOD FORMULA_1222 "FORMULA_1222" TAB_VERB "%5.2" "-" COMPU_TAB_REF FORMULA_1222_VTAB /end COMPU_METHOD
/begin COMPU_METHOD FORMULA_1223 "FORMULA_1223" RAT_FUNC "%6.3" "Aend/Sampl" COEFFS 0 256.0 0.0 0 0.0 1.0 /end COMPU_METHOD
/begin COMPU_METHOD FORMULA_1224 "FORMULA_1224" RAT_FUNC "%3.0" "%" COEFFS 0 2.56 0.0 0 0.0 1.0 /end COMPU_METHOD
/begin COMPU_METHOD FORMULA_1225 "FORMULA_1225" TAB_VERB "%5.2" "-" COMPU_TAB_REF FORMULA_1225_VTAB /end COMPU_METHOD
/begin COMPU_METHOD FORMULA_1226 "FORMULA_1226" TAB_VERB "%5.2" "-" COMPU_TAB_REF FORMULA_1226_VTAB /end COMPU_METHOD
/begin COMPU_METHOD FORMULA_1227 "FORMULA_1227" TAB_VERB "%5.2" "-" COMPU_TAB_REF FORMULA_1227_VTAB /end COMPU_METHOD
/begin COMPU_METHOD FORMULA_1228 "FORMULA_1228" RAT_FUNC "%3.0" "KW_Zahn" COEFFS 0 1 0 0 0 1 /end COMPU_METHOD
/begin COMPU_METHOD FORMULA_1229 "FORMULA_1229" TAB_VERB "%3.0" "-" COMPU_TAB_REF FORMULA_1229_VTAB /end COMPU_METHOD
/begin COMPU_METHOD FORMULA_1230 "FORMULA_1230" RAT_FUNC "%3.0" "Zaehne/Asp" COEFFS 0 1 0 0 0 1 /end COMPU_METHOD
/begin COMPU_METHOD FORMULA_1231 "FORMULA_1231" RAT_FUNC "%7.2" "10exp-3" COEFFS 0 100.0 0.0 0 0.0 1.0 /end COMPU_METHOD
/begin COMPU_METHOD FORMULA_1232 "FORMULA_1232" TAB_VERB "%3.0" "-" COMPU_TAB_REF FORMULA_1232_VTAB /end COMPU_METHOD
/begin COMPU_METHOD FORMULA_1233 "FORMULA_1233" RAT_FUNC "%5.0" "mA/Zahn" COEFFS 0 1 0 0 0 1 /end COMPU_METHOD
/begin COMPU_METHOD FORMULA_1234 "FORMULA_1234" TAB_VERB "%3.0" "-" COMPU_TAB_REF FORMULA_1234_VTAB /end COMPU_METHOD
/begin COMPU_METHOD FORMULA_1235 "FORMULA_1235" RAT_FUNC "%6.1" "%" COEFFS 0 81.92 0.0 0 0.0 1.0 /end COMPU_METHOD
/begin COMPU_METHOD FORMULA_1236 "FORMULA_1236" TAB_VERB "%5.2" "-" COMPU_TAB_REF FORMULA_1236_VTAB /end COMPU_METHOD
/begin COMPU_METHOD FORMULA_1239 "FORMULA_1239" RAT_FUNC "%5.0" "Segm" COEFFS 0 1 0 0 0 1 /end COMPU_METHOD
/begin COMPU_METHOD FORMULA_1240 "FORMULA_1240" RAT_FUNC "%5.0" "ASP" COEFFS 0 1 0 0 0 1 /end COMPU_METHOD
/begin COMPU_METHOD FORMULA_1241 "FORMULA_1241" TAB_VERB "%5.2" "-" COMPU_TAB_REF FORMULA_1241_VTAB /end COMPU_METHOD
/begin COMPU_METHOD FORMULA_1242 "FORMULA_1242" TAB_VERB "%5.2" "-" COMPU_TAB_REF FORMULA_1242_VTAB /end COMPU_METHOD
/begin COMPU_METHOD FORMULA_1243 "FORMULA_1243" TAB_VERB "%5.2" "-" COMPU_TAB_REF FORMULA_1243_VTAB /end COMPU_METHOD
/begin COMPU_METHOD FORMULA_1244 "FORMULA_1244" RAT_FUNC "%7.2" "ms" COEFFS 0 1 0 0 0 1 /end COMPU_METHOD
/begin COMPU_METHOD FORMULA_ATP1 "FORMULA_ATP1" RAT_FUNC "%7.2" "°" COEFFS 0 91.0222066877656 0.0 0 0.0 1.0 /end COMPU_METHOD
/begin COMPU_METHOD FORMULA_ATP2 "FORMULA_ATP2" RAT_FUNC "%7.2" "ms" COEFFS 0 7000.0 0.0 0 0.0 1.0 /end COMPU_METHOD
/begin COMPU_METHOD FORMULA_ATP3 "FORMULA_ATP3" RAT_FUNC "%5.0" "-" COEFFS 0 1 0 0 0 1 /end COMPU_METHOD
/begin COMPU_METHOD FORMULA_DIO1 "FORMULA_DIO1" TAB_VERB "%5.0" "-" COMPU_TAB_REF FORMULA_DIO1_VTAB /end COMPU_METHOD
/begin COMPU_METHOD FORMULA_DIO2 "FORMULA_DIO2" RAT_FUNC "%5.0" "-" COEFFS 0 1 0 0 0 1 /end COMPU_METHOD
/begin COMPU_METHOD FORMULA_DIO3 "FORMULA_DIO3" RAT_FUNC "%7.2" "ms" COEFFS 0 7000.0 0.0 0 0.0 1.0 /end COMPU_METHOD
/begin COMPU_METHOD FORMULA_INJ1 "FORMULA_INJ1" RAT_FUNC "%7.2" "°" COEFFS 0 91.0222066877656 0.0 0 0.0 1.0 /end COMPU_METHOD
/begin COMPU_METHOD FORMULA_INJ10 "FORMULA_INJ10" RAT_FUNC "%9.2" "ms" COEFFS 0 7000.0 0.0 0 0.0 1.0 /end COMPU_METHOD
/begin COMPU_METHOD FORMULA_INJ11 "FORMULA_INJ11" RAT_FUNC "%9.2" "ms" COEFFS 0 27.34375 0.0 0 0.0 1.0 /end COMPU_METHOD
/begin COMPU_METHOD FORMULA_INJ2 "FORMULA_INJ2" RAT_FUNC "%7.2" "ms" COEFFS 0 7000.0 0.0 0 0.0 1.0 /end COMPU_METHOD
/begin COMPU_METHOD FORMULA_INJ3 "FORMULA_INJ3" RAT_FUNC "%9.2" "ms" COEFFS 0 1750.0 0.0 0 0.0 1.0 /end COMPU_METHOD
/begin COMPU_METHOD FORMULA_INJ5 "FORMULA_INJ5" RAT_FUNC "%5.0" "-" COEFFS 0 32768.0 0.0 0 0.0 1.0 /end COMPU_METHOD
/begin COMPU_METHOD FORMULA_INJ6 "FORMULA_INJ6" RAT_FUNC "%5.0" "-" COEFFS 0 16384.0 0.0 0 0.0 1.0 /end COMPU_METHOD
/begin COMPU_METHOD FORMULA_INJ7 "FORMULA_INJ7" RAT_FUNC "%5.0" "-" COEFFS 0 128.0 0.0 0 0.0 1.0 /end COMPU_METHOD
/begin COMPU_METHOD FORMULA_INJ8 "FORMULA_INJ8" RAT_FUNC "%5.0" "-" COEFFS 0 64.0 0.0 0 0.0 1.0 /end COMPU_METHOD
/begin COMPU_METHOD FORMULA_INJ9 "FORMULA_INJ9" RAT_FUNC "%9.2" "ms" COEFFS 0 27.34375 0.0 0 0.0 1.0 /end COMPU_METHOD
/begin COMPU_METHOD FORMULA_KW1 "FORMULA_KW1" RAT_FUNC "%5.0" "-" COEFFS 0 256.0 128.0 0 0.0 1.0 /end COMPU_METHOD
/begin COMPU_METHOD FORMULA_KW10 "FORMULA_KW10" RAT_FUNC "%7.2" "°" COEFFS 0 91.0222066877656 0.0 0 0.0 1.0 /end COMPU_METHOD
/begin COMPU_METHOD FORMULA_KW11 "FORMULA_KW11" RAT_FUNC "%7.2" "ms" COEFFS 0 7000.0 0.0 0 0.0 1.0 /end COMPU_METHOD
/begin COMPU_METHOD FORMULA_KW12 "FORMULA_KW12" RAT_FUNC "%9.2" "ms" COEFFS 0 27.34375 0.0 0 0.0 1.0 /end COMPU_METHOD
/begin COMPU_METHOD FORMULA_KW13 "FORMULA_KW13" RAT_FUNC "%12.2" "ms" COEFFS 0 840000.0 0.0 0 0.0 1.0 /end COMPU_METHOD
/begin COMPU_METHOD FORMULA_KW2 "FORMULA_KW2" RAT_FUNC "%5.0" "-" COEFFS 0 64.0 0.0 0 0.0 1.0 /end COMPU_METHOD
/begin COMPU_METHOD FORMULA_KW3 "FORMULA_KW3" TAB_VERB "%5.0" "-" COMPU_TAB_REF FORMULA_KW3_VTAB /end COMPU_METHOD
/begin COMPU_METHOD FORMULA_KW4 "FORMULA_KW4" RAT_FUNC "%5.0" "-" COEFFS 0 1 0 0 0 1 /end COMPU_METHOD
/begin COMPU_METHOD FORMULA_KW5 "FORMULA_KW5" RAT_FUNC "%5.0" "Upm" COEFFS 0 0 27344 0 1 0 /end COMPU_METHOD
/begin COMPU_METHOD FORMULA_KW6 "FORMULA_KW6" RAT_FUNC "%6.4" "°" COEFFS 0 23301.68888888889 0.0 0 0.0 1.0 /end COMPU_METHOD
/begin COMPU_METHOD FORMULA_KW8 "FORMULA_KW8" RAT_FUNC "%9.2" "ms" COEFFS 0 7000.0 0.0 0 0.0 1.0 /end COMPU_METHOD
/begin COMPU_METHOD FORMULA_KW9 "FORMULA_KW9" RAT_FUNC "%7.2" "ms" COEFFS 0 0.42724635452048 0.0 0 0.0 1.0 /end COMPU_METHOD
/begin COMPU_METHOD FORMULA_USER1 "FORMULA_USER1" RAT_FUNC "%7.0" "-" COEFFS 0 1 0 0 0 1 /end COMPU_METHOD
/begin COMPU_VTAB FORMULA_0200_VTAB "FORMULA_0200_VTAB" TAB_VERB 2 0 "nein" 1 "ja" /end COMPU_VTAB
/begin COMPU_VTAB FORMULA_0201_VTAB "FORMULA_0201_VTAB" TAB_VERB 2 0 "nein" 1 "ja" /end COMPU_VTAB
/begin COMPU_VTAB FORMULA_0202_VTAB "FORMULA_0202_VTAB" TAB_VERB 2 0 "nein" 1 "ja" /end COMPU_VTAB
/begin COMPU_VTAB FORMULA_0203_VTAB "FORMULA_0203_VTAB" TAB_VERB 2 0 "nein" 1 "ja" /end COMPU_VTAB
/begin COMPU_VTAB FORMULA_0204_VTAB "FORMULA_0204_VTAB" TAB_VERB 2 0 "nein" 1 "ja" /end COMPU_VTAB
/begin COMPU_VTAB FORMULA_0205_VTAB "FORMULA_0205_VTAB" TAB_VERB 2 0 "nein" 1 "ja" /end COMPU_VTAB
/begin COMPU_VTAB FORMULA_0206_VTAB "FORMULA_0206_VTAB" TAB_VERB 2 0 "nein" 1 "ja" /end COMPU_VTAB
/begin COMPU_VTAB FORMULA_0407_VTAB "FORMULA_0407_VTAB" TAB_VERB 5 0 "sync - 720° Mode" 1 "sync - 360° Mode" 129 "suche Luecke" 161 "Zahnentprellung laeuft" 225 "nicht sync." /end COMPU_VTAB
/begin COMPU_VTAB FORMULA_0409_VTAB "FORMULA_0409_VTAB" TAB_VERB 1 0 "Kein Interrupt." DEFAULT_VALUE "Mind. Einfachinterrupt." /end COMPU_VTAB
/begin COMPU_VTAB FORMULA_0410_VTAB "FORMULA_0410_VTAB" TAB_VERB 1 0 "nein." DEFAULT_VALUE "aktiv." /end COMPU_VTAB
/begin COMPU_VTAB FORMULA_0411_VTAB "FORMULA_0411_VTAB" TAB_VERB 1 0 "nein." DEFAULT_VALUE "aktiv." /end COMPU_VTAB
/begin COMPU_VTAB FORMULA_0412_VTAB "FORMULA_0412_VTAB" TAB_VERB 1 0 "nein." DEFAULT_VALUE "aktiv." /end COMPU_VTAB
/begin COMPU_VTAB FORMULA_0413_VTAB "FORMULA_0413_VTAB" TAB_VERB 1 0 "nein." DEFAULT_VALUE "aktiv." /end COMPU_VTAB
/begin COMPU_VTAB FORMULA_0414_VTAB "FORMULA_0414_VTAB" TAB_VERB 1 0 "nein." DEFAULT_VALUE "aktiv." /end COMPU_VTAB
/begin COMPU_VTAB FORMULA_0415_VTAB "FORMULA_0415_VTAB" TAB_VERB 1 0 "nein." DEFAULT_VALUE "aktiv." /end COMPU_VTAB
/begin COMPU_VTAB FORMULA_0416_VTAB "FORMULA_0416_VTAB" TAB_VERB 1 0 "nein." DEFAULT_VALUE "aktiv." /end COMPU_VTAB
/begin COMPU_VTAB FORMULA_0417_VTAB "FORMULA_0417_VTAB" TAB_VERB 1 0 "nein." DEFAULT_VALUE "aktiv." /end COMPU_VTAB
/begin COMPU_VTAB FORMULA_0419_VTAB "FORMULA_0419_VTAB" TAB_VERB 63 45 "-" 48 "0" 49 "1" 50 "2" 51 "3" 52 "4" 53 "5" 54 "6" 55 "7" 56 "8" 57 "9" 65 "A" 66 "B" 67 "C" 68 "D" 69 "E" 70 "F" 71 "G" 72 "H" 73 "I" 74 "J" 75 "K" 76 "L" 77 "M" 78 "N" 79 "O" 80 "P" 81 "Q" 82 "R" 83 "S" 84 "T" 85 "U" 86 "V" 87 "W" 88 "X" 89 "Y" 90 "Z" 97 "a" 98 "b" 99 "c" 100 "d" 101 "e" 102 "f" 103 "g" 104 "h" 105 "i" 106 "j" 107 "k" 108 "l" 109 "m" 110 "n" 111 "o" 112 "p" 113 "q" 114 "r" 115 "s" 116 "t" 117 "u" 118 "v" 119 "w" 120 "x" 121 "y" 122 "z" DEFAULT_VALUE "DEZ" /end COMPU_VTAB
/begin COMPU_VTAB FORMULA_0420_VTAB "FORMULA_0420_VTAB" TAB_VERB 29 0 "Labordaten" 1 "ZS-M-57" 2 "Master" 3 "Prerauer" 4 "Gerum" 5 "Heiss" 6 "Lutz" 7 "Maier" 8 "Menn" 9 "Neumann" 10 "Wilke" 11 "Scherer" 12 "Erdoedy" 13 "Fischer" 14 "May" 15 "ECE" 16 "US" 17 "Habermann" 18 "Moesbauer" 19 "Hartke" 20 "Renner" 21 "Stoll" 22 "Schaefer" 23 "Ast" 24 "Schloen" 25 "Biebl" 26 "Betz" 27 "NN2" 28 "NN2" DEFAULT_VALUE "unbekannt" /end COMPU_VTAB
/begin COMPU_VTAB FORMULA_0421_VTAB "FORMULA_0421_VTAB" TAB_VERB 6 177 "B1-Muster" 178 "B2-Muster" 179 "B3-Muster" 193 "C1-Muster" 194 "C2-Muster" 255 "ohne Kennung" /end COMPU_VTAB
/begin COMPU_VTAB FORMULA_0422_VTAB "FORMULA_0422_VTAB" TAB_VERB 2 1 "INJ" 2 "IGN" DEFAULT_VALUE "undefiniert" /end COMPU_VTAB
/begin COMPU_VTAB FORMULA_0630_VTAB "FORMULA_0630_VTAB" TAB_VERB 1 0 "AUS" DEFAULT_VALUE "EIN" /end COMPU_VTAB
/begin COMPU_VTAB FORMULA_0992_VTAB "FORMULA_0992_VTAB" TAB_VERB 2 0 "Schnellsync." 1 "sichere Sync." /end COMPU_VTAB
/begin COMPU_VTAB FORMULA_1049_VTAB "FORMULA_1049_VTAB" TAB_VERB 2 0 "nein" 1 "ja" DEFAULT_VALUE "undef" /end COMPU_VTAB
/begin COMPU_VTAB FORMULA_1054_VTAB "FORMULA_1054_VTAB" TAB_VERB 3 0 "pumg_obd aus" 1 "Modell kontinuierlich" 2 "Modell einmalig" DEFAULT_VALUE "undef" /end COMPU_VTAB
/begin COMPU_VTAB FORMULA_1055_VTAB "FORMULA_1055_VTAB" TAB_VERB 2 0 "nur via Modell" 1 "mit Zyklusvergleich" DEFAULT_VALUE "undef" /end COMPU_VTAB
/begin COMPU_VTAB FORMULA_1122_VTAB "FORMULA_1122_VTAB" TAB_VERB 2 0 "Modellierung" 255 "Initialisierung" /end COMPU_VTAB
/begin COMPU_VTAB FORMULA_1123_VTAB "FORMULA_1123_VTAB" TAB_VERB 4 0 "In tumg, Out tanzyl" 1 "In tumg, Out tan_mw" 2 "In tan_mw, Out tanzyl" 3 "In tan_mw, Out tan_mw" DEFAULT_VALUE "undefiniert" /end COMPU_VTAB
/begin COMPU_VTAB FORMULA_1199_VTAB "FORMULA_1199_VTAB" TAB_VERB 2 0 "Quelle ist Modell" 1 "Quelle ist tmot" DEFAULT_VALUE "undefiniert" /end COMPU_VTAB
/begin COMPU_VTAB FORMULA_1203_VTAB "FORMULA_1203_VTAB" TAB_VERB 38 0 "AUS" 1 "START" 2 "WAIT_LLR_HOCH" 3 "ANSCHL_MAX_E1" 4 "ANSCHL_MIN_E1" 5 "ANSCHL_MAX_A1" 6 "ANSCHL_MIN_A1" 7 "ANSCHL_MAX_E2" 8 "ANSCHL_MIN_E2" 9 "ANSCHL_MAX_A2" 10 "ANSCHL_MIN_A2" 11 "VERST_PRE_KLEIN_E1" 12 "VERST_KLEIN_E1" 13 "VERST_PRE_GROSS_E1" 14 "VERST_GROSS_E1" 15 "VERST_PRE_KLEIN_A1" 16 "VERST_KLEIN_A1" 17 "VERST_PRE_GROSS_A1" 18 "VERST_GROSS_A1" 19 "VERST_PRE_KLEIN_E2" 20 "VERST_KLEIN_E2" 21 "VERST_PRE_GROSS_E2" 22 "VERST_GROSS_E2" 23 "VERST_PRE_KLEIN_A2" 24 "VERST_KLEIN_A2" 25 "VERST_PRE_GROSS_A2" 26 "VERST_GROSS_A2" 27 "WAIT_LLR_NORM" 28 "MESS_GUETE" 29 "DSV1" 30 "DSV2" 31 "DSV3" 32 "DSV4" 33 "DSV5" 34 "DSV6" 35 "DSV7" 36 "DSV8" 37 "VAN_ABBRUCH" DEFAULT_VALUE "undef" /end COMPU_VTAB
/begin COMPU_VTAB FORMULA_1204_VTAB "FORMULA_1204_VTAB" TAB_VERB 2 0 "kein Druck" 1 "Druck" /end COMPU_VTAB
/begin COMPU_VTAB FORMULA_1205_VTAB "FORMULA_1205_VTAB" TAB_VERB 2 0 "aus" 1 "aktiv" /end COMPU_VTAB
/begin COMPU_VTAB FORMULA_1213_VTAB "FORMULA_1213_VTAB" TAB_VERB 2 0 "Kein Eingriff" 1 "SMG Schaltung" DEFAULT_VALUE "undef." /end COMPU_VTAB
/begin COMPU_VTAB FORMULA_1215_VTAB "FORMULA_1215_VTAB" TAB_VERB 1 3 "ja" DEFAULT_VALUE "nein" /end COMPU_VTAB
/begin COMPU_VTAB FORMULA_1216_VTAB "FORMULA_1216_VTAB" TAB_VERB 1 3 "ja" DEFAULT_VALUE "nein" /end COMPU_VTAB
/begin COMPU_VTAB FORMULA_1217_VTAB "FORMULA_1217_VTAB" TAB_VERB 2 0 "o.k" 1 "unplausibel" DEFAULT_VALUE "undef." /end COMPU_VTAB
/begin COMPU_VTAB FORMULA_1218_VTAB "FORMULA_1218_VTAB" TAB_VERB 3 0 "verriegelt" 1 "dyn begrenzt" 2 "frei" DEFAULT_VALUE "undef." /end COMPU_VTAB
/begin COMPU_VTAB FORMULA_1221_VTAB "FORMULA_1221_VTAB" TAB_VERB 3 0 "Flueg" 1 "Hochdr" 2 "MCS" DEFAULT_VALUE "undef." /end COMPU_VTAB
/begin COMPU_VTAB FORMULA_1222_VTAB "FORMULA_1222_VTAB" TAB_VERB 8 0 "lls+wdk+ti" 1 "lls+ti" 2 "wdk+ti" 3 "ti" 4 "lls+wdk" 5 "lls" 6 "wdk" 7 "ignore all" DEFAULT_VALUE "undef." /end COMPU_VTAB
/begin COMPU_VTAB FORMULA_1225_VTAB "FORMULA_1225_VTAB" TAB_VERB 2 0 "normal" 1 "ohne Ueberschwinger" DEFAULT_VALUE "undef." /end COMPU_VTAB
/begin COMPU_VTAB FORMULA_1226_VTAB "FORMULA_1226_VTAB" TAB_VERB 2 0 "Running" 1 "Reset" DEFAULT_VALUE "undef." /end COMPU_VTAB
/begin COMPU_VTAB FORMULA_1227_VTAB "FORMULA_1227_VTAB" TAB_VERB 2 0 "normal" 1 "invers" DEFAULT_VALUE "undef." /end COMPU_VTAB
/begin COMPU_VTAB FORMULA_1229_VTAB "FORMULA_1229_VTAB" TAB_VERB 2 0 "7Zahn(S54)" 1 "6Zahn" /end COMPU_VTAB
/begin COMPU_VTAB FORMULA_1232_VTAB "FORMULA_1232_VTAB" TAB_VERB 2 0 "dr_rel" 1 "md_rf_soll_pt" DEFAULT_VALUE "undef." /end COMPU_VTAB
/begin COMPU_VTAB FORMULA_1234_VTAB "FORMULA_1234_VTAB" TAB_VERB 8 0 "AUS" 1 "EIN_BEI_START" 2 "EIN_NACH_START" 3 "ABFALLEN_START" 4 "AUS_DRUCKERKENN" 5 "EIN_BEI_DRUCK" 6 "ABFALLEN_ABSTELL" 7 "KS_AUS" DEFAULT_VALUE "undef" /end COMPU_VTAB
/begin COMPU_VTAB FORMULA_1236_VTAB "FORMULA_1236_VTAB" TAB_VERB 2 0 "ohne DSV" 1 "mit DSV" DEFAULT_VALUE "undef." /end COMPU_VTAB
/begin COMPU_VTAB FORMULA_1241_VTAB "FORMULA_1241_VTAB" TAB_VERB 3 0 "PSAU" 1 "DR_REL" 2 "PSAU+DR_REL" /end COMPU_VTAB
/begin COMPU_VTAB FORMULA_1242_VTAB "FORMULA_1242_VTAB" TAB_VERB 2 1 "powerDown" 3 "powerDown hart" DEFAULT_VALUE "aus" /end COMPU_VTAB
/begin COMPU_VTAB FORMULA_1243_VTAB "FORMULA_1243_VTAB" TAB_VERB 3 0 "Inaktiv" 1 "Aktiv" 2 "Ist-Md" /end COMPU_VTAB
/begin COMPU_VTAB FORMULA_DIO1_VTAB "FORMULA_DIO1_VTAB" TAB_VERB 5 4 "in rising edge" 8 "in falling edge" 12 "in both edges" 225 "out pin high" 226 "out pin low" DEFAULT_VALUE "1 undefined" /end COMPU_VTAB
/begin COMPU_VTAB FORMULA_KW3_VTAB "FORMULA_KW3_VTAB" TAB_VERB 13 0 "ini" 1 "1st edge" 2 "second edge" 3 "wait teeth" 4 "search gap" 5 "1st missing required" 6 "last tooth until gap" 7 "1st missing tooth" 8 "2nd missing tooth" 9 "1st tooth after gap" 10 "2nd tooth after gap" 11 "tooth 2..56, 62..116" 12 "gap required" DEFAULT_VALUE "1 undefined" /end COMPU_VTAB
/begin FUNCTION TKS ""
 /begin DEF_CHARACTERISTIC K_TANZYL_CFG K_TANZYL_MR_TAU K_TKSM_CFG K_TKSM_MR_TAU KF_TANZYL_RATIO KL_TANZYL_ABREG KL_TANZYL_ML_GES_TAU KL_TANZYL_MR_ABREG KL_TANZYL_MR_TUMG_KAL KL_TKSM_ABREG KL_TKSM_MR_ABREG KL_TKSM_MR_TUMG_KAL KL_TKSM_Q_MOT_RATIO KL_TKSM_Q_MOT_TAU /end DEF_CHARACTERISTIC
 /begin OUT_MEASUREMENT tanzyl_abreg tanzyl_loc tanzyl_ml_ges_tau tanzyl_mr tanzyl_mr_abreg tanzyl_mr_off tanzyl_mr_stat tanzyl_mr_tumg_delta tanzyl_mr_tumg_kal tanzyl_ratio tanzyl_raw tanzyl_st tksm_abreg tksm_loc tksm_mr tksm_mr_abreg tksm_mr_off tksm_mr_stat tksm_mr_tumg_delta tksm_mr_tumg_kal tksm_q_mot_ratio tksm_q_mot_tau tksm_raw tksm_st /end OUT_MEASUREMENT
/end FUNCTION
/begin FUNCTION TPU ""
 /begin DEF_CHARACTERISTIC K_NW_CONFIG K_NW_IO K_NW_IO_ASP K_NW_MFMAX K_NW_MFMIN K_NW_NIO K_NW_NIO_INC K_NW_SYNC_ION_IO K_TPU_KW_N_MIN K_TPU_KW_SYNC_ZAHN /end DEF_CHARACTERISTIC
 /begin IN_MEASUREMENT tpu_a_htu tpu_a_kw_cnt_720 tpu_a_kw_cnt_cor tpu_a_kw_count tpu_a_kw_irq tpu_a_kw_irq_ack tpu_a_kw_irq_zahn tpu_a_kw_last_event_time tpu_a_kw_last_period_high tpu_a_kw_last_period_low tpu_a_kw_last_trans_time tpu_a_kw_link tpu_a_kw_max_teeth_unsync tpu_a_kw_next_segm_tooth tpu_a_kw_norm_period tpu_a_kw_prev_period tpu_a_kw_segm_length tpu_a_kw_segm_start tpu_a_kw_segm_zeit tpu_a_kw_state tpu_a_kw_time_out tpu_a_kw_wait_teeth tpu_atp_angle_etrig7 tpu_atp_cnt_etrig7 tpu_atp_period_etrig7 tpu_atp_time_etrig7 tpu_b_htu tpu_b_kw_cnt_720 tpu_b_kw_cnt_cor tpu_b_kw_count tpu_b_kw_irq tpu_b_kw_irq_ack tpu_b_kw_irq_zahn tpu_b_kw_last_event_time tpu_b_kw_last_period_high tpu_b_kw_last_period_low tpu_b_kw_last_trans_time tpu_b_kw_link tpu_b_kw_max_teeth_unsync tpu_b_kw_next_segm_tooth tpu_b_kw_norm_period tpu_b_kw_nw_lev tpu_b_kw_prev_period tpu_b_kw_segm_length tpu_b_kw_segm_start tpu_b_kw_segm_zeit tpu_b_kw_state tpu_b_kw_time_out tpu_b_kw_wait_teeth tpu_dio_config_kw_gap tpu_dio_irq_cnt_kw_gap tpu_dio_pin_level_kw_gap tpu_dio_pulse_time_kw_gap tpu_inj_copy_time_zyl1 tpu_inj_copy_time_zyl10 tpu_inj_copy_time_zyl2 tpu_inj_copy_time_zyl3 tpu_inj_copy_time_zyl4 tpu_inj_copy_time_zyl5 tpu_inj_copy_time_zyl6 tpu_inj_copy_time_zyl7 tpu_inj_copy_time_zyl8 tpu_inj_copy_time_zyl9 tpu_inj_demand_time_zyl1 tpu_inj_demand_time_zyl10 tpu_inj_demand_time_zyl2 tpu_inj_demand_time_zyl3 tpu_inj_demand_time_zyl4 tpu_inj_demand_time_zyl5 tpu_inj_demand_time_zyl6 tpu_inj_demand_time_zyl7 tpu_inj_demand_time_zyl8 tpu_inj_demand_time_zyl9 tpu_inj_end_angle_b1 tpu_inj_end_angle_b2 tpu_inj_end_angle_zyl1 tpu_inj_end_angle_zyl10 tpu_inj_end_angle_zyl2 tpu_inj_end_angle_zyl3 tpu_inj_end_angle_zyl4 tpu_inj_end_angle_zyl5 tpu_inj_end_angle_zyl6 tpu_inj_end_angle_zyl7 tpu_inj_end_angle_zyl8 tpu_inj_end_angle_zyl9 tpu_inj_first_zyl1 tpu_inj_first_zyl10 tpu_inj_first_zyl2 tpu_inj_first_zyl3 tpu_inj_first_zyl4 tpu_inj_first_zyl5 tpu_inj_first_zyl6 tpu_inj_first_zyl7 tpu_inj_first_zyl8 tpu_inj_first_zyl9 tpu_inj_main_zyl1 tpu_inj_main_zyl10 tpu_inj_main_zyl2 tpu_inj_main_zyl3 tpu_inj_main_zyl4 tpu_inj_main_zyl5 tpu_inj_main_zyl6 tpu_inj_main_zyl7 tpu_inj_main_zyl8 tpu_inj_main_zyl9 tpu_inj_min_off_time_b1 tpu_inj_min_off_time_b2 tpu_inj_min_off_zyl1 tpu_inj_min_off_zyl10 tpu_inj_min_off_zyl2 tpu_inj_min_off_zyl3 tpu_inj_min_off_zyl4 tpu_inj_min_off_zyl5 tpu_inj_min_off_zyl6 tpu_inj_min_off_zyl7 tpu_inj_min_off_zyl8 tpu_inj_min_off_zyl9 tpu_inj_min_time_b1 tpu_inj_min_time_b2 tpu_inj_miss_zyl1 tpu_inj_miss_zyl10 tpu_inj_miss_zyl2 tpu_inj_miss_zyl3 tpu_inj_miss_zyl4 tpu_inj_miss_zyl5 tpu_inj_miss_zyl6 tpu_inj_miss_zyl7 tpu_inj_miss_zyl8 tpu_inj_miss_zyl9 tpu_inj_offset_time_b1 tpu_inj_offset_time_b2 tpu_inj_out_time_high_zyl1 tpu_inj_out_time_high_zyl10 tpu_inj_out_time_high_zyl2 tpu_inj_out_time_high_zyl3 tpu_inj_out_time_high_zyl4 tpu_inj_out_time_high_zyl5 tpu_inj_out_time_high_zyl6 tpu_inj_out_time_high_zyl7 tpu_inj_out_time_high_zyl8 tpu_inj_out_time_high_zyl9 tpu_inj_out_time_low_zyl1 tpu_inj_out_time_low_zyl10 tpu_inj_out_time_low_zyl2 tpu_inj_out_time_low_zyl3 tpu_inj_out_time_low_zyl4 tpu_inj_out_time_low_zyl5 tpu_inj_out_time_low_zyl6 tpu_inj_out_time_low_zyl7 tpu_inj_out_time_low_zyl8 tpu_inj_out_time_low_zyl9 tpu_inj_phase_angle_b1 tpu_inj_phase_angle_b2 tpu_inj_start_time_high_zyl1 tpu_inj_start_time_high_zyl10 tpu_inj_start_time_high_zyl2 tpu_inj_start_time_high_zyl3 tpu_inj_start_time_high_zyl4 tpu_inj_start_time_high_zyl5 tpu_inj_start_time_high_zyl6 tpu_inj_start_time_high_zyl7 tpu_inj_start_time_high_zyl8 tpu_inj_start_time_high_zyl9 tpu_inj_start_time_low_zyl1 tpu_inj_start_time_low_zyl10 tpu_inj_start_time_low_zyl2 tpu_inj_start_time_low_zyl3 tpu_inj_start_time_low_zyl4 tpu_inj_start_time_low_zyl5 tpu_inj_start_time_low_zyl6 tpu_inj_start_time_low_zyl7 tpu_inj_start_time_low_zyl8 tpu_inj_start_time_low_zyl9 tpu_inj_tdc_angle_high_zyl1 tpu_inj_tdc_angle_high_zyl10 tpu_inj_tdc_angle_high_zyl2 tpu_inj_tdc_angle_high_zyl3 tpu_inj_tdc_angle_high_zyl4 tpu_inj_tdc_angle_high_zyl5 tpu_inj_tdc_angle_high_zyl6 tpu_inj_tdc_angle_high_zyl7 tpu_inj_tdc_angle_high_zyl8 tpu_inj_tdc_angle_high_zyl9 tpu_inj_tdc_angle_low_zyl1 tpu_inj_tdc_angle_low_zyl10 tpu_inj_tdc_angle_low_zyl2 tpu_inj_tdc_angle_low_zyl3 tpu_inj_tdc_angle_low_zyl4 tpu_inj_tdc_angle_low_zyl5 tpu_inj_tdc_angle_low_zyl6 tpu_inj_tdc_angle_low_zyl7 tpu_inj_tdc_angle_low_zyl8 tpu_inj_tdc_angle_low_zyl9 tpu_inj_temp_zyl1 tpu_inj_temp_zyl10 tpu_inj_temp_zyl2 tpu_inj_temp_zyl3 tpu_inj_temp_zyl4 tpu_inj_temp_zyl5 tpu_inj_temp_zyl6 tpu_inj_temp_zyl7 tpu_inj_temp_zyl8 tpu_inj_temp_zyl9 tpu_nw_kw_cnt_720_a1 tpu_nw_kw_cnt_720_a2 tpu_nw_kw_cnt_720_e1 tpu_nw_kw_cnt_720_e2 tpu_nw_kw_last_trans_time_a1 tpu_nw_kw_last_trans_time_a2 tpu_nw_kw_last_trans_time_e1 tpu_nw_kw_last_trans_time_e2 tpu_nw_kw_norm_period_a1 tpu_nw_kw_norm_period_a2 tpu_nw_kw_norm_period_e1 tpu_nw_kw_norm_period_e2 tpu_nw_last_trans_time_a1 tpu_nw_last_trans_time_a2 tpu_nw_last_trans_time_e1 tpu_nw_last_trans_time_e2 tpu_nw_pin_level_a1 tpu_nw_pin_level_a2 tpu_nw_pin_level_e1 tpu_nw_pin_level_e2 tpu_pwm_active_time_elue tpu_pwm_active_time_tev1 tpu_pwm_active_time_tev2 tpu_pwm_passive_time_elue tpu_pwm_passive_time_tev1 tpu_pwm_passive_time_tev2 tpu_pwm_period_elue tpu_pwm_period_tev1 tpu_pwm_period_tev2 /end IN_MEASUREMENT
 /begin OUT_MEASUREMENT tpu_a.CFSR01 tpu_a.CFSR23 tpu_a.CIER tpu_a.CISR tpu_a.CPR tpu_a.HSQR tpu_a.HSRR tpu_a.TICR tpu_a.TPUMCR tpu_a.TPUMCR2 tpu_a.TPUMCR3 tpu_a_pram tpu_b.CFSR01 tpu_b.CFSR23 tpu_b.CIER tpu_b.CISR tpu_b.CPR tpu_b.HSQR tpu_b.HSRR tpu_b.TICR tpu_b.TPUMCR tpu_b.TPUMCR2 tpu_b.TPUMCR3 tpu_b_pram tpu_bank tpu_code_status tpu_idx_a tpu_idx_b tpu_index tpu_kw_irq_a tpu_kw_irq_b tpu_kw_irq_cnt_a tpu_kw_irq_cnt_b tpu_kw_irq_error_a tpu_kw_irq_error_b tpu_kw_irq_info_a tpu_kw_irq_info_b tpu_kw_irq_mess_a tpu_kw_irq_mess_b tpu_kw_irq_n_min_a tpu_kw_irq_n_min_b tpu_kw_irq_pre_sync_a tpu_kw_irq_pre_sync_b tpu_kw_irq_segm_a tpu_kw_irq_segm_b tpu_kw_irq_segm_cnt_a tpu_kw_irq_segm_cnt_b tpu_kw_irq_sync_a tpu_kw_irq_sync_b tpu_kw_irq_tooth_a tpu_kw_irq_tooth_b tpu_kw_irq_tooth_cnt_a tpu_kw_irq_tooth_cnt_b tpu_kw_irq_zahn_a tpu_kw_irq_zahn_b tpu_kw_nw_sync_cnt_a tpu_kw_nw_sync_cnt_b tpu_kw_rot tpu_nw_pos_b1 tpu_nw_pos_b2 tpu_st_a tpu_st_b tpu_zyl tpu_zyl_bank tpu_zyl_p2 /end OUT_MEASUREMENT
/end FUNCTION
/begin FUNCTION TZ_DIAG "" /begin DEF_CHARACTERISTIC K_TZ_DIAG_MAX_BESTR /end DEF_CHARACTERISTIC
 /begin OUT_MEASUREMENT tz_diag_tr_ctr_zyl1 tz_diag_tr_ctr_zyl10 tz_diag_tr_ctr_zyl2 tz_diag_tr_ctr_zyl3 tz_diag_tr_ctr_zyl4 tz_diag_tr_ctr_zyl5 tz_diag_tr_ctr_zyl6 tz_diag_tr_ctr_zyl7 tz_diag_tr_ctr_zyl8 tz_diag_tr_ctr_zyl9 /end OUT_MEASUREMENT
/end FUNCTION
/begin FUNCTION Umgebungsdruck ""
 /begin DEF_CHARACTERISTIC K_PUMG_AEBEGR K_PUMG_DIAG_MAX K_PUMG_DIAG_MIN K_PUMG_ERSATZ K_PUMG_MAX_E2 K_PUMG_MAX_NEG_GRAD_E2 K_PUMG_MAX_POS_GRAD_E2 K_PUMG_MIN_E2 K_PUMG_OBD_ABW K_PUMG_OBD_CFG K_PUMG_OBD_FPLAU_ABW_MAX K_PUMG_OBD_FPLAU_ABW_MAX_T K_PUMG_OBD_MIN_MESS K_PUMG_OBD_ML_MS K_PUMG_OBD_MODEL_DELTA_MAX K_PUMG_OBD_N_MAX K_PUMG_OBD_N_MIN K_PUMG_OBD_PUMG_TAU K_PUMG_OBD_PWG_MIN K_PUMG_OBD_TAN_MAX K_PUMG_OBD_TAN_MIN K_PUMG_OBD_TIME_ML_MIN K_PUMG_OBD_TUMG_MIN K_PUMG_OBD_V_MAX K_PUMG_OBD_ZV_DELTA_MAX K_PUMG_RBM_HEILUNG_CFG K_PUMG_SENSOR_OFFSET K_PUMG_SENSOR_STEIGUNG K_PUMG_TAU KF_PUMG_OBD_P_STAU_KOMP KF_PUMG_OBD_RF_MAX_P400 KF_PUMG_OBD_RF_MAX_P500 /end DEF_CHARACTERISTIC
 /begin OUT_MEASUREMENT pumg_ad pumg_e2 pumg_obd_filter pumg_obd_fplau_abw_max_t pumg_obd_modell pumg_obd_modell_freigabe pumg_obd_modell_integral pumg_obd_modell_integral_cnt pumg_obd_modell_mw pumg_obd_rf pumg_roh /end OUT_MEASUREMENT
/end FUNCTION
/begin FUNCTION Vanos ""
 /begin DEF_CHARACTERISTIC K_VAN_ANSCHL_DELTA K_VAN_ANSCHL_HYS K_VAN_ANSCHL_I_A1 K_VAN_ANSCHL_I_A2 K_VAN_ANSCHL_I_E1 K_VAN_ANSCHL_I_E2 K_VAN_ANSCHL_I_RAMPE K_VAN_ANSCHL_I_START_MAX K_VAN_ANSCHL_T K_VAN_BEGR_AB_FAKT_E K_VAN_CFG_A1 K_VAN_CFG_A2 K_VAN_CFG_E1 K_VAN_CFG_E2 K_VAN_D_XD_TAU_Auslass K_VAN_D_XD_TAU_Einlass K_VAN_DRUCK_CNT K_VAN_DRUCK_SOLL_OFFSET_E K_VAN_DRUCK_VERSTELL_E K_VAN_DSV_ABFALL_DLY K_VAN_DSV_CFG K_VAN_DSV_N_AUS K_VAN_DSV_N_EIN K_VAN_DSV_PEAK_TIME K_VAN_ERR_CFG K_VAN_EXD_GUETE_TAU K_VAN_EXD_I_MAX_Auslass K_VAN_EXD_I_MAX_Einlass K_VAN_EXD_I_MIN_Auslass K_VAN_EXD_I_MIN_Einlass K_VAN_EXD_N_SOLL K_VAN_EXD_SPR_MAX_MIN_Auslass K_VAN_EXD_SPR_MAX_MIN_Einlass K_VAN_EXD_T_ANSCHL K_VAN_EXD_T_GUETE K_VAN_EXD_TMOT_MIN K_VAN_EXD_VERST_SOLL_MAX_Auslass K_VAN_EXD_VERST_SOLL_MAX_Einlass K_VAN_EXD_VERST_SOLL_MIN_Auslass K_VAN_EXD_VERST_SOLL_MIN_Einlass K_VAN_EXD_VERST_TMAX K_VAN_EXD_VERST_TOL K_VAN_EXD_VERST_TOL_START K_VAN_FILTR_AMPL K_VAN_FILTR_DAUER K_VAN_FILTR_PERIOD K_VAN_FILTR_SOLL_DELTA K_VAN_FILTR_T_ML_MIN K_VAN_FILTR_TV_PRUEF K_VAN_FREQU_ANSCHL K_VAN_FREQU_SPUEL_MIN K_VAN_FREQU_STAND K_VAN_FREQU_WICHT K_VAN_GUETE_CFG K_VAN_GUETE_DAUER K_VAN_GUETE_INIT K_VAN_GUETE_PAUSE K_VAN_GUETE_RESET K_VAN_GUETE_RESET_MIN K_VAN_GUETE_RESET_ZEIT K_VAN_GUETE_TAU K_VAN_GUETE_TMOT K_VAN_GUETE_TOEL K_VAN_I_I_MAX K_VAN_I_I_MIN K_VAN_I_MAX K_VAN_INVERT_A1 K_VAN_INVERT_A2 K_VAN_INVERT_E1 K_VAN_INVERT_E2 K_VAN_KP_XD_KORR_Auslass K_VAN_KP_XD_KORR_Einlass K_VAN_KW_SPR_MAX_A1 K_VAN_KW_SPR_MAX_A2 K_VAN_KW_SPR_MAX_E1 K_VAN_KW_SPR_MAX_E2 K_VAN_N_OFF K_VAN_N_OFFSET_MAX_A K_VAN_N_OFFSET_MIN_A K_VAN_N_ON K_VAN_R_TK K_VAN_R20 K_VAN_RAD_CFG K_VAN_RAD_MAX K_VAN_RAD_MIN K_VAN_SMG_DAUER_MAX K_VAN_SMG_DR_REL K_VAN_SMG_MD_ABBR K_VAN_SMG_MD_MIN K_VAN_SMG_N_ABBR K_VAN_SMG_N_MIN K_VAN_SMG_T_AUFREG K_VAN_SOLL_ABSTELL_Auslass K_VAN_SOLL_ABSTELL_Einlass K_VAN_SOLL_CFG K_VAN_SOLL_ERSATZ_Auslass K_VAN_SOLL_ERSATZ_Einlass K_VAN_SOLL_MAX_Auslass K_VAN_SOLL_MAX_Einlass K_VAN_SOLL_MIN_Auslass K_VAN_SOLL_MIN_Einlass K_VAN_SOLL_OFFSET_Auslass K_VAN_SOLL_OFFSET_Einlass K_VAN_SPR_MAX_Auslass K_VAN_SPR_MAX_Einlass K_VAN_SPR_MAX_TOL_Auslass K_VAN_SPR_MAX_TOL_Einlass K_VAN_SPR_MIN_Auslass K_VAN_SPR_MIN_Einlass K_VAN_SPR_OFFSET_A1 K_VAN_SPR_OFFSET_A2 K_VAN_SPR_OFFSET_E1 K_VAN_SPR_OFFSET_E2 K_VAN_START_I_MAX_AUSLASS K_VAN_SZ_Auslass K_VAN_SZ_Einlass K_VAN_TMOT_BEGR_E K_VAN_TV_MCS_A1 K_VAN_TV_MCS_A2 K_VAN_TV_MCS_E1 K_VAN_TV_MCS_E2 K_VAN_UB_ERS K_VAN_UNL_D_I_Auslass K_VAN_UNL_D_I_Einlass K_VAN_UNL_I_DYN_Auslass K_VAN_UNL_I_DYN_Einlass K_VAN_UNL_N_MIN_Auslass K_VAN_UNL_N_MIN_Einlass K_VAN_UNLOCK_SPR_Auslass K_VAN_UNLOCK_SPR_Einlass K_VAN_XD_EINGEREGELT K_VAN_XD_FILT_ED_Auslass K_VAN_XD_FILT_ED_Einlass K_VAN_XD_REG_MIN K_VAN_XD_SK KF_VAN_I_VORST_A KF_VAN_I_VORST_E KF_VAN_KH_SOLL_A KF_VAN_KH_SOLL_DMAX_A KF_VAN_KH_SOLL_DMAX_E KF_VAN_KH_SOLL_E KF_VAN_SOLL_A KF_VAN_SOLL_BEGR_A KF_VAN_SOLL_DMAX_A KF_VAN_SOLL_DMAX_E KF_VAN_SOLL_E KF_VAN_XD_TAU KL_VAN_DSV_HOLD_TV KL_VAN_DSV_PEAK_TV KL_VAN_FILTR_XD_WICHT KL_VAN_FREQU_ML KL_VAN_KD_A KL_VAN_KD_E KL_VAN_KI_A KL_VAN_KI_E KL_VAN_KP_A KL_VAN_KP_E KL_VAN_REG_FAKT_TMOT KL_VAN_SOLL_BEGR_E KL_VAN_SOLL_DMAX_WL_A KL_VAN_SOLL_DMAX_WL_E KL_VAN_T_DRUCK_E KL_VAN_T_SOLL_BEGR_E KL_VAN_T_START_DLY /end DEF_CHARACTERISTIC
 /begin OUT_MEASUREMENT B_VAN_ANSCHL_ANF_A1 B_VAN_ANSCHL_ANF_A2 B_VAN_ANSCHL_ANF_E1 B_VAN_ANSCHL_ANF_E2 B_VAN_ANSCHL_DC_A1 B_VAN_ANSCHL_DC_A2 B_VAN_ANSCHL_DC_E1 B_VAN_ANSCHL_DC_E2 B_VAN_DRUCK B_VAN_DRUCK_SPAET_A1 B_VAN_DRUCK_SPAET_A2 B_VAN_DRUCK_SPAET_E1 B_VAN_DRUCK_SPAET_E2 B_VAN_EINGER_A1 B_VAN_EINGER_A2 B_VAN_EINGER_BANK1 B_VAN_EINGER_BANK2 B_VAN_EINGER_E1 B_VAN_EINGER_E2 B_VAN_EXD_PRUEF_I_A1 B_VAN_EXD_PRUEF_I_A2 B_VAN_EXD_PRUEF_I_E1 B_VAN_EXD_PRUEF_I_E2 B_VAN_FILTR_A1 B_VAN_FILTR_A2 B_VAN_FILTR_E1 B_VAN_FILTR_E2 B_VAN_GUETE B_VAN_KS_AUS_A1 B_VAN_KS_AUS_A2 B_VAN_KS_AUS_E1 B_VAN_KS_AUS_E2 B_VAN_REG_FREI_A1 B_VAN_REG_FREI_A2 B_VAN_REG_FREI_E1 B_VAN_REG_FREI_E2 n_van_b1 n_van_b2 van_anschl_t_A1 van_anschl_t_A2 van_anschl_t_E1 van_anschl_t_E2 van_begr_faktor van_d_xd_A1 van_d_xd_A2 van_d_xd_E1 van_d_xd_E2 van_d_xd_filt_A1 van_d_xd_filt_A2 van_d_xd_filt_E1 van_d_xd_filt_E2 van_druck_cnt_b1 van_druck_cnt_b2 van_druck_start_e_b1 van_druck_start_e_b2 van_druck_time van_druck_timeout van_dsv_exd_st van_dsv_exd_timeout van_dsv_peak_time van_dsv_st van_dsv_timer van_dsv_tv van_exd_anschl_max_A1 van_exd_anschl_max_A2 van_exd_anschl_max_E1 van_exd_anschl_max_E2 van_exd_anschl_min_A1 van_exd_anschl_min_A2 van_exd_anschl_min_E1 van_exd_anschl_min_E2 van_exd_frequ_A1 van_exd_frequ_A2 van_exd_frequ_E1 van_exd_frequ_E2 van_exd_pruef van_exd_soll_A1 van_exd_soll_A2 van_exd_soll_E1 van_exd_soll_E2 van_exd_soll_timeout_A1 van_exd_soll_timeout_A2 van_exd_soll_timeout_E1 van_exd_soll_timeout_E2 van_exd_t van_exd_t_verst_gross_A1 van_exd_t_verst_gross_A2 van_exd_t_verst_gross_E1 van_exd_t_verst_gross_E2 van_exd_t_verst_klein_A1 van_exd_t_verst_klein_A2 van_exd_t_verst_klein_E1 van_exd_t_verst_klein_E2 van_exd_tv_A1 van_exd_tv_A2 van_exd_tv_E1 van_exd_tv_E2 van_exd_tv_timeout_A1 van_exd_tv_timeout_A2 van_exd_tv_timeout_E1 van_exd_tv_timeout_E2 van_filtr_dauer_A1 van_filtr_dauer_A2 van_filtr_dauer_E1 van_filtr_dauer_E2 van_filtr_fgen van_fitr_xd_wicht van_flags van_fpos_A1 van_fpos_A2 van_fpos_E1 van_fpos_E2 van_frequ_A1 van_frequ_A2 van_frequ_dyn_A1 van_frequ_dyn_A2 van_frequ_dyn_E1 van_frequ_dyn_E2 van_frequ_E1 van_frequ_E2 van_frequ_fakt_A1 van_frequ_fakt_A2 van_frequ_fakt_E1 van_frequ_fakt_E2 van_frequ_stat van_gpos_A1 van_gpos_A2 van_gpos_E1 van_gpos_E2 van_guete_dauer van_guete_pause van_guete_reset_zeit van_guete_roh_A1 van_guete_roh_A2 van_guete_roh_E1 van_guete_roh_E2 van_i_A1 van_i_A2 van_i_d_A1 van_i_d_A2 van_i_d_E1 van_i_d_E2 van_i_E1 van_i_E2 van_i_i_A1 van_i_i_A2 van_i_i_E1 van_i_i_E2 van_i_p_A1 van_i_p_A2 van_i_p_E1 van_i_p_E2 van_i_vorst_Auslass van_i_vorst_Einlass van_imp_cnt_A1 van_imp_cnt_A2 van_imp_cnt_E1 van_imp_cnt_E2 van_ist_kh_start_A1 van_ist_kh_start_A2 van_ist_kh_start_E1 van_ist_kh_start_E2 van_ist_oeff_A1 van_ist_oeff_A2 van_ist_oeff_E1 van_ist_oeff_E2 van_ist_schl_A1 van_ist_schl_A2 van_ist_schl_E1 van_ist_schl_E2 van_kd_Auslass van_kd_Einlass van_kh_soll_A1 van_kh_soll_A2 van_kh_soll_E1 van_kh_soll_E2 van_ki_A1 van_ki_A2 van_ki_E1 van_ki_E2 van_kp_Auslass van_kp_Einlass van_n_korr_a_b1 van_n_korr_a_b2 van_r van_reg_fakt_tmot van_smg_dauer van_smg_st van_soll_dmax_A1 van_soll_dmax_A2 van_soll_dmax_E1 van_soll_dmax_E2 van_soll_dmax_wl_Auslass van_soll_dmax_wl_Einlass van_soll_filtr_offs van_soll_old_A1 van_soll_old_A2 van_soll_old_E1 van_soll_old_E2 van_soll_stat_A1 van_soll_stat_A2 van_soll_stat_E1 van_soll_stat_E2 van_st_A1 van_st_A2 van_st_E1 van_st_E2 van_st_eingeregelt van_st_geber_A1 van_st_geber_A2 van_st_geber_E1 van_st_geber_E2 van_st_unlock_A1 van_st_unlock_A2 van_st_unlock_E1 van_st_unlock_E2 van_t_soll_begr van_t_start_dly van_tb_imp_A1 van_tb_imp_A2 van_tb_imp_E1 van_tb_imp_E2 van_tv_A1 van_tv_A2 van_tv_E1 van_tv_E2 van_vo_filt_b1 van_vo_filt_b2 van_xd_A1 van_xd_A2 van_xd_E1 van_xd_E2 van_xd_filt_A1 van_xd_filt_A2 van_xd_filt_E1 van_xd_filt_E2 van_xd_tau van_zahn_cnt_b1 van_zahn_cnt_b2 van_zahn_ctr5ms_b1 van_zahn_ctr5ms_b2 /end OUT_MEASUREMENT
/end FUNCTION
/begin FUNCTION Version ""
 /begin DEF_CHARACTERISTIC K_DATENKENNUNG_1 K_DATENKENNUNG_2 K_DATENKENNUNG_3 K_VERS_DATEN K_VERS_NAME K_VERS_PROG K_VERS_PROZ /end DEF_CHARACTERISTIC
 /begin OUT_MEASUREMENT vers_index vers_name vers_prog vers_sg /end OUT_MEASUREMENT
/end FUNCTION
/begin FUNCTION Wandfilm ""
 /begin DEF_CHARACTERISTIC K_WF_ASP_START K_WF_IST_PLAU_MAX K_WF_MKS_AUS_HYS K_WF_MKS_TI_CFG K_WF_SOLL_CFG K_WF_SOLL_START_PSAU K_WF_SOLL_START_PSAU_CFG KF_WF_ASP_NEG KF_WF_ASP_POS KF_WF_MKS_AKTIV_NEG KF_WF_MKS_AKTIV_POS KF_WF_MKS_BEGR_NEG KF_WF_MKS_BEGR_POS KF_WF_MKS_START_MAX KF_WF_OELV_ETA KF_WF_PSAU_WICHT KF_WF_SOLL_F_SA KF_WF_SOLL_F_VAN KF_WF_SOLL_GRUND KF_WF_SOLL_GRUND_DR_REL KL_WF_ASP_NEG_START KL_WF_ASP_POS_START KL_WF_DMKS_T1_MS KL_WF_MKS_BEGR_NEG_WICHT KL_WF_SOLL_F_LAM KL_WF_SOLL_F_PUMG KL_WF_SOLL_F_TI_PHI_ENDE /end DEF_CHARACTERISTIC
 /begin OUT_MEASUREMENT wf_asp_cnt wf_b1.soll wf_b1.soll_f_lam wf_b1.soll_f_ti wf_b1.soll_f_van wf_b1.soll_grund wf_b2.soll wf_b2.soll_f_lam wf_b2.soll_f_ti wf_b2.soll_f_van wf_b2.soll_grund wf_bank wf_dmks_t1 wf_ist_eta_zyl1 wf_ist_eta_zyl10 wf_ist_eta_zyl2 wf_ist_eta_zyl3 wf_ist_eta_zyl4 wf_ist_eta_zyl5 wf_ist_eta_zyl6 wf_ist_eta_zyl7 wf_ist_eta_zyl8 wf_ist_eta_zyl9 wf_ist_start_zyl1 wf_ist_start_zyl10 wf_ist_start_zyl2 wf_ist_start_zyl3 wf_ist_start_zyl4 wf_ist_start_zyl5 wf_ist_start_zyl6 wf_ist_start_zyl7 wf_ist_start_zyl8 wf_ist_start_zyl9 wf_lam_soll_offs_b1 wf_lam_soll_offs_b2 wf_mks_begr_neg_b1 wf_mks_begr_neg_b2 wf_mks_begr_pos_b1 wf_mks_begr_pos_b2 wf_mks_begr_zyl1 wf_mks_begr_zyl10 wf_mks_begr_zyl2 wf_mks_begr_zyl3 wf_mks_begr_zyl4 wf_mks_begr_zyl5 wf_mks_begr_zyl6 wf_mks_begr_zyl7 wf_mks_begr_zyl8 wf_mks_begr_zyl9 wf_mks_dif_zyl1 wf_mks_dif_zyl10 wf_mks_dif_zyl2 wf_mks_dif_zyl3 wf_mks_dif_zyl4 wf_mks_dif_zyl5 wf_mks_dif_zyl6 wf_mks_dif_zyl7 wf_mks_dif_zyl8 wf_mks_dif_zyl9 wf_mks_roh_zyl1 wf_mks_roh_zyl10 wf_mks_roh_zyl2 wf_mks_roh_zyl3 wf_mks_roh_zyl4 wf_mks_roh_zyl5 wf_mks_roh_zyl6 wf_mks_roh_zyl7 wf_mks_roh_zyl8 wf_mks_roh_zyl9 wf_mks_st wf_mks_start_max wf_mks_start_zyl1 wf_mks_start_zyl10 wf_mks_start_zyl2 wf_mks_start_zyl3 wf_mks_start_zyl4 wf_mks_start_zyl5 wf_mks_start_zyl6 wf_mks_start_zyl7 wf_mks_start_zyl8 wf_mks_start_zyl9 wf_mks_tau wf_mks_zyl_offs wf_mks_zyl1 wf_mks_zyl10 wf_mks_zyl2 wf_mks_zyl3 wf_mks_zyl4 wf_mks_zyl5 wf_mks_zyl6 wf_mks_zyl7 wf_mks_zyl8 wf_mks_zyl9 wf_oelv_eta_f wf_oelv_zyl1 wf_oelv_zyl10 wf_oelv_zyl2 wf_oelv_zyl3 wf_oelv_zyl4 wf_oelv_zyl5 wf_oelv_zyl6 wf_oelv_zyl7 wf_oelv_zyl8 wf_oelv_zyl9 wf_psau_b1 wf_psau_b2 wf_soll_f_pumg wf_start_seq_cnt wf_start_st wf_zyl_aktiv_st /end OUT_MEASUREMENT
/end FUNCTION
/begin FUNCTION Zustand ""
 /begin DEF_CHARACTERISTIC K_ZUST_MD_HYST_LL_TL K_ZUST_MD_HYST_TL_VL K_ZUST_MD_LL_TL K_ZUST_N_PS_LL K_ZUST_NL_TIMOUT_INJ K_ZUST_POWER K_ZUST_T_NL KL_ZUST_MD_TL_VL KL_ZUST_N_ST_LL /end DEF_CHARACTERISTIC
 /begin OUT_MEASUREMENT zust_exd_st /end OUT_MEASUREMENT
/end FUNCTION
/begin RECORD_LAYOUT TKF_SW_SW_SW FNC_VALUES 5 SWORD COLUMN_DIR DIRECT AXIS_PTS_X 3 SWORD INDEX_INCR DIRECT AXIS_PTS_Y 4 SWORD INDEX_INCR DIRECT NO_AXIS_PTS_X 1 UBYTE NO_AXIS_PTS_Y 2 UBYTE /end RECORD_LAYOUT
/begin RECORD_LAYOUT TKF_SW_SW_UW FNC_VALUES 5 UWORD COLUMN_DIR DIRECT AXIS_PTS_X 3 SWORD INDEX_INCR DIRECT AXIS_PTS_Y 4 SWORD INDEX_INCR DIRECT NO_AXIS_PTS_X 1 UBYTE NO_AXIS_PTS_Y 2 UBYTE /end RECORD_LAYOUT
/begin RECORD_LAYOUT TKL_SW_VV_SW FNC_VALUES 4 SWORD COLUMN_DIR DIRECT AXIS_PTS_X 3 SWORD INDEX_INCR DIRECT NO_AXIS_PTS_X 1 UBYTE RESERVED 2 BYTE /end RECORD_LAYOUT
/begin RECORD_LAYOUT TKL_SW_VV_UB FNC_VALUES 4 UBYTE COLUMN_DIR DIRECT AXIS_PTS_X 3 SWORD INDEX_INCR DIRECT NO_AXIS_PTS_X 1 UBYTE RESERVED 2 BYTE /end RECORD_LAYOUT
/begin RECORD_LAYOUT TKL_SW_VV_UW FNC_VALUES 4 UWORD COLUMN_DIR DIRECT AXIS_PTS_X 3 SWORD INDEX_INCR DIRECT NO_AXIS_PTS_X 1 UBYTE RESERVED 2 BYTE /end RECORD_LAYOUT
/begin RECORD_LAYOUT TKL_UW_VV_UW FNC_VALUES 4 UWORD COLUMN_DIR DIRECT AXIS_PTS_X 3 UWORD INDEX_INCR DIRECT NO_AXIS_PTS_X 1 UBYTE RESERVED 2 BYTE /end RECORD_LAYOUT
/begin RECORD_LAYOUT TKW_VV_VV_SB FNC_VALUES 1 SBYTE COLUMN_DIR DIRECT /end RECORD_LAYOUT
/begin RECORD_LAYOUT TKW_VV_VV_SW FNC_VALUES 1 SWORD COLUMN_DIR DIRECT /end RECORD_LAYOUT
/begin RECORD_LAYOUT TKW_VV_VV_UB FNC_VALUES 1 UBYTE COLUMN_DIR DIRECT /end RECORD_LAYOUT
/begin RECORD_LAYOUT TKW_VV_VV_UL FNC_VALUES 1 ULONG COLUMN_DIR DIRECT /end RECORD_LAYOUT
/begin RECORD_LAYOUT TKW_VV_VV_UW FNC_VALUES 1 UWORD COLUMN_DIR DIRECT /end RECORD_LAYOUT
/end MODULE
/end PROJECT
