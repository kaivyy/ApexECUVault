ASAP2_VERSION 1 31
/begin PROJECT MS45 "BMW Motorsteuerung R6"
/begin HEADER "_default_HeaderComment" PROJECT_NO _56 /end HEADER
/begin MODULE _default_ModuleName "_default_ModuleLongIdentifier"
/begin MOD_COMMON "_default_ModCommonComment" DEPOSIT ABSOLUTE BYTE_ORDER MSB_FIRST ALIGNMENT_BYTE 1 ALIGNMENT_WORD 2 ALIGNMENT_LONG 4 ALIGNMENT_FLOAT32_IEEE 4 ALIGNMENT_FLOAT64_IEEE 8 /end MOD_COMMON
/begin MEASUREMENT lv_state_rr "Boolean for state of rough road detection (No : Yes)." UBYTE _CNV_S_2_RANGE______0_CM 1 100. 0. 1. DISPLAY_IDENTIFIER LV_STATE_RR ECU_ADDRESS 0x3fe4d3 /end MEASUREMENT
/begin MEASUREMENT seg_t_mes_0_rr "Actual segment time measurement from the wheel speed signal." ULONG _CNV_A_R_LINEAR_____35_CM 1 100. 0. 4294967288. DISPLAY_IDENTIFIER SEG_T_MES_0_RR ECU_ADDRESS 0x3fcd14 BYTE_ORDER MSB_LAST FORMAT "%10.0" /end MEASUREMENT
/begin MEASUREMENT seg_t_mes_1_rr "Previous segment time measurement from the wheel speed signal." ULONG _CNV_A_R_LINEAR_____35_CM 1 100. 0. 4294967288. DISPLAY_IDENTIFIER SEG_T_MES_1_RR ECU_ADDRESS 0x3fcd18 BYTE_ORDER MSB_LAST FORMAT "%10.0" /end MEASUREMENT
/begin MEASUREMENT wheel_grd_mmv "Rough road value." UWORD _CNV_A_R_LINEAR_____36_CM 1 100. 0. 999.985 DISPLAY_IDENTIFIER WHEEL_GRD_MMV ECU_ADDRESS 0x3fd712 BYTE_ORDER MSB_LAST FORMAT "%6.2" /end MEASUREMENT
/begin MEASUREMENT wheel_grd_mmv_thd "Threshold for rough road value" UWORD _CNV_A_R_LINEAR_____36_CM 1 100. 0. 999.985 DISPLAY_IDENTIFIER WHEEL_GRD_MMV_THD ECU_ADDRESS 0x3fd714 BYTE_ORDER MSB_LAST FORMAT "%6.2" /end MEASUREMENT
/begin MEASUREMENT sum_rr "Counter of rough road detection events." UWORD _CNV_A_R_LINEAR_____1_CM 1 100. 0. 65535. DISPLAY_IDENTIFIER SUM_RR ECU_ADDRESS 0x3fd716 BYTE_ORDER MSB_LAST FORMAT "%5.0" /end MEASUREMENT
/begin CHARACTERISTIC c_vs_min_rr "Minimum vehicle speed for rough road detection." VALUE 0x0095c _REC_VAL_20_u1 255. _CNV_A_R_LINEAR_____1_CM 0. 255. DISPLAY_IDENTIFIER C_VS_MIN_RR FORMAT "%3.0" /end CHARACTERISTIC
/begin CHARACTERISTIC c_vs_max_rr "Maximum vehicle speed for rough road detection." VALUE 0x00953 _REC_VAL_20_u1 254. _CNV_A_R_LINEAR_____1_CM 1. 255. DISPLAY_IDENTIFIER C_VS_MAX_RR FORMAT "%3.0" /end CHARACTERISTIC
/begin CHARACTERISTIC c_wheel_grd_crlc_rr "Correlation factor for floating averaging of the rough road raw values" VALUE 0x01a58 _REC_VAL_20_u2 0.99998474 _CNV_A_R_LINEAR_____37_CM 0. 0.99998474 DISPLAY_IDENTIFIER C_WHEEL_GRD_CRLC_RR FORMAT "%7.5" /end CHARACTERISTIC
/begin CHARACTERISTIC c_dly_er_rr "Fade out time for engine roughness after rough road detection" VALUE 0x0152c _REC_VAL_20_u2 655350. _CNV_A_R_LINEAR_____31_CM 0. 655350. DISPLAY_IDENTIFIER C_DLY_ER_RR FORMAT "%6.0" /end CHARACTERISTIC
/begin CHARACTERISTIC ip_wheel_grd_mmv_thd_at__vs "Threshold versus vehicle speed for rough road detection, automatic tzransmission" CURVE 0x10826 _REC_CUR_20_u2_u1 255. _CNV_A_R_LINEAR_____38_CM 0. 255. DISPLAY_IDENTIFIER IP_WHEEL_GRD_MMV_THD_AT__VS FORMAT "%6.2"
 /begin AXIS_DESCR COM_AXIS vs _CNV_A_R_LINEAR_____23_CM 9 0. 255. FORMAT "%3.0" AXIS_PTS_REF ldpm_vs_wheel_grd_mmv_thd /end AXIS_DESCR
/end CHARACTERISTIC
/begin CHARACTERISTIC ip_wheel_grd_mmv_thd_mt__vs "Threshold versus vehicle speed for rough road detection, manual transmission" CURVE 0x10838 _REC_CUR_20_u2_u1 255. _CNV_A_R_LINEAR_____38_CM 0. 255. DISPLAY_IDENTIFIER IP_WHEEL_GRD_MMV_THD_MT__VS FORMAT "%6.2"
 /begin AXIS_DESCR COM_AXIS vs _CNV_A_R_LINEAR_____23_CM 9 0. 255. FORMAT "%3.0" AXIS_PTS_REF ldpm_vs_wheel_grd_mmv_thd /end AXIS_DESCR
/end CHARACTERISTIC
/begin AXIS_PTS ldpm_vs_wheel_grd_mmv_thd "" 0x082c6 vs _REC_AXS_20_u1 255. _CNV_A_R_LINEAR_____23_CM 9 0. 255. DISPLAY_IDENTIFIER LDPM_VS_WHEEL_GRD_MMV_THD FORMAT "%3.0" /end AXIS_PTS
/begin AXIS_PTS ldpm_n_2_cybl "" 0x118e2 n _REC_AXS_20_u2 8160. _CNV_A_R_LINEAR_____11_CM 6 0. 8160. DISPLAY_IDENTIFIER LDPM_N_2_CYBL FORMAT "%4.0" /end AXIS_PTS
/begin CHARACTERISTIC id_crlc_vls_down_t_dly "Correlation constant downstream signal" CURVE 0x0097a _REC_CUR_20_u1_u2 0.99610001 _CNV_A_R_LINEAR_____29_CM 0. 0.99610001 DISPLAY_IDENTIFIER ID_CRLC_VLS_DOWN_T_DLY FORMAT "%5.3"
 /begin AXIS_DESCR COM_AXIS maf_kgh _CNV_A_R_LINEAR_____113_CM 6 0. 2047.96875 FORMAT "%6.2" AXIS_PTS_REF ldp_maf_kgh__crlc_vls_down /end AXIS_DESCR
/end CHARACTERISTIC
/begin AXIS_PTS ldp_maf_kgh__crlc_vls_down "" 0x10cc4 maf_kgh _REC_AXS_20_u2 2047.96875 _CNV_A_R_LINEAR_____113_CM 6 0. 2047.96875 DISPLAY_IDENTIFIER LDP_MAF_KGH__CRLC_VLS_DOWN FORMAT "%6.2" /end AXIS_PTS
/begin MEASUREMENT lv_dui_inj_req "Double injection requested" UBYTE _CNV_S_2_RANGE______5_CM 1 100. 0. 1. DISPLAY_IDENTIFIER LV_DUI_INJ_REQ ECU_ADDRESS 0x3fe353 BIT_MASK 0x1 /end MEASUREMENT
/begin MEASUREMENT lv_ch_s_req "request bit to ask the comb.management for stratified combustion" UBYTE _CNV_S_2_RANGE______5_CM 1 100. 0. 1. DISPLAY_IDENTIFIER LV_CH_S_REQ ECU_ADDRESS 0x3fe354 BIT_MASK 0x1 /end MEASUREMENT
/begin MEASUREMENT lv_t_tqi_swi_supp "Request bit to suppress C_T_TQI_SWI for transition to Stratified mode" UBYTE _CNV_S_2_RANGE______5_CM 1 100. 0. 1. DISPLAY_IDENTIFIER LV_T_TQI_SWI_SUPP ECU_ADDRESS 0x3fe352 BIT_MASK 0x1 /end MEASUREMENT
/begin CHARACTERISTIC c_tco_dui_min_st "minimum temperature threshold for double injection" VALUE 0x00867 _REC_VAL_20_u1 190.5 _CNV_A_R_LINEAR_____12_CM -48. 142.5 DISPLAY_IDENTIFIER C_TCO_DUI_MIN_ST FORMAT "%5.1" /end CHARACTERISTIC
/begin CHARACTERISTIC c_tco_dui_max_st "maximum temperature threshold for double injection" VALUE 0x00866 _REC_VAL_20_u1 190.5 _CNV_A_R_LINEAR_____12_CM -48. 142.5 DISPLAY_IDENTIFIER C_TCO_DUI_MAX_ST FORMAT "%5.1" /end CHARACTERISTIC
/begin CHARACTERISTIC c_tqi_dui_thd "threshold for torque limitation for double injection" VALUE 0x004bc _REC_VAL_20_s2 2047.96875 _CNV_A_R_LINEAR_____55_CM -1024. 1023.96875 DISPLAY_IDENTIFIER C_TQI_DUI_THD FORMAT "%8.2" /end CHARACTERISTIC
/begin CHARACTERISTIC c_cyc_cast_dui_thd "threshold for cycle counter limitation for double injection" VALUE 0x01514 _REC_VAL_20_u2 65535. _CNV_A_R_LINEAR_____1_CM 0. 65535. DISPLAY_IDENTIFIER C_CYC_CAST_DUI_THD FORMAT "%5.0" /end CHARACTERISTIC
/begin MEASUREMENT state_clc_red "Calculation reduction state for runtime optimization" UBYTE _CNV_A_R_LINEAR_____1_CM 1 100. 0. 255. DISPLAY_IDENTIFIER STATE_CLC_RED ECU_ADDRESS 0x3fe34f FORMAT "%3.0" /end MEASUREMENT
/begin MEASUREMENT ctr_cyl_nr_clc "Number of cylinder to be calculated at current segment" UBYTE _CNV_A_R_LINEAR_____1_CM 1 100. 0. 255. DISPLAY_IDENTIFIER CTR_CYL_NR_CLC ECU_ADDRESS 0x3fe350 FORMAT "%3.0" /end MEASUREMENT
/begin MEASUREMENT ctr_cbk_nr_clc "number of cylinder bank to be calculated at current segment" UBYTE _CNV_A_R_LINEAR_____176_CM 1 100. 1. 2. DISPLAY_IDENTIFIER CTR_CBK_NR_CLC ECU_ADDRESS 0x3fe351 FORMAT "%2.0" /end MEASUREMENT
/begin AXIS_PTS ldp_seg_nr_id_ctr_cyl_nr_clc "Cylinder and segment relation for runtime reduction" 0x01128 seg_nr _REC_AXS_20_u1 7. _CNV_A_R_LINEAR_____1_CM 6 0. 7. DISPLAY_IDENTIFIER LDP_SEG_NR_ID_CTR_CYL_NR_CLC FORMAT "%3.0" /end AXIS_PTS
/begin CHARACTERISTIC id_ctr_cyl_nr_clc "Cylinder and segment relation for runtime reduction" CURVE 0x00980 _REC_CUR_20_u1_u1 7. _CNV_A_R_LINEAR_____1_CM 0. 7. DISPLAY_IDENTIFIER ID_CTR_CYL_NR_CLC FORMAT "%3.0"
 /begin AXIS_DESCR COM_AXIS seg_nr _CNV_A_R_LINEAR_____1_CM 6 0. 7. FORMAT "%3.0" AXIS_PTS_REF ldp_seg_nr_id_ctr_cyl_nr_clc /end AXIS_DESCR
/end CHARACTERISTIC
/begin CHARACTERISTIC c_seg_nr_st_clc_red "Start segment number for runtime reduction activation" VALUE 0x007b9 _REC_VAL_20_u1 7. _CNV_A_R_LINEAR_____1_CM 0. 7. DISPLAY_IDENTIFIER C_SEG_NR_ST_CLC_RED FORMAT "%3.0" /end CHARACTERISTIC
/begin CHARACTERISTIC c_n_32_thd_clc_red "Engine speed threshold for activation of runtime reduction" VALUE 0x00754 _REC_VAL_20_u1 8160. _CNV_A_R_LINEAR_____16_CM 0. 8160. DISPLAY_IDENTIFIER C_N_32_THD_CLC_RED FORMAT "%4.0" /end CHARACTERISTIC
/begin CHARACTERISTIC c_n_32_hys_clc_red "Engine speed hysteresis for activation of runtime reduction" VALUE 0x00751 _REC_VAL_20_u1 2016. _CNV_A_R_LINEAR_____16_CM 0. 2016. DISPLAY_IDENTIFIER C_N_32_HYS_CLC_RED FORMAT "%4.0" /end CHARACTERISTIC
/begin CHARACTERISTIC lc_clr_fmy "Boolean to clear failure memory when set to 1" VALUE 0x00f08 _REC_VAL_20_u1 1. _CNV_A_R_LINEAR_____1_CM 0. 1. DISPLAY_IDENTIFIER LC_CLR_FMY FORMAT "%2.0" /end CHARACTERISTIC
/begin MEASUREMENT ctr_err_dyn_nr "" UBYTE _CNV_A_R_LINEAR_____1_CM 1 100. 0. 255. DISPLAY_IDENTIFIER CTR_ERR_DYN_NR ECU_ADDRESS 0x3fb804 FORMAT "%3.0" /end MEASUREMENT
/begin CHARACTERISTIC c_ctr_max_wup_cyc "Initialization value for the warm-up cycle of diagnostics" VALUE 0x00672 _REC_VAL_20_u1 255. _CNV_A_R_LINEAR_____1_CM 0. 255. DISPLAY_IDENTIFIER C_CTR_MAX_WUP_CYC FORMAT "%3.0" /end CHARACTERISTIC
/begin CHARACTERISTIC lc_ena_scdn "Boolean to indicate iof similar conditions are inhibited (0) or (1)" VALUE 0x00f20 _REC_VAL_20_u1 1. _CNV_A_R_LINEAR_____1_CM 0. 1. DISPLAY_IDENTIFIER LC_ENA_SCDN FORMAT "%2.0" /end CHARACTERISTIC
/begin CHARACTERISTIC lc_clr_his_fmy "Clearing the history memory" VALUE 0x00f09 _REC_VAL_20_u1 1. _CNV_A_R_LINEAR_____1_CM 0. 1. DISPLAY_IDENTIFIER LC_CLR_HIS_FMY FORMAT "%2.0" /end CHARACTERISTIC
/begin MEASUREMENT ctr_err_his_nr "Number of failures in the history memory" UBYTE _CNV_A_R_LINEAR_____1_CM 1 100. 0. 255. DISPLAY_IDENTIFIER CTR_ERR_HIS_NR ECU_ADDRESS 0x3fbe54 FORMAT "%3.0" /end MEASUREMENT
/begin MEASUREMENT fmy_his_cod[0] "" UWORD _CNV_A_R_LINEAR_____1_CM 1 100. 0. 65535. DISPLAY_IDENTIFIER HIS_COD_1 ECU_ADDRESS 0x3fbde6 BYTE_ORDER MSB_LAST FORMAT "%5.0" /end MEASUREMENT
/begin MEASUREMENT fmy_his_cod[1] "" UWORD _CNV_A_R_LINEAR_____1_CM 1 100. 0. 65535. DISPLAY_IDENTIFIER HIS_COD_2 ECU_ADDRESS 0x3fbde8 BYTE_ORDER MSB_LAST FORMAT "%5.0" /end MEASUREMENT
/begin MEASUREMENT fmy_his_cod[2] "" UWORD _CNV_A_R_LINEAR_____1_CM 1 100. 0. 65535. DISPLAY_IDENTIFIER HIS_COD_3 ECU_ADDRESS 0x3fbdea BYTE_ORDER MSB_LAST FORMAT "%5.0" /end MEASUREMENT
/begin MEASUREMENT fmy_his_cod[3] "" UWORD _CNV_A_R_LINEAR_____1_CM 1 100. 0. 65535. DISPLAY_IDENTIFIER HIS_COD_4 ECU_ADDRESS 0x3fbdec BYTE_ORDER MSB_LAST FORMAT "%5.0" /end MEASUREMENT
/begin MEASUREMENT fmy_his_cod[4] "" UWORD _CNV_A_R_LINEAR_____1_CM 1 100. 0. 65535. DISPLAY_IDENTIFIER HIS_COD_5 ECU_ADDRESS 0x3fbdee BYTE_ORDER MSB_LAST FORMAT "%5.0" /end MEASUREMENT
/begin MEASUREMENT fmy_his_cod[5] "" UWORD _CNV_A_R_LINEAR_____1_CM 1 100. 0. 65535. DISPLAY_IDENTIFIER HIS_COD_6 ECU_ADDRESS 0x3fbdf0 BYTE_ORDER MSB_LAST FORMAT "%5.0" /end MEASUREMENT
/begin MEASUREMENT fmy_his_cod[6] "" UWORD _CNV_A_R_LINEAR_____1_CM 1 100. 0. 65535. DISPLAY_IDENTIFIER HIS_COD_7 ECU_ADDRESS 0x3fbdf2 BYTE_ORDER MSB_LAST FORMAT "%5.0" /end MEASUREMENT
/begin MEASUREMENT fmy_his_cod[7] "" UWORD _CNV_A_R_LINEAR_____1_CM 1 100. 0. 65535. DISPLAY_IDENTIFIER HIS_COD_8 ECU_ADDRESS 0x3fbdf4 BYTE_ORDER MSB_LAST FORMAT "%5.0" /end MEASUREMENT
/begin MEASUREMENT fmy_his_cod[8] "" UWORD _CNV_A_R_LINEAR_____1_CM 1 100. 0. 65535. DISPLAY_IDENTIFIER HIS_COD_9 ECU_ADDRESS 0x3fbdf6 BYTE_ORDER MSB_LAST FORMAT "%5.0" /end MEASUREMENT
/begin MEASUREMENT fmy_his_cod[9] "" UWORD _CNV_A_R_LINEAR_____1_CM 1 100. 0. 65535. DISPLAY_IDENTIFIER HIS_COD_10 ECU_ADDRESS 0x3fbdf8 BYTE_ORDER MSB_LAST FORMAT "%5.0" /end MEASUREMENT
/begin MEASUREMENT rel_dist_act_mil "" ULONG _CNV_A_R_LINEAR_____17_CM 1 100. 0. 429496729500. DISPLAY_IDENTIFIER REL_DIST_ACT_MIL ECU_ADDRESS 0x3fbe60 BYTE_ORDER MSB_LAST FORMAT "%13.0" /end MEASUREMENT
/begin MEASUREMENT state_mil "" UBYTE _CNV_S_3_RANGE_STAT_193_CM 1 100. 0. 2. DISPLAY_IDENTIFIER STATE_MIL ECU_ADDRESS 0x3fbc23 /end MEASUREMENT
/begin MEASUREMENT rel_dist_act_wal_1 "" ULONG _CNV_A_R_LINEAR_____17_CM 1 100. 0. 429496729500. DISPLAY_IDENTIFIER REL_DIST_ACT_WAL_1 ECU_ADDRESS 0x3fbe6c BYTE_ORDER MSB_LAST FORMAT "%13.0" /end MEASUREMENT
/begin MEASUREMENT rel_dist_act_wal_2 "" ULONG _CNV_A_R_LINEAR_____17_CM 1 100. 0. 429496729500. DISPLAY_IDENTIFIER REL_DIST_ACT_WAL_2 ECU_ADDRESS 0x3fbe78 BYTE_ORDER MSB_LAST FORMAT "%13.0" /end MEASUREMENT
/begin MEASUREMENT lv_wal_2 "" UBYTE _CNV_S_2_RANGE______194_R_CM 1 100. 0. 255. DISPLAY_IDENTIFIER LV_WAL_2 ECU_ADDRESS 0x3fbc26 /end MEASUREMENT
/begin MEASUREMENT state_wal_1 "" UBYTE _CNV_S_3_RANGE_STAT_193_CM 1 100. 0. 2. DISPLAY_IDENTIFIER STATE_WAL_1 ECU_ADDRESS 0x3fbc25 /end MEASUREMENT
/begin MEASUREMENT state_wal_2 "" UBYTE _CNV_S_3_RANGE_STAT_193_CM 1 100. 0. 2. DISPLAY_IDENTIFIER STATE_WAL_2 ECU_ADDRESS 0x3fbc27 /end MEASUREMENT
/begin MEASUREMENT dist_act_wal_2 "" ULONG _CNV_A_R_LINEAR_____17_CM 1 100. 0. 429496729500. DISPLAY_IDENTIFIER DIST_ACT_WAL_2 ECU_ADDRESS 0x3fbe74 BYTE_ORDER MSB_LAST FORMAT "%13.0" /end MEASUREMENT
/begin MEASUREMENT dist_act_wal_1 "" ULONG _CNV_A_R_LINEAR_____17_CM 1 100. 0. 429496729500. DISPLAY_IDENTIFIER DIST_ACT_WAL_1 ECU_ADDRESS 0x3fbe68 BYTE_ORDER MSB_LAST FORMAT "%13.0" /end MEASUREMENT
/begin CHARACTERISTIC c_conf_mil "" VALUE 0x0060c _REC_VAL_20_u1 7. _CNV_A_R_LINEAR_____1_CM 0. 7. DISPLAY_IDENTIFIER C_CONF_MIL FORMAT "%1.0" /end CHARACTERISTIC
/begin CHARACTERISTIC c_conf_wal_1 "" VALUE 0x0060f _REC_VAL_20_u1 7. _CNV_A_R_LINEAR_____1_CM 0. 7. DISPLAY_IDENTIFIER C_CONF_WAL_1 FORMAT "%1.0" /end CHARACTERISTIC
/begin CHARACTERISTIC c_conf_wal_2 "" VALUE 0x00610 _REC_VAL_20_u1 7. _CNV_A_R_LINEAR_____1_CM 0. 7. DISPLAY_IDENTIFIER C_CONF_WAL_2 FORMAT "%1.0" /end CHARACTERISTIC
/begin CHARACTERISTIC lc_inh_wal_st "" VALUE 0x00f45 _REC_VAL_20_u1 1. _CNV_A_R_LINEAR_____1_CM 0. 1. DISPLAY_IDENTIFIER LC_INH_WAL_ST FORMAT "%2.0" /end CHARACTERISTIC
/begin MEASUREMENT dist_act_mil "" ULONG _CNV_A_R_LINEAR_____17_CM 1 100. 0. 429496729500. DISPLAY_IDENTIFIER DIST_ACT_MIL ECU_ADDRESS 0x3fbe5c BYTE_ORDER MSB_LAST FORMAT "%13.0" /end MEASUREMENT
/begin CHARACTERISTIC c_dly_wal_st "" VALUE 0x006aa _REC_VAL_20_u1 255. _CNV_A_R_LINEAR_____195_CM 0. 255. DISPLAY_IDENTIFIER C_DLY_WAL_ST FORMAT "%3.0" /end CHARACTERISTIC
/begin CHARACTERISTIC c_dly_inh_iv_mis "Delay for MIL blinking in case of misfiring present failure with cylinder cut off" VALUE 0x006a8 _REC_VAL_20_u1 255. _CNV_A_R_LINEAR_____195_CM 0. 255. DISPLAY_IDENTIFIER C_DLY_INH_IV_MIS FORMAT "%3.0" /end CHARACTERISTIC
/begin MEASUREMENT lv_mil "" UBYTE _CNV_S_2_RANGE______194_R_CM 1 100. 0. 255. DISPLAY_IDENTIFIER LV_MIL ECU_ADDRESS 0x3fbc22 /end MEASUREMENT
/begin MEASUREMENT lv_wal_1 "" UBYTE _CNV_S_2_RANGE______194_R_CM 1 100. 0. 255. DISPLAY_IDENTIFIER LV_WAL_1 ECU_ADDRESS 0x3fbc24 /end MEASUREMENT
/begin MEASUREMENT lv_wal_st "Boolean indicating Pre-drive check mode (0 : off / 1 : on)" UBYTE _CNV_S_2_RANGE______0_CM 1 100. 0. 1. DISPLAY_IDENTIFIER LV_WAL_ST ECU_ADDRESS 0x3fbc28 /end MEASUREMENT
/begin CHARACTERISTIC c_ctr_scdn_equ_dc_max "" VALUE 0x00674 _REC_VAL_20_u1 255. _CNV_A_R_LINEAR_____1_CM 0. 255. DISPLAY_IDENTIFIER C_CTR_SCDN_EQU_DC_MAX FORMAT "%3.0" /end CHARACTERISTIC
/begin CHARACTERISTIC c_n_scdn_equ "" VALUE 0x01710 _REC_VAL_20_u2 8160. _CNV_A_R_LINEAR_____11_CM 0. 8160. DISPLAY_IDENTIFIER C_N_SCDN_EQU FORMAT "%4.0" /end CHARACTERISTIC
/begin CHARACTERISTIC c_load_scdn_equ "engine spped threshold for similar condirions detection (375 rpm)" VALUE 0x0071f _REC_VAL_20_u1 99.609375 _CNV_A_R_LINEAR_____10_CM 0. 99.609375 DISPLAY_IDENTIFIER C_LOAD_SCDN_EQU FORMAT "%4.1" /end CHARACTERISTIC
/begin CHARACTERISTIC c_t_ramp_lim_i_dt_is "Time constant for ramp limit of I-controller output in case of idle speed controller passive and drive train engaged" VALUE 0x01890 _REC_VAL_20_u2 1310.7 _CNV_A_R_LINEAR_____197_CM 0. 1310.7 DISPLAY_IDENTIFIER C_T_RAMP_LIM_I_DT_IS FORMAT "%7.2" /end CHARACTERISTIC
/begin CHARACTERISTIC c_t_ramp_lim_p_d_dt_is "Time constant for ramp limit of P-, D-controller output in case of idle speed controller passive and LV_DT=1" VALUE 0x01894 _REC_VAL_20_u2 655.35 _CNV_A_R_LINEAR_____4_CM 0. 655.35 DISPLAY_IDENTIFIER C_T_RAMP_LIM_P_D_DT_IS FORMAT "%5.2" /end CHARACTERISTIC
/begin CHARACTERISTIC c_t_ramp_lim_p_d_is "Time constant for ramp limit of P-, D-controller output in case of idle speed controller passive" VALUE 0x01896 _REC_VAL_20_u2 655.35 _CNV_A_R_LINEAR_____4_CM 0. 655.35 DISPLAY_IDENTIFIER C_T_RAMP_LIM_P_D_IS FORMAT "%5.2" /end CHARACTERISTIC
/begin CHARACTERISTIC c_tq_bol_i_dt_is "Bottom limit for I-controller output and drive train closed" VALUE 0x0047e _REC_VAL_20_s2 2047.96875 _CNV_A_R_LINEAR_____55_CM -1024. 1023.96875 DISPLAY_IDENTIFIER C_TQ_BOL_I_DT_IS FORMAT "%7.1" /end CHARACTERISTIC
/begin CHARACTERISTIC c_tq_bol_i_is "Bottom limit for I-controller output" VALUE 0x00480 _REC_VAL_20_s2 2047.96875 _CNV_A_R_LINEAR_____55_CM -1024. 1023.96875 DISPLAY_IDENTIFIER C_TQ_BOL_I_IS FORMAT "%7.1" /end CHARACTERISTIC
/begin CHARACTERISTIC c_tq_tol_i_dt_is "Top limit for I-controller output and drive train closed" VALUE 0x004ac _REC_VAL_20_s2 2047.96875 _CNV_A_R_LINEAR_____55_CM -1024. 1023.96875 DISPLAY_IDENTIFIER C_TQ_TOL_I_DT_IS FORMAT "%7.1" /end CHARACTERISTIC
/begin CHARACTERISTIC c_tq_tol_i_is "Top limit for I-controller output" VALUE 0x004ae _REC_VAL_20_s2 2047.96875 _CNV_A_R_LINEAR_____55_CM -1024. 1023.96875 DISPLAY_IDENTIFIER C_TQ_TOL_I_IS FORMAT "%7.1" /end CHARACTERISTIC
/begin CHARACTERISTIC ip_tq_i_dt_is "I-component for idle speed controller at closed drive train" CURVE 0x0fb3a _REC_CUR_20_u2_u2 7.99987793 _CNV_A_R_LINEAR_____211_CM -4. 3.99987793 DISPLAY_IDENTIFIER IP_TQ_I_DT_IS FORMAT "%6.5"
 /begin AXIS_DESCR COM_AXIS n_dif_cor _CNV_A_R_LINEAR_____206_CM 12 -32768. 32767. FORMAT "%6.0" AXIS_PTS_REF ldp_n_dif_cor__tq_i_dt_is /end AXIS_DESCR
/end CHARACTERISTIC
/begin MEASUREMENT tq_dif_p_d_fast_is "TQ_DIF_P_D_IS for fast-path of torque coordination" SWORD _CNV_A_R_LINEAR_____55_CM 1 100. -1024. 1023.96875 DISPLAY_IDENTIFIER TQ_DIF_P_D_FAST_IS ECU_ADDRESS 0x3fd5be BYTE_ORDER MSB_LAST FORMAT "%6.2" /end MEASUREMENT
/begin MEASUREMENT tq_dif_i_is "I- controller output for idle speed control" SWORD _CNV_A_R_LINEAR_____55_CM 1 100. -1024. 1023.96875 DISPLAY_IDENTIFIER TQ_DIF_I_IS ECU_ADDRESS 0x3fd5bc BYTE_ORDER MSB_LAST FORMAT "%6.2" /end MEASUREMENT
/begin MEASUREMENT tq_add_i_is "Incrememt of limited integrator" SWORD _CNV_A_R_LINEAR_____212_CM 1 100. -4. 3.99987793 DISPLAY_IDENTIFIER TQ_ADD_I_IS ECU_ADDRESS 0x3fd5c6 BYTE_ORDER MSB_LAST FORMAT "%7.4" /end MEASUREMENT
/begin CHARACTERISTIC lc_tq_dif_i_inh_as "Logical variable for ISCI I-part deactivation - default value at initialisation = 0" VALUE 0x00f80 _REC_VAL_20_u1 1. _CNV_A_R_LINEAR_____22_CM 0. 1. DISPLAY_IDENTIFIER LC_TQ_DIF_I_INH_AS FORMAT "%1.0" /end CHARACTERISTIC
/begin CHARACTERISTIC lc_tq_dif_p_d_inh_as "Logical variable for deactivation of TQ_DIF_P_D_IS -default value at initialisation = 0" VALUE 0x00f81 _REC_VAL_20_u1 1. _CNV_A_R_LINEAR_____22_CM 0. 1. DISPLAY_IDENTIFIER LC_TQ_DIF_P_D_INH_AS FORMAT "%1.0" /end CHARACTERISTIC
/begin MEASUREMENT n_grd_fil_is "Filtered engine speed gradient for ISC" SBYTE _CNV_A_R_LINEAR_____51_CM 1 100. -4096. 4064. DISPLAY_IDENTIFIER N_GRD_FIL_IS ECU_ADDRESS 0x3fe392 FORMAT "%4.0" /end MEASUREMENT
/begin MEASUREMENT n_grd_p_d_is "Filtered gradient for PD-part" SBYTE _CNV_A_R_LINEAR_____51_CM 1 100. -4096. 4064. DISPLAY_IDENTIFIER N_GRD_P_D_IS ECU_ADDRESS 0x3fe391 FORMAT "%5.0" /end MEASUREMENT
/begin MEASUREMENT n_grd_i_is "Filtered gradient for I-part" SBYTE _CNV_A_R_LINEAR_____51_CM 1 100. -4096. 4064. DISPLAY_IDENTIFIER N_GRD_I_IS ECU_ADDRESS 0x3fe390 FORMAT "%5.0" /end MEASUREMENT
/begin CHARACTERISTIC ip_fac_p_d_fast_tco_is "TCO depending factor foe fast-path of torque coordination" CURVE 0x0ad5a _REC_CUR_20_u2_u1 1.99996948 _CNV_A_R_LINEAR_____21_CM 0. 1.99996948 DISPLAY_IDENTIFIER IP_FAC_P_D_FAST_TCO_IS FORMAT "%7.5"
 /begin AXIS_DESCR COM_AXIS tco _CNV_A_R_LINEAR_____12_CM 8 -48. 142.5 FORMAT "%5.1" AXIS_PTS_REF ldpm_tco_is_1 /end AXIS_DESCR
/end CHARACTERISTIC
/begin CHARACTERISTIC ip_fac_p_d_slow_tco_is "TCO depending factor foe slow-path of torque coordination" CURVE 0x0ad6a _REC_CUR_20_u2_u1 1.99996948 _CNV_A_R_LINEAR_____21_CM 0. 1.99996948 DISPLAY_IDENTIFIER IP_FAC_P_D_SLOW_TCO_IS FORMAT "%7.5"
 /begin AXIS_DESCR COM_AXIS tco _CNV_A_R_LINEAR_____12_CM 8 -48. 142.5 FORMAT "%5.1" AXIS_PTS_REF ldpm_tco_is_1 /end AXIS_DESCR
/end CHARACTERISTIC
/begin MEASUREMENT lv_pas_ramp_act_p_d_is "Logical value for PD-part passive ramp active" UBYTE _CNV_S_2_RANGE______0_CM 1 100. 0. 1. DISPLAY_IDENTIFIER LV_PAS_RAMP_ACT_P_D_IS ECU_ADDRESS 0x3fe38b /end MEASUREMENT
/begin MEASUREMENT lv_pas_ramp_act_i_is "Logical value for I-part passive ramp active" UBYTE _CNV_S_2_RANGE______0_CM 1 100. 0. 1. DISPLAY_IDENTIFIER LV_PAS_RAMP_ACT_I_IS ECU_ADDRESS 0x3fe38a /end MEASUREMENT
/begin MEASUREMENT tq_add_i_ramp "Increment of the I-part ramps" SWORD _CNV_A_R_LINEAR_____55_CM 1 100. -1024. 1023.96875 DISPLAY_IDENTIFIER TQ_ADD_I_RAMP ECU_ADDRESS 0x3fd5c8 BYTE_ORDER MSB_LAST FORMAT "%6.2" /end MEASUREMENT
/begin MEASUREMENT state_p_d_isc "State of the PD-part: P_D_PASSIVE, P_D_NORMAL, RAMP_TO_ZERO" UBYTE _CNV_S_3_STATE_P_D__213_CM 1 100. 0. 2. DISPLAY_IDENTIFIER STATE_P_D_ISC ECU_ADDRESS 0x3fe38c /end MEASUREMENT
/begin MEASUREMENT state_i_isc "State of the integral part: I_PASSIVE, I_NORMAL, RAMP_TO_PAS, RAMP_TO_LIM" UBYTE _CNV_S_4_STATE_I_IS_214_CM 1 100. 0. 3. DISPLAY_IDENTIFIER STATE_I_ISC ECU_ADDRESS 0x3fe38f /end MEASUREMENT
/begin CHARACTERISTIC ip_tq_i_is "I-component for idle speed controller at open drive train" MAP 0x0fb52 _REC_MAP_20_u2_u2_u1 7.99987793 _CNV_A_R_LINEAR_____211_CM -4. 3.99987793 DISPLAY_IDENTIFIER IP_TQ_I_IS FORMAT "%5.4"
 /begin AXIS_DESCR COM_AXIS n_dif_cor _CNV_A_R_LINEAR_____206_CM 12 -32768. 32767. FORMAT "%6.0" AXIS_PTS_REF ldp_n_dif_cor_tq_i_is /end AXIS_DESCR
 /begin AXIS_DESCR COM_AXIS n_grd _CNV_A_R_LINEAR_____54_CM 8 -4096. 4064. FORMAT "%5.0" AXIS_PTS_REF ldp_n_grd_tq_i_is /end AXIS_DESCR
/end CHARACTERISTIC
/begin CHARACTERISTIC lc_isc_inh "Bit for inhibiting the PD- and integral part - default value = 0" VALUE 0x00f4b _REC_VAL_20_u1 1. _CNV_A_R_LINEAR_____22_CM 0. 1. DISPLAY_IDENTIFIER LC_ISC_INH FORMAT "%1.0" /end CHARACTERISTIC
/begin CHARACTERISTIC lc_tq_add_i_inh_as "Logical variable for ISC I-part map output deactivation - default value at initialisation = 0" VALUE 0x00f7d _REC_VAL_20_u1 1. _CNV_A_R_LINEAR_____22_CM 0. 1. DISPLAY_IDENTIFIER LC_TQ_ADD_I_INH_AS FORMAT "%1.0" /end CHARACTERISTIC
/begin AXIS_PTS ldp_n_dif_cor__tq_i_dt_is "" 0x10f30 n_dif_cor _REC_AXS_20_u2 65535. _CNV_A_R_LINEAR_____206_CM 12 -32768. 32767. DISPLAY_IDENTIFIER LDP_N_DIF_COR__TQ_I_DT_IS FORMAT "%6.0" /end AXIS_PTS
/begin AXIS_PTS ldp_n_dif_cor_tq_i_is "" 0x10f4a n_dif_cor _REC_AXS_20_u2 65535. _CNV_A_R_LINEAR_____206_CM 12 -32768. 32767. DISPLAY_IDENTIFIER LDP_N_DIF_COR_TQ_I_IS FORMAT "%6.0" /end AXIS_PTS
/begin AXIS_PTS ldp_n_grd_tq_i_is "" 0x07ced n_grd _REC_AXS_20_u1 8160. _CNV_A_R_LINEAR_____54_CM 8 -4096. 4064. DISPLAY_IDENTIFIER LDP_N_GRD_TQ_I_IS FORMAT "%5.0" /end AXIS_PTS
/begin AXIS_PTS ldpm_tco_is_1 "" 0x08214 tco _REC_AXS_20_u1 190.5 _CNV_A_R_LINEAR_____12_CM 8 -48. 142.5 DISPLAY_IDENTIFIER LDPM_TCO_IS_1 FORMAT "%5.1" /end AXIS_PTS
/begin AXIS_PTS ldpm_gr_mt_2 "" 0x07f76 gr_mt _REC_AXS_20_u1 255. _CNV_A_R_LINEAR_____1_CM 8 0. 255. DISPLAY_IDENTIFIER LDPM_GR_MT_2 FORMAT "%3.0" /end AXIS_PTS
/begin MEASUREMENT tq_dif_p_d_slow_is "TQ_DIF_P_D_IS for slow-path of torque coordination" SWORD _CNV_A_R_LINEAR_____55_CM 1 100. -1024. 1023.96875 DISPLAY_IDENTIFIER TQ_DIF_P_D_SLOW_IS ECU_ADDRESS 0x3fd5ba BYTE_ORDER MSB_LAST FORMAT "%6.2" /end MEASUREMENT
/begin MEASUREMENT tq_dif_p_d_is_slow "PD-part before seperation into fast/slow path" SWORD _CNV_A_R_LINEAR_____55_CM 1 100. -1024. 1023.96875 DISPLAY_IDENTIFIER TQ_DIF_P_D_IS_SLOW ECU_ADDRESS 0x3fd5d8 BYTE_ORDER MSB_LAST FORMAT "%8.2" /end MEASUREMENT
/begin MEASUREMENT tq_dif_p_d_is_fast "PD-part before seperation into fast/slow path" SWORD _CNV_A_R_LINEAR_____55_CM 1 100. -1024. 1023.96875 DISPLAY_IDENTIFIER TQ_DIF_P_D_IS_FAST ECU_ADDRESS 0x3fd5d6 BYTE_ORDER MSB_LAST FORMAT "%8.2" /end MEASUREMENT
/begin MEASUREMENT tq_add_p_d_ramp_fast "Increment of the PD-part ramps ignition path" SWORD _CNV_A_R_LINEAR_____55_CM 1 100. -1024. 1023.96875 DISPLAY_IDENTIFIER TQ_ADD_P_D_RAMP_FAST ECU_ADDRESS 0x3fd5ce BYTE_ORDER MSB_LAST FORMAT "%8.2" /end MEASUREMENT
/begin MEASUREMENT tq_add_p_d_ramp_slow "Increment of the PD-part ramps air path" SWORD _CNV_A_R_LINEAR_____55_CM 1 100. -1024. 1023.96875 DISPLAY_IDENTIFIER TQ_ADD_P_D_RAMP_SLOW ECU_ADDRESS 0x3fd5d0 BYTE_ORDER MSB_LAST FORMAT "%8.2" /end MEASUREMENT
/begin MEASUREMENT lv_tq_p_d_act_fast "Logical variable for PD-part fast active (STATE_P_D_ISC = P_D_NORMAL)" UBYTE _CNV_S_2_RANGE______5_CM 1 100. 0. 1. DISPLAY_IDENTIFIER LV_TQ_P_D_ACT_FAST ECU_ADDRESS 0x3fe39a BIT_MASK 0x1 /end MEASUREMENT
/begin MEASUREMENT lv_tq_p_d_act_slow "Logical variable for PD-part air path active (STATE_P_D_ISC = P_D_NORMAL)" UBYTE _CNV_S_2_RANGE______5_CM 1 100. 0. 1. DISPLAY_IDENTIFIER LV_TQ_P_D_ACT_SLOW ECU_ADDRESS 0x3fe39b BIT_MASK 0x1 /end MEASUREMENT
/begin CHARACTERISTIC ip_p_d_dt_is "P- and D-component for idle speed controller at closed drive train" MAP 0x0d17e _REC_MAP_20_u2_u2_u1 2047.96875 _CNV_A_R_LINEAR_____186_CM -1024. 1023.96875 DISPLAY_IDENTIFIER IP_P_D_DT_IS FORMAT "%6.2"
 /begin AXIS_DESCR COM_AXIS n_dif_cor _CNV_A_R_LINEAR_____206_CM 12 -32768. 32767. FORMAT "%6.0" AXIS_PTS_REF ldpm_n_dif_cor_p_d_dt_is /end AXIS_DESCR
 /begin AXIS_DESCR COM_AXIS n_grd _CNV_A_R_LINEAR_____54_CM 8 -4096. 4064. FORMAT "%5.0" AXIS_PTS_REF ldpm_n_grd_p_d_dt_is /end AXIS_DESCR
/end CHARACTERISTIC
/begin CHARACTERISTIC ip_p_d_dt_is_slow "P- and D-component for idle speed controller at closed drive train" MAP 0x0d23e _REC_MAP_20_u2_u2_u1 2047.96875 _CNV_A_R_LINEAR_____186_CM -1024. 1023.96875 DISPLAY_IDENTIFIER IP_P_D_DT_IS_SLOW FORMAT "%6.2"
 /begin AXIS_DESCR COM_AXIS n_dif_cor _CNV_A_R_LINEAR_____206_CM 12 -32768. 32767. FORMAT "%6.0" AXIS_PTS_REF ldpm_n_dif_cor_p_d_dt_is /end AXIS_DESCR
 /begin AXIS_DESCR COM_AXIS n_grd _CNV_A_R_LINEAR_____54_CM 8 -4096. 4064. FORMAT "%5.0" AXIS_PTS_REF ldpm_n_grd_p_d_dt_is /end AXIS_DESCR
/end CHARACTERISTIC
/begin AXIS_PTS ldpm_n_dif_cor_p_d_dt_is "" 0x11954 n_dif_cor _REC_AXS_20_u2 65535. _CNV_A_R_LINEAR_____206_CM 12 -32768. 32767. DISPLAY_IDENTIFIER LDPM_N_DIF_COR_P_D_DT_IS FORMAT "%6.0" /end AXIS_PTS
/begin AXIS_PTS ldpm_n_grd_p_d_dt_is "" 0x0812d n_grd _REC_AXS_20_u1 8160. _CNV_A_R_LINEAR_____54_CM 8 -4096. 4064. DISPLAY_IDENTIFIER LDPM_N_GRD_P_D_DT_IS FORMAT "%5.0" /end AXIS_PTS
/begin AXIS_PTS ldpm_n_dif_cor_p_d_is "" 0x1196e n_dif_cor _REC_AXS_20_u2 65535. _CNV_A_R_LINEAR_____206_CM 12 -32768. 32767. DISPLAY_IDENTIFIER LDPM_N_DIF_COR_P_D_IS FORMAT "%6.0" /end AXIS_PTS
/begin AXIS_PTS ldpm_n_grd_p_d_is "" 0x08136 n_grd _REC_AXS_20_u1 8160. _CNV_A_R_LINEAR_____54_CM 8 -4096. 4064. DISPLAY_IDENTIFIER LDPM_N_GRD_P_D_IS FORMAT "%5.0" /end AXIS_PTS
/begin CHARACTERISTIC ip_p_d_is "P- and D-component for idle speed controller at open drive train" MAP 0x0d2fe _REC_MAP_20_u2_u2_u1 2047.96875 _CNV_A_R_LINEAR_____186_CM -1024. 1023.96875 DISPLAY_IDENTIFIER IP_P_D_IS FORMAT "%6.2"
 /begin AXIS_DESCR COM_AXIS n_dif_cor _CNV_A_R_LINEAR_____206_CM 12 -32768. 32767. FORMAT "%6.0" AXIS_PTS_REF ldpm_n_dif_cor_p_d_is /end AXIS_DESCR
 /begin AXIS_DESCR COM_AXIS n_grd _CNV_A_R_LINEAR_____54_CM 8 -4096. 4064. FORMAT "%5.0" AXIS_PTS_REF ldpm_n_grd_p_d_is /end AXIS_DESCR
/end CHARACTERISTIC
/begin CHARACTERISTIC ip_p_d_is_slow "P- and D-component for idle speed controller at open drive train" MAP 0x0d3be _REC_MAP_20_u2_u2_u1 2047.96875 _CNV_A_R_LINEAR_____186_CM -1024. 1023.96875 DISPLAY_IDENTIFIER IP_P_D_IS_SLOW FORMAT "%6.2"
 /begin AXIS_DESCR COM_AXIS n_dif_cor _CNV_A_R_LINEAR_____206_CM 12 -32768. 32767. FORMAT "%6.0" AXIS_PTS_REF ldpm_n_dif_cor_p_d_is /end AXIS_DESCR
 /begin AXIS_DESCR COM_AXIS n_grd _CNV_A_R_LINEAR_____54_CM 8 -4096. 4064. FORMAT "%5.0" AXIS_PTS_REF ldpm_n_grd_p_d_is /end AXIS_DESCR
/end CHARACTERISTIC
/begin CHARACTERISTIC id_fac_p_d_dt_is "Weighting factor for IP_P_D_DT_IS" CURVE 0x08348 _REC_CUR_20_u2_u1 1.99996948 _CNV_A_R_LINEAR_____21_CM 0. 1.99996948 DISPLAY_IDENTIFIER ID_FAC_P_D_DT_IS FORMAT "%7.5"
 /begin AXIS_DESCR COM_AXIS gr_mt _CNV_A_R_LINEAR_____1_CM 8 0. 255. FORMAT "%3.0" AXIS_PTS_REF ldpm_gr_mt_2 /end AXIS_DESCR
/end CHARACTERISTIC
/begin CHARACTERISTIC id_fac_p_d_dt_is_slow "Weighting factor for IP_P_D_DT_IS_SLOW" CURVE 0x08358 _REC_CUR_20_u2_u1 1.99996948 _CNV_A_R_LINEAR_____21_CM 0. 1.99996948 DISPLAY_IDENTIFIER ID_FAC_P_D_DT_IS_SLOW FORMAT "%7.5"
 /begin AXIS_DESCR COM_AXIS gr_mt _CNV_A_R_LINEAR_____1_CM 8 0. 255. FORMAT "%3.0" AXIS_PTS_REF ldpm_gr_mt_2 /end AXIS_DESCR
/end CHARACTERISTIC
/begin AXIS_PTS ldpm_t_ast__fac_n_grd_is "" 0x11b00 t_ast _REC_AXS_20_u2 6553.5 _CNV_A_R_LINEAR_____24_CM 8 0. 6553.5 DISPLAY_IDENTIFIER LDPM_T_AST__FAC_N_GRD_IS FORMAT "%5.1" /end AXIS_PTS
/begin CHARACTERISTIC ip_fac_n_grd_is "Weighting factor N_GRD input for IP_P_D_IS" MAP 0x04fd6 _REC_MAP_20_u1_u1_u2 1.9921875 _CNV_A_R_LINEAR_____115_CM 0. 1.9921875 DISPLAY_IDENTIFIER IP_FAC_N_GRD_IS FORMAT "%5.3"
 /begin AXIS_DESCR COM_AXIS tco _CNV_A_R_LINEAR_____12_CM 8 -48. 142.5 FORMAT "%6.2" AXIS_PTS_REF ldpm_tco__fac_n_grd_is /end AXIS_DESCR
 /begin AXIS_DESCR COM_AXIS t_ast _CNV_A_R_LINEAR_____24_CM 8 0. 6553.5 FORMAT "%5.1" AXIS_PTS_REF ldpm_t_ast__fac_n_grd_is /end AXIS_DESCR
/end CHARACTERISTIC
/begin CHARACTERISTIC lc_tq_p_d_slow_inh_as "Logical variable for deactivation of TQ_DIF_P_D_IS - default value at initialisation = 0" VALUE 0x00f90 _REC_VAL_20_u1 1. _CNV_A_R_LINEAR_____22_CM 0. 1. DISPLAY_IDENTIFIER LC_TQ_P_D_SLOW_INH_AS FORMAT "%1.0" /end CHARACTERISTIC
/begin CHARACTERISTIC lc_tq_p_d_fast_inh_as "Logical variable for deactivation of TQ_DIF_P_D_IS - default value at initialisation = 0" VALUE 0x00f8f _REC_VAL_20_u1 1. _CNV_A_R_LINEAR_____22_CM 0. 1. DISPLAY_IDENTIFIER LC_TQ_P_D_FAST_INH_AS FORMAT "%1.0" /end CHARACTERISTIC
/begin CHARACTERISTIC ip_fac_n_grd_is_slow "Weighting factor N_GRD input for IP_P_D_IS_SLOW" MAP 0x05016 _REC_MAP_20_u1_u1_u2 1.9921875 _CNV_A_R_LINEAR_____115_CM 0. 1.9921875 DISPLAY_IDENTIFIER IP_FAC_N_GRD_IS_SLOW FORMAT "%5.3"
 /begin AXIS_DESCR COM_AXIS tco _CNV_A_R_LINEAR_____12_CM 8 -48. 142.5 FORMAT "%6.2" AXIS_PTS_REF ldpm_tco__fac_n_grd_is /end AXIS_DESCR
 /begin AXIS_DESCR COM_AXIS t_ast _CNV_A_R_LINEAR_____24_CM 8 0. 6553.5 FORMAT "%5.1" AXIS_PTS_REF ldpm_t_ast__fac_n_grd_is /end AXIS_DESCR
/end CHARACTERISTIC
/begin AXIS_PTS ldpm_tco__fac_n_grd_is "" 0x081ca tco _REC_AXS_20_u1 190.5 _CNV_A_R_LINEAR_____12_CM 8 -48. 142.5 DISPLAY_IDENTIFIER LDPM_TCO__FAC_N_GRD_IS FORMAT "%6.2" /end AXIS_PTS
/begin AXIS_PTS ldpm_n_dif_cor_tq_i_is "" 0x11988 n_dif_cor _REC_AXS_20_u2 65535. _CNV_A_R_LINEAR_____206_CM 4 -32768. 32767. DISPLAY_IDENTIFIER LDPM_N_DIF_COR_TQ_I_IS FORMAT "%6.0" /end AXIS_PTS
/begin AXIS_PTS ldpm_n_grd_tq_i_is "" 0x0138f n_grd _REC_AXS_20_u1 8160. _CNV_A_R_LINEAR_____215_CM 4 -4096. 4064. DISPLAY_IDENTIFIER LDPM_N_GRD_TQ_I_IS FORMAT "%5.0" /end AXIS_PTS
/begin CHARACTERISTIC ip_fac_t_ast_i_is "TQ_ADD_I_IS correction after start" MAP 0x0afd2 _REC_MAP_20_u2_u1_u2 0.999755 _CNV_A_R_LINEAR_____124_CM 0. 0.999755 DISPLAY_IDENTIFIER IP_FAC_T_AST_I_IS FORMAT "%7.5"
 /begin AXIS_DESCR COM_AXIS tco _CNV_A_R_LINEAR_____12_CM 8 -48. 142.5 FORMAT "%6.2" AXIS_PTS_REF ldpm_tco__fac_n_grd_is /end AXIS_DESCR
 /begin AXIS_DESCR COM_AXIS t_ast _CNV_A_R_LINEAR_____24_CM 8 0. 6553.5 FORMAT "%5.1" AXIS_PTS_REF ldpm_t_ast__fac_n_grd_is /end AXIS_DESCR
/end CHARACTERISTIC
/begin CHARACTERISTIC ip_tq_pas_i_acc_is "I-component for idle speed controller at transition out of Passive with air condition" MAP 0x0ff8e _REC_MAP_20_u2_u2_u1 2047.96875 _CNV_A_R_LINEAR_____186_CM -1024. 1023.96875 DISPLAY_IDENTIFIER IP_TQ_PAS_I_ACC_IS FORMAT "%6.2"
 /begin AXIS_DESCR COM_AXIS n_dif_cor _CNV_A_R_LINEAR_____206_CM 4 -32768. 32767. FORMAT "%6.0" AXIS_PTS_REF ldpm_n_dif_cor_tq_i_is /end AXIS_DESCR
 /begin AXIS_DESCR COM_AXIS n_grd _CNV_A_R_LINEAR_____215_CM 4 -4096. 4064. FORMAT "%5.0" AXIS_PTS_REF ldpm_n_grd_tq_i_is /end AXIS_DESCR
/end CHARACTERISTIC
/begin CHARACTERISTIC ip_tq_pas_i_is "I-component for idle speed controller at transition out of Passive with air condition" MAP 0x0ffae _REC_MAP_20_u2_u2_u1 2047.96875 _CNV_A_R_LINEAR_____186_CM -1024. 1023.96875 DISPLAY_IDENTIFIER IP_TQ_PAS_I_IS FORMAT "%6.2"
 /begin AXIS_DESCR COM_AXIS n_dif_cor _CNV_A_R_LINEAR_____206_CM 4 -32768. 32767. FORMAT "%6.0" AXIS_PTS_REF ldpm_n_dif_cor_tq_i_is /end AXIS_DESCR
 /begin AXIS_DESCR COM_AXIS n_grd _CNV_A_R_LINEAR_____215_CM 4 -4096. 4064. FORMAT "%5.0" AXIS_PTS_REF ldpm_n_grd_tq_i_is /end AXIS_DESCR
/end CHARACTERISTIC
/begin CHARACTERISTIC c_t_ramp_lim_i_is "Time constant for ramp limit of I-controller output in case of idle speed controller passive" VALUE 0x01892 _REC_VAL_20_u2 1310.7 _CNV_A_R_LINEAR_____197_CM 0. 1310.7 DISPLAY_IDENTIFIER C_T_RAMP_LIM_I_IS FORMAT "%7.2" /end CHARACTERISTIC
/begin CHARACTERISTIC lc_p_d_slow_fast_sel_ena "Enable seperation of slow and fast path of TQ_DIF_P_D_IS - default value at initialisation = 0" VALUE 0x00f63 _REC_VAL_20_u1 1. _CNV_A_R_LINEAR_____22_CM 0. 1. DISPLAY_IDENTIFIER LC_P_D_SLOW_FAST_SEL_ENA FORMAT "%1.0" /end CHARACTERISTIC
/begin MEASUREMENT tq_dif_p_d_dt_is_1 "PD-part st drive train into fast path" SWORD _CNV_A_R_LINEAR_____55_CM 1 100. -1024. 1023.96875 DISPLAY_IDENTIFIER TQ_DIF_P_D_DT_IS_1 ECU_ADDRESS 0x3fd5d2 BYTE_ORDER MSB_LAST FORMAT "%8.2" /end MEASUREMENT
/begin MEASUREMENT tq_dif_p_d_dt_is_1_slow "PD-part at drive train into slow path" SWORD _CNV_A_R_LINEAR_____55_CM 1 100. -1024. 1023.96875 DISPLAY_IDENTIFIER TQ_DIF_P_D_DT_IS_1_SLOW ECU_ADDRESS 0x3fd5d4 BYTE_ORDER MSB_LAST FORMAT "%8.2" /end MEASUREMENT
/begin MEASUREMENT fac_n_grd_is "Factor in dependance of TCO and TOIL for weighting the speed gradient influence on the PD-part (for LV_DT=0)" UBYTE _CNV_A_R_LINEAR_____39_CM 1 100. 0. 1.99220002 DISPLAY_IDENTIFIER FAC_N_GRD_IS ECU_ADDRESS 0x3fe38d FORMAT "%5.3" /end MEASUREMENT
/begin MEASUREMENT fac_n_grd_is_slow "Factor in dependance of TCO and TOIL for weighting the speed gradient influence on the PD-part (for LV_DT=0)" UBYTE _CNV_A_R_LINEAR_____39_CM 1 100. 0. 1.99220002 DISPLAY_IDENTIFIER FAC_N_GRD_IS_SLOW ECU_ADDRESS 0x3fe38e FORMAT "%5.3" /end MEASUREMENT
/begin CHARACTERISTIC c_crlc_n_grd "Filter correlation constant" VALUE 0x014da _REC_VAL_20_u2 0.99998474 _CNV_A_R_LINEAR_____37_CM 0. 0.99998474 DISPLAY_IDENTIFIER C_CRLC_N_GRD FORMAT "%7.5" /end CHARACTERISTIC
/begin CHARACTERISTIC c_nr_buf_n_grd_fil "number of relevant buffer cells for N_GRD_FIL_1_IS" VALUE 0x00797 _REC_VAL_20_u1 5. _CNV_A_R_LINEAR_____1_CM 1. 6. DISPLAY_IDENTIFIER C_NR_BUF_N_GRD_FIL FORMAT "%2.0" /end CHARACTERISTIC
/begin CHARACTERISTIC lc_n_grd_fil_p_d_swi "Logical variable for switching between N_GRD_FIL_1_IS and N_GRD_FIL_IS" VALUE 0x00f61 _REC_VAL_20_u1 1. _CNV_A_R_LINEAR_____22_CM 0. 1. DISPLAY_IDENTIFIER LC_N_GRD_FIL_P_D_SWI FORMAT "%1.0" /end CHARACTERISTIC
/begin CHARACTERISTIC lc_n_grd_fil_i_swi "Logical variable for changing between N_GRD_FIL_1_IS and N_GRD_FIL_IS" VALUE 0x00f60 _REC_VAL_20_u1 1. _CNV_A_R_LINEAR_____22_CM 0. 1. DISPLAY_IDENTIFIER LC_N_GRD_FIL_I_SWI FORMAT "%1.0" /end CHARACTERISTIC
/begin MEASUREMENT lv_req_isc "Logical variable for idle speed controller activatIon request" UBYTE _CNV_S_2_RANGE______0_CM 1 100. 0. 1. DISPLAY_IDENTIFIER LV_REQ_ISC ECU_ADDRESS 0x3fe3a2 BIT_MASK 0x1 /end MEASUREMENT
/begin MEASUREMENT state_req_isc "actual state for ISC request" UBYTE _CNV_S_4_STATE_REQ__216_CM 1 100. 0. 3. DISPLAY_IDENTIFIER STATE_REQ_ISC ECU_ADDRESS 0x3fe3a3 /end MEASUREMENT
/begin MEASUREMENT lv_neg_n_grd_fil_mem "Memory bit for falling gradient after start" UBYTE _CNV_S_2_RANGE______0_CM 1 100. 0. 1. DISPLAY_IDENTIFIER LV_NEG_N_GRD_FIL_MEM ECU_ADDRESS 0x3fe3a7 /end MEASUREMENT
/begin MEASUREMENT n_grd_fil_isc_act_ast "Filtered gradient for ISC after start activation" SBYTE _CNV_A_R_LINEAR_____51_CM 1 100. -4096. 4064. DISPLAY_IDENTIFIER N_GRD_FIL_ISC_ACT_AST ECU_ADDRESS 0x3fe3a4 FORMAT "%5.0" /end MEASUREMENT
/begin CHARACTERISTIC lc_isc_act_cdn_swi "Calibratible logical bit for switching between different activation conditions " VALUE 0x00f4a _REC_VAL_20_u1 1. _CNV_A_R_LINEAR_____1_CM 0. 1. DISPLAY_IDENTIFIER LC_ISC_ACT_CDN_SWI FORMAT "%2.0" /end CHARACTERISTIC
/begin CHARACTERISTIC lc_isc_act_ast_cdn_swi "Switch for using different after start ISC activation conditions" VALUE 0x00f49 _REC_VAL_20_u1 1. _CNV_A_R_LINEAR_____1_CM 0. 1. DISPLAY_IDENTIFIER LC_ISC_ACT_AST_CDN_SWI FORMAT "%2.0" /end CHARACTERISTIC
/begin CHARACTERISTIC c_n_dif_isc_act_ast "Additive term to define the low limit for ISC activation after start" VALUE 0x00442 _REC_VAL_20_s2 65535. _CNV_A_R_LINEAR_____11_CM -32768. 32767. DISPLAY_IDENTIFIER C_N_DIF_ISC_ACT_AST FORMAT "%6.0" /end CHARACTERISTIC
/begin CHARACTERISTIC c_crlc_n_grd_fil_isc_act_ast "Filter correlation factor for speed gradient filtering in connection with after start activation of ISC" VALUE 0x014e0 _REC_VAL_20_u2 0.99998474 _CNV_A_R_LINEAR_____37_CM 0. 0.99998474 DISPLAY_IDENTIFIER C_CRLC_N_GRD_FIL_ISC_ACT_AST FORMAT "%7.5" /end CHARACTERISTIC
/begin CHARACTERISTIC c_t_dly_isc_act_pu "Time limit for ISC activation in PU" VALUE 0x017f6 _REC_VAL_20_u2 655.35 _CNV_A_R_LINEAR_____4_CM 0. 655.35 DISPLAY_IDENTIFIER C_T_DLY_ISC_ACT_PU FORMAT "%6.2" /end CHARACTERISTIC
/begin MEASUREMENT n_dif_ofs_pred "Predicted engine speed difference for torque reserve calculation" SWORD _CNV_A_R_LINEAR_____11_CM 1 100. -32768. 32767. DISPLAY_IDENTIFIER N_DIF_OFS_PRED ECU_ADDRESS 0x3fd5e4 BYTE_ORDER MSB_LAST FORMAT "%6.0" /end MEASUREMENT
/begin MEASUREMENT t_n_dif_ofs_pred "Prediction time for engine speed difference" UBYTE _CNV_A_R_LINEAR_____217_CM 1 100. 0. 7.96875 DISPLAY_IDENTIFIER T_N_DIF_OFS_PRED ECU_ADDRESS 0x3fe39f FORMAT "%4.2" /end MEASUREMENT
/begin CHARACTERISTIC ip_t_n_dif_ofs_pred__n "Time constant for calculation of predicted engine speed deviation" CURVE 0x00e0d _REC_CUR_20_u1_u2 7.96875 _CNV_A_R_LINEAR_____217_CM 0. 7.96875 DISPLAY_IDENTIFIER IP_T_N_DIF_OFS_PRED__N FORMAT "%4.2"
 /begin AXIS_DESCR COM_AXIS n _CNV_A_R_LINEAR_____11_CM 8 0. 8160. FORMAT "%4.0" AXIS_PTS_REF ldpm_n_t_n_dif_ofs_pred /end AXIS_DESCR
/end CHARACTERISTIC
/begin MEASUREMENT n_dif_pred "Predicted idle speed control variable" SWORD _CNV_A_R_LINEAR_____11_CM 1 100. -32768. 32767. DISPLAY_IDENTIFIER N_DIF_PRED ECU_ADDRESS 0x3fd5e0 BYTE_ORDER MSB_LAST FORMAT "%6.0" /end MEASUREMENT
/begin MEASUREMENT tq_add_is_bol "Torque reserve ad idle due to deviation of engine speed to set point at idle" SWORD _CNV_A_R_LINEAR_____55_CM 1 100. -1024. 1023.96875 DISPLAY_IDENTIFIER TQ_ADD_IS_BOL ECU_ADDRESS 0x3fd5da BYTE_ORDER MSB_LAST FORMAT "%8.2" /end MEASUREMENT
/begin MEASUREMENT tq_dif_add_is_tol "Idle speed torque reserve limitation for stabilization the ISC at high torque reserves" SWORD _CNV_A_R_LINEAR_____55_CM 1 100. -1024. 1023.96875 DISPLAY_IDENTIFIER TQ_DIF_ADD_IS_TOL ECU_ADDRESS 0x3fd5dc BYTE_ORDER MSB_LAST FORMAT "%8.2" /end MEASUREMENT
/begin CHARACTERISTIC c_tq_add_is_bol_crlc "Filter constant for torque reserve" VALUE 0x008fc _REC_VAL_20_u1 0.9960940000000002 _CNV_A_R_LINEAR_____50_CM 0. 0.996094 DISPLAY_IDENTIFIER C_TQ_ADD_IS_BOL_CRLC FORMAT "%5.3" /end CHARACTERISTIC
/begin CHARACTERISTIC c_tq_dif_add_is_tol "Idle speed torque reserve limitation for stabilizing the ISC at high torque reserve" VALUE 0x0197c _REC_VAL_20_u2 1023.96875 _CNV_A_R_LINEAR_____55_CM 0. 1023.96875 DISPLAY_IDENTIFIER C_TQ_DIF_ADD_IS_TOL FORMAT "%7.2" /end CHARACTERISTIC
/begin AXIS_PTS ldp_maf_lgrd_tq_add_is_bol "" 0x10d92 maf _REC_AXS_20_u2 1389. _CNV_A_R_LINEAR_____106_CM 6 0. 1389. DISPLAY_IDENTIFIER LDP_MAF_LGRD_TQ_ADD_IS_BOL FORMAT "%7.2" /end AXIS_PTS
/begin AXIS_PTS ldp_n_sp_is_tq_add_is_bol_bas "" 0x11018 n_sp_is _REC_AXS_20_u2 8160. _CNV_A_R_LINEAR_____11_CM 6 0. 8160. DISPLAY_IDENTIFIER LDP_N_SP_IS_TQ_ADD_IS_BOL_BAS FORMAT "%4.0" /end AXIS_PTS
/begin AXIS_PTS ldp_n_lgrd_tq_add_is_bol "" 0x10f96 n _REC_AXS_20_u2 8160. _CNV_A_R_LINEAR_____11_CM 6 0. 8160. DISPLAY_IDENTIFIER LDP_N_LGRD_TQ_ADD_IS_BOL FORMAT "%4.0" /end AXIS_PTS
/begin CHARACTERISTIC ip_fac_tq_add_is_bol_dri "Factor for basis torque reserve at idle due to N_DIF_PRED and load with drive" MAP 0x0557c _REC_MAP_20_u1_u2_u2 7.96875 _CNV_A_R_LINEAR_____48_CM 0. 7.96875 DISPLAY_IDENTIFIER IP_FAC_TQ_ADD_IS_BOL_DRI FORMAT "%5.3"
 /begin AXIS_DESCR COM_AXIS n_dif_pred_pl_drof _CNV_A_R_LINEAR_____206_CM 8 -32768. 32767. FORMAT "%6.0" AXIS_PTS_REF ldpm_n_dif_pred_fac_tq_add_is /end AXIS_DESCR
 /begin AXIS_DESCR COM_AXIS maf _CNV_A_R_LINEAR_____106_CM 6 0. 1389. FORMAT "%7.2" AXIS_PTS_REF ldpm_maf_fac_tq_add_is /end AXIS_DESCR
/end CHARACTERISTIC
/begin CHARACTERISTIC ip_tq_add_is_bol_bas "Basis torque reserve at idle." MAP 0x0f9a6 _REC_MAP_20_u2_u2_u1 1023.96875 _CNV_A_R_LINEAR_____55_CM 0. 1023.96875 DISPLAY_IDENTIFIER IP_TQ_ADD_IS_BOL_BAS FORMAT "%7.2"
 /begin AXIS_DESCR COM_AXIS n_sp_is _CNV_A_R_LINEAR_____11_CM 6 0. 8160. FORMAT "%4.0" AXIS_PTS_REF ldp_n_sp_is_tq_add_is_bol_bas /end AXIS_DESCR
 /begin AXIS_DESCR COM_AXIS tco _CNV_A_R_LINEAR_____12_CM 6 -48. 142.5 FORMAT "%5.1" AXIS_PTS_REF ldp_tco_tq_add_is_bol_bas /end AXIS_DESCR
/end CHARACTERISTIC
/begin CHARACTERISTIC ip_lgrd_tq_add_is_bol "Gradient for decrementation of the torque reserve at idle" MAP 0x06924 _REC_MAP_20_u1_u2_u2 7.96875 _CNV_A_R_LINEAR_____55_CM 0. 7.96875 DISPLAY_IDENTIFIER IP_LGRD_TQ_ADD_IS_BOL_BAS FORMAT "%4.3"
 /begin AXIS_DESCR COM_AXIS n _CNV_A_R_LINEAR_____11_CM 6 0. 8160. FORMAT "%4.0" AXIS_PTS_REF ldp_n_lgrd_tq_add_is_bol /end AXIS_DESCR
 /begin AXIS_DESCR COM_AXIS maf _CNV_A_R_LINEAR_____106_CM 6 0. 1389. FORMAT "%7.2" AXIS_PTS_REF ldp_maf_lgrd_tq_add_is_bol /end AXIS_DESCR
/end CHARACTERISTIC
/begin CHARACTERISTIC ip_t_n_dif_ofs_pred_cs__n "Time constant for calculation of predicted engine speed deviation at drive-off-support" CURVE 0x00e15 _REC_CUR_20_u1_u2 7.96875 _CNV_A_R_LINEAR_____217_CM 0. 7.96875 DISPLAY_IDENTIFIER IP_T_N_DIF_OFS_PRED_CS__N FORMAT "%4.2"
 /begin AXIS_DESCR COM_AXIS n _CNV_A_R_LINEAR_____11_CM 8 0. 8160. FORMAT "%4.0" AXIS_PTS_REF ldpm_n_t_n_dif_ofs_pred /end AXIS_DESCR
/end CHARACTERISTIC
/begin AXIS_PTS ldpm_maf_fac_tq_add_is "" 0x11766 maf _REC_AXS_20_u2 1389. _CNV_A_R_LINEAR_____106_CM 6 0. 1389. DISPLAY_IDENTIFIER LDPM_MAF_FAC_TQ_ADD_IS FORMAT "%7.2" /end AXIS_PTS
/begin CHARACTERISTIC ip_fac_tq_add_is_bol_cs "Factor for basis torque reserve at idle due to N_DIF_PRED and load for drive-off-support" MAP 0x0554c _REC_MAP_20_u1_u2_u2 7.96875 _CNV_A_R_LINEAR_____48_CM 0. 7.96875 DISPLAY_IDENTIFIER IP_FAC_TQ_ADD_IS_BOL_CS FORMAT "%5.3"
 /begin AXIS_DESCR COM_AXIS n_dif_pred_pl_drof _CNV_A_R_LINEAR_____206_CM 8 -32768. 32767. FORMAT "%6.0" AXIS_PTS_REF ldpm_n_dif_pred_fac_tq_add_is /end AXIS_DESCR
 /begin AXIS_DESCR COM_AXIS maf _CNV_A_R_LINEAR_____106_CM 6 0. 1389. FORMAT "%7.2" AXIS_PTS_REF ldpm_maf_fac_tq_add_is /end AXIS_DESCR
/end CHARACTERISTIC
/begin MEASUREMENT t_n_dif_ofs_pred_cs "Prediction time for engine speed difference at drive-off-support" UBYTE _CNV_A_R_LINEAR_____217_CM 1 100. 0. 7.96875 DISPLAY_IDENTIFIER T_N_DIF_OFS_PRED_CS ECU_ADDRESS 0x3fe3a0 FORMAT "%4.2" /end MEASUREMENT
/begin MEASUREMENT n_dif_ofs_pred_cs "Predicted engine speed difference for torque reserve calculation at drive-off-support" SWORD _CNV_A_R_LINEAR_____11_CM 1 100. -32768. 32767. DISPLAY_IDENTIFIER N_DIF_OFS_PRED_CS ECU_ADDRESS 0x3fd5e6 BYTE_ORDER MSB_LAST FORMAT "%6.0" /end MEASUREMENT
/begin MEASUREMENT n_dif_pred_cs "Predicted idle speed control variable at drive-off-support" SWORD _CNV_A_R_LINEAR_____11_CM 1 100. -32768. 32767. DISPLAY_IDENTIFIER N_DIF_PRED_CS ECU_ADDRESS 0x3fd5e2 BYTE_ORDER MSB_LAST FORMAT "%6.0" /end MEASUREMENT
/begin MEASUREMENT fac_tq_add_is_bol "Resulting factor for IP_TQ_ADD_IS_BOL_BAS" UBYTE _CNV_A_R_LINEAR_____48_CM 1 100. 0. 7.96875 DISPLAY_IDENTIFIER FAC_TQ_ADD_IS_BOL ECU_ADDRESS 0x3fe3a1 FORMAT "%5.3" /end MEASUREMENT
/begin CHARACTERISTIC ip_fac_tq_add_is_bol "Factor for basis torque reserve at idle due to N_DIF_PRED and load without drive" MAP 0x0551c _REC_MAP_20_u1_u2_u2 7.96875 _CNV_A_R_LINEAR_____48_CM 0. 7.96875 DISPLAY_IDENTIFIER IP_FAC_TQ_ADD_IS_BOL FORMAT "%5.3"
 /begin AXIS_DESCR COM_AXIS n_dif_pred_pl_drof _CNV_A_R_LINEAR_____206_CM 8 -32768. 32767. FORMAT "%6.0" AXIS_PTS_REF ldpm_n_dif_pred_fac_tq_add_is /end AXIS_DESCR
 /begin AXIS_DESCR COM_AXIS maf _CNV_A_R_LINEAR_____106_CM 6 0. 1389. FORMAT "%7.2" AXIS_PTS_REF ldpm_maf_fac_tq_add_is /end AXIS_DESCR
/end CHARACTERISTIC
/begin CHARACTERISTIC ip_fac_temp_tq_add_is_bas "Temperature correction for IP_TQ_ADD_IS_BOL_BAS" MAP 0x05328 _REC_MAP_20_u1_u1_u1 1.9921875 _CNV_A_R_LINEAR_____115_CM 0. 1.9921875 DISPLAY_IDENTIFIER IP_FAC_TEMP_TQ_ADD_IS_BAS FORMAT "%5.3"
 /begin AXIS_DESCR COM_AXIS tia _CNV_A_R_LINEAR_____12_CM 6 -48. 142.5 FORMAT "%5.1" AXIS_PTS_REF ldp_tia_ip_fac_temp_tq_add_is /end AXIS_DESCR
 /begin AXIS_DESCR COM_AXIS toil _CNV_A_R_LINEAR_____15_CM 6 -40. 160. FORMAT "%3.0" AXIS_PTS_REF ldp_toil_ip_fac_temp_tq_add_is /end AXIS_DESCR
/end CHARACTERISTIC
/begin AXIS_PTS ldp_tco_tq_add_is_bol_bas "" 0x011c8 tco _REC_AXS_20_u1 190.5 _CNV_A_R_LINEAR_____12_CM 6 -48. 142.5 DISPLAY_IDENTIFIER LDP_TCO_TQ_ADD_IS_BOL_BAS FORMAT "%5.1" /end AXIS_PTS
/begin AXIS_PTS ldp_tia_ip_fac_temp_tq_add_is "" 0x0120b tia _REC_AXS_20_u1 190.5 _CNV_A_R_LINEAR_____12_CM 6 -48. 142.5 DISPLAY_IDENTIFIER LDP_TIA_IP_FAC_TEMP_TQ_ADD_IS FORMAT "%5.1" /end AXIS_PTS
/begin AXIS_PTS ldp_toil_ip_fac_temp_tq_add_is "" 0x01242 toil _REC_AXS_20_u1 200. _CNV_A_R_LINEAR_____15_CM 6 -40. 160. DISPLAY_IDENTIFIER LDP_TOIL_IP_FAC_TEMP_TQ_ADD_IS FORMAT "%3.0" /end AXIS_PTS
/begin CHARACTERISTIC c_fac_tq_is_ad_conv_max "Max. limitation for converter torque Adaptation factor" VALUE 0x003f0 _REC_VAL_20_s2 4.879900000000001e-004 _CNV_A_R_LINEAR_____218_CM -2.44e-004 2.4399e-004 DISPLAY_IDENTIFIER C_FAC_TQ_IS_AD_CONV_MAX FORMAT "%10.9" /end CHARACTERISTIC
/begin CHARACTERISTIC c_fac_tq_is_ad_conv_min "Min. limitation of converter torque Adaptation factor" VALUE 0x003f2 _REC_VAL_20_s2 4.879900000000001e-004 _CNV_A_R_LINEAR_____218_CM -2.44e-004 2.4399e-004 DISPLAY_IDENTIFIER C_FAC_TQ_IS_AD_CONV_MIN FORMAT "%10.9" /end CHARACTERISTIC
/begin CHARACTERISTIC c_tq_is_ad_acc_min "Min. limitation for ACC Adaptation" VALUE 0x00498 _REC_VAL_20_s2 2047.96875 _CNV_A_R_LINEAR_____55_CM -1024. 1023.96875 DISPLAY_IDENTIFIER C_TQ_IS_AD_ACC_MIN FORMAT "%7.1" /end CHARACTERISTIC
/begin CHARACTERISTIC c_tq_is_ad_max "Max. limitation of engine torque losses Adaptation" VALUE 0x0049e _REC_VAL_20_s2 2047.96875 _CNV_A_R_LINEAR_____55_CM -1024. 1023.96875 DISPLAY_IDENTIFIER C_TQ_IS_AD_MAX FORMAT "%7.1" /end CHARACTERISTIC
/begin CHARACTERISTIC c_tq_is_ad_min "Min. limitation of engine torque losses Adaptation" VALUE 0x004a0 _REC_VAL_20_s2 2047.96875 _CNV_A_R_LINEAR_____55_CM -1024. 1023.96875 DISPLAY_IDENTIFIER C_TQ_IS_AD_MIN FORMAT "%7.1" /end CHARACTERISTIC
/begin MEASUREMENT fac_tq_is_ad_conv "Converter torque Adaptation factor" SWORD _CNV_A_R_LINEAR_____219_CM 1 100. -2.4414e-004 2.4414e-004 DISPLAY_IDENTIFIER FAC_TQ_IS_AD_CONV ECU_ADDRESS 0x3fd5ea BYTE_ORDER MSB_LAST FORMAT "%9.8" /end MEASUREMENT
/begin CHARACTERISTIC c_fac_tq_is_ad_acc "Calibration parameter, LV_ACC=1" VALUE 0x0159c _REC_VAL_20_u2 0.99998474 _CNV_A_R_LINEAR_____37_CM 0. 0.99998474 DISPLAY_IDENTIFIER C_FAC_TQ_IS_AD_ACC FORMAT "%7.5" /end CHARACTERISTIC
/begin CHARACTERISTIC c_fac_tq_is_ad_conv "Calibration parameter, LV_ACC=0, LV_DRI=1" VALUE 0x015a0 _REC_VAL_20_u2 4.88e-004 _CNV_A_R_LINEAR_____220_CM 0. 4.88e-004 DISPLAY_IDENTIFIER C_FAC_TQ_IS_AD_CONV FORMAT "%10.9" /end CHARACTERISTIC
/begin CHARACTERISTIC c_fac_tq_is_ad_acc_conv "Calibration parameter, LV_ACC=1, LV_DRI=1" VALUE 0x0159e _REC_VAL_20_u2 0.99998474 _CNV_A_R_LINEAR_____37_CM 0. 0.99998474 DISPLAY_IDENTIFIER C_FAC_TQ_IS_AD_ACC_CONV FORMAT "%7.5" /end CHARACTERISTIC
/begin CHARACTERISTIC c_tq_is_ad_acc_max "Max. limitation for ACC torque Adaptation" VALUE 0x00496 _REC_VAL_20_s2 2047.96875 _CNV_A_R_LINEAR_____55_CM -1024. 1023.96875 DISPLAY_IDENTIFIER C_TQ_IS_AD_ACC_MAX FORMAT "%7.1" /end CHARACTERISTIC
/begin CHARACTERISTIC c_tq_is_ad_acc_conv_max "Max. limitation of air conditioning compressor and converter  torque Adaptation" VALUE 0x00492 _REC_VAL_20_s2 2047.96875 _CNV_A_R_LINEAR_____55_CM -1024. 1023.96875 DISPLAY_IDENTIFIER C_TQ_IS_AD_ACC_CONV_MAX FORMAT "%7.1" /end CHARACTERISTIC
/begin CHARACTERISTIC c_tq_is_ad_acc_conv_min "Min. limitation of air conditioning compressor and converter  torque Adaptation" VALUE 0x00494 _REC_VAL_20_s2 2047.96875 _CNV_A_R_LINEAR_____55_CM -1024. 1023.96875 DISPLAY_IDENTIFIER C_TQ_IS_AD_ACC_CONV_MIN FORMAT "%7.1" /end CHARACTERISTIC
/begin MEASUREMENT tq_dif_is_ad_acc_1 "ACC torque Adaptation" SWORD _CNV_A_R_LINEAR_____55_CM 1 100. -1024. 1023.96875 DISPLAY_IDENTIFIER TQ_DIF_IS_AD_ACC_1 ECU_ADDRESS 0x3fd5f2 BYTE_ORDER MSB_LAST FORMAT "%6.2" /end MEASUREMENT
/begin MEASUREMENT tq_dif_is_ad_acc_conv "ACC and converter torque Adaptation" SWORD _CNV_A_R_LINEAR_____55_CM 1 100. -1024. 1023.96875 DISPLAY_IDENTIFIER TQ_DIF_IS_AD_ACC_CONV ECU_ADDRESS 0x3fd5f0 BYTE_ORDER MSB_LAST FORMAT "%6.2" /end MEASUREMENT
/begin MEASUREMENT tq_dif_is_ad "Basic ISC Adaptation" SWORD _CNV_A_R_LINEAR_____55_CM 1 100. -1024. 1023.96875 DISPLAY_IDENTIFIER TQ_DIF_IS_AD ECU_ADDRESS 0x3fd5e8 BYTE_ORDER MSB_LAST FORMAT "%6.2" /end MEASUREMENT
/begin MEASUREMENT tq_dif_is_ad_inter "Basic ISC Adaptation, inetmediate value with high resolution (long signed word)" SLONG _CNV_A_R_LINEAR_____221_CM 1 100. -1024. 1023.99999952 DISPLAY_IDENTIFIER TQ_DIF_IS_AD_INTER ECU_ADDRESS 0x3fcccc BYTE_ORDER MSB_LAST FORMAT "%12.7" /end MEASUREMENT
/begin MEASUREMENT tq_dif_is_ad_acc_1_inter "Torque ACC Adaptation, inetmediate value with high resolution (long signed word)" SLONG _CNV_A_R_LINEAR_____221_CM 1 100. -1024. 1023.99999952 DISPLAY_IDENTIFIER TQ_DIF_IS_AD_ACC_1_INTER ECU_ADDRESS 0x3fccd0 BYTE_ORDER MSB_LAST FORMAT "%12.7" /end MEASUREMENT
/begin MEASUREMENT tq_dif_is_ad_acc_conv_inter "ACC and torque Adaptation, inetmediate value with high resolution (long signed word)" SLONG _CNV_A_R_LINEAR_____221_CM 1 100. -1024. 1023.99999952 DISPLAY_IDENTIFIER TQ_DIF_IS_AD_ACC_CONV_INTER ECU_ADDRESS 0x3fccd4 BYTE_ORDER MSB_LAST FORMAT "%12.7" /end MEASUREMENT
/begin CHARACTERISTIC c_fac_tq_is_ad "Calibration parameter, LV_ACC=0, LV_DRI=0" VALUE 0x0159a _REC_VAL_20_u2 0.99998474 _CNV_A_R_LINEAR_____37_CM 0. 0.99998474 DISPLAY_IDENTIFIER C_FAC_TQ_IS_AD FORMAT "%7.5" /end CHARACTERISTIC
/begin MEASUREMENT tq_dif_is_ad_acc "Low-pass filtered ACC torque Adaptation or ACC and converter torque Adaptation" SWORD _CNV_A_R_LINEAR_____55_CM 1 100. -1024. 1023.96875 DISPLAY_IDENTIFIER TQ_DIF_IS_AD_ACC ECU_ADDRESS 0x3fd5ec BYTE_ORDER MSB_LAST FORMAT "%6.2" /end MEASUREMENT
/begin CHARACTERISTIC c_crlc_tq_dif_is_ad_acc "Filter constant for LOW_PASS_1" VALUE 0x0063a _REC_VAL_20_u1 0.9960940000000002 _CNV_A_R_LINEAR_____50_CM 0. 0.996094 DISPLAY_IDENTIFIER C_CRLC_TQ_DIF_IS_AD_ACC FORMAT "%5.3" /end CHARACTERISTIC
/begin CHARACTERISTIC c_fac_tq_is_ad_conv_can "Calibration parameter, LV_ACC = 0 AND LV_DRI= 1" VALUE 0x015a2 _REC_VAL_20_u2 0.99998474 _CNV_A_R_LINEAR_____37_CM 0. 0.99998474 DISPLAY_IDENTIFIER C_FAC_TQ_IS_AD_CONV_CAN FORMAT "%7.5" /end CHARACTERISTIC
/begin MEASUREMENT tq_dif_is_ad_conv "Converter torque Adaptation" SWORD _CNV_A_R_LINEAR_____55_CM 1 100. -1024. 1023.96875 DISPLAY_IDENTIFIER TQ_DIF_IS_AD_CONV ECU_ADDRESS 0x3fd5ee BYTE_ORDER MSB_LAST FORMAT "%8.2" /end MEASUREMENT
/begin MEASUREMENT tq_dif_is_ad_conv_inter "Converter torque Adaptation, intermediate value with high resolution (long signed word)" SLONG _CNV_A_R_LINEAR_____221_CM 1 100. -1024. 1023.99999952 DISPLAY_IDENTIFIER TQ_DIF_IS_AD_CONV_INTER ECU_ADDRESS 0x3fccd8 BYTE_ORDER MSB_LAST FORMAT "%12.7" /end MEASUREMENT
/begin CHARACTERISTIC c_tq_is_ad_conv_can_min "Min. limitation converter torque adaptation" VALUE 0x0049c _REC_VAL_20_s2 2047.96875 _CNV_A_R_LINEAR_____55_CM -1024. 1023.96875 DISPLAY_IDENTIFIER C_TQ_IS_AD_CONV_CAN_MIN FORMAT "%8.2" /end CHARACTERISTIC
/begin CHARACTERISTIC c_tq_is_ad_conv_can_max "Max. limitation converter torque adaptation" VALUE 0x0049a _REC_VAL_20_s2 2047.96875 _CNV_A_R_LINEAR_____55_CM -1024. 1023.96875 DISPLAY_IDENTIFIER C_TQ_IS_AD_CONV_CAN_MAX FORMAT "%8.2" /end CHARACTERISTIC
/begin CHARACTERISTIC c_n_delta "engine speed threshold for ISC Adaptation" VALUE 0x016d8 _REC_VAL_20_u2 8160. _CNV_A_R_LINEAR_____11_CM 0. 8160. DISPLAY_IDENTIFIER C_N_DELTA FORMAT "%4.0" /end CHARACTERISTIC
/begin CHARACTERISTIC c_tco_ad_min_is "temperature bottom limit for ISC Adaptation" VALUE 0x0085a _REC_VAL_20_u1 28.575 _CNV_A_R_LINEAR_____12_CM -48. 142.5 DISPLAY_IDENTIFIER C_TCO_AD_MIN_IS FORMAT "%5.1" /end CHARACTERISTIC
/begin MEASUREMENT lv_is_ad_cnd "Adaptation Condition" UBYTE _CNV_S_2_RANGE______0_CM 1 100. 0. 1. DISPLAY_IDENTIFIER LV_IS_AD_CND ECU_ADDRESS 0x3fe384 BIT_MASK 0x1 /end MEASUREMENT
/begin MEASUREMENT lv_tco_ad_cnd_is "Logical bit \"Coolant temperature in operating range\"" UBYTE _CNV_S_2_RANGE______0_CM 1 100. 0. 1. DISPLAY_IDENTIFIER LV_TCO_AD_CND_IS ECU_ADDRESS 0x3fe385 /end MEASUREMENT
/begin MEASUREMENT lv_dly_ad_is "Logical bit \"Idle speed has settled for a given time delay\"" UBYTE _CNV_S_2_RANGE______0_CM 1 100. 0. 1. DISPLAY_IDENTIFIER LV_DLY_AD_IS ECU_ADDRESS 0x3fe386 /end MEASUREMENT
/begin CHARACTERISTIC c_tco_ad_max_is "temperature top limit for ISC Adaptation" VALUE 0x00859 _REC_VAL_20_u1 28.575 _CNV_A_R_LINEAR_____12_CM -48. 142.5 DISPLAY_IDENTIFIER C_TCO_AD_MAX_IS FORMAT "%5.1" /end CHARACTERISTIC
/begin CHARACTERISTIC c_dly_is_ad "time delay for ISC Adaptation" VALUE 0x006a9 _REC_VAL_20_u1 255. _CNV_A_R_LINEAR_____195_CM 0. 255. DISPLAY_IDENTIFIER C_DLY_IS_AD FORMAT "%3.0" /end CHARACTERISTIC
/begin MEASUREMENT lv_is_ad_inh_obd "Application incidence value" UBYTE _CNV_S_2_RANGE______0_CM 1 100. 0. 1. DISPLAY_IDENTIFIER LV_IS_AD_INH_OBD ECU_ADDRESS 0x3fe388 /end MEASUREMENT
/begin MEASUREMENT lv_is_ad_inh "Application incidence value (additional adaptation conditions, project specific)" UBYTE _CNV_S_2_RANGE______0_CM 1 100. 0. 1. DISPLAY_IDENTIFIER LV_IS_AD_INH ECU_ADDRESS 0x3fe389 /end MEASUREMENT
/begin MEASUREMENT t_mff_ad_min "Time indicating the minimum time for next requested lambda Adaptation" UWORD _CNV_A_R_LINEAR_____24_CM 1 100. 0. 6553.5 DISPLAY_IDENTIFIER T_MFF_AD_MIN ECU_ADDRESS 0x3fd0ae BYTE_ORDER MSB_LAST FORMAT "%6.1" /end MEASUREMENT
/begin MEASUREMENT lv_mff_ad_end "Logical value signals the temporary end of  lambda Adaptation" UBYTE _CNV_S_2_RANGE______0_CM 1 100. 0. 1. DISPLAY_IDENTIFIER LV_MFF_AD_END ECU_ADDRESS 0x3fe005 /end MEASUREMENT
/begin MEASUREMENT lv_mff_ad_ena_first "Logical value which indicates the first lambda Adaptation phase " UBYTE _CNV_S_2_RANGE______0_CM 1 100. 0. 1. DISPLAY_IDENTIFIER LV_MFF_AD_ENA_FIRST ECU_ADDRESS 0x3fe008 /end MEASUREMENT
/begin MEASUREMENT lv_lamb_ad_afs_req "Boolean for Combustion Manager to force lambda eq. 1 conditions for lambda Adaptation" UBYTE _CNV_S_2_RANGE______0_CM 1 100. 0. 1. DISPLAY_IDENTIFIER LV_LAMB_AD_AFS_REQ ECU_ADDRESS 0x3fe006 /end MEASUREMENT
/begin CHARACTERISTIC c_mff_ad_cor_crlc "Correlation constant  Lambdaadapatation at  LV_IS = 0" VALUE 0x0072d _REC_VAL_20_u1 0.99610001 _CNV_A_R_LINEAR_____29_CM 0. 0.99610001 DISPLAY_IDENTIFIER C_MFF_AD_COR_CRLC FORMAT "%5.3" /end CHARACTERISTIC
/begin CHARACTERISTIC c_lam_ad_sum_p_is "P component jump delay between two Adaptations in Idle" VALUE 0x00717 _REC_VAL_20_u1 254. _CNV_A_R_LINEAR_____1_CM 1. 255. DISPLAY_IDENTIFIER C_LAM_AD_SUM_P_IS FORMAT "%3.0" /end CHARACTERISTIC
/begin CHARACTERISTIC c_lam_ad_sum_p "P component jump delay between two Adaptations out of Idle" VALUE 0x00716 _REC_VAL_20_u1 255. _CNV_A_R_LINEAR_____1_CM 0. 255. DISPLAY_IDENTIFIER C_LAM_AD_SUM_P FORMAT "%3.0" /end CHARACTERISTIC
/begin CHARACTERISTIC ip_mff_ad_add_fac "Multiplicative factor on additive Adaptation value during warm-up" MAP 0x069a8 _REC_MAP_20_u1_u1_u2 0.99610001 _CNV_A_R_LINEAR_____29_CM 0. 0.99610001 DISPLAY_IDENTIFIER IP_MFF_AD_ADD_FAC FORMAT "%5.3"
 /begin AXIS_DESCR COM_AXIS tco _CNV_A_R_LINEAR_____12_CM 5 -48. 142.5 FORMAT "%5.1" AXIS_PTS_REF ldpm_tco_1_mff_ad /end AXIS_DESCR
 /begin AXIS_DESCR COM_AXIS online_dummy _CNV_A_R_LINEAR_____263_CM 5 -695. 694.97 FORMAT "%7.2" AXIS_PTS_REF ldp_mff_ad_add_mmv_2_mff_add /end AXIS_DESCR
/end CHARACTERISTIC
/begin CHARACTERISTIC ip_mff_ad_fac_fac "Multiplicative factor on multiplicative Adaptation value during warm-up" MAP 0x069c1 _REC_MAP_20_u1_u1_u2 0.99610001 _CNV_A_R_LINEAR_____29_CM 0. 0.99610001 DISPLAY_IDENTIFIER IP_MFF_AD_FAC_FAC FORMAT "%5.3"
 /begin AXIS_DESCR COM_AXIS tco _CNV_A_R_LINEAR_____12_CM 5 -48. 142.5 FORMAT "%5.1" AXIS_PTS_REF ldpm_tco_1_mff_ad /end AXIS_DESCR
 /begin AXIS_DESCR COM_AXIS online_dummy _CNV_A_R_LINEAR_____159_CM 5 -50. 49.99847412 FORMAT "%7.3" AXIS_PTS_REF ldp_mff_ad_fac_mmv_2_mff_fac /end AXIS_DESCR
/end CHARACTERISTIC
/begin CHARACTERISTIC c_n_mff_ad_add_max "Maximum engine speed for additive Adaptation value calculation" VALUE 0x00779 _REC_VAL_20_u1 8160. _CNV_A_R_LINEAR_____16_CM 0. 8160. DISPLAY_IDENTIFIER C_N_MFF_AD_ADD_MAX FORMAT "%4.0" /end CHARACTERISTIC
/begin CHARACTERISTIC c_maf_mff_ad_add_max "Maximum MAF for additive Adaptation value calculation" VALUE 0x016aa _REC_VAL_20_u2 1389. _CNV_A_R_LINEAR_____106_CM 0. 1389. DISPLAY_IDENTIFIER C_MAF_MFF_AD_ADD_MAX FORMAT "%7.2" /end CHARACTERISTIC
/begin CHARACTERISTIC c_mff_ad_add_min "Minimum value of adaptive additive factor for injection" VALUE 0x00422 _REC_VAL_20_s2 1388.978806 _CNV_A_R_LINEAR_____255_CM -694.5 694.478806 DISPLAY_IDENTIFIER C_MFF_AD_ADD_MIN FORMAT "%7.2" /end CHARACTERISTIC
/begin CHARACTERISTIC c_mff_ad_add_max "Maximum value of adaptive additive factor for injection" VALUE 0x00420 _REC_VAL_20_s2 1388.978806 _CNV_A_R_LINEAR_____255_CM -694.5 694.478806 DISPLAY_IDENTIFIER C_MFF_AD_ADD_MAX FORMAT "%7.2" /end CHARACTERISTIC
/begin CHARACTERISTIC id_t_mff_ad_add "Minimum time for next requested lambda Adaptation according to additive factor difference" CURVE 0x089d8 _REC_CUR_20_u2_u2 6553.5 _CNV_A_R_LINEAR_____24_CM 0. 6553.5 DISPLAY_IDENTIFIER ID_T_MFF_AD_ADD FORMAT "%6.1"
 /begin AXIS_DESCR COM_AXIS online_dummy _CNV_A_R_LINEAR_____263_CM 8 -695. 694.97 FORMAT "%7.2" AXIS_PTS_REF ldp_mff_ad_add_mmv_delta_add /end AXIS_DESCR
/end CHARACTERISTIC
/begin CHARACTERISTIC lc_mff_ad_add "Logical calibration to allow forced lambda-1 conditions for offset Adaptation" VALUE 0x00f58 _REC_VAL_20_u1 1. _CNV_A_R_LINEAR_____1_CM 0. 1. DISPLAY_IDENTIFIER LC_MFF_AD_ADD FORMAT "%2.0" /end CHARACTERISTIC
/begin MEASUREMENT lv_mff_ad_cdn "Boolean for time scheduler indicating good conditions for lambda Adaptation" UBYTE _CNV_S_2_RANGE______0_CM 1 100. 0. 1. DISPLAY_IDENTIFIER LV_MFF_AD_CDN ECU_ADDRESS 0x3fe007 /end MEASUREMENT
/begin CHARACTERISTIC c_t_mff_ad_min_max "Maximum time to set temporary end of Adaptation flag" VALUE 0x01872 _REC_VAL_20_u2 6553.5 _CNV_A_R_LINEAR_____24_CM 0. 6553.5 DISPLAY_IDENTIFIER C_T_MFF_AD_MIN_MAX FORMAT "%6.1" /end CHARACTERISTIC
/begin CHARACTERISTIC ip_mff_ad_fac "Weighting factor for MFF_AD_FAC versus N" CURVE 0x00cdd _REC_CUR_20_u1_u1 0.99610001 _CNV_A_R_LINEAR_____29_CM 0. 0.99610001 DISPLAY_IDENTIFIER IP_MFF_AD_FAC FORMAT "%5.3"
 /begin AXIS_DESCR COM_AXIS n_32 _CNV_A_R_LINEAR_____16_CM 6 0. 8160. FORMAT "%4.0" AXIS_PTS_REF ldpm_n_32_1_mff_ad /end AXIS_DESCR
/end CHARACTERISTIC
/begin CHARACTERISTIC ip_mff_ad_add "Weighting factor for MFF_AD_ADD versus N" CURVE 0x00cd7 _REC_CUR_20_u1_u1 1.99220002 _CNV_A_R_LINEAR_____39_CM 0. 1.99220002 DISPLAY_IDENTIFIER IP_MFF_AD_ADD FORMAT "%5.3"
 /begin AXIS_DESCR COM_AXIS n_32 _CNV_A_R_LINEAR_____16_CM 6 0. 8160. FORMAT "%4.0" AXIS_PTS_REF ldpm_n_32_1_mff_ad /end AXIS_DESCR
/end CHARACTERISTIC
/begin AXIS_PTS ldp_mff_ad_add_mmv_delta_add "" 0x10e12 online_dummy _REC_AXS_20_u2 1389.97 _CNV_A_R_LINEAR_____263_CM 8 -695. 694.97 DISPLAY_IDENTIFIER LDP_MFF_AD_ADD_MMV_DELTA_ADD FORMAT "%7.2" /end AXIS_PTS
/begin AXIS_PTS ldpm_tco_1_mff_ad "" 0x013c1 tco _REC_AXS_20_u1 190.5 _CNV_A_R_LINEAR_____12_CM 5 -48. 142.5 DISPLAY_IDENTIFIER LDPM_TCO_1_MFF_AD FORMAT "%5.1" /end AXIS_PTS
/begin AXIS_PTS ldp_mff_ad_add_mmv_2_mff_add "" 0x10e06 online_dummy _REC_AXS_20_u2 1389.97 _CNV_A_R_LINEAR_____263_CM 5 -695. 694.97 DISPLAY_IDENTIFIER LDP_MFF_AD_ADD_MMV_2_MFF_ADD FORMAT "%7.2" /end AXIS_PTS
/begin AXIS_PTS ldp_mff_ad_fac_mmv_2_mff_fac "" 0x10e24 online_dummy _REC_AXS_20_u2 99.99847412 _CNV_A_R_LINEAR_____159_CM 5 -50. 49.99847412 DISPLAY_IDENTIFIER LDP_MFF_AD_FAC_MMV_2_MFF_FAC FORMAT "%7.3" /end AXIS_PTS
/begin AXIS_PTS ldpm_n_32_1_mff_ad "" 0x01322 n_32 _REC_AXS_20_u1 8160. _CNV_A_R_LINEAR_____16_CM 6 0. 8160. DISPLAY_IDENTIFIER LDPM_N_32_1_MFF_AD FORMAT "%4.0" /end AXIS_PTS
/begin CHARACTERISTIC c_maf_mff_ad_fac_l_min "Minimum MAF for multiplicative Adaptation value calculation at lower area" VALUE 0x016ae _REC_VAL_20_u2 1389. _CNV_A_R_LINEAR_____106_CM 0. 1389. DISPLAY_IDENTIFIER C_MAF_MFF_AD_FAC_L_MIN FORMAT "%7.2" /end CHARACTERISTIC
/begin CHARACTERISTIC c_n_mff_ad_fac_h_min "Minimum engine speed for multiplicative Adaptation value calculation at higher area" VALUE 0x0077b _REC_VAL_20_u1 8160. _CNV_A_R_LINEAR_____16_CM 0. 8160. DISPLAY_IDENTIFIER C_N_MFF_AD_FAC_H_MIN FORMAT "%4.0" /end CHARACTERISTIC
/begin CHARACTERISTIC lc_mff_ad_fac_l "Logical calibration to allow forced lambda-1 conditions for gain Adaptation at lower area" VALUE 0x00f5a _REC_VAL_20_u1 1. _CNV_A_R_LINEAR_____1_CM 0. 1. DISPLAY_IDENTIFIER LC_MFF_AD_FAC_L FORMAT "%2.0" /end CHARACTERISTIC
/begin CHARACTERISTIC lc_mff_ad_fac_h "Logical calibration to allow forced lambda-1 conditions for gain Adaptation at higher area" VALUE 0x00f59 _REC_VAL_20_u1 1. _CNV_A_R_LINEAR_____1_CM 0. 1. DISPLAY_IDENTIFIER LC_MFF_AD_FAC_H FORMAT "%2.0" /end CHARACTERISTIC
/begin CHARACTERISTIC c_mff_ad_cor_crlc_is "Correlation constant  Lambdaadapatation at  LV_IS = 1" VALUE 0x0072f _REC_VAL_20_u1 0.99610001 _CNV_A_R_LINEAR_____29_CM 0. 0.99610001 DISPLAY_IDENTIFIER C_MFF_AD_COR_CRLC_IS FORMAT "%5.3" /end CHARACTERISTIC
/begin CHARACTERISTIC c_mff_ad_cor_crlc_h "Correlation constant  Lambda Adapatation at  the higher area" VALUE 0x0072e _REC_VAL_20_u1 0.99610001 _CNV_A_R_LINEAR_____29_CM 0. 0.99610001 DISPLAY_IDENTIFIER C_MFF_AD_COR_CRLC_H FORMAT "%5.3" /end CHARACTERISTIC
/begin CHARACTERISTIC c_mff_ad_fac_l_min "Minimum value of adaptive multiplicative factor for injection at lower area" VALUE 0x0042a _REC_VAL_20_s2 99.99847412 _CNV_A_R_LINEAR_____109_CM -50. 49.99847412 DISPLAY_IDENTIFIER C_MFF_AD_FAC_L_MIN FORMAT "%7.3" /end CHARACTERISTIC
/begin CHARACTERISTIC c_mff_ad_fac_h_min "Minimum value of adaptive multiplicative factor for injection at higher area" VALUE 0x00426 _REC_VAL_20_s2 99.99847412 _CNV_A_R_LINEAR_____109_CM -50. 49.99847412 DISPLAY_IDENTIFIER C_MFF_AD_FAC_H_MIN FORMAT "%7.3" /end CHARACTERISTIC
/begin CHARACTERISTIC c_mff_ad_fac_l_max "Maximum value of adaptive multiplicative factor for injection at lower area" VALUE 0x00428 _REC_VAL_20_s2 99.99847412 _CNV_A_R_LINEAR_____109_CM -50. 49.99847412 DISPLAY_IDENTIFIER C_MFF_AD_FAC_L_MAX FORMAT "%7.3" /end CHARACTERISTIC
/begin CHARACTERISTIC c_mff_ad_fac_h_max "Maximum value of adaptive multiplicative factor for injection at higher area" VALUE 0x00424 _REC_VAL_20_s2 99.99847412 _CNV_A_R_LINEAR_____109_CM -50. 49.99847412 DISPLAY_IDENTIFIER C_MFF_AD_FAC_H_MAX FORMAT "%7.3" /end CHARACTERISTIC
/begin CHARACTERISTIC c_n_mff_ad_fac_l_min "Minimum engine speed for multiplicative Adaptation value calculation at lower area" VALUE 0x0077c _REC_VAL_20_u1 8160. _CNV_A_R_LINEAR_____16_CM 0. 8160. DISPLAY_IDENTIFIER C_N_MFF_AD_FAC_L_MIN FORMAT "%4.0" /end CHARACTERISTIC
/begin CHARACTERISTIC c_n_mff_ad_fac_h_max "Maximum engine speed for multiplicative Adaptation value calculation at higher area" VALUE 0x0077a _REC_VAL_20_u1 8160. _CNV_A_R_LINEAR_____16_CM 0. 8160. DISPLAY_IDENTIFIER C_N_MFF_AD_FAC_H_MAX FORMAT "%4.0" /end CHARACTERISTIC
/begin CHARACTERISTIC c_maf_mff_ad_fac_h_max "Maximum MAF for multiplicative Adaptation value calculation at higher area" VALUE 0x016ac _REC_VAL_20_u2 1389. _CNV_A_R_LINEAR_____106_CM 0. 1389. DISPLAY_IDENTIFIER C_MAF_MFF_AD_FAC_H_MAX FORMAT "%7.2" /end CHARACTERISTIC
/begin CHARACTERISTIC c_maf_kgh_ad_fac_l "MAF_KGH threshold for consideration of only lower value MFF_AD_FAC_MMV_L" VALUE 0x0168a _REC_VAL_20_u2 2047.96875 _CNV_A_R_LINEAR_____113_CM 0. 2047.96875 DISPLAY_IDENTIFIER C_MAF_KGH_AD_FAC_L FORMAT "%7.2" /end CHARACTERISTIC
/begin CHARACTERISTIC c_maf_kgh_ad_fac_h "MAF_KGH threshold for consideration of only upper value MFF_AD_FAC_MMV_L" VALUE 0x01688 _REC_VAL_20_u2 2047.96875 _CNV_A_R_LINEAR_____113_CM 0. 2047.96875 DISPLAY_IDENTIFIER C_MAF_KGH_AD_FAC_H FORMAT "%7.2" /end CHARACTERISTIC
/begin CHARACTERISTIC id_t_mff_ad_fac_l "Minimum time for next requested lambda Adaptation according to multiplicative factor difference of lower area" CURVE 0x089f8 _REC_CUR_20_u2_u2 6553.5 _CNV_A_R_LINEAR_____24_CM 0. 6553.5 DISPLAY_IDENTIFIER ID_T_MFF_AD_FAC_L FORMAT "%6.1"
 /begin AXIS_DESCR COM_AXIS online_dummy _CNV_A_R_LINEAR_____159_CM 8 -50. 49.99847412 FORMAT "%7.3" AXIS_PTS_REF ldp_mff_ad_fac_mmv_delta_l /end AXIS_DESCR
/end CHARACTERISTIC
/begin CHARACTERISTIC id_t_mff_ad_fac_h "Minimum time for next requested lambda Adaptation according to multiplicative factor difference of higher area" CURVE 0x089e8 _REC_CUR_20_u2_u2 6553.5 _CNV_A_R_LINEAR_____24_CM 0. 6553.5 DISPLAY_IDENTIFIER ID_T_MFF_AD_FAC_H FORMAT "%6.1"
 /begin AXIS_DESCR COM_AXIS online_dummy _CNV_A_R_LINEAR_____159_CM 8 -50. 49.99847412 FORMAT "%7.3" AXIS_PTS_REF ldp_mff_ad_fac_mmv_delta_h /end AXIS_DESCR
/end CHARACTERISTIC
/begin AXIS_PTS ldp_mff_ad_fac_mmv_delta_h "" 0x10e30 online_dummy _REC_AXS_20_u2 99.99847412 _CNV_A_R_LINEAR_____159_CM 8 -50. 49.99847412 DISPLAY_IDENTIFIER LDP_MFF_AD_FAC_MMV_DELTA_H FORMAT "%7.3" /end AXIS_PTS
/begin AXIS_PTS ldp_mff_ad_fac_mmv_delta_l "" 0x10e42 online_dummy _REC_AXS_20_u2 99.99847412 _CNV_A_R_LINEAR_____159_CM 8 -50. 49.99847412 DISPLAY_IDENTIFIER LDP_MFF_AD_FAC_MMV_DELTA_L FORMAT "%7.3" /end AXIS_PTS
/begin AXIS_PTS ldp_n_32_maf_mff_ad_fac_l_max "" 0x010ad n_32 _REC_AXS_20_u1 816. _CNV_A_R_LINEAR_____16_CM 6 0. 8160. DISPLAY_IDENTIFIER LDP_N_32_MAF_MFF_AD_FAC_L_MAX FORMAT "%4.0" /end AXIS_PTS
/begin CHARACTERISTIC ip_maf_mff_ad_fac_l_max "Maximum MAF for multiplicative adaptive learning at lower area" CURVE 0x00cb9 _REC_CUR_20_u1_u1 1389. _CNV_A_R_LINEAR_____27_CM 0. 1389. DISPLAY_IDENTIFIER IP_MAF_MFF_AD_FAC_L_MAX FORMAT "%4.0"
 /begin AXIS_DESCR COM_AXIS n_32 _CNV_A_R_LINEAR_____16_CM 6 0. 8160. FORMAT "%4.0" AXIS_PTS_REF ldp_n_32_maf_mff_ad_fac_l_max /end AXIS_DESCR
/end CHARACTERISTIC
/begin AXIS_PTS ldpm_n_32_maf_mff_ad_fac_l_min "" 0x01373 n_32 _REC_AXS_20_u1 816. _CNV_A_R_LINEAR_____16_CM 6 0. 8160. DISPLAY_IDENTIFIER LDPM_N_32_MAF_MFF_AD_FAC_L_MIN FORMAT "%4.0" /end AXIS_PTS
/begin AXIS_PTS ldpm_n_32_maf_mff_ad_fac_h_min "" 0x0136c n_32 _REC_AXS_20_u1 816. _CNV_A_R_LINEAR_____16_CM 6 0. 8160. DISPLAY_IDENTIFIER LDPM_N_32_MAF_MFF_AD_FAC_H_MIN FORMAT "%4.0" /end AXIS_PTS
/begin CHARACTERISTIC ip_maf_mff_ad_fac_l_min "Minimum MAF for multiplicative adaptive learning at lower area" CURVE 0x00cbf _REC_CUR_20_u1_u1 1389. _CNV_A_R_LINEAR_____27_CM 0. 1389. DISPLAY_IDENTIFIER IP_MAF_MFF_AD_FAC_L_MIN FORMAT "%4.0"
 /begin AXIS_DESCR COM_AXIS n_32 _CNV_A_R_LINEAR_____16_CM 6 0. 8160. FORMAT "%4.0" AXIS_PTS_REF ldpm_n_32_maf_mff_ad_fac_l_min /end AXIS_DESCR
/end CHARACTERISTIC
/begin CHARACTERISTIC ip_maf_mff_ad_fac_h_min "Minimum MAF for multiplicative adaptive learning at higher area" CURVE 0x00cb3 _REC_CUR_20_u1_u1 1389. _CNV_A_R_LINEAR_____27_CM 0. 1389. DISPLAY_IDENTIFIER IP_MAF_MFF_AD_FAC_H_MIN FORMAT "%4.0"
 /begin AXIS_DESCR COM_AXIS n_32 _CNV_A_R_LINEAR_____16_CM 6 0. 8160. FORMAT "%4.0" AXIS_PTS_REF ldpm_n_32_maf_mff_ad_fac_h_min /end AXIS_DESCR
/end CHARACTERISTIC
/begin MEASUREMENT lam_bank_1.ls_act_chk_pl.bf.lv_req_lamb_sp_ls_act_test "Request for lambda coordination and canister purge for active plausibility test" ULONG _CNV_S_2_RANGE______0_CM 1 100. 0. 1. DISPLAY_IDENTIFIER LV_REQ_LAMB_SP_LS_ACT_TEST_1 ECU_ADDRESS 0x3fc454 BYTE_ORDER MSB_LAST BIT_MASK 0x80000000 /end MEASUREMENT
/begin MEASUREMENT lam_bank_1.ls_act_chk_pl.bf.lv_vls_down_afl "Monitoring sensor has detected lean " ULONG _CNV_S_2_RANGE______0_CM 1 100. 0. 1. DISPLAY_IDENTIFIER LV_VLS_DOWN_AFL_1 ECU_ADDRESS 0x3fc454 BYTE_ORDER MSB_LAST BIT_MASK 0x40000000 /end MEASUREMENT
/begin MEASUREMENT lam_bank_1.ls_act_chk_pl.bf.lv_vls_down_afr " Monitoring sensor has detected rich " ULONG _CNV_S_2_RANGE______0_CM 1 100. 0. 1. DISPLAY_IDENTIFIER LV_VLS_DOWN_AFR_1 ECU_ADDRESS 0x3fc454 BYTE_ORDER MSB_LAST BIT_MASK 0x20000000 /end MEASUREMENT
/begin MEASUREMENT lam_bank_1.ls_act_chk_pl.bf.lv_end_cyc_chk_ls_down "End of cycle of active test of downstream sensor" ULONG _CNV_S_2_RANGE______0_CM 1 100. 0. 1. DISPLAY_IDENTIFIER LV_END_CYC_CHK_LS_DOWN_1 ECU_ADDRESS 0x3fc454 BYTE_ORDER MSB_LAST BIT_MASK 0x10000000 /end MEASUREMENT
/begin MEASUREMENT lam_bank_1.ls_act_chk_pl.bf.lv_vls_down_maf_int_puc "Minimum mass air flow integral in puc reached" ULONG _CNV_S_2_RANGE______0_CM 1 100. 0. 1. DISPLAY_IDENTIFIER LV_VLS_DOWN_MAF_INT_PUC_1 ECU_ADDRESS 0x3fc454 BYTE_ORDER MSB_LAST BIT_MASK 0x8000000 /end MEASUREMENT
/begin MEASUREMENT lam_bank_1.ls_act_chk_pl.bf.lv_vls_down_maf_int "Minimum mass air flow integral outside of puc reached" ULONG _CNV_S_2_RANGE______0_CM 1 100. 0. 1. DISPLAY_IDENTIFIER LV_VLS_DOWN_MAF_INT_1 ECU_ADDRESS 0x3fc454 BYTE_ORDER MSB_LAST BIT_MASK 0x4000000 /end MEASUREMENT
/begin MEASUREMENT lam_bank_1.ls_act_chk_pl.lamb_sp_ls_act_test "Lambda set point for active plausibility test" UWORD _CNV_A_R_LINEAR_____269_CM 1 100. 0. 31.9990234 DISPLAY_IDENTIFIER LAMB_SP_LS_ACT_TEST_1 ECU_ADDRESS 0x3fc462 BYTE_ORDER MSB_LAST FORMAT "%10.7" /end MEASUREMENT
/begin MEASUREMENT lam_bank_1.ls_act_chk_pl.maf_int_puc_vls_down "Mass air flow integral in puc" UWORD _CNV_A_R_LINEAR_____270_CM 1 100. 0. 1820.42 DISPLAY_IDENTIFIER MAF_INT_PUC_VLS_DOWN_1 ECU_ADDRESS 0x3fc458 BYTE_ORDER MSB_LAST FORMAT "%7.2" /end MEASUREMENT
/begin MEASUREMENT lam_bank_1.ls_act_chk_pl.maf_int_vls_down "Mass air flow integral outside of puc" UWORD _CNV_A_R_LINEAR_____270_CM 1 100. 0. 1820.42 DISPLAY_IDENTIFIER MAF_INT_VLS_DOWN_1 ECU_ADDRESS 0x3fc45a BYTE_ORDER MSB_LAST FORMAT "%7.2" /end MEASUREMENT
/begin MEASUREMENT lam_bank_1.ls_act_chk_pl.maf_int_diag_afr "Mass air flow integral rich" UWORD _CNV_A_R_LINEAR_____270_CM 1 100. 0. 1820.42 DISPLAY_IDENTIFIER MAF_INT_DIAG_AFR_1 ECU_ADDRESS 0x3fc45e BYTE_ORDER MSB_LAST FORMAT "%7.2" /end MEASUREMENT
/begin MEASUREMENT lam_bank_1.ls_act_chk_pl.maf_int_diag_afl "Mass air flow integral lean" UWORD _CNV_A_R_LINEAR_____270_CM 1 100. 0. 1820.42 DISPLAY_IDENTIFIER MAF_INT_DIAG_AFL_1 ECU_ADDRESS 0x3fc45c BYTE_ORDER MSB_LAST FORMAT "%7.2" /end MEASUREMENT
/begin MEASUREMENT lam_bank_1.fsd_obd2.t_sum_max_fsd "Total duration over C_LAM_MAX_FSD" UWORD _CNV_A_R_LINEAR_____197_CM 1 100. 0. 1310.7 DISPLAY_IDENTIFIER T_SUM_MAX_FSD_1 ECU_ADDRESS 0x3fc23c BYTE_ORDER MSB_LAST FORMAT "%7.2" /end MEASUREMENT
/begin MEASUREMENT lam_bank_1.fsd_obd2.t_sum_min_fsd "Total duration over C_LAM_MIN_FSD" UWORD _CNV_A_R_LINEAR_____197_CM 1 100. 0. 1310.7 DISPLAY_IDENTIFIER T_SUM_MIN_FSD_1 ECU_ADDRESS 0x3fc240 BYTE_ORDER MSB_LAST FORMAT "%7.2" /end MEASUREMENT
/begin MEASUREMENT lam_bank_1.fsd_obd2.t_sum_end_diag_win_fsd "Time counter to set LV_END_DIAG_FSD_i" UWORD _CNV_A_R_LINEAR_____197_CM 1 100. 0. 1310.7 DISPLAY_IDENTIFIER T_SUM_END_DIAG_WIN_FSD_1 ECU_ADDRESS 0x3fc244 BYTE_ORDER MSB_LAST FORMAT "%7.2" /end MEASUREMENT
/begin MEASUREMENT lam_bank_1.fsd_obd2.t_sum_rst_fsd "Time counter to reset T_SUM_MAX_FSD_i and T_SUM_MIN_FSD_i" UWORD _CNV_A_R_LINEAR_____197_CM 1 100. 0. 1310.7 DISPLAY_IDENTIFIER T_SUM_RST_FSD_1 ECU_ADDRESS 0x3fc246 BYTE_ORDER MSB_LAST FORMAT "%7.2" /end MEASUREMENT
/begin MEASUREMENT lam_bank_1.lam_dly_prj.lv_inh_lam_dly "Activation condition for lambda trim control" UBYTE _CNV_S_2_RANGE______0_CM 1 100. 0. 1. DISPLAY_IDENTIFIER LV_INH_LAM_DLY_1 ECU_ADDRESS 0x3fc489 /end MEASUREMENT
/begin MEASUREMENT lam_bank_1.lam_dly_prj.vls_down_av "Filtered VLS_DOWN for input downstream fuel trim" UWORD _CNV_A_R_LINEAR_____3_CM 1 100. 0. 4.99511719 DISPLAY_IDENTIFIER VLS_DOWN_AV_1 ECU_ADDRESS 0x3fc48a BYTE_ORDER MSB_LAST FORMAT "%5.3" /end MEASUREMENT
/begin MEASUREMENT lam_bank_1.lsh_down_inci.lv_inh_lsh_down "Boolean flag indicating project specific application conditions for heating not met" UBYTE _CNV_S_2_RANGE______0_CM 1 100. 0. 1. DISPLAY_IDENTIFIER LV_INH_LSH_DOWN_1 ECU_ADDRESS 0x3fc344 /end MEASUREMENT
/begin MEASUREMENT lam_bank_1.lsh_down_inci.temp_ls_down_ini "Oxygen sensor temperature at start" SWORD _CNV_A_R_LINEAR_____280_CM 1 100. -2048. 2047.938 DISPLAY_IDENTIFIER TEMP_LS_DOWN_INI_1 ECU_ADDRESS 0x3fc346 BYTE_ORDER MSB_LAST FORMAT "%8.2" /end MEASUREMENT
/begin MEASUREMENT lam_bank_1.lam_ad.bf.lv_lam_adj_ad "logical value activates the shift of the lambda-controller" ULONG _CNV_S_2_RANGE______0_CM 1 100. 0. 1. DISPLAY_IDENTIFIER LV_LAM_ADJ_AD_1 ECU_ADDRESS 0x3fc248 BYTE_ORDER MSB_LAST BIT_MASK 0x80000000 /end MEASUREMENT
/begin MEASUREMENT lam_bank_1.lam_ad.bf.lv_lam_ad_stop "Logical variable indicates passing stop of the lambda Adaptation" ULONG _CNV_S_2_RANGE______0_CM 1 100. 0. 1. DISPLAY_IDENTIFIER LV_LAM_AD_STOP_1 ECU_ADDRESS 0x3fc248 BYTE_ORDER MSB_LAST BIT_MASK 0x40000000 /end MEASUREMENT
/begin MEASUREMENT lam_bank_1.lam_ad.bf.lv_mff_ad_fac_h_lim "Limitation of multiplicative adapted factor of upper area" ULONG _CNV_S_2_RANGE______0_CM 1 100. 0. 1. DISPLAY_IDENTIFIER LV_MFF_AD_FAC_LIM_1 ECU_ADDRESS 0x3fc248 BYTE_ORDER MSB_LAST BIT_MASK 0x10000000 /end MEASUREMENT
/begin MEASUREMENT lam_bank_1.lam_ad.bf.lv_mff_ad_add_lim "Limitation of additive adapted factor" ULONG _CNV_S_2_RANGE______0_CM 1 100. 0. 1. DISPLAY_IDENTIFIER LV_MFF_AD_ADD_LIM_1 ECU_ADDRESS 0x3fc248 BYTE_ORDER MSB_LAST BIT_MASK 0x8000000 /end MEASUREMENT
/begin MEASUREMENT lam_bank_1.lam_ad.bf.lv_mff_ad_fac_l_lim "Limitation of multiplicative adapted factor of lower area" ULONG _CNV_S_2_RANGE______0_CM 1 100. 0. 1. DISPLAY_IDENTIFIER LV_MFF_AD_FAC_L_LIM_1 ECU_ADDRESS 0x3fc248 BYTE_ORDER MSB_LAST BIT_MASK 0x20000000 /end MEASUREMENT
/begin MEASUREMENT lam_bank_1.lam_ad.mff_ad_add_mmv_rel "Relative additive adaptive factor" SWORD _CNV_A_R_LINEAR_____255_CM 1 100. -694.5 694.478806 DISPLAY_IDENTIFIER MFF_AD_ADD_MMV_REL_1 ECU_ADDRESS 0x3fc24c BYTE_ORDER MSB_LAST FORMAT "%7.2" /end MEASUREMENT
/begin MEASUREMENT lam_bank_1.lam_ad.mff_ad_add_mmv_rel_quo "Relative additive adaptive factor quotient" SWORD _CNV_A_R_LINEAR_____298_CM 1 100. -100. 99.99694824 DISPLAY_IDENTIFIER MFF_AD_ADD_MMV_REL_QUO_1 ECU_ADDRESS 0x3fc24e BYTE_ORDER MSB_LAST FORMAT "%8.3" /end MEASUREMENT
/begin MEASUREMENT lam_bank_1.lam_ad.mff_ad_fac_mmv_rel "Relative Multiplicative adaptive factor" SWORD _CNV_A_R_LINEAR_____109_CM 1 100. -50. 49.99847412 DISPLAY_IDENTIFIER MFF_AD_FAC_MMV_REL_1 ECU_ADDRESS 0x3fc256 BYTE_ORDER MSB_LAST FORMAT "%7.3" /end MEASUREMENT
/begin MEASUREMENT lam_bank_1.lam_ad.mff_ad_add_mmv "Additive adaptive factor" SWORD _CNV_A_R_LINEAR_____255_CM 1 100. -694.5 694.478806 DISPLAY_IDENTIFIER MFF_AD_ADD_MMV_1 ECU_ADDRESS 0x3fc250 BYTE_ORDER MSB_LAST FORMAT "%7.2" /end MEASUREMENT
/begin MEASUREMENT lam_bank_1.lam_ad.mff_ad_fac_mmv "Multiplicative adaptive factor" SWORD _CNV_A_R_LINEAR_____109_CM 1 100. -50. 49.99847412 DISPLAY_IDENTIFIER MFF_AD_FAC_MMV_1 ECU_ADDRESS 0x3fc258 BYTE_ORDER MSB_LAST FORMAT "%7.3" /end MEASUREMENT
/begin MEASUREMENT lam_bank_1.lam_ad.lam_adj_ad "output value for the lambda controller shift" SWORD _CNV_A_R_LINEAR_____109_CM 1 100. -50. 49.99847412 DISPLAY_IDENTIFIER LAM_ADJ_AD_1 ECU_ADDRESS 0x3fc26a BYTE_ORDER MSB_LAST FORMAT "%7.3" /end MEASUREMENT
/begin MEASUREMENT lam_bank_1.lam_ad.mff_ad_add_mmv_delta "Difference of additive adaptive factor to previous Adaptation" SWORD _CNV_A_R_LINEAR_____255_CM 1 100. -694.5 694.478806 DISPLAY_IDENTIFIER MFF_AD_ADD_MMV_DELTA_1 ECU_ADDRESS 0x3fc252 BYTE_ORDER MSB_LAST FORMAT "%7.2" /end MEASUREMENT
/begin MEASUREMENT lam_bank_1.lam_ad.mff_ad_add_mmv_delta_h_res "Difference of additive adaptive factor to previous Adaptation" SWORD _CNV_A_R_LINEAR_____299_CM 1 100. -10.85 10.85 DISPLAY_IDENTIFIER MFF_AD_ADD_MMV_DELTA_H_RES_1 ECU_ADDRESS 0x3fc254 BYTE_ORDER MSB_LAST FORMAT "%7.2" /end MEASUREMENT
/begin MEASUREMENT lam_bank_1.lam_ad.mff_ad_fac_mmv_delta_l "Difference of multiplicative adaptive factor of lower area to previous Adaptation" SWORD _CNV_A_R_LINEAR_____109_CM 1 100. -50. 49.99847412 DISPLAY_IDENTIFIER MFF_AD_FAC_MMV_DELTA_1 ECU_ADDRESS 0x3fc266 BYTE_ORDER MSB_LAST FORMAT "%7.3" /end MEASUREMENT
/begin MEASUREMENT lam_bank_1.lam_ad.mff_sae_ad_mmv_rel "Relative adaptive correction for cylinder bank i for scantool" SWORD _CNV_A_R_LINEAR_____298_CM 1 100. -100. 99.99694824 DISPLAY_IDENTIFIER MFF_SAE_AD_MMV_REL_1 ECU_ADDRESS 0x3fc272 BYTE_ORDER MSB_LAST FORMAT "%8.3" /end MEASUREMENT
/begin MEASUREMENT lam_bank_1.lam_ad.lam_ad_sum_p "Counter indicating the number of observed p jumps reported by the lambda controller" UBYTE _CNV_A_R_LINEAR_____1_CM 1 100. 1. 255. DISPLAY_IDENTIFIER LAM_AD_SUM_P_1 ECU_ADDRESS 0x3fc274 FORMAT "%3.0" /end MEASUREMENT
/begin MEASUREMENT lam_bank_1.lam_ad.state_mff_ad "State indicating the status of the lambda Adaptation, e.g. to concerned time scheduler with CP" UBYTE _CNV_S_8_STATE_MFF__300_CM 1 100. 0. 7. DISPLAY_IDENTIFIER STATE_MFF_AD_1 ECU_ADDRESS 0x3fc275 /end MEASUREMENT
/begin MEASUREMENT lam_bank_1.lam_ad.t_mff_ad_fac "Time indicating the time for next requested multiplicative lambda Adaptation" UWORD _CNV_A_R_LINEAR_____24_CM 1 100. 0. 6553.5 DISPLAY_IDENTIFIER T_MFF_AD_FAC_1 ECU_ADDRESS 0x3fc26e BYTE_ORDER MSB_LAST FORMAT "%6.1" /end MEASUREMENT
/begin MEASUREMENT lam_bank_1.lam_ad.t_mff_ad_add "Time indicating the time for next requested additive lambda Adaptation" UWORD _CNV_A_R_LINEAR_____24_CM 1 100. 0. 6553.5 DISPLAY_IDENTIFIER T_MFF_AD_ADD_1 ECU_ADDRESS 0x3fc270 BYTE_ORDER MSB_LAST FORMAT "%6.1" /end MEASUREMENT
/begin MEASUREMENT lam_bank_1.lam_ad.mff_ad_fac_mmv_delta_h "Difference of multiplicative adaptive factor of upper area to previous Adaptation" SWORD _CNV_A_R_LINEAR_____109_CM 1 100. -50. 49.99847412 DISPLAY_IDENTIFIER MFF_AD_FAC_MMV_DELTA_H_1 ECU_ADDRESS 0x3fc268 BYTE_ORDER MSB_LAST FORMAT "%7.3" /end MEASUREMENT
/begin MEASUREMENT lam_bank_1.lam_ad.mff_ad_fac_mmv_l "Multiplicative adaptive factor lower part load" SWORD _CNV_A_R_LINEAR_____109_CM 1 100. -50. 49.99847412 DISPLAY_IDENTIFIER MFF_AD_FAC_MMV_L_1 ECU_ADDRESS 0x3fc25c BYTE_ORDER MSB_LAST FORMAT "%7.3" /end MEASUREMENT
/begin MEASUREMENT lam_bank_1.lam_ad.mff_ad_fac_mmv_h "Multiplicative adaptive factor higher part load" SWORD _CNV_A_R_LINEAR_____109_CM 1 100. -50. 49.99847412 DISPLAY_IDENTIFIER MFF_AD_FAC_MMV_H_1 ECU_ADDRESS 0x3fc25e BYTE_ORDER MSB_LAST FORMAT "%7.3" /end MEASUREMENT
/begin MEASUREMENT lam_bank_1.lamb_scc.lamb_scc "Lambda setpoint at single cylinder cut off" UWORD _CNV_A_R_LINEAR_____164_CM 1 100. 0. 31.99902344 DISPLAY_IDENTIFIER LAMB_SCC_1 ECU_ADDRESS 0x3fc236 BYTE_ORDER MSB_LAST FORMAT "%7.4" /end MEASUREMENT
/begin MEASUREMENT lam_bank_1.cat_eff_act.lv_ls_cat_diag_cdn "Activation condidtions for O2 sensor and catalyst efficiency diagnosis" UBYTE _CNV_S_2_RANGE______0_CM 1 100. 0. 1. DISPLAY_IDENTIFIER LV_LS_CAT_DIAG_CDN_1 ECU_ADDRESS 0x3fc464 /end MEASUREMENT
/begin MEASUREMENT lam_bank_1.cat_eff_act.maf_int_cat_diag_dly "Air mass flow integral after conditions fulfilled for cat diag activation" UWORD _CNV_A_R_LINEAR_____270_CM 1 100. 0. 1820.42 DISPLAY_IDENTIFIER MAF_INT_CAT_DIAG_DLY_1 ECU_ADDRESS 0x3fc466 BYTE_ORDER MSB_LAST FORMAT "%7.2" /end MEASUREMENT
/begin MEASUREMENT lam_bank_1.lam_puc_inci.bf.lv_inh_int_puc "catalyst purge function inhibited" ULONG _CNV_S_2_RANGE______0_CM 1 100. 0. 1. DISPLAY_IDENTIFIER LV_INH_INT_PUC_1 ECU_ADDRESS 0x3fc47c BYTE_ORDER MSB_LAST BIT_MASK 0x40000000 /end MEASUREMENT
/begin MEASUREMENT lam_bank_1.lam_puc_inci.bf.lv_act_int_puc_afl "state of the enrichment function for pre and main cat balancing" ULONG _CNV_S_2_RANGE______0_CM 1 100. 0. 1. DISPLAY_IDENTIFIER LV_ACT_INT_PUC_AFL_1 ECU_ADDRESS 0x3fc47c BYTE_ORDER MSB_LAST BIT_MASK 0x80000000 /end MEASUREMENT
/begin MEASUREMENT lam_bank_1.lam_puc_inci.temp_main_cat "modeled or assumed temperature of main cat" UWORD _CNV_A_R_LINEAR_____302_CM 1 100. -33. 990.984375 DISPLAY_IDENTIFIER TEMP_MAIN_CAT_1 ECU_ADDRESS 0x3fc480 BYTE_ORDER MSB_LAST FORMAT "%6.2" /end MEASUREMENT
/begin MEASUREMENT lam_bank_1.lam_puc_inci.temp_pcat "modeled or assumed temperature of pre cat" UWORD _CNV_A_R_LINEAR_____302_CM 1 100. -33. 990.984375 DISPLAY_IDENTIFIER TEMP_PCAT_1 ECU_ADDRESS 0x3fc482 BYTE_ORDER MSB_LAST FORMAT "%6.2" /end MEASUREMENT
/begin MEASUREMENT lam_bank_1.lam_co.mff_ad_add_mmv_co "Intermediary lambda adaptation value, used for CO adjustment at idling, value to be stored" SWORD _CNV_A_R_LINEAR_____255_CM 1 100. -694.5 694.478806 DISPLAY_IDENTIFIER MFF_AD_ADD_MMV_CO_1 ECU_ADDRESS 0x3fc554 BYTE_ORDER MSB_LAST FORMAT "%7.2" /end MEASUREMENT
/begin MEASUREMENT lam_bank_1.lam_co.mff_ad_add_mmv_rel_co "Intermediary lambda adaptation value, used for CO adjustment at idling, input value for injection" SWORD _CNV_A_R_LINEAR_____255_CM 1 100. -694.5 694.478806 DISPLAY_IDENTIFIER MFF_AD_ADD_MMV_REL_CO_1 ECU_ADDRESS 0x3fc556 BYTE_ORDER MSB_LAST FORMAT "%7.2" /end MEASUREMENT
/begin MEASUREMENT lam_bank_2.ls_act_chk_pl.bf.lv_req_lamb_sp_ls_act_test "Request for lambda coordination and canister purge for active plausibility test" ULONG _CNV_S_2_RANGE______0_CM 1 100. 0. 1. DISPLAY_IDENTIFIER LV_REQ_LAMB_SP_LS_ACT_TEST_2 ECU_ADDRESS 0x3fc7b8 BYTE_ORDER MSB_LAST BIT_MASK 0x80000000 /end MEASUREMENT
/begin MEASUREMENT lam_bank_2.ls_act_chk_pl.bf.lv_vls_down_afl "Monitoring sensor has detected lean " ULONG _CNV_S_2_RANGE______0_CM 1 100. 0. 1. DISPLAY_IDENTIFIER LV_VLS_DOWN_AFL_2 ECU_ADDRESS 0x3fc7b8 BYTE_ORDER MSB_LAST BIT_MASK 0x40000000 /end MEASUREMENT
/begin MEASUREMENT lam_bank_2.ls_act_chk_pl.bf.lv_vls_down_afr " Monitoring sensor has detected rich " ULONG _CNV_S_2_RANGE______0_CM 1 100. 0. 1. DISPLAY_IDENTIFIER LV_VLS_DOWN_AFR_2 ECU_ADDRESS 0x3fc7b8 BYTE_ORDER MSB_LAST BIT_MASK 0x20000000 /end MEASUREMENT
/begin MEASUREMENT lam_bank_2.ls_act_chk_pl.bf.lv_end_cyc_chk_ls_down "End of cycle of active test of downstream sensor" ULONG _CNV_S_2_RANGE______0_CM 1 100. 0. 1. DISPLAY_IDENTIFIER LV_END_CYC_CHK_LS_DOWN_2 ECU_ADDRESS 0x3fc7b8 BYTE_ORDER MSB_LAST BIT_MASK 0x10000000 /end MEASUREMENT
/begin MEASUREMENT lam_bank_2.ls_act_chk_pl.bf.lv_vls_down_maf_int_puc "Minimum mass air flow integral in puc reached" ULONG _CNV_S_2_RANGE______0_CM 1 100. 0. 1. DISPLAY_IDENTIFIER LV_VLS_DOWN_MAF_INT_PUC_2 ECU_ADDRESS 0x3fc7b8 BYTE_ORDER MSB_LAST BIT_MASK 0x8000000 /end MEASUREMENT
/begin MEASUREMENT lam_bank_2.ls_act_chk_pl.bf.lv_vls_down_maf_int "Minimum mass air flow integral outside of puc reached" ULONG _CNV_S_2_RANGE______0_CM 1 100. 0. 1. DISPLAY_IDENTIFIER LV_VLS_DOWN_MAF_INT_2 ECU_ADDRESS 0x3fc7b8 BYTE_ORDER MSB_LAST BIT_MASK 0x4000000 /end MEASUREMENT
/begin MEASUREMENT lam_bank_2.ls_act_chk_pl.lamb_sp_ls_act_test "Lambda set point for active plausibility test" UWORD _CNV_A_R_LINEAR_____269_CM 1 100. 0. 31.9990234 DISPLAY_IDENTIFIER LAMB_SP_LS_ACT_TEST_2 ECU_ADDRESS 0x3fc7c6 BYTE_ORDER MSB_LAST FORMAT "%10.7" /end MEASUREMENT
/begin MEASUREMENT lam_bank_2.ls_act_chk_pl.maf_int_puc_vls_down "Mass air flow integral in puc" UWORD _CNV_A_R_LINEAR_____270_CM 1 100. 0. 1820.42 DISPLAY_IDENTIFIER MAF_INT_PUC_VLS_DOWN_2 ECU_ADDRESS 0x3fc7bc BYTE_ORDER MSB_LAST FORMAT "%7.2" /end MEASUREMENT
/begin MEASUREMENT lam_bank_2.ls_act_chk_pl.maf_int_vls_down "Mass air flow integral outside of puc" UWORD _CNV_A_R_LINEAR_____270_CM 1 100. 0. 1820.42 DISPLAY_IDENTIFIER MAF_INT_VLS_DOWN_2 ECU_ADDRESS 0x3fc7be BYTE_ORDER MSB_LAST FORMAT "%7.2" /end MEASUREMENT
/begin MEASUREMENT lam_bank_2.ls_act_chk_pl.maf_int_diag_afr "Mass air flow integral rich" UWORD _CNV_A_R_LINEAR_____270_CM 1 100. 0. 1820.42 DISPLAY_IDENTIFIER MAF_INT_DIAG_AFR_2 ECU_ADDRESS 0x3fc7c2 BYTE_ORDER MSB_LAST FORMAT "%7.2" /end MEASUREMENT
/begin MEASUREMENT lam_bank_2.ls_act_chk_pl.maf_int_diag_afl "Mass air flow integral lean" UWORD _CNV_A_R_LINEAR_____270_CM 1 100. 0. 1820.42 DISPLAY_IDENTIFIER MAF_INT_DIAG_AFL_2 ECU_ADDRESS 0x3fc7c0 BYTE_ORDER MSB_LAST FORMAT "%7.2" /end MEASUREMENT
/begin MEASUREMENT lam_bank_2.fsd_obd2.t_sum_max_fsd "Total duration over C_LAM_MAX_FSD" UWORD _CNV_A_R_LINEAR_____197_CM 1 100. 0. 1310.7 DISPLAY_IDENTIFIER T_SUM_MAX_FSD_2 ECU_ADDRESS 0x3fc5a0 BYTE_ORDER MSB_LAST FORMAT "%7.2" /end MEASUREMENT
/begin MEASUREMENT lam_bank_2.fsd_obd2.t_sum_min_fsd "Total duration over C_LAM_MIN_FSD" UWORD _CNV_A_R_LINEAR_____197_CM 1 100. 0. 1310.7 DISPLAY_IDENTIFIER T_SUM_MIN_FSD_2 ECU_ADDRESS 0x3fc5a4 BYTE_ORDER MSB_LAST FORMAT "%7.2" /end MEASUREMENT
/begin MEASUREMENT lam_bank_2.fsd_obd2.t_sum_end_diag_win_fsd "Time counter to set LV_END_DIAG_FSD_i" UWORD _CNV_A_R_LINEAR_____197_CM 1 100. 0. 1310.7 DISPLAY_IDENTIFIER T_SUM_END_DIAG_WIN_FSD_2 ECU_ADDRESS 0x3fc5a8 BYTE_ORDER MSB_LAST FORMAT "%7.2" /end MEASUREMENT
/begin MEASUREMENT lam_bank_2.fsd_obd2.t_sum_rst_fsd "Time counter to reset T_SUM_MAX_FSD_i and T_SUM_MIN_FSD_i" UWORD _CNV_A_R_LINEAR_____197_CM 1 100. 0. 1310.7 DISPLAY_IDENTIFIER T_SUM_RST_FSD_2 ECU_ADDRESS 0x3fc5aa BYTE_ORDER MSB_LAST FORMAT "%7.2" /end MEASUREMENT
/begin MEASUREMENT lam_bank_2.lam_dly_prj.lv_inh_lam_dly "Activation condition for lambda trim control" UBYTE _CNV_S_2_RANGE______0_CM 1 100. 0. 1. DISPLAY_IDENTIFIER LV_INH_LAM_DLY_2 ECU_ADDRESS 0x3fc7ed /end MEASUREMENT
/begin MEASUREMENT lam_bank_2.lam_dly_prj.vls_down_av "Filtered VLS_DOWN for input downstream fuel trim" UWORD _CNV_A_R_LINEAR_____3_CM 1 100. 0. 4.99511719 DISPLAY_IDENTIFIER VLS_DOWN_AV_2 ECU_ADDRESS 0x3fc7ee BYTE_ORDER MSB_LAST FORMAT "%5.3" /end MEASUREMENT
/begin MEASUREMENT lam_bank_2.lsh_down_inci.lv_inh_lsh_down "Boolean flag indicating project specific application conditions for heating not met" UBYTE _CNV_S_2_RANGE______0_CM 1 100. 0. 1. DISPLAY_IDENTIFIER LV_INH_LSH_DOWN_2 ECU_ADDRESS 0x3fc6a8 /end MEASUREMENT
/begin MEASUREMENT lam_bank_2.lsh_down_inci.temp_ls_down_ini "Oxygen sensor temperature at start" SWORD _CNV_A_R_LINEAR_____280_CM 1 100. -2048. 2047.938 DISPLAY_IDENTIFIER TEMP_LS_DOWN_INI_2 ECU_ADDRESS 0x3fc6aa BYTE_ORDER MSB_LAST FORMAT "%8.2" /end MEASUREMENT
/begin MEASUREMENT lam_bank_2.lam_ad.bf.lv_lam_adj_ad "logical value activates the shift of the lambda-controller" ULONG _CNV_S_2_RANGE______0_CM 1 100. 0. 1. DISPLAY_IDENTIFIER LV_LAM_ADJ_AD_2 ECU_ADDRESS 0x3fc5ac BYTE_ORDER MSB_LAST BIT_MASK 0x80000000 /end MEASUREMENT
/begin MEASUREMENT lam_bank_2.lam_ad.bf.lv_lam_ad_stop "Logical variable indicates passing stop of the lambda Adaptation" ULONG _CNV_S_2_RANGE______0_CM 1 100. 0. 1. DISPLAY_IDENTIFIER LV_LAM_AD_STOP_2 ECU_ADDRESS 0x3fc5ac BYTE_ORDER MSB_LAST BIT_MASK 0x40000000 /end MEASUREMENT
/begin MEASUREMENT lam_bank_2.lam_ad.bf.lv_mff_ad_fac_h_lim "Limitation of multiplicative adapted factor of upper area" ULONG _CNV_S_2_RANGE______0_CM 1 100. 0. 1. DISPLAY_IDENTIFIER LV_MFF_AD_FAC_LIM_2 ECU_ADDRESS 0x3fc5ac BYTE_ORDER MSB_LAST BIT_MASK 0x10000000 /end MEASUREMENT
/begin MEASUREMENT lam_bank_2.lam_ad.bf.lv_mff_ad_add_lim "Limitation of additive adapted factor" ULONG _CNV_S_2_RANGE______0_CM 1 100. 0. 1. DISPLAY_IDENTIFIER LV_MFF_AD_ADD_LIM_2 ECU_ADDRESS 0x3fc5ac BYTE_ORDER MSB_LAST BIT_MASK 0x8000000 /end MEASUREMENT
/begin MEASUREMENT lam_bank_2.lam_ad.bf.lv_mff_ad_fac_l_lim "Limitation of multiplicative adapted factor of lower area" ULONG _CNV_S_2_RANGE______0_CM 1 100. 0. 1. DISPLAY_IDENTIFIER LV_MFF_AD_FAC_L_LIM_2 ECU_ADDRESS 0x3fc5ac BYTE_ORDER MSB_LAST BIT_MASK 0x20000000 /end MEASUREMENT
/begin MEASUREMENT lam_bank_2.lam_ad.mff_ad_add_mmv_rel "Relative additive adaptive factor" SWORD _CNV_A_R_LINEAR_____255_CM 1 100. -694.5 694.478806 DISPLAY_IDENTIFIER MFF_AD_ADD_MMV_REL_2 ECU_ADDRESS 0x3fc5b0 BYTE_ORDER MSB_LAST FORMAT "%7.2" /end MEASUREMENT
/begin MEASUREMENT lam_bank_2.lam_ad.mff_ad_add_mmv_rel_quo "Relative additive adaptive factor quotient" SWORD _CNV_A_R_LINEAR_____298_CM 1 100. -100. 99.99694824 DISPLAY_IDENTIFIER MFF_AD_ADD_MMV_REL_QUO_2 ECU_ADDRESS 0x3fc5b2 BYTE_ORDER MSB_LAST FORMAT "%8.3" /end MEASUREMENT
/begin MEASUREMENT lam_bank_2.lam_ad.mff_ad_fac_mmv_rel "Relative Multiplicative adaptive factor" SWORD _CNV_A_R_LINEAR_____109_CM 1 100. -50. 49.99847412 DISPLAY_IDENTIFIER MFF_AD_FAC_MMV_REL_2 ECU_ADDRESS 0x3fc5ba BYTE_ORDER MSB_LAST FORMAT "%7.3" /end MEASUREMENT
/begin MEASUREMENT lam_bank_2.lam_ad.mff_ad_add_mmv "Additive adaptive factor" SWORD _CNV_A_R_LINEAR_____255_CM 1 100. -694.5 694.478806 DISPLAY_IDENTIFIER MFF_AD_ADD_MMV_2 ECU_ADDRESS 0x3fc5b4 BYTE_ORDER MSB_LAST FORMAT "%7.2" /end MEASUREMENT
/begin MEASUREMENT lam_bank_2.lam_ad.mff_ad_fac_mmv "Multiplicative adaptive factor" SWORD _CNV_A_R_LINEAR_____109_CM 1 100. -50. 49.99847412 DISPLAY_IDENTIFIER MFF_AD_FAC_MMV_2 ECU_ADDRESS 0x3fc5bc BYTE_ORDER MSB_LAST FORMAT "%7.3" /end MEASUREMENT
/begin MEASUREMENT lam_bank_2.lam_ad.lam_adj_ad "output value for the lambda controller shift" SWORD _CNV_A_R_LINEAR_____109_CM 1 100. -50. 49.99847412 DISPLAY_IDENTIFIER LAM_ADJ_AD_2 ECU_ADDRESS 0x3fc5ce BYTE_ORDER MSB_LAST FORMAT "%7.3" /end MEASUREMENT
/begin MEASUREMENT lam_bank_2.lam_ad.mff_ad_add_mmv_delta "Difference of additive adaptive factor to previous Adaptation" SWORD _CNV_A_R_LINEAR_____255_CM 1 100. -694.5 694.478806 DISPLAY_IDENTIFIER MFF_AD_ADD_MMV_DELTA_2 ECU_ADDRESS 0x3fc5b6 BYTE_ORDER MSB_LAST FORMAT "%7.2" /end MEASUREMENT
/begin MEASUREMENT lam_bank_2.lam_ad.mff_ad_add_mmv_delta_h_res "Difference of additive adaptive factor to previous Adaptation" SWORD _CNV_A_R_LINEAR_____299_CM 1 100. -10.85 10.85 DISPLAY_IDENTIFIER MFF_AD_ADD_MMV_DELTA_H_RES_2 ECU_ADDRESS 0x3fc5b8 BYTE_ORDER MSB_LAST FORMAT "%7.2" /end MEASUREMENT
/begin MEASUREMENT lam_bank_2.lam_ad.mff_ad_fac_mmv_delta_l "Difference of multiplicative adaptive factor of lower area to previous Adaptation" SWORD _CNV_A_R_LINEAR_____109_CM 1 100. -50. 49.99847412 DISPLAY_IDENTIFIER MFF_AD_FAC_MMV_DELTA_2 ECU_ADDRESS 0x3fc5ca BYTE_ORDER MSB_LAST FORMAT "%7.3" /end MEASUREMENT
/begin MEASUREMENT lam_bank_2.lam_ad.mff_sae_ad_mmv_rel "Relative adaptive correction for cylinder bank i for scantool" SWORD _CNV_A_R_LINEAR_____298_CM 1 100. -100. 99.99694824 DISPLAY_IDENTIFIER MFF_SAE_AD_MMV_REL_2 ECU_ADDRESS 0x3fc5d6 BYTE_ORDER MSB_LAST FORMAT "%8.3" /end MEASUREMENT
/begin MEASUREMENT lam_bank_2.lam_ad.lam_ad_sum_p "Counter indicating the number of observed p jumps reported by the lambda controller" UBYTE _CNV_A_R_LINEAR_____1_CM 1 100. 1. 255. DISPLAY_IDENTIFIER LAM_AD_SUM_P_2 ECU_ADDRESS 0x3fc5d8 FORMAT "%3.0" /end MEASUREMENT
/begin MEASUREMENT lam_bank_2.lam_ad.state_mff_ad "State indicating the status of the lambda Adaptation, e.g. to concerned time scheduler with CP" UBYTE _CNV_S_8_STATE_MFF__300_CM 1 100. 0. 7. DISPLAY_IDENTIFIER STATE_MFF_AD_2 ECU_ADDRESS 0x3fc5d9 /end MEASUREMENT
/begin MEASUREMENT lam_bank_2.lam_ad.t_mff_ad_fac "Time indicating the time for next requested multiplicative lambda Adaptation" UWORD _CNV_A_R_LINEAR_____24_CM 1 100. 0. 6553.5 DISPLAY_IDENTIFIER T_MFF_AD_FAC_2 ECU_ADDRESS 0x3fc5d2 BYTE_ORDER MSB_LAST FORMAT "%6.1" /end MEASUREMENT
/begin MEASUREMENT lam_bank_2.lam_ad.t_mff_ad_add "Time indicating the time for next requested additive lambda Adaptation" UWORD _CNV_A_R_LINEAR_____24_CM 1 100. 0. 6553.5 DISPLAY_IDENTIFIER T_MFF_AD_ADD_2 ECU_ADDRESS 0x3fc5d4 BYTE_ORDER MSB_LAST FORMAT "%6.1" /end MEASUREMENT
/begin MEASUREMENT lam_bank_2.lam_ad.mff_ad_fac_mmv_delta_h "Difference of multiplicative adaptive factor of upper area to previous Adaptation" SWORD _CNV_A_R_LINEAR_____109_CM 1 100. -50. 49.99847412 DISPLAY_IDENTIFIER MFF_AD_FAC_MMV_DELTA_H_2 ECU_ADDRESS 0x3fc5cc BYTE_ORDER MSB_LAST FORMAT "%7.3" /end MEASUREMENT
/begin MEASUREMENT lam_bank_2.lam_ad.mff_ad_fac_mmv_l "Multiplicative adaptive factor lower part load" SWORD _CNV_A_R_LINEAR_____109_CM 1 100. -50. 49.99847412 DISPLAY_IDENTIFIER MFF_AD_FAC_MMV_L_2 ECU_ADDRESS 0x3fc5c0 BYTE_ORDER MSB_LAST FORMAT "%7.3" /end MEASUREMENT
/begin MEASUREMENT lam_bank_2.lam_ad.mff_ad_fac_mmv_h "Multiplicative adaptive factor higher part load" SWORD _CNV_A_R_LINEAR_____109_CM 1 100. -50. 49.99847412 DISPLAY_IDENTIFIER MFF_AD_FAC_MMV_H_2 ECU_ADDRESS 0x3fc5c2 BYTE_ORDER MSB_LAST FORMAT "%7.3" /end MEASUREMENT
/begin MEASUREMENT lam_bank_2.lamb_scc.lamb_scc "Lambda setpoint at single cylinder cut off" UWORD _CNV_A_R_LINEAR_____164_CM 1 100. 0. 31.99902344 DISPLAY_IDENTIFIER LAMB_SCC_2 ECU_ADDRESS 0x3fc59a BYTE_ORDER MSB_LAST FORMAT "%7.4" /end MEASUREMENT
/begin MEASUREMENT lam_bank_2.cat_eff_act.lv_ls_cat_diag_cdn "Activation condidtions for O2 sensor and catalyst efficiency diagnosis" UBYTE _CNV_S_2_RANGE______0_CM 1 100. 0. 1. DISPLAY_IDENTIFIER LV_LS_CAT_DIAG_CDN_2 ECU_ADDRESS 0x3fc7c8 /end MEASUREMENT
/begin MEASUREMENT lam_bank_2.cat_eff_act.maf_int_cat_diag_dly "Air mass flow integral after conditions fulfilled for cat diag activation" UWORD _CNV_A_R_LINEAR_____270_CM 1 100. 0. 1820.42 DISPLAY_IDENTIFIER MAF_INT_CAT_DIAG_DLY_2 ECU_ADDRESS 0x3fc7ca BYTE_ORDER MSB_LAST FORMAT "%7.2" /end MEASUREMENT
/begin MEASUREMENT lam_bank_2.lam_puc_inci.bf.lv_inh_int_puc "catalyst purge function inhibited" ULONG _CNV_S_2_RANGE______0_CM 1 100. 0. 1. DISPLAY_IDENTIFIER LV_INH_INT_PUC_2 ECU_ADDRESS 0x3fc7e0 BYTE_ORDER MSB_LAST BIT_MASK 0x40000000 /end MEASUREMENT
/begin MEASUREMENT lam_bank_2.lam_puc_inci.bf.lv_act_int_puc_afl "state of the enrichment function for pre and main cat balancing" ULONG _CNV_S_2_RANGE______0_CM 1 100. 0. 1. DISPLAY_IDENTIFIER LV_ACT_INT_PUC_AFL_2 ECU_ADDRESS 0x3fc7e0 BYTE_ORDER MSB_LAST BIT_MASK 0x80000000 /end MEASUREMENT
/begin MEASUREMENT lam_bank_2.lam_puc_inci.temp_main_cat "modeled or assumed temperature of main cat" UWORD _CNV_A_R_LINEAR_____302_CM 1 100. -33. 990.984375 DISPLAY_IDENTIFIER TEMP_MAIN_CAT_2 ECU_ADDRESS 0x3fc7e4 BYTE_ORDER MSB_LAST FORMAT "%6.2" /end MEASUREMENT
/begin MEASUREMENT lam_bank_2.lam_puc_inci.temp_pcat "modeled or assumed temperature of pre cat" UWORD _CNV_A_R_LINEAR_____302_CM 1 100. -33. 990.984375 DISPLAY_IDENTIFIER TEMP_PCAT_2 ECU_ADDRESS 0x3fc7e6 BYTE_ORDER MSB_LAST FORMAT "%6.2" /end MEASUREMENT
/begin MEASUREMENT lam_bank_2.lam_co.mff_ad_add_mmv_co "Intermediary lambda adaptation value, used for CO adjustment at idling, value to be stored" SWORD _CNV_A_R_LINEAR_____255_CM 1 100. -694.5 694.478806 DISPLAY_IDENTIFIER MFF_AD_ADD_MMV_CO_2 ECU_ADDRESS 0x3fc8b8 BYTE_ORDER MSB_LAST FORMAT "%7.2" /end MEASUREMENT
/begin MEASUREMENT lam_bank_2.lam_co.mff_ad_add_mmv_rel_co "Intermediary lambda adaptation value, used for CO adjustment at idling, input value for injection" SWORD _CNV_A_R_LINEAR_____255_CM 1 100. -694.5 694.478806 DISPLAY_IDENTIFIER MFF_AD_ADD_MMV_REL_CO_2 ECU_ADDRESS 0x3fc8ba BYTE_ORDER MSB_LAST FORMAT "%7.2" /end MEASUREMENT
/begin CHARACTERISTIC ip_lamb_scc "lambda setpoint for single cylinder shut off" CURVE 0x0c412 _REC_CUR_20_u2_u1 31.99902344 _CNV_A_R_LINEAR_____164_CM 0. 31.99902344 DISPLAY_IDENTIFIER IP_LAMB_SCC FORMAT "%7.4"
 /begin AXIS_DESCR COM_AXIS tco _CNV_A_R_LINEAR_____12_CM 8 -48. 142.5 FORMAT "%5.1" AXIS_PTS_REF ldp_tco_ip_lamb_scc /end AXIS_DESCR
/end CHARACTERISTIC
/begin AXIS_PTS ldp_tco_ip_lamb_scc "" 0x07def tco _REC_AXS_20_u1 190.5 _CNV_A_R_LINEAR_____12_CM 8 -48. 142.5 DISPLAY_IDENTIFIER LDP_TCO_IP_LAMB_SCC FORMAT "%5.1" /end AXIS_PTS
/begin CHARACTERISTIC c_tco_act_puc_min "minimum TCO threshold for cat purge activation" VALUE 0x00854 _REC_VAL_20_u1 190.5 _CNV_A_R_LINEAR_____12_CM -48. 142.5 DISPLAY_IDENTIFIER C_TCO_ACT_PUC_MIN FORMAT "%5.1" /end CHARACTERISTIC
/begin CHARACTERISTIC c_n_max_cat_purge "maximum engine speed for cat purge" VALUE 0x00771 _REC_VAL_20_u1 8160. _CNV_A_R_LINEAR_____16_CM 0. 8160. DISPLAY_IDENTIFIER C_N_MAX_CAT_PURGE FORMAT "%4.0" /end CHARACTERISTIC
/begin CHARACTERISTIC c_temp_dif_pcat_main_cat "temperature difference between pre and main cat" VALUE 0x01900 _REC_VAL_20_u2 1507.3 _CNV_A_R_LINEAR_____262_CM -48. 1459.3 DISPLAY_IDENTIFIER C_TEMP_DIF_PCAT_MAIN_CAT FORMAT "%7.2" /end CHARACTERISTIC
/begin CHARACTERISTIC c_maf_cyl_act_int_puc_max "maximum MAF_CYL threshold for active cat purge function" VALUE 0x01642 _REC_VAL_20_u2 2047.96875 _CNV_A_R_LINEAR_____113_CM 0. 2047.96875 DISPLAY_IDENTIFIER C_MAF_CYL_ACT_INT_PUC_MAX FORMAT "%7.2" /end CHARACTERISTIC
/begin CHARACTERISTIC c_thd_vls_up_cat_purge "VLS_UP - threshold to inhibit cat purge function" VALUE 0x01914 _REC_VAL_20_u2 4.995 _CNV_A_R_LINEAR_____316_CM 0. 4.995 DISPLAY_IDENTIFIER C_THD_VLS_UP_CAT_PURGE FORMAT "%5.3" /end CHARACTERISTIC
/begin CHARACTERISTIC c_thd_delta_lamb_sp_puc "DELTA_LAMB_SP_PUC - threshold to inhibit cat purge function" VALUE 0x008bc _REC_VAL_20_u1 0.125 _CNV_A_R_LINEAR_____304_CM 0. 0.125 DISPLAY_IDENTIFIER C_THD_DELTA_LAMB_SP_PUC FORMAT "%5.3" /end CHARACTERISTIC
/begin CHARACTERISTIC c_tco_cur_on_ls_down_min "TCO-threshold for detection of R_DOWN_LS_i" VALUE 0x00861 _REC_VAL_20_u1 190.5 _CNV_A_R_LINEAR_____12_CM -48. 142.5 DISPLAY_IDENTIFIER C_TCO_CUR_ON_LS_DOWN_MIN FORMAT "%5.1" /end CHARACTERISTIC
/begin CHARACTERISTIC c_tco_cur_on_ls_up_min "TCO-threshold for detection of R_UP_LS_i" VALUE 0x00862 _REC_VAL_20_u1 190.5 _CNV_A_R_LINEAR_____12_CM -48. 142.5 DISPLAY_IDENTIFIER C_TCO_CUR_ON_LS_UP_MIN FORMAT "%5.1" /end CHARACTERISTIC
/begin CHARACTERISTIC c_temp_cat_down_ls_ready "Temperature threshold above which O2 sensor recognised as operatively ready" VALUE 0x018fa _REC_VAL_20_u2 1023.984375 _CNV_A_R_LINEAR_____302_CM -33. 990.984375 DISPLAY_IDENTIFIER C_TEMP_CAT_DOWN_LS_READY FORMAT "%5.2" /end CHARACTERISTIC
/begin CHARACTERISTIC c_vls_down_afl_ready "Lean VLS_xxxx_i threshold for operative readiness detection" VALUE 0x01a00 _REC_VAL_20_u2 4.99511719 _CNV_A_R_LINEAR_____3_CM 0. 4.99511719 DISPLAY_IDENTIFIER C_VLS_DOWN_AFL_READY FORMAT "%5.3" /end CHARACTERISTIC
/begin CHARACTERISTIC c_vls_down_afr_ready "Rich VLS_xxxx_i threshold for operative readiness detection" VALUE 0x01a04 _REC_VAL_20_u2 4.99511719 _CNV_A_R_LINEAR_____3_CM 0. 4.99511719 DISPLAY_IDENTIFIER C_VLS_DOWN_AFR_READY FORMAT "%5.3" /end CHARACTERISTIC
/begin CHARACTERISTIC c_maf_int_puc_max_down_ls_ready "Maximum MAF integral during PUC for operability reset\n" VALUE 0x01676 _REC_VAL_20_u2 1820.398 _CNV_A_R_LINEAR_____271_CM 0. 1820.398 DISPLAY_IDENTIFIER C_MAF_INT_PUC_MAX_DOWN_LS_READY FORMAT "%7.2" /end CHARACTERISTIC
/begin CHARACTERISTIC lc_lsh_down_1 "Boolean variable to enable oxygen sensor heating" VALUE 0x00f52 _REC_VAL_20_u1 1. _CNV_A_R_LINEAR_____22_CM 0. 1. DISPLAY_IDENTIFIER LC_LSH_DOWN_1 FORMAT "%1.0" /end CHARACTERISTIC
/begin CHARACTERISTIC lc_lsh_down_2 "Boolean variable to enable oxygen sensor heating" VALUE 0x00f53 _REC_VAL_20_u1 1. _CNV_A_R_LINEAR_____22_CM 0. 1. DISPLAY_IDENTIFIER LC_LSH_DOWN_2 FORMAT "%1.0" /end CHARACTERISTIC
/begin MEASUREMENT lv_dly_ls_ready "Logical variable set if delay time of operability detection has elapsed" UBYTE _CNV_S_2_RANGE______5_CM 1 100. 0. 1. DISPLAY_IDENTIFIER LV_DLY_LS_READY ECU_ADDRESS 0x3fe034 BIT_MASK 0x1 /end MEASUREMENT
/begin MEASUREMENT lv_t_min_ls "Logical variable set if delay time C_T_MIN_LS has elapsed" UBYTE _CNV_S_2_RANGE______0_CM 1 100. 0. 1. DISPLAY_IDENTIFIER LV_T_MIN_LS ECU_ADDRESS 0x3fe033 BIT_MASK 0x1 /end MEASUREMENT
/begin CHARACTERISTIC c_temp_min_ls_up "Exhaust gas temperature minimum for the detection of the limited sensor operability" VALUE 0x01902 _REC_VAL_20_u2 2047. _CNV_A_R_LINEAR_____7_CM 0. 2047. DISPLAY_IDENTIFIER C_TEMP_MIN_LS_UP FORMAT "%7.2" /end CHARACTERISTIC
/begin CHARACTERISTIC c_r_min_ls_ready "Internal resistance threshold for detection of operability" VALUE 0x01764 _REC_VAL_20_u2 65535. _CNV_A_R_LINEAR_____279_CM 0. 65535. DISPLAY_IDENTIFIER C_R_MIN_LS_READY FORMAT "%5.0" /end CHARACTERISTIC
/begin CHARACTERISTIC c_vls_afl_max_diag "rich VLS_UP_i threshold for detection of operability" VALUE 0x019e8 _REC_VAL_20_u2 4.99511719 _CNV_A_R_LINEAR_____3_CM 0. 4.99511719 DISPLAY_IDENTIFIER C_VLS_AFL_MAX_DIAG FORMAT "%5.3" /end CHARACTERISTIC
/begin CHARACTERISTIC c_vls_afr_min_diag "" VALUE 0x019f2 _REC_VAL_20_u2 4.99511719 _CNV_A_R_LINEAR_____3_CM 0. 4.99511719 DISPLAY_IDENTIFIER C_VLS_AFR_MIN_DIAG FORMAT "%5.3" /end CHARACTERISTIC
/begin CHARACTERISTIC id_t_dly_ls_ready "Delay time before starting detection of operability" CURVE 0x009fa _REC_CUR_20_u1_u1 76.2 _CNV_A_R_LINEAR_____325_CM 0.3 76.5 DISPLAY_IDENTIFIER ID_T_DLY_LS_READY FORMAT "%4.1"
 /begin AXIS_DESCR COM_AXIS tco_st _CNV_A_R_LINEAR_____12_CM 8 -48. 142.5 FORMAT "%5.1" AXIS_PTS_REF ldp_tco_st_t_dly_ls_ready /end AXIS_DESCR
/end CHARACTERISTIC
/begin AXIS_PTS ldp_tco_st_t_dly_ls_ready "" 0x07e39 tco_st _REC_AXS_20_u1 190.5 _CNV_A_R_LINEAR_____12_CM 8 -48. 142.5 DISPLAY_IDENTIFIER LDP_TCO_ST_T_DLY_LS_READY FORMAT "%5.1" /end AXIS_PTS
/begin MEASUREMENT lv_err_chk_ls_down_1 "Debounced failure in the downstream sensor" UBYTE _CNV_S_2_RANGE______5_CM 1 100. 0. 1. DISPLAY_IDENTIFIER LV_ERR_CHK_LS_DOWN_1 ECU_ADDRESS 0x3fbb54 BIT_MASK 0x1 /end MEASUREMENT
/begin MEASUREMENT lv_err_chk_ls_down_2 "Debounced failure in the downstream sensor" UBYTE _CNV_S_2_RANGE______5_CM 1 100. 0. 1. DISPLAY_IDENTIFIER LV_ERR_CHK_LS_DOWN_2 ECU_ADDRESS 0x3fbb58 BIT_MASK 0x1 /end MEASUREMENT
/begin CHARACTERISTIC c_vls_down_thd_afl_diag "Lambda sensor voltage lean detected" VALUE 0x01a1e _REC_VAL_20_u2 4.995 _CNV_A_R_LINEAR_____316_CM 0. 4.995 DISPLAY_IDENTIFIER C_VLS_DOWN_THD_AFL_DIAG FORMAT "%5.3" /end CHARACTERISTIC
/begin CHARACTERISTIC c_vls_down_thd_afr_diag "Lambda sensor voltage rich detected" VALUE 0x01a20 _REC_VAL_20_u2 4.995 _CNV_A_R_LINEAR_____316_CM 0. 4.995 DISPLAY_IDENTIFIER C_VLS_DOWN_THD_AFR_DIAG FORMAT "%5.3" /end CHARACTERISTIC
/begin CHARACTERISTIC c_maf_int_puc_vls_down "Threshold for mass air flow integral in puc" VALUE 0x0167c _REC_VAL_20_u2 1820.42 _CNV_A_R_LINEAR_____270_CM 0. 1820.42 DISPLAY_IDENTIFIER C_MAF_INT_PUC_VLS_DOWN FORMAT "%7.2" /end CHARACTERISTIC
/begin CHARACTERISTIC c_maf_int_vls_down "Threshold for mass air flow integral outside of puc" VALUE 0x01686 _REC_VAL_20_u2 1820.42 _CNV_A_R_LINEAR_____270_CM 0. 1820.42 DISPLAY_IDENTIFIER C_MAF_INT_VLS_DOWN FORMAT "%7.2" /end CHARACTERISTIC
/begin CHARACTERISTIC c_maf_int_afr_max_diag "Threshold for mass air flow integral rich" VALUE 0x01658 _REC_VAL_20_u2 1820.42 _CNV_A_R_LINEAR_____270_CM 0. 1820.42 DISPLAY_IDENTIFIER C_MAF_INT_AFR_MAX_DIAG FORMAT "%7.2" /end CHARACTERISTIC
/begin CHARACTERISTIC c_maf_int_afl_max_diag "Threshold for mass air flow integral lean" VALUE 0x01656 _REC_VAL_20_u2 1820.42 _CNV_A_R_LINEAR_____270_CM 0. 1820.42 DISPLAY_IDENTIFIER C_MAF_INT_AFL_MAX_DIAG FORMAT "%7.2" /end CHARACTERISTIC
/begin CHARACTERISTIC c_t_dly_ls_diag_min "Start of diagnosis after lambda sensor normal operation" VALUE 0x017fc _REC_VAL_20_u2 6553.5 _CNV_A_R_LINEAR_____24_CM 0. 6553.5 DISPLAY_IDENTIFIER C_T_DLY_LS_DIAG_MIN FORMAT "%6.1" /end CHARACTERISTIC
/begin CHARACTERISTIC c_tco_vls_down_diag_min "Minimum tco temperature for starting the diagnosis" VALUE 0x008ac _REC_VAL_20_u1 190.5 _CNV_A_R_LINEAR_____12_CM -48. 142.5 DISPLAY_IDENTIFIER C_TCO_VLS_DOWN_DIAG_MIN FORMAT "%5.1" /end CHARACTERISTIC
/begin CHARACTERISTIC c_t_ast_vls_down_diag "Time after start for interrogation of the mass air flow integrals" VALUE 0x017c0 _REC_VAL_20_u2 6553.5 _CNV_A_R_LINEAR_____24_CM 0. 6553.5 DISPLAY_IDENTIFIER C_T_AST_VLS_DOWN_DIAG FORMAT "%6.1" /end CHARACTERISTIC
/begin CHARACTERISTIC c_lamb_sp_ls_act_afr "Max. lambda set point for rich fault detection" VALUE 0x0160e _REC_VAL_20_u2 31.9990234 _CNV_A_R_LINEAR_____269_CM 0. 31.9990234 DISPLAY_IDENTIFIER C_LAMB_SP_LS_ACT_AFR FORMAT "%10.7" /end CHARACTERISTIC
/begin CHARACTERISTIC c_lamb_sp_ls_act_afl "Min. lambda set point for rich fault detection" VALUE 0x0160c _REC_VAL_20_u2 31.9990234 _CNV_A_R_LINEAR_____269_CM 0. 31.9990234 DISPLAY_IDENTIFIER C_LAMB_SP_LS_ACT_AFL FORMAT "%10.7" /end CHARACTERISTIC
/begin MEASUREMENT fmy_ram_dyn[0].ctr_frc "Frequency counter of failure N" UBYTE _CNV_A_R_LINEAR_____1_CM 1 100. 0. 255. DISPLAY_IDENTIFIER CTR_FRC_0 ECU_ADDRESS 0x3fb7a6 FORMAT "%3.0" /end MEASUREMENT
/begin MEASUREMENT fmy_ram_dyn[0].ctr_wup_cyc "Counter for warm-up cycle" UBYTE _CNV_A_R_LINEAR_____1_CM 1 100. 0. 255. DISPLAY_IDENTIFIER CTR_WUP_CYC_0 ECU_ADDRESS 0x3fb7a7 FORMAT "%3.0" /end MEASUREMENT
/begin MEASUREMENT fmy_ram_dyn[0].ctr_dc "Counter for driving cycle" UBYTE _CNV_A_R_LINEAR_____1_CM 1 100. 0. 255. DISPLAY_IDENTIFIER CTR_DC_0 ECU_ADDRESS 0x3fb7a8 FORMAT "%3.0" /end MEASUREMENT
/begin MEASUREMENT fmy_ram_dyn[0].err_info_dyn "" UWORD _CNV_S_2_RANGE______2_R_CM 1 100. 0. 255. DISPLAY_IDENTIFIER ERR_INFO_DYN ECU_ADDRESS 0x3fb7a4 BYTE_ORDER MSB_LAST /end MEASUREMENT
/begin MEASUREMENT fmy_ram_dyn[0].err_info_dyn.bit_5 "" UWORD _CNV_S_2_RANGE______191_CM 1 100. 0. 1. DISPLAY_IDENTIFIER LV_ERR_DC_0 ECU_ADDRESS 0x3fb7a4 BYTE_ORDER MSB_LAST BIT_MASK 0x20 /end MEASUREMENT
/begin MEASUREMENT fmy_ram_dyn[0].err_info_dyn.bit_6 "" UWORD _CNV_S_2_RANGE______2_R_CM 1 100. 0. 255. DISPLAY_IDENTIFIER LV_ERR_TMP_0 ECU_ADDRESS 0x3fb7a4 BYTE_ORDER MSB_LAST BIT_MASK 0x40 /end MEASUREMENT
/begin MEASUREMENT fmy_ram_dyn[0].err_info_dyn.bit_8 "" UWORD _CNV_S_2_RANGE______2_R_CM 1 100. 0. 255. DISPLAY_IDENTIFIER LV_ERR_DISA_0 ECU_ADDRESS 0x3fb7a4 BYTE_ORDER MSB_LAST BIT_MASK 0x100 /end MEASUREMENT
/begin MEASUREMENT fmy_ram_dyn[0].err_info_dyn.bit_9 "" UWORD _CNV_S_2_RANGE______2_R_CM 1 100. 0. 255. DISPLAY_IDENTIFIER LV_DC_MAX_0 ECU_ADDRESS 0x3fb7a4 BYTE_ORDER MSB_LAST BIT_MASK 0x200 /end MEASUREMENT
/begin MEASUREMENT fmy_ram_dyn[0].err_info_dyn.bit_7 "" UWORD _CNV_S_2_RANGE______2_R_CM 1 100. 0. 255. DISPLAY_IDENTIFIER LV_ERR_CFM_0 ECU_ADDRESS 0x3fb7a4 BYTE_ORDER MSB_LAST BIT_MASK 0x80 /end MEASUREMENT
/begin MEASUREMENT fmy_ram_dyn[0].err_info_dyn.bit_10 "" UWORD _CNV_S_2_RANGE______2_R_CM 1 100. 0. 255. DISPLAY_IDENTIFIER LV_ERR_MKD_0 ECU_ADDRESS 0x3fb7a4 BYTE_ORDER MSB_LAST BIT_MASK 0x400 /end MEASUREMENT
/begin MEASUREMENT fmy_ram_dyn[0].diag_inst "" UWORD _CNV_S_231_RANGE_DIAG_384_CM 1 100. 0. 230. DISPLAY_IDENTIFIER DIAG_INST_0 ECU_ADDRESS 0x3fb7a2 BYTE_ORDER MSB_LAST /end MEASUREMENT
/begin MEASUREMENT fmy_ram_dyn[1].ctr_frc "Frequency counter of failure N" UBYTE _CNV_A_R_LINEAR_____1_CM 1 100. 0. 255. DISPLAY_IDENTIFIER CTR_FRC_1 ECU_ADDRESS 0x3fb7b0 FORMAT "%3.0" /end MEASUREMENT
/begin MEASUREMENT fmy_ram_dyn[1].ctr_wup_cyc "Counter for warm-up cycle" UBYTE _CNV_A_R_LINEAR_____1_CM 1 100. 0. 255. DISPLAY_IDENTIFIER CTR_WUP_CYC_1 ECU_ADDRESS 0x3fb7b1 FORMAT "%3.0" /end MEASUREMENT
/begin MEASUREMENT fmy_ram_dyn[1].ctr_dc "Counter for driving cycle" UBYTE _CNV_A_R_LINEAR_____1_CM 1 100. 0. 255. DISPLAY_IDENTIFIER CTR_DC_1 ECU_ADDRESS 0x3fb7b2 FORMAT "%3.0" /end MEASUREMENT
/begin MEASUREMENT fmy_ram_dyn[1].err_info_dyn "" UWORD _CNV_S_2_RANGE______2_R_CM 1 100. 0. 255. DISPLAY_IDENTIFIER ERR_INFO_DYN ECU_ADDRESS 0x3fb7ae BYTE_ORDER MSB_LAST /end MEASUREMENT
/begin MEASUREMENT fmy_ram_dyn[1].err_info_dyn.bit_5 "" UWORD _CNV_S_2_RANGE______191_CM 1 100. 0. 1. DISPLAY_IDENTIFIER LV_ERR_DC_1 ECU_ADDRESS 0x3fb7ae BYTE_ORDER MSB_LAST BIT_MASK 0x20 /end MEASUREMENT
/begin MEASUREMENT fmy_ram_dyn[1].err_info_dyn.bit_6 "" UWORD _CNV_S_2_RANGE______2_R_CM 1 100. 0. 255. DISPLAY_IDENTIFIER LV_ERR_TMP_1 ECU_ADDRESS 0x3fb7ae BYTE_ORDER MSB_LAST BIT_MASK 0x40 /end MEASUREMENT
/begin MEASUREMENT fmy_ram_dyn[1].err_info_dyn.bit_8 "" UWORD _CNV_S_2_RANGE______2_R_CM 1 100. 0. 255. DISPLAY_IDENTIFIER LV_ERR_DISA_1 ECU_ADDRESS 0x3fb7ae BYTE_ORDER MSB_LAST BIT_MASK 0x100 /end MEASUREMENT
/begin MEASUREMENT fmy_ram_dyn[1].err_info_dyn.bit_9 "" UWORD _CNV_S_2_RANGE______2_R_CM 1 100. 0. 255. DISPLAY_IDENTIFIER LV_DC_MAX_1 ECU_ADDRESS 0x3fb7ae BYTE_ORDER MSB_LAST BIT_MASK 0x200 /end MEASUREMENT
/begin MEASUREMENT fmy_ram_dyn[1].err_info_dyn.bit_7 "" UWORD _CNV_S_2_RANGE______2_R_CM 1 100. 0. 255. DISPLAY_IDENTIFIER LV_ERR_CFM_1 ECU_ADDRESS 0x3fb7ae BYTE_ORDER MSB_LAST BIT_MASK 0x80 /end MEASUREMENT
/begin MEASUREMENT fmy_ram_dyn[1].err_info_dyn.bit_10 "" UWORD _CNV_S_2_RANGE______2_R_CM 1 100. 0. 255. DISPLAY_IDENTIFIER LV_ERR_MKD_1 ECU_ADDRESS 0x3fb7ae BYTE_ORDER MSB_LAST BIT_MASK 0x400 /end MEASUREMENT
/begin MEASUREMENT fmy_ram_dyn[1].diag_inst "" UWORD _CNV_S_231_RANGE_DIAG_384_CM 1 100. 0. 230. DISPLAY_IDENTIFIER DIAG_INST_1 ECU_ADDRESS 0x3fb7ac BYTE_ORDER MSB_LAST /end MEASUREMENT
/begin MEASUREMENT fmy_ram_dyn[2].ctr_frc "Frequency counter of failure N" UBYTE _CNV_A_R_LINEAR_____1_CM 1 100. 0. 255. DISPLAY_IDENTIFIER CTR_FRC_2 ECU_ADDRESS 0x3fb7ba FORMAT "%3.0" /end MEASUREMENT
/begin MEASUREMENT fmy_ram_dyn[2].ctr_wup_cyc "Counter for warm-up cycle" UBYTE _CNV_A_R_LINEAR_____1_CM 1 100. 0. 255. DISPLAY_IDENTIFIER CTR_WUP_CYC_2 ECU_ADDRESS 0x3fb7bb FORMAT "%3.0" /end MEASUREMENT
/begin MEASUREMENT fmy_ram_dyn[2].ctr_dc "Counter for driving cycle" UBYTE _CNV_A_R_LINEAR_____1_CM 1 100. 0. 255. DISPLAY_IDENTIFIER CTR_DC_2 ECU_ADDRESS 0x3fb7bc FORMAT "%3.0" /end MEASUREMENT
/begin MEASUREMENT fmy_ram_dyn[2].err_info_dyn "" UWORD _CNV_S_2_RANGE______2_R_CM 1 100. 0. 255. DISPLAY_IDENTIFIER ERR_INFO_DYN ECU_ADDRESS 0x3fb7b8 BYTE_ORDER MSB_LAST /end MEASUREMENT
/begin MEASUREMENT fmy_ram_dyn[2].err_info_dyn.bit_5 "" UWORD _CNV_S_2_RANGE______191_CM 1 100. 0. 1. DISPLAY_IDENTIFIER LV_ERR_DC_2 ECU_ADDRESS 0x3fb7b8 BYTE_ORDER MSB_LAST BIT_MASK 0x20 /end MEASUREMENT
/begin MEASUREMENT fmy_ram_dyn[2].err_info_dyn.bit_6 "" UWORD _CNV_S_2_RANGE______2_R_CM 1 100. 0. 255. DISPLAY_IDENTIFIER LV_ERR_TMP_2 ECU_ADDRESS 0x3fb7b8 BYTE_ORDER MSB_LAST BIT_MASK 0x40 /end MEASUREMENT
/begin MEASUREMENT fmy_ram_dyn[2].err_info_dyn.bit_8 "" UWORD _CNV_S_2_RANGE______2_R_CM 1 100. 0. 255. DISPLAY_IDENTIFIER LV_ERR_DISA_2 ECU_ADDRESS 0x3fb7b8 BYTE_ORDER MSB_LAST BIT_MASK 0x100 /end MEASUREMENT
/begin MEASUREMENT fmy_ram_dyn[2].err_info_dyn.bit_9 "" UWORD _CNV_S_2_RANGE______2_R_CM 1 100. 0. 255. DISPLAY_IDENTIFIER LV_DC_MAX_2 ECU_ADDRESS 0x3fb7b8 BYTE_ORDER MSB_LAST BIT_MASK 0x200 /end MEASUREMENT
/begin MEASUREMENT fmy_ram_dyn[2].err_info_dyn.bit_7 "" UWORD _CNV_S_2_RANGE______2_R_CM 1 100. 0. 255. DISPLAY_IDENTIFIER LV_ERR_CFM_2 ECU_ADDRESS 0x3fb7b8 BYTE_ORDER MSB_LAST BIT_MASK 0x80 /end MEASUREMENT
/begin MEASUREMENT fmy_ram_dyn[2].err_info_dyn.bit_10 "" UWORD _CNV_S_2_RANGE______2_R_CM 1 100. 0. 255. DISPLAY_IDENTIFIER LV_ERR_MKD_2 ECU_ADDRESS 0x3fb7b8 BYTE_ORDER MSB_LAST BIT_MASK 0x400 /end MEASUREMENT
/begin MEASUREMENT fmy_ram_dyn[2].diag_inst "" UWORD _CNV_S_231_RANGE_DIAG_384_CM 1 100. 0. 230. DISPLAY_IDENTIFIER DIAG_INST_2 ECU_ADDRESS 0x3fb7b6 BYTE_ORDER MSB_LAST /end MEASUREMENT
/begin MEASUREMENT fmy_ram_dyn[3].ctr_frc "Frequency counter of failure N" UBYTE _CNV_A_R_LINEAR_____1_CM 1 100. 0. 255. DISPLAY_IDENTIFIER CTR_FRC_3 ECU_ADDRESS 0x3fb7c4 FORMAT "%3.0" /end MEASUREMENT
/begin MEASUREMENT fmy_ram_dyn[3].ctr_wup_cyc "Counter for warm-up cycle" UBYTE _CNV_A_R_LINEAR_____1_CM 1 100. 0. 255. DISPLAY_IDENTIFIER CTR_WUP_CYC_3 ECU_ADDRESS 0x3fb7c5 FORMAT "%3.0" /end MEASUREMENT
/begin MEASUREMENT fmy_ram_dyn[3].ctr_dc "Counter for driving cycle" UBYTE _CNV_A_R_LINEAR_____1_CM 1 100. 0. 255. DISPLAY_IDENTIFIER CTR_DC_3 ECU_ADDRESS 0x3fb7c6 FORMAT "%3.0" /end MEASUREMENT
/begin MEASUREMENT fmy_ram_dyn[3].err_info_dyn "" UWORD _CNV_S_2_RANGE______2_R_CM 1 100. 0. 255. DISPLAY_IDENTIFIER ERR_INFO_DYN ECU_ADDRESS 0x3fb7c2 BYTE_ORDER MSB_LAST /end MEASUREMENT
/begin MEASUREMENT fmy_ram_dyn[3].err_info_dyn.bit_5 "" UWORD _CNV_S_2_RANGE______191_CM 1 100. 0. 1. DISPLAY_IDENTIFIER LV_ERR_DC_3 ECU_ADDRESS 0x3fb7c2 BYTE_ORDER MSB_LAST BIT_MASK 0x20 /end MEASUREMENT
/begin MEASUREMENT fmy_ram_dyn[3].err_info_dyn.bit_6 "" UWORD _CNV_S_2_RANGE______2_R_CM 1 100. 0. 255. DISPLAY_IDENTIFIER LV_ERR_TMP_3 ECU_ADDRESS 0x3fb7c2 BYTE_ORDER MSB_LAST BIT_MASK 0x40 /end MEASUREMENT
/begin MEASUREMENT fmy_ram_dyn[3].err_info_dyn.bit_8 "" UWORD _CNV_S_2_RANGE______2_R_CM 1 100. 0. 255. DISPLAY_IDENTIFIER LV_ERR_DISA_3 ECU_ADDRESS 0x3fb7c2 BYTE_ORDER MSB_LAST BIT_MASK 0x100 /end MEASUREMENT
/begin MEASUREMENT fmy_ram_dyn[3].err_info_dyn.bit_9 "" UWORD _CNV_S_2_RANGE______2_R_CM 1 100. 0. 255. DISPLAY_IDENTIFIER LV_DC_MAX_3 ECU_ADDRESS 0x3fb7c2 BYTE_ORDER MSB_LAST BIT_MASK 0x200 /end MEASUREMENT
/begin MEASUREMENT fmy_ram_dyn[3].err_info_dyn.bit_7 "" UWORD _CNV_S_2_RANGE______2_R_CM 1 100. 0. 255. DISPLAY_IDENTIFIER LV_ERR_CFM_3 ECU_ADDRESS 0x3fb7c2 BYTE_ORDER MSB_LAST BIT_MASK 0x80 /end MEASUREMENT
/begin MEASUREMENT fmy_ram_dyn[3].err_info_dyn.bit_10 "" UWORD _CNV_S_2_RANGE______2_R_CM 1 100. 0. 255. DISPLAY_IDENTIFIER LV_ERR_MKD_3 ECU_ADDRESS 0x3fb7c2 BYTE_ORDER MSB_LAST BIT_MASK 0x400 /end MEASUREMENT
/begin MEASUREMENT fmy_ram_dyn[3].diag_inst "" UWORD _CNV_S_231_RANGE_DIAG_384_CM 1 100. 0. 230. DISPLAY_IDENTIFIER DIAG_INST_3 ECU_ADDRESS 0x3fb7c0 BYTE_ORDER MSB_LAST /end MEASUREMENT
/begin MEASUREMENT fmy_ram_dyn[4].ctr_frc "Frequency counter of failure N" UBYTE _CNV_A_R_LINEAR_____1_CM 1 100. 0. 255. DISPLAY_IDENTIFIER CTR_FRC_4 ECU_ADDRESS 0x3fb7ce FORMAT "%3.0" /end MEASUREMENT
/begin MEASUREMENT fmy_ram_dyn[4].ctr_wup_cyc "Counter for warm-up cycle" UBYTE _CNV_A_R_LINEAR_____1_CM 1 100. 0. 255. DISPLAY_IDENTIFIER CTR_WUP_CYC_4 ECU_ADDRESS 0x3fb7cf FORMAT "%3.0" /end MEASUREMENT
/begin MEASUREMENT fmy_ram_dyn[4].ctr_dc "Counter for driving cycle" UBYTE _CNV_A_R_LINEAR_____1_CM 1 100. 0. 255. DISPLAY_IDENTIFIER CTR_DC_4 ECU_ADDRESS 0x3fb7d0 FORMAT "%3.0" /end MEASUREMENT
/begin MEASUREMENT fmy_ram_dyn[4].err_info_dyn "" UWORD _CNV_S_2_RANGE______2_R_CM 1 100. 0. 255. DISPLAY_IDENTIFIER ERR_INFO_DYN ECU_ADDRESS 0x3fb7cc BYTE_ORDER MSB_LAST /end MEASUREMENT
/begin MEASUREMENT fmy_ram_dyn[4].err_info_dyn.bit_5 "" UWORD _CNV_S_2_RANGE______191_CM 1 100. 0. 1. DISPLAY_IDENTIFIER LV_ERR_DC_4 ECU_ADDRESS 0x3fb7cc BYTE_ORDER MSB_LAST BIT_MASK 0x20 /end MEASUREMENT
/begin MEASUREMENT fmy_ram_dyn[4].err_info_dyn.bit_6 "" UWORD _CNV_S_2_RANGE______2_R_CM 1 100. 0. 255. DISPLAY_IDENTIFIER LV_ERR_TMP_4 ECU_ADDRESS 0x3fb7cc BYTE_ORDER MSB_LAST BIT_MASK 0x40 /end MEASUREMENT
/begin MEASUREMENT fmy_ram_dyn[4].err_info_dyn.bit_8 "" UWORD _CNV_S_2_RANGE______2_R_CM 1 100. 0. 255. DISPLAY_IDENTIFIER LV_ERR_DISA_4 ECU_ADDRESS 0x3fb7cc BYTE_ORDER MSB_LAST BIT_MASK 0x100 /end MEASUREMENT
/begin MEASUREMENT fmy_ram_dyn[4].err_info_dyn.bit_9 "" UWORD _CNV_S_2_RANGE______2_R_CM 1 100. 0. 255. DISPLAY_IDENTIFIER LV_DC_MAX_4 ECU_ADDRESS 0x3fb7cc BYTE_ORDER MSB_LAST BIT_MASK 0x200 /end MEASUREMENT
/begin MEASUREMENT fmy_ram_dyn[4].err_info_dyn.bit_7 "" UWORD _CNV_S_2_RANGE______2_R_CM 1 100. 0. 255. DISPLAY_IDENTIFIER LV_ERR_CFM_4 ECU_ADDRESS 0x3fb7cc BYTE_ORDER MSB_LAST BIT_MASK 0x80 /end MEASUREMENT
/begin MEASUREMENT fmy_ram_dyn[4].err_info_dyn.bit_10 "" UWORD _CNV_S_2_RANGE______2_R_CM 1 100. 0. 255. DISPLAY_IDENTIFIER LV_ERR_MKD_4 ECU_ADDRESS 0x3fb7cc BYTE_ORDER MSB_LAST BIT_MASK 0x400 /end MEASUREMENT
/begin MEASUREMENT fmy_ram_dyn[4].diag_inst "" UWORD _CNV_S_231_RANGE_DIAG_384_CM 1 100. 0. 230. DISPLAY_IDENTIFIER DIAG_INST_4 ECU_ADDRESS 0x3fb7ca BYTE_ORDER MSB_LAST /end MEASUREMENT
/begin MEASUREMENT fmy_ram_dyn[5].ctr_frc "Frequency counter of failure N" UBYTE _CNV_A_R_LINEAR_____1_CM 1 100. 0. 255. DISPLAY_IDENTIFIER CTR_FRC_5 ECU_ADDRESS 0x3fb7d8 FORMAT "%3.0" /end MEASUREMENT
/begin MEASUREMENT fmy_ram_dyn[5].ctr_wup_cyc "Counter for warm-up cycle" UBYTE _CNV_A_R_LINEAR_____1_CM 1 100. 0. 255. DISPLAY_IDENTIFIER CTR_WUP_CYC_5 ECU_ADDRESS 0x3fb7d9 FORMAT "%3.0" /end MEASUREMENT
/begin MEASUREMENT fmy_ram_dyn[5].ctr_dc "Counter for driving cycle" UBYTE _CNV_A_R_LINEAR_____1_CM 1 100. 0. 255. DISPLAY_IDENTIFIER CTR_DC_5 ECU_ADDRESS 0x3fb7da FORMAT "%3.0" /end MEASUREMENT
/begin MEASUREMENT fmy_ram_dyn[5].err_info_dyn "" UWORD _CNV_S_2_RANGE______2_R_CM 1 100. 0. 255. DISPLAY_IDENTIFIER ERR_INFO_DYN ECU_ADDRESS 0x3fb7d6 BYTE_ORDER MSB_LAST /end MEASUREMENT
/begin MEASUREMENT fmy_ram_dyn[5].err_info_dyn.bit_5 "" UWORD _CNV_S_2_RANGE______191_CM 1 100. 0. 1. DISPLAY_IDENTIFIER LV_ERR_DC_5 ECU_ADDRESS 0x3fb7d6 BYTE_ORDER MSB_LAST BIT_MASK 0x20 /end MEASUREMENT
/begin MEASUREMENT fmy_ram_dyn[5].err_info_dyn.bit_6 "" UWORD _CNV_S_2_RANGE______2_R_CM 1 100. 0. 255. DISPLAY_IDENTIFIER LV_ERR_TMP_5 ECU_ADDRESS 0x3fb7d6 BYTE_ORDER MSB_LAST BIT_MASK 0x40 /end MEASUREMENT
/begin MEASUREMENT fmy_ram_dyn[5].err_info_dyn.bit_8 "" UWORD _CNV_S_2_RANGE______2_R_CM 1 100. 0. 255. DISPLAY_IDENTIFIER LV_ERR_DISA_5 ECU_ADDRESS 0x3fb7d6 BYTE_ORDER MSB_LAST BIT_MASK 0x100 /end MEASUREMENT
/begin MEASUREMENT fmy_ram_dyn[5].err_info_dyn.bit_9 "" UWORD _CNV_S_2_RANGE______2_R_CM 1 100. 0. 255. DISPLAY_IDENTIFIER LV_DC_MAX_5 ECU_ADDRESS 0x3fb7d6 BYTE_ORDER MSB_LAST BIT_MASK 0x200 /end MEASUREMENT
/begin MEASUREMENT fmy_ram_dyn[5].err_info_dyn.bit_7 "" UWORD _CNV_S_2_RANGE______2_R_CM 1 100. 0. 255. DISPLAY_IDENTIFIER LV_ERR_CFM_5 ECU_ADDRESS 0x3fb7d6 BYTE_ORDER MSB_LAST BIT_MASK 0x80 /end MEASUREMENT
/begin MEASUREMENT fmy_ram_dyn[5].err_info_dyn.bit_10 "" UWORD _CNV_S_2_RANGE______2_R_CM 1 100. 0. 255. DISPLAY_IDENTIFIER LV_ERR_MKD_5 ECU_ADDRESS 0x3fb7d6 BYTE_ORDER MSB_LAST BIT_MASK 0x400 /end MEASUREMENT
/begin MEASUREMENT fmy_ram_dyn[5].diag_inst "" UWORD _CNV_S_231_RANGE_DIAG_384_CM 1 100. 0. 230. DISPLAY_IDENTIFIER DIAG_INST_5 ECU_ADDRESS 0x3fb7d4 BYTE_ORDER MSB_LAST /end MEASUREMENT
/begin MEASUREMENT fmy_ram_dyn[6].ctr_frc "Frequency counter of failure N" UBYTE _CNV_A_R_LINEAR_____1_CM 1 100. 0. 255. DISPLAY_IDENTIFIER CTR_FRC_6 ECU_ADDRESS 0x3fb7e2 FORMAT "%3.0" /end MEASUREMENT
/begin MEASUREMENT fmy_ram_dyn[6].ctr_wup_cyc "Counter for warm-up cycle" UBYTE _CNV_A_R_LINEAR_____1_CM 1 100. 0. 255. DISPLAY_IDENTIFIER CTR_WUP_CYC_6 ECU_ADDRESS 0x3fb7e3 FORMAT "%3.0" /end MEASUREMENT
/begin MEASUREMENT fmy_ram_dyn[6].ctr_dc "Counter for driving cycle" UBYTE _CNV_A_R_LINEAR_____1_CM 1 100. 0. 255. DISPLAY_IDENTIFIER CTR_DC_6 ECU_ADDRESS 0x3fb7e4 FORMAT "%3.0" /end MEASUREMENT
/begin MEASUREMENT fmy_ram_dyn[6].err_info_dyn "" UWORD _CNV_S_2_RANGE______2_R_CM 1 100. 0. 255. DISPLAY_IDENTIFIER ERR_INFO_DYN ECU_ADDRESS 0x3fb7e0 BYTE_ORDER MSB_LAST /end MEASUREMENT
/begin MEASUREMENT fmy_ram_dyn[6].err_info_dyn.bit_5 "" UWORD _CNV_S_2_RANGE______191_CM 1 100. 0. 1. DISPLAY_IDENTIFIER LV_ERR_DC_6 ECU_ADDRESS 0x3fb7e0 BYTE_ORDER MSB_LAST BIT_MASK 0x20 /end MEASUREMENT
/begin MEASUREMENT fmy_ram_dyn[6].err_info_dyn.bit_6 "" UWORD _CNV_S_2_RANGE______2_R_CM 1 100. 0. 255. DISPLAY_IDENTIFIER LV_ERR_TMP_6 ECU_ADDRESS 0x3fb7e0 BYTE_ORDER MSB_LAST BIT_MASK 0x40 /end MEASUREMENT
/begin MEASUREMENT fmy_ram_dyn[6].err_info_dyn.bit_8 "" UWORD _CNV_S_2_RANGE______2_R_CM 1 100. 0. 255. DISPLAY_IDENTIFIER LV_ERR_DISA_6 ECU_ADDRESS 0x3fb7e0 BYTE_ORDER MSB_LAST BIT_MASK 0x100 /end MEASUREMENT
/begin MEASUREMENT fmy_ram_dyn[6].err_info_dyn.bit_9 "" UWORD _CNV_S_2_RANGE______2_R_CM 1 100. 0. 255. DISPLAY_IDENTIFIER LV_DC_MAX_6 ECU_ADDRESS 0x3fb7e0 BYTE_ORDER MSB_LAST BIT_MASK 0x200 /end MEASUREMENT
/begin MEASUREMENT fmy_ram_dyn[6].err_info_dyn.bit_7 "" UWORD _CNV_S_2_RANGE______2_R_CM 1 100. 0. 255. DISPLAY_IDENTIFIER LV_ERR_CFM_6 ECU_ADDRESS 0x3fb7e0 BYTE_ORDER MSB_LAST BIT_MASK 0x80 /end MEASUREMENT
/begin MEASUREMENT fmy_ram_dyn[6].err_info_dyn.bit_10 "" UWORD _CNV_S_2_RANGE______2_R_CM 1 100. 0. 255. DISPLAY_IDENTIFIER LV_ERR_MKD_6 ECU_ADDRESS 0x3fb7e0 BYTE_ORDER MSB_LAST BIT_MASK 0x400 /end MEASUREMENT
/begin MEASUREMENT fmy_ram_dyn[6].diag_inst "" UWORD _CNV_S_231_RANGE_DIAG_384_CM 1 100. 0. 230. DISPLAY_IDENTIFIER DIAG_INST_6 ECU_ADDRESS 0x3fb7de BYTE_ORDER MSB_LAST /end MEASUREMENT
/begin MEASUREMENT fmy_ram_dyn[7].ctr_frc "Frequency counter of failure N" UBYTE _CNV_A_R_LINEAR_____1_CM 1 100. 0. 255. DISPLAY_IDENTIFIER CTR_FRC_7 ECU_ADDRESS 0x3fb7ec FORMAT "%3.0" /end MEASUREMENT
/begin MEASUREMENT fmy_ram_dyn[7].ctr_wup_cyc "Counter for warm-up cycle" UBYTE _CNV_A_R_LINEAR_____1_CM 1 100. 0. 255. DISPLAY_IDENTIFIER CTR_WUP_CYC_7 ECU_ADDRESS 0x3fb7ed FORMAT "%3.0" /end MEASUREMENT
/begin MEASUREMENT fmy_ram_dyn[7].ctr_dc "Counter for driving cycle" UBYTE _CNV_A_R_LINEAR_____1_CM 1 100. 0. 255. DISPLAY_IDENTIFIER CTR_DC_7 ECU_ADDRESS 0x3fb7ee FORMAT "%3.0" /end MEASUREMENT
/begin MEASUREMENT fmy_ram_dyn[7].err_info_dyn "" UWORD _CNV_S_2_RANGE______2_R_CM 1 100. 0. 255. DISPLAY_IDENTIFIER ERR_INFO_DYN ECU_ADDRESS 0x3fb7ea BYTE_ORDER MSB_LAST /end MEASUREMENT
/begin MEASUREMENT fmy_ram_dyn[7].err_info_dyn.bit_5 "" UWORD _CNV_S_2_RANGE______191_CM 1 100. 0. 1. DISPLAY_IDENTIFIER LV_ERR_DC_7 ECU_ADDRESS 0x3fb7ea BYTE_ORDER MSB_LAST BIT_MASK 0x20 /end MEASUREMENT
/begin MEASUREMENT fmy_ram_dyn[7].err_info_dyn.bit_6 "" UWORD _CNV_S_2_RANGE______2_R_CM 1 100. 0. 255. DISPLAY_IDENTIFIER LV_ERR_TMP_7 ECU_ADDRESS 0x3fb7ea BYTE_ORDER MSB_LAST BIT_MASK 0x40 /end MEASUREMENT
/begin MEASUREMENT fmy_ram_dyn[7].err_info_dyn.bit_8 "" UWORD _CNV_S_2_RANGE______2_R_CM 1 100. 0. 255. DISPLAY_IDENTIFIER LV_ERR_DISA_7 ECU_ADDRESS 0x3fb7ea BYTE_ORDER MSB_LAST BIT_MASK 0x100 /end MEASUREMENT
/begin MEASUREMENT fmy_ram_dyn[7].err_info_dyn.bit_9 "" UWORD _CNV_S_2_RANGE______2_R_CM 1 100. 0. 255. DISPLAY_IDENTIFIER LV_DC_MAX_7 ECU_ADDRESS 0x3fb7ea BYTE_ORDER MSB_LAST BIT_MASK 0x200 /end MEASUREMENT
/begin MEASUREMENT fmy_ram_dyn[7].err_info_dyn.bit_7 "" UWORD _CNV_S_2_RANGE______2_R_CM 1 100. 0. 255. DISPLAY_IDENTIFIER LV_ERR_CFM_7 ECU_ADDRESS 0x3fb7ea BYTE_ORDER MSB_LAST BIT_MASK 0x80 /end MEASUREMENT
/begin MEASUREMENT fmy_ram_dyn[7].err_info_dyn.bit_10 "" UWORD _CNV_S_2_RANGE______2_R_CM 1 100. 0. 255. DISPLAY_IDENTIFIER LV_ERR_MKD_7 ECU_ADDRESS 0x3fb7ea BYTE_ORDER MSB_LAST BIT_MASK 0x400 /end MEASUREMENT
/begin MEASUREMENT fmy_ram_dyn[7].diag_inst "" UWORD _CNV_S_231_RANGE_DIAG_384_CM 1 100. 0. 230. DISPLAY_IDENTIFIER DIAG_INST_7 ECU_ADDRESS 0x3fb7e8 BYTE_ORDER MSB_LAST /end MEASUREMENT
/begin MEASUREMENT fmy_ram_dyn[8].ctr_frc "Frequency counter of failure N" UBYTE _CNV_A_R_LINEAR_____1_CM 1 100. 0. 255. DISPLAY_IDENTIFIER CTR_FRC_8 ECU_ADDRESS 0x3fb7f6 FORMAT "%3.0" /end MEASUREMENT
/begin MEASUREMENT fmy_ram_dyn[8].ctr_wup_cyc "Counter for warm-up cycle" UBYTE _CNV_A_R_LINEAR_____1_CM 1 100. 0. 255. DISPLAY_IDENTIFIER CTR_WUP_CYC_8 ECU_ADDRESS 0x3fb7f7 FORMAT "%3.0" /end MEASUREMENT
/begin MEASUREMENT fmy_ram_dyn[8].ctr_dc "Counter for driving cycle" UBYTE _CNV_A_R_LINEAR_____1_CM 1 100. 0. 255. DISPLAY_IDENTIFIER CTR_DC_8 ECU_ADDRESS 0x3fb7f8 FORMAT "%3.0" /end MEASUREMENT
/begin MEASUREMENT fmy_ram_dyn[8].err_info_dyn "" UWORD _CNV_S_2_RANGE______2_R_CM 1 100. 0. 255. DISPLAY_IDENTIFIER ERR_INFO_DYN ECU_ADDRESS 0x3fb7f4 BYTE_ORDER MSB_LAST /end MEASUREMENT
/begin MEASUREMENT fmy_ram_dyn[8].err_info_dyn.bit_5 "" UWORD _CNV_S_2_RANGE______191_CM 1 100. 0. 1. DISPLAY_IDENTIFIER LV_ERR_DC_8 ECU_ADDRESS 0x3fb7f4 BYTE_ORDER MSB_LAST BIT_MASK 0x20 /end MEASUREMENT
/begin MEASUREMENT fmy_ram_dyn[8].err_info_dyn.bit_6 "" UWORD _CNV_S_2_RANGE______2_R_CM 1 100. 0. 255. DISPLAY_IDENTIFIER LV_ERR_TMP_8 ECU_ADDRESS 0x3fb7f4 BYTE_ORDER MSB_LAST BIT_MASK 0x40 /end MEASUREMENT
/begin MEASUREMENT fmy_ram_dyn[8].err_info_dyn.bit_8 "" UWORD _CNV_S_2_RANGE______2_R_CM 1 100. 0. 255. DISPLAY_IDENTIFIER LV_ERR_DISA_8 ECU_ADDRESS 0x3fb7f4 BYTE_ORDER MSB_LAST BIT_MASK 0x100 /end MEASUREMENT
/begin MEASUREMENT fmy_ram_dyn[8].err_info_dyn.bit_9 "" UWORD _CNV_S_2_RANGE______2_R_CM 1 100. 0. 255. DISPLAY_IDENTIFIER LV_DC_MAX_8 ECU_ADDRESS 0x3fb7f4 BYTE_ORDER MSB_LAST BIT_MASK 0x200 /end MEASUREMENT
/begin MEASUREMENT fmy_ram_dyn[8].err_info_dyn.bit_7 "" UWORD _CNV_S_2_RANGE______2_R_CM 1 100. 0. 255. DISPLAY_IDENTIFIER LV_ERR_CFM_8 ECU_ADDRESS 0x3fb7f4 BYTE_ORDER MSB_LAST BIT_MASK 0x80 /end MEASUREMENT
/begin MEASUREMENT fmy_ram_dyn[8].err_info_dyn.bit_10 "" UWORD _CNV_S_2_RANGE______2_R_CM 1 100. 0. 255. DISPLAY_IDENTIFIER LV_ERR_MKD_8 ECU_ADDRESS 0x3fb7f4 BYTE_ORDER MSB_LAST BIT_MASK 0x400 /end MEASUREMENT
/begin MEASUREMENT fmy_ram_dyn[8].diag_inst "" UWORD _CNV_S_231_RANGE_DIAG_384_CM 1 100. 0. 230. DISPLAY_IDENTIFIER DIAG_INST_8 ECU_ADDRESS 0x3fb7f2 BYTE_ORDER MSB_LAST /end MEASUREMENT
/begin MEASUREMENT fmy_ram_dyn[9].ctr_frc "Frequency counter of failure N" UBYTE _CNV_A_R_LINEAR_____1_CM 1 100. 0. 255. DISPLAY_IDENTIFIER CTR_FRC_9 ECU_ADDRESS 0x3fb800 FORMAT "%3.0" /end MEASUREMENT
/begin MEASUREMENT fmy_ram_dyn[9].ctr_wup_cyc "Counter for warm-up cycle" UBYTE _CNV_A_R_LINEAR_____1_CM 1 100. 0. 255. DISPLAY_IDENTIFIER CTR_WUP_CYC_9 ECU_ADDRESS 0x3fb801 FORMAT "%3.0" /end MEASUREMENT
/begin MEASUREMENT fmy_ram_dyn[9].ctr_dc "Counter for driving cycle" UBYTE _CNV_A_R_LINEAR_____1_CM 1 100. 0. 255. DISPLAY_IDENTIFIER CTR_DC_9 ECU_ADDRESS 0x3fb802 FORMAT "%3.0" /end MEASUREMENT
/begin MEASUREMENT fmy_ram_dyn[9].err_info_dyn "" UWORD _CNV_S_2_RANGE______2_R_CM 1 100. 0. 255. DISPLAY_IDENTIFIER ERR_INFO_DYN ECU_ADDRESS 0x3fb7fe BYTE_ORDER MSB_LAST /end MEASUREMENT
/begin MEASUREMENT fmy_ram_dyn[9].err_info_dyn.bit_5 "" UWORD _CNV_S_2_RANGE______191_CM 1 100. 0. 1. DISPLAY_IDENTIFIER LV_ERR_DC_9 ECU_ADDRESS 0x3fb7fe BYTE_ORDER MSB_LAST BIT_MASK 0x20 /end MEASUREMENT
/begin MEASUREMENT fmy_ram_dyn[9].err_info_dyn.bit_6 "" UWORD _CNV_S_2_RANGE______2_R_CM 1 100. 0. 255. DISPLAY_IDENTIFIER LV_ERR_TMP_9 ECU_ADDRESS 0x3fb7fe BYTE_ORDER MSB_LAST BIT_MASK 0x40 /end MEASUREMENT
/begin MEASUREMENT fmy_ram_dyn[9].err_info_dyn.bit_8 "" UWORD _CNV_S_2_RANGE______2_R_CM 1 100. 0. 255. DISPLAY_IDENTIFIER LV_ERR_DISA_9 ECU_ADDRESS 0x3fb7fe BYTE_ORDER MSB_LAST BIT_MASK 0x100 /end MEASUREMENT
/begin MEASUREMENT fmy_ram_dyn[9].err_info_dyn.bit_9 "" UWORD _CNV_S_2_RANGE______2_R_CM 1 100. 0. 255. DISPLAY_IDENTIFIER LV_DC_MAX_9 ECU_ADDRESS 0x3fb7fe BYTE_ORDER MSB_LAST BIT_MASK 0x200 /end MEASUREMENT
/begin MEASUREMENT fmy_ram_dyn[9].err_info_dyn.bit_7 "" UWORD _CNV_S_2_RANGE______2_R_CM 1 100. 0. 255. DISPLAY_IDENTIFIER LV_ERR_CFM_9 ECU_ADDRESS 0x3fb7fe BYTE_ORDER MSB_LAST BIT_MASK 0x80 /end MEASUREMENT
/begin MEASUREMENT fmy_ram_dyn[9].err_info_dyn.bit_10 "" UWORD _CNV_S_2_RANGE______2_R_CM 1 100. 0. 255. DISPLAY_IDENTIFIER LV_ERR_MKD_9 ECU_ADDRESS 0x3fb7fe BYTE_ORDER MSB_LAST BIT_MASK 0x400 /end MEASUREMENT
/begin MEASUREMENT fmy_ram_dyn[9].diag_inst "" UWORD _CNV_S_231_RANGE_DIAG_384_CM 1 100. 0. 230. DISPLAY_IDENTIFIER DIAG_INST_9 ECU_ADDRESS 0x3fb7fc BYTE_ORDER MSB_LAST /end MEASUREMENT
/begin MEASUREMENT fmy_scdn_equ_fsd_2.ctr_scdn_equ_dc "" UBYTE _CNV_A_R_LINEAR_____1_CM 1 100. 0. 255. DISPLAY_IDENTIFIER CTR_SCDN_EQU_DC_FSD_2 ECU_ADDRESS 0x3fbbb2 FORMAT "%3.0" /end MEASUREMENT
/begin MEASUREMENT fmy_scdn_equ_fsd_2.scdn_info "" UBYTE _CNV_A_R_LINEAR_____1_CM 1 100. 0. 15. DISPLAY_IDENTIFIER SCDN_INFO_FSD_2 ECU_ADDRESS 0x3fbbb3 FORMAT "%2.0" /end MEASUREMENT
/begin MEASUREMENT fmy_scdn_equ_fsd_1.ctr_scdn_equ_dc "" UBYTE _CNV_A_R_LINEAR_____1_CM 1 100. 0. 255. DISPLAY_IDENTIFIER CTR_SCDN_EQU_DC_FSD_1 ECU_ADDRESS 0x3fbba8 FORMAT "%3.0" /end MEASUREMENT
/begin MEASUREMENT fmy_scdn_equ_fsd_1.scdn_info "" UBYTE _CNV_A_R_LINEAR_____1_CM 1 100. 0. 15. DISPLAY_IDENTIFIER SCDN_INFO_FSD_1 ECU_ADDRESS 0x3fbba9 FORMAT "%2.0" /end MEASUREMENT
/begin MEASUREMENT fmy_scdn_equ_mis_1.ctr_scdn_equ_dc "" UBYTE _CNV_A_R_LINEAR_____1_CM 1 100. 0. 255. DISPLAY_IDENTIFIER CTR_SCDN_EQU_DC_MIS_1 ECU_ADDRESS 0x3fbbc6 FORMAT "%3.0" /end MEASUREMENT
/begin MEASUREMENT fmy_scdn_equ_mis_1.scdn_info "" UBYTE _CNV_A_R_LINEAR_____1_CM 1 100. 0. 15. DISPLAY_IDENTIFIER SCDN_INFO_MIS_1 ECU_ADDRESS 0x3fbbc7 FORMAT "%2.0" /end MEASUREMENT
/begin MEASUREMENT fmy_scdn_equ_mis_2.ctr_scdn_equ_dc "" UBYTE _CNV_A_R_LINEAR_____1_CM 1 100. 0. 255. DISPLAY_IDENTIFIER CTR_SCDN_EQU_DC_MIS_2 ECU_ADDRESS 0x3fbbd0 FORMAT "%3.0" /end MEASUREMENT
/begin MEASUREMENT fmy_scdn_equ_mis_2.scdn_info "" UBYTE _CNV_A_R_LINEAR_____1_CM 1 100. 0. 15. DISPLAY_IDENTIFIER SCDN_INFO_MIS_2 ECU_ADDRESS 0x3fbbd1 FORMAT "%2.0" /end MEASUREMENT
/begin MEASUREMENT fmy_scdn_equ_mis_3.ctr_scdn_equ_dc "" UBYTE _CNV_A_R_LINEAR_____1_CM 1 100. 0. 255. DISPLAY_IDENTIFIER CTR_SCDN_EQU_DC_MIS_3 ECU_ADDRESS 0x3fbbda FORMAT "%3.0" /end MEASUREMENT
/begin MEASUREMENT fmy_scdn_equ_mis_3.scdn_info "" UBYTE _CNV_A_R_LINEAR_____1_CM 1 100. 0. 15. DISPLAY_IDENTIFIER SCDN_INFO_MIS_3 ECU_ADDRESS 0x3fbbdb FORMAT "%2.0" /end MEASUREMENT
/begin MEASUREMENT fmy_scdn_equ_mis_4.ctr_scdn_equ_dc "" UBYTE _CNV_A_R_LINEAR_____1_CM 1 100. 0. 255. DISPLAY_IDENTIFIER CTR_SCDN_EQU_DC_MIS_4 ECU_ADDRESS 0x3fbbe4 FORMAT "%3.0" /end MEASUREMENT
/begin MEASUREMENT fmy_scdn_equ_mis_4.scdn_info "" UBYTE _CNV_A_R_LINEAR_____1_CM 1 100. 0. 15. DISPLAY_IDENTIFIER SCDN_INFO_MIS_4 ECU_ADDRESS 0x3fbbe5 FORMAT "%2.0" /end MEASUREMENT
/begin MEASUREMENT fmy_scdn_equ_mis_0.ctr_scdn_equ_dc "" UBYTE _CNV_A_R_LINEAR_____1_CM 1 100. 0. 255. DISPLAY_IDENTIFIER CTR_SCDN_EQU_DC_MIS_0 ECU_ADDRESS 0x3fbbbc FORMAT "%3.0" /end MEASUREMENT
/begin MEASUREMENT fmy_scdn_equ_mis_0.scdn_info "" UBYTE _CNV_A_R_LINEAR_____1_CM 1 100. 0. 15. DISPLAY_IDENTIFIER SCDN_INFO_MIS_0 ECU_ADDRESS 0x3fbbbd FORMAT "%2.0" /end MEASUREMENT
/begin MEASUREMENT fmy_scdn_equ_mis_5.ctr_scdn_equ_dc "" UBYTE _CNV_A_R_LINEAR_____1_CM 1 100. 0. 255. DISPLAY_IDENTIFIER CTR_SCDN_EQU_DC_MIS_5 ECU_ADDRESS 0x3fbbee FORMAT "%3.0" /end MEASUREMENT
/begin MEASUREMENT fmy_scdn_equ_mis_5.scdn_info "" UBYTE _CNV_A_R_LINEAR_____1_CM 1 100. 0. 15. DISPLAY_IDENTIFIER SCDN_INFO_MIS_5 ECU_ADDRESS 0x3fbbef FORMAT "%2.0" /end MEASUREMENT
/begin CHARACTERISTIC c_cl_max_cat_ls_diag "Maximum canister load to allow catalyst and O2 sensor diagnosis" VALUE 0x014ac _REC_VAL_20_u2 1.99996948 _CNV_A_R_LINEAR_____21_CM 0. 1.99996948 DISPLAY_IDENTIFIER C_CL_MAX_CAT_LS_DIAG FORMAT "%7.5" /end CHARACTERISTIC
/begin CHARACTERISTIC lc_ls_cat_diag_cdn_man_act "Flag to set diagnosis condition manually" VALUE 0x00f51 _REC_VAL_20_u1 1. _CNV_A_R_LINEAR_____1_CM 0. 1. DISPLAY_IDENTIFIER LC_LS_CAT_DIAG_CDN_MAN_ACT FORMAT "%2.0" /end CHARACTERISTIC
/begin CHARACTERISTIC ip_maf_lam_cat_min__n_32 "min. MAF threshold " CURVE 0x0c686 _REC_CUR_20_u2_u1 1389. _CNV_A_R_LINEAR_____106_CM 0. 1389. DISPLAY_IDENTIFIER IP_MAF_LAM_CAT_MIN__N_32 FORMAT "%7.2"
 /begin AXIS_DESCR COM_AXIS n_32 _CNV_A_R_LINEAR_____16_CM 6 0. 8160. FORMAT "%4.0" AXIS_PTS_REF ldpm_n_32__lam_cat /end AXIS_DESCR
/end CHARACTERISTIC
/begin CHARACTERISTIC ip_maf_lam_cat_max__n_32 "max MAF threshold for activation I-share" CURVE 0x0c67a _REC_CUR_20_u2_u1 1389. _CNV_A_R_LINEAR_____106_CM 0. 1389. DISPLAY_IDENTIFIER IP_MAF_LAM_CAT_MAX__N_32 FORMAT "%7.2"
 /begin AXIS_DESCR COM_AXIS n_32 _CNV_A_R_LINEAR_____16_CM 6 0. 8160. FORMAT "%4.0" AXIS_PTS_REF ldpm_n_32__lam_cat /end AXIS_DESCR
/end CHARACTERISTIC
/begin CHARACTERISTIC c_tco_min_cat "Min TCO threshold" VALUE 0x0087e _REC_VAL_20_u1 190.5 _CNV_A_R_LINEAR_____12_CM -48. 142.5 DISPLAY_IDENTIFIER C_TCO_MIN_CAT FORMAT "%5.1" /end CHARACTERISTIC
/begin CHARACTERISTIC c_temp_min_cat "min. TEMP_CAT theshold" VALUE 0x008ba _REC_VAL_20_u1 1020. _CNV_A_R_LINEAR_____177_CM -33. 987. DISPLAY_IDENTIFIER C_TEMP_MIN_CAT FORMAT "%3.0" /end CHARACTERISTIC
/begin CHARACTERISTIC c_temp_max_cat "max. TEMP_CAT theshold" VALUE 0x008b9 _REC_VAL_20_u1 1020. _CNV_A_R_LINEAR_____177_CM -33. 987. DISPLAY_IDENTIFIER C_TEMP_MAX_CAT FORMAT "%3.0" /end CHARACTERISTIC
/begin CHARACTERISTIC c_temp_hys_cat "hysterese after exceeding TEMP_CAT threshold " VALUE 0x008b8 _REC_VAL_20_u1 1020. _CNV_A_R_LINEAR_____385_CM 0. 1020. DISPLAY_IDENTIFIER C_TEMP_HYS_CAT FORMAT "%4.0" /end CHARACTERISTIC
/begin CHARACTERISTIC c_vs_min_cat "min. VS threshold" VALUE 0x00954 _REC_VAL_20_u1 255. _CNV_A_R_LINEAR_____23_CM 0. 255. DISPLAY_IDENTIFIER C_VS_MIN_CAT FORMAT "%3.0" /end CHARACTERISTIC
/begin CHARACTERISTIC c_vs_max_cat "max. VS threshold" VALUE 0x00948 _REC_VAL_20_u1 255. _CNV_A_R_LINEAR_____23_CM 0. 255. DISPLAY_IDENTIFIER C_VS_MAX_CAT FORMAT "%3.0" /end CHARACTERISTIC
/begin CHARACTERISTIC c_amp_min_cat_ls_diag "min. ambient pressure threshold " VALUE 0x0148a _REC_VAL_20_u2 5434. _CNV_A_R_LINEAR_____49_CM 0. 5434. DISPLAY_IDENTIFIER C_AMP_MIN_CAT_LS_DIAG FORMAT "%7.2" /end CHARACTERISTIC
/begin AXIS_PTS ldpm_n_32__lam_cat "" 0x0134c n_32 _REC_AXS_20_u1 8160. _CNV_A_R_LINEAR_____16_CM 6 0. 8160. DISPLAY_IDENTIFIER LDPM_N_32__LAM_CAT FORMAT "%4.0" /end AXIS_PTS
/begin CHARACTERISTIC c_maf_int_cat_diag_dly "Air mass flow threshold for cat diag activation after PUC, CL max purge, etc." VALUE 0x0165a _REC_VAL_20_u2 1820.42 _CNV_A_R_LINEAR_____270_CM 0. 1820.42 DISPLAY_IDENTIFIER C_MAF_INT_CAT_DIAG_DLY FORMAT "%7.2" /end CHARACTERISTIC
/begin CHARACTERISTIC c_lam_min_fsd "Lambda controller maximum threshold for fuel system diagnosis" VALUE 0x00410 _REC_VAL_20_s2 199.99694824 _CNV_A_R_LINEAR_____298_CM -100. 99.99694824 DISPLAY_IDENTIFIER C_LAM_MIN_FSD FORMAT "%8.3" /end CHARACTERISTIC
/begin CHARACTERISTIC c_lam_max_fsd "Lambda controller minimum threshold for fuel system diagnosis" VALUE 0x0040c _REC_VAL_20_s2 199.99694824 _CNV_A_R_LINEAR_____298_CM -100. 99.99694824 DISPLAY_IDENTIFIER C_LAM_MAX_FSD FORMAT "%8.3" /end CHARACTERISTIC
/begin CHARACTERISTIC c_t_sum_max_max_fsd "Time counter threshold for T_SUM_MAX_FSD_i" VALUE 0x018a4 _REC_VAL_20_u2 1310.68 _CNV_A_R_LINEAR_____197_CM 2.e-002 1310.7 DISPLAY_IDENTIFIER C_T_SUM_MAX_MAX_FSD FORMAT "%7.2" /end CHARACTERISTIC
/begin CHARACTERISTIC c_t_sum_min_max_fsd "Time counter threshold for T_SUM_MIN_FSD_i" VALUE 0x018a6 _REC_VAL_20_u2 1310.68 _CNV_A_R_LINEAR_____197_CM 2.e-002 1310.7 DISPLAY_IDENTIFIER C_T_SUM_MIN_MAX_FSD FORMAT "%7.2" /end CHARACTERISTIC
/begin CHARACTERISTIC c_t_sum_rst_max_fsd "Time counter threshold for T_SUM_RST_FSD_i" VALUE 0x018a8 _REC_VAL_20_u2 1310.68 _CNV_A_R_LINEAR_____197_CM 2.e-002 1310.7 DISPLAY_IDENTIFIER C_T_SUM_RST_MAX_FSD FORMAT "%7.2" /end CHARACTERISTIC
/begin CHARACTERISTIC c_n_min_fsd "Engine speed threshold for fuel system diagnosis" VALUE 0x00782 _REC_VAL_20_u1 8160. _CNV_A_R_LINEAR_____16_CM 0. 8160. DISPLAY_IDENTIFIER C_N_MIN_FSD FORMAT "%4.0" /end CHARACTERISTIC
/begin CHARACTERISTIC c_maf_min_fsd "Mass air flow threshold for fuel system diagnosis" VALUE 0x00725 _REC_VAL_20_u1 1389. _CNV_A_R_LINEAR_____27_CM 0. 1389. DISPLAY_IDENTIFIER C_MAF_MIN_FSD FORMAT "%4.0" /end CHARACTERISTIC
/begin CHARACTERISTIC c_tco_min_fsd "Minimum threshold of TCO for fuel system diagnosis" VALUE 0x00888 _REC_VAL_20_u1 190.5 _CNV_A_R_LINEAR_____12_CM -48. 142.5 DISPLAY_IDENTIFIER C_TCO_MIN_FSD FORMAT "%5.1" /end CHARACTERISTIC
/begin CHARACTERISTIC id_stop_inc_fsd__tco_st "Increasing value for the debounce counter STOP_FSD" CURVE 0x009f0 _REC_CUR_20_u1_u1 255. _CNV_A_R_LINEAR_____1_CM 0. 255. DISPLAY_IDENTIFIER ID_STOP_INC_FSD__TCO_ST FORMAT "%3.0"
 /begin AXIS_DESCR COM_AXIS tco_st _CNV_A_R_LINEAR_____12_CM 4 -48. 142.5 FORMAT "%5.1" AXIS_PTS_REF ldp_tco_st__stop_inc_fsd /end AXIS_DESCR
/end CHARACTERISTIC
/begin CHARACTERISTIC id_stop_dec_fsd__toil_max "Decreasing value for the debounce counter STOP_FSD" CURVE 0x009ec _REC_CUR_20_u1_u1 255. _CNV_A_R_LINEAR_____1_CM 0. 255. DISPLAY_IDENTIFIER ID_STOP_DEC_FSD__TOIL_MAX FORMAT "%3.0"
 /begin AXIS_DESCR COM_AXIS toil_max _CNV_A_R_LINEAR_____15_CM 4 -40. 160. FORMAT "%3.0" AXIS_PTS_REF ldp_toil_max__stop_dec_fsd /end AXIS_DESCR
/end CHARACTERISTIC
/begin MEASUREMENT toil_max "Maximum oil temperature from the last engine running" UBYTE _CNV_A_R_LINEAR_____15_CM 1 100. -40. 160. DISPLAY_IDENTIFIER TOIL_MAX ECU_ADDRESS 0x3fe4da FORMAT "%3.0" /end MEASUREMENT
/begin MEASUREMENT ctr_stop_fsd "Counter value as a measure of the oil dilution under cold start conditions" UBYTE _CNV_A_R_LINEAR_____1_CM 1 100. 0. 255. DISPLAY_IDENTIFIER CTR_STOP_FSD ECU_ADDRESS 0x3fe4d9 FORMAT "%3.0" /end MEASUREMENT
/begin CHARACTERISTIC c_stop_max_fsd "Maximum value for the debounce counter STOP_FSD" VALUE 0x007c3 _REC_VAL_20_u1 255. _CNV_A_R_LINEAR_____1_CM 0. 255. DISPLAY_IDENTIFIER C_STOP_MAX_FSD FORMAT "%3.0" /end CHARACTERISTIC
/begin AXIS_PTS ldp_toil_max__stop_dec_fsd "" 0x01249 toil_max _REC_AXS_20_u1 200. _CNV_A_R_LINEAR_____15_CM 4 -40. 160. DISPLAY_IDENTIFIER LDP_TOIL_MAX__STOP_DEC_FSD FORMAT "%3.0" /end AXIS_PTS
/begin AXIS_PTS ldp_tco_st__stop_inc_fsd "" 0x0119d tco_st _REC_AXS_20_u1 190.5 _CNV_A_R_LINEAR_____12_CM 4 -48. 142.5 DISPLAY_IDENTIFIER LDP_TCO_ST__STOP_INC_FSD FORMAT "%5.1" /end AXIS_PTS
/begin CHARACTERISTIC c_amp_min_fsd "Minimum ambient pressure threshold for fuel system diagnosis" VALUE 0x0148c _REC_VAL_20_u2 5434. _CNV_A_R_LINEAR_____49_CM 0. 5434. DISPLAY_IDENTIFIER C_AMP_MIN_FSD FORMAT "%7.2" /end CHARACTERISTIC
/begin CHARACTERISTIC c_tam_min_fsd "Minimum ambient temperature threshold for fuel system diagnosis" VALUE 0x0084e _REC_VAL_20_u1 190.5 _CNV_A_R_LINEAR_____12_CM -48. 142.5 DISPLAY_IDENTIFIER C_TAM_MIN_FSD FORMAT "%5.1" /end CHARACTERISTIC
/begin CHARACTERISTIC c_t_min_maf_fsd "Minimum time at 'low load' for deactivating FSD" VALUE 0x01878 _REC_VAL_20_u2 1310.68 _CNV_A_R_LINEAR_____197_CM 2.e-002 1310.7 DISPLAY_IDENTIFIER C_T_MIN_MAF_FSD FORMAT "%7.2" /end CHARACTERISTIC
/begin CHARACTERISTIC c_t_dly_maf_fsd "Minimum time at 'no low load' for deactivating FSD" VALUE 0x017fe _REC_VAL_20_u2 1310.68 _CNV_A_R_LINEAR_____197_CM 2.e-002 1310.7 DISPLAY_IDENTIFIER C_T_DLY_MAF_FSD FORMAT "%7.2" /end CHARACTERISTIC
/begin CHARACTERISTIC c_n_min_mff_ad_add_fsd "Minimum engine speed for consideration of MFF_AD_ADD_MMV_REL_QUO" VALUE 0x00785 _REC_VAL_20_u1 8160. _CNV_A_R_LINEAR_____16_CM 0. 8160. DISPLAY_IDENTIFIER C_N_MIN_MFF_AD_ADD_FSD FORMAT "%4.0" /end CHARACTERISTIC
/begin CHARACTERISTIC c_maf_min_mff_ad_add_fsd "Minimum engine load for consideration of MFF_AD_ADD_MMV_REL_QUO" VALUE 0x00727 _REC_VAL_20_u1 1389. _CNV_A_R_LINEAR_____27_CM 0. 1389. DISPLAY_IDENTIFIER C_MAF_MIN_MFF_AD_ADD_FSD FORMAT "%4.0" /end CHARACTERISTIC
/begin CHARACTERISTIC c_fac_cp_fsd "Velocity of time integration during canister purge phase" VALUE 0x006c3 _REC_VAL_20_u1 0.99610001 _CNV_A_R_LINEAR_____29_CM 0. 0.99610001 DISPLAY_IDENTIFIER C_FAC_CP_FSD FORMAT "%5.3" /end CHARACTERISTIC
/begin MEASUREMENT lv_inh_diag_obd2_lsh_down_1 "" UBYTE _CNV_S_2_RANGE______0_CM 1 100. 0. 1. DISPLAY_IDENTIFIER LV_INH_DIAG_OBD2_LSH_DOWN_1 ECU_ADDRESS 0x3fe4e2 /end MEASUREMENT
/begin MEASUREMENT lv_inh_diag_obd2_lsh_down_2 "" UBYTE _CNV_S_2_RANGE______0_CM 1 100. 0. 1. DISPLAY_IDENTIFIER LV_INH_DIAG_OBD2_LSH_DOWN_2 ECU_ADDRESS 0x3fe4e3 /end MEASUREMENT
/begin CHARACTERISTIC c_tco_min_obd2_lsh_down "TCO-threshold for OBD2 heater diagnosis downstream" VALUE 0x0088c _REC_VAL_20_u1 190.5 _CNV_A_R_LINEAR_____12_CM -48. 142.5 DISPLAY_IDENTIFIER C_TCO_MIN_OBD2_LSH_DOWN FORMAT "%5.1" /end CHARACTERISTIC
/begin MEASUREMENT lv_err_fsd_1 "" UBYTE _CNV_S_2_RANGE______2_R_CM 1 100. 0. 255. DISPLAY_IDENTIFIER LV_ERR_FSD_1 ECU_ADDRESS 0x3fba44 /end MEASUREMENT
/begin MEASUREMENT lv_err_fsd_2 "" UBYTE _CNV_S_2_RANGE______2_R_CM 1 100. 0. 255. DISPLAY_IDENTIFIER LV_ERR_FSD_2 ECU_ADDRESS 0x3fba48 /end MEASUREMENT
/begin MEASUREMENT teg_1.appl_inc_struct.lamb_sp_teg "Lambda setpoint for TEG calculation (bank 1,2)" UWORD _CNV_A_R_LINEAR_____164_CM 1 100. 0. 31.99902344 DISPLAY_IDENTIFIER LAMB_SP_TEG_1 ECU_ADDRESS 0x3fc8ec BYTE_ORDER MSB_LAST FORMAT "%7.4" /end MEASUREMENT
/begin MEASUREMENT teg_1.appl_inc_struct.eff_iga_av_teg "Ignition efficiency actual actual value for TEG calculation" UWORD _CNV_A_R_LINEAR_____21_CM 1 100. 0. 1.99996948 DISPLAY_IDENTIFIER EFF_IGA_AV_TEG_1 ECU_ADDRESS 0x3fc8f4 BYTE_ORDER MSB_LAST FORMAT "%7.5" /end MEASUREMENT
/begin MEASUREMENT teg_1.appl_inc_struct.nr_cyl_scc_teg "Number of shut off cyl for TEG calculation" UBYTE _CNV_A_R_LINEAR_____388_CM 1 100. 0. 13. DISPLAY_IDENTIFIER NR_CYL_SCC_TEG_1 ECU_ADDRESS 0x3fc8fc FORMAT "%4.1" /end MEASUREMENT
/begin MEASUREMENT teg_2.appl_inc_struct.lamb_sp_teg "Lambda setpoint for TEG calculation (bank 1,2)" UWORD _CNV_A_R_LINEAR_____164_CM 1 100. 0. 31.99902344 DISPLAY_IDENTIFIER LAMB_SP_TEG_2 ECU_ADDRESS 0x3fc9e0 BYTE_ORDER MSB_LAST FORMAT "%7.4" /end MEASUREMENT
/begin MEASUREMENT teg_2.appl_inc_struct.eff_iga_av_teg "Ignition efficiency actual actual value for TEG calculation" UWORD _CNV_A_R_LINEAR_____21_CM 1 100. 0. 1.99996948 DISPLAY_IDENTIFIER EFF_IGA_AV_TEG_2 ECU_ADDRESS 0x3fc9e8 BYTE_ORDER MSB_LAST FORMAT "%7.5" /end MEASUREMENT
/begin MEASUREMENT teg_2.appl_inc_struct.nr_cyl_scc_teg "Number of shut off cyl for TEG calculation" UBYTE _CNV_A_R_LINEAR_____388_CM 1 100. 0. 13. DISPLAY_IDENTIFIER NR_CYL_SCC_TEG_2 ECU_ADDRESS 0x3fc9f0 FORMAT "%4.1" /end MEASUREMENT
/begin MEASUREMENT temp_cat "catalyst temperature" UWORD _CNV_A_R_LINEAR_____302_CM 1 100. -33. 990.984375 DISPLAY_IDENTIFIER TEMP_CAT ECU_ADDRESS 0x3fd2a6 BYTE_ORDER MSB_LAST FORMAT "%6.2" /end MEASUREMENT
/begin MEASUREMENT maf_teg "Air mass for TEG calculation" UWORD _CNV_A_R_LINEAR_____106_CM 1 100. 0. 1389. DISPLAY_IDENTIFIER MAF_TEG ECU_ADDRESS 0x3fd29c BYTE_ORDER MSB_LAST FORMAT "%7.2" /end MEASUREMENT
/begin MEASUREMENT maf_int_teg_st "Mass air beginning at  start" UWORD _CNV_A_R_LINEAR_____271_CM 1 100. 0. 1820.398 DISPLAY_IDENTIFIER MAF_INT_TEG_ST ECU_ADDRESS 0x3fd2a0 BYTE_ORDER MSB_LAST FORMAT "%7.2" /end MEASUREMENT
/begin MEASUREMENT maf_kgh_teg "Mass air beginning at  start" UWORD _CNV_A_R_LINEAR_____113_CM 1 100. 0. 2047.96875 DISPLAY_IDENTIFIER MAF_KGH_TEG ECU_ADDRESS 0x3fd29e BYTE_ORDER MSB_LAST FORMAT "%7.2" /end MEASUREMENT
/begin MEASUREMENT n_teg "Engine speed for TEG calculation" UWORD _CNV_A_R_LINEAR_____11_CM 1 100. 1. 8160. DISPLAY_IDENTIFIER N_TEG ECU_ADDRESS 0x3fd2a2 BYTE_ORDER MSB_LAST FORMAT "%4.0" /end MEASUREMENT
/begin MEASUREMENT teg_dyn "model output signal of the exhaust gas temperature" UWORD _CNV_A_R_LINEAR_____7_CM 1 100. 0. 2047. DISPLAY_IDENTIFIER TEG_DYN ECU_ADDRESS 0x3fd2a4 BYTE_ORDER MSB_LAST FORMAT "%7.2" /end MEASUREMENT
/begin MEASUREMENT teg_cat_up_mdl_1 "exhaust gas temperature" UWORD _CNV_A_R_LINEAR_____7_CM 1 100. 0. 2047. DISPLAY_IDENTIFIER TEG_CAT_UP_MDL_1 ECU_ADDRESS 0x3fd2a8 BYTE_ORDER MSB_LAST FORMAT "%7.2" /end MEASUREMENT
/begin MEASUREMENT teg_cat_up_mdl_2 "exhaust gas temperature" UWORD _CNV_A_R_LINEAR_____7_CM 1 100. 0. 2047. DISPLAY_IDENTIFIER TEG_CAT_UP_MDL_2 ECU_ADDRESS 0x3fd2ac BYTE_ORDER MSB_LAST FORMAT "%7.2" /end MEASUREMENT
/begin MEASUREMENT teg_cat_down_mdl_2 "exhaust gas temperature" UWORD _CNV_A_R_LINEAR_____7_CM 1 100. 0. 2047. DISPLAY_IDENTIFIER TEG_CAT_DOWN_MDL_2 ECU_ADDRESS 0x3fd2ae BYTE_ORDER MSB_LAST FORMAT "%7.2" /end MEASUREMENT
/begin MEASUREMENT teg_cat_down_mdl_1 "exhaust gas temperature" UWORD _CNV_A_R_LINEAR_____7_CM 1 100. 0. 2047. DISPLAY_IDENTIFIER TEG_CAT_DOWN_MDL_1 ECU_ADDRESS 0x3fd2aa BYTE_ORDER MSB_LAST FORMAT "%7.2" /end MEASUREMENT
/begin MEASUREMENT lv_st_h_prs "Logical variable indicating high pressure start active" UBYTE _CNV_S_2_RANGE______5_CM 1 100. 0. 1. DISPLAY_IDENTIFIER LV_ST_H_PRS ECU_ADDRESS 0x3fe372 BIT_MASK 0x1 /end MEASUREMENT
/begin MEASUREMENT mff_cst "Basic injection at start (LV_ST)" UWORD _CNV_A_R_LINEAR_____106_CM 1 100. 0. 1389. DISPLAY_IDENTIFIER MFF_CST ECU_ADDRESS 0x3fd530 BYTE_ORDER MSB_LAST FORMAT "%7.2" /end MEASUREMENT
/begin CHARACTERISTIC c_cyc_cast_h_prs "Cycle counter break off threshold to switch over to \"low pressure start\"" VALUE 0x01516 _REC_VAL_20_u2 65535. _CNV_A_R_LINEAR_____1_CM 0. 65535. DISPLAY_IDENTIFIER C_CYC_CAST_H_PRS FORMAT "%5.0" /end CHARACTERISTIC
/begin CHARACTERISTIC ip_mff_cst "Basic value for cranking injection" MAP 0x0cc96 _REC_MAP_20_u2_u2_u1 1389. _CNV_A_R_LINEAR_____106_CM 0. 1389. DISPLAY_IDENTIFIER IP_MFF_CST FORMAT "%7.2"
 /begin AXIS_DESCR COM_AXIS n_tooth _CNV_A_R_LINEAR_____11_CM 3 0. 8160. FORMAT "%4.0" AXIS_PTS_REF ldp_n_tooth__mff_cst /end AXIS_DESCR
 /begin AXIS_DESCR COM_AXIS tco _CNV_A_R_LINEAR_____12_CM 8 -48. 142.5 FORMAT "%5.1" AXIS_PTS_REF ldpm_tco__mff_cst /end AXIS_DESCR
/end CHARACTERISTIC
/begin CHARACTERISTIC ip_mff_deac_cst "Cranking injection time deactivation factor" MAP 0x069da _REC_MAP_20_u1_u1_u1 0.1494141 _CNV_A_R_LINEAR_____50_CM 0. 0.996094 DISPLAY_IDENTIFIER IP_MFF_DEAC_CST FORMAT "%5.3"
 /begin AXIS_DESCR COM_AXIS cycnr_st _CNV_A_R_LINEAR_____1_CM 4 0. 255. FORMAT "%3.0" AXIS_PTS_REF ldp_cyc__mff_cst /end AXIS_DESCR
 /begin AXIS_DESCR COM_AXIS tco _CNV_A_R_LINEAR_____12_CM 8 -48. 142.5 FORMAT "%5.1" AXIS_PTS_REF ldpm_tco__mff_cst /end AXIS_DESCR
/end CHARACTERISTIC
/begin CHARACTERISTIC ip_fup_min_inj_st "Fuel pressure threshold to reach before injection is started" CURVE 0x00c20 _REC_CUR_20_u1_u1 173888. _CNV_A_R_LINEAR_____438_CM 0. 173888. DISPLAY_IDENTIFIER IP_FUP_MIN_INJ_ST FORMAT "%6.0"
 /begin AXIS_DESCR COM_AXIS tco _CNV_A_R_LINEAR_____12_CM 8 -48. 142.5 FORMAT "%5.1" AXIS_PTS_REF ldpm_tco__mff_cst /end AXIS_DESCR
/end CHARACTERISTIC
/begin MEASUREMENT lv_mff_cst_fup_act "Logical variable indicating fuel pressure has reached threshold once" UBYTE _CNV_S_2_RANGE______5_CM 1 100. 0. 1. DISPLAY_IDENTIFIER LV_MFF_CST_FUP_ACT ECU_ADDRESS 0x3fe373 BIT_MASK 0x1 /end MEASUREMENT
/begin MEASUREMENT cyc_cast_fup_thd "cycle counter value when high pressure injection starts" UWORD _CNV_A_R_LINEAR_____1_CM 1 100. 0. 65535. DISPLAY_IDENTIFIER CYC_CAST_FUP_THD ECU_ADDRESS 0x3fd534 BYTE_ORDER MSB_LAST FORMAT "%5.0" /end MEASUREMENT
/begin CHARACTERISTIC c_tco_st_h_prs "Coolant temp. threshold to select high or low pressure start " VALUE 0x0089a _REC_VAL_20_u1 190.5 _CNV_A_R_LINEAR_____12_CM -48. 142.5 DISPLAY_IDENTIFIER C_TCO_ST_H_PRS FORMAT "%5.1" /end CHARACTERISTIC
/begin AXIS_PTS ldp_cyc__mff_cst "" 0x00fa2 cycnr_st _REC_AXS_20_u1 255. _CNV_A_R_LINEAR_____1_CM 4 0. 255. DISPLAY_IDENTIFIER LDP_CYC__MFF_CST FORMAT "%3.0" /end AXIS_PTS
/begin AXIS_PTS ldp_n_tooth__mff_cst "" 0x01b92 n_tooth _REC_AXS_20_u2 816. _CNV_A_R_LINEAR_____11_CM 3 0. 8160. DISPLAY_IDENTIFIER LDP_N_TOOTH__MFF_CST FORMAT "%4.0" /end AXIS_PTS
/begin AXIS_PTS ldpm_tco__mff_cst "" 0x081dc tco _REC_AXS_20_u1 19.05 _CNV_A_R_LINEAR_____12_CM 8 -48. 142.5 DISPLAY_IDENTIFIER LDPM_TCO__MFF_CST FORMAT "%5.1" /end AXIS_PTS
/begin CHARACTERISTIC id_fac_tipr_deac "Pre injection time deactivation factor" CURVE 0x009b2 _REC_CUR_20_u1_u1 1.99220002 _CNV_A_R_LINEAR_____39_CM 0. 1.99220002 DISPLAY_IDENTIFIER ID_FAC_TIPR_DEAC FORMAT "%5.3"
 /begin AXIS_DESCR COM_AXIS cycnr_cst _CNV_A_R_LINEAR_____1_CM 6 0. 7. FORMAT "%2.0" AXIS_PTS_REF ldp_cycnr_cst__fac_tipr_deac /end AXIS_DESCR
/end CHARACTERISTIC
/begin MEASUREMENT bios_tipr_bas[0] "injection time preinjection" UWORD _CNV_A_R_LINEAR_____198_CM 1 100. 0. 262.14 DISPLAY_IDENTIFIER BIOS_TIPR_BAS_0 ECU_ADDRESS 0x3fd57c BYTE_ORDER MSB_LAST FORMAT "%7.3" /end MEASUREMENT
/begin MEASUREMENT bios_tipr_bas[1] "injection time preinjection" UWORD _CNV_A_R_LINEAR_____198_CM 1 100. 0. 262.14 DISPLAY_IDENTIFIER BIOS_TIPR_BAS_1 ECU_ADDRESS 0x3fd57e BYTE_ORDER MSB_LAST FORMAT "%7.3" /end MEASUREMENT
/begin MEASUREMENT bios_tipr_bas[2] "injection time preinjection" UWORD _CNV_A_R_LINEAR_____198_CM 1 100. 0. 262.14 DISPLAY_IDENTIFIER BIOS_TIPR_BAS_2 ECU_ADDRESS 0x3fd580 BYTE_ORDER MSB_LAST FORMAT "%7.3" /end MEASUREMENT
/begin MEASUREMENT bios_tipr_bas[3] "injection time preinjection" UWORD _CNV_A_R_LINEAR_____198_CM 1 100. 0. 262.14 DISPLAY_IDENTIFIER BIOS_TIPR_BAS_3 ECU_ADDRESS 0x3fd582 BYTE_ORDER MSB_LAST FORMAT "%7.3" /end MEASUREMENT
/begin MEASUREMENT bios_tipr_bas[4] "injection time preinjection" UWORD _CNV_A_R_LINEAR_____198_CM 1 100. 0. 262.14 DISPLAY_IDENTIFIER BIOS_TIPR_BAS_4 ECU_ADDRESS 0x3fd584 BYTE_ORDER MSB_LAST FORMAT "%7.3" /end MEASUREMENT
/begin MEASUREMENT bios_tipr_bas[5] "injection time preinjection" UWORD _CNV_A_R_LINEAR_____198_CM 1 100. 0. 262.14 DISPLAY_IDENTIFIER BIOS_TIPR_BAS_5 ECU_ADDRESS 0x3fd586 BYTE_ORDER MSB_LAST FORMAT "%7.3" /end MEASUREMENT
/begin MEASUREMENT bios_eoi_min_tipr "Latest permitted predicted end of injection for pre-injection" UWORD _CNV_A_R_LINEAR_____82_CM 1 100. 0. 720. DISPLAY_IDENTIFIER BIOS_EOI_MIN_TIPR ECU_ADDRESS 0x3fd576 BYTE_ORDER MSB_LAST FORMAT "%6.2" /end MEASUREMENT
/begin MEASUREMENT bios_nr_max_tooth_tipr "Maximum tooth number till preliminary synchronisation for preinjection" UBYTE _CNV_A_R_LINEAR_____1_CM 1 100. 1. 64. DISPLAY_IDENTIFIER BIOS_NR_MAX_TOOTH_TIPR ECU_ADDRESS 0x3fe377 FORMAT "%3.0" /end MEASUREMENT
/begin MEASUREMENT cycnr_cst "Pre injection counter" UBYTE _CNV_A_R_LINEAR_____1_CM 1 100. 0. 7. DISPLAY_IDENTIFIER CYCNR_CST ECU_ADDRESS 0x3fe378 FORMAT "%2.0" /end MEASUREMENT
/begin MEASUREMENT tipr[0] "Pre-injection time" UWORD _CNV_A_R_LINEAR_____198_CM 1 100. 0. 262.14 DISPLAY_IDENTIFIER TIPR_0 ECU_ADDRESS 0x3fd588 BYTE_ORDER MSB_LAST FORMAT "%7.3" /end MEASUREMENT
/begin MEASUREMENT tipr[1] "Pre-injection time" UWORD _CNV_A_R_LINEAR_____198_CM 1 100. 0. 262.14 DISPLAY_IDENTIFIER TIPR_1 ECU_ADDRESS 0x3fd58a BYTE_ORDER MSB_LAST FORMAT "%7.3" /end MEASUREMENT
/begin MEASUREMENT tipr[2] "Pre-injection time" UWORD _CNV_A_R_LINEAR_____198_CM 1 100. 0. 262.14 DISPLAY_IDENTIFIER TIPR_2 ECU_ADDRESS 0x3fd58c BYTE_ORDER MSB_LAST FORMAT "%7.3" /end MEASUREMENT
/begin MEASUREMENT tipr[3] "Pre-injection time" UWORD _CNV_A_R_LINEAR_____198_CM 1 100. 0. 262.14 DISPLAY_IDENTIFIER TIPR_3 ECU_ADDRESS 0x3fd58e BYTE_ORDER MSB_LAST FORMAT "%7.3" /end MEASUREMENT
/begin MEASUREMENT tipr[4] "Pre-injection time" UWORD _CNV_A_R_LINEAR_____198_CM 1 100. 0. 262.14 DISPLAY_IDENTIFIER TIPR_4 ECU_ADDRESS 0x3fd590 BYTE_ORDER MSB_LAST FORMAT "%7.3" /end MEASUREMENT
/begin MEASUREMENT tipr[5] "Pre-injection time" UWORD _CNV_A_R_LINEAR_____198_CM 1 100. 0. 262.14 DISPLAY_IDENTIFIER TIPR_5 ECU_ADDRESS 0x3fd592 BYTE_ORDER MSB_LAST FORMAT "%7.3" /end MEASUREMENT
/begin MEASUREMENT mffpr "Calculated mass fuel flow setpoint for pre injection" UWORD _CNV_A_R_LINEAR_____106_CM 1 100. 0. 1389. DISPLAY_IDENTIFIER MFFPR ECU_ADDRESS 0x3fd57a BYTE_ORDER MSB_LAST FORMAT "%7.2" /end MEASUREMENT
/begin MEASUREMENT mffpr_cst "Basic value of pre-injection at LV_ES" UWORD _CNV_A_R_LINEAR_____106_CM 1 100. 0. 1389. DISPLAY_IDENTIFIER MFFPR_CST ECU_ADDRESS 0x3fd578 BYTE_ORDER MSB_LAST FORMAT "%7.2" /end MEASUREMENT
/begin CHARACTERISTIC ip_mffpr_cst "Pre-injection basic value" CURVE 0x0ce56 _REC_CUR_20_u2_u1 1389. _CNV_A_R_LINEAR_____106_CM 0. 1389. DISPLAY_IDENTIFIER IP_MFFPR_CST FORMAT "%7.2"
 /begin AXIS_DESCR COM_AXIS tco _CNV_A_R_LINEAR_____12_CM 8 -48. 142.5 FORMAT "%5.1" AXIS_PTS_REF ldp_tco__mffpr_cst /end AXIS_DESCR
/end CHARACTERISTIC
/begin CHARACTERISTIC ip_mffpr_fac_st_es "Pre-injection basic value correction in case of previous transition ST --> ES" CURVE 0x00ce3 _REC_CUR_20_u1_u1 0.99610001 _CNV_A_R_LINEAR_____29_CM 0. 0.99610001 DISPLAY_IDENTIFIER IP_MFFPR_FAC_ST_ES FORMAT "%5.3"
 /begin AXIS_DESCR COM_AXIS tco _CNV_A_R_LINEAR_____12_CM 8 -48. 142.5 FORMAT "%5.1" AXIS_PTS_REF ldp_tco__mffpr_fac_st_es /end AXIS_DESCR
/end CHARACTERISTIC
/begin AXIS_PTS ldp_cycnr_cst__fac_tipr_deac "" 0x00fae cycnr_cst _REC_AXS_20_u1 7. _CNV_A_R_LINEAR_____1_CM 6 0. 7. DISPLAY_IDENTIFIER LDP_CYCNR_CST__FAC_TIPR_DEAC FORMAT "%2.0" /end AXIS_PTS
/begin AXIS_PTS ldp_tco__mffpr_cst "" 0x07da7 tco _REC_AXS_20_u1 190.5 _CNV_A_R_LINEAR_____12_CM 8 -48. 142.5 DISPLAY_IDENTIFIER LDP_TCO__MFFPR_CST FORMAT "%5.1" /end AXIS_PTS
/begin AXIS_PTS ldp_tco__mffpr_fac_st_es "" 0x07db0 tco _REC_AXS_20_u1 190.5 _CNV_A_R_LINEAR_____12_CM 8 -48. 142.5 DISPLAY_IDENTIFIER LDP_TCO__MFFPR_FAC_ST_ES FORMAT "%5.1" /end AXIS_PTS
/begin MEASUREMENT ti_st_rest "Cold start reduction factor in case of re-start detected" UBYTE _CNV_A_R_LINEAR_____50_CM 1 100. 0. 0.996094 DISPLAY_IDENTIFIER TI_ST_REST ECU_ADDRESS 0x3fe379 FORMAT "%5.3" /end MEASUREMENT
/begin CHARACTERISTIC ip_tq_add_cp__cl_mmv "MAP for dtermination of TQ_ADD_CP in dependence of CL_MMV" CURVE 0x0f98e _REC_CUR_20_u2_u2 2047.96875 _CNV_A_R_LINEAR_____186_CM -1024. 1023.96875 DISPLAY_IDENTIFIER IP_TQ_ADD_CP FORMAT "%6.2"
 /begin AXIS_DESCR COM_AXIS online_dummy _CNV_A_R_LINEAR_____345_CM 6 0. 7.99987793 FORMAT "%6.4" AXIS_PTS_REF ldp_cl_mmv /end AXIS_DESCR
/end CHARACTERISTIC
/begin MEASUREMENT tq_add_cp "Torque reserve for canister purge at idle" SWORD _CNV_A_R_LINEAR_____55_CM 1 100. -1024. 1023.96875 DISPLAY_IDENTIFIER TQ_ADD_CP ECU_ADDRESS 0x3fda2e BYTE_ORDER MSB_LAST FORMAT "%8.2" /end MEASUREMENT
/begin CHARACTERISTIC c_crlc_tq_add_cp "Filter constant" VALUE 0x00639 _REC_VAL_20_u1 0.9960940000000002 _CNV_A_R_LINEAR_____50_CM 0. 0.996094 DISPLAY_IDENTIFIER C_CRLC_TQ_ADD_CP FORMAT "%5.3" /end CHARACTERISTIC
/begin CHARACTERISTIC lc_tq_add_cp_inh "Logical variable for inhibiting the torque reserve for canister purge in idle" VALUE 0x00f7c _REC_VAL_20_u1 1. _CNV_A_R_LINEAR_____1_CM 0. 1. DISPLAY_IDENTIFIER LC_TQ_ADD_CP_INH FORMAT "%2.0" /end CHARACTERISTIC
/begin AXIS_PTS ldp_cl_mmv "" 0x1099a online_dummy _REC_AXS_20_u2 7.99987793 _CNV_A_R_LINEAR_____345_CM 6 0. 7.99987793 DISPLAY_IDENTIFIER LDP_CL_MMV FORMAT "%6.4" /end AXIS_PTS
/begin CHARACTERISTIC c_tco_cat_var "TCO threshold for IS-CO adjustment" VALUE 0x0085e _REC_VAL_20_u1 190.5 _CNV_A_R_LINEAR_____12_CM -48. 142.5 DISPLAY_IDENTIFIER C_TCO_CAT_VAR FORMAT "%5.1" /end CHARACTERISTIC
/begin AXIS_PTS ldpm_n_dif_pred_fac_tq_add_is "" 0x119b6 n_dif_pred_pl_drof _REC_AXS_20_u2 65535. _CNV_A_R_LINEAR_____206_CM 8 -32768. 32767. DISPLAY_IDENTIFIER LDPM_N_DIF_PRED_FAC_TQ_ADD_IS FORMAT "%6.0" /end AXIS_PTS
/begin AXIS_PTS ldpm_n_t_n_dif_ofs_pred "" 0x11a0a n _REC_AXS_20_u2 8160. _CNV_A_R_LINEAR_____11_CM 8 0. 8160. DISPLAY_IDENTIFIER LDPM_N_T_N_DIF_OFS_PRED FORMAT "%4.0" /end AXIS_PTS
/begin CHARACTERISTIC c_tco_min_obd2_lsh_up "TCO-threshold for OBD2 heater diagnosis upstream" VALUE 0x0088d _REC_VAL_20_u1 190.5 _CNV_A_R_LINEAR_____12_CM -48. 142.5 DISPLAY_IDENTIFIER C_TCO_MIN_OBD2_LSH_UP FORMAT "%5.1" /end CHARACTERISTIC
/begin CHARACTERISTIC ip_maf_min_cyl_lam "lower load threshold control mode" CURVE 0x00cc5 _REC_CUR_20_u1_u2 1389. _CNV_A_R_LINEAR_____27_CM 0. 1389. DISPLAY_IDENTIFIER IP_MAF_MIN_CYL_LAM FORMAT "%4.0"
 /begin AXIS_DESCR COM_AXIS n _CNV_A_R_LINEAR_____11_CM 6 0. 8160. FORMAT "%4.0" AXIS_PTS_REF ldpm_n_2_cybl /end AXIS_DESCR
/end CHARACTERISTIC
/begin CHARACTERISTIC ip_maf_max_cyl_lam "upper load threshold control mode" CURVE 0x00c9f _REC_CUR_20_u1_u2 1389. _CNV_A_R_LINEAR_____27_CM 0. 1389. DISPLAY_IDENTIFIER IP_MAF_MAX_CYL_LAM FORMAT "%4.0"
 /begin AXIS_DESCR COM_AXIS n _CNV_A_R_LINEAR_____11_CM 6 0. 8160. FORMAT "%4.0" AXIS_PTS_REF ldpm_n_2_cybl /end AXIS_DESCR
/end CHARACTERISTIC
/begin CHARACTERISTIC c_n_max_cyl_lam "engine speed threshold of the function" VALUE 0x00772 _REC_VAL_20_u1 8160. _CNV_A_R_LINEAR_____16_CM 0. 8160. DISPLAY_IDENTIFIER C_N_MAX_CYL_LAM FORMAT "%4.0" /end CHARACTERISTIC
/begin CHARACTERISTIC c_vls_cyc_ratio_mv_max "maximum admissible duration of a LR oscillation" VALUE 0x00937 _REC_VAL_20_u1 1.984375 _CNV_A_R_LINEAR_____157_CM 0. 1.984375 DISPLAY_IDENTIFIER C_VLS_CYC_RATIO_MV_MAX FORMAT "%4.2" /end CHARACTERISTIC
/begin CHARACTERISTIC c_toil_min_cyl_lam "minimum oil temperature for cylinder individual injection correction" VALUE 0x008e6 _REC_VAL_20_u1 200. _CNV_A_R_LINEAR_____15_CM -40. 160. DISPLAY_IDENTIFIER C_TOIL_MIN_CYL_LAM FORMAT "%3.0" /end CHARACTERISTIC
/begin CHARACTERISTIC lc_cdn_lscl_cyl_lam "calibrateable switch for lambda-control closed loop condition" VALUE 0x00f06 _REC_VAL_20_u1 1. _CNV_A_R_LINEAR_____1_CM 0. 1. DISPLAY_IDENTIFIER LC_CDN_LSCL_CYL_LAM FORMAT "%2.0" /end CHARACTERISTIC
/begin MEASUREMENT lv_cyl_lam_act[0] "LV conditions for cylinder individual mixture control, 1= fulfilled" UBYTE _CNV_S_2_RANGE______5_CM 1 100. 0. 1. DISPLAY_IDENTIFIER LV_CYL_LAM_ACT_1 ECU_ADDRESS 0x3fe037 /end MEASUREMENT
/begin MEASUREMENT lv_cyl_lam_act[1] "LV conditions for cylinder individual mixture control, 1= fulfilled" UBYTE _CNV_S_2_RANGE______5_CM 1 100. 0. 1. DISPLAY_IDENTIFIER LV_CYL_LAM_ACT_2 ECU_ADDRESS 0x3fe038 /end MEASUREMENT
/begin COMPU_METHOD _CNV_S_2_RANGE______0_CM "" TAB_VERB "%6.3" "[-]" COMPU_TAB_REF _CNV_S_2_RANGE______0 /end COMPU_METHOD
/begin COMPU_VTAB _CNV_S_2_RANGE______0 "" TAB_VERB 2 0 "0" 1 "1" /end COMPU_VTAB
/begin COMPU_METHOD _CNV_A_R_LINEAR_____1_CM "" RAT_FUNC "%6.3" "-" COEFFS 0 1. 0. 0 0 1 /end COMPU_METHOD
/begin COMPU_METHOD _CNV_S_2_RANGE______2_R_CM "" TAB_VERB "%6.3" "[-]" COMPU_TAB_REF _CNV_S_2_RANGE______2_R /end COMPU_METHOD
/begin COMPU_VTAB_RANGE _CNV_S_2_RANGE______2_R "" 2 0 0 "0" 1 255 "1" /end COMPU_VTAB_RANGE
/begin COMPU_METHOD _CNV_A_R_LINEAR_____3_CM "" RAT_FUNC "%6.3" "V" COEFFS 0 204.7999998974999 0. 0 0 1 /end COMPU_METHOD
/begin COMPU_METHOD _CNV_A_R_LINEAR_____4_CM "" RAT_FUNC "%6.3" "s" COEFFS 0 100. 0. 0 0 1 /end COMPU_METHOD
/begin COMPU_METHOD _CNV_S_2_RANGE______5_CM "" TAB_VERB "%6.3" "-" COMPU_TAB_REF _CNV_S_2_RANGE______5 /end COMPU_METHOD
/begin COMPU_VTAB _CNV_S_2_RANGE______5 "" TAB_VERB 2 0 "0" 1 "1" /end COMPU_VTAB
/begin COMPU_METHOD _CNV_A_R_LINEAR_____7_CM "" RAT_FUNC "%6.3" "°C" COEFFS 0 16. 0. 0 0 1 /end COMPU_METHOD
/begin COMPU_METHOD _CNV_A_R_LINEAR_____10_CM "" RAT_FUNC "%6.3" "%" COEFFS 0 2.56 0. 0 0 1 /end COMPU_METHOD
/begin COMPU_METHOD _CNV_A_R_LINEAR_____11_CM "" RAT_FUNC "%6.3" "rpm" COEFFS 0 1. 0. 0 0 1 /end COMPU_METHOD
/begin COMPU_METHOD _CNV_A_R_LINEAR_____12_CM "" RAT_FUNC "%6.3" "°C" COEFFS 0 1.333333333333333 64. 0 0 1 /end COMPU_METHOD
/begin COMPU_METHOD _CNV_A_R_LINEAR_____15_CM "" RAT_FUNC "%6.3" "°C" COEFFS 0 1. 40. 0 0 1 /end COMPU_METHOD
/begin COMPU_METHOD _CNV_A_R_LINEAR_____16_CM "" RAT_FUNC "%6.3" "rpm" COEFFS 0 3.125e-002 0. 0 0 1 /end COMPU_METHOD
/begin COMPU_METHOD _CNV_A_R_LINEAR_____17_CM "" RAT_FUNC "%6.3" "m" COEFFS 0 1.e-002 0. 0 0 1 /end COMPU_METHOD
/begin COMPU_METHOD _CNV_A_R_LINEAR_____21_CM "" RAT_FUNC "%6.3" "-" COEFFS 0 32768.00003968061 0. 0 0 1 /end COMPU_METHOD
/begin COMPU_METHOD _CNV_A_R_LINEAR_____22_CM "" RAT_FUNC "%6.3" "[-]" COEFFS 0 1. 0. 0 0 1 /end COMPU_METHOD
/begin COMPU_METHOD _CNV_A_R_LINEAR_____23_CM "" RAT_FUNC "%6.3" "km/h" COEFFS 0 1. 0. 0 0 1 /end COMPU_METHOD
/begin COMPU_METHOD _CNV_A_R_LINEAR_____24_CM "" RAT_FUNC "%6.3" "s" COEFFS 0 10. 0. 0 0 1 /end COMPU_METHOD
/begin COMPU_METHOD _CNV_A_R_LINEAR_____27_CM "" RAT_FUNC "%6.3" "mg/stk" COEFFS 0 0.183585313174946 0. 0 0 1 /end COMPU_METHOD
/begin COMPU_METHOD _CNV_A_R_LINEAR_____29_CM "" RAT_FUNC "%6.3" "-" COEFFS 0 255.9983911655618 0. 0 0 1 /end COMPU_METHOD
/begin COMPU_METHOD _CNV_A_R_LINEAR_____31_CM "" RAT_FUNC "%6.3" "ms" COEFFS 0 0.1 0. 0 0 1 /end COMPU_METHOD
/begin COMPU_METHOD _CNV_A_R_LINEAR_____35_CM "" RAT_FUNC "%6.3" "µs" COEFFS 0 0.125 0. 0 0 1 /end COMPU_METHOD
/begin COMPU_METHOD _CNV_A_R_LINEAR_____36_CM "" RAT_FUNC "%6.3" "%." COEFFS 0 65.5359830397456 0. 0 0 1 /end COMPU_METHOD
/begin COMPU_METHOD _CNV_A_R_LINEAR_____37_CM "" RAT_FUNC "%6.3" "-" COEFFS 0 65536.00007936121 0. 0 0 1 /end COMPU_METHOD
/begin COMPU_METHOD _CNV_A_R_LINEAR_____38_CM "" RAT_FUNC "%6.3" "%." COEFFS 0 65.77254901960784 0. 0 0 1 /end COMPU_METHOD
/begin COMPU_METHOD _CNV_A_R_LINEAR_____39_CM "" RAT_FUNC "%6.3" "-" COEFFS 0 127.9991955827809 0. 0 0 1 /end COMPU_METHOD
/begin COMPU_METHOD _CNV_A_R_LINEAR_____48_CM "" RAT_FUNC "%6.3" "[-]" COEFFS 0 32. 0. 0 0 1 /end COMPU_METHOD
/begin COMPU_METHOD _CNV_A_R_LINEAR_____49_CM "" RAT_FUNC "%6.3" "hPa" COEFFS 0 12.06017666543982 0. 0 0 1 /end COMPU_METHOD
/begin COMPU_METHOD _CNV_A_R_LINEAR_____50_CM "" RAT_FUNC "%6.3" "[-]" COEFFS 0 255.9999357490357 0. 0 0 1 /end COMPU_METHOD
/begin COMPU_METHOD _CNV_A_R_LINEAR_____51_CM "" RAT_FUNC "%6.3" "rpm/s" COEFFS 0 3.125e-002 0. 0 0 1 /end COMPU_METHOD
/begin COMPU_METHOD _CNV_A_R_LINEAR_____54_CM "" RAT_FUNC "%6.3" "rpm/s" COEFFS 0 3.125e-002 128. 0 0 1 /end COMPU_METHOD
/begin COMPU_METHOD _CNV_A_R_LINEAR_____55_CM "" RAT_FUNC "%6.3" "Nm" COEFFS 0 32. 0. 0 0 1 /end COMPU_METHOD
/begin COMPU_METHOD _CNV_A_R_LINEAR_____82_CM "" RAT_FUNC "%6.3" "°CRK" COEFFS 0 2.666666666666667 0. 0 0 1 /end COMPU_METHOD
/begin COMPU_METHOD _CNV_A_R_LINEAR_____106_CM "" RAT_FUNC "%6.3" "mg/stk" COEFFS 0 47.18142548596112 0. 0 0 1 /end COMPU_METHOD
/begin COMPU_METHOD _CNV_A_R_LINEAR_____109_CM "" RAT_FUNC "%6.3" "%" COEFFS 0 655.3600000071681 3.584063961170614e-007 0 0 1 /end COMPU_METHOD
/begin COMPU_METHOD _CNV_A_R_LINEAR_____113_CM "" RAT_FUNC "%6.3" "kg/h" COEFFS 0 32. 0. 0 0 1 /end COMPU_METHOD
/begin COMPU_METHOD _CNV_A_R_LINEAR_____115_CM "" RAT_FUNC "%6.3" "-" COEFFS 0 128. 0. 0 0 1 /end COMPU_METHOD
/begin COMPU_METHOD _CNV_A_R_LINEAR_____124_CM "" RAT_FUNC "%6.3" "-" COEFFS 0 65551.06000970239 0. 0 0 1 /end COMPU_METHOD
/begin COMPU_METHOD _CNV_A_R_LINEAR_____157_CM "" RAT_FUNC "%6.3" "-" COEFFS 0 64. 0. 0 0 1 /end COMPU_METHOD
/begin COMPU_METHOD _CNV_A_R_LINEAR_____159_CM "" RAT_FUNC "%6.3" "%" COEFFS 0 655.3600000071681 32768.00000035841 0 0 1 /end COMPU_METHOD
/begin COMPU_METHOD _CNV_A_R_LINEAR_____164_CM "" RAT_FUNC "%6.3" "-" COEFFS 0 1023.999999919998 0. 0 0 1 /end COMPU_METHOD
/begin COMPU_METHOD _CNV_A_R_LINEAR_____176_CM "" RAT_FUNC "%6.3" "-" COEFFS 0 1. -1. 0 0 1 /end COMPU_METHOD
/begin COMPU_METHOD _CNV_A_R_LINEAR_____177_CM "" RAT_FUNC "%6.3" "°C" COEFFS 0 0.25 8.25 0 0 1 /end COMPU_METHOD
/begin COMPU_METHOD _CNV_A_R_LINEAR_____186_CM "" RAT_FUNC "%6.3" "Nm" COEFFS 0 32. 32768. 0 0 1 /end COMPU_METHOD
/begin COMPU_METHOD _CNV_S_2_RANGE______191_CM "" TAB_VERB "%6.3" "[-]" COMPU_TAB_REF _CNV_S_2_RANGE______191 /end COMPU_METHOD
/begin COMPU_VTAB _CNV_S_2_RANGE______191 "" TAB_VERB 2 0 "PASSIVE" 1 "ACTIVE" /end COMPU_VTAB
/begin COMPU_METHOD _CNV_S_3_RANGE_STAT_193_CM "" TAB_VERB "%6.3" "[-]" COMPU_TAB_REF _CNV_S_3_RANGE_STAT_193 /end COMPU_METHOD
/begin COMPU_VTAB _CNV_S_3_RANGE_STAT_193 "" TAB_VERB 3 0 "OFF" 1 "ON" 2 "LAMP BLINKING" /end COMPU_VTAB
/begin COMPU_METHOD _CNV_S_2_RANGE______194_R_CM "" TAB_VERB "%6.3" "[-]" COMPU_TAB_REF _CNV_S_2_RANGE______194_R /end COMPU_METHOD
/begin COMPU_VTAB_RANGE _CNV_S_2_RANGE______194_R "" 2 0 0 "OFF" 1 255 "ON" /end COMPU_VTAB_RANGE
/begin COMPU_METHOD _CNV_A_R_LINEAR_____195_CM "" RAT_FUNC "%6.3" "*100ms" COEFFS 0 1. 0. 0 0 1 /end COMPU_METHOD
/begin COMPU_METHOD _CNV_A_R_LINEAR_____197_CM "" RAT_FUNC "%6.3" "s" COEFFS 0 50. 0. 0 0 1 /end COMPU_METHOD
/begin COMPU_METHOD _CNV_A_R_LINEAR_____198_CM "" RAT_FUNC "%6.3" "ms" COEFFS 0 250. 0. 0 0 1 /end COMPU_METHOD
/begin COMPU_METHOD _CNV_A_R_LINEAR_____206_CM "" RAT_FUNC "%6.3" "rpm" COEFFS 0 1. 32768. 0 0 1 /end COMPU_METHOD
/begin COMPU_METHOD _CNV_A_R_LINEAR_____211_CM "" RAT_FUNC "%6.3" "Nm" COEFFS 0 8191.999999679995 32767.99999871998 0 0 1 /end COMPU_METHOD
/begin COMPU_METHOD _CNV_A_R_LINEAR_____212_CM "" RAT_FUNC "%6.3" "Nm" COEFFS 0 8191.999999679995 -1.280019205296412e-006 0 0 1 /end COMPU_METHOD
/begin COMPU_METHOD _CNV_S_3_STATE_P_D__213_CM "" TAB_VERB "%6.3" "[-]" COMPU_TAB_REF _CNV_S_3_STATE_P_D__213 /end COMPU_METHOD
/begin COMPU_VTAB _CNV_S_3_STATE_P_D__213 "" TAB_VERB 3 0 "P_D_PASSIVE" 1 "P_D_NORMAL" 2 "RAMP_TO_ZERO" /end COMPU_VTAB
/begin COMPU_METHOD _CNV_S_4_STATE_I_IS_214_CM "" TAB_VERB "%6.3" "[-]" COMPU_TAB_REF _CNV_S_4_STATE_I_IS_214 /end COMPU_METHOD
/begin COMPU_VTAB _CNV_S_4_STATE_I_IS_214 "" TAB_VERB 4 0 "I_PASSIVE" 1 "I_NORMAL" 2 "RAMP_TO_PAS" 3 "RAMP_TO_LIM" /end COMPU_VTAB
/begin COMPU_METHOD _CNV_A_R_LINEAR_____215_CM "" RAT_FUNC "%6.3" "rpm" COEFFS 0 3.125e-002 128. 0 0 1 /end COMPU_METHOD
/begin COMPU_METHOD _CNV_S_4_STATE_REQ__216_CM "" TAB_VERB "%6.3" "[-]" COMPU_TAB_REF _CNV_S_4_STATE_REQ__216 /end COMPU_METHOD
/begin COMPU_VTAB _CNV_S_4_STATE_REQ__216 "" TAB_VERB 4 0 "ISC_PASSIVE" 1 "AFTER_START" 2 "NORMAL" 3 "TRAILING_THR" /end COMPU_VTAB
/begin COMPU_METHOD _CNV_A_R_LINEAR_____217_CM "" RAT_FUNC "%6.3" "s" COEFFS 0 32. 0. 0 0 1 /end COMPU_METHOD
/begin COMPU_METHOD _CNV_A_R_LINEAR_____218_CM "" RAT_FUNC "%6.3" "Nm/rpm*rpm" COEFFS 0 134295784.7496875 0.1714789237448713 0 0 1 /end COMPU_METHOD
/begin COMPU_METHOD _CNV_A_R_LINEAR_____219_CM "" RAT_FUNC "%6.3" "Nm/rpm*rpm" COEFFS 0 134213975.5877775 -1. 0 0 1 /end COMPU_METHOD
/begin COMPU_METHOD _CNV_A_R_LINEAR_____220_CM "" RAT_FUNC "%6.3" "1/rpm²" COEFFS 0 134293032.7868853 0. 0 0 1 /end COMPU_METHOD
/begin COMPU_METHOD _CNV_A_R_LINEAR_____221_CM "" RAT_FUNC "%6.3" "Nm" COEFFS 0 2097152.000003239 3.316402435302734e-003 0 0 1 /end COMPU_METHOD
/begin COMPU_METHOD _CNV_A_R_LINEAR_____255_CM "" RAT_FUNC "%6.3" "mg/stk" COEFFS 0 47.18214541280769 -1.080506262951531e-005 0 0 1 /end COMPU_METHOD
/begin COMPU_METHOD _CNV_A_R_LINEAR_____262_CM "" RAT_FUNC "%6.3" "°C" COEFFS 0 43.47840509520334 2086.96344456976 0 0 1 /end COMPU_METHOD
/begin COMPU_METHOD _CNV_A_R_LINEAR_____263_CM "" RAT_FUNC "%6.3" "mg/stk" COEFFS 0 47.14849960790521 32768.20722749412 0 0 1 /end COMPU_METHOD
/begin COMPU_METHOD _CNV_A_R_LINEAR_____269_CM "" RAT_FUNC "%6.3" "-" COEFFS 0 1024.000001200037 0. 0 0 1 /end COMPU_METHOD
/begin COMPU_METHOD _CNV_A_R_LINEAR_____270_CM "" RAT_FUNC "%6.3" "g" COEFFS 0 35.99993408114611 0. 0 0 1 /end COMPU_METHOD
/begin COMPU_METHOD _CNV_A_R_LINEAR_____271_CM "" RAT_FUNC "%6.3" "g" COEFFS 0 36.00036915004301 0. 0 0 1 /end COMPU_METHOD
/begin COMPU_METHOD _CNV_A_R_LINEAR_____279_CM "" RAT_FUNC "%6.3" "ohm" COEFFS 0 1. 0. 0 0 1 /end COMPU_METHOD
/begin COMPU_METHOD _CNV_A_R_LINEAR_____280_CM "" RAT_FUNC "%6.3" "°C" COEFFS 0 15.99999804684544 -4.000060547696194e-003 0 0 1 /end COMPU_METHOD
/begin COMPU_METHOD _CNV_A_R_LINEAR_____298_CM "" RAT_FUNC "%6.3" "%" COEFFS 0 327.680000003584 3.584063961170614e-007 0 0 1 /end COMPU_METHOD
/begin COMPU_METHOD _CNV_A_R_LINEAR_____299_CM "" RAT_FUNC "%6.3" "mg/stk" COEFFS 0 3020.046082949309 -0.499999999996362 0 0 1 /end COMPU_METHOD
/begin COMPU_METHOD _CNV_S_8_STATE_MFF__300_CM "" TAB_VERB "%6.3" "[-]" COMPU_TAB_REF _CNV_S_8_STATE_MFF__300 /end COMPU_METHOD
/begin COMPU_VTAB _CNV_S_8_STATE_MFF__300 "" TAB_VERB 8 0 "INIT" 1 "WAIT" 2 "CDN_ADD" 3 "ADAPT_ADD" 4 "CDN_FAC_L" 5 "CDN_FAC_H" 6 "ADAPT_FAC_L" 7 "ADAPT_FAC_H" /end COMPU_VTAB
/begin COMPU_METHOD _CNV_A_R_LINEAR_____302_CM "" RAT_FUNC "%6.3" "°C" COEFFS 0 64. 2112. 0 0 1 /end COMPU_METHOD
/begin COMPU_METHOD _CNV_A_R_LINEAR_____304_CM "" RAT_FUNC "%6.3" "-" COEFFS 0 1024. 0. 0 0 1 /end COMPU_METHOD
/begin COMPU_METHOD _CNV_A_R_LINEAR_____316_CM "" RAT_FUNC "%6.3" "V" COEFFS 0 204.8048048048048 0. 0 0 1 /end COMPU_METHOD
/begin COMPU_METHOD _CNV_A_R_LINEAR_____325_CM "" RAT_FUNC "%6.3" "s" COEFFS 0 3.333333333333333 1.110223024625157e-016 0 0 1 /end COMPU_METHOD
/begin COMPU_METHOD _CNV_A_R_LINEAR_____345_CM "" RAT_FUNC "%6.3" "-" COEFFS 0 8191.999999679995 0. 0 0 1 /end COMPU_METHOD
/begin COMPU_METHOD _CNV_S_231_RANGE_DIAG_384_CM "" TAB_VERB "%6.3" "[-]" COMPU_TAB_REF _CNV_S_231_RANGE_DIAG_384 /end COMPU_METHOD
/begin COMPU_VTAB _CNV_S_231_RANGE_DIAG_384 "" TAB_VERB 231 0 "NO_ERROR" 1 "TOIL" 2 "TCO_EX" 3 "TIA" 4 "AMP" 5 "MAF" 6 "VLS_DOWN_MAX_1" 7 "VLS_DOWN_MAX_2" 8 "VLS_DOWN_MIN_COLD_1" 9 "VLS_DOWN_MIN_COLD_2" 10 "VLS_DOWN_MIN_1" 11 "VLS_DOWN_MIN_2" 12 "VLS_DOWN_OC_1" 13 "VLS_DOWN_OC_2" 14 "IV_0" 15 "IV_1" 16 "IV_2" 17 "IV_3" 18 "IV_4" 19 "IV_5" 20 "LSH_UP_1" 21 "LSH_UP_2" 22 "LSH_DOWN_1" 23 "LSH_DOWN_2" 24 "RLY_EFP" 25 "CPS" 26 "MEC_IVVT_IN_1" 27 "MEC_IVVT_EX_1" 28 "REF_IVVT_IN_1" 29 "REF_IVVT_EX_1" 30 "SLV_IVVT_IN_1" 31 "SLV_IVVT_EX_1" 32 "PARK_IVVT_IN_1" 33 "PARK_IVVT_EX_1" 34 "ECU_CKS" 35 "TOIL_LEVEL" 36 "TOUT_ETCU_1" 37 "TOUT_ETCU_2" 38 "TOUT_ICL_2" 39 "TOUT_ICL_3" 40 "TOUT_ASR_1" 41 "TOUT_ASR_3" 42 "TOUT_ASR_4" 43 "TOUT_PSTE_1" 44 "TOUT_AMT_1" 45 "VS" 46 "KNKS_1" 47 "KNKS_2" 48 "TD_IGC_CUT_0" 49 "TD_IGC_CUT_1" 50 "TD_IGC_CUT_2" 51 "TD_IGC_CUT_3" 52 "TD_IGC_CUT_4" 53 "TD_IGC_CUT_5" 54 "DUR_IGC_0" 55 "DUR_IGC_1" 56 "DUR_IGC_2" 57 "DUR_IGC_3" 58 "DUR_IGC_4" 59 "DUR_IGC_5" 60 "TPS_1" 61 "TPS_2" 62 "TPS_MAF_1" 63 "TPS_MAF_2" 64 "V_REF_1" 65 "V_REF_2" 66 "PVS_1" 67 "PVS_2" 68 "PVS_RATIO" 69 "PVS_DOUBLE" 70 "PVS_BLS_NOT_PLAUS" 71 "MTC_DR" 72 "MTC_CTL_1" 73 "MTC_CTL_2" 74 "MTC_CTL_3" 75 "TPS_AD" 76 "TPS_AD_BOL" 77 "TPS_ST_CHK_1" 78 "TPS_ST_CHK_2" 79 "GEN" 80 "GEN_IF" 81 "GEN_DIAG" 82 "VIM" 83 "CAM_PER_0" 84 "CAM_PER_1" 85 "CAM_PSN_0" 86 "CAM_PSN_1" 87 "CAM_0_NOT_PLAUS" 88 "CAM_1_NOT_PLAUS" 89 "ENG_PSN" 90 "TOOTH_PER" 91 "TPU_SYN" 92 "CRK_NOT_PLAUS" 93 "TOUT_TXU_1" 94 "CAN_BOFF" 95 "RLY_MAIN" 96 "RLY_MAIN_DLY" 97 "RLY_ACCOUT" 98 "SAP" 99 "SAV" 100 "ECF" 101 "TCO_PLAUS" 102 "TCO_EL" 103 "TCO_GRD" 104 "TCO_STUCK" 105 "ECT_EL" 106 "ECT_MEC" 107 "ISC" 108 "IM_BLS_PLAUS" 109 "IM_BTS_PLAUS" 110 "MSW_TOG" 111 "MSW_2" 112 "MSW_3" 113 "ISA_1" 114 "ISA_2" 115 "SEG_T_AD" 116 "SEG_T" 117 "MIS_0" 118 "MIS_1" 119 "MIS_2" 120 "MIS_3" 121 "MIS_4" 122 "MIS_5" 123 "MIS_LOW_FUEL" 124 "MIS_MPL" 125 "CONV_MON_1" 126 "N_32_MON_1" 127 "PVS_MON_1" 128 "MAF_TPS_MON_1" 129 "TQ_DIF_ISC_MON_1" 130 "TQ_REQ_MON_1" 131 "TQ_EXT_MON_1" 132 "TQI_AV_MON_1" 133 "TQI_N_MAX_MON_1" 134 "CRU_INH_MON_1" 135 "TQI_N_MAX_NVMY_MON" 136 "SA_SAFM" 137 "SA_SAP" 138 "SA_SYS" 139 "SA_SAV" 140 "IMOB_1" 141 "IMOB_2" 142 "IMOB_3" 143 "FSD_1" 144 "FSD_2" 145 "LS_DOWN_SWT_1" 146 "LS_DOWN_SWT_2" 147 "LS_DOWN_PUE_1" 148 "LS_DOWN_PUE_2" 149 "EF" 150 "TECU" 151 "EBOX_CFA" 152 "ECU_RAM" 153 "TQI_LIM" 154 "OBD2_LSH_DOWN_1" 155 "OBD2_LSH_DOWN_2" 156 "DMTLS" 157 "DMTL_PUMP" 158 "DMTLM" 159 "DMTL_LEAK" 160 "SOF" 161 "SOF_REQ" 162 "RLY_ST" 163 "BSD" 164 "POIL_SWI" 165 "TOUT_EFP" 166 "DIAGCPS" 167 "TQ_GS_INC_PLAUS" 168 "DCC" 169 "ECRAS" 170 "DMTLH" 171 "CS" 172 "SPI_MPS" 173 "SPI_KNK" 174 "BN_TQ_DCC" 175 "BN_TQ_PSTE_2" 176 "BN_ARS" 177 "BN_CAS" 178 "BN_TQ_TCS" 179 "BN_VS_TCS" 180 "BN_TCS" 181 "BN_TQ_ETCU" 182 "BN_ETCU" 183 "BN_TQ_AMT" 184 "BN_ACC" 185 "BN_T_ICL" 186 "BN_VEH_MOD" 187 "BN_KM_ICL" 188 "BN_ICL" 189 "BN_POW_VB" 190 "BN_POW_GEN" 191 "BN_MSW" 192 "BN_ANG_PSTE" 193 "BN_EFP" 194 "LOAD_TPS_PLAUS" 195 "EFP_CRASH" 196 "EFP" 197 "LOCAN_BOFF" 198 "CHG_LS_UP" 199 "CHG_LS_DOWN" 200 "QOIL_SENS" 201 "BAT_SENS" 202 "BAT_SENS_IT" 203 "BAT_SENS_IT_EL" 204 "ECU_NVMY" 205 "GS" 206 "O3_CONC" 207 "OBD2_LSH_UP_1" 208 "OBD2_LSH_UP_2" 209 "CAT_DIAG_1" 210 "CAT_DIAG_2" 211 "CHK_LS_DOWN_1" 212 "CHK_LS_DOWN_2" 213 "VLS_UP_MIN_COLD_1" 214 "VLS_UP_MIN_COLD_2" 215 "VLS_UP_MIN_1" 216 "VLS_UP_MIN_2" 217 "VLS_UP_MAX_1" 218 "VLS_UP_MAX_2" 219 "VLS_UP_OC_1" 220 "VLS_UP_OC_2" 221 "VLS_UP_PUC_1" 222 "VLS_UP_PUC_2" 223 "VLS_UP_STK_1" 224 "VLS_UP_STK_2" 225 "LAM_DLY_1" 226 "LAM_DLY_2" 227 "LS_UP_SWT_1" 228 "LS_UP_SWT_2" 229 "LS_UP_FRQ_1" 230 "LS_UP_FRQ_2" /end COMPU_VTAB
/begin COMPU_METHOD _CNV_A_R_LINEAR_____385_CM "" RAT_FUNC "%6.3" "°C" COEFFS 0 0.25 0. 0 0 1 /end COMPU_METHOD
/begin COMPU_METHOD _CNV_A_R_LINEAR_____388_CM "" RAT_FUNC "%6.3" "-" COEFFS 0 2. 0. 0 0 1 /end COMPU_METHOD
/begin COMPU_METHOD _CNV_A_R_LINEAR_____438_CM "" RAT_FUNC "%6.3" "hPa" COEFFS 0 1.466461170408539e-003 0. 0 0 1 /end COMPU_METHOD
/begin RECORD_LAYOUT _REC_VAL_20_u1 FNC_VALUES 1 UBYTE COLUMN_DIR DIRECT /end RECORD_LAYOUT
/begin RECORD_LAYOUT _REC_VAL_20_u2 FNC_VALUES 1 UWORD COLUMN_DIR DIRECT /end RECORD_LAYOUT
/begin RECORD_LAYOUT _REC_CUR_20_u2_u1 FNC_VALUES 1 UWORD COLUMN_DIR DIRECT /end RECORD_LAYOUT
/begin RECORD_LAYOUT _REC_AXS_20_u1 NO_AXIS_PTS_X 1 UBYTE AXIS_PTS_X 2 UBYTE INDEX_INCR DIRECT /end RECORD_LAYOUT
/begin RECORD_LAYOUT _REC_MAP_20_u1_u1_u1 FNC_VALUES 1 UBYTE COLUMN_DIR DIRECT /end RECORD_LAYOUT
/begin RECORD_LAYOUT _REC_CUR_20_u1_u1 FNC_VALUES 1 UBYTE COLUMN_DIR DIRECT /end RECORD_LAYOUT
/begin RECORD_LAYOUT _REC_AXS_20_u2 NO_AXIS_PTS_X 1 UWORD AXIS_PTS_X 2 UWORD INDEX_INCR DIRECT /end RECORD_LAYOUT
/begin RECORD_LAYOUT _REC_MAP_20_u1_u1_u2 FNC_VALUES 1 UBYTE COLUMN_DIR DIRECT /end RECORD_LAYOUT
/begin RECORD_LAYOUT _REC_MAP_20_u2_u2_u1 FNC_VALUES 1 UWORD COLUMN_DIR DIRECT /end RECORD_LAYOUT
/begin RECORD_LAYOUT _REC_CUR_20_u1_u2 FNC_VALUES 1 UBYTE COLUMN_DIR DIRECT /end RECORD_LAYOUT
/begin RECORD_LAYOUT _REC_CUR_20_u2_u2 FNC_VALUES 1 UWORD COLUMN_DIR DIRECT /end RECORD_LAYOUT
/begin RECORD_LAYOUT _REC_VAL_20_s2 FNC_VALUES 1 SWORD COLUMN_DIR DIRECT /end RECORD_LAYOUT
/begin RECORD_LAYOUT _REC_MAP_20_u2_u1_u2 FNC_VALUES 1 UWORD COLUMN_DIR DIRECT /end RECORD_LAYOUT
/begin RECORD_LAYOUT _REC_MAP_20_u1_u2_u2 FNC_VALUES 1 UBYTE COLUMN_DIR DIRECT /end RECORD_LAYOUT
/begin FUNCTION INJ_Application_incidences_for_c "_Application incidences for catalyst enrichment function"
 /begin DEF_CHARACTERISTIC c_tco_act_puc_min c_n_max_cat_purge c_temp_dif_pcat_main_cat c_maf_cyl_act_int_puc_max c_thd_vls_up_cat_purge c_thd_delta_lamb_sp_puc /end DEF_CHARACTERISTIC
 /begin OUT_MEASUREMENT lam_bank_1.lam_puc_inci.bf.lv_inh_int_puc lam_bank_1.lam_puc_inci.bf.lv_act_int_puc_afl lam_bank_1.lam_puc_inci.temp_main_cat lam_bank_1.lam_puc_inci.temp_pcat lam_bank_2.lam_puc_inci.bf.lv_inh_int_puc lam_bank_2.lam_puc_inci.bf.lv_act_int_puc_afl lam_bank_2.lam_puc_inci.temp_main_cat lam_bank_2.lam_puc_inci.temp_pcat /end OUT_MEASUREMENT
/end FUNCTION
/begin FUNCTION INJ_Fuel_mass_setpoint_and_pre_i "_Fuel mass setpoint and pre injection time calculation"
 /begin DEF_CHARACTERISTIC c_cyc_cast_h_prs ip_mff_cst ip_mff_deac_cst ip_fup_min_inj_st c_tco_st_h_prs id_fac_tipr_deac ip_mffpr_cst ip_mffpr_fac_st_es /end DEF_CHARACTERISTIC
 /begin OUT_MEASUREMENT lv_st_h_prs mff_cst lv_mff_cst_fup_act cyc_cast_fup_thd bios_tipr_bas[0] bios_tipr_bas[1] bios_tipr_bas[2] bios_tipr_bas[3] bios_tipr_bas[4] bios_tipr_bas[5] bios_eoi_min_tipr bios_nr_max_tooth_tipr cycnr_cst tipr[0] tipr[1] tipr[2] tipr[3] tipr[4] tipr[5] mffpr mffpr_cst /end OUT_MEASUREMENT
/end FUNCTION
/begin FUNCTION INJ_Application_Incidences_for_D "_Application Incidences for Downstream fuel trim" /begin DEF_CHARACTERISTIC id_crlc_vls_down_t_dly /end DEF_CHARACTERISTIC
 /begin OUT_MEASUREMENT lam_bank_1.lam_dly_prj.lv_inh_lam_dly lam_bank_1.lam_dly_prj.vls_down_av lam_bank_2.lam_dly_prj.lv_inh_lam_dly lam_bank_2.lam_dly_prj.vls_down_av /end OUT_MEASUREMENT
/end FUNCTION
/begin FUNCTION INJ_Application_incidences_for_u "_Application incidences for upstream oxygen sensor heater management" /end FUNCTION
/begin FUNCTION INJ_Application_incidences_for_d "_Application incidences for downstream oxygen sensor heater management" /begin DEF_CHARACTERISTIC lc_lsh_down_1 lc_lsh_down_2 /end DEF_CHARACTERISTIC
 /begin OUT_MEASUREMENT lam_bank_1.lsh_down_inci.lv_inh_lsh_down lam_bank_1.lsh_down_inci.temp_ls_down_ini lam_bank_2.lsh_down_inci.lv_inh_lsh_down lam_bank_2.lsh_down_inci.temp_ls_down_ini /end OUT_MEASUREMENT
/end FUNCTION
/begin FUNCTION INJ_Lambda_Adaptation "_Lambda Adaptation"
 /begin DEF_CHARACTERISTIC c_mff_ad_cor_crlc c_lam_ad_sum_p_is c_lam_ad_sum_p ip_mff_ad_add_fac ip_mff_ad_fac_fac c_n_mff_ad_add_max c_maf_mff_ad_add_max c_mff_ad_add_min c_mff_ad_add_max id_t_mff_ad_add lc_mff_ad_add c_t_mff_ad_min_max ip_mff_ad_fac ip_mff_ad_add c_maf_mff_ad_fac_l_min c_n_mff_ad_fac_h_min lc_mff_ad_fac_l lc_mff_ad_fac_h c_mff_ad_cor_crlc_is c_mff_ad_cor_crlc_h c_mff_ad_fac_l_min c_mff_ad_fac_h_min c_mff_ad_fac_l_max c_mff_ad_fac_h_max c_n_mff_ad_fac_l_min c_n_mff_ad_fac_h_max c_maf_mff_ad_fac_h_max c_maf_kgh_ad_fac_l c_maf_kgh_ad_fac_h id_t_mff_ad_fac_l id_t_mff_ad_fac_h ip_maf_mff_ad_fac_l_max ip_maf_mff_ad_fac_l_min ip_maf_mff_ad_fac_h_min /end DEF_CHARACTERISTIC
 /begin OUT_MEASUREMENT t_mff_ad_min lv_mff_ad_end lv_mff_ad_ena_first lv_lamb_ad_afs_req lv_mff_ad_cdn lam_bank_1.lam_ad.bf.lv_lam_adj_ad lam_bank_1.lam_ad.bf.lv_lam_ad_stop lam_bank_1.lam_ad.bf.lv_mff_ad_fac_h_lim lam_bank_1.lam_ad.bf.lv_mff_ad_add_lim lam_bank_1.lam_ad.bf.lv_mff_ad_fac_l_lim lam_bank_1.lam_ad.mff_ad_add_mmv_rel lam_bank_1.lam_ad.mff_ad_add_mmv_rel_quo lam_bank_1.lam_ad.mff_ad_fac_mmv_rel lam_bank_1.lam_ad.mff_ad_add_mmv lam_bank_1.lam_ad.mff_ad_fac_mmv lam_bank_1.lam_ad.lam_adj_ad lam_bank_1.lam_ad.mff_ad_add_mmv_delta lam_bank_1.lam_ad.mff_ad_add_mmv_delta_h_res lam_bank_1.lam_ad.mff_ad_fac_mmv_delta_l lam_bank_1.lam_ad.mff_sae_ad_mmv_rel lam_bank_1.lam_ad.lam_ad_sum_p lam_bank_1.lam_ad.state_mff_ad lam_bank_1.lam_ad.t_mff_ad_fac lam_bank_1.lam_ad.t_mff_ad_add lam_bank_1.lam_ad.mff_ad_fac_mmv_delta_h lam_bank_1.lam_ad.mff_ad_fac_mmv_l lam_bank_1.lam_ad.mff_ad_fac_mmv_h lam_bank_2.lam_ad.bf.lv_lam_adj_ad lam_bank_2.lam_ad.bf.lv_lam_ad_stop lam_bank_2.lam_ad.bf.lv_mff_ad_fac_h_lim lam_bank_2.lam_ad.bf.lv_mff_ad_add_lim lam_bank_2.lam_ad.bf.lv_mff_ad_fac_l_lim lam_bank_2.lam_ad.mff_ad_add_mmv_rel lam_bank_2.lam_ad.mff_ad_add_mmv_rel_quo lam_bank_2.lam_ad.mff_ad_fac_mmv_rel lam_bank_2.lam_ad.mff_ad_add_mmv lam_bank_2.lam_ad.mff_ad_fac_mmv lam_bank_2.lam_ad.lam_adj_ad lam_bank_2.lam_ad.mff_ad_add_mmv_delta lam_bank_2.lam_ad.mff_ad_add_mmv_delta_h_res lam_bank_2.lam_ad.mff_ad_fac_mmv_delta_l lam_bank_2.lam_ad.mff_sae_ad_mmv_rel lam_bank_2.lam_ad.lam_ad_sum_p lam_bank_2.lam_ad.state_mff_ad lam_bank_2.lam_ad.t_mff_ad_fac lam_bank_2.lam_ad.t_mff_ad_add lam_bank_2.lam_ad.mff_ad_fac_mmv_delta_h lam_bank_2.lam_ad.mff_ad_fac_mmv_l lam_bank_2.lam_ad.mff_ad_fac_mmv_h /end OUT_MEASUREMENT
/end FUNCTION
/begin FUNCTION INJ_Injection_Phase_for_Stratifi "_Injection Phase for Stratified Mode" /end FUNCTION
/begin FUNCTION INJ_Restart_function "_Restart function" /begin OUT_MEASUREMENT ti_st_rest /end OUT_MEASUREMENT /end FUNCTION
/begin FUNCTION INJ_MFF_Split_Up_for_DUI_at_Stra "_MFF Split Up for DUI at Stratified Mode" /end FUNCTION
/begin FUNCTION INJ_Application_incidences_for_i "_Application incidences for injection mode management"
 /begin DEF_CHARACTERISTIC c_tco_dui_min_st c_tco_dui_max_st c_tqi_dui_thd c_cyc_cast_dui_thd /end DEF_CHARACTERISTIC
 /begin OUT_MEASUREMENT lv_dui_inj_req lv_ch_s_req lv_t_tqi_swi_supp /end OUT_MEASUREMENT
/end FUNCTION
/begin FUNCTION INJ_Application_incidences_for_s "_Application incidences for some injection functions"
 /begin DEF_CHARACTERISTIC ldp_seg_nr_id_ctr_cyl_nr_clc id_ctr_cyl_nr_clc c_seg_nr_st_clc_red c_n_32_thd_clc_red c_n_32_hys_clc_red /end DEF_CHARACTERISTIC
 /begin OUT_MEASUREMENT state_clc_red ctr_cyl_nr_clc ctr_cbk_nr_clc /end OUT_MEASUREMENT
/end FUNCTION
/begin FUNCTION INJ_Upstream_oxygen_sensor_opera "_Upstream oxygen sensor operative readiness detection"
 /begin DEF_CHARACTERISTIC c_temp_min_ls_up c_r_min_ls_ready c_vls_afl_max_diag c_vls_afr_min_diag id_t_dly_ls_ready /end DEF_CHARACTERISTIC
 /begin OUT_MEASUREMENT lv_dly_ls_ready lv_t_min_ls /end OUT_MEASUREMENT
/end FUNCTION
/begin FUNCTION INJ_Downstream_oxygen_sensor_ope "_Downstream oxygen sensor operative readiness detection"
 /begin DEF_CHARACTERISTIC c_temp_cat_down_ls_ready c_vls_down_afl_ready c_vls_down_afr_ready c_maf_int_puc_max_down_ls_ready /end DEF_CHARACTERISTIC
/end FUNCTION
/begin FUNCTION INJ_Application_incidence_exhaus "_Application incidence exhaust gas temperature model"
 /begin OUT_MEASUREMENT teg_1.appl_inc_struct.lamb_sp_teg teg_1.appl_inc_struct.eff_iga_av_teg teg_1.appl_inc_struct.nr_cyl_scc_teg teg_2.appl_inc_struct.lamb_sp_teg teg_2.appl_inc_struct.eff_iga_av_teg teg_2.appl_inc_struct.nr_cyl_scc_teg temp_cat maf_teg maf_int_teg_st maf_kgh_teg n_teg teg_dyn teg_cat_up_mdl_1 teg_cat_up_mdl_2 teg_cat_down_mdl_2 teg_cat_down_mdl_1 /end OUT_MEASUREMENT
/end FUNCTION
/begin FUNCTION INJ_Lambda_Setpoint_for_Single_C "_Lambda Setpoint for Single Cylinder Fuel Shut Off" /begin DEF_CHARACTERISTIC ip_lamb_scc /end DEF_CHARACTERISTIC /begin OUT_MEASUREMENT lam_bank_1.lamb_scc.lamb_scc lam_bank_2.lamb_scc.lamb_scc /end OUT_MEASUREMENT /end FUNCTION
/begin FUNCTION INJ_CO_adjustment_at_idling "_CO adjustment at idling" /begin DEF_CHARACTERISTIC c_tco_cat_var /end DEF_CHARACTERISTIC
 /begin OUT_MEASUREMENT lam_bank_1.lam_co.mff_ad_add_mmv_co lam_bank_1.lam_co.mff_ad_add_mmv_rel_co lam_bank_2.lam_co.mff_ad_add_mmv_co lam_bank_2.lam_co.mff_ad_add_mmv_rel_co /end OUT_MEASUREMENT
/end FUNCTION
/begin FUNCTION INJ_Application_incidences_for_C "_Application incidences for cylinder-selective mixture control and Adaptation function"
 /begin DEF_CHARACTERISTIC ip_maf_min_cyl_lam ip_maf_max_cyl_lam c_n_max_cyl_lam c_vls_cyc_ratio_mv_max c_toil_min_cyl_lam lc_cdn_lscl_cyl_lam /end DEF_CHARACTERISTIC
 /begin OUT_MEASUREMENT lv_cyl_lam_act[0] lv_cyl_lam_act[1] /end OUT_MEASUREMENT
/end FUNCTION
/begin FUNCTION INJ_Inhibition_Conditions_for_OB "Inhibition Conditions for OBDII oxygen downstream heater diagnosis" /begin DEF_CHARACTERISTIC c_tco_min_obd2_lsh_down /end DEF_CHARACTERISTIC /begin OUT_MEASUREMENT lv_inh_diag_obd2_lsh_down_1 lv_inh_diag_obd2_lsh_down_2 /end OUT_MEASUREMENT /end FUNCTION
/begin FUNCTION INJ_Application_specific_conditi "INJ_Application specific conditions for oxygen sensor internal resistance" /begin DEF_CHARACTERISTIC c_tco_cur_on_ls_down_min c_tco_cur_on_ls_up_min /end DEF_CHARACTERISTIC /end FUNCTION
/begin FUNCTION INJ_Inhibition_conditions_for_OB "Inhibition conditions for OBDII oxygen upstream heater diagnosis" /begin DEF_CHARACTERISTIC c_tco_min_obd2_lsh_up /end DEF_CHARACTERISTIC /end FUNCTION
/begin FUNCTION ISC_Idle_Speed_Control_Adaptatio "ISC"
 /begin SUB_FUNCTION ISC_Idle_speed_control ISC_Idle_speed_Adaptation ISC_Idle_speed_torque_reserve ISC_Application_Incidence_for_Id ISC_Adaptation_Condition ISC__Adaptation_Algorithm ISC_Torque_Reserve_for_canister_ /end SUB_FUNCTION
/end FUNCTION
/begin FUNCTION ISC_Idle_speed_control "_Idle speed control"
 /begin DEF_CHARACTERISTIC c_t_ramp_lim_i_dt_is c_t_ramp_lim_p_d_dt_is c_t_ramp_lim_p_d_is c_tq_bol_i_dt_is c_tq_bol_i_is c_tq_tol_i_dt_is c_tq_tol_i_is ip_tq_i_dt_is lc_tq_dif_i_inh_as lc_tq_dif_p_d_inh_as ip_fac_p_d_fast_tco_is ip_fac_p_d_slow_tco_is ip_tq_i_is lc_isc_inh lc_tq_add_i_inh_as ip_p_d_dt_is ip_p_d_dt_is_slow ip_p_d_is ip_p_d_is_slow id_fac_p_d_dt_is id_fac_p_d_dt_is_slow ip_fac_n_grd_is lc_tq_p_d_slow_inh_as lc_tq_p_d_fast_inh_as ip_fac_n_grd_is_slow ip_fac_t_ast_i_is ip_tq_pas_i_acc_is ip_tq_pas_i_is c_t_ramp_lim_i_is lc_p_d_slow_fast_sel_ena c_crlc_n_grd c_nr_buf_n_grd_fil lc_n_grd_fil_p_d_swi lc_n_grd_fil_i_swi /end DEF_CHARACTERISTIC
 /begin OUT_MEASUREMENT tq_dif_p_d_fast_is tq_dif_i_is tq_add_i_is n_grd_fil_is n_grd_p_d_is n_grd_i_is lv_pas_ramp_act_p_d_is lv_pas_ramp_act_i_is tq_add_i_ramp state_p_d_isc state_i_isc tq_dif_p_d_slow_is tq_dif_p_d_is_slow tq_dif_p_d_is_fast tq_add_p_d_ramp_fast tq_add_p_d_ramp_slow lv_tq_p_d_act_fast lv_tq_p_d_act_slow tq_dif_p_d_dt_is_1 tq_dif_p_d_dt_is_1_slow fac_n_grd_is fac_n_grd_is_slow lv_req_isc /end OUT_MEASUREMENT
/end FUNCTION
/begin FUNCTION ISC_Idle_speed_Adaptation "_Idle speed Adaptation"
 /begin DEF_CHARACTERISTIC c_fac_tq_is_ad_conv_max c_fac_tq_is_ad_conv_min c_tq_is_ad_acc_min c_tq_is_ad_max c_tq_is_ad_min c_fac_tq_is_ad_acc c_fac_tq_is_ad_conv c_fac_tq_is_ad_acc_conv c_tq_is_ad_acc_max c_tq_is_ad_acc_conv_max c_tq_is_ad_acc_conv_min c_fac_tq_is_ad c_crlc_tq_dif_is_ad_acc c_fac_tq_is_ad_conv_can c_tq_is_ad_conv_can_min c_tq_is_ad_conv_can_max c_n_delta c_tco_ad_min_is c_tco_ad_max_is c_dly_is_ad /end DEF_CHARACTERISTIC
/end FUNCTION
/begin FUNCTION ISC_Idle_speed_torque_reserve "_Idle speed torque reserve"
 /begin DEF_CHARACTERISTIC ip_t_n_dif_ofs_pred__n c_tq_add_is_bol_crlc c_tq_dif_add_is_tol ip_fac_tq_add_is_bol_dri ip_tq_add_is_bol_bas ip_lgrd_tq_add_is_bol ip_t_n_dif_ofs_pred_cs__n ip_fac_tq_add_is_bol_cs ip_fac_tq_add_is_bol ip_fac_temp_tq_add_is_bas /end DEF_CHARACTERISTIC
 /begin OUT_MEASUREMENT n_dif_ofs_pred t_n_dif_ofs_pred n_dif_pred tq_add_is_bol tq_dif_add_is_tol t_n_dif_ofs_pred_cs n_dif_ofs_pred_cs n_dif_pred_cs fac_tq_add_is_bol /end OUT_MEASUREMENT
/end FUNCTION
/begin FUNCTION ISC_Application_Incidence_for_Id "_Application Incidence for Idle Speed Control"
 /begin DEF_CHARACTERISTIC lc_isc_act_cdn_swi lc_isc_act_ast_cdn_swi c_n_dif_isc_act_ast c_crlc_n_grd_fil_isc_act_ast c_t_dly_isc_act_pu /end DEF_CHARACTERISTIC
 /begin OUT_MEASUREMENT state_req_isc lv_neg_n_grd_fil_mem n_grd_fil_isc_act_ast lv_is_ad_inh_obd lv_is_ad_inh /end OUT_MEASUREMENT
/end FUNCTION
/begin FUNCTION ISC_Adaptation_Condition "_Adaptation Condition" /begin OUT_MEASUREMENT lv_is_ad_cnd lv_tco_ad_cnd_is lv_dly_ad_is /end OUT_MEASUREMENT /end FUNCTION
/begin FUNCTION ISC__Adaptation_Algorithm "_ Adaptation Algorithm"
 /begin OUT_MEASUREMENT fac_tq_is_ad_conv tq_dif_is_ad_acc_1 tq_dif_is_ad_acc_conv tq_dif_is_ad tq_dif_is_ad_inter tq_dif_is_ad_acc_1_inter tq_dif_is_ad_acc_conv_inter tq_dif_is_ad_acc tq_dif_is_ad_conv tq_dif_is_ad_conv_inter /end OUT_MEASUREMENT
/end FUNCTION
/begin FUNCTION ISC_Torque_Reserve_for_canister_ "_Torque Reserve for canister purge at idle" /begin DEF_CHARACTERISTIC ip_tq_add_cp__cl_mmv c_crlc_tq_add_cp lc_tq_add_cp_inh /end DEF_CHARACTERISTIC /begin OUT_MEASUREMENT tq_add_cp /end OUT_MEASUREMENT /end FUNCTION
/begin FUNCTION OBD_OBD_II_Function "OBD"
 /begin SUB_FUNCTION OBD_Oxygen_downstream_sensor_act OBD_Dynamic_Error_management OBD_Misfire_detection OBD_Rough_road_detection OBD_History_memory OBD_Fuel_system_diagnosis OBD_Similar_conditions OBD_Lamp_management OBD_Activation_conditions_for_ca OBD_Cat_Efficiency_Diagnosis__OS OBD_Limited_dynamic_for_catalyst OBD_Oxygen_Sensor_diagnosis_with OBD_Diagnosis_of_monitor_sensors OBD_SA_system_monitoring_through OBD_Readiness_code OBD_Upstream_oxygen_sensor_heate OBD_Application_incidences_Secon OBD_Tank_leakage_diagnosis_based OBD_Cycle_manager OBD_Environmental_Data OBD_Diagnostic_Trouble_Code OBD_Failure_class OBD_Application_incidences_for_f OBD_Application_incidence_cataly OBD_Downstream_oxygen_sensor_hea OBD_SA_system_diagnosis_through_ OBD_Application_incidences_for_S OBD_Functional_Check_CPS OBD_Load_Throttle_position_ratio OBD_Application_incidences_Load_ OBD_Application_incidence_Oxygen OBD_Oxygen_Sensor_Interchanged_S OBD_OBD_II_diagnosis_of_the_lamb OBD_Application_incidences_of_Dy OBD_Application_incidence_enviro OBD_Application_incidences_of_th OBD_Statistical_data_for_once_pe /end SUB_FUNCTION
/end FUNCTION
/begin FUNCTION OBD_Oxygen_downstream_sensor_act "_Oxygen downstream sensor active plausibility check"
 /begin DEF_CHARACTERISTIC c_vls_down_thd_afl_diag c_vls_down_thd_afr_diag c_maf_int_puc_vls_down c_maf_int_vls_down c_maf_int_afr_max_diag c_maf_int_afl_max_diag c_t_dly_ls_diag_min c_tco_vls_down_diag_min c_t_ast_vls_down_diag c_lamb_sp_ls_act_afr c_lamb_sp_ls_act_afl /end DEF_CHARACTERISTIC
 /begin OUT_MEASUREMENT lam_bank_1.ls_act_chk_pl.bf.lv_req_lamb_sp_ls_act_test lam_bank_1.ls_act_chk_pl.bf.lv_vls_down_afl lam_bank_1.ls_act_chk_pl.bf.lv_vls_down_afr lam_bank_1.ls_act_chk_pl.bf.lv_end_cyc_chk_ls_down lam_bank_1.ls_act_chk_pl.bf.lv_vls_down_maf_int_puc lam_bank_1.ls_act_chk_pl.bf.lv_vls_down_maf_int lam_bank_1.ls_act_chk_pl.lamb_sp_ls_act_test lam_bank_1.ls_act_chk_pl.maf_int_puc_vls_down lam_bank_1.ls_act_chk_pl.maf_int_vls_down lam_bank_1.ls_act_chk_pl.maf_int_diag_afr lam_bank_1.ls_act_chk_pl.maf_int_diag_afl lam_bank_2.ls_act_chk_pl.bf.lv_req_lamb_sp_ls_act_test lam_bank_2.ls_act_chk_pl.bf.lv_vls_down_afl lam_bank_2.ls_act_chk_pl.bf.lv_vls_down_afr lam_bank_2.ls_act_chk_pl.bf.lv_end_cyc_chk_ls_down lam_bank_2.ls_act_chk_pl.bf.lv_vls_down_maf_int_puc lam_bank_2.ls_act_chk_pl.bf.lv_vls_down_maf_int lam_bank_2.ls_act_chk_pl.lamb_sp_ls_act_test lam_bank_2.ls_act_chk_pl.maf_int_puc_vls_down lam_bank_2.ls_act_chk_pl.maf_int_vls_down lam_bank_2.ls_act_chk_pl.maf_int_diag_afr lam_bank_2.ls_act_chk_pl.maf_int_diag_afl lv_err_chk_ls_down_1 lv_err_chk_ls_down_2 /end OUT_MEASUREMENT
/end FUNCTION
/begin FUNCTION OBD_Dynamic_Error_management "_Dynamic Error management" /begin DEF_CHARACTERISTIC lc_clr_fmy c_ctr_max_wup_cyc lc_ena_scdn /end DEF_CHARACTERISTIC
 /begin OUT_MEASUREMENT ctr_err_dyn_nr fmy_ram_dyn[0].ctr_frc fmy_ram_dyn[0].ctr_wup_cyc fmy_ram_dyn[0].ctr_dc fmy_ram_dyn[0].err_info_dyn fmy_ram_dyn[0].err_info_dyn.bit_5 fmy_ram_dyn[0].err_info_dyn.bit_6 fmy_ram_dyn[0].err_info_dyn.bit_8 fmy_ram_dyn[0].err_info_dyn.bit_9 fmy_ram_dyn[0].err_info_dyn.bit_7 fmy_ram_dyn[0].err_info_dyn.bit_10 fmy_ram_dyn[0].diag_inst fmy_ram_dyn[1].ctr_frc fmy_ram_dyn[1].ctr_wup_cyc fmy_ram_dyn[1].ctr_dc fmy_ram_dyn[1].err_info_dyn fmy_ram_dyn[1].err_info_dyn.bit_5 fmy_ram_dyn[1].err_info_dyn.bit_6 fmy_ram_dyn[1].err_info_dyn.bit_8 fmy_ram_dyn[1].err_info_dyn.bit_9 fmy_ram_dyn[1].err_info_dyn.bit_7 fmy_ram_dyn[1].err_info_dyn.bit_10 fmy_ram_dyn[1].diag_inst fmy_ram_dyn[2].ctr_frc fmy_ram_dyn[2].ctr_wup_cyc fmy_ram_dyn[2].ctr_dc fmy_ram_dyn[2].err_info_dyn fmy_ram_dyn[2].err_info_dyn.bit_5 fmy_ram_dyn[2].err_info_dyn.bit_6 fmy_ram_dyn[2].err_info_dyn.bit_8 fmy_ram_dyn[2].err_info_dyn.bit_9 fmy_ram_dyn[2].err_info_dyn.bit_7 fmy_ram_dyn[2].err_info_dyn.bit_10 fmy_ram_dyn[2].diag_inst fmy_ram_dyn[3].ctr_frc fmy_ram_dyn[3].ctr_wup_cyc fmy_ram_dyn[3].ctr_dc fmy_ram_dyn[3].err_info_dyn fmy_ram_dyn[3].err_info_dyn.bit_5 fmy_ram_dyn[3].err_info_dyn.bit_6 fmy_ram_dyn[3].err_info_dyn.bit_8 fmy_ram_dyn[3].err_info_dyn.bit_9 fmy_ram_dyn[3].err_info_dyn.bit_7 fmy_ram_dyn[3].err_info_dyn.bit_10 fmy_ram_dyn[3].diag_inst fmy_ram_dyn[4].ctr_frc fmy_ram_dyn[4].ctr_wup_cyc fmy_ram_dyn[4].ctr_dc fmy_ram_dyn[4].err_info_dyn fmy_ram_dyn[4].err_info_dyn.bit_5 fmy_ram_dyn[4].err_info_dyn.bit_6 fmy_ram_dyn[4].err_info_dyn.bit_8 fmy_ram_dyn[4].err_info_dyn.bit_9 fmy_ram_dyn[4].err_info_dyn.bit_7 fmy_ram_dyn[4].err_info_dyn.bit_10 fmy_ram_dyn[4].diag_inst fmy_ram_dyn[5].ctr_frc fmy_ram_dyn[5].ctr_wup_cyc fmy_ram_dyn[5].ctr_dc fmy_ram_dyn[5].err_info_dyn fmy_ram_dyn[5].err_info_dyn.bit_5 fmy_ram_dyn[5].err_info_dyn.bit_6 fmy_ram_dyn[5].err_info_dyn.bit_8 fmy_ram_dyn[5].err_info_dyn.bit_9 fmy_ram_dyn[5].err_info_dyn.bit_7 fmy_ram_dyn[5].err_info_dyn.bit_10 fmy_ram_dyn[5].diag_inst fmy_ram_dyn[6].ctr_frc fmy_ram_dyn[6].ctr_wup_cyc fmy_ram_dyn[6].ctr_dc fmy_ram_dyn[6].err_info_dyn fmy_ram_dyn[6].err_info_dyn.bit_5 fmy_ram_dyn[6].err_info_dyn.bit_6 fmy_ram_dyn[6].err_info_dyn.bit_8 fmy_ram_dyn[6].err_info_dyn.bit_9 fmy_ram_dyn[6].err_info_dyn.bit_7 fmy_ram_dyn[6].err_info_dyn.bit_10 fmy_ram_dyn[6].diag_inst fmy_ram_dyn[7].ctr_frc fmy_ram_dyn[7].ctr_wup_cyc fmy_ram_dyn[7].ctr_dc fmy_ram_dyn[7].err_info_dyn fmy_ram_dyn[7].err_info_dyn.bit_5 fmy_ram_dyn[7].err_info_dyn.bit_6 fmy_ram_dyn[7].err_info_dyn.bit_8 fmy_ram_dyn[7].err_info_dyn.bit_9 fmy_ram_dyn[7].err_info_dyn.bit_7 fmy_ram_dyn[7].err_info_dyn.bit_10 fmy_ram_dyn[7].diag_inst fmy_ram_dyn[8].ctr_frc fmy_ram_dyn[8].ctr_wup_cyc fmy_ram_dyn[8].ctr_dc fmy_ram_dyn[8].err_info_dyn fmy_ram_dyn[8].err_info_dyn.bit_5 fmy_ram_dyn[8].err_info_dyn.bit_6 fmy_ram_dyn[8].err_info_dyn.bit_8 fmy_ram_dyn[8].err_info_dyn.bit_9 fmy_ram_dyn[8].err_info_dyn.bit_7 fmy_ram_dyn[8].err_info_dyn.bit_10 fmy_ram_dyn[8].diag_inst fmy_ram_dyn[9].ctr_frc fmy_ram_dyn[9].ctr_wup_cyc fmy_ram_dyn[9].ctr_dc fmy_ram_dyn[9].err_info_dyn fmy_ram_dyn[9].err_info_dyn.bit_5 fmy_ram_dyn[9].err_info_dyn.bit_6 fmy_ram_dyn[9].err_info_dyn.bit_8 fmy_ram_dyn[9].err_info_dyn.bit_9 fmy_ram_dyn[9].err_info_dyn.bit_7 fmy_ram_dyn[9].err_info_dyn.bit_10 fmy_ram_dyn[9].diag_inst /end OUT_MEASUREMENT
/end FUNCTION
/begin FUNCTION OBD_Misfire_detection "_Misfire detection" /end FUNCTION
/begin FUNCTION OBD_Rough_road_detection "_Rough road detection"
 /begin DEF_CHARACTERISTIC c_vs_min_rr c_vs_max_rr c_wheel_grd_crlc_rr c_dly_er_rr ip_wheel_grd_mmv_thd_at__vs ip_wheel_grd_mmv_thd_mt__vs /end DEF_CHARACTERISTIC
 /begin OUT_MEASUREMENT lv_state_rr seg_t_mes_0_rr seg_t_mes_1_rr wheel_grd_mmv wheel_grd_mmv_thd sum_rr /end OUT_MEASUREMENT
/end FUNCTION
/begin FUNCTION OBD_History_memory "_History memory" /begin DEF_CHARACTERISTIC lc_clr_his_fmy /end DEF_CHARACTERISTIC
 /begin OUT_MEASUREMENT ctr_err_his_nr fmy_his_cod[0] fmy_his_cod[1] fmy_his_cod[2] fmy_his_cod[3] fmy_his_cod[4] fmy_his_cod[5] fmy_his_cod[6] fmy_his_cod[7] fmy_his_cod[8] fmy_his_cod[9] /end OUT_MEASUREMENT
/end FUNCTION
/begin FUNCTION OBD_Fuel_system_diagnosis "_Fuel system diagnosis"
 /begin DEF_CHARACTERISTIC c_lam_min_fsd c_lam_max_fsd c_t_sum_max_max_fsd c_t_sum_min_max_fsd c_t_sum_rst_max_fsd c_n_min_fsd c_maf_min_fsd c_tco_min_fsd id_stop_inc_fsd__tco_st id_stop_dec_fsd__toil_max c_stop_max_fsd c_amp_min_fsd c_tam_min_fsd c_t_min_maf_fsd c_t_dly_maf_fsd c_n_min_mff_ad_add_fsd c_maf_min_mff_ad_add_fsd c_fac_cp_fsd /end DEF_CHARACTERISTIC
 /begin OUT_MEASUREMENT lam_bank_1.fsd_obd2.t_sum_max_fsd lam_bank_1.fsd_obd2.t_sum_min_fsd lam_bank_1.fsd_obd2.t_sum_end_diag_win_fsd lam_bank_1.fsd_obd2.t_sum_rst_fsd lam_bank_2.fsd_obd2.t_sum_max_fsd lam_bank_2.fsd_obd2.t_sum_min_fsd lam_bank_2.fsd_obd2.t_sum_end_diag_win_fsd lam_bank_2.fsd_obd2.t_sum_rst_fsd toil_max ctr_stop_fsd lv_err_fsd_1 lv_err_fsd_2 /end OUT_MEASUREMENT
/end FUNCTION
/begin FUNCTION OBD_Similar_conditions "_Similar conditions" /begin DEF_CHARACTERISTIC c_ctr_scdn_equ_dc_max c_n_scdn_equ c_load_scdn_equ /end DEF_CHARACTERISTIC
 /begin OUT_MEASUREMENT fmy_scdn_equ_fsd_2.ctr_scdn_equ_dc fmy_scdn_equ_fsd_2.scdn_info fmy_scdn_equ_fsd_1.ctr_scdn_equ_dc fmy_scdn_equ_fsd_1.scdn_info fmy_scdn_equ_mis_1.ctr_scdn_equ_dc fmy_scdn_equ_mis_1.scdn_info fmy_scdn_equ_mis_2.ctr_scdn_equ_dc fmy_scdn_equ_mis_2.scdn_info fmy_scdn_equ_mis_3.ctr_scdn_equ_dc fmy_scdn_equ_mis_3.scdn_info fmy_scdn_equ_mis_4.ctr_scdn_equ_dc fmy_scdn_equ_mis_4.scdn_info fmy_scdn_equ_mis_0.ctr_scdn_equ_dc fmy_scdn_equ_mis_0.scdn_info fmy_scdn_equ_mis_5.ctr_scdn_equ_dc fmy_scdn_equ_mis_5.scdn_info /end OUT_MEASUREMENT
/end FUNCTION
/begin FUNCTION OBD_Lamp_management "_Lamp management"
 /begin DEF_CHARACTERISTIC c_conf_mil c_conf_wal_1 c_conf_wal_2 lc_inh_wal_st c_dly_wal_st c_dly_inh_iv_mis /end DEF_CHARACTERISTIC
 /begin OUT_MEASUREMENT rel_dist_act_mil state_mil rel_dist_act_wal_1 rel_dist_act_wal_2 lv_wal_2 state_wal_1 state_wal_2 dist_act_wal_2 dist_act_wal_1 dist_act_mil lv_mil lv_wal_1 lv_wal_st /end OUT_MEASUREMENT
/end FUNCTION
/begin FUNCTION OBD_Activation_conditions_for_ca "_Activation conditions for cat eff and O2 sensor diag"
 /begin DEF_CHARACTERISTIC c_cl_max_cat_ls_diag lc_ls_cat_diag_cdn_man_act ip_maf_lam_cat_min__n_32 ip_maf_lam_cat_max__n_32 c_tco_min_cat c_temp_min_cat c_temp_max_cat c_temp_hys_cat c_vs_min_cat c_vs_max_cat c_amp_min_cat_ls_diag c_maf_int_cat_diag_dly /end DEF_CHARACTERISTIC
 /begin OUT_MEASUREMENT lam_bank_1.cat_eff_act.lv_ls_cat_diag_cdn lam_bank_1.cat_eff_act.maf_int_cat_diag_dly lam_bank_2.cat_eff_act.lv_ls_cat_diag_cdn lam_bank_2.cat_eff_act.maf_int_cat_diag_dly /end OUT_MEASUREMENT
/end FUNCTION
/end MODULE
/end PROJECT
